ASAP2_VERSION 1 41
/begin PROJECT MSD70 "Spray Guided DI-System with Piezo Injectors for 6-Cylinder"
/begin HEADER "_default_HeaderComment" PROJECT_NO _0B /end HEADER
/begin MODULE _default_ModuleName "_default_ModuleLongIdentifier"
/begin MOD_COMMON "_default_ModCommonComment" DEPOSIT ABSOLUTE BYTE_ORDER MSB_LAST ALIGNMENT_BYTE 1 ALIGNMENT_WORD 2 ALIGNMENT_LONG 2 ALIGNMENT_FLOAT32_IEEE 2 ALIGNMENT_FLOAT64_IEEE 4 /end MOD_COMMON
/begin MEASUREMENT err_ecraspwm_fb "The failure status of the failure feedback coming from the ECRAS control unit " UBYTE _CNV_A_R_LINEAR_____0_CM 1 100. 0. 8. DISPLAY_IDENTIFIER ERR_ECRASPWM_FB ECU_ADDRESS 0xd0003e76 FORMAT "%1.0" /end MEASUREMENT
/begin MEASUREMENT t_ecraspwm_fb "Timer counting tlow for failure feedback recognition" UBYTE _CNV_A_R_LINEAR_____4_CM 1 100. 0. 25.5 DISPLAY_IDENTIFIER T_ECRASPWM_FB ECU_ADDRESS 0xc00005a0 FORMAT "%4.1" /end MEASUREMENT
/begin MEASUREMENT lv_ecraspwm_fb_vld "If LV_ECRASPWM_FB_VLD  = 1 the failure number ERR_ECRASPWM_FB  (01H) is valid" UBYTE _CNV_S_2_RANGE__0___1_CM 1 100. 0. 1. DISPLAY_IDENTIFIER LV_ECRASPWM_FB_VLD ECU_ADDRESS 0xd0003e78 /end MEASUREMENT
/begin MEASUREMENT cdn_diag_ecras_el "Diagnosis condition for each symptom of ECRAS_EL	" UBYTE _CNV_A_R_LINEAR_____0_CM 1 100. 0. 7. DISPLAY_IDENTIFIER CDN_DIAG_ECRAS_EL ECU_ADDRESS 0xc00005a1 FORMAT "%1.0" /end MEASUREMENT
/begin MEASUREMENT abc_ecraspwm_fb "Antibounce counter for ECRAS failure feedback diagnosis." UBYTE _CNV_A_R_LINEAR_____0_CM 1 100. 0. 255. DISPLAY_IDENTIFIER ABC_ECRASPWM_FB ECU_ADDRESS 0xc00005a2 FORMAT "%3.0" /end MEASUREMENT
/begin MEASUREMENT t_act_ecraspwm_fb "Time with ECRASPWM  > C_EFPPWM_MIN_FB necessary to have failure feedback from ECRAS control unit" UWORD _CNV_A_R_LINEAR_____4_CM 1 100. 0. 6553.5 DISPLAY_IDENTIFIER T_ACT_ECRASPWM_FB ECU_ADDRESS 0xc000059c FORMAT "%6.1" /end MEASUREMENT
/begin MEASUREMENT lv_err_ecras_el "Boolean for error currently present on ECRAS command signal" UBYTE _CNV_S_2_RANGE__0___1_CM 1 100. 0. 1. DISPLAY_IDENTIFIER LV_ERR_ECRAS_EL ECU_ADDRESS 0xd00034c9 /end MEASUREMENT
/begin MEASUREMENT lv_err_ecras "Boolean for error currently present on ECRAS command signal." UBYTE _CNV_S_2_RANGE__0___1_CM 1 100. 0. 1. DISPLAY_IDENTIFIER LV_ERR_ECRAS ECU_ADDRESS 0xd0003e77 /end MEASUREMENT
/begin MEASUREMENT lv_err_ecraspwm_fb "Error currently present, indicated by failure feedback from ECRAS control unit" UBYTE _CNV_S_2_RANGE__0___1_CM 1 100. 0. 1. DISPLAY_IDENTIFIER LV_ERR_ECRASPWM_FB ECU_ADDRESS 0xd00034c8 /end MEASUREMENT
/begin MEASUREMENT err_diag_ecraspwm "Raw value of error symptom for ECRASPWM detected on interface ECU and ECRAS control unit	" UBYTE _CNV_A_R_LINEAR_____0_CM 1 100. 0. 8. DISPLAY_IDENTIFIER ERR_DIAG_ECRASPWM ECU_ADDRESS 0xd0003e74 FORMAT "%1.0" /end MEASUREMENT
/begin MEASUREMENT lv_intr_diag_ecras_el "Boolean for irreversible interrupt of ECARS_EL diagnosis" UBYTE _CNV_S_2_RANGE__0___1_CM 1 100. 0. 1. DISPLAY_IDENTIFIER LV_INTR_DIAG_ECRAS_EL ECU_ADDRESS 0xd0003e79 BIT_MASK 0x1 /end MEASUREMENT
/begin AXIS_PTS ldpm_gear_ef_1 "" 0xa1021af8 gear_ef _REC_AXS_20_u1 6. _CNV_A_R_LINEAR_____0_CM 7 0. 6. FORMAT "%1.0" /end AXIS_PTS
/begin AXIS_PTS ldpm_n_ef "" 0xa1021ffa n_ef _REC_AXS_20_u1 8160. _CNV_A_R_LINEAR_____9_CM 6 0. 8160. FORMAT "%4.0" /end AXIS_PTS
/begin AXIS_PTS ldp_n_32_ip_t_dly_ef "" 0xa1020e40 n_32 _REC_AXS_20_u1 8160. _CNV_A_R_LINEAR_____9_CM 8 0. 8160. FORMAT "%4.0" /end AXIS_PTS
/begin AXIS_PTS ldp_maf__thd_is_er_diag "" 0xa1020c5a maf _REC_AXS_20_u1 1389. _CNV_A_R_LINEAR_____14_CM 4 0. 1389. FORMAT "%4.0" /end AXIS_PTS
/begin AXIS_PTS ldp_n__thd_is_er_diag "" 0xa1020ec8 n _REC_AXS_20_u2 816. _CNV_A_R_LINEAR_____13_CM 4 0. 8160. FORMAT "%4.0" /end AXIS_PTS
/begin AXIS_PTS ldp_tco__fac_thd_is_er_diag "" 0xa1021278 tco _REC_AXS_20_u1 190.5 _CNV_A_R_LINEAR_____16_CM 8 -48. 142.5 FORMAT "%5.1" /end AXIS_PTS
/begin AXIS_PTS ldpm_n_sof "" 0xa10220dc n_sof _REC_AXS_20_u1 8160. _CNV_A_R_LINEAR_____9_CM 6 0. 8160. FORMAT "%4.0" /end AXIS_PTS
/begin AXIS_PTS ldp_n_32_ip_t_dly_sof "" 0xa1020e4c n_32 _REC_AXS_20_u1 8160. _CNV_A_R_LINEAR_____9_CM 8 0. 8160. FORMAT "%4.0" /end AXIS_PTS
/begin AXIS_PTS ldpm_n_32__t_acc "" 0xa1021e2c n_32 _REC_AXS_20_u1 8160. _CNV_A_R_LINEAR_____9_CM 3 0. 8160. FORMAT "%4.0" /end AXIS_PTS
/begin AXIS_PTS ldp_vs__amp_raw_cor "" 0xa102185c vs _REC_AXS_20_u1 255. _CNV_A_R_LINEAR_____6_CM 8 0. 255. FORMAT "%3.0" /end AXIS_PTS
/begin AXIS_PTS ldp_v_amp__amp_raw "" 0xa1021630 v_amp _REC_AXS_20_u2 4.9951171875 _CNV_A_R_LINEAR_____2_CM 8 0. 4.9951171875 FORMAT "%5.3" /end AXIS_PTS
/begin AXIS_PTS ldpm_n_2_3 "" 0xa1021d3c n _REC_AXS_20_u2 816. _CNV_A_R_LINEAR_____13_CM 16 0. 8160. FORMAT "%4.0" /end AXIS_PTS
/begin AXIS_PTS ldp_toil__t_dly_poil_swi_can "" 0xa10213f0 toil _REC_AXS_20_u1 200. _CNV_A_R_LINEAR_____25_CM 6 -40. 160. FORMAT "%3.0" /end AXIS_PTS
/begin CHARACTERISTIC lc_snd_msg_oil_key_aux "LC for transmitting Layer-values independent of Kl.15" VALUE 0xa1029dd5 _REC_VAL_20_u1 1. _CNV_S_2_RANGE__0___1_CM 0. 1. DISPLAY_IDENTIFIER LC_SND_MSG_OIL_KEY_AUX /end CHARACTERISTIC
/begin AXIS_PTS lpdm_ctr_km_can "" 0xa102242c ctr_km_can _REC_AXS_20_u2 655340. _CNV_A_R_LINEAR_____70_CM 4 0. 655340. FORMAT "%6.0" /end AXIS_PTS
/begin AXIS_PTS ldpm_tco_2 "" 0xa1022224 tco _REC_AXS_20_u1 190.5 _CNV_A_R_LINEAR_____16_CM 8 -48. 142.5 FORMAT "%5.1" /end AXIS_PTS
/begin AXIS_PTS ldpm_ctr_km_can_1 "" 0xa1021924 ctr_km_can _REC_AXS_20_u2 655350. _CNV_A_R_LINEAR_____70_CM 4 0. 655350. FORMAT "%7.0" /end AXIS_PTS
/begin AXIS_PTS ldpm_t_ctl_cru_1 "" 0xa10221ee t_ctl_cru _REC_AXS_20_u1 2.55 _CNV_A_R_LINEAR_____4_CM 5 0. 25.5 FORMAT "%4.1" /end AXIS_PTS
/begin AXIS_PTS ldp_vs_dif_cru__fac_prop_cru "" 0xa1021868 vs_dif_cru _REC_AXS_20_u2 511.9921875 _CNV_A_R_LINEAR_____98_CM 4 -256. 255.9921875 FORMAT "%7.3" /end AXIS_PTS
/begin AXIS_PTS ldpm_vs_sp_dif_cru_1 "" 0xa1022410 vs_sp_dif_cru _REC_AXS_20_u2 511.9921875 _CNV_A_R_LINEAR_____98_CM 5 -256. 255.9921875 FORMAT "%7.3" /end AXIS_PTS
/begin AXIS_PTS ldpm_n_21 "" 0xa1021d36 n_32 _REC_AXS_20_u1 8160. _CNV_A_R_LINEAR_____9_CM 3 0. 8160. FORMAT "%4.0" /end AXIS_PTS
/begin AXIS_PTS ldpm_vs_sp_cru_1 "" 0xa1022404 vs_sp_cru _REC_AXS_20_u2 511.99218 _CNV_A_R_LINEAR_____66_CM 5 0. 511.99218 FORMAT "%7.3" /end AXIS_PTS
/begin AXIS_PTS ldpm_ac_cru__fac_tq_cru "" 0xa10218c8 ac_cru _REC_AXS_20_u2 31.43952 _CNV_A_R_LINEAR_____103_CM 6 -15.72 15.71952 FORMAT "%8.4" /end AXIS_PTS
/begin AXIS_PTS ldpm_gear__fac_tq_cru "" 0xa1021ad8 gear _REC_AXS_20_u1 255. _CNV_A_R_LINEAR_____0_CM 12 0. 255. FORMAT "%3.0" /end AXIS_PTS
/begin AXIS_PTS ldp_n_32__fac_tq_cru "" 0xa1020d72 n_32 _REC_AXS_20_u1 816. _CNV_A_R_LINEAR_____9_CM 5 0. 8160. FORMAT "%4.0" /end AXIS_PTS
/begin AXIS_PTS ldpm_fac_tq_cru_1 "" 0xa1021a78 fac_tq_cru _REC_AXS_20_u2 99.99847412109381 _CNV_A_R_LINEAR_____7_CM 3 0. 99.99847412109381 /end AXIS_PTS
/begin AXIS_PTS ldp_n_32__fac_tq_req_clu_is "" 0xa1020d78 n_32 _REC_AXS_20_u1 8160. _CNV_A_R_LINEAR_____9_CM 3 0. 8160. FORMAT "%4.0" /end AXIS_PTS
/begin AXIS_PTS ldp_ftl__t_cur_dmtl_stat "" 0xa1020a38 ftl _REC_AXS_20_u1 126. _CNV_A_R_LINEAR_____76_CM 8 0. 126. FORMAT "%3.0" /end AXIS_PTS
/begin AXIS_PTS ldp_ftl__t_small_leak_test "" 0xa1020a48 ftl _REC_AXS_20_u1 126. _CNV_A_R_LINEAR_____76_CM 5 0. 126. FORMAT "%3.0" /end AXIS_PTS
/begin AXIS_PTS ldp_vb_dmtl_fil__fac_cur_dmtl "" 0xa102170c vb_dmtl_fil _REC_AXS_20_u2 26. _CNV_A_R_LINEAR_____140_CM 6 0. 26. FORMAT "%7.4" /end AXIS_PTS
/begin AXIS_PTS ldpm_cur_dmtldifrefroughleak_1 "" 0xa1021930 cur_dmtl_dif_ref_rough_leak _REC_AXS_20_u2 400. _CNV_A_R_LINEAR_____133_CM 8 0. 400. FORMAT "%7.3" /end AXIS_PTS
/begin AXIS_PTS ldp_ftl__t_rough_leak_test "" 0xa1020a42 ftl _REC_AXS_20_u1 126. _CNV_A_R_LINEAR_____76_CM 5 0. 126. FORMAT "%3.0" /end AXIS_PTS
/begin MEASUREMENT cycnr_puc "" UWORD _CNV_A_R_LINEAR_____0_CM 1 100. 0. 65535. DISPLAY_IDENTIFIER CYCNR_PUC ECU_ADDRESS 0xc00005f4 FORMAT "%5.0" /end MEASUREMENT
/begin MEASUREMENT n_hys_puc "" UBYTE _CNV_A_R_LINEAR_____9_CM 1 100. 0. 8160. DISPLAY_IDENTIFIER N_HYS_PUC ECU_ADDRESS 0xc00005f8 FORMAT "%4.0" /end MEASUREMENT
/begin MEASUREMENT n_min_puc "" UBYTE _CNV_A_R_LINEAR_____9_CM 1 100. 0. 8160. DISPLAY_IDENTIFIER N_MIN_PUC ECU_ADDRESS 0xd0003cc5 FORMAT "%4.0" /end MEASUREMENT
/begin AXIS_PTS ldpm_tco_1_6 "" 0xa10221fa tco _REC_AXS_20_u1 28.575 _CNV_A_R_LINEAR_____16_CM 6 -48. 142.5 FORMAT "%5.1" /end AXIS_PTS
/begin AXIS_PTS ldpm_gr_mt_3 "" 0xa1021b1c gr_mt _REC_AXS_20_u1 255. _CNV_A_R_LINEAR_____0_CM 13 0. 255. FORMAT "%3.0" /end AXIS_PTS
/begin AXIS_PTS ldpm_gr_at_3 "" 0xa1021b00 gr_at _REC_AXS_20_u1 255. _CNV_A_R_LINEAR_____0_CM 13 0. 255. FORMAT "%3.0" /end AXIS_PTS
/begin AXIS_PTS ldpm_tco_9 "" 0xa1022230 tco _REC_AXS_20_u1 28.575 _CNV_A_R_LINEAR_____16_CM 9 -48. 142.5 FORMAT "%5.1" /end AXIS_PTS
/begin AXIS_PTS ldp_n__t_min_pu "" 0xa1020eb4 n _REC_AXS_20_u2 8159. _CNV_A_R_LINEAR_____13_CM 8 1. 8160. FORMAT "%4.0" /end AXIS_PTS
/begin AXIS_PTS ldp_tco__t_min_pu "" 0xa1021294 tco _REC_AXS_20_u1 190.5 _CNV_A_R_LINEAR_____16_CM 6 -48. 142.5 FORMAT "%5.1" /end AXIS_PTS
/begin AXIS_PTS ldp_tq_loss_ars_sp_can__puc "" 0xa1021554 tq_loss_ars_sp_can _REC_AXS_20_u2 2047.96875 _CNV_A_R_LINEAR_____65_CM 6 -1024. 1023.96875 FORMAT "%6.2" /end AXIS_PTS
/begin AXIS_PTS ldp_tq_loss_pste_2_sp_can__puc "" 0xa10215c4 tq_loss_pste_2_sp_can _REC_AXS_20_u2 2047.96875 _CNV_A_R_LINEAR_____65_CM 6 -1024. 1023.96875 FORMAT "%6.2" /end AXIS_PTS
/begin AXIS_PTS ldp_n_grd_n_dif_max_is "" 0xa1020f16 n_grd _REC_AXS_20_u1 8160. _CNV_A_R_LINEAR_____28_CM 6 -4096. 4064. FORMAT "%5.0" /end AXIS_PTS
/begin MEASUREMENT lv_diagcps_min_mod "Indication EVAC sent into MIN_PURGE by FC CPS" UBYTE _CNV_S_2_RANGE__0___1_CM 1 100. 0. 1. DISPLAY_IDENTIFIER LV_DIAGCPS_MIN_MOD ECU_ADDRESS 0xd0003773 /end MEASUREMENT
/begin MEASUREMENT lv_eol_cps_ini "LV indicating EOL-requested functional check CPS " UBYTE _CNV_S_2_RANGE__0___1_CM 1 100. 0. 1. DISPLAY_IDENTIFIER LV_EOL_CPS_INI ECU_ADDRESS 0xd0003774 /end MEASUREMENT
/begin MEASUREMENT lv_opm_av_cng_diagcps "LV indicating change of operation mode " UBYTE _CNV_S_2_RANGE__0___1_CM 1 100. 0. 1. DISPLAY_IDENTIFIER LV_OPM_AV_CNG_DIAGCPS ECU_ADDRESS 0xd0003775 /end MEASUREMENT
/begin MEASUREMENT t_diagcps_dly_1_rbm "Delay time step 2 (RBM) - functional check CPS" UBYTE _CNV_A_R_LINEAR_____4_CM 1 100. 0.1 25.5 DISPLAY_IDENTIFIER T_DIAGCPS_DLY_1_RBM ECU_ADDRESS 0xc0000653 FORMAT "%4.1" /end MEASUREMENT
/begin MEASUREMENT t_diagcps_dly_2_rbm "Delay time step 3 (RBM) - functional check CPS" UBYTE _CNV_A_R_LINEAR_____4_CM 1 100. 0.1 25.5 DISPLAY_IDENTIFIER T_DIAGCPS_DLY_2_RBM ECU_ADDRESS 0xc0000654 FORMAT "%4.1" /end MEASUREMENT
/begin MEASUREMENT t_diagcps_maf_rbm "Time for active FLOW_SP offset  step 3 (RBM) - functional check CPS" UBYTE _CNV_A_R_LINEAR_____4_CM 1 100. 0.1 25.5 DISPLAY_IDENTIFIER T_DIAGCPS_MAF_RBM ECU_ADDRESS 0xc0000655 FORMAT "%4.1" /end MEASUREMENT
/begin MEASUREMENT lv_t_diagcps_rbm "Auxiliary bit timer for RBM - functional check CPS" UBYTE _CNV_S_2_RANGE__0___1_CM 1 100. 0. 1. DISPLAY_IDENTIFIER LV_T_DIAGCPS_RBM ECU_ADDRESS 0xc0000660 /end MEASUREMENT
/begin MEASUREMENT t_diagcps_n_map_1_rbm "time interval for N-DIF-Diagnosis step 2 (RBM) - functional check CPS" UWORD _CNV_A_R_LINEAR_____4_CM 1 100. 0.1 6553.5 DISPLAY_IDENTIFIER T_DIAGCPS_N_MAP_1_RBM ECU_ADDRESS 0xc0000640 FORMAT "%6.1" /end MEASUREMENT
/begin AXIS_PTS ldp_n_vs_ratio_gr_mt "" 0xa1021038 n_vs_ratio _REC_AXS_20_u1 255. _CNV_A_R_LINEAR_____0_CM 13 0. 255. FORMAT "%3.0" /end AXIS_PTS
/begin AXIS_PTS ldpm_tco_1_igsp "" 0xa102220c tco _REC_AXS_20_u1 190.5 _CNV_A_R_LINEAR_____16_CM 8 -48. 142.5 FORMAT "%5.1" /end AXIS_PTS
/begin AXIS_PTS ldpm_cyc_cast_ip_iga_dif_min "" 0xa1021984 cyc_cast _REC_AXS_20_u2 65535. _CNV_A_R_LINEAR_____0_CM 8 0. 65535. FORMAT "%5.0" /end AXIS_PTS
/begin AXIS_PTS ldpm_n_32_2_igsp "" 0xa1021db8 n_32 _REC_AXS_20_u1 8160. _CNV_A_R_LINEAR_____9_CM 8 0. 8160. FORMAT "%4.0" /end AXIS_PTS
/begin AXIS_PTS ldpm_maf_hb_2_igsp "" 0xa1021c36 maf _REC_AXS_20_u1 1389. _CNV_A_R_LINEAR_____14_CM 6 0. 1389. FORMAT "%4.0" /end AXIS_PTS
/begin AXIS_PTS ldp_amp_ip_iga_dif_min_cyc_amp "" 0xa102086c amp _REC_AXS_20_u2 5434. _CNV_A_R_LINEAR_____26_CM 6 0. 5434. FORMAT "%7.2" /end AXIS_PTS
/begin AXIS_PTS ldpm_n_dif_igsp "" 0xa1021fc0 n_dif _REC_AXS_20_u2 65535. _CNV_A_R_LINEAR_____172_CM 8 -32768. 32767. FORMAT "%6.0" /end AXIS_PTS
/begin AXIS_PTS ldp_eff_iga_inv_cor_ip_iga_dif "" 0xa10208d0 eff_iga_inv_cor _REC_AXS_20_u2 100. _CNV_A_R_LINEAR_____173_CM 16 0. 100. FORMAT "%5.3" /end AXIS_PTS
/begin AXIS_PTS ldpm_cyc_1_iga_st "" 0xa1021942 NO_INPUT_QUANTITY _REC_AXS_20_u1 255. _CNV_A_R_LINEAR_____0_CM 6 0. 255. FORMAT "%3.0" /end AXIS_PTS
/begin AXIS_PTS ldpm_n_1_iga_st "" 0xa1021d28 n _REC_AXS_20_u2 8160. _CNV_A_R_LINEAR_____13_CM 6 0. 8160. FORMAT "%4.0" /end AXIS_PTS
/begin AXIS_PTS ldpm_amp_1_iga_st "" 0xa10218ec amp _REC_AXS_20_u2 5434. _CNV_A_R_LINEAR_____26_CM 6 0. 5434. FORMAT "%7.2" /end AXIS_PTS
/begin AXIS_PTS ldpm_tia_1_iga_st "" 0xa1022306 tia _REC_AXS_20_u1 190.5 _CNV_A_R_LINEAR_____16_CM 6 -48. 142.5 FORMAT "%5.1" /end AXIS_PTS
/begin AXIS_PTS ldp_teg_dyn_hys "" 0xa10212e8 teg_dyn_hys _REC_AXS_20_u2 2047. _CNV_A_R_LINEAR_____123_CM 16 0. 2047. FORMAT "%7.2" /end AXIS_PTS
/begin AXIS_PTS ldpm_tco_is_1 "" 0xa1022294 tco _REC_AXS_20_u1 190.5 _CNV_A_R_LINEAR_____16_CM 8 -48. 142.5 FORMAT "%5.1" /end AXIS_PTS
/begin AXIS_PTS ldpm_gr_mt_2 "" 0xa1021b10 gr_mt _REC_AXS_20_u1 255. _CNV_A_R_LINEAR_____0_CM 8 0. 255. FORMAT "%3.0" /end AXIS_PTS
/begin AXIS_PTS ldpm_t_ast__fac_n_grd_is "" 0xa10221dc t_ast _REC_AXS_20_u2 6553.5 _CNV_A_R_LINEAR_____4_CM 8 0. 6553.5 FORMAT "%5.1" /end AXIS_PTS
/begin AXIS_PTS ldpm_tco__fac_n_grd_is "" 0xa102223a tco _REC_AXS_20_u1 190.5 _CNV_A_R_LINEAR_____16_CM 3 -48. 142.5 FORMAT "%6.2" /end AXIS_PTS
/begin AXIS_PTS ldp_tco__fac_tco_pas_i_is "" 0xa1021270 tco _REC_AXS_20_u1 190.5 _CNV_A_R_LINEAR_____16_CM 4 -48. 142.5 FORMAT "%5.1" /end AXIS_PTS
/begin AXIS_PTS ldpm_n_dif_cor_p_d_dt_is_opm_1 "" 0xa1021ea8 n_dif_cor _REC_AXS_20_u2 65535. _CNV_A_R_LINEAR_____172_CM 12 -32768. 32767. FORMAT "%6.0" /end AXIS_PTS
/begin AXIS_PTS ldpm_n_dif_cor_p_d_dt_is_opm_2 "" 0xa1021ec4 n_dif_cor _REC_AXS_20_u2 65535. _CNV_A_R_LINEAR_____172_CM 10 -32768. 32767. FORMAT "%6.0" /end AXIS_PTS
/begin AXIS_PTS ldpm_n_grd_p_d_dt_is_opm_1 "" 0xa1022038 n_grd _REC_AXS_20_u1 8160. _CNV_A_R_LINEAR_____28_CM 8 -4096. 4064. FORMAT "%5.0" /end AXIS_PTS
/begin AXIS_PTS ldpm_n_grd_p_d_dt_is_opm_2 "" 0xa1022044 n_grd _REC_AXS_20_u1 8160. _CNV_A_R_LINEAR_____28_CM 8 -4096. 4064. FORMAT "%5.0" /end AXIS_PTS
/begin AXIS_PTS ldpm_n_dif_cor_p_d_is_opm_1 "" 0xa1021edc n_dif_cor _REC_AXS_20_u2 65535. _CNV_A_R_LINEAR_____172_CM 12 -32768. 32767. FORMAT "%6.0" /end AXIS_PTS
/begin AXIS_PTS ldpm_n_dif_cor_p_d_is_opm_2 "" 0xa1021ef8 n_dif_cor _REC_AXS_20_u2 65535. _CNV_A_R_LINEAR_____172_CM 10 -32768. 32767. FORMAT "%6.0" /end AXIS_PTS
/begin AXIS_PTS ldpm_n_grd_p_d_is_opm_1 "" 0xa1022050 n_grd _REC_AXS_20_u1 8160. _CNV_A_R_LINEAR_____28_CM 8 -4096. 4064. FORMAT "%5.0" /end AXIS_PTS
/begin AXIS_PTS ldpm_n_grd_p_d_is_opm_2 "" 0xa102205c n_grd _REC_AXS_20_u1 8160. _CNV_A_R_LINEAR_____28_CM 8 -4096. 4064. FORMAT "%5.0" /end AXIS_PTS
/begin AXIS_PTS ldpm_n_dif_cor_tq_i_is_1_opm_1 "" 0xa1021f48 n_dif_cor _REC_AXS_20_u2 65535. _CNV_A_R_LINEAR_____172_CM 12 -32768. 32767. FORMAT "%6.0" /end AXIS_PTS
/begin AXIS_PTS ldpm_n_dif_cor_tq_i_is_1_opm_2 "" 0xa1021f64 n_dif_cor _REC_AXS_20_u2 65535. _CNV_A_R_LINEAR_____172_CM 12 -32768. 32767. FORMAT "%6.0" /end AXIS_PTS
/begin AXIS_PTS ldpm_n_grd_tq_i_is_1_opm_1 "" 0xa1022068 n_grd _REC_AXS_20_u1 8160. _CNV_A_R_LINEAR_____28_CM 8 -4096. 4064. FORMAT "%5.0" /end AXIS_PTS
/begin AXIS_PTS ldpm_n_grd_tq_i_is_1_opm_2 "" 0xa1022074 n_grd _REC_AXS_20_u1 8160. _CNV_A_R_LINEAR_____28_CM 8 -4096. 4064. FORMAT "%5.0" /end AXIS_PTS
/begin AXIS_PTS ldpm_n_dif_cor_tq_i_dt_is_opm_1 "" 0xa1021f10 n_dif_cor _REC_AXS_20_u2 65535. _CNV_A_R_LINEAR_____172_CM 12 -32768. 32767. FORMAT "%6.0" /end AXIS_PTS
/begin AXIS_PTS ldpm_n_dif_cor_tq_i_dt_is_opm_2 "" 0xa1021f2c n_dif_cor _REC_AXS_20_u2 65535. _CNV_A_R_LINEAR_____172_CM 12 -32768. 32767. FORMAT "%6.0" /end AXIS_PTS
/begin AXIS_PTS ldpm_n_dif_cor_tq_i_is_opm_1 "" 0xa1021f80 n_dif_cor _REC_AXS_20_u2 65535. _CNV_A_R_LINEAR_____172_CM 4 -32768. 32767. FORMAT "%6.0" /end AXIS_PTS
/begin AXIS_PTS ldpm_n_dif_cor_tq_i_is_opm_2 "" 0xa1021f8c n_dif_cor _REC_AXS_20_u2 65535. _CNV_A_R_LINEAR_____172_CM 4 -32768. 32767. FORMAT "%6.0" /end AXIS_PTS
/begin AXIS_PTS ldpm_n_grd_tq_i_is_opm_1 "" 0xa102207e n_grd _REC_AXS_20_u1 8160. _CNV_A_R_LINEAR_____180_CM 4 -4096. 4064. FORMAT "%5.0" /end AXIS_PTS
/begin AXIS_PTS ldpm_n_grd_tq_i_is_opm_2 "" 0xa1022084 n_grd _REC_AXS_20_u1 8160. _CNV_A_R_LINEAR_____180_CM 4 -4096. 4064. FORMAT "%5.0" /end AXIS_PTS
/begin AXIS_PTS ldp_tco__fac_n_grd_is_thr "" 0xa102126a tco _REC_AXS_20_u1 190.5 _CNV_A_R_LINEAR_____16_CM 4 -48. 142.5 FORMAT "%6.2" /end AXIS_PTS
/begin AXIS_PTS ldp_t_ast__fac_n_grd_is_thr "" 0xa10211a4 t_ast _REC_AXS_20_u2 6553.5 _CNV_A_R_LINEAR_____4_CM 6 0. 6553.5 FORMAT "%5.1" /end AXIS_PTS
/begin AXIS_PTS ldpm_n_sp_is_tq_add_is_bol_bas "" 0xa10220e4 n_sp_is _REC_AXS_20_u2 8160. _CNV_A_R_LINEAR_____13_CM 6 0. 8160. FORMAT "%4.0" /end AXIS_PTS
/begin AXIS_PTS ldp_n_sp_is_tq_add_is_bol_bas_opm_2 "" 0xa102101c n_sp_is _REC_AXS_20_u2 8160. _CNV_A_R_LINEAR_____13_CM 4 0. 8160. FORMAT "%4.0" /end AXIS_PTS
/begin AXIS_PTS ldpm_tco_tq_add_is_bol_bas "" 0xa10222de tco _REC_AXS_20_u1 190.5 _CNV_A_R_LINEAR_____16_CM 6 -48. 142.5 FORMAT "%5.1" /end AXIS_PTS
/begin AXIS_PTS ldp_tco_tq_add_is_bol_bas_opm_2 "" 0xa10212e2 tco _REC_AXS_20_u1 190.5 _CNV_A_R_LINEAR_____16_CM 4 -48. 142.5 FORMAT "%5.1" /end AXIS_PTS
/begin AXIS_PTS ldpm_toil_ip_fac_temp_tq_add_is "" 0xa1022356 toil _REC_AXS_20_u1 200. _CNV_A_R_LINEAR_____25_CM 6 -40. 160. FORMAT "%3.0" /end AXIS_PTS
/begin AXIS_PTS ldpm_tia_ip_fac_temp_tq_add_is "" 0xa1022314 tia _REC_AXS_20_u1 190.5 _CNV_A_R_LINEAR_____16_CM 6 -48. 142.5 FORMAT "%5.1" /end AXIS_PTS
/begin AXIS_PTS ldpm_maf_fac_tq_add_is "" 0xa1021c10 maf _REC_AXS_20_u2 1389. _CNV_A_R_LINEAR_____108_CM 6 0. 1389. FORMAT "%4.0" /end AXIS_PTS
/begin AXIS_PTS ldpm_maf_fac_tq_add_is_opm2 "" 0xa1021c1e maf _REC_AXS_20_u2 1389. _CNV_A_R_LINEAR_____108_CM 1 0. 1389. FORMAT "%4.0" /end AXIS_PTS
/begin AXIS_PTS ldpm_vs_fil_ip_fac_vs_tq_add_is "" 0xa10223f8 vs_fil _REC_AXS_20_u2 511.99218 _CNV_A_R_LINEAR_____66_CM 4 0. 511.99218 FORMAT "%7.3" /end AXIS_PTS
/begin AXIS_PTS ldp_maf_lgrd_tq_add_is_bol "" 0xa1020ccc maf _REC_AXS_20_u2 1389. _CNV_A_R_LINEAR_____108_CM 6 0. 1389. FORMAT "%4.0" /end AXIS_PTS
/begin AXIS_PTS ldp_vlft_min_ip_tq_add_is_cor "" 0xa102178c NO_INPUT_QUANTITY _REC_AXS_20_u2 65.535 _CNV_A_R_LINEAR_____185_CM 6 0. 65.535 /end AXIS_PTS
/begin AXIS_PTS ldp_map_dip_sp_mmv_ip_tq_add_is "" 0xa1020d18 NO_INPUT_QUANTITY _REC_AXS_20_u2 2559.9609375 _CNV_A_R_LINEAR_____186_CM 6 -1280. 1279.9609375 FORMAT "%8.2" /end AXIS_PTS
/begin AXIS_PTS ldp_n_lgrd_tq_add_is_bol "" 0xa1020f90 n _REC_AXS_20_u2 8160. _CNV_A_R_LINEAR_____13_CM 6 0. 8160. FORMAT "%4.0" /end AXIS_PTS
/begin AXIS_PTS ldp_n_lgrd_tq_add_is_bol_opm_2 "" 0xa1020fa0 n _REC_AXS_20_u2 8160. _CNV_A_R_LINEAR_____13_CM 6 0. 8160. FORMAT "%4.0" /end AXIS_PTS
/begin AXIS_PTS ldpm_n_4_9 "" 0xa1021e7e n_knk _REC_AXS_20_u1 8160. _CNV_A_R_LINEAR_____9_CM 3 0. 8160. FORMAT "%4.0" /end AXIS_PTS
/begin AXIS_PTS ldpm_n_6_4 "" 0xa1021e82 n_knk _REC_AXS_20_u1 8160. _CNV_A_R_LINEAR_____9_CM 4 0. 8160. FORMAT "%4.0" /end AXIS_PTS
/begin AXIS_PTS ldpm_n_iga_max_knk "" 0xa10220c4 n_32 _REC_AXS_20_u1 8160. _CNV_A_R_LINEAR_____9_CM 8 0. 8160. FORMAT "%4.0" /end AXIS_PTS
/begin AXIS_PTS ldpm_maf_iga_max_knk "" 0xa1021c54 maf _REC_AXS_20_u1 1389. _CNV_A_R_LINEAR_____14_CM 8 0. 1389. FORMAT "%4.0" /end AXIS_PTS
/begin AXIS_PTS ldp_tco__fac_iga_max_knk "" 0xa1021264 tco _REC_AXS_20_u1 190.5 _CNV_A_R_LINEAR_____16_CM 4 -48. 142.5 FORMAT "%5.1" /end AXIS_PTS
/begin AXIS_PTS ldp_tia__fac_iga_max_knk "" 0xa1021352 tia _REC_AXS_20_u1 190.5 _CNV_A_R_LINEAR_____16_CM 4 -48. 142.5 FORMAT "%5.1" /end AXIS_PTS
/begin AXIS_PTS ldpm_maf_1_9 "" 0xa1021b80 maf_knk _REC_AXS_20_u1 69.45 _CNV_A_R_LINEAR_____14_CM 4 0. 1389. FORMAT "%4.0" /end AXIS_PTS
/begin AXIS_PTS ldpm_n_2_9 "" 0xa1021d60 n_knk _REC_AXS_20_u1 8160. _CNV_A_R_LINEAR_____9_CM 16 0. 8160. FORMAT "%4.0" /end AXIS_PTS
/begin MEASUREMENT lam_bank_1.fsd_obd2.bf.lv_end_diag_win_fsd "End diagnosis cycle for similar conditions window" ULONG _CNV_S_2_RANGE______75_CM 1 100. 0. 1. DISPLAY_IDENTIFIER LV_END_DIAG_WIN_FSD_1 ECU_ADDRESS 0xd00055d8 BIT_MASK 0x1 /end MEASUREMENT
/begin MEASUREMENT lam_bank_1.fsd_obd2.bf.lv_det_sym_eve_fsd "Bit for second time counter FSD" ULONG _CNV_S_2_RANGE______75_CM 1 100. 0. 1. DISPLAY_IDENTIFIER LV_DET_SYM_EVE_FSD[1] ECU_ADDRESS 0xd00055d8 BIT_MASK 0x2 /end MEASUREMENT
/begin MEASUREMENT lam_bank_2.fsd_obd2.bf.lv_end_diag_win_fsd "End diagnosis cycle for similar conditions window" ULONG _CNV_S_2_RANGE______75_CM 1 100. 0. 1. DISPLAY_IDENTIFIER LV_END_DIAG_WIN_FSD_2 ECU_ADDRESS 0xd0005670 BIT_MASK 0x1 /end MEASUREMENT
/begin MEASUREMENT lam_bank_2.fsd_obd2.bf.lv_det_sym_eve_fsd "Bit for second time counter FSD" ULONG _CNV_S_2_RANGE______75_CM 1 100. 0. 1. DISPLAY_IDENTIFIER LV_DET_SYM_EVE_FSD[2] ECU_ADDRESS 0xd0005670 BIT_MASK 0x2 /end MEASUREMENT
/begin AXIS_PTS ldp_n__pq_sp_puls "" 0xa1020ea4 n _REC_AXS_20_u2 816. _CNV_A_R_LINEAR_____13_CM 6 0. 8160. FORMAT "%4.0" /end AXIS_PTS
/begin AXIS_PTS ldp_maf_kgh_mes_bas "" 0xa1020cbc maf_kgh_mes_bas _REC_AXS_20_u2 2047.96875 _CNV_A_R_LINEAR_____207_CM 6 0. 2047.96875 FORMAT "%7.2" /end AXIS_PTS
/begin AXIS_PTS ldp_tia_ip_fac_maf_kgh_cor "" 0xa1021376 tia _REC_AXS_20_u1 190.5 _CNV_A_R_LINEAR_____16_CM 6 -48. 142.5 FORMAT "%6.2" /end AXIS_PTS
/begin AXIS_PTS ldpm_maf_cyl_ex "" 0xa1021bfc maf_cyl _REC_AXS_20_u2 2047.96875 _CNV_A_R_LINEAR_____207_CM 8 0. 2047.96875 FORMAT "%6.2" /end AXIS_PTS
/begin AXIS_PTS ldpm_maf_flow_egr "" 0xa1021c24 maf_flow_ex _REC_AXS_20_u2 2047.96875 _CNV_A_R_LINEAR_____207_CM 8 0. 2047.96875 FORMAT "%6.2" /end AXIS_PTS
/begin AXIS_PTS ldp_n_32_ip_crlc_eff_vol_temp "" 0xa1020dea n_32 _REC_AXS_20_u1 8160. _CNV_A_R_LINEAR_____9_CM 6 0. 8160. FORMAT "%4.0" /end AXIS_PTS
/begin AXIS_PTS ldpm_n_32__eff_vol_cor "" 0xa1021e04 n_32 _REC_AXS_20_u1 8160. _CNV_A_R_LINEAR_____9_CM 8 0. 8160. FORMAT "%4.0" /end AXIS_PTS
/begin AXIS_PTS ldpm_maf__eff_vol_cor "" 0xa1021be8 maf _REC_AXS_20_u2 1389. _CNV_A_R_LINEAR_____108_CM 8 0. 1389. FORMAT "%7.2" /end AXIS_PTS
/begin AXIS_PTS ldp_n_32__crlc_v_maf_diag "" 0xa1020d6c n_32 _REC_AXS_20_u1 8160. _CNV_A_R_LINEAR_____9_CM 4 0. 8160. FORMAT "%4.0" /end AXIS_PTS
/begin AXIS_PTS ldp_v_map__map_mes_bas "" 0xa102165e v_map _REC_AXS_20_u2 4.5 _CNV_A_R_LINEAR_____2_CM 2 0. 5. FORMAT "%5.3" /end AXIS_PTS
/begin AXIS_PTS ldp_tps_dif__mtcpwm_p "" 0xa10214ac tps_dif _REC_AXS_20_u2 239. _CNV_A_R_LINEAR_____223_CM 8 -119.5 119.5 FORMAT "%8.3" /end AXIS_PTS
/begin AXIS_PTS ldp_tps_dif__mtcpwm_i "" 0xa1021498 tps_dif _REC_AXS_20_u2 239. _CNV_A_R_LINEAR_____223_CM 8 -119.5 119.5 FORMAT "%8.3" /end AXIS_PTS
/begin AXIS_PTS ldp_tps_av_lih_dif_mtcpwm_i "" 0xa1021484 tps_av_lih_dif _REC_AXS_20_u2 239. _CNV_A_R_LINEAR_____223_CM 8 -119.5 119.5 FORMAT "%8.3" /end AXIS_PTS
/begin AXIS_PTS ldp_tps_dif_grd__mtcpwm_d "" 0xa10214c0 tps_dif_grd _REC_AXS_20_u2 239. _CNV_A_R_LINEAR_____223_CM 8 -119.5 119.5 FORMAT "%8.3" /end AXIS_PTS
/begin AXIS_PTS ldp_tps_sp_lih_dif__mtcpwm_add "" 0xa10214d4 tps_sp_lih_dif _REC_AXS_20_u2 239. _CNV_A_R_LINEAR_____223_CM 8 -119.5 119.5 FORMAT "%8.3" /end AXIS_PTS
/begin AXIS_PTS ldp_vb__mtcpwm_vb_fac "" 0xa1021700 vb _REC_AXS_20_u1 25.8984 _CNV_A_R_LINEAR_____21_CM 8 0. 25.8984 FORMAT "%3.1" /end AXIS_PTS
/begin AXIS_PTS ldpm_tco_n_sp_1 "" 0xa10222a0 tco _REC_AXS_20_u1 190.5 _CNV_A_R_LINEAR_____16_CM 8 -48. 142.5 FORMAT "%5.1" /end AXIS_PTS
/begin AXIS_PTS ldpm_tco_n_sp_is_pste "" 0xa10222aa tco _REC_AXS_20_u1 190.5 _CNV_A_R_LINEAR_____16_CM 6 -48. 142.5 FORMAT "%6.2" /end AXIS_PTS
/begin AXIS_PTS ldpm_toil_n_sp_is_toil "" 0xa102235e toil _REC_AXS_20_u1 200. _CNV_A_R_LINEAR_____25_CM 4 -40. 160. FORMAT "%3.0" /end AXIS_PTS
/begin AXIS_PTS ldpm_iga_n_sp_is_knk "" 0xa1021b34 iga_mv_adj_knk_cus _REC_AXS_20_u1 48. _CNV_A_R_LINEAR_____171_CM 4 -48. 0. FORMAT "%7.3" /end AXIS_PTS
/begin AXIS_PTS ldp_toil_ip_n_sp_is_cs_opm_1 "" 0xa1021410 toil _REC_AXS_20_u1 200. _CNV_A_R_LINEAR_____25_CM 8 -40. 160. FORMAT "%3.0" /end AXIS_PTS
/begin AXIS_PTS ldp_toil_ip_n_sp_is_cs_opm_2 "" 0xa102141a toil _REC_AXS_20_u1 200. _CNV_A_R_LINEAR_____25_CM 4 -40. 160. FORMAT "%3.0" /end AXIS_PTS
/begin AXIS_PTS ldp_n_n_sp_is_pl_opm_1 "" 0xa1020fcc n _REC_AXS_20_u2 8160. _CNV_A_R_LINEAR_____13_CM 6 0. 8160. FORMAT "%4.0" /end AXIS_PTS
/begin AXIS_PTS ldp_n_n_sp_is_pl_opm_2 "" 0xa1020fdc n _REC_AXS_20_u2 8160. _CNV_A_R_LINEAR_____13_CM 4 0. 8160. FORMAT "%4.0" /end AXIS_PTS
/begin AXIS_PTS ldp_n_n_sp_is_pl_amt_opm_1 "" 0xa1020fb0 n _REC_AXS_20_u2 8160. _CNV_A_R_LINEAR_____13_CM 6 0. 8160. FORMAT "%4.0" /end AXIS_PTS
/begin AXIS_PTS ldp_n_n_sp_is_pl_amt_opm_2 "" 0xa1020fc0 n _REC_AXS_20_u2 8160. _CNV_A_R_LINEAR_____13_CM 4 0. 8160. FORMAT "%4.0" /end AXIS_PTS
/begin AXIS_PTS ldp_tq_loss_n_sp_is_pl_opm_1 "" 0xa1021594 tq_loss _REC_AXS_20_u2 2047.96875 _CNV_A_R_LINEAR_____65_CM 6 -1024. 1023.96875 FORMAT "%6.2" /end AXIS_PTS
/begin AXIS_PTS ldp_tq_loss_n_sp_is_pl_opm_2 "" 0xa10215a4 tq_loss _REC_AXS_20_u2 2047.96875 _CNV_A_R_LINEAR_____65_CM 4 -1024. 1023.96875 FORMAT "%6.2" /end AXIS_PTS
/begin AXIS_PTS ldp_tq_loss_n_sp_is_pl_amt_opm_1 "" 0xa1021578 tq_loss _REC_AXS_20_u2 2047.96875 _CNV_A_R_LINEAR_____65_CM 6 -1024. 1023.96875 FORMAT "%6.2" /end AXIS_PTS
/begin AXIS_PTS ldp_tq_loss_n_sp_is_pl_amt_opm_2 "" 0xa1021588 tq_loss _REC_AXS_20_u2 2047.96875 _CNV_A_R_LINEAR_____65_CM 4 -1024. 1023.96875 FORMAT "%6.2" /end AXIS_PTS
/begin AXIS_PTS ldp_n_32_n_grd_thd "" 0xa1020e68 n_32 _REC_AXS_20_u1 8160. _CNV_A_R_LINEAR_____9_CM 8 0. 8160. FORMAT "%4.0" /end AXIS_PTS
/begin AXIS_PTS ldpm_gear "" 0xa1021acc gear _REC_AXS_20_u1 255. _CNV_A_R_LINEAR_____0_CM 9 0. 255. FORMAT "%3.0" /end AXIS_PTS
/begin AXIS_PTS ldp_pv_av__n_max_mtc_cur_off "" 0xa102114e pv_av _REC_AXS_20_u1 99.609375 _CNV_A_R_LINEAR_____5_CM 4 0. 99.609375 FORMAT "%5.2" /end AXIS_PTS
/begin AXIS_PTS ldp_tco__n_max_1 "" 0xa1021288 tco _REC_AXS_20_u1 190.5 _CNV_A_R_LINEAR_____16_CM 4 -48. 142.5 FORMAT "%6.2" /end AXIS_PTS
/begin AXIS_PTS ldp_tco__n_max_2 "" 0xa102128e tco _REC_AXS_20_u1 190.5 _CNV_A_R_LINEAR_____16_CM 4 -48. 142.5 FORMAT "%6.2" /end AXIS_PTS
/begin MEASUREMENT lv_fmy_exit_st "" UBYTE _CNV_S_2_RANGE__0___1_CM 1 100. 0. 1. DISPLAY_IDENTIFIER LV_FMY_EXIT_ST ECU_ADDRESS 0xd0003c3c BIT_MASK 0x1 /end MEASUREMENT
/begin AXIS_PTS ldp_toil_max__stop_dec_fsd "" 0xa1021420 toil_max _REC_AXS_20_u1 200. _CNV_A_R_LINEAR_____25_CM 4 -40. 160. FORMAT "%3.0" /end AXIS_PTS
/begin AXIS_PTS ldp_tco_st__stop_inc_fsd "" 0xa10212be tco_st _REC_AXS_20_u1 190.5 _CNV_A_R_LINEAR_____16_CM 4 -48. 142.5 FORMAT "%5.1" /end AXIS_PTS
/begin AXIS_PTS ldpm_lamb_sp "" 0xa1021b60 online_dummy _REC_AXS_20_u2 31.9990234375 _CNV_A_R_LINEAR_____122_CM 6 0. 31.9990234375 FORMAT "%7.4" /end AXIS_PTS
/begin AXIS_PTS ldp_n_32__pv_lih_max "" 0xa1020da0 n_32 _REC_AXS_20_u1 816. _CNV_A_R_LINEAR_____9_CM 6 0. 8160. FORMAT "%4.0" /end AXIS_PTS
/begin AXIS_PTS ldpm_vs_fil__pv_fac_cor "" 0xa10223d4 vs_fil _REC_AXS_20_u2 51.199218 _CNV_A_R_LINEAR_____250_CM 8 0. 511.99218 FORMAT "%7.3" /end AXIS_PTS
/begin AXIS_PTS ldpm_n_dif__pv_fac_cor "" 0xa1021e98 n_dif _REC_AXS_20_u2 6553.5 _CNV_A_R_LINEAR_____172_CM 6 -32768. 32767. FORMAT "%6.0" /end AXIS_PTS
/begin AXIS_PTS ldpm_n__pv_fac_cor "" 0xa1021e88 n _REC_AXS_20_u2 815.9 _CNV_A_R_LINEAR_____13_CM 6 1. 8160. FORMAT "%4.0" /end AXIS_PTS
/begin AXIS_PTS ldpm_pv_av_raw__pv_fac_cor "" 0xa10221b6 pv_av_raw _REC_AXS_20_u1 9.9609375 _CNV_A_R_LINEAR_____5_CM 6 0. 99.609375 FORMAT "%4.1" /end AXIS_PTS
/begin AXIS_PTS ldpm_n_32__fac_tq_req_driv "" 0xa1021e10 n_32 _REC_AXS_20_u1 8160. _CNV_A_R_LINEAR_____9_CM 8 0. 8160. FORMAT "%4.0" /end AXIS_PTS
/begin AXIS_PTS ldpm_fac_tq_cru_dcc "" 0xa1021a80 fac_tq_req_cru _REC_AXS_20_u2 1.99996948242188 _CNV_A_R_LINEAR_____8_CM 8 0. 1.99996948242188 FORMAT "%7.5" /end AXIS_PTS
/begin AXIS_PTS ldp_v_pvs_min "" 0xa1021676 online_dummy _REC_AXS_20_u2 4.9951171875 _CNV_A_R_LINEAR_____2_CM 2 0. 4.9951171875 FORMAT "%5.3" /end AXIS_PTS
/begin AXIS_PTS ldp_v_tecu__tecu "" 0xa102167c v_tecu _REC_AXS_20_u2 4.49560546875 _CNV_A_R_LINEAR_____2_CM 16 0. 4.9951171875 FORMAT "%5.3" /end AXIS_PTS
/begin AXIS_PTS ldpm_tia_ip_ti_cast "" 0xa102231c tia _REC_AXS_20_u1 28.575 _CNV_A_R_LINEAR_____16_CM 2 -48. 142.5 FORMAT "%5.1" /end AXIS_PTS
/begin AXIS_PTS ldpm_tco__mff_deac_cst "" 0xa1022258 tco _REC_AXS_20_u1 19.05 _CNV_A_R_LINEAR_____16_CM 10 -48. 142.5 FORMAT "%5.1" /end AXIS_PTS
/begin AXIS_PTS ldpm_fac_st_rest "" 0xa1021a26 fac_st_rest _REC_AXS_20_u1 1.99220002 _CNV_A_R_LINEAR_____97_CM 6 0. 1.99220002 FORMAT "%5.3" /end AXIS_PTS
/begin AXIS_PTS ldpm_cyc_cast_1 "" 0xa102194c cyc_cast _REC_AXS_20_u2 65535. _CNV_A_R_LINEAR_____0_CM 8 0. 65535. FORMAT "%5.0" /end AXIS_PTS
/begin AXIS_PTS ldpm_cyc_cast_2 "" 0xa1021960 cyc_cast _REC_AXS_20_u2 65535. _CNV_A_R_LINEAR_____0_CM 16 0. 65535. FORMAT "%5.0" /end AXIS_PTS
/begin AXIS_PTS ldpm_tco__ti_st_rest "" 0xa1022270 tco _REC_AXS_20_u1 28.575 _CNV_A_R_LINEAR_____16_CM 8 -48. 142.5 FORMAT "%5.1" /end AXIS_PTS
/begin AXIS_PTS ldp_tco_stop__fac_rest "" 0xa10212d8 tco_stop _REC_AXS_20_u1 28.575 _CNV_A_R_LINEAR_____16_CM 8 -48. 142.5 FORMAT "%5.1" /end AXIS_PTS
/begin AXIS_PTS ldpm_tco__fac_stall "" 0xa1022240 tco _REC_AXS_20_u1 28.575 _CNV_A_R_LINEAR_____16_CM 8 -48. 142.5 FORMAT "%5.1" /end AXIS_PTS
/begin AXIS_PTS ldp_t_es__rest "" 0xa10211d8 t_es _REC_AXS_20_u2 9830.25 _CNV_A_R_LINEAR_____77_CM 8 0. 65535. FORMAT "%5.0" /end AXIS_PTS
/begin AXIS_PTS ldp_t_ast_rest "" 0xa10211c4 t_ast_rest _REC_AXS_20_u2 983.025 _CNV_A_R_LINEAR_____4_CM 8 0. 6553.5 FORMAT "%6.1" /end AXIS_PTS
/begin AXIS_PTS ldpm_maf_hb__ti_wup "" 0xa1021c40 maf _REC_AXS_20_u1 1389. _CNV_A_R_LINEAR_____14_CM 8 0. 1389. FORMAT "%4.0" /end AXIS_PTS
/begin AXIS_PTS ldpm_n_32__ti_wup "" 0xa1021e30 n_32 _REC_AXS_20_u1 8160. _CNV_A_R_LINEAR_____9_CM 8 0. 8160. FORMAT "%4.0" /end AXIS_PTS
/begin AXIS_PTS ldp_map_dif__fac_ti_vo_wup "" 0xa1020d04 online_dummy _REC_AXS_20_u2 5434. _CNV_A_R_LINEAR_____26_CM 8 0. 5434. FORMAT "%7.2" /end AXIS_PTS
/begin AXIS_PTS ldp_map__ti_fac_n_map "" 0xa1020cf0 map _REC_AXS_20_u2 5434. _CNV_A_R_LINEAR_____26_CM 8 0. 5434. FORMAT "%7.2" /end AXIS_PTS
/begin AXIS_PTS ldp_n_32__ti_fac_n_map "" 0xa1020da8 n_32 _REC_AXS_20_u1 8160. _CNV_A_R_LINEAR_____9_CM 8 0. 8160. FORMAT "%4.0" /end AXIS_PTS
/begin AXIS_PTS ldp_toil_ti_fac_tia_toil "" 0xa1021456 toil _REC_AXS_20_u1 200. _CNV_A_R_LINEAR_____25_CM 6 -40. 160. FORMAT "%3.0" /end AXIS_PTS
/begin AXIS_PTS ldp_tia_ti_fac_tia_toil "" 0xa1021386 tia _REC_AXS_20_u1 190.5 _CNV_A_R_LINEAR_____16_CM 6 -48. 142.5 FORMAT "%5.1" /end AXIS_PTS
/begin AXIS_PTS ldp_tco__ti_fac_tco "" 0xa102129c tco _REC_AXS_20_u1 190.5 _CNV_A_R_LINEAR_____16_CM 3 -48. 142.5 FORMAT "%5.1" /end AXIS_PTS
/begin AXIS_PTS ldpm_tco_ti_wup_opm_1 "" 0xa10222c8 tco _REC_AXS_20_u1 190.5 _CNV_A_R_LINEAR_____16_CM 8 -48. 142.5 FORMAT "%5.1" /end AXIS_PTS
/begin AXIS_PTS ldpm_tco_ti_wup_opm_2 "" 0xa10222d4 tco _REC_AXS_20_u1 190.5 _CNV_A_R_LINEAR_____16_CM 8 -48. 142.5 FORMAT "%5.1" /end AXIS_PTS
/begin AXIS_PTS ldp_tco_st_ti_tco_wup_opm_1 "" 0xa10212d0 tco_st _REC_AXS_20_u1 190.5 _CNV_A_R_LINEAR_____16_CM 3 -48. 142.5 FORMAT "%5.1" /end AXIS_PTS
/begin AXIS_PTS ldp_tco_st_ti_tco_wup_opm_2 "" 0xa10212d4 tco_st _REC_AXS_20_u1 190.5 _CNV_A_R_LINEAR_____16_CM 3 -48. 142.5 FORMAT "%5.1" /end AXIS_PTS
/begin AXIS_PTS ldp_v_tia_tia "" 0xa10216ec v_tia _REC_AXS_20_u1 4.447265625 _CNV_A_R_LINEAR_____195_CM 16 3.90625e-002 4.98046875 FORMAT "%5.3" /end AXIS_PTS
/begin AXIS_PTS ldp_v_tia_tcha "" 0xa10216d8 v_tia_tcha _REC_AXS_20_u1 4.998 _CNV_A_R_LINEAR_____189_CM 16 0. 4.998 FORMAT "%6.4" /end AXIS_PTS
/begin MEASUREMENT toil_max_warn "max. TOIL at last warning threshold 1" UBYTE _CNV_A_R_LINEAR_____25_CM 1 100. -40. 160. DISPLAY_IDENTIFIER TOIL_MAX_WARN ECU_ADDRESS 0xd0004fba FORMAT "%3.0" /end MEASUREMENT
/begin MEASUREMENT vs_toil_max "VS at last warning threshold 1" UBYTE _CNV_A_R_LINEAR_____6_CM 1 100. 0. 255. DISPLAY_IDENTIFIER VS_TOIL_MAX ECU_ADDRESS 0xd0004fbb FORMAT "%3.0" /end MEASUREMENT
/begin MEASUREMENT n_toil_max "N at last warning threshold 1" UWORD _CNV_A_R_LINEAR_____13_CM 1 100. 0. 8160. DISPLAY_IDENTIFIER N_TOIL_MAX ECU_ADDRESS 0xd0004fb4 FORMAT "%4.0" /end MEASUREMENT
/begin MEASUREMENT gear_toil_max "GEAR at last warning threshold 1" UBYTE _CNV_A_R_LINEAR_____0_CM 1 100. 0. 255. DISPLAY_IDENTIFIER GEAR_TOIL_MAX ECU_ADDRESS 0xd0004fbc FORMAT "%3.0" /end MEASUREMENT
/begin MEASUREMENT tqi_av_toil_max "indicated engine torque at last warning threshold 1" SWORD _CNV_A_R_LINEAR_____30_CM 1 100. -1024. 1023.96875 DISPLAY_IDENTIFIER TQI_AV_TOIL_MAX ECU_ADDRESS 0xd0004fb8 FORMAT "%8.2" /end MEASUREMENT
/begin MEASUREMENT tco_toil_max "Coolant temperature at last warning threshold 1" UBYTE _CNV_A_R_LINEAR_____16_CM 1 100. -48. 142.5 DISPLAY_IDENTIFIER TCO_TOIL_MAX ECU_ADDRESS 0xd0004fbe FORMAT "%5.1" /end MEASUREMENT
/begin MEASUREMENT tam_toil_max "Ambient temperature at last warning threshold 1" UBYTE _CNV_A_R_LINEAR_____16_CM 1 100. -48. 142.5 DISPLAY_IDENTIFIER TAM_TOIL_MAX ECU_ADDRESS 0xd0004fbd FORMAT "%5.1" /end MEASUREMENT
/begin MEASUREMENT ctr_toil_max "event frequency counter" UBYTE _CNV_A_R_LINEAR_____0_CM 1 100. 0. 255. DISPLAY_IDENTIFIER CTR_TOIL_MAX ECU_ADDRESS 0xd0004fbf FORMAT "%3.0" /end MEASUREMENT
/begin MEASUREMENT pv_av_toil_max "PV_AV  at last warning threshold 1" UBYTE _CNV_A_R_LINEAR_____5_CM 1 100. 0. 99.609375 DISPLAY_IDENTIFIER PV_AV_TOIL_MAX ECU_ADDRESS 0xd0004fc0 FORMAT "%4.1" /end MEASUREMENT
/begin MEASUREMENT lv_cs_toil_max "clutch switch detection at last warning threshold 1" UBYTE _CNV_S_2_RANGE______75_CM 1 100. 0. 1. DISPLAY_IDENTIFIER LV_CS_TOIL_MAX ECU_ADDRESS 0xd0003b84 BIT_MASK 0x1 /end MEASUREMENT
/begin MEASUREMENT toil_thd_toil_max "warning threshold 1" UBYTE _CNV_A_R_LINEAR_____25_CM 1 100. -40. 160. DISPLAY_IDENTIFIER TOIL_THD_TOIL_MAX ECU_ADDRESS 0xd0004fc1 FORMAT "%3.0" /end MEASUREMENT
/begin MEASUREMENT dist_toil_max "mileage at last warning threshold 1" UWORD _CNV_A_R_LINEAR_____259_CM 1 100. 0. 524280. DISPLAY_IDENTIFIER DIST_TOIL_MAX ECU_ADDRESS 0xd0004fb6 FORMAT "%8.3" /end MEASUREMENT
/begin MEASUREMENT lv_toil_thd_warn_1 "TOIL > warning threshold 1" UBYTE _CNV_S_2_RANGE______75_CM 1 100. 0. 1. DISPLAY_IDENTIFIER LV_TOIL_THD_WARN_1 ECU_ADDRESS 0xd0003b85 BIT_MASK 0x1 /end MEASUREMENT
/begin MEASUREMENT lv_toil_thd_warn_2 "TOIL > warning threshold 2" UBYTE _CNV_S_2_RANGE______75_CM 1 100. 0. 1. DISPLAY_IDENTIFIER LV_TOIL_THD_WARN_2 ECU_ADDRESS 0xd0003b86 BIT_MASK 0x1 /end MEASUREMENT
/begin AXIS_PTS ldpm_n_32_6 "" 0xa1021dd0 n_32 _REC_AXS_20_u1 8160. _CNV_A_R_LINEAR_____9_CM 16 0. 8160. FORMAT "%4.0" /end AXIS_PTS
/begin AXIS_PTS ldp_tps_av__maf_1_diag "" 0xa1021460 tps_av _REC_AXS_20_u2 119.5 _CNV_A_R_LINEAR_____269_CM 16 0. 119.5 FORMAT "%7.3" /end AXIS_PTS
/begin AXIS_PTS ldp_n_32__tps_max_ratio_diag "" 0xa1020db2 n_32 _REC_AXS_20_u1 8160. _CNV_A_R_LINEAR_____9_CM 4 0. 8160. FORMAT "%4.0" /end AXIS_PTS
/begin AXIS_PTS ldp_n_ip_fac_tps_dif_1 "" 0xa1020f5c n _REC_AXS_20_u2 8160. _CNV_A_R_LINEAR_____13_CM 8 0. 8160. FORMAT "%4.0" /end AXIS_PTS
/begin AXIS_PTS ldp_maf_sp_tqi_ip_fac_tps_dif_1 "" 0xa1020cdc maf_sp _REC_AXS_20_u2 1389. _CNV_A_R_LINEAR_____108_CM 8 0. 1389. FORMAT "%7.2" /end AXIS_PTS
/begin AXIS_PTS ldp_pq_sp_ip_fac_tps_dif_2 "" 0xa1021140 pq _REC_AXS_20_u2 0.9999847412109381 _CNV_A_R_LINEAR_____68_CM 6 0. 0.9999847412109381 FORMAT "%7.5" /end AXIS_PTS
/begin AXIS_PTS ldp_n_32_tps_sp_pwl "" 0xa1020e7e n_32 _REC_AXS_20_u1 816. _CNV_A_R_LINEAR_____9_CM 4 0. 8160. FORMAT "%4.0" /end AXIS_PTS
/begin AXIS_PTS ldp_pv_av__tps_sp_ext "" 0xa1021154 pv_av _REC_AXS_20_u1 99.609375 _CNV_A_R_LINEAR_____5_CM 6 0. 99.609375 FORMAT "%4.1" /end AXIS_PTS
/begin AXIS_PTS ldpm_tco_1_thro "" 0xa1022218 tco _REC_AXS_20_u1 190.5 _CNV_A_R_LINEAR_____16_CM 8 -48. 142.5 FORMAT "%5.1" /end AXIS_PTS
/begin AXIS_PTS ldp_t_acc_ip_fac_tq_loss_acc_on "" 0xa1021184 t_acc _REC_AXS_20_u1 2.55 _CNV_A_R_LINEAR_____3_CM 8 0. 2.55 FORMAT "%4.2" /end AXIS_PTS
/begin AXIS_PTS ldp_n_32_ip_fac_tq_loss_acc_on "" 0xa1020e0c n_32 _REC_AXS_20_u1 8160. _CNV_A_R_LINEAR_____9_CM 8 0. 8160. FORMAT "%4.0" /end AXIS_PTS
/begin AXIS_PTS ldp_n_32__tq_add_acc "" 0xa1020db8 n_32 _REC_AXS_20_u1 8160. _CNV_A_R_LINEAR_____9_CM 6 0. 8160. FORMAT "%4.0" /end AXIS_PTS
/begin AXIS_PTS ldp_t_acc_fac_tq_loss_acc "" 0xa1021178 t_acc _REC_AXS_20_u1 2.55 _CNV_A_R_LINEAR_____3_CM 8 0. 2.55 FORMAT "%4.2" /end AXIS_PTS
/begin AXIS_PTS ldp_n_32__tq_add_heat_acc "" 0xa1020dc0 n_32 _REC_AXS_20_u1 8160. _CNV_A_R_LINEAR_____9_CM 6 0. 8160. FORMAT "%4.0" /end AXIS_PTS
/begin AXIS_PTS ldp_n_32__tq_loss_acc "" 0xa1020dd2 n_32 _REC_AXS_20_u1 8160. _CNV_A_R_LINEAR_____9_CM 6 0. 8160. FORMAT "%4.0" /end AXIS_PTS
/begin AXIS_PTS ldp_tq_accin_can__tq_loss_acc "" 0xa10214e6 tq_accin_can _REC_AXS_20_u1 31. _CNV_A_R_LINEAR_____60_CM 6 0. 31. FORMAT "%3.0" /end AXIS_PTS
/begin AXIS_PTS ldp_tq_loss_acc_inp__tq_add_acc "" 0xa1021530 tq_loss_acc_inp _REC_AXS_20_u2 2047.96875 _CNV_A_R_LINEAR_____65_CM 6 -1024. 1023.96875 FORMAT "%6.2" /end AXIS_PTS
/begin AXIS_PTS ldpm_ac_veh_trv_tcs "" 0xa10218d8 ac_veh_trv_tcs _REC_AXS_20_u2 102.35 _CNV_A_R_LINEAR_____272_CM 8 -51.175 51.175 FORMAT "%7.4" /end AXIS_PTS
/begin AXIS_PTS ldpm_vs_fil "" 0xa10223c0 vs_fil _REC_AXS_20_u2 511.99218 _CNV_A_R_LINEAR_____66_CM 8 0. 511.99218 FORMAT "%7.3" /end AXIS_PTS
/begin AXIS_PTS ldpm_n_32__tq_loss_ars "" 0xa1021e3c n_32 _REC_AXS_20_u1 8160. _CNV_A_R_LINEAR_____9_CM 8 0. 8160. FORMAT "%4.0" /end AXIS_PTS
/begin AXIS_PTS ldp_tq_loss_ars_sp_can_max "" 0xa1021564 tq_loss_ars_sp_can _REC_AXS_20_u2 2047.96875 _CNV_A_R_LINEAR_____65_CM 8 -1024. 1023.96875 FORMAT "%6.2" /end AXIS_PTS
/begin AXIS_PTS ldp_tq_loss_ars_av_can_max "" 0xa1021540 tq_loss_ars_av_can _REC_AXS_20_u2 2047.96875 _CNV_A_R_LINEAR_____65_CM 8 -1024. 1023.96875 FORMAT "%6.2" /end AXIS_PTS
/begin MEASUREMENT n_ratio_conv "" UBYTE _CNV_A_R_LINEAR_____27_CM 1 100. 0. 0.99609375 DISPLAY_IDENTIFIER N_RATIO_CONV ECU_ADDRESS 0xc0000d2b FORMAT "%4.3" /end MEASUREMENT
/begin AXIS_PTS ldp_tco__tq_clu_amt "" 0xa10212a0 tco _REC_AXS_20_u1 190.5 _CNV_A_R_LINEAR_____16_CM 6 -48. 142.5 FORMAT "%5.1" /end AXIS_PTS
/begin AXIS_PTS ldp_n_dif__tq_clu_amt "" 0xa1020ed4 n_dif _REC_AXS_20_u2 65535. _CNV_A_R_LINEAR_____172_CM 6 -32768. 32767. FORMAT "%6.0" /end AXIS_PTS
/begin AXIS_PTS ldp_n_32_ip_tq_add_conv "" 0xa1020e5e n_32 _REC_AXS_20_u1 8160. _CNV_A_R_LINEAR_____9_CM 6 0. 8160. FORMAT "%4.0" /end AXIS_PTS
/begin AXIS_PTS ldp_n_32_ip_tq_add_amt "" 0xa1020e56 n_32 _REC_AXS_20_u1 8160. _CNV_A_R_LINEAR_____9_CM 6 0. 8160. FORMAT "%4.0" /end AXIS_PTS
/begin AXIS_PTS ldp_vs_fil__tq_clu_amt "" 0xa1021874 vs_fil _REC_AXS_20_u2 511.99218 _CNV_A_R_LINEAR_____66_CM 6 0. 511.99218 FORMAT "%7.3" /end AXIS_PTS
/begin AXIS_PTS ldp_n_ratio_conv_fac_tq_conv "" 0xa1020fe8 n_ratio_conv _REC_AXS_20_u1 0.99609375 _CNV_A_R_LINEAR_____27_CM 8 0. 0.99609375 FORMAT "%5.3" /end AXIS_PTS
/begin AXIS_PTS ldp_toil_t_dly_n_sp_is "" 0xa1021434 toil _REC_AXS_20_u1 200. _CNV_A_R_LINEAR_____25_CM 8 -40. 160. FORMAT "%3.0" /end AXIS_PTS
/begin AXIS_PTS ldp_toil_t_dly_conv "" 0xa1021428 toil _REC_AXS_20_u1 200. _CNV_A_R_LINEAR_____25_CM 8 -40. 160. FORMAT "%3.0" /end AXIS_PTS
/begin AXIS_PTS ldp_toil_fac_conv "" 0xa10213f8 toil _REC_AXS_20_u1 200. _CNV_A_R_LINEAR_____25_CM 8 -40. 160. FORMAT "%3.0" /end AXIS_PTS
/begin AXIS_PTS ldp_gr_at_n_tur "" 0xa1020afc gr_at _REC_AXS_20_u1 8. _CNV_A_R_LINEAR_____0_CM 13 0. 8. FORMAT "%1.0" /end AXIS_PTS
/begin AXIS_PTS ldp_n_32__tq_conv "" 0xa1020dc8 n_32 _REC_AXS_20_u1 8160. _CNV_A_R_LINEAR_____9_CM 8 0. 8160. FORMAT "%4.0" /end AXIS_PTS
/begin AXIS_PTS ldp_vs_n_tur "" 0xa10218c2 vs _REC_AXS_20_u1 255. _CNV_A_R_LINEAR_____6_CM 2 0. 255. FORMAT "%3.0" /end AXIS_PTS
/begin AXIS_PTS ldp_tq_conv_can__tq_conv "" 0xa10214fc tq_conv_can _REC_AXS_20_u2 2047.96875 _CNV_A_R_LINEAR_____65_CM 8 -1024. 1023.96875 FORMAT "%6.2" /end AXIS_PTS
/begin AXIS_PTS ldp_toil_t_ramp_conv_pos "" 0xa102144c toil _REC_AXS_20_u1 200. _CNV_A_R_LINEAR_____25_CM 8 -40. 160. FORMAT "%3.0" /end AXIS_PTS
/begin AXIS_PTS ldp_toil_t_ramp_conv_neg "" 0xa1021440 toil _REC_AXS_20_u1 200. _CNV_A_R_LINEAR_____25_CM 8 -40. 160. FORMAT "%3.0" /end AXIS_PTS
/begin AXIS_PTS ldpm_toil_tq_add_conv "" 0xa1022364 toil _REC_AXS_20_u1 200. _CNV_A_R_LINEAR_____25_CM 6 -40. 160. FORMAT "%3.0" /end AXIS_PTS
/begin AXIS_PTS ldpm_vs_tq_add_conv "" 0xa102241c vs _REC_AXS_20_u1 255. _CNV_A_R_LINEAR_____6_CM 6 0. 255. FORMAT "%3.0" /end AXIS_PTS
/begin AXIS_PTS ldp_n_grd_tq_add_conv "" 0xa1020f26 n_grd _REC_AXS_20_u1 8160. _CNV_A_R_LINEAR_____28_CM 6 -4096. 4064. FORMAT "%5.0" /end AXIS_PTS
/begin AXIS_PTS ldp_ac_cru_tq_add_conv "" 0xa102085c ac_cru _REC_AXS_20_u2 31.43952 _CNV_A_R_LINEAR_____274_CM 6 -15.72 15.71952 FORMAT "%8.4" /end AXIS_PTS
/begin AXIS_PTS ldp_eff_scc_sp__nr_pat_scc "" 0xa10208f4 eff_scc_sp _REC_AXS_20_u2 1.99996948242188 _CNV_A_R_LINEAR_____8_CM 13 0. 1.99996948242188 FORMAT "%7.5" /end AXIS_PTS
/begin AXIS_PTS ldp_maf__min_fcut_fast "" 0xa1020c50 maf _REC_AXS_20_u2 1389. _CNV_A_R_LINEAR_____108_CM 4 0. 1389. FORMAT "%7.2" /end AXIS_PTS
/begin AXIS_PTS ldp_n__min_fcut_fast "" 0xa1020e98 n _REC_AXS_20_u2 8160. _CNV_A_R_LINEAR_____13_CM 4 0. 8160. FORMAT "%4.0" /end AXIS_PTS
/begin AXIS_PTS ldpm_tco_ip_tq_st "" 0xa1022288 tco _REC_AXS_20_u1 190.5 _CNV_A_R_LINEAR_____16_CM 8 -48. 142.5 FORMAT "%5.1" /end AXIS_PTS
/begin AXIS_PTS ldpm_n_dif_ip_tq_st "" 0xa1021fd4 n_dif _REC_AXS_20_u2 65535. _CNV_A_R_LINEAR_____172_CM 8 -32768. 32767. FORMAT "%6.0" /end AXIS_PTS
/begin AXIS_PTS ldpm_n_fac_tq_req_driv "" 0xa1022004 n _REC_AXS_20_u2 8160. _CNV_A_R_LINEAR_____13_CM 12 0. 8160. FORMAT "%4.0" /end AXIS_PTS
/begin AXIS_PTS ldpm_pv_cus_fac_tq_req_driv "" 0xa10221c0 pv_cus _REC_AXS_20_u2 99.99847412109381 _CNV_A_R_LINEAR_____7_CM 12 0. 99.99847412109381 /end AXIS_PTS
/begin AXIS_PTS ldp_n_sp_is_ratio "" 0xa1021008 n_sp_is_ratio _REC_AXS_20_u2 7.9998779296875 _CNV_A_R_LINEAR_____113_CM 8 0. 7.9998779296875 FORMAT "%6.4" /end AXIS_PTS
/begin AXIS_PTS ldpm_n_32__tqi_min_pu "" 0xa1021e48 n_32 _REC_AXS_20_u1 8160. _CNV_A_R_LINEAR_____9_CM 12 0. 8160. FORMAT "%4.0" /end AXIS_PTS
/begin AXIS_PTS ldpm_tco__tqi_min_pu "" 0xa102227a tco _REC_AXS_20_u1 190.5 _CNV_A_R_LINEAR_____16_CM 4 -48. 142.5 FORMAT "%5.1" /end AXIS_PTS
/begin AXIS_PTS ldp_n_32__tqi_dif_lim "" 0xa1020dda n_32 _REC_AXS_20_u1 8160. _CNV_A_R_LINEAR_____9_CM 4 0. 8160. FORMAT "%4.0" /end AXIS_PTS
/begin AXIS_PTS ldp_tqi_sp_mon__tqi_dif_lim "" 0xa102162a tqi_sp_mon _REC_AXS_20_u1 510. _CNV_A_R_LINEAR_____280_CM 4 0. 510. FORMAT "%3.0" /end AXIS_PTS
/begin AXIS_PTS ldpm_gear__tq_p_max "" 0xa1021ae8 gear _REC_AXS_20_u1 12. _CNV_A_R_LINEAR_____50_CM 13 0. 12. FORMAT "%3.0" /end AXIS_PTS
/begin AXIS_PTS ldpm_vs_fil__tq_p_max "" 0xa10223e8 vs_fil _REC_AXS_20_u2 511.99218 _CNV_A_R_LINEAR_____66_CM 6 0. 511.99218 FORMAT "%7.3" /end AXIS_PTS
/begin AXIS_PTS ldpm_ang_pste_stnd_tqlo_1 "" 0xa1021910 ang_pste_stnd _REC_AXS_20_u2 199.99694824 _CNV_A_R_LINEAR_____225_CM 8 -100. 99.99694824 FORMAT "%8.3" /end AXIS_PTS
/begin AXIS_PTS ldpm_ang_pste_stnd_tqlo "" 0xa10218fc ang_pste_stnd _REC_AXS_20_u2 199.99694824 _CNV_A_R_LINEAR_____225_CM 8 -100. 99.99694824 FORMAT "%8.3" /end AXIS_PTS
/begin AXIS_PTS ldp_tq_loss_pste_2_sp_can "" 0xa10215b0 tq_loss_pste_2_sp_can _REC_AXS_20_u2 2047.96875 _CNV_A_R_LINEAR_____65_CM 8 -1024. 1023.96875 FORMAT "%6.2" /end AXIS_PTS
/begin AXIS_PTS ldp_n__fac_tq_add_pste "" 0xa1020e84 n _REC_AXS_20_u2 8160. _CNV_A_R_LINEAR_____13_CM 8 0. 8160. FORMAT "%4.0" /end AXIS_PTS
/begin AXIS_PTS ldpm_vs_tq_loss_pste_2 "" 0xa1022424 vs _REC_AXS_20_u1 255. _CNV_A_R_LINEAR_____6_CM 6 0. 255. FORMAT "%3.0" /end AXIS_PTS
/begin AXIS_PTS ldp_vel_ang_pste_tqlo_1 "" 0xa102171c vel_ang_pste_cor _REC_AXS_20_u2 2879.935575 _CNV_A_R_LINEAR_____282_CM 8 -1439.98976 1439.945815 FORMAT "%8.2" /end AXIS_PTS
/begin AXIS_PTS ldpm_vel_ang_pste_tqlo "" 0xa10223ac vel_ang_pste_cor _REC_AXS_20_u2 2879.935575 _CNV_A_R_LINEAR_____282_CM 8 -1439.98976 1439.945815 FORMAT "%8.2" /end AXIS_PTS
/begin AXIS_PTS ldpm_idx_1_sp_vim_1_vima "" 0xa1021b2a idx_1_sp_vim_1 _REC_AXS_20_u1 3. _CNV_A_R_LINEAR_____0_CM 4 0. 3. FORMAT "%1.0" /end AXIS_PTS
/begin AXIS_PTS ldpm_idx_2_sp_vim_1_vima "" 0xa1021b30 idx_2_sp_vim_1 _REC_AXS_20_u1 1. _CNV_A_R_LINEAR_____0_CM 2 0. 1. FORMAT "%1.0" /end AXIS_PTS
/begin AXIS_PTS ldp_fac_maf_max_ip_fac_n_vim "" 0xa102099c fac_maf_max _REC_AXS_20_u2 1.99996948242188 _CNV_A_R_LINEAR_____8_CM 6 0. 1.99996948242188 FORMAT "%7.5" /end AXIS_PTS
/begin AXIS_PTS ldp_tia_fac_tia_n_vim "" 0xa1021364 tia _REC_AXS_20_u1 190.5 _CNV_A_R_LINEAR_____16_CM 8 -48. 142.5 FORMAT "%5.1" /end AXIS_PTS
/begin AXIS_PTS ldp_n_32_fac_n_vim "" 0xa1020de0 n_32 _REC_AXS_20_u1 8160. _CNV_A_R_LINEAR_____9_CM 8 0. 8160. FORMAT "%4.0" /end AXIS_PTS
/begin MEASUREMENT cdn_diag_el_cps "Diagnosis condition for failure el_cps" UBYTE _CNV_A_R_LINEAR_____0_CM 1 100. 0. 7. DISPLAY_IDENTIFIER CDN_DIAG_EL_CPS ECU_ADDRESS 0xc0001f70 FORMAT "%3.0" /end MEASUREMENT
/begin AXIS_PTS ldpm_n_32_ip_rel_flow_max_cps "" 0xa10053a0 n_32 _REC_AXS_20_u1 8160. _CNV_A_R_LINEAR_____9_CM 12 0. 8160. FORMAT "%4.0" /end AXIS_PTS
/begin MEASUREMENT lv_ls_up_obd_man_deac_ext "Upstream WRAF Sensor Diagnosis deactivation for all banks" UBYTE _CNV_S_2_RANGE__0___1_CM 1 100. 0. 1. DISPLAY_IDENTIFIER LV_LS_UP_OBD_MAN_DEAC_EXT ECU_ADDRESS 0xd00033a0 BIT_MASK 0x1 /end MEASUREMENT
/begin MEASUREMENT lv_ls_down_obd_man_deac_ext "Downstream WRAF Sensor Diagnosis deactivation for all banks" UBYTE _CNV_S_2_RANGE__0___1_CM 1 100. 0. 1. DISPLAY_IDENTIFIER LV_LS_DOWN_OBD_MAN_DEAC_EXT ECU_ADDRESS 0xd00033a1 BIT_MASK 0x1 /end MEASUREMENT
/begin AXIS_PTS ldpm_maf_kgh__crlc_vls_down "" 0xa1008be4 maf_kgh _REC_AXS_20_u2 2047.96875 _CNV_A_R_LINEAR_____207_CM 4 0. 2047.96875 FORMAT "%7.2" /end AXIS_PTS
/begin MEASUREMENT lv_inh_diag_seg_ad_er "Specific conditions to inhibate Engine roughness segment adaptive values diagnosis" UBYTE _CNV_S_2_RANGE__0___1_CM 1 100. 0. 1. DISPLAY_IDENTIFIER LV_INH_DIAG_SEG_AD_ER ECU_ADDRESS 0xd0002dcf BIT_MASK 0x1 /end MEASUREMENT
/begin MEASUREMENT lv_inh_diag_t_seg_er "Specific conditions to inhibate Engine roughness segment time acquisition diagnosis" UBYTE _CNV_S_2_RANGE__0___1_CM 1 100. 0. 1. DISPLAY_IDENTIFIER LV_INH_DIAG_T_SEG_ER ECU_ADDRESS 0xd0002dd0 BIT_MASK 0x1 /end MEASUREMENT
/begin AXIS_PTS ldpm_vs_wheel_grd_mmv_thd "" 0xa1009a38 vs _REC_AXS_20_u1 255. _CNV_A_R_LINEAR_____6_CM 9 0. 255. FORMAT "%3.0" /end AXIS_PTS
/begin AXIS_PTS ldpm_tia_1 "" 0xa10222f6 tia _REC_AXS_20_u1 190.5 _CNV_A_R_LINEAR_____16_CM 6 -48. 142.5 FORMAT "%5.1" /end AXIS_PTS
/begin MEASUREMENT poil_sp_ext_adj "adjustment value for Oilpressure setpoint" UWORD _CNV_A_R_LINEAR_____439_CM 1 100. 0. 65535. DISPLAY_IDENTIFIER POIL_SP_EXT_ADJ ECU_ADDRESS 0xd000548a FORMAT "%6.0" /end MEASUREMENT
/begin MEASUREMENT poil_pwm_ext_adj "adjustment value for Oilpressure solenoid setpoint" UBYTE _CNV_A_R_LINEAR_____5_CM 1 100. 0. 99.609375 DISPLAY_IDENTIFIER POIL_PWM_EXT_ADJ ECU_ADDRESS 0xd0004074 FORMAT "%4.1" /end MEASUREMENT
/begin MEASUREMENT tps_sp_ext_adj "Throttle position setpoint of external device" UBYTE _CNV_A_R_LINEAR_____5_CM 1 100. 0. 99.609375 DISPLAY_IDENTIFIER TPS_SP_EXT_ADJ ECU_ADDRESS 0xd0004070 FORMAT "%4.1" /end MEASUREMENT
/begin CHARACTERISTIC c_var_state "Country variant of the dataset" VALUE 0xa1029bc4 _REC_VAL_20_u1 255. _CNV_A_R_LINEAR_____0_CM 0. 255. DISPLAY_IDENTIFIER C_VAR_STATE FORMAT "%3.0" /end CHARACTERISTIC
/begin CHARACTERISTIC lc_state_test_opm_can_ena_vvl "" VALUE 0xa1029ddb _REC_VAL_20_u1 1. _CNV_S_2_RANGE______75_CM 0. 1. DISPLAY_IDENTIFIER LC_STATE_TEST_OPM_CAN_ENA_VVL /end CHARACTERISTIC
/begin CHARACTERISTIC lc_egy_min_kwp "Switch to enable the configuration of FeTraWe-mode in ECU / enable =1 " VALUE 0xa1029d24 _REC_VAL_20_u1 1. _CNV_S_2_RANGE______75_CM 0. 1. DISPLAY_IDENTIFIER LC_EGY_MIN_KWP /end CHARACTERISTIC
/begin MEASUREMENT state_egy_min_kwp "state of FeTraWe / 01= Fertigung 02 = Transport 03 = Werkstatt" UBYTE _CNV_S_4_RANGE_STAT_444_CM 1 100. 0. 3. DISPLAY_IDENTIFIER STATE_EGY_MIN_KWP ECU_ADDRESS 0xd0004065 /end MEASUREMENT
/begin AXIS_PTS ldpm_tst_rec "" 0xa1022390 NO_INPUT_QUANTITY _REC_AXS_20_u1 12. _CNV_A_R_LINEAR_____0_CM 12 0. 12. FORMAT "%3.0" /end AXIS_PTS
/begin MEASUREMENT val_mon_err_ram "Logical variable for fault of RAM in process monitoring present" UBYTE _CNV_S_2_RANGE__0___1_CM 1 100. 0. 1. DISPLAY_IDENTIFIER VAL_MON_ERR_RAM ECU_ADDRESS 0xd0003c47 BIT_MASK 0x1 /end MEASUREMENT
/begin MEASUREMENT lv_err_tmp_mu_mc "Error flag requesting temporary disabling of power stages connected to MC" UBYTE _CNV_S_2_RANGE__0___1_CM 1 100. 0. 1. DISPLAY_IDENTIFIER LV_ERR_TMP_MU_MC ECU_ADDRESS 0xd0003379 BIT_MASK 0x1 /end MEASUREMENT
/begin MEASUREMENT lv_err_mu_mc "Error flag requesting permanent disabling of power stages connected to MC" UBYTE _CNV_S_2_RANGE__0___1_CM 1 100. 0. 1. DISPLAY_IDENTIFIER LV_ERR_MU_MC ECU_ADDRESS 0xd0003378 BIT_MASK 0x1 /end MEASUREMENT
/begin AXIS_PTS ldp_fmy_dtc "" 0xa1020a28 online_dummy _REC_AXS_20_u2 5. _CNV_A_R_LINEAR_____50_CM 6 0. 5. FORMAT "%2.0" /end AXIS_PTS
/begin MEASUREMENT cyl_id_sam_trig "" UBYTE _CNV_A_R_LINEAR_____412_CM 1 100. 1. 4. DISPLAY_IDENTIFIER CYL_ID_SAM_TRIG ECU_ADDRESS 0xd0003ffa FORMAT "%1.0" /end MEASUREMENT
/begin MEASUREMENT lv_err_load_tps_plaus "Error Flag for LOAD_TPS_PLAUS error" UBYTE _CNV_S_2_RANGE__0___1_CM 1 100. 0. 1. DISPLAY_IDENTIFIER LV_ERR_LOAD_TPS_PLAUS ECU_ADDRESS 0xd0003465 BIT_MASK 0x1 /end MEASUREMENT
/begin MEASUREMENT lv_err_vim_plaus "Error Flag for vim_plaus error" UBYTE _CNV_S_2_RANGE__0___1_CM 1 100. 0. 1. DISPLAY_IDENTIFIER LV_ERR_VIM_PLAUS ECU_ADDRESS 0xd0003408 BIT_MASK 0x1 /end MEASUREMENT
/begin MEASUREMENT lv_err_map_dip_plaus "Error Flag for map_dip_plaus error" UBYTE _CNV_S_2_RANGE__0___1_CM 1 100. 0. 1. DISPLAY_IDENTIFIER LV_ERR_MAP_DIP_PLAUS ECU_ADDRESS 0xd0003406 BIT_MASK 0x1 /end MEASUREMENT
/begin MEASUREMENT lv_err_alter_bn_rgn "Error Flag for alter_bn_rgn error" UBYTE _CNV_S_2_RANGE__0___1_CM 1 100. 0. 1. DISPLAY_IDENTIFIER LV_ERR_ALTER_BN_RGN ECU_ADDRESS 0xd0003409 BIT_MASK 0x1 /end MEASUREMENT
/begin MEASUREMENT lv_inh_diag_rbm_mec_ivvt_ex "Flag set if IVVT diagnosis is inhibitied due to present OBD error" UBYTE _CNV_S_2_RANGE__0___1_CM 1 100. 0. 1. DISPLAY_IDENTIFIER LV_INH_DIAG_RBM_MEC_IVVT_EX ECU_ADDRESS 0xc0001cc9 BIT_MASK 0x1 /end MEASUREMENT
/begin MEASUREMENT lv_eol_obd_dc "" UBYTE _CNV_S_2_RANGE__0___1_CM 1 100. 0. 1. DISPLAY_IDENTIFIER LV_EOL_OBD_DC ECU_ADDRESS 0xd00037f5 BIT_MASK 0x1 /end MEASUREMENT
/begin MEASUREMENT state_rbm_mec_ivvt_ex "Interface of MEC_IVVT_EX monitor with the Rate-Based Monitoring statistics" UBYTE _CNV_A_R_LINEAR_____0_CM 1 100. 0. 7. DISPLAY_IDENTIFIER STATE_RBM_MEC_IVVT_EX ECU_ADDRESS 0xd00037f1 FORMAT "%1.0" /end MEASUREMENT
/begin MEASUREMENT lv_inh_diag_rbm_mec_ivvt_in "flag set if ivvt diagnosis is inhibitied due to present OBD error" UBYTE _CNV_S_2_RANGE__0___1_CM 1 100. 0. 1. DISPLAY_IDENTIFIER LV_INH_DIAG_RBM_MEC_IVVT_IN ECU_ADDRESS 0xc0001cc6 BIT_MASK 0x1 /end MEASUREMENT
/begin MEASUREMENT lv_inh_diag_rbm_map_dip_plaus "flag set if MAP_DIP_PLAUS diagnosis is inhibitied due to present OBD error" UBYTE _CNV_S_2_RANGE__0___1_CM 1 100. 0. 1. DISPLAY_IDENTIFIER LV_INH_DIAG_RBM_MAP_DIP_PLAUS ECU_ADDRESS 0xc0001ccc BIT_MASK 0x1 /end MEASUREMENT
/begin MEASUREMENT lv_inh_diag_rbm_load_tps_plaus "flag set if LOAD_TPS_PLAUS diagnosis is inhibitied due to present OBD error" UBYTE _CNV_S_2_RANGE__0___1_CM 1 100. 0. 1. DISPLAY_IDENTIFIER LV_INH_DIAG_RBM_LOAD_TPS_PLAUS ECU_ADDRESS 0xc0001ccf BIT_MASK 0x1 /end MEASUREMENT
/begin MEASUREMENT state_rbm_mec_ivvt_in "Interface of MEC_IVVT_IN monitor with the Rate-Based Monitoring statistics" UBYTE _CNV_A_R_LINEAR_____0_CM 1 100. 0. 7. DISPLAY_IDENTIFIER STATE_RBM_MEC_IVVT_IN ECU_ADDRESS 0xd00037f0 FORMAT "%1.0" /end MEASUREMENT
/begin MEASUREMENT state_rbm_map_dip_plaus "Interface of MAP_DIP_PLAUS monitor with the Rate-Based Monitoring statistics" UBYTE _CNV_A_R_LINEAR_____0_CM 1 100. 0. 7. DISPLAY_IDENTIFIER STATE_RBM_MAP_DIP_PLAUS ECU_ADDRESS 0xd00037f2 FORMAT "%1.0" /end MEASUREMENT
/begin MEASUREMENT state_rbm_load_tps_plaus "Interface of LOAD_TPS_PLAUS monitor with the Rate-Based Monitoring statistics" UBYTE _CNV_A_R_LINEAR_____0_CM 1 100. 0. 7. DISPLAY_IDENTIFIER STATE_RBM_LOAD_TPS_PLAUS ECU_ADDRESS 0xd00037f3 FORMAT "%1.0" /end MEASUREMENT
/begin MEASUREMENT lv_end_rbm_mec_ivvt_ex "flag set if ivvt diagnosis cycle RBM is finished" UBYTE _CNV_S_2_RANGE__0___1_CM 1 100. 0. 1. DISPLAY_IDENTIFIER LV_END_RBM_MEC_IVVT_EX ECU_ADDRESS 0xc0001cc8 BIT_MASK 0x1 /end MEASUREMENT
/begin MEASUREMENT lv_end_rbm_mec_ivvt_in "flag set if ivvt diagnosis cycle RBM is finished" UBYTE _CNV_S_2_RANGE__0___1_CM 1 100. 0. 1. DISPLAY_IDENTIFIER LV_END_RBM_MEC_IVVT_IN ECU_ADDRESS 0xc0001cc5 BIT_MASK 0x1 /end MEASUREMENT
/begin MEASUREMENT lv_end_rbm_map_dip_plaus "flag set if map_dip_plaus diagnosis cycle RBM is finished" UBYTE _CNV_S_2_RANGE__0___1_CM 1 100. 0. 1. DISPLAY_IDENTIFIER LV_END_RBM_MAP_DIP_PLAUS ECU_ADDRESS 0xc0001ccb BIT_MASK 0x1 /end MEASUREMENT
/begin MEASUREMENT lv_end_rbm_load_tps_plaus "flag set if load_tps_plaus diagnosis cycle RBM is finished" UBYTE _CNV_S_2_RANGE__0___1_CM 1 100. 0. 1. DISPLAY_IDENTIFIER LV_END_RBM_LOAD_TPS_PLAUS ECU_ADDRESS 0xc0001cce BIT_MASK 0x1 /end MEASUREMENT
/begin MEASUREMENT lv_cdn_rbm_mec_ivvt_ex "flag set if ivvt diagnosis condition RBM is fulfilled" UBYTE _CNV_S_2_RANGE__0___1_CM 1 100. 0. 1. DISPLAY_IDENTIFIER LV_CDN_RBM_MEC_IVVT_EX ECU_ADDRESS 0xc0001cca BIT_MASK 0x1 /end MEASUREMENT
/begin MEASUREMENT lv_cdn_rbm_mec_ivvt_in "flag set if ivvt diagnosis condition RBM is fulfilled" UBYTE _CNV_S_2_RANGE__0___1_CM 1 100. 0. 1. DISPLAY_IDENTIFIER LV_CDN_RBM_MEC_IVVT_IN ECU_ADDRESS 0xc0001cc7 BIT_MASK 0x1 /end MEASUREMENT
/begin MEASUREMENT lv_cdn_rbm_map_dip_plaus "flag set if map_dip_plaus diagnosis condition RBM is fulfilled" UBYTE _CNV_S_2_RANGE__0___1_CM 1 100. 0. 1. DISPLAY_IDENTIFIER LV_CDN_RBM_MAP_DIP_PLAUS ECU_ADDRESS 0xc0001ccd BIT_MASK 0x1 /end MEASUREMENT
/begin MEASUREMENT lv_cdn_rbm_load_tps_plaus "flag set if load_tps_plaus diagnosis condition RBM is fulfilled" UBYTE _CNV_S_2_RANGE__0___1_CM 1 100. 0. 1. DISPLAY_IDENTIFIER LV_CDN_RBM_LOAD_TPS_PLAUS ECU_ADDRESS 0xc0001cd0 BIT_MASK 0x1 /end MEASUREMENT
/begin AXIS_PTS ldp_toil_ip_tqfr_add "" 0xa100a830 toil _REC_AXS_20_u1 200. _CNV_A_R_LINEAR_____25_CM 8 -40. 160. FORMAT "%3.0" /end AXIS_PTS
/begin AXIS_PTS ldpm_toil_ip_tqfr_add "" 0xa100a8b8 toil _REC_AXS_20_u1 200. _CNV_A_R_LINEAR_____25_CM 8 -40. 160. FORMAT "%3.0" /end AXIS_PTS
/begin AXIS_PTS ldp_ctr_km_can__tqfr_add "" 0xa100ac20 ctr_km_can _REC_AXS_20_u2 655350. _CNV_A_R_LINEAR_____70_CM 4 0. 655350. FORMAT "%7.0" /end AXIS_PTS
/begin AXIS_PTS ldp_toil__tqfr_add "" 0xa100ac38 toil _REC_AXS_20_u1 200. _CNV_A_R_LINEAR_____25_CM 4 -40. 160. FORMAT "%3.0" /end AXIS_PTS
/begin AXIS_PTS ldpm_amp__tqfr_add "AMP Correction" 0xa100ac50 amp _REC_AXS_20_u2 5434. _CNV_A_R_LINEAR_____450_CM 6 -2717. 2717. FORMAT "%7.2" /end AXIS_PTS
/begin AXIS_PTS ldp_tco_ip_t_ast_is_ad_inh "" 0xa100ac32 tco _REC_AXS_20_u1 190.5 _CNV_A_R_LINEAR_____16_CM 4 -48. 142.5 FORMAT "%5.1" /end AXIS_PTS
/begin MEASUREMENT nvmy_tqlo.nvmy_dtsysisad.tq_dif_is_ad_inter.slongword "SLONGWORD" SLONG _CNV_A_R_TQLO_LINEA_451_CM 1 100. -1024. 1023.99999952316 DISPLAY_IDENTIFIER SLONGWORD ECU_ADDRESS 0xd00023d0 FORMAT "%13.7" /end MEASUREMENT
/begin MEASUREMENT nvmy_tqlo.nvmy_dtsysisad.tq_dif_is_ad_inter.sword[0] "SWORD" SWORD _CNV_A_R_LINEAR_____30_CM 1 100. -1024. 1023.96875 DISPLAY_IDENTIFIER SWORD ECU_ADDRESS 0xd00023d0 FORMAT "%11.5" /end MEASUREMENT
/begin MEASUREMENT nvmy_tqlo.nvmy_dtsysisad.tq_dif_is_ad_inter.sword[1] "SWORD" SWORD _CNV_A_R_LINEAR_____30_CM 1 100. -1024. 1023.96875 DISPLAY_IDENTIFIER SWORD ECU_ADDRESS 0xd00023d2 FORMAT "%11.5" /end MEASUREMENT
/begin MEASUREMENT nvmy_tqlo.nvmy_dtsysisad.tq_dif_is_ad_inter.sbyte[0] "SBYTE" SBYTE _CNV_A_R_LINEAR_____50_CM 1 100. -128. 127. DISPLAY_IDENTIFIER SBYTE ECU_ADDRESS 0xd00023d0 /end MEASUREMENT
/begin MEASUREMENT nvmy_tqlo.nvmy_dtsysisad.tq_dif_is_ad_inter.sbyte[1] "SBYTE" SBYTE _CNV_A_R_LINEAR_____50_CM 1 100. -128. 127. DISPLAY_IDENTIFIER SBYTE ECU_ADDRESS 0xd00023d1 /end MEASUREMENT
/begin MEASUREMENT nvmy_tqlo.nvmy_dtsysisad.tq_dif_is_ad_inter.sbyte[2] "SBYTE" SBYTE _CNV_A_R_LINEAR_____50_CM 1 100. -128. 127. DISPLAY_IDENTIFIER SBYTE ECU_ADDRESS 0xd00023d2 /end MEASUREMENT
/begin MEASUREMENT nvmy_tqlo.nvmy_dtsysisad.tq_dif_is_ad_inter.sbyte[3] "SBYTE" SBYTE _CNV_A_R_LINEAR_____50_CM 1 100. -128. 127. DISPLAY_IDENTIFIER SBYTE ECU_ADDRESS 0xd00023d3 /end MEASUREMENT
/begin MEASUREMENT nvmy_tqlo.nvmy_dtsysisad.tq_dif_is_ad_conv_inter.slongword "SLONGWORD" SLONG _CNV_A_R_TQLO_LINEA_451_CM 1 100. -1024. 1023.99999952316 DISPLAY_IDENTIFIER SLONGWORD ECU_ADDRESS 0xd00023d4 FORMAT "%13.7" /end MEASUREMENT
/begin MEASUREMENT nvmy_tqlo.nvmy_dtsysisad.tq_dif_is_ad_conv_inter.sword[0] "SWORD" SWORD _CNV_A_R_LINEAR_____30_CM 1 100. -1024. 1023.96875 DISPLAY_IDENTIFIER SWORD ECU_ADDRESS 0xd00023d4 FORMAT "%11.5" /end MEASUREMENT
/begin MEASUREMENT nvmy_tqlo.nvmy_dtsysisad.tq_dif_is_ad_conv_inter.sword[1] "SWORD" SWORD _CNV_A_R_LINEAR_____30_CM 1 100. -1024. 1023.96875 DISPLAY_IDENTIFIER SWORD ECU_ADDRESS 0xd00023d6 FORMAT "%11.5" /end MEASUREMENT
/begin MEASUREMENT nvmy_tqlo.nvmy_dtsysisad.tq_dif_is_ad_conv_inter.sbyte[0] "SBYTE" SBYTE _CNV_A_R_LINEAR_____50_CM 1 100. -128. 127. DISPLAY_IDENTIFIER SBYTE ECU_ADDRESS 0xd00023d4 /end MEASUREMENT
/begin MEASUREMENT nvmy_tqlo.nvmy_dtsysisad.tq_dif_is_ad_conv_inter.sbyte[1] "SBYTE" SBYTE _CNV_A_R_LINEAR_____50_CM 1 100. -128. 127. DISPLAY_IDENTIFIER SBYTE ECU_ADDRESS 0xd00023d5 /end MEASUREMENT
/begin MEASUREMENT nvmy_tqlo.nvmy_dtsysisad.tq_dif_is_ad_conv_inter.sbyte[2] "SBYTE" SBYTE _CNV_A_R_LINEAR_____50_CM 1 100. -128. 127. DISPLAY_IDENTIFIER SBYTE ECU_ADDRESS 0xd00023d6 /end MEASUREMENT
/begin MEASUREMENT nvmy_tqlo.nvmy_dtsysisad.tq_dif_is_ad_conv_inter.sbyte[3] "SBYTE" SBYTE _CNV_A_R_LINEAR_____50_CM 1 100. -128. 127. DISPLAY_IDENTIFIER SBYTE ECU_ADDRESS 0xd00023d7 /end MEASUREMENT
/begin MEASUREMENT nvmy_tqlo.nvmy_dtsysisad.tq_dif_is_ad_acc_1_inter.slongword "SLONGWORD" SLONG _CNV_A_R_TQLO_LINEA_451_CM 1 100. -1024. 1023.99999952316 DISPLAY_IDENTIFIER SLONGWORD ECU_ADDRESS 0xd00023d8 FORMAT "%13.7" /end MEASUREMENT
/begin MEASUREMENT nvmy_tqlo.nvmy_dtsysisad.tq_dif_is_ad_acc_1_inter.sword[0] "SWORD" SWORD _CNV_A_R_LINEAR_____30_CM 1 100. -1024. 1023.96875 DISPLAY_IDENTIFIER SWORD ECU_ADDRESS 0xd00023d8 FORMAT "%11.5" /end MEASUREMENT
/begin MEASUREMENT nvmy_tqlo.nvmy_dtsysisad.tq_dif_is_ad_acc_1_inter.sword[1] "SWORD" SWORD _CNV_A_R_LINEAR_____30_CM 1 100. -1024. 1023.96875 DISPLAY_IDENTIFIER SWORD ECU_ADDRESS 0xd00023da FORMAT "%11.5" /end MEASUREMENT
/begin MEASUREMENT nvmy_tqlo.nvmy_dtsysisad.tq_dif_is_ad_acc_1_inter.sbyte[0] "SBYTE" SBYTE _CNV_A_R_LINEAR_____50_CM 1 100. -128. 127. DISPLAY_IDENTIFIER SBYTE ECU_ADDRESS 0xd00023d8 /end MEASUREMENT
/begin MEASUREMENT nvmy_tqlo.nvmy_dtsysisad.tq_dif_is_ad_acc_1_inter.sbyte[1] "SBYTE" SBYTE _CNV_A_R_LINEAR_____50_CM 1 100. -128. 127. DISPLAY_IDENTIFIER SBYTE ECU_ADDRESS 0xd00023d9 /end MEASUREMENT
/begin MEASUREMENT nvmy_tqlo.nvmy_dtsysisad.tq_dif_is_ad_acc_1_inter.sbyte[2] "SBYTE" SBYTE _CNV_A_R_LINEAR_____50_CM 1 100. -128. 127. DISPLAY_IDENTIFIER SBYTE ECU_ADDRESS 0xd00023da /end MEASUREMENT
/begin MEASUREMENT nvmy_tqlo.nvmy_dtsysisad.tq_dif_is_ad_acc_1_inter.sbyte[3] "SBYTE" SBYTE _CNV_A_R_LINEAR_____50_CM 1 100. -128. 127. DISPLAY_IDENTIFIER SBYTE ECU_ADDRESS 0xd00023db /end MEASUREMENT
/begin MEASUREMENT nvmy_tqlo.nvmy_dtsysisad.tq_dif_is_ad_acc_conv_inter.slongword "SLONGWORD" SLONG _CNV_A_R_TQLO_LINEA_451_CM 1 100. -1024. 1023.99999952316 DISPLAY_IDENTIFIER SLONGWORD ECU_ADDRESS 0xd00023dc FORMAT "%13.7" /end MEASUREMENT
/begin MEASUREMENT nvmy_tqlo.nvmy_dtsysisad.tq_dif_is_ad_acc_conv_inter.sword[0] "SWORD" SWORD _CNV_A_R_LINEAR_____30_CM 1 100. -1024. 1023.96875 DISPLAY_IDENTIFIER SWORD ECU_ADDRESS 0xd00023dc FORMAT "%11.5" /end MEASUREMENT
/begin MEASUREMENT nvmy_tqlo.nvmy_dtsysisad.tq_dif_is_ad_acc_conv_inter.sword[1] "SWORD" SWORD _CNV_A_R_LINEAR_____30_CM 1 100. -1024. 1023.96875 DISPLAY_IDENTIFIER SWORD ECU_ADDRESS 0xd00023de FORMAT "%11.5" /end MEASUREMENT
/begin MEASUREMENT nvmy_tqlo.nvmy_dtsysisad.tq_dif_is_ad_acc_conv_inter.sbyte[0] "SBYTE" SBYTE _CNV_A_R_LINEAR_____50_CM 1 100. -128. 127. DISPLAY_IDENTIFIER SBYTE ECU_ADDRESS 0xd00023dc /end MEASUREMENT
/begin MEASUREMENT nvmy_tqlo.nvmy_dtsysisad.tq_dif_is_ad_acc_conv_inter.sbyte[1] "SBYTE" SBYTE _CNV_A_R_LINEAR_____50_CM 1 100. -128. 127. DISPLAY_IDENTIFIER SBYTE ECU_ADDRESS 0xd00023dd /end MEASUREMENT
/begin MEASUREMENT nvmy_tqlo.nvmy_dtsysisad.tq_dif_is_ad_acc_conv_inter.sbyte[2] "SBYTE" SBYTE _CNV_A_R_LINEAR_____50_CM 1 100. -128. 127. DISPLAY_IDENTIFIER SBYTE ECU_ADDRESS 0xd00023de /end MEASUREMENT
/begin MEASUREMENT nvmy_tqlo.nvmy_dtsysisad.tq_dif_is_ad_acc_conv_inter.sbyte[3] "SBYTE" SBYTE _CNV_A_R_LINEAR_____50_CM 1 100. -128. 127. DISPLAY_IDENTIFIER SBYTE ECU_ADDRESS 0xd00023df /end MEASUREMENT
/begin MEASUREMENT cdn_diag_ect_el "Diagnosis condition for failure ect_el" UBYTE _CNV_A_R_LINEAR_____0_CM 1 100. 0. 7. DISPLAY_IDENTIFIER CDN_DIAG_ECT_EL ECU_ADDRESS 0xc0001c76 FORMAT "%3.0" /end MEASUREMENT
/begin MEASUREMENT lv_err_ect_el "Present failure : failure after filtering of diagnosis ECT" UBYTE _CNV_S_2_RANGE__0___1_CM 1 100. 0. 1. DISPLAY_IDENTIFIER LV_ERR_ECT_EL ECU_ADDRESS 0xd00033b7 BIT_MASK 0x1 /end MEASUREMENT
/begin AXIS_PTS ldp_ecfpwm "" 0xa1003568 ecfpwm[0] _REC_AXS_20_u1 99.609375 _CNV_A_R_LINEAR_____5_CM 8 0. 99.609375 FORMAT "%9.6" /end AXIS_PTS
/begin MEASUREMENT lv_err_ecf[0] "Boolean for electronic controlled cooling fan error" UBYTE _CNV_S_2_RANGE__0___1_CM 1 100. 0. 1. DISPLAY_IDENTIFIER LV_ERR_ECF[0] ECU_ADDRESS 0xd0002e4a /end MEASUREMENT
/begin MEASUREMENT pow_out_ecf "Cooling fan power output of all available fan(s) at the vehicle" UBYTE _CNV_A_R_LINEAR_____5_CM 1 100. 0. 99.609375 DISPLAY_IDENTIFIER POW_OUT_ECF ECU_ADDRESS 0xd0002e2d /end MEASUREMENT
/begin MEASUREMENT t_dly_purge_diagcps "Delay time for activating DIAGCPS-diagnosis (step2) after LV CL MMV 0  --> 1" UWORD _CNV_A_R_LINEAR_____107_CM 1 100. 0. 1310.7 DISPLAY_IDENTIFIER T_DLY_PURGE_DIAGCPS ECU_ADDRESS 0xd00040f8 FORMAT "%7.2" /end MEASUREMENT
/begin AXIS_PTS ldp_id_saf_tab_1 "" 0xa1020b40 online_dummy _REC_AXS_20_u1 255. _CNV_A_R_LINEAR_____0_CM 16 0. 255. FORMAT "%3.0" /end AXIS_PTS
/begin AXIS_PTS ldp_id_saf_tab_2 "" 0xa1020b54 online_dummy _REC_AXS_20_u1 255. _CNV_A_R_LINEAR_____0_CM 16 0. 255. FORMAT "%3.0" /end AXIS_PTS
/begin AXIS_PTS ldpm_n_id_crk_acq "" 0xa10220a8 n _REC_AXS_20_u2 8160. _CNV_A_R_LINEAR_____13_CM 6 0. 8160. FORMAT "%4.0" /end AXIS_PTS
/begin AXIS_PTS ldpm_n_id_cam_acq "" 0xa102208c n _REC_AXS_20_u2 8160. _CNV_A_R_LINEAR_____13_CM 12 0. 8160. FORMAT "%4.0" /end AXIS_PTS
/begin AXIS_PTS ldpm_n_t_n_dif_ofs_pred "" 0xa10220f4 n _REC_AXS_20_u2 8160. _CNV_A_R_LINEAR_____13_CM 8 0. 8160. FORMAT "%4.0" /end AXIS_PTS
/begin AXIS_PTS ldp_vs_fil_ip_fac_vs_tq_add_pl "" 0xa10218a4 vs_fil _REC_AXS_20_u2 511.99218 _CNV_A_R_LINEAR_____66_CM 4 0. 511.99218 FORMAT "%7.3" /end AXIS_PTS
/begin AXIS_PTS ldp_tq_av_ip_fac_n_grd "" 0xa10214f0 tq_av _REC_AXS_20_u2 2047.96875 _CNV_A_R_LINEAR_____65_CM 4 -1024. 1023.96875 FORMAT "%6.2" /end AXIS_PTS
/begin AXIS_PTS ldp_fac_tq_req_ip_fac_tq_drof "" 0xa10209dc fac_tq_req _REC_AXS_20_u2 1.99996948242188 _CNV_A_R_LINEAR_____8_CM 6 0. 1.99996948242188 FORMAT "%9.8" /end AXIS_PTS
/begin AXIS_PTS ldp_n_dif_drof__id_tq_drof "" 0xa1020ee4 n_dif_drof _REC_AXS_20_u2 65535. _CNV_A_R_LINEAR_____172_CM 3 -32768. 32767. FORMAT "%6.0" /end AXIS_PTS
/begin AXIS_PTS ldp_n_grd__id_tq_drof "" 0xa1020f06 n_grd _REC_AXS_20_u1 8160. _CNV_A_R_LINEAR_____28_CM 3 -4096. 4064. FORMAT "%5.0" /end AXIS_PTS
/begin AXIS_PTS ldp_gear__var_amt_load_im "" 0xa1020af0 gear _REC_AXS_20_u1 255. _CNV_A_R_LINEAR_____0_CM 8 0. 255. FORMAT "%3.0" /end AXIS_PTS
/begin AXIS_PTS ldpm_n_dif_pred_fac_tq_add_is "" 0xa1021fe8 n_dif_pred_pl_drof _REC_AXS_20_u2 65535. _CNV_A_R_LINEAR_____172_CM 8 -32768. 32767. FORMAT "%6.0" /end AXIS_PTS
/begin AXIS_PTS ldp_n_dif_pred_fac_tq_add_is_1 "" 0xa1020eec n_dif_pred_pl_drof _REC_AXS_20_u2 65535. _CNV_A_R_LINEAR_____172_CM 6 -32768. 32767. FORMAT "%6.0" /end AXIS_PTS
/begin AXIS_PTS ldp_n_dif_pred_fac_tq_add_is_2 "" 0xa1020efc n_dif_pred_pl_drof _REC_AXS_20_u2 65535. _CNV_A_R_LINEAR_____172_CM 4 -32768. 32767. FORMAT "%6.0" /end AXIS_PTS
/begin AXIS_PTS ldpm_fac_tq_req_drof "" 0xa1021a94 fac_tq_req _REC_AXS_20_u2 1.99996948242188 _CNV_A_R_LINEAR_____8_CM 6 0. 1.99996948242188 FORMAT "%7.5" /end AXIS_PTS
/begin AXIS_PTS ldp_fac_tq_req_drof_1 "" 0xa10209c0 fac_tq_req _REC_AXS_20_u2 1.99996948242188 _CNV_A_R_LINEAR_____8_CM 6 0. 1.99996948242188 FORMAT "%7.5" /end AXIS_PTS
/begin AXIS_PTS ldp_fac_tq_req_drof_2 "" 0xa10209d0 fac_tq_req _REC_AXS_20_u2 1.99996948242188 _CNV_A_R_LINEAR_____8_CM 4 0. 1.99996948242188 FORMAT "%7.5" /end AXIS_PTS
/begin AXIS_PTS ldp_tia_ip_fac_temp_tq_add_1 "" 0xa102137e tia _REC_AXS_20_u1 190.5 _CNV_A_R_LINEAR_____16_CM 6 -48. 142.5 FORMAT "%5.1" /end AXIS_PTS
/begin AXIS_PTS ldp_toil_ip_fac_temp_tq_add_1 "" 0xa1021402 toil _REC_AXS_20_u1 200. _CNV_A_R_LINEAR_____25_CM 6 -40. 160. FORMAT "%3.0" /end AXIS_PTS
/begin AXIS_PTS ldp_toil_ip_fac_temp_tq_add_2 "" 0xa102140a toil _REC_AXS_20_u1 200. _CNV_A_R_LINEAR_____25_CM 4 -40. 160. FORMAT "%3.0" /end AXIS_PTS
/begin AXIS_PTS ldp_n_grd_ip_n_dif_add_drof_1 "" 0xa1020f0a n_grd _REC_AXS_20_u1 8160. _CNV_A_R_LINEAR_____28_CM 4 -4096. 4064. FORMAT "%5.0" /end AXIS_PTS
/begin AXIS_PTS ldp_n_grd_ip_n_dif_add_drof_2 "" 0xa1020f10 n_grd _REC_AXS_20_u1 8160. _CNV_A_R_LINEAR_____28_CM 4 -4096. 4064. FORMAT "%5.0" /end AXIS_PTS
/begin AXIS_PTS ldp_n_sp_is_ip_n_dif_add_drof_1 "" 0xa1020ff4 n_sp_is _REC_AXS_20_u2 8160. _CNV_A_R_LINEAR_____13_CM 4 0. 8160. FORMAT "%4.0" /end AXIS_PTS
/begin AXIS_PTS ldp_n_sp_is_ip_n_dif_add_drof_2 "" 0xa1021000 n_sp_is _REC_AXS_20_u2 8160. _CNV_A_R_LINEAR_____13_CM 3 0. 8160. FORMAT "%4.0" /end AXIS_PTS
/begin AXIS_PTS ldpm_n_dif_drof_ip_tq_drof_1 "" 0xa1021f98 n_dif_drof _REC_AXS_20_u2 65535. _CNV_A_R_LINEAR_____172_CM 11 -32768. 32767. FORMAT "%6.0" /end AXIS_PTS
/begin AXIS_PTS ldpm_n_dif_drof_ip_tq_drof_2 "" 0xa1021fb0 n_dif_drof _REC_AXS_20_u2 65535. _CNV_A_R_LINEAR_____172_CM 6 -32768. 32767. FORMAT "%6.0" /end AXIS_PTS
/begin AXIS_PTS ldpm_n_grd_ip_tq_drof_1 "" 0xa1022024 n_grd _REC_AXS_20_u1 8160. _CNV_A_R_LINEAR_____28_CM 10 -4096. 4064. FORMAT "%5.0" /end AXIS_PTS
/begin AXIS_PTS ldpm_n_grd_ip_tq_drof_2 "" 0xa1022030 n_grd _REC_AXS_20_u1 8160. _CNV_A_R_LINEAR_____28_CM 6 -4096. 4064. FORMAT "%5.0" /end AXIS_PTS
/begin AXIS_PTS ldp_vs_fil_ip_fac_tq_drof_vs_1 "" 0xa1021884 vs_fil _REC_AXS_20_u2 511.99218 _CNV_A_R_LINEAR_____66_CM 6 0. 511.99218 FORMAT "%7.3" /end AXIS_PTS
/begin AXIS_PTS ldp_vs_fil_ip_fac_tq_drof_vs_2 "" 0xa1021894 vs_fil _REC_AXS_20_u2 511.99218 _CNV_A_R_LINEAR_____66_CM 6 0. 511.99218 FORMAT "%7.3" /end AXIS_PTS
/begin AXIS_PTS ldp_n_ip_fac_tq_drof_vs_1 "" 0xa1020f70 n _REC_AXS_20_u2 8160. _CNV_A_R_LINEAR_____13_CM 6 0. 8160. FORMAT "%4.0" /end AXIS_PTS
/begin AXIS_PTS ldp_tq_drof_grd_deac_1 "" 0xa1021510 tq_drof_fast _REC_AXS_20_u2 1023.96875 _CNV_A_R_LINEAR_____30_CM 6 0. 1023.96875 FORMAT "%7.2" /end AXIS_PTS
/begin AXIS_PTS ldp_tq_drof_grd_deac_2 "" 0xa1021520 tq_drof_fast _REC_AXS_20_u2 1023.96875 _CNV_A_R_LINEAR_____30_CM 6 0. 1023.96875 FORMAT "%7.2" /end AXIS_PTS
/begin MEASUREMENT maf_kgh_add_max "Maximum possible engine load for catalyst heating - kg/h" UWORD _CNV_A_R_LINEAR_____207_CM 1 100. 0. 2047.96875 DISPLAY_IDENTIFIER MAF_KGH_ADD_MAX ECU_ADDRESS 0xd0002c32 FORMAT "%7.2" /end MEASUREMENT
/begin MEASUREMENT tqi_sp_s "Torque setpoint for stratified combustion mode" SWORD _CNV_A_R_LINEAR_____30_CM 1 100. -1024. 1023.96875 DISPLAY_IDENTIFIER TQI_SP_S ECU_ADDRESS 0xd0002c3c FORMAT "%8.2" /end MEASUREMENT
/begin AXIS_PTS ldp_maf_cyl__amp_dec "" 0xa1020c60 maf_cyl _REC_AXS_20_u2 2047.96875 _CNV_A_R_LINEAR_____207_CM 4 0. 2047.96875 FORMAT "%6.2" /end AXIS_PTS
/begin MEASUREMENT lamb_cop_1 "Lambda for catalyst overheating prevention bank 1" UWORD _CNV_A_R_LINEAR_____122_CM 1 100. 0. 31.9990234375 DISPLAY_IDENTIFIER LAMB_COP_1 ECU_ADDRESS 0xd000274c FORMAT "%7.4" /end MEASUREMENT
/begin MEASUREMENT lamb_cop_2 "Lambda for catalyst overheating prevention bank 2" UWORD _CNV_A_R_LINEAR_____122_CM 1 100. 0. 31.9990234375 DISPLAY_IDENTIFIER LAMB_COP_2 ECU_ADDRESS 0xd000274e FORMAT "%7.4" /end MEASUREMENT
/begin MEASUREMENT lv_lamb_cop "Boolean for active catalyst overheating control" UBYTE _CNV_S_2_RANGE__0___1_CM 1 100. 0. 1. DISPLAY_IDENTIFIER LV_LAMB_COP ECU_ADDRESS 0xd0002ec6 BIT_MASK 0x1 /end MEASUREMENT
/begin MEASUREMENT lv_ch_hom_act "" UBYTE _CNV_S_2_RANGE__0___1_CM 1 100. 0. 1. DISPLAY_IDENTIFIER LV_CH_HOM_ACT ECU_ADDRESS 0xd0002ec7 BIT_MASK 0x1 /end MEASUREMENT
/begin MEASUREMENT lv_lamb_cop_[0] "Boolean for active catalyst overheating control bank 1" UBYTE _CNV_S_2_RANGE__0___1_CM 1 100. 0. 1. DISPLAY_IDENTIFIER LV_LAMB_COP[1] ECU_ADDRESS 0xd0002ec4 BIT_MASK 0x1 /end MEASUREMENT
/begin MEASUREMENT lv_lamb_cop_[1] "Boolean for active catalyst overheating control bank 2" UBYTE _CNV_S_2_RANGE__0___1_CM 1 100. 0. 1. DISPLAY_IDENTIFIER LV_LAMB_COP[2] ECU_ADDRESS 0xd0002ec5 BIT_MASK 0x1 /end MEASUREMENT
/begin MEASUREMENT n_sp_is_brake "idle speed correction due to accumulator charge" UWORD _CNV_A_R_LINEAR_____13_CM 1 100. 0. 32767. DISPLAY_IDENTIFIER N_SP_IS_BRAKE ECU_ADDRESS 0xd0004b5a FORMAT "%5.0" /end MEASUREMENT
/begin MEASUREMENT fac_tq_add_is_opm_sel "torque reserve for idle speed interpolation factor for operation switch manager" UBYTE _CNV_A_R_LINEAR_____71_CM 1 100. 0. 0.99609375 DISPLAY_IDENTIFIER FAC_TQ_ADD_IS_OPM_SEL ECU_ADDRESS 0xd00037e8 FORMAT "%5.3" /end MEASUREMENT
/begin MEASUREMENT fac_tq_loss_opm_sel "torque loss interpolation factor for opeartion switch manager" UBYTE _CNV_A_R_LINEAR_____71_CM 1 100. 0. 0.99609375 DISPLAY_IDENTIFIER FAC_TQ_LOSS_OPM_SEL ECU_ADDRESS 0xd0003804 FORMAT "%5.3" /end MEASUREMENT
/begin MEASUREMENT lamb_sp_[0] "lambda setpoint " UWORD _CNV_A_R_LINEAR_____122_CM 1 100. -32768. 32767. DISPLAY_IDENTIFIER LAMB_SP[1] ECU_ADDRESS 0xd0004be6 FORMAT "%7.4" /end MEASUREMENT
/begin MEASUREMENT lamb_sp_[1] "lambda setpoint " UWORD _CNV_A_R_LINEAR_____122_CM 1 100. -32768. 32767. DISPLAY_IDENTIFIER LAMB_SP[2] ECU_ADDRESS 0xd0004be8 FORMAT "%7.4" /end MEASUREMENT
/begin MEASUREMENT lamb_sp_hom[0] "lambda setpoint " UWORD _CNV_A_R_LINEAR_____23_CM 1 100. 0. 1.99993896484375 DISPLAY_IDENTIFIER LAMB_SP_HOM[1] ECU_ADDRESS 0xd0004bea FORMAT "%7.5" /end MEASUREMENT
/begin MEASUREMENT lamb_sp_hom[1] "lambda setpoint " UWORD _CNV_A_R_LINEAR_____23_CM 1 100. 0. 1.99993896484375 DISPLAY_IDENTIFIER LAMB_SP_HOM[2] ECU_ADDRESS 0xd0004bec FORMAT "%7.5" /end MEASUREMENT
/begin MEASUREMENT lv_cs "Clutch switch information from Siemens" UBYTE _CNV_S_2_RANGE__0___1_CM 1 100. 0. 1. DISPLAY_IDENTIFIER LV_CS ECU_ADDRESS 0xd0003808 BIT_MASK 0x1 /end MEASUREMENT
/begin AXIS_PTS ldpm_opm_req "" 0xa1022198 opm_req _REC_AXS_20_u1 8. _CNV_A_R_LINEAR_____0_CM 8 0. 8. FORMAT "%1.0" /end AXIS_PTS
/begin MEASUREMENT fac_eff_iga_ch_cor "Factor for basic ignition efficiency correction depening on engine operation mode" UBYTE _CNV_A_R_LINEAR_____467_CM 1 100. 0. 11.22 DISPLAY_IDENTIFIER FAC_EFF_IGA_CH_COR ECU_ADDRESS 0xd0003ce6 FORMAT "%5.2" /end MEASUREMENT
/begin AXIS_PTS ldpm_n_32_5_tqdr "" 0xa1021dc4 n_32 _REC_AXS_20_u1 8160. _CNV_A_R_LINEAR_____9_CM 10 0. 8160. FORMAT "%4.0" /end AXIS_PTS
/begin AXIS_PTS ldpm_n_32_6_tqdr "" 0xa1021de4 n_32 _REC_AXS_20_u1 8160. _CNV_A_R_LINEAR_____9_CM 10 0. 8160. FORMAT "%4.0" /end AXIS_PTS
/begin AXIS_PTS ldpm_fac_maf_rel_1_tqdr "" 0xa10219b0 fac_maf_rel _REC_AXS_20_u2 300. _CNV_A_R_LINEAR_____468_CM 10 0. 300. FORMAT "%5.1" /end AXIS_PTS
/begin AXIS_PTS ldpm_fac_maf_rel_2_tqdr "" 0xa10219c8 fac_maf_rel _REC_AXS_20_u2 300. _CNV_A_R_LINEAR_____468_CM 10 0. 300. FORMAT "%5.1" /end AXIS_PTS
/begin AXIS_PTS ldpm_n_32_1_tqdr "" 0xa1021da4 n_32 _REC_AXS_20_u1 8160. _CNV_A_R_LINEAR_____9_CM 16 0. 8160. FORMAT "%4.0" /end AXIS_PTS
/begin AXIS_PTS ldpm_fac_maf_rel_3_tqdr "" 0xa10219e0 fac_maf_rel _REC_AXS_20_u2 300. _CNV_A_R_LINEAR_____468_CM 16 0. 300. FORMAT "%5.1" /end AXIS_PTS
/begin AXIS_PTS ldpm_n_32_7_tqdr "" 0xa1021df0 n_32 _REC_AXS_20_u1 8160. _CNV_A_R_LINEAR_____9_CM 16 0. 8160. FORMAT "%4.0" /end AXIS_PTS
/begin AXIS_PTS ldpm_fac_maf_rel_4_tqdr "" 0xa1021a04 fac_maf_rel _REC_AXS_20_u2 300. _CNV_A_R_LINEAR_____468_CM 16 0. 300. FORMAT "%5.1" /end AXIS_PTS
/begin AXIS_PTS ldpm_opm_av "" 0xa102218c opm_av _REC_AXS_20_u1 8. _CNV_A_R_LINEAR_____0_CM 8 0. 8. FORMAT "%1.0" /end AXIS_PTS
/begin AXIS_PTS ldpm_eff_2_tqdr "" 0xa10219a4 opm_av _REC_AXS_20_u1 8. _CNV_A_R_LINEAR_____0_CM 8 0. 8. FORMAT "%1.0" /end AXIS_PTS
/begin AXIS_PTS ldpm_eff_1_tqdr "" 0xa1021998 opm_req _REC_AXS_20_u1 8. _CNV_A_R_LINEAR_____0_CM 8 0. 8. FORMAT "%1.0" /end AXIS_PTS
/begin AXIS_PTS ldpm_n_14_tqdr "" 0xa1021cdc n _REC_AXS_20_u2 8160. _CNV_A_R_LINEAR_____13_CM 20 0. 8160. FORMAT "%4.0" /end AXIS_PTS
/begin AXIS_PTS ldpm_maf_2_tqdr "" 0xa1021bc4 maf _REC_AXS_20_u2 69.45 _CNV_A_R_LINEAR_____108_CM 16 0. 1389. FORMAT "%7.2" /end AXIS_PTS
/begin AXIS_PTS ldp_iga_dif_ip_eff_iga "" 0xa1020bdc iga_dif_min _REC_AXS_20_u2 -180. _CNV_A_R_LINEAR_____169_CM 16 0. -180. FORMAT "%8.4" /end AXIS_PTS
/begin MEASUREMENT toil_mes "Oil temperature" UBYTE _CNV_A_R_LINEAR_____25_CM 1 100. -40. 160. DISPLAY_IDENTIFIER TOIL_MES ECU_ADDRESS 0xd000385c FORMAT "%3.0" /end MEASUREMENT
/begin MEASUREMENT state_oil_req "Recommended refill volume engine-oil" UBYTE _CNV_A_R_LINEAR_____0_CM 1 100. 0. 255. DISPLAY_IDENTIFIER STATE_OIL_REQ ECU_ADDRESS 0xd0003861 FORMAT "%3.0" /end MEASUREMENT
/begin MEASUREMENT state_loil "fluid-level engine-oil" UBYTE _CNV_A_R_LINEAR_____0_CM 1 100. 0. 255. DISPLAY_IDENTIFIER STATE_LOIL ECU_ADDRESS 0xd0003862 FORMAT "%3.0" /end MEASUREMENT
/begin MEASUREMENT qoil_ds_can_2_1 "ID2 BOS message 2" UBYTE _CNV_A_R_LINEAR_____0_CM 1 100. 0. 255. DISPLAY_IDENTIFIER QOIL_DS_CAN_2_1 ECU_ADDRESS 0xd0003863 FORMAT "%3.0" /end MEASUREMENT
/begin MEASUREMENT qoil_ds_can_2_2 "ID function BOS message 2" SWORD _CNV_A_R_LINEAR_____0_CM 1 100. -32768. 32767. DISPLAY_IDENTIFIER QOIL_DS_CAN_2_2 ECU_ADDRESS 0xd0004c8c FORMAT "%6.0" /end MEASUREMENT
/begin MEASUREMENT qoil_ds_can_2_3 "Forecast intermittent way BOS message 2" UBYTE _CNV_A_R_LINEAR_____0_CM 1 100. 0. 255. DISPLAY_IDENTIFIER QOIL_DS_CAN_2_3 ECU_ADDRESS 0xd0003864 FORMAT "%3.0" /end MEASUREMENT
/begin MEASUREMENT qoil_ds_can_2_4 "target-date year BOS message 2" UBYTE _CNV_A_R_LINEAR_____0_CM 1 100. 0. 255. DISPLAY_IDENTIFIER QOIL_DS_CAN_2_4 ECU_ADDRESS 0xd0003865 FORMAT "%3.0" /end MEASUREMENT
/begin MEASUREMENT qoil_ds_can_2_5 "target-date month BOS message 2" UBYTE _CNV_A_R_LINEAR_____0_CM 1 100. 0. 255. DISPLAY_IDENTIFIER QOIL_DS_CAN_2_5 ECU_ADDRESS 0xd0003866 FORMAT "%3.0" /end MEASUREMENT
/begin MEASUREMENT qoil_ds_can_2_6 "Forecast intermittent time BOS message 2" UBYTE _CNV_A_R_LINEAR_____0_CM 1 100. 0. 255. DISPLAY_IDENTIFIER QOIL_DS_CAN_2_6 ECU_ADDRESS 0xd0003867 FORMAT "%3.0" /end MEASUREMENT
/begin MEASUREMENT dist_resi_oil "Ausgabewert Restlaufstrecke Motoröl" SWORD _CNV_R_R_Def_km_sw__64_CM 1 100. -327680. 327670. DISPLAY_IDENTIFIER DIST_RESI_OIL ECU_ADDRESS 0xd0004c8e FORMAT "%6.1" /end MEASUREMENT
/begin MEASUREMENT dist_resi_oil_km "Einheit der BOS-Info (km)" UBYTE _CNV_A_R_LINEAR_____0_CM 1 100. 0. 255. DISPLAY_IDENTIFIER DIST_RESI_OIL_KM ECU_ADDRESS 0xd0003868 FORMAT "%3.0" /end MEASUREMENT
/begin MEASUREMENT state_oil_avl "Rest-Verfügbarkeit Motoröl in Prozent" UBYTE _CNV_A_R_LINEAR_____0_CM 1 100. 0. 255. DISPLAY_IDENTIFIER STATE_OIL_AVL ECU_ADDRESS 0xd0003869 FORMAT "%3.0" /end MEASUREMENT
/begin MEASUREMENT poil_sp "Oil pressure setpoint" UWORD _CNV_A_R_LINEAR_____470_CM 1 100. 0. 20. DISPLAY_IDENTIFIER POIL_SP ECU_ADDRESS 0xd0004c90 /end MEASUREMENT
/begin MEASUREMENT poil_pwm "Tastverhältnis Öldruck-Regelventil" UWORD _CNV_A_R_LINEAR_____7_CM 1 100. 0. 99.99847412109381 DISPLAY_IDENTIFIER POIL_PWM ECU_ADDRESS 0xd0004c92 /end MEASUREMENT
/begin MEASUREMENT fac_mff_cst_opm_sel "start fuel mass flow interpolation factor for operation switch manager" UBYTE _CNV_A_R_LINEAR_____71_CM 1 100. 0. 0.99609375 DISPLAY_IDENTIFIER FAC_MFF_CST_OPM_SEL ECU_ADDRESS 0xd0002ed2 FORMAT "%5.3" /end MEASUREMENT
/begin MEASUREMENT mff_sp_s "Fuel mass in stratified combustion." UWORD _CNV_A_R_LINEAR_____108_CM 1 100. 0. 1389. DISPLAY_IDENTIFIER MFF_SP_S ECU_ADDRESS 0xd00027a4 FORMAT "%7.2" /end MEASUREMENT
/begin MEASUREMENT fac_ti_wup_opm_sel "warm up injection time correction interpolation factor for operation switch manager" UBYTE _CNV_A_R_LINEAR_____71_CM 1 100. 0. 0.99609375 DISPLAY_IDENTIFIER FAC_TI_WUP_OPM_SEL ECU_ADDRESS 0xd0002ed5 FORMAT "%5.3" /end MEASUREMENT
/begin MEASUREMENT fac_ti_cast_opm_sel "post start injection time correction interpolation factor for operation switch manager" UBYTE _CNV_A_R_LINEAR_____71_CM 1 100. 0. 0.99609375 DISPLAY_IDENTIFIER FAC_TI_CAST_OPM_SEL ECU_ADDRESS 0xd0002ed4 FORMAT "%5.3" /end MEASUREMENT
/begin MEASUREMENT inj_mod_hom_req "injection mode selection hom(single/multi)" UBYTE _CNV_A_R_LINEAR_____0_CM 1 100. 0. 255. DISPLAY_IDENTIFIER INJ_MOD_HOM_REQ ECU_ADDRESS 0xd0002ed6 FORMAT "%3.0" /end MEASUREMENT
/begin MEASUREMENT inj_mod_s_req "injection mode selection strat (single/multi)" UBYTE _CNV_A_R_LINEAR_____0_CM 1 100. 0. 255. DISPLAY_IDENTIFIER INJ_MOD_S_REQ ECU_ADDRESS 0xd0002ed7 FORMAT "%3.0" /end MEASUREMENT
/begin MEASUREMENT mff_sp_1_s[0] "Fuel mass setpoint for the first pulse at stratified mode " UWORD _CNV_A_R_LINEAR_____108_CM 1 100. 0. 1389. DISPLAY_IDENTIFIER MFF_SP_1_S_1 ECU_ADDRESS 0xd0002768 FORMAT "%7.2" /end MEASUREMENT
/begin MEASUREMENT mff_sp_1_s[1] "Fuel mass setpoint for the first pulse at stratified mode " UWORD _CNV_A_R_LINEAR_____108_CM 1 100. 0. 1389. DISPLAY_IDENTIFIER MFF_SP_1_S_2 ECU_ADDRESS 0xd000276a FORMAT "%7.2" /end MEASUREMENT
/begin MEASUREMENT mff_sp_1_s[2] "Fuel mass setpoint for the first pulse at stratified mode " UWORD _CNV_A_R_LINEAR_____108_CM 1 100. 0. 1389. DISPLAY_IDENTIFIER MFF_SP_1_S_3 ECU_ADDRESS 0xd000276c FORMAT "%7.2" /end MEASUREMENT
/begin MEASUREMENT mff_sp_1_s[3] "Fuel mass setpoint for the first pulse at stratified mode " UWORD _CNV_A_R_LINEAR_____108_CM 1 100. 0. 1389. DISPLAY_IDENTIFIER MFF_SP_1_S_4 ECU_ADDRESS 0xd000276e FORMAT "%7.2" /end MEASUREMENT
/begin MEASUREMENT mff_sp_1_s[4] "Fuel mass setpoint for the first pulse at stratified mode " UWORD _CNV_A_R_LINEAR_____108_CM 1 100. 0. 1389. DISPLAY_IDENTIFIER MFF_SP_1_S_5 ECU_ADDRESS 0xd0002770 FORMAT "%7.2" /end MEASUREMENT
/begin MEASUREMENT mff_sp_1_s[5] "Fuel mass setpoint for the first pulse at stratified mode " UWORD _CNV_A_R_LINEAR_____108_CM 1 100. 0. 1389. DISPLAY_IDENTIFIER MFF_SP_1_S_6 ECU_ADDRESS 0xd0002772 FORMAT "%7.2" /end MEASUREMENT
/begin MEASUREMENT mff_sp_2_s[0] "Fuel mass setpoint for the  second  pulse at stratified mode " UWORD _CNV_A_R_LINEAR_____108_CM 1 100. 0. 1389. DISPLAY_IDENTIFIER MFF_SP_2_S_1 ECU_ADDRESS 0xd000278c FORMAT "%7.2" /end MEASUREMENT
/begin MEASUREMENT mff_sp_2_s[1] "Fuel mass setpoint for the  second  pulse at stratified mode " UWORD _CNV_A_R_LINEAR_____108_CM 1 100. 0. 1389. DISPLAY_IDENTIFIER MFF_SP_2_S_2 ECU_ADDRESS 0xd000278e FORMAT "%7.2" /end MEASUREMENT
/begin MEASUREMENT mff_sp_2_s[2] "Fuel mass setpoint for the  second  pulse at stratified mode " UWORD _CNV_A_R_LINEAR_____108_CM 1 100. 0. 1389. DISPLAY_IDENTIFIER MFF_SP_2_S_3 ECU_ADDRESS 0xd0002790 FORMAT "%7.2" /end MEASUREMENT
/begin MEASUREMENT mff_sp_2_s[3] "Fuel mass setpoint for the  second  pulse at stratified mode " UWORD _CNV_A_R_LINEAR_____108_CM 1 100. 0. 1389. DISPLAY_IDENTIFIER MFF_SP_2_S_4 ECU_ADDRESS 0xd0002792 FORMAT "%7.2" /end MEASUREMENT
/begin MEASUREMENT mff_sp_2_s[4] "Fuel mass setpoint for the  second  pulse at stratified mode " UWORD _CNV_A_R_LINEAR_____108_CM 1 100. 0. 1389. DISPLAY_IDENTIFIER MFF_SP_2_S_5 ECU_ADDRESS 0xd0002794 FORMAT "%7.2" /end MEASUREMENT
/begin MEASUREMENT mff_sp_2_s[5] "Fuel mass setpoint for the  second  pulse at stratified mode " UWORD _CNV_A_R_LINEAR_____108_CM 1 100. 0. 1389. DISPLAY_IDENTIFIER MFF_SP_2_S_6 ECU_ADDRESS 0xd0002796 FORMAT "%7.2" /end MEASUREMENT
/begin MEASUREMENT mff_sp_3_s[0] "Fuel mass setpoint for the third  pulse at stratified mode " UWORD _CNV_A_R_LINEAR_____108_CM 1 100. 0. 1389. DISPLAY_IDENTIFIER MFF_SP_3_S_1 ECU_ADDRESS 0xd0002798 FORMAT "%7.2" /end MEASUREMENT
/begin MEASUREMENT mff_sp_3_s[1] "Fuel mass setpoint for the third  pulse at stratified mode " UWORD _CNV_A_R_LINEAR_____108_CM 1 100. 0. 1389. DISPLAY_IDENTIFIER MFF_SP_3_S_2 ECU_ADDRESS 0xd000279a FORMAT "%7.2" /end MEASUREMENT
/begin MEASUREMENT mff_sp_3_s[2] "Fuel mass setpoint for the third  pulse at stratified mode " UWORD _CNV_A_R_LINEAR_____108_CM 1 100. 0. 1389. DISPLAY_IDENTIFIER MFF_SP_3_S_3 ECU_ADDRESS 0xd000279c FORMAT "%7.2" /end MEASUREMENT
/begin MEASUREMENT mff_sp_3_s[3] "Fuel mass setpoint for the third  pulse at stratified mode " UWORD _CNV_A_R_LINEAR_____108_CM 1 100. 0. 1389. DISPLAY_IDENTIFIER MFF_SP_3_S_4 ECU_ADDRESS 0xd000279e FORMAT "%7.2" /end MEASUREMENT
/begin MEASUREMENT mff_sp_3_s[4] "Fuel mass setpoint for the third  pulse at stratified mode " UWORD _CNV_A_R_LINEAR_____108_CM 1 100. 0. 1389. DISPLAY_IDENTIFIER MFF_SP_3_S_5 ECU_ADDRESS 0xd00027a0 FORMAT "%7.2" /end MEASUREMENT
/begin MEASUREMENT mff_sp_3_s[5] "Fuel mass setpoint for the third  pulse at stratified mode " UWORD _CNV_A_R_LINEAR_____108_CM 1 100. 0. 1389. DISPLAY_IDENTIFIER MFF_SP_3_S_6 ECU_ADDRESS 0xd00027a2 FORMAT "%7.2" /end MEASUREMENT
/begin MEASUREMENT mff_sp_1_hom[0] "Fuel mass setpoint for the first pulse at homogeneous  mode " UWORD _CNV_A_R_LINEAR_____108_CM 1 100. 0. 1389. DISPLAY_IDENTIFIER MFF_SP_1_HOM_1 ECU_ADDRESS 0xd0002750 FORMAT "%7.2" /end MEASUREMENT
/begin MEASUREMENT mff_sp_1_hom[1] "Fuel mass setpoint for the first pulse at homogeneous  mode " UWORD _CNV_A_R_LINEAR_____108_CM 1 100. 0. 1389. DISPLAY_IDENTIFIER MFF_SP_1_HOM_2 ECU_ADDRESS 0xd0002752 FORMAT "%7.2" /end MEASUREMENT
/begin MEASUREMENT mff_sp_1_hom[2] "Fuel mass setpoint for the first pulse at homogeneous  mode " UWORD _CNV_A_R_LINEAR_____108_CM 1 100. 0. 1389. DISPLAY_IDENTIFIER MFF_SP_1_HOM_3 ECU_ADDRESS 0xd0002754 FORMAT "%7.2" /end MEASUREMENT
/begin MEASUREMENT mff_sp_1_hom[3] "Fuel mass setpoint for the first pulse at homogeneous  mode " UWORD _CNV_A_R_LINEAR_____108_CM 1 100. 0. 1389. DISPLAY_IDENTIFIER MFF_SP_1_HOM_4 ECU_ADDRESS 0xd0002756 FORMAT "%7.2" /end MEASUREMENT
/begin MEASUREMENT mff_sp_1_hom[4] "Fuel mass setpoint for the first pulse at homogeneous  mode " UWORD _CNV_A_R_LINEAR_____108_CM 1 100. 0. 1389. DISPLAY_IDENTIFIER MFF_SP_1_HOM_5 ECU_ADDRESS 0xd0002758 FORMAT "%7.2" /end MEASUREMENT
/begin MEASUREMENT mff_sp_1_hom[5] "Fuel mass setpoint for the first pulse at homogeneous  mode " UWORD _CNV_A_R_LINEAR_____108_CM 1 100. 0. 1389. DISPLAY_IDENTIFIER MFF_SP_1_HOM_6 ECU_ADDRESS 0xd000275a FORMAT "%7.2" /end MEASUREMENT
/begin MEASUREMENT mff_sp_2_hom[0] "Fuel mass setpoint for the second  pulse at homogeneous  mode " UWORD _CNV_A_R_LINEAR_____108_CM 1 100. 0. 1389. DISPLAY_IDENTIFIER MFF_SP_2_HOM_1 ECU_ADDRESS 0xd0002774 FORMAT "%7.2" /end MEASUREMENT
/begin MEASUREMENT mff_sp_2_hom[1] "Fuel mass setpoint for the second  pulse at homogeneous  mode " UWORD _CNV_A_R_LINEAR_____108_CM 1 100. 0. 1389. DISPLAY_IDENTIFIER MFF_SP_2_HOM_2 ECU_ADDRESS 0xd0002776 FORMAT "%7.2" /end MEASUREMENT
/begin MEASUREMENT mff_sp_2_hom[2] "Fuel mass setpoint for the second  pulse at homogeneous  mode " UWORD _CNV_A_R_LINEAR_____108_CM 1 100. 0. 1389. DISPLAY_IDENTIFIER MFF_SP_2_HOM_3 ECU_ADDRESS 0xd0002778 FORMAT "%7.2" /end MEASUREMENT
/begin MEASUREMENT mff_sp_2_hom[3] "Fuel mass setpoint for the second  pulse at homogeneous  mode " UWORD _CNV_A_R_LINEAR_____108_CM 1 100. 0. 1389. DISPLAY_IDENTIFIER MFF_SP_2_HOM_4 ECU_ADDRESS 0xd000277a FORMAT "%7.2" /end MEASUREMENT
/begin MEASUREMENT mff_sp_2_hom[4] "Fuel mass setpoint for the second  pulse at homogeneous  mode " UWORD _CNV_A_R_LINEAR_____108_CM 1 100. 0. 1389. DISPLAY_IDENTIFIER MFF_SP_2_HOM_5 ECU_ADDRESS 0xd000277c FORMAT "%7.2" /end MEASUREMENT
/begin MEASUREMENT mff_sp_2_hom[5] "Fuel mass setpoint for the second  pulse at homogeneous  mode " UWORD _CNV_A_R_LINEAR_____108_CM 1 100. 0. 1389. DISPLAY_IDENTIFIER MFF_SP_2_HOM_6 ECU_ADDRESS 0xd000277e FORMAT "%7.2" /end MEASUREMENT
/begin MEASUREMENT lv_eoi_st_ena "Indicates if an EOI based start is requested" UBYTE _CNV_S_2_RANGE__0___1_CM 1 100. 0. 1. DISPLAY_IDENTIFIER LV_EOI_ST_ENA ECU_ADDRESS 0xd0002edd /end MEASUREMENT
/begin MEASUREMENT lv_ti_cor_wf_opm_1_act "wall film operation mode switch" UBYTE _CNV_S_2_RANGE__0___1_CM 1 100. 0. 1. DISPLAY_IDENTIFIER LV_TI_COR_WF_OPM_1_ACT ECU_ADDRESS 0xd0002ede BIT_MASK 0x1 /end MEASUREMENT
/begin CHARACTERISTIC c_mff_sp_1_hom_man "Fuel mass setpoint for the first pulse in homogeneus mode (manual adjustment)" VALUE 0xa102957a _REC_VAL_20_u2 1389. _CNV_A_R_LINEAR_____108_CM 0. 1389. DISPLAY_IDENTIFIER C_MFF_SP_1_HOM_MAN FORMAT "%7.2" /end CHARACTERISTIC
/begin CHARACTERISTIC c_mff_sp_2_hom_man "Fuel mass setpoint for the second pulse in homogeneus mode (manual adjustment)" VALUE 0xa1029580 _REC_VAL_20_u2 1389. _CNV_A_R_LINEAR_____108_CM 0. 1389. DISPLAY_IDENTIFIER C_MFF_SP_2_HOM_MAN FORMAT "%7.2" /end CHARACTERISTIC
/begin CHARACTERISTIC c_mff_sp_1_s_man "Fuel mass setpoint for the first pulse in stratified mode (manual adjustment)" VALUE 0xa102957e _REC_VAL_20_u2 1389. _CNV_A_R_LINEAR_____108_CM 0. 1389. DISPLAY_IDENTIFIER C_MFF_SP_1_S_MAN FORMAT "%7.2" /end CHARACTERISTIC
/begin CHARACTERISTIC c_mff_sp_2_s_man "Fuel mass setpoint for the second pulse in stratified mode (manual adjustment)" VALUE 0xa1029584 _REC_VAL_20_u2 1389. _CNV_A_R_LINEAR_____108_CM 0. 1389. DISPLAY_IDENTIFIER C_MFF_SP_2_S_MAN FORMAT "%7.2" /end CHARACTERISTIC
/begin CHARACTERISTIC c_mff_sp_3_s_man "Fuel mass setpoint for the third pulse in stratified mode (manual adjustment)" VALUE 0xa1029586 _REC_VAL_20_u2 1389. _CNV_A_R_LINEAR_____108_CM 0. 1389. DISPLAY_IDENTIFIER C_MFF_SP_3_S_MAN FORMAT "%7.2" /end CHARACTERISTIC
/begin CHARACTERISTIC lc_mff_sp_hom_man_act "Switch for manual homogeneus mode active" VALUE 0xa1029d79 _REC_VAL_20_u1 1. _CNV_S_2_RANGE__0___1_CM 0. 1. DISPLAY_IDENTIFIER LC_MFF_SP_HOM_MAN_ACT /end CHARACTERISTIC
/begin CHARACTERISTIC lc_mff_sp_s_man_act "Switch for manual stratified mode active" VALUE 0xa1029d7b _REC_VAL_20_u1 1. _CNV_S_2_RANGE__0___1_CM 0. 1. DISPLAY_IDENTIFIER LC_MFF_SP_S_MAN_ACT /end CHARACTERISTIC
/begin CHARACTERISTIC lc_mff_add_ad_lam_bal_man "Manual switch to consider lamda adaption values for MFF_SP_1_S calculation" VALUE 0xa1029d78 _REC_VAL_20_u1 1. _CNV_S_2_RANGE__0___1_CM 0. 1. DISPLAY_IDENTIFIER LC_MFF_ADD_AD_LAM_BAL_MAN /end CHARACTERISTIC
/begin MEASUREMENT mff_sp_1_homs[0] "Fuel mass setpoint for the first pulse at homogeneous-stratified mode" UWORD _CNV_A_R_LINEAR_____108_CM 1 100. 0. 1389. DISPLAY_IDENTIFIER MFF_SP_1_HOMS[0] ECU_ADDRESS 0xd000275c FORMAT "%7.2" /end MEASUREMENT
/begin MEASUREMENT mff_sp_1_homs[1] "Fuel mass setpoint for the first pulse at homogeneous-stratified mode" UWORD _CNV_A_R_LINEAR_____108_CM 1 100. 0. 1389. DISPLAY_IDENTIFIER MFF_SP_1_HOMS[1] ECU_ADDRESS 0xd000275e FORMAT "%7.2" /end MEASUREMENT
/begin MEASUREMENT mff_sp_1_homs[2] "Fuel mass setpoint for the first pulse at homogeneous-stratified mode" UWORD _CNV_A_R_LINEAR_____108_CM 1 100. 0. 1389. DISPLAY_IDENTIFIER MFF_SP_1_HOMS[2] ECU_ADDRESS 0xd0002760 FORMAT "%7.2" /end MEASUREMENT
/begin MEASUREMENT mff_sp_1_homs[3] "Fuel mass setpoint for the first pulse at homogeneous-stratified mode" UWORD _CNV_A_R_LINEAR_____108_CM 1 100. 0. 1389. DISPLAY_IDENTIFIER MFF_SP_1_HOMS[3] ECU_ADDRESS 0xd0002762 FORMAT "%7.2" /end MEASUREMENT
/begin MEASUREMENT mff_sp_1_homs[4] "Fuel mass setpoint for the first pulse at homogeneous-stratified mode" UWORD _CNV_A_R_LINEAR_____108_CM 1 100. 0. 1389. DISPLAY_IDENTIFIER MFF_SP_1_HOMS[4] ECU_ADDRESS 0xd0002764 FORMAT "%7.2" /end MEASUREMENT
/begin MEASUREMENT mff_sp_1_homs[5] "Fuel mass setpoint for the first pulse at homogeneous-stratified mode" UWORD _CNV_A_R_LINEAR_____108_CM 1 100. 0. 1389. DISPLAY_IDENTIFIER MFF_SP_1_HOMS[5] ECU_ADDRESS 0xd0002766 FORMAT "%7.2" /end MEASUREMENT
/begin MEASUREMENT mff_sp_2_homs[0] "Fuel mass setpoint for the second pulse at homogeneous-stratified mode" UWORD _CNV_A_R_LINEAR_____108_CM 1 100. 0. 1389. DISPLAY_IDENTIFIER MFF_SP_2_HOMS[0] ECU_ADDRESS 0xd0002780 FORMAT "%7.2" /end MEASUREMENT
/begin MEASUREMENT mff_sp_2_homs[1] "Fuel mass setpoint for the second pulse at homogeneous-stratified mode" UWORD _CNV_A_R_LINEAR_____108_CM 1 100. 0. 1389. DISPLAY_IDENTIFIER MFF_SP_2_HOMS[1] ECU_ADDRESS 0xd0002782 FORMAT "%7.2" /end MEASUREMENT
/begin MEASUREMENT mff_sp_2_homs[2] "Fuel mass setpoint for the second pulse at homogeneous-stratified mode" UWORD _CNV_A_R_LINEAR_____108_CM 1 100. 0. 1389. DISPLAY_IDENTIFIER MFF_SP_2_HOMS[2] ECU_ADDRESS 0xd0002784 FORMAT "%7.2" /end MEASUREMENT
/begin MEASUREMENT mff_sp_2_homs[3] "Fuel mass setpoint for the second pulse at homogeneous-stratified mode" UWORD _CNV_A_R_LINEAR_____108_CM 1 100. 0. 1389. DISPLAY_IDENTIFIER MFF_SP_2_HOMS[3] ECU_ADDRESS 0xd0002786 FORMAT "%7.2" /end MEASUREMENT
/begin MEASUREMENT mff_sp_2_homs[4] "Fuel mass setpoint for the second pulse at homogeneous-stratified mode" UWORD _CNV_A_R_LINEAR_____108_CM 1 100. 0. 1389. DISPLAY_IDENTIFIER MFF_SP_2_HOMS[4] ECU_ADDRESS 0xd0002788 FORMAT "%7.2" /end MEASUREMENT
/begin MEASUREMENT mff_sp_2_homs[5] "Fuel mass setpoint for the second pulse at homogeneous-stratified mode" UWORD _CNV_A_R_LINEAR_____108_CM 1 100. 0. 1389. DISPLAY_IDENTIFIER MFF_SP_2_HOMS[5] ECU_ADDRESS 0xd000278a FORMAT "%7.2" /end MEASUREMENT
/begin MEASUREMENT lv_add_pulse_ena "Switch to enable additional injection pulse at homogeneous mode, single injection mode" UBYTE _CNV_S_2_RANGE__0___1_CM 1 100. 0. 1. DISPLAY_IDENTIFIER LV_ADD_PULSE_ENA ECU_ADDRESS 0xd0002edc /end MEASUREMENT
/begin CHARACTERISTIC lc_add_pulse_ena "Logical constant for enabling additional pulses in case of injection time update at transient conditions, homogeneous mode" VALUE 0xa1029d06 _REC_VAL_20_u1 1. _CNV_S_2_RANGE__0___1_CM 0. 1. DISPLAY_IDENTIFIER LC_ADD_PULSE_ENA /end CHARACTERISTIC
/begin MEASUREMENT injr.STR_INJR_ISPCLEGYIV0.ti_1_stnd_s[0] "Mapped Injection time, stratified mode, 1. pulse" UWORD _CNV_A_R_LINEAR_____233_CM 1 100. 0. 65.535 DISPLAY_IDENTIFIER TI_1_STND_S[0] ECU_ADDRESS 0xd0002a20 /end MEASUREMENT
/begin MEASUREMENT injr.STR_INJR_ISPCLEGYIV0.ti_1_stnd_s[1] "Mapped Injection time, stratified mode, 1. pulse" UWORD _CNV_A_R_LINEAR_____233_CM 1 100. 0. 65.535 DISPLAY_IDENTIFIER TI_1_STND_S[1] ECU_ADDRESS 0xd0002a22 /end MEASUREMENT
/begin MEASUREMENT injr.STR_INJR_ISPCLEGYIV0.ti_1_stnd_s[2] "Mapped Injection time, stratified mode, 1. pulse" UWORD _CNV_A_R_LINEAR_____233_CM 1 100. 0. 65.535 DISPLAY_IDENTIFIER TI_1_STND_S[2] ECU_ADDRESS 0xd0002a24 /end MEASUREMENT
/begin MEASUREMENT injr.STR_INJR_ISPCLEGYIV0.ti_1_stnd_s[3] "Mapped Injection time, stratified mode, 1. pulse" UWORD _CNV_A_R_LINEAR_____233_CM 1 100. 0. 65.535 DISPLAY_IDENTIFIER TI_1_STND_S[3] ECU_ADDRESS 0xd0002a26 /end MEASUREMENT
/begin MEASUREMENT injr.STR_INJR_ISPCLEGYIV0.ti_1_stnd_s[4] "Mapped Injection time, stratified mode, 1. pulse" UWORD _CNV_A_R_LINEAR_____233_CM 1 100. 0. 65.535 DISPLAY_IDENTIFIER TI_1_STND_S[4] ECU_ADDRESS 0xd0002a28 /end MEASUREMENT
/begin MEASUREMENT injr.STR_INJR_ISPCLEGYIV0.ti_1_stnd_s[5] "Mapped Injection time, stratified mode, 1. pulse" UWORD _CNV_A_R_LINEAR_____233_CM 1 100. 0. 65.535 DISPLAY_IDENTIFIER TI_1_STND_S[5] ECU_ADDRESS 0xd0002a2a /end MEASUREMENT
/begin MEASUREMENT injr.STR_INJR_ISPCLEGYIV0.ti_2_stnd_s[0] "Mapped Injection time, stratified mode, 2. pulse" UWORD _CNV_A_R_LINEAR_____233_CM 1 100. 0. 65.535 DISPLAY_IDENTIFIER TI_2_STND_S[0] ECU_ADDRESS 0xd0002a2c /end MEASUREMENT
/begin MEASUREMENT injr.STR_INJR_ISPCLEGYIV0.ti_2_stnd_s[1] "Mapped Injection time, stratified mode, 2. pulse" UWORD _CNV_A_R_LINEAR_____233_CM 1 100. 0. 65.535 DISPLAY_IDENTIFIER TI_2_STND_S[1] ECU_ADDRESS 0xd0002a2e /end MEASUREMENT
/begin MEASUREMENT injr.STR_INJR_ISPCLEGYIV0.ti_2_stnd_s[2] "Mapped Injection time, stratified mode, 2. pulse" UWORD _CNV_A_R_LINEAR_____233_CM 1 100. 0. 65.535 DISPLAY_IDENTIFIER TI_2_STND_S[2] ECU_ADDRESS 0xd0002a30 /end MEASUREMENT
/begin MEASUREMENT injr.STR_INJR_ISPCLEGYIV0.ti_2_stnd_s[3] "Mapped Injection time, stratified mode, 2. pulse" UWORD _CNV_A_R_LINEAR_____233_CM 1 100. 0. 65.535 DISPLAY_IDENTIFIER TI_2_STND_S[3] ECU_ADDRESS 0xd0002a32 /end MEASUREMENT
/begin MEASUREMENT injr.STR_INJR_ISPCLEGYIV0.ti_2_stnd_s[4] "Mapped Injection time, stratified mode, 2. pulse" UWORD _CNV_A_R_LINEAR_____233_CM 1 100. 0. 65.535 DISPLAY_IDENTIFIER TI_2_STND_S[4] ECU_ADDRESS 0xd0002a34 /end MEASUREMENT
/begin MEASUREMENT injr.STR_INJR_ISPCLEGYIV0.ti_2_stnd_s[5] "Mapped Injection time, stratified mode, 2. pulse" UWORD _CNV_A_R_LINEAR_____233_CM 1 100. 0. 65.535 DISPLAY_IDENTIFIER TI_2_STND_S[5] ECU_ADDRESS 0xd0002a36 /end MEASUREMENT
/begin MEASUREMENT injr.STR_INJR_ISPCLEGYIV0.fac_mff_dif_hom[0] "MFF-difference factor - homogenous operation" UWORD _CNV_A_R_LINEAR_____249_CM 1 100. -1. 0.99996948 DISPLAY_IDENTIFIER FAC_MFF_DIF_HOM[0] ECU_ADDRESS 0xd0002a44 FORMAT "%8.5" /end MEASUREMENT
/begin MEASUREMENT injr.STR_INJR_ISPCLEGYIV0.fac_mff_dif_hom[1] "MFF-difference factor - homogenous operation" UWORD _CNV_A_R_LINEAR_____249_CM 1 100. -1. 0.99996948 DISPLAY_IDENTIFIER FAC_MFF_DIF_HOM[1] ECU_ADDRESS 0xd0002a46 FORMAT "%8.5" /end MEASUREMENT
/begin MEASUREMENT injr.STR_INJR_ISPCLEGYIV0.fac_mff_dif_hom[2] "MFF-difference factor - homogenous operation" UWORD _CNV_A_R_LINEAR_____249_CM 1 100. -1. 0.99996948 DISPLAY_IDENTIFIER FAC_MFF_DIF_HOM[2] ECU_ADDRESS 0xd0002a48 FORMAT "%8.5" /end MEASUREMENT
/begin MEASUREMENT injr.STR_INJR_ISPCLEGYIV0.fac_mff_dif_hom[3] "MFF-difference factor - homogenous operation" UWORD _CNV_A_R_LINEAR_____249_CM 1 100. -1. 0.99996948 DISPLAY_IDENTIFIER FAC_MFF_DIF_HOM[3] ECU_ADDRESS 0xd0002a4a FORMAT "%8.5" /end MEASUREMENT
/begin MEASUREMENT injr.STR_INJR_ISPCLEGYIV0.fac_mff_dif_hom[4] "MFF-difference factor - homogenous operation" UWORD _CNV_A_R_LINEAR_____249_CM 1 100. -1. 0.99996948 DISPLAY_IDENTIFIER FAC_MFF_DIF_HOM[4] ECU_ADDRESS 0xd0002a4c FORMAT "%8.5" /end MEASUREMENT
/begin MEASUREMENT injr.STR_INJR_ISPCLEGYIV0.fac_mff_dif_hom[5] "MFF-difference factor - homogenous operation" UWORD _CNV_A_R_LINEAR_____249_CM 1 100. -1. 0.99996948 DISPLAY_IDENTIFIER FAC_MFF_DIF_HOM[5] ECU_ADDRESS 0xd0002a4e FORMAT "%8.5" /end MEASUREMENT
/begin AXIS_PTS ldp_amp_ip_load_clc_amp "" 0xa1003860 amp _REC_AXS_20_u2 5434. _CNV_A_R_LINEAR_____26_CM 6 0. 5434. FORMAT "%7.2" /end AXIS_PTS
/begin AXIS_PTS ldp_n_32_ip_load_clc "" 0xa1003890 n_32 _REC_AXS_20_u1 8160. _CNV_A_R_LINEAR_____9_CM 8 0. 8160. FORMAT "%4.0" /end AXIS_PTS
/begin AXIS_PTS ldp_maf_ip_load_clc "" 0xa100387c maf _REC_AXS_20_u2 1389. _CNV_A_R_LINEAR_____108_CM 8 0. 1389. FORMAT "%7.2" /end AXIS_PTS
/begin AXIS_PTS ldpm_tco__n_stall "" 0xa1022264 tco _REC_AXS_20_u1 190.5 _CNV_A_R_LINEAR_____16_CM 9 -48. 142.5 FORMAT "%5.1" /end AXIS_PTS
/begin AXIS_PTS ldp_n_32__iga_egr_s "" 0xa1020d7c n_32 _REC_AXS_20_u1 8160. _CNV_A_R_LINEAR_____9_CM 5 0. 8160. FORMAT "%4.0" /end AXIS_PTS
/begin AXIS_PTS ldp_mff_sp_s__egr_iga "" 0xa1020d60 mff_sp_s _REC_AXS_20_u2 1389. _CNV_A_R_LINEAR_____108_CM 5 0. 1389. FORMAT "%7.2" /end AXIS_PTS
/begin AXIS_PTS ldp_egr_ratio_cor_2__iga_bas "" 0xa102091c egr_ratio_cor_2 _REC_AXS_20_u2 99.99847412109381 _CNV_A_R_LINEAR_____489_CM 6 0. 99.99847412109381 /end AXIS_PTS
/begin AXIS_PTS ldpm_tco__iga_egr "" 0xa102224c tco _REC_AXS_20_u1 190.5 _CNV_A_R_LINEAR_____16_CM 8 -48. 142.5 FORMAT "%5.1" /end AXIS_PTS
/begin AXIS_PTS ldpm_n_32_ip_egr_ratio "" 0xa1021e64 n_32 _REC_AXS_20_u1 8160. _CNV_A_R_LINEAR_____9_CM 12 0. 8160. FORMAT "%4.0" /end AXIS_PTS
/begin AXIS_PTS ldpm_maf_ip_egr_ratio "" 0xa1021c60 maf _REC_AXS_20_u2 1389. _CNV_A_R_LINEAR_____108_CM 12 0. 1389. FORMAT "%7.2" /end AXIS_PTS
/begin MEASUREMENT lv_swi_aeb "switch to control the active engine brackets" UBYTE _CNV_S_2_RANGE__0___1_CM 1 100. 0. 1. DISPLAY_IDENTIFIER LV_SWI_AEB ECU_ADDRESS 0xd0003dc0 BIT_MASK 0x1 /end MEASUREMENT
/begin MEASUREMENT lv_inh_nt_act "flag inhibiting the NOx catalyst management" UBYTE _CNV_S_2_RANGE__0___1_CM 1 100. 0. 1. DISPLAY_IDENTIFIER LV_INH_NT_ACT ECU_ADDRESS 0xd0003ae1 BIT_MASK 0x1 /end MEASUREMENT
/begin MEASUREMENT lv_inh_rgn_req "flag inhibiting the request of a NOx catalyst regeneration" UBYTE _CNV_S_2_RANGE__0___1_CM 1 100. 0. 1. DISPLAY_IDENTIFIER LV_INH_RGN_REQ ECU_ADDRESS 0xd0003ae3 BIT_MASK 0x1 /end MEASUREMENT
/begin MEASUREMENT lv_inh_nt_afl "flag inhibiting lean operation (requests air/fuel stoichiometric)" UBYTE _CNV_S_2_RANGE__0___1_CM 1 100. 0. 1. DISPLAY_IDENTIFIER LV_INH_NT_AFL ECU_ADDRESS 0xd0003ae4 BIT_MASK 0x1 /end MEASUREMENT
/begin MEASUREMENT lv_inh_nt_prj_act "flag inhibiting the NOx catalyst auxiliary functionalities (complete)" UBYTE _CNV_S_2_RANGE__0___1_CM 1 100. 0. 1. DISPLAY_IDENTIFIER LV_INH_NT_PRJ_ACT ECU_ADDRESS 0xd0003ae8 BIT_MASK 0x1 /end MEASUREMENT
/begin MEASUREMENT lv_inh_nt_stc_max "flag inhibiting the full saturation" UBYTE _CNV_S_2_RANGE__0___1_CM 1 100. 0. 1. DISPLAY_IDENTIFIER LV_INH_NT_STC_MAX ECU_ADDRESS 0xd0003ae9 BIT_MASK 0x1 /end MEASUREMENT
/begin MEASUREMENT lv_inh_nt_o2_stc "Flag for inhibition of oxygen storage capacity adaptation" UBYTE _CNV_S_2_RANGE__0___1_CM 1 100. 0. 1. DISPLAY_IDENTIFIER LV_INH_NT_O2_STC ECU_ADDRESS 0xd0003aea BIT_MASK 0x1 /end MEASUREMENT
/begin MEASUREMENT lv_inh_rgn_req_ntld "flah inhibiting the request of a NOx catalyst regeneration due to high loading degree" UBYTE _CNV_S_2_RANGE__0___1_CM 1 100. 0. 1. DISPLAY_IDENTIFIER LV_INH_RGN_REQ_NTLD ECU_ADDRESS 0xd0003ae7 BIT_MASK 0x1 /end MEASUREMENT
/begin MEASUREMENT lv_inh_rgn_req_nox_sens "Inhibition flag for NOx catalyst regeneration request by NOx sensor readiness" UBYTE _CNV_S_2_RANGE__0___1_CM 1 100. 0. 1. DISPLAY_IDENTIFIER LV_INH_RGN_REQ_NOX_SENS ECU_ADDRESS 0xd0003ae5 BIT_MASK 0x1 /end MEASUREMENT
/begin MEASUREMENT lv_adj_nox_sens_rgn "Exclusively regeneration by NOx sensor is allowed(=0)" UBYTE _CNV_S_2_RANGE__0___1_CM 1 100. 0. 1. DISPLAY_IDENTIFIER LV_ADJ_NOX_SENS_RGN ECU_ADDRESS 0xd0003aec BIT_MASK 0x1 /end MEASUREMENT
/begin MEASUREMENT state_rgn_req "State of regenration request" UBYTE _CNV_S_4_STATE_RGN__496_CM 1 100. 0. 3. DISPLAY_IDENTIFIER STATE_RGN_REQ ECU_ADDRESS 0xc0000a8a /end MEASUREMENT
/begin MEASUREMENT lv_ntld_adj "Flag to activate NOx catalyst loading degree threshold for regeneration without NOx sensor readiness" UBYTE _CNV_S_2_RANGE__0___1_CM 1 100. 0. 1. DISPLAY_IDENTIFIER LV_NTLD_ADJ ECU_ADDRESS 0xd0003aed BIT_MASK 0x1 /end MEASUREMENT
/begin MEASUREMENT lv_tnt_mdl_max_ofs "Catalyst cooling function activation flag" UBYTE _CNV_S_2_RANGE__0___1_CM 1 100. 0. 1. DISPLAY_IDENTIFIER LV_TNT_MDL_MAX_OFS ECU_ADDRESS 0xd0003aeb BIT_MASK 0x1 /end MEASUREMENT
/begin MEASUREMENT tnt_mdl_max_ofs "Nox catalyst temperature offset to enable catalyst cooling at standing car" SBYTE _CNV_A_R_LINEAR_____490_CM 1 100. -512. 508. DISPLAY_IDENTIFIER TNT_MDL_MAX_OFS ECU_ADDRESS 0xd0003ae0 FORMAT "%4.2" /end MEASUREMENT
/begin MEASUREMENT lv_ntld_rgn_req_afs_swi "Request of a NOx catalyst regeneration before a switch to stoichiometric operation is done" UBYTE _CNV_S_2_RANGE__0___1_CM 1 100. 0. 1. DISPLAY_IDENTIFIER LV_NTLD_RGN_REQ_AFS_SWI ECU_ADDRESS 0xd0003aee BIT_MASK 0x1 /end MEASUREMENT
/begin MEASUREMENT t_vs_is_nt "Catalyst cooling function activation timer" UBYTE _CNV_A_R_LINEAR_____4_CM 1 100. 0. 25.5 DISPLAY_IDENTIFIER T_VS_IS_NT ECU_ADDRESS 0xc0000a8b FORMAT "%4.1" /end MEASUREMENT
/begin MEASUREMENT fac_maf_rel "relative filling" UWORD _CNV_A_R_LINEAR_____468_CM 1 100. 0. 300. DISPLAY_IDENTIFIER FAC_MAF_REL ECU_ADDRESS 0xd0002c74 FORMAT "%5.1" /end MEASUREMENT
/begin MEASUREMENT maf_sp "MAF setpoint output for inverse air path" UWORD _CNV_A_R_LINEAR_____108_CM 1 100. 0. 1389. DISPLAY_IDENTIFIER MAF_SP ECU_ADDRESS 0xd0002c60 FORMAT "%6.2" /end MEASUREMENT
/begin MEASUREMENT map_drv1 "First derivative of  intake  manifold pressure " SWORD _CNV_A_R_LINEAR_____539_CM 1 100. -82.91625999999999 82.91377 DISPLAY_IDENTIFIER MAP_DRV1 ECU_ADDRESS 0xd0002c84 FORMAT "%7.3" /end MEASUREMENT
/begin MEASUREMENT map_sp " manifold air pressure setpoint" UWORD _CNV_A_R_LINEAR_____26_CM 1 100. 0. 5434. DISPLAY_IDENTIFIER MAP_SP ECU_ADDRESS 0xd0002c86 FORMAT "%7.2" /end MEASUREMENT
/begin MEASUREMENT pq_egr_sp "pressure quotient between exhausted branch and MAP" UWORD _CNV_A_R_LINEAR_____150_CM 1 100. 0. 1. DISPLAY_IDENTIFIER PQ_EGR_SP ECU_ADDRESS 0xd0004cc0 FORMAT "%8.6" /end MEASUREMENT
/begin MEASUREMENT maf_egr_neut_gas "mass flow of inert gas" UWORD _CNV_A_R_LINEAR_____108_CM 1 100. 0. 1389. DISPLAY_IDENTIFIER MAF_EGR_NEUT_GAS ECU_ADDRESS 0xd0002c8a FORMAT "%6.2" /end MEASUREMENT
/begin MEASUREMENT lv_tps_sub_diag_not_vld "Bedingung Berechnung DKWinkel aus Signal des HF-Sensors ungedrosselt " UBYTE _CNV_S_2_RANGE__0___1_CM 1 100. 0. 1. DISPLAY_IDENTIFIER LV_TPS_SUB_DIAG_NOT_VLD ECU_ADDRESS 0xd0002fb8 /end MEASUREMENT
/begin MEASUREMENT fac_maf_ad_thr_kwp "Testerwert NN DK-Adaption" SWORD _CNV_A_R_LINEAR_____275_CM 1 100. -1. 0.999969482421875 DISPLAY_IDENTIFIER FAC_MAF_AD_THR_KWP ECU_ADDRESS 0xd0002c8c FORMAT "%8.5" /end MEASUREMENT
/begin MEASUREMENT fac_maf_ad_egr_kwp "Testerwert NN PR-Adaption" SWORD _CNV_A_R_LINEAR_____23_CM 1 100. -2. 1.99993896484375 DISPLAY_IDENTIFIER FAC_MAF_AD_EGR_KWP ECU_ADDRESS 0xd0002c8e FORMAT "%8.5" /end MEASUREMENT
/begin MEASUREMENT lv_vim_inh_cus "Enable bit for VIM" UBYTE _CNV_S_2_RANGE__0___1_CM 1 100. 0. 1. DISPLAY_IDENTIFIER LV_VIM_INH_CUS ECU_ADDRESS 0xd000380c BIT_MASK 0x1 /end MEASUREMENT
/begin MEASUREMENT lv_vim_1_cus "Request from BMW for open variable intake manifold 1" UBYTE _CNV_S_2_RANGE__0___1_CM 1 100. 0. 1. DISPLAY_IDENTIFIER LV_VIM_1_CUS ECU_ADDRESS 0xd000380d BIT_MASK 0x1 /end MEASUREMENT
/begin MEASUREMENT lv_vim_2_cus "Request from BMW for open variable intake manifold 2" UBYTE _CNV_S_2_RANGE__0___1_CM 1 100. 0. 1. DISPLAY_IDENTIFIER LV_VIM_2_CUS ECU_ADDRESS 0xd000380e BIT_MASK 0x1 /end MEASUREMENT
/begin CHARACTERISTIC lc_rpu_lamb_rgn_2 "switch to use RPU value of LAMB_RGN_i" VALUE 0xa1029dc9 _REC_VAL_20_u1 1. _CNV_A_R_LINEAR_____0_CM 0. 1. DISPLAY_IDENTIFIER LC_RPU_LAMB_RGN_2 FORMAT "%1.0" /end CHARACTERISTIC
/begin MEASUREMENT lv_puc_lock_tnt "PUC prohibited, if TNT_MDL_H to large" UBYTE _CNV_S_2_RANGE__0___1_CM 1 100. 0. 1. DISPLAY_IDENTIFIER LV_PUC_LOCK_TNT ECU_ADDRESS 0xd0003810 BIT_MASK 0x1 /end MEASUREMENT
/begin MEASUREMENT tq_max_acc "air-conditioning-compressor limit torque" UBYTE _CNV_A_R_LINEAR_____57_CM 1 100. 0. 127.5 DISPLAY_IDENTIFIER TQ_MAX_ACC ECU_ADDRESS 0xd00037cd FORMAT "%3.1" /end MEASUREMENT
/begin MEASUREMENT pwm_value_hiv_perc "control signal for heater inlet valve" UBYTE _CNV_A_R_LINEAR_____565_CM 1 100. 0. 150. DISPLAY_IDENTIFIER PWM_VALUE_HIV_PERC ECU_ADDRESS 0xd00037ce FORMAT "%5.1" /end MEASUREMENT
/begin MEASUREMENT state_egy_cns_off "state all electrical consumers off" UBYTE _CNV_A_R_LINEAR_____0_CM 1 100. 0. 255. DISPLAY_IDENTIFIER STATE_EGY_CNS_OFF ECU_ADDRESS 0xd00037d8 FORMAT "%3.0" /end MEASUREMENT
/begin MEASUREMENT state_engg_pos "state engagement positve" UBYTE _CNV_A_R_LINEAR_____0_CM 1 100. 0. 255. DISPLAY_IDENTIFIER STATE_ENGG_POS ECU_ADDRESS 0xd00037da FORMAT "%3.0" /end MEASUREMENT
/begin MEASUREMENT state_tq_wheel "state torque wheel" UBYTE _CNV_A_R_LINEAR_____0_CM 1 100. 0. 255. DISPLAY_IDENTIFIER STATE_TQ_WHEEL ECU_ADDRESS 0xd00037db FORMAT "%3.0" /end MEASUREMENT
/begin MEASUREMENT tq_wheel "torque wheel actual value" UWORD _CNV_A_R_LINEAR_____566_CM 1 100. -32000. 33535. DISPLAY_IDENTIFIER TQ_WHEEL ECU_ADDRESS 0xd0004b4a FORMAT "%6.0" /end MEASUREMENT
/begin MEASUREMENT tq_max_wheel "maximum torque wheel" UWORD _CNV_A_R_LINEAR_____566_CM 1 100. -32000. 33535. DISPLAY_IDENTIFIER TQ_MAX_WHEEL ECU_ADDRESS 0xd0004b4c FORMAT "%6.0" /end MEASUREMENT
/begin MEASUREMENT tq_min_wheel_l "minimum torque wheel low" UWORD _CNV_A_R_LINEAR_____566_CM 1 100. -32000. 33535. DISPLAY_IDENTIFIER TQ_MIN_WHEEL_L ECU_ADDRESS 0xd0004b4e FORMAT "%6.0" /end MEASUREMENT
/begin MEASUREMENT lv_can_snd_msg_pwr_mng_0 "Flag indicating \"Bedingung POWERMANAGMENT VERBRAUCHERSTEUERUNG Sendeanforderung\"" UBYTE _CNV_S_2_RANGE__0___1_CM 1 100. 0. 1. DISPLAY_IDENTIFIER LV_CAN_SND_MSG_PWR_MNG_0 ECU_ADDRESS 0xd00037dc BIT_MASK 0x1 /end MEASUREMENT
/begin MEASUREMENT lv_can_snd_msg_pwr_mng_1 "Flag indicating \"Bedingung POWERMANAGMENT BATTERIESPANNUNG Sendeanforderung\"" UBYTE _CNV_S_2_RANGE__0___1_CM 1 100. 0. 1. DISPLAY_IDENTIFIER LV_CAN_SND_MSG_PWR_MNG_1 ECU_ADDRESS 0xd00037dd BIT_MASK 0x1 /end MEASUREMENT
/begin MEASUREMENT lv_oil_cns_warn_1 "LV warning oil consumption" UBYTE _CNV_S_2_RANGE__0___1_CM 1 100. 0. 1. DISPLAY_IDENTIFIER LV_OIL_CNS_WARN_1 ECU_ADDRESS 0xd00037de BIT_MASK 0x1 /end MEASUREMENT
/begin MEASUREMENT lv_oil_cns_warn_2 "LV warning oil consumption" UBYTE _CNV_S_2_RANGE__0___1_CM 1 100. 0. 1. DISPLAY_IDENTIFIER LV_OIL_CNS_WARN_2 ECU_ADDRESS 0xd00037df BIT_MASK 0x1 /end MEASUREMENT
/begin MEASUREMENT lv_ldm_off "LDM off requested by DME" UBYTE _CNV_S_2_RANGE__0___1_CM 1 100. 0. 1. DISPLAY_IDENTIFIER LV_LDM_OFF ECU_ADDRESS 0xd00037e0 BIT_MASK 0x1 /end MEASUREMENT
/begin MEASUREMENT lv_gs_up "Gear-shift up" UBYTE _CNV_S_2_RANGE__0___1_CM 1 100. 0. 1. DISPLAY_IDENTIFIER LV_GS_UP ECU_ADDRESS 0xd00037e1 BIT_MASK 0x1 /end MEASUREMENT
/begin MEASUREMENT lv_gs_down "Gear-shift down" UBYTE _CNV_S_2_RANGE__0___1_CM 1 100. 0. 1. DISPLAY_IDENTIFIER LV_GS_DOWN ECU_ADDRESS 0xd00037e2 BIT_MASK 0x1 /end MEASUREMENT
/begin MEASUREMENT lv_ldm_driv_act "Condition LDM driver active" UBYTE _CNV_S_2_RANGE__0___1_CM 1 100. 0. 1. DISPLAY_IDENTIFIER LV_LDM_DRIV_ACT ECU_ADDRESS 0xd00037e3 BIT_MASK 0x1 /end MEASUREMENT
/begin MEASUREMENT gr_dt "Gear ratio factor" UBYTE _CNV_A_R_EGCP_LINEA_370_CM 1 100. 0. 31.875 DISPLAY_IDENTIFIER GR_DT ECU_ADDRESS 0xd00037d9 /end MEASUREMENT
/begin MEASUREMENT cur_rng_ctl "Control current path" UBYTE _CNV_A_R_LINEAR_____0_CM 1 100. 0. 255. DISPLAY_IDENTIFIER CUR_RNG_CTL ECU_ADDRESS 0xd00037cf FORMAT "%3.0" /end MEASUREMENT
/begin MEASUREMENT pow_ctl_pri_peak_red "Control priority peak reduction" UBYTE _CNV_A_R_LINEAR_____0_CM 1 100. 0. 255. DISPLAY_IDENTIFIER POW_CTL_PRI_PEAK_RED ECU_ADDRESS 0xd00037d1 FORMAT "%3.0" /end MEASUREMENT
/begin MEASUREMENT pow_ctl_pri_peak_red_cft "Control priority peak reduction comfort" UBYTE _CNV_A_R_LINEAR_____0_CM 1 100. 0. 255. DISPLAY_IDENTIFIER POW_CTL_PRI_PEAK_RED_CFT ECU_ADDRESS 0xd00037d2 FORMAT "%3.0" /end MEASUREMENT
/begin MEASUREMENT pow_ctl_park_cns "Control park consumer" UBYTE _CNV_A_R_LINEAR_____0_CM 1 100. 0. 255. DISPLAY_IDENTIFIER POW_CTL_PARK_CNS ECU_ADDRESS 0xd00037d0 FORMAT "%3.0" /end MEASUREMENT
/begin MEASUREMENT pow_ctl_pwr_cns_1 "Control power consumer" UWORD _CNV_A_R_LINEAR_____0_CM 1 100. 0. 65535. DISPLAY_IDENTIFIER POW_CTL_PWR_CNS_1 ECU_ADDRESS 0xd0004b46 FORMAT "%5.0" /end MEASUREMENT
/begin MEASUREMENT pow_ctl_pwr_cns_2 "Control power special consumer" UBYTE _CNV_A_R_LINEAR_____465_CM 1 100. 0. 127.5 DISPLAY_IDENTIFIER POW_CTL_PWR_CNS_2 ECU_ADDRESS 0xd00037d3 FORMAT "%5.1" /end MEASUREMENT
/begin MEASUREMENT idfbosmg_w "Control power consumer" UWORD _CNV_A_R_LINEAR_____0_CM 1 100. 0. 65535. DISPLAY_IDENTIFIER IDFBOSMG_W ECU_ADDRESS 0xd0004b48 FORMAT "%5.0" /end MEASUREMENT
/begin MEASUREMENT lv_inh_dc_rbm "" UBYTE _CNV_S_2_RANGE__0___1_CM 1 100. 0. 1. DISPLAY_IDENTIFIER LV_INH_DC_RBM ECU_ADDRESS 0xd0003544 BIT_MASK 0x1 /end MEASUREMENT
/begin AXIS_PTS ldp_tq_loss_alter_1__tq_alter "" 0xa100ac40 tq_loss_alter_1 _REC_AXS_20_u2 2047.96875 _CNV_A_R_LINEAR_____65_CM 6 -1024. 1023.96875 FORMAT "%6.2" /end AXIS_PTS
/begin AXIS_PTS ldp_n_32__tq_alter "" 0xa100ac2a n_32 _REC_AXS_20_u1 816. _CNV_A_R_LINEAR_____9_CM 6 0. 8160. FORMAT "%4.0" /end AXIS_PTS
/begin MEASUREMENT lv_err_ftl_obd "error flag fuel tank level" UBYTE _CNV_S_2_RANGE__0___1_CM 1 100. 0. 1. DISPLAY_IDENTIFIER LV_ERR_FTL_OBD ECU_ADDRESS 0xd0003488 BIT_MASK 0x1 /end MEASUREMENT
/begin MEASUREMENT lv_err_ftl_can "error flag fuel tank level" UBYTE _CNV_S_2_RANGE__0___1_CM 1 100. 0. 1. DISPLAY_IDENTIFIER LV_ERR_FTL_CAN ECU_ADDRESS 0xd0003489 BIT_MASK 0x1 /end MEASUREMENT
/begin MEASUREMENT n_max_lih_state_cmb_s "Engine speed limit for required  stratified limp home mode" UWORD _CNV_A_R_LINEAR_____13_CM 1 100. 0. 8160. DISPLAY_IDENTIFIER N_MAX_LIH_STATE_CMB_S ECU_ADDRESS 0xd0004b60 FORMAT "%4.0" /end MEASUREMENT
/begin AXIS_PTS ldp_idx_bsd_sdl_tbl "" 0xa1020b68 online_dummy _REC_AXS_20_u1 255. _CNV_A_R_LINEAR_____0_CM 32 0. 255. FORMAT "%3.0" /end AXIS_PTS
/begin MEASUREMENT lv_cp_inh_cus "CPS-INH request from customer" UBYTE _CNV_S_2_RANGE__0___1_CM 1 100. 0. 1. DISPLAY_IDENTIFIER LV_CP_INH_CUS ECU_ADDRESS 0xd00038f4 BIT_MASK 0x1 /end MEASUREMENT
/begin MEASUREMENT mff_max_cp_cus "Maximum mass flow from canister purge" SWORD _CNV_A_R_LINEAR_____202_CM 1 100. -694.510597390707 694.4894026092931 DISPLAY_IDENTIFIER MFF_MAX_CP_CUS ECU_ADDRESS 0xd0004cf4 FORMAT "%7.2" /end MEASUREMENT
/begin MEASUREMENT mff_add_tq_cp "TQ relevant mass flow" SWORD _CNV_A_R_LINEAR_____202_CM 1 100. -694.510597390707 694.4894026092931 DISPLAY_IDENTIFIER MFF_ADD_TQ_CP ECU_ADDRESS 0xd0004cf6 FORMAT "%7.2" /end MEASUREMENT
/begin MEASUREMENT state_nox_rpu "RPU value of STATE_NOX" UBYTE _CNV_S_6_STATE_NOX__514_CM 1 100. 0. 5. DISPLAY_IDENTIFIER STATE_NOX_RPU ECU_ADDRESS 0xd000384e /end MEASUREMENT
/begin MEASUREMENT nt_eff_cor_rpu "RPU value of NT_EFF_COR" UBYTE _CNV_A_R_LINEAR_____255_CM 1 100. 0. 3.984375 DISPLAY_IDENTIFIER NT_EFF_COR_RPU ECU_ADDRESS 0xd000384f FORMAT "%4.2" /end MEASUREMENT
/begin MEASUREMENT nt_stc_bas_rpu "RPU value of NT_STC_BAS" UWORD _CNV_A_R_LINEAR_____495_CM 1 100. 0. 10485.6 DISPLAY_IDENTIFIER NT_STC_BAS_RPU ECU_ADDRESS 0xd0004c2c FORMAT "%7.1" /end MEASUREMENT
/begin MEASUREMENT ntl_rpu "RPU value of NTL_RPU" UWORD _CNV_A_R_LINEAR_____495_CM 1 100. 0. 10485.6 DISPLAY_IDENTIFIER NTL_RPU ECU_ADDRESS 0xd0004c2e FORMAT "%7.1" /end MEASUREMENT
/begin MEASUREMENT lv_rgn_nt_req_rpu "RPU value of LV_RGN_NT_REQ_RPU" UBYTE _CNV_S_2_RANGE__0___1_CM 1 100. 0. 1. DISPLAY_IDENTIFIER LV_RGN_NT_REQ_RPU ECU_ADDRESS 0xd0003851 BIT_MASK 0x1 /end MEASUREMENT
/begin MEASUREMENT lv_nt_afs_req_rpu "RPU value of LV_NT_AFS_REQ" UBYTE _CNV_S_2_RANGE__0___1_CM 1 100. 0. 1. DISPLAY_IDENTIFIER LV_NT_AFS_REQ_RPU ECU_ADDRESS 0xd0003852 BIT_MASK 0x1 /end MEASUREMENT
/begin MEASUREMENT lv_rgn_agi_rpu_1 "RPU value of  LV_RGN_AGI_1" UBYTE _CNV_S_2_RANGE__0___1_CM 1 100. 0. 1. DISPLAY_IDENTIFIER LV_RGN_AGI_RPU_1 ECU_ADDRESS 0xd0003854 BIT_MASK 0x1 /end MEASUREMENT
/begin MEASUREMENT lv_rgn_agi_rpu_2 "RPU value of  LV_RGN_AGI_2" UBYTE _CNV_S_2_RANGE__0___1_CM 1 100. 0. 1. DISPLAY_IDENTIFIER LV_RGN_AGI_RPU_2 ECU_ADDRESS 0xd0003858 BIT_MASK 0x1 /end MEASUREMENT
/begin MEASUREMENT lv_act_int_puc_afl_rpu_1 "RPU value of  LV_ACT_INT_PUC_AFL_1" UBYTE _CNV_S_2_RANGE__0___1_CM 1 100. 0. 1. DISPLAY_IDENTIFIER LV_ACT_INT_PUC_AFL_RPU_1 ECU_ADDRESS 0xd0003855 BIT_MASK 0x1 /end MEASUREMENT
/begin MEASUREMENT lv_act_int_puc_afl_rpu_2 "RPU value of  LV_ACT_INT_PUC_AFL_2" UBYTE _CNV_S_2_RANGE__0___1_CM 1 100. 0. 1. DISPLAY_IDENTIFIER LV_ACT_INT_PUC_AFL_RPU_2 ECU_ADDRESS 0xd0003859 BIT_MASK 0x1 /end MEASUREMENT
/begin MEASUREMENT lv_sens_afr_rpu_1 "RPU value of  LV_SENS_AFR_1" UBYTE _CNV_S_2_RANGE__0___1_CM 1 100. 0. 1. DISPLAY_IDENTIFIER LV_SENS_AFR_RPU_1 ECU_ADDRESS 0xd0003856 BIT_MASK 0x1 /end MEASUREMENT
/begin MEASUREMENT lv_sens_afr_rpu_2 "RPU value of  LV_SENS_AFR_2" UBYTE _CNV_S_2_RANGE__0___1_CM 1 100. 0. 1. DISPLAY_IDENTIFIER LV_SENS_AFR_RPU_2 ECU_ADDRESS 0xd000385a BIT_MASK 0x1 /end MEASUREMENT
/begin MEASUREMENT lv_nt_req_rgn "Logical value for regeneration phase request" UBYTE _CNV_S_2_RANGE__0___1_CM 1 100. 0. 1. DISPLAY_IDENTIFIER LV_NT_REQ_RGN ECU_ADDRESS 0xd0003850 BIT_MASK 0x1 /end MEASUREMENT
/begin MEASUREMENT lamb_rgn_rpu_1 "RPU value of LAMB_RGN_RPU_1" UWORD _CNV_A_R_LINEAR_____122_CM 1 100. 0. 31.9990234375 DISPLAY_IDENTIFIER LAMB_RGN_RPU_1 ECU_ADDRESS 0xd0004c30 FORMAT "%7.4" /end MEASUREMENT
/begin MEASUREMENT nox_cor_s_rpu "RPU value of NOX_COR_S" UWORD _CNV_A_R_LINEAR_____492_CM 1 100. 0. 1023.984375 DISPLAY_IDENTIFIER NOX_COR_S_RPU ECU_ADDRESS 0xd0004c34 FORMAT "%7.2" /end MEASUREMENT
/begin MEASUREMENT lamb_rgn_rpu_2 "RPU value of LAMB_RGN_RPU_2" UWORD _CNV_A_R_LINEAR_____122_CM 1 100. 0. 31.9990234375 DISPLAY_IDENTIFIER LAMB_RGN_RPU_2 ECU_ADDRESS 0xd0004c32 FORMAT "%7.4" /end MEASUREMENT
/begin MEASUREMENT tnt_mdl_1_1_rpu "RPU value of TNT_MDL_1_1" UWORD _CNV_A_R_LINEAR_____197_CM 1 100. 0. 1023.984375 DISPLAY_IDENTIFIER TNT_MDL_1_1_RPU ECU_ADDRESS 0xd0004c36 FORMAT "%7.2" /end MEASUREMENT
/begin MEASUREMENT tnt_mdl_1_2_rpu "RPU value of TNT_MDL_1_2" UWORD _CNV_A_R_LINEAR_____197_CM 1 100. 0. 1023.984375 DISPLAY_IDENTIFIER TNT_MDL_1_2_RPU ECU_ADDRESS 0xd0004c38 FORMAT "%7.2" /end MEASUREMENT
/begin MEASUREMENT tnt_mdl_2_1_rpu "RPU value of TNT_MDL_2_1" UWORD _CNV_A_R_LINEAR_____197_CM 1 100. 0. 1023.984375 DISPLAY_IDENTIFIER TNT_MDL_2_1_RPU ECU_ADDRESS 0xd0004c3a FORMAT "%7.2" /end MEASUREMENT
/begin MEASUREMENT tnt_mdl_2_2_rpu "RPU value of TNT_MDL_2_2" UWORD _CNV_A_R_LINEAR_____197_CM 1 100. 0. 1023.984375 DISPLAY_IDENTIFIER TNT_MDL_2_2_RPU ECU_ADDRESS 0xd0004c3c FORMAT "%7.2" /end MEASUREMENT
/begin MEASUREMENT teg_dyn_stop "Modelled exhaust gas temperature at last engine stop" UWORD _CNV_A_R_LINEAR_____123_CM 1 100. 0. 2047. DISPLAY_IDENTIFIER TEG_DYN_STOP ECU_ADDRESS 0xd0004c88 FORMAT "%7.2" /end MEASUREMENT
/begin MEASUREMENT temp_cat "modelled catalyst monolith temperature (average value)" UWORD _CNV_A_R_LINEAR_____790_CM 1 100. -33. 990.984375 DISPLAY_IDENTIFIER TEMP_CAT ECU_ADDRESS 0xd0004c54 FORMAT "%6.2" /end MEASUREMENT
/begin MEASUREMENT teg_cat_down_mdl "Gemittelte Agbastemperatur nach Kat" UWORD _CNV_A_R_LINEAR_____123_CM 1 100. 0. 2047. DISPLAY_IDENTIFIER TEG_CAT_DOWN_MDL ECU_ADDRESS 0xd0004c4e FORMAT "%7.2" /end MEASUREMENT
/begin MEASUREMENT teg_cat_down_mdl_2 "Agbastemperatur nach Kat Bank 2" UWORD _CNV_A_R_LINEAR_____123_CM 1 100. 0. 2047. DISPLAY_IDENTIFIER TEG_CAT_DOWN_MDL_2 ECU_ADDRESS 0xd0004c78 FORMAT "%7.2" /end MEASUREMENT
/begin MEASUREMENT teg_dyn "Gemittelte Agbastemperatur vor Kat" UWORD _CNV_A_R_LINEAR_____123_CM 1 100. 0. 2047. DISPLAY_IDENTIFIER TEG_DYN ECU_ADDRESS 0xd0004c56 FORMAT "%7.2" /end MEASUREMENT
/begin MEASUREMENT teg_cat_down_mdl_1_bas "Abgastemperatur nach Rohr 9, nach Kat, Bank 2" SWORD _CNV_A_R_LINEAR_____791_CM 1 100. -3276.8 3276.7 DISPLAY_IDENTIFIER TEG_CAT_DOWN_MDL_1_BAS ECU_ADDRESS 0xd0004c48 FORMAT "%7.2" /end MEASUREMENT
/begin MEASUREMENT teg_cat_down_mdl_2_bas "Abgastemperatur nach Rohr 9, nach Kat, Bank 1" SWORD _CNV_A_R_LINEAR_____791_CM 1 100. -3276.8 3276.7 DISPLAY_IDENTIFIER TEG_CAT_DOWN_MDL_2_BAS ECU_ADDRESS 0xd0004c74 FORMAT "%7.2" /end MEASUREMENT
/begin MEASUREMENT teg_wall_cat_up_mdl_2 "Model of exhaust wall temperature post catalyst upstream" UWORD _CNV_A_R_LINEAR_____216_CM 1 100. -48. 1459.3 DISPLAY_IDENTIFIER TEG_WALL_CAT_UP_MDL_2 ECU_ADDRESS 0xd0004c70 FORMAT "%7.2" /end MEASUREMENT
/begin MEASUREMENT teg_wall_cat_up_mdl_1 "Model of exhaust wall temperature pre catalyst upstream" UWORD _CNV_A_R_LINEAR_____216_CM 1 100. -48. 1459.3 DISPLAY_IDENTIFIER TEG_WALL_CAT_UP_MDL_1 ECU_ADDRESS 0xd0004c44 FORMAT "%7.2" /end MEASUREMENT
/begin MEASUREMENT teg_wall_cat_down_mdl_1 "Model of exhaust wall temperature pre catalyst upstream" UWORD _CNV_A_R_LINEAR_____216_CM 1 100. -48. 1459.3 DISPLAY_IDENTIFIER TEG_WALL_CAT_DOWN_MDL_1 ECU_ADDRESS 0xd0004c46 FORMAT "%7.2" /end MEASUREMENT
/begin MEASUREMENT teg_wall_cat_down_mdl_2 "Model of exhaust wall temperature pre catalyst upstream" UWORD _CNV_A_R_LINEAR_____216_CM 1 100. -48. 1459.3 DISPLAY_IDENTIFIER TEG_WALL_CAT_DOWN_MDL_2 ECU_ADDRESS 0xd0004c72 FORMAT "%7.2" /end MEASUREMENT
/begin MEASUREMENT teg_cat_down_mdl_1 "Agbastemperatur nach Kat Bank 1" UWORD _CNV_A_R_LINEAR_____123_CM 1 100. 0. 2047. DISPLAY_IDENTIFIER TEG_CAT_DOWN_MDL_1 ECU_ADDRESS 0xd0004c4c FORMAT "%7.2" /end MEASUREMENT
/begin MEASUREMENT teg_cat_up_mdl_2 "Agbastemperatur nach Kat Bank 1" UWORD _CNV_A_R_LINEAR_____123_CM 1 100. 0. 2047. DISPLAY_IDENTIFIER TEG_CAT_UP_MDL_2 ECU_ADDRESS 0xd0004c76 FORMAT "%7.2" /end MEASUREMENT
/begin MEASUREMENT teg_cat_up_mdl_1 "Agbastemperatur nach Kat Bank 1" UWORD _CNV_A_R_LINEAR_____123_CM 1 100. 0. 2047. DISPLAY_IDENTIFIER TEG_CAT_UP_MDL_1 ECU_ADDRESS 0xd0004c4a FORMAT "%7.2" /end MEASUREMENT
/begin MEASUREMENT teg_stat_max_1 "Agbastemperatur nach Kat Bank 1" UWORD _CNV_A_R_LINEAR_____123_CM 1 100. 0. 2047. DISPLAY_IDENTIFIER TEG_STAT_MAX_1 ECU_ADDRESS 0xd0004c50 FORMAT "%7.2" /end MEASUREMENT
/begin MEASUREMENT teg_stat_max_2 "Agbastemperatur nach Kat Bank 1" UWORD _CNV_A_R_LINEAR_____123_CM 1 100. 0. 2047. DISPLAY_IDENTIFIER TEG_STAT_MAX_2 ECU_ADDRESS 0xd0004c7a FORMAT "%7.2" /end MEASUREMENT
/begin MEASUREMENT teg_stat_max "Agbastemperatur nach Kat Bank 1" UWORD _CNV_A_R_LINEAR_____123_CM 1 100. 0. 2047. DISPLAY_IDENTIFIER TEG_STAT_MAX ECU_ADDRESS 0xd0004c52 FORMAT "%7.2" /end MEASUREMENT
/begin MEASUREMENT lv_lamb_ohp_1 "Flag indicating enrichment for overheating prevention (bank 1)" UBYTE _CNV_S_2_RANGE__0___1_CM 1 100. 0. 1. DISPLAY_IDENTIFIER LV_LAMB_OHP_1 ECU_ADDRESS 0xd000381a BIT_MASK 0x1 /end MEASUREMENT
/begin MEASUREMENT lv_lamb_ohp_2 "Flag indicating enrichment for overheating prevention (bank 2)" UBYTE _CNV_S_2_RANGE__0___1_CM 1 100. 0. 1. DISPLAY_IDENTIFIER LV_LAMB_OHP_2 ECU_ADDRESS 0xd000381b BIT_MASK 0x1 /end MEASUREMENT
/begin MEASUREMENT tam_st "Ambient air temperature at start" UBYTE _CNV_A_R_LINEAR_____16_CM 1 100. -48. 142.5 DISPLAY_IDENTIFIER TAM_ST ECU_ADDRESS 0xd0003b90 FORMAT "%5.1" /end MEASUREMENT
/begin MEASUREMENT tam_stop "Ambient air temperature at engine stop" UBYTE _CNV_A_R_LINEAR_____16_CM 1 100. -48. 142.5 DISPLAY_IDENTIFIER TAM_STOP ECU_ADDRESS 0xd0003b91 FORMAT "%5.1" /end MEASUREMENT
/begin MEASUREMENT state_rbm_ftl_obd "Interface of FTL_OBD monitor with the Rate-Based Monitoring statistics" UBYTE _CNV_A_R_LINEAR_____0_CM 1 100. 0. 7. DISPLAY_IDENTIFIER STATE_RBM_FTL_OBD ECU_ADDRESS 0xd0003e64 FORMAT "%1.0" /end MEASUREMENT
/begin MEASUREMENT lv_err_map "MAP sensor error" UBYTE _CNV_S_2_RANGE__0___1_CM 1 100. 0. 1. DISPLAY_IDENTIFIER LV_ERR_MAP ECU_ADDRESS 0xd00038ac BIT_MASK 0x1 /end MEASUREMENT
/begin MEASUREMENT rfppwm "PWM output recirculation flap" UWORD _CNV_A_R_LINEAR_____7_CM 1 100. 0. 99.99847412109381 DISPLAY_IDENTIFIER RFPPWM ECU_ADDRESS 0xd0004bf4 /end MEASUREMENT
/begin MEASUREMENT wgpwm[0] "PWM output wastegate 0" UWORD _CNV_A_R_LINEAR_____7_CM 1 100. 0. 99.99847412109381 DISPLAY_IDENTIFIER WGPWM_0 ECU_ADDRESS 0xd0004bf0 /end MEASUREMENT
/begin MEASUREMENT wgpwm[1] "PWM output wastegate 1" UWORD _CNV_A_R_LINEAR_____7_CM 1 100. 0. 99.99847412109381 DISPLAY_IDENTIFIER WGPWM_1 ECU_ADDRESS 0xd0004bf2 /end MEASUREMENT
/begin MEASUREMENT lv_inh_puc_cus "Flag indicating \"Bedingung Schubabschaltung verboten\"" UBYTE _CNV_S_2_RANGE__0___1_CM 1 100. 0. 1. DISPLAY_IDENTIFIER LV_INH_PUC_CUS ECU_ADDRESS 0xd00037ec BIT_MASK 0x1 /end MEASUREMENT
/begin AXIS_PTS ldpm_temp_cat_dif_ch_l_1_extc "" 0xa10066d4 temp_cat_dif_ch_l _REC_AXS_20_u2 2047.96875 _CNV_A_R_EXTC_LINEA_792_CM 8 -1056. 991.96875 FORMAT "%11.5" /end AXIS_PTS
/begin AXIS_PTS ldpm_tnt_dif_ch_l_1_extc "" 0xa10066e8 tnt_dif_ch_l _REC_AXS_20_u2 2047.96875 _CNV_A_R_LINEAR_____793_CM 8 -1024. 1023.96875 FORMAT "%11.5" /end AXIS_PTS
/begin AXIS_PTS ldp_n_32_ip_soi_1_mplh_ch_so2p "" 0xa1006358 n_32 _REC_AXS_20_u1 8160. _CNV_A_R_LINEAR_____9_CM 8 0. 8160. FORMAT "%4.0" /end AXIS_PTS
/begin CHARACTERISTIC ip_tq_add_so2p_pctl "Precontrolled torque reserve for desulfation catalyst heating" MAP 0xa1008040 _REC_MAP_20_u2_u1_u2 2047.96875 _CNV_A_R_LINEAR_____65_CM -1024. 1023.96875 DISPLAY_IDENTIFIER IP_TQ_ADD_SO2P_PCTL FORMAT "%11.5"
 /begin AXIS_DESCR COM_AXIS n_32 _CNV_A_R_LINEAR_____9_CM 6 0. 8160. FORMAT "%4.0" AXIS_PTS_REF ldp_n_32_ip_tq_so2p_pctl /end AXIS_DESCR
 /begin AXIS_DESCR COM_AXIS tqi_req_tra _CNV_A_R_LINEAR_____30_CM 6 0. 1023.96875 FORMAT "%7.2" AXIS_PTS_REF ldp_tqi_req_tra_ip_tq_so2p_pctl /end AXIS_DESCR
/end CHARACTERISTIC
/begin AXIS_PTS ldp_n_32_ip_tq_so2p_pctl "" 0xa10063aa n_32 _REC_AXS_20_u1 8160. _CNV_A_R_LINEAR_____9_CM 6 0. 8160. FORMAT "%4.0" /end AXIS_PTS
/begin AXIS_PTS ldp_tqi_req_tra_ip_tq_so2p_pctl "" 0xa1006584 tqi_req_tra _REC_AXS_20_u2 1023.96875 _CNV_A_R_LINEAR_____30_CM 6 0. 1023.96875 FORMAT "%7.2" /end AXIS_PTS
/begin MEASUREMENT tq_add_so2p "Torque reserve for desulfation catalyst heating" SWORD _CNV_A_R_LINEAR_____30_CM 1 100. -1024. 1023.96875 DISPLAY_IDENTIFIER TQ_ADD_SO2P ECU_ADDRESS 0xd0002742 FORMAT "%8.2" /end MEASUREMENT
/begin MEASUREMENT tq_add_so2p_i "I share of torque reserve for desulfation catalyst heating" SWORD _CNV_A_R_LINEAR_____800_CM 1 100. -128. 127.9960938 DISPLAY_IDENTIFIER TQ_ADD_SO2P_I ECU_ADDRESS 0xd0002744 FORMAT "%11.5" /end MEASUREMENT
/begin MEASUREMENT tq_add_so2p_p "P share of torque reserve for desulfation catalyst heating" SWORD _CNV_A_R_LINEAR_____800_CM 1 100. -128. 127.9960938 DISPLAY_IDENTIFIER TQ_ADD_SO2P_P ECU_ADDRESS 0xd0002746 FORMAT "%11.5" /end MEASUREMENT
/begin MEASUREMENT tq_add_so2p_pctl "Precontrolled torque reserve for desulfation catalyst heating" UWORD _CNV_A_R_LINEAR_____65_CM 1 100. -1024. 1023.96875 DISPLAY_IDENTIFIER TQ_ADD_SO2P_PCTL ECU_ADDRESS 0xd0002748 FORMAT "%11.5" /end MEASUREMENT
/begin CHARACTERISTIC c_fac_tq_add_so2p_pctl_mplh "factor to weigh the precontrolled torque reserve in case of homogen split   mode" VALUE 0xa1008092 _REC_VAL_20_u2 31.9990234375 _CNV_A_R_LINEAR_____122_CM 0. 31.9990234375 DISPLAY_IDENTIFIER C_FAC_TQ_ADD_SO2P_PCTL_MPLH FORMAT "%7.4" /end CHARACTERISTIC
/begin CHARACTERISTIC c_tq_add_so2p_i "Correlation constant for the I share of the controller" VALUE 0xa10080e8 _REC_VAL_20_u2 0.9999847412109381 _CNV_A_R_LINEAR_____801_CM 0. 0.9999847412109381 DISPLAY_IDENTIFIER C_TQ_ADD_SO2P_I FORMAT "%11.5" /end CHARACTERISTIC
/begin CHARACTERISTIC c_tq_add_so2p_i_max "Maximium of the I share of the controller" VALUE 0xa10080ea _REC_VAL_20_s2 127.997 _CNV_A_R_LINEAR_____802_CM 0. 127.997 DISPLAY_IDENTIFIER C_TQ_ADD_SO2P_I_MAX FORMAT "%11.5" /end CHARACTERISTIC
/begin CHARACTERISTIC c_tq_add_so2p_p "Correlation constant for the P share of the controller" VALUE 0xa10080ec _REC_VAL_20_u2 1.99996948242188 _CNV_A_R_LINEAR_____803_CM 0. 1.99996948242188 DISPLAY_IDENTIFIER C_TQ_ADD_SO2P_P FORMAT "%11.5" /end CHARACTERISTIC
/begin CHARACTERISTIC c_tq_add_so2p_p_max "Maximium of the P share of the controller" VALUE 0xa10080ee _REC_VAL_20_s2 127.997 _CNV_A_R_LINEAR_____802_CM 0. 127.997 DISPLAY_IDENTIFIER C_TQ_ADD_SO2P_P_MAX FORMAT "%11.5" /end CHARACTERISTIC
/begin CHARACTERISTIC c_tq_add_so2p_ramp_dec "Ramp gradient for gradual decrease of the torque reserve" VALUE 0xa10080f0 _REC_VAL_20_u2 255.99609375 _CNV_A_R_LINEAR_____804_CM 0. 255.99609375 DISPLAY_IDENTIFIER C_TQ_ADD_SO2P_RAMP_DEC FORMAT "%11.5" /end CHARACTERISTIC
/begin CHARACTERISTIC c_tq_add_so2p_ramp_inc "Ramp gradient for gradual increase of the torque reserve" VALUE 0xa10080f2 _REC_VAL_20_u2 255.99609375 _CNV_A_R_LINEAR_____804_CM 0. 255.99609375 DISPLAY_IDENTIFIER C_TQ_ADD_SO2P_RAMP_INC FORMAT "%11.5" /end CHARACTERISTIC
/begin MEASUREMENT lv_err_map_dip_sens "Error flag for Differential Manifold Pressure Sensor" UBYTE _CNV_S_2_RANGE__0___1_CM 1 100. 0. 1. DISPLAY_IDENTIFIER LV_ERR_MAP_DIP_SENS ECU_ADDRESS 0xd0003476 BIT_MASK 0x1 /end MEASUREMENT
/begin MEASUREMENT lv_err_map_dip_shift "MAP_DIP sensor error present" UBYTE _CNV_S_2_RANGE__0___1_CM 1 100. 0. 1. DISPLAY_IDENTIFIER LV_ERR_MAP_DIP_SHIFT ECU_ADDRESS 0xd000348d BIT_MASK 0x1 /end MEASUREMENT
/begin CHARACTERISTIC c_v_map_bas_max_diag "Maximum diagnostic value for the manifold differential pressure value" VALUE 0xa1029b6e _REC_VAL_20_u2 4.9951171875 _CNV_A_R_LINEAR_____2_CM 0. 4.9951171875 DISPLAY_IDENTIFIER C_V_MAP_BAS_MAX_DIAG FORMAT "%5.3" /end CHARACTERISTIC
/begin CHARACTERISTIC c_v_map_bas_min_diag "Minimum diagnostic value for the manifold differential pressure value" VALUE 0xa1029b70 _REC_VAL_20_u2 4.9951171875 _CNV_A_R_LINEAR_____2_CM 0. 4.9951171875 DISPLAY_IDENTIFIER C_V_MAP_BAS_MIN_DIAG FORMAT "%5.3" /end CHARACTERISTIC
/begin MEASUREMENT state_ivvt "State IVVT" UBYTE _CNV_S_7_STATE_IVVT_810_CM 1 100. 0. 6. DISPLAY_IDENTIFIER STATE_IVVT ECU_ADDRESS 0xd00038e4 /end MEASUREMENT
/begin MEASUREMENT t_veh_pow_var_act "time since function check of power variant activation" UBYTE _CNV_A_R_LINEAR_____4_CM 1 100. 0. 25.5 DISPLAY_IDENTIFIER T_VEH_POW_VAR_ACT ECU_ADDRESS 0xc00000a4 FORMAT "%4.1" /end MEASUREMENT
/begin CHARACTERISTIC c_t_min_pow_clas_veh_can_req "delay time before check of power variant coding" VALUE 0xa10298fc _REC_VAL_20_u1 25.5 _CNV_A_R_LINEAR_____4_CM 0. 25.5 DISPLAY_IDENTIFIER C_T_MIN_POW_CLAS_VEH_CAN_REQ FORMAT "%4.1" /end CHARACTERISTIC
/begin CHARACTERISTIC c_t_max_pow_clas_veh_can_rcv "timeout for receiving LV_POW_CLAS_VEH_CAN_RCV" VALUE 0xa10298c8 _REC_VAL_20_u1 25.5 _CNV_A_R_LINEAR_____4_CM 0. 25.5 DISPLAY_IDENTIFIER C_T_MAX_POW_CLAS_VEH_CAN_RCV FORMAT "%4.1" /end CHARACTERISTIC
/begin CHARACTERISTIC c_state_pow_clas_veh "calibrated status vehicle power class" VALUE 0xa10297b7 _REC_VAL_20_u1 3. _CNV_A_R_LINEAR_____0_CM 0. 3. DISPLAY_IDENTIFIER C_STATE_POW_CLAS_VEH FORMAT "%2.0" /end CHARACTERISTIC
/begin CHARACTERISTIC lc_veh_pow_var_err_dis "Logical constant to disable check of power variant coding" VALUE 0xa1029e15 _REC_VAL_20_u1 1. _CNV_A_R_LINEAR_____0_CM 0. 1. DISPLAY_IDENTIFIER LC_VEH_POW_VAR_ERR_DIS FORMAT "%2.0" /end CHARACTERISTIC
/begin CHARACTERISTIC c_abc_max_pow_clas_veh_err "number of timeouts for antibounce of LV_ERR_VEH_POW_VAR" VALUE 0xa1029131 _REC_VAL_20_u1 254. _CNV_A_R_LINEAR_____0_CM 1. 255. DISPLAY_IDENTIFIER C_ABC_MAX_POW_CLAS_VEH_ERR FORMAT "%3.0" /end CHARACTERISTIC
/begin CHARACTERISTIC c_idx_cod_conv "BMW coding index to disable check of successful BMW coding of variants via KWP" VALUE 0xa1000600 _REC_VAL_20_u1 255. _CNV_A_R_LINEAR_____0_CM 0. 255. DISPLAY_IDENTIFIER C_IDX_COD_CONV FORMAT "%3.0" /end CHARACTERISTIC
/begin MEASUREMENT lv_err_var_cod "Configuration variant coding error" UBYTE _CNV_S_2_RANGE__0___1_CM 1 100. 0. 1. DISPLAY_IDENTIFIER LV_ERR_VAR_COD ECU_ADDRESS 0xd00034cf BIT_MASK 0x1 /end MEASUREMENT
/begin MEASUREMENT lv_err_veh_pow_var "Present error of wrong or unknown power variant" UBYTE _CNV_S_2_RANGE__0___1_CM 1 100. 0. 1. DISPLAY_IDENTIFIER LV_ERR_VEH_POW_VAR ECU_ADDRESS 0xd00034d0 BIT_MASK 0x1 /end MEASUREMENT
/begin MEASUREMENT lv_pow_clas_veh_can_req "LV to request CAN signal vehicle type" UBYTE _CNV_S_2_RANGE__0___1_CM 1 100. 0. 1. DISPLAY_IDENTIFIER LV_POW_CLAS_VEH_CAN_REQ ECU_ADDRESS 0xd0003c0f BIT_MASK 0x1 /end MEASUREMENT
/begin MEASUREMENT lv_cat_conf_dis_ext_req "disable of learning cat variants and setting variant to NO CAT via tester" UBYTE _CNV_S_2_RANGE__0___1_CM 1 100. 0. 1. DISPLAY_IDENTIFIER LV_CAT_CONF_DIS_EXT_REQ ECU_ADDRESS 0xd0003c1a BIT_MASK 0x1 /end MEASUREMENT
/begin MEASUREMENT state_mil_on_dis_ext_req "request for variant MIL_OFF via tester" UBYTE _CNV_A_R_LINEAR_____0_CM 1 100. 0. 2. DISPLAY_IDENTIFIER STATE_MIL_ON_DIS_EXT_REQ ECU_ADDRESS 0xd0003c19 FORMAT "%2.0" /end MEASUREMENT
/begin MEASUREMENT pow_conf_idx_ext_req "Selected power configuration code via tester" UBYTE _CNV_A_R_LINEAR_____0_CM 1 100. 0. 3. DISPLAY_IDENTIFIER POW_CONF_IDX_EXT_REQ ECU_ADDRESS 0xd0003c1c FORMAT "%2.0" /end MEASUREMENT
/begin MEASUREMENT t_pow_clas_veh_can_req "time since request of CAN signal vehicle type" UBYTE _CNV_A_R_LINEAR_____4_CM 1 100. 0. 25.5 DISPLAY_IDENTIFIER T_POW_CLAS_VEH_CAN_REQ ECU_ADDRESS 0xc00000a5 FORMAT "%4.1" /end MEASUREMENT
/begin MEASUREMENT idx_var_cod[0] "changing index of vehicle configuration code via tester" UBYTE _CNV_A_R_LINEAR_____0_CM 1 100. 0. 255. DISPLAY_IDENTIFIER IDX_VAR_COD[0] ECU_ADDRESS 0xd0003c10 FORMAT "%3.0" /end MEASUREMENT
/begin MEASUREMENT idx_var_cod[1] "changing index of vehicle configuration code via tester" UBYTE _CNV_A_R_LINEAR_____0_CM 1 100. 0. 255. DISPLAY_IDENTIFIER IDX_VAR_COD[1] ECU_ADDRESS 0xd0003c11 FORMAT "%3.0" /end MEASUREMENT
/begin MEASUREMENT vin_sho[0] "short vehicle identification number" UBYTE _CNV_A_R_LINEAR_____0_CM 1 100. 0. 255. DISPLAY_IDENTIFIER VIN_SHO[0] ECU_ADDRESS 0xd0003c12 FORMAT "%3.0" /end MEASUREMENT
/begin MEASUREMENT vin_sho[1] "short vehicle identification number" UBYTE _CNV_A_R_LINEAR_____0_CM 1 100. 0. 255. DISPLAY_IDENTIFIER VIN_SHO[1] ECU_ADDRESS 0xd0003c13 FORMAT "%3.0" /end MEASUREMENT
/begin MEASUREMENT vin_sho[2] "short vehicle identification number" UBYTE _CNV_A_R_LINEAR_____0_CM 1 100. 0. 255. DISPLAY_IDENTIFIER VIN_SHO[2] ECU_ADDRESS 0xd0003c14 FORMAT "%3.0" /end MEASUREMENT
/begin MEASUREMENT vin_sho[3] "short vehicle identification number" UBYTE _CNV_A_R_LINEAR_____0_CM 1 100. 0. 255. DISPLAY_IDENTIFIER VIN_SHO[3] ECU_ADDRESS 0xd0003c15 FORMAT "%3.0" /end MEASUREMENT
/begin MEASUREMENT vin_sho[4] "short vehicle identification number" UBYTE _CNV_A_R_LINEAR_____0_CM 1 100. 0. 255. DISPLAY_IDENTIFIER VIN_SHO[4] ECU_ADDRESS 0xd0003c16 FORMAT "%3.0" /end MEASUREMENT
/begin MEASUREMENT vin_sho[5] "short vehicle identification number" UBYTE _CNV_A_R_LINEAR_____0_CM 1 100. 0. 255. DISPLAY_IDENTIFIER VIN_SHO[5] ECU_ADDRESS 0xd0003c17 FORMAT "%3.0" /end MEASUREMENT
/begin MEASUREMENT vin_sho[6] "short vehicle identification number" UBYTE _CNV_A_R_LINEAR_____0_CM 1 100. 0. 255. DISPLAY_IDENTIFIER VIN_SHO[6] ECU_ADDRESS 0xd0003c18 FORMAT "%3.0" /end MEASUREMENT
/begin AXIS_PTS ldp_vs_ip_clrc_amp_plaus "" 0xa10218ae vs _REC_AXS_20_u1 255. _CNV_A_R_LINEAR_____6_CM 4 0. 255. FORMAT "%3.0" /end AXIS_PTS
/begin MEASUREMENT lv_inh_diag_amp_plaus "Inhibition of AMP_PLAUS diagnosis" UBYTE _CNV_S_2_RANGE__0___1_CM 1 100. 0. 1. DISPLAY_IDENTIFIER LV_INH_DIAG_AMP_PLAUS ECU_ADDRESS 0xd0003e84 BIT_MASK 0x1 /end MEASUREMENT
/begin MEASUREMENT state_rbm_amp_plaus "Interface of AMP_PLAUS monitor with the Rate-Based Monitoring statistics" UBYTE _CNV_A_R_LINEAR_____0_CM 1 100. 0. 7. DISPLAY_IDENTIFIER STATE_RBM_AMP_PLAUS ECU_ADDRESS 0xd0003e85 FORMAT "%2.0" /end MEASUREMENT
/begin AXIS_PTS ldp_id_maf_tab_1 "" 0xa1020b18 online_dummy _REC_AXS_20_u1 255. _CNV_A_R_LINEAR_____0_CM 16 0. 255. FORMAT "%3.0" /end AXIS_PTS
/begin AXIS_PTS ldp_id_maf_tab_2 "" 0xa1020b2c online_dummy _REC_AXS_20_u1 255. _CNV_A_R_LINEAR_____0_CM 16 0. 255. FORMAT "%3.0" /end AXIS_PTS
/begin AXIS_PTS ldp_tco_st_ip_fac_fup_sp_ch "Factor for fuel pressure setpoint during (MPLH)   catalyst heating" 0xa100647a tco_st _REC_AXS_20_u1 190.5 _CNV_A_R_LINEAR_____16_CM 4 -48. 142.5 FORMAT "%5.1" /end AXIS_PTS
/begin AXIS_PTS ldp_t_ast_ip_fac_fup_sp_ch "Factor for fuel pressure setpoint during (MPLH)   catalyst heating" 0xa10063d8 t_ast _REC_AXS_20_u2 6553.5 _CNV_A_R_LINEAR_____4_CM 6 0. 6553.5 FORMAT "%6.1" /end AXIS_PTS
/begin AXIS_PTS ldp_n_32_ip_fup_sp_ch "Fuel pressure setpoint for catalyst heating   used for MPLH mode" 0xa1006308 n_32 _REC_AXS_20_u1 8160. _CNV_A_R_LINEAR_____9_CM 6 0. 8160. FORMAT "%4.0" /end AXIS_PTS
/begin AXIS_PTS ldp_tqi_req_tra_ip_fup_sp_ch "Fuel pressure setpoint for catalyst heating   used for MPLH mode" 0xa1006574 tqi_req_tra _REC_AXS_20_u2 1023.96875 _CNV_A_R_LINEAR_____30_CM 6 0. 1023.96875 FORMAT "%7.2" /end AXIS_PTS
/begin CHARACTERISTIC ip_fac_fup_sp_ch "Factor for fuel pressure setpoint during (MPLH)   catalyst heating" MAP 0xa1006e08 _REC_MAP_20_u1_u1_u2 0.99609375 _CNV_A_R_LINEAR_____71_CM 0. 0.99609375 DISPLAY_IDENTIFIER IP_FAC_FUP_SP_CH FORMAT "%5.3"
 /begin AXIS_DESCR COM_AXIS tco_st _CNV_A_R_LINEAR_____16_CM 4 -48. 142.5 FORMAT "%5.1" AXIS_PTS_REF ldp_tco_st_ip_fac_fup_sp_ch /end AXIS_DESCR
 /begin AXIS_DESCR COM_AXIS t_ast _CNV_A_R_LINEAR_____4_CM 6 0. 6553.5 FORMAT "%6.1" AXIS_PTS_REF ldp_t_ast_ip_fac_fup_sp_ch /end AXIS_DESCR
/end CHARACTERISTIC
/begin CHARACTERISTIC ip_fup_sp_ch "Fuel pressure setpoint for catalyst heating   used for MPLH mode" MAP 0xa1007038 _REC_MAP_20_u2_u1_u2 347776. _CNV_A_R_LINEAR_____152_CM 0. 347776. DISPLAY_IDENTIFIER IP_FUP_SP_CH FORMAT "%6.0"
 /begin AXIS_DESCR COM_AXIS n_32 _CNV_A_R_LINEAR_____9_CM 6 0. 8160. FORMAT "%4.0" AXIS_PTS_REF ldp_n_32_ip_fup_sp_ch /end AXIS_DESCR
 /begin AXIS_DESCR COM_AXIS tqi_req_tra _CNV_A_R_LINEAR_____30_CM 6 0. 1023.96875 FORMAT "%7.2" AXIS_PTS_REF ldp_tqi_req_tra_ip_fup_sp_ch /end AXIS_DESCR
/end CHARACTERISTIC
/begin MEASUREMENT lv_err_rly_crcv_heat "Boolean for error currently present on RLY_CRCV_HEAT" UBYTE _CNV_S_2_RANGE__0___1_CM 1 100. 0. 1. DISPLAY_IDENTIFIER LV_ERR_RLY_CRCV_HEAT ECU_ADDRESS 0xd000343c BIT_MASK 0x1 /end MEASUREMENT
/begin MEASUREMENT cdn_diag_rly_crcv_heat "Activation conditions for rly_crcv_heat" UBYTE _CNV_A_R_LINEAR_____0_CM 1 100. 0. 255. DISPLAY_IDENTIFIER CDN_DIAG_RLY_CRCV_HEAT ECU_ADDRESS 0xc0000250 FORMAT "%3.0" /end MEASUREMENT
/begin MEASUREMENT lv_inh_diag_rly_crcv_heat "Inhibit diagnosis rly_crcv_heat" UBYTE _CNV_S_2_RANGE__0___1_CM 1 100. 0. 1. DISPLAY_IDENTIFIER LV_INH_DIAG_RLY_CRCV_HEAT ECU_ADDRESS 0xd0003de8 BIT_MASK 0x1 /end MEASUREMENT
/begin CHARACTERISTIC c_fac_k_fil_acr_ctl "Pre-Filter amplification of the ACR position controlller" VALUE 0xa1001100 _REC_VAL_20_u2 0.9999847412109381 _CNV_A_R_LINEAR_____68_CM 0. 0.9999847412109381 DISPLAY_IDENTIFIER C_FAC_K_FIL_ACR_CTL FORMAT "%10.9" /end CHARACTERISTIC
/begin CHARACTERISTIC c_fac_opg_sp_acr "Weighting factor for setpoint rate limitation of the ACR position controller" VALUE 0xa1001102 _REC_VAL_20_u1 1. _CNV_A_R_LINEAR_____797_CM 0. 1. DISPLAY_IDENTIFIER C_FAC_OPG_SP_ACR FORMAT "%7.5" /end CHARACTERISTIC
/begin MEASUREMENT loc_state_adaption "" UBYTE _CNV_A_R_LINEAR_____0_CM 1 100. 0. 255. DISPLAY_IDENTIFIER LOC_STATE_ADAPTION ECU_ADDRESS 0xc000021c FORMAT "%1.0" /end MEASUREMENT
/begin CHARACTERISTIC c_ccp_pt_act "Security pattern to activate the CCP on powertrain CAN" VALUE 0xa1029e58 _REC_VAL_20_u2 65535. _CNV_A_R_LINEAR_____0_CM 0. 65535. DISPLAY_IDENTIFIER C_CCP_PT_ACT FORMAT "%5.0" /end CHARACTERISTIC
/begin COMPU_METHOD _CNV_A_R_LINEAR_____0_CM "" RAT_FUNC "%6.3" "-" COEFFS 0 1. 0. 0 0 1 /end COMPU_METHOD
/begin COMPU_METHOD _CNV_S_2_RANGE__0___1_CM "" TAB_VERB "%6.3" "-" COMPU_TAB_REF _CNV_S_2_RANGE__0___1 /end COMPU_METHOD
/begin COMPU_VTAB _CNV_S_2_RANGE__0___1 "" TAB_VERB 2 0 "0" 1 "1" /end COMPU_VTAB
/begin COMPU_METHOD _CNV_A_R_LINEAR_____2_CM "" RAT_FUNC "%6.3" "V" COEFFS 0 204.8 0. 0 0 1 /end COMPU_METHOD
/begin COMPU_METHOD _CNV_A_R_LINEAR_____3_CM "" RAT_FUNC "%6.3" "s" COEFFS 0 100. 0. 0 0 1 /end COMPU_METHOD
/begin COMPU_METHOD _CNV_A_R_LINEAR_____4_CM "" RAT_FUNC "%6.3" "s" COEFFS 0 10. 0. 0 0 1 /end COMPU_METHOD
/begin COMPU_METHOD _CNV_A_R_LINEAR_____5_CM "" RAT_FUNC "%6.3" "%" COEFFS 0 2.56 0. 0 0 1 /end COMPU_METHOD
/begin COMPU_METHOD _CNV_A_R_LINEAR_____6_CM "" RAT_FUNC "%6.3" "km/h" COEFFS 0 1. 0. 0 0 1 /end COMPU_METHOD
/begin COMPU_METHOD _CNV_A_R_LINEAR_____7_CM "" RAT_FUNC "%6.3" "%" COEFFS 0 655.3599999999997 0. 0 0 1 /end COMPU_METHOD
/begin COMPU_METHOD _CNV_A_R_LINEAR_____8_CM "" RAT_FUNC "%6.3" "-" COEFFS 0 32767.99999999992 0. 0 0 1 /end COMPU_METHOD
/begin COMPU_METHOD _CNV_A_R_LINEAR_____9_CM "" RAT_FUNC "%6.3" "rpm" COEFFS 0 3.125e-002 0. 0 0 1 /end COMPU_METHOD
/begin COMPU_METHOD _CNV_A_R_LINEAR_____13_CM "" RAT_FUNC "%6.3" "rpm" COEFFS 0 1. 0. 0 0 1 /end COMPU_METHOD
/begin COMPU_METHOD _CNV_A_R_LINEAR_____14_CM "" RAT_FUNC "%6.3" "mg/stk" COEFFS 0 0.183585313174946 0. 0 0 1 /end COMPU_METHOD
/begin COMPU_METHOD _CNV_A_R_LINEAR_____16_CM "" RAT_FUNC "%6.3" "°C" COEFFS 0 1.333333333333333 64. 0 0 1 /end COMPU_METHOD
/begin COMPU_METHOD _CNV_A_R_LINEAR_____21_CM "" RAT_FUNC "%6.3" "V" COEFFS 0 9.846168103048838 0. 0 0 1 /end COMPU_METHOD
/begin COMPU_METHOD _CNV_A_R_LINEAR_____23_CM "" RAT_FUNC "%6.3" "-" COEFFS 0 16384. 0. 0 0 1 /end COMPU_METHOD
/begin COMPU_METHOD _CNV_A_R_LINEAR_____25_CM "" RAT_FUNC "%6.3" "°C" COEFFS 0 1. 40. 0 0 1 /end COMPU_METHOD
/begin COMPU_METHOD _CNV_A_R_LINEAR_____26_CM "" RAT_FUNC "%6.3" "hPa" COEFFS 0 12.06017666543982 0. 0 0 1 /end COMPU_METHOD
/begin COMPU_METHOD _CNV_A_R_LINEAR_____27_CM "" RAT_FUNC "%6.3" "-" COEFFS 0 256. 0. 0 0 1 /end COMPU_METHOD
/begin COMPU_METHOD _CNV_A_R_LINEAR_____28_CM "" RAT_FUNC "%6.3" "rpm/s" COEFFS 0 3.125e-002 128. 0 0 1 /end COMPU_METHOD
/begin COMPU_METHOD _CNV_A_R_LINEAR_____30_CM "" RAT_FUNC "%6.3" "Nm" COEFFS 0 32. 0. 0 0 1 /end COMPU_METHOD
/begin COMPU_METHOD _CNV_A_R_LINEAR_____50_CM "" RAT_FUNC "%6.3" "" COEFFS 0 1. 0. 0 0 1 /end COMPU_METHOD
/begin COMPU_METHOD _CNV_A_R_LINEAR_____57_CM "" RAT_FUNC "%6.3" "Nm" COEFFS 0 2. 0. 0 0 1 /end COMPU_METHOD
/begin COMPU_METHOD _CNV_A_R_LINEAR_____60_CM "" RAT_FUNC "%6.3" "Nm" COEFFS 0 1. 0. 0 0 1 /end COMPU_METHOD
/begin COMPU_METHOD _CNV_R_R_Def_km_sw__64_CM "Def_km_sw_q10" RAT_FUNC "%6.3" "km" COEFFS 0. 1. 0. 0. 0. 10. /end COMPU_METHOD
/begin COMPU_METHOD _CNV_A_R_LINEAR_____65_CM "" RAT_FUNC "%6.3" "Nm" COEFFS 0 32. 32768. 0 0 1 /end COMPU_METHOD
/begin COMPU_METHOD _CNV_A_R_LINEAR_____66_CM "" RAT_FUNC "%6.3" "km/h" COEFFS 0 128.0000018750286 0. 0 0 1 /end COMPU_METHOD
/begin COMPU_METHOD _CNV_A_R_LINEAR_____68_CM "" RAT_FUNC "%6.3" "-" COEFFS 0 65535.99999999996 0. 0 0 1 /end COMPU_METHOD
/begin COMPU_METHOD _CNV_A_R_LINEAR_____70_CM "" RAT_FUNC "%6.3" "km" COEFFS 0 0.1 0. 0 0 1 /end COMPU_METHOD
/begin COMPU_METHOD _CNV_A_R_LINEAR_____71_CM "" RAT_FUNC "%6.3" "" COEFFS 0 256. 0. 0 0 1 /end COMPU_METHOD
/begin COMPU_METHOD _CNV_S_2_RANGE______75_CM "" TAB_VERB "%6.3" "" COMPU_TAB_REF _CNV_S_2_RANGE______75 /end COMPU_METHOD
/begin COMPU_VTAB _CNV_S_2_RANGE______75 "" TAB_VERB 2 0 "0" 1 "1" /end COMPU_VTAB
/begin COMPU_METHOD _CNV_A_R_LINEAR_____76_CM "" RAT_FUNC "%6.3" "l" COEFFS 0 1. 0. 0 0 1 /end COMPU_METHOD
/begin COMPU_METHOD _CNV_A_R_LINEAR_____77_CM "" RAT_FUNC "%6.3" "min" COEFFS 0 1. 0. 0 0 1 /end COMPU_METHOD
/begin COMPU_METHOD _CNV_A_R_LINEAR_____97_CM "" RAT_FUNC "%6.3" "-" COEFFS 0 127.9991955827809 0. 0 0 1 /end COMPU_METHOD
/begin COMPU_METHOD _CNV_A_R_LINEAR_____98_CM "" RAT_FUNC "%6.3" "km/h" COEFFS 0 128. 32768. 0 0 1 /end COMPU_METHOD
/begin COMPU_METHOD _CNV_A_R_LINEAR_____103_CM "" RAT_FUNC "%6.3" "%" COEFFS 0 2084.478388983038 32768.00027481336 0 0 1 /end COMPU_METHOD
/begin COMPU_METHOD _CNV_A_R_LINEAR_____107_CM "" RAT_FUNC "%6.3" "s" COEFFS 0 50. 0. 0 0 1 /end COMPU_METHOD
/begin COMPU_METHOD _CNV_A_R_LINEAR_____108_CM "" RAT_FUNC "%6.3" "mg/stk" COEFFS 0 47.18142548596112 0. 0 0 1 /end COMPU_METHOD
/begin COMPU_METHOD _CNV_A_R_LINEAR_____113_CM "" RAT_FUNC "%6.3" "-" COEFFS 0 8192. 0. 0 0 1 /end COMPU_METHOD
/begin COMPU_METHOD _CNV_A_R_LINEAR_____122_CM "" RAT_FUNC "%6.3" "-" COEFFS 0 1024. 0. 0 0 1 /end COMPU_METHOD
/begin COMPU_METHOD _CNV_A_R_LINEAR_____123_CM "" RAT_FUNC "%6.3" "°C" COEFFS 0 16. 0. 0 0 1 /end COMPU_METHOD
/begin COMPU_METHOD _CNV_A_R_LINEAR_____133_CM "" RAT_FUNC "%6.3" "mA" COEFFS 0 163.8375 0. 0 0 1 /end COMPU_METHOD
/begin COMPU_METHOD _CNV_A_R_LINEAR_____140_CM "" RAT_FUNC "%6.3" "V" COEFFS 0 2510.769230769231 0. 0 0 1 /end COMPU_METHOD
/begin COMPU_METHOD _CNV_A_R_LINEAR_____150_CM "" RAT_FUNC "%6.3" "-" COEFFS 0 65535. 0. 0 0 1 /end COMPU_METHOD
/begin COMPU_METHOD _CNV_A_R_LINEAR_____152_CM "" RAT_FUNC "%6.3" "hPa" COEFFS 0 0.1884402603974972 0. 0 0 1 /end COMPU_METHOD
/begin COMPU_METHOD _CNV_A_R_LINEAR_____169_CM "" RAT_FUNC "%6.3" "°CRK" COEFFS 0 -16. 0. 0 0 1 /end COMPU_METHOD
/begin COMPU_METHOD _CNV_A_R_LINEAR_____171_CM "" RAT_FUNC "%6.3" "°CRK" COEFFS 0 2.666666666666667 128. 0 0 1 /end COMPU_METHOD
/begin COMPU_METHOD _CNV_A_R_LINEAR_____172_CM "" RAT_FUNC "%6.3" "rpm" COEFFS 0 1. 32768. 0 0 1 /end COMPU_METHOD
/begin COMPU_METHOD _CNV_A_R_LINEAR_____173_CM "" RAT_FUNC "%6.3" "%" COEFFS 0 200. 0. 0 0 1 /end COMPU_METHOD
/begin COMPU_METHOD _CNV_A_R_LINEAR_____180_CM "" RAT_FUNC "%6.3" "rpm" COEFFS 0 3.125e-002 128. 0 0 1 /end COMPU_METHOD
/begin COMPU_METHOD _CNV_A_R_LINEAR_____185_CM "" RAT_FUNC "%6.3" "mm" COEFFS 0 1000. 0. 0 0 1 /end COMPU_METHOD
/begin COMPU_METHOD _CNV_A_R_LINEAR_____186_CM "" RAT_FUNC "%6.3" "hPa" COEFFS 0 25.6 32768. 0 0 1 /end COMPU_METHOD
/begin COMPU_METHOD _CNV_A_R_LINEAR_____189_CM "" RAT_FUNC "%6.3" "V" COEFFS 0 51.0204081632653 0. 0 0 1 /end COMPU_METHOD
/begin COMPU_METHOD _CNV_A_R_LINEAR_____195_CM "" RAT_FUNC "%6.3" "V" COEFFS 0 51.2 0. 0 0 1 /end COMPU_METHOD
/begin COMPU_METHOD _CNV_A_R_LINEAR_____197_CM "" RAT_FUNC "%6.3" "°C" COEFFS 0 64. 0. 0 0 1 /end COMPU_METHOD
/begin COMPU_METHOD _CNV_A_R_LINEAR_____202_CM "" RAT_FUNC "%6.3" "mg/stk" COEFFS 0 47.18142548596112 -1.455191522836685e-011 0 0 1 /end COMPU_METHOD
/begin COMPU_METHOD _CNV_A_R_LINEAR_____207_CM "" RAT_FUNC "%6.3" "kg/h" COEFFS 0 32. 0. 0 0 1 /end COMPU_METHOD
/begin COMPU_METHOD _CNV_A_R_LINEAR_____216_CM "" RAT_FUNC "%6.3" "°C" COEFFS 0 43.47840509520334 2086.96344456976 0 0 1 /end COMPU_METHOD
/begin COMPU_METHOD _CNV_A_R_LINEAR_____223_CM "" RAT_FUNC "%6.3" "°TPS" COEFFS 0 137.0962343096234 16383. 0 0 1 /end COMPU_METHOD
/begin COMPU_METHOD _CNV_A_R_LINEAR_____225_CM "" RAT_FUNC "%6.3" "%" COEFFS 0 327.680000003584 32768.00000035841 0 0 1 /end COMPU_METHOD
/begin COMPU_METHOD _CNV_A_R_LINEAR_____233_CM "" RAT_FUNC "%6.3" "ms" COEFFS 0 1000. 0. 0 0 1 /end COMPU_METHOD
/begin COMPU_METHOD _CNV_A_R_LINEAR_____249_CM "" RAT_FUNC "%6.3" "-" COEFFS 0 32768.00003968061 32768.00003968061 0 0 1 /end COMPU_METHOD
/begin COMPU_METHOD _CNV_A_R_LINEAR_____250_CM "" RAT_FUNC "%6.3" "kg/h" COEFFS 0 128.0000018750286 0. 0 0 1 /end COMPU_METHOD
/begin COMPU_METHOD _CNV_A_R_LINEAR_____255_CM "" RAT_FUNC "%6.3" "" COEFFS 0 64. 0. 0 0 1 /end COMPU_METHOD
/begin COMPU_METHOD _CNV_A_R_LINEAR_____259_CM "" RAT_FUNC "%6.3" "km" COEFFS 0 0.125 0. 0 0 1 /end COMPU_METHOD
/begin COMPU_METHOD _CNV_A_R_LINEAR_____269_CM "" RAT_FUNC "%6.3" "°TPS" COEFFS 0 548.4100418410042 0. 0 0 1 /end COMPU_METHOD
/begin COMPU_METHOD _CNV_A_R_LINEAR_____272_CM "" RAT_FUNC "%6.3" "m/s²" COEFFS 0 640. 32768. 0 0 1 /end COMPU_METHOD
/begin COMPU_METHOD _CNV_A_R_LINEAR_____274_CM "" RAT_FUNC "%6.3" "m/s²" COEFFS 0 2084.478388983038 32768.00027481336 0 0 1 /end COMPU_METHOD
/begin COMPU_METHOD _CNV_A_R_LINEAR_____275_CM "" RAT_FUNC "%6.3" "-" COEFFS 0 32768. 0. 0 0 1 /end COMPU_METHOD
/begin COMPU_METHOD _CNV_A_R_LINEAR_____280_CM "" RAT_FUNC "%6.3" "Nm" COEFFS 0 0.5 0. 0 0 1 /end COMPU_METHOD
/begin COMPU_METHOD _CNV_A_R_LINEAR_____282_CM "" RAT_FUNC "%6.3" "°STW/s" COEFFS 0 22.75571737399022 32768. 0 0 1 /end COMPU_METHOD
/begin COMPU_METHOD _CNV_A_R_EGCP_LINEA_370_CM "" RAT_FUNC "%6.3" "-" COEFFS 0 8. 0. 0 0 1 /end COMPU_METHOD
/begin COMPU_METHOD _CNV_A_R_LINEAR_____412_CM "" RAT_FUNC "%6.3" "-" COEFFS 0 1. -1. 0 0 1 /end COMPU_METHOD
/begin COMPU_METHOD _CNV_A_R_LINEAR_____439_CM "" RAT_FUNC "%6.3" "hPa" COEFFS 0 1. 0. 0 0 1 /end COMPU_METHOD
/begin COMPU_METHOD _CNV_S_4_RANGE_STAT_444_CM "" TAB_VERB "%6.3" "-" COMPU_TAB_REF _CNV_S_4_RANGE_STAT_444 /end COMPU_METHOD
/begin COMPU_VTAB _CNV_S_4_RANGE_STAT_444 "" TAB_VERB 4 0 "PASSIVE" 1 "EGY_1" 2 "EGY_2" 3 "EGY_3" /end COMPU_VTAB
/begin COMPU_METHOD _CNV_A_R_LINEAR_____450_CM "" RAT_FUNC "%6.3" "hPa" COEFFS 0 12.06017666543982 32767.5 0 0 1 /end COMPU_METHOD
/begin COMPU_METHOD _CNV_A_R_TQLO_LINEA_451_CM "" RAT_FUNC "%6.3" "Nm" COEFFS 0 2097152.000000003 2.86102294921875e-006 0 0 1 /end COMPU_METHOD
/begin COMPU_METHOD _CNV_A_R_LINEAR_____465_CM "" RAT_FUNC "%6.3" "-" COEFFS 0 2. 0. 0 0 1 /end COMPU_METHOD
/begin COMPU_METHOD _CNV_A_R_LINEAR_____467_CM "" RAT_FUNC "%6.3" "-" COEFFS 0 22.72727272727273 0. 0 0 1 /end COMPU_METHOD
/begin COMPU_METHOD _CNV_A_R_LINEAR_____468_CM "" RAT_FUNC "%6.3" "%" COEFFS 0 10. 0. 0 0 1 /end COMPU_METHOD
/begin COMPU_METHOD _CNV_A_R_LINEAR_____470_CM "" RAT_FUNC "%6.3" "Bar" COEFFS 0 1000. 0. 0 0 1 /end COMPU_METHOD
/begin COMPU_METHOD _CNV_A_R_LINEAR_____489_CM "" RAT_FUNC "%6.3" "-" COEFFS 0 655.3599999999997 0. 0 0 1 /end COMPU_METHOD
/begin COMPU_METHOD _CNV_A_R_LINEAR_____490_CM "" RAT_FUNC "%6.3" "°C" COEFFS 0 0.25 0. 0 0 1 /end COMPU_METHOD
/begin COMPU_METHOD _CNV_A_R_LINEAR_____492_CM "" RAT_FUNC "%6.3" "mg/s" COEFFS 0 64. 0. 0 0 1 /end COMPU_METHOD
/begin COMPU_METHOD _CNV_A_R_LINEAR_____495_CM "" RAT_FUNC "%6.3" "mg" COEFFS 0 6.25 0. 0 0 1 /end COMPU_METHOD
/begin COMPU_METHOD _CNV_S_4_STATE_RGN__496_CM "" TAB_VERB "%6.3" "" COMPU_TAB_REF _CNV_S_4_STATE_RGN__496 /end COMPU_METHOD
/begin COMPU_VTAB _CNV_S_4_STATE_RGN__496 "" TAB_VERB 4 0 "SENSOR" 1 "MODEL" 2 "SENSOR_MODEL" 3 "TIME" /end COMPU_VTAB
/begin COMPU_METHOD _CNV_S_6_STATE_NOX__514_CM "" TAB_VERB "%6.3" "-" COMPU_TAB_REF _CNV_S_6_STATE_NOX__514 /end COMPU_METHOD
/begin COMPU_VTAB _CNV_S_6_STATE_NOX__514 "" TAB_VERB 6 0 "PASSIV" 1 "LOAD" 2 "REGENERATION" 3 "WAIT" 4 "STOP" 5 "WARMUP" /end COMPU_VTAB
/begin COMPU_METHOD _CNV_A_R_LINEAR_____539_CM "" RAT_FUNC "%6.3" "hPa/ms" COEFFS 0 395.1938017499002 -7.983716819580877e-003 0 0 1 /end COMPU_METHOD
/begin COMPU_METHOD _CNV_A_R_LINEAR_____565_CM "" RAT_FUNC "%6.3" "%" COEFFS 0 0.1 0. 0 0 1 /end COMPU_METHOD
/begin COMPU_METHOD _CNV_A_R_LINEAR_____566_CM "" RAT_FUNC "%6.3" "Nm" COEFFS 0 1. 32000. 0 0 1 /end COMPU_METHOD
/begin COMPU_METHOD _CNV_A_R_LINEAR_____790_CM "" RAT_FUNC "%6.3" "°C" COEFFS 0 64. 2112. 0 0 1 /end COMPU_METHOD
/begin COMPU_METHOD _CNV_A_R_LINEAR_____791_CM "" RAT_FUNC "%6.3" "°C" COEFFS 0 10. 0. 0 0 1 /end COMPU_METHOD
/begin COMPU_METHOD _CNV_A_R_EXTC_LINEA_792_CM "" RAT_FUNC "%6.3" "K" COEFFS 0 32. 33792. 0 0 1 /end COMPU_METHOD
/begin COMPU_METHOD _CNV_A_R_LINEAR_____793_CM "" RAT_FUNC "%6.3" "K" COEFFS 0 32. 32768. 0 0 1 /end COMPU_METHOD
/begin COMPU_METHOD _CNV_A_R_LINEAR_____797_CM "" RAT_FUNC "%6.3" "" COEFFS 0 255. 0. 0 0 1 /end COMPU_METHOD
/begin COMPU_METHOD _CNV_A_R_LINEAR_____800_CM "" RAT_FUNC "%6.3" "Nm" COEFFS 0 255.9999999499993 -6.400096026482061e-006 0 0 1 /end COMPU_METHOD
/begin COMPU_METHOD _CNV_A_R_LINEAR_____801_CM "" RAT_FUNC "%6.3" "Nm/K" COEFFS 0 65535.99999999996 0. 0 0 1 /end COMPU_METHOD
/begin COMPU_METHOD _CNV_A_R_LINEAR_____802_CM "" RAT_FUNC "%6.3" "Nm" COEFFS 0 255.9999999499992 -6.40009488994675e-006 0 0 1 /end COMPU_METHOD
/begin COMPU_METHOD _CNV_A_R_LINEAR_____803_CM "" RAT_FUNC "%6.3" "Nm/K" COEFFS 0 32767.99999999992 0. 0 0 1 /end COMPU_METHOD
/begin COMPU_METHOD _CNV_A_R_LINEAR_____804_CM "" RAT_FUNC "%6.3" "Nm/100ms" COEFFS 0 256. 0. 0 0 1 /end COMPU_METHOD
/begin COMPU_METHOD _CNV_S_7_STATE_IVVT_810_CM "" TAB_VERB "%6.3" "-" COMPU_TAB_REF _CNV_S_7_STATE_IVVT_810 /end COMPU_METHOD
/begin COMPU_VTAB _CNV_S_7_STATE_IVVT_810 "" TAB_VERB 7 0 "Passive" 1 "Ready" 2 "Enable" 3 "Limp Home" 4 "Adaptation" 5 "Parking" 6 "Init" /end COMPU_VTAB
/begin RECORD_LAYOUT _REC_VAL_20_u1 FNC_VALUES 1 UBYTE COLUMN_DIR DIRECT /end RECORD_LAYOUT
/begin RECORD_LAYOUT _REC_VAL_20_u2 FNC_VALUES 1 UWORD COLUMN_DIR DIRECT /end RECORD_LAYOUT
/begin RECORD_LAYOUT _REC_AXS_20_u1 NO_AXIS_PTS_X 1 UBYTE AXIS_PTS_X 2 UBYTE INDEX_INCR DIRECT /end RECORD_LAYOUT
/begin RECORD_LAYOUT _REC_VAL_20_s2 FNC_VALUES 1 SWORD COLUMN_DIR DIRECT /end RECORD_LAYOUT
/begin RECORD_LAYOUT _REC_AXS_20_u2 NO_AXIS_PTS_X 1 UWORD AXIS_PTS_X 2 UWORD INDEX_INCR DIRECT /end RECORD_LAYOUT
/begin RECORD_LAYOUT _REC_MAP_20_u2_u1_u2 FNC_VALUES 1 UWORD COLUMN_DIR DIRECT /end RECORD_LAYOUT
/begin RECORD_LAYOUT _REC_MAP_20_u1_u1_u2 FNC_VALUES 1 UBYTE COLUMN_DIR DIRECT /end RECORD_LAYOUT
/begin FUNCTION __DDS_EXPA2_DEFAULT_FUNC__ "__DDS_EXPA2_DEFAULT_FUNC__"
 /begin DEF_CHARACTERISTIC ldpm_gear_ef_1 ldpm_n_ef ldp_n_32_ip_t_dly_ef ldp_maf__thd_is_er_diag ldp_n__thd_is_er_diag ldp_tco__fac_thd_is_er_diag ldpm_n_sof ldp_n_32_ip_t_dly_sof ldpm_n_32__t_acc ldp_vs__amp_raw_cor ldp_v_amp__amp_raw ldpm_n_2_3 ldp_toil__t_dly_poil_swi_can lc_snd_msg_oil_key_aux lpdm_ctr_km_can ldpm_tco_2 ldpm_ctr_km_can_1 ldpm_t_ctl_cru_1 ldp_vs_dif_cru__fac_prop_cru ldpm_vs_sp_dif_cru_1 ldpm_n_21 ldpm_vs_sp_cru_1 ldpm_ac_cru__fac_tq_cru ldpm_gear__fac_tq_cru ldp_n_32__fac_tq_cru ldpm_fac_tq_cru_1 ldp_n_32__fac_tq_req_clu_is ldp_ftl__t_cur_dmtl_stat ldp_ftl__t_small_leak_test ldp_vb_dmtl_fil__fac_cur_dmtl ldpm_cur_dmtldifrefroughleak_1 ldp_ftl__t_rough_leak_test ldpm_tco_1_6 ldpm_gr_mt_3 ldpm_gr_at_3 ldpm_tco_9 ldp_n__t_min_pu ldp_tco__t_min_pu ldp_tq_loss_ars_sp_can__puc ldp_tq_loss_pste_2_sp_can__puc ldp_n_grd_n_dif_max_is ldp_n_vs_ratio_gr_mt ldpm_tco_1_igsp ldpm_cyc_cast_ip_iga_dif_min ldpm_n_32_2_igsp ldpm_maf_hb_2_igsp ldp_amp_ip_iga_dif_min_cyc_amp ldpm_n_dif_igsp ldp_eff_iga_inv_cor_ip_iga_dif ldpm_cyc_1_iga_st ldpm_n_1_iga_st ldpm_amp_1_iga_st ldpm_tia_1_iga_st ldp_teg_dyn_hys ldpm_tco_is_1 ldpm_gr_mt_2 ldpm_t_ast__fac_n_grd_is ldpm_tco__fac_n_grd_is ldp_tco__fac_tco_pas_i_is ldpm_n_dif_cor_p_d_dt_is_opm_1 ldpm_n_dif_cor_p_d_dt_is_opm_2 ldpm_n_grd_p_d_dt_is_opm_1 ldpm_n_grd_p_d_dt_is_opm_2 ldpm_n_dif_cor_p_d_is_opm_1 ldpm_n_dif_cor_p_d_is_opm_2 ldpm_n_grd_p_d_is_opm_1 ldpm_n_grd_p_d_is_opm_2 ldpm_n_dif_cor_tq_i_is_1_opm_1 ldpm_n_dif_cor_tq_i_is_1_opm_2 ldpm_n_grd_tq_i_is_1_opm_1 ldpm_n_grd_tq_i_is_1_opm_2 ldpm_n_dif_cor_tq_i_dt_is_opm_1 ldpm_n_dif_cor_tq_i_dt_is_opm_2 ldpm_n_dif_cor_tq_i_is_opm_1 ldpm_n_dif_cor_tq_i_is_opm_2 ldpm_n_grd_tq_i_is_opm_1 ldpm_n_grd_tq_i_is_opm_2 ldp_tco__fac_n_grd_is_thr ldp_t_ast__fac_n_grd_is_thr ldpm_n_sp_is_tq_add_is_bol_bas ldp_n_sp_is_tq_add_is_bol_bas_opm_2 ldpm_tco_tq_add_is_bol_bas ldp_tco_tq_add_is_bol_bas_opm_2 ldpm_toil_ip_fac_temp_tq_add_is ldpm_tia_ip_fac_temp_tq_add_is ldpm_maf_fac_tq_add_is ldpm_maf_fac_tq_add_is_opm2 ldpm_vs_fil_ip_fac_vs_tq_add_is ldp_maf_lgrd_tq_add_is_bol ldp_vlft_min_ip_tq_add_is_cor ldp_map_dip_sp_mmv_ip_tq_add_is ldp_n_lgrd_tq_add_is_bol ldp_n_lgrd_tq_add_is_bol_opm_2 ldpm_n_4_9 ldpm_n_6_4 ldpm_n_iga_max_knk ldpm_maf_iga_max_knk ldp_tco__fac_iga_max_knk ldp_tia__fac_iga_max_knk ldpm_maf_1_9 ldpm_n_2_9 ldp_n__pq_sp_puls ldp_maf_kgh_mes_bas ldp_tia_ip_fac_maf_kgh_cor ldpm_maf_cyl_ex ldpm_maf_flow_egr ldp_n_32_ip_crlc_eff_vol_temp ldpm_n_32__eff_vol_cor ldpm_maf__eff_vol_cor ldp_n_32__crlc_v_maf_diag ldp_v_map__map_mes_bas ldp_tps_dif__mtcpwm_p ldp_tps_dif__mtcpwm_i ldp_tps_av_lih_dif_mtcpwm_i ldp_tps_dif_grd__mtcpwm_d ldp_tps_sp_lih_dif__mtcpwm_add ldp_vb__mtcpwm_vb_fac ldpm_tco_n_sp_1 ldpm_tco_n_sp_is_pste ldpm_toil_n_sp_is_toil ldpm_iga_n_sp_is_knk ldp_toil_ip_n_sp_is_cs_opm_1 ldp_toil_ip_n_sp_is_cs_opm_2 ldp_n_n_sp_is_pl_opm_1 ldp_n_n_sp_is_pl_opm_2 ldp_n_n_sp_is_pl_amt_opm_1 ldp_n_n_sp_is_pl_amt_opm_2 ldp_tq_loss_n_sp_is_pl_opm_1 ldp_tq_loss_n_sp_is_pl_opm_2 ldp_tq_loss_n_sp_is_pl_amt_opm_1 ldp_tq_loss_n_sp_is_pl_amt_opm_2 ldp_n_32_n_grd_thd ldpm_gear ldp_pv_av__n_max_mtc_cur_off ldp_tco__n_max_1 ldp_tco__n_max_2 ldp_toil_max__stop_dec_fsd ldp_tco_st__stop_inc_fsd ldpm_lamb_sp ldp_n_32__pv_lih_max ldpm_vs_fil__pv_fac_cor ldpm_n_dif__pv_fac_cor ldpm_n__pv_fac_cor ldpm_pv_av_raw__pv_fac_cor ldpm_n_32__fac_tq_req_driv ldpm_fac_tq_cru_dcc ldp_v_pvs_min ldp_v_tecu__tecu ldpm_tia_ip_ti_cast ldpm_tco__mff_deac_cst ldpm_fac_st_rest ldpm_cyc_cast_1 ldpm_cyc_cast_2 ldpm_tco__ti_st_rest ldp_tco_stop__fac_rest ldpm_tco__fac_stall ldp_t_es__rest ldp_t_ast_rest ldpm_maf_hb__ti_wup ldpm_n_32__ti_wup ldp_map_dif__fac_ti_vo_wup ldp_map__ti_fac_n_map ldp_n_32__ti_fac_n_map ldp_toil_ti_fac_tia_toil ldp_tia_ti_fac_tia_toil ldp_tco__ti_fac_tco ldpm_tco_ti_wup_opm_1 ldpm_tco_ti_wup_opm_2 ldp_tco_st_ti_tco_wup_opm_1 ldp_tco_st_ti_tco_wup_opm_2 ldp_v_tia_tia ldp_v_tia_tcha ldpm_n_32_6 ldp_tps_av__maf_1_diag ldp_n_32__tps_max_ratio_diag ldp_n_ip_fac_tps_dif_1 ldp_maf_sp_tqi_ip_fac_tps_dif_1 ldp_pq_sp_ip_fac_tps_dif_2 ldp_n_32_tps_sp_pwl ldp_pv_av__tps_sp_ext ldpm_tco_1_thro ldp_t_acc_ip_fac_tq_loss_acc_on ldp_n_32_ip_fac_tq_loss_acc_on ldp_n_32__tq_add_acc ldp_t_acc_fac_tq_loss_acc ldp_n_32__tq_add_heat_acc ldp_n_32__tq_loss_acc ldp_tq_accin_can__tq_loss_acc ldp_tq_loss_acc_inp__tq_add_acc ldpm_ac_veh_trv_tcs ldpm_vs_fil ldpm_n_32__tq_loss_ars ldp_tq_loss_ars_sp_can_max ldp_tq_loss_ars_av_can_max ldp_tco__tq_clu_amt ldp_n_dif__tq_clu_amt ldp_n_32_ip_tq_add_conv ldp_n_32_ip_tq_add_amt ldp_vs_fil__tq_clu_amt ldp_n_ratio_conv_fac_tq_conv ldp_toil_t_dly_n_sp_is ldp_toil_t_dly_conv ldp_toil_fac_conv ldp_gr_at_n_tur ldp_n_32__tq_conv ldp_vs_n_tur ldp_tq_conv_can__tq_conv ldp_toil_t_ramp_conv_pos ldp_toil_t_ramp_conv_neg ldpm_toil_tq_add_conv ldpm_vs_tq_add_conv ldp_n_grd_tq_add_conv ldp_ac_cru_tq_add_conv ldp_eff_scc_sp__nr_pat_scc ldp_maf__min_fcut_fast ldp_n__min_fcut_fast ldpm_tco_ip_tq_st ldpm_n_dif_ip_tq_st ldpm_n_fac_tq_req_driv ldpm_pv_cus_fac_tq_req_driv ldp_n_sp_is_ratio ldpm_n_32__tqi_min_pu ldpm_tco__tqi_min_pu ldp_n_32__tqi_dif_lim ldp_tqi_sp_mon__tqi_dif_lim ldpm_gear__tq_p_max ldpm_vs_fil__tq_p_max ldpm_ang_pste_stnd_tqlo_1 ldpm_ang_pste_stnd_tqlo ldp_tq_loss_pste_2_sp_can ldp_n__fac_tq_add_pste ldpm_vs_tq_loss_pste_2 ldp_vel_ang_pste_tqlo_1 ldpm_vel_ang_pste_tqlo ldpm_idx_1_sp_vim_1_vima ldpm_idx_2_sp_vim_1_vima ldp_fac_maf_max_ip_fac_n_vim ldp_tia_fac_tia_n_vim ldp_n_32_fac_n_vim ldpm_n_32_ip_rel_flow_max_cps ldpm_maf_kgh__crlc_vls_down ldpm_vs_wheel_grd_mmv_thd ldpm_tia_1 c_var_state lc_state_test_opm_can_ena_vvl lc_egy_min_kwp ldpm_tst_rec ldp_fmy_dtc ldp_toil_ip_tqfr_add ldpm_toil_ip_tqfr_add ldp_ctr_km_can__tqfr_add ldp_toil__tqfr_add ldpm_amp__tqfr_add ldp_tco_ip_t_ast_is_ad_inh ldp_ecfpwm ldp_id_saf_tab_1 ldp_id_saf_tab_2 ldpm_n_id_crk_acq ldpm_n_id_cam_acq ldpm_n_t_n_dif_ofs_pred ldp_vs_fil_ip_fac_vs_tq_add_pl ldp_tq_av_ip_fac_n_grd ldp_fac_tq_req_ip_fac_tq_drof ldp_n_dif_drof__id_tq_drof ldp_n_grd__id_tq_drof ldp_gear__var_amt_load_im ldpm_n_dif_pred_fac_tq_add_is ldp_n_dif_pred_fac_tq_add_is_1 ldp_n_dif_pred_fac_tq_add_is_2 ldpm_fac_tq_req_drof ldp_fac_tq_req_drof_1 ldp_fac_tq_req_drof_2 ldp_tia_ip_fac_temp_tq_add_1 ldp_toil_ip_fac_temp_tq_add_1 ldp_toil_ip_fac_temp_tq_add_2 ldp_n_grd_ip_n_dif_add_drof_1 ldp_n_grd_ip_n_dif_add_drof_2 ldp_n_sp_is_ip_n_dif_add_drof_1 ldp_n_sp_is_ip_n_dif_add_drof_2 ldpm_n_dif_drof_ip_tq_drof_1 ldpm_n_dif_drof_ip_tq_drof_2 ldpm_n_grd_ip_tq_drof_1 ldpm_n_grd_ip_tq_drof_2 ldp_vs_fil_ip_fac_tq_drof_vs_1 ldp_vs_fil_ip_fac_tq_drof_vs_2 ldp_n_ip_fac_tq_drof_vs_1 ldp_tq_drof_grd_deac_1 ldp_tq_drof_grd_deac_2 ldp_maf_cyl__amp_dec ldpm_opm_req ldpm_n_32_5_tqdr ldpm_n_32_6_tqdr ldpm_fac_maf_rel_1_tqdr ldpm_fac_maf_rel_2_tqdr ldpm_n_32_1_tqdr ldpm_fac_maf_rel_3_tqdr ldpm_n_32_7_tqdr ldpm_fac_maf_rel_4_tqdr ldpm_opm_av ldpm_eff_2_tqdr ldpm_eff_1_tqdr ldpm_n_14_tqdr ldpm_maf_2_tqdr ldp_iga_dif_ip_eff_iga c_mff_sp_1_hom_man c_mff_sp_2_hom_man c_mff_sp_1_s_man c_mff_sp_2_s_man c_mff_sp_3_s_man lc_mff_sp_hom_man_act lc_mff_sp_s_man_act lc_mff_add_ad_lam_bal_man lc_add_pulse_ena ldp_amp_ip_load_clc_amp ldp_n_32_ip_load_clc ldp_maf_ip_load_clc ldpm_tco__n_stall ldp_n_32__iga_egr_s ldp_mff_sp_s__egr_iga ldp_egr_ratio_cor_2__iga_bas ldpm_tco__iga_egr ldpm_n_32_ip_egr_ratio ldpm_maf_ip_egr_ratio lc_rpu_lamb_rgn_2 ldp_tq_loss_alter_1__tq_alter ldp_n_32__tq_alter ldp_idx_bsd_sdl_tbl ldpm_temp_cat_dif_ch_l_1_extc ldpm_tnt_dif_ch_l_1_extc ldp_n_32_ip_soi_1_mplh_ch_so2p c_v_map_bas_max_diag c_v_map_bas_min_diag c_t_min_pow_clas_veh_can_req c_t_max_pow_clas_veh_can_rcv c_state_pow_clas_veh lc_veh_pow_var_err_dis c_abc_max_pow_clas_veh_err c_idx_cod_conv ldp_vs_ip_clrc_amp_plaus ldp_id_maf_tab_1 ldp_id_maf_tab_2 ip_fac_fup_sp_ch ip_fup_sp_ch c_fac_k_fil_acr_ctl c_fac_opg_sp_acr c_ccp_pt_act /end DEF_CHARACTERISTIC
 /begin OUT_MEASUREMENT err_ecraspwm_fb t_ecraspwm_fb lv_ecraspwm_fb_vld cdn_diag_ecras_el abc_ecraspwm_fb t_act_ecraspwm_fb lv_err_ecras_el lv_err_ecras lv_err_ecraspwm_fb err_diag_ecraspwm lv_intr_diag_ecras_el cycnr_puc n_hys_puc n_min_puc lv_diagcps_min_mod lv_eol_cps_ini lv_opm_av_cng_diagcps t_diagcps_dly_1_rbm t_diagcps_dly_2_rbm t_diagcps_maf_rbm lv_t_diagcps_rbm t_diagcps_n_map_1_rbm lam_bank_1.fsd_obd2.bf.lv_end_diag_win_fsd lam_bank_1.fsd_obd2.bf.lv_det_sym_eve_fsd lam_bank_2.fsd_obd2.bf.lv_end_diag_win_fsd lam_bank_2.fsd_obd2.bf.lv_det_sym_eve_fsd lv_fmy_exit_st toil_max_warn vs_toil_max n_toil_max gear_toil_max tqi_av_toil_max tco_toil_max tam_toil_max ctr_toil_max pv_av_toil_max lv_cs_toil_max toil_thd_toil_max dist_toil_max lv_toil_thd_warn_1 lv_toil_thd_warn_2 n_ratio_conv cdn_diag_el_cps lv_ls_up_obd_man_deac_ext lv_ls_down_obd_man_deac_ext lv_inh_diag_seg_ad_er lv_inh_diag_t_seg_er poil_sp_ext_adj poil_pwm_ext_adj tps_sp_ext_adj state_egy_min_kwp val_mon_err_ram lv_err_tmp_mu_mc lv_err_mu_mc cyl_id_sam_trig lv_err_load_tps_plaus lv_err_vim_plaus lv_err_map_dip_plaus lv_err_alter_bn_rgn lv_inh_diag_rbm_mec_ivvt_ex lv_eol_obd_dc state_rbm_mec_ivvt_ex lv_inh_diag_rbm_mec_ivvt_in lv_inh_diag_rbm_map_dip_plaus lv_inh_diag_rbm_load_tps_plaus state_rbm_mec_ivvt_in state_rbm_map_dip_plaus state_rbm_load_tps_plaus lv_end_rbm_mec_ivvt_ex lv_end_rbm_mec_ivvt_in lv_end_rbm_map_dip_plaus lv_end_rbm_load_tps_plaus lv_cdn_rbm_mec_ivvt_ex lv_cdn_rbm_mec_ivvt_in lv_cdn_rbm_map_dip_plaus lv_cdn_rbm_load_tps_plaus nvmy_tqlo.nvmy_dtsysisad.tq_dif_is_ad_inter.slongword nvmy_tqlo.nvmy_dtsysisad.tq_dif_is_ad_inter.sword[0] nvmy_tqlo.nvmy_dtsysisad.tq_dif_is_ad_inter.sword[1] nvmy_tqlo.nvmy_dtsysisad.tq_dif_is_ad_inter.sbyte[0] nvmy_tqlo.nvmy_dtsysisad.tq_dif_is_ad_inter.sbyte[1] nvmy_tqlo.nvmy_dtsysisad.tq_dif_is_ad_inter.sbyte[2] nvmy_tqlo.nvmy_dtsysisad.tq_dif_is_ad_inter.sbyte[3] nvmy_tqlo.nvmy_dtsysisad.tq_dif_is_ad_conv_inter.slongword nvmy_tqlo.nvmy_dtsysisad.tq_dif_is_ad_conv_inter.sword[0] nvmy_tqlo.nvmy_dtsysisad.tq_dif_is_ad_conv_inter.sword[1] nvmy_tqlo.nvmy_dtsysisad.tq_dif_is_ad_conv_inter.sbyte[0] nvmy_tqlo.nvmy_dtsysisad.tq_dif_is_ad_conv_inter.sbyte[1] nvmy_tqlo.nvmy_dtsysisad.tq_dif_is_ad_conv_inter.sbyte[2] nvmy_tqlo.nvmy_dtsysisad.tq_dif_is_ad_conv_inter.sbyte[3] nvmy_tqlo.nvmy_dtsysisad.tq_dif_is_ad_acc_1_inter.slongword nvmy_tqlo.nvmy_dtsysisad.tq_dif_is_ad_acc_1_inter.sword[0] nvmy_tqlo.nvmy_dtsysisad.tq_dif_is_ad_acc_1_inter.sword[1] nvmy_tqlo.nvmy_dtsysisad.tq_dif_is_ad_acc_1_inter.sbyte[0] nvmy_tqlo.nvmy_dtsysisad.tq_dif_is_ad_acc_1_inter.sbyte[1] nvmy_tqlo.nvmy_dtsysisad.tq_dif_is_ad_acc_1_inter.sbyte[2] nvmy_tqlo.nvmy_dtsysisad.tq_dif_is_ad_acc_1_inter.sbyte[3] nvmy_tqlo.nvmy_dtsysisad.tq_dif_is_ad_acc_conv_inter.slongword nvmy_tqlo.nvmy_dtsysisad.tq_dif_is_ad_acc_conv_inter.sword[0] nvmy_tqlo.nvmy_dtsysisad.tq_dif_is_ad_acc_conv_inter.sword[1] nvmy_tqlo.nvmy_dtsysisad.tq_dif_is_ad_acc_conv_inter.sbyte[0] nvmy_tqlo.nvmy_dtsysisad.tq_dif_is_ad_acc_conv_inter.sbyte[1] nvmy_tqlo.nvmy_dtsysisad.tq_dif_is_ad_acc_conv_inter.sbyte[2] nvmy_tqlo.nvmy_dtsysisad.tq_dif_is_ad_acc_conv_inter.sbyte[3] cdn_diag_ect_el lv_err_ect_el lv_err_ecf[0] pow_out_ecf t_dly_purge_diagcps maf_kgh_add_max tqi_sp_s lamb_cop_1 lamb_cop_2 lv_lamb_cop lv_ch_hom_act lv_lamb_cop_[0] lv_lamb_cop_[1] n_sp_is_brake fac_tq_add_is_opm_sel fac_tq_loss_opm_sel lamb_sp_[0] lamb_sp_[1] lamb_sp_hom[0] lamb_sp_hom[1] lv_cs fac_eff_iga_ch_cor toil_mes state_oil_req state_loil qoil_ds_can_2_1 qoil_ds_can_2_2 qoil_ds_can_2_3 qoil_ds_can_2_4 qoil_ds_can_2_5 qoil_ds_can_2_6 dist_resi_oil dist_resi_oil_km state_oil_avl poil_sp poil_pwm fac_mff_cst_opm_sel mff_sp_s fac_ti_wup_opm_sel fac_ti_cast_opm_sel inj_mod_hom_req inj_mod_s_req mff_sp_1_s[0] mff_sp_1_s[1] mff_sp_1_s[2] mff_sp_1_s[3] mff_sp_1_s[4] mff_sp_1_s[5] mff_sp_2_s[0] mff_sp_2_s[1] mff_sp_2_s[2] mff_sp_2_s[3] mff_sp_2_s[4] mff_sp_2_s[5] mff_sp_3_s[0] mff_sp_3_s[1] mff_sp_3_s[2] mff_sp_3_s[3] mff_sp_3_s[4] mff_sp_3_s[5] mff_sp_1_hom[0] mff_sp_1_hom[1] mff_sp_1_hom[2] mff_sp_1_hom[3] mff_sp_1_hom[4] mff_sp_1_hom[5] mff_sp_2_hom[0] mff_sp_2_hom[1] mff_sp_2_hom[2] mff_sp_2_hom[3] mff_sp_2_hom[4] mff_sp_2_hom[5] lv_eoi_st_ena lv_ti_cor_wf_opm_1_act mff_sp_1_homs[0] mff_sp_1_homs[1] mff_sp_1_homs[2] mff_sp_1_homs[3] mff_sp_1_homs[4] mff_sp_1_homs[5] mff_sp_2_homs[0] mff_sp_2_homs[1] mff_sp_2_homs[2] mff_sp_2_homs[3] mff_sp_2_homs[4] mff_sp_2_homs[5] lv_add_pulse_ena injr.STR_INJR_ISPCLEGYIV0.ti_1_stnd_s[0] injr.STR_INJR_ISPCLEGYIV0.ti_1_stnd_s[1] injr.STR_INJR_ISPCLEGYIV0.ti_1_stnd_s[2] injr.STR_INJR_ISPCLEGYIV0.ti_1_stnd_s[3] injr.STR_INJR_ISPCLEGYIV0.ti_1_stnd_s[4] injr.STR_INJR_ISPCLEGYIV0.ti_1_stnd_s[5] injr.STR_INJR_ISPCLEGYIV0.ti_2_stnd_s[0] injr.STR_INJR_ISPCLEGYIV0.ti_2_stnd_s[1] injr.STR_INJR_ISPCLEGYIV0.ti_2_stnd_s[2] injr.STR_INJR_ISPCLEGYIV0.ti_2_stnd_s[3] injr.STR_INJR_ISPCLEGYIV0.ti_2_stnd_s[4] injr.STR_INJR_ISPCLEGYIV0.ti_2_stnd_s[5] injr.STR_INJR_ISPCLEGYIV0.fac_mff_dif_hom[0] injr.STR_INJR_ISPCLEGYIV0.fac_mff_dif_hom[1] injr.STR_INJR_ISPCLEGYIV0.fac_mff_dif_hom[2] injr.STR_INJR_ISPCLEGYIV0.fac_mff_dif_hom[3] injr.STR_INJR_ISPCLEGYIV0.fac_mff_dif_hom[4] injr.STR_INJR_ISPCLEGYIV0.fac_mff_dif_hom[5] lv_swi_aeb lv_inh_nt_act lv_inh_rgn_req lv_inh_nt_afl lv_inh_nt_prj_act lv_inh_nt_stc_max lv_inh_nt_o2_stc lv_inh_rgn_req_ntld lv_inh_rgn_req_nox_sens lv_adj_nox_sens_rgn state_rgn_req lv_ntld_adj lv_tnt_mdl_max_ofs tnt_mdl_max_ofs lv_ntld_rgn_req_afs_swi t_vs_is_nt fac_maf_rel maf_sp map_drv1 map_sp pq_egr_sp maf_egr_neut_gas lv_tps_sub_diag_not_vld fac_maf_ad_thr_kwp fac_maf_ad_egr_kwp lv_vim_inh_cus lv_vim_1_cus lv_vim_2_cus lv_puc_lock_tnt tq_max_acc pwm_value_hiv_perc state_egy_cns_off state_engg_pos state_tq_wheel tq_wheel tq_max_wheel tq_min_wheel_l lv_can_snd_msg_pwr_mng_0 lv_can_snd_msg_pwr_mng_1 lv_oil_cns_warn_1 lv_oil_cns_warn_2 lv_ldm_off lv_gs_up lv_gs_down lv_ldm_driv_act gr_dt cur_rng_ctl pow_ctl_pri_peak_red pow_ctl_pri_peak_red_cft pow_ctl_park_cns pow_ctl_pwr_cns_1 pow_ctl_pwr_cns_2 idfbosmg_w lv_inh_dc_rbm lv_err_ftl_obd lv_err_ftl_can n_max_lih_state_cmb_s lv_cp_inh_cus mff_max_cp_cus mff_add_tq_cp state_nox_rpu nt_eff_cor_rpu nt_stc_bas_rpu ntl_rpu lv_rgn_nt_req_rpu lv_nt_afs_req_rpu lv_rgn_agi_rpu_1 lv_rgn_agi_rpu_2 lv_act_int_puc_afl_rpu_1 lv_act_int_puc_afl_rpu_2 lv_sens_afr_rpu_1 lv_sens_afr_rpu_2 lv_nt_req_rgn lamb_rgn_rpu_1 nox_cor_s_rpu lamb_rgn_rpu_2 tnt_mdl_1_1_rpu tnt_mdl_1_2_rpu tnt_mdl_2_1_rpu tnt_mdl_2_2_rpu teg_dyn_stop temp_cat teg_cat_down_mdl teg_cat_down_mdl_2 teg_dyn teg_cat_down_mdl_1_bas teg_cat_down_mdl_2_bas teg_wall_cat_up_mdl_2 teg_wall_cat_up_mdl_1 teg_wall_cat_down_mdl_1 teg_wall_cat_down_mdl_2 teg_cat_down_mdl_1 teg_cat_up_mdl_2 teg_cat_up_mdl_1 teg_stat_max_1 teg_stat_max_2 teg_stat_max lv_lamb_ohp_1 lv_lamb_ohp_2 tam_st tam_stop state_rbm_ftl_obd lv_err_map rfppwm wgpwm[0] wgpwm[1] lv_inh_puc_cus lv_err_map_dip_sens lv_err_map_dip_shift state_ivvt t_veh_pow_var_act lv_err_var_cod lv_err_veh_pow_var lv_pow_clas_veh_can_req lv_cat_conf_dis_ext_req state_mil_on_dis_ext_req pow_conf_idx_ext_req t_pow_clas_veh_can_req idx_var_cod[0] idx_var_cod[1] vin_sho[0] vin_sho[1] vin_sho[2] vin_sho[3] vin_sho[4] vin_sho[5] vin_sho[6] lv_inh_diag_amp_plaus state_rbm_amp_plaus lv_err_rly_crcv_heat cdn_diag_rly_crcv_heat lv_inh_diag_rly_crcv_heat loc_state_adaption /end OUT_MEASUREMENT
/end FUNCTION
/end MODULE
/end PROJECT
