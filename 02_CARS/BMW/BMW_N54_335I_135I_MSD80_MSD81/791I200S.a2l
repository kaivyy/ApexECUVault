ASAP2_VERSION 1 41
/begin PROJECT MSD85 "Spray Guided DI-System with Piezo Injectors for 8-Cylinder"
/begin HEADER "_default_HeaderComment" PROJECT_NO _91 /end HEADER
/begin MODULE _default_ModuleName "_default_ModuleLongIdentifier"
/begin MOD_COMMON "_default_ModCommonComment" DEPOSIT ABSOLUTE BYTE_ORDER MSB_LAST ALIGNMENT_BYTE 1 ALIGNMENT_WORD 2 ALIGNMENT_LONG 2 ALIGNMENT_FLOAT32_IEEE 2 ALIGNMENT_FLOAT64_IEEE 4 /end MOD_COMMON
/begin CHARACTERISTIC lc_cru_req_swi "Configuration switch between MSW and steering lever" VALUE 0xa080c542 _REC_VAL_20_u1 1. _CNV_A_R_LINEAR_____0_CM 0. 1. DISPLAY_IDENTIFIER LC_CRU_REQ_SWI FORMAT "%1.0" /end CHARACTERISTIC
/begin CHARACTERISTIC c_t_crus_on "Minimum recognition time on actuating the OFF button" VALUE 0xa080c14a _REC_VAL_20_u1 2550. _CNV_A_R_LINEAR_____20_CM 0. 2550. DISPLAY_IDENTIFIER C_T_CRUS_ON FORMAT "%4.0" /end CHARACTERISTIC
/begin MEASUREMENT lv_cru_main_swi "indicate CRU readiness" UBYTE _CNV_S_2_RANGE__0___1_CM 1 100. 0. 1. DISPLAY_IDENTIFIER LV_CRU_MAIN_SWI ECU_ADDRESS 0xd0008f11 BIT_MASK 0x1 /end MEASUREMENT
/begin MEASUREMENT req_msw "Evaluated Status of MSW request module" UBYTE _CNV_S_10_RANGE_REQ__21_CM 1 100. 0. 9. DISPLAY_IDENTIFIER REQ_MSW ECU_ADDRESS 0xd0008f10 /end MEASUREMENT
/begin CHARACTERISTIC c_t_ready_cru "Delay time after control unit initialization" VALUE 0xa080c262 _REC_VAL_20_u1 1550. _CNV_A_R_LINEAR_____20_CM 1000. 2550. DISPLAY_IDENTIFIER C_T_READY_CRU FORMAT "%5.0" /end CHARACTERISTIC
/begin CHARACTERISTIC c_t_crus "Minimum time between switch on ready and switch off ready" VALUE 0xa080c148 _REC_VAL_20_u1 2550. _CNV_A_R_LINEAR_____20_CM 0. 2550. DISPLAY_IDENTIFIER C_T_CRUS FORMAT "%4.0" /end CHARACTERISTIC
/begin CHARACTERISTIC c_t_crus_off "Minimum recognition time on actuating the OFF button to switch off the display for BN2000" VALUE 0xa080c149 _REC_VAL_20_u1 5100. _CNV_A_R_LINEAR_____23_CM 0. 5100. DISPLAY_IDENTIFIER C_T_CRUS_OFF FORMAT "%5.0" /end CHARACTERISTIC
/begin CHARACTERISTIC c_t_min_msw "time delay of REQ_MSW" VALUE 0xa080c225 _REC_VAL_20_u1 2.54 _CNV_A_R_LINEAR_____3_CM 1.e-002 2.55 DISPLAY_IDENTIFIER C_T_MIN_MSW FORMAT "%4.2" /end CHARACTERISTIC
/begin CHARACTERISTIC c_t_min_tip_msw "Time delay of REQ_MSW TIP detection" VALUE 0xa080c234 _REC_VAL_20_u1 2.55 _CNV_A_R_LINEAR_____3_CM 0. 2.55 DISPLAY_IDENTIFIER C_T_MIN_TIP_MSW FORMAT "%4.2" /end CHARACTERISTIC
/begin CHARACTERISTIC lc_crus_off_swi "Configuration switch to switch off the cruise control via MSW" VALUE 0xa080c543 _REC_VAL_20_u1 1. _CNV_A_R_LINEAR_____0_CM 0. 1. DISPLAY_IDENTIFIER LC_CRUS_OFF_SWI FORMAT "%1.0" /end CHARACTERISTIC
/begin CHARACTERISTIC c_t_cru_esp_off "minimum time before cut-off CRU in case of ESP intervention" VALUE 0xa080c146 _REC_VAL_20_u1 25.5 _CNV_A_R_LINEAR_____4_CM 0. 25.5 DISPLAY_IDENTIFIER C_T_CRU_ESP_OFF FORMAT "%4.1" /end CHARACTERISTIC
/begin CHARACTERISTIC c_t_cru_asr_off "minimum time before cut-off CRU in case of ASR intervention" VALUE 0xa080c144 _REC_VAL_20_u1 25.5 _CNV_A_R_LINEAR_____4_CM 0. 25.5 DISPLAY_IDENTIFIER C_T_CRU_ASR_OFF FORMAT "%4.1" /end CHARACTERISTIC
/begin CHARACTERISTIC c_t_cru_esp_brake_off "minimum time before cut-off CRU in case of ESP intervention only with brake" VALUE 0xa080c145 _REC_VAL_20_u1 25.5 _CNV_A_R_LINEAR_____4_CM 0. 25.5 DISPLAY_IDENTIFIER C_T_CRU_ESP_BRAKE_OFF FORMAT "%4.1" /end CHARACTERISTIC
/begin CHARACTERISTIC c_t_err_vs_can "minimum threshold time for error of vehicle speed from CAN" VALUE 0xa080c1b2 _REC_VAL_20_u1 25.5 _CNV_A_R_LINEAR_____4_CM 0. 25.5 DISPLAY_IDENTIFIER C_T_ERR_VS_CAN FORMAT "%4.1" /end CHARACTERISTIC
/begin MEASUREMENT ac_cru "Vehicle acceleration in CRU" SWORD _CNV_A_R_LINEAR_____88_CM 1 100. -15.719999999972 15.71952 DISPLAY_IDENTIFIER AC_CRU ECU_ADDRESS 0xd000ab8a FORMAT "%7.4" /end MEASUREMENT
/begin CHARACTERISTIC c_fac_vs_fil "Filter factor" VALUE 0xa080bd29 _REC_VAL_20_u1 255. _CNV_A_R_LINEAR_____0_CM 0. 255. DISPLAY_IDENTIFIER C_FAC_VS_FIL FORMAT "%3.0" /end CHARACTERISTIC
/begin CHARACTERISTIC c_vs_max_diag "Max. allowed deviation between VS_FIL and VS" VALUE 0xa080c4cb _REC_VAL_20_u1 255. _CNV_A_R_LINEAR_____6_CM 0. 255. DISPLAY_IDENTIFIER C_VS_MAX_DIAG FORMAT "%3.0" /end CHARACTERISTIC
/begin MEASUREMENT lv_vs_diag_not_plaus "VS_FIL not plausible" UBYTE _CNV_S_2_RANGE__0___1_CM 1 100. 0. 1. DISPLAY_IDENTIFIER LV_VS_DIAG_NOT_PLAUS ECU_ADDRESS 0xd0008ee8 BIT_MASK 0x1 /end MEASUREMENT
/begin MEASUREMENT lv_cru_off_by_asr_esp_ctl "Soft off condition depending on ASC interventions" UBYTE _CNV_S_2_RANGE__0___1_CM 1 100. 0. 1. DISPLAY_IDENTIFIER LV_CRU_OFF_BY_ASR_ESP_CTL ECU_ADDRESS 0xd0008ee9 BIT_MASK 0x1 /end MEASUREMENT
/begin CHARACTERISTIC c_fac_tq_req_driv_mmv "Filtering of driver demand" VALUE 0xa080bd16 _REC_VAL_20_u2 0.9999847412109381 _CNV_A_R_LINEAR_____89_CM 0. 0.9999847412109381 DISPLAY_IDENTIFIER C_FAC_TQ_REQ_DRIV_MMV FORMAT "%7.5" /end CHARACTERISTIC
/begin MEASUREMENT fac_tq_req_driv_mmv "MMV of driver torque demand" UWORD _CNV_A_R_LINEAR_____9_CM 1 100. 0. 1.99996948242188 DISPLAY_IDENTIFIER FAC_TQ_REQ_DRIV_MMV ECU_ADDRESS 0xd000ab90 FORMAT "%7.5" /end MEASUREMENT
/begin MEASUREMENT n_vs_cru "Ratio between engine speed and vehicle speed" UWORD _CNV_A_R_LINEAR_____90_CM 1 100. 0. 16320. DISPLAY_IDENTIFIER N_VS_CRU ECU_ADDRESS 0xd000ab8c FORMAT "%5.0" /end MEASUREMENT
/begin CHARACTERISTIC c_fac_ac_cru_mmv "Filtering AC_CRU" VALUE 0xa080bcae _REC_VAL_20_u2 0.9999847412109381 _CNV_A_R_LINEAR_____89_CM 0. 0.9999847412109381 DISPLAY_IDENTIFIER C_FAC_AC_CRU_MMV FORMAT "%7.5" /end CHARACTERISTIC
/begin CHARACTERISTIC lc_vs_cru_fil "Filter factor activation" VALUE 0xa080c623 _REC_VAL_20_u1 1. _CNV_A_R_LINEAR_____0_CM 0. 1. DISPLAY_IDENTIFIER LC_VS_CRU_FIL FORMAT "%1.0" /end CHARACTERISTIC
/begin CHARACTERISTIC c_crlc_vs_cru_mmv "Filter factor" VALUE 0xa080bb1e _REC_VAL_20_u2 0.9999847412109381 _CNV_A_R_LINEAR_____91_CM 0. 0.9999847412109381 DISPLAY_IDENTIFIER C_CRLC_VS_CRU_MMV FORMAT "%7.5" /end CHARACTERISTIC
/begin MEASUREMENT vs_fil "Filtered vehicle speed" UWORD _CNV_A_R_LINEAR_____86_CM 1 100. 0. 511.99218 DISPLAY_IDENTIFIER VS_FIL ECU_ADDRESS 0xd000ab84 FORMAT "%7.3" /end MEASUREMENT
/begin MEASUREMENT t_err_vs_can "Time to freeze VS_FIL before VS_FIL = 0" UWORD _CNV_A_R_LINEAR_____92_CM 1 100. 0. 65535. DISPLAY_IDENTIFIER T_ERR_VS_CAN ECU_ADDRESS 0xd000ab86 FORMAT "%5.0" /end MEASUREMENT
/begin MEASUREMENT vs_cru "Filtered vehicle speed" UWORD _CNV_A_R_LINEAR_____86_CM 1 100. 0. 511.99218 DISPLAY_IDENTIFIER VS_CRU ECU_ADDRESS 0xd000ab88 FORMAT "%7.3" /end MEASUREMENT
/begin MEASUREMENT vs_dif_icl_tcs "Difference of vehicle speed INSTR and TCS" SWORD _CNV_A_R_LINEAR_____93_CM 1 100. -256. 255.9921875 DISPLAY_IDENTIFIER VS_DIF_ICL_TCS ECU_ADDRESS 0xd0000520 FORMAT "%7.3" /end MEASUREMENT
/begin CHARACTERISTIC c_t_vs_diag_not_plaus "debounce time for setting VS_CRU not plausible" VALUE 0xa080c29c _REC_VAL_20_u1 25.5 _CNV_A_R_LINEAR_____4_CM 0. 25.5 DISPLAY_IDENTIFIER C_T_VS_DIAG_NOT_PLAUS FORMAT "%4.1" /end CHARACTERISTIC
/begin MEASUREMENT req_cru "Request of cruise control functionality" UBYTE _CNV_S_8_RANGE_REQ__94_CM 1 100. 0. 7. DISPLAY_IDENTIFIER REQ_CRU ECU_ADDRESS 0xd0008eec /end MEASUREMENT
/begin MEASUREMENT lv_cru_off_irr "Irreversible cut off conditions for cruise control" UBYTE _CNV_S_2_RANGE__0___1_CM 1 100. 0. 1. DISPLAY_IDENTIFIER LV_CRU_OFF_IRR ECU_ADDRESS 0xd0008eef BIT_MASK 0x1 /end MEASUREMENT
/begin CHARACTERISTIC c_vs_min_plaus_cru "Vehicle speed condition for VS_FIL" VALUE 0xa080c4e2 _REC_VAL_20_u2 511.99218 _CNV_A_R_LINEAR_____86_CM 0. 511.99218 DISPLAY_IDENTIFIER C_VS_MIN_PLAUS_CRU FORMAT "%7.3" /end CHARACTERISTIC
/begin MEASUREMENT t_dly_cru "Time counter overtaking" UWORD _CNV_A_R_LINEAR_____3_CM 1 100. 0. 655.35 DISPLAY_IDENTIFIER T_DLY_CRU ECU_ADDRESS 0xd0000528 FORMAT "%5.2" /end MEASUREMENT
/begin MEASUREMENT lv_cru_over_act "Overtaking function active" UBYTE _CNV_S_2_RANGE__0___1_CM 1 100. 0. 1. DISPLAY_IDENTIFIER LV_CRU_OVER_ACT ECU_ADDRESS 0xd0008ef0 BIT_MASK 0x1 /end MEASUREMENT
/begin CHARACTERISTIC c_t_dly_vs_sp_cru_max "Max .time for VS more than  VS max at CRU" VALUE 0xa080c192 _REC_VAL_20_u1 255. _CNV_A_R_LINEAR_____36_CM 0. 255. DISPLAY_IDENTIFIER C_T_DLY_VS_SP_CRU_MAX FORMAT "%3.0" /end CHARACTERISTIC
/begin CHARACTERISTIC c_t_dly_max_cru "Delay threshold for start of the restart function" VALUE 0xa080c184 _REC_VAL_20_u2 655.35 _CNV_A_R_LINEAR_____3_CM 0. 655.35 DISPLAY_IDENTIFIER C_T_DLY_MAX_CRU FORMAT "%6.2" /end CHARACTERISTIC
/begin CHARACTERISTIC c_n_vs_max_cru "Threshold value for hard cut-off" VALUE 0xa080bfdf _REC_VAL_20_u1 99.609375 _CNV_A_R_LINEAR_____5_CM 0. 99.609375 DISPLAY_IDENTIFIER C_N_VS_MAX_CRU FORMAT "%4.1" /end CHARACTERISTIC
/begin CHARACTERISTIC c_vs_sp_dif_min_cru "Min. deviation between target and actual speed" VALUE 0xa080c4fa _REC_VAL_20_s2 511.9921875 _CNV_A_R_LINEAR_____93_CM -256. 255.9921875 DISPLAY_IDENTIFIER C_VS_SP_DIF_MIN_CRU FORMAT "%7.3" /end CHARACTERISTIC
/begin CHARACTERISTIC c_vs_sp_dif_max_cru "Max. deviation between target and actual speed" VALUE 0xa080c4f8 _REC_VAL_20_s2 511.9921875 _CNV_A_R_LINEAR_____93_CM -256. 255.9921875 DISPLAY_IDENTIFIER C_VS_SP_DIF_MAX_CRU FORMAT "%7.3" /end CHARACTERISTIC
/begin MEASUREMENT lv_cru_act "Intervention of cruise control" UBYTE _CNV_S_2_RANGE__0___1_CM 1 100. 0. 1. DISPLAY_IDENTIFIER LV_CRU_ACT ECU_ADDRESS 0xd0008ef1 BIT_MASK 0x1 /end MEASUREMENT
/begin CHARACTERISTIC c_vs_dif_dly_cru_neg "Max. difference from VS_SP_DRIV_CRU and C_VS_DIF_DLY_CRU" VALUE 0xa080c492 _REC_VAL_20_u2 255.9921875 _CNV_A_R_LINEAR_____93_CM 0. 255.9921875 DISPLAY_IDENTIFIER C_VS_DIF_DLY_CRU_NEG FORMAT "%7.3" /end CHARACTERISTIC
/begin CHARACTERISTIC c_fac_tq_req_hys_cru "FAC_TQ_REQ hysteresis for start of the restart function" VALUE 0xa080bd22 _REC_VAL_20_u2 1.99996948242188 _CNV_A_R_LINEAR_____9_CM 0. 1.99996948242188 DISPLAY_IDENTIFIER C_FAC_TQ_REQ_HYS_CRU FORMAT "%7.5" /end CHARACTERISTIC
/begin CHARACTERISTIC c_ac_max_cru "Max. acceleration" VALUE 0xa080ba64 _REC_VAL_20_u2 15.71952 _CNV_A_R_LINEAR_____95_CM 0. 15.71952 DISPLAY_IDENTIFIER C_AC_MAX_CRU FORMAT "%7.4" /end CHARACTERISTIC
/begin MEASUREMENT state_cru_can "Status of cruise control to the CAN- Message" UBYTE _CNV_S_8_RANGE_STAT_96_CM 1 100. 0. 7. DISPLAY_IDENTIFIER STATE_CRU_CAN ECU_ADDRESS 0xd0008eed /end MEASUREMENT
/begin MEASUREMENT state_cru_off_rev "Status switch off conditions reversible" UWORD _CNV_A_R_LINEAR_____50_CM 1 100. 0. 65535. DISPLAY_IDENTIFIER STATE_CRU_OFF_REV ECU_ADDRESS 0xd000ab96 FORMAT "%5.0" /end MEASUREMENT
/begin MEASUREMENT state_cru_off_irr "Status switch off conditions irreversible" UWORD _CNV_A_R_LINEAR_____50_CM 1 100. 0. 65535. DISPLAY_IDENTIFIER STATE_CRU_OFF_IRR ECU_ADDRESS 0xd000ab94 FORMAT "%5.0" /end MEASUREMENT
/begin CHARACTERISTIC c_vs_dif_dly_cru_pos "Maximum difference from VS_SP_DRIV_CRU and C_VS_DIF_DLY_CRU" VALUE 0xa080c494 _REC_VAL_20_s2 255.9922 _CNV_A_R_LINEAR_____97_CM -255.9922 0. DISPLAY_IDENTIFIER C_VS_DIF_DLY_CRU_POS FORMAT "%7.3" /end CHARACTERISTIC
/begin CHARACTERISTIC c_vs_dif_min_cru_over "Vs_dif_cru min value vor finished overtaking function" VALUE 0xa080c49e _REC_VAL_20_s2 511.9921875 _CNV_A_R_LINEAR_____93_CM -256. 255.9921875 DISPLAY_IDENTIFIER C_VS_DIF_MIN_CRU_OVER FORMAT "%7.3" /end CHARACTERISTIC
/begin CHARACTERISTIC c_vs_min_cru_m "Vehicle speed conditions for vs_cru in case of mile - ICL" VALUE 0xa080c4d6 _REC_VAL_20_u2 511.99218 _CNV_A_R_LINEAR_____86_CM 0. 511.99218 DISPLAY_IDENTIFIER C_VS_MIN_CRU_M FORMAT "%7.3" /end CHARACTERISTIC
/begin CHARACTERISTIC c_vs_min_cru_k "Vehicle speed conditions for vs_cru in case of km - ICL" VALUE 0xa080c4d4 _REC_VAL_20_u2 511.99218 _CNV_A_R_LINEAR_____86_CM 0. 511.99218 DISPLAY_IDENTIFIER C_VS_MIN_CRU_K FORMAT "%7.3" /end CHARACTERISTIC
/begin MEASUREMENT vs_min_cru "Minimal Vehicle speed conditions for VS_CRU" UWORD _CNV_A_R_LINEAR_____86_CM 1 100. 0. 511.99218 DISPLAY_IDENTIFIER VS_MIN_CRU ECU_ADDRESS 0xd000ab98 FORMAT "%7.3" /end MEASUREMENT
/begin MEASUREMENT lv_cru_act_inh "Intervention of cruise control inhibited due to environmental conditions" UBYTE _CNV_S_2_RANGE__0___1_CM 1 100. 0. 1. DISPLAY_IDENTIFIER LV_CRU_ACT_INH ECU_ADDRESS 0xd0008ef2 BIT_MASK 0x1 /end MEASUREMENT
/begin MEASUREMENT vs_dif_i_cru "Sum of the control deviations" SWORD _CNV_A_R_LINEAR_____93_CM 1 100. -256. 255.9921875 DISPLAY_IDENTIFIER VS_DIF_I_CRU ECU_ADDRESS 0xd000053a FORMAT "%7.3" /end MEASUREMENT
/begin MEASUREMENT t_ctl_cru "Time of the controlled acceleration" UBYTE _CNV_A_R_LINEAR_____4_CM 1 100. 0. 25.5 DISPLAY_IDENTIFIER T_CTL_CRU ECU_ADDRESS 0xd0000542 FORMAT "%4.1" /end MEASUREMENT
/begin MEASUREMENT vs_sp_cru "Reference input variable of the controller" UWORD _CNV_A_R_LINEAR_____86_CM 1 100. 0. 511.99218 DISPLAY_IDENTIFIER VS_SP_CRU ECU_ADDRESS 0xd000aba2 FORMAT "%7.3" /end MEASUREMENT
/begin MEASUREMENT vs_sp_dif_cru "Target variable/reference input variable difference" SWORD _CNV_A_R_LINEAR_____93_CM 1 100. -256. 255.9921875 DISPLAY_IDENTIFIER VS_SP_DIF_CRU ECU_ADDRESS 0xd000053c FORMAT "%7.3" /end MEASUREMENT
/begin MEASUREMENT vs_sp_inc_cru "Increment for VS_SP_CRU" UWORD _CNV_A_R_LINEAR_____86_CM 1 100. 0. 511.99218 DISPLAY_IDENTIFIER VS_SP_INC_CRU ECU_ADDRESS 0xd0000538 FORMAT "%7.3" /end MEASUREMENT
/begin MEASUREMENT vs_sp_dec_cru "Decrement for VS_SP_CRU" UWORD _CNV_A_R_LINEAR_____86_CM 1 100. 0. 511.99218 DISPLAY_IDENTIFIER VS_SP_DEC_CRU ECU_ADDRESS 0xd0000536 FORMAT "%7.3" /end MEASUREMENT
/begin MEASUREMENT vs_sp_driv_cru "Driver wish target variable" UWORD _CNV_A_R_LINEAR_____86_CM 1 100. 0. 511.99218 DISPLAY_IDENTIFIER VS_SP_DRIV_CRU ECU_ADDRESS 0xd000aba4 FORMAT "%7.3" /end MEASUREMENT
/begin CHARACTERISTIC c_vs_dif_min_is_cru "Threshold of the control deviation for zero setting of PV_CRU" VALUE 0xa080c4a0 _REC_VAL_20_s2 511.9921875 _CNV_A_R_LINEAR_____93_CM -256. 255.9921875 DISPLAY_IDENTIFIER C_VS_DIF_MIN_IS_CRU FORMAT "%7.3" /end CHARACTERISTIC
/begin CHARACTERISTIC c_vs_dif_max_is_cru "Threshold of the control deviation for PUC end" VALUE 0xa080c49a _REC_VAL_20_s2 511.9921875 _CNV_A_R_LINEAR_____93_CM -256. 255.9921875 DISPLAY_IDENTIFIER C_VS_DIF_MAX_IS_CRU FORMAT "%7.3" /end CHARACTERISTIC
/begin CHARACTERISTIC c_vs_dif_max_ac_cru "Condition for interrupting the incrementation or decrementation" VALUE 0xa080c496 _REC_VAL_20_s2 511.9921875 _CNV_A_R_LINEAR_____93_CM -256. 255.9921875 DISPLAY_IDENTIFIER C_VS_DIF_MAX_AC_CRU FORMAT "%7.3" /end CHARACTERISTIC
/begin CHARACTERISTIC c_vs_dif_min_ac_cru "Condition for interrupting the incrementation or decrementation" VALUE 0xa080c49c _REC_VAL_20_s2 511.9921875 _CNV_A_R_LINEAR_____93_CM -256. 255.9921875 DISPLAY_IDENTIFIER C_VS_DIF_MIN_AC_CRU FORMAT "%7.3" /end CHARACTERISTIC
/begin CHARACTERISTIC c_vs_ac_min_cru "Vehicle speed threshold for acceleration valuation" VALUE 0xa080c489 _REC_VAL_20_u1 255. _CNV_A_R_LINEAR_____6_CM 0. 255. DISPLAY_IDENTIFIER C_VS_AC_MIN_CRU FORMAT "%3.0" /end CHARACTERISTIC
/begin CHARACTERISTIC c_vs_ac_max_cru "Vehicle speed threshold for acceleration valuation" VALUE 0xa080c488 _REC_VAL_20_u1 255. _CNV_A_R_LINEAR_____6_CM 0. 255. DISPLAY_IDENTIFIER C_VS_AC_MAX_CRU FORMAT "%3.0" /end CHARACTERISTIC
/begin CHARACTERISTIC c_vs_dif_max_cru "Control difference threshold for incrementing VS_SP_CRU" VALUE 0xa080c498 _REC_VAL_20_u1 31.875 _CNV_A_R_LINEAR_____98_CM 0. 31.875 DISPLAY_IDENTIFIER C_VS_DIF_MAX_CRU /end CHARACTERISTIC
/begin CHARACTERISTIC c_ac_pos_cru_tip "Positive acceleration for Tip-up" VALUE 0xa080ba74 _REC_VAL_20_u2 511.9789 _CNV_A_R_LINEAR_____99_CM 0. 511.9789 DISPLAY_IDENTIFIER C_AC_POS_CRU_TIP FORMAT "%6.2" /end CHARACTERISTIC
/begin CHARACTERISTIC c_ac_neg_cru_tip "Negative acceleration for Tip-up" VALUE 0xa080ba68 _REC_VAL_20_u2 511.9789 _CNV_A_R_LINEAR_____99_CM 0. 511.9789 DISPLAY_IDENTIFIER C_AC_NEG_CRU_TIP FORMAT "%6.2" /end CHARACTERISTIC
/begin CHARACTERISTIC c_ac_neg_cru_deacc "Negative acceleration in deceleration" VALUE 0xa080ba66 _REC_VAL_20_u2 511.9789 _CNV_A_R_LINEAR_____99_CM 0. 511.9789 DISPLAY_IDENTIFIER C_AC_NEG_CRU_DEACC FORMAT "%6.2" /end CHARACTERISTIC
/begin CHARACTERISTIC c_ac_pos_cru_deacc "Positive acceleration" VALUE 0xa080ba6e _REC_VAL_20_u2 511.9789 _CNV_A_R_LINEAR_____99_CM 0. 511.9789 DISPLAY_IDENTIFIER C_AC_POS_CRU_DEACC FORMAT "%6.2" /end CHARACTERISTIC
/begin CHARACTERISTIC ip_fac_cru_rest__t_ctl_cru "Correction factor of in/decrementing (xx = --, CC; yy = REST, AC, DEACC)" CURVE 0xa080a2d8 _REC_CUR_20_u1_u1 1.99220002 _CNV_A_R_LINEAR_____100_CM 0. 1.99220002 DISPLAY_IDENTIFIER IP_FAC_CRU_REST__T_CTL_CRU FORMAT "%5.3"
 /begin AXIS_DESCR COM_AXIS t_ctl_cru _CNV_A_R_LINEAR_____4_CM 5 0. 25.5 FORMAT "%4.1" AXIS_PTS_REF ldpm_t_ctl_cru_1 /end AXIS_DESCR
/end CHARACTERISTIC
/begin CHARACTERISTIC ip_fac_cru_ac__t_ctl_cru "Correction factor of in/decrementing (xx = --, CC; yy = REST, AC, DEACC)" CURVE 0xa080a2cc _REC_CUR_20_u1_u1 1.99220002 _CNV_A_R_LINEAR_____100_CM 0. 1.99220002 DISPLAY_IDENTIFIER IP_FAC_CRU_AC__T_CTL_CRU FORMAT "%5.3"
 /begin AXIS_DESCR COM_AXIS t_ctl_cru _CNV_A_R_LINEAR_____4_CM 5 0. 25.5 FORMAT "%4.1" AXIS_PTS_REF ldpm_t_ctl_cru_1 /end AXIS_DESCR
/end CHARACTERISTIC
/begin CHARACTERISTIC ip_fac_cru_dece__t_ctl_cru "Correction factor of in/decrementing (xx = --, CC; yy = REST, AC, DEACC)" CURVE 0xa080a2d2 _REC_CUR_20_u1_u1 1.99220002 _CNV_A_R_LINEAR_____100_CM 0. 1.99220002 DISPLAY_IDENTIFIER IP_FAC_CRU_DECE__T_CTL_CRU FORMAT "%5.3"
 /begin AXIS_DESCR COM_AXIS t_ctl_cru _CNV_A_R_LINEAR_____4_CM 5 0. 25.5 FORMAT "%4.1" AXIS_PTS_REF ldpm_t_ctl_cru_1 /end AXIS_DESCR
/end CHARACTERISTIC
/begin CHARACTERISTIC ip_fac_lgrd_cru_rest__vs_sp_dif "Interception factor of the in/decrementing (xx = REST, TIP)" CURVE 0xa080a358 _REC_CUR_20_u1_u2 0.99609375 _CNV_A_R_LINEAR_____28_CM 0. 0.99609375 DISPLAY_IDENTIFIER IP_FAC_LGRD_CRU_REST__VS_SP_DIF FORMAT "%5.3"
 /begin AXIS_DESCR COM_AXIS vs_sp_dif_cru _CNV_A_R_LINEAR_____101_CM 5 -256. 255.9921875 FORMAT "%7.3" AXIS_PTS_REF ldpm_vs_sp_dif_cru_1 /end AXIS_DESCR
/end CHARACTERISTIC
/begin CHARACTERISTIC ip_fac_lgrd_cru_tip__vs_sp_dif "Interception factor of the in/decrementing (xx = REST, TIP)" CURVE 0xa080a35e _REC_CUR_20_u1_u2 0.99609375 _CNV_A_R_LINEAR_____28_CM 0. 0.99609375 DISPLAY_IDENTIFIER IP_FAC_LGRD_CRU_TIP__VS_SP_DIF FORMAT "%5.3"
 /begin AXIS_DESCR COM_AXIS vs_sp_dif_cru _CNV_A_R_LINEAR_____101_CM 5 -256. 255.9921875 FORMAT "%7.3" AXIS_PTS_REF ldpm_vs_sp_dif_cru_1 /end AXIS_DESCR
/end CHARACTERISTIC
/begin CHARACTERISTIC c_t_min_cru_con "Time condition for controlled acceleration" VALUE 0xa080c20e _REC_VAL_20_u1 25.5 _CNV_A_R_LINEAR_____4_CM 0. 25.5 DISPLAY_IDENTIFIER C_T_MIN_CRU_CON FORMAT "%4.1" /end CHARACTERISTIC
/begin CHARACTERISTIC ip_fac_cc_cru_ac__t_ctl_cru "Correction factor of in/decrementing (xx = --, CC; yy = REST, AC, DEACC)" CURVE 0xa080a29c _REC_CUR_20_u1_u1 1.99220002 _CNV_A_R_LINEAR_____100_CM 0. 1.99220002 DISPLAY_IDENTIFIER IP_FAC_CC_CRU_AC__T_CTL_CRU FORMAT "%5.3"
 /begin AXIS_DESCR COM_AXIS t_ctl_cru _CNV_A_R_LINEAR_____4_CM 5 0. 25.5 FORMAT "%4.1" AXIS_PTS_REF ldpm_t_ctl_cru_1 /end AXIS_DESCR
/end CHARACTERISTIC
/begin CHARACTERISTIC ip_fac_cc_cru_dece__t_ctl_cru "Correction factor of in/decrementing (xx = --, CC; yy = REST, AC, DEACC)" CURVE 0xa080a2a2 _REC_CUR_20_u1_u1 1.99220002 _CNV_A_R_LINEAR_____100_CM 0. 1.99220002 DISPLAY_IDENTIFIER IP_FAC_CC_CRU_DECE__T_CTL_CRU FORMAT "%5.3"
 /begin AXIS_DESCR COM_AXIS t_ctl_cru _CNV_A_R_LINEAR_____4_CM 5 0. 25.5 FORMAT "%4.1" AXIS_PTS_REF ldpm_t_ctl_cru_1 /end AXIS_DESCR
/end CHARACTERISTIC
/begin CHARACTERISTIC c_vs_dif_rng_cru "Bandwidth for reducing the control deviation" VALUE 0xa080c4a2 _REC_VAL_20_u2 511.99218 _CNV_A_R_LINEAR_____86_CM 0. 511.99218 DISPLAY_IDENTIFIER C_VS_DIF_RNG_CRU FORMAT "%7.3" /end CHARACTERISTIC
/begin MEASUREMENT state_cru "Status of cruise control to the CAN- Message" UBYTE _CNV_S_6_RANGE_STAT_102_CM 1 100. 0. 9. DISPLAY_IDENTIFIER STATE_CRU ECU_ADDRESS 0xd0008ef4 /end MEASUREMENT
/begin MEASUREMENT fac_vs_lgrd_cru "Factor for intercepting the reference input variable" UBYTE _CNV_A_R_LINEAR_____18_CM 1 100. 0. 0.99610001 DISPLAY_IDENTIFIER FAC_VS_LGRD_CRU ECU_ADDRESS 0xd0000540 FORMAT "%5.3" /end MEASUREMENT
/begin MEASUREMENT fac_vs_ctl_cru "Correction factor for actuating the reference input variable" UBYTE _CNV_A_R_LINEAR_____103_CM 1 100. 0. 1.9921875 DISPLAY_IDENTIFIER FAC_VS_CTL_CRU ECU_ADDRESS 0xd0000541 FORMAT "%5.3" /end MEASUREMENT
/begin CHARACTERISTIC c_t_min_puc_cru "Time after entry into controlled constant drive" VALUE 0xa080c230 _REC_VAL_20_u1 25.5 _CNV_A_R_LINEAR_____4_CM 0. 25.5 DISPLAY_IDENTIFIER C_T_MIN_PUC_CRU FORMAT "%4.1" /end CHARACTERISTIC
/begin MEASUREMENT vs_dif_cru "Control deviation" SWORD _CNV_A_R_LINEAR_____93_CM 1 100. -256. 255.9921875 DISPLAY_IDENTIFIER VS_DIF_CRU ECU_ADDRESS 0xd000aba6 FORMAT "%7.3" /end MEASUREMENT
/begin MEASUREMENT fac_tq_cru_ini "CRU control variable initialisation value" UWORD _CNV_A_R_LINEAR_____8_CM 1 100. 0. 99.99847412109381 DISPLAY_IDENTIFIER FAC_TQ_CRU_INI ECU_ADDRESS 0xd0000530 /end MEASUREMENT
/begin CHARACTERISTIC ip_fac_prop_cru "Proportional coefficient of the PI controller" MAP 0xa080a41c _REC_MAP_20_u2_u2_u2 49.999237 _CNV_A_R_LINEAR_____104_CM 0. 49.999237 DISPLAY_IDENTIFIER IP_FAC_PROP_CRU FORMAT "%7.4"
 /begin AXIS_DESCR COM_AXIS vs_sp_cru _CNV_A_R_LINEAR_____86_CM 5 0. 511.99218 FORMAT "%7.3" AXIS_PTS_REF ldpm_vs_sp_cru_1 /end AXIS_DESCR
 /begin AXIS_DESCR COM_AXIS vs_dif_cru _CNV_A_R_LINEAR_____101_CM 4 -256. 255.9921875 FORMAT "%7.3" AXIS_PTS_REF ldp_vs_dif_cru__fac_prop_cru /end AXIS_DESCR
/end CHARACTERISTIC
/begin CHARACTERISTIC ip_fac_tq_cru_ini_add_at "Additive torque based on gear and acceleration" MAP 0xa0814644 _REC_MAP_20_u2_u2_u1 400. _CNV_A_R_LINEAR_____105_CM -200. 200. DISPLAY_IDENTIFIER IP_FAC_TQ_CRU_INI_ADD_AT FORMAT "%8.3"
 /begin AXIS_DESCR COM_AXIS ac_cru _CNV_A_R_LINEAR_____106_CM 6 -15.72 15.71952 FORMAT "%8.4" AXIS_PTS_REF ldpm_ac_cru__fac_tq_cru /end AXIS_DESCR
 /begin AXIS_DESCR COM_AXIS gear _CNV_A_R_LINEAR_____0_CM 12 0. 255. FORMAT "%3.0" AXIS_PTS_REF ldpm_gear__fac_tq_cru /end AXIS_DESCR
/end CHARACTERISTIC
/begin CHARACTERISTIC ip_fac_tq_cru_ini_add_mt "Additive torque based on gear and acceleration" MAP 0xa08146d4 _REC_MAP_20_u2_u2_u1 400. _CNV_A_R_LINEAR_____105_CM -200. 200. DISPLAY_IDENTIFIER IP_FAC_TQ_CRU_INI_ADD_MT FORMAT "%8.3"
 /begin AXIS_DESCR COM_AXIS ac_cru _CNV_A_R_LINEAR_____106_CM 6 -15.72 15.71952 FORMAT "%8.4" AXIS_PTS_REF ldpm_ac_cru__fac_tq_cru /end AXIS_DESCR
 /begin AXIS_DESCR COM_AXIS gear _CNV_A_R_LINEAR_____0_CM 12 0. 255. FORMAT "%3.0" AXIS_PTS_REF ldpm_gear__fac_tq_cru /end AXIS_DESCR
/end CHARACTERISTIC
/begin CHARACTERISTIC c_fac_vs_dif_rng_cru "Reduction factor for the control deviation VS_DIF_CRU" VALUE 0xa080bd28 _REC_VAL_20_u1 0.99610001 _CNV_A_R_LINEAR_____18_CM 0. 0.99610001 DISPLAY_IDENTIFIER C_FAC_VS_DIF_RNG_CRU FORMAT "%5.3" /end CHARACTERISTIC
/begin CHARACTERISTIC ip_fac_tq_cru_dec__n_32 "Decrement of the FAC_TQ_CRU" CURVE 0xa080a96c _REC_CUR_20_u2_u1 99.99847412109381 _CNV_A_R_LINEAR_____8_CM 0. 99.99847412109381 DISPLAY_IDENTIFIER IP_FAC_TQ_CRU_DEC__N_32
 /begin AXIS_DESCR COM_AXIS n_32 _CNV_A_R_LINEAR_____10_CM 5 0. 8160. FORMAT "%4.0" AXIS_PTS_REF ldp_n_32__fac_tq_cru /end AXIS_DESCR
/end CHARACTERISTIC
/begin CHARACTERISTIC ip_ac_neg_cru_ac__n__fac_tq_cru "negative acceleration in setting" MAP 0xa0809f44 _REC_MAP_20_u2_u1_u2 511.9789 _CNV_A_R_LINEAR_____99_CM 0. 511.9789 DISPLAY_IDENTIFIER IP_AC_NEG_CRU_AC__N__FAC_TQ_CRU FORMAT "%6.2"
 /begin AXIS_DESCR COM_AXIS n_32 _CNV_A_R_LINEAR_____10_CM 3 0. 8160. FORMAT "%4.0" AXIS_PTS_REF ldpm_n_21 /end AXIS_DESCR
 /begin AXIS_DESCR COM_AXIS fac_tq_cru _CNV_A_R_LINEAR_____8_CM 3 0. 99.99847412109381 AXIS_PTS_REF ldpm_fac_tq_cru_1 /end AXIS_DESCR
/end CHARACTERISTIC
/begin CHARACTERISTIC ip_fac_vs_dif_i_cru "Delta VS_SP_CRU correction" MAP 0xa080ac14 _REC_MAP_20_u2_u2_u2 0.9999847412109381 _CNV_A_R_LINEAR_____89_CM 0. 0.9999847412109381 DISPLAY_IDENTIFIER IP_FAC_VS_DIF_I_CRU FORMAT "%7.5"
 /begin AXIS_DESCR COM_AXIS vs_sp_cru _CNV_A_R_LINEAR_____86_CM 5 0. 511.99218 FORMAT "%7.3" AXIS_PTS_REF ldpm_vs_sp_cru_1 /end AXIS_DESCR
 /begin AXIS_DESCR COM_AXIS vs_dif_cru _CNV_A_R_LINEAR_____101_CM 4 -256. 255.9921875 FORMAT "%7.3" AXIS_PTS_REF ldp_vs_dif_cru__fac_prop_cru /end AXIS_DESCR
/end CHARACTERISTIC
/begin CHARACTERISTIC ip_fac_vs_sp_dif_i_cru "Delta VS_SP_CRU correction" CURVE 0xa080ac60 _REC_CUR_20_u2_u2 1.99996948242188 _CNV_A_R_LINEAR_____9_CM 0. 1.99996948242188 DISPLAY_IDENTIFIER IP_FAC_VS_SP_DIF_I_CRU FORMAT "%7.5"
 /begin AXIS_DESCR COM_AXIS vs_sp_cru _CNV_A_R_LINEAR_____86_CM 5 0. 511.99218 FORMAT "%7.3" AXIS_PTS_REF ldpm_vs_sp_cru_1 /end AXIS_DESCR
/end CHARACTERISTIC
/begin CHARACTERISTIC c_vs_dif_delta_i "Positive acceleration" VALUE 0xa080c490 _REC_VAL_20_u1 63.75 _CNV_A_R_LINEAR_____107_CM 0. 63.75 DISPLAY_IDENTIFIER C_VS_DIF_DELTA_I /end CHARACTERISTIC
/begin CHARACTERISTIC c_fac_tq_cru_max "Maximum request of Cruise Control" VALUE 0xa080bd04 _REC_VAL_20_u2 99.99847412109381 _CNV_A_R_LINEAR_____108_CM 0. 99.99847412109381 DISPLAY_IDENTIFIER C_FAC_TQ_CRU_MAX /end CHARACTERISTIC
/begin CHARACTERISTIC c_fac_ac_pos_cru "Maximum reduction of FAC_VS_LGRD_CRU" VALUE 0xa080bcb0 _REC_VAL_20_u1 0.99609375 _CNV_A_R_LINEAR_____28_CM 0. 0.99609375 DISPLAY_IDENTIFIER C_FAC_AC_POS_CRU FORMAT "%5.3" /end CHARACTERISTIC
/begin CHARACTERISTIC c_fac_ac_pos_cru_rng_l "Maximum reduction of FAC_VS_LGRD_CRU at RNG_L" VALUE 0xa080bcb1 _REC_VAL_20_u1 0.99609375 _CNV_A_R_LINEAR_____28_CM 0. 0.99609375 DISPLAY_IDENTIFIER C_FAC_AC_POS_CRU_RNG_L FORMAT "%5.3" /end CHARACTERISTIC
/begin CHARACTERISTIC c_ac_pos_cru_resu "Positive acceleration at CRU resume" VALUE 0xa080ba70 _REC_VAL_20_u2 511.9789 _CNV_A_R_LINEAR_____99_CM 0. 511.9789 DISPLAY_IDENTIFIER C_AC_POS_CRU_RESU FORMAT "%6.2" /end CHARACTERISTIC
/begin CHARACTERISTIC c_ac_pos_cru_resu_rng_l "Positive acceleration at CRU resume at RNG_L" VALUE 0xa080ba72 _REC_VAL_20_u2 511.9789 _CNV_A_R_LINEAR_____99_CM 0. 511.9789 DISPLAY_IDENTIFIER C_AC_POS_CRU_RESU_RNG_L FORMAT "%6.2" /end CHARACTERISTIC
/begin CHARACTERISTIC c_ac_pos_cru_ac "Positive acceleration in setting/acceleration" VALUE 0xa080ba6a _REC_VAL_20_u2 511.9789 _CNV_A_R_LINEAR_____99_CM 0. 511.9789 DISPLAY_IDENTIFIER C_AC_POS_CRU_AC FORMAT "%6.2" /end CHARACTERISTIC
/begin CHARACTERISTIC c_ac_pos_cru_ac_rng_l "Positive acceleration in setting/acceleration at RNG_L" VALUE 0xa080ba6c _REC_VAL_20_u2 511.9789 _CNV_A_R_LINEAR_____99_CM 0. 511.9789 DISPLAY_IDENTIFIER C_AC_POS_CRU_AC_RNG_L FORMAT "%6.2" /end CHARACTERISTIC
/begin MEASUREMENT fac_tq_cru "CRU control variable" UWORD _CNV_A_R_LINEAR_____8_CM 1 100. 0. 99.99847412109381 DISPLAY_IDENTIFIER FAC_TQ_CRU ECU_ADDRESS 0xd000aba0 /end MEASUREMENT
/begin MEASUREMENT state_i_cru "Condition of I Share VS_DIF_I_CRU" UBYTE _CNV_S_4_STATE_I_CR_109_CM 1 100. 0. 3. DISPLAY_IDENTIFIER STATE_I_CRU ECU_ADDRESS 0xd0000543 /end MEASUREMENT
/begin CHARACTERISTIC ip_ac_neg_cru_resu "negative acceleration at CRU resume" MAP 0xa0809f58 _REC_MAP_20_u2_u1_u2 511.9789 _CNV_A_R_LINEAR_____99_CM 0. 511.9789 DISPLAY_IDENTIFIER IP_AC_NEG_CRU_RESU FORMAT "%6.2"
 /begin AXIS_DESCR COM_AXIS n_32 _CNV_A_R_LINEAR_____10_CM 3 0. 8160. FORMAT "%4.0" AXIS_PTS_REF ldpm_n_21 /end AXIS_DESCR
 /begin AXIS_DESCR COM_AXIS fac_tq_cru _CNV_A_R_LINEAR_____8_CM 3 0. 99.99847412109381 AXIS_PTS_REF ldpm_fac_tq_cru_1 /end AXIS_DESCR
/end CHARACTERISTIC
/begin AXIS_PTS ldpm_t_ctl_cru_1 "" 0xa0809766 t_ctl_cru _REC_AXS_20_u1 2.55 _CNV_A_R_LINEAR_____4_CM 5 0. 25.5 FORMAT "%4.1" /end AXIS_PTS
/begin AXIS_PTS ldp_vs_dif_cru__fac_prop_cru "" 0xa08092b8 vs_dif_cru _REC_AXS_20_u2 511.9921875 _CNV_A_R_LINEAR_____101_CM 4 -256. 255.9921875 FORMAT "%7.3" /end AXIS_PTS
/begin AXIS_PTS ldpm_vs_sp_dif_cru_1 "" 0xa0809904 vs_sp_dif_cru _REC_AXS_20_u2 511.9921875 _CNV_A_R_LINEAR_____101_CM 5 -256. 255.9921875 FORMAT "%7.3" /end AXIS_PTS
/begin AXIS_PTS ldpm_n_21 "" 0xa0809586 n_32 _REC_AXS_20_u1 8160. _CNV_A_R_LINEAR_____10_CM 3 0. 8160. FORMAT "%4.0" /end AXIS_PTS
/begin AXIS_PTS ldpm_vs_sp_cru_1 "" 0xa08098f8 vs_sp_cru _REC_AXS_20_u2 511.99218 _CNV_A_R_LINEAR_____86_CM 5 0. 511.99218 FORMAT "%7.3" /end AXIS_PTS
/begin AXIS_PTS ldpm_ac_cru__fac_tq_cru "" 0xa0809314 ac_cru _REC_AXS_20_u2 31.43952 _CNV_A_R_LINEAR_____106_CM 6 -15.72 15.71952 FORMAT "%8.4" /end AXIS_PTS
/begin AXIS_PTS ldpm_gear__fac_tq_cru "" 0xa0809424 gear _REC_AXS_20_u1 255. _CNV_A_R_LINEAR_____0_CM 12 0. 255. FORMAT "%3.0" /end AXIS_PTS
/begin AXIS_PTS ldp_n_32__fac_tq_cru "" 0xa080898c n_32 _REC_AXS_20_u1 816. _CNV_A_R_LINEAR_____10_CM 5 0. 8160. FORMAT "%4.0" /end AXIS_PTS
/begin AXIS_PTS ldpm_fac_tq_cru_1 "" 0xa08093fc fac_tq_cru _REC_AXS_20_u2 99.99847412109381 _CNV_A_R_LINEAR_____8_CM 3 0. 99.99847412109381 /end AXIS_PTS
/begin MEASUREMENT lv_cru_over_act_ack "Hand shake overtaking function" UBYTE _CNV_S_2_RANGE__0___1_CM 1 100. 0. 1. DISPLAY_IDENTIFIER LV_CRU_OVER_ACT_ACK ECU_ADDRESS 0xd0008ef6 BIT_MASK 0x1 /end MEASUREMENT
/begin MEASUREMENT vs_sp_cru_max "Maximum limitation of cruise control" UWORD _CNV_A_R_LINEAR_____86_CM 1 100. 0. 511.99218 DISPLAY_IDENTIFIER VS_SP_CRU_MAX ECU_ADDRESS 0xd000aba8 FORMAT "%7.3" /end MEASUREMENT
/begin CHARACTERISTIC c_vs_sp_cru_max_k "maximum limitation of cruise control in case of KM - ICL" VALUE 0xa080c4f4 _REC_VAL_20_u2 511.99218 _CNV_A_R_LINEAR_____86_CM 0. 511.99218 DISPLAY_IDENTIFIER C_VS_SP_CRU_MAX_K FORMAT "%7.3" /end CHARACTERISTIC
/begin CHARACTERISTIC c_vs_sp_cru_max_m "maximum limitation of cruise control in case of Mile - ICL" VALUE 0xa080c4f6 _REC_VAL_20_u2 511.99218 _CNV_A_R_LINEAR_____86_CM 0. 511.99218 DISPLAY_IDENTIFIER C_VS_SP_CRU_MAX_M FORMAT "%7.3" /end CHARACTERISTIC
/begin CHARACTERISTIC c_vs_dif_tip_m "Km per tip in case of mile - icl" VALUE 0xa080c4b0 _REC_VAL_20_u2 511.99218 _CNV_A_R_LINEAR_____86_CM 0. 511.99218 DISPLAY_IDENTIFIER C_VS_DIF_TIP_M FORMAT "%7.3" /end CHARACTERISTIC
/begin CHARACTERISTIC c_vs_dif_tip_k "Km per tip in case of km - icl" VALUE 0xa080c4ae _REC_VAL_20_u2 511.99218 _CNV_A_R_LINEAR_____86_CM 0. 511.99218 DISPLAY_IDENTIFIER C_VS_DIF_TIP_K FORMAT "%7.3" /end CHARACTERISTIC
/begin CHARACTERISTIC c_fac_tq_cru_lgrd "Control variable limitaion gradiant" VALUE 0xa080bd02 _REC_VAL_20_u2 99.99847412109381 _CNV_A_R_LINEAR_____108_CM 0. 99.99847412109381 DISPLAY_IDENTIFIER C_FAC_TQ_CRU_LGRD /end CHARACTERISTIC
/begin CHARACTERISTIC c_fac_tq_cru_ofs "Offset for cruise control variable" VALUE 0xa080bd06 _REC_VAL_20_u2 99.99847412109381 _CNV_A_R_LINEAR_____8_CM 0. 99.99847412109381 DISPLAY_IDENTIFIER C_FAC_TQ_CRU_OFS /end CHARACTERISTIC
/begin MEASUREMENT nr_step_on "Current vehicle speed step" UBYTE _CNV_A_R_LINEAR_____0_CM 1 100. 0. 255. DISPLAY_IDENTIFIER NR_STEP_ON ECU_ADDRESS 0xd0000574 FORMAT "%3.0" /end MEASUREMENT
/begin MEASUREMENT count_vs_step "Number of used vehicle speed steps" UBYTE _CNV_A_R_LINEAR_____0_CM 1 100. 0. 255. DISPLAY_IDENTIFIER COUNT_VS_STEP ECU_ADDRESS 0xd0008f07 FORMAT "%3.0" /end MEASUREMENT
/begin MEASUREMENT vs_dif_step_prog "Differences between steps" UWORD _CNV_A_R_LINEAR_____86_CM 1 100. 0. 511.99218 DISPLAY_IDENTIFIER VS_DIF_STEP_PROG ECU_ADDRESS 0xd0000548 FORMAT "%7.3" /end MEASUREMENT
/begin MEASUREMENT lv_step_on "Step display on" UBYTE _CNV_S_2_RANGE__0___1_CM 1 100. 0. 1. DISPLAY_IDENTIFIER LV_STEP_ON ECU_ADDRESS 0xd0008f09 BIT_MASK 0x1 /end MEASUREMENT
/begin MEASUREMENT vs_sp_driv_step "Active vehicle speed step for the controller" UWORD _CNV_A_R_LINEAR_____86_CM 1 100. 0. 511.99218 DISPLAY_IDENTIFIER VS_SP_DRIV_STEP ECU_ADDRESS 0xd000abcc FORMAT "%7.3" /end MEASUREMENT
/begin MEASUREMENT nr_vs_cru "Cycle number of message IDX_NO" UBYTE _CNV_A_R_LINEAR_____0_CM 1 100. 0. 255. DISPLAY_IDENTIFIER NR_VS_CRU ECU_ADDRESS 0xd0008f08 FORMAT "%3.0" /end MEASUREMENT
/begin MEASUREMENT vs_sp_driv_cru_can "Driver demand cruise control for INSTR" UWORD _CNV_A_R_LINEAR_____86_CM 1 100. 0. 511.99218 DISPLAY_IDENTIFIER VS_SP_DRIV_CRU_CAN ECU_ADDRESS 0xd000abca FORMAT "%7.3" /end MEASUREMENT
/begin MEASUREMENT vs_step_can_1 "Vehicle speed step to the CAN Nr.1" UWORD _CNV_A_R_LINEAR_____86_CM 1 100. 0. 511.99218 DISPLAY_IDENTIFIER VS_STEP_CAN_1 ECU_ADDRESS 0xd000abce FORMAT "%7.3" /end MEASUREMENT
/begin MEASUREMENT vs_step_can_2 "Vehicle speed step to the CAN Nr.2" UWORD _CNV_A_R_LINEAR_____86_CM 1 100. 0. 511.99218 DISPLAY_IDENTIFIER VS_STEP_CAN_2 ECU_ADDRESS 0xd000abd0 FORMAT "%7.3" /end MEASUREMENT
/begin MEASUREMENT vs_step_can_3 "Vehicle speed step to the CAN Nr.3" UWORD _CNV_A_R_LINEAR_____86_CM 1 100. 0. 511.99218 DISPLAY_IDENTIFIER VS_STEP_CAN_3 ECU_ADDRESS 0xd000abd2 FORMAT "%7.3" /end MEASUREMENT
/begin CHARACTERISTIC c_vs_dif_step_prog_m "M.p.h step calibration" VALUE 0xa080c4ac _REC_VAL_20_u2 511.99218 _CNV_A_R_LINEAR_____86_CM 0. 511.99218 DISPLAY_IDENTIFIER C_VS_DIF_STEP_PROG_M FORMAT "%7.3" /end CHARACTERISTIC
/begin CHARACTERISTIC c_vs_dif_step_prog_k "Km.p.h step calibration" VALUE 0xa080c4aa _REC_VAL_20_u2 511.99218 _CNV_A_R_LINEAR_____86_CM 0. 511.99218 DISPLAY_IDENTIFIER C_VS_DIF_STEP_PROG_K FORMAT "%7.3" /end CHARACTERISTIC
/begin CHARACTERISTIC c_vs_min_prog "VS_CRU threshold stand programming detection" VALUE 0xa080c4e4 _REC_VAL_20_u2 511.99218 _CNV_A_R_LINEAR_____86_CM 0. 511.99218 DISPLAY_IDENTIFIER C_VS_MIN_PROG FORMAT "%7.3" /end CHARACTERISTIC
/begin CHARACTERISTIC c_max_step "Maximum number of steps" VALUE 0xa080be5c _REC_VAL_20_u1 255. _CNV_A_R_LINEAR_____0_CM 0. 255. DISPLAY_IDENTIFIER C_MAX_STEP FORMAT "%3.0" /end CHARACTERISTIC
/begin CHARACTERISTIC c_t_cru_flash_light "Flash light duration time" VALUE 0xa080c147 _REC_VAL_20_u1 2.55 _CNV_A_R_LINEAR_____3_CM 0. 2.55 DISPLAY_IDENTIFIER C_T_CRU_FLASH_LIGHT FORMAT "%4.2" /end CHARACTERISTIC
/begin CHARACTERISTIC c_t_min_prog "Time for programming detection" VALUE 0xa080c227 _REC_VAL_20_u1 5.1 _CNV_A_R_LINEAR_____110_CM 0. 5.1 DISPLAY_IDENTIFIER C_T_MIN_PROG FORMAT "%4.2" /end CHARACTERISTIC
/begin CHARACTERISTIC c_ctr_cru_flash_light "Counter for flash lights" VALUE 0xa080bb3c _REC_VAL_20_u1 254. _CNV_A_R_LINEAR_____0_CM 1. 255. DISPLAY_IDENTIFIER C_CTR_CRU_FLASH_LIGHT FORMAT "%3.0" /end CHARACTERISTIC
/begin MEASUREMENT lv_prog_step_1 "Standing programming on" UBYTE _CNV_S_2_RANGE__0___1_CM 1 100. 0. 1. DISPLAY_IDENTIFIER LV_PROG_STEP_1 ECU_ADDRESS 0xd0008f0a BIT_MASK 0x1 /end MEASUREMENT
/begin MEASUREMENT lv_prog_step_if_act "Step Display on" UBYTE _CNV_S_2_RANGE__0___1_CM 1 100. 0. 1. DISPLAY_IDENTIFIER LV_PROG_STEP_IF_ACT ECU_ADDRESS 0xd0000583 BIT_MASK 0x1 /end MEASUREMENT
/begin CHARACTERISTIC c_t_dly_cru_tip "Time delay for display vehicle speed pointer" VALUE 0xa080c168 _REC_VAL_20_u1 2.55 _CNV_A_R_LINEAR_____3_CM 0. 2.55 DISPLAY_IDENTIFIER C_T_DLY_CRU_TIP FORMAT "%4.2" /end CHARACTERISTIC
/begin CHARACTERISTIC c_t_min_cru_chg "Lock time for events" VALUE 0xa080c20d _REC_VAL_20_u1 2.55 _CNV_A_R_LINEAR_____3_CM 0. 2.55 DISPLAY_IDENTIFIER C_T_MIN_CRU_CHG FORMAT "%4.2" /end CHARACTERISTIC
/begin CHARACTERISTIC c_vs_dif_step_min_hys "Minimum between steps hysteresis" VALUE 0xa080c4a4 _REC_VAL_20_u2 511.99218 _CNV_A_R_LINEAR_____86_CM 0. 511.99218 DISPLAY_IDENTIFIER C_VS_DIF_STEP_MIN_HYS FORMAT "%7.3" /end CHARACTERISTIC
/begin CHARACTERISTIC c_t_prog_step_if_act "Time out for programming mode" VALUE 0xa080c259 _REC_VAL_20_u1 2.55 _CNV_A_R_LINEAR_____3_CM 0. 2.55 DISPLAY_IDENTIFIER C_T_PROG_STEP_IF_ACT FORMAT "%4.2" /end CHARACTERISTIC
/begin CHARACTERISTIC c_vs_dif_step_min_m "Minimum between steps in case of mile ICL" VALUE 0xa080c4a8 _REC_VAL_20_u2 511.99218 _CNV_A_R_LINEAR_____86_CM 0. 511.99218 DISPLAY_IDENTIFIER C_VS_DIF_STEP_MIN_M FORMAT "%7.3" /end CHARACTERISTIC
/begin CHARACTERISTIC c_vs_dif_step_min_k "Minimum between steps in case of  Km - ICL" VALUE 0xa080c4a6 _REC_VAL_20_u2 511.99218 _CNV_A_R_LINEAR_____86_CM 0. 511.99218 DISPLAY_IDENTIFIER C_VS_DIF_STEP_MIN_K FORMAT "%7.3" /end CHARACTERISTIC
/begin CHARACTERISTIC c_vs_dif_tip_prog_m "Difference between tip steps in case of mile ICL" VALUE 0xa080c4b4 _REC_VAL_20_u2 511.99218 _CNV_A_R_LINEAR_____86_CM 0. 511.99218 DISPLAY_IDENTIFIER C_VS_DIF_TIP_PROG_M FORMAT "%7.3" /end CHARACTERISTIC
/begin CHARACTERISTIC c_vs_dif_tip_prog_k "Difference between tip steps in case of Km ICL" VALUE 0xa080c4b2 _REC_VAL_20_u2 511.99218 _CNV_A_R_LINEAR_____86_CM 0. 511.99218 DISPLAY_IDENTIFIER C_VS_DIF_TIP_PROG_K FORMAT "%7.3" /end CHARACTERISTIC
/begin MEASUREMENT lv_step_on_icl "Step Display on for instrument cluster" UBYTE _CNV_S_2_RANGE__0___1_CM 1 100. 0. 1. DISPLAY_IDENTIFIER LV_STEP_ON_ICL ECU_ADDRESS 0xd0008f0c BIT_MASK 0x1 /end MEASUREMENT
/begin MEASUREMENT lv_cru_disp_hud "Display on for HUD" UBYTE _CNV_S_2_RANGE__0___1_CM 1 100. 0. 1. DISPLAY_IDENTIFIER LV_CRU_DISP_HUD ECU_ADDRESS 0xd0008f0d BIT_MASK 0x1 /end MEASUREMENT
/begin CHARACTERISTIC lc_cru_disp_swi "Configuration switch to switch off CRU display for HUD and ICL due to driver request" VALUE 0xa080c541 _REC_VAL_20_u1 1. _CNV_A_R_LINEAR_____0_CM 0. 1. DISPLAY_IDENTIFIER LC_CRU_DISP_SWI FORMAT "%1.0" /end CHARACTERISTIC
/begin MEASUREMENT state_msw_can "Status of MSW to the CAN Message" UBYTE _CNV_S_8_RANGE_STAT_246_CM 1 100. 0. 7. DISPLAY_IDENTIFIER STATE_MSW_CAN ECU_ADDRESS 0xd0008b63 /end MEASUREMENT
/begin MEASUREMENT lv_var_msw "LV MSW detected" UBYTE _CNV_S_2_RANGE__0___1_CM 1 100. 0. 1. DISPLAY_IDENTIFIER LV_VAR_MSW ECU_ADDRESS 0xd0008b73 BIT_MASK 0x1 /end MEASUREMENT
/begin MEASUREMENT lv_mtc_lih_act "LV limp home request main throttle" UBYTE _CNV_S_2_RANGE__0___1_CM 1 100. 0. 1. DISPLAY_IDENTIFIER LV_MTC_LIH_ACT ECU_ADDRESS 0xd00089e7 BIT_MASK 0x1 /end MEASUREMENT
/begin MEASUREMENT lv_ivvt_in_and_ex "LV  IVVT inlet and exhaust cam (0 = inlet cam variable, 1 = inlet & exhaust cam variable) " UBYTE _CNV_S_2_RANGE__0___1_CM 1 100. 0. 1. DISPLAY_IDENTIFIER LV_IVVT_IN_AND_EX ECU_ADDRESS 0xd0008b16 BIT_MASK 0x1 /end MEASUREMENT
/begin MEASUREMENT lv_inj_conf "LV injection configuration (0 = intake manifold injection, 1 = direct injection) " UBYTE _CNV_S_2_RANGE__0___1_CM 1 100. 0. 1. DISPLAY_IDENTIFIER LV_INJ_CONF ECU_ADDRESS 0xd0008b17 BIT_MASK 0x1 /end MEASUREMENT
/begin MEASUREMENT lv_isa_conf "logical variable idle speed actuator configuration (0=no idle speed actuator, 1=idle speed actuator)" UBYTE _CNV_S_2_RANGE__0___1_CM 1 100. 0. 1. DISPLAY_IDENTIFIER LV_ISA_CONF ECU_ADDRESS 0xd0008b18 BIT_MASK 0x1 /end MEASUREMENT
/begin MEASUREMENT vim_type "VIM configuration" UBYTE _CNV_S_2_RANGE_VIM__267_CM 1 100. 0. 1. DISPLAY_IDENTIFIER VIM_TYPE ECU_ADDRESS 0xd0008b0d /end MEASUREMENT
/begin MEASUREMENT lv_var_sof "variant of sound-flap" UBYTE _CNV_S_2_RANGE__0___1_CM 1 100. 0. 1. DISPLAY_IDENTIFIER LV_VAR_SOF ECU_ADDRESS 0xd0008b25 BIT_MASK 0x1 /end MEASUREMENT
/begin MEASUREMENT lv_cbk_mpl "LV  multiple cylinder banks (0 = single bank, 1 = multiple banks) " UBYTE _CNV_S_2_RANGE__0___1_CM 1 100. 0. 1. DISPLAY_IDENTIFIER LV_CBK_MPL ECU_ADDRESS 0xd0008b15 BIT_MASK 0x1 /end MEASUREMENT
/begin MEASUREMENT state_lrn_ecu "Variant ECU" UWORD _CNV_S_9_RANGE_STAT_268_CM 1 100. 0. 65535. DISPLAY_IDENTIFIER STATE_LRN_ECU ECU_ADDRESS 0xd000a700 /end MEASUREMENT
/begin MEASUREMENT conf_swi_efp_out "configuration of EFP-control" UBYTE _CNV_A_R_LINEAR_____0_CM 1 100. 0. 2. DISPLAY_IDENTIFIER CONF_SWI_EFP_OUT ECU_ADDRESS 0xd0008b0e FORMAT "%2.0" /end MEASUREMENT
/begin CHARACTERISTIC c_conf_swi_efp_out "configuration bit for EFP-control" VALUE 0xa080bab6 _REC_VAL_20_u1 2. _CNV_A_R_LINEAR_____0_CM 0. 2. DISPLAY_IDENTIFIER C_CONF_SWI_EFP_OUT FORMAT "%2.0" /end CHARACTERISTIC
/begin MEASUREMENT conf_oil_level_sens "configuration of EFP-control" UBYTE _CNV_A_R_LINEAR_____0_CM 1 100. 0. 2. DISPLAY_IDENTIFIER CONF_OIL_LEVEL_SENS ECU_ADDRESS 0xd0008b0f FORMAT "%2.0" /end MEASUREMENT
/begin MEASUREMENT lv_var_bn "PT-CAN Variant (0=CAN11h / 1=BN2000 recognized)" UBYTE _CNV_S_2_RANGE__0___1_CM 1 100. 0. 1. DISPLAY_IDENTIFIER LV_VAR_BN ECU_ADDRESS 0xd0008b26 BIT_MASK 0x1 /end MEASUREMENT
/begin MEASUREMENT lv_var_bn_efp "EFP via CAN recognized (BN2000 only)" UBYTE _CNV_S_2_RANGE__0___1_CM 1 100. 0. 1. DISPLAY_IDENTIFIER LV_VAR_BN_EFP ECU_ADDRESS 0xd0008b2c BIT_MASK 0x1 /end MEASUREMENT
/begin CHARACTERISTIC c_conf_dmtl "" VALUE 0xa080bab4 _REC_VAL_20_u1 1. _CNV_A_R_LINEAR_____0_CM 0. 1. DISPLAY_IDENTIFIER C_CONF_DMTL FORMAT "%2.0" /end CHARACTERISTIC
/begin MEASUREMENT lv_conf_dmtl "configuration of DMTL" UBYTE _CNV_S_2_RANGE__0___1_CM 1 100. 0. 1. DISPLAY_IDENTIFIER LV_CONF_DMTL ECU_ADDRESS 0xd0008b1b BIT_MASK 0x1 /end MEASUREMENT
/begin MEASUREMENT lv_var_tco_2 "TCO_2 sensor is available (=1)" UBYTE _CNV_S_2_RANGE__0___1_CM 1 100. 0. 1. DISPLAY_IDENTIFIER LV_VAR_TCO_2 ECU_ADDRESS 0xd0008b21 BIT_MASK 0x1 /end MEASUREMENT
/begin MEASUREMENT conf_sof_swi "Configuration of sport-switch" UBYTE _CNV_S_3_STATE_CONF_269_CM 1 100. 0. 2. DISPLAY_IDENTIFIER CONF_SOF_SWI ECU_ADDRESS 0xd0008b10 /end MEASUREMENT
/begin MEASUREMENT lv_var_ecras_up "ECRAS system with ECRAS_UP flap detected (2 flap system)" UBYTE _CNV_S_2_RANGE__0___1_CM 1 100. 0. 1. DISPLAY_IDENTIFIER LV_VAR_ECRAS_UP ECU_ADDRESS 0xd0008b1d BIT_MASK 0x1 /end MEASUREMENT
/begin CHARACTERISTIC c_conf_oil_level_sens "configuration bit for EFP - control" VALUE 0xa080bab5 _REC_VAL_20_u1 2. _CNV_A_R_LINEAR_____0_CM 0. 2. DISPLAY_IDENTIFIER C_CONF_OIL_LEVEL_SENS FORMAT "%2.0" /end CHARACTERISTIC
/begin CHARACTERISTIC c_conf_cat "configuration bit for CAT/exahaust type" VALUE 0xa080bab3 _REC_VAL_20_u1 2. _CNV_A_R_LINEAR_____0_CM 0. 2. DISPLAY_IDENTIFIER C_CONF_CAT FORMAT "%2.0" /end CHARACTERISTIC
/begin MEASUREMENT lv_var_ef "variant for exhaust flap" UBYTE _CNV_S_2_RANGE__0___1_CM 1 100. 0. 1. DISPLAY_IDENTIFIER LV_VAR_EF ECU_ADDRESS 0xd0008b1e BIT_MASK 0x1 /end MEASUREMENT
/begin MEASUREMENT lv_var_lsh_up "variant for CAT/exahust type" UBYTE _CNV_S_2_RANGE__0___1_CM 1 100. 0. 1. DISPLAY_IDENTIFIER LV_VAR_LSH_UP ECU_ADDRESS 0xd0008b22 BIT_MASK 0x1 /end MEASUREMENT
/begin MEASUREMENT lv_var_lsh_down "variant for CAT/exahust type" UBYTE _CNV_S_2_RANGE__0___1_CM 1 100. 0. 1. DISPLAY_IDENTIFIER LV_VAR_LSH_DOWN ECU_ADDRESS 0xd0008b23 BIT_MASK 0x1 /end MEASUREMENT
/begin MEASUREMENT psn_ls "OBD-communication mode01 PID13, automatic learnig of oxygen sensors" UBYTE _CNV_A_R_LINEAR_____0_CM 1 100. 0. 255. DISPLAY_IDENTIFIER PSN_LS ECU_ADDRESS 0xd0008b11 FORMAT "%3.0" /end MEASUREMENT
/begin MEASUREMENT psn_ls_1 "OBD-communication mode01 PID1D, automatic learnig of oxygen sensors" UBYTE _CNV_A_R_LINEAR_____0_CM 1 100. 0. 255. DISPLAY_IDENTIFIER PSN_LS_1 ECU_ADDRESS 0xd0008b12 FORMAT "%3.0" /end MEASUREMENT
/begin MEASUREMENT lv_var_ebox_cfa "variant for EBOX cooling fan" UBYTE _CNV_S_2_RANGE__0___1_CM 1 100. 0. 1. DISPLAY_IDENTIFIER LV_VAR_EBOX_CFA ECU_ADDRESS 0xd0008b1c BIT_MASK 0x1 /end MEASUREMENT
/begin MEASUREMENT lv_var_rly_st "variant of starter relay recognized " UBYTE _CNV_S_2_RANGE__0___1_CM 1 100. 0. 1. DISPLAY_IDENTIFIER LV_VAR_RLY_ST ECU_ADDRESS 0xd0008b20 BIT_MASK 0x1 /end MEASUREMENT
/begin MEASUREMENT lv_var_rly_accout "variant of ACC-relay recognized" UBYTE _CNV_S_2_RANGE__0___1_CM 1 100. 0. 1. DISPLAY_IDENTIFIER LV_VAR_RLY_ACCOUT ECU_ADDRESS 0xd0008b1f BIT_MASK 0x1 /end MEASUREMENT
/begin MEASUREMENT var_veh "Vehicle Variant" UBYTE _CNV_S_4_RANGE_VAR__270_CM 1 100. 0. 3. DISPLAY_IDENTIFIER VAR_VEH ECU_ADDRESS 0xd0008b13 /end MEASUREMENT
/begin MEASUREMENT lv_var_bn_gear_rev "reverse gear via CAN recognized (BN2000/E60 - MT only)" UBYTE _CNV_S_2_RANGE__0___1_CM 1 100. 0. 1. DISPLAY_IDENTIFIER LV_VAR_BN_GEAR_REV ECU_ADDRESS 0xd0008b2e BIT_MASK 0x1 /end MEASUREMENT
/begin MEASUREMENT lv_var_acin "LV air conditioning recognized" UBYTE _CNV_S_2_RANGE__0___1_CM 1 100. 0. 1. DISPLAY_IDENTIFIER LV_VAR_ACIN ECU_ADDRESS 0xd0008b34 BIT_MASK 0x1 /end MEASUREMENT
/begin MEASUREMENT lv_var_bn_ltg_hdlp_l "Dipped Beam via CAN recognized (BN2000 only)" UBYTE _CNV_S_2_RANGE__0___1_CM 1 100. 0. 1. DISPLAY_IDENTIFIER LV_VAR_BN_LTG_HDLP_L ECU_ADDRESS 0xd0008b2f BIT_MASK 0x1 /end MEASUREMENT
/begin CHARACTERISTIC c_n_var_dis_misf "Switch off threshold" VALUE 0xa080bfdc _REC_VAL_20_u1 816. _CNV_A_R_LINEAR_____10_CM 0. 8160. DISPLAY_IDENTIFIER C_N_VAR_DIS_MISF FORMAT "%4.0" /end CHARACTERISTIC
/begin CHARACTERISTIC c_n_var_dis_er "Switch off threshold" VALUE 0xa080bfda _REC_VAL_20_u1 816. _CNV_A_R_LINEAR_____10_CM 0. 8160. DISPLAY_IDENTIFIER C_N_VAR_DIS_ER FORMAT "%4.0" /end CHARACTERISTIC
/begin CHARACTERISTIC c_n_var_dis_inj "Switch off threshold" VALUE 0xa080bfdb _REC_VAL_20_u1 816. _CNV_A_R_LINEAR_____10_CM 0. 8160. DISPLAY_IDENTIFIER C_N_VAR_DIS_INJ FORMAT "%4.0" /end CHARACTERISTIC
/begin CHARACTERISTIC lc_var_dis_fsd "switch off function" VALUE 0xa080c615 _REC_VAL_20_u1 1. _CNV_A_R_LINEAR_____0_CM 0. 1. DISPLAY_IDENTIFIER LC_VAR_DIS_FSD FORMAT "%2.0" /end CHARACTERISTIC
/begin CHARACTERISTIC lc_var_dis_obd_cat "switch off function" VALUE 0xa080c617 _REC_VAL_20_u1 1. _CNV_A_R_LINEAR_____0_CM 0. 1. DISPLAY_IDENTIFIER LC_VAR_DIS_OBD_CAT FORMAT "%2.0" /end CHARACTERISTIC
/begin CHARACTERISTIC lc_var_dis_nox "switch off function" VALUE 0xa080c616 _REC_VAL_20_u1 1. _CNV_A_R_LINEAR_____0_CM 0. 1. DISPLAY_IDENTIFIER LC_VAR_DIS_NOX FORMAT "%2.0" /end CHARACTERISTIC
/begin CHARACTERISTIC lc_var_dis_cru "switch off function cruise control" VALUE 0xa080c613 _REC_VAL_20_u1 1. _CNV_A_R_LINEAR_____0_CM 0. 1. DISPLAY_IDENTIFIER LC_VAR_DIS_CRU FORMAT "%2.0" /end CHARACTERISTIC
/begin CHARACTERISTIC lc_var_dis_tq_loss_ars "switch off function torque loss - anti roll stabilization" VALUE 0xa080c619 _REC_VAL_20_u1 1. _CNV_A_R_LINEAR_____0_CM 0. 1. DISPLAY_IDENTIFIER LC_VAR_DIS_TQ_LOSS_ARS FORMAT "%2.0" /end CHARACTERISTIC
/begin MEASUREMENT cam_type "CAM type" UBYTE _CNV_S_3_RANGE_CAM__271_CM 1 100. 0. 2. DISPLAY_IDENTIFIER CAM_TYPE ECU_ADDRESS 0xd0008b0c /end MEASUREMENT
/begin CHARACTERISTIC lc_tcha_conf "logical constant for variant turbo charger" VALUE 0xa080c5fb _REC_VAL_20_u1 1. _CNV_A_R_LINEAR_____0_CM 0. 1. DISPLAY_IDENTIFIER LC_TCHA_CONF FORMAT "%2.0" /end CHARACTERISTIC
/begin MEASUREMENT lv_var_tcha "Lambda 1 turbo charger" UBYTE _CNV_S_2_RANGE__0___1_CM 1 100. 0. 1. DISPLAY_IDENTIFIER LV_VAR_TCHA ECU_ADDRESS 0xd0008b24 BIT_MASK 0x1 /end MEASUREMENT
/begin CHARACTERISTIC c_ctr_avl_maf "Minimum cycle number to learn HFM component" VALUE 0xa080bb21 _REC_VAL_20_u1 255. _CNV_A_R_LINEAR_____0_CM 0. 255. DISPLAY_IDENTIFIER C_CTR_AVL_MAF FORMAT "%3.0" /end CHARACTERISTIC
/begin MEASUREMENT lv_var_maf "variant mass air flow meter" UBYTE _CNV_S_2_RANGE__0___1_CM 1 100. 0. 1. DISPLAY_IDENTIFIER LV_VAR_MAF ECU_ADDRESS 0xd0008b1a BIT_MASK 0x1 /end MEASUREMENT
/begin CHARACTERISTIC lc_mafm_det_di "Disable flag for automatically learning of HFM" VALUE 0xa080c5a8 _REC_VAL_20_u1 1. _CNV_A_R_LINEAR_____0_CM 0. 1. DISPLAY_IDENTIFIER LC_MAFM_DET_DI FORMAT "%1.0" /end CHARACTERISTIC
/begin MEASUREMENT lv_var_veh "Vehicle Variant with power module (E60/E65) recognized - BN2000 only" UBYTE _CNV_S_2_RANGE__0___1_CM 1 100. 0. 1. DISPLAY_IDENTIFIER LV_VAR_VEH ECU_ADDRESS 0xd0008b33 BIT_MASK 0x1 /end MEASUREMENT
/begin CHARACTERISTIC c_var_veh "Vehicle configuration code" VALUE 0xa080c415 _REC_VAL_20_u1 3. _CNV_S_4_RANGE_VAR__270_CM 0. 3. DISPLAY_IDENTIFIER C_VAR_VEH /end CHARACTERISTIC
/begin MEASUREMENT state_var_det_cus_1 "carrier double-word 1 of all learned variants for customer environment" ULONG _CNV_A_R_LINEAR_____50_CM 1 100. 0. 4294967295. DISPLAY_IDENTIFIER STATE_VAR_DET_CUS_1 ECU_ADDRESS 0xd000ba1c FORMAT "%11.0" /end MEASUREMENT
/begin MEASUREMENT state_var_det_cus_2 "carrier double-word 2 of all learned variants for customer environment" ULONG _CNV_A_R_LINEAR_____50_CM 1 100. 0. 4294967295. DISPLAY_IDENTIFIER STATE_VAR_DET_CUS_2 ECU_ADDRESS 0xd000ba20 FORMAT "%11.0" /end MEASUREMENT
/begin MEASUREMENT lv_var_bn_ldm "LDM detected (E9x only)" UBYTE _CNV_S_2_RANGE__0___1_CM 1 100. 0. 1. DISPLAY_IDENTIFIER LV_VAR_BN_LDM ECU_ADDRESS 0xd0008b30 BIT_MASK 0x1 /end MEASUREMENT
/begin MEASUREMENT lv_var_bn_trl "TRL detected" UBYTE _CNV_S_2_RANGE__0___1_CM 1 100. 0. 1. DISPLAY_IDENTIFIER LV_VAR_BN_TRL ECU_ADDRESS 0xd0008b31 BIT_MASK 0x1 /end MEASUREMENT
/begin MEASUREMENT lv_var_bn_hiv "HIV-Slave detected" UBYTE _CNV_S_2_RANGE__0___1_CM 1 100. 0. 1. DISPLAY_IDENTIFIER LV_VAR_BN_HIV ECU_ADDRESS 0xd0008b32 BIT_MASK 0x1 /end MEASUREMENT
/begin CHARACTERISTIC c_t_det_var_can "time for learning variants via CAN after ignition key on" VALUE 0xa080c15c _REC_VAL_20_u1 255. _CNV_A_R_LINEAR_____36_CM 0. 255. DISPLAY_IDENTIFIER C_T_DET_VAR_CAN FORMAT "%3.0" /end CHARACTERISTIC
/begin CHARACTERISTIC lc_var_dis_dmtl "switch off tank leakage diagnosis" VALUE 0xa080c614 _REC_VAL_20_u1 1. _CNV_A_R_LINEAR_____0_CM 0. 1. DISPLAY_IDENTIFIER LC_VAR_DIS_DMTL FORMAT "%2.0" /end CHARACTERISTIC
/begin CHARACTERISTIC lc_var_tco_2 "configuration switch for TCO_2 sensor" VALUE 0xa080c61e _REC_VAL_20_u1 1. _CNV_A_R_LINEAR_____0_CM 0. 1. DISPLAY_IDENTIFIER LC_VAR_TCO_2 FORMAT "%2.0" /end CHARACTERISTIC
/begin CHARACTERISTIC lc_var_dis_s_fct "switch off stratified functions" VALUE 0xa080c618 _REC_VAL_20_u1 1. _CNV_A_R_LINEAR_____0_CM 0. 1. DISPLAY_IDENTIFIER LC_VAR_DIS_S_FCT FORMAT "%2.0" /end CHARACTERISTIC
/begin CHARACTERISTIC c_thd_ctr_t_per_maf_frq_sum "Threshold to learn HFM component" VALUE 0xa080c31e _REC_VAL_20_u1 255. _CNV_A_R_LINEAR_____0_CM 0. 255. DISPLAY_IDENTIFIER C_THD_CTR_T_PER_MAF_FRQ_SUM FORMAT "%3.0" /end CHARACTERISTIC
/begin MEASUREMENT ctr_avl_maf[0] "Cycle counter for HFM learning function" UBYTE _CNV_A_R_LINEAR_____0_CM 1 100. 0. 255. DISPLAY_IDENTIFIER CTR_AVL_MAF[0] ECU_ADDRESS 0xd0001822 FORMAT "%3.0" /end MEASUREMENT
/begin MEASUREMENT ctr_avl_maf[1] "Cycle counter for HFM learning function" UBYTE _CNV_A_R_LINEAR_____0_CM 1 100. 0. 255. DISPLAY_IDENTIFIER CTR_AVL_MAF[1] ECU_ADDRESS 0xd0001823 FORMAT "%3.0" /end MEASUREMENT
/begin MEASUREMENT lv_var_pbr "Bit indicating electro-mechanical park brake variant " UBYTE _CNV_S_2_RANGE__0___1_CM 1 100. 0. 1. DISPLAY_IDENTIFIER LV_VAR_PBR ECU_ADDRESS 0xd0008b37 BIT_MASK 0x1 /end MEASUREMENT
/begin MEASUREMENT lv_var_l6 "Bit indicating L6 board network " UBYTE _CNV_S_2_RANGE__0___1_CM 1 100. 0. 1. DISPLAY_IDENTIFIER LV_VAR_L6 ECU_ADDRESS 0xd0008b39 BIT_MASK 0x1 /end MEASUREMENT
/begin CHARACTERISTIC lc_var_ebox_cfa "Configuration of LV_VAR_EBOX_CFA (if 1, LV_VAR_xx =1, else LV_VAR_xx learnt by power stage diag)" VALUE 0xa080c61a _REC_VAL_20_u1 1. _CNV_S_2_RANGE__0___1_CM 0. 1. DISPLAY_IDENTIFIER LC_VAR_EBOX_CFA /end CHARACTERISTIC
/begin MEASUREMENT lv_var_etcu_3 "Transmission control unit, using 'Getriebedaten 3' message detected" UBYTE _CNV_S_2_RANGE__0___1_CM 1 100. 0. 1. DISPLAY_IDENTIFIER LV_VAR_ETCU_3 ECU_ADDRESS 0xd0008b38 BIT_MASK 0x1 /end MEASUREMENT
/begin MEASUREMENT online_dummy "" UWORD _CNV_A_R_LINEAR_____0_CM 1 100. 0. 65535. DISPLAY_IDENTIFIER ONLINE_DUMMY ECU_ADDRESS 0xd000a74c FORMAT "%5.0" /end MEASUREMENT
/begin MEASUREMENT iga_dif_sp_h_rng "Setpoint subtrahend ignition angle in wide range" UWORD _CNV_A_R_LINEAR_____189_CM 1 100. 0. -180. DISPLAY_IDENTIFIER IGA_DIF_SP_H_RNG ECU_ADDRESS 0xd000a35a FORMAT "%8.4" /end MEASUREMENT
/begin MEASUREMENT eff_iga_av "Ignition efficiency actual ignition angle bank selective" UWORD _CNV_A_R_LINEAR_____9_CM 1 100. 0. 1.99996948242188 DISPLAY_IDENTIFIER EFF_IGA_AV ECU_ADDRESS 0xd000a35c FORMAT "%7.5" /end MEASUREMENT
/begin MEASUREMENT eff_iga_av_can "Ignition efficiency actual ignition angle for CAN" UWORD _CNV_A_R_LINEAR_____9_CM 1 100. 0. 1.99996948242188 DISPLAY_IDENTIFIER EFF_IGA_AV_CAN ECU_ADDRESS 0xd000a35e FORMAT "%7.5" /end MEASUREMENT
/begin MEASUREMENT eff_iga_min_teg "possible ignition efficiency minimum according to the exhaust gas temperature" UWORD _CNV_A_R_LINEAR_____9_CM 1 100. 0. 1.99996948242188 DISPLAY_IDENTIFIER EFF_IGA_MIN_TEG ECU_ADDRESS 0xd000a360 FORMAT "%7.5" /end MEASUREMENT
/begin MEASUREMENT eff_iga_bas_cor "Ignition efficiency basic ignition angle" UWORD _CNV_A_R_LINEAR_____9_CM 1 100. 0. 1.99996948242188 DISPLAY_IDENTIFIER EFF_IGA_BAS_COR ECU_ADDRESS 0xd000a362 FORMAT "%7.5" /end MEASUREMENT
/begin MEASUREMENT iga_sp_h_rng "Setpoint ignition angle from torque management" SWORD _CNV_A_R_LINEAR_____188_CM 1 100. -90. 90. DISPLAY_IDENTIFIER IGA_SP_H_RNG ECU_ADDRESS 0xd000a368 FORMAT "%8.4" /end MEASUREMENT
/begin MEASUREMENT iga_sp_can_h_rng "Setpoint ignition angle from torque management for CAN" UWORD _CNV_A_R_LINEAR_____189_CM 1 100. 0. -180. DISPLAY_IDENTIFIER IGA_SP_CAN_H_RNG ECU_ADDRESS 0xd000a36a FORMAT "%8.4" /end MEASUREMENT
/begin CHARACTERISTIC c_data_id_0 "Dataset identifier, string with 5 calibratable values, only visible in INCA (SAM doesn't support ascii format)" ASCII 0xa080001c _REC_VAL_3_u1 255. _CNV_A_R_LINEAR_____50_CM 0. 255. DISPLAY_IDENTIFIER C_DATA_ID_0 NUMBER 5 /end CHARACTERISTIC
/begin CHARACTERISTIC c_data_id_1 "Dataset identifier, string with 5 calibratable values, only visible in INCA (SAM doesn't support ascii format)" ASCII 0xa080002d _REC_VAL_3_u1 255. _CNV_A_R_LINEAR_____50_CM 0. 255. DISPLAY_IDENTIFIER C_DATA_ID_1 NUMBER 5 /end CHARACTERISTIC
/begin CHARACTERISTIC c_data_id_2 "Dataset identifier, string with 5 calibratable values, only visible in INCA (SAM doesn't support ascii format)" ASCII 0xa080003e _REC_VAL_3_u1 255. _CNV_A_R_LINEAR_____50_CM 0. 255. DISPLAY_IDENTIFIER C_DATA_ID_2 NUMBER 5 /end CHARACTERISTIC
/begin CHARACTERISTIC cal_cks_active "Constant to activate the dataset checksum calculation" VALUE 0xa080034c _REC_VAL_20_u2 65535. _CNV_A_R_LINEAR_____0_CM 0. 65535. DISPLAY_IDENTIFIER C_CHECK_SUM FORMAT "%5.0" /end CHARACTERISTIC
/begin MEASUREMENT lv_state_tbl_alter_inh "Bit indicating that writing of STATE_TBL_ALTER_DC is stopped" UBYTE _CNV_S_2_RANGE__0___1_CM 1 100. 0. 1. DISPLAY_IDENTIFIER LV_STATE_TBL_ALTER_INH ECU_ADDRESS 0xd00015d4 BIT_MASK 0x1 /end MEASUREMENT
/begin MEASUREMENT t_state_tbl_alter_dc "Time since starting to write STATE_TBL_ALTER_DC" UWORD _CNV_A_R_LINEAR_____36_CM 1 100. 0. 65535. DISPLAY_IDENTIFIER T_STATE_TBL_ALTER_DC ECU_ADDRESS 0xd00015d0 FORMAT "%5.0" /end MEASUREMENT
/begin MEASUREMENT t_state_tbl_alter "Time since starting to write STATE_TBL_ALTER (saved in NVMY)" ULONG _CNV_A_R_LINEAR_____36_CM 1 100. 0. 4294967294. DISPLAY_IDENTIFIER T_STATE_TBL_ALTER ECU_ADDRESS 0xd000ba40 FORMAT "%11.0" /end MEASUREMENT
/begin AXIS_PTS ldp_n_alter "" 0xa0808adc NO_INPUT_QUANTITY _REC_AXS_20_u2 65535. _CNV_A_R_LINEAR_____193_CM 5 -32768. 32767. FORMAT "%6.0" /end AXIS_PTS
/begin AXIS_PTS ldp_pow_rel_alter "" 0xa0808c7e NO_INPUT_QUANTITY _REC_AXS_20_u1 96.875 _CNV_A_R_LINEAR_____402_CM 5 0. 96.875 FORMAT "%4.1" /end AXIS_PTS
/begin AXIS_PTS ldp_temp_alter_mc "" 0xa0808e5c NO_INPUT_QUANTITY _REC_AXS_20_u1 248. _CNV_A_R_LINEAR_____405_CM 7 -32. 216. FORMAT "%4.0" /end AXIS_PTS
/begin CHARACTERISTIC id_state_temp_alter "Table with x-axis for STATE_TBL_ALTER and STATE_TBL_ALTER_DC" CURVE 0xa0809e1c _REC_CUR_20_u1_u1 6. _CNV_A_R_LINEAR_____0_CM 1. 7. DISPLAY_IDENTIFIER ID_STATE_TEMP_ALTER FORMAT "%1.0"
 /begin AXIS_DESCR COM_AXIS NO_INPUT_QUANTITY _CNV_A_R_LINEAR_____405_CM 7 -32. 216. FORMAT "%4.0" AXIS_PTS_REF ldp_temp_alter_mc /end AXIS_DESCR
/end CHARACTERISTIC
/begin CHARACTERISTIC id_state_load_alter "Table with y-axis for STATE_TBL_ALTER and STATE_TBL_ALTER_DC" CURVE 0xa0809e10 _REC_CUR_20_u1_u1 4. _CNV_A_R_LINEAR_____0_CM 1. 5. DISPLAY_IDENTIFIER ID_STATE_LOAD_ALTER FORMAT "%2.0"
 /begin AXIS_DESCR COM_AXIS NO_INPUT_QUANTITY _CNV_A_R_LINEAR_____402_CM 5 0. 96.875 FORMAT "%4.1" AXIS_PTS_REF ldp_pow_rel_alter /end AXIS_DESCR
/end CHARACTERISTIC
/begin CHARACTERISTIC id_state_n_alter "Table with z-axis for STATE_TBL_ALTER and STATE_TBL_ALTER_DC" CURVE 0xa0809e16 _REC_CUR_20_u1_u2 4. _CNV_A_R_LINEAR_____0_CM 1. 5. DISPLAY_IDENTIFIER ID_STATE_N_ALTER FORMAT "%2.0"
 /begin AXIS_DESCR COM_AXIS NO_INPUT_QUANTITY _CNV_A_R_LINEAR_____193_CM 5 -32768. 32767. FORMAT "%6.0" AXIS_PTS_REF ldp_n_alter /end AXIS_DESCR
/end CHARACTERISTIC
/begin MEASUREMENT state_tbl_alter[0][0][0] "Table with profile of alternator over alternator chip-temperature, load and speed (saved in NVMY)" UBYTE _CNV_A_R_LINEAR_____5_CM 1 100. 0. 99.609375 DISPLAY_IDENTIFIER STATE_TBL_ALTER[0][0][0] ECU_ADDRESS 0xd0008d2c FORMAT "%9.6" /end MEASUREMENT
/begin MEASUREMENT state_tbl_alter[0][0][1] "Table with profile of alternator over alternator chip-temperature, load and speed (saved in NVMY)" UBYTE _CNV_A_R_LINEAR_____5_CM 1 100. 0. 99.609375 DISPLAY_IDENTIFIER STATE_TBL_ALTER[0][0][1] ECU_ADDRESS 0xd0008d2d FORMAT "%9.6" /end MEASUREMENT
/begin MEASUREMENT state_tbl_alter[0][0][2] "Table with profile of alternator over alternator chip-temperature, load and speed (saved in NVMY)" UBYTE _CNV_A_R_LINEAR_____5_CM 1 100. 0. 99.609375 DISPLAY_IDENTIFIER STATE_TBL_ALTER[0][0][2] ECU_ADDRESS 0xd0008d2e FORMAT "%9.6" /end MEASUREMENT
/begin MEASUREMENT state_tbl_alter[0][0][3] "Table with profile of alternator over alternator chip-temperature, load and speed (saved in NVMY)" UBYTE _CNV_A_R_LINEAR_____5_CM 1 100. 0. 99.609375 DISPLAY_IDENTIFIER STATE_TBL_ALTER[0][0][3] ECU_ADDRESS 0xd0008d2f FORMAT "%9.6" /end MEASUREMENT
/begin MEASUREMENT state_tbl_alter[0][0][4] "Table with profile of alternator over alternator chip-temperature, load and speed (saved in NVMY)" UBYTE _CNV_A_R_LINEAR_____5_CM 1 100. 0. 99.609375 DISPLAY_IDENTIFIER STATE_TBL_ALTER[0][0][4] ECU_ADDRESS 0xd0008d30 FORMAT "%9.6" /end MEASUREMENT
/begin MEASUREMENT state_tbl_alter[0][1][0] "Table with profile of alternator over alternator chip-temperature, load and speed (saved in NVMY)" UBYTE _CNV_A_R_LINEAR_____5_CM 1 100. 0. 99.609375 DISPLAY_IDENTIFIER STATE_TBL_ALTER[0][1][0] ECU_ADDRESS 0xd0008d31 FORMAT "%9.6" /end MEASUREMENT
/begin MEASUREMENT state_tbl_alter[0][1][1] "Table with profile of alternator over alternator chip-temperature, load and speed (saved in NVMY)" UBYTE _CNV_A_R_LINEAR_____5_CM 1 100. 0. 99.609375 DISPLAY_IDENTIFIER STATE_TBL_ALTER[0][1][1] ECU_ADDRESS 0xd0008d32 FORMAT "%9.6" /end MEASUREMENT
/begin MEASUREMENT state_tbl_alter[0][1][2] "Table with profile of alternator over alternator chip-temperature, load and speed (saved in NVMY)" UBYTE _CNV_A_R_LINEAR_____5_CM 1 100. 0. 99.609375 DISPLAY_IDENTIFIER STATE_TBL_ALTER[0][1][2] ECU_ADDRESS 0xd0008d33 FORMAT "%9.6" /end MEASUREMENT
/begin MEASUREMENT state_tbl_alter[0][1][3] "Table with profile of alternator over alternator chip-temperature, load and speed (saved in NVMY)" UBYTE _CNV_A_R_LINEAR_____5_CM 1 100. 0. 99.609375 DISPLAY_IDENTIFIER STATE_TBL_ALTER[0][1][3] ECU_ADDRESS 0xd0008d34 FORMAT "%9.6" /end MEASUREMENT
/begin MEASUREMENT state_tbl_alter[0][1][4] "Table with profile of alternator over alternator chip-temperature, load and speed (saved in NVMY)" UBYTE _CNV_A_R_LINEAR_____5_CM 1 100. 0. 99.609375 DISPLAY_IDENTIFIER STATE_TBL_ALTER[0][1][4] ECU_ADDRESS 0xd0008d35 FORMAT "%9.6" /end MEASUREMENT
/begin MEASUREMENT state_tbl_alter[0][2][0] "Table with profile of alternator over alternator chip-temperature, load and speed (saved in NVMY)" UBYTE _CNV_A_R_LINEAR_____5_CM 1 100. 0. 99.609375 DISPLAY_IDENTIFIER STATE_TBL_ALTER[0][2][0] ECU_ADDRESS 0xd0008d36 FORMAT "%9.6" /end MEASUREMENT
/begin MEASUREMENT state_tbl_alter[0][2][1] "Table with profile of alternator over alternator chip-temperature, load and speed (saved in NVMY)" UBYTE _CNV_A_R_LINEAR_____5_CM 1 100. 0. 99.609375 DISPLAY_IDENTIFIER STATE_TBL_ALTER[0][2][1] ECU_ADDRESS 0xd0008d37 FORMAT "%9.6" /end MEASUREMENT
/begin MEASUREMENT state_tbl_alter[0][2][2] "Table with profile of alternator over alternator chip-temperature, load and speed (saved in NVMY)" UBYTE _CNV_A_R_LINEAR_____5_CM 1 100. 0. 99.609375 DISPLAY_IDENTIFIER STATE_TBL_ALTER[0][2][2] ECU_ADDRESS 0xd0008d38 FORMAT "%9.6" /end MEASUREMENT
/begin MEASUREMENT state_tbl_alter[0][2][3] "Table with profile of alternator over alternator chip-temperature, load and speed (saved in NVMY)" UBYTE _CNV_A_R_LINEAR_____5_CM 1 100. 0. 99.609375 DISPLAY_IDENTIFIER STATE_TBL_ALTER[0][2][3] ECU_ADDRESS 0xd0008d39 FORMAT "%9.6" /end MEASUREMENT
/begin MEASUREMENT state_tbl_alter[0][2][4] "Table with profile of alternator over alternator chip-temperature, load and speed (saved in NVMY)" UBYTE _CNV_A_R_LINEAR_____5_CM 1 100. 0. 99.609375 DISPLAY_IDENTIFIER STATE_TBL_ALTER[0][2][4] ECU_ADDRESS 0xd0008d3a FORMAT "%9.6" /end MEASUREMENT
/begin MEASUREMENT state_tbl_alter[0][3][0] "Table with profile of alternator over alternator chip-temperature, load and speed (saved in NVMY)" UBYTE _CNV_A_R_LINEAR_____5_CM 1 100. 0. 99.609375 DISPLAY_IDENTIFIER STATE_TBL_ALTER[0][3][0] ECU_ADDRESS 0xd0008d3b FORMAT "%9.6" /end MEASUREMENT
/begin MEASUREMENT state_tbl_alter[0][3][1] "Table with profile of alternator over alternator chip-temperature, load and speed (saved in NVMY)" UBYTE _CNV_A_R_LINEAR_____5_CM 1 100. 0. 99.609375 DISPLAY_IDENTIFIER STATE_TBL_ALTER[0][3][1] ECU_ADDRESS 0xd0008d3c FORMAT "%9.6" /end MEASUREMENT
/begin MEASUREMENT state_tbl_alter[0][3][2] "Table with profile of alternator over alternator chip-temperature, load and speed (saved in NVMY)" UBYTE _CNV_A_R_LINEAR_____5_CM 1 100. 0. 99.609375 DISPLAY_IDENTIFIER STATE_TBL_ALTER[0][3][2] ECU_ADDRESS 0xd0008d3d FORMAT "%9.6" /end MEASUREMENT
/begin MEASUREMENT state_tbl_alter[0][3][3] "Table with profile of alternator over alternator chip-temperature, load and speed (saved in NVMY)" UBYTE _CNV_A_R_LINEAR_____5_CM 1 100. 0. 99.609375 DISPLAY_IDENTIFIER STATE_TBL_ALTER[0][3][3] ECU_ADDRESS 0xd0008d3e FORMAT "%9.6" /end MEASUREMENT
/begin MEASUREMENT state_tbl_alter[0][3][4] "Table with profile of alternator over alternator chip-temperature, load and speed (saved in NVMY)" UBYTE _CNV_A_R_LINEAR_____5_CM 1 100. 0. 99.609375 DISPLAY_IDENTIFIER STATE_TBL_ALTER[0][3][4] ECU_ADDRESS 0xd0008d3f FORMAT "%9.6" /end MEASUREMENT
/begin MEASUREMENT state_tbl_alter[0][4][0] "Table with profile of alternator over alternator chip-temperature, load and speed (saved in NVMY)" UBYTE _CNV_A_R_LINEAR_____5_CM 1 100. 0. 99.609375 DISPLAY_IDENTIFIER STATE_TBL_ALTER[0][4][0] ECU_ADDRESS 0xd0008d40 FORMAT "%9.6" /end MEASUREMENT
/begin MEASUREMENT state_tbl_alter[0][4][1] "Table with profile of alternator over alternator chip-temperature, load and speed (saved in NVMY)" UBYTE _CNV_A_R_LINEAR_____5_CM 1 100. 0. 99.609375 DISPLAY_IDENTIFIER STATE_TBL_ALTER[0][4][1] ECU_ADDRESS 0xd0008d41 FORMAT "%9.6" /end MEASUREMENT
/begin MEASUREMENT state_tbl_alter[0][4][2] "Table with profile of alternator over alternator chip-temperature, load and speed (saved in NVMY)" UBYTE _CNV_A_R_LINEAR_____5_CM 1 100. 0. 99.609375 DISPLAY_IDENTIFIER STATE_TBL_ALTER[0][4][2] ECU_ADDRESS 0xd0008d42 FORMAT "%9.6" /end MEASUREMENT
/begin MEASUREMENT state_tbl_alter[0][4][3] "Table with profile of alternator over alternator chip-temperature, load and speed (saved in NVMY)" UBYTE _CNV_A_R_LINEAR_____5_CM 1 100. 0. 99.609375 DISPLAY_IDENTIFIER STATE_TBL_ALTER[0][4][3] ECU_ADDRESS 0xd0008d43 FORMAT "%9.6" /end MEASUREMENT
/begin MEASUREMENT state_tbl_alter[0][4][4] "Table with profile of alternator over alternator chip-temperature, load and speed (saved in NVMY)" UBYTE _CNV_A_R_LINEAR_____5_CM 1 100. 0. 99.609375 DISPLAY_IDENTIFIER STATE_TBL_ALTER[0][4][4] ECU_ADDRESS 0xd0008d44 FORMAT "%9.6" /end MEASUREMENT
/begin MEASUREMENT state_tbl_alter[1][0][0] "Table with profile of alternator over alternator chip-temperature, load and speed (saved in NVMY)" UBYTE _CNV_A_R_LINEAR_____5_CM 1 100. 0. 99.609375 DISPLAY_IDENTIFIER STATE_TBL_ALTER[1][0][0] ECU_ADDRESS 0xd0008d45 FORMAT "%9.6" /end MEASUREMENT
/begin MEASUREMENT state_tbl_alter[1][0][1] "Table with profile of alternator over alternator chip-temperature, load and speed (saved in NVMY)" UBYTE _CNV_A_R_LINEAR_____5_CM 1 100. 0. 99.609375 DISPLAY_IDENTIFIER STATE_TBL_ALTER[1][0][1] ECU_ADDRESS 0xd0008d46 FORMAT "%9.6" /end MEASUREMENT
/begin MEASUREMENT state_tbl_alter[1][0][2] "Table with profile of alternator over alternator chip-temperature, load and speed (saved in NVMY)" UBYTE _CNV_A_R_LINEAR_____5_CM 1 100. 0. 99.609375 DISPLAY_IDENTIFIER STATE_TBL_ALTER[1][0][2] ECU_ADDRESS 0xd0008d47 FORMAT "%9.6" /end MEASUREMENT
/begin MEASUREMENT state_tbl_alter[1][0][3] "Table with profile of alternator over alternator chip-temperature, load and speed (saved in NVMY)" UBYTE _CNV_A_R_LINEAR_____5_CM 1 100. 0. 99.609375 DISPLAY_IDENTIFIER STATE_TBL_ALTER[1][0][3] ECU_ADDRESS 0xd0008d48 FORMAT "%9.6" /end MEASUREMENT
/begin MEASUREMENT state_tbl_alter[1][0][4] "Table with profile of alternator over alternator chip-temperature, load and speed (saved in NVMY)" UBYTE _CNV_A_R_LINEAR_____5_CM 1 100. 0. 99.609375 DISPLAY_IDENTIFIER STATE_TBL_ALTER[1][0][4] ECU_ADDRESS 0xd0008d49 FORMAT "%9.6" /end MEASUREMENT
/begin MEASUREMENT state_tbl_alter[1][1][0] "Table with profile of alternator over alternator chip-temperature, load and speed (saved in NVMY)" UBYTE _CNV_A_R_LINEAR_____5_CM 1 100. 0. 99.609375 DISPLAY_IDENTIFIER STATE_TBL_ALTER[1][1][0] ECU_ADDRESS 0xd0008d4a FORMAT "%9.6" /end MEASUREMENT
/begin MEASUREMENT state_tbl_alter[1][1][1] "Table with profile of alternator over alternator chip-temperature, load and speed (saved in NVMY)" UBYTE _CNV_A_R_LINEAR_____5_CM 1 100. 0. 99.609375 DISPLAY_IDENTIFIER STATE_TBL_ALTER[1][1][1] ECU_ADDRESS 0xd0008d4b FORMAT "%9.6" /end MEASUREMENT
/begin MEASUREMENT state_tbl_alter[1][1][2] "Table with profile of alternator over alternator chip-temperature, load and speed (saved in NVMY)" UBYTE _CNV_A_R_LINEAR_____5_CM 1 100. 0. 99.609375 DISPLAY_IDENTIFIER STATE_TBL_ALTER[1][1][2] ECU_ADDRESS 0xd0008d4c FORMAT "%9.6" /end MEASUREMENT
/begin MEASUREMENT state_tbl_alter[1][1][3] "Table with profile of alternator over alternator chip-temperature, load and speed (saved in NVMY)" UBYTE _CNV_A_R_LINEAR_____5_CM 1 100. 0. 99.609375 DISPLAY_IDENTIFIER STATE_TBL_ALTER[1][1][3] ECU_ADDRESS 0xd0008d4d FORMAT "%9.6" /end MEASUREMENT
/begin MEASUREMENT state_tbl_alter[1][1][4] "Table with profile of alternator over alternator chip-temperature, load and speed (saved in NVMY)" UBYTE _CNV_A_R_LINEAR_____5_CM 1 100. 0. 99.609375 DISPLAY_IDENTIFIER STATE_TBL_ALTER[1][1][4] ECU_ADDRESS 0xd0008d4e FORMAT "%9.6" /end MEASUREMENT
/begin MEASUREMENT state_tbl_alter[1][2][0] "Table with profile of alternator over alternator chip-temperature, load and speed (saved in NVMY)" UBYTE _CNV_A_R_LINEAR_____5_CM 1 100. 0. 99.609375 DISPLAY_IDENTIFIER STATE_TBL_ALTER[1][2][0] ECU_ADDRESS 0xd0008d4f FORMAT "%9.6" /end MEASUREMENT
/begin MEASUREMENT state_tbl_alter[1][2][1] "Table with profile of alternator over alternator chip-temperature, load and speed (saved in NVMY)" UBYTE _CNV_A_R_LINEAR_____5_CM 1 100. 0. 99.609375 DISPLAY_IDENTIFIER STATE_TBL_ALTER[1][2][1] ECU_ADDRESS 0xd0008d50 FORMAT "%9.6" /end MEASUREMENT
/begin MEASUREMENT state_tbl_alter[1][2][2] "Table with profile of alternator over alternator chip-temperature, load and speed (saved in NVMY)" UBYTE _CNV_A_R_LINEAR_____5_CM 1 100. 0. 99.609375 DISPLAY_IDENTIFIER STATE_TBL_ALTER[1][2][2] ECU_ADDRESS 0xd0008d51 FORMAT "%9.6" /end MEASUREMENT
/begin MEASUREMENT state_tbl_alter[1][2][3] "Table with profile of alternator over alternator chip-temperature, load and speed (saved in NVMY)" UBYTE _CNV_A_R_LINEAR_____5_CM 1 100. 0. 99.609375 DISPLAY_IDENTIFIER STATE_TBL_ALTER[1][2][3] ECU_ADDRESS 0xd0008d52 FORMAT "%9.6" /end MEASUREMENT
/begin MEASUREMENT state_tbl_alter[1][2][4] "Table with profile of alternator over alternator chip-temperature, load and speed (saved in NVMY)" UBYTE _CNV_A_R_LINEAR_____5_CM 1 100. 0. 99.609375 DISPLAY_IDENTIFIER STATE_TBL_ALTER[1][2][4] ECU_ADDRESS 0xd0008d53 FORMAT "%9.6" /end MEASUREMENT
/begin MEASUREMENT state_tbl_alter[1][3][0] "Table with profile of alternator over alternator chip-temperature, load and speed (saved in NVMY)" UBYTE _CNV_A_R_LINEAR_____5_CM 1 100. 0. 99.609375 DISPLAY_IDENTIFIER STATE_TBL_ALTER[1][3][0] ECU_ADDRESS 0xd0008d54 FORMAT "%9.6" /end MEASUREMENT
/begin MEASUREMENT state_tbl_alter[1][3][1] "Table with profile of alternator over alternator chip-temperature, load and speed (saved in NVMY)" UBYTE _CNV_A_R_LINEAR_____5_CM 1 100. 0. 99.609375 DISPLAY_IDENTIFIER STATE_TBL_ALTER[1][3][1] ECU_ADDRESS 0xd0008d55 FORMAT "%9.6" /end MEASUREMENT
/begin MEASUREMENT state_tbl_alter[1][3][2] "Table with profile of alternator over alternator chip-temperature, load and speed (saved in NVMY)" UBYTE _CNV_A_R_LINEAR_____5_CM 1 100. 0. 99.609375 DISPLAY_IDENTIFIER STATE_TBL_ALTER[1][3][2] ECU_ADDRESS 0xd0008d56 FORMAT "%9.6" /end MEASUREMENT
/begin MEASUREMENT state_tbl_alter[1][3][3] "Table with profile of alternator over alternator chip-temperature, load and speed (saved in NVMY)" UBYTE _CNV_A_R_LINEAR_____5_CM 1 100. 0. 99.609375 DISPLAY_IDENTIFIER STATE_TBL_ALTER[1][3][3] ECU_ADDRESS 0xd0008d57 FORMAT "%9.6" /end MEASUREMENT
/begin MEASUREMENT state_tbl_alter[1][3][4] "Table with profile of alternator over alternator chip-temperature, load and speed (saved in NVMY)" UBYTE _CNV_A_R_LINEAR_____5_CM 1 100. 0. 99.609375 DISPLAY_IDENTIFIER STATE_TBL_ALTER[1][3][4] ECU_ADDRESS 0xd0008d58 FORMAT "%9.6" /end MEASUREMENT
/begin MEASUREMENT state_tbl_alter[1][4][0] "Table with profile of alternator over alternator chip-temperature, load and speed (saved in NVMY)" UBYTE _CNV_A_R_LINEAR_____5_CM 1 100. 0. 99.609375 DISPLAY_IDENTIFIER STATE_TBL_ALTER[1][4][0] ECU_ADDRESS 0xd0008d59 FORMAT "%9.6" /end MEASUREMENT
/begin MEASUREMENT state_tbl_alter[1][4][1] "Table with profile of alternator over alternator chip-temperature, load and speed (saved in NVMY)" UBYTE _CNV_A_R_LINEAR_____5_CM 1 100. 0. 99.609375 DISPLAY_IDENTIFIER STATE_TBL_ALTER[1][4][1] ECU_ADDRESS 0xd0008d5a FORMAT "%9.6" /end MEASUREMENT
/begin MEASUREMENT state_tbl_alter[1][4][2] "Table with profile of alternator over alternator chip-temperature, load and speed (saved in NVMY)" UBYTE _CNV_A_R_LINEAR_____5_CM 1 100. 0. 99.609375 DISPLAY_IDENTIFIER STATE_TBL_ALTER[1][4][2] ECU_ADDRESS 0xd0008d5b FORMAT "%9.6" /end MEASUREMENT
/begin MEASUREMENT state_tbl_alter[1][4][3] "Table with profile of alternator over alternator chip-temperature, load and speed (saved in NVMY)" UBYTE _CNV_A_R_LINEAR_____5_CM 1 100. 0. 99.609375 DISPLAY_IDENTIFIER STATE_TBL_ALTER[1][4][3] ECU_ADDRESS 0xd0008d5c FORMAT "%9.6" /end MEASUREMENT
/begin MEASUREMENT state_tbl_alter[1][4][4] "Table with profile of alternator over alternator chip-temperature, load and speed (saved in NVMY)" UBYTE _CNV_A_R_LINEAR_____5_CM 1 100. 0. 99.609375 DISPLAY_IDENTIFIER STATE_TBL_ALTER[1][4][4] ECU_ADDRESS 0xd0008d5d FORMAT "%9.6" /end MEASUREMENT
/begin MEASUREMENT state_tbl_alter[2][0][0] "Table with profile of alternator over alternator chip-temperature, load and speed (saved in NVMY)" UBYTE _CNV_A_R_LINEAR_____5_CM 1 100. 0. 99.609375 DISPLAY_IDENTIFIER STATE_TBL_ALTER[2][0][0] ECU_ADDRESS 0xd0008d5e FORMAT "%9.6" /end MEASUREMENT
/begin MEASUREMENT state_tbl_alter[2][0][1] "Table with profile of alternator over alternator chip-temperature, load and speed (saved in NVMY)" UBYTE _CNV_A_R_LINEAR_____5_CM 1 100. 0. 99.609375 DISPLAY_IDENTIFIER STATE_TBL_ALTER[2][0][1] ECU_ADDRESS 0xd0008d5f FORMAT "%9.6" /end MEASUREMENT
/begin MEASUREMENT state_tbl_alter[2][0][2] "Table with profile of alternator over alternator chip-temperature, load and speed (saved in NVMY)" UBYTE _CNV_A_R_LINEAR_____5_CM 1 100. 0. 99.609375 DISPLAY_IDENTIFIER STATE_TBL_ALTER[2][0][2] ECU_ADDRESS 0xd0008d60 FORMAT "%9.6" /end MEASUREMENT
/begin MEASUREMENT state_tbl_alter[2][0][3] "Table with profile of alternator over alternator chip-temperature, load and speed (saved in NVMY)" UBYTE _CNV_A_R_LINEAR_____5_CM 1 100. 0. 99.609375 DISPLAY_IDENTIFIER STATE_TBL_ALTER[2][0][3] ECU_ADDRESS 0xd0008d61 FORMAT "%9.6" /end MEASUREMENT
/begin MEASUREMENT state_tbl_alter[2][0][4] "Table with profile of alternator over alternator chip-temperature, load and speed (saved in NVMY)" UBYTE _CNV_A_R_LINEAR_____5_CM 1 100. 0. 99.609375 DISPLAY_IDENTIFIER STATE_TBL_ALTER[2][0][4] ECU_ADDRESS 0xd0008d62 FORMAT "%9.6" /end MEASUREMENT
/begin MEASUREMENT state_tbl_alter[2][1][0] "Table with profile of alternator over alternator chip-temperature, load and speed (saved in NVMY)" UBYTE _CNV_A_R_LINEAR_____5_CM 1 100. 0. 99.609375 DISPLAY_IDENTIFIER STATE_TBL_ALTER[2][1][0] ECU_ADDRESS 0xd0008d63 FORMAT "%9.6" /end MEASUREMENT
/begin MEASUREMENT state_tbl_alter[2][1][1] "Table with profile of alternator over alternator chip-temperature, load and speed (saved in NVMY)" UBYTE _CNV_A_R_LINEAR_____5_CM 1 100. 0. 99.609375 DISPLAY_IDENTIFIER STATE_TBL_ALTER[2][1][1] ECU_ADDRESS 0xd0008d64 FORMAT "%9.6" /end MEASUREMENT
/begin MEASUREMENT state_tbl_alter[2][1][2] "Table with profile of alternator over alternator chip-temperature, load and speed (saved in NVMY)" UBYTE _CNV_A_R_LINEAR_____5_CM 1 100. 0. 99.609375 DISPLAY_IDENTIFIER STATE_TBL_ALTER[2][1][2] ECU_ADDRESS 0xd0008d65 FORMAT "%9.6" /end MEASUREMENT
/begin MEASUREMENT state_tbl_alter[2][1][3] "Table with profile of alternator over alternator chip-temperature, load and speed (saved in NVMY)" UBYTE _CNV_A_R_LINEAR_____5_CM 1 100. 0. 99.609375 DISPLAY_IDENTIFIER STATE_TBL_ALTER[2][1][3] ECU_ADDRESS 0xd0008d66 FORMAT "%9.6" /end MEASUREMENT
/begin MEASUREMENT state_tbl_alter[2][1][4] "Table with profile of alternator over alternator chip-temperature, load and speed (saved in NVMY)" UBYTE _CNV_A_R_LINEAR_____5_CM 1 100. 0. 99.609375 DISPLAY_IDENTIFIER STATE_TBL_ALTER[2][1][4] ECU_ADDRESS 0xd0008d67 FORMAT "%9.6" /end MEASUREMENT
/begin MEASUREMENT state_tbl_alter[2][2][0] "Table with profile of alternator over alternator chip-temperature, load and speed (saved in NVMY)" UBYTE _CNV_A_R_LINEAR_____5_CM 1 100. 0. 99.609375 DISPLAY_IDENTIFIER STATE_TBL_ALTER[2][2][0] ECU_ADDRESS 0xd0008d68 FORMAT "%9.6" /end MEASUREMENT
/begin MEASUREMENT state_tbl_alter[2][2][1] "Table with profile of alternator over alternator chip-temperature, load and speed (saved in NVMY)" UBYTE _CNV_A_R_LINEAR_____5_CM 1 100. 0. 99.609375 DISPLAY_IDENTIFIER STATE_TBL_ALTER[2][2][1] ECU_ADDRESS 0xd0008d69 FORMAT "%9.6" /end MEASUREMENT
/begin MEASUREMENT state_tbl_alter[2][2][2] "Table with profile of alternator over alternator chip-temperature, load and speed (saved in NVMY)" UBYTE _CNV_A_R_LINEAR_____5_CM 1 100. 0. 99.609375 DISPLAY_IDENTIFIER STATE_TBL_ALTER[2][2][2] ECU_ADDRESS 0xd0008d6a FORMAT "%9.6" /end MEASUREMENT
/begin MEASUREMENT state_tbl_alter[2][2][3] "Table with profile of alternator over alternator chip-temperature, load and speed (saved in NVMY)" UBYTE _CNV_A_R_LINEAR_____5_CM 1 100. 0. 99.609375 DISPLAY_IDENTIFIER STATE_TBL_ALTER[2][2][3] ECU_ADDRESS 0xd0008d6b FORMAT "%9.6" /end MEASUREMENT
/begin MEASUREMENT state_tbl_alter[2][2][4] "Table with profile of alternator over alternator chip-temperature, load and speed (saved in NVMY)" UBYTE _CNV_A_R_LINEAR_____5_CM 1 100. 0. 99.609375 DISPLAY_IDENTIFIER STATE_TBL_ALTER[2][2][4] ECU_ADDRESS 0xd0008d6c FORMAT "%9.6" /end MEASUREMENT
/begin MEASUREMENT state_tbl_alter[2][3][0] "Table with profile of alternator over alternator chip-temperature, load and speed (saved in NVMY)" UBYTE _CNV_A_R_LINEAR_____5_CM 1 100. 0. 99.609375 DISPLAY_IDENTIFIER STATE_TBL_ALTER[2][3][0] ECU_ADDRESS 0xd0008d6d FORMAT "%9.6" /end MEASUREMENT
/begin MEASUREMENT state_tbl_alter[2][3][1] "Table with profile of alternator over alternator chip-temperature, load and speed (saved in NVMY)" UBYTE _CNV_A_R_LINEAR_____5_CM 1 100. 0. 99.609375 DISPLAY_IDENTIFIER STATE_TBL_ALTER[2][3][1] ECU_ADDRESS 0xd0008d6e FORMAT "%9.6" /end MEASUREMENT
/begin MEASUREMENT state_tbl_alter[2][3][2] "Table with profile of alternator over alternator chip-temperature, load and speed (saved in NVMY)" UBYTE _CNV_A_R_LINEAR_____5_CM 1 100. 0. 99.609375 DISPLAY_IDENTIFIER STATE_TBL_ALTER[2][3][2] ECU_ADDRESS 0xd0008d6f FORMAT "%9.6" /end MEASUREMENT
/begin MEASUREMENT state_tbl_alter[2][3][3] "Table with profile of alternator over alternator chip-temperature, load and speed (saved in NVMY)" UBYTE _CNV_A_R_LINEAR_____5_CM 1 100. 0. 99.609375 DISPLAY_IDENTIFIER STATE_TBL_ALTER[2][3][3] ECU_ADDRESS 0xd0008d70 FORMAT "%9.6" /end MEASUREMENT
/begin MEASUREMENT state_tbl_alter[2][3][4] "Table with profile of alternator over alternator chip-temperature, load and speed (saved in NVMY)" UBYTE _CNV_A_R_LINEAR_____5_CM 1 100. 0. 99.609375 DISPLAY_IDENTIFIER STATE_TBL_ALTER[2][3][4] ECU_ADDRESS 0xd0008d71 FORMAT "%9.6" /end MEASUREMENT
/begin MEASUREMENT state_tbl_alter[2][4][0] "Table with profile of alternator over alternator chip-temperature, load and speed (saved in NVMY)" UBYTE _CNV_A_R_LINEAR_____5_CM 1 100. 0. 99.609375 DISPLAY_IDENTIFIER STATE_TBL_ALTER[2][4][0] ECU_ADDRESS 0xd0008d72 FORMAT "%9.6" /end MEASUREMENT
/begin MEASUREMENT state_tbl_alter[2][4][1] "Table with profile of alternator over alternator chip-temperature, load and speed (saved in NVMY)" UBYTE _CNV_A_R_LINEAR_____5_CM 1 100. 0. 99.609375 DISPLAY_IDENTIFIER STATE_TBL_ALTER[2][4][1] ECU_ADDRESS 0xd0008d73 FORMAT "%9.6" /end MEASUREMENT
/begin MEASUREMENT state_tbl_alter[2][4][2] "Table with profile of alternator over alternator chip-temperature, load and speed (saved in NVMY)" UBYTE _CNV_A_R_LINEAR_____5_CM 1 100. 0. 99.609375 DISPLAY_IDENTIFIER STATE_TBL_ALTER[2][4][2] ECU_ADDRESS 0xd0008d74 FORMAT "%9.6" /end MEASUREMENT
/begin MEASUREMENT state_tbl_alter[2][4][3] "Table with profile of alternator over alternator chip-temperature, load and speed (saved in NVMY)" UBYTE _CNV_A_R_LINEAR_____5_CM 1 100. 0. 99.609375 DISPLAY_IDENTIFIER STATE_TBL_ALTER[2][4][3] ECU_ADDRESS 0xd0008d75 FORMAT "%9.6" /end MEASUREMENT
/begin MEASUREMENT state_tbl_alter[2][4][4] "Table with profile of alternator over alternator chip-temperature, load and speed (saved in NVMY)" UBYTE _CNV_A_R_LINEAR_____5_CM 1 100. 0. 99.609375 DISPLAY_IDENTIFIER STATE_TBL_ALTER[2][4][4] ECU_ADDRESS 0xd0008d76 FORMAT "%9.6" /end MEASUREMENT
/begin MEASUREMENT state_tbl_alter[3][0][0] "Table with profile of alternator over alternator chip-temperature, load and speed (saved in NVMY)" UBYTE _CNV_A_R_LINEAR_____5_CM 1 100. 0. 99.609375 DISPLAY_IDENTIFIER STATE_TBL_ALTER[3][0][0] ECU_ADDRESS 0xd0008d77 FORMAT "%9.6" /end MEASUREMENT
/begin MEASUREMENT state_tbl_alter[3][0][1] "Table with profile of alternator over alternator chip-temperature, load and speed (saved in NVMY)" UBYTE _CNV_A_R_LINEAR_____5_CM 1 100. 0. 99.609375 DISPLAY_IDENTIFIER STATE_TBL_ALTER[3][0][1] ECU_ADDRESS 0xd0008d78 FORMAT "%9.6" /end MEASUREMENT
/begin MEASUREMENT state_tbl_alter[3][0][2] "Table with profile of alternator over alternator chip-temperature, load and speed (saved in NVMY)" UBYTE _CNV_A_R_LINEAR_____5_CM 1 100. 0. 99.609375 DISPLAY_IDENTIFIER STATE_TBL_ALTER[3][0][2] ECU_ADDRESS 0xd0008d79 FORMAT "%9.6" /end MEASUREMENT
/begin MEASUREMENT state_tbl_alter[3][0][3] "Table with profile of alternator over alternator chip-temperature, load and speed (saved in NVMY)" UBYTE _CNV_A_R_LINEAR_____5_CM 1 100. 0. 99.609375 DISPLAY_IDENTIFIER STATE_TBL_ALTER[3][0][3] ECU_ADDRESS 0xd0008d7a FORMAT "%9.6" /end MEASUREMENT
/begin MEASUREMENT state_tbl_alter[3][0][4] "Table with profile of alternator over alternator chip-temperature, load and speed (saved in NVMY)" UBYTE _CNV_A_R_LINEAR_____5_CM 1 100. 0. 99.609375 DISPLAY_IDENTIFIER STATE_TBL_ALTER[3][0][4] ECU_ADDRESS 0xd0008d7b FORMAT "%9.6" /end MEASUREMENT
/begin MEASUREMENT state_tbl_alter[3][1][0] "Table with profile of alternator over alternator chip-temperature, load and speed (saved in NVMY)" UBYTE _CNV_A_R_LINEAR_____5_CM 1 100. 0. 99.609375 DISPLAY_IDENTIFIER STATE_TBL_ALTER[3][1][0] ECU_ADDRESS 0xd0008d7c FORMAT "%9.6" /end MEASUREMENT
/begin MEASUREMENT state_tbl_alter[3][1][1] "Table with profile of alternator over alternator chip-temperature, load and speed (saved in NVMY)" UBYTE _CNV_A_R_LINEAR_____5_CM 1 100. 0. 99.609375 DISPLAY_IDENTIFIER STATE_TBL_ALTER[3][1][1] ECU_ADDRESS 0xd0008d7d FORMAT "%9.6" /end MEASUREMENT
/begin MEASUREMENT state_tbl_alter[3][1][2] "Table with profile of alternator over alternator chip-temperature, load and speed (saved in NVMY)" UBYTE _CNV_A_R_LINEAR_____5_CM 1 100. 0. 99.609375 DISPLAY_IDENTIFIER STATE_TBL_ALTER[3][1][2] ECU_ADDRESS 0xd0008d7e FORMAT "%9.6" /end MEASUREMENT
/begin MEASUREMENT state_tbl_alter[3][1][3] "Table with profile of alternator over alternator chip-temperature, load and speed (saved in NVMY)" UBYTE _CNV_A_R_LINEAR_____5_CM 1 100. 0. 99.609375 DISPLAY_IDENTIFIER STATE_TBL_ALTER[3][1][3] ECU_ADDRESS 0xd0008d7f FORMAT "%9.6" /end MEASUREMENT
/begin MEASUREMENT state_tbl_alter[3][1][4] "Table with profile of alternator over alternator chip-temperature, load and speed (saved in NVMY)" UBYTE _CNV_A_R_LINEAR_____5_CM 1 100. 0. 99.609375 DISPLAY_IDENTIFIER STATE_TBL_ALTER[3][1][4] ECU_ADDRESS 0xd0008d80 FORMAT "%9.6" /end MEASUREMENT
/begin MEASUREMENT state_tbl_alter[3][2][0] "Table with profile of alternator over alternator chip-temperature, load and speed (saved in NVMY)" UBYTE _CNV_A_R_LINEAR_____5_CM 1 100. 0. 99.609375 DISPLAY_IDENTIFIER STATE_TBL_ALTER[3][2][0] ECU_ADDRESS 0xd0008d81 FORMAT "%9.6" /end MEASUREMENT
/begin MEASUREMENT state_tbl_alter[3][2][1] "Table with profile of alternator over alternator chip-temperature, load and speed (saved in NVMY)" UBYTE _CNV_A_R_LINEAR_____5_CM 1 100. 0. 99.609375 DISPLAY_IDENTIFIER STATE_TBL_ALTER[3][2][1] ECU_ADDRESS 0xd0008d82 FORMAT "%9.6" /end MEASUREMENT
/begin MEASUREMENT state_tbl_alter[3][2][2] "Table with profile of alternator over alternator chip-temperature, load and speed (saved in NVMY)" UBYTE _CNV_A_R_LINEAR_____5_CM 1 100. 0. 99.609375 DISPLAY_IDENTIFIER STATE_TBL_ALTER[3][2][2] ECU_ADDRESS 0xd0008d83 FORMAT "%9.6" /end MEASUREMENT
/begin MEASUREMENT state_tbl_alter[3][2][3] "Table with profile of alternator over alternator chip-temperature, load and speed (saved in NVMY)" UBYTE _CNV_A_R_LINEAR_____5_CM 1 100. 0. 99.609375 DISPLAY_IDENTIFIER STATE_TBL_ALTER[3][2][3] ECU_ADDRESS 0xd0008d84 FORMAT "%9.6" /end MEASUREMENT
/begin MEASUREMENT state_tbl_alter[3][2][4] "Table with profile of alternator over alternator chip-temperature, load and speed (saved in NVMY)" UBYTE _CNV_A_R_LINEAR_____5_CM 1 100. 0. 99.609375 DISPLAY_IDENTIFIER STATE_TBL_ALTER[3][2][4] ECU_ADDRESS 0xd0008d85 FORMAT "%9.6" /end MEASUREMENT
/begin MEASUREMENT state_tbl_alter[3][3][0] "Table with profile of alternator over alternator chip-temperature, load and speed (saved in NVMY)" UBYTE _CNV_A_R_LINEAR_____5_CM 1 100. 0. 99.609375 DISPLAY_IDENTIFIER STATE_TBL_ALTER[3][3][0] ECU_ADDRESS 0xd0008d86 FORMAT "%9.6" /end MEASUREMENT
/begin MEASUREMENT state_tbl_alter[3][3][1] "Table with profile of alternator over alternator chip-temperature, load and speed (saved in NVMY)" UBYTE _CNV_A_R_LINEAR_____5_CM 1 100. 0. 99.609375 DISPLAY_IDENTIFIER STATE_TBL_ALTER[3][3][1] ECU_ADDRESS 0xd0008d87 FORMAT "%9.6" /end MEASUREMENT
/begin MEASUREMENT state_tbl_alter[3][3][2] "Table with profile of alternator over alternator chip-temperature, load and speed (saved in NVMY)" UBYTE _CNV_A_R_LINEAR_____5_CM 1 100. 0. 99.609375 DISPLAY_IDENTIFIER STATE_TBL_ALTER[3][3][2] ECU_ADDRESS 0xd0008d88 FORMAT "%9.6" /end MEASUREMENT
/begin MEASUREMENT state_tbl_alter[3][3][3] "Table with profile of alternator over alternator chip-temperature, load and speed (saved in NVMY)" UBYTE _CNV_A_R_LINEAR_____5_CM 1 100. 0. 99.609375 DISPLAY_IDENTIFIER STATE_TBL_ALTER[3][3][3] ECU_ADDRESS 0xd0008d89 FORMAT "%9.6" /end MEASUREMENT
/begin MEASUREMENT state_tbl_alter[3][3][4] "Table with profile of alternator over alternator chip-temperature, load and speed (saved in NVMY)" UBYTE _CNV_A_R_LINEAR_____5_CM 1 100. 0. 99.609375 DISPLAY_IDENTIFIER STATE_TBL_ALTER[3][3][4] ECU_ADDRESS 0xd0008d8a FORMAT "%9.6" /end MEASUREMENT
/begin MEASUREMENT state_tbl_alter[3][4][0] "Table with profile of alternator over alternator chip-temperature, load and speed (saved in NVMY)" UBYTE _CNV_A_R_LINEAR_____5_CM 1 100. 0. 99.609375 DISPLAY_IDENTIFIER STATE_TBL_ALTER[3][4][0] ECU_ADDRESS 0xd0008d8b FORMAT "%9.6" /end MEASUREMENT
/begin MEASUREMENT state_tbl_alter[3][4][1] "Table with profile of alternator over alternator chip-temperature, load and speed (saved in NVMY)" UBYTE _CNV_A_R_LINEAR_____5_CM 1 100. 0. 99.609375 DISPLAY_IDENTIFIER STATE_TBL_ALTER[3][4][1] ECU_ADDRESS 0xd0008d8c FORMAT "%9.6" /end MEASUREMENT
/begin MEASUREMENT state_tbl_alter[3][4][2] "Table with profile of alternator over alternator chip-temperature, load and speed (saved in NVMY)" UBYTE _CNV_A_R_LINEAR_____5_CM 1 100. 0. 99.609375 DISPLAY_IDENTIFIER STATE_TBL_ALTER[3][4][2] ECU_ADDRESS 0xd0008d8d FORMAT "%9.6" /end MEASUREMENT
/begin MEASUREMENT state_tbl_alter[3][4][3] "Table with profile of alternator over alternator chip-temperature, load and speed (saved in NVMY)" UBYTE _CNV_A_R_LINEAR_____5_CM 1 100. 0. 99.609375 DISPLAY_IDENTIFIER STATE_TBL_ALTER[3][4][3] ECU_ADDRESS 0xd0008d8e FORMAT "%9.6" /end MEASUREMENT
/begin MEASUREMENT state_tbl_alter[3][4][4] "Table with profile of alternator over alternator chip-temperature, load and speed (saved in NVMY)" UBYTE _CNV_A_R_LINEAR_____5_CM 1 100. 0. 99.609375 DISPLAY_IDENTIFIER STATE_TBL_ALTER[3][4][4] ECU_ADDRESS 0xd0008d8f FORMAT "%9.6" /end MEASUREMENT
/begin MEASUREMENT state_tbl_alter[4][0][0] "Table with profile of alternator over alternator chip-temperature, load and speed (saved in NVMY)" UBYTE _CNV_A_R_LINEAR_____5_CM 1 100. 0. 99.609375 DISPLAY_IDENTIFIER STATE_TBL_ALTER[4][0][0] ECU_ADDRESS 0xd0008d90 FORMAT "%9.6" /end MEASUREMENT
/begin MEASUREMENT state_tbl_alter[4][0][1] "Table with profile of alternator over alternator chip-temperature, load and speed (saved in NVMY)" UBYTE _CNV_A_R_LINEAR_____5_CM 1 100. 0. 99.609375 DISPLAY_IDENTIFIER STATE_TBL_ALTER[4][0][1] ECU_ADDRESS 0xd0008d91 FORMAT "%9.6" /end MEASUREMENT
/begin MEASUREMENT state_tbl_alter[4][0][2] "Table with profile of alternator over alternator chip-temperature, load and speed (saved in NVMY)" UBYTE _CNV_A_R_LINEAR_____5_CM 1 100. 0. 99.609375 DISPLAY_IDENTIFIER STATE_TBL_ALTER[4][0][2] ECU_ADDRESS 0xd0008d92 FORMAT "%9.6" /end MEASUREMENT
/begin MEASUREMENT state_tbl_alter[4][0][3] "Table with profile of alternator over alternator chip-temperature, load and speed (saved in NVMY)" UBYTE _CNV_A_R_LINEAR_____5_CM 1 100. 0. 99.609375 DISPLAY_IDENTIFIER STATE_TBL_ALTER[4][0][3] ECU_ADDRESS 0xd0008d93 FORMAT "%9.6" /end MEASUREMENT
/begin MEASUREMENT state_tbl_alter[4][0][4] "Table with profile of alternator over alternator chip-temperature, load and speed (saved in NVMY)" UBYTE _CNV_A_R_LINEAR_____5_CM 1 100. 0. 99.609375 DISPLAY_IDENTIFIER STATE_TBL_ALTER[4][0][4] ECU_ADDRESS 0xd0008d94 FORMAT "%9.6" /end MEASUREMENT
/begin MEASUREMENT state_tbl_alter[4][1][0] "Table with profile of alternator over alternator chip-temperature, load and speed (saved in NVMY)" UBYTE _CNV_A_R_LINEAR_____5_CM 1 100. 0. 99.609375 DISPLAY_IDENTIFIER STATE_TBL_ALTER[4][1][0] ECU_ADDRESS 0xd0008d95 FORMAT "%9.6" /end MEASUREMENT
/begin MEASUREMENT state_tbl_alter[4][1][1] "Table with profile of alternator over alternator chip-temperature, load and speed (saved in NVMY)" UBYTE _CNV_A_R_LINEAR_____5_CM 1 100. 0. 99.609375 DISPLAY_IDENTIFIER STATE_TBL_ALTER[4][1][1] ECU_ADDRESS 0xd0008d96 FORMAT "%9.6" /end MEASUREMENT
/begin MEASUREMENT state_tbl_alter[4][1][2] "Table with profile of alternator over alternator chip-temperature, load and speed (saved in NVMY)" UBYTE _CNV_A_R_LINEAR_____5_CM 1 100. 0. 99.609375 DISPLAY_IDENTIFIER STATE_TBL_ALTER[4][1][2] ECU_ADDRESS 0xd0008d97 FORMAT "%9.6" /end MEASUREMENT
/begin MEASUREMENT state_tbl_alter[4][1][3] "Table with profile of alternator over alternator chip-temperature, load and speed (saved in NVMY)" UBYTE _CNV_A_R_LINEAR_____5_CM 1 100. 0. 99.609375 DISPLAY_IDENTIFIER STATE_TBL_ALTER[4][1][3] ECU_ADDRESS 0xd0008d98 FORMAT "%9.6" /end MEASUREMENT
/begin MEASUREMENT state_tbl_alter[4][1][4] "Table with profile of alternator over alternator chip-temperature, load and speed (saved in NVMY)" UBYTE _CNV_A_R_LINEAR_____5_CM 1 100. 0. 99.609375 DISPLAY_IDENTIFIER STATE_TBL_ALTER[4][1][4] ECU_ADDRESS 0xd0008d99 FORMAT "%9.6" /end MEASUREMENT
/begin MEASUREMENT state_tbl_alter[4][2][0] "Table with profile of alternator over alternator chip-temperature, load and speed (saved in NVMY)" UBYTE _CNV_A_R_LINEAR_____5_CM 1 100. 0. 99.609375 DISPLAY_IDENTIFIER STATE_TBL_ALTER[4][2][0] ECU_ADDRESS 0xd0008d9a FORMAT "%9.6" /end MEASUREMENT
/begin MEASUREMENT state_tbl_alter[4][2][1] "Table with profile of alternator over alternator chip-temperature, load and speed (saved in NVMY)" UBYTE _CNV_A_R_LINEAR_____5_CM 1 100. 0. 99.609375 DISPLAY_IDENTIFIER STATE_TBL_ALTER[4][2][1] ECU_ADDRESS 0xd0008d9b FORMAT "%9.6" /end MEASUREMENT
/begin MEASUREMENT state_tbl_alter[4][2][2] "Table with profile of alternator over alternator chip-temperature, load and speed (saved in NVMY)" UBYTE _CNV_A_R_LINEAR_____5_CM 1 100. 0. 99.609375 DISPLAY_IDENTIFIER STATE_TBL_ALTER[4][2][2] ECU_ADDRESS 0xd0008d9c FORMAT "%9.6" /end MEASUREMENT
/begin MEASUREMENT state_tbl_alter[4][2][3] "Table with profile of alternator over alternator chip-temperature, load and speed (saved in NVMY)" UBYTE _CNV_A_R_LINEAR_____5_CM 1 100. 0. 99.609375 DISPLAY_IDENTIFIER STATE_TBL_ALTER[4][2][3] ECU_ADDRESS 0xd0008d9d FORMAT "%9.6" /end MEASUREMENT
/begin MEASUREMENT state_tbl_alter[4][2][4] "Table with profile of alternator over alternator chip-temperature, load and speed (saved in NVMY)" UBYTE _CNV_A_R_LINEAR_____5_CM 1 100. 0. 99.609375 DISPLAY_IDENTIFIER STATE_TBL_ALTER[4][2][4] ECU_ADDRESS 0xd0008d9e FORMAT "%9.6" /end MEASUREMENT
/begin MEASUREMENT state_tbl_alter[4][3][0] "Table with profile of alternator over alternator chip-temperature, load and speed (saved in NVMY)" UBYTE _CNV_A_R_LINEAR_____5_CM 1 100. 0. 99.609375 DISPLAY_IDENTIFIER STATE_TBL_ALTER[4][3][0] ECU_ADDRESS 0xd0008d9f FORMAT "%9.6" /end MEASUREMENT
/begin MEASUREMENT state_tbl_alter[4][3][1] "Table with profile of alternator over alternator chip-temperature, load and speed (saved in NVMY)" UBYTE _CNV_A_R_LINEAR_____5_CM 1 100. 0. 99.609375 DISPLAY_IDENTIFIER STATE_TBL_ALTER[4][3][1] ECU_ADDRESS 0xd0008da0 FORMAT "%9.6" /end MEASUREMENT
/begin MEASUREMENT state_tbl_alter[4][3][2] "Table with profile of alternator over alternator chip-temperature, load and speed (saved in NVMY)" UBYTE _CNV_A_R_LINEAR_____5_CM 1 100. 0. 99.609375 DISPLAY_IDENTIFIER STATE_TBL_ALTER[4][3][2] ECU_ADDRESS 0xd0008da1 FORMAT "%9.6" /end MEASUREMENT
/begin MEASUREMENT state_tbl_alter[4][3][3] "Table with profile of alternator over alternator chip-temperature, load and speed (saved in NVMY)" UBYTE _CNV_A_R_LINEAR_____5_CM 1 100. 0. 99.609375 DISPLAY_IDENTIFIER STATE_TBL_ALTER[4][3][3] ECU_ADDRESS 0xd0008da2 FORMAT "%9.6" /end MEASUREMENT
/begin MEASUREMENT state_tbl_alter[4][3][4] "Table with profile of alternator over alternator chip-temperature, load and speed (saved in NVMY)" UBYTE _CNV_A_R_LINEAR_____5_CM 1 100. 0. 99.609375 DISPLAY_IDENTIFIER STATE_TBL_ALTER[4][3][4] ECU_ADDRESS 0xd0008da3 FORMAT "%9.6" /end MEASUREMENT
/begin MEASUREMENT state_tbl_alter[4][4][0] "Table with profile of alternator over alternator chip-temperature, load and speed (saved in NVMY)" UBYTE _CNV_A_R_LINEAR_____5_CM 1 100. 0. 99.609375 DISPLAY_IDENTIFIER STATE_TBL_ALTER[4][4][0] ECU_ADDRESS 0xd0008da4 FORMAT "%9.6" /end MEASUREMENT
/begin MEASUREMENT state_tbl_alter[4][4][1] "Table with profile of alternator over alternator chip-temperature, load and speed (saved in NVMY)" UBYTE _CNV_A_R_LINEAR_____5_CM 1 100. 0. 99.609375 DISPLAY_IDENTIFIER STATE_TBL_ALTER[4][4][1] ECU_ADDRESS 0xd0008da5 FORMAT "%9.6" /end MEASUREMENT
/begin MEASUREMENT state_tbl_alter[4][4][2] "Table with profile of alternator over alternator chip-temperature, load and speed (saved in NVMY)" UBYTE _CNV_A_R_LINEAR_____5_CM 1 100. 0. 99.609375 DISPLAY_IDENTIFIER STATE_TBL_ALTER[4][4][2] ECU_ADDRESS 0xd0008da6 FORMAT "%9.6" /end MEASUREMENT
/begin MEASUREMENT state_tbl_alter[4][4][3] "Table with profile of alternator over alternator chip-temperature, load and speed (saved in NVMY)" UBYTE _CNV_A_R_LINEAR_____5_CM 1 100. 0. 99.609375 DISPLAY_IDENTIFIER STATE_TBL_ALTER[4][4][3] ECU_ADDRESS 0xd0008da7 FORMAT "%9.6" /end MEASUREMENT
/begin MEASUREMENT state_tbl_alter[4][4][4] "Table with profile of alternator over alternator chip-temperature, load and speed (saved in NVMY)" UBYTE _CNV_A_R_LINEAR_____5_CM 1 100. 0. 99.609375 DISPLAY_IDENTIFIER STATE_TBL_ALTER[4][4][4] ECU_ADDRESS 0xd0008da8 FORMAT "%9.6" /end MEASUREMENT
/begin MEASUREMENT state_tbl_alter[5][0][0] "Table with profile of alternator over alternator chip-temperature, load and speed (saved in NVMY)" UBYTE _CNV_A_R_LINEAR_____5_CM 1 100. 0. 99.609375 DISPLAY_IDENTIFIER STATE_TBL_ALTER[5][0][0] ECU_ADDRESS 0xd0008da9 FORMAT "%9.6" /end MEASUREMENT
/begin MEASUREMENT state_tbl_alter[5][0][1] "Table with profile of alternator over alternator chip-temperature, load and speed (saved in NVMY)" UBYTE _CNV_A_R_LINEAR_____5_CM 1 100. 0. 99.609375 DISPLAY_IDENTIFIER STATE_TBL_ALTER[5][0][1] ECU_ADDRESS 0xd0008daa FORMAT "%9.6" /end MEASUREMENT
/begin MEASUREMENT state_tbl_alter[5][0][2] "Table with profile of alternator over alternator chip-temperature, load and speed (saved in NVMY)" UBYTE _CNV_A_R_LINEAR_____5_CM 1 100. 0. 99.609375 DISPLAY_IDENTIFIER STATE_TBL_ALTER[5][0][2] ECU_ADDRESS 0xd0008dab FORMAT "%9.6" /end MEASUREMENT
/begin MEASUREMENT state_tbl_alter[5][0][3] "Table with profile of alternator over alternator chip-temperature, load and speed (saved in NVMY)" UBYTE _CNV_A_R_LINEAR_____5_CM 1 100. 0. 99.609375 DISPLAY_IDENTIFIER STATE_TBL_ALTER[5][0][3] ECU_ADDRESS 0xd0008dac FORMAT "%9.6" /end MEASUREMENT
/begin MEASUREMENT state_tbl_alter[5][0][4] "Table with profile of alternator over alternator chip-temperature, load and speed (saved in NVMY)" UBYTE _CNV_A_R_LINEAR_____5_CM 1 100. 0. 99.609375 DISPLAY_IDENTIFIER STATE_TBL_ALTER[5][0][4] ECU_ADDRESS 0xd0008dad FORMAT "%9.6" /end MEASUREMENT
/begin MEASUREMENT state_tbl_alter[5][1][0] "Table with profile of alternator over alternator chip-temperature, load and speed (saved in NVMY)" UBYTE _CNV_A_R_LINEAR_____5_CM 1 100. 0. 99.609375 DISPLAY_IDENTIFIER STATE_TBL_ALTER[5][1][0] ECU_ADDRESS 0xd0008dae FORMAT "%9.6" /end MEASUREMENT
/begin MEASUREMENT state_tbl_alter[5][1][1] "Table with profile of alternator over alternator chip-temperature, load and speed (saved in NVMY)" UBYTE _CNV_A_R_LINEAR_____5_CM 1 100. 0. 99.609375 DISPLAY_IDENTIFIER STATE_TBL_ALTER[5][1][1] ECU_ADDRESS 0xd0008daf FORMAT "%9.6" /end MEASUREMENT
/begin MEASUREMENT state_tbl_alter[5][1][2] "Table with profile of alternator over alternator chip-temperature, load and speed (saved in NVMY)" UBYTE _CNV_A_R_LINEAR_____5_CM 1 100. 0. 99.609375 DISPLAY_IDENTIFIER STATE_TBL_ALTER[5][1][2] ECU_ADDRESS 0xd0008db0 FORMAT "%9.6" /end MEASUREMENT
/begin MEASUREMENT state_tbl_alter[5][1][3] "Table with profile of alternator over alternator chip-temperature, load and speed (saved in NVMY)" UBYTE _CNV_A_R_LINEAR_____5_CM 1 100. 0. 99.609375 DISPLAY_IDENTIFIER STATE_TBL_ALTER[5][1][3] ECU_ADDRESS 0xd0008db1 FORMAT "%9.6" /end MEASUREMENT
/begin MEASUREMENT state_tbl_alter[5][1][4] "Table with profile of alternator over alternator chip-temperature, load and speed (saved in NVMY)" UBYTE _CNV_A_R_LINEAR_____5_CM 1 100. 0. 99.609375 DISPLAY_IDENTIFIER STATE_TBL_ALTER[5][1][4] ECU_ADDRESS 0xd0008db2 FORMAT "%9.6" /end MEASUREMENT
/begin MEASUREMENT state_tbl_alter[5][2][0] "Table with profile of alternator over alternator chip-temperature, load and speed (saved in NVMY)" UBYTE _CNV_A_R_LINEAR_____5_CM 1 100. 0. 99.609375 DISPLAY_IDENTIFIER STATE_TBL_ALTER[5][2][0] ECU_ADDRESS 0xd0008db3 FORMAT "%9.6" /end MEASUREMENT
/begin MEASUREMENT state_tbl_alter[5][2][1] "Table with profile of alternator over alternator chip-temperature, load and speed (saved in NVMY)" UBYTE _CNV_A_R_LINEAR_____5_CM 1 100. 0. 99.609375 DISPLAY_IDENTIFIER STATE_TBL_ALTER[5][2][1] ECU_ADDRESS 0xd0008db4 FORMAT "%9.6" /end MEASUREMENT
/begin MEASUREMENT state_tbl_alter[5][2][2] "Table with profile of alternator over alternator chip-temperature, load and speed (saved in NVMY)" UBYTE _CNV_A_R_LINEAR_____5_CM 1 100. 0. 99.609375 DISPLAY_IDENTIFIER STATE_TBL_ALTER[5][2][2] ECU_ADDRESS 0xd0008db5 FORMAT "%9.6" /end MEASUREMENT
/begin MEASUREMENT state_tbl_alter[5][2][3] "Table with profile of alternator over alternator chip-temperature, load and speed (saved in NVMY)" UBYTE _CNV_A_R_LINEAR_____5_CM 1 100. 0. 99.609375 DISPLAY_IDENTIFIER STATE_TBL_ALTER[5][2][3] ECU_ADDRESS 0xd0008db6 FORMAT "%9.6" /end MEASUREMENT
/begin MEASUREMENT state_tbl_alter[5][2][4] "Table with profile of alternator over alternator chip-temperature, load and speed (saved in NVMY)" UBYTE _CNV_A_R_LINEAR_____5_CM 1 100. 0. 99.609375 DISPLAY_IDENTIFIER STATE_TBL_ALTER[5][2][4] ECU_ADDRESS 0xd0008db7 FORMAT "%9.6" /end MEASUREMENT
/begin MEASUREMENT state_tbl_alter[5][3][0] "Table with profile of alternator over alternator chip-temperature, load and speed (saved in NVMY)" UBYTE _CNV_A_R_LINEAR_____5_CM 1 100. 0. 99.609375 DISPLAY_IDENTIFIER STATE_TBL_ALTER[5][3][0] ECU_ADDRESS 0xd0008db8 FORMAT "%9.6" /end MEASUREMENT
/begin MEASUREMENT state_tbl_alter[5][3][1] "Table with profile of alternator over alternator chip-temperature, load and speed (saved in NVMY)" UBYTE _CNV_A_R_LINEAR_____5_CM 1 100. 0. 99.609375 DISPLAY_IDENTIFIER STATE_TBL_ALTER[5][3][1] ECU_ADDRESS 0xd0008db9 FORMAT "%9.6" /end MEASUREMENT
/begin MEASUREMENT state_tbl_alter[5][3][2] "Table with profile of alternator over alternator chip-temperature, load and speed (saved in NVMY)" UBYTE _CNV_A_R_LINEAR_____5_CM 1 100. 0. 99.609375 DISPLAY_IDENTIFIER STATE_TBL_ALTER[5][3][2] ECU_ADDRESS 0xd0008dba FORMAT "%9.6" /end MEASUREMENT
/begin MEASUREMENT state_tbl_alter[5][3][3] "Table with profile of alternator over alternator chip-temperature, load and speed (saved in NVMY)" UBYTE _CNV_A_R_LINEAR_____5_CM 1 100. 0. 99.609375 DISPLAY_IDENTIFIER STATE_TBL_ALTER[5][3][3] ECU_ADDRESS 0xd0008dbb FORMAT "%9.6" /end MEASUREMENT
/begin MEASUREMENT state_tbl_alter[5][3][4] "Table with profile of alternator over alternator chip-temperature, load and speed (saved in NVMY)" UBYTE _CNV_A_R_LINEAR_____5_CM 1 100. 0. 99.609375 DISPLAY_IDENTIFIER STATE_TBL_ALTER[5][3][4] ECU_ADDRESS 0xd0008dbc FORMAT "%9.6" /end MEASUREMENT
/begin MEASUREMENT state_tbl_alter[5][4][0] "Table with profile of alternator over alternator chip-temperature, load and speed (saved in NVMY)" UBYTE _CNV_A_R_LINEAR_____5_CM 1 100. 0. 99.609375 DISPLAY_IDENTIFIER STATE_TBL_ALTER[5][4][0] ECU_ADDRESS 0xd0008dbd FORMAT "%9.6" /end MEASUREMENT
/begin MEASUREMENT state_tbl_alter[5][4][1] "Table with profile of alternator over alternator chip-temperature, load and speed (saved in NVMY)" UBYTE _CNV_A_R_LINEAR_____5_CM 1 100. 0. 99.609375 DISPLAY_IDENTIFIER STATE_TBL_ALTER[5][4][1] ECU_ADDRESS 0xd0008dbe FORMAT "%9.6" /end MEASUREMENT
/begin MEASUREMENT state_tbl_alter[5][4][2] "Table with profile of alternator over alternator chip-temperature, load and speed (saved in NVMY)" UBYTE _CNV_A_R_LINEAR_____5_CM 1 100. 0. 99.609375 DISPLAY_IDENTIFIER STATE_TBL_ALTER[5][4][2] ECU_ADDRESS 0xd0008dbf FORMAT "%9.6" /end MEASUREMENT
/begin MEASUREMENT state_tbl_alter[5][4][3] "Table with profile of alternator over alternator chip-temperature, load and speed (saved in NVMY)" UBYTE _CNV_A_R_LINEAR_____5_CM 1 100. 0. 99.609375 DISPLAY_IDENTIFIER STATE_TBL_ALTER[5][4][3] ECU_ADDRESS 0xd0008dc0 FORMAT "%9.6" /end MEASUREMENT
/begin MEASUREMENT state_tbl_alter[5][4][4] "Table with profile of alternator over alternator chip-temperature, load and speed (saved in NVMY)" UBYTE _CNV_A_R_LINEAR_____5_CM 1 100. 0. 99.609375 DISPLAY_IDENTIFIER STATE_TBL_ALTER[5][4][4] ECU_ADDRESS 0xd0008dc1 FORMAT "%9.6" /end MEASUREMENT
/begin MEASUREMENT state_tbl_alter[6][0][0] "Table with profile of alternator over alternator chip-temperature, load and speed (saved in NVMY)" UBYTE _CNV_A_R_LINEAR_____5_CM 1 100. 0. 99.609375 DISPLAY_IDENTIFIER STATE_TBL_ALTER[6][0][0] ECU_ADDRESS 0xd0008dc2 FORMAT "%9.6" /end MEASUREMENT
/begin MEASUREMENT state_tbl_alter[6][0][1] "Table with profile of alternator over alternator chip-temperature, load and speed (saved in NVMY)" UBYTE _CNV_A_R_LINEAR_____5_CM 1 100. 0. 99.609375 DISPLAY_IDENTIFIER STATE_TBL_ALTER[6][0][1] ECU_ADDRESS 0xd0008dc3 FORMAT "%9.6" /end MEASUREMENT
/begin MEASUREMENT state_tbl_alter[6][0][2] "Table with profile of alternator over alternator chip-temperature, load and speed (saved in NVMY)" UBYTE _CNV_A_R_LINEAR_____5_CM 1 100. 0. 99.609375 DISPLAY_IDENTIFIER STATE_TBL_ALTER[6][0][2] ECU_ADDRESS 0xd0008dc4 FORMAT "%9.6" /end MEASUREMENT
/begin MEASUREMENT state_tbl_alter[6][0][3] "Table with profile of alternator over alternator chip-temperature, load and speed (saved in NVMY)" UBYTE _CNV_A_R_LINEAR_____5_CM 1 100. 0. 99.609375 DISPLAY_IDENTIFIER STATE_TBL_ALTER[6][0][3] ECU_ADDRESS 0xd0008dc5 FORMAT "%9.6" /end MEASUREMENT
/begin MEASUREMENT state_tbl_alter[6][0][4] "Table with profile of alternator over alternator chip-temperature, load and speed (saved in NVMY)" UBYTE _CNV_A_R_LINEAR_____5_CM 1 100. 0. 99.609375 DISPLAY_IDENTIFIER STATE_TBL_ALTER[6][0][4] ECU_ADDRESS 0xd0008dc6 FORMAT "%9.6" /end MEASUREMENT
/begin MEASUREMENT state_tbl_alter[6][1][0] "Table with profile of alternator over alternator chip-temperature, load and speed (saved in NVMY)" UBYTE _CNV_A_R_LINEAR_____5_CM 1 100. 0. 99.609375 DISPLAY_IDENTIFIER STATE_TBL_ALTER[6][1][0] ECU_ADDRESS 0xd0008dc7 FORMAT "%9.6" /end MEASUREMENT
/begin MEASUREMENT state_tbl_alter[6][1][1] "Table with profile of alternator over alternator chip-temperature, load and speed (saved in NVMY)" UBYTE _CNV_A_R_LINEAR_____5_CM 1 100. 0. 99.609375 DISPLAY_IDENTIFIER STATE_TBL_ALTER[6][1][1] ECU_ADDRESS 0xd0008dc8 FORMAT "%9.6" /end MEASUREMENT
/begin MEASUREMENT state_tbl_alter[6][1][2] "Table with profile of alternator over alternator chip-temperature, load and speed (saved in NVMY)" UBYTE _CNV_A_R_LINEAR_____5_CM 1 100. 0. 99.609375 DISPLAY_IDENTIFIER STATE_TBL_ALTER[6][1][2] ECU_ADDRESS 0xd0008dc9 FORMAT "%9.6" /end MEASUREMENT
/begin MEASUREMENT state_tbl_alter[6][1][3] "Table with profile of alternator over alternator chip-temperature, load and speed (saved in NVMY)" UBYTE _CNV_A_R_LINEAR_____5_CM 1 100. 0. 99.609375 DISPLAY_IDENTIFIER STATE_TBL_ALTER[6][1][3] ECU_ADDRESS 0xd0008dca FORMAT "%9.6" /end MEASUREMENT
/begin MEASUREMENT state_tbl_alter[6][1][4] "Table with profile of alternator over alternator chip-temperature, load and speed (saved in NVMY)" UBYTE _CNV_A_R_LINEAR_____5_CM 1 100. 0. 99.609375 DISPLAY_IDENTIFIER STATE_TBL_ALTER[6][1][4] ECU_ADDRESS 0xd0008dcb FORMAT "%9.6" /end MEASUREMENT
/begin MEASUREMENT state_tbl_alter[6][2][0] "Table with profile of alternator over alternator chip-temperature, load and speed (saved in NVMY)" UBYTE _CNV_A_R_LINEAR_____5_CM 1 100. 0. 99.609375 DISPLAY_IDENTIFIER STATE_TBL_ALTER[6][2][0] ECU_ADDRESS 0xd0008dcc FORMAT "%9.6" /end MEASUREMENT
/begin MEASUREMENT state_tbl_alter[6][2][1] "Table with profile of alternator over alternator chip-temperature, load and speed (saved in NVMY)" UBYTE _CNV_A_R_LINEAR_____5_CM 1 100. 0. 99.609375 DISPLAY_IDENTIFIER STATE_TBL_ALTER[6][2][1] ECU_ADDRESS 0xd0008dcd FORMAT "%9.6" /end MEASUREMENT
/begin MEASUREMENT state_tbl_alter[6][2][2] "Table with profile of alternator over alternator chip-temperature, load and speed (saved in NVMY)" UBYTE _CNV_A_R_LINEAR_____5_CM 1 100. 0. 99.609375 DISPLAY_IDENTIFIER STATE_TBL_ALTER[6][2][2] ECU_ADDRESS 0xd0008dce FORMAT "%9.6" /end MEASUREMENT
/begin MEASUREMENT state_tbl_alter[6][2][3] "Table with profile of alternator over alternator chip-temperature, load and speed (saved in NVMY)" UBYTE _CNV_A_R_LINEAR_____5_CM 1 100. 0. 99.609375 DISPLAY_IDENTIFIER STATE_TBL_ALTER[6][2][3] ECU_ADDRESS 0xd0008dcf FORMAT "%9.6" /end MEASUREMENT
/begin MEASUREMENT state_tbl_alter[6][2][4] "Table with profile of alternator over alternator chip-temperature, load and speed (saved in NVMY)" UBYTE _CNV_A_R_LINEAR_____5_CM 1 100. 0. 99.609375 DISPLAY_IDENTIFIER STATE_TBL_ALTER[6][2][4] ECU_ADDRESS 0xd0008dd0 FORMAT "%9.6" /end MEASUREMENT
/begin MEASUREMENT state_tbl_alter[6][3][0] "Table with profile of alternator over alternator chip-temperature, load and speed (saved in NVMY)" UBYTE _CNV_A_R_LINEAR_____5_CM 1 100. 0. 99.609375 DISPLAY_IDENTIFIER STATE_TBL_ALTER[6][3][0] ECU_ADDRESS 0xd0008dd1 FORMAT "%9.6" /end MEASUREMENT
/begin MEASUREMENT state_tbl_alter[6][3][1] "Table with profile of alternator over alternator chip-temperature, load and speed (saved in NVMY)" UBYTE _CNV_A_R_LINEAR_____5_CM 1 100. 0. 99.609375 DISPLAY_IDENTIFIER STATE_TBL_ALTER[6][3][1] ECU_ADDRESS 0xd0008dd2 FORMAT "%9.6" /end MEASUREMENT
/begin MEASUREMENT state_tbl_alter[6][3][2] "Table with profile of alternator over alternator chip-temperature, load and speed (saved in NVMY)" UBYTE _CNV_A_R_LINEAR_____5_CM 1 100. 0. 99.609375 DISPLAY_IDENTIFIER STATE_TBL_ALTER[6][3][2] ECU_ADDRESS 0xd0008dd3 FORMAT "%9.6" /end MEASUREMENT
/begin MEASUREMENT state_tbl_alter[6][3][3] "Table with profile of alternator over alternator chip-temperature, load and speed (saved in NVMY)" UBYTE _CNV_A_R_LINEAR_____5_CM 1 100. 0. 99.609375 DISPLAY_IDENTIFIER STATE_TBL_ALTER[6][3][3] ECU_ADDRESS 0xd0008dd4 FORMAT "%9.6" /end MEASUREMENT
/begin MEASUREMENT state_tbl_alter[6][3][4] "Table with profile of alternator over alternator chip-temperature, load and speed (saved in NVMY)" UBYTE _CNV_A_R_LINEAR_____5_CM 1 100. 0. 99.609375 DISPLAY_IDENTIFIER STATE_TBL_ALTER[6][3][4] ECU_ADDRESS 0xd0008dd5 FORMAT "%9.6" /end MEASUREMENT
/begin MEASUREMENT state_tbl_alter[6][4][0] "Table with profile of alternator over alternator chip-temperature, load and speed (saved in NVMY)" UBYTE _CNV_A_R_LINEAR_____5_CM 1 100. 0. 99.609375 DISPLAY_IDENTIFIER STATE_TBL_ALTER[6][4][0] ECU_ADDRESS 0xd0008dd6 FORMAT "%9.6" /end MEASUREMENT
/begin MEASUREMENT state_tbl_alter[6][4][1] "Table with profile of alternator over alternator chip-temperature, load and speed (saved in NVMY)" UBYTE _CNV_A_R_LINEAR_____5_CM 1 100. 0. 99.609375 DISPLAY_IDENTIFIER STATE_TBL_ALTER[6][4][1] ECU_ADDRESS 0xd0008dd7 FORMAT "%9.6" /end MEASUREMENT
/begin MEASUREMENT state_tbl_alter[6][4][2] "Table with profile of alternator over alternator chip-temperature, load and speed (saved in NVMY)" UBYTE _CNV_A_R_LINEAR_____5_CM 1 100. 0. 99.609375 DISPLAY_IDENTIFIER STATE_TBL_ALTER[6][4][2] ECU_ADDRESS 0xd0008dd8 FORMAT "%9.6" /end MEASUREMENT
/begin MEASUREMENT state_tbl_alter[6][4][3] "Table with profile of alternator over alternator chip-temperature, load and speed (saved in NVMY)" UBYTE _CNV_A_R_LINEAR_____5_CM 1 100. 0. 99.609375 DISPLAY_IDENTIFIER STATE_TBL_ALTER[6][4][3] ECU_ADDRESS 0xd0008dd9 FORMAT "%9.6" /end MEASUREMENT
/begin MEASUREMENT state_tbl_alter[6][4][4] "Table with profile of alternator over alternator chip-temperature, load and speed (saved in NVMY)" UBYTE _CNV_A_R_LINEAR_____5_CM 1 100. 0. 99.609375 DISPLAY_IDENTIFIER STATE_TBL_ALTER[6][4][4] ECU_ADDRESS 0xd0008dda FORMAT "%9.6" /end MEASUREMENT
/begin MEASUREMENT state_tbl_alter_dc[0][0][0] "Table with profile of alternator over alternator chip-temperature, load and speed during driving cycle (in s)" UWORD _CNV_A_R_LINEAR_____36_CM 1 100. 0. 65535. DISPLAY_IDENTIFIER STATE_TBL_ALTER_DC[0][0][0] ECU_ADDRESS 0xd000a90c FORMAT "%5.0" /end MEASUREMENT
/begin MEASUREMENT state_tbl_alter_dc[0][0][1] "Table with profile of alternator over alternator chip-temperature, load and speed during driving cycle (in s)" UWORD _CNV_A_R_LINEAR_____36_CM 1 100. 0. 65535. DISPLAY_IDENTIFIER STATE_TBL_ALTER_DC[0][0][1] ECU_ADDRESS 0xd000a90e FORMAT "%5.0" /end MEASUREMENT
/begin MEASUREMENT state_tbl_alter_dc[0][0][2] "Table with profile of alternator over alternator chip-temperature, load and speed during driving cycle (in s)" UWORD _CNV_A_R_LINEAR_____36_CM 1 100. 0. 65535. DISPLAY_IDENTIFIER STATE_TBL_ALTER_DC[0][0][2] ECU_ADDRESS 0xd000a910 FORMAT "%5.0" /end MEASUREMENT
/begin MEASUREMENT state_tbl_alter_dc[0][0][3] "Table with profile of alternator over alternator chip-temperature, load and speed during driving cycle (in s)" UWORD _CNV_A_R_LINEAR_____36_CM 1 100. 0. 65535. DISPLAY_IDENTIFIER STATE_TBL_ALTER_DC[0][0][3] ECU_ADDRESS 0xd000a912 FORMAT "%5.0" /end MEASUREMENT
/begin MEASUREMENT state_tbl_alter_dc[0][0][4] "Table with profile of alternator over alternator chip-temperature, load and speed during driving cycle (in s)" UWORD _CNV_A_R_LINEAR_____36_CM 1 100. 0. 65535. DISPLAY_IDENTIFIER STATE_TBL_ALTER_DC[0][0][4] ECU_ADDRESS 0xd000a914 FORMAT "%5.0" /end MEASUREMENT
/begin MEASUREMENT state_tbl_alter_dc[0][1][0] "Table with profile of alternator over alternator chip-temperature, load and speed during driving cycle (in s)" UWORD _CNV_A_R_LINEAR_____36_CM 1 100. 0. 65535. DISPLAY_IDENTIFIER STATE_TBL_ALTER_DC[0][1][0] ECU_ADDRESS 0xd000a916 FORMAT "%5.0" /end MEASUREMENT
/begin MEASUREMENT state_tbl_alter_dc[0][1][1] "Table with profile of alternator over alternator chip-temperature, load and speed during driving cycle (in s)" UWORD _CNV_A_R_LINEAR_____36_CM 1 100. 0. 65535. DISPLAY_IDENTIFIER STATE_TBL_ALTER_DC[0][1][1] ECU_ADDRESS 0xd000a918 FORMAT "%5.0" /end MEASUREMENT
/begin MEASUREMENT state_tbl_alter_dc[0][1][2] "Table with profile of alternator over alternator chip-temperature, load and speed during driving cycle (in s)" UWORD _CNV_A_R_LINEAR_____36_CM 1 100. 0. 65535. DISPLAY_IDENTIFIER STATE_TBL_ALTER_DC[0][1][2] ECU_ADDRESS 0xd000a91a FORMAT "%5.0" /end MEASUREMENT
/begin MEASUREMENT state_tbl_alter_dc[0][1][3] "Table with profile of alternator over alternator chip-temperature, load and speed during driving cycle (in s)" UWORD _CNV_A_R_LINEAR_____36_CM 1 100. 0. 65535. DISPLAY_IDENTIFIER STATE_TBL_ALTER_DC[0][1][3] ECU_ADDRESS 0xd000a91c FORMAT "%5.0" /end MEASUREMENT
/begin MEASUREMENT state_tbl_alter_dc[0][1][4] "Table with profile of alternator over alternator chip-temperature, load and speed during driving cycle (in s)" UWORD _CNV_A_R_LINEAR_____36_CM 1 100. 0. 65535. DISPLAY_IDENTIFIER STATE_TBL_ALTER_DC[0][1][4] ECU_ADDRESS 0xd000a91e FORMAT "%5.0" /end MEASUREMENT
/begin MEASUREMENT state_tbl_alter_dc[0][2][0] "Table with profile of alternator over alternator chip-temperature, load and speed during driving cycle (in s)" UWORD _CNV_A_R_LINEAR_____36_CM 1 100. 0. 65535. DISPLAY_IDENTIFIER STATE_TBL_ALTER_DC[0][2][0] ECU_ADDRESS 0xd000a920 FORMAT "%5.0" /end MEASUREMENT
/begin MEASUREMENT state_tbl_alter_dc[0][2][1] "Table with profile of alternator over alternator chip-temperature, load and speed during driving cycle (in s)" UWORD _CNV_A_R_LINEAR_____36_CM 1 100. 0. 65535. DISPLAY_IDENTIFIER STATE_TBL_ALTER_DC[0][2][1] ECU_ADDRESS 0xd000a922 FORMAT "%5.0" /end MEASUREMENT
/begin MEASUREMENT state_tbl_alter_dc[0][2][2] "Table with profile of alternator over alternator chip-temperature, load and speed during driving cycle (in s)" UWORD _CNV_A_R_LINEAR_____36_CM 1 100. 0. 65535. DISPLAY_IDENTIFIER STATE_TBL_ALTER_DC[0][2][2] ECU_ADDRESS 0xd000a924 FORMAT "%5.0" /end MEASUREMENT
/begin MEASUREMENT state_tbl_alter_dc[0][2][3] "Table with profile of alternator over alternator chip-temperature, load and speed during driving cycle (in s)" UWORD _CNV_A_R_LINEAR_____36_CM 1 100. 0. 65535. DISPLAY_IDENTIFIER STATE_TBL_ALTER_DC[0][2][3] ECU_ADDRESS 0xd000a926 FORMAT "%5.0" /end MEASUREMENT
/begin MEASUREMENT state_tbl_alter_dc[0][2][4] "Table with profile of alternator over alternator chip-temperature, load and speed during driving cycle (in s)" UWORD _CNV_A_R_LINEAR_____36_CM 1 100. 0. 65535. DISPLAY_IDENTIFIER STATE_TBL_ALTER_DC[0][2][4] ECU_ADDRESS 0xd000a928 FORMAT "%5.0" /end MEASUREMENT
/begin MEASUREMENT state_tbl_alter_dc[0][3][0] "Table with profile of alternator over alternator chip-temperature, load and speed during driving cycle (in s)" UWORD _CNV_A_R_LINEAR_____36_CM 1 100. 0. 65535. DISPLAY_IDENTIFIER STATE_TBL_ALTER_DC[0][3][0] ECU_ADDRESS 0xd000a92a FORMAT "%5.0" /end MEASUREMENT
/begin MEASUREMENT state_tbl_alter_dc[0][3][1] "Table with profile of alternator over alternator chip-temperature, load and speed during driving cycle (in s)" UWORD _CNV_A_R_LINEAR_____36_CM 1 100. 0. 65535. DISPLAY_IDENTIFIER STATE_TBL_ALTER_DC[0][3][1] ECU_ADDRESS 0xd000a92c FORMAT "%5.0" /end MEASUREMENT
/begin MEASUREMENT state_tbl_alter_dc[0][3][2] "Table with profile of alternator over alternator chip-temperature, load and speed during driving cycle (in s)" UWORD _CNV_A_R_LINEAR_____36_CM 1 100. 0. 65535. DISPLAY_IDENTIFIER STATE_TBL_ALTER_DC[0][3][2] ECU_ADDRESS 0xd000a92e FORMAT "%5.0" /end MEASUREMENT
/begin MEASUREMENT state_tbl_alter_dc[0][3][3] "Table with profile of alternator over alternator chip-temperature, load and speed during driving cycle (in s)" UWORD _CNV_A_R_LINEAR_____36_CM 1 100. 0. 65535. DISPLAY_IDENTIFIER STATE_TBL_ALTER_DC[0][3][3] ECU_ADDRESS 0xd000a930 FORMAT "%5.0" /end MEASUREMENT
/begin MEASUREMENT state_tbl_alter_dc[0][3][4] "Table with profile of alternator over alternator chip-temperature, load and speed during driving cycle (in s)" UWORD _CNV_A_R_LINEAR_____36_CM 1 100. 0. 65535. DISPLAY_IDENTIFIER STATE_TBL_ALTER_DC[0][3][4] ECU_ADDRESS 0xd000a932 FORMAT "%5.0" /end MEASUREMENT
/begin MEASUREMENT state_tbl_alter_dc[0][4][0] "Table with profile of alternator over alternator chip-temperature, load and speed during driving cycle (in s)" UWORD _CNV_A_R_LINEAR_____36_CM 1 100. 0. 65535. DISPLAY_IDENTIFIER STATE_TBL_ALTER_DC[0][4][0] ECU_ADDRESS 0xd000a934 FORMAT "%5.0" /end MEASUREMENT
/begin MEASUREMENT state_tbl_alter_dc[0][4][1] "Table with profile of alternator over alternator chip-temperature, load and speed during driving cycle (in s)" UWORD _CNV_A_R_LINEAR_____36_CM 1 100. 0. 65535. DISPLAY_IDENTIFIER STATE_TBL_ALTER_DC[0][4][1] ECU_ADDRESS 0xd000a936 FORMAT "%5.0" /end MEASUREMENT
/begin MEASUREMENT state_tbl_alter_dc[0][4][2] "Table with profile of alternator over alternator chip-temperature, load and speed during driving cycle (in s)" UWORD _CNV_A_R_LINEAR_____36_CM 1 100. 0. 65535. DISPLAY_IDENTIFIER STATE_TBL_ALTER_DC[0][4][2] ECU_ADDRESS 0xd000a938 FORMAT "%5.0" /end MEASUREMENT
/begin MEASUREMENT state_tbl_alter_dc[0][4][3] "Table with profile of alternator over alternator chip-temperature, load and speed during driving cycle (in s)" UWORD _CNV_A_R_LINEAR_____36_CM 1 100. 0. 65535. DISPLAY_IDENTIFIER STATE_TBL_ALTER_DC[0][4][3] ECU_ADDRESS 0xd000a93a FORMAT "%5.0" /end MEASUREMENT
/begin MEASUREMENT state_tbl_alter_dc[0][4][4] "Table with profile of alternator over alternator chip-temperature, load and speed during driving cycle (in s)" UWORD _CNV_A_R_LINEAR_____36_CM 1 100. 0. 65535. DISPLAY_IDENTIFIER STATE_TBL_ALTER_DC[0][4][4] ECU_ADDRESS 0xd000a93c FORMAT "%5.0" /end MEASUREMENT
/begin MEASUREMENT state_tbl_alter_dc[1][0][0] "Table with profile of alternator over alternator chip-temperature, load and speed during driving cycle (in s)" UWORD _CNV_A_R_LINEAR_____36_CM 1 100. 0. 65535. DISPLAY_IDENTIFIER STATE_TBL_ALTER_DC[1][0][0] ECU_ADDRESS 0xd000a93e FORMAT "%5.0" /end MEASUREMENT
/begin MEASUREMENT state_tbl_alter_dc[1][0][1] "Table with profile of alternator over alternator chip-temperature, load and speed during driving cycle (in s)" UWORD _CNV_A_R_LINEAR_____36_CM 1 100. 0. 65535. DISPLAY_IDENTIFIER STATE_TBL_ALTER_DC[1][0][1] ECU_ADDRESS 0xd000a940 FORMAT "%5.0" /end MEASUREMENT
/begin MEASUREMENT state_tbl_alter_dc[1][0][2] "Table with profile of alternator over alternator chip-temperature, load and speed during driving cycle (in s)" UWORD _CNV_A_R_LINEAR_____36_CM 1 100. 0. 65535. DISPLAY_IDENTIFIER STATE_TBL_ALTER_DC[1][0][2] ECU_ADDRESS 0xd000a942 FORMAT "%5.0" /end MEASUREMENT
/begin MEASUREMENT state_tbl_alter_dc[1][0][3] "Table with profile of alternator over alternator chip-temperature, load and speed during driving cycle (in s)" UWORD _CNV_A_R_LINEAR_____36_CM 1 100. 0. 65535. DISPLAY_IDENTIFIER STATE_TBL_ALTER_DC[1][0][3] ECU_ADDRESS 0xd000a944 FORMAT "%5.0" /end MEASUREMENT
/begin MEASUREMENT state_tbl_alter_dc[1][0][4] "Table with profile of alternator over alternator chip-temperature, load and speed during driving cycle (in s)" UWORD _CNV_A_R_LINEAR_____36_CM 1 100. 0. 65535. DISPLAY_IDENTIFIER STATE_TBL_ALTER_DC[1][0][4] ECU_ADDRESS 0xd000a946 FORMAT "%5.0" /end MEASUREMENT
/begin MEASUREMENT state_tbl_alter_dc[1][1][0] "Table with profile of alternator over alternator chip-temperature, load and speed during driving cycle (in s)" UWORD _CNV_A_R_LINEAR_____36_CM 1 100. 0. 65535. DISPLAY_IDENTIFIER STATE_TBL_ALTER_DC[1][1][0] ECU_ADDRESS 0xd000a948 FORMAT "%5.0" /end MEASUREMENT
/begin MEASUREMENT state_tbl_alter_dc[1][1][1] "Table with profile of alternator over alternator chip-temperature, load and speed during driving cycle (in s)" UWORD _CNV_A_R_LINEAR_____36_CM 1 100. 0. 65535. DISPLAY_IDENTIFIER STATE_TBL_ALTER_DC[1][1][1] ECU_ADDRESS 0xd000a94a FORMAT "%5.0" /end MEASUREMENT
/begin MEASUREMENT state_tbl_alter_dc[1][1][2] "Table with profile of alternator over alternator chip-temperature, load and speed during driving cycle (in s)" UWORD _CNV_A_R_LINEAR_____36_CM 1 100. 0. 65535. DISPLAY_IDENTIFIER STATE_TBL_ALTER_DC[1][1][2] ECU_ADDRESS 0xd000a94c FORMAT "%5.0" /end MEASUREMENT
/begin MEASUREMENT state_tbl_alter_dc[1][1][3] "Table with profile of alternator over alternator chip-temperature, load and speed during driving cycle (in s)" UWORD _CNV_A_R_LINEAR_____36_CM 1 100. 0. 65535. DISPLAY_IDENTIFIER STATE_TBL_ALTER_DC[1][1][3] ECU_ADDRESS 0xd000a94e FORMAT "%5.0" /end MEASUREMENT
/begin MEASUREMENT state_tbl_alter_dc[1][1][4] "Table with profile of alternator over alternator chip-temperature, load and speed during driving cycle (in s)" UWORD _CNV_A_R_LINEAR_____36_CM 1 100. 0. 65535. DISPLAY_IDENTIFIER STATE_TBL_ALTER_DC[1][1][4] ECU_ADDRESS 0xd000a950 FORMAT "%5.0" /end MEASUREMENT
/begin MEASUREMENT state_tbl_alter_dc[1][2][0] "Table with profile of alternator over alternator chip-temperature, load and speed during driving cycle (in s)" UWORD _CNV_A_R_LINEAR_____36_CM 1 100. 0. 65535. DISPLAY_IDENTIFIER STATE_TBL_ALTER_DC[1][2][0] ECU_ADDRESS 0xd000a952 FORMAT "%5.0" /end MEASUREMENT
/begin MEASUREMENT state_tbl_alter_dc[1][2][1] "Table with profile of alternator over alternator chip-temperature, load and speed during driving cycle (in s)" UWORD _CNV_A_R_LINEAR_____36_CM 1 100. 0. 65535. DISPLAY_IDENTIFIER STATE_TBL_ALTER_DC[1][2][1] ECU_ADDRESS 0xd000a954 FORMAT "%5.0" /end MEASUREMENT
/begin MEASUREMENT state_tbl_alter_dc[1][2][2] "Table with profile of alternator over alternator chip-temperature, load and speed during driving cycle (in s)" UWORD _CNV_A_R_LINEAR_____36_CM 1 100. 0. 65535. DISPLAY_IDENTIFIER STATE_TBL_ALTER_DC[1][2][2] ECU_ADDRESS 0xd000a956 FORMAT "%5.0" /end MEASUREMENT
/begin MEASUREMENT state_tbl_alter_dc[1][2][3] "Table with profile of alternator over alternator chip-temperature, load and speed during driving cycle (in s)" UWORD _CNV_A_R_LINEAR_____36_CM 1 100. 0. 65535. DISPLAY_IDENTIFIER STATE_TBL_ALTER_DC[1][2][3] ECU_ADDRESS 0xd000a958 FORMAT "%5.0" /end MEASUREMENT
/begin MEASUREMENT state_tbl_alter_dc[1][2][4] "Table with profile of alternator over alternator chip-temperature, load and speed during driving cycle (in s)" UWORD _CNV_A_R_LINEAR_____36_CM 1 100. 0. 65535. DISPLAY_IDENTIFIER STATE_TBL_ALTER_DC[1][2][4] ECU_ADDRESS 0xd000a95a FORMAT "%5.0" /end MEASUREMENT
/begin MEASUREMENT state_tbl_alter_dc[1][3][0] "Table with profile of alternator over alternator chip-temperature, load and speed during driving cycle (in s)" UWORD _CNV_A_R_LINEAR_____36_CM 1 100. 0. 65535. DISPLAY_IDENTIFIER STATE_TBL_ALTER_DC[1][3][0] ECU_ADDRESS 0xd000a95c FORMAT "%5.0" /end MEASUREMENT
/begin MEASUREMENT state_tbl_alter_dc[1][3][1] "Table with profile of alternator over alternator chip-temperature, load and speed during driving cycle (in s)" UWORD _CNV_A_R_LINEAR_____36_CM 1 100. 0. 65535. DISPLAY_IDENTIFIER STATE_TBL_ALTER_DC[1][3][1] ECU_ADDRESS 0xd000a95e FORMAT "%5.0" /end MEASUREMENT
/begin MEASUREMENT state_tbl_alter_dc[1][3][2] "Table with profile of alternator over alternator chip-temperature, load and speed during driving cycle (in s)" UWORD _CNV_A_R_LINEAR_____36_CM 1 100. 0. 65535. DISPLAY_IDENTIFIER STATE_TBL_ALTER_DC[1][3][2] ECU_ADDRESS 0xd000a960 FORMAT "%5.0" /end MEASUREMENT
/begin MEASUREMENT state_tbl_alter_dc[1][3][3] "Table with profile of alternator over alternator chip-temperature, load and speed during driving cycle (in s)" UWORD _CNV_A_R_LINEAR_____36_CM 1 100. 0. 65535. DISPLAY_IDENTIFIER STATE_TBL_ALTER_DC[1][3][3] ECU_ADDRESS 0xd000a962 FORMAT "%5.0" /end MEASUREMENT
/begin MEASUREMENT state_tbl_alter_dc[1][3][4] "Table with profile of alternator over alternator chip-temperature, load and speed during driving cycle (in s)" UWORD _CNV_A_R_LINEAR_____36_CM 1 100. 0. 65535. DISPLAY_IDENTIFIER STATE_TBL_ALTER_DC[1][3][4] ECU_ADDRESS 0xd000a964 FORMAT "%5.0" /end MEASUREMENT
/begin MEASUREMENT state_tbl_alter_dc[1][4][0] "Table with profile of alternator over alternator chip-temperature, load and speed during driving cycle (in s)" UWORD _CNV_A_R_LINEAR_____36_CM 1 100. 0. 65535. DISPLAY_IDENTIFIER STATE_TBL_ALTER_DC[1][4][0] ECU_ADDRESS 0xd000a966 FORMAT "%5.0" /end MEASUREMENT
/begin MEASUREMENT state_tbl_alter_dc[1][4][1] "Table with profile of alternator over alternator chip-temperature, load and speed during driving cycle (in s)" UWORD _CNV_A_R_LINEAR_____36_CM 1 100. 0. 65535. DISPLAY_IDENTIFIER STATE_TBL_ALTER_DC[1][4][1] ECU_ADDRESS 0xd000a968 FORMAT "%5.0" /end MEASUREMENT
/begin MEASUREMENT state_tbl_alter_dc[1][4][2] "Table with profile of alternator over alternator chip-temperature, load and speed during driving cycle (in s)" UWORD _CNV_A_R_LINEAR_____36_CM 1 100. 0. 65535. DISPLAY_IDENTIFIER STATE_TBL_ALTER_DC[1][4][2] ECU_ADDRESS 0xd000a96a FORMAT "%5.0" /end MEASUREMENT
/begin MEASUREMENT state_tbl_alter_dc[1][4][3] "Table with profile of alternator over alternator chip-temperature, load and speed during driving cycle (in s)" UWORD _CNV_A_R_LINEAR_____36_CM 1 100. 0. 65535. DISPLAY_IDENTIFIER STATE_TBL_ALTER_DC[1][4][3] ECU_ADDRESS 0xd000a96c FORMAT "%5.0" /end MEASUREMENT
/begin MEASUREMENT state_tbl_alter_dc[1][4][4] "Table with profile of alternator over alternator chip-temperature, load and speed during driving cycle (in s)" UWORD _CNV_A_R_LINEAR_____36_CM 1 100. 0. 65535. DISPLAY_IDENTIFIER STATE_TBL_ALTER_DC[1][4][4] ECU_ADDRESS 0xd000a96e FORMAT "%5.0" /end MEASUREMENT
/begin MEASUREMENT state_tbl_alter_dc[2][0][0] "Table with profile of alternator over alternator chip-temperature, load and speed during driving cycle (in s)" UWORD _CNV_A_R_LINEAR_____36_CM 1 100. 0. 65535. DISPLAY_IDENTIFIER STATE_TBL_ALTER_DC[2][0][0] ECU_ADDRESS 0xd000a970 FORMAT "%5.0" /end MEASUREMENT
/begin MEASUREMENT state_tbl_alter_dc[2][0][1] "Table with profile of alternator over alternator chip-temperature, load and speed during driving cycle (in s)" UWORD _CNV_A_R_LINEAR_____36_CM 1 100. 0. 65535. DISPLAY_IDENTIFIER STATE_TBL_ALTER_DC[2][0][1] ECU_ADDRESS 0xd000a972 FORMAT "%5.0" /end MEASUREMENT
/begin MEASUREMENT state_tbl_alter_dc[2][0][2] "Table with profile of alternator over alternator chip-temperature, load and speed during driving cycle (in s)" UWORD _CNV_A_R_LINEAR_____36_CM 1 100. 0. 65535. DISPLAY_IDENTIFIER STATE_TBL_ALTER_DC[2][0][2] ECU_ADDRESS 0xd000a974 FORMAT "%5.0" /end MEASUREMENT
/begin MEASUREMENT state_tbl_alter_dc[2][0][3] "Table with profile of alternator over alternator chip-temperature, load and speed during driving cycle (in s)" UWORD _CNV_A_R_LINEAR_____36_CM 1 100. 0. 65535. DISPLAY_IDENTIFIER STATE_TBL_ALTER_DC[2][0][3] ECU_ADDRESS 0xd000a976 FORMAT "%5.0" /end MEASUREMENT
/begin MEASUREMENT state_tbl_alter_dc[2][0][4] "Table with profile of alternator over alternator chip-temperature, load and speed during driving cycle (in s)" UWORD _CNV_A_R_LINEAR_____36_CM 1 100. 0. 65535. DISPLAY_IDENTIFIER STATE_TBL_ALTER_DC[2][0][4] ECU_ADDRESS 0xd000a978 FORMAT "%5.0" /end MEASUREMENT
/begin MEASUREMENT state_tbl_alter_dc[2][1][0] "Table with profile of alternator over alternator chip-temperature, load and speed during driving cycle (in s)" UWORD _CNV_A_R_LINEAR_____36_CM 1 100. 0. 65535. DISPLAY_IDENTIFIER STATE_TBL_ALTER_DC[2][1][0] ECU_ADDRESS 0xd000a97a FORMAT "%5.0" /end MEASUREMENT
/begin MEASUREMENT state_tbl_alter_dc[2][1][1] "Table with profile of alternator over alternator chip-temperature, load and speed during driving cycle (in s)" UWORD _CNV_A_R_LINEAR_____36_CM 1 100. 0. 65535. DISPLAY_IDENTIFIER STATE_TBL_ALTER_DC[2][1][1] ECU_ADDRESS 0xd000a97c FORMAT "%5.0" /end MEASUREMENT
/begin MEASUREMENT state_tbl_alter_dc[2][1][2] "Table with profile of alternator over alternator chip-temperature, load and speed during driving cycle (in s)" UWORD _CNV_A_R_LINEAR_____36_CM 1 100. 0. 65535. DISPLAY_IDENTIFIER STATE_TBL_ALTER_DC[2][1][2] ECU_ADDRESS 0xd000a97e FORMAT "%5.0" /end MEASUREMENT
/begin MEASUREMENT state_tbl_alter_dc[2][1][3] "Table with profile of alternator over alternator chip-temperature, load and speed during driving cycle (in s)" UWORD _CNV_A_R_LINEAR_____36_CM 1 100. 0. 65535. DISPLAY_IDENTIFIER STATE_TBL_ALTER_DC[2][1][3] ECU_ADDRESS 0xd000a980 FORMAT "%5.0" /end MEASUREMENT
/begin MEASUREMENT state_tbl_alter_dc[2][1][4] "Table with profile of alternator over alternator chip-temperature, load and speed during driving cycle (in s)" UWORD _CNV_A_R_LINEAR_____36_CM 1 100. 0. 65535. DISPLAY_IDENTIFIER STATE_TBL_ALTER_DC[2][1][4] ECU_ADDRESS 0xd000a982 FORMAT "%5.0" /end MEASUREMENT
/begin MEASUREMENT state_tbl_alter_dc[2][2][0] "Table with profile of alternator over alternator chip-temperature, load and speed during driving cycle (in s)" UWORD _CNV_A_R_LINEAR_____36_CM 1 100. 0. 65535. DISPLAY_IDENTIFIER STATE_TBL_ALTER_DC[2][2][0] ECU_ADDRESS 0xd000a984 FORMAT "%5.0" /end MEASUREMENT
/begin MEASUREMENT state_tbl_alter_dc[2][2][1] "Table with profile of alternator over alternator chip-temperature, load and speed during driving cycle (in s)" UWORD _CNV_A_R_LINEAR_____36_CM 1 100. 0. 65535. DISPLAY_IDENTIFIER STATE_TBL_ALTER_DC[2][2][1] ECU_ADDRESS 0xd000a986 FORMAT "%5.0" /end MEASUREMENT
/begin MEASUREMENT state_tbl_alter_dc[2][2][2] "Table with profile of alternator over alternator chip-temperature, load and speed during driving cycle (in s)" UWORD _CNV_A_R_LINEAR_____36_CM 1 100. 0. 65535. DISPLAY_IDENTIFIER STATE_TBL_ALTER_DC[2][2][2] ECU_ADDRESS 0xd000a988 FORMAT "%5.0" /end MEASUREMENT
/begin MEASUREMENT state_tbl_alter_dc[2][2][3] "Table with profile of alternator over alternator chip-temperature, load and speed during driving cycle (in s)" UWORD _CNV_A_R_LINEAR_____36_CM 1 100. 0. 65535. DISPLAY_IDENTIFIER STATE_TBL_ALTER_DC[2][2][3] ECU_ADDRESS 0xd000a98a FORMAT "%5.0" /end MEASUREMENT
/begin MEASUREMENT state_tbl_alter_dc[2][2][4] "Table with profile of alternator over alternator chip-temperature, load and speed during driving cycle (in s)" UWORD _CNV_A_R_LINEAR_____36_CM 1 100. 0. 65535. DISPLAY_IDENTIFIER STATE_TBL_ALTER_DC[2][2][4] ECU_ADDRESS 0xd000a98c FORMAT "%5.0" /end MEASUREMENT
/begin MEASUREMENT state_tbl_alter_dc[2][3][0] "Table with profile of alternator over alternator chip-temperature, load and speed during driving cycle (in s)" UWORD _CNV_A_R_LINEAR_____36_CM 1 100. 0. 65535. DISPLAY_IDENTIFIER STATE_TBL_ALTER_DC[2][3][0] ECU_ADDRESS 0xd000a98e FORMAT "%5.0" /end MEASUREMENT
/begin MEASUREMENT state_tbl_alter_dc[2][3][1] "Table with profile of alternator over alternator chip-temperature, load and speed during driving cycle (in s)" UWORD _CNV_A_R_LINEAR_____36_CM 1 100. 0. 65535. DISPLAY_IDENTIFIER STATE_TBL_ALTER_DC[2][3][1] ECU_ADDRESS 0xd000a990 FORMAT "%5.0" /end MEASUREMENT
/begin MEASUREMENT state_tbl_alter_dc[2][3][2] "Table with profile of alternator over alternator chip-temperature, load and speed during driving cycle (in s)" UWORD _CNV_A_R_LINEAR_____36_CM 1 100. 0. 65535. DISPLAY_IDENTIFIER STATE_TBL_ALTER_DC[2][3][2] ECU_ADDRESS 0xd000a992 FORMAT "%5.0" /end MEASUREMENT
/begin MEASUREMENT state_tbl_alter_dc[2][3][3] "Table with profile of alternator over alternator chip-temperature, load and speed during driving cycle (in s)" UWORD _CNV_A_R_LINEAR_____36_CM 1 100. 0. 65535. DISPLAY_IDENTIFIER STATE_TBL_ALTER_DC[2][3][3] ECU_ADDRESS 0xd000a994 FORMAT "%5.0" /end MEASUREMENT
/begin MEASUREMENT state_tbl_alter_dc[2][3][4] "Table with profile of alternator over alternator chip-temperature, load and speed during driving cycle (in s)" UWORD _CNV_A_R_LINEAR_____36_CM 1 100. 0. 65535. DISPLAY_IDENTIFIER STATE_TBL_ALTER_DC[2][3][4] ECU_ADDRESS 0xd000a996 FORMAT "%5.0" /end MEASUREMENT
/begin MEASUREMENT state_tbl_alter_dc[2][4][0] "Table with profile of alternator over alternator chip-temperature, load and speed during driving cycle (in s)" UWORD _CNV_A_R_LINEAR_____36_CM 1 100. 0. 65535. DISPLAY_IDENTIFIER STATE_TBL_ALTER_DC[2][4][0] ECU_ADDRESS 0xd000a998 FORMAT "%5.0" /end MEASUREMENT
/begin MEASUREMENT state_tbl_alter_dc[2][4][1] "Table with profile of alternator over alternator chip-temperature, load and speed during driving cycle (in s)" UWORD _CNV_A_R_LINEAR_____36_CM 1 100. 0. 65535. DISPLAY_IDENTIFIER STATE_TBL_ALTER_DC[2][4][1] ECU_ADDRESS 0xd000a99a FORMAT "%5.0" /end MEASUREMENT
/begin MEASUREMENT state_tbl_alter_dc[2][4][2] "Table with profile of alternator over alternator chip-temperature, load and speed during driving cycle (in s)" UWORD _CNV_A_R_LINEAR_____36_CM 1 100. 0. 65535. DISPLAY_IDENTIFIER STATE_TBL_ALTER_DC[2][4][2] ECU_ADDRESS 0xd000a99c FORMAT "%5.0" /end MEASUREMENT
/begin MEASUREMENT state_tbl_alter_dc[2][4][3] "Table with profile of alternator over alternator chip-temperature, load and speed during driving cycle (in s)" UWORD _CNV_A_R_LINEAR_____36_CM 1 100. 0. 65535. DISPLAY_IDENTIFIER STATE_TBL_ALTER_DC[2][4][3] ECU_ADDRESS 0xd000a99e FORMAT "%5.0" /end MEASUREMENT
/begin MEASUREMENT state_tbl_alter_dc[2][4][4] "Table with profile of alternator over alternator chip-temperature, load and speed during driving cycle (in s)" UWORD _CNV_A_R_LINEAR_____36_CM 1 100. 0. 65535. DISPLAY_IDENTIFIER STATE_TBL_ALTER_DC[2][4][4] ECU_ADDRESS 0xd000a9a0 FORMAT "%5.0" /end MEASUREMENT
/begin MEASUREMENT state_tbl_alter_dc[3][0][0] "Table with profile of alternator over alternator chip-temperature, load and speed during driving cycle (in s)" UWORD _CNV_A_R_LINEAR_____36_CM 1 100. 0. 65535. DISPLAY_IDENTIFIER STATE_TBL_ALTER_DC[3][0][0] ECU_ADDRESS 0xd000a9a2 FORMAT "%5.0" /end MEASUREMENT
/begin MEASUREMENT state_tbl_alter_dc[3][0][1] "Table with profile of alternator over alternator chip-temperature, load and speed during driving cycle (in s)" UWORD _CNV_A_R_LINEAR_____36_CM 1 100. 0. 65535. DISPLAY_IDENTIFIER STATE_TBL_ALTER_DC[3][0][1] ECU_ADDRESS 0xd000a9a4 FORMAT "%5.0" /end MEASUREMENT
/begin MEASUREMENT state_tbl_alter_dc[3][0][2] "Table with profile of alternator over alternator chip-temperature, load and speed during driving cycle (in s)" UWORD _CNV_A_R_LINEAR_____36_CM 1 100. 0. 65535. DISPLAY_IDENTIFIER STATE_TBL_ALTER_DC[3][0][2] ECU_ADDRESS 0xd000a9a6 FORMAT "%5.0" /end MEASUREMENT
/begin MEASUREMENT state_tbl_alter_dc[3][0][3] "Table with profile of alternator over alternator chip-temperature, load and speed during driving cycle (in s)" UWORD _CNV_A_R_LINEAR_____36_CM 1 100. 0. 65535. DISPLAY_IDENTIFIER STATE_TBL_ALTER_DC[3][0][3] ECU_ADDRESS 0xd000a9a8 FORMAT "%5.0" /end MEASUREMENT
/begin MEASUREMENT state_tbl_alter_dc[3][0][4] "Table with profile of alternator over alternator chip-temperature, load and speed during driving cycle (in s)" UWORD _CNV_A_R_LINEAR_____36_CM 1 100. 0. 65535. DISPLAY_IDENTIFIER STATE_TBL_ALTER_DC[3][0][4] ECU_ADDRESS 0xd000a9aa FORMAT "%5.0" /end MEASUREMENT
/begin MEASUREMENT state_tbl_alter_dc[3][1][0] "Table with profile of alternator over alternator chip-temperature, load and speed during driving cycle (in s)" UWORD _CNV_A_R_LINEAR_____36_CM 1 100. 0. 65535. DISPLAY_IDENTIFIER STATE_TBL_ALTER_DC[3][1][0] ECU_ADDRESS 0xd000a9ac FORMAT "%5.0" /end MEASUREMENT
/begin MEASUREMENT state_tbl_alter_dc[3][1][1] "Table with profile of alternator over alternator chip-temperature, load and speed during driving cycle (in s)" UWORD _CNV_A_R_LINEAR_____36_CM 1 100. 0. 65535. DISPLAY_IDENTIFIER STATE_TBL_ALTER_DC[3][1][1] ECU_ADDRESS 0xd000a9ae FORMAT "%5.0" /end MEASUREMENT
/begin MEASUREMENT state_tbl_alter_dc[3][1][2] "Table with profile of alternator over alternator chip-temperature, load and speed during driving cycle (in s)" UWORD _CNV_A_R_LINEAR_____36_CM 1 100. 0. 65535. DISPLAY_IDENTIFIER STATE_TBL_ALTER_DC[3][1][2] ECU_ADDRESS 0xd000a9b0 FORMAT "%5.0" /end MEASUREMENT
/begin MEASUREMENT state_tbl_alter_dc[3][1][3] "Table with profile of alternator over alternator chip-temperature, load and speed during driving cycle (in s)" UWORD _CNV_A_R_LINEAR_____36_CM 1 100. 0. 65535. DISPLAY_IDENTIFIER STATE_TBL_ALTER_DC[3][1][3] ECU_ADDRESS 0xd000a9b2 FORMAT "%5.0" /end MEASUREMENT
/begin MEASUREMENT state_tbl_alter_dc[3][1][4] "Table with profile of alternator over alternator chip-temperature, load and speed during driving cycle (in s)" UWORD _CNV_A_R_LINEAR_____36_CM 1 100. 0. 65535. DISPLAY_IDENTIFIER STATE_TBL_ALTER_DC[3][1][4] ECU_ADDRESS 0xd000a9b4 FORMAT "%5.0" /end MEASUREMENT
/begin MEASUREMENT state_tbl_alter_dc[3][2][0] "Table with profile of alternator over alternator chip-temperature, load and speed during driving cycle (in s)" UWORD _CNV_A_R_LINEAR_____36_CM 1 100. 0. 65535. DISPLAY_IDENTIFIER STATE_TBL_ALTER_DC[3][2][0] ECU_ADDRESS 0xd000a9b6 FORMAT "%5.0" /end MEASUREMENT
/begin MEASUREMENT state_tbl_alter_dc[3][2][1] "Table with profile of alternator over alternator chip-temperature, load and speed during driving cycle (in s)" UWORD _CNV_A_R_LINEAR_____36_CM 1 100. 0. 65535. DISPLAY_IDENTIFIER STATE_TBL_ALTER_DC[3][2][1] ECU_ADDRESS 0xd000a9b8 FORMAT "%5.0" /end MEASUREMENT
/begin MEASUREMENT state_tbl_alter_dc[3][2][2] "Table with profile of alternator over alternator chip-temperature, load and speed during driving cycle (in s)" UWORD _CNV_A_R_LINEAR_____36_CM 1 100. 0. 65535. DISPLAY_IDENTIFIER STATE_TBL_ALTER_DC[3][2][2] ECU_ADDRESS 0xd000a9ba FORMAT "%5.0" /end MEASUREMENT
/begin MEASUREMENT state_tbl_alter_dc[3][2][3] "Table with profile of alternator over alternator chip-temperature, load and speed during driving cycle (in s)" UWORD _CNV_A_R_LINEAR_____36_CM 1 100. 0. 65535. DISPLAY_IDENTIFIER STATE_TBL_ALTER_DC[3][2][3] ECU_ADDRESS 0xd000a9bc FORMAT "%5.0" /end MEASUREMENT
/begin MEASUREMENT state_tbl_alter_dc[3][2][4] "Table with profile of alternator over alternator chip-temperature, load and speed during driving cycle (in s)" UWORD _CNV_A_R_LINEAR_____36_CM 1 100. 0. 65535. DISPLAY_IDENTIFIER STATE_TBL_ALTER_DC[3][2][4] ECU_ADDRESS 0xd000a9be FORMAT "%5.0" /end MEASUREMENT
/begin MEASUREMENT state_tbl_alter_dc[3][3][0] "Table with profile of alternator over alternator chip-temperature, load and speed during driving cycle (in s)" UWORD _CNV_A_R_LINEAR_____36_CM 1 100. 0. 65535. DISPLAY_IDENTIFIER STATE_TBL_ALTER_DC[3][3][0] ECU_ADDRESS 0xd000a9c0 FORMAT "%5.0" /end MEASUREMENT
/begin MEASUREMENT state_tbl_alter_dc[3][3][1] "Table with profile of alternator over alternator chip-temperature, load and speed during driving cycle (in s)" UWORD _CNV_A_R_LINEAR_____36_CM 1 100. 0. 65535. DISPLAY_IDENTIFIER STATE_TBL_ALTER_DC[3][3][1] ECU_ADDRESS 0xd000a9c2 FORMAT "%5.0" /end MEASUREMENT
/begin MEASUREMENT state_tbl_alter_dc[3][3][2] "Table with profile of alternator over alternator chip-temperature, load and speed during driving cycle (in s)" UWORD _CNV_A_R_LINEAR_____36_CM 1 100. 0. 65535. DISPLAY_IDENTIFIER STATE_TBL_ALTER_DC[3][3][2] ECU_ADDRESS 0xd000a9c4 FORMAT "%5.0" /end MEASUREMENT
/begin MEASUREMENT state_tbl_alter_dc[3][3][3] "Table with profile of alternator over alternator chip-temperature, load and speed during driving cycle (in s)" UWORD _CNV_A_R_LINEAR_____36_CM 1 100. 0. 65535. DISPLAY_IDENTIFIER STATE_TBL_ALTER_DC[3][3][3] ECU_ADDRESS 0xd000a9c6 FORMAT "%5.0" /end MEASUREMENT
/begin MEASUREMENT state_tbl_alter_dc[3][3][4] "Table with profile of alternator over alternator chip-temperature, load and speed during driving cycle (in s)" UWORD _CNV_A_R_LINEAR_____36_CM 1 100. 0. 65535. DISPLAY_IDENTIFIER STATE_TBL_ALTER_DC[3][3][4] ECU_ADDRESS 0xd000a9c8 FORMAT "%5.0" /end MEASUREMENT
/begin MEASUREMENT state_tbl_alter_dc[3][4][0] "Table with profile of alternator over alternator chip-temperature, load and speed during driving cycle (in s)" UWORD _CNV_A_R_LINEAR_____36_CM 1 100. 0. 65535. DISPLAY_IDENTIFIER STATE_TBL_ALTER_DC[3][4][0] ECU_ADDRESS 0xd000a9ca FORMAT "%5.0" /end MEASUREMENT
/begin MEASUREMENT state_tbl_alter_dc[3][4][1] "Table with profile of alternator over alternator chip-temperature, load and speed during driving cycle (in s)" UWORD _CNV_A_R_LINEAR_____36_CM 1 100. 0. 65535. DISPLAY_IDENTIFIER STATE_TBL_ALTER_DC[3][4][1] ECU_ADDRESS 0xd000a9cc FORMAT "%5.0" /end MEASUREMENT
/begin MEASUREMENT state_tbl_alter_dc[3][4][2] "Table with profile of alternator over alternator chip-temperature, load and speed during driving cycle (in s)" UWORD _CNV_A_R_LINEAR_____36_CM 1 100. 0. 65535. DISPLAY_IDENTIFIER STATE_TBL_ALTER_DC[3][4][2] ECU_ADDRESS 0xd000a9ce FORMAT "%5.0" /end MEASUREMENT
/begin MEASUREMENT state_tbl_alter_dc[3][4][3] "Table with profile of alternator over alternator chip-temperature, load and speed during driving cycle (in s)" UWORD _CNV_A_R_LINEAR_____36_CM 1 100. 0. 65535. DISPLAY_IDENTIFIER STATE_TBL_ALTER_DC[3][4][3] ECU_ADDRESS 0xd000a9d0 FORMAT "%5.0" /end MEASUREMENT
/begin MEASUREMENT state_tbl_alter_dc[3][4][4] "Table with profile of alternator over alternator chip-temperature, load and speed during driving cycle (in s)" UWORD _CNV_A_R_LINEAR_____36_CM 1 100. 0. 65535. DISPLAY_IDENTIFIER STATE_TBL_ALTER_DC[3][4][4] ECU_ADDRESS 0xd000a9d2 FORMAT "%5.0" /end MEASUREMENT
/begin MEASUREMENT state_tbl_alter_dc[4][0][0] "Table with profile of alternator over alternator chip-temperature, load and speed during driving cycle (in s)" UWORD _CNV_A_R_LINEAR_____36_CM 1 100. 0. 65535. DISPLAY_IDENTIFIER STATE_TBL_ALTER_DC[4][0][0] ECU_ADDRESS 0xd000a9d4 FORMAT "%5.0" /end MEASUREMENT
/begin MEASUREMENT state_tbl_alter_dc[4][0][1] "Table with profile of alternator over alternator chip-temperature, load and speed during driving cycle (in s)" UWORD _CNV_A_R_LINEAR_____36_CM 1 100. 0. 65535. DISPLAY_IDENTIFIER STATE_TBL_ALTER_DC[4][0][1] ECU_ADDRESS 0xd000a9d6 FORMAT "%5.0" /end MEASUREMENT
/begin MEASUREMENT state_tbl_alter_dc[4][0][2] "Table with profile of alternator over alternator chip-temperature, load and speed during driving cycle (in s)" UWORD _CNV_A_R_LINEAR_____36_CM 1 100. 0. 65535. DISPLAY_IDENTIFIER STATE_TBL_ALTER_DC[4][0][2] ECU_ADDRESS 0xd000a9d8 FORMAT "%5.0" /end MEASUREMENT
/begin MEASUREMENT state_tbl_alter_dc[4][0][3] "Table with profile of alternator over alternator chip-temperature, load and speed during driving cycle (in s)" UWORD _CNV_A_R_LINEAR_____36_CM 1 100. 0. 65535. DISPLAY_IDENTIFIER STATE_TBL_ALTER_DC[4][0][3] ECU_ADDRESS 0xd000a9da FORMAT "%5.0" /end MEASUREMENT
/begin MEASUREMENT state_tbl_alter_dc[4][0][4] "Table with profile of alternator over alternator chip-temperature, load and speed during driving cycle (in s)" UWORD _CNV_A_R_LINEAR_____36_CM 1 100. 0. 65535. DISPLAY_IDENTIFIER STATE_TBL_ALTER_DC[4][0][4] ECU_ADDRESS 0xd000a9dc FORMAT "%5.0" /end MEASUREMENT
/begin MEASUREMENT state_tbl_alter_dc[4][1][0] "Table with profile of alternator over alternator chip-temperature, load and speed during driving cycle (in s)" UWORD _CNV_A_R_LINEAR_____36_CM 1 100. 0. 65535. DISPLAY_IDENTIFIER STATE_TBL_ALTER_DC[4][1][0] ECU_ADDRESS 0xd000a9de FORMAT "%5.0" /end MEASUREMENT
/begin MEASUREMENT state_tbl_alter_dc[4][1][1] "Table with profile of alternator over alternator chip-temperature, load and speed during driving cycle (in s)" UWORD _CNV_A_R_LINEAR_____36_CM 1 100. 0. 65535. DISPLAY_IDENTIFIER STATE_TBL_ALTER_DC[4][1][1] ECU_ADDRESS 0xd000a9e0 FORMAT "%5.0" /end MEASUREMENT
/begin MEASUREMENT state_tbl_alter_dc[4][1][2] "Table with profile of alternator over alternator chip-temperature, load and speed during driving cycle (in s)" UWORD _CNV_A_R_LINEAR_____36_CM 1 100. 0. 65535. DISPLAY_IDENTIFIER STATE_TBL_ALTER_DC[4][1][2] ECU_ADDRESS 0xd000a9e2 FORMAT "%5.0" /end MEASUREMENT
/begin MEASUREMENT state_tbl_alter_dc[4][1][3] "Table with profile of alternator over alternator chip-temperature, load and speed during driving cycle (in s)" UWORD _CNV_A_R_LINEAR_____36_CM 1 100. 0. 65535. DISPLAY_IDENTIFIER STATE_TBL_ALTER_DC[4][1][3] ECU_ADDRESS 0xd000a9e4 FORMAT "%5.0" /end MEASUREMENT
/begin MEASUREMENT state_tbl_alter_dc[4][1][4] "Table with profile of alternator over alternator chip-temperature, load and speed during driving cycle (in s)" UWORD _CNV_A_R_LINEAR_____36_CM 1 100. 0. 65535. DISPLAY_IDENTIFIER STATE_TBL_ALTER_DC[4][1][4] ECU_ADDRESS 0xd000a9e6 FORMAT "%5.0" /end MEASUREMENT
/begin MEASUREMENT state_tbl_alter_dc[4][2][0] "Table with profile of alternator over alternator chip-temperature, load and speed during driving cycle (in s)" UWORD _CNV_A_R_LINEAR_____36_CM 1 100. 0. 65535. DISPLAY_IDENTIFIER STATE_TBL_ALTER_DC[4][2][0] ECU_ADDRESS 0xd000a9e8 FORMAT "%5.0" /end MEASUREMENT
/begin MEASUREMENT state_tbl_alter_dc[4][2][1] "Table with profile of alternator over alternator chip-temperature, load and speed during driving cycle (in s)" UWORD _CNV_A_R_LINEAR_____36_CM 1 100. 0. 65535. DISPLAY_IDENTIFIER STATE_TBL_ALTER_DC[4][2][1] ECU_ADDRESS 0xd000a9ea FORMAT "%5.0" /end MEASUREMENT
/begin MEASUREMENT state_tbl_alter_dc[4][2][2] "Table with profile of alternator over alternator chip-temperature, load and speed during driving cycle (in s)" UWORD _CNV_A_R_LINEAR_____36_CM 1 100. 0. 65535. DISPLAY_IDENTIFIER STATE_TBL_ALTER_DC[4][2][2] ECU_ADDRESS 0xd000a9ec FORMAT "%5.0" /end MEASUREMENT
/begin MEASUREMENT state_tbl_alter_dc[4][2][3] "Table with profile of alternator over alternator chip-temperature, load and speed during driving cycle (in s)" UWORD _CNV_A_R_LINEAR_____36_CM 1 100. 0. 65535. DISPLAY_IDENTIFIER STATE_TBL_ALTER_DC[4][2][3] ECU_ADDRESS 0xd000a9ee FORMAT "%5.0" /end MEASUREMENT
/begin MEASUREMENT state_tbl_alter_dc[4][2][4] "Table with profile of alternator over alternator chip-temperature, load and speed during driving cycle (in s)" UWORD _CNV_A_R_LINEAR_____36_CM 1 100. 0. 65535. DISPLAY_IDENTIFIER STATE_TBL_ALTER_DC[4][2][4] ECU_ADDRESS 0xd000a9f0 FORMAT "%5.0" /end MEASUREMENT
/begin MEASUREMENT state_tbl_alter_dc[4][3][0] "Table with profile of alternator over alternator chip-temperature, load and speed during driving cycle (in s)" UWORD _CNV_A_R_LINEAR_____36_CM 1 100. 0. 65535. DISPLAY_IDENTIFIER STATE_TBL_ALTER_DC[4][3][0] ECU_ADDRESS 0xd000a9f2 FORMAT "%5.0" /end MEASUREMENT
/begin MEASUREMENT state_tbl_alter_dc[4][3][1] "Table with profile of alternator over alternator chip-temperature, load and speed during driving cycle (in s)" UWORD _CNV_A_R_LINEAR_____36_CM 1 100. 0. 65535. DISPLAY_IDENTIFIER STATE_TBL_ALTER_DC[4][3][1] ECU_ADDRESS 0xd000a9f4 FORMAT "%5.0" /end MEASUREMENT
/begin MEASUREMENT state_tbl_alter_dc[4][3][2] "Table with profile of alternator over alternator chip-temperature, load and speed during driving cycle (in s)" UWORD _CNV_A_R_LINEAR_____36_CM 1 100. 0. 65535. DISPLAY_IDENTIFIER STATE_TBL_ALTER_DC[4][3][2] ECU_ADDRESS 0xd000a9f6 FORMAT "%5.0" /end MEASUREMENT
/begin MEASUREMENT state_tbl_alter_dc[4][3][3] "Table with profile of alternator over alternator chip-temperature, load and speed during driving cycle (in s)" UWORD _CNV_A_R_LINEAR_____36_CM 1 100. 0. 65535. DISPLAY_IDENTIFIER STATE_TBL_ALTER_DC[4][3][3] ECU_ADDRESS 0xd000a9f8 FORMAT "%5.0" /end MEASUREMENT
/begin MEASUREMENT state_tbl_alter_dc[4][3][4] "Table with profile of alternator over alternator chip-temperature, load and speed during driving cycle (in s)" UWORD _CNV_A_R_LINEAR_____36_CM 1 100. 0. 65535. DISPLAY_IDENTIFIER STATE_TBL_ALTER_DC[4][3][4] ECU_ADDRESS 0xd000a9fa FORMAT "%5.0" /end MEASUREMENT
/begin MEASUREMENT state_tbl_alter_dc[4][4][0] "Table with profile of alternator over alternator chip-temperature, load and speed during driving cycle (in s)" UWORD _CNV_A_R_LINEAR_____36_CM 1 100. 0. 65535. DISPLAY_IDENTIFIER STATE_TBL_ALTER_DC[4][4][0] ECU_ADDRESS 0xd000a9fc FORMAT "%5.0" /end MEASUREMENT
/begin MEASUREMENT state_tbl_alter_dc[4][4][1] "Table with profile of alternator over alternator chip-temperature, load and speed during driving cycle (in s)" UWORD _CNV_A_R_LINEAR_____36_CM 1 100. 0. 65535. DISPLAY_IDENTIFIER STATE_TBL_ALTER_DC[4][4][1] ECU_ADDRESS 0xd000a9fe FORMAT "%5.0" /end MEASUREMENT
/begin MEASUREMENT state_tbl_alter_dc[4][4][2] "Table with profile of alternator over alternator chip-temperature, load and speed during driving cycle (in s)" UWORD _CNV_A_R_LINEAR_____36_CM 1 100. 0. 65535. DISPLAY_IDENTIFIER STATE_TBL_ALTER_DC[4][4][2] ECU_ADDRESS 0xd000aa00 FORMAT "%5.0" /end MEASUREMENT
/begin MEASUREMENT state_tbl_alter_dc[4][4][3] "Table with profile of alternator over alternator chip-temperature, load and speed during driving cycle (in s)" UWORD _CNV_A_R_LINEAR_____36_CM 1 100. 0. 65535. DISPLAY_IDENTIFIER STATE_TBL_ALTER_DC[4][4][3] ECU_ADDRESS 0xd000aa02 FORMAT "%5.0" /end MEASUREMENT
/begin MEASUREMENT state_tbl_alter_dc[4][4][4] "Table with profile of alternator over alternator chip-temperature, load and speed during driving cycle (in s)" UWORD _CNV_A_R_LINEAR_____36_CM 1 100. 0. 65535. DISPLAY_IDENTIFIER STATE_TBL_ALTER_DC[4][4][4] ECU_ADDRESS 0xd000aa04 FORMAT "%5.0" /end MEASUREMENT
/begin MEASUREMENT state_tbl_alter_dc[5][0][0] "Table with profile of alternator over alternator chip-temperature, load and speed during driving cycle (in s)" UWORD _CNV_A_R_LINEAR_____36_CM 1 100. 0. 65535. DISPLAY_IDENTIFIER STATE_TBL_ALTER_DC[5][0][0] ECU_ADDRESS 0xd000aa06 FORMAT "%5.0" /end MEASUREMENT
/begin MEASUREMENT state_tbl_alter_dc[5][0][1] "Table with profile of alternator over alternator chip-temperature, load and speed during driving cycle (in s)" UWORD _CNV_A_R_LINEAR_____36_CM 1 100. 0. 65535. DISPLAY_IDENTIFIER STATE_TBL_ALTER_DC[5][0][1] ECU_ADDRESS 0xd000aa08 FORMAT "%5.0" /end MEASUREMENT
/begin MEASUREMENT state_tbl_alter_dc[5][0][2] "Table with profile of alternator over alternator chip-temperature, load and speed during driving cycle (in s)" UWORD _CNV_A_R_LINEAR_____36_CM 1 100. 0. 65535. DISPLAY_IDENTIFIER STATE_TBL_ALTER_DC[5][0][2] ECU_ADDRESS 0xd000aa0a FORMAT "%5.0" /end MEASUREMENT
/begin MEASUREMENT state_tbl_alter_dc[5][0][3] "Table with profile of alternator over alternator chip-temperature, load and speed during driving cycle (in s)" UWORD _CNV_A_R_LINEAR_____36_CM 1 100. 0. 65535. DISPLAY_IDENTIFIER STATE_TBL_ALTER_DC[5][0][3] ECU_ADDRESS 0xd000aa0c FORMAT "%5.0" /end MEASUREMENT
/begin MEASUREMENT state_tbl_alter_dc[5][0][4] "Table with profile of alternator over alternator chip-temperature, load and speed during driving cycle (in s)" UWORD _CNV_A_R_LINEAR_____36_CM 1 100. 0. 65535. DISPLAY_IDENTIFIER STATE_TBL_ALTER_DC[5][0][4] ECU_ADDRESS 0xd000aa0e FORMAT "%5.0" /end MEASUREMENT
/begin MEASUREMENT state_tbl_alter_dc[5][1][0] "Table with profile of alternator over alternator chip-temperature, load and speed during driving cycle (in s)" UWORD _CNV_A_R_LINEAR_____36_CM 1 100. 0. 65535. DISPLAY_IDENTIFIER STATE_TBL_ALTER_DC[5][1][0] ECU_ADDRESS 0xd000aa10 FORMAT "%5.0" /end MEASUREMENT
/begin MEASUREMENT state_tbl_alter_dc[5][1][1] "Table with profile of alternator over alternator chip-temperature, load and speed during driving cycle (in s)" UWORD _CNV_A_R_LINEAR_____36_CM 1 100. 0. 65535. DISPLAY_IDENTIFIER STATE_TBL_ALTER_DC[5][1][1] ECU_ADDRESS 0xd000aa12 FORMAT "%5.0" /end MEASUREMENT
/begin MEASUREMENT state_tbl_alter_dc[5][1][2] "Table with profile of alternator over alternator chip-temperature, load and speed during driving cycle (in s)" UWORD _CNV_A_R_LINEAR_____36_CM 1 100. 0. 65535. DISPLAY_IDENTIFIER STATE_TBL_ALTER_DC[5][1][2] ECU_ADDRESS 0xd000aa14 FORMAT "%5.0" /end MEASUREMENT
/begin MEASUREMENT state_tbl_alter_dc[5][1][3] "Table with profile of alternator over alternator chip-temperature, load and speed during driving cycle (in s)" UWORD _CNV_A_R_LINEAR_____36_CM 1 100. 0. 65535. DISPLAY_IDENTIFIER STATE_TBL_ALTER_DC[5][1][3] ECU_ADDRESS 0xd000aa16 FORMAT "%5.0" /end MEASUREMENT
/begin MEASUREMENT state_tbl_alter_dc[5][1][4] "Table with profile of alternator over alternator chip-temperature, load and speed during driving cycle (in s)" UWORD _CNV_A_R_LINEAR_____36_CM 1 100. 0. 65535. DISPLAY_IDENTIFIER STATE_TBL_ALTER_DC[5][1][4] ECU_ADDRESS 0xd000aa18 FORMAT "%5.0" /end MEASUREMENT
/begin MEASUREMENT state_tbl_alter_dc[5][2][0] "Table with profile of alternator over alternator chip-temperature, load and speed during driving cycle (in s)" UWORD _CNV_A_R_LINEAR_____36_CM 1 100. 0. 65535. DISPLAY_IDENTIFIER STATE_TBL_ALTER_DC[5][2][0] ECU_ADDRESS 0xd000aa1a FORMAT "%5.0" /end MEASUREMENT
/begin MEASUREMENT state_tbl_alter_dc[5][2][1] "Table with profile of alternator over alternator chip-temperature, load and speed during driving cycle (in s)" UWORD _CNV_A_R_LINEAR_____36_CM 1 100. 0. 65535. DISPLAY_IDENTIFIER STATE_TBL_ALTER_DC[5][2][1] ECU_ADDRESS 0xd000aa1c FORMAT "%5.0" /end MEASUREMENT
/begin MEASUREMENT state_tbl_alter_dc[5][2][2] "Table with profile of alternator over alternator chip-temperature, load and speed during driving cycle (in s)" UWORD _CNV_A_R_LINEAR_____36_CM 1 100. 0. 65535. DISPLAY_IDENTIFIER STATE_TBL_ALTER_DC[5][2][2] ECU_ADDRESS 0xd000aa1e FORMAT "%5.0" /end MEASUREMENT
/begin MEASUREMENT state_tbl_alter_dc[5][2][3] "Table with profile of alternator over alternator chip-temperature, load and speed during driving cycle (in s)" UWORD _CNV_A_R_LINEAR_____36_CM 1 100. 0. 65535. DISPLAY_IDENTIFIER STATE_TBL_ALTER_DC[5][2][3] ECU_ADDRESS 0xd000aa20 FORMAT "%5.0" /end MEASUREMENT
/begin MEASUREMENT state_tbl_alter_dc[5][2][4] "Table with profile of alternator over alternator chip-temperature, load and speed during driving cycle (in s)" UWORD _CNV_A_R_LINEAR_____36_CM 1 100. 0. 65535. DISPLAY_IDENTIFIER STATE_TBL_ALTER_DC[5][2][4] ECU_ADDRESS 0xd000aa22 FORMAT "%5.0" /end MEASUREMENT
/begin MEASUREMENT state_tbl_alter_dc[5][3][0] "Table with profile of alternator over alternator chip-temperature, load and speed during driving cycle (in s)" UWORD _CNV_A_R_LINEAR_____36_CM 1 100. 0. 65535. DISPLAY_IDENTIFIER STATE_TBL_ALTER_DC[5][3][0] ECU_ADDRESS 0xd000aa24 FORMAT "%5.0" /end MEASUREMENT
/begin MEASUREMENT state_tbl_alter_dc[5][3][1] "Table with profile of alternator over alternator chip-temperature, load and speed during driving cycle (in s)" UWORD _CNV_A_R_LINEAR_____36_CM 1 100. 0. 65535. DISPLAY_IDENTIFIER STATE_TBL_ALTER_DC[5][3][1] ECU_ADDRESS 0xd000aa26 FORMAT "%5.0" /end MEASUREMENT
/begin MEASUREMENT state_tbl_alter_dc[5][3][2] "Table with profile of alternator over alternator chip-temperature, load and speed during driving cycle (in s)" UWORD _CNV_A_R_LINEAR_____36_CM 1 100. 0. 65535. DISPLAY_IDENTIFIER STATE_TBL_ALTER_DC[5][3][2] ECU_ADDRESS 0xd000aa28 FORMAT "%5.0" /end MEASUREMENT
/begin MEASUREMENT state_tbl_alter_dc[5][3][3] "Table with profile of alternator over alternator chip-temperature, load and speed during driving cycle (in s)" UWORD _CNV_A_R_LINEAR_____36_CM 1 100. 0. 65535. DISPLAY_IDENTIFIER STATE_TBL_ALTER_DC[5][3][3] ECU_ADDRESS 0xd000aa2a FORMAT "%5.0" /end MEASUREMENT
/begin MEASUREMENT state_tbl_alter_dc[5][3][4] "Table with profile of alternator over alternator chip-temperature, load and speed during driving cycle (in s)" UWORD _CNV_A_R_LINEAR_____36_CM 1 100. 0. 65535. DISPLAY_IDENTIFIER STATE_TBL_ALTER_DC[5][3][4] ECU_ADDRESS 0xd000aa2c FORMAT "%5.0" /end MEASUREMENT
/begin MEASUREMENT state_tbl_alter_dc[5][4][0] "Table with profile of alternator over alternator chip-temperature, load and speed during driving cycle (in s)" UWORD _CNV_A_R_LINEAR_____36_CM 1 100. 0. 65535. DISPLAY_IDENTIFIER STATE_TBL_ALTER_DC[5][4][0] ECU_ADDRESS 0xd000aa2e FORMAT "%5.0" /end MEASUREMENT
/begin MEASUREMENT state_tbl_alter_dc[5][4][1] "Table with profile of alternator over alternator chip-temperature, load and speed during driving cycle (in s)" UWORD _CNV_A_R_LINEAR_____36_CM 1 100. 0. 65535. DISPLAY_IDENTIFIER STATE_TBL_ALTER_DC[5][4][1] ECU_ADDRESS 0xd000aa30 FORMAT "%5.0" /end MEASUREMENT
/begin MEASUREMENT state_tbl_alter_dc[5][4][2] "Table with profile of alternator over alternator chip-temperature, load and speed during driving cycle (in s)" UWORD _CNV_A_R_LINEAR_____36_CM 1 100. 0. 65535. DISPLAY_IDENTIFIER STATE_TBL_ALTER_DC[5][4][2] ECU_ADDRESS 0xd000aa32 FORMAT "%5.0" /end MEASUREMENT
/begin MEASUREMENT state_tbl_alter_dc[5][4][3] "Table with profile of alternator over alternator chip-temperature, load and speed during driving cycle (in s)" UWORD _CNV_A_R_LINEAR_____36_CM 1 100. 0. 65535. DISPLAY_IDENTIFIER STATE_TBL_ALTER_DC[5][4][3] ECU_ADDRESS 0xd000aa34 FORMAT "%5.0" /end MEASUREMENT
/begin MEASUREMENT state_tbl_alter_dc[5][4][4] "Table with profile of alternator over alternator chip-temperature, load and speed during driving cycle (in s)" UWORD _CNV_A_R_LINEAR_____36_CM 1 100. 0. 65535. DISPLAY_IDENTIFIER STATE_TBL_ALTER_DC[5][4][4] ECU_ADDRESS 0xd000aa36 FORMAT "%5.0" /end MEASUREMENT
/begin MEASUREMENT state_tbl_alter_dc[6][0][0] "Table with profile of alternator over alternator chip-temperature, load and speed during driving cycle (in s)" UWORD _CNV_A_R_LINEAR_____36_CM 1 100. 0. 65535. DISPLAY_IDENTIFIER STATE_TBL_ALTER_DC[6][0][0] ECU_ADDRESS 0xd000aa38 FORMAT "%5.0" /end MEASUREMENT
/begin MEASUREMENT state_tbl_alter_dc[6][0][1] "Table with profile of alternator over alternator chip-temperature, load and speed during driving cycle (in s)" UWORD _CNV_A_R_LINEAR_____36_CM 1 100. 0. 65535. DISPLAY_IDENTIFIER STATE_TBL_ALTER_DC[6][0][1] ECU_ADDRESS 0xd000aa3a FORMAT "%5.0" /end MEASUREMENT
/begin MEASUREMENT state_tbl_alter_dc[6][0][2] "Table with profile of alternator over alternator chip-temperature, load and speed during driving cycle (in s)" UWORD _CNV_A_R_LINEAR_____36_CM 1 100. 0. 65535. DISPLAY_IDENTIFIER STATE_TBL_ALTER_DC[6][0][2] ECU_ADDRESS 0xd000aa3c FORMAT "%5.0" /end MEASUREMENT
/begin MEASUREMENT state_tbl_alter_dc[6][0][3] "Table with profile of alternator over alternator chip-temperature, load and speed during driving cycle (in s)" UWORD _CNV_A_R_LINEAR_____36_CM 1 100. 0. 65535. DISPLAY_IDENTIFIER STATE_TBL_ALTER_DC[6][0][3] ECU_ADDRESS 0xd000aa3e FORMAT "%5.0" /end MEASUREMENT
/begin MEASUREMENT state_tbl_alter_dc[6][0][4] "Table with profile of alternator over alternator chip-temperature, load and speed during driving cycle (in s)" UWORD _CNV_A_R_LINEAR_____36_CM 1 100. 0. 65535. DISPLAY_IDENTIFIER STATE_TBL_ALTER_DC[6][0][4] ECU_ADDRESS 0xd000aa40 FORMAT "%5.0" /end MEASUREMENT
/begin MEASUREMENT state_tbl_alter_dc[6][1][0] "Table with profile of alternator over alternator chip-temperature, load and speed during driving cycle (in s)" UWORD _CNV_A_R_LINEAR_____36_CM 1 100. 0. 65535. DISPLAY_IDENTIFIER STATE_TBL_ALTER_DC[6][1][0] ECU_ADDRESS 0xd000aa42 FORMAT "%5.0" /end MEASUREMENT
/begin MEASUREMENT state_tbl_alter_dc[6][1][1] "Table with profile of alternator over alternator chip-temperature, load and speed during driving cycle (in s)" UWORD _CNV_A_R_LINEAR_____36_CM 1 100. 0. 65535. DISPLAY_IDENTIFIER STATE_TBL_ALTER_DC[6][1][1] ECU_ADDRESS 0xd000aa44 FORMAT "%5.0" /end MEASUREMENT
/begin MEASUREMENT state_tbl_alter_dc[6][1][2] "Table with profile of alternator over alternator chip-temperature, load and speed during driving cycle (in s)" UWORD _CNV_A_R_LINEAR_____36_CM 1 100. 0. 65535. DISPLAY_IDENTIFIER STATE_TBL_ALTER_DC[6][1][2] ECU_ADDRESS 0xd000aa46 FORMAT "%5.0" /end MEASUREMENT
/begin MEASUREMENT state_tbl_alter_dc[6][1][3] "Table with profile of alternator over alternator chip-temperature, load and speed during driving cycle (in s)" UWORD _CNV_A_R_LINEAR_____36_CM 1 100. 0. 65535. DISPLAY_IDENTIFIER STATE_TBL_ALTER_DC[6][1][3] ECU_ADDRESS 0xd000aa48 FORMAT "%5.0" /end MEASUREMENT
/begin MEASUREMENT state_tbl_alter_dc[6][1][4] "Table with profile of alternator over alternator chip-temperature, load and speed during driving cycle (in s)" UWORD _CNV_A_R_LINEAR_____36_CM 1 100. 0. 65535. DISPLAY_IDENTIFIER STATE_TBL_ALTER_DC[6][1][4] ECU_ADDRESS 0xd000aa4a FORMAT "%5.0" /end MEASUREMENT
/begin MEASUREMENT state_tbl_alter_dc[6][2][0] "Table with profile of alternator over alternator chip-temperature, load and speed during driving cycle (in s)" UWORD _CNV_A_R_LINEAR_____36_CM 1 100. 0. 65535. DISPLAY_IDENTIFIER STATE_TBL_ALTER_DC[6][2][0] ECU_ADDRESS 0xd000aa4c FORMAT "%5.0" /end MEASUREMENT
/begin MEASUREMENT state_tbl_alter_dc[6][2][1] "Table with profile of alternator over alternator chip-temperature, load and speed during driving cycle (in s)" UWORD _CNV_A_R_LINEAR_____36_CM 1 100. 0. 65535. DISPLAY_IDENTIFIER STATE_TBL_ALTER_DC[6][2][1] ECU_ADDRESS 0xd000aa4e FORMAT "%5.0" /end MEASUREMENT
/begin MEASUREMENT state_tbl_alter_dc[6][2][2] "Table with profile of alternator over alternator chip-temperature, load and speed during driving cycle (in s)" UWORD _CNV_A_R_LINEAR_____36_CM 1 100. 0. 65535. DISPLAY_IDENTIFIER STATE_TBL_ALTER_DC[6][2][2] ECU_ADDRESS 0xd000aa50 FORMAT "%5.0" /end MEASUREMENT
/begin MEASUREMENT state_tbl_alter_dc[6][2][3] "Table with profile of alternator over alternator chip-temperature, load and speed during driving cycle (in s)" UWORD _CNV_A_R_LINEAR_____36_CM 1 100. 0. 65535. DISPLAY_IDENTIFIER STATE_TBL_ALTER_DC[6][2][3] ECU_ADDRESS 0xd000aa52 FORMAT "%5.0" /end MEASUREMENT
/begin MEASUREMENT state_tbl_alter_dc[6][2][4] "Table with profile of alternator over alternator chip-temperature, load and speed during driving cycle (in s)" UWORD _CNV_A_R_LINEAR_____36_CM 1 100. 0. 65535. DISPLAY_IDENTIFIER STATE_TBL_ALTER_DC[6][2][4] ECU_ADDRESS 0xd000aa54 FORMAT "%5.0" /end MEASUREMENT
/begin MEASUREMENT state_tbl_alter_dc[6][3][0] "Table with profile of alternator over alternator chip-temperature, load and speed during driving cycle (in s)" UWORD _CNV_A_R_LINEAR_____36_CM 1 100. 0. 65535. DISPLAY_IDENTIFIER STATE_TBL_ALTER_DC[6][3][0] ECU_ADDRESS 0xd000aa56 FORMAT "%5.0" /end MEASUREMENT
/begin MEASUREMENT state_tbl_alter_dc[6][3][1] "Table with profile of alternator over alternator chip-temperature, load and speed during driving cycle (in s)" UWORD _CNV_A_R_LINEAR_____36_CM 1 100. 0. 65535. DISPLAY_IDENTIFIER STATE_TBL_ALTER_DC[6][3][1] ECU_ADDRESS 0xd000aa58 FORMAT "%5.0" /end MEASUREMENT
/begin MEASUREMENT state_tbl_alter_dc[6][3][2] "Table with profile of alternator over alternator chip-temperature, load and speed during driving cycle (in s)" UWORD _CNV_A_R_LINEAR_____36_CM 1 100. 0. 65535. DISPLAY_IDENTIFIER STATE_TBL_ALTER_DC[6][3][2] ECU_ADDRESS 0xd000aa5a FORMAT "%5.0" /end MEASUREMENT
/begin MEASUREMENT state_tbl_alter_dc[6][3][3] "Table with profile of alternator over alternator chip-temperature, load and speed during driving cycle (in s)" UWORD _CNV_A_R_LINEAR_____36_CM 1 100. 0. 65535. DISPLAY_IDENTIFIER STATE_TBL_ALTER_DC[6][3][3] ECU_ADDRESS 0xd000aa5c FORMAT "%5.0" /end MEASUREMENT
/begin MEASUREMENT state_tbl_alter_dc[6][3][4] "Table with profile of alternator over alternator chip-temperature, load and speed during driving cycle (in s)" UWORD _CNV_A_R_LINEAR_____36_CM 1 100. 0. 65535. DISPLAY_IDENTIFIER STATE_TBL_ALTER_DC[6][3][4] ECU_ADDRESS 0xd000aa5e FORMAT "%5.0" /end MEASUREMENT
/begin MEASUREMENT state_tbl_alter_dc[6][4][0] "Table with profile of alternator over alternator chip-temperature, load and speed during driving cycle (in s)" UWORD _CNV_A_R_LINEAR_____36_CM 1 100. 0. 65535. DISPLAY_IDENTIFIER STATE_TBL_ALTER_DC[6][4][0] ECU_ADDRESS 0xd000aa60 FORMAT "%5.0" /end MEASUREMENT
/begin MEASUREMENT state_tbl_alter_dc[6][4][1] "Table with profile of alternator over alternator chip-temperature, load and speed during driving cycle (in s)" UWORD _CNV_A_R_LINEAR_____36_CM 1 100. 0. 65535. DISPLAY_IDENTIFIER STATE_TBL_ALTER_DC[6][4][1] ECU_ADDRESS 0xd000aa62 FORMAT "%5.0" /end MEASUREMENT
/begin MEASUREMENT state_tbl_alter_dc[6][4][2] "Table with profile of alternator over alternator chip-temperature, load and speed during driving cycle (in s)" UWORD _CNV_A_R_LINEAR_____36_CM 1 100. 0. 65535. DISPLAY_IDENTIFIER STATE_TBL_ALTER_DC[6][4][2] ECU_ADDRESS 0xd000aa64 FORMAT "%5.0" /end MEASUREMENT
/begin MEASUREMENT state_tbl_alter_dc[6][4][3] "Table with profile of alternator over alternator chip-temperature, load and speed during driving cycle (in s)" UWORD _CNV_A_R_LINEAR_____36_CM 1 100. 0. 65535. DISPLAY_IDENTIFIER STATE_TBL_ALTER_DC[6][4][3] ECU_ADDRESS 0xd000aa66 FORMAT "%5.0" /end MEASUREMENT
/begin MEASUREMENT state_tbl_alter_dc[6][4][4] "Table with profile of alternator over alternator chip-temperature, load and speed during driving cycle (in s)" UWORD _CNV_A_R_LINEAR_____36_CM 1 100. 0. 65535. DISPLAY_IDENTIFIER STATE_TBL_ALTER_DC[6][4][4] ECU_ADDRESS 0xd000aa68 FORMAT "%5.0" /end MEASUREMENT
/begin COMPU_METHOD _CNV_A_R_LINEAR_____0_CM "" RAT_FUNC "%6.3" "-" COEFFS 0 1. 0. 0 0 1 /end COMPU_METHOD
/begin COMPU_METHOD _CNV_S_2_RANGE__0___1_CM "" TAB_VERB "%6.3" "-" COMPU_TAB_REF _CNV_S_2_RANGE__0___1 /end COMPU_METHOD
/begin COMPU_VTAB _CNV_S_2_RANGE__0___1 "" TAB_VERB 2 0 "0" 1 "1" /end COMPU_VTAB
/begin COMPU_METHOD _CNV_A_R_LINEAR_____3_CM "" RAT_FUNC "%6.3" "s" COEFFS 0 100. 0. 0 0 1 /end COMPU_METHOD
/begin COMPU_METHOD _CNV_A_R_LINEAR_____4_CM "" RAT_FUNC "%6.3" "s" COEFFS 0 10. 0. 0 0 1 /end COMPU_METHOD
/begin COMPU_METHOD _CNV_A_R_LINEAR_____5_CM "" RAT_FUNC "%6.3" "%" COEFFS 0 2.56 0. 0 0 1 /end COMPU_METHOD
/begin COMPU_METHOD _CNV_A_R_LINEAR_____6_CM "" RAT_FUNC "%6.3" "km/h" COEFFS 0 1. 0. 0 0 1 /end COMPU_METHOD
/begin COMPU_METHOD _CNV_A_R_LINEAR_____8_CM "" RAT_FUNC "%6.3" "%" COEFFS 0 655.3599999999997 0. 0 0 1 /end COMPU_METHOD
/begin COMPU_METHOD _CNV_A_R_LINEAR_____9_CM "" RAT_FUNC "%6.3" "-" COEFFS 0 32767.99999999992 0. 0 0 1 /end COMPU_METHOD
/begin COMPU_METHOD _CNV_A_R_LINEAR_____10_CM "" RAT_FUNC "%6.3" "rpm" COEFFS 0 3.125e-002 0. 0 0 1 /end COMPU_METHOD
/begin COMPU_METHOD _CNV_A_R_LINEAR_____18_CM "" RAT_FUNC "%6.3" "-" COEFFS 0 255.9983911655618 0. 0 0 1 /end COMPU_METHOD
/begin COMPU_METHOD _CNV_A_R_LINEAR_____20_CM "" RAT_FUNC "%6.3" "ms" COEFFS 0 0.1 0. 0 0 1 /end COMPU_METHOD
/begin COMPU_METHOD _CNV_S_10_RANGE_REQ__21_CM "" TAB_VERB "%6.3" "" COMPU_TAB_REF _CNV_S_10_RANGE_REQ__21 /end COMPU_METHOD
/begin COMPU_VTAB _CNV_S_10_RANGE_REQ__21 "" TAB_VERB 10 0 "Hard_off" 1 "Soft_off" 2 "TIP up" 3 "TIP Down " 4 "Set / Accelerate" 5 "Resume" 6 "Decelerate" 7 "None" 8 "Mark up" 9 "Mark down" /end COMPU_VTAB
/begin COMPU_METHOD _CNV_A_R_LINEAR_____23_CM "" RAT_FUNC "%6.3" "ms" COEFFS 0 5.e-002 0. 0 0 1 /end COMPU_METHOD
/begin COMPU_METHOD _CNV_A_R_LINEAR_____28_CM "" RAT_FUNC "%6.3" "-" COEFFS 0 256. 0. 0 0 1 /end COMPU_METHOD
/begin COMPU_METHOD _CNV_A_R_LINEAR_____36_CM "" RAT_FUNC "%6.3" "s" COEFFS 0 1. 0. 0 0 1 /end COMPU_METHOD
/begin COMPU_METHOD _CNV_A_R_LINEAR_____50_CM "" RAT_FUNC "%6.3" "" COEFFS 0 1. 0. 0 0 1 /end COMPU_METHOD
/begin COMPU_METHOD _CNV_A_R_LINEAR_____86_CM "" RAT_FUNC "%6.3" "km/h" COEFFS 0 128.0000018750286 0. 0 0 1 /end COMPU_METHOD
/begin COMPU_METHOD _CNV_A_R_LINEAR_____88_CM "" RAT_FUNC "%6.3" "m/s²" COEFFS 0 2084.478388984895 2.74784179055132e-004 0 0 1 /end COMPU_METHOD
/begin COMPU_METHOD _CNV_A_R_LINEAR_____89_CM "" RAT_FUNC "%6.3" "-" COEFFS 0 65535.99999999996 0. 0 0 1 /end COMPU_METHOD
/begin COMPU_METHOD _CNV_A_R_LINEAR_____90_CM "" RAT_FUNC "%6.3" "rpm/(km/h)" COEFFS 0 0.5 0. 0 0 1 /end COMPU_METHOD
/begin COMPU_METHOD _CNV_A_R_LINEAR_____91_CM "" RAT_FUNC "%6.3" "km/h" COEFFS 0 65535.99999999996 0. 0 0 1 /end COMPU_METHOD
/begin COMPU_METHOD _CNV_A_R_LINEAR_____92_CM "" RAT_FUNC "%6.3" "ms" COEFFS 0 1. 0. 0 0 1 /end COMPU_METHOD
/begin COMPU_METHOD _CNV_A_R_LINEAR_____93_CM "" RAT_FUNC "%6.3" "km/h" COEFFS 0 128. 0. 0 0 1 /end COMPU_METHOD
/begin COMPU_METHOD _CNV_S_8_RANGE_REQ__94_CM "" TAB_VERB "%6.3" "" COMPU_TAB_REF _CNV_S_8_RANGE_REQ__94 /end COMPU_METHOD
/begin COMPU_VTAB _CNV_S_8_RANGE_REQ__94 "" TAB_VERB 8 0 "Hard_off" 1 "Soft_off" 2 "TIP up" 3 "TIP Down " 4 "Set / Accelerate" 5 "Resume" 6 "Decelerate" 7 "None" /end COMPU_VTAB
/begin COMPU_METHOD _CNV_A_R_LINEAR_____95_CM "" RAT_FUNC "%6.3" "m/s²" COEFFS 0 2084.478406465338 0. 0 0 1 /end COMPU_METHOD
/begin COMPU_METHOD _CNV_S_8_RANGE_STAT_96_CM "" TAB_VERB "%6.3" "" COMPU_TAB_REF _CNV_S_8_RANGE_STAT_96 /end COMPU_METHOD
/begin COMPU_VTAB _CNV_S_8_RANGE_STAT_96 "" TAB_VERB 8 0 "PASSIVE" 1 "CONST/TIP " 2 "-" 3 "RES" 4 "-" 5 "SET_ACC" 6 "-" 7 "DEC" /end COMPU_VTAB
/begin COMPU_METHOD _CNV_A_R_LINEAR_____97_CM "" RAT_FUNC "%6.3" "km/h" COEFFS 0 128.0039001188318 0. 0 0 1 /end COMPU_METHOD
/begin COMPU_METHOD _CNV_A_R_LINEAR_____98_CM "" RAT_FUNC "%6.3" "km/h" COEFFS 0 8. 0. 0 0 1 /end COMPU_METHOD
/begin COMPU_METHOD _CNV_A_R_LINEAR_____99_CM "" RAT_FUNC "%6.3" "m/s²" COEFFS 0 46.08002400098911 0. 0 0 1 /end COMPU_METHOD
/begin COMPU_METHOD _CNV_A_R_LINEAR_____100_CM "" RAT_FUNC "%6.3" "-" COEFFS 0 127.9991955827809 0. 0 0 1 /end COMPU_METHOD
/begin COMPU_METHOD _CNV_A_R_LINEAR_____101_CM "" RAT_FUNC "%6.3" "km/h" COEFFS 0 128. 32768. 0 0 1 /end COMPU_METHOD
/begin COMPU_METHOD _CNV_S_6_RANGE_STAT_102_CM "" TAB_VERB "%6.3" "" COMPU_TAB_REF _CNV_S_6_RANGE_STAT_102 /end COMPU_METHOD
/begin COMPU_VTAB _CNV_S_6_RANGE_STAT_102 "" TAB_VERB 6 0 "PASSIVE" 1 "CONST_DRIVE" 3 "RESUME" 5 "SET_ACC" 7 "RETARD" 9 "TIP" /end COMPU_VTAB
/begin COMPU_METHOD _CNV_A_R_LINEAR_____103_CM "" RAT_FUNC "%6.3" "-" COEFFS 0 128. 0. 0 0 1 /end COMPU_METHOD
/begin COMPU_METHOD _CNV_A_R_LINEAR_____104_CM "" RAT_FUNC "%6.3" "%/(km/h)" COEFFS 0 1310.720001587224 0. 0 0 1 /end COMPU_METHOD
/begin COMPU_METHOD _CNV_A_R_LINEAR_____105_CM "" RAT_FUNC "%6.3" "%/(m/s²)" COEFFS 0 163.8375 32767.5 0 0 1 /end COMPU_METHOD
/begin COMPU_METHOD _CNV_A_R_LINEAR_____106_CM "" RAT_FUNC "%6.3" "%" COEFFS 0 2084.478388983038 32768.00027481336 0 0 1 /end COMPU_METHOD
/begin COMPU_METHOD _CNV_A_R_LINEAR_____107_CM "" RAT_FUNC "%6.3" "km/h" COEFFS 0 4. 0. 0 0 1 /end COMPU_METHOD
/begin COMPU_METHOD _CNV_A_R_LINEAR_____108_CM "" RAT_FUNC "%6.3" "%/100ms" COEFFS 0 655.3599999999997 0. 0 0 1 /end COMPU_METHOD
/begin COMPU_METHOD _CNV_S_4_STATE_I_CR_109_CM "" TAB_VERB "%6.3" "" COMPU_TAB_REF _CNV_S_4_STATE_I_CR_109 /end COMPU_METHOD
/begin COMPU_VTAB _CNV_S_4_STATE_I_CR_109 "" TAB_VERB 4 0 "NO" 1 "LIM" 2 "FREEZE" 3 "NORM" /end COMPU_VTAB
/begin COMPU_METHOD _CNV_A_R_LINEAR_____110_CM "" RAT_FUNC "%6.3" "s" COEFFS 0 50. 0. 0 0 1 /end COMPU_METHOD
/begin COMPU_METHOD _CNV_A_R_LINEAR_____188_CM "" RAT_FUNC "%6.3" "°CRK" COEFFS 0 16. 0. 0 0 1 /end COMPU_METHOD
/begin COMPU_METHOD _CNV_A_R_LINEAR_____189_CM "" RAT_FUNC "%6.3" "°CRK" COEFFS 0 -16. 0. 0 0 1 /end COMPU_METHOD
/begin COMPU_METHOD _CNV_A_R_LINEAR_____193_CM "" RAT_FUNC "%6.3" "rpm" COEFFS 0 1. 32768. 0 0 1 /end COMPU_METHOD
/begin COMPU_METHOD _CNV_S_8_RANGE_STAT_246_CM "" TAB_VERB "%6.3" "" COMPU_TAB_REF _CNV_S_8_RANGE_STAT_246 /end COMPU_METHOD
/begin COMPU_VTAB _CNV_S_8_RANGE_STAT_246 "" TAB_VERB 8 0 "None" 1 "Set-Acc-TipUp" 2 "Decelerate-TipDown" 3 "Resume" 4 "Off" 5 "-" 6 "-" 7 "Error" /end COMPU_VTAB
/begin COMPU_METHOD _CNV_S_2_RANGE_VIM__267_CM "" TAB_VERB "%6.3" "" COMPU_TAB_REF _CNV_S_2_RANGE_VIM__267 /end COMPU_METHOD
/begin COMPU_VTAB _CNV_S_2_RANGE_VIM__267 "" TAB_VERB 2 0 "closed loop" 1 "switched" /end COMPU_VTAB
/begin COMPU_METHOD _CNV_S_9_RANGE_STAT_268_CM "" TAB_VERB "%6.3" "" COMPU_TAB_REF _CNV_S_9_RANGE_STAT_268 /end COMPU_METHOD
/begin COMPU_VTAB _CNV_S_9_RANGE_STAT_268 "" TAB_VERB 9 0 "ROM_NOT_PLAUS" 4369 "LEARNING_FAILED" 23130 "LOT1" 42405 "LOT2" 44718 "LOT4" 48316 "SERIAL ECU" 52171 "LOT6" 60138 "LOT3" 65535 "NOT LEARNED" /end COMPU_VTAB
/begin COMPU_METHOD _CNV_S_3_STATE_CONF_269_CM "" TAB_VERB "%6.3" "-" COMPU_TAB_REF _CNV_S_3_STATE_CONF_269 /end COMPU_METHOD
/begin COMPU_VTAB _CNV_S_3_STATE_CONF_269 "" TAB_VERB 3 0 "NO_SOF_SWI" 1 "SOF_SWI" 2 "SOF_SWI_AMT" /end COMPU_VTAB
/begin COMPU_METHOD _CNV_S_4_RANGE_VAR__270_CM "" TAB_VERB "%6.3" "" COMPU_TAB_REF _CNV_S_4_RANGE_VAR__270 /end COMPU_METHOD
/begin COMPU_VTAB _CNV_S_4_RANGE_VAR__270 "" TAB_VERB 4 0 "E60" 1 "E65" 2 "PL2" 3 "E83/E85" /end COMPU_VTAB
/begin COMPU_METHOD _CNV_S_3_RANGE_CAM__271_CM "" TAB_VERB "%6.3" "" COMPU_TAB_REF _CNV_S_3_RANGE_CAM__271 /end COMPU_METHOD
/begin COMPU_VTAB _CNV_S_3_RANGE_CAM__271 "" TAB_VERB 3 0 "3 SEG" 1 "4 SEG SYM" 2 "4 SEG ASYM" /end COMPU_VTAB
/begin COMPU_METHOD _CNV_A_R_LINEAR_____402_CM "" RAT_FUNC "%6.3" "%" COEFFS 0 0.32 0. 0 0 1 /end COMPU_METHOD
/begin COMPU_METHOD _CNV_A_R_LINEAR_____405_CM "" RAT_FUNC "%6.3" "°C" COEFFS 0 0.125 4. 0 0 1 /end COMPU_METHOD
/begin RECORD_LAYOUT _REC_VAL_20_u1 FNC_VALUES 1 UBYTE COLUMN_DIR DIRECT /end RECORD_LAYOUT
/begin RECORD_LAYOUT _REC_VAL_20_u2 FNC_VALUES 1 UWORD COLUMN_DIR DIRECT /end RECORD_LAYOUT
/begin RECORD_LAYOUT _REC_AXS_20_u1 NO_AXIS_PTS_X 1 UBYTE AXIS_PTS_X 2 UBYTE INDEX_INCR DIRECT /end RECORD_LAYOUT
/begin RECORD_LAYOUT _REC_CUR_20_u1_u1 FNC_VALUES 1 UBYTE COLUMN_DIR DIRECT /end RECORD_LAYOUT
/begin RECORD_LAYOUT _REC_VAL_20_s2 FNC_VALUES 1 SWORD COLUMN_DIR DIRECT /end RECORD_LAYOUT
/begin RECORD_LAYOUT _REC_MAP_20_u2_u2_u1 FNC_VALUES 1 UWORD COLUMN_DIR DIRECT /end RECORD_LAYOUT
/begin RECORD_LAYOUT _REC_AXS_20_u2 NO_AXIS_PTS_X 1 UWORD AXIS_PTS_X 2 UWORD INDEX_INCR DIRECT /end RECORD_LAYOUT
/begin RECORD_LAYOUT _REC_CUR_20_u2_u1 FNC_VALUES 1 UWORD COLUMN_DIR DIRECT /end RECORD_LAYOUT
/begin RECORD_LAYOUT _REC_CUR_20_u2_u2 FNC_VALUES 1 UWORD COLUMN_DIR DIRECT /end RECORD_LAYOUT
/begin RECORD_LAYOUT _REC_CUR_20_u1_u2 FNC_VALUES 1 UBYTE COLUMN_DIR DIRECT /end RECORD_LAYOUT
/begin RECORD_LAYOUT _REC_MAP_20_u2_u2_u2 FNC_VALUES 1 UWORD COLUMN_DIR DIRECT /end RECORD_LAYOUT
/begin RECORD_LAYOUT _REC_MAP_20_u2_u1_u2 FNC_VALUES 1 UWORD COLUMN_DIR DIRECT /end RECORD_LAYOUT
/begin RECORD_LAYOUT _REC_VAL_3_u1 FNC_VALUES 1 UBYTE COLUMN_DIR DIRECT /end RECORD_LAYOUT
/begin FUNCTION AUX_Alternator_profile "_Alternator profile"
 /begin DEF_CHARACTERISTIC ldp_n_alter ldp_pow_rel_alter ldp_temp_alter_mc id_state_temp_alter id_state_load_alter id_state_n_alter /end DEF_CHARACTERISTIC
 /begin OUT_MEASUREMENT lv_state_tbl_alter_inh t_state_tbl_alter_dc t_state_tbl_alter state_tbl_alter[0][0][0] state_tbl_alter[0][0][1] state_tbl_alter[0][0][2] state_tbl_alter[0][0][3] state_tbl_alter[0][0][4] state_tbl_alter[0][1][0] state_tbl_alter[0][1][1] state_tbl_alter[0][1][2] state_tbl_alter[0][1][3] state_tbl_alter[0][1][4] state_tbl_alter[0][2][0] state_tbl_alter[0][2][1] state_tbl_alter[0][2][2] state_tbl_alter[0][2][3] state_tbl_alter[0][2][4] state_tbl_alter[0][3][0] state_tbl_alter[0][3][1] state_tbl_alter[0][3][2] state_tbl_alter[0][3][3] state_tbl_alter[0][3][4] state_tbl_alter[0][4][0] state_tbl_alter[0][4][1] state_tbl_alter[0][4][2] state_tbl_alter[0][4][3] state_tbl_alter[0][4][4] state_tbl_alter[1][0][0] state_tbl_alter[1][0][1] state_tbl_alter[1][0][2] state_tbl_alter[1][0][3] state_tbl_alter[1][0][4] state_tbl_alter[1][1][0] state_tbl_alter[1][1][1] state_tbl_alter[1][1][2] state_tbl_alter[1][1][3] state_tbl_alter[1][1][4] state_tbl_alter[1][2][0] state_tbl_alter[1][2][1] state_tbl_alter[1][2][2] state_tbl_alter[1][2][3] state_tbl_alter[1][2][4] state_tbl_alter[1][3][0] state_tbl_alter[1][3][1] state_tbl_alter[1][3][2] state_tbl_alter[1][3][3] state_tbl_alter[1][3][4] state_tbl_alter[1][4][0] state_tbl_alter[1][4][1] state_tbl_alter[1][4][2] state_tbl_alter[1][4][3] state_tbl_alter[1][4][4] state_tbl_alter[2][0][0] state_tbl_alter[2][0][1] state_tbl_alter[2][0][2] state_tbl_alter[2][0][3] state_tbl_alter[2][0][4] state_tbl_alter[2][1][0] state_tbl_alter[2][1][1] state_tbl_alter[2][1][2] state_tbl_alter[2][1][3] state_tbl_alter[2][1][4] state_tbl_alter[2][2][0] state_tbl_alter[2][2][1] state_tbl_alter[2][2][2] state_tbl_alter[2][2][3] state_tbl_alter[2][2][4] state_tbl_alter[2][3][0] state_tbl_alter[2][3][1] state_tbl_alter[2][3][2] state_tbl_alter[2][3][3] state_tbl_alter[2][3][4] state_tbl_alter[2][4][0] state_tbl_alter[2][4][1] state_tbl_alter[2][4][2] state_tbl_alter[2][4][3] state_tbl_alter[2][4][4] state_tbl_alter[3][0][0] state_tbl_alter[3][0][1] state_tbl_alter[3][0][2] state_tbl_alter[3][0][3] state_tbl_alter[3][0][4] state_tbl_alter[3][1][0] state_tbl_alter[3][1][1] state_tbl_alter[3][1][2] state_tbl_alter[3][1][3] state_tbl_alter[3][1][4] state_tbl_alter[3][2][0] state_tbl_alter[3][2][1] state_tbl_alter[3][2][2] state_tbl_alter[3][2][3] state_tbl_alter[3][2][4] state_tbl_alter[3][3][0] state_tbl_alter[3][3][1] state_tbl_alter[3][3][2] state_tbl_alter[3][3][3] state_tbl_alter[3][3][4] state_tbl_alter[3][4][0] state_tbl_alter[3][4][1] state_tbl_alter[3][4][2] state_tbl_alter[3][4][3] state_tbl_alter[3][4][4] state_tbl_alter[4][0][0] state_tbl_alter[4][0][1] state_tbl_alter[4][0][2] state_tbl_alter[4][0][3] state_tbl_alter[4][0][4] state_tbl_alter[4][1][0] state_tbl_alter[4][1][1] state_tbl_alter[4][1][2] state_tbl_alter[4][1][3] state_tbl_alter[4][1][4] state_tbl_alter[4][2][0] state_tbl_alter[4][2][1] state_tbl_alter[4][2][2] state_tbl_alter[4][2][3] state_tbl_alter[4][2][4] state_tbl_alter[4][3][0] state_tbl_alter[4][3][1] state_tbl_alter[4][3][2] state_tbl_alter[4][3][3] state_tbl_alter[4][3][4] state_tbl_alter[4][4][0] state_tbl_alter[4][4][1] state_tbl_alter[4][4][2] state_tbl_alter[4][4][3] state_tbl_alter[4][4][4] state_tbl_alter[5][0][0] state_tbl_alter[5][0][1] state_tbl_alter[5][0][2] state_tbl_alter[5][0][3] state_tbl_alter[5][0][4] state_tbl_alter[5][1][0] state_tbl_alter[5][1][1] state_tbl_alter[5][1][2] state_tbl_alter[5][1][3] state_tbl_alter[5][1][4] state_tbl_alter[5][2][0] state_tbl_alter[5][2][1] state_tbl_alter[5][2][2] state_tbl_alter[5][2][3] state_tbl_alter[5][2][4] state_tbl_alter[5][3][0] state_tbl_alter[5][3][1] state_tbl_alter[5][3][2] state_tbl_alter[5][3][3] state_tbl_alter[5][3][4] state_tbl_alter[5][4][0] state_tbl_alter[5][4][1] state_tbl_alter[5][4][2] state_tbl_alter[5][4][3] state_tbl_alter[5][4][4] state_tbl_alter[6][0][0] state_tbl_alter[6][0][1] state_tbl_alter[6][0][2] state_tbl_alter[6][0][3] state_tbl_alter[6][0][4] state_tbl_alter[6][1][0] state_tbl_alter[6][1][1] state_tbl_alter[6][1][2] state_tbl_alter[6][1][3] state_tbl_alter[6][1][4] state_tbl_alter[6][2][0] state_tbl_alter[6][2][1] state_tbl_alter[6][2][2] state_tbl_alter[6][2][3] state_tbl_alter[6][2][4] state_tbl_alter[6][3][0] state_tbl_alter[6][3][1] state_tbl_alter[6][3][2] state_tbl_alter[6][3][3] state_tbl_alter[6][3][4] state_tbl_alter[6][4][0] state_tbl_alter[6][4][1] state_tbl_alter[6][4][2] state_tbl_alter[6][4][3] state_tbl_alter[6][4][4] state_tbl_alter_dc[0][0][0] state_tbl_alter_dc[0][0][1] state_tbl_alter_dc[0][0][2] state_tbl_alter_dc[0][0][3] state_tbl_alter_dc[0][0][4] state_tbl_alter_dc[0][1][0] state_tbl_alter_dc[0][1][1] state_tbl_alter_dc[0][1][2] state_tbl_alter_dc[0][1][3] state_tbl_alter_dc[0][1][4] state_tbl_alter_dc[0][2][0] state_tbl_alter_dc[0][2][1] state_tbl_alter_dc[0][2][2] state_tbl_alter_dc[0][2][3] state_tbl_alter_dc[0][2][4] state_tbl_alter_dc[0][3][0] state_tbl_alter_dc[0][3][1] state_tbl_alter_dc[0][3][2] state_tbl_alter_dc[0][3][3] state_tbl_alter_dc[0][3][4] state_tbl_alter_dc[0][4][0] state_tbl_alter_dc[0][4][1] state_tbl_alter_dc[0][4][2] state_tbl_alter_dc[0][4][3] state_tbl_alter_dc[0][4][4] state_tbl_alter_dc[1][0][0] state_tbl_alter_dc[1][0][1] state_tbl_alter_dc[1][0][2] state_tbl_alter_dc[1][0][3] state_tbl_alter_dc[1][0][4] state_tbl_alter_dc[1][1][0] state_tbl_alter_dc[1][1][1] state_tbl_alter_dc[1][1][2] state_tbl_alter_dc[1][1][3] state_tbl_alter_dc[1][1][4] state_tbl_alter_dc[1][2][0] state_tbl_alter_dc[1][2][1] state_tbl_alter_dc[1][2][2] state_tbl_alter_dc[1][2][3] state_tbl_alter_dc[1][2][4] state_tbl_alter_dc[1][3][0] state_tbl_alter_dc[1][3][1] state_tbl_alter_dc[1][3][2] state_tbl_alter_dc[1][3][3] state_tbl_alter_dc[1][3][4] state_tbl_alter_dc[1][4][0] state_tbl_alter_dc[1][4][1] state_tbl_alter_dc[1][4][2] state_tbl_alter_dc[1][4][3] state_tbl_alter_dc[1][4][4] state_tbl_alter_dc[2][0][0] state_tbl_alter_dc[2][0][1] state_tbl_alter_dc[2][0][2] state_tbl_alter_dc[2][0][3] state_tbl_alter_dc[2][0][4] state_tbl_alter_dc[2][1][0] state_tbl_alter_dc[2][1][1] state_tbl_alter_dc[2][1][2] state_tbl_alter_dc[2][1][3] state_tbl_alter_dc[2][1][4] state_tbl_alter_dc[2][2][0] state_tbl_alter_dc[2][2][1] state_tbl_alter_dc[2][2][2] state_tbl_alter_dc[2][2][3] state_tbl_alter_dc[2][2][4] state_tbl_alter_dc[2][3][0] state_tbl_alter_dc[2][3][1] state_tbl_alter_dc[2][3][2] state_tbl_alter_dc[2][3][3] state_tbl_alter_dc[2][3][4] state_tbl_alter_dc[2][4][0] state_tbl_alter_dc[2][4][1] state_tbl_alter_dc[2][4][2] state_tbl_alter_dc[2][4][3] state_tbl_alter_dc[2][4][4] state_tbl_alter_dc[3][0][0] state_tbl_alter_dc[3][0][1] state_tbl_alter_dc[3][0][2] state_tbl_alter_dc[3][0][3] state_tbl_alter_dc[3][0][4] state_tbl_alter_dc[3][1][0] state_tbl_alter_dc[3][1][1] state_tbl_alter_dc[3][1][2] state_tbl_alter_dc[3][1][3] state_tbl_alter_dc[3][1][4] state_tbl_alter_dc[3][2][0] state_tbl_alter_dc[3][2][1] state_tbl_alter_dc[3][2][2] state_tbl_alter_dc[3][2][3] state_tbl_alter_dc[3][2][4] state_tbl_alter_dc[3][3][0] state_tbl_alter_dc[3][3][1] state_tbl_alter_dc[3][3][2] state_tbl_alter_dc[3][3][3] state_tbl_alter_dc[3][3][4] state_tbl_alter_dc[3][4][0] state_tbl_alter_dc[3][4][1] state_tbl_alter_dc[3][4][2] state_tbl_alter_dc[3][4][3] state_tbl_alter_dc[3][4][4] state_tbl_alter_dc[4][0][0] state_tbl_alter_dc[4][0][1] state_tbl_alter_dc[4][0][2] state_tbl_alter_dc[4][0][3] state_tbl_alter_dc[4][0][4] state_tbl_alter_dc[4][1][0] state_tbl_alter_dc[4][1][1] state_tbl_alter_dc[4][1][2] state_tbl_alter_dc[4][1][3] state_tbl_alter_dc[4][1][4] state_tbl_alter_dc[4][2][0] state_tbl_alter_dc[4][2][1] state_tbl_alter_dc[4][2][2] state_tbl_alter_dc[4][2][3] state_tbl_alter_dc[4][2][4] state_tbl_alter_dc[4][3][0] state_tbl_alter_dc[4][3][1] state_tbl_alter_dc[4][3][2] state_tbl_alter_dc[4][3][3] state_tbl_alter_dc[4][3][4] state_tbl_alter_dc[4][4][0] state_tbl_alter_dc[4][4][1] state_tbl_alter_dc[4][4][2] state_tbl_alter_dc[4][4][3] state_tbl_alter_dc[4][4][4] state_tbl_alter_dc[5][0][0] state_tbl_alter_dc[5][0][1] state_tbl_alter_dc[5][0][2] state_tbl_alter_dc[5][0][3] state_tbl_alter_dc[5][0][4] state_tbl_alter_dc[5][1][0] state_tbl_alter_dc[5][1][1] state_tbl_alter_dc[5][1][2] state_tbl_alter_dc[5][1][3] state_tbl_alter_dc[5][1][4] state_tbl_alter_dc[5][2][0] state_tbl_alter_dc[5][2][1] state_tbl_alter_dc[5][2][2] state_tbl_alter_dc[5][2][3] state_tbl_alter_dc[5][2][4] state_tbl_alter_dc[5][3][0] state_tbl_alter_dc[5][3][1] state_tbl_alter_dc[5][3][2] state_tbl_alter_dc[5][3][3] state_tbl_alter_dc[5][3][4] state_tbl_alter_dc[5][4][0] state_tbl_alter_dc[5][4][1] state_tbl_alter_dc[5][4][2] state_tbl_alter_dc[5][4][3] state_tbl_alter_dc[5][4][4] state_tbl_alter_dc[6][0][0] state_tbl_alter_dc[6][0][1] state_tbl_alter_dc[6][0][2] state_tbl_alter_dc[6][0][3] state_tbl_alter_dc[6][0][4] state_tbl_alter_dc[6][1][0] state_tbl_alter_dc[6][1][1] state_tbl_alter_dc[6][1][2] state_tbl_alter_dc[6][1][3] state_tbl_alter_dc[6][1][4] state_tbl_alter_dc[6][2][0] state_tbl_alter_dc[6][2][1] state_tbl_alter_dc[6][2][2] state_tbl_alter_dc[6][2][3] state_tbl_alter_dc[6][2][4] state_tbl_alter_dc[6][3][0] state_tbl_alter_dc[6][3][1] state_tbl_alter_dc[6][3][2] state_tbl_alter_dc[6][3][3] state_tbl_alter_dc[6][3][4] state_tbl_alter_dc[6][4][0] state_tbl_alter_dc[6][4][1] state_tbl_alter_dc[6][4][2] state_tbl_alter_dc[6][4][3] state_tbl_alter_dc[6][4][4] /end OUT_MEASUREMENT
/end FUNCTION
/begin FUNCTION C_G_CRU "C_G_CRU"
 /begin SUB_FUNCTION CRU_General__calculation_of_cruise_control_and_constant_drive CRU_Controlled_acceleration CRU_Actuating_the_reference_input_variable CRU_Intercepting_the_reference_input_variable_target_acceleration CRU_Interventions CRU_Ready_state_and_display CRU_Evaluation_serial_data_line_from_the_MSW CRU_Conditions_for_cruise_control CRU_Additional_functions CRU_Step_cruise_control /end SUB_FUNCTION
/end FUNCTION
/begin FUNCTION CRU_General__calculation_of_cruise_control_and_constant_drive "_General  calculation of cruise control and constant drive"
 /begin DEF_CHARACTERISTIC c_vs_dif_min_is_cru c_vs_dif_max_is_cru c_vs_dif_rng_cru c_t_min_puc_cru ip_fac_prop_cru ip_fac_tq_cru_ini_add_at ip_fac_tq_cru_ini_add_mt c_fac_vs_dif_rng_cru ip_fac_tq_cru_dec__n_32 ip_fac_vs_dif_i_cru ip_fac_vs_sp_dif_i_cru c_fac_tq_cru_max c_fac_tq_cru_lgrd c_fac_tq_cru_ofs /end DEF_CHARACTERISTIC
 /begin OUT_MEASUREMENT vs_dif_i_cru vs_dif_cru fac_tq_cru_ini fac_tq_cru state_i_cru /end OUT_MEASUREMENT
/end FUNCTION
/begin FUNCTION CRU_Controlled_acceleration "_Controlled acceleration" /begin DEF_CHARACTERISTIC c_vs_dif_max_ac_cru c_vs_dif_min_ac_cru /end DEF_CHARACTERISTIC /begin OUT_MEASUREMENT t_ctl_cru vs_sp_cru vs_sp_dif_cru /end OUT_MEASUREMENT /end FUNCTION
/begin FUNCTION CRU_Actuating_the_reference_input_variable "_Actuating the reference input variable"
 /begin DEF_CHARACTERISTIC ip_fac_cru_rest__t_ctl_cru ip_fac_cru_ac__t_ctl_cru ip_fac_cru_dece__t_ctl_cru ip_fac_cc_cru_ac__t_ctl_cru ip_fac_cc_cru_dece__t_ctl_cru /end DEF_CHARACTERISTIC
 /begin OUT_MEASUREMENT fac_vs_ctl_cru /end OUT_MEASUREMENT
/end FUNCTION
/begin FUNCTION CRU_Intercepting_the_reference_input_variable_target_acceleration "_Intercepting the reference input variable target acceleration"
 /begin DEF_CHARACTERISTIC c_vs_ac_min_cru c_vs_ac_max_cru ip_fac_lgrd_cru_rest__vs_sp_dif ip_fac_lgrd_cru_tip__vs_sp_dif c_fac_ac_pos_cru c_fac_ac_pos_cru_rng_l /end DEF_CHARACTERISTIC
 /begin OUT_MEASUREMENT fac_vs_lgrd_cru /end OUT_MEASUREMENT
/end FUNCTION
/begin FUNCTION CRU_Interventions "_Interventions"
 /begin DEF_CHARACTERISTIC c_vs_dif_max_cru c_ac_pos_cru_tip c_ac_neg_cru_tip c_ac_neg_cru_deacc c_ac_pos_cru_deacc c_t_min_cru_con ip_ac_neg_cru_ac__n__fac_tq_cru c_vs_dif_delta_i c_ac_pos_cru_resu c_ac_pos_cru_resu_rng_l c_ac_pos_cru_ac c_ac_pos_cru_ac_rng_l ip_ac_neg_cru_resu c_vs_sp_cru_max_k c_vs_sp_cru_max_m c_vs_dif_tip_m c_vs_dif_tip_k /end DEF_CHARACTERISTIC
 /begin OUT_MEASUREMENT vs_sp_inc_cru vs_sp_dec_cru vs_sp_driv_cru lv_cru_over_act_ack vs_sp_cru_max /end OUT_MEASUREMENT
/end FUNCTION
/begin FUNCTION CRU_Ready_state_and_display "_Ready state and display"
 /begin DEF_CHARACTERISTIC lc_cru_req_swi c_t_crus_on c_t_ready_cru c_t_crus c_t_crus_off lc_crus_off_swi /end DEF_CHARACTERISTIC
 /begin OUT_MEASUREMENT lv_cru_main_swi /end OUT_MEASUREMENT
/end FUNCTION
/begin FUNCTION CRU_Evaluation_serial_data_line_from_the_MSW "_Evaluation serial data line from the MSW" /begin DEF_CHARACTERISTIC c_t_min_msw c_t_min_tip_msw /end DEF_CHARACTERISTIC /begin OUT_MEASUREMENT req_msw state_msw_can /end OUT_MEASUREMENT /end FUNCTION
/begin FUNCTION CRU_Conditions_for_cruise_control "_Conditions for cruise control"
 /begin DEF_CHARACTERISTIC c_t_cru_esp_off c_t_cru_asr_off c_t_cru_esp_brake_off c_vs_min_plaus_cru c_t_dly_vs_sp_cru_max c_n_vs_max_cru c_ac_max_cru c_vs_min_cru_m c_vs_min_cru_k /end DEF_CHARACTERISTIC
 /begin OUT_MEASUREMENT lv_cru_off_by_asr_esp_ctl req_cru lv_cru_off_irr lv_cru_act state_cru_can state_cru_off_rev state_cru_off_irr vs_min_cru state_cru /end OUT_MEASUREMENT
/end FUNCTION
/begin FUNCTION CRU_Additional_functions "_Additional functions"
 /begin DEF_CHARACTERISTIC c_t_err_vs_can c_fac_vs_fil c_vs_max_diag c_fac_tq_req_driv_mmv c_fac_ac_cru_mmv lc_vs_cru_fil c_crlc_vs_cru_mmv c_t_vs_diag_not_plaus c_t_dly_max_cru c_vs_sp_dif_min_cru c_vs_sp_dif_max_cru c_vs_dif_dly_cru_neg c_fac_tq_req_hys_cru c_vs_dif_dly_cru_pos c_vs_dif_min_cru_over /end DEF_CHARACTERISTIC
 /begin OUT_MEASUREMENT ac_cru lv_vs_diag_not_plaus fac_tq_req_driv_mmv n_vs_cru vs_fil t_err_vs_can vs_cru vs_dif_icl_tcs t_dly_cru lv_cru_over_act lv_cru_act_inh /end OUT_MEASUREMENT
/end FUNCTION
/begin FUNCTION CRU_Step_cruise_control "_Step cruise control"
 /begin DEF_CHARACTERISTIC c_vs_dif_step_prog_m c_vs_dif_step_prog_k c_vs_min_prog c_max_step c_t_cru_flash_light c_t_min_prog c_ctr_cru_flash_light c_t_dly_cru_tip c_t_min_cru_chg c_vs_dif_step_min_hys c_t_prog_step_if_act c_vs_dif_step_min_m c_vs_dif_step_min_k c_vs_dif_tip_prog_m c_vs_dif_tip_prog_k lc_cru_disp_swi /end DEF_CHARACTERISTIC
 /begin OUT_MEASUREMENT nr_step_on count_vs_step vs_dif_step_prog lv_step_on vs_sp_driv_step nr_vs_cru vs_sp_driv_cru_can vs_step_can_1 vs_step_can_2 vs_step_can_3 lv_prog_step_1 lv_prog_step_if_act lv_step_on_icl lv_cru_disp_hud /end OUT_MEASUREMENT
/end FUNCTION
/begin FUNCTION C_1_GEN "C_1_GEN"
 /begin SUB_FUNCTION GEN_Variant_coding GEN_Initialisation_of_variables_from_non_implemented_functions GEN_Dataset_identification /end SUB_FUNCTION
/end FUNCTION
/begin FUNCTION GEN_Variant_coding "_Variant coding"
 /begin DEF_CHARACTERISTIC c_conf_swi_efp_out c_conf_dmtl c_conf_oil_level_sens c_conf_cat c_n_var_dis_misf c_n_var_dis_er c_n_var_dis_inj lc_var_dis_fsd lc_var_dis_obd_cat lc_var_dis_nox lc_var_dis_cru lc_var_dis_tq_loss_ars lc_tcha_conf c_ctr_avl_maf lc_mafm_det_di c_var_veh c_t_det_var_can lc_var_dis_dmtl lc_var_tco_2 lc_var_dis_s_fct c_thd_ctr_t_per_maf_frq_sum lc_var_ebox_cfa /end DEF_CHARACTERISTIC
 /begin OUT_MEASUREMENT lv_var_msw lv_ivvt_in_and_ex lv_inj_conf lv_isa_conf vim_type lv_var_sof lv_cbk_mpl state_lrn_ecu conf_swi_efp_out conf_oil_level_sens lv_var_bn lv_var_bn_efp lv_conf_dmtl lv_var_tco_2 conf_sof_swi lv_var_ecras_up lv_var_ef lv_var_lsh_up lv_var_lsh_down psn_ls psn_ls_1 lv_var_ebox_cfa lv_var_rly_st lv_var_rly_accout var_veh lv_var_bn_gear_rev lv_var_acin lv_var_bn_ltg_hdlp_l cam_type lv_var_tcha lv_var_maf lv_var_veh state_var_det_cus_1 state_var_det_cus_2 lv_var_bn_ldm lv_var_bn_trl lv_var_bn_hiv ctr_avl_maf[0] ctr_avl_maf[1] lv_var_pbr lv_var_l6 lv_var_etcu_3 /end OUT_MEASUREMENT
/end FUNCTION
/begin FUNCTION GEN_Initialisation_of_variables_from_non_implemented_functions "_Initialisation of variables from non implemented functions" /begin OUT_MEASUREMENT lv_mtc_lih_act online_dummy /end OUT_MEASUREMENT /end FUNCTION
/begin FUNCTION GEN_Dataset_identification "_Dataset identification" /begin DEF_CHARACTERISTIC c_data_id_0 c_data_id_1 c_data_id_2 cal_cks_active /end DEF_CHARACTERISTIC /end FUNCTION
/begin FUNCTION C_6_IGA "C_6_IGA"
 /begin SUB_FUNCTION IGA_Ignition_angle_general IGA_Dwell_time_control_open_loop IGA_Ignition_with_multiple_spark IGA_Corrected_basic_ignition_angle IGA_Setpoint_ignition_angle IGA_Minimum_ignition_angle IGA_Basic_ignition_angle_at_start IGA_KnockControl IGA_Ignition_angle_correction_due_to_EGR IGA_Minimum_IGA_limitation_for_exhaust_gas_temperature_protection IGA_Load_dynamics_correction /end SUB_FUNCTION
/end FUNCTION
/begin FUNCTION IGA_Ignition_angle_general "_Ignition angle general" /begin OUT_MEASUREMENT eff_iga_av eff_iga_av_can eff_iga_min_teg eff_iga_bas_cor /end OUT_MEASUREMENT /end FUNCTION
/begin FUNCTION IGA_Dwell_time_control_open_loop "_Dwell time control open loop" /end FUNCTION
/begin FUNCTION IGA_Ignition_with_multiple_spark "_Ignition with multiple spark" /end FUNCTION
/begin FUNCTION IGA_Corrected_basic_ignition_angle "_Corrected basic ignition angle" /end FUNCTION
/begin FUNCTION IGA_Setpoint_ignition_angle "_Setpoint ignition angle" /begin OUT_MEASUREMENT iga_dif_sp_h_rng iga_sp_h_rng iga_sp_can_h_rng /end OUT_MEASUREMENT /end FUNCTION
/begin FUNCTION IGA_Minimum_ignition_angle "_Minimum ignition angle" /end FUNCTION
/begin FUNCTION IGA_Basic_ignition_angle_at_start "_Basic ignition angle at start" /end FUNCTION
/end MODULE
/end PROJECT
