ASAP2_VERSION 1 31
/begin PROJECT MS45 "BMW Motorsteuerung R6"
/begin HEADER "_default_HeaderComment" PROJECT_NO _57 /end HEADER
/begin MODULE _default_ModuleName "_default_ModuleLongIdentifier"
/begin MOD_COMMON "_default_ModCommonComment" DEPOSIT ABSOLUTE BYTE_ORDER MSB_FIRST ALIGNMENT_BYTE 1 ALIGNMENT_WORD 2 ALIGNMENT_LONG 4 ALIGNMENT_FLOAT32_IEEE 4 ALIGNMENT_FLOAT64_IEEE 8 /end MOD_COMMON
/begin MEASUREMENT lv_state_rr "Boolean for state of rough road detection (No : Yes)." UBYTE _CNV_S_2_RANGE______2_CM 1 100. 0. 1. DISPLAY_IDENTIFIER LV_STATE_RR ECU_ADDRESS 0x3fea4e /end MEASUREMENT
/begin MEASUREMENT seg_t_mes_0_rr "Actual segment time measurement from the wheel speed signal." ULONG _CNV_A_R_LINEAR_____35_CM 1 100. 0. 4294967288. DISPLAY_IDENTIFIER SEG_T_MES_0_RR ECU_ADDRESS 0x3fd010 BYTE_ORDER MSB_LAST FORMAT "%10.0" /end MEASUREMENT
/begin MEASUREMENT seg_t_mes_1_rr "Previous segment time measurement from the wheel speed signal." ULONG _CNV_A_R_LINEAR_____35_CM 1 100. 0. 4294967288. DISPLAY_IDENTIFIER SEG_T_MES_1_RR ECU_ADDRESS 0x3fd014 BYTE_ORDER MSB_LAST FORMAT "%10.0" /end MEASUREMENT
/begin MEASUREMENT wheel_grd_mmv "Rough road value." UWORD _CNV_A_R_LINEAR_____36_CM 1 100. 0. 999.985 DISPLAY_IDENTIFIER WHEEL_GRD_MMV ECU_ADDRESS 0x3fdbec BYTE_ORDER MSB_LAST FORMAT "%6.2" /end MEASUREMENT
/begin MEASUREMENT wheel_grd_mmv_thd "Threshold for rough road value" UWORD _CNV_A_R_LINEAR_____36_CM 1 100. 0. 999.985 DISPLAY_IDENTIFIER WHEEL_GRD_MMV_THD ECU_ADDRESS 0x3fdbee BYTE_ORDER MSB_LAST FORMAT "%6.2" /end MEASUREMENT
/begin MEASUREMENT sum_rr "Counter of rough road detection events." UWORD _CNV_A_R_LINEAR_____0_CM 1 100. 0. 65535. DISPLAY_IDENTIFIER SUM_RR ECU_ADDRESS 0x3fdbf0 BYTE_ORDER MSB_LAST FORMAT "%5.0" /end MEASUREMENT
/begin CHARACTERISTIC c_vs_min_rr "Minimum vehicle speed for rough road detection." VALUE 0xffe409e7 _REC_VAL_20_u1 255. _CNV_A_R_LINEAR_____0_CM 0. 255. DISPLAY_IDENTIFIER C_VS_MIN_RR FORMAT "%3.0" /end CHARACTERISTIC
/begin CHARACTERISTIC c_vs_max_rr "Maximum vehicle speed for rough road detection." VALUE 0xffe409de _REC_VAL_20_u1 254. _CNV_A_R_LINEAR_____0_CM 1. 255. DISPLAY_IDENTIFIER C_VS_MAX_RR FORMAT "%3.0" /end CHARACTERISTIC
/begin CHARACTERISTIC c_wheel_grd_crlc_rr "Correlation factor for floating averaging of the rough road raw values" VALUE 0xffe41bbc _REC_VAL_20_u2 0.99998474 _CNV_A_R_LINEAR_____37_CM 0. 0.99998474 DISPLAY_IDENTIFIER C_WHEEL_GRD_CRLC_RR FORMAT "%7.5" /end CHARACTERISTIC
/begin CHARACTERISTIC c_dly_er_rr "Fade out time for engine roughness after rough road detection" VALUE 0xffe415be _REC_VAL_20_u2 655350. _CNV_A_R_LINEAR_____31_CM 0. 655350. DISPLAY_IDENTIFIER C_DLY_ER_RR FORMAT "%6.0" /end CHARACTERISTIC
/begin CHARACTERISTIC ip_wheel_grd_mmv_thd_at__vs "Threshold versus vehicle speed for rough road detection, automatic tzransmission" CURVE 0xffe508f6 _REC_CUR_20_u2_u1 255. _CNV_A_R_LINEAR_____38_CM 0. 255. DISPLAY_IDENTIFIER IP_WHEEL_GRD_MMV_THD_AT__VS FORMAT "%6.2"
 /begin AXIS_DESCR COM_AXIS vs _CNV_A_R_LINEAR_____23_CM 9 0. 255. FORMAT "%3.0" AXIS_PTS_REF ldpm_vs_wheel_grd_mmv_thd /end AXIS_DESCR
/end CHARACTERISTIC
/begin CHARACTERISTIC ip_wheel_grd_mmv_thd_mt__vs "Threshold versus vehicle speed for rough road detection, manual transmission" CURVE 0xffe50908 _REC_CUR_20_u2_u1 255. _CNV_A_R_LINEAR_____38_CM 0. 255. DISPLAY_IDENTIFIER IP_WHEEL_GRD_MMV_THD_MT__VS FORMAT "%6.2"
 /begin AXIS_DESCR COM_AXIS vs _CNV_A_R_LINEAR_____23_CM 9 0. 255. FORMAT "%3.0" AXIS_PTS_REF ldpm_vs_wheel_grd_mmv_thd /end AXIS_DESCR
/end CHARACTERISTIC
/begin AXIS_PTS ldpm_vs_wheel_grd_mmv_thd "" 0xffe48729 vs _REC_AXS_20_u1 255. _CNV_A_R_LINEAR_____23_CM 9 0. 255. DISPLAY_IDENTIFIER LDPM_VS_WHEEL_GRD_MMV_THD FORMAT "%3.0" /end AXIS_PTS
/begin CHARACTERISTIC c_obd_state_1 "" VALUE 0xffe4081a _REC_VAL_20_u1 7. _CNV_A_R_LINEAR_____0_CM 0. 7. DISPLAY_IDENTIFIER C_OBD_STATE_1 FORMAT "%2.0" /end CHARACTERISTIC
/begin CHARACTERISTIC c_obd_state_2 "" VALUE 0xffe4081b _REC_VAL_20_u1 255. _CNV_A_R_LINEAR_____0_CM 0. 255. DISPLAY_IDENTIFIER C_OBD_STATE_2 FORMAT "%3.0" /end CHARACTERISTIC
/begin CHARACTERISTIC lc_clr_fmy "Boolean to clear failure memory when set to 1" VALUE 0xffe40f3f _REC_VAL_20_u1 1. _CNV_A_R_LINEAR_____0_CM 0. 1. DISPLAY_IDENTIFIER LC_CLR_FMY FORMAT "%2.0" /end CHARACTERISTIC
/begin MEASUREMENT ctr_err_dyn_nr "" UBYTE _CNV_A_R_LINEAR_____0_CM 1 100. 0. 255. DISPLAY_IDENTIFIER CTR_ERR_DYN_NR ECU_ADDRESS 0x3fb7f0 FORMAT "%3.0" /end MEASUREMENT
/begin CHARACTERISTIC c_ctr_max_wup_cyc "Initialization value for the warm-up cycle of diagnostics" VALUE 0xffe406d5 _REC_VAL_20_u1 255. _CNV_A_R_LINEAR_____0_CM 0. 255. DISPLAY_IDENTIFIER C_CTR_MAX_WUP_CYC FORMAT "%3.0" /end CHARACTERISTIC
/begin CHARACTERISTIC lc_ena_scdn "Boolean to indicate iof similar conditions are inhibited (0) or (1)" VALUE 0xffe40f5f _REC_VAL_20_u1 1. _CNV_A_R_LINEAR_____0_CM 0. 1. DISPLAY_IDENTIFIER LC_ENA_SCDN FORMAT "%2.0" /end CHARACTERISTIC
/begin CHARACTERISTIC lc_clr_his_fmy "Clearing the history memory" VALUE 0xffe40f40 _REC_VAL_20_u1 1. _CNV_A_R_LINEAR_____0_CM 0. 1. DISPLAY_IDENTIFIER LC_CLR_HIS_FMY FORMAT "%2.0" /end CHARACTERISTIC
/begin MEASUREMENT ctr_err_his_nr "Number of failures in the history memory" UBYTE _CNV_A_R_LINEAR_____0_CM 1 100. 0. 255. DISPLAY_IDENTIFIER CTR_ERR_HIS_NR ECU_ADDRESS 0x3fbea8 FORMAT "%3.0" /end MEASUREMENT
/begin MEASUREMENT fmy_his_cod[0] "" UWORD _CNV_A_R_LINEAR_____0_CM 1 100. 0. 65535. DISPLAY_IDENTIFIER HIS_COD_1 ECU_ADDRESS 0x3fbe3a BYTE_ORDER MSB_LAST FORMAT "%5.0" /end MEASUREMENT
/begin MEASUREMENT fmy_his_cod[1] "" UWORD _CNV_A_R_LINEAR_____0_CM 1 100. 0. 65535. DISPLAY_IDENTIFIER HIS_COD_2 ECU_ADDRESS 0x3fbe3c BYTE_ORDER MSB_LAST FORMAT "%5.0" /end MEASUREMENT
/begin MEASUREMENT fmy_his_cod[2] "" UWORD _CNV_A_R_LINEAR_____0_CM 1 100. 0. 65535. DISPLAY_IDENTIFIER HIS_COD_3 ECU_ADDRESS 0x3fbe3e BYTE_ORDER MSB_LAST FORMAT "%5.0" /end MEASUREMENT
/begin MEASUREMENT fmy_his_cod[3] "" UWORD _CNV_A_R_LINEAR_____0_CM 1 100. 0. 65535. DISPLAY_IDENTIFIER HIS_COD_4 ECU_ADDRESS 0x3fbe40 BYTE_ORDER MSB_LAST FORMAT "%5.0" /end MEASUREMENT
/begin MEASUREMENT fmy_his_cod[4] "" UWORD _CNV_A_R_LINEAR_____0_CM 1 100. 0. 65535. DISPLAY_IDENTIFIER HIS_COD_5 ECU_ADDRESS 0x3fbe42 BYTE_ORDER MSB_LAST FORMAT "%5.0" /end MEASUREMENT
/begin MEASUREMENT fmy_his_cod[5] "" UWORD _CNV_A_R_LINEAR_____0_CM 1 100. 0. 65535. DISPLAY_IDENTIFIER HIS_COD_6 ECU_ADDRESS 0x3fbe44 BYTE_ORDER MSB_LAST FORMAT "%5.0" /end MEASUREMENT
/begin MEASUREMENT fmy_his_cod[6] "" UWORD _CNV_A_R_LINEAR_____0_CM 1 100. 0. 65535. DISPLAY_IDENTIFIER HIS_COD_7 ECU_ADDRESS 0x3fbe46 BYTE_ORDER MSB_LAST FORMAT "%5.0" /end MEASUREMENT
/begin MEASUREMENT fmy_his_cod[7] "" UWORD _CNV_A_R_LINEAR_____0_CM 1 100. 0. 65535. DISPLAY_IDENTIFIER HIS_COD_8 ECU_ADDRESS 0x3fbe48 BYTE_ORDER MSB_LAST FORMAT "%5.0" /end MEASUREMENT
/begin MEASUREMENT fmy_his_cod[8] "" UWORD _CNV_A_R_LINEAR_____0_CM 1 100. 0. 65535. DISPLAY_IDENTIFIER HIS_COD_9 ECU_ADDRESS 0x3fbe4a BYTE_ORDER MSB_LAST FORMAT "%5.0" /end MEASUREMENT
/begin MEASUREMENT fmy_his_cod[9] "" UWORD _CNV_A_R_LINEAR_____0_CM 1 100. 0. 65535. DISPLAY_IDENTIFIER HIS_COD_10 ECU_ADDRESS 0x3fbe4c BYTE_ORDER MSB_LAST FORMAT "%5.0" /end MEASUREMENT
/begin MEASUREMENT rel_dist_act_mil "" ULONG _CNV_A_R_LINEAR_____16_CM 1 100. 0. 429496729500. DISPLAY_IDENTIFIER REL_DIST_ACT_MIL ECU_ADDRESS 0x3fbeb4 BYTE_ORDER MSB_LAST FORMAT "%13.0" /end MEASUREMENT
/begin MEASUREMENT state_mil "" UBYTE _CNV_S_3_RANGE_STAT_194_CM 1 100. 0. 2. DISPLAY_IDENTIFIER STATE_MIL ECU_ADDRESS 0x3fbc77 /end MEASUREMENT
/begin MEASUREMENT rel_dist_act_wal_1 "" ULONG _CNV_A_R_LINEAR_____16_CM 1 100. 0. 429496729500. DISPLAY_IDENTIFIER REL_DIST_ACT_WAL_1 ECU_ADDRESS 0x3fbec0 BYTE_ORDER MSB_LAST FORMAT "%13.0" /end MEASUREMENT
/begin MEASUREMENT rel_dist_act_wal_2 "" ULONG _CNV_A_R_LINEAR_____16_CM 1 100. 0. 429496729500. DISPLAY_IDENTIFIER REL_DIST_ACT_WAL_2 ECU_ADDRESS 0x3fbecc BYTE_ORDER MSB_LAST FORMAT "%13.0" /end MEASUREMENT
/begin MEASUREMENT lv_wal_2 "" UBYTE _CNV_S_2_RANGE______195_R_CM 1 100. 0. 255. DISPLAY_IDENTIFIER LV_WAL_2 ECU_ADDRESS 0x3fbc7a /end MEASUREMENT
/begin MEASUREMENT state_wal_1 "" UBYTE _CNV_S_3_RANGE_STAT_194_CM 1 100. 0. 2. DISPLAY_IDENTIFIER STATE_WAL_1 ECU_ADDRESS 0x3fbc79 /end MEASUREMENT
/begin MEASUREMENT state_wal_2 "" UBYTE _CNV_S_3_RANGE_STAT_194_CM 1 100. 0. 2. DISPLAY_IDENTIFIER STATE_WAL_2 ECU_ADDRESS 0x3fbc7b /end MEASUREMENT
/begin MEASUREMENT dist_act_wal_2 "" ULONG _CNV_A_R_LINEAR_____16_CM 1 100. 0. 429496729500. DISPLAY_IDENTIFIER DIST_ACT_WAL_2 ECU_ADDRESS 0x3fbec8 BYTE_ORDER MSB_LAST FORMAT "%13.0" /end MEASUREMENT
/begin MEASUREMENT dist_act_wal_1 "" ULONG _CNV_A_R_LINEAR_____16_CM 1 100. 0. 429496729500. DISPLAY_IDENTIFIER DIST_ACT_WAL_1 ECU_ADDRESS 0x3fbebc BYTE_ORDER MSB_LAST FORMAT "%13.0" /end MEASUREMENT
/begin CHARACTERISTIC c_conf_mil "" VALUE 0xffe40659 _REC_VAL_20_u1 7. _CNV_A_R_LINEAR_____0_CM 0. 7. DISPLAY_IDENTIFIER C_CONF_MIL FORMAT "%1.0" /end CHARACTERISTIC
/begin CHARACTERISTIC c_conf_wal_1 "" VALUE 0xffe4065c _REC_VAL_20_u1 7. _CNV_A_R_LINEAR_____0_CM 0. 7. DISPLAY_IDENTIFIER C_CONF_WAL_1 FORMAT "%1.0" /end CHARACTERISTIC
/begin CHARACTERISTIC c_conf_wal_2 "" VALUE 0xffe4065d _REC_VAL_20_u1 7. _CNV_A_R_LINEAR_____0_CM 0. 7. DISPLAY_IDENTIFIER C_CONF_WAL_2 FORMAT "%1.0" /end CHARACTERISTIC
/begin CHARACTERISTIC lc_inh_wal_st "" VALUE 0xffe40f89 _REC_VAL_20_u1 1. _CNV_A_R_LINEAR_____0_CM 0. 1. DISPLAY_IDENTIFIER LC_INH_WAL_ST FORMAT "%2.0" /end CHARACTERISTIC
/begin MEASUREMENT dist_act_mil "" ULONG _CNV_A_R_LINEAR_____16_CM 1 100. 0. 429496729500. DISPLAY_IDENTIFIER DIST_ACT_MIL ECU_ADDRESS 0x3fbeb0 BYTE_ORDER MSB_LAST FORMAT "%13.0" /end MEASUREMENT
/begin CHARACTERISTIC c_dly_wal_st "" VALUE 0xffe40714 _REC_VAL_20_u1 255. _CNV_A_R_LINEAR_____196_CM 0. 255. DISPLAY_IDENTIFIER C_DLY_WAL_ST FORMAT "%3.0" /end CHARACTERISTIC
/begin CHARACTERISTIC c_dly_inh_iv_mis "Delay for MIL blinking in case of misfiring present failure with cylinder cut off" VALUE 0xffe40712 _REC_VAL_20_u1 255. _CNV_A_R_LINEAR_____196_CM 0. 255. DISPLAY_IDENTIFIER C_DLY_INH_IV_MIS FORMAT "%3.0" /end CHARACTERISTIC
/begin MEASUREMENT lv_mil "" UBYTE _CNV_S_2_RANGE______195_R_CM 1 100. 0. 255. DISPLAY_IDENTIFIER LV_MIL ECU_ADDRESS 0x3fbc76 /end MEASUREMENT
/begin MEASUREMENT lv_wal_1 "" UBYTE _CNV_S_2_RANGE______195_R_CM 1 100. 0. 255. DISPLAY_IDENTIFIER LV_WAL_1 ECU_ADDRESS 0x3fbc78 /end MEASUREMENT
/begin MEASUREMENT lv_wal_st "Boolean indicating Pre-drive check mode (0 : off / 1 : on)" UBYTE _CNV_S_2_RANGE______2_CM 1 100. 0. 1. DISPLAY_IDENTIFIER LV_WAL_ST ECU_ADDRESS 0x3fbc7c /end MEASUREMENT
/begin CHARACTERISTIC c_ctr_scdn_equ_dc_max "" VALUE 0xffe406d7 _REC_VAL_20_u1 255. _CNV_A_R_LINEAR_____0_CM 0. 255. DISPLAY_IDENTIFIER C_CTR_SCDN_EQU_DC_MAX FORMAT "%3.0" /end CHARACTERISTIC
/begin CHARACTERISTIC c_n_scdn_equ "" VALUE 0xffe4182e _REC_VAL_20_u2 8160. _CNV_A_R_LINEAR_____10_CM 0. 8160. DISPLAY_IDENTIFIER C_N_SCDN_EQU FORMAT "%4.0" /end CHARACTERISTIC
/begin CHARACTERISTIC c_load_scdn_equ "engine spped threshold for similar condirions detection (375 rpm)" VALUE 0xffe4078c _REC_VAL_20_u1 99.609375 _CNV_A_R_LINEAR_____9_CM 0. 99.609375 DISPLAY_IDENTIFIER C_LOAD_SCDN_EQU FORMAT "%4.1" /end CHARACTERISTIC
/begin CHARACTERISTIC c_t_ramp_lim_i_dt_is "Time constant for ramp limit of I-controller output in case of idle speed controller passive and drive train engaged" VALUE 0xffe419e0 _REC_VAL_20_u2 1310.7 _CNV_A_R_LINEAR_____198_CM 0. 1310.7 DISPLAY_IDENTIFIER C_T_RAMP_LIM_I_DT_IS FORMAT "%7.2" /end CHARACTERISTIC
/begin CHARACTERISTIC c_t_ramp_lim_p_d_dt_is "Time constant for ramp limit of P-, D-controller output in case of idle speed controller passive and LV_DT=1" VALUE 0xffe419e4 _REC_VAL_20_u2 655.35 _CNV_A_R_LINEAR_____4_CM 0. 655.35 DISPLAY_IDENTIFIER C_T_RAMP_LIM_P_D_DT_IS FORMAT "%5.2" /end CHARACTERISTIC
/begin CHARACTERISTIC c_t_ramp_lim_p_d_is "Time constant for ramp limit of P-, D-controller output in case of idle speed controller passive" VALUE 0xffe419e6 _REC_VAL_20_u2 655.35 _CNV_A_R_LINEAR_____4_CM 0. 655.35 DISPLAY_IDENTIFIER C_T_RAMP_LIM_P_D_IS FORMAT "%5.2" /end CHARACTERISTIC
/begin CHARACTERISTIC c_tq_bol_i_dt_is "Bottom limit for I-controller output and drive train closed" VALUE 0xffe404b0 _REC_VAL_20_s2 2047.96875 _CNV_A_R_LINEAR_____55_CM -1024. 1023.96875 DISPLAY_IDENTIFIER C_TQ_BOL_I_DT_IS FORMAT "%7.1" /end CHARACTERISTIC
/begin CHARACTERISTIC c_tq_bol_i_is "Bottom limit for I-controller output" VALUE 0xffe404b2 _REC_VAL_20_s2 2047.96875 _CNV_A_R_LINEAR_____55_CM -1024. 1023.96875 DISPLAY_IDENTIFIER C_TQ_BOL_I_IS FORMAT "%7.1" /end CHARACTERISTIC
/begin CHARACTERISTIC c_tq_tol_i_dt_is "Top limit for I-controller output and drive train closed" VALUE 0xffe404de _REC_VAL_20_s2 2047.96875 _CNV_A_R_LINEAR_____55_CM -1024. 1023.96875 DISPLAY_IDENTIFIER C_TQ_TOL_I_DT_IS FORMAT "%7.1" /end CHARACTERISTIC
/begin CHARACTERISTIC c_tq_tol_i_is "Top limit for I-controller output" VALUE 0xffe404e0 _REC_VAL_20_s2 2047.96875 _CNV_A_R_LINEAR_____55_CM -1024. 1023.96875 DISPLAY_IDENTIFIER C_TQ_TOL_I_IS FORMAT "%7.1" /end CHARACTERISTIC
/begin CHARACTERISTIC ip_tq_i_dt_is "I-component for idle speed controller at closed drive train" CURVE 0xffe4fafa _REC_CUR_20_u2_u2 7.99987793 _CNV_A_R_LINEAR_____212_CM -4. 3.99987793 DISPLAY_IDENTIFIER IP_TQ_I_DT_IS FORMAT "%6.5"
 /begin AXIS_DESCR COM_AXIS n_dif_cor _CNV_A_R_LINEAR_____207_CM 12 -32768. 32767. FORMAT "%6.0" AXIS_PTS_REF ldp_n_dif_cor__tq_i_dt_is /end AXIS_DESCR
/end CHARACTERISTIC
/begin MEASUREMENT tq_dif_p_d_fast_is "TQ_DIF_P_D_IS for fast-path of torque coordination" SWORD _CNV_A_R_LINEAR_____55_CM 1 100. -1024. 1023.96875 DISPLAY_IDENTIFIER TQ_DIF_P_D_FAST_IS ECU_ADDRESS 0x3fda3c BYTE_ORDER MSB_LAST FORMAT "%6.2" /end MEASUREMENT
/begin MEASUREMENT tq_dif_i_is "I- controller output for idle speed control" SWORD _CNV_A_R_LINEAR_____55_CM 1 100. -1024. 1023.96875 DISPLAY_IDENTIFIER TQ_DIF_I_IS ECU_ADDRESS 0x3fda3a BYTE_ORDER MSB_LAST FORMAT "%6.2" /end MEASUREMENT
/begin MEASUREMENT tq_add_i_is "Incrememt of limited integrator" SWORD _CNV_A_R_LINEAR_____213_CM 1 100. -4. 3.99987793 DISPLAY_IDENTIFIER TQ_ADD_I_IS ECU_ADDRESS 0x3fda44 BYTE_ORDER MSB_LAST FORMAT "%7.4" /end MEASUREMENT
/begin CHARACTERISTIC lc_tq_dif_i_inh_as "Logical variable for ISCI I-part deactivation - default value at initialisation = 0" VALUE 0xffe40fea _REC_VAL_20_u1 1. _CNV_A_R_LINEAR_____22_CM 0. 1. DISPLAY_IDENTIFIER LC_TQ_DIF_I_INH_AS FORMAT "%1.0" /end CHARACTERISTIC
/begin CHARACTERISTIC lc_tq_dif_p_d_inh_as "Logical variable for deactivation of TQ_DIF_P_D_IS -default value at initialisation = 0" VALUE 0xffe40feb _REC_VAL_20_u1 1. _CNV_A_R_LINEAR_____22_CM 0. 1. DISPLAY_IDENTIFIER LC_TQ_DIF_P_D_INH_AS FORMAT "%1.0" /end CHARACTERISTIC
/begin MEASUREMENT n_grd_fil_is "Filtered engine speed gradient for ISC" SBYTE _CNV_A_R_LINEAR_____51_CM 1 100. -4096. 4064. DISPLAY_IDENTIFIER N_GRD_FIL_IS ECU_ADDRESS 0x3fe8d3 FORMAT "%4.0" /end MEASUREMENT
/begin MEASUREMENT n_grd_p_d_is "Filtered gradient for PD-part" SBYTE _CNV_A_R_LINEAR_____51_CM 1 100. -4096. 4064. DISPLAY_IDENTIFIER N_GRD_P_D_IS ECU_ADDRESS 0x3fe8d2 FORMAT "%5.0" /end MEASUREMENT
/begin MEASUREMENT n_grd_i_is "Filtered gradient for I-part" SBYTE _CNV_A_R_LINEAR_____51_CM 1 100. -4096. 4064. DISPLAY_IDENTIFIER N_GRD_I_IS ECU_ADDRESS 0x3fe8d1 FORMAT "%5.0" /end MEASUREMENT
/begin CHARACTERISTIC ip_fac_p_d_fast_tco_is "TCO depending factor foe fast-path of torque coordination" CURVE 0xffe4b166 _REC_CUR_20_u2_u1 1.99996948 _CNV_A_R_LINEAR_____20_CM 0. 1.99996948 DISPLAY_IDENTIFIER IP_FAC_P_D_FAST_TCO_IS FORMAT "%7.5"
 /begin AXIS_DESCR COM_AXIS tco _CNV_A_R_LINEAR_____11_CM 8 -48. 142.5 FORMAT "%5.1" AXIS_PTS_REF ldpm_tco_is_1 /end AXIS_DESCR
/end CHARACTERISTIC
/begin CHARACTERISTIC ip_fac_p_d_slow_tco_is "TCO depending factor foe slow-path of torque coordination" CURVE 0xffe4b176 _REC_CUR_20_u2_u1 1.99996948 _CNV_A_R_LINEAR_____20_CM 0. 1.99996948 DISPLAY_IDENTIFIER IP_FAC_P_D_SLOW_TCO_IS FORMAT "%7.5"
 /begin AXIS_DESCR COM_AXIS tco _CNV_A_R_LINEAR_____11_CM 8 -48. 142.5 FORMAT "%5.1" AXIS_PTS_REF ldpm_tco_is_1 /end AXIS_DESCR
/end CHARACTERISTIC
/begin MEASUREMENT lv_pas_ramp_act_p_d_is "Logical value for PD-part passive ramp active" UBYTE _CNV_S_2_RANGE______2_CM 1 100. 0. 1. DISPLAY_IDENTIFIER LV_PAS_RAMP_ACT_P_D_IS ECU_ADDRESS 0x3fe8cc /end MEASUREMENT
/begin MEASUREMENT lv_pas_ramp_act_i_is "Logical value for I-part passive ramp active" UBYTE _CNV_S_2_RANGE______2_CM 1 100. 0. 1. DISPLAY_IDENTIFIER LV_PAS_RAMP_ACT_I_IS ECU_ADDRESS 0x3fe8cb /end MEASUREMENT
/begin MEASUREMENT tq_add_i_ramp "Increment of the I-part ramps" SWORD _CNV_A_R_LINEAR_____55_CM 1 100. -1024. 1023.96875 DISPLAY_IDENTIFIER TQ_ADD_I_RAMP ECU_ADDRESS 0x3fda46 BYTE_ORDER MSB_LAST FORMAT "%6.2" /end MEASUREMENT
/begin MEASUREMENT state_p_d_isc "State of the PD-part: P_D_PASSIVE, P_D_NORMAL, RAMP_TO_ZERO" UBYTE _CNV_S_3_STATE_P_D__214_CM 1 100. 0. 2. DISPLAY_IDENTIFIER STATE_P_D_ISC ECU_ADDRESS 0x3fe8cd /end MEASUREMENT
/begin MEASUREMENT state_i_isc "State of the integral part: I_PASSIVE, I_NORMAL, RAMP_TO_PAS, RAMP_TO_LIM" UBYTE _CNV_S_4_STATE_I_IS_215_CM 1 100. 0. 3. DISPLAY_IDENTIFIER STATE_I_ISC ECU_ADDRESS 0x3fe8d0 /end MEASUREMENT
/begin CHARACTERISTIC ip_tq_i_is "I-component for idle speed controller at open drive train" MAP 0xffe4fb12 _REC_MAP_20_u2_u2_u1 7.99987793 _CNV_A_R_LINEAR_____212_CM -4. 3.99987793 DISPLAY_IDENTIFIER IP_TQ_I_IS FORMAT "%5.4"
 /begin AXIS_DESCR COM_AXIS n_dif_cor _CNV_A_R_LINEAR_____207_CM 12 -32768. 32767. FORMAT "%6.0" AXIS_PTS_REF ldp_n_dif_cor_tq_i_is /end AXIS_DESCR
 /begin AXIS_DESCR COM_AXIS n_grd _CNV_A_R_LINEAR_____54_CM 8 -4096. 4064. FORMAT "%5.0" AXIS_PTS_REF ldp_n_grd_tq_i_is /end AXIS_DESCR
/end CHARACTERISTIC
/begin CHARACTERISTIC lc_isc_inh "Bit for inhibiting the PD- and integral part - default value = 0" VALUE 0xffe40f8f _REC_VAL_20_u1 1. _CNV_A_R_LINEAR_____22_CM 0. 1. DISPLAY_IDENTIFIER LC_ISC_INH FORMAT "%1.0" /end CHARACTERISTIC
/begin CHARACTERISTIC lc_tq_add_i_inh_as "Logical variable for ISC I-part map output deactivation - default value at initialisation = 0" VALUE 0xffe40fe7 _REC_VAL_20_u1 1. _CNV_A_R_LINEAR_____22_CM 0. 1. DISPLAY_IDENTIFIER LC_TQ_ADD_I_INH_AS FORMAT "%1.0" /end CHARACTERISTIC
/begin AXIS_PTS ldp_n_dif_cor__tq_i_dt_is "" 0xffe5103c n_dif_cor _REC_AXS_20_u2 65535. _CNV_A_R_LINEAR_____207_CM 12 -32768. 32767. DISPLAY_IDENTIFIER LDP_N_DIF_COR__TQ_I_DT_IS FORMAT "%6.0" /end AXIS_PTS
/begin AXIS_PTS ldp_n_dif_cor_tq_i_is "" 0xffe51056 n_dif_cor _REC_AXS_20_u2 65535. _CNV_A_R_LINEAR_____207_CM 12 -32768. 32767. DISPLAY_IDENTIFIER LDP_N_DIF_COR_TQ_I_IS FORMAT "%6.0" /end AXIS_PTS
/begin AXIS_PTS ldp_n_grd_tq_i_is "" 0xffe4813e n_grd _REC_AXS_20_u1 8160. _CNV_A_R_LINEAR_____54_CM 8 -4096. 4064. DISPLAY_IDENTIFIER LDP_N_GRD_TQ_I_IS FORMAT "%5.0" /end AXIS_PTS
/begin AXIS_PTS ldpm_tco_is_1 "" 0xffe48677 tco _REC_AXS_20_u1 190.5 _CNV_A_R_LINEAR_____11_CM 8 -48. 142.5 DISPLAY_IDENTIFIER LDPM_TCO_IS_1 FORMAT "%5.1" /end AXIS_PTS
/begin AXIS_PTS ldpm_gr_mt_2 "" 0xffe483c7 gr_mt _REC_AXS_20_u1 255. _CNV_A_R_LINEAR_____0_CM 8 0. 255. DISPLAY_IDENTIFIER LDPM_GR_MT_2 FORMAT "%3.0" /end AXIS_PTS
/begin MEASUREMENT tq_dif_p_d_slow_is "TQ_DIF_P_D_IS for slow-path of torque coordination" SWORD _CNV_A_R_LINEAR_____55_CM 1 100. -1024. 1023.96875 DISPLAY_IDENTIFIER TQ_DIF_P_D_SLOW_IS ECU_ADDRESS 0x3fda38 BYTE_ORDER MSB_LAST FORMAT "%6.2" /end MEASUREMENT
/begin MEASUREMENT tq_dif_p_d_is_slow "PD-part before seperation into fast/slow path" SWORD _CNV_A_R_LINEAR_____55_CM 1 100. -1024. 1023.96875 DISPLAY_IDENTIFIER TQ_DIF_P_D_IS_SLOW ECU_ADDRESS 0x3fda56 BYTE_ORDER MSB_LAST FORMAT "%8.2" /end MEASUREMENT
/begin MEASUREMENT tq_dif_p_d_is_fast "PD-part before seperation into fast/slow path" SWORD _CNV_A_R_LINEAR_____55_CM 1 100. -1024. 1023.96875 DISPLAY_IDENTIFIER TQ_DIF_P_D_IS_FAST ECU_ADDRESS 0x3fda54 BYTE_ORDER MSB_LAST FORMAT "%8.2" /end MEASUREMENT
/begin MEASUREMENT tq_add_p_d_ramp_fast "Increment of the PD-part ramps ignition path" SWORD _CNV_A_R_LINEAR_____55_CM 1 100. -1024. 1023.96875 DISPLAY_IDENTIFIER TQ_ADD_P_D_RAMP_FAST ECU_ADDRESS 0x3fda4c BYTE_ORDER MSB_LAST FORMAT "%8.2" /end MEASUREMENT
/begin MEASUREMENT tq_add_p_d_ramp_slow "Increment of the PD-part ramps air path" SWORD _CNV_A_R_LINEAR_____55_CM 1 100. -1024. 1023.96875 DISPLAY_IDENTIFIER TQ_ADD_P_D_RAMP_SLOW ECU_ADDRESS 0x3fda4e BYTE_ORDER MSB_LAST FORMAT "%8.2" /end MEASUREMENT
/begin MEASUREMENT lv_tq_p_d_act_fast "Logical variable for PD-part fast active (STATE_P_D_ISC = P_D_NORMAL)" UBYTE _CNV_S_2_RANGE______21_CM 1 100. 0. 1. DISPLAY_IDENTIFIER LV_TQ_P_D_ACT_FAST ECU_ADDRESS 0x3fe8db BIT_MASK 0x1 /end MEASUREMENT
/begin MEASUREMENT lv_tq_p_d_act_slow "Logical variable for PD-part air path active (STATE_P_D_ISC = P_D_NORMAL)" UBYTE _CNV_S_2_RANGE______21_CM 1 100. 0. 1. DISPLAY_IDENTIFIER LV_TQ_P_D_ACT_SLOW ECU_ADDRESS 0x3fe8dc BIT_MASK 0x1 /end MEASUREMENT
/begin CHARACTERISTIC ip_p_d_dt_is "P- and D-component for idle speed controller at closed drive train" MAP 0xffe4d98a _REC_MAP_20_u2_u2_u1 2047.96875 _CNV_A_R_LINEAR_____187_CM -1024. 1023.96875 DISPLAY_IDENTIFIER IP_P_D_DT_IS FORMAT "%6.2"
 /begin AXIS_DESCR COM_AXIS n_dif_cor _CNV_A_R_LINEAR_____207_CM 12 -32768. 32767. FORMAT "%6.0" AXIS_PTS_REF ldpm_n_dif_cor_p_d_dt_is /end AXIS_DESCR
 /begin AXIS_DESCR COM_AXIS n_grd _CNV_A_R_LINEAR_____54_CM 8 -4096. 4064. FORMAT "%5.0" AXIS_PTS_REF ldpm_n_grd_p_d_dt_is /end AXIS_DESCR
/end CHARACTERISTIC
/begin CHARACTERISTIC ip_p_d_dt_is_slow "P- and D-component for idle speed controller at closed drive train" MAP 0xffe4da4a _REC_MAP_20_u2_u2_u1 2047.96875 _CNV_A_R_LINEAR_____187_CM -1024. 1023.96875 DISPLAY_IDENTIFIER IP_P_D_DT_IS_SLOW FORMAT "%6.2"
 /begin AXIS_DESCR COM_AXIS n_dif_cor _CNV_A_R_LINEAR_____207_CM 12 -32768. 32767. FORMAT "%6.0" AXIS_PTS_REF ldpm_n_dif_cor_p_d_dt_is /end AXIS_DESCR
 /begin AXIS_DESCR COM_AXIS n_grd _CNV_A_R_LINEAR_____54_CM 8 -4096. 4064. FORMAT "%5.0" AXIS_PTS_REF ldpm_n_grd_p_d_dt_is /end AXIS_DESCR
/end CHARACTERISTIC
/begin AXIS_PTS ldpm_n_dif_cor_p_d_dt_is "" 0xffe51b3c n_dif_cor _REC_AXS_20_u2 65535. _CNV_A_R_LINEAR_____207_CM 12 -32768. 32767. DISPLAY_IDENTIFIER LDPM_N_DIF_COR_P_D_DT_IS FORMAT "%6.0" /end AXIS_PTS
/begin AXIS_PTS ldpm_n_grd_p_d_dt_is "" 0xffe48587 n_grd _REC_AXS_20_u1 8160. _CNV_A_R_LINEAR_____54_CM 8 -4096. 4064. DISPLAY_IDENTIFIER LDPM_N_GRD_P_D_DT_IS FORMAT "%5.0" /end AXIS_PTS
/begin AXIS_PTS ldpm_n_dif_cor_p_d_is "" 0xffe51b56 n_dif_cor _REC_AXS_20_u2 65535. _CNV_A_R_LINEAR_____207_CM 12 -32768. 32767. DISPLAY_IDENTIFIER LDPM_N_DIF_COR_P_D_IS FORMAT "%6.0" /end AXIS_PTS
/begin AXIS_PTS ldpm_n_grd_p_d_is "" 0xffe48590 n_grd _REC_AXS_20_u1 8160. _CNV_A_R_LINEAR_____54_CM 8 -4096. 4064. DISPLAY_IDENTIFIER LDPM_N_GRD_P_D_IS FORMAT "%5.0" /end AXIS_PTS
/begin CHARACTERISTIC ip_p_d_is "P- and D-component for idle speed controller at open drive train" MAP 0xffe4db0a _REC_MAP_20_u2_u2_u1 2047.96875 _CNV_A_R_LINEAR_____187_CM -1024. 1023.96875 DISPLAY_IDENTIFIER IP_P_D_IS FORMAT "%6.2"
 /begin AXIS_DESCR COM_AXIS n_dif_cor _CNV_A_R_LINEAR_____207_CM 12 -32768. 32767. FORMAT "%6.0" AXIS_PTS_REF ldpm_n_dif_cor_p_d_is /end AXIS_DESCR
 /begin AXIS_DESCR COM_AXIS n_grd _CNV_A_R_LINEAR_____54_CM 8 -4096. 4064. FORMAT "%5.0" AXIS_PTS_REF ldpm_n_grd_p_d_is /end AXIS_DESCR
/end CHARACTERISTIC
/begin CHARACTERISTIC ip_p_d_is_slow "P- and D-component for idle speed controller at open drive train" MAP 0xffe4dbca _REC_MAP_20_u2_u2_u1 2047.96875 _CNV_A_R_LINEAR_____187_CM -1024. 1023.96875 DISPLAY_IDENTIFIER IP_P_D_IS_SLOW FORMAT "%6.2"
 /begin AXIS_DESCR COM_AXIS n_dif_cor _CNV_A_R_LINEAR_____207_CM 12 -32768. 32767. FORMAT "%6.0" AXIS_PTS_REF ldpm_n_dif_cor_p_d_is /end AXIS_DESCR
 /begin AXIS_DESCR COM_AXIS n_grd _CNV_A_R_LINEAR_____54_CM 8 -4096. 4064. FORMAT "%5.0" AXIS_PTS_REF ldpm_n_grd_p_d_is /end AXIS_DESCR
/end CHARACTERISTIC
/begin CHARACTERISTIC id_fac_p_d_dt_is "Weighting factor for IP_P_D_DT_IS" CURVE 0xffe487ac _REC_CUR_20_u2_u1 1.99996948 _CNV_A_R_LINEAR_____20_CM 0. 1.99996948 DISPLAY_IDENTIFIER ID_FAC_P_D_DT_IS FORMAT "%7.5"
 /begin AXIS_DESCR COM_AXIS gr_mt _CNV_A_R_LINEAR_____0_CM 8 0. 255. FORMAT "%3.0" AXIS_PTS_REF ldpm_gr_mt_2 /end AXIS_DESCR
/end CHARACTERISTIC
/begin CHARACTERISTIC id_fac_p_d_dt_is_slow "Weighting factor for IP_P_D_DT_IS_SLOW" CURVE 0xffe487bc _REC_CUR_20_u2_u1 1.99996948 _CNV_A_R_LINEAR_____20_CM 0. 1.99996948 DISPLAY_IDENTIFIER ID_FAC_P_D_DT_IS_SLOW FORMAT "%7.5"
 /begin AXIS_DESCR COM_AXIS gr_mt _CNV_A_R_LINEAR_____0_CM 8 0. 255. FORMAT "%3.0" AXIS_PTS_REF ldpm_gr_mt_2 /end AXIS_DESCR
/end CHARACTERISTIC
/begin AXIS_PTS ldpm_t_ast__fac_n_grd_is "" 0xffe51d04 t_ast _REC_AXS_20_u2 6553.5 _CNV_A_R_LINEAR_____24_CM 8 0. 6553.5 DISPLAY_IDENTIFIER LDPM_T_AST__FAC_N_GRD_IS FORMAT "%5.1" /end AXIS_PTS
/begin CHARACTERISTIC ip_fac_n_grd_is "Weighting factor N_GRD input for IP_P_D_IS" MAP 0xffe45456 _REC_MAP_20_u1_u1_u2 1.9921875 _CNV_A_R_LINEAR_____117_CM 0. 1.9921875 DISPLAY_IDENTIFIER IP_FAC_N_GRD_IS FORMAT "%5.3"
 /begin AXIS_DESCR COM_AXIS tco _CNV_A_R_LINEAR_____11_CM 8 -48. 142.5 FORMAT "%6.2" AXIS_PTS_REF ldpm_tco__fac_n_grd_is /end AXIS_DESCR
 /begin AXIS_DESCR COM_AXIS t_ast _CNV_A_R_LINEAR_____24_CM 8 0. 6553.5 FORMAT "%5.1" AXIS_PTS_REF ldpm_t_ast__fac_n_grd_is /end AXIS_DESCR
/end CHARACTERISTIC
/begin CHARACTERISTIC lc_tq_p_d_slow_inh_as "Logical variable for deactivation of TQ_DIF_P_D_IS - default value at initialisation = 0" VALUE 0xffe40ffa _REC_VAL_20_u1 1. _CNV_A_R_LINEAR_____22_CM 0. 1. DISPLAY_IDENTIFIER LC_TQ_P_D_SLOW_INH_AS FORMAT "%1.0" /end CHARACTERISTIC
/begin CHARACTERISTIC lc_tq_p_d_fast_inh_as "Logical variable for deactivation of TQ_DIF_P_D_IS - default value at initialisation = 0" VALUE 0xffe40ff9 _REC_VAL_20_u1 1. _CNV_A_R_LINEAR_____22_CM 0. 1. DISPLAY_IDENTIFIER LC_TQ_P_D_FAST_INH_AS FORMAT "%1.0" /end CHARACTERISTIC
/begin CHARACTERISTIC ip_fac_n_grd_is_slow "Weighting factor N_GRD input for IP_P_D_IS_SLOW" MAP 0xffe45496 _REC_MAP_20_u1_u1_u2 1.9921875 _CNV_A_R_LINEAR_____117_CM 0. 1.9921875 DISPLAY_IDENTIFIER IP_FAC_N_GRD_IS_SLOW FORMAT "%5.3"
 /begin AXIS_DESCR COM_AXIS tco _CNV_A_R_LINEAR_____11_CM 8 -48. 142.5 FORMAT "%6.2" AXIS_PTS_REF ldpm_tco__fac_n_grd_is /end AXIS_DESCR
 /begin AXIS_DESCR COM_AXIS t_ast _CNV_A_R_LINEAR_____24_CM 8 0. 6553.5 FORMAT "%5.1" AXIS_PTS_REF ldpm_t_ast__fac_n_grd_is /end AXIS_DESCR
/end CHARACTERISTIC
/begin AXIS_PTS ldpm_tco__fac_n_grd_is "" 0xffe4862d tco _REC_AXS_20_u1 190.5 _CNV_A_R_LINEAR_____11_CM 8 -48. 142.5 DISPLAY_IDENTIFIER LDPM_TCO__FAC_N_GRD_IS FORMAT "%6.2" /end AXIS_PTS
/begin AXIS_PTS ldpm_n_dif_cor_tq_i_is "" 0xffe51b70 n_dif_cor _REC_AXS_20_u2 65535. _CNV_A_R_LINEAR_____207_CM 4 -32768. 32767. DISPLAY_IDENTIFIER LDPM_N_DIF_COR_TQ_I_IS FORMAT "%6.0" /end AXIS_PTS
/begin AXIS_PTS ldpm_n_grd_tq_i_is "" 0xffe41402 n_grd _REC_AXS_20_u1 8160. _CNV_A_R_LINEAR_____216_CM 4 -4096. 4064. DISPLAY_IDENTIFIER LDPM_N_GRD_TQ_I_IS FORMAT "%5.0" /end AXIS_PTS
/begin CHARACTERISTIC ip_fac_t_ast_i_is "TQ_ADD_I_IS correction after start" MAP 0xffe4b3de _REC_MAP_20_u2_u1_u2 0.999755 _CNV_A_R_LINEAR_____126_CM 0. 0.999755 DISPLAY_IDENTIFIER IP_FAC_T_AST_I_IS FORMAT "%7.5"
 /begin AXIS_DESCR COM_AXIS tco _CNV_A_R_LINEAR_____11_CM 8 -48. 142.5 FORMAT "%6.2" AXIS_PTS_REF ldpm_tco__fac_n_grd_is /end AXIS_DESCR
 /begin AXIS_DESCR COM_AXIS t_ast _CNV_A_R_LINEAR_____24_CM 8 0. 6553.5 FORMAT "%5.1" AXIS_PTS_REF ldpm_t_ast__fac_n_grd_is /end AXIS_DESCR
/end CHARACTERISTIC
/begin CHARACTERISTIC ip_tq_pas_i_acc_is "I-component for idle speed controller at transition out of Passive with air condition" MAP 0xffe4ff4e _REC_MAP_20_u2_u2_u1 2047.96875 _CNV_A_R_LINEAR_____187_CM -1024. 1023.96875 DISPLAY_IDENTIFIER IP_TQ_PAS_I_ACC_IS FORMAT "%6.2"
 /begin AXIS_DESCR COM_AXIS n_dif_cor _CNV_A_R_LINEAR_____207_CM 4 -32768. 32767. FORMAT "%6.0" AXIS_PTS_REF ldpm_n_dif_cor_tq_i_is /end AXIS_DESCR
 /begin AXIS_DESCR COM_AXIS n_grd _CNV_A_R_LINEAR_____216_CM 4 -4096. 4064. FORMAT "%5.0" AXIS_PTS_REF ldpm_n_grd_tq_i_is /end AXIS_DESCR
/end CHARACTERISTIC
/begin CHARACTERISTIC ip_tq_pas_i_is "I-component for idle speed controller at transition out of Passive with air condition" MAP 0xffe4ff6e _REC_MAP_20_u2_u2_u1 2047.96875 _CNV_A_R_LINEAR_____187_CM -1024. 1023.96875 DISPLAY_IDENTIFIER IP_TQ_PAS_I_IS FORMAT "%6.2"
 /begin AXIS_DESCR COM_AXIS n_dif_cor _CNV_A_R_LINEAR_____207_CM 4 -32768. 32767. FORMAT "%6.0" AXIS_PTS_REF ldpm_n_dif_cor_tq_i_is /end AXIS_DESCR
 /begin AXIS_DESCR COM_AXIS n_grd _CNV_A_R_LINEAR_____216_CM 4 -4096. 4064. FORMAT "%5.0" AXIS_PTS_REF ldpm_n_grd_tq_i_is /end AXIS_DESCR
/end CHARACTERISTIC
/begin CHARACTERISTIC c_t_ramp_lim_i_is "Time constant for ramp limit of I-controller output in case of idle speed controller passive" VALUE 0xffe419e2 _REC_VAL_20_u2 1310.7 _CNV_A_R_LINEAR_____198_CM 0. 1310.7 DISPLAY_IDENTIFIER C_T_RAMP_LIM_I_IS FORMAT "%7.2" /end CHARACTERISTIC
/begin CHARACTERISTIC lc_p_d_slow_fast_sel_ena "Enable seperation of slow and fast path of TQ_DIF_P_D_IS - default value at initialisation = 0" VALUE 0xffe40fc5 _REC_VAL_20_u1 1. _CNV_A_R_LINEAR_____22_CM 0. 1. DISPLAY_IDENTIFIER LC_P_D_SLOW_FAST_SEL_ENA FORMAT "%1.0" /end CHARACTERISTIC
/begin MEASUREMENT tq_dif_p_d_dt_is_1 "PD-part st drive train into fast path" SWORD _CNV_A_R_LINEAR_____55_CM 1 100. -1024. 1023.96875 DISPLAY_IDENTIFIER TQ_DIF_P_D_DT_IS_1 ECU_ADDRESS 0x3fda50 BYTE_ORDER MSB_LAST FORMAT "%8.2" /end MEASUREMENT
/begin MEASUREMENT tq_dif_p_d_dt_is_1_slow "PD-part at drive train into slow path" SWORD _CNV_A_R_LINEAR_____55_CM 1 100. -1024. 1023.96875 DISPLAY_IDENTIFIER TQ_DIF_P_D_DT_IS_1_SLOW ECU_ADDRESS 0x3fda52 BYTE_ORDER MSB_LAST FORMAT "%8.2" /end MEASUREMENT
/begin MEASUREMENT fac_n_grd_is "Factor in dependance of TCO and TOIL for weighting the speed gradient influence on the PD-part (for LV_DT=0)" UBYTE _CNV_A_R_LINEAR_____39_CM 1 100. 0. 1.99220002 DISPLAY_IDENTIFIER FAC_N_GRD_IS ECU_ADDRESS 0x3fe8ce FORMAT "%5.3" /end MEASUREMENT
/begin MEASUREMENT fac_n_grd_is_slow "Factor in dependance of TCO and TOIL for weighting the speed gradient influence on the PD-part (for LV_DT=0)" UBYTE _CNV_A_R_LINEAR_____39_CM 1 100. 0. 1.99220002 DISPLAY_IDENTIFIER FAC_N_GRD_IS_SLOW ECU_ADDRESS 0x3fe8cf FORMAT "%5.3" /end MEASUREMENT
/begin CHARACTERISTIC c_crlc_n_grd "Filter correlation constant" VALUE 0xffe41560 _REC_VAL_20_u2 0.99998474 _CNV_A_R_LINEAR_____37_CM 0. 0.99998474 DISPLAY_IDENTIFIER C_CRLC_N_GRD FORMAT "%7.5" /end CHARACTERISTIC
/begin CHARACTERISTIC c_nr_buf_n_grd_fil "number of relevant buffer cells for N_GRD_FIL_1_IS" VALUE 0xffe4080f _REC_VAL_20_u1 5. _CNV_A_R_LINEAR_____0_CM 1. 6. DISPLAY_IDENTIFIER C_NR_BUF_N_GRD_FIL FORMAT "%2.0" /end CHARACTERISTIC
/begin CHARACTERISTIC lc_n_grd_fil_p_d_swi "Logical variable for switching between N_GRD_FIL_1_IS and N_GRD_FIL_IS" VALUE 0xffe40fb0 _REC_VAL_20_u1 1. _CNV_A_R_LINEAR_____22_CM 0. 1. DISPLAY_IDENTIFIER LC_N_GRD_FIL_P_D_SWI FORMAT "%1.0" /end CHARACTERISTIC
/begin CHARACTERISTIC lc_n_grd_fil_i_swi "Logical variable for changing between N_GRD_FIL_1_IS and N_GRD_FIL_IS" VALUE 0xffe40faf _REC_VAL_20_u1 1. _CNV_A_R_LINEAR_____22_CM 0. 1. DISPLAY_IDENTIFIER LC_N_GRD_FIL_I_SWI FORMAT "%1.0" /end CHARACTERISTIC
/begin MEASUREMENT lv_req_isc "Logical variable for idle speed controller activatIon request" UBYTE _CNV_S_2_RANGE______2_CM 1 100. 0. 1. DISPLAY_IDENTIFIER LV_REQ_ISC ECU_ADDRESS 0x3fe8e3 BIT_MASK 0x1 /end MEASUREMENT
/begin MEASUREMENT state_req_isc "actual state for ISC request" UBYTE _CNV_S_4_STATE_REQ__217_CM 1 100. 0. 3. DISPLAY_IDENTIFIER STATE_REQ_ISC ECU_ADDRESS 0x3fe8e4 /end MEASUREMENT
/begin MEASUREMENT lv_neg_n_grd_fil_mem "Memory bit for falling gradient after start" UBYTE _CNV_S_2_RANGE______2_CM 1 100. 0. 1. DISPLAY_IDENTIFIER LV_NEG_N_GRD_FIL_MEM ECU_ADDRESS 0x3fe8e8 /end MEASUREMENT
/begin MEASUREMENT n_grd_fil_isc_act_ast "Filtered gradient for ISC after start activation" SBYTE _CNV_A_R_LINEAR_____51_CM 1 100. -4096. 4064. DISPLAY_IDENTIFIER N_GRD_FIL_ISC_ACT_AST ECU_ADDRESS 0x3fe8e5 FORMAT "%5.0" /end MEASUREMENT
/begin CHARACTERISTIC lc_isc_act_cdn_swi "Calibratible logical bit for switching between different activation conditions " VALUE 0xffe40f8e _REC_VAL_20_u1 1. _CNV_A_R_LINEAR_____0_CM 0. 1. DISPLAY_IDENTIFIER LC_ISC_ACT_CDN_SWI FORMAT "%2.0" /end CHARACTERISTIC
/begin CHARACTERISTIC lc_isc_act_ast_cdn_swi "Switch for using different after start ISC activation conditions" VALUE 0xffe40f8d _REC_VAL_20_u1 1. _CNV_A_R_LINEAR_____0_CM 0. 1. DISPLAY_IDENTIFIER LC_ISC_ACT_AST_CDN_SWI FORMAT "%2.0" /end CHARACTERISTIC
/begin CHARACTERISTIC c_n_dif_isc_act_ast "Additive term to define the low limit for ISC activation after start" VALUE 0xffe4047c _REC_VAL_20_s2 65535. _CNV_A_R_LINEAR_____10_CM -32768. 32767. DISPLAY_IDENTIFIER C_N_DIF_ISC_ACT_AST FORMAT "%6.0" /end CHARACTERISTIC
/begin CHARACTERISTIC c_crlc_n_grd_fil_isc_act_ast "Filter correlation factor for speed gradient filtering in connection with after start activation of ISC" VALUE 0xffe41566 _REC_VAL_20_u2 0.99998474 _CNV_A_R_LINEAR_____37_CM 0. 0.99998474 DISPLAY_IDENTIFIER C_CRLC_N_GRD_FIL_ISC_ACT_AST FORMAT "%7.5" /end CHARACTERISTIC
/begin CHARACTERISTIC c_t_dly_isc_act_pu "Time limit for ISC activation in PU" VALUE 0xffe41918 _REC_VAL_20_u2 655.35 _CNV_A_R_LINEAR_____4_CM 0. 655.35 DISPLAY_IDENTIFIER C_T_DLY_ISC_ACT_PU FORMAT "%6.2" /end CHARACTERISTIC
/begin MEASUREMENT n_dif_ofs_pred "Predicted engine speed difference for torque reserve calculation" SWORD _CNV_A_R_LINEAR_____10_CM 1 100. -32768. 32767. DISPLAY_IDENTIFIER N_DIF_OFS_PRED ECU_ADDRESS 0x3fda62 BYTE_ORDER MSB_LAST FORMAT "%6.0" /end MEASUREMENT
/begin MEASUREMENT t_n_dif_ofs_pred "Prediction time for engine speed difference" UBYTE _CNV_A_R_LINEAR_____218_CM 1 100. 0. 7.96875 DISPLAY_IDENTIFIER T_N_DIF_OFS_PRED ECU_ADDRESS 0x3fe8e0 FORMAT "%4.2" /end MEASUREMENT
/begin CHARACTERISTIC ip_t_n_dif_ofs_pred__n "Time constant for calculation of predicted engine speed deviation" CURVE 0xffe40e40 _REC_CUR_20_u1_u2 7.96875 _CNV_A_R_LINEAR_____218_CM 0. 7.96875 DISPLAY_IDENTIFIER IP_T_N_DIF_OFS_PRED__N FORMAT "%4.2"
 /begin AXIS_DESCR COM_AXIS n _CNV_A_R_LINEAR_____10_CM 8 0. 8160. FORMAT "%4.0" AXIS_PTS_REF ldpm_n_t_n_dif_ofs_pred /end AXIS_DESCR
/end CHARACTERISTIC
/begin MEASUREMENT n_dif_pred "Predicted idle speed control variable" SWORD _CNV_A_R_LINEAR_____10_CM 1 100. -32768. 32767. DISPLAY_IDENTIFIER N_DIF_PRED ECU_ADDRESS 0x3fda5e BYTE_ORDER MSB_LAST FORMAT "%6.0" /end MEASUREMENT
/begin MEASUREMENT tq_add_is_bol "Torque reserve ad idle due to deviation of engine speed to set point at idle" SWORD _CNV_A_R_LINEAR_____55_CM 1 100. -1024. 1023.96875 DISPLAY_IDENTIFIER TQ_ADD_IS_BOL ECU_ADDRESS 0x3fda58 BYTE_ORDER MSB_LAST FORMAT "%8.2" /end MEASUREMENT
/begin MEASUREMENT tq_dif_add_is_tol "Idle speed torque reserve limitation for stabilization the ISC at high torque reserves" SWORD _CNV_A_R_LINEAR_____55_CM 1 100. -1024. 1023.96875 DISPLAY_IDENTIFIER TQ_DIF_ADD_IS_TOL ECU_ADDRESS 0x3fda5a BYTE_ORDER MSB_LAST FORMAT "%8.2" /end MEASUREMENT
/begin CHARACTERISTIC c_tq_add_is_bol_crlc "Filter constant for torque reserve" VALUE 0xffe4098b _REC_VAL_20_u1 0.9960940000000002 _CNV_A_R_LINEAR_____50_CM 0. 0.996094 DISPLAY_IDENTIFIER C_TQ_ADD_IS_BOL_CRLC FORMAT "%5.3" /end CHARACTERISTIC
/begin CHARACTERISTIC c_tq_dif_add_is_tol "Idle speed torque reserve limitation for stabilizing the ISC at high torque reserve" VALUE 0xffe41ad2 _REC_VAL_20_u2 1023.96875 _CNV_A_R_LINEAR_____55_CM 0. 1023.96875 DISPLAY_IDENTIFIER C_TQ_DIF_ADD_IS_TOL FORMAT "%7.2" /end CHARACTERISTIC
/begin AXIS_PTS ldp_maf_lgrd_tq_add_is_bol "" 0xffe50e9e maf _REC_AXS_20_u2 1389. _CNV_A_R_LINEAR_____108_CM 6 0. 1389. DISPLAY_IDENTIFIER LDP_MAF_LGRD_TQ_ADD_IS_BOL FORMAT "%7.2" /end AXIS_PTS
/begin AXIS_PTS ldp_n_sp_is_tq_add_is_bol_bas "" 0xffe51148 n_sp_is _REC_AXS_20_u2 8160. _CNV_A_R_LINEAR_____10_CM 6 0. 8160. DISPLAY_IDENTIFIER LDP_N_SP_IS_TQ_ADD_IS_BOL_BAS FORMAT "%4.0" /end AXIS_PTS
/begin AXIS_PTS ldp_n_lgrd_tq_add_is_bol "" 0xffe510c6 n _REC_AXS_20_u2 8160. _CNV_A_R_LINEAR_____10_CM 6 0. 8160. DISPLAY_IDENTIFIER LDP_N_LGRD_TQ_ADD_IS_BOL FORMAT "%4.0" /end AXIS_PTS
/begin CHARACTERISTIC ip_fac_tq_add_is_bol_dri "Factor for basis torque reserve at idle due to N_DIF_PRED and load with drive" MAP 0xffe4596c _REC_MAP_20_u1_u2_u2 7.96875 _CNV_A_R_LINEAR_____48_CM 0. 7.96875 DISPLAY_IDENTIFIER IP_FAC_TQ_ADD_IS_BOL_DRI FORMAT "%5.3"
 /begin AXIS_DESCR COM_AXIS n_dif_pred_pl_drof _CNV_A_R_LINEAR_____207_CM 8 -32768. 32767. FORMAT "%6.0" AXIS_PTS_REF ldpm_n_dif_pred_fac_tq_add_is /end AXIS_DESCR
 /begin AXIS_DESCR COM_AXIS maf _CNV_A_R_LINEAR_____108_CM 6 0. 1389. FORMAT "%7.2" AXIS_PTS_REF ldpm_maf_fac_tq_add_is /end AXIS_DESCR
/end CHARACTERISTIC
/begin CHARACTERISTIC ip_tq_add_is_bol_bas "Basis torque reserve at idle." MAP 0xffe4f966 _REC_MAP_20_u2_u2_u1 1023.96875 _CNV_A_R_LINEAR_____55_CM 0. 1023.96875 DISPLAY_IDENTIFIER IP_TQ_ADD_IS_BOL_BAS FORMAT "%7.2"
 /begin AXIS_DESCR COM_AXIS n_sp_is _CNV_A_R_LINEAR_____10_CM 6 0. 8160. FORMAT "%4.0" AXIS_PTS_REF ldp_n_sp_is_tq_add_is_bol_bas /end AXIS_DESCR
 /begin AXIS_DESCR COM_AXIS tco _CNV_A_R_LINEAR_____11_CM 6 -48. 142.5 FORMAT "%5.1" AXIS_PTS_REF ldp_tco_tq_add_is_bol_bas /end AXIS_DESCR
/end CHARACTERISTIC
/begin CHARACTERISTIC ip_lgrd_tq_add_is_bol "Gradient for decrementation of the torque reserve at idle" MAP 0xffe46c14 _REC_MAP_20_u1_u2_u2 7.96875 _CNV_A_R_LINEAR_____55_CM 0. 7.96875 DISPLAY_IDENTIFIER IP_LGRD_TQ_ADD_IS_BOL_BAS FORMAT "%4.3"
 /begin AXIS_DESCR COM_AXIS n _CNV_A_R_LINEAR_____10_CM 6 0. 8160. FORMAT "%4.0" AXIS_PTS_REF ldp_n_lgrd_tq_add_is_bol /end AXIS_DESCR
 /begin AXIS_DESCR COM_AXIS maf _CNV_A_R_LINEAR_____108_CM 6 0. 1389. FORMAT "%7.2" AXIS_PTS_REF ldp_maf_lgrd_tq_add_is_bol /end AXIS_DESCR
/end CHARACTERISTIC
/begin CHARACTERISTIC ip_t_n_dif_ofs_pred_cs__n "Time constant for calculation of predicted engine speed deviation at drive-off-support" CURVE 0xffe40e48 _REC_CUR_20_u1_u2 7.96875 _CNV_A_R_LINEAR_____218_CM 0. 7.96875 DISPLAY_IDENTIFIER IP_T_N_DIF_OFS_PRED_CS__N FORMAT "%4.2"
 /begin AXIS_DESCR COM_AXIS n _CNV_A_R_LINEAR_____10_CM 8 0. 8160. FORMAT "%4.0" AXIS_PTS_REF ldpm_n_t_n_dif_ofs_pred /end AXIS_DESCR
/end CHARACTERISTIC
/begin AXIS_PTS ldpm_maf_fac_tq_add_is "" 0xffe51956 maf _REC_AXS_20_u2 1389. _CNV_A_R_LINEAR_____108_CM 6 0. 1389. DISPLAY_IDENTIFIER LDPM_MAF_FAC_TQ_ADD_IS FORMAT "%7.2" /end AXIS_PTS
/begin CHARACTERISTIC ip_fac_tq_add_is_bol_cs "Factor for basis torque reserve at idle due to N_DIF_PRED and load for drive-off-support" MAP 0xffe4593c _REC_MAP_20_u1_u2_u2 7.96875 _CNV_A_R_LINEAR_____48_CM 0. 7.96875 DISPLAY_IDENTIFIER IP_FAC_TQ_ADD_IS_BOL_CS FORMAT "%5.3"
 /begin AXIS_DESCR COM_AXIS n_dif_pred_pl_drof _CNV_A_R_LINEAR_____207_CM 8 -32768. 32767. FORMAT "%6.0" AXIS_PTS_REF ldpm_n_dif_pred_fac_tq_add_is /end AXIS_DESCR
 /begin AXIS_DESCR COM_AXIS maf _CNV_A_R_LINEAR_____108_CM 6 0. 1389. FORMAT "%7.2" AXIS_PTS_REF ldpm_maf_fac_tq_add_is /end AXIS_DESCR
/end CHARACTERISTIC
/begin MEASUREMENT t_n_dif_ofs_pred_cs "Prediction time for engine speed difference at drive-off-support" UBYTE _CNV_A_R_LINEAR_____218_CM 1 100. 0. 7.96875 DISPLAY_IDENTIFIER T_N_DIF_OFS_PRED_CS ECU_ADDRESS 0x3fe8e1 FORMAT "%4.2" /end MEASUREMENT
/begin MEASUREMENT n_dif_ofs_pred_cs "Predicted engine speed difference for torque reserve calculation at drive-off-support" SWORD _CNV_A_R_LINEAR_____10_CM 1 100. -32768. 32767. DISPLAY_IDENTIFIER N_DIF_OFS_PRED_CS ECU_ADDRESS 0x3fda64 BYTE_ORDER MSB_LAST FORMAT "%6.0" /end MEASUREMENT
/begin MEASUREMENT n_dif_pred_cs "Predicted idle speed control variable at drive-off-support" SWORD _CNV_A_R_LINEAR_____10_CM 1 100. -32768. 32767. DISPLAY_IDENTIFIER N_DIF_PRED_CS ECU_ADDRESS 0x3fda60 BYTE_ORDER MSB_LAST FORMAT "%6.0" /end MEASUREMENT
/begin MEASUREMENT fac_tq_add_is_bol "Resulting factor for IP_TQ_ADD_IS_BOL_BAS" UBYTE _CNV_A_R_LINEAR_____48_CM 1 100. 0. 7.96875 DISPLAY_IDENTIFIER FAC_TQ_ADD_IS_BOL ECU_ADDRESS 0x3fe8e2 FORMAT "%5.3" /end MEASUREMENT
/begin CHARACTERISTIC ip_fac_tq_add_is_bol "Factor for basis torque reserve at idle due to N_DIF_PRED and load without drive" MAP 0xffe4590c _REC_MAP_20_u1_u2_u2 7.96875 _CNV_A_R_LINEAR_____48_CM 0. 7.96875 DISPLAY_IDENTIFIER IP_FAC_TQ_ADD_IS_BOL FORMAT "%5.3"
 /begin AXIS_DESCR COM_AXIS n_dif_pred_pl_drof _CNV_A_R_LINEAR_____207_CM 8 -32768. 32767. FORMAT "%6.0" AXIS_PTS_REF ldpm_n_dif_pred_fac_tq_add_is /end AXIS_DESCR
 /begin AXIS_DESCR COM_AXIS maf _CNV_A_R_LINEAR_____108_CM 6 0. 1389. FORMAT "%7.2" AXIS_PTS_REF ldpm_maf_fac_tq_add_is /end AXIS_DESCR
/end CHARACTERISTIC
/begin CHARACTERISTIC ip_fac_temp_tq_add_is_bas "Temperature correction for IP_TQ_ADD_IS_BOL_BAS" MAP 0xffe45718 _REC_MAP_20_u1_u1_u1 1.9921875 _CNV_A_R_LINEAR_____117_CM 0. 1.9921875 DISPLAY_IDENTIFIER IP_FAC_TEMP_TQ_ADD_IS_BAS FORMAT "%5.3"
 /begin AXIS_DESCR COM_AXIS tia _CNV_A_R_LINEAR_____11_CM 6 -48. 142.5 FORMAT "%5.1" AXIS_PTS_REF ldp_tia_ip_fac_temp_tq_add_is /end AXIS_DESCR
 /begin AXIS_DESCR COM_AXIS toil _CNV_A_R_LINEAR_____14_CM 6 -40. 160. FORMAT "%3.0" AXIS_PTS_REF ldp_toil_ip_fac_temp_tq_add_is /end AXIS_DESCR
/end CHARACTERISTIC
/begin AXIS_PTS ldp_tco_tq_add_is_bol_bas "" 0xffe41249 tco _REC_AXS_20_u1 190.5 _CNV_A_R_LINEAR_____11_CM 6 -48. 142.5 DISPLAY_IDENTIFIER LDP_TCO_TQ_ADD_IS_BOL_BAS FORMAT "%5.1" /end AXIS_PTS
/begin AXIS_PTS ldp_tia_ip_fac_temp_tq_add_is "" 0xffe4128c tia _REC_AXS_20_u1 190.5 _CNV_A_R_LINEAR_____11_CM 6 -48. 142.5 DISPLAY_IDENTIFIER LDP_TIA_IP_FAC_TEMP_TQ_ADD_IS FORMAT "%5.1" /end AXIS_PTS
/begin AXIS_PTS ldp_toil_ip_fac_temp_tq_add_is "" 0xffe412c3 toil _REC_AXS_20_u1 200. _CNV_A_R_LINEAR_____14_CM 6 -40. 160. DISPLAY_IDENTIFIER LDP_TOIL_IP_FAC_TEMP_TQ_ADD_IS FORMAT "%3.0" /end AXIS_PTS
/begin CHARACTERISTIC c_fac_tq_is_ad_conv_max "Max. limitation for converter torque Adaptation factor" VALUE 0xffe40404 _REC_VAL_20_s2 4.879900000000001e-004 _CNV_A_R_LINEAR_____219_CM -2.44e-004 2.4399e-004 DISPLAY_IDENTIFIER C_FAC_TQ_IS_AD_CONV_MAX FORMAT "%10.9" /end CHARACTERISTIC
/begin CHARACTERISTIC c_fac_tq_is_ad_conv_min "Min. limitation of converter torque Adaptation factor" VALUE 0xffe40406 _REC_VAL_20_s2 4.879900000000001e-004 _CNV_A_R_LINEAR_____219_CM -2.44e-004 2.4399e-004 DISPLAY_IDENTIFIER C_FAC_TQ_IS_AD_CONV_MIN FORMAT "%10.9" /end CHARACTERISTIC
/begin CHARACTERISTIC c_tq_is_ad_acc_min "Min. limitation for ACC Adaptation" VALUE 0xffe404ca _REC_VAL_20_s2 2047.96875 _CNV_A_R_LINEAR_____55_CM -1024. 1023.96875 DISPLAY_IDENTIFIER C_TQ_IS_AD_ACC_MIN FORMAT "%7.1" /end CHARACTERISTIC
/begin CHARACTERISTIC c_tq_is_ad_max "Max. limitation of engine torque losses Adaptation" VALUE 0xffe404d0 _REC_VAL_20_s2 2047.96875 _CNV_A_R_LINEAR_____55_CM -1024. 1023.96875 DISPLAY_IDENTIFIER C_TQ_IS_AD_MAX FORMAT "%7.1" /end CHARACTERISTIC
/begin CHARACTERISTIC c_tq_is_ad_min "Min. limitation of engine torque losses Adaptation" VALUE 0xffe404d2 _REC_VAL_20_s2 2047.96875 _CNV_A_R_LINEAR_____55_CM -1024. 1023.96875 DISPLAY_IDENTIFIER C_TQ_IS_AD_MIN FORMAT "%7.1" /end CHARACTERISTIC
/begin MEASUREMENT fac_tq_is_ad_conv "Converter torque Adaptation factor" SWORD _CNV_A_R_LINEAR_____220_CM 1 100. -2.4414e-004 2.4414e-004 DISPLAY_IDENTIFIER FAC_TQ_IS_AD_CONV ECU_ADDRESS 0x3fda68 BYTE_ORDER MSB_LAST FORMAT "%9.8" /end MEASUREMENT
/begin CHARACTERISTIC c_fac_tq_is_ad_acc "Calibration parameter, LV_ACC=1" VALUE 0xffe41636 _REC_VAL_20_u2 0.99998474 _CNV_A_R_LINEAR_____37_CM 0. 0.99998474 DISPLAY_IDENTIFIER C_FAC_TQ_IS_AD_ACC FORMAT "%7.5" /end CHARACTERISTIC
/begin CHARACTERISTIC c_fac_tq_is_ad_conv "Calibration parameter, LV_ACC=0, LV_DRI=1" VALUE 0xffe4163a _REC_VAL_20_u2 4.88e-004 _CNV_A_R_LINEAR_____221_CM 0. 4.88e-004 DISPLAY_IDENTIFIER C_FAC_TQ_IS_AD_CONV FORMAT "%10.9" /end CHARACTERISTIC
/begin CHARACTERISTIC c_fac_tq_is_ad_acc_conv "Calibration parameter, LV_ACC=1, LV_DRI=1" VALUE 0xffe41638 _REC_VAL_20_u2 0.99998474 _CNV_A_R_LINEAR_____37_CM 0. 0.99998474 DISPLAY_IDENTIFIER C_FAC_TQ_IS_AD_ACC_CONV FORMAT "%7.5" /end CHARACTERISTIC
/begin CHARACTERISTIC c_tq_is_ad_acc_max "Max. limitation for ACC torque Adaptation" VALUE 0xffe404c8 _REC_VAL_20_s2 2047.96875 _CNV_A_R_LINEAR_____55_CM -1024. 1023.96875 DISPLAY_IDENTIFIER C_TQ_IS_AD_ACC_MAX FORMAT "%7.1" /end CHARACTERISTIC
/begin CHARACTERISTIC c_tq_is_ad_acc_conv_max "Max. limitation of air conditioning compressor and converter  torque Adaptation" VALUE 0xffe404c4 _REC_VAL_20_s2 2047.96875 _CNV_A_R_LINEAR_____55_CM -1024. 1023.96875 DISPLAY_IDENTIFIER C_TQ_IS_AD_ACC_CONV_MAX FORMAT "%7.1" /end CHARACTERISTIC
/begin CHARACTERISTIC c_tq_is_ad_acc_conv_min "Min. limitation of air conditioning compressor and converter  torque Adaptation" VALUE 0xffe404c6 _REC_VAL_20_s2 2047.96875 _CNV_A_R_LINEAR_____55_CM -1024. 1023.96875 DISPLAY_IDENTIFIER C_TQ_IS_AD_ACC_CONV_MIN FORMAT "%7.1" /end CHARACTERISTIC
/begin MEASUREMENT tq_dif_is_ad_acc_1 "ACC torque Adaptation" SWORD _CNV_A_R_LINEAR_____55_CM 1 100. -1024. 1023.96875 DISPLAY_IDENTIFIER TQ_DIF_IS_AD_ACC_1 ECU_ADDRESS 0x3fda70 BYTE_ORDER MSB_LAST FORMAT "%6.2" /end MEASUREMENT
/begin MEASUREMENT tq_dif_is_ad_acc_conv "ACC and converter torque Adaptation" SWORD _CNV_A_R_LINEAR_____55_CM 1 100. -1024. 1023.96875 DISPLAY_IDENTIFIER TQ_DIF_IS_AD_ACC_CONV ECU_ADDRESS 0x3fda6e BYTE_ORDER MSB_LAST FORMAT "%6.2" /end MEASUREMENT
/begin MEASUREMENT tq_dif_is_ad "Basic ISC Adaptation" SWORD _CNV_A_R_LINEAR_____55_CM 1 100. -1024. 1023.96875 DISPLAY_IDENTIFIER TQ_DIF_IS_AD ECU_ADDRESS 0x3fda66 BYTE_ORDER MSB_LAST FORMAT "%6.2" /end MEASUREMENT
/begin MEASUREMENT tq_dif_is_ad_inter "Basic ISC Adaptation, inetmediate value with high resolution (long signed word)" SLONG _CNV_A_R_LINEAR_____222_CM 1 100. -1024. 1023.99999952 DISPLAY_IDENTIFIER TQ_DIF_IS_AD_INTER ECU_ADDRESS 0x3fcfc8 BYTE_ORDER MSB_LAST FORMAT "%12.7" /end MEASUREMENT
/begin MEASUREMENT tq_dif_is_ad_acc_1_inter "Torque ACC Adaptation, inetmediate value with high resolution (long signed word)" SLONG _CNV_A_R_LINEAR_____222_CM 1 100. -1024. 1023.99999952 DISPLAY_IDENTIFIER TQ_DIF_IS_AD_ACC_1_INTER ECU_ADDRESS 0x3fcfcc BYTE_ORDER MSB_LAST FORMAT "%12.7" /end MEASUREMENT
/begin MEASUREMENT tq_dif_is_ad_acc_conv_inter "ACC and torque Adaptation, inetmediate value with high resolution (long signed word)" SLONG _CNV_A_R_LINEAR_____222_CM 1 100. -1024. 1023.99999952 DISPLAY_IDENTIFIER TQ_DIF_IS_AD_ACC_CONV_INTER ECU_ADDRESS 0x3fcfd0 BYTE_ORDER MSB_LAST FORMAT "%12.7" /end MEASUREMENT
/begin CHARACTERISTIC c_fac_tq_is_ad "Calibration parameter, LV_ACC=0, LV_DRI=0" VALUE 0xffe41634 _REC_VAL_20_u2 0.99998474 _CNV_A_R_LINEAR_____37_CM 0. 0.99998474 DISPLAY_IDENTIFIER C_FAC_TQ_IS_AD FORMAT "%7.5" /end CHARACTERISTIC
/begin MEASUREMENT tq_dif_is_ad_acc "Low-pass filtered ACC torque Adaptation or ACC and converter torque Adaptation" SWORD _CNV_A_R_LINEAR_____55_CM 1 100. -1024. 1023.96875 DISPLAY_IDENTIFIER TQ_DIF_IS_AD_ACC ECU_ADDRESS 0x3fda6a BYTE_ORDER MSB_LAST FORMAT "%6.2" /end MEASUREMENT
/begin CHARACTERISTIC c_crlc_tq_dif_is_ad_acc "Filter constant for LOW_PASS_1" VALUE 0xffe40695 _REC_VAL_20_u1 0.9960940000000002 _CNV_A_R_LINEAR_____50_CM 0. 0.996094 DISPLAY_IDENTIFIER C_CRLC_TQ_DIF_IS_AD_ACC FORMAT "%5.3" /end CHARACTERISTIC
/begin CHARACTERISTIC c_fac_tq_is_ad_conv_can "Calibration parameter, LV_ACC = 0 AND LV_DRI= 1" VALUE 0xffe4163c _REC_VAL_20_u2 0.99998474 _CNV_A_R_LINEAR_____37_CM 0. 0.99998474 DISPLAY_IDENTIFIER C_FAC_TQ_IS_AD_CONV_CAN FORMAT "%7.5" /end CHARACTERISTIC
/begin MEASUREMENT tq_dif_is_ad_conv "Converter torque Adaptation" SWORD _CNV_A_R_LINEAR_____55_CM 1 100. -1024. 1023.96875 DISPLAY_IDENTIFIER TQ_DIF_IS_AD_CONV ECU_ADDRESS 0x3fda6c BYTE_ORDER MSB_LAST FORMAT "%8.2" /end MEASUREMENT
/begin MEASUREMENT tq_dif_is_ad_conv_inter "Converter torque Adaptation, intermediate value with high resolution (long signed word)" SLONG _CNV_A_R_LINEAR_____222_CM 1 100. -1024. 1023.99999952 DISPLAY_IDENTIFIER TQ_DIF_IS_AD_CONV_INTER ECU_ADDRESS 0x3fcfd4 BYTE_ORDER MSB_LAST FORMAT "%12.7" /end MEASUREMENT
/begin CHARACTERISTIC c_tq_is_ad_conv_can_min "Min. limitation converter torque adaptation" VALUE 0xffe404ce _REC_VAL_20_s2 2047.96875 _CNV_A_R_LINEAR_____55_CM -1024. 1023.96875 DISPLAY_IDENTIFIER C_TQ_IS_AD_CONV_CAN_MIN FORMAT "%8.2" /end CHARACTERISTIC
/begin CHARACTERISTIC c_tq_is_ad_conv_can_max "Max. limitation converter torque adaptation" VALUE 0xffe404cc _REC_VAL_20_s2 2047.96875 _CNV_A_R_LINEAR_____55_CM -1024. 1023.96875 DISPLAY_IDENTIFIER C_TQ_IS_AD_CONV_CAN_MAX FORMAT "%8.2" /end CHARACTERISTIC
/begin CHARACTERISTIC c_n_delta "engine speed threshold for ISC Adaptation" VALUE 0xffe417ee _REC_VAL_20_u2 8160. _CNV_A_R_LINEAR_____10_CM 0. 8160. DISPLAY_IDENTIFIER C_N_DELTA FORMAT "%4.0" /end CHARACTERISTIC
/begin CHARACTERISTIC c_tco_ad_min_is "temperature bottom limit for ISC Adaptation" VALUE 0xffe408ea _REC_VAL_20_u1 28.575 _CNV_A_R_LINEAR_____11_CM -48. 142.5 DISPLAY_IDENTIFIER C_TCO_AD_MIN_IS FORMAT "%5.1" /end CHARACTERISTIC
/begin MEASUREMENT lv_is_ad_cnd "Adaptation Condition" UBYTE _CNV_S_2_RANGE______2_CM 1 100. 0. 1. DISPLAY_IDENTIFIER LV_IS_AD_CND ECU_ADDRESS 0x3fe8c5 BIT_MASK 0x1 /end MEASUREMENT
/begin MEASUREMENT lv_tco_ad_cnd_is "Logical bit \"Coolant temperature in operating range\"" UBYTE _CNV_S_2_RANGE______2_CM 1 100. 0. 1. DISPLAY_IDENTIFIER LV_TCO_AD_CND_IS ECU_ADDRESS 0x3fe8c6 /end MEASUREMENT
/begin MEASUREMENT lv_dly_ad_is "Logical bit \"Idle speed has settled for a given time delay\"" UBYTE _CNV_S_2_RANGE______2_CM 1 100. 0. 1. DISPLAY_IDENTIFIER LV_DLY_AD_IS ECU_ADDRESS 0x3fe8c7 /end MEASUREMENT
/begin CHARACTERISTIC c_tco_ad_max_is "temperature top limit for ISC Adaptation" VALUE 0xffe408e9 _REC_VAL_20_u1 28.575 _CNV_A_R_LINEAR_____11_CM -48. 142.5 DISPLAY_IDENTIFIER C_TCO_AD_MAX_IS FORMAT "%5.1" /end CHARACTERISTIC
/begin CHARACTERISTIC c_dly_is_ad "time delay for ISC Adaptation" VALUE 0xffe40713 _REC_VAL_20_u1 255. _CNV_A_R_LINEAR_____196_CM 0. 255. DISPLAY_IDENTIFIER C_DLY_IS_AD FORMAT "%3.0" /end CHARACTERISTIC
/begin MEASUREMENT lv_is_ad_inh_obd "Application incidence value" UBYTE _CNV_S_2_RANGE______2_CM 1 100. 0. 1. DISPLAY_IDENTIFIER LV_IS_AD_INH_OBD ECU_ADDRESS 0x3fe8c9 /end MEASUREMENT
/begin MEASUREMENT lv_is_ad_inh "Application incidence value (additional adaptation conditions, project specific)" UBYTE _CNV_S_2_RANGE______2_CM 1 100. 0. 1. DISPLAY_IDENTIFIER LV_IS_AD_INH ECU_ADDRESS 0x3fe8ca /end MEASUREMENT
/begin MEASUREMENT lam_bank_1.fsd_obd2.t_sum_max_fsd "Total duration over C_LAM_MAX_FSD" UWORD _CNV_A_R_LINEAR_____198_CM 1 100. 0. 1310.7 DISPLAY_IDENTIFIER T_SUM_MAX_FSD_1 ECU_ADDRESS 0x3fc284 BYTE_ORDER MSB_LAST FORMAT "%7.2" /end MEASUREMENT
/begin MEASUREMENT lam_bank_1.fsd_obd2.t_sum_min_fsd "Total duration over C_LAM_MIN_FSD" UWORD _CNV_A_R_LINEAR_____198_CM 1 100. 0. 1310.7 DISPLAY_IDENTIFIER T_SUM_MIN_FSD_1 ECU_ADDRESS 0x3fc288 BYTE_ORDER MSB_LAST FORMAT "%7.2" /end MEASUREMENT
/begin MEASUREMENT lam_bank_1.fsd_obd2.t_sum_end_diag_win_fsd "Time counter to set LV_END_DIAG_FSD_i" UWORD _CNV_A_R_LINEAR_____198_CM 1 100. 0. 1310.7 DISPLAY_IDENTIFIER T_SUM_END_DIAG_WIN_FSD_1 ECU_ADDRESS 0x3fc28c BYTE_ORDER MSB_LAST FORMAT "%7.2" /end MEASUREMENT
/begin MEASUREMENT lam_bank_1.fsd_obd2.t_sum_rst_fsd "Time counter to reset T_SUM_MAX_FSD_i and T_SUM_MIN_FSD_i" UWORD _CNV_A_R_LINEAR_____198_CM 1 100. 0. 1310.7 DISPLAY_IDENTIFIER T_SUM_RST_FSD_1 ECU_ADDRESS 0x3fc28e BYTE_ORDER MSB_LAST FORMAT "%7.2" /end MEASUREMENT
/begin MEASUREMENT lam_bank_1.ls_down_obd2.bf.lv_ls_down_swt_vld "Validity bit of the current switching time check" ULONG _CNV_S_2_RANGE______2_CM 1 100. 0. 1. DISPLAY_IDENTIFIER LV_LS_DOWN_SWT_VLD_1 ECU_ADDRESS 0x3fc484 BYTE_ORDER MSB_LAST BIT_MASK 0x80000000 /end MEASUREMENT
/begin MEASUREMENT lam_bank_1.ls_down_obd2.bf.lv_ls_down_pue_vld "Debounced diagnosis result of pull end plausibility" ULONG _CNV_S_2_RANGE______2_CM 1 100. 0. 1. DISPLAY_IDENTIFIER LV_LS_DOWN_PUE_VLD_1 ECU_ADDRESS 0x3fc484 BYTE_ORDER MSB_LAST BIT_MASK 0x40000000 /end MEASUREMENT
/begin MEASUREMENT lam_bank_1.ls_down_obd2.bf.lv_cdn_diag_ls_down "Status of permission for diagnosis" ULONG _CNV_S_2_RANGE______2_CM 1 100. 0. 1. DISPLAY_IDENTIFIER LV_CDN_DIAG_LS_DOWN_1 ECU_ADDRESS 0x3fc484 BYTE_ORDER MSB_LAST BIT_MASK 0x20000000 /end MEASUREMENT
/begin MEASUREMENT lam_bank_1.ls_down_obd2.cycnr_vls_down_act "Cycle counter for switching time determination, Bank i" UBYTE _CNV_A_R_LINEAR_____313_CM 1 100. 0. 5100. DISPLAY_IDENTIFIER CYCNR_VLS_DOWN_ACT_1 ECU_ADDRESS 0x3fc48e FORMAT "%5.0" /end MEASUREMENT
/begin MEASUREMENT lam_bank_1.ls_down_obd2.ctr_vls_down_diag "Number of valid switching times from rich to lean" UBYTE _CNV_A_R_LINEAR_____0_CM 1 100. 0. 255. DISPLAY_IDENTIFIER CTR_VLS_DOWN_DIAG_1 ECU_ADDRESS 0x3fc492 FORMAT "%3.0" /end MEASUREMENT
/begin MEASUREMENT lam_bank_1.ls_down_obd2.vls_down_tran_puc "Monitor sensor voltage on activating the trailing throttle fuel cut-off, Bank i " UWORD _CNV_A_R_LINEAR_____3_CM 1 100. 0. 4.99511719 DISPLAY_IDENTIFIER VLS_DOWN_TRAN_PUC_1 ECU_ADDRESS 0x3fc48a BYTE_ORDER MSB_LAST FORMAT "%5.3" /end MEASUREMENT
/begin MEASUREMENT lam_bank_1.ls_down_obd2.ctr_cycnr_quo_vls_down_sum "Sum of weighted CYCNR_VLS_DOWN_ACT_i, Bank i " UWORD _CNV_A_R_LINEAR_____125_CM 1 100. 0. 255.996094 DISPLAY_IDENTIFIER CTR_CYCNR_QUO_VLS_DOWN_SUM_1 ECU_ADDRESS 0x3fc494 BYTE_ORDER MSB_LAST FORMAT "%7.3" /end MEASUREMENT
/begin MEASUREMENT lam_bank_1.ls_down_obd2.cycnr_ratio_vls_down "mean value of the ratio between the monitor sensor switching time and the threshold value" UBYTE _CNV_A_R_LINEAR_____39_CM 1 100. 0. 1.99220002 DISPLAY_IDENTIFIER CYCNR_RATIO_VLS_DOWN_1 ECU_ADDRESS 0x3fc496 FORMAT "%5.3" /end MEASUREMENT
/begin MEASUREMENT lam_bank_1.ls_down_obd2.cycnr_sae_ratio_vls_down "mean value of the ratio between the monitor sensor switching time and the threshold value for scantool" UBYTE _CNV_A_R_LINEAR_____39_CM 1 100. 0. 1.99220002 DISPLAY_IDENTIFIER CYCNR_SAE_RATIO_VLS_DOWN_1 ECU_ADDRESS 0x3fc497 FORMAT "%5.3" /end MEASUREMENT
/begin MEASUREMENT lam_bank_1.ls_down_obd2.cycnr_quo_vls_down "weighted value of CYCNR_VLS_DOWN_ACT_i " UWORD _CNV_A_R_LINEAR_____125_CM 1 100. 0. 255.996094 DISPLAY_IDENTIFIER CYCNR_QUO_VLS_DOWN_1 ECU_ADDRESS 0x3fc490 BYTE_ORDER MSB_LAST FORMAT "%7.3" /end MEASUREMENT
/begin MEASUREMENT lam_bank_1.ls_down_obd2.vls_down_pue "Monitor sensor voltage at the time of leaving PUC, Bank i (i=1.2)" UWORD _CNV_A_R_LINEAR_____3_CM 1 100. 0. 4.99511719 DISPLAY_IDENTIFIER VLS_DOWN_PUE_1 ECU_ADDRESS 0x3fc49a BYTE_ORDER MSB_LAST FORMAT "%5.3" /end MEASUREMENT
/begin MEASUREMENT lam_bank_1.ls_down_obd2.ctr_end_diag_ls_down_pue "Time counter to set LV_END_DIAG_VLS_DOWN_PUE_i" UWORD _CNV_A_R_LINEAR_____0_CM 1 100. 0. 65535. DISPLAY_IDENTIFIER CTR_END_DIAG_LS_DOWN_PUE_1 ECU_ADDRESS 0x3fc4a0 BYTE_ORDER MSB_LAST FORMAT "%5.0" /end MEASUREMENT
/begin MEASUREMENT lam_bank_1.ls_down_obd2.vls_down_dif_diag "difference of VLS_DOWN values from the beginning to the end of the MAF_INT_PUE calculation" UWORD _CNV_A_R_LINEAR_____3_CM 1 100. 0. 4.99511719 DISPLAY_IDENTIFIER VLS_DOWN_DIF_DIAG_1 ECU_ADDRESS 0x3fc49c BYTE_ORDER MSB_LAST FORMAT "%5.3" /end MEASUREMENT
/begin MEASUREMENT lam_bank_1.ls_down_obd2.vls_sae_down_dif_diag "difference of VLS_DOWN values from the beginning to the end of the MAF_INT_PUE calculation for scantool" UWORD _CNV_A_R_LINEAR_____3_CM 1 100. 0. 4.99511719 DISPLAY_IDENTIFIER VLS_SAE_DOWN_DIF_DIAG_1 ECU_ADDRESS 0x3fc49e BYTE_ORDER MSB_LAST FORMAT "%5.3" /end MEASUREMENT
/begin MEASUREMENT lam_bank_1.ls_down_obd2.ctr_ls_down_pue "counter for anti-bounce" UBYTE _CNV_A_R_LINEAR_____0_CM 1 100. 0. 255. DISPLAY_IDENTIFIER CTR_LS_DOWN_PUE_1 ECU_ADDRESS 0x3fc4a2 FORMAT "%3.0" /end MEASUREMENT
/begin MEASUREMENT lam_bank_1.cat_eff_act.lv_ls_cat_diag_cdn "Activation condidtions for O2 sensor and catalyst efficiency diagnosis" UBYTE _CNV_S_2_RANGE______2_CM 1 100. 0. 1. DISPLAY_IDENTIFIER LV_LS_CAT_DIAG_CDN_1 ECU_ADDRESS 0x3fc55e /end MEASUREMENT
/begin MEASUREMENT lam_bank_1.cat_eff_act.maf_int_cat_diag_dly "Air mass flow integral after conditions fulfilled for cat diag activation" UWORD _CNV_A_R_LINEAR_____316_CM 1 100. 0. 1820.42 DISPLAY_IDENTIFIER MAF_INT_CAT_DIAG_DLY_1 ECU_ADDRESS 0x3fc55c BYTE_ORDER MSB_LAST FORMAT "%7.2" /end MEASUREMENT
/begin MEASUREMENT lam_bank_1.cat_eff_inci.lv_inh_diag_cat_diag "" UBYTE _CNV_S_2_RANGE______2_CM 1 100. 0. 1. DISPLAY_IDENTIFIER LV_INH_DIAG_CAT_DIAG_1 ECU_ADDRESS 0x3fc560 /end MEASUREMENT
/begin MEASUREMENT lam_bank_1.cat_eff_inci.t_vls_cyc_efc "" UWORD _CNV_A_R_LINEAR_____4_CM 1 100. 0. 655.35 DISPLAY_IDENTIFIER T_VLS_CYC_EFC_1 ECU_ADDRESS 0x3fc564 BYTE_ORDER MSB_LAST FORMAT "%5.2" /end MEASUREMENT
/begin MEASUREMENT lam_bank_1.cat_eff_inci.lv_auth_cat_diag "" UBYTE _CNV_S_2_RANGE______2_CM 1 100. 0. 1. DISPLAY_IDENTIFIER LV_AUTH_CAT_DIAG_1 ECU_ADDRESS 0x3fc562 /end MEASUREMENT
/begin MEASUREMENT lam_bank_1.cat_eff_inci.vls_cyc_step "state-counter for several phases of a rich-lean-cycle" UBYTE _CNV_S_5_RANGE_U8_S_317_CM 1 100. 0. 255. DISPLAY_IDENTIFIER VLS_CYC_STEP_1 ECU_ADDRESS 0x3fc566 /end MEASUREMENT
/begin MEASUREMENT lam_bank_1.cat_eff_ldc_obd2.lv_ldc_cat "" UBYTE _CNV_S_2_RANGE______2_CM 1 100. 0. 1. DISPLAY_IDENTIFIER LV_LDC_CAT_1 ECU_ADDRESS 0x3fc247 /end MEASUREMENT
/begin MEASUREMENT lam_bank_1.cat_eff_ldc_obd2.maf_int_ldc_cat "integral of mass air flow since limited dynamic conditions fulfilled" UWORD _CNV_A_R_LINEAR_____287_CM 1 100. 0. 1820.398 DISPLAY_IDENTIFIER MAF_INT_LDC_CAT_1 ECU_ADDRESS 0x3fc240 BYTE_ORDER MSB_LAST FORMAT "%7.2" /end MEASUREMENT
/begin MEASUREMENT lam_bank_1.cat_eff_ldc_obd2.pv_av_grd_sum "su. value for limited PV_AV gradient" UWORD _CNV_A_R_LINEAR_____318_CM 1 100. 0. 639990.2340000001 DISPLAY_IDENTIFIER PV_AV_GRD_SUM_1 ECU_ADDRESS 0x3fc242 BYTE_ORDER MSB_LAST FORMAT "%8.1" /end MEASUREMENT
/begin MEASUREMENT lam_bank_1.cat_eff_ldc_obd2.lam_mv_mmv_cat "floating mean value for limited lambda deviation" SWORD _CNV_A_R_LINEAR_____111_CM 1 100. -50. 49.99847412 DISPLAY_IDENTIFIER LAM_MV_MMV_CAT_1 ECU_ADDRESS 0x3fc244 BYTE_ORDER MSB_LAST FORMAT "%7.3" /end MEASUREMENT
/begin MEASUREMENT lam_bank_1.cat_eff_obd2.bf.lv_req_cat_diag "Flag passed to the OBD sequencer indicating a request to do catalyst diagnosis" ULONG _CNV_S_2_RANGE______2_CM 1 100. 0. 1. DISPLAY_IDENTIFIER LV_REQ_CAT_DIAG_1 ECU_ADDRESS 0x3fc24c BYTE_ORDER MSB_LAST BIT_MASK 0x80000000 /end MEASUREMENT
/begin MEASUREMENT lam_bank_1.cat_eff_obd2.bf.lv_cat_diag_cyc_vld "Monitoring cycle valid, used for calculation of diagnosis value" ULONG _CNV_S_2_RANGE______2_CM 1 100. 0. 1. DISPLAY_IDENTIFIER LV_CAT_DIAG_CYC_VLD_1 ECU_ADDRESS 0x3fc24c BYTE_ORDER MSB_LAST BIT_MASK 0x40000000 /end MEASUREMENT
/begin MEASUREMENT lam_bank_1.cat_eff_obd2.bf.lv_o2_cat_cyc_vld_1 "" ULONG _CNV_S_2_RANGE______2_CM 1 100. 0. 1. DISPLAY_IDENTIFIER LV_O2_CAT_CYC_VLD_1_1 ECU_ADDRESS 0x3fc24c BYTE_ORDER MSB_LAST BIT_MASK 0x10000000 /end MEASUREMENT
/begin MEASUREMENT lam_bank_1.cat_eff_obd2.bf.lv_o2_cat_cyc_vld_2 "" ULONG _CNV_S_2_RANGE______2_CM 1 100. 0. 1. DISPLAY_IDENTIFIER LV_O2_CAT_CYC_VLD_2_1 ECU_ADDRESS 0x3fc24c BYTE_ORDER MSB_LAST BIT_MASK 0x8000000 /end MEASUREMENT
/begin MEASUREMENT lam_bank_1.cat_eff_obd2.bf.lv_delta_lamb_cat_diag "flag to switch trim control parameters for OSC/NOX cat diag" ULONG _CNV_S_2_RANGE______2_CM 1 100. 0. 1. DISPLAY_IDENTIFIER LV_DELTA_LAMB_CAT_DIAG_1 ECU_ADDRESS 0x3fc24c BYTE_ORDER MSB_LAST BIT_MASK 0x2000000 /end MEASUREMENT
/begin MEASUREMENT lam_bank_1.cat_eff_obd2.bf.lv_lamb_puls_cat_diag "flag to switch forced stimulation parameters for OSC/NOX cat diag" ULONG _CNV_S_2_RANGE______2_CM 1 100. 0. 1. DISPLAY_IDENTIFIER LV_LAMB_PULS_CAT_DIAG_1 ECU_ADDRESS 0x3fc24c BYTE_ORDER MSB_LAST BIT_MASK 0x1000000 /end MEASUREMENT
/begin MEASUREMENT lam_bank_1.cat_eff_obd2.bf.lv_o2_cat_cyc_vld_3 "Third validity check O2_CAT_i for monitoring cycle" ULONG _CNV_S_2_RANGE______2_CM 1 100. 0. 1. DISPLAY_IDENTIFIER LV_O2_CAT_CYC_VLD_3_1 ECU_ADDRESS 0x3fc24c BYTE_ORDER MSB_LAST BIT_MASK 0x4000000 /end MEASUREMENT
/begin MEASUREMENT lam_bank_1.cat_eff_obd2.o2_cat_dif_sum "integral of difference downstream sensor signal to mean value through 1 diagnosis period" ULONG _CNV_A_R_LINEAR_____328_CM 1 100. 0. 1277.995125 DISPLAY_IDENTIFIER O2_CAT_DIF_SUM_1 ECU_ADDRESS 0x3fc250 BYTE_ORDER MSB_LAST FORMAT "%8.3" /end MEASUREMENT
/begin MEASUREMENT lam_bank_1.cat_eff_obd2.o2_cat_sum "integral of downstream sensor signal through 1 diagnosis period for calulation of mean value" ULONG _CNV_A_R_LINEAR_____329_CM 1 100. 0. 2555.99025 DISPLAY_IDENTIFIER O2_CAT_SUM_1 ECU_ADDRESS 0x3fc254 BYTE_ORDER MSB_LAST FORMAT "%8.3" /end MEASUREMENT
/begin MEASUREMENT lam_bank_1.cat_eff_obd2.o2_cat_mv "downstream sensor signal mean value for complete diagnosis period " UWORD _CNV_A_R_LINEAR_____330_CM 1 100. 0. 4.99511719 DISPLAY_IDENTIFIER O2_CAT_MV_1 ECU_ADDRESS 0x3fc25c BYTE_ORDER MSB_LAST FORMAT "%5.3" /end MEASUREMENT
/begin MEASUREMENT lam_bank_1.cat_eff_obd2.o2_cat_int "average deviation of downstream sensor signal to mean value through 1 diagnosis period" UWORD _CNV_A_R_LINEAR_____331_CM 1 100. 0. 4.998779 DISPLAY_IDENTIFIER O2_CAT_INT_1 ECU_ADDRESS 0x3fc25e BYTE_ORDER MSB_LAST FORMAT "%5.3" /end MEASUREMENT
/begin MEASUREMENT lam_bank_1.cat_eff_obd2.o2_cat_ratio "weighted o2_can_int_i value" UWORD _CNV_A_R_LINEAR_____332_CM 1 100. 0. 3.99609375 DISPLAY_IDENTIFIER O2_CAT_RATIO_1 ECU_ADDRESS 0x3fc260 BYTE_ORDER MSB_LAST FORMAT "%5.3" /end MEASUREMENT
/begin MEASUREMENT lam_bank_1.cat_eff_obd2.o2_cat "O2 load linearization value from downstream LS signal" UWORD _CNV_A_R_LINEAR_____330_CM 1 100. 0. 4.99511719 DISPLAY_IDENTIFIER O2_CAT_1 ECU_ADDRESS 0x3fc262 BYTE_ORDER MSB_LAST FORMAT "%5.3" /end MEASUREMENT
/begin MEASUREMENT lam_bank_1.cat_eff_obd2.state_cat_diag "" UBYTE _CNV_S_5_RANGE_STAT_333_CM 1 100. 0. 4. DISPLAY_IDENTIFIER STATE_CAT_DIAG_1 ECU_ADDRESS 0x3fc268 /end MEASUREMENT
/begin MEASUREMENT lam_bank_1.cat_eff_obd2.o2_cat_ratio_sum "total ratio between measured and max.allowed integral of downstream sensor signal" ULONG _CNV_A_R_LINEAR_____334_CM 1 100. 0. 511.996094 DISPLAY_IDENTIFIER O2_CAT_RATIO_SUM_1 ECU_ADDRESS 0x3fc258 BYTE_ORDER MSB_LAST FORMAT "%7.3" /end MEASUREMENT
/begin MEASUREMENT lam_bank_1.cat_eff_obd2.cat_diag_clc "value for catalyst conversion capability" UBYTE _CNV_A_R_LINEAR_____117_CM 1 100. 0. 1.9921875 DISPLAY_IDENTIFIER CAT_DIAG_CLC_1 ECU_ADDRESS 0x3fc269 FORMAT "%5.3" /end MEASUREMENT
/begin MEASUREMENT lam_bank_1.cat_eff_obd2.cat_diag "value for catalyst conversion capability" UBYTE _CNV_A_R_LINEAR_____335_CM 1 100. 0. 1.9968 DISPLAY_IDENTIFIER CAT_DIAG_1 ECU_ADDRESS 0x3fc26a FORMAT "%4.2" /end MEASUREMENT
/begin MEASUREMENT lam_bank_1.cat_eff_obd2.sum_cat_diag "monitoring cycle counter" UWORD _CNV_A_R_LINEAR_____22_CM 1 100. 0. 511. DISPLAY_IDENTIFIER SUM_CAT_DIAG_1 ECU_ADDRESS 0x3fc264 BYTE_ORDER MSB_LAST FORMAT "%4.0" /end MEASUREMENT
/begin MEASUREMENT lam_bank_1.cat_eff_obd2.sum_cat_diag_tot "Total sum of monitoring cycles since ECU programming" UBYTE _CNV_A_R_LINEAR_____0_CM 1 100. 0. 255. DISPLAY_IDENTIFIER SUM_CAT_DIAG_TOT_1 ECU_ADDRESS 0x3fc26b FORMAT "%3.0" /end MEASUREMENT
/begin MEASUREMENT lam_bank_1.cat_eff_obd2.o2_cat_st_cyc "O2_CAT_i value at start of monitoring cycle" UWORD _CNV_A_R_LINEAR_____3_CM 1 100. 0. 4.99511719 DISPLAY_IDENTIFIER O2_CAT_ST_CYC_1 ECU_ADDRESS 0x3fc266 BYTE_ORDER MSB_LAST FORMAT "%5.3" /end MEASUREMENT
/begin MEASUREMENT lam_bank_1.cat_eff_obd2.ctr_cat_diag_afr_afl "Counter of rich->lean changes after trim control and forced stimul. Param. changed" UBYTE _CNV_A_R_LINEAR_____0_CM 1 100. 0. 255. DISPLAY_IDENTIFIER CTR_CAT_DIAG_AFR_AFL_1 ECU_ADDRESS 0x3fc26c FORMAT "%3.0" /end MEASUREMENT
/begin MEASUREMENT lam_bank_1.lsh_up_obd2.bf.lv_lamb_puls_on_ls_diag_req "" ULONG _CNV_S_2_RANGE______2_CM 1 100. 0. 1. DISPLAY_IDENTIFIER LV_LAMB_PULS_ON_LS_DIAG_REQ_1 ECU_ADDRESS 0x3fc688 BYTE_ORDER MSB_LAST BIT_MASK 0x80000000 /end MEASUREMENT
/begin MEASUREMENT lam_bank_1.lsh_up_obd2.bf.lv_end_obd2_lsh_up "Boolean flag indicating that diagnosis has been completed" ULONG _CNV_S_2_RANGE______2_CM 1 100. 0. 1. DISPLAY_IDENTIFIER LV_END_OBD2_LSH_UP_1 ECU_ADDRESS 0x3fc688 BYTE_ORDER MSB_LAST BIT_MASK 0x10000000 /end MEASUREMENT
/begin MEASUREMENT lam_bank_1.lsh_up_obd2.bf.lv_sym_obd2_lsh_up "Boolean flag indicating that fault is present and has been debounced" ULONG _CNV_S_2_RANGE______2_CM 1 100. 0. 1. DISPLAY_IDENTIFIER LV_SYM_OBD2_LSH_UP_1 ECU_ADDRESS 0x3fc688 BYTE_ORDER MSB_LAST BIT_MASK 0x40000000 /end MEASUREMENT
/begin MEASUREMENT lam_bank_1.lsh_up_obd2.bf.lv_cdn_obd2_lsh_up "Boolean flag indicating that conditions for diagnosis met" ULONG _CNV_S_2_RANGE______2_CM 1 100. 0. 1. DISPLAY_IDENTIFIER LV_CDN_OBD2_LSH_UP_1 ECU_ADDRESS 0x3fc688 BYTE_ORDER MSB_LAST BIT_MASK 0x20000000 /end MEASUREMENT
/begin MEASUREMENT lam_bank_1.lsh_up_obd2.tcc_obd2_lsh_up "Number of completed valid diagnosis cycles" UWORD _CNV_A_R_LINEAR_____22_CM 1 100. 0. 1023. DISPLAY_IDENTIFIER TCC_OBD2_LSH_UP_1 ECU_ADDRESS 0x3fc68c BYTE_ORDER MSB_LAST FORMAT "%4.0" /end MEASUREMENT
/begin MEASUREMENT lam_bank_1.lsh_up_obd2.frc_obd2_lsh_up "Number of faults detected during valid diagnosis cycles" UWORD _CNV_A_R_LINEAR_____22_CM 1 100. 0. 1023. DISPLAY_IDENTIFIER FRC_OBD2_LSH_UP_1 ECU_ADDRESS 0x3fc68e BYTE_ORDER MSB_LAST FORMAT "%4.0" /end MEASUREMENT
/begin MEASUREMENT lam_bank_1.lsh_up_obd2.t_dly_obd2_lsh_up "TIMER_1 private use  " UBYTE _CNV_A_R_LINEAR_____30_CM 1 100. 0. 255. DISPLAY_IDENTIFIER T_DLY_OBD2_LSH_UP_1 ECU_ADDRESS 0x3fc692 FORMAT "%3.0" /end MEASUREMENT
/begin MEASUREMENT lam_bank_1.lsh_up_obd2.ttip_ls_up_mes_obd2_lsh_up "Most current oxygen sensor temperature (Mode 6 information)" SWORD _CNV_A_R_LINEAR_____303_CM 1 100. -2048. 2047.938 DISPLAY_IDENTIFIER TTIP_LS_UP_MES_OBD2_LSH_UP_1 ECU_ADDRESS 0x3fc690 BYTE_ORDER MSB_LAST FORMAT "%8.2" /end MEASUREMENT
/begin MEASUREMENT lam_bank_1.lsh_up_obd2.sym_obd2_lsh_up "Variable indicating status of each symptom, updated each recurrence & at diagnosis completion" UBYTE _CNV_S_6_RANGE_ERR__337_CM 1 100. 0. 15. DISPLAY_IDENTIFIER SYM_OBD2_LSH_UP_1 ECU_ADDRESS 0x3fc693 /end MEASUREMENT
/begin MEASUREMENT lam_bank_1.lam_o2l_inci.bf.lv_delta_lamb_sp_o2l_mdl "activation fo lambda set point shift by catalyst o2 loading conditioning function" ULONG _CNV_S_2_RANGE______2_CM 1 100. 0. 1. DISPLAY_IDENTIFIER LV_DELTA_LAMB_SP_O2L_MDL_1 ECU_ADDRESS 0x3fc6c8 BYTE_ORDER MSB_LAST BIT_MASK 0x80000000 /end MEASUREMENT
/begin MEASUREMENT lam_bank_2.fsd_obd2.t_sum_max_fsd "Total duration over C_LAM_MAX_FSD" UWORD _CNV_A_R_LINEAR_____198_CM 1 100. 0. 1310.7 DISPLAY_IDENTIFIER T_SUM_MAX_FSD_2 ECU_ADDRESS 0x3fc73c BYTE_ORDER MSB_LAST FORMAT "%7.2" /end MEASUREMENT
/begin MEASUREMENT lam_bank_2.fsd_obd2.t_sum_min_fsd "Total duration over C_LAM_MIN_FSD" UWORD _CNV_A_R_LINEAR_____198_CM 1 100. 0. 1310.7 DISPLAY_IDENTIFIER T_SUM_MIN_FSD_2 ECU_ADDRESS 0x3fc740 BYTE_ORDER MSB_LAST FORMAT "%7.2" /end MEASUREMENT
/begin MEASUREMENT lam_bank_2.fsd_obd2.t_sum_end_diag_win_fsd "Time counter to set LV_END_DIAG_FSD_i" UWORD _CNV_A_R_LINEAR_____198_CM 1 100. 0. 1310.7 DISPLAY_IDENTIFIER T_SUM_END_DIAG_WIN_FSD_2 ECU_ADDRESS 0x3fc744 BYTE_ORDER MSB_LAST FORMAT "%7.2" /end MEASUREMENT
/begin MEASUREMENT lam_bank_2.fsd_obd2.t_sum_rst_fsd "Time counter to reset T_SUM_MAX_FSD_i and T_SUM_MIN_FSD_i" UWORD _CNV_A_R_LINEAR_____198_CM 1 100. 0. 1310.7 DISPLAY_IDENTIFIER T_SUM_RST_FSD_2 ECU_ADDRESS 0x3fc746 BYTE_ORDER MSB_LAST FORMAT "%7.2" /end MEASUREMENT
/begin MEASUREMENT lam_bank_2.ls_down_obd2.bf.lv_ls_down_swt_vld "Validity bit of the current switching time check" ULONG _CNV_S_2_RANGE______2_CM 1 100. 0. 1. DISPLAY_IDENTIFIER LV_LS_DOWN_SWT_VLD_2 ECU_ADDRESS 0x3fc93c BYTE_ORDER MSB_LAST BIT_MASK 0x80000000 /end MEASUREMENT
/begin MEASUREMENT lam_bank_2.ls_down_obd2.bf.lv_ls_down_pue_vld "Debounced diagnosis result of pull end plausibility" ULONG _CNV_S_2_RANGE______2_CM 1 100. 0. 1. DISPLAY_IDENTIFIER LV_LS_DOWN_PUE_VLD_2 ECU_ADDRESS 0x3fc93c BYTE_ORDER MSB_LAST BIT_MASK 0x40000000 /end MEASUREMENT
/begin MEASUREMENT lam_bank_2.ls_down_obd2.bf.lv_cdn_diag_ls_down "Status of permission for diagnosis" ULONG _CNV_S_2_RANGE______2_CM 1 100. 0. 1. DISPLAY_IDENTIFIER LV_CDN_DIAG_LS_DOWN_2 ECU_ADDRESS 0x3fc93c BYTE_ORDER MSB_LAST BIT_MASK 0x20000000 /end MEASUREMENT
/begin MEASUREMENT lam_bank_2.ls_down_obd2.cycnr_vls_down_act "Cycle counter for switching time determination, Bank i" UBYTE _CNV_A_R_LINEAR_____313_CM 1 100. 0. 5100. DISPLAY_IDENTIFIER CYCNR_VLS_DOWN_ACT_2 ECU_ADDRESS 0x3fc946 FORMAT "%5.0" /end MEASUREMENT
/begin MEASUREMENT lam_bank_2.ls_down_obd2.ctr_vls_down_diag "Number of valid switching times from rich to lean" UBYTE _CNV_A_R_LINEAR_____0_CM 1 100. 0. 255. DISPLAY_IDENTIFIER CTR_VLS_DOWN_DIAG_2 ECU_ADDRESS 0x3fc94a FORMAT "%3.0" /end MEASUREMENT
/begin MEASUREMENT lam_bank_2.ls_down_obd2.vls_down_tran_puc "Monitor sensor voltage on activating the trailing throttle fuel cut-off, Bank i " UWORD _CNV_A_R_LINEAR_____3_CM 1 100. 0. 4.99511719 DISPLAY_IDENTIFIER VLS_DOWN_TRAN_PUC_2 ECU_ADDRESS 0x3fc942 BYTE_ORDER MSB_LAST FORMAT "%5.3" /end MEASUREMENT
/begin MEASUREMENT lam_bank_2.ls_down_obd2.ctr_cycnr_quo_vls_down_sum "Sum of weighted CYCNR_VLS_DOWN_ACT_i, Bank i " UWORD _CNV_A_R_LINEAR_____125_CM 1 100. 0. 255.996094 DISPLAY_IDENTIFIER CTR_CYCNR_QUO_VLS_DOWN_SUM_2 ECU_ADDRESS 0x3fc94c BYTE_ORDER MSB_LAST FORMAT "%7.3" /end MEASUREMENT
/begin MEASUREMENT lam_bank_2.ls_down_obd2.cycnr_ratio_vls_down "mean value of the ratio between the monitor sensor switching time and the threshold value" UBYTE _CNV_A_R_LINEAR_____39_CM 1 100. 0. 1.99220002 DISPLAY_IDENTIFIER CYCNR_RATIO_VLS_DOWN_2 ECU_ADDRESS 0x3fc94e FORMAT "%5.3" /end MEASUREMENT
/begin MEASUREMENT lam_bank_2.ls_down_obd2.cycnr_sae_ratio_vls_down "mean value of the ratio between the monitor sensor switching time and the threshold value for scantool" UBYTE _CNV_A_R_LINEAR_____39_CM 1 100. 0. 1.99220002 DISPLAY_IDENTIFIER CYCNR_SAE_RATIO_VLS_DOWN_2 ECU_ADDRESS 0x3fc94f FORMAT "%5.3" /end MEASUREMENT
/begin MEASUREMENT lam_bank_2.ls_down_obd2.cycnr_quo_vls_down "weighted value of CYCNR_VLS_DOWN_ACT_i " UWORD _CNV_A_R_LINEAR_____125_CM 1 100. 0. 255.996094 DISPLAY_IDENTIFIER CYCNR_QUO_VLS_DOWN_2 ECU_ADDRESS 0x3fc948 BYTE_ORDER MSB_LAST FORMAT "%7.3" /end MEASUREMENT
/begin MEASUREMENT lam_bank_2.ls_down_obd2.vls_down_pue "Monitor sensor voltage at the time of leaving PUC, Bank i (i=1.2)" UWORD _CNV_A_R_LINEAR_____3_CM 1 100. 0. 4.99511719 DISPLAY_IDENTIFIER VLS_DOWN_PUE_2 ECU_ADDRESS 0x3fc952 BYTE_ORDER MSB_LAST FORMAT "%5.3" /end MEASUREMENT
/begin MEASUREMENT lam_bank_2.ls_down_obd2.ctr_end_diag_ls_down_pue "Time counter to set LV_END_DIAG_VLS_DOWN_PUE_i" UWORD _CNV_A_R_LINEAR_____0_CM 1 100. 0. 65535. DISPLAY_IDENTIFIER CTR_END_DIAG_LS_DOWN_PUE_2 ECU_ADDRESS 0x3fc958 BYTE_ORDER MSB_LAST FORMAT "%5.0" /end MEASUREMENT
/begin MEASUREMENT lam_bank_2.ls_down_obd2.vls_down_dif_diag "difference of VLS_DOWN values from the beginning to the end of the MAF_INT_PUE calculation" UWORD _CNV_A_R_LINEAR_____3_CM 1 100. 0. 4.99511719 DISPLAY_IDENTIFIER VLS_DOWN_DIF_DIAG_2 ECU_ADDRESS 0x3fc954 BYTE_ORDER MSB_LAST FORMAT "%5.3" /end MEASUREMENT
/begin MEASUREMENT lam_bank_2.ls_down_obd2.vls_sae_down_dif_diag "difference of VLS_DOWN values from the beginning to the end of the MAF_INT_PUE calculation for scantool" UWORD _CNV_A_R_LINEAR_____3_CM 1 100. 0. 4.99511719 DISPLAY_IDENTIFIER VLS_SAE_DOWN_DIF_DIAG_2 ECU_ADDRESS 0x3fc956 BYTE_ORDER MSB_LAST FORMAT "%5.3" /end MEASUREMENT
/begin MEASUREMENT lam_bank_2.ls_down_obd2.ctr_ls_down_pue "counter for anti-bounce" UBYTE _CNV_A_R_LINEAR_____0_CM 1 100. 0. 255. DISPLAY_IDENTIFIER CTR_LS_DOWN_PUE_2 ECU_ADDRESS 0x3fc95a FORMAT "%3.0" /end MEASUREMENT
/begin MEASUREMENT lam_bank_2.cat_eff_act.lv_ls_cat_diag_cdn "Activation condidtions for O2 sensor and catalyst efficiency diagnosis" UBYTE _CNV_S_2_RANGE______2_CM 1 100. 0. 1. DISPLAY_IDENTIFIER LV_LS_CAT_DIAG_CDN_2 ECU_ADDRESS 0x3fca16 /end MEASUREMENT
/begin MEASUREMENT lam_bank_2.cat_eff_act.maf_int_cat_diag_dly "Air mass flow integral after conditions fulfilled for cat diag activation" UWORD _CNV_A_R_LINEAR_____316_CM 1 100. 0. 1820.42 DISPLAY_IDENTIFIER MAF_INT_CAT_DIAG_DLY_2 ECU_ADDRESS 0x3fca14 BYTE_ORDER MSB_LAST FORMAT "%7.2" /end MEASUREMENT
/begin MEASUREMENT lam_bank_2.cat_eff_inci.lv_inh_diag_cat_diag "" UBYTE _CNV_S_2_RANGE______2_CM 1 100. 0. 1. DISPLAY_IDENTIFIER LV_INH_DIAG_CAT_DIAG_2 ECU_ADDRESS 0x3fca18 /end MEASUREMENT
/begin MEASUREMENT lam_bank_2.cat_eff_inci.t_vls_cyc_efc "" UWORD _CNV_A_R_LINEAR_____4_CM 1 100. 0. 655.35 DISPLAY_IDENTIFIER T_VLS_CYC_EFC_2 ECU_ADDRESS 0x3fca1c BYTE_ORDER MSB_LAST FORMAT "%5.2" /end MEASUREMENT
/begin MEASUREMENT lam_bank_2.cat_eff_inci.lv_auth_cat_diag "" UBYTE _CNV_S_2_RANGE______2_CM 1 100. 0. 1. DISPLAY_IDENTIFIER LV_AUTH_CAT_DIAG_2 ECU_ADDRESS 0x3fca1a /end MEASUREMENT
/begin MEASUREMENT lam_bank_2.cat_eff_inci.vls_cyc_step "state-counter for several phases of a rich-lean-cycle" UBYTE _CNV_S_5_RANGE_U8_S_317_CM 1 100. 0. 255. DISPLAY_IDENTIFIER VLS_CYC_STEP_2 ECU_ADDRESS 0x3fca1e /end MEASUREMENT
/begin MEASUREMENT lam_bank_2.cat_eff_ldc_obd2.lv_ldc_cat "" UBYTE _CNV_S_2_RANGE______2_CM 1 100. 0. 1. DISPLAY_IDENTIFIER LV_LDC_CAT_2 ECU_ADDRESS 0x3fc6ff /end MEASUREMENT
/begin MEASUREMENT lam_bank_2.cat_eff_ldc_obd2.maf_int_ldc_cat "integral of mass air flow since limited dynamic conditions fulfilled" UWORD _CNV_A_R_LINEAR_____287_CM 1 100. 0. 1820.398 DISPLAY_IDENTIFIER MAF_INT_LDC_CAT_2 ECU_ADDRESS 0x3fc6f8 BYTE_ORDER MSB_LAST FORMAT "%7.2" /end MEASUREMENT
/begin MEASUREMENT lam_bank_2.cat_eff_ldc_obd2.pv_av_grd_sum "su. value for limited PV_AV gradient" UWORD _CNV_A_R_LINEAR_____318_CM 1 100. 0. 639990.2340000001 DISPLAY_IDENTIFIER PV_AV_GRD_SUM_2 ECU_ADDRESS 0x3fc6fa BYTE_ORDER MSB_LAST FORMAT "%8.1" /end MEASUREMENT
/begin MEASUREMENT lam_bank_2.cat_eff_ldc_obd2.lam_mv_mmv_cat "floating mean value for limited lambda deviation" SWORD _CNV_A_R_LINEAR_____111_CM 1 100. -50. 49.99847412 DISPLAY_IDENTIFIER LAM_MV_MMV_CAT_2 ECU_ADDRESS 0x3fc6fc BYTE_ORDER MSB_LAST FORMAT "%7.3" /end MEASUREMENT
/begin MEASUREMENT lam_bank_2.cat_eff_obd2.bf.lv_req_cat_diag "Flag passed to the OBD sequencer indicating a request to do catalyst diagnosis" ULONG _CNV_S_2_RANGE______2_CM 1 100. 0. 1. DISPLAY_IDENTIFIER LV_REQ_CAT_DIAG_2 ECU_ADDRESS 0x3fc704 BYTE_ORDER MSB_LAST BIT_MASK 0x80000000 /end MEASUREMENT
/begin MEASUREMENT lam_bank_2.cat_eff_obd2.bf.lv_cat_diag_cyc_vld "Monitoring cycle valid, used for calculation of diagnosis value" ULONG _CNV_S_2_RANGE______2_CM 1 100. 0. 1. DISPLAY_IDENTIFIER LV_CAT_DIAG_CYC_VLD_2 ECU_ADDRESS 0x3fc704 BYTE_ORDER MSB_LAST BIT_MASK 0x40000000 /end MEASUREMENT
/begin MEASUREMENT lam_bank_2.cat_eff_obd2.bf.lv_o2_cat_cyc_vld_1 "" ULONG _CNV_S_2_RANGE______2_CM 1 100. 0. 1. DISPLAY_IDENTIFIER LV_O2_CAT_CYC_VLD_1_2 ECU_ADDRESS 0x3fc704 BYTE_ORDER MSB_LAST BIT_MASK 0x10000000 /end MEASUREMENT
/begin MEASUREMENT lam_bank_2.cat_eff_obd2.bf.lv_o2_cat_cyc_vld_2 "" ULONG _CNV_S_2_RANGE______2_CM 1 100. 0. 1. DISPLAY_IDENTIFIER LV_O2_CAT_CYC_VLD_2_2 ECU_ADDRESS 0x3fc704 BYTE_ORDER MSB_LAST BIT_MASK 0x8000000 /end MEASUREMENT
/begin MEASUREMENT lam_bank_2.cat_eff_obd2.bf.lv_delta_lamb_cat_diag "flag to switch trim control parameters for OSC/NOX cat diag" ULONG _CNV_S_2_RANGE______2_CM 1 100. 0. 1. DISPLAY_IDENTIFIER LV_DELTA_LAMB_CAT_DIAG_2 ECU_ADDRESS 0x3fc704 BYTE_ORDER MSB_LAST BIT_MASK 0x2000000 /end MEASUREMENT
/begin MEASUREMENT lam_bank_2.cat_eff_obd2.bf.lv_lamb_puls_cat_diag "flag to switch forced stimulation parameters for OSC/NOX cat diag" ULONG _CNV_S_2_RANGE______2_CM 1 100. 0. 1. DISPLAY_IDENTIFIER LV_LAMB_PULS_CAT_DIAG_2 ECU_ADDRESS 0x3fc704 BYTE_ORDER MSB_LAST BIT_MASK 0x1000000 /end MEASUREMENT
/begin MEASUREMENT lam_bank_2.cat_eff_obd2.bf.lv_o2_cat_cyc_vld_3 "Third validity check O2_CAT_i for monitoring cycle" ULONG _CNV_S_2_RANGE______2_CM 1 100. 0. 1. DISPLAY_IDENTIFIER LV_O2_CAT_CYC_VLD_3_2 ECU_ADDRESS 0x3fc704 BYTE_ORDER MSB_LAST BIT_MASK 0x4000000 /end MEASUREMENT
/begin MEASUREMENT lam_bank_2.cat_eff_obd2.o2_cat_dif_sum "integral of difference downstream sensor signal to mean value through 1 diagnosis period" ULONG _CNV_A_R_LINEAR_____328_CM 1 100. 0. 1277.995125 DISPLAY_IDENTIFIER O2_CAT_DIF_SUM_2 ECU_ADDRESS 0x3fc708 BYTE_ORDER MSB_LAST FORMAT "%8.3" /end MEASUREMENT
/begin MEASUREMENT lam_bank_2.cat_eff_obd2.o2_cat_sum "integral of downstream sensor signal through 1 diagnosis period for calulation of mean value" ULONG _CNV_A_R_LINEAR_____329_CM 1 100. 0. 2555.99025 DISPLAY_IDENTIFIER O2_CAT_SUM_2 ECU_ADDRESS 0x3fc70c BYTE_ORDER MSB_LAST FORMAT "%8.3" /end MEASUREMENT
/begin MEASUREMENT lam_bank_2.cat_eff_obd2.o2_cat_mv "downstream sensor signal mean value for complete diagnosis period " UWORD _CNV_A_R_LINEAR_____330_CM 1 100. 0. 4.99511719 DISPLAY_IDENTIFIER O2_CAT_MV_2 ECU_ADDRESS 0x3fc714 BYTE_ORDER MSB_LAST FORMAT "%5.3" /end MEASUREMENT
/begin MEASUREMENT lam_bank_2.cat_eff_obd2.o2_cat_int "average deviation of downstream sensor signal to mean value through 1 diagnosis period" UWORD _CNV_A_R_LINEAR_____331_CM 1 100. 0. 4.998779 DISPLAY_IDENTIFIER O2_CAT_INT_2 ECU_ADDRESS 0x3fc716 BYTE_ORDER MSB_LAST FORMAT "%5.3" /end MEASUREMENT
/begin MEASUREMENT lam_bank_2.cat_eff_obd2.o2_cat_ratio "weighted o2_can_int_i value" UWORD _CNV_A_R_LINEAR_____332_CM 1 100. 0. 3.99609375 DISPLAY_IDENTIFIER O2_CAT_RATIO_2 ECU_ADDRESS 0x3fc718 BYTE_ORDER MSB_LAST FORMAT "%5.3" /end MEASUREMENT
/begin MEASUREMENT lam_bank_2.cat_eff_obd2.o2_cat "O2 load linearization value from downstream LS signal" UWORD _CNV_A_R_LINEAR_____330_CM 1 100. 0. 4.99511719 DISPLAY_IDENTIFIER O2_CAT_2 ECU_ADDRESS 0x3fc71a BYTE_ORDER MSB_LAST FORMAT "%5.3" /end MEASUREMENT
/begin MEASUREMENT lam_bank_2.cat_eff_obd2.state_cat_diag "" UBYTE _CNV_S_5_RANGE_STAT_333_CM 1 100. 0. 4. DISPLAY_IDENTIFIER STATE_CAT_DIAG_2 ECU_ADDRESS 0x3fc720 /end MEASUREMENT
/begin MEASUREMENT lam_bank_2.cat_eff_obd2.o2_cat_ratio_sum "total ratio between measured and max.allowed integral of downstream sensor signal" ULONG _CNV_A_R_LINEAR_____334_CM 1 100. 0. 511.996094 DISPLAY_IDENTIFIER O2_CAT_RATIO_SUM_2 ECU_ADDRESS 0x3fc710 BYTE_ORDER MSB_LAST FORMAT "%7.3" /end MEASUREMENT
/begin MEASUREMENT lam_bank_2.cat_eff_obd2.cat_diag_clc "value for catalyst conversion capability" UBYTE _CNV_A_R_LINEAR_____117_CM 1 100. 0. 1.9921875 DISPLAY_IDENTIFIER CAT_DIAG_CLC_2 ECU_ADDRESS 0x3fc721 FORMAT "%5.3" /end MEASUREMENT
/begin MEASUREMENT lam_bank_2.cat_eff_obd2.cat_diag "value for catalyst conversion capability" UBYTE _CNV_A_R_LINEAR_____335_CM 1 100. 0. 1.9968 DISPLAY_IDENTIFIER CAT_DIAG_2 ECU_ADDRESS 0x3fc722 FORMAT "%4.2" /end MEASUREMENT
/begin MEASUREMENT lam_bank_2.cat_eff_obd2.sum_cat_diag "monitoring cycle counter" UWORD _CNV_A_R_LINEAR_____22_CM 1 100. 0. 511. DISPLAY_IDENTIFIER SUM_CAT_DIAG_2 ECU_ADDRESS 0x3fc71c BYTE_ORDER MSB_LAST FORMAT "%4.0" /end MEASUREMENT
/begin MEASUREMENT lam_bank_2.cat_eff_obd2.sum_cat_diag_tot "Total sum of monitoring cycles since ECU programming" UBYTE _CNV_A_R_LINEAR_____0_CM 1 100. 0. 255. DISPLAY_IDENTIFIER SUM_CAT_DIAG_TOT_2 ECU_ADDRESS 0x3fc723 FORMAT "%3.0" /end MEASUREMENT
/begin MEASUREMENT lam_bank_2.cat_eff_obd2.o2_cat_st_cyc "O2_CAT_i value at start of monitoring cycle" UWORD _CNV_A_R_LINEAR_____3_CM 1 100. 0. 4.99511719 DISPLAY_IDENTIFIER O2_CAT_ST_CYC_2 ECU_ADDRESS 0x3fc71e BYTE_ORDER MSB_LAST FORMAT "%5.3" /end MEASUREMENT
/begin MEASUREMENT lam_bank_2.cat_eff_obd2.ctr_cat_diag_afr_afl "Counter of rich->lean changes after trim control and forced stimul. Param. changed" UBYTE _CNV_A_R_LINEAR_____0_CM 1 100. 0. 255. DISPLAY_IDENTIFIER CTR_CAT_DIAG_AFR_AFL_2 ECU_ADDRESS 0x3fc724 FORMAT "%3.0" /end MEASUREMENT
/begin MEASUREMENT lam_bank_2.lsh_up_obd2.bf.lv_lamb_puls_on_ls_diag_req "" ULONG _CNV_S_2_RANGE______2_CM 1 100. 0. 1. DISPLAY_IDENTIFIER LV_LAMB_PULS_ON_LS_DIAG_REQ_2 ECU_ADDRESS 0x3fcb40 BYTE_ORDER MSB_LAST BIT_MASK 0x80000000 /end MEASUREMENT
/begin MEASUREMENT lam_bank_2.lsh_up_obd2.bf.lv_end_obd2_lsh_up "Boolean flag indicating that diagnosis has been completed" ULONG _CNV_S_2_RANGE______2_CM 1 100. 0. 1. DISPLAY_IDENTIFIER LV_END_OBD2_LSH_UP_2 ECU_ADDRESS 0x3fcb40 BYTE_ORDER MSB_LAST BIT_MASK 0x10000000 /end MEASUREMENT
/begin MEASUREMENT lam_bank_2.lsh_up_obd2.bf.lv_sym_obd2_lsh_up "Boolean flag indicating that fault is present and has been debounced" ULONG _CNV_S_2_RANGE______2_CM 1 100. 0. 1. DISPLAY_IDENTIFIER LV_SYM_OBD2_LSH_UP_2 ECU_ADDRESS 0x3fcb40 BYTE_ORDER MSB_LAST BIT_MASK 0x40000000 /end MEASUREMENT
/begin MEASUREMENT lam_bank_2.lsh_up_obd2.bf.lv_cdn_obd2_lsh_up "Boolean flag indicating that conditions for diagnosis met" ULONG _CNV_S_2_RANGE______2_CM 1 100. 0. 1. DISPLAY_IDENTIFIER LV_CDN_OBD2_LSH_UP_2 ECU_ADDRESS 0x3fcb40 BYTE_ORDER MSB_LAST BIT_MASK 0x20000000 /end MEASUREMENT
/begin MEASUREMENT lam_bank_2.lsh_up_obd2.tcc_obd2_lsh_up "Number of completed valid diagnosis cycles" UWORD _CNV_A_R_LINEAR_____22_CM 1 100. 0. 1023. DISPLAY_IDENTIFIER TCC_OBD2_LSH_UP_2 ECU_ADDRESS 0x3fcb44 BYTE_ORDER MSB_LAST FORMAT "%4.0" /end MEASUREMENT
/begin MEASUREMENT lam_bank_2.lsh_up_obd2.frc_obd2_lsh_up "Number of faults detected during valid diagnosis cycles" UWORD _CNV_A_R_LINEAR_____22_CM 1 100. 0. 1023. DISPLAY_IDENTIFIER FRC_OBD2_LSH_UP_2 ECU_ADDRESS 0x3fcb46 BYTE_ORDER MSB_LAST FORMAT "%4.0" /end MEASUREMENT
/begin MEASUREMENT lam_bank_2.lsh_up_obd2.t_dly_obd2_lsh_up "TIMER_1 private use  " UBYTE _CNV_A_R_LINEAR_____30_CM 1 100. 0. 255. DISPLAY_IDENTIFIER T_DLY_OBD2_LSH_UP_2 ECU_ADDRESS 0x3fcb4a FORMAT "%3.0" /end MEASUREMENT
/begin MEASUREMENT lam_bank_2.lsh_up_obd2.ttip_ls_up_mes_obd2_lsh_up "Most current oxygen sensor temperature (Mode 6 information)" SWORD _CNV_A_R_LINEAR_____303_CM 1 100. -2048. 2047.938 DISPLAY_IDENTIFIER TTIP_LS_UP_MES_OBD2_LSH_UP_2 ECU_ADDRESS 0x3fcb48 BYTE_ORDER MSB_LAST FORMAT "%8.2" /end MEASUREMENT
/begin MEASUREMENT lam_bank_2.lsh_up_obd2.sym_obd2_lsh_up "Variable indicating status of each symptom, updated each recurrence & at diagnosis completion" UBYTE _CNV_S_6_RANGE_ERR__337_CM 1 100. 0. 15. DISPLAY_IDENTIFIER SYM_OBD2_LSH_UP_2 ECU_ADDRESS 0x3fcb4b /end MEASUREMENT
/begin MEASUREMENT lam_bank_2.lam_o2l_inci.bf.lv_delta_lamb_sp_o2l_mdl "activation fo lambda set point shift by catalyst o2 loading conditioning function" ULONG _CNV_S_2_RANGE______2_CM 1 100. 0. 1. DISPLAY_IDENTIFIER LV_DELTA_LAMB_SP_O2L_MDL_2 ECU_ADDRESS 0x3fcb80 BYTE_ORDER MSB_LAST BIT_MASK 0x80000000 /end MEASUREMENT
/begin CHARACTERISTIC c_tco_cur_on_ls_down_min "TCO-threshold for detection of R_DOWN_LS_i" VALUE 0xffe408f0 _REC_VAL_20_u1 190.5 _CNV_A_R_LINEAR_____11_CM -48. 142.5 DISPLAY_IDENTIFIER C_TCO_CUR_ON_LS_DOWN_MIN FORMAT "%5.1" /end CHARACTERISTIC
/begin AXIS_PTS ldpm_temp_ls_ini_1_egcp "" 0xffe51e1e online_dummy _REC_AXS_20_u2 4095.938 _CNV_A_R_LINEAR_____368_CM 6 -2048. 2047.938 DISPLAY_IDENTIFIER LDPM_TEMP_LS_INI_1_EGCP FORMAT "%8.2" /end AXIS_PTS
/begin MEASUREMENT fmy_ram_dyn[0].ctr_frc "Frequency counter of failure N" UBYTE _CNV_A_R_LINEAR_____0_CM 1 100. 0. 255. DISPLAY_IDENTIFIER CTR_FRC_0 ECU_ADDRESS 0x3fb792 FORMAT "%3.0" /end MEASUREMENT
/begin MEASUREMENT fmy_ram_dyn[0].ctr_wup_cyc "Counter for warm-up cycle" UBYTE _CNV_A_R_LINEAR_____0_CM 1 100. 0. 255. DISPLAY_IDENTIFIER CTR_WUP_CYC_0 ECU_ADDRESS 0x3fb793 FORMAT "%3.0" /end MEASUREMENT
/begin MEASUREMENT fmy_ram_dyn[0].ctr_dc "Counter for driving cycle" UBYTE _CNV_A_R_LINEAR_____0_CM 1 100. 0. 255. DISPLAY_IDENTIFIER CTR_DC_0 ECU_ADDRESS 0x3fb794 FORMAT "%3.0" /end MEASUREMENT
/begin MEASUREMENT fmy_ram_dyn[0].err_info_dyn "" UWORD _CNV_S_2_RANGE______1_R_CM 1 100. 0. 255. DISPLAY_IDENTIFIER ERR_INFO_DYN ECU_ADDRESS 0x3fb790 BYTE_ORDER MSB_LAST /end MEASUREMENT
/begin MEASUREMENT fmy_ram_dyn[0].err_info_dyn.bit_5 "" UWORD _CNV_S_2_RANGE______192_CM 1 100. 0. 1. DISPLAY_IDENTIFIER LV_ERR_DC_0 ECU_ADDRESS 0x3fb790 BYTE_ORDER MSB_LAST BIT_MASK 0x20 /end MEASUREMENT
/begin MEASUREMENT fmy_ram_dyn[0].err_info_dyn.bit_6 "" UWORD _CNV_S_2_RANGE______1_R_CM 1 100. 0. 255. DISPLAY_IDENTIFIER LV_ERR_TMP_0 ECU_ADDRESS 0x3fb790 BYTE_ORDER MSB_LAST BIT_MASK 0x40 /end MEASUREMENT
/begin MEASUREMENT fmy_ram_dyn[0].err_info_dyn.bit_8 "" UWORD _CNV_S_2_RANGE______1_R_CM 1 100. 0. 255. DISPLAY_IDENTIFIER LV_ERR_DISA_0 ECU_ADDRESS 0x3fb790 BYTE_ORDER MSB_LAST BIT_MASK 0x100 /end MEASUREMENT
/begin MEASUREMENT fmy_ram_dyn[0].err_info_dyn.bit_9 "" UWORD _CNV_S_2_RANGE______1_R_CM 1 100. 0. 255. DISPLAY_IDENTIFIER LV_DC_MAX_0 ECU_ADDRESS 0x3fb790 BYTE_ORDER MSB_LAST BIT_MASK 0x200 /end MEASUREMENT
/begin MEASUREMENT fmy_ram_dyn[0].err_info_dyn.bit_7 "" UWORD _CNV_S_2_RANGE______1_R_CM 1 100. 0. 255. DISPLAY_IDENTIFIER LV_ERR_CFM_0 ECU_ADDRESS 0x3fb790 BYTE_ORDER MSB_LAST BIT_MASK 0x80 /end MEASUREMENT
/begin MEASUREMENT fmy_ram_dyn[0].err_info_dyn.bit_10 "" UWORD _CNV_S_2_RANGE______1_R_CM 1 100. 0. 255. DISPLAY_IDENTIFIER LV_ERR_MKD_0 ECU_ADDRESS 0x3fb790 BYTE_ORDER MSB_LAST BIT_MASK 0x400 /end MEASUREMENT
/begin MEASUREMENT fmy_ram_dyn[0].diag_inst "" UWORD _CNV_S_257_RANGE_DIAG_430_CM 1 100. 0. 256. DISPLAY_IDENTIFIER DIAG_INST_0 ECU_ADDRESS 0x3fb78e BYTE_ORDER MSB_LAST /end MEASUREMENT
/begin MEASUREMENT fmy_ram_dyn[1].ctr_frc "Frequency counter of failure N" UBYTE _CNV_A_R_LINEAR_____0_CM 1 100. 0. 255. DISPLAY_IDENTIFIER CTR_FRC_1 ECU_ADDRESS 0x3fb79c FORMAT "%3.0" /end MEASUREMENT
/begin MEASUREMENT fmy_ram_dyn[1].ctr_wup_cyc "Counter for warm-up cycle" UBYTE _CNV_A_R_LINEAR_____0_CM 1 100. 0. 255. DISPLAY_IDENTIFIER CTR_WUP_CYC_1 ECU_ADDRESS 0x3fb79d FORMAT "%3.0" /end MEASUREMENT
/begin MEASUREMENT fmy_ram_dyn[1].ctr_dc "Counter for driving cycle" UBYTE _CNV_A_R_LINEAR_____0_CM 1 100. 0. 255. DISPLAY_IDENTIFIER CTR_DC_1 ECU_ADDRESS 0x3fb79e FORMAT "%3.0" /end MEASUREMENT
/begin MEASUREMENT fmy_ram_dyn[1].err_info_dyn "" UWORD _CNV_S_2_RANGE______1_R_CM 1 100. 0. 255. DISPLAY_IDENTIFIER ERR_INFO_DYN ECU_ADDRESS 0x3fb79a BYTE_ORDER MSB_LAST /end MEASUREMENT
/begin MEASUREMENT fmy_ram_dyn[1].err_info_dyn.bit_5 "" UWORD _CNV_S_2_RANGE______192_CM 1 100. 0. 1. DISPLAY_IDENTIFIER LV_ERR_DC_1 ECU_ADDRESS 0x3fb79a BYTE_ORDER MSB_LAST BIT_MASK 0x20 /end MEASUREMENT
/begin MEASUREMENT fmy_ram_dyn[1].err_info_dyn.bit_6 "" UWORD _CNV_S_2_RANGE______1_R_CM 1 100. 0. 255. DISPLAY_IDENTIFIER LV_ERR_TMP_1 ECU_ADDRESS 0x3fb79a BYTE_ORDER MSB_LAST BIT_MASK 0x40 /end MEASUREMENT
/begin MEASUREMENT fmy_ram_dyn[1].err_info_dyn.bit_8 "" UWORD _CNV_S_2_RANGE______1_R_CM 1 100. 0. 255. DISPLAY_IDENTIFIER LV_ERR_DISA_1 ECU_ADDRESS 0x3fb79a BYTE_ORDER MSB_LAST BIT_MASK 0x100 /end MEASUREMENT
/begin MEASUREMENT fmy_ram_dyn[1].err_info_dyn.bit_9 "" UWORD _CNV_S_2_RANGE______1_R_CM 1 100. 0. 255. DISPLAY_IDENTIFIER LV_DC_MAX_1 ECU_ADDRESS 0x3fb79a BYTE_ORDER MSB_LAST BIT_MASK 0x200 /end MEASUREMENT
/begin MEASUREMENT fmy_ram_dyn[1].err_info_dyn.bit_7 "" UWORD _CNV_S_2_RANGE______1_R_CM 1 100. 0. 255. DISPLAY_IDENTIFIER LV_ERR_CFM_1 ECU_ADDRESS 0x3fb79a BYTE_ORDER MSB_LAST BIT_MASK 0x80 /end MEASUREMENT
/begin MEASUREMENT fmy_ram_dyn[1].err_info_dyn.bit_10 "" UWORD _CNV_S_2_RANGE______1_R_CM 1 100. 0. 255. DISPLAY_IDENTIFIER LV_ERR_MKD_1 ECU_ADDRESS 0x3fb79a BYTE_ORDER MSB_LAST BIT_MASK 0x400 /end MEASUREMENT
/begin MEASUREMENT fmy_ram_dyn[1].diag_inst "" UWORD _CNV_S_257_RANGE_DIAG_430_CM 1 100. 0. 256. DISPLAY_IDENTIFIER DIAG_INST_1 ECU_ADDRESS 0x3fb798 BYTE_ORDER MSB_LAST /end MEASUREMENT
/begin MEASUREMENT fmy_ram_dyn[2].ctr_frc "Frequency counter of failure N" UBYTE _CNV_A_R_LINEAR_____0_CM 1 100. 0. 255. DISPLAY_IDENTIFIER CTR_FRC_2 ECU_ADDRESS 0x3fb7a6 FORMAT "%3.0" /end MEASUREMENT
/begin MEASUREMENT fmy_ram_dyn[2].ctr_wup_cyc "Counter for warm-up cycle" UBYTE _CNV_A_R_LINEAR_____0_CM 1 100. 0. 255. DISPLAY_IDENTIFIER CTR_WUP_CYC_2 ECU_ADDRESS 0x3fb7a7 FORMAT "%3.0" /end MEASUREMENT
/begin MEASUREMENT fmy_ram_dyn[2].ctr_dc "Counter for driving cycle" UBYTE _CNV_A_R_LINEAR_____0_CM 1 100. 0. 255. DISPLAY_IDENTIFIER CTR_DC_2 ECU_ADDRESS 0x3fb7a8 FORMAT "%3.0" /end MEASUREMENT
/begin MEASUREMENT fmy_ram_dyn[2].err_info_dyn "" UWORD _CNV_S_2_RANGE______1_R_CM 1 100. 0. 255. DISPLAY_IDENTIFIER ERR_INFO_DYN ECU_ADDRESS 0x3fb7a4 BYTE_ORDER MSB_LAST /end MEASUREMENT
/begin MEASUREMENT fmy_ram_dyn[2].err_info_dyn.bit_5 "" UWORD _CNV_S_2_RANGE______192_CM 1 100. 0. 1. DISPLAY_IDENTIFIER LV_ERR_DC_2 ECU_ADDRESS 0x3fb7a4 BYTE_ORDER MSB_LAST BIT_MASK 0x20 /end MEASUREMENT
/begin MEASUREMENT fmy_ram_dyn[2].err_info_dyn.bit_6 "" UWORD _CNV_S_2_RANGE______1_R_CM 1 100. 0. 255. DISPLAY_IDENTIFIER LV_ERR_TMP_2 ECU_ADDRESS 0x3fb7a4 BYTE_ORDER MSB_LAST BIT_MASK 0x40 /end MEASUREMENT
/begin MEASUREMENT fmy_ram_dyn[2].err_info_dyn.bit_8 "" UWORD _CNV_S_2_RANGE______1_R_CM 1 100. 0. 255. DISPLAY_IDENTIFIER LV_ERR_DISA_2 ECU_ADDRESS 0x3fb7a4 BYTE_ORDER MSB_LAST BIT_MASK 0x100 /end MEASUREMENT
/begin MEASUREMENT fmy_ram_dyn[2].err_info_dyn.bit_9 "" UWORD _CNV_S_2_RANGE______1_R_CM 1 100. 0. 255. DISPLAY_IDENTIFIER LV_DC_MAX_2 ECU_ADDRESS 0x3fb7a4 BYTE_ORDER MSB_LAST BIT_MASK 0x200 /end MEASUREMENT
/begin MEASUREMENT fmy_ram_dyn[2].err_info_dyn.bit_7 "" UWORD _CNV_S_2_RANGE______1_R_CM 1 100. 0. 255. DISPLAY_IDENTIFIER LV_ERR_CFM_2 ECU_ADDRESS 0x3fb7a4 BYTE_ORDER MSB_LAST BIT_MASK 0x80 /end MEASUREMENT
/begin MEASUREMENT fmy_ram_dyn[2].err_info_dyn.bit_10 "" UWORD _CNV_S_2_RANGE______1_R_CM 1 100. 0. 255. DISPLAY_IDENTIFIER LV_ERR_MKD_2 ECU_ADDRESS 0x3fb7a4 BYTE_ORDER MSB_LAST BIT_MASK 0x400 /end MEASUREMENT
/begin MEASUREMENT fmy_ram_dyn[2].diag_inst "" UWORD _CNV_S_257_RANGE_DIAG_430_CM 1 100. 0. 256. DISPLAY_IDENTIFIER DIAG_INST_2 ECU_ADDRESS 0x3fb7a2 BYTE_ORDER MSB_LAST /end MEASUREMENT
/begin MEASUREMENT fmy_ram_dyn[3].ctr_frc "Frequency counter of failure N" UBYTE _CNV_A_R_LINEAR_____0_CM 1 100. 0. 255. DISPLAY_IDENTIFIER CTR_FRC_3 ECU_ADDRESS 0x3fb7b0 FORMAT "%3.0" /end MEASUREMENT
/begin MEASUREMENT fmy_ram_dyn[3].ctr_wup_cyc "Counter for warm-up cycle" UBYTE _CNV_A_R_LINEAR_____0_CM 1 100. 0. 255. DISPLAY_IDENTIFIER CTR_WUP_CYC_3 ECU_ADDRESS 0x3fb7b1 FORMAT "%3.0" /end MEASUREMENT
/begin MEASUREMENT fmy_ram_dyn[3].ctr_dc "Counter for driving cycle" UBYTE _CNV_A_R_LINEAR_____0_CM 1 100. 0. 255. DISPLAY_IDENTIFIER CTR_DC_3 ECU_ADDRESS 0x3fb7b2 FORMAT "%3.0" /end MEASUREMENT
/begin MEASUREMENT fmy_ram_dyn[3].err_info_dyn "" UWORD _CNV_S_2_RANGE______1_R_CM 1 100. 0. 255. DISPLAY_IDENTIFIER ERR_INFO_DYN ECU_ADDRESS 0x3fb7ae BYTE_ORDER MSB_LAST /end MEASUREMENT
/begin MEASUREMENT fmy_ram_dyn[3].err_info_dyn.bit_5 "" UWORD _CNV_S_2_RANGE______192_CM 1 100. 0. 1. DISPLAY_IDENTIFIER LV_ERR_DC_3 ECU_ADDRESS 0x3fb7ae BYTE_ORDER MSB_LAST BIT_MASK 0x20 /end MEASUREMENT
/begin MEASUREMENT fmy_ram_dyn[3].err_info_dyn.bit_6 "" UWORD _CNV_S_2_RANGE______1_R_CM 1 100. 0. 255. DISPLAY_IDENTIFIER LV_ERR_TMP_3 ECU_ADDRESS 0x3fb7ae BYTE_ORDER MSB_LAST BIT_MASK 0x40 /end MEASUREMENT
/begin MEASUREMENT fmy_ram_dyn[3].err_info_dyn.bit_8 "" UWORD _CNV_S_2_RANGE______1_R_CM 1 100. 0. 255. DISPLAY_IDENTIFIER LV_ERR_DISA_3 ECU_ADDRESS 0x3fb7ae BYTE_ORDER MSB_LAST BIT_MASK 0x100 /end MEASUREMENT
/begin MEASUREMENT fmy_ram_dyn[3].err_info_dyn.bit_9 "" UWORD _CNV_S_2_RANGE______1_R_CM 1 100. 0. 255. DISPLAY_IDENTIFIER LV_DC_MAX_3 ECU_ADDRESS 0x3fb7ae BYTE_ORDER MSB_LAST BIT_MASK 0x200 /end MEASUREMENT
/begin MEASUREMENT fmy_ram_dyn[3].err_info_dyn.bit_7 "" UWORD _CNV_S_2_RANGE______1_R_CM 1 100. 0. 255. DISPLAY_IDENTIFIER LV_ERR_CFM_3 ECU_ADDRESS 0x3fb7ae BYTE_ORDER MSB_LAST BIT_MASK 0x80 /end MEASUREMENT
/begin MEASUREMENT fmy_ram_dyn[3].err_info_dyn.bit_10 "" UWORD _CNV_S_2_RANGE______1_R_CM 1 100. 0. 255. DISPLAY_IDENTIFIER LV_ERR_MKD_3 ECU_ADDRESS 0x3fb7ae BYTE_ORDER MSB_LAST BIT_MASK 0x400 /end MEASUREMENT
/begin MEASUREMENT fmy_ram_dyn[3].diag_inst "" UWORD _CNV_S_257_RANGE_DIAG_430_CM 1 100. 0. 256. DISPLAY_IDENTIFIER DIAG_INST_3 ECU_ADDRESS 0x3fb7ac BYTE_ORDER MSB_LAST /end MEASUREMENT
/begin MEASUREMENT fmy_ram_dyn[4].ctr_frc "Frequency counter of failure N" UBYTE _CNV_A_R_LINEAR_____0_CM 1 100. 0. 255. DISPLAY_IDENTIFIER CTR_FRC_4 ECU_ADDRESS 0x3fb7ba FORMAT "%3.0" /end MEASUREMENT
/begin MEASUREMENT fmy_ram_dyn[4].ctr_wup_cyc "Counter for warm-up cycle" UBYTE _CNV_A_R_LINEAR_____0_CM 1 100. 0. 255. DISPLAY_IDENTIFIER CTR_WUP_CYC_4 ECU_ADDRESS 0x3fb7bb FORMAT "%3.0" /end MEASUREMENT
/begin MEASUREMENT fmy_ram_dyn[4].ctr_dc "Counter for driving cycle" UBYTE _CNV_A_R_LINEAR_____0_CM 1 100. 0. 255. DISPLAY_IDENTIFIER CTR_DC_4 ECU_ADDRESS 0x3fb7bc FORMAT "%3.0" /end MEASUREMENT
/begin MEASUREMENT fmy_ram_dyn[4].err_info_dyn "" UWORD _CNV_S_2_RANGE______1_R_CM 1 100. 0. 255. DISPLAY_IDENTIFIER ERR_INFO_DYN ECU_ADDRESS 0x3fb7b8 BYTE_ORDER MSB_LAST /end MEASUREMENT
/begin MEASUREMENT fmy_ram_dyn[4].err_info_dyn.bit_5 "" UWORD _CNV_S_2_RANGE______192_CM 1 100. 0. 1. DISPLAY_IDENTIFIER LV_ERR_DC_4 ECU_ADDRESS 0x3fb7b8 BYTE_ORDER MSB_LAST BIT_MASK 0x20 /end MEASUREMENT
/begin MEASUREMENT fmy_ram_dyn[4].err_info_dyn.bit_6 "" UWORD _CNV_S_2_RANGE______1_R_CM 1 100. 0. 255. DISPLAY_IDENTIFIER LV_ERR_TMP_4 ECU_ADDRESS 0x3fb7b8 BYTE_ORDER MSB_LAST BIT_MASK 0x40 /end MEASUREMENT
/begin MEASUREMENT fmy_ram_dyn[4].err_info_dyn.bit_8 "" UWORD _CNV_S_2_RANGE______1_R_CM 1 100. 0. 255. DISPLAY_IDENTIFIER LV_ERR_DISA_4 ECU_ADDRESS 0x3fb7b8 BYTE_ORDER MSB_LAST BIT_MASK 0x100 /end MEASUREMENT
/begin MEASUREMENT fmy_ram_dyn[4].err_info_dyn.bit_9 "" UWORD _CNV_S_2_RANGE______1_R_CM 1 100. 0. 255. DISPLAY_IDENTIFIER LV_DC_MAX_4 ECU_ADDRESS 0x3fb7b8 BYTE_ORDER MSB_LAST BIT_MASK 0x200 /end MEASUREMENT
/begin MEASUREMENT fmy_ram_dyn[4].err_info_dyn.bit_7 "" UWORD _CNV_S_2_RANGE______1_R_CM 1 100. 0. 255. DISPLAY_IDENTIFIER LV_ERR_CFM_4 ECU_ADDRESS 0x3fb7b8 BYTE_ORDER MSB_LAST BIT_MASK 0x80 /end MEASUREMENT
/begin MEASUREMENT fmy_ram_dyn[4].err_info_dyn.bit_10 "" UWORD _CNV_S_2_RANGE______1_R_CM 1 100. 0. 255. DISPLAY_IDENTIFIER LV_ERR_MKD_4 ECU_ADDRESS 0x3fb7b8 BYTE_ORDER MSB_LAST BIT_MASK 0x400 /end MEASUREMENT
/begin MEASUREMENT fmy_ram_dyn[4].diag_inst "" UWORD _CNV_S_257_RANGE_DIAG_430_CM 1 100. 0. 256. DISPLAY_IDENTIFIER DIAG_INST_4 ECU_ADDRESS 0x3fb7b6 BYTE_ORDER MSB_LAST /end MEASUREMENT
/begin MEASUREMENT fmy_ram_dyn[5].ctr_frc "Frequency counter of failure N" UBYTE _CNV_A_R_LINEAR_____0_CM 1 100. 0. 255. DISPLAY_IDENTIFIER CTR_FRC_5 ECU_ADDRESS 0x3fb7c4 FORMAT "%3.0" /end MEASUREMENT
/begin MEASUREMENT fmy_ram_dyn[5].ctr_wup_cyc "Counter for warm-up cycle" UBYTE _CNV_A_R_LINEAR_____0_CM 1 100. 0. 255. DISPLAY_IDENTIFIER CTR_WUP_CYC_5 ECU_ADDRESS 0x3fb7c5 FORMAT "%3.0" /end MEASUREMENT
/begin MEASUREMENT fmy_ram_dyn[5].ctr_dc "Counter for driving cycle" UBYTE _CNV_A_R_LINEAR_____0_CM 1 100. 0. 255. DISPLAY_IDENTIFIER CTR_DC_5 ECU_ADDRESS 0x3fb7c6 FORMAT "%3.0" /end MEASUREMENT
/begin MEASUREMENT fmy_ram_dyn[5].err_info_dyn "" UWORD _CNV_S_2_RANGE______1_R_CM 1 100. 0. 255. DISPLAY_IDENTIFIER ERR_INFO_DYN ECU_ADDRESS 0x3fb7c2 BYTE_ORDER MSB_LAST /end MEASUREMENT
/begin MEASUREMENT fmy_ram_dyn[5].err_info_dyn.bit_5 "" UWORD _CNV_S_2_RANGE______192_CM 1 100. 0. 1. DISPLAY_IDENTIFIER LV_ERR_DC_5 ECU_ADDRESS 0x3fb7c2 BYTE_ORDER MSB_LAST BIT_MASK 0x20 /end MEASUREMENT
/begin MEASUREMENT fmy_ram_dyn[5].err_info_dyn.bit_6 "" UWORD _CNV_S_2_RANGE______1_R_CM 1 100. 0. 255. DISPLAY_IDENTIFIER LV_ERR_TMP_5 ECU_ADDRESS 0x3fb7c2 BYTE_ORDER MSB_LAST BIT_MASK 0x40 /end MEASUREMENT
/begin MEASUREMENT fmy_ram_dyn[5].err_info_dyn.bit_8 "" UWORD _CNV_S_2_RANGE______1_R_CM 1 100. 0. 255. DISPLAY_IDENTIFIER LV_ERR_DISA_5 ECU_ADDRESS 0x3fb7c2 BYTE_ORDER MSB_LAST BIT_MASK 0x100 /end MEASUREMENT
/begin MEASUREMENT fmy_ram_dyn[5].err_info_dyn.bit_9 "" UWORD _CNV_S_2_RANGE______1_R_CM 1 100. 0. 255. DISPLAY_IDENTIFIER LV_DC_MAX_5 ECU_ADDRESS 0x3fb7c2 BYTE_ORDER MSB_LAST BIT_MASK 0x200 /end MEASUREMENT
/begin MEASUREMENT fmy_ram_dyn[5].err_info_dyn.bit_7 "" UWORD _CNV_S_2_RANGE______1_R_CM 1 100. 0. 255. DISPLAY_IDENTIFIER LV_ERR_CFM_5 ECU_ADDRESS 0x3fb7c2 BYTE_ORDER MSB_LAST BIT_MASK 0x80 /end MEASUREMENT
/begin MEASUREMENT fmy_ram_dyn[5].err_info_dyn.bit_10 "" UWORD _CNV_S_2_RANGE______1_R_CM 1 100. 0. 255. DISPLAY_IDENTIFIER LV_ERR_MKD_5 ECU_ADDRESS 0x3fb7c2 BYTE_ORDER MSB_LAST BIT_MASK 0x400 /end MEASUREMENT
/begin MEASUREMENT fmy_ram_dyn[5].diag_inst "" UWORD _CNV_S_257_RANGE_DIAG_430_CM 1 100. 0. 256. DISPLAY_IDENTIFIER DIAG_INST_5 ECU_ADDRESS 0x3fb7c0 BYTE_ORDER MSB_LAST /end MEASUREMENT
/begin MEASUREMENT fmy_ram_dyn[6].ctr_frc "Frequency counter of failure N" UBYTE _CNV_A_R_LINEAR_____0_CM 1 100. 0. 255. DISPLAY_IDENTIFIER CTR_FRC_6 ECU_ADDRESS 0x3fb7ce FORMAT "%3.0" /end MEASUREMENT
/begin MEASUREMENT fmy_ram_dyn[6].ctr_wup_cyc "Counter for warm-up cycle" UBYTE _CNV_A_R_LINEAR_____0_CM 1 100. 0. 255. DISPLAY_IDENTIFIER CTR_WUP_CYC_6 ECU_ADDRESS 0x3fb7cf FORMAT "%3.0" /end MEASUREMENT
/begin MEASUREMENT fmy_ram_dyn[6].ctr_dc "Counter for driving cycle" UBYTE _CNV_A_R_LINEAR_____0_CM 1 100. 0. 255. DISPLAY_IDENTIFIER CTR_DC_6 ECU_ADDRESS 0x3fb7d0 FORMAT "%3.0" /end MEASUREMENT
/begin MEASUREMENT fmy_ram_dyn[6].err_info_dyn "" UWORD _CNV_S_2_RANGE______1_R_CM 1 100. 0. 255. DISPLAY_IDENTIFIER ERR_INFO_DYN ECU_ADDRESS 0x3fb7cc BYTE_ORDER MSB_LAST /end MEASUREMENT
/begin MEASUREMENT fmy_ram_dyn[6].err_info_dyn.bit_5 "" UWORD _CNV_S_2_RANGE______192_CM 1 100. 0. 1. DISPLAY_IDENTIFIER LV_ERR_DC_6 ECU_ADDRESS 0x3fb7cc BYTE_ORDER MSB_LAST BIT_MASK 0x20 /end MEASUREMENT
/begin MEASUREMENT fmy_ram_dyn[6].err_info_dyn.bit_6 "" UWORD _CNV_S_2_RANGE______1_R_CM 1 100. 0. 255. DISPLAY_IDENTIFIER LV_ERR_TMP_6 ECU_ADDRESS 0x3fb7cc BYTE_ORDER MSB_LAST BIT_MASK 0x40 /end MEASUREMENT
/begin MEASUREMENT fmy_ram_dyn[6].err_info_dyn.bit_8 "" UWORD _CNV_S_2_RANGE______1_R_CM 1 100. 0. 255. DISPLAY_IDENTIFIER LV_ERR_DISA_6 ECU_ADDRESS 0x3fb7cc BYTE_ORDER MSB_LAST BIT_MASK 0x100 /end MEASUREMENT
/begin MEASUREMENT fmy_ram_dyn[6].err_info_dyn.bit_9 "" UWORD _CNV_S_2_RANGE______1_R_CM 1 100. 0. 255. DISPLAY_IDENTIFIER LV_DC_MAX_6 ECU_ADDRESS 0x3fb7cc BYTE_ORDER MSB_LAST BIT_MASK 0x200 /end MEASUREMENT
/begin MEASUREMENT fmy_ram_dyn[6].err_info_dyn.bit_7 "" UWORD _CNV_S_2_RANGE______1_R_CM 1 100. 0. 255. DISPLAY_IDENTIFIER LV_ERR_CFM_6 ECU_ADDRESS 0x3fb7cc BYTE_ORDER MSB_LAST BIT_MASK 0x80 /end MEASUREMENT
/begin MEASUREMENT fmy_ram_dyn[6].err_info_dyn.bit_10 "" UWORD _CNV_S_2_RANGE______1_R_CM 1 100. 0. 255. DISPLAY_IDENTIFIER LV_ERR_MKD_6 ECU_ADDRESS 0x3fb7cc BYTE_ORDER MSB_LAST BIT_MASK 0x400 /end MEASUREMENT
/begin MEASUREMENT fmy_ram_dyn[6].diag_inst "" UWORD _CNV_S_257_RANGE_DIAG_430_CM 1 100. 0. 256. DISPLAY_IDENTIFIER DIAG_INST_6 ECU_ADDRESS 0x3fb7ca BYTE_ORDER MSB_LAST /end MEASUREMENT
/begin MEASUREMENT fmy_ram_dyn[7].ctr_frc "Frequency counter of failure N" UBYTE _CNV_A_R_LINEAR_____0_CM 1 100. 0. 255. DISPLAY_IDENTIFIER CTR_FRC_7 ECU_ADDRESS 0x3fb7d8 FORMAT "%3.0" /end MEASUREMENT
/begin MEASUREMENT fmy_ram_dyn[7].ctr_wup_cyc "Counter for warm-up cycle" UBYTE _CNV_A_R_LINEAR_____0_CM 1 100. 0. 255. DISPLAY_IDENTIFIER CTR_WUP_CYC_7 ECU_ADDRESS 0x3fb7d9 FORMAT "%3.0" /end MEASUREMENT
/begin MEASUREMENT fmy_ram_dyn[7].ctr_dc "Counter for driving cycle" UBYTE _CNV_A_R_LINEAR_____0_CM 1 100. 0. 255. DISPLAY_IDENTIFIER CTR_DC_7 ECU_ADDRESS 0x3fb7da FORMAT "%3.0" /end MEASUREMENT
/begin MEASUREMENT fmy_ram_dyn[7].err_info_dyn "" UWORD _CNV_S_2_RANGE______1_R_CM 1 100. 0. 255. DISPLAY_IDENTIFIER ERR_INFO_DYN ECU_ADDRESS 0x3fb7d6 BYTE_ORDER MSB_LAST /end MEASUREMENT
/begin MEASUREMENT fmy_ram_dyn[7].err_info_dyn.bit_5 "" UWORD _CNV_S_2_RANGE______192_CM 1 100. 0. 1. DISPLAY_IDENTIFIER LV_ERR_DC_7 ECU_ADDRESS 0x3fb7d6 BYTE_ORDER MSB_LAST BIT_MASK 0x20 /end MEASUREMENT
/begin MEASUREMENT fmy_ram_dyn[7].err_info_dyn.bit_6 "" UWORD _CNV_S_2_RANGE______1_R_CM 1 100. 0. 255. DISPLAY_IDENTIFIER LV_ERR_TMP_7 ECU_ADDRESS 0x3fb7d6 BYTE_ORDER MSB_LAST BIT_MASK 0x40 /end MEASUREMENT
/begin MEASUREMENT fmy_ram_dyn[7].err_info_dyn.bit_8 "" UWORD _CNV_S_2_RANGE______1_R_CM 1 100. 0. 255. DISPLAY_IDENTIFIER LV_ERR_DISA_7 ECU_ADDRESS 0x3fb7d6 BYTE_ORDER MSB_LAST BIT_MASK 0x100 /end MEASUREMENT
/begin MEASUREMENT fmy_ram_dyn[7].err_info_dyn.bit_9 "" UWORD _CNV_S_2_RANGE______1_R_CM 1 100. 0. 255. DISPLAY_IDENTIFIER LV_DC_MAX_7 ECU_ADDRESS 0x3fb7d6 BYTE_ORDER MSB_LAST BIT_MASK 0x200 /end MEASUREMENT
/begin MEASUREMENT fmy_ram_dyn[7].err_info_dyn.bit_7 "" UWORD _CNV_S_2_RANGE______1_R_CM 1 100. 0. 255. DISPLAY_IDENTIFIER LV_ERR_CFM_7 ECU_ADDRESS 0x3fb7d6 BYTE_ORDER MSB_LAST BIT_MASK 0x80 /end MEASUREMENT
/begin MEASUREMENT fmy_ram_dyn[7].err_info_dyn.bit_10 "" UWORD _CNV_S_2_RANGE______1_R_CM 1 100. 0. 255. DISPLAY_IDENTIFIER LV_ERR_MKD_7 ECU_ADDRESS 0x3fb7d6 BYTE_ORDER MSB_LAST BIT_MASK 0x400 /end MEASUREMENT
/begin MEASUREMENT fmy_ram_dyn[7].diag_inst "" UWORD _CNV_S_257_RANGE_DIAG_430_CM 1 100. 0. 256. DISPLAY_IDENTIFIER DIAG_INST_7 ECU_ADDRESS 0x3fb7d4 BYTE_ORDER MSB_LAST /end MEASUREMENT
/begin MEASUREMENT fmy_ram_dyn[8].ctr_frc "Frequency counter of failure N" UBYTE _CNV_A_R_LINEAR_____0_CM 1 100. 0. 255. DISPLAY_IDENTIFIER CTR_FRC_8 ECU_ADDRESS 0x3fb7e2 FORMAT "%3.0" /end MEASUREMENT
/begin MEASUREMENT fmy_ram_dyn[8].ctr_wup_cyc "Counter for warm-up cycle" UBYTE _CNV_A_R_LINEAR_____0_CM 1 100. 0. 255. DISPLAY_IDENTIFIER CTR_WUP_CYC_8 ECU_ADDRESS 0x3fb7e3 FORMAT "%3.0" /end MEASUREMENT
/begin MEASUREMENT fmy_ram_dyn[8].ctr_dc "Counter for driving cycle" UBYTE _CNV_A_R_LINEAR_____0_CM 1 100. 0. 255. DISPLAY_IDENTIFIER CTR_DC_8 ECU_ADDRESS 0x3fb7e4 FORMAT "%3.0" /end MEASUREMENT
/begin MEASUREMENT fmy_ram_dyn[8].err_info_dyn "" UWORD _CNV_S_2_RANGE______1_R_CM 1 100. 0. 255. DISPLAY_IDENTIFIER ERR_INFO_DYN ECU_ADDRESS 0x3fb7e0 BYTE_ORDER MSB_LAST /end MEASUREMENT
/begin MEASUREMENT fmy_ram_dyn[8].err_info_dyn.bit_5 "" UWORD _CNV_S_2_RANGE______192_CM 1 100. 0. 1. DISPLAY_IDENTIFIER LV_ERR_DC_8 ECU_ADDRESS 0x3fb7e0 BYTE_ORDER MSB_LAST BIT_MASK 0x20 /end MEASUREMENT
/begin MEASUREMENT fmy_ram_dyn[8].err_info_dyn.bit_6 "" UWORD _CNV_S_2_RANGE______1_R_CM 1 100. 0. 255. DISPLAY_IDENTIFIER LV_ERR_TMP_8 ECU_ADDRESS 0x3fb7e0 BYTE_ORDER MSB_LAST BIT_MASK 0x40 /end MEASUREMENT
/begin MEASUREMENT fmy_ram_dyn[8].err_info_dyn.bit_8 "" UWORD _CNV_S_2_RANGE______1_R_CM 1 100. 0. 255. DISPLAY_IDENTIFIER LV_ERR_DISA_8 ECU_ADDRESS 0x3fb7e0 BYTE_ORDER MSB_LAST BIT_MASK 0x100 /end MEASUREMENT
/begin MEASUREMENT fmy_ram_dyn[8].err_info_dyn.bit_9 "" UWORD _CNV_S_2_RANGE______1_R_CM 1 100. 0. 255. DISPLAY_IDENTIFIER LV_DC_MAX_8 ECU_ADDRESS 0x3fb7e0 BYTE_ORDER MSB_LAST BIT_MASK 0x200 /end MEASUREMENT
/begin MEASUREMENT fmy_ram_dyn[8].err_info_dyn.bit_7 "" UWORD _CNV_S_2_RANGE______1_R_CM 1 100. 0. 255. DISPLAY_IDENTIFIER LV_ERR_CFM_8 ECU_ADDRESS 0x3fb7e0 BYTE_ORDER MSB_LAST BIT_MASK 0x80 /end MEASUREMENT
/begin MEASUREMENT fmy_ram_dyn[8].err_info_dyn.bit_10 "" UWORD _CNV_S_2_RANGE______1_R_CM 1 100. 0. 255. DISPLAY_IDENTIFIER LV_ERR_MKD_8 ECU_ADDRESS 0x3fb7e0 BYTE_ORDER MSB_LAST BIT_MASK 0x400 /end MEASUREMENT
/begin MEASUREMENT fmy_ram_dyn[8].diag_inst "" UWORD _CNV_S_257_RANGE_DIAG_430_CM 1 100. 0. 256. DISPLAY_IDENTIFIER DIAG_INST_8 ECU_ADDRESS 0x3fb7de BYTE_ORDER MSB_LAST /end MEASUREMENT
/begin MEASUREMENT fmy_ram_dyn[9].ctr_frc "Frequency counter of failure N" UBYTE _CNV_A_R_LINEAR_____0_CM 1 100. 0. 255. DISPLAY_IDENTIFIER CTR_FRC_9 ECU_ADDRESS 0x3fb7ec FORMAT "%3.0" /end MEASUREMENT
/begin MEASUREMENT fmy_ram_dyn[9].ctr_wup_cyc "Counter for warm-up cycle" UBYTE _CNV_A_R_LINEAR_____0_CM 1 100. 0. 255. DISPLAY_IDENTIFIER CTR_WUP_CYC_9 ECU_ADDRESS 0x3fb7ed FORMAT "%3.0" /end MEASUREMENT
/begin MEASUREMENT fmy_ram_dyn[9].ctr_dc "Counter for driving cycle" UBYTE _CNV_A_R_LINEAR_____0_CM 1 100. 0. 255. DISPLAY_IDENTIFIER CTR_DC_9 ECU_ADDRESS 0x3fb7ee FORMAT "%3.0" /end MEASUREMENT
/begin MEASUREMENT fmy_ram_dyn[9].err_info_dyn "" UWORD _CNV_S_2_RANGE______1_R_CM 1 100. 0. 255. DISPLAY_IDENTIFIER ERR_INFO_DYN ECU_ADDRESS 0x3fb7ea BYTE_ORDER MSB_LAST /end MEASUREMENT
/begin MEASUREMENT fmy_ram_dyn[9].err_info_dyn.bit_5 "" UWORD _CNV_S_2_RANGE______192_CM 1 100. 0. 1. DISPLAY_IDENTIFIER LV_ERR_DC_9 ECU_ADDRESS 0x3fb7ea BYTE_ORDER MSB_LAST BIT_MASK 0x20 /end MEASUREMENT
/begin MEASUREMENT fmy_ram_dyn[9].err_info_dyn.bit_6 "" UWORD _CNV_S_2_RANGE______1_R_CM 1 100. 0. 255. DISPLAY_IDENTIFIER LV_ERR_TMP_9 ECU_ADDRESS 0x3fb7ea BYTE_ORDER MSB_LAST BIT_MASK 0x40 /end MEASUREMENT
/begin MEASUREMENT fmy_ram_dyn[9].err_info_dyn.bit_8 "" UWORD _CNV_S_2_RANGE______1_R_CM 1 100. 0. 255. DISPLAY_IDENTIFIER LV_ERR_DISA_9 ECU_ADDRESS 0x3fb7ea BYTE_ORDER MSB_LAST BIT_MASK 0x100 /end MEASUREMENT
/begin MEASUREMENT fmy_ram_dyn[9].err_info_dyn.bit_9 "" UWORD _CNV_S_2_RANGE______1_R_CM 1 100. 0. 255. DISPLAY_IDENTIFIER LV_DC_MAX_9 ECU_ADDRESS 0x3fb7ea BYTE_ORDER MSB_LAST BIT_MASK 0x200 /end MEASUREMENT
/begin MEASUREMENT fmy_ram_dyn[9].err_info_dyn.bit_7 "" UWORD _CNV_S_2_RANGE______1_R_CM 1 100. 0. 255. DISPLAY_IDENTIFIER LV_ERR_CFM_9 ECU_ADDRESS 0x3fb7ea BYTE_ORDER MSB_LAST BIT_MASK 0x80 /end MEASUREMENT
/begin MEASUREMENT fmy_ram_dyn[9].err_info_dyn.bit_10 "" UWORD _CNV_S_2_RANGE______1_R_CM 1 100. 0. 255. DISPLAY_IDENTIFIER LV_ERR_MKD_9 ECU_ADDRESS 0x3fb7ea BYTE_ORDER MSB_LAST BIT_MASK 0x400 /end MEASUREMENT
/begin MEASUREMENT fmy_ram_dyn[9].diag_inst "" UWORD _CNV_S_257_RANGE_DIAG_430_CM 1 100. 0. 256. DISPLAY_IDENTIFIER DIAG_INST_9 ECU_ADDRESS 0x3fb7e8 BYTE_ORDER MSB_LAST /end MEASUREMENT
/begin MEASUREMENT fmy_scdn_equ_fsd_2.ctr_scdn_equ_dc "" UBYTE _CNV_A_R_LINEAR_____0_CM 1 100. 0. 255. DISPLAY_IDENTIFIER CTR_SCDN_EQU_DC_FSD_2 ECU_ADDRESS 0x3fbc06 FORMAT "%3.0" /end MEASUREMENT
/begin MEASUREMENT fmy_scdn_equ_fsd_2.scdn_info "" UBYTE _CNV_A_R_LINEAR_____0_CM 1 100. 0. 15. DISPLAY_IDENTIFIER SCDN_INFO_FSD_2 ECU_ADDRESS 0x3fbc07 FORMAT "%2.0" /end MEASUREMENT
/begin MEASUREMENT fmy_scdn_equ_fsd_1.ctr_scdn_equ_dc "" UBYTE _CNV_A_R_LINEAR_____0_CM 1 100. 0. 255. DISPLAY_IDENTIFIER CTR_SCDN_EQU_DC_FSD_1 ECU_ADDRESS 0x3fbbfc FORMAT "%3.0" /end MEASUREMENT
/begin MEASUREMENT fmy_scdn_equ_fsd_1.scdn_info "" UBYTE _CNV_A_R_LINEAR_____0_CM 1 100. 0. 15. DISPLAY_IDENTIFIER SCDN_INFO_FSD_1 ECU_ADDRESS 0x3fbbfd FORMAT "%2.0" /end MEASUREMENT
/begin MEASUREMENT fmy_scdn_equ_mis_1.ctr_scdn_equ_dc "" UBYTE _CNV_A_R_LINEAR_____0_CM 1 100. 0. 255. DISPLAY_IDENTIFIER CTR_SCDN_EQU_DC_MIS_1 ECU_ADDRESS 0x3fbc1a FORMAT "%3.0" /end MEASUREMENT
/begin MEASUREMENT fmy_scdn_equ_mis_1.scdn_info "" UBYTE _CNV_A_R_LINEAR_____0_CM 1 100. 0. 15. DISPLAY_IDENTIFIER SCDN_INFO_MIS_1 ECU_ADDRESS 0x3fbc1b FORMAT "%2.0" /end MEASUREMENT
/begin MEASUREMENT fmy_scdn_equ_mis_2.ctr_scdn_equ_dc "" UBYTE _CNV_A_R_LINEAR_____0_CM 1 100. 0. 255. DISPLAY_IDENTIFIER CTR_SCDN_EQU_DC_MIS_2 ECU_ADDRESS 0x3fbc24 FORMAT "%3.0" /end MEASUREMENT
/begin MEASUREMENT fmy_scdn_equ_mis_2.scdn_info "" UBYTE _CNV_A_R_LINEAR_____0_CM 1 100. 0. 15. DISPLAY_IDENTIFIER SCDN_INFO_MIS_2 ECU_ADDRESS 0x3fbc25 FORMAT "%2.0" /end MEASUREMENT
/begin MEASUREMENT fmy_scdn_equ_mis_3.ctr_scdn_equ_dc "" UBYTE _CNV_A_R_LINEAR_____0_CM 1 100. 0. 255. DISPLAY_IDENTIFIER CTR_SCDN_EQU_DC_MIS_3 ECU_ADDRESS 0x3fbc2e FORMAT "%3.0" /end MEASUREMENT
/begin MEASUREMENT fmy_scdn_equ_mis_3.scdn_info "" UBYTE _CNV_A_R_LINEAR_____0_CM 1 100. 0. 15. DISPLAY_IDENTIFIER SCDN_INFO_MIS_3 ECU_ADDRESS 0x3fbc2f FORMAT "%2.0" /end MEASUREMENT
/begin MEASUREMENT fmy_scdn_equ_mis_4.ctr_scdn_equ_dc "" UBYTE _CNV_A_R_LINEAR_____0_CM 1 100. 0. 255. DISPLAY_IDENTIFIER CTR_SCDN_EQU_DC_MIS_4 ECU_ADDRESS 0x3fbc38 FORMAT "%3.0" /end MEASUREMENT
/begin MEASUREMENT fmy_scdn_equ_mis_4.scdn_info "" UBYTE _CNV_A_R_LINEAR_____0_CM 1 100. 0. 15. DISPLAY_IDENTIFIER SCDN_INFO_MIS_4 ECU_ADDRESS 0x3fbc39 FORMAT "%2.0" /end MEASUREMENT
/begin MEASUREMENT fmy_scdn_equ_mis_0.ctr_scdn_equ_dc "" UBYTE _CNV_A_R_LINEAR_____0_CM 1 100. 0. 255. DISPLAY_IDENTIFIER CTR_SCDN_EQU_DC_MIS_0 ECU_ADDRESS 0x3fbc10 FORMAT "%3.0" /end MEASUREMENT
/begin MEASUREMENT fmy_scdn_equ_mis_0.scdn_info "" UBYTE _CNV_A_R_LINEAR_____0_CM 1 100. 0. 15. DISPLAY_IDENTIFIER SCDN_INFO_MIS_0 ECU_ADDRESS 0x3fbc11 FORMAT "%2.0" /end MEASUREMENT
/begin MEASUREMENT fmy_scdn_equ_mis_5.ctr_scdn_equ_dc "" UBYTE _CNV_A_R_LINEAR_____0_CM 1 100. 0. 255. DISPLAY_IDENTIFIER CTR_SCDN_EQU_DC_MIS_5 ECU_ADDRESS 0x3fbc42 FORMAT "%3.0" /end MEASUREMENT
/begin MEASUREMENT fmy_scdn_equ_mis_5.scdn_info "" UBYTE _CNV_A_R_LINEAR_____0_CM 1 100. 0. 15. DISPLAY_IDENTIFIER SCDN_INFO_MIS_5 ECU_ADDRESS 0x3fbc43 FORMAT "%2.0" /end MEASUREMENT
/begin CHARACTERISTIC c_cl_max_cat_ls_diag "Maximum canister load to allow catalyst and O2 sensor diagnosis" VALUE 0xffe41520 _REC_VAL_20_u2 1.99996948 _CNV_A_R_LINEAR_____20_CM 0. 1.99996948 DISPLAY_IDENTIFIER C_CL_MAX_CAT_LS_DIAG FORMAT "%7.5" /end CHARACTERISTIC
/begin CHARACTERISTIC lc_ls_cat_diag_cdn_man_act "Flag to set diagnosis condition manually" VALUE 0xffe40f99 _REC_VAL_20_u1 1. _CNV_A_R_LINEAR_____0_CM 0. 1. DISPLAY_IDENTIFIER LC_LS_CAT_DIAG_CDN_MAN_ACT FORMAT "%2.0" /end CHARACTERISTIC
/begin CHARACTERISTIC ip_maf_lam_cat_min__n_32 "min. MAF threshold " CURVE 0xffe4ce32 _REC_CUR_20_u2_u1 1389. _CNV_A_R_LINEAR_____108_CM 0. 1389. DISPLAY_IDENTIFIER IP_MAF_LAM_CAT_MIN__N_32 FORMAT "%7.2"
 /begin AXIS_DESCR COM_AXIS n_32 _CNV_A_R_LINEAR_____15_CM 6 0. 8160. FORMAT "%4.0" AXIS_PTS_REF ldpm_n_32__lam_cat /end AXIS_DESCR
/end CHARACTERISTIC
/begin CHARACTERISTIC ip_maf_lam_cat_max__n_32 "max MAF threshold for activation I-share" CURVE 0xffe4ce26 _REC_CUR_20_u2_u1 1389. _CNV_A_R_LINEAR_____108_CM 0. 1389. DISPLAY_IDENTIFIER IP_MAF_LAM_CAT_MAX__N_32 FORMAT "%7.2"
 /begin AXIS_DESCR COM_AXIS n_32 _CNV_A_R_LINEAR_____15_CM 6 0. 8160. FORMAT "%4.0" AXIS_PTS_REF ldpm_n_32__lam_cat /end AXIS_DESCR
/end CHARACTERISTIC
/begin CHARACTERISTIC c_tco_min_cat "Min TCO threshold" VALUE 0xffe4090d _REC_VAL_20_u1 190.5 _CNV_A_R_LINEAR_____11_CM -48. 142.5 DISPLAY_IDENTIFIER C_TCO_MIN_CAT FORMAT "%5.1" /end CHARACTERISTIC
/begin CHARACTERISTIC c_temp_min_cat "min. TEMP_CAT theshold" VALUE 0xffe4094a _REC_VAL_20_u1 1023. _CNV_A_R_LINEAR_____352_CM -33. 990. DISPLAY_IDENTIFIER C_TEMP_MIN_CAT FORMAT "%4.0" /end CHARACTERISTIC
/begin CHARACTERISTIC c_temp_max_cat "max. TEMP_CAT theshold" VALUE 0xffe40949 _REC_VAL_20_u1 1023. _CNV_A_R_LINEAR_____352_CM -33. 990. DISPLAY_IDENTIFIER C_TEMP_MAX_CAT FORMAT "%4.0" /end CHARACTERISTIC
/begin CHARACTERISTIC c_temp_hys_cat "hysterese after exceeding TEMP_CAT threshold " VALUE 0xffe40948 _REC_VAL_20_u1 1020. _CNV_A_R_LINEAR_____439_CM 0. 1020. DISPLAY_IDENTIFIER C_TEMP_HYS_CAT FORMAT "%4.0" /end CHARACTERISTIC
/begin CHARACTERISTIC c_vs_min_cat "min. VS threshold" VALUE 0xffe409df _REC_VAL_20_u1 255. _CNV_A_R_LINEAR_____23_CM 0. 255. DISPLAY_IDENTIFIER C_VS_MIN_CAT FORMAT "%3.0" /end CHARACTERISTIC
/begin CHARACTERISTIC c_vs_max_cat "max. VS threshold" VALUE 0xffe409d3 _REC_VAL_20_u1 255. _CNV_A_R_LINEAR_____23_CM 0. 255. DISPLAY_IDENTIFIER C_VS_MAX_CAT FORMAT "%3.0" /end CHARACTERISTIC
/begin CHARACTERISTIC c_amp_min_cat_ls_diag "min. ambient pressure threshold " VALUE 0xffe414f4 _REC_VAL_20_u2 5434. _CNV_A_R_LINEAR_____49_CM 0. 5434. DISPLAY_IDENTIFIER C_AMP_MIN_CAT_LS_DIAG FORMAT "%7.2" /end CHARACTERISTIC
/begin AXIS_PTS ldpm_n_32__lam_cat "" 0xffe413b8 n_32 _REC_AXS_20_u1 8160. _CNV_A_R_LINEAR_____15_CM 6 0. 8160. DISPLAY_IDENTIFIER LDPM_N_32__LAM_CAT FORMAT "%4.0" /end AXIS_PTS
/begin CHARACTERISTIC c_maf_int_cat_diag_dly "Air mass flow threshold for cat diag activation after PUC, CL max purge, etc." VALUE 0xffe4174a _REC_VAL_20_u2 1820.42 _CNV_A_R_LINEAR_____316_CM 0. 1820.42 DISPLAY_IDENTIFIER C_MAF_INT_CAT_DIAG_DLY FORMAT "%7.2" /end CHARACTERISTIC
/begin CHARACTERISTIC c_maf_int_cat_diag_sw "Air mass flow initial for cat diag activation after MAX to NO_PURGE and back" VALUE 0xffe4174c _REC_VAL_20_u2 1820.42 _CNV_A_R_LINEAR_____316_CM 0. 1820.42 DISPLAY_IDENTIFIER C_MAF_INT_CAT_DIAG_SW FORMAT "%7.2" /end CHARACTERISTIC
/begin MEASUREMENT n_mmv_cat "floating mean value for limited engine speed" UWORD _CNV_A_R_LINEAR_____10_CM 1 100. 0. 8160. DISPLAY_IDENTIFIER N_MMV_CAT ECU_ADDRESS 0x3fdbf4 BYTE_ORDER MSB_LAST FORMAT "%4.0" /end MEASUREMENT
/begin MEASUREMENT maf_mmv_cat "floating mean value for limited MAF" UWORD _CNV_A_R_LINEAR_____108_CM 1 100. 0. 1389. DISPLAY_IDENTIFIER MAF_MMV_CAT ECU_ADDRESS 0x3fdbf6 BYTE_ORDER MSB_LAST FORMAT "%7.2" /end MEASUREMENT
/begin MEASUREMENT lv_n_ldc "" UBYTE _CNV_S_2_RANGE______2_CM 1 100. 0. 1. DISPLAY_IDENTIFIER LV_N_LDC ECU_ADDRESS 0x3fea50 /end MEASUREMENT
/begin MEASUREMENT lv_maf_ldc "" UBYTE _CNV_S_2_RANGE______2_CM 1 100. 0. 1. DISPLAY_IDENTIFIER LV_MAF_LDC ECU_ADDRESS 0x3fea51 /end MEASUREMENT
/begin CHARACTERISTIC c_n_crlc_cat "floating mean value calculation engine speed" VALUE 0xffe417e8 _REC_VAL_20_u2 0.99998474 _CNV_A_R_LINEAR_____37_CM 0. 0.99998474 DISPLAY_IDENTIFIER C_N_CRLC_CAT FORMAT "%7.5" /end CHARACTERISTIC
/begin CHARACTERISTIC c_maf_crlc_cat "floating mean value calculation MAF" VALUE 0xffe41726 _REC_VAL_20_u2 0.99998474 _CNV_A_R_LINEAR_____37_CM 0. 0.99998474 DISPLAY_IDENTIFIER C_MAF_CRLC_CAT FORMAT "%7.5" /end CHARACTERISTIC
/begin CHARACTERISTIC c_lam_mv_crlc_cat "floating mean value calculation lambda " VALUE 0xffe41694 _REC_VAL_20_u2 0.99998474 _CNV_A_R_LINEAR_____37_CM 0. 0.99998474 DISPLAY_IDENTIFIER C_LAM_MV_CRLC_CAT FORMAT "%7.5" /end CHARACTERISTIC
/begin CHARACTERISTIC c_n_dyw_cat "threshold limited dynamic engine speed" VALUE 0xffe417fc _REC_VAL_20_u2 8160. _CNV_A_R_LINEAR_____10_CM 0. 8160. DISPLAY_IDENTIFIER C_N_DYW_CAT FORMAT "%4.0" /end CHARACTERISTIC
/begin CHARACTERISTIC c_maf_dyw_cat "threshold limited dynamic engine MAF" VALUE 0xffe4173e _REC_VAL_20_u2 1389. _CNV_A_R_LINEAR_____108_CM 0. 1389. DISPLAY_IDENTIFIER C_MAF_DYW_CAT FORMAT "%7.2" /end CHARACTERISTIC
/begin CHARACTERISTIC c_lam_mv_dyw_cat "threshold limited dynamic lambda " VALUE 0xffe4169c _REC_VAL_20_u2 99.99847412 _CNV_A_R_LINEAR_____8_CM 0. 99.99847412 DISPLAY_IDENTIFIER C_LAM_MV_DYW_CAT /end CHARACTERISTIC
/begin CHARACTERISTIC c_maf_int_min_cat "MAF integral after setting limited dynamic conditions LV_LDC_CATi before starting the monitoring cycle" VALUE 0xffe41764 _REC_VAL_20_u2 1820.398 _CNV_A_R_LINEAR_____287_CM 0. 1820.398 DISPLAY_IDENTIFIER C_MAF_INT_MIN_CAT FORMAT "%7.2" /end CHARACTERISTIC
/begin CHARACTERISTIC c_pv_av_grd_dec "decrement for calculation PV_AV gradient" VALUE 0xffe40820 _REC_VAL_20_u1 2490.234 _CNV_A_R_LINEAR_____358_CM 0. 2490.234 DISPLAY_IDENTIFIER C_PV_AV_GRD_DEC FORMAT "%6.1" /end CHARACTERISTIC
/begin CHARACTERISTIC c_pv_av_grd_sum_max "max. threshold limited dynamic PV_AV gradient" VALUE 0xffe41886 _REC_VAL_20_u2 639990.2340000001 _CNV_A_R_LINEAR_____318_CM 0. 639990.2340000001 DISPLAY_IDENTIFIER C_PV_AV_GRD_SUM_MAX FORMAT "%8.1" /end CHARACTERISTIC
/begin CHARACTERISTIC c_pv_av_grd_sum_min "min. threshold limited dynamic PV_AV gradient" VALUE 0xffe4188a _REC_VAL_20_u2 639990.2340000001 _CNV_A_R_LINEAR_____318_CM 0. 639990.2340000001 DISPLAY_IDENTIFIER C_PV_AV_GRD_SUM_MIN FORMAT "%8.1" /end CHARACTERISTIC
/begin CHARACTERISTIC c_t_pv_av_grd_dec_sum "time periods for calculation limited dynamic PV_AV  gradient" VALUE 0xffe408c7 _REC_VAL_20_u1 5.1 _CNV_A_R_LINEAR_____198_CM 0. 5.1 DISPLAY_IDENTIFIER C_T_PV_AV_GRD_DEC_SUM FORMAT "%4.2" /end CHARACTERISTIC
/begin CHARACTERISTIC c_pv_av_grd_min_sum_cat "minimum value of PV_AV gradient to increment PV_AV_GRD_SUM" VALUE 0xffe40824 _REC_VAL_20_u1 1240.2 _CNV_A_R_LINEAR_____359_CM 0. 1240.2 DISPLAY_IDENTIFIER C_PV_AV_GRD_MIN_SUM_CAT FORMAT "%6.1" /end CHARACTERISTIC
/begin CHARACTERISTIC ip_vls_cat_int_max_at "weight factor of downstream sensor signal integral for automatic transmission" MAP 0xffe50616 _REC_MAP_20_u2_u1_u1 4.99511719 _CNV_A_R_LINEAR_____3_CM 0. 4.99511719 DISPLAY_IDENTIFIER IP_VLS_CAT_INT_MAX_AT FORMAT "%5.3"
 /begin AXIS_DESCR COM_AXIS n_32 _CNV_A_R_LINEAR_____15_CM 6 0. 8160. FORMAT "%4.0" AXIS_PTS_REF ldpm_n_32_1_egtr /end AXIS_DESCR
 /begin AXIS_DESCR COM_AXIS maf _CNV_A_R_LINEAR_____27_CM 6 0. 1389. FORMAT "%4.0" AXIS_PTS_REF ldpm_maf_1_egtr /end AXIS_DESCR
/end CHARACTERISTIC
/begin CHARACTERISTIC c_sum_min_cat_diag "min. threshold of required monitoring cycles for catalyst diagnosis " VALUE 0xffe418b6 _REC_VAL_20_u2 511. _CNV_A_R_LINEAR_____22_CM 0. 511. DISPLAY_IDENTIFIER C_SUM_MIN_CAT_DIAG FORMAT "%4.0" /end CHARACTERISTIC
/begin CHARACTERISTIC c_cat_max_diag "max. threshold for CAT_DIAG to detect a catalyst with malfunction" VALUE 0xffe40651 _REC_VAL_20_u1 1.984375 _CNV_A_R_LINEAR_____248_CM 0. 1.984375 DISPLAY_IDENTIFIER C_CAT_MAX_DIAG FORMAT "%4.2" /end CHARACTERISTIC
/begin CHARACTERISTIC c_n_32_cat_diag_deac_thd "Engine speed threshold to deactivate catalyst diagnosis to save ECU performance" VALUE 0xffe407bf _REC_VAL_20_u1 8160. _CNV_A_R_LINEAR_____15_CM 0. 8160. DISPLAY_IDENTIFIER C_N_32_CAT_DIAG_DEAC_THD FORMAT "%4.0" /end CHARACTERISTIC
/begin CHARACTERISTIC c_o2_cat_mv_max "max. O2_CAT_MV threshold for a valid monitoring cycle" VALUE 0xffe4185a _REC_VAL_20_u2 4.99511719 _CNV_A_R_LINEAR_____3_CM 0. 4.99511719 DISPLAY_IDENTIFIER C_O2_CAT_MV_MAX FORMAT "%5.3" /end CHARACTERISTIC
/begin CHARACTERISTIC c_o2_cat_mv_delta_max "max. allowed fluctuation between O2_CAT_MV and O2_DOWN in the same monitoring cycle" VALUE 0xffe41856 _REC_VAL_20_u2 4.99511719 _CNV_A_R_LINEAR_____3_CM 0. 4.99511719 DISPLAY_IDENTIFIER C_O2_CAT_MV_DELTA_MAX FORMAT "%5.3" /end CHARACTERISTIC
/begin CHARACTERISTIC c_o2_cat_mv_dif_max "max. allowed O2_CAT_MV fluctuation between 2 subsequent monitoring cycles" VALUE 0xffe41858 _REC_VAL_20_u2 4.99511719 _CNV_A_R_LINEAR_____3_CM 0. 4.99511719 DISPLAY_IDENTIFIER C_O2_CAT_MV_DIF_MAX FORMAT "%5.3" /end CHARACTERISTIC
/begin CHARACTERISTIC ip_vls_cat_int_max_mt "weight factor of downstream sensor signal integral for manual transmission" MAP 0xffe5065e _REC_MAP_20_u2_u1_u1 4.99511719 _CNV_A_R_LINEAR_____3_CM 0. 4.99511719 DISPLAY_IDENTIFIER IP_VLS_CAT_INT_MAX_MT FORMAT "%5.3"
 /begin AXIS_DESCR COM_AXIS n_32 _CNV_A_R_LINEAR_____15_CM 6 0. 8160. FORMAT "%4.0" AXIS_PTS_REF ldpm_n_32_1_egtr /end AXIS_DESCR
 /begin AXIS_DESCR COM_AXIS maf _CNV_A_R_LINEAR_____27_CM 6 0. 1389. FORMAT "%4.0" AXIS_PTS_REF ldpm_maf_1_egtr /end AXIS_DESCR
/end CHARACTERISTIC
/begin CHARACTERISTIC ip_o2_cat "o2_load linearization from downstream LS signal" CURVE 0xffe4d7a6 _REC_CUR_20_u2_u2 4.99511719 _CNV_A_R_LINEAR_____330_CM 0. 4.99511719 DISPLAY_IDENTIFIER IP_O2_CAT FORMAT "%5.3"
 /begin AXIS_DESCR COM_AXIS online_dummy _CNV_A_R_LINEAR_____3_CM 12 0. 4.99511719 FORMAT "%5.3" AXIS_PTS_REF ldp_vls_down_ip_o2_cat /end AXIS_DESCR
/end CHARACTERISTIC
/begin AXIS_PTS ldp_vls_down_ip_o2_cat "" 0xffe516b4 online_dummy _REC_AXS_20_u2 4.99511719 _CNV_A_R_LINEAR_____3_CM 12 0. 4.99511719 DISPLAY_IDENTIFIER LDP_VLS_DOWN_IP_O2_CAT FORMAT "%5.3" /end AXIS_PTS
/begin AXIS_PTS ldpm_n_32_1_egtr "" 0xffe41389 n_32 _REC_AXS_20_u1 8160. _CNV_A_R_LINEAR_____15_CM 6 0. 8160. DISPLAY_IDENTIFIER LDPM_N_32_1_EGTR FORMAT "%4.0" /end AXIS_PTS
/begin AXIS_PTS ldpm_maf_1_egtr "" 0xffe41364 maf _REC_AXS_20_u1 1389. _CNV_A_R_LINEAR_____27_CM 6 0. 1389. DISPLAY_IDENTIFIER LDPM_MAF_1_EGTR FORMAT "%4.0" /end AXIS_PTS
/begin MEASUREMENT lv_err_cat_diag_1 "failure after filtering diagnosis value cat diag" UBYTE _CNV_S_2_RANGE______1_R_CM 1 100. 0. 255. DISPLAY_IDENTIFIER LV_ERR_CAT_DIAG_1 ECU_ADDRESS 0x3fbb48 /end MEASUREMENT
/begin MEASUREMENT lv_err_cat_diag_2 "failure after filtering diagnosis value cat diag" UBYTE _CNV_S_2_RANGE______1_R_CM 1 100. 0. 255. DISPLAY_IDENTIFIER LV_ERR_CAT_DIAG_2 ECU_ADDRESS 0x3fbb4c /end MEASUREMENT
/begin CHARACTERISTIC c_o2_cat_mv_min "min. O2_CAT_MV threshold for a valid monitoring cycle" VALUE 0xffe4185c _REC_VAL_20_u2 4.99511719 _CNV_A_R_LINEAR_____3_CM 0. 4.99511719 DISPLAY_IDENTIFIER C_O2_CAT_MV_MIN FORMAT "%5.3" /end CHARACTERISTIC
/begin CHARACTERISTIC c_ctr_cat_diag_lam_out "Threshold to switch off Cat Diag due to O2_CAT_MV_i is not in the right range" VALUE 0xffe406a2 _REC_VAL_20_u1 255. _CNV_A_R_LINEAR_____0_CM 0. 255. DISPLAY_IDENTIFIER C_CTR_CAT_DIAG_LAM_OUT FORMAT "%3.0" /end CHARACTERISTIC
/begin CHARACTERISTIC c_lam_min_fsd "Lambda controller maximum threshold for fuel system diagnosis" VALUE 0xffe40430 _REC_VAL_20_s2 199.99694824 _CNV_A_R_LINEAR_____321_CM -100. 99.99694824 DISPLAY_IDENTIFIER C_LAM_MIN_FSD FORMAT "%8.3" /end CHARACTERISTIC
/begin CHARACTERISTIC c_lam_max_fsd "Lambda controller minimum threshold for fuel system diagnosis" VALUE 0xffe4042e _REC_VAL_20_s2 199.99694824 _CNV_A_R_LINEAR_____321_CM -100. 99.99694824 DISPLAY_IDENTIFIER C_LAM_MAX_FSD FORMAT "%8.3" /end CHARACTERISTIC
/begin CHARACTERISTIC c_t_sum_max_max_fsd "Time counter threshold for T_SUM_MAX_FSD_i" VALUE 0xffe419f6 _REC_VAL_20_u2 1310.68 _CNV_A_R_LINEAR_____198_CM 2.e-002 1310.7 DISPLAY_IDENTIFIER C_T_SUM_MAX_MAX_FSD FORMAT "%7.2" /end CHARACTERISTIC
/begin CHARACTERISTIC c_t_sum_min_max_fsd "Time counter threshold for T_SUM_MIN_FSD_i" VALUE 0xffe419fa _REC_VAL_20_u2 1310.68 _CNV_A_R_LINEAR_____198_CM 2.e-002 1310.7 DISPLAY_IDENTIFIER C_T_SUM_MIN_MAX_FSD FORMAT "%7.2" /end CHARACTERISTIC
/begin CHARACTERISTIC c_t_sum_rst_max_fsd "Time counter threshold for T_SUM_RST_FSD_i" VALUE 0xffe41a00 _REC_VAL_20_u2 1310.68 _CNV_A_R_LINEAR_____198_CM 2.e-002 1310.7 DISPLAY_IDENTIFIER C_T_SUM_RST_MAX_FSD FORMAT "%7.2" /end CHARACTERISTIC
/begin CHARACTERISTIC c_n_min_fsd "Engine speed threshold for fuel system diagnosis" VALUE 0xffe407f6 _REC_VAL_20_u1 8160. _CNV_A_R_LINEAR_____15_CM 0. 8160. DISPLAY_IDENTIFIER C_N_MIN_FSD FORMAT "%4.0" /end CHARACTERISTIC
/begin CHARACTERISTIC c_maf_min_fsd "Mass air flow threshold for fuel system diagnosis" VALUE 0xffe40793 _REC_VAL_20_u1 1389. _CNV_A_R_LINEAR_____27_CM 0. 1389. DISPLAY_IDENTIFIER C_MAF_MIN_FSD FORMAT "%4.0" /end CHARACTERISTIC
/begin CHARACTERISTIC c_tco_min_fsd "Minimum threshold of TCO for fuel system diagnosis" VALUE 0xffe40917 _REC_VAL_20_u1 190.5 _CNV_A_R_LINEAR_____11_CM -48. 142.5 DISPLAY_IDENTIFIER C_TCO_MIN_FSD FORMAT "%5.1" /end CHARACTERISTIC
/begin CHARACTERISTIC id_stop_inc_fsd__tco_st "Increasing value for the debounce counter STOP_FSD" CURVE 0xffe40a85 _REC_CUR_20_u1_u1 255. _CNV_A_R_LINEAR_____0_CM 0. 255. DISPLAY_IDENTIFIER ID_STOP_INC_FSD__TCO_ST FORMAT "%3.0"
 /begin AXIS_DESCR COM_AXIS tco_st _CNV_A_R_LINEAR_____11_CM 4 -48. 142.5 FORMAT "%5.1" AXIS_PTS_REF ldp_tco_st__stop_inc_fsd /end AXIS_DESCR
/end CHARACTERISTIC
/begin CHARACTERISTIC id_stop_dec_fsd__toil_max "Decreasing value for the debounce counter STOP_FSD" CURVE 0xffe40a81 _REC_CUR_20_u1_u1 255. _CNV_A_R_LINEAR_____0_CM 0. 255. DISPLAY_IDENTIFIER ID_STOP_DEC_FSD__TOIL_MAX FORMAT "%3.0"
 /begin AXIS_DESCR COM_AXIS toil_max _CNV_A_R_LINEAR_____14_CM 4 -40. 160. FORMAT "%3.0" AXIS_PTS_REF ldp_toil_max__stop_dec_fsd /end AXIS_DESCR
/end CHARACTERISTIC
/begin MEASUREMENT toil_max "Maximum oil temperature from the last engine running" UBYTE _CNV_A_R_LINEAR_____14_CM 1 100. -40. 160. DISPLAY_IDENTIFIER TOIL_MAX ECU_ADDRESS 0x3fea53 FORMAT "%3.0" /end MEASUREMENT
/begin MEASUREMENT ctr_stop_fsd "Counter value as a measure of the oil dilution under cold start conditions" UBYTE _CNV_A_R_LINEAR_____0_CM 1 100. 0. 255. DISPLAY_IDENTIFIER CTR_STOP_FSD ECU_ADDRESS 0x3fea52 FORMAT "%3.0" /end MEASUREMENT
/begin CHARACTERISTIC c_stop_max_fsd "Maximum value for the debounce counter STOP_FSD" VALUE 0xffe40847 _REC_VAL_20_u1 255. _CNV_A_R_LINEAR_____0_CM 0. 255. DISPLAY_IDENTIFIER C_STOP_MAX_FSD FORMAT "%3.0" /end CHARACTERISTIC
/begin AXIS_PTS ldp_toil_max__stop_dec_fsd "" 0xffe412ca toil_max _REC_AXS_20_u1 200. _CNV_A_R_LINEAR_____14_CM 4 -40. 160. DISPLAY_IDENTIFIER LDP_TOIL_MAX__STOP_DEC_FSD FORMAT "%3.0" /end AXIS_PTS
/begin AXIS_PTS ldp_tco_st__stop_inc_fsd "" 0xffe41219 tco_st _REC_AXS_20_u1 190.5 _CNV_A_R_LINEAR_____11_CM 4 -48. 142.5 DISPLAY_IDENTIFIER LDP_TCO_ST__STOP_INC_FSD FORMAT "%5.1" /end AXIS_PTS
/begin CHARACTERISTIC c_amp_min_fsd "Minimum ambient pressure threshold for fuel system diagnosis" VALUE 0xffe414f6 _REC_VAL_20_u2 5434. _CNV_A_R_LINEAR_____49_CM 0. 5434. DISPLAY_IDENTIFIER C_AMP_MIN_FSD FORMAT "%7.2" /end CHARACTERISTIC
/begin CHARACTERISTIC c_tam_min_fsd "Minimum ambient temperature threshold for fuel system diagnosis" VALUE 0xffe408dc _REC_VAL_20_u1 190.5 _CNV_A_R_LINEAR_____11_CM -48. 142.5 DISPLAY_IDENTIFIER C_TAM_MIN_FSD FORMAT "%5.1" /end CHARACTERISTIC
/begin CHARACTERISTIC c_t_min_maf_fsd "Minimum time at 'low load' for deactivating FSD" VALUE 0xffe419b4 _REC_VAL_20_u2 1310.68 _CNV_A_R_LINEAR_____198_CM 2.e-002 1310.7 DISPLAY_IDENTIFIER C_T_MIN_MAF_FSD FORMAT "%7.2" /end CHARACTERISTIC
/begin CHARACTERISTIC c_t_dly_maf_fsd "Minimum time at 'no low load' for deactivating FSD" VALUE 0xffe4191e _REC_VAL_20_u2 1310.68 _CNV_A_R_LINEAR_____198_CM 2.e-002 1310.7 DISPLAY_IDENTIFIER C_T_DLY_MAF_FSD FORMAT "%7.2" /end CHARACTERISTIC
/begin CHARACTERISTIC c_n_min_mff_ad_add_fsd "Minimum engine speed for consideration of MFF_AD_ADD_MMV_REL_QUO" VALUE 0xffe407fa _REC_VAL_20_u1 8160. _CNV_A_R_LINEAR_____15_CM 0. 8160. DISPLAY_IDENTIFIER C_N_MIN_MFF_AD_ADD_FSD FORMAT "%4.0" /end CHARACTERISTIC
/begin CHARACTERISTIC c_maf_min_mff_ad_add_fsd "Minimum engine load for consideration of MFF_AD_ADD_MMV_REL_QUO" VALUE 0xffe40795 _REC_VAL_20_u1 1389. _CNV_A_R_LINEAR_____27_CM 0. 1389. DISPLAY_IDENTIFIER C_MAF_MIN_MFF_AD_ADD_FSD FORMAT "%4.0" /end CHARACTERISTIC
/begin CHARACTERISTIC c_fac_cp_fsd "Velocity of time integration during canister purge phase" VALUE 0xffe40733 _REC_VAL_20_u1 0.99610001 _CNV_A_R_LINEAR_____29_CM 0. 0.99610001 DISPLAY_IDENTIFIER C_FAC_CP_FSD FORMAT "%5.3" /end CHARACTERISTIC
/begin CHARACTERISTIC lc_inh_ls_down_man_deac "Manual deactivation of downstream oxygen sensor diagnosis" VALUE 0xffe40f7e _REC_VAL_20_u1 1. _CNV_A_R_LINEAR_____22_CM 0. 1. DISPLAY_IDENTIFIER LC_INH_LS_DOWN_MAN_DEAC FORMAT "%2.0" /end CHARACTERISTIC
/begin CHARACTERISTIC c_vls_down_hys "Monitor sensor voltage hysteresis" VALUE 0xffe41b52 _REC_VAL_20_u2 4.99511719 _CNV_A_R_LINEAR_____3_CM 0. 4.99511719 DISPLAY_IDENTIFIER C_VLS_DOWN_HYS FORMAT "%5.3" /end CHARACTERISTIC
/begin CHARACTERISTIC ip_vls_down_max_cycnr "Weighting factor for CYCNR_VLS_DOWN_ACT_i" CURVE 0xffe40edf _REC_CUR_20_u1_u2 5100. _CNV_A_R_LINEAR_____313_CM 0. 5100. DISPLAY_IDENTIFIER IP_VLS_DOWN_MAX_CYCNR FORMAT "%5.0"
 /begin AXIS_DESCR COM_AXIS maf_kgh _CNV_A_R_LINEAR_____115_CM 8 0. 2047.96875 FORMAT "%7.2" AXIS_PTS_REF ldp_maf_kgh__vls_down_max_cycnr /end AXIS_DESCR
/end CHARACTERISTIC
/begin CHARACTERISTIC c_cycnr_vls_down_max "Diagnostic threshold for VLS_DOWN_CYCNR_i" VALUE 0xffe406df _REC_VAL_20_u1 1.99220002 _CNV_A_R_LINEAR_____39_CM 0. 1.99220002 DISPLAY_IDENTIFIER C_CYCNR_VLS_DOWN_MAX FORMAT "%5.3" /end CHARACTERISTIC
/begin MEASUREMENT maf_kgh_min_puc "minimum value of MAF_KGH while switching time calculation" UWORD _CNV_A_R_LINEAR_____115_CM 1 100. 0. 2047.96875 DISPLAY_IDENTIFIER MAF_KGH_MIN_PUC ECU_ADDRESS 0x3fdbfe BYTE_ORDER MSB_LAST FORMAT "%7.2" /end MEASUREMENT
/begin MEASUREMENT maf_int_pue "sucked air mass after leaving PUC" UWORD _CNV_A_R_LINEAR_____287_CM 1 100. 0. 1820.398 DISPLAY_IDENTIFIER MAF_INT_PUE ECU_ADDRESS 0x3fd38a BYTE_ORDER MSB_LAST FORMAT "%7.2" /end MEASUREMENT
/begin MEASUREMENT lv_req_diag_ls_down "Logical variable" UBYTE _CNV_S_2_RANGE______2_CM 1 100. 0. 1. DISPLAY_IDENTIFIER LV_REQ_DIAG_LS_DOWN ECU_ADDRESS 0x3fea58 BIT_MASK 0x1 /end MEASUREMENT
/begin MEASUREMENT lv_end_diag_ls_down "Logical variable" UBYTE _CNV_S_2_RANGE______2_CM 1 100. 0. 1. DISPLAY_IDENTIFIER LV_END_DIAG_LS_DOWN ECU_ADDRESS 0x3fea59 BIT_MASK 0x1 /end MEASUREMENT
/begin AXIS_PTS ldp_maf_kgh__vls_down_max_cycnr "" 0xffe50e4e maf_kgh _REC_AXS_20_u2 2047.96875 _CNV_A_R_LINEAR_____115_CM 8 0. 2047.96875 DISPLAY_IDENTIFIER LDP_MAF_KGH__VLS_DOWN_MAX_CYCNR FORMAT "%7.2" /end AXIS_PTS
/begin CHARACTERISTIC c_tco_min_ls_down "Minimum coolant temperature for diagnosis of the monitor sensors" VALUE 0xffe40919 _REC_VAL_20_u1 190.5 _CNV_A_R_LINEAR_____11_CM -48. 142.5 DISPLAY_IDENTIFIER C_TCO_MIN_LS_DOWN FORMAT "%5.1" /end CHARACTERISTIC
/begin CHARACTERISTIC c_vs_max_ls_down "Maximum vehicle speed for diagnosis of the monitor sensors" VALUE 0xffe409dc _REC_VAL_20_u1 255. _CNV_A_R_LINEAR_____23_CM 0. 255. DISPLAY_IDENTIFIER C_VS_MAX_LS_DOWN FORMAT "%3.0" /end CHARACTERISTIC
/begin CHARACTERISTIC c_vs_min_ls_down "Minimum vehicle speed for diagnosis of the monitor sensors" VALUE 0xffe409e5 _REC_VAL_20_u1 255. _CNV_A_R_LINEAR_____23_CM 0. 255. DISPLAY_IDENTIFIER C_VS_MIN_LS_DOWN FORMAT "%3.0" /end CHARACTERISTIC
/begin CHARACTERISTIC c_temp_cat_min_ls_down "Catalyst temperature threshold for diagnosis of the monitor sensors" VALUE 0xffe40942 _REC_VAL_20_u1 1020. _CNV_A_R_LINEAR_____178_CM -33. 987. DISPLAY_IDENTIFIER C_TEMP_CAT_MIN_LS_DOWN FORMAT "%3.0" /end CHARACTERISTIC
/begin CHARACTERISTIC c_maf_kgh_max_puc_ls_down "Mass air flow threshold for diagnosis of the switching times" VALUE 0xffe417a2 _REC_VAL_20_u2 2047.96875 _CNV_A_R_LINEAR_____115_CM 0. 2047.96875 DISPLAY_IDENTIFIER C_MAF_KGH_MAX_PUC_LS_DOWN FORMAT "%7.2" /end CHARACTERISTIC
/begin CHARACTERISTIC c_maf_kgh_min_puc_ls_down "Mass air flow threshold for diagnosis of the switching times" VALUE 0xffe417a4 _REC_VAL_20_u2 2047.96875 _CNV_A_R_LINEAR_____115_CM 0. 2047.96875 DISPLAY_IDENTIFIER C_MAF_KGH_MIN_PUC_LS_DOWN FORMAT "%7.2" /end CHARACTERISTIC
/begin CHARACTERISTIC c_vls_down_min_puc_diag "Voltage threshold for monitor sensor diagnosis" VALUE 0xffe41b62 _REC_VAL_20_u2 4.99511719 _CNV_A_R_LINEAR_____3_CM 0. 4.99511719 DISPLAY_IDENTIFIER C_VLS_DOWN_MIN_PUC_DIAG FORMAT "%5.3" /end CHARACTERISTIC
/begin CHARACTERISTIC c_fac_vls_down_max_diag "Reduction factor for start of switching time determination" VALUE 0xffe4074f _REC_VAL_20_u1 0.9960940000000002 _CNV_A_R_LINEAR_____50_CM 0. 0.996094 DISPLAY_IDENTIFIER C_FAC_VLS_DOWN_MAX_DIAG FORMAT "%5.3" /end CHARACTERISTIC
/begin CHARACTERISTIC c_fac_vls_down_min_diag "Reduction factor for end of switching time determination" VALUE 0xffe40750 _REC_VAL_20_u1 0.9960940000000002 _CNV_A_R_LINEAR_____50_CM 0. 0.996094 DISPLAY_IDENTIFIER C_FAC_VLS_DOWN_MIN_DIAG FORMAT "%5.3" /end CHARACTERISTIC
/begin CHARACTERISTIC c_sum_min_vls_down_diag "Condition for the start of the lambda sensor switching time check" VALUE 0xffe40852 _REC_VAL_20_u1 254. _CNV_A_R_LINEAR_____0_CM 1. 255. DISPLAY_IDENTIFIER C_SUM_MIN_VLS_DOWN_DIAG FORMAT "%3.0" /end CHARACTERISTIC
/begin CHARACTERISTIC c_maf_int_puc_ls_down_pue "Threshold for start of the diagnosis" VALUE 0xffe41782 _REC_VAL_20_u2 1820.398 _CNV_A_R_LINEAR_____287_CM 0. 1820.398 DISPLAY_IDENTIFIER C_MAF_INT_PUC_LS_DOWN_PUE FORMAT "%7.2" /end CHARACTERISTIC
/begin CHARACTERISTIC c_maf_int_ls_down_pue "Threshold for start of the diagnosis" VALUE 0xffe41758 _REC_VAL_20_u2 1820.398 _CNV_A_R_LINEAR_____287_CM 0. 1820.398 DISPLAY_IDENTIFIER C_MAF_INT_LS_DOWN_PUE FORMAT "%7.2" /end CHARACTERISTIC
/begin CHARACTERISTIC c_ctr_min_end_diag_ls_down_pue "Time counter threshold for CTR_END_DIAG_VLS_DOWN_PUE_i" VALUE 0xffe41584 _REC_VAL_20_u2 65534. _CNV_A_R_LINEAR_____0_CM 1. 65535. DISPLAY_IDENTIFIER C_CTR_MIN_END_DIAG_LS_DOWN_PUE FORMAT "%5.0" /end CHARACTERISTIC
/begin CHARACTERISTIC c_ctr_inc_ls_down_pue "Counter increment for VLS_DOWN_PUE diagnosis" VALUE 0xffe406ce _REC_VAL_20_u1 255. _CNV_A_R_LINEAR_____0_CM 0. 255. DISPLAY_IDENTIFIER C_CTR_INC_LS_DOWN_PUE FORMAT "%3.0" /end CHARACTERISTIC
/begin CHARACTERISTIC c_ctr_max_ls_down_pue "Max value of counter for VLS_DOWN_PUE diagnosis" VALUE 0xffe406d2 _REC_VAL_20_u1 255. _CNV_A_R_LINEAR_____0_CM 0. 255. DISPLAY_IDENTIFIER C_CTR_MAX_LS_DOWN_PUE FORMAT "%3.0" /end CHARACTERISTIC
/begin CHARACTERISTIC c_vls_down_dif_min_diag "Threshold for VLS_DOWN_DIF_DIAG" VALUE 0xffe41b50 _REC_VAL_20_u2 4.99511719 _CNV_A_R_LINEAR_____3_CM 0. 4.99511719 DISPLAY_IDENTIFIER C_VLS_DOWN_DIF_MIN_DIAG FORMAT "%5.3" /end CHARACTERISTIC
/begin MEASUREMENT lv_err_ls_down_pue_1 "debounded diagnosis result of pull end plausibility" UBYTE _CNV_S_2_RANGE______1_R_CM 1 100. 0. 255. DISPLAY_IDENTIFIER LV_ERR_LS_DOWN_PUE_1 ECU_ADDRESS 0x3fba40 /end MEASUREMENT
/begin MEASUREMENT lv_err_ls_down_pue_2 "debounded diagnosis result of pull end plausibility" UBYTE _CNV_S_2_RANGE______1_R_CM 1 100. 0. 255. DISPLAY_IDENTIFIER LV_ERR_LS_DOWN_PUE_2 ECU_ADDRESS 0x3fba44 /end MEASUREMENT
/begin MEASUREMENT lv_err_ls_down_swt_1 "error bit for switchtime diagnosis" UBYTE _CNV_S_2_RANGE______1_R_CM 1 100. 0. 255. DISPLAY_IDENTIFIER LV_ERR_LS_DOWN_SWT_1 ECU_ADDRESS 0x3fba38 /end MEASUREMENT
/begin MEASUREMENT lv_err_ls_down_swt_2 "error bit for switchtime diagnosis" UBYTE _CNV_S_2_RANGE______1_R_CM 1 100. 0. 255. DISPLAY_IDENTIFIER LV_ERR_LS_DOWN_SWT_2 ECU_ADDRESS 0x3fba3c /end MEASUREMENT
/begin CHARACTERISTIC c_t_dly_pow_ctl_obd2_lsh_up "Time delay after last condition met (normally POW_CTL) prior to starting diagnosis\n" VALUE 0xffe4088e _REC_VAL_20_u1 255. _CNV_A_R_LINEAR_____30_CM 0. 255. DISPLAY_IDENTIFIER C_T_DLY_POW_CTL_OBD2_LSH_UP FORMAT "%3.0" /end CHARACTERISTIC
/begin CHARACTERISTIC c_ttip_ls_up_min_obd2 "Lower diagnosis threshold for oxygen sensor ceramic temperature\n" VALUE 0xffe404f4 _REC_VAL_20_s2 4095.938 _CNV_A_R_LINEAR_____303_CM -2048. 2047.938 DISPLAY_IDENTIFIER C_TTIP_LS_UP_MIN_OBD2 FORMAT "%8.2" /end CHARACTERISTIC
/begin CHARACTERISTIC c_ttip_ls_up_max_obd2 "Upper diagnosis threshold for oxygen sensor ceramic temperature\n" VALUE 0xffe404f2 _REC_VAL_20_s2 4095.938 _CNV_A_R_LINEAR_____303_CM -2048. 2047.938 DISPLAY_IDENTIFIER C_TTIP_LS_UP_MAX_OBD2 FORMAT "%8.2" /end CHARACTERISTIC
/begin CHARACTERISTIC ip_t_dly_raw_obd2_lsh_up "Time after heater management start to exaggerated forced stimulation if no raw readiness detected" CURVE 0xffe4e876 _REC_CUR_20_u2_u2 6553.5 _CNV_A_R_LINEAR_____24_CM 0. 6553.5 DISPLAY_IDENTIFIER IP_T_DLY_RAW_OBD2_LSH_UP FORMAT "%6.1"
 /begin AXIS_DESCR COM_AXIS online_dummy _CNV_A_R_LINEAR_____368_CM 6 -2048. 2047.938 FORMAT "%8.2" AXIS_PTS_REF ldpm_temp_ls_ini_1_egcp /end AXIS_DESCR
/end CHARACTERISTIC
/begin CHARACTERISTIC ip_t_ls_ready_obd2_lsh_up "Time threshold after heater management start where fault detected if no full operative readiness observed" CURVE 0xffe4ea9a _REC_CUR_20_u2_u2 6553.5 _CNV_A_R_LINEAR_____24_CM 0. 6553.5 DISPLAY_IDENTIFIER IP_T_LS_READY_OBD2_LSH_UP FORMAT "%6.1"
 /begin AXIS_DESCR COM_AXIS online_dummy _CNV_A_R_LINEAR_____368_CM 6 -2048. 2047.938 FORMAT "%8.2" AXIS_PTS_REF ldpm_temp_ls_ini_1_egcp /end AXIS_DESCR
/end CHARACTERISTIC
/begin CHARACTERISTIC lc_rep_obd2_lsh_up "Logical constant permitting diagnosis to be repeated within one driving cycle" VALUE 0xffe40fce _REC_VAL_20_u1 1. _CNV_A_R_LINEAR_____0_CM 0. 1. DISPLAY_IDENTIFIER LC_REP_OBD2_LSH_UP FORMAT "%2.0" /end CHARACTERISTIC
/begin CHARACTERISTIC lc_obd2_lsh_up "Logical constant permitting diagnosis to be carried out" VALUE 0xffe40fc3 _REC_VAL_20_u1 1. _CNV_A_R_LINEAR_____0_CM 0. 1. DISPLAY_IDENTIFIER LC_OBD2_LSH_UP FORMAT "%2.0" /end CHARACTERISTIC
/begin MEASUREMENT lv_inh_diag_obd2_lsh_up_1 "Boolean inhibit flag for O2 sensor heater OBDII monitoring" UBYTE _CNV_S_2_RANGE______2_CM 1 100. 0. 1. DISPLAY_IDENTIFIER LV_INH_DIAG_OBD2_LSH_UP_1 ECU_ADDRESS 0x3fea1c /end MEASUREMENT
/begin MEASUREMENT lv_inh_diag_obd2_lsh_up_2 "Boolean inhibit flag for O2 sensor heater OBDII monitoring" UBYTE _CNV_S_2_RANGE______2_CM 1 100. 0. 1. DISPLAY_IDENTIFIER LV_INH_DIAG_OBD2_LSH_UP_2 ECU_ADDRESS 0x3fea1d /end MEASUREMENT
/begin CHARACTERISTIC c_tcc_obd2_lsh_up "Number of valid upstream LSH OBDII diagnosis cycles over which statistic evaluation to be carried out" VALUE 0xffe41a2e _REC_VAL_20_u2 1023. _CNV_A_R_LINEAR_____22_CM 0. 1023. DISPLAY_IDENTIFIER C_TCC_OBD2_LSH_UP FORMAT "%4.0" /end CHARACTERISTIC
/begin CHARACTERISTIC ip_n_32_min_diag_sa "Minimum speed to start the SA diagnosis" CURVE 0xffe40d38 _REC_CUR_20_u1_u2 8160. _CNV_A_R_LINEAR_____15_CM 0. 8160. DISPLAY_IDENTIFIER IP_N_32_MIN_DIAG_SA FORMAT "%4.0"
 /begin AXIS_DESCR COM_AXIS fac_amp _CNV_A_R_LINEAR_____20_CM 6 0. 1.99996948 FORMAT "%7.5" AXIS_PTS_REF ldpm_fac_amp /end AXIS_DESCR
/end CHARACTERISTIC
/begin CHARACTERISTIC ip_maf_kgh_max_diag_sa "Maximum load [kg/h] for break-off the SA diagnosis" CURVE 0xffe4ce1a _REC_CUR_20_u2_u2 2047.96875 _CNV_A_R_LINEAR_____115_CM 0. 2047.96875 DISPLAY_IDENTIFIER IP_MAF_KGH_MAX_DIAG_SA FORMAT "%7.2"
 /begin AXIS_DESCR COM_AXIS fac_amp _CNV_A_R_LINEAR_____20_CM 6 0. 1.99996948 FORMAT "%7.5" AXIS_PTS_REF ldpm_fac_amp /end AXIS_DESCR
/end CHARACTERISTIC
/begin CHARACTERISTIC ip_maf_max_diag_sa "Maximum load [mg/str] for break-off the SA diagnosis" CURVE 0xffe40cf4 _REC_CUR_20_u1_u1 1389. _CNV_A_R_LINEAR_____27_CM 0. 1389. DISPLAY_IDENTIFIER IP_MAF_MAX_DIAG_SA FORMAT "%4.0"
 /begin AXIS_DESCR COM_AXIS n_32 _CNV_A_R_LINEAR_____15_CM 8 0. 8160. FORMAT "%4.0" AXIS_PTS_REF ldp_n_32__maf_max_diag_sa /end AXIS_DESCR
/end CHARACTERISTIC
/begin CHARACTERISTIC c_ti_add_wf_max_diag_sa "Maximum TI_ADD_WF threshold to start the SA diagnosis" VALUE 0xffe40496 _REC_VAL_20_s2 262.14 _CNV_A_R_LINEAR_____165_CM -131.072 131.068 DISPLAY_IDENTIFIER C_TI_ADD_WF_MAX_DIAG_SA FORMAT "%8.3" /end CHARACTERISTIC
/begin CHARACTERISTIC c_ti_add_wf_min_diag_sa "Minimum TI_ADD_WF threshold to start the SA diagnosis" VALUE 0xffe40498 _REC_VAL_20_s2 262.14 _CNV_A_R_LINEAR_____165_CM -131.072 131.068 DISPLAY_IDENTIFIER C_TI_ADD_WF_MIN_DIAG_SA FORMAT "%8.3" /end CHARACTERISTIC
/begin CHARACTERISTIC lc_inh_sa_man_deac "Manual deactivation of SA diagnosis inhibition conditions" VALUE 0xffe40f85 _REC_VAL_20_u1 1. _CNV_A_R_LINEAR_____0_CM 0. 1. DISPLAY_IDENTIFIER LC_INH_SA_MAN_DEAC FORMAT "%2.0" /end CHARACTERISTIC
/begin CHARACTERISTIC id_tco_min_diag_sa "Minimum load [mg/str] to start the SA diagnosis" CURVE 0xffe40aa1 _REC_CUR_20_u1_u1 190.5 _CNV_A_R_LINEAR_____11_CM -48. 142.5 DISPLAY_IDENTIFIER ID_TCO_MIN_DIAG_SA FORMAT "%5.1"
 /begin AXIS_DESCR COM_AXIS tia _CNV_A_R_LINEAR_____11_CM 6 -48. 142.5 FORMAT "%5.1" AXIS_PTS_REF ldp_tia_id_tco_min_diag_sa /end AXIS_DESCR
/end CHARACTERISTIC
/begin CHARACTERISTIC ip_maf_min_diag_sa "Minimum load [mg/str] to start the SA diagnosis" CURVE 0xffe40d0e _REC_CUR_20_u1_u2 1389. _CNV_A_R_LINEAR_____27_CM 0. 1389. DISPLAY_IDENTIFIER IP_MAF_MIN_DIAG_SA FORMAT "%4.0"
 /begin AXIS_DESCR COM_AXIS fac_amp _CNV_A_R_LINEAR_____20_CM 6 0. 1.99996948 FORMAT "%7.5" AXIS_PTS_REF ldpm_fac_amp /end AXIS_DESCR
/end CHARACTERISTIC
/begin CHARACTERISTIC c_n_32_max_diag_sa "Maximum speed to start the SA diagnosis" VALUE 0xffe407c4 _REC_VAL_20_u1 8160. _CNV_A_R_LINEAR_____15_CM 0. 8160. DISPLAY_IDENTIFIER C_N_32_MAX_DIAG_SA FORMAT "%4.0" /end CHARACTERISTIC
/begin AXIS_PTS ldp_tia_id_tco_min_diag_sa "" 0xffe41285 tia _REC_AXS_20_u1 190.5 _CNV_A_R_LINEAR_____11_CM 6 -48. 142.5 DISPLAY_IDENTIFIER LDP_TIA_ID_TCO_MIN_DIAG_SA FORMAT "%5.1" /end AXIS_PTS
/begin AXIS_PTS ldpm_fac_amp "" 0xffe5182c fac_amp _REC_AXS_20_u2 1.99996948 _CNV_A_R_LINEAR_____20_CM 6 0. 1.99996948 DISPLAY_IDENTIFIER LDPM_FAC_AMP FORMAT "%7.5" /end AXIS_PTS
/begin MEASUREMENT lv_err_fsd_1 "" UBYTE _CNV_S_2_RANGE______1_R_CM 1 100. 0. 255. DISPLAY_IDENTIFIER LV_ERR_FSD_1 ECU_ADDRESS 0x3fba30 /end MEASUREMENT
/begin MEASUREMENT lv_err_fsd_2 "" UBYTE _CNV_S_2_RANGE______1_R_CM 1 100. 0. 255. DISPLAY_IDENTIFIER LV_ERR_FSD_2 ECU_ADDRESS 0x3fba34 /end MEASUREMENT
/begin CHARACTERISTIC c_t_ast_tia_diag_sa "Time after start for TAM - determination" VALUE 0xffe418e2 _REC_VAL_20_u2 6553.2 _CNV_A_R_LINEAR_____24_CM 0.3 6553.5 DISPLAY_IDENTIFIER C_T_AST_TIA_DIAG_SA FORMAT "%6.1" /end CHARACTERISTIC
/begin CHARACTERISTIC c_tco_max_diag_sa "???" VALUE 0xffe40907 _REC_VAL_20_u1 190.5 _CNV_A_R_LINEAR_____11_CM -48. 142.5 DISPLAY_IDENTIFIER C_TCO_MAX_DIAG_SA FORMAT "%5.1" /end CHARACTERISTIC
/begin CHARACTERISTIC c_vls_afr_ready_sa_diag "VLS rich threshold to start the SAFM-monitoring" VALUE 0xffe41b40 _REC_VAL_20_u2 4.99511719 _CNV_A_R_LINEAR_____3_CM 0. 4.99511719 DISPLAY_IDENTIFIER C_VLS_AFR_READY_SA_DIAG FORMAT "%5.3" /end CHARACTERISTIC
/begin CHARACTERISTIC c_vls_afl_ready_sa_diag "VLS lean threshold to start the SAFM-monitoring" VALUE 0xffe41b3e _REC_VAL_20_u2 4.99511719 _CNV_A_R_LINEAR_____3_CM 0. 4.99511719 DISPLAY_IDENTIFIER C_VLS_AFL_READY_SA_DIAG FORMAT "%5.3" /end CHARACTERISTIC
/begin AXIS_PTS ldp_n_32__maf_max_diag_sa "" 0xffe4806e n_32 _REC_AXS_20_u1 816. _CNV_A_R_LINEAR_____15_CM 8 0. 8160. DISPLAY_IDENTIFIER LDP_N_32__MAF_MAX_DIAG_SA FORMAT "%4.0" /end AXIS_PTS
/begin MEASUREMENT lv_intr_diag_sa "Secondary air system diagnosis: application incidence to interrupt the diagnosis" UBYTE _CNV_S_2_RANGE______2_CM 1 100. 0. 1. DISPLAY_IDENTIFIER LV_INTR_DIAG_SA ECU_ADDRESS 0x3fe640 BIT_MASK 0x1 /end MEASUREMENT
/begin MEASUREMENT lv_vls_ready_sa_diag_up_1 "VLS lean threshold jto start diagnosis bank1" UBYTE _CNV_S_2_RANGE______2_CM 1 100. 0. 1. DISPLAY_IDENTIFIER LV_VLS_READY_SA_DIAG_UP_1 ECU_ADDRESS 0x3fe641 BIT_MASK 0x1 /end MEASUREMENT
/begin MEASUREMENT lv_vls_ready_sa_diag_up_2 "VLS lean threshold jto start diagnosis bank2" UBYTE _CNV_S_2_RANGE______2_CM 1 100. 0. 1. DISPLAY_IDENTIFIER LV_VLS_READY_SA_DIAG_UP_2 ECU_ADDRESS 0x3fe642 BIT_MASK 0x1 /end MEASUREMENT
/begin CHARACTERISTIC c_amp_min_sa_diag "Maximum speed to interrupt the SA diagnosis" VALUE 0xffe414fa _REC_VAL_20_u2 5434. _CNV_A_R_LINEAR_____49_CM 0. 5434. DISPLAY_IDENTIFIER C_AMP_MIN_SA_DIAG FORMAT "%7.2" /end CHARACTERISTIC
/begin CHARACTERISTIC ip_tq_add_cp__cl_mmv "MAP for dtermination of TQ_ADD_CP in dependence of CL_MMV" CURVE 0xffe4f94e _REC_CUR_20_u2_u2 2047.96875 _CNV_A_R_LINEAR_____187_CM -1024. 1023.96875 DISPLAY_IDENTIFIER IP_TQ_ADD_CP FORMAT "%6.2"
 /begin AXIS_DESCR COM_AXIS online_dummy _CNV_A_R_LINEAR_____394_CM 6 0. 7.99987793 FORMAT "%6.4" AXIS_PTS_REF ldp_cl_mmv /end AXIS_DESCR
/end CHARACTERISTIC
/begin MEASUREMENT tq_add_cp "Torque reserve for canister purge at idle" SWORD _CNV_A_R_LINEAR_____55_CM 1 100. -1024. 1023.96875 DISPLAY_IDENTIFIER TQ_ADD_CP ECU_ADDRESS 0x3fdf2a BYTE_ORDER MSB_LAST FORMAT "%8.2" /end MEASUREMENT
/begin CHARACTERISTIC c_crlc_tq_add_cp "Filter constant" VALUE 0xffe40694 _REC_VAL_20_u1 0.9960940000000002 _CNV_A_R_LINEAR_____50_CM 0. 0.996094 DISPLAY_IDENTIFIER C_CRLC_TQ_ADD_CP FORMAT "%5.3" /end CHARACTERISTIC
/begin CHARACTERISTIC lc_tq_add_cp_inh "Logical variable for inhibiting the torque reserve for canister purge in idle" VALUE 0xffe40fe6 _REC_VAL_20_u1 1. _CNV_A_R_LINEAR_____0_CM 0. 1. DISPLAY_IDENTIFIER LC_TQ_ADD_CP_INH FORMAT "%2.0" /end CHARACTERISTIC
/begin AXIS_PTS ldp_cl_mmv "" 0xffe50a8c online_dummy _REC_AXS_20_u2 7.99987793 _CNV_A_R_LINEAR_____394_CM 6 0. 7.99987793 DISPLAY_IDENTIFIER LDP_CL_MMV FORMAT "%6.4" /end AXIS_PTS
/begin MEASUREMENT vls_cur_on_vls_down_1 "Downstream oxygen sensor voltage C_T_CUR_ON_LS_DOWN after switching on pump current switch" UWORD _CNV_A_R_LINEAR_____3_CM 1 100. 0. 4.99511719 DISPLAY_IDENTIFIER VLS_CUR_ON_VLS_DOWN_1 ECU_ADDRESS 0x3fb400 BYTE_ORDER MSB_LAST FORMAT "%5.3" /end MEASUREMENT
/begin MEASUREMENT vls_cur_off_vls_down_1 "Downstream oxygen sensor voltage prior to switching on pump current switch" UWORD _CNV_A_R_LINEAR_____3_CM 1 100. 0. 4.99511719 DISPLAY_IDENTIFIER VLS_CUR_OFF_VLS_DOWN_1 ECU_ADDRESS 0x3fb402 BYTE_ORDER MSB_LAST FORMAT "%5.3" /end MEASUREMENT
/begin MEASUREMENT vls_cur_on_vls_down_2 "Downstream oxygen sensor voltage C_T_CUR_ON_LS_DOWN after switching on pump current switch" UWORD _CNV_A_R_LINEAR_____3_CM 1 100. 0. 4.99511719 DISPLAY_IDENTIFIER VLS_CUR_ON_VLS_DOWN_2 ECU_ADDRESS 0x3fb40a BYTE_ORDER MSB_LAST FORMAT "%5.3" /end MEASUREMENT
/begin MEASUREMENT vls_cur_off_vls_down_2 "Downstream oxygen sensor voltage prior to switching on pump current switch" UWORD _CNV_A_R_LINEAR_____3_CM 1 100. 0. 4.99511719 DISPLAY_IDENTIFIER VLS_CUR_OFF_VLS_DOWN_2 ECU_ADDRESS 0x3fb40c BYTE_ORDER MSB_LAST FORMAT "%5.3" /end MEASUREMENT
/begin CHARACTERISTIC c_pwm_min_obd2_lsh_up "Minimum permitted heater effective voltage PWM for upstream LSH OBDII diagnosis " VALUE 0xffe40833 _REC_VAL_20_u1 99.609375 _CNV_A_R_LINEAR_____9_CM 0. 99.609375 DISPLAY_IDENTIFIER C_PWM_MIN_OBD2_LSH_UP FORMAT "%4.1" /end CHARACTERISTIC
/begin MEASUREMENT lv_inh_diag_obd2_lsh_down_1 "" UBYTE _CNV_S_2_RANGE______2_CM 1 100. 0. 1. DISPLAY_IDENTIFIER LV_INH_DIAG_OBD2_LSH_DOWN_1 ECU_ADDRESS 0x3fea5d /end MEASUREMENT
/begin MEASUREMENT lv_inh_diag_obd2_lsh_down_2 "" UBYTE _CNV_S_2_RANGE______2_CM 1 100. 0. 1. DISPLAY_IDENTIFIER LV_INH_DIAG_OBD2_LSH_DOWN_2 ECU_ADDRESS 0x3fea5e /end MEASUREMENT
/begin CHARACTERISTIC c_tco_min_obd2_lsh_down "TCO-threshold for OBD2 heater diagnosis downstream" VALUE 0xffe4091c _REC_VAL_20_u1 190.5 _CNV_A_R_LINEAR_____11_CM -48. 142.5 DISPLAY_IDENTIFIER C_TCO_MIN_OBD2_LSH_DOWN FORMAT "%5.1" /end CHARACTERISTIC
/begin CHARACTERISTIC lc_delta_lamb_sp_o2l_mdl_man_1 "logical calibration flag to allow activation of lamb set point shift by catalyst o2 loading conditioning function" VALUE 0xffe40f4c _REC_VAL_20_u1 1. _CNV_A_R_LINEAR_____22_CM 0. 1. DISPLAY_IDENTIFIER LC_DELTA_LAMB_SP_O2L_MDL_MAN_1 FORMAT "%1.0" /end CHARACTERISTIC
/begin CHARACTERISTIC lc_delta_lamb_sp_o2l_mdl_man_2 "logical calibration flag to allow activation of lamb set point shift by catalyst o2 loading conditioning function" VALUE 0xffe40f4d _REC_VAL_20_u1 1. _CNV_A_R_LINEAR_____22_CM 0. 1. DISPLAY_IDENTIFIER LC_DELTA_LAMB_SP_O2L_MDL_MAN_2 FORMAT "%1.0" /end CHARACTERISTIC
/begin AXIS_PTS ldpm_n_dif_pred_fac_tq_add_is "" 0xffe51b9e n_dif_pred_pl_drof _REC_AXS_20_u2 65535. _CNV_A_R_LINEAR_____207_CM 8 -32768. 32767. DISPLAY_IDENTIFIER LDPM_N_DIF_PRED_FAC_TQ_ADD_IS FORMAT "%6.0" /end AXIS_PTS
/begin AXIS_PTS ldpm_n_t_n_dif_ofs_pred "" 0xffe51bf2 n _REC_AXS_20_u2 8160. _CNV_A_R_LINEAR_____10_CM 8 0. 8160. DISPLAY_IDENTIFIER LDPM_N_T_N_DIF_OFS_PRED FORMAT "%4.0" /end AXIS_PTS
/begin MEASUREMENT lv_inh_lsl_gain_ad_1 "Boolean inhibit flag for WRAF sensor gain adaptation at PUC" UBYTE _CNV_S_2_RANGE______2_CM 1 100. 0. 1. DISPLAY_IDENTIFIER LV_INH_LSL_GAIN_AD_1 ECU_ADDRESS 0x3fe566 BIT_MASK 0x1 /end MEASUREMENT
/begin MEASUREMENT lv_inh_lsl_gain_ad_2 "Boolean inhibit flag for WRAF sensor gain adaptation at PUC" UBYTE _CNV_S_2_RANGE______2_CM 1 100. 0. 1. DISPLAY_IDENTIFIER LV_INH_LSL_GAIN_AD_2 ECU_ADDRESS 0x3fe567 BIT_MASK 0x1 /end MEASUREMENT
/begin COMPU_METHOD _CNV_A_R_LINEAR_____0_CM "" RAT_FUNC "%6.3" "-" COEFFS 0 1. 0. 0 0 1 /end COMPU_METHOD
/begin COMPU_METHOD _CNV_S_2_RANGE______1_R_CM "" TAB_VERB "%6.3" "[-]" COMPU_TAB_REF _CNV_S_2_RANGE______1_R /end COMPU_METHOD
/begin COMPU_VTAB_RANGE _CNV_S_2_RANGE______1_R "" 2 0 0 "0" 1 255 "1" /end COMPU_VTAB_RANGE
/begin COMPU_METHOD _CNV_S_2_RANGE______2_CM "" TAB_VERB "%6.3" "[-]" COMPU_TAB_REF _CNV_S_2_RANGE______2 /end COMPU_METHOD
/begin COMPU_VTAB _CNV_S_2_RANGE______2 "" TAB_VERB 2 0 "0" 1 "1" /end COMPU_VTAB
/begin COMPU_METHOD _CNV_A_R_LINEAR_____3_CM "" RAT_FUNC "%6.3" "V" COEFFS 0 204.7999998974999 0. 0 0 1 /end COMPU_METHOD
/begin COMPU_METHOD _CNV_A_R_LINEAR_____4_CM "" RAT_FUNC "%6.3" "s" COEFFS 0 100. 0. 0 0 1 /end COMPU_METHOD
/begin COMPU_METHOD _CNV_A_R_LINEAR_____8_CM "" RAT_FUNC "%6.3" "%" COEFFS 0 655.3600000071681 0. 0 0 1 /end COMPU_METHOD
/begin COMPU_METHOD _CNV_A_R_LINEAR_____9_CM "" RAT_FUNC "%6.3" "%" COEFFS 0 2.56 0. 0 0 1 /end COMPU_METHOD
/begin COMPU_METHOD _CNV_A_R_LINEAR_____10_CM "" RAT_FUNC "%6.3" "rpm" COEFFS 0 1. 0. 0 0 1 /end COMPU_METHOD
/begin COMPU_METHOD _CNV_A_R_LINEAR_____11_CM "" RAT_FUNC "%6.3" "°C" COEFFS 0 1.333333333333333 64. 0 0 1 /end COMPU_METHOD
/begin COMPU_METHOD _CNV_A_R_LINEAR_____14_CM "" RAT_FUNC "%6.3" "°C" COEFFS 0 1. 40. 0 0 1 /end COMPU_METHOD
/begin COMPU_METHOD _CNV_A_R_LINEAR_____15_CM "" RAT_FUNC "%6.3" "rpm" COEFFS 0 3.125e-002 0. 0 0 1 /end COMPU_METHOD
/begin COMPU_METHOD _CNV_A_R_LINEAR_____16_CM "" RAT_FUNC "%6.3" "m" COEFFS 0 1.e-002 0. 0 0 1 /end COMPU_METHOD
/begin COMPU_METHOD _CNV_A_R_LINEAR_____20_CM "" RAT_FUNC "%6.3" "-" COEFFS 0 32768.00003968061 0. 0 0 1 /end COMPU_METHOD
/begin COMPU_METHOD _CNV_S_2_RANGE______21_CM "" TAB_VERB "%6.3" "-" COMPU_TAB_REF _CNV_S_2_RANGE______21 /end COMPU_METHOD
/begin COMPU_VTAB _CNV_S_2_RANGE______21 "" TAB_VERB 2 0 "0" 1 "1" /end COMPU_VTAB
/begin COMPU_METHOD _CNV_A_R_LINEAR_____22_CM "" RAT_FUNC "%6.3" "[-]" COEFFS 0 1. 0. 0 0 1 /end COMPU_METHOD
/begin COMPU_METHOD _CNV_A_R_LINEAR_____23_CM "" RAT_FUNC "%6.3" "km/h" COEFFS 0 1. 0. 0 0 1 /end COMPU_METHOD
/begin COMPU_METHOD _CNV_A_R_LINEAR_____24_CM "" RAT_FUNC "%6.3" "s" COEFFS 0 10. 0. 0 0 1 /end COMPU_METHOD
/begin COMPU_METHOD _CNV_A_R_LINEAR_____27_CM "" RAT_FUNC "%6.3" "mg/stk" COEFFS 0 0.183585313174946 0. 0 0 1 /end COMPU_METHOD
/begin COMPU_METHOD _CNV_A_R_LINEAR_____29_CM "" RAT_FUNC "%6.3" "-" COEFFS 0 255.9983911655618 0. 0 0 1 /end COMPU_METHOD
/begin COMPU_METHOD _CNV_A_R_LINEAR_____30_CM "" RAT_FUNC "%6.3" "s" COEFFS 0 1. 0. 0 0 1 /end COMPU_METHOD
/begin COMPU_METHOD _CNV_A_R_LINEAR_____31_CM "" RAT_FUNC "%6.3" "ms" COEFFS 0 0.1 0. 0 0 1 /end COMPU_METHOD
/begin COMPU_METHOD _CNV_A_R_LINEAR_____35_CM "" RAT_FUNC "%6.3" "µs" COEFFS 0 0.125 0. 0 0 1 /end COMPU_METHOD
/begin COMPU_METHOD _CNV_A_R_LINEAR_____36_CM "" RAT_FUNC "%6.3" "%." COEFFS 0 65.5359830397456 0. 0 0 1 /end COMPU_METHOD
/begin COMPU_METHOD _CNV_A_R_LINEAR_____37_CM "" RAT_FUNC "%6.3" "-" COEFFS 0 65536.00007936121 0. 0 0 1 /end COMPU_METHOD
/begin COMPU_METHOD _CNV_A_R_LINEAR_____38_CM "" RAT_FUNC "%6.3" "%." COEFFS 0 65.77254901960784 0. 0 0 1 /end COMPU_METHOD
/begin COMPU_METHOD _CNV_A_R_LINEAR_____39_CM "" RAT_FUNC "%6.3" "-" COEFFS 0 127.9991955827809 0. 0 0 1 /end COMPU_METHOD
/begin COMPU_METHOD _CNV_A_R_LINEAR_____48_CM "" RAT_FUNC "%6.3" "[-]" COEFFS 0 32. 0. 0 0 1 /end COMPU_METHOD
/begin COMPU_METHOD _CNV_A_R_LINEAR_____49_CM "" RAT_FUNC "%6.3" "hPa" COEFFS 0 12.06017666543982 0. 0 0 1 /end COMPU_METHOD
/begin COMPU_METHOD _CNV_A_R_LINEAR_____50_CM "" RAT_FUNC "%6.3" "[-]" COEFFS 0 255.9999357490357 0. 0 0 1 /end COMPU_METHOD
/begin COMPU_METHOD _CNV_A_R_LINEAR_____51_CM "" RAT_FUNC "%6.3" "rpm/s" COEFFS 0 3.125e-002 0. 0 0 1 /end COMPU_METHOD
/begin COMPU_METHOD _CNV_A_R_LINEAR_____54_CM "" RAT_FUNC "%6.3" "rpm/s" COEFFS 0 3.125e-002 128. 0 0 1 /end COMPU_METHOD
/begin COMPU_METHOD _CNV_A_R_LINEAR_____55_CM "" RAT_FUNC "%6.3" "Nm" COEFFS 0 32. 0. 0 0 1 /end COMPU_METHOD
/begin COMPU_METHOD _CNV_A_R_LINEAR_____108_CM "" RAT_FUNC "%6.3" "mg/stk" COEFFS 0 47.18142548596112 0. 0 0 1 /end COMPU_METHOD
/begin COMPU_METHOD _CNV_A_R_LINEAR_____111_CM "" RAT_FUNC "%6.3" "%" COEFFS 0 655.3600000071681 3.584063961170614e-007 0 0 1 /end COMPU_METHOD
/begin COMPU_METHOD _CNV_A_R_LINEAR_____115_CM "" RAT_FUNC "%6.3" "kg/h" COEFFS 0 32. 0. 0 0 1 /end COMPU_METHOD
/begin COMPU_METHOD _CNV_A_R_LINEAR_____117_CM "" RAT_FUNC "%6.3" "-" COEFFS 0 128. 0. 0 0 1 /end COMPU_METHOD
/begin COMPU_METHOD _CNV_A_R_LINEAR_____125_CM "" RAT_FUNC "%6.3" "-" COEFFS 0 255.9999997499962 0. 0 0 1 /end COMPU_METHOD
/begin COMPU_METHOD _CNV_A_R_LINEAR_____126_CM "" RAT_FUNC "%6.3" "-" COEFFS 0 65551.06000970239 0. 0 0 1 /end COMPU_METHOD
/begin COMPU_METHOD _CNV_A_R_LINEAR_____165_CM "" RAT_FUNC "%6.3" "ms" COEFFS 0 250. 0. 0 0 1 /end COMPU_METHOD
/begin COMPU_METHOD _CNV_A_R_LINEAR_____178_CM "" RAT_FUNC "%6.3" "°C" COEFFS 0 0.25 8.25 0 0 1 /end COMPU_METHOD
/begin COMPU_METHOD _CNV_A_R_LINEAR_____187_CM "" RAT_FUNC "%6.3" "Nm" COEFFS 0 32. 32768. 0 0 1 /end COMPU_METHOD
/begin COMPU_METHOD _CNV_S_2_RANGE______192_CM "" TAB_VERB "%6.3" "[-]" COMPU_TAB_REF _CNV_S_2_RANGE______192 /end COMPU_METHOD
/begin COMPU_VTAB _CNV_S_2_RANGE______192 "" TAB_VERB 2 0 "PASSIVE" 1 "ACTIVE" /end COMPU_VTAB
/begin COMPU_METHOD _CNV_S_3_RANGE_STAT_194_CM "" TAB_VERB "%6.3" "[-]" COMPU_TAB_REF _CNV_S_3_RANGE_STAT_194 /end COMPU_METHOD
/begin COMPU_VTAB _CNV_S_3_RANGE_STAT_194 "" TAB_VERB 3 0 "OFF" 1 "ON" 2 "LAMP BLINKING" /end COMPU_VTAB
/begin COMPU_METHOD _CNV_S_2_RANGE______195_R_CM "" TAB_VERB "%6.3" "[-]" COMPU_TAB_REF _CNV_S_2_RANGE______195_R /end COMPU_METHOD
/begin COMPU_VTAB_RANGE _CNV_S_2_RANGE______195_R "" 2 0 0 "OFF" 1 255 "ON" /end COMPU_VTAB_RANGE
/begin COMPU_METHOD _CNV_A_R_LINEAR_____196_CM "" RAT_FUNC "%6.3" "*100ms" COEFFS 0 1. 0. 0 0 1 /end COMPU_METHOD
/begin COMPU_METHOD _CNV_A_R_LINEAR_____198_CM "" RAT_FUNC "%6.3" "s" COEFFS 0 50. 0. 0 0 1 /end COMPU_METHOD
/begin COMPU_METHOD _CNV_A_R_LINEAR_____207_CM "" RAT_FUNC "%6.3" "rpm" COEFFS 0 1. 32768. 0 0 1 /end COMPU_METHOD
/begin COMPU_METHOD _CNV_A_R_LINEAR_____212_CM "" RAT_FUNC "%6.3" "Nm" COEFFS 0 8191.999999679995 32767.99999871998 0 0 1 /end COMPU_METHOD
/begin COMPU_METHOD _CNV_A_R_LINEAR_____213_CM "" RAT_FUNC "%6.3" "Nm" COEFFS 0 8191.999999679995 -1.280019205296412e-006 0 0 1 /end COMPU_METHOD
/begin COMPU_METHOD _CNV_S_3_STATE_P_D__214_CM "" TAB_VERB "%6.3" "[-]" COMPU_TAB_REF _CNV_S_3_STATE_P_D__214 /end COMPU_METHOD
/begin COMPU_VTAB _CNV_S_3_STATE_P_D__214 "" TAB_VERB 3 0 "P_D_PASSIVE" 1 "P_D_NORMAL" 2 "RAMP_TO_ZERO" /end COMPU_VTAB
/begin COMPU_METHOD _CNV_S_4_STATE_I_IS_215_CM "" TAB_VERB "%6.3" "[-]" COMPU_TAB_REF _CNV_S_4_STATE_I_IS_215 /end COMPU_METHOD
/begin COMPU_VTAB _CNV_S_4_STATE_I_IS_215 "" TAB_VERB 4 0 "I_PASSIVE" 1 "I_NORMAL" 2 "RAMP_TO_PAS" 3 "RAMP_TO_LIM" /end COMPU_VTAB
/begin COMPU_METHOD _CNV_A_R_LINEAR_____216_CM "" RAT_FUNC "%6.3" "rpm" COEFFS 0 3.125e-002 128. 0 0 1 /end COMPU_METHOD
/begin COMPU_METHOD _CNV_S_4_STATE_REQ__217_CM "" TAB_VERB "%6.3" "[-]" COMPU_TAB_REF _CNV_S_4_STATE_REQ__217 /end COMPU_METHOD
/begin COMPU_VTAB _CNV_S_4_STATE_REQ__217 "" TAB_VERB 4 0 "ISC_PASSIVE" 1 "AFTER_START" 2 "NORMAL" 3 "TRAILING_THR" /end COMPU_VTAB
/begin COMPU_METHOD _CNV_A_R_LINEAR_____218_CM "" RAT_FUNC "%6.3" "s" COEFFS 0 32. 0. 0 0 1 /end COMPU_METHOD
/begin COMPU_METHOD _CNV_A_R_LINEAR_____219_CM "" RAT_FUNC "%6.3" "Nm/rpm*rpm" COEFFS 0 134295784.7496875 0.1714789237448713 0 0 1 /end COMPU_METHOD
/begin COMPU_METHOD _CNV_A_R_LINEAR_____220_CM "" RAT_FUNC "%6.3" "Nm/rpm*rpm" COEFFS 0 134213975.5877775 -1. 0 0 1 /end COMPU_METHOD
/begin COMPU_METHOD _CNV_A_R_LINEAR_____221_CM "" RAT_FUNC "%6.3" "1/rpm²" COEFFS 0 134293032.7868853 0. 0 0 1 /end COMPU_METHOD
/begin COMPU_METHOD _CNV_A_R_LINEAR_____222_CM "" RAT_FUNC "%6.3" "Nm" COEFFS 0 2097152.000003239 3.316402435302734e-003 0 0 1 /end COMPU_METHOD
/begin COMPU_METHOD _CNV_A_R_LINEAR_____248_CM "" RAT_FUNC "%6.3" "-" COEFFS 0 64. 0. 0 0 1 /end COMPU_METHOD
/begin COMPU_METHOD _CNV_A_R_LINEAR_____287_CM "" RAT_FUNC "%6.3" "g" COEFFS 0 36.00036915004301 0. 0 0 1 /end COMPU_METHOD
/begin COMPU_METHOD _CNV_A_R_LINEAR_____303_CM "" RAT_FUNC "%6.3" "°C" COEFFS 0 15.99999804684544 -4.000060547696194e-003 0 0 1 /end COMPU_METHOD
/begin COMPU_METHOD _CNV_A_R_LINEAR_____313_CM "" RAT_FUNC "%6.3" "ms" COEFFS 0 5.e-002 0. 0 0 1 /end COMPU_METHOD
/begin COMPU_METHOD _CNV_A_R_LINEAR_____316_CM "" RAT_FUNC "%6.3" "g" COEFFS 0 35.99993408114611 0. 0 0 1 /end COMPU_METHOD
/begin COMPU_METHOD _CNV_S_5_RANGE_U8_S_317_CM "" TAB_VERB "%6.3" "-" COMPU_TAB_REF _CNV_S_5_RANGE_U8_S_317 /end COMPU_METHOD
/begin COMPU_VTAB _CNV_S_5_RANGE_U8_S_317 "" TAB_VERB 5 0 "Cond. not fulfilled" 1 "Cond. fulfilled waiting" 2 "Monitoring cycle lean" 3 "Monitoring cycle rich" 255 "Diagnosis finished" /end COMPU_VTAB
/begin COMPU_METHOD _CNV_A_R_LINEAR_____318_CM "" RAT_FUNC "%6.3" "%/s" COEFFS 0 0.1024000000600009 0. 0 0 1 /end COMPU_METHOD
/begin COMPU_METHOD _CNV_A_R_LINEAR_____321_CM "" RAT_FUNC "%6.3" "%" COEFFS 0 327.680000003584 3.584063961170614e-007 0 0 1 /end COMPU_METHOD
/begin COMPU_METHOD _CNV_A_R_LINEAR_____328_CM "" RAT_FUNC "%6.3" "-" COEFFS 0 205.1205007530839 0. 0 0 1 /end COMPU_METHOD
/begin COMPU_METHOD _CNV_A_R_LINEAR_____329_CM "" RAT_FUNC "%6.3" "-" COEFFS 0 102.5602503765419 0. 0 0 1 /end COMPU_METHOD
/begin COMPU_METHOD _CNV_A_R_LINEAR_____330_CM "" RAT_FUNC "%6.3" "-" COEFFS 0 204.7999998974999 0. 0 0 1 /end COMPU_METHOD
/begin COMPU_METHOD _CNV_A_R_LINEAR_____331_CM "" RAT_FUNC "%6.3" "-" COEFFS 0 819.2000486518808 0. 0 0 1 /end COMPU_METHOD
/begin COMPU_METHOD _CNV_A_R_LINEAR_____332_CM "" RAT_FUNC "%6.3" "-" COEFFS 0 256. 0. 0 0 1 /end COMPU_METHOD
/begin COMPU_METHOD _CNV_S_5_RANGE_STAT_333_CM "" TAB_VERB "%6.3" "[-]" COMPU_TAB_REF _CNV_S_5_RANGE_STAT_333 /end COMPU_METHOD
/begin COMPU_VTAB _CNV_S_5_RANGE_STAT_333 "" TAB_VERB 5 0 "PASSIVE" 1 "WAIT " 2 "CYC_LEAN" 3 "CYC_RICH" 4 "END" /end COMPU_VTAB
/begin COMPU_METHOD _CNV_A_R_LINEAR_____334_CM "" RAT_FUNC "%6.3" "-" COEFFS 0 255.999999874999 0. 0 0 1 /end COMPU_METHOD
/begin COMPU_METHOD _CNV_A_R_LINEAR_____335_CM "" RAT_FUNC "%6.3" "-" COEFFS 0 63.60176282051283 0. 0 0 1 /end COMPU_METHOD
/begin COMPU_METHOD _CNV_S_6_RANGE_ERR__337_CM "" TAB_VERB "%6.3" "[-]" COMPU_TAB_REF _CNV_S_6_RANGE_ERR__337 /end COMPU_METHOD
/begin COMPU_VTAB _CNV_S_6_RANGE_ERR__337 "" TAB_VERB 6 0 "NO_SYM" 1 "SYM_0" 2 "SYM_1" 4 "SYM_2" 8 "SYM_3" 15 "BENCH_MODE" /end COMPU_VTAB
/begin COMPU_METHOD _CNV_A_R_LINEAR_____352_CM "" RAT_FUNC "%6.3" "°C" COEFFS 0 0.249266862170088 8.225806451612904 0 0 1 /end COMPU_METHOD
/begin COMPU_METHOD _CNV_A_R_LINEAR_____358_CM "" RAT_FUNC "%6.3" "%/s" COEFFS 0 0.1024000154202376 0. 0 0 1 /end COMPU_METHOD
/begin COMPU_METHOD _CNV_A_R_LINEAR_____359_CM "" RAT_FUNC "%6.3" "%/s" COEFFS 0 0.1024028382518949 128. 0 0 1 /end COMPU_METHOD
/begin COMPU_METHOD _CNV_A_R_LINEAR_____368_CM "" RAT_FUNC "%6.3" "°C" COEFFS 0 15.99999804684544 32767.99599993945 0 0 1 /end COMPU_METHOD
/begin COMPU_METHOD _CNV_A_R_LINEAR_____394_CM "" RAT_FUNC "%6.3" "-" COEFFS 0 8191.999999679995 0. 0 0 1 /end COMPU_METHOD
/begin COMPU_METHOD _CNV_S_257_RANGE_DIAG_430_CM "" TAB_VERB "%6.3" "[-]" COMPU_TAB_REF _CNV_S_257_RANGE_DIAG_430 /end COMPU_METHOD
/begin COMPU_VTAB _CNV_S_257_RANGE_DIAG_430 "" TAB_VERB 255 0 "NO_ERROR" 1 "TOIL" 2 "TCO_EX" 3 "TIA" 4 "AMP" 5 "MAF" 6 "VLS_DOWN_MAX_1" 7 "VLS_DOWN_MAX_2" 8 "VLS_DOWN_MIN_COLD_1" 9 "VLS_DOWN_MIN_COLD_2" 10 "VLS_DOWN_MIN_1" 11 "VLS_DOWN_MIN_2" 12 "VLS_DOWN_OC_1" 13 "VLS_DOWN_OC_2" 14 "IV_0" 15 "IV_1" 16 "IV_2" 17 "IV_3" 18 "IV_4" 19 "IV_5" 20 "LSH_UP_1" 21 "LSH_UP_2" 22 "LSH_DOWN_1" 23 "LSH_DOWN_2" 24 "RLY_EFP" 25 "CPS" 26 "MEC_IVVT_IN_1" 27 "MEC_IVVT_EX_1" 28 "REF_IVVT_IN_1" 29 "REF_IVVT_EX_1" 30 "SLV_IVVT_IN_1" 31 "SLV_IVVT_EX_1" 32 "PARK_IVVT_IN_1" 33 "PARK_IVVT_EX_1" 34 "ECU_CKS" 35 "TOIL_LEVEL" 36 "TOUT_ETCU_1" 37 "TOUT_ETCU_2" 38 "TOUT_ICL_2" 39 "TOUT_ICL_3" 40 "TOUT_ASR_1" 41 "TOUT_ASR_3" 42 "TOUT_ASR_4" 43 "TOUT_PSTE_1" 44 "TOUT_AMT_1" 45 "VS" 46 "KNKS_1" 47 "KNKS_2" 48 "TD_IGC_CUT_0" 49 "TD_IGC_CUT_1" 50 "TD_IGC_CUT_2" 51 "TD_IGC_CUT_3" 52 "TD_IGC_CUT_4" 53 "TD_IGC_CUT_5" 54 "DUR_IGC_0" 55 "DUR_IGC_1" 56 "DUR_IGC_2" 57 "DUR_IGC_3" 58 "DUR_IGC_4" 59 "DUR_IGC_5" 60 "TPS_1" 61 "TPS_2" 62 "TPS_MAF_1" 63 "TPS_MAF_2" 64 "V_REF_1" 65 "V_REF_2" 66 "PVS_1" 67 "PVS_2" 68 "PVS_RATIO" 69 "PVS_DOUBLE" 70 "PVS_BLS_NOT_PLAUS" 71 "MTC_DR" 72 "MTC_CTL_1" 73 "MTC_CTL_2" 74 "MTC_CTL_3" 75 "TPS_AD" 76 "TPS_AD_BOL" 77 "TPS_ST_CHK_1" 78 "TPS_ST_CHK_2" 79 "GEN" 80 "GEN_IF" 81 "GEN_DIAG" 82 "VIM" 83 "CAM_PER_0" 84 "CAM_PER_1" 85 "CAM_PSN_0" 86 "CAM_PSN_1" 87 "CAM_0_NOT_PLAUS" 88 "CAM_1_NOT_PLAUS" 89 "ENG_PSN" 90 "TOOTH_PER" 91 "TPU_SYN" 92 "CRK_NOT_PLAUS" 93 "TOUT_TXU_1" 94 "CAN_BOFF" 95 "RLY_MAIN" 96 "RLY_MAIN_DLY" 97 "RLY_ACCOUT" 98 "SAP" 99 "SAV" 100 "ECF" 101 "TCO_PLAUS" 102 "TCO_EL" 103 "TCO_GRD" 104 "TCO_STUCK" 105 "ECT_EL" 106 "ECT_MEC" 107 "ISC" 108 "IM_BLS_PLAUS" 109 "IM_BTS_PLAUS" 110 "MSW_TOG" 111 "MSW_2" 112 "MSW_3" 113 "ISA_1" 114 "ISA_2" 115 "SEG_T_AD" 116 "SEG_T" 117 "MIS_0" 118 "MIS_1" 119 "MIS_2" 120 "MIS_3" 121 "MIS_4" 122 "MIS_5" 123 "MIS_LOW_FUEL" 124 "MIS_MPL" 125 "CONV_MON_1" 126 "N_32_MON_1" 127 "PVS_MON_1" 128 "MAF_TPS_MON_1" 129 "TQ_DIF_ISC_MON_1" 130 "TQ_REQ_MON_1" 131 "TQ_EXT_MON_1" 132 "TQI_AV_MON_1" 133 "TQI_N_MAX_MON_1" 134 "CRU_INH_MON_1" 135 "TQI_N_MAX_NVMY_MON" 136 "SA_SAFM" 137 "SA_SAP" 138 "SA_SYS" 139 "SA_SAV" 140 "IMOB_1" 141 "IMOB_2" 142 "IMOB_3" 143 "FSD_1" 144 "FSD_2" 145 "LS_DOWN_SWT_1" 146 "LS_DOWN_SWT_2" 147 "LS_DOWN_PUE_1" 148 "LS_DOWN_PUE_2" 149 "EF" 150 "TECU" 151 "EBOX_CFA" 152 "ECU_RAM" 153 "TQI_LIM" 154 "OBD2_LSH_DOWN_1" 155 "OBD2_LSH_DOWN_2" 156 "DMTLS" 157 "DMTL_PUMP" 158 "DMTLM" 159 "DMTL_LEAK" 160 "SOF" 161 "SOF_REQ" 162 "RLY_ST" 163 "BSD" 164 "POIL_SWI" 165 "TOUT_EFP" 166 "DIAGCPS" 167 "TQ_GS_INC_PLAUS" 168 "DCC" 169 "ECRAS" 170 "DMTLH" 171 "CS" 172 "SPI_MPS" 173 "SPI_KNK" 174 "BN_TQ_DCC" 175 "BN_TQ_PSTE_2" 176 "BN_ARS" 177 "BN_CAS" 178 "BN_TQ_TCS" 179 "BN_VS_TCS" 180 "BN_TCS" 181 "BN_TQ_ETCU" 182 "BN_ETCU" 183 "BN_TQ_AMT" 184 "BN_ACC" 185 "BN_T_ICL" 186 "BN_VEH_MOD" 187 "BN_KM_ICL" 188 "BN_ICL" 189 "BN_POW_VB" 190 "BN_POW_GEN" 191 "BN_MSW" 192 "BN_ANG_PSTE" 193 "BN_EFP" 194 "LOAD_TPS_PLAUS" 195 "EFP_CRASH" 196 "EFP" 197 "LOCAN_BOFF" 198 "CHG_LS_UP" 199 "CHG_LS_DOWN" 200 "QOIL_SENS" 201 "BAT_SENS" 202 "BAT_SENS_IT" 203 "BAT_SENS_IT_EL" 204 "ECU_NVMY" 205 "GS" 206 "O3_CONC" 207 "LS_UP_SHIFT_AFL_1" 208 "LS_UP_SHIFT_AFL_2" 209 "LS_UP_SHIFT_AFR_1" 210 "LS_UP_SHIFT_AFR_2" 211 "OC_LSL_1" 212 "OC_LSL_2" 213 "CAT_DIAG_1" 214 "CAT_DIAG_2" 215 "EL_LSL_1" 216 "EL_LSL_2" 217 "CAT_DIAG_NOX_1" 218 "CAT_DIAG_NOX_2" 219 "VLS_DOWN_PUC_1" 220 "VLS_DOWN_PUC_2" 221 "VLS_DOWN_FL_1" 222 "VLS_DOWN_FL_2" 223 "CHK_LS_DOWN_1" 224 "CHK_LS_DOWN_2" 225 "DELTA_LAMB_I_1" 226 "DELTA_LAMB_I_2" 227 "O3_UP" 228 "O3_DOWN" 229 "OBD2_TTIP_LS_UP_1" 230 "OBD2_TTIP_LS_UP_2" 231 "LSH_LS_UP_1" 232 "LSH_LS_UP_2" 233 "VLS_UP_THD_OVER_1" 234 "VLS_UP_THD_OVER_2" 235 "TOUT_NOX_SENS_1" 236 "NOX_SENS_1" 237 "TOUT_NOX_SENS_2" 238 "NOX_SENS_2" 239 "IF_LSL_1" 240 "IF_LSL_2" 241 "LS_UP_DYN_VLD_1" 242 "LS_UP_DYN_VLD_2" 243 "LS_UP_PUC_VLD_1" 244 "LS_UP_PUC_VLD_2" 245 "LSH_UP_OBD2_VLD_1" 246 "LSH_UP_OBD2_VLD_2" 247 "NOX_SENS_HTP_1" 248 "NOX_SENS_PLAUS_1" 249 "NOX_SENS_AVL_1" 250 "NOX_SENS_DYN_1" 251 "NOX_SENS_REF_AIR_1" 252 "NOX_SENS_HTP_2" 253 "NOX_SENS_PLAUS_2" 254 "NOX_SENS_AVL_2" /end COMPU_VTAB
/begin COMPU_METHOD _CNV_A_R_LINEAR_____439_CM "" RAT_FUNC "%6.3" "°C" COEFFS 0 0.25 0. 0 0 1 /end COMPU_METHOD
/begin RECORD_LAYOUT _REC_VAL_20_u1 FNC_VALUES 1 UBYTE COLUMN_DIR DIRECT /end RECORD_LAYOUT
/begin RECORD_LAYOUT _REC_VAL_20_u2 FNC_VALUES 1 UWORD COLUMN_DIR DIRECT /end RECORD_LAYOUT
/begin RECORD_LAYOUT _REC_CUR_20_u2_u1 FNC_VALUES 1 UWORD COLUMN_DIR DIRECT /end RECORD_LAYOUT
/begin RECORD_LAYOUT _REC_AXS_20_u1 NO_AXIS_PTS_X 1 UBYTE AXIS_PTS_X 2 UBYTE INDEX_INCR DIRECT /end RECORD_LAYOUT
/begin RECORD_LAYOUT _REC_MAP_20_u1_u1_u1 FNC_VALUES 1 UBYTE COLUMN_DIR DIRECT /end RECORD_LAYOUT
/begin RECORD_LAYOUT _REC_CUR_20_u1_u1 FNC_VALUES 1 UBYTE COLUMN_DIR DIRECT /end RECORD_LAYOUT
/begin RECORD_LAYOUT _REC_AXS_20_u2 NO_AXIS_PTS_X 1 UWORD AXIS_PTS_X 2 UWORD INDEX_INCR DIRECT /end RECORD_LAYOUT
/begin RECORD_LAYOUT _REC_MAP_20_u1_u1_u2 FNC_VALUES 1 UBYTE COLUMN_DIR DIRECT /end RECORD_LAYOUT
/begin RECORD_LAYOUT _REC_MAP_20_u2_u2_u1 FNC_VALUES 1 UWORD COLUMN_DIR DIRECT /end RECORD_LAYOUT
/begin RECORD_LAYOUT _REC_CUR_20_u1_u2 FNC_VALUES 1 UBYTE COLUMN_DIR DIRECT /end RECORD_LAYOUT
/begin RECORD_LAYOUT _REC_MAP_20_u2_u1_u1 FNC_VALUES 1 UWORD COLUMN_DIR DIRECT /end RECORD_LAYOUT
/begin RECORD_LAYOUT _REC_CUR_20_u2_u2 FNC_VALUES 1 UWORD COLUMN_DIR DIRECT /end RECORD_LAYOUT
/begin RECORD_LAYOUT _REC_VAL_20_s2 FNC_VALUES 1 SWORD COLUMN_DIR DIRECT /end RECORD_LAYOUT
/begin RECORD_LAYOUT _REC_MAP_20_u2_u1_u2 FNC_VALUES 1 UWORD COLUMN_DIR DIRECT /end RECORD_LAYOUT
/begin RECORD_LAYOUT _REC_MAP_20_u1_u2_u2 FNC_VALUES 1 UBYTE COLUMN_DIR DIRECT /end RECORD_LAYOUT
/begin FUNCTION INJ_Application_Incidences_for_c "_Application Incidences for conditioning of catalyst O2 loading"
 /begin DEF_CHARACTERISTIC lc_delta_lamb_sp_o2l_mdl_man_1 lc_delta_lamb_sp_o2l_mdl_man_2 /end DEF_CHARACTERISTIC
 /begin OUT_MEASUREMENT lam_bank_1.lam_o2l_inci.bf.lv_delta_lamb_sp_o2l_mdl lam_bank_2.lam_o2l_inci.bf.lv_delta_lamb_sp_o2l_mdl /end OUT_MEASUREMENT
/end FUNCTION
/begin FUNCTION INJ_Downstream_oxygen_sensor_int "_Downstream oxygen sensor internal resistance determination"
 /begin OUT_MEASUREMENT vls_cur_on_vls_down_1 vls_cur_off_vls_down_1 vls_cur_on_vls_down_2 vls_cur_off_vls_down_2 /end OUT_MEASUREMENT
/end FUNCTION
/begin FUNCTION INJ_Application_Incidences_for_W "_Application Incidences for WRAF Sensor Gain Adaptation at Fuel Cut Off" /begin OUT_MEASUREMENT lv_inh_lsl_gain_ad_1 lv_inh_lsl_gain_ad_2 /end OUT_MEASUREMENT /end FUNCTION
/begin FUNCTION INJ_Inhibition_Conditions_for_OB "Inhibition Conditions for OBDII oxygen downstream heater diagnosis" /begin DEF_CHARACTERISTIC c_tco_min_obd2_lsh_down /end DEF_CHARACTERISTIC /begin OUT_MEASUREMENT lv_inh_diag_obd2_lsh_down_1 lv_inh_diag_obd2_lsh_down_2 /end OUT_MEASUREMENT /end FUNCTION
/begin FUNCTION INJ_Application_specific_conditi "INJ_Application specific conditions for oxygen sensor internal resistance" /begin DEF_CHARACTERISTIC c_tco_cur_on_ls_down_min /end DEF_CHARACTERISTIC /end FUNCTION
/begin FUNCTION ISC_Idle_Speed_Control_Adaptatio "ISC"
 /begin SUB_FUNCTION ISC_Idle_speed_control ISC_Idle_speed_torque_reserve ISC_Adaptation_Condition ISC__Adaptation_Algorithm ISC_Torque_Reserve_for_canister_ ISC_Idle_speed_Adaptation ISC_Application_Incidence_for_Id /end SUB_FUNCTION
/end FUNCTION
/begin FUNCTION ISC_Idle_speed_control "_Idle speed control"
 /begin DEF_CHARACTERISTIC c_t_ramp_lim_i_dt_is c_t_ramp_lim_p_d_dt_is c_t_ramp_lim_p_d_is c_tq_bol_i_dt_is c_tq_bol_i_is c_tq_tol_i_dt_is c_tq_tol_i_is ip_tq_i_dt_is lc_tq_dif_i_inh_as lc_tq_dif_p_d_inh_as ip_fac_p_d_fast_tco_is ip_fac_p_d_slow_tco_is ip_tq_i_is lc_isc_inh lc_tq_add_i_inh_as ip_p_d_dt_is ip_p_d_dt_is_slow ip_p_d_is ip_p_d_is_slow id_fac_p_d_dt_is id_fac_p_d_dt_is_slow ip_fac_n_grd_is lc_tq_p_d_slow_inh_as lc_tq_p_d_fast_inh_as ip_fac_n_grd_is_slow ip_fac_t_ast_i_is ip_tq_pas_i_acc_is ip_tq_pas_i_is c_t_ramp_lim_i_is lc_p_d_slow_fast_sel_ena c_crlc_n_grd c_nr_buf_n_grd_fil lc_n_grd_fil_p_d_swi lc_n_grd_fil_i_swi /end DEF_CHARACTERISTIC
 /begin OUT_MEASUREMENT tq_dif_p_d_fast_is tq_dif_i_is tq_add_i_is n_grd_fil_is n_grd_p_d_is n_grd_i_is lv_pas_ramp_act_p_d_is lv_pas_ramp_act_i_is tq_add_i_ramp state_p_d_isc state_i_isc tq_dif_p_d_slow_is tq_dif_p_d_is_slow tq_dif_p_d_is_fast tq_add_p_d_ramp_fast tq_add_p_d_ramp_slow lv_tq_p_d_act_fast lv_tq_p_d_act_slow tq_dif_p_d_dt_is_1 tq_dif_p_d_dt_is_1_slow fac_n_grd_is fac_n_grd_is_slow lv_req_isc /end OUT_MEASUREMENT
/end FUNCTION
/begin FUNCTION ISC_Idle_speed_torque_reserve "_Idle speed torque reserve"
 /begin DEF_CHARACTERISTIC ip_t_n_dif_ofs_pred__n c_tq_add_is_bol_crlc c_tq_dif_add_is_tol ip_fac_tq_add_is_bol_dri ip_tq_add_is_bol_bas ip_lgrd_tq_add_is_bol ip_t_n_dif_ofs_pred_cs__n ip_fac_tq_add_is_bol_cs ip_fac_tq_add_is_bol ip_fac_temp_tq_add_is_bas /end DEF_CHARACTERISTIC
 /begin OUT_MEASUREMENT n_dif_ofs_pred t_n_dif_ofs_pred n_dif_pred tq_add_is_bol tq_dif_add_is_tol t_n_dif_ofs_pred_cs n_dif_ofs_pred_cs n_dif_pred_cs fac_tq_add_is_bol /end OUT_MEASUREMENT
/end FUNCTION
/begin FUNCTION ISC_Adaptation_Condition "_Adaptation Condition" /begin OUT_MEASUREMENT lv_is_ad_cnd lv_tco_ad_cnd_is lv_dly_ad_is /end OUT_MEASUREMENT /end FUNCTION
/begin FUNCTION ISC__Adaptation_Algorithm "_ Adaptation Algorithm"
 /begin OUT_MEASUREMENT fac_tq_is_ad_conv tq_dif_is_ad_acc_1 tq_dif_is_ad_acc_conv tq_dif_is_ad tq_dif_is_ad_inter tq_dif_is_ad_acc_1_inter tq_dif_is_ad_acc_conv_inter tq_dif_is_ad_acc tq_dif_is_ad_conv tq_dif_is_ad_conv_inter /end OUT_MEASUREMENT
/end FUNCTION
/begin FUNCTION ISC_Torque_Reserve_for_canister_ "_Torque Reserve for canister purge at idle" /begin DEF_CHARACTERISTIC ip_tq_add_cp__cl_mmv c_crlc_tq_add_cp lc_tq_add_cp_inh /end DEF_CHARACTERISTIC /begin OUT_MEASUREMENT tq_add_cp /end OUT_MEASUREMENT /end FUNCTION
/begin FUNCTION ISC_Idle_speed_Adaptation "_Idle speed Adaptation"
 /begin DEF_CHARACTERISTIC c_fac_tq_is_ad_conv_max c_fac_tq_is_ad_conv_min c_tq_is_ad_acc_min c_tq_is_ad_max c_tq_is_ad_min c_fac_tq_is_ad_acc c_fac_tq_is_ad_conv c_fac_tq_is_ad_acc_conv c_tq_is_ad_acc_max c_tq_is_ad_acc_conv_max c_tq_is_ad_acc_conv_min c_fac_tq_is_ad c_crlc_tq_dif_is_ad_acc c_fac_tq_is_ad_conv_can c_tq_is_ad_conv_can_min c_tq_is_ad_conv_can_max c_n_delta c_tco_ad_min_is c_tco_ad_max_is c_dly_is_ad /end DEF_CHARACTERISTIC
/end FUNCTION
/begin FUNCTION ISC_Application_Incidence_for_Id "_Application Incidence for Idle Speed Control"
 /begin DEF_CHARACTERISTIC lc_isc_act_cdn_swi lc_isc_act_ast_cdn_swi c_n_dif_isc_act_ast c_crlc_n_grd_fil_isc_act_ast c_t_dly_isc_act_pu /end DEF_CHARACTERISTIC
 /begin OUT_MEASUREMENT state_req_isc lv_neg_n_grd_fil_mem n_grd_fil_isc_act_ast lv_is_ad_inh_obd lv_is_ad_inh /end OUT_MEASUREMENT
/end FUNCTION
/begin FUNCTION OBD_OBD_II_Function "OBD"
 /begin SUB_FUNCTION OBD_Computation_of_catalyst_temp OBD_Dynamic_Error_management OBD_Misfire_detection OBD_Rough_road_detection OBD_History_memory OBD_Fuel_system_diagnosis OBD_Similar_conditions OBD_Lamp_management OBD_Activation_conditions_for_ca OBD_Cat_Efficiency_Diagnosis__OS OBD_Limited_dynamic_for_catalyst OBD_Oxygen_Sensor_diagnosis_with OBD_Diagnosis_of_monitor_sensors OBD_Readiness_code OBD_Upstream_oxygen_sensor_heate OBD_Application_incidences_Secon OBD_Tank_leakage_diagnosis_based OBD_Downstream_oxygen_sensor_hea OBD_Application_incidence_cataly OBD_Application_incidences_for_f OBD_Environmental_Data OBD_Failure_class OBD_Diagnostic_Trouble_Code OBD_Cycle_manager OBD_Oxygen_Sensor_Active_Plausib OBD_Cat_Efficiency_Diagnosis_wit OBD_Functional_Check_CPS OBD_Application_Incidences_of_th OBD_SA_system_diagnosis_through_ OBD_Application_incidences_for_S OBD_SA_system_monitoring_through OBD_Oxygen_sensor_diagnosis_mana OBD_Dynamic_Fuel_trim_diagnosis OBD_Upstream_O2_sensor_ceramic_t OBD_Diagnosis_of_WRAF_Sensor OBD_Application_Incidencies_of_t OBD_Application_incidences_Load_ OBD_Load_Throttle_position_ratio OBD_Oxygen_sensor_temperature OBD_Application_Incidences_for_D OBD_Application_incidence_of_Oxy OBD_Oxygen_Sensor_Interchanged_S OBD_Application_incidence_enviro OBD_NOx_sensor_OBDII_diagnosis NOx_sensor_OBD_II_diagnosis__App OBD_Application_Incidences_of_Dy OBD_Statistical_data_for_once_pe /end SUB_FUNCTION
/end FUNCTION
/begin FUNCTION OBD_Computation_of_catalyst_temp "_Computation of catalyst temperature for catalyst efficiency diagnosis" /end FUNCTION
/begin FUNCTION OBD_Dynamic_Error_management "_Dynamic Error management" /begin DEF_CHARACTERISTIC lc_clr_fmy c_ctr_max_wup_cyc lc_ena_scdn /end DEF_CHARACTERISTIC
 /begin OUT_MEASUREMENT ctr_err_dyn_nr fmy_ram_dyn[0].ctr_frc fmy_ram_dyn[0].ctr_wup_cyc fmy_ram_dyn[0].ctr_dc fmy_ram_dyn[0].err_info_dyn fmy_ram_dyn[0].err_info_dyn.bit_5 fmy_ram_dyn[0].err_info_dyn.bit_6 fmy_ram_dyn[0].err_info_dyn.bit_8 fmy_ram_dyn[0].err_info_dyn.bit_9 fmy_ram_dyn[0].err_info_dyn.bit_7 fmy_ram_dyn[0].err_info_dyn.bit_10 fmy_ram_dyn[0].diag_inst fmy_ram_dyn[1].ctr_frc fmy_ram_dyn[1].ctr_wup_cyc fmy_ram_dyn[1].ctr_dc fmy_ram_dyn[1].err_info_dyn fmy_ram_dyn[1].err_info_dyn.bit_5 fmy_ram_dyn[1].err_info_dyn.bit_6 fmy_ram_dyn[1].err_info_dyn.bit_8 fmy_ram_dyn[1].err_info_dyn.bit_9 fmy_ram_dyn[1].err_info_dyn.bit_7 fmy_ram_dyn[1].err_info_dyn.bit_10 fmy_ram_dyn[1].diag_inst fmy_ram_dyn[2].ctr_frc fmy_ram_dyn[2].ctr_wup_cyc fmy_ram_dyn[2].ctr_dc fmy_ram_dyn[2].err_info_dyn fmy_ram_dyn[2].err_info_dyn.bit_5 fmy_ram_dyn[2].err_info_dyn.bit_6 fmy_ram_dyn[2].err_info_dyn.bit_8 fmy_ram_dyn[2].err_info_dyn.bit_9 fmy_ram_dyn[2].err_info_dyn.bit_7 fmy_ram_dyn[2].err_info_dyn.bit_10 fmy_ram_dyn[2].diag_inst fmy_ram_dyn[3].ctr_frc fmy_ram_dyn[3].ctr_wup_cyc fmy_ram_dyn[3].ctr_dc fmy_ram_dyn[3].err_info_dyn fmy_ram_dyn[3].err_info_dyn.bit_5 fmy_ram_dyn[3].err_info_dyn.bit_6 fmy_ram_dyn[3].err_info_dyn.bit_8 fmy_ram_dyn[3].err_info_dyn.bit_9 fmy_ram_dyn[3].err_info_dyn.bit_7 fmy_ram_dyn[3].err_info_dyn.bit_10 fmy_ram_dyn[3].diag_inst fmy_ram_dyn[4].ctr_frc fmy_ram_dyn[4].ctr_wup_cyc fmy_ram_dyn[4].ctr_dc fmy_ram_dyn[4].err_info_dyn fmy_ram_dyn[4].err_info_dyn.bit_5 fmy_ram_dyn[4].err_info_dyn.bit_6 fmy_ram_dyn[4].err_info_dyn.bit_8 fmy_ram_dyn[4].err_info_dyn.bit_9 fmy_ram_dyn[4].err_info_dyn.bit_7 fmy_ram_dyn[4].err_info_dyn.bit_10 fmy_ram_dyn[4].diag_inst fmy_ram_dyn[5].ctr_frc fmy_ram_dyn[5].ctr_wup_cyc fmy_ram_dyn[5].ctr_dc fmy_ram_dyn[5].err_info_dyn fmy_ram_dyn[5].err_info_dyn.bit_5 fmy_ram_dyn[5].err_info_dyn.bit_6 fmy_ram_dyn[5].err_info_dyn.bit_8 fmy_ram_dyn[5].err_info_dyn.bit_9 fmy_ram_dyn[5].err_info_dyn.bit_7 fmy_ram_dyn[5].err_info_dyn.bit_10 fmy_ram_dyn[5].diag_inst fmy_ram_dyn[6].ctr_frc fmy_ram_dyn[6].ctr_wup_cyc fmy_ram_dyn[6].ctr_dc fmy_ram_dyn[6].err_info_dyn fmy_ram_dyn[6].err_info_dyn.bit_5 fmy_ram_dyn[6].err_info_dyn.bit_6 fmy_ram_dyn[6].err_info_dyn.bit_8 fmy_ram_dyn[6].err_info_dyn.bit_9 fmy_ram_dyn[6].err_info_dyn.bit_7 fmy_ram_dyn[6].err_info_dyn.bit_10 fmy_ram_dyn[6].diag_inst fmy_ram_dyn[7].ctr_frc fmy_ram_dyn[7].ctr_wup_cyc fmy_ram_dyn[7].ctr_dc fmy_ram_dyn[7].err_info_dyn fmy_ram_dyn[7].err_info_dyn.bit_5 fmy_ram_dyn[7].err_info_dyn.bit_6 fmy_ram_dyn[7].err_info_dyn.bit_8 fmy_ram_dyn[7].err_info_dyn.bit_9 fmy_ram_dyn[7].err_info_dyn.bit_7 fmy_ram_dyn[7].err_info_dyn.bit_10 fmy_ram_dyn[7].diag_inst fmy_ram_dyn[8].ctr_frc fmy_ram_dyn[8].ctr_wup_cyc fmy_ram_dyn[8].ctr_dc fmy_ram_dyn[8].err_info_dyn fmy_ram_dyn[8].err_info_dyn.bit_5 fmy_ram_dyn[8].err_info_dyn.bit_6 fmy_ram_dyn[8].err_info_dyn.bit_8 fmy_ram_dyn[8].err_info_dyn.bit_9 fmy_ram_dyn[8].err_info_dyn.bit_7 fmy_ram_dyn[8].err_info_dyn.bit_10 fmy_ram_dyn[8].diag_inst fmy_ram_dyn[9].ctr_frc fmy_ram_dyn[9].ctr_wup_cyc fmy_ram_dyn[9].ctr_dc fmy_ram_dyn[9].err_info_dyn fmy_ram_dyn[9].err_info_dyn.bit_5 fmy_ram_dyn[9].err_info_dyn.bit_6 fmy_ram_dyn[9].err_info_dyn.bit_8 fmy_ram_dyn[9].err_info_dyn.bit_9 fmy_ram_dyn[9].err_info_dyn.bit_7 fmy_ram_dyn[9].err_info_dyn.bit_10 fmy_ram_dyn[9].diag_inst /end OUT_MEASUREMENT
/end FUNCTION
/begin FUNCTION OBD_Misfire_detection "_Misfire detection" /end FUNCTION
/begin FUNCTION OBD_Rough_road_detection "_Rough road detection"
 /begin DEF_CHARACTERISTIC c_vs_min_rr c_vs_max_rr c_wheel_grd_crlc_rr c_dly_er_rr ip_wheel_grd_mmv_thd_at__vs ip_wheel_grd_mmv_thd_mt__vs /end DEF_CHARACTERISTIC
 /begin OUT_MEASUREMENT lv_state_rr seg_t_mes_0_rr seg_t_mes_1_rr wheel_grd_mmv wheel_grd_mmv_thd sum_rr /end OUT_MEASUREMENT
/end FUNCTION
/begin FUNCTION OBD_History_memory "_History memory" /begin DEF_CHARACTERISTIC lc_clr_his_fmy /end DEF_CHARACTERISTIC
 /begin OUT_MEASUREMENT ctr_err_his_nr fmy_his_cod[0] fmy_his_cod[1] fmy_his_cod[2] fmy_his_cod[3] fmy_his_cod[4] fmy_his_cod[5] fmy_his_cod[6] fmy_his_cod[7] fmy_his_cod[8] fmy_his_cod[9] /end OUT_MEASUREMENT
/end FUNCTION
/begin FUNCTION OBD_Fuel_system_diagnosis "_Fuel system diagnosis"
 /begin DEF_CHARACTERISTIC c_lam_min_fsd c_lam_max_fsd c_t_sum_max_max_fsd c_t_sum_min_max_fsd c_t_sum_rst_max_fsd c_n_min_fsd c_maf_min_fsd c_tco_min_fsd id_stop_inc_fsd__tco_st id_stop_dec_fsd__toil_max c_stop_max_fsd c_amp_min_fsd c_tam_min_fsd c_t_min_maf_fsd c_t_dly_maf_fsd c_n_min_mff_ad_add_fsd c_maf_min_mff_ad_add_fsd c_fac_cp_fsd /end DEF_CHARACTERISTIC
 /begin OUT_MEASUREMENT lam_bank_1.fsd_obd2.t_sum_max_fsd lam_bank_1.fsd_obd2.t_sum_min_fsd lam_bank_1.fsd_obd2.t_sum_end_diag_win_fsd lam_bank_1.fsd_obd2.t_sum_rst_fsd lam_bank_2.fsd_obd2.t_sum_max_fsd lam_bank_2.fsd_obd2.t_sum_min_fsd lam_bank_2.fsd_obd2.t_sum_end_diag_win_fsd lam_bank_2.fsd_obd2.t_sum_rst_fsd toil_max ctr_stop_fsd lv_err_fsd_1 lv_err_fsd_2 /end OUT_MEASUREMENT
/end FUNCTION
/begin FUNCTION OBD_Similar_conditions "_Similar conditions" /begin DEF_CHARACTERISTIC c_ctr_scdn_equ_dc_max c_n_scdn_equ c_load_scdn_equ /end DEF_CHARACTERISTIC
 /begin OUT_MEASUREMENT fmy_scdn_equ_fsd_2.ctr_scdn_equ_dc fmy_scdn_equ_fsd_2.scdn_info fmy_scdn_equ_fsd_1.ctr_scdn_equ_dc fmy_scdn_equ_fsd_1.scdn_info fmy_scdn_equ_mis_1.ctr_scdn_equ_dc fmy_scdn_equ_mis_1.scdn_info fmy_scdn_equ_mis_2.ctr_scdn_equ_dc fmy_scdn_equ_mis_2.scdn_info fmy_scdn_equ_mis_3.ctr_scdn_equ_dc fmy_scdn_equ_mis_3.scdn_info fmy_scdn_equ_mis_4.ctr_scdn_equ_dc fmy_scdn_equ_mis_4.scdn_info fmy_scdn_equ_mis_0.ctr_scdn_equ_dc fmy_scdn_equ_mis_0.scdn_info fmy_scdn_equ_mis_5.ctr_scdn_equ_dc fmy_scdn_equ_mis_5.scdn_info /end OUT_MEASUREMENT
/end FUNCTION
/begin FUNCTION OBD_Lamp_management "_Lamp management"
 /begin DEF_CHARACTERISTIC c_conf_mil c_conf_wal_1 c_conf_wal_2 lc_inh_wal_st c_dly_wal_st c_dly_inh_iv_mis /end DEF_CHARACTERISTIC
 /begin OUT_MEASUREMENT rel_dist_act_mil state_mil rel_dist_act_wal_1 rel_dist_act_wal_2 lv_wal_2 state_wal_1 state_wal_2 dist_act_wal_2 dist_act_wal_1 dist_act_mil lv_mil lv_wal_1 lv_wal_st /end OUT_MEASUREMENT
/end FUNCTION
/begin FUNCTION OBD_Activation_conditions_for_ca "_Activation conditions for cat eff and O2 sensor diag"
 /begin DEF_CHARACTERISTIC c_cl_max_cat_ls_diag lc_ls_cat_diag_cdn_man_act ip_maf_lam_cat_min__n_32 ip_maf_lam_cat_max__n_32 c_tco_min_cat c_temp_min_cat c_temp_max_cat c_temp_hys_cat c_vs_min_cat c_vs_max_cat c_amp_min_cat_ls_diag c_maf_int_cat_diag_dly c_maf_int_cat_diag_sw /end DEF_CHARACTERISTIC
 /begin OUT_MEASUREMENT lam_bank_1.cat_eff_act.lv_ls_cat_diag_cdn lam_bank_1.cat_eff_act.maf_int_cat_diag_dly lam_bank_2.cat_eff_act.lv_ls_cat_diag_cdn lam_bank_2.cat_eff_act.maf_int_cat_diag_dly /end OUT_MEASUREMENT
/end FUNCTION
/begin FUNCTION OBD_Cat_Efficiency_Diagnosis__OS "_Cat Efficiency Diagnosis (OSC Method)"
 /begin DEF_CHARACTERISTIC ip_vls_cat_int_max_at c_sum_min_cat_diag c_cat_max_diag c_n_32_cat_diag_deac_thd c_o2_cat_mv_max c_o2_cat_mv_delta_max c_o2_cat_mv_dif_max ip_vls_cat_int_max_mt ip_o2_cat c_o2_cat_mv_min c_ctr_cat_diag_lam_out /end DEF_CHARACTERISTIC
 /begin OUT_MEASUREMENT lam_bank_1.cat_eff_inci.lv_inh_diag_cat_diag lam_bank_1.cat_eff_inci.t_vls_cyc_efc lam_bank_1.cat_eff_inci.lv_auth_cat_diag lam_bank_1.cat_eff_inci.vls_cyc_step lam_bank_1.cat_eff_obd2.bf.lv_req_cat_diag lam_bank_1.cat_eff_obd2.bf.lv_cat_diag_cyc_vld lam_bank_1.cat_eff_obd2.bf.lv_o2_cat_cyc_vld_1 lam_bank_1.cat_eff_obd2.bf.lv_o2_cat_cyc_vld_2 lam_bank_1.cat_eff_obd2.bf.lv_delta_lamb_cat_diag lam_bank_1.cat_eff_obd2.bf.lv_lamb_puls_cat_diag lam_bank_1.cat_eff_obd2.bf.lv_o2_cat_cyc_vld_3 lam_bank_1.cat_eff_obd2.o2_cat_dif_sum lam_bank_1.cat_eff_obd2.o2_cat_sum lam_bank_1.cat_eff_obd2.o2_cat_mv lam_bank_1.cat_eff_obd2.o2_cat_int lam_bank_1.cat_eff_obd2.o2_cat_ratio lam_bank_1.cat_eff_obd2.o2_cat lam_bank_1.cat_eff_obd2.state_cat_diag lam_bank_1.cat_eff_obd2.o2_cat_ratio_sum lam_bank_1.cat_eff_obd2.cat_diag_clc lam_bank_1.cat_eff_obd2.cat_diag lam_bank_1.cat_eff_obd2.sum_cat_diag lam_bank_1.cat_eff_obd2.sum_cat_diag_tot lam_bank_1.cat_eff_obd2.o2_cat_st_cyc lam_bank_1.cat_eff_obd2.ctr_cat_diag_afr_afl lam_bank_2.cat_eff_inci.lv_inh_diag_cat_diag lam_bank_2.cat_eff_inci.t_vls_cyc_efc lam_bank_2.cat_eff_inci.lv_auth_cat_diag lam_bank_2.cat_eff_inci.vls_cyc_step lam_bank_2.cat_eff_obd2.bf.lv_req_cat_diag lam_bank_2.cat_eff_obd2.bf.lv_cat_diag_cyc_vld lam_bank_2.cat_eff_obd2.bf.lv_o2_cat_cyc_vld_1 lam_bank_2.cat_eff_obd2.bf.lv_o2_cat_cyc_vld_2 lam_bank_2.cat_eff_obd2.bf.lv_delta_lamb_cat_diag lam_bank_2.cat_eff_obd2.bf.lv_lamb_puls_cat_diag lam_bank_2.cat_eff_obd2.bf.lv_o2_cat_cyc_vld_3 lam_bank_2.cat_eff_obd2.o2_cat_dif_sum lam_bank_2.cat_eff_obd2.o2_cat_sum lam_bank_2.cat_eff_obd2.o2_cat_mv lam_bank_2.cat_eff_obd2.o2_cat_int lam_bank_2.cat_eff_obd2.o2_cat_ratio lam_bank_2.cat_eff_obd2.o2_cat lam_bank_2.cat_eff_obd2.state_cat_diag lam_bank_2.cat_eff_obd2.o2_cat_ratio_sum lam_bank_2.cat_eff_obd2.cat_diag_clc lam_bank_2.cat_eff_obd2.cat_diag lam_bank_2.cat_eff_obd2.sum_cat_diag lam_bank_2.cat_eff_obd2.sum_cat_diag_tot lam_bank_2.cat_eff_obd2.o2_cat_st_cyc lam_bank_2.cat_eff_obd2.ctr_cat_diag_afr_afl lv_err_cat_diag_1 lv_err_cat_diag_2 /end OUT_MEASUREMENT
/end FUNCTION
/begin FUNCTION OBD_Limited_dynamic_for_catalyst "_Limited dynamic for catalyst effiency and oxygen sensor diagnosis"
 /begin DEF_CHARACTERISTIC c_n_crlc_cat c_maf_crlc_cat c_lam_mv_crlc_cat c_n_dyw_cat c_maf_dyw_cat c_lam_mv_dyw_cat c_maf_int_min_cat c_pv_av_grd_dec c_pv_av_grd_sum_max c_pv_av_grd_sum_min c_t_pv_av_grd_dec_sum c_pv_av_grd_min_sum_cat /end DEF_CHARACTERISTIC
 /begin OUT_MEASUREMENT lam_bank_1.cat_eff_ldc_obd2.lv_ldc_cat lam_bank_1.cat_eff_ldc_obd2.maf_int_ldc_cat lam_bank_1.cat_eff_ldc_obd2.pv_av_grd_sum lam_bank_1.cat_eff_ldc_obd2.lam_mv_mmv_cat lam_bank_2.cat_eff_ldc_obd2.lv_ldc_cat lam_bank_2.cat_eff_ldc_obd2.maf_int_ldc_cat lam_bank_2.cat_eff_ldc_obd2.pv_av_grd_sum lam_bank_2.cat_eff_ldc_obd2.lam_mv_mmv_cat n_mmv_cat maf_mmv_cat lv_n_ldc lv_maf_ldc /end OUT_MEASUREMENT
/end FUNCTION
/begin FUNCTION OBD_Oxygen_Sensor_diagnosis_with "_Oxygen Sensor diagnosis with multiple check" /end FUNCTION
/begin FUNCTION OBD_Diagnosis_of_monitor_sensors "_Diagnosis of monitor sensors"
 /begin DEF_CHARACTERISTIC lc_inh_ls_down_man_deac c_vls_down_hys ip_vls_down_max_cycnr c_cycnr_vls_down_max c_tco_min_ls_down c_vs_max_ls_down c_vs_min_ls_down c_temp_cat_min_ls_down c_maf_kgh_max_puc_ls_down c_maf_kgh_min_puc_ls_down c_vls_down_min_puc_diag c_fac_vls_down_max_diag c_fac_vls_down_min_diag c_sum_min_vls_down_diag c_maf_int_puc_ls_down_pue c_maf_int_ls_down_pue c_ctr_min_end_diag_ls_down_pue c_ctr_inc_ls_down_pue c_ctr_max_ls_down_pue c_vls_down_dif_min_diag /end DEF_CHARACTERISTIC
 /begin OUT_MEASUREMENT lam_bank_1.ls_down_obd2.bf.lv_ls_down_swt_vld lam_bank_1.ls_down_obd2.bf.lv_ls_down_pue_vld lam_bank_1.ls_down_obd2.bf.lv_cdn_diag_ls_down lam_bank_1.ls_down_obd2.cycnr_vls_down_act lam_bank_1.ls_down_obd2.ctr_vls_down_diag lam_bank_1.ls_down_obd2.vls_down_tran_puc lam_bank_1.ls_down_obd2.ctr_cycnr_quo_vls_down_sum lam_bank_1.ls_down_obd2.cycnr_ratio_vls_down lam_bank_1.ls_down_obd2.cycnr_sae_ratio_vls_down lam_bank_1.ls_down_obd2.cycnr_quo_vls_down lam_bank_1.ls_down_obd2.vls_down_pue lam_bank_1.ls_down_obd2.ctr_end_diag_ls_down_pue lam_bank_1.ls_down_obd2.vls_down_dif_diag lam_bank_1.ls_down_obd2.vls_sae_down_dif_diag lam_bank_1.ls_down_obd2.ctr_ls_down_pue lam_bank_2.ls_down_obd2.bf.lv_ls_down_swt_vld lam_bank_2.ls_down_obd2.bf.lv_ls_down_pue_vld lam_bank_2.ls_down_obd2.bf.lv_cdn_diag_ls_down lam_bank_2.ls_down_obd2.cycnr_vls_down_act lam_bank_2.ls_down_obd2.ctr_vls_down_diag lam_bank_2.ls_down_obd2.vls_down_tran_puc lam_bank_2.ls_down_obd2.ctr_cycnr_quo_vls_down_sum lam_bank_2.ls_down_obd2.cycnr_ratio_vls_down lam_bank_2.ls_down_obd2.cycnr_sae_ratio_vls_down lam_bank_2.ls_down_obd2.cycnr_quo_vls_down lam_bank_2.ls_down_obd2.vls_down_pue lam_bank_2.ls_down_obd2.ctr_end_diag_ls_down_pue lam_bank_2.ls_down_obd2.vls_down_dif_diag lam_bank_2.ls_down_obd2.vls_sae_down_dif_diag lam_bank_2.ls_down_obd2.ctr_ls_down_pue maf_kgh_min_puc maf_int_pue lv_req_diag_ls_down lv_end_diag_ls_down lv_err_ls_down_pue_1 lv_err_ls_down_pue_2 lv_err_ls_down_swt_1 lv_err_ls_down_swt_2 /end OUT_MEASUREMENT
/end FUNCTION
/begin FUNCTION OBD_Readiness_code "_Readiness code" /begin DEF_CHARACTERISTIC c_obd_state_1 c_obd_state_2 /end DEF_CHARACTERISTIC /end FUNCTION
/begin FUNCTION OBD_Upstream_oxygen_sensor_heate "_Upstream oxygen sensor heater OBDII monitoring"
 /begin DEF_CHARACTERISTIC c_t_dly_pow_ctl_obd2_lsh_up c_ttip_ls_up_min_obd2 c_ttip_ls_up_max_obd2 ip_t_dly_raw_obd2_lsh_up ip_t_ls_ready_obd2_lsh_up lc_rep_obd2_lsh_up lc_obd2_lsh_up c_tcc_obd2_lsh_up c_pwm_min_obd2_lsh_up /end DEF_CHARACTERISTIC
 /begin OUT_MEASUREMENT lam_bank_1.lsh_up_obd2.bf.lv_lamb_puls_on_ls_diag_req lam_bank_1.lsh_up_obd2.bf.lv_end_obd2_lsh_up lam_bank_1.lsh_up_obd2.bf.lv_sym_obd2_lsh_up lam_bank_1.lsh_up_obd2.bf.lv_cdn_obd2_lsh_up lam_bank_1.lsh_up_obd2.tcc_obd2_lsh_up lam_bank_1.lsh_up_obd2.frc_obd2_lsh_up lam_bank_1.lsh_up_obd2.t_dly_obd2_lsh_up lam_bank_1.lsh_up_obd2.ttip_ls_up_mes_obd2_lsh_up lam_bank_1.lsh_up_obd2.sym_obd2_lsh_up lam_bank_2.lsh_up_obd2.bf.lv_lamb_puls_on_ls_diag_req lam_bank_2.lsh_up_obd2.bf.lv_end_obd2_lsh_up lam_bank_2.lsh_up_obd2.bf.lv_sym_obd2_lsh_up lam_bank_2.lsh_up_obd2.bf.lv_cdn_obd2_lsh_up lam_bank_2.lsh_up_obd2.tcc_obd2_lsh_up lam_bank_2.lsh_up_obd2.frc_obd2_lsh_up lam_bank_2.lsh_up_obd2.t_dly_obd2_lsh_up lam_bank_2.lsh_up_obd2.ttip_ls_up_mes_obd2_lsh_up lam_bank_2.lsh_up_obd2.sym_obd2_lsh_up lv_inh_diag_obd2_lsh_up_1 lv_inh_diag_obd2_lsh_up_2 /end OUT_MEASUREMENT
/end FUNCTION
/begin FUNCTION OBD_Application_incidences_Secon "_Application incidences Secondary air system monitoring through binary lambda sensor (ZrO2)"
 /begin DEF_CHARACTERISTIC ip_n_32_min_diag_sa ip_maf_kgh_max_diag_sa ip_maf_max_diag_sa c_ti_add_wf_max_diag_sa c_ti_add_wf_min_diag_sa lc_inh_sa_man_deac id_tco_min_diag_sa ip_maf_min_diag_sa c_n_32_max_diag_sa c_t_ast_tia_diag_sa c_tco_max_diag_sa c_vls_afr_ready_sa_diag c_vls_afl_ready_sa_diag c_amp_min_sa_diag /end DEF_CHARACTERISTIC
 /begin OUT_MEASUREMENT lv_intr_diag_sa lv_vls_ready_sa_diag_up_1 lv_vls_ready_sa_diag_up_2 /end OUT_MEASUREMENT
/end FUNCTION
/end MODULE
/end PROJECT
