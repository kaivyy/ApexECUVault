ASAP2_VERSION 1 41
/begin PROJECT MSD70 "Spray Guided DI-System with Piezo Injectors for 6-Cylinder"
/begin HEADER "_default_HeaderComment" PROJECT_NO _0B /end HEADER
/begin MODULE _default_ModuleName "_default_ModuleLongIdentifier"
/begin MOD_COMMON "_default_ModCommonComment" DEPOSIT ABSOLUTE BYTE_ORDER MSB_LAST ALIGNMENT_BYTE 1 ALIGNMENT_WORD 2 ALIGNMENT_LONG 2 ALIGNMENT_FLOAT32_IEEE 2 ALIGNMENT_FLOAT64_IEEE 4 /end MOD_COMMON
/begin MEASUREMENT egtr[0].egtr_struct_fctdgtdlac0.temp_ldc_cat_diag_afl "Filtered modelled catalyst dynamic temperature" UWORD _CNV_A_R_LINEAR_____204_CM 1 100. -273.15 1774.7875 DISPLAY_IDENTIFIER TEMP_LDC_CAT_DIAG_AFL[1] ECU_ADDRESS 0xd0001f64 FORMAT "%9.4" /end MEASUREMENT
/begin MEASUREMENT egtr[0].egtr_struct_fctdgtdlac0.lv_o2l_clc_act_opp_tmp "Activation for diagnosis regarding operating point" UBYTE _CNV_A_R_LINEAR_____0_CM 1 100. 0. 1. DISPLAY_IDENTIFIER LV_O2L_CLC_ACT_OPP_TMP[1] ECU_ADDRESS 0xd0001f66 FORMAT "%1.0" BIT_MASK 0x1 /end MEASUREMENT
/begin MEASUREMENT egtr[0].egtr_struct_fctdgtdlac0.lv_o2l_clc_act_cdn "General activation flag for calculation of oxygen capacity" UBYTE _CNV_A_R_LINEAR_____0_CM 1 100. 0. 1. DISPLAY_IDENTIFIER LV_O2L_CLC_ACT_CDN[1] ECU_ADDRESS 0xd0001f67 FORMAT "%1.0" BIT_MASK 0x1 /end MEASUREMENT
/begin MEASUREMENT egtr[0].egtr_struct_fctdgtdlac0.lv_o2l_clc_act_tco_tmp "Activation for diagnosis regarding coolant temperature" UBYTE _CNV_A_R_LINEAR_____0_CM 1 100. 0. 1. DISPLAY_IDENTIFIER LV_O2L_CLC_ACT_TCO_TMP[1] ECU_ADDRESS 0xd0001f68 FORMAT "%1.0" BIT_MASK 0x1 /end MEASUREMENT
/begin MEASUREMENT egtr[0].egtr_struct_fctdgtdlac0.lv_o2l_clc_act_temp_tmp "Activation for diagnosis regarding TWC temperature" UBYTE _CNV_A_R_LINEAR_____0_CM 1 100. 0. 1. DISPLAY_IDENTIFIER LV_O2L_CLC_ACT_TEMP_TMP[1] ECU_ADDRESS 0xd0001f69 FORMAT "%1.0" BIT_MASK 0x1 /end MEASUREMENT
/begin MEASUREMENT egtr[0].egtr_struct_fctdgtdlac0.lv_o2l_clc_act_ldc_temp_tmp "Activation for diagnosis regarding TWC temperature limited dynamic" UBYTE _CNV_A_R_LINEAR_____0_CM 1 100. 0. 1. DISPLAY_IDENTIFIER LV_O2L_CLC_ACT_LDC_TEMP_TMP[1] ECU_ADDRESS 0xd0001f6a FORMAT "%1.0" BIT_MASK 0x1 /end MEASUREMENT
/begin MEASUREMENT egtr[0].egtr_struct_fctdgtdldd0.action_clcO2L_data_l_ampl.o2l_mv "Mean value of O2L values calculated in regenerations phase" UWORD _CNV_A_R_LINEAR_____822_CM 1 100. 0. 2.61684895833333 DISPLAY_IDENTIFIER O2L_L_AMPL_MV[1] ECU_ADDRESS 0xd0001f6c FORMAT "%7.5" /end MEASUREMENT
/begin MEASUREMENT egtr[0].egtr_struct_fctdgtdldd0.action_clcO2L_data_l_ampl.o2l_sum "Sum of O2L values calculated during regenerations phase" UWORD _CNV_A_R_EGTR_LINEA_837_CM 1 100. 0. 20.93479 DISPLAY_IDENTIFIER O2L_L_AMPL_SUM[1] ECU_ADDRESS 0xd0001f6e FORMAT "%4.1" /end MEASUREMENT
/begin MEASUREMENT egtr[0].egtr_struct_fctdgtdldd0.action_clcO2L_data_l_ampl.ctr_sum "Counter for calculation of mean value of O2L calculated in regeneration phases" UBYTE _CNV_A_R_LINEAR_____0_CM 1 100. 0. 255. DISPLAY_IDENTIFIER CTR_O2L_SUM_L_AMPL[1] ECU_ADDRESS 0xd0001f70 FORMAT "%3.0" /end MEASUREMENT
/begin MEASUREMENT egtr[0].egtr_struct_fctdgtdldd0.action_clcO2L_data_h_ampl.o2l_mv "Mean value of O2L values calculated in regenerations phase" UWORD _CNV_A_R_LINEAR_____822_CM 1 100. 0. 2.61684895833333 DISPLAY_IDENTIFIER O2L_H_AMPL_MV[1] ECU_ADDRESS 0xd0001f72 FORMAT "%7.5" /end MEASUREMENT
/begin MEASUREMENT egtr[0].egtr_struct_fctdgtdldd0.action_clcO2L_data_h_ampl.o2l_sum "Sum of O2L values calculated during regenerations phase" UWORD _CNV_A_R_EGTR_LINEA_837_CM 1 100. 0. 20.93479 DISPLAY_IDENTIFIER O2L_H_AMPL_SUM[1] ECU_ADDRESS 0xd0001f74 FORMAT "%4.1" /end MEASUREMENT
/begin MEASUREMENT egtr[0].egtr_struct_fctdgtdldd0.action_clcO2L_data_h_ampl.ctr_sum "Counter for calculation of mean value of O2L calculated in regeneration phases" UBYTE _CNV_A_R_LINEAR_____0_CM 1 100. 0. 255. DISPLAY_IDENTIFIER CTR_O2L_SUM_H_AMPL[1] ECU_ADDRESS 0xd0001f76 FORMAT "%3.0" /end MEASUREMENT
/begin MEASUREMENT egtr[0].egtr_struct_fctdgtdldd0.action_clcO2L_data_park.o2l_mv "Mean value of O2L values calculated in regenerations phase" UWORD _CNV_A_R_LINEAR_____822_CM 1 100. 0. 2.61684895833333 DISPLAY_IDENTIFIER O2L_PARK_MV[1] ECU_ADDRESS 0xd0001f78 FORMAT "%7.5" /end MEASUREMENT
/begin MEASUREMENT egtr[0].egtr_struct_fctdgtdldd0.action_clcO2L_data_park.o2l_sum "Sum of O2L values calculated during regenerations phase" UWORD _CNV_A_R_EGTR_LINEA_837_CM 1 100. 0. 20.93479 DISPLAY_IDENTIFIER O2L_PARK_SUM[1] ECU_ADDRESS 0xd0001f7a FORMAT "%4.1" /end MEASUREMENT
/begin MEASUREMENT egtr[0].egtr_struct_fctdgtdldd0.action_clcO2L_data_park.ctr_sum "Counter for calculation of mean value of O2L calculated in regeneration phases" UBYTE _CNV_A_R_LINEAR_____0_CM 1 100. 0. 255. DISPLAY_IDENTIFIER CTR_O2L_SUM_PARK[1] ECU_ADDRESS 0xd0001f7c FORMAT "%3.0" /end MEASUREMENT
/begin MEASUREMENT egtr[0].egtr_struct_fctdgtdldd0.action_clcO2L_data_load.o2l_mv "Mean value of O2L values calculated in regenerations phase" UWORD _CNV_A_R_LINEAR_____822_CM 1 100. 0. 2.61684895833333 DISPLAY_IDENTIFIER O2L_LOAD_MV[1] ECU_ADDRESS 0xd0001f7e FORMAT "%7.5" /end MEASUREMENT
/begin MEASUREMENT egtr[0].egtr_struct_fctdgtdldd0.action_clcO2L_data_load.o2l_sum "Sum of O2L values calculated during regenerations phase" UWORD _CNV_A_R_EGTR_LINEA_837_CM 1 100. 0. 20.93479 DISPLAY_IDENTIFIER O2L_LOAD_SUM[1] ECU_ADDRESS 0xd0001f80 FORMAT "%4.1" /end MEASUREMENT
/begin MEASUREMENT egtr[0].egtr_struct_fctdgtdldd0.action_clcO2L_data_load.ctr_sum "Counter for calculation of mean value of O2L calculated in regeneration phases" UBYTE _CNV_A_R_LINEAR_____0_CM 1 100. 0. 255. DISPLAY_IDENTIFIER CTR_O2L_SUM_LOAD[1] ECU_ADDRESS 0xd0001f82 FORMAT "%3.0" /end MEASUREMENT
/begin MEASUREMENT egtr[0].egtr_struct_fctdgtdldd0.o2l_sum_cat_diag_afl "Sum of O2L values of all phases for calculation of O2L_MMV_CAT_DIAG_AFL" UWORD _CNV_A_R_EGTR_LINEA_837_CM 1 100. 0. 20.93479 DISPLAY_IDENTIFIER O2L_SUM_CAT_DIAG_AFL[1] ECU_ADDRESS 0xd0001f84 FORMAT "%4.1" /end MEASUREMENT
/begin MEASUREMENT egtr[0].egtr_struct_fctdgtdldd0.o2l_mmv_cat_diag_afl "Mean value of O2L values calculated in all phases" UWORD _CNV_A_R_LINEAR_____822_CM 1 100. 0. 2.61684895833333 DISPLAY_IDENTIFIER O2L_MMV_CAT_DIAG_AFL[1] ECU_ADDRESS 0xd0001f86 FORMAT "%7.5" /end MEASUREMENT
/begin MEASUREMENT egtr[0].egtr_struct_fctdgtdldd0.ctr_cyc_cat_diag_afl "Counter of diagnosis cycles for calculation of error indicator" UBYTE _CNV_A_R_LINEAR_____0_CM 1 100. 0. 255. DISPLAY_IDENTIFIER CTR_CYC_CAT_DIAG_AFL[1] ECU_ADDRESS 0xd0001f88 FORMAT "%3.0" /end MEASUREMENT
/begin MEASUREMENT egtr[0].egtr_struct_fctdgtdldd0.fac_sum_o2l_mmv_tmp "Denoiminator for calculation of O2L_MMV_CAT_DIAG_AFL" UBYTE _CNV_A_R_LINEAR_____0_CM 1 100. 0. 255. DISPLAY_IDENTIFIER FAC_SUM_O2L_MMV_TMP[1] ECU_ADDRESS 0xd0001f89 FORMAT "%3.0" /end MEASUREMENT
/begin MEASUREMENT egtr[0].egtr_struct_fctdgtdldd0.lv_err_mv_cat_diag_afl "Error indicator if O2L mean value in minimum one phase is lower then threshold" UBYTE _CNV_A_R_LINEAR_____0_CM 1 100. 0. 1. DISPLAY_IDENTIFIER LV_ERR_MV_CAT_DIAG_AFL[1] ECU_ADDRESS 0xd0001f8a FORMAT "%1.0" BIT_MASK 0x1 /end MEASUREMENT
/begin MEASUREMENT egtr[0].egtr_struct_fctdgtdldd0.lv_err_mmv_cat_diag_afl "Error indicator if O2L mean of all phases is lower then threshold" UBYTE _CNV_A_R_LINEAR_____0_CM 1 100. 0. 1. DISPLAY_IDENTIFIER LV_ERR_MMV_CAT_DIAG_AFL[1] ECU_ADDRESS 0xd0001f8b FORMAT "%1.0" BIT_MASK 0x1 /end MEASUREMENT
/begin MEASUREMENT egtr[0].egtr_struct_fctdgtdlai0.lv_inh_diag_cat_diag_afl "Inhibition condition for the TWC lean diagnosis" UBYTE _CNV_A_R_LINEAR_____0_CM 1 100. 0. 1. DISPLAY_IDENTIFIER LV_INH_DIAG_CAT_DIAG_AFL[1] ECU_ADDRESS 0xd0001f8c FORMAT "%1.0" BIT_MASK 0x1 /end MEASUREMENT
/begin MEASUREMENT egtr[1].egtr_struct_fctdgtdlac0.temp_ldc_cat_diag_afl "Filtered modelled catalyst dynamic temperature" UWORD _CNV_A_R_LINEAR_____204_CM 1 100. -273.15 1774.7875 DISPLAY_IDENTIFIER TEMP_LDC_CAT_DIAG_AFL[2] ECU_ADDRESS 0xd000203c FORMAT "%9.4" /end MEASUREMENT
/begin MEASUREMENT egtr[1].egtr_struct_fctdgtdlac0.lv_o2l_clc_act_opp_tmp "Activation for diagnosis regarding operating point" UBYTE _CNV_A_R_LINEAR_____0_CM 1 100. 0. 1. DISPLAY_IDENTIFIER LV_O2L_CLC_ACT_OPP_TMP[2] ECU_ADDRESS 0xd000203e FORMAT "%1.0" BIT_MASK 0x1 /end MEASUREMENT
/begin MEASUREMENT egtr[1].egtr_struct_fctdgtdlac0.lv_o2l_clc_act_cdn "General activation flag for calculation of oxygen capacity" UBYTE _CNV_A_R_LINEAR_____0_CM 1 100. 0. 1. DISPLAY_IDENTIFIER LV_O2L_CLC_ACT_CDN[2] ECU_ADDRESS 0xd000203f FORMAT "%1.0" BIT_MASK 0x1 /end MEASUREMENT
/begin MEASUREMENT egtr[1].egtr_struct_fctdgtdlac0.lv_o2l_clc_act_tco_tmp "Activation for diagnosis regarding coolant temperature" UBYTE _CNV_A_R_LINEAR_____0_CM 1 100. 0. 1. DISPLAY_IDENTIFIER LV_O2L_CLC_ACT_TCO_TMP[2] ECU_ADDRESS 0xd0002040 FORMAT "%1.0" BIT_MASK 0x1 /end MEASUREMENT
/begin MEASUREMENT egtr[1].egtr_struct_fctdgtdlac0.lv_o2l_clc_act_temp_tmp "Activation for diagnosis regarding TWC temperature" UBYTE _CNV_A_R_LINEAR_____0_CM 1 100. 0. 1. DISPLAY_IDENTIFIER LV_O2L_CLC_ACT_TEMP_TMP[2] ECU_ADDRESS 0xd0002041 FORMAT "%1.0" BIT_MASK 0x1 /end MEASUREMENT
/begin MEASUREMENT egtr[1].egtr_struct_fctdgtdlac0.lv_o2l_clc_act_ldc_temp_tmp "Activation for diagnosis regarding TWC temperature limited dynamic" UBYTE _CNV_A_R_LINEAR_____0_CM 1 100. 0. 1. DISPLAY_IDENTIFIER LV_O2L_CLC_ACT_LDC_TEMP_TMP[2] ECU_ADDRESS 0xd0002042 FORMAT "%1.0" BIT_MASK 0x1 /end MEASUREMENT
/begin MEASUREMENT egtr[1].egtr_struct_fctdgtdldd0.action_clcO2L_data_l_ampl.o2l_mv "Mean value of O2L values calculated in regenerations phase" UWORD _CNV_A_R_LINEAR_____822_CM 1 100. 0. 2.61684895833333 DISPLAY_IDENTIFIER O2L_L_AMPL_MV[2] ECU_ADDRESS 0xd0002044 FORMAT "%7.5" /end MEASUREMENT
/begin MEASUREMENT egtr[1].egtr_struct_fctdgtdldd0.action_clcO2L_data_l_ampl.o2l_sum "Sum of O2L values calculated during regenerations phase" UWORD _CNV_A_R_EGTR_LINEA_837_CM 1 100. 0. 20.93479 DISPLAY_IDENTIFIER O2L_L_AMPL_SUM[2] ECU_ADDRESS 0xd0002046 FORMAT "%4.1" /end MEASUREMENT
/begin MEASUREMENT egtr[1].egtr_struct_fctdgtdldd0.action_clcO2L_data_l_ampl.ctr_sum "Counter for calculation of mean value of O2L calculated in regeneration phases" UBYTE _CNV_A_R_LINEAR_____0_CM 1 100. 0. 255. DISPLAY_IDENTIFIER CTR_O2L_SUM_L_AMPL[2] ECU_ADDRESS 0xd0002048 FORMAT "%3.0" /end MEASUREMENT
/begin MEASUREMENT egtr[1].egtr_struct_fctdgtdldd0.action_clcO2L_data_h_ampl.o2l_mv "Mean value of O2L values calculated in regenerations phase" UWORD _CNV_A_R_LINEAR_____822_CM 1 100. 0. 2.61684895833333 DISPLAY_IDENTIFIER O2L_H_AMPL_MV[2] ECU_ADDRESS 0xd000204a FORMAT "%7.5" /end MEASUREMENT
/begin MEASUREMENT egtr[1].egtr_struct_fctdgtdldd0.action_clcO2L_data_h_ampl.o2l_sum "Sum of O2L values calculated during regenerations phase" UWORD _CNV_A_R_EGTR_LINEA_837_CM 1 100. 0. 20.93479 DISPLAY_IDENTIFIER O2L_H_AMPL_SUM[2] ECU_ADDRESS 0xd000204c FORMAT "%4.1" /end MEASUREMENT
/begin MEASUREMENT egtr[1].egtr_struct_fctdgtdldd0.action_clcO2L_data_h_ampl.ctr_sum "Counter for calculation of mean value of O2L calculated in regeneration phases" UBYTE _CNV_A_R_LINEAR_____0_CM 1 100. 0. 255. DISPLAY_IDENTIFIER CTR_O2L_SUM_H_AMPL[2] ECU_ADDRESS 0xd000204e FORMAT "%3.0" /end MEASUREMENT
/begin MEASUREMENT egtr[1].egtr_struct_fctdgtdldd0.action_clcO2L_data_park.o2l_mv "Mean value of O2L values calculated in regenerations phase" UWORD _CNV_A_R_LINEAR_____822_CM 1 100. 0. 2.61684895833333 DISPLAY_IDENTIFIER O2L_PARK_MV[2] ECU_ADDRESS 0xd0002050 FORMAT "%7.5" /end MEASUREMENT
/begin MEASUREMENT egtr[1].egtr_struct_fctdgtdldd0.action_clcO2L_data_park.o2l_sum "Sum of O2L values calculated during regenerations phase" UWORD _CNV_A_R_EGTR_LINEA_837_CM 1 100. 0. 20.93479 DISPLAY_IDENTIFIER O2L_PARK_SUM[2] ECU_ADDRESS 0xd0002052 FORMAT "%4.1" /end MEASUREMENT
/begin MEASUREMENT egtr[1].egtr_struct_fctdgtdldd0.action_clcO2L_data_park.ctr_sum "Counter for calculation of mean value of O2L calculated in regeneration phases" UBYTE _CNV_A_R_LINEAR_____0_CM 1 100. 0. 255. DISPLAY_IDENTIFIER CTR_O2L_SUM_PARK[2] ECU_ADDRESS 0xd0002054 FORMAT "%3.0" /end MEASUREMENT
/begin MEASUREMENT egtr[1].egtr_struct_fctdgtdldd0.action_clcO2L_data_load.o2l_mv "Mean value of O2L values calculated in regenerations phase" UWORD _CNV_A_R_LINEAR_____822_CM 1 100. 0. 2.61684895833333 DISPLAY_IDENTIFIER O2L_LOAD_MV[2] ECU_ADDRESS 0xd0002056 FORMAT "%7.5" /end MEASUREMENT
/begin MEASUREMENT egtr[1].egtr_struct_fctdgtdldd0.action_clcO2L_data_load.o2l_sum "Sum of O2L values calculated during regenerations phase" UWORD _CNV_A_R_EGTR_LINEA_837_CM 1 100. 0. 20.93479 DISPLAY_IDENTIFIER O2L_LOAD_SUM[2] ECU_ADDRESS 0xd0002058 FORMAT "%4.1" /end MEASUREMENT
/begin MEASUREMENT egtr[1].egtr_struct_fctdgtdldd0.action_clcO2L_data_load.ctr_sum "Counter for calculation of mean value of O2L calculated in regeneration phases" UBYTE _CNV_A_R_LINEAR_____0_CM 1 100. 0. 255. DISPLAY_IDENTIFIER CTR_O2L_SUM_LOAD[2] ECU_ADDRESS 0xd000205a FORMAT "%3.0" /end MEASUREMENT
/begin MEASUREMENT egtr[1].egtr_struct_fctdgtdldd0.o2l_sum_cat_diag_afl "Sum of O2L values of all phases for calculation of O2L_MMV_CAT_DIAG_AFL" UWORD _CNV_A_R_EGTR_LINEA_837_CM 1 100. 0. 20.93479 DISPLAY_IDENTIFIER O2L_SUM_CAT_DIAG_AFL[2] ECU_ADDRESS 0xd000205c FORMAT "%4.1" /end MEASUREMENT
/begin MEASUREMENT egtr[1].egtr_struct_fctdgtdldd0.o2l_mmv_cat_diag_afl "Mean value of O2L values calculated in all phases" UWORD _CNV_A_R_LINEAR_____822_CM 1 100. 0. 2.61684895833333 DISPLAY_IDENTIFIER O2L_MMV_CAT_DIAG_AFL[2] ECU_ADDRESS 0xd000205e FORMAT "%7.5" /end MEASUREMENT
/begin MEASUREMENT egtr[1].egtr_struct_fctdgtdldd0.ctr_cyc_cat_diag_afl "Counter of diagnosis cycles for calculation of error indicator" UBYTE _CNV_A_R_LINEAR_____0_CM 1 100. 0. 255. DISPLAY_IDENTIFIER CTR_CYC_CAT_DIAG_AFL[2] ECU_ADDRESS 0xd0002060 FORMAT "%3.0" /end MEASUREMENT
/begin MEASUREMENT egtr[1].egtr_struct_fctdgtdldd0.fac_sum_o2l_mmv_tmp "Denoiminator for calculation of O2L_MMV_CAT_DIAG_AFL" UBYTE _CNV_A_R_LINEAR_____0_CM 1 100. 0. 255. DISPLAY_IDENTIFIER FAC_SUM_O2L_MMV_TMP[2] ECU_ADDRESS 0xd0002061 FORMAT "%3.0" /end MEASUREMENT
/begin MEASUREMENT egtr[1].egtr_struct_fctdgtdldd0.lv_err_mv_cat_diag_afl "Error indicator if O2L mean value in minimum one phase is lower then threshold" UBYTE _CNV_A_R_LINEAR_____0_CM 1 100. 0. 1. DISPLAY_IDENTIFIER LV_ERR_MV_CAT_DIAG_AFL[2] ECU_ADDRESS 0xd0002062 FORMAT "%1.0" BIT_MASK 0x1 /end MEASUREMENT
/begin MEASUREMENT egtr[1].egtr_struct_fctdgtdldd0.lv_err_mmv_cat_diag_afl "Error indicator if O2L mean of all phases is lower then threshold" UBYTE _CNV_A_R_LINEAR_____0_CM 1 100. 0. 1. DISPLAY_IDENTIFIER LV_ERR_MMV_CAT_DIAG_AFL[2] ECU_ADDRESS 0xd0002063 FORMAT "%1.0" BIT_MASK 0x1 /end MEASUREMENT
/begin MEASUREMENT egtr[1].egtr_struct_fctdgtdlai0.lv_inh_diag_cat_diag_afl "Inhibition condition for the TWC lean diagnosis" UBYTE _CNV_A_R_LINEAR_____0_CM 1 100. 0. 1. DISPLAY_IDENTIFIER LV_INH_DIAG_CAT_DIAG_AFL[2] ECU_ADDRESS 0xd0002064 FORMAT "%1.0" BIT_MASK 0x1 /end MEASUREMENT
/begin CHARACTERISTIC c_crlc_temp_cat_diag_afl "Correlation constant for calculation of filtered TWC temperature" VALUE 0xa1002b84 _REC_VAL_20_u1 0.99609375 _CNV_A_R_LINEAR_____27_CM 0. 0.99609375 DISPLAY_IDENTIFIER C_CRLC_TEMP_CAT_DIAG_AFL FORMAT "%5.3" /end CHARACTERISTIC
/begin CHARACTERISTIC c_maf_down_lim_cat_diag_afl "Lower limit of MAF_FG_CYL to allow of OSC calculation" VALUE 0xa1002bcc _REC_VAL_20_u2 2047.96875 _CNV_A_R_LINEAR_____207_CM 0. 2047.96875 DISPLAY_IDENTIFIER C_MAF_DOWN_LIM_CAT_DIAG_AFL FORMAT "%10.5" /end CHARACTERISTIC
/begin CHARACTERISTIC c_maf_up_lim_cat_diag_afl "Upper limit of MAF_FG_CYL to allow of OSC calculation" VALUE 0xa1002bde _REC_VAL_20_u2 2047.96875 _CNV_A_R_LINEAR_____207_CM 0. 2047.96875 DISPLAY_IDENTIFIER C_MAF_UP_LIM_CAT_DIAG_AFL FORMAT "%10.5" /end CHARACTERISTIC
/begin CHARACTERISTIC c_n_32_down_lim_cat_diag_afl "Lower limit of N_32 to allow of OSC calculation" VALUE 0xa1002be1 _REC_VAL_20_u1 8160. _CNV_A_R_LINEAR_____9_CM 0. 8160. DISPLAY_IDENTIFIER C_N_32_DOWN_LIM_CAT_DIAG_AFL FORMAT "%4.0" /end CHARACTERISTIC
/begin CHARACTERISTIC c_n_32_up_lim_cat_diag_afl "Upper limit of N_32 to allow of OSC calculation" VALUE 0xa1002be2 _REC_VAL_20_u1 8160. _CNV_A_R_LINEAR_____9_CM 0. 8160. DISPLAY_IDENTIFIER C_N_32_UP_LIM_CAT_DIAG_AFL FORMAT "%4.0" /end CHARACTERISTIC
/begin CHARACTERISTIC c_tco_down_lim_cat_diag_afl "Lower limit of TCO to allow of OSC calculation" VALUE 0xa1002c0f _REC_VAL_20_u1 190.5 _CNV_A_R_LINEAR_____16_CM -48. 142.5 DISPLAY_IDENTIFIER C_TCO_DOWN_LIM_CAT_DIAG_AFL FORMAT "%6.2" /end CHARACTERISTIC
/begin CHARACTERISTIC c_tco_up_lim_cat_diag_afl "Upper limit of TCO to allow of OSC calculation" VALUE 0xa1002c13 _REC_VAL_20_u1 190.5 _CNV_A_R_LINEAR_____16_CM -48. 142.5 DISPLAY_IDENTIFIER C_TCO_UP_LIM_CAT_DIAG_AFL FORMAT "%6.2" /end CHARACTERISTIC
/begin CHARACTERISTIC c_temp_ldc_cat_diag_afl "Threshold for deactivation of OSC calculation regarding TWC temp. limited dynamic" VALUE 0xa1002c1e _REC_VAL_20_s2 4095.9375 _CNV_A_R_LINEAR_____123_CM -2048. 2047.9375 DISPLAY_IDENTIFIER C_TEMP_LDC_CAT_DIAG_AFL FORMAT "%10.4" /end CHARACTERISTIC
/begin CHARACTERISTIC c_temp_down_lim_cat_diag_afl "Lower limit of TWC temperature to allow of OSC calculation" VALUE 0xa1002c1a _REC_VAL_20_u2 2047.9375 _CNV_A_R_LINEAR_____204_CM -273.15 1774.7875 DISPLAY_IDENTIFIER C_TEMP_DOWN_LIM_CAT_DIAG_AFL FORMAT "%9.4" /end CHARACTERISTIC
/begin CHARACTERISTIC c_temp_up_lim_cat_diag_afl "Upper limit of TWC temperature to allow of OSC calculation" VALUE 0xa1002c24 _REC_VAL_20_u2 2047.9375 _CNV_A_R_LINEAR_____204_CM -273.15 1774.7875 DISPLAY_IDENTIFIER C_TEMP_UP_LIM_CAT_DIAG_AFL FORMAT "%9.4" /end CHARACTERISTIC
/begin MEASUREMENT lv_err_cat_diag_afl_1 "Present failure after filtering of diagnostic CAT_DIAG_AFL" UBYTE _CNV_S_2_RANGE__0___1_CM 1 100. 0. 1. DISPLAY_IDENTIFIER LV_ERR_CAT_DIAG_AFL_1 ECU_ADDRESS 0xd0003490 BIT_MASK 0x1 /end MEASUREMENT
/begin MEASUREMENT lv_err_cat_diag_afl_2 "Present failure after filtering of diagnostic CAT_DIAG_AFL" UBYTE _CNV_S_2_RANGE__0___1_CM 1 100. 0. 1. DISPLAY_IDENTIFIER LV_ERR_CAT_DIAG_AFL_2 ECU_ADDRESS 0xd0003491 BIT_MASK 0x1 /end MEASUREMENT
/begin CHARACTERISTIC c_ctr_cyc_cat_diag_afl "Number of diagnosis cycles for calculation of error indicator" VALUE 0xa1002b85 _REC_VAL_20_u1 254. _CNV_A_R_LINEAR_____0_CM 1. 255. DISPLAY_IDENTIFIER C_CTR_CYC_CAT_DIAG_AFL FORMAT "%3.0" /end CHARACTERISTIC
/begin CHARACTERISTIC c_ctr_o2l_mv_clc "Number of necessary O2L calculations for calculation of mean value of each phase" VALUE 0xa1002b8c _REC_VAL_20_u1 254. _CNV_A_R_LINEAR_____0_CM 1. 255. DISPLAY_IDENTIFIER C_CTR_O2L_MV_CLC FORMAT "%3.0" /end CHARACTERISTIC
/begin CHARACTERISTIC lc_err_sym_clc_cat_diag_afl "Strategy choice for calculation of error symptom" VALUE 0xa1002c33 _REC_VAL_20_u1 1. _CNV_A_R_LINEAR_____0_CM 0. 1. DISPLAY_IDENTIFIER LC_ERR_SYM_CLC_CAT_DIAG_AFL FORMAT "%1.0" /end CHARACTERISTIC
/begin CHARACTERISTIC c_o2l_thd_diag_err_h_ampl_mv[0] "O2L threshold for set of error of mean value of O2L from regenerations with high amplitude" VALUE 0xa1002bf6 _REC_VAL_20_u2 2.616848958333331 _CNV_A_R_LINEAR_____822_CM 0. 2.61684895833333 DISPLAY_IDENTIFIER C_O2L_THD_DIAG_ERR_H_AMPL_MV[1] FORMAT "%7.5" /end CHARACTERISTIC
/begin CHARACTERISTIC c_o2l_thd_diag_err_h_ampl_mv[1] "O2L threshold for set of error of mean value of O2L from regenerations with high amplitude" VALUE 0xa1002bf8 _REC_VAL_20_u2 2.616848958333331 _CNV_A_R_LINEAR_____822_CM 0. 2.61684895833333 DISPLAY_IDENTIFIER C_O2L_THD_DIAG_ERR_H_AMPL_MV[2] FORMAT "%7.5" /end CHARACTERISTIC
/begin CHARACTERISTIC c_o2l_thd_diag_err_load_mv[0] "O2L threshold for set of error of mean value of O2L from load phases" VALUE 0xa1002bfe _REC_VAL_20_u2 2.616848958333331 _CNV_A_R_LINEAR_____822_CM 0. 2.61684895833333 DISPLAY_IDENTIFIER C_O2L_THD_DIAG_ERR_LOAD_MV[1] FORMAT "%7.5" /end CHARACTERISTIC
/begin CHARACTERISTIC c_o2l_thd_diag_err_load_mv[1] "O2L threshold for set of error of mean value of O2L from load phases" VALUE 0xa1002c00 _REC_VAL_20_u2 2.616848958333331 _CNV_A_R_LINEAR_____822_CM 0. 2.61684895833333 DISPLAY_IDENTIFIER C_O2L_THD_DIAG_ERR_LOAD_MV[2] FORMAT "%7.5" /end CHARACTERISTIC
/begin CHARACTERISTIC c_o2l_thd_diag_err_l_ampl_mv[0] "O2L threshold for set of error of mean value of O2L from regenerations with low amplitude" VALUE 0xa1002bfa _REC_VAL_20_u2 2.616848958333331 _CNV_A_R_LINEAR_____822_CM 0. 2.61684895833333 DISPLAY_IDENTIFIER C_O2L_THD_DIAG_ERR_L_AMPL_MV[1] FORMAT "%7.5" /end CHARACTERISTIC
/begin CHARACTERISTIC c_o2l_thd_diag_err_l_ampl_mv[1] "O2L threshold for set of error of mean value of O2L from regenerations with low amplitude" VALUE 0xa1002bfc _REC_VAL_20_u2 2.616848958333331 _CNV_A_R_LINEAR_____822_CM 0. 2.61684895833333 DISPLAY_IDENTIFIER C_O2L_THD_DIAG_ERR_L_AMPL_MV[2] FORMAT "%7.5" /end CHARACTERISTIC
/begin CHARACTERISTIC c_o2l_thd_diag_err_mmv[0] "O2L threshold for set of LV_ERR_MMV_CAT_DIAG_AFL" VALUE 0xa1002c02 _REC_VAL_20_u2 2.616848958333331 _CNV_A_R_LINEAR_____822_CM 0. 2.61684895833333 DISPLAY_IDENTIFIER C_O2L_THD_DIAG_ERR_MMV[1] FORMAT "%7.5" /end CHARACTERISTIC
/begin CHARACTERISTIC c_o2l_thd_diag_err_mmv[1] "O2L threshold for set of LV_ERR_MMV_CAT_DIAG_AFL" VALUE 0xa1002c04 _REC_VAL_20_u2 2.616848958333331 _CNV_A_R_LINEAR_____822_CM 0. 2.61684895833333 DISPLAY_IDENTIFIER C_O2L_THD_DIAG_ERR_MMV[2] FORMAT "%7.5" /end CHARACTERISTIC
/begin CHARACTERISTIC c_o2l_thd_diag_err_park_mv[0] "O2L threshold for set of error of mean value of O2L from park phases" VALUE 0xa1002c06 _REC_VAL_20_u2 2.616848958333331 _CNV_A_R_LINEAR_____822_CM 0. 2.61684895833333 DISPLAY_IDENTIFIER C_O2L_THD_DIAG_ERR_PARK_MV[1] FORMAT "%7.5" /end CHARACTERISTIC
/begin CHARACTERISTIC c_o2l_thd_diag_err_park_mv[1] "O2L threshold for set of error of mean value of O2L from park phases" VALUE 0xa1002c08 _REC_VAL_20_u2 2.616848958333331 _CNV_A_R_LINEAR_____822_CM 0. 2.61684895833333 DISPLAY_IDENTIFIER C_O2L_THD_DIAG_ERR_PARK_MV[2] FORMAT "%7.5" /end CHARACTERISTIC
/begin CHARACTERISTIC c_abc_max_cat_diag_afl "Maximum value for antibounce counter" VALUE 0xa1002b7a _REC_VAL_20_u1 254. _CNV_A_R_LINEAR_____0_CM 1. 255. DISPLAY_IDENTIFIER C_ABC_MAX_CAT_DIAG_AFL FORMAT "%3.0" /end CHARACTERISTIC
/begin CHARACTERISTIC c_abc_inc_cat_diag_afl "Antibounce counter increment" VALUE 0xa1002b79 _REC_VAL_20_u1 255. _CNV_A_R_LINEAR_____0_CM 0. 255. DISPLAY_IDENTIFIER C_ABC_INC_CAT_DIAG_AFL FORMAT "%3.0" /end CHARACTERISTIC
/begin CHARACTERISTIC c_abc_dec_cat_diag_afl "Decrement value for antibounce counter" VALUE 0xa1002b78 _REC_VAL_20_u1 255. _CNV_A_R_LINEAR_____0_CM 0. 255. DISPLAY_IDENTIFIER C_ABC_DEC_CAT_DIAG_AFL FORMAT "%3.0" /end CHARACTERISTIC
/begin CHARACTERISTIC lc_diag_cat_diag_afl_deac "Deactivation flag for the TWC lean diagnosis" VALUE 0xa1002c32 _REC_VAL_20_u1 1. _CNV_A_R_LINEAR_____0_CM 0. 1. DISPLAY_IDENTIFIER LC_DIAG_CAT_DIAG_AFL_DEAC FORMAT "%1.0" /end CHARACTERISTIC
/begin CHARACTERISTIC c_lamb_o2l_int_clc "Threshold of linear upstream lambda signal for calculation of O2L integral" VALUE 0xa1002bb2 _REC_VAL_20_u2 31.9990234375 _CNV_A_R_LINEAR_____122_CM 0. 31.9990234375 DISPLAY_IDENTIFIER C_LAMB_O2L_INT_CLC FORMAT "%7.4" /end CHARACTERISTIC
/begin CHARACTERISTIC c_vls_o2l_int_clc "Threshold of binary downstream lambda signal for calculation of O2L integral" VALUE 0xa1002c28 _REC_VAL_20_u2 4.9951171875 _CNV_A_R_LINEAR_____2_CM 0. 4.9951171875 DISPLAY_IDENTIFIER C_VLS_O2L_INT_CLC FORMAT "%5.3" /end CHARACTERISTIC
/begin MEASUREMENT lv_err_tqi_av_mon "fault currently present in torque generation" UBYTE _CNV_S_2_RANGE__0___1_CM 1 100. 0. 1. DISPLAY_IDENTIFIER LV_ERR_TQI_AV_MON ECU_ADDRESS 0xd0002d7c BIT_MASK 0x1 /end MEASUREMENT
/begin MEASUREMENT lv_swi_afs_tqi_mon "Switch to AFS (TQI_DIF above allowed threshold)" UBYTE _CNV_S_2_RANGE__0___1_CM 1 100. 0. 1. DISPLAY_IDENTIFIER LV_SWI_AFS_TQI_MON ECU_ADDRESS 0xd0002d9b BIT_MASK 0x1 /end MEASUREMENT
/begin MEASUREMENT tqi_dif_sp_mon "deviation between torque setpoint and desired indicated engine torque" UBYTE _CNV_A_R_LINEAR_____280_CM 1 100. 0. 510. DISPLAY_IDENTIFIER TQI_DIF_SP_MON ECU_ADDRESS 0xc0001530 FORMAT "%3.0" /end MEASUREMENT
/begin MEASUREMENT tqi_dif_max_mon "permitted deviation between actual and desired indicated engine torque" UBYTE _CNV_A_R_LINEAR_____280_CM 1 100. 0. 510. DISPLAY_IDENTIFIER TQI_DIF_MAX_MON ECU_ADDRESS 0xc000152e FORMAT "%3.0" /end MEASUREMENT
/begin MEASUREMENT abc_tqi_av_not_afs_mon "Anti bounce counter for fault in torque generation (not AFS mode)" UBYTE _CNV_A_R_LINEAR_____0_CM 1 100. 0. 255. DISPLAY_IDENTIFIER ABC_TQI_AV_NOT_AFS_MON ECU_ADDRESS 0xc00014e7 FORMAT "%3.0" /end MEASUREMENT
/begin MEASUREMENT abc_swi_afs_tqi_mon "Anit bounce counter for request to AFS (TQI_DIF above allowed threshold)" UBYTE _CNV_A_R_LINEAR_____0_CM 1 100. 0. 255. DISPLAY_IDENTIFIER ABC_SWI_AFS_TQI_MON ECU_ADDRESS 0xc00014df FORMAT "%3.0" /end MEASUREMENT
/begin CHARACTERISTIC c_abc_inc_tqi_av_not_afs_mon "ABC increment at TQI_DIF above allowed treshold (not AFS-mode)" VALUE 0xa1000fe6 _REC_VAL_20_u1 255. _CNV_A_R_LINEAR_____0_CM 0. 255. DISPLAY_IDENTIFIER C_ABC_INC_TQI_AV_NOT_AFS_MON FORMAT "%3.0" /end CHARACTERISTIC
/begin CHARACTERISTIC c_abc_inc_swi_afs_tqi_mon "ABC increment for request to AFS (TQ_DIF above allowed threshold)" VALUE 0xa1000fdf _REC_VAL_20_u1 255. _CNV_A_R_LINEAR_____0_CM 0. 255. DISPLAY_IDENTIFIER C_ABC_INC_SWI_AFS_TQI_MON FORMAT "%3.0" /end CHARACTERISTIC
/begin CHARACTERISTIC c_abc_max_tqi_av_not_afs_mon "Value at which TQI_AV_MON error is recognized. when reached (not AFS-mode)" VALUE 0xa1001002 _REC_VAL_20_u1 254. _CNV_A_R_LINEAR_____0_CM 1. 255. DISPLAY_IDENTIFIER C_ABC_MAX_TQI_AV_NOT_AFS_MON FORMAT "%3.0" /end CHARACTERISTIC
/begin CHARACTERISTIC c_abc_max_swi_afs_tqi_mon "Value at which OPM will be switched to AFS at TQI_DIF above allowed treshold" VALUE 0xa1000ffb _REC_VAL_20_u1 254. _CNV_A_R_LINEAR_____0_CM 1. 255. DISPLAY_IDENTIFIER C_ABC_MAX_SWI_AFS_TQI_MON FORMAT "%3.0" /end CHARACTERISTIC
/begin MEASUREMENT abc_tqi_av_afs_mon "Anti bounce counter for fault in torque generation (AFS mode)" UBYTE _CNV_A_R_LINEAR_____0_CM 1 100. 0. 255. DISPLAY_IDENTIFIER ABC_TQI_AV_AFS_MON ECU_ADDRESS 0xc00014e5 FORMAT "%3.0" /end MEASUREMENT
/begin MEASUREMENT tqi_dif_av_mon "deviation between actual and desired indicated engine torque" UBYTE _CNV_A_R_LINEAR_____280_CM 1 100. 0. 510. DISPLAY_IDENTIFIER TQI_DIF_AV_MON ECU_ADDRESS 0xc000152c FORMAT "%3.0" /end MEASUREMENT
/begin CHARACTERISTIC c_abc_inc_tqi_av_afs_mon "ABC increment at TQI_DIF above allowed threshold (AFS mode)" VALUE 0xa1000fe5 _REC_VAL_20_u1 255. _CNV_A_R_LINEAR_____0_CM 0. 255. DISPLAY_IDENTIFIER C_ABC_INC_TQI_AV_AFS_MON FORMAT "%3.0" /end CHARACTERISTIC
/begin CHARACTERISTIC c_abc_max_tqi_av_afs_mon "Value at which TQI_AV_MON error is recognized. when reached (AFS-mode)" VALUE 0xa1001001 _REC_VAL_20_u1 254. _CNV_A_R_LINEAR_____0_CM 1. 255. DISPLAY_IDENTIFIER C_ABC_MAX_TQI_AV_AFS_MON FORMAT "%3.0" /end CHARACTERISTIC
/begin CHARACTERISTIC ip_tqi_dif_max_mon "threshold for diagnosis of engine torque overflow" MAP 0xa1000f78 _REC_MAP_20_u1_u1_u1 510. _CNV_A_R_LINEAR_____280_CM 0. 510. DISPLAY_IDENTIFIER IP_TQI_DIF_MAX_MON FORMAT "%3.0"
 /begin AXIS_DESCR COM_AXIS n_32_mon _CNV_A_R_LINEAR_____9_CM 4 0. 8160. FORMAT "%4.0" AXIS_PTS_REF ldp_n_32_ip_tqi_dif_max_mon /end AXIS_DESCR
 /begin AXIS_DESCR COM_AXIS tqi_sp_mon _CNV_A_R_LINEAR_____280_CM 4 0. 510. FORMAT "%3.0" AXIS_PTS_REF ldp_tqi_sp_ip_tqi_dif_max_mon /end AXIS_DESCR
/end CHARACTERISTIC
/begin CHARACTERISTIC c_gain_tqi_dif_max_mon "factor for threshold diagnosis with TQI_SP" VALUE 0xa100101a _REC_VAL_20_u1 63.75 _CNV_A_R_EGCP_LINEA_349_CM 0. 63.75 DISPLAY_IDENTIFIER C_GAIN_TQI_DIF_MAX_MON FORMAT "%4.1" /end CHARACTERISTIC
/begin AXIS_PTS ldp_n_32_ip_tqi_dif_max_mon "" 0xa1000832 n_32_mon _REC_AXS_20_u1 8160. _CNV_A_R_LINEAR_____9_CM 4 0. 8160. FORMAT "%4.0" /end AXIS_PTS
/begin AXIS_PTS ldp_tqi_sp_ip_tqi_dif_max_mon "" 0xa1000952 tqi_sp_mon _REC_AXS_20_u1 510. _CNV_A_R_LINEAR_____280_CM 4 0. 510. FORMAT "%3.0" /end AXIS_PTS
/begin AXIS_PTS ldpm_test_rec_idx_mon2 "" 0xa1001630 NO_INPUT_QUANTITY _REC_AXS_20_u1 15. _CNV_A_R_LINEAR_____0_CM 12 0. 15. FORMAT "%3.0" /end AXIS_PTS
/begin AXIS_PTS ldpm_iga_dif_av_mon_ip_eff_mon "" 0xa1000988 iga_dif_av_hom_mon _REC_AXS_20_u1 -95.625 _CNV_A_R_LINEAR_____174_CM 8 0. -95.625 FORMAT "%7.3" /end AXIS_PTS
/begin AXIS_PTS ldpm_n_32_mon__fac_cha_mon "" 0xa1000994 n_32 _REC_AXS_20_u1 8160. _CNV_A_R_LINEAR_____9_CM 11 0. 8160. FORMAT "%4.0" /end AXIS_PTS
/begin AXIS_PTS ldpm_n_32_mon_ip_iga_ref_mon "" 0xa10009ac n_32 _REC_AXS_20_u1 8160. _CNV_A_R_LINEAR_____9_CM 8 0. 8160. FORMAT "%4.0" /end AXIS_PTS
/begin AXIS_PTS ldpm_n_32_mon_ip_fac_tq_mon "" 0xa10009a0 n_32_mon _REC_AXS_20_u1 8160. _CNV_A_R_LINEAR_____9_CM 8 0. 8160. FORMAT "%4.0" /end AXIS_PTS
/begin AXIS_PTS ldpm_pv_av_ad_mon_ip_fac_mon "" 0xa10009c8 pv_av_ad_mon _REC_AXS_20_u1 99.609375 _CNV_A_R_LINEAR_____5_CM 8 0. 99.609375 FORMAT "%9.6" /end AXIS_PTS
/begin MEASUREMENT state_err_det_tq_min_mon "Error-detection-state for monitoring of minimum torque at clutch" UBYTE _CNV_S_3_ECM2_RANGE_839_CM 1 100. 0. 2. DISPLAY_IDENTIFIER STATE_ERR_DET_TQ_MIN_MON ECU_ADDRESS 0xd0002d4e /end MEASUREMENT
/begin MEASUREMENT opm_av_mon "Engine speed deviation N_SP_IS - N" UBYTE _CNV_S_5_ECM2_RANGE_840_CM 1 100. 0. 8. DISPLAY_IDENTIFIER OPM_AV_MON ECU_ADDRESS 0xd0002d4b /end MEASUREMENT
/begin MEASUREMENT n_dif_sp_is_mon "Deviation of actual engine speed to idle speed setpoint" SBYTE _CNV_A_R_LINEAR_____9_CM 1 100. -4096. 4064. DISPLAY_IDENTIFIER N_DIF_SP_IS_MON ECU_ADDRESS 0xd0002d49 FORMAT "%5.0" /end MEASUREMENT
/begin MEASUREMENT lv_ls_up_act_mon[0] "Logical variable for activation of engine speed limitation monitoring" UBYTE _CNV_S_2_RANGE__0___1_CM 1 100. 0. 1. DISPLAY_IDENTIFIER LV_LS_UP_ACT_MON[0] ECU_ADDRESS 0xd0002d8c BIT_MASK 0x1 /end MEASUREMENT
/begin MEASUREMENT lv_ls_up_act_mon[1] "Logical variable for activation of engine speed limitation monitoring" UBYTE _CNV_S_2_RANGE__0___1_CM 1 100. 0. 1. DISPLAY_IDENTIFIER LV_LS_UP_ACT_MON[1] ECU_ADDRESS 0xd0002d8d BIT_MASK 0x1 /end MEASUREMENT
/begin CHARACTERISTIC c_n_dif_crlc_low_mon "Correlation factor for n_dif_mmv calculation" VALUE 0xa1001029 _REC_VAL_20_u1 0.99609375 _CNV_A_R_LINEAR_____71_CM 0. 0.99609375 DISPLAY_IDENTIFIER C_N_DIF_CRLC_LOW_MON FORMAT "%5.3" /end CHARACTERISTIC
/begin MEASUREMENT lv_lamb_ls_up_vld_mon[0] "Logical variable for activation of engine speed limitation monitoring" UBYTE _CNV_S_2_RANGE__0___1_CM 1 100. 0. 1. DISPLAY_IDENTIFIER LV_LAMB_LS_UP_VLD_MON[0] ECU_ADDRESS 0xd0002d86 BIT_MASK 0x1 /end MEASUREMENT
/begin MEASUREMENT lv_lamb_ls_up_vld_mon[1] "Logical variable for activation of engine speed limitation monitoring" UBYTE _CNV_S_2_RANGE__0___1_CM 1 100. 0. 1. DISPLAY_IDENTIFIER LV_LAMB_LS_UP_VLD_MON[1] ECU_ADDRESS 0xd0002d87 BIT_MASK 0x1 /end MEASUREMENT
/begin MEASUREMENT state_req_isc_mon "State of idle speed controller monitoring" UBYTE _CNV_S_4_ECM2_RANGE_841_CM 1 100. 0. 3. DISPLAY_IDENTIFIER STATE_REQ_ISC_MON ECU_ADDRESS 0xd0002d54 /end MEASUREMENT
/begin CHARACTERISTIC c_n_dif_max_is_mon "Maximum idle speed setpoint deviation for active PD-part" VALUE 0xa100102e _REC_VAL_20_s1 8160. _CNV_A_R_LINEAR_____9_CM -4096. 4064. DISPLAY_IDENTIFIER C_N_DIF_MAX_IS_MON FORMAT "%5.0" /end CHARACTERISTIC
/begin CHARACTERISTIC c_iga_ref_temp_cor_lim_mon "Correction of reference ignition angle limitation TEMP" VALUE 0xa100101c _REC_VAL_20_u1 95.625 _CNV_A_R_LINEAR_____167_CM -35.625 60. DISPLAY_IDENTIFIER C_IGA_REF_TEMP_COR_LIM_MON FORMAT "%5.1" /end CHARACTERISTIC
/begin CHARACTERISTIC c_iga_ref_lamb_cor_lim_mon "Correction of reference ignition angle limitation LAMB_SP" VALUE 0xa100101b _REC_VAL_20_u1 95.625 _CNV_A_R_LINEAR_____167_CM -35.625 60. DISPLAY_IDENTIFIER C_IGA_REF_LAMB_COR_LIM_MON FORMAT "%5.1" /end CHARACTERISTIC
/begin CHARACTERISTIC c_abc_max_sof_mon "Maximum value of anti-bounce counter" VALUE 0xa1000ff9 _REC_VAL_20_u1 254. _CNV_A_R_LINEAR_____0_CM 1. 255. DISPLAY_IDENTIFIER C_ABC_MAX_SOF_MON FORMAT "%3.0" /end CHARACTERISTIC
/begin CHARACTERISTIC c_abc_inc_sof_mon "Anti bounce counter increment" VALUE 0xa1000fdd _REC_VAL_20_u1 255. _CNV_A_R_LINEAR_____0_CM 0. 255. DISPLAY_IDENTIFIER C_ABC_INC_SOF_MON FORMAT "%3.0" /end CHARACTERISTIC
/begin MEASUREMENT lv_n_lim_etc_mon "Logical variable for activation of engine speed limitation monitoring" UBYTE _CNV_S_2_RANGE__0___1_CM 1 100. 0. 1. DISPLAY_IDENTIFIER LV_N_LIM_ETC_MON ECU_ADDRESS 0xd0002d8f BIT_MASK 0x1 /end MEASUREMENT
/begin MEASUREMENT lv_tqi_mon_act_mon "Logical variable for torque monitoring active" UBYTE _CNV_S_2_RANGE__0___1_CM 1 100. 0. 1. DISPLAY_IDENTIFIER LV_TQI_MON_ACT_MON ECU_ADDRESS 0xd0002d9e BIT_MASK 0x1 /end MEASUREMENT
/begin CHARACTERISTIC c_v_tps_1_lih_mon "Threshold for detection of throttle position 1 outside limp home position" VALUE 0xa1001092 _REC_VAL_20_u2 4.9951171875 _CNV_A_R_LINEAR_____2_CM 0. 4.9951171875 DISPLAY_IDENTIFIER C_V_TPS_1_LIH_MON FORMAT "%5.3" /end CHARACTERISTIC
/begin CHARACTERISTIC c_v_tps_2_lih_mon "Threshold for detection of throttle position 2 outside limp home position" VALUE 0xa1001094 _REC_VAL_20_u2 4.9951171875 _CNV_A_R_LINEAR_____2_CM 0. 4.9951171875 DISPLAY_IDENTIFIER C_V_TPS_2_LIH_MON FORMAT "%5.3" /end CHARACTERISTIC
/begin CHARACTERISTIC c_n_thd_fcut_n_lim_etc_mon "Engine speed threshold for forced injection cut off in SAS mode " VALUE 0xa1001034 _REC_VAL_20_u1 8160. _CNV_A_R_LINEAR_____9_CM 0. 8160. DISPLAY_IDENTIFIER C_N_THD_FCUT_N_LIM_ETC_MON FORMAT "%4.0" /end CHARACTERISTIC
/begin MEASUREMENT lv_brake_mon "Brake active or brake fault present" UBYTE _CNV_S_2_RANGE__0___1_CM 1 100. 0. 1. DISPLAY_IDENTIFIER LV_BRAKE_MON ECU_ADDRESS 0xd0002d5c BIT_MASK 0x1 /end MEASUREMENT
/begin MEASUREMENT lv_err_vcc_pvs_1_mon "Fault in power supply for PVS_1 present" UBYTE _CNV_S_2_RANGE__0___1_CM 1 100. 0. 1. DISPLAY_IDENTIFIER LV_ERR_VCC_PVS_1_MON ECU_ADDRESS 0xd0002d80 BIT_MASK 0x1 /end MEASUREMENT
/begin MEASUREMENT tq_loss_ars_mon "Anti roll stabilisation torque losses" SWORD _CNV_A_R_LINEAR_____30_CM 1 100. -1024. 1023.96875 DISPLAY_IDENTIFIER TQ_LOSS_ARS_MON ECU_ADDRESS 0xc00014a0 FORMAT "%8.2" /end MEASUREMENT
/begin MEASUREMENT tq_loss_pste_1_mon "Steering wheel compressor torque losses" SWORD _CNV_A_R_LINEAR_____30_CM 1 100. -1024. 1023.96875 DISPLAY_IDENTIFIER TQ_LOSS_PSTE_1_MON ECU_ADDRESS 0xc00014aa FORMAT "%8.2" /end MEASUREMENT
/begin MEASUREMENT tq_loss_pste_2_mon "Steering wheel compressor torque losses" SWORD _CNV_A_R_LINEAR_____30_CM 1 100. -1024. 1023.96875 DISPLAY_IDENTIFIER TQ_LOSS_PSTE_2_MON ECU_ADDRESS 0xc00014ac FORMAT "%8.2" /end MEASUREMENT
/begin MEASUREMENT cur_alter_mon "Currency torque losses monitoring" UBYTE _CNV_A_R_LINEAR_____459_CM 1 100. 0. 255. DISPLAY_IDENTIFIER CUR_ALTER_MON ECU_ADDRESS 0xc00014eb FORMAT "%4.1" /end MEASUREMENT
/begin MEASUREMENT tq_loss_sa_mon "Secondary air torque losses" SWORD _CNV_A_R_LINEAR_____30_CM 1 100. -1024. 1023.96875 DISPLAY_IDENTIFIER TQ_LOSS_SA_MON ECU_ADDRESS 0xc00014b0 FORMAT "%8.2" /end MEASUREMENT
/begin MEASUREMENT n_alter_mon "Currency torque losses monitoring" UWORD _CNV_A_R_LINEAR_____13_CM 1 100. 0. 65535. DISPLAY_IDENTIFIER N_ALTER_MON ECU_ADDRESS 0xc0001478 FORMAT "%5.0" /end MEASUREMENT
/begin MEASUREMENT dffgen_fil_mon "Currency torque losses monitoring" UBYTE _CNV_A_R_LINEAR_____5_CM 1 100. 0. 99.609375 DISPLAY_IDENTIFIER DFFGEN_FIL_MON ECU_ADDRESS 0xc00014ec FORMAT "%5.2" /end MEASUREMENT
/begin MEASUREMENT lv_err_vcc_pvs_2_mon "Fault in power supply for PVS_2 present" UBYTE _CNV_S_2_RANGE__0___1_CM 1 100. 0. 1. DISPLAY_IDENTIFIER LV_ERR_VCC_PVS_2_MON ECU_ADDRESS 0xd0002d81 BIT_MASK 0x1 /end MEASUREMENT
/begin MEASUREMENT lv_err_vcc_pvs_mon "Fault of any PVS power supply detected by level 2 diagnosis" UBYTE _CNV_S_2_RANGE__0___1_CM 1 100. 0. 1. DISPLAY_IDENTIFIER LV_ERR_VCC_PVS_MON ECU_ADDRESS 0xd0002d82 BIT_MASK 0x1 /end MEASUREMENT
/begin MEASUREMENT tq_loss_add_mon "Additional torque losses" SWORD _CNV_A_R_LINEAR_____30_CM 1 100. -1024. 1023.96875 DISPLAY_IDENTIFIER TQ_LOSS_ADD_MON ECU_ADDRESS 0xd0002514 FORMAT "%11.5" /end MEASUREMENT
/begin MEASUREMENT tq_loss_acc_mon "Air conditioning compressor torque losses" SWORD _CNV_A_R_LINEAR_____30_CM 1 100. -1024. 1023.96875 DISPLAY_IDENTIFIER TQ_LOSS_ACC_MON ECU_ADDRESS 0xc000149a FORMAT "%11.5" /end MEASUREMENT
/begin CHARACTERISTIC c_vs_dif_max_mon "Maximum possible difference between VS_FIL and VS_SENS" VALUE 0xa100109a _REC_VAL_20_u2 511.99218 _CNV_A_R_LINEAR_____66_CM 0. 511.99218 DISPLAY_IDENTIFIER C_VS_DIF_MAX_MON FORMAT "%7.3" /end CHARACTERISTIC
/begin CHARACTERISTIC c_tq_loss_add_acc_min_mon "minimum additional torque loss for acc active" VALUE 0xa100106e _REC_VAL_20_s2 40.96 _CNV_A_R_LINEAR_____30_CM -1024. 0. DISPLAY_IDENTIFIER C_TQ_LOSS_ADD_ACC_MIN_MON FORMAT "%6.2" /end CHARACTERISTIC
/begin CHARACTERISTIC c_tq_loss_alter_min_mon "minimum additional torque loss for alternator active" VALUE 0xa1001070 _REC_VAL_20_s2 40.96 _CNV_A_R_LINEAR_____30_CM -1024. 0. DISPLAY_IDENTIFIER C_TQ_LOSS_ALTER_MIN_MON FORMAT "%6.2" /end CHARACTERISTIC
/begin CHARACTERISTIC c_tq_loss_pste_1_min_mon "minimum additional torque loss for pste 1 active" VALUE 0xa1001076 _REC_VAL_20_s2 40.96 _CNV_A_R_LINEAR_____30_CM -1024. 0. DISPLAY_IDENTIFIER C_TQ_LOSS_PSTE_1_MIN_MON FORMAT "%6.2" /end CHARACTERISTIC
/begin CHARACTERISTIC c_tq_loss_sa_min_mon "minimum additional torque loss for secondary air active" VALUE 0xa1001078 _REC_VAL_20_s2 40.96 _CNV_A_R_LINEAR_____30_CM -1024. 0. DISPLAY_IDENTIFIER C_TQ_LOSS_SA_MIN_MON FORMAT "%6.2" /end CHARACTERISTIC
/begin CHARACTERISTIC c_crlc_alter_mon "Alternator torque losses low pass" VALUE 0xa1001005 _REC_VAL_20_u1 3.984375e-002 _CNV_A_R_LINEAR_____71_CM 0. 0.99609375 DISPLAY_IDENTIFIER C_CRLC_ALTER_MON FORMAT "%5.3" /end CHARACTERISTIC
/begin CHARACTERISTIC c_fac_eff_alter_mon "Alternator torque losses low pass" VALUE 0xa1001009 _REC_VAL_20_u1 0.31875 _CNV_A_R_LINEAR_____842_CM 0. 7.96875 DISPLAY_IDENTIFIER C_FAC_EFF_ALTER_MON FORMAT "%5.3" /end CHARACTERISTIC
/begin CHARACTERISTIC c_tq_loss_ars_min_mon "minimum additional torque loss for ars active" VALUE 0xa1001072 _REC_VAL_20_s2 40.96 _CNV_A_R_LINEAR_____30_CM -1024. 0. DISPLAY_IDENTIFIER C_TQ_LOSS_ARS_MIN_MON FORMAT "%6.2" /end CHARACTERISTIC
/begin CHARACTERISTIC c_fac_n_alter_mon "" VALUE 0xa1001010 _REC_VAL_20_u1 0.31875 _CNV_A_R_LINEAR_____842_CM 0. 7.96875 DISPLAY_IDENTIFIER C_FAC_N_ALTER_MON FORMAT "%5.3" /end CHARACTERISTIC
/begin CHARACTERISTIC c_v_tq_alter_mon "Voltage range of monitoring" VALUE 0xa1001096 _REC_VAL_20_u1 1.04 _CNV_A_R_LINEAR_____36_CM 0. 26. DISPLAY_IDENTIFIER C_V_TQ_ALTER_MON FORMAT "%4.1" /end CHARACTERISTIC
/begin CHARACTERISTIC lc_inh_pu_req_mon "Logical bit to inhibit LV_PU in calculation of TQ_MIN_CLU_MDL_MON" VALUE 0xa10010a2 _REC_VAL_20_u1 1. _CNV_A_R_LINEAR_____0_CM 0. 1. DISPLAY_IDENTIFIER LC_INH_PU_REQ_MON FORMAT "%1.0" /end CHARACTERISTIC
/begin CHARACTERISTIC ip_cur_alter_mon "Alternator torque losses" MAP 0xa10009d8 _REC_MAP_20_u1_u1_u2 255. _CNV_A_R_LINEAR_____459_CM 0. 255. DISPLAY_IDENTIFIER IP_CUR_ALTER_MON FORMAT "%4.1"
 /begin AXIS_DESCR COM_AXIS dffgen_fil_mon _CNV_A_R_LINEAR_____5_CM 6 0. 99.609375 FORMAT "%9.6" AXIS_PTS_REF ldp_dffgen_fil_mon__loss_mon /end AXIS_DESCR
 /begin AXIS_DESCR COM_AXIS n_alter_mon _CNV_A_R_LINEAR_____13_CM 6 0. 65535. FORMAT "%5.0" AXIS_PTS_REF ldpm_n_alter_mon__tq_loss_mon /end AXIS_DESCR
/end CHARACTERISTIC
/begin CHARACTERISTIC ip_eff_alter_mon "Alternator torque losses" MAP 0xa10009fc _REC_MAP_20_u1_u2_u1 0.99609375 _CNV_A_R_LINEAR_____71_CM 0. 0.99609375 DISPLAY_IDENTIFIER IP_EFF_ALTER_MON FORMAT "%5.3"
 /begin AXIS_DESCR COM_AXIS n_alter_mon _CNV_A_R_LINEAR_____13_CM 6 0. 65535. FORMAT "%5.0" AXIS_PTS_REF ldpm_n_alter_mon__tq_loss_mon /end AXIS_DESCR
 /begin AXIS_DESCR COM_AXIS cur_alter_mon _CNV_A_R_LINEAR_____459_CM 6 0. 255. FORMAT "%4.1" AXIS_PTS_REF ldp_cur_alter_mon__tq_loss_mon /end AXIS_DESCR
/end CHARACTERISTIC
/begin AXIS_PTS ldp_cur_alter_mon__tq_loss_mon "" 0xa1000752 cur_alter_mon _REC_AXS_20_u1 255. _CNV_A_R_LINEAR_____459_CM 6 0. 255. FORMAT "%4.1" /end AXIS_PTS
/begin CHARACTERISTIC ip_tq_loss_pste_2_min_mon "Minimum additional torque losses for PSTE_2 active" MAP 0xa1000edc _REC_MAP_20_u2_u2_u2 1024. _CNV_A_R_LINEAR_____65_CM -1024. 0. DISPLAY_IDENTIFIER IP_TQ_LOSS_PSTE_2_MIN_MON FORMAT "%6.2"
 /begin AXIS_DESCR COM_AXIS vs_mon _CNV_A_R_LINEAR_____66_CM 6 0. 511.99218 FORMAT "%7.3" AXIS_PTS_REF ldp_vs_mon__tq_loss_mon /end AXIS_DESCR
 /begin AXIS_DESCR COM_AXIS ang_pste_stnd _CNV_A_R_LINEAR_____225_CM 6 -100. 99.99694824 FORMAT "%8.3" AXIS_PTS_REF ldp_ang_pste_stnd__tq_loss_mon /end AXIS_DESCR
/end CHARACTERISTIC
/begin MEASUREMENT vs_mon "Vehicle speed for monitoring PSTE_2" UWORD _CNV_A_R_LINEAR_____66_CM 1 100. 0. 511.99218 DISPLAY_IDENTIFIER VS_MON ECU_ADDRESS 0xc00014c8 FORMAT "%7.3" /end MEASUREMENT
/begin AXIS_PTS ldp_vs_mon__tq_loss_mon "" 0xa1000978 vs_mon _REC_AXS_20_u2 511.99218 _CNV_A_R_LINEAR_____66_CM 6 0. 511.99218 FORMAT "%7.3" /end AXIS_PTS
/begin AXIS_PTS ldp_ang_pste_stnd__tq_loss_mon "" 0xa1000700 ang_pste_stnd _REC_AXS_20_u2 199.99694824 _CNV_A_R_LINEAR_____225_CM 6 -100. 99.99694824 FORMAT "%8.3" /end AXIS_PTS
/begin MEASUREMENT pv_av_ad_mon "Modified pedal value signal" UBYTE _CNV_A_R_LINEAR_____5_CM 1 100. 0. 99.609375 DISPLAY_IDENTIFIER PV_AV_AD_MON ECU_ADDRESS 0xd0002d4c FORMAT "%9.6" /end MEASUREMENT
/begin MEASUREMENT tqi_inc_ext_mon "Monitored external torque demands" SWORD _CNV_A_R_LINEAR_____30_CM 1 100. -1024. 1023.96875 DISPLAY_IDENTIFIER TQI_INC_EXT_MON ECU_ADDRESS 0xd0002524 FORMAT "%11.5" /end MEASUREMENT
/begin MEASUREMENT n_sp_is_ratio_mon "Ratio between actual engine speed and idle speed setpoint" UWORD _CNV_A_R_LINEAR_____113_CM 1 100. 0. 7.9998779296875 DISPLAY_IDENTIFIER N_SP_IS_RATIO_MON ECU_ADDRESS 0xd0002500 FORMAT "%6.4" /end MEASUREMENT
/begin MEASUREMENT n_sp_is_mon "Monitored value of idle speed setpoint" UBYTE _CNV_A_R_LINEAR_____9_CM 1 100. 0. 8160. DISPLAY_IDENTIFIER N_SP_IS_MON ECU_ADDRESS 0xd0002d4a FORMAT "%4.0" /end MEASUREMENT
/begin MEASUREMENT n_dif_mmv_mon "n_dif moving mean value" UBYTE _CNV_A_R_LINEAR_____180_CM 1 100. -4096. 4064. DISPLAY_IDENTIFIER N_DIF_MMV_MON ECU_ADDRESS 0xc000150d FORMAT "%5.0" /end MEASUREMENT
/begin MEASUREMENT n_dif_cor_mon "Idle speed control variable" UBYTE _CNV_A_R_LINEAR_____180_CM 1 100. -4096. 4064. DISPLAY_IDENTIFIER N_DIF_COR_MON ECU_ADDRESS 0xc000150b FORMAT "%5.0" /end MEASUREMENT
/begin CHARACTERISTIC ip_fac_conv_mon "Converter torque characteristics" CURVE 0xa1000b04 _REC_CUR_20_u2_u1 4.88e-004 _CNV_A_R_ECM2_LINEA_843_CM 0. 4.88e-004 DISPLAY_IDENTIFIER IP_FAC_CONV_MON FORMAT "%7.6"
 /begin AXIS_DESCR COM_AXIS tco_mon _CNV_A_R_LINEAR_____16_CM 6 -48. 142.5 FORMAT "%6.2" AXIS_PTS_REF ldp_tco_mon_ip_fac_conv_mon /end AXIS_DESCR
/end CHARACTERISTIC
/begin MEASUREMENT fac_ramp_neg_p_d_is_mon "Factor for monitoring negative PD deactivation-ramp operations" UWORD _CNV_A_R_ECM2_LINEA_844_CM 1 100. 0. 0.5 DISPLAY_IDENTIFIER FAC_RAMP_NEG_P_D_IS_MON ECU_ADDRESS 0xd00024f0 FORMAT "%8.6" /end MEASUREMENT
/begin MEASUREMENT n_dif_mon "Engine speed deviation N_SP_IS - N" SBYTE _CNV_A_R_LINEAR_____9_CM 1 100. -4096. 4064. DISPLAY_IDENTIFIER N_DIF_MON ECU_ADDRESS 0xd0002d48 FORMAT "%5.0" /end MEASUREMENT
/begin MEASUREMENT n_dif_drof_mon "Engine speed difference effective for TQ_DROF" UBYTE _CNV_A_R_LINEAR_____180_CM 1 100. -4096. 4064. DISPLAY_IDENTIFIER N_DIF_DROF_MON ECU_ADDRESS 0xc000150c FORMAT "%5.0" /end MEASUREMENT
/begin MEASUREMENT tqi_min_pu_mon "Plausiblised L2 value of Minimum indicated torque in PU phase" UWORD _CNV_A_R_LINEAR_____30_CM 1 100. 0. 1023.96875 DISPLAY_IDENTIFIER TQI_MIN_PU_MON ECU_ADDRESS 0xd0002526 FORMAT "%10.5" /end MEASUREMENT
/begin CHARACTERISTIC c_fac_ramp_p_d_mon "Factor for monitoring negative DROF deactivation-ramp operation" VALUE 0xa1001014 _REC_VAL_20_u2 0.5 _CNV_A_R_ECM2_LINEA_844_CM 0. 0.5 DISPLAY_IDENTIFIER C_FAC_RAMP_P_D_MON FORMAT "%8.6" /end CHARACTERISTIC
/begin AXIS_PTS ldp_tco_mon_ip_n_sp_is_mon "" 0xa10008cc tco_mon _REC_AXS_20_u1 190.5 _CNV_A_R_LINEAR_____16_CM 5 -48. 142.5 FORMAT "%6.2" /end AXIS_PTS
/begin CHARACTERISTIC ip_n_sp_is_bas_max_mon "maximum idle speed setpoint depending on coolant temperature" CURVE 0xa1000d40 _REC_CUR_20_u1_u1 8160. _CNV_A_R_LINEAR_____9_CM 0. 8160. DISPLAY_IDENTIFIER IP_N_SP_IS_BAS_MAX_MON FORMAT "%4.0"
 /begin AXIS_DESCR COM_AXIS tco_mon _CNV_A_R_LINEAR_____16_CM 5 -48. 142.5 FORMAT "%6.2" AXIS_PTS_REF ldp_tco_mon_ip_n_sp_is_mon /end AXIS_DESCR
/end CHARACTERISTIC
/begin AXIS_PTS ldp_tco_mon_ip_fac_conv_mon "" 0xa10008be tco_mon _REC_AXS_20_u1 190.5 _CNV_A_R_LINEAR_____16_CM 6 -48. 142.5 FORMAT "%6.2" /end AXIS_PTS
/begin CHARACTERISTIC ip_fac_tq_dif_p_d_is_mon "maximum scaling factor due to separation of PD-part" CURVE 0xa1000bb0 _REC_CUR_20_u1_u1 1.9921875 _CNV_A_R_LINEAR_____100_CM 0. 1.9921875 DISPLAY_IDENTIFIER IP_FAC_TQ_DIF_P_D_IS_MON FORMAT "%8.6"
 /begin AXIS_DESCR COM_AXIS tco_mon _CNV_A_R_LINEAR_____16_CM 5 -48. 142.5 FORMAT "%6.2" AXIS_PTS_REF ldp_tco_mon_ip_fac_tq_p_d_mon /end AXIS_DESCR
/end CHARACTERISTIC
/begin CHARACTERISTIC ip_tq_dif_p_d_is_max_mon "maximum PD-part depending on speed deviation to idle speed setpoint" CURVE 0xa1000ec8 _REC_CUR_20_u1_u1 510. _CNV_A_R_LINEAR_____280_CM 0. 510. DISPLAY_IDENTIFIER IP_TQ_DIF_P_D_IS_MAX_MON FORMAT "%3.0"
 /begin AXIS_DESCR COM_AXIS n_dif_sp_is_mon _CNV_A_R_LINEAR_____180_CM 6 -4096. 4064. FORMAT "%5.0" AXIS_PTS_REF ldp_n_dif_sp_is_mon_ip_tq_mon /end AXIS_DESCR
/end CHARACTERISTIC
/begin AXIS_PTS ldp_n_dif_sp_is_mon_ip_tq_mon "" 0xa100087c n_dif_sp_is_mon _REC_AXS_20_u1 8160. _CNV_A_R_LINEAR_____180_CM 6 -4096. 4064. FORMAT "%5.0" /end AXIS_PTS
/begin AXIS_PTS ldp_tco_mon_ip_fac_tq_p_d_mon "" 0xa10008c6 tco_mon _REC_AXS_20_u1 190.5 _CNV_A_R_LINEAR_____16_CM 5 -48. 142.5 FORMAT "%6.2" /end AXIS_PTS
/begin MEASUREMENT tq_dif_p_d_is_mon "Monitored PD-part of the idle speed controller" SWORD _CNV_A_R_LINEAR_____30_CM 1 100. -1024. 1023.96875 DISPLAY_IDENTIFIER TQ_DIF_P_D_IS_MON ECU_ADDRESS 0xd000250e FORMAT "%11.5" /end MEASUREMENT
/begin MEASUREMENT lv_ct_mon "Logical bit for detection of driver request passive" UBYTE _CNV_S_2_RANGE__0___1_CM 1 100. 0. 1. DISPLAY_IDENTIFIER LV_CT_MON ECU_ADDRESS 0xc000153c BIT_MASK 0x1 /end MEASUREMENT
/begin CHARACTERISTIC c_n_dif_crlc_high_mon "Correlation factor for n_dif_mmv calculation" VALUE 0xa1001028 _REC_VAL_20_u1 0.99609375 _CNV_A_R_LINEAR_____71_CM 0. 0.99609375 DISPLAY_IDENTIFIER C_N_DIF_CRLC_HIGH_MON FORMAT "%5.3" /end CHARACTERISTIC
/begin CHARACTERISTIC lc_n_sp_is_clc_inh_mon "Logical bit for switching between two engine-speed-deviation calculation paths (N_DIF_COR_x_MON)" VALUE 0xa10010a4 _REC_VAL_20_u1 1. _CNV_A_R_LINEAR_____0_CM 0. 1. DISPLAY_IDENTIFIER LC_N_SP_IS_CLC_INH_MON FORMAT "%1.0" /end CHARACTERISTIC
/begin CHARACTERISTIC c_n_sp_is_bas_dif_max_mon "Idle speed gradient limitation" VALUE 0xa1001031 _REC_VAL_20_u1 4064. _CNV_A_R_LINEAR_____9_CM 0. 4064. DISPLAY_IDENTIFIER C_N_SP_IS_BAS_DIF_MAX_MON FORMAT "%4.0" /end CHARACTERISTIC
/begin MEASUREMENT tq_dif_p_d_is_max_mon "Maximum value of PD-part" UWORD _CNV_A_R_LINEAR_____30_CM 1 100. 0. 1023.96875 DISPLAY_IDENTIFIER TQ_DIF_P_D_IS_MAX_MON ECU_ADDRESS 0xd000250c FORMAT "%10.5" /end MEASUREMENT
/begin MEASUREMENT tq_dif_p_d_is_max_2_mon "Temporary variable" UWORD _CNV_A_R_LINEAR_____30_CM 1 100. 0. 1023.96875 DISPLAY_IDENTIFIER TQ_DIF_P_D_IS_MAX_2_MON ECU_ADDRESS 0xc0001490 FORMAT "%10.5" /end MEASUREMENT
/begin MEASUREMENT state_pas_ramp_act_i_is_mon "Circular buffer indicating statuts of I-part deactivation ramp" UBYTE _CNV_A_R_LINEAR_____0_CM 1 100. 0. 255. DISPLAY_IDENTIFIER STATE_PAS_RAMP_ACT_I_IS_MON ECU_ADDRESS 0xd0002d52 FORMAT "%3.0" /end MEASUREMENT
/begin MEASUREMENT lv_pas_ramp_act_p_d_chg_mon "Activation bit  for initialisation of PD-ramp" UBYTE _CNV_S_2_RANGE__0___1_CM 1 100. 0. 1. DISPLAY_IDENTIFIER LV_PAS_RAMP_ACT_P_D_CHG_MON ECU_ADDRESS 0xd0002d95 BIT_MASK 0x1 /end MEASUREMENT
/begin MEASUREMENT lv_pas_ramp_act_i_chg_mon "Activation bit  for initialisation of I-ramp" UBYTE _CNV_S_2_RANGE__0___1_CM 1 100. 0. 1. DISPLAY_IDENTIFIER LV_PAS_RAMP_ACT_I_CHG_MON ECU_ADDRESS 0xd0002d94 BIT_MASK 0x1 /end MEASUREMENT
/begin CHARACTERISTIC c_fil_tq_p_d_is_max_mon "Filter correlation constant for PD-part torque threshold" VALUE 0xa1001018 _REC_VAL_20_u2 0.9999847412109381 _CNV_A_R_LINEAR_____68_CM 0. 0.9999847412109381 DISPLAY_IDENTIFIER C_FIL_TQ_P_D_IS_MAX_MON FORMAT "%7.5" /end CHARACTERISTIC
/begin MEASUREMENT n_sp_is_bas_mon "Plausiblised basis idle-speed setpoint" UBYTE _CNV_A_R_LINEAR_____9_CM 1 100. 0. 8160. DISPLAY_IDENTIFIER N_SP_IS_BAS_MON ECU_ADDRESS 0xc000150e FORMAT "%4.0" /end MEASUREMENT
/begin MEASUREMENT lv_off_iv_n_lim_etc_mon "Reversible fuel Cut Off Switch for all cylinders" UBYTE _CNV_S_2_RANGE__0___1_CM 1 100. 0. 1. DISPLAY_IDENTIFIER LV_OFF_IV_N_LIM_ETC_MON ECU_ADDRESS 0xd0002d92 BIT_MASK 0x1 /end MEASUREMENT
/begin MEASUREMENT tq_drof_mon "Torque request for drive off assistance" SWORD _CNV_A_R_LINEAR_____30_CM 1 100. -1024. 1023.96875 DISPLAY_IDENTIFIER TQ_DROF_MON ECU_ADDRESS 0xd0002510 FORMAT "%8.2" /end MEASUREMENT
/begin MEASUREMENT tq_drof_mdl_mon "Drive off model value" SWORD _CNV_A_R_LINEAR_____30_CM 1 100. -1024. 1023.96875 DISPLAY_IDENTIFIER TQ_DROF_MDL_MON ECU_ADDRESS 0xc0001498 FORMAT "%8.2" /end MEASUREMENT
/begin MEASUREMENT tq_drof_mdl_dec_mon "Decrementation to zero" SWORD _CNV_A_R_LINEAR_____30_CM 1 100. -1024. 1023.96875 DISPLAY_IDENTIFIER TQ_DROF_MDL_DEC_MON ECU_ADDRESS 0xc0001496 FORMAT "%8.2" /end MEASUREMENT
/begin MEASUREMENT lv_tq_drof_act_mon "Function active" UBYTE _CNV_S_2_RANGE__0___1_CM 1 100. 0. 1. DISPLAY_IDENTIFIER LV_TQ_DROF_ACT_MON ECU_ADDRESS 0xc000155a BIT_MASK 0x1 /end MEASUREMENT
/begin MEASUREMENT lv_cs_mon "Clutch switch level 2" UBYTE _CNV_S_2_RANGE__0___1_CM 1 100. 0. 1. DISPLAY_IDENTIFIER LV_CS_MON ECU_ADDRESS 0xc000153b BIT_MASK 0x1 /end MEASUREMENT
/begin MEASUREMENT lv_cs_dly_mon "Clutch switch delay" UBYTE _CNV_S_2_RANGE__0___1_CM 1 100. 0. 1. DISPLAY_IDENTIFIER LV_CS_DLY_MON ECU_ADDRESS 0xc000153a BIT_MASK 0x1 /end MEASUREMENT
/begin CHARACTERISTIC ip_fac_n_grd_tq_av_mon "N_DIF correction" CURVE 0xa1000b58 _REC_CUR_20_u1_u2 1.9921875 _CNV_A_R_LINEAR_____100_CM 0. 1.9921875 DISPLAY_IDENTIFIER IP_FAC_N_GRD_TQ_AV_MON FORMAT "%5.3"
 /begin AXIS_DESCR COM_AXIS tq_av_mon _CNV_A_R_LINEAR_____65_CM 4 -1024. 1023.96875 FORMAT "%6.2" AXIS_PTS_REF ldp_tq_av_mon__tq_drof /end AXIS_DESCR
/end CHARACTERISTIC
/begin CHARACTERISTIC ip_fac_tq_drof_fac_tq_req_mon "Correction FAC_TQ_REQ_MON" CURVE 0xa1000bb6 _REC_CUR_20_u1_u1 1.9921875 _CNV_A_R_LINEAR_____100_CM 0. 1.9921875 DISPLAY_IDENTIFIER IP_FAC_TQ_DROF_FAC_TQ_REQ_MON FORMAT "%5.3"
 /begin AXIS_DESCR COM_AXIS fac_tq_req_mon _CNV_A_R_LINEAR_____100_CM 6 0. 1.9921875 FORMAT "%5.3" AXIS_PTS_REF ldp_fac_tq_req_mon__tq_drof /end AXIS_DESCR
/end CHARACTERISTIC
/begin AXIS_PTS ldp_tq_av_mon__tq_drof "" 0xa1000948 tq_av_mon _REC_AXS_20_u2 2047.96875 _CNV_A_R_LINEAR_____65_CM 4 -1024. 1023.96875 FORMAT "%6.2" /end AXIS_PTS
/begin AXIS_PTS ldp_fac_tq_req_mon__tq_drof "" 0xa1000792 fac_tq_req_mon _REC_AXS_20_u1 1.9921875 _CNV_A_R_LINEAR_____100_CM 6 0. 1.9921875 FORMAT "%5.3" /end AXIS_PTS
/begin CHARACTERISTIC c_t_drof_pas_dly_mon "Clutch switch turn off delay" VALUE 0xa1001043 _REC_VAL_20_u1 0.408 _CNV_A_R_LINEAR_____279_CM 0. 10.2 DISPLAY_IDENTIFIER C_T_DROF_PAS_DLY_MON FORMAT "%5.2" /end CHARACTERISTIC
/begin CHARACTERISTIC c_t_drof_zero_mon "Ramp down to zero time" VALUE 0xa1001044 _REC_VAL_20_u1 0.408 _CNV_A_R_LINEAR_____279_CM 0. 10.2 DISPLAY_IDENTIFIER C_T_DROF_ZERO_MON FORMAT "%5.2" /end CHARACTERISTIC
/begin CHARACTERISTIC c_n_dif_drof_max_mon "Maximum threshold N_DIF_DROF_MON" VALUE 0xa100102a _REC_VAL_20_u1 326.4 _CNV_A_R_LINEAR_____180_CM -4096. 4064. DISPLAY_IDENTIFIER C_N_DIF_DROF_MAX_MON FORMAT "%5.0" /end CHARACTERISTIC
/begin CHARACTERISTIC c_n_dif_drof_min_mon "Minimum threshold N_DIF_DROF_MON" VALUE 0xa100102b _REC_VAL_20_u1 326.4 _CNV_A_R_LINEAR_____180_CM -4096. 4064. DISPLAY_IDENTIFIER C_N_DIF_DROF_MIN_MON FORMAT "%5.0" /end CHARACTERISTIC
/begin CHARACTERISTIC c_n_dif_add_drof_mon "Offset threshold N_DIF_DROF_MON" VALUE 0xa1001027 _REC_VAL_20_u1 326.4 _CNV_A_R_LINEAR_____180_CM -4096. 4064. DISPLAY_IDENTIFIER C_N_DIF_ADD_DROF_MON FORMAT "%5.0" /end CHARACTERISTIC
/begin CHARACTERISTIC ip_tq_drof_mon "Drive off torque request" CURVE 0xa1000ed0 _REC_CUR_20_u2_u1 2047.96875 _CNV_A_R_LINEAR_____65_CM -1024. 1023.96875 DISPLAY_IDENTIFIER IP_TQ_DROF_MON FORMAT "%6.2"
 /begin AXIS_DESCR COM_AXIS n_dif_drof_mon _CNV_A_R_LINEAR_____180_CM 6 -4096. 4064. FORMAT "%5.0" AXIS_PTS_REF ldp_n_dif_drof_mon__tq_drof /end AXIS_DESCR
/end CHARACTERISTIC
/begin AXIS_PTS ldp_vs_mon__tq_drof "" 0xa1000968 vs_mon _REC_AXS_20_u2 511.99218 _CNV_A_R_LINEAR_____66_CM 6 0. 511.99218 FORMAT "%7.3" /end AXIS_PTS
/begin AXIS_PTS ldp_n_32_mon__tq_drof "" 0xa1000838 n_32_mon _REC_AXS_20_u1 816. _CNV_A_R_LINEAR_____9_CM 6 0. 8160. FORMAT "%4.0" /end AXIS_PTS
/begin CHARACTERISTIC id_tq_drof_ena_mon "Correction depending on VS and N_32" CURVE 0xa10009d2 _REC_CUR_20_u1_u1 1. _CNV_A_R_LINEAR_____0_CM 0. 1. DISPLAY_IDENTIFIER ID_TQ_DROF_ENA_MON FORMAT "%2.0"
 /begin AXIS_DESCR COM_AXIS n_dif_drof_mon _CNV_A_R_LINEAR_____180_CM 6 -4096. 4064. FORMAT "%5.0" AXIS_PTS_REF ldp_n_dif_drof_mon__id_tq_drof /end AXIS_DESCR
/end CHARACTERISTIC
/begin AXIS_PTS ldp_n_dif_drof_mon__id_tq_drof "" 0xa100086c n_dif_drof_mon _REC_AXS_20_u1 8160. _CNV_A_R_LINEAR_____180_CM 6 -4096. 4064. FORMAT "%5.0" /end AXIS_PTS
/begin CHARACTERISTIC ip_fac_tq_drof_vs_mon "Correction depending on N_32 and VS" MAP 0xa1000bbc _REC_MAP_20_u1_u2_u1 1.9921875 _CNV_A_R_LINEAR_____100_CM 0. 1.9921875 DISPLAY_IDENTIFIER IP_FAC_TQ_DROF_VS_MON FORMAT "%5.3"
 /begin AXIS_DESCR COM_AXIS vs_mon _CNV_A_R_LINEAR_____66_CM 6 0. 511.99218 FORMAT "%7.3" AXIS_PTS_REF ldp_vs_mon__tq_drof /end AXIS_DESCR
 /begin AXIS_DESCR COM_AXIS n_32_mon _CNV_A_R_LINEAR_____9_CM 6 0. 8160. FORMAT "%4.0" AXIS_PTS_REF ldp_n_32_mon__tq_drof /end AXIS_DESCR
/end CHARACTERISTIC
/begin CHARACTERISTIC c_n_32_tq_drof_max_mon "Minimum threshold N_DIF_DROF_MON" VALUE 0xa1001026 _REC_VAL_20_u1 326.4 _CNV_A_R_LINEAR_____9_CM 0. 8160. DISPLAY_IDENTIFIER C_N_32_TQ_DROF_MAX_MON FORMAT "%4.0" /end CHARACTERISTIC
/begin MEASUREMENT tq_av_mon "Effective torque" SWORD _CNV_A_R_LINEAR_____30_CM 1 100. -1024. 1023.96875 DISPLAY_IDENTIFIER TQ_AV_MON ECU_ADDRESS 0xc000148c FORMAT "%8.2" /end MEASUREMENT
/begin MEASUREMENT t_drof_pas_dly_mon "Delay time" UBYTE _CNV_A_R_LINEAR_____279_CM 1 100. 0. 10.2 DISPLAY_IDENTIFIER T_DROF_PAS_DLY_MON ECU_ADDRESS 0xc000151a FORMAT "%5.2" /end MEASUREMENT
/begin CHARACTERISTIC c_v_sof_swi_min_mon "Input voltage threshold min" VALUE 0xa100108c _REC_VAL_20_u2 4.9951171875 _CNV_A_R_LINEAR_____2_CM 0. 4.9951171875 DISPLAY_IDENTIFIER C_V_SOF_SWI_MIN_MON FORMAT "%5.3" /end CHARACTERISTIC
/begin CHARACTERISTIC c_v_sof_swi_max_mon "Input voltage threshold max" VALUE 0xa100108a _REC_VAL_20_u2 4.9951171875 _CNV_A_R_LINEAR_____2_CM 0. 4.9951171875 DISPLAY_IDENTIFIER C_V_SOF_SWI_MAX_MON FORMAT "%5.3" /end CHARACTERISTIC
/begin MEASUREMENT state_pas_ramp_act_p_d_is_mon "Circular buffer indicating statuts of PD-part deactivation ramp" UBYTE _CNV_A_R_LINEAR_____0_CM 1 100. 0. 255. DISPLAY_IDENTIFIER STATE_PAS_RAMP_ACT_P_D_IS_MON ECU_ADDRESS 0xd0002d53 FORMAT "%3.0" /end MEASUREMENT
/begin CHARACTERISTIC c_pv_av_sof_min_mon "PV_AV threshold for activation IP_FAC_TQ_REQ_DRIV_RNG_L_MON" VALUE 0xa1001039 _REC_VAL_20_u1 99.609375 _CNV_A_R_LINEAR_____5_CM 0. 99.609375 DISPLAY_IDENTIFIER C_PV_AV_SOF_MIN_MON FORMAT "%4.1" /end CHARACTERISTIC
/begin CHARACTERISTIC c_fac_tq_req_driv_sof_max_mon "Scaling factor threshold for activation IP_FAC_TQ_REQ_DRIV_RNG_L_MON" VALUE 0xa1001017 _REC_VAL_20_u1 1.99220002 _CNV_A_R_LINEAR_____97_CM 0. 1.99220002 DISPLAY_IDENTIFIER C_FAC_TQ_REQ_DRIV_SOF_MAX_MON FORMAT "%5.3" /end CHARACTERISTIC
/begin CHARACTERISTIC c_pv_av_grd_sof_max_mon "Pedal value gradient rheshold for recognition of LV_RNG_L_MON" VALUE 0xa1001038 _REC_VAL_20_u1 2490.234 _CNV_A_R_LINEAR_____247_CM -1250. 1240.234 DISPLAY_IDENTIFIER C_PV_AV_GRD_SOF_MAX_MON FORMAT "%6.1" /end CHARACTERISTIC
/begin CHARACTERISTIC c_t_pv_av_grd_sof_max_mon "Minimum time for pedal value gradient for recognition of LV_RNG_L_MON" VALUE 0xa100104f _REC_VAL_20_u1 10.2 _CNV_A_R_LINEAR_____279_CM 0. 10.2 DISPLAY_IDENTIFIER C_T_PV_AV_GRD_SOF_MAX_MON FORMAT "%5.2" /end CHARACTERISTIC
/begin CHARACTERISTIC lc_rng_l_man_as_mon "Calibration constant for to activate IP_FAC_TQ_REQ_DRIV_RNG_L (low range mode) in case if LV_RNG_L = 0 (default value = 0)" VALUE 0xa10010a5 _REC_VAL_20_u1 1. _CNV_A_R_LINEAR_____0_CM 0. 1. DISPLAY_IDENTIFIER LC_RNG_L_MAN_AS_MON FORMAT "%2.0" /end CHARACTERISTIC
/begin AXIS_PTS ldp_n_dif_drof_mon__tq_drof "" 0xa1000874 n_dif_drof_mon _REC_AXS_20_u1 8160. _CNV_A_R_LINEAR_____180_CM 6 -4096. 4064. FORMAT "%5.0" /end AXIS_PTS
/begin AXIS_PTS ldp_dffgen_fil_mon__loss_mon "" 0xa100075a dffgen_fil_mon _REC_AXS_20_u1 99.609375 _CNV_A_R_LINEAR_____5_CM 6 0. 99.609375 FORMAT "%9.6" /end AXIS_PTS
/begin AXIS_PTS ldpm_n_alter_mon__tq_loss_mon "" 0xa10009b8 n_alter_mon _REC_AXS_20_u2 65535. _CNV_A_R_LINEAR_____13_CM 6 0. 65535. FORMAT "%5.0" /end AXIS_PTS
/begin MEASUREMENT v_tps_1_mon "Channel 1 of TPS for monitoring" UWORD _CNV_A_R_LINEAR_____2_CM 1 100. 0. 4.9951171875 DISPLAY_IDENTIFIER V_TPS_1_MON ECU_ADDRESS 0xd000252c FORMAT "%5.3" /end MEASUREMENT
/begin MEASUREMENT v_tps_2_mon "Channel 2 of TPS for monitoring" UWORD _CNV_A_R_LINEAR_____2_CM 1 100. 0. 4.9951171875 DISPLAY_IDENTIFIER V_TPS_2_MON ECU_ADDRESS 0xd000252e FORMAT "%5.3" /end MEASUREMENT
/begin MEASUREMENT tq_loss_pste_mon "Power steering torque losses" SWORD _CNV_A_R_LINEAR_____30_CM 1 100. -1024. 1023.96875 DISPLAY_IDENTIFIER TQ_LOSS_PSTE_MON ECU_ADDRESS 0xc00014ae FORMAT "%11.5" /end MEASUREMENT
/begin MEASUREMENT tq_conv_max_mon "Monitored value of converter torque losses" UBYTE _CNV_A_R_LINEAR_____280_CM 1 100. 0. 510. DISPLAY_IDENTIFIER TQ_CONV_MAX_MON ECU_ADDRESS 0xd0002d56 FORMAT "%3.0" /end MEASUREMENT
/begin MEASUREMENT tq_conv_max_mdl_mon "Maximum converter torque losses" UBYTE _CNV_A_R_LINEAR_____280_CM 1 100. 0. 510. DISPLAY_IDENTIFIER TQ_CONV_MAX_MDL_MON ECU_ADDRESS 0xc0001527 FORMAT "%3.0" /end MEASUREMENT
/begin CHARACTERISTIC c_tq_dif_is_ad_conv_max_mon "Max.limitation for converter torque adaptation" VALUE 0xa1001066 _REC_VAL_20_u1 510. _CNV_A_R_LINEAR_____280_CM 0. 510. DISPLAY_IDENTIFIER C_TQ_DIF_IS_AD_CONV_MAX_MON FORMAT "%3.0" /end CHARACTERISTIC
/begin CHARACTERISTIC c_n_dif_fac_mon "Multiplicative factor for n_dif_cor calculation" VALUE 0xa100102c _REC_VAL_20_u1 0.99609375 _CNV_A_R_LINEAR_____71_CM 0. 0.99609375 DISPLAY_IDENTIFIER C_N_DIF_FAC_MON FORMAT "%5.3" /end CHARACTERISTIC
/begin CHARACTERISTIC c_n_sp_is_lih_max_mon "Multiplicative factor for n_dif_cor calculation" VALUE 0xa1001032 _REC_VAL_20_u1 8160. _CNV_A_R_LINEAR_____9_CM 0. 8160. DISPLAY_IDENTIFIER C_N_SP_IS_LIH_MAX_MON FORMAT "%4.0" /end CHARACTERISTIC
/begin CHARACTERISTIC c_n_dif_hys_is_pu_mon "N_DIF_MON hysteresis before state PU" VALUE 0xa100102d _REC_VAL_20_s1 8160. _CNV_A_R_LINEAR_____9_CM -4096. 4064. DISPLAY_IDENTIFIER C_N_DIF_HYS_IS_PU_MON FORMAT "%5.0" /end CHARACTERISTIC
/begin CHARACTERISTIC lc_tq_drof_isc_off_mon "N_DIF_MON hysteresis before state PU" VALUE 0xa10010a8 _REC_VAL_20_u1 1. _CNV_A_R_LINEAR_____0_CM 0. 1. DISPLAY_IDENTIFIER LC_TQ_DROF_ISC_OFF_MON FORMAT "%1.0" /end CHARACTERISTIC
/begin CHARACTERISTIC lc_swi_opm_av_mon "N_DIF_MON hysteresis before state PU" VALUE 0xa10010a7 _REC_VAL_20_u1 1. _CNV_A_R_LINEAR_____0_CM 0. 1. DISPLAY_IDENTIFIER LC_SWI_OPM_AV_MON FORMAT "%1.0" /end CHARACTERISTIC
/begin CHARACTERISTIC c_swi_opm_av_mon "N_DIF_MON hysteresis before state PU" VALUE 0xa100103c _REC_VAL_20_u1 3. _CNV_A_R_LINEAR_____0_CM 0. 3. DISPLAY_IDENTIFIER C_SWI_OPM_AV_MON FORMAT "%1.0" /end CHARACTERISTIC
/begin MEASUREMENT lv_igk_mon "Logical variable for ignition key on" UBYTE _CNV_S_2_RANGE__0___1_CM 1 100. 0. 1. DISPLAY_IDENTIFIER LV_IGK_MON ECU_ADDRESS 0xd0002d84 BIT_MASK 0x1 /end MEASUREMENT
/begin MEASUREMENT lv_sf_tqd_mon "Logical variable for ignition key on" UBYTE _CNV_S_2_RANGE__0___1_CM 1 100. 0. 1. DISPLAY_IDENTIFIER LV_SF_TQD_MON ECU_ADDRESS 0xd0002d97 BIT_MASK 0x1 /end MEASUREMENT
/begin MEASUREMENT gr_dt_mdl_mon "Logical variable for ignition key on" UWORD _CNV_A_R_LINEAR_____114_CM 1 100. 0. 63.99902344 DISPLAY_IDENTIFIER GR_DT_MDL_MON ECU_ADDRESS 0xd00024f2 FORMAT "%7.4" BIT_MASK 0x1 /end MEASUREMENT
/begin CHARACTERISTIC c_vs_lih_mon "Vehicle speed monitoring value in case of error" VALUE 0xa100109e _REC_VAL_20_u2 511.99218 _CNV_A_R_LINEAR_____66_CM 0. 511.99218 DISPLAY_IDENTIFIER C_VS_LIH_MON FORMAT "%7.3" /end CHARACTERISTIC
/begin CHARACTERISTIC c_fac_rax_mon "Vehicle speed monitoring value in case of error" VALUE 0xa1001016 _REC_VAL_20_u1 7.96875 _CNV_A_R_LINEAR_____842_CM 0. 7.96875 DISPLAY_IDENTIFIER C_FAC_RAX_MON FORMAT "%5.3" /end CHARACTERISTIC
/begin CHARACTERISTIC c_fac_gr_mon "Vehicle speed monitoring value in case of error" VALUE 0xa100100d _REC_VAL_20_u1 2.55 _CNV_A_R_LINEAR_____404_CM 0. 2.55 DISPLAY_IDENTIFIER C_FAC_GR_MON /end CHARACTERISTIC
/begin CHARACTERISTIC c_fac_gr_dif_mon "Vehicle speed monitoring value in case of error" VALUE 0xa100100a _REC_VAL_20_u1 1.9921875 _CNV_A_R_LINEAR_____100_CM 0. 1.9921875 DISPLAY_IDENTIFIER C_FAC_GR_DIF_MON FORMAT "%5.3" /end CHARACTERISTIC
/begin CHARACTERISTIC c_fac_gr_min_mon "Vehicle speed monitoring value in case of error" VALUE 0xa100100c _REC_VAL_20_u1 31.99 _CNV_A_R_LINEAR_____845_CM 0. 31.99 DISPLAY_IDENTIFIER C_FAC_GR_MIN_MON FORMAT "%4.1" /end CHARACTERISTIC
/begin MEASUREMENT tq_add_min_clu_mon "Additional torque request from external sources " SWORD _CNV_A_R_LINEAR_____30_CM 1 100. -1024. 1023.96875 DISPLAY_IDENTIFIER TQ_ADD_MIN_CLU_MON ECU_ADDRESS 0xd0002504 FORMAT "%11.5" /end MEASUREMENT
/begin MEASUREMENT iga_ref_hom_cor_ext_mon "Additional torque request from external sources " UBYTE _CNV_A_R_LINEAR_____167_CM 1 100. -35.625 60. DISPLAY_IDENTIFIER IGA_REF_HOM_COR_EXT_MON ECU_ADDRESS 0xd0002d44 FORMAT "%7.3" /end MEASUREMENT
/begin MEASUREMENT iga_ref_mplh_cor_ext_mon "Additional torque request from external sources " UBYTE _CNV_A_R_LINEAR_____167_CM 1 100. -35.625 60. DISPLAY_IDENTIFIER IGA_REF_MPLH_COR_EXT_MON ECU_ADDRESS 0xd0002d45 FORMAT "%7.3" /end MEASUREMENT
/begin MEASUREMENT lv_swi_tq_min_clu_mon "Idle speed setpoint from external influences" UBYTE _CNV_S_2_RANGE__0___1_CM 1 100. 0. 1. DISPLAY_IDENTIFIER LV_SWI_TQ_MIN_CLU_MON ECU_ADDRESS 0xd0002d9d BIT_MASK 0x1 /end MEASUREMENT
/begin MEASUREMENT lv_sof_swi_req_mon "Idle speed setpoint from external influences" UBYTE _CNV_S_2_RANGE__0___1_CM 1 100. 0. 1. DISPLAY_IDENTIFIER LV_SOF_SWI_REQ_MON ECU_ADDRESS 0xd0002d98 BIT_MASK 0x1 /end MEASUREMENT
/begin MEASUREMENT lv_sof_swi_mon "Idle speed setpoint from external influences" UBYTE _CNV_S_2_RANGE__0___1_CM 1 100. 0. 1. DISPLAY_IDENTIFIER LV_SOF_SWI_MON ECU_ADDRESS 0xc0001559 BIT_MASK 0x1 /end MEASUREMENT
/begin CHARACTERISTIC c_fac_gr_max_mon "Vehicle speed monitoring value in case of error" VALUE 0xa100100b _REC_VAL_20_u1 31.99 _CNV_A_R_LINEAR_____845_CM 0. 31.99 DISPLAY_IDENTIFIER C_FAC_GR_MAX_MON FORMAT "%4.1" /end CHARACTERISTIC
/begin CHARACTERISTIC c_v_sof_swi_on_tol_mon "Vehicle speed monitoring value in case of error" VALUE 0xa1001090 _REC_VAL_20_u2 4.9951171875 _CNV_A_R_LINEAR_____2_CM 0. 4.9951171875 DISPLAY_IDENTIFIER C_V_SOF_SWI_ON_TOL_MON FORMAT "%5.3" /end CHARACTERISTIC
/begin CHARACTERISTIC c_v_sof_swi_on_bol_mon "Vehicle speed monitoring value in case of error" VALUE 0xa100108e _REC_VAL_20_u2 4.9951171875 _CNV_A_R_LINEAR_____2_CM 0. 4.9951171875 DISPLAY_IDENTIFIER C_V_SOF_SWI_ON_BOL_MON FORMAT "%5.3" /end CHARACTERISTIC
/begin CHARACTERISTIC lc_var_sof_swi_mon "Vehicle speed monitoring value in case of error" VALUE 0xa10010a9 _REC_VAL_20_u1 1. _CNV_A_R_LINEAR_____0_CM 0. 1. DISPLAY_IDENTIFIER LC_VAR_SOF_SWI_MON FORMAT "%1.0" /end CHARACTERISTIC
/begin CHARACTERISTIC lc_rng_l_mon "Vehicle speed monitoring value in case of error" VALUE 0xa10010a6 _REC_VAL_20_u1 1. _CNV_A_R_LINEAR_____0_CM 0. 1. DISPLAY_IDENTIFIER LC_RNG_L_MON FORMAT "%1.0" /end CHARACTERISTIC
/begin CHARACTERISTIC lc_conf_city_ena_mon "Vehicle speed monitoring value in case of error" VALUE 0xa10010a1 _REC_VAL_20_u1 1. _CNV_A_R_LINEAR_____0_CM 0. 1. DISPLAY_IDENTIFIER LC_CONF_CITY_ENA_MON FORMAT "%1.0" /end CHARACTERISTIC
/begin MEASUREMENT lv_rng_l_mon "Idle speed setpoint from external influences" UBYTE _CNV_S_2_RANGE__0___1_CM 1 100. 0. 1. DISPLAY_IDENTIFIER LV_RNG_L_MON ECU_ADDRESS 0xd0002d96 BIT_MASK 0x1 /end MEASUREMENT
/begin MEASUREMENT lv_swi_fac_tq_req_mon "Idle speed setpoint from external influences" UBYTE _CNV_S_2_RANGE__0___1_CM 1 100. 0. 1. DISPLAY_IDENTIFIER LV_SWI_FAC_TQ_REQ_MON ECU_ADDRESS 0xd0002d9c BIT_MASK 0x1 /end MEASUREMENT
/begin MEASUREMENT lv_err_sof_inh_mon "Idle speed setpoint from external influences" UBYTE _CNV_S_2_RANGE__0___1_CM 1 100. 0. 1. DISPLAY_IDENTIFIER LV_ERR_SOF_INH_MON ECU_ADDRESS 0xd0002d73 BIT_MASK 0x1 /end MEASUREMENT
/begin MEASUREMENT abc_sof_inh_mon "Idle speed setpoint from external influences" UBYTE _CNV_A_R_LINEAR_____0_CM 1 100. 0. 255. DISPLAY_IDENTIFIER ABC_SOF_INH_MON ECU_ADDRESS 0xc00014dd FORMAT "%3.0" BIT_MASK 0x1 /end MEASUREMENT
/begin MEASUREMENT lv_err_cru_inh_mon "Logical variable for ignition key on" UBYTE _CNV_S_2_RANGE__0___1_CM 1 100. 0. 1. DISPLAY_IDENTIFIER LV_ERR_CRU_INH_MON ECU_ADDRESS 0xd0002d62 BIT_MASK 0x1 /end MEASUREMENT
/begin MEASUREMENT lv_msr_inh_mon "Logical variable for ignition key on" UBYTE _CNV_S_2_RANGE__0___1_CM 1 100. 0. 1. DISPLAY_IDENTIFIER LV_MSR_INH_MON ECU_ADDRESS 0xd0002d8e BIT_MASK 0x1 /end MEASUREMENT
/begin MEASUREMENT lv_gs_inh_mon "Logical variable for ignition key on" UBYTE _CNV_S_2_RANGE__0___1_CM 1 100. 0. 1. DISPLAY_IDENTIFIER LV_GS_INH_MON ECU_ADDRESS 0xd0002d83 BIT_MASK 0x1 /end MEASUREMENT
/begin MEASUREMENT gr_dt_mon "Logical variable for ignition key on" UWORD _CNV_A_R_LINEAR_____114_CM 1 100. 0. 63.99902344 DISPLAY_IDENTIFIER GR_DT_MON ECU_ADDRESS 0xd00024f4 FORMAT "%7.4" BIT_MASK 0x1 /end MEASUREMENT
/begin MEASUREMENT tqi_inc_can_mon "Logical variable for ignition key on" UWORD _CNV_A_R_LINEAR_____30_CM 1 100. 0. 1023.96875 DISPLAY_IDENTIFIER TQI_INC_CAN_MON ECU_ADDRESS 0xd0002522 FORMAT "%7.2" BIT_MASK 0x1 /end MEASUREMENT
/begin MEASUREMENT tq_loss_alter_mon "Alternator torque losses" SWORD _CNV_A_R_LINEAR_____30_CM 1 100. -1024. 1023.96875 DISPLAY_IDENTIFIER TQ_LOSS_ALTER_MON ECU_ADDRESS 0xc000149e FORMAT "%11.5" /end MEASUREMENT
/begin MEASUREMENT tq_loss_alter_mdl_mon "Alternator torque losses" SWORD _CNV_A_R_LINEAR_____30_CM 1 100. -1024. 1023.96875 DISPLAY_IDENTIFIER TQ_LOSS_ALTER_MDL_MON ECU_ADDRESS 0xc000149c FORMAT "%11.5" /end MEASUREMENT
/begin CHARACTERISTIC c_vp_acq_conv_hys_mon "Maximum allowed difference between the voltage on main controller and on monitoring unit" VALUE 0xa1001098 _REC_VAL_20_u2 4.99984741210938 _CNV_A_R_ECM2_LINEA_846_CM 0. 4.99984741210938 DISPLAY_IDENTIFIER C_VP_ACQ_CONV_HYS_MON FORMAT "%6.4" /end CHARACTERISTIC
/begin CHARACTERISTIC c_abc_inc_conv_mon "Anti bounce counter increment (additive value in case of ADC error)" VALUE 0xa1000fcd _REC_VAL_20_u1 255. _CNV_A_R_LINEAR_____0_CM 0. 255. DISPLAY_IDENTIFIER C_ABC_INC_CONV_MON FORMAT "%3.0" /end CHARACTERISTIC
/begin CHARACTERISTIC c_abc_max_conv_mon "Value at which ADC error is recognized, when reached" VALUE 0xa1000fe9 _REC_VAL_20_u1 254. _CNV_A_R_LINEAR_____0_CM 1. 255. DISPLAY_IDENTIFIER C_ABC_MAX_CONV_MON FORMAT "%3.0" /end CHARACTERISTIC
/begin MEASUREMENT abc_conv_mon "Anti bounce counter ADC error" UBYTE _CNV_A_R_LINEAR_____0_CM 1 100. 0. 255. DISPLAY_IDENTIFIER ABC_CONV_MON ECU_ADDRESS 0xc00014d1 FORMAT "%3.0" /end MEASUREMENT
/begin MEASUREMENT lv_err_conv_mon "Logical variable for ADC error" UBYTE _CNV_S_2_RANGE__0___1_CM 1 100. 0. 1. DISPLAY_IDENTIFIER LV_ERR_CONV_MON ECU_ADDRESS 0xd0002d60 BIT_MASK 0x1 /end MEASUREMENT
/begin CHARACTERISTIC c_state_an_dig_err_act_mon "Calibratable value used for provoking an error of the A/D conversion" VALUE 0xa100103b _REC_VAL_20_u1 255. _CNV_A_R_LINEAR_____0_CM 0. 255. DISPLAY_IDENTIFIER C_STATE_AN_DIG_ERR_ACT_MON FORMAT "%3.0" /end CHARACTERISTIC
/begin CHARACTERISTIC c_can_vb_min_diag_mon "Threshold of battery voltage for CAN diagnosis" VALUE 0xa1001004 _REC_VAL_20_u1 25.8984375 _CNV_A_R_LINEAR_____289_CM 0. 25.8984375 DISPLAY_IDENTIFIER C_CAN_VB_MIN_DIAG_MON FORMAT "%9.6" /end CHARACTERISTIC
/begin MEASUREMENT lv_can_inh_msr_mon "Logical variable to inhibit MSR due to CAN fault" UBYTE _CNV_S_2_RANGE__0___1_CM 1 100. 0. 1. DISPLAY_IDENTIFIER LV_CAN_INH_MSR_MON ECU_ADDRESS 0xc0001539 BIT_MASK 0x1 /end MEASUREMENT
/begin MEASUREMENT lv_can_inh_gs_mon "Logical variable to inhibit GS due to CAN fault" UBYTE _CNV_S_2_RANGE__0___1_CM 1 100. 0. 1. DISPLAY_IDENTIFIER LV_CAN_INH_GS_MON ECU_ADDRESS 0xc0001538 BIT_MASK 0x1 /end MEASUREMENT
/begin MEASUREMENT t_gs_inh_mon "Timer for inhibition of GS torque demand in monitoring level" UBYTE _CNV_A_R_LINEAR_____279_CM 1 100. 0. 10.2 DISPLAY_IDENTIFIER T_GS_INH_MON ECU_ADDRESS 0xc000151b FORMAT "%5.2" /end MEASUREMENT
/begin MEASUREMENT tqi_gs_mon "Torque demand for Gear Shift" UBYTE _CNV_A_R_LINEAR_____280_CM 1 100. 0. 510. DISPLAY_IDENTIFIER TQI_GS_MON ECU_ADDRESS 0xd0002d59 FORMAT "%3.0" /end MEASUREMENT
/begin MEASUREMENT abc_msr_mon "Value of the MSR anti - bounce counter" UBYTE _CNV_A_R_LINEAR_____0_CM 1 100. 0. 255. DISPLAY_IDENTIFIER ABC_MSR_MON ECU_ADDRESS 0xc00014da FORMAT "%3.0" /end MEASUREMENT
/begin CHARACTERISTIC c_abc_inc_gs_mon "Anti bounce counter increment" VALUE 0xa1000fd3 _REC_VAL_20_u1 255. _CNV_A_R_LINEAR_____0_CM 0. 255. DISPLAY_IDENTIFIER C_ABC_INC_GS_MON FORMAT "%3.0" /end CHARACTERISTIC
/begin CHARACTERISTIC c_abc_max_msr_mon "Maximum value of anti-bounce counter" VALUE 0xa1000ff5 _REC_VAL_20_u1 254. _CNV_A_R_LINEAR_____0_CM 1. 255. DISPLAY_IDENTIFIER C_ABC_MAX_MSR_MON FORMAT "%3.0" /end CHARACTERISTIC
/begin CHARACTERISTIC c_t_msr_inh_mon "Delay time for disable of MSR torque demand in monitoring level" VALUE 0xa100104e _REC_VAL_20_u1 10.2 _CNV_A_R_LINEAR_____279_CM 0. 10.2 DISPLAY_IDENTIFIER C_T_MSR_INH_MON FORMAT "%5.2" /end CHARACTERISTIC
/begin CHARACTERISTIC c_t_can_vb_vld_mon "Delay time for disable of MSR torque demand in monitoring level" VALUE 0xa100103e _REC_VAL_20_u1 10.2 _CNV_A_R_LINEAR_____279_CM 0. 10.2 DISPLAY_IDENTIFIER C_T_CAN_VB_VLD_MON FORMAT "%5.2" /end CHARACTERISTIC
/begin CHARACTERISTIC c_tqi_gs_max_mon "Maximum allowed indicated engine torque for Gear intervention" VALUE 0xa1001082 _REC_VAL_20_u1 510. _CNV_A_R_LINEAR_____280_CM 0. 510. DISPLAY_IDENTIFIER C_TQI_GS_MAX_MON FORMAT "%3.0" /end CHARACTERISTIC
/begin CHARACTERISTIC c_thd_max_gs_miss_mon "Max.allowed number for no incoming of CAN - msg" VALUE 0xa100105a _REC_VAL_20_u1 255. _CNV_A_R_LINEAR_____0_CM 0. 255. DISPLAY_IDENTIFIER C_THD_MAX_GS_MISS_MON FORMAT "%3.0" /end CHARACTERISTIC
/begin CHARACTERISTIC c_thd_max_tcs1_miss_mon "Max.allowed number for no incoming of CAN - msg" VALUE 0xa100105b _REC_VAL_20_u1 255. _CNV_A_R_LINEAR_____0_CM 0. 255. DISPLAY_IDENTIFIER C_THD_MAX_TCS1_MISS_MON FORMAT "%3.0" /end CHARACTERISTIC
/begin MEASUREMENT abc_gs_mon "Value of the Gear Shift anti - bounce counter" UBYTE _CNV_A_R_LINEAR_____0_CM 1 100. 0. 255. DISPLAY_IDENTIFIER ABC_GS_MON ECU_ADDRESS 0xc00014d5 FORMAT "%3.0" /end MEASUREMENT
/begin MEASUREMENT abc_msr_inh_mon "Value of the Gear Shift anti - bounce counter" UBYTE _CNV_A_R_LINEAR_____0_CM 1 100. 0. 255. DISPLAY_IDENTIFIER ABC_MSR_INH_MON ECU_ADDRESS 0xc00014d9 FORMAT "%3.0" /end MEASUREMENT
/begin MEASUREMENT abc_ldm_inh_mon "Value of the Gear Shift anti - bounce counter" UBYTE _CNV_A_R_LINEAR_____0_CM 1 100. 0. 255. DISPLAY_IDENTIFIER ABC_LDM_INH_MON ECU_ADDRESS 0xc00014d6 FORMAT "%3.0" /end MEASUREMENT
/begin MEASUREMENT abc_dcc_inh_mon "Value of the Gear Shift anti - bounce counter" UBYTE _CNV_A_R_LINEAR_____0_CM 1 100. 0. 255. DISPLAY_IDENTIFIER ABC_DCC_INH_MON ECU_ADDRESS 0xc00014d3 FORMAT "%3.0" /end MEASUREMENT
/begin MEASUREMENT abc_gs_inh_mon "Value of the Gear Shift anti - bounce counter" UBYTE _CNV_A_R_LINEAR_____0_CM 1 100. 0. 255. DISPLAY_IDENTIFIER ABC_GS_INH_MON ECU_ADDRESS 0xc00014d4 FORMAT "%3.0" /end MEASUREMENT
/begin MEASUREMENT t_ldm_inh_mon "Timer for inhibition of MSR torque demand in monitoring level" UBYTE _CNV_A_R_LINEAR_____279_CM 1 100. 0. 10.2 DISPLAY_IDENTIFIER T_LDM_INH_MON ECU_ADDRESS 0xc000151d FORMAT "%5.2" /end MEASUREMENT
/begin MEASUREMENT t_ldm_brake_det_mon "Timer for inhibition of MSR torque demand in monitoring level" UBYTE _CNV_A_R_LINEAR_____279_CM 1 100. 0. 10.2 DISPLAY_IDENTIFIER T_LDM_BRAKE_DET_MON ECU_ADDRESS 0xc000151c FORMAT "%5.2" /end MEASUREMENT
/begin MEASUREMENT t_dcc_inh_mon "Timer for inhibition of MSR torque demand in monitoring level" UBYTE _CNV_A_R_LINEAR_____279_CM 1 100. 0. 10.2 DISPLAY_IDENTIFIER T_DCC_INH_MON ECU_ADDRESS 0xc0001519 FORMAT "%5.2" /end MEASUREMENT
/begin MEASUREMENT t_dcc_brake_det_mon "Timer for inhibition of MSR torque demand in monitoring level" UBYTE _CNV_A_R_LINEAR_____279_CM 1 100. 0. 10.2 DISPLAY_IDENTIFIER T_DCC_BRAKE_DET_MON ECU_ADDRESS 0xc0001518 FORMAT "%5.2" /end MEASUREMENT
/begin MEASUREMENT t_state_amt_2_diag_mon "Timer for inhibition of MSR torque demand in monitoring level" UBYTE _CNV_A_R_LINEAR_____279_CM 1 100. 0. 10.2 DISPLAY_IDENTIFIER T_STATE_AMT_2_DIAG_MON ECU_ADDRESS 0xc0001520 FORMAT "%5.2" /end MEASUREMENT
/begin MEASUREMENT t_state_amt_3_diag_mon "Timer for inhibition of MSR torque demand in monitoring level" UBYTE _CNV_A_R_LINEAR_____279_CM 1 100. 0. 10.2 DISPLAY_IDENTIFIER T_STATE_AMT_3_DIAG_MON ECU_ADDRESS 0xc0001521 FORMAT "%5.2" /end MEASUREMENT
/begin MEASUREMENT t_state_clu_amt_diag_mon "Timer for inhibition of MSR torque demand in monitoring level" UBYTE _CNV_A_R_LINEAR_____279_CM 1 100. 0. 10.2 DISPLAY_IDENTIFIER T_STATE_CLU_AMT_DIAG_MON ECU_ADDRESS 0xc0001522 FORMAT "%5.2" /end MEASUREMENT
/begin MEASUREMENT tqi_amt_plaus_mon "Timer for inhibition of MSR torque demand in monitoring level" UBYTE _CNV_A_R_LINEAR_____279_CM 1 100. 0. 10.2 DISPLAY_IDENTIFIER TQI_AMT_PLAUS_MON ECU_ADDRESS 0xc000152a FORMAT "%5.2" /end MEASUREMENT
/begin MEASUREMENT tqi_msr_mon "Torque demand from drag control" UBYTE _CNV_A_R_LINEAR_____280_CM 1 100. 0. 510. DISPLAY_IDENTIFIER TQI_MSR_MON ECU_ADDRESS 0xd0002d5a FORMAT "%3.0" /end MEASUREMENT
/begin MEASUREMENT tqi_amt_mon "Torque demand from drag control" UBYTE _CNV_A_R_LINEAR_____280_CM 1 100. 0. 510. DISPLAY_IDENTIFIER TQI_AMT_MON ECU_ADDRESS 0xd0002d57 FORMAT "%3.0" /end MEASUREMENT
/begin MEASUREMENT t_msr_inh_mon "Timer for inhibition of MSR torque demand in monitoring level" UBYTE _CNV_A_R_LINEAR_____279_CM 1 100. 0. 10.2 DISPLAY_IDENTIFIER T_MSR_INH_MON ECU_ADDRESS 0xc000151e FORMAT "%5.2" /end MEASUREMENT
/begin MEASUREMENT t_amt_inh_mon "Timer for inhibition of MSR torque demand in monitoring level" UBYTE _CNV_A_R_LINEAR_____279_CM 1 100. 0. 10.2 DISPLAY_IDENTIFIER T_AMT_INH_MON ECU_ADDRESS 0xc0001516 FORMAT "%5.2" /end MEASUREMENT
/begin MEASUREMENT lv_err_msr_inh_mon "Fault in MSR present" UBYTE _CNV_S_2_RANGE__0___1_CM 1 100. 0. 1. DISPLAY_IDENTIFIER LV_ERR_MSR_INH_MON ECU_ADDRESS 0xd0002d6d BIT_MASK 0x1 /end MEASUREMENT
/begin MEASUREMENT lv_err_ldm_inh_mon "Fault in MSR present" UBYTE _CNV_S_2_RANGE__0___1_CM 1 100. 0. 1. DISPLAY_IDENTIFIER LV_ERR_LDM_INH_MON ECU_ADDRESS 0xd0002d69 BIT_MASK 0x1 /end MEASUREMENT
/begin MEASUREMENT lv_err_ldm_mon "Fault in MSR present" UBYTE _CNV_S_2_RANGE__0___1_CM 1 100. 0. 1. DISPLAY_IDENTIFIER LV_ERR_LDM_MON ECU_ADDRESS 0xd0002d6a BIT_MASK 0x1 /end MEASUREMENT
/begin MEASUREMENT lv_ldm_off_ecu_mon "Fault in MSR present" UBYTE _CNV_S_2_RANGE__0___1_CM 1 100. 0. 1. DISPLAY_IDENTIFIER LV_LDM_OFF_ECU_MON ECU_ADDRESS 0xd0002d8a BIT_MASK 0x1 /end MEASUREMENT
/begin MEASUREMENT lv_ldm_off_ecu_1_mon "Fault in MSR present" UBYTE _CNV_S_2_RANGE__0___1_CM 1 100. 0. 1. DISPLAY_IDENTIFIER LV_LDM_OFF_ECU_1_MON ECU_ADDRESS 0xd0002d88 BIT_MASK 0x1 /end MEASUREMENT
/begin MEASUREMENT lv_ldm_off_ecu_2_mon "Fault in MSR present" UBYTE _CNV_S_2_RANGE__0___1_CM 1 100. 0. 1. DISPLAY_IDENTIFIER LV_LDM_OFF_ECU_2_MON ECU_ADDRESS 0xd0002d89 BIT_MASK 0x1 /end MEASUREMENT
/begin MEASUREMENT lv_err_dcc_inh_mon "Fault in MSR present" UBYTE _CNV_S_2_RANGE__0___1_CM 1 100. 0. 1. DISPLAY_IDENTIFIER LV_ERR_DCC_INH_MON ECU_ADDRESS 0xd0002d65 BIT_MASK 0x1 /end MEASUREMENT
/begin MEASUREMENT lv_err_dcc_rev_mon "Fault in MSR present" UBYTE _CNV_S_2_RANGE__0___1_CM 1 100. 0. 1. DISPLAY_IDENTIFIER LV_ERR_DCC_REV_MON ECU_ADDRESS 0xd0002d67 BIT_MASK 0x1 /end MEASUREMENT
/begin MEASUREMENT lv_err_dcc_irrev_mon "Fault in MSR present" UBYTE _CNV_S_2_RANGE__0___1_CM 1 100. 0. 1. DISPLAY_IDENTIFIER LV_ERR_DCC_IRREV_MON ECU_ADDRESS 0xd0002d66 BIT_MASK 0x1 /end MEASUREMENT
/begin MEASUREMENT lv_dcc_off_ecu_mon "Fault in MSR present" UBYTE _CNV_S_2_RANGE__0___1_CM 1 100. 0. 1. DISPLAY_IDENTIFIER LV_DCC_OFF_ECU_MON ECU_ADDRESS 0xd0002d5e BIT_MASK 0x1 /end MEASUREMENT
/begin MEASUREMENT lv_err_amt_inh_mon "Fault in MSR present" UBYTE _CNV_S_2_RANGE__0___1_CM 1 100. 0. 1. DISPLAY_IDENTIFIER LV_ERR_AMT_INH_MON ECU_ADDRESS 0xd0002d5f BIT_MASK 0x1 /end MEASUREMENT
/begin MEASUREMENT lv_err_gs_inh_mon "Fault in MSR present" UBYTE _CNV_S_2_RANGE__0___1_CM 1 100. 0. 1. DISPLAY_IDENTIFIER LV_ERR_GS_INH_MON ECU_ADDRESS 0xd0002d68 BIT_MASK 0x1 /end MEASUREMENT
/begin MEASUREMENT tq_msr_mon "Fault in MSR present" SWORD _CNV_A_R_LINEAR_____30_CM 1 100. -1024. 1023.96875 DISPLAY_IDENTIFIER TQ_MSR_MON ECU_ADDRESS 0xd000251e FORMAT "%8.2" BIT_MASK 0x1 /end MEASUREMENT
/begin MEASUREMENT tq_dcc_mon "Fault in MSR present" SWORD _CNV_A_R_LINEAR_____30_CM 1 100. -1024. 1023.96875 DISPLAY_IDENTIFIER TQ_DCC_MON ECU_ADDRESS 0xd0002508 FORMAT "%8.2" BIT_MASK 0x1 /end MEASUREMENT
/begin MEASUREMENT tq_amt_mon "Fault in MSR present" SWORD _CNV_A_R_LINEAR_____30_CM 1 100. -1024. 1023.96875 DISPLAY_IDENTIFIER TQ_AMT_MON ECU_ADDRESS 0xd0002506 FORMAT "%8.2" BIT_MASK 0x1 /end MEASUREMENT
/begin MEASUREMENT tq_gs_mon "Fault in MSR present" SWORD _CNV_A_R_LINEAR_____30_CM 1 100. -1024. 1023.96875 DISPLAY_IDENTIFIER TQ_GS_MON ECU_ADDRESS 0xd0002512 FORMAT "%8.2" BIT_MASK 0x1 /end MEASUREMENT
/begin MEASUREMENT tq_wheel_ldm_mon "Fault in MSR present" SWORD _CNV_A_R_LINEAR_____60_CM 1 100. -32768. 32767. DISPLAY_IDENTIFIER TQ_WHEEL_LDM_MON ECU_ADDRESS 0xd0002520 FORMAT "%6.0" BIT_MASK 0x1 /end MEASUREMENT
/begin CHARACTERISTIC c_abc_inc_msr_mon "Anti bounce counter increment" VALUE 0xa1000fd9 _REC_VAL_20_u1 255. _CNV_A_R_LINEAR_____0_CM 0. 255. DISPLAY_IDENTIFIER C_ABC_INC_MSR_MON FORMAT "%3.0" /end CHARACTERISTIC
/begin CHARACTERISTIC c_abc_inc_dcc_rev_mon "Anti bounce counter increment" VALUE 0xa1000fd1 _REC_VAL_20_u1 255. _CNV_A_R_LINEAR_____0_CM 0. 255. DISPLAY_IDENTIFIER C_ABC_INC_DCC_REV_MON FORMAT "%3.0" /end CHARACTERISTIC
/begin CHARACTERISTIC c_abc_inc_dcc_irrev_mon "Anti bounce counter increment" VALUE 0xa1000fd0 _REC_VAL_20_u1 255. _CNV_A_R_LINEAR_____0_CM 0. 255. DISPLAY_IDENTIFIER C_ABC_INC_DCC_IRREV_MON FORMAT "%3.0" /end CHARACTERISTIC
/begin CHARACTERISTIC c_abc_inc_ldm_inh_mon "Anti bounce counter increment" VALUE 0xa1000fd4 _REC_VAL_20_u1 255. _CNV_A_R_LINEAR_____0_CM 0. 255. DISPLAY_IDENTIFIER C_ABC_INC_LDM_INH_MON FORMAT "%3.0" /end CHARACTERISTIC
/begin CHARACTERISTIC c_abc_inc_ldm_mon "Anti bounce counter increment" VALUE 0xa1000fd5 _REC_VAL_20_u1 255. _CNV_A_R_LINEAR_____0_CM 0. 255. DISPLAY_IDENTIFIER C_ABC_INC_LDM_MON FORMAT "%3.0" /end CHARACTERISTIC
/begin CHARACTERISTIC c_abc_inc_gs_inh_mon "Anti bounce counter increment" VALUE 0xa1000fd2 _REC_VAL_20_u1 255. _CNV_A_R_LINEAR_____0_CM 0. 255. DISPLAY_IDENTIFIER C_ABC_INC_GS_INH_MON FORMAT "%3.0" /end CHARACTERISTIC
/begin CHARACTERISTIC c_abc_max_gs_mon "Maximum value of anti-bounce counter" VALUE 0xa1000fef _REC_VAL_20_u1 254. _CNV_A_R_LINEAR_____0_CM 1. 255. DISPLAY_IDENTIFIER C_ABC_MAX_GS_MON FORMAT "%3.0" /end CHARACTERISTIC
/begin CHARACTERISTIC c_abc_max_gs_inh_mon "Maximum value of anti-bounce counter" VALUE 0xa1000fee _REC_VAL_20_u1 254. _CNV_A_R_LINEAR_____0_CM 1. 255. DISPLAY_IDENTIFIER C_ABC_MAX_GS_INH_MON FORMAT "%3.0" /end CHARACTERISTIC
/begin CHARACTERISTIC c_abc_max_amt_inh_mon "Maximum value of anti-bounce counter" VALUE 0xa1000fe8 _REC_VAL_20_u1 254. _CNV_A_R_LINEAR_____0_CM 1. 255. DISPLAY_IDENTIFIER C_ABC_MAX_AMT_INH_MON FORMAT "%3.0" /end CHARACTERISTIC
/begin CHARACTERISTIC c_abc_max_ldm_mon "Maximum value of anti-bounce counter" VALUE 0xa1000ff1 _REC_VAL_20_u1 254. _CNV_A_R_LINEAR_____0_CM 1. 255. DISPLAY_IDENTIFIER C_ABC_MAX_LDM_MON FORMAT "%3.0" /end CHARACTERISTIC
/begin CHARACTERISTIC c_abc_max_ldm_inh_mon "Maximum value of anti-bounce counter" VALUE 0xa1000ff0 _REC_VAL_20_u1 254. _CNV_A_R_LINEAR_____0_CM 1. 255. DISPLAY_IDENTIFIER C_ABC_MAX_LDM_INH_MON FORMAT "%3.0" /end CHARACTERISTIC
/begin CHARACTERISTIC c_abc_max_dcc_rev_mon "Maximum value of anti-bounce counter" VALUE 0xa1000fed _REC_VAL_20_u1 254. _CNV_A_R_LINEAR_____0_CM 1. 255. DISPLAY_IDENTIFIER C_ABC_MAX_DCC_REV_MON FORMAT "%3.0" /end CHARACTERISTIC
/begin CHARACTERISTIC c_abc_max_dcc_irrev_mon "Maximum value of anti-bounce counter" VALUE 0xa1000fec _REC_VAL_20_u1 254. _CNV_A_R_LINEAR_____0_CM 1. 255. DISPLAY_IDENTIFIER C_ABC_MAX_DCC_IRREV_MON FORMAT "%3.0" /end CHARACTERISTIC
/begin CHARACTERISTIC c_abc_max_dcc_inh_mon "Maximum value of anti-bounce counter" VALUE 0xa1000feb _REC_VAL_20_u1 254. _CNV_A_R_LINEAR_____0_CM 1. 255. DISPLAY_IDENTIFIER C_ABC_MAX_DCC_INH_MON FORMAT "%3.0" /end CHARACTERISTIC
/begin CHARACTERISTIC c_abc_max_msr_inh_mon "Maximum value of anti-bounce counter" VALUE 0xa1000ff4 _REC_VAL_20_u1 254. _CNV_A_R_LINEAR_____0_CM 1. 255. DISPLAY_IDENTIFIER C_ABC_MAX_MSR_INH_MON FORMAT "%3.0" /end CHARACTERISTIC
/begin CHARACTERISTIC c_abc_inc_msr_inh_mon "Anti bounce counter increment" VALUE 0xa1000fd8 _REC_VAL_20_u1 255. _CNV_A_R_LINEAR_____0_CM 0. 255. DISPLAY_IDENTIFIER C_ABC_INC_MSR_INH_MON FORMAT "%3.0" /end CHARACTERISTIC
/begin CHARACTERISTIC c_abc_inc_dcc_inh_mon "Anti bounce counter increment" VALUE 0xa1000fcf _REC_VAL_20_u1 255. _CNV_A_R_LINEAR_____0_CM 0. 255. DISPLAY_IDENTIFIER C_ABC_INC_DCC_INH_MON FORMAT "%3.0" /end CHARACTERISTIC
/begin CHARACTERISTIC c_t_gs_inh_mon "Delay time for disable of GS torque demand in monitoring level" VALUE 0xa1001045 _REC_VAL_20_u1 10.2 _CNV_A_R_LINEAR_____279_CM 0. 10.2 DISPLAY_IDENTIFIER C_T_GS_INH_MON FORMAT "%5.2" /end CHARACTERISTIC
/begin CHARACTERISTIC c_t_dcc_inh_mon "Delay time for disable of GS torque demand in monitoring level" VALUE 0xa1001040 _REC_VAL_20_u1 10.2 _CNV_A_R_LINEAR_____279_CM 0. 10.2 DISPLAY_IDENTIFIER C_T_DCC_INH_MON FORMAT "%5.2" /end CHARACTERISTIC
/begin CHARACTERISTIC c_t_max_brake_det_dcc_mon "Delay time for disable of GS torque demand in monitoring level" VALUE 0xa1001047 _REC_VAL_20_u1 10.2 _CNV_A_R_LINEAR_____279_CM 0. 10.2 DISPLAY_IDENTIFIER C_T_MAX_BRAKE_DET_DCC_MON FORMAT "%5.2" /end CHARACTERISTIC
/begin CHARACTERISTIC c_t_ldm_inh_mon "Delay time for disable of GS torque demand in monitoring level" VALUE 0xa1001046 _REC_VAL_20_u1 10.2 _CNV_A_R_LINEAR_____279_CM 0. 10.2 DISPLAY_IDENTIFIER C_T_LDM_INH_MON FORMAT "%5.2" /end CHARACTERISTIC
/begin CHARACTERISTIC c_t_max_brake_det_ldm_mon "Delay time for disable of GS torque demand in monitoring level" VALUE 0xa1001048 _REC_VAL_20_u1 10.2 _CNV_A_R_LINEAR_____279_CM 0. 10.2 DISPLAY_IDENTIFIER C_T_MAX_BRAKE_DET_LDM_MON FORMAT "%5.2" /end CHARACTERISTIC
/begin CHARACTERISTIC c_t_amt_inh_mon "Delay time for disable of GS torque demand in monitoring level" VALUE 0xa100103d _REC_VAL_20_u1 10.2 _CNV_A_R_LINEAR_____279_CM 0. 10.2 DISPLAY_IDENTIFIER C_T_AMT_INH_MON FORMAT "%5.2" /end CHARACTERISTIC
/begin CHARACTERISTIC c_t_dly_amt_inh_mon "Delay time for disable of GS torque demand in monitoring level" VALUE 0xa1001041 _REC_VAL_20_u1 10.2 _CNV_A_R_LINEAR_____279_CM 0. 10.2 DISPLAY_IDENTIFIER C_T_DLY_AMT_INH_MON FORMAT "%5.2" /end CHARACTERISTIC
/begin CHARACTERISTIC c_t_max_state_amt_1_diag_mon "Delay time for disable of GS torque demand in monitoring level" VALUE 0xa1001049 _REC_VAL_20_u1 10.2 _CNV_A_R_LINEAR_____279_CM 0. 10.2 DISPLAY_IDENTIFIER C_T_MAX_STATE_AMT_1_DIAG_MON FORMAT "%5.2" /end CHARACTERISTIC
/begin CHARACTERISTIC c_t_max_state_amt_2_diag_mon "Delay time for disable of GS torque demand in monitoring level" VALUE 0xa100104a _REC_VAL_20_u1 10.2 _CNV_A_R_LINEAR_____279_CM 0. 10.2 DISPLAY_IDENTIFIER C_T_MAX_STATE_AMT_2_DIAG_MON FORMAT "%5.2" /end CHARACTERISTIC
/begin CHARACTERISTIC c_t_max_state_amt_3_diag_mon "Delay time for disable of GS torque demand in monitoring level" VALUE 0xa100104b _REC_VAL_20_u1 10.2 _CNV_A_R_LINEAR_____279_CM 0. 10.2 DISPLAY_IDENTIFIER C_T_MAX_STATE_AMT_3_DIAG_MON FORMAT "%5.2" /end CHARACTERISTIC
/begin CHARACTERISTIC c_t_max_tqi_amt_diag_mon "Delay time for disable of GS torque demand in monitoring level" VALUE 0xa100104d _REC_VAL_20_u1 10.2 _CNV_A_R_LINEAR_____279_CM 0. 10.2 DISPLAY_IDENTIFIER C_T_MAX_TQI_AMT_DIAG_MON FORMAT "%5.2" /end CHARACTERISTIC
/begin CHARACTERISTIC c_t_max_state_clu_amt_diag_mon "Delay time for disable of GS torque demand in monitoring level" VALUE 0xa100104c _REC_VAL_20_u1 10.2 _CNV_A_R_LINEAR_____279_CM 0. 10.2 DISPLAY_IDENTIFIER C_T_MAX_STATE_CLU_AMT_DIAG_MON FORMAT "%5.2" /end CHARACTERISTIC
/begin CHARACTERISTIC c_t_dly_gs_inh_mon "Delay time for disable of GS torque demand in monitoring level" VALUE 0xa1001042 _REC_VAL_20_u1 10.2 _CNV_A_R_LINEAR_____279_CM 0. 10.2 DISPLAY_IDENTIFIER C_T_DLY_GS_INH_MON FORMAT "%5.2" /end CHARACTERISTIC
/begin CHARACTERISTIC c_tqi_stnd_mon "Maximum indicated engine torque (scaling factor for torque demands from CAN)" VALUE 0xa1001083 _REC_VAL_20_u1 510. _CNV_A_R_LINEAR_____280_CM 0. 510. DISPLAY_IDENTIFIER C_TQI_STND_MON FORMAT "%3.0" /end CHARACTERISTIC
/begin CHARACTERISTIC c_tqi_amt_diag_mon "Maximum indicated engine torque (scaling factor for torque demands from CAN)" VALUE 0xa1001081 _REC_VAL_20_u1 510. _CNV_A_R_LINEAR_____280_CM 0. 510. DISPLAY_IDENTIFIER C_TQI_AMT_DIAG_MON FORMAT "%3.0" /end CHARACTERISTIC
/begin CHARACTERISTIC c_tqi_amt_cond_diag_mon "Maximum indicated engine torque (scaling factor for torque demands from CAN)" VALUE 0xa1001080 _REC_VAL_20_u1 510. _CNV_A_R_LINEAR_____280_CM 0. 510. DISPLAY_IDENTIFIER C_TQI_AMT_COND_DIAG_MON FORMAT "%3.0" /end CHARACTERISTIC
/begin CHARACTERISTIC c_tqi_amt_can_es_mon "Maximum indicated engine torque (scaling factor for torque demands from CAN)" VALUE 0xa100107f _REC_VAL_20_u1 510. _CNV_A_R_LINEAR_____280_CM 0. 510. DISPLAY_IDENTIFIER C_TQI_AMT_CAN_ES_MON FORMAT "%3.0" /end CHARACTERISTIC
/begin MEASUREMENT t_state_amt_1_diag_mon "Timer for inhibition of MSR torque demand in monitoring level" UBYTE _CNV_A_R_LINEAR_____279_CM 1 100. 0. 10.2 DISPLAY_IDENTIFIER T_STATE_AMT_1_DIAG_MON ECU_ADDRESS 0xc000151f FORMAT "%5.2" /end MEASUREMENT
/begin MEASUREMENT t_tqi_amt_diag_mon "Timer for inhibition of MSR torque demand in monitoring level" UBYTE _CNV_A_R_LINEAR_____279_CM 1 100. 0. 10.2 DISPLAY_IDENTIFIER T_TQI_AMT_DIAG_MON ECU_ADDRESS 0xc0001524 FORMAT "%5.2" /end MEASUREMENT
/begin MEASUREMENT abc_amt_inh_mon "Value of the Gear Shift anti - bounce counter" UBYTE _CNV_A_R_LINEAR_____0_CM 1 100. 0. 255. DISPLAY_IDENTIFIER ABC_AMT_INH_MON ECU_ADDRESS 0xc00014d0 FORMAT "%3.0" /end MEASUREMENT
/begin MEASUREMENT state_err_amt_mon "Value of the Gear Shift anti - bounce counter" UBYTE _CNV_A_R_LINEAR_____0_CM 1 100. 0. 255. DISPLAY_IDENTIFIER STATE_ERR_AMT_MON ECU_ADDRESS 0xc0001514 FORMAT "%3.0" /end MEASUREMENT
/begin MEASUREMENT state_amt_old_mon "Value of the Gear Shift anti - bounce counter" UBYTE _CNV_A_R_LINEAR_____0_CM 1 100. 0. 255. DISPLAY_IDENTIFIER STATE_AMT_OLD_MON ECU_ADDRESS 0xc0001513 FORMAT "%3.0" /end MEASUREMENT
/begin CHARACTERISTIC c_abc_inc_amt_inh_mon "Anti bounce counter increment" VALUE 0xa1000fcc _REC_VAL_20_u1 255. _CNV_A_R_LINEAR_____0_CM 0. 255. DISPLAY_IDENTIFIER C_ABC_INC_AMT_INH_MON FORMAT "%3.0" /end CHARACTERISTIC
/begin CHARACTERISTIC c_vs_fil_amt_mon "Timer for inhibition of MSR torque demand in monitoring level" VALUE 0xa100109c _REC_VAL_20_u2 511.99218 _CNV_A_R_LINEAR_____66_CM 0. 511.99218 DISPLAY_IDENTIFIER C_VS_FIL_AMT_MON FORMAT "%7.3" /end CHARACTERISTIC
/begin MEASUREMENT t_tqi_mon2 "Dead time for delay of desired indicated engine torque" UBYTE _CNV_A_R_LINEAR_____279_CM 1 100. 0. 10.2 DISPLAY_IDENTIFIER T_TQI_MON2 ECU_ADDRESS 0xc0001526 FORMAT "%5.2" /end MEASUREMENT
/begin CHARACTERISTIC c_t_tqi_mon2 "Dead time for torque decrease" VALUE 0xa100189b _REC_VAL_20_u1 10.2 _CNV_A_R_LINEAR_____279_CM 0. 10.2 DISPLAY_IDENTIFIER C_T_TQI_MON2 FORMAT "%5.2" /end CHARACTERISTIC
/begin CHARACTERISTIC c_gain_tqi_dif_max_mon2 "Factor for threshold diagnosis with TQI_SP" VALUE 0xa1001899 _REC_VAL_20_u1 63.75 _CNV_A_R_EGCP_LINEA_349_CM 0. 63.75 DISPLAY_IDENTIFIER C_GAIN_TQI_DIF_MAX_MON2 FORMAT "%4.1" /end CHARACTERISTIC
/begin MEASUREMENT fac_tq_req_cru_mon2 "Torque demand from cruise control" UBYTE _CNV_A_R_LINEAR_____100_CM 1 100. 0. 1.9921875 DISPLAY_IDENTIFIER FAC_TQ_REQ_CRU_MON2 ECU_ADDRESS 0xc00014f5 FORMAT "%8.6" /end MEASUREMENT
/begin MEASUREMENT sum_inh_inj_mon2 "SUM of inhibit injection (all cylinders)" UBYTE _CNV_A_R_LINEAR_____0_CM 1 100. 0. 255. DISPLAY_IDENTIFIER SUM_INH_INJ_MON2 ECU_ADDRESS 0xc0001515 FORMAT "%3.0" /end MEASUREMENT
/begin MEASUREMENT lv_err_conv_mon2 "Fault in A/D-conversion present" UBYTE _CNV_S_2_RANGE__0___1_CM 1 100. 0. 1. DISPLAY_IDENTIFIER LV_ERR_CONV_MON2 ECU_ADDRESS 0xc000153e BIT_MASK 0x1 /end MEASUREMENT
/begin MEASUREMENT lv_err_maf_mon2 "Fault in mass air flow signal" UBYTE _CNV_S_2_RANGE__0___1_CM 1 100. 0. 1. DISPLAY_IDENTIFIER LV_ERR_MAF_MON2 ECU_ADDRESS 0xc000153f BIT_MASK 0x1 /end MEASUREMENT
/begin MEASUREMENT lv_err_n_32_mon2 "Fault in engine speed present" UBYTE _CNV_S_2_RANGE__0___1_CM 1 100. 0. 1. DISPLAY_IDENTIFIER LV_ERR_N_32_MON2 ECU_ADDRESS 0xc0001541 BIT_MASK 0x1 /end MEASUREMENT
/begin MEASUREMENT lv_err_pvs_mon2 "Fault in pedal value signal present" UBYTE _CNV_S_2_RANGE__0___1_CM 1 100. 0. 1. DISPLAY_IDENTIFIER LV_ERR_PVS_MON2 ECU_ADDRESS 0xc0001543 BIT_MASK 0x1 /end MEASUREMENT
/begin MEASUREMENT lv_err_tps_mon2 "Fault in TPS present" UBYTE _CNV_S_2_RANGE__0___1_CM 1 100. 0. 1. DISPLAY_IDENTIFIER LV_ERR_TPS_MON2 ECU_ADDRESS 0xc0001545 BIT_MASK 0x1 /end MEASUREMENT
/begin MEASUREMENT lv_err_tq_dif_p_d_is_mon2 "Fault currently present in torque generation, symptom 'idle speed controller - PD-part'" UBYTE _CNV_S_2_RANGE__0___1_CM 1 100. 0. 1. DISPLAY_IDENTIFIER LV_ERR_TQ_DIF_P_D_IS_MON2 ECU_ADDRESS 0xc0001547 BIT_MASK 0x1 /end MEASUREMENT
/begin MEASUREMENT lv_err_tq_dif_i_is_mon2 "Fault currently present in torque generation, symptom 'idle speed controller - I-part'" UBYTE _CNV_S_2_RANGE__0___1_CM 1 100. 0. 1. DISPLAY_IDENTIFIER LV_ERR_TQ_DIF_I_IS_MON2 ECU_ADDRESS 0xc0001546 BIT_MASK 0x1 /end MEASUREMENT
/begin MEASUREMENT lv_err_tq_loss_mon2 "Fault in torque losses present" UBYTE _CNV_S_2_RANGE__0___1_CM 1 100. 0. 1. DISPLAY_IDENTIFIER LV_ERR_TQ_LOSS_MON2 ECU_ADDRESS 0xc0001548 BIT_MASK 0x1 /end MEASUREMENT
/begin MEASUREMENT lv_err_tq_min_clu_mon2 "Fault currently present in torque generation, symptom 'minimum torque at clutch'" UBYTE _CNV_S_2_RANGE__0___1_CM 1 100. 0. 1. DISPLAY_IDENTIFIER LV_ERR_TQ_MIN_CLU_MON2 ECU_ADDRESS 0xc000154a BIT_MASK 0x1 /end MEASUREMENT
/begin MEASUREMENT lv_err_tq_max_clu_mon2 "Fault currently present in torque generation, symptom 'maximum torque at clutch'" UBYTE _CNV_S_2_RANGE__0___1_CM 1 100. 0. 1. DISPLAY_IDENTIFIER LV_ERR_TQ_MAX_CLU_MON2 ECU_ADDRESS 0xc0001549 BIT_MASK 0x1 /end MEASUREMENT
/begin MEASUREMENT lv_n_lim_etc_mon2 "Engine speed limitation request" UBYTE _CNV_S_2_RANGE__0___1_CM 1 100. 0. 1. DISPLAY_IDENTIFIER LV_N_LIM_ETC_MON2 ECU_ADDRESS 0xc0001551 BIT_MASK 0x1 /end MEASUREMENT
/begin MEASUREMENT lv_tqi_mon_act_mon2 "Logical variable for torque monitoring active" UBYTE _CNV_S_2_RANGE__0___1_CM 1 100. 0. 1. DISPLAY_IDENTIFIER LV_TQI_MON_ACT_MON2 ECU_ADDRESS 0xc000155b BIT_MASK 0x1 /end MEASUREMENT
/begin MEASUREMENT maf_mon2 "Mass air flow signal used monitoring level" UBYTE _CNV_A_R_LINEAR_____14_CM 1 100. 0. 1389. DISPLAY_IDENTIFIER MAF_MON2 ECU_ADDRESS 0xc0001508 FORMAT "%4.0" /end MEASUREMENT
/begin MEASUREMENT n_32_mon2 "Engine speed" UBYTE _CNV_A_R_LINEAR_____9_CM 1 100. 0. 8160. DISPLAY_IDENTIFIER N_32_MON2 ECU_ADDRESS 0xc0001509 FORMAT "%4.0" /end MEASUREMENT
/begin MEASUREMENT pv_av_ad_mon2 "Pedal value adaptation" UBYTE _CNV_A_R_LINEAR_____5_CM 1 100. 0. 99.609375 DISPLAY_IDENTIFIER PV_AV_AD_MON2 ECU_ADDRESS 0xc0001512 FORMAT "%9.6" /end MEASUREMENT
/begin MEASUREMENT tq_loss_mon2 "Torque losses" SWORD _CNV_A_R_LINEAR_____30_CM 1 100. -1024. 1023.96875 DISPLAY_IDENTIFIER TQ_LOSS_MON2 ECU_ADDRESS 0xc00014a8 FORMAT "%11.5" /end MEASUREMENT
/begin MEASUREMENT tq_max_clu_mon2 "Monitored maximum torque at clutch" SWORD _CNV_A_R_LINEAR_____30_CM 1 100. -1024. 1023.96875 DISPLAY_IDENTIFIER TQ_MAX_CLU_MON2 ECU_ADDRESS 0xc00014b6 FORMAT "%11.5" /end MEASUREMENT
/begin MEASUREMENT tq_dif_p_d_is_mon2 "P- and D- controller output for idle speed control" SWORD _CNV_A_R_LINEAR_____30_CM 1 100. -1024. 1023.96875 DISPLAY_IDENTIFIER TQ_DIF_P_D_IS_MON2 ECU_ADDRESS 0xc0001492 FORMAT "%11.5" /end MEASUREMENT
/begin MEASUREMENT tqi_inc_ext_mon2 "External torque request" SWORD _CNV_A_R_LINEAR_____30_CM 1 100. -1024. 1023.96875 DISPLAY_IDENTIFIER TQI_INC_EXT_MON2 ECU_ADDRESS 0xc00014c2 FORMAT "%11.5" /end MEASUREMENT
/begin MEASUREMENT tqi_sp_mon2 "Setpoint indicated engine torque(function level)" SWORD _CNV_A_R_LINEAR_____30_CM 1 100. -1024. 1023.96875 DISPLAY_IDENTIFIER TQI_SP_MON2 ECU_ADDRESS 0xc00014c6 FORMAT "%11.5" /end MEASUREMENT
/begin MEASUREMENT prev_state_iv_mon2 "State of injection valves at previous cycle" UBYTE _CNV_A_R_LINEAR_____0_CM 1 100. 0. 255. DISPLAY_IDENTIFIER PREV_STATE_IV_MON2 ECU_ADDRESS 0xc000150f FORMAT "%3.0" /end MEASUREMENT
/begin MEASUREMENT iga_ref_cor_ext_mon2 "Correction of  reference ignition angle (for external functions e.gVVT,EGR..)" UBYTE _CNV_A_R_LINEAR_____167_CM 1 100. -35.625 60. DISPLAY_IDENTIFIER IGA_REF_COR_EXT_MON2 ECU_ADDRESS 0xc0001502 FORMAT "%7.3" /end MEASUREMENT
/begin MEASUREMENT resp_mon2 "Answer of copy of process monitoring (Level 2')" UWORD _CNV_A_R_LINEAR_____0_CM 1 100. 0. 65535. DISPLAY_IDENTIFIER RESP_MON2 ECU_ADDRESS 0xd0002502 FORMAT "%5.0" /end MEASUREMENT
/begin MEASUREMENT fac_tq_req_mon2 "Scaling factor for requested torque at clutch from driver and cruise control" UBYTE _CNV_A_R_LINEAR_____100_CM 1 100. 0. 1.9921875 DISPLAY_IDENTIFIER FAC_TQ_REQ_MON2 ECU_ADDRESS 0xc00014f7 FORMAT "%8.6" /end MEASUREMENT
/begin MEASUREMENT fac_tq_req_driv_mon2 "Scaling factor for requested torque at clutch from driver" UBYTE _CNV_A_R_LINEAR_____100_CM 1 100. 0. 1.9921875 DISPLAY_IDENTIFIER FAC_TQ_REQ_DRIV_MON2 ECU_ADDRESS 0xc00014f6 FORMAT "%8.6" /end MEASUREMENT
/begin AXIS_PTS ldp_n_32_mon2_ip_fac_tq_mon2 "" 0xa10015fc n_32_mon2 _REC_AXS_20_u1 8160. _CNV_A_R_LINEAR_____9_CM 8 0. 8160. FORMAT "%4.0" /end AXIS_PTS
/begin AXIS_PTS ldp_pv_av_ad_mon2_ip_fac_mon2 "" 0xa1001620 pv_av_ad_mon2 _REC_AXS_20_u1 99.609375 _CNV_A_R_LINEAR_____5_CM 8 0. 99.609375 FORMAT "%9.6" /end AXIS_PTS
/begin MEASUREMENT tqi_req_tot_mon2 "Desired non-delayed indicated engine torque" UBYTE _CNV_A_R_LINEAR_____280_CM 1 100. 0. 510. DISPLAY_IDENTIFIER TQI_REQ_TOT_MON2 ECU_ADDRESS 0xc0001534 FORMAT "%3.0" /end MEASUREMENT
/begin MEASUREMENT tqi_sp_mon_mon2 "Desired indicated engine torque" UBYTE _CNV_A_R_LINEAR_____280_CM 1 100. 0. 510. DISPLAY_IDENTIFIER TQI_SP_MON_MON2 ECU_ADDRESS 0xc0001535 FORMAT "%3.0" /end MEASUREMENT
/begin MEASUREMENT eff_iga_mon2 "actual ignition efficiency for torque monitoring" UBYTE _CNV_A_R_LINEAR_____100_CM 1 100. 0. 1.9921875 DISPLAY_IDENTIFIER EFF_IGA_MON2 ECU_ADDRESS 0xc00014ef FORMAT "%8.6" /end MEASUREMENT
/begin AXIS_PTS ldp_maf_mon2_ip_iga_ref_mon2 "" 0xa10015e4 maf_mon2 _REC_AXS_20_u1 1389. _CNV_A_R_LINEAR_____14_CM 8 0. 1389. FORMAT "%4.0" /end AXIS_PTS
/begin AXIS_PTS ldp_n_32_mon2_ip_iga_ref_mon2 "" 0xa1001608 n_32_mon2 _REC_AXS_20_u1 8160. _CNV_A_R_LINEAR_____9_CM 8 0. 8160. FORMAT "%4.0" /end AXIS_PTS
/begin MEASUREMENT eff_scc_mon2 " actual efficinecy of cylinder cut-off for torque monitoring" UBYTE _CNV_A_R_LINEAR_____100_CM 1 100. 0. 1.9921875 DISPLAY_IDENTIFIER EFF_SCC_MON2 ECU_ADDRESS 0xc00014f4 FORMAT "%8.6" /end MEASUREMENT
/begin MEASUREMENT iga_dif_av_mon2 " difference of IGA_AV_MV_MON and IGA_REF_COR_MON" UBYTE _CNV_A_R_LINEAR_____174_CM 1 100. 0. -95.625 DISPLAY_IDENTIFIER IGA_DIF_AV_MON2 ECU_ADDRESS 0xc00014fb FORMAT "%7.3" /end MEASUREMENT
/begin AXIS_PTS ldp_iga_dif_av_mon2_ip_eff_mon2 "" 0xa10015d8 iga_dif_av_mon2 _REC_AXS_20_u1 -95.625 _CNV_A_R_LINEAR_____174_CM 8 0. -95.625 FORMAT "%7.3" /end AXIS_PTS
/begin CHARACTERISTIC ip_eff_iga_mon2 "Basic ignition efficiency (process monitoring)" CURVE 0xa10017cc _REC_CUR_20_u1_u1 1.9921875 _CNV_A_R_LINEAR_____100_CM 0. 1.9921875 DISPLAY_IDENTIFIER IP_EFF_IGA_MON2 FORMAT "%8.6"
 /begin AXIS_DESCR COM_AXIS iga_dif_av_mon2 _CNV_A_R_LINEAR_____174_CM 8 0. -95.625 FORMAT "%7.3" AXIS_PTS_REF ldp_iga_dif_av_mon2_ip_eff_mon2 /end AXIS_DESCR
/end CHARACTERISTIC
/begin MEASUREMENT tqi_av_mon2 "Actual indicated engine torque (process monitoring)" UBYTE _CNV_A_R_LINEAR_____280_CM 1 100. 0. 510. DISPLAY_IDENTIFIER TQI_AV_MON2 ECU_ADDRESS 0xc000152b FORMAT "%3.0" /end MEASUREMENT
/begin MEASUREMENT tqi_ref_mon2 "Reference indicated engine torque (process monitoring)" UBYTE _CNV_A_R_LINEAR_____280_CM 1 100. 0. 510. DISPLAY_IDENTIFIER TQI_REF_MON2 ECU_ADDRESS 0xc0001532 FORMAT "%3.0" /end MEASUREMENT
/begin AXIS_PTS ldp_n_32_mon2_ip_tqi_ref_mon2 "" 0xa1001618 n_32_mon2 _REC_AXS_20_u1 8160. _CNV_A_R_LINEAR_____9_CM 6 0. 8160. FORMAT "%4.0" /end AXIS_PTS
/begin AXIS_PTS ldp_maf_mon2_ip_tqi_ref_mon2 "" 0xa10015f0 maf_mon2 _REC_AXS_20_u1 1389. _CNV_A_R_LINEAR_____14_CM 8 0. 1389. FORMAT "%4.0" /end AXIS_PTS
/begin MEASUREMENT lv_err_tqi_av_mon2 "Fault currently present in torque generation" UBYTE _CNV_S_2_RANGE__0___1_CM 1 100. 0. 1. DISPLAY_IDENTIFIER LV_ERR_TQI_AV_MON2 ECU_ADDRESS 0xc000154b BIT_MASK 0x1 /end MEASUREMENT
/begin MEASUREMENT tqi_dif_sp_mon2 "deviation between torque setpoint and desired indicated engine torque" UBYTE _CNV_A_R_LINEAR_____280_CM 1 100. 0. 510. DISPLAY_IDENTIFIER TQI_DIF_SP_MON2 ECU_ADDRESS 0xc0001531 FORMAT "%3.0" /end MEASUREMENT
/begin MEASUREMENT tqi_dif_max_mon2 "Permitted deviation between actual and desired indicated engine torque" UBYTE _CNV_A_R_LINEAR_____280_CM 1 100. 0. 510. DISPLAY_IDENTIFIER TQI_DIF_MAX_MON2 ECU_ADDRESS 0xc000152f FORMAT "%3.0" /end MEASUREMENT
/begin MEASUREMENT abc_tqi_av_mon2 "Anti bounce counter for fault in torque generation" UBYTE _CNV_A_R_LINEAR_____0_CM 1 100. 0. 255. DISPLAY_IDENTIFIER ABC_TQI_AV_MON2 ECU_ADDRESS 0xc00014e6 FORMAT "%3.0" /end MEASUREMENT
/begin CHARACTERISTIC c_abc_inc_tqi_av_mon2 "Anti bounce counter increment for torque monitoring" VALUE 0xa1001894 _REC_VAL_20_u1 255. _CNV_A_R_LINEAR_____0_CM 0. 255. DISPLAY_IDENTIFIER C_ABC_INC_TQI_AV_MON2 FORMAT "%3.0" /end CHARACTERISTIC
/begin CHARACTERISTIC c_abc_max_tqi_av_mon2 "Maximum value of anti-bounce counter for torque monitoring" VALUE 0xa1001896 _REC_VAL_20_u1 254. _CNV_A_R_LINEAR_____0_CM 1. 255. DISPLAY_IDENTIFIER C_ABC_MAX_TQI_AV_MON2 FORMAT "%3.0" /end CHARACTERISTIC
/begin MEASUREMENT tqi_dif_av_mon2 "deviation between actual and desired indicated engine torque" UBYTE _CNV_A_R_LINEAR_____280_CM 1 100. 0. 510. DISPLAY_IDENTIFIER TQI_DIF_AV_MON2 ECU_ADDRESS 0xc000152d FORMAT "%3.0" /end MEASUREMENT
/begin AXIS_PTS ldp_tqi_sp_mon_mon2_ip_mon2 "" 0xa100162a tqi_sp_mon_mon2 _REC_AXS_20_u1 510. _CNV_A_R_LINEAR_____280_CM 4 0. 510. FORMAT "%3.0" /end AXIS_PTS
/begin AXIS_PTS ldp_n_32_mon2_ip_tqi_dif_mon2 "" 0xa1001612 n_32_mon2 _REC_AXS_20_u1 8160. _CNV_A_R_LINEAR_____9_CM 4 0. 8160. FORMAT "%4.0" /end AXIS_PTS
/begin CHARACTERISTIC ip_tqi_dif_max_mon2 "Threshold for diagnosis of engine torque overflow" MAP 0xa1001854 _REC_MAP_20_u1_u1_u1 510. _CNV_A_R_LINEAR_____280_CM 0. 510. DISPLAY_IDENTIFIER IP_TQI_DIF_MAX_MON2 FORMAT "%3.0"
 /begin AXIS_DESCR COM_AXIS n_32_mon2 _CNV_A_R_LINEAR_____9_CM 4 0. 8160. FORMAT "%4.0" AXIS_PTS_REF ldp_n_32_mon2_ip_tqi_dif_mon2 /end AXIS_DESCR
 /begin AXIS_DESCR COM_AXIS tqi_sp_mon_mon2 _CNV_A_R_LINEAR_____280_CM 4 0. 510. FORMAT "%3.0" AXIS_PTS_REF ldp_tqi_sp_mon_mon2_ip_mon2 /end AXIS_DESCR
/end CHARACTERISTIC
/begin MEASUREMENT abc_tqi_n_max_mon2 "Anti-bounce-counter for fault in engine speed limitation" UBYTE _CNV_A_R_LINEAR_____0_CM 1 100. 0. 255. DISPLAY_IDENTIFIER ABC_TQI_N_MAX_MON2 ECU_ADDRESS 0xc00014e9 FORMAT "%3.0" /end MEASUREMENT
/begin MEASUREMENT lv_err_tqi_n_max_mon2 "Fault currently present in engine speed limitation" UBYTE _CNV_S_2_RANGE__0___1_CM 1 100. 0. 1. DISPLAY_IDENTIFIER LV_ERR_TQI_N_MAX_MON2 ECU_ADDRESS 0xc000154c BIT_MASK 0x1 /end MEASUREMENT
/begin CHARACTERISTIC c_n_max_mtc_lih_thd_mon2 "Speed threshold for the detection of a fault in the engine speed limitation" VALUE 0xa100189a _REC_VAL_20_u1 8160. _CNV_A_R_LINEAR_____9_CM 0. 8160. DISPLAY_IDENTIFIER C_N_MAX_MTC_LIH_THD_MON2 FORMAT "%4.0" /end CHARACTERISTIC
/begin CHARACTERISTIC c_abc_inc_tqi_n_max_mon2 "Anti bounce counter increment" VALUE 0xa1001895 _REC_VAL_20_u1 255. _CNV_A_R_LINEAR_____0_CM 0. 255. DISPLAY_IDENTIFIER C_ABC_INC_TQI_N_MAX_MON2 FORMAT "%3.0" /end CHARACTERISTIC
/begin CHARACTERISTIC c_abc_max_tqi_n_max_mon2 "Maximum value of anti-bounce counter" VALUE 0xa1001897 _REC_VAL_20_u1 254. _CNV_A_R_LINEAR_____0_CM 1. 255. DISPLAY_IDENTIFIER C_ABC_MAX_TQI_N_MAX_MON2 FORMAT "%3.0" /end CHARACTERISTIC
/begin MEASUREMENT lv_n_lim_req_mon2 "Request for engine speed limitation" UBYTE _CNV_S_2_RANGE__0___1_CM 1 100. 0. 1. DISPLAY_IDENTIFIER LV_N_LIM_REQ_MON2 ECU_ADDRESS 0xc0001552 BIT_MASK 0x1 /end MEASUREMENT
/begin MEASUREMENT lv_dr_off_mu_mon2 "Request for wrong answers of the level 2' test calculations to the monitoring unit in order to disable MTC and IV" UBYTE _CNV_S_2_RANGE__0___1_CM 1 100. 0. 1. DISPLAY_IDENTIFIER LV_DR_OFF_MU_MON2 ECU_ADDRESS 0xc000153d BIT_MASK 0x1 /end MEASUREMENT
/begin MEASUREMENT lv_off_mtc_mon2 "Request for disable of MTC power stage by main controller" UBYTE _CNV_S_2_RANGE__0___1_CM 1 100. 0. 1. DISPLAY_IDENTIFIER LV_OFF_MTC_MON2 ECU_ADDRESS 0xc0001557 BIT_MASK 0x1 /end MEASUREMENT
/begin MEASUREMENT lv_off_iv_mon2 "Request for disable of IV power stage by main controller" UBYTE _CNV_S_2_RANGE__0___1_CM 1 100. 0. 1. DISPLAY_IDENTIFIER LV_OFF_IV_MON2 ECU_ADDRESS 0xc0001553 BIT_MASK 0x1 /end MEASUREMENT
/begin MEASUREMENT lv_off_iv_n_lim_etc_mon2 "Reversible fuel Cut Off Switch for all cylinders" UBYTE _CNV_S_2_RANGE__0___1_CM 1 100. 0. 1. DISPLAY_IDENTIFIER LV_OFF_IV_N_LIM_ETC_MON2 ECU_ADDRESS 0xc0001554 BIT_MASK 0x1 /end MEASUREMENT
/begin MEASUREMENT lv_off_iv_n_lim_etc_tmp_mon2 "Flag for temporary injection cut off during last recurrency" UBYTE _CNV_S_2_RANGE__0___1_CM 1 100. 0. 1. DISPLAY_IDENTIFIER LV_OFF_IV_N_LIM_ETC_TMP_MON2 ECU_ADDRESS 0xc0001556 BIT_MASK 0x1 /end MEASUREMENT
/begin CHARACTERISTIC id_tqi_inc_ext_mon2 "External torque request" CURVE 0xa100176c _REC_CUR_20_s2_u1 2047.96875 _CNV_A_R_LINEAR_____30_CM -1024. 1023.96875 DISPLAY_IDENTIFIER ID_TQI_INC_EXT_MON2 FORMAT "%11.5"
 /begin AXIS_DESCR COM_AXIS NO_INPUT_QUANTITY _CNV_A_R_LINEAR_____0_CM 12 0. 15. FORMAT "%3.0" AXIS_PTS_REF ldpm_test_rec_idx_mon2 /end AXIS_DESCR
/end CHARACTERISTIC
/begin CHARACTERISTIC id_pv_av_ad_mon2 "Pedal value adaptation" CURVE 0xa10016d0 _REC_CUR_20_u1_u1 99.609375 _CNV_A_R_LINEAR_____5_CM 0. 99.609375 DISPLAY_IDENTIFIER ID_PV_AV_AD_MON2 FORMAT "%9.6"
 /begin AXIS_DESCR COM_AXIS NO_INPUT_QUANTITY _CNV_A_R_LINEAR_____0_CM 12 0. 15. FORMAT "%3.0" AXIS_PTS_REF ldpm_test_rec_idx_mon2 /end AXIS_DESCR
/end CHARACTERISTIC
/begin CHARACTERISTIC id_fac_tq_req_cru_mon2 "Torque demand from cruise control" CURVE 0xa1001658 _REC_CUR_20_u1_u1 1.9921875 _CNV_A_R_LINEAR_____100_CM 0. 1.9921875 DISPLAY_IDENTIFIER ID_FAC_TQ_REQ_CRU_MON2 FORMAT "%8.6"
 /begin AXIS_DESCR COM_AXIS NO_INPUT_QUANTITY _CNV_A_R_LINEAR_____0_CM 12 0. 15. FORMAT "%3.0" AXIS_PTS_REF ldpm_test_rec_idx_mon2 /end AXIS_DESCR
/end CHARACTERISTIC
/begin CHARACTERISTIC id_tq_min_clu_mon2 "Monitored minimum torque at clutch" CURVE 0xa1001754 _REC_CUR_20_s2_u1 2047.96875 _CNV_A_R_LINEAR_____30_CM -1024. 1023.96875 DISPLAY_IDENTIFIER ID_TQ_MIN_CLU_MON2 FORMAT "%11.5"
 /begin AXIS_DESCR COM_AXIS NO_INPUT_QUANTITY _CNV_A_R_LINEAR_____0_CM 12 0. 15. FORMAT "%3.0" AXIS_PTS_REF ldpm_test_rec_idx_mon2 /end AXIS_DESCR
/end CHARACTERISTIC
/begin CHARACTERISTIC id_tq_max_clu_mon2 "Monitored maximum torque at clutch" CURVE 0xa100173c _REC_CUR_20_s2_u1 2047.96875 _CNV_A_R_LINEAR_____30_CM -1024. 1023.96875 DISPLAY_IDENTIFIER ID_TQ_MAX_CLU_MON2 FORMAT "%11.5"
 /begin AXIS_DESCR COM_AXIS NO_INPUT_QUANTITY _CNV_A_R_LINEAR_____0_CM 12 0. 15. FORMAT "%3.0" AXIS_PTS_REF ldpm_test_rec_idx_mon2 /end AXIS_DESCR
/end CHARACTERISTIC
/begin CHARACTERISTIC id_tq_dif_p_d_is_mon2 "P- and D- controller output for idle speed control" CURVE 0xa100170c _REC_CUR_20_s2_u1 2047.96875 _CNV_A_R_LINEAR_____30_CM -1024. 1023.96875 DISPLAY_IDENTIFIER ID_TQ_DIF_P_D_IS_MON2 FORMAT "%11.5"
 /begin AXIS_DESCR COM_AXIS NO_INPUT_QUANTITY _CNV_A_R_LINEAR_____0_CM 12 0. 15. FORMAT "%3.0" AXIS_PTS_REF ldpm_test_rec_idx_mon2 /end AXIS_DESCR
/end CHARACTERISTIC
/begin CHARACTERISTIC id_tq_loss_mon2 "Torque losses" CURVE 0xa1001724 _REC_CUR_20_s2_u1 2047.96875 _CNV_A_R_LINEAR_____30_CM -1024. 1023.96875 DISPLAY_IDENTIFIER ID_TQ_LOSS_MON2 FORMAT "%11.5"
 /begin AXIS_DESCR COM_AXIS NO_INPUT_QUANTITY _CNV_A_R_LINEAR_____0_CM 12 0. 15. FORMAT "%3.0" AXIS_PTS_REF ldpm_test_rec_idx_mon2 /end AXIS_DESCR
/end CHARACTERISTIC
/begin CHARACTERISTIC id_n_32_mon2 "Engine speed (monitoring level)" CURVE 0xa10016b8 _REC_CUR_20_u1_u1 8160. _CNV_A_R_LINEAR_____9_CM 0. 8160. DISPLAY_IDENTIFIER ID_N_32_MON2 FORMAT "%4.0"
 /begin AXIS_DESCR COM_AXIS NO_INPUT_QUANTITY _CNV_A_R_LINEAR_____0_CM 12 0. 15. FORMAT "%3.0" AXIS_PTS_REF ldpm_test_rec_idx_mon2 /end AXIS_DESCR
/end CHARACTERISTIC
/begin CHARACTERISTIC id_iga_ref_cor_ext_mon2 "Reference ignition angle" CURVE 0xa1001670 _REC_CUR_20_u1_u1 95.625 _CNV_A_R_LINEAR_____167_CM -35.625 60. DISPLAY_IDENTIFIER ID_IGA_REF_COR_EXT_MON2 FORMAT "%7.3"
 /begin AXIS_DESCR COM_AXIS NO_INPUT_QUANTITY _CNV_A_R_LINEAR_____0_CM 12 0. 15. FORMAT "%3.0" AXIS_PTS_REF ldpm_test_rec_idx_mon2 /end AXIS_DESCR
/end CHARACTERISTIC
/begin CHARACTERISTIC id_iga_igc_mon2 "Actual ignition angle" CURVE 0xa1001664 _REC_CUR_20_u1_u1 95.625 _CNV_A_R_LINEAR_____167_CM -35.625 60. DISPLAY_IDENTIFIER ID_IGA_IGC_MON2 FORMAT "%7.3"
 /begin AXIS_DESCR COM_AXIS NO_INPUT_QUANTITY _CNV_A_R_LINEAR_____0_CM 12 0. 15. FORMAT "%3.0" AXIS_PTS_REF ldpm_test_rec_idx_mon2 /end AXIS_DESCR
/end CHARACTERISTIC
/begin CHARACTERISTIC id_sum_inh_inj_mon2 "SUM of inhibit injection (all cylinders)" CURVE 0xa10016f4 _REC_CUR_20_u1_u1 8. _CNV_A_R_LINEAR_____0_CM 0. 8. DISPLAY_IDENTIFIER ID_SUM_INH_INJ_MON2 FORMAT "%3.0"
 /begin AXIS_DESCR COM_AXIS NO_INPUT_QUANTITY _CNV_A_R_LINEAR_____0_CM 12 0. 15. FORMAT "%3.0" AXIS_PTS_REF ldpm_test_rec_idx_mon2 /end AXIS_DESCR
/end CHARACTERISTIC
/begin CHARACTERISTIC id_maf_mon2 "Actual fuel mass flow (torque monitoring)" CURVE 0xa10016ac _REC_CUR_20_u1_u1 1389. _CNV_A_R_LINEAR_____14_CM 0. 1389. DISPLAY_IDENTIFIER ID_MAF_MON2 FORMAT "%4.0"
 /begin AXIS_DESCR COM_AXIS NO_INPUT_QUANTITY _CNV_A_R_LINEAR_____0_CM 12 0. 15. FORMAT "%3.0" AXIS_PTS_REF ldpm_test_rec_idx_mon2 /end AXIS_DESCR
/end CHARACTERISTIC
/begin CHARACTERISTIC id_prev_state_iv_mon2 "State of injection valves at previous cycle" CURVE 0xa10016c4 _REC_CUR_20_u1_u1 255. _CNV_A_R_LINEAR_____0_CM 0. 255. DISPLAY_IDENTIFIER ID_PREV_STATE_IV_MON2 FORMAT "%3.0"
 /begin AXIS_DESCR COM_AXIS NO_INPUT_QUANTITY _CNV_A_R_LINEAR_____0_CM 12 0. 15. FORMAT "%3.0" AXIS_PTS_REF ldpm_test_rec_idx_mon2 /end AXIS_DESCR
/end CHARACTERISTIC
/begin CHARACTERISTIC id_abc_tqi_av_mon2 "Anti bounce counter for fault in torque generation in AFS mode" CURVE 0xa1001640 _REC_CUR_20_u1_u1 255. _CNV_A_R_LINEAR_____0_CM 0. 255. DISPLAY_IDENTIFIER ID_ABC_TQI_AV_MON2 FORMAT "%3.0"
 /begin AXIS_DESCR COM_AXIS NO_INPUT_QUANTITY _CNV_A_R_LINEAR_____0_CM 12 0. 15. FORMAT "%3.0" AXIS_PTS_REF ldpm_test_rec_idx_mon2 /end AXIS_DESCR
/end CHARACTERISTIC
/begin CHARACTERISTIC id_abc_tqi_n_max_mon2 "Anti-bounce-counter for monitoring of engine speed limitation" CURVE 0xa100164c _REC_CUR_20_u1_u1 255. _CNV_A_R_LINEAR_____0_CM 0. 255. DISPLAY_IDENTIFIER ID_ABC_TQI_N_MAX_MON2 FORMAT "%3.0"
 /begin AXIS_DESCR COM_AXIS NO_INPUT_QUANTITY _CNV_A_R_LINEAR_____0_CM 12 0. 15. FORMAT "%3.0" AXIS_PTS_REF ldpm_test_rec_idx_mon2 /end AXIS_DESCR
/end CHARACTERISTIC
/begin CHARACTERISTIC id_tqi_sp_mon_mon2 "Resulting desired indicated engine torque, old value" CURVE 0xa10017c0 _REC_CUR_20_u1_u1 510. _CNV_A_R_LINEAR_____280_CM 0. 510. DISPLAY_IDENTIFIER ID_TQI_SP_MON_MON2 FORMAT "%3.0"
 /begin AXIS_DESCR COM_AXIS NO_INPUT_QUANTITY _CNV_A_R_LINEAR_____0_CM 12 0. 15. FORMAT "%3.0" AXIS_PTS_REF ldpm_test_rec_idx_mon2 /end AXIS_DESCR
/end CHARACTERISTIC
/begin CHARACTERISTIC id_tqi_req_tot_mon2 "Desired non-delayed indicated engine torque, old value" CURVE 0xa100179c _REC_CUR_20_u1_u1 510. _CNV_A_R_LINEAR_____280_CM 0. 510. DISPLAY_IDENTIFIER ID_TQI_REQ_TOT_MON2 FORMAT "%3.0"
 /begin AXIS_DESCR COM_AXIS NO_INPUT_QUANTITY _CNV_A_R_LINEAR_____0_CM 12 0. 15. FORMAT "%3.0" AXIS_PTS_REF ldpm_test_rec_idx_mon2 /end AXIS_DESCR
/end CHARACTERISTIC
/begin CHARACTERISTIC id_t_tqi_mon2 "Dead time for delay of desired indicated engine torque, old value" CURVE 0xa1001700 _REC_CUR_20_u1_u1 10.2 _CNV_A_R_LINEAR_____279_CM 0. 10.2 DISPLAY_IDENTIFIER ID_T_TQI_MON2 FORMAT "%5.2"
 /begin AXIS_DESCR COM_AXIS NO_INPUT_QUANTITY _CNV_A_R_LINEAR_____0_CM 12 0. 15. FORMAT "%3.0" AXIS_PTS_REF ldpm_test_rec_idx_mon2 /end AXIS_DESCR
/end CHARACTERISTIC
/begin CHARACTERISTIC id_resp_mon2 "Assignement table for answer decoder copy of process monitoring" CURVE 0xa10016dc _REC_CUR_20_u2_u1 65535. _CNV_A_R_LINEAR_____0_CM 0. 65535. DISPLAY_IDENTIFIER ID_RESP_MON2 FORMAT "%5.0"
 /begin AXIS_DESCR COM_AXIS NO_INPUT_QUANTITY _CNV_A_R_LINEAR_____0_CM 12 0. 15. FORMAT "%3.0" AXIS_PTS_REF ldpm_test_rec_idx_mon2 /end AXIS_DESCR
/end CHARACTERISTIC
/begin MEASUREMENT iga_igc_mon2[0] "Actual Ignition angle of cylinder x" UBYTE _CNV_A_R_LINEAR_____167_CM 1 100. -35.625 60. DISPLAY_IDENTIFIER IGA_IGC_MON2_1 ECU_ADDRESS 0xc00014fc FORMAT "%7.3" /end MEASUREMENT
/begin MEASUREMENT iga_igc_mon2[1] "Actual Ignition angle of cylinder x" UBYTE _CNV_A_R_LINEAR_____167_CM 1 100. -35.625 60. DISPLAY_IDENTIFIER IGA_IGC_MON2_2 ECU_ADDRESS 0xc00014fd FORMAT "%7.3" /end MEASUREMENT
/begin MEASUREMENT iga_igc_mon2[2] "Actual Ignition angle of cylinder x" UBYTE _CNV_A_R_LINEAR_____167_CM 1 100. -35.625 60. DISPLAY_IDENTIFIER IGA_IGC_MON2_3 ECU_ADDRESS 0xc00014fe FORMAT "%7.3" /end MEASUREMENT
/begin MEASUREMENT iga_igc_mon2[3] "Actual Ignition angle of cylinder x" UBYTE _CNV_A_R_LINEAR_____167_CM 1 100. -35.625 60. DISPLAY_IDENTIFIER IGA_IGC_MON2_4 ECU_ADDRESS 0xc00014ff FORMAT "%7.3" /end MEASUREMENT
/begin MEASUREMENT iga_igc_mon2[4] "Actual Ignition angle of cylinder x" UBYTE _CNV_A_R_LINEAR_____167_CM 1 100. -35.625 60. DISPLAY_IDENTIFIER IGA_IGC_MON2_5 ECU_ADDRESS 0xc0001500 FORMAT "%7.3" /end MEASUREMENT
/begin MEASUREMENT iga_igc_mon2[5] "Actual Ignition angle of cylinder x" UBYTE _CNV_A_R_LINEAR_____167_CM 1 100. -35.625 60. DISPLAY_IDENTIFIER IGA_IGC_MON2_6 ECU_ADDRESS 0xc0001501 FORMAT "%7.3" /end MEASUREMENT
/begin MEASUREMENT iga_ref_mon2 "Reference Ignition angle" UBYTE _CNV_A_R_LINEAR_____167_CM 1 100. -35.625 60. DISPLAY_IDENTIFIER IGA_REF_MON2 ECU_ADDRESS 0xc0001503 FORMAT "%7.3" /end MEASUREMENT
/begin CHARACTERISTIC ip_fac_tq_req_driv_mon2 "Scaling factor for requested torque at clutch from driver" MAP 0xa10017d4 _REC_MAP_20_u1_u1_u1 1.9921875 _CNV_A_R_LINEAR_____100_CM 0. 1.9921875 DISPLAY_IDENTIFIER IP_FAC_TQ_REQ_DRIV_MON2 FORMAT "%8.6"
 /begin AXIS_DESCR COM_AXIS n_32_mon2 _CNV_A_R_LINEAR_____9_CM 8 0. 8160. FORMAT "%4.0" AXIS_PTS_REF ldp_n_32_mon2_ip_fac_tq_mon2 /end AXIS_DESCR
 /begin AXIS_DESCR COM_AXIS pv_av_ad_mon2 _CNV_A_R_LINEAR_____5_CM 8 0. 99.609375 FORMAT "%9.6" AXIS_PTS_REF ldp_pv_av_ad_mon2_ip_fac_mon2 /end AXIS_DESCR
/end CHARACTERISTIC
/begin CHARACTERISTIC ip_iga_ref_mon2 "Reference ignition angle (process monitoring)" MAP 0xa1001814 _REC_MAP_20_u1_u1_u1 95.625 _CNV_A_R_LINEAR_____167_CM -35.625 60. DISPLAY_IDENTIFIER IP_IGA_REF_MON2 FORMAT "%7.3"
 /begin AXIS_DESCR COM_AXIS n_32_mon2 _CNV_A_R_LINEAR_____9_CM 8 0. 8160. FORMAT "%4.0" AXIS_PTS_REF ldp_n_32_mon2_ip_iga_ref_mon2 /end AXIS_DESCR
 /begin AXIS_DESCR COM_AXIS maf_mon2 _CNV_A_R_LINEAR_____14_CM 8 0. 1389. FORMAT "%4.0" AXIS_PTS_REF ldp_maf_mon2_ip_iga_ref_mon2 /end AXIS_DESCR
/end CHARACTERISTIC
/begin CHARACTERISTIC ip_tqi_ref_mon2 "Indicated engine torque at reference conditions (process monitoring)" MAP 0xa1001864 _REC_MAP_20_u1_u1_u1 510. _CNV_A_R_LINEAR_____280_CM 0. 510. DISPLAY_IDENTIFIER IP_TQI_REF_MON2 FORMAT "%3.0"
 /begin AXIS_DESCR COM_AXIS n_32_mon2 _CNV_A_R_LINEAR_____9_CM 6 0. 8160. FORMAT "%4.0" AXIS_PTS_REF ldp_n_32_mon2_ip_tqi_ref_mon2 /end AXIS_DESCR
 /begin AXIS_DESCR COM_AXIS maf_mon2 _CNV_A_R_LINEAR_____14_CM 8 0. 1389. FORMAT "%4.0" AXIS_PTS_REF ldp_maf_mon2_ip_tqi_ref_mon2 /end AXIS_DESCR
/end CHARACTERISTIC
/begin MEASUREMENT tq_min_clu_mon2 "Monitored minimum torque at clutch" SWORD _CNV_A_R_LINEAR_____30_CM 1 100. -1024. 1023.96875 DISPLAY_IDENTIFIER TQ_MIN_CLU_MON2 ECU_ADDRESS 0xc00014be FORMAT "%11.5" /end MEASUREMENT
/begin MEASUREMENT lv_err_mu_mc_mon2 "Fault detected by processor monitoring(continuous)" UBYTE _CNV_S_2_RANGE__0___1_CM 1 100. 0. 1. DISPLAY_IDENTIFIER LV_ERR_MU_MC_MON2 ECU_ADDRESS 0xc0001540 BIT_MASK 0x1 /end MEASUREMENT
/begin MEASUREMENT lv_err_tmp_mu_mc_mon2 "Fault detected by processor monitoring(temporary)" UBYTE _CNV_S_2_RANGE__0___1_CM 1 100. 0. 1. DISPLAY_IDENTIFIER LV_ERR_TMP_MU_MC_MON2 ECU_ADDRESS 0xc0001544 BIT_MASK 0x1 /end MEASUREMENT
/begin CHARACTERISTIC id_tqi_sp_mon2 "Setpoint indicated engine torque" CURVE 0xa10017a8 _REC_CUR_20_s2_u1 2047.96875 _CNV_A_R_LINEAR_____30_CM -1024. 1023.96875 DISPLAY_IDENTIFIER ID_TQI_SP_MON2 FORMAT "%11.5"
 /begin AXIS_DESCR COM_AXIS NO_INPUT_QUANTITY _CNV_A_R_LINEAR_____0_CM 12 0. 15. FORMAT "%3.0" AXIS_PTS_REF ldpm_test_rec_idx_mon2 /end AXIS_DESCR
/end CHARACTERISTIC
/begin CHARACTERISTIC id_tqi_min_pu_mon2 "Torque for trailing throttle" CURVE 0xa1001784 _REC_CUR_20_u2_u1 1023.96875 _CNV_A_R_LINEAR_____30_CM 0. 1023.96875 DISPLAY_IDENTIFIER ID_TQI_MIN_PU_MON2 FORMAT "%10.5"
 /begin AXIS_DESCR COM_AXIS NO_INPUT_QUANTITY _CNV_A_R_LINEAR_____0_CM 12 0. 15. FORMAT "%3.0" AXIS_PTS_REF ldpm_test_rec_idx_mon2 /end AXIS_DESCR
/end CHARACTERISTIC
/begin MEASUREMENT tqi_min_pu_mon2 "Torque for trailing throttle" UWORD _CNV_A_R_LINEAR_____30_CM 1 100. 0. 1023.96875 DISPLAY_IDENTIFIER TQI_MIN_PU_MON2 ECU_ADDRESS 0xc00014c4 FORMAT "%10.5" /end MEASUREMENT
/begin CHARACTERISTIC id_lf_1_mon2 "Table of logical starting values 1" CURVE 0xa100167c _REC_CUR_20_u1_u1 255. _CNV_A_R_LINEAR_____0_CM 0. 255. DISPLAY_IDENTIFIER ID_LF_1_MON2 FORMAT "%3.0"
 /begin AXIS_DESCR COM_AXIS NO_INPUT_QUANTITY _CNV_A_R_LINEAR_____0_CM 12 0. 15. FORMAT "%3.0" AXIS_PTS_REF ldpm_test_rec_idx_mon2 /end AXIS_DESCR
/end CHARACTERISTIC
/begin CHARACTERISTIC id_lf_2_mon2 "Table of logical starting values 2" CURVE 0xa1001688 _REC_CUR_20_u1_u1 255. _CNV_A_R_LINEAR_____0_CM 0. 255. DISPLAY_IDENTIFIER ID_LF_2_MON2 FORMAT "%3.0"
 /begin AXIS_DESCR COM_AXIS NO_INPUT_QUANTITY _CNV_A_R_LINEAR_____0_CM 12 0. 15. FORMAT "%3.0" AXIS_PTS_REF ldpm_test_rec_idx_mon2 /end AXIS_DESCR
/end CHARACTERISTIC
/begin CHARACTERISTIC id_lf_3_mon2 "Table of logical starting values 3" CURVE 0xa1001694 _REC_CUR_20_u1_u1 255. _CNV_A_R_LINEAR_____0_CM 0. 255. DISPLAY_IDENTIFIER ID_LF_3_MON2 FORMAT "%3.0"
 /begin AXIS_DESCR COM_AXIS NO_INPUT_QUANTITY _CNV_A_R_LINEAR_____0_CM 12 0. 15. FORMAT "%3.0" AXIS_PTS_REF ldpm_test_rec_idx_mon2 /end AXIS_DESCR
/end CHARACTERISTIC
/begin CHARACTERISTIC id_lf_4_mon2 "Table of logical starting values 4" CURVE 0xa10016a0 _REC_CUR_20_u1_u1 255. _CNV_A_R_LINEAR_____0_CM 0. 255. DISPLAY_IDENTIFIER ID_LF_4_MON2 FORMAT "%3.0"
 /begin AXIS_DESCR COM_AXIS NO_INPUT_QUANTITY _CNV_A_R_LINEAR_____0_CM 12 0. 15. FORMAT "%3.0" AXIS_PTS_REF ldpm_test_rec_idx_mon2 /end AXIS_DESCR
/end CHARACTERISTIC
/begin CHARACTERISTIC c_crlc_tqi_sp_mon2 "Filter constant for realization of first order filter" VALUE 0xa1001898 _REC_VAL_20_u1 0.99609375 _CNV_A_R_LINEAR_____27_CM 0. 0.99609375 DISPLAY_IDENTIFIER C_CRLC_TQI_SP_MON2 FORMAT "%5.3" /end CHARACTERISTIC
/begin MEASUREMENT lv_err_tran_1_mon2 "Flag for temporary fault 1(exclusive fault of L3) during last recurrency" UBYTE _CNV_S_2_RANGE__0___1_CM 1 100. 0. 1. DISPLAY_IDENTIFIER LV_ERR_TRAN_1_MON2 ECU_ADDRESS 0xc000154e BIT_MASK 0x1 /end MEASUREMENT
/begin MEASUREMENT lv_err_tran_2_mon2 "Flag for temporary fault 2(together with fault of L2) during last recurrency" UBYTE _CNV_S_2_RANGE__0___1_CM 1 100. 0. 1. DISPLAY_IDENTIFIER LV_ERR_TRAN_2_MON2 ECU_ADDRESS 0xc0001550 BIT_MASK 0x1 /end MEASUREMENT
/begin MEASUREMENT lf_4_mon2 "Byte of logical starting values 4" UBYTE _CNV_A_R_LINEAR_____0_CM 1 100. 0. 255. DISPLAY_IDENTIFIER LF_4_MON2 ECU_ADDRESS 0xc0001507 FORMAT "%3.0" /end MEASUREMENT
/begin MEASUREMENT fac_tq_req_cru_mon "Charge demand from cruise control" UBYTE _CNV_A_R_LINEAR_____100_CM 1 100. 0. 1.9921875 DISPLAY_IDENTIFIER FAC_TQ_REQ_CRU_MON ECU_ADDRESS 0xd0002d41 FORMAT "%8.6" /end MEASUREMENT
/begin MEASUREMENT t_cru_inh_mon "Delay time for disable of GS torque demand in monitoring level" UBYTE _CNV_A_R_LINEAR_____279_CM 1 100. 0. 10.2 DISPLAY_IDENTIFIER T_CRU_INH_MON ECU_ADDRESS 0xc0001517 FORMAT "%5.2" /end MEASUREMENT
/begin CHARACTERISTIC c_t_cru_inh_mon "Delay time for disable of GS torque demand in monitoring level" VALUE 0xa100103f _REC_VAL_20_u1 10.2 _CNV_A_R_LINEAR_____279_CM 0. 10.2 DISPLAY_IDENTIFIER C_T_CRU_INH_MON FORMAT "%5.2" /end CHARACTERISTIC
/begin CHARACTERISTIC c_vs_min_cru_mon "Minimum threshold for vehicle speed control active" VALUE 0xa10010a0 _REC_VAL_20_u1 510. _CNV_A_R_ECM2_LINEA_847_CM 0. 510. DISPLAY_IDENTIFIER C_VS_MIN_CRU_MON FORMAT "%3.0" /end CHARACTERISTIC
/begin MEASUREMENT lv_cru_inh_mon "Inhibition of Cruise Control by Monitoring" UBYTE _CNV_S_2_RANGE__0___1_CM 1 100. 0. 1. DISPLAY_IDENTIFIER LV_CRU_INH_MON ECU_ADDRESS 0xd0002d5d BIT_MASK 0x1 /end MEASUREMENT
/begin MEASUREMENT lv_err_cru_mon "Fault in Cruise Control present" UBYTE _CNV_S_2_RANGE__0___1_CM 1 100. 0. 1. DISPLAY_IDENTIFIER LV_ERR_CRU_MON ECU_ADDRESS 0xd0002d63 BIT_MASK 0x1 /end MEASUREMENT
/begin MEASUREMENT abc_cru_tq_mon "Value of the anti - bounce counter" UBYTE _CNV_A_R_LINEAR_____0_CM 1 100. 0. 255. DISPLAY_IDENTIFIER ABC_CRU_TQ_MON ECU_ADDRESS 0xc00014d2 FORMAT "%3.0" /end MEASUREMENT
/begin CHARACTERISTIC c_abc_inc_cru_tq_mon "Anti bounce counter increment" VALUE 0xa1000fce _REC_VAL_20_u1 255. _CNV_A_R_LINEAR_____0_CM 0. 255. DISPLAY_IDENTIFIER C_ABC_INC_CRU_TQ_MON FORMAT "%3.0" /end CHARACTERISTIC
/begin CHARACTERISTIC c_abc_max_cru_tq_mon "Maximum value of anti-bounce counter" VALUE 0xa1000fea _REC_VAL_20_u1 254. _CNV_A_R_LINEAR_____0_CM 1. 255. DISPLAY_IDENTIFIER C_ABC_MAX_CRU_TQ_MON FORMAT "%3.0" /end CHARACTERISTIC
/begin MEASUREMENT lv_err_conv_mon_1 "General monitoring error debounced" UBYTE _CNV_S_2_RANGE__0___1_CM 1 100. 0. 1. DISPLAY_IDENTIFIER LV_ERR_CONV_MON_1 ECU_ADDRESS 0xd0002d61 BIT_MASK 0x1 /end MEASUREMENT
/begin MEASUREMENT lv_err_n_32_mon_1 "General monitoring error debounced" UBYTE _CNV_S_2_RANGE__0___1_CM 1 100. 0. 1. DISPLAY_IDENTIFIER LV_ERR_N_32_MON_1 ECU_ADDRESS 0xd0002d6f BIT_MASK 0x1 /end MEASUREMENT
/begin MEASUREMENT lv_err_pvs_mon_1 "General monitoring error debounced" UBYTE _CNV_S_2_RANGE__0___1_CM 1 100. 0. 1. DISPLAY_IDENTIFIER LV_ERR_PVS_MON_1 ECU_ADDRESS 0xd0002d71 BIT_MASK 0x1 /end MEASUREMENT
/begin MEASUREMENT lv_err_cru_mon_1 "General monitoring error debounced" UBYTE _CNV_S_2_RANGE__0___1_CM 1 100. 0. 1. DISPLAY_IDENTIFIER LV_ERR_CRU_MON_1 ECU_ADDRESS 0xd0002d64 BIT_MASK 0x1 /end MEASUREMENT
/begin MEASUREMENT lv_err_tqi_av_mon_1 "General monitoring error debounced" UBYTE _CNV_S_2_RANGE__0___1_CM 1 100. 0. 1. DISPLAY_IDENTIFIER LV_ERR_TQI_AV_MON_1 ECU_ADDRESS 0xd0002d7d BIT_MASK 0x1 /end MEASUREMENT
/begin MEASUREMENT lv_err_tqi_n_max_mon_1 "General monitoring error debounced" UBYTE _CNV_S_2_RANGE__0___1_CM 1 100. 0. 1. DISPLAY_IDENTIFIER LV_ERR_TQI_N_MAX_MON_1 ECU_ADDRESS 0xd0002d7f BIT_MASK 0x1 /end MEASUREMENT
/begin MEASUREMENT lv_err_mff_mon_1 "General monitoring error debounced" UBYTE _CNV_S_2_RANGE__0___1_CM 1 100. 0. 1. DISPLAY_IDENTIFIER LV_ERR_MFF_MON_1 ECU_ADDRESS 0xd0002d6c BIT_MASK 0x1 /end MEASUREMENT
/begin MEASUREMENT lv_err_tq_dif_isc_mon_1 "General monitoring error debounced" UBYTE _CNV_S_2_RANGE__0___1_CM 1 100. 0. 1. DISPLAY_IDENTIFIER LV_ERR_TQ_DIF_ISC_MON_1 ECU_ADDRESS 0xd0002d75 BIT_MASK 0x1 /end MEASUREMENT
/begin MEASUREMENT lv_err_tq_req_mon_1 "General monitoring error debounced" UBYTE _CNV_S_2_RANGE__0___1_CM 1 100. 0. 1. DISPLAY_IDENTIFIER LV_ERR_TQ_REQ_MON_1 ECU_ADDRESS 0xd0002d7b BIT_MASK 0x1 /end MEASUREMENT
/begin MEASUREMENT lv_err_tq_ext_mon_1 "General monitoring error debounced" UBYTE _CNV_S_2_RANGE__0___1_CM 1 100. 0. 1. DISPLAY_IDENTIFIER LV_ERR_TQ_EXT_MON_1 ECU_ADDRESS 0xd0002d77 BIT_MASK 0x1 /end MEASUREMENT
/begin MEASUREMENT lv_n_lim_req_mon "Request for engine speed limitation" UBYTE _CNV_S_2_RANGE__0___1_CM 1 100. 0. 1. DISPLAY_IDENTIFIER LV_N_LIM_REQ_MON ECU_ADDRESS 0xd0002d90 BIT_MASK 0x1 /end MEASUREMENT
/begin MEASUREMENT lv_off_mtc_mon "Request for disable of MTC power stage by main controller" UBYTE _CNV_S_2_RANGE__0___1_CM 1 100. 0. 1. DISPLAY_IDENTIFIER LV_OFF_MTC_MON ECU_ADDRESS 0xd0002d93 BIT_MASK 0x1 /end MEASUREMENT
/begin MEASUREMENT lv_off_iv_mon "Request for disable of IV power stage by main controller" UBYTE _CNV_S_2_RANGE__0___1_CM 1 100. 0. 1. DISPLAY_IDENTIFIER LV_OFF_IV_MON ECU_ADDRESS 0xd0002d91 BIT_MASK 0x1 /end MEASUREMENT
/begin MEASUREMENT lv_off_iv_n_lim_etc_tmp_mon "Flag for temporary injection cut off  during last recurrency" UBYTE _CNV_S_2_RANGE__0___1_CM 1 100. 0. 1. DISPLAY_IDENTIFIER LV_OFF_IV_N_LIM_ETC_TMP_MON ECU_ADDRESS 0xc0001555 BIT_MASK 0x1 /end MEASUREMENT
/begin MEASUREMENT lv_err_tran_1_mon "Flag for temporary fault 1 (exclusive fault of L3) during last recurrency" UBYTE _CNV_S_2_RANGE__0___1_CM 1 100. 0. 1. DISPLAY_IDENTIFIER LV_ERR_TRAN_1_MON ECU_ADDRESS 0xc000154d BIT_MASK 0x1 /end MEASUREMENT
/begin MEASUREMENT lv_err_tran_2_mon "Flag for temporary fault 2 (together with fault of L2) during last recurrency" UBYTE _CNV_S_2_RANGE__0___1_CM 1 100. 0. 1. DISPLAY_IDENTIFIER LV_ERR_TRAN_2_MON ECU_ADDRESS 0xc000154f BIT_MASK 0x1 /end MEASUREMENT
/begin MEASUREMENT tq_dif_p_d_is_dif_mon "Difference between monitored and modelled PD-part" SBYTE _CNV_A_R_LINEAR_____280_CM 1 100. -256. 254. DISPLAY_IDENTIFIER TQ_DIF_P_D_IS_DIF_MON ECU_ADDRESS 0xc0001529 FORMAT "%4.0" /end MEASUREMENT
/begin MEASUREMENT tq_dif_p_d_is_ramp_mon "Modelled PD-part during ramp function" UWORD _CNV_A_R_LINEAR_____30_CM 1 100. 0. 1023.96875 DISPLAY_IDENTIFIER TQ_DIF_P_D_IS_RAMP_MON ECU_ADDRESS 0xc0001494 FORMAT "%10.5" /end MEASUREMENT
/begin MEASUREMENT state_err_tq_dif_p_d_is_mon "State variable for fault detection in torque generation, symptom 'idle speed controller - PD-part'" UBYTE _CNV_S_5_ECM2_RANGE_848_CM 1 100. 0. 4. DISPLAY_IDENTIFIER STATE_ERR_TQ_DIF_P_D_IS_MON ECU_ADDRESS 0xd0002d50 /end MEASUREMENT
/begin MEASUREMENT tq_dif_i_is_ramp_mon "Modelled I-part dring ramp function" SWORD _CNV_A_R_ECM2_LINEA_849_CM 1 100. -256. 255.9921875 DISPLAY_IDENTIFIER TQ_DIF_I_IS_RAMP_MON ECU_ADDRESS 0xc000148e FORMAT "%9.4" /end MEASUREMENT
/begin MEASUREMENT tq_dif_i_is_dif_mon "Difference between monitored and modelled I-part" SBYTE _CNV_A_R_LINEAR_____280_CM 1 100. -256. 254. DISPLAY_IDENTIFIER TQ_DIF_I_IS_DIF_MON ECU_ADDRESS 0xc0001528 FORMAT "%4.0" /end MEASUREMENT
/begin CHARACTERISTIC c_fac_ramp_neg_i_is_mon "Factor for monitoring negative ISC deactivation-ramp of I-part" VALUE 0xa1001012 _REC_VAL_20_u2 0.5 _CNV_A_R_ECM2_LINEA_844_CM 0. 0.5 DISPLAY_IDENTIFIER C_FAC_RAMP_NEG_I_IS_MON FORMAT "%8.6" /end CHARACTERISTIC
/begin MEASUREMENT state_err_tq_dif_i_is_mon "State variable for fault detection in torque generation, symptom 'idle speed controller -   I-part'" UBYTE _CNV_S_5_ECM2_RANGE_848_CM 1 100. 0. 4. DISPLAY_IDENTIFIER STATE_ERR_TQ_DIF_I_IS_MON ECU_ADDRESS 0xd0002d4f /end MEASUREMENT
/begin CHARACTERISTIC c_tq_dif_i_is_max_mon "Maximum I-part" VALUE 0xa1001065 _REC_VAL_20_u1 255. _CNV_A_R_LINEAR_____60_CM 0. 255. DISPLAY_IDENTIFIER C_TQ_DIF_I_IS_MAX_MON FORMAT "%3.0" /end CHARACTERISTIC
/begin CHARACTERISTIC c_tq_dif_i_is_add_mon "Additive constant for I-part model value" VALUE 0xa1001064 _REC_VAL_20_u1 255. _CNV_A_R_LINEAR_____60_CM 0. 255. DISPLAY_IDENTIFIER C_TQ_DIF_I_IS_ADD_MON FORMAT "%3.0" /end CHARACTERISTIC
/begin CHARACTERISTIC c_tq_pas_i_is_mon "Target value for monitoring ISC deactivation-ramp operation" VALUE 0xa100107e _REC_VAL_20_u1 255. _CNV_A_R_LINEAR_____60_CM 0. 255. DISPLAY_IDENTIFIER C_TQ_PAS_I_IS_MON FORMAT "%3.0" /end CHARACTERISTIC
/begin MEASUREMENT lv_err_tq_dif_p_d_is_mon "Fault currently present in torque generation, symptom 'idle speed controller - PD-part'" UBYTE _CNV_S_2_RANGE__0___1_CM 1 100. 0. 1. DISPLAY_IDENTIFIER LV_ERR_TQ_DIF_P_D_IS_MON ECU_ADDRESS 0xd0002d76 BIT_MASK 0x1 /end MEASUREMENT
/begin MEASUREMENT tq_add_p_d_is_mon "Decrement for modelled PD-part during ramp function" SWORD _CNV_A_R_LINEAR_____30_CM 1 100. -1024. 1023.96875 DISPLAY_IDENTIFIER TQ_ADD_P_D_IS_MON ECU_ADDRESS 0xc000148a FORMAT "%11.5" /end MEASUREMENT
/begin MEASUREMENT abc_tq_dif_p_d_is_mon "Anti bounce counter for monitoring of idle speed controller - PD-part" UBYTE _CNV_A_R_LINEAR_____0_CM 1 100. 0. 255. DISPLAY_IDENTIFIER ABC_TQ_DIF_P_D_IS_MON ECU_ADDRESS 0xc00014e1 FORMAT "%3.0" /end MEASUREMENT
/begin CHARACTERISTIC c_abc_inc_tq_dif_p_d_is_mon "Anti bounce counter increment" VALUE 0xa1000fe1 _REC_VAL_20_u1 255. _CNV_A_R_LINEAR_____0_CM 0. 255. DISPLAY_IDENTIFIER C_ABC_INC_TQ_DIF_P_D_IS_MON FORMAT "%3.0" /end CHARACTERISTIC
/begin CHARACTERISTIC c_abc_max_tq_dif_p_d_is_mon "Maximum of anti bounce counter" VALUE 0xa1000ffd _REC_VAL_20_u1 254. _CNV_A_R_LINEAR_____0_CM 1. 255. DISPLAY_IDENTIFIER C_ABC_MAX_TQ_DIF_P_D_IS_MON FORMAT "%3.0" /end CHARACTERISTIC
/begin CHARACTERISTIC c_tq_p_d_isc_not_act_max_mon "Maximum PD-part allowed when ISC not active" VALUE 0xa100107c _REC_VAL_20_s2 2047.96875 _CNV_A_R_LINEAR_____30_CM -1024. 1023.96875 DISPLAY_IDENTIFIER C_TQ_P_D_ISC_NOT_ACT_MAX_MON FORMAT "%11.5" /end CHARACTERISTIC
/begin MEASUREMENT tq_dif_i_is_mon "Monitored I-part of the idle speed controller" SWORD _CNV_A_R_LINEAR_____30_CM 1 100. -1024. 1023.96875 DISPLAY_IDENTIFIER TQ_DIF_I_IS_MON ECU_ADDRESS 0xd000250a FORMAT "%11.5" /end MEASUREMENT
/begin MEASUREMENT tq_add_i_is_mon "Decrement for modelled I-part during ramp function" SWORD _CNV_A_R_LINEAR_____30_CM 1 100. -1024. 1023.96875 DISPLAY_IDENTIFIER TQ_ADD_I_IS_MON ECU_ADDRESS 0xc0001488 FORMAT "%11.5" /end MEASUREMENT
/begin MEASUREMENT abc_tq_dif_i_is_mon "Anti bounce counter for monitoring of I-part idle speed controller" UBYTE _CNV_A_R_LINEAR_____0_CM 1 100. 0. 255. DISPLAY_IDENTIFIER ABC_TQ_DIF_I_IS_MON ECU_ADDRESS 0xc00014e0 FORMAT "%3.0" /end MEASUREMENT
/begin CHARACTERISTIC c_abc_inc_tq_dif_i_is_mon "Anti bounce counter increment" VALUE 0xa1000fe0 _REC_VAL_20_u1 255. _CNV_A_R_LINEAR_____0_CM 0. 255. DISPLAY_IDENTIFIER C_ABC_INC_TQ_DIF_I_IS_MON FORMAT "%3.0" /end CHARACTERISTIC
/begin CHARACTERISTIC c_abc_max_tq_dif_i_is_mon "Maximum of anti bounce counter" VALUE 0xa1000ffc _REC_VAL_20_u1 254. _CNV_A_R_LINEAR_____0_CM 1. 255. DISPLAY_IDENTIFIER C_ABC_MAX_TQ_DIF_I_IS_MON FORMAT "%3.0" /end CHARACTERISTIC
/begin CHARACTERISTIC c_tq_i_isc_not_act_max_mon "maximum I-part allowed when ISC not active" VALUE 0xa100106a _REC_VAL_20_s2 2047.96875 _CNV_A_R_LINEAR_____30_CM -1024. 1023.96875 DISPLAY_IDENTIFIER C_TQ_I_ISC_NOT_ACT_MAX_MON FORMAT "%11.5" /end CHARACTERISTIC
/begin MEASUREMENT lv_err_tq_dif_i_is_mon "Fault currently present in torque generation, symptom 'idle speed controller - I-part'" UBYTE _CNV_S_2_RANGE__0___1_CM 1 100. 0. 1. DISPLAY_IDENTIFIER LV_ERR_TQ_DIF_I_IS_MON ECU_ADDRESS 0xd0002d74 BIT_MASK 0x1 /end MEASUREMENT
/begin CHARACTERISTIC c_tq_dif_p_d_is_add_mon "Additive constant for PD-part model value" VALUE 0xa1001067 _REC_VAL_20_u1 255. _CNV_A_R_LINEAR_____60_CM 0. 255. DISPLAY_IDENTIFIER C_TQ_DIF_P_D_IS_ADD_MON FORMAT "%3.0" /end CHARACTERISTIC
/begin CHARACTERISTIC c_tq_dif_p_d_ramp_chk_ofs_mon "Offset for monitoring ramp start value" VALUE 0xa1001068 _REC_VAL_20_u1 255. _CNV_A_R_LINEAR_____60_CM 0. 255. DISPLAY_IDENTIFIER C_TQ_DIF_P_D_RAMP_CHK_OFS_MON FORMAT "%3.0" /end CHARACTERISTIC
/begin MEASUREMENT lv_ramp_p_d_beg_value_wrg_mon "Logical bit indicating wrong start-value of PD-ramp" UBYTE _CNV_S_2_RANGE__0___1_CM 1 100. 0. 1. DISPLAY_IDENTIFIER LV_RAMP_P_D_BEG_VALUE_WRG_MON ECU_ADDRESS 0xc0001558 BIT_MASK 0x1 /end MEASUREMENT
/begin MEASUREMENT abc_n_32_mon "Anti bounce counter N_32 ratio error" UBYTE _CNV_A_R_LINEAR_____0_CM 1 100. 0. 255. DISPLAY_IDENTIFIER ABC_N_32_MON ECU_ADDRESS 0xc00014db FORMAT "%3.0" /end MEASUREMENT
/begin MEASUREMENT lv_err_n_32_mon "Logical variable for ratio error between N_32 and N_32_SUB_MON" UBYTE _CNV_S_2_RANGE__0___1_CM 1 100. 0. 1. DISPLAY_IDENTIFIER LV_ERR_N_32_MON ECU_ADDRESS 0xd0002d6e BIT_MASK 0x1 /end MEASUREMENT
/begin MEASUREMENT n_32_dif_rel_mon "Relative engine speed deviation monitoring level" UWORD _CNV_A_R_ECM2_LINEA_850_CM 1 100. 0. 255. DISPLAY_IDENTIFIER N_32_DIF_REL_MON ECU_ADDRESS 0xc0001476 FORMAT "%8.4" /end MEASUREMENT
/begin MEASUREMENT n_32_sub_mon "Engine speed substitute monitoring level" UBYTE _CNV_A_R_LINEAR_____9_CM 1 100. 0. 8160. DISPLAY_IDENTIFIER N_32_SUB_MON ECU_ADDRESS 0xc000150a FORMAT "%4.0" /end MEASUREMENT
/begin CHARACTERISTIC c_abc_inc_n_32_mon "Anti bounce counter increment (additive value in case of N_32 ratio error)" VALUE 0xa1000fda _REC_VAL_20_u1 255. _CNV_A_R_LINEAR_____0_CM 0. 255. DISPLAY_IDENTIFIER C_ABC_INC_N_32_MON FORMAT "%3.0" /end CHARACTERISTIC
/begin CHARACTERISTIC c_abc_max_n_32_mon "Value at which N_32 ratio error is recognized, when reached" VALUE 0xa1000ff6 _REC_VAL_20_u1 254. _CNV_A_R_LINEAR_____0_CM 1. 255. DISPLAY_IDENTIFIER C_ABC_MAX_N_32_MON FORMAT "%3.0" /end CHARACTERISTIC
/begin CHARACTERISTIC c_n_32_lim_mon "Lower limit  of denominator for relative error calculation (initial value: 32)" VALUE 0xa1001024 _REC_VAL_20_u1 8128. _CNV_A_R_LINEAR_____9_CM 32. 8160. DISPLAY_IDENTIFIER C_N_32_LIM_MON FORMAT "%4.0" /end CHARACTERISTIC
/begin CHARACTERISTIC c_n_32_min_mon "Lower limit for using the relative error concept" VALUE 0xa1001025 _REC_VAL_20_u1 8160. _CNV_A_R_LINEAR_____9_CM 0. 8160. DISPLAY_IDENTIFIER C_N_32_MIN_MON FORMAT "%4.0" /end CHARACTERISTIC
/begin CHARACTERISTIC c_n_32_dif_rel_max_mon "Maximum relative difference between N_32 and N_32_SUB_MON" VALUE 0xa1001022 _REC_VAL_20_u2 255. _CNV_A_R_ECM2_LINEA_850_CM 0. 255. DISPLAY_IDENTIFIER C_N_32_DIF_REL_MAX_MON FORMAT "%8.4" /end CHARACTERISTIC
/begin MEASUREMENT n_32_mon "Engine speed (monitoring level)" UBYTE _CNV_A_R_LINEAR_____9_CM 1 100. 0. 8160. DISPLAY_IDENTIFIER N_32_MON ECU_ADDRESS 0xd0002d47 FORMAT "%4.0" /end MEASUREMENT
/begin MEASUREMENT t_seg_sw_mon "Segment time determined by means of a software timer" ULONG _CNV_A_R_LINEAR_____401_CM 1 100. 0. 268435455. DISPLAY_IDENTIFIER T_SEG_SW_MON ECU_ADDRESS 0xc00014cc FORMAT "%9.0" /end MEASUREMENT
/begin MEASUREMENT abc_tqi_n_max_mon "Anti-bounce-counter for fault in engine speed limitation" UBYTE _CNV_A_R_LINEAR_____0_CM 1 100. 0. 255. DISPLAY_IDENTIFIER ABC_TQI_N_MAX_MON ECU_ADDRESS 0xc00014e8 FORMAT "%3.0" /end MEASUREMENT
/begin MEASUREMENT lv_err_tqi_n_max_mon "Fault currently present in engine speed limitation" UBYTE _CNV_S_2_RANGE__0___1_CM 1 100. 0. 1. DISPLAY_IDENTIFIER LV_ERR_TQI_N_MAX_MON ECU_ADDRESS 0xd0002d7e BIT_MASK 0x1 /end MEASUREMENT
/begin CHARACTERISTIC c_n_max_mtc_lih_thd_mon "Speed threshold for the detection of a fault in the engine speed limitation" VALUE 0xa100102f _REC_VAL_20_u1 8160. _CNV_A_R_LINEAR_____9_CM 0. 8160. DISPLAY_IDENTIFIER C_N_MAX_MTC_LIH_THD_MON FORMAT "%4.0" /end CHARACTERISTIC
/begin CHARACTERISTIC c_abc_inc_tqi_n_max_mon "Anti bounce counter increment" VALUE 0xa1000fe7 _REC_VAL_20_u1 255. _CNV_A_R_LINEAR_____0_CM 0. 255. DISPLAY_IDENTIFIER C_ABC_INC_TQI_N_MAX_MON FORMAT "%3.0" /end CHARACTERISTIC
/begin CHARACTERISTIC c_abc_max_tqi_n_max_mon "Maximum value of anti-bounce counter" VALUE 0xa1001003 _REC_VAL_20_u1 254. _CNV_A_R_LINEAR_____0_CM 1. 255. DISPLAY_IDENTIFIER C_ABC_MAX_TQI_N_MAX_MON FORMAT "%3.0" /end CHARACTERISTIC
/begin MEASUREMENT lv_err_pvs_ratio_mon "Logical variable for ratio-error between PVS channel 1 and 2" UBYTE _CNV_S_2_RANGE__0___1_CM 1 100. 0. 1. DISPLAY_IDENTIFIER LV_ERR_PVS_RATIO_MON ECU_ADDRESS 0xd0002d72 BIT_MASK 0x1 /end MEASUREMENT
/begin MEASUREMENT abc_pvs_ratio_mon "Anti bounce counter PVS ratio error" UBYTE _CNV_A_R_LINEAR_____0_CM 1 100. 0. 255. DISPLAY_IDENTIFIER ABC_PVS_RATIO_MON ECU_ADDRESS 0xc00014dc FORMAT "%3.0" /end MEASUREMENT
/begin MEASUREMENT pv_av_1_mon "Degree of activation of the accelerator pedal (channel 1)" UBYTE _CNV_A_R_LINEAR_____5_CM 1 100. 0. 99.609375 DISPLAY_IDENTIFIER PV_AV_1_MON ECU_ADDRESS 0xc0001510 FORMAT "%9.6" /end MEASUREMENT
/begin MEASUREMENT pv_av_2_mon "Degree of activation of the accelerator pedal (channel 2)" UBYTE _CNV_A_R_LINEAR_____5_CM 1 100. 0. 99.609375 DISPLAY_IDENTIFIER PV_AV_2_MON ECU_ADDRESS 0xc0001511 FORMAT "%9.6" /end MEASUREMENT
/begin MEASUREMENT lv_err_pvs_mon "Logical variable for different PVS diagnosis between L1 and L2" UBYTE _CNV_S_2_RANGE__0___1_CM 1 100. 0. 1. DISPLAY_IDENTIFIER LV_ERR_PVS_MON ECU_ADDRESS 0xd0002d70 BIT_MASK 0x1 /end MEASUREMENT
/begin MEASUREMENT pv_av_mon "Level 2 degree of activation of the accelerator pedal" UBYTE _CNV_A_R_LINEAR_____5_CM 1 100. 0. 99.609375 DISPLAY_IDENTIFIER PV_AV_MON ECU_ADDRESS 0xd0002d4d FORMAT "%9.6" /end MEASUREMENT
/begin CHARACTERISTIC c_n_min_pvs_diag_mon "Minimum engine speed for PVS diagnosis" VALUE 0xa1001030 _REC_VAL_20_u1 8160. _CNV_A_R_LINEAR_____9_CM 0. 8160. DISPLAY_IDENTIFIER C_N_MIN_PVS_DIAG_MON FORMAT "%4.0" /end CHARACTERISTIC
/begin CHARACTERISTIC c_abc_inc_pvs_ratio_mon "Anti bounce counter increment (additive value in case of error)" VALUE 0xa1000fdb _REC_VAL_20_u1 255. _CNV_A_R_LINEAR_____0_CM 0. 255. DISPLAY_IDENTIFIER C_ABC_INC_PVS_RATIO_MON FORMAT "%3.0" /end CHARACTERISTIC
/begin CHARACTERISTIC c_abc_max_pvs_ratio_mon "Value at which ratio error is recognized, when reached" VALUE 0xa1000ff7 _REC_VAL_20_u1 254. _CNV_A_R_LINEAR_____0_CM 1. 255. DISPLAY_IDENTIFIER C_ABC_MAX_PVS_RATIO_MON FORMAT "%3.0" /end CHARACTERISTIC
/begin CHARACTERISTIC c_v_pvs_is_thd_1_mon "Threshold for idle speed PVS channel 1" VALUE 0xa1001084 _REC_VAL_20_u2 4.9951171875 _CNV_A_R_LINEAR_____2_CM 0. 4.9951171875 DISPLAY_IDENTIFIER C_V_PVS_IS_THD_1_MON FORMAT "%5.3" /end CHARACTERISTIC
/begin CHARACTERISTIC c_v_pvs_is_thd_2_mon "Threshold for idle speed PVS channel 2" VALUE 0xa1001086 _REC_VAL_20_u2 4.9951171875 _CNV_A_R_LINEAR_____2_CM 0. 4.9951171875 DISPLAY_IDENTIFIER C_V_PVS_IS_THD_2_MON FORMAT "%5.3" /end CHARACTERISTIC
/begin CHARACTERISTIC c_v_pvs_slop_1_mon "Slope of the PVS channel 1" VALUE 0xa1001088 _REC_VAL_20_u1 79.6875 _CNV_A_R_LINEAR_____246_CM 0. 79.6875 DISPLAY_IDENTIFIER C_V_PVS_SLOP_1_MON FORMAT "%7.4" /end CHARACTERISTIC
/begin CHARACTERISTIC c_v_pvs_slop_2_mon "Slope of the PVS channel 2" VALUE 0xa1001089 _REC_VAL_20_u1 159.375 _CNV_A_R_ECM2_LINEA_851_CM 0. 159.375 DISPLAY_IDENTIFIER C_V_PVS_SLOP_2_MON FORMAT "%7.3" /end CHARACTERISTIC
/begin CHARACTERISTIC c_pv_lih_max_mon "Max. pedal position on case of any PVS error" VALUE 0xa100103a _REC_VAL_20_u1 99.609375 _CNV_A_R_LINEAR_____5_CM 0. 99.609375 DISPLAY_IDENTIFIER C_PV_LIH_MAX_MON FORMAT "%9.6" /end CHARACTERISTIC
/begin MEASUREMENT v_pvs_1_mon "Pedal value sensor 1 raw acquisition" UWORD _CNV_A_R_LINEAR_____2_CM 1 100. 0. 4.9951171875 DISPLAY_IDENTIFIER V_PVS_1_MON ECU_ADDRESS 0xd0002528 FORMAT "%5.3" /end MEASUREMENT
/begin MEASUREMENT v_pvs_2_mon "Pedal value sensor 2 raw acquisition" UWORD _CNV_A_R_LINEAR_____2_CM 1 100. 0. 4.9951171875 DISPLAY_IDENTIFIER V_PVS_2_MON ECU_ADDRESS 0xd000252a FORMAT "%5.3" /end MEASUREMENT
/begin CHARACTERISTIC ip_v_thd_ratio_chk_pvs_mon "Maximum PV ratio error allowed" CURVE 0xa1000fc6 _REC_CUR_20_u1_u1 4.98046875 _CNV_A_R_LINEAR_____195_CM 0. 4.98046875 DISPLAY_IDENTIFIER IP_V_THD_RATIO_CHK_PVS_MON FORMAT "%4.2"
 /begin AXIS_DESCR COM_AXIS online_dummy _CNV_A_R_LINEAR_____195_CM 6 0. 4.98046875 FORMAT "%4.2" AXIS_PTS_REF ldp_v_min_pv_mon_ip_v_pvs_mon /end AXIS_DESCR
/end CHARACTERISTIC
/begin AXIS_PTS ldp_v_min_pv_mon_ip_v_pvs_mon "" 0xa100095e online_dummy _REC_AXS_20_u1 4.98046875 _CNV_A_R_LINEAR_____195_CM 6 0. 4.98046875 FORMAT "%4.2" /end AXIS_PTS
/begin MEASUREMENT fac_v_slop_pvs_mon "Factor for correction of slop of channel 2 in ratio check" UBYTE _CNV_A_R_LINEAR_____283_CM 1 100. 0. 3.984375 DISPLAY_IDENTIFIER FAC_V_SLOP_PVS_MON ECU_ADDRESS 0xc00014f8 FORMAT "%8.6" /end MEASUREMENT
/begin MEASUREMENT tco_mon "Coolant temperature(monitoring level)" UBYTE _CNV_A_R_LINEAR_____16_CM 1 100. -48. 142.5 DISPLAY_IDENTIFIER TCO_MON ECU_ADDRESS 0xd0002d55 FORMAT "%6.2" /end MEASUREMENT
/begin MEASUREMENT t_tco_grd_mon "Timer for negative TCO gradient limitation" UBYTE _CNV_A_R_LINEAR_____279_CM 1 100. 0. 10.2 DISPLAY_IDENTIFIER T_TCO_GRD_MON ECU_ADDRESS 0xc0001523 FORMAT "%5.2" /end MEASUREMENT
/begin CHARACTERISTIC c_tco_grd_max_mon "Maximum negative gradient for the coolant temperature" VALUE 0xa1001052 _REC_VAL_20_u1 190.5 _CNV_A_R_LINEAR_____24_CM 0. 190.5 DISPLAY_IDENTIFIER C_TCO_GRD_MAX_MON FORMAT "%6.2" /end CHARACTERISTIC
/begin CHARACTERISTIC c_t_tco_grd_max_mon "Minimum time before a new change fo TCO_MON is allowed" VALUE 0xa1001050 _REC_VAL_20_u1 10.2 _CNV_A_R_LINEAR_____279_CM 0. 10.2 DISPLAY_IDENTIFIER C_T_TCO_GRD_MAX_MON FORMAT "%5.2" /end CHARACTERISTIC
/begin CHARACTERISTIC c_tco_thd_min_mon "Threshold for the min. TCO temp. while TCO_SUB is higher than C_TCO_SUB_THD_MAX_MON" VALUE 0xa1001056 _REC_VAL_20_u1 190.5 _CNV_A_R_LINEAR_____16_CM -48. 142.5 DISPLAY_IDENTIFIER C_TCO_THD_MIN_MON FORMAT "%6.2" /end CHARACTERISTIC
/begin CHARACTERISTIC c_tco_sub_thd_max_mon "Threshold for the max. TCO_SUB temp. while TCO is lower than C_TCO_THD_MIN_MON" VALUE 0xa1001054 _REC_VAL_20_u2 190.5 _CNV_A_R_LINEAR_____452_CM -48. 142.5 DISPLAY_IDENTIFIER C_TCO_SUB_THD_MAX_MON FORMAT "%7.3" /end CHARACTERISTIC
/begin MEASUREMENT tqi_av_mon "Actual indicated engine torque (process monitoring)" UBYTE _CNV_A_R_LINEAR_____280_CM 1 100. 0. 510. DISPLAY_IDENTIFIER TQI_AV_MON ECU_ADDRESS 0xd0002d58 FORMAT "%3.0" /end MEASUREMENT
/begin AXIS_PTS ldp_n_32_mon_ip_tqi_cus_mon "" 0xa1000854 n_32_mon _REC_AXS_20_u1 8160. _CNV_A_R_LINEAR_____9_CM 6 0. 8160. FORMAT "%4.0" /end AXIS_PTS
/begin AXIS_PTS ldp_mff_mon_ip_tqi_cus_mon "" 0xa100080c online_dummy _REC_AXS_20_u2 1389. _CNV_A_R_LINEAR_____108_CM 8 0. 1389. FORMAT "%7.2" /end AXIS_PTS
/begin CHARACTERISTIC ip_tqi_cus_mon "Customer specific engine torque (process monitoring)" MAP 0xa1000f48 _REC_MAP_20_u1_u1_u2 510. _CNV_A_R_LINEAR_____280_CM 0. 510. DISPLAY_IDENTIFIER IP_TQI_CUS_MON FORMAT "%3.0"
 /begin AXIS_DESCR COM_AXIS n_32_mon _CNV_A_R_LINEAR_____9_CM 6 0. 8160. FORMAT "%4.0" AXIS_PTS_REF ldp_n_32_mon_ip_tqi_cus_mon /end AXIS_DESCR
 /begin AXIS_DESCR COM_AXIS online_dummy _CNV_A_R_LINEAR_____108_CM 8 0. 1389. FORMAT "%7.2" AXIS_PTS_REF ldp_mff_mon_ip_tqi_cus_mon /end AXIS_DESCR
/end CHARACTERISTIC
/begin MEASUREMENT t_tqi_mon "dead time counter for torque decrease" UBYTE _CNV_A_R_LINEAR_____279_CM 1 100. 0. 10.2 DISPLAY_IDENTIFIER T_TQI_MON ECU_ADDRESS 0xc0001525 FORMAT "%5.2" /end MEASUREMENT
/begin CHARACTERISTIC c_t_tqi_mon "Dead time for torque decrease" VALUE 0xa1001051 _REC_VAL_20_u1 10.2 _CNV_A_R_LINEAR_____279_CM 0. 10.2 DISPLAY_IDENTIFIER C_T_TQI_MON FORMAT "%5.2" /end CHARACTERISTIC
/begin MEASUREMENT fac_tq_req_mon "scaling factor for requested torque at clutch from driver and cruise control" UBYTE _CNV_A_R_LINEAR_____100_CM 1 100. 0. 1.9921875 DISPLAY_IDENTIFIER FAC_TQ_REQ_MON ECU_ADDRESS 0xd0002d43 FORMAT "%8.6" /end MEASUREMENT
/begin MEASUREMENT tqi_req_tot_mon "desired non-filtered indicated engine torque" UBYTE _CNV_A_R_LINEAR_____280_CM 1 100. 0. 510. DISPLAY_IDENTIFIER TQI_REQ_TOT_MON ECU_ADDRESS 0xc0001533 FORMAT "%3.0" /end MEASUREMENT
/begin MEASUREMENT tqi_sp_mon "desired indicated engine torque" UBYTE _CNV_A_R_LINEAR_____280_CM 1 100. 0. 510. DISPLAY_IDENTIFIER TQI_SP_MON ECU_ADDRESS 0xd0002d5b FORMAT "%3.0" /end MEASUREMENT
/begin MEASUREMENT fac_tq_req_driv_mon "scaling factor for requested torque at clutch from driver" UBYTE _CNV_A_R_LINEAR_____100_CM 1 100. 0. 1.9921875 DISPLAY_IDENTIFIER FAC_TQ_REQ_DRIV_MON ECU_ADDRESS 0xd0002d42 FORMAT "%8.6" /end MEASUREMENT
/begin CHARACTERISTIC ip_fac_tq_req_driv_mon "Scaling factor for requested torque at clutch from driver" MAP 0xa1000c20 _REC_MAP_20_u1_u1_u1 1.9921875 _CNV_A_R_LINEAR_____100_CM 0. 1.9921875 DISPLAY_IDENTIFIER IP_FAC_TQ_REQ_DRIV_MON FORMAT "%8.6"
 /begin AXIS_DESCR COM_AXIS n_32_mon _CNV_A_R_LINEAR_____9_CM 8 0. 8160. FORMAT "%4.0" AXIS_PTS_REF ldpm_n_32_mon_ip_fac_tq_mon /end AXIS_DESCR
 /begin AXIS_DESCR COM_AXIS pv_av_ad_mon _CNV_A_R_LINEAR_____5_CM 8 0. 99.609375 FORMAT "%9.6" AXIS_PTS_REF ldpm_pv_av_ad_mon_ip_fac_mon /end AXIS_DESCR
/end CHARACTERISTIC
/begin CHARACTERISTIC c_crlc_tqi_sp_mon "filter constant for realization of first order filter" VALUE 0xa1001007 _REC_VAL_20_u1 0.99609375 _CNV_A_R_LINEAR_____27_CM 0. 0.99609375 DISPLAY_IDENTIFIER C_CRLC_TQI_SP_MON FORMAT "%5.3" /end CHARACTERISTIC
/begin CHARACTERISTIC ip_fac_tq_req_driv_1_mon "Scaling factor for requested torque at clutch from driver in other mode" MAP 0xa1000be0 _REC_MAP_20_u1_u1_u1 1.9921875 _CNV_A_R_LINEAR_____100_CM 0. 1.9921875 DISPLAY_IDENTIFIER IP_FAC_TQ_REQ_DRIV_1_MON FORMAT "%8.6"
 /begin AXIS_DESCR COM_AXIS n_32_mon _CNV_A_R_LINEAR_____9_CM 8 0. 8160. FORMAT "%4.0" AXIS_PTS_REF ldpm_n_32_mon_ip_fac_tq_mon /end AXIS_DESCR
 /begin AXIS_DESCR COM_AXIS pv_av_ad_mon _CNV_A_R_LINEAR_____5_CM 8 0. 99.609375 FORMAT "%9.6" AXIS_PTS_REF ldpm_pv_av_ad_mon_ip_fac_mon /end AXIS_DESCR
/end CHARACTERISTIC
/begin MEASUREMENT abc_tq_loss_mon "Anti bounce counter for monitoring of torque losses" UBYTE _CNV_A_R_LINEAR_____0_CM 1 100. 0. 255. DISPLAY_IDENTIFIER ABC_TQ_LOSS_MON ECU_ADDRESS 0xc00014e2 FORMAT "%3.0" /end MEASUREMENT
/begin MEASUREMENT lv_err_tq_loss_mon "Fault currently present in torque generation, symptom 'torque losses'" UBYTE _CNV_S_2_RANGE__0___1_CM 1 100. 0. 1. DISPLAY_IDENTIFIER LV_ERR_TQ_LOSS_MON ECU_ADDRESS 0xd0002d78 BIT_MASK 0x1 /end MEASUREMENT
/begin MEASUREMENT tq_loss_mon "Torque losses" SWORD _CNV_A_R_LINEAR_____30_CM 1 100. -1024. 1023.96875 DISPLAY_IDENTIFIER TQ_LOSS_MON ECU_ADDRESS 0xd0002516 FORMAT "%11.5" /end MEASUREMENT
/begin MEASUREMENT tq_loss_req_clu_mon "Torque losses without pumping losses" SWORD _CNV_A_R_LINEAR_____30_CM 1 100. -1024. 1023.96875 DISPLAY_IDENTIFIER TQ_LOSS_REQ_CLU_MON ECU_ADDRESS 0xd0002518 FORMAT "%11.5" /end MEASUREMENT
/begin MEASUREMENT tq_loss_mmv_mon "filtered TQ_LOSS" SWORD _CNV_A_R_LINEAR_____30_CM 1 100. -1024. 1023.96875 DISPLAY_IDENTIFIER TQ_LOSS_MMV_MON ECU_ADDRESS 0xc00014a6 FORMAT "%11.5" /end MEASUREMENT
/begin MEASUREMENT tq_loss_dif_mon "difference of monitored and modelled torque losses" SWORD _CNV_A_R_LINEAR_____30_CM 1 100. -1024. 1023.96875 DISPLAY_IDENTIFIER TQ_LOSS_DIF_MON ECU_ADDRESS 0xc00014a2 FORMAT "%11.5" /end MEASUREMENT
/begin MEASUREMENT tq_loss_mdl_mon "modelled torque losses" SWORD _CNV_A_R_LINEAR_____30_CM 1 100. -1024. 1023.96875 DISPLAY_IDENTIFIER TQ_LOSS_MDL_MON ECU_ADDRESS 0xc00014a4 FORMAT "%11.5" /end MEASUREMENT
/begin AXIS_PTS ldp_maf_mon_ip_tqfr_mon "" 0xa10007f2 maf_mon _REC_AXS_20_u1 1389. _CNV_A_R_LINEAR_____14_CM 5 0. 1389. FORMAT "%4.0" /end AXIS_PTS
/begin AXIS_PTS ldp_n_32_mon_ip_tqfr_mon "" 0xa100084e n_32_mon _REC_AXS_20_u1 8160. _CNV_A_R_LINEAR_____9_CM 5 0. 8160. FORMAT "%4.0" /end AXIS_PTS
/begin AXIS_PTS ldp_tco_mon_ip_tqfr_add_mon "" 0xa10008d2 tco_mon _REC_AXS_20_u1 190.5 _CNV_A_R_LINEAR_____16_CM 5 -48. 142.5 FORMAT "%6.2" /end AXIS_PTS
/begin CHARACTERISTIC ip_tqfr_mon "base friction torque and pumping losses" MAP 0xa1000f2c _REC_MAP_20_u1_u1_u1 510. _CNV_A_R_LINEAR_____280_CM 0. 510. DISPLAY_IDENTIFIER IP_TQFR_MON FORMAT "%3.0"
 /begin AXIS_DESCR COM_AXIS n_32_mon _CNV_A_R_LINEAR_____9_CM 5 0. 8160. FORMAT "%4.0" AXIS_PTS_REF ldp_n_32_mon_ip_tqfr_mon /end AXIS_DESCR
 /begin AXIS_DESCR COM_AXIS maf_mon _CNV_A_R_LINEAR_____14_CM 5 0. 1389. FORMAT "%4.0" AXIS_PTS_REF ldp_maf_mon_ip_tqfr_mon /end AXIS_DESCR
/end CHARACTERISTIC
/begin CHARACTERISTIC ip_tqfr_add_mon "coolant temperature correction of friction torque" CURVE 0xa1000f24 _REC_CUR_20_u1_u1 510. _CNV_A_R_LINEAR_____280_CM 0. 510. DISPLAY_IDENTIFIER IP_TQFR_ADD_MON FORMAT "%3.0"
 /begin AXIS_DESCR COM_AXIS tco_mon _CNV_A_R_LINEAR_____16_CM 5 -48. 142.5 FORMAT "%6.2" AXIS_PTS_REF ldp_tco_mon_ip_tqfr_add_mon /end AXIS_DESCR
/end CHARACTERISTIC
/begin CHARACTERISTIC c_abc_inc_tq_loss_mon "anti bounce counter increment" VALUE 0xa1000fe2 _REC_VAL_20_u1 255. _CNV_A_R_LINEAR_____0_CM 0. 255. DISPLAY_IDENTIFIER C_ABC_INC_TQ_LOSS_MON FORMAT "%3.0" /end CHARACTERISTIC
/begin CHARACTERISTIC c_abc_max_tq_loss_mon "maximum of anti bounce counter" VALUE 0xa1000ffe _REC_VAL_20_u1 254. _CNV_A_R_LINEAR_____0_CM 1. 255. DISPLAY_IDENTIFIER C_ABC_MAX_TQ_LOSS_MON FORMAT "%3.0" /end CHARACTERISTIC
/begin CHARACTERISTIC c_crlc_tq_loss_req_clu_mon "correlation constant for TQ_LOSS  filtering" VALUE 0xa1001006 _REC_VAL_20_u1 0.99609375 _CNV_A_R_LINEAR_____27_CM 0. 0.99609375 DISPLAY_IDENTIFIER C_CRLC_TQ_LOSS_REQ_CLU_MON FORMAT "%5.3" /end CHARACTERISTIC
/begin CHARACTERISTIC c_tq_loss_dif_max_mon "threshold for tq_loss deviation" VALUE 0xa1001074 _REC_VAL_20_s1 510. _CNV_A_R_LINEAR_____280_CM -256. 254. DISPLAY_IDENTIFIER C_TQ_LOSS_DIF_MAX_MON FORMAT "%4.0" /end CHARACTERISTIC
/begin CHARACTERISTIC c_tq_is_ad_min_mon "min. limitation of engine torque losses adaptation" VALUE 0xa100106c _REC_VAL_20_s1 510. _CNV_A_R_LINEAR_____280_CM -256. 254. DISPLAY_IDENTIFIER C_TQ_IS_AD_MIN_MON FORMAT "%4.0" /end CHARACTERISTIC
/begin MEASUREMENT lv_err_tq_max_clu_mon "Fault currently present in torque generation, symptom 'maximum torque at clutch'" UBYTE _CNV_S_2_RANGE__0___1_CM 1 100. 0. 1. DISPLAY_IDENTIFIER LV_ERR_TQ_MAX_CLU_MON ECU_ADDRESS 0xd0002d79 BIT_MASK 0x1 /end MEASUREMENT
/begin MEASUREMENT abc_tq_max_clu_mon "Anti bounce counter for monitoring of maximum torque at clutch" UBYTE _CNV_A_R_LINEAR_____0_CM 1 100. 0. 255. DISPLAY_IDENTIFIER ABC_TQ_MAX_CLU_MON ECU_ADDRESS 0xc00014e3 FORMAT "%3.0" /end MEASUREMENT
/begin MEASUREMENT tq_max_clu_max_mon "model value for maximum torque at clutch" SWORD _CNV_A_R_LINEAR_____30_CM 1 100. -1024. 1023.96875 DISPLAY_IDENTIFIER TQ_MAX_CLU_MAX_MON ECU_ADDRESS 0xc00014b4 FORMAT "%11.5" /end MEASUREMENT
/begin CHARACTERISTIC c_abc_max_tq_max_clu_mon "Maximum of anti bounce counter" VALUE 0xa1000fff _REC_VAL_20_u1 254. _CNV_A_R_LINEAR_____0_CM 1. 255. DISPLAY_IDENTIFIER C_ABC_MAX_TQ_MAX_CLU_MON FORMAT "%3.0" /end CHARACTERISTIC
/begin MEASUREMENT tq_max_clu_mon "monitored maximum torque at clutch" SWORD _CNV_A_R_LINEAR_____30_CM 1 100. -1024. 1023.96875 DISPLAY_IDENTIFIER TQ_MAX_CLU_MON ECU_ADDRESS 0xd000251a FORMAT "%11.5" /end MEASUREMENT
/begin MEASUREMENT tq_max_clu_dif_mon "Difference between monitored and modelled maximum torque at clutch" SWORD _CNV_A_R_LINEAR_____30_CM 1 100. -1024. 1023.96875 DISPLAY_IDENTIFIER TQ_MAX_CLU_DIF_MON ECU_ADDRESS 0xc00014b2 FORMAT "%11.5" /end MEASUREMENT
/begin MEASUREMENT fac_cha_max_mon "Ratio between the optimal and real air efficiency" UWORD _CNV_A_R_LINEAR_____8_CM 1 100. 0. 1.99996948242188 DISPLAY_IDENTIFIER FAC_CHA_MAX_MON ECU_ADDRESS 0xc0001464 FORMAT "%7.5" /end MEASUREMENT
/begin MEASUREMENT fac_cus_tq_max_mon "Model value of the output factor from the crossfade calculation" UWORD _CNV_A_R_LINEAR_____8_CM 1 100. 0. 1.99996948242188 DISPLAY_IDENTIFIER FAC_CUS_TQ_MAX_MON ECU_ADDRESS 0xc0001466 FORMAT "%7.5" /end MEASUREMENT
/begin CHARACTERISTIC c_abc_inc_tq_max_clu_mon "Anti bounce counter increment" VALUE 0xa1000fe3 _REC_VAL_20_u1 255. _CNV_A_R_LINEAR_____0_CM 0. 255. DISPLAY_IDENTIFIER C_ABC_INC_TQ_MAX_CLU_MON FORMAT "%3.0" /end CHARACTERISTIC
/begin CHARACTERISTIC c_ofs_tia_mon "Offset reflecting the sound velocity influence" VALUE 0xa1001036 _REC_VAL_20_u2 1.99996948242188 _CNV_A_R_LINEAR_____8_CM 0. 1.99996948242188 DISPLAY_IDENTIFIER C_OFS_TIA_MON FORMAT "%7.5" /end CHARACTERISTIC
/begin AXIS_PTS ldp_n_32_mon_ip_tqi_max_mon "" 0xa100085c n_32_mon _REC_AXS_20_u1 8160. _CNV_A_R_LINEAR_____9_CM 7 0. 8160. FORMAT "%4.0" /end AXIS_PTS
/begin AXIS_PTS ldp_fac_tq_req_mon__tq_max_mon "" 0xa100079a fac_tq_req_mon _REC_AXS_20_u1 1.9921875 _CNV_A_R_LINEAR_____100_CM 6 0. 1.9921875 FORMAT "%8.6" /end AXIS_PTS
/begin CHARACTERISTIC ip_tqi_ref_max_mon "Maximum reference indicated engine torque" CURVE 0xa1000fb8 _REC_CUR_20_u2_u1 1023.96875 _CNV_A_R_LINEAR_____30_CM 0. 1023.96875 DISPLAY_IDENTIFIER IP_TQI_REF_MAX_MON FORMAT "%10.5"
 /begin AXIS_DESCR COM_AXIS n_32_mon _CNV_A_R_LINEAR_____9_CM 7 0. 8160. FORMAT "%4.0" AXIS_PTS_REF ldp_n_32_mon_ip_tqi_max_mon /end AXIS_DESCR
/end CHARACTERISTIC
/begin CHARACTERISTIC ip_fac_cha_max_fac_tq_req_mon "Weighting factor for TQ_MAX_MON correction" CURVE 0xa1000afe _REC_CUR_20_u1_u1 0.99609375 _CNV_A_R_LINEAR_____27_CM 0. 0.99609375 DISPLAY_IDENTIFIER IP_FAC_CHA_MAX_FAC_TQ_REQ_MON FORMAT "%5.3"
 /begin AXIS_DESCR COM_AXIS fac_tq_req_mon _CNV_A_R_LINEAR_____100_CM 6 0. 1.9921875 FORMAT "%8.6" AXIS_PTS_REF ldp_fac_tq_req_mon__tq_max_mon /end AXIS_DESCR
/end CHARACTERISTIC
/begin CHARACTERISTIC ip_fac_cha_max_1_mon "Maximum relative cylinder filling by full load under normal conditions" CURVE 0xa1000ad0 _REC_CUR_20_u2_u1 655.35 _CNV_A_R_ECM2_LINEA_852_CM -327.68 327.67 DISPLAY_IDENTIFIER IP_FAC_CHA_MAX_1_MON FORMAT "%7.2"
 /begin AXIS_DESCR COM_AXIS n_32 _CNV_A_R_LINEAR_____9_CM 11 0. 8160. FORMAT "%4.0" AXIS_PTS_REF ldpm_n_32_mon__fac_cha_mon /end AXIS_DESCR
/end CHARACTERISTIC
/begin CHARACTERISTIC ip_fac_cha_max_2_mon "Maximum relative cylinder filling" CURVE 0xa1000ae8 _REC_CUR_20_u2_u1 655.35 _CNV_A_R_ECM2_LINEA_852_CM -327.68 327.67 DISPLAY_IDENTIFIER IP_FAC_CHA_MAX_2_MON FORMAT "%7.2"
 /begin AXIS_DESCR COM_AXIS n_32 _CNV_A_R_LINEAR_____9_CM 11 0. 8160. FORMAT "%4.0" AXIS_PTS_REF ldpm_n_32_mon__fac_cha_mon /end AXIS_DESCR
/end CHARACTERISTIC
/begin MEASUREMENT fac_n_sp_is_ratio_mon "Model of control factor for engine self-stabilising effect" SWORD _CNV_A_R_LINEAR_____115_CM 1 100. -8. 7.999755859375 DISPLAY_IDENTIFIER FAC_N_SP_IS_RATIO_MON ECU_ADDRESS 0xc0001468 FORMAT "%7.4" /end MEASUREMENT
/begin MEASUREMENT tq_st_mon "modelled value of start torque" UWORD _CNV_A_R_LINEAR_____30_CM 1 100. 0. 1023.96875 DISPLAY_IDENTIFIER TQ_ST_MON ECU_ADDRESS 0xc00014c0 FORMAT "%10.5" /end MEASUREMENT
/begin MEASUREMENT state_err_tq_min_clu_mon "State variable indicating origin of error resulting from monitoring of L1 torque value" UBYTE _CNV_S_3_ECM2_RANGE_853_CM 1 100. 0. 2. DISPLAY_IDENTIFIER STATE_ERR_TQ_MIN_CLU_MON ECU_ADDRESS 0xd0002d51 /end MEASUREMENT
/begin MEASUREMENT lv_err_tq_min_clu_mon "Fault currently present in torque generation, symptom 'minimum torque at clutch'" UBYTE _CNV_S_2_RANGE__0___1_CM 1 100. 0. 1. DISPLAY_IDENTIFIER LV_ERR_TQ_MIN_CLU_MON ECU_ADDRESS 0xd0002d7a BIT_MASK 0x1 /end MEASUREMENT
/begin MEASUREMENT abc_tq_min_clu_mon "Anti bounce counter for monitoring of minimum torque at clutch" UBYTE _CNV_A_R_LINEAR_____0_CM 1 100. 0. 255. DISPLAY_IDENTIFIER ABC_TQ_MIN_CLU_MON ECU_ADDRESS 0xc00014e4 FORMAT "%3.0" /end MEASUREMENT
/begin MEASUREMENT tq_min_clu_mdl_2_mon "Temporary variable 2 for calculation of modelled minimum torque at clutch" SWORD _CNV_A_R_LINEAR_____30_CM 1 100. -1024. 1023.96875 DISPLAY_IDENTIFIER TQ_MIN_CLU_MDL_2_MON ECU_ADDRESS 0xc00014ba FORMAT "%11.5" /end MEASUREMENT
/begin AXIS_PTS ldp_n_sp_is_ratio_mon_ip_mon "" 0xa1000898 n_sp_is_ratio_mon _REC_AXS_20_u2 7.9998779296875 _CNV_A_R_LINEAR_____113_CM 5 0. 7.9998779296875 FORMAT "%6.4" /end AXIS_PTS
/begin CHARACTERISTIC ip_fac_n_sp_is_ratio_mon "Idle self stabilising factor" CURVE 0xa1000b5c _REC_CUR_20_u2_u2 15.999755859375 _CNV_A_R_ECM2_LINEA_854_CM -8. 7.999755859375 DISPLAY_IDENTIFIER IP_FAC_N_SP_IS_RATIO_MON FORMAT "%6.5"
 /begin AXIS_DESCR COM_AXIS n_sp_is_ratio_mon _CNV_A_R_LINEAR_____113_CM 5 0. 7.9998779296875 FORMAT "%6.4" AXIS_PTS_REF ldp_n_sp_is_ratio_mon_ip_mon /end AXIS_DESCR
/end CHARACTERISTIC
/begin AXIS_PTS ldp_n_32_mon_ip_tqi_min_mon "" 0xa1000864 n_32_mon _REC_AXS_20_u1 8160. _CNV_A_R_LINEAR_____9_CM 6 0. 8160. FORMAT "%4.0" /end AXIS_PTS
/begin AXIS_PTS ldp_tco_mon_ip_tqi_min_pu_mon "" 0xa10008d8 tco_mon _REC_AXS_20_u1 190.5 _CNV_A_R_LINEAR_____16_CM 4 -48. 142.5 FORMAT "%6.2" /end AXIS_PTS
/begin CHARACTERISTIC ip_tqi_min_req_pu_mon "Minimum requested indicated torque in PU phase" MAP 0xa1000f88 _REC_MAP_20_u2_u1_u1 1023.96875 _CNV_A_R_LINEAR_____30_CM 0. 1023.96875 DISPLAY_IDENTIFIER IP_TQI_MIN_REQ_PU_MON FORMAT "%10.5"
 /begin AXIS_DESCR COM_AXIS n_32_mon _CNV_A_R_LINEAR_____9_CM 6 0. 8160. FORMAT "%4.0" AXIS_PTS_REF ldp_n_32_mon_ip_tqi_min_mon /end AXIS_DESCR
 /begin AXIS_DESCR COM_AXIS tco_mon _CNV_A_R_LINEAR_____16_CM 4 -48. 142.5 FORMAT "%6.2" AXIS_PTS_REF ldp_tco_mon_ip_tqi_min_pu_mon /end AXIS_DESCR
/end CHARACTERISTIC
/begin CHARACTERISTIC c_n_st_max_mon "maximum start end speed" VALUE 0xa1001033 _REC_VAL_20_u1 8160. _CNV_A_R_LINEAR_____9_CM 0. 8160. DISPLAY_IDENTIFIER C_N_ST_MAX_MON FORMAT "%4.0" /end CHARACTERISTIC
/begin CHARACTERISTIC c_abc_inc_tq_min_clu_mon "Anti bounce counter increment" VALUE 0xa1000fe4 _REC_VAL_20_u1 255. _CNV_A_R_LINEAR_____0_CM 0. 255. DISPLAY_IDENTIFIER C_ABC_INC_TQ_MIN_CLU_MON FORMAT "%3.0" /end CHARACTERISTIC
/begin MEASUREMENT tq_min_clu_dif_mon "difference of monitored and modelled minimum torque at clutch" SWORD _CNV_A_R_LINEAR_____30_CM 1 100. -1024. 1023.96875 DISPLAY_IDENTIFIER TQ_MIN_CLU_DIF_MON ECU_ADDRESS 0xc00014b8 FORMAT "%11.5" /end MEASUREMENT
/begin MEASUREMENT tq_min_clu_mon "monitored minimum torque at clutch" SWORD _CNV_A_R_LINEAR_____30_CM 1 100. -1024. 1023.96875 DISPLAY_IDENTIFIER TQ_MIN_CLU_MON ECU_ADDRESS 0xd000251c FORMAT "%11.5" /end MEASUREMENT
/begin MEASUREMENT tq_min_clu_mdl_5_mon "Temporary variable 4 for calculation of modelled minimum torque at clutch" SWORD _CNV_A_R_LINEAR_____30_CM 1 100. -1024. 1023.96875 DISPLAY_IDENTIFIER TQ_MIN_CLU_MDL_5_MON ECU_ADDRESS 0xc00014bc FORMAT "%11.5" /end MEASUREMENT
/begin CHARACTERISTIC c_abc_max_tq_min_clu_mon "Maximum of anti bounce counter" VALUE 0xa1001000 _REC_VAL_20_u1 254. _CNV_A_R_LINEAR_____0_CM 1. 255. DISPLAY_IDENTIFIER C_ABC_MAX_TQ_MIN_CLU_MON FORMAT "%3.0" /end CHARACTERISTIC
/begin CHARACTERISTIC c_tq_min_clu_mdl_ofs_mon "Offset for L2 model value of minimum torque at clutch" VALUE 0xa100107a _REC_VAL_20_s2 2047.96875 _CNV_A_R_LINEAR_____30_CM -1024. 1023.96875 DISPLAY_IDENTIFIER C_TQ_MIN_CLU_MDL_OFS_MON FORMAT "%11.5" /end CHARACTERISTIC
/begin MEASUREMENT ctr_dly_tq_st_mon "Delay time counter for holding start torque influence" UBYTE _CNV_A_R_LINEAR_____279_CM 1 100. 0. 10.2 DISPLAY_IDENTIFIER CTR_DLY_TQ_ST_MON ECU_ADDRESS 0xc00014ea FORMAT "%5.2" /end MEASUREMENT
/begin CHARACTERISTIC c_dly_tq_st_mon "Time delay to hold influence of start torque on TQ_MIN_CLU model value" VALUE 0xa1001008 _REC_VAL_20_u1 10.2 _CNV_A_R_LINEAR_____279_CM 0. 10.2 DISPLAY_IDENTIFIER C_DLY_TQ_ST_MON FORMAT "%5.2" /end CHARACTERISTIC
/begin MEASUREMENT eff_tot_mon "total actual efficiencies" UBYTE _CNV_A_R_LINEAR_____100_CM 1 100. 0. 1.9921875 DISPLAY_IDENTIFIER EFF_TOT_MON ECU_ADDRESS 0xd0002d1c FORMAT "%8.6" /end MEASUREMENT
/begin MEASUREMENT eff_iga_hom_mon "ignition efficiency in homogeneous (process monitoring)" UBYTE _CNV_A_R_LINEAR_____100_CM 1 100. 0. 1.9921875 DISPLAY_IDENTIFIER EFF_IGA_HOM_MON ECU_ADDRESS 0xc00014ed FORMAT "%8.6" /end MEASUREMENT
/begin MEASUREMENT eff_iga_s_mon "ignition efficiency in stratified (process monitoring)" UBYTE _CNV_A_R_LINEAR_____100_CM 1 100. 0. 1.9921875 DISPLAY_IDENTIFIER EFF_IGA_S_MON ECU_ADDRESS 0xc00014f0 FORMAT "%8.6" /end MEASUREMENT
/begin MEASUREMENT eff_lamb_hom_mon "lambda efficiency in homogeneous (process monitoring)" UBYTE _CNV_A_R_LINEAR_____100_CM 1 100. 0. 1.9921875 DISPLAY_IDENTIFIER EFF_LAMB_HOM_MON ECU_ADDRESS 0xc00014f1 FORMAT "%8.6" /end MEASUREMENT
/begin MEASUREMENT eff_lamb_s_mon "lambda efficiency in stratified homogeneous (process monitoring)" UBYTE _CNV_A_R_LINEAR_____100_CM 1 100. 0. 1.9921875 DISPLAY_IDENTIFIER EFF_LAMB_S_MON ECU_ADDRESS 0xc00014f3 FORMAT "%8.6" /end MEASUREMENT
/begin MEASUREMENT iga_dif_av_hom_mon "difference from reference to actual ignition angle in homogeneous (process monitoring)" UBYTE _CNV_A_R_LINEAR_____174_CM 1 100. 0. -95.625 DISPLAY_IDENTIFIER IGA_DIF_AV_HOM_MON ECU_ADDRESS 0xc00014f9 FORMAT "%7.3" /end MEASUREMENT
/begin CHARACTERISTIC ip_eff_iga_hom_mon "actual ignition efficiency in homogeneous (process monitoring)" CURVE 0xa1000a20 _REC_CUR_20_u1_u1 99.609375 _CNV_A_R_LINEAR_____5_CM 0. 99.609375 DISPLAY_IDENTIFIER IP_EFF_IGA_HOM_MON FORMAT "%9.6"
 /begin AXIS_DESCR COM_AXIS iga_dif_av_hom_mon _CNV_A_R_LINEAR_____174_CM 8 0. -95.625 FORMAT "%7.3" AXIS_PTS_REF ldpm_iga_dif_av_mon_ip_eff_mon /end AXIS_DESCR
/end CHARACTERISTIC
/begin CHARACTERISTIC ip_eff_lamb_hom_mon "lambda efficiency in homogeneous (process monitoring)" CURVE 0xa1000a30 _REC_CUR_20_u1_u2 1.9921875 _CNV_A_R_LINEAR_____100_CM 0. 1.9921875 DISPLAY_IDENTIFIER IP_EFF_LAMB_HOM_MON FORMAT "%8.6"
 /begin AXIS_DESCR COM_AXIS lamb_mon _CNV_A_R_LINEAR_____122_CM 8 0. 31.9990234375 FORMAT "%7.4" AXIS_PTS_REF ldp_lamb_hom_mon_ip_eff_mon /end AXIS_DESCR
/end CHARACTERISTIC
/begin CHARACTERISTIC ip_eff_lamb_s_mon "lambda efficiency in stratified (process monitoring)" CURVE 0xa1000a40 _REC_CUR_20_u1_u2 1.9921875 _CNV_A_R_LINEAR_____100_CM 0. 1.9921875 DISPLAY_IDENTIFIER IP_EFF_LAMB_S_MON FORMAT "%8.6"
 /begin AXIS_DESCR COM_AXIS lamb_mon _CNV_A_R_LINEAR_____122_CM 8 0. 31.9990234375 FORMAT "%7.4" AXIS_PTS_REF ldp_lamb_s_mon_ip_eff_mon /end AXIS_DESCR
/end CHARACTERISTIC
/begin CHARACTERISTIC ip_iga_ref_hom_mon "reference ignition angle in homogeneous (process monitoring)" MAP 0xa1000c60 _REC_MAP_20_u1_u1_u1 95.625 _CNV_A_R_LINEAR_____167_CM -35.625 60. DISPLAY_IDENTIFIER IP_IGA_REF_HOM_MON FORMAT "%7.3"
 /begin AXIS_DESCR COM_AXIS n_32 _CNV_A_R_LINEAR_____9_CM 8 0. 8160. FORMAT "%4.0" AXIS_PTS_REF ldpm_n_32_mon_ip_iga_ref_mon /end AXIS_DESCR
 /begin AXIS_DESCR COM_AXIS maf_mon _CNV_A_R_LINEAR_____14_CM 8 0. 1389. FORMAT "%4.0" AXIS_PTS_REF ldp_maf_mon_ip_iga_ref_mon /end AXIS_DESCR
/end CHARACTERISTIC
/begin MEASUREMENT eff_iga_homs_mon "ignition efficiency in multiple homogeneous_stratified (process monitoring)" UBYTE _CNV_A_R_LINEAR_____100_CM 1 100. 0. 1.9921875 DISPLAY_IDENTIFIER EFF_IGA_HOMS_MON ECU_ADDRESS 0xc00014ee FORMAT "%8.6" /end MEASUREMENT
/begin MEASUREMENT eff_lamb_homs_mon "lambda efficiency in multiple homogeneous_stratified (process monitoring)" UBYTE _CNV_A_R_LINEAR_____100_CM 1 100. 0. 1.9921875 DISPLAY_IDENTIFIER EFF_LAMB_HOMS_MON ECU_ADDRESS 0xc00014f2 FORMAT "%8.6" /end MEASUREMENT
/begin MEASUREMENT iga_dif_av_homs_mon "difference from reference to actual ignition angle in multiple homogeneous_stratified (process monitoring)" UBYTE _CNV_A_R_LINEAR_____174_CM 1 100. 0. -95.625 DISPLAY_IDENTIFIER IGA_DIF_AV_HOMS_MON ECU_ADDRESS 0xc00014fa FORMAT "%7.3" /end MEASUREMENT
/begin CHARACTERISTIC ip_eff_iga_homs_mon "actual ignition efficiency in homogeneous_stratified (process monitoring)" CURVE 0xa1000a28 _REC_CUR_20_u1_u1 1.9921875 _CNV_A_R_LINEAR_____100_CM 0. 1.9921875 DISPLAY_IDENTIFIER IP_EFF_IGA_HOMS_MON FORMAT "%8.6"
 /begin AXIS_DESCR COM_AXIS iga_dif_av_hom_mon _CNV_A_R_LINEAR_____174_CM 8 0. -95.625 FORMAT "%7.3" AXIS_PTS_REF ldpm_iga_dif_av_mon_ip_eff_mon /end AXIS_DESCR
/end CHARACTERISTIC
/begin AXIS_PTS ldp_mff_mon_ip_iga_ref_mon "" 0xa10007f8 mff_tq_mon _REC_AXS_20_u2 1389. _CNV_A_R_LINEAR_____108_CM 8 0. 1389. FORMAT "%7.2" /end AXIS_PTS
/begin AXIS_PTS ldp_lamb_homs_mon_ip_eff_mon "" 0xa10007b8 lamb_mon _REC_AXS_20_u2 31.9990234375 _CNV_A_R_LINEAR_____122_CM 8 0. 31.9990234375 FORMAT "%7.4" /end AXIS_PTS
/begin CHARACTERISTIC ip_eff_lamb_homs_mon "lambda efficiency in homogeneous_stratified (process monitoring)" CURVE 0xa1000a38 _REC_CUR_20_u1_u2 1.9921875 _CNV_A_R_LINEAR_____100_CM 0. 1.9921875 DISPLAY_IDENTIFIER IP_EFF_LAMB_HOMS_MON FORMAT "%8.6"
 /begin AXIS_DESCR COM_AXIS lamb_mon _CNV_A_R_LINEAR_____122_CM 8 0. 31.9990234375 FORMAT "%7.4" AXIS_PTS_REF ldp_lamb_homs_mon_ip_eff_mon /end AXIS_DESCR
/end CHARACTERISTIC
/begin AXIS_PTS ldp_maf_mon_ip_iga_ref_mon "" 0xa10007e8 maf_mon _REC_AXS_20_u1 1389. _CNV_A_R_LINEAR_____14_CM 8 0. 1389. FORMAT "%4.0" /end AXIS_PTS
/begin AXIS_PTS ldp_maf_mon_ip_fac_eff_iga_mon "" 0xa10007de maf_mon _REC_AXS_20_u1 1389. _CNV_A_R_LINEAR_____14_CM 6 0. 1389. FORMAT "%4.0" /end AXIS_PTS
/begin AXIS_PTS ldp_n_32_mon_ip_fac_eff_iga_mon "" 0xa1000840 n_32_mon _REC_AXS_20_u1 8160. _CNV_A_R_LINEAR_____9_CM 6 0. 8160. FORMAT "%4.0" /end AXIS_PTS
/begin CHARACTERISTIC ip_iga_ref_homs_mon "reference ignition angle in multiple homogeneous (process monitoring)" MAP 0xa1000ca0 _REC_MAP_20_u1_u1_u2 95.625 _CNV_A_R_LINEAR_____167_CM -35.625 60. DISPLAY_IDENTIFIER IP_IGA_REF_HOMS_MON FORMAT "%7.3"
 /begin AXIS_DESCR COM_AXIS n_32 _CNV_A_R_LINEAR_____9_CM 8 0. 8160. FORMAT "%4.0" AXIS_PTS_REF ldpm_n_32_mon_ip_iga_ref_mon /end AXIS_DESCR
 /begin AXIS_DESCR COM_AXIS mff_tq_mon _CNV_A_R_LINEAR_____108_CM 8 0. 1389. FORMAT "%7.2" AXIS_PTS_REF ldp_mff_mon_ip_iga_ref_mon /end AXIS_DESCR
/end CHARACTERISTIC
/begin CHARACTERISTIC ip_fac_eff_iga_mon "factor ignition efficiency (process monitoring)" MAP 0xa1000b34 _REC_MAP_20_u1_u1_u1 15.9375 _CNV_A_R_EVAC_LINEA_314_CM 0. 15.9375 DISPLAY_IDENTIFIER IP_FAC_EFF_IGA_MON FORMAT "%7.4"
 /begin AXIS_DESCR COM_AXIS n_32_mon _CNV_A_R_LINEAR_____9_CM 6 0. 8160. FORMAT "%4.0" AXIS_PTS_REF ldp_n_32_mon_ip_fac_eff_iga_mon /end AXIS_DESCR
 /begin AXIS_DESCR COM_AXIS maf_mon _CNV_A_R_LINEAR_____14_CM 6 0. 1389. FORMAT "%4.0" AXIS_PTS_REF ldp_maf_mon_ip_fac_eff_iga_mon /end AXIS_DESCR
/end CHARACTERISTIC
/begin AXIS_PTS ldp_lamb_hom_mon_ip_eff_mon "" 0xa10007a4 lamb_mon _REC_AXS_20_u2 31.9990234375 _CNV_A_R_LINEAR_____122_CM 8 0. 31.9990234375 FORMAT "%7.4" /end AXIS_PTS
/begin AXIS_PTS ldp_lamb_s_mon_ip_eff_mon "" 0xa10007cc lamb_mon _REC_AXS_20_u2 31.9990234375 _CNV_A_R_LINEAR_____122_CM 8 0. 31.9990234375 FORMAT "%7.4" /end AXIS_PTS
/begin MEASUREMENT lamb_dif_mon "Deviation between actual and modeled Lambda" SWORD _CNV_A_R_LINEAR_____122_CM 1 100. -32. 31.9990234375 DISPLAY_IDENTIFIER LAMB_DIF_MON ECU_ADDRESS 0xd00024f6 FORMAT "%8.4" /end MEASUREMENT
/begin MEASUREMENT maf_mon "Mass air flow signal used monitoring level" UBYTE _CNV_A_R_LINEAR_____14_CM 1 100. 0. 1389. DISPLAY_IDENTIFIER MAF_MON ECU_ADDRESS 0xd0002d46 FORMAT "%4.0" /end MEASUREMENT
/begin MEASUREMENT lamb_mon "Modeled Lambda" UWORD _CNV_A_R_LINEAR_____122_CM 1 100. 0. 31.9990234375 DISPLAY_IDENTIFIER LAMB_MON ECU_ADDRESS 0xd00024f8 FORMAT "%7.4" /end MEASUREMENT
/begin MEASUREMENT lamb_mdl_dly_mon "Modeled Lambda signal after delay" UWORD _CNV_A_R_LINEAR_____122_CM 1 100. 0. 31.9990234375 DISPLAY_IDENTIFIER LAMB_MDL_DLY_MON ECU_ADDRESS 0xc000146c FORMAT "%7.4" /end MEASUREMENT
/begin MEASUREMENT lamb_mdl_sens_mon "Modeled Lambda sensor signal" UWORD _CNV_A_R_LINEAR_____122_CM 1 100. 0. 31.9990234375 DISPLAY_IDENTIFIER LAMB_MDL_SENS_MON ECU_ADDRESS 0xc000146e FORMAT "%7.4" /end MEASUREMENT
/begin CHARACTERISTIC c_thd_mff_min_mon "treshold for minimum injected fuel mass" VALUE 0xa1001060 _REC_VAL_20_u2 1389. _CNV_A_R_LINEAR_____108_CM 0. 1389. DISPLAY_IDENTIFIER C_THD_MFF_MIN_MON FORMAT "%7.2" /end CHARACTERISTIC
/begin CHARACTERISTIC c_fac_mff_maf_mon "Stoichiometric Constant for Lambda calculation" VALUE 0xa100100e _REC_VAL_20_u2 15.999755859375 _CNV_A_R_LINEAR_____115_CM 0. 15.999755859375 DISPLAY_IDENTIFIER C_FAC_MFF_MAF_MON FORMAT "%7.4" /end CHARACTERISTIC
/begin CHARACTERISTIC c_lamb_ref_mon "adjustable lambda reference" VALUE 0xa1001020 _REC_VAL_20_u2 31.9990234375 _CNV_A_R_LINEAR_____122_CM 0. 31.9990234375 DISPLAY_IDENTIFIER C_LAMB_REF_MON FORMAT "%7.4" /end CHARACTERISTIC
/begin CHARACTERISTIC lc_lamb_ref_mon "lambda reference selection" VALUE 0xa10010a3 _REC_VAL_20_u1 1. _CNV_A_R_LINEAR_____0_CM 0. 1. DISPLAY_IDENTIFIER LC_LAMB_REF_MON FORMAT "%1.0" /end CHARACTERISTIC
/begin COMPU_METHOD _CNV_A_R_LINEAR_____0_CM "" RAT_FUNC "%6.3" "-" COEFFS 0 1. 0. 0 0 1 /end COMPU_METHOD
/begin COMPU_METHOD _CNV_S_2_RANGE__0___1_CM "" TAB_VERB "%6.3" "-" COMPU_TAB_REF _CNV_S_2_RANGE__0___1 /end COMPU_METHOD
/begin COMPU_VTAB _CNV_S_2_RANGE__0___1 "" TAB_VERB 2 0 "0" 1 "1" /end COMPU_VTAB
/begin COMPU_METHOD _CNV_A_R_LINEAR_____2_CM "" RAT_FUNC "%6.3" "V" COEFFS 0 204.8 0. 0 0 1 /end COMPU_METHOD
/begin COMPU_METHOD _CNV_A_R_LINEAR_____5_CM "" RAT_FUNC "%6.3" "%" COEFFS 0 2.56 0. 0 0 1 /end COMPU_METHOD
/begin COMPU_METHOD _CNV_A_R_LINEAR_____8_CM "" RAT_FUNC "%6.3" "-" COEFFS 0 32767.99999999992 0. 0 0 1 /end COMPU_METHOD
/begin COMPU_METHOD _CNV_A_R_LINEAR_____9_CM "" RAT_FUNC "%6.3" "rpm" COEFFS 0 3.125e-002 0. 0 0 1 /end COMPU_METHOD
/begin COMPU_METHOD _CNV_A_R_LINEAR_____13_CM "" RAT_FUNC "%6.3" "rpm" COEFFS 0 1. 0. 0 0 1 /end COMPU_METHOD
/begin COMPU_METHOD _CNV_A_R_LINEAR_____14_CM "" RAT_FUNC "%6.3" "mg/stk" COEFFS 0 0.183585313174946 0. 0 0 1 /end COMPU_METHOD
/begin COMPU_METHOD _CNV_A_R_LINEAR_____16_CM "" RAT_FUNC "%6.3" "°C" COEFFS 0 1.333333333333333 64. 0 0 1 /end COMPU_METHOD
/begin COMPU_METHOD _CNV_A_R_LINEAR_____24_CM "" RAT_FUNC "%6.3" "°C" COEFFS 0 1.333333333333333 0. 0 0 1 /end COMPU_METHOD
/begin COMPU_METHOD _CNV_A_R_LINEAR_____27_CM "" RAT_FUNC "%6.3" "-" COEFFS 0 256. 0. 0 0 1 /end COMPU_METHOD
/begin COMPU_METHOD _CNV_A_R_LINEAR_____30_CM "" RAT_FUNC "%6.3" "Nm" COEFFS 0 32. 0. 0 0 1 /end COMPU_METHOD
/begin COMPU_METHOD _CNV_A_R_LINEAR_____36_CM "" RAT_FUNC "%6.3" "V" COEFFS 0 9.807692307692308 0. 0 0 1 /end COMPU_METHOD
/begin COMPU_METHOD _CNV_A_R_LINEAR_____60_CM "" RAT_FUNC "%6.3" "Nm" COEFFS 0 1. 0. 0 0 1 /end COMPU_METHOD
/begin COMPU_METHOD _CNV_A_R_LINEAR_____65_CM "" RAT_FUNC "%6.3" "Nm" COEFFS 0 32. 32768. 0 0 1 /end COMPU_METHOD
/begin COMPU_METHOD _CNV_A_R_LINEAR_____66_CM "" RAT_FUNC "%6.3" "km/h" COEFFS 0 128.0000018750286 0. 0 0 1 /end COMPU_METHOD
/begin COMPU_METHOD _CNV_A_R_LINEAR_____68_CM "" RAT_FUNC "%6.3" "-" COEFFS 0 65535.99999999996 0. 0 0 1 /end COMPU_METHOD
/begin COMPU_METHOD _CNV_A_R_LINEAR_____71_CM "" RAT_FUNC "%6.3" "" COEFFS 0 256. 0. 0 0 1 /end COMPU_METHOD
/begin COMPU_METHOD _CNV_A_R_LINEAR_____97_CM "" RAT_FUNC "%6.3" "-" COEFFS 0 127.9991955827809 0. 0 0 1 /end COMPU_METHOD
/begin COMPU_METHOD _CNV_A_R_LINEAR_____100_CM "" RAT_FUNC "%6.3" "-" COEFFS 0 128. 0. 0 0 1 /end COMPU_METHOD
/begin COMPU_METHOD _CNV_A_R_LINEAR_____108_CM "" RAT_FUNC "%6.3" "mg/stk" COEFFS 0 47.18142548596112 0. 0 0 1 /end COMPU_METHOD
/begin COMPU_METHOD _CNV_A_R_LINEAR_____113_CM "" RAT_FUNC "%6.3" "-" COEFFS 0 8192. 0. 0 0 1 /end COMPU_METHOD
/begin COMPU_METHOD _CNV_A_R_LINEAR_____114_CM "" RAT_FUNC "%6.3" "-" COEFFS 0 1023.999999959999 0. 0 0 1 /end COMPU_METHOD
/begin COMPU_METHOD _CNV_A_R_LINEAR_____115_CM "" RAT_FUNC "%6.3" "-" COEFFS 0 4096. 0. 0 0 1 /end COMPU_METHOD
/begin COMPU_METHOD _CNV_A_R_LINEAR_____122_CM "" RAT_FUNC "%6.3" "-" COEFFS 0 1024. 0. 0 0 1 /end COMPU_METHOD
/begin COMPU_METHOD _CNV_A_R_LINEAR_____123_CM "" RAT_FUNC "%6.3" "°C" COEFFS 0 16. 0. 0 0 1 /end COMPU_METHOD
/begin COMPU_METHOD _CNV_A_R_LINEAR_____167_CM "" RAT_FUNC "%6.3" "°CRK" COEFFS 0 2.666666666666667 95. 0 0 1 /end COMPU_METHOD
/begin COMPU_METHOD _CNV_A_R_LINEAR_____174_CM "" RAT_FUNC "%6.3" "°CRK" COEFFS 0 -2.666666666666667 0. 0 0 1 /end COMPU_METHOD
/begin COMPU_METHOD _CNV_A_R_LINEAR_____180_CM "" RAT_FUNC "%6.3" "rpm" COEFFS 0 3.125e-002 128. 0 0 1 /end COMPU_METHOD
/begin COMPU_METHOD _CNV_A_R_LINEAR_____195_CM "" RAT_FUNC "%6.3" "V" COEFFS 0 51.2 0. 0 0 1 /end COMPU_METHOD
/begin COMPU_METHOD _CNV_A_R_LINEAR_____204_CM "" RAT_FUNC "%6.3" "°C" COEFFS 0 16. 4370.4 0 0 1 /end COMPU_METHOD
/begin COMPU_METHOD _CNV_A_R_LINEAR_____207_CM "" RAT_FUNC "%6.3" "kg/h" COEFFS 0 32. 0. 0 0 1 /end COMPU_METHOD
/begin COMPU_METHOD _CNV_A_R_LINEAR_____225_CM "" RAT_FUNC "%6.3" "%" COEFFS 0 327.680000003584 32768.00000035841 0 0 1 /end COMPU_METHOD
/begin COMPU_METHOD _CNV_A_R_LINEAR_____246_CM "" RAT_FUNC "%6.3" "%/V" COEFFS 0 3.2 0. 0 0 1 /end COMPU_METHOD
/begin COMPU_METHOD _CNV_A_R_LINEAR_____247_CM "" RAT_FUNC "%6.3" "%/s" COEFFS 0 0.1024000154202376 128.000019275297 0 0 1 /end COMPU_METHOD
/begin COMPU_METHOD _CNV_A_R_LINEAR_____279_CM "" RAT_FUNC "%6.3" "s" COEFFS 0 25. 0. 0 0 1 /end COMPU_METHOD
/begin COMPU_METHOD _CNV_A_R_LINEAR_____280_CM "" RAT_FUNC "%6.3" "Nm" COEFFS 0 0.5 0. 0 0 1 /end COMPU_METHOD
/begin COMPU_METHOD _CNV_A_R_LINEAR_____283_CM "" RAT_FUNC "%6.3" "-" COEFFS 0 64. 0. 0 0 1 /end COMPU_METHOD
/begin COMPU_METHOD _CNV_A_R_LINEAR_____289_CM "Battery voltage" RAT_FUNC "%6.3" "V" COEFFS 0 9.846153846153847 0. 0 0 1 /end COMPU_METHOD
/begin COMPU_METHOD _CNV_A_R_EVAC_LINEA_314_CM "" RAT_FUNC "%6.3" "-" COEFFS 0 16. 0. 0 0 1 /end COMPU_METHOD
/begin COMPU_METHOD _CNV_A_R_EGCP_LINEA_349_CM "" RAT_FUNC "%6.3" "-" COEFFS 0 4. 0. 0 0 1 /end COMPU_METHOD
/begin COMPU_METHOD _CNV_A_R_LINEAR_____401_CM "" RAT_FUNC "%6.3" "µs" COEFFS 0 1. 0. 0 0 1 /end COMPU_METHOD
/begin COMPU_METHOD _CNV_A_R_LINEAR_____404_CM "" RAT_FUNC "%6.3" "-" COEFFS 0 100. 0. 0 0 1 /end COMPU_METHOD
/begin COMPU_METHOD _CNV_A_R_LINEAR_____452_CM "" RAT_FUNC "%6.3" "°C" COEFFS 0 341.3333333333333 16384. 0 0 1 /end COMPU_METHOD
/begin COMPU_METHOD _CNV_A_R_LINEAR_____459_CM "" RAT_FUNC "%6.3" "A" COEFFS 0 1. 0. 0 0 1 /end COMPU_METHOD
/begin COMPU_METHOD _CNV_A_R_LINEAR_____822_CM "" RAT_FUNC "%6.3" "g" COEFFS 0 25043.4782608696 0. 0 0 1 /end COMPU_METHOD
/begin COMPU_METHOD _CNV_A_R_EGTR_LINEA_837_CM "" RAT_FUNC "%6.3" "g" COEFFS 0 3130.435031829792 0. 0 0 1 /end COMPU_METHOD
/begin COMPU_METHOD _CNV_S_3_ECM2_RANGE_839_CM "" TAB_VERB "%6.3" "-" COMPU_TAB_REF _CNV_S_3_ECM2_RANGE_839 /end COMPU_METHOD
/begin COMPU_VTAB _CNV_S_3_ECM2_RANGE_839 "" TAB_VERB 3 0 "PU" 1 "NON_PU" 2 "PASSIVE" /end COMPU_VTAB
/begin COMPU_METHOD _CNV_S_5_ECM2_RANGE_840_CM "" TAB_VERB "%6.3" "-" COMPU_TAB_REF _CNV_S_5_ECM2_RANGE_840 /end COMPU_METHOD
/begin COMPU_VTAB _CNV_S_5_ECM2_RANGE_840 "" TAB_VERB 5 0 "-" 1 "S" 2 "AFS" 3 "AFL" 8 "LIH" /end COMPU_VTAB
/begin COMPU_METHOD _CNV_S_4_ECM2_RANGE_841_CM "" TAB_VERB "%6.3" "-" COMPU_TAB_REF _CNV_S_4_ECM2_RANGE_841 /end COMPU_METHOD
/begin COMPU_VTAB _CNV_S_4_ECM2_RANGE_841 "" TAB_VERB 4 0 "NOT_ACTIVE" 1 "IDLE" 2 "TRAILING_THR" 3 "PART_LOAD" /end COMPU_VTAB
/begin COMPU_METHOD _CNV_A_R_LINEAR_____842_CM "" RAT_FUNC "%6.3" "" COEFFS 0 32. 0. 0 0 1 /end COMPU_METHOD
/begin COMPU_METHOD _CNV_A_R_ECM2_LINEA_843_CM "" RAT_FUNC "%6.3" "Nm/rpm²" COEFFS 0 134293032.7868853 0. 0 0 1 /end COMPU_METHOD
/begin COMPU_METHOD _CNV_A_R_ECM2_LINEA_844_CM "" RAT_FUNC "%6.3" "-" COEFFS 0 8000. 0. 0 0 1 /end COMPU_METHOD
/begin COMPU_METHOD _CNV_A_R_LINEAR_____845_CM "" RAT_FUNC "%6.3" "-" COEFFS 0 7.971241012816505 0. 0 0 1 /end COMPU_METHOD
/begin COMPU_METHOD _CNV_A_R_ECM2_LINEA_846_CM "" RAT_FUNC "%6.3" "V" COEFFS 0 6553.599999999993 0. 0 0 1 /end COMPU_METHOD
/begin COMPU_METHOD _CNV_A_R_ECM2_LINEA_847_CM "" RAT_FUNC "%6.3" "km/h" COEFFS 0 0.5 0. 0 0 1 /end COMPU_METHOD
/begin COMPU_METHOD _CNV_S_5_ECM2_RANGE_848_CM "" TAB_VERB "%6.3" "-" COMPU_TAB_REF _CNV_S_5_ECM2_RANGE_848 /end COMPU_METHOD
/begin COMPU_VTAB _CNV_S_5_ECM2_RANGE_848 "" TAB_VERB 5 0 "NO_ERROR" 1 "ERROR_PATH_1" 2 "ERROR_PATH_2" 3 "ERROR_PATH_3" 4 "ERROR_PATH_4" /end COMPU_VTAB
/begin COMPU_METHOD _CNV_A_R_ECM2_LINEA_849_CM "" RAT_FUNC "%6.3" "Nm" COEFFS 0 128. 0. 0 0 1 /end COMPU_METHOD
/begin COMPU_METHOD _CNV_A_R_ECM2_LINEA_850_CM "" RAT_FUNC "%6.3" "-" COEFFS 0 257. 0. 0 0 1 /end COMPU_METHOD
/begin COMPU_METHOD _CNV_A_R_ECM2_LINEA_851_CM "" RAT_FUNC "%6.3" "%/V" COEFFS 0 1.6 0. 0 0 1 /end COMPU_METHOD
/begin COMPU_METHOD _CNV_A_R_ECM2_LINEA_852_CM "" RAT_FUNC "%6.3" "%" COEFFS 0 100. 32768. 0 0 1 /end COMPU_METHOD
/begin COMPU_METHOD _CNV_S_3_ECM2_RANGE_853_CM "" TAB_VERB "%6.3" "-" COMPU_TAB_REF _CNV_S_3_ECM2_RANGE_853 /end COMPU_METHOD
/begin COMPU_VTAB _CNV_S_3_ECM2_RANGE_853 "" TAB_VERB 3 0 "NO_ERROR" 1 "ERROR_PATH_1" 2 "ERROR_PATH_2" /end COMPU_VTAB
/begin COMPU_METHOD _CNV_A_R_ECM2_LINEA_854_CM "" RAT_FUNC "%6.3" "-" COEFFS 0 4096. 32768. 0 0 1 /end COMPU_METHOD
/begin RECORD_LAYOUT _REC_VAL_20_u1 FNC_VALUES 1 UBYTE COLUMN_DIR DIRECT /end RECORD_LAYOUT
/begin RECORD_LAYOUT _REC_VAL_20_u2 FNC_VALUES 1 UWORD COLUMN_DIR DIRECT /end RECORD_LAYOUT
/begin RECORD_LAYOUT _REC_AXS_20_u1 NO_AXIS_PTS_X 1 UBYTE AXIS_PTS_X 2 UBYTE INDEX_INCR DIRECT /end RECORD_LAYOUT
/begin RECORD_LAYOUT _REC_MAP_20_u2_u1_u1 FNC_VALUES 1 UWORD COLUMN_DIR DIRECT /end RECORD_LAYOUT
/begin RECORD_LAYOUT _REC_CUR_20_u1_u1 FNC_VALUES 1 UBYTE COLUMN_DIR DIRECT /end RECORD_LAYOUT
/begin RECORD_LAYOUT _REC_VAL_20_s2 FNC_VALUES 1 SWORD COLUMN_DIR DIRECT /end RECORD_LAYOUT
/begin RECORD_LAYOUT _REC_AXS_20_u2 NO_AXIS_PTS_X 1 UWORD AXIS_PTS_X 2 UWORD INDEX_INCR DIRECT /end RECORD_LAYOUT
/begin RECORD_LAYOUT _REC_CUR_20_u2_u1 FNC_VALUES 1 UWORD COLUMN_DIR DIRECT /end RECORD_LAYOUT
/begin RECORD_LAYOUT _REC_CUR_20_u2_u2 FNC_VALUES 1 UWORD COLUMN_DIR DIRECT /end RECORD_LAYOUT
/begin RECORD_LAYOUT _REC_VAL_20_s1 FNC_VALUES 1 SBYTE COLUMN_DIR DIRECT /end RECORD_LAYOUT
/begin RECORD_LAYOUT _REC_CUR_20_u1_u2 FNC_VALUES 1 UBYTE COLUMN_DIR DIRECT /end RECORD_LAYOUT
/begin RECORD_LAYOUT _REC_MAP_20_u2_u2_u2 FNC_VALUES 1 UWORD COLUMN_DIR DIRECT /end RECORD_LAYOUT
/begin RECORD_LAYOUT _REC_MAP_20_u1_u1_u1 FNC_VALUES 1 UBYTE COLUMN_DIR DIRECT /end RECORD_LAYOUT
/begin RECORD_LAYOUT _REC_MAP_20_u1_u2_u1 FNC_VALUES 1 UBYTE COLUMN_DIR DIRECT /end RECORD_LAYOUT
/begin RECORD_LAYOUT _REC_MAP_20_u1_u1_u2 FNC_VALUES 1 UBYTE COLUMN_DIR DIRECT /end RECORD_LAYOUT
/begin RECORD_LAYOUT _REC_CUR_20_s2_u1 FNC_VALUES 1 SWORD COLUMN_DIR DIRECT /end RECORD_LAYOUT
/begin FUNCTION EGTR_Diag_value_determination ""
 /begin DEF_CHARACTERISTIC c_ctr_cyc_cat_diag_afl c_ctr_o2l_mv_clc lc_err_sym_clc_cat_diag_afl c_o2l_thd_diag_err_h_ampl_mv[0] c_o2l_thd_diag_err_h_ampl_mv[1] c_o2l_thd_diag_err_load_mv[0] c_o2l_thd_diag_err_load_mv[1] c_o2l_thd_diag_err_l_ampl_mv[0] c_o2l_thd_diag_err_l_ampl_mv[1] c_o2l_thd_diag_err_mmv[0] c_o2l_thd_diag_err_mmv[1] c_o2l_thd_diag_err_park_mv[0] c_o2l_thd_diag_err_park_mv[1] c_lamb_o2l_int_clc c_vls_o2l_int_clc /end DEF_CHARACTERISTIC
 /begin OUT_MEASUREMENT egtr[0].egtr_struct_fctdgtdldd0.action_clcO2L_data_l_ampl.o2l_mv egtr[0].egtr_struct_fctdgtdldd0.action_clcO2L_data_l_ampl.o2l_sum egtr[0].egtr_struct_fctdgtdldd0.action_clcO2L_data_l_ampl.ctr_sum egtr[0].egtr_struct_fctdgtdldd0.action_clcO2L_data_h_ampl.o2l_mv egtr[0].egtr_struct_fctdgtdldd0.action_clcO2L_data_h_ampl.o2l_sum egtr[0].egtr_struct_fctdgtdldd0.action_clcO2L_data_h_ampl.ctr_sum egtr[0].egtr_struct_fctdgtdldd0.action_clcO2L_data_park.o2l_mv egtr[0].egtr_struct_fctdgtdldd0.action_clcO2L_data_park.o2l_sum egtr[0].egtr_struct_fctdgtdldd0.action_clcO2L_data_park.ctr_sum egtr[0].egtr_struct_fctdgtdldd0.action_clcO2L_data_load.o2l_mv egtr[0].egtr_struct_fctdgtdldd0.action_clcO2L_data_load.o2l_sum egtr[0].egtr_struct_fctdgtdldd0.action_clcO2L_data_load.ctr_sum egtr[0].egtr_struct_fctdgtdldd0.o2l_sum_cat_diag_afl egtr[0].egtr_struct_fctdgtdldd0.o2l_mmv_cat_diag_afl egtr[0].egtr_struct_fctdgtdldd0.ctr_cyc_cat_diag_afl egtr[0].egtr_struct_fctdgtdldd0.fac_sum_o2l_mmv_tmp egtr[0].egtr_struct_fctdgtdldd0.lv_err_mv_cat_diag_afl egtr[0].egtr_struct_fctdgtdldd0.lv_err_mmv_cat_diag_afl egtr[1].egtr_struct_fctdgtdldd0.action_clcO2L_data_l_ampl.o2l_mv egtr[1].egtr_struct_fctdgtdldd0.action_clcO2L_data_l_ampl.o2l_sum egtr[1].egtr_struct_fctdgtdldd0.action_clcO2L_data_l_ampl.ctr_sum egtr[1].egtr_struct_fctdgtdldd0.action_clcO2L_data_h_ampl.o2l_mv egtr[1].egtr_struct_fctdgtdldd0.action_clcO2L_data_h_ampl.o2l_sum egtr[1].egtr_struct_fctdgtdldd0.action_clcO2L_data_h_ampl.ctr_sum egtr[1].egtr_struct_fctdgtdldd0.action_clcO2L_data_park.o2l_mv egtr[1].egtr_struct_fctdgtdldd0.action_clcO2L_data_park.o2l_sum egtr[1].egtr_struct_fctdgtdldd0.action_clcO2L_data_park.ctr_sum egtr[1].egtr_struct_fctdgtdldd0.action_clcO2L_data_load.o2l_mv egtr[1].egtr_struct_fctdgtdldd0.action_clcO2L_data_load.o2l_sum egtr[1].egtr_struct_fctdgtdldd0.action_clcO2L_data_load.ctr_sum egtr[1].egtr_struct_fctdgtdldd0.o2l_sum_cat_diag_afl egtr[1].egtr_struct_fctdgtdldd0.o2l_mmv_cat_diag_afl egtr[1].egtr_struct_fctdgtdldd0.ctr_cyc_cat_diag_afl egtr[1].egtr_struct_fctdgtdldd0.fac_sum_o2l_mmv_tmp egtr[1].egtr_struct_fctdgtdldd0.lv_err_mv_cat_diag_afl egtr[1].egtr_struct_fctdgtdldd0.lv_err_mmv_cat_diag_afl lv_err_cat_diag_afl_1 lv_err_cat_diag_afl_2 /end OUT_MEASUREMENT
/end FUNCTION
/begin FUNCTION EGTR_Diag_value_determination_AI ""
 /begin DEF_CHARACTERISTIC c_abc_max_cat_diag_afl c_abc_inc_cat_diag_afl c_abc_dec_cat_diag_afl lc_diag_cat_diag_afl_deac /end DEF_CHARACTERISTIC
 /begin OUT_MEASUREMENT egtr[0].egtr_struct_fctdgtdlai0.lv_inh_diag_cat_diag_afl egtr[1].egtr_struct_fctdgtdlai0.lv_inh_diag_cat_diag_afl /end OUT_MEASUREMENT
/end FUNCTION
/begin FUNCTION EGTR_Activation_conditions ""
 /begin DEF_CHARACTERISTIC c_crlc_temp_cat_diag_afl c_maf_down_lim_cat_diag_afl c_maf_up_lim_cat_diag_afl c_n_32_down_lim_cat_diag_afl c_n_32_up_lim_cat_diag_afl c_tco_down_lim_cat_diag_afl c_tco_up_lim_cat_diag_afl c_temp_ldc_cat_diag_afl c_temp_down_lim_cat_diag_afl c_temp_up_lim_cat_diag_afl /end DEF_CHARACTERISTIC
 /begin OUT_MEASUREMENT egtr[0].egtr_struct_fctdgtdlac0.temp_ldc_cat_diag_afl egtr[0].egtr_struct_fctdgtdlac0.lv_o2l_clc_act_opp_tmp egtr[0].egtr_struct_fctdgtdlac0.lv_o2l_clc_act_cdn egtr[0].egtr_struct_fctdgtdlac0.lv_o2l_clc_act_tco_tmp egtr[0].egtr_struct_fctdgtdlac0.lv_o2l_clc_act_temp_tmp egtr[0].egtr_struct_fctdgtdlac0.lv_o2l_clc_act_ldc_temp_tmp egtr[1].egtr_struct_fctdgtdlac0.temp_ldc_cat_diag_afl egtr[1].egtr_struct_fctdgtdlac0.lv_o2l_clc_act_opp_tmp egtr[1].egtr_struct_fctdgtdlac0.lv_o2l_clc_act_cdn egtr[1].egtr_struct_fctdgtdlac0.lv_o2l_clc_act_tco_tmp egtr[1].egtr_struct_fctdgtdlac0.lv_o2l_clc_act_temp_tmp egtr[1].egtr_struct_fctdgtdlac0.lv_o2l_clc_act_ldc_temp_tmp /end OUT_MEASUREMENT
/end FUNCTION
/begin FUNCTION C_E_ECM2 "C_E_ECM2"
 /begin DEF_CHARACTERISTIC ldpm_test_rec_idx_mon2 ldpm_iga_dif_av_mon_ip_eff_mon ldpm_n_32_mon__fac_cha_mon ldpm_n_32_mon_ip_iga_ref_mon ldpm_n_32_mon_ip_fac_tq_mon ldpm_pv_av_ad_mon_ip_fac_mon /end DEF_CHARACTERISTIC
 /begin SUB_FUNCTION ECM2_TCO_monitoring ECM2_Monitoring_PVS ECM2_Monitoring_CAN_signals ECM2_Fault_reaction_process_mon ECM2_Mon_engine_speed_limitation ECM2_Mon_cruise_ctl_conditions ECM2_Desired_indicated_eng_tq ECM2_Actual_indicated_eng_tq ECM2_Mon_actual_indicated_eng_tq ECM2_Processor_monitoring_MON2 ECM2_Conf_process_mon_AI ECM2_Mon_analog_dig_conversion ECM2_Mon_N_32_using_sw_timer ECM2_Mon_tq_demand_is_controller ECM2_Monitoring_torque_losses ECM2_Monitoring_min_tq_clutch ECM2_Monitoring_max_tq_clutch ECM2_Err_mem_mng_process_mon ECM2_Actual_efficiencies ECM2_Actual_lambda_deviation ECM2_Actual_fuel_mass_flow ECM2_Cmb_mode_switch_requests ECM2_Mon_of_mass_fuel_flow ECM2_Err_mem_mng_process_mon_AI /end SUB_FUNCTION
/end FUNCTION
/begin FUNCTION ECM2_TCO_monitoring "TCO_monitoring"
 /begin DEF_CHARACTERISTIC c_tco_grd_max_mon c_t_tco_grd_max_mon c_tco_thd_min_mon c_tco_sub_thd_max_mon /end DEF_CHARACTERISTIC
 /begin OUT_MEASUREMENT tco_mon t_tco_grd_mon /end OUT_MEASUREMENT
/end FUNCTION
/begin FUNCTION ECM2_Monitoring_PVS "Monitoring_PVS"
 /begin DEF_CHARACTERISTIC c_n_min_pvs_diag_mon c_abc_inc_pvs_ratio_mon c_abc_max_pvs_ratio_mon c_v_pvs_is_thd_1_mon c_v_pvs_is_thd_2_mon c_v_pvs_slop_1_mon c_v_pvs_slop_2_mon c_pv_lih_max_mon ip_v_thd_ratio_chk_pvs_mon ldp_v_min_pv_mon_ip_v_pvs_mon /end DEF_CHARACTERISTIC
 /begin OUT_MEASUREMENT lv_err_pvs_ratio_mon abc_pvs_ratio_mon pv_av_1_mon pv_av_2_mon lv_err_pvs_mon pv_av_mon v_pvs_1_mon v_pvs_2_mon fac_v_slop_pvs_mon /end OUT_MEASUREMENT
/end FUNCTION
/begin FUNCTION ECM2_Monitoring_CAN_signals "Monitoring_CAN_signals"
 /begin DEF_CHARACTERISTIC c_abc_max_sof_mon c_abc_inc_sof_mon c_can_vb_min_diag_mon c_abc_inc_gs_mon c_abc_max_msr_mon c_t_msr_inh_mon c_t_can_vb_vld_mon c_tqi_gs_max_mon c_thd_max_gs_miss_mon c_thd_max_tcs1_miss_mon c_abc_inc_msr_mon c_abc_inc_dcc_rev_mon c_abc_inc_dcc_irrev_mon c_abc_inc_ldm_inh_mon c_abc_inc_ldm_mon c_abc_inc_gs_inh_mon c_abc_max_gs_mon c_abc_max_gs_inh_mon c_abc_max_amt_inh_mon c_abc_max_ldm_mon c_abc_max_ldm_inh_mon c_abc_max_dcc_rev_mon c_abc_max_dcc_irrev_mon c_abc_max_dcc_inh_mon c_abc_max_msr_inh_mon c_abc_inc_msr_inh_mon c_abc_inc_dcc_inh_mon c_t_gs_inh_mon c_t_dcc_inh_mon c_t_max_brake_det_dcc_mon c_t_ldm_inh_mon c_t_max_brake_det_ldm_mon c_t_amt_inh_mon c_t_dly_amt_inh_mon c_t_max_state_amt_1_diag_mon c_t_max_state_amt_2_diag_mon c_t_max_state_amt_3_diag_mon c_t_max_tqi_amt_diag_mon c_t_max_state_clu_amt_diag_mon c_t_dly_gs_inh_mon c_tqi_stnd_mon c_tqi_amt_diag_mon c_tqi_amt_cond_diag_mon c_tqi_amt_can_es_mon c_abc_inc_amt_inh_mon c_vs_fil_amt_mon /end DEF_CHARACTERISTIC
 /begin OUT_MEASUREMENT lv_can_inh_msr_mon lv_can_inh_gs_mon t_gs_inh_mon tqi_gs_mon abc_msr_mon abc_gs_mon abc_msr_inh_mon abc_ldm_inh_mon abc_dcc_inh_mon abc_gs_inh_mon t_ldm_inh_mon t_ldm_brake_det_mon t_dcc_inh_mon t_dcc_brake_det_mon t_state_amt_2_diag_mon t_state_amt_3_diag_mon t_state_clu_amt_diag_mon tqi_amt_plaus_mon tqi_msr_mon tqi_amt_mon t_msr_inh_mon t_amt_inh_mon lv_err_msr_inh_mon lv_err_ldm_inh_mon lv_err_ldm_mon lv_ldm_off_ecu_mon lv_ldm_off_ecu_1_mon lv_ldm_off_ecu_2_mon lv_err_dcc_inh_mon lv_err_dcc_rev_mon lv_err_dcc_irrev_mon lv_dcc_off_ecu_mon lv_err_amt_inh_mon lv_err_gs_inh_mon tq_msr_mon tq_dcc_mon tq_amt_mon tq_gs_mon tq_wheel_ldm_mon t_state_amt_1_diag_mon t_tqi_amt_diag_mon abc_amt_inh_mon state_err_amt_mon state_amt_old_mon /end OUT_MEASUREMENT
/end FUNCTION
/begin FUNCTION ECM2_Fault_reaction_process_mon "Fault_reaction_process_mon"
 /begin OUT_MEASUREMENT lv_n_lim_req_mon lv_off_mtc_mon lv_off_iv_mon lv_off_iv_n_lim_etc_tmp_mon lv_err_tran_1_mon lv_err_tran_2_mon /end OUT_MEASUREMENT
/end FUNCTION
/begin FUNCTION ECM2_Mon_engine_speed_limitation "Mon_engine_speed_limitation"
 /begin DEF_CHARACTERISTIC c_n_max_mtc_lih_thd_mon c_abc_inc_tqi_n_max_mon c_abc_max_tqi_n_max_mon /end DEF_CHARACTERISTIC
 /begin OUT_MEASUREMENT abc_tqi_n_max_mon lv_err_tqi_n_max_mon /end OUT_MEASUREMENT
/end FUNCTION
/begin FUNCTION ECM2_Mon_cruise_ctl_conditions "Mon_cruise_ctl_conditions"
 /begin DEF_CHARACTERISTIC c_t_cru_inh_mon c_vs_min_cru_mon c_abc_inc_cru_tq_mon c_abc_max_cru_tq_mon /end DEF_CHARACTERISTIC
 /begin OUT_MEASUREMENT fac_tq_req_cru_mon t_cru_inh_mon lv_cru_inh_mon lv_err_cru_mon abc_cru_tq_mon /end OUT_MEASUREMENT
/end FUNCTION
/begin FUNCTION ECM2_Desired_indicated_eng_tq "Desired_indicated_eng_tq"
 /begin DEF_CHARACTERISTIC c_t_tqi_mon ip_fac_tq_req_driv_mon c_crlc_tqi_sp_mon ip_fac_tq_req_driv_1_mon /end DEF_CHARACTERISTIC
 /begin OUT_MEASUREMENT t_tqi_mon fac_tq_req_mon tqi_req_tot_mon tqi_sp_mon fac_tq_req_driv_mon /end OUT_MEASUREMENT
/end FUNCTION
/begin FUNCTION ECM2_Actual_indicated_eng_tq "Actual_indicated_eng_tq"
 /begin DEF_CHARACTERISTIC ldp_n_32_mon_ip_tqi_cus_mon ldp_mff_mon_ip_tqi_cus_mon ip_tqi_cus_mon /end DEF_CHARACTERISTIC
 /begin OUT_MEASUREMENT tqi_av_mon /end OUT_MEASUREMENT
/end FUNCTION
/begin FUNCTION ECM2_Mon_actual_indicated_eng_tq "Mon_actual_indicated_eng_tq"
 /begin DEF_CHARACTERISTIC c_abc_inc_tqi_av_not_afs_mon c_abc_inc_swi_afs_tqi_mon c_abc_max_tqi_av_not_afs_mon c_abc_max_swi_afs_tqi_mon c_abc_inc_tqi_av_afs_mon c_abc_max_tqi_av_afs_mon ip_tqi_dif_max_mon c_gain_tqi_dif_max_mon ldp_n_32_ip_tqi_dif_max_mon ldp_tqi_sp_ip_tqi_dif_max_mon /end DEF_CHARACTERISTIC
 /begin OUT_MEASUREMENT lv_err_tqi_av_mon lv_swi_afs_tqi_mon tqi_dif_sp_mon tqi_dif_max_mon abc_tqi_av_not_afs_mon abc_swi_afs_tqi_mon abc_tqi_av_afs_mon tqi_dif_av_mon /end OUT_MEASUREMENT
/end FUNCTION
/begin FUNCTION ECM2_Processor_monitoring_MON2 "Processor_monitoring_MON2"
 /begin DEF_CHARACTERISTIC c_t_tqi_mon2 c_gain_tqi_dif_max_mon2 ldp_n_32_mon2_ip_fac_tq_mon2 ldp_pv_av_ad_mon2_ip_fac_mon2 ldp_maf_mon2_ip_iga_ref_mon2 ldp_n_32_mon2_ip_iga_ref_mon2 ldp_iga_dif_av_mon2_ip_eff_mon2 ip_eff_iga_mon2 ldp_n_32_mon2_ip_tqi_ref_mon2 ldp_maf_mon2_ip_tqi_ref_mon2 c_abc_inc_tqi_av_mon2 c_abc_max_tqi_av_mon2 ldp_tqi_sp_mon_mon2_ip_mon2 ldp_n_32_mon2_ip_tqi_dif_mon2 ip_tqi_dif_max_mon2 c_n_max_mtc_lih_thd_mon2 c_abc_inc_tqi_n_max_mon2 c_abc_max_tqi_n_max_mon2 id_tqi_inc_ext_mon2 id_pv_av_ad_mon2 id_fac_tq_req_cru_mon2 id_tq_min_clu_mon2 id_tq_max_clu_mon2 id_tq_dif_p_d_is_mon2 id_tq_loss_mon2 id_n_32_mon2 id_iga_ref_cor_ext_mon2 id_iga_igc_mon2 id_sum_inh_inj_mon2 id_maf_mon2 id_prev_state_iv_mon2 id_abc_tqi_av_mon2 id_abc_tqi_n_max_mon2 id_tqi_sp_mon_mon2 id_tqi_req_tot_mon2 id_t_tqi_mon2 id_resp_mon2 ip_fac_tq_req_driv_mon2 ip_iga_ref_mon2 ip_tqi_ref_mon2 id_tqi_sp_mon2 id_tqi_min_pu_mon2 id_lf_1_mon2 id_lf_2_mon2 id_lf_3_mon2 id_lf_4_mon2 c_crlc_tqi_sp_mon2 /end DEF_CHARACTERISTIC
 /begin OUT_MEASUREMENT t_tqi_mon2 fac_tq_req_cru_mon2 sum_inh_inj_mon2 lv_err_conv_mon2 lv_err_maf_mon2 lv_err_n_32_mon2 lv_err_pvs_mon2 lv_err_tps_mon2 lv_err_tq_dif_p_d_is_mon2 lv_err_tq_dif_i_is_mon2 lv_err_tq_loss_mon2 lv_err_tq_min_clu_mon2 lv_err_tq_max_clu_mon2 lv_n_lim_etc_mon2 lv_tqi_mon_act_mon2 maf_mon2 n_32_mon2 pv_av_ad_mon2 tq_loss_mon2 tq_max_clu_mon2 tq_dif_p_d_is_mon2 tqi_inc_ext_mon2 tqi_sp_mon2 prev_state_iv_mon2 iga_ref_cor_ext_mon2 resp_mon2 fac_tq_req_mon2 fac_tq_req_driv_mon2 tqi_req_tot_mon2 tqi_sp_mon_mon2 eff_iga_mon2 eff_scc_mon2 iga_dif_av_mon2 tqi_av_mon2 tqi_ref_mon2 lv_err_tqi_av_mon2 tqi_dif_sp_mon2 tqi_dif_max_mon2 abc_tqi_av_mon2 tqi_dif_av_mon2 abc_tqi_n_max_mon2 lv_err_tqi_n_max_mon2 lv_n_lim_req_mon2 lv_dr_off_mu_mon2 lv_off_mtc_mon2 lv_off_iv_mon2 lv_off_iv_n_lim_etc_mon2 lv_off_iv_n_lim_etc_tmp_mon2 iga_igc_mon2[0] iga_igc_mon2[1] iga_igc_mon2[2] iga_igc_mon2[3] iga_igc_mon2[4] iga_igc_mon2[5] iga_ref_mon2 tq_min_clu_mon2 lv_err_mu_mc_mon2 lv_err_tmp_mu_mc_mon2 tqi_min_pu_mon2 lv_err_tran_1_mon2 lv_err_tran_2_mon2 lf_4_mon2 /end OUT_MEASUREMENT
/end FUNCTION
/begin FUNCTION ECM2_Conf_process_mon_AI "Conf_process_mon_AI"
 /begin DEF_CHARACTERISTIC c_n_dif_crlc_low_mon c_n_dif_max_is_mon c_iga_ref_temp_cor_lim_mon c_iga_ref_lamb_cor_lim_mon c_v_tps_1_lih_mon c_v_tps_2_lih_mon c_n_thd_fcut_n_lim_etc_mon c_vs_dif_max_mon c_tq_loss_add_acc_min_mon c_tq_loss_alter_min_mon c_tq_loss_pste_1_min_mon c_tq_loss_sa_min_mon c_crlc_alter_mon c_fac_eff_alter_mon c_tq_loss_ars_min_mon c_fac_n_alter_mon c_v_tq_alter_mon lc_inh_pu_req_mon ip_cur_alter_mon ip_eff_alter_mon ldp_cur_alter_mon__tq_loss_mon ip_tq_loss_pste_2_min_mon ldp_vs_mon__tq_loss_mon ldp_ang_pste_stnd__tq_loss_mon ip_fac_conv_mon c_fac_ramp_p_d_mon ldp_tco_mon_ip_n_sp_is_mon ip_n_sp_is_bas_max_mon ldp_tco_mon_ip_fac_conv_mon ip_fac_tq_dif_p_d_is_mon ip_tq_dif_p_d_is_max_mon ldp_n_dif_sp_is_mon_ip_tq_mon ldp_tco_mon_ip_fac_tq_p_d_mon c_n_dif_crlc_high_mon lc_n_sp_is_clc_inh_mon c_n_sp_is_bas_dif_max_mon c_fil_tq_p_d_is_max_mon ip_fac_n_grd_tq_av_mon ip_fac_tq_drof_fac_tq_req_mon ldp_tq_av_mon__tq_drof ldp_fac_tq_req_mon__tq_drof c_t_drof_pas_dly_mon c_t_drof_zero_mon c_n_dif_drof_max_mon c_n_dif_drof_min_mon c_n_dif_add_drof_mon ip_tq_drof_mon ldp_vs_mon__tq_drof ldp_n_32_mon__tq_drof id_tq_drof_ena_mon ldp_n_dif_drof_mon__id_tq_drof ip_fac_tq_drof_vs_mon c_n_32_tq_drof_max_mon c_v_sof_swi_min_mon c_v_sof_swi_max_mon c_pv_av_sof_min_mon c_fac_tq_req_driv_sof_max_mon c_pv_av_grd_sof_max_mon c_t_pv_av_grd_sof_max_mon lc_rng_l_man_as_mon ldp_n_dif_drof_mon__tq_drof ldp_dffgen_fil_mon__loss_mon ldpm_n_alter_mon__tq_loss_mon c_tq_dif_is_ad_conv_max_mon c_n_dif_fac_mon c_n_sp_is_lih_max_mon c_n_dif_hys_is_pu_mon lc_tq_drof_isc_off_mon lc_swi_opm_av_mon c_swi_opm_av_mon c_vs_lih_mon c_fac_rax_mon c_fac_gr_mon c_fac_gr_dif_mon c_fac_gr_min_mon c_fac_gr_max_mon c_v_sof_swi_on_tol_mon c_v_sof_swi_on_bol_mon lc_var_sof_swi_mon lc_rng_l_mon lc_conf_city_ena_mon /end DEF_CHARACTERISTIC
 /begin OUT_MEASUREMENT state_err_det_tq_min_mon opm_av_mon n_dif_sp_is_mon lv_ls_up_act_mon[0] lv_ls_up_act_mon[1] lv_lamb_ls_up_vld_mon[0] lv_lamb_ls_up_vld_mon[1] state_req_isc_mon lv_n_lim_etc_mon lv_tqi_mon_act_mon lv_brake_mon lv_err_vcc_pvs_1_mon tq_loss_ars_mon tq_loss_pste_1_mon tq_loss_pste_2_mon cur_alter_mon tq_loss_sa_mon n_alter_mon dffgen_fil_mon lv_err_vcc_pvs_2_mon lv_err_vcc_pvs_mon tq_loss_add_mon tq_loss_acc_mon vs_mon pv_av_ad_mon tqi_inc_ext_mon n_sp_is_ratio_mon n_sp_is_mon n_dif_mmv_mon n_dif_cor_mon fac_ramp_neg_p_d_is_mon n_dif_mon n_dif_drof_mon tqi_min_pu_mon tq_dif_p_d_is_mon lv_ct_mon tq_dif_p_d_is_max_mon tq_dif_p_d_is_max_2_mon state_pas_ramp_act_i_is_mon lv_pas_ramp_act_p_d_chg_mon lv_pas_ramp_act_i_chg_mon n_sp_is_bas_mon lv_off_iv_n_lim_etc_mon tq_drof_mon tq_drof_mdl_mon tq_drof_mdl_dec_mon lv_tq_drof_act_mon lv_cs_mon lv_cs_dly_mon tq_av_mon t_drof_pas_dly_mon state_pas_ramp_act_p_d_is_mon v_tps_1_mon v_tps_2_mon tq_loss_pste_mon tq_conv_max_mon tq_conv_max_mdl_mon lv_igk_mon lv_sf_tqd_mon gr_dt_mdl_mon tq_add_min_clu_mon iga_ref_hom_cor_ext_mon iga_ref_mplh_cor_ext_mon lv_swi_tq_min_clu_mon lv_sof_swi_req_mon lv_sof_swi_mon lv_rng_l_mon lv_swi_fac_tq_req_mon lv_err_sof_inh_mon abc_sof_inh_mon lv_err_cru_inh_mon lv_msr_inh_mon lv_gs_inh_mon gr_dt_mon tqi_inc_can_mon tq_loss_alter_mon tq_loss_alter_mdl_mon /end OUT_MEASUREMENT
/end FUNCTION
/begin FUNCTION ECM2_Mon_analog_dig_conversion "Mon_analog_dig_conversion"
 /begin DEF_CHARACTERISTIC c_vp_acq_conv_hys_mon c_abc_inc_conv_mon c_abc_max_conv_mon c_state_an_dig_err_act_mon /end DEF_CHARACTERISTIC
 /begin OUT_MEASUREMENT abc_conv_mon lv_err_conv_mon /end OUT_MEASUREMENT
/end FUNCTION
/begin FUNCTION ECM2_Mon_N_32_using_sw_timer "Mon_N_32_using_sw_timer"
 /begin DEF_CHARACTERISTIC c_abc_inc_n_32_mon c_abc_max_n_32_mon c_n_32_lim_mon c_n_32_min_mon c_n_32_dif_rel_max_mon /end DEF_CHARACTERISTIC
 /begin OUT_MEASUREMENT abc_n_32_mon lv_err_n_32_mon n_32_dif_rel_mon n_32_sub_mon n_32_mon t_seg_sw_mon /end OUT_MEASUREMENT
/end FUNCTION
/begin FUNCTION ECM2_Mon_tq_demand_is_controller "Mon_tq_demand_is_controller"
 /begin DEF_CHARACTERISTIC c_fac_ramp_neg_i_is_mon c_tq_dif_i_is_max_mon c_tq_dif_i_is_add_mon c_tq_pas_i_is_mon c_abc_inc_tq_dif_p_d_is_mon c_abc_max_tq_dif_p_d_is_mon c_tq_p_d_isc_not_act_max_mon c_abc_inc_tq_dif_i_is_mon c_abc_max_tq_dif_i_is_mon c_tq_i_isc_not_act_max_mon c_tq_dif_p_d_is_add_mon c_tq_dif_p_d_ramp_chk_ofs_mon /end DEF_CHARACTERISTIC
 /begin OUT_MEASUREMENT tq_dif_p_d_is_dif_mon tq_dif_p_d_is_ramp_mon state_err_tq_dif_p_d_is_mon tq_dif_i_is_ramp_mon tq_dif_i_is_dif_mon state_err_tq_dif_i_is_mon lv_err_tq_dif_p_d_is_mon tq_add_p_d_is_mon abc_tq_dif_p_d_is_mon tq_dif_i_is_mon tq_add_i_is_mon abc_tq_dif_i_is_mon lv_err_tq_dif_i_is_mon lv_ramp_p_d_beg_value_wrg_mon /end OUT_MEASUREMENT
/end FUNCTION
/begin FUNCTION ECM2_Monitoring_torque_losses "Monitoring_torque_losses"
 /begin DEF_CHARACTERISTIC ldp_maf_mon_ip_tqfr_mon ldp_n_32_mon_ip_tqfr_mon ldp_tco_mon_ip_tqfr_add_mon ip_tqfr_mon ip_tqfr_add_mon c_abc_inc_tq_loss_mon c_abc_max_tq_loss_mon c_crlc_tq_loss_req_clu_mon c_tq_loss_dif_max_mon c_tq_is_ad_min_mon /end DEF_CHARACTERISTIC
 /begin OUT_MEASUREMENT abc_tq_loss_mon lv_err_tq_loss_mon tq_loss_mon tq_loss_req_clu_mon tq_loss_mmv_mon tq_loss_dif_mon tq_loss_mdl_mon /end OUT_MEASUREMENT
/end FUNCTION
/begin FUNCTION ECM2_Monitoring_min_tq_clutch "Monitoring_min_tq_clutch"
 /begin DEF_CHARACTERISTIC ldp_n_sp_is_ratio_mon_ip_mon ip_fac_n_sp_is_ratio_mon ldp_n_32_mon_ip_tqi_min_mon ldp_tco_mon_ip_tqi_min_pu_mon ip_tqi_min_req_pu_mon c_n_st_max_mon c_abc_inc_tq_min_clu_mon c_abc_max_tq_min_clu_mon c_tq_min_clu_mdl_ofs_mon c_dly_tq_st_mon /end DEF_CHARACTERISTIC
 /begin OUT_MEASUREMENT fac_n_sp_is_ratio_mon tq_st_mon state_err_tq_min_clu_mon lv_err_tq_min_clu_mon abc_tq_min_clu_mon tq_min_clu_mdl_2_mon tq_min_clu_dif_mon tq_min_clu_mon tq_min_clu_mdl_5_mon ctr_dly_tq_st_mon /end OUT_MEASUREMENT
/end FUNCTION
/begin FUNCTION ECM2_Monitoring_max_tq_clutch "Monitoring_max_tq_clutch"
 /begin DEF_CHARACTERISTIC c_abc_max_tq_max_clu_mon c_abc_inc_tq_max_clu_mon c_ofs_tia_mon ldp_n_32_mon_ip_tqi_max_mon ldp_fac_tq_req_mon__tq_max_mon ip_tqi_ref_max_mon ip_fac_cha_max_fac_tq_req_mon ip_fac_cha_max_1_mon ip_fac_cha_max_2_mon /end DEF_CHARACTERISTIC
 /begin OUT_MEASUREMENT lv_err_tq_max_clu_mon abc_tq_max_clu_mon tq_max_clu_max_mon tq_max_clu_mon tq_max_clu_dif_mon fac_cha_max_mon fac_cus_tq_max_mon /end OUT_MEASUREMENT
/end FUNCTION
/begin FUNCTION ECM2_Err_mem_mng_process_mon "Err_mem_mng_process_mon"
 /begin OUT_MEASUREMENT lv_err_conv_mon_1 lv_err_n_32_mon_1 lv_err_pvs_mon_1 lv_err_cru_mon_1 lv_err_tqi_av_mon_1 lv_err_tqi_n_max_mon_1 lv_err_mff_mon_1 lv_err_tq_dif_isc_mon_1 lv_err_tq_req_mon_1 lv_err_tq_ext_mon_1 /end OUT_MEASUREMENT
/end FUNCTION
/begin FUNCTION ECM2_Actual_efficiencies "Actual_efficiencies"
 /begin DEF_CHARACTERISTIC ip_eff_iga_hom_mon ip_eff_lamb_hom_mon ip_eff_lamb_s_mon ip_iga_ref_hom_mon ip_eff_iga_homs_mon ldp_mff_mon_ip_iga_ref_mon ldp_lamb_homs_mon_ip_eff_mon ip_eff_lamb_homs_mon ldp_maf_mon_ip_iga_ref_mon ldp_maf_mon_ip_fac_eff_iga_mon ldp_n_32_mon_ip_fac_eff_iga_mon ip_iga_ref_homs_mon ip_fac_eff_iga_mon ldp_lamb_hom_mon_ip_eff_mon ldp_lamb_s_mon_ip_eff_mon /end DEF_CHARACTERISTIC
 /begin OUT_MEASUREMENT eff_tot_mon eff_iga_hom_mon eff_iga_s_mon eff_lamb_hom_mon eff_lamb_s_mon iga_dif_av_hom_mon eff_iga_homs_mon eff_lamb_homs_mon iga_dif_av_homs_mon /end OUT_MEASUREMENT
/end FUNCTION
/begin FUNCTION ECM2_Actual_lambda_deviation "Actual_lambda_deviation"
 /begin DEF_CHARACTERISTIC c_thd_mff_min_mon c_fac_mff_maf_mon c_lamb_ref_mon lc_lamb_ref_mon /end DEF_CHARACTERISTIC
 /begin OUT_MEASUREMENT lamb_dif_mon maf_mon lamb_mon lamb_mdl_dly_mon lamb_mdl_sens_mon /end OUT_MEASUREMENT
/end FUNCTION
/end MODULE
/end PROJECT
