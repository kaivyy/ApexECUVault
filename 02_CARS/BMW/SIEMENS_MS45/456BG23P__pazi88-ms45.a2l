ASAP2_VERSION 1 31
/begin PROJECT MS45 "BMW Motorsteuerung R6"
/begin HEADER "_default_HeaderComment" PROJECT_NO _56 /end HEADER
/begin MODULE _default_ModuleName "_default_ModuleLongIdentifier"
/begin MOD_COMMON "_default_ModCommonComment" DEPOSIT ABSOLUTE BYTE_ORDER MSB_FIRST ALIGNMENT_BYTE 1 ALIGNMENT_WORD 2 ALIGNMENT_LONG 4 ALIGNMENT_FLOAT32_IEEE 4 ALIGNMENT_FLOAT64_IEEE 8 /end MOD_COMMON
/begin MEASUREMENT v_dmtl "???" UWORD _CNV_A_R_LINEAR_____3_CM 1 100. 0. 4.99511719 DISPLAY_IDENTIFIER V_DMTL ECU_ADDRESS 0x3fd326 BYTE_ORDER MSB_LAST FORMAT "%5.3" /end MEASUREMENT
/begin MEASUREMENT v_sof_swi "Voltage sound flap switch" UWORD _CNV_A_R_LINEAR_____3_CM 1 100. 0. 4.99511719 DISPLAY_IDENTIFIER V_SOF_SWI ECU_ADDRESS 0x3fd32a BYTE_ORDER MSB_LAST FORMAT "%5.3" /end MEASUREMENT
/begin MEASUREMENT v_sof_swi_mon "Voltage sound flap switch" UWORD _CNV_A_R_LINEAR_____3_CM 1 100. 0. 4.99511719 DISPLAY_IDENTIFIER V_SOF_SWI_MON ECU_ADDRESS 0x3fd32c BYTE_ORDER MSB_LAST FORMAT "%5.3" /end MEASUREMENT
/begin CHARACTERISTIC c_amp_dmtl_max "lower altitude threshold for DMTL function / upper ambient pressure for DMTL function" VALUE 0x0147c _REC_VAL_20_u2 5434.25976563 _CNV_A_R_LINEAR_____165_CM 0. 5434.25976563 DISPLAY_IDENTIFIER C_AMP_DMTL_MAX FORMAT "%7.2" /end CHARACTERISTIC
/begin CHARACTERISTIC c_cod_2_dmtl "2nd  application code word of DMTL function" VALUE 0x00607 _REC_VAL_20_u1 255. _CNV_A_R_LINEAR_____1_CM 0. 255. DISPLAY_IDENTIFIER C_COD_2_DMTL FORMAT "%3.0" /end CHARACTERISTIC
/begin CHARACTERISTIC c_cod_dmtl "Calibrationconstant" VALUE 0x00608 _REC_VAL_20_u1 255. _CNV_A_R_LINEAR_____1_CM 0. 255. DISPLAY_IDENTIFIER C_COD_DMTL FORMAT "%3.0" /end CHARACTERISTIC
/begin CHARACTERISTIC c_crlc_cur_dmtl_fil "Time constant of pump current filtering" VALUE 0x014c2 _REC_VAL_20_u2 0.99998474 _CNV_A_R_LINEAR_____37_CM 0. 0.99998474 DISPLAY_IDENTIFIER C_CRLC_CUR_DMTL_FIL FORMAT "%7.5" /end CHARACTERISTIC
/begin CHARACTERISTIC c_crlc_cur_dmtl_fil_lim "Time constant at the beginning of pump current filtering" VALUE 0x014c4 _REC_VAL_20_u2 0.99998474 _CNV_A_R_LINEAR_____37_CM 0. 0.99998474 DISPLAY_IDENTIFIER C_CRLC_CUR_DMTL_FIL_LIM FORMAT "%7.5" /end CHARACTERISTIC
/begin CHARACTERISTIC c_crlc_cur_dmtl_fil_refu "Correlation constant at the beginning of pump current filtering" VALUE 0x014c6 _REC_VAL_20_u2 0.99998474 _CNV_A_R_LINEAR_____37_CM 0. 0.99998474 DISPLAY_IDENTIFIER C_CRLC_CUR_DMTL_FIL_REFU FORMAT "%7.5" /end CHARACTERISTIC
/begin CHARACTERISTIC c_crlc_vb_dmtl_fil "Time constant of VB filtering" VALUE 0x014f4 _REC_VAL_20_u2 0.99998474 _CNV_A_R_LINEAR_____37_CM 0. 0.99998474 DISPLAY_IDENTIFIER C_CRLC_VB_DMTL_FIL FORMAT "%7.5" /end CHARACTERISTIC
/begin CHARACTERISTIC c_crlc_vb_dmtl_fil_lim "Time constant at the beginning of VB filtering" VALUE 0x014f6 _REC_VAL_20_u2 0.99998474 _CNV_A_R_LINEAR_____37_CM 0. 0.99998474 DISPLAY_IDENTIFIER C_CRLC_VB_DMTL_FIL_LIM FORMAT "%7.5" /end CHARACTERISTIC
/begin CHARACTERISTIC c_cur_dmtl_cor_fil_ofs_amp "Pump current offset in case of ambient pressure" VALUE 0x003dc _REC_VAL_20_s2 399.9938 _CNV_A_R_LINEAR_____166_CM -200. 199.9938 DISPLAY_IDENTIFIER C_CUR_DMTL_COR_FIL_OFS_AMP FORMAT "%8.3" /end CHARACTERISTIC
/begin CHARACTERISTIC c_cur_dmtl_dif_cur_dmtl_stat "Delta pump current for pump current" VALUE 0x01508 _REC_VAL_20_u2 400. _CNV_A_R_LINEAR_____167_CM 0. 400. DISPLAY_IDENTIFIER C_CUR_DMTL_DIF_CUR_DMTL_STAT FORMAT "%7.3" /end CHARACTERISTIC
/begin CHARACTERISTIC c_cur_dmtl_ref_leak_max "upper threshold of pump current for reference measurement" VALUE 0x0150e _REC_VAL_20_u2 400. _CNV_A_R_LINEAR_____167_CM 0. 400. DISPLAY_IDENTIFIER C_CUR_DMTL_REF_LEAK_MAX FORMAT "%7.3" /end CHARACTERISTIC
/begin CHARACTERISTIC c_cur_dmtl_ref_leak_min "lower threshold of pump current for reference measurement" VALUE 0x01510 _REC_VAL_20_u2 400. _CNV_A_R_LINEAR_____167_CM 0. 400. DISPLAY_IDENTIFIER C_CUR_DMTL_REF_LEAK_MIN FORMAT "%7.3" /end CHARACTERISTIC
/begin CHARACTERISTIC c_cur_dmtl_ref_ofs "Reference pump current offset" VALUE 0x01512 _REC_VAL_20_u2 400. _CNV_A_R_LINEAR_____167_CM 0. 400. DISPLAY_IDENTIFIER C_CUR_DMTL_REF_OFS FORMAT "%7.3" /end CHARACTERISTIC
/begin CHARACTERISTIC c_ena_fco_diag "Threshold consumed fuel for diagnosis enable" VALUE 0x01552 _REC_VAL_20_u2 4294.9 _CNV_A_R_LINEAR_____168_CM 0. 4294.9 DISPLAY_IDENTIFIER C_ENA_FCO_DIAG FORMAT "%7.2" /end CHARACTERISTIC
/begin CHARACTERISTIC c_fco_diag_max "Upper tolerance variable for level sensor diagnosis" VALUE 0x0037f _REC_VAL_20_s1 255. _CNV_A_R_LINEAR_____96_CM -128. 127. DISPLAY_IDENTIFIER C_FCO_DIAG_MAX FORMAT "%4.0" /end CHARACTERISTIC
/begin CHARACTERISTIC c_fco_diag_min "Lower tolerance variable for level sensor diagnosis" VALUE 0x00380 _REC_VAL_20_s1 255. _CNV_A_R_LINEAR_____96_CM -128. 127. DISPLAY_IDENTIFIER C_FCO_DIAG_MIN FORMAT "%4.0" /end CHARACTERISTIC
/begin CHARACTERISTIC c_ftl_dec_ftl_diag_min "minimum level decrease for refueling detection" VALUE 0x00381 _REC_VAL_20_s1 255. _CNV_A_R_LINEAR_____96_CM -128. 127. DISPLAY_IDENTIFIER C_FTL_DEC_FTL_DIAG_MIN FORMAT "%4.0" /end CHARACTERISTIC
/begin CHARACTERISTIC c_ftl_diag_max "maximum tank level" VALUE 0x015ca _REC_VAL_20_u2 126. _CNV_A_R_LINEAR_____169_CM 0. 126. DISPLAY_IDENTIFIER C_FTL_DIAG_MAX FORMAT "%6.2" /end CHARACTERISTIC
/begin CHARACTERISTIC c_ftl_diag_min "minimum fuel tank volume for refueling detection" VALUE 0x00382 _REC_VAL_20_s1 255. _CNV_A_R_LINEAR_____96_CM -128. 127. DISPLAY_IDENTIFIER C_FTL_DIAG_MIN FORMAT "%4.0" /end CHARACTERISTIC
/begin CHARACTERISTIC c_ftl_dmtl_max "max. tank level for DMTL function" VALUE 0x006ec _REC_VAL_20_u1 5.04 _CNV_A_R_LINEAR_____96_CM 0. 126. DISPLAY_IDENTIFIER C_FTL_DMTL_MAX FORMAT "%3.0" /end CHARACTERISTIC
/begin CHARACTERISTIC c_ftl_dmtl_min "min. tank level for DMTL function" VALUE 0x006ed _REC_VAL_20_u1 5.04 _CNV_A_R_LINEAR_____96_CM 0. 126. DISPLAY_IDENTIFIER C_FTL_DMTL_MIN FORMAT "%3.0" /end CHARACTERISTIC
/begin CHARACTERISTIC c_hys_ftl_dmtl "hysteresis for tank level bit for DMTL function" VALUE 0x006f0 _REC_VAL_20_u1 5.04 _CNV_A_R_LINEAR_____96_CM 0. 126. DISPLAY_IDENTIFIER C_HYS_FTL_DMTL FORMAT "%3.0" /end CHARACTERISTIC
/begin CHARACTERISTIC c_r_dmtl "Resistance of pump current measurement" VALUE 0x007b8 _REC_VAL_20_u1 50. _CNV_A_R_LINEAR_____170_CM 0. 50. DISPLAY_IDENTIFIER C_R_DMTL /end CHARACTERISTIC
/begin CHARACTERISTIC c_sum_ena_rough_leak_max "maximum number of ENABLES satisfied for rough leak check" VALUE 0x007c9 _REC_VAL_20_u1 255. _CNV_A_R_LINEAR_____1_CM 0. 255. DISPLAY_IDENTIFIER C_SUM_ENA_ROUGH_LEAK_MAX FORMAT "%3.0" /end CHARACTERISTIC
/begin CHARACTERISTIC c_sum_ena_rough_leak_test_max "max. number of miniature leak checks after refueling" VALUE 0x007ca _REC_VAL_20_u1 255. _CNV_A_R_LINEAR_____1_CM 0. 255. DISPLAY_IDENTIFIER C_SUM_ENA_ROUGH_LEAK_TEST_MAX FORMAT "%3.0" /end CHARACTERISTIC
/begin CHARACTERISTIC c_sum_ena_small_leak_test_max "max. number of rough leak checks for miniature leak check" VALUE 0x007cb _REC_VAL_20_u1 255. _CNV_A_R_LINEAR_____1_CM 0. 255. DISPLAY_IDENTIFIER C_SUM_ENA_SMALL_LEAK_TEST_MAX FORMAT "%3.0" /end CHARACTERISTIC
/begin CHARACTERISTIC c_sum_rep_rough_leak_mes_fuc_max "maximum number of repeated check filler cap checks" VALUE 0x007cf _REC_VAL_20_u1 255. _CNV_A_R_LINEAR_____1_CM 0. 255. DISPLAY_IDENTIFIER C_SUM_REP_ROUGH_LEAK_MES_FUC_MAX FORMAT "%3.0" /end CHARACTERISTIC
/begin CHARACTERISTIC c_t_cur_dmtl_rough_leak_max "max. time pump current check in rough leak phase" VALUE 0x017c6 _REC_VAL_20_u2 6553.5 _CNV_A_R_LINEAR_____24_CM 0. 6553.5 DISPLAY_IDENTIFIER C_T_CUR_DMTL_ROUGH_LEAK_MAX FORMAT "%6.1" /end CHARACTERISTIC
/begin CHARACTERISTIC c_t_cur_dmtl_rough_leak_min "min. time pump current check in rough leak phase" VALUE 0x017c8 _REC_VAL_20_u2 6553.5 _CNV_A_R_LINEAR_____24_CM 0. 6553.5 DISPLAY_IDENTIFIER C_T_CUR_DMTL_ROUGH_LEAK_MIN FORMAT "%6.1" /end CHARACTERISTIC
/begin CHARACTERISTIC c_t_cur_dmtl_stat "Time for pump current stable" VALUE 0x017ca _REC_VAL_20_u2 6553.5 _CNV_A_R_LINEAR_____24_CM 0. 6553.5 DISPLAY_IDENTIFIER C_T_CUR_DMTL_STAT FORMAT "%6.1" /end CHARACTERISTIC
/begin CHARACTERISTIC c_t_dly_cur_dmtl_dif_mes "Current decrease detection delay during measurement" VALUE 0x017e4 _REC_VAL_20_u2 6553.5 _CNV_A_R_LINEAR_____24_CM 0. 6553.5 DISPLAY_IDENTIFIER C_T_DLY_CUR_DMTL_DIF_MES FORMAT "%6.1" /end CHARACTERISTIC
/begin CHARACTERISTIC c_t_dly_det_refu "Wait period of refueling detection" VALUE 0x017e6 _REC_VAL_20_u2 655.35 _CNV_A_R_LINEAR_____4_CM 0. 655.35 DISPLAY_IDENTIFIER C_T_DLY_DET_REFU FORMAT "%6.2" /end CHARACTERISTIC
/begin CHARACTERISTIC c_t_dly_dmtls "Waiting time after change-over of solenoid valve" VALUE 0x007f3 _REC_VAL_20_u1 25.5 _CNV_A_R_LINEAR_____24_CM 0. 25.5 DISPLAY_IDENTIFIER C_T_DLY_DMTLS FORMAT "%4.1" /end CHARACTERISTIC
/begin CHARACTERISTIC c_t_dly_es_pwl "Post-operating wait period until start of DMTL function" VALUE 0x007f4 _REC_VAL_20_u1 25.5 _CNV_A_R_LINEAR_____24_CM 0. 25.5 DISPLAY_IDENTIFIER C_T_DLY_ES_PWL FORMAT "%4.1" /end CHARACTERISTIC
/begin CHARACTERISTIC c_t_dly_fuc_can_off "Delay time with which Check filler Cap - light is switched off" VALUE 0x017f2 _REC_VAL_20_u2 6553.5 _CNV_A_R_LINEAR_____24_CM 0. 6553.5 DISPLAY_IDENTIFIER C_T_DLY_FUC_CAN_OFF FORMAT "%6.1" /end CHARACTERISTIC
/begin CHARACTERISTIC c_t_dly_fuc_can_on "Delay time with which Check filler Cap - light is switched on" VALUE 0x017f4 _REC_VAL_20_u2 6553.5 _CNV_A_R_LINEAR_____24_CM 0. 6553.5 DISPLAY_IDENTIFIER C_T_DLY_FUC_CAN_ON FORMAT "%6.1" /end CHARACTERISTIC
/begin CHARACTERISTIC c_t_dly_igk_ftl "Minimum time for which LV_IGK must be = 1 to issue a validated level" VALUE 0x007f6 _REC_VAL_20_u1 1.02 _CNV_A_R_LINEAR_____24_CM 0. 25.5 DISPLAY_IDENTIFIER C_T_DLY_IGK_FTL FORMAT "%4.1" /end CHARACTERISTIC
/begin CHARACTERISTIC c_t_dly_req_pwl_dmtl "Post-operating time after no request for extending the post-operating phase is present any longer" VALUE 0x00807 _REC_VAL_20_u1 25.5 _CNV_A_R_LINEAR_____24_CM 0. 25.5 DISPLAY_IDENTIFIER C_T_DLY_REQ_PWL_DMTL FORMAT "%4.1" /end CHARACTERISTIC
/begin CHARACTERISTIC c_t_dmtl_eol_max "Max. time for end of line diagnosis after test unit initiation" VALUE 0x01824 _REC_VAL_20_u2 6553.5 _CNV_A_R_LINEAR_____24_CM 0. 6553.5 DISPLAY_IDENTIFIER C_T_DMTL_EOL_MAX FORMAT "%6.1" /end CHARACTERISTIC
/begin CHARACTERISTIC c_t_dmtl_max "Maximum time for DMTL diagnosis" VALUE 0x01826 _REC_VAL_20_u2 6553.5 _CNV_A_R_LINEAR_____24_CM 0. 6553.5 DISPLAY_IDENTIFIER C_T_DMTL_MAX FORMAT "%6.1" /end CHARACTERISTIC
/begin CHARACTERISTIC c_t_es_dmtl_min "minimum shut-off time for tank leakage diagnosis" VALUE 0x01848 _REC_VAL_20_u2 65535. _CNV_A_R_LINEAR_____97_CM 0. 65535. DISPLAY_IDENTIFIER C_T_ES_DMTL_MIN FORMAT "%5.0" /end CHARACTERISTIC
/begin CHARACTERISTIC c_t_es_sub_dmtl "Substitute shut-off time for tank leakage diagnosis" VALUE 0x0184c _REC_VAL_20_u2 65535. _CNV_A_R_LINEAR_____97_CM 0. 65535. DISPLAY_IDENTIFIER C_T_ES_SUB_DMTL FORMAT "%5.0" /end CHARACTERISTIC
/begin CHARACTERISTIC c_t_ref_leak_mes_max "Time for reference leakage measurement" VALUE 0x01898 _REC_VAL_20_u2 6553.5 _CNV_A_R_LINEAR_____24_CM 0. 6553.5 DISPLAY_IDENTIFIER C_T_REF_LEAK_MES_MAX FORMAT "%6.1" /end CHARACTERISTIC
/begin CHARACTERISTIC c_t_ref_leak_mes_rep_max "Time for repeat reference leakage measurement" VALUE 0x0189a _REC_VAL_20_u2 6553.5 _CNV_A_R_LINEAR_____24_CM 0. 6553.5 DISPLAY_IDENTIFIER C_T_REF_LEAK_MES_REP_MAX FORMAT "%6.1" /end CHARACTERISTIC
/begin CHARACTERISTIC c_t_vb_dly_dmtl "Time delay for Vbat monitoring" VALUE 0x018c4 _REC_VAL_20_u2 6553.5 _CNV_A_R_LINEAR_____24_CM 0. 6553.5 DISPLAY_IDENTIFIER C_T_VB_DLY_DMTL FORMAT "%6.1" /end CHARACTERISTIC
/begin CHARACTERISTIC c_tam_dmtl_min "lower temperature threshold for the DMTL function" VALUE 0x00848 _REC_VAL_20_u1 190.5 _CNV_A_R_LINEAR_____12_CM -48. 142.5 DISPLAY_IDENTIFIER C_TAM_DMTL_MIN FORMAT "%5.1" /end CHARACTERISTIC
/begin CHARACTERISTIC c_tco_st_dmtl_min "min. TCO_ST for DMTL enable" VALUE 0x00898 _REC_VAL_20_u1 190.5 _CNV_A_R_LINEAR_____12_CM -48. 142.5 DISPLAY_IDENTIFIER C_TCO_ST_DMTL_MIN FORMAT "%5.1" /end CHARACTERISTIC
/begin CHARACTERISTIC c_trt_dmtl_eol_max "" VALUE 0x01448 _REC_VAL_20_u4 119304.6471 _CNV_A_R_LINEAR_____171_CM 0. 119304.6471 DISPLAY_IDENTIFIER C_TRT_DMTL_EOL_MAX FORMAT "%12.5" /end CHARACTERISTIC
/begin CHARACTERISTIC c_vb_dmtl_asa_max "Maximum battery threshold at end of line for DMTL" VALUE 0x0091e _REC_VAL_20_u1 26. _CNV_A_R_LINEAR_____60_CM 0. 26. DISPLAY_IDENTIFIER C_VB_DMTL_ASA_MAX FORMAT "%4.1" /end CHARACTERISTIC
/begin CHARACTERISTIC c_vb_dmtl_asa_min "Minimum battery threshold at end of line for DMTL" VALUE 0x0091f _REC_VAL_20_u1 26. _CNV_A_R_LINEAR_____60_CM 0. 26. DISPLAY_IDENTIFIER C_VB_DMTL_ASA_MIN FORMAT "%4.1" /end CHARACTERISTIC
/begin CHARACTERISTIC c_vb_dmtl_dif "Delta VB threshold for DMTL" VALUE 0x019d0 _REC_VAL_20_u2 26. _CNV_A_R_LINEAR_____172_CM 0. 26. DISPLAY_IDENTIFIER C_VB_DMTL_DIF FORMAT "%7.4" /end CHARACTERISTIC
/begin CHARACTERISTIC c_vb_dmtl_max "maximum battery threshold for the DMTL function" VALUE 0x00920 _REC_VAL_20_u1 26. _CNV_A_R_LINEAR_____60_CM 0. 26. DISPLAY_IDENTIFIER C_VB_DMTL_MAX FORMAT "%4.1" /end CHARACTERISTIC
/begin CHARACTERISTIC c_vb_dmtl_min "minimum battery threshold for the DMTL function" VALUE 0x00921 _REC_VAL_20_u1 26. _CNV_A_R_LINEAR_____60_CM 0. 26. DISPLAY_IDENTIFIER C_VB_DMTL_MIN FORMAT "%4.1" /end CHARACTERISTIC
/begin CHARACTERISTIC c_vs_ftl_diag_max "" VALUE 0x00942 _REC_VAL_20_u1 255. _CNV_A_R_LINEAR_____23_CM 0. 255. DISPLAY_IDENTIFIER C_VS_FTL_DIAG_MAX FORMAT "%3.0" /end CHARACTERISTIC
/begin MEASUREMENT ctr_cnl_rough_leak_mes_fuc "Number of aborted check filler cap checks" UBYTE _CNV_A_R_LINEAR_____1_CM 1 100. 0. 255. DISPLAY_IDENTIFIER CTR_CNL_ROUGH_LEAK_MES_FUC ECU_ADDRESS 0x3fe492 FORMAT "%3.0" /end MEASUREMENT
/begin MEASUREMENT ctr_cnl_small_leak_mes "Number of aborted miniature leak measurements due to current fluctuations" UBYTE _CNV_A_R_LINEAR_____1_CM 1 100. 0. 255. DISPLAY_IDENTIFIER CTR_CNL_SMALL_LEAK_MES ECU_ADDRESS 0x3fe493 FORMAT "%3.0" /end MEASUREMENT
/begin MEASUREMENT ctr_cur_dmtl_ref_dif_max "Number of aborted measurements due to current fluctuation" UWORD _CNV_A_R_LINEAR_____1_CM 1 100. 0. 65535. DISPLAY_IDENTIFIER CTR_CUR_DMTL_REF_DIF_MAX ECU_ADDRESS 0x3fd672 BYTE_ORDER MSB_LAST FORMAT "%5.0" /end MEASUREMENT
/begin MEASUREMENT ctr_dmtl_act "Number of commenced leakage measurements" UWORD _CNV_A_R_LINEAR_____1_CM 1 100. 0. 65535. DISPLAY_IDENTIFIER CTR_DMTL_ACT ECU_ADDRESS 0x3fd674 BYTE_ORDER MSB_LAST FORMAT "%5.0" /end MEASUREMENT
/begin MEASUREMENT ctr_rep_rough_leak_mes_fuc "Number of repeated check filler cap checks" UBYTE _CNV_A_R_LINEAR_____1_CM 1 100. 0. 255. DISPLAY_IDENTIFIER CTR_REP_ROUGH_LEAK_MES_FUC ECU_ADDRESS 0x3fe497 FORMAT "%3.0" /end MEASUREMENT
/begin MEASUREMENT ctr_rough_leak_mes "Number of realized rough leak diagnosis" UWORD _CNV_A_R_LINEAR_____1_CM 1 100. 0. 65535. DISPLAY_IDENTIFIER CTR_ROUGH_LEAK_MES ECU_ADDRESS 0x3fd676 BYTE_ORDER MSB_LAST FORMAT "%5.0" /end MEASUREMENT
/begin MEASUREMENT ctr_small_leak_mes "Number of realized miniature leak diagnosis" UWORD _CNV_A_R_LINEAR_____1_CM 1 100. 0. 65535. DISPLAY_IDENTIFIER CTR_SMALL_LEAK_MES ECU_ADDRESS 0x3fd678 BYTE_ORDER MSB_LAST FORMAT "%5.0" /end MEASUREMENT
/begin MEASUREMENT cur_dmtl "Pump current tank leakage diagnosis" UWORD _CNV_A_R_LINEAR_____167_CM 1 100. 0. 400. DISPLAY_IDENTIFIER CUR_DMTL ECU_ADDRESS 0x3fd67a BYTE_ORDER MSB_LAST FORMAT "%7.3" /end MEASUREMENT
/begin MEASUREMENT cur_dmtl_comp_rough_leak "Pump current comparision in case of rough leak measurement" UWORD _CNV_A_R_LINEAR_____167_CM 1 100. 0. 400. DISPLAY_IDENTIFIER CUR_DMTL_COMP_ROUGH_LEAK ECU_ADDRESS 0x3fd6ba BYTE_ORDER MSB_LAST FORMAT "%7.3" /end MEASUREMENT
/begin MEASUREMENT cur_dmtl_comp_small_leak_len "Pump current comparision in case of 2. miniature leak measurement" UWORD _CNV_A_R_LINEAR_____167_CM 1 100. 0. 400. DISPLAY_IDENTIFIER CUR_DMTL_COMP_SMALL_LEAK_LEN ECU_ADDRESS 0x3fd6bc BYTE_ORDER MSB_LAST FORMAT "%7.3" /end MEASUREMENT
/begin MEASUREMENT cur_dmtl_cor_fil_max "Maximum pump current during reference leka measurement" UWORD _CNV_A_R_LINEAR_____167_CM 1 100. 0. 400. DISPLAY_IDENTIFIER CUR_DMTL_COR_FIL_MAX ECU_ADDRESS 0x3fd6c0 BYTE_ORDER MSB_LAST FORMAT "%7.3" /end MEASUREMENT
/begin MEASUREMENT cur_dmtl_cor_fil_min "Minimum pump current during reference leak  measurement" UWORD _CNV_A_R_LINEAR_____167_CM 1 100. 0. 400. DISPLAY_IDENTIFIER CUR_DMTL_COR_FIL_MIN ECU_ADDRESS 0x3fd6c4 BYTE_ORDER MSB_LAST FORMAT "%7.3" /end MEASUREMENT
/begin MEASUREMENT cur_dmtl_cor_fil_refu_hpf "corrected, high-pass filtered pump current" SWORD _CNV_A_R_LINEAR_____166_CM 1 100. -200. 199.9938 DISPLAY_IDENTIFIER CUR_DMTL_COR_FIL_REFU_HPF ECU_ADDRESS 0x3fd6f0 BYTE_ORDER MSB_LAST FORMAT "%8.3" /end MEASUREMENT
/begin MEASUREMENT cur_dmtl_dif "Differential pump current" UWORD _CNV_A_R_LINEAR_____167_CM 1 100. 0. 400. DISPLAY_IDENTIFIER CUR_DMTL_DIF ECU_ADDRESS 0x3fd6c6 BYTE_ORDER MSB_LAST FORMAT "%7.3" /end MEASUREMENT
/begin MEASUREMENT cur_dmtl_dif_ref_rough_leak "Difference, pump current  between reference and min. in case of rough leak check" UWORD _CNV_A_R_LINEAR_____167_CM 1 100. 0. 400. DISPLAY_IDENTIFIER CUR_DMTL_DIF_REF_ROUGH_LEAK ECU_ADDRESS 0x3fd67c BYTE_ORDER MSB_LAST FORMAT "%7.3" /end MEASUREMENT
/begin MEASUREMENT cur_dmtl_ref_leak "Pump current reference leakage" UWORD _CNV_A_R_LINEAR_____167_CM 1 100. 0. 400. DISPLAY_IDENTIFIER CUR_DMTL_REF_LEAK ECU_ADDRESS 0x3fd680 BYTE_ORDER MSB_LAST FORMAT "%7.3" /end MEASUREMENT
/begin MEASUREMENT cur_dmtl_rough_leak_len_end "Pump current at the end of the rough leak measurement extension" UWORD _CNV_A_R_LINEAR_____167_CM 1 100. 0. 400. DISPLAY_IDENTIFIER CUR_DMTL_ROUGH_LEAK_LEN_END ECU_ADDRESS 0x3fd6ce BYTE_ORDER MSB_LAST FORMAT "%7.3" /end MEASUREMENT
/begin MEASUREMENT cur_dmtl_rough_leak_min "Min. pump current in case of rough leak measurement" UWORD _CNV_A_R_LINEAR_____167_CM 1 100. 0. 400. DISPLAY_IDENTIFIER CUR_DMTL_ROUGH_LEAK_MIN ECU_ADDRESS 0x3fd684 BYTE_ORDER MSB_LAST FORMAT "%7.3" /end MEASUREMENT
/begin MEASUREMENT cur_dmtl_thd_rough_leak_len "Pump current threshold in case of rough leak measurement extension" UWORD _CNV_A_R_LINEAR_____167_CM 1 100. 0. 400. DISPLAY_IDENTIFIER CUR_DMTL_THD_ROUGH_LEAK_LEN ECU_ADDRESS 0x3fd6d6 BYTE_ORDER MSB_LAST FORMAT "%7.3" /end MEASUREMENT
/begin MEASUREMENT fco_av_dmtl "currently consumed fuel" UWORD _CNV_A_R_LINEAR_____168_CM 1 100. 0. 4294.9 DISPLAY_IDENTIFIER FCO_AV_DMTL ECU_ADDRESS 0x3fd688 BYTE_ORDER MSB_LAST FORMAT "%7.2" /end MEASUREMENT
/begin MEASUREMENT state_dmtl "DMTL state" UBYTE _CNV_S_13_STATE_DMTL_173_CM 1 100. 0. 12. DISPLAY_IDENTIFIER STATE_DMTL ECU_ADDRESS 0x3fe49e /end MEASUREMENT
/begin MEASUREMENT t_act_cur_dmtl_stat "Current time, pump current stable" UWORD _CNV_A_R_LINEAR_____24_CM 1 100. 0. 6553.5 DISPLAY_IDENTIFIER T_ACT_CUR_DMTL_STAT ECU_ADDRESS 0x3fd6da BYTE_ORDER MSB_LAST FORMAT "%6.1" /end MEASUREMENT
/begin MEASUREMENT t_act_leak_mes "Current time, leakage measurement" UWORD _CNV_A_R_LINEAR_____24_CM 1 100. 0. 6553.5 DISPLAY_IDENTIFIER T_ACT_LEAK_MES ECU_ADDRESS 0x3fd694 BYTE_ORDER MSB_LAST FORMAT "%6.1" /end MEASUREMENT
/begin MEASUREMENT t_act_ref_leak_mes "Current time, reference leakage measurement" UWORD _CNV_A_R_LINEAR_____24_CM 1 100. 0. 6553.5 DISPLAY_IDENTIFIER T_ACT_REF_LEAK_MES ECU_ADDRESS 0x3fd6dc BYTE_ORDER MSB_LAST FORMAT "%6.1" /end MEASUREMENT
/begin MEASUREMENT t_es_dmtl "Engine off duration time for the DMTL-function" UWORD _CNV_A_R_LINEAR_____97_CM 1 100. 0. 65535. DISPLAY_IDENTIFIER T_ES_DMTL ECU_ADDRESS 0x3fd6e8 BYTE_ORDER MSB_LAST FORMAT "%5.0" /end MEASUREMENT
/begin MEASUREMENT cur_dmtl_dmtls_test "pump current during pump test" UWORD _CNV_A_R_LINEAR_____167_CM 1 100. 0. 400. DISPLAY_IDENTIFIER CUR_DMTL_DMTLS_TEST ECU_ADDRESS 0x3fd6c8 BYTE_ORDER MSB_LAST FORMAT "%7.3" /end MEASUREMENT
/begin MEASUREMENT cur_dmtl_thd_rough_leak "Pump current threshold in case of rough leak measurement" UWORD _CNV_A_R_LINEAR_____167_CM 1 100. 0. 400. DISPLAY_IDENTIFIER CUR_DMTL_THD_ROUGH_LEAK ECU_ADDRESS 0x3fd6d4 BYTE_ORDER MSB_LAST FORMAT "%7.3" /end MEASUREMENT
/begin MEASUREMENT cur_dmtl_thd_dmtls_test "Pump current threshold in case of DMTL valve check" UWORD _CNV_A_R_LINEAR_____167_CM 1 100. 0. 400. DISPLAY_IDENTIFIER CUR_DMTL_THD_DMTLS_TEST ECU_ADDRESS 0x3fd6d2 BYTE_ORDER MSB_LAST FORMAT "%7.3" /end MEASUREMENT
/begin CHARACTERISTIC c_t_ast_dmtl_max "min. post-starting period for canister purge diagnosis" VALUE 0x017b4 _REC_VAL_20_u2 6553.2 _CNV_A_R_LINEAR_____24_CM 0.3 6553.5 DISPLAY_IDENTIFIER C_T_AST_DMTL_MAX FORMAT "%6.1" /end CHARACTERISTIC
/begin CHARACTERISTIC c_t_act_rough_leak "Time for rough leak measurement" VALUE 0x017ac _REC_VAL_20_u2 6553.2 _CNV_A_R_LINEAR_____24_CM 0.3 6553.5 DISPLAY_IDENTIFIER C_T_ACT_ROUGH_LEAK FORMAT "%6.1" /end CHARACTERISTIC
/begin CHARACTERISTIC c_t_act_small_leak "Time for miniature leak measurement" VALUE 0x017ae _REC_VAL_20_u2 6553.2 _CNV_A_R_LINEAR_____24_CM 0.3 6553.5 DISPLAY_IDENTIFIER C_T_ACT_SMALL_LEAK FORMAT "%6.1" /end CHARACTERISTIC
/begin CHARACTERISTIC ip_t_act_small_leak__ftl "Time for miniature leak measurement" CURVE 0x0dd6c _REC_CUR_20_u2_u1 655.35 _CNV_A_R_LINEAR_____24_CM 0. 6553.5 DISPLAY_IDENTIFIER IP_T_ACT_SMALL_LEAK__FTL FORMAT "%6.1"
 /begin AXIS_DESCR COM_AXIS ftl _CNV_A_R_LINEAR_____96_CM 5 0. 126. FORMAT "%3.0" AXIS_PTS_REF ldp_ftl__t_small_leak_test /end AXIS_DESCR
/end CHARACTERISTIC
/begin CHARACTERISTIC ip_fac_cur_dmtl_rough "Factor delta pump current for rough leak detection" CURVE 0x0abce _REC_CUR_20_u2_u2 0.99998474 _CNV_A_R_LINEAR_____37_CM 0. 0.99998474 DISPLAY_IDENTIFIER IP_FAC_CUR_DMTL_ROUGH FORMAT "%7.5"
 /begin AXIS_DESCR COM_AXIS cur_dmtl_dif_ref_rough_leak _CNV_A_R_LINEAR_____167_CM 8 0. 400. FORMAT "%7.3" AXIS_PTS_REF ldpm_cur_dmtldifrefroughleak_1 /end AXIS_DESCR
/end CHARACTERISTIC
/begin CHARACTERISTIC ip_fac_cur_dmtl_ref "Factor delta pump current for rouh leak detection concerning reference" CURVE 0x0abbe _REC_CUR_20_u2_u2 0.99998474 _CNV_A_R_LINEAR_____37_CM 0. 0.99998474 DISPLAY_IDENTIFIER IP_FAC_CUR_DMTL_REF FORMAT "%7.5"
 /begin AXIS_DESCR COM_AXIS cur_dmtl_dif_ref_rough_leak _CNV_A_R_LINEAR_____167_CM 8 0. 400. FORMAT "%7.3" AXIS_PTS_REF ldpm_cur_dmtldifrefroughleak_1 /end AXIS_DESCR
/end CHARACTERISTIC
/begin CHARACTERISTIC ip_t_cur_dmtl_stat "Time for pump current stable" MAP 0x0df06 _REC_MAP_20_u2_u2_u1 655.35 _CNV_A_R_LINEAR_____24_CM 0. 6553.5 DISPLAY_IDENTIFIER IP_T_CUR_DMTL_STAT FORMAT "%6.1"
 /begin AXIS_DESCR COM_AXIS cur_dmtl_dif_ref_rough_leak _CNV_A_R_LINEAR_____167_CM 8 0. 400. FORMAT "%7.3" AXIS_PTS_REF ldpm_cur_dmtldifrefroughleak_1 /end AXIS_DESCR
 /begin AXIS_DESCR COM_AXIS ftl _CNV_A_R_LINEAR_____96_CM 8 0. 126. FORMAT "%3.0" AXIS_PTS_REF ldp_ftl__t_cur_dmtl_stat /end AXIS_DESCR
/end CHARACTERISTIC
/begin CHARACTERISTIC c_t_ref_test_rough_leak "Time for reference test in case of rough leak check" VALUE 0x0189c _REC_VAL_20_u2 6553.5 _CNV_A_R_LINEAR_____24_CM 0. 6553.5 DISPLAY_IDENTIFIER C_T_REF_TEST_ROUGH_LEAK FORMAT "%6.1" /end CHARACTERISTIC
/begin CHARACTERISTIC c_fac_t_cur_dmtl_stat_len "Factor for 2. stabilization" VALUE 0x01584 _REC_VAL_20_u2 0.99997 _CNV_A_R_LINEAR_____174_CM 0. 0.99997 DISPLAY_IDENTIFIER C_FAC_T_CUR_DMTL_STAT_LEN FORMAT "%8.6" /end CHARACTERISTIC
/begin MEASUREMENT cur_dmtl_cor "Corrected pump current" UWORD _CNV_A_R_LINEAR_____167_CM 1 100. 0. 400. DISPLAY_IDENTIFIER CUR_DMTL_COR ECU_ADDRESS 0x3fd6be BYTE_ORDER MSB_LAST FORMAT "%7.3" /end MEASUREMENT
/begin MEASUREMENT cur_dmtl_cor_fil "corrected and filtered pump current" UWORD _CNV_A_R_LINEAR_____167_CM 1 100. 0. 400. DISPLAY_IDENTIFIER CUR_DMTL_COR_FIL ECU_ADDRESS 0x3fccf0 BYTE_ORDER MSB_LAST FORMAT "%7.3" /end MEASUREMENT
/begin CHARACTERISTIC ip_fac_cur_dmtl "Battery-voltage dependent correction factor for the pump current" CURVE 0x00ae1 _REC_CUR_20_u1_u2 1.9921875 _CNV_A_R_LINEAR_____115_CM 0. 1.9921875 DISPLAY_IDENTIFIER IP_FAC_CUR_DMTL FORMAT "%5.3"
 /begin AXIS_DESCR COM_AXIS vb_dmtl_fil _CNV_A_R_LINEAR_____172_CM 6 0. 26. FORMAT "%7.4" AXIS_PTS_REF ldp_vb_dmtl_fil__fac_cur_dmtl /end AXIS_DESCR
/end CHARACTERISTIC
/begin MEASUREMENT vb_dmtl_ref "Filtered battery voltage on transition to refeence leak measurement" UWORD _CNV_A_R_LINEAR_____172_CM 1 100. 0. 26. DISPLAY_IDENTIFIER VB_DMTL_REF ECU_ADDRESS 0x3fd6ee BYTE_ORDER MSB_LAST FORMAT "%7.4" /end MEASUREMENT
/begin MEASUREMENT vb_dmtl_fil "Filtered battery voltage" UWORD _CNV_A_R_LINEAR_____172_CM 1 100. 0. 26. DISPLAY_IDENTIFIER VB_DMTL_FIL ECU_ADDRESS 0x3fd69a BYTE_ORDER MSB_LAST FORMAT "%7.4" /end MEASUREMENT
/begin CHARACTERISTIC c_tam_dmtl_max "upper temperature threshold for the DMTL function" VALUE 0x00847 _REC_VAL_20_u1 190.5 _CNV_A_R_LINEAR_____12_CM -48. 142.5 DISPLAY_IDENTIFIER C_TAM_DMTL_MAX FORMAT "%5.1" /end CHARACTERISTIC
/begin CHARACTERISTIC c_cl_dmtl_max "maximum loading degree for the DMTL function" VALUE 0x014a8 _REC_VAL_20_u2 1.99996948 _CNV_A_R_LINEAR_____21_CM 0. 1.99996948 DISPLAY_IDENTIFIER C_CL_DMTL_MAX FORMAT "%7.5" /end CHARACTERISTIC
/begin CHARACTERISTIC c_vs_fuc_can_min "Minimum speed for activation Check filler cap" VALUE 0x00943 _REC_VAL_20_u1 255. _CNV_A_R_LINEAR_____23_CM 0. 255. DISPLAY_IDENTIFIER C_VS_FUC_CAN_MIN FORMAT "%3.0" /end CHARACTERISTIC
/begin CHARACTERISTIC c_vs_dmtl_max "max. vehicle speed" VALUE 0x00940 _REC_VAL_20_u1 255. _CNV_A_R_LINEAR_____23_CM 0. 255. DISPLAY_IDENTIFIER C_VS_DMTL_MAX FORMAT "%3.0" /end CHARACTERISTIC
/begin MEASUREMENT ftl_ini "Ini value level for diagnostic cycle" UBYTE _CNV_A_R_LINEAR_____96_CM 1 100. 0. 126. DISPLAY_IDENTIFIER FTL_INI ECU_ADDRESS 0x3fe49c FORMAT "%3.0" /end MEASUREMENT
/begin MEASUREMENT ftl_old "FTL for plausibility check" UBYTE _CNV_A_R_LINEAR_____96_CM 1 100. 0. 126. DISPLAY_IDENTIFIER FTL_OLD ECU_ADDRESS 0x3fe49d FORMAT "%3.0" /end MEASUREMENT
/begin MEASUREMENT ctr_ena_rough_leak "Counter of  enable conditions fulfilled, without rough leak test" UBYTE _CNV_A_R_LINEAR_____1_CM 1 100. 0. 255. DISPLAY_IDENTIFIER CTR_ENA_ROUGH_LEAK ECU_ADDRESS 0x3fe494 FORMAT "%3.0" /end MEASUREMENT
/begin CHARACTERISTIC c_sum_cnl_rough_leak_mes_fuc_max "maximum number of aborted check filler cap checks" VALUE 0x007c4 _REC_VAL_20_u1 255. _CNV_A_R_LINEAR_____1_CM 0. 255. DISPLAY_IDENTIFIER C_SUM_CNL_ROUGH_LEAK_MES_FUC_MAX FORMAT "%3.0" /end CHARACTERISTIC
/begin CHARACTERISTIC c_sum_cnl_small_leak_mes_max "Max. number of aborted miniature leak  checks due to current fluctuations" VALUE 0x007c5 _REC_VAL_20_u1 255. _CNV_A_R_LINEAR_____1_CM 0. 255. DISPLAY_IDENTIFIER C_SUM_CNL_SMALL_LEAK_MES_MAX FORMAT "%3.0" /end CHARACTERISTIC
/begin MEASUREMENT ctr_ena_rough_leak_test "Counter for the number of rough leak checks for miniature leak check" UBYTE _CNV_A_R_LINEAR_____1_CM 1 100. 0. 255. DISPLAY_IDENTIFIER CTR_ENA_ROUGH_LEAK_TEST ECU_ADDRESS 0x3fe495 FORMAT "%3.0" /end MEASUREMENT
/begin MEASUREMENT ctr_ena_small_leak_test "Counter recording the number of miniature leak checks after refueling" UBYTE _CNV_A_R_LINEAR_____1_CM 1 100. 0. 255. DISPLAY_IDENTIFIER CTR_ENA_SMALL_LEAK_TEST ECU_ADDRESS 0x3fe496 FORMAT "%3.0" /end MEASUREMENT
/begin CHARACTERISTIC c_cur_dmtl_ref_dif_max "Upper threshold of the Delta pump current" VALUE 0x0150c _REC_VAL_20_u2 400. _CNV_A_R_LINEAR_____167_CM 0. 400. DISPLAY_IDENTIFIER C_CUR_DMTL_REF_DIF_MAX FORMAT "%7.3" /end CHARACTERISTIC
/begin CHARACTERISTIC c_cur_dmtl_dif_thd_refu "Threshold pump current change for refueling detection" VALUE 0x003e0 _REC_VAL_20_s2 399.9938 _CNV_A_R_LINEAR_____166_CM -200. 199.9938 DISPLAY_IDENTIFIER C_CUR_DMTL_DIF_THD_REFU FORMAT "%8.3" /end CHARACTERISTIC
/begin CHARACTERISTIC c_cur_dmtl_dif_thd_fuc "Threshold pump current change for refueling detection" VALUE 0x003de _REC_VAL_20_s2 399.9938 _CNV_A_R_LINEAR_____166_CM -200. 199.9938 DISPLAY_IDENTIFIER C_CUR_DMTL_DIF_THD_FUC FORMAT "%8.3" /end CHARACTERISTIC
/begin CHARACTERISTIC c_cur_dmtl_dif_thd_mes "Current decrease threshold during measurement" VALUE 0x0150a _REC_VAL_20_u2 400. _CNV_A_R_LINEAR_____167_CM 0. 400. DISPLAY_IDENTIFIER C_CUR_DMTL_DIF_THD_MES FORMAT "%7.3" /end CHARACTERISTIC
/begin CHARACTERISTIC c_dist_refu_rough_leak_min "lower threshold of distance covered between refueling and rough leak suspicion" VALUE 0x0152a _REC_VAL_20_u2 65535. _CNV_A_R_LINEAR_____175_CM 0. 65535. DISPLAY_IDENTIFIER C_DIST_REFU_ROUGH_LEAK_MIN FORMAT "%5.0" /end CHARACTERISTIC
/begin CHARACTERISTIC lc_cod_hdmtl "Max. time for end of line diagnosis after test unit initiation" VALUE 0x00f0a _REC_VAL_20_u1 1. _CNV_A_R_LINEAR_____1_CM 0. 1. DISPLAY_IDENTIFIER LC_COD_HDMTL FORMAT "%2.0" /end CHARACTERISTIC
/begin CHARACTERISTIC ip_t_act_rough_leak "Time for rough leak measurement" CURVE 0x0dd62 _REC_CUR_20_u2_u1 655.35 _CNV_A_R_LINEAR_____24_CM 0. 6553.5 DISPLAY_IDENTIFIER IP_T_ACT_ROUGH_LEAK FORMAT "%6.1"
 /begin AXIS_DESCR COM_AXIS ftl _CNV_A_R_LINEAR_____96_CM 5 0. 126. FORMAT "%3.0" AXIS_PTS_REF ldp_ftl__t_rough_leak_test /end AXIS_DESCR
/end CHARACTERISTIC
/begin AXIS_PTS ldp_ftl__t_cur_dmtl_stat "" 0x07ae9 ftl _REC_AXS_20_u1 126. _CNV_A_R_LINEAR_____96_CM 8 0. 126. DISPLAY_IDENTIFIER LDP_FTL__T_CUR_DMTL_STAT FORMAT "%3.0" /end AXIS_PTS
/begin AXIS_PTS ldp_ftl__t_small_leak_test "" 0x00fc9 ftl _REC_AXS_20_u1 126. _CNV_A_R_LINEAR_____96_CM 5 0. 126. DISPLAY_IDENTIFIER LDP_FTL__T_SMALL_LEAK_TEST FORMAT "%3.0" /end AXIS_PTS
/begin AXIS_PTS ldp_vb_dmtl_fil__fac_cur_dmtl "" 0x114c4 vb_dmtl_fil _REC_AXS_20_u2 26. _CNV_A_R_LINEAR_____172_CM 6 0. 26. DISPLAY_IDENTIFIER LDP_VB_DMTL_FIL__FAC_CUR_DMTL FORMAT "%7.4" /end AXIS_PTS
/begin AXIS_PTS ldpm_cur_dmtldifrefroughleak_1 "" 0x115f6 cur_dmtl_dif_ref_rough_leak _REC_AXS_20_u2 400. _CNV_A_R_LINEAR_____167_CM 8 0. 400. DISPLAY_IDENTIFIER LDPM_CUR_DMTLDIFREFROUGHLEAK_1 FORMAT "%7.3" /end AXIS_PTS
/begin AXIS_PTS ldp_ftl__t_rough_leak_test "" 0x00fc3 ftl _REC_AXS_20_u1 126. _CNV_A_R_LINEAR_____96_CM 5 0. 126. DISPLAY_IDENTIFIER LDP_FTL__T_ROUGH_LEAK_TEST FORMAT "%3.0" /end AXIS_PTS
/begin MEASUREMENT dmtl_priv_state_1.bitfield.lv_chk_dmtl_cur_dmtl_vld "Check of components on pump current thresholds valid" ULONG _CNV_S_2_RANGE______0_CM 1 100. 0. 1. DISPLAY_IDENTIFIER LV_CHK_DMTL_CUR_DMTL_VLD ECU_ADDRESS 0x3fccfc BYTE_ORDER MSB_LAST BIT_MASK 0x80000000 /end MEASUREMENT
/begin MEASUREMENT dmtl_priv_state_1.bitfield.lv_chk_dmtl_vld "Check of components on current fluctuations valid" ULONG _CNV_S_2_RANGE______0_CM 1 100. 0. 1. DISPLAY_IDENTIFIER LV_CHK_DMTL_VLD ECU_ADDRESS 0x3fccfc BYTE_ORDER MSB_LAST BIT_MASK 0x40000000 /end MEASUREMENT
/begin MEASUREMENT dmtl_priv_state_1.bitfield.lv_cur_dmtl_dmtls_test "Pump current threshold reached in case of  DMTL-valve check" ULONG _CNV_S_2_RANGE______0_CM 1 100. 0. 1. DISPLAY_IDENTIFIER LV_CUR_DMTL_DMTLS_TEST ECU_ADDRESS 0x3fccfc BYTE_ORDER MSB_LAST BIT_MASK 0x1000000 /end MEASUREMENT
/begin MEASUREMENT dmtl_priv_state_1.bitfield.lv_cur_dmtl_ref_mes_max "Upper pump current threshold reached during reference measurement" ULONG _CNV_S_2_RANGE______0_CM 1 100. 0. 1. DISPLAY_IDENTIFIER LV_CUR_DMTL_REF_MES_MAX ECU_ADDRESS 0x3fccfc BYTE_ORDER MSB_LAST BIT_MASK 0x800000 /end MEASUREMENT
/begin MEASUREMENT dmtl_priv_state_1.bitfield.lv_cur_dmtl_ref_mes_min "Lower pump current threshold reached during reference measurement" ULONG _CNV_S_2_RANGE______0_CM 1 100. 0. 1. DISPLAY_IDENTIFIER LV_CUR_DMTL_REF_MES_MIN ECU_ADDRESS 0x3fccfc BYTE_ORDER MSB_LAST BIT_MASK 0x400000 /end MEASUREMENT
/begin MEASUREMENT dmtl_priv_state_1.bitfield.lv_cyc_rough_leak_susp "Cycle flag, rough leak suspected" ULONG _CNV_S_2_RANGE______0_CM 1 100. 0. 1. DISPLAY_IDENTIFIER LV_CYC_ROUGH_LEAK_SUSP ECU_ADDRESS 0x3fccfc BYTE_ORDER MSB_LAST BIT_MASK 0x200000 /end MEASUREMENT
/begin MEASUREMENT dmtl_priv_state_1.bitfield.lv_dist_dmtl "Minimum distance after suspected rough leak or refueling" ULONG _CNV_S_2_RANGE______0_CM 1 100. 0. 1. DISPLAY_IDENTIFIER LV_DIST_DMTL ECU_ADDRESS 0x3fccfc BYTE_ORDER MSB_LAST BIT_MASK 0x20000 /end MEASUREMENT
/begin MEASUREMENT dmtl_priv_state_1.bitfield.lv_dmtl_asa "Factory test active" ULONG _CNV_S_2_RANGE______0_CM 1 100. 0. 1. DISPLAY_IDENTIFIER LV_DMTL_ASA ECU_ADDRESS 0x3fccfc BYTE_ORDER MSB_LAST BIT_MASK 0x10000 /end MEASUREMENT
/begin MEASUREMENT dmtl_priv_state_1.bitfield.lv_dmtl_eol "End of line test active" ULONG _CNV_S_2_RANGE______0_CM 1 100. 0. 1. DISPLAY_IDENTIFIER LV_DMTL_EOL ECU_ADDRESS 0x3fccfc BYTE_ORDER MSB_LAST BIT_MASK 0x8000 /end MEASUREMENT
/begin MEASUREMENT dmtl_priv_state_1.bitfield.lv_dmtl_pump "controlbit of the DMTL pump powerstage" ULONG _CNV_S_2_RANGE______0_CM 1 100. 0. 1. DISPLAY_IDENTIFIER LV_DMTL_PUMP ECU_ADDRESS 0x3fccfc BYTE_ORDER MSB_LAST BIT_MASK 0x1000 /end MEASUREMENT
/begin MEASUREMENT dmtl_priv_state_1.bitfield.lv_dmtl_pump_on "DMTL pump motor on" ULONG _CNV_S_2_RANGE______0_CM 1 100. 0. 1. DISPLAY_IDENTIFIER LV_DMTL_PUMP_ON ECU_ADDRESS 0x3fccfc BYTE_ORDER MSB_LAST BIT_MASK 0x800 /end MEASUREMENT
/begin MEASUREMENT dmtl_priv_state_1.bitfield.lv_dmtl_rst_rough_leak "inhibit small leak diagnosis" ULONG _CNV_S_2_RANGE______0_CM 1 100. 0. 1. DISPLAY_IDENTIFIER LV_DMTL_RST_ROUGH_LEAK ECU_ADDRESS 0x3fccfc BYTE_ORDER MSB_LAST BIT_MASK 0x400 /end MEASUREMENT
/begin MEASUREMENT dmtl_priv_state_1.bitfield.lv_dmtls "controlbit of the DMTL solenoid powerstage" ULONG _CNV_S_2_RANGE______0_CM 1 100. 0. 1. DISPLAY_IDENTIFIER LV_DMTLS ECU_ADDRESS 0x3fccfc BYTE_ORDER MSB_LAST BIT_MASK 0x200 /end MEASUREMENT
/begin MEASUREMENT dmtl_priv_state_1.bitfield.lv_dmtls_on "DMTL valve on" ULONG _CNV_S_2_RANGE______0_CM 1 100. 0. 1. DISPLAY_IDENTIFIER LV_DMTLS_ON ECU_ADDRESS 0x3fccfc BYTE_ORDER MSB_LAST BIT_MASK 0x100 /end MEASUREMENT
/begin MEASUREMENT dmtl_priv_state_1.bitfield.lv_dr_dmtl "Enabling the output stages of the DMTL module" ULONG _CNV_S_2_RANGE______0_CM 1 100. 0. 1. DISPLAY_IDENTIFIER LV_DR_DMTL ECU_ADDRESS 0x3fccfc BYTE_ORDER MSB_LAST BIT_MASK 0x80 /end MEASUREMENT
/begin MEASUREMENT dmtl_priv_state_1.bitfield.lv_dr_dmtl_pump "DMTL pump activation" ULONG _CNV_S_2_RANGE______0_CM 1 100. 0. 1. DISPLAY_IDENTIFIER LV_DR_DMTL_PUMP ECU_ADDRESS 0x3fccfc BYTE_ORDER MSB_LAST BIT_MASK 0x40 /end MEASUREMENT
/begin MEASUREMENT dmtl_priv_state_1.bitfield.lv_ena_fco_diag "Consumption diagnosis enable" ULONG _CNV_S_2_RANGE______0_CM 1 100. 0. 1. DISPLAY_IDENTIFIER LV_ENA_FCO_DIAG ECU_ADDRESS 0x3fccfc BYTE_ORDER MSB_LAST BIT_MASK 0x20 /end MEASUREMENT
/begin MEASUREMENT dmtl_priv_state_1.bitfield.lv_ena_ftl_diag "Fuel level diagnosis enable" ULONG _CNV_S_2_RANGE______0_CM 1 100. 0. 1. DISPLAY_IDENTIFIER LV_ENA_FTL_DIAG ECU_ADDRESS 0x3fccfc BYTE_ORDER MSB_LAST BIT_MASK 0x10 /end MEASUREMENT
/begin MEASUREMENT dmtl_priv_state_2.bitfield.lv_ena_fuc_rough_leak_mes "Enable rough leak measurement due to Check Filler Cap" ULONG _CNV_S_2_RANGE______0_CM 1 100. 0. 1. DISPLAY_IDENTIFIER LV_ENA_FUC_ROUGH_LEAK_MES ECU_ADDRESS 0x3fcd00 BYTE_ORDER MSB_LAST BIT_MASK 0x80000000 /end MEASUREMENT
/begin MEASUREMENT dmtl_priv_state_2.bitfield.lv_ena_main_dmtl "DMTL main enabling" ULONG _CNV_S_2_RANGE______0_CM 1 100. 0. 1. DISPLAY_IDENTIFIER LV_ENA_MAIN_DMTL ECU_ADDRESS 0x3fcd00 BYTE_ORDER MSB_LAST BIT_MASK 0x40000000 /end MEASUREMENT
/begin MEASUREMENT dmtl_priv_state_2.bitfield.lv_ena_main_dmtl_fuc "Main enabling DMTL Check Filler Cap" ULONG _CNV_S_2_RANGE______0_CM 1 100. 0. 1. DISPLAY_IDENTIFIER LV_ENA_MAIN_DMTL_FUC ECU_ADDRESS 0x3fcd00 BYTE_ORDER MSB_LAST BIT_MASK 0x20000000 /end MEASUREMENT
/begin MEASUREMENT dmtl_priv_state_2.bitfield.lv_ena_rough_leak_1 "Auxiliary bit enable condition for rough leak check is present" ULONG _CNV_S_2_RANGE______0_CM 1 100. 0. 1. DISPLAY_IDENTIFIER LV_ENA_ROUGH_LEAK_1 ECU_ADDRESS 0x3fcd00 BYTE_ORDER MSB_LAST BIT_MASK 0x10000000 /end MEASUREMENT
/begin MEASUREMENT dmtl_priv_state_2.bitfield.lv_ena_rough_leak_2 "Auxiliary bit enabling rough leak check through manual activation" ULONG _CNV_S_2_RANGE______0_CM 1 100. 0. 1. DISPLAY_IDENTIFIER LV_ENA_ROUGH_LEAK_2 ECU_ADDRESS 0x3fcd00 BYTE_ORDER MSB_LAST BIT_MASK 0x8000000 /end MEASUREMENT
/begin MEASUREMENT dmtl_priv_state_2.bitfield.lv_ena_rough_leak_3 "Auxiliary bit interruption of rough leak check" ULONG _CNV_S_2_RANGE______0_CM 1 100. 0. 1. DISPLAY_IDENTIFIER LV_ENA_ROUGH_LEAK_3 ECU_ADDRESS 0x3fcd00 BYTE_ORDER MSB_LAST BIT_MASK 0x4000000 /end MEASUREMENT
/begin MEASUREMENT dmtl_priv_state_2.bitfield.lv_ena_rough_leak_mes "Enabling rough leak measurement" ULONG _CNV_S_2_RANGE______0_CM 1 100. 0. 1. DISPLAY_IDENTIFIER LV_ENA_ROUGH_LEAK_MES ECU_ADDRESS 0x3fcd00 BYTE_ORDER MSB_LAST BIT_MASK 0x800000 /end MEASUREMENT
/begin MEASUREMENT dmtl_priv_state_2.bitfield.lv_ena_rough_leak_mes_only "Enable only rough leak measurement" ULONG _CNV_S_2_RANGE______0_CM 1 100. 0. 1. DISPLAY_IDENTIFIER LV_ENA_ROUGH_LEAK_MES_ONLY ECU_ADDRESS 0x3fcd00 BYTE_ORDER MSB_LAST BIT_MASK 0x400000 /end MEASUREMENT
/begin MEASUREMENT dmtl_priv_state_2.bitfield.lv_ena_small_leak_1 "Enable for miniature leak check via test unit intervention" ULONG _CNV_S_2_RANGE______0_CM 1 100. 0. 1. DISPLAY_IDENTIFIER LV_ENA_SMALL_LEAK_1 ECU_ADDRESS 0x3fcd00 BYTE_ORDER MSB_LAST BIT_MASK 0x100000 /end MEASUREMENT
/begin MEASUREMENT dmtl_priv_state_2.bitfield.lv_ena_small_leak_mes_end "End of enable miniature leak measurement" ULONG _CNV_S_2_RANGE______0_CM 1 100. 0. 1. DISPLAY_IDENTIFIER LV_ENA_SMALL_LEAK_MES_END ECU_ADDRESS 0x3fcd00 BYTE_ORDER MSB_LAST BIT_MASK 0x80000 /end MEASUREMENT
/begin MEASUREMENT dmtl_priv_state_2.bitfield.lv_err_det_small_leak_min "Error, minimum value detected, miniature leakage" ULONG _CNV_S_2_RANGE______0_CM 1 100. 0. 1. DISPLAY_IDENTIFIER LV_ERR_DET_SMALL_LEAK_MIN ECU_ADDRESS 0x3fcd00 BYTE_ORDER MSB_LAST BIT_MASK 0x2000 /end MEASUREMENT
/begin MEASUREMENT dmtl_priv_state_2.bitfield.lv_fco_diag_max "Upper consumption diagnosis threshold" ULONG _CNV_S_2_RANGE______0_CM 1 100. 0. 1. DISPLAY_IDENTIFIER LV_FCO_DIAG_MAX ECU_ADDRESS 0x3fcd00 BYTE_ORDER MSB_LAST BIT_MASK 0x1000 /end MEASUREMENT
/begin MEASUREMENT dmtl_priv_state_2.bitfield.lv_fco_diag_min "Lower consumption diagnosis threshold" ULONG _CNV_S_2_RANGE______0_CM 1 100. 0. 1. DISPLAY_IDENTIFIER LV_FCO_DIAG_MIN ECU_ADDRESS 0x3fcd00 BYTE_ORDER MSB_LAST BIT_MASK 0x800 /end MEASUREMENT
/begin MEASUREMENT dmtl_priv_state_2.bitfield.lv_fco_h_ftl "Consumed fuel greater than tank level" ULONG _CNV_S_2_RANGE______0_CM 1 100. 0. 1. DISPLAY_IDENTIFIER LV_FCO_H_FTL ECU_ADDRESS 0x3fcd00 BYTE_ORDER MSB_LAST BIT_MASK 0x400 /end MEASUREMENT
/begin MEASUREMENT dmtl_priv_state_2.bitfield.lv_ftl_dec "Tank volume has decreased" ULONG _CNV_S_2_RANGE______0_CM 1 100. 0. 1. DISPLAY_IDENTIFIER LV_FTL_DEC ECU_ADDRESS 0x3fcd00 BYTE_ORDER MSB_LAST BIT_MASK 0x20 /end MEASUREMENT
/begin MEASUREMENT dmtl_priv_state_2.bitfield.lv_ftl_dec_igk_on "Tank filling volume has decreased in case of ignition key ON" ULONG _CNV_S_2_RANGE______0_CM 1 100. 0. 1. DISPLAY_IDENTIFIER LV_FTL_DEC_IGK_ON ECU_ADDRESS 0x3fcd00 BYTE_ORDER MSB_LAST BIT_MASK 0x10 /end MEASUREMENT
/begin MEASUREMENT dmtl_priv_state_2.bitfield.lv_ftl_dmtl_max "max. tank level for DMTL function" ULONG _CNV_S_2_RANGE______0_CM 1 100. 0. 1. DISPLAY_IDENTIFIER LV_FTL_DMTL_MAX ECU_ADDRESS 0x3fcd00 BYTE_ORDER MSB_LAST BIT_MASK 0x4 /end MEASUREMENT
/begin MEASUREMENT dmtl_priv_state_2.bitfield.lv_ftl_dmtl_min "min. tank level for DMTL function" ULONG _CNV_S_2_RANGE______0_CM 1 100. 0. 1. DISPLAY_IDENTIFIER LV_FTL_DMTL_MIN ECU_ADDRESS 0x3fcd00 BYTE_ORDER MSB_LAST BIT_MASK 0x2 /end MEASUREMENT
/begin MEASUREMENT dmtl_priv_state_2.bitfield.lv_ftl_dmtl_val "validated tank level for DMTL function" ULONG _CNV_S_2_RANGE______0_CM 1 100. 0. 1. DISPLAY_IDENTIFIER LV_FTL_DMTL_VAL ECU_ADDRESS 0x3fcd00 BYTE_ORDER MSB_LAST BIT_MASK 0x1 /end MEASUREMENT
/begin MEASUREMENT dmtl_priv_state_3.bitfield.lv_ftl_dyn "Level dynamics due to refueling" ULONG _CNV_S_2_RANGE______0_CM 1 100. 0. 1. DISPLAY_IDENTIFIER LV_FTL_DYN ECU_ADDRESS 0x3fcd04 BYTE_ORDER MSB_LAST BIT_MASK 0x80000000 /end MEASUREMENT
/begin MEASUREMENT dmtl_priv_state_3.bitfield.lv_ftl_inc "Tank volume has increased" ULONG _CNV_S_2_RANGE______0_CM 1 100. 0. 1. DISPLAY_IDENTIFIER LV_FTL_INC ECU_ADDRESS 0x3fcd04 BYTE_ORDER MSB_LAST BIT_MASK 0x40000000 /end MEASUREMENT
/begin MEASUREMENT dmtl_priv_state_3.bitfield.lv_ftl_inc_igk_on "Tank filling volume has increased in case of ignition key ON" ULONG _CNV_S_2_RANGE______0_CM 1 100. 0. 1. DISPLAY_IDENTIFIER LV_FTL_INC_IGK_ON ECU_ADDRESS 0x3fcd04 BYTE_ORDER MSB_LAST BIT_MASK 0x20000000 /end MEASUREMENT
/begin MEASUREMENT dmtl_priv_state_3.bitfield.lv_no_purge_dr_dmtl "Pulse width modulation of canister-purge" ULONG _CNV_S_2_RANGE______0_CM 1 100. 0. 1. DISPLAY_IDENTIFIER LV_NO_PURGE_DR_DMTL ECU_ADDRESS 0x3fcd04 BYTE_ORDER MSB_LAST BIT_MASK 0x1000000 /end MEASUREMENT
/begin MEASUREMENT dmtl_priv_state_3.bitfield.lv_no_purge_dmtl_rough_leak "request bit for no_purge" ULONG _CNV_S_2_RANGE______0_CM 1 100. 0. 1. DISPLAY_IDENTIFIER LV_NO_PURGE_DMTL_ROUGH_LEAK ECU_ADDRESS 0x3fcd04 BYTE_ORDER MSB_LAST BIT_MASK 0x800000 /end MEASUREMENT
/begin MEASUREMENT dmtl_priv_state_3.bitfield.lv_no_purge_dmtl_small_leak "request bit for no_purge" ULONG _CNV_S_2_RANGE______0_CM 1 100. 0. 1. DISPLAY_IDENTIFIER LV_NO_PURGE_DMTL_SMALL_LEAK ECU_ADDRESS 0x3fcd04 BYTE_ORDER MSB_LAST BIT_MASK 0x400000 /end MEASUREMENT
/begin MEASUREMENT dmtl_priv_state_4.bitfield.lv_ref_leak_rough_leak_susp "Condition, second reference measurement due to \"rough leak suspected\"" ULONG _CNV_S_2_RANGE______0_CM 1 100. 0. 1. DISPLAY_IDENTIFIER LV_REF_LEAK_ROUGH_LEAK_SUSP ECU_ADDRESS 0x3fcd08 BYTE_ORDER MSB_LAST BIT_MASK 0x8000000 /end MEASUREMENT
/begin MEASUREMENT dmtl_priv_state_4.bitfield.lv_refu "Refueling" ULONG _CNV_S_2_RANGE______0_CM 1 100. 0. 1. DISPLAY_IDENTIFIER LV_REFU ECU_ADDRESS 0x3fcd08 BYTE_ORDER MSB_LAST BIT_MASK 0x4000000 /end MEASUREMENT
/begin MEASUREMENT dmtl_priv_state_4.bitfield.lv_refu_1 "Refueling process, internal" ULONG _CNV_S_2_RANGE______0_CM 1 100. 0. 1. DISPLAY_IDENTIFIER LV_REFU_1 ECU_ADDRESS 0x3fcd08 BYTE_ORDER MSB_LAST BIT_MASK 0x2000000 /end MEASUREMENT
/begin MEASUREMENT dmtl_priv_state_4.bitfield.lv_refu_end "Refueling finished" ULONG _CNV_S_2_RANGE______0_CM 1 100. 0. 1. DISPLAY_IDENTIFIER LV_REFU_END ECU_ADDRESS 0x3fcd08 BYTE_ORDER MSB_LAST BIT_MASK 0x1000000 /end MEASUREMENT
/begin MEASUREMENT dmtl_priv_state_4.bitfield.lv_refu_rls_diag "Refueling diagnosis possible" ULONG _CNV_S_2_RANGE______0_CM 1 100. 0. 1. DISPLAY_IDENTIFIER LV_REFU_RLS_DIAG ECU_ADDRESS 0x3fcd08 BYTE_ORDER MSB_LAST BIT_MASK 0x400000 /end MEASUREMENT
/begin MEASUREMENT dmtl_priv_state_4.bitfield.lv_refu_val "Refueling bit valid, internal" ULONG _CNV_S_2_RANGE______0_CM 1 100. 0. 1. DISPLAY_IDENTIFIER LV_REFU_VAL ECU_ADDRESS 0x3fcd08 BYTE_ORDER MSB_LAST BIT_MASK 0x200000 /end MEASUREMENT
/begin MEASUREMENT dmtl_priv_state_4.bitfield.lv_refu_val_1 "Refueling bit valid, internal" ULONG _CNV_S_2_RANGE______0_CM 1 100. 0. 1. DISPLAY_IDENTIFIER LV_REFU_VAL_1 ECU_ADDRESS 0x3fcd08 BYTE_ORDER MSB_LAST BIT_MASK 0x100000 /end MEASUREMENT
/begin MEASUREMENT dmtl_priv_state_4.bitfield.lv_req_ena_rough_leak "Request rough leak measurement" ULONG _CNV_S_2_RANGE______0_CM 1 100. 0. 1. DISPLAY_IDENTIFIER LV_REQ_ENA_ROUGH_LEAK ECU_ADDRESS 0x3fcd08 BYTE_ORDER MSB_LAST BIT_MASK 0x80000 /end MEASUREMENT
/begin MEASUREMENT dmtl_priv_state_4.bitfield.lv_req_pwl_rough_leak "Request of STG off delay, rough leak diagnosis" ULONG _CNV_S_2_RANGE______0_CM 1 100. 0. 1. DISPLAY_IDENTIFIER LV_REQ_PWL_ROUGH_LEAK ECU_ADDRESS 0x3fcd08 BYTE_ORDER MSB_LAST BIT_MASK 0x20000 /end MEASUREMENT
/begin MEASUREMENT dmtl_priv_state_4.bitfield.lv_req_pwl_small_leak "Request of STG off delay, miniature leak test" ULONG _CNV_S_2_RANGE______0_CM 1 100. 0. 1. DISPLAY_IDENTIFIER LV_REQ_PWL_SMALL_LEAK ECU_ADDRESS 0x3fcd08 BYTE_ORDER MSB_LAST BIT_MASK 0x10000 /end MEASUREMENT
/begin MEASUREMENT dmtl_priv_state_4.bitfield.lv_req_rough_leak "Request rough leak measurement (low volatile fuel)" ULONG _CNV_S_2_RANGE______0_CM 1 100. 0. 1. DISPLAY_IDENTIFIER LV_REQ_ROUGH_LEAK ECU_ADDRESS 0x3fcd08 BYTE_ORDER MSB_LAST BIT_MASK 0x8000 /end MEASUREMENT
/begin MEASUREMENT dmtl_priv_state_4.bitfield.lv_rough_leak_susp "Rough leak suspected" ULONG _CNV_S_2_RANGE______0_CM 1 100. 0. 1. DISPLAY_IDENTIFIER LV_ROUGH_LEAK_SUSP ECU_ADDRESS 0x3fcd08 BYTE_ORDER MSB_LAST BIT_MASK 0x4000 /end MEASUREMENT
/begin MEASUREMENT dmtl_priv_state_4.bitfield.lv_small_leak_mes_len "Condition, extension miniature leak measurement" ULONG _CNV_S_2_RANGE______0_CM 1 100. 0. 1. DISPLAY_IDENTIFIER LV_SMALL_LEAK_MES_LEN ECU_ADDRESS 0x3fcd08 BYTE_ORDER MSB_LAST BIT_MASK 0x10 /end MEASUREMENT
/begin MEASUREMENT dmtl_priv_state_4.bitfield.lv_t_dly_dmtl_pwl "Waiting time DMTL start finished" ULONG _CNV_S_2_RANGE______0_CM 1 100. 0. 1. DISPLAY_IDENTIFIER LV_T_DLY_DMTL_PWL ECU_ADDRESS 0x3fcd08 BYTE_ORDER MSB_LAST BIT_MASK 0x8 /end MEASUREMENT
/begin MEASUREMENT dmtl_glob_state_1.bitfield.lv_ctr_cnl_small_leak_mes "Threshold of aborted miniature leak measurements due to current fluctuations exceeded" ULONG _CNV_S_2_RANGE______0_CM 1 100. 0. 1. DISPLAY_IDENTIFIER LV_CTR_CNL_SMALL_LEAK_MES ECU_ADDRESS 0x3fcce8 BYTE_ORDER MSB_LAST BIT_MASK 0x80000000 /end MEASUREMENT
/begin MEASUREMENT dmtl_glob_state_1.bitfield.lv_cur_dmtl_ref_dif_max "Condition \"delta reference current\" exceeded" ULONG _CNV_S_2_RANGE______0_CM 1 100. 0. 1. DISPLAY_IDENTIFIER LV_CUR_DMTL_REF_DIF_MAX ECU_ADDRESS 0x3fcce8 BYTE_ORDER MSB_LAST BIT_MASK 0x40000000 /end MEASUREMENT
/begin MEASUREMENT dmtl_glob_state_1.bitfield.lv_cur_dmtl_thd_dif_mes "Decreasing pump current during measurement" ULONG _CNV_S_2_RANGE______0_CM 1 100. 0. 1. DISPLAY_IDENTIFIER LV_CUR_DMTL_THD_DIF_MES ECU_ADDRESS 0x3fcce8 BYTE_ORDER MSB_LAST BIT_MASK 0x20000000 /end MEASUREMENT
/begin MEASUREMENT dmtl_glob_state_1.bitfield.lv_det_fuc_open "Detection of fuel cap open" ULONG _CNV_S_2_RANGE______0_CM 1 100. 0. 1. DISPLAY_IDENTIFIER LV_DET_FUC_OPEN ECU_ADDRESS 0x3fcce8 BYTE_ORDER MSB_LAST BIT_MASK 0x10000000 /end MEASUREMENT
/begin MEASUREMENT dmtl_glob_state_1.bitfield.lv_det_refu "Detection of refueling" ULONG _CNV_S_2_RANGE______0_CM 1 100. 0. 1. DISPLAY_IDENTIFIER LV_DET_REFU ECU_ADDRESS 0x3fcce8 BYTE_ORDER MSB_LAST BIT_MASK 0x8000000 /end MEASUREMENT
/begin MEASUREMENT dmtl_glob_state_1.bitfield.lv_dist_det_rough_leak "Distance covered since rough leak detection" ULONG _CNV_S_2_RANGE______0_CM 1 100. 0. 1. DISPLAY_IDENTIFIER LV_DIST_DET_ROUGH_LEAK ECU_ADDRESS 0x3fcce8 BYTE_ORDER MSB_LAST BIT_MASK 0x4000000 /end MEASUREMENT
/begin MEASUREMENT dmtl_glob_state_1.bitfield.lv_dmtl_act "DMTL state machine running" ULONG _CNV_S_2_RANGE______0_CM 1 100. 0. 1. DISPLAY_IDENTIFIER LV_DMTL_ACT ECU_ADDRESS 0x3fcce8 BYTE_ORDER MSB_LAST BIT_MASK 0x2000000 /end MEASUREMENT
/begin MEASUREMENT dmtl_glob_state_1.bitfield.lv_dmtl_stop "Abnormal termination of DMTL function" ULONG _CNV_S_2_RANGE______0_CM 1 100. 0. 1. DISPLAY_IDENTIFIER LV_DMTL_STOP ECU_ADDRESS 0x3fcce8 BYTE_ORDER MSB_LAST BIT_MASK 0x800000 /end MEASUREMENT
/begin MEASUREMENT dmtl_glob_state_1.bitfield.lv_ena_fuc "Request check filler cap" ULONG _CNV_S_2_RANGE______0_CM 1 100. 0. 1. DISPLAY_IDENTIFIER LV_ENA_FUC ECU_ADDRESS 0x3fcce8 BYTE_ORDER MSB_LAST BIT_MASK 0x400000 /end MEASUREMENT
/begin MEASUREMENT dmtl_glob_state_1.bitfield.lv_ena_leak_dmtl "Enabling function request, coarse / miniature leakage measurement" ULONG _CNV_S_2_RANGE______0_CM 1 100. 0. 1. DISPLAY_IDENTIFIER LV_ENA_LEAK_DMTL ECU_ADDRESS 0x3fcce8 BYTE_ORDER MSB_LAST BIT_MASK 0x200000 /end MEASUREMENT
/begin MEASUREMENT dmtl_glob_state_1.bitfield.lv_ena_osc_rough_leak_mes "Enable rough leak measurement after current fluctuations" ULONG _CNV_S_2_RANGE______0_CM 1 100. 0. 1. DISPLAY_IDENTIFIER LV_ENA_OSC_ROUGH_LEAK_MES ECU_ADDRESS 0x3fcce8 BYTE_ORDER MSB_LAST BIT_MASK 0x100000 /end MEASUREMENT
/begin MEASUREMENT dmtl_glob_state_1.bitfield.lv_ena_small_leak_mes "Enable miniature leak measurement" ULONG _CNV_S_2_RANGE______0_CM 1 100. 0. 1. DISPLAY_IDENTIFIER LV_ENA_SMALL_LEAK_MES ECU_ADDRESS 0x3fcce8 BYTE_ORDER MSB_LAST BIT_MASK 0x20000 /end MEASUREMENT
/begin MEASUREMENT dmtl_glob_state_1.bitfield.lv_ena_small_leak_refu "Enable miniature leak check after refueling" ULONG _CNV_S_2_RANGE______0_CM 1 100. 0. 1. DISPLAY_IDENTIFIER LV_ENA_SMALL_LEAK_REFU ECU_ADDRESS 0x3fcce8 BYTE_ORDER MSB_LAST BIT_MASK 0x10000 /end MEASUREMENT
/begin MEASUREMENT dmtl_glob_state_1.bitfield.lv_err_det_dmtl_max "Error maximum value DMTL" ULONG _CNV_S_2_RANGE______0_CM 1 100. 0. 1. DISPLAY_IDENTIFIER LV_ERR_DET_DMTL_MAX ECU_ADDRESS 0x3fcce8 BYTE_ORDER MSB_LAST BIT_MASK 0x8000 /end MEASUREMENT
/begin MEASUREMENT dmtl_glob_state_1.bitfield.lv_err_det_dmtl_min "Error, minimum value detected in DMTL module" ULONG _CNV_S_2_RANGE______0_CM 1 100. 0. 1. DISPLAY_IDENTIFIER LV_ERR_DET_DMTL_MIN ECU_ADDRESS 0x3fcce8 BYTE_ORDER MSB_LAST BIT_MASK 0x4000 /end MEASUREMENT
/begin MEASUREMENT dmtl_glob_state_1.bitfield.lv_err_det_rough_leak_min "Rough leak error" ULONG _CNV_S_2_RANGE______0_CM 1 100. 0. 1. DISPLAY_IDENTIFIER LV_ERR_DET_ROUGH_LEAK_MIN ECU_ADDRESS 0x3fcce8 BYTE_ORDER MSB_LAST BIT_MASK 0x2000 /end MEASUREMENT
/begin MEASUREMENT dmtl_glob_state_1.bitfield.lv_err_ftl "Tank level error" ULONG _CNV_S_2_RANGE______0_CM 1 100. 0. 1. DISPLAY_IDENTIFIER LV_ERR_FTL ECU_ADDRESS 0x3fcce8 BYTE_ORDER MSB_LAST BIT_MASK 0x1000 /end MEASUREMENT
/begin MEASUREMENT dmtl_glob_state_1.bitfield.lv_err_ftl_plaus "Tank level plausibility error" ULONG _CNV_S_2_RANGE______0_CM 1 100. 0. 1. DISPLAY_IDENTIFIER LV_ERR_FTL_PLAUS ECU_ADDRESS 0x3fcce8 BYTE_ORDER MSB_LAST BIT_MASK 0x800 /end MEASUREMENT
/begin MEASUREMENT dmtl_glob_state_1.bitfield.lv_err_sig_dmtl "Error signal DMTL" ULONG _CNV_S_2_RANGE______0_CM 1 100. 0. 1. DISPLAY_IDENTIFIER LV_ERR_SIG_DMTL ECU_ADDRESS 0x3fcce8 BYTE_ORDER MSB_LAST BIT_MASK 0x200 /end MEASUREMENT
/begin MEASUREMENT dmtl_glob_state_1.bitfield.lv_err_small_leak "Error miniature leak" ULONG _CNV_S_2_RANGE______0_CM 1 100. 0. 1. DISPLAY_IDENTIFIER LV_ERR_SMALL_LEAK ECU_ADDRESS 0x3fcce8 BYTE_ORDER MSB_LAST BIT_MASK 0x100 /end MEASUREMENT
/begin MEASUREMENT dmtl_glob_state_1.bitfield.lv_ftl_diag "Level sensor diagnosis" ULONG _CNV_S_2_RANGE______0_CM 1 100. 0. 1. DISPLAY_IDENTIFIER LV_FTL_DIAG ECU_ADDRESS 0x3fcce8 BYTE_ORDER MSB_LAST BIT_MASK 0x80 /end MEASUREMENT
/begin MEASUREMENT dmtl_glob_state_1.bitfield.lv_fuc_can "Tank cap open - display" ULONG _CNV_S_2_RANGE______0_CM 1 100. 0. 1. DISPLAY_IDENTIFIER LV_FUC_CAN ECU_ADDRESS 0x3fcce8 BYTE_ORDER MSB_LAST BIT_MASK 0x40 /end MEASUREMENT
/begin MEASUREMENT dmtl_glob_state_1.bitfield.lv_fuc_open "Filler cap open" ULONG _CNV_S_2_RANGE______0_CM 1 100. 0. 1. DISPLAY_IDENTIFIER LV_FUC_OPEN ECU_ADDRESS 0x3fcce8 BYTE_ORDER MSB_LAST BIT_MASK 0x20 /end MEASUREMENT
/begin MEASUREMENT dmtl_glob_state_1.bitfield.lv_no_purge_dmtl "request for no_purge of the evap.-system" ULONG _CNV_S_2_RANGE______0_CM 1 100. 0. 1. DISPLAY_IDENTIFIER LV_NO_PURGE_DMTL ECU_ADDRESS 0x3fcce8 BYTE_ORDER MSB_LAST BIT_MASK 0x10 /end MEASUREMENT
/begin MEASUREMENT dmtl_glob_state_1.bitfield.lv_refu_dmtl "Condition refueling" ULONG _CNV_S_2_RANGE______0_CM 1 100. 0. 1. DISPLAY_IDENTIFIER LV_REFU_DMTL ECU_ADDRESS 0x3fcce8 BYTE_ORDER MSB_LAST BIT_MASK 0x4 /end MEASUREMENT
/begin MEASUREMENT dmtl_glob_state_2.bitfield.lv_req_pwl_dmtl "Request of STG off delay, tank leakage diagnosis" ULONG _CNV_S_2_RANGE______0_CM 1 100. 0. 1. DISPLAY_IDENTIFIER LV_REQ_PWL_DMTL ECU_ADDRESS 0x3fccec BYTE_ORDER MSB_LAST BIT_MASK 0x80000000 /end MEASUREMENT
/begin MEASUREMENT dmtl_glob_state_2.bitfield.lv_rough_leak_susp_set "Rough leak suspicion with cycle bit rough leak suspicion present" ULONG _CNV_S_2_RANGE______0_CM 1 100. 0. 1. DISPLAY_IDENTIFIER LV_ROUGH_LEAK_SUSP_SET ECU_ADDRESS 0x3fccec BYTE_ORDER MSB_LAST BIT_MASK 0x20000000 /end MEASUREMENT
/begin MEASUREMENT dmtl_glob_state_2.bitfield.lv_rst_small_leak_mes_refu "reset miniature leck after refueling" ULONG _CNV_S_2_RANGE______0_CM 1 100. 0. 1. DISPLAY_IDENTIFIER LV_RST_SMALL_LEAK_MES_REFU ECU_ADDRESS 0x3fccec BYTE_ORDER MSB_LAST BIT_MASK 0x10000000 /end MEASUREMENT
/begin MEASUREMENT dmtl_glob_state_2.bitfield.lv_sdr_dmtl "Error plausibility DMTL" ULONG _CNV_S_2_RANGE______0_CM 1 100. 0. 1. DISPLAY_IDENTIFIER LV_SDR_DMTL ECU_ADDRESS 0x3fccec BYTE_ORDER MSB_LAST BIT_MASK 0x8000000 /end MEASUREMENT
/begin MEASUREMENT dmtl_glob_state_2.bitfield.lv_t_dmtl_max "max. time for DMTL" ULONG _CNV_S_2_RANGE______0_CM 1 100. 0. 1. DISPLAY_IDENTIFIER LV_T_DMTL_MAX ECU_ADDRESS 0x3fccec BYTE_ORDER MSB_LAST BIT_MASK 0x4000000 /end MEASUREMENT
/begin MEASUREMENT dmtl_glob_state_2.bitfield.lv_vb_dif_max "high battery voltage deviation" ULONG _CNV_S_2_RANGE______0_CM 1 100. 0. 1. DISPLAY_IDENTIFIER LV_VB_DIF_MAX ECU_ADDRESS 0x3fccec BYTE_ORDER MSB_LAST BIT_MASK 0x1000000 /end MEASUREMENT
/begin MEASUREMENT dmtl_glob_state_2.bitfield.lv_hdmtl_on "heater DMTL" ULONG _CNV_S_2_RANGE______0_CM 1 100. 0. 1. DISPLAY_IDENTIFIER LV_HDMTL_ON ECU_ADDRESS 0x3fccec BYTE_ORDER MSB_LAST BIT_MASK 0x800000 /end MEASUREMENT
/begin MEASUREMENT dmtl_glob_state_2.bitfield.lv_dr_dmtls "DMTL solenoid valve activation" ULONG _CNV_S_2_RANGE______0_CM 1 100. 0. 1. DISPLAY_IDENTIFIER LV_DR_DMTLS ECU_ADDRESS 0x3fccec BYTE_ORDER MSB_LAST BIT_MASK 0x400000 /end MEASUREMENT
/begin MEASUREMENT dmtl_glob_state_2.bitfield.lv_vb_range_dmtl "DMTL does not start because battery is out of band width" ULONG _CNV_S_2_RANGE______0_CM 1 100. 0. 1. DISPLAY_IDENTIFIER LV_VB_RANGE_DMTL ECU_ADDRESS 0x3fccec BYTE_ORDER MSB_LAST BIT_MASK 0x20000 /end MEASUREMENT
/begin MEASUREMENT dmtl_glob_state_2.bitfield.lv_cyc_rough_leak_mode6 "Cycle flag, rough leak error" ULONG _CNV_S_2_RANGE______0_CM 1 100. 0. 1. DISPLAY_IDENTIFIER LV_CYC_ROUGH_LEAK_MODE6 ECU_ADDRESS 0x3fccec BYTE_ORDER MSB_LAST BIT_MASK 0x200000 /end MEASUREMENT
/begin MEASUREMENT dmtl_glob_state_2.bitfield.lv_rough_leak_mes_len "Condition, extension rough leak measurement" ULONG _CNV_S_2_RANGE______0_CM 1 100. 0. 1. DISPLAY_IDENTIFIER LV_ROUGH_LEAK_MES_LEN ECU_ADDRESS 0x3fccec BYTE_ORDER MSB_LAST BIT_MASK 0x100000 /end MEASUREMENT
/begin MEASUREMENT dmtl_glob_state_2.bitfield.lv_cyc_small_leak_mode6 "Cycle flag, miniature leak" ULONG _CNV_S_2_RANGE______0_CM 1 100. 0. 1. DISPLAY_IDENTIFIER LV_CYC_SMALL_LEAK_MODE6 ECU_ADDRESS 0x3fccec BYTE_ORDER MSB_LAST BIT_MASK 0x80000 /end MEASUREMENT
/begin MEASUREMENT cur_dmtl_small_leak_end "Pump current at the end of the miniature leak measurement" UWORD _CNV_A_R_LINEAR_____167_CM 1 100. 0. 400. DISPLAY_IDENTIFIER CUR_DMTL_SMALL_LEAK_END ECU_ADDRESS 0x3fd6d0 BYTE_ORDER MSB_LAST FORMAT "%7.3" /end MEASUREMENT
/begin MEASUREMENT cur_dmtl_ref_dif_max "???" UWORD _CNV_A_R_LINEAR_____167_CM 1 100. 0. 400. DISPLAY_IDENTIFIER CUR_DMTL_REF_DIF_MAX ECU_ADDRESS 0x3fd6ca BYTE_ORDER MSB_LAST FORMAT "%7.3" /end MEASUREMENT
/begin CHARACTERISTIC c_t_dly_stop_refu "Delay time stop before refueling" VALUE 0x01814 _REC_VAL_20_u2 65535. _CNV_A_R_LINEAR_____30_CM 0. 65535. DISPLAY_IDENTIFIER C_T_DLY_STOP_REFU FORMAT "%5.0" /end CHARACTERISTIC
/begin CHARACTERISTIC c_t_ena_dr_dmtl_max "max. time for function request DMTL output stages" VALUE 0x01830 _REC_VAL_20_u2 6553.5 _CNV_A_R_LINEAR_____24_CM 0. 6553.5 DISPLAY_IDENTIFIER C_T_ENA_DR_DMTL_MAX FORMAT "%6.1" /end CHARACTERISTIC
/begin MEASUREMENT lv_err_dmtl_leak "logical variable for DMTL LEAK error" UBYTE _CNV_S_2_RANGE______2_R_CM 1 100. 0. 255. DISPLAY_IDENTIFIER LV_ERR_DMTL_LEAK ECU_ADDRESS 0x3fba84 /end MEASUREMENT
/begin CHARACTERISTIC c_obd_state_1 "" VALUE 0x0079e _REC_VAL_20_u1 7. _CNV_A_R_LINEAR_____1_CM 0. 7. DISPLAY_IDENTIFIER C_OBD_STATE_1 FORMAT "%2.0" /end CHARACTERISTIC
/begin CHARACTERISTIC c_obd_state_2 "" VALUE 0x0079f _REC_VAL_20_u1 255. _CNV_A_R_LINEAR_____1_CM 0. 255. DISPLAY_IDENTIFIER C_OBD_STATE_2 FORMAT "%3.0" /end CHARACTERISTIC
/begin MEASUREMENT lv_dc "driving cycle status flag" UBYTE _CNV_S_2_RANGE______191_CM 1 100. 0. 1. DISPLAY_IDENTIFIER LV_DC ECU_ADDRESS 0x3fe769 BIT_MASK 0x1 /end MEASUREMENT
/begin MEASUREMENT lv_wup_cyc "warm-up cycle status flag" UBYTE _CNV_S_2_RANGE______0_CM 1 100. 0. 1. DISPLAY_IDENTIFIER LV_WUP_CYC ECU_ADDRESS 0x3fe76b BIT_MASK 0x1 /end MEASUREMENT
/begin MEASUREMENT lv_state_wup "TCO state for exceeding the warm-up cycle tco threshold" UBYTE _CNV_S_2_RANGE______0_CM 1 100. 0. 1. DISPLAY_IDENTIFIER LV_STATE_WUP ECU_ADDRESS 0x3fe76a BIT_MASK 0x1 /end MEASUREMENT
/begin CHARACTERISTIC c_tco_wup_thd "OBD II required at least 72 °C for GS and 60 °C for DS engines EOBD required at least 70 °C for DS and GS engines" VALUE 0x008ae _REC_VAL_20_u1 190.5 _CNV_A_R_LINEAR_____12_CM -48. 142.5 DISPLAY_IDENTIFIER C_TCO_WUP_THD FORMAT "%5.1" /end CHARACTERISTIC
/begin CHARACTERISTIC c_tco_wup_inc "OBDII required at least 23 °C for GS and DS engines EOBD required at least 22 °C for GS and DS engines" VALUE 0x008ad _REC_VAL_20_u1 190.5 _CNV_A_R_LINEAR_____12_CM -48. 142.5 DISPLAY_IDENTIFIER C_TCO_WUP_INC FORMAT "%5.1" /end CHARACTERISTIC
/begin MEASUREMENT lam_bank_1.cat_eff_obd2.bf.lv_cat_diag_cyc_vld "Monitoring cycle valid, used for calculation of diagnosis value" ULONG _CNV_S_2_RANGE______0_CM 1 100. 0. 1. DISPLAY_IDENTIFIER LV_CAT_DIAG_CYC_VLD_1 ECU_ADDRESS 0x3fc200 BYTE_ORDER MSB_LAST BIT_MASK 0x80000000 /end MEASUREMENT
/begin MEASUREMENT lam_bank_1.cat_eff_obd2.sum_cat_diag "monitoring cycle counter" UWORD _CNV_A_R_LINEAR_____1_CM 1 100. 0. 65535. DISPLAY_IDENTIFIER SUM_CAT_DIAG_1 ECU_ADDRESS 0x3fc20e BYTE_ORDER MSB_LAST FORMAT "%5.0" /end MEASUREMENT
/begin MEASUREMENT lam_bank_1.cat_eff_obd2.cat_diag_clc "Diagnostic value, catalytic converter efficiency check, bank i (i=1,2)" UWORD _CNV_A_R_LINEAR_____285_CM 1 100. 0. 20. DISPLAY_IDENTIFIER CAT_DIAG_CLC_1 ECU_ADDRESS 0x3fc216 BYTE_ORDER MSB_LAST FORMAT "%5.2" /end MEASUREMENT
/begin MEASUREMENT lam_bank_1.cat_eff_obd2.cat_diag_cus "Customer diagnostic value, catalytic converter efficiency check, bank i (i=1,2)" UWORD _CNV_A_R_LINEAR_____285_CM 1 100. 0. 20. DISPLAY_IDENTIFIER CAT_DIAG_CUS_1 ECU_ADDRESS 0x3fc21c BYTE_ORDER MSB_LAST FORMAT "%5.2" /end MEASUREMENT
/begin MEASUREMENT lam_bank_1.cat_eff_obd2.vls_cyc_step "state-counter for several phases of a rich-lean-cycle" UBYTE _CNV_S_8_STATE_VLS__286_CM 1 100. 0. 255. DISPLAY_IDENTIFIER VLS_CYC_STEP_1 ECU_ADDRESS 0x3fc212 /end MEASUREMENT
/begin MEASUREMENT lam_bank_1.cat_eff_obd2.sum_o2_cat_dif "Sum of the difference between measured post-CAT oxygen exposure and mean oxygen exposure, bank i (i=1,2)" UWORD _CNV_A_R_LINEAR_____287_CM 1 100. 0. 5119.9218 DISPLAY_IDENTIFIER SUM_O2_CAT_DIF_1 ECU_ADDRESS 0x3fc204 BYTE_ORDER MSB_LAST FORMAT "%9.4" /end MEASUREMENT
/begin MEASUREMENT lam_bank_1.cat_eff_obd2.sum_o2_cat "Sum of post-catalyst oxygen exposure, bank i (i=1,2)" UWORD _CNV_A_R_LINEAR_____288_CM 1 100. 0. 5.119921 DISPLAY_IDENTIFIER SUM_O2_CAT_1 ECU_ADDRESS 0x3fc206 BYTE_ORDER MSB_LAST FORMAT "%7.5" /end MEASUREMENT
/begin MEASUREMENT lam_bank_1.cat_eff_obd2.o2_cat_mv "Mean value of post-catalyst oxygen exposure, bank i (i=1,2)" UBYTE _CNV_A_R_LINEAR_____29_CM 1 100. 0. 0.99610001 DISPLAY_IDENTIFIER O2_CAT_MV_1 ECU_ADDRESS 0x3fc208 FORMAT "%5.3" /end MEASUREMENT
/begin MEASUREMENT lam_bank_1.cat_eff_obd2.o2_cat_ratio "Quotient of O2_CAT_INT_i and ID_VLS_CAT_INT_MAX_AT/MT__N__MAF, bank i (i=1,2)" UWORD _CNV_A_R_LINEAR_____285_CM 1 100. 0. 20. DISPLAY_IDENTIFIER O2_CAT_RATIO_1 ECU_ADDRESS 0x3fc20c BYTE_ORDER MSB_LAST FORMAT "%5.2" /end MEASUREMENT
/begin MEASUREMENT lam_bank_1.cat_eff_obd2.sum_o2_cat_ratio "Sum of O2_CAT_RATIO_i" UWORD _CNV_A_R_LINEAR_____289_CM 1 100. 0. 2559.96094 DISPLAY_IDENTIFIER SUM_O2_CAT_RATIO_1 ECU_ADDRESS 0x3fc210 BYTE_ORDER MSB_LAST FORMAT "%7.2" /end MEASUREMENT
/begin MEASUREMENT lam_bank_1.cat_eff_obd2.sum_vls_cat_o2 "Oxygen oscillation at CAT-entry" ULONG _CNV_A_R_LINEAR_____22_CM 1 100. 0. 4294967295. DISPLAY_IDENTIFIER SUM_VLS_CAT_O2_1 ECU_ADDRESS 0x3fc218 BYTE_ORDER MSB_LAST FORMAT "%11.0" /end MEASUREMENT
/begin MEASUREMENT lam_bank_1.cat_eff_obd2.o2_cat "Value of post-catalyst oxygen exposure, bank i (i=1,2)" UBYTE _CNV_A_R_LINEAR_____29_CM 1 100. 0. 0.99610001 DISPLAY_IDENTIFIER O2_CAT_1 ECU_ADDRESS 0x3fc213 FORMAT "%5.3" /end MEASUREMENT
/begin MEASUREMENT lam_bank_1.cat_eff_obd2.cat_diag "Generic diagnosis value" UBYTE _CNV_A_R_LINEAR_____157_CM 1 100. 0. 1.984375 DISPLAY_IDENTIFIER CAT_DIAG_1 ECU_ADDRESS 0x3fc21e FORMAT "%4.2" /end MEASUREMENT
/begin MEASUREMENT lam_bank_1.ls_up_obd2.bf.lv_inh_diag_ls_up "OBD2 function: application incidence for inhibition" ULONG _CNV_S_2_RANGE______0_CM 1 100. 0. 1. DISPLAY_IDENTIFIER LV_INH_DIAG_LS_UP_1 ECU_ADDRESS 0x3fc4f0 BYTE_ORDER MSB_LAST BIT_MASK 0x40000000 /end MEASUREMENT
/begin MEASUREMENT lam_bank_1.ls_up_obd2.vls_cycnr_max "top limit diagnostic threshold for switching time monitoring" UWORD _CNV_A_R_LINEAR_____3_CM 1 100. 0. 4.99511719 DISPLAY_IDENTIFIER VLS_CYCNR_MAX_1 ECU_ADDRESS 0x3fc518 BYTE_ORDER MSB_LAST FORMAT "%5.3" /end MEASUREMENT
/begin MEASUREMENT lam_bank_1.ls_up_obd2.vls_cycnr_min "bottom limit diagnostic threshold for switching time monitoring" UWORD _CNV_A_R_LINEAR_____3_CM 1 100. 0. 4.99511719 DISPLAY_IDENTIFIER VLS_CYCNR_MIN_1 ECU_ADDRESS 0x3fc51a BYTE_ORDER MSB_LAST FORMAT "%5.3" /end MEASUREMENT
/begin MEASUREMENT lam_bank_1.ls_up_obd2.t_vls_cycnr "actual switching time" UWORD _CNV_A_R_LINEAR_____4_CM 1 100. 0. 655.35 DISPLAY_IDENTIFIER T_VLS_CYCNR_1 ECU_ADDRESS 0x3fc51c BYTE_ORDER MSB_LAST FORMAT "%5.2" /end MEASUREMENT
/begin MEASUREMENT lam_bank_1.ls_up_obd2.ratio_vls_cycnr_afl_mv "total ratio between measured and max. allowed switching times from rich to lean" UWORD _CNV_A_R_LINEAR_____123_CM 1 100. 0. 255.996094 DISPLAY_IDENTIFIER RATIO_VLS_CYCNR_AFL_MV_1 ECU_ADDRESS 0x3fc52a BYTE_ORDER MSB_LAST FORMAT "%7.3" /end MEASUREMENT
/begin MEASUREMENT lam_bank_1.ls_up_obd2.ratio_vls_cycnr_afr_mv "number of measured switching times from rich to lean" UWORD _CNV_A_R_LINEAR_____123_CM 1 100. 0. 255.996094 DISPLAY_IDENTIFIER RATIO_VLS_CYCNR_AFR_MV_1 ECU_ADDRESS 0x3fc52c BYTE_ORDER MSB_LAST FORMAT "%7.3" /end MEASUREMENT
/begin MEASUREMENT lam_bank_1.ls_up_obd2.sum_cycnr_afl "number of measured switching times from rich to lean" UWORD _CNV_A_R_LINEAR_____1_CM 1 100. 0. 65535. DISPLAY_IDENTIFIER SUM_CYCNR_AFL_1 ECU_ADDRESS 0x3fc51e BYTE_ORDER MSB_LAST FORMAT "%5.0" /end MEASUREMENT
/begin MEASUREMENT lam_bank_1.ls_up_obd2.sum_cycnr_afr "number of measured switching times from lean to rich" UWORD _CNV_A_R_LINEAR_____1_CM 1 100. 0. 65535. DISPLAY_IDENTIFIER SUM_CYCNR_AFR_1 ECU_ADDRESS 0x3fc520 BYTE_ORDER MSB_LAST FORMAT "%5.0" /end MEASUREMENT
/begin MEASUREMENT lam_bank_1.ls_up_obd2.ratio_vls_cycnr_afl "ratio between measured and max. allowed switching times from rich to lean" UWORD _CNV_A_R_LINEAR_____123_CM 1 100. 0. 255.996094 DISPLAY_IDENTIFIER RATIO_VLS_CYCNR_AFL_1 ECU_ADDRESS 0x3fc522 BYTE_ORDER MSB_LAST FORMAT "%7.3" /end MEASUREMENT
/begin MEASUREMENT lam_bank_1.ls_up_obd2.ratio_sae_vls_cycnr_afl_mv "ratio between measured and max. allowed switching times from rich to lean for scantool" UWORD _CNV_A_R_LINEAR_____123_CM 1 100. 0. 255.996094 DISPLAY_IDENTIFIER RATIO_SAE_VLS_CYCNR_AFL_MV_1 ECU_ADDRESS 0x3fc52e BYTE_ORDER MSB_LAST FORMAT "%7.3" /end MEASUREMENT
/begin MEASUREMENT lam_bank_1.ls_up_obd2.ratio_sae_vls_cycnr_afr_mv "ratio between measured and max. allowed switching times from lean to rich for scantool" UWORD _CNV_A_R_LINEAR_____123_CM 1 100. 0. 255.996094 DISPLAY_IDENTIFIER RATIO_SAE_VLS_CYCNR_AFR_MV_1 ECU_ADDRESS 0x3fc530 BYTE_ORDER MSB_LAST FORMAT "%7.3" /end MEASUREMENT
/begin MEASUREMENT lam_bank_1.ls_up_obd2.ratio_vls_cycnr_afr "ratio between measured and max. allowed switching times from lean to rich" UWORD _CNV_A_R_LINEAR_____123_CM 1 100. 0. 255.996094 DISPLAY_IDENTIFIER RATIO_VLS_CYCNR_AFR_1 ECU_ADDRESS 0x3fc524 BYTE_ORDER MSB_LAST FORMAT "%7.3" /end MEASUREMENT
/begin MEASUREMENT lam_bank_1.ls_up_obd2.t_vls_afr_to_afl_sum "sum of SWT rich to lean" UWORD _CNV_A_R_LINEAR_____4_CM 1 100. 0. 655.35 DISPLAY_IDENTIFIER T_VLS_AFR_TO_AFL_SUM_1 ECU_ADDRESS 0x3fc534 BYTE_ORDER MSB_LAST FORMAT "%6.2" /end MEASUREMENT
/begin MEASUREMENT lam_bank_1.ls_up_obd2.t_vls_afr_to_afl_sum_max "sum of max SWT rich to lean" UWORD _CNV_A_R_LINEAR_____4_CM 1 100. 0. 655.35 DISPLAY_IDENTIFIER T_VLS_AFR_TO_AFL_SUM_MAX_1 ECU_ADDRESS 0x3fc536 BYTE_ORDER MSB_LAST FORMAT "%6.2" /end MEASUREMENT
/begin MEASUREMENT lam_bank_1.ls_up_obd2.t_vls_afl_to_afr_sum "sum of SWT lean to rich" UWORD _CNV_A_R_LINEAR_____4_CM 1 100. 0. 655.35 DISPLAY_IDENTIFIER T_VLS_AFL_TO_AFR_SUM_1 ECU_ADDRESS 0x3fc538 BYTE_ORDER MSB_LAST FORMAT "%6.2" /end MEASUREMENT
/begin MEASUREMENT lam_bank_1.ls_up_obd2.t_vls_afl_to_afr_sum_max "sum of max SWT lean to rich" UWORD _CNV_A_R_LINEAR_____4_CM 1 100. 0. 655.35 DISPLAY_IDENTIFIER T_VLS_AFL_TO_AFR_SUM_MAX_1 ECU_ADDRESS 0x3fc53a BYTE_ORDER MSB_LAST FORMAT "%6.2" /end MEASUREMENT
/begin MEASUREMENT lam_bank_1.ls_up_obd2.vls_sae_afl_thd "SWT lean threshold for scantool" UWORD _CNV_A_R_LINEAR_____3_CM 1 100. 0. 4.99511719 DISPLAY_IDENTIFIER VLS_SAE_AFL_THD_1 ECU_ADDRESS 0x3fc544 BYTE_ORDER MSB_LAST FORMAT "%5.3" /end MEASUREMENT
/begin MEASUREMENT lam_bank_1.ls_up_obd2.vls_sae_afr_thd "SWT rich threshold for scantool" UWORD _CNV_A_R_LINEAR_____3_CM 1 100. 0. 4.99511719 DISPLAY_IDENTIFIER VLS_SAE_AFR_THD_1 ECU_ADDRESS 0x3fc546 BYTE_ORDER MSB_LAST FORMAT "%5.3" /end MEASUREMENT
/begin MEASUREMENT lam_bank_1.ls_up_obd2.t_sae_vls_afr_afl "SWT rich to lean for scantool" UBYTE _CNV_A_R_LINEAR_____4_CM 1 100. 0. 2.55 DISPLAY_IDENTIFIER T_SAE_VLS_AFR_AFL_1 ECU_ADDRESS 0x3fc548 FORMAT "%4.2" /end MEASUREMENT
/begin MEASUREMENT lam_bank_1.ls_up_obd2.t_sae_vls_afr_afl_max "max. SWT rich to lean for scantool" UBYTE _CNV_A_R_LINEAR_____4_CM 1 100. 0. 2.55 DISPLAY_IDENTIFIER T_SAE_VLS_AFR_AFL_MAX_1 ECU_ADDRESS 0x3fc549 FORMAT "%4.2" /end MEASUREMENT
/begin MEASUREMENT lam_bank_1.ls_up_obd2.t_sae_vls_afl_afr_max "max. SWT lean to rich for scantool" UBYTE _CNV_A_R_LINEAR_____4_CM 1 100. 0. 2.55 DISPLAY_IDENTIFIER T_SAE_VLS_AFL_AFR_MAX_1 ECU_ADDRESS 0x3fc54b FORMAT "%4.2" /end MEASUREMENT
/begin MEASUREMENT lam_bank_1.ls_up_obd2.t_sae_vls_afl_afr "SWT lean to rich for scantool" UBYTE _CNV_A_R_LINEAR_____4_CM 1 100. 0. 2.55 DISPLAY_IDENTIFIER T_SAE_VLS_AFL_AFR_1 ECU_ADDRESS 0x3fc54a FORMAT "%4.2" /end MEASUREMENT
/begin MEASUREMENT lam_bank_1.ls_up_obd2.sum_cyc "number of measured complete controller periods" UWORD _CNV_A_R_LINEAR_____1_CM 1 100. 0. 65535. DISPLAY_IDENTIFIER SUM_CYC_1 ECU_ADDRESS 0x3fc4f4 BYTE_ORDER MSB_LAST FORMAT "%5.0" /end MEASUREMENT
/begin MEASUREMENT lam_bank_1.ls_up_obd2.ratio_vls_cyc_afl "ratio between measured and max. allowed lean time" UWORD _CNV_A_R_LINEAR_____123_CM 1 100. 0. 255.996094 DISPLAY_IDENTIFIER RATIO_VLS_CYC_AFL_1 ECU_ADDRESS 0x3fc4f6 BYTE_ORDER MSB_LAST FORMAT "%7.3" /end MEASUREMENT
/begin MEASUREMENT lam_bank_1.ls_up_obd2.ratio_vls_cyc_afr "ratio between measured and max. allowed  rich time" UWORD _CNV_A_R_LINEAR_____123_CM 1 100. 0. 255.996094 DISPLAY_IDENTIFIER RATIO_VLS_CYC_AFR_1 ECU_ADDRESS 0x3fc4f8 BYTE_ORDER MSB_LAST FORMAT "%7.3" /end MEASUREMENT
/begin MEASUREMENT lam_bank_1.ls_up_obd2.ratio_vls_cyc_afl_sum "total value of lean time" UWORD _CNV_A_R_LINEAR_____127_CM 1 100. 0. 1023.984375 DISPLAY_IDENTIFIER RATIO_VLS_CYC_AFL_SUM_1 ECU_ADDRESS 0x3fc4fa BYTE_ORDER MSB_LAST FORMAT "%7.2" /end MEASUREMENT
/begin MEASUREMENT lam_bank_1.ls_up_obd2.ratio_vls_cyc_afr_sum "total value of rich time" UWORD _CNV_A_R_LINEAR_____127_CM 1 100. 0. 1023.984375 DISPLAY_IDENTIFIER RATIO_VLS_CYC_AFR_SUM_1 ECU_ADDRESS 0x3fc4fc BYTE_ORDER MSB_LAST FORMAT "%7.2" /end MEASUREMENT
/begin MEASUREMENT lam_bank_1.ls_up_obd2.ratio_vls_cyc_afl_mv "total ratio between measured and max. allowed lean time" UWORD _CNV_A_R_LINEAR_____123_CM 1 100. 0. 255.996094 DISPLAY_IDENTIFIER RATIO_VLS_CYC_AFL_MV_1 ECU_ADDRESS 0x3fc4fe BYTE_ORDER MSB_LAST FORMAT "%7.3" /end MEASUREMENT
/begin MEASUREMENT lam_bank_1.ls_up_obd2.ratio_vls_cyc_afr_mv "total ratio between measured and max. allowed rich time, saved for SAE Mode $6 output" UWORD _CNV_A_R_LINEAR_____123_CM 1 100. 0. 255.996094 DISPLAY_IDENTIFIER RATIO_VLS_CYC_AFR_MV_1 ECU_ADDRESS 0x3fc500 BYTE_ORDER MSB_LAST FORMAT "%7.3" /end MEASUREMENT
/begin MEASUREMENT lam_bank_1.ls_up_obd2.ratio_sae_vls_cyc_afl_mv "total ratio between measured and max. allowed lean time, saved for SAE Mode $6 output" UWORD _CNV_A_R_LINEAR_____123_CM 1 100. 0. 255.996094 DISPLAY_IDENTIFIER RATIO_SAE_VLS_CYC_AFL_MV_1 ECU_ADDRESS 0x3fc502 BYTE_ORDER MSB_LAST FORMAT "%7.3" /end MEASUREMENT
/begin MEASUREMENT lam_bank_1.ls_up_obd2.ratio_sae_vls_cyc_afr_mv "total ratio between measured and max. allowed rich time, saved for SAE Mode $6 output" UWORD _CNV_A_R_LINEAR_____123_CM 1 100. 0. 255.996094 DISPLAY_IDENTIFIER RATIO_SAE_VLS_CYC_AFR_MV_1 ECU_ADDRESS 0x3fc504 BYTE_ORDER MSB_LAST FORMAT "%7.3" /end MEASUREMENT
/begin MEASUREMENT lam_bank_1.ls_up_obd2.t_vls_cyc_afr_sum "sum of rich time" UWORD _CNV_A_R_LINEAR_____4_CM 1 100. 0. 655.35 DISPLAY_IDENTIFIER T_VLS_CYC_AFR_SUM_1 ECU_ADDRESS 0x3fc53c BYTE_ORDER MSB_LAST FORMAT "%6.2" /end MEASUREMENT
/begin MEASUREMENT lam_bank_1.ls_up_obd2.t_vls_cyc_afr_sum_max "sum of max rich time" UWORD _CNV_A_R_LINEAR_____4_CM 1 100. 0. 655.35 DISPLAY_IDENTIFIER T_VLS_CYC_AFR_SUM_MAX_1 ECU_ADDRESS 0x3fc53e BYTE_ORDER MSB_LAST FORMAT "%6.2" /end MEASUREMENT
/begin MEASUREMENT lam_bank_1.ls_up_obd2.t_sae_vls_cyc_afr "rich dwell time for scantool" UWORD _CNV_A_R_LINEAR_____4_CM 1 100. 0. 655.35 DISPLAY_IDENTIFIER T_SAE_VLS_CYC_AFR_1 ECU_ADDRESS 0x3fc54c BYTE_ORDER MSB_LAST FORMAT "%6.2" /end MEASUREMENT
/begin MEASUREMENT lam_bank_1.ls_up_obd2.t_sae_vls_cyc_afr_max "max. rich dwell time for scantool" UWORD _CNV_A_R_LINEAR_____4_CM 1 100. 0. 655.35 DISPLAY_IDENTIFIER T_SAE_VLS_CYC_AFR_MAX_1 ECU_ADDRESS 0x3fc54e BYTE_ORDER MSB_LAST FORMAT "%6.2" /end MEASUREMENT
/begin MEASUREMENT lam_bank_1.ls_up_obd2.t_lam_dly_p_old "The T_LAM_DLY_i value witch was active at the last p-jump" SWORD _CNV_A_R_LINEAR_____274_CM 1 100. -15360. 15359.53125 DISPLAY_IDENTIFIER T_LAM_DLY_P_OLD_1 ECU_ADDRESS 0x3fc540 BYTE_ORDER MSB_LAST FORMAT "%8.1" /end MEASUREMENT
/begin MEASUREMENT lam_bank_1.ls_up_obd2.t_lam_dly_p "The T_LAM_DLY_i value of actual p-jump" SWORD _CNV_A_R_LINEAR_____274_CM 1 100. -15360. 15359.53125 DISPLAY_IDENTIFIER T_LAM_DLY_P_1 ECU_ADDRESS 0x3fc542 BYTE_ORDER MSB_LAST FORMAT "%8.1" /end MEASUREMENT
/begin MEASUREMENT lam_bank_1.ls_up_obd2.sum_ratio_vls_cycnr_afl "total value of switching time from rich to lean" UWORD _CNV_A_R_LINEAR_____127_CM 1 100. 0. 1023.984375 DISPLAY_IDENTIFIER SUM_RATIO_VLS_CYCNR_AFL_1 ECU_ADDRESS 0x3fc526 BYTE_ORDER MSB_LAST FORMAT "%7.2" /end MEASUREMENT
/begin MEASUREMENT lam_bank_1.ls_up_obd2.sum_ratio_vls_cycnr_afr "total value of switching time from lean to rich" UWORD _CNV_A_R_LINEAR_____127_CM 1 100. 0. 1023.984375 DISPLAY_IDENTIFIER SUM_RATIO_VLS_CYCNR_AFR_1 ECU_ADDRESS 0x3fc528 BYTE_ORDER MSB_LAST FORMAT "%7.2" /end MEASUREMENT
/begin MEASUREMENT lam_bank_1.ls_up_obd2.t_vls_cyc_afr_mv_max "mean value of rich time" UWORD _CNV_A_R_LINEAR_____4_CM 1 100. 0. 10.23 DISPLAY_IDENTIFIER T_VLS_CYC_AFR_MV_MAX_1 ECU_ADDRESS 0x3fc506 BYTE_ORDER MSB_LAST FORMAT "%5.2" /end MEASUREMENT
/begin MEASUREMENT lam_bank_1.ls_up_obd2.t_vls_cyc_afl_mv_max "mean value of lean time" UWORD _CNV_A_R_LINEAR_____4_CM 1 100. 0. 10.23 DISPLAY_IDENTIFIER T_VLS_CYC_AFL_MV_MAX_1 ECU_ADDRESS 0x3fc508 BYTE_ORDER MSB_LAST FORMAT "%5.2" /end MEASUREMENT
/begin MEASUREMENT lam_bank_1.ls_down_obd2.bf.lv_ls_down_swt_vld "Validity bit of the current switching time check" ULONG _CNV_S_2_RANGE______0_CM 1 100. 0. 1. DISPLAY_IDENTIFIER LV_LS_DOWN_SWT_VLD_1 ECU_ADDRESS 0x3fc3b8 BYTE_ORDER MSB_LAST BIT_MASK 0x80000000 /end MEASUREMENT
/begin MEASUREMENT lam_bank_1.ls_down_obd2.bf.lv_ls_down_pue_vld "Debounced diagnosis result of pull end plausibility" ULONG _CNV_S_2_RANGE______0_CM 1 100. 0. 1. DISPLAY_IDENTIFIER LV_LS_DOWN_PUE_VLD_1 ECU_ADDRESS 0x3fc3b8 BYTE_ORDER MSB_LAST BIT_MASK 0x40000000 /end MEASUREMENT
/begin MEASUREMENT lam_bank_1.ls_down_obd2.bf.lv_cdn_diag_ls_down "Status of permission for diagnosis" ULONG _CNV_S_2_RANGE______0_CM 1 100. 0. 1. DISPLAY_IDENTIFIER LV_CDN_DIAG_LS_DOWN_1 ECU_ADDRESS 0x3fc3b8 BYTE_ORDER MSB_LAST BIT_MASK 0x20000000 /end MEASUREMENT
/begin MEASUREMENT lam_bank_1.ls_down_obd2.cycnr_vls_down_act "Cycle counter for switching time determination, Bank i" UBYTE _CNV_A_R_LINEAR_____290_CM 1 100. 0. 5100. DISPLAY_IDENTIFIER CYCNR_VLS_DOWN_ACT_1 ECU_ADDRESS 0x3fc3c2 FORMAT "%5.0" /end MEASUREMENT
/begin MEASUREMENT lam_bank_1.ls_down_obd2.ctr_vls_down_diag "Number of valid switching times from rich to lean" UBYTE _CNV_A_R_LINEAR_____1_CM 1 100. 0. 255. DISPLAY_IDENTIFIER CTR_VLS_DOWN_DIAG_1 ECU_ADDRESS 0x3fc3c6 FORMAT "%3.0" /end MEASUREMENT
/begin MEASUREMENT lam_bank_1.ls_down_obd2.vls_down_tran_puc "Monitor sensor voltage on activating the trailing throttle fuel cut-off, Bank i " UWORD _CNV_A_R_LINEAR_____3_CM 1 100. 0. 4.99511719 DISPLAY_IDENTIFIER VLS_DOWN_TRAN_PUC_1 ECU_ADDRESS 0x3fc3be BYTE_ORDER MSB_LAST FORMAT "%5.3" /end MEASUREMENT
/begin MEASUREMENT lam_bank_1.ls_down_obd2.ctr_cycnr_quo_vls_down_sum "Sum of weighted CYCNR_VLS_DOWN_ACT_i, Bank i " UWORD _CNV_A_R_LINEAR_____123_CM 1 100. 0. 255.996094 DISPLAY_IDENTIFIER CTR_CYCNR_QUO_VLS_DOWN_SUM_1 ECU_ADDRESS 0x3fc3c8 BYTE_ORDER MSB_LAST FORMAT "%7.3" /end MEASUREMENT
/begin MEASUREMENT lam_bank_1.ls_down_obd2.cycnr_ratio_vls_down "mean value of the ratio between the monitor sensor switching time and the threshold value" UBYTE _CNV_A_R_LINEAR_____39_CM 1 100. 0. 1.99220002 DISPLAY_IDENTIFIER CYCNR_RATIO_VLS_DOWN_1 ECU_ADDRESS 0x3fc3ca FORMAT "%5.3" /end MEASUREMENT
/begin MEASUREMENT lam_bank_1.ls_down_obd2.cycnr_sae_ratio_vls_down "mean value of the ratio between the monitor sensor switching time and the threshold value for scantool" UBYTE _CNV_A_R_LINEAR_____39_CM 1 100. 0. 1.99220002 DISPLAY_IDENTIFIER CYCNR_SAE_RATIO_VLS_DOWN_1 ECU_ADDRESS 0x3fc3cb FORMAT "%5.3" /end MEASUREMENT
/begin MEASUREMENT lam_bank_1.ls_down_obd2.cycnr_quo_vls_down "weighted value of CYCNR_VLS_DOWN_ACT_i " UWORD _CNV_A_R_LINEAR_____123_CM 1 100. 0. 255.996094 DISPLAY_IDENTIFIER CYCNR_QUO_VLS_DOWN_1 ECU_ADDRESS 0x3fc3c4 BYTE_ORDER MSB_LAST FORMAT "%7.3" /end MEASUREMENT
/begin MEASUREMENT lam_bank_1.ls_down_obd2.vls_down_pue "Monitor sensor voltage at the time of leaving PUC, Bank i (i=1.2)" UWORD _CNV_A_R_LINEAR_____3_CM 1 100. 0. 4.99511719 DISPLAY_IDENTIFIER VLS_DOWN_PUE_1 ECU_ADDRESS 0x3fc3ce BYTE_ORDER MSB_LAST FORMAT "%5.3" /end MEASUREMENT
/begin MEASUREMENT lam_bank_1.ls_down_obd2.ctr_end_diag_ls_down_pue "Time counter to set LV_END_DIAG_VLS_DOWN_PUE_i" UWORD _CNV_A_R_LINEAR_____1_CM 1 100. 0. 65535. DISPLAY_IDENTIFIER CTR_END_DIAG_LS_DOWN_PUE_1 ECU_ADDRESS 0x3fc3d4 BYTE_ORDER MSB_LAST FORMAT "%5.0" /end MEASUREMENT
/begin MEASUREMENT lam_bank_1.ls_down_obd2.vls_down_dif_diag "difference of VLS_DOWN values from the beginning to the end of the MAF_INT_PUE calculation" UWORD _CNV_A_R_LINEAR_____3_CM 1 100. 0. 4.99511719 DISPLAY_IDENTIFIER VLS_DOWN_DIF_DIAG_1 ECU_ADDRESS 0x3fc3d0 BYTE_ORDER MSB_LAST FORMAT "%5.3" /end MEASUREMENT
/begin MEASUREMENT lam_bank_1.ls_down_obd2.vls_sae_down_dif_diag "difference of VLS_DOWN values from the beginning to the end of the MAF_INT_PUE calculation for scantool" UWORD _CNV_A_R_LINEAR_____3_CM 1 100. 0. 4.99511719 DISPLAY_IDENTIFIER VLS_SAE_DOWN_DIF_DIAG_1 ECU_ADDRESS 0x3fc3d2 BYTE_ORDER MSB_LAST FORMAT "%5.3" /end MEASUREMENT
/begin MEASUREMENT lam_bank_1.ls_down_obd2.ctr_ls_down_pue "counter for anti-bounce" UBYTE _CNV_A_R_LINEAR_____1_CM 1 100. 0. 255. DISPLAY_IDENTIFIER CTR_LS_DOWN_PUE_1 ECU_ADDRESS 0x3fc3d6 FORMAT "%3.0" /end MEASUREMENT
/begin MEASUREMENT lam_bank_1.lsh_up_obd2.pow_int_obd2_lsh_up "Integral indicates measure of cooling energy of exhaust gas at sensor location" UWORD _CNV_A_R_LINEAR_____291_CM 1 100. 0. 65535. DISPLAY_IDENTIFIER POW_INT_OBD2_LSH_UP_1 ECU_ADDRESS 0x3fc492 BYTE_ORDER MSB_LAST FORMAT "%5.0" /end MEASUREMENT
/begin MEASUREMENT lam_bank_1.lsh_up_obd2.state_obd2_lsh_up "Indicates current phase of oxygen sensor heater OBDII diagnosis" UBYTE _CNV_S_9_STATE_OBD2_292_CM 1 100. 0. 8. DISPLAY_IDENTIFIER STATE_OBD2_LSH_UP_1 ECU_ADDRESS 0x3fc490 /end MEASUREMENT
/begin MEASUREMENT lam_bank_1.lsh_up_obd2.tcc_obd2_lsh_up "Number of completed valid diagnosis cycles" UWORD _CNV_A_R_LINEAR_____22_CM 1 100. 0. 1023. DISPLAY_IDENTIFIER TCC_OBD2_LSH_UP_1 ECU_ADDRESS 0x3fc494 BYTE_ORDER MSB_LAST FORMAT "%4.0" /end MEASUREMENT
/begin MEASUREMENT lam_bank_1.lsh_up_obd2.frc_obd2_lsh_up "Number of faults detected during valid diagnosis cycles" UWORD _CNV_A_R_LINEAR_____22_CM 1 100. 0. 1023. DISPLAY_IDENTIFIER FRC_OBD2_LSH_UP_1 ECU_ADDRESS 0x3fc496 BYTE_ORDER MSB_LAST FORMAT "%4.0" /end MEASUREMENT
/begin MEASUREMENT lam_bank_1.lsh_up_obd2.ctr_cycnr_r_obd2_lsh_up "Value of handshake counter for last valid resistance value used for diagnosis" UWORD _CNV_A_R_LINEAR_____1_CM 1 100. 0. 65535. DISPLAY_IDENTIFIER CTR_CYCNR_R_OBD2_LSH_UP_1 ECU_ADDRESS 0x3fc498 BYTE_ORDER MSB_LAST FORMAT "%5.0" /end MEASUREMENT
/begin MEASUREMENT lam_bank_1.lsh_up_obd2.r_up_ls_obd2_lsh_up "Most current upstream oxygen sensor internal resistance used for diagnosis cycle, Mode 6 information" UWORD _CNV_A_R_LINEAR_____1_CM 1 100. 0. 65535. DISPLAY_IDENTIFIER R_UP_LS_OBD2_LSH_UP_1 ECU_ADDRESS 0x3fc49a BYTE_ORDER MSB_LAST FORMAT "%5.0" /end MEASUREMENT
/begin MEASUREMENT lam_bank_1.lsh_up_obd2.temp_dif_obd2_lsh_up "Indicates difference in temperature between set operating temperature & exhaust gas at sensor location" UWORD _CNV_A_R_LINEAR_____14_CM 1 100. 0. 2047. DISPLAY_IDENTIFIER TEMP_DIF_OBD2_LSH_UP_1 ECU_ADDRESS 0x3fc49e BYTE_ORDER MSB_LAST FORMAT "%4.0" /end MEASUREMENT
/begin MEASUREMENT lam_bank_1.cat_eff_inci.lv_inh_diag_cat_diag "" UBYTE _CNV_S_2_RANGE______0_CM 1 100. 0. 1. DISPLAY_IDENTIFIER LV_INH_DIAG_CAT_DIAG_1 ECU_ADDRESS 0x3fc468 /end MEASUREMENT
/begin MEASUREMENT lam_bank_1.cat_eff_inci.lv_auth_cat_diag "" UBYTE _CNV_S_2_RANGE______0_CM 1 100. 0. 1. DISPLAY_IDENTIFIER LV_AUTH_CAT_DIAG_1 ECU_ADDRESS 0x3fc46a /end MEASUREMENT
/begin MEASUREMENT lam_bank_1.cat_eff_ldc_obd2.lv_ldc_cat "" UBYTE _CNV_S_2_RANGE______0_CM 1 100. 0. 1. DISPLAY_IDENTIFIER LV_LDC_CAT_1 ECU_ADDRESS 0x3fc1fb /end MEASUREMENT
/begin MEASUREMENT lam_bank_1.cat_eff_ldc_obd2.maf_int_ldc_cat "integral of mass air flow since limited dynamic conditions fulfilled" UWORD _CNV_A_R_LINEAR_____271_CM 1 100. 0. 1820.398 DISPLAY_IDENTIFIER MAF_INT_LDC_CAT_1 ECU_ADDRESS 0x3fc1f4 BYTE_ORDER MSB_LAST FORMAT "%7.2" /end MEASUREMENT
/begin MEASUREMENT lam_bank_1.cat_eff_ldc_obd2.pv_av_grd_sum "su. value for limited PV_AV gradient" UWORD _CNV_A_R_LINEAR_____301_CM 1 100. 0. 639990.2340000001 DISPLAY_IDENTIFIER PV_AV_GRD_SUM_1 ECU_ADDRESS 0x3fc1f6 BYTE_ORDER MSB_LAST FORMAT "%8.1" /end MEASUREMENT
/begin MEASUREMENT lam_bank_1.cat_eff_ldc_obd2.lam_mv_mmv_cat "floating mean value for limited lambda deviation" SWORD _CNV_A_R_LINEAR_____109_CM 1 100. -50. 49.99847412 DISPLAY_IDENTIFIER LAM_MV_MMV_CAT_1 ECU_ADDRESS 0x3fc1f8 BYTE_ORDER MSB_LAST FORMAT "%7.3" /end MEASUREMENT
/begin MEASUREMENT lam_bank_2.cat_eff_obd2.bf.lv_cat_diag_cyc_vld "Monitoring cycle valid, used for calculation of diagnosis value" ULONG _CNV_S_2_RANGE______0_CM 1 100. 0. 1. DISPLAY_IDENTIFIER LV_CAT_DIAG_CYC_VLD_2 ECU_ADDRESS 0x3fc564 BYTE_ORDER MSB_LAST BIT_MASK 0x80000000 /end MEASUREMENT
/begin MEASUREMENT lam_bank_2.cat_eff_obd2.sum_cat_diag "monitoring cycle counter" UWORD _CNV_A_R_LINEAR_____1_CM 1 100. 0. 65535. DISPLAY_IDENTIFIER SUM_CAT_DIAG_2 ECU_ADDRESS 0x3fc572 BYTE_ORDER MSB_LAST FORMAT "%5.0" /end MEASUREMENT
/begin MEASUREMENT lam_bank_2.cat_eff_obd2.cat_diag_clc "Diagnostic value, catalytic converter efficiency check, bank i (i=1,2)" UWORD _CNV_A_R_LINEAR_____285_CM 1 100. 0. 20. DISPLAY_IDENTIFIER CAT_DIAG_CLC_2 ECU_ADDRESS 0x3fc57a BYTE_ORDER MSB_LAST FORMAT "%5.2" /end MEASUREMENT
/begin MEASUREMENT lam_bank_2.cat_eff_obd2.cat_diag_cus "Customer diagnostic value, catalytic converter efficiency check, bank i (i=1,2)" UWORD _CNV_A_R_LINEAR_____285_CM 1 100. 0. 20. DISPLAY_IDENTIFIER CAT_DIAG_CUS_2 ECU_ADDRESS 0x3fc580 BYTE_ORDER MSB_LAST FORMAT "%5.2" /end MEASUREMENT
/begin MEASUREMENT lam_bank_2.cat_eff_obd2.vls_cyc_step "state-counter for several phases of a rich-lean-cycle" UBYTE _CNV_S_8_STATE_VLS__286_CM 1 100. 0. 255. DISPLAY_IDENTIFIER VLS_CYC_STEP_2 ECU_ADDRESS 0x3fc576 /end MEASUREMENT
/begin MEASUREMENT lam_bank_2.cat_eff_obd2.sum_o2_cat_dif "Sum of the difference between measured post-CAT oxygen exposure and mean oxygen exposure, bank i (i=1,2)" UWORD _CNV_A_R_LINEAR_____287_CM 1 100. 0. 5119.9218 DISPLAY_IDENTIFIER SUM_O2_CAT_DIF_2 ECU_ADDRESS 0x3fc568 BYTE_ORDER MSB_LAST FORMAT "%9.4" /end MEASUREMENT
/begin MEASUREMENT lam_bank_2.cat_eff_obd2.sum_o2_cat "Sum of post-catalyst oxygen exposure, bank i (i=1,2)" UWORD _CNV_A_R_LINEAR_____288_CM 1 100. 0. 5.119921 DISPLAY_IDENTIFIER SUM_O2_CAT_2 ECU_ADDRESS 0x3fc56a BYTE_ORDER MSB_LAST FORMAT "%7.5" /end MEASUREMENT
/begin MEASUREMENT lam_bank_2.cat_eff_obd2.o2_cat_mv "Mean value of post-catalyst oxygen exposure, bank i (i=1,2)" UBYTE _CNV_A_R_LINEAR_____29_CM 1 100. 0. 0.99610001 DISPLAY_IDENTIFIER O2_CAT_MV_2 ECU_ADDRESS 0x3fc56c FORMAT "%5.3" /end MEASUREMENT
/begin MEASUREMENT lam_bank_2.cat_eff_obd2.o2_cat_ratio "Quotient of O2_CAT_INT_i and ID_VLS_CAT_INT_MAX_AT/MT__N__MAF, bank i (i=1,2)" UWORD _CNV_A_R_LINEAR_____285_CM 1 100. 0. 20. DISPLAY_IDENTIFIER O2_CAT_RATIO_2 ECU_ADDRESS 0x3fc570 BYTE_ORDER MSB_LAST FORMAT "%5.2" /end MEASUREMENT
/begin MEASUREMENT lam_bank_2.cat_eff_obd2.sum_o2_cat_ratio "Sum of O2_CAT_RATIO_i" UWORD _CNV_A_R_LINEAR_____289_CM 1 100. 0. 2559.96094 DISPLAY_IDENTIFIER SUM_O2_CAT_RATIO_2 ECU_ADDRESS 0x3fc574 BYTE_ORDER MSB_LAST FORMAT "%7.2" /end MEASUREMENT
/begin MEASUREMENT lam_bank_2.cat_eff_obd2.sum_vls_cat_o2 "Oxygen oscillation at CAT-entry" ULONG _CNV_A_R_LINEAR_____22_CM 1 100. 0. 4294967295. DISPLAY_IDENTIFIER SUM_VLS_CAT_O2_2 ECU_ADDRESS 0x3fc57c BYTE_ORDER MSB_LAST FORMAT "%11.0" /end MEASUREMENT
/begin MEASUREMENT lam_bank_2.cat_eff_obd2.o2_cat "Value of post-catalyst oxygen exposure, bank i (i=1,2)" UBYTE _CNV_A_R_LINEAR_____29_CM 1 100. 0. 0.99610001 DISPLAY_IDENTIFIER O2_CAT_2 ECU_ADDRESS 0x3fc577 FORMAT "%5.3" /end MEASUREMENT
/begin MEASUREMENT lam_bank_2.cat_eff_obd2.cat_diag "Generic diagnosis value" UBYTE _CNV_A_R_LINEAR_____157_CM 1 100. 0. 1.984375 DISPLAY_IDENTIFIER CAT_DIAG_2 ECU_ADDRESS 0x3fc582 FORMAT "%4.2" /end MEASUREMENT
/begin MEASUREMENT lam_bank_2.ls_up_obd2.bf.lv_inh_diag_ls_up "OBD2 function: application incidence for inhibition" ULONG _CNV_S_2_RANGE______0_CM 1 100. 0. 1. DISPLAY_IDENTIFIER LV_INH_DIAG_LS_UP_2 ECU_ADDRESS 0x3fc854 BYTE_ORDER MSB_LAST BIT_MASK 0x40000000 /end MEASUREMENT
/begin MEASUREMENT lam_bank_2.ls_up_obd2.vls_cycnr_max "top limit diagnostic threshold for switching time monitoring" UWORD _CNV_A_R_LINEAR_____3_CM 1 100. 0. 4.99511719 DISPLAY_IDENTIFIER VLS_CYCNR_MAX_2 ECU_ADDRESS 0x3fc87c BYTE_ORDER MSB_LAST FORMAT "%5.3" /end MEASUREMENT
/begin MEASUREMENT lam_bank_2.ls_up_obd2.vls_cycnr_min "bottom limit diagnostic threshold for switching time monitoring" UWORD _CNV_A_R_LINEAR_____3_CM 1 100. 0. 4.99511719 DISPLAY_IDENTIFIER VLS_CYCNR_MIN_2 ECU_ADDRESS 0x3fc87e BYTE_ORDER MSB_LAST FORMAT "%5.3" /end MEASUREMENT
/begin MEASUREMENT lam_bank_2.ls_up_obd2.t_vls_cycnr "actual switching time" UWORD _CNV_A_R_LINEAR_____4_CM 1 100. 0. 655.35 DISPLAY_IDENTIFIER T_VLS_CYCNR_2 ECU_ADDRESS 0x3fc880 BYTE_ORDER MSB_LAST FORMAT "%5.2" /end MEASUREMENT
/begin MEASUREMENT lam_bank_2.ls_up_obd2.ratio_vls_cycnr_afl_mv "total ratio between measured and max. allowed switching times from rich to lean" UWORD _CNV_A_R_LINEAR_____123_CM 1 100. 0. 255.996094 DISPLAY_IDENTIFIER RATIO_VLS_CYCNR_AFL_MV_2 ECU_ADDRESS 0x3fc88e BYTE_ORDER MSB_LAST FORMAT "%7.3" /end MEASUREMENT
/begin MEASUREMENT lam_bank_2.ls_up_obd2.ratio_vls_cycnr_afr_mv "number of measured switching times from rich to lean" UWORD _CNV_A_R_LINEAR_____123_CM 1 100. 0. 255.996094 DISPLAY_IDENTIFIER RATIO_VLS_CYCNR_AFR_MV_2 ECU_ADDRESS 0x3fc890 BYTE_ORDER MSB_LAST FORMAT "%7.3" /end MEASUREMENT
/begin MEASUREMENT lam_bank_2.ls_up_obd2.sum_cycnr_afl "number of measured switching times from rich to lean" UWORD _CNV_A_R_LINEAR_____1_CM 1 100. 0. 65535. DISPLAY_IDENTIFIER SUM_CYCNR_AFL_2 ECU_ADDRESS 0x3fc882 BYTE_ORDER MSB_LAST FORMAT "%5.0" /end MEASUREMENT
/begin MEASUREMENT lam_bank_2.ls_up_obd2.sum_cycnr_afr "number of measured switching times from lean to rich" UWORD _CNV_A_R_LINEAR_____1_CM 1 100. 0. 65535. DISPLAY_IDENTIFIER SUM_CYCNR_AFR_2 ECU_ADDRESS 0x3fc884 BYTE_ORDER MSB_LAST FORMAT "%5.0" /end MEASUREMENT
/begin MEASUREMENT lam_bank_2.ls_up_obd2.ratio_vls_cycnr_afl "ratio between measured and max. allowed switching times from rich to lean" UWORD _CNV_A_R_LINEAR_____123_CM 1 100. 0. 255.996094 DISPLAY_IDENTIFIER RATIO_VLS_CYCNR_AFL_2 ECU_ADDRESS 0x3fc886 BYTE_ORDER MSB_LAST FORMAT "%7.3" /end MEASUREMENT
/begin MEASUREMENT lam_bank_2.ls_up_obd2.ratio_sae_vls_cycnr_afl_mv "ratio between measured and max. allowed switching times from rich to lean for scantool" UWORD _CNV_A_R_LINEAR_____123_CM 1 100. 0. 255.996094 DISPLAY_IDENTIFIER RATIO_SAE_VLS_CYCNR_AFL_MV_2 ECU_ADDRESS 0x3fc892 BYTE_ORDER MSB_LAST FORMAT "%7.3" /end MEASUREMENT
/begin MEASUREMENT lam_bank_2.ls_up_obd2.ratio_sae_vls_cycnr_afr_mv "ratio between measured and max. allowed switching times from lean to rich for scantool" UWORD _CNV_A_R_LINEAR_____123_CM 1 100. 0. 255.996094 DISPLAY_IDENTIFIER RATIO_SAE_VLS_CYCNR_AFR_MV_2 ECU_ADDRESS 0x3fc894 BYTE_ORDER MSB_LAST FORMAT "%7.3" /end MEASUREMENT
/begin MEASUREMENT lam_bank_2.ls_up_obd2.ratio_vls_cycnr_afr "ratio between measured and max. allowed switching times from lean to rich" UWORD _CNV_A_R_LINEAR_____123_CM 1 100. 0. 255.996094 DISPLAY_IDENTIFIER RATIO_VLS_CYCNR_AFR_2 ECU_ADDRESS 0x3fc888 BYTE_ORDER MSB_LAST FORMAT "%7.3" /end MEASUREMENT
/begin MEASUREMENT lam_bank_2.ls_up_obd2.t_vls_afr_to_afl_sum "sum of SWT rich to lean" UWORD _CNV_A_R_LINEAR_____4_CM 1 100. 0. 655.35 DISPLAY_IDENTIFIER T_VLS_AFR_TO_AFL_SUM_2 ECU_ADDRESS 0x3fc898 BYTE_ORDER MSB_LAST FORMAT "%6.2" /end MEASUREMENT
/begin MEASUREMENT lam_bank_2.ls_up_obd2.t_vls_afr_to_afl_sum_max "sum of max SWT rich to lean" UWORD _CNV_A_R_LINEAR_____4_CM 1 100. 0. 655.35 DISPLAY_IDENTIFIER T_VLS_AFR_TO_AFL_SUM_MAX_2 ECU_ADDRESS 0x3fc89a BYTE_ORDER MSB_LAST FORMAT "%6.2" /end MEASUREMENT
/begin MEASUREMENT lam_bank_2.ls_up_obd2.t_vls_afl_to_afr_sum "sum of SWT lean to rich" UWORD _CNV_A_R_LINEAR_____4_CM 1 100. 0. 655.35 DISPLAY_IDENTIFIER T_VLS_AFL_TO_AFR_SUM_2 ECU_ADDRESS 0x3fc89c BYTE_ORDER MSB_LAST FORMAT "%6.2" /end MEASUREMENT
/begin MEASUREMENT lam_bank_2.ls_up_obd2.t_vls_afl_to_afr_sum_max "sum of max SWT lean to rich" UWORD _CNV_A_R_LINEAR_____4_CM 1 100. 0. 655.35 DISPLAY_IDENTIFIER T_VLS_AFL_TO_AFR_SUM_MAX_2 ECU_ADDRESS 0x3fc89e BYTE_ORDER MSB_LAST FORMAT "%6.2" /end MEASUREMENT
/begin MEASUREMENT lam_bank_2.ls_up_obd2.vls_sae_afl_thd "SWT lean threshold for scantool" UWORD _CNV_A_R_LINEAR_____3_CM 1 100. 0. 4.99511719 DISPLAY_IDENTIFIER VLS_SAE_AFL_THD_2 ECU_ADDRESS 0x3fc8a8 BYTE_ORDER MSB_LAST FORMAT "%5.3" /end MEASUREMENT
/begin MEASUREMENT lam_bank_2.ls_up_obd2.vls_sae_afr_thd "SWT rich threshold for scantool" UWORD _CNV_A_R_LINEAR_____3_CM 1 100. 0. 4.99511719 DISPLAY_IDENTIFIER VLS_SAE_AFR_THD_2 ECU_ADDRESS 0x3fc8aa BYTE_ORDER MSB_LAST FORMAT "%5.3" /end MEASUREMENT
/begin MEASUREMENT lam_bank_2.ls_up_obd2.t_sae_vls_afr_afl "SWT rich to lean for scantool" UBYTE _CNV_A_R_LINEAR_____4_CM 1 100. 0. 2.55 DISPLAY_IDENTIFIER T_SAE_VLS_AFR_AFL_2 ECU_ADDRESS 0x3fc8ac FORMAT "%4.2" /end MEASUREMENT
/begin MEASUREMENT lam_bank_2.ls_up_obd2.t_sae_vls_afr_afl_max "max. SWT rich to lean for scantool" UBYTE _CNV_A_R_LINEAR_____4_CM 1 100. 0. 2.55 DISPLAY_IDENTIFIER T_SAE_VLS_AFR_AFL_MAX_2 ECU_ADDRESS 0x3fc8ad FORMAT "%4.2" /end MEASUREMENT
/begin MEASUREMENT lam_bank_2.ls_up_obd2.t_sae_vls_afl_afr_max "max. SWT lean to rich for scantool" UBYTE _CNV_A_R_LINEAR_____4_CM 1 100. 0. 2.55 DISPLAY_IDENTIFIER T_SAE_VLS_AFL_AFR_MAX_2 ECU_ADDRESS 0x3fc8af FORMAT "%4.2" /end MEASUREMENT
/begin MEASUREMENT lam_bank_2.ls_up_obd2.t_sae_vls_afl_afr "SWT lean to rich for scantool" UBYTE _CNV_A_R_LINEAR_____4_CM 1 100. 0. 2.55 DISPLAY_IDENTIFIER T_SAE_VLS_AFL_AFR_2 ECU_ADDRESS 0x3fc8ae FORMAT "%4.2" /end MEASUREMENT
/begin MEASUREMENT lam_bank_2.ls_up_obd2.sum_cyc "number of measured complete controller periods" UWORD _CNV_A_R_LINEAR_____1_CM 1 100. 0. 65535. DISPLAY_IDENTIFIER SUM_CYC_2 ECU_ADDRESS 0x3fc858 BYTE_ORDER MSB_LAST FORMAT "%5.0" /end MEASUREMENT
/begin MEASUREMENT lam_bank_2.ls_up_obd2.ratio_vls_cyc_afl "ratio between measured and max. allowed lean time" UWORD _CNV_A_R_LINEAR_____123_CM 1 100. 0. 255.996094 DISPLAY_IDENTIFIER RATIO_VLS_CYC_AFL_2 ECU_ADDRESS 0x3fc85a BYTE_ORDER MSB_LAST FORMAT "%7.3" /end MEASUREMENT
/begin MEASUREMENT lam_bank_2.ls_up_obd2.ratio_vls_cyc_afr "ratio between measured and max. allowed  rich time" UWORD _CNV_A_R_LINEAR_____123_CM 1 100. 0. 255.996094 DISPLAY_IDENTIFIER RATIO_VLS_CYC_AFR_2 ECU_ADDRESS 0x3fc85c BYTE_ORDER MSB_LAST FORMAT "%7.3" /end MEASUREMENT
/begin MEASUREMENT lam_bank_2.ls_up_obd2.ratio_vls_cyc_afl_sum "total value of lean time" UWORD _CNV_A_R_LINEAR_____127_CM 1 100. 0. 1023.984375 DISPLAY_IDENTIFIER RATIO_VLS_CYC_AFL_SUM_2 ECU_ADDRESS 0x3fc85e BYTE_ORDER MSB_LAST FORMAT "%7.2" /end MEASUREMENT
/begin MEASUREMENT lam_bank_2.ls_up_obd2.ratio_vls_cyc_afr_sum "total value of rich time" UWORD _CNV_A_R_LINEAR_____127_CM 1 100. 0. 1023.984375 DISPLAY_IDENTIFIER RATIO_VLS_CYC_AFR_SUM_2 ECU_ADDRESS 0x3fc860 BYTE_ORDER MSB_LAST FORMAT "%7.2" /end MEASUREMENT
/begin MEASUREMENT lam_bank_2.ls_up_obd2.ratio_vls_cyc_afl_mv "total ratio between measured and max. allowed lean time" UWORD _CNV_A_R_LINEAR_____123_CM 1 100. 0. 255.996094 DISPLAY_IDENTIFIER RATIO_VLS_CYC_AFL_MV_2 ECU_ADDRESS 0x3fc862 BYTE_ORDER MSB_LAST FORMAT "%7.3" /end MEASUREMENT
/begin MEASUREMENT lam_bank_2.ls_up_obd2.ratio_vls_cyc_afr_mv "total ratio between measured and max. allowed rich time, saved for SAE Mode $6 output" UWORD _CNV_A_R_LINEAR_____123_CM 1 100. 0. 255.996094 DISPLAY_IDENTIFIER RATIO_VLS_CYC_AFR_MV_2 ECU_ADDRESS 0x3fc864 BYTE_ORDER MSB_LAST FORMAT "%7.3" /end MEASUREMENT
/begin MEASUREMENT lam_bank_2.ls_up_obd2.ratio_sae_vls_cyc_afl_mv "total ratio between measured and max. allowed lean time, saved for SAE Mode $6 output" UWORD _CNV_A_R_LINEAR_____123_CM 1 100. 0. 255.996094 DISPLAY_IDENTIFIER RATIO_SAE_VLS_CYC_AFL_MV_2 ECU_ADDRESS 0x3fc866 BYTE_ORDER MSB_LAST FORMAT "%7.3" /end MEASUREMENT
/begin MEASUREMENT lam_bank_2.ls_up_obd2.ratio_sae_vls_cyc_afr_mv "total ratio between measured and max. allowed rich time, saved for SAE Mode $6 output" UWORD _CNV_A_R_LINEAR_____123_CM 1 100. 0. 255.996094 DISPLAY_IDENTIFIER RATIO_SAE_VLS_CYC_AFR_MV_2 ECU_ADDRESS 0x3fc868 BYTE_ORDER MSB_LAST FORMAT "%7.3" /end MEASUREMENT
/begin MEASUREMENT lam_bank_2.ls_up_obd2.t_vls_cyc_afr_sum "sum of rich time" UWORD _CNV_A_R_LINEAR_____4_CM 1 100. 0. 655.35 DISPLAY_IDENTIFIER T_VLS_CYC_AFR_SUM_2 ECU_ADDRESS 0x3fc8a0 BYTE_ORDER MSB_LAST FORMAT "%6.2" /end MEASUREMENT
/begin MEASUREMENT lam_bank_2.ls_up_obd2.t_vls_cyc_afr_sum_max "sum of max rich time" UWORD _CNV_A_R_LINEAR_____4_CM 1 100. 0. 655.35 DISPLAY_IDENTIFIER T_VLS_CYC_AFR_SUM_MAX_2 ECU_ADDRESS 0x3fc8a2 BYTE_ORDER MSB_LAST FORMAT "%6.2" /end MEASUREMENT
/begin MEASUREMENT lam_bank_2.ls_up_obd2.t_sae_vls_cyc_afr "rich dwell time for scantool" UWORD _CNV_A_R_LINEAR_____4_CM 1 100. 0. 655.35 DISPLAY_IDENTIFIER T_SAE_VLS_CYC_AFR_2 ECU_ADDRESS 0x3fc8b0 BYTE_ORDER MSB_LAST FORMAT "%6.2" /end MEASUREMENT
/begin MEASUREMENT lam_bank_2.ls_up_obd2.t_sae_vls_cyc_afr_max "max. rich dwell time for scantool" UWORD _CNV_A_R_LINEAR_____4_CM 1 100. 0. 655.35 DISPLAY_IDENTIFIER T_SAE_VLS_CYC_AFR_MAX_2 ECU_ADDRESS 0x3fc8b2 BYTE_ORDER MSB_LAST FORMAT "%6.2" /end MEASUREMENT
/begin MEASUREMENT lam_bank_2.ls_up_obd2.t_lam_dly_p_old "The T_LAM_DLY_i value witch was active at the last p-jump" SWORD _CNV_A_R_LINEAR_____274_CM 1 100. -15360. 15359.53125 DISPLAY_IDENTIFIER T_LAM_DLY_P_OLD_2 ECU_ADDRESS 0x3fc8a4 BYTE_ORDER MSB_LAST FORMAT "%8.1" /end MEASUREMENT
/begin MEASUREMENT lam_bank_2.ls_up_obd2.t_lam_dly_p "The T_LAM_DLY_i value of actual p-jump" SWORD _CNV_A_R_LINEAR_____274_CM 1 100. -15360. 15359.53125 DISPLAY_IDENTIFIER T_LAM_DLY_P_2 ECU_ADDRESS 0x3fc8a6 BYTE_ORDER MSB_LAST FORMAT "%8.1" /end MEASUREMENT
/begin MEASUREMENT lam_bank_2.ls_up_obd2.sum_ratio_vls_cycnr_afl "total value of switching time from rich to lean" UWORD _CNV_A_R_LINEAR_____127_CM 1 100. 0. 1023.984375 DISPLAY_IDENTIFIER SUM_RATIO_VLS_CYCNR_AFL_2 ECU_ADDRESS 0x3fc88a BYTE_ORDER MSB_LAST FORMAT "%7.2" /end MEASUREMENT
/begin MEASUREMENT lam_bank_2.ls_up_obd2.sum_ratio_vls_cycnr_afr "total value of switching time from lean to rich" UWORD _CNV_A_R_LINEAR_____127_CM 1 100. 0. 1023.984375 DISPLAY_IDENTIFIER SUM_RATIO_VLS_CYCNR_AFR_2 ECU_ADDRESS 0x3fc88c BYTE_ORDER MSB_LAST FORMAT "%7.2" /end MEASUREMENT
/begin MEASUREMENT lam_bank_2.ls_up_obd2.t_vls_cyc_afr_mv_max "mean value of rich time" UWORD _CNV_A_R_LINEAR_____4_CM 1 100. 0. 10.23 DISPLAY_IDENTIFIER T_VLS_CYC_AFR_MV_MAX_2 ECU_ADDRESS 0x3fc86a BYTE_ORDER MSB_LAST FORMAT "%5.2" /end MEASUREMENT
/begin MEASUREMENT lam_bank_2.ls_up_obd2.t_vls_cyc_afl_mv_max "mean value of lean time" UWORD _CNV_A_R_LINEAR_____4_CM 1 100. 0. 10.23 DISPLAY_IDENTIFIER T_VLS_CYC_AFL_MV_MAX_2 ECU_ADDRESS 0x3fc86c BYTE_ORDER MSB_LAST FORMAT "%5.2" /end MEASUREMENT
/begin MEASUREMENT lam_bank_2.ls_down_obd2.bf.lv_ls_down_swt_vld "Validity bit of the current switching time check" ULONG _CNV_S_2_RANGE______0_CM 1 100. 0. 1. DISPLAY_IDENTIFIER LV_LS_DOWN_SWT_VLD_2 ECU_ADDRESS 0x3fc71c BYTE_ORDER MSB_LAST BIT_MASK 0x80000000 /end MEASUREMENT
/begin MEASUREMENT lam_bank_2.ls_down_obd2.bf.lv_ls_down_pue_vld "Debounced diagnosis result of pull end plausibility" ULONG _CNV_S_2_RANGE______0_CM 1 100. 0. 1. DISPLAY_IDENTIFIER LV_LS_DOWN_PUE_VLD_2 ECU_ADDRESS 0x3fc71c BYTE_ORDER MSB_LAST BIT_MASK 0x40000000 /end MEASUREMENT
/begin MEASUREMENT lam_bank_2.ls_down_obd2.bf.lv_cdn_diag_ls_down "Status of permission for diagnosis" ULONG _CNV_S_2_RANGE______0_CM 1 100. 0. 1. DISPLAY_IDENTIFIER LV_CDN_DIAG_LS_DOWN_2 ECU_ADDRESS 0x3fc71c BYTE_ORDER MSB_LAST BIT_MASK 0x20000000 /end MEASUREMENT
/begin MEASUREMENT lam_bank_2.ls_down_obd2.cycnr_vls_down_act "Cycle counter for switching time determination, Bank i" UBYTE _CNV_A_R_LINEAR_____290_CM 1 100. 0. 5100. DISPLAY_IDENTIFIER CYCNR_VLS_DOWN_ACT_2 ECU_ADDRESS 0x3fc726 FORMAT "%5.0" /end MEASUREMENT
/begin MEASUREMENT lam_bank_2.ls_down_obd2.ctr_vls_down_diag "Number of valid switching times from rich to lean" UBYTE _CNV_A_R_LINEAR_____1_CM 1 100. 0. 255. DISPLAY_IDENTIFIER CTR_VLS_DOWN_DIAG_2 ECU_ADDRESS 0x3fc72a FORMAT "%3.0" /end MEASUREMENT
/begin MEASUREMENT lam_bank_2.ls_down_obd2.vls_down_tran_puc "Monitor sensor voltage on activating the trailing throttle fuel cut-off, Bank i " UWORD _CNV_A_R_LINEAR_____3_CM 1 100. 0. 4.99511719 DISPLAY_IDENTIFIER VLS_DOWN_TRAN_PUC_2 ECU_ADDRESS 0x3fc722 BYTE_ORDER MSB_LAST FORMAT "%5.3" /end MEASUREMENT
/begin MEASUREMENT lam_bank_2.ls_down_obd2.ctr_cycnr_quo_vls_down_sum "Sum of weighted CYCNR_VLS_DOWN_ACT_i, Bank i " UWORD _CNV_A_R_LINEAR_____123_CM 1 100. 0. 255.996094 DISPLAY_IDENTIFIER CTR_CYCNR_QUO_VLS_DOWN_SUM_2 ECU_ADDRESS 0x3fc72c BYTE_ORDER MSB_LAST FORMAT "%7.3" /end MEASUREMENT
/begin MEASUREMENT lam_bank_2.ls_down_obd2.cycnr_ratio_vls_down "mean value of the ratio between the monitor sensor switching time and the threshold value" UBYTE _CNV_A_R_LINEAR_____39_CM 1 100. 0. 1.99220002 DISPLAY_IDENTIFIER CYCNR_RATIO_VLS_DOWN_2 ECU_ADDRESS 0x3fc72e FORMAT "%5.3" /end MEASUREMENT
/begin MEASUREMENT lam_bank_2.ls_down_obd2.cycnr_sae_ratio_vls_down "mean value of the ratio between the monitor sensor switching time and the threshold value for scantool" UBYTE _CNV_A_R_LINEAR_____39_CM 1 100. 0. 1.99220002 DISPLAY_IDENTIFIER CYCNR_SAE_RATIO_VLS_DOWN_2 ECU_ADDRESS 0x3fc72f FORMAT "%5.3" /end MEASUREMENT
/begin MEASUREMENT lam_bank_2.ls_down_obd2.cycnr_quo_vls_down "weighted value of CYCNR_VLS_DOWN_ACT_i " UWORD _CNV_A_R_LINEAR_____123_CM 1 100. 0. 255.996094 DISPLAY_IDENTIFIER CYCNR_QUO_VLS_DOWN_2 ECU_ADDRESS 0x3fc728 BYTE_ORDER MSB_LAST FORMAT "%7.3" /end MEASUREMENT
/begin MEASUREMENT lam_bank_2.ls_down_obd2.vls_down_pue "Monitor sensor voltage at the time of leaving PUC, Bank i (i=1.2)" UWORD _CNV_A_R_LINEAR_____3_CM 1 100. 0. 4.99511719 DISPLAY_IDENTIFIER VLS_DOWN_PUE_2 ECU_ADDRESS 0x3fc732 BYTE_ORDER MSB_LAST FORMAT "%5.3" /end MEASUREMENT
/begin MEASUREMENT lam_bank_2.ls_down_obd2.ctr_end_diag_ls_down_pue "Time counter to set LV_END_DIAG_VLS_DOWN_PUE_i" UWORD _CNV_A_R_LINEAR_____1_CM 1 100. 0. 65535. DISPLAY_IDENTIFIER CTR_END_DIAG_LS_DOWN_PUE_2 ECU_ADDRESS 0x3fc738 BYTE_ORDER MSB_LAST FORMAT "%5.0" /end MEASUREMENT
/begin MEASUREMENT lam_bank_2.ls_down_obd2.vls_down_dif_diag "difference of VLS_DOWN values from the beginning to the end of the MAF_INT_PUE calculation" UWORD _CNV_A_R_LINEAR_____3_CM 1 100. 0. 4.99511719 DISPLAY_IDENTIFIER VLS_DOWN_DIF_DIAG_2 ECU_ADDRESS 0x3fc734 BYTE_ORDER MSB_LAST FORMAT "%5.3" /end MEASUREMENT
/begin MEASUREMENT lam_bank_2.ls_down_obd2.vls_sae_down_dif_diag "difference of VLS_DOWN values from the beginning to the end of the MAF_INT_PUE calculation for scantool" UWORD _CNV_A_R_LINEAR_____3_CM 1 100. 0. 4.99511719 DISPLAY_IDENTIFIER VLS_SAE_DOWN_DIF_DIAG_2 ECU_ADDRESS 0x3fc736 BYTE_ORDER MSB_LAST FORMAT "%5.3" /end MEASUREMENT
/begin MEASUREMENT lam_bank_2.ls_down_obd2.ctr_ls_down_pue "counter for anti-bounce" UBYTE _CNV_A_R_LINEAR_____1_CM 1 100. 0. 255. DISPLAY_IDENTIFIER CTR_LS_DOWN_PUE_2 ECU_ADDRESS 0x3fc73a FORMAT "%3.0" /end MEASUREMENT
/begin MEASUREMENT lam_bank_2.lsh_up_obd2.pow_int_obd2_lsh_up "Integral indicates measure of cooling energy of exhaust gas at sensor location" UWORD _CNV_A_R_LINEAR_____291_CM 1 100. 0. 65535. DISPLAY_IDENTIFIER POW_INT_OBD2_LSH_UP_2 ECU_ADDRESS 0x3fc7f6 BYTE_ORDER MSB_LAST FORMAT "%5.0" /end MEASUREMENT
/begin MEASUREMENT lam_bank_2.lsh_up_obd2.state_obd2_lsh_up "Indicates current phase of oxygen sensor heater OBDII diagnosis" UBYTE _CNV_S_9_STATE_OBD2_292_CM 1 100. 0. 8. DISPLAY_IDENTIFIER STATE_OBD2_LSH_UP_2 ECU_ADDRESS 0x3fc7f4 /end MEASUREMENT
/begin MEASUREMENT lam_bank_2.lsh_up_obd2.tcc_obd2_lsh_up "Number of completed valid diagnosis cycles" UWORD _CNV_A_R_LINEAR_____22_CM 1 100. 0. 1023. DISPLAY_IDENTIFIER TCC_OBD2_LSH_UP_2 ECU_ADDRESS 0x3fc7f8 BYTE_ORDER MSB_LAST FORMAT "%4.0" /end MEASUREMENT
/begin MEASUREMENT lam_bank_2.lsh_up_obd2.frc_obd2_lsh_up "Number of faults detected during valid diagnosis cycles" UWORD _CNV_A_R_LINEAR_____22_CM 1 100. 0. 1023. DISPLAY_IDENTIFIER FRC_OBD2_LSH_UP_2 ECU_ADDRESS 0x3fc7fa BYTE_ORDER MSB_LAST FORMAT "%4.0" /end MEASUREMENT
/begin MEASUREMENT lam_bank_2.lsh_up_obd2.ctr_cycnr_r_obd2_lsh_up "Value of handshake counter for last valid resistance value used for diagnosis" UWORD _CNV_A_R_LINEAR_____1_CM 1 100. 0. 65535. DISPLAY_IDENTIFIER CTR_CYCNR_R_OBD2_LSH_UP_2 ECU_ADDRESS 0x3fc7fc BYTE_ORDER MSB_LAST FORMAT "%5.0" /end MEASUREMENT
/begin MEASUREMENT lam_bank_2.lsh_up_obd2.r_up_ls_obd2_lsh_up "Most current upstream oxygen sensor internal resistance used for diagnosis cycle, Mode 6 information" UWORD _CNV_A_R_LINEAR_____1_CM 1 100. 0. 65535. DISPLAY_IDENTIFIER R_UP_LS_OBD2_LSH_UP_2 ECU_ADDRESS 0x3fc7fe BYTE_ORDER MSB_LAST FORMAT "%5.0" /end MEASUREMENT
/begin MEASUREMENT lam_bank_2.lsh_up_obd2.temp_dif_obd2_lsh_up "Indicates difference in temperature between set operating temperature & exhaust gas at sensor location" UWORD _CNV_A_R_LINEAR_____14_CM 1 100. 0. 2047. DISPLAY_IDENTIFIER TEMP_DIF_OBD2_LSH_UP_2 ECU_ADDRESS 0x3fc802 BYTE_ORDER MSB_LAST FORMAT "%4.0" /end MEASUREMENT
/begin MEASUREMENT lam_bank_2.cat_eff_inci.lv_inh_diag_cat_diag "" UBYTE _CNV_S_2_RANGE______0_CM 1 100. 0. 1. DISPLAY_IDENTIFIER LV_INH_DIAG_CAT_DIAG_2 ECU_ADDRESS 0x3fc7cc /end MEASUREMENT
/begin MEASUREMENT lam_bank_2.cat_eff_inci.lv_auth_cat_diag "" UBYTE _CNV_S_2_RANGE______0_CM 1 100. 0. 1. DISPLAY_IDENTIFIER LV_AUTH_CAT_DIAG_2 ECU_ADDRESS 0x3fc7ce /end MEASUREMENT
/begin MEASUREMENT lam_bank_2.cat_eff_ldc_obd2.lv_ldc_cat "" UBYTE _CNV_S_2_RANGE______0_CM 1 100. 0. 1. DISPLAY_IDENTIFIER LV_LDC_CAT_2 ECU_ADDRESS 0x3fc55f /end MEASUREMENT
/begin MEASUREMENT lam_bank_2.cat_eff_ldc_obd2.maf_int_ldc_cat "integral of mass air flow since limited dynamic conditions fulfilled" UWORD _CNV_A_R_LINEAR_____271_CM 1 100. 0. 1820.398 DISPLAY_IDENTIFIER MAF_INT_LDC_CAT_2 ECU_ADDRESS 0x3fc558 BYTE_ORDER MSB_LAST FORMAT "%7.2" /end MEASUREMENT
/begin MEASUREMENT lam_bank_2.cat_eff_ldc_obd2.pv_av_grd_sum "su. value for limited PV_AV gradient" UWORD _CNV_A_R_LINEAR_____301_CM 1 100. 0. 639990.2340000001 DISPLAY_IDENTIFIER PV_AV_GRD_SUM_2 ECU_ADDRESS 0x3fc55a BYTE_ORDER MSB_LAST FORMAT "%8.1" /end MEASUREMENT
/begin MEASUREMENT lam_bank_2.cat_eff_ldc_obd2.lam_mv_mmv_cat "floating mean value for limited lambda deviation" SWORD _CNV_A_R_LINEAR_____109_CM 1 100. -50. 49.99847412 DISPLAY_IDENTIFIER LAM_MV_MMV_CAT_2 ECU_ADDRESS 0x3fc55c BYTE_ORDER MSB_LAST FORMAT "%7.3" /end MEASUREMENT
/begin MEASUREMENT lv_err_dmtlm "error DMTL module" UBYTE _CNV_S_2_RANGE______0_CM 1 100. 0. 1. DISPLAY_IDENTIFIER LV_ERR_DMTLM ECU_ADDRESS 0x3fba80 /end MEASUREMENT
/begin MEASUREMENT n_mmv_cat "floating mean value for limited engine speed" UWORD _CNV_A_R_LINEAR_____11_CM 1 100. 0. 8160. DISPLAY_IDENTIFIER N_MMV_CAT ECU_ADDRESS 0x3fd71a BYTE_ORDER MSB_LAST FORMAT "%4.0" /end MEASUREMENT
/begin MEASUREMENT maf_mmv_cat "floating mean value for limited MAF" UWORD _CNV_A_R_LINEAR_____106_CM 1 100. 0. 1389. DISPLAY_IDENTIFIER MAF_MMV_CAT ECU_ADDRESS 0x3fd71c BYTE_ORDER MSB_LAST FORMAT "%7.2" /end MEASUREMENT
/begin MEASUREMENT lv_n_ldc "" UBYTE _CNV_S_2_RANGE______0_CM 1 100. 0. 1. DISPLAY_IDENTIFIER LV_N_LDC ECU_ADDRESS 0x3fe4d5 /end MEASUREMENT
/begin MEASUREMENT lv_maf_ldc "" UBYTE _CNV_S_2_RANGE______0_CM 1 100. 0. 1. DISPLAY_IDENTIFIER LV_MAF_LDC ECU_ADDRESS 0x3fe4d6 /end MEASUREMENT
/begin CHARACTERISTIC c_n_crlc_cat "floating mean value calculation engine speed" VALUE 0x016d4 _REC_VAL_20_u2 0.99998474 _CNV_A_R_LINEAR_____37_CM 0. 0.99998474 DISPLAY_IDENTIFIER C_N_CRLC_CAT FORMAT "%7.5" /end CHARACTERISTIC
/begin CHARACTERISTIC c_maf_crlc_cat "floating mean value calculation MAF" VALUE 0x0163c _REC_VAL_20_u2 0.99998474 _CNV_A_R_LINEAR_____37_CM 0. 0.99998474 DISPLAY_IDENTIFIER C_MAF_CRLC_CAT FORMAT "%7.5" /end CHARACTERISTIC
/begin CHARACTERISTIC c_lam_mv_crlc_cat "floating mean value calculation lambda " VALUE 0x015f2 _REC_VAL_20_u2 0.99998474 _CNV_A_R_LINEAR_____37_CM 0. 0.99998474 DISPLAY_IDENTIFIER C_LAM_MV_CRLC_CAT FORMAT "%7.5" /end CHARACTERISTIC
/begin CHARACTERISTIC c_n_dyw_cat "threshold limited dynamic engine speed" VALUE 0x016e6 _REC_VAL_20_u2 8160. _CNV_A_R_LINEAR_____11_CM 0. 8160. DISPLAY_IDENTIFIER C_N_DYW_CAT FORMAT "%4.0" /end CHARACTERISTIC
/begin CHARACTERISTIC c_maf_dyw_cat "threshold limited dynamic engine MAF" VALUE 0x0164e _REC_VAL_20_u2 1389. _CNV_A_R_LINEAR_____106_CM 0. 1389. DISPLAY_IDENTIFIER C_MAF_DYW_CAT FORMAT "%7.2" /end CHARACTERISTIC
/begin CHARACTERISTIC c_lam_mv_dyw_cat "threshold limited dynamic lambda " VALUE 0x015f8 _REC_VAL_20_u2 99.99847412 _CNV_A_R_LINEAR_____9_CM 0. 99.99847412 DISPLAY_IDENTIFIER C_LAM_MV_DYW_CAT /end CHARACTERISTIC
/begin CHARACTERISTIC c_maf_int_min_cat "MAF integral after setting limited dynamic conditions LV_LDC_CATi before starting the monitoring cycle" VALUE 0x01662 _REC_VAL_20_u2 1820.398 _CNV_A_R_LINEAR_____271_CM 0. 1820.398 DISPLAY_IDENTIFIER C_MAF_INT_MIN_CAT FORMAT "%7.2" /end CHARACTERISTIC
/begin CHARACTERISTIC c_pv_av_grd_dec "decrement for calculation PV_AV gradient" VALUE 0x007a4 _REC_VAL_20_u1 2490.234 _CNV_A_R_LINEAR_____314_CM 0. 2490.234 DISPLAY_IDENTIFIER C_PV_AV_GRD_DEC FORMAT "%6.1" /end CHARACTERISTIC
/begin CHARACTERISTIC c_pv_av_grd_sum_max "max. threshold limited dynamic PV_AV gradient" VALUE 0x01756 _REC_VAL_20_u2 639990.2340000001 _CNV_A_R_LINEAR_____301_CM 0. 639990.2340000001 DISPLAY_IDENTIFIER C_PV_AV_GRD_SUM_MAX FORMAT "%8.1" /end CHARACTERISTIC
/begin CHARACTERISTIC c_pv_av_grd_sum_min "min. threshold limited dynamic PV_AV gradient" VALUE 0x0175a _REC_VAL_20_u2 639990.2340000001 _CNV_A_R_LINEAR_____301_CM 0. 639990.2340000001 DISPLAY_IDENTIFIER C_PV_AV_GRD_SUM_MIN FORMAT "%8.1" /end CHARACTERISTIC
/begin CHARACTERISTIC c_t_pv_av_grd_dec_sum "time periods for calculation limited dynamic PV_AV  gradient" VALUE 0x00838 _REC_VAL_20_u1 5.1 _CNV_A_R_LINEAR_____197_CM 0. 5.1 DISPLAY_IDENTIFIER C_T_PV_AV_GRD_DEC_SUM FORMAT "%4.2" /end CHARACTERISTIC
/begin CHARACTERISTIC c_pv_av_grd_min_sum_cat "minimum value of PV_AV gradient to increment PV_AV_GRD_SUM" VALUE 0x007a6 _REC_VAL_20_u1 1240.2 _CNV_A_R_LINEAR_____315_CM 0. 1240.2 DISPLAY_IDENTIFIER C_PV_AV_GRD_MIN_SUM_CAT FORMAT "%6.1" /end CHARACTERISTIC
/begin CHARACTERISTIC c_o2_cat_mv_min "O2_CAT_MV_i threshold" VALUE 0x0079c _REC_VAL_20_u1 0.9960940000000002 _CNV_A_R_LINEAR_____50_CM 0. 0.996094 DISPLAY_IDENTIFIER C_O2_CAT_MV_MIN FORMAT "%5.3" /end CHARACTERISTIC
/begin CHARACTERISTIC c_o2_cat_mv_max "O2_CAT_MV_i threshold" VALUE 0x0079b _REC_VAL_20_u1 0.9960940000000002 _CNV_A_R_LINEAR_____50_CM 0. 0.996094 DISPLAY_IDENTIFIER C_O2_CAT_MV_MAX FORMAT "%5.3" /end CHARACTERISTIC
/begin CHARACTERISTIC c_o2_cat_mv_dif_max "max. value for O2_CAT_MV_i oscillation between two calculation cycles" VALUE 0x0079a _REC_VAL_20_u1 0.9960940000000002 _CNV_A_R_LINEAR_____50_CM 0. 0.996094 DISPLAY_IDENTIFIER C_O2_CAT_MV_DIF_MAX FORMAT "%5.3" /end CHARACTERISTIC
/begin CHARACTERISTIC c_sum_min_cat_diag "Threshold for cycle counter" VALUE 0x01798 _REC_VAL_20_u2 65535. _CNV_A_R_LINEAR_____1_CM 0. 65535. DISPLAY_IDENTIFIER C_SUM_MIN_CAT_DIAG FORMAT "%5.0" /end CHARACTERISTIC
/begin CHARACTERISTIC c_cat_max_diag "Diagnostic threshold for CAT_DIAG_i - error entry" VALUE 0x014a4 _REC_VAL_20_u2 2559.96094 _CNV_A_R_LINEAR_____289_CM 0. 2559.96094 DISPLAY_IDENTIFIER C_CAT_MAX_DIAG FORMAT "%7.2" /end CHARACTERISTIC
/begin CHARACTERISTIC id_o2_int_max_at__n_32__maf "map-dependent max. admissible value for O2_CAT_INT_i " MAP 0x086b6 _REC_MAP_20_u2_u2_u1 511.99218 _CNV_A_R_LINEAR_____386_CM 0. 511.99218 DISPLAY_IDENTIFIER ID_O2_INT_MAX_AT__N_32__MAF FORMAT "%7.3"
 /begin AXIS_DESCR COM_AXIS maf _CNV_A_R_LINEAR_____106_CM 6 0. 1389. FORMAT "%7.2" AXIS_PTS_REF ldp_maf__o2_int_max_at /end AXIS_DESCR
 /begin AXIS_DESCR COM_AXIS n_32 _CNV_A_R_LINEAR_____16_CM 6 0. 8160. FORMAT "%4.0" AXIS_PTS_REF ldp_n_32__o2_int_max_at /end AXIS_DESCR
/end CHARACTERISTIC
/begin CHARACTERISTIC id_o2_int_max_mt__n_32__maf "map-dependent max. admissible value for O2_CAT_INT_i " MAP 0x086fe _REC_MAP_20_u2_u2_u1 511.99218 _CNV_A_R_LINEAR_____386_CM 0. 511.99218 DISPLAY_IDENTIFIER ID_O2_INT_MAX_MT__N_32__MAF FORMAT "%7.3"
 /begin AXIS_DESCR COM_AXIS maf _CNV_A_R_LINEAR_____106_CM 6 0. 1389. FORMAT "%7.2" AXIS_PTS_REF ldp_maf__o2_int_max_mt /end AXIS_DESCR
 /begin AXIS_DESCR COM_AXIS n_32 _CNV_A_R_LINEAR_____16_CM 6 0. 8160. FORMAT "%4.0" AXIS_PTS_REF ldp_n_32__o2_int_max_mt /end AXIS_DESCR
/end CHARACTERISTIC
/begin CHARACTERISTIC ip_o2_cat_1__vls_down_1 "Characteristic curve for conversion of the sensor voltage into an oxygen characteristic quantity, bank 1" CURVE 0x00d4a _REC_CUR_20_u1_u2 0.99610001 _CNV_A_R_LINEAR_____29_CM 0. 0.99610001 DISPLAY_IDENTIFIER IP_O2_CAT_1__VLS_DOWN_1 FORMAT "%5.3"
 /begin AXIS_DESCR COM_AXIS online_dummy _CNV_A_R_LINEAR_____3_CM 6 0. 4.99511719 FORMAT "%5.3" AXIS_PTS_REF ldpm_vls_down /end AXIS_DESCR
/end CHARACTERISTIC
/begin CHARACTERISTIC ip_o2_cat_2__vls_down_2 "Characteristic curve for conversion of the sensor voltage into an oxygen characteristic quantity, bank 2" CURVE 0x00d50 _REC_CUR_20_u1_u2 0.99610001 _CNV_A_R_LINEAR_____29_CM 0. 0.99610001 DISPLAY_IDENTIFIER IP_O2_CAT_2__VLS_DOWN_2 FORMAT "%5.3"
 /begin AXIS_DESCR COM_AXIS online_dummy _CNV_A_R_LINEAR_____3_CM 6 0. 4.99511719 FORMAT "%5.3" AXIS_PTS_REF ldpm_vls_down /end AXIS_DESCR
/end CHARACTERISTIC
/begin CHARACTERISTIC ip_o2_cat_max__sum_vls_cat_o2 "admissible integral of O2 oscillation downstream of catalyst" CURVE 0x00d56 _REC_CUR_20_u1_u2 0.99610001 _CNV_A_R_LINEAR_____29_CM 0. 0.99610001 DISPLAY_IDENTIFIER IP_O2_CAT_MAX__SUM_VLS_CAT_O2 FORMAT "%5.3"
 /begin AXIS_DESCR COM_AXIS online_dummy _CNV_A_R_LINEAR_____387_CM 6 0. 4294967295. FORMAT "%11.0" AXIS_PTS_REF ldp_sum_vls_cat_o2 /end AXIS_DESCR
/end CHARACTERISTIC
/begin AXIS_PTS ldp_maf__o2_int_max_at "" 0x10bce maf _REC_AXS_20_u2 1389. _CNV_A_R_LINEAR_____106_CM 6 0. 1389. DISPLAY_IDENTIFIER LDP_MAF__O2_INT_MAX_AT FORMAT "%7.2" /end AXIS_PTS
/begin AXIS_PTS ldp_maf__o2_int_max_mt "" 0x10bdc maf _REC_AXS_20_u2 1389. _CNV_A_R_LINEAR_____106_CM 6 0. 1389. DISPLAY_IDENTIFIER LDP_MAF__O2_INT_MAX_MT FORMAT "%7.2" /end AXIS_PTS
/begin AXIS_PTS ldp_n_32__o2_int_max_mt "" 0x0103d n_32 _REC_AXS_20_u1 8160. _CNV_A_R_LINEAR_____16_CM 6 0. 8160. DISPLAY_IDENTIFIER LDP_N_32__O2_INT_MAX_MT FORMAT "%4.0" /end AXIS_PTS
/begin AXIS_PTS ldp_n_32__o2_int_max_at "" 0x01036 n_32 _REC_AXS_20_u1 8160. _CNV_A_R_LINEAR_____16_CM 6 0. 8160. DISPLAY_IDENTIFIER LDP_N_32__O2_INT_MAX_AT FORMAT "%4.0" /end AXIS_PTS
/begin AXIS_PTS ldp_sum_vls_cat_o2 "" 0x11148 online_dummy _REC_AXS_20_u2 4294967295. _CNV_A_R_LINEAR_____387_CM 6 0. 4294967295. DISPLAY_IDENTIFIER LDP_SUM_VLS_CAT_O2 FORMAT "%11.0" /end AXIS_PTS
/begin AXIS_PTS ldpm_vls_down "" 0x11cb8 online_dummy _REC_AXS_20_u2 4.99511719 _CNV_A_R_LINEAR_____3_CM 6 0. 4.99511719 DISPLAY_IDENTIFIER LDPM_VLS_DOWN FORMAT "%5.3" /end AXIS_PTS
/begin MEASUREMENT lv_err_cat_diag_1 "failure after filtering diagnosis value cat diag" UBYTE _CNV_S_2_RANGE______2_R_CM 1 100. 0. 255. DISPLAY_IDENTIFIER LV_ERR_CAT_DIAG_1 ECU_ADDRESS 0x3fbb4c /end MEASUREMENT
/begin MEASUREMENT lv_err_cat_diag_2 "failure after filtering diagnosis value cat diag" UBYTE _CNV_S_2_RANGE______2_R_CM 1 100. 0. 255. DISPLAY_IDENTIFIER LV_ERR_CAT_DIAG_2 ECU_ADDRESS 0x3fbb50 /end MEASUREMENT
/begin CHARACTERISTIC lc_inh_ls_up_man_deac "Manual deactivation of upstream oxygen sensor diagnosis" VALUE 0x00f3a _REC_VAL_20_u1 1. _CNV_A_R_LINEAR_____22_CM 0. 1. DISPLAY_IDENTIFIER LC_INH_LS_UP_MAN_DEAC FORMAT "%2.0" /end CHARACTERISTIC
/begin CHARACTERISTIC ip_t_vls_cyc_afl_max__n_32__maf "max. lean time interval for frequency monitoring" MAP 0x0eb42 _REC_MAP_20_u2_u1_u2 10.23 _CNV_A_R_LINEAR_____4_CM 0. 10.23 DISPLAY_IDENTIFIER IP_T_VLS_CYC_AFL_MAX__N_32__MAF FORMAT "%5.2"
 /begin AXIS_DESCR COM_AXIS n_32 _CNV_A_R_LINEAR_____16_CM 6 0. 8160. FORMAT "%4.0" AXIS_PTS_REF ldpm_n_32_1_t_vls_cyc /end AXIS_DESCR
 /begin AXIS_DESCR COM_AXIS maf _CNV_A_R_LINEAR_____106_CM 6 0. 1389. FORMAT "%7.2" AXIS_PTS_REF ldpm_maf_2_t_vls_cyc /end AXIS_DESCR
/end CHARACTERISTIC
/begin CHARACTERISTIC c_sum_cyc_min_diag "Min. total diagnostic cycles for frequency monitoring" VALUE 0x01794 _REC_VAL_20_u2 65535. _CNV_A_R_LINEAR_____1_CM 0. 65535. DISPLAY_IDENTIFIER C_SUM_CYC_MIN_DIAG FORMAT "%5.0" /end CHARACTERISTIC
/begin CHARACTERISTIC c_ratio_vls_cyc_afl_mv_max "max. limit for total ratio between measured and max. allowed lean time" VALUE 0x0176c _REC_VAL_20_u2 255.996094 _CNV_A_R_LINEAR_____123_CM 0. 255.996094 DISPLAY_IDENTIFIER C_RATIO_VLS_CYC_AFL_MV_MAX FORMAT "%7.3" /end CHARACTERISTIC
/begin CHARACTERISTIC c_ratio_vls_cyc_afr_mv_max "max. limit for total ratio between measured and max. allowed rich time" VALUE 0x0176e _REC_VAL_20_u2 255.996094 _CNV_A_R_LINEAR_____123_CM 0. 255.996094 DISPLAY_IDENTIFIER C_RATIO_VLS_CYC_AFR_MV_MAX FORMAT "%7.3" /end CHARACTERISTIC
/begin CHARACTERISTIC c_vls_cyc_dif_max "max. difference between lean and rich time ratio" VALUE 0x004d2 _REC_VAL_20_s2 511.9921875 _CNV_A_R_LINEAR_____115_CM -256. 255.9921875 DISPLAY_IDENTIFIER C_VLS_CYC_DIF_MAX FORMAT "%8.3" /end CHARACTERISTIC
/begin CHARACTERISTIC c_vls_cyc_dif_min "min. difference between lean and rich time ratio" VALUE 0x004d4 _REC_VAL_20_s2 511.9921875 _CNV_A_R_LINEAR_____115_CM -256. 255.9921875 DISPLAY_IDENTIFIER C_VLS_CYC_DIF_MIN FORMAT "%8.3" /end CHARACTERISTIC
/begin CHARACTERISTIC c_fac_t_lam_dly_ls_frq_diag "weighting factor for considering Adaptation value of downstream fuel trim" VALUE 0x006dc _REC_VAL_20_u1 0.99610001 _CNV_A_R_LINEAR_____29_CM 0. 0.99610001 DISPLAY_IDENTIFIER C_FAC_T_LAM_DLY_LS_FRQ_DIAG FORMAT "%5.3" /end CHARACTERISTIC
/begin CHARACTERISTIC ip_t_vls_cyc_afr_max__n_32__maf "max. rich time interval for frequency monitoring" MAP 0x0eb8a _REC_MAP_20_u2_u1_u2 10.23 _CNV_A_R_LINEAR_____4_CM 0. 10.23 DISPLAY_IDENTIFIER IP_T_VLS_CYC_AFR_MAX__N_32__MAF FORMAT "%5.2"
 /begin AXIS_DESCR COM_AXIS n_32 _CNV_A_R_LINEAR_____16_CM 6 0. 8160. FORMAT "%4.0" AXIS_PTS_REF ldpm_n_32_1_t_vls_cyc /end AXIS_DESCR
 /begin AXIS_DESCR COM_AXIS maf _CNV_A_R_LINEAR_____106_CM 6 0. 1389. FORMAT "%7.2" AXIS_PTS_REF ldpm_maf_2_t_vls_cyc /end AXIS_DESCR
/end CHARACTERISTIC
/begin CHARACTERISTIC c_vls_hys "max. allowed sensor output peak while switching" VALUE 0x01a22 _REC_VAL_20_u2 4.99511719 _CNV_A_R_LINEAR_____3_CM 0. 4.99511719 DISPLAY_IDENTIFIER C_VLS_HYS FORMAT "%5.3" /end CHARACTERISTIC
/begin CHARACTERISTIC c_sum_cycnr_min_diag "min. number diagnostic cycles for switching time monitoring" VALUE 0x01796 _REC_VAL_20_u2 65535. _CNV_A_R_LINEAR_____1_CM 0. 65535. DISPLAY_IDENTIFIER C_SUM_CYCNR_MIN_DIAG FORMAT "%5.0" /end CHARACTERISTIC
/begin CHARACTERISTIC c_ratio_vls_cycnr_afl_mv_max "limit for total ratio between measured and max. allowed switching times from rich to lean" VALUE 0x01770 _REC_VAL_20_u2 255.996094 _CNV_A_R_LINEAR_____123_CM 0. 255.996094 DISPLAY_IDENTIFIER C_RATIO_VLS_CYCNR_AFL_MV_MAX FORMAT "%7.3" /end CHARACTERISTIC
/begin CHARACTERISTIC c_ratio_vls_cycnr_afr_mv_max "max. limit for total ratio between measured and max. allowed switching times from lean to rich" VALUE 0x01772 _REC_VAL_20_u2 255.996094 _CNV_A_R_LINEAR_____123_CM 0. 255.996094 DISPLAY_IDENTIFIER C_RATIO_VLS_CYCNR_AFR_MV_MAX FORMAT "%7.3" /end CHARACTERISTIC
/begin CHARACTERISTIC c_ratio_vls_cycnr_dif_max "max. difference between lean and rich switching times ratio" VALUE 0x00452 _REC_VAL_20_s2 511.9921875 _CNV_A_R_LINEAR_____115_CM -256. 255.9921875 DISPLAY_IDENTIFIER C_RATIO_VLS_CYCNR_DIF_MAX FORMAT "%8.3" /end CHARACTERISTIC
/begin CHARACTERISTIC c_ratio_vls_cycnr_dif_min "min. difference between lean and rich switching times ratio" VALUE 0x00454 _REC_VAL_20_s2 511.9921875 _CNV_A_R_LINEAR_____115_CM -256. 255.9921875 DISPLAY_IDENTIFIER C_RATIO_VLS_CYCNR_DIF_MIN FORMAT "%8.3" /end CHARACTERISTIC
/begin CHARACTERISTIC id_t_vls_cycnr_afr_max "max. time interval for switching time monitoring (lean to rich)" CURVE 0x00a08 _REC_CUR_20_u1_u2 2.55 _CNV_A_R_LINEAR_____4_CM 0. 2.55 DISPLAY_IDENTIFIER ID_T_VLS_CYCNR_AFR_MAX FORMAT "%4.2"
 /begin AXIS_DESCR COM_AXIS maf_kgh _CNV_A_R_LINEAR_____113_CM 6 0. 2047.96875 FORMAT "%7.2" AXIS_PTS_REF ldpm_maf_kgh_1_t_vls_cycnr /end AXIS_DESCR
/end CHARACTERISTIC
/begin CHARACTERISTIC id_t_vls_cycnr_afl_max "max. time interval for switching time monitoring (rich to lean)" CURVE 0x00a02 _REC_CUR_20_u1_u2 2.55 _CNV_A_R_LINEAR_____4_CM 0. 2.55 DISPLAY_IDENTIFIER ID_T_VLS_CYCNR_AFL_MAX FORMAT "%4.2"
 /begin AXIS_DESCR COM_AXIS maf_kgh _CNV_A_R_LINEAR_____113_CM 6 0. 2047.96875 FORMAT "%7.2" AXIS_PTS_REF ldpm_maf_kgh_1_t_vls_cycnr /end AXIS_DESCR
/end CHARACTERISTIC
/begin AXIS_PTS ldpm_maf_kgh_1_t_vls_cycnr "" 0x117c8 maf_kgh _REC_AXS_20_u2 2047.96875 _CNV_A_R_LINEAR_____113_CM 6 0. 2047.96875 DISPLAY_IDENTIFIER LDPM_MAF_KGH_1_T_VLS_CYCNR FORMAT "%7.2" /end AXIS_PTS
/begin AXIS_PTS ldpm_n_32_1_t_vls_cyc "" 0x01329 n_32 _REC_AXS_20_u1 8160. _CNV_A_R_LINEAR_____16_CM 6 0. 8160. DISPLAY_IDENTIFIER LDPM_N_32_1_T_VLS_CYC FORMAT "%4.0" /end AXIS_PTS
/begin AXIS_PTS ldpm_maf_2_t_vls_cyc "" 0x11714 maf _REC_AXS_20_u2 1389. _CNV_A_R_LINEAR_____106_CM 6 0. 1389. DISPLAY_IDENTIFIER LDPM_MAF_2_T_VLS_CYC FORMAT "%7.2" /end AXIS_PTS
/begin CHARACTERISTIC lc_inh_ls_down_man_deac "Manual deactivation of downstream oxygen sensor diagnosis" VALUE 0x00f39 _REC_VAL_20_u1 1. _CNV_A_R_LINEAR_____22_CM 0. 1. DISPLAY_IDENTIFIER LC_INH_LS_DOWN_MAN_DEAC FORMAT "%2.0" /end CHARACTERISTIC
/begin CHARACTERISTIC c_vls_down_hys "Monitor sensor voltage hysteresis" VALUE 0x01a0c _REC_VAL_20_u2 4.99511719 _CNV_A_R_LINEAR_____3_CM 0. 4.99511719 DISPLAY_IDENTIFIER C_VLS_DOWN_HYS FORMAT "%5.3" /end CHARACTERISTIC
/begin CHARACTERISTIC ip_vls_down_max_cycnr "Weighting factor for CYCNR_VLS_DOWN_ACT_i" CURVE 0x00ea8 _REC_CUR_20_u1_u2 5100. _CNV_A_R_LINEAR_____290_CM 0. 5100. DISPLAY_IDENTIFIER IP_VLS_DOWN_MAX_CYCNR FORMAT "%5.0"
 /begin AXIS_DESCR COM_AXIS maf_kgh _CNV_A_R_LINEAR_____113_CM 8 0. 2047.96875 FORMAT "%7.2" AXIS_PTS_REF ldp_maf_kgh__vls_down_max_cycnr /end AXIS_DESCR
/end CHARACTERISTIC
/begin CHARACTERISTIC c_cycnr_vls_down_max "Diagnostic threshold for VLS_DOWN_CYCNR_i" VALUE 0x0067a _REC_VAL_20_u1 1.99220002 _CNV_A_R_LINEAR_____39_CM 0. 1.99220002 DISPLAY_IDENTIFIER C_CYCNR_VLS_DOWN_MAX FORMAT "%5.3" /end CHARACTERISTIC
/begin MEASUREMENT maf_kgh_min_puc "minimum value of MAF_KGH while switching time calculation" UWORD _CNV_A_R_LINEAR_____113_CM 1 100. 0. 2047.96875 DISPLAY_IDENTIFIER MAF_KGH_MIN_PUC ECU_ADDRESS 0x3fd720 BYTE_ORDER MSB_LAST FORMAT "%7.2" /end MEASUREMENT
/begin MEASUREMENT maf_int_pue "sucked air mass after leaving PUC" UWORD _CNV_A_R_LINEAR_____271_CM 1 100. 0. 1820.398 DISPLAY_IDENTIFIER MAF_INT_PUE ECU_ADDRESS 0x3fd0ac BYTE_ORDER MSB_LAST FORMAT "%7.2" /end MEASUREMENT
/begin MEASUREMENT lv_req_diag_ls_down "Logical variable" UBYTE _CNV_S_2_RANGE______0_CM 1 100. 0. 1. DISPLAY_IDENTIFIER LV_REQ_DIAG_LS_DOWN ECU_ADDRESS 0x3fe4dd BIT_MASK 0x1 /end MEASUREMENT
/begin MEASUREMENT lv_end_diag_ls_down "Logical variable" UBYTE _CNV_S_2_RANGE______0_CM 1 100. 0. 1. DISPLAY_IDENTIFIER LV_END_DIAG_LS_DOWN ECU_ADDRESS 0x3fe4de BIT_MASK 0x1 /end MEASUREMENT
/begin AXIS_PTS ldp_maf_kgh__vls_down_max_cycnr "" 0x10cf8 maf_kgh _REC_AXS_20_u2 2047.96875 _CNV_A_R_LINEAR_____113_CM 8 0. 2047.96875 DISPLAY_IDENTIFIER LDP_MAF_KGH__VLS_DOWN_MAX_CYCNR FORMAT "%7.2" /end AXIS_PTS
/begin MEASUREMENT lv_err_sa_sap "Present failure: Minimum secondary air flow rate failure after filtering" UBYTE _CNV_S_2_RANGE______2_R_CM 1 100. 0. 255. DISPLAY_IDENTIFIER LV_ERR_SA_SAP ECU_ADDRESS 0x3fba2c /end MEASUREMENT
/begin MEASUREMENT lv_err_sa_sav "Present failure: Mechanical jammed SAV after filtering" UBYTE _CNV_S_2_RANGE______2_R_CM 1 100. 0. 255. DISPLAY_IDENTIFIER LV_ERR_SA_SAV ECU_ADDRESS 0x3fba34 /end MEASUREMENT
/begin CHARACTERISTIC c_tco_min_ls_down "Minimum coolant temperature for diagnosis of the monitor sensors" VALUE 0x0088a _REC_VAL_20_u1 190.5 _CNV_A_R_LINEAR_____12_CM -48. 142.5 DISPLAY_IDENTIFIER C_TCO_MIN_LS_DOWN FORMAT "%5.1" /end CHARACTERISTIC
/begin CHARACTERISTIC c_vs_max_ls_down "Maximum vehicle speed for diagnosis of the monitor sensors" VALUE 0x00951 _REC_VAL_20_u1 255. _CNV_A_R_LINEAR_____23_CM 0. 255. DISPLAY_IDENTIFIER C_VS_MAX_LS_DOWN FORMAT "%3.0" /end CHARACTERISTIC
/begin CHARACTERISTIC c_vs_min_ls_down "Minimum vehicle speed for diagnosis of the monitor sensors" VALUE 0x0095a _REC_VAL_20_u1 255. _CNV_A_R_LINEAR_____23_CM 0. 255. DISPLAY_IDENTIFIER C_VS_MIN_LS_DOWN FORMAT "%3.0" /end CHARACTERISTIC
/begin CHARACTERISTIC c_temp_cat_min_ls_down "Catalyst temperature threshold for diagnosis of the monitor sensors" VALUE 0x008b4 _REC_VAL_20_u1 1020. _CNV_A_R_LINEAR_____177_CM -33. 987. DISPLAY_IDENTIFIER C_TEMP_CAT_MIN_LS_DOWN FORMAT "%3.0" /end CHARACTERISTIC
/begin CHARACTERISTIC c_maf_kgh_max_puc_ls_down "Mass air flow threshold for diagnosis of the switching times" VALUE 0x0168e _REC_VAL_20_u2 2047.96875 _CNV_A_R_LINEAR_____113_CM 0. 2047.96875 DISPLAY_IDENTIFIER C_MAF_KGH_MAX_PUC_LS_DOWN FORMAT "%7.2" /end CHARACTERISTIC
/begin CHARACTERISTIC c_maf_kgh_min_puc_ls_down "Mass air flow threshold for diagnosis of the switching times" VALUE 0x01690 _REC_VAL_20_u2 2047.96875 _CNV_A_R_LINEAR_____113_CM 0. 2047.96875 DISPLAY_IDENTIFIER C_MAF_KGH_MIN_PUC_LS_DOWN FORMAT "%7.2" /end CHARACTERISTIC
/begin CHARACTERISTIC c_vls_down_min_puc_diag "Voltage threshold for monitor sensor diagnosis" VALUE 0x01a18 _REC_VAL_20_u2 4.99511719 _CNV_A_R_LINEAR_____3_CM 0. 4.99511719 DISPLAY_IDENTIFIER C_VLS_DOWN_MIN_PUC_DIAG FORMAT "%5.3" /end CHARACTERISTIC
/begin CHARACTERISTIC c_fac_vls_down_max_diag "Reduction factor for start of switching time determination" VALUE 0x006e4 _REC_VAL_20_u1 0.9960940000000002 _CNV_A_R_LINEAR_____50_CM 0. 0.996094 DISPLAY_IDENTIFIER C_FAC_VLS_DOWN_MAX_DIAG FORMAT "%5.3" /end CHARACTERISTIC
/begin CHARACTERISTIC c_fac_vls_down_min_diag "Reduction factor for end of switching time determination" VALUE 0x006e5 _REC_VAL_20_u1 0.9960940000000002 _CNV_A_R_LINEAR_____50_CM 0. 0.996094 DISPLAY_IDENTIFIER C_FAC_VLS_DOWN_MIN_DIAG FORMAT "%5.3" /end CHARACTERISTIC
/begin CHARACTERISTIC c_sum_min_vls_down_diag "Condition for the start of the lambda sensor switching time check" VALUE 0x007ce _REC_VAL_20_u1 254. _CNV_A_R_LINEAR_____1_CM 1. 255. DISPLAY_IDENTIFIER C_SUM_MIN_VLS_DOWN_DIAG FORMAT "%3.0" /end CHARACTERISTIC
/begin CHARACTERISTIC c_maf_int_puc_ls_down_pue "Threshold for start of the diagnosis" VALUE 0x01674 _REC_VAL_20_u2 1820.398 _CNV_A_R_LINEAR_____271_CM 0. 1820.398 DISPLAY_IDENTIFIER C_MAF_INT_PUC_LS_DOWN_PUE FORMAT "%7.2" /end CHARACTERISTIC
/begin CHARACTERISTIC c_maf_int_ls_down_pue "Threshold for start of the diagnosis" VALUE 0x0165e _REC_VAL_20_u2 1820.398 _CNV_A_R_LINEAR_____271_CM 0. 1820.398 DISPLAY_IDENTIFIER C_MAF_INT_LS_DOWN_PUE FORMAT "%7.2" /end CHARACTERISTIC
/begin CHARACTERISTIC c_ctr_min_end_diag_ls_down_pue "Time counter threshold for CTR_END_DIAG_VLS_DOWN_PUE_i" VALUE 0x014fa _REC_VAL_20_u2 65534. _CNV_A_R_LINEAR_____1_CM 1. 65535. DISPLAY_IDENTIFIER C_CTR_MIN_END_DIAG_LS_DOWN_PUE FORMAT "%5.0" /end CHARACTERISTIC
/begin CHARACTERISTIC c_ctr_inc_ls_down_pue "Counter increment for VLS_DOWN_PUE diagnosis" VALUE 0x0066e _REC_VAL_20_u1 255. _CNV_A_R_LINEAR_____1_CM 0. 255. DISPLAY_IDENTIFIER C_CTR_INC_LS_DOWN_PUE FORMAT "%3.0" /end CHARACTERISTIC
/begin CHARACTERISTIC c_ctr_max_ls_down_pue "Max value of counter for VLS_DOWN_PUE diagnosis" VALUE 0x0066f _REC_VAL_20_u1 255. _CNV_A_R_LINEAR_____1_CM 0. 255. DISPLAY_IDENTIFIER C_CTR_MAX_LS_DOWN_PUE FORMAT "%3.0" /end CHARACTERISTIC
/begin CHARACTERISTIC c_vls_down_dif_min_diag "Threshold for VLS_DOWN_DIF_DIAG" VALUE 0x01a0a _REC_VAL_20_u2 4.99511719 _CNV_A_R_LINEAR_____3_CM 0. 4.99511719 DISPLAY_IDENTIFIER C_VLS_DOWN_DIF_MIN_DIAG FORMAT "%5.3" /end CHARACTERISTIC
/begin MEASUREMENT lv_err_ls_down_pue_1 "debounded diagnosis result of pull end plausibility" UBYTE _CNV_S_2_RANGE______2_R_CM 1 100. 0. 255. DISPLAY_IDENTIFIER LV_ERR_LS_DOWN_PUE_1 ECU_ADDRESS 0x3fba54 /end MEASUREMENT
/begin MEASUREMENT lv_err_ls_down_pue_2 "debounded diagnosis result of pull end plausibility" UBYTE _CNV_S_2_RANGE______2_R_CM 1 100. 0. 255. DISPLAY_IDENTIFIER LV_ERR_LS_DOWN_PUE_2 ECU_ADDRESS 0x3fba58 /end MEASUREMENT
/begin MEASUREMENT lv_err_ls_down_swt_1 "error bit for switchtime diagnosis" UBYTE _CNV_S_2_RANGE______2_R_CM 1 100. 0. 255. DISPLAY_IDENTIFIER LV_ERR_LS_DOWN_SWT_1 ECU_ADDRESS 0x3fba4c /end MEASUREMENT
/begin MEASUREMENT lv_err_ls_down_swt_2 "error bit for switchtime diagnosis" UBYTE _CNV_S_2_RANGE______2_R_CM 1 100. 0. 255. DISPLAY_IDENTIFIER LV_ERR_LS_DOWN_SWT_2 ECU_ADDRESS 0x3fba50 /end MEASUREMENT
/begin CHARACTERISTIC c_pwm_min_obd2_lsh_up "Minimum permitted heater effective voltage PWM for upstream LSH OBDII diagnosis " VALUE 0x007b6 _REC_VAL_20_u1 99.609375 _CNV_A_R_LINEAR_____10_CM 0. 99.609375 DISPLAY_IDENTIFIER C_PWM_MIN_OBD2_LSH_UP FORMAT "%4.1" /end CHARACTERISTIC
/begin CHARACTERISTIC c_pwm_max_obd2_lsh_up "Maximum permitted heater effective voltage PWM for upstream LSH OBDII diagnosis " VALUE 0x007b4 _REC_VAL_20_u1 99.609375 _CNV_A_R_LINEAR_____10_CM 0. 99.609375 DISPLAY_IDENTIFIER C_PWM_MAX_OBD2_LSH_UP FORMAT "%4.1" /end CHARACTERISTIC
/begin CHARACTERISTIC c_t_dly_obd2_lsh_up "Minimum delay prior to checking status of OBDI heater / signal faults" VALUE 0x00805 _REC_VAL_20_u1 255. _CNV_A_R_LINEAR_____30_CM 0. 255. DISPLAY_IDENTIFIER C_T_DLY_OBD2_LSH_UP FORMAT "%3.0" /end CHARACTERISTIC
/begin CHARACTERISTIC c_temp_min_obd2_lsh_up "Temperature threshold under which upstream LSH OBDII diagnosis activated" VALUE 0x01906 _REC_VAL_20_u2 2047. _CNV_A_R_LINEAR_____7_CM 0. 2047. DISPLAY_IDENTIFIER C_TEMP_MIN_OBD2_LSH_UP FORMAT "%7.2" /end CHARACTERISTIC
/begin CHARACTERISTIC c_temp_set_obd2_lsh_up "Set temperature for upstream LSH operation used to generate power integral" VALUE 0x0190a _REC_VAL_20_u2 2047. _CNV_A_R_LINEAR_____7_CM 0. 2047. DISPLAY_IDENTIFIER C_TEMP_SET_OBD2_LSH_UP FORMAT "%7.2" /end CHARACTERISTIC
/begin CHARACTERISTIC c_egy_min_obd2_lsh_up "Measure of minimum required cooling energy required at upstream sensor prior to checking Ri threshold" VALUE 0x01544 _REC_VAL_20_u2 65535. _CNV_A_R_LINEAR_____291_CM 0. 65535. DISPLAY_IDENTIFIER C_EGY_MIN_OBD2_LSH_UP FORMAT "%5.0" /end CHARACTERISTIC
/begin CHARACTERISTIC c_tcc_obd2_lsh_up "Number of valid upstream LSH OBDII diagnosis cycles over which statistic evaluation to be carried out" VALUE 0x018ca _REC_VAL_20_u2 1023. _CNV_A_R_LINEAR_____22_CM 0. 1023. DISPLAY_IDENTIFIER C_TCC_OBD2_LSH_UP FORMAT "%4.0" /end CHARACTERISTIC
/begin CHARACTERISTIC c_frc_obd2_lsh_up "Fault detection threshold, when exceeded, heater is determined to be defective during driving cycle" VALUE 0x015c8 _REC_VAL_20_u2 1023. _CNV_A_R_LINEAR_____22_CM 0. 1023. DISPLAY_IDENTIFIER C_FRC_OBD2_LSH_UP FORMAT "%4.0" /end CHARACTERISTIC
/begin CHARACTERISTIC ip_r_thd_obd2_lsh_up "Internal resistence threshold, when exceeded, heater is determinated to be defective for current diagnosis cycle; including reference to modelled value for a new sensor" CURVE 0x01b2c _REC_CUR_20_u2_u2 65535. _CNV_A_R_LINEAR_____279_CM 0. 65535. DISPLAY_IDENTIFIER IP_R_THD_OBD2_LSH_UP FORMAT "%5.0"
 /begin AXIS_DESCR COM_AXIS online_dummy _CNV_A_R_LINEAR_____279_CM 4 0. 65535. FORMAT "%5.0" AXIS_PTS_REF ldp_r_up_mdl_sens_new_r_thd /end AXIS_DESCR
/end CHARACTERISTIC
/begin AXIS_PTS ldp_r_up_mdl_sens_new_r_thd "" 0x11134 online_dummy _REC_AXS_20_u2 65535. _CNV_A_R_LINEAR_____279_CM 4 0. 65535. DISPLAY_IDENTIFIER LDP_R_UP_MDL_SENS_NEW_R_THD FORMAT "%5.0" /end AXIS_PTS
/begin AXIS_PTS ldp_maf_kgh__fac_maf_lsh_up "" 0x10ce0 maf_kgh _REC_AXS_20_u2 2047.96875 _CNV_A_R_LINEAR_____113_CM 6 0. 2047.96875 DISPLAY_IDENTIFIER LDP_MAF_KGH__FAC_MAF_LSH_UP FORMAT "%7.2" /end AXIS_PTS
/begin CHARACTERISTIC ip_fac_maf_lsh_up "Factor reflecting forced convection influence of cooling area, gas velocity and heat transfer coefficient" CURVE 0x00b42 _REC_CUR_20_u1_u2 15.9375 _CNV_A_R_LINEAR_____46_CM 0. 15.9375 DISPLAY_IDENTIFIER IP_FAC_MAF_LSH_UP FORMAT "%5.2"
 /begin AXIS_DESCR COM_AXIS maf_kgh _CNV_A_R_LINEAR_____113_CM 6 0. 2047.96875 FORMAT "%7.2" AXIS_PTS_REF ldp_maf_kgh__fac_maf_lsh_up /end AXIS_DESCR
/end CHARACTERISTIC
/begin CHARACTERISTIC ip_fac_teg_cat_up_mdl "Internal resistance threshold, when exceeded, heater is determined to be defective for current diagnosis cycle, including reference to modelled value for new sensor" CURVE 0x00baa _REC_CUR_20_u1_u2 127.5 _CNV_A_R_LINEAR_____388_CM 0. 127.5 DISPLAY_IDENTIFIER IP_FAC_TEG_CAT_UP_MDL FORMAT "%5.1"
 /begin AXIS_DESCR COM_AXIS online_dummy _CNV_A_R_LINEAR_____7_CM 8 0. 2047. FORMAT "%7.2" AXIS_PTS_REF ldp_ttip_ref_ls_up_ip_fac_teg /end AXIS_DESCR
/end CHARACTERISTIC
/begin AXIS_PTS ldp_ttip_ref_ls_up_ip_fac_teg "" 0x11416 online_dummy _REC_AXS_20_u2 2047. _CNV_A_R_LINEAR_____7_CM 8 0. 2047. DISPLAY_IDENTIFIER LDP_TTIP_REF_LS_UP_IP_FAC_TEG FORMAT "%7.2" /end AXIS_PTS
/begin MEASUREMENT sum_afl_vls_diag_sa_2 "Lean indication counter cylinder group 2" UWORD _CNV_A_R_LINEAR_____1_CM 1 100. 0. 65535. DISPLAY_IDENTIFIER SUM_AFL_VLS_DIAG_SA_2 ECU_ADDRESS 0x3fd240 BYTE_ORDER MSB_LAST FORMAT "%5.0" /end MEASUREMENT
/begin MEASUREMENT t_dly_diag_sa "Time delay after secondary air activation to start the SA monitoring" UWORD _CNV_A_R_LINEAR_____401_CM 1 100. 0. 655.3200000000001 DISPLAY_IDENTIFIER T_DLY_DIAG_SA ECU_ADDRESS 0x3fd242 BYTE_ORDER MSB_LAST FORMAT "%6.2" /end MEASUREMENT
/begin MEASUREMENT t_diag_sa "Timer for duration of Minimum air flow monitoring" UWORD _CNV_A_R_LINEAR_____401_CM 1 100. 0. 655.3200000000001 DISPLAY_IDENTIFIER T_DIAG_SA ECU_ADDRESS 0x3fd238 BYTE_ORDER MSB_LAST FORMAT "%6.2" /end MEASUREMENT
/begin MEASUREMENT lam_diag_sav_max "Maximum LAM-value during SAV check with LAM threshold exceed" SWORD _CNV_A_R_LINEAR_____109_CM 1 100. -50. 49.99847412 DISPLAY_IDENTIFIER LAM_DIAG_SAV_MAX ECU_ADDRESS 0x3fd250 BYTE_ORDER MSB_LAST FORMAT "%7.3" /end MEASUREMENT
/begin CHARACTERISTIC id_t_dly_diag_sa "Time after START  to start the SA diagnosis" CURVE 0x089bc _REC_CUR_20_u2_u1 654.99 _CNV_A_R_LINEAR_____402_CM 1.e-002 655. DISPLAY_IDENTIFIER ID_T_DLY_DIAG_SA FORMAT "%7.3"
 /begin AXIS_DESCR COM_AXIS tco_st _CNV_A_R_LINEAR_____12_CM 8 -48. 142.5 FORMAT "%5.1" AXIS_PTS_REF ldp_tco_st_id_t_dly_diag_sa /end AXIS_DESCR
/end CHARACTERISTIC
/begin CHARACTERISTIC c_sum_afl_vls_min_diag_sa "Lean indication threshold for Monitoring of minimum flow rate" VALUE 0x01792 _REC_VAL_20_u2 65535. _CNV_A_R_LINEAR_____1_CM 0. 65535. DISPLAY_IDENTIFIER C_SUM_AFL_VLS_MIN_DIAG_SA FORMAT "%5.0" /end CHARACTERISTIC
/begin CHARACTERISTIC c_t_diag_sa "Maximum duration for Monitoring of minimum flow rate" VALUE 0x017da _REC_VAL_20_u2 655.3200000000001 _CNV_A_R_LINEAR_____401_CM 0. 655.3200000000001 DISPLAY_IDENTIFIER C_T_DIAG_SA FORMAT "%6.2" /end CHARACTERISTIC
/begin CHARACTERISTIC c_conf_diag_sav "Configuration byte for activation of the SAV diagnosis" VALUE 0x0060a _REC_VAL_20_u1 10. _CNV_S_7_RANGE_C_CO_403_CM 0. 10. DISPLAY_IDENTIFIER C_CONF_DIAG_SAV /end CHARACTERISTIC
/begin AXIS_PTS ldp_tco_st_id_t_dly_diag_sa "" 0x07e27 tco_st _REC_AXS_20_u1 190.5 _CNV_A_R_LINEAR_____12_CM 8 -48. 142.5 DISPLAY_IDENTIFIER LDP_TCO_ST_ID_T_DLY_DIAG_SA FORMAT "%5.1" /end AXIS_PTS
/begin MEASUREMENT t_dly_intr_diag_sa "Time delay after secair interrupt to continue the SA monitoring" UBYTE _CNV_A_R_LINEAR_____24_CM 1 100. 0. 25.5 DISPLAY_IDENTIFIER T_DLY_INTR_DIAG_SA ECU_ADDRESS 0x3fe0db FORMAT "%4.1" /end MEASUREMENT
/begin CHARACTERISTIC c_t_dly_intr_diag_sa "Time delay after leaving the STATE_SA = INTERRUPT to continue the SA monitoring" VALUE 0x007f7 _REC_VAL_20_u1 25.5 _CNV_A_R_LINEAR_____24_CM 0. 25.5 DISPLAY_IDENTIFIER C_T_DLY_INTR_DIAG_SA FORMAT "%4.1" /end CHARACTERISTIC
/begin MEASUREMENT sum_afl_vls_diag_sa_1 "Lean indication counter cylinder group 1" UWORD _CNV_A_R_LINEAR_____1_CM 1 100. 0. 65535. DISPLAY_IDENTIFIER SUM_AFL_VLS_DIAG_SA_1 ECU_ADDRESS 0x3fd23e BYTE_ORDER MSB_LAST FORMAT "%5.0" /end MEASUREMENT
/begin MEASUREMENT sum_afl_vls_diag_sa_1_sae "Lean indication counter cylinder group 1 for the mode 6" UWORD _CNV_A_R_LINEAR_____1_CM 1 100. 0. 65535. DISPLAY_IDENTIFIER SUM_AFL_VLS_DIAG_SA_1_SAE ECU_ADDRESS 0x3fd23a BYTE_ORDER MSB_LAST FORMAT "%5.0" /end MEASUREMENT
/begin MEASUREMENT sum_afl_vls_diag_sa_2_sae "Lean indication counter cylinder group 2 for the mode 6" UWORD _CNV_A_R_LINEAR_____1_CM 1 100. 0. 65535. DISPLAY_IDENTIFIER SUM_AFL_VLS_DIAG_SA_2_SAE ECU_ADDRESS 0x3fd23c BYTE_ORDER MSB_LAST FORMAT "%5.0" /end MEASUREMENT
/begin CHARACTERISTIC c_ctr_p_diag_sa_sav "Nr. of P-jumps (lambda period = 2 \"P\" -jumps) for the SAV-diagnosis" VALUE 0x014fe _REC_VAL_20_u2 65535. _CNV_A_R_LINEAR_____1_CM 0. 65535. DISPLAY_IDENTIFIER C_CTR_P_DIAG_SA_SAV FORMAT "%5.0" /end CHARACTERISTIC
/begin CHARACTERISTIC c_lam_thd_diag_sav "LAM-threshold for SAV diagnosis" VALUE 0x015fc _REC_VAL_20_u2 49.99850082 _CNV_A_R_LINEAR_____405_CM 0. 49.99850082 DISPLAY_IDENTIFIER C_LAM_THD_DIAG_SAV FORMAT "%7.3" /end CHARACTERISTIC
/begin CHARACTERISTIC c_ctr_p_diag_sa_sap "Nr. of P-jumps (lambda period = 2 \"P\" -jumps) to  weighten diagnosis results with exceed of the LAM-threshold  " VALUE 0x014fc _REC_VAL_20_u2 65535. _CNV_A_R_LINEAR_____1_CM 0. 65535. DISPLAY_IDENTIFIER C_CTR_P_DIAG_SA_SAP FORMAT "%5.0" /end CHARACTERISTIC
/begin MEASUREMENT lam_mv_diag_sav "Mean LAM-value during SAV check with active lambda control" SWORD _CNV_A_R_LINEAR_____109_CM 1 100. -50. 49.99847412 DISPLAY_IDENTIFIER LAM_MV_DIAG_SAV ECU_ADDRESS 0x3fd252 BYTE_ORDER MSB_LAST FORMAT "%7.3" /end MEASUREMENT
/begin MEASUREMENT ctr_p_diag_sa_sap_2 "actual P-jumps Bank2 (lambda period = 2 \"P\"-jumps) for the SAP diagnosis" UWORD _CNV_A_R_LINEAR_____1_CM 1 100. 0. 65535. DISPLAY_IDENTIFIER CTR_P_DIAG_SA_SAP_2 ECU_ADDRESS 0x3fd25a BYTE_ORDER MSB_LAST FORMAT "%5.0" /end MEASUREMENT
/begin MEASUREMENT ctr_p_diag_sa_sap_1 "actual P-jumps Bank1 (lambda period = 2 \"P\"-jumps) for the SAP diagnosis" UWORD _CNV_A_R_LINEAR_____1_CM 1 100. 0. 65535. DISPLAY_IDENTIFIER CTR_P_DIAG_SA_SAP_1 ECU_ADDRESS 0x3fd24a BYTE_ORDER MSB_LAST FORMAT "%5.0" /end MEASUREMENT
/begin MEASUREMENT ctr_p_diag_sa_sav "actual P-jumps Bank1 (lambda period = 2 \"P\"-jumps) for the SAV diagnosis" UWORD _CNV_A_R_LINEAR_____1_CM 1 100. 0. 65535. DISPLAY_IDENTIFIER CTR_P_DIAG_SA_SAV ECU_ADDRESS 0x3fd248 BYTE_ORDER MSB_LAST FORMAT "%5.0" /end MEASUREMENT
/begin CHARACTERISTIC ip_n_32_min_diag_sa "Minimum speed to start the SA diagnosis" CURVE 0x00cfb _REC_CUR_20_u1_u2 8160. _CNV_A_R_LINEAR_____16_CM 0. 8160. DISPLAY_IDENTIFIER IP_N_32_MIN_DIAG_SA FORMAT "%4.0"
 /begin AXIS_DESCR COM_AXIS fac_amp _CNV_A_R_LINEAR_____21_CM 6 0. 1.99996948 FORMAT "%7.5" AXIS_PTS_REF ldpm_fac_amp /end AXIS_DESCR
/end CHARACTERISTIC
/begin CHARACTERISTIC ip_maf_kgh_max_diag_sa "Maximum load [kg/h] for break-off the SA diagnosis" CURVE 0x0c66e _REC_CUR_20_u2_u2 2047.96875 _CNV_A_R_LINEAR_____113_CM 0. 2047.96875 DISPLAY_IDENTIFIER IP_MAF_KGH_MAX_DIAG_SA FORMAT "%7.2"
 /begin AXIS_DESCR COM_AXIS fac_amp _CNV_A_R_LINEAR_____21_CM 6 0. 1.99996948 FORMAT "%7.5" AXIS_PTS_REF ldpm_fac_amp /end AXIS_DESCR
/end CHARACTERISTIC
/begin CHARACTERISTIC ip_maf_max_diag_sa "Maximum load [mg/str] for break-off the SA diagnosis" CURVE 0x00cab _REC_CUR_20_u1_u1 1389. _CNV_A_R_LINEAR_____27_CM 0. 1389. DISPLAY_IDENTIFIER IP_MAF_MAX_DIAG_SA FORMAT "%4.0"
 /begin AXIS_DESCR COM_AXIS n_32 _CNV_A_R_LINEAR_____16_CM 8 0. 8160. FORMAT "%4.0" AXIS_PTS_REF ldp_n_32__maf_max_diag_sa /end AXIS_DESCR
/end CHARACTERISTIC
/begin CHARACTERISTIC c_ti_add_wf_max_diag_sa "Maximum TI_ADD_WF threshold to start the SA diagnosis" VALUE 0x00464 _REC_VAL_20_s2 262.14 _CNV_A_R_LINEAR_____198_CM -131.072 131.068 DISPLAY_IDENTIFIER C_TI_ADD_WF_MAX_DIAG_SA FORMAT "%8.3" /end CHARACTERISTIC
/begin CHARACTERISTIC c_ti_add_wf_min_diag_sa "Minimum TI_ADD_WF threshold to start the SA diagnosis" VALUE 0x00466 _REC_VAL_20_s2 262.14 _CNV_A_R_LINEAR_____198_CM -131.072 131.068 DISPLAY_IDENTIFIER C_TI_ADD_WF_MIN_DIAG_SA FORMAT "%8.3" /end CHARACTERISTIC
/begin CHARACTERISTIC lc_inh_sa_man_deac "Manual deactivation of SA diagnosis inhibition conditions" VALUE 0x00f41 _REC_VAL_20_u1 1. _CNV_A_R_LINEAR_____1_CM 0. 1. DISPLAY_IDENTIFIER LC_INH_SA_MAN_DEAC FORMAT "%2.0" /end CHARACTERISTIC
/begin CHARACTERISTIC id_tco_min_diag_sa "Minimum load [mg/str] to start the SA diagnosis" CURVE 0x00a1a _REC_CUR_20_u1_u1 190.5 _CNV_A_R_LINEAR_____12_CM -48. 142.5 DISPLAY_IDENTIFIER ID_TCO_MIN_DIAG_SA FORMAT "%5.1"
 /begin AXIS_DESCR COM_AXIS tia _CNV_A_R_LINEAR_____12_CM 6 -48. 142.5 FORMAT "%5.1" AXIS_PTS_REF ldp_tia_id_tco_min_diag_sa /end AXIS_DESCR
/end CHARACTERISTIC
/begin CHARACTERISTIC ip_maf_min_diag_sa "Minimum load [mg/str] to start the SA diagnosis" CURVE 0x00cd1 _REC_CUR_20_u1_u2 1389. _CNV_A_R_LINEAR_____27_CM 0. 1389. DISPLAY_IDENTIFIER IP_MAF_MIN_DIAG_SA FORMAT "%4.0"
 /begin AXIS_DESCR COM_AXIS fac_amp _CNV_A_R_LINEAR_____21_CM 6 0. 1.99996948 FORMAT "%7.5" AXIS_PTS_REF ldpm_fac_amp /end AXIS_DESCR
/end CHARACTERISTIC
/begin CHARACTERISTIC c_n_32_max_diag_sa "Maximum speed to start the SA diagnosis" VALUE 0x00752 _REC_VAL_20_u1 8160. _CNV_A_R_LINEAR_____16_CM 0. 8160. DISPLAY_IDENTIFIER C_N_32_MAX_DIAG_SA FORMAT "%4.0" /end CHARACTERISTIC
/begin AXIS_PTS ldp_tia_id_tco_min_diag_sa "" 0x01204 tia _REC_AXS_20_u1 190.5 _CNV_A_R_LINEAR_____12_CM 6 -48. 142.5 DISPLAY_IDENTIFIER LDP_TIA_ID_TCO_MIN_DIAG_SA FORMAT "%5.1" /end AXIS_PTS
/begin AXIS_PTS ldpm_fac_amp "" 0x11644 fac_amp _REC_AXS_20_u2 1.99996948 _CNV_A_R_LINEAR_____21_CM 6 0. 1.99996948 DISPLAY_IDENTIFIER LDPM_FAC_AMP FORMAT "%7.5" /end AXIS_PTS
/begin MEASUREMENT lv_err_ls_up_swt_1 "status diagnosis result of switch time monitoring" UBYTE _CNV_S_2_RANGE______2_R_CM 1 100. 0. 255. DISPLAY_IDENTIFIER LV_ERR_LS_UP_SWT_1 ECU_ADDRESS 0x3fbb94 /end MEASUREMENT
/begin MEASUREMENT lv_err_ls_up_swt_2 "status diagnosis result of switch time monitoring" UBYTE _CNV_S_2_RANGE______2_R_CM 1 100. 0. 255. DISPLAY_IDENTIFIER LV_ERR_LS_UP_SWT_2 ECU_ADDRESS 0x3fbb98 /end MEASUREMENT
/begin MEASUREMENT lv_err_ls_up_frq_1 "status diagnosis result of oxygen fequency monitoring" UBYTE _CNV_S_2_RANGE______2_R_CM 1 100. 0. 255. DISPLAY_IDENTIFIER LV_ERR_LS_UP_FRQ_1 ECU_ADDRESS 0x3fbb9c /end MEASUREMENT
/begin MEASUREMENT lv_err_ls_up_frq_2 "status diagnosis result of oxygen fequency monitoring" UBYTE _CNV_S_2_RANGE______2_R_CM 1 100. 0. 255. DISPLAY_IDENTIFIER LV_ERR_LS_UP_FRQ_2 ECU_ADDRESS 0x3fbba0 /end MEASUREMENT
/begin MEASUREMENT lv_err_obd2_lsh_up_1 "Boolean flag indicating that fault is present and has been debounced" UBYTE _CNV_S_2_RANGE______2_R_CM 1 100. 0. 255. DISPLAY_IDENTIFIER LV_ERR_OBD2_LSH_UP_1 ECU_ADDRESS 0x3fbb44 /end MEASUREMENT
/begin MEASUREMENT lv_err_obd2_lsh_up_2 "Boolean flag indicating that fault is present and has been debounced" UBYTE _CNV_S_2_RANGE______2_R_CM 1 100. 0. 255. DISPLAY_IDENTIFIER LV_ERR_OBD2_LSH_UP_2 ECU_ADDRESS 0x3fbb48 /end MEASUREMENT
/begin CHARACTERISTIC c_t_ast_tia_diag_sa "Time after start for TAM - determination" VALUE 0x017be _REC_VAL_20_u2 6553.2 _CNV_A_R_LINEAR_____24_CM 0.3 6553.5 DISPLAY_IDENTIFIER C_T_AST_TIA_DIAG_SA FORMAT "%6.1" /end CHARACTERISTIC
/begin CHARACTERISTIC c_tco_max_diag_sa "???" VALUE 0x00878 _REC_VAL_20_u1 190.5 _CNV_A_R_LINEAR_____12_CM -48. 142.5 DISPLAY_IDENTIFIER C_TCO_MAX_DIAG_SA FORMAT "%5.1" /end CHARACTERISTIC
/begin CHARACTERISTIC c_vls_afr_ready_sa_diag "VLS rich threshold to start the SAFM-monitoring" VALUE 0x019f6 _REC_VAL_20_u2 4.99511719 _CNV_A_R_LINEAR_____3_CM 0. 4.99511719 DISPLAY_IDENTIFIER C_VLS_AFR_READY_SA_DIAG FORMAT "%5.3" /end CHARACTERISTIC
/begin CHARACTERISTIC c_vls_afl_ready_sa_diag "VLS lean threshold to start the SAFM-monitoring" VALUE 0x019ec _REC_VAL_20_u2 4.99511719 _CNV_A_R_LINEAR_____3_CM 0. 4.99511719 DISPLAY_IDENTIFIER C_VLS_AFL_READY_SA_DIAG FORMAT "%5.3" /end CHARACTERISTIC
/begin AXIS_PTS ldp_n_32__maf_max_diag_sa "" 0x07c2f n_32 _REC_AXS_20_u1 816. _CNV_A_R_LINEAR_____16_CM 8 0. 8160. DISPLAY_IDENTIFIER LDP_N_32__MAF_MAX_DIAG_SA FORMAT "%4.0" /end AXIS_PTS
/begin MEASUREMENT lv_intr_diag_sa "Secondary air system diagnosis: application incidence to interrupt the diagnosis" UBYTE _CNV_S_2_RANGE______0_CM 1 100. 0. 1. DISPLAY_IDENTIFIER LV_INTR_DIAG_SA ECU_ADDRESS 0x3fe0eb BIT_MASK 0x1 /end MEASUREMENT
/begin MEASUREMENT lv_vls_ready_sa_diag_up_1 "VLS lean threshold jto start diagnosis bank1" UBYTE _CNV_S_2_RANGE______0_CM 1 100. 0. 1. DISPLAY_IDENTIFIER LV_VLS_READY_SA_DIAG_UP_1 ECU_ADDRESS 0x3fe0ec BIT_MASK 0x1 /end MEASUREMENT
/begin MEASUREMENT lv_vls_ready_sa_diag_up_2 "VLS lean threshold jto start diagnosis bank2" UBYTE _CNV_S_2_RANGE______0_CM 1 100. 0. 1. DISPLAY_IDENTIFIER LV_VLS_READY_SA_DIAG_UP_2 ECU_ADDRESS 0x3fe0ed BIT_MASK 0x1 /end MEASUREMENT
/begin CHARACTERISTIC c_amp_min_sa_diag "Maximum speed to interrupt the SA diagnosis" VALUE 0x0148e _REC_VAL_20_u2 5434. _CNV_A_R_LINEAR_____49_CM 0. 5434. DISPLAY_IDENTIFIER C_AMP_MIN_SA_DIAG FORMAT "%7.2" /end CHARACTERISTIC
/begin MEASUREMENT dist_dmtl "Distance covered for DMTL function" UWORD _CNV_A_R_LINEAR_____175_CM 1 100. 0. 65535. DISPLAY_IDENTIFIER DIST_DMTL ECU_ADDRESS 0x3fcce4 BYTE_ORDER MSB_LAST FORMAT "%5.0" /end MEASUREMENT
/begin COMPU_METHOD _CNV_S_2_RANGE______0_CM "" TAB_VERB "%6.3" "[-]" COMPU_TAB_REF _CNV_S_2_RANGE______0 /end COMPU_METHOD
/begin COMPU_VTAB _CNV_S_2_RANGE______0 "" TAB_VERB 2 0 "0" 1 "1" /end COMPU_VTAB
/begin COMPU_METHOD _CNV_A_R_LINEAR_____1_CM "" RAT_FUNC "%6.3" "-" COEFFS 0 1. 0. 0 0 1 /end COMPU_METHOD
/begin COMPU_METHOD _CNV_S_2_RANGE______2_R_CM "" TAB_VERB "%6.3" "[-]" COMPU_TAB_REF _CNV_S_2_RANGE______2_R /end COMPU_METHOD
/begin COMPU_VTAB_RANGE _CNV_S_2_RANGE______2_R "" 2 0 0 "0" 1 255 "1" /end COMPU_VTAB_RANGE
/begin COMPU_METHOD _CNV_A_R_LINEAR_____3_CM "" RAT_FUNC "%6.3" "V" COEFFS 0 204.7999998974999 0. 0 0 1 /end COMPU_METHOD
/begin COMPU_METHOD _CNV_A_R_LINEAR_____4_CM "" RAT_FUNC "%6.3" "s" COEFFS 0 100. 0. 0 0 1 /end COMPU_METHOD
/begin COMPU_METHOD _CNV_A_R_LINEAR_____7_CM "" RAT_FUNC "%6.3" "°C" COEFFS 0 16. 0. 0 0 1 /end COMPU_METHOD
/begin COMPU_METHOD _CNV_A_R_LINEAR_____9_CM "" RAT_FUNC "%6.3" "%" COEFFS 0 655.3600000071681 0. 0 0 1 /end COMPU_METHOD
/begin COMPU_METHOD _CNV_A_R_LINEAR_____10_CM "" RAT_FUNC "%6.3" "%" COEFFS 0 2.56 0. 0 0 1 /end COMPU_METHOD
/begin COMPU_METHOD _CNV_A_R_LINEAR_____11_CM "" RAT_FUNC "%6.3" "rpm" COEFFS 0 1. 0. 0 0 1 /end COMPU_METHOD
/begin COMPU_METHOD _CNV_A_R_LINEAR_____12_CM "" RAT_FUNC "%6.3" "°C" COEFFS 0 1.333333333333333 64. 0 0 1 /end COMPU_METHOD
/begin COMPU_METHOD _CNV_A_R_LINEAR_____14_CM "" RAT_FUNC "%6.3" "°C" COEFFS 0 1. 0. 0 0 1 /end COMPU_METHOD
/begin COMPU_METHOD _CNV_A_R_LINEAR_____16_CM "" RAT_FUNC "%6.3" "rpm" COEFFS 0 3.125e-002 0. 0 0 1 /end COMPU_METHOD
/begin COMPU_METHOD _CNV_A_R_LINEAR_____21_CM "" RAT_FUNC "%6.3" "-" COEFFS 0 32768.00003968061 0. 0 0 1 /end COMPU_METHOD
/begin COMPU_METHOD _CNV_A_R_LINEAR_____22_CM "" RAT_FUNC "%6.3" "[-]" COEFFS 0 1. 0. 0 0 1 /end COMPU_METHOD
/begin COMPU_METHOD _CNV_A_R_LINEAR_____23_CM "" RAT_FUNC "%6.3" "km/h" COEFFS 0 1. 0. 0 0 1 /end COMPU_METHOD
/begin COMPU_METHOD _CNV_A_R_LINEAR_____24_CM "" RAT_FUNC "%6.3" "s" COEFFS 0 10. 0. 0 0 1 /end COMPU_METHOD
/begin COMPU_METHOD _CNV_A_R_LINEAR_____27_CM "" RAT_FUNC "%6.3" "mg/stk" COEFFS 0 0.183585313174946 0. 0 0 1 /end COMPU_METHOD
/begin COMPU_METHOD _CNV_A_R_LINEAR_____29_CM "" RAT_FUNC "%6.3" "-" COEFFS 0 255.9983911655618 0. 0 0 1 /end COMPU_METHOD
/begin COMPU_METHOD _CNV_A_R_LINEAR_____30_CM "" RAT_FUNC "%6.3" "s" COEFFS 0 1. 0. 0 0 1 /end COMPU_METHOD
/begin COMPU_METHOD _CNV_A_R_LINEAR_____37_CM "" RAT_FUNC "%6.3" "-" COEFFS 0 65536.00007936121 0. 0 0 1 /end COMPU_METHOD
/begin COMPU_METHOD _CNV_A_R_LINEAR_____39_CM "" RAT_FUNC "%6.3" "-" COEFFS 0 127.9991955827809 0. 0 0 1 /end COMPU_METHOD
/begin COMPU_METHOD _CNV_A_R_LINEAR_____46_CM "" RAT_FUNC "%6.3" "-" COEFFS 0 16. 0. 0 0 1 /end COMPU_METHOD
/begin COMPU_METHOD _CNV_A_R_LINEAR_____49_CM "" RAT_FUNC "%6.3" "hPa" COEFFS 0 12.06017666543982 0. 0 0 1 /end COMPU_METHOD
/begin COMPU_METHOD _CNV_A_R_LINEAR_____50_CM "" RAT_FUNC "%6.3" "[-]" COEFFS 0 255.9999357490357 0. 0 0 1 /end COMPU_METHOD
/begin COMPU_METHOD _CNV_A_R_LINEAR_____60_CM "" RAT_FUNC "%6.3" "V" COEFFS 0 9.807692307692308 0. 0 0 1 /end COMPU_METHOD
/begin COMPU_METHOD _CNV_A_R_LINEAR_____96_CM "" RAT_FUNC "%6.3" "l" COEFFS 0 1. 0. 0 0 1 /end COMPU_METHOD
/begin COMPU_METHOD _CNV_A_R_LINEAR_____97_CM "" RAT_FUNC "%6.3" "min" COEFFS 0 1. 0. 0 0 1 /end COMPU_METHOD
/begin COMPU_METHOD _CNV_A_R_LINEAR_____106_CM "" RAT_FUNC "%6.3" "mg/stk" COEFFS 0 47.18142548596112 0. 0 0 1 /end COMPU_METHOD
/begin COMPU_METHOD _CNV_A_R_LINEAR_____109_CM "" RAT_FUNC "%6.3" "%" COEFFS 0 655.3600000071681 3.584063961170614e-007 0 0 1 /end COMPU_METHOD
/begin COMPU_METHOD _CNV_A_R_LINEAR_____113_CM "" RAT_FUNC "%6.3" "kg/h" COEFFS 0 32. 0. 0 0 1 /end COMPU_METHOD
/begin COMPU_METHOD _CNV_A_R_LINEAR_____115_CM "" RAT_FUNC "%6.3" "-" COEFFS 0 128. 0. 0 0 1 /end COMPU_METHOD
/begin COMPU_METHOD _CNV_A_R_LINEAR_____123_CM "" RAT_FUNC "%6.3" "-" COEFFS 0 255.9999997499962 0. 0 0 1 /end COMPU_METHOD
/begin COMPU_METHOD _CNV_A_R_LINEAR_____127_CM "" RAT_FUNC "%6.3" "[-]" COEFFS 0 64. 0. 0 0 1 /end COMPU_METHOD
/begin COMPU_METHOD _CNV_A_R_LINEAR_____157_CM "" RAT_FUNC "%6.3" "-" COEFFS 0 64. 0. 0 0 1 /end COMPU_METHOD
/begin COMPU_METHOD _CNV_A_R_LINEAR_____165_CM "" RAT_FUNC "%6.3" "hPa" COEFFS 0 12.05960017121163 0. 0 0 1 /end COMPU_METHOD
/begin COMPU_METHOD _CNV_A_R_LINEAR_____166_CM "" RAT_FUNC "%6.3" "mA" COEFFS 0 163.8400395206126 7.904122518084478e-003 0 0 1 /end COMPU_METHOD
/begin COMPU_METHOD _CNV_A_R_LINEAR_____167_CM "" RAT_FUNC "%6.3" "mA" COEFFS 0 163.8375 0. 0 0 1 /end COMPU_METHOD
/begin COMPU_METHOD _CNV_A_R_LINEAR_____168_CM "" RAT_FUNC "%6.3" "l" COEFFS 0 15.25879531537405 0. 0 0 1 /end COMPU_METHOD
/begin COMPU_METHOD _CNV_A_R_LINEAR_____169_CM "" RAT_FUNC "%6.3" "l" COEFFS 0 15.26190476190476 0. 0 0 1 /end COMPU_METHOD
/begin COMPU_METHOD _CNV_A_R_LINEAR_____170_CM "" RAT_FUNC "%6.3" "ohm" COEFFS 0 5.1 0. 0 0 1 /end COMPU_METHOD
/begin COMPU_METHOD _CNV_A_R_LINEAR_____171_CM "" RAT_FUNC "%6.3" "h" COEFFS 0 35999.99999497086 0. 0 0 1 /end COMPU_METHOD
/begin COMPU_METHOD _CNV_A_R_LINEAR_____172_CM "" RAT_FUNC "%6.3" "V" COEFFS 0 2510.769230769231 0. 0 0 1 /end COMPU_METHOD
/begin COMPU_METHOD _CNV_S_13_STATE_DMTL_173_CM "" TAB_VERB "%6.3" "-" COMPU_TAB_REF _CNV_S_13_STATE_DMTL_173 /end COMPU_METHOD
/begin COMPU_VTAB _CNV_S_13_STATE_DMTL_173 "" TAB_VERB 13 0 "START" 1 "REF_LEAK_MES" 2 "ROUGH_LEAK_MES" 3 "ROUGH_LEAK_MES_LEN" 4 "ROUGH_LEAK_MES_END" 5 "SMALL_LEAK_MES" 6 "SMALL_LEAK_MES_LEN" 7 "2.REF_LEAK_MES" 8 "TANK_PROOFED" 9 "SMALL_LEAK" 10 "ROUGH_LEAK" 11 "MODULE_ERROR" 12 "END" /end COMPU_VTAB
/begin COMPU_METHOD _CNV_A_R_LINEAR_____174_CM "" RAT_FUNC "%6.3" "-" COEFFS 0 32767.98303949118 0. 0 0 1 /end COMPU_METHOD
/begin COMPU_METHOD _CNV_A_R_LINEAR_____175_CM "" RAT_FUNC "%6.3" "m" COEFFS 0 1. 0. 0 0 1 /end COMPU_METHOD
/begin COMPU_METHOD _CNV_A_R_LINEAR_____177_CM "" RAT_FUNC "%6.3" "°C" COEFFS 0 0.25 8.25 0 0 1 /end COMPU_METHOD
/begin COMPU_METHOD _CNV_S_2_RANGE______191_CM "" TAB_VERB "%6.3" "[-]" COMPU_TAB_REF _CNV_S_2_RANGE______191 /end COMPU_METHOD
/begin COMPU_VTAB _CNV_S_2_RANGE______191 "" TAB_VERB 2 0 "PASSIVE" 1 "ACTIVE" /end COMPU_VTAB
/begin COMPU_METHOD _CNV_A_R_LINEAR_____197_CM "" RAT_FUNC "%6.3" "s" COEFFS 0 50. 0. 0 0 1 /end COMPU_METHOD
/begin COMPU_METHOD _CNV_A_R_LINEAR_____198_CM "" RAT_FUNC "%6.3" "ms" COEFFS 0 250. 0. 0 0 1 /end COMPU_METHOD
/begin COMPU_METHOD _CNV_A_R_LINEAR_____271_CM "" RAT_FUNC "%6.3" "g" COEFFS 0 36.00036915004301 0. 0 0 1 /end COMPU_METHOD
/begin COMPU_METHOD _CNV_A_R_LINEAR_____274_CM "" RAT_FUNC "%6.3" "ms" COEFFS 0 2.133333333333333 0. 0 0 1 /end COMPU_METHOD
/begin COMPU_METHOD _CNV_A_R_LINEAR_____279_CM "" RAT_FUNC "%6.3" "ohm" COEFFS 0 1. 0. 0 0 1 /end COMPU_METHOD
/begin COMPU_METHOD _CNV_A_R_LINEAR_____285_CM "" RAT_FUNC "%6.3" "-" COEFFS 0 25.6 0. 0 0 1 /end COMPU_METHOD
/begin COMPU_METHOD _CNV_S_8_STATE_VLS__286_CM "" TAB_VERB "%6.3" "[-]" COMPU_TAB_REF _CNV_S_8_STATE_VLS__286 /end COMPU_METHOD
/begin COMPU_VTAB _CNV_S_8_STATE_VLS__286 "" TAB_VERB 8 0 "Passive" 1 "Active" 2 "Monitoring 1" 3 "Monitoring 2" 4 "Validation" 5 "Calculation" 6 "Cycle end" 255 "Finished" /end COMPU_VTAB
/begin COMPU_METHOD _CNV_A_R_LINEAR_____287_CM "" RAT_FUNC "%6.3" "g/180" COEFFS 0 12.80000018750286 0. 0 0 1 /end COMPU_METHOD
/begin COMPU_METHOD _CNV_A_R_LINEAR_____288_CM "" RAT_FUNC "%6.3" "[-]" COEFFS 0 12800.00218753375 0. 0 0 1 /end COMPU_METHOD
/begin COMPU_METHOD _CNV_A_R_LINEAR_____289_CM "" RAT_FUNC "%6.3" "-" COEFFS 0 25.59999997499962 0. 0 0 1 /end COMPU_METHOD
/begin COMPU_METHOD _CNV_A_R_LINEAR_____290_CM "" RAT_FUNC "%6.3" "ms" COEFFS 0 5.e-002 0. 0 0 1 /end COMPU_METHOD
/begin COMPU_METHOD _CNV_A_R_LINEAR_____291_CM "" RAT_FUNC "%6.3" "J" COEFFS 0 1. 0. 0 0 1 /end COMPU_METHOD
/begin COMPU_METHOD _CNV_S_9_STATE_OBD2_292_CM "" TAB_VERB "%6.3" "[-]" COMPU_TAB_REF _CNV_S_9_STATE_OBD2_292 /end COMPU_METHOD
/begin COMPU_VTAB _CNV_S_9_STATE_OBD2_292 "" TAB_VERB 9 0 "DIAG_OFF" 1 "DIAG_INIT" 2 "LS_READY" 3 "OBD1_DLY" 4 "OBD1_CHK" 5 "TEG_THD" 6 "POW_INT" 7 "DIAG_ACT" 8 "DIAG_END" /end COMPU_VTAB
/begin COMPU_METHOD _CNV_A_R_LINEAR_____301_CM "" RAT_FUNC "%6.3" "%/s" COEFFS 0 0.1024000000600009 0. 0 0 1 /end COMPU_METHOD
/begin COMPU_METHOD _CNV_A_R_LINEAR_____314_CM "" RAT_FUNC "%6.3" "%/s" COEFFS 0 0.1024000154202376 0. 0 0 1 /end COMPU_METHOD
/begin COMPU_METHOD _CNV_A_R_LINEAR_____315_CM "" RAT_FUNC "%6.3" "%/s" COEFFS 0 0.1024028382518949 128. 0 0 1 /end COMPU_METHOD
/begin COMPU_METHOD _CNV_A_R_LINEAR_____386_CM "" RAT_FUNC "%6.3" "[-]" COEFFS 0 128.0000018750286 0. 0 0 1 /end COMPU_METHOD
/begin COMPU_METHOD _CNV_A_R_LINEAR_____387_CM "" RAT_FUNC "%6.3" "[-]" COEFFS 0 1.525855623540901e-005 0. 0 0 1 /end COMPU_METHOD
/begin COMPU_METHOD _CNV_A_R_LINEAR_____388_CM "" RAT_FUNC "%6.3" "-" COEFFS 0 2. 0. 0 0 1 /end COMPU_METHOD
/begin COMPU_METHOD _CNV_A_R_LINEAR_____401_CM "" RAT_FUNC "%6.3" "s" COEFFS 0 100.0015259720442 0. 0 0 1 /end COMPU_METHOD
/begin COMPU_METHOD _CNV_A_R_LINEAR_____402_CM "" RAT_FUNC "%6.3" "s" COEFFS 0 100.0015267408663 -1.000015267408663 0 0 1 /end COMPU_METHOD
/begin COMPU_METHOD _CNV_S_7_RANGE_C_CO_403_CM "" TAB_VERB "%6.3" "[-]" COMPU_TAB_REF _CNV_S_7_RANGE_C_CO_403 /end COMPU_METHOD
/begin COMPU_VTAB _CNV_S_7_RANGE_C_CO_403 "" TAB_VERB 7 0 "NO_SAV_DIAG_EOL" 1 "DIAG_Bank_1" 2 "DIAG_Bank_2" 4 "EOL_Bank_1" 5 "DIAG_EOL_BANK_1" 8 "EOL_BANK_2" 10 "DIAG_EOL_BANK_2" /end COMPU_VTAB
/begin COMPU_METHOD _CNV_A_R_LINEAR_____405_CM "" RAT_FUNC "%6.3" "%" COEFFS 0 655.359650041603 0. 0 0 1 /end COMPU_METHOD
/begin RECORD_LAYOUT _REC_VAL_20_u1 FNC_VALUES 1 UBYTE COLUMN_DIR DIRECT /end RECORD_LAYOUT
/begin RECORD_LAYOUT _REC_VAL_20_u2 FNC_VALUES 1 UWORD COLUMN_DIR DIRECT /end RECORD_LAYOUT
/begin RECORD_LAYOUT _REC_CUR_20_u2_u1 FNC_VALUES 1 UWORD COLUMN_DIR DIRECT /end RECORD_LAYOUT
/begin RECORD_LAYOUT _REC_AXS_20_u1 NO_AXIS_PTS_X 1 UBYTE AXIS_PTS_X 2 UBYTE INDEX_INCR DIRECT /end RECORD_LAYOUT
/begin RECORD_LAYOUT _REC_CUR_20_u1_u1 FNC_VALUES 1 UBYTE COLUMN_DIR DIRECT /end RECORD_LAYOUT
/begin RECORD_LAYOUT _REC_AXS_20_u2 NO_AXIS_PTS_X 1 UWORD AXIS_PTS_X 2 UWORD INDEX_INCR DIRECT /end RECORD_LAYOUT
/begin RECORD_LAYOUT _REC_MAP_20_u2_u2_u1 FNC_VALUES 1 UWORD COLUMN_DIR DIRECT /end RECORD_LAYOUT
/begin RECORD_LAYOUT _REC_CUR_20_u1_u2 FNC_VALUES 1 UBYTE COLUMN_DIR DIRECT /end RECORD_LAYOUT
/begin RECORD_LAYOUT _REC_CUR_20_u2_u2 FNC_VALUES 1 UWORD COLUMN_DIR DIRECT /end RECORD_LAYOUT
/begin RECORD_LAYOUT _REC_VAL_20_s1 FNC_VALUES 1 SBYTE COLUMN_DIR DIRECT /end RECORD_LAYOUT
/begin RECORD_LAYOUT _REC_VAL_20_u4 FNC_VALUES 1 ULONG COLUMN_DIR DIRECT /end RECORD_LAYOUT
/begin RECORD_LAYOUT _REC_VAL_20_s2 FNC_VALUES 1 SWORD COLUMN_DIR DIRECT /end RECORD_LAYOUT
/begin RECORD_LAYOUT _REC_MAP_20_u2_u1_u2 FNC_VALUES 1 UWORD COLUMN_DIR DIRECT /end RECORD_LAYOUT
/begin FUNCTION OBD_Cat_Efficiency_Diagnosis__OS "_Cat Efficiency Diagnosis (OSC Method)"
 /begin DEF_CHARACTERISTIC c_o2_cat_mv_min c_o2_cat_mv_max c_o2_cat_mv_dif_max c_sum_min_cat_diag c_cat_max_diag id_o2_int_max_at__n_32__maf id_o2_int_max_mt__n_32__maf ip_o2_cat_1__vls_down_1 ip_o2_cat_2__vls_down_2 ip_o2_cat_max__sum_vls_cat_o2 /end DEF_CHARACTERISTIC
 /begin OUT_MEASUREMENT lam_bank_1.cat_eff_obd2.bf.lv_cat_diag_cyc_vld lam_bank_1.cat_eff_obd2.sum_cat_diag lam_bank_1.cat_eff_obd2.cat_diag_clc lam_bank_1.cat_eff_obd2.cat_diag_cus lam_bank_1.cat_eff_obd2.vls_cyc_step lam_bank_1.cat_eff_obd2.sum_o2_cat_dif lam_bank_1.cat_eff_obd2.sum_o2_cat lam_bank_1.cat_eff_obd2.o2_cat_mv lam_bank_1.cat_eff_obd2.o2_cat_ratio lam_bank_1.cat_eff_obd2.sum_o2_cat_ratio lam_bank_1.cat_eff_obd2.sum_vls_cat_o2 lam_bank_1.cat_eff_obd2.o2_cat lam_bank_1.cat_eff_obd2.cat_diag lam_bank_1.cat_eff_inci.lv_inh_diag_cat_diag lam_bank_1.cat_eff_inci.lv_auth_cat_diag lam_bank_2.cat_eff_obd2.bf.lv_cat_diag_cyc_vld lam_bank_2.cat_eff_obd2.sum_cat_diag lam_bank_2.cat_eff_obd2.cat_diag_clc lam_bank_2.cat_eff_obd2.cat_diag_cus lam_bank_2.cat_eff_obd2.vls_cyc_step lam_bank_2.cat_eff_obd2.sum_o2_cat_dif lam_bank_2.cat_eff_obd2.sum_o2_cat lam_bank_2.cat_eff_obd2.o2_cat_mv lam_bank_2.cat_eff_obd2.o2_cat_ratio lam_bank_2.cat_eff_obd2.sum_o2_cat_ratio lam_bank_2.cat_eff_obd2.sum_vls_cat_o2 lam_bank_2.cat_eff_obd2.o2_cat lam_bank_2.cat_eff_obd2.cat_diag lam_bank_2.cat_eff_inci.lv_inh_diag_cat_diag lam_bank_2.cat_eff_inci.lv_auth_cat_diag lv_err_cat_diag_1 lv_err_cat_diag_2 /end OUT_MEASUREMENT
/end FUNCTION
/begin FUNCTION OBD_Limited_dynamic_for_catalyst "_Limited dynamic for catalyst effiency and oxygen sensor diagnosis"
 /begin DEF_CHARACTERISTIC c_n_crlc_cat c_maf_crlc_cat c_lam_mv_crlc_cat c_n_dyw_cat c_maf_dyw_cat c_lam_mv_dyw_cat c_maf_int_min_cat c_pv_av_grd_dec c_pv_av_grd_sum_max c_pv_av_grd_sum_min c_t_pv_av_grd_dec_sum c_pv_av_grd_min_sum_cat /end DEF_CHARACTERISTIC
 /begin OUT_MEASUREMENT lam_bank_1.cat_eff_ldc_obd2.lv_ldc_cat lam_bank_1.cat_eff_ldc_obd2.maf_int_ldc_cat lam_bank_1.cat_eff_ldc_obd2.pv_av_grd_sum lam_bank_1.cat_eff_ldc_obd2.lam_mv_mmv_cat lam_bank_2.cat_eff_ldc_obd2.lv_ldc_cat lam_bank_2.cat_eff_ldc_obd2.maf_int_ldc_cat lam_bank_2.cat_eff_ldc_obd2.pv_av_grd_sum lam_bank_2.cat_eff_ldc_obd2.lam_mv_mmv_cat n_mmv_cat maf_mmv_cat lv_n_ldc lv_maf_ldc /end OUT_MEASUREMENT
/end FUNCTION
/begin FUNCTION OBD_Oxygen_Sensor_diagnosis_with "_Oxygen Sensor diagnosis with multiple check"
 /begin DEF_CHARACTERISTIC lc_inh_ls_up_man_deac ip_t_vls_cyc_afl_max__n_32__maf c_sum_cyc_min_diag c_ratio_vls_cyc_afl_mv_max c_ratio_vls_cyc_afr_mv_max c_vls_cyc_dif_max c_vls_cyc_dif_min c_fac_t_lam_dly_ls_frq_diag ip_t_vls_cyc_afr_max__n_32__maf c_vls_hys c_sum_cycnr_min_diag c_ratio_vls_cycnr_afl_mv_max c_ratio_vls_cycnr_afr_mv_max c_ratio_vls_cycnr_dif_max c_ratio_vls_cycnr_dif_min id_t_vls_cycnr_afr_max id_t_vls_cycnr_afl_max /end DEF_CHARACTERISTIC
 /begin OUT_MEASUREMENT lam_bank_1.ls_up_obd2.bf.lv_inh_diag_ls_up lam_bank_1.ls_up_obd2.vls_cycnr_max lam_bank_1.ls_up_obd2.vls_cycnr_min lam_bank_1.ls_up_obd2.t_vls_cycnr lam_bank_1.ls_up_obd2.ratio_vls_cycnr_afl_mv lam_bank_1.ls_up_obd2.ratio_vls_cycnr_afr_mv lam_bank_1.ls_up_obd2.sum_cycnr_afl lam_bank_1.ls_up_obd2.sum_cycnr_afr lam_bank_1.ls_up_obd2.ratio_vls_cycnr_afl lam_bank_1.ls_up_obd2.ratio_sae_vls_cycnr_afl_mv lam_bank_1.ls_up_obd2.ratio_sae_vls_cycnr_afr_mv lam_bank_1.ls_up_obd2.ratio_vls_cycnr_afr lam_bank_1.ls_up_obd2.t_vls_afr_to_afl_sum lam_bank_1.ls_up_obd2.t_vls_afr_to_afl_sum_max lam_bank_1.ls_up_obd2.t_vls_afl_to_afr_sum lam_bank_1.ls_up_obd2.t_vls_afl_to_afr_sum_max lam_bank_1.ls_up_obd2.vls_sae_afl_thd lam_bank_1.ls_up_obd2.vls_sae_afr_thd lam_bank_1.ls_up_obd2.t_sae_vls_afr_afl lam_bank_1.ls_up_obd2.t_sae_vls_afr_afl_max lam_bank_1.ls_up_obd2.t_sae_vls_afl_afr_max lam_bank_1.ls_up_obd2.t_sae_vls_afl_afr lam_bank_1.ls_up_obd2.sum_cyc lam_bank_1.ls_up_obd2.ratio_vls_cyc_afl lam_bank_1.ls_up_obd2.ratio_vls_cyc_afr lam_bank_1.ls_up_obd2.ratio_vls_cyc_afl_sum lam_bank_1.ls_up_obd2.ratio_vls_cyc_afr_sum lam_bank_1.ls_up_obd2.ratio_vls_cyc_afl_mv lam_bank_1.ls_up_obd2.ratio_vls_cyc_afr_mv lam_bank_1.ls_up_obd2.ratio_sae_vls_cyc_afl_mv lam_bank_1.ls_up_obd2.ratio_sae_vls_cyc_afr_mv lam_bank_1.ls_up_obd2.t_vls_cyc_afr_sum lam_bank_1.ls_up_obd2.t_vls_cyc_afr_sum_max lam_bank_1.ls_up_obd2.t_sae_vls_cyc_afr lam_bank_1.ls_up_obd2.t_sae_vls_cyc_afr_max lam_bank_1.ls_up_obd2.t_lam_dly_p_old lam_bank_1.ls_up_obd2.t_lam_dly_p lam_bank_1.ls_up_obd2.sum_ratio_vls_cycnr_afl lam_bank_1.ls_up_obd2.sum_ratio_vls_cycnr_afr lam_bank_1.ls_up_obd2.t_vls_cyc_afr_mv_max lam_bank_1.ls_up_obd2.t_vls_cyc_afl_mv_max lam_bank_2.ls_up_obd2.bf.lv_inh_diag_ls_up lam_bank_2.ls_up_obd2.vls_cycnr_max lam_bank_2.ls_up_obd2.vls_cycnr_min lam_bank_2.ls_up_obd2.t_vls_cycnr lam_bank_2.ls_up_obd2.ratio_vls_cycnr_afl_mv lam_bank_2.ls_up_obd2.ratio_vls_cycnr_afr_mv lam_bank_2.ls_up_obd2.sum_cycnr_afl lam_bank_2.ls_up_obd2.sum_cycnr_afr lam_bank_2.ls_up_obd2.ratio_vls_cycnr_afl lam_bank_2.ls_up_obd2.ratio_sae_vls_cycnr_afl_mv lam_bank_2.ls_up_obd2.ratio_sae_vls_cycnr_afr_mv lam_bank_2.ls_up_obd2.ratio_vls_cycnr_afr lam_bank_2.ls_up_obd2.t_vls_afr_to_afl_sum lam_bank_2.ls_up_obd2.t_vls_afr_to_afl_sum_max lam_bank_2.ls_up_obd2.t_vls_afl_to_afr_sum lam_bank_2.ls_up_obd2.t_vls_afl_to_afr_sum_max lam_bank_2.ls_up_obd2.vls_sae_afl_thd lam_bank_2.ls_up_obd2.vls_sae_afr_thd lam_bank_2.ls_up_obd2.t_sae_vls_afr_afl lam_bank_2.ls_up_obd2.t_sae_vls_afr_afl_max lam_bank_2.ls_up_obd2.t_sae_vls_afl_afr_max lam_bank_2.ls_up_obd2.t_sae_vls_afl_afr lam_bank_2.ls_up_obd2.sum_cyc lam_bank_2.ls_up_obd2.ratio_vls_cyc_afl lam_bank_2.ls_up_obd2.ratio_vls_cyc_afr lam_bank_2.ls_up_obd2.ratio_vls_cyc_afl_sum lam_bank_2.ls_up_obd2.ratio_vls_cyc_afr_sum lam_bank_2.ls_up_obd2.ratio_vls_cyc_afl_mv lam_bank_2.ls_up_obd2.ratio_vls_cyc_afr_mv lam_bank_2.ls_up_obd2.ratio_sae_vls_cyc_afl_mv lam_bank_2.ls_up_obd2.ratio_sae_vls_cyc_afr_mv lam_bank_2.ls_up_obd2.t_vls_cyc_afr_sum lam_bank_2.ls_up_obd2.t_vls_cyc_afr_sum_max lam_bank_2.ls_up_obd2.t_sae_vls_cyc_afr lam_bank_2.ls_up_obd2.t_sae_vls_cyc_afr_max lam_bank_2.ls_up_obd2.t_lam_dly_p_old lam_bank_2.ls_up_obd2.t_lam_dly_p lam_bank_2.ls_up_obd2.sum_ratio_vls_cycnr_afl lam_bank_2.ls_up_obd2.sum_ratio_vls_cycnr_afr lam_bank_2.ls_up_obd2.t_vls_cyc_afr_mv_max lam_bank_2.ls_up_obd2.t_vls_cyc_afl_mv_max lv_err_ls_up_swt_1 lv_err_ls_up_swt_2 lv_err_ls_up_frq_1 lv_err_ls_up_frq_2 /end OUT_MEASUREMENT
/end FUNCTION
/begin FUNCTION OBD_Diagnosis_of_monitor_sensors "_Diagnosis of monitor sensors"
 /begin DEF_CHARACTERISTIC lc_inh_ls_down_man_deac c_vls_down_hys ip_vls_down_max_cycnr c_cycnr_vls_down_max c_tco_min_ls_down c_vs_max_ls_down c_vs_min_ls_down c_temp_cat_min_ls_down c_maf_kgh_max_puc_ls_down c_maf_kgh_min_puc_ls_down c_vls_down_min_puc_diag c_fac_vls_down_max_diag c_fac_vls_down_min_diag c_sum_min_vls_down_diag c_maf_int_puc_ls_down_pue c_maf_int_ls_down_pue c_ctr_min_end_diag_ls_down_pue c_ctr_inc_ls_down_pue c_ctr_max_ls_down_pue c_vls_down_dif_min_diag /end DEF_CHARACTERISTIC
 /begin OUT_MEASUREMENT lam_bank_1.ls_down_obd2.bf.lv_ls_down_swt_vld lam_bank_1.ls_down_obd2.bf.lv_ls_down_pue_vld lam_bank_1.ls_down_obd2.bf.lv_cdn_diag_ls_down lam_bank_1.ls_down_obd2.cycnr_vls_down_act lam_bank_1.ls_down_obd2.ctr_vls_down_diag lam_bank_1.ls_down_obd2.vls_down_tran_puc lam_bank_1.ls_down_obd2.ctr_cycnr_quo_vls_down_sum lam_bank_1.ls_down_obd2.cycnr_ratio_vls_down lam_bank_1.ls_down_obd2.cycnr_sae_ratio_vls_down lam_bank_1.ls_down_obd2.cycnr_quo_vls_down lam_bank_1.ls_down_obd2.vls_down_pue lam_bank_1.ls_down_obd2.ctr_end_diag_ls_down_pue lam_bank_1.ls_down_obd2.vls_down_dif_diag lam_bank_1.ls_down_obd2.vls_sae_down_dif_diag lam_bank_1.ls_down_obd2.ctr_ls_down_pue lam_bank_2.ls_down_obd2.bf.lv_ls_down_swt_vld lam_bank_2.ls_down_obd2.bf.lv_ls_down_pue_vld lam_bank_2.ls_down_obd2.bf.lv_cdn_diag_ls_down lam_bank_2.ls_down_obd2.cycnr_vls_down_act lam_bank_2.ls_down_obd2.ctr_vls_down_diag lam_bank_2.ls_down_obd2.vls_down_tran_puc lam_bank_2.ls_down_obd2.ctr_cycnr_quo_vls_down_sum lam_bank_2.ls_down_obd2.cycnr_ratio_vls_down lam_bank_2.ls_down_obd2.cycnr_sae_ratio_vls_down lam_bank_2.ls_down_obd2.cycnr_quo_vls_down lam_bank_2.ls_down_obd2.vls_down_pue lam_bank_2.ls_down_obd2.ctr_end_diag_ls_down_pue lam_bank_2.ls_down_obd2.vls_down_dif_diag lam_bank_2.ls_down_obd2.vls_sae_down_dif_diag lam_bank_2.ls_down_obd2.ctr_ls_down_pue maf_kgh_min_puc maf_int_pue lv_req_diag_ls_down lv_end_diag_ls_down lv_err_ls_down_pue_1 lv_err_ls_down_pue_2 lv_err_ls_down_swt_1 lv_err_ls_down_swt_2 /end OUT_MEASUREMENT
/end FUNCTION
/begin FUNCTION OBD_SA_system_monitoring_through "_SA system monitoring through binary lambda sensor (ZrO2)"
 /begin DEF_CHARACTERISTIC id_t_dly_diag_sa c_sum_afl_vls_min_diag_sa c_t_diag_sa c_conf_diag_sav c_t_dly_intr_diag_sa c_ctr_p_diag_sa_sav c_lam_thd_diag_sav c_ctr_p_diag_sa_sap /end DEF_CHARACTERISTIC
 /begin OUT_MEASUREMENT lv_err_sa_sap lv_err_sa_sav sum_afl_vls_diag_sa_2 t_dly_diag_sa t_diag_sa lam_diag_sav_max t_dly_intr_diag_sa sum_afl_vls_diag_sa_1 sum_afl_vls_diag_sa_1_sae sum_afl_vls_diag_sa_2_sae lam_mv_diag_sav ctr_p_diag_sa_sap_2 ctr_p_diag_sa_sap_1 ctr_p_diag_sa_sav /end OUT_MEASUREMENT
/end FUNCTION
/begin FUNCTION OBD_Readiness_code "_Readiness code" /begin DEF_CHARACTERISTIC c_obd_state_1 c_obd_state_2 /end DEF_CHARACTERISTIC /end FUNCTION
/begin FUNCTION OBD_Upstream_oxygen_sensor_heate "_Upstream oxygen sensor heater OBDII monitoring"
 /begin DEF_CHARACTERISTIC c_pwm_min_obd2_lsh_up c_pwm_max_obd2_lsh_up c_t_dly_obd2_lsh_up c_temp_min_obd2_lsh_up c_temp_set_obd2_lsh_up c_egy_min_obd2_lsh_up c_tcc_obd2_lsh_up c_frc_obd2_lsh_up ip_r_thd_obd2_lsh_up ip_fac_maf_lsh_up ip_fac_teg_cat_up_mdl /end DEF_CHARACTERISTIC
 /begin OUT_MEASUREMENT lam_bank_1.lsh_up_obd2.pow_int_obd2_lsh_up lam_bank_1.lsh_up_obd2.state_obd2_lsh_up lam_bank_1.lsh_up_obd2.tcc_obd2_lsh_up lam_bank_1.lsh_up_obd2.frc_obd2_lsh_up lam_bank_1.lsh_up_obd2.ctr_cycnr_r_obd2_lsh_up lam_bank_1.lsh_up_obd2.r_up_ls_obd2_lsh_up lam_bank_1.lsh_up_obd2.temp_dif_obd2_lsh_up lam_bank_2.lsh_up_obd2.pow_int_obd2_lsh_up lam_bank_2.lsh_up_obd2.state_obd2_lsh_up lam_bank_2.lsh_up_obd2.tcc_obd2_lsh_up lam_bank_2.lsh_up_obd2.frc_obd2_lsh_up lam_bank_2.lsh_up_obd2.ctr_cycnr_r_obd2_lsh_up lam_bank_2.lsh_up_obd2.r_up_ls_obd2_lsh_up lam_bank_2.lsh_up_obd2.temp_dif_obd2_lsh_up lv_err_obd2_lsh_up_1 lv_err_obd2_lsh_up_2 /end OUT_MEASUREMENT
/end FUNCTION
/begin FUNCTION OBD_Application_incidences_Secon "_Application incidences Secondary air system monitoring through binary lambda sensor (ZrO2)"
 /begin DEF_CHARACTERISTIC ip_n_32_min_diag_sa ip_maf_kgh_max_diag_sa ip_maf_max_diag_sa c_ti_add_wf_max_diag_sa c_ti_add_wf_min_diag_sa lc_inh_sa_man_deac id_tco_min_diag_sa ip_maf_min_diag_sa c_n_32_max_diag_sa c_t_ast_tia_diag_sa c_tco_max_diag_sa c_vls_afr_ready_sa_diag c_vls_afl_ready_sa_diag c_amp_min_sa_diag /end DEF_CHARACTERISTIC
 /begin OUT_MEASUREMENT lv_intr_diag_sa lv_vls_ready_sa_diag_up_1 lv_vls_ready_sa_diag_up_2 /end OUT_MEASUREMENT
/end FUNCTION
/begin FUNCTION OBD_Tank_leakage_diagnosis_based "_Tank leakage diagnosis based on DMTL"
 /begin DEF_CHARACTERISTIC c_amp_dmtl_max c_cod_2_dmtl c_cod_dmtl c_crlc_cur_dmtl_fil c_crlc_cur_dmtl_fil_lim c_crlc_cur_dmtl_fil_refu c_crlc_vb_dmtl_fil c_crlc_vb_dmtl_fil_lim c_cur_dmtl_cor_fil_ofs_amp c_cur_dmtl_dif_cur_dmtl_stat c_cur_dmtl_ref_leak_max c_cur_dmtl_ref_leak_min c_cur_dmtl_ref_ofs c_ena_fco_diag c_fco_diag_max c_fco_diag_min c_ftl_dec_ftl_diag_min c_ftl_diag_max c_ftl_diag_min c_ftl_dmtl_max c_ftl_dmtl_min c_hys_ftl_dmtl c_r_dmtl c_sum_ena_rough_leak_max c_sum_ena_rough_leak_test_max c_sum_ena_small_leak_test_max c_sum_rep_rough_leak_mes_fuc_max c_t_cur_dmtl_rough_leak_max c_t_cur_dmtl_rough_leak_min c_t_cur_dmtl_stat c_t_dly_cur_dmtl_dif_mes c_t_dly_det_refu c_t_dly_dmtls c_t_dly_es_pwl c_t_dly_fuc_can_off c_t_dly_fuc_can_on c_t_dly_igk_ftl c_t_dly_req_pwl_dmtl c_t_dmtl_eol_max c_t_dmtl_max c_t_es_dmtl_min c_t_es_sub_dmtl c_t_ref_leak_mes_max c_t_ref_leak_mes_rep_max c_t_vb_dly_dmtl c_tam_dmtl_min c_tco_st_dmtl_min c_trt_dmtl_eol_max c_vb_dmtl_asa_max c_vb_dmtl_asa_min c_vb_dmtl_dif c_vb_dmtl_max c_vb_dmtl_min c_vs_ftl_diag_max c_t_ast_dmtl_max c_t_act_rough_leak c_t_act_small_leak ip_t_act_small_leak__ftl ip_fac_cur_dmtl_rough ip_fac_cur_dmtl_ref ip_t_cur_dmtl_stat c_t_ref_test_rough_leak c_fac_t_cur_dmtl_stat_len ip_fac_cur_dmtl c_tam_dmtl_max c_cl_dmtl_max c_vs_fuc_can_min c_vs_dmtl_max c_sum_cnl_rough_leak_mes_fuc_max c_sum_cnl_small_leak_mes_max c_cur_dmtl_ref_dif_max c_cur_dmtl_dif_thd_refu c_cur_dmtl_dif_thd_fuc c_cur_dmtl_dif_thd_mes c_dist_refu_rough_leak_min lc_cod_hdmtl ip_t_act_rough_leak c_t_dly_stop_refu c_t_ena_dr_dmtl_max /end DEF_CHARACTERISTIC
 /begin OUT_MEASUREMENT v_dmtl v_sof_swi v_sof_swi_mon ctr_cnl_rough_leak_mes_fuc ctr_cnl_small_leak_mes ctr_cur_dmtl_ref_dif_max ctr_dmtl_act ctr_rep_rough_leak_mes_fuc ctr_rough_leak_mes ctr_small_leak_mes cur_dmtl cur_dmtl_comp_rough_leak cur_dmtl_comp_small_leak_len cur_dmtl_cor_fil_max cur_dmtl_cor_fil_min cur_dmtl_cor_fil_refu_hpf cur_dmtl_dif cur_dmtl_dif_ref_rough_leak cur_dmtl_ref_leak cur_dmtl_rough_leak_len_end cur_dmtl_rough_leak_min cur_dmtl_thd_rough_leak_len fco_av_dmtl state_dmtl t_act_cur_dmtl_stat t_act_leak_mes t_act_ref_leak_mes t_es_dmtl cur_dmtl_dmtls_test cur_dmtl_thd_rough_leak cur_dmtl_thd_dmtls_test cur_dmtl_cor cur_dmtl_cor_fil vb_dmtl_ref vb_dmtl_fil ftl_ini ftl_old ctr_ena_rough_leak ctr_ena_rough_leak_test ctr_ena_small_leak_test dmtl_priv_state_1.bitfield.lv_chk_dmtl_cur_dmtl_vld dmtl_priv_state_1.bitfield.lv_chk_dmtl_vld dmtl_priv_state_1.bitfield.lv_cur_dmtl_dmtls_test dmtl_priv_state_1.bitfield.lv_cur_dmtl_ref_mes_max dmtl_priv_state_1.bitfield.lv_cur_dmtl_ref_mes_min dmtl_priv_state_1.bitfield.lv_cyc_rough_leak_susp dmtl_priv_state_1.bitfield.lv_dist_dmtl dmtl_priv_state_1.bitfield.lv_dmtl_asa dmtl_priv_state_1.bitfield.lv_dmtl_eol dmtl_priv_state_1.bitfield.lv_dmtl_pump dmtl_priv_state_1.bitfield.lv_dmtl_pump_on dmtl_priv_state_1.bitfield.lv_dmtl_rst_rough_leak dmtl_priv_state_1.bitfield.lv_dmtls dmtl_priv_state_1.bitfield.lv_dmtls_on dmtl_priv_state_1.bitfield.lv_dr_dmtl dmtl_priv_state_1.bitfield.lv_dr_dmtl_pump dmtl_priv_state_1.bitfield.lv_ena_fco_diag dmtl_priv_state_1.bitfield.lv_ena_ftl_diag dmtl_priv_state_2.bitfield.lv_ena_fuc_rough_leak_mes dmtl_priv_state_2.bitfield.lv_ena_main_dmtl dmtl_priv_state_2.bitfield.lv_ena_main_dmtl_fuc dmtl_priv_state_2.bitfield.lv_ena_rough_leak_1 dmtl_priv_state_2.bitfield.lv_ena_rough_leak_2 dmtl_priv_state_2.bitfield.lv_ena_rough_leak_3 dmtl_priv_state_2.bitfield.lv_ena_rough_leak_mes dmtl_priv_state_2.bitfield.lv_ena_rough_leak_mes_only dmtl_priv_state_2.bitfield.lv_ena_small_leak_1 dmtl_priv_state_2.bitfield.lv_ena_small_leak_mes_end dmtl_priv_state_2.bitfield.lv_err_det_small_leak_min dmtl_priv_state_2.bitfield.lv_fco_diag_max dmtl_priv_state_2.bitfield.lv_fco_diag_min dmtl_priv_state_2.bitfield.lv_fco_h_ftl dmtl_priv_state_2.bitfield.lv_ftl_dec dmtl_priv_state_2.bitfield.lv_ftl_dec_igk_on dmtl_priv_state_2.bitfield.lv_ftl_dmtl_max dmtl_priv_state_2.bitfield.lv_ftl_dmtl_min dmtl_priv_state_2.bitfield.lv_ftl_dmtl_val dmtl_priv_state_3.bitfield.lv_ftl_dyn dmtl_priv_state_3.bitfield.lv_ftl_inc dmtl_priv_state_3.bitfield.lv_ftl_inc_igk_on dmtl_priv_state_3.bitfield.lv_no_purge_dr_dmtl dmtl_priv_state_3.bitfield.lv_no_purge_dmtl_rough_leak dmtl_priv_state_3.bitfield.lv_no_purge_dmtl_small_leak dmtl_priv_state_4.bitfield.lv_ref_leak_rough_leak_susp dmtl_priv_state_4.bitfield.lv_refu dmtl_priv_state_4.bitfield.lv_refu_1 dmtl_priv_state_4.bitfield.lv_refu_end dmtl_priv_state_4.bitfield.lv_refu_rls_diag dmtl_priv_state_4.bitfield.lv_refu_val dmtl_priv_state_4.bitfield.lv_refu_val_1 dmtl_priv_state_4.bitfield.lv_req_ena_rough_leak dmtl_priv_state_4.bitfield.lv_req_pwl_rough_leak dmtl_priv_state_4.bitfield.lv_req_pwl_small_leak dmtl_priv_state_4.bitfield.lv_req_rough_leak dmtl_priv_state_4.bitfield.lv_rough_leak_susp dmtl_priv_state_4.bitfield.lv_small_leak_mes_len dmtl_priv_state_4.bitfield.lv_t_dly_dmtl_pwl dmtl_glob_state_1.bitfield.lv_ctr_cnl_small_leak_mes dmtl_glob_state_1.bitfield.lv_cur_dmtl_ref_dif_max dmtl_glob_state_1.bitfield.lv_cur_dmtl_thd_dif_mes dmtl_glob_state_1.bitfield.lv_det_fuc_open dmtl_glob_state_1.bitfield.lv_det_refu dmtl_glob_state_1.bitfield.lv_dist_det_rough_leak dmtl_glob_state_1.bitfield.lv_dmtl_act dmtl_glob_state_1.bitfield.lv_dmtl_stop dmtl_glob_state_1.bitfield.lv_ena_fuc dmtl_glob_state_1.bitfield.lv_ena_leak_dmtl dmtl_glob_state_1.bitfield.lv_ena_osc_rough_leak_mes dmtl_glob_state_1.bitfield.lv_ena_small_leak_mes dmtl_glob_state_1.bitfield.lv_ena_small_leak_refu dmtl_glob_state_1.bitfield.lv_err_det_dmtl_max dmtl_glob_state_1.bitfield.lv_err_det_dmtl_min dmtl_glob_state_1.bitfield.lv_err_det_rough_leak_min dmtl_glob_state_1.bitfield.lv_err_ftl dmtl_glob_state_1.bitfield.lv_err_ftl_plaus dmtl_glob_state_1.bitfield.lv_err_sig_dmtl dmtl_glob_state_1.bitfield.lv_err_small_leak dmtl_glob_state_1.bitfield.lv_ftl_diag dmtl_glob_state_1.bitfield.lv_fuc_can dmtl_glob_state_1.bitfield.lv_fuc_open dmtl_glob_state_1.bitfield.lv_no_purge_dmtl dmtl_glob_state_1.bitfield.lv_refu_dmtl dmtl_glob_state_2.bitfield.lv_req_pwl_dmtl dmtl_glob_state_2.bitfield.lv_rough_leak_susp_set dmtl_glob_state_2.bitfield.lv_rst_small_leak_mes_refu dmtl_glob_state_2.bitfield.lv_sdr_dmtl dmtl_glob_state_2.bitfield.lv_t_dmtl_max dmtl_glob_state_2.bitfield.lv_vb_dif_max dmtl_glob_state_2.bitfield.lv_hdmtl_on dmtl_glob_state_2.bitfield.lv_dr_dmtls dmtl_glob_state_2.bitfield.lv_vb_range_dmtl dmtl_glob_state_2.bitfield.lv_cyc_rough_leak_mode6 dmtl_glob_state_2.bitfield.lv_rough_leak_mes_len dmtl_glob_state_2.bitfield.lv_cyc_small_leak_mode6 cur_dmtl_small_leak_end cur_dmtl_ref_dif_max lv_err_dmtl_leak lv_err_dmtlm dist_dmtl /end OUT_MEASUREMENT
/end FUNCTION
/begin FUNCTION OBD_Cycle_manager "_Cycle manager" /begin DEF_CHARACTERISTIC c_tco_wup_thd c_tco_wup_inc /end DEF_CHARACTERISTIC /begin OUT_MEASUREMENT lv_dc lv_wup_cyc lv_state_wup /end OUT_MEASUREMENT /end FUNCTION
/end MODULE
/end PROJECT
