ASAP2_VERSION 1 3
/begin PROJECT _725D601B "725D601B"
/begin HEADER "" VERSION "_725D601B" PROJECT_NO _725D601B /end HEADER
/begin MODULE DIM ""
/begin MOD_COMMON "" BYTE_ORDER MSB_FIRST ALIGNMENT_BYTE 1 ALIGNMENT_WORD 2 ALIGNMENT_LONG 2 ALIGNMENT_FLOAT32_IEEE 4 /end MOD_COMMON
/begin CHARACTERISTIC ACFCNIO "Anzahl zul‰ssiger Pr¸fungen mit Ergebnis Tankdeckel offen" VALUE 0xFD484E KwWU8 255.0 dez 0.00 255.0 FORMAT "%5.1" /end CHARACTERISTIC
/begin CHARACTERISTIC ADMTLREF2 "DMTL Zustandsautomat: zustands-Nummer der 2-ten Referenzmessung" VALUE 0xFD30A2 KwWU8 255.0 dez 0.00 255.0 FORMAT "%5.1" /end CHARACTERISTIC
/begin CHARACTERISTIC AZCFCMX "Max. Anzahl Fahrzyklen, in denen Tankdeckel gepr¸ft werden kann" VALUE 0xFD484F KwWU8 255.0 dez 0.00 255.0 FORMAT "%5.1" /end CHARACTERISTIC
/begin CHARACTERISTIC CDCAKRE "Codewort CARB: Abgasklappe Endstufe" VAL_BLK 0xFD5D08 KwbWU16 65535.00 dez 0.00 65535.00 FORMAT "%8.2" NUMBER 4 /end CHARACTERISTIC
/begin CHARACTERISTIC CDCANSKE "Codewort CARB: Ansaugklappe Endstufe" VAL_BLK 0xFD5D10 KwbWU16 65535.00 dez 0.00 65535.00 FORMAT "%8.2" NUMBER 4 /end CHARACTERISTIC
/begin CHARACTERISTIC CDCCACC "Codewort CARB: CAN-Schnittstelle, Timeout ACC" VAL_BLK 0xFD5D50 KwbUw 65535.00 dez 0.00 65535.00 FORMAT "%8.2" NUMBER 4 /end CHARACTERISTIC
/begin CHARACTERISTIC CDCCAFS "Codewort CARB: Can-Schnittstelle, Timeout AFS" VAL_BLK 0xFD5D58 KwbWU16 65535.00 dez 0.00 65535.00 FORMAT "%8.2" NUMBER 4 /end CHARACTERISTIC
/begin CHARACTERISTIC CDCCANA "Codewort CARB: CAN-Schnittstelle, CANA-Diagnose" VAL_BLK 0xFD5D60 KwbWU16 65535.00 dez 0.00 65535.00 FORMAT "%8.2" NUMBER 4 /end CHARACTERISTIC
/begin CHARACTERISTIC CDCCANB "Codewort CARB: CAN-Schnittstelle, CANB-Diagnose" VAL_BLK 0xFD5D68 KwbWU16 65535.00 dez 0.00 65535.00 FORMAT "%8.2" NUMBER 4 /end CHARACTERISTIC
/begin CHARACTERISTIC CDCCUHR "" VAL_BLK 0xFD5DC0 KwbUw 65535.00 dez 0.00 65535.00 FORMAT "%8.2" NUMBER 4 /end CHARACTERISTIC
/begin CHARACTERISTIC CDCLSV "Codewort CARB: Lambda-Sonde vor Kat" VAL_BLK 0xFD6230 KwbWU16 65535.00 dez 0.00 65535.00 FORMAT "%8.2" NUMBER 4 /end CHARACTERISTIC
/begin CHARACTERISTIC CDCLSV2 "Codewort CARB: Lambda-Sonde 2 vor Kat" VAL_BLK 0xFD6238 KwbWU16 65535.00 dez 0.00 65535.00 FORMAT "%8.2" NUMBER 4 /end CHARACTERISTIC
/begin CHARACTERISTIC CDCSWE "Codewort CARB:	Beschleunigungssensor der Schlechtwegeerkennung" VAL_BLK 0xFD63C0 KwbWU16 65535.00 dez 0.00 65535.00 FORMAT "%8.2" NUMBER 4 /end CHARACTERISTIC
/begin CHARACTERISTIC CDCX135 "Codewort CARB: CAN-Schnittstelle ST_EKP_CRASHABSCHALTUNG" VAL_BLK 0xFD6498 KwbWU16 65535.00 dez 0.00 65535.00 FORMAT "%8.2" NUMBER 4 /end CHARACTERISTIC
/begin CHARACTERISTIC CDCX315 "Codewort CARB: CAN-Schnittstelle FAHRZEUGMODUS" VAL_BLK 0xFD64A0 KwbWU16 65535.00 dez 0.00 65535.00 FORMAT "%8.2" NUMBER 4 /end CHARACTERISTIC
/begin CHARACTERISTIC CDCX334 "Codewort CARB: CAN-Schnittstelle PWM_LADESPANNUNG" VAL_BLK 0xFD64A8 KwbWU16 65535.00 dez 0.00 65535.00 FORMAT "%8.2" NUMBER 4 /end CHARACTERISTIC
/begin CHARACTERISTIC CDCX3B0 "Codewort CARB: CAN-Schnittstelle ST_GANG_R‹CKWƒRTS" VAL_BLK 0xFD64B0 KwbWU16 65535.00 dez 0.00 65535.00 FORMAT "%8.2" NUMBER 4 /end CHARACTERISTIC
/begin CHARACTERISTIC CDCX3B4 "Codewort CARB: CAN-Schnittstelle PWM_BATTERIESPANNUNG" VAL_BLK 0xFD64B8 KwbWU16 65535.00 dez 0.00 65535.00 FORMAT "%8.2" NUMBER 4 /end CHARACTERISTIC
/begin CHARACTERISTIC CDCXC4 "Codewort CARB: CAN-Schnittstelle LENKRADWINKEL" VAL_BLK 0xFD64C0 KwbWU16 65535.00 dez 0.00 65535.00 FORMAT "%8.2" NUMBER 4 /end CHARACTERISTIC
/begin CHARACTERISTIC CDKAKRE "Codewort Kunde: Endstufe Abgasklappe" VALUE 0xFD64D2 KwWU16 65535.00 dez 0.00 65535.00 FORMAT "%8.2" /end CHARACTERISTIC
/begin CHARACTERISTIC CDKANSKE "Codewort Kunde: Ansaugklappe Endstufe" VALUE 0xFD64D4 KwWU16 65535.00 dez 0.00 65535.00 FORMAT "%8.2" /end CHARACTERISTIC
/begin CHARACTERISTIC CDKCACC "Codewort Kunde: CAN_ Timeout ACC- Botschaft" VALUE 0xFD64E4 KwUw 65535.00 dez 0.00 65535.00 FORMAT "%8.2" /end CHARACTERISTIC
/begin CHARACTERISTIC CDKCAFS "Codewort Kunde: CAN-Timeout AFS- Botschaft" VALUE 0xFD64E6 KwWU16 65535.00 dez 0.00 65535.00 FORMAT "%8.2" /end CHARACTERISTIC
/begin CHARACTERISTIC CDKCANA "Codewort Kunde: CANA-Diagnose" VALUE 0xFD64E8 KwWU16 65535.00 dez 0.00 65535.00 FORMAT "%8.2" /end CHARACTERISTIC
/begin CHARACTERISTIC CDKCANB "Codewort Kunde: CANB-Diagnose" VALUE 0xFD64EA KwWU16 65535.00 dez 0.00 65535.00 FORMAT "%8.2" /end CHARACTERISTIC
/begin CHARACTERISTIC CDKCUHR "" VALUE 0xFD6500 KwUw 65535.00 dez 0.00 65535.00 FORMAT "%8.2" /end CHARACTERISTIC
/begin CHARACTERISTIC CDKLSV "Codewort Kunde:	Lambda-Sonde vor Kat" VALUE 0xFD661C KwWU16 65535.00 dez 0.00 65535.00 FORMAT "%8.2" /end CHARACTERISTIC
/begin CHARACTERISTIC CDKLSV2 "Codewort Kunde:	Lambda-Sonde 2 vor Kat" VALUE 0xFD661E KwWU16 65535.00 dez 0.00 65535.00 FORMAT "%8.2" /end CHARACTERISTIC
/begin CHARACTERISTIC CDKSWE "Codewort Kunde:	Beschleunigungssensor der Schlechtwegeerkennung" VALUE 0xFD6680 KwWU16 65535.00 dez 0.00 65535.00 FORMAT "%8.2" /end CHARACTERISTIC
/begin CHARACTERISTIC CDKX135 "Codewort Kunde: CAN-Schnittstelle ST_EKP_CRASHABSCHALTUNG" VALUE 0xFD66B6 KwWU16 65535.00 dez 0.00 65535.00 FORMAT "%8.2" /end CHARACTERISTIC
/begin CHARACTERISTIC CDKX315 "Codewort Kunde: CAN-Schnittstelle FAHRZEUGMODUS" VALUE 0xFD66B8 KwWU16 65535.00 dez 0.00 65535.00 FORMAT "%8.2" /end CHARACTERISTIC
/begin CHARACTERISTIC CDKX334 "Codewort Kunde: CAN-Schnittstelle PWM_LADESPANNUNG" VALUE 0xFD66BA KwWU16 65535.00 dez 0.00 65535.00 FORMAT "%8.2" /end CHARACTERISTIC
/begin CHARACTERISTIC CDKX3B0 "Codewort Kunde: CAN-Schnittstelle ST_GANG_R‹CKWƒRTS" VALUE 0xFD66BC KwWU16 65535.00 dez 0.00 65535.00 FORMAT "%8.2" /end CHARACTERISTIC
/begin CHARACTERISTIC CDKX3B4 "Codewort Kunde: CAN-Schnittstelle PWM_BATTERIESPANNUNG" VALUE 0xFD66BE KwWU16 65535.00 dez 0.00 65535.00 FORMAT "%8.2" /end CHARACTERISTIC
/begin CHARACTERISTIC CDKXC4 "Codewort Kunde: CAN-Schnittstelle LENKRADWINKEL" VALUE 0xFD66C0 KwWU16 65535.00 dez 0.00 65535.00 FORMAT "%8.2" /end CHARACTERISTIC
/begin CHARACTERISTIC CDTAKRE "Codewort Tester: Abgasklappe Endstufe" VALUE 0xFD66C6 KwWU16 65535.00 dez 0.00 65535.00 FORMAT "%8.2" /end CHARACTERISTIC
/begin CHARACTERISTIC CDTANSKE "Codewort Tester: Ansaugklappe Endstufe" VALUE 0xFD66C8 KwWU16 65535.00 dez 0.00 65535.00 FORMAT "%8.2" /end CHARACTERISTIC
/begin CHARACTERISTIC CDTCACC "Codewort Tester: CAN-Schnittstelle, Timeout ACC" VALUE 0xFD66D8 KwUw 65535.00 dez 0.00 65535.00 FORMAT "%8.2" /end CHARACTERISTIC
/begin CHARACTERISTIC CDTCAFS "Codewort Tester: CAN-Schnittstelle, Timeout AFS" VALUE 0xFD66DA KwWU16 65535.00 dez 0.00 65535.00 FORMAT "%8.2" /end CHARACTERISTIC
/begin CHARACTERISTIC CDTCANA "Codewort Tester: CAN-Schnittstelle, CANA-Diagnose" VALUE 0xFD66DC KwWU16 65535.00 dez 0.00 65535.00 FORMAT "%8.2" /end CHARACTERISTIC
/begin CHARACTERISTIC CDTCANB "Codewort Tester: CAN-Schnittstelle, CANB-Diagnose" VALUE 0xFD66DE KwWU16 65535.00 dez 0.00 65535.00 FORMAT "%8.2" /end CHARACTERISTIC
/begin CHARACTERISTIC CDTCUHR "" VALUE 0xFD66F4 KwUw 65535.00 dez 0.00 65535.00 FORMAT "%8.2" /end CHARACTERISTIC
/begin CHARACTERISTIC CDTLSV "Codewort Tester: Lambda-Sonde vor Kat" VALUE 0xFD6810 KwWU16 65535.00 dez 0.00 65535.00 FORMAT "%8.2" /end CHARACTERISTIC
/begin CHARACTERISTIC CDTLSV2 "Codewort Tester: Lambda-Sonde 2 vor Kat" VALUE 0xFD6812 KwWU16 65535.00 dez 0.00 65535.00 FORMAT "%8.2" /end CHARACTERISTIC
/begin CHARACTERISTIC CDTSWE "Codewort Tester: Beschleunigungssensor Schlechtwegeerk." VALUE 0xFD6874 KwWU16 65535.00 dez 0.00 65535.00 FORMAT "%8.2" /end CHARACTERISTIC
/begin CHARACTERISTIC CDTX135 "Codewort Tester: CAN-Schnittstelle ST_EKP_CRASHABSCHALTUNG" VALUE 0xFD68AA KwWU16 65535.00 dez 0.00 65535.00 FORMAT "%8.2" /end CHARACTERISTIC
/begin CHARACTERISTIC CDTX315 "Codewort Tester: CAN-Schnittstelle FAHRZEUGMODUS" VALUE 0xFD68AC KwWU16 65535.00 dez 0.00 65535.00 FORMAT "%8.2" /end CHARACTERISTIC
/begin CHARACTERISTIC CDTX334 "Codewort Tester: CAN-Schnittstelle PWM_LADESPANNUNG" VALUE 0xFD68AE KwWU16 65535.00 dez 0.00 65535.00 FORMAT "%8.2" /end CHARACTERISTIC
/begin CHARACTERISTIC CDTX3B0 "Codewort Tester: CAN-Schnittstelle ST_GANG_R‹CKWƒRTS" VALUE 0xFD68B0 KwWU16 65535.00 dez 0.00 65535.00 FORMAT "%8.2" /end CHARACTERISTIC
/begin CHARACTERISTIC CDTX3B4 "Codewort Tester: CAN-Schnittstelle PWM_BATTERIESPANNUNG" VALUE 0xFD68B2 KwWU16 65535.00 dez 0.00 65535.00 FORMAT "%8.2" /end CHARACTERISTIC
/begin CHARACTERISTIC CDTXC4 "Codewort Tester: CAN-Schnittstelle LENKRADWINKEL" VALUE 0xFD68B4 KwWU16 65535.00 dez 0.00 65535.00 FORMAT "%8.2" /end CHARACTERISTIC
/begin CHARACTERISTIC CIDDMTK "Component ID f¸r 0.5 mm Tankleckpr¸fung" VALUE 0xFD4859 KwWU8 255.0 dez 0.00 255.0 FORMAT "%5.1" /end CHARACTERISTIC
/begin CHARACTERISTIC CIDDMTL "Component ID f¸r DMTL-Komponentenpr¸fung (Bereichs-Fehler)" VALUE 0xFD485A KwWU8 255.0 dez 0.00 255.0 FORMAT "%5.1" /end CHARACTERISTIC
/begin CHARACTERISTIC CIDDMTNP "Component ID f¸r Plausibilit‰tspr¸fung" VALUE 0xFD485B KwWU8 255.0 dez 0.00 255.0 FORMAT "%5.1" /end CHARACTERISTIC
/begin CHARACTERISTIC CIDDMTSG "Component ID f¸r Komponentenpr¸fung (Signalfehler)" VALUE 0xFD485C KwWU8 255.0 dez 0.00 255.0 FORMAT "%5.1" /end CHARACTERISTIC
/begin CHARACTERISTIC CIDTESG "Component ID f¸r Grobleckdiagnose" VALUE 0xFD485D KwWU8 255.0 dez 0.00 255.0 FORMAT "%5.1" /end CHARACTERISTIC
/begin CHARACTERISTIC CL30LINE "30. Linie der Klassentabelle" VAL_BLK 0xFD6A5C KwbUb 255.0 dez 0.00 255.0 FORMAT "%5.1" NUMBER 14 /end CHARACTERISTIC
/begin CHARACTERISTIC CL31LINE "31. Linie der Klassentabelle" VAL_BLK 0xFD6A6A KwbUb 255.0 dez 0.00 255.0 FORMAT "%5.1" NUMBER 14 /end CHARACTERISTIC
/begin CHARACTERISTIC CL32LINE "32. Linie der Klassentabelle" VAL_BLK 0xFD6A78 KwbUb 255.0 dez 0.00 255.0 FORMAT "%5.1" NUMBER 14 /end CHARACTERISTIC
/begin CHARACTERISTIC CL33LINE "33. Linie der Klassentabelle" VAL_BLK 0xFD6A86 KwbUb 255.0 dez 0.00 255.0 FORMAT "%5.1" NUMBER 14 /end CHARACTERISTIC
/begin CHARACTERISTIC CL34LINE "34. Linie der Klassentabelle" VAL_BLK 0xFD6A94 KwbUb 255.0 dez 0.00 255.0 FORMAT "%5.1" NUMBER 14 /end CHARACTERISTIC
/begin CHARACTERISTIC CL35LINE "35. Linie der Klassentabelle" VAL_BLK 0xFD6AA2 KwbUb 255.0 dez 0.00 255.0 FORMAT "%5.1" NUMBER 14 /end CHARACTERISTIC
/begin CHARACTERISTIC CL36LINE "36. Linie der Klassentabelle" VAL_BLK 0xFD6AB0 KwbUb 255.0 dez 0.00 255.0 FORMAT "%5.1" NUMBER 14 /end CHARACTERISTIC
/begin CHARACTERISTIC CL37LINE "37. Linie der Klassentabelle" VAL_BLK 0xFD6ABE KwbUb 255.0 dez 0.00 255.0 FORMAT "%5.1" NUMBER 14 /end CHARACTERISTIC
/begin CHARACTERISTIC CL38LINE "38. Linie der Klassentabelle" VAL_BLK 0xFD6ACC KwbUb 255.0 dez 0.00 255.0 FORMAT "%5.1" NUMBER 14 /end CHARACTERISTIC
/begin CHARACTERISTIC CL39LINE "39. Linie der Klassentabelle" VAL_BLK 0xFD6ADA KwbUb 255.0 dez 0.00 255.0 FORMAT "%5.1" NUMBER 14 /end CHARACTERISTIC
/begin CHARACTERISTIC CLAAKRE "Fehlerklasse: Abgasklappe Endstufe" VALUE 0xFD5724 KwWU8 255.0 dez 0.00 255.0 FORMAT "%5.1" /end CHARACTERISTIC
/begin CHARACTERISTIC CLAANSKE "Fehlerklasse: Ansaugklappe Endstufe" VALUE 0xFD5725 KwWU8 255.0 dez 0.00 255.0 FORMAT "%5.1" /end CHARACTERISTIC
/begin CHARACTERISTIC CLACACC "Fehlerklasse: CAN-Timeout ACC-Botschaft" VALUE 0xFD572D KwUb 255.0 dez 0.00 255.0 FORMAT "%5.1" /end CHARACTERISTIC
/begin CHARACTERISTIC CLACAFS "Fehlerklasse: CAN-Timeout AFS-Botschaft" VALUE 0xFD572E KwWU8 255.0 dez 0.00 255.0 FORMAT "%5.1" /end CHARACTERISTIC
/begin CHARACTERISTIC CLACANA "Fehlerklasse: CANA-Diagnose" VALUE 0xFD572F KwWU8 255.0 dez 0.00 255.0 FORMAT "%5.1" /end CHARACTERISTIC
/begin CHARACTERISTIC CLACANB "Fehlerklasse: CANB-Diagnose" VALUE 0xFD5730 KwWU8 255.0 dez 0.00 255.0 FORMAT "%5.1" /end CHARACTERISTIC
/begin CHARACTERISTIC CLACUHR "" VALUE 0xFD573B KwUb 255.0 dez 0.00 255.0 FORMAT "%5.1" /end CHARACTERISTIC
/begin CHARACTERISTIC CLALSV "Fehlerklasse: Lambdasonde vor Kat" VALUE 0xFD57C9 KwWU8 255.0 dez 0.00 255.0 FORMAT "%5.1" /end CHARACTERISTIC
/begin CHARACTERISTIC CLALSV2 "Fehlerklasse: Lambdasonde 2 vor Kat" VALUE 0xFD57CA KwWU8 255.0 dez 0.00 255.0 FORMAT "%5.1" /end CHARACTERISTIC
/begin CHARACTERISTIC CLASWE "Fehlerklasse: Beschleunigungssensor der Schlechtwegerkennung" VALUE 0xFD57FB KwWU8 255.0 dez 0.00 255.0 FORMAT "%5.1" /end CHARACTERISTIC
/begin CHARACTERISTIC CLAX135 "Fehlerklasse: CAN-ST_EKP_CRASHABSCHALTUNG-Botschaft" VALUE 0xFD5816 KwWU8 255.0 dez 0.00 255.0 FORMAT "%5.1" /end CHARACTERISTIC
/begin CHARACTERISTIC CLAX315 "Fehlerklasse: CAN-FAHRZEUGMODUS-Botschaft" VALUE 0xFD5817 KwWU8 255.0 dez 0.00 255.0 FORMAT "%5.1" /end CHARACTERISTIC
/begin CHARACTERISTIC CLAX334 "Fehlerklasse: CAN-PWM_LADESPANNUNG-Botschaft" VALUE 0xFD5818 KwWU8 255.0 dez 0.00 255.0 FORMAT "%5.1" /end CHARACTERISTIC
/begin CHARACTERISTIC CLAX3B0 "Fehlerklasse: CAN-ST_GANG_R‹CKWƒRTS-Botschaft" VALUE 0xFD5819 KwWU8 255.0 dez 0.00 255.0 FORMAT "%5.1" /end CHARACTERISTIC
/begin CHARACTERISTIC CLAX3B4 "Fehlerklasse: CAN-PWM_BATTERIESPANNUNG-Botschaft" VALUE 0xFD581A KwWU8 255.0 dez 0.00 255.0 FORMAT "%5.1" /end CHARACTERISTIC
/begin CHARACTERISTIC CLAXC4 "Fehlerklasse: CAN-LENKRADWINKEL-Botschaft" VALUE 0xFD581B KwWU8 255.0 dez 0.00 255.0 FORMAT "%5.1" /end CHARACTERISTIC
/begin CHARACTERISTIC CORTINC "Wert der bei Zahnkorrektur aufaddiert wird" VALUE 0xFC1D9C KwWU8 255.0 dez 0.00 255.0 FORMAT "%5.1" /end CHARACTERISTIC
/begin CHARACTERISTIC CORTINIT "Initialisierungswert f¸r Z‰hler Zahnkorrektur" VALUE 0xFC1D9D KwWU8 255.0 dez 0.00 255.0 FORMAT "%5.1" /end CHARACTERISTIC
/begin CHARACTERISTIC CORTMX "Maximal zul‰ssiger Wert f¸r den Zahnkorrekturz‰hler" VALUE 0xFCFA28 KwWU8 255.0 dez 0.00 255.0 FORMAT "%5.1" /end CHARACTERISTIC
/begin CHARACTERISTIC CWAFS "Codewort f¸r Umschaltung Ist/Soll-Moment AFS" VALUE 0xFCF7E2 KwUb 255.0 dez 0.00 255.0 FORMAT "%5.1" /end CHARACTERISTIC
/begin CHARACTERISTIC CWCFCEO "Codewort f¸r DCFCEO" VALUE 0xFD4850 KwWU8 255.0 dez 0.00 255.0 FORMAT "%5.1" /end CHARACTERISTIC
/begin CHARACTERISTIC CWDDISA "Codewort Diagnose Disa" VALUE 0xFC2396 KwWU8 255.0 dez 0.00 255.0 FORMAT "%5.1" /end CHARACTERISTIC
/begin CHARACTERISTIC CWDEGFE "Codewort f¸r Abschaltung der Funktion %DEGFE" VALUE 0xFD0DCC KwUb 255.0 dez 0.00 255.0 FORMAT "%5.1" /end CHARACTERISTIC
/begin CHARACTERISTIC CWDFPDMTL "Codewort Tankleckdiagnose Fehlerpfadmanagement" VALUE 0xFD4866 KwWU8 255.0 dez 0.00 255.0 FORMAT "%5.1" /end CHARACTERISTIC
/begin CHARACTERISTIC CWDMTDD "Codewort f¸r Anforderung einer Wegstreckenentprellung" VALUE 0xFD4860 KwWU16 65535.00 dez 0.00 65535.00 FORMAT "%8.2" /end CHARACTERISTIC
/begin CHARACTERISTIC CWFGDCAN "Applikationscodewort zum Freigeben der CAN-Diagnosen" VALUE 0xFCF7E6 KwWU16 65535.00 dez 0.00 65535.00 FORMAT "%8.2" /end CHARACTERISTIC
/begin CHARACTERISTIC CWFLC "Codewort f¸r Steuerung MIL-ON entsprechend OBDII / EOBD" VALUE 0xFC14AF KwUb 255.0 dez 0.00 255.0 FORMAT "%5.1" /end CHARACTERISTIC
/begin CHARACTERISTIC CWPSAKRE "Codewort f¸r Endstufendiagnose ECO-Lenkhilfpumpe" VALUE 0xFD055C KwWU8 255.0 dez 0.00 255.0 FORMAT "%5.1" /end CHARACTERISTIC
/begin CHARACTERISTIC CWPSANSKE "Codewort f¸r Endstufe Ansaugklappe" VALUE 0xFD055D KwWU8 255.0 dez 0.00 255.0 FORMAT "%5.1" /end CHARACTERISTIC
/begin CHARACTERISTIC CWPSDMMVE "Codewort f¸r aktive Endstufendiagnose DM-TL Magnetventil" VALUE 0xFD055E KwWU8 255.0 dez 0.00 255.0 FORMAT "%5.1" /end CHARACTERISTIC
/begin CHARACTERISTIC CWPSDMPME "Codewort f¸r aktive Endstufendiagnose DM-TL Pumpe" VALUE 0xFD055F KwWU8 255.0 dez 0.00 255.0 FORMAT "%5.1" /end CHARACTERISTIC
/begin CHARACTERISTIC CWPSDPMEE "Codewort f¸r aktive Endstufendiagnose DM-TL Pumpe (nur mn- und si-Fehler)" VALUE 0xFD0560 KwWU8 255.0 dez 0.00 255.0 FORMAT "%5.1" /end CHARACTERISTIC
/begin CHARACTERISTIC CWPSELS "Kodewort zum Abschalten der Endstufediagnose E-Box L¸fter" VALUE 0xFD0563 KwWU8 255.0 dez 0.00 255.0 FORMAT "%5.1" /end CHARACTERISTIC
/begin CHARACTERISTIC CWPSEVE "Codewort f¸r Endstufendiagnose EV" VALUE 0xFD0568 KwWU8 255.0 dez 0.00 255.0 FORMAT "%5.1" /end CHARACTERISTIC
/begin CHARACTERISTIC CWPSKPE "Codewort f¸r Endstufendiagnose EKP" VALUE 0xFD0565 KwWU8 255.0 dez 0.00 255.0 FORMAT "%5.1" /end CHARACTERISTIC
/begin CHARACTERISTIC DEAVANOS "Funkionsschalter Diagnose" VALUE 0xFCCAC2 KwWU8 255.0 dez 0.00 255.0 FORMAT "%5.1" /end CHARACTERISTIC
/begin CHARACTERISTIC DFSTMX "Maximale Differenz zwischen F¸llstandsgeber und gefiltertem Wert f¸r CFC" VALUE 0xFD4838 KwWU16 6553.500 vol_q0p1_l 0.00 6553.500 FORMAT "%8.3" /end CHARACTERISTIC
/begin CHARACTERISTIC DIFTANS "Multiplikativer Faktor f¸r Ansauglufttemperatur" VALUE 0xFD081C KwUb 3.000 fak_q0p0625 0.00 3.000 FORMAT "%5.3" /end CHARACTERISTIC
/begin CHARACTERISTIC DIOTANS "Untere Grenze Ansaugtemp." VALUE 0xFD0820 KwSw 60.00000 temp_sw_q0p1 -30.00000 30.00000 FORMAT "%8.5" /end CHARACTERISTIC
/begin CHARACTERISTIC DISAPOTIMN "Minimal mˆgliche Potispannung" VALUE 0xFD0822 KwUw 319.9951 spg_uw_b5 0.00 319.9951 FORMAT "%8.4" /end CHARACTERISTIC
/begin CHARACTERISTIC DISAPOTIMX "Maximal mˆgliche Potispannung" VALUE 0xFD0824 KwUw 319.9951 spg_uw_b5 0.00 319.9951 FORMAT "%8.4" /end CHARACTERISTIC
/begin CHARACTERISTIC DISAPRELL "Entprellzeit fuer Warnungen und Fehler" VALUE 0xFD081D KwUb 5.100 t20msxs_ub_b5p1 0.00 5.100 FORMAT "%5.3" /end CHARACTERISTIC
/begin CHARACTERISTIC DISAREGDME "Maximal erlaubte Regeldifferenz bei krit. DISA Stellmotor" VALUE 0xFD0826 KwUw 199.997 vnstv_q0p00305 0.00 199.997 FORMAT "%7.3" /end CHARACTERISTIC
/begin CHARACTERISTIC DISAREGDMX "Maximal erlaubte Regeldifferenz" VALUE 0xFD0828 KwUw 199.997 vnstv_q0p00305 0.00 199.997 FORMAT "%7.3" /end CHARACTERISTIC
/begin CHARACTERISTIC DITEMPHYST "Temperaturschwelle fuer Wicklungsuebertemperatur" VALUE 0xFD082A KwSw 6553.500 temp_sw_q0p1 -3276.800 3276.700 FORMAT "%8.3" /end CHARACTERISTIC
/begin CHARACTERISTIC DITEMPINI1 "Initialisierungstemperatur fuer Wicklungsuebertemperatur DISA-Stellmotor" VALUE 0xFD082C KwSw 6553.500 temp_sw_q0p1 -3276.800 3276.700 FORMAT "%8.3" /end CHARACTERISTIC
/begin CHARACTERISTIC DITEMPINI2 "InitialisierungstemperaturTemperaturschwelle fuer Wicklungsuebertemperatur DISA-" VALUE 0xFD082E KwSw 6553.500 temp_sw_q0p1 -3276.800 3276.700 FORMAT "%8.3" /end CHARACTERISTIC
/begin CHARACTERISTIC DITEMPMOT "Temperaturschwelle fuer Wicklungsuebertemperatur DISA-Stellmotor" VALUE 0xFD0830 KwSw 6553.500 temp_sw_q0p1 -3276.800 3276.700 FORMAT "%8.3" /end CHARACTERISTIC
/begin CHARACTERISTIC DITEMPWARN "Temperaturwarnschwelle fuer Wicklungsuebertemperatur DISA-Stellmotor" VALUE 0xFD0832 KwSw 6553.500 temp_sw_q0p1 -3276.800 3276.700 FORMAT "%8.3" /end CHARACTERISTIC
/begin CHARACTERISTIC DMARSILL "Deltamoment f¸r Aufweitung Istmomentendiagnose ARS" VALUE 0xFC12FA KwWU8 127.5 md_q0p5 0.00 127.5 FORMAT "%5.1" /end CHARACTERISTIC
/begin CHARACTERISTIC DMARSSLL "Deltamoment f¸r Aufweitung Sollmomentendiagnose ARS" VALUE 0xFC12FB KwWU8 127.5 md_q0p5 0.00 127.5 FORMAT "%5.1" /end CHARACTERISTIC
/begin CHARACTERISTIC DMKSSGME "Delta Kupplungsmoment f¸r ‹berwachung Momenteneingriff" VALUE 0xFC130A KwWS16 32767.50 md_q0p5 -16384.00 16383.50 FORMAT "%8.2" /end CHARACTERISTIC
/begin CHARACTERISTIC DMRLSV "Momentenreserve f¸r Diagnose Lambdasonde vor Kat" VALUE 0xFD00E8 KwUw 99.99847 rel_uw_b100 0.00 99.99847 FORMAT "%8.5" /end CHARACTERISTIC
/begin CHARACTERISTIC DRLMXW "Schwelle f¸r Last‰nderung (16Bit)" VALUE 0xFD00EA KwUw 1535.977 rel_uw_q0p0234 0.00 1535.977 FORMAT "%8.3" /end CHARACTERISTIC
/begin CHARACTERISTIC DVFZGMX "Maximale Geschwindigkeitsdifferenz in 100 ms" VALUE 0xFD483A KwWU16 511.9922 vfzg_uw_b512 0.00 511.9922 FORMAT "%8.4" /end CHARACTERISTIC
/begin CHARACTERISTIC DYNLSUFA "Grenzwert f¸r LSU-Dynamik bei Kurztest" VALUE 0xFD00EC KwUw 15.99976 fak_uw_b16 0.00 15.99976 FORMAT "%8.5" /end CHARACTERISTIC
/begin CHARACTERISTIC DYNLSUMX "Grenzwert f¸r LSU-Dynamik" VALUE 0xFD00EE KwUw 15.99976 fak_uw_b16 0.00 15.99976 FORMAT "%8.5" /end CHARACTERISTIC
/begin CHARACTERISTIC DYNLSURD "reduzierter Grenzwert f¸r LSU-Dynamik" VALUE 0xFD00F0 KwUw 15.99976 fak_uw_b16 0.00 15.99976 FORMAT "%8.5" /end CHARACTERISTIC
/begin CHARACTERISTIC EKPFA "Anzahl Verifikationen zur Fehlerentprellung in der Endstufendiagnose EKP-Relais" VALUE 0xFD0566 KwWU8 255.0 dez 0.00 255.0 FORMAT "%5.1" /end CHARACTERISTIC
/begin CHARACTERISTIC EKPPA "Anzahl Pr¸fpulsausgaben in der Endstufendiagnose EKP-Relais" VALUE 0xFD0567 KwWU8 255.0 dez 0.00 255.0 FORMAT "%5.1" /end CHARACTERISTIC
/begin CHARACTERISTIC FDMDARS "Faktor f¸r Wichtung Deltamoment f¸r Pr‰diktion ARS-Moment" VALUE 0xFC12FC KwWU8 0.9961 fak_ub_b1 0.00 0.9961 /end CHARACTERISTIC
/begin CHARACTERISTIC FDMDARSS "Faktor f¸r Wichtung Momentengradient f¸r Pr‰diktion ARS-Moment" VALUE 0xFC12FD KwWU8 15.94 fak_ub_b16 0.00 15.94 FORMAT "%5.2" /end CHARACTERISTIC
/begin CHARACTERISTIC FFTAKRE "Freeze Frame Tabelle: Abgasklappe Endstufe" VAL_BLK 0xFD5821 KwbWU8 255.0 dez 0.00 255.0 FORMAT "%5.1" NUMBER 4 /end CHARACTERISTIC
/begin CHARACTERISTIC FFTANSKE "Freeze Frame Tabelle: Ansaugklappe Endstufe" VAL_BLK 0xFD5825 KwbWU8 255.0 dez 0.00 255.0 FORMAT "%5.1" NUMBER 4 /end CHARACTERISTIC
/begin CHARACTERISTIC FFTCACC "Freeze Frame Tabelle: CAN-Timeout ACC-Botschaft" VAL_BLK 0xFD5845 KwbUb 255.0 dez 0.00 255.0 FORMAT "%5.1" NUMBER 4 /end CHARACTERISTIC
/begin CHARACTERISTIC FFTCAFS "Freeze Frame Tabelle: CAN-Timeout AFS-Botschaft" VAL_BLK 0xFD5849 KwbWU8 255.0 dez 0.00 255.0 FORMAT "%5.1" NUMBER 4 /end CHARACTERISTIC
/begin CHARACTERISTIC FFTCANA "Freeze Frame Tabelle: CANA-Diagnose" VAL_BLK 0xFD584D KwbWU8 255.0 dez 0.00 255.0 FORMAT "%5.1" NUMBER 4 /end CHARACTERISTIC
/begin CHARACTERISTIC FFTCANB "Freeze Frame Tabelle: CANB-Diagnose" VAL_BLK 0xFD5851 KwbWU8 255.0 dez 0.00 255.0 FORMAT "%5.1" NUMBER 4 /end CHARACTERISTIC
/begin CHARACTERISTIC FFTCUHR "" VAL_BLK 0xFD587D KwbUb 255.0 dez 0.00 255.0 FORMAT "%5.1" NUMBER 4 /end CHARACTERISTIC
/begin CHARACTERISTIC FFTLSV "Tabelle Umweltbedingungen: Lambdasonde vor Kat" VAL_BLK 0xFD5AB5 KwbWU8 255.0 dez 0.00 255.0 FORMAT "%5.1" NUMBER 4 /end CHARACTERISTIC
/begin CHARACTERISTIC FFTLSV2 "Tabelle Umweltbedingungen: Lambdasonde vor Kat Bank2" VAL_BLK 0xFD5AB9 KwbWU8 255.0 dez 0.00 255.0 FORMAT "%5.1" NUMBER 4 /end CHARACTERISTIC
/begin CHARACTERISTIC FFTSWE "Freeze Frame Tabelle: Beschleunigungssensor Schlechtwegeerk." VAL_BLK 0xFD5B7D KwbWU8 255.0 dez 0.00 255.0 FORMAT "%5.1" NUMBER 4 /end CHARACTERISTIC
/begin CHARACTERISTIC FFTX135 "Freeze Frame Tabelle: CAN-ST_EKP_CRASHABSCHALTUNG-Botschaft" VAL_BLK 0xFD5BE9 KwbWU8 255.0 dez 0.00 255.0 FORMAT "%5.1" NUMBER 4 /end CHARACTERISTIC
/begin CHARACTERISTIC FFTX315 "Freeze Frame Tabelle: CAN-FAHRZEUGMODUS-Botschaft" VAL_BLK 0xFD5BED KwbWU8 255.0 dez 0.00 255.0 FORMAT "%5.1" NUMBER 4 /end CHARACTERISTIC
/begin CHARACTERISTIC FFTX334 "Freeze Frame Tabelle: CAN-PWM_LADESPANNUNG-Botschaft" VAL_BLK 0xFD5BF1 KwbWU8 255.0 dez 0.00 255.0 FORMAT "%5.1" NUMBER 4 /end CHARACTERISTIC
/begin CHARACTERISTIC FFTX3B0 "Freeze Frame Tabelle: CAN-ST_GANG_R‹CKWƒRTS-Botschaft" VAL_BLK 0xFD5BF5 KwbWU8 255.0 dez 0.00 255.0 FORMAT "%5.1" NUMBER 4 /end CHARACTERISTIC
/begin CHARACTERISTIC FFTX3B4 "Freeze Frame Tabelle: CAN-PWM_BATTERIESPANNUNG-Botschaft" VAL_BLK 0xFD5BF9 KwbWU8 255.0 dez 0.00 255.0 FORMAT "%5.1" NUMBER 4 /end CHARACTERISTIC
/begin CHARACTERISTIC FFTXC4 "Freeze Frame Tabelle: CAN-LENKRADWINKEL-Botschaft" VAL_BLK 0xFD5BFD KwbWU8 255.0 dez 0.00 255.0 FORMAT "%5.1" NUMBER 4 /end CHARACTERISTIC
/begin CHARACTERISTIC FTEDYLSUMX "max. Beladung (Faktor) ab der keine Dynamikdiagnose mehr laufen darf" VALUE 0xFC204E KwSb 127.5 fak_sb_b64 -64.00 63.50 FORMAT "%5.2" /end CHARACTERISTIC
/begin CHARACTERISTIC IVDYNLSU "Startwert f¸r dynlsu_w" VALUE 0xFD00F2 KwUw 15.99976 fak_uw_b16 0.00 15.99976 FORMAT "%8.5" /end CHARACTERISTIC
/begin CHARACTERISTIC KDISADELTA "Faktor f¸r Tiefpaﬂfilter Regeldifferenz" VALUE 0xFD0834 KwUw 199.997 vnstv_q0p00305 0.00 199.997 FORMAT "%7.3" /end CHARACTERISTIC
/begin CHARACTERISTIC KDYNFA "Rekursionskonstante f¸r LSU-Dynamik bei Kurztest" VALUE 0xFD00F4 KwUw 0.9999847 fak_uw_b1 0.00 0.9999847 FORMAT "%9.7" /end CHARACTERISTIC
/begin CHARACTERISTIC KDYNLSU "Rekursionskonstante f¸r LSU-Dynamik" VALUE 0xFD00F6 KwUw 0.9999847 fak_uw_b1 0.00 0.9999847 FORMAT "%9.7" /end CHARACTERISTIC
/begin CHARACTERISTIC KFAFSERR "Kennfeld Momentenvorhalt bei Error AFS" MAP 0xFCF552 KfAxU8AyU8SstxS16SstyU16WU16 99.99847 rel_uw_b100 0.00 99.99847 FORMAT "%8.5"
 /begin AXIS_DESCR STD_AXIS lws_w lws_q0p04375 6 -1433.600 1433.556 FORMAT "%8.3" DEPOSIT ABSOLUTE /end AXIS_DESCR
 /begin AXIS_DESCR STD_AXIS vfzg_w vfzg_uw_b512 5 0.00 511.9922 FORMAT "%8.4" DEPOSIT ABSOLUTE /end AXIS_DESCR
/end CHARACTERISTIC
/begin CHARACTERISTIC KFAFSMDLW "Kennfeld Faktor Verlustmoment kein AFS verbaut" MAP 0xFCF5A6 KfAxU8AyU8SstxS16SstyS16WS16 1.999939 fak_sw_b2 0.00 1.999939 FORMAT "%8.6"
 /begin AXIS_DESCR STD_AXIS lws_w lws_q0p04375 6 -1433.600 1433.556 FORMAT "%8.3" DEPOSIT ABSOLUTE /end AXIS_DESCR
 /begin AXIS_DESCR STD_AXIS vlws_w lws_q0p04375 6 -1433.600 1433.556 FORMAT "%8.3" DEPOSIT ABSOLUTE /end AXIS_DESCR
/end CHARACTERISTIC
/begin CHARACTERISTIC KFAFSMDMN "Kennfeld Momentenplausibilisierung AFS" MAP 0xFCF60A KfAxU8AyU8SstxS16SstyU16WU16 99.99847 rel_uw_b100 0.00 99.99847 FORMAT "%8.5"
 /begin AXIS_DESCR STD_AXIS lws_w lws_q0p04375 6 -1433.600 1433.556 FORMAT "%8.3" DEPOSIT ABSOLUTE /end AXIS_DESCR
 /begin AXIS_DESCR STD_AXIS vfzg_w vfzg_uw_b512 5 0.00 511.9922 FORMAT "%8.4" DEPOSIT ABSOLUTE /end AXIS_DESCR
/end CHARACTERISTIC
/begin CHARACTERISTIC KFAFSMDV "Kennfeld Verlustmoment in abh. geschwindigkeit" MAP 0xFCF65E KfAxU8AyU8SstxU16SstyU16WU16 1.999969 fak_uw_b2 0.00 1.999969 FORMAT "%8.6"
 /begin AXIS_DESCR STD_AXIS nmot_w nmot_uw_q0p25 6 0.00 16383.75 FORMAT "%8.2" DEPOSIT ABSOLUTE /end AXIS_DESCR
 /begin AXIS_DESCR STD_AXIS vfzg_w vfzg_uw_b512 5 0.00 511.9922 FORMAT "%8.4" DEPOSIT ABSOLUTE /end AXIS_DESCR
/end CHARACTERISTIC
/begin CHARACTERISTIC KFAFSVHMD "Kennfeld relativer Momentenvorhalt AFS" MAP 0xFCF6B4 KfAxU8AyU8SstxS16SstyU16WU16 99.99847 rel_uw_b100 0.00 99.99847 FORMAT "%8.5"
 /begin AXIS_DESCR STD_AXIS lws_w lws_q0p04375 6 -1433.600 1433.556 FORMAT "%8.3" DEPOSIT ABSOLUTE /end AXIS_DESCR
 /begin AXIS_DESCR STD_AXIS miafs_w rel_uw_b100 6 0.00 99.99847 FORMAT "%8.5" DEPOSIT ABSOLUTE /end AXIS_DESCR
/end CHARACTERISTIC
/begin CHARACTERISTIC KFAFSVLMD "Kennfeld Verlustmoment in abh. Lenkwinkel" MAP 0xFCF716 KfAxU8AyU8SstxS16SstyS16WS16 1.999939 fak_sw_b2 0.00 1.999939 FORMAT "%8.6"
 /begin AXIS_DESCR STD_AXIS lws_w lws_q0p04375 6 -1433.600 1433.556 FORMAT "%8.3" DEPOSIT ABSOLUTE /end AXIS_DESCR
 /begin AXIS_DESCR STD_AXIS vlws_w lws_q0p04375 6 -1433.600 1433.556 FORMAT "%8.3" DEPOSIT ABSOLUTE /end AXIS_DESCR
/end CHARACTERISTIC
/begin CHARACTERISTIC KFMDARSI "Kennfeld Umrechnung ARS-Istmoment" MAP 0xFC11F6 KfAxU8AyU8SstxU16SstyU16WU16 99.99847 rel_uw_b100 0.00 99.99847 FORMAT "%8.5"
 /begin AXIS_DESCR STD_AXIS nmot_w nmot_uw_q0p25 5 0.00 16383.75 FORMAT "%8.2" DEPOSIT ABSOLUTE /end AXIS_DESCR
 /begin AXIS_DESCR STD_AXIS mdarsi_w md_q0p002 4 0.00 127.9980 FORMAT "%8.4" DEPOSIT ABSOLUTE /end AXIS_DESCR
/end CHARACTERISTIC
/begin CHARACTERISTIC KFMDARSIMX "Kennfeld max. Istwert Diagnose ARS" MAP 0xFC1234 KfAxU8AyU8SstxU16SstyU16WU16 32767.50 md_q0p5 0.00 32767.50 FORMAT "%8.2"
 /begin AXIS_DESCR STD_AXIS vfzgv1_w vfzg_uw_b512 5 0.00 511.9922 FORMAT "%8.4" DEPOSIT ABSOLUTE /end AXIS_DESCR
 /begin AXIS_DESCR STD_AXIS bfzgqars_w bfzg_q0p025 4 0.00 1638.375 FORMAT "%8.3" DEPOSIT ABSOLUTE /end AXIS_DESCR
/end CHARACTERISTIC
/begin CHARACTERISTIC KFMDARSS "Kennfeld Umrechnung ARS-Sollmoment" MAP 0xFC1272 KfAxU8AyU8SstxU16SstyU16WU16 99.99847 rel_uw_b100 0.00 99.99847 FORMAT "%8.5"
 /begin AXIS_DESCR STD_AXIS nmot_w nmot_uw_q0p25 5 0.00 16383.75 FORMAT "%8.2" DEPOSIT ABSOLUTE /end AXIS_DESCR
 /begin AXIS_DESCR STD_AXIS mdarss_w md_q0p002 4 0.00 127.9980 FORMAT "%8.4" DEPOSIT ABSOLUTE /end AXIS_DESCR
/end CHARACTERISTIC
/begin CHARACTERISTIC KFMDARSSMX "Kennfeld max. Sollwert Diagnose ARS" MAP 0xFC12B0 KfAxU8AyU8SstxU16SstyU16WU16 32767.50 md_q0p5 0.00 32767.50 FORMAT "%8.2"
 /begin AXIS_DESCR STD_AXIS vfzgv1_w vfzg_uw_b512 5 0.00 511.9922 FORMAT "%8.4" DEPOSIT ABSOLUTE /end AXIS_DESCR
 /begin AXIS_DESCR STD_AXIS bfzgqars_w bfzg_q0p025 4 0.00 1638.375 FORMAT "%8.3" DEPOSIT ABSOLUTE /end AXIS_DESCR
/end CHARACTERISTIC
/begin CHARACTERISTIC KLAFSMDN "Kennlinie relatives Verlustmoment kein AFS verbaut" CURVE 0xFCF77A KlAxU8SstxU16WU16 99.99847 rel_uw_b100 0.00 99.99847 FORMAT "%8.5"
 /begin AXIS_DESCR STD_AXIS nmot_w nmot_uw_q0p25 6 0.00 16383.75 FORMAT "%8.2" DEPOSIT ABSOLUTE /end AXIS_DESCR
/end CHARACTERISTIC
/begin CHARACTERISTIC KLAFSSTND "Kennlinie Momentenvorhalt kein AFS verbaut" CURVE 0xFCF794 KlAxU8SstxS16WU16 99.99847 rel_uw_b100 0.00 99.99847 FORMAT "%8.5"
 /begin AXIS_DESCR STD_AXIS lws_w lws_q0p04375 6 -1433.600 1433.556 FORMAT "%8.3" DEPOSIT ABSOLUTE /end AXIS_DESCR
/end CHARACTERISTIC
/begin CHARACTERISTIC KLAFSVHV "Kennlinie Faktor Momentenvorhalt AFS" CURVE 0xFCF7AE KlAxU8SstxU16WU16 1.999969 fak_uw_b2 0.00 1.999969 FORMAT "%8.6"
 /begin AXIS_DESCR STD_AXIS vfzg_w vfzg_uw_b512 5 0.00 511.9922 FORMAT "%8.4" DEPOSIT ABSOLUTE /end AXIS_DESCR
/end CHARACTERISTIC
/begin CHARACTERISTIC KLMDAFSSMX "Kennlinie max. Sollwert Diagnose AFS" CURVE 0xFCF7C4 KlAxU8SstxS16WS16 32767.50 md_q0p5 -16384.00 16383.50 FORMAT "%8.2"
 /begin AXIS_DESCR STD_AXIS vlws_w lws_q0p04375 6 -1433.600 1433.556 FORMAT "%8.3" DEPOSIT ABSOLUTE /end AXIS_DESCR
/end CHARACTERISTIC
/begin CHARACTERISTIC LAMDYNO "obere Lambdaschwelle f¸r Dynamikpr¸fung LSU" VALUE 0xFD00F8 KwUw 15.99976 fak_uw_b16 0.00 15.99976 FORMAT "%8.5" /end CHARACTERISTIC
/begin CHARACTERISTIC LAMDYNU "untere Lambdaschwelle f¸r Dynamikpr¸fung LSU" VALUE 0xFD00FA KwUw 15.99976 fak_uw_b16 0.00 15.99976 FORMAT "%8.5" /end CHARACTERISTIC
/begin CHARACTERISTIC LBMINC "Wert der bei Bezugsmarkenverlust hinzuaddiert wird" VALUE 0xFC1D98 KwWU16 32767.00 dez 0.00 32767.00 FORMAT "%8.2" /end CHARACTERISTIC
/begin CHARACTERISTIC LBMINIT "Initialisierungswert des Z‰hlers Bezugsmarkenverlust, wenn SG zuvor im NLDG war" VALUE 0xFC1D9A KwWU16 32000.00 dez 0.00 32000.00 FORMAT "%8.2" /end CHARACTERISTIC
/begin CHARACTERISTIC LBMMX "Maximalwert f¸r Z‰hler Bezugsmarkenverlust" VALUE 0xFCFA1E KwWU16 32000.00 dez 0.00 32000.00 FORMAT "%8.2" /end CHARACTERISTIC
/begin CHARACTERISTIC LBMSUB "Differenzwert zwischen der Fehlereintragsschwelle und der Notlaufanforderung" VALUE 0xFCFA20 KwWU16 65535.00 dez 0.00 65535.00 FORMAT "%8.2" /end CHARACTERISTIC
/begin CHARACTERISTIC MDAFSFW "Ersatzwert Plausiblisierung bei Fehler AFS" VALUE 0xFCF7E4 KwUw 99.99847 rel_uw_b100 0.00 99.99847 FORMAT "%8.5" /end CHARACTERISTIC
/begin CHARACTERISTIC MKSSGMXMST "max. zul‰ssiges Kupplungsmoment f¸r Aktivierung Motorstop" VALUE 0xFC130C KwWS16 32767.50 md_q0p5 -16384.00 16383.50 FORMAT "%8.2" /end CHARACTERISTIC
/begin CHARACTERISTIC MKSSGMXNSV "max. zul.  Kupplungssoll-Moment w‰hrend eines inaktiven Schaltvorgangs (no SV)" VALUE 0xFC130E KwWS16 32767.50 md_q0p5 -16384.00 16383.50 FORMAT "%8.2" /end CHARACTERISTIC
/begin CHARACTERISTIC MXNLN "Mindestanzahl von Zahnsignalen zur Heilung des NLDG" VALUE 0xFCFA29 KwWU8 255.0 dez 0.00 255.0 FORMAT "%5.1" /end CHARACTERISTIC
/begin CHARACTERISTIC NARS "Drehzahlschwelle f¸r Aufweitung Diagnose ARS-Moment" VALUE 0xFC12FE KwWU8 10200. nmot_ub_q40 0.00 10200. FORMAT "%5.0" /end CHARACTERISTIC
/begin CHARACTERISTIC NDECJ "Drehzahl-Schwelle f¸r CJ400-Endstufendiagnose" VALUE 0xFC222F KwUb 10200. nmot_ub_q40 0.00 10200. FORMAT "%5.0" /end CHARACTERISTIC
/begin CHARACTERISTIC NDMTLVV "Zahl der Leck-Verifizierungsversuche bei MIL an wegen Leck" VALUE 0xFD4857 KwWU8 255.0 dez 0.00 255.0 FORMAT "%5.1" /end CHARACTERISTIC
/begin CHARACTERISTIC NDMTLWHV "Zahl der Wiederholungen bei Leck-Heilung" VALUE 0xFD4858 KwWU8 255.0 dez 0.00 255.0 FORMAT "%5.1" /end CHARACTERISTIC
/begin CHARACTERISTIC NERRINC "Wert der bei Drehzahlsignalsrˆrungen aufaddiert wird" VALUE 0xFCFA2A KwWU8 255.0 dez 0.00 255.0 FORMAT "%5.1" /end CHARACTERISTIC
/begin CHARACTERISTIC NERRINIT "Initialisierungswert f¸r Z‰hler Drehzahlsignalstˆrungen" VALUE 0xFCFA22 KwWU16 65535.00 dez 0.00 65535.00 FORMAT "%8.2" /end CHARACTERISTIC
/begin CHARACTERISTIC NERRMX "Maximalwert f¸r Z‰hler Drehzahlsignalstˆrungen" VALUE 0xFCFA24 KwWU16 65535.00 dez 0.00 65535.00 FORMAT "%8.2" /end CHARACTERISTIC
/begin CHARACTERISTIC NERRSUB "Differenzwert zwischen der Fehlereintragschwelle und der Notlaufanforderung" VALUE 0xFCFA26 KwWU16 65535.00 dez 0.00 65535.00 FORMAT "%8.2" /end CHARACTERISTIC
/begin CHARACTERISTIC NMAXCBRL "max. Motordrehzahl f¸r Berechnung von rl_u" VALUE 0xFC14B0 KwWU16 16383.75 nmot_uw_q0p25 0.00 16383.75 FORMAT "%8.2" /end CHARACTERISTIC
/begin CHARACTERISTIC NMOTDYFA "untere Drehzahlschwelle f¸r Dynamikpr¸fung LSU bei Kurztest" VALUE 0xFD00E2 KwUb 10200. nmot_ub_q40 0.00 10200. FORMAT "%5.0" /end CHARACTERISTIC
/begin CHARACTERISTIC NMOTDYNO "obere Drehzahlschwelle f¸r Dynamikpr¸fung LSU" VALUE 0xFD00E3 KwUb 10200. nmot_ub_q40 0.00 10200. FORMAT "%5.0" /end CHARACTERISTIC
/begin CHARACTERISTIC NMOTDYNU "untere Drehzahlschwelle f¸r Dynamikpr¸fung LSU" VALUE 0xFD00E4 KwUb 10200. nmot_ub_q40 0.00 10200. FORMAT "%5.0" /end CHARACTERISTIC
/begin CHARACTERISTIC NOBMINC "Wert der bei nicht erkannter Bezugsmarke aufaddiert wird" VALUE 0xFCFA2B KwWU8 255.0 dez 0.00 255.0 FORMAT "%5.1" /end CHARACTERISTIC
/begin CHARACTERISTIC NOBMINIT "Initialisierungswert f¸r Z‰hler Bezugsmarkenverlust" VALUE 0xFC1D9E KwWU8 255.0 dez 0.00 255.0 FORMAT "%5.1" /end CHARACTERISTIC
/begin CHARACTERISTIC NOBMSTMX "Maximalwert f¸r nicht erkannte Bezugsmarken im Start" VALUE 0xFCFA2C KwWU8 255.0 dez 0.00 255.0 FORMAT "%5.1" /end CHARACTERISTIC
/begin CHARACTERISTIC NW_ADP_MN "Minimalwert Adaption NW" VAL_BLK 0xFCCA96 KwbUw 6553.500 sprzi_q0p1 0.00 6553.500 FORMAT "%8.3" NUMBER 4 /end CHARACTERISTIC
/begin CHARACTERISTIC NW_ADP_MX "Maximalwert Adaption NW" VAL_BLK 0xFCCA9E KwbUw 6553.500 sprzi_q0p1 0.00 6553.500 FORMAT "%8.3" NUMBER 4 /end CHARACTERISTIC
/begin CHARACTERISTIC NW_POSMN "Minimalwert Nw_pos" VAL_BLK 0xFCCAA6 KwbUw 6553.500 sprzi_q0p1 0.00 6553.500 FORMAT "%8.3" NUMBER 4 /end CHARACTERISTIC
/begin CHARACTERISTIC NW_POSMX "Maximalwert Nw_pos" VAL_BLK 0xFCCAAE KwbUw 6553.500 sprzi_q0p1 0.00 6553.500 FORMAT "%8.3" NUMBER 4 /end CHARACTERISTIC
/begin CHARACTERISTIC PGFLNL "Anzahl an Phasenflanken bis NLDG aufgerufen wird bei eingetragenem E_n" VALUE 0xFCFA2D KwWU8 255.0 dez 0.00 255.0 FORMAT "%5.1" /end CHARACTERISTIC
/begin CHARACTERISTIC PGFLWA "Anzahl PG-Flankenwechsel f¸r DG-Fehler B_signal" VALUE 0xFCFA2E KwWU8 255.0 dez 0.00 255.0 FORMAT "%5.1" /end CHARACTERISTIC
/begin CHARACTERISTIC PUTEDOCFC "maximale Schwelle f¸r ƒnderung des Umgebungsdruck in %DCFCEO" VALUE 0xFD4851 KwWU8 9.961 p_q0p039 0.00 9.961 FORMAT "%5.3" /end CHARACTERISTIC
/begin CHARACTERISTIC RKACOMN "untere Schwelle additive Korrektur pro Zeit LL-CO Abgleich" VALUE 0xFC68CA KwSw 20.01563 rel_sw_b1536 -20.01563 0.00 FORMAT "%8.5" /end CHARACTERISTIC
/begin CHARACTERISTIC RKACOMX "obere Schwelle additive Korrektur pro Zeit LL-CO Abgleich" VALUE 0xFC68CC KwSw 20.01563 rel_sw_b1536 0.00 20.01563 FORMAT "%8.5" /end CHARACTERISTIC
/begin CHARACTERISTIC RLDYNFAW "Lastschwelle f¸r Dynamikpr¸fung LSU bei Kurztest (16 Bit)" VALUE 0xFD00FC KwUw 1535.977 rel_uw_q0p0234 0.00 1535.977 FORMAT "%8.3" /end CHARACTERISTIC
/begin CHARACTERISTIC RLDYNOW "obere Lastschwelle f¸r Dynamikpr¸fung LSU (16 Bit)" VALUE 0xFD00FE KwUw 1535.977 rel_uw_q0p0234 0.00 1535.977 FORMAT "%8.3" /end CHARACTERISTIC
/begin CHARACTERISTIC RLDYNUW "untere Lastschwelle f¸r Dynamikpr¸fung LSU (16 Bit)" VALUE 0xFD0100 KwUw 1535.977 rel_uw_q0p0234 0.00 1535.977 FORMAT "%8.3" /end CHARACTERISTIC
/begin CHARACTERISTIC SDMGLVU "untere Schwelle Fahrstrecke zwischen Betankung und Grobleckverdacht" VALUE 0xFD4862 KwWU16 1820.417 s_q0p02777_m 0.00 1820.417 FORMAT "%8.3" /end CHARACTERISTIC
/begin AXIS_PTS STM05EPMSB "St¸tzstellenverteilung f¸r WNWKM* / NW Korrektur ¸ber tmot" 0xFCF9FF tmot SstAUbSstUb 191.3 temp_ub_q0p75_o48 5 -48.00 143.3 FORMAT "%5.1" DEPOSIT ABSOLUTE /end AXIS_PTS
/begin CHARACTERISTIC TANKDBE "Einschaltzeitpunkt Kombianzeige nach Kl.15" VALUE 0xFD4852 KwWU8 25.50 t_q0p1 0.00 25.50 FORMAT "%5.2" /end CHARACTERISTIC
/begin CHARACTERISTIC TBRACCR "Zeit in der das ACC-SG seinen MD-Wunsch n. einer Fahrerbremsung zur¸cknehmen muﬂ" VALUE 0xFCF54C KwUb 5.100 t20msxs_ub_b5p1 0.00 5.100 FORMAT "%5.3" /end CHARACTERISTIC
/begin CHARACTERISTIC TDCACC2 "Zeit f¸r Timeouterkennung CAN-Schnittstelle ACC" VALUE 0xFCF54D KwUb 5.100 t20msxs_ub_b5p1 0.00 5.100 FORMAT "%5.3" /end CHARACTERISTIC
/begin CHARACTERISTIC TDCACC3 "Zeit f¸r Timeouterkennung CAN-Schnittstelle ACC" VALUE 0xFCF54E KwUb 5.100 t20msxs_ub_b5p1 0.00 5.100 FORMAT "%5.3" /end CHARACTERISTIC
/begin CHARACTERISTIC TDCACC4 "Zeit f¸r Timeouterkennung CAN-Schnittstelle ACC" VALUE 0xFCF54F KwUb 5.100 t20msxs_ub_b5p1 0.00 5.100 FORMAT "%5.3" /end CHARACTERISTIC
/begin CHARACTERISTIC TDCACCH "Zeit f¸r Heilung der CAN-Schnittstelle ACC" VALUE 0xFCF550 KwUb 5.100 t20msxs_ub_b5p1 0.00 5.100 FORMAT "%5.3" /end CHARACTERISTIC
/begin CHARACTERISTIC TDCACN "Zeitschwelle  Verdacht auf CAN-Timeout" VALUE 0xFCF551 KwUb 5.100 t20msxs_ub_b5p1 0.00 5.100 FORMAT "%5.3" /end CHARACTERISTIC
/begin CHARACTERISTIC TDCAFS1 "Zeit f¸r Fehlereintrag Momenten¸berwachung AFS-Eingriff" VALUE 0xFCF7DE KwWU8 5.100 t20msxs_ub_q0p02 0.00 5.100 FORMAT "%5.3" /end CHARACTERISTIC
/begin CHARACTERISTIC TDCAFS2 "Zeit f¸r Timeouterkennung CAN-Schnittstelle AFS" VALUE 0xFCF7DF KwWU8 5.100 t20msxs_ub_q0p02 0.00 5.100 FORMAT "%5.3" /end CHARACTERISTIC
/begin CHARACTERISTIC TDCAFS3 "Zeit f¸r Fehlereintrag Alive-Check Ebene2 AFS-Eingriff" VALUE 0xFCF7E0 KwWU8 5.100 t20msxs_ub_q0p02 0.00 5.100 FORMAT "%5.3" /end CHARACTERISTIC
/begin CHARACTERISTIC TDCAFSH "Entprellzeit f¸r Fehlerheilung CAN-Schnittstelle AFS" VALUE 0xFCF7E1 KwWU8 5.100 t20msxs_ub_q0p02 0.00 5.100 FORMAT "%5.3" /end CHARACTERISTIC
/begin CHARACTERISTIC TDCANA1 "Zeit f¸r Fehlererkennung ""CAN_A Error passiv""" VALUE 0xFC11EF KwWU8 2.550 t10msxs_ub_b2p55 0.00 2.550 FORMAT "%5.3" /end CHARACTERISTIC
/begin CHARACTERISTIC TDCANA3 "Zeit f¸r Fehlererkennung ""CAN_A BUS off""" VALUE 0xFC11F0 KwWU8 2.550 t10msxs_ub_b2p55 0.00 2.550 FORMAT "%5.3" /end CHARACTERISTIC
/begin CHARACTERISTIC TDCANAH "Heilungsentprellzeit f¸r CAN_A-Fehler" VALUE 0xFC11F1 KwWU8 2.550 t10msxs_ub_b2p55 0.00 2.550 FORMAT "%5.3" /end CHARACTERISTIC
/begin CHARACTERISTIC TDCANB1 "Zeit f¸r Fehlererkennung ""CAN_B Error passiv""" VALUE 0xFC11F2 KwWU8 2.550 t10msxs_ub_b2p55 0.00 2.550 FORMAT "%5.3" /end CHARACTERISTIC
/begin CHARACTERISTIC TDCANB3 "Zeit f¸r Fehlererkennung ""CAN_B BUS off""" VALUE 0xFC11F3 KwWU8 2.550 t10msxs_ub_b2p55 0.00 2.550 FORMAT "%5.3" /end CHARACTERISTIC
/begin CHARACTERISTIC TDCANBH "Heilungsentprellzeit f¸r CAN_B-Fehler" VALUE 0xFC11F4 KwWU8 2.550 t10msxs_ub_b2p55 0.00 2.550 FORMAT "%5.3" /end CHARACTERISTIC
/begin CHARACTERISTIC TDCARS1 "Zeit f¸r Fehlereintrag Momenten¸berwachung ARS-Eingriff" VALUE 0xFC12EE KwWU16 1310.700 t20msxs_uw_q0p02 0.00 1310.700 FORMAT "%8.3" /end CHARACTERISTIC
/begin CHARACTERISTIC TDCARS2 "Zeit f¸r Timeouterkennung CAN-Schnittstelle ARS" VALUE 0xFC12F0 KwWU16 1310.700 t20msxs_uw_q0p02 0.00 1310.700 FORMAT "%8.3" /end CHARACTERISTIC
/begin CHARACTERISTIC TDCARS3 "Zeit f¸r Fehlereintrag Alive-Check Ebene2 ARS-Eingriff" VALUE 0xFC12F2 KwWU16 1310.700 t20msxs_uw_q0p02 0.00 1310.700 FORMAT "%8.3" /end CHARACTERISTIC
/begin CHARACTERISTIC TDCARS4 "Zeit f¸r Fehlererkennung Alive-Counter ‰ndert sich nicht" VALUE 0xFC12F4 KwWU16 1310.700 t20msxs_uw_q0p02 0.00 1310.700 FORMAT "%8.3" /end CHARACTERISTIC
/begin CHARACTERISTIC TDCARSH "Entprellzeit f¸r Fehlerheilung CAN-Schnittstelle ARS" VALUE 0xFC12F6 KwWU16 1310.700 t20msxs_uw_q0p02 0.00 1310.700 FORMAT "%8.3" /end CHARACTERISTIC
/begin CHARACTERISTIC TDCCAS "Zeit f¸r Timeouterkennung CAN-Schnittstelle CAS" VALUE 0xFCF7E8 KwWU8 25.50 t_q0p1 0.00 25.50 FORMAT "%5.2" /end CHARACTERISTIC
/begin CHARACTERISTIC TDCCASH "Entprellzeit f¸r Fehlerheilung CAN-Schnittstelle CAS" VALUE 0xFCF7E9 KwWU8 25.50 t_q0p1 0.00 25.50 FORMAT "%5.2" /end CHARACTERISTIC
/begin CHARACTERISTIC TDCCASNP "Entprellzeit f¸r Checksummen oder Alivefehler CAN-Schnittstelle CAS" VALUE 0xFCF7EA KwWU8 25.50 t_q0p1 0.00 25.50 FORMAT "%5.2" /end CHARACTERISTIC
/begin CHARACTERISTIC TDCDSC "Zeit f¸r Timeouterkennung CAN-Schnittstelle DSC" VALUE 0xFC12FF KwWU8 5.100 t20msxs_ub_b5p1 0.00 5.100 FORMAT "%5.3" /end CHARACTERISTIC
/begin CHARACTERISTIC TDCDSC2 "Zeit f¸r Fehlererkennung CAN-Schnittstelle DSC" VALUE 0xFC1300 KwWU8 5.100 t20msxs_ub_b5p1 0.00 5.100 FORMAT "%5.3" /end CHARACTERISTIC
/begin CHARACTERISTIC TDCDSC3 "Zeit f¸r Fehlererkennung CAN-Schnittstelle DSC" VALUE 0xFC1301 KwWU8 5.100 t20msxs_ub_b5p1 0.00 5.100 FORMAT "%5.3" /end CHARACTERISTIC
/begin CHARACTERISTIC TDCDSCH "Zeit f¸r Heilung der CAN-Schnittstelle DSC" VALUE 0xFC1302 KwWU8 5.100 t20msxs_ub_b5p1 0.00 5.100 FORMAT "%5.3" /end CHARACTERISTIC
/begin CHARACTERISTIC TDCDSCN "Zeitschwelle  Verdacht auf CAN-Timeout" VALUE 0xFC1303 KwWU8 5.100 t20msxs_ub_b5p1 0.00 5.100 FORMAT "%5.3" /end CHARACTERISTIC
/begin CHARACTERISTIC TDCEGS "Zeit f¸r Timeouterkennung CAN-Schnittstelle EGS" VALUE 0xFC1304 KwWU8 5.100 t20msxs_ub_b5p1 0.00 5.100 FORMAT "%5.3" /end CHARACTERISTIC
/begin CHARACTERISTIC TDCEGS2 "Zeit f¸r Plausfehlererkennung CAN-Schnittstelle EGS" VALUE 0xFC1305 KwWU8 5.100 t20msxs_ub_b5p1 0.00 5.100 FORMAT "%5.3" /end CHARACTERISTIC
/begin CHARACTERISTIC TDCEGS3 "Zeit f¸r Fehlererkennung CAN-Schnittstelle EGS" VALUE 0xFC1306 KwWU8 5.100 t20msxs_ub_b5p1 0.00 5.100 FORMAT "%5.3" /end CHARACTERISTIC
/begin CHARACTERISTIC TDCEGSH "Zeit f¸r Heilung der CAN-Schnittstelle EGS" VALUE 0xFC1307 KwWU8 5.100 t20msxs_ub_b5p1 0.00 5.100 FORMAT "%5.3" /end CHARACTERISTIC
/begin CHARACTERISTIC TDCEGSN "Zeitschwelle  Verdacht auf CAN-Timeout" VALUE 0xFC1308 KwWU8 2.550 t10msxs_ub_b2p55 0.00 2.550 FORMAT "%5.3" /end CHARACTERISTIC
/begin CHARACTERISTIC TDCFCDEN "Zeitschwelle f¸r Freigabe der Check Filler Cap Diagnose" VALUE 0xFD483C KwWU16 6553.500 t_q0p1 0.00 6553.500 FORMAT "%8.3" /end CHARACTERISTIC
/begin CHARACTERISTIC TDCFCNIOLA "Dauer Lampenansteuerung bei offenem Tankdeckel" VALUE 0xFD483E KwWU16 6553.500 t_q0p1 0.00 6553.500 FORMAT "%8.3" /end CHARACTERISTIC
/begin CHARACTERISTIC TDCFCVFZAB "Minimale Fahrzeugabstellzeit nach Lampe bei offenem Tankdeckel" VALUE 0xFD4853 KwWU8 25.50 t_q0p1 0.00 25.50 FORMAT "%5.2" /end CHARACTERISTIC
/begin CHARACTERISTIC TDCFCVFZG "Minimale Dauer  der Geschwindigkeit  f¸r Lampe bei offenem Tankdeckel" VALUE 0xFD4854 KwWU8 25.50 t_q0p1 0.00 25.50 FORMAT "%5.2" /end CHARACTERISTIC
/begin CHARACTERISTIC TDCIHKA "Zeit f¸r Timeouterkennung CAN-Schnittstelle IHKA" VALUE 0xFCF7EE KwWU8 25.50 t_q0p1 0.00 25.50 FORMAT "%5.2" /end CHARACTERISTIC
/begin CHARACTERISTIC TDCIHKAH "Entprellzeit f¸r Fehlerheilung CAN-Schnittstelle IHKA" VALUE 0xFCF7EF KwWU8 25.50 t_q0p1 0.00 25.50 FORMAT "%5.2" /end CHARACTERISTIC
/begin CHARACTERISTIC TDCIMILOFF "Sperrzeit high f¸r MIL-Diagnose" VALUE 0xFCF7F0 KwWU8 25.50 t_q0p1 0.00 25.50 FORMAT "%5.2" /end CHARACTERISTIC
/begin CHARACTERISTIC TDCIMILON "Sperrzeit low f¸r MIL-Diagnose" VALUE 0xFCF7F1 KwWU8 25.50 t_q0p1 0.00 25.50 FORMAT "%5.2" /end CHARACTERISTIC
/begin CHARACTERISTIC TDCINS "Zeit f¸r Timeouterkennung CAN-Schnittstelle Kombi-Instr." VALUE 0xFCF7F2 KwWU8 25.50 t_q0p1 0.00 25.50 FORMAT "%5.2" /end CHARACTERISTIC
/begin CHARACTERISTIC TDCINS2 "Zeit f¸r Timeouterkennung CAN-Schnittstelle Kombi-Instr." VALUE 0xFCF7EC KwWU16 6553.500 t100msxs_uw_b6553p5 0.00 6553.500 FORMAT "%8.3" /end CHARACTERISTIC
/begin CHARACTERISTIC TDCINS3 "Zeit f¸r Fehlerkennung CAN-Schnittstelle Kombi-Instr." VALUE 0xFCF7F3 KwWU8 25.50 t_q0p1 0.00 25.50 FORMAT "%5.2" /end CHARACTERISTIC
/begin CHARACTERISTIC TDCINS4 "Zeit f¸r Alive-Fehlerkennung CAN-Schnittstelle Kombi-Instr." VALUE 0xFCF7F4 KwWU8 25.50 t_q0p1 0.00 25.50 FORMAT "%5.2" /end CHARACTERISTIC
/begin CHARACTERISTIC TDCINS5 "Zeit f¸r Fehlerkennung CAN-Schnittstelle Kombi-Instr." VALUE 0xFCF7F5 KwWU8 25.50 t_q0p1 0.00 25.50 FORMAT "%5.2" /end CHARACTERISTIC
/begin CHARACTERISTIC TDCINSH "Entprellzeit f¸r Fehlerheilung CAN-Schnittstelle Kombi-INST" VALUE 0xFCF7F6 KwWU8 25.50 t_q0p1 0.00 25.50 FORMAT "%5.2" /end CHARACTERISTIC
/begin CHARACTERISTIC TDCINSMIL "Entprellz‰hler f¸r MIL-Diagnose" VALUE 0xFCF7F7 KwWU8 25.50 t_q0p1 0.00 25.50 FORMAT "%5.2" /end CHARACTERISTIC
/begin CHARACTERISTIC TDCSZL "Zeit f¸r Timeouterkennung CAN-Schnittstelle SZL" VALUE 0xFC131C KwWU8 5.100 t20msxs_ub_b5p1 0.00 5.100 FORMAT "%5.3" /end CHARACTERISTIC
/begin CHARACTERISTIC TDCSZL2 "Zeit f¸r Timeouterkennung CAN-Schnittstelle SZL" VALUE 0xFC131D KwWU8 5.100 t20msxs_ub_b5p1 0.00 5.100 FORMAT "%5.3" /end CHARACTERISTIC
/begin CHARACTERISTIC TDCSZL3 "Zeit f¸r Plauserkennung CAN-Schnittstelle SZL" VALUE 0xFC131E KwWU8 5.100 t20msxs_ub_b5p1 0.00 5.100 FORMAT "%5.3" /end CHARACTERISTIC
/begin CHARACTERISTIC TDCSZL4 "Zeit f¸r Erkennung Alivefehler liegt vor (CAN-Schnittstelle SZL)" VALUE 0xFC131F KwWU8 5.100 t20msxs_ub_b5p1 0.00 5.100 FORMAT "%5.3" /end CHARACTERISTIC
/begin CHARACTERISTIC TDCSZLH "Zeit f¸r Heilung der CAN-Schnittstelle SZL" VALUE 0xFC1320 KwWU8 5.100 t20msxs_ub_b5p1 0.00 5.100 FORMAT "%5.3" /end CHARACTERISTIC
/begin CHARACTERISTIC TDCSZLN "Zeitschwelle Verdacht auf CAN-Timeout" VALUE 0xFC1321 KwWU8 5.100 t20msxs_ub_b5p1 0.00 5.100 FORMAT "%5.3" /end CHARACTERISTIC
/begin CHARACTERISTIC TDDIAGEL "Zeitdauer Berechnung Endstufen-Diagnose E-Box Luefter gesperrt" VALUE 0xFD0564 KwWU8 25.50 t_q0p1 0.00 25.50 FORMAT "%5.2" /end CHARACTERISTIC
/begin CHARACTERISTIC TDEGFEMN "Zeitverzˆgerung f¸r Setzen des MIN-Fehlers" VALUE 0xFD0DCD KwUb 25.50 t100msxs_ub_b25p5 0.00 25.50 FORMAT "%5.2" /end CHARACTERISTIC
/begin CHARACTERISTIC TDEGFEMX "Zeitverzˆgerung f¸r Setzen des MAX-Fehlers" VALUE 0xFD0DCE KwUb 25.50 t100msxs_ub_b25p5 0.00 25.50 FORMAT "%5.2" /end CHARACTERISTIC
/begin CHARACTERISTIC TDEGFENO "Zeitverzˆgerung f¸r Setzen des NO-Fehlers" VALUE 0xFD0DCF KwUb 25.50 t100msxs_ub_b25p5 0.00 25.50 FORMAT "%5.2" /end CHARACTERISTIC
/begin CHARACTERISTIC TDEGFEST "Zeitverzˆgerung nach Start" VALUE 0xFD0DD0 KwUb 25.50 t100msxs_ub_b25p5 0.00 25.50 FORMAT "%5.2" /end CHARACTERISTIC
/begin CHARACTERISTIC TDMTLMVMN "Zeit-Schwelle f¸r Erkennung ""aktiviertes Magnetventil""" VALUE 0xFD485E KwWU8 25.50 t_q0p1 0.00 25.50 FORMAT "%5.2" /end CHARACTERISTIC
/begin CHARACTERISTIC TDPURECFC "R¸cksetzzeit bei ƒnderung des Umgebungsdruck in %DCFCEO" VALUE 0xFD4855 KwWU8 254.0 t_q1 0.00 254.0 FORMAT "%5.1" /end CHARACTERISTIC
/begin CHARACTERISTIC TDTLDFSTV "Verzugszeit F¸llstandsg¸ltigkeit f¸r Wegstreckenentprellung Leckdiagnose" VALUE 0xFD4864 KwWU16 6553.500 t_q0p1 0.00 6553.500 FORMAT "%8.3" /end CHARACTERISTIC
/begin CHARACTERISTIC TEFABE "Zeitdauer Diagnosen-Systemtest am Bandende" VALUE 0xFD309E KwWU16 393210.0 t6minxmin_q6 0.00 393210.0 FORMAT "%8.1" /end CHARACTERISTIC
/begin CHARACTERISTIC TEPCL "Zeit ab Motorlauf bis EPCL-Testansteuerung Ende" VALUE 0xFCF93A KwWU8 51.00 t200msxs_ub_b51 0.00 51.00 FORMAT "%5.2" /end CHARACTERISTIC
/begin CHARACTERISTIC TEPCLI "Zeit ab INI bis EPCL-Testansteuerung Ende" VALUE 0xFCF93B KwWU8 51.00 t200msxs_ub_b51 0.00 51.00 FORMAT "%5.2" /end CHARACTERISTIC
/begin CHARACTERISTIC TFADTLMX "max. Zeitdauer f¸r DM-TL Systemtest am Bandende" VALUE 0xFD30A0 KwWU16 6553.500 t_q0p1 0.00 6553.500 FORMAT "%8.3" /end CHARACTERISTIC
/begin CHARACTERISTIC TLLCO "Motortemp. - Schwelle CO - Korrektur" VALUE 0xFC68C8 KwUb 191.3 temp_ub_q0p75_o48 -48.00 143.3 FORMAT "%5.1" /end CHARACTERISTIC
/begin CHARACTERISTIC TMOTNLDG "Temperaturschwelle f¸r Drehzahlgeber-Notlauf" VALUE 0xFCFA2F KwWU8 191.3 temp_ub_q0p75_o48 -48.00 143.3 FORMAT "%5.1" /end CHARACTERISTIC
/begin CHARACTERISTIC TNSECFC "Schwelle f¸r Zeitz‰hler ab Startende bei Check Filler Cap" VALUE 0xFD4840 KwWU16 6553.500 t_q0p1 0.00 6553.500 FORMAT "%8.3" /end CHARACTERISTIC
/begin CHARACTERISTIC TPNSE "Pr¸fzeit nach Startende f¸r DVE-Diagnose" VALUE 0xFCFA46 KwUb 25.40 t100msxs_ub_b25p5 0.1000 25.50 FORMAT "%5.2" /end CHARACTERISTIC
/begin CHARACTERISTIC TPUTESVCFC "Startwert des Z‰hlers f¸r ƒnderung des Umgebungsdruck in %DCFCEO" VALUE 0xFD4856 KwWU8 255.0 t_q1 0.00 255.0 FORMAT "%5.1" /end CHARACTERISTIC
/begin CHARACTERISTIC TSFAKRE "Fehlersummenzeit: Abgasklappe Endstufe" VALUE 0xFD5C06 KwWU8 255.0 dez 0.00 255.0 FORMAT "%5.1" /end CHARACTERISTIC
/begin CHARACTERISTIC TSFANSKE "Fehlersummenzeit: Ansaugklappe Endstufe" VALUE 0xFD5C07 KwWU8 255.0 dez 0.00 255.0 FORMAT "%5.1" /end CHARACTERISTIC
/begin CHARACTERISTIC TSFCACC "Fehlersummenzeit: CAN-Schnittstelle, Timeout ACC" VALUE 0xFD5C0F KwUb 255.0 dez 0.00 255.0 FORMAT "%5.1" /end CHARACTERISTIC
/begin CHARACTERISTIC TSFCAFS "Fehlersummenzeit: CAN-Schnittstelle, Timeout AFS" VALUE 0xFD5C10 KwWU8 255.0 dez 0.00 255.0 FORMAT "%5.1" /end CHARACTERISTIC
/begin CHARACTERISTIC TSFCANA "Fehlersummenzeit: CANA-Diagnose" VALUE 0xFD5C11 KwWU8 255.0 dez 0.00 255.0 FORMAT "%5.1" /end CHARACTERISTIC
/begin CHARACTERISTIC TSFCANB "Fehlersummenzeit: CAN-Schnittstelle, CANB-Diagnose" VALUE 0xFD5C12 KwWU8 255.0 dez 0.00 255.0 FORMAT "%5.1" /end CHARACTERISTIC
/begin CHARACTERISTIC TSFCUHR "" VALUE 0xFD5C1D KwUb 255.0 dez 0.00 255.0 FORMAT "%5.1" /end CHARACTERISTIC
/begin CHARACTERISTIC TSFLSV "Fehlersummenzeit: Lambda-Sonde vor Kat" VALUE 0xFD5CAB KwWU8 255.0 dez 0.00 255.0 FORMAT "%5.1" /end CHARACTERISTIC
/begin CHARACTERISTIC TSFLSV2 "Fehlersummenzeit: Lambda-Sonde 2 vor Kat" VALUE 0xFD5CAC KwWU8 255.0 dez 0.00 255.0 FORMAT "%5.1" /end CHARACTERISTIC
/begin CHARACTERISTIC TSFSWE "Fehlersummenzeit: Beschleunigungssensor der Schlechtwegeerkennung" VALUE 0xFD5CDD KwWU8 255.0 dez 0.00 255.0 FORMAT "%5.1" /end CHARACTERISTIC
/begin CHARACTERISTIC TSFX135 "Fehlersummenzeit: CAN-Schnittstelle ST_EKP_CRASHABSCHALTUNG" VALUE 0xFD5CF8 KwWU8 255.0 dez 0.00 255.0 FORMAT "%5.1" /end CHARACTERISTIC
/begin CHARACTERISTIC TSFX315 "Fehlersummenzeit: CAN-Schnittstelle FAHRZEUGMODUS" VALUE 0xFD5CF9 KwWU8 255.0 dez 0.00 255.0 FORMAT "%5.1" /end CHARACTERISTIC
/begin CHARACTERISTIC TSFX334 "Fehlersummenzeit: CAN-Schnittstelle PWM_LADESPANNUNG" VALUE 0xFD5CFA KwWU8 255.0 dez 0.00 255.0 FORMAT "%5.1" /end CHARACTERISTIC
/begin CHARACTERISTIC TSFX3B0 "Fehlersummenzeit: CAN-Schnittstelle ST_GANG_R‹CKWƒRTS" VALUE 0xFD5CFB KwWU8 255.0 dez 0.00 255.0 FORMAT "%5.1" /end CHARACTERISTIC
/begin CHARACTERISTIC TSFX3B4 "Fehlersummenzeit: CAN-Schnittstelle PWM_BATTERIESPANNUNG" VALUE 0xFD5CFC KwWU8 255.0 dez 0.00 255.0 FORMAT "%5.1" /end CHARACTERISTIC
/begin CHARACTERISTIC TSFXC4 "Fehlersummenzeit: CAN-Schnittstelle LENKRADWINKEL" VALUE 0xFD5CFD KwWU8 255.0 dez 0.00 255.0 FORMAT "%5.1" /end CHARACTERISTIC
/begin CHARACTERISTIC TSSGDRMX "max. zul‰ssige Zeit f¸r Drehzahlregelung" VALUE 0xFC1310 KwWU16 655.3500 t_q0p01 0.00 655.3500 FORMAT "%8.4" /end CHARACTERISTIC
/begin CHARACTERISTIC TSSGMD "max. zul‰ssige Dauer Sollmoment zu hoch (¸berschritten)" VALUE 0xFC1312 KwWU16 655.3500 t_q0p01 0.00 655.3500 FORMAT "%8.4" /end CHARACTERISTIC
/begin CHARACTERISTIC TSSGMEMX "max. zul‰ssige Zeit f¸r erhˆhenden Momenteneingriff" VALUE 0xFC1314 KwWU16 655.3500 t_q0p01 0.00 655.3500 FORMAT "%8.4" /end CHARACTERISTIC
/begin CHARACTERISTIC TSSGMRMX "max. zul‰ssige Zeit f¸r reduzieren Momenteneingriff" VALUE 0xFC1316 KwWU16 655.3500 t_q0p01 0.00 655.3500 FORMAT "%8.4" /end CHARACTERISTIC
/begin CHARACTERISTIC TSSGNOKPL "max. zul‰ssige Entprellzeit f¸r Erkennung Kupplung ˆffnet nicht" VALUE 0xFC1318 KwWU16 655.3500 t_q0p01 0.00 655.3500 FORMAT "%8.4" /end CHARACTERISTIC
/begin CHARACTERISTIC TVCO "CO-Korrektur" CURVE 0xFC68CE KlASwSstSwWSw 3071.953 rel_sw_b1536 -1536.000 1535.953 FORMAT "%8.3"
 /begin AXIS_DESCR STD_AXIS co_pot_w dez 8 -32768.00 32767.00 FORMAT "%8.2" DEPOSIT ABSOLUTE /end AXIS_DESCR
/end CHARACTERISTIC
/begin CHARACTERISTIC TVDISAPOTI "Verzˆgerungszeit f¸r Poti¸berwachung" VALUE 0xFD081E KwUb 0.07000 t10msxs_sb_q0p01 0.00 0.07000 FORMAT "%7.5" /end CHARACTERISTIC
/begin CHARACTERISTIC TVDRL "Verzˆgerungszeit f¸r Dynamikmessung LSU" VALUE 0xFD00E5 KwUb 5.100 t20msxs_ub_b5p1 0.00 5.100 FORMAT "%5.3" /end CHARACTERISTIC
/begin CHARACTERISTIC TWBDCY "Wartezeit f¸r Erkennung Bedingung 'driving cycle'" VALUE 0xFCF938 KwUw 13107.00 t200msxs_uw_q0p2 0.00 13107.00 FORMAT "%8.2" /end CHARACTERISTIC
/begin CHARACTERISTIC TWDMTLTC "Wartezeit f¸r Statusberechnung ab Pumpenmotor aus" VALUE 0xFD30A3 KwWU8 25.50 t_q0p1 0.00 25.50 FORMAT "%5.2" /end CHARACTERISTIC
/begin CHARACTERISTIC TWUPDLO "Wartezeit Erkennung hohe Dauerverlustleistung" VALUE 0xFC222C KwWU8 2.550 t_q0p01 0.00 2.550 FORMAT "%5.3" /end CHARACTERISTIC
/begin CHARACTERISTIC TWUPDLWE "Wartezeit Wiedereinschaltversuch bei hoher Dauerverlustleistung" VALUE 0xFC2224 KwWU16 655.3500 t_q0p01 0.00 655.3500 FORMAT "%8.4" /end CHARACTERISTIC
/begin CHARACTERISTIC TWUPKSO "Wartezeit Kurzschlusserkennung" VALUE 0xFC222D KwWU8 2.550 t_q0p01 0.00 2.550 FORMAT "%5.3" /end CHARACTERISTIC
/begin CHARACTERISTIC TWUPKSWE "Wartezeit Wiedereinschaltversuch bei Kurzschluss" VALUE 0xFC2226 KwWU16 655.3500 t_q0p01 0.00 655.3500 FORMAT "%8.4" /end CHARACTERISTIC
/begin CHARACTERISTIC UBCJMN "Minimale UBat-Schwelle f¸r Freigabe der CJ400-Endstufendiagnose" VALUE 0xFC2230 KwUb 24.02 spg_ubatt 0.00 24.02 FORMAT "%5.2" /end CHARACTERISTIC
/begin CHARACTERISTIC UBCJMX "Maximale UBat-Schwelle f¸r Freigabe der CJ400-Endstufendiagnose" VALUE 0xFC2231 KwUb 24.02 spg_ubatt 0.00 24.02 FORMAT "%5.2" /end CHARACTERISTIC
/begin CHARACTERISTIC UBPMEO "obere UB-Schwelle DM-TL Pumpenmotoransteuerung" VALUE 0xFC222E KwWU8 25.50 spg_q0p1 0.00 25.50 FORMAT "%5.2" /end CHARACTERISTIC
/begin CHARACTERISTIC UPTESDLO "Schwelle Pumpenspannung zur Erkennung hoher Dauerverlustleistung" VALUE 0xFC2228 KwWU16 319.9951 spg_q0p00488 0.00 319.9951 FORMAT "%8.4" /end CHARACTERISTIC
/begin CHARACTERISTIC UPTESO "Schwelle Pumpenspannung zur Kurzschlusserkennung" VALUE 0xFC222A KwWU16 319.9951 spg_q0p00488 0.00 319.9951 FORMAT "%8.4" /end CHARACTERISTIC
/begin CHARACTERISTIC VARS "Geschwindigkeitsschwelle f¸r Aufweitung Diagnose ARS-Moment" VALUE 0xFC12F8 KwWU16 511.9922 vfzg_uw_b512 0.00 511.9922 FORMAT "%8.4" /end CHARACTERISTIC
/begin CHARACTERISTIC VFSSGMXMST "max. zul‰ssige Fahrzeuggeschwindigkeit f¸r SSG-Anforderung Motorstop" VALUE 0xFC131A KwWU16 511.9922 vfzg_uw_b512 0.00 511.9922 FORMAT "%8.4" /end CHARACTERISTIC
/begin CHARACTERISTIC VFZGCFCAB "Max. Geschwindi, ab der Fahrzeug als stehend erkannt wird bei offenem Tankdeckel" VALUE 0xFD4842 KwWU16 511.9922 vfzg_uw_b512 0.00 511.9922 FORMAT "%8.4" /end CHARACTERISTIC
/begin CHARACTERISTIC VFZGCFCLA "Geschwindigkeit f¸r Lampe bei offenem Tankdeckel" VALUE 0xFD4844 KwWU16 511.9922 vfzg_uw_b512 0.00 511.9922 FORMAT "%8.4" /end CHARACTERISTIC
/begin CHARACTERISTIC VFZGCFCO "Minimale Geschwindigkeit zum Aktivieren der Check Filler Cap Pr¸fung" VALUE 0xFD4846 KwWU16 511.9922 vfzg_uw_b512 0.00 511.9922 FORMAT "%8.4" /end CHARACTERISTIC
/begin CHARACTERISTIC VFZGCFCU "Maximale Geschwindigkeit zum Abbruch der Check Filler Cap Pr¸fung" VALUE 0xFD4848 KwWU16 511.9922 vfzg_uw_b512 0.00 511.9922 FORMAT "%8.4" /end CHARACTERISTIC
/begin CHARACTERISTIC VFZGDVU "Minimale Geschwindigkeit zum Abbruch der Check Filler Cap Pr¸fung wegen Fahrzeug" VALUE 0xFD484A KwWU16 10.00000 vfzg_uw_b512 0.00 10.00000 FORMAT "%8.5" /end CHARACTERISTIC
/begin CHARACTERISTIC VNSK_DELTA "Filterzeitkonstante Regler¸berwachung" VALUE 0xFCCAB6 KwWU16 0.9999847 fak_uw_b1 0.00 0.9999847 FORMAT "%9.7" /end CHARACTERISTIC
/begin CHARACTERISTIC VNSK_TV_I "Filterzeitkonstante Haltetastverh‰ltnis¸berwachung" VALUE 0xFCCAB8 KwWU16 0.9999847 fak_uw_b1 0.00 0.9999847 FORMAT "%9.7" /end CHARACTERISTIC
/begin CHARACTERISTIC VNS_DELTMX "Maximale Regelabweichung PT1 Regler¸berwachung" VALUE 0xFCCABA KwWU16 6553.500 sprzi_q0p1 0.00 6553.500 FORMAT "%8.3" /end CHARACTERISTIC
/begin CHARACTERISTIC VNS_DELTMX2 "" VALUE 0xFCCABC KwWU16 6553.500 sprzi_q0p1 0.00 6553.500 FORMAT "%8.3" /end CHARACTERISTIC
/begin CHARACTERISTIC VNS_ERRCNT "Eintragschwelle Sensorsignal abgefallen" VALUE 0xFCCAC3 KwWU8 255.0 dez 0.00 255.0 FORMAT "%5.1" /end CHARACTERISTIC
/begin CHARACTERISTIC VNS_ERRCNT2 "" VALUE 0xFCCAC4 KwWU8 255.0 dez 0.00 255.0 FORMAT "%5.1" /end CHARACTERISTIC
/begin CHARACTERISTIC VNS_NMOTS "Drehzahlschelle Sensorsignal abgefallen" VALUE 0xFCCAC5 KwWU8 10200. nmot_ub_q40 0.00 10200. FORMAT "%5.0" /end CHARACTERISTIC
/begin CHARACTERISTIC VNS_TMN "Minimale Temperaturschelle f¸r Diagnose variable NWS" VALUE 0xFCCAC6 KwWU8 191.3 temp_ub_q0p75_o48 -48.00 143.3 FORMAT "%5.1" /end CHARACTERISTIC
/begin CHARACTERISTIC VNS_TMX "Maximale Temperaturschelle f¸r Diagnose variable NWS" VALUE 0xFCCAC7 KwWU8 191.3 temp_ub_q0p75_o48 -48.00 143.3 FORMAT "%5.1" /end CHARACTERISTIC
/begin CHARACTERISTIC VNS_TVIMN "Minimalbegrenzung Tastverh‰ltnis I-Anteil" VALUE 0xFCCABE KwWU16 199.997 vnstv_q0p00305s32768 -100.000 99.9969 /end CHARACTERISTIC
/begin CHARACTERISTIC VNS_TVIMX "Maximalbegrenzung Tastverh‰ltnis I-Anteil" VALUE 0xFCCAC0 KwWU16 199.997 vnstv_q0p00305s32768 -100.000 99.9969 /end CHARACTERISTIC
/begin CHARACTERISTIC VSAADPDLY "Verzˆgerungszeit f¸r B_vsaadp" VALUE 0xFCFA05 KwUb 255.0 dez 0.00 255.0 FORMAT "%5.1" /end CHARACTERISTIC
/begin CHARACTERISTIC VSEADPDLY "Verzˆgerungszeit f¸r B_vseadp" VALUE 0xFCFA06 KwUb 255.0 dez 0.00 255.0 FORMAT "%5.1" /end CHARACTERISTIC
/begin CHARACTERISTIC WNWKMA "Korrekturwinkel Nockenwelle ¸ber Motortemperatur f¸r Auslass Bank 1" CURVE 0xFCFA07 GklWSb 15.94 kw_q0p0625 -8.000 7.938 FORMAT "%5.3"
 /begin AXIS_DESCR COM_AXIS tmot temp_ub_q0p75_o48 5 -48.00 143.3 FORMAT "%5.1" AXIS_PTS_REF STM05EPMSB /end AXIS_DESCR
/end CHARACTERISTIC
/begin CHARACTERISTIC WNWKME "Korrekturwinkel Nockenwelle ¸ber Motortemperatur f¸r Einlass Bank 1" CURVE 0xFCFA0C GklWSb 15.94 kw_q0p0625 -8.000 7.938 FORMAT "%5.3"
 /begin AXIS_DESCR COM_AXIS tmot temp_ub_q0p75_o48 5 -48.00 143.3 FORMAT "%5.1" AXIS_PTS_REF STM05EPMSB /end AXIS_DESCR
/end CHARACTERISTIC
/begin CHARACTERISTIC WNWKN "Korrekturwinkel Nockenwelle ¸ber Drehzahl" CURVE 0xFCFA11 KlAUbSstUbWSb 15.94 kw_q0p0625 -8.000 7.938 FORMAT "%5.3"
 /begin AXIS_DESCR STD_AXIS nmot nmot_ub_q40 6 0.00 10200. FORMAT "%5.0" DEPOSIT ABSOLUTE /end AXIS_DESCR
/end CHARACTERISTIC
/begin CHARACTERISTIC ZDIWISCHMX "Schwelle Wischfunktionsh‰ufigkeit f¸r Fehlereintrag" VALUE 0xFC2397 KwWU8 255.0 dez 0.00 255.0 FORMAT "%5.1" /end CHARACTERISTIC
/begin CHARACTERISTIC ZDYNFA "Z‰hlerwert f¸r Dynamikmessung LSU bei Kurztest" VALUE 0xFD00E6 KwUb 255.0 dez 0.00 255.0 FORMAT "%5.1" /end CHARACTERISTIC
/begin CHARACTERISTIC ZDYNLSU "Z‰hlerwert f¸r Dynamikmessung LSU" VALUE 0xFD00E7 KwUb 255.0 dez 0.00 255.0 FORMAT "%5.1" /end CHARACTERISTIC
/begin CHARACTERISTIC ZFCFCTFST "Filterzeitkonstante F¸llstandsgeber f¸r Check Filler Cap" VALUE 0xFD484C KwWU16 6553.4999985 zk100msxs_uw_b6553 0.10000152590 6553.6000000 FORMAT "%12.7" /end CHARACTERISTIC
/begin MEASUREMENT abschkor_u "Umweltbedingung Korrekturwert Abschaltung" UBYTE rel_q1p024_o100 1 100 -100 161.121 FORMAT "%5.1" ECU_ADDRESS 0x403ADA /end MEASUREMENT
/begin MEASUREMENT addsu_u "AD-Messwert Umgebungsdrucksensor; DFPM Umweltbedingung" UBYTE dez 1 100 0 255 FORMAT "%5.1" ECU_ADDRESS 0x403ADB /end MEASUREMENT
/begin MEASUREMENT adhfm_u "AD-Messwert Luftmassenmesser; DFPM Umweltbedingung" UBYTE dez 1 100 0 255 FORMAT "%5.1" ECU_ADDRESS 0x403ADC /end MEASUREMENT
/begin MEASUREMENT adta_u "AD-Messwert Ansauglufttemperatur; DFPM Umweltbedingung" UBYTE dez 1 100 0 255 FORMAT "%5.1" ECU_ADDRESS 0x403ADD /end MEASUREMENT
/begin MEASUREMENT adtka_u "AD-Messwert Temperatur K¸hlwasseraustritt; DFPM-Umweltbedingung" UBYTE dez 1 100 0 255 FORMAT "%5.1" ECU_ADDRESS 0x403ADE /end MEASUREMENT
/begin MEASUREMENT adtm_u "AD-Messwert Motortemperatur; DFPM Umweltbedingung" UBYTE dez 1 100 0 255 FORMAT "%5.1" ECU_ADDRESS 0x403ADF /end MEASUREMENT
/begin MEASUREMENT aniodcfc "Anzahl Pr¸fungen Check Filler Cap mit Ergebnis Tank offen" UBYTE dez 1 100 0 255 FORMAT "%5.1" ECU_ADDRESS 0x3FE29E /end MEASUREMENT
/begin MEASUREMENT anzdyn "Anzahl der Dynamikmessungen LSU" UBYTE dez 1 100 0 255 FORMAT "%5.1" ECU_ADDRESS 0x403B66 /end MEASUREMENT
/begin MEASUREMENT anzdyn2 "Anzahl der Dynamikmessungen LSU2" UBYTE dez 1 100 0 255 FORMAT "%5.1" ECU_ADDRESS 0x403B67 /end MEASUREMENT
/begin MEASUREMENT anzdyst "Anzahl der Steigungsmessungen LSU" UBYTE dez 1 100 0 255 FORMAT "%5.1" ECU_ADDRESS 0x403B68 /end MEASUREMENT
/begin MEASUREMENT anzdyst2 "Anzahl der Steigungsmessungen LSU 2" UBYTE dez 1 100 0 255 FORMAT "%5.1" ECU_ADDRESS 0x403B69 /end MEASUREMENT
/begin MEASUREMENT azdcfc "Anzahl Fahryklen seit Beginn der Anforderung Check Filler Cap" UBYTE dez 1 100 0 255 FORMAT "%5.1" ECU_ADDRESS 0x3FE29F /end MEASUREMENT
/begin MEASUREMENT bbdcy "Byte f¸r Bedingung B_dcy als Triggerevent in DCLA" UBYTE dez 1 100 0 255 FORMAT "%5.1" ECU_ADDRESS 0x403AD9 /end MEASUREMENT
/begin MEASUREMENT bbno "Byte f¸r Bedingung B_no  als Triggerevent in DCLA" UBYTE dez 1 100 0 255 FORMAT "%5.1" ECU_ADDRESS 0x3FDEE5 /end MEASUREMENT
/begin MEASUREMENT bbsp3 "Byte f¸r Bedingung B_sp3 als Triggerevent in DCLA" UBYTE dez 1 100 0 255 FORMAT "%5.1" ECU_ADDRESS 0x3FDEE6 /end MEASUREMENT
/begin MEASUREMENT bbtim "Byte f¸r Bedingung B_tim als Triggerevent in DCLA" UBYTE dez 1 100 0 255 FORMAT "%5.1" ECU_ADDRESS 0x403B2B /end MEASUREMENT
/begin MEASUREMENT bmlosold_w "Alter Wert des Z‰hlers bmlosctr_w" UWORD dez 1 100 0 65535 FORMAT "%8.2" ECU_ADDRESS 0x402964 /end MEASUREMENT
/begin MEASUREMENT B_admtls "Bedingung DDMTL-Automat soll stoppen" UBYTE B_TRUE 1 100 0 1 BIT_MASK 0x4 FORMAT "%13.11" ECU_ADDRESS 0x403042 /end MEASUREMENT
/begin MEASUREMENT B_akrdet "Variantenerkennung AKR durchgef¸hrt" UBYTE B_TRUE 1 100 0 1 BIT_MASK 0x2 FORMAT "%13.11" ECU_ADDRESS 0x3FE0BB /end MEASUREMENT
/begin MEASUREMENT B_akrfz "Bedingung Abgasklappe vorhanden" UBYTE B_TRUE 1 100 0 1 BIT_MASK 0x1 FORMAT "%13.11" ECU_ADDRESS 0x3FC04C /end MEASUREMENT
/begin MEASUREMENT B_akrvar "Bedingung AKR-Variante" UBYTE B_TRUE 1 100 0 1 BIT_MASK 0x1 FORMAT "%13.11" ECU_ADDRESS 0x3FE0BB /end MEASUREMENT
/begin MEASUREMENT B_anwmn "Nockenwellensteuerung: Min Position nicht ok (Auslaﬂ Nockenwelle 1)" UBYTE B_TRUE 1 100 0 1 BIT_MASK 0x20 FORMAT "%13.11" ECU_ADDRESS 0x40368E /end MEASUREMENT
/begin MEASUREMENT B_anwmn2 "Nockenwellensteuerung: Min Position nicht ok (Auslaﬂ Nockenwelle 2)" UBYTE B_TRUE 1 100 0 1 BIT_MASK 0x80 FORMAT "%13.11" ECU_ADDRESS 0x40368E /end MEASUREMENT
/begin MEASUREMENT B_anwpnp "Nockenwellensteuerung: Position nicht plausibel (Auslaﬂ Nockenwelle 1)" UBYTE B_TRUE 1 100 0 1 BIT_MASK 0x2 FORMAT "%13.11" ECU_ADDRESS 0x40368E /end MEASUREMENT
/begin MEASUREMENT B_anwpnp2 "Nockenwellensteuerung: Position nicht plausibel (Auslaﬂ Nockenwelle 2)" UBYTE B_TRUE 1 100 0 1 BIT_MASK 0x8 FORMAT "%13.11" ECU_ADDRESS 0x40368E /end MEASUREMENT
/begin MEASUREMENT B_beakre "Bedingung Bandendeanforderung f¸r Fehler Abgasklappe Endstufe" UWORD B_TRUE 1 100 0 1 BIT_MASK 0x20 FORMAT "%13.11" ECU_ADDRESS 0x3FE3B0 /end MEASUREMENT
/begin MEASUREMENT B_beanske "Bedingung Bandendeanforderung f¸r Fehler Endstufe ANSKL" UWORD B_TRUE 1 100 0 1 BIT_MASK 0x20 FORMAT "%13.11" ECU_ADDRESS 0x3FE3B2 /end MEASUREMENT
/begin MEASUREMENT B_becacc "Bedingung Bandende-Funktionsanforderung: CAN-Schnittstelle ACC" UWORD B_TRUE 1 100 0 1 BIT_MASK 0x20 FORMAT "%13.11" ECU_ADDRESS 0x3FE3C2 /end MEASUREMENT
/begin MEASUREMENT B_becafs "Bedingung Bandende-Funktionsanforderung: CAN-Schnittstelle AFS" UWORD B_TRUE 1 100 0 1 BIT_MASK 0x20 FORMAT "%13.11" ECU_ADDRESS 0x3FE3C4 /end MEASUREMENT
/begin MEASUREMENT B_becana "Bedingung Bandende-Funktionsanforderung: CANA-Diangnose" UWORD B_TRUE 1 100 0 1 BIT_MASK 0x20 FORMAT "%13.11" ECU_ADDRESS 0x3FE3C6 /end MEASUREMENT
/begin MEASUREMENT B_becanb "Bedingung Bandende-Funktionsanforderung: CANB-Diagnosis" UWORD B_TRUE 1 100 0 1 BIT_MASK 0x20 FORMAT "%13.11" ECU_ADDRESS 0x3FE3C8 /end MEASUREMENT
/begin MEASUREMENT B_becuhr "Bedingung Bandende-  CAN  rel. Zeitgeber" UWORD B_TRUE 1 100 0 1 BIT_MASK 0x20 FORMAT "%13.11" ECU_ADDRESS 0x3FE3DE /end MEASUREMENT
/begin MEASUREMENT B_belsv "Bedingung Bandende-Funktionsanforderung elktr. Diag. Lambda-Sonde vor KAT" UWORD B_TRUE 1 100 0 1 BIT_MASK 0x20 FORMAT "%13.11" ECU_ADDRESS 0x3FE4FA /end MEASUREMENT
/begin MEASUREMENT B_belsv2 "Bedingung Bandende-Funktionsanforderung elktr. Diag. Lambda-Sonde vor KAT Bank2" UWORD B_TRUE 1 100 0 1 BIT_MASK 0x20 FORMAT "%13.11" ECU_ADDRESS 0x3FE4FC /end MEASUREMENT
/begin MEASUREMENT B_beswe "Bedingung Bandende-Funktionsanforderung Beschleunigungss. f Schlechtwegerkennung" UWORD B_TRUE 1 100 0 1 BIT_MASK 0x20 FORMAT "%13.11" ECU_ADDRESS 0x3FE55E /end MEASUREMENT
/begin MEASUREMENT B_bex135 "Bedingung Bandende-Funktionsanforderung: CAN-Schnittstelle EGS" UWORD B_TRUE 1 100 0 1 BIT_MASK 0x20 FORMAT "%13.11" ECU_ADDRESS 0x3FE594 /end MEASUREMENT
/begin MEASUREMENT B_bex315 "Bedingung Bandende-Funktionsanforderung: CAN-Botschaft FAHRZEUGMODUS" UWORD B_TRUE 1 100 0 1 BIT_MASK 0x20 FORMAT "%13.11" ECU_ADDRESS 0x3FE596 /end MEASUREMENT
/begin MEASUREMENT B_bex334 "Bedingung Bandende-Funktionsanforderung: CAN-Botschaft PWM_LADESPANNUNG" UWORD B_TRUE 1 100 0 1 BIT_MASK 0x20 FORMAT "%13.11" ECU_ADDRESS 0x3FE598 /end MEASUREMENT
/begin MEASUREMENT B_bex3b0 "Bedingung Bandende-Funktionsanforderung: CAN-Botschaft ST_GANG_R‹CKWƒRTS" UWORD B_TRUE 1 100 0 1 BIT_MASK 0x20 FORMAT "%13.11" ECU_ADDRESS 0x3FE59A /end MEASUREMENT
/begin MEASUREMENT B_bex3b4 "Bedingung Bandende-Funktionsanforderung: CAN-Botschaft PWM_BATTERIESPANNUNG" UWORD B_TRUE 1 100 0 1 BIT_MASK 0x20 FORMAT "%13.11" ECU_ADDRESS 0x3FE59C /end MEASUREMENT
/begin MEASUREMENT B_bexc4 "Bedingung Bandende-Funktionsanforderung: CAN-Botschaft LENKRADWINKEL" UWORD B_TRUE 1 100 0 1 BIT_MASK 0x20 FORMAT "%13.11" ECU_ADDRESS 0x3FE59E /end MEASUREMENT
/begin MEASUREMENT B_bkakre "Bedingung Ersatzwert aktiv Abgasklappe Endstufe" UWORD B_TRUE 1 100 0 1 BIT_MASK 0x40 FORMAT "%13.11" ECU_ADDRESS 0x3FE3B0 /end MEASUREMENT
/begin MEASUREMENT B_bkanske "Bedingung Ersatzwert aktiv ANSKL" UWORD B_TRUE 1 100 0 1 BIT_MASK 0x40 FORMAT "%13.11" ECU_ADDRESS 0x3FE3B2 /end MEASUREMENT
/begin MEASUREMENT B_bkcacc "Bedingung Ersatzwert aktiv: CAN-Schnittstelle ACC" UWORD B_TRUE 1 100 0 1 BIT_MASK 0x40 FORMAT "%13.11" ECU_ADDRESS 0x3FE3C2 /end MEASUREMENT
/begin MEASUREMENT B_bkcafs "Bedingung Ersatzwert aktiv: CAN-Schnittstelle AFS" UWORD B_TRUE 1 100 0 1 BIT_MASK 0x40 FORMAT "%13.11" ECU_ADDRESS 0x3FE3C4 /end MEASUREMENT
/begin MEASUREMENT B_bkcana "Bedingung Ersatzwert aktiv: CANA-Diagnose" UWORD B_TRUE 1 100 0 1 BIT_MASK 0x40 FORMAT "%13.11" ECU_ADDRESS 0x3FE3C6 /end MEASUREMENT
/begin MEASUREMENT B_bkcanb "Bedingung Ersatzwert aktiv: CANB-Diagnose" UWORD B_TRUE 1 100 0 1 BIT_MASK 0x40 FORMAT "%13.11" ECU_ADDRESS 0x3FE3C8 /end MEASUREMENT
/begin MEASUREMENT B_bkcuhr "Ersatzwert aktiv  CAN  rel. Zeitgeber" UWORD B_TRUE 1 100 0 1 BIT_MASK 0x40 FORMAT "%13.11" ECU_ADDRESS 0x3FE3DE /end MEASUREMENT
/begin MEASUREMENT B_bklsv "Bedingung: Lambdasonde vor Kat. aktiv" UWORD B_TRUE 1 100 0 1 BIT_MASK 0x40 FORMAT "%13.11" ECU_ADDRESS 0x3FE4FA /end MEASUREMENT
/begin MEASUREMENT B_bklsv2 "Bedingung: Lambdasonde vor Kat. aktiv Bank2" UWORD B_TRUE 1 100 0 1 BIT_MASK 0x40 FORMAT "%13.11" ECU_ADDRESS 0x3FE4FC /end MEASUREMENT
/begin MEASUREMENT B_bkswe "Bedingung Ersatzwert aktiv: Schlechtwegerkennung" UWORD B_TRUE 1 100 0 1 BIT_MASK 0x40 FORMAT "%13.11" ECU_ADDRESS 0x3FE55E /end MEASUREMENT
/begin MEASUREMENT B_bkx135 "Backup-Bedingung: CAN-Botschaft ST_EKP_CRASHABSCHALTUNG" UWORD B_TRUE 1 100 0 1 BIT_MASK 0x40 FORMAT "%13.11" ECU_ADDRESS 0x3FE594 /end MEASUREMENT
/begin MEASUREMENT B_bkx315 "Backup-Bedingung: CAN-Botschaft FAHRZEUGMODUS" UWORD B_TRUE 1 100 0 1 BIT_MASK 0x40 FORMAT "%13.11" ECU_ADDRESS 0x3FE596 /end MEASUREMENT
/begin MEASUREMENT B_bkx334 "Backup-Bedingung: CAN-Botschaft PWM_LADESPANNUNG" UWORD B_TRUE 1 100 0 1 BIT_MASK 0x40 FORMAT "%13.11" ECU_ADDRESS 0x3FE598 /end MEASUREMENT
/begin MEASUREMENT B_bkx3b0 "Backup-Bedingung: CAN-Botschaft ST_GANG_R‹CKWƒRTS" UWORD B_TRUE 1 100 0 1 BIT_MASK 0x40 FORMAT "%13.11" ECU_ADDRESS 0x3FE59A /end MEASUREMENT
/begin MEASUREMENT B_bkx3b4 "Backup-Bedingung: CAN-Botschaft PWM_BATTERIESPANNUNG" UWORD B_TRUE 1 100 0 1 BIT_MASK 0x40 FORMAT "%13.11" ECU_ADDRESS 0x3FE59C /end MEASUREMENT
/begin MEASUREMENT B_bkxc4 "Backup-Bedingung: CAN-Botschaft LENKRADWINKEL" UWORD B_TRUE 1 100 0 1 BIT_MASK 0x40 FORMAT "%13.11" ECU_ADDRESS 0x3FE59E /end MEASUREMENT
/begin MEASUREMENT B_calcelse "Bedingung: Berechnung Endstufen-Diagnose E-Box Luefter" UBYTE B_TRUE 1 100 0 1 BIT_MASK 0x1 FORMAT "%13.11" ECU_ADDRESS 0x3FC04F /end MEASUREMENT
/begin MEASUREMENT B_cfcend "Pr¸fung Check Filler Cap beendet" UBYTE B_TRUE 1 100 0 1 BIT_MASK 0x1 FORMAT "%13.11" ECU_ADDRESS 0x4035E7 /end MEASUREMENT
/begin MEASUREMENT B_cfceolas "Hinweislampe Check Filler Cap war bereits angesteuert" UBYTE B_TRUE 1 100 0 1 BIT_MASK 0x1 FORMAT "%13.11" ECU_ADDRESS 0x3FE2A0 /end MEASUREMENT
/begin MEASUREMENT B_cfceos "Anforderung an TLD: Check Filler Cap starten" UBYTE B_TRUE 1 100 0 1 BIT_MASK 0x2 FORMAT "%13.11" ECU_ADDRESS 0x4035E6 /end MEASUREMENT
/begin MEASUREMENT B_cfcheal "Heilungspr¸fung Check Filler Cap kann durchgef¸hrt werden" UBYTE B_TRUE 1 100 0 1 BIT_MASK 0x2 FORMAT "%13.11" ECU_ADDRESS 0x3FE2A0 /end MEASUREMENT
/begin MEASUREMENT B_cfcio "Filler Cap geschlossen (in Ordnung)" UBYTE B_TRUE 1 100 0 1 BIT_MASK 0x2 FORMAT "%13.11" ECU_ADDRESS 0x4035E7 /end MEASUREMENT
/begin MEASUREMENT B_cfcnio "Filler Cap open (nicht in Ordnung)" UBYTE B_TRUE 1 100 0 1 BIT_MASK 0x4 FORMAT "%13.11" ECU_ADDRESS 0x3FE2A0 /end MEASUREMENT
/begin MEASUREMENT B_cfctafg "Check Filler Cap  notwendig, da Betankung stattgefunden hat" UBYTE B_TRUE 1 100 0 1 BIT_MASK 0x8 FORMAT "%13.11" ECU_ADDRESS 0x3FE2A0 /end MEASUREMENT
/begin MEASUREMENT B_cfczae "Freigabe des Fahrzyklenz‰hlers bei Check Filler Cap" UBYTE B_TRUE 1 100 0 1 BIT_MASK 0x10 FORMAT "%13.11" ECU_ADDRESS 0x4035E7 /end MEASUREMENT
/begin MEASUREMENT B_clakre "Bedingung Fehlerpfad Abgasklappe Endstufe lˆschen" UWORD B_TRUE 1 100 0 1 BIT_MASK 0x80 FORMAT "%13.11" ECU_ADDRESS 0x3FE3B0 /end MEASUREMENT
/begin MEASUREMENT B_clanske "Bedingung: Fehlerpfad Endstufe Ansaugklappe lˆschen" UWORD B_TRUE 1 100 0 1 BIT_MASK 0x80 FORMAT "%13.11" ECU_ADDRESS 0x3FE3B2 /end MEASUREMENT
/begin MEASUREMENT B_clcacc "Bedingung Fehlerpfad CACC lˆschen" UWORD B_TRUE 1 100 0 1 BIT_MASK 0x80 FORMAT "%13.11" ECU_ADDRESS 0x3FE3C2 /end MEASUREMENT
/begin MEASUREMENT B_clcafs "Bedingung Fehlerpfad CAFS lˆschen" UWORD B_TRUE 1 100 0 1 BIT_MASK 0x80 FORMAT "%13.11" ECU_ADDRESS 0x3FE3C4 /end MEASUREMENT
/begin MEASUREMENT B_clcana "Bedingung Fehlerpfad CANA lˆschen" UWORD B_TRUE 1 100 0 1 BIT_MASK 0x80 FORMAT "%13.11" ECU_ADDRESS 0x3FE3C6 /end MEASUREMENT
/begin MEASUREMENT B_clcanb "Bedingung Fehlerpfad CANB lˆschen" UWORD B_TRUE 1 100 0 1 BIT_MASK 0x80 FORMAT "%13.11" ECU_ADDRESS 0x3FE3C8 /end MEASUREMENT
/begin MEASUREMENT B_clcuhr "" UWORD B_TRUE 1 100 0 1 BIT_MASK 0x80 FORMAT "%13.11" ECU_ADDRESS 0x3FE3DE /end MEASUREMENT
/begin MEASUREMENT B_cllsv "Fehlerpfad in DLSV lˆschen." UWORD B_TRUE 1 100 0 1 BIT_MASK 0x80 FORMAT "%13.11" ECU_ADDRESS 0x3FE4FA /end MEASUREMENT
/begin MEASUREMENT B_cllsv2 "Fehlerpfad in DLSV lˆschen.  Bank2" UWORD B_TRUE 1 100 0 1 BIT_MASK 0x80 FORMAT "%13.11" ECU_ADDRESS 0x3FE4FC /end MEASUREMENT
/begin MEASUREMENT B_clradlra "Bedingung: Adaptionswerte Lambdasondenalterung selektiv loeschen" UBYTE B_TRUE 1 100 0 1 BIT_MASK 0x1 FORMAT "%13.11" ECU_ADDRESS 0x403B71 /end MEASUREMENT
/begin MEASUREMENT B_clswe "Flag : Fehlerpfad Diagnose Beschleunigungssensor lˆschen" UWORD B_TRUE 1 100 0 1 BIT_MASK 0x80 FORMAT "%13.11" ECU_ADDRESS 0x3FE55E /end MEASUREMENT
/begin MEASUREMENT B_clx135 "Bedingung Fehlerpfad lˆschen" UWORD B_TRUE 1 100 0 1 BIT_MASK 0x80 FORMAT "%13.11" ECU_ADDRESS 0x3FE594 /end MEASUREMENT
/begin MEASUREMENT B_clx315 "Bedingung Fehlerpfad lˆschen" UWORD B_TRUE 1 100 0 1 BIT_MASK 0x80 FORMAT "%13.11" ECU_ADDRESS 0x3FE596 /end MEASUREMENT
/begin MEASUREMENT B_clx334 "Bedingung Fehlerpfad lˆschen" UWORD B_TRUE 1 100 0 1 BIT_MASK 0x80 FORMAT "%13.11" ECU_ADDRESS 0x3FE598 /end MEASUREMENT
/begin MEASUREMENT B_clx3b0 "Bedingung Fehlerpfad lˆschen" UWORD B_TRUE 1 100 0 1 BIT_MASK 0x80 FORMAT "%13.11" ECU_ADDRESS 0x3FE59A /end MEASUREMENT
/begin MEASUREMENT B_clx3b4 "Bedingung Fehlerpfad lˆschen" UWORD B_TRUE 1 100 0 1 BIT_MASK 0x80 FORMAT "%13.11" ECU_ADDRESS 0x3FE59C /end MEASUREMENT
/begin MEASUREMENT B_clxc4 "Bedingung Fehlerpfad lˆschen" UWORD B_TRUE 1 100 0 1 BIT_MASK 0x80 FORMAT "%13.11" ECU_ADDRESS 0x3FE59E /end MEASUREMENT
/begin MEASUREMENT B_cotrim "Bedingung f¸r LL-CO Abgleich erf¸llt" UBYTE B_TRUE 1 100 0 1 BIT_MASK 0x1 FORMAT "%13.11" ECU_ADDRESS 0x3FC097 /end MEASUREMENT
/begin MEASUREMENT B_dcy "Bedingung 'driving cycle' erkannt" UBYTE B_TRUE 1 100 0 1 BIT_MASK 0x1 FORMAT "%13.11" ECU_ADDRESS 0x403AD9 /end MEASUREMENT
/begin MEASUREMENT B_desee "Diagnose Endstufe: Eingangsbedingungen erf¸llt" UBYTE B_TRUE 1 100 0 1 BIT_MASK 0x1 FORMAT "%13.11" ECU_ADDRESS 0x3FC04E /end MEASUREMENT
/begin MEASUREMENT B_diffnl "Phaseninterrupts ohne DG Signal f¸hren zum Notlauf" UBYTE B_TRUE 1 100 0 1 BIT_MASK 0x2 FORMAT "%13.11" ECU_ADDRESS 0x402972 /end MEASUREMENT
/begin MEASUREMENT B_diffsi "Phaseninterrupts trotz keinem DG Signal f¸hren zu DG Signalfehler" UBYTE B_TRUE 1 100 0 1 BIT_MASK 0x4 FORMAT "%13.11" ECU_ADDRESS 0x402972 /end MEASUREMENT
/begin MEASUREMENT B_disareg "Bedingung Fehler in Regelung" UBYTE dez 1 100 0 255 FORMAT "%5.1" ECU_ADDRESS 0x402C48 /end MEASUREMENT
/begin MEASUREMENT B_diwisch "Bedingung DISA-Wischfunktion starten" UBYTE dez 1 100 0 255 FORMAT "%5.1" ECU_ADDRESS 0x3FE0DF /end MEASUREMENT
/begin MEASUREMENT B_dmpmea "Bedingung Endstufendiagnose DMTL-Pumpe aktiv" UBYTE B_TRUE 1 100 0 1 BIT_MASK 0x1 FORMAT "%13.11" ECU_ADDRESS 0x402BEF /end MEASUREMENT
/begin MEASUREMENT B_dmtdddbr "Bedingung Wegstreckenentprellung angefordert" UBYTE B_TRUE 1 100 0 1 BIT_MASK 0x4 FORMAT "%13.11" ECU_ADDRESS 0x3FE2B7 /end MEASUREMENT
/begin MEASUREMENT B_dmtgvb "Tankentl¸ftungssystem Verdacht Grobleck gespeichert" UBYTE B_TRUE 1 100 0 1 BIT_MASK 0x20 FORMAT "%13.11" ECU_ADDRESS 0x3FE2A0 /end MEASUREMENT
/begin MEASUREMENT B_dmtgvloc "lokale Kopie des letzten Ergebnisses der Grobleckpr¸fung" UBYTE B_TRUE 1 100 0 1 BIT_MASK 0x8 FORMAT "%13.11" ECU_ADDRESS 0x3FE2B7 /end MEASUREMENT
/begin MEASUREMENT B_dmtllhv "Bedingung Anforderung Feinleckpr¸fung wegen Leck-Heilung oder -Verifizierung" UBYTE B_TRUE 1 100 0 1 BIT_MASK 0x1 FORMAT "%13.11" ECU_ADDRESS 0x4035E9 /end MEASUREMENT
/begin MEASUREMENT B_dmtlmv "Bedingung DMTL-Magnetventil an" UBYTE B_TRUE 1 100 0 1 BIT_MASK 0x1 FORMAT "%13.11" ECU_ADDRESS 0x402BEE /end MEASUREMENT
/begin MEASUREMENT B_dmtlpm "Bedingung DMTL-Pumpenmotor an" UBYTE B_TRUE 1 100 0 1 BIT_MASK 0x1 FORMAT "%13.11" ECU_ADDRESS 0x3FC04D /end MEASUREMENT
/begin MEASUREMENT B_dmtmvdhp "Heilungspuls DM-TL Pumpenmotor (Endstufe) bei hoher Dauerleistung" UBYTE B_TRUE 1 100 0 1 BIT_MASK 0x1 FORMAT "%13.11" ECU_ADDRESS 0x4038CA /end MEASUREMENT
/begin MEASUREMENT B_dmtmve "Anforderung Magnetventil bestromt bei externem Modus des Zustandsautomaten" UBYTE B_TRUE 1 100 0 1 BIT_MASK 0x1 FORMAT "%13.11" ECU_ADDRESS 0x4035EE /end MEASUREMENT
/begin MEASUREMENT B_dmtmvkhp "Heilungspuls DM-TL Pumpenmotor (Endstufe) bei Kurzschluﬂ nach Ub" UBYTE B_TRUE 1 100 0 1 BIT_MASK 0x2 FORMAT "%13.11" ECU_ADDRESS 0x4038CA /end MEASUREMENT
/begin MEASUREMENT B_dmtpme "Anforderung aktiver Pumpe im externen Modus des Zustandsautomaten" UBYTE B_TRUE 1 100 0 1 BIT_MASK 0x2 FORMAT "%13.11" ECU_ADDRESS 0x4035EE /end MEASUREMENT
/begin MEASUREMENT B_dmtrfm2 "Bedingung zweite Referenzmessung aktiv" UBYTE B_TRUE 1 100 0 1 BIT_MASK 0x1 FORMAT "%13.11" ECU_ADDRESS 0x403042 /end MEASUREMENT
/begin MEASUREMENT B_drlmx "Last‰nderung unterhalb Schwellwert" UBYTE B_TRUE 1 100 0 1 BIT_MASK 0x1 FORMAT "%13.11" ECU_ADDRESS 0x403B6A /end MEASUREMENT
/begin MEASUREMENT B_dylsu "Dynamik LSU gepr¸ft" UBYTE B_TRUE 1 100 0 1 BIT_MASK 0x1 FORMAT "%13.11" ECU_ADDRESS 0x403B6D /end MEASUREMENT
/begin MEASUREMENT B_dylsu2 "Dynamik LSU2 gepr¸ft" UBYTE B_TRUE 1 100 0 1 BIT_MASK 0x1 FORMAT "%13.11" ECU_ADDRESS 0x403B70 /end MEASUREMENT
/begin MEASUREMENT B_dylsuav "Dynamik¸berwachung LSU aktiv" UBYTE B_TRUE 1 100 0 1 BIT_MASK 0x2 FORMAT "%13.11" ECU_ADDRESS 0x403B6D /end MEASUREMENT
/begin MEASUREMENT B_dylsuav2 "Dynamik¸berwachung LSU2 aktiv" UBYTE B_TRUE 1 100 0 1 BIT_MASK 0x2 FORMAT "%13.11" ECU_ADDRESS 0x403B70 /end MEASUREMENT
/begin MEASUREMENT B_dylsuf "Freigabe Dynamikpr¸fung LSU" UBYTE B_TRUE 1 100 0 1 BIT_MASK 0x1 FORMAT "%13.11" ECU_ADDRESS 0x403B6C /end MEASUREMENT
/begin MEASUREMENT B_dyslsu2 "Steigung LSU 2 gepr¸ft" UBYTE B_TRUE 1 100 0 1 BIT_MASK 0x1 FORMAT "%13.11" ECU_ADDRESS 0x403B6F /end MEASUREMENT
/begin MEASUREMENT B_edmtg "Tankentl¸ftungssystem Grobleck" UBYTE B_TRUE 1 100 0 1 BIT_MASK 0x1 FORMAT "%13.11" ECU_ADDRESS 0x4035F2 /end MEASUREMENT
/begin MEASUREMENT B_edprcana "Bedingung Fehler im dualported Ram CAN A" UBYTE B_TRUE 1 100 0 1 BIT_MASK 0x1 FORMAT "%13.11" ECU_ADDRESS 0x40377D /end MEASUREMENT
/begin MEASUREMENT B_edprcanb "Bedingung Fehler im dualported Ram CAN B" UBYTE B_TRUE 1 100 0 1 BIT_MASK 0x1 FORMAT "%13.11" ECU_ADDRESS 0x40377E /end MEASUREMENT
/begin MEASUREMENT B_eepcod1 "Data ID im Flash und EEPROM Spiegel unterschiedlich" UBYTE B_TRUE 1 100 0 1 BIT_MASK 0x1 FORMAT "%13.11" ECU_ADDRESS 0x3FC1E1 /end MEASUREMENT
/begin MEASUREMENT B_eev "Bedingung Endstufenfehler EV" UBYTE B_TRUE 1 100 0 1 BIT_MASK 0x1 FORMAT "%13.11" ECU_ADDRESS 0x3FC050 /end MEASUREMENT
/begin MEASUREMENT B_enabddg "Ausblendung der Drehzahlgeberdiagnose f¸r E_bm" UBYTE B_TRUE 1 100 0 1 BIT_MASK 0x8 FORMAT "%13.11" ECU_ADDRESS 0x402972 /end MEASUREMENT
/begin MEASUREMENT B_enwmn "Nockenwellensteuerung: Min Position nicht ok (Einlaﬂ Nockenwelle 1)" UBYTE B_TRUE 1 100 0 1 BIT_MASK 0x10 FORMAT "%13.11" ECU_ADDRESS 0x40368E /end MEASUREMENT
/begin MEASUREMENT B_enwmn2 "Nockenwellensteuerung: Min. Position nicht ok (Einlaﬂ Nockenwelle 2)" UBYTE B_TRUE 1 100 0 1 BIT_MASK 0x40 FORMAT "%13.11" ECU_ADDRESS 0x40368E /end MEASUREMENT
/begin MEASUREMENT B_enwpnp "Nockenwellensteuerung: Position nicht plausibel (Einlaﬂ Nockenwelle 1)" UBYTE B_TRUE 1 100 0 1 BIT_MASK 0x1 FORMAT "%13.11" ECU_ADDRESS 0x40368E /end MEASUREMENT
/begin MEASUREMENT B_enwpnp2 "Nockenwellensteuerung: Position nicht plausibel (Einlaﬂ Nockenwelle 2)" UBYTE B_TRUE 1 100 0 1 BIT_MASK 0x4 FORMAT "%13.11" ECU_ADDRESS 0x40368E /end MEASUREMENT
/begin MEASUREMENT B_epcl "Bedingung f¸r Ansteuerung EGAS-Fehlerlampe" UBYTE B_TRUE 1 100 0 1 BIT_MASK 0x1 FORMAT "%13.11" ECU_ADDRESS 0x40284A /end MEASUREMENT
/begin MEASUREMENT B_epclloc "Bedingung f¸r Ansteuerung EGAS-Fehlerlampe loc." UBYTE B_TRUE 1 100 0 1 BIT_MASK 0x2 FORMAT "%13.11" ECU_ADDRESS 0x40284A /end MEASUREMENT
/begin MEASUREMENT B_evanos "Fehler im Vanos nach letztem Reset" UBYTE B_TRUE 1 100 0 1 FORMAT "%13.11" ECU_ADDRESS 0x4039BB /end MEASUREMENT
/begin MEASUREMENT B_fadmtl "Bedingung Funktionsanforderung Tankentl¸ftungssystem" UBYTE B_TRUE 1 100 0 1 BIT_MASK 0x2 FORMAT "%13.11" ECU_ADDRESS 0x403042 /end MEASUREMENT
/begin MEASUREMENT B_fadtlbe "Bedingung Systemtest Tankentl¸ftungssystem bei Fz-Produktion" UBYTE B_TRUE 1 100 0 1 BIT_MASK 0x1 FORMAT "%13.11" ECU_ADDRESS 0x3FE1CA /end MEASUREMENT
/begin MEASUREMENT B_fam8dmtl "Bedingung: Funktionsanforderung DM-TL Tankleckdiagnose durch Mode 8" UBYTE B_TRUE 1 100 0 1 BIT_MASK 0x8 FORMAT "%13.11" ECU_ADDRESS 0x403042 /end MEASUREMENT
/begin MEASUREMENT B_fopr "Bedingung Leckdiagnose: erster Betrieb des Magnetventils" UBYTE B_TRUE 1 100 0 1 BIT_MASK 0x4 FORMAT "%13.11" ECU_ADDRESS 0x4035EE /end MEASUREMENT
/begin MEASUREMENT B_ftakre "Bedingung: Fehlereintrag durch Tester f¸r Abgasklappe Endstufe" UWORD B_TRUE 1 100 0 1 BIT_MASK 0x10 FORMAT "%13.11" ECU_ADDRESS 0x3FE3B0 /end MEASUREMENT
/begin MEASUREMENT B_ftanske "Bedingung: Fehlereintrag durch Tester f¸r ANSKL" UWORD B_TRUE 1 100 0 1 BIT_MASK 0x10 FORMAT "%13.11" ECU_ADDRESS 0x3FE3B2 /end MEASUREMENT
/begin MEASUREMENT B_ftcacc "Bedingung Fehlereintrag durch Tester: CAN-Schnittstelle ACC" UWORD B_TRUE 1 100 0 1 BIT_MASK 0x10 FORMAT "%13.11" ECU_ADDRESS 0x3FE3C2 /end MEASUREMENT
/begin MEASUREMENT B_ftcafs "Bedingung Fehlereintrag durch Tester: CAN-Schnittstelle AFS" UWORD B_TRUE 1 100 0 1 BIT_MASK 0x10 FORMAT "%13.11" ECU_ADDRESS 0x3FE3C4 /end MEASUREMENT
/begin MEASUREMENT B_ftcana "Bedingung Fehlereintrag durch Tester: CANA-Diagnose" UWORD B_TRUE 1 100 0 1 BIT_MASK 0x10 FORMAT "%13.11" ECU_ADDRESS 0x3FE3C6 /end MEASUREMENT
/begin MEASUREMENT B_ftcanb "Bedingung Fehlereintrag durch Tester: CANB-Diagnose" UWORD B_TRUE 1 100 0 1 BIT_MASK 0x10 FORMAT "%13.11" ECU_ADDRESS 0x3FE3C8 /end MEASUREMENT
/begin MEASUREMENT B_ftcuhr "Bedingung: Fehlereintrag durch Tester,   CAN  rel. Zeitgeber" UWORD B_TRUE 1 100 0 1 BIT_MASK 0x10 FORMAT "%13.11" ECU_ADDRESS 0x3FE3DE /end MEASUREMENT
/begin MEASUREMENT B_ftlsv "Bedingung Fehlereintrag durch Tester Lambda Sonde vor KAT" UWORD B_TRUE 1 100 0 1 BIT_MASK 0x10 FORMAT "%13.11" ECU_ADDRESS 0x3FE4FA /end MEASUREMENT
/begin MEASUREMENT B_ftlsv2 "Bedingung Fehlereintrag durch Tester Lambda Sonde vor KAT Bank2" UWORD B_TRUE 1 100 0 1 BIT_MASK 0x10 FORMAT "%13.11" ECU_ADDRESS 0x3FE4FC /end MEASUREMENT
/begin MEASUREMENT B_ftswe "Bedingung Fehlereintrag durch Tester:  Schlechtwegerkennung" UWORD B_TRUE 1 100 0 1 BIT_MASK 0x10 FORMAT "%13.11" ECU_ADDRESS 0x3FE55E /end MEASUREMENT
/begin MEASUREMENT B_ftx135 "Bedingung Fehlereintrag durch Tester" UWORD B_TRUE 1 100 0 1 BIT_MASK 0x10 FORMAT "%13.11" ECU_ADDRESS 0x3FE594 /end MEASUREMENT
/begin MEASUREMENT B_ftx315 "Bedingung Fehlereintrag durch Tester" UWORD B_TRUE 1 100 0 1 BIT_MASK 0x10 FORMAT "%13.11" ECU_ADDRESS 0x3FE596 /end MEASUREMENT
/begin MEASUREMENT B_ftx334 "Bedingung Fehlereintrag durch Tester" UWORD B_TRUE 1 100 0 1 BIT_MASK 0x10 FORMAT "%13.11" ECU_ADDRESS 0x3FE598 /end MEASUREMENT
/begin MEASUREMENT B_ftx3b0 "Bedingung Fehlereintrag durch Tester" UWORD B_TRUE 1 100 0 1 BIT_MASK 0x10 FORMAT "%13.11" ECU_ADDRESS 0x3FE59A /end MEASUREMENT
/begin MEASUREMENT B_ftx3b4 "Bedingung Fehlereintrag durch Tester" UWORD B_TRUE 1 100 0 1 BIT_MASK 0x10 FORMAT "%13.11" ECU_ADDRESS 0x3FE59C /end MEASUREMENT
/begin MEASUREMENT B_ftxc4 "Bedingung Fehlereintrag durch Tester" UWORD B_TRUE 1 100 0 1 BIT_MASK 0x10 FORMAT "%13.11" ECU_ADDRESS 0x3FE59E /end MEASUREMENT
/begin MEASUREMENT B_healmxbm "Bedingung: Heilung des Fehlers <zu h‰ufige BM Korrektur>" UBYTE B_TRUE 1 100 0 1 BIT_MASK 0x10 FORMAT "%13.11" ECU_ADDRESS 0x402972 /end MEASUREMENT
/begin MEASUREMENT B_healnpbm "Bedingung: Heilung des Fehlers <Bezugsmarkenverlust>" UBYTE B_TRUE 1 100 0 1 BIT_MASK 0x20 FORMAT "%13.11" ECU_ADDRESS 0x402972 /end MEASUREMENT
/begin MEASUREMENT B_healnpn "Zustand heile nicht plausibel Drehzahlfehler" UBYTE B_TRUE 1 100 0 1 BIT_MASK 0x4 FORMAT "%13.11" ECU_ADDRESS 0x402973 /end MEASUREMENT
/begin MEASUREMENT B_healsibm "Bedingung: Heilung Fehler <Bezugsmarkenpr¸fung>" UBYTE B_TRUE 1 100 0 1 BIT_MASK 0x40 FORMAT "%13.11" ECU_ADDRESS 0x402972 /end MEASUREMENT
/begin MEASUREMENT B_minflsu "Dynamikfehler LSU, Bank1" UBYTE B_TRUE 1 100 0 1 BIT_MASK 0x4 FORMAT "%13.11" ECU_ADDRESS 0x403B6D /end MEASUREMENT
/begin MEASUREMENT B_minflsu2 "Dynamikfehler LSU, Bank2" UBYTE B_TRUE 1 100 0 1 BIT_MASK 0x4 FORMAT "%13.11" ECU_ADDRESS 0x403B70 /end MEASUREMENT
/begin MEASUREMENT B_minslsu2 "Steigungsfehler LSU, Bank2" UBYTE B_TRUE 1 100 0 1 BIT_MASK 0x8 FORMAT "%13.11" ECU_ADDRESS 0x403B6F /end MEASUREMENT
/begin MEASUREMENT B_mnakre "Fehlerart: Kurzschluﬂ Masse Abgasklappe Endstufe" UWORD B_TRUE 1 100 0 1 BIT_MASK 0x200 FORMAT "%13.11" ECU_ADDRESS 0x3FE3B0 /end MEASUREMENT
/begin MEASUREMENT B_mnanske "Fehlertype: Kurzschluss nach Masse Endstufe Ansaugklappe" UWORD B_TRUE 1 100 0 1 BIT_MASK 0x200 FORMAT "%13.11" ECU_ADDRESS 0x3FE3B2 /end MEASUREMENT
/begin MEASUREMENT B_mncacc "Bedingung: min-Fehler CAN-ACC-Botschaft" UWORD B_TRUE 1 100 0 1 BIT_MASK 0x200 FORMAT "%13.11" ECU_ADDRESS 0x3FE3C2 /end MEASUREMENT
/begin MEASUREMENT B_mncafs "Aktivit‰tsfehler CAN- AFS-Botschaft" UWORD B_TRUE 1 100 0 1 BIT_MASK 0x200 FORMAT "%13.11" ECU_ADDRESS 0x3FE3C4 /end MEASUREMENT
/begin MEASUREMENT B_mncana "Bedingung min-Fehler,  DPRAM defekt (von CAN_A)" UWORD B_TRUE 1 100 0 1 BIT_MASK 0x200 FORMAT "%13.11" ECU_ADDRESS 0x3FE3C6 /end MEASUREMENT
/begin MEASUREMENT B_mncanb "Bedingung min-Fehler,  DPRAM defekt (von CAN_B)" UWORD B_TRUE 1 100 0 1 BIT_MASK 0x200 FORMAT "%13.11" ECU_ADDRESS 0x3FE3C8 /end MEASUREMENT
/begin MEASUREMENT B_mncuhr "MN-Fehler CAN  rel. Zeitgeber" UWORD B_TRUE 1 100 0 1 BIT_MASK 0x200 FORMAT "%13.11" ECU_ADDRESS 0x3FE3DE /end MEASUREMENT
/begin MEASUREMENT B_mnlsv "Fehlertyp 'Minimalwert' vor KAT erkannt" UWORD B_TRUE 1 100 0 1 BIT_MASK 0x200 FORMAT "%13.11" ECU_ADDRESS 0x3FE4FA /end MEASUREMENT
/begin MEASUREMENT B_mnlsv2 "Fehlertyp 'Minimalwert' vor KAT erkannt  Bank2" UWORD B_TRUE 1 100 0 1 BIT_MASK 0x200 FORMAT "%13.11" ECU_ADDRESS 0x3FE4FC /end MEASUREMENT
/begin MEASUREMENT B_mnswe "Beschleunigungssensorsignal kleiner als Plausibilit‰tsschwelle" UWORD B_TRUE 1 100 0 1 BIT_MASK 0x200 FORMAT "%13.11" ECU_ADDRESS 0x3FE55E /end MEASUREMENT
/begin MEASUREMENT B_mnx135 "Fehlertyp Minfehler CAN-Botschaft ST_EKP_CRASHABSCHALTUNG" UWORD B_TRUE 1 100 0 1 BIT_MASK 0x200 FORMAT "%13.11" ECU_ADDRESS 0x3FE594 /end MEASUREMENT
/begin MEASUREMENT B_mnx315 "Fehlertyp Minfehler CAN-Botschaft FAHRZEUGMODUS" UWORD B_TRUE 1 100 0 1 BIT_MASK 0x200 FORMAT "%13.11" ECU_ADDRESS 0x3FE596 /end MEASUREMENT
/begin MEASUREMENT B_mnx334 "Fehlertyp Minfehler CAN-Botschaft PWM_LADESPANNUNG" UWORD B_TRUE 1 100 0 1 BIT_MASK 0x200 FORMAT "%13.11" ECU_ADDRESS 0x3FE598 /end MEASUREMENT
/begin MEASUREMENT B_mnx3b0 "Fehlertyp Minfehler CAN-Botschaft ST_GANG_R‹CKWƒRTS" UWORD B_TRUE 1 100 0 1 BIT_MASK 0x200 FORMAT "%13.11" ECU_ADDRESS 0x3FE59A /end MEASUREMENT
/begin MEASUREMENT B_mnx3b4 "Fehlertyp Minfehler CAN-Botschaft PWM_BATTERIESPANNUNG" UWORD B_TRUE 1 100 0 1 BIT_MASK 0x200 FORMAT "%13.11" ECU_ADDRESS 0x3FE59C /end MEASUREMENT
/begin MEASUREMENT B_mnxc4 "Fehlertyp Minfehler CAN-Botschaft LENKRADWINKEL" UWORD B_TRUE 1 100 0 1 BIT_MASK 0x200 FORMAT "%13.11" ECU_ADDRESS 0x3FE59E /end MEASUREMENT
/begin MEASUREMENT B_mstpssg "Bedingung Motorstopanforderung vom SSG wir umgesetzt" UBYTE B_TRUE 1 100 0 1 BIT_MASK 0x1 FORMAT "%13.11" ECU_ADDRESS 0x3FBEEE /end MEASUREMENT
/begin MEASUREMENT B_mxakre "Fehlerart: Kurzschluﬂ nach UBat Abgasklappe Endstufe" UWORD B_TRUE 1 100 0 1 BIT_MASK 0x100 FORMAT "%13.11" ECU_ADDRESS 0x3FE3B0 /end MEASUREMENT
/begin MEASUREMENT B_mxanske "Fehlertype: Kurzschluss nach Ubatt Endstufe Ansaugklappe" UWORD B_TRUE 1 100 0 1 BIT_MASK 0x100 FORMAT "%13.11" ECU_ADDRESS 0x3FE3B2 /end MEASUREMENT
/begin MEASUREMENT B_mxcacc "Fehlertyp: Maximalwertueberschreitung" UWORD B_TRUE 1 100 0 1 BIT_MASK 0x100 FORMAT "%13.11" ECU_ADDRESS 0x3FE3C2 /end MEASUREMENT
/begin MEASUREMENT B_mxcafs "Maxfehler CAN-AFS" UWORD B_TRUE 1 100 0 1 BIT_MASK 0x100 FORMAT "%13.11" ECU_ADDRESS 0x3FE3C4 /end MEASUREMENT
/begin MEASUREMENT B_mxcana "Bedingung max-Fehler,   (CAN_A ""Error passiv"")" UWORD B_TRUE 1 100 0 1 BIT_MASK 0x100 FORMAT "%13.11" ECU_ADDRESS 0x3FE3C6 /end MEASUREMENT
/begin MEASUREMENT B_mxcanb "Bedingung max-Fehler,   (CAN_B ""Error passiv"")" UWORD B_TRUE 1 100 0 1 BIT_MASK 0x100 FORMAT "%13.11" ECU_ADDRESS 0x3FE3C8 /end MEASUREMENT
/begin MEASUREMENT B_mxcuhr "MX-Fehler CAN  rel. Zeitgeber" UWORD B_TRUE 1 100 0 1 BIT_MASK 0x100 FORMAT "%13.11" ECU_ADDRESS 0x3FE3DE /end MEASUREMENT
/begin MEASUREMENT B_mxlsv "Fehlertyp 'Maximalwert' vor KAT erkannt" UWORD B_TRUE 1 100 0 1 BIT_MASK 0x100 FORMAT "%13.11" ECU_ADDRESS 0x3FE4FA /end MEASUREMENT
/begin MEASUREMENT B_mxlsv2 "Fehlertyp 'Maximalwert' vor KAT erkannt Bank2" UWORD B_TRUE 1 100 0 1 BIT_MASK 0x100 FORMAT "%13.11" ECU_ADDRESS 0x3FE4FC /end MEASUREMENT
/begin MEASUREMENT B_mxswe "Beschleunigungssensorsignal grˆﬂer als Plausibilit‰tsschwelle" UWORD B_TRUE 1 100 0 1 BIT_MASK 0x100 FORMAT "%13.11" ECU_ADDRESS 0x3FE55E /end MEASUREMENT
/begin MEASUREMENT B_mxx135 "Fehlertyp Maxfehler CAN-Botschaft ST_EKP_CRASHABSCHALTUNG" UWORD B_TRUE 1 100 0 1 BIT_MASK 0x100 FORMAT "%13.11" ECU_ADDRESS 0x3FE594 /end MEASUREMENT
/begin MEASUREMENT B_mxx315 "Fehlertyp Maxfehler CAN-Botschaft FAHRZEUGMODUS" UWORD B_TRUE 1 100 0 1 BIT_MASK 0x100 FORMAT "%13.11" ECU_ADDRESS 0x3FE596 /end MEASUREMENT
/begin MEASUREMENT B_mxx334 "Fehlertyp Maxfehler CAN-Botschaft PWM_LADESPANNUNG" UWORD B_TRUE 1 100 0 1 BIT_MASK 0x100 FORMAT "%13.11" ECU_ADDRESS 0x3FE598 /end MEASUREMENT
/begin MEASUREMENT B_mxx3b0 "Fehlertyp Maxfehler CAN-Botschaft ST_GANG_R‹CKWƒRTS" UWORD B_TRUE 1 100 0 1 BIT_MASK 0x100 FORMAT "%13.11" ECU_ADDRESS 0x3FE59A /end MEASUREMENT
/begin MEASUREMENT B_mxx3b4 "Fehlertyp Maxfehler CAN-Botschaft PWM_BATTERIESPANNUNG" UWORD B_TRUE 1 100 0 1 BIT_MASK 0x100 FORMAT "%13.11" ECU_ADDRESS 0x3FE59C /end MEASUREMENT
/begin MEASUREMENT B_mxxc4 "Fehlertyp Maxfehler CAN-Botschaft LENKRADWINKEL" UWORD B_TRUE 1 100 0 1 BIT_MASK 0x100 FORMAT "%13.11" ECU_ADDRESS 0x3FE59E /end MEASUREMENT
/begin MEASUREMENT B_nlbm "Bedingung f¸r NLDG wenn Bezugsmarke h‰ufig verloren wird" UBYTE B_TRUE 1 100 0 1 BIT_MASK 0x1 FORMAT "%13.11" ECU_ADDRESS 0x402973 /end MEASUREMENT
/begin MEASUREMENT B_nldg "Bedingung Drehzahlgeber-Notlauf ist aktiv." UBYTE B_TRUE 1 100 0 1 BIT_MASK 0x1 FORMAT "%13.11" ECU_ADDRESS 0x3FBF77 /end MEASUREMENT
/begin MEASUREMENT B_no "unendlich-Trigger f¸r Fehlerpfadmanagement" UBYTE B_TRUE 1 100 0 1 BIT_MASK 0x1 FORMAT "%13.11" ECU_ADDRESS 0x3FDEE5 /end MEASUREMENT
/begin MEASUREMENT B_nom8dmtl "Bedingung: Start der DMTL ¸ber Scan-Tool Mode 8 nicht mˆglich" UBYTE B_TRUE 1 100 0 1 BIT_MASK 0x10 FORMAT "%13.11" ECU_ADDRESS 0x403042 /end MEASUREMENT
/begin MEASUREMENT B_npakre "Fehlerart: Endstufe Abgasklappe unplausibel" UWORD B_TRUE 1 100 0 1 BIT_MASK 0x800 FORMAT "%13.11" ECU_ADDRESS 0x3FE3B0 /end MEASUREMENT
/begin MEASUREMENT B_npanske "Fehlertype: Wert unplausibel Ansaugklappe Endstufe" UWORD B_TRUE 1 100 0 1 BIT_MASK 0x800 FORMAT "%13.11" ECU_ADDRESS 0x3FE3B2 /end MEASUREMENT
/begin MEASUREMENT B_npcacc "Plausfehler CAN-ACC-Botschaft" UWORD B_TRUE 1 100 0 1 BIT_MASK 0x800 FORMAT "%13.11" ECU_ADDRESS 0x3FE3C2 /end MEASUREMENT
/begin MEASUREMENT B_npcafs "Plausfehler der AFS-Botschaft" UWORD B_TRUE 1 100 0 1 BIT_MASK 0x800 FORMAT "%13.11" ECU_ADDRESS 0x3FE3C4 /end MEASUREMENT
/begin MEASUREMENT B_npcafsv "Bedingung Plausfehler der AFS-Botschaft nicht entprellt" UBYTE B_TRUE 1 100 0 1 BIT_MASK 0x1 FORMAT "%13.11" ECU_ADDRESS 0x3FBEEB /end MEASUREMENT
/begin MEASUREMENT B_npcana "Bedingung Plausfehler  (CAN_A ""Bus off"")" UWORD B_TRUE 1 100 0 1 BIT_MASK 0x800 FORMAT "%13.11" ECU_ADDRESS 0x3FE3C6 /end MEASUREMENT
/begin MEASUREMENT B_npcanb "Bedingung Plausfehler  (CAN_B ""Bus off"")" UWORD B_TRUE 1 100 0 1 BIT_MASK 0x800 FORMAT "%13.11" ECU_ADDRESS 0x3FE3C8 /end MEASUREMENT
/begin MEASUREMENT B_npcarsv "Bedingung Plausfehler der ARS-Botschaft nicht entprellt" UBYTE B_TRUE 1 100 0 1 BIT_MASK 0x1 FORMAT "%13.11" ECU_ADDRESS 0x3FBEEC /end MEASUREMENT
/begin MEASUREMENT B_npcuhr "NPL-Fehler CAN  rel. Zeitgeber unplausibel" UWORD B_TRUE 1 100 0 1 BIT_MASK 0x800 FORMAT "%13.11" ECU_ADDRESS 0x3FE3DE /end MEASUREMENT
/begin MEASUREMENT B_nplsv "Fehlertyp 'Wert unplausibel' erkannt" UWORD B_TRUE 1 100 0 1 BIT_MASK 0x800 FORMAT "%13.11" ECU_ADDRESS 0x3FE4FA /end MEASUREMENT
/begin MEASUREMENT B_nplsv2 "Fehlertyp 'Wert unplausibel' erkannt Bank2" UWORD B_TRUE 1 100 0 1 BIT_MASK 0x800 FORMAT "%13.11" ECU_ADDRESS 0x3FE4FC /end MEASUREMENT
/begin MEASUREMENT B_npswe "Beschleunigungssensorsignal ist nicht plausibel" UWORD B_TRUE 1 100 0 1 BIT_MASK 0x800 FORMAT "%13.11" ECU_ADDRESS 0x3FE55E /end MEASUREMENT
/begin MEASUREMENT B_npx135 "Fehlerart Plausfehler CAN-Botschaft ST_EKP_CRASHABSCHALTUNG" UWORD B_TRUE 1 100 0 1 BIT_MASK 0x800 FORMAT "%13.11" ECU_ADDRESS 0x3FE594 /end MEASUREMENT
/begin MEASUREMENT B_npx315 "Fehlerart Plausfehler CAN-Botschaft FAHRZEUGMODUS" UWORD B_TRUE 1 100 0 1 BIT_MASK 0x800 FORMAT "%13.11" ECU_ADDRESS 0x3FE596 /end MEASUREMENT
/begin MEASUREMENT B_npx334 "Fehlerart Plausfehler CAN-Botschaft PWM_LADESPANNUNG" UWORD B_TRUE 1 100 0 1 BIT_MASK 0x800 FORMAT "%13.11" ECU_ADDRESS 0x3FE598 /end MEASUREMENT
/begin MEASUREMENT B_npx3b0 "Fehlerart Plausfehler CAN-Botschaft ST_GANG_R‹CKWƒRTS" UWORD B_TRUE 1 100 0 1 BIT_MASK 0x800 FORMAT "%13.11" ECU_ADDRESS 0x3FE59A /end MEASUREMENT
/begin MEASUREMENT B_npx3b4 "Fehlerart Plausfehler CAN-Botschaft PWM_BATTERIESPANNUNG" UWORD B_TRUE 1 100 0 1 BIT_MASK 0x800 FORMAT "%13.11" ECU_ADDRESS 0x3FE59C /end MEASUREMENT
/begin MEASUREMENT B_npxc4 "Fehlerart Plausfehler CAN-Botschaft LENKRADWINKEL" UWORD B_TRUE 1 100 0 1 BIT_MASK 0x800 FORMAT "%13.11" ECU_ADDRESS 0x3FE59E /end MEASUREMENT
/begin MEASUREMENT B_onetime "Information der BM wurde einmal ausgewertet oder 2 KW Umdrehungen" UBYTE B_TRUE 1 100 0 1 BIT_MASK 0x2 FORMAT "%13.11" ECU_ADDRESS 0x402973 /end MEASUREMENT
/begin MEASUREMENT B_phad "Adaption Kurbel/Nockenwelle erfolgt" UBYTE B_TRUE 1 100 0 1 BIT_MASK 0x1 FORMAT "%13.11" ECU_ADDRESS 0x40368D /end MEASUREMENT
/begin MEASUREMENT B_phad2 "Adaption Kurbel-/Nockenwelle 2 erfolgt" UBYTE B_TRUE 1 100 0 1 BIT_MASK 0x4 FORMAT "%13.11" ECU_ADDRESS 0x40368D /end MEASUREMENT
/begin MEASUREMENT B_phad3 "Adaption Kurbel-/Nockenwelle 3 erfolgt" UBYTE B_TRUE 1 100 0 1 BIT_MASK 0x2 FORMAT "%13.11" ECU_ADDRESS 0x40368D /end MEASUREMENT
/begin MEASUREMENT B_phad4 "Adaption Kurbel-/Nockenwelle 4 erfolgt" UBYTE B_TRUE 1 100 0 1 BIT_MASK 0x8 FORMAT "%13.11" ECU_ADDRESS 0x40368D /end MEASUREMENT
/begin MEASUREMENT B_phada1 "Adaption Kurbel- zu Nockenwelle von Auslass Bank 1 erfolgt" UBYTE B_TRUE 1 100 0 1 BIT_MASK 0x2 FORMAT "%13.11" ECU_ADDRESS 0x3FE042 /end MEASUREMENT
/begin MEASUREMENT B_phada2 "Adaption Kurbel- zu Nockenwelle von Auslass Bank 2 erfolgt" UBYTE B_TRUE 1 100 0 1 BIT_MASK 0x4 FORMAT "%13.11" ECU_ADDRESS 0x3FE042 /end MEASUREMENT
/begin MEASUREMENT B_phade1 "Adaption Kurbel- zu Nockenwelle von Einlass Bank 1 erfolgt" UBYTE B_TRUE 1 100 0 1 BIT_MASK 0x10 FORMAT "%13.11" ECU_ADDRESS 0x3FE042 /end MEASUREMENT
/begin MEASUREMENT B_phade2 "Adaption Kurbel- zu Nockenwelle von Einlass Bank 2 erfolgt" UBYTE B_TRUE 1 100 0 1 BIT_MASK 0x20 FORMAT "%13.11" ECU_ADDRESS 0x3FE042 /end MEASUREMENT
/begin MEASUREMENT B_pmedlo "Hohe Dauerverlustleistung DM-TL Pumpenmotor (Endstufe)" UBYTE B_TRUE 1 100 0 1 BIT_MASK 0x2 FORMAT "%13.11" ECU_ADDRESS 0x3FE0BC /end MEASUREMENT
/begin MEASUREMENT B_pmekso "Kurzschluﬂ Ubat DM-TL Pumpenmotor (Endstufe)" UBYTE B_TRUE 1 100 0 1 BIT_MASK 0x1 FORMAT "%13.11" ECU_ADDRESS 0x3FE0BC /end MEASUREMENT
/begin MEASUREMENT B_pmkste "Bedingung DM-TL Pumpenmotor (Endstufe) Kurzschluﬂtest Enable" UBYTE B_TRUE 1 100 0 1 BIT_MASK 0x4 FORMAT "%13.11" ECU_ADDRESS 0x4038CA /end MEASUREMENT
/begin MEASUREMENT B_poti "Bedingung Poti-Grenzwerte verletzt nach Verzˆgerung" UBYTE dez 1 100 0 255 FORMAT "%5.1" ECU_ADDRESS 0x402C49 /end MEASUREMENT
/begin MEASUREMENT B_potimn "Bedingung unterer Poti-Grenzwert unterschritten" UBYTE dez 1 100 0 255 FORMAT "%5.1" ECU_ADDRESS 0x402C4A /end MEASUREMENT
/begin MEASUREMENT B_potimx "Bedingung oberer Poti-Grenzwert ¸berschritten" UBYTE dez 1 100 0 255 FORMAT "%5.1" ECU_ADDRESS 0x402C4B /end MEASUREMENT
/begin MEASUREMENT B_potiv "Bedingung Poti-Grenzwerte verletzt" UBYTE dez 1 100 0 255 FORMAT "%5.1" ECU_ADDRESS 0x402C4C /end MEASUREMENT
/begin MEASUREMENT B_prsen "Anforderung Diagnose als Drucksensor" UBYTE B_TRUE 1 100 0 1 BIT_MASK 0x8 FORMAT "%13.11" ECU_ADDRESS 0x4035EE /end MEASUREMENT
/begin MEASUREMENT B_rdytlio "ready-Info (i.o.) des Teilsystems Tankleckdiagnose (TLD) (lokal)" UBYTE B_TRUE 1 100 0 1 BIT_MASK 0x2 FORMAT "%13.11" ECU_ADDRESS 0x3FE2B7 /end MEASUREMENT
/begin MEASUREMENT B_rdytlnio "ready-Info (nicht i.o.) des Teilsystems Tankleckdiagnose (TLD) (lokal)" UBYTE B_TRUE 1 100 0 1 BIT_MASK 0x1 FORMAT "%13.11" ECU_ADDRESS 0x3FE2B7 /end MEASUREMENT
/begin MEASUREMENT B_sfadmtle "Bedingung gespeicherte Funktionsanforderung DMTL" UBYTE B_TRUE 1 100 0 1 BIT_MASK 0x20 FORMAT "%13.11" ECU_ADDRESS 0x403042 /end MEASUREMENT
/begin MEASUREMENT B_siakre "Fehlerart: Leitungsabfall Abgasklappe Endstufe" UWORD B_TRUE 1 100 0 1 BIT_MASK 0x400 FORMAT "%13.11" ECU_ADDRESS 0x3FE3B0 /end MEASUREMENT
/begin MEASUREMENT B_sianske "Fehlertype: Leitungsabfall Endstufe Ansaugklappe" UWORD B_TRUE 1 100 0 1 BIT_MASK 0x400 FORMAT "%13.11" ECU_ADDRESS 0x3FE3B2 /end MEASUREMENT
/begin MEASUREMENT B_siars_fr "Bedingung Alive-Check ARS-Alive-Counter nicht OK" UBYTE B_TRUE 1 100 0 1 BIT_MASK 0x1 FORMAT "%13.11" ECU_ADDRESS 0x3FBEED /end MEASUREMENT
/begin MEASUREMENT B_sicacc "Signalfehler CAN-Timeout ACC-Botschaft" UWORD B_TRUE 1 100 0 1 BIT_MASK 0x400 FORMAT "%13.11" ECU_ADDRESS 0x3FE3C2 /end MEASUREMENT
/begin MEASUREMENT B_sicafs "Signalfehler CAN-Timeout AFS-Botschaft" UWORD B_TRUE 1 100 0 1 BIT_MASK 0x400 FORMAT "%13.11" ECU_ADDRESS 0x3FE3C4 /end MEASUREMENT
/begin MEASUREMENT B_sicana "Signalfehler CANA Bus Off" UWORD B_TRUE 1 100 0 1 BIT_MASK 0x400 FORMAT "%13.11" ECU_ADDRESS 0x3FE3C6 /end MEASUREMENT
/begin MEASUREMENT B_sicanb "Signalfehler, LOCAN BUS OFF-Fehler" UWORD B_TRUE 1 100 0 1 BIT_MASK 0x400 FORMAT "%13.11" ECU_ADDRESS 0x3FE3C8 /end MEASUREMENT
/begin MEASUREMENT B_sicuhr "SIG-Fehler  CAN  rel. Zeitgeber" UWORD B_TRUE 1 100 0 1 BIT_MASK 0x400 FORMAT "%13.11" ECU_ADDRESS 0x3FE3DE /end MEASUREMENT
/begin MEASUREMENT B_siins_fr "Bedingung Kombi-SG Alivecounter wird nicht korrekt inkrement. bzw. bleibt stehen" UBYTE B_TRUE 1 100 0 1 BIT_MASK 0x2 FORMAT "%13.11" ECU_ADDRESS 0x40283E /end MEASUREMENT
/begin MEASUREMENT B_silsv "Fehlertyp 'Signal fehlt' vor KAT erkannt" UWORD B_TRUE 1 100 0 1 BIT_MASK 0x400 FORMAT "%13.11" ECU_ADDRESS 0x3FE4FA /end MEASUREMENT
/begin MEASUREMENT B_silsv2 "Fehlertyp 'Signal fehlt' vor KAT erkannt Bank2" UWORD B_TRUE 1 100 0 1 BIT_MASK 0x400 FORMAT "%13.11" ECU_ADDRESS 0x3FE4FC /end MEASUREMENT
/begin MEASUREMENT B_siswe "Fehlertyp: Geschwindigkeitssignal nicht vorhanden" UWORD B_TRUE 1 100 0 1 BIT_MASK 0x400 FORMAT "%13.11" ECU_ADDRESS 0x3FE55E /end MEASUREMENT
/begin MEASUREMENT B_six135 "Fehlerart Signalfehler CAN-Botschaft Botschaft-ST_EKP_CRASHABSCHALTUNG" UWORD B_TRUE 1 100 0 1 BIT_MASK 0x400 FORMAT "%13.11" ECU_ADDRESS 0x3FE594 /end MEASUREMENT
/begin MEASUREMENT B_six315 "Fehlerart Signalfehler CAN-Botschaft FAHRZEUGMODUS" UWORD B_TRUE 1 100 0 1 BIT_MASK 0x400 FORMAT "%13.11" ECU_ADDRESS 0x3FE596 /end MEASUREMENT
/begin MEASUREMENT B_six334 "Fehlerart Signalfehler CAN-Botschaft PWM_LADESPANNUNG" UWORD B_TRUE 1 100 0 1 BIT_MASK 0x400 FORMAT "%13.11" ECU_ADDRESS 0x3FE598 /end MEASUREMENT
/begin MEASUREMENT B_six3b0 "Fehlerart Signalfehler CAN-Botschaft ST_GANG_R‹CKWƒRTS" UWORD B_TRUE 1 100 0 1 BIT_MASK 0x400 FORMAT "%13.11" ECU_ADDRESS 0x3FE59A /end MEASUREMENT
/begin MEASUREMENT B_six3b4 "Fehlerart Signalfehler CAN-Botschaft PWM_BATTERIESPANNUNG" UWORD B_TRUE 1 100 0 1 BIT_MASK 0x400 FORMAT "%13.11" ECU_ADDRESS 0x3FE59C /end MEASUREMENT
/begin MEASUREMENT B_sixc4 "Fehlerart Signalfehler CAN-Botschaft LENKRADWINKEL" UWORD B_TRUE 1 100 0 1 BIT_MASK 0x400 FORMAT "%13.11" ECU_ADDRESS 0x3FE59E /end MEASUREMENT
/begin MEASUREMENT B_sm8te "Bedingung Anforderung Mode 8 gespeichert" UBYTE B_TRUE 1 100 0 1 BIT_MASK 0x40 FORMAT "%13.11" ECU_ADDRESS 0x403042 /end MEASUREMENT
/begin MEASUREMENT B_sp3 "Spezial-Bereichs-Trigger der Diagnose Kraftstoffversorgungssystem" UBYTE B_TRUE 1 100 0 1 BIT_MASK 0x1 FORMAT "%13.11" ECU_ADDRESS 0x3FDEE6 /end MEASUREMENT
/begin MEASUREMENT B_stcal "Bedingung: alle Eingangsbedingungen der Dynamikpr¸fung sind gegeben" UBYTE B_TRUE 1 100 0 1 BIT_MASK 0x8 FORMAT "%13.11" ECU_ADDRESS 0x403B6D /end MEASUREMENT
/begin MEASUREMENT B_stcal2 "Bedingung: alle Eingangsbedingungen der Dynamikpr¸fung sind gegeben, Bank2" UBYTE B_TRUE 1 100 0 1 BIT_MASK 0x8 FORMAT "%13.11" ECU_ADDRESS 0x403B70 /end MEASUREMENT
/begin MEASUREMENT B_stcdyn "Bedingung Start Berechnung Dynamik der LSU" UBYTE B_TRUE 1 100 0 1 BIT_MASK 0x1 FORMAT "%13.11" ECU_ADDRESS 0x403B6B /end MEASUREMENT
/begin MEASUREMENT B_stcdyn2 "Bedingung Start Berechnung Dynamik der LSU, Bank 2" UBYTE B_TRUE 1 100 0 1 BIT_MASK 0x1 FORMAT "%13.11" ECU_ADDRESS 0x403B6E /end MEASUREMENT
/begin MEASUREMENT B_tankd "Ansteuerung Lampe Check-Filler-Cap" UBYTE B_TRUE 1 100 0 1 BIT_MASK 0x1 FORMAT "%13.11" ECU_ADDRESS 0x4035E6 /end MEASUREMENT
/begin MEASUREMENT B_tankdff "Ansteuerung Lampe Check-Filler-Cap (gespeichert)" UBYTE B_TRUE 1 100 0 1 BIT_MASK 0x4 FORMAT "%13.11" ECU_ADDRESS 0x4035E7 /end MEASUREMENT
/begin MEASUREMENT B_tankdo "Tankdeckel offen" UBYTE B_TRUE 1 100 0 1 BIT_MASK 0x8 FORMAT "%13.11" ECU_ADDRESS 0x4035E7 /end MEASUREMENT
/begin MEASUREMENT B_tcm8sa "Statusanfage durch Mode 08 liegt vor" UBYTE B_TRUE 1 100 0 1 BIT_MASK 0x80 FORMAT "%13.11" ECU_ADDRESS 0x403042 /end MEASUREMENT
/begin MEASUREMENT B_tim "Zeit-Trigger f¸r Fehlerpfadmanagement" UBYTE B_TRUE 1 100 0 1 BIT_MASK 0x1 FORMAT "%13.11" ECU_ADDRESS 0x403B2B /end MEASUREMENT
/begin MEASUREMENT B_tlddfpen "Speicherung des Ergebnisses der Tankleckdiagnose in den DFPM" UBYTE B_TRUE 1 100 0 1 BIT_MASK 0x4 FORMAT "%13.11" ECU_ADDRESS 0x4035F2 /end MEASUREMENT
/begin MEASUREMENT B_tldlhvtk "Condition: Refuelling event detected" UBYTE B_TRUE 1 100 0 1 BIT_MASK 0x1 FORMAT "%13.11" ECU_ADDRESS 0x3FE2A1 /end MEASUREMENT
/begin MEASUREMENT B_tldmvdcy "Bedingung: DMTL Magnetventil wurde im laufenden Fahrzyklus bereits aktiviert" UBYTE B_TRUE 1 100 0 1 BIT_MASK 0x10 FORMAT "%13.11" ECU_ADDRESS 0x4035EE /end MEASUREMENT
/begin MEASUREMENT B_tldtevda "Diagnose TEV-Pr¸fung mit DM-TL ist aktiv" UBYTE B_TRUE 1 100 0 1 BIT_MASK 0x20 FORMAT "%13.11" ECU_ADDRESS 0x4035EE /end MEASUREMENT
/begin MEASUREMENT B_toleol "Toleranzfehler bei Bandendetest DM-TL" UBYTE B_TRUE 1 100 0 1 BIT_MASK 0x1 FORMAT "%13.11" ECU_ADDRESS 0x4035EA /end MEASUREMENT
/begin MEASUREMENT B_wnwinla "Bedingung: Winkeldifferenz wnwia1_w nicht plausibel" UBYTE B_TRUE 1 100 0 1 BIT_MASK 0x10 FORMAT "%13.11" ECU_ADDRESS 0x403B34 /end MEASUREMENT
/begin MEASUREMENT B_wnwinla2 "Bedingung: Winkeldifferenz wnwia2_w nicht plausibel" UBYTE B_TRUE 1 100 0 1 BIT_MASK 0x20 FORMAT "%13.11" ECU_ADDRESS 0x403B34 /end MEASUREMENT
/begin MEASUREMENT B_wnwinle "Bedingung: Winkeldifferenz wnwie1_w nicht plausibel" UBYTE B_TRUE 1 100 0 1 BIT_MASK 0x40 FORMAT "%13.11" ECU_ADDRESS 0x403B34 /end MEASUREMENT
/begin MEASUREMENT B_wnwinle2 "Bedingung: Winkeldifferenz wnwie2_w nicht plausibel" UBYTE B_TRUE 1 100 0 1 BIT_MASK 0x80 FORMAT "%13.11" ECU_ADDRESS 0x403B34 /end MEASUREMENT
/begin MEASUREMENT B_zdmtg "Zyklusflag: Tankentl¸ftungssystem Grobleck" UBYTE B_TRUE 1 100 0 1 BIT_MASK 0x2 FORMAT "%13.11" ECU_ADDRESS 0x4035F2 /end MEASUREMENT
/begin MEASUREMENT B_zdpmee "Zyklusflag: Kurzschluss nach Masse DM-TL Pumpenmotor" UBYTE B_TRUE 1 100 0 1 BIT_MASK 0x1 FORMAT "%13.11" ECU_ADDRESS 0x402BF0 /end MEASUREMENT
/begin MEASUREMENT B_zmedlo "Zyklusflag: Dauer-Verlustleistung DM-TL Pumpenmotor zu hoch" UBYTE B_TRUE 1 100 0 1 BIT_MASK 0x10 FORMAT "%13.11" ECU_ADDRESS 0x4038CA /end MEASUREMENT
/begin MEASUREMENT B_zmekso "Zyklusflag: Kurzschluss nach ub DM-TL Pumpenmotor" UBYTE B_TRUE 1 100 0 1 BIT_MASK 0x8 FORMAT "%13.11" ECU_ADDRESS 0x4038CA /end MEASUREMENT
/begin MEASUREMENT canastat "Fehlerstatus des CAN A" UBYTE dez 1 100 0 255 FORMAT "%5.1" ECU_ADDRESS 0x40282C /end MEASUREMENT
/begin MEASUREMENT canbstat "Fehlerstatus des CAN B" UBYTE dez 1 100 0 255 FORMAT "%5.1" ECU_ADDRESS 0x40282D /end MEASUREMENT
/begin MEASUREMENT co_pot "Leerlauf-CO-Gemisch-Versteller" SBYTE dez 1 100 -128 127 FORMAT "%5.1" ECU_ADDRESS 0x403BCD /end MEASUREMENT
/begin MEASUREMENT co_pot_w "Leerlauf-CO-Gemisch-Versteller" SWORD dez 1 100 -32768 32767 FORMAT "%8.2" ECU_ADDRESS 0x403FE4 /end MEASUREMENT
/begin MEASUREMENT dakreAusBitsNV "" UBYTE dez 1 100 0 255 FORMAT "%5.1" ECU_ADDRESS 0x3FE0BB /end MEASUREMENT
/begin MEASUREMENT dcfceoAusBits "" UBYTE dez 1 100 0 255 FORMAT "%5.1" ECU_ADDRESS 0x4035E6 /end MEASUREMENT
/begin MEASUREMENT dcfceoLokBits "" UBYTE dez 1 100 0 255 FORMAT "%5.1" ECU_ADDRESS 0x4035E7 /end MEASUREMENT
/begin MEASUREMENT dcfceoLokBitsNov "" UBYTE dez 1 100 0 255 FORMAT "%5.1" ECU_ADDRESS 0x3FE2A0 /end MEASUREMENT
/begin MEASUREMENT dcinsAusBits "" UBYTE dez 1 100 0 255 FORMAT "%5.1" ECU_ADDRESS 0x40283E /end MEASUREMENT
/begin MEASUREMENT dcycnt "Driving cycle - counter" UWORD dez 1 100 0 65535 FORMAT "%8.2" ECU_ADDRESS 0x3FDEE0 /end MEASUREMENT
/begin MEASUREMENT ddgLokBits1 "" UBYTE dez 1 100 0 255 FORMAT "%5.1" ECU_ADDRESS 0x402972 /end MEASUREMENT
/begin MEASUREMENT ddgLokBits2 "" UBYTE dez 1 100 0 255 FORMAT "%5.1" ECU_ADDRESS 0x402973 /end MEASUREMENT
/begin MEASUREMENT ddmmveAusBits "" UBYTE dez 1 100 0 255 FORMAT "%5.1" ECU_ADDRESS 0x402BEE /end MEASUREMENT
/begin MEASUREMENT ddmpmeAusBitsIni "" UBYTE dez 1 100 0 255 FORMAT "%5.1" ECU_ADDRESS 0x402BEF /end MEASUREMENT
/begin MEASUREMENT ddmpmeAusBitsNov10ms "" UBYTE dez 1 100 0 255 FORMAT "%5.1" ECU_ADDRESS 0x3FE0BC /end MEASUREMENT
/begin MEASUREMENT ddmpmeLokBits100ms "" UBYTE dez 1 100 0 255 FORMAT "%5.1" ECU_ADDRESS 0x402BF0 /end MEASUREMENT
/begin MEASUREMENT ddmpmeLokBits10ms "" UBYTE dez 1 100 0 255 FORMAT "%5.1" ECU_ADDRESS 0x4038CA /end MEASUREMENT
/begin MEASUREMENT ddmtllhvAusBits "" UBYTE dez 1 100 0 255 FORMAT "%5.1" ECU_ADDRESS 0x4035E9 /end MEASUREMENT
/begin MEASUREMENT ddmtllhvLokBitsNov "" UBYTE dez 1 100 0 255 FORMAT "%5.1" ECU_ADDRESS 0x3FE2A1 /end MEASUREMENT
/begin MEASUREMENT ddmtlsvLokBits "" UBYTE dez 1 100 0 255 FORMAT "%5.1" ECU_ADDRESS 0x4035EA /end MEASUREMENT
/begin MEASUREMENT ddmtltcAusBits "" UBYTE dez 1 100 0 255 FORMAT "%5.1" ECU_ADDRESS 0x403042 /end MEASUREMENT
/begin MEASUREMENT ddmtltcAusBitsNov "" UBYTE dez 1 100 0 255 FORMAT "%5.1" ECU_ADDRESS 0x3FE1CA /end MEASUREMENT
/begin MEASUREMENT ddmtlterAusBits "" UBYTE dez 1 100 0 255 FORMAT "%5.1" ECU_ADDRESS 0x4035EE /end MEASUREMENT
/begin MEASUREMENT dekpe "Statusbyte Diagnose EKP Endstufe" UBYTE dez 1 100 0 255 FORMAT "%5.1" ECU_ADDRESS 0x402BF1 /end MEASUREMENT
/begin MEASUREMENT depclAusBits "" UBYTE dez 1 100 0 255 FORMAT "%5.1" ECU_ADDRESS 0x40284A /end MEASUREMENT
/begin MEASUREMENT dfcmFcm "plausibisierter FCM-EIntrag (aktiver Eintrag)" UBYTE dez 1 100 0 255 FORMAT "%5.1" ECU_ADDRESS 0x3FDEE7 /end MEASUREMENT
/begin MEASUREMENT dfcmNo "plausibilisierter FCM-EIntrag (leer)" UBYTE dez 1 100 0 255 FORMAT "%5.1" ECU_ADDRESS 0x3FDEE8 /end MEASUREMENT
/begin MEASUREMENT dfcmSfp "plausibilisierter Fehlerpfad" UBYTE dez 1 100 0 255 FORMAT "%5.1" ECU_ADDRESS 0x3FDEE9 /end MEASUREMENT
/begin MEASUREMENT dfpdmtlAusBits "" UBYTE dez 1 100 0 255 FORMAT "%5.1" ECU_ADDRESS 0x4035F2 /end MEASUREMENT
/begin MEASUREMENT dfpdmtlAusBitsNov "" UBYTE dez 1 100 0 255 FORMAT "%5.1" ECU_ADDRESS 0x3FE2B7 /end MEASUREMENT
/begin MEASUREMENT dfpmEpclState "" UWORD dez 1 100 0 65535 FORMAT "%8.2" ECU_ADDRESS 0x3FDEE4 /end MEASUREMENT
/begin MEASUREMENT dfpmMilState "" UWORD dez 1 100 0 65535 FORMAT "%8.2" ECU_ADDRESS 0x3FDEE3 /end MEASUREMENT
/begin MEASUREMENT dfp_ap "aktueller Fehler f¸r Dauerlaufmessung" UBYTE dez 1 100 0 255 FORMAT "%5.1" ECU_ADDRESS 0x3FDEEA /end MEASUREMENT
/begin MEASUREMENT disa_sta "Status DISA" UBYTE dez 1 100 0 255 FORMAT "%5.1" ECU_ADDRESS 0x4038CB /end MEASUREMENT
/begin MEASUREMENT di_ed_cnt "Entprellz‰hler f¸r DISA Error disable" UBYTE t20msxs_ub_b5p1 1 100 0 5.1 FORMAT "%5.3" ECU_ADDRESS 0x402C7C /end MEASUREMENT
/begin MEASUREMENT di_ee_cnt "Entprellz‰hler f¸r DISA Error enable" UBYTE t20msxs_ub_b5p1 1 100 0 5.1 FORMAT "%5.3" ECU_ADDRESS 0x402C7D /end MEASUREMENT
/begin MEASUREMENT di_wad_cnt "Entprellz‰hler f¸r DISA Warnung disable" UBYTE t20msxs_ub_b5p1 1 100 0 5.1 FORMAT "%5.3" ECU_ADDRESS 0x402C7E /end MEASUREMENT
/begin MEASUREMENT di_wae_cnt "Entprellz‰hler f¸r DISA Warnung enable" UBYTE t20msxs_ub_b5p1 1 100 0 5.1 FORMAT "%5.3" ECU_ADDRESS 0x402C7F /end MEASUREMENT
/begin MEASUREMENT dlahi2_u "I-Anteil der stetigen LRHK Bank2 (Byte)" SBYTE fak_q4p883Em4 1 100 -0.0625 0.0620117 FORMAT "%7.5" ECU_ADDRESS 0x403AE0 /end MEASUREMENT
/begin MEASUREMENT dlahi_u "I-Anteil der stetigen LRHK (Byte)" SBYTE fak_q4p883Em4 1 100 -0.0625 0.0620117 FORMAT "%7.5" ECU_ADDRESS 0x403AE1 /end MEASUREMENT
/begin MEASUREMENT dmgarss_w "Momentengradient Sollmoment ARS-Eingriff" SWORD rel_sw_b100 1 100 -100 99.9969 FORMAT "%8.4" ECU_ADDRESS 0x402830 /end MEASUREMENT
/begin MEASUREMENT dmgars_w "Deltamoment zwischen Soll- und Ist-Eingriff ARS" SWORD rel_sw_b100 1 100 -100 99.9969 FORMAT "%8.4" ECU_ADDRESS 0x402832 /end MEASUREMENT
/begin MEASUREMENT dmrlsv_w "Momenten-Reserve f¸r Sondendiagnose vor Kat" UWORD rel_uw_b100 1 100 0 99.9985 FORMAT "%8.5" ECU_ADDRESS 0x402A3E /end MEASUREMENT
/begin MEASUREMENT dtfstcfc "Abweichung F¸llstandsgeber f¸r Check Filler Cap" UWORD vol_q0p1_l 1 100 0 6553.5 FORMAT "%8.3" ECU_ADDRESS 0x4035DC /end MEASUREMENT
/begin MEASUREMENT dtrgmem_w "Memory-Word f¸r DFPM-Trigger" UWORD dez 1 100 0 65535 FORMAT "%8.2" ECU_ADDRESS 0x3FDEEC /end MEASUREMENT
/begin MEASUREMENT dynlsu2_u "Dynamikwert der LSU Bank2 (Byte)" UBYTE fak_ub_b4 1 100 0 3.98438 FORMAT "%5.3" ECU_ADDRESS 0x403AE2 /end MEASUREMENT
/begin MEASUREMENT dynlsu2_w "Dynamikwert der LSU, Bank 2" UWORD fak_uw_b16 1 100 0 15.9998 FORMAT "%8.5" ECU_ADDRESS 0x3FE07A /end MEASUREMENT
/begin MEASUREMENT dynlsu_u "Dynamikwert der LSU (Byte)" UBYTE fak_ub_b4 1 100 0 3.98438 FORMAT "%5.3" ECU_ADDRESS 0x403AE3 /end MEASUREMENT
/begin MEASUREMENT dynlsu_w "Dynamikwert der LSU" UWORD fak_uw_b16 1 100 0 15.9998 FORMAT "%8.5" ECU_ADDRESS 0x3FE07C /end MEASUREMENT
/begin MEASUREMENT D_disaf_w "gefilterte Regelabweichung" SWORD vnstv_q0p00305 1 100 -100 99.9969 FORMAT "%7.3" ECU_ADDRESS 0x402C50 /end MEASUREMENT
/begin MEASUREMENT d_soc_u "Umweltbedinung Abstand zur Startf‰higkeitsgrenze" UBYTE rel_q1p024_o100 1 100 -100 161.121 FORMAT "%5.1" ECU_ADDRESS 0x403AE4 /end MEASUREMENT
/begin MEASUREMENT ekpfz "Endstufendiagnose EKP-Relais: Z‰hler zur Entprellung der Endstufenfehler" UBYTE dez 1 100 0 255 FORMAT "%5.1" ECU_ADDRESS 0x402BF2 /end MEASUREMENT
/begin MEASUREMENT ekppz "Endstufendiagnose EKP-Relais: Z‰hler f¸r Pr¸fpulsausgabe" UBYTE dez 1 100 0 255 FORMAT "%5.1" ECU_ADDRESS 0x402BF3 /end MEASUREMENT
/begin MEASUREMENT esst_stm05epmsb "" ULONG dez 1 100 0 4.29497e+009 FORMAT "%13.2" ECU_ADDRESS 0x404A2C /end MEASUREMENT
/begin MEASUREMENT E_akre "Error Flag: Abgasklappe Endstufe mit Resonator" UWORD B_TRUE 1 100 0 1 BIT_MASK 0x1 FORMAT "%13.11" ECU_ADDRESS 0x3FE3B0 /end MEASUREMENT
/begin MEASUREMENT E_anske "Errorflag: Ansaugklappe, Endstufe" UWORD B_TRUE 1 100 0 1 BIT_MASK 0x1 FORMAT "%13.11" ECU_ADDRESS 0x3FE3B2 /end MEASUREMENT
/begin MEASUREMENT E_cacc "Errorflag: CAN-Schnittstelle, Timeout ACC" UWORD B_TRUE 1 100 0 1 BIT_MASK 0x1 FORMAT "%13.11" ECU_ADDRESS 0x3FE3C2 /end MEASUREMENT
/begin MEASUREMENT E_cafs "Errorflag: CAN-Schnittstelle, Timeout AFS" UWORD B_TRUE 1 100 0 1 BIT_MASK 0x1 FORMAT "%13.11" ECU_ADDRESS 0x3FE3C4 /end MEASUREMENT
/begin MEASUREMENT E_cana "Errorflag: CAN-Schnittstelle ""CAN_A defekt""" UWORD B_TRUE 1 100 0 1 BIT_MASK 0x1 FORMAT "%13.11" ECU_ADDRESS 0x3FE3C6 /end MEASUREMENT
/begin MEASUREMENT E_canb "Errorflag: CAN-Schnittstelle ""CAN_B defekt""" UWORD B_TRUE 1 100 0 1 BIT_MASK 0x1 FORMAT "%13.11" ECU_ADDRESS 0x3FE3C8 /end MEASUREMENT
/begin MEASUREMENT E_cuhr "Errorflag  CAN  rel. Zeitgeber" UWORD B_TRUE 1 100 0 1 BIT_MASK 0x1 FORMAT "%13.11" ECU_ADDRESS 0x3FE3DE /end MEASUREMENT
/begin MEASUREMENT E_disager "Fehlerflag aus DDISAGER" UBYTE dez 1 100 0 255 FORMAT "%5.1" ECU_ADDRESS 0x402C4D /end MEASUREMENT
/begin MEASUREMENT E_disamot "Fehlerflag Wicklungsuebertemperatur DISA Stellmotor" UBYTE dez 1 100 0 255 FORMAT "%5.1" ECU_ADDRESS 0x402C4E /end MEASUREMENT
/begin MEASUREMENT E_disawarn "Warnflag Wicklungsuebertemperatur DISA Stellmotor" UBYTE dez 1 100 0 255 FORMAT "%5.1" ECU_ADDRESS 0x402C4F /end MEASUREMENT
/begin MEASUREMENT E_lsv "Errorflag: Lambda-Sonde vor Kat" UWORD B_TRUE 1 100 0 1 BIT_MASK 0x1 FORMAT "%13.11" ECU_ADDRESS 0x3FE4FA /end MEASUREMENT
/begin MEASUREMENT E_lsv2 "Errorflag: Lambda-Sonde 2 vor Kat" UWORD B_TRUE 1 100 0 1 BIT_MASK 0x1 FORMAT "%13.11" ECU_ADDRESS 0x3FE4FC /end MEASUREMENT
/begin MEASUREMENT E_swe "Errorflag: Beschleunigungssensor der Schlechtwegeerkennung" UWORD B_TRUE 1 100 0 1 BIT_MASK 0x1 FORMAT "%13.11" ECU_ADDRESS 0x3FE55E /end MEASUREMENT
/begin MEASUREMENT E_x135 "Errorflag CAN-Botschaft ST_EKP_CRASHABSCHALTUNG" UWORD B_TRUE 1 100 0 1 BIT_MASK 0x1 FORMAT "%13.11" ECU_ADDRESS 0x3FE594 /end MEASUREMENT
/begin MEASUREMENT E_x315 "Errorflag CAN-Botschaft FAHRZEUGMODUS" UWORD B_TRUE 1 100 0 1 BIT_MASK 0x1 FORMAT "%13.11" ECU_ADDRESS 0x3FE596 /end MEASUREMENT
/begin MEASUREMENT E_x334 "Errorflag CAN-Botschaft PWM_LADESPANNUNG" UWORD B_TRUE 1 100 0 1 BIT_MASK 0x1 FORMAT "%13.11" ECU_ADDRESS 0x3FE598 /end MEASUREMENT
/begin MEASUREMENT E_x3b0 "Errorflag CAN-Botschaft ST_GANG_R‹CKWƒRTS" UWORD B_TRUE 1 100 0 1 BIT_MASK 0x1 FORMAT "%13.11" ECU_ADDRESS 0x3FE59A /end MEASUREMENT
/begin MEASUREMENT E_x3b4 "Errorflag CAN-Botschaft PWM_BATTERIESPANNUNG" UWORD B_TRUE 1 100 0 1 BIT_MASK 0x1 FORMAT "%13.11" ECU_ADDRESS 0x3FE59C /end MEASUREMENT
/begin MEASUREMENT E_xc4 "Errorflag CAN-Botschaft LENKRADWINKEL" UWORD B_TRUE 1 100 0 1 BIT_MASK 0x1 FORMAT "%13.11" ECU_ADDRESS 0x3FE59E /end MEASUREMENT
/begin MEASUREMENT fcmcla_0_A "" UBYTE default 1 100 0 255 FORMAT "%5.1" ECU_ADDRESS 0x3FCFEE /end MEASUREMENT
/begin MEASUREMENT fcmdfp_0_A "" UBYTE default 1 100 0 255 FORMAT "%5.1" ECU_ADDRESS 0x3FCFEA /end MEASUREMENT
/begin MEASUREMENT fcmdlc_0_A "" UBYTE default 1 100 0 255 FORMAT "%5.1" ECU_ADDRESS 0x3FCFF2 /end MEASUREMENT
/begin MEASUREMENT fcmEnd "Anzahl Eintr‰ge im Fehlerspeicher" UBYTE dez 1 100 0 255 FORMAT "%5.1" ECU_ADDRESS 0x3FDEEB /end MEASUREMENT
/begin MEASUREMENT fcmfes_0_A "" UBYTE default 1 100 0 255 FORMAT "%5.1" ECU_ADDRESS 0x3FCFEF /end MEASUREMENT
/begin MEASUREMENT fcmflc_0_A "" UBYTE default 1 100 0 255 FORMAT "%5.1" ECU_ADDRESS 0x3FCFF0 /end MEASUREMENT
/begin MEASUREMENT fcmfps_0_A "" UBYTE default 1 100 0 255 FORMAT "%5.1" ECU_ADDRESS 0x3FCFED /end MEASUREMENT
/begin MEASUREMENT fcmfrz0_0_A "" UBYTE default 1 100 0 255 FORMAT "%5.1" ECU_ADDRESS 0x3FCFF3 /end MEASUREMENT
/begin MEASUREMENT fcmfrz1_0_A "" UBYTE default 1 100 0 255 FORMAT "%5.1" ECU_ADDRESS 0x3FCFF4 /end MEASUREMENT
/begin MEASUREMENT fcmfrz10_0_A "" UBYTE default 1 100 0 255 FORMAT "%5.1" ECU_ADDRESS 0x3FCFFD /end MEASUREMENT
/begin MEASUREMENT fcmfrz2_0_A "" UBYTE default 1 100 0 255 FORMAT "%5.1" ECU_ADDRESS 0x3FCFF5 /end MEASUREMENT
/begin MEASUREMENT fcmfrz3_0_A "" UBYTE default 1 100 0 255 FORMAT "%5.1" ECU_ADDRESS 0x3FCFF6 /end MEASUREMENT
/begin MEASUREMENT fcmfrz4_0_A "" UBYTE default 1 100 0 255 FORMAT "%5.1" ECU_ADDRESS 0x3FCFF7 /end MEASUREMENT
/begin MEASUREMENT fcmfrz5_0_A "" UBYTE default 1 100 0 255 FORMAT "%5.1" ECU_ADDRESS 0x3FCFF8 /end MEASUREMENT
/begin MEASUREMENT fcmfrz6_0_A "" UBYTE default 1 100 0 255 FORMAT "%5.1" ECU_ADDRESS 0x3FCFF9 /end MEASUREMENT
/begin MEASUREMENT fcmfrz7_0_A "" UBYTE default 1 100 0 255 FORMAT "%5.1" ECU_ADDRESS 0x3FCFFA /end MEASUREMENT
/begin MEASUREMENT fcmfrz8_0_A "" UBYTE default 1 100 0 255 FORMAT "%5.1" ECU_ADDRESS 0x3FCFFB /end MEASUREMENT
/begin MEASUREMENT fcmfrz9_0_A "" UBYTE default 1 100 0 255 FORMAT "%5.1" ECU_ADDRESS 0x3FCFFC /end MEASUREMENT
/begin MEASUREMENT fcmHis "" UBYTE dez 1 100 0 255 FORMAT "%5.1" ECU_ADDRESS 0x3FE884 /end MEASUREMENT
/begin MEASUREMENT fcmhlc_0_A "" UBYTE default 1 100 0 255 FORMAT "%5.1" ECU_ADDRESS 0x3FCFF1 /end MEASUREMENT
/begin MEASUREMENT fcmhz_0_A "" UBYTE default 1 100 0 255 FORMAT "%5.1" ECU_ADDRESS 0x3FD010 /end MEASUREMENT
/begin MEASUREMENT FCMTab "Fehlerspeichertabelle" UWORD dez 1 100 0 65535 FORMAT "%8.2" ECU_ADDRESS 0x3FCFEA /end MEASUREMENT
/begin MEASUREMENT fcmtsf_0_A "" UBYTE default 1 100 0 255 FORMAT "%5.1" ECU_ADDRESS 0x3FCFEB /end MEASUREMENT
/begin MEASUREMENT fcmtyp_0_A "" UBYTE default 1 100 0 255 FORMAT "%5.1" ECU_ADDRESS 0x3FCFEC /end MEASUREMENT
/begin MEASUREMENT fho_u "Korrekturfaktor Hˆhe (byte)" UBYTE fak_q0p015625 1 100 0 3.98438 FORMAT "%5.3" ECU_ADDRESS 0x40382B /end MEASUREMENT
/begin MEASUREMENT fkdyn_w "Korrekturfaktor  bzgl. AGR f¸r Modellerwartungswert dynlsu" UWORD fak_uw_b16 1 100 0 15.9998 FORMAT "%8.5" ECU_ADDRESS 0x403E8E /end MEASUREMENT
/begin MEASUREMENT fr2_u "Lambda-Regler-Ausgang; Bank2 (Byte)" UBYTE fak_ub_b2 1 100 0 1.99219 FORMAT "%5.3" ECU_ADDRESS 0x403AE5 /end MEASUREMENT
/begin MEASUREMENT fra2_u "multiplikative Gemischkorrektur der Gemischadaption (Byte)" UBYTE fak_ub_b2 1 100 0 1.99219 FORMAT "%5.3" ECU_ADDRESS 0x403AE6 /end MEASUREMENT
/begin MEASUREMENT frau2_u "multipl. Gemischadaptionsfaktor unterer mult. Bereich der Bank 2 (Byte)" UBYTE fak_ub_b2 1 100 0 1.99219 FORMAT "%5.3" ECU_ADDRESS 0x403AE7 /end MEASUREMENT
/begin MEASUREMENT frau_u "multiplikativer Gemischadaptionsfaktor unterer mult. Bereich (Byte)" UBYTE fak_ub_b2 1 100 0 1.99219 FORMAT "%5.3" ECU_ADDRESS 0x403AE8 /end MEASUREMENT
/begin MEASUREMENT fra_u "multiplikative Gemischkorrektur der Gemischadaption (Byte)" UBYTE fak_ub_b2 1 100 0 1.99219 FORMAT "%5.3" ECU_ADDRESS 0x403AE9 /end MEASUREMENT
/begin MEASUREMENT frhol_u "Umweltwert: Faktor Luftdichte f(Ansauglufttemp., Hˆhe) 8-Bit" UBYTE fak_ub_b2 1 100 0 1.99219 FORMAT "%5.3" ECU_ADDRESS 0x403AEA /end MEASUREMENT
/begin MEASUREMENT frm2_u "schneller Mittelwert des Lambdaregelfaktors Bank 2 (1 Byte f¸r Tester)" UBYTE fak_ub_b2 1 100 0 1.99219 FORMAT "%5.3" ECU_ADDRESS 0x403AEB /end MEASUREMENT
/begin MEASUREMENT frm_u "schneller Mittelwert des Lambdaregelfaktors ( 1 Byte f¸r Tester )" UBYTE fak_ub_b2 1 100 0 1.99219 FORMAT "%5.3" ECU_ADDRESS 0x403AEC /end MEASUREMENT
/begin MEASUREMENT fr_u "Lambda-Regler-Ausgang (Byte)" UBYTE fak_ub_b2 1 100 0 1.99219 FORMAT "%5.3" ECU_ADDRESS 0x403AED /end MEASUREMENT
/begin MEASUREMENT fs_pmold "" UBYTE DEZ 1 100 0 255 FORMAT "%5.1" ECU_ADDRESS 0x4031CB /end MEASUREMENT
/begin MEASUREMENT ftead_u "Beladung des Aktivkohlefilters" SBYTE fak_q0p5 1 100 -64 63.5 FORMAT "%5.2" ECU_ADDRESS 0x403AEE /end MEASUREMENT
/begin MEASUREMENT igod_u "Integratorgradient f¸r Nulltest-Diagnose Klopfregelung (1 Byte f¸r Tester)" SBYTE spgg_sb_b3052 1 100 -3052.01 3028.16 FORMAT "%5.0" ECU_ADDRESS 0x403AEF /end MEASUREMENT
/begin MEASUREMENT igokr_u "Integratorgradient f¸r Offsetkorrektur Klopfregelung (Byte)" SBYTE spgg_sb_b3052 1 100 -3052.01 3028.16 FORMAT "%5.0" ECU_ADDRESS 0x403AF0 /end MEASUREMENT
/begin MEASUREMENT iptgh_u "Differenz Pumpstrom zwischen Referenz und min. bei Grobleckm (1 Byte f¸r Tester)" UBYTE i_q0p1953_mA 1 100 0 49.8047 FORMAT "%5.2" ECU_ADDRESS 0x403AF1 /end MEASUREMENT
/begin MEASUREMENT iptref_u "Pumpenstrom Referenzleck (1 Byte f¸r Tester)" UBYTE i_q0p1953_mA 1 100 0 49.8047 FORMAT "%5.2" ECU_ADDRESS 0x403AF2 /end MEASUREMENT
/begin MEASUREMENT ko2vk_u "Umweltwert f¸r FFT: Korrekturfaktor f¸r Funktionspumstrom LSU aus Schubabgleich" UBYTE fak_ub_b2 1 100 0 1.99219 FORMAT "%5.3" ECU_ADDRESS 0x40382C /end MEASUREMENT
/begin MEASUREMENT kpe_error "Fehlerstatus aus Error Trace Buffer" UBYTE dez 1 100 0 255 FORMAT "%5.1" ECU_ADDRESS 0x402BF4 /end MEASUREMENT
/begin MEASUREMENT krivk_u "Korrekturwert f¸r den Innenwiderstand der Nernstzelle der LSU (byte)" SBYTE r_q10p01 1 100 -1281 1270.99 FORMAT "%5.0" ECU_ADDRESS 0x40382D /end MEASUREMENT
/begin MEASUREMENT kusvk2_u "Korrekturwert der LSU-Spannung vor Kat Bank2 (Byte)" SBYTE spg_sw_q0p00488 1 100 -0.625 0.620117 ECU_ADDRESS 0x403AF3 /end MEASUREMENT
/begin MEASUREMENT kusvk_u "Korrekturwert der LSU-Spannung vor Kat (Byte)" SBYTE spg_sw_q0p00488 1 100 -0.625 0.620117 ECU_ADDRESS 0x403AF4 /end MEASUREMENT
/begin MEASUREMENT ladiff2_u "Regelabweichung Lambda;Bank2  (Byte)" SBYTE fak_q0p00195 1 100 -0.25 0.248047 ECU_ADDRESS 0x403AF5 /end MEASUREMENT
/begin MEASUREMENT ladiff_u "Regelabweichung Lambda (Byte)" SBYTE fak_q0p00195 1 100 -0.25 0.248047 ECU_ADDRESS 0x403AF6 /end MEASUREMENT
/begin MEASUREMENT lamsam2_u "Lambdaamplitude nach Filterung Bank 2  (Byte)" SBYTE fak_q0p00195 1 100 -0.25 0.248047 ECU_ADDRESS 0x403AF7 /end MEASUREMENT
/begin MEASUREMENT lamsam2_w "Lambdaamplitude nach Filterung Bank 2" UWORD fak_uw_b16 1 100 0 15.9998 FORMAT "%8.5" ECU_ADDRESS 0x403E90 /end MEASUREMENT
/begin MEASUREMENT lamsam_u "Lambdaamplitude nach Filterung  (Byte)" SBYTE fak_q0p00195 1 100 -0.25 0.248047 ECU_ADDRESS 0x403AF8 /end MEASUREMENT
/begin MEASUREMENT lamsam_w "Lambdaamplitude nach Filterung" UWORD fak_uw_b16 1 100 0 15.9998 FORMAT "%8.5" ECU_ADDRESS 0x403E92 /end MEASUREMENT
/begin MEASUREMENT lamsoni2_u "Lambda-Istwert Bank2 (Byte)" UBYTE fak_q0p0625 1 100 0 15.9375 FORMAT "%5.2" ECU_ADDRESS 0x403AF9 /end MEASUREMENT
/begin MEASUREMENT lamsoni_u "Lambda-Istwert (Byte)" UBYTE fak_q0p0625 1 100 0 15.9375 FORMAT "%5.2" ECU_ADDRESS 0x403AFA /end MEASUREMENT
/begin MEASUREMENT lamsons2_u "Lambda-Sollwert bezogen auf Einbauort Lambda-Sensor Bank2 (1 Byte f¸r Tester)" UBYTE fak_ub_b16 1 100 0 15.9375 FORMAT "%5.2" ECU_ADDRESS 0x403AFB /end MEASUREMENT
/begin MEASUREMENT lamsons_u "Lambda-Sollwert bezogen auf Einbauort Lambda-Sensor (1 Byte f¸r Tester)" UBYTE fak_ub_b16 1 100 0 15.9375 FORMAT "%5.2" ECU_ADDRESS 0x403AFC /end MEASUREMENT
/begin MEASUREMENT lamzak2_u "Umweltwert: Lambdasondenistwert, korrigiert um Zusatzamplitude, Bank2" UBYTE fak_ub_b16 1 100 0 15.9375 FORMAT "%5.2" ECU_ADDRESS 0x40382E /end MEASUREMENT
/begin MEASUREMENT lamzak_u "Umweltwert: Lambdasondenistwert, korrigiert um Zusatzamplitude" UBYTE fak_ub_b16 1 100 0 15.9375 FORMAT "%5.2" ECU_ADDRESS 0x40382F /end MEASUREMENT
/begin MEASUREMENT m6cdmtk "Mode $6 - Speicher: Component ID f¸r small leak test" UBYTE dez 1 100 0 255 FORMAT "%5.1" ECU_ADDRESS 0x3FE2B4 /end MEASUREMENT
/begin MEASUREMENT m6cdmtl "Mode $6 - Speicher: Component ID f¸r Modulpr¸fung DM-TL" UBYTE dez 1 100 0 255 FORMAT "%5.1" ECU_ADDRESS 0x3FE2B5 /end MEASUREMENT
/begin MEASUREMENT m6ctesg "Mode $6 - Speicher: Component ID f¸r Grobleckpr¸fung" UBYTE dez 1 100 0 255 FORMAT "%5.1" ECU_ADDRESS 0x3FE2B6 /end MEASUREMENT
/begin MEASUREMENT m6sdmtk_w "Mode $6 - Speicher: Schwelle f¸r Feinleckpr¸fung (0.5mm)" UWORD dez 1 100 0 65535 FORMAT "%8.2" ECU_ADDRESS 0x3FE2A4 /end MEASUREMENT
/begin MEASUREMENT m6sdmtl_w "Mode $6 - Speicher: Schwelle f¸r Modultest DM-TL" UWORD dez 1 100 0 65535 FORMAT "%8.2" ECU_ADDRESS 0x3FE2A6 /end MEASUREMENT
/begin MEASUREMENT m6stesg_w "Mode $6 - Speicher: Schwellwert f¸r Grobleckpr¸fung (1.0mm)" UWORD dez 1 100 0 65535 FORMAT "%8.2" ECU_ADDRESS 0x3FE2A8 /end MEASUREMENT
/begin MEASUREMENT m6wdmtk_w "Mode $6 - Speicher: Meﬂwert f¸r Feinleckpr¸fung (0.5mm)" UWORD dez 1 100 0 65535 FORMAT "%8.2" ECU_ADDRESS 0x3FE2AA /end MEASUREMENT
/begin MEASUREMENT m6wdmtl_w "Mode $6 - Speicher: Meﬂwert f¸r DM-TL Komponentenpr¸fung" UWORD dez 1 100 0 65535 FORMAT "%8.2" ECU_ADDRESS 0x3FE2AC /end MEASUREMENT
/begin MEASUREMENT m6wtesg_w "Mode 6 - Speicher: Messwert Grobleck-Pr¸fung" UWORD dez 1 100 0 65535 FORMAT "%8.2" ECU_ADDRESS 0x3FE2AE /end MEASUREMENT
/begin MEASUREMENT mdafsmr_w "Momentenvorhalt" UWORD rel_uw_b100 1 100 0 99.9985 FORMAT "%8.5" ECU_ADDRESS 0x40281C /end MEASUREMENT
/begin MEASUREMENT mdafsp_w "Pr‰diziertes Moment aus AFS-Eingriff" UWORD rel_uw_b100 1 100 0 99.9985 FORMAT "%8.5" ECU_ADDRESS 0x40281E /end MEASUREMENT
/begin MEASUREMENT mdafsvh_w "Momentenvorhalt AFS" UWORD rel_uw_b100 1 100 0 99.9985 FORMAT "%8.5" ECU_ADDRESS 0x402820 /end MEASUREMENT
/begin MEASUREMENT mdafsvl_w "Verlustmoment von AFS" UWORD rel_uw_b100 1 100 0 99.9985 FORMAT "%8.5" ECU_ADDRESS 0x402822 /end MEASUREMENT
/begin MEASUREMENT mdarsi_w "Delta-Ist-Moment ARS (CAN)" UWORD md_q0p002 1 100 0 127.998 FORMAT "%8.4" ECU_ADDRESS 0x402834 /end MEASUREMENT
/begin MEASUREMENT mdarsp_w "Pr‰diziertes Moment aus ARS-Eingriff" UWORD rel_uw_b100 1 100 0 99.9985 FORMAT "%8.5" ECU_ADDRESS 0x402836 /end MEASUREMENT
/begin MEASUREMENT mdarss_w "Delta-Soll-Moment ARS bei Solldruck" UWORD md_q0p002 1 100 0 127.998 FORMAT "%8.4" ECU_ADDRESS 0x402838 /end MEASUREMENT
/begin MEASUREMENT mdiars_w "Ist-Moment aus KF f¸r ARS-Eingriff" UWORD rel_uw_b100 1 100 0 99.9985 FORMAT "%8.5" ECU_ADDRESS 0x40283A /end MEASUREMENT
/begin MEASUREMENT mdsars_w "Sollmoment aus KF f¸r ARS-Eingriff" UWORD rel_uw_b100 1 100 0 99.9985 FORMAT "%8.5" ECU_ADDRESS 0x40283C /end MEASUREMENT
/begin MEASUREMENT mdvhstnd_w "Momentenvorhalt kein AFS verbaut" UWORD rel_uw_b100 1 100 0 99.9985 FORMAT "%8.5" ECU_ADDRESS 0x402824 /end MEASUREMENT
/begin MEASUREMENT mdvlstnd_w "Verlustmoment kein AFS verbaut" UWORD rel_uw_b100 1 100 0 99.9985 FORMAT "%8.5" ECU_ADDRESS 0x402826 /end MEASUREMENT
/begin MEASUREMENT miafs_w "Momentenanforderung vom AFS" UWORD rel_uw_b100 1 100 0 99.9985 FORMAT "%8.5" ECU_ADDRESS 0x402828 /end MEASUREMENT
/begin MEASUREMENT mkafs_w "angefordertes AFS-Moment" SWORD md_q0p5 1 100 -16384 16383.5 FORMAT "%8.2" ECU_ADDRESS 0x40282A /end MEASUREMENT
/begin MEASUREMENT ndmtllh "Zahl der verbleibenden Wiederholungsversuche bei Leck-Heilung" UBYTE dez 1 100 0 255 FORMAT "%5.1" ECU_ADDRESS 0x3FE2A2 /end MEASUREMENT
/begin MEASUREMENT ndmtllv "Zahl der verbleibenden Versuche bei Leck-Verifizierung" UBYTE dez 1 100 0 255 FORMAT "%5.1" ECU_ADDRESS 0x3FE2A3 /end MEASUREMENT
/begin MEASUREMENT o2vk_u "Umweltwert f¸r FFT: O2- ‹berschuss bzw. _O2- Mangel der LSU im Abgas" SBYTE relO2_q0p25 1 100 -32 31.75 FORMAT "%5.2" ECU_ADDRESS 0x403830 /end MEASUREMENT
/begin MEASUREMENT Omega "Drehzahl des E-Motors" UWORD dez 1 100 0 65535 FORMAT "%8.2" ECU_ADDRESS 0x402C52 /end MEASUREMENT
/begin MEASUREMENT Omega_1 "Drehzahl des E-Motors des letzten Durchlaufs" UWORD dez 1 100 0 65535 FORMAT "%8.2" ECU_ADDRESS 0x402C54 /end MEASUREMENT
/begin MEASUREMENT out_tv "Tastverh‰ltnis" UBYTE di_ub_b2 1 100 0 99.6094 FORMAT "%5.2" ECU_ADDRESS 0x402C80 /end MEASUREMENT
/begin MEASUREMENT palsu2_u "Absolutdruck Abgassystem 2   (Byte)" UBYTE p_ub_q10 1 100 0 2550 FORMAT "%5.0" ECU_ADDRESS 0x403AFD /end MEASUREMENT
/begin MEASUREMENT palsu_u "Absolutdruck Abgassystem  (Byte)" UBYTE p_ub_q10 1 100 0 2550 FORMAT "%5.0" ECU_ADDRESS 0x403AFE /end MEASUREMENT
/begin MEASUREMENT Phi_1 "Position des letzten Durchlaufs" UWORD spg_uw_b50 1 100 0 5 FORMAT "%8.6" ECU_ADDRESS 0x402C56 /end MEASUREMENT
/begin MEASUREMENT poti1_tp "Potiwert" UWORD spg_uw_b50 1 100 0 5 FORMAT "%8.6" ECU_ADDRESS 0x402C58 /end MEASUREMENT
/begin MEASUREMENT puoldcfc_w "Umgebungsdruck (alter Wert) f¸r %DCFCEO" UWORD p_q0p039 1 100 0 2559.96 FORMAT "%8.3" ECU_ADDRESS 0x4035DE /end MEASUREMENT
/begin MEASUREMENT PV "Berechnete Verlustleistung" UWORD p_q0p1 1 100 0 6553.5 FORMAT "%8.3" ECU_ADDRESS 0x402C5A /end MEASUREMENT
/begin MEASUREMENT R "Vektor Rechenraster-Flags (nur SG-Modell)" UWORD wid_q0p01 1 100 0 655.35 FORMAT "%8.4" ECU_ADDRESS 0x402C5C /end MEASUREMENT
/begin MEASUREMENT rinh2_u "Istwert (Byte) Innenwiderstand Ri-Nernstzelle der Lambdasonde hinter KAT Bank2" UBYTE r_ub_q64 1 100 0 16320 FORMAT "%5.0" ECU_ADDRESS 0x403AFF /end MEASUREMENT
/begin MEASUREMENT rinh_u "Istwert (Byte) Innenwiderstand Ri-Nernstzelle der Lambdasonde hinter KAT" UBYTE r_ub_q64 1 100 0 16320 FORMAT "%5.0" ECU_ADDRESS 0x403B00 /end MEASUREMENT
/begin MEASUREMENT rinlsu2_u "Innenwiderstand der Nernstzelle der LSU mit 8bit-Quantisierung, (Bank2)" UBYTE r_q10 1 100 0 2550 FORMAT "%5.0" ECU_ADDRESS 0x403B01 /end MEASUREMENT
/begin MEASUREMENT rinlsu_u "Innenwiderstand der Nernstzelle der LSU mit 8bit-Quantisierung" UBYTE r_q10 1 100 0 2550 FORMAT "%5.0" ECU_ADDRESS 0x403B02 /end MEASUREMENT
/begin MEASUREMENT rinv2_u "Istwert (Byte) Innenwiderstand Ri-Nernstzelle der Lambdasonde vor KAT Bank2" UBYTE r_ub_q64 1 100 0 16320 FORMAT "%5.0" ECU_ADDRESS 0x403B03 /end MEASUREMENT
/begin MEASUREMENT rinv_u "Istwert (Byte) Innenwiderstand Ri-Nernstzelle der Lambdasonde vor KAT" UBYTE r_ub_q64 1 100 0 16320 FORMAT "%5.0" ECU_ADDRESS 0x403B04 /end MEASUREMENT
/begin MEASUREMENT rkaco_w "Additive Korrektur der rel. Kraftstoffmasse f¸r LL-CO einstellen" SWORD rel_sw_b1536 1 100 -1536 1535.95 FORMAT "%8.3" ECU_ADDRESS 0x403FE6 /end MEASUREMENT
/begin MEASUREMENT rkrn_u "normierter Referenzpegel Klopfregelung (Byte)" UBYTE spg_q0p625 1 100 0 159.375 FORMAT "%5.1" ARRAY_SIZE 8 ECU_ADDRESS 0x403B05 /end MEASUREMENT
/begin MEASUREMENT rk_u "Umweltwert f¸r FFT: relative Kraftstoffmasse" UBYTE rel_ub_b765 1 100 0 765 FORMAT "%5.1" ECU_ADDRESS 0x403831 /end MEASUREMENT
/begin MEASUREMENT rl_u "relative Luftf¸llung (Byte) f¸r Fehlerspeicher-Umwelten" UBYTE rel_ub_b100 1 100 0 99.6094 FORMAT "%5.2" ECU_ADDRESS 0x403B0D /end MEASUREMENT
/begin MEASUREMENT RW_Phi "Rechenwert Position des Stellers" UWORD spg_uw_b50 1 100 0 5 FORMAT "%8.6" ECU_ADDRESS 0x402C5E /end MEASUREMENT
/begin MEASUREMENT RW_TU "Rechenwert Umgebungstemperatur" SLONG temp_q0p00002 1 100 -42949.7 42949.7 FORMAT "%13.7" ECU_ADDRESS 0x402C68 /end MEASUREMENT
/begin MEASUREMENT RW_TV "Rechenwert Tastverh‰ltnis" UBYTE di_ub_b2 1 100 0 99.6094 FORMAT "%5.2" ECU_ADDRESS 0x402C81 /end MEASUREMENT
/begin MEASUREMENT RW_u "Rechenwert Umot" UWORD spg_uw_b55 1 100 0 439.993 FORMAT "%8.4" ECU_ADDRESS 0x402C60 /end MEASUREMENT
/begin MEASUREMENT sbmcorpm "Summierer f¸r L¸ckenkorrektur um plus/minus einen Zahn" UBYTE dez 1 100 0 255 FORMAT "%5.1" ECU_ADDRESS 0x402974 /end MEASUREMENT
/begin MEASUREMENT sbmlos_w "Summierer f¸r Bezugsmarkenverluste" UWORD dez 1 100 0 65535 FORMAT "%8.2" ECU_ADDRESS 0x3FE064 /end MEASUREMENT
/begin MEASUREMENT sdmglva_w "Fahrstrecke seit Grobleckerkennung" UWORD s_q0p02777_m 1 100 0 1820.42 FORMAT "%8.3" ECU_ADDRESS 0x4035F0 /end MEASUREMENT
/begin MEASUREMENT sfpakre "Status Fehlerpfad: Abgasklappe Endstufe" UWORD dez 1 100 0 65535 FORMAT "%8.2" ECU_ADDRESS 0x3FE3B0 /end MEASUREMENT
/begin MEASUREMENT sfpanske "Status Fehlerpfad: Diagnose Ansaugklappe Endstufe" UWORD dez 1 100 0 65535 FORMAT "%8.2" ECU_ADDRESS 0x3FE3B2 /end MEASUREMENT
/begin MEASUREMENT sfpcacc "Status Fehlerpfad: Diagnose CAN-Timeout ACC-Schnittstelle" UWORD dez 1 100 0 65535 FORMAT "%8.2" ECU_ADDRESS 0x3FE3C2 /end MEASUREMENT
/begin MEASUREMENT sfpcafs "Status Fehlerpfad: Diagnose CAN-Timeout AFS-Schnittstelle" UWORD dez 1 100 0 65535 FORMAT "%8.2" ECU_ADDRESS 0x3FE3C4 /end MEASUREMENT
/begin MEASUREMENT sfpcana "Status Fehlerpfad: Diagnose CAN A (Fahrzeug-CAN)" UWORD default 1 100 0 65535 FORMAT "%8.2" ECU_ADDRESS 0x3FE3C6 /end MEASUREMENT
/begin MEASUREMENT sfpcanb "Status Fehlerpfad: Diagnose CAN B (LOCAN)" UWORD default 1 100 0 65535 FORMAT "%8.2" ECU_ADDRESS 0x3FE3C8 /end MEASUREMENT
/begin MEASUREMENT sfpcuhr "Fehlerpfad CAN  rel. Zeitgeber" UWORD default 1 100 0 65535 FORMAT "%8.2" ECU_ADDRESS 0x3FE3DE /end MEASUREMENT
/begin MEASUREMENT sfplsv "Status Fehlerpfad: Diagnose Lambdasonde vor Kat" UWORD dez 1 100 0 65535 FORMAT "%8.2" ECU_ADDRESS 0x3FE4FA /end MEASUREMENT
/begin MEASUREMENT sfplsv2 "Status Fehlerpfad: Diagnose Lambdasonde vor Kat Bank2" UWORD dez 1 100 0 65535 FORMAT "%8.2" ECU_ADDRESS 0x3FE4FC /end MEASUREMENT
/begin MEASUREMENT sfpswe "Status Fehlerpfad: Schlechtwegerkennung" UWORD dez 1 100 0 65535 FORMAT "%8.2" ECU_ADDRESS 0x3FE55E /end MEASUREMENT
/begin MEASUREMENT sfpx135 "Status Fehlerpfad: Diagnose CAN-Botschaft ST_EKP_CRASHABSCHALTUNG" UWORD dez 1 100 0 65535 FORMAT "%8.2" ECU_ADDRESS 0x3FE594 /end MEASUREMENT
/begin MEASUREMENT sfpx315 "Status Fehlerpfad: Diagnose CAN-Botschaft FAHRZEUGMODUS" UWORD dez 1 100 0 65535 FORMAT "%8.2" ECU_ADDRESS 0x3FE596 /end MEASUREMENT
/begin MEASUREMENT sfpx334 "Status Fehlerpfad: Diagnose CAN-Botschaft PWM_LADESPANNUNG" UWORD dez 1 100 0 65535 FORMAT "%8.2" ECU_ADDRESS 0x3FE598 /end MEASUREMENT
/begin MEASUREMENT sfpx3b0 "Status Fehlerpfad: Diagnose CAN-Botschaft ST_GANG_R‹CKWƒRTS" UWORD dez 1 100 0 65535 FORMAT "%8.2" ECU_ADDRESS 0x3FE59A /end MEASUREMENT
/begin MEASUREMENT sfpx3b4 "Status Fehlerpfad: Diagnose CAN-Botschaft PWM_BATTERIESPANNUNG" UWORD dez 1 100 0 65535 FORMAT "%8.2" ECU_ADDRESS 0x3FE59C /end MEASUREMENT
/begin MEASUREMENT sfpxc4 "Status Fehlerpfad: Diagnose CAN-Botschaft LENKRADWINKEL" UWORD dez 1 100 0 65535 FORMAT "%8.2" ECU_ADDRESS 0x3FE59E /end MEASUREMENT
/begin MEASUREMENT snerror_w "Z‰hler Unterdrehzahl oder Drehzahlstˆrungen" UWORD dez 1 100 0 65535 FORMAT "%8.2" ECU_ADDRESS 0x40296E /end MEASUREMENT
/begin MEASUREMENT snobm "Summierer f¸r nicht gefundene Bezugsmarken im Start" UBYTE dez 1 100 0 255 FORMAT "%5.1" ECU_ADDRESS 0x3FE066 /end MEASUREMENT
/begin MEASUREMENT softres "Variable zum Anzeigen eines Soft Reset durch die Drehzahlgeber Diagnose" UBYTE dez 1 100 0 255 FORMAT "%5.1" ECU_ADDRESS 0x3FE067 /end MEASUREMENT
/begin MEASUREMENT ssgmon "Monitor f¸r SSG" UBYTE dez 1 100 0 255 FORMAT "%5.1" ECU_ADDRESS 0x3FDED3 /end MEASUREMENT
/begin MEASUREMENT stddpsakr "Status Diagnose Powerstage AKR" UBYTE dez 1 100 0 255 FORMAT "%5.1" ECU_ADDRESS 0x402BED /end MEASUREMENT
/begin MEASUREMENT stpdmtl "Funktionsstatus-Z‰hler DM-TL f¸r Testerausgabe" UBYTE dez 1 100 0 255 FORMAT "%5.1" ECU_ADDRESS 0x3FE1CB /end MEASUREMENT
/begin MEASUREMENT stpdmtla "Funktionsstatus-Z‰hler DM-TL f¸r Testerausgabe aus letztem Fahrzyklus" UBYTE dez 1 100 0 255 FORMAT "%5.1" ECU_ADDRESS 0x3FE1CC /end MEASUREMENT
/begin MEASUREMENT stpdmtlm8 "Funktionsstatus-Z‰hler DM-TL f¸r Scan-Tool Mode 8" UBYTE dez 1 100 0 255 FORMAT "%5.1" ECU_ADDRESS 0x403044 /end MEASUREMENT
/begin MEASUREMENT stpdmtlp "Vergangenheitswert Funktionsstatus-Z‰hler DM-TL f¸r Testerausgabe" UBYTE dez 1 100 0 255 FORMAT "%5.1" ECU_ADDRESS 0x3FE1CD /end MEASUREMENT
/begin MEASUREMENT stssgerr "Fehler-Status der SSG - Diagnose" UBYTE dez 1 100 0 255 FORMAT "%5.1" ECU_ADDRESS 0x403825 /end MEASUREMENT
/begin MEASUREMENT T1 "Zeit" SLONG temp_q0p00002 1 100 -42949.7 42949.7 FORMAT "%13.7" ECU_ADDRESS 0x402C6C /end MEASUREMENT
/begin MEASUREMENT T2 "Berechnete virtuelle Geh‰usetemperatur" SLONG temp_q0p00002 1 100 -42949.7 42949.7 FORMAT "%13.7" ECU_ADDRESS 0x402C70 /end MEASUREMENT
/begin MEASUREMENT T3 "Berechnete virtuelle Geh‰usetemperatur" SLONG temp_q0p00002 1 100 -42949.7 42949.7 FORMAT "%13.7" ECU_ADDRESS 0x402C74 /end MEASUREMENT
/begin MEASUREMENT tabst_u "Abstellzeit (Byte)" UBYTE t_q256 1 100 0 65280 FORMAT "%5.0" ECU_ADDRESS 0x403B0E /end MEASUREMENT
/begin MEASUREMENT tdmlka_u "aktuelle Zeit Leckmessung (1 Byte f¸r Tester)" UBYTE t_q1p6_s 1 100 0 408 FORMAT "%5.1" ECU_ADDRESS 0x403B0F /end MEASUREMENT
/begin MEASUREMENT tdmtlmv "Zeit der ununterbrochenen Magnetventil-Bestromung" UBYTE t_q0p1 1 100 0 25.5 FORMAT "%5.2" ECU_ADDRESS 0x4035EF /end MEASUREMENT
/begin MEASUREMENT tdmtlrf_w "Maximale Zeit f¸r DM-TL Referenzmessung bei externer Anforderung" UWORD t_q0p1 1 100 0 6553.5 FORMAT "%8.3" ECU_ADDRESS 0x4035EC /end MEASUREMENT
/begin MEASUREMENT tdpucfc "Zeitz‰hler f¸r ƒnderungen des Umgebungsdruck in %DCFCEO" UBYTE t_q1 1 100 0 255 FORMAT "%5.1" ECU_ADDRESS 0x4035E8 /end MEASUREMENT
/begin MEASUREMENT tfadtlbe_w "Zeitz‰hler f¸r Abbruch Funktionsanforderung DM-TL Systemtest" UWORD t_q0p1 1 100 0 6553.5 FORMAT "%8.3" ECU_ADDRESS 0x3FE1C8 /end MEASUREMENT
/begin MEASUREMENT tfstcfcf_w "gefilterter Wert von F¸llstandsgeber f¸r Check Filler Cap" UWORD vol_q0p1_l 1 100 0 6553.5 FORMAT "%8.3" ECU_ADDRESS 0x4035E0 /end MEASUREMENT
/begin MEASUREMENT tmot_u "Motor-Temperatur mit def. Quantisierung f¸r FSP-Umwelten" UBYTE temp_ub_q1_o40 1 100 -40 215 FORMAT "%5.1" ECU_ADDRESS 0x403B10 /end MEASUREMENT
/begin MEASUREMENT tnkl15on_w "Timer Zeit nach KL15 ein oder Zeit nach FSP-Lˆschen" UWORD t_q0p1 1 100 0 6553.5 FORMAT "%8.3" ECU_ADDRESS 0x40282E /end MEASUREMENT
/begin MEASUREMENT tnse_u "Zeit nach Startende Byte" UBYTE t25p6sxs_ub_b6528 1 100 0 6528 FORMAT "%5.0" ECU_ADDRESS 0x403B11 /end MEASUREMENT
/begin MEASUREMENT top_u "Operating time" UBYTE t1536minxmin_q1536 1 100 0 391680 FORMAT "%5.0" ECU_ADDRESS 0x403832 /end MEASUREMENT
/begin MEASUREMENT TP1 "Steigung Wicklungstemperatur" SWORD dez 1 100 -32768 32767 FORMAT "%8.2" ECU_ADDRESS 0x402C62 /end MEASUREMENT
/begin MEASUREMENT TP2 "Steigung virtuelle Geh‰usetemperatur" SWORD dez 1 100 -32768 32767 FORMAT "%8.2" ECU_ADDRESS 0x402C64 /end MEASUREMENT
/begin MEASUREMENT tpsvkmf2_u "gefilterter Periodendauerwert des Sondensignals vor Kat, Bank2 (Byte)" UBYTE t10msxs_ub_b10p2 1 100 0 10.2 FORMAT "%5.2" ECU_ADDRESS 0x403B12 /end MEASUREMENT
/begin MEASUREMENT tpsvkmf_u "gefilterter Periodendauerwert des Sondensignals vor Kat. (Byte)" UBYTE t10msxs_ub_b10p2 1 100 0 10.2 FORMAT "%5.2" ECU_ADDRESS 0x403B13 /end MEASUREMENT
/begin MEASUREMENT tsmgspl2_w "Entprelltimer 2 SMG Schaltphasen-Plausibilisierung" UWORD t_q0p01 1 100 0 655.35 FORMAT "%8.4" ECU_ADDRESS 0x40437A /end MEASUREMENT
/begin MEASUREMENT tsmgspl_w "Entprelltimer SMG Schaltphasen-Plausibilisierung" UWORD t_q0p01 1 100 0 655.35 FORMAT "%8.4" ECU_ADDRESS 0x40437C /end MEASUREMENT
/begin MEASUREMENT TU "Zwischenspeicher f¸r Eingang KLUGTUMG (abhg. von CWBATMOD)" SLONG temp_q0p00002 1 100 -42949.7 42949.7 FORMAT "%13.7" ECU_ADDRESS 0x402C78 /end MEASUREMENT
/begin MEASUREMENT TYP_akre "" UWORD B_TRUE 1 100 0 1 BIT_MASK 0xf00 FORMAT "%13.11" ECU_ADDRESS 0x3FE3B0 /end MEASUREMENT
/begin MEASUREMENT TYP_anske "" UWORD B_TRUE 1 100 0 1 BIT_MASK 0xf00 FORMAT "%13.11" ECU_ADDRESS 0x3FE3B2 /end MEASUREMENT
/begin MEASUREMENT TYP_cacc "" UWORD B_TRUE 1 100 0 1 BIT_MASK 0xf00 FORMAT "%13.11" ECU_ADDRESS 0x3FE3C2 /end MEASUREMENT
/begin MEASUREMENT TYP_cafs "" UWORD B_TRUE 1 100 0 1 BIT_MASK 0xf00 FORMAT "%13.11" ECU_ADDRESS 0x3FE3C4 /end MEASUREMENT
/begin MEASUREMENT TYP_cana "" UWORD B_TRUE 1 100 0 1 BIT_MASK 0xf00 FORMAT "%13.11" ECU_ADDRESS 0x3FE3C6 /end MEASUREMENT
/begin MEASUREMENT TYP_canb "" UWORD B_TRUE 1 100 0 1 BIT_MASK 0xf00 FORMAT "%13.11" ECU_ADDRESS 0x3FE3C8 /end MEASUREMENT
/begin MEASUREMENT TYP_cuhr "" UWORD B_TRUE 1 100 0 1 BIT_MASK 0xf00 FORMAT "%13.11" ECU_ADDRESS 0x3FE3DE /end MEASUREMENT
/begin MEASUREMENT TYP_lsv "Fehlertyp: Lambdasonde 1 vor Kat" UWORD B_TRUE 1 100 0 1 BIT_MASK 0xf00 FORMAT "%13.11" ECU_ADDRESS 0x3FE4FA /end MEASUREMENT
/begin MEASUREMENT TYP_lsv2 "Fehlertyp: Lambdasonde 2 vor Kat" UWORD B_TRUE 1 100 0 1 BIT_MASK 0xf00 FORMAT "%13.11" ECU_ADDRESS 0x3FE4FC /end MEASUREMENT
/begin MEASUREMENT TYP_swe "" UWORD B_TRUE 1 100 0 1 BIT_MASK 0xf00 FORMAT "%13.11" ECU_ADDRESS 0x3FE55E /end MEASUREMENT
/begin MEASUREMENT TYP_x135 "" UWORD B_TRUE 1 100 0 1 BIT_MASK 0xf00 FORMAT "%13.11" ECU_ADDRESS 0x3FE594 /end MEASUREMENT
/begin MEASUREMENT TYP_x315 "" UWORD B_TRUE 1 100 0 1 BIT_MASK 0xf00 FORMAT "%13.11" ECU_ADDRESS 0x3FE596 /end MEASUREMENT
/begin MEASUREMENT TYP_x334 "" UWORD B_TRUE 1 100 0 1 BIT_MASK 0xf00 FORMAT "%13.11" ECU_ADDRESS 0x3FE598 /end MEASUREMENT
/begin MEASUREMENT TYP_x3b0 "" UWORD B_TRUE 1 100 0 1 BIT_MASK 0xf00 FORMAT "%13.11" ECU_ADDRESS 0x3FE59A /end MEASUREMENT
/begin MEASUREMENT TYP_x3b4 "" UWORD B_TRUE 1 100 0 1 BIT_MASK 0xf00 FORMAT "%13.11" ECU_ADDRESS 0x3FE59C /end MEASUREMENT
/begin MEASUREMENT TYP_xc4 "" UWORD B_TRUE 1 100 0 1 BIT_MASK 0xf00 FORMAT "%13.11" ECU_ADDRESS 0x3FE59E /end MEASUREMENT
/begin MEASUREMENT ubatt_u "Umweltbedingung aktuelle Batteriespannung" UBYTE spg_q0p064_o6 1 100 6 22.32 FORMAT "%5.2" ECU_ADDRESS 0x403B14 /end MEASUREMENT
/begin MEASUREMENT udkp1a_u "Spannung Drosselklappen-Poti 1 am (unteren) Anschlag (Byte)" UBYTE spg_ub_b5 1 100 0 4.98047 FORMAT "%5.3" ECU_ADDRESS 0x403B15 /end MEASUREMENT
/begin MEASUREMENT udkp1_u "Spannung Drosselklappen-Poti 1 (Byte)" UBYTE spg_ub_b5 1 100 0 4.98047 FORMAT "%5.3" ECU_ADDRESS 0x403B16 /end MEASUREMENT
/begin MEASUREMENT udkp2_u "Spannung Drosselklappen-Poti 2 (Byte)" UBYTE spg_ub_b5 1 100 0 4.98047 FORMAT "%5.3" ECU_ADDRESS 0x403B17 /end MEASUREMENT
/begin MEASUREMENT Umot "Batteriespannung" UWORD spg_uw_b55 1 100 0 439.993 FORMAT "%8.4" ECU_ADDRESS 0x402C66 /end MEASUREMENT
/begin MEASUREMENT upwg1_u "Spannung PWG-Poti 1 (Byte)" UBYTE spg_ub_b5 1 100 0 4.98047 FORMAT "%5.3" ECU_ADDRESS 0x403B18 /end MEASUREMENT
/begin MEASUREMENT upwg2d_u "Verdoppelte PWG-Poti-2-Spannung (Byte)" UBYTE spg_ub_b5 1 100 0 4.98047 FORMAT "%5.3" ECU_ADDRESS 0x403B19 /end MEASUREMENT
/begin MEASUREMENT upwg2_u "Spannung PWG-Poti 2 (Byte)" UBYTE spg_ub_b5 1 100 0 4.98047 FORMAT "%5.3" ECU_ADDRESS 0x403B1A /end MEASUREMENT
/begin MEASUREMENT usvkk2_u "LSU-Spannung vor Kat, korrigiert Bank2 (Byte)" UBYTE spg_ub_b5 1 100 0 4.98047 FORMAT "%5.3" ECU_ADDRESS 0x403B1B /end MEASUREMENT
/begin MEASUREMENT usvkk_u "LSU-Spannung vor Kat, korrigiert (Byte)" UBYTE spg_ub_b5 1 100 0 4.98047 FORMAT "%5.3" ECU_ADDRESS 0x403B1C /end MEASUREMENT
/begin MEASUREMENT uulsuf2_u "gefilterte Sondenspannung vor Kat einer Breitbandlambdasonde Bank2  (Byte)" UBYTE spg_ub_b5 1 100 0 4.98047 FORMAT "%5.3" ECU_ADDRESS 0x403B1D /end MEASUREMENT
/begin MEASUREMENT uulsuf_u "gefilterte Sondenspannung vor Kat einer Breitbandlambdasonde (Byte)" UBYTE spg_ub_b5 1 100 0 4.98047 FORMAT "%5.3" ECU_ADDRESS 0x403B1E /end MEASUREMENT
/begin MEASUREMENT uulsuv2_u "Sondenspannung vor Kat einer Breitbandlambdasonde Bank2 (ADC-Wert) (Byte)" UBYTE spg_ub_b5 1 100 0 4.98047 FORMAT "%5.3" ECU_ADDRESS 0x403B1F /end MEASUREMENT
/begin MEASUREMENT uulsuv_u "Sondenspannung vor Kat einer Breitbandlambdasonde (ADC-Wert) (Byte)" UBYTE spg_ub_b5 1 100 0 4.98047 FORMAT "%5.3" ECU_ADDRESS 0x403B20 /end MEASUREMENT
/begin MEASUREMENT uushk2_u "ADC-Spannung Lambdasonde hinter Katalysator Bank2 (Byte)" UBYTE spg_ub_b5 1 100 0 4.98047 FORMAT "%5.3" ECU_ADDRESS 0x403B21 /end MEASUREMENT
/begin MEASUREMENT uushk_u "ADC-Spannung Lambdasonde hinter Katalysator (Byte)" UBYTE spg_ub_b5 1 100 0 4.98047 FORMAT "%5.3" ECU_ADDRESS 0x403B22 /end MEASUREMENT
/begin MEASUREMENT vfzgv1_u "Umweltbedingung Fahrzeuggeschwindigkeit, CAN-Signal V 1" UBYTE vfzg_q1p0 1 100 0 255 FORMAT "%5.1" ECU_ADDRESS 0x403833 /end MEASUREMENT
/begin MEASUREMENT vfzgzsd_w "Zwischengespeicherte Fahrzeuggeschwindigkeitsdifferenz f¸r Check Filler Cap" UWORD vfzg_uw_b512 1 100 0 511.992 FORMAT "%8.4" ECU_ADDRESS 0x4035E2 /end MEASUREMENT
/begin MEASUREMENT vfzgzs_w "Zwischengespeicherte Fahrzeuggeschwindigkeit f¸r Check Filler Cap" UWORD vfzg_uw_b512 1 100 0 511.992 FORMAT "%8.4" ECU_ADDRESS 0x4035E4 /end MEASUREMENT
/begin MEASUREMENT vfzg_u "Fahrzeuggeschwindigkeit, mit def. Quantisierung f¸r Tester" UBYTE vfzg_q1p0 1 100 0 255 FORMAT "%5.1" ECU_ADDRESS 0x403B23 /end MEASUREMENT
/begin MEASUREMENT Vnscnt "Fehlerz‰hler Vanos abgefallener Sensor NW/KW" UBYTE dez 1 100 0 255 FORMAT "%5.1" ARRAY_SIZE 4 ECU_ADDRESS 0x4039BC /end MEASUREMENT
/begin MEASUREMENT Vnscnt2 "Fehlerz‰hler Vanos Istposition auﬂerhalb Fenster NW/KW" UBYTE dez 1 100 0 255 FORMAT "%5.1" ARRAY_SIZE 4 ECU_ADDRESS 0x4039C0 /end MEASUREMENT
/begin MEASUREMENT Vnsdeltaub "Regelabweichung nach Filter" UWORD sprzi_q0p1 1 100 0 6553.5 FORMAT "%8.3" ARRAY_SIZE 4 ECU_ADDRESS 0x404844 /end MEASUREMENT
/begin MEASUREMENT Vnserr "Fehlerstatus Vanos" UBYTE dez 1 100 0 255 FORMAT "%5.1" ARRAY_SIZE 4 ECU_ADDRESS 0x4039C4 /end MEASUREMENT
/begin MEASUREMENT Vnshaltetv "Haltetv Vanos" UWORD vnstv_q0p00305s32768 1 100 -100 99.9969 ARRAY_SIZE 4 ECU_ADDRESS 0x40484C /end MEASUREMENT
/begin MEASUREMENT Vns_dad "" UBYTE dez 1 100 0 255 FORMAT "%5.1" ECU_ADDRESS 0x40368D /end MEASUREMENT
/begin MEASUREMENT Vns_dst "" UBYTE dez 1 100 0 255 FORMAT "%5.1" ECU_ADDRESS 0x40368E /end MEASUREMENT
/begin MEASUREMENT vvt_iw2_u "Umweltwert: VVT-Istwert in % bzgl. Verstellbereich Bank2" UBYTE rel_q0p39 1 100 0 99.6094 FORMAT "%5.2" ECU_ADDRESS 0x403834 /end MEASUREMENT
/begin MEASUREMENT vvt_iw_u "Umweltwert: VVT-Istwert in % bzgl. Verstellbereich Bank1" UBYTE rel_q0p39 1 100 0 99.6094 FORMAT "%5.2" ECU_ADDRESS 0x403835 /end MEASUREMENT
/begin MEASUREMENT vvt_sw2_u "Umweltwert: VVT-Sollwert in % bzgl Verstellbereich Bank 2" UBYTE rel_q0p39 1 100 0 99.6094 FORMAT "%5.2" ECU_ADDRESS 0x403836 /end MEASUREMENT
/begin MEASUREMENT vvt_sw_u "Umweltwert: VVT-Sollwert in % bzgl Verstellbereich Bank1" UBYTE rel_q0p39 1 100 0 99.6094 FORMAT "%5.2" ECU_ADDRESS 0x403837 /end MEASUREMENT
/begin MEASUREMENT waitheal "Z‰hler zum Warten auf die Bezugsmarkendiagnose" UWORD dez 1 100 0 65535 FORMAT "%8.2" ECU_ADDRESS 0x402970 /end MEASUREMENT
/begin MEASUREMENT wdknlpr_u "Dauer-RAM: Sollwert DK-Winkel in NLP-Stellung, bez. auf UMA" UBYTE relDK_ub_b100 1 100 0 100 FORMAT "%5.1" ECU_ADDRESS 0x403B24 /end MEASUREMENT
/begin MEASUREMENT wdknlp_u "DK-Winkel der Notluftposition (byte)" UBYTE relDK_ub_b100 1 100 0 100 FORMAT "%5.1" ECU_ADDRESS 0x403B25 /end MEASUREMENT
/begin MEASUREMENT wnwi1_u "Istwinkel f¸r Nockenwelle 1 (Byte)" SBYTE wkw_sb_b128 1 100 -128 127 FORMAT "%5.1" ECU_ADDRESS 0x403B26 /end MEASUREMENT
/begin MEASUREMENT wnwi2_u "Istwinkel f¸r Nockenwelle 2 (Byte)" SBYTE wkw_sb_b128 1 100 -128 127 FORMAT "%5.1" ECU_ADDRESS 0x403B27 /end MEASUREMENT
/begin MEASUREMENT wnwiada1_w "Winkeldifferenz zwischen adaptierter und aktueller NW-Flanke Auslass Bank1" SWORD kw_q0p0039 1 100 -128 127.996 FORMAT "%8.4" ECU_ADDRESS 0x40443A /end MEASUREMENT
/begin MEASUREMENT wnwiada2_w "Winkeldifferenz zwischen adaptierter und aktueller NW-Flanke Auslass Bank2" SWORD kw_q0p0039 1 100 -128 127.996 FORMAT "%8.4" ECU_ADDRESS 0x40443C /end MEASUREMENT
/begin MEASUREMENT wnwiade1_w "Winkeldifferenz zwischen adaptierter und aktueller NW-Flanke Einlass Bank1" SWORD kw_q0p0039 1 100 -128 127.996 FORMAT "%8.4" ECU_ADDRESS 0x40443E /end MEASUREMENT
/begin MEASUREMENT wnwiade2_w "Winkeldifferenz zwischen adaptierter und aktueller NW-Flanke Einlass Bank2" SWORD kw_q0p0039 1 100 -128 127.996 FORMAT "%8.4" ECU_ADDRESS 0x404440 /end MEASUREMENT
/begin MEASUREMENT wnwkora1_w "Aktueller Korrekturwert f¸r NW-Winkel von Auslass Bank 1" SWORD kw_q0p0156 1 100 -512 511.984 FORMAT "%8.4" ECU_ADDRESS 0x40295C /end MEASUREMENT
/begin MEASUREMENT wnwkora2_w "Aktueller Korrekturwert f¸r NW-Winkel von Auslass Bank 2" SWORD kw_q0p0156 1 100 -512 511.984 FORMAT "%8.4" ECU_ADDRESS 0x40295E /end MEASUREMENT
/begin MEASUREMENT wnwkore1_w "Aktueller Korrekturwert f¸r NW-Winkel von Einlass Bank 1" SWORD kw_q0p0156 1 100 -512 511.984 FORMAT "%8.4" ECU_ADDRESS 0x402960 /end MEASUREMENT
/begin MEASUREMENT wnwkore2_w "Aktueller Korrekturwert f¸r NW-Winkel von Einlass Bank 2" SWORD kw_q0p0156 1 100 -512 511.984 FORMAT "%8.4" ECU_ADDRESS 0x402962 /end MEASUREMENT
/begin MEASUREMENT wnwspa2_w "Adaptionswinkel der Nockenwellenflanken von Auslass Bank 2  (Referenzposition)" UWORD kw_q0p0156 1 100 0 1023.98 FORMAT "%8.3" ARRAY_SIZE 4 ECU_ADDRESS 0x3FE044 /end MEASUREMENT
/begin MEASUREMENT wnwspaa2_w "Adaptionswinkel der NW-Flanken (Referenzposition) f¸r Auslass Bank2" UWORD kw_q0p0156 1 100 0 1023.98 FORMAT "%8.3" ECU_ADDRESS 0x404442 /end MEASUREMENT
/begin MEASUREMENT wnwspaa_w "Adaptionswinkel der NW-Flanken (Referenzposition) f¸r Auslass Bank1" UWORD kw_q0p0156 1 100 0 1023.98 FORMAT "%8.3" ECU_ADDRESS 0x404444 /end MEASUREMENT
/begin MEASUREMENT wnwspae2_w "Adaptionswinkel der NW-Flanken (Referenzposition) f¸r Einlass Bank2" UWORD kw_q0p0156 1 100 0 1023.98 FORMAT "%8.3" ECU_ADDRESS 0x404446 /end MEASUREMENT
/begin MEASUREMENT wnwspae_w "Adaptionswinkel der NW-Flanken (Referenzposition) f¸r Einlass Bank1" UWORD kw_q0p0156 1 100 0 1023.98 FORMAT "%8.3" ECU_ADDRESS 0x404448 /end MEASUREMENT
/begin MEASUREMENT wnwspatmp2_w "" UWORD kw_q0p0156 1 100 0 1023.98 FORMAT "%8.3" ARRAY_SIZE 4 ECU_ADDRESS 0x403DA8 /end MEASUREMENT
/begin MEASUREMENT wnwspatmp_w "" UWORD kw_q0p0156 1 100 0 1023.98 FORMAT "%8.3" ARRAY_SIZE 4 ECU_ADDRESS 0x403DB0 /end MEASUREMENT
/begin MEASUREMENT wnwspa_w "Adaptionswinkel der Nockenwellenflanken von Auslass Bank 1  (Referenzposition)" UWORD kw_q0p0156 1 100 0 1023.98 FORMAT "%8.3" ARRAY_SIZE 4 ECU_ADDRESS 0x3FE04C /end MEASUREMENT
/begin MEASUREMENT wnwspe2_w "Adaptionswinkel der Nockenwellenflanken von Einlass Bank 2  (Referenzposition)" UWORD kw_q0p0156 1 100 0 1023.98 FORMAT "%8.3" ARRAY_SIZE 4 ECU_ADDRESS 0x3FE054 /end MEASUREMENT
/begin MEASUREMENT wnwspetmp2_w "" UWORD kw_q0p0156 1 100 0 1023.98 FORMAT "%8.3" ARRAY_SIZE 4 ECU_ADDRESS 0x403DB8 /end MEASUREMENT
/begin MEASUREMENT wnwspetmp_w "" UWORD kw_q0p0156 1 100 0 1023.98 FORMAT "%8.3" ARRAY_SIZE 4 ECU_ADDRESS 0x403DC0 /end MEASUREMENT
/begin MEASUREMENT wnwspe_w "Adaptionswinkel der Nockenwellenflanken von Einlass Bank 1  (Referenzposition)" UWORD kw_q0p0156 1 100 0 1023.98 FORMAT "%8.3" ARRAY_SIZE 4 ECU_ADDRESS 0x3FE05C /end MEASUREMENT
/begin MEASUREMENT ztesgmn_w "Untere Schwelle f¸r Grobleckpr¸fung" UWORD i_q6p1035_uA 1 100 0 399.994 FORMAT "%8.4" ECU_ADDRESS 0x3FE2B0 /end MEASUREMENT
/begin MEASUREMENT ztesg_w "Meﬂwert f¸r Grobleckpr¸fung (Mode$06)" UWORD i_q6p1035_uA 1 100 0 399.994 FORMAT "%8.4" ECU_ADDRESS 0x3FE2B2 /end MEASUREMENT
/begin MEASUREMENT Z_akre "Zyklus Flag: Abgasklappe Endstufe mit Resonator" UWORD B_TRUE 1 100 0 1 BIT_MASK 0x2 FORMAT "%13.11" ECU_ADDRESS 0x3FE3B0 /end MEASUREMENT
/begin MEASUREMENT Z_anske "Zyklusflag: Ansaugklappe, Endstufe" UWORD B_TRUE 1 100 0 1 BIT_MASK 0x2 FORMAT "%13.11" ECU_ADDRESS 0x3FE3B2 /end MEASUREMENT
/begin MEASUREMENT Z_cacc "Zyklusflag: CAN-Schnittstelle, Timeout ACC" UWORD B_TRUE 1 100 0 1 BIT_MASK 0x2 FORMAT "%13.11" ECU_ADDRESS 0x3FE3C2 /end MEASUREMENT
/begin MEASUREMENT Z_cafs "Zyklusflag: CAN-Schnittstelle, Timeout AFS" UWORD B_TRUE 1 100 0 1 BIT_MASK 0x2 FORMAT "%13.11" ECU_ADDRESS 0x3FE3C4 /end MEASUREMENT
/begin MEASUREMENT Z_cana "Zyklusflag: CAN-Schnittstelle ""CAN_A""" UWORD B_TRUE 1 100 0 1 BIT_MASK 0x2 FORMAT "%13.11" ECU_ADDRESS 0x3FE3C6 /end MEASUREMENT
/begin MEASUREMENT Z_canb "Zyklusflag: CAN-Schnittstelle ""CAN_B""" UWORD B_TRUE 1 100 0 1 BIT_MASK 0x2 FORMAT "%13.11" ECU_ADDRESS 0x3FE3C8 /end MEASUREMENT
/begin MEASUREMENT Z_cuhr "Zyklusflag  CAN  rel. Zeitgeber" UWORD B_TRUE 1 100 0 1 BIT_MASK 0x2 FORMAT "%13.11" ECU_ADDRESS 0x3FE3DE /end MEASUREMENT
/begin MEASUREMENT Z_lsv "Zyklusflag: Lambda-Sonde vor Kat" UWORD B_TRUE 1 100 0 1 BIT_MASK 0x2 FORMAT "%13.11" ECU_ADDRESS 0x3FE4FA /end MEASUREMENT
/begin MEASUREMENT Z_lsv2 "Zyklusflag: Lambda-Sonde 2 vor Kat" UWORD B_TRUE 1 100 0 1 BIT_MASK 0x2 FORMAT "%13.11" ECU_ADDRESS 0x3FE4FC /end MEASUREMENT
/begin MEASUREMENT Z_swe "Zyklusflag: Beschleunigungssensor der Schlechtwegeerkennung" UWORD B_TRUE 1 100 0 1 BIT_MASK 0x2 FORMAT "%13.11" ECU_ADDRESS 0x3FE55E /end MEASUREMENT
/begin MEASUREMENT Z_x135 "Zyklusflag CAN-Botschaft ST_EKP_CRASHABSCHALTUNG" UWORD B_TRUE 1 100 0 1 BIT_MASK 0x2 FORMAT "%13.11" ECU_ADDRESS 0x3FE594 /end MEASUREMENT
/begin MEASUREMENT Z_x315 "Zyklusflag CAN-Botschaft FAHRZEUGMODUS" UWORD B_TRUE 1 100 0 1 BIT_MASK 0x2 FORMAT "%13.11" ECU_ADDRESS 0x3FE596 /end MEASUREMENT
/begin MEASUREMENT Z_x334 "Zyklusflag CAN-Botschaft PWM_LADESPANNUNG" UWORD B_TRUE 1 100 0 1 BIT_MASK 0x2 FORMAT "%13.11" ECU_ADDRESS 0x3FE598 /end MEASUREMENT
/begin MEASUREMENT Z_x3b0 "Zyklusflag CAN-Botschaft ST_GANG_R‹CKWƒRTS" UWORD B_TRUE 1 100 0 1 BIT_MASK 0x2 FORMAT "%13.11" ECU_ADDRESS 0x3FE59A /end MEASUREMENT
/begin MEASUREMENT Z_x3b4 "Zyklusflag CAN-Botschaft PWM_BATTERIESPANNUNG" UWORD B_TRUE 1 100 0 1 BIT_MASK 0x2 FORMAT "%13.11" ECU_ADDRESS 0x3FE59C /end MEASUREMENT
/begin MEASUREMENT Z_xc4 "Zyklusflag CAN-Botschaft LENKRADWINKEL" UWORD B_TRUE 1 100 0 1 BIT_MASK 0x2 FORMAT "%13.11" ECU_ADDRESS 0x3FE59E /end MEASUREMENT
/begin FUNCTION convanld "Schnitt-Stellenmodul BMW-EAVANOS - NLDG" /begin DEF_CHARACTERISTIC STM05EPMSB VSAADPDLY VSEADPDLY WNWKMA WNWKME WNWKN /end DEF_CHARACTERISTIC
 /begin IN_MEASUREMENT B_nldg B_pwf B_synnldg B_vsaadp B_vseadp nmot synstate tmot wnwkwa2_w wnwkwa_w wnwkwe2_w wnwkwe_w zphfl zphfl2 zphfl3 zphfl4 /end IN_MEASUREMENT
 /begin OUT_MEASUREMENT B_phada1 B_phada2 B_phade1 B_phade2 B_wnwinla B_wnwinla2 B_wnwinle B_wnwinle2 wnwiada1_w wnwiada2_w wnwiade1_w wnwiade2_w wnwspaa_w wnwspae2_w wnwspae_w /end OUT_MEASUREMENT
 /begin LOC_MEASUREMENT esst_stm05epmsb wnwkora1_w wnwkora2_w wnwkore1_w wnwkore2_w wnwspa2_w wnwspaa2_w wnwspatmp2_w wnwspatmp_w wnwspa_w wnwspe2_w wnwspetmp2_w wnwspetmp_w wnwspe_w /end LOC_MEASUREMENT
/end FUNCTION
/begin FUNCTION COSA "6.30      Software-Abgleich" /begin DEF_CHARACTERISTIC RKACOMN RKACOMX TLLCO TVCO /end DEF_CHARACTERISTIC /begin REF_CHARACTERISTIC N0 NRKAB /end REF_CHARACTERISTIC /begin IN_MEASUREMENT B_eepdif B_ll B_nokatfz nmot tmot /end IN_MEASUREMENT /begin OUT_MEASUREMENT B_cotrim co_pot rkaco_w /end OUT_MEASUREMENT /begin LOC_MEASUREMENT co_pot_w /end LOC_MEASUREMENT /end FUNCTION
/begin FUNCTION DAKRE "4.20      Diagnose; Abgasklappe Endstufe" /begin DEF_CHARACTERISTIC CWPSAKRE /end DEF_CHARACTERISTIC /begin REF_CHARACTERISTIC TVP /end REF_CHARACTERISTIC /begin IN_MEASUREMENT B_akr B_clvar B_desee /end IN_MEASUREMENT /begin OUT_MEASUREMENT B_akrdet B_akrfz B_akrvar dakreAusBitsNV /end OUT_MEASUREMENT /begin LOC_MEASUREMENT stddpsakr /end LOC_MEASUREMENT /begin SUB_FUNCTION DFPM_DAKRE /end SUB_FUNCTION /end FUNCTION
/begin FUNCTION DANSKLE "2.10      Diagnose Ansaugklappe Endstufe" /begin DEF_CHARACTERISTIC CWPSANSKE /end DEF_CHARACTERISTIC /begin REF_CHARACTERISTIC TVP /end REF_CHARACTERISTIC /begin IN_MEASUREMENT B_anskl B_desee /end IN_MEASUREMENT /begin SUB_FUNCTION DFPM_DANSKLE /end SUB_FUNCTION /end FUNCTION
/begin FUNCTION DCACC "3.10      Diagnose; CAN-Timeout ACC-Schnittstelle" /begin DEF_CHARACTERISTIC TBRACCR TDCACC2 TDCACC3 TDCACC4 TDCACCH TDCACN /end DEF_CHARACTERISTIC
 /begin IN_MEASUREMENT B_acc B_acccok B_accnew B_fgdcana B_mdacc_um B_npacc_um B_siacc_um S_bls S_brs tnoaccnew /end IN_MEASUREMENT
/end FUNCTION
/begin FUNCTION DCAFS "1.30"
 /begin DEF_CHARACTERISTIC CWAFS KFAFSERR KFAFSMDLW KFAFSMDMN KFAFSMDV KFAFSVHMD KFAFSVLMD KLAFSMDN KLAFSSTND KLAFSVHV KLMDAFSSMX MDAFSFW TDCAFS1 TDCAFS2 TDCAFS3 TDCAFSH /end DEF_CHARACTERISTIC
 /begin IN_MEASUREMENT B_afs1cok B_afs1csao B_afs1new B_afsron B_afsvar B_elws B_fgdcana fqepmdn lws_w mkiafs_w mksafs_w nmot_w stafserr vfzg_w vlws_w /end IN_MEASUREMENT
 /begin OUT_MEASUREMENT B_npcafsv mdafsmr_w mdafsp_w /end OUT_MEASUREMENT
 /begin LOC_MEASUREMENT mdafsvh_w mdafsvl_w mdvhstnd_w mdvlstnd_w miafs_w mkafs_w /end LOC_MEASUREMENT
 /begin SUB_FUNCTION DFPM_DCAFS /end SUB_FUNCTION
/end FUNCTION
/begin FUNCTION DCANA "1.30      Diagnose CAN A" /begin DEF_CHARACTERISTIC TDCANA1 TDCANA3 TDCANAH /end DEF_CHARACTERISTIC /begin IN_MEASUREMENT B_fgdcan /end IN_MEASUREMENT /begin OUT_MEASUREMENT B_edprcana canastat /end OUT_MEASUREMENT /end FUNCTION
/begin FUNCTION DCANB "1.40      Diagnose CAN B" /begin DEF_CHARACTERISTIC TDCANB1 TDCANB3 TDCANBH /end DEF_CHARACTERISTIC /begin IN_MEASUREMENT B_fgdcan /end IN_MEASUREMENT /begin OUT_MEASUREMENT B_edprcanb canbstat /end OUT_MEASUREMENT /end FUNCTION
/begin FUNCTION DCANBOT "1.40" /begin DEF_CHARACTERISTIC CWFGDCAN /end DEF_CHARACTERISTIC
 /begin REF_CHARACTERISTIC TDCIDX0C4H TDCIDX135H TDCIDX315H TDCIDX334H TDCIDX3B0H TDCIDX3B4H /end REF_CHARACTERISTIC
 /begin IN_MEASUREMENT B_dsc5cok B_fgdcana B_ins5cok B_lm1cok B_pwml1cok B_pwml2cok B_szm1cok B_szm1csao codcan codget tnodsc5 tnoins5_w tnolm1 tnopwml1 tnopwml2 tnoszm1 /end IN_MEASUREMENT
 /begin OUT_MEASUREMENT tnkl15on_w /end OUT_MEASUREMENT
 /begin SUB_FUNCTION DFPM_DCANBOT /end SUB_FUNCTION
/end FUNCTION
/begin FUNCTION DCARS "2.10      Diagnose CAN-Timeout ARS-Steuerger‰t"
 /begin DEF_CHARACTERISTIC DMARSILL DMARSSLL FDMDARS FDMDARSS KFMDARSI KFMDARSIMX KFMDARSS KFMDARSSMX NARS TDCARS1 TDCARS2 TDCARS3 TDCARS4 TDCARSH VARS /end DEF_CHARACTERISTIC
 /begin IN_MEASUREMENT bfzgqars_w B_ars1cok B_ars1new B_arsron B_arsvar B_cdiagoff B_fgdcana B_kl15 mdarsi mdarss nmot nmot_w vfzgv1_w vfzg_w zalvars /end IN_MEASUREMENT
 /begin OUT_MEASUREMENT B_siars_fr dmgarss_w dmgars_w mdarsp_w mdiars_w mdsars_w /end OUT_MEASUREMENT
 /begin LOC_MEASUREMENT B_npcarsv mdarsi_w mdarss_w /end LOC_MEASUREMENT
/end FUNCTION
/begin FUNCTION DCCAS "2.10      Diagnose CAN-Timeout CAS-Steuerger‰t" /begin DEF_CHARACTERISTIC TDCCAS TDCCASH TDCCASNP /end DEF_CHARACTERISTIC /begin IN_MEASUREMENT B_cas1csao B_cascok B_casnew B_fgdcana codcan /end IN_MEASUREMENT /begin SUB_FUNCTION DFPM_DCCAS /end SUB_FUNCTION /end FUNCTION
/begin FUNCTION DCDACC "1.10      Diagnose; Zugriff auf Testerdaten" /end FUNCTION
/begin FUNCTION DCDSC "2.10      Diagnose CAN-Timeout DSC-SG" /begin DEF_CHARACTERISTIC TDCDSC TDCDSC2 TDCDSC3 TDCDSCH TDCDSCN /end DEF_CHARACTERISTIC
 /begin IN_MEASUREMENT B_ascpkw B_dsc1cok B_dsc1new B_dsc2cok B_dsc2new B_dsc3cok B_dsc3new B_dsc4cok B_dsc4new B_fgdcana B_npdsc_um B_sidsc_um tnodscnew /end IN_MEASUREMENT
/end FUNCTION
/begin FUNCTION DCEGS "2.10      Diagnose CAN-Timeout Getriebesteuerger‰t" /begin DEF_CHARACTERISTIC TDCEGS TDCEGS2 TDCEGS3 TDCEGSH TDCEGSN /end DEF_CHARACTERISTIC
 /begin IN_MEASUREMENT B_autget B_egs1cok B_egs1new B_egs2cok B_egs3cok B_egs3new B_fgdcana B_npegs_um B_siegs_um tnoegsnew /end IN_MEASUREMENT
/end FUNCTION
/begin FUNCTION DCFCEO "1.80"
 /begin DEF_CHARACTERISTIC ACFCNIO AZCFCMX CWCFCEO DFSTMX DVFZGMX PUTEDOCFC TANKDBE TDCFCDEN TDCFCNIOLA TDCFCVFZAB TDCFCVFZG TDPURECFC TNSECFC TPUTESVCFC VFZGCFCAB VFZGCFCLA VFZGCFCO VFZGCFCU VFZGDVU ZFCFCTFST /end DEF_CHARACTERISTIC
 /begin IN_MEASUREMENT B_cddmtl B_dmtgv B_fsttldv B_mirdmtl B_tank B_tankg B_tldinfo B_zdmtgv fstof_w pu_w tnse_w vfzg_w /end IN_MEASUREMENT
 /begin OUT_MEASUREMENT B_cfceos B_tankd dcfceoAusBits /end OUT_MEASUREMENT
 /begin LOC_MEASUREMENT aniodcfc azdcfc B_cfcend B_cfceolas B_cfcheal B_cfcio B_cfcnio B_cfctafg B_cfczae B_dmtgvb B_tankdff B_tankdo dcfceoLokBits dcfceoLokBitsNov dtfstcfc puoldcfc_w tdpucfc tfstcfcf_w vfzgzsd_w vfzgzs_w /end LOC_MEASUREMENT
 /begin SUB_FUNCTION DFPM_DCFCEO /end SUB_FUNCTION
/end FUNCTION
/begin FUNCTION DCINS "10.10     Diagnose; CAN Timeout Instrument (Kombi)"
 /begin DEF_CHARACTERISTIC TDCIHKA TDCIHKAH TDCIMILOFF TDCIMILON TDCINS TDCINS2 TDCINS3 TDCINS4 TDCINS5 TDCINSH TDCINSMIL /end DEF_CHARACTERISTIC
 /begin IN_MEASUREMENT B_fgdcana B_ins1cok B_ins1new B_ins2cok B_ins2new B_ins3cok B_ins3new B_ins4cok B_ins4new B_insmilon B_mil B_milblk B_nomil zalvins /end IN_MEASUREMENT
 /begin OUT_MEASUREMENT B_siins_fr dcinsAusBits /end OUT_MEASUREMENT
 /begin SUB_FUNCTION DFPM_DCINS /end SUB_FUNCTION
/end FUNCTION
/begin FUNCTION DCLA "7.10      OBDII; Klassentabelle"
 /begin DEF_CHARACTERISTIC CL30LINE CL31LINE CL32LINE CL33LINE CL34LINE CL35LINE CL36LINE CL37LINE CL38LINE CL39LINE CWFLC /end DEF_CHARACTERISTIC
/end FUNCTION
/begin FUNCTION DCOD "1.20      Diagnosefunktion Codierung" /begin REF_CHARACTERISTIC CODINDEX /end REF_CHARACTERISTIC /begin IN_MEASUREMENT B_pwf /end IN_MEASUREMENT /begin OUT_MEASUREMENT B_eepcod1 /end OUT_MEASUREMENT /end FUNCTION
/begin FUNCTION DCSSG "1.50      Diagnose CAN-Steuerger‰t SSG"
 /begin DEF_CHARACTERISTIC DMKSSGME MKSSGMXMST MKSSGMXNSV TSSGDRMX TSSGMD TSSGMEMX TSSGMRMX TSSGNOKPL VFSSGMXMST /end DEF_CHARACTERISTIC
 /begin REF_CHARACTERISTIC TDCIDXBAH TDCIDXBDH /end REF_CHARACTERISTIC
 /begin IN_MEASUREMENT B_cegs2npv B_egs1cok B_egs2cok B_fgdcana B_msrext B_mstpssgr B_nomsr_um B_ssgschlt codget mksasrs_um mksgs_um mkvbeg_w mkverl_w stssgkpl stssgsv tnkl15on_w tnoegs1 tnoegsnew vfzg_w /end IN_MEASUREMENT
 /begin OUT_MEASUREMENT B_mstpssg ssgmon stssgerr /end OUT_MEASUREMENT
 /begin LOC_MEASUREMENT tsmgspl2_w tsmgspl_w /end LOC_MEASUREMENT
/end FUNCTION
/begin FUNCTION DCSZL "2.10      Diagnose CAN-Timeout SZL-Steuerger‰t" /begin DEF_CHARACTERISTIC TDCSZL TDCSZL2 TDCSZL3 TDCSZL4 TDCSZLH TDCSZLN /end DEF_CHARACTERISTIC
 /begin IN_MEASUREMENT B_fgdcana B_npszl_um B_siszl_um B_szl1cok B_szl1new tnoszlnew /end IN_MEASUREMENT
/end FUNCTION
/begin FUNCTION DDCY "15.10     OBDII; Erf¸llung Bedingung 'driving cycle'" /begin DEF_CHARACTERISTIC TWBDCY /end DEF_CHARACTERISTIC /begin IN_MEASUREMENT B_pwf B_stend /end IN_MEASUREMENT /begin OUT_MEASUREMENT bbdcy B_dcy dcycnt /end OUT_MEASUREMENT /end FUNCTION
/begin FUNCTION DDG "19.40     Diagnose Drehzahlgeber"
 /begin DEF_CHARACTERISTIC CORTINC CORTINIT CORTMX LBMINC LBMINIT LBMMX LBMSUB MXNLN NERRINC NERRINIT NERRMX NERRSUB NOBMINC NOBMINIT NOBMSTMX PGFLNL PGFLWA TMOTNLDG /end DEF_CHARACTERISTIC
 /begin REF_CHARACTERISTIC CWPG1 CWPG2 CWPG3 CWPG4 /end REF_CHARACTERISTIC
 /begin IN_MEASUREMENT bmlosctr_w B_bm B_fbm B_nmin B_phada1 B_phada2 B_phade1 B_phade2 B_pwf B_zprel nmotllfil nstat pgmaster tmcorctr_w tmot tpcorctr_w uzkw_w vfzg_w zrph2_l zrph3_l zrph4_l zrph_l zzvirt /end IN_MEASUREMENT
 /begin OUT_MEASUREMENT B_nldg softres /end OUT_MEASUREMENT
 /begin LOC_MEASUREMENT bmlosold_w B_diffnl B_diffsi B_enabddg B_healmxbm B_healnpbm B_healnpn B_healsibm B_nlbm B_onetime ddgLokBits1 ddgLokBits2 sbmcorpm sbmlos_w snerror_w snobm waitheal /end LOC_MEASUREMENT
 /begin SUB_FUNCTION DFPM_DDG /end SUB_FUNCTION
/end FUNCTION
/begin FUNCTION DDISA "1.70      Diagnose DISA (BMW)"
 /begin DEF_CHARACTERISTIC CWDDISA DIFTANS DIOTANS DISAPOTIMN DISAPOTIMX DISAPRELL DISAREGDME DISAREGDMX DITEMPHYST DITEMPINI1 DITEMPINI2 DITEMPMOT DITEMPWARN KDISADELTA TVDISAPOTI ZDIWISCHMX /end DEF_CHARACTERISTIC
 /begin REF_CHARACTERISTIC DISA_TOT /end REF_CHARACTERISTIC
 /begin IN_MEASUREMENT B_disalern B_pwf B_stend Disaaus_w Disa_lern Disa_spg di_lernst D_disa_w tans ub Zdiwisch /end IN_MEASUREMENT
 /begin OUT_MEASUREMENT B_disareg B_diwisch B_potimn B_potimx disa_sta E_disager E_disamot E_disawarn T1 /end OUT_MEASUREMENT
 /begin LOC_MEASUREMENT B_poti B_potiv di_ed_cnt di_ee_cnt di_wad_cnt di_wae_cnt D_disaf_w Omega Omega_1 out_tv Phi_1 poti1_tp PV R RW_Phi RW_TU RW_TV RW_u T2 T3 TP1 TP2 TU Umot /end LOC_MEASUREMENT
/end FUNCTION
/begin FUNCTION DDMMVE "6.20      Diagnose Endstufe DM-TL Magnetventil" /begin DEF_CHARACTERISTIC CWPSDMMVE /end DEF_CHARACTERISTIC /begin REF_CHARACTERISTIC TVP /end REF_CHARACTERISTIC /begin IN_MEASUREMENT B_admtmv B_cddmtl B_desee B_nmot /end IN_MEASUREMENT /begin OUT_MEASUREMENT B_dmtlmv ddmmveAusBits /end OUT_MEASUREMENT /begin SUB_FUNCTION DFPM_DDMMVE /end SUB_FUNCTION /end FUNCTION
/begin FUNCTION DDMPME "5.80      Diagnose Endstufe DM-TL Pumpenmotor"
 /begin DEF_CHARACTERISTIC CWPSDMPME TWUPDLO TWUPDLWE TWUPKSO TWUPKSWE UBPMEO UPTESDLO UPTESO /end DEF_CHARACTERISTIC
 /begin IN_MEASUREMENT B_admtpm B_cddmtl B_desee ubsq uptes_w /end IN_MEASUREMENT
 /begin OUT_MEASUREMENT B_dmpmea B_dmtlpm B_pmedlo B_pmekso ddmpmeAusBitsIni ddmpmeAusBitsNov10ms /end OUT_MEASUREMENT
 /begin LOC_MEASUREMENT B_dmtmvdhp B_dmtmvkhp B_pmkste B_zdpmee B_zmedlo B_zmekso ddmpmeLokBits100ms ddmpmeLokBits10ms /end LOC_MEASUREMENT
 /begin SUB_FUNCTION DFPM_DDMPME /end SUB_FUNCTION
/end FUNCTION
/begin FUNCTION DDMTLLHV "1.60      Diagnose mit DMTL: Leck-Heilung und -Verifizierung" /begin DEF_CHARACTERISTIC NDMTLVV NDMTLWHV /end DEF_CHARACTERISTIC /begin IN_MEASUREMENT B_cddmtl B_mirdmtl B_nmot B_tank B_tankg /end IN_MEASUREMENT /begin OUT_MEASUREMENT B_dmtllhv ddmtllhvAusBits ndmtllh ndmtllv /end OUT_MEASUREMENT /begin LOC_MEASUREMENT B_tldlhvtk ddmtllhvLokBitsNov /end LOC_MEASUREMENT /end FUNCTION
/begin FUNCTION DDMTLSV "1.30" /begin DEF_CHARACTERISTIC CIDDMTK CIDDMTL CIDDMTNP CIDDMTSG CIDTESG /end DEF_CHARACTERISTIC /begin REF_CHARACTERISTIC DIPTGEOL DIPTGFT IPTGHTOL IPTREFO IPTREFU NKLDIPFMX /end REF_CHARACTERISTIC
 /begin IN_MEASUREMENT B_cddmtl B_dmtdddbr B_dmteol B_dmtglmv B_dmtlpe B_nkfl B_nkflg B_refo B_sumv B_tlddfpen B_zdmtg B_zdmtgv B_zdmtk iptghmn_w iptghmx_w iptgh_w iptglv_w iptgl_w iptkl_w iptrefr_w iptref_w iptsglv_w iptsgl_w nkfl /end IN_MEASUREMENT
 /begin OUT_MEASUREMENT m6cdmtk m6cdmtl m6ctesg m6sdmtk_w m6sdmtl_w m6stesg_w m6wdmtk_w m6wdmtl_w m6wtesg_w /end OUT_MEASUREMENT
 /begin LOC_MEASUREMENT B_toleol ddmtlsvLokBits ztesgmn_w ztesg_w /end LOC_MEASUREMENT
/end FUNCTION
/begin FUNCTION DDMTLTC "3.10      DMTL Mode 8 und Schnittstelle Testerkommunikation" /begin DEF_CHARACTERISTIC ADMTLREF2 TEFABE TFADTLMX TWDMTLTC /end DEF_CHARACTERISTIC
 /begin IN_MEASUREMENT aktstop_w B_admtll B_cddmtl B_diprfo B_dmtge B_dmtglm B_dmtgv B_dmtke B_dmtklm B_dmtrfm B_dpsf B_dtetd B_dtetk B_dubtes B_edmtg B_edmtk B_esdmte B_evdmtbc B_fadmtle B_fadmtls B_m8te B_nmot B_pwf B_stend B_txdmts B_ubdmte B_zdmtg B_zdmtk isadmtl top_w /end IN_MEASUREMENT
 /begin OUT_MEASUREMENT B_admtls B_dmtrfm2 B_fadmtl B_fadtlbe B_fam8dmtl B_nom8dmtl B_sfadmtle B_sm8te B_tcm8sa ddmtltcAusBits ddmtltcAusBitsNov stpdmtl stpdmtla stpdmtlm8 stpdmtlp tfadtlbe_w /end OUT_MEASUREMENT
/end FUNCTION
/begin FUNCTION DDMTLTER "1.20" /begin DEF_CHARACTERISTIC TDMTLMVMN /end DEF_CHARACTERISTIC /begin REF_CHARACTERISTIC PRFADMET PRFOPR PRPRSEN TNSTESMN /end REF_CHARACTERISTIC
 /begin IN_MEASUREMENT aktlauf_w B_admtmv B_dmmvet B_dmpmet B_pwf B_tldtevmv B_tldtevpm B_tldtevrq tnse_w trefdtev_w /end IN_MEASUREMENT
 /begin OUT_MEASUREMENT B_dmtmve B_dmtpme B_fopr B_prsen B_tldmvdcy B_tldtevda ddmtlterAusBits tdmtlrf_w /end OUT_MEASUREMENT
 /begin LOC_MEASUREMENT tdmtlmv /end LOC_MEASUREMENT
/end FUNCTION
/begin FUNCTION DDPMEE "5.30      Diagnose; DM-TL Pumpenmotor Endstufe" /begin DEF_CHARACTERISTIC CWPSDPMEE /end DEF_CHARACTERISTIC /begin IN_MEASUREMENT B_cddmtl B_desee /end IN_MEASUREMENT /begin SUB_FUNCTION DFPM_DDPMEE /end SUB_FUNCTION /end FUNCTION
/begin FUNCTION DDVE "7.30      Diagnose: EGAS-Steller DV-E" /begin DEF_CHARACTERISTIC TPNSE /end DEF_CHARACTERISTIC
 /begin IN_MEASUREMENT B_abgle B_dkaden B_dkp1e B_dkp1mn B_dkp1mx B_dkp1np B_dkp2e B_dkp2mn B_dkp2mx B_dkp2np B_dlrbe B_dlrpide B_dveese B_fproab B_fproe B_fprook B_fprordy B_fprovb B_fprrdy B_fprzab B_fprze B_fprzvb B_lrnakt B_lrnerf B_lrnrdy B_lrnvb B_lrnws B_nlpe B_nlperf B_nlpnew B_pwf B_stend B_umae B_umauab B_wdksive dveadchst fprstep_c lrnstep_c /end IN_MEASUREMENT
/end FUNCTION
/begin FUNCTION DDYLSU "1.70      Diagnose Dynamikverhalten der LSU"
 /begin DEF_CHARACTERISTIC DMRLSV DRLMXW DYNLSUFA DYNLSUMX DYNLSURD FTEDYLSUMX IVDYNLSU KDYNFA KDYNLSU LAMDYNO LAMDYNU NMOTDYFA NMOTDYNO NMOTDYNU RLDYNFAW RLDYNOW RLDYNUW TVDRL ZDYNFA ZDYNLSU /end DEF_CHARACTERISTIC
 /begin IN_MEASUREMENT B_cddylsu B_dsls B_fa B_fadylsu B_frmax B_frmax2 B_frmin B_frmin2 B_helsuip B_helsuip2 B_mdarv B_pwf B_sbblsu B_sbblsu2 B_te B_vekat B_vekat2 B_za B_za2 dfrzaf_w dfrza_w dlahi2_w dlahi_w fteadf lamsoni2_w lamsoni_w lamsons2_w lamsons_w nmot rirext_w rlp_w rl_w /end IN_MEASUREMENT
 /begin OUT_MEASUREMENT anzdyn anzdyn2 B_clradlra B_drlmx B_stcdyn B_stcdyn2 dmrlsv_w dynlsu2_w dynlsu_w /end OUT_MEASUREMENT
 /begin LOC_MEASUREMENT anzdyst anzdyst2 B_dylsu B_dylsu2 B_dylsuav B_dylsuav2 B_dylsuf B_dyslsu2 B_minflsu B_minflsu2 B_minslsu2 B_stcal B_stcal2 fkdyn_w lamsam2_w lamsam_w /end LOC_MEASUREMENT
/end FUNCTION
/begin FUNCTION DEAVANOS "1.20      Diagnose Ein- / Auslaﬂ- VANOS"
 /begin DEF_CHARACTERISTIC DEAVANOS NW_ADP_MN NW_ADP_MX NW_POSMN NW_POSMX VNSK_DELTA VNSK_TV_I VNS_DELTMX VNS_DELTMX2 VNS_ERRCNT VNS_ERRCNT2 VNS_NMOTS VNS_TMN VNS_TMX VNS_TVIMN VNS_TVIMX /end DEF_CHARACTERISTIC
 /begin REF_CHARACTERISTIC SPRZG_AN /end REF_CHARACTERISTIC
 /begin IN_MEASUREMENT B2vsaadnok B2vsaadok B2vsaflan B2vseadnok B2vseadok B2vseflan B_vsaadnok B_vsaadok B_vsaflan B_vseadnok B_vseadok B_vseflan nmot Nw_pos tmot Vsa2adp Vsa2sprs Vsa2tv_i Vsa_adp Vsa_sprs Vsa_tv_i Vse2adp Vse2sprs Vse2tv_i Vse_adp Vse_sprs Vse_tv_i /end IN_MEASUREMENT
 /begin OUT_MEASUREMENT B_anwmn B_anwmn2 B_anwpnp B_anwpnp2 B_enwmn B_enwmn2 B_enwpnp B_enwpnp2 B_evanos B_phad B_phad2 B_phad3 B_phad4 Vnscnt Vnscnt2 Vnsdeltaub Vnserr Vnshaltetv Vns_dad Vns_dst /end OUT_MEASUREMENT
/end FUNCTION
/begin FUNCTION DECJ "26.10     Diagnose; Endstufe CJ4x/9x" /begin DEF_CHARACTERISTIC NDECJ UBCJMN UBCJMX /end DEF_CHARACTERISTIC /begin IN_MEASUREMENT nmot ub /end IN_MEASUREMENT /begin OUT_MEASUREMENT B_desee /end OUT_MEASUREMENT /end FUNCTION
/begin FUNCTION DEGFE "2.10      Diagnose der Eingangsgrˆﬂen F¸llungserfassung" /begin DEF_CHARACTERISTIC CWDEGFE TDEGFEMN TDEGFEMX TDEGFENO TDEGFEST /end DEF_CHARACTERISTIC /begin IN_MEASUREMENT B_fkmsmn B_fkmsmx B_fkpvmn B_fkpvmx B_stend /end IN_MEASUREMENT /end FUNCTION
/begin FUNCTION DEKPE "17.10     Diagnose; Elektrokraftstoffpumpe Endstufe" /begin DEF_CHARACTERISTIC CWPSKPE EKPFA EKPPA /end DEF_CHARACTERISTIC /begin IN_MEASUREMENT B_desee /end IN_MEASUREMENT /begin LOC_MEASUREMENT dekpe ekpfz ekppz kpe_error /end LOC_MEASUREMENT /begin SUB_FUNCTION DFPM_DEKPE /end SUB_FUNCTION /end FUNCTION
/begin FUNCTION DELSE "3.10      Diagnose; Endstufe  E-BOX L¸fteransteuerung" /begin DEF_CHARACTERISTIC CWPSELS TDDIAGEL /end DEF_CHARACTERISTIC /begin REF_CHARACTERISTIC TVP /end REF_CHARACTERISTIC /begin IN_MEASUREMENT B_desee B_ebl /end IN_MEASUREMENT /begin LOC_MEASUREMENT B_calcelse /end LOC_MEASUREMENT /begin SUB_FUNCTION DFPM_DELSE /end SUB_FUNCTION /end FUNCTION
/begin FUNCTION DEPCL "1.50      Diagnose; Elektronik Powertrain Control Lampe" /begin DEF_CHARACTERISTIC TEPCL TEPCLI /end DEF_CHARACTERISTIC /begin IN_MEASUREMENT B_bt B_bteepcl B_btepcl B_kl15 B_nmot codcan /end IN_MEASUREMENT /begin OUT_MEASUREMENT B_epcl B_epclloc depclAusBits /end OUT_MEASUREMENT /end FUNCTION
/begin FUNCTION DEVE "10.10     Diagnose; Einspritzventil - Endstufe" /begin DEF_CHARACTERISTIC CWPSEVE /end DEF_CHARACTERISTIC /begin REF_CHARACTERISTIC TVP /end REF_CHARACTERISTIC /begin IN_MEASUREMENT B_desee B_sa B_stend evz_austot /end IN_MEASUREMENT /begin OUT_MEASUREMENT B_eev /end OUT_MEASUREMENT /begin SUB_FUNCTION DFPM_DEVE /end SUB_FUNCTION /end FUNCTION
/begin FUNCTION DFFT "1.80      Diagnose; Freeze Frame Auswahltabelle"
 /begin IN_MEASUREMENT egaspfad flglrs flglrs2 fr2_u fra2_u fra_u fr_u gangi mizsolv_u mizuvfil mi_duf mi_um ml mpfad nmot pu rinh2_u rinh_u rinlsu2_u rinlsu_u rl rml rstpfad skapfad tabgm tabgm2 tans tfst tkatm tkatm2 tmew tmot tmotlin tmot_u tmrw tumg ub udkp1_u udkp2_u uhsh uhsh2 uhsv uhsv2 upwg1_u upwg2d_u upwg2_u ushk ushk2 usvk usvk2 vfzg_u wdkba wdks wped /end IN_MEASUREMENT
/end FUNCTION
/begin FUNCTION DFFTCNV "13.80     Diagnose; Freeze Frame Tabelle, Konvertierung zu Bytes" /begin DEF_CHARACTERISTIC NMAXCBRL /end DEF_CHARACTERISTIC
 /begin IN_MEASUREMENT absch_korr dlahi2_w dlahi_w dynlsu2_w dynlsu_w d_soc fho_w fr2_w fra2_w frau2_w frau_w fra_w frhol_w frm2_w frm_w fr_w ftead_w igod_w igokr_w iptgh_w iptref_w ko2vk_w krivk_w kusvk2_w kusvk_w ladiff2_w ladiff_w lamsam2_w lamsam_w lamsoni2_w lamsoni_w lamsons2_w lamsons_w lamzak2_w lamzak_w nmot_w o2vk_w palsu2_w palsu_w rinh2_w rinh_w rinv2_w rinv_w rkrn_w rk_w rlugd_w rl_w tabst_w tdmlka_w tmotlin tnse_w top_w tpsvkmf2_w tpsvkmf_w ubatt_w udkp1a_w udkp1_w udkp2_w udsu_w uhfm_w upwg1_w upwg2d_w upwg2_w usvkk2_w usvkk_w uulsuf2_w uulsuf_w uulsuv2_w uulsuv_w uushk2_w uushk_w vfzg vfzgv1_w vvt_iw vvt_iw2 vvt_sw vvt_sw2 wdknlpr_w wdknlp_w wnwi_w wtans wtka wtmot /end IN_MEASUREMENT
 /begin OUT_MEASUREMENT abschkor_u addsu_u adhfm_u adta_u adtka_u adtm_u dlahi2_u dlahi_u dynlsu2_u dynlsu_u d_soc_u fho_u fr2_u fra2_u frau2_u frau_u fra_u frhol_u frm2_u frm_u fr_u ftead_u igod_u igokr_u iptgh_u iptref_u ko2vk_u krivk_u kusvk2_u kusvk_u ladiff2_u ladiff_u lamsam2_u lamsam_u lamsoni2_u lamsoni_u lamsons2_u lamsons_u lamzak2_u lamzak_u o2vk_u palsu2_u palsu_u rinh2_u rinh_u rinlsu2_u rinlsu_u rinv2_u rinv_u rkrn_u rk_u rl_u tabst_u tdmlka_u tmot_u tnse_u top_u tpsvkmf2_u tpsvkmf_u ubatt_u udkp1a_u udkp1_u udkp2_u upwg1_u upwg2d_u upwg2_u usvkk2_u usvkk_u uulsuf2_u uulsuf_u uulsuv2_u uulsuv_u uushk2_u uushk_u vfzgv1_u vfzg_u vvt_iw2_u vvt_iw_u vvt_sw2_u vvt_sw_u wdknlpr_u wdknlp_u wnwi1_u wnwi2_u /end OUT_MEASUREMENT
/end FUNCTION
/begin FUNCTION DFFTK "2.230     Diagnose; Kundenspezifische Auswahlliste f¸r Freeze Frame-Werte"
 /begin IN_MEASUREMENT abschkor_u addsu_u adhfm_u adta_u adtka_u adtm_u ahkat ahkat2 B_fe dffgen dlahi2_u dlahi_u dnvrbupctr dynlsu2_u dynlsu_u d_soc_u fho_u flgtiab frau2_u frau_u frhol_u frm2_u frm_u fstt ftead_u gentemp ibsderrs1 ibsderrs2 igod_u igokr_u ikrma ikrmet iptgh_u iptref_u ko2vk_u krivk_u kusvk2_u kusvk_u ladiff2_u ladiff_u lamsam2_u lamsam_u lamsoni2_u lamsoni_u lamsons2_u lamsons_u lamzak2_u lamzak_u lsunpstat lsunpstat2 midmd msabg msabg2 nmot o2vk_u Oelnivak oelstandr palsu2_u palsu_u phlsnh phlsnh2 rkrn_u rk_u sls2fft1 sls2fft2 sls2fft3 sls2fft4 slsfft1 slsfft2 slsfft3 slsfft4 stssgerr tabst_u talsuf talsuf2 taml tdmlka_u tikatm tikatm2 tkatmf tkatmf2 tmst tnse_u top_u ubatt_u udkp1a_u ugen usvkk2_u usvkk_u uulsuf2_u uulsuf_u uulsuv2_u uulsuv_u uushk2_u uushk_u vfzg2 vfzgv1_u vvt_iw2_u vvt_iw_u vvt_sw2_u vvt_sw_u wdknlpr_u wdknlp_u wnwi1_u wnwi2_u /end IN_MEASUREMENT
/end FUNCTION
/begin FUNCTION DFPDMTL "1.90" /begin DEF_CHARACTERISTIC CWDFPDMTL CWDMTDD SDMGLVU TDTLDFSTV /end DEF_CHARACTERISTIC
 /begin IN_MEASUREMENT aktlauf_w B_cddmtl B_dmtgv B_dmtlpe B_dmtlrst B_edmtk B_fadmtg B_fsttldv B_kl15 B_nkfl B_nkflg B_nmot B_refo B_refu B_sumv B_tank B_tankg B_tldinfo B_tldobd B_tldtehb B_zdmtgv B_zdmtk vfzg_w /end IN_MEASUREMENT
 /begin OUT_MEASUREMENT B_dmtdddbr B_dmtgvloc B_edmtg B_rdytlio B_rdytlnio B_tlddfpen B_zdmtg dfpdmtlAusBits dfpdmtlAusBitsNov /end OUT_MEASUREMENT
 /begin LOC_MEASUREMENT sdmglva_w /end LOC_MEASUREMENT
 /begin SUB_FUNCTION DFPM_DFPDMTL /end SUB_FUNCTION
/end FUNCTION
/begin FUNCTION DFPM "40.10     OBDII; Fehlerpfadmanager" /begin REF_CHARACTERISTIC CWFLC /end REF_CHARACTERISTIC
 /begin IN_MEASUREMENT bbwuc B_pwf egaspfad mi_duf mpfad nmot rstpfad skapfad tans tmot tmotlin top_w ushk ushk2 usvk usvk2 vfzg /end IN_MEASUREMENT
 /begin OUT_MEASUREMENT bbno bbsp3 bbtim B_no B_sp3 B_tim dfcmFcm dfcmNo dfcmSfp dfpmEpclState dfpmMilState dfp_ap dtrgmem_w fcmcla_0_A fcmdfp_0_A fcmdlc_0_A fcmEnd fcmfes_0_A fcmflc_0_A fcmfps_0_A fcmfrz0_0_A fcmfrz1_0_A fcmfrz10_0_A fcmfrz2_0_A fcmfrz3_0_A fcmfrz4_0_A fcmfrz5_0_A fcmfrz6_0_A fcmfrz7_0_A fcmfrz8_0_A fcmfrz9_0_A fcmhlc_0_A fcmhz_0_A FCMTab fcmtsf_0_A fcmtyp_0_A /end OUT_MEASUREMENT
/end FUNCTION
/begin FUNCTION DFPMHIS "1.30      Diagnose Fehlerpfadmanagement; History-Speicher" /begin IN_MEASUREMENT B_eemrdy B_eepwf fcmEnd FCMTab /end IN_MEASUREMENT /begin OUT_MEASUREMENT fcmHis /end OUT_MEASUREMENT /end FUNCTION
/begin FUNCTION DFPMNL "40.10     Diagnose Fehlerpfadmanagement im Nachlauf" /begin REF_CHARACTERISTIC CWFLC /end REF_CHARACTERISTIC /begin IN_MEASUREMENT bbwuc B_nlobd fcmEnd /end IN_MEASUREMENT /end FUNCTION
/begin FUNCTION DFPMOVF "2.10      Diagnose Fehlerpfadmanagement, Memory Overflow" /begin REF_CHARACTERISTIC CWFLC /end REF_CHARACTERISTIC /begin IN_MEASUREMENT fcmEnd /end IN_MEASUREMENT /end FUNCTION
/begin FUNCTION DFPMPMDIAG "1.10" /begin IN_MEASUREMENT fs_pm /end IN_MEASUREMENT /begin LOC_MEASUREMENT fs_pmold /end LOC_MEASUREMENT /begin SUB_FUNCTION DFPM_DFPMPMDIAG INDEX_DFPMPMDIAG /end SUB_FUNCTION /end FUNCTION
/begin FUNCTION DFPM_BGELSV ""
 /begin DEF_CHARACTERISTIC CDCLSV CDCLSV2 CDKLSV CDKLSV2 CDTLSV CDTLSV2 CLALSV CLALSV2 FFTLSV FFTLSV2 TSFLSV TSFLSV2 /end DEF_CHARACTERISTIC
 /begin OUT_MEASUREMENT B_belsv B_belsv2 B_bklsv B_bklsv2 B_cllsv B_cllsv2 B_ftlsv B_ftlsv2 B_mnlsv B_mnlsv2 B_mxlsv B_mxlsv2 B_nplsv B_nplsv2 B_silsv B_silsv2 E_lsv E_lsv2 sfplsv sfplsv2 TYP_lsv TYP_lsv2 Z_lsv Z_lsv2 /end OUT_MEASUREMENT
/end FUNCTION
/begin FUNCTION DFPM_BGRBS "" /begin DEF_CHARACTERISTIC CDCSWE CDKSWE CDTSWE CLASWE FFTSWE TSFSWE /end DEF_CHARACTERISTIC
 /begin OUT_MEASUREMENT B_beswe B_bkswe B_clswe B_ftswe B_mnswe B_mxswe B_npswe B_siswe E_swe sfpswe TYP_swe Z_swe /end OUT_MEASUREMENT
/end FUNCTION
/begin FUNCTION DFPM_BGTABST "" /begin DEF_CHARACTERISTIC CDCCUHR CDKCUHR CDTCUHR CLACUHR FFTCUHR TSFCUHR /end DEF_CHARACTERISTIC
 /begin OUT_MEASUREMENT B_becuhr B_bkcuhr B_clcuhr B_ftcuhr B_mncuhr B_mxcuhr B_npcuhr B_sicuhr E_cuhr sfpcuhr TYP_cuhr Z_cuhr /end OUT_MEASUREMENT
/end FUNCTION
/begin FUNCTION DFPM_DAKRE "" /begin DEF_CHARACTERISTIC CDCAKRE CDKAKRE CDTAKRE CLAAKRE FFTAKRE TSFAKRE /end DEF_CHARACTERISTIC
 /begin OUT_MEASUREMENT B_beakre B_bkakre B_clakre B_ftakre B_mnakre B_mxakre B_npakre B_siakre E_akre sfpakre TYP_akre Z_akre /end OUT_MEASUREMENT
/end FUNCTION
/begin FUNCTION DFPM_DANSKLE "" /begin DEF_CHARACTERISTIC CDCANSKE CDKANSKE CDTANSKE CLAANSKE FFTANSKE TSFANSKE /end DEF_CHARACTERISTIC
 /begin OUT_MEASUREMENT B_beanske B_bkanske B_clanske B_ftanske B_mnanske B_mxanske B_npanske B_sianske E_anske sfpanske TYP_anske Z_anske /end OUT_MEASUREMENT
/end FUNCTION
/begin FUNCTION DFPM_DCACC "" /begin DEF_CHARACTERISTIC CDCCACC CDKCACC CDTCACC CLACACC FFTCACC TSFCACC /end DEF_CHARACTERISTIC
 /begin OUT_MEASUREMENT B_becacc B_bkcacc B_clcacc B_ftcacc B_mncacc B_mxcacc B_npcacc B_sicacc E_cacc sfpcacc TYP_cacc Z_cacc /end OUT_MEASUREMENT
/end FUNCTION
/begin FUNCTION DFPM_DCAFS "" /begin DEF_CHARACTERISTIC CDCCAFS CDKCAFS CDTCAFS CLACAFS FFTCAFS TSFCAFS /end DEF_CHARACTERISTIC
 /begin OUT_MEASUREMENT B_becafs B_bkcafs B_clcafs B_ftcafs B_mncafs B_mxcafs B_npcafs B_sicafs E_cafs sfpcafs TYP_cafs Z_cafs /end OUT_MEASUREMENT
/end FUNCTION
/begin FUNCTION DFPM_DCANA "" /begin DEF_CHARACTERISTIC CDCCANA CDKCANA CDTCANA CLACANA FFTCANA TSFCANA /end DEF_CHARACTERISTIC
 /begin OUT_MEASUREMENT B_becana B_bkcana B_clcana B_ftcana B_mncana B_mxcana B_npcana B_sicana E_cana sfpcana TYP_cana Z_cana /end OUT_MEASUREMENT
/end FUNCTION
/begin FUNCTION DFPM_DCANB "" /begin DEF_CHARACTERISTIC CDCCANB CDKCANB CDTCANB CLACANB FFTCANB TSFCANB /end DEF_CHARACTERISTIC
 /begin OUT_MEASUREMENT B_becanb B_bkcanb B_clcanb B_ftcanb B_mncanb B_mxcanb B_npcanb B_sicanb E_canb sfpcanb TYP_canb Z_canb /end OUT_MEASUREMENT
/end FUNCTION
/begin FUNCTION DFPM_DCANBOT ""
 /begin DEF_CHARACTERISTIC CDCX135 CDCX315 CDCX334 CDCX3B0 CDCX3B4 CDCXC4 CDKX135 CDKX315 CDKX334 CDKX3B0 CDKX3B4 CDKXC4 CDTX135 CDTX315 CDTX334 CDTX3B0 CDTX3B4 CDTXC4 CLAX135 CLAX315 CLAX334 CLAX3B0 CLAX3B4 CLAXC4 FFTX135 FFTX315 FFTX334 FFTX3B0 FFTX3B4 FFTXC4 TSFX135 TSFX315 TSFX334 TSFX3B0 TSFX3B4 TSFXC4 /end DEF_CHARACTERISTIC
 /begin OUT_MEASUREMENT B_bex135 B_bex315 B_bex334 B_bex3b0 B_bex3b4 B_bexc4 B_bkx135 B_bkx315 B_bkx334 B_bkx3b0 B_bkx3b4 B_bkxc4 B_clx135 B_clx315 B_clx334 B_clx3b0 B_clx3b4 B_clxc4 B_ftx135 B_ftx315 B_ftx334 B_ftx3b0 B_ftx3b4 B_ftxc4 B_mnx135 B_mnx315 B_mnx334 B_mnx3b0 B_mnx3b4 B_mnxc4 B_mxx135 B_mxx315 B_mxx334 B_mxx3b0 B_mxx3b4 B_mxxc4 B_npx135 B_npx315 B_npx334 B_npx3b0 B_npx3b4 B_npxc4 B_six135 B_six315 B_six334 B_six3b0 B_six3b4 B_sixc4 E_x135 E_x315 E_x334 E_x3b0 E_x3b4 E_xc4 sfpx135 sfpx315 sfpx334 sfpx3b0 sfpx3b4 sfpxc4 TYP_x135 TYP_x315 TYP_x334 TYP_x3b0 TYP_x3b4 TYP_xc4 Z_x135 Z_x315 Z_x334 Z_x3b0 Z_x3b4 Z_xc4 /end OUT_MEASUREMENT
/end FUNCTION
/begin COMPU_METHOD bfzg_q0p025 "" RAT_FUNC "%6.4" "m/s^2" COEFFS 0 40 0 0 0 1 /end COMPU_METHOD
/begin COMPU_METHOD B_TRUE "boolsche Zust‰nde, positive Logik" TAB_VERB "%6.3" "" COMPU_TAB_REF B_TRUE /end COMPU_METHOD
/begin COMPU_VTAB B_TRUE "boolsche Zust‰nde, positive Logik" TAB_VERB 2 0 "----" 1 "TRUE" /end COMPU_VTAB
/begin COMPU_METHOD DEZ "1 : 1 Umrechnug (dez/hex)" RAT_FUNC "%6.2" "" COEFFS 0 1 0 0 0 1 /end COMPU_METHOD
/begin COMPU_METHOD dez "1 : 1 Umrechnug (dez/hex)" RAT_FUNC "%6.2" "" COEFFS 0 1 0 0 0 1 /end COMPU_METHOD
/begin COMPU_METHOD di_ub_b2 "" RAT_FUNC "%6.3" "%" COEFFS 0 2.56 0 0 0 1 /end COMPU_METHOD
/begin COMPU_METHOD fak_q0p00195 "" RAT_FUNC "%6.4" "-" COEFFS 0 65536 0 0 0 128 /end COMPU_METHOD
/begin COMPU_METHOD fak_q0p015625 "" RAT_FUNC "%6.4" "-" COEFFS 0 64 0 0 0 1 /end COMPU_METHOD
/begin COMPU_METHOD fak_q0p0625 "" RAT_FUNC "%6.4" "-" COEFFS 0 16 0 0 0 1 /end COMPU_METHOD
/begin COMPU_METHOD fak_q0p5 "" RAT_FUNC "%6.3" "-" COEFFS 0 1 0 0 0 0.5 /end COMPU_METHOD
/begin COMPU_METHOD fak_q4p883Em4 "" RAT_FUNC "%6.5" "-" COEFFS 0 65536 0 0 0 32 /end COMPU_METHOD
/begin COMPU_METHOD fak_sb_b64 "" RAT_FUNC "%6.3" "-" COEFFS 0 256 0 0 0 128 /end COMPU_METHOD
/begin COMPU_METHOD fak_sw_b2 "" RAT_FUNC "%7.6" "-" COEFFS 0 65536 0 0 0 4 /end COMPU_METHOD
/begin COMPU_METHOD fak_ub_b1 "" RAT_FUNC "%6.4" "-" COEFFS 0 256 0 0 0 1 /end COMPU_METHOD
/begin COMPU_METHOD fak_ub_b16 "" RAT_FUNC "%6.4" "-" COEFFS 0 256 0 0 0 16 /end COMPU_METHOD
/begin COMPU_METHOD fak_ub_b2 "" RAT_FUNC "%6.4" "-" COEFFS 0 256 0 0 0 2 /end COMPU_METHOD
/begin COMPU_METHOD fak_ub_b4 "" RAT_FUNC "%6.4" "-" COEFFS 0 256 0 0 0 4 /end COMPU_METHOD
/begin COMPU_METHOD fak_uw_b1 "" RAT_FUNC "%7.6" "-" COEFFS 0 65536 0 0 0 1 /end COMPU_METHOD
/begin COMPU_METHOD fak_uw_b16 "" RAT_FUNC "%6.5" "-" COEFFS 0 65536 0 0 0 16 /end COMPU_METHOD
/begin COMPU_METHOD fak_uw_b2 "" RAT_FUNC "%7.6" "-" COEFFS 0 65536 0 0 0 2 /end COMPU_METHOD
/begin COMPU_METHOD i_q0p1953_mA "" RAT_FUNC "%6.3" "mA" COEFFS 0 256 0 0 0 50 /end COMPU_METHOD
/begin COMPU_METHOD i_q6p1035_uA "" RAT_FUNC "%6.4" "mA" COEFFS 0 65536 0 0 0 400 /end COMPU_METHOD
/begin COMPU_METHOD kw_q0p0039 "" RAT_FUNC "%6.4" "Grad KW" COEFFS 0 256 0 0 0 1 /end COMPU_METHOD
/begin COMPU_METHOD kw_q0p0156 "" RAT_FUNC "%6.4" "Grad KW" COEFFS 0 64 0 0 0 1 /end COMPU_METHOD
/begin COMPU_METHOD kw_q0p0625 "" RAT_FUNC "%6.4" "Grad KW" COEFFS 0 16 0 0 0 1 /end COMPU_METHOD
/begin COMPU_METHOD lws_q0p04375 "" RAT_FUNC "%6.4" "Grad" COEFFS 0 1 0 0 0 0.04375 /end COMPU_METHOD
/begin COMPU_METHOD md_q0p002 "" RAT_FUNC "%6.4" "Nm" COEFFS 0 512 0 0 0 1 /end COMPU_METHOD
/begin COMPU_METHOD md_q0p5 "" RAT_FUNC "%6.3" "Nm" COEFFS 0 1 0 0 0 0.5 /end COMPU_METHOD
/begin COMPU_METHOD nmot_ub_q40 "" RAT_FUNC "%6.1" "1/min" COEFFS 0 1 0 0 0 40 /end COMPU_METHOD
/begin COMPU_METHOD nmot_uw_q0p25 "" RAT_FUNC "%6.3" "1/min" COEFFS 0 1 0 0 0 0.25 /end COMPU_METHOD
/begin COMPU_METHOD p_q0p039 "" RAT_FUNC "%6.4" "hPa" COEFFS 0 256 0 0 0 10 /end COMPU_METHOD
/begin COMPU_METHOD p_q0p1 "" RAT_FUNC "%6.3" "W" COEFFS 0 10 0 0 0 1 /end COMPU_METHOD
/begin COMPU_METHOD p_ub_q10 "" RAT_FUNC "%6.1" "hPa" COEFFS 0 1 0 0 0 10 /end COMPU_METHOD
/begin COMPU_METHOD relDK_ub_b100 "" RAT_FUNC "%6.3" "%DK" COEFFS 0 255 0 0 0 100 /end COMPU_METHOD
/begin COMPU_METHOD relO2_q0p25 "" RAT_FUNC "%6.3" "% O2" COEFFS 0 256 0 0 0 64 /end COMPU_METHOD
/begin COMPU_METHOD rel_q0p39 "" RAT_FUNC "%6.3" "%" COEFFS 0 256 0 0 0 100 /end COMPU_METHOD
/begin COMPU_METHOD rel_q1p024_o100 "" RAT_FUNC "%6.2" "%" COEFFS 0 65536 6553600 0 0 67109 /end COMPU_METHOD
/begin COMPU_METHOD rel_sw_b100 "" RAT_FUNC "%6.4" "%" COEFFS 0 32768 0 0 0 100 /end COMPU_METHOD
/begin COMPU_METHOD rel_sw_b1536 "" RAT_FUNC "%6.4" "%" COEFFS 0 65536 0 0 0 3072 /end COMPU_METHOD
/begin COMPU_METHOD rel_ub_b100 "" RAT_FUNC "%6.3" "%" COEFFS 0 256 0 0 0 100 /end COMPU_METHOD
/begin COMPU_METHOD rel_ub_b765 "" RAT_FUNC "%6.2" "%" COEFFS 0 255 0 0 0 765 /end COMPU_METHOD
/begin COMPU_METHOD rel_uw_b100 "" RAT_FUNC "%6.4" "%" COEFFS 0 65536 0 0 0 100 /end COMPU_METHOD
/begin COMPU_METHOD rel_uw_q0p0234 "" RAT_FUNC "%6.4" "%" COEFFS 0 32 0 0 0 0.75 /end COMPU_METHOD
/begin COMPU_METHOD r_q10 "" RAT_FUNC "%6.1" "Ohm" COEFFS 0 1 0 0 0 10 /end COMPU_METHOD
/begin COMPU_METHOD r_q10p01 "" RAT_FUNC "%6.1" "Ohm" COEFFS 0 256 0 0 0 2562 /end COMPU_METHOD
/begin COMPU_METHOD r_ub_q64 "" RAT_FUNC "%6.1" "Ohm" COEFFS 0 1 0 0 0 64 /end COMPU_METHOD
/begin COMPU_METHOD spgg_sb_b3052 "" RAT_FUNC "%6.1" "V/s" COEFFS 0 1 0 0 0 23.8438 /end COMPU_METHOD
/begin COMPU_METHOD spg_q0p00488 "" RAT_FUNC "%6.4" "V" COEFFS 0 1024 0 0 0 5 /end COMPU_METHOD
/begin COMPU_METHOD spg_q0p064_o6 "" RAT_FUNC "%6.3" "V" COEFFS 0 125 -750 0 0 8 /end COMPU_METHOD
/begin COMPU_METHOD spg_q0p1 "" RAT_FUNC "%6.3" "V" COEFFS 0 1 0 0 0 0.1 /end COMPU_METHOD
/begin COMPU_METHOD spg_q0p625 "" RAT_FUNC "%6.3" "V" COEFFS 0 8 0 0 0 5 /end COMPU_METHOD
/begin COMPU_METHOD spg_sw_q0p00488 "" RAT_FUNC "%6.4" "V" COEFFS 0 1024 0 0 0 5 /end COMPU_METHOD
/begin COMPU_METHOD spg_ubatt "" RAT_FUNC "%6.3" "V" COEFFS 0 1 0 0 0 0.0942 /end COMPU_METHOD
/begin COMPU_METHOD spg_ub_b5 "" RAT_FUNC "%6.4" "V" COEFFS 0 256 0 0 0 5 /end COMPU_METHOD
/begin COMPU_METHOD spg_uw_b5 "" RAT_FUNC "%6.4" "V" COEFFS 0 1024 0 0 0 5 /end COMPU_METHOD
/begin COMPU_METHOD spg_uw_b50 "" RAT_FUNC "%7.6" "V" COEFFS 0 13107 0 0 0 1 /end COMPU_METHOD
/begin COMPU_METHOD spg_uw_b55 "" RAT_FUNC "%6.4" "V" COEFFS 0 8192 0 0 0 55 /end COMPU_METHOD
/begin COMPU_METHOD sprzi_q0p1 "" RAT_FUNC "%6.3" "Grad KW" COEFFS 0 10 0 0 0 1 /end COMPU_METHOD
/begin COMPU_METHOD s_q0p02777_m "" RAT_FUNC "%6.4" "m" COEFFS 0 36 0 0 0 1 /end COMPU_METHOD
/begin COMPU_METHOD t100msxs_ub_b25p5 "" RAT_FUNC "%6.3" "s" COEFFS 0 1 0 0 0 0.1 /end COMPU_METHOD
/begin COMPU_METHOD t100msxs_uw_b6553p5 "" RAT_FUNC "%6.3" "s" COEFFS 0 1 0 0 0 0.1 /end COMPU_METHOD
/begin COMPU_METHOD t10msxs_sb_q0p01 "" RAT_FUNC "%6.4" "s" COEFFS 0 1 0 0 0 0.01 /end COMPU_METHOD
/begin COMPU_METHOD t10msxs_ub_b10p2 "" RAT_FUNC "%6.4" "s" COEFFS 0 1 0 0 0 0.04 /end COMPU_METHOD
/begin COMPU_METHOD t10msxs_ub_b2p55 "" RAT_FUNC "%6.4" "s" COEFFS 0 1 0 0 0 0.01 /end COMPU_METHOD
/begin COMPU_METHOD t1536minxmin_q1536 "" RAT_FUNC "%7.0" "min" COEFFS 0 1 0 0 0 1536 /end COMPU_METHOD
/begin COMPU_METHOD t200msxs_ub_b51 "" RAT_FUNC "%6.3" "s" COEFFS 0 1 0 0 0 0.2 /end COMPU_METHOD
/begin COMPU_METHOD t200msxs_uw_q0p2 "" RAT_FUNC "%6.3" "s" COEFFS 0 1 0 0 0 0.2 /end COMPU_METHOD
/begin COMPU_METHOD t20msxs_ub_b5p1 "" RAT_FUNC "%6.4" "s" COEFFS 0 1 0 0 0 0.02 /end COMPU_METHOD
/begin COMPU_METHOD t20msxs_ub_q0p02 "" RAT_FUNC "%6.4" "s" COEFFS 0 50 0 0 0 1 /end COMPU_METHOD
/begin COMPU_METHOD t20msxs_uw_q0p02 "" RAT_FUNC "%6.4" "s" COEFFS 0 1 0 0 0 0.02 /end COMPU_METHOD
/begin COMPU_METHOD t25p6sxs_ub_b6528 "" RAT_FUNC "%6.1" "s" COEFFS 0 1 0 0 0 25.6 /end COMPU_METHOD
/begin COMPU_METHOD t6minxmin_q6 "" RAT_FUNC "%6.2" "min" COEFFS 0 1 0 0 0 6 /end COMPU_METHOD
/begin COMPU_METHOD temp_q0p00002 "" RAT_FUNC "%7.6" "Grad C" COEFFS 0 50000 0 0 0 1 /end COMPU_METHOD
/begin COMPU_METHOD temp_sw_q0p1 "" RAT_FUNC "%6.3" "Grad C" COEFFS 0 10 0 0 0 1 /end COMPU_METHOD
/begin COMPU_METHOD temp_ub_q0p75_o48 "" RAT_FUNC "%6.2" "Grad C" COEFFS 0 1 48 0 0 0.75 /end COMPU_METHOD
/begin COMPU_METHOD temp_ub_q1_o40 "" RAT_FUNC "%6.2" "Grad C" COEFFS 0 1 40 0 0 1 /end COMPU_METHOD
/begin COMPU_METHOD t_q0p01 "" RAT_FUNC "%6.4" "s" COEFFS 0 100 0 0 0 1 /end COMPU_METHOD
/begin COMPU_METHOD t_q0p1 "" RAT_FUNC "%6.3" "s" COEFFS 0 10 0 0 0 1 /end COMPU_METHOD
/begin COMPU_METHOD t_q1 "" RAT_FUNC "%6.2" "s" COEFFS 0 1 0 0 0 1 /end COMPU_METHOD
/begin COMPU_METHOD t_q1p6_s "" RAT_FUNC "%6.2" "s" COEFFS 0 2560 0 0 0 4096 /end COMPU_METHOD
/begin COMPU_METHOD t_q256 "" RAT_FUNC "%6.0" "s" COEFFS 0 1 0 0 0 256 /end COMPU_METHOD
/begin COMPU_METHOD vfzg_q1p0 "" RAT_FUNC "%6.2" "km/h" COEFFS 0 1 0 0 0 1 /end COMPU_METHOD
/begin COMPU_METHOD vfzg_uw_b512 "" RAT_FUNC "%6.4" "km/h" COEFFS 0 65536 0 0 0 512 /end COMPU_METHOD
/begin COMPU_METHOD vnstv_q0p00305 "" RAT_FUNC "%7.5" "%" COEFFS 0 327.68 0 0 0 1 /end COMPU_METHOD
/begin COMPU_METHOD vnstv_q0p00305s32768 "" RAT_FUNC "%7.3" "%" COEFFS 0 327.68 32768 0 0 1 /end COMPU_METHOD
/begin COMPU_METHOD vol_q0p1_l "" RAT_FUNC "%6.3" "l" COEFFS 0 1 0 0 0 0.1 /end COMPU_METHOD
/begin COMPU_METHOD wid_q0p01 "" RAT_FUNC "%6.4" "Ohm" COEFFS 0 100 0 0 0 1 /end COMPU_METHOD
/begin COMPU_METHOD wkw_sb_b128 "" RAT_FUNC "%6.2" "Grad KW" COEFFS 0 1 0 0 0 1 /end COMPU_METHOD
/begin COMPU_METHOD zk100msxs_uw_b6553 "" RAT_FUNC "%6.1" "s" COEFFS 0 0 65536 0 10 0 /end COMPU_METHOD
/begin COMPU_METHOD default "" RAT_FUNC "%6.2" "" COEFFS 0 1 0 0 0 1 /end COMPU_METHOD
/begin RECORD_LAYOUT GklWSb FNC_VALUES 1 SBYTE COLUMN_DIR DIRECT /end RECORD_LAYOUT
/begin RECORD_LAYOUT KfAxU8AyU8SstxS16SstyS16WS16 NO_AXIS_PTS_X 1 SWORD NO_AXIS_PTS_Y 2 SWORD AXIS_PTS_X 3 SWORD INDEX_INCR DIRECT AXIS_PTS_Y 4 SWORD INDEX_INCR DIRECT FNC_VALUES 5 SWORD COLUMN_DIR DIRECT /end RECORD_LAYOUT
/begin RECORD_LAYOUT KfAxU8AyU8SstxS16SstyU16WU16 NO_AXIS_PTS_X 1 UBYTE NO_AXIS_PTS_Y 2 UBYTE AXIS_PTS_X 3 SWORD INDEX_INCR DIRECT AXIS_PTS_Y 4 UWORD INDEX_INCR DIRECT FNC_VALUES 5 UWORD COLUMN_DIR DIRECT /end RECORD_LAYOUT
/begin RECORD_LAYOUT KfAxU8AyU8SstxU16SstyU16WU16 NO_AXIS_PTS_X 1 UWORD NO_AXIS_PTS_Y 2 UWORD AXIS_PTS_X 3 UWORD INDEX_INCR DIRECT AXIS_PTS_Y 4 UWORD INDEX_INCR DIRECT FNC_VALUES 5 UWORD COLUMN_DIR DIRECT /end RECORD_LAYOUT
/begin RECORD_LAYOUT KlASwSstSwWSw NO_AXIS_PTS_X 1 SWORD AXIS_PTS_X 2 SWORD INDEX_INCR DIRECT FNC_VALUES 3 SWORD COLUMN_DIR DIRECT /end RECORD_LAYOUT
/begin RECORD_LAYOUT KlAUbSstUbWSb NO_AXIS_PTS_X 1 UBYTE AXIS_PTS_X 2 UBYTE INDEX_INCR DIRECT FNC_VALUES 3 SBYTE COLUMN_DIR DIRECT /end RECORD_LAYOUT
/begin RECORD_LAYOUT KlAxU8SstxS16WS16 NO_AXIS_PTS_X 1 SWORD AXIS_PTS_X 2 SWORD INDEX_INCR DIRECT FNC_VALUES 3 SWORD COLUMN_DIR DIRECT /end RECORD_LAYOUT
/begin RECORD_LAYOUT KlAxU8SstxS16WU16 NO_AXIS_PTS_X 1 UWORD AXIS_PTS_X 2 SWORD INDEX_INCR DIRECT FNC_VALUES 3 UWORD COLUMN_DIR DIRECT /end RECORD_LAYOUT
/begin RECORD_LAYOUT KlAxU8SstxU16WU16 NO_AXIS_PTS_X 1 UWORD AXIS_PTS_X 2 UWORD INDEX_INCR DIRECT FNC_VALUES 3 UWORD COLUMN_DIR DIRECT /end RECORD_LAYOUT
/begin RECORD_LAYOUT KwbUb FNC_VALUES 1 UBYTE COLUMN_DIR DIRECT /end RECORD_LAYOUT
/begin RECORD_LAYOUT KwbUw FNC_VALUES 1 UWORD COLUMN_DIR DIRECT /end RECORD_LAYOUT
/begin RECORD_LAYOUT KwbWU16 FNC_VALUES 1 UWORD COLUMN_DIR DIRECT /end RECORD_LAYOUT
/begin RECORD_LAYOUT KwbWU8 FNC_VALUES 1 UBYTE COLUMN_DIR DIRECT /end RECORD_LAYOUT
/begin RECORD_LAYOUT KwSb FNC_VALUES 1 SBYTE COLUMN_DIR DIRECT /end RECORD_LAYOUT
/begin RECORD_LAYOUT KwSw FNC_VALUES 1 SWORD COLUMN_DIR DIRECT /end RECORD_LAYOUT
/begin RECORD_LAYOUT KwUb FNC_VALUES 1 UBYTE COLUMN_DIR DIRECT /end RECORD_LAYOUT
/begin RECORD_LAYOUT KwUw FNC_VALUES 1 UWORD COLUMN_DIR DIRECT /end RECORD_LAYOUT
/begin RECORD_LAYOUT KwWS16 FNC_VALUES 1 SWORD COLUMN_DIR DIRECT /end RECORD_LAYOUT
/begin RECORD_LAYOUT KwWU16 FNC_VALUES 1 UWORD COLUMN_DIR DIRECT /end RECORD_LAYOUT
/begin RECORD_LAYOUT KwWU8 FNC_VALUES 1 UBYTE COLUMN_DIR DIRECT /end RECORD_LAYOUT
/begin RECORD_LAYOUT SstAUbSstUb NO_AXIS_PTS_X 1 UBYTE AXIS_PTS_X 2 UBYTE INDEX_INCR DIRECT /end RECORD_LAYOUT
/end MODULE
/end PROJECT
