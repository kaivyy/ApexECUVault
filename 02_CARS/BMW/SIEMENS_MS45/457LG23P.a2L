ASAP2_VERSION 1 31
/begin PROJECT MS45 "BMW Motorsteuerung R6"
/begin HEADER "_default_HeaderComment" PROJECT_NO _57 /end HEADER
/begin MODULE _default_ModuleName "_default_ModuleLongIdentifier"
/begin MOD_COMMON "_default_ModCommonComment" DEPOSIT ABSOLUTE BYTE_ORDER MSB_FIRST ALIGNMENT_BYTE 1 ALIGNMENT_WORD 2 ALIGNMENT_LONG 4 ALIGNMENT_FLOAT32_IEEE 4 ALIGNMENT_FLOAT64_IEEE 8 /end MOD_COMMON
/begin MEASUREMENT cdn_diag_rly_accout "Diagnosis conditions for ACC Relay" UBYTE _CNV_A_R_LINEAR_____0_CM 1 100. 0. 255. DISPLAY_IDENTIFIER CDN_DIAG_RLY_ACCOUT ECU_ADDRESS 0x3fe96f FORMAT "%3.0" /end MEASUREMENT
/begin MEASUREMENT ctr_det_rly_accout "Diagnosis counter for checksum counter error symptom detection" UBYTE _CNV_A_R_LINEAR_____0_CM 1 100. 0. 255. DISPLAY_IDENTIFIER CTR_DET_RLY_ACCOUT ECU_ADDRESS 0x3fe970 FORMAT "%3.0" /end MEASUREMENT
/begin MEASUREMENT ctr_ready_rly_accout "Counter for end of diagnosis calculation for ACCOUT" UBYTE _CNV_A_R_LINEAR_____0_CM 1 100. 0. 255. DISPLAY_IDENTIFIER CTR_READY_RLY_ACCOUT ECU_ADDRESS 0x3fe971 FORMAT "%3.0" /end MEASUREMENT
/begin MEASUREMENT lv_err_rly_accout "Status air condition compressor relay diagnosis" UBYTE _CNV_S_2_RANGE______1_R_CM 1 100. 0. 255. DISPLAY_IDENTIFIER LV_ERR_RLY_ACCOUT ECU_ADDRESS 0x3fb978 /end MEASUREMENT
/begin MEASUREMENT lv_inh_diag_rly_accout "Diagnosis inhibition RLY_ACCOUT_diagnosis" UBYTE _CNV_S_2_RANGE______2_CM 1 100. 0. 1. DISPLAY_IDENTIFIER LV_INH_DIAG_RLY_ACCOUT ECU_ADDRESS 0x3fe96e /end MEASUREMENT
/begin MEASUREMENT cdn_diag_ef "Diagnosis conditions for Exhaust Flap" UBYTE _CNV_A_R_LINEAR_____0_CM 1 100. 0. 255. DISPLAY_IDENTIFIER CDN_DIAG_EF ECU_ADDRESS 0x3fe942 FORMAT "%3.0" /end MEASUREMENT
/begin MEASUREMENT lv_err_ef "Logical value for exhaust flap power stage error" UBYTE _CNV_S_2_RANGE______1_R_CM 1 100. 0. 255. DISPLAY_IDENTIFIER LV_ERR_EF ECU_ADDRESS 0x3fba48 BIT_MASK 0x1 /end MEASUREMENT
/begin MEASUREMENT lv_inh_diag_ef "Exhaust Flap diagnosis: application incidence to inhibit the diagnosis" UBYTE _CNV_S_2_RANGE______2_CM 1 100. 0. 1. DISPLAY_IDENTIFIER LV_INH_DIAG_EF ECU_ADDRESS 0x3fe941 /end MEASUREMENT
/begin MEASUREMENT ctr_det_ef "Diagnosis counter for checksum counter error symptom detection" UBYTE _CNV_A_R_LINEAR_____0_CM 1 100. 0. 255. DISPLAY_IDENTIFIER CTR_DET_EF ECU_ADDRESS 0x3fe943 FORMAT "%3.0" /end MEASUREMENT
/begin MEASUREMENT ctr_ready_ef "Counter for end of diagnosis calculation for Exhaust Flap" UBYTE _CNV_A_R_LINEAR_____0_CM 1 100. 0. 255. DISPLAY_IDENTIFIER CTR_READY_EF ECU_ADDRESS 0x3fe944 FORMAT "%3.0" /end MEASUREMENT
/begin MEASUREMENT cdn_diag_sav "Diagnosis conditions for SAV" UBYTE _CNV_A_R_LINEAR_____0_CM 1 100. 0. 255. DISPLAY_IDENTIFIER CDN_DIAG_SAV ECU_ADDRESS 0x3fe95d FORMAT "%3.0" /end MEASUREMENT
/begin MEASUREMENT lv_err_sav "Boolean for errorcurrently present on secondary air valve command signal" UBYTE _CNV_S_2_RANGE______1_R_CM 1 100. 0. 255. DISPLAY_IDENTIFIER LV_ERR_SAV ECU_ADDRESS 0x3fb980 /end MEASUREMENT
/begin MEASUREMENT lv_inh_diag_sav "Secondary air valve diagnosis: application incidence to inhibit the diagnosis" UBYTE _CNV_S_2_RANGE______2_CM 1 100. 0. 1. DISPLAY_IDENTIFIER LV_INH_DIAG_SAV ECU_ADDRESS 0x3fe95c /end MEASUREMENT
/begin MEASUREMENT ctr_det_sav "Diagnosis counter for checksum counter error symptom detection" UBYTE _CNV_A_R_LINEAR_____0_CM 1 100. 0. 255. DISPLAY_IDENTIFIER CTR_DET_SAV ECU_ADDRESS 0x3fe95e FORMAT "%3.0" /end MEASUREMENT
/begin MEASUREMENT ctr_ready_sav "Counter for end of diagnosis calculation for SAV" UBYTE _CNV_A_R_LINEAR_____0_CM 1 100. 0. 255. DISPLAY_IDENTIFIER CTR_READY_SAV ECU_ADDRESS 0x3fe95f FORMAT "%3.0" /end MEASUREMENT
/begin MEASUREMENT lv_err_vim "Boolean for error currently present on var. intake manifold drive (after debounce)" UBYTE _CNV_S_2_RANGE______1_R_CM 1 100. 0. 255. DISPLAY_IDENTIFIER LV_ERR_VIM ECU_ADDRESS 0x3fb93c /end MEASUREMENT
/begin MEASUREMENT lv_inh_diag_vim "Inhibit diagnosis variable intake manifold" UBYTE _CNV_S_2_RANGE______2_CM 1 100. 0. 1. DISPLAY_IDENTIFIER LV_INH_DIAG_VIM ECU_ADDRESS 0x3fe963 /end MEASUREMENT
/begin MEASUREMENT cdn_diag_vim "Diagnosis conditions for VIM" UBYTE _CNV_A_R_LINEAR_____0_CM 1 100. 0. 255. DISPLAY_IDENTIFIER CDN_DIAG_VIM ECU_ADDRESS 0x3fe964 FORMAT "%3.0" /end MEASUREMENT
/begin MEASUREMENT ctr_det_vim "Diagnosis counter for checksum counter error symptom detection" UBYTE _CNV_A_R_LINEAR_____0_CM 1 100. 0. 255. DISPLAY_IDENTIFIER CTR_DET_VIM ECU_ADDRESS 0x3fe965 FORMAT "%3.0" /end MEASUREMENT
/begin MEASUREMENT ctr_ready_vim "Counter for end of diagnosis calculation for VIM" UBYTE _CNV_A_R_LINEAR_____0_CM 1 100. 0. 255. DISPLAY_IDENTIFIER CTR_READY_VIM ECU_ADDRESS 0x3fe966 FORMAT "%3.0" /end MEASUREMENT
/begin MEASUREMENT lv_err_lsh_down_1 "Boolean error flag, fault currently present on upstream oxygen sensor heater circuit 1" UBYTE _CNV_S_2_RANGE______5_R_CM 1 100. 0. 255. DISPLAY_IDENTIFIER LV_ERR_LSH_DOWN_1 ECU_ADDRESS 0x3fb84c /end MEASUREMENT
/begin MEASUREMENT cdn_diag_lsh_down_2 "Diagnosis condition for each symptom for LSH_DOWN_2" UBYTE _CNV_A_R_LINEAR_____0_CM 1 100. 0. 255. DISPLAY_IDENTIFIER CDN_DIAG_LSH_DOWN_2 ECU_ADDRESS 0x3fe561 FORMAT "%3.0" /end MEASUREMENT
/begin MEASUREMENT ctr_det_lsh_down_2 "Debounce counter for LSH_DOWN_2" UBYTE _CNV_A_R_LINEAR_____0_CM 1 100. 0. 255. DISPLAY_IDENTIFIER CTR_DET_LSH_DOWN_2 ECU_ADDRESS 0x3fe562 FORMAT "%3.0" /end MEASUREMENT
/begin MEASUREMENT lv_inh_diag_lsh_down_2 "Diagnosis inhibition LSH_DOWN_2" UBYTE _CNV_S_2_RANGE______2_CM 1 100. 0. 1. DISPLAY_IDENTIFIER LV_INH_DIAG_LSH_DOWN_2 ECU_ADDRESS 0x3fe55c BIT_MASK 0x1 /end MEASUREMENT
/begin CHARACTERISTIC c_teg_cat_down_mdl_min_lsh_diag "Minimum exhaust gas temperature to permit diagnosis" VALUE 0xffe41a3c _REC_VAL_20_u2 2047. _CNV_A_R_LINEAR_____6_CM 0. 2047. DISPLAY_IDENTIFIER C_TEG_CAT_DOWN_MDL_MIN_LSH_DIAG FORMAT "%7.2" /end CHARACTERISTIC
/begin MEASUREMENT cdn_diag_lsh_down_1 "Diagnosis condition for each symptom for LSH_DOWN_1" UBYTE _CNV_A_R_LINEAR_____0_CM 1 100. 0. 255. DISPLAY_IDENTIFIER CDN_DIAG_LSH_DOWN_1 ECU_ADDRESS 0x3fe55d FORMAT "%3.0" /end MEASUREMENT
/begin MEASUREMENT ctr_det_lsh_down_1 "Debounce counter for LSH_DOWN_1" UBYTE _CNV_A_R_LINEAR_____0_CM 1 100. 0. 255. DISPLAY_IDENTIFIER CTR_DET_LSH_DOWN_1 ECU_ADDRESS 0x3fe55e FORMAT "%3.0" /end MEASUREMENT
/begin MEASUREMENT ctr_ready_lsh_down_1 "Counter for end of diagnosis calculation for LSH_DOWN_1" UBYTE _CNV_A_R_LINEAR_____0_CM 1 100. 0. 255. DISPLAY_IDENTIFIER CTR_READY_LSH_DOWN_1 ECU_ADDRESS 0x3fe55f FORMAT "%3.0" /end MEASUREMENT
/begin MEASUREMENT ctr_ready_lsh_down_2 "Counter for end of diagnosis calculation for LSH_DOWN_2" UBYTE _CNV_A_R_LINEAR_____0_CM 1 100. 0. 255. DISPLAY_IDENTIFIER CTR_READY_LSH_DOWN_2 ECU_ADDRESS 0x3fe563 FORMAT "%3.0" /end MEASUREMENT
/begin MEASUREMENT lv_inh_diag_lsh_down_1 "Diagnosis inhibition LSH_DOWN_1" UBYTE _CNV_S_2_RANGE______2_CM 1 100. 0. 1. DISPLAY_IDENTIFIER LV_INH_DIAG_LSH_DOWN_1 ECU_ADDRESS 0x3fe55b BIT_MASK 0x1 /end MEASUREMENT
/begin MEASUREMENT lv_err_lsh_up_1 "Boolean error flag, fault currently present on upstream oxygen sensor heater circuit 1" UBYTE _CNV_S_2_RANGE______5_R_CM 1 100. 0. 255. DISPLAY_IDENTIFIER LV_ERR_LSH_UP_1 ECU_ADDRESS 0x3fb844 /end MEASUREMENT
/begin MEASUREMENT lv_err_lsh_up_2 "Boolean error flag, fault currently present on upstream oxygen sensor heater circuit 2" UBYTE _CNV_S_2_RANGE______5_R_CM 1 100. 0. 255. DISPLAY_IDENTIFIER LV_ERR_LSH_UP_2 ECU_ADDRESS 0x3fb848 /end MEASUREMENT
/begin MEASUREMENT lv_inh_diag_lsh_up_2 "Diagnosis inhibition LSH_UP_2" UBYTE _CNV_S_2_RANGE______2_CM 1 100. 0. 1. DISPLAY_IDENTIFIER LV_INH_DIAG_LSH_UP_2 ECU_ADDRESS 0x3fe552 BIT_MASK 0x1 /end MEASUREMENT
/begin MEASUREMENT cdn_diag_lsh_up_1 "Diagnosis condition for each symptom for LSH_UP_1" UBYTE _CNV_A_R_LINEAR_____0_CM 1 100. 0. 255. DISPLAY_IDENTIFIER CDN_DIAG_LSH_UP_1 ECU_ADDRESS 0x3fe553 FORMAT "%3.0" /end MEASUREMENT
/begin MEASUREMENT cdn_diag_lsh_up_2 "Diagnosis condition for each symptom for LSH_UP_2" UBYTE _CNV_A_R_LINEAR_____0_CM 1 100. 0. 255. DISPLAY_IDENTIFIER CDN_DIAG_LSH_UP_2 ECU_ADDRESS 0x3fe557 FORMAT "%3.0" /end MEASUREMENT
/begin MEASUREMENT ctr_det_lsh_up_1 "Debounce counter for LSH_UP_1" UBYTE _CNV_A_R_LINEAR_____0_CM 1 100. 0. 255. DISPLAY_IDENTIFIER CTR_DET_LSH_UP_1 ECU_ADDRESS 0x3fe554 FORMAT "%3.0" /end MEASUREMENT
/begin MEASUREMENT ctr_det_lsh_up_2 "Debounce counter for LSH_UP_2" UBYTE _CNV_A_R_LINEAR_____0_CM 1 100. 0. 255. DISPLAY_IDENTIFIER CTR_DET_LSH_UP_2 ECU_ADDRESS 0x3fe558 FORMAT "%3.0" /end MEASUREMENT
/begin MEASUREMENT ctr_ready_lsh_up_1 "Counter for end of diagnosis calculation for LSH_DOWN_1" UBYTE _CNV_A_R_LINEAR_____0_CM 1 100. 0. 255. DISPLAY_IDENTIFIER CTR_READY_LSH_UP_1 ECU_ADDRESS 0x3fe555 FORMAT "%3.0" /end MEASUREMENT
/begin MEASUREMENT ctr_ready_lsh_up_2 "Counter for end of diagnosis calculation for LSH_DOWN_2" UBYTE _CNV_A_R_LINEAR_____0_CM 1 100. 0. 255. DISPLAY_IDENTIFIER CTR_READY_LSH_UP_2 ECU_ADDRESS 0x3fe559 FORMAT "%3.0" /end MEASUREMENT
/begin MEASUREMENT lv_inh_diag_lsh_up_1 "Diagnosis inhibition LSH_UP_1" UBYTE _CNV_S_2_RANGE______2_CM 1 100. 0. 1. DISPLAY_IDENTIFIER LV_INH_DIAG_LSH_UP_1 ECU_ADDRESS 0x3fe551 BIT_MASK 0x1 /end MEASUREMENT
/begin CHARACTERISTIC c_teg_cat_up_mdl_min_lsh_diag "Minimum exhaust gas temperature to permit diagnosis" VALUE 0xffe41a42 _REC_VAL_20_u2 2047. _CNV_A_R_LINEAR_____6_CM 0. 2047. DISPLAY_IDENTIFIER C_TEG_CAT_UP_MDL_MIN_LSH_DIAG FORMAT "%7.2" /end CHARACTERISTIC
/begin MEASUREMENT cdn_diag_isa_2 "Diagnosis condition for each symptom for  ISA_2" UBYTE _CNV_A_R_LINEAR_____0_CM 1 100. 0. 255. DISPLAY_IDENTIFIER CDN_DIAG_ISA_2 ECU_ADDRESS 0x3fe99f FORMAT "%3.0" /end MEASUREMENT
/begin MEASUREMENT ctr_det_isa_2 "Debounce counter for  ISA_2" UBYTE _CNV_A_R_LINEAR_____0_CM 1 100. 0. 255. DISPLAY_IDENTIFIER CTR_DET_ISA_2 ECU_ADDRESS 0x3fe9a0 FORMAT "%3.0" /end MEASUREMENT
/begin MEASUREMENT ctr_ready_isa_2 "Counter for end of diagnosis calculation for  ISA_2" UBYTE _CNV_A_R_LINEAR_____0_CM 1 100. 0. 255. DISPLAY_IDENTIFIER CTR_READY_ISA_2 ECU_ADDRESS 0x3fe9a1 FORMAT "%3.0" /end MEASUREMENT
/begin MEASUREMENT lv_err_isa_2 "electrical error idle speed actuator (ISA) coil 2 (closing)" UBYTE _CNV_S_2_RANGE______1_R_CM 1 100. 0. 255. DISPLAY_IDENTIFIER LV_ERR_ISA_2 ECU_ADDRESS 0x3fb9bc /end MEASUREMENT
/begin MEASUREMENT lv_err_isa_1 "electrical error idle speed actuator (ISA) coil 1 (opening)" UBYTE _CNV_S_2_RANGE______1_R_CM 1 100. 0. 255. DISPLAY_IDENTIFIER LV_ERR_ISA_1 ECU_ADDRESS 0x3fb9b8 /end MEASUREMENT
/begin MEASUREMENT lv_inh_diag_isa_2 "Diagnosis inhibition ISA_2" UBYTE _CNV_S_2_RANGE______2_CM 1 100. 0. 1. DISPLAY_IDENTIFIER LV_INH_DIAG_ISA_2 ECU_ADDRESS 0x3fe99b BIT_MASK 0x1 /end MEASUREMENT
/begin MEASUREMENT state_isa_diag "state of idle speed actuator" UBYTE _CNV_S_6_RANGE_STAT_7_CM 1 100. 0. 5. DISPLAY_IDENTIFIER STATE_ISA_DIAG ECU_ADDRESS 0x3fe999 /end MEASUREMENT
/begin MEASUREMENT ctr_det_isa_1 "Debounce counter for  ISA_1" UBYTE _CNV_A_R_LINEAR_____0_CM 1 100. 0. 255. DISPLAY_IDENTIFIER CTR_DET_ISA_1 ECU_ADDRESS 0x3fe99d FORMAT "%3.0" /end MEASUREMENT
/begin MEASUREMENT ctr_ready_isa_1 "Counter for end of diagnosis calculation for  ISA_1" UBYTE _CNV_A_R_LINEAR_____0_CM 1 100. 0. 255. DISPLAY_IDENTIFIER CTR_READY_ISA_1 ECU_ADDRESS 0x3fe99e FORMAT "%3.0" /end MEASUREMENT
/begin CHARACTERISTIC c_isa_pwm_diag_min_scb "Minimum threshold for SCB diagnosis window" VALUE 0xffe41684 _REC_VAL_20_u2 99.99847412 _CNV_A_R_LINEAR_____8_CM 0. 99.99847412 DISPLAY_IDENTIFIER C_ISA_PWM_DIAG_MIN_SCB FORMAT "%5.2" /end CHARACTERISTIC
/begin CHARACTERISTIC c_isa_pwm_diag_min_oc "Maximum threshold for OC diagnosis window" VALUE 0xffe41682 _REC_VAL_20_u2 99.99847412 _CNV_A_R_LINEAR_____8_CM 0. 99.99847412 DISPLAY_IDENTIFIER C_ISA_PWM_DIAG_MIN_OC FORMAT "%5.2" /end CHARACTERISTIC
/begin CHARACTERISTIC c_isa_pwm_diag_max_scg "Maximum threshold for SCG diagnosis window" VALUE 0xffe41680 _REC_VAL_20_u2 99.99847412 _CNV_A_R_LINEAR_____8_CM 0. 99.99847412 DISPLAY_IDENTIFIER C_ISA_PWM_DIAG_MAX_SCG FORMAT "%5.2" /end CHARACTERISTIC
/begin MEASUREMENT lv_inh_diag_isa_1 "Diagnosis inhibition ISA_1" UBYTE _CNV_S_2_RANGE______2_CM 1 100. 0. 1. DISPLAY_IDENTIFIER LV_INH_DIAG_ISA_1 ECU_ADDRESS 0x3fe99a BIT_MASK 0x1 /end MEASUREMENT
/begin MEASUREMENT cdn_diag_isa_1 "Diagnosis condition for each symptom for ISA_1" UBYTE _CNV_A_R_LINEAR_____0_CM 1 100. 0. 255. DISPLAY_IDENTIFIER CDN_DIAG_ISA_1 ECU_ADDRESS 0x3fe99c FORMAT "%3.0" /end MEASUREMENT
/begin MEASUREMENT lv_err_sap "Boolean for errorcurrently present on secondary air pump command signal" UBYTE _CNV_S_2_RANGE______1_R_CM 1 100. 0. 255. DISPLAY_IDENTIFIER LV_ERR_SAP ECU_ADDRESS 0x3fb97c /end MEASUREMENT
/begin MEASUREMENT lv_inh_diag_sap "Diagnosis inhibition SAP" UBYTE _CNV_S_2_RANGE______2_CM 1 100. 0. 1. DISPLAY_IDENTIFIER LV_INH_DIAG_SAP ECU_ADDRESS 0x3fe992 BIT_MASK 0x1 /end MEASUREMENT
/begin MEASUREMENT cdn_diag_sap "Diagnosis condition for each symptom for SAP" UBYTE _CNV_A_R_LINEAR_____0_CM 1 100. 0. 255. DISPLAY_IDENTIFIER CDN_DIAG_SAP ECU_ADDRESS 0x3fe993 FORMAT "%3.0" /end MEASUREMENT
/begin MEASUREMENT ctr_det_sap "Debounce counter for SAP" UBYTE _CNV_A_R_LINEAR_____0_CM 1 100. 0. 255. DISPLAY_IDENTIFIER CTR_DET_SAP ECU_ADDRESS 0x3fe994 FORMAT "%3.0" /end MEASUREMENT
/begin MEASUREMENT ctr_ready_sap "Counter for end of diagnosis calculation for SAP" UBYTE _CNV_A_R_LINEAR_____0_CM 1 100. 0. 255. DISPLAY_IDENTIFIER CTR_READY_SAP ECU_ADDRESS 0x3fe995 FORMAT "%3.0" /end MEASUREMENT
/begin MEASUREMENT lv_err_rly_efp "Boolean for error currently present on RLY_EFP" UBYTE _CNV_S_2_RANGE______1_R_CM 1 100. 0. 255. DISPLAY_IDENTIFIER LV_ERR_RLY_EFP ECU_ADDRESS 0x3fb854 /end MEASUREMENT
/begin MEASUREMENT lv_err_cps "Logical value for CPS error" UBYTE _CNV_S_2_RANGE______1_R_CM 1 100. 0. 255. DISPLAY_IDENTIFIER LV_ERR_CPS ECU_ADDRESS 0x3fb858 /end MEASUREMENT
/begin MEASUREMENT cppwm_lih "Canister purge PWM limp home value" UBYTE _CNV_A_R_LINEAR_____9_CM 1 100. 0. 99.609375 DISPLAY_IDENTIFIER CPPWM_LIH ECU_ADDRESS 0x3fe98b FORMAT "%4.1" /end MEASUREMENT
/begin MEASUREMENT lv_inh_diag_cps "Diagnosis inhibition CPS" UBYTE _CNV_S_2_RANGE______2_CM 1 100. 0. 1. DISPLAY_IDENTIFIER LV_INH_DIAG_CPS ECU_ADDRESS 0x3fe98c BIT_MASK 0x1 /end MEASUREMENT
/begin CHARACTERISTIC c_cppwm_sub_diag_1 "CPPWM substitute value when SCG failure" VALUE 0xffe40667 _REC_VAL_20_u1 99.609375 _CNV_A_R_LINEAR_____9_CM 0. 99.609375 DISPLAY_IDENTIFIER C_CPPWM_SUB_DIAG_1 FORMAT "%5.1" /end CHARACTERISTIC
/begin CHARACTERISTIC c_cppwm_sub_diag_2 "CPPWM substitute value when SCB or OL failure" VALUE 0xffe40668 _REC_VAL_20_u1 99.609375 _CNV_A_R_LINEAR_____9_CM 0. 99.609375 DISPLAY_IDENTIFIER C_CPPWM_SUB_DIAG_2 FORMAT "%5.1" /end CHARACTERISTIC
/begin MEASUREMENT ctr_det_cps "Debounce counter for CPS" UBYTE _CNV_A_R_LINEAR_____0_CM 1 100. 0. 255. DISPLAY_IDENTIFIER CTR_DET_CPS ECU_ADDRESS 0x3fe98e FORMAT "%3.0" /end MEASUREMENT
/begin MEASUREMENT ctr_ready_cps "Counter for end of diagnosis calculation for CPS" UBYTE _CNV_A_R_LINEAR_____0_CM 1 100. 0. 255. DISPLAY_IDENTIFIER CTR_READY_CPS ECU_ADDRESS 0x3fe98f FORMAT "%3.0" /end MEASUREMENT
/begin MEASUREMENT cdn_diag_cps "Diagnosis condition for each symptom for CPS" UBYTE _CNV_A_R_LINEAR_____0_CM 1 100. 0. 255. DISPLAY_IDENTIFIER CDN_DIAG_CPS ECU_ADDRESS 0x3fe98d FORMAT "%3.0" /end MEASUREMENT
/begin CHARACTERISTIC c_cps_pwm_diag_min_scb "Minimum threshold for SCB diagnosis window" VALUE 0xffe4066b _REC_VAL_20_u1 99.609375 _CNV_A_R_LINEAR_____9_CM 0. 99.609375 DISPLAY_IDENTIFIER C_CPS_PWM_DIAG_MIN_SCB FORMAT "%4.1" /end CHARACTERISTIC
/begin CHARACTERISTIC c_cps_pwm_diag_min_oc "Maximum threshold for OC diagnosis window" VALUE 0xffe4066a _REC_VAL_20_u1 99.609375 _CNV_A_R_LINEAR_____9_CM 0. 99.609375 DISPLAY_IDENTIFIER C_CPS_PWM_DIAG_MIN_OC FORMAT "%4.1" /end CHARACTERISTIC
/begin CHARACTERISTIC c_cps_pwm_diag_max_scg "Maximum threshold for SCG diagnosis window" VALUE 0xffe40669 _REC_VAL_20_u1 99.609375 _CNV_A_R_LINEAR_____9_CM 0. 99.609375 DISPLAY_IDENTIFIER C_CPS_PWM_DIAG_MAX_SCG FORMAT "%4.1" /end CHARACTERISTIC
/begin MEASUREMENT lv_err_ect_el "ECT Electrical error detected" UBYTE _CNV_S_2_RANGE______1_R_CM 1 100. 0. 255. DISPLAY_IDENTIFIER LV_ERR_ECT_EL ECU_ADDRESS 0x3fb998 /end MEASUREMENT
/begin MEASUREMENT lv_inh_diag_ect_el "Diagnosis inhibition ECT_EL" UBYTE _CNV_S_2_RANGE______2_CM 1 100. 0. 1. DISPLAY_IDENTIFIER LV_INH_DIAG_ECT_EL ECU_ADDRESS 0x3fe985 BIT_MASK 0x1 /end MEASUREMENT
/begin MEASUREMENT ctr_det_ect_el "Debounce counter for ECT_EL" UBYTE _CNV_A_R_LINEAR_____0_CM 1 100. 0. 255. DISPLAY_IDENTIFIER CTR_DET_ECT_EL ECU_ADDRESS 0x3fe987 FORMAT "%3.0" /end MEASUREMENT
/begin MEASUREMENT ctr_ready_ect_el "Counter for end of diagnosis calculation for ECT_EL" UBYTE _CNV_A_R_LINEAR_____0_CM 1 100. 0. 255. DISPLAY_IDENTIFIER CTR_READY_ECT_EL ECU_ADDRESS 0x3fe988 FORMAT "%3.0" /end MEASUREMENT
/begin MEASUREMENT cdn_diag_ect_el "Diagnosis condition for each symptom for ECT_EL" UBYTE _CNV_A_R_LINEAR_____0_CM 1 100. 0. 255. DISPLAY_IDENTIFIER CDN_DIAG_ECT_EL ECU_ADDRESS 0x3fe986 FORMAT "%3.0" /end MEASUREMENT
/begin CHARACTERISTIC c_ect_el_pwm_diag_min_scb "Minimum threshold for SCB diagnosis window" VALUE 0xffe4071c _REC_VAL_20_u1 99.609375 _CNV_A_R_LINEAR_____9_CM 0. 99.609375 DISPLAY_IDENTIFIER C_ECT_EL_PWM_DIAG_MIN_SCB FORMAT "%5.1" /end CHARACTERISTIC
/begin CHARACTERISTIC c_ect_el_pwm_diag_min_oc "Maximum threshold for OC diagnosis window" VALUE 0xffe4071b _REC_VAL_20_u1 99.609375 _CNV_A_R_LINEAR_____9_CM 0. 99.609375 DISPLAY_IDENTIFIER C_ECT_EL_PWM_DIAG_MIN_OC FORMAT "%5.1" /end CHARACTERISTIC
/begin CHARACTERISTIC c_ect_el_pwm_diag_max_scg "Maximum threshold for SCG diagnosis window" VALUE 0xffe4071a _REC_VAL_20_u1 99.609375 _CNV_A_R_LINEAR_____9_CM 0. 99.609375 DISPLAY_IDENTIFIER C_ECT_EL_PWM_DIAG_MAX_SCG FORMAT "%5.1" /end CHARACTERISTIC
/begin MEASUREMENT lv_inh_diag_ecf "Diagnosis inhibition ECF" UBYTE _CNV_S_2_RANGE______2_CM 1 100. 0. 1. DISPLAY_IDENTIFIER LV_INH_DIAG_ECF ECU_ADDRESS 0x3fe980 BIT_MASK 0x1 /end MEASUREMENT
/begin MEASUREMENT ctr_det_ecf "Debounce counter for ECT_EL" UBYTE _CNV_A_R_LINEAR_____0_CM 1 100. 0. 255. DISPLAY_IDENTIFIER CTR_DET_ECF ECU_ADDRESS 0x3fe982 FORMAT "%3.0" /end MEASUREMENT
/begin MEASUREMENT ctr_ready_ecf "Counter for end of diagnosis calculation for ECT_EL" UBYTE _CNV_A_R_LINEAR_____0_CM 1 100. 0. 255. DISPLAY_IDENTIFIER CTR_READY_ECF ECU_ADDRESS 0x3fe983 FORMAT "%3.0" /end MEASUREMENT
/begin MEASUREMENT cdn_diag_ecf "Diagnosis condition for each symptom for ECT_EL" UBYTE _CNV_A_R_LINEAR_____0_CM 1 100. 0. 255. DISPLAY_IDENTIFIER CDN_DIAG_ECF ECU_ADDRESS 0x3fe981 FORMAT "%3.0" /end MEASUREMENT
/begin MEASUREMENT lv_err_ecf "Boolean for errorcurrently present on ECF signal" UBYTE _CNV_S_2_RANGE______1_R_CM 1 100. 0. 255. DISPLAY_IDENTIFIER LV_ERR_ECF ECU_ADDRESS 0x3fb984 /end MEASUREMENT
/begin CHARACTERISTIC ip_n_max_iv_diag "Maximum N for diagnosis" CURVE 0xffe4d686 _REC_CUR_20_u2_u1 8160. _CNV_A_R_LINEAR_____10_CM 0. 8160. DISPLAY_IDENTIFIER IP_N_MAX_IV_DIAG FORMAT "%4.0"
 /begin AXIS_DESCR COM_AXIS tco _CNV_A_R_LINEAR_____11_CM 6 -48. 142.5 FORMAT "%5.1" AXIS_PTS_REF ldp_tco__ip_n_max_iv_diag /end AXIS_DESCR
/end CHARACTERISTIC
/begin MEASUREMENT lv_err_iv_0 "???" UBYTE _CNV_S_2_RANGE______1_R_CM 1 100. 0. 255. DISPLAY_IDENTIFIER LV_ERR_IV_0 ECU_ADDRESS 0x3fb82c /end MEASUREMENT
/begin MEASUREMENT iv_diag_mis "Detected symptom in a byte mask for misfire function" UBYTE _CNV_A_R_LINEAR_____0_CM 1 100. 0. 255. DISPLAY_IDENTIFIER IV_DIAG_MIS ECU_ADDRESS 0x3fe978 FORMAT "%3.0" /end MEASUREMENT
/begin MEASUREMENT lv_err_iv_5 "???" UBYTE _CNV_S_2_RANGE______1_R_CM 1 100. 0. 255. DISPLAY_IDENTIFIER LV_ERR_IV_5 ECU_ADDRESS 0x3fb840 /end MEASUREMENT
/begin MEASUREMENT lv_err_iv_4 "???" UBYTE _CNV_S_2_RANGE______1_R_CM 1 100. 0. 255. DISPLAY_IDENTIFIER LV_ERR_IV_4 ECU_ADDRESS 0x3fb83c /end MEASUREMENT
/begin MEASUREMENT lv_err_iv_3 "???" UBYTE _CNV_S_2_RANGE______1_R_CM 1 100. 0. 255. DISPLAY_IDENTIFIER LV_ERR_IV_3 ECU_ADDRESS 0x3fb838 /end MEASUREMENT
/begin MEASUREMENT lv_err_iv_2 "???" UBYTE _CNV_S_2_RANGE______1_R_CM 1 100. 0. 255. DISPLAY_IDENTIFIER LV_ERR_IV_2 ECU_ADDRESS 0x3fb834 /end MEASUREMENT
/begin MEASUREMENT lv_err_iv_1 "???" UBYTE _CNV_S_2_RANGE______1_R_CM 1 100. 0. 255. DISPLAY_IDENTIFIER LV_ERR_IV_1 ECU_ADDRESS 0x3fb830 /end MEASUREMENT
/begin AXIS_PTS ldp_tco__ip_n_max_iv_diag "" 0xffe411cb tco _REC_AXS_20_u1 190.5 _CNV_A_R_LINEAR_____11_CM 6 -48. 142.5 DISPLAY_IDENTIFIER LDP_TCO__IP_N_MAX_IV_DIAG FORMAT "%5.1" /end AXIS_PTS
/begin MEASUREMENT er_mmv_is_diag[0] "Filtered engine roughness value cylinder individual" SWORD _CNV_A_R_LINEAR_____25_CM 1 100. -8. 7.99975586 DISPLAY_IDENTIFIER ER_MMV_IS_DIAG_0 ECU_ADDRESS 0x3fd832 BYTE_ORDER MSB_LAST FORMAT "%7.4" /end MEASUREMENT
/begin MEASUREMENT er_mmv_is_diag[1] "Filtered engine roughness value cylinder individual" SWORD _CNV_A_R_LINEAR_____25_CM 1 100. -8. 7.99975586 DISPLAY_IDENTIFIER ER_MMV_IS_DIAG_1 ECU_ADDRESS 0x3fd834 BYTE_ORDER MSB_LAST FORMAT "%7.4" /end MEASUREMENT
/begin MEASUREMENT er_mmv_is_diag[2] "Filtered engine roughness value cylinder individual" SWORD _CNV_A_R_LINEAR_____25_CM 1 100. -8. 7.99975586 DISPLAY_IDENTIFIER ER_MMV_IS_DIAG_2 ECU_ADDRESS 0x3fd836 BYTE_ORDER MSB_LAST FORMAT "%7.4" /end MEASUREMENT
/begin MEASUREMENT er_mmv_is_diag[3] "Filtered engine roughness value cylinder individual" SWORD _CNV_A_R_LINEAR_____25_CM 1 100. -8. 7.99975586 DISPLAY_IDENTIFIER ER_MMV_IS_DIAG_3 ECU_ADDRESS 0x3fd838 BYTE_ORDER MSB_LAST FORMAT "%7.4" /end MEASUREMENT
/begin MEASUREMENT er_mmv_is_diag[4] "Filtered engine roughness value cylinder individual" SWORD _CNV_A_R_LINEAR_____25_CM 1 100. -8. 7.99975586 DISPLAY_IDENTIFIER ER_MMV_IS_DIAG_4 ECU_ADDRESS 0x3fd83a BYTE_ORDER MSB_LAST FORMAT "%7.4" /end MEASUREMENT
/begin MEASUREMENT er_mmv_is_diag[5] "Filtered engine roughness value cylinder individual" SWORD _CNV_A_R_LINEAR_____25_CM 1 100. -8. 7.99975586 DISPLAY_IDENTIFIER ER_MMV_IS_DIAG_5 ECU_ADDRESS 0x3fd83c BYTE_ORDER MSB_LAST FORMAT "%7.4" /end MEASUREMENT
/begin CHARACTERISTIC ip_thd_is_er_diag__n__maf "ER reference value for ER diagnosis" MAP 0xffe4f38e _REC_MAP_20_u2_u2_u1 -32766. _CNV_A_R_LINEAR_____26_CM -1. -32767. DISPLAY_IDENTIFIER IP_THD_IS_ER_DIAG__N__MAF FORMAT "%7.0"
 /begin AXIS_DESCR COM_AXIS n _CNV_A_R_LINEAR_____10_CM 4 0. 8160. FORMAT "%4.0" AXIS_PTS_REF ldp_n__thd_is_er_diag /end AXIS_DESCR
 /begin AXIS_DESCR COM_AXIS maf _CNV_A_R_LINEAR_____27_CM 4 0. 1389. FORMAT "%4.0" AXIS_PTS_REF ldp_maf__thd_is_er_diag /end AXIS_DESCR
/end CHARACTERISTIC
/begin CHARACTERISTIC ip_fac_thd_is_er_diag__tco "TCO-dependent reference value correction" CURVE 0xffe40c0f _REC_CUR_20_u1_u1 0.9922 _CNV_A_R_LINEAR_____28_CM 1. 1.9922 DISPLAY_IDENTIFIER IP_FAC_THD_IS_ER_DIAG__TCO FORMAT "%5.3"
 /begin AXIS_DESCR COM_AXIS tco _CNV_A_R_LINEAR_____11_CM 8 -48. 142.5 FORMAT "%5.1" AXIS_PTS_REF ldp_tco__fac_thd_is_er_diag /end AXIS_DESCR
/end CHARACTERISTIC
/begin CHARACTERISTIC c_crlc_is_er_diag "Correlation constant for calculating the ER diagnostic values" VALUE 0xffe40683 _REC_VAL_20_u1 0.99610001 _CNV_A_R_LINEAR_____29_CM 0. 0.99610001 DISPLAY_IDENTIFIER C_CRLC_IS_ER_DIAG FORMAT "%5.3" /end CHARACTERISTIC
/begin AXIS_PTS ldp_maf__thd_is_er_diag "" 0xffe41059 maf _REC_AXS_20_u1 1389. _CNV_A_R_LINEAR_____27_CM 4 0. 1389. DISPLAY_IDENTIFIER LDP_MAF__THD_IS_ER_DIAG FORMAT "%4.0" /end AXIS_PTS
/begin AXIS_PTS ldp_n__thd_is_er_diag "" 0xffe51024 n _REC_AXS_20_u2 816. _CNV_A_R_LINEAR_____10_CM 4 0. 8160. DISPLAY_IDENTIFIER LDP_N__THD_IS_ER_DIAG FORMAT "%4.0" /end AXIS_PTS
/begin AXIS_PTS ldp_tco__fac_thd_is_er_diag "" 0xffe481c2 tco _REC_AXS_20_u1 190.5 _CNV_A_R_LINEAR_____11_CM 8 -48. 142.5 DISPLAY_IDENTIFIER LDP_TCO__FAC_THD_IS_ER_DIAG FORMAT "%5.1" /end AXIS_PTS
/begin CHARACTERISTIC c_tout_imob "" VALUE 0xffe40984 _REC_VAL_20_u1 25.4 _CNV_A_R_LINEAR_____24_CM 0.1 25.5 DISPLAY_IDENTIFIER C_TOUT_IMOB FORMAT "%4.1" /end CHARACTERISTIC
/begin MEASUREMENT lv_err_imob_2 "" UBYTE _CNV_S_2_RANGE______1_R_CM 1 100. 0. 255. DISPLAY_IDENTIFIER LV_ERR_IMOB_2 ECU_ADDRESS 0x3fba28 BIT_MASK 0x1 /end MEASUREMENT
/begin MEASUREMENT lv_err_imob_1 "" UBYTE _CNV_S_2_RANGE______1_R_CM 1 100. 0. 255. DISPLAY_IDENTIFIER LV_ERR_IMOB_1 ECU_ADDRESS 0x3fba24 BIT_MASK 0x1 /end MEASUREMENT
/begin MEASUREMENT lv_err_imob_3 "" UBYTE _CNV_S_2_RANGE______1_R_CM 1 100. 0. 255. DISPLAY_IDENTIFIER LV_ERR_IMOB_3 ECU_ADDRESS 0x3fba2c BIT_MASK 0x1 /end MEASUREMENT
/begin MEASUREMENT lv_lock_imob "Locking of ign and inj by imob" UBYTE _CNV_S_2_RANGE______21_CM 1 100. 0. 1. DISPLAY_IDENTIFIER LV_LOCK_IMOB ECU_ADDRESS 0x3fee2f BIT_MASK 0x1 /end MEASUREMENT
/begin MEASUREMENT inh_iv_imob "Locking request for inj by imob" UBYTE _CNV_A_R_LINEAR_____0_CM 1 100. 0. 255. DISPLAY_IDENTIFIER INH_IV_IMOB ECU_ADDRESS 0x3fee22 FORMAT "%3.0" BIT_MASK 0x1 /end MEASUREMENT
/begin MEASUREMENT ctr_err_imob_2 "Error counter of diagnosis imob_2 diagnosis" UBYTE _CNV_A_R_LINEAR_____0_CM 1 100. 0. 255. DISPLAY_IDENTIFIER CTR_ERR_IMOB_2 ECU_ADDRESS 0x3fee1a FORMAT "%3.0" /end MEASUREMENT
/begin MEASUREMENT ctr_err_imob_1 "Error counter of diagnosis imob_1 diagnosis" UBYTE _CNV_A_R_LINEAR_____0_CM 1 100. 0. 255. DISPLAY_IDENTIFIER CTR_ERR_IMOB_1 ECU_ADDRESS 0x3fee19 FORMAT "%3.0" /end MEASUREMENT
/begin CHARACTERISTIC c_vb_min_msw_diag "Min. battery voltage for MSW diagnosis" VALUE 0xffe409be _REC_VAL_20_u1 25.8984 _CNV_A_R_LINEAR_____34_CM 0. 25.8984 DISPLAY_IDENTIFIER C_VB_MIN_MSW_DIAG FORMAT "%3.1" /end CHARACTERISTIC
/begin CHARACTERISTIC c_amp_ref "reference value of the ambient pressure" VALUE 0xffe41500 _REC_VAL_20_u2 5434. _CNV_A_R_LINEAR_____49_CM 0. 5434. DISPLAY_IDENTIFIER C_AMP_REF FORMAT "%7.2" /end CHARACTERISTIC
/begin CHARACTERISTIC c_v_amp_max_diag "maximum diagnostic value for the ambient pressure value" VALUE 0xffe41aee _REC_VAL_20_u2 4.99511719 _CNV_A_R_LINEAR_____3_CM 0. 4.99511719 DISPLAY_IDENTIFIER C_V_AMP_MAX_DIAG FORMAT "%5.3" /end CHARACTERISTIC
/begin CHARACTERISTIC c_v_amp_min_diag "minimum diagnostic value for the ambient pressure value" VALUE 0xffe41af0 _REC_VAL_20_u2 4.99511719 _CNV_A_R_LINEAR_____3_CM 0. 4.99511719 DISPLAY_IDENTIFIER C_V_AMP_MIN_DIAG FORMAT "%5.3" /end CHARACTERISTIC
/begin MEASUREMENT lv_brake_det "LV_IM_BLS or _BTS detected" UBYTE _CNV_S_2_RANGE______2_CM 1 100. 0. 1. DISPLAY_IDENTIFIER LV_BRAKE_DET ECU_ADDRESS 0x3fe61a /end MEASUREMENT
/begin CHARACTERISTIC c_t_bts_plaus_max "Maximum value of the time counter for debounce  " VALUE 0xffe4085d _REC_VAL_20_u1 25.5 _CNV_A_R_LINEAR_____24_CM 0. 25.5 DISPLAY_IDENTIFIER C_T_BTS_PLAUS_MAX FORMAT "%4.1" /end CHARACTERISTIC
/begin MEASUREMENT lv_err_bls_plaus "BLS plausibility error flag" UBYTE _CNV_S_2_RANGE______1_R_CM 1 100. 0. 255. DISPLAY_IDENTIFIER LV_ERR_BLS_PLAUS ECU_ADDRESS 0x3fe619 /end MEASUREMENT
/begin MEASUREMENT lv_err_im_bls_plaus "BLS plausibility error flag" UBYTE _CNV_S_2_RANGE______1_R_CM 1 100. 0. 255. DISPLAY_IDENTIFIER LV_ERR_IM_BLS_PLAUS ECU_ADDRESS 0x3fb9a4 /end MEASUREMENT
/begin MEASUREMENT lv_err_im_bts_plaus "BTS plausibility error flag" UBYTE _CNV_S_2_RANGE______1_R_CM 1 100. 0. 255. DISPLAY_IDENTIFIER LV_ERR_IM_BTS_PLAUS ECU_ADDRESS 0x3fb9a8 /end MEASUREMENT
/begin MEASUREMENT lv_err_cam_0 "logical variable camshaft signal error CAM_0 (error debounced = 1) " UBYTE _CNV_S_2_RANGE______1_R_CM 1 100. 0. 255. DISPLAY_IDENTIFIER LV_ERR_CAM_0 ECU_ADDRESS 0x3fe9a9 /end MEASUREMENT
/begin CHARACTERISTIC id_win_bol_chk_cam_0 "camshaft and edge specific start angle of check window CAM_0" CURVE 0xffe41bce _REC_CUR_20_u2_u1 720. _CNV_A_R_LINEAR_____82_CM 0. 720. DISPLAY_IDENTIFIER ID_WIN_BOL_CHK_CAM_0 FORMAT "%6.2"
 /begin AXIS_DESCR COM_AXIS cam_edge_nr_0 _CNV_A_R_LINEAR_____0_CM 4 0. 3. FORMAT "%2.0" AXIS_PTS_REF ldpm_cam_edge_nr_0__win_chk /end AXIS_DESCR
/end CHARACTERISTIC
/begin CHARACTERISTIC id_win_bol_chk_cam_1 "camshaft and edge specific start angle of check window CAM_1" CURVE 0xffe41bd6 _REC_CUR_20_u2_u1 720. _CNV_A_R_LINEAR_____82_CM 0. 720. DISPLAY_IDENTIFIER ID_WIN_BOL_CHK_CAM_1 FORMAT "%6.2"
 /begin AXIS_DESCR COM_AXIS cam_edge_nr_1 _CNV_A_R_LINEAR_____0_CM 4 0. 3. FORMAT "%2.0" AXIS_PTS_REF ldpm_cam_edge_nr_1__win_chk /end AXIS_DESCR
/end CHARACTERISTIC
/begin CHARACTERISTIC id_win_tol_chk_cam_1 "camshaft and edge specific end angle of check window CAM_1" CURVE 0xffe41bf6 _REC_CUR_20_u2_u1 720. _CNV_A_R_LINEAR_____82_CM 0. 720. DISPLAY_IDENTIFIER ID_WIN_TOL_CHK_CAM_1 FORMAT "%6.2"
 /begin AXIS_DESCR COM_AXIS cam_edge_nr_1 _CNV_A_R_LINEAR_____0_CM 4 0. 3. FORMAT "%2.0" AXIS_PTS_REF ldpm_cam_edge_nr_1__win_chk /end AXIS_DESCR
/end CHARACTERISTIC
/begin CHARACTERISTIC id_win_tol_chk_cam_0 "camshaft and edge specific end angle of check window CAM_0" CURVE 0xffe41bee _REC_CUR_20_u2_u1 720. _CNV_A_R_LINEAR_____82_CM 0. 720. DISPLAY_IDENTIFIER ID_WIN_TOL_CHK_CAM_0 FORMAT "%6.2"
 /begin AXIS_DESCR COM_AXIS cam_edge_nr_0 _CNV_A_R_LINEAR_____0_CM 4 0. 3. FORMAT "%2.0" AXIS_PTS_REF ldpm_cam_edge_nr_0__win_chk /end AXIS_DESCR
/end CHARACTERISTIC
/begin MEASUREMENT cam_edge_ctr_0 "Free counting camshaft edge counter CAM_0" UWORD _CNV_A_R_LINEAR_____0_CM 1 100. 0. 65535. DISPLAY_IDENTIFIER CAM_EDGE_CTR_0 ECU_ADDRESS 0x3fda9c BYTE_ORDER MSB_LAST FORMAT "%5.0" /end MEASUREMENT
/begin MEASUREMENT cam_edge_1 "Camshaft edge specific angle CAM_1" UWORD _CNV_A_R_LINEAR_____82_CM 1 100. 0. 720. DISPLAY_IDENTIFIER CAM_EDGE_1 ECU_ADDRESS 0x3fda96 BYTE_ORDER MSB_LAST FORMAT "%6.2" /end MEASUREMENT
/begin MEASUREMENT state_cam_edge_ctr_0 "State of camshaft signal position at actual recurrence for CAM_0" UBYTE _CNV_S_4_RANGE_STAT_83_CM 1 100. 0. 4. DISPLAY_IDENTIFIER STATE_CAM_EDGE_CTR_0 ECU_ADDRESS 0x3fe9ad /end MEASUREMENT
/begin MEASUREMENT state_cam_edge_ctr_1 "State of camshaft signal position at actual recurrence for CAM_1" UBYTE _CNV_S_4_RANGE_STAT_83_CM 1 100. 0. 4. DISPLAY_IDENTIFIER STATE_CAM_EDGE_CTR_1 ECU_ADDRESS 0x3fe9ae /end MEASUREMENT
/begin MEASUREMENT lv_err_cam "logical variable camshaft signal error (debounced error = 1)" UBYTE _CNV_S_2_RANGE______1_R_CM 1 100. 0. 255. DISPLAY_IDENTIFIER LV_ERR_CAM ECU_ADDRESS 0x3fe9a8 /end MEASUREMENT
/begin MEASUREMENT lv_err_cam_1 "logical variable camshaft signal error CAM_1 (error debounced = 1) " UBYTE _CNV_S_2_RANGE______1_R_CM 1 100. 0. 255. DISPLAY_IDENTIFIER LV_ERR_CAM_1 ECU_ADDRESS 0x3fe9aa /end MEASUREMENT
/begin MEASUREMENT lv_cam_syn_det_0 "logical variable camshaft error CAM_0 debounce counters are 0 (indicates synchronisation)" UBYTE _CNV_S_2_RANGE______2_CM 1 100. 0. 1. DISPLAY_IDENTIFIER LV_CAM_SYN_DET_0 ECU_ADDRESS 0x3fe9ab /end MEASUREMENT
/begin MEASUREMENT lv_cam_syn_det_1 "logical variable camshaft error CAM_1 debounce counters are 0 (indicates synchronisation)" UBYTE _CNV_S_2_RANGE______2_CM 1 100. 0. 1. DISPLAY_IDENTIFIER LV_CAM_SYN_DET_1 ECU_ADDRESS 0x3fe9ac /end MEASUREMENT
/begin MEASUREMENT cam_edge_ctr_1 "Free counting camshaft edge counter CAM_1" UWORD _CNV_A_R_LINEAR_____0_CM 1 100. 0. 65535. DISPLAY_IDENTIFIER CAM_EDGE_CTR_1 ECU_ADDRESS 0x3fda9e BYTE_ORDER MSB_LAST FORMAT "%5.0" /end MEASUREMENT
/begin MEASUREMENT cam_edge_ctr_diag_1 "Camshaft edge counter CAM_1 (started at first electrical cam edge!!)" UWORD _CNV_A_R_LINEAR_____0_CM 1 100. 0. 65535. DISPLAY_IDENTIFIER CAM_EDGE_CTR_DIAG_1 ECU_ADDRESS 0x3fda9a BYTE_ORDER MSB_LAST FORMAT "%5.0" /end MEASUREMENT
/begin MEASUREMENT cam_edge_0 "Camshaft edge specific angle CAM_0" UWORD _CNV_A_R_LINEAR_____82_CM 1 100. 0. 720. DISPLAY_IDENTIFIER CAM_EDGE_0 ECU_ADDRESS 0x3fda94 BYTE_ORDER MSB_LAST FORMAT "%6.2" /end MEASUREMENT
/begin MEASUREMENT state_cam_syn "Camshaft synchronisation state" UBYTE _CNV_S_7_RANGE_STAT_84_CM 1 100. 0. 9. DISPLAY_IDENTIFIER STATE_CAM_SYN ECU_ADDRESS 0x3fe9a7 /end MEASUREMENT
/begin CHARACTERISTIC c_t_cam_diag_max "max value of time counter for detection of crank-but no camsignal" VALUE 0xffe418e4 _REC_VAL_20_u2 655350. _CNV_A_R_LINEAR_____31_CM 0. 655350. DISPLAY_IDENTIFIER C_T_CAM_DIAG_MAX FORMAT "%6.0" /end CHARACTERISTIC
/begin CHARACTERISTIC c_t_max_cam_tooth_per "Maximum tooth period CAM_i" VALUE 0xffe408a5 _REC_VAL_20_u1 2550. _CNV_A_R_LINEAR_____31_CM 0. 2550. DISPLAY_IDENTIFIER C_T_MAX_CAM_TOOTH_PER FORMAT "%4.0" /end CHARACTERISTIC
/begin MEASUREMENT cam_edge_ctr_diag_0 "Camshaft edge counter CAM_0 (started at first electrical cam edge!!)" UWORD _CNV_A_R_LINEAR_____0_CM 1 100. 0. 65535. DISPLAY_IDENTIFIER CAM_EDGE_CTR_DIAG_0 ECU_ADDRESS 0x3fda98 BYTE_ORDER MSB_LAST FORMAT "%5.0" /end MEASUREMENT
/begin MEASUREMENT t_max_cam_tooth_per_0 "Time counter for detection of maximum tooth period CAM 0 time elapsed" UBYTE _CNV_A_R_LINEAR_____31_CM 1 100. 0. 2550. DISPLAY_IDENTIFIER T_MAX_CAM_TOOTH_PER_0 ECU_ADDRESS 0x3fe9af FORMAT "%4.0" /end MEASUREMENT
/begin MEASUREMENT t_max_cam_tooth_per_1 "Time counter for detection of maximum tooth period CAM 1 time elapsed" UBYTE _CNV_A_R_LINEAR_____31_CM 1 100. 0. 2550. DISPLAY_IDENTIFIER T_MAX_CAM_TOOTH_PER_1 ECU_ADDRESS 0x3fe9b0 FORMAT "%4.0" /end MEASUREMENT
/begin AXIS_PTS ldpm_cam_edge_nr_0__win_chk "" 0xffe41331 cam_edge_nr_0 _REC_AXS_20_u1 3. _CNV_A_R_LINEAR_____0_CM 4 0. 3. DISPLAY_IDENTIFIER LDPM_CAM_EDGE_NR_0__WIN_CHK FORMAT "%2.0" /end AXIS_PTS
/begin AXIS_PTS ldpm_cam_edge_nr_1__win_chk "" 0xffe41336 cam_edge_nr_1 _REC_AXS_20_u1 3. _CNV_A_R_LINEAR_____0_CM 4 0. 3. DISPLAY_IDENTIFIER LDPM_CAM_EDGE_NR_1__WIN_CHK FORMAT "%2.0" /end AXIS_PTS
/begin MEASUREMENT lv_err_cam_0_not_plaus "logical variable implausible camshaft sensor signal CAM_0 detected" UBYTE _CNV_S_2_RANGE______1_R_CM 1 100. 0. 255. DISPLAY_IDENTIFIER LV_ERR_CAM_0_NOT_PLAUS ECU_ADDRESS 0x3fb950 /end MEASUREMENT
/begin MEASUREMENT lv_err_cam_1_not_plaus "logical variable implausible camshaft sensor signal CAM_1 detected" UBYTE _CNV_S_2_RANGE______1_R_CM 1 100. 0. 255. DISPLAY_IDENTIFIER LV_ERR_CAM_1_NOT_PLAUS ECU_ADDRESS 0x3fb954 /end MEASUREMENT
/begin MEASUREMENT lv_err_cam_per_0 "logical variable camshaft signal period error CAM_0 (debounced error = 1)" UBYTE _CNV_S_2_RANGE______1_R_CM 1 100. 0. 255. DISPLAY_IDENTIFIER LV_ERR_CAM_PER_0 ECU_ADDRESS 0x3fb940 /end MEASUREMENT
/begin MEASUREMENT lv_err_cam_per_1 "logical variable camshaft signal period error CAM_1 (debounced error = 1)" UBYTE _CNV_S_2_RANGE______1_R_CM 1 100. 0. 255. DISPLAY_IDENTIFIER LV_ERR_CAM_PER_1 ECU_ADDRESS 0x3fb944 /end MEASUREMENT
/begin MEASUREMENT lv_err_cam_psn_0 "logical variable camshaft position error CAM_0 (debounced error = 1)" UBYTE _CNV_S_2_RANGE______1_R_CM 1 100. 0. 255. DISPLAY_IDENTIFIER LV_ERR_CAM_PSN_0 ECU_ADDRESS 0x3fb948 /end MEASUREMENT
/begin MEASUREMENT lv_err_cam_psn_1 "logical variable camshaft position error CAM_1 (debounced error = 1)" UBYTE _CNV_S_2_RANGE______1_R_CM 1 100. 0. 255. DISPLAY_IDENTIFIER LV_ERR_CAM_PSN_1 ECU_ADDRESS 0x3fb94c /end MEASUREMENT
/begin CHARACTERISTIC c_cam_edge_ebr_det_0_max "maximum number of detected engine back rotations on CAM_0 (0 = function inactive)" VALUE 0xffe4063c _REC_VAL_20_u1 255. _CNV_A_R_LINEAR_____0_CM 0. 255. DISPLAY_IDENTIFIER C_CAM_EDGE_EBR_DET_0_MAX FORMAT "%3.0" /end CHARACTERISTIC
/begin CHARACTERISTIC id_win_bol_chk_cam_low_0 "camshaft and edge specific start angle of check window CAM_0_LOW" CURVE 0xffe41bde _REC_CUR_20_u2_u1 720. _CNV_A_R_LINEAR_____82_CM 0. 720. DISPLAY_IDENTIFIER ID_WIN_BOL_CHK_CAM_LOW_0 FORMAT "%6.2"
 /begin AXIS_DESCR COM_AXIS cam_edge_nr_0 _CNV_A_R_LINEAR_____0_CM 4 0. 3. FORMAT "%2.0" AXIS_PTS_REF ldpm_cam_edge_nr_0__win_chk /end AXIS_DESCR
/end CHARACTERISTIC
/begin CHARACTERISTIC id_win_tol_chk_cam_low_0 "camshaft and edge specific end angle of check window CAM_0_LOW" CURVE 0xffe41bfe _REC_CUR_20_u2_u1 720. _CNV_A_R_LINEAR_____82_CM 0. 720. DISPLAY_IDENTIFIER ID_WIN_TOL_CHK_CAM_LOW_0 FORMAT "%6.2"
 /begin AXIS_DESCR COM_AXIS cam_edge_nr_0 _CNV_A_R_LINEAR_____0_CM 4 0. 3. FORMAT "%2.0" AXIS_PTS_REF ldpm_cam_edge_nr_0__win_chk /end AXIS_DESCR
/end CHARACTERISTIC
/begin CHARACTERISTIC id_win_bol_chk_cam_low_1 "camshaft and edge specific start angle of check window CAM_1_LOW" CURVE 0xffe41be6 _REC_CUR_20_u2_u1 720. _CNV_A_R_LINEAR_____82_CM 0. 720. DISPLAY_IDENTIFIER ID_WIN_BOL_CHK_CAM_LOW_1 FORMAT "%6.2"
 /begin AXIS_DESCR COM_AXIS cam_edge_nr_1 _CNV_A_R_LINEAR_____0_CM 4 0. 3. FORMAT "%2.0" AXIS_PTS_REF ldpm_cam_edge_nr_1__win_chk /end AXIS_DESCR
/end CHARACTERISTIC
/begin CHARACTERISTIC id_win_tol_chk_cam_low_1 "camshaft and edge specific end angle of check window CAM_1_LOW" CURVE 0xffe41c06 _REC_CUR_20_u2_u1 720. _CNV_A_R_LINEAR_____82_CM 0. 720. DISPLAY_IDENTIFIER ID_WIN_TOL_CHK_CAM_LOW_1 FORMAT "%6.2"
 /begin AXIS_DESCR COM_AXIS cam_edge_nr_1 _CNV_A_R_LINEAR_____0_CM 4 0. 3. FORMAT "%2.0" AXIS_PTS_REF ldpm_cam_edge_nr_1__win_chk /end AXIS_DESCR
/end CHARACTERISTIC
/begin CHARACTERISTIC c_cam_edge_dif_max "difference between edge counters" VALUE 0xffe4150c _REC_VAL_20_u2 65535. _CNV_A_R_LINEAR_____0_CM 0. 65535. DISPLAY_IDENTIFIER C_CAM_EDGE_DIF_MAX FORMAT "%5.0" /end CHARACTERISTIC
/begin CHARACTERISTIC c_cam_edge_ctr_diag_low "Number of CAM-Edges for using LOW-maps check window CAM_0 / CAM_1" VALUE 0xffe4150a _REC_VAL_20_u2 65535. _CNV_A_R_LINEAR_____0_CM 0. 65535. DISPLAY_IDENTIFIER C_CAM_EDGE_CTR_DIAG_LOW FORMAT "%5.0" /end CHARACTERISTIC
/begin MEASUREMENT t_cam_diag_0 "Time counter for detection of crank-but no camsignal CAM_0" UWORD _CNV_A_R_LINEAR_____31_CM 1 100. 0. 655350. DISPLAY_IDENTIFIER T_CAM_DIAG_0 ECU_ADDRESS 0x3fdaa0 BYTE_ORDER MSB_LAST FORMAT "%6.0" /end MEASUREMENT
/begin MEASUREMENT t_cam_diag_1 "Time counter for detection of crank-but no camsignal CAM_1" UWORD _CNV_A_R_LINEAR_____31_CM 1 100. 0. 655350. DISPLAY_IDENTIFIER T_CAM_DIAG_1 ECU_ADDRESS 0x3fdaa2 BYTE_ORDER MSB_LAST FORMAT "%6.0" /end MEASUREMENT
/begin MEASUREMENT lv_err_can_boff "logical variableCAN bus off in bus off mode" UBYTE _CNV_S_2_RANGE______1_R_CM 1 100. 0. 255. DISPLAY_IDENTIFIER LV_ERR_CAN_BOFF ECU_ADDRESS 0x3fb96c /end MEASUREMENT
/begin MEASUREMENT cyc_ctr_asr_3_diag "counter of not received ASC3 messages" UBYTE _CNV_A_R_LINEAR_____0_CM 1 100. 0. 255. DISPLAY_IDENTIFIER CYC_CTR_ASR_3_DIAG ECU_ADDRESS 0x3fe2f2 FORMAT "%3.0" /end MEASUREMENT
/begin CHARACTERISTIC c_asr_3_cycnr_max "maximum number of missing ASC3 messages for error debounce counter increment" VALUE 0xffe4062f _REC_VAL_20_u1 254. _CNV_A_R_LINEAR_____0_CM 1. 255. DISPLAY_IDENTIFIER C_ASR_3_CYCNR_MAX FORMAT "%3.0" /end CHARACTERISTIC
/begin CHARACTERISTIC c_asr_1_cycnr_max "maximum number of missing ASC1 messages for error debounce counter increment" VALUE 0xffe4062e _REC_VAL_20_u1 254. _CNV_A_R_LINEAR_____0_CM 1. 255. DISPLAY_IDENTIFIER C_ASR_1_CYCNR_MAX FORMAT "%3.0" /end CHARACTERISTIC
/begin MEASUREMENT cyc_ctr_asr_1_diag "counter of not received ASC1 messages" UBYTE _CNV_A_R_LINEAR_____0_CM 1 100. 0. 255. DISPLAY_IDENTIFIER CYC_CTR_ASR_1_DIAG ECU_ADDRESS 0x3fe2f1 FORMAT "%3.0" /end MEASUREMENT
/begin MEASUREMENT lv_err_tout_asr_1 "logical variable timeout error CAN message ASC1" UBYTE _CNV_S_2_RANGE______1_R_CM 1 100. 0. 255. DISPLAY_IDENTIFIER LV_ERR_TOUT_ASR_1 ECU_ADDRESS 0x3fb894 /end MEASUREMENT
/begin MEASUREMENT lv_err_tout_asr_3 "logical variable timeout error CAN message ASC3 " UBYTE _CNV_S_2_RANGE______1_R_CM 1 100. 0. 255. DISPLAY_IDENTIFIER LV_ERR_TOUT_ASR_3 ECU_ADDRESS 0x3fb898 /end MEASUREMENT
/begin MEASUREMENT cyc_ctr_asr_4_diag "counter of not received ASC4 messages" UBYTE _CNV_A_R_LINEAR_____0_CM 1 100. 0. 255. DISPLAY_IDENTIFIER CYC_CTR_ASR_4_DIAG ECU_ADDRESS 0x3fe2f3 FORMAT "%3.0" /end MEASUREMENT
/begin CHARACTERISTIC c_asr_4_cycnr_max "maximum number of missing ASC messages for error debounce counter increment" VALUE 0xffe40630 _REC_VAL_20_u1 254. _CNV_A_R_LINEAR_____0_CM 1. 255. DISPLAY_IDENTIFIER C_ASR_4_CYCNR_MAX FORMAT "%3.0" /end CHARACTERISTIC
/begin MEASUREMENT lv_err_tout_asr_4 "logical variable timeout error CAN message ASC3 " UBYTE _CNV_S_2_RANGE______1_R_CM 1 100. 0. 255. DISPLAY_IDENTIFIER LV_ERR_TOUT_ASR_4 ECU_ADDRESS 0x3fb89c /end MEASUREMENT
/begin CHARACTERISTIC c_etcu_1_cycnr_max "maximum number of missing EGS1 messages for error debounce counter increment" VALUE 0xffe40726 _REC_VAL_20_u1 254. _CNV_A_R_LINEAR_____0_CM 1. 255. DISPLAY_IDENTIFIER C_ETCU_1_CYCNR_MAX FORMAT "%3.0" /end CHARACTERISTIC
/begin CHARACTERISTIC c_etcu_2_cycnr_max "maximum number of missing EGS2 messages for error debounce counter increment" VALUE 0xffe40727 _REC_VAL_20_u1 254. _CNV_A_R_LINEAR_____0_CM 1. 255. DISPLAY_IDENTIFIER C_ETCU_2_CYCNR_MAX FORMAT "%3.0" /end CHARACTERISTIC
/begin MEASUREMENT cyc_ctr_etcu_1_diag "counter of not received EGS1 messages" UBYTE _CNV_A_R_LINEAR_____0_CM 1 100. 0. 255. DISPLAY_IDENTIFIER CYC_CTR_ETCU_1_DIAG ECU_ADDRESS 0x3fe322 FORMAT "%3.0" /end MEASUREMENT
/begin MEASUREMENT cyc_ctr_etcu_2_diag "counter of not received EGS2 messages" UBYTE _CNV_A_R_LINEAR_____0_CM 1 100. 0. 255. DISPLAY_IDENTIFIER CYC_CTR_ETCU_2_DIAG ECU_ADDRESS 0x3fe323 FORMAT "%3.0" /end MEASUREMENT
/begin MEASUREMENT cyc_ctr_icl_2_diag "counter of not received INSTR2 messages" UBYTE _CNV_A_R_LINEAR_____0_CM 1 100. 0. 255. DISPLAY_IDENTIFIER CYC_CTR_ICL_2_DIAG ECU_ADDRESS 0x3fd120 FORMAT "%3.0" /end MEASUREMENT
/begin CHARACTERISTIC c_icl_2_cycnr_max "maximum number of missing INSTR2 messages for error debounce counter increment" VALUE 0xffe4075b _REC_VAL_20_u1 254. _CNV_A_R_LINEAR_____0_CM 1. 255. DISPLAY_IDENTIFIER C_ICL_2_CYCNR_MAX FORMAT "%3.0" /end CHARACTERISTIC
/begin MEASUREMENT cyc_ctr_icl_3_diag "counter of not received INSTR3 messages" UBYTE _CNV_A_R_LINEAR_____0_CM 1 100. 0. 255. DISPLAY_IDENTIFIER CYC_CTR_ICL_3_DIAG ECU_ADDRESS 0x3fd121 FORMAT "%3.0" /end MEASUREMENT
/begin CHARACTERISTIC c_icl_3_cycnr_max "maximum number of missing INSTR3 messages for error debounce counter increment" VALUE 0xffe4075c _REC_VAL_20_u1 254. _CNV_A_R_LINEAR_____0_CM 1. 255. DISPLAY_IDENTIFIER C_ICL_3_CYCNR_MAX FORMAT "%3.0" /end CHARACTERISTIC
/begin MEASUREMENT cyc_ctr_pste_1_diag "counter of not received LWS1 messages" UBYTE _CNV_A_R_LINEAR_____0_CM 1 100. 0. 255. DISPLAY_IDENTIFIER CYC_CTR_PSTE_1_DIAG ECU_ADDRESS 0x3fe344 FORMAT "%3.0" /end MEASUREMENT
/begin CHARACTERISTIC c_pste_1_cycnr_max "maximum number of missing LWS1 messages for error debounce counter increment" VALUE 0xffe4081c _REC_VAL_20_u1 254. _CNV_A_R_LINEAR_____0_CM 1. 255. DISPLAY_IDENTIFIER C_PSTE_1_CYCNR_MAX FORMAT "%3.0" /end CHARACTERISTIC
/begin CHARACTERISTIC c_ctr_diag_tcc_can_max_amt_1 "maximum number of wrong alive counter events for error debounce counter increment" VALUE 0xffe406ae _REC_VAL_20_u1 255. _CNV_A_R_LINEAR_____0_CM 0. 255. DISPLAY_IDENTIFIER C_CTR_DIAG_TCC_CAN_MAX_AMT_1 FORMAT "%3.0" /end CHARACTERISTIC
/begin CHARACTERISTIC c_ctr_diag_cpl_can_max_amt_1 "maximum number of wrong complement messages for error debounce counter increment" VALUE 0xffe406ac _REC_VAL_20_u1 255. _CNV_A_R_LINEAR_____0_CM 0. 255. DISPLAY_IDENTIFIER C_CTR_DIAG_CPL_CAN_MAX_AMT_1 FORMAT "%3.0" /end CHARACTERISTIC
/begin MEASUREMENT cyc_ctr_amt_1_diag "counter of not received SSG1 messages" UBYTE _CNV_A_R_LINEAR_____0_CM 1 100. 0. 255. DISPLAY_IDENTIFIER CYC_CTR_AMT_1_DIAG ECU_ADDRESS 0x3fe363 FORMAT "%3.0" /end MEASUREMENT
/begin CHARACTERISTIC c_amt_1_cycnr_max "maximum number of missing SSG1 messages for error debounce counter increment" VALUE 0xffe4062c _REC_VAL_20_u1 254. _CNV_A_R_LINEAR_____0_CM 1. 255. DISPLAY_IDENTIFIER C_AMT_1_CYCNR_MAX FORMAT "%3.0" /end CHARACTERISTIC
/begin MEASUREMENT cyc_ctr_txu_1_diag "counter of not received TXU1messages" UBYTE _CNV_A_R_LINEAR_____0_CM 1 100. 0. 255. DISPLAY_IDENTIFIER CYC_CTR_TXU_1_DIAG ECU_ADDRESS 0x3fe371 FORMAT "%3.0" /end MEASUREMENT
/begin CHARACTERISTIC c_txu_1_cycnr_max "maximum number of missing TXU1 messages for error debounce counter increment" VALUE 0xffe4098e _REC_VAL_20_u1 254. _CNV_A_R_LINEAR_____0_CM 1. 255. DISPLAY_IDENTIFIER C_TXU_1_CYCNR_MAX FORMAT "%3.0" /end CHARACTERISTIC
/begin MEASUREMENT lv_err_tout_txu_1 "logical variable timeout error CAN message TXU1" UBYTE _CNV_S_2_RANGE______1_R_CM 1 100. 0. 255. DISPLAY_IDENTIFIER LV_ERR_TOUT_TXU_1 ECU_ADDRESS 0x3fb968 /end MEASUREMENT
/begin MEASUREMENT state_crk_diag "Crankshaft diagnosis state" UBYTE _CNV_S_5_RANGE_STAT_135_CM 1 100. 0. 8. DISPLAY_IDENTIFIER STATE_CRK_DIAG ECU_ADDRESS 0x3fe9b8 /end MEASUREMENT
/begin MEASUREMENT state_crk_syn "Crankshaft synchronization state" UBYTE _CNV_S_10_RANGE_CRK__136_CM 1 100. 0. 9. DISPLAY_IDENTIFIER STATE_CRK_SYN ECU_ADDRESS 0x3fe9b9 /end MEASUREMENT
/begin MEASUREMENT state_syn_req "State of synchronizationrequest" UBYTE _CNV_S_5_RANGE_STAT_137_CM 1 100. 0. 4. DISPLAY_IDENTIFIER STATE_SYN_REQ ECU_ADDRESS 0x3fe9ba /end MEASUREMENT
/begin CHARACTERISTIC lc_inh_det_rev_eng "LC to switch of the detection (=1)" VALUE 0xffe40f6f _REC_VAL_20_u1 1. _CNV_A_R_LINEAR_____0_CM 0. 1. DISPLAY_IDENTIFIER LC_INH_DET_REV_ENG FORMAT "%2.0" /end CHARACTERISTIC
/begin CHARACTERISTIC c_cam_edge_sum_max "number of cam edges for detection of not plausible crankshaft sensor signal" VALUE 0xffe4150e _REC_VAL_20_u2 65535. _CNV_A_R_LINEAR_____0_CM 0. 65535. DISPLAY_IDENTIFIER C_CAM_EDGE_SUM_MAX FORMAT "%5.0" /end CHARACTERISTIC
/begin CHARACTERISTIC c_cam_det_rev_eng_max "CAM setpoint threshold for engine forward detection" VALUE 0xffe40637 _REC_VAL_20_u1 95.625 _CNV_A_R_LINEAR_____138_CM 0. 95.625 DISPLAY_IDENTIFIER C_CAM_DET_REV_ENG_MAX FORMAT "%4.1" /end CHARACTERISTIC
/begin CHARACTERISTIC c_cam_det_rev_eng_min "CAM setpoint threshold for engine reverse detection" VALUE 0xffe40638 _REC_VAL_20_u1 95.625 _CNV_A_R_LINEAR_____138_CM 0. 95.625 DISPLAY_IDENTIFIER C_CAM_DET_REV_ENG_MIN FORMAT "%4.1" /end CHARACTERISTIC
/begin MEASUREMENT lv_det_rev_eng "Flag for detection of reverse running engine" UBYTE _CNV_S_2_RANGE______1_R_CM 1 100. 0. 255. DISPLAY_IDENTIFIER LV_DET_REV_ENG ECU_ADDRESS 0x3fe9c3 /end MEASUREMENT
/begin MEASUREMENT lv_err_crk_not_plaus "logical variable not plausible crankshaft sensor signal detected" UBYTE _CNV_S_2_RANGE______1_R_CM 1 100. 0. 255. DISPLAY_IDENTIFIER LV_ERR_CRK_NOT_PLAUS ECU_ADDRESS 0x3fb964 /end MEASUREMENT
/begin MEASUREMENT lv_err_eng_psn "logical variable engine position error (debounced error = 1)" UBYTE _CNV_S_2_RANGE______1_R_CM 1 100. 0. 255. DISPLAY_IDENTIFIER LV_ERR_ENG_PSN ECU_ADDRESS 0x3fb958 /end MEASUREMENT
/begin MEASUREMENT lv_err_tooth_per "logical variable tooth period error (debounced error = 1)" UBYTE _CNV_S_2_RANGE______1_R_CM 1 100. 0. 255. DISPLAY_IDENTIFIER LV_ERR_TOOTH_PER ECU_ADDRESS 0x3fb95c /end MEASUREMENT
/begin MEASUREMENT lv_err_tpu_syn "logical variable TPU synchronization error (debounced error = 1)" UBYTE _CNV_S_2_RANGE______1_R_CM 1 100. 0. 255. DISPLAY_IDENTIFIER LV_ERR_TPU_SYN ECU_ADDRESS 0x3fb960 /end MEASUREMENT
/begin MEASUREMENT lv_err_crk "logical variable global crankshaft signal error (debounced error = 1)" UBYTE _CNV_S_2_RANGE______1_R_CM 1 100. 0. 255. DISPLAY_IDENTIFIER LV_ERR_CRK ECU_ADDRESS 0x3fe9c2 /end MEASUREMENT
/begin MEASUREMENT ctr_crk_eng_psn_err_prev "Counter for detected ENG_PSN error at previous driving cycle" UBYTE _CNV_A_R_LINEAR_____0_CM 1 100. 0. 255. DISPLAY_IDENTIFIER CTR_CRK_ENG_PSN_ERR_PREV ECU_ADDRESS 0x3fe9c7 FORMAT "%3.0" /end MEASUREMENT
/begin MEASUREMENT ctr_crk_tooth_per_err_prev "Counter for detected TOOTH_PER error at previous driving cycle" UBYTE _CNV_A_R_LINEAR_____0_CM 1 100. 0. 255. DISPLAY_IDENTIFIER CTR_CRK_TOOTH_PER_ERR_PREV ECU_ADDRESS 0x3fe9c8 FORMAT "%3.0" /end MEASUREMENT
/begin MEASUREMENT ctr_crk_tooth_per_err "Counter for detected TOOTH_PER error at actual driving cycle" UBYTE _CNV_A_R_LINEAR_____0_CM 1 100. 0. 255. DISPLAY_IDENTIFIER CTR_CRK_TOOTH_PER_ERR ECU_ADDRESS 0x3fe9c0 FORMAT "%3.0" /end MEASUREMENT
/begin MEASUREMENT ctr_crk_eng_psn_err "Counter for detected ENG_PSN error at actual driving cycle" UBYTE _CNV_A_R_LINEAR_____0_CM 1 100. 0. 255. DISPLAY_IDENTIFIER CTR_CRK_ENG_PSN_ERR ECU_ADDRESS 0x3fe9bd FORMAT "%3.0" /end MEASUREMENT
/begin MEASUREMENT crk_eng_psn_err_cnd_n_32 "N_32 at ENG_PSN error occurs" UBYTE _CNV_A_R_LINEAR_____15_CM 1 100. 0. 8160. DISPLAY_IDENTIFIER CRK_ENG_PSN_ERR_CND_N_32 ECU_ADDRESS 0x3fe9bb FORMAT "%4.0" /end MEASUREMENT
/begin MEASUREMENT crk_tooth_per_err_cnd_n_32 "N_32 at TOOTH_PER error occurs" UBYTE _CNV_A_R_LINEAR_____15_CM 1 100. 0. 8160. DISPLAY_IDENTIFIER CRK_TOOTH_PER_ERR_CND_N_32 ECU_ADDRESS 0x3fe9be FORMAT "%4.0" /end MEASUREMENT
/begin MEASUREMENT crk_tooth_per_err_cnd_vb "VB at TOOTH_PER error occurs" UBYTE _CNV_A_R_LINEAR_____60_CM 1 100. 0. 26. DISPLAY_IDENTIFIER CRK_TOOTH_PER_ERR_CND_VB ECU_ADDRESS 0x3fe9bf FORMAT "%4.1" /end MEASUREMENT
/begin MEASUREMENT crk_eng_psn_err_cnd_vb "VB at ENG_PSN error occurs" UBYTE _CNV_A_R_LINEAR_____60_CM 1 100. 0. 26. DISPLAY_IDENTIFIER CRK_ENG_PSN_ERR_CND_VB ECU_ADDRESS 0x3fe9bc FORMAT "%4.1" /end MEASUREMENT
/begin MEASUREMENT n_32_crk_diag "Last valid engine speed before CRK error occured" UBYTE _CNV_A_R_LINEAR_____15_CM 1 100. 0. 8160. DISPLAY_IDENTIFIER N_32_CRK_DIAG ECU_ADDRESS 0x3fe9c1 FORMAT "%4.0" /end MEASUREMENT
/begin CHARACTERISTIC c_tco_st_ect_plaus_diag "Constant to detect a cold engine" VALUE 0xffe40928 _REC_VAL_20_u1 190.5 _CNV_A_R_LINEAR_____11_CM -48. 142.5 DISPLAY_IDENTIFIER C_TCO_ST_ECT_PLAUS_DIAG FORMAT "%5.1" /end CHARACTERISTIC
/begin MEASUREMENT lv_err_ect "ECT error detected" UBYTE _CNV_S_2_RANGE______1_R_CM 1 100. 0. 255. DISPLAY_IDENTIFIER LV_ERR_ECT ECU_ADDRESS 0x3fe922 /end MEASUREMENT
/begin MEASUREMENT t_puc_int_ect_diag "Duration of PUC phases for ECT_MEC diagnosis" UWORD _CNV_A_R_LINEAR_____24_CM 1 100. 0. 6553.5 DISPLAY_IDENTIFIER T_PUC_INT_ECT_DIAG ECU_ADDRESS 0x3fda80 BYTE_ORDER MSB_LAST FORMAT "%5.1" /end MEASUREMENT
/begin CHARACTERISTIC c_t_puc_tco_ex_plaus_diag "Max. duration of PUC phase for diagnosis active" VALUE 0xffe419da _REC_VAL_20_u2 6553.400000000001 _CNV_A_R_LINEAR_____24_CM 0.1 6553.5 DISPLAY_IDENTIFIER C_T_PUC_TCO_EX_PLAUS_DIAG FORMAT "%6.1" /end CHARACTERISTIC
/begin CHARACTERISTIC c_tco_tco_ex_plaus_diag "TCO/TCO_EX Plausiblization difference" VALUE 0xffe40934 _REC_VAL_20_u1 190.5 _CNV_A_R_LINEAR_____12_CM 0. 190.5 DISPLAY_IDENTIFIER C_TCO_TCO_EX_PLAUS_DIAG FORMAT "%5.1" /end CHARACTERISTIC
/begin CHARACTERISTIC c_tco_ex_tco_ex_plaus_diag "Min TCO_EX difference between ST and diagnosis" VALUE 0xffe408fe _REC_VAL_20_u1 190.5 _CNV_A_R_LINEAR_____12_CM 0. 190.5 DISPLAY_IDENTIFIER C_TCO_EX_TCO_EX_PLAUS_DIAG FORMAT "%5.1" /end CHARACTERISTIC
/begin CHARACTERISTIC c_tam_min_tco_ex_plaus_diag "Threshold of ambient temperature for diagnosis" VALUE 0xffe408de _REC_VAL_20_u1 190.5 _CNV_A_R_LINEAR_____11_CM -48. 142.5 DISPLAY_IDENTIFIER C_TAM_MIN_TCO_EX_PLAUS_DIAG FORMAT "%5.1" /end CHARACTERISTIC
/begin CHARACTERISTIC c_tco_tco_ex_plaus_diag_min "Min. TCO for diagnosis result \"no error\"" VALUE 0xffe40935 _REC_VAL_20_u1 190.5 _CNV_A_R_LINEAR_____11_CM -48. 142.5 DISPLAY_IDENTIFIER C_TCO_TCO_EX_PLAUS_DIAG_MIN FORMAT "%5.1" /end CHARACTERISTIC
/begin CHARACTERISTIC c_n_min_ect_plaus_diag "Min. N_32 threshold for STEP2 of diagnosis" VALUE 0xffe407f3 _REC_VAL_20_u1 8160. _CNV_A_R_LINEAR_____15_CM 0. 8160. DISPLAY_IDENTIFIER C_N_MIN_ECT_PLAUS_DIAG FORMAT "%4.0" /end CHARACTERISTIC
/begin MEASUREMENT fmy_stat_toil.ctr_abc "" UBYTE _CNV_A_R_LINEAR_____0_CM 1 100. 0. 255. DISPLAY_IDENTIFIER CTR_ABC_TOIL ECU_ADDRESS 0x3fb7f7 FORMAT "%3.0" /end MEASUREMENT
/begin MEASUREMENT fmy_stat_toil.ctr_end_diag "" UBYTE _CNV_A_R_LINEAR_____0_CM 1 100. 0. 255. DISPLAY_IDENTIFIER CTR_ABC_END_DIAG_TOIL ECU_ADDRESS 0x3fb7f6 FORMAT "%3.0" /end MEASUREMENT
/begin MEASUREMENT fmy_stat_toil.err_info_stat.lv_err_mem "" UBYTE _CNV_S_2_RANGE______21_CM 1 100. 0. 1. DISPLAY_IDENTIFIER LV_ERR_MEM_TOIL ECU_ADDRESS 0x3fb7f5 BIT_MASK 0x80 /end MEASUREMENT
/begin MEASUREMENT fmy_stat_toil.err_info_stat.lv_ready "" UBYTE _CNV_S_2_RANGE______21_CM 1 100. 0. 1. DISPLAY_IDENTIFIER LV_READY_TOIL ECU_ADDRESS 0x3fb7f5 BIT_MASK 0x40 /end MEASUREMENT
/begin MEASUREMENT fmy_stat_toil.err_info_stat.lv_end_diag "" UBYTE _CNV_S_2_RANGE______21_CM 1 100. 0. 1. DISPLAY_IDENTIFIER LV_END_DIAG_TOIL ECU_ADDRESS 0x3fb7f5 BIT_MASK 0x20 /end MEASUREMENT
/begin MEASUREMENT fmy_stat_toil.err_info_stat.lv_cdn_diag "" UBYTE _CNV_S_2_RANGE______21_CM 1 100. 0. 1. DISPLAY_IDENTIFIER LV_CDN_DIAG_TOIL ECU_ADDRESS 0x3fb7f5 BIT_MASK 0x10 /end MEASUREMENT
/begin MEASUREMENT fmy_stat_toil.err_info_stat.err_sym "" UBYTE _CNV_S_6_RANGE_ERR__193_CM 1 100. 0. 15. DISPLAY_IDENTIFIER ERR_SYM_TOIL ECU_ADDRESS 0x3fb7f5 BIT_MASK 0xF /end MEASUREMENT
/begin MEASUREMENT fmy_stat_tco_ex.ctr_abc "" UBYTE _CNV_A_R_LINEAR_____0_CM 1 100. 0. 255. DISPLAY_IDENTIFIER CTR_ABC_TCO_EX ECU_ADDRESS 0x3fb7fb FORMAT "%3.0" /end MEASUREMENT
/begin MEASUREMENT fmy_stat_tco_ex.ctr_end_diag "" UBYTE _CNV_A_R_LINEAR_____0_CM 1 100. 0. 255. DISPLAY_IDENTIFIER CTR_ABC_END_DIAG_TCO_EX ECU_ADDRESS 0x3fb7fa FORMAT "%3.0" /end MEASUREMENT
/begin MEASUREMENT fmy_stat_tco_ex.err_info_stat.lv_err_mem "" UBYTE _CNV_S_2_RANGE______21_CM 1 100. 0. 1. DISPLAY_IDENTIFIER LV_ERR_MEM_TCO_EX ECU_ADDRESS 0x3fb7f9 BIT_MASK 0x80 /end MEASUREMENT
/begin MEASUREMENT fmy_stat_tco_ex.err_info_stat.lv_ready "" UBYTE _CNV_S_2_RANGE______21_CM 1 100. 0. 1. DISPLAY_IDENTIFIER LV_READY_TCO_EX ECU_ADDRESS 0x3fb7f9 BIT_MASK 0x40 /end MEASUREMENT
/begin MEASUREMENT fmy_stat_tco_ex.err_info_stat.lv_end_diag "" UBYTE _CNV_S_2_RANGE______21_CM 1 100. 0. 1. DISPLAY_IDENTIFIER LV_END_DIAG_TCO_EX ECU_ADDRESS 0x3fb7f9 BIT_MASK 0x20 /end MEASUREMENT
/begin MEASUREMENT fmy_stat_tco_ex.err_info_stat.lv_cdn_diag "" UBYTE _CNV_S_2_RANGE______21_CM 1 100. 0. 1. DISPLAY_IDENTIFIER LV_CDN_DIAG_TCO_EX ECU_ADDRESS 0x3fb7f9 BIT_MASK 0x10 /end MEASUREMENT
/begin MEASUREMENT fmy_stat_tco_ex.err_info_stat.err_sym "" UBYTE _CNV_S_6_RANGE_ERR__193_CM 1 100. 0. 15. DISPLAY_IDENTIFIER ERR_SYM_TCO_EX ECU_ADDRESS 0x3fb7f9 BIT_MASK 0xF /end MEASUREMENT
/begin MEASUREMENT fmy_stat_tia.ctr_abc "" UBYTE _CNV_A_R_LINEAR_____0_CM 1 100. 0. 255. DISPLAY_IDENTIFIER CTR_ABC_TIA ECU_ADDRESS 0x3fb7ff FORMAT "%3.0" /end MEASUREMENT
/begin MEASUREMENT fmy_stat_tia.ctr_end_diag "" UBYTE _CNV_A_R_LINEAR_____0_CM 1 100. 0. 255. DISPLAY_IDENTIFIER CTR_ABC_END_DIAG_TIA ECU_ADDRESS 0x3fb7fe FORMAT "%3.0" /end MEASUREMENT
/begin MEASUREMENT fmy_stat_tia.err_info_stat.lv_err_mem "" UBYTE _CNV_S_2_RANGE______21_CM 1 100. 0. 1. DISPLAY_IDENTIFIER LV_ERR_MEM_TIA ECU_ADDRESS 0x3fb7fd BIT_MASK 0x80 /end MEASUREMENT
/begin MEASUREMENT fmy_stat_tia.err_info_stat.lv_ready "" UBYTE _CNV_S_2_RANGE______21_CM 1 100. 0. 1. DISPLAY_IDENTIFIER LV_READY_TIA ECU_ADDRESS 0x3fb7fd BIT_MASK 0x40 /end MEASUREMENT
/begin MEASUREMENT fmy_stat_tia.err_info_stat.lv_end_diag "" UBYTE _CNV_S_2_RANGE______21_CM 1 100. 0. 1. DISPLAY_IDENTIFIER LV_END_DIAG_TIA ECU_ADDRESS 0x3fb7fd BIT_MASK 0x20 /end MEASUREMENT
/begin MEASUREMENT fmy_stat_tia.err_info_stat.lv_cdn_diag "" UBYTE _CNV_S_2_RANGE______21_CM 1 100. 0. 1. DISPLAY_IDENTIFIER LV_CDN_DIAG_TIA ECU_ADDRESS 0x3fb7fd BIT_MASK 0x10 /end MEASUREMENT
/begin MEASUREMENT fmy_stat_tia.err_info_stat.err_sym "" UBYTE _CNV_S_6_RANGE_ERR__193_CM 1 100. 0. 15. DISPLAY_IDENTIFIER ERR_SYM_TIA ECU_ADDRESS 0x3fb7fd BIT_MASK 0xF /end MEASUREMENT
/begin MEASUREMENT fmy_stat_amp.ctr_abc "" UBYTE _CNV_A_R_LINEAR_____0_CM 1 100. 0. 255. DISPLAY_IDENTIFIER CTR_ABC_AMP ECU_ADDRESS 0x3fb803 FORMAT "%3.0" /end MEASUREMENT
/begin MEASUREMENT fmy_stat_amp.ctr_end_diag "" UBYTE _CNV_A_R_LINEAR_____0_CM 1 100. 0. 255. DISPLAY_IDENTIFIER CTR_ABC_END_DIAG_AMP ECU_ADDRESS 0x3fb802 FORMAT "%3.0" /end MEASUREMENT
/begin MEASUREMENT fmy_stat_amp.err_info_stat.lv_err_mem "" UBYTE _CNV_S_2_RANGE______21_CM 1 100. 0. 1. DISPLAY_IDENTIFIER LV_ERR_MEM_AMP ECU_ADDRESS 0x3fb801 BIT_MASK 0x80 /end MEASUREMENT
/begin MEASUREMENT fmy_stat_amp.err_info_stat.lv_ready "" UBYTE _CNV_S_2_RANGE______21_CM 1 100. 0. 1. DISPLAY_IDENTIFIER LV_READY_AMP ECU_ADDRESS 0x3fb801 BIT_MASK 0x40 /end MEASUREMENT
/begin MEASUREMENT fmy_stat_amp.err_info_stat.lv_end_diag "" UBYTE _CNV_S_2_RANGE______21_CM 1 100. 0. 1. DISPLAY_IDENTIFIER LV_END_DIAG_AMP ECU_ADDRESS 0x3fb801 BIT_MASK 0x20 /end MEASUREMENT
/begin MEASUREMENT fmy_stat_amp.err_info_stat.lv_cdn_diag "" UBYTE _CNV_S_2_RANGE______21_CM 1 100. 0. 1. DISPLAY_IDENTIFIER LV_CDN_DIAG_AMP ECU_ADDRESS 0x3fb801 BIT_MASK 0x10 /end MEASUREMENT
/begin MEASUREMENT fmy_stat_amp.err_info_stat.err_sym "" UBYTE _CNV_S_6_RANGE_ERR__193_CM 1 100. 0. 15. DISPLAY_IDENTIFIER ERR_SYM_AMP ECU_ADDRESS 0x3fb801 BIT_MASK 0xF /end MEASUREMENT
/begin MEASUREMENT fmy_stat_maf.ctr_abc "" UBYTE _CNV_A_R_LINEAR_____0_CM 1 100. 0. 255. DISPLAY_IDENTIFIER CTR_ABC_MAF ECU_ADDRESS 0x3fb807 FORMAT "%3.0" /end MEASUREMENT
/begin MEASUREMENT fmy_stat_maf.ctr_end_diag "" UBYTE _CNV_A_R_LINEAR_____0_CM 1 100. 0. 255. DISPLAY_IDENTIFIER CTR_ABC_END_DIAG_MAF ECU_ADDRESS 0x3fb806 FORMAT "%3.0" /end MEASUREMENT
/begin MEASUREMENT fmy_stat_maf.err_info_stat.lv_err_mem "" UBYTE _CNV_S_2_RANGE______21_CM 1 100. 0. 1. DISPLAY_IDENTIFIER LV_ERR_MEM_MAF ECU_ADDRESS 0x3fb805 BIT_MASK 0x80 /end MEASUREMENT
/begin MEASUREMENT fmy_stat_maf.err_info_stat.lv_ready "" UBYTE _CNV_S_2_RANGE______21_CM 1 100. 0. 1. DISPLAY_IDENTIFIER LV_READY_MAF ECU_ADDRESS 0x3fb805 BIT_MASK 0x40 /end MEASUREMENT
/begin MEASUREMENT fmy_stat_maf.err_info_stat.lv_end_diag "" UBYTE _CNV_S_2_RANGE______21_CM 1 100. 0. 1. DISPLAY_IDENTIFIER LV_END_DIAG_MAF ECU_ADDRESS 0x3fb805 BIT_MASK 0x20 /end MEASUREMENT
/begin MEASUREMENT fmy_stat_maf.err_info_stat.lv_cdn_diag "" UBYTE _CNV_S_2_RANGE______21_CM 1 100. 0. 1. DISPLAY_IDENTIFIER LV_CDN_DIAG_MAF ECU_ADDRESS 0x3fb805 BIT_MASK 0x10 /end MEASUREMENT
/begin MEASUREMENT fmy_stat_maf.err_info_stat.err_sym "" UBYTE _CNV_S_6_RANGE_ERR__193_CM 1 100. 0. 15. DISPLAY_IDENTIFIER ERR_SYM_MAF ECU_ADDRESS 0x3fb805 BIT_MASK 0xF /end MEASUREMENT
/begin MEASUREMENT fmy_stat_vls_down_max_1.ctr_abc "" UBYTE _CNV_A_R_LINEAR_____0_CM 1 100. 0. 255. DISPLAY_IDENTIFIER CTR_ABC_VLS_DOWN_MAX_1 ECU_ADDRESS 0x3fb80b FORMAT "%3.0" /end MEASUREMENT
/begin MEASUREMENT fmy_stat_vls_down_max_1.ctr_end_diag "" UBYTE _CNV_A_R_LINEAR_____0_CM 1 100. 0. 255. DISPLAY_IDENTIFIER CTR_ABC_END_DIAG_VLS_DOWN_MAX_1 ECU_ADDRESS 0x3fb80a FORMAT "%3.0" /end MEASUREMENT
/begin MEASUREMENT fmy_stat_vls_down_max_1.err_info_stat.lv_err_mem "" UBYTE _CNV_S_2_RANGE______21_CM 1 100. 0. 1. DISPLAY_IDENTIFIER LV_ERR_MEM_VLS_DOWN_MAX_1 ECU_ADDRESS 0x3fb809 BIT_MASK 0x80 /end MEASUREMENT
/begin MEASUREMENT fmy_stat_vls_down_max_1.err_info_stat.lv_ready "" UBYTE _CNV_S_2_RANGE______21_CM 1 100. 0. 1. DISPLAY_IDENTIFIER LV_READY_VLS_DOWN_MAX_1 ECU_ADDRESS 0x3fb809 BIT_MASK 0x40 /end MEASUREMENT
/begin MEASUREMENT fmy_stat_vls_down_max_1.err_info_stat.lv_end_diag "" UBYTE _CNV_S_2_RANGE______21_CM 1 100. 0. 1. DISPLAY_IDENTIFIER LV_END_DIAG_VLS_DOWN_MAX_1 ECU_ADDRESS 0x3fb809 BIT_MASK 0x20 /end MEASUREMENT
/begin MEASUREMENT fmy_stat_vls_down_max_1.err_info_stat.lv_cdn_diag "" UBYTE _CNV_S_2_RANGE______21_CM 1 100. 0. 1. DISPLAY_IDENTIFIER LV_CDN_DIAG_VLS_DOWN_MAX_1 ECU_ADDRESS 0x3fb809 BIT_MASK 0x10 /end MEASUREMENT
/begin MEASUREMENT fmy_stat_vls_down_max_1.err_info_stat.err_sym "" UBYTE _CNV_S_6_RANGE_ERR__193_CM 1 100. 0. 15. DISPLAY_IDENTIFIER ERR_SYM_VLS_DOWN_MAX_1 ECU_ADDRESS 0x3fb809 BIT_MASK 0xF /end MEASUREMENT
/begin MEASUREMENT fmy_stat_vls_down_max_2.ctr_abc "" UBYTE _CNV_A_R_LINEAR_____0_CM 1 100. 0. 255. DISPLAY_IDENTIFIER CTR_ABC_VLS_DOWN_MAX_2 ECU_ADDRESS 0x3fb80f FORMAT "%3.0" /end MEASUREMENT
/begin MEASUREMENT fmy_stat_vls_down_max_2.ctr_end_diag "" UBYTE _CNV_A_R_LINEAR_____0_CM 1 100. 0. 255. DISPLAY_IDENTIFIER CTR_ABC_END_DIAG_VLS_DOWN_MAX_2 ECU_ADDRESS 0x3fb80e FORMAT "%3.0" /end MEASUREMENT
/begin MEASUREMENT fmy_stat_vls_down_max_2.err_info_stat.lv_err_mem "" UBYTE _CNV_S_2_RANGE______21_CM 1 100. 0. 1. DISPLAY_IDENTIFIER LV_ERR_MEM_VLS_DOWN_MAX_2 ECU_ADDRESS 0x3fb80d BIT_MASK 0x80 /end MEASUREMENT
/begin MEASUREMENT fmy_stat_vls_down_max_2.err_info_stat.lv_ready "" UBYTE _CNV_S_2_RANGE______21_CM 1 100. 0. 1. DISPLAY_IDENTIFIER LV_READY_VLS_DOWN_MAX_2 ECU_ADDRESS 0x3fb80d BIT_MASK 0x40 /end MEASUREMENT
/begin MEASUREMENT fmy_stat_vls_down_max_2.err_info_stat.lv_end_diag "" UBYTE _CNV_S_2_RANGE______21_CM 1 100. 0. 1. DISPLAY_IDENTIFIER LV_END_DIAG_VLS_DOWN_MAX_2 ECU_ADDRESS 0x3fb80d BIT_MASK 0x20 /end MEASUREMENT
/begin MEASUREMENT fmy_stat_vls_down_max_2.err_info_stat.lv_cdn_diag "" UBYTE _CNV_S_2_RANGE______21_CM 1 100. 0. 1. DISPLAY_IDENTIFIER LV_CDN_DIAG_VLS_DOWN_MAX_2 ECU_ADDRESS 0x3fb80d BIT_MASK 0x10 /end MEASUREMENT
/begin MEASUREMENT fmy_stat_vls_down_max_2.err_info_stat.err_sym "" UBYTE _CNV_S_6_RANGE_ERR__193_CM 1 100. 0. 15. DISPLAY_IDENTIFIER ERR_SYM_VLS_DOWN_MAX_2 ECU_ADDRESS 0x3fb80d BIT_MASK 0xF /end MEASUREMENT
/begin MEASUREMENT fmy_stat_vls_down_min_cold_1.ctr_abc "" UBYTE _CNV_A_R_LINEAR_____0_CM 1 100. 0. 255. DISPLAY_IDENTIFIER CTR_ABC_VLS_DOWN_MIN_COLD_1 ECU_ADDRESS 0x3fb813 FORMAT "%3.0" /end MEASUREMENT
/begin MEASUREMENT fmy_stat_vls_down_min_cold_1.ctr_end_diag "" UBYTE _CNV_A_R_LINEAR_____0_CM 1 100. 0. 255. DISPLAY_IDENTIFIER CTR_ABC_END_DIAG_VLS_DOWN_MIN_CO ECU_ADDRESS 0x3fb812 FORMAT "%3.0" /end MEASUREMENT
/begin MEASUREMENT fmy_stat_vls_down_min_cold_1.err_info_stat.lv_err_mem "" UBYTE _CNV_S_2_RANGE______21_CM 1 100. 0. 1. DISPLAY_IDENTIFIER LV_ERR_MEM_VLS_DOWN_MIN_COLD_1 ECU_ADDRESS 0x3fb811 BIT_MASK 0x80 /end MEASUREMENT
/begin MEASUREMENT fmy_stat_vls_down_min_cold_1.err_info_stat.lv_ready "" UBYTE _CNV_S_2_RANGE______21_CM 1 100. 0. 1. DISPLAY_IDENTIFIER LV_READY_VLS_DOWN_MIN_COLD_1 ECU_ADDRESS 0x3fb811 BIT_MASK 0x40 /end MEASUREMENT
/begin MEASUREMENT fmy_stat_vls_down_min_cold_1.err_info_stat.lv_end_diag "" UBYTE _CNV_S_2_RANGE______21_CM 1 100. 0. 1. DISPLAY_IDENTIFIER LV_END_DIAG_VLS_DOWN_MIN_COLD_1 ECU_ADDRESS 0x3fb811 BIT_MASK 0x20 /end MEASUREMENT
/begin MEASUREMENT fmy_stat_vls_down_min_cold_1.err_info_stat.lv_cdn_diag "" UBYTE _CNV_S_2_RANGE______21_CM 1 100. 0. 1. DISPLAY_IDENTIFIER LV_CDN_DIAG_VLS_DOWN_MIN_COLD_1 ECU_ADDRESS 0x3fb811 BIT_MASK 0x10 /end MEASUREMENT
/begin MEASUREMENT fmy_stat_vls_down_min_cold_1.err_info_stat.err_sym "" UBYTE _CNV_S_6_RANGE_ERR__193_CM 1 100. 0. 15. DISPLAY_IDENTIFIER ERR_SYM_VLS_DOWN_MIN_COLD_1 ECU_ADDRESS 0x3fb811 BIT_MASK 0xF /end MEASUREMENT
/begin MEASUREMENT fmy_stat_vls_down_min_cold_2.ctr_abc "" UBYTE _CNV_A_R_LINEAR_____0_CM 1 100. 0. 255. DISPLAY_IDENTIFIER CTR_ABC_VLS_DOWN_MIN_COLD_2 ECU_ADDRESS 0x3fb817 FORMAT "%3.0" /end MEASUREMENT
/begin MEASUREMENT fmy_stat_vls_down_min_cold_2.ctr_end_diag "" UBYTE _CNV_A_R_LINEAR_____0_CM 1 100. 0. 255. DISPLAY_IDENTIFIER CTR_ABC_END_DIAG_VLS_DOWN_MIN_CO ECU_ADDRESS 0x3fb816 FORMAT "%3.0" /end MEASUREMENT
/begin MEASUREMENT fmy_stat_vls_down_min_cold_2.err_info_stat.lv_err_mem "" UBYTE _CNV_S_2_RANGE______21_CM 1 100. 0. 1. DISPLAY_IDENTIFIER LV_ERR_MEM_VLS_DOWN_MIN_COLD_2 ECU_ADDRESS 0x3fb815 BIT_MASK 0x80 /end MEASUREMENT
/begin MEASUREMENT fmy_stat_vls_down_min_cold_2.err_info_stat.lv_ready "" UBYTE _CNV_S_2_RANGE______21_CM 1 100. 0. 1. DISPLAY_IDENTIFIER LV_READY_VLS_DOWN_MIN_COLD_2 ECU_ADDRESS 0x3fb815 BIT_MASK 0x40 /end MEASUREMENT
/begin MEASUREMENT fmy_stat_vls_down_min_cold_2.err_info_stat.lv_end_diag "" UBYTE _CNV_S_2_RANGE______21_CM 1 100. 0. 1. DISPLAY_IDENTIFIER LV_END_DIAG_VLS_DOWN_MIN_COLD_2 ECU_ADDRESS 0x3fb815 BIT_MASK 0x20 /end MEASUREMENT
/begin MEASUREMENT fmy_stat_vls_down_min_cold_2.err_info_stat.lv_cdn_diag "" UBYTE _CNV_S_2_RANGE______21_CM 1 100. 0. 1. DISPLAY_IDENTIFIER LV_CDN_DIAG_VLS_DOWN_MIN_COLD_2 ECU_ADDRESS 0x3fb815 BIT_MASK 0x10 /end MEASUREMENT
/begin MEASUREMENT fmy_stat_vls_down_min_cold_2.err_info_stat.err_sym "" UBYTE _CNV_S_6_RANGE_ERR__193_CM 1 100. 0. 15. DISPLAY_IDENTIFIER ERR_SYM_VLS_DOWN_MIN_COLD_2 ECU_ADDRESS 0x3fb815 BIT_MASK 0xF /end MEASUREMENT
/begin MEASUREMENT fmy_stat_vls_down_min_1.ctr_abc "" UBYTE _CNV_A_R_LINEAR_____0_CM 1 100. 0. 255. DISPLAY_IDENTIFIER CTR_ABC_VLS_DOWN_MIN_1 ECU_ADDRESS 0x3fb81b FORMAT "%3.0" /end MEASUREMENT
/begin MEASUREMENT fmy_stat_vls_down_min_1.ctr_end_diag "" UBYTE _CNV_A_R_LINEAR_____0_CM 1 100. 0. 255. DISPLAY_IDENTIFIER CTR_ABC_END_DIAG_VLS_DOWN_MIN_1 ECU_ADDRESS 0x3fb81a FORMAT "%3.0" /end MEASUREMENT
/begin MEASUREMENT fmy_stat_vls_down_min_1.err_info_stat.lv_err_mem "" UBYTE _CNV_S_2_RANGE______21_CM 1 100. 0. 1. DISPLAY_IDENTIFIER LV_ERR_MEM_VLS_DOWN_MIN_1 ECU_ADDRESS 0x3fb819 BIT_MASK 0x80 /end MEASUREMENT
/begin MEASUREMENT fmy_stat_vls_down_min_1.err_info_stat.lv_ready "" UBYTE _CNV_S_2_RANGE______21_CM 1 100. 0. 1. DISPLAY_IDENTIFIER LV_READY_VLS_DOWN_MIN_1 ECU_ADDRESS 0x3fb819 BIT_MASK 0x40 /end MEASUREMENT
/begin MEASUREMENT fmy_stat_vls_down_min_1.err_info_stat.lv_end_diag "" UBYTE _CNV_S_2_RANGE______21_CM 1 100. 0. 1. DISPLAY_IDENTIFIER LV_END_DIAG_VLS_DOWN_MIN_1 ECU_ADDRESS 0x3fb819 BIT_MASK 0x20 /end MEASUREMENT
/begin MEASUREMENT fmy_stat_vls_down_min_1.err_info_stat.lv_cdn_diag "" UBYTE _CNV_S_2_RANGE______21_CM 1 100. 0. 1. DISPLAY_IDENTIFIER LV_CDN_DIAG_VLS_DOWN_MIN_1 ECU_ADDRESS 0x3fb819 BIT_MASK 0x10 /end MEASUREMENT
/begin MEASUREMENT fmy_stat_vls_down_min_1.err_info_stat.err_sym "" UBYTE _CNV_S_6_RANGE_ERR__193_CM 1 100. 0. 15. DISPLAY_IDENTIFIER ERR_SYM_VLS_DOWN_MIN_1 ECU_ADDRESS 0x3fb819 BIT_MASK 0xF /end MEASUREMENT
/begin MEASUREMENT fmy_stat_vls_down_min_2.ctr_abc "" UBYTE _CNV_A_R_LINEAR_____0_CM 1 100. 0. 255. DISPLAY_IDENTIFIER CTR_ABC_VLS_DOWN_MIN_2 ECU_ADDRESS 0x3fb81f FORMAT "%3.0" /end MEASUREMENT
/begin MEASUREMENT fmy_stat_vls_down_min_2.ctr_end_diag "" UBYTE _CNV_A_R_LINEAR_____0_CM 1 100. 0. 255. DISPLAY_IDENTIFIER CTR_ABC_END_DIAG_VLS_DOWN_MIN_2 ECU_ADDRESS 0x3fb81e FORMAT "%3.0" /end MEASUREMENT
/begin MEASUREMENT fmy_stat_vls_down_min_2.err_info_stat.lv_err_mem "" UBYTE _CNV_S_2_RANGE______21_CM 1 100. 0. 1. DISPLAY_IDENTIFIER LV_ERR_MEM_VLS_DOWN_MIN_2 ECU_ADDRESS 0x3fb81d BIT_MASK 0x80 /end MEASUREMENT
/begin MEASUREMENT fmy_stat_vls_down_min_2.err_info_stat.lv_ready "" UBYTE _CNV_S_2_RANGE______21_CM 1 100. 0. 1. DISPLAY_IDENTIFIER LV_READY_VLS_DOWN_MIN_2 ECU_ADDRESS 0x3fb81d BIT_MASK 0x40 /end MEASUREMENT
/begin MEASUREMENT fmy_stat_vls_down_min_2.err_info_stat.lv_end_diag "" UBYTE _CNV_S_2_RANGE______21_CM 1 100. 0. 1. DISPLAY_IDENTIFIER LV_END_DIAG_VLS_DOWN_MIN_2 ECU_ADDRESS 0x3fb81d BIT_MASK 0x20 /end MEASUREMENT
/begin MEASUREMENT fmy_stat_vls_down_min_2.err_info_stat.lv_cdn_diag "" UBYTE _CNV_S_2_RANGE______21_CM 1 100. 0. 1. DISPLAY_IDENTIFIER LV_CDN_DIAG_VLS_DOWN_MIN_2 ECU_ADDRESS 0x3fb81d BIT_MASK 0x10 /end MEASUREMENT
/begin MEASUREMENT fmy_stat_vls_down_min_2.err_info_stat.err_sym "" UBYTE _CNV_S_6_RANGE_ERR__193_CM 1 100. 0. 15. DISPLAY_IDENTIFIER ERR_SYM_VLS_DOWN_MIN_2 ECU_ADDRESS 0x3fb81d BIT_MASK 0xF /end MEASUREMENT
/begin MEASUREMENT fmy_stat_vls_down_oc_1.ctr_abc "" UBYTE _CNV_A_R_LINEAR_____0_CM 1 100. 0. 255. DISPLAY_IDENTIFIER CTR_ABC_VLS_DOWN_OC_1 ECU_ADDRESS 0x3fb823 FORMAT "%3.0" /end MEASUREMENT
/begin MEASUREMENT fmy_stat_vls_down_oc_1.ctr_end_diag "" UBYTE _CNV_A_R_LINEAR_____0_CM 1 100. 0. 255. DISPLAY_IDENTIFIER CTR_ABC_END_DIAG_VLS_DOWN_OC_1 ECU_ADDRESS 0x3fb822 FORMAT "%3.0" /end MEASUREMENT
/begin MEASUREMENT fmy_stat_vls_down_oc_1.err_info_stat.lv_err_mem "" UBYTE _CNV_S_2_RANGE______21_CM 1 100. 0. 1. DISPLAY_IDENTIFIER LV_ERR_MEM_VLS_DOWN_OC_1 ECU_ADDRESS 0x3fb821 BIT_MASK 0x80 /end MEASUREMENT
/begin MEASUREMENT fmy_stat_vls_down_oc_1.err_info_stat.lv_ready "" UBYTE _CNV_S_2_RANGE______21_CM 1 100. 0. 1. DISPLAY_IDENTIFIER LV_READY_VLS_DOWN_OC_1 ECU_ADDRESS 0x3fb821 BIT_MASK 0x40 /end MEASUREMENT
/begin MEASUREMENT fmy_stat_vls_down_oc_1.err_info_stat.lv_end_diag "" UBYTE _CNV_S_2_RANGE______21_CM 1 100. 0. 1. DISPLAY_IDENTIFIER LV_END_DIAG_VLS_DOWN_OC_1 ECU_ADDRESS 0x3fb821 BIT_MASK 0x20 /end MEASUREMENT
/begin MEASUREMENT fmy_stat_vls_down_oc_1.err_info_stat.lv_cdn_diag "" UBYTE _CNV_S_2_RANGE______21_CM 1 100. 0. 1. DISPLAY_IDENTIFIER LV_CDN_DIAG_VLS_DOWN_OC_1 ECU_ADDRESS 0x3fb821 BIT_MASK 0x10 /end MEASUREMENT
/begin MEASUREMENT fmy_stat_vls_down_oc_1.err_info_stat.err_sym "" UBYTE _CNV_S_6_RANGE_ERR__193_CM 1 100. 0. 15. DISPLAY_IDENTIFIER ERR_SYM_VLS_DOWN_OC_1 ECU_ADDRESS 0x3fb821 BIT_MASK 0xF /end MEASUREMENT
/begin MEASUREMENT fmy_stat_vls_down_oc_2.ctr_abc "" UBYTE _CNV_A_R_LINEAR_____0_CM 1 100. 0. 255. DISPLAY_IDENTIFIER CTR_ABC_VLS_DOWN_OC_2 ECU_ADDRESS 0x3fb827 FORMAT "%3.0" /end MEASUREMENT
/begin MEASUREMENT fmy_stat_vls_down_oc_2.ctr_end_diag "" UBYTE _CNV_A_R_LINEAR_____0_CM 1 100. 0. 255. DISPLAY_IDENTIFIER CTR_ABC_END_DIAG_VLS_DOWN_OC_2 ECU_ADDRESS 0x3fb826 FORMAT "%3.0" /end MEASUREMENT
/begin MEASUREMENT fmy_stat_vls_down_oc_2.err_info_stat.lv_err_mem "" UBYTE _CNV_S_2_RANGE______21_CM 1 100. 0. 1. DISPLAY_IDENTIFIER LV_ERR_MEM_VLS_DOWN_OC_2 ECU_ADDRESS 0x3fb825 BIT_MASK 0x80 /end MEASUREMENT
/begin MEASUREMENT fmy_stat_vls_down_oc_2.err_info_stat.lv_ready "" UBYTE _CNV_S_2_RANGE______21_CM 1 100. 0. 1. DISPLAY_IDENTIFIER LV_READY_VLS_DOWN_OC_2 ECU_ADDRESS 0x3fb825 BIT_MASK 0x40 /end MEASUREMENT
/begin MEASUREMENT fmy_stat_vls_down_oc_2.err_info_stat.lv_end_diag "" UBYTE _CNV_S_2_RANGE______21_CM 1 100. 0. 1. DISPLAY_IDENTIFIER LV_END_DIAG_VLS_DOWN_OC_2 ECU_ADDRESS 0x3fb825 BIT_MASK 0x20 /end MEASUREMENT
/begin MEASUREMENT fmy_stat_vls_down_oc_2.err_info_stat.lv_cdn_diag "" UBYTE _CNV_S_2_RANGE______21_CM 1 100. 0. 1. DISPLAY_IDENTIFIER LV_CDN_DIAG_VLS_DOWN_OC_2 ECU_ADDRESS 0x3fb825 BIT_MASK 0x10 /end MEASUREMENT
/begin MEASUREMENT fmy_stat_vls_down_oc_2.err_info_stat.err_sym "" UBYTE _CNV_S_6_RANGE_ERR__193_CM 1 100. 0. 15. DISPLAY_IDENTIFIER ERR_SYM_VLS_DOWN_OC_2 ECU_ADDRESS 0x3fb825 BIT_MASK 0xF /end MEASUREMENT
/begin MEASUREMENT fmy_stat_iv_0.ctr_abc "" UBYTE _CNV_A_R_LINEAR_____0_CM 1 100. 0. 255. DISPLAY_IDENTIFIER CTR_ABC_IV_0 ECU_ADDRESS 0x3fb82b FORMAT "%3.0" /end MEASUREMENT
/begin MEASUREMENT fmy_stat_iv_0.ctr_end_diag "" UBYTE _CNV_A_R_LINEAR_____0_CM 1 100. 0. 255. DISPLAY_IDENTIFIER CTR_ABC_END_DIAG_IV_0 ECU_ADDRESS 0x3fb82a FORMAT "%3.0" /end MEASUREMENT
/begin MEASUREMENT fmy_stat_iv_0.err_info_stat.lv_err_mem "" UBYTE _CNV_S_2_RANGE______21_CM 1 100. 0. 1. DISPLAY_IDENTIFIER LV_ERR_MEM_IV_0 ECU_ADDRESS 0x3fb829 BIT_MASK 0x80 /end MEASUREMENT
/begin MEASUREMENT fmy_stat_iv_0.err_info_stat.lv_ready "" UBYTE _CNV_S_2_RANGE______21_CM 1 100. 0. 1. DISPLAY_IDENTIFIER LV_READY_IV_0 ECU_ADDRESS 0x3fb829 BIT_MASK 0x40 /end MEASUREMENT
/begin MEASUREMENT fmy_stat_iv_0.err_info_stat.lv_end_diag "" UBYTE _CNV_S_2_RANGE______21_CM 1 100. 0. 1. DISPLAY_IDENTIFIER LV_END_DIAG_IV_0 ECU_ADDRESS 0x3fb829 BIT_MASK 0x20 /end MEASUREMENT
/begin MEASUREMENT fmy_stat_iv_0.err_info_stat.lv_cdn_diag "" UBYTE _CNV_S_2_RANGE______21_CM 1 100. 0. 1. DISPLAY_IDENTIFIER LV_CDN_DIAG_IV_0 ECU_ADDRESS 0x3fb829 BIT_MASK 0x10 /end MEASUREMENT
/begin MEASUREMENT fmy_stat_iv_0.err_info_stat.err_sym "" UBYTE _CNV_S_6_RANGE_ERR__193_CM 1 100. 0. 15. DISPLAY_IDENTIFIER ERR_SYM_IV_0 ECU_ADDRESS 0x3fb829 BIT_MASK 0xF /end MEASUREMENT
/begin MEASUREMENT fmy_stat_iv_1.ctr_abc "" UBYTE _CNV_A_R_LINEAR_____0_CM 1 100. 0. 255. DISPLAY_IDENTIFIER CTR_ABC_IV_1 ECU_ADDRESS 0x3fb82f FORMAT "%3.0" /end MEASUREMENT
/begin MEASUREMENT fmy_stat_iv_1.ctr_end_diag "" UBYTE _CNV_A_R_LINEAR_____0_CM 1 100. 0. 255. DISPLAY_IDENTIFIER CTR_ABC_END_DIAG_IV_1 ECU_ADDRESS 0x3fb82e FORMAT "%3.0" /end MEASUREMENT
/begin MEASUREMENT fmy_stat_iv_1.err_info_stat.lv_err_mem "" UBYTE _CNV_S_2_RANGE______21_CM 1 100. 0. 1. DISPLAY_IDENTIFIER LV_ERR_MEM_IV_1 ECU_ADDRESS 0x3fb82d BIT_MASK 0x80 /end MEASUREMENT
/begin MEASUREMENT fmy_stat_iv_1.err_info_stat.lv_ready "" UBYTE _CNV_S_2_RANGE______21_CM 1 100. 0. 1. DISPLAY_IDENTIFIER LV_READY_IV_1 ECU_ADDRESS 0x3fb82d BIT_MASK 0x40 /end MEASUREMENT
/begin MEASUREMENT fmy_stat_iv_1.err_info_stat.lv_end_diag "" UBYTE _CNV_S_2_RANGE______21_CM 1 100. 0. 1. DISPLAY_IDENTIFIER LV_END_DIAG_IV_1 ECU_ADDRESS 0x3fb82d BIT_MASK 0x20 /end MEASUREMENT
/begin MEASUREMENT fmy_stat_iv_1.err_info_stat.lv_cdn_diag "" UBYTE _CNV_S_2_RANGE______21_CM 1 100. 0. 1. DISPLAY_IDENTIFIER LV_CDN_DIAG_IV_1 ECU_ADDRESS 0x3fb82d BIT_MASK 0x10 /end MEASUREMENT
/begin MEASUREMENT fmy_stat_iv_1.err_info_stat.err_sym "" UBYTE _CNV_S_6_RANGE_ERR__193_CM 1 100. 0. 15. DISPLAY_IDENTIFIER ERR_SYM_IV_1 ECU_ADDRESS 0x3fb82d BIT_MASK 0xF /end MEASUREMENT
/begin MEASUREMENT fmy_stat_iv_2.ctr_abc "" UBYTE _CNV_A_R_LINEAR_____0_CM 1 100. 0. 255. DISPLAY_IDENTIFIER CTR_ABC_IV_2 ECU_ADDRESS 0x3fb833 FORMAT "%3.0" /end MEASUREMENT
/begin MEASUREMENT fmy_stat_iv_2.ctr_end_diag "" UBYTE _CNV_A_R_LINEAR_____0_CM 1 100. 0. 255. DISPLAY_IDENTIFIER CTR_ABC_END_DIAG_IV_2 ECU_ADDRESS 0x3fb832 FORMAT "%3.0" /end MEASUREMENT
/begin MEASUREMENT fmy_stat_iv_2.err_info_stat.lv_err_mem "" UBYTE _CNV_S_2_RANGE______21_CM 1 100. 0. 1. DISPLAY_IDENTIFIER LV_ERR_MEM_IV_2 ECU_ADDRESS 0x3fb831 BIT_MASK 0x80 /end MEASUREMENT
/begin MEASUREMENT fmy_stat_iv_2.err_info_stat.lv_ready "" UBYTE _CNV_S_2_RANGE______21_CM 1 100. 0. 1. DISPLAY_IDENTIFIER LV_READY_IV_2 ECU_ADDRESS 0x3fb831 BIT_MASK 0x40 /end MEASUREMENT
/begin MEASUREMENT fmy_stat_iv_2.err_info_stat.lv_end_diag "" UBYTE _CNV_S_2_RANGE______21_CM 1 100. 0. 1. DISPLAY_IDENTIFIER LV_END_DIAG_IV_2 ECU_ADDRESS 0x3fb831 BIT_MASK 0x20 /end MEASUREMENT
/begin MEASUREMENT fmy_stat_iv_2.err_info_stat.lv_cdn_diag "" UBYTE _CNV_S_2_RANGE______21_CM 1 100. 0. 1. DISPLAY_IDENTIFIER LV_CDN_DIAG_IV_2 ECU_ADDRESS 0x3fb831 BIT_MASK 0x10 /end MEASUREMENT
/begin MEASUREMENT fmy_stat_iv_2.err_info_stat.err_sym "" UBYTE _CNV_S_6_RANGE_ERR__193_CM 1 100. 0. 15. DISPLAY_IDENTIFIER ERR_SYM_IV_2 ECU_ADDRESS 0x3fb831 BIT_MASK 0xF /end MEASUREMENT
/begin MEASUREMENT fmy_stat_iv_3.ctr_abc "" UBYTE _CNV_A_R_LINEAR_____0_CM 1 100. 0. 255. DISPLAY_IDENTIFIER CTR_ABC_IV_3 ECU_ADDRESS 0x3fb837 FORMAT "%3.0" /end MEASUREMENT
/begin MEASUREMENT fmy_stat_iv_3.ctr_end_diag "" UBYTE _CNV_A_R_LINEAR_____0_CM 1 100. 0. 255. DISPLAY_IDENTIFIER CTR_ABC_END_DIAG_IV_3 ECU_ADDRESS 0x3fb836 FORMAT "%3.0" /end MEASUREMENT
/begin MEASUREMENT fmy_stat_iv_3.err_info_stat.lv_err_mem "" UBYTE _CNV_S_2_RANGE______21_CM 1 100. 0. 1. DISPLAY_IDENTIFIER LV_ERR_MEM_IV_3 ECU_ADDRESS 0x3fb835 BIT_MASK 0x80 /end MEASUREMENT
/begin MEASUREMENT fmy_stat_iv_3.err_info_stat.lv_ready "" UBYTE _CNV_S_2_RANGE______21_CM 1 100. 0. 1. DISPLAY_IDENTIFIER LV_READY_IV_3 ECU_ADDRESS 0x3fb835 BIT_MASK 0x40 /end MEASUREMENT
/begin MEASUREMENT fmy_stat_iv_3.err_info_stat.lv_end_diag "" UBYTE _CNV_S_2_RANGE______21_CM 1 100. 0. 1. DISPLAY_IDENTIFIER LV_END_DIAG_IV_3 ECU_ADDRESS 0x3fb835 BIT_MASK 0x20 /end MEASUREMENT
/begin MEASUREMENT fmy_stat_iv_3.err_info_stat.lv_cdn_diag "" UBYTE _CNV_S_2_RANGE______21_CM 1 100. 0. 1. DISPLAY_IDENTIFIER LV_CDN_DIAG_IV_3 ECU_ADDRESS 0x3fb835 BIT_MASK 0x10 /end MEASUREMENT
/begin MEASUREMENT fmy_stat_iv_3.err_info_stat.err_sym "" UBYTE _CNV_S_6_RANGE_ERR__193_CM 1 100. 0. 15. DISPLAY_IDENTIFIER ERR_SYM_IV_3 ECU_ADDRESS 0x3fb835 BIT_MASK 0xF /end MEASUREMENT
/begin MEASUREMENT fmy_stat_iv_4.ctr_abc "" UBYTE _CNV_A_R_LINEAR_____0_CM 1 100. 0. 255. DISPLAY_IDENTIFIER CTR_ABC_IV_4 ECU_ADDRESS 0x3fb83b FORMAT "%3.0" /end MEASUREMENT
/begin MEASUREMENT fmy_stat_iv_4.ctr_end_diag "" UBYTE _CNV_A_R_LINEAR_____0_CM 1 100. 0. 255. DISPLAY_IDENTIFIER CTR_ABC_END_DIAG_IV_4 ECU_ADDRESS 0x3fb83a FORMAT "%3.0" /end MEASUREMENT
/begin MEASUREMENT fmy_stat_iv_4.err_info_stat.lv_err_mem "" UBYTE _CNV_S_2_RANGE______21_CM 1 100. 0. 1. DISPLAY_IDENTIFIER LV_ERR_MEM_IV_4 ECU_ADDRESS 0x3fb839 BIT_MASK 0x80 /end MEASUREMENT
/begin MEASUREMENT fmy_stat_iv_4.err_info_stat.lv_ready "" UBYTE _CNV_S_2_RANGE______21_CM 1 100. 0. 1. DISPLAY_IDENTIFIER LV_READY_IV_4 ECU_ADDRESS 0x3fb839 BIT_MASK 0x40 /end MEASUREMENT
/begin MEASUREMENT fmy_stat_iv_4.err_info_stat.lv_end_diag "" UBYTE _CNV_S_2_RANGE______21_CM 1 100. 0. 1. DISPLAY_IDENTIFIER LV_END_DIAG_IV_4 ECU_ADDRESS 0x3fb839 BIT_MASK 0x20 /end MEASUREMENT
/begin MEASUREMENT fmy_stat_iv_4.err_info_stat.lv_cdn_diag "" UBYTE _CNV_S_2_RANGE______21_CM 1 100. 0. 1. DISPLAY_IDENTIFIER LV_CDN_DIAG_IV_4 ECU_ADDRESS 0x3fb839 BIT_MASK 0x10 /end MEASUREMENT
/begin MEASUREMENT fmy_stat_iv_4.err_info_stat.err_sym "" UBYTE _CNV_S_6_RANGE_ERR__193_CM 1 100. 0. 15. DISPLAY_IDENTIFIER ERR_SYM_IV_4 ECU_ADDRESS 0x3fb839 BIT_MASK 0xF /end MEASUREMENT
/begin MEASUREMENT fmy_stat_iv_5.ctr_abc "" UBYTE _CNV_A_R_LINEAR_____0_CM 1 100. 0. 255. DISPLAY_IDENTIFIER CTR_ABC_IV_5 ECU_ADDRESS 0x3fb83f FORMAT "%3.0" /end MEASUREMENT
/begin MEASUREMENT fmy_stat_iv_5.ctr_end_diag "" UBYTE _CNV_A_R_LINEAR_____0_CM 1 100. 0. 255. DISPLAY_IDENTIFIER CTR_ABC_END_DIAG_IV_5 ECU_ADDRESS 0x3fb83e FORMAT "%3.0" /end MEASUREMENT
/begin MEASUREMENT fmy_stat_iv_5.err_info_stat.lv_err_mem "" UBYTE _CNV_S_2_RANGE______21_CM 1 100. 0. 1. DISPLAY_IDENTIFIER LV_ERR_MEM_IV_5 ECU_ADDRESS 0x3fb83d BIT_MASK 0x80 /end MEASUREMENT
/begin MEASUREMENT fmy_stat_iv_5.err_info_stat.lv_ready "" UBYTE _CNV_S_2_RANGE______21_CM 1 100. 0. 1. DISPLAY_IDENTIFIER LV_READY_IV_5 ECU_ADDRESS 0x3fb83d BIT_MASK 0x40 /end MEASUREMENT
/begin MEASUREMENT fmy_stat_iv_5.err_info_stat.lv_end_diag "" UBYTE _CNV_S_2_RANGE______21_CM 1 100. 0. 1. DISPLAY_IDENTIFIER LV_END_DIAG_IV_5 ECU_ADDRESS 0x3fb83d BIT_MASK 0x20 /end MEASUREMENT
/begin MEASUREMENT fmy_stat_iv_5.err_info_stat.lv_cdn_diag "" UBYTE _CNV_S_2_RANGE______21_CM 1 100. 0. 1. DISPLAY_IDENTIFIER LV_CDN_DIAG_IV_5 ECU_ADDRESS 0x3fb83d BIT_MASK 0x10 /end MEASUREMENT
/begin MEASUREMENT fmy_stat_iv_5.err_info_stat.err_sym "" UBYTE _CNV_S_6_RANGE_ERR__193_CM 1 100. 0. 15. DISPLAY_IDENTIFIER ERR_SYM_IV_5 ECU_ADDRESS 0x3fb83d BIT_MASK 0xF /end MEASUREMENT
/begin MEASUREMENT fmy_stat_lsh_up_1.err_info_stat.lv_err_mem "" UBYTE _CNV_S_2_RANGE______21_CM 1 100. 0. 1. DISPLAY_IDENTIFIER LV_ERR_MEM_LSH_UP_1 ECU_ADDRESS 0x3fb841 BIT_MASK 0x80 /end MEASUREMENT
/begin MEASUREMENT fmy_stat_lsh_up_1.err_info_stat.lv_ready "" UBYTE _CNV_S_2_RANGE______21_CM 1 100. 0. 1. DISPLAY_IDENTIFIER LV_READY_LSH_UP_1 ECU_ADDRESS 0x3fb841 BIT_MASK 0x40 /end MEASUREMENT
/begin MEASUREMENT fmy_stat_lsh_up_1.err_info_stat.lv_end_diag "" UBYTE _CNV_S_2_RANGE______21_CM 1 100. 0. 1. DISPLAY_IDENTIFIER LV_END_DIAG_LSH_UP_1 ECU_ADDRESS 0x3fb841 BIT_MASK 0x20 /end MEASUREMENT
/begin MEASUREMENT fmy_stat_lsh_up_1.err_info_stat.lv_cdn_diag "" UBYTE _CNV_S_2_RANGE______21_CM 1 100. 0. 1. DISPLAY_IDENTIFIER LV_CDN_DIAG_LSH_UP_1 ECU_ADDRESS 0x3fb841 BIT_MASK 0x10 /end MEASUREMENT
/begin MEASUREMENT fmy_stat_lsh_up_1.err_info_stat.err_sym "" UBYTE _CNV_S_6_RANGE_ERR__193_CM 1 100. 0. 15. DISPLAY_IDENTIFIER ERR_SYM_LSH_UP_1 ECU_ADDRESS 0x3fb841 BIT_MASK 0xF /end MEASUREMENT
/begin MEASUREMENT fmy_stat_lsh_up_2.err_info_stat.lv_err_mem "" UBYTE _CNV_S_2_RANGE______21_CM 1 100. 0. 1. DISPLAY_IDENTIFIER LV_ERR_MEM_LSH_UP_2 ECU_ADDRESS 0x3fb845 BIT_MASK 0x80 /end MEASUREMENT
/begin MEASUREMENT fmy_stat_lsh_up_2.err_info_stat.lv_ready "" UBYTE _CNV_S_2_RANGE______21_CM 1 100. 0. 1. DISPLAY_IDENTIFIER LV_READY_LSH_UP_2 ECU_ADDRESS 0x3fb845 BIT_MASK 0x40 /end MEASUREMENT
/begin MEASUREMENT fmy_stat_lsh_up_2.err_info_stat.lv_end_diag "" UBYTE _CNV_S_2_RANGE______21_CM 1 100. 0. 1. DISPLAY_IDENTIFIER LV_END_DIAG_LSH_UP_2 ECU_ADDRESS 0x3fb845 BIT_MASK 0x20 /end MEASUREMENT
/begin MEASUREMENT fmy_stat_lsh_up_2.err_info_stat.lv_cdn_diag "" UBYTE _CNV_S_2_RANGE______21_CM 1 100. 0. 1. DISPLAY_IDENTIFIER LV_CDN_DIAG_LSH_UP_2 ECU_ADDRESS 0x3fb845 BIT_MASK 0x10 /end MEASUREMENT
/begin MEASUREMENT fmy_stat_lsh_up_2.err_info_stat.err_sym "" UBYTE _CNV_S_6_RANGE_ERR__193_CM 1 100. 0. 15. DISPLAY_IDENTIFIER ERR_SYM_LSH_UP_2 ECU_ADDRESS 0x3fb845 BIT_MASK 0xF /end MEASUREMENT
/begin MEASUREMENT fmy_stat_lsh_down_1.err_info_stat.lv_err_mem "" UBYTE _CNV_S_2_RANGE______21_CM 1 100. 0. 1. DISPLAY_IDENTIFIER LV_ERR_MEM_LSH_DOWN_1 ECU_ADDRESS 0x3fb849 BIT_MASK 0x80 /end MEASUREMENT
/begin MEASUREMENT fmy_stat_lsh_down_1.err_info_stat.lv_ready "" UBYTE _CNV_S_2_RANGE______21_CM 1 100. 0. 1. DISPLAY_IDENTIFIER LV_READY_LSH_DOWN_1 ECU_ADDRESS 0x3fb849 BIT_MASK 0x40 /end MEASUREMENT
/begin MEASUREMENT fmy_stat_lsh_down_1.err_info_stat.lv_end_diag "" UBYTE _CNV_S_2_RANGE______21_CM 1 100. 0. 1. DISPLAY_IDENTIFIER LV_END_DIAG_LSH_DOWN_1 ECU_ADDRESS 0x3fb849 BIT_MASK 0x20 /end MEASUREMENT
/begin MEASUREMENT fmy_stat_lsh_down_1.err_info_stat.lv_cdn_diag "" UBYTE _CNV_S_2_RANGE______21_CM 1 100. 0. 1. DISPLAY_IDENTIFIER LV_CDN_DIAG_LSH_DOWN_1 ECU_ADDRESS 0x3fb849 BIT_MASK 0x10 /end MEASUREMENT
/begin MEASUREMENT fmy_stat_lsh_down_1.err_info_stat.err_sym "" UBYTE _CNV_S_6_RANGE_ERR__193_CM 1 100. 0. 15. DISPLAY_IDENTIFIER ERR_SYM_LSH_DOWN_1 ECU_ADDRESS 0x3fb849 BIT_MASK 0xF /end MEASUREMENT
/begin MEASUREMENT fmy_stat_lsh_down_2.err_info_stat.lv_err_mem "" UBYTE _CNV_S_2_RANGE______21_CM 1 100. 0. 1. DISPLAY_IDENTIFIER LV_ERR_MEM_LSH_DOWN_2 ECU_ADDRESS 0x3fb84d BIT_MASK 0x80 /end MEASUREMENT
/begin MEASUREMENT fmy_stat_lsh_down_2.err_info_stat.lv_ready "" UBYTE _CNV_S_2_RANGE______21_CM 1 100. 0. 1. DISPLAY_IDENTIFIER LV_READY_LSH_DOWN_2 ECU_ADDRESS 0x3fb84d BIT_MASK 0x40 /end MEASUREMENT
/begin MEASUREMENT fmy_stat_lsh_down_2.err_info_stat.lv_end_diag "" UBYTE _CNV_S_2_RANGE______21_CM 1 100. 0. 1. DISPLAY_IDENTIFIER LV_END_DIAG_LSH_DOWN_2 ECU_ADDRESS 0x3fb84d BIT_MASK 0x20 /end MEASUREMENT
/begin MEASUREMENT fmy_stat_lsh_down_2.err_info_stat.lv_cdn_diag "" UBYTE _CNV_S_2_RANGE______21_CM 1 100. 0. 1. DISPLAY_IDENTIFIER LV_CDN_DIAG_LSH_DOWN_2 ECU_ADDRESS 0x3fb84d BIT_MASK 0x10 /end MEASUREMENT
/begin MEASUREMENT fmy_stat_lsh_down_2.err_info_stat.err_sym "" UBYTE _CNV_S_6_RANGE_ERR__193_CM 1 100. 0. 15. DISPLAY_IDENTIFIER ERR_SYM_LSH_DOWN_2 ECU_ADDRESS 0x3fb84d BIT_MASK 0xF /end MEASUREMENT
/begin MEASUREMENT fmy_stat_rly_efp.ctr_abc "" UBYTE _CNV_A_R_LINEAR_____0_CM 1 100. 0. 255. DISPLAY_IDENTIFIER CTR_ABC_RLY_EFP ECU_ADDRESS 0x3fb853 FORMAT "%3.0" /end MEASUREMENT
/begin MEASUREMENT fmy_stat_rly_efp.ctr_end_diag "" UBYTE _CNV_A_R_LINEAR_____0_CM 1 100. 0. 255. DISPLAY_IDENTIFIER CTR_ABC_END_DIAG_RLY_EFP ECU_ADDRESS 0x3fb852 FORMAT "%3.0" /end MEASUREMENT
/begin MEASUREMENT fmy_stat_rly_efp.err_info_stat.lv_err_mem "" UBYTE _CNV_S_2_RANGE______21_CM 1 100. 0. 1. DISPLAY_IDENTIFIER LV_ERR_MEM_RLY_EFP ECU_ADDRESS 0x3fb851 BIT_MASK 0x80 /end MEASUREMENT
/begin MEASUREMENT fmy_stat_rly_efp.err_info_stat.lv_ready "" UBYTE _CNV_S_2_RANGE______21_CM 1 100. 0. 1. DISPLAY_IDENTIFIER LV_READY_RLY_EFP ECU_ADDRESS 0x3fb851 BIT_MASK 0x40 /end MEASUREMENT
/begin MEASUREMENT fmy_stat_rly_efp.err_info_stat.lv_end_diag "" UBYTE _CNV_S_2_RANGE______21_CM 1 100. 0. 1. DISPLAY_IDENTIFIER LV_END_DIAG_RLY_EFP ECU_ADDRESS 0x3fb851 BIT_MASK 0x20 /end MEASUREMENT
/begin MEASUREMENT fmy_stat_rly_efp.err_info_stat.lv_cdn_diag "" UBYTE _CNV_S_2_RANGE______21_CM 1 100. 0. 1. DISPLAY_IDENTIFIER LV_CDN_DIAG_RLY_EFP ECU_ADDRESS 0x3fb851 BIT_MASK 0x10 /end MEASUREMENT
/begin MEASUREMENT fmy_stat_rly_efp.err_info_stat.err_sym "" UBYTE _CNV_S_6_RANGE_ERR__193_CM 1 100. 0. 15. DISPLAY_IDENTIFIER ERR_SYM_RLY_EFP ECU_ADDRESS 0x3fb851 BIT_MASK 0xF /end MEASUREMENT
/begin MEASUREMENT fmy_stat_cps.err_info_stat.lv_err_mem "" UBYTE _CNV_S_2_RANGE______21_CM 1 100. 0. 1. DISPLAY_IDENTIFIER LV_ERR_MEM_CPS ECU_ADDRESS 0x3fb855 BIT_MASK 0x80 /end MEASUREMENT
/begin MEASUREMENT fmy_stat_cps.err_info_stat.lv_ready "" UBYTE _CNV_S_2_RANGE______21_CM 1 100. 0. 1. DISPLAY_IDENTIFIER LV_READY_CPS ECU_ADDRESS 0x3fb855 BIT_MASK 0x40 /end MEASUREMENT
/begin MEASUREMENT fmy_stat_cps.err_info_stat.lv_end_diag "" UBYTE _CNV_S_2_RANGE______21_CM 1 100. 0. 1. DISPLAY_IDENTIFIER LV_END_DIAG_CPS ECU_ADDRESS 0x3fb855 BIT_MASK 0x20 /end MEASUREMENT
/begin MEASUREMENT fmy_stat_cps.err_info_stat.lv_cdn_diag "" UBYTE _CNV_S_2_RANGE______21_CM 1 100. 0. 1. DISPLAY_IDENTIFIER LV_CDN_DIAG_CPS ECU_ADDRESS 0x3fb855 BIT_MASK 0x10 /end MEASUREMENT
/begin MEASUREMENT fmy_stat_cps.err_info_stat.err_sym "" UBYTE _CNV_S_6_RANGE_ERR__193_CM 1 100. 0. 15. DISPLAY_IDENTIFIER ERR_SYM_CPS ECU_ADDRESS 0x3fb855 BIT_MASK 0xF /end MEASUREMENT
/begin MEASUREMENT fmy_stat_mec_ivvt_in_1.ctr_abc "" UBYTE _CNV_A_R_LINEAR_____0_CM 1 100. 0. 255. DISPLAY_IDENTIFIER CTR_ABC_MEC_IVVT_IN_1 ECU_ADDRESS 0x3fb85b FORMAT "%3.0" /end MEASUREMENT
/begin MEASUREMENT fmy_stat_mec_ivvt_in_1.ctr_end_diag "" UBYTE _CNV_A_R_LINEAR_____0_CM 1 100. 0. 255. DISPLAY_IDENTIFIER CTR_ABC_END_DIAG_MEC_IVVT_IN_1 ECU_ADDRESS 0x3fb85a FORMAT "%3.0" /end MEASUREMENT
/begin MEASUREMENT fmy_stat_mec_ivvt_in_1.err_info_stat.lv_err_mem "" UBYTE _CNV_S_2_RANGE______21_CM 1 100. 0. 1. DISPLAY_IDENTIFIER LV_ERR_MEM_MEC_IVVT_IN_1 ECU_ADDRESS 0x3fb859 BIT_MASK 0x80 /end MEASUREMENT
/begin MEASUREMENT fmy_stat_mec_ivvt_in_1.err_info_stat.lv_ready "" UBYTE _CNV_S_2_RANGE______21_CM 1 100. 0. 1. DISPLAY_IDENTIFIER LV_READY_MEC_IVVT_IN_1 ECU_ADDRESS 0x3fb859 BIT_MASK 0x40 /end MEASUREMENT
/begin MEASUREMENT fmy_stat_mec_ivvt_in_1.err_info_stat.lv_end_diag "" UBYTE _CNV_S_2_RANGE______21_CM 1 100. 0. 1. DISPLAY_IDENTIFIER LV_END_DIAG_MEC_IVVT_IN_1 ECU_ADDRESS 0x3fb859 BIT_MASK 0x20 /end MEASUREMENT
/begin MEASUREMENT fmy_stat_mec_ivvt_in_1.err_info_stat.lv_cdn_diag "" UBYTE _CNV_S_2_RANGE______21_CM 1 100. 0. 1. DISPLAY_IDENTIFIER LV_CDN_DIAG_MEC_IVVT_IN_1 ECU_ADDRESS 0x3fb859 BIT_MASK 0x10 /end MEASUREMENT
/begin MEASUREMENT fmy_stat_mec_ivvt_in_1.err_info_stat.err_sym "" UBYTE _CNV_S_6_RANGE_ERR__193_CM 1 100. 0. 15. DISPLAY_IDENTIFIER ERR_SYM_MEC_IVVT_IN_1 ECU_ADDRESS 0x3fb859 BIT_MASK 0xF /end MEASUREMENT
/begin MEASUREMENT fmy_stat_mec_ivvt_ex_1.ctr_abc "" UBYTE _CNV_A_R_LINEAR_____0_CM 1 100. 0. 255. DISPLAY_IDENTIFIER CTR_ABC_MEC_IVVT_EX_1 ECU_ADDRESS 0x3fb85f FORMAT "%3.0" /end MEASUREMENT
/begin MEASUREMENT fmy_stat_mec_ivvt_ex_1.ctr_end_diag "" UBYTE _CNV_A_R_LINEAR_____0_CM 1 100. 0. 255. DISPLAY_IDENTIFIER CTR_ABC_END_DIAG_MEC_IVVT_EX_1 ECU_ADDRESS 0x3fb85e FORMAT "%3.0" /end MEASUREMENT
/begin MEASUREMENT fmy_stat_mec_ivvt_ex_1.err_info_stat.lv_err_mem "" UBYTE _CNV_S_2_RANGE______21_CM 1 100. 0. 1. DISPLAY_IDENTIFIER LV_ERR_MEM_MEC_IVVT_EX_1 ECU_ADDRESS 0x3fb85d BIT_MASK 0x80 /end MEASUREMENT
/begin MEASUREMENT fmy_stat_mec_ivvt_ex_1.err_info_stat.lv_ready "" UBYTE _CNV_S_2_RANGE______21_CM 1 100. 0. 1. DISPLAY_IDENTIFIER LV_READY_MEC_IVVT_EX_1 ECU_ADDRESS 0x3fb85d BIT_MASK 0x40 /end MEASUREMENT
/begin MEASUREMENT fmy_stat_mec_ivvt_ex_1.err_info_stat.lv_end_diag "" UBYTE _CNV_S_2_RANGE______21_CM 1 100. 0. 1. DISPLAY_IDENTIFIER LV_END_DIAG_MEC_IVVT_EX_1 ECU_ADDRESS 0x3fb85d BIT_MASK 0x20 /end MEASUREMENT
/begin MEASUREMENT fmy_stat_mec_ivvt_ex_1.err_info_stat.lv_cdn_diag "" UBYTE _CNV_S_2_RANGE______21_CM 1 100. 0. 1. DISPLAY_IDENTIFIER LV_CDN_DIAG_MEC_IVVT_EX_1 ECU_ADDRESS 0x3fb85d BIT_MASK 0x10 /end MEASUREMENT
/begin MEASUREMENT fmy_stat_mec_ivvt_ex_1.err_info_stat.err_sym "" UBYTE _CNV_S_6_RANGE_ERR__193_CM 1 100. 0. 15. DISPLAY_IDENTIFIER ERR_SYM_MEC_IVVT_EX_1 ECU_ADDRESS 0x3fb85d BIT_MASK 0xF /end MEASUREMENT
/begin MEASUREMENT fmy_stat_ref_ivvt_in_1.ctr_abc "" UBYTE _CNV_A_R_LINEAR_____0_CM 1 100. 0. 255. DISPLAY_IDENTIFIER CTR_ABC_REF_IVVT_IN_1 ECU_ADDRESS 0x3fb863 FORMAT "%3.0" /end MEASUREMENT
/begin MEASUREMENT fmy_stat_ref_ivvt_in_1.ctr_end_diag "" UBYTE _CNV_A_R_LINEAR_____0_CM 1 100. 0. 255. DISPLAY_IDENTIFIER CTR_ABC_END_DIAG_REF_IVVT_IN_1 ECU_ADDRESS 0x3fb862 FORMAT "%3.0" /end MEASUREMENT
/begin MEASUREMENT fmy_stat_ref_ivvt_in_1.err_info_stat.lv_err_mem "" UBYTE _CNV_S_2_RANGE______21_CM 1 100. 0. 1. DISPLAY_IDENTIFIER LV_ERR_MEM_REF_IVVT_IN_1 ECU_ADDRESS 0x3fb861 BIT_MASK 0x80 /end MEASUREMENT
/begin MEASUREMENT fmy_stat_ref_ivvt_in_1.err_info_stat.lv_ready "" UBYTE _CNV_S_2_RANGE______21_CM 1 100. 0. 1. DISPLAY_IDENTIFIER LV_READY_REF_IVVT_IN_1 ECU_ADDRESS 0x3fb861 BIT_MASK 0x40 /end MEASUREMENT
/begin MEASUREMENT fmy_stat_ref_ivvt_in_1.err_info_stat.lv_end_diag "" UBYTE _CNV_S_2_RANGE______21_CM 1 100. 0. 1. DISPLAY_IDENTIFIER LV_END_DIAG_REF_IVVT_IN_1 ECU_ADDRESS 0x3fb861 BIT_MASK 0x20 /end MEASUREMENT
/begin MEASUREMENT fmy_stat_ref_ivvt_in_1.err_info_stat.lv_cdn_diag "" UBYTE _CNV_S_2_RANGE______21_CM 1 100. 0. 1. DISPLAY_IDENTIFIER LV_CDN_DIAG_REF_IVVT_IN_1 ECU_ADDRESS 0x3fb861 BIT_MASK 0x10 /end MEASUREMENT
/begin MEASUREMENT fmy_stat_ref_ivvt_in_1.err_info_stat.err_sym "" UBYTE _CNV_S_6_RANGE_ERR__193_CM 1 100. 0. 15. DISPLAY_IDENTIFIER ERR_SYM_REF_IVVT_IN_1 ECU_ADDRESS 0x3fb861 BIT_MASK 0xF /end MEASUREMENT
/begin MEASUREMENT fmy_stat_ref_ivvt_ex_1.ctr_abc "" UBYTE _CNV_A_R_LINEAR_____0_CM 1 100. 0. 255. DISPLAY_IDENTIFIER CTR_ABC_REF_IVVT_EX_1 ECU_ADDRESS 0x3fb867 FORMAT "%3.0" /end MEASUREMENT
/begin MEASUREMENT fmy_stat_ref_ivvt_ex_1.ctr_end_diag "" UBYTE _CNV_A_R_LINEAR_____0_CM 1 100. 0. 255. DISPLAY_IDENTIFIER CTR_ABC_END_DIAG_REF_IVVT_EX_1 ECU_ADDRESS 0x3fb866 FORMAT "%3.0" /end MEASUREMENT
/begin MEASUREMENT fmy_stat_ref_ivvt_ex_1.err_info_stat.lv_err_mem "" UBYTE _CNV_S_2_RANGE______21_CM 1 100. 0. 1. DISPLAY_IDENTIFIER LV_ERR_MEM_REF_IVVT_EX_1 ECU_ADDRESS 0x3fb865 BIT_MASK 0x80 /end MEASUREMENT
/begin MEASUREMENT fmy_stat_ref_ivvt_ex_1.err_info_stat.lv_ready "" UBYTE _CNV_S_2_RANGE______21_CM 1 100. 0. 1. DISPLAY_IDENTIFIER LV_READY_REF_IVVT_EX_1 ECU_ADDRESS 0x3fb865 BIT_MASK 0x40 /end MEASUREMENT
/begin MEASUREMENT fmy_stat_ref_ivvt_ex_1.err_info_stat.lv_end_diag "" UBYTE _CNV_S_2_RANGE______21_CM 1 100. 0. 1. DISPLAY_IDENTIFIER LV_END_DIAG_REF_IVVT_EX_1 ECU_ADDRESS 0x3fb865 BIT_MASK 0x20 /end MEASUREMENT
/begin MEASUREMENT fmy_stat_ref_ivvt_ex_1.err_info_stat.lv_cdn_diag "" UBYTE _CNV_S_2_RANGE______21_CM 1 100. 0. 1. DISPLAY_IDENTIFIER LV_CDN_DIAG_REF_IVVT_EX_1 ECU_ADDRESS 0x3fb865 BIT_MASK 0x10 /end MEASUREMENT
/begin MEASUREMENT fmy_stat_ref_ivvt_ex_1.err_info_stat.err_sym "" UBYTE _CNV_S_6_RANGE_ERR__193_CM 1 100. 0. 15. DISPLAY_IDENTIFIER ERR_SYM_REF_IVVT_EX_1 ECU_ADDRESS 0x3fb865 BIT_MASK 0xF /end MEASUREMENT
/begin MEASUREMENT fmy_stat_slv_ivvt_in_1.err_info_stat.lv_err_mem "" UBYTE _CNV_S_2_RANGE______21_CM 1 100. 0. 1. DISPLAY_IDENTIFIER LV_ERR_MEM_SLV_IVVT_IN_1 ECU_ADDRESS 0x3fb869 BIT_MASK 0x80 /end MEASUREMENT
/begin MEASUREMENT fmy_stat_slv_ivvt_in_1.err_info_stat.lv_ready "" UBYTE _CNV_S_2_RANGE______21_CM 1 100. 0. 1. DISPLAY_IDENTIFIER LV_READY_SLV_IVVT_IN_1 ECU_ADDRESS 0x3fb869 BIT_MASK 0x40 /end MEASUREMENT
/begin MEASUREMENT fmy_stat_slv_ivvt_in_1.err_info_stat.lv_end_diag "" UBYTE _CNV_S_2_RANGE______21_CM 1 100. 0. 1. DISPLAY_IDENTIFIER LV_END_DIAG_SLV_IVVT_IN_1 ECU_ADDRESS 0x3fb869 BIT_MASK 0x20 /end MEASUREMENT
/begin MEASUREMENT fmy_stat_slv_ivvt_in_1.err_info_stat.lv_cdn_diag "" UBYTE _CNV_S_2_RANGE______21_CM 1 100. 0. 1. DISPLAY_IDENTIFIER LV_CDN_DIAG_SLV_IVVT_IN_1 ECU_ADDRESS 0x3fb869 BIT_MASK 0x10 /end MEASUREMENT
/begin MEASUREMENT fmy_stat_slv_ivvt_in_1.err_info_stat.err_sym "" UBYTE _CNV_S_6_RANGE_ERR__193_CM 1 100. 0. 15. DISPLAY_IDENTIFIER ERR_SYM_SLV_IVVT_IN_1 ECU_ADDRESS 0x3fb869 BIT_MASK 0xF /end MEASUREMENT
/begin MEASUREMENT fmy_stat_slv_ivvt_ex_1.err_info_stat.lv_err_mem "" UBYTE _CNV_S_2_RANGE______21_CM 1 100. 0. 1. DISPLAY_IDENTIFIER LV_ERR_MEM_SLV_IVVT_EX_1 ECU_ADDRESS 0x3fb86d BIT_MASK 0x80 /end MEASUREMENT
/begin MEASUREMENT fmy_stat_slv_ivvt_ex_1.err_info_stat.lv_ready "" UBYTE _CNV_S_2_RANGE______21_CM 1 100. 0. 1. DISPLAY_IDENTIFIER LV_READY_SLV_IVVT_EX_1 ECU_ADDRESS 0x3fb86d BIT_MASK 0x40 /end MEASUREMENT
/begin MEASUREMENT fmy_stat_slv_ivvt_ex_1.err_info_stat.lv_end_diag "" UBYTE _CNV_S_2_RANGE______21_CM 1 100. 0. 1. DISPLAY_IDENTIFIER LV_END_DIAG_SLV_IVVT_EX_1 ECU_ADDRESS 0x3fb86d BIT_MASK 0x20 /end MEASUREMENT
/begin MEASUREMENT fmy_stat_slv_ivvt_ex_1.err_info_stat.lv_cdn_diag "" UBYTE _CNV_S_2_RANGE______21_CM 1 100. 0. 1. DISPLAY_IDENTIFIER LV_CDN_DIAG_SLV_IVVT_EX_1 ECU_ADDRESS 0x3fb86d BIT_MASK 0x10 /end MEASUREMENT
/begin MEASUREMENT fmy_stat_slv_ivvt_ex_1.err_info_stat.err_sym "" UBYTE _CNV_S_6_RANGE_ERR__193_CM 1 100. 0. 15. DISPLAY_IDENTIFIER ERR_SYM_SLV_IVVT_EX_1 ECU_ADDRESS 0x3fb86d BIT_MASK 0xF /end MEASUREMENT
/begin MEASUREMENT fmy_stat_park_ivvt_in_1.ctr_abc "" UBYTE _CNV_A_R_LINEAR_____0_CM 1 100. 0. 255. DISPLAY_IDENTIFIER CTR_ABC_PARK_IVVT_IN_1 ECU_ADDRESS 0x3fb873 FORMAT "%3.0" /end MEASUREMENT
/begin MEASUREMENT fmy_stat_park_ivvt_in_1.ctr_end_diag "" UBYTE _CNV_A_R_LINEAR_____0_CM 1 100. 0. 255. DISPLAY_IDENTIFIER CTR_ABC_END_DIAG_PARK_IVVT_IN_1 ECU_ADDRESS 0x3fb872 FORMAT "%3.0" /end MEASUREMENT
/begin MEASUREMENT fmy_stat_park_ivvt_in_1.err_info_stat.lv_err_mem "" UBYTE _CNV_S_2_RANGE______21_CM 1 100. 0. 1. DISPLAY_IDENTIFIER LV_ERR_MEM_PARK_IVVT_IN_1 ECU_ADDRESS 0x3fb871 BIT_MASK 0x80 /end MEASUREMENT
/begin MEASUREMENT fmy_stat_park_ivvt_in_1.err_info_stat.lv_ready "" UBYTE _CNV_S_2_RANGE______21_CM 1 100. 0. 1. DISPLAY_IDENTIFIER LV_READY_PARK_IVVT_IN_1 ECU_ADDRESS 0x3fb871 BIT_MASK 0x40 /end MEASUREMENT
/begin MEASUREMENT fmy_stat_park_ivvt_in_1.err_info_stat.lv_end_diag "" UBYTE _CNV_S_2_RANGE______21_CM 1 100. 0. 1. DISPLAY_IDENTIFIER LV_END_DIAG_PARK_IVVT_IN_1 ECU_ADDRESS 0x3fb871 BIT_MASK 0x20 /end MEASUREMENT
/begin MEASUREMENT fmy_stat_park_ivvt_in_1.err_info_stat.lv_cdn_diag "" UBYTE _CNV_S_2_RANGE______21_CM 1 100. 0. 1. DISPLAY_IDENTIFIER LV_CDN_DIAG_PARK_IVVT_IN_1 ECU_ADDRESS 0x3fb871 BIT_MASK 0x10 /end MEASUREMENT
/begin MEASUREMENT fmy_stat_park_ivvt_in_1.err_info_stat.err_sym "" UBYTE _CNV_S_6_RANGE_ERR__193_CM 1 100. 0. 15. DISPLAY_IDENTIFIER ERR_SYM_PARK_IVVT_IN_1 ECU_ADDRESS 0x3fb871 BIT_MASK 0xF /end MEASUREMENT
/begin MEASUREMENT fmy_stat_park_ivvt_ex_1.ctr_abc "" UBYTE _CNV_A_R_LINEAR_____0_CM 1 100. 0. 255. DISPLAY_IDENTIFIER CTR_ABC_PARK_IVVT_EX_1 ECU_ADDRESS 0x3fb877 FORMAT "%3.0" /end MEASUREMENT
/begin MEASUREMENT fmy_stat_park_ivvt_ex_1.ctr_end_diag "" UBYTE _CNV_A_R_LINEAR_____0_CM 1 100. 0. 255. DISPLAY_IDENTIFIER CTR_ABC_END_DIAG_PARK_IVVT_EX_1 ECU_ADDRESS 0x3fb876 FORMAT "%3.0" /end MEASUREMENT
/begin MEASUREMENT fmy_stat_park_ivvt_ex_1.err_info_stat.lv_err_mem "" UBYTE _CNV_S_2_RANGE______21_CM 1 100. 0. 1. DISPLAY_IDENTIFIER LV_ERR_MEM_PARK_IVVT_EX_1 ECU_ADDRESS 0x3fb875 BIT_MASK 0x80 /end MEASUREMENT
/begin MEASUREMENT fmy_stat_park_ivvt_ex_1.err_info_stat.lv_ready "" UBYTE _CNV_S_2_RANGE______21_CM 1 100. 0. 1. DISPLAY_IDENTIFIER LV_READY_PARK_IVVT_EX_1 ECU_ADDRESS 0x3fb875 BIT_MASK 0x40 /end MEASUREMENT
/begin MEASUREMENT fmy_stat_park_ivvt_ex_1.err_info_stat.lv_end_diag "" UBYTE _CNV_S_2_RANGE______21_CM 1 100. 0. 1. DISPLAY_IDENTIFIER LV_END_DIAG_PARK_IVVT_EX_1 ECU_ADDRESS 0x3fb875 BIT_MASK 0x20 /end MEASUREMENT
/begin MEASUREMENT fmy_stat_park_ivvt_ex_1.err_info_stat.lv_cdn_diag "" UBYTE _CNV_S_2_RANGE______21_CM 1 100. 0. 1. DISPLAY_IDENTIFIER LV_CDN_DIAG_PARK_IVVT_EX_1 ECU_ADDRESS 0x3fb875 BIT_MASK 0x10 /end MEASUREMENT
/begin MEASUREMENT fmy_stat_park_ivvt_ex_1.err_info_stat.err_sym "" UBYTE _CNV_S_6_RANGE_ERR__193_CM 1 100. 0. 15. DISPLAY_IDENTIFIER ERR_SYM_PARK_IVVT_EX_1 ECU_ADDRESS 0x3fb875 BIT_MASK 0xF /end MEASUREMENT
/begin MEASUREMENT fmy_stat_ecu_cks.ctr_abc "" UBYTE _CNV_A_R_LINEAR_____0_CM 1 100. 0. 255. DISPLAY_IDENTIFIER CTR_ABC_ECU_CKS ECU_ADDRESS 0x3fb87b FORMAT "%3.0" /end MEASUREMENT
/begin MEASUREMENT fmy_stat_ecu_cks.ctr_end_diag "" UBYTE _CNV_A_R_LINEAR_____0_CM 1 100. 0. 255. DISPLAY_IDENTIFIER CTR_ABC_END_DIAG_ECU_CKS ECU_ADDRESS 0x3fb87a FORMAT "%3.0" /end MEASUREMENT
/begin MEASUREMENT fmy_stat_ecu_cks.err_info_stat.lv_err_mem "" UBYTE _CNV_S_2_RANGE______21_CM 1 100. 0. 1. DISPLAY_IDENTIFIER LV_ERR_MEM_ECU_CKS ECU_ADDRESS 0x3fb879 BIT_MASK 0x80 /end MEASUREMENT
/begin MEASUREMENT fmy_stat_ecu_cks.err_info_stat.lv_ready "" UBYTE _CNV_S_2_RANGE______21_CM 1 100. 0. 1. DISPLAY_IDENTIFIER LV_READY_ECU_CKS ECU_ADDRESS 0x3fb879 BIT_MASK 0x40 /end MEASUREMENT
/begin MEASUREMENT fmy_stat_ecu_cks.err_info_stat.lv_end_diag "" UBYTE _CNV_S_2_RANGE______21_CM 1 100. 0. 1. DISPLAY_IDENTIFIER LV_END_DIAG_ECU_CKS ECU_ADDRESS 0x3fb879 BIT_MASK 0x20 /end MEASUREMENT
/begin MEASUREMENT fmy_stat_ecu_cks.err_info_stat.lv_cdn_diag "" UBYTE _CNV_S_2_RANGE______21_CM 1 100. 0. 1. DISPLAY_IDENTIFIER LV_CDN_DIAG_ECU_CKS ECU_ADDRESS 0x3fb879 BIT_MASK 0x10 /end MEASUREMENT
/begin MEASUREMENT fmy_stat_ecu_cks.err_info_stat.err_sym "" UBYTE _CNV_S_6_RANGE_ERR__193_CM 1 100. 0. 15. DISPLAY_IDENTIFIER ERR_SYM_ECU_CKS ECU_ADDRESS 0x3fb879 BIT_MASK 0xF /end MEASUREMENT
/begin MEASUREMENT fmy_stat_toil_level.ctr_abc "" UBYTE _CNV_A_R_LINEAR_____0_CM 1 100. 0. 255. DISPLAY_IDENTIFIER CTR_ABC_TOIL_LEVEL ECU_ADDRESS 0x3fb87f FORMAT "%3.0" /end MEASUREMENT
/begin MEASUREMENT fmy_stat_toil_level.ctr_end_diag "" UBYTE _CNV_A_R_LINEAR_____0_CM 1 100. 0. 255. DISPLAY_IDENTIFIER CTR_ABC_END_DIAG_TOIL_LEVEL ECU_ADDRESS 0x3fb87e FORMAT "%3.0" /end MEASUREMENT
/begin MEASUREMENT fmy_stat_toil_level.err_info_stat.lv_err_mem "" UBYTE _CNV_S_2_RANGE______21_CM 1 100. 0. 1. DISPLAY_IDENTIFIER LV_ERR_MEM_TOIL_LEVEL ECU_ADDRESS 0x3fb87d BIT_MASK 0x80 /end MEASUREMENT
/begin MEASUREMENT fmy_stat_toil_level.err_info_stat.lv_ready "" UBYTE _CNV_S_2_RANGE______21_CM 1 100. 0. 1. DISPLAY_IDENTIFIER LV_READY_TOIL_LEVEL ECU_ADDRESS 0x3fb87d BIT_MASK 0x40 /end MEASUREMENT
/begin MEASUREMENT fmy_stat_toil_level.err_info_stat.lv_end_diag "" UBYTE _CNV_S_2_RANGE______21_CM 1 100. 0. 1. DISPLAY_IDENTIFIER LV_END_DIAG_TOIL_LEVEL ECU_ADDRESS 0x3fb87d BIT_MASK 0x20 /end MEASUREMENT
/begin MEASUREMENT fmy_stat_toil_level.err_info_stat.lv_cdn_diag "" UBYTE _CNV_S_2_RANGE______21_CM 1 100. 0. 1. DISPLAY_IDENTIFIER LV_CDN_DIAG_TOIL_LEVEL ECU_ADDRESS 0x3fb87d BIT_MASK 0x10 /end MEASUREMENT
/begin MEASUREMENT fmy_stat_toil_level.err_info_stat.err_sym "" UBYTE _CNV_S_6_RANGE_ERR__193_CM 1 100. 0. 15. DISPLAY_IDENTIFIER ERR_SYM_TOIL_LEVEL ECU_ADDRESS 0x3fb87d BIT_MASK 0xF /end MEASUREMENT
/begin MEASUREMENT fmy_stat_tout_etcu_1.ctr_abc "" UBYTE _CNV_A_R_LINEAR_____0_CM 1 100. 0. 255. DISPLAY_IDENTIFIER CTR_ABC_TOUT_ETCU_1 ECU_ADDRESS 0x3fb883 FORMAT "%3.0" /end MEASUREMENT
/begin MEASUREMENT fmy_stat_tout_etcu_1.ctr_end_diag "" UBYTE _CNV_A_R_LINEAR_____0_CM 1 100. 0. 255. DISPLAY_IDENTIFIER CTR_ABC_END_DIAG_TOUT_ETCU_1 ECU_ADDRESS 0x3fb882 FORMAT "%3.0" /end MEASUREMENT
/begin MEASUREMENT fmy_stat_tout_etcu_1.err_info_stat.lv_err_mem "" UBYTE _CNV_S_2_RANGE______21_CM 1 100. 0. 1. DISPLAY_IDENTIFIER LV_ERR_MEM_TOUT_ETCU_1 ECU_ADDRESS 0x3fb881 BIT_MASK 0x80 /end MEASUREMENT
/begin MEASUREMENT fmy_stat_tout_etcu_1.err_info_stat.lv_ready "" UBYTE _CNV_S_2_RANGE______21_CM 1 100. 0. 1. DISPLAY_IDENTIFIER LV_READY_TOUT_ETCU_1 ECU_ADDRESS 0x3fb881 BIT_MASK 0x40 /end MEASUREMENT
/begin MEASUREMENT fmy_stat_tout_etcu_1.err_info_stat.lv_end_diag "" UBYTE _CNV_S_2_RANGE______21_CM 1 100. 0. 1. DISPLAY_IDENTIFIER LV_END_DIAG_TOUT_ETCU_1 ECU_ADDRESS 0x3fb881 BIT_MASK 0x20 /end MEASUREMENT
/begin MEASUREMENT fmy_stat_tout_etcu_1.err_info_stat.lv_cdn_diag "" UBYTE _CNV_S_2_RANGE______21_CM 1 100. 0. 1. DISPLAY_IDENTIFIER LV_CDN_DIAG_TOUT_ETCU_1 ECU_ADDRESS 0x3fb881 BIT_MASK 0x10 /end MEASUREMENT
/begin MEASUREMENT fmy_stat_tout_etcu_1.err_info_stat.err_sym "" UBYTE _CNV_S_6_RANGE_ERR__193_CM 1 100. 0. 15. DISPLAY_IDENTIFIER ERR_SYM_TOUT_ETCU_1 ECU_ADDRESS 0x3fb881 BIT_MASK 0xF /end MEASUREMENT
/begin MEASUREMENT fmy_stat_tout_etcu_2.ctr_abc "" UBYTE _CNV_A_R_LINEAR_____0_CM 1 100. 0. 255. DISPLAY_IDENTIFIER CTR_ABC_TOUT_ETCU_2 ECU_ADDRESS 0x3fb887 FORMAT "%3.0" /end MEASUREMENT
/begin MEASUREMENT fmy_stat_tout_etcu_2.ctr_end_diag "" UBYTE _CNV_A_R_LINEAR_____0_CM 1 100. 0. 255. DISPLAY_IDENTIFIER CTR_ABC_END_DIAG_TOUT_ETCU_2 ECU_ADDRESS 0x3fb886 FORMAT "%3.0" /end MEASUREMENT
/begin MEASUREMENT fmy_stat_tout_etcu_2.err_info_stat.lv_err_mem "" UBYTE _CNV_S_2_RANGE______21_CM 1 100. 0. 1. DISPLAY_IDENTIFIER LV_ERR_MEM_TOUT_ETCU_2 ECU_ADDRESS 0x3fb885 BIT_MASK 0x80 /end MEASUREMENT
/begin MEASUREMENT fmy_stat_tout_etcu_2.err_info_stat.lv_ready "" UBYTE _CNV_S_2_RANGE______21_CM 1 100. 0. 1. DISPLAY_IDENTIFIER LV_READY_TOUT_ETCU_2 ECU_ADDRESS 0x3fb885 BIT_MASK 0x40 /end MEASUREMENT
/begin MEASUREMENT fmy_stat_tout_etcu_2.err_info_stat.lv_end_diag "" UBYTE _CNV_S_2_RANGE______21_CM 1 100. 0. 1. DISPLAY_IDENTIFIER LV_END_DIAG_TOUT_ETCU_2 ECU_ADDRESS 0x3fb885 BIT_MASK 0x20 /end MEASUREMENT
/begin MEASUREMENT fmy_stat_tout_etcu_2.err_info_stat.lv_cdn_diag "" UBYTE _CNV_S_2_RANGE______21_CM 1 100. 0. 1. DISPLAY_IDENTIFIER LV_CDN_DIAG_TOUT_ETCU_2 ECU_ADDRESS 0x3fb885 BIT_MASK 0x10 /end MEASUREMENT
/begin MEASUREMENT fmy_stat_tout_etcu_2.err_info_stat.err_sym "" UBYTE _CNV_S_6_RANGE_ERR__193_CM 1 100. 0. 15. DISPLAY_IDENTIFIER ERR_SYM_TOUT_ETCU_2 ECU_ADDRESS 0x3fb885 BIT_MASK 0xF /end MEASUREMENT
/begin MEASUREMENT fmy_stat_tout_icl_2.ctr_abc "" UBYTE _CNV_A_R_LINEAR_____0_CM 1 100. 0. 255. DISPLAY_IDENTIFIER CTR_ABC_TOUT_ICL_2 ECU_ADDRESS 0x3fb88b FORMAT "%3.0" /end MEASUREMENT
/begin MEASUREMENT fmy_stat_tout_icl_2.ctr_end_diag "" UBYTE _CNV_A_R_LINEAR_____0_CM 1 100. 0. 255. DISPLAY_IDENTIFIER CTR_ABC_END_DIAG_TOUT_ICL_2 ECU_ADDRESS 0x3fb88a FORMAT "%3.0" /end MEASUREMENT
/begin MEASUREMENT fmy_stat_tout_icl_2.err_info_stat.lv_err_mem "" UBYTE _CNV_S_2_RANGE______21_CM 1 100. 0. 1. DISPLAY_IDENTIFIER LV_ERR_MEM_TOUT_ICL_2 ECU_ADDRESS 0x3fb889 BIT_MASK 0x80 /end MEASUREMENT
/begin MEASUREMENT fmy_stat_tout_icl_2.err_info_stat.lv_ready "" UBYTE _CNV_S_2_RANGE______21_CM 1 100. 0. 1. DISPLAY_IDENTIFIER LV_READY_TOUT_ICL_2 ECU_ADDRESS 0x3fb889 BIT_MASK 0x40 /end MEASUREMENT
/begin MEASUREMENT fmy_stat_tout_icl_2.err_info_stat.lv_end_diag "" UBYTE _CNV_S_2_RANGE______21_CM 1 100. 0. 1. DISPLAY_IDENTIFIER LV_END_DIAG_TOUT_ICL_2 ECU_ADDRESS 0x3fb889 BIT_MASK 0x20 /end MEASUREMENT
/begin MEASUREMENT fmy_stat_tout_icl_2.err_info_stat.lv_cdn_diag "" UBYTE _CNV_S_2_RANGE______21_CM 1 100. 0. 1. DISPLAY_IDENTIFIER LV_CDN_DIAG_TOUT_ICL_2 ECU_ADDRESS 0x3fb889 BIT_MASK 0x10 /end MEASUREMENT
/begin MEASUREMENT fmy_stat_tout_icl_2.err_info_stat.err_sym "" UBYTE _CNV_S_6_RANGE_ERR__193_CM 1 100. 0. 15. DISPLAY_IDENTIFIER ERR_SYM_TOUT_ICL_2 ECU_ADDRESS 0x3fb889 BIT_MASK 0xF /end MEASUREMENT
/begin MEASUREMENT fmy_stat_tout_icl_3.ctr_abc "" UBYTE _CNV_A_R_LINEAR_____0_CM 1 100. 0. 255. DISPLAY_IDENTIFIER CTR_ABC_TOUT_ICL_3 ECU_ADDRESS 0x3fb88f FORMAT "%3.0" /end MEASUREMENT
/begin MEASUREMENT fmy_stat_tout_icl_3.ctr_end_diag "" UBYTE _CNV_A_R_LINEAR_____0_CM 1 100. 0. 255. DISPLAY_IDENTIFIER CTR_ABC_END_DIAG_TOUT_ICL_3 ECU_ADDRESS 0x3fb88e FORMAT "%3.0" /end MEASUREMENT
/begin MEASUREMENT fmy_stat_tout_icl_3.err_info_stat.lv_err_mem "" UBYTE _CNV_S_2_RANGE______21_CM 1 100. 0. 1. DISPLAY_IDENTIFIER LV_ERR_MEM_TOUT_ICL_3 ECU_ADDRESS 0x3fb88d BIT_MASK 0x80 /end MEASUREMENT
/begin MEASUREMENT fmy_stat_tout_icl_3.err_info_stat.lv_ready "" UBYTE _CNV_S_2_RANGE______21_CM 1 100. 0. 1. DISPLAY_IDENTIFIER LV_READY_TOUT_ICL_3 ECU_ADDRESS 0x3fb88d BIT_MASK 0x40 /end MEASUREMENT
/begin MEASUREMENT fmy_stat_tout_icl_3.err_info_stat.lv_end_diag "" UBYTE _CNV_S_2_RANGE______21_CM 1 100. 0. 1. DISPLAY_IDENTIFIER LV_END_DIAG_TOUT_ICL_3 ECU_ADDRESS 0x3fb88d BIT_MASK 0x20 /end MEASUREMENT
/begin MEASUREMENT fmy_stat_tout_icl_3.err_info_stat.lv_cdn_diag "" UBYTE _CNV_S_2_RANGE______21_CM 1 100. 0. 1. DISPLAY_IDENTIFIER LV_CDN_DIAG_TOUT_ICL_3 ECU_ADDRESS 0x3fb88d BIT_MASK 0x10 /end MEASUREMENT
/begin MEASUREMENT fmy_stat_tout_icl_3.err_info_stat.err_sym "" UBYTE _CNV_S_6_RANGE_ERR__193_CM 1 100. 0. 15. DISPLAY_IDENTIFIER ERR_SYM_TOUT_ICL_3 ECU_ADDRESS 0x3fb88d BIT_MASK 0xF /end MEASUREMENT
/begin MEASUREMENT fmy_stat_tout_asr_1.ctr_abc "" UBYTE _CNV_A_R_LINEAR_____0_CM 1 100. 0. 255. DISPLAY_IDENTIFIER CTR_ABC_TOUT_ASR_1 ECU_ADDRESS 0x3fb893 FORMAT "%3.0" /end MEASUREMENT
/begin MEASUREMENT fmy_stat_tout_asr_1.ctr_end_diag "" UBYTE _CNV_A_R_LINEAR_____0_CM 1 100. 0. 255. DISPLAY_IDENTIFIER CTR_ABC_END_DIAG_TOUT_ASR_1 ECU_ADDRESS 0x3fb892 FORMAT "%3.0" /end MEASUREMENT
/begin MEASUREMENT fmy_stat_tout_asr_1.err_info_stat.lv_err_mem "" UBYTE _CNV_S_2_RANGE______21_CM 1 100. 0. 1. DISPLAY_IDENTIFIER LV_ERR_MEM_TOUT_ASR_1 ECU_ADDRESS 0x3fb891 BIT_MASK 0x80 /end MEASUREMENT
/begin MEASUREMENT fmy_stat_tout_asr_1.err_info_stat.lv_ready "" UBYTE _CNV_S_2_RANGE______21_CM 1 100. 0. 1. DISPLAY_IDENTIFIER LV_READY_TOUT_ASR_1 ECU_ADDRESS 0x3fb891 BIT_MASK 0x40 /end MEASUREMENT
/begin MEASUREMENT fmy_stat_tout_asr_1.err_info_stat.lv_end_diag "" UBYTE _CNV_S_2_RANGE______21_CM 1 100. 0. 1. DISPLAY_IDENTIFIER LV_END_DIAG_TOUT_ASR_1 ECU_ADDRESS 0x3fb891 BIT_MASK 0x20 /end MEASUREMENT
/begin MEASUREMENT fmy_stat_tout_asr_1.err_info_stat.lv_cdn_diag "" UBYTE _CNV_S_2_RANGE______21_CM 1 100. 0. 1. DISPLAY_IDENTIFIER LV_CDN_DIAG_TOUT_ASR_1 ECU_ADDRESS 0x3fb891 BIT_MASK 0x10 /end MEASUREMENT
/begin MEASUREMENT fmy_stat_tout_asr_1.err_info_stat.err_sym "" UBYTE _CNV_S_6_RANGE_ERR__193_CM 1 100. 0. 15. DISPLAY_IDENTIFIER ERR_SYM_TOUT_ASR_1 ECU_ADDRESS 0x3fb891 BIT_MASK 0xF /end MEASUREMENT
/begin MEASUREMENT fmy_stat_tout_asr_3.ctr_abc "" UBYTE _CNV_A_R_LINEAR_____0_CM 1 100. 0. 255. DISPLAY_IDENTIFIER CTR_ABC_TOUT_ASR_3 ECU_ADDRESS 0x3fb897 FORMAT "%3.0" /end MEASUREMENT
/begin MEASUREMENT fmy_stat_tout_asr_3.ctr_end_diag "" UBYTE _CNV_A_R_LINEAR_____0_CM 1 100. 0. 255. DISPLAY_IDENTIFIER CTR_ABC_END_DIAG_TOUT_ASR_3 ECU_ADDRESS 0x3fb896 FORMAT "%3.0" /end MEASUREMENT
/begin MEASUREMENT fmy_stat_tout_asr_3.err_info_stat.lv_err_mem "" UBYTE _CNV_S_2_RANGE______21_CM 1 100. 0. 1. DISPLAY_IDENTIFIER LV_ERR_MEM_TOUT_ASR_3 ECU_ADDRESS 0x3fb895 BIT_MASK 0x80 /end MEASUREMENT
/begin MEASUREMENT fmy_stat_tout_asr_3.err_info_stat.lv_ready "" UBYTE _CNV_S_2_RANGE______21_CM 1 100. 0. 1. DISPLAY_IDENTIFIER LV_READY_TOUT_ASR_3 ECU_ADDRESS 0x3fb895 BIT_MASK 0x40 /end MEASUREMENT
/begin MEASUREMENT fmy_stat_tout_asr_3.err_info_stat.lv_end_diag "" UBYTE _CNV_S_2_RANGE______21_CM 1 100. 0. 1. DISPLAY_IDENTIFIER LV_END_DIAG_TOUT_ASR_3 ECU_ADDRESS 0x3fb895 BIT_MASK 0x20 /end MEASUREMENT
/begin MEASUREMENT fmy_stat_tout_asr_3.err_info_stat.lv_cdn_diag "" UBYTE _CNV_S_2_RANGE______21_CM 1 100. 0. 1. DISPLAY_IDENTIFIER LV_CDN_DIAG_TOUT_ASR_3 ECU_ADDRESS 0x3fb895 BIT_MASK 0x10 /end MEASUREMENT
/begin MEASUREMENT fmy_stat_tout_asr_3.err_info_stat.err_sym "" UBYTE _CNV_S_6_RANGE_ERR__193_CM 1 100. 0. 15. DISPLAY_IDENTIFIER ERR_SYM_TOUT_ASR_3 ECU_ADDRESS 0x3fb895 BIT_MASK 0xF /end MEASUREMENT
/begin MEASUREMENT fmy_stat_tout_asr_4.ctr_abc "" UBYTE _CNV_A_R_LINEAR_____0_CM 1 100. 0. 255. DISPLAY_IDENTIFIER CTR_ABC_TOUT_ASR_4 ECU_ADDRESS 0x3fb89b FORMAT "%3.0" /end MEASUREMENT
/begin MEASUREMENT fmy_stat_tout_asr_4.ctr_end_diag "" UBYTE _CNV_A_R_LINEAR_____0_CM 1 100. 0. 255. DISPLAY_IDENTIFIER CTR_ABC_END_DIAG_TOUT_ASR_4 ECU_ADDRESS 0x3fb89a FORMAT "%3.0" /end MEASUREMENT
/begin MEASUREMENT lv_err_tout_etcu_2 "logical variable timeout error CAN message EGS2" UBYTE _CNV_S_2_RANGE______1_R_CM 1 100. 0. 255. DISPLAY_IDENTIFIER LV_ERR_TOUT_ETCU_2 ECU_ADDRESS 0x3fb888 /end MEASUREMENT
/begin MEASUREMENT lv_inh_igc[0] "Inhibition Bit for ignition system of cylinder x" UBYTE _CNV_S_2_RANGE______21_CM 1 100. 0. 1. DISPLAY_IDENTIFIER LV_INH_IGC_0 ECU_ADDRESS 0x3fe826 /end MEASUREMENT
/begin MEASUREMENT lv_inh_igc[1] "Inhibition Bit for ignition system of cylinder x" UBYTE _CNV_S_2_RANGE______21_CM 1 100. 0. 1. DISPLAY_IDENTIFIER LV_INH_IGC_1 ECU_ADDRESS 0x3fe827 /end MEASUREMENT
/begin MEASUREMENT lv_inh_igc[2] "Inhibition Bit for ignition system of cylinder x" UBYTE _CNV_S_2_RANGE______21_CM 1 100. 0. 1. DISPLAY_IDENTIFIER LV_INH_IGC_2 ECU_ADDRESS 0x3fe828 /end MEASUREMENT
/begin MEASUREMENT lv_inh_igc[3] "Inhibition Bit for ignition system of cylinder x" UBYTE _CNV_S_2_RANGE______21_CM 1 100. 0. 1. DISPLAY_IDENTIFIER LV_INH_IGC_3 ECU_ADDRESS 0x3fe829 /end MEASUREMENT
/begin MEASUREMENT lv_inh_igc[4] "Inhibition Bit for ignition system of cylinder x" UBYTE _CNV_S_2_RANGE______21_CM 1 100. 0. 1. DISPLAY_IDENTIFIER LV_INH_IGC_4 ECU_ADDRESS 0x3fe82a /end MEASUREMENT
/begin MEASUREMENT lv_inh_igc[5] "Inhibition Bit for ignition system of cylinder x" UBYTE _CNV_S_2_RANGE______21_CM 1 100. 0. 1. DISPLAY_IDENTIFIER LV_INH_IGC_5 ECU_ADDRESS 0x3fe82b /end MEASUREMENT
/begin CHARACTERISTIC c_iga_off_cycnr_hld "Duration for regeneration cycle (2 engine evolutions); coil has been switched off" VALUE 0xffe40776 _REC_VAL_20_u1 255. _CNV_A_R_LINEAR_____0_CM 0. 255. DISPLAY_IDENTIFIER C_IGA_OFF_CYCNR_HLD FORMAT "%3.0" /end CHARACTERISTIC
/begin CHARACTERISTIC c_abc_td_igc_cut "Value of anti-bounce counter after regeneration cycle" VALUE 0xffe40629 _REC_VAL_20_u1 255. _CNV_A_R_LINEAR_____0_CM 0. 255. DISPLAY_IDENTIFIER C_ABC_TD_IGC_CUT FORMAT "%3.0" /end CHARACTERISTIC
/begin CHARACTERISTIC c_sum_td_igc_cut "Number of allowed trials to check the ignition system in one engine run" VALUE 0xffe40856 _REC_VAL_20_u1 255. _CNV_A_R_LINEAR_____0_CM 0. 255. DISPLAY_IDENTIFIER C_SUM_TD_IGC_CUT FORMAT "%3.0" /end CHARACTERISTIC
/begin CHARACTERISTIC c_tco_min_dur_igc_diag "Minimum coolant temperature to enable the diagnosis" VALUE 0xffe40913 _REC_VAL_20_u1 190.5 _CNV_A_R_LINEAR_____11_CM -48. 142.5 DISPLAY_IDENTIFIER C_TCO_MIN_DUR_IGC_DIAG FORMAT "%5.1" /end CHARACTERISTIC
/begin CHARACTERISTIC id_v_dur_igc_min__n__maf "Minimum duration of the primary over voltage to detect ignition errors" MAP 0xffe48e3c _REC_MAP_20_u2_u1_u1 20. _CNV_A_R_LINEAR_____165_CM 0. 20. DISPLAY_IDENTIFIER ID_V_DUR_IGC_MIN__N__MAF FORMAT "%8.3"
 /begin AXIS_DESCR COM_AXIS n_32 _CNV_A_R_LINEAR_____15_CM 8 0. 8160. FORMAT "%4.0" AXIS_PTS_REF ldp_n__v_dur_igc_min /end AXIS_DESCR
 /begin AXIS_DESCR COM_AXIS maf _CNV_A_R_LINEAR_____27_CM 6 0. 1389. FORMAT "%4.0" AXIS_PTS_REF ldp_maf__v_dur_igc_min /end AXIS_DESCR
/end CHARACTERISTIC
/begin CHARACTERISTIC c_esb_ign_cut_diag "Enable byte for the diagnosis configuration" VALUE 0xffe415e6 _REC_VAL_20_u2 65535. _CNV_A_R_LINEAR_____0_CM 0. 65535. DISPLAY_IDENTIFIER C_ESB_IGN_CUT_DIAG FORMAT "%5.0" /end CHARACTERISTIC
/begin MEASUREMENT lv_err_igc "General error flag for ignition" UBYTE _CNV_S_2_RANGE______1_R_CM 1 100. 0. 255. DISPLAY_IDENTIFIER LV_ERR_IGC ECU_ADDRESS 0x3fe82c /end MEASUREMENT
/begin MEASUREMENT igc_diag_mis "No filtered error information for misfire detection" UBYTE _CNV_A_R_LINEAR_____0_CM 1 100. 0. 255. DISPLAY_IDENTIFIER IGC_DIAG_MIS ECU_ADDRESS 0x3fe825 FORMAT "%3.0" /end MEASUREMENT
/begin AXIS_PTS ldp_n__v_dur_igc_min "" 0xffe48124 n_32 _REC_AXS_20_u1 816. _CNV_A_R_LINEAR_____15_CM 8 0. 8160. DISPLAY_IDENTIFIER LDP_N__V_DUR_IGC_MIN FORMAT "%4.0" /end AXIS_PTS
/begin AXIS_PTS ldp_maf__v_dur_igc_min "" 0xffe4105e maf _REC_AXS_20_u1 138.9 _CNV_A_R_LINEAR_____27_CM 6 0. 1389. DISPLAY_IDENTIFIER LDP_MAF__V_DUR_IGC_MIN FORMAT "%4.0" /end AXIS_PTS
/begin MEASUREMENT lv_err_td_igc_cut_0 "Error bit for short cut to battery" UBYTE _CNV_S_2_RANGE______1_R_CM 1 100. 0. 255. DISPLAY_IDENTIFIER LV_ERR_TD_IGC_CUT_0 ECU_ADDRESS 0x3fb8b4 /end MEASUREMENT
/begin MEASUREMENT lv_err_td_igc_cut_1 "Error bit for short cut to battery" UBYTE _CNV_S_2_RANGE______1_R_CM 1 100. 0. 255. DISPLAY_IDENTIFIER LV_ERR_TD_IGC_CUT_1 ECU_ADDRESS 0x3fb8b8 /end MEASUREMENT
/begin MEASUREMENT lv_err_td_igc_cut_2 "Error bit for short cut to battery" UBYTE _CNV_S_2_RANGE______1_R_CM 1 100. 0. 255. DISPLAY_IDENTIFIER LV_ERR_TD_IGC_CUT_2 ECU_ADDRESS 0x3fb8bc /end MEASUREMENT
/begin MEASUREMENT lv_err_td_igc_cut_3 "Error bit for short cut to battery" UBYTE _CNV_S_2_RANGE______1_R_CM 1 100. 0. 255. DISPLAY_IDENTIFIER LV_ERR_TD_IGC_CUT_3 ECU_ADDRESS 0x3fb8c0 /end MEASUREMENT
/begin MEASUREMENT lv_err_td_igc_cut_4 "Error bit for short cut to battery" UBYTE _CNV_S_2_RANGE______1_R_CM 1 100. 0. 255. DISPLAY_IDENTIFIER LV_ERR_TD_IGC_CUT_4 ECU_ADDRESS 0x3fb8c4 /end MEASUREMENT
/begin MEASUREMENT lv_err_td_igc_cut_5 "Error bit for short cut to battery" UBYTE _CNV_S_2_RANGE______1_R_CM 1 100. 0. 255. DISPLAY_IDENTIFIER LV_ERR_TD_IGC_CUT_5 ECU_ADDRESS 0x3fb8c8 /end MEASUREMENT
/begin MEASUREMENT lv_err_dur_igc_1 "Error bit for short Burntime" UBYTE _CNV_S_2_RANGE______1_R_CM 1 100. 0. 255. DISPLAY_IDENTIFIER LV_ERR_DUR_IGC_1 ECU_ADDRESS 0x3fb8d0 /end MEASUREMENT
/begin MEASUREMENT lv_err_dur_igc_2 "Error bit for short Burntime" UBYTE _CNV_S_2_RANGE______1_R_CM 1 100. 0. 255. DISPLAY_IDENTIFIER LV_ERR_DUR_IGC_2 ECU_ADDRESS 0x3fb8d4 /end MEASUREMENT
/begin MEASUREMENT lv_err_dur_igc_3 "Error bit for short Burntime" UBYTE _CNV_S_2_RANGE______1_R_CM 1 100. 0. 255. DISPLAY_IDENTIFIER LV_ERR_DUR_IGC_3 ECU_ADDRESS 0x3fb8d8 /end MEASUREMENT
/begin MEASUREMENT lv_err_dur_igc_4 "Error bit for short Burntime" UBYTE _CNV_S_2_RANGE______1_R_CM 1 100. 0. 255. DISPLAY_IDENTIFIER LV_ERR_DUR_IGC_4 ECU_ADDRESS 0x3fb8dc /end MEASUREMENT
/begin MEASUREMENT lv_err_dur_igc_5 "Error bit for short Burntime" UBYTE _CNV_S_2_RANGE______1_R_CM 1 100. 0. 255. DISPLAY_IDENTIFIER LV_ERR_DUR_IGC_5 ECU_ADDRESS 0x3fb8e0 /end MEASUREMENT
/begin MEASUREMENT lv_err_dur_igc_0 "Error bit for short Burntime" UBYTE _CNV_S_2_RANGE______1_R_CM 1 100. 0. 255. DISPLAY_IDENTIFIER LV_ERR_DUR_IGC_0 ECU_ADDRESS 0x3fb8cc /end MEASUREMENT
/begin MEASUREMENT lv_inh_diag_isc "Flag for inhibitation of the idle speed control diagnosis" UBYTE _CNV_S_2_RANGE______21_CM 1 100. 0. 1. DISPLAY_IDENTIFIER LV_INH_DIAG_ISC ECU_ADDRESS 0x3fe8ed /end MEASUREMENT
/begin CHARACTERISTIC c_isapwm_ldc_max "Minimum value for limited dynamic condition" VALUE 0xffe4168a _REC_VAL_20_u2 99.99847412 _CNV_A_R_LINEAR_____8_CM 0. 99.99847412 DISPLAY_IDENTIFIER C_ISAPWM_LDC_MAX /end CHARACTERISTIC
/begin MEASUREMENT lv_err_ivvt "Global error flag IVVT" UBYTE _CNV_S_2_RANGE______1_R_CM 1 100. 0. 255. DISPLAY_IDENTIFIER LV_ERR_IVVT ECU_ADDRESS 0x3fe4ce /end MEASUREMENT
/begin MEASUREMENT lv_err_mec_ivvt_in_1 "IVVT 1 Error flag" UBYTE _CNV_S_2_RANGE______1_R_CM 1 100. 0. 255. DISPLAY_IDENTIFIER LV_ERR_MEC_IVVT_IN_1 ECU_ADDRESS 0x3fb85c /end MEASUREMENT
/begin MEASUREMENT lv_err_ref_ivvt_in_1 "IVVT 1 Error flag" UBYTE _CNV_S_2_RANGE______1_R_CM 1 100. 0. 255. DISPLAY_IDENTIFIER LV_ERR_REF_IVVT_IN_1 ECU_ADDRESS 0x3fb864 /end MEASUREMENT
/begin MEASUREMENT lv_err_mec_ivvt_ex_1 "IVVT 1 Error flag" UBYTE _CNV_S_2_RANGE______1_R_CM 1 100. 0. 255. DISPLAY_IDENTIFIER LV_ERR_MEC_IVVT_EX_1 ECU_ADDRESS 0x3fb860 /end MEASUREMENT
/begin MEASUREMENT lv_err_ref_ivvt_ex_1 "IVVT 1 Error flag" UBYTE _CNV_S_2_RANGE______1_R_CM 1 100. 0. 255. DISPLAY_IDENTIFIER LV_ERR_REF_IVVT_EX_1 ECU_ADDRESS 0x3fb868 /end MEASUREMENT
/begin CHARACTERISTIC c_t_dly_diag_ref_ivvt "Delaytime before IVVT" VALUE 0xffe40878 _REC_VAL_20_u1 25.5 _CNV_A_R_LINEAR_____24_CM 0. 25.5 DISPLAY_IDENTIFIER C_T_DLY_DIAG_REF_IVVT FORMAT "%4.1" /end CHARACTERISTIC
/begin CHARACTERISTIC c_cam_hys_diag_ivvt "Threshold for diagnosis IVVT mechanical reference position" VALUE 0xffe40641 _REC_VAL_20_u1 47.625 _CNV_A_R_LINEAR_____82_CM 0. 47.625 DISPLAY_IDENTIFIER C_CAM_HYS_DIAG_IVVT /end CHARACTERISTIC
/begin CHARACTERISTIC c_ctr_thd_ivvt_park "Maximum treshold for activation of IVVT parking function despite too high setpoint deviation or drift " VALUE 0xffe4158c _REC_VAL_20_u2 65535. _CNV_A_R_LINEAR_____0_CM 0. 65535. DISPLAY_IDENTIFIER C_CTR_THD_IVVT_PARK FORMAT "%5.0" /end CHARACTERISTIC
/begin MEASUREMENT lv_err_park_ivvt_in_1 "Error flag for park position error CAM IN 1" UBYTE _CNV_S_2_RANGE______1_R_CM 1 100. 0. 255. DISPLAY_IDENTIFIER LV_ERR_PARK_IVVT_IN_1 ECU_ADDRESS 0x3fb874 /end MEASUREMENT
/begin MEASUREMENT lv_err_park_ivvt_ex_1 "Error flag for park position error CAM EX 1" UBYTE _CNV_S_2_RANGE______1_R_CM 1 100. 0. 255. DISPLAY_IDENTIFIER LV_ERR_PARK_IVVT_EX_1 ECU_ADDRESS 0x3fb878 /end MEASUREMENT
/begin MEASUREMENT lv_err_knks_1 "Boolean for knock sensor 1 error currently active" UBYTE _CNV_S_2_RANGE______1_R_CM 1 100. 0. 255. DISPLAY_IDENTIFIER LV_ERR_KNKS_1 ECU_ADDRESS 0x3fb8ac /end MEASUREMENT
/begin MEASUREMENT lv_err_knks_2 "Boolean for knock sensor 2 error currently active" UBYTE _CNV_S_2_RANGE______1_R_CM 1 100. 0. 255. DISPLAY_IDENTIFIER LV_ERR_KNKS_2 ECU_ADDRESS 0x3fb8b0 /end MEASUREMENT
/begin CHARACTERISTIC c_n_min_knks_diag "Lower engine speed treshold for knock sensor diagnosis" VALUE 0xffe407f7 _REC_VAL_20_u1 8160. _CNV_A_R_LINEAR_____15_CM 0. 8160. DISPLAY_IDENTIFIER C_N_MIN_KNKS_DIAG FORMAT "%4.0" /end CHARACTERISTIC
/begin CHARACTERISTIC c_maf_min_knks_diag "Lower engine load treshold for knock sensor diagnosis" VALUE 0xffe417c6 _REC_VAL_20_u2 1389. _CNV_A_R_LINEAR_____108_CM 0. 1389. DISPLAY_IDENTIFIER C_MAF_MIN_KNKS_DIAG FORMAT "%7.2" /end CHARACTERISTIC
/begin CHARACTERISTIC c_nl_min_diag "Minimum noise level treshold" VALUE 0xffe4080b _REC_VAL_20_u1 4.998 _CNV_A_R_LINEAR_____44_CM 0. 4.998 DISPLAY_IDENTIFIER C_NL_MIN_DIAG FORMAT "%6.4" /end CHARACTERISTIC
/begin CHARACTERISTIC c_nl_max_diag "Maximum noise level treshold" VALUE 0xffe40809 _REC_VAL_20_u1 4.998 _CNV_A_R_LINEAR_____44_CM 0. 4.998 DISPLAY_IDENTIFIER C_NL_MAX_DIAG FORMAT "%6.4" /end CHARACTERISTIC
/begin CHARACTERISTIC c_n_min_maf_diag "Engine speed condition" VALUE 0xffe407f9 _REC_VAL_20_u1 2448. _CNV_A_R_LINEAR_____15_CM 0. 8160. DISPLAY_IDENTIFIER C_N_MIN_MAF_DIAG FORMAT "%4.0" /end CHARACTERISTIC
/begin CHARACTERISTIC c_maf_min_diag "max. mass air flow diagnostic threshold" VALUE 0xffe417c4 _REC_VAL_20_u2 614.390625 _CNV_A_R_LINEAR_____115_CM 0. 2047.96875 DISPLAY_IDENTIFIER C_MAF_MIN_DIAG FORMAT "%7.2" /end CHARACTERISTIC
/begin CHARACTERISTIC c_isapwm_maf_min_isa_diag "ISAPWM_ISA-condition" VALUE 0xffe4168c _REC_VAL_20_u2 99.99847412 _CNV_A_R_LINEAR_____8_CM 0. 99.99847412 DISPLAY_IDENTIFIER C_ISAPWM_MAF_MIN_ISA_DIAG /end CHARACTERISTIC
/begin CHARACTERISTIC c_maf_kgh_diag_ini "Set point for MAF_KGH_DIAG at transition out of start" VALUE 0xffe4179c _REC_VAL_20_u2 2047.96875 _CNV_A_R_LINEAR_____115_CM 0. 2047.96875 DISPLAY_IDENTIFIER C_MAF_KGH_DIAG_INI FORMAT "%7.2" /end CHARACTERISTIC
/begin MEASUREMENT pq_turb_sys "Substitute Mass air flow on ISA " UBYTE _CNV_A_R_LINEAR_____29_CM 1 100. 0. 0.99610001 DISPLAY_IDENTIFIER PQ_TURB_SYS ECU_ADDRESS 0x3fe483 FORMAT "%5.3" /end MEASUREMENT
/begin MEASUREMENT maf_sub_isa "Substitute Mass air flow on ISA " UWORD _CNV_A_R_LINEAR_____108_CM 1 100. 0. 1389. DISPLAY_IDENTIFIER MAF_SUB_ISA ECU_ADDRESS 0x3fd23c BYTE_ORDER MSB_LAST FORMAT "%7.2" /end MEASUREMENT
/begin MEASUREMENT maf_kgh_diag "Substitute Mass air flow on ISA " UWORD _CNV_A_R_LINEAR_____115_CM 1 100. 0. 2047.96875 DISPLAY_IDENTIFIER MAF_KGH_DIAG ECU_ADDRESS 0x3fd23e BYTE_ORDER MSB_LAST FORMAT "%7.2" /end MEASUREMENT
/begin CHARACTERISTIC id_crlc_maf_diag__n_32 "Mittelungskonstante zur Mittelung des Luftmassen-Diagnosewertes" CURVE 0xffe40a01 _REC_CUR_20_u1_u1 0.99610001 _CNV_A_R_LINEAR_____29_CM 0. 0.99610001 DISPLAY_IDENTIFIER ID_CRLC_MAF_DIAG__N_32 FORMAT "%5.3"
 /begin AXIS_DESCR COM_AXIS n_32 _CNV_A_R_LINEAR_____15_CM 4 0. 8160. FORMAT "%4.0" AXIS_PTS_REF ldp_n_32__crlc_maf_diag /end AXIS_DESCR
/end CHARACTERISTIC
/begin CHARACTERISTIC ip_maf_max_isa__pq_turb_sys "max. mass Air flow thru ISA" CURVE 0xffe4ce3e _REC_CUR_20_u2_u1 2047.96875 _CNV_A_R_LINEAR_____115_CM 0. 2047.96875 DISPLAY_IDENTIFIER IP_MAF_MAX_ISA__PQ_TURB_SYS FORMAT "%7.2"
 /begin AXIS_DESCR COM_AXIS n_32 _CNV_A_R_LINEAR_____29_CM 6 0. 0.99610001 FORMAT "%5.3" AXIS_PTS_REF ldpm_pq_turb_sys /end AXIS_DESCR
/end CHARACTERISTIC
/begin CHARACTERISTIC c_maf_max_diag "min. mass air flow diagnostic threshold" VALUE 0xffe417b4 _REC_VAL_20_u2 614.390625 _CNV_A_R_LINEAR_____115_CM 0. 2047.96875 DISPLAY_IDENTIFIER C_MAF_MAX_DIAG FORMAT "%7.2" /end CHARACTERISTIC
/begin CHARACTERISTIC c_fac_tq_req_min_maf_diag "" VALUE 0xffe4164a _REC_VAL_20_u2 0.599990844 _CNV_A_R_LINEAR_____20_CM 0. 1.99996948 DISPLAY_IDENTIFIER C_FAC_TQ_REQ_MIN_MAF_DIAG FORMAT "%7.5" /end CHARACTERISTIC
/begin MEASUREMENT lv_maf_bls_diag "MAF error anf break active" UBYTE _CNV_S_2_RANGE______2_CM 1 100. 0. 1. DISPLAY_IDENTIFIER LV_MAF_BLS_DIAG ECU_ADDRESS 0x3fe482 /end MEASUREMENT
/begin AXIS_PTS ldp_n_32__crlc_maf_diag "" 0xffe4107f n_32 _REC_AXS_20_u1 8160. _CNV_A_R_LINEAR_____15_CM 4 0. 8160. DISPLAY_IDENTIFIER LDP_N_32__CRLC_MAF_DIAG FORMAT "%4.0" /end AXIS_PTS
/begin AXIS_PTS ldpm_pq_turb_sys "" 0xffe41407 n_32 _REC_AXS_20_u1 0.99610001 _CNV_A_R_LINEAR_____29_CM 6 0. 0.99610001 DISPLAY_IDENTIFIER LDPM_PQ_TURB_SYS FORMAT "%5.3" /end AXIS_PTS
/begin AXIS_PTS ldp_isapwm__fac_pq_isa "" 0xffe50bf6 isapwm _REC_AXS_20_u2 99.99847412 _CNV_A_R_LINEAR_____8_CM 4 0. 99.99847412 DISPLAY_IDENTIFIER LDP_ISAPWM__FAC_PQ_ISA /end AXIS_PTS
/begin CHARACTERISTIC ip_fac_pq_isa__isapwm "Correction manifold/ turbulence pressure" CURVE 0xffe40bc9 _REC_CUR_20_u1_u2 1.99220002 _CNV_A_R_LINEAR_____39_CM 0. 1.99220002 DISPLAY_IDENTIFIER IP_FAC_PQ_ISA__ISAPWM FORMAT "%5.3"
 /begin AXIS_DESCR COM_AXIS isapwm _CNV_A_R_LINEAR_____8_CM 4 0. 99.99847412 AXIS_PTS_REF ldp_isapwm__fac_pq_isa /end AXIS_DESCR
/end CHARACTERISTIC
/begin MEASUREMENT lv_err_maf "MAF error detected" UBYTE _CNV_S_2_RANGE______1_R_CM 1 100. 0. 255. DISPLAY_IDENTIFIER LV_ERR_MAF ECU_ADDRESS 0x3fb808 /end MEASUREMENT
/begin CHARACTERISTIC c_t_min_msw_bit_diag "Min. diagnostic threshold - Toggle bit monitoring" VALUE 0xffe408b5 _REC_VAL_20_u1 2550. _CNV_A_R_LINEAR_____406_CM 10. 2560. DISPLAY_IDENTIFIER C_T_MIN_MSW_BIT_DIAG FORMAT "%5.0" /end CHARACTERISTIC
/begin CHARACTERISTIC c_t_max_msw_bit_diag "Max. diagnostic threshold - Toggle bit monitoring" VALUE 0xffe408a8 _REC_VAL_20_u1 2550. _CNV_A_R_LINEAR_____406_CM 10. 2560. DISPLAY_IDENTIFIER C_T_MAX_MSW_BIT_DIAG FORMAT "%5.0" /end CHARACTERISTIC
/begin MEASUREMENT lv_err_msw_3 "???" UBYTE _CNV_S_2_RANGE______21_CM 1 100. 0. 1. DISPLAY_IDENTIFIER LV_ERR_MSW_3 ECU_ADDRESS 0x3fb9b4 /end MEASUREMENT
/begin MEASUREMENT lv_err_msw_tog "???" UBYTE _CNV_S_2_RANGE______21_CM 1 100. 0. 1. DISPLAY_IDENTIFIER LV_ERR_MSW_TOG ECU_ADDRESS 0x3fb9ac /end MEASUREMENT
/begin MEASUREMENT lv_err_msw_2 "???" UBYTE _CNV_S_2_RANGE______21_CM 1 100. 0. 1. DISPLAY_IDENTIFIER LV_ERR_MSW_2 ECU_ADDRESS 0x3fb9b0 /end MEASUREMENT
/begin CHARACTERISTIC c_v_pvs_min_diag_2 "lower diagnosis-threshold channel 2" VALUE 0xffe41afc _REC_VAL_20_u2 4.99511719 _CNV_A_R_LINEAR_____3_CM 0. 4.99511719 DISPLAY_IDENTIFIER C_V_PVS_MIN_DIAG_2 FORMAT "%5.3" /end CHARACTERISTIC
/begin CHARACTERISTIC c_t_is_pvs_err "Minimum idle dwell time in error cases" VALUE 0xffe4089a _REC_VAL_20_u1 2.55 _CNV_A_R_LINEAR_____4_CM 0. 2.55 DISPLAY_IDENTIFIER C_T_IS_PVS_ERR FORMAT "%4.2" /end CHARACTERISTIC
/begin CHARACTERISTIC ip_pvs_ratio_hys "permissible variance of the PVS-values" CURVE 0xffe41c94 _REC_CUR_20_u2_u2 4.99511719 _CNV_A_R_LINEAR_____3_CM 0. 4.99511719 DISPLAY_IDENTIFIER IP_PVS_RATIO_HYS FORMAT "%5.3"
 /begin AXIS_DESCR COM_AXIS online_dummy _CNV_A_R_LINEAR_____3_CM 2 0. 4.99511719 FORMAT "%5.3" AXIS_PTS_REF ldp_v_pvs_min /end AXIS_DESCR
/end CHARACTERISTIC
/begin MEASUREMENT lv_dyn_lim_1_act "Limited dynamic 1 is  active / passive" UBYTE _CNV_S_2_RANGE______2_CM 1 100. 0. 1. DISPLAY_IDENTIFIER LV_DYN_LIM_1_ACT ECU_ADDRESS 0x3fe60d BIT_MASK 0x1 /end MEASUREMENT
/begin MEASUREMENT lv_dyn_lim_2_act "Limited dynamic 2 is  active / passive" UBYTE _CNV_S_2_RANGE______2_CM 1 100. 0. 1. DISPLAY_IDENTIFIER LV_DYN_LIM_2_ACT ECU_ADDRESS 0x3fe60e BIT_MASK 0x1 /end MEASUREMENT
/begin MEASUREMENT state_pvs_diag "Status of PVS-diagnosis" UBYTE _CNV_S_9_RANGE_STAT_451_CM 1 100. 0. 128. DISPLAY_IDENTIFIER STATE_PVS_DIAG ECU_ADDRESS 0x3fe60c /end MEASUREMENT
/begin MEASUREMENT lv_n_sp_is_lih_act "LIH idle speed setpoint" UBYTE _CNV_S_2_RANGE______21_CM 1 100. 0. 1. DISPLAY_IDENTIFIER LV_N_SP_IS_LIH_ACT ECU_ADDRESS 0x3fe610 BIT_MASK 0x1 /end MEASUREMENT
/begin MEASUREMENT lv_err_pvs "Logical value (set, if a PVS -error is debounced)" UBYTE _CNV_S_2_RANGE______1_R_CM 1 100. 0. 255. DISPLAY_IDENTIFIER LV_ERR_PVS ECU_ADDRESS 0x3fe609 /end MEASUREMENT
/begin MEASUREMENT lv_det_not_plaus_act "PV_AV / Brake signal current not plausible" UBYTE _CNV_S_2_RANGE______2_CM 1 100. 0. 1. DISPLAY_IDENTIFIER LV_DET_NOT_PLAUS_ACT ECU_ADDRESS 0x3fe60b /end MEASUREMENT
/begin CHARACTERISTIC c_n_pvs_bls_bts_plaus "Activation threshold for N  " VALUE 0xffe407fd _REC_VAL_20_u1 8160. _CNV_A_R_LINEAR_____15_CM 0. 8160. DISPLAY_IDENTIFIER C_N_PVS_BLS_BTS_PLAUS FORMAT "%4.0" /end CHARACTERISTIC
/begin CHARACTERISTIC c_vs_pvs_bls_bts_plaus "Activation threshold for VS  " VALUE 0xffe409e9 _REC_VAL_20_u1 255. _CNV_A_R_LINEAR_____23_CM 0. 255. DISPLAY_IDENTIFIER C_VS_PVS_BLS_BTS_PLAUS FORMAT "%3.0" /end CHARACTERISTIC
/begin CHARACTERISTIC c_pv_av_pvs_bls_bts_plaus "Activation threshold for PV_AV" VALUE 0xffe40828 _REC_VAL_20_u1 99.609375 _CNV_A_R_LINEAR_____9_CM 0. 99.609375 DISPLAY_IDENTIFIER C_PV_AV_PVS_BLS_BTS_PLAUS FORMAT "%4.1" /end CHARACTERISTIC
/begin CHARACTERISTIC c_ctr_max_pv_av_con "PV_AV_CON counter maximum value" VALUE 0xffe406d3 _REC_VAL_20_u1 255. _CNV_A_R_LINEAR_____0_CM 0. 255. DISPLAY_IDENTIFIER C_CTR_MAX_PV_AV_CON FORMAT "%3.0" /end CHARACTERISTIC
/begin CHARACTERISTIC c_pv_av_hys_bls_bts_plaus "Threshold for detection of a constant pedal value" VALUE 0xffe40827 _REC_VAL_20_u1 99.609375 _CNV_A_R_LINEAR_____9_CM 0. 99.609375 DISPLAY_IDENTIFIER C_PV_AV_HYS_BLS_BTS_PLAUS FORMAT "%4.1" /end CHARACTERISTIC
/begin MEASUREMENT lv_pv_av_stat "Recognisation of constant pedal value" UBYTE _CNV_S_2_RANGE______2_CM 1 100. 0. 1. DISPLAY_IDENTIFIER LV_PV_AV_STAT_ ECU_ADDRESS 0x3fe617 /end MEASUREMENT
/begin MEASUREMENT lv_pvs_bls_not_plaus_act "Plausibility error PVS recognized without error entry" UBYTE _CNV_S_2_RANGE______2_CM 1 100. 0. 1. DISPLAY_IDENTIFIER LV_PVS_BLS_NOT_PLAUS_ACT ECU_ADDRESS 0x3fe60a /end MEASUREMENT
/begin MEASUREMENT ctr_pvs_bls_not_plaus_act "Counter plausibility error PVS recognized without error entry" UBYTE _CNV_A_R_LINEAR_____0_CM 1 100. 0. 255. DISPLAY_IDENTIFIER CTR_PVS_BLS_NOT_PLAUS_ACT ECU_ADDRESS 0x3fe611 FORMAT "%3.0" /end MEASUREMENT
/begin CHARACTERISTIC c_pvs_bls_bts_plaus_conf "Enable bit for plausibility check" VALUE 0xffe4082d _REC_VAL_20_u1 2. _CNV_A_R_LINEAR_____0_CM 0. 2. DISPLAY_IDENTIFIER C_PVS_BLS_BTS_PLAUS_CONF FORMAT "%2.0" /end CHARACTERISTIC
/begin AXIS_PTS ldp_v_pvs_min "" 0xffe41d1c online_dummy _REC_AXS_20_u2 4.99511719 _CNV_A_R_LINEAR_____3_CM 2 0. 4.99511719 DISPLAY_IDENTIFIER LDP_V_PVS_MIN FORMAT "%5.3" /end AXIS_PTS
/begin MEASUREMENT lv_err_v_ref_2 "Logical value (set, if supply voltage PVS- Channel 2 debounced)" UBYTE _CNV_S_2_RANGE______1_R_CM 1 100. 0. 255. DISPLAY_IDENTIFIER LV_ERR_V_REF_2 ECU_ADDRESS 0x3fb8f8 /end MEASUREMENT
/begin MEASUREMENT lv_err_pvs_double "Logical value (set, if a PVS double error is present)" UBYTE _CNV_S_2_RANGE______1_R_CM 1 100. 0. 255. DISPLAY_IDENTIFIER LV_ERR_PVS_DOUBLE ECU_ADDRESS 0x3fb908 /end MEASUREMENT
/begin MEASUREMENT lv_err_v_ref_1 "Logical value (set, if supply voltage PVS- Channel 1  debounced)" UBYTE _CNV_S_2_RANGE______1_R_CM 1 100. 0. 255. DISPLAY_IDENTIFIER LV_ERR_V_REF_1 ECU_ADDRESS 0x3fb8f4 /end MEASUREMENT
/begin MEASUREMENT lv_err_pvs_bls_not_plaus "Plausibility error PVS / Brake recognized" UBYTE _CNV_S_2_RANGE______2_CM 1 100. 0. 1. DISPLAY_IDENTIFIER LV_ERR_PVS_BLS_NOT_PLAUS ECU_ADDRESS 0x3fb90c /end MEASUREMENT
/begin MEASUREMENT lv_det_err_pvs "Logical value (set, if a PVS-error is present)" UBYTE _CNV_S_2_RANGE______2_CM 1 100. 0. 1. DISPLAY_IDENTIFIER LV_DET_ERR_PVS ECU_ADDRESS 0x3fe616 /end MEASUREMENT
/begin CHARACTERISTIC c_vcc_dif_pvs "max. permissible variance of the supply voltage of 10V" VALUE 0xffe41b30 _REC_VAL_20_u2 9.9902 _CNV_A_R_LINEAR_____43_CM 0. 9.9902 DISPLAY_IDENTIFIER C_VCC_DIF_PVS FORMAT "%5.3" /end CHARACTERISTIC
/begin CHARACTERISTIC c_v_pvs_min_diag_1 "lower diagnosis-threshold channel 1" VALUE 0xffe41afa _REC_VAL_20_u2 4.99511719 _CNV_A_R_LINEAR_____3_CM 0. 4.99511719 DISPLAY_IDENTIFIER C_V_PVS_MIN_DIAG_1 FORMAT "%5.3" /end CHARACTERISTIC
/begin CHARACTERISTIC c_v_pvs_min_diag_min_1 "Upper diagnosis threshold for switching from faulty channel to error-free" VALUE 0xffe41afe _REC_VAL_20_u2 4.99511719 _CNV_A_R_LINEAR_____3_CM 0. 4.99511719 DISPLAY_IDENTIFIER C_V_PVS_MIN_DIAG_MIN_1 FORMAT "%5.3" /end CHARACTERISTIC
/begin CHARACTERISTIC c_v_pvs_min_diag_min_2 "Upper diagnosis threshold for switching from faulty channel to error-free" VALUE 0xffe41b00 _REC_VAL_20_u2 4.99511719 _CNV_A_R_LINEAR_____3_CM 0. 4.99511719 DISPLAY_IDENTIFIER C_V_PVS_MIN_DIAG_MIN_2 FORMAT "%5.3" /end CHARACTERISTIC
/begin MEASUREMENT lv_err_pvs_2 "Logical value (set, if PVS - Channel 2 has debounced a range error)" UBYTE _CNV_S_2_RANGE______1_R_CM 1 100. 0. 255. DISPLAY_IDENTIFIER LV_ERR_PVS_2 ECU_ADDRESS 0x3fb900 /end MEASUREMENT
/begin MEASUREMENT lv_err_pvs_ratio "Logical value (set, if a synchronous error between PVS_1 and PVS_2 is debounced)" UBYTE _CNV_S_2_RANGE______1_R_CM 1 100. 0. 255. DISPLAY_IDENTIFIER LV_ERR_PVS_RATIO ECU_ADDRESS 0x3fb904 /end MEASUREMENT
/begin MEASUREMENT lv_err_pvs_1 "Logical value (set, if PVS - Channel 1 has debounced a range error)" UBYTE _CNV_S_2_RANGE______1_R_CM 1 100. 0. 255. DISPLAY_IDENTIFIER LV_ERR_PVS_1 ECU_ADDRESS 0x3fb8fc /end MEASUREMENT
/begin MEASUREMENT t_rly_main_diag "Time window to perform the main relay diagnosis" UBYTE _CNV_A_R_LINEAR_____31_CM 1 100. 0. 2550. DISPLAY_IDENTIFIER T_RLY_MAIN_DIAG ECU_ADDRESS 0x3fe9f0 FORMAT "%4.0" /end MEASUREMENT
/begin CHARACTERISTIC c_t_rly_main_diag "Time window to perform the main relay diagnosis" VALUE 0xffe408ca _REC_VAL_20_u1 2550. _CNV_A_R_LINEAR_____31_CM 0. 2550. DISPLAY_IDENTIFIER C_T_RLY_MAIN_DIAG FORMAT "%4.0" /end CHARACTERISTIC
/begin CHARACTERISTIC c_vb_rly_main_diag "Voltage threshold for detection of battery voltage present" VALUE 0xffe409c5 _REC_VAL_20_u1 25.8984 _CNV_A_R_LINEAR_____34_CM 0. 25.8984 DISPLAY_IDENTIFIER C_VB_RLY_MAIN_DIAG FORMAT "%3.1" /end CHARACTERISTIC
/begin CHARACTERISTIC c_v_igk_rly_main_diag "Voltage threshold for detection of main relay on" VALUE 0xffe4099a _REC_VAL_20_u1 25.8984 _CNV_A_R_LINEAR_____34_CM 0. 25.8984 DISPLAY_IDENTIFIER C_V_IGK_RLY_MAIN_DIAG FORMAT "%3.1" /end CHARACTERISTIC
/begin CHARACTERISTIC c_t_dly_rly_main_diag "Delay time for the diagnosis to allow switching of the relay" VALUE 0xffe40891 _REC_VAL_20_u1 2550. _CNV_A_R_LINEAR_____31_CM 0. 2550. DISPLAY_IDENTIFIER C_T_DLY_RLY_MAIN_DIAG FORMAT "%4.0" /end CHARACTERISTIC
/begin CHARACTERISTIC c_t_predrive_dly_max "Maximum predrive check delay" VALUE 0xffe408c5 _REC_VAL_20_u1 2550. _CNV_A_R_LINEAR_____31_CM 0. 2550. DISPLAY_IDENTIFIER C_T_PREDRIVE_DLY_MAX FORMAT "%4.0" /end CHARACTERISTIC
/begin MEASUREMENT lv_err_bn_veh_mod "Present error BN2000" UBYTE _CNV_S_2_RANGE______1_R_CM 1 100. 0. 255. DISPLAY_IDENTIFIER LV_ERR_BN_VEH_MOD ECU_ADDRESS 0x3fbadc /end MEASUREMENT
/begin MEASUREMENT lv_err_rly_main_dly "Present error BN2000" UBYTE _CNV_S_2_RANGE______1_R_CM 1 100. 0. 255. DISPLAY_IDENTIFIER LV_ERR_RLY_MAIN_DLY ECU_ADDRESS 0x3fb974 /end MEASUREMENT
/begin MEASUREMENT lv_err_rly_main "Boolean for error detected at the main relay" UBYTE _CNV_S_2_RANGE______1_R_CM 1 100. 0. 255. DISPLAY_IDENTIFIER LV_ERR_RLY_MAIN ECU_ADDRESS 0x3fb970 /end MEASUREMENT
/begin MEASUREMENT lv_err_lsh_down_2 "Boolean error flag, fault currently present on upstream oxygen sensor heater circuit 2" UBYTE _CNV_S_2_RANGE______5_R_CM 1 100. 0. 255. DISPLAY_IDENTIFIER LV_ERR_LSH_DOWN_2 ECU_ADDRESS 0x3fb850 /end MEASUREMENT
/begin MEASUREMENT lv_err_amp "Error of the ambient pressure sensor" UBYTE _CNV_S_2_RANGE______1_R_CM 1 100. 0. 255. DISPLAY_IDENTIFIER LV_ERR_AMP ECU_ADDRESS 0x3fb804 /end MEASUREMENT
/begin MEASUREMENT tco_dif_diag "Difference between minimum and maximum measured coolant temperature value." UBYTE _CNV_A_R_LINEAR_____12_CM 1 100. 0. 190.5 DISPLAY_IDENTIFIER TCO_DIF_DIAG ECU_ADDRESS 0x3fe667 FORMAT "%5.1" /end MEASUREMENT
/begin MEASUREMENT tco_min_diag "Measured coolant temperature minimum value." UBYTE _CNV_A_R_LINEAR_____11_CM 1 100. -48. 142.5 DISPLAY_IDENTIFIER TCO_MIN_DIAG ECU_ADDRESS 0x3fe668 FORMAT "%5.1" /end MEASUREMENT
/begin MEASUREMENT tco_max_diag "Measured coolant temperature maximum value." UBYTE _CNV_A_R_LINEAR_____11_CM 1 100. -48. 142.5 DISPLAY_IDENTIFIER TCO_MAX_DIAG ECU_ADDRESS 0x3fe669 FORMAT "%5.1" /end MEASUREMENT
/begin MEASUREMENT tco_sub_dif_diag "Difference between minimum and maximum substitute coolant temperature value." UBYTE _CNV_A_R_LINEAR_____12_CM 1 100. 0. 190.5 DISPLAY_IDENTIFIER TCO_SUB_DIF_DIAG ECU_ADDRESS 0x3fe66a FORMAT "%5.1" /end MEASUREMENT
/begin MEASUREMENT tco_sub_min_diag "Substitute coolant temperature minimum value." UBYTE _CNV_A_R_LINEAR_____11_CM 1 100. -48. 142.5 DISPLAY_IDENTIFIER TCO_SUB_MIN_DIAG ECU_ADDRESS 0x3fe66b FORMAT "%5.1" /end MEASUREMENT
/begin MEASUREMENT tco_sub_max_diag "Substitute coolant temperature maximum value." UBYTE _CNV_A_R_LINEAR_____11_CM 1 100. -48. 142.5 DISPLAY_IDENTIFIER TCO_SUB_MAX_DIAG ECU_ADDRESS 0x3fe66c FORMAT "%5.1" /end MEASUREMENT
/begin CHARACTERISTIC ip_tco_sub_dif_min_diag__tco_st "Minimum substitute coolant temperature increase to perform stuck signal diagnosis" CURVE 0xffe40e74 _REC_CUR_20_u1_u1 190.5 _CNV_A_R_LINEAR_____12_CM 0. 190.5 DISPLAY_IDENTIFIER IP_TCO_SUB_DIF_MIN_DIAG__TCO_ST FORMAT "%5.1"
 /begin AXIS_DESCR COM_AXIS tco_st _CNV_A_R_LINEAR_____11_CM 6 -48. 142.5 FORMAT "%5.1" AXIS_PTS_REF ldpm_tco_st__tco_dif_diag /end AXIS_DESCR
/end CHARACTERISTIC
/begin CHARACTERISTIC ip_tco_mes_dif_min_diag__tco_st "Minimum measured coolant temperature increase to detect a stuck signal" CURVE 0xffe40e6e _REC_CUR_20_u1_u1 190.5 _CNV_A_R_LINEAR_____12_CM 0. 190.5 DISPLAY_IDENTIFIER IP_TCO_MES_DIF_MIN_DIAG__TCO_ST FORMAT "%5.1"
 /begin AXIS_DESCR COM_AXIS tco_st _CNV_A_R_LINEAR_____11_CM 6 -48. 142.5 FORMAT "%5.1" AXIS_PTS_REF ldpm_tco_st__tco_dif_diag /end AXIS_DESCR
/end CHARACTERISTIC
/begin MEASUREMENT lv_err_tco "TCO error detected" UBYTE _CNV_S_2_RANGE______5_R_CM 1 100. 0. 255. DISPLAY_IDENTIFIER LV_ERR_TCO ECU_ADDRESS 0x3fe666 /end MEASUREMENT
/begin AXIS_PTS ldpm_tco_st__tco_dif_diag "" 0xffe4145e tco_st _REC_AXS_20_u1 190.5 _CNV_A_R_LINEAR_____11_CM 6 -48. 142.5 DISPLAY_IDENTIFIER LDPM_TCO_ST__TCO_DIF_DIAG FORMAT "%5.1" /end AXIS_PTS
/begin MEASUREMENT lv_err_tco_el "TCO Signal range error active/passive" UBYTE _CNV_S_2_RANGE______5_R_CM 1 100. 0. 255. DISPLAY_IDENTIFIER LV_ERR_TCO_EL ECU_ADDRESS 0x3fb98c /end MEASUREMENT
/begin MEASUREMENT lv_err_tco_stuck "TCO Stuck signal detected" UBYTE _CNV_S_2_RANGE______5_R_CM 1 100. 0. 255. DISPLAY_IDENTIFIER LV_ERR_TCO_STUCK ECU_ADDRESS 0x3fb994 /end MEASUREMENT
/begin MEASUREMENT lv_err_tco_grd "Boolean for error currently present on coolant temperature signal (gradient of the signal implausible)." UBYTE _CNV_S_2_RANGE______5_R_CM 1 100. 0. 255. DISPLAY_IDENTIFIER LV_ERR_TCO_GRD ECU_ADDRESS 0x3fb990 /end MEASUREMENT
/begin MEASUREMENT lv_err_tco_plaus "Boolean for error currently present on TCO-sensor." UBYTE _CNV_S_2_RANGE______5_R_CM 1 100. 0. 255. DISPLAY_IDENTIFIER LV_ERR_TCO_PLAUS ECU_ADDRESS 0x3fb988 /end MEASUREMENT
/begin CHARACTERISTIC c_t_tia_tco_diag "Time condition - TIA diagnosis" VALUE 0xffe41a18 _REC_VAL_20_u2 65534. _CNV_A_R_LINEAR_____30_CM 1. 65535. DISPLAY_IDENTIFIER C_T_TIA_TCO_DIAG FORMAT "%5.0" /end CHARACTERISTIC
/begin CHARACTERISTIC c_tco_grd_max_diag "Maximum allowed gradient for the coolant temperature signal" VALUE 0xffe40901 _REC_VAL_20_u1 38.1 _CNV_A_R_LINEAR_____12_CM 0. 190.5 DISPLAY_IDENTIFIER C_TCO_GRD_MAX_DIAG FORMAT "%5.1" /end CHARACTERISTIC
/begin CHARACTERISTIC c_tco_max_diag "maximum permissible coolant temperature" VALUE 0xffe40906 _REC_VAL_20_u1 28.575 _CNV_A_R_LINEAR_____11_CM -48. 142.5 DISPLAY_IDENTIFIER C_TCO_MAX_DIAG FORMAT "%5.1" /end CHARACTERISTIC
/begin CHARACTERISTIC c_tco_min_diag "minimum permissible coolant temperature" VALUE 0xffe4090f _REC_VAL_20_u1 28.575 _CNV_A_R_LINEAR_____11_CM -48. 142.5 DISPLAY_IDENTIFIER C_TCO_MIN_DIAG FORMAT "%5.1" /end CHARACTERISTIC
/begin CHARACTERISTIC c_tia_tco_diag "TIA condition - TCO_EX diagnosis" VALUE 0xffe4096a _REC_VAL_20_u1 190.5 _CNV_A_R_LINEAR_____11_CM -48. 142.5 DISPLAY_IDENTIFIER C_TIA_TCO_DIAG FORMAT "%5.1" /end CHARACTERISTIC
/begin CHARACTERISTIC c_t_tia_tco_ex_diag "Time condition - TCO_EX diagnosis" VALUE 0xffe41a1a _REC_VAL_20_u2 65534. _CNV_A_R_LINEAR_____30_CM 1. 65535. DISPLAY_IDENTIFIER C_T_TIA_TCO_EX_DIAG FORMAT "%5.0" /end CHARACTERISTIC
/begin MEASUREMENT lv_err_tco_ex "TCO_EX error detected" UBYTE _CNV_S_2_RANGE______1_R_CM 1 100. 0. 255. DISPLAY_IDENTIFIER LV_ERR_TCO_EX ECU_ADDRESS 0x3fb7fc /end MEASUREMENT
/begin MEASUREMENT t_tco_min "Time after start where TCO Plaus diagnosis is inhibited" UWORD _CNV_A_R_LINEAR_____30_CM 1 100. 0. 65535. DISPLAY_IDENTIFIER T_TCO_MIN ECU_ADDRESS 0x3fd6c6 BYTE_ORDER MSB_LAST FORMAT "%5.0" /end MEASUREMENT
/begin CHARACTERISTIC id_t_tco_min__tco_st "Locking time after start for lambda activation monitoring" CURVE 0xffe48dfc _REC_CUR_20_u2_u1 65534. _CNV_A_R_LINEAR_____30_CM 1. 65535. DISPLAY_IDENTIFIER ID_T_TCO_MIN__TCO_ST FORMAT "%5.0"
 /begin AXIS_DESCR COM_AXIS tco_st _CNV_A_R_LINEAR_____11_CM 6 -48. 142.5 FORMAT "%5.1" AXIS_PTS_REF ldp_tco_st_id_t_tco_min /end AXIS_DESCR
/end CHARACTERISTIC
/begin AXIS_PTS ldp_tco_st_id_t_tco_min "Locking time after start for lambda activation monitoring" 0xffe41231 tco_st _REC_AXS_20_u1 190.5 _CNV_A_R_LINEAR_____11_CM 6 -48. 142.5 DISPLAY_IDENTIFIER LDP_TCO_ST_ID_T_TCO_MIN FORMAT "%5.1" /end AXIS_PTS
/begin AXIS_PTS ldpm_tia_1 "" 0xffe41473 tia _REC_AXS_20_u1 190.5 _CNV_A_R_LINEAR_____11_CM 6 -48. 142.5 DISPLAY_IDENTIFIER LDPM_TIA_1 FORMAT "%5.1" /end AXIS_PTS
/begin MEASUREMENT lv_err_tout_icl_2 "logical variable timeout error CAN message INSTR2" UBYTE _CNV_S_2_RANGE______1_R_CM 1 100. 0. 255. DISPLAY_IDENTIFIER LV_ERR_TOUT_ICL_2 ECU_ADDRESS 0x3fb88c /end MEASUREMENT
/begin MEASUREMENT lv_err_tout_icl_3 "logical variable timeout error CAN message INSTR3" UBYTE _CNV_S_2_RANGE______1_R_CM 1 100. 0. 255. DISPLAY_IDENTIFIER LV_ERR_TOUT_ICL_3 ECU_ADDRESS 0x3fb890 /end MEASUREMENT
/begin MEASUREMENT lv_err_tia "TIA error detected" UBYTE _CNV_S_2_RANGE______1_R_CM 1 100. 0. 255. DISPLAY_IDENTIFIER LV_ERR_TIA ECU_ADDRESS 0x3fb800 /end MEASUREMENT
/begin CHARACTERISTIC c_tia_max_diag "TIA threshold for short to ground - TIA diagnosis" VALUE 0xffe4095f _REC_VAL_20_u1 28.575 _CNV_A_R_LINEAR_____11_CM -48. 142.5 DISPLAY_IDENTIFIER C_TIA_MAX_DIAG FORMAT "%5.1" /end CHARACTERISTIC
/begin CHARACTERISTIC c_tia_min_diag "TIA threshold for short to VB or line break - TIA diagnosis" VALUE 0xffe40964 _REC_VAL_20_u1 28.575 _CNV_A_R_LINEAR_____11_CM -48. 142.5 DISPLAY_IDENTIFIER C_TIA_MIN_DIAG FORMAT "%5.1" /end CHARACTERISTIC
/begin CHARACTERISTIC c_v_tps_min_diag_1 "lower diagnostic voltage, pot  1" VALUE 0xffe41b1e _REC_VAL_20_u2 4.99511719 _CNV_A_R_LINEAR_____3_CM 0. 4.99511719 DISPLAY_IDENTIFIER C_V_TPS_MIN_DIAG_1 FORMAT "%5.3" /end CHARACTERISTIC
/begin CHARACTERISTIC c_v_tps_min_diag_2 "lower diagnostic voltage, pot  2" VALUE 0xffe41b20 _REC_VAL_20_u2 4.99511719 _CNV_A_R_LINEAR_____3_CM 0. 4.99511719 DISPLAY_IDENTIFIER C_V_TPS_MIN_DIAG_2 FORMAT "%5.3" /end CHARACTERISTIC
/begin CHARACTERISTIC c_v_tps_max_diag_2 "upper diagnostic voltage, pot  2" VALUE 0xffe41b1c _REC_VAL_20_u2 4.99511719 _CNV_A_R_LINEAR_____3_CM 0. 4.99511719 DISPLAY_IDENTIFIER C_V_TPS_MAX_DIAG_2 FORMAT "%5.3" /end CHARACTERISTIC
/begin MEASUREMENT tps_maf_dif_2 "Deviation of the substitute DK angle from TPS_2" UWORD _CNV_A_R_LINEAR_____108_CM 1 100. 0. 1389. DISPLAY_IDENTIFIER TPS_MAF_DIF_2 ECU_ADDRESS 0x3fdcea BYTE_ORDER MSB_LAST FORMAT "%7.2" /end MEASUREMENT
/begin MEASUREMENT tps_maf_dif_int_2 "Sum of deviation between DK substitute value and TPS_2" UWORD _CNV_A_R_LINEAR_____108_CM 1 100. 0. 1389. DISPLAY_IDENTIFIER TPS_MAF_DIF_INT_2 ECU_ADDRESS 0x3fdcee BYTE_ORDER MSB_LAST FORMAT "%7.2" /end MEASUREMENT
/begin MEASUREMENT tps_maf_dif_int_1 "Sum of deviation between DK substitute value and TPS_1" UWORD _CNV_A_R_LINEAR_____108_CM 1 100. 0. 1389. DISPLAY_IDENTIFIER TPS_MAF_DIF_INT_1 ECU_ADDRESS 0x3fdcec BYTE_ORDER MSB_LAST FORMAT "%7.2" /end MEASUREMENT
/begin MEASUREMENT maf_sub_1 "Substitute mass air flow calculated with TPS_AV_1" UWORD _CNV_A_R_LINEAR_____108_CM 1 100. 0. 1389. DISPLAY_IDENTIFIER MAF_SUB_1 ECU_ADDRESS 0x3fdcf0 BYTE_ORDER MSB_LAST FORMAT "%7.2" /end MEASUREMENT
/begin MEASUREMENT maf_sub_2 "Substitute mass air flow calculated with TPS_AV_2" UWORD _CNV_A_R_LINEAR_____108_CM 1 100. 0. 1389. DISPLAY_IDENTIFIER MAF_SUB_2 ECU_ADDRESS 0x3fdcf2 BYTE_ORDER MSB_LAST FORMAT "%7.2" /end MEASUREMENT
/begin MEASUREMENT lv_err_tps_ratio "Logic variable (set if TPS ratio has been identified as faulty)" UBYTE _CNV_S_2_RANGE______1_R_CM 1 100. 0. 255. DISPLAY_IDENTIFIER LV_ERR_TPS_RATIO ECU_ADDRESS 0x3feab8 /end MEASUREMENT
/begin CHARACTERISTIC c_v_tps_max_diag_1 "upper diagnostic voltage, pot  1" VALUE 0xffe41b1a _REC_VAL_20_u2 4.99511719 _CNV_A_R_LINEAR_____3_CM 0. 4.99511719 DISPLAY_IDENTIFIER C_V_TPS_MAX_DIAG_1 FORMAT "%5.3" /end CHARACTERISTIC
/begin CHARACTERISTIC c_v_tps_ratio_hys "Admissible deviation of DK angle" VALUE 0xffe41b22 _REC_VAL_20_u2 4.99511719 _CNV_A_R_LINEAR_____3_CM 0. 4.99511719 DISPLAY_IDENTIFIER C_V_TPS_RATIO_HYS FORMAT "%5.3" /end CHARACTERISTIC
/begin CHARACTERISTIC c_maf_mes_max_tps_diag "Maximum threshold for usable air mass flow signal" VALUE 0xffe417ba _REC_VAL_20_u2 1389. _CNV_A_R_LINEAR_____108_CM 0. 1389. DISPLAY_IDENTIFIER C_MAF_MES_MAX_TPS_DIAG FORMAT "%7.2" /end CHARACTERISTIC
/begin CHARACTERISTIC ip_maf_add_tia_fac__tia "Correction of air density" CURVE 0xffe40cee _REC_CUR_20_u1_u1 1.9921875 _CNV_A_R_LINEAR_____117_CM 0. 1.9921875 DISPLAY_IDENTIFIER IP_MAF_ADD_TIA_FAC__TIA FORMAT "%5.3"
 /begin AXIS_DESCR COM_AXIS tia _CNV_A_R_LINEAR_____11_CM 6 -48. 142.5 FORMAT "%5.1" AXIS_PTS_REF ldpm_tia_1 /end AXIS_DESCR
/end CHARACTERISTIC
/begin CHARACTERISTIC ip_fac_tco_tqi__tco "Coolant temperature correction" CURVE 0xffe40c01 _REC_CUR_20_u1_u1 1.9921875 _CNV_A_R_LINEAR_____117_CM 0. 1.9921875 DISPLAY_IDENTIFIER IP_FAC_TCO_TQI__TCO FORMAT "%5.3"
 /begin AXIS_DESCR COM_AXIS tco _CNV_A_R_LINEAR_____11_CM 6 -48. 142.5 FORMAT "%5.1" AXIS_PTS_REF ldpm_tco__fac_tco_tqi /end AXIS_DESCR
/end CHARACTERISTIC
/begin MEASUREMENT tps_maf_dif_1 "Deviation of the substitute DK angle from TPS_1" UWORD _CNV_A_R_LINEAR_____108_CM 1 100. 0. 1389. DISPLAY_IDENTIFIER TPS_MAF_DIF_1 ECU_ADDRESS 0x3fdce8 BYTE_ORDER MSB_LAST FORMAT "%7.2" /end MEASUREMENT
/begin MEASUREMENT tps_maf_dif_mmv_1 "moving mean value of the difference between the DK position 1 and the map value" UWORD _CNV_A_R_LINEAR_____108_CM 1 100. 0. 1389. DISPLAY_IDENTIFIER TPS_MAF_DIF_MMV_1 ECU_ADDRESS 0x3fdcf4 BYTE_ORDER MSB_LAST FORMAT "%7.2" /end MEASUREMENT
/begin MEASUREMENT tps_maf_dif_mmv_2 "moving mean value of the difference between the DK position 2 and the map value" UWORD _CNV_A_R_LINEAR_____108_CM 1 100. 0. 1389. DISPLAY_IDENTIFIER TPS_MAF_DIF_MMV_2 ECU_ADDRESS 0x3fdcf6 BYTE_ORDER MSB_LAST FORMAT "%7.2" /end MEASUREMENT
/begin CHARACTERISTIC c_tps_maf_dif_mmv_thd "Limit  for calculation of the floating mean value of the deviation between channel X and map value" VALUE 0xffe41a94 _REC_VAL_20_u2 1389. _CNV_A_R_LINEAR_____108_CM 0. 1389. DISPLAY_IDENTIFIER C_TPS_MAF_DIF_MMV_THD FORMAT "%7.2" /end CHARACTERISTIC
/begin CHARACTERISTIC c_tps_maf_crlc_dif "Correlation constant for filtering of error (second error)" VALUE 0xffe41a90 _REC_VAL_20_u2 0.99998474 _CNV_A_R_LINEAR_____37_CM 0. 0.99998474 DISPLAY_IDENTIFIER C_TPS_MAF_CRLC_DIF FORMAT "%7.5" /end CHARACTERISTIC
/begin CHARACTERISTIC c_t_tps_dif_int "Integration time for deviation between measured and calculated DK value" VALUE 0xffe408d1 _REC_VAL_20_u1 1.275 _CNV_A_R_LINEAR_____414_CM 0. 1.275 DISPLAY_IDENTIFIER C_T_TPS_DIF_INT FORMAT "%5.3" /end CHARACTERISTIC
/begin CHARACTERISTIC c_tps_maf_dif_int_thd "Limit for integrated deviation between DK angle channel X and map value" VALUE 0xffe41a92 _REC_VAL_20_u2 1389. _CNV_A_R_LINEAR_____108_CM 0. 1389. DISPLAY_IDENTIFIER C_TPS_MAF_DIF_INT_THD FORMAT "%7.2" /end CHARACTERISTIC
/begin CHARACTERISTIC c_maf_dif_tps_diag "Normalisationfactor for deviation" VALUE 0xffe4173c _REC_VAL_20_u2 0.99998474 _CNV_A_R_LINEAR_____37_CM 0. 0.99998474 DISPLAY_IDENTIFIER C_MAF_DIF_TPS_DIAG FORMAT "%7.5" /end CHARACTERISTIC
/begin AXIS_PTS ldpm_tco__fac_tco_tqi "" 0xffe4143a tco _REC_AXS_20_u1 190.5 _CNV_A_R_LINEAR_____11_CM 6 -48. 142.5 DISPLAY_IDENTIFIER LDPM_TCO__FAC_TCO_TQI FORMAT "%5.1" /end AXIS_PTS
/begin AXIS_PTS ldpm_n_32_6 "" 0xffe484b3 n_32 _REC_AXS_20_u1 8160. _CNV_A_R_LINEAR_____15_CM 16 0. 8160. DISPLAY_IDENTIFIER LDPM_N_32_6 FORMAT "%4.0" /end AXIS_PTS
/begin MEASUREMENT lv_err_tps_2 "Logic variable  (set if  TPS_2 is being identified as errored)" UBYTE _CNV_S_2_RANGE______1_R_CM 1 100. 0. 255. DISPLAY_IDENTIFIER LV_ERR_TPS_2 ECU_ADDRESS 0x3fb8e8 /end MEASUREMENT
/begin MEASUREMENT lv_err_tps_maf_1 "Logic variable (set if TPS_1 has been identified as faulty by the ratio check)" UBYTE _CNV_S_2_RANGE______1_R_CM 1 100. 0. 255. DISPLAY_IDENTIFIER LV_ERR_TPS_MAF_1 ECU_ADDRESS 0x3fb8ec /end MEASUREMENT
/begin MEASUREMENT lv_err_tps_maf_2 "Logic variable(set if TPS_2 has been identified as faulty by the ratio check)" UBYTE _CNV_S_2_RANGE______1_R_CM 1 100. 0. 255. DISPLAY_IDENTIFIER LV_ERR_TPS_MAF_2 ECU_ADDRESS 0x3fb8f0 /end MEASUREMENT
/begin MEASUREMENT lv_err_tps_1 "Logic variable  (set if  TPS_1 is being identified as errored)" UBYTE _CNV_S_2_RANGE______1_R_CM 1 100. 0. 255. DISPLAY_IDENTIFIER LV_ERR_TPS_1 ECU_ADDRESS 0x3fb8e4 /end MEASUREMENT
/begin MEASUREMENT lv_err_mtc_dr "MTC_DR-error is present" UBYTE _CNV_S_2_RANGE______1_R_CM 1 100. 0. 255. DISPLAY_IDENTIFIER LV_ERR_MTC_DR ECU_ADDRESS 0x3fb910 /end MEASUREMENT
/begin AXIS_PTS ldp_tps_av__maf_1_diag "" 0xffe51388 tps_av _REC_AXS_20_u2 119.5 _CNV_A_R_LINEAR_____500_CM 16 0. 119.5 DISPLAY_IDENTIFIER LDP_TPS_AV__MAF_1_DIAG FORMAT "%7.3" /end AXIS_PTS
/begin AXIS_PTS ldp_n_32__tps_max_ratio_diag "" 0xffe410ab n_32 _REC_AXS_20_u1 8160. _CNV_A_R_LINEAR_____15_CM 4 0. 8160. DISPLAY_IDENTIFIER LDP_N_32__TPS_MAX_RATIO_DIAG FORMAT "%4.0" /end AXIS_PTS
/begin CHARACTERISTIC ip_maf_1_diag__n__tps_av "Substitute mass air flow through MTC" MAP 0xffe4cb9e _REC_MAP_20_u2_u1_u2 1389. _CNV_A_R_LINEAR_____108_CM 0. 1389. DISPLAY_IDENTIFIER IP_MAF_1_DIAG__N__TPS_AV FORMAT "%7.2"
 /begin AXIS_DESCR COM_AXIS n_32 _CNV_A_R_LINEAR_____15_CM 16 0. 8160. FORMAT "%4.0" AXIS_PTS_REF ldpm_n_32_6 /end AXIS_DESCR
 /begin AXIS_DESCR COM_AXIS tps_av _CNV_A_R_LINEAR_____500_CM 16 0. 119.5 FORMAT "%7.3" AXIS_PTS_REF ldp_tps_av__maf_1_diag /end AXIS_DESCR
/end CHARACTERISTIC
/begin CHARACTERISTIC ip_tps_max_tps_ratio_diag "Maximum throttle angle for TPS ratio diagnosis" CURVE 0xffe41ce8 _REC_CUR_20_u2_u1 119.5 _CNV_A_R_LINEAR_____53_CM 0. 119.5 DISPLAY_IDENTIFIER IP_TPS_MAX_TPS_RATIO_DIAG FORMAT "%7.3"
 /begin AXIS_DESCR COM_AXIS n_32 _CNV_A_R_LINEAR_____15_CM 4 0. 8160. FORMAT "%4.0" AXIS_PTS_REF ldp_n_32__tps_max_ratio_diag /end AXIS_DESCR
/end CHARACTERISTIC
/begin MEASUREMENT lv_err_tout_amt_1 "logical variable timeout error CAN message SSG1" UBYTE _CNV_S_2_RANGE______1_R_CM 1 100. 0. 255. DISPLAY_IDENTIFIER LV_ERR_TOUT_AMT_1 ECU_ADDRESS 0x3fb8a4 /end MEASUREMENT
/begin MEASUREMENT lv_err_tout_etcu_1 "logical variable timeout error CAN message EGS1" UBYTE _CNV_S_2_RANGE______1_R_CM 1 100. 0. 255. DISPLAY_IDENTIFIER LV_ERR_TOUT_ETCU_1 ECU_ADDRESS 0x3fb884 /end MEASUREMENT
/begin MEASUREMENT lv_err_tout_pste_1 "logical variable timeout error CAN message LWS1" UBYTE _CNV_S_2_RANGE______1_R_CM 1 100. 0. 255. DISPLAY_IDENTIFIER LV_ERR_TOUT_PSTE_1 ECU_ADDRESS 0x3fb8a0 /end MEASUREMENT
/begin CHARACTERISTIC c_maf_vs_min_diag "MAF condition - vehicle speed diagnosis" VALUE 0xffe40798 _REC_VAL_20_u1 1389. _CNV_A_R_LINEAR_____27_CM 0. 1389. DISPLAY_IDENTIFIER C_MAF_VS_MIN_DIAG FORMAT "%4.0" /end CHARACTERISTIC
/begin CHARACTERISTIC c_n_vs_min_diag "Engine speed condition - vehicle speed diagnosis" VALUE 0xffe4184c _REC_VAL_20_u2 8160. _CNV_A_R_LINEAR_____10_CM 0. 8160. DISPLAY_IDENTIFIER C_N_VS_MIN_DIAG FORMAT "%4.0" /end CHARACTERISTIC
/begin CHARACTERISTIC c_t_vs_min_diag "Time condition - vehicle speed diagnosis" VALUE 0xffe41a24 _REC_VAL_20_u2 65535. _CNV_A_R_LINEAR_____30_CM 0. 65535. DISPLAY_IDENTIFIER C_T_VS_MIN_DIAG FORMAT "%5.0" /end CHARACTERISTIC
/begin MEASUREMENT t_vs_diag "Time counter for error detection" UWORD _CNV_A_R_LINEAR_____30_CM 1 100. 0. 65535. DISPLAY_IDENTIFIER T_VS_DIAG ECU_ADDRESS 0x3fd85e BYTE_ORDER MSB_LAST FORMAT "%5.0" /end MEASUREMENT
/begin MEASUREMENT t_vs_end_diag "Time counter for end of diagnosis" UWORD _CNV_A_R_LINEAR_____30_CM 1 100. 0. 65535. DISPLAY_IDENTIFIER T_VS_END_DIAG ECU_ADDRESS 0x3fd860 BYTE_ORDER MSB_LAST FORMAT "%5.0" /end MEASUREMENT
/begin MEASUREMENT lv_gen_err_mec_act "mechanical error currently present on Generator " UBYTE _CNV_S_2_RANGE______1_R_CM 1 100. 0. 255. DISPLAY_IDENTIFIER LV_GEN_ERR_MEC_ACT ECU_ADDRESS 0x3fe3f8 /end MEASUREMENT
/begin MEASUREMENT lv_gen_err_temp_act "High temperature  error currently present on Generator" UBYTE _CNV_S_2_RANGE______1_R_CM 1 100. 0. 255. DISPLAY_IDENTIFIER LV_GEN_ERR_TEMP_ACT ECU_ADDRESS 0x3fe3f9 /end MEASUREMENT
/begin MEASUREMENT lv_gen_err_el_act "ele error currently present on Generator BSD Interface" UBYTE _CNV_S_2_RANGE______1_R_CM 1 100. 0. 255. DISPLAY_IDENTIFIER LV_GEN_ERR_EL_ACT ECU_ADDRESS 0x3fe3fa /end MEASUREMENT
/begin MEASUREMENT lv_gen_err_plaus_act "Boolean for error currently present on Generator BSD Interface" UBYTE _CNV_S_2_RANGE______1_R_CM 1 100. 0. 255. DISPLAY_IDENTIFIER LV_GEN_ERR_PLAUS_ACT ECU_ADDRESS 0x3fe3fb /end MEASUREMENT
/begin MEASUREMENT lv_gen_err_tout_act "Boolean for error currently present on Generator BSD Interface active" UBYTE _CNV_S_2_RANGE______1_R_CM 1 100. 0. 255. DISPLAY_IDENTIFIER LV_GEN_ERR_TOUT_ACT ECU_ADDRESS 0x3fe3fc /end MEASUREMENT
/begin MEASUREMENT lv_gen_err_act "error currently present on Generator " UBYTE _CNV_S_2_RANGE______1_R_CM 1 100. 0. 255. DISPLAY_IDENTIFIER LV_GEN_ERR_ACT ECU_ADDRESS 0x3fe3fd /end MEASUREMENT
/begin CHARACTERISTIC c_t_ast_gen_diag_off "End of genertaor diagnosis T_AST" VALUE 0xffe418d8 _REC_VAL_20_u2 51.2 _CNV_A_R_LINEAR_____24_CM 0. 51.2 DISPLAY_IDENTIFIER C_T_AST_GEN_DIAG_OFF FORMAT "%4.1" /end CHARACTERISTIC
/begin CHARACTERISTIC c_t_ast_gen_diag_on "Begin of genertaor diagnosis T_AST" VALUE 0xffe418da _REC_VAL_20_u2 51.2 _CNV_A_R_LINEAR_____24_CM 0. 51.2 DISPLAY_IDENTIFIER C_T_AST_GEN_DIAG_ON FORMAT "%4.1" /end CHARACTERISTIC
/begin CHARACTERISTIC c_dffgen_thd_min "Min.DF diagnosis threshold for Generator diagnosis" VALUE 0xffe40711 _REC_VAL_20_u1 99.609375 _CNV_A_R_LINEAR_____9_CM 0. 99.609375 DISPLAY_IDENTIFIER C_DFFGEN_THD_MIN /end CHARACTERISTIC
/begin CHARACTERISTIC c_dffgen_thd_max "Max.DF diagnosis threshold for Generator diagnosis" VALUE 0xffe40710 _REC_VAL_20_u1 99.609375 _CNV_A_R_LINEAR_____9_CM 0. 99.609375 DISPLAY_IDENTIFIER C_DFFGEN_THD_MAX /end CHARACTERISTIC
/begin CHARACTERISTIC c_vb_mes_gen_diag_thd_max "Max.battery voltage threshold for diagnosis" VALUE 0xffe41b2e _REC_VAL_20_u2 28.7055 _CNV_A_R_LINEAR_____208_CM 0. 28.7055 DISPLAY_IDENTIFIER C_VB_MES_GEN_DIAG_THD_MAX FORMAT "%5.2" /end CHARACTERISTIC
/begin CHARACTERISTIC c_vb_mes_gen_diag_thd "battery voltage threshold for diagnosis" VALUE 0xffe41b2c _REC_VAL_20_u2 28.7055 _CNV_A_R_LINEAR_____208_CM 0. 28.7055 DISPLAY_IDENTIFIER C_VB_MES_GEN_DIAG_THD FORMAT "%5.2" /end CHARACTERISTIC
/begin CHARACTERISTIC c_perc_gen_diag_vb_max "Percentage of battery voltage values within diagnosis range" VALUE 0xffe4185e _REC_VAL_20_u2 99.99847412 _CNV_A_R_LINEAR_____8_CM 0. 99.99847412 DISPLAY_IDENTIFIER C_PERC_GEN_DIAG_VB_MAX /end CHARACTERISTIC
/begin MEASUREMENT lv_err_gen "Boolean for error currently present on Generator" UBYTE _CNV_S_2_RANGE______1_R_CM 1 100. 0. 255. DISPLAY_IDENTIFIER LV_ERR_GEN ECU_ADDRESS 0x3fb930 /end MEASUREMENT
/begin MEASUREMENT lv_err_gen_diag "Error Generator diagnosis" UBYTE _CNV_S_2_RANGE______1_R_CM 1 100. 0. 255. DISPLAY_IDENTIFIER LV_ERR_GEN_DIAG ECU_ADDRESS 0x3fb938 /end MEASUREMENT
/begin MEASUREMENT ctr_ref_gen_diag "Reference counter for diagnosis result" UWORD _CNV_A_R_LINEAR_____22_CM 1 100. 0. 512. DISPLAY_IDENTIFIER CTR_REF_GEN_DIAG ECU_ADDRESS 0x3fd210 BYTE_ORDER MSB_LAST FORMAT "%4.0" /end MEASUREMENT
/begin MEASUREMENT ctr_diag_gen_diag "Diagnosis counter for fulfilled diagnosis values" UWORD _CNV_A_R_LINEAR_____22_CM 1 100. 0. 512. DISPLAY_IDENTIFIER CTR_DIAG_GEN_DIAG ECU_ADDRESS 0x3fd212 BYTE_ORDER MSB_LAST FORMAT "%4.0" /end MEASUREMENT
/begin MEASUREMENT lv_err_gen_if "Boolean for error currently present on Generator BSD Interface" UBYTE _CNV_S_2_RANGE______1_R_CM 1 100. 0. 255. DISPLAY_IDENTIFIER LV_ERR_GEN_IF ECU_ADDRESS 0x3fb934 /end MEASUREMENT
/begin CHARACTERISTIC c_v_pvs_max_diag_1 "Upper diagnosis threshold channel 1" VALUE 0xffe41af6 _REC_VAL_20_u2 4.99511719 _CNV_A_R_LINEAR_____3_CM 0. 4.99511719 DISPLAY_IDENTIFIER C_V_PVS_MAX_DIAG_1 FORMAT "%5.3" /end CHARACTERISTIC
/begin CHARACTERISTIC c_v_pvs_max_diag_2 "Upper diagnosis threshold channel 2" VALUE 0xffe41af8 _REC_VAL_20_u2 4.99511719 _CNV_A_R_LINEAR_____3_CM 0. 4.99511719 DISPLAY_IDENTIFIER C_V_PVS_MAX_DIAG_2 FORMAT "%5.3" /end CHARACTERISTIC
/begin MEASUREMENT lv_err_toil "TOIL error flag" UBYTE _CNV_S_2_RANGE______1_R_CM 1 100. 0. 255. DISPLAY_IDENTIFIER LV_ERR_TOIL ECU_ADDRESS 0x3fb7f8 /end MEASUREMENT
/begin CHARACTERISTIC c_toil_max_diag "TOIL threshold for short to ground - TOIL diagnosis" VALUE 0xffe40973 _REC_VAL_20_u1 200. _CNV_A_R_LINEAR_____14_CM -40. 160. DISPLAY_IDENTIFIER C_TOIL_MAX_DIAG FORMAT "%3.0" /end CHARACTERISTIC
/begin CHARACTERISTIC c_toil_min_diag "TOIL threshold for short to VB or line break - TOIL diagnosis" VALUE 0xffe40976 _REC_VAL_20_u1 200. _CNV_A_R_LINEAR_____14_CM -40. 160. DISPLAY_IDENTIFIER C_TOIL_MIN_DIAG FORMAT "%3.0" /end CHARACTERISTIC
/begin CHARACTERISTIC c_tco_max_toil_diag "TCO threshold - TOIL diagnosis" VALUE 0xffe4090a _REC_VAL_20_u1 190.5 _CNV_A_R_LINEAR_____11_CM -48. 142.5 DISPLAY_IDENTIFIER C_TCO_MAX_TOIL_DIAG FORMAT "%5.1" /end CHARACTERISTIC
/begin COMPU_METHOD _CNV_A_R_LINEAR_____0_CM "" RAT_FUNC "%6.3" "-" COEFFS 0 1. 0. 0 0 1 /end COMPU_METHOD
/begin COMPU_METHOD _CNV_S_2_RANGE______1_R_CM "" TAB_VERB "%6.3" "[-]" COMPU_TAB_REF _CNV_S_2_RANGE______1_R /end COMPU_METHOD
/begin COMPU_VTAB_RANGE _CNV_S_2_RANGE______1_R "" 2 0 0 "0" 1 255 "1" /end COMPU_VTAB_RANGE
/begin COMPU_METHOD _CNV_S_2_RANGE______2_CM "" TAB_VERB "%6.3" "[-]" COMPU_TAB_REF _CNV_S_2_RANGE______2 /end COMPU_METHOD
/begin COMPU_VTAB _CNV_S_2_RANGE______2 "" TAB_VERB 2 0 "0" 1 "1" /end COMPU_VTAB
/begin COMPU_METHOD _CNV_A_R_LINEAR_____3_CM "" RAT_FUNC "%6.3" "V" COEFFS 0 204.7999998974999 0. 0 0 1 /end COMPU_METHOD
/begin COMPU_METHOD _CNV_A_R_LINEAR_____4_CM "" RAT_FUNC "%6.3" "s" COEFFS 0 100. 0. 0 0 1 /end COMPU_METHOD
/begin COMPU_METHOD _CNV_S_2_RANGE______5_R_CM "" TAB_VERB "%6.3" "-" COMPU_TAB_REF _CNV_S_2_RANGE______5_R /end COMPU_METHOD
/begin COMPU_VTAB_RANGE _CNV_S_2_RANGE______5_R "" 2 0 0 "0" 1 255 "1" /end COMPU_VTAB_RANGE
/begin COMPU_METHOD _CNV_A_R_LINEAR_____6_CM "" RAT_FUNC "%6.3" "°C" COEFFS 0 16. 0. 0 0 1 /end COMPU_METHOD
/begin COMPU_METHOD _CNV_S_6_RANGE_STAT_7_CM "" TAB_VERB "%6.3" "[-]" COMPU_TAB_REF _CNV_S_6_RANGE_STAT_7 /end COMPU_METHOD
/begin COMPU_VTAB _CNV_S_6_RANGE_STAT_7 "" TAB_VERB 6 0 "no error" 1 "error active / no substitutes" 2 "error active / closing 100%" 3 "error active / substitute opening" 4 "error active / opening 0%" 5 "error active / limp home" /end COMPU_VTAB
/begin COMPU_METHOD _CNV_A_R_LINEAR_____8_CM "" RAT_FUNC "%6.3" "%" COEFFS 0 655.3600000071681 0. 0 0 1 /end COMPU_METHOD
/begin COMPU_METHOD _CNV_A_R_LINEAR_____9_CM "" RAT_FUNC "%6.3" "%" COEFFS 0 2.56 0. 0 0 1 /end COMPU_METHOD
/begin COMPU_METHOD _CNV_A_R_LINEAR_____10_CM "" RAT_FUNC "%6.3" "rpm" COEFFS 0 1. 0. 0 0 1 /end COMPU_METHOD
/begin COMPU_METHOD _CNV_A_R_LINEAR_____11_CM "" RAT_FUNC "%6.3" "°C" COEFFS 0 1.333333333333333 64. 0 0 1 /end COMPU_METHOD
/begin COMPU_METHOD _CNV_A_R_LINEAR_____12_CM "" RAT_FUNC "%6.3" "°C" COEFFS 0 1.333333333333333 0. 0 0 1 /end COMPU_METHOD
/begin COMPU_METHOD _CNV_A_R_LINEAR_____14_CM "" RAT_FUNC "%6.3" "°C" COEFFS 0 1. 40. 0 0 1 /end COMPU_METHOD
/begin COMPU_METHOD _CNV_A_R_LINEAR_____15_CM "" RAT_FUNC "%6.3" "rpm" COEFFS 0 3.125e-002 0. 0 0 1 /end COMPU_METHOD
/begin COMPU_METHOD _CNV_A_R_LINEAR_____20_CM "" RAT_FUNC "%6.3" "-" COEFFS 0 32768.00003968061 0. 0 0 1 /end COMPU_METHOD
/begin COMPU_METHOD _CNV_S_2_RANGE______21_CM "" TAB_VERB "%6.3" "-" COMPU_TAB_REF _CNV_S_2_RANGE______21 /end COMPU_METHOD
/begin COMPU_VTAB _CNV_S_2_RANGE______21 "" TAB_VERB 2 0 "0" 1 "1" /end COMPU_VTAB
/begin COMPU_METHOD _CNV_A_R_LINEAR_____22_CM "" RAT_FUNC "%6.3" "[-]" COEFFS 0 1. 0. 0 0 1 /end COMPU_METHOD
/begin COMPU_METHOD _CNV_A_R_LINEAR_____23_CM "" RAT_FUNC "%6.3" "km/h" COEFFS 0 1. 0. 0 0 1 /end COMPU_METHOD
/begin COMPU_METHOD _CNV_A_R_LINEAR_____24_CM "" RAT_FUNC "%6.3" "s" COEFFS 0 10. 0. 0 0 1 /end COMPU_METHOD
/begin COMPU_METHOD _CNV_A_R_LINEAR_____25_CM "" RAT_FUNC "%6.3" "-" COEFFS 0 4095.999999839998 -1.280019205296412e-006 0 0 1 /end COMPU_METHOD
/begin COMPU_METHOD _CNV_A_R_LINEAR_____26_CM "" RAT_FUNC "%6.3" "µs" COEFFS 0 -1. 0. 0 0 1 /end COMPU_METHOD
/begin COMPU_METHOD _CNV_A_R_LINEAR_____27_CM "" RAT_FUNC "%6.3" "mg/stk" COEFFS 0 0.183585313174946 0. 0 0 1 /end COMPU_METHOD
/begin COMPU_METHOD _CNV_A_R_LINEAR_____28_CM "" RAT_FUNC "%6.3" "-" COEFFS 0 127.9983874218908 1.612578109245533e-003 0 0 1 /end COMPU_METHOD
/begin COMPU_METHOD _CNV_A_R_LINEAR_____29_CM "" RAT_FUNC "%6.3" "-" COEFFS 0 255.9983911655618 0. 0 0 1 /end COMPU_METHOD
/begin COMPU_METHOD _CNV_A_R_LINEAR_____30_CM "" RAT_FUNC "%6.3" "s" COEFFS 0 1. 0. 0 0 1 /end COMPU_METHOD
/begin COMPU_METHOD _CNV_A_R_LINEAR_____31_CM "" RAT_FUNC "%6.3" "ms" COEFFS 0 0.1 0. 0 0 1 /end COMPU_METHOD
/begin COMPU_METHOD _CNV_A_R_LINEAR_____34_CM "" RAT_FUNC "%6.3" "V" COEFFS 0 9.846168103048838 0. 0 0 1 /end COMPU_METHOD
/begin COMPU_METHOD _CNV_A_R_LINEAR_____37_CM "" RAT_FUNC "%6.3" "-" COEFFS 0 65536.00007936121 0. 0 0 1 /end COMPU_METHOD
/begin COMPU_METHOD _CNV_A_R_LINEAR_____39_CM "" RAT_FUNC "%6.3" "-" COEFFS 0 127.9991955827809 0. 0 0 1 /end COMPU_METHOD
/begin COMPU_METHOD _CNV_A_R_LINEAR_____43_CM "" RAT_FUNC "%6.3" "V" COEFFS 0 102.4003523452984 0. 0 0 1 /end COMPU_METHOD
/begin COMPU_METHOD _CNV_A_R_LINEAR_____44_CM "" RAT_FUNC "%6.3" "V" COEFFS 0 51.0204081632653 0. 0 0 1 /end COMPU_METHOD
/begin COMPU_METHOD _CNV_A_R_LINEAR_____49_CM "" RAT_FUNC "%6.3" "hPa" COEFFS 0 12.06017666543982 0. 0 0 1 /end COMPU_METHOD
/begin COMPU_METHOD _CNV_A_R_LINEAR_____53_CM "" RAT_FUNC "%6.3" "°TPS" COEFFS 0 137.0962343096234 0. 0 0 1 /end COMPU_METHOD
/begin COMPU_METHOD _CNV_A_R_LINEAR_____60_CM "" RAT_FUNC "%6.3" "V" COEFFS 0 9.807692307692308 0. 0 0 1 /end COMPU_METHOD
/begin COMPU_METHOD _CNV_A_R_LINEAR_____82_CM "" RAT_FUNC "%6.3" "°CRK" COEFFS 0 2.666666666666667 0. 0 0 1 /end COMPU_METHOD
/begin COMPU_METHOD _CNV_S_4_RANGE_STAT_83_CM "" TAB_VERB "%6.3" "-" COMPU_TAB_REF _CNV_S_4_RANGE_STAT_83 /end COMPU_METHOD
/begin COMPU_VTAB _CNV_S_4_RANGE_STAT_83 "" TAB_VERB 4 0 "CAM_EDGE_NO_ERROR" 1 "CAM_EDGE_BELOW" 2 "CAM_EDGE_ABOVE" 4 "CAM_EDGE_WRONG" /end COMPU_VTAB
/begin COMPU_METHOD _CNV_S_7_RANGE_STAT_84_CM "" TAB_VERB "%6.3" "[-]" COMPU_TAB_REF _CNV_S_7_RANGE_STAT_84 /end COMPU_METHOD
/begin COMPU_VTAB _CNV_S_7_RANGE_STAT_84 "" TAB_VERB 7 0 "BIOS_EPO_CAM_SYNC" 4 "BIOS_EPO_CAM_SEG_VLD" 5 "BIOS_EPO_CAM_FIRST_SEG" 6 "BIOS_EPO_CAM_SEC_EDGE" 7 "BIOS_EPO_CAM_FIRST_EDGE" 8 "BIOS_EPO_CAM_ASW_ACT" 9 "BIOS_EPO_CAM_PAS" /end COMPU_VTAB
/begin COMPU_METHOD _CNV_A_R_LINEAR_____108_CM "" RAT_FUNC "%6.3" "mg/stk" COEFFS 0 47.18142548596112 0. 0 0 1 /end COMPU_METHOD
/begin COMPU_METHOD _CNV_A_R_LINEAR_____115_CM "" RAT_FUNC "%6.3" "kg/h" COEFFS 0 32. 0. 0 0 1 /end COMPU_METHOD
/begin COMPU_METHOD _CNV_A_R_LINEAR_____117_CM "" RAT_FUNC "%6.3" "-" COEFFS 0 128. 0. 0 0 1 /end COMPU_METHOD
/begin COMPU_METHOD _CNV_S_5_RANGE_STAT_135_CM "" TAB_VERB "%6.3" "[-]" COMPU_TAB_REF _CNV_S_5_RANGE_STAT_135 /end COMPU_METHOD
/begin COMPU_VTAB _CNV_S_5_RANGE_STAT_135 "" TAB_VERB 5 0 "BIOS_EPO_CRK_DIAG_NO_ERR" 1 "BIOS_EPO_CRK_DIAG_ENG_PSN_ERR" 2 "BIOS_EPO_CRK_DIAG_TOOTH_PER_ERR" 4 "BIOS_EPO_CRK_DIAG_TPUA_SYN_ERR" 8 "BIOS_EPO_CRK_DIAG_TPUB_SYN_ERR" /end COMPU_VTAB
/begin COMPU_METHOD _CNV_S_10_RANGE_CRK__136_CM "" TAB_VERB "%6.3" "[-]" COMPU_TAB_REF _CNV_S_10_RANGE_CRK__136 /end COMPU_METHOD
/begin COMPU_VTAB _CNV_S_10_RANGE_CRK__136 "" TAB_VERB 10 0 "BIOS_EPO_CRK_SYNC" 1 "BIOS_EPO_CRK_SYNC_CHK_MIS" 2 "BIOS_EPO_CRK_SYNC_GAP_SIM" 3 "BIOS_EPO_CRK_SYNC_CHK_GAP" 4 "BIOS_EPO_CRK_SYNC_GAP" 5 "BIOS_CRK_VLD_TEETH" 6 "BIOS_CRK_FIRST_TOOTH" 7 "BIOS_EPO_CRK_SENS_DLY" 8 "BIOS_EPO_CRK_FIRST_EDGE" 9 "BIOS_EPO_CRK_PAS" /end COMPU_VTAB
/begin COMPU_METHOD _CNV_S_5_RANGE_STAT_137_CM "" TAB_VERB "%6.3" "[-]" COMPU_TAB_REF _CNV_S_5_RANGE_STAT_137 /end COMPU_METHOD
/begin COMPU_VTAB _CNV_S_5_RANGE_STAT_137 "" TAB_VERB 5 0 "CRK_SYN_REQ_CAM_0" 1 "CRK_SYN_REQ_CAM_1" 2 "CAM_0_SYN_REQ" 3 "CAM_1_SYN_REQ" 4 "SYN_DISABLE" /end COMPU_VTAB
/begin COMPU_METHOD _CNV_A_R_LINEAR_____138_CM "" RAT_FUNC "%6.3" "-" COEFFS 0 2.666666666666667 0. 0 0 1 /end COMPU_METHOD
/begin COMPU_METHOD _CNV_A_R_LINEAR_____165_CM "" RAT_FUNC "%6.3" "ms" COEFFS 0 250. 0. 0 0 1 /end COMPU_METHOD
/begin COMPU_METHOD _CNV_S_6_RANGE_ERR__193_CM "" TAB_VERB "%6.3" "-" COMPU_TAB_REF _CNV_S_6_RANGE_ERR__193 /end COMPU_METHOD
/begin COMPU_VTAB _CNV_S_6_RANGE_ERR__193 "" TAB_VERB 6 0 "NO_SYM" 1 "SYM_0" 2 "SYM_1" 4 "SYM_2" 8 "SYM_3" 15 "BENCH_MODE" /end COMPU_VTAB
/begin COMPU_METHOD _CNV_A_R_LINEAR_____208_CM "" RAT_FUNC "%6.3" "V" COEFFS 0 35.63776976537597 0. 0 0 1 /end COMPU_METHOD
/begin COMPU_METHOD _CNV_A_R_LINEAR_____406_CM "" RAT_FUNC "%6.3" "ms" COEFFS 0 0.1 -1. 0 0 1 /end COMPU_METHOD
/begin COMPU_METHOD _CNV_A_R_LINEAR_____414_CM "" RAT_FUNC "%6.3" "s" COEFFS 0 200. 0. 0 0 1 /end COMPU_METHOD
/begin COMPU_METHOD _CNV_S_9_RANGE_STAT_451_CM "" TAB_VERB "%6.3" "-" COMPU_TAB_REF _CNV_S_9_RANGE_STAT_451 /end COMPU_METHOD
/begin COMPU_VTAB _CNV_S_9_RANGE_STAT_451 "" TAB_VERB 9 0 "PVS_NO_ERROR" 1 "PVS_LIH_PRED" 2 "PVS_LIH_1" 4 "PVS_LIH_2" 8 "PVS_LIH_MIN" 16 "PVS_DBL_ERROR" 32 "PVS_LIH_BLS" 64 "PVS_LIH_1_PRED" 128 "PVS_LIH_2_PRED" /end COMPU_VTAB
/begin COMPU_METHOD _CNV_A_R_LINEAR_____500_CM "" RAT_FUNC "%6.3" "°TPS" COEFFS 0 548.4100418410042 0. 0 0 1 /end COMPU_METHOD
/begin RECORD_LAYOUT _REC_VAL_20_u1 FNC_VALUES 1 UBYTE COLUMN_DIR DIRECT /end RECORD_LAYOUT
/begin RECORD_LAYOUT _REC_VAL_20_u2 FNC_VALUES 1 UWORD COLUMN_DIR DIRECT /end RECORD_LAYOUT
/begin RECORD_LAYOUT _REC_CUR_20_u2_u1 FNC_VALUES 1 UWORD COLUMN_DIR DIRECT /end RECORD_LAYOUT
/begin RECORD_LAYOUT _REC_AXS_20_u1 NO_AXIS_PTS_X 1 UBYTE AXIS_PTS_X 2 UBYTE INDEX_INCR DIRECT /end RECORD_LAYOUT
/begin RECORD_LAYOUT _REC_CUR_20_u1_u1 FNC_VALUES 1 UBYTE COLUMN_DIR DIRECT /end RECORD_LAYOUT
/begin RECORD_LAYOUT _REC_AXS_20_u2 NO_AXIS_PTS_X 1 UWORD AXIS_PTS_X 2 UWORD INDEX_INCR DIRECT /end RECORD_LAYOUT
/begin RECORD_LAYOUT _REC_MAP_20_u2_u2_u1 FNC_VALUES 1 UWORD COLUMN_DIR DIRECT /end RECORD_LAYOUT
/begin RECORD_LAYOUT _REC_CUR_20_u1_u2 FNC_VALUES 1 UBYTE COLUMN_DIR DIRECT /end RECORD_LAYOUT
/begin RECORD_LAYOUT _REC_MAP_20_u2_u1_u1 FNC_VALUES 1 UWORD COLUMN_DIR DIRECT /end RECORD_LAYOUT
/begin RECORD_LAYOUT _REC_CUR_20_u2_u2 FNC_VALUES 1 UWORD COLUMN_DIR DIRECT /end RECORD_LAYOUT
/begin RECORD_LAYOUT _REC_MAP_20_u2_u1_u2 FNC_VALUES 1 UWORD COLUMN_DIR DIRECT /end RECORD_LAYOUT
/begin FUNCTION DIA_Diagnosis_and_limp_home "DIA"
 /begin SUB_FUNCTION DIA_Mass_air_flow_meter DIA_Intake_air_temperature_senso DIA_Temperature_sensor___TCO_EX_ DIA_IVVT_diagnosis DIA_Fuel_pump_relay_RLY_EFP DIA_Ambient_pressure_sensor DIA_Lambda_control_diagnosis DIA_Upstream_oxygen_sensor_heate DIA_Downstream_oxygen_sensor_hea DIA_Oil_temperature_sensor_TOIL DIA_Electronically_controlled_th DIA_Knock_sensor_diagnosis DIA_Vehicle_speed_signal_diagnos DIA_Ignition_system_diagnosis DIA_Throttle_position_sensor_dia DIA_Injection_valves_IV_1_to_6 DIA_Error_memory_interface DIA_Canister_purge_valve_diagnos DIA_ETC_driver_diagnosis DIA_Lambda_sensor_upstream_heate DIA_Lambda_sensor_downstream_hea DIA_Generator_diagnosis DIA_Crankshaft_Signal_Diagnosis_ DIA_Camshaft_Sensor_Diagnosis_an DIA_Secondary_Air_Valve_Diagnosi DIA_Electronical_Cooling_Fan_Dia DIA_Secondary_Air_Pump_Diagnosis DIA_Air_Condition_Compressor_Con DIA_Main_Relay_Diagnosis__RLY_MA DIA_Coolant_Temperature_Sensor_D DIA_TCO_Sensor_Plausibility_Diag DIA_Idle_Speed_Control_Diagnosis DIA_CAN_diagnosis DIA_Multifunctional_steering_whe DIA_Pedal_value_sensor_diagnosis DIA_Brake_light_switch_diagnosis DIA_Idle_Speed_Actuator_Diagnosi DIA_Engine_roughness_idle_diagno DIA_Variable_Intake_Manifold__VI DIA_Immobilizer_signal_diagnosis DIA_Exhaust_flap_diagnosis DIA_Anti_bounce_algorithm DIA_Torque_Request_for_Safety_Di DIA_E_box_cooling_fan_diagnosis DIA_ECU_temperature_sensor_diagn DIA_Application_incidences_for_d DIA_Downstream_oxygen_sensor_sig DIA_Tank_leakage_pump_diagnosis DIA_SOF_diagnosis DIA_HW_based_diagnosis_for_the_C DIA_Oxygen_sensor_ceramic_temper DIA_Downstream_oxygen_sensor_int DIA_TPS___ETC_Limp_Home_Manager DIA_Diagnosis_Oil_temperature_an DIA_BSD_Diagnosis DIA_Starter_Output_Diagnosis DIA_Oil_pressure_switch_diagnosi DIA_CAN_diagnosis_for_EFP_contro DIA_Signal_plausibility_monitori DIA_ETC_Actuator_diagnosis_and_A DIA_Electric_solenoid_valve_diag DIA_Ozone_sensor_diagnosis DIA_Acquition_of_ozone_concentra DIA_AMT_intervention_plausibilit DIA_GS_intervention_plausibility DIA_Distance_cruise_control_diag DIA_DMTL_heater_diagnosis DIA_Electronically_controlled_ra DIA_Upstream_oxygen_sensor_signa DIA_CAN_diagnosis_for_NOX_contro DIA_NOx_Sensor_Diagnosis___OBD_I DIA_Application_incidences_NOx_S DIA_Application_Incidences_of__W DIA_WRAF_Sensor_Controller_Diagn DIA_Clutch_switch_diagnosis DIA_ECU_selftest DIA_SPI_Bus_diagnosis DIA_PVS_diagnosis_application_in DIA_Automatic_gear_shift_signal_ /end SUB_FUNCTION
/end FUNCTION
/begin FUNCTION DIA_Mass_air_flow_meter "_Mass air flow meter"
 /begin DEF_CHARACTERISTIC c_n_min_maf_diag c_maf_min_diag c_isapwm_maf_min_isa_diag c_maf_kgh_diag_ini id_crlc_maf_diag__n_32 ip_maf_max_isa__pq_turb_sys c_maf_max_diag c_fac_tq_req_min_maf_diag ip_fac_pq_isa__isapwm /end DEF_CHARACTERISTIC
 /begin OUT_MEASUREMENT pq_turb_sys maf_sub_isa maf_kgh_diag lv_maf_bls_diag lv_err_maf /end OUT_MEASUREMENT
/end FUNCTION
/begin FUNCTION DIA_Intake_air_temperature_senso "_Intake air temperature sensor" /begin DEF_CHARACTERISTIC c_tia_max_diag c_tia_min_diag /end DEF_CHARACTERISTIC /begin OUT_MEASUREMENT lv_err_tia /end OUT_MEASUREMENT /end FUNCTION
/begin FUNCTION DIA_Temperature_sensor___TCO_EX_ "_Temperature sensor - TCO_EX Coolant" /begin DEF_CHARACTERISTIC c_t_tia_tco_ex_diag /end DEF_CHARACTERISTIC /begin OUT_MEASUREMENT lv_err_tco_ex /end OUT_MEASUREMENT /end FUNCTION
/begin FUNCTION DIA_IVVT_diagnosis "_IVVT diagnosis"
 /begin DEF_CHARACTERISTIC c_t_dly_diag_ref_ivvt c_cam_hys_diag_ivvt c_ctr_thd_ivvt_park /end DEF_CHARACTERISTIC
 /begin OUT_MEASUREMENT lv_err_ivvt lv_err_mec_ivvt_in_1 lv_err_ref_ivvt_in_1 lv_err_mec_ivvt_ex_1 lv_err_ref_ivvt_ex_1 lv_err_park_ivvt_in_1 lv_err_park_ivvt_ex_1 /end OUT_MEASUREMENT
/end FUNCTION
/begin FUNCTION DIA_Fuel_pump_relay_RLY_EFP "_Fuel pump relay RLY_EFP" /begin OUT_MEASUREMENT lv_err_rly_efp /end OUT_MEASUREMENT /end FUNCTION
/begin FUNCTION DIA_Ambient_pressure_sensor "_Ambient pressure sensor" /begin DEF_CHARACTERISTIC c_amp_ref c_v_amp_max_diag c_v_amp_min_diag /end DEF_CHARACTERISTIC /begin OUT_MEASUREMENT lv_err_amp /end OUT_MEASUREMENT /end FUNCTION
/begin FUNCTION DIA_Lambda_control_diagnosis "_Lambda control diagnosis" /end FUNCTION
/begin FUNCTION DIA_Upstream_oxygen_sensor_heate "_Upstream oxygen sensor heater diagnosis" /begin DEF_CHARACTERISTIC c_teg_cat_up_mdl_min_lsh_diag /end DEF_CHARACTERISTIC
 /begin OUT_MEASUREMENT lv_err_lsh_up_1 lv_err_lsh_up_2 lv_inh_diag_lsh_up_2 cdn_diag_lsh_up_1 cdn_diag_lsh_up_2 ctr_det_lsh_up_1 ctr_det_lsh_up_2 ctr_ready_lsh_up_1 ctr_ready_lsh_up_2 lv_inh_diag_lsh_up_1 /end OUT_MEASUREMENT
/end FUNCTION
/begin FUNCTION DIA_Downstream_oxygen_sensor_hea "_Downstream oxygen sensor heater diagnosis" /begin DEF_CHARACTERISTIC c_teg_cat_down_mdl_min_lsh_diag /end DEF_CHARACTERISTIC
 /begin OUT_MEASUREMENT lv_err_lsh_down_1 cdn_diag_lsh_down_2 ctr_det_lsh_down_2 lv_inh_diag_lsh_down_2 cdn_diag_lsh_down_1 ctr_det_lsh_down_1 ctr_ready_lsh_down_1 ctr_ready_lsh_down_2 lv_inh_diag_lsh_down_1 /end OUT_MEASUREMENT
/end FUNCTION
/begin FUNCTION DIA_Oil_temperature_sensor_TOIL "_Oil temperature sensor TOIL" /begin DEF_CHARACTERISTIC c_toil_max_diag c_toil_min_diag c_tco_max_toil_diag /end DEF_CHARACTERISTIC /begin OUT_MEASUREMENT lv_err_toil /end OUT_MEASUREMENT /end FUNCTION
/begin FUNCTION DIA_Electronically_controlled_th "_Electronically controlled thermostat diagnosis (ECT)"
 /begin DEF_CHARACTERISTIC c_ect_el_pwm_diag_min_scb c_ect_el_pwm_diag_min_oc c_ect_el_pwm_diag_max_scg c_tco_st_ect_plaus_diag c_t_puc_tco_ex_plaus_diag c_tco_tco_ex_plaus_diag c_tco_ex_tco_ex_plaus_diag c_tam_min_tco_ex_plaus_diag c_tco_tco_ex_plaus_diag_min c_n_min_ect_plaus_diag /end DEF_CHARACTERISTIC
 /begin OUT_MEASUREMENT lv_err_ect_el lv_inh_diag_ect_el ctr_det_ect_el ctr_ready_ect_el cdn_diag_ect_el lv_err_ect t_puc_int_ect_diag /end OUT_MEASUREMENT
/end FUNCTION
/begin FUNCTION DIA_Knock_sensor_diagnosis "_Knock sensor diagnosis"
 /begin DEF_CHARACTERISTIC c_n_min_knks_diag c_maf_min_knks_diag c_nl_min_diag c_nl_max_diag /end DEF_CHARACTERISTIC
 /begin OUT_MEASUREMENT lv_err_knks_1 lv_err_knks_2 /end OUT_MEASUREMENT
/end FUNCTION
/begin FUNCTION DIA_Vehicle_speed_signal_diagnos "_Vehicle speed signal diagnosis" /begin DEF_CHARACTERISTIC c_maf_vs_min_diag c_n_vs_min_diag c_t_vs_min_diag /end DEF_CHARACTERISTIC /begin OUT_MEASUREMENT t_vs_diag t_vs_end_diag /end OUT_MEASUREMENT /end FUNCTION
/begin FUNCTION DIA_Ignition_system_diagnosis "_Ignition system diagnosis"
 /begin DEF_CHARACTERISTIC c_iga_off_cycnr_hld c_abc_td_igc_cut c_sum_td_igc_cut c_tco_min_dur_igc_diag id_v_dur_igc_min__n__maf c_esb_ign_cut_diag /end DEF_CHARACTERISTIC
 /begin OUT_MEASUREMENT lv_inh_igc[0] lv_inh_igc[1] lv_inh_igc[2] lv_inh_igc[3] lv_inh_igc[4] lv_inh_igc[5] lv_err_igc igc_diag_mis lv_err_td_igc_cut_0 lv_err_td_igc_cut_1 lv_err_td_igc_cut_2 lv_err_td_igc_cut_3 lv_err_td_igc_cut_4 lv_err_td_igc_cut_5 lv_err_dur_igc_1 lv_err_dur_igc_2 lv_err_dur_igc_3 lv_err_dur_igc_4 lv_err_dur_igc_5 lv_err_dur_igc_0 /end OUT_MEASUREMENT
/end FUNCTION
/begin FUNCTION DIA_Throttle_position_sensor_dia "_Throttle position sensor diagnosis"
 /begin DEF_CHARACTERISTIC c_v_tps_min_diag_1 c_v_tps_min_diag_2 c_v_tps_max_diag_2 c_v_tps_max_diag_1 c_v_tps_ratio_hys c_maf_mes_max_tps_diag ip_maf_add_tia_fac__tia ip_fac_tco_tqi__tco c_tps_maf_dif_mmv_thd c_tps_maf_crlc_dif c_t_tps_dif_int c_tps_maf_dif_int_thd c_maf_dif_tps_diag ip_maf_1_diag__n__tps_av ip_tps_max_tps_ratio_diag /end DEF_CHARACTERISTIC
 /begin OUT_MEASUREMENT tps_maf_dif_2 tps_maf_dif_int_2 tps_maf_dif_int_1 maf_sub_1 maf_sub_2 lv_err_tps_ratio tps_maf_dif_1 tps_maf_dif_mmv_1 tps_maf_dif_mmv_2 lv_err_tps_2 lv_err_tps_maf_1 lv_err_tps_maf_2 lv_err_tps_1 /end OUT_MEASUREMENT
/end FUNCTION
/begin FUNCTION DIA_Injection_valves_IV_1_to_6 "_Injection valves IV 1 to 6" /begin DEF_CHARACTERISTIC ip_n_max_iv_diag /end DEF_CHARACTERISTIC
 /begin OUT_MEASUREMENT lv_err_iv_0 iv_diag_mis lv_err_iv_5 lv_err_iv_4 lv_err_iv_3 lv_err_iv_2 lv_err_iv_1 /end OUT_MEASUREMENT
/end FUNCTION
/begin FUNCTION DIA_Error_memory_interface "_Error-memory interface" /end FUNCTION
/begin FUNCTION DIA_Canister_purge_valve_diagnos "_Canister purge valve diagnosis (CPS)"
 /begin DEF_CHARACTERISTIC c_cppwm_sub_diag_1 c_cppwm_sub_diag_2 c_cps_pwm_diag_min_scb c_cps_pwm_diag_min_oc c_cps_pwm_diag_max_scg /end DEF_CHARACTERISTIC
 /begin OUT_MEASUREMENT lv_err_cps cppwm_lih lv_inh_diag_cps ctr_det_cps ctr_ready_cps cdn_diag_cps /end OUT_MEASUREMENT
/end FUNCTION
/begin FUNCTION DIA_ETC_driver_diagnosis "_ETC driver diagnosis" /begin OUT_MEASUREMENT lv_err_mtc_dr /end OUT_MEASUREMENT /end FUNCTION
/begin FUNCTION DIA_Lambda_sensor_upstream_heate "_Lambda sensor upstream heater diagnosis" /end FUNCTION
/begin FUNCTION DIA_Lambda_sensor_downstream_hea "_Lambda sensor downstream heater diagnosis" /begin OUT_MEASUREMENT lv_err_lsh_down_2 /end OUT_MEASUREMENT /end FUNCTION
/begin FUNCTION DIA_Generator_diagnosis "_Generator diagnosis"
 /begin DEF_CHARACTERISTIC c_t_ast_gen_diag_off c_t_ast_gen_diag_on c_dffgen_thd_min c_dffgen_thd_max c_vb_mes_gen_diag_thd_max c_vb_mes_gen_diag_thd c_perc_gen_diag_vb_max /end DEF_CHARACTERISTIC
 /begin OUT_MEASUREMENT lv_gen_err_mec_act lv_gen_err_temp_act lv_gen_err_el_act lv_gen_err_plaus_act lv_gen_err_tout_act lv_gen_err_act lv_err_gen lv_err_gen_diag ctr_ref_gen_diag ctr_diag_gen_diag lv_err_gen_if /end OUT_MEASUREMENT
/end FUNCTION
/begin FUNCTION DIA_Crankshaft_Signal_Diagnosis_ "_Crankshaft Signal Diagnosis and Plausibility Check"
 /begin DEF_CHARACTERISTIC lc_inh_det_rev_eng c_cam_edge_sum_max c_cam_det_rev_eng_max c_cam_det_rev_eng_min /end DEF_CHARACTERISTIC
 /begin OUT_MEASUREMENT state_crk_diag state_crk_syn state_syn_req lv_det_rev_eng lv_err_crk_not_plaus lv_err_eng_psn lv_err_tooth_per lv_err_tpu_syn lv_err_crk ctr_crk_eng_psn_err_prev ctr_crk_tooth_per_err_prev ctr_crk_tooth_per_err ctr_crk_eng_psn_err crk_eng_psn_err_cnd_n_32 crk_tooth_per_err_cnd_n_32 crk_tooth_per_err_cnd_vb crk_eng_psn_err_cnd_vb n_32_crk_diag /end OUT_MEASUREMENT
/end FUNCTION
/begin FUNCTION DIA_Camshaft_Sensor_Diagnosis_an "_Camshaft Sensor Diagnosis and Plausibility Check"
 /begin DEF_CHARACTERISTIC id_win_bol_chk_cam_0 id_win_bol_chk_cam_1 id_win_tol_chk_cam_1 id_win_tol_chk_cam_0 c_t_cam_diag_max c_t_max_cam_tooth_per c_cam_edge_ebr_det_0_max id_win_bol_chk_cam_low_0 id_win_tol_chk_cam_low_0 id_win_bol_chk_cam_low_1 id_win_tol_chk_cam_low_1 c_cam_edge_dif_max c_cam_edge_ctr_diag_low /end DEF_CHARACTERISTIC
 /begin OUT_MEASUREMENT lv_err_cam_0 cam_edge_ctr_0 cam_edge_1 state_cam_edge_ctr_0 state_cam_edge_ctr_1 lv_err_cam lv_err_cam_1 lv_cam_syn_det_0 lv_cam_syn_det_1 cam_edge_ctr_1 cam_edge_ctr_diag_1 cam_edge_0 state_cam_syn cam_edge_ctr_diag_0 t_max_cam_tooth_per_0 t_max_cam_tooth_per_1 lv_err_cam_0_not_plaus lv_err_cam_1_not_plaus lv_err_cam_per_0 lv_err_cam_per_1 lv_err_cam_psn_0 lv_err_cam_psn_1 t_cam_diag_0 t_cam_diag_1 /end OUT_MEASUREMENT
/end FUNCTION
/begin FUNCTION DIA_Secondary_Air_Valve_Diagnosi "_Secondary Air Valve Diagnosis (SAV)"
 /begin OUT_MEASUREMENT cdn_diag_sav lv_err_sav lv_inh_diag_sav ctr_det_sav ctr_ready_sav /end OUT_MEASUREMENT
/end FUNCTION
/begin FUNCTION DIA_Electronical_Cooling_Fan_Dia "_Electronical Cooling Fan Diagnosis (ECF)"
 /begin OUT_MEASUREMENT lv_inh_diag_ecf ctr_det_ecf ctr_ready_ecf cdn_diag_ecf lv_err_ecf /end OUT_MEASUREMENT
/end FUNCTION
/begin FUNCTION DIA_Secondary_Air_Pump_Diagnosis "_Secondary Air Pump Diagnosis (SAP)"
 /begin OUT_MEASUREMENT lv_err_sap lv_inh_diag_sap cdn_diag_sap ctr_det_sap ctr_ready_sap /end OUT_MEASUREMENT
/end FUNCTION
/begin FUNCTION DIA_Air_Condition_Compressor_Con "_Air Condition Compressor Control Relay Diagnosis (RLY_ACCOUT)"
 /begin OUT_MEASUREMENT cdn_diag_rly_accout ctr_det_rly_accout ctr_ready_rly_accout lv_err_rly_accout lv_inh_diag_rly_accout /end OUT_MEASUREMENT
/end FUNCTION
/begin FUNCTION DIA_Main_Relay_Diagnosis__RLY_MA "_Main Relay Diagnosis (RLY_MAIN)"
 /begin DEF_CHARACTERISTIC c_t_rly_main_diag c_vb_rly_main_diag c_v_igk_rly_main_diag c_t_dly_rly_main_diag c_t_predrive_dly_max /end DEF_CHARACTERISTIC
 /begin OUT_MEASUREMENT t_rly_main_diag lv_err_bn_veh_mod lv_err_rly_main_dly lv_err_rly_main /end OUT_MEASUREMENT
/end FUNCTION
/begin FUNCTION DIA_Coolant_Temperature_Sensor_D "_Coolant Temperature Sensor Diagnosis (TCO)"
 /begin DEF_CHARACTERISTIC ip_tco_sub_dif_min_diag__tco_st ip_tco_mes_dif_min_diag__tco_st c_t_tia_tco_diag c_tco_grd_max_diag c_tco_max_diag c_tco_min_diag c_tia_tco_diag /end DEF_CHARACTERISTIC
 /begin OUT_MEASUREMENT tco_dif_diag tco_min_diag tco_max_diag tco_sub_dif_diag tco_sub_min_diag tco_sub_max_diag lv_err_tco lv_err_tco_el lv_err_tco_stuck lv_err_tco_grd /end OUT_MEASUREMENT
/end FUNCTION
/begin FUNCTION DIA_TCO_Sensor_Plausibility_Diag "_TCO-Sensor Plausibility Diagnosis for Lambda Control Activation Monitoring" /begin DEF_CHARACTERISTIC id_t_tco_min__tco_st /end DEF_CHARACTERISTIC /begin OUT_MEASUREMENT lv_err_tco_plaus t_tco_min /end OUT_MEASUREMENT /end FUNCTION
/begin FUNCTION DIA_Idle_Speed_Control_Diagnosis "_Idle Speed Control Diagnosis" /begin DEF_CHARACTERISTIC c_isapwm_ldc_max /end DEF_CHARACTERISTIC /begin OUT_MEASUREMENT lv_inh_diag_isc /end OUT_MEASUREMENT /end FUNCTION
/begin FUNCTION DIA_CAN_diagnosis "_CAN diagnosis"
 /begin DEF_CHARACTERISTIC c_asr_3_cycnr_max c_asr_1_cycnr_max c_asr_4_cycnr_max c_etcu_1_cycnr_max c_etcu_2_cycnr_max c_icl_2_cycnr_max c_icl_3_cycnr_max c_pste_1_cycnr_max c_ctr_diag_tcc_can_max_amt_1 c_ctr_diag_cpl_can_max_amt_1 c_amt_1_cycnr_max c_txu_1_cycnr_max /end DEF_CHARACTERISTIC
 /begin OUT_MEASUREMENT lv_err_can_boff cyc_ctr_asr_3_diag cyc_ctr_asr_1_diag lv_err_tout_asr_1 lv_err_tout_asr_3 cyc_ctr_asr_4_diag lv_err_tout_asr_4 cyc_ctr_etcu_1_diag cyc_ctr_etcu_2_diag cyc_ctr_icl_2_diag cyc_ctr_icl_3_diag cyc_ctr_pste_1_diag cyc_ctr_amt_1_diag cyc_ctr_txu_1_diag lv_err_tout_txu_1 lv_err_tout_etcu_2 lv_err_tout_icl_2 lv_err_tout_icl_3 lv_err_tout_amt_1 lv_err_tout_etcu_1 lv_err_tout_pste_1 /end OUT_MEASUREMENT
/end FUNCTION
/begin FUNCTION DIA_Multifunctional_steering_whe "_Multifunctional steering wheel (MSW)"
 /begin DEF_CHARACTERISTIC c_vb_min_msw_diag c_t_min_msw_bit_diag c_t_max_msw_bit_diag /end DEF_CHARACTERISTIC
 /begin OUT_MEASUREMENT lv_err_msw_3 lv_err_msw_tog lv_err_msw_2 /end OUT_MEASUREMENT
/end FUNCTION
/begin FUNCTION DIA_Pedal_value_sensor_diagnosis "_Pedal value sensor diagnosis"
 /begin DEF_CHARACTERISTIC c_v_pvs_min_diag_2 c_t_is_pvs_err ip_pvs_ratio_hys c_n_pvs_bls_bts_plaus c_vs_pvs_bls_bts_plaus c_pv_av_pvs_bls_bts_plaus c_ctr_max_pv_av_con c_pv_av_hys_bls_bts_plaus c_pvs_bls_bts_plaus_conf c_vcc_dif_pvs c_v_pvs_min_diag_1 c_v_pvs_min_diag_min_1 c_v_pvs_min_diag_min_2 c_v_pvs_max_diag_1 c_v_pvs_max_diag_2 /end DEF_CHARACTERISTIC
 /begin OUT_MEASUREMENT lv_dyn_lim_1_act lv_dyn_lim_2_act state_pvs_diag lv_n_sp_is_lih_act lv_err_pvs lv_det_not_plaus_act lv_pv_av_stat lv_pvs_bls_not_plaus_act ctr_pvs_bls_not_plaus_act lv_err_v_ref_2 lv_err_pvs_double lv_err_v_ref_1 lv_err_pvs_bls_not_plaus lv_det_err_pvs lv_err_pvs_2 lv_err_pvs_ratio lv_err_pvs_1 /end OUT_MEASUREMENT
/end FUNCTION
/begin FUNCTION DIA_Brake_light_switch_diagnosis "_Brake light switch diagnosis (BLS/BTS)" /begin DEF_CHARACTERISTIC c_t_bts_plaus_max /end DEF_CHARACTERISTIC
 /begin OUT_MEASUREMENT lv_brake_det lv_err_bls_plaus lv_err_im_bls_plaus lv_err_im_bts_plaus /end OUT_MEASUREMENT
/end FUNCTION
/begin FUNCTION DIA_Idle_Speed_Actuator_Diagnosi "_Idle Speed Actuator Diagnosis"
 /begin DEF_CHARACTERISTIC c_isa_pwm_diag_min_scb c_isa_pwm_diag_min_oc c_isa_pwm_diag_max_scg /end DEF_CHARACTERISTIC
 /begin OUT_MEASUREMENT cdn_diag_isa_2 ctr_det_isa_2 ctr_ready_isa_2 lv_err_isa_2 lv_err_isa_1 lv_inh_diag_isa_2 state_isa_diag ctr_det_isa_1 ctr_ready_isa_1 lv_inh_diag_isa_1 cdn_diag_isa_1 /end OUT_MEASUREMENT
/end FUNCTION
/begin FUNCTION DIA_Engine_roughness_idle_diagno "_Engine roughness idle diagnosis"
 /begin DEF_CHARACTERISTIC ip_thd_is_er_diag__n__maf ip_fac_thd_is_er_diag__tco c_crlc_is_er_diag /end DEF_CHARACTERISTIC
 /begin OUT_MEASUREMENT er_mmv_is_diag[0] er_mmv_is_diag[1] er_mmv_is_diag[2] er_mmv_is_diag[3] er_mmv_is_diag[4] er_mmv_is_diag[5] /end OUT_MEASUREMENT
/end FUNCTION
/begin FUNCTION DIA_Variable_Intake_Manifold__VI "_Variable Intake Manifold (VIM) H-Bridge Diagnosis"
 /begin OUT_MEASUREMENT lv_err_vim lv_inh_diag_vim cdn_diag_vim ctr_det_vim ctr_ready_vim /end OUT_MEASUREMENT
/end FUNCTION
/begin FUNCTION DIA_Immobilizer_signal_diagnosis "_Immobilizer signal diagnosis" /begin DEF_CHARACTERISTIC c_tout_imob /end DEF_CHARACTERISTIC
 /begin OUT_MEASUREMENT lv_err_imob_2 lv_err_imob_1 lv_err_imob_3 lv_lock_imob inh_iv_imob ctr_err_imob_2 ctr_err_imob_1 /end OUT_MEASUREMENT
/end FUNCTION
/begin FUNCTION DIA_Exhaust_flap_diagnosis "_Exhaust flap diagnosis"
 /begin OUT_MEASUREMENT cdn_diag_ef lv_err_ef lv_inh_diag_ef ctr_det_ef ctr_ready_ef /end OUT_MEASUREMENT
/end FUNCTION
/begin FUNCTION DIA_Anti_bounce_algorithm "_Anti-bounce-algorithm"
 /begin OUT_MEASUREMENT fmy_stat_toil.ctr_abc fmy_stat_toil.ctr_end_diag fmy_stat_toil.err_info_stat.lv_err_mem fmy_stat_toil.err_info_stat.lv_ready fmy_stat_toil.err_info_stat.lv_end_diag fmy_stat_toil.err_info_stat.lv_cdn_diag fmy_stat_toil.err_info_stat.err_sym fmy_stat_tco_ex.ctr_abc fmy_stat_tco_ex.ctr_end_diag fmy_stat_tco_ex.err_info_stat.lv_err_mem fmy_stat_tco_ex.err_info_stat.lv_ready fmy_stat_tco_ex.err_info_stat.lv_end_diag fmy_stat_tco_ex.err_info_stat.lv_cdn_diag fmy_stat_tco_ex.err_info_stat.err_sym fmy_stat_tia.ctr_abc fmy_stat_tia.ctr_end_diag fmy_stat_tia.err_info_stat.lv_err_mem fmy_stat_tia.err_info_stat.lv_ready fmy_stat_tia.err_info_stat.lv_end_diag fmy_stat_tia.err_info_stat.lv_cdn_diag fmy_stat_tia.err_info_stat.err_sym fmy_stat_amp.ctr_abc fmy_stat_amp.ctr_end_diag fmy_stat_amp.err_info_stat.lv_err_mem fmy_stat_amp.err_info_stat.lv_ready fmy_stat_amp.err_info_stat.lv_end_diag fmy_stat_amp.err_info_stat.lv_cdn_diag fmy_stat_amp.err_info_stat.err_sym fmy_stat_maf.ctr_abc fmy_stat_maf.ctr_end_diag fmy_stat_maf.err_info_stat.lv_err_mem fmy_stat_maf.err_info_stat.lv_ready fmy_stat_maf.err_info_stat.lv_end_diag fmy_stat_maf.err_info_stat.lv_cdn_diag fmy_stat_maf.err_info_stat.err_sym fmy_stat_vls_down_max_1.ctr_abc fmy_stat_vls_down_max_1.ctr_end_diag fmy_stat_vls_down_max_1.err_info_stat.lv_err_mem fmy_stat_vls_down_max_1.err_info_stat.lv_ready fmy_stat_vls_down_max_1.err_info_stat.lv_end_diag fmy_stat_vls_down_max_1.err_info_stat.lv_cdn_diag fmy_stat_vls_down_max_1.err_info_stat.err_sym fmy_stat_vls_down_max_2.ctr_abc fmy_stat_vls_down_max_2.ctr_end_diag fmy_stat_vls_down_max_2.err_info_stat.lv_err_mem fmy_stat_vls_down_max_2.err_info_stat.lv_ready fmy_stat_vls_down_max_2.err_info_stat.lv_end_diag fmy_stat_vls_down_max_2.err_info_stat.lv_cdn_diag fmy_stat_vls_down_max_2.err_info_stat.err_sym fmy_stat_vls_down_min_cold_1.ctr_abc fmy_stat_vls_down_min_cold_1.ctr_end_diag fmy_stat_vls_down_min_cold_1.err_info_stat.lv_err_mem fmy_stat_vls_down_min_cold_1.err_info_stat.lv_ready fmy_stat_vls_down_min_cold_1.err_info_stat.lv_end_diag fmy_stat_vls_down_min_cold_1.err_info_stat.lv_cdn_diag fmy_stat_vls_down_min_cold_1.err_info_stat.err_sym fmy_stat_vls_down_min_cold_2.ctr_abc fmy_stat_vls_down_min_cold_2.ctr_end_diag fmy_stat_vls_down_min_cold_2.err_info_stat.lv_err_mem fmy_stat_vls_down_min_cold_2.err_info_stat.lv_ready fmy_stat_vls_down_min_cold_2.err_info_stat.lv_end_diag fmy_stat_vls_down_min_cold_2.err_info_stat.lv_cdn_diag fmy_stat_vls_down_min_cold_2.err_info_stat.err_sym fmy_stat_vls_down_min_1.ctr_abc fmy_stat_vls_down_min_1.ctr_end_diag fmy_stat_vls_down_min_1.err_info_stat.lv_err_mem fmy_stat_vls_down_min_1.err_info_stat.lv_ready fmy_stat_vls_down_min_1.err_info_stat.lv_end_diag fmy_stat_vls_down_min_1.err_info_stat.lv_cdn_diag fmy_stat_vls_down_min_1.err_info_stat.err_sym fmy_stat_vls_down_min_2.ctr_abc fmy_stat_vls_down_min_2.ctr_end_diag fmy_stat_vls_down_min_2.err_info_stat.lv_err_mem fmy_stat_vls_down_min_2.err_info_stat.lv_ready fmy_stat_vls_down_min_2.err_info_stat.lv_end_diag fmy_stat_vls_down_min_2.err_info_stat.lv_cdn_diag fmy_stat_vls_down_min_2.err_info_stat.err_sym fmy_stat_vls_down_oc_1.ctr_abc fmy_stat_vls_down_oc_1.ctr_end_diag fmy_stat_vls_down_oc_1.err_info_stat.lv_err_mem fmy_stat_vls_down_oc_1.err_info_stat.lv_ready fmy_stat_vls_down_oc_1.err_info_stat.lv_end_diag fmy_stat_vls_down_oc_1.err_info_stat.lv_cdn_diag fmy_stat_vls_down_oc_1.err_info_stat.err_sym fmy_stat_vls_down_oc_2.ctr_abc fmy_stat_vls_down_oc_2.ctr_end_diag fmy_stat_vls_down_oc_2.err_info_stat.lv_err_mem fmy_stat_vls_down_oc_2.err_info_stat.lv_ready fmy_stat_vls_down_oc_2.err_info_stat.lv_end_diag fmy_stat_vls_down_oc_2.err_info_stat.lv_cdn_diag fmy_stat_vls_down_oc_2.err_info_stat.err_sym fmy_stat_iv_0.ctr_abc fmy_stat_iv_0.ctr_end_diag fmy_stat_iv_0.err_info_stat.lv_err_mem fmy_stat_iv_0.err_info_stat.lv_ready fmy_stat_iv_0.err_info_stat.lv_end_diag fmy_stat_iv_0.err_info_stat.lv_cdn_diag fmy_stat_iv_0.err_info_stat.err_sym fmy_stat_iv_1.ctr_abc fmy_stat_iv_1.ctr_end_diag fmy_stat_iv_1.err_info_stat.lv_err_mem fmy_stat_iv_1.err_info_stat.lv_ready fmy_stat_iv_1.err_info_stat.lv_end_diag fmy_stat_iv_1.err_info_stat.lv_cdn_diag fmy_stat_iv_1.err_info_stat.err_sym fmy_stat_iv_2.ctr_abc fmy_stat_iv_2.ctr_end_diag fmy_stat_iv_2.err_info_stat.lv_err_mem fmy_stat_iv_2.err_info_stat.lv_ready fmy_stat_iv_2.err_info_stat.lv_end_diag fmy_stat_iv_2.err_info_stat.lv_cdn_diag fmy_stat_iv_2.err_info_stat.err_sym fmy_stat_iv_3.ctr_abc fmy_stat_iv_3.ctr_end_diag fmy_stat_iv_3.err_info_stat.lv_err_mem fmy_stat_iv_3.err_info_stat.lv_ready fmy_stat_iv_3.err_info_stat.lv_end_diag fmy_stat_iv_3.err_info_stat.lv_cdn_diag fmy_stat_iv_3.err_info_stat.err_sym fmy_stat_iv_4.ctr_abc fmy_stat_iv_4.ctr_end_diag fmy_stat_iv_4.err_info_stat.lv_err_mem fmy_stat_iv_4.err_info_stat.lv_ready fmy_stat_iv_4.err_info_stat.lv_end_diag fmy_stat_iv_4.err_info_stat.lv_cdn_diag fmy_stat_iv_4.err_info_stat.err_sym fmy_stat_iv_5.ctr_abc fmy_stat_iv_5.ctr_end_diag fmy_stat_iv_5.err_info_stat.lv_err_mem fmy_stat_iv_5.err_info_stat.lv_ready fmy_stat_iv_5.err_info_stat.lv_end_diag fmy_stat_iv_5.err_info_stat.lv_cdn_diag fmy_stat_iv_5.err_info_stat.err_sym fmy_stat_lsh_up_1.err_info_stat.lv_err_mem fmy_stat_lsh_up_1.err_info_stat.lv_ready fmy_stat_lsh_up_1.err_info_stat.lv_end_diag fmy_stat_lsh_up_1.err_info_stat.lv_cdn_diag fmy_stat_lsh_up_1.err_info_stat.err_sym fmy_stat_lsh_up_2.err_info_stat.lv_err_mem fmy_stat_lsh_up_2.err_info_stat.lv_ready fmy_stat_lsh_up_2.err_info_stat.lv_end_diag fmy_stat_lsh_up_2.err_info_stat.lv_cdn_diag fmy_stat_lsh_up_2.err_info_stat.err_sym fmy_stat_lsh_down_1.err_info_stat.lv_err_mem fmy_stat_lsh_down_1.err_info_stat.lv_ready fmy_stat_lsh_down_1.err_info_stat.lv_end_diag fmy_stat_lsh_down_1.err_info_stat.lv_cdn_diag fmy_stat_lsh_down_1.err_info_stat.err_sym fmy_stat_lsh_down_2.err_info_stat.lv_err_mem fmy_stat_lsh_down_2.err_info_stat.lv_ready fmy_stat_lsh_down_2.err_info_stat.lv_end_diag fmy_stat_lsh_down_2.err_info_stat.lv_cdn_diag fmy_stat_lsh_down_2.err_info_stat.err_sym fmy_stat_rly_efp.ctr_abc fmy_stat_rly_efp.ctr_end_diag fmy_stat_rly_efp.err_info_stat.lv_err_mem fmy_stat_rly_efp.err_info_stat.lv_ready fmy_stat_rly_efp.err_info_stat.lv_end_diag fmy_stat_rly_efp.err_info_stat.lv_cdn_diag fmy_stat_rly_efp.err_info_stat.err_sym fmy_stat_cps.err_info_stat.lv_err_mem fmy_stat_cps.err_info_stat.lv_ready fmy_stat_cps.err_info_stat.lv_end_diag fmy_stat_cps.err_info_stat.lv_cdn_diag fmy_stat_cps.err_info_stat.err_sym fmy_stat_mec_ivvt_in_1.ctr_abc fmy_stat_mec_ivvt_in_1.ctr_end_diag fmy_stat_mec_ivvt_in_1.err_info_stat.lv_err_mem fmy_stat_mec_ivvt_in_1.err_info_stat.lv_ready fmy_stat_mec_ivvt_in_1.err_info_stat.lv_end_diag fmy_stat_mec_ivvt_in_1.err_info_stat.lv_cdn_diag fmy_stat_mec_ivvt_in_1.err_info_stat.err_sym fmy_stat_mec_ivvt_ex_1.ctr_abc fmy_stat_mec_ivvt_ex_1.ctr_end_diag fmy_stat_mec_ivvt_ex_1.err_info_stat.lv_err_mem fmy_stat_mec_ivvt_ex_1.err_info_stat.lv_ready fmy_stat_mec_ivvt_ex_1.err_info_stat.lv_end_diag fmy_stat_mec_ivvt_ex_1.err_info_stat.lv_cdn_diag fmy_stat_mec_ivvt_ex_1.err_info_stat.err_sym fmy_stat_ref_ivvt_in_1.ctr_abc fmy_stat_ref_ivvt_in_1.ctr_end_diag fmy_stat_ref_ivvt_in_1.err_info_stat.lv_err_mem fmy_stat_ref_ivvt_in_1.err_info_stat.lv_ready fmy_stat_ref_ivvt_in_1.err_info_stat.lv_end_diag fmy_stat_ref_ivvt_in_1.err_info_stat.lv_cdn_diag fmy_stat_ref_ivvt_in_1.err_info_stat.err_sym fmy_stat_ref_ivvt_ex_1.ctr_abc fmy_stat_ref_ivvt_ex_1.ctr_end_diag fmy_stat_ref_ivvt_ex_1.err_info_stat.lv_err_mem fmy_stat_ref_ivvt_ex_1.err_info_stat.lv_ready fmy_stat_ref_ivvt_ex_1.err_info_stat.lv_end_diag fmy_stat_ref_ivvt_ex_1.err_info_stat.lv_cdn_diag fmy_stat_ref_ivvt_ex_1.err_info_stat.err_sym fmy_stat_slv_ivvt_in_1.err_info_stat.lv_err_mem fmy_stat_slv_ivvt_in_1.err_info_stat.lv_ready fmy_stat_slv_ivvt_in_1.err_info_stat.lv_end_diag fmy_stat_slv_ivvt_in_1.err_info_stat.lv_cdn_diag fmy_stat_slv_ivvt_in_1.err_info_stat.err_sym fmy_stat_slv_ivvt_ex_1.err_info_stat.lv_err_mem fmy_stat_slv_ivvt_ex_1.err_info_stat.lv_ready fmy_stat_slv_ivvt_ex_1.err_info_stat.lv_end_diag fmy_stat_slv_ivvt_ex_1.err_info_stat.lv_cdn_diag fmy_stat_slv_ivvt_ex_1.err_info_stat.err_sym fmy_stat_park_ivvt_in_1.ctr_abc fmy_stat_park_ivvt_in_1.ctr_end_diag fmy_stat_park_ivvt_in_1.err_info_stat.lv_err_mem fmy_stat_park_ivvt_in_1.err_info_stat.lv_ready fmy_stat_park_ivvt_in_1.err_info_stat.lv_end_diag fmy_stat_park_ivvt_in_1.err_info_stat.lv_cdn_diag fmy_stat_park_ivvt_in_1.err_info_stat.err_sym fmy_stat_park_ivvt_ex_1.ctr_abc fmy_stat_park_ivvt_ex_1.ctr_end_diag fmy_stat_park_ivvt_ex_1.err_info_stat.lv_err_mem fmy_stat_park_ivvt_ex_1.err_info_stat.lv_ready fmy_stat_park_ivvt_ex_1.err_info_stat.lv_end_diag fmy_stat_park_ivvt_ex_1.err_info_stat.lv_cdn_diag fmy_stat_park_ivvt_ex_1.err_info_stat.err_sym fmy_stat_ecu_cks.ctr_abc fmy_stat_ecu_cks.ctr_end_diag fmy_stat_ecu_cks.err_info_stat.lv_err_mem fmy_stat_ecu_cks.err_info_stat.lv_ready fmy_stat_ecu_cks.err_info_stat.lv_end_diag fmy_stat_ecu_cks.err_info_stat.lv_cdn_diag fmy_stat_ecu_cks.err_info_stat.err_sym fmy_stat_toil_level.ctr_abc fmy_stat_toil_level.ctr_end_diag fmy_stat_toil_level.err_info_stat.lv_err_mem fmy_stat_toil_level.err_info_stat.lv_ready fmy_stat_toil_level.err_info_stat.lv_end_diag fmy_stat_toil_level.err_info_stat.lv_cdn_diag fmy_stat_toil_level.err_info_stat.err_sym fmy_stat_tout_etcu_1.ctr_abc fmy_stat_tout_etcu_1.ctr_end_diag fmy_stat_tout_etcu_1.err_info_stat.lv_err_mem fmy_stat_tout_etcu_1.err_info_stat.lv_ready fmy_stat_tout_etcu_1.err_info_stat.lv_end_diag fmy_stat_tout_etcu_1.err_info_stat.lv_cdn_diag fmy_stat_tout_etcu_1.err_info_stat.err_sym fmy_stat_tout_etcu_2.ctr_abc fmy_stat_tout_etcu_2.ctr_end_diag fmy_stat_tout_etcu_2.err_info_stat.lv_err_mem fmy_stat_tout_etcu_2.err_info_stat.lv_ready fmy_stat_tout_etcu_2.err_info_stat.lv_end_diag fmy_stat_tout_etcu_2.err_info_stat.lv_cdn_diag fmy_stat_tout_etcu_2.err_info_stat.err_sym fmy_stat_tout_icl_2.ctr_abc fmy_stat_tout_icl_2.ctr_end_diag fmy_stat_tout_icl_2.err_info_stat.lv_err_mem fmy_stat_tout_icl_2.err_info_stat.lv_ready fmy_stat_tout_icl_2.err_info_stat.lv_end_diag fmy_stat_tout_icl_2.err_info_stat.lv_cdn_diag fmy_stat_tout_icl_2.err_info_stat.err_sym fmy_stat_tout_icl_3.ctr_abc fmy_stat_tout_icl_3.ctr_end_diag fmy_stat_tout_icl_3.err_info_stat.lv_err_mem fmy_stat_tout_icl_3.err_info_stat.lv_ready fmy_stat_tout_icl_3.err_info_stat.lv_end_diag fmy_stat_tout_icl_3.err_info_stat.lv_cdn_diag fmy_stat_tout_icl_3.err_info_stat.err_sym fmy_stat_tout_asr_1.ctr_abc fmy_stat_tout_asr_1.ctr_end_diag fmy_stat_tout_asr_1.err_info_stat.lv_err_mem fmy_stat_tout_asr_1.err_info_stat.lv_ready fmy_stat_tout_asr_1.err_info_stat.lv_end_diag fmy_stat_tout_asr_1.err_info_stat.lv_cdn_diag fmy_stat_tout_asr_1.err_info_stat.err_sym fmy_stat_tout_asr_3.ctr_abc fmy_stat_tout_asr_3.ctr_end_diag fmy_stat_tout_asr_3.err_info_stat.lv_err_mem fmy_stat_tout_asr_3.err_info_stat.lv_ready fmy_stat_tout_asr_3.err_info_stat.lv_end_diag fmy_stat_tout_asr_3.err_info_stat.lv_cdn_diag fmy_stat_tout_asr_3.err_info_stat.err_sym fmy_stat_tout_asr_4.ctr_abc fmy_stat_tout_asr_4.ctr_end_diag /end OUT_MEASUREMENT
/end FUNCTION
/end MODULE
/end PROJECT
