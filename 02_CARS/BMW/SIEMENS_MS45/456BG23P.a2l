ASAP2_VERSION 1 31
/begin PROJECT MS45 "BMW Motorsteuerung R6"
/begin HEADER "_default_HeaderComment" PROJECT_NO _56 /end HEADER
/begin MODULE _default_ModuleName "_default_ModuleLongIdentifier"
/begin MOD_COMMON "_default_ModCommonComment" DEPOSIT ABSOLUTE BYTE_ORDER MSB_FIRST ALIGNMENT_BYTE 1 ALIGNMENT_WORD 2 ALIGNMENT_LONG 4 ALIGNMENT_FLOAT32_IEEE 4 ALIGNMENT_FLOAT64_IEEE 8 /end MOD_COMMON
/begin CHARACTERISTIC fmy_id_toil.dtc "" CURVE 0x01bca _REC_CUR_20_u2_u2 65535. _CNV_A_R_LINEAR_____1_CM 0. 65535. DISPLAY_IDENTIFIER ID_ERR_DTC_TOIL FORMAT "%5.0"
 /begin AXIS_DESCR COM_AXIS online_dummy _CNV_A_R_LINEAR_____22_CM 6 0. 5. FORMAT "%2.0" AXIS_PTS_REF ldp_fmy_dtc /end AXIS_DESCR
/end CHARACTERISTIC
/begin CHARACTERISTIC fmy_id_toil.envd "" CURVE 0x01bd6 _REC_CUR_20_u1_u1 255. _CNV_A_R_LINEAR_____1_CM 0. 255. DISPLAY_IDENTIFIER ID_ERR_ENVD_TOIL FORMAT "%3.0"
 /begin AXIS_DESCR COM_AXIS online_dummy _CNV_A_R_LINEAR_____22_CM 4 0. 3. FORMAT "%2.0" AXIS_PTS_REF ldp_fmy_envd /end AXIS_DESCR
/end CHARACTERISTIC
/begin CHARACTERISTIC fmy_id_tco_ex.dtc "" CURVE 0x01bdc _REC_CUR_20_u2_u2 65535. _CNV_A_R_LINEAR_____1_CM 0. 65535. DISPLAY_IDENTIFIER ID_ERR_DTC_TCO_EX FORMAT "%5.0"
 /begin AXIS_DESCR COM_AXIS online_dummy _CNV_A_R_LINEAR_____22_CM 6 0. 5. FORMAT "%2.0" AXIS_PTS_REF ldp_fmy_dtc /end AXIS_DESCR
/end CHARACTERISTIC
/begin CHARACTERISTIC fmy_id_tco_ex.envd "" CURVE 0x01be8 _REC_CUR_20_u1_u1 255. _CNV_A_R_LINEAR_____1_CM 0. 255. DISPLAY_IDENTIFIER ID_ERR_ENVD_TCO_EX FORMAT "%3.0"
 /begin AXIS_DESCR COM_AXIS online_dummy _CNV_A_R_LINEAR_____22_CM 4 0. 3. FORMAT "%2.0" AXIS_PTS_REF ldp_fmy_envd /end AXIS_DESCR
/end CHARACTERISTIC
/begin CHARACTERISTIC fmy_id_tia.dtc "" CURVE 0x01bee _REC_CUR_20_u2_u2 65535. _CNV_A_R_LINEAR_____1_CM 0. 65535. DISPLAY_IDENTIFIER ID_ERR_DTC_TIA FORMAT "%5.0"
 /begin AXIS_DESCR COM_AXIS online_dummy _CNV_A_R_LINEAR_____22_CM 6 0. 5. FORMAT "%2.0" AXIS_PTS_REF ldp_fmy_dtc /end AXIS_DESCR
/end CHARACTERISTIC
/begin CHARACTERISTIC fmy_id_tia.envd "" CURVE 0x01bfa _REC_CUR_20_u1_u1 255. _CNV_A_R_LINEAR_____1_CM 0. 255. DISPLAY_IDENTIFIER ID_ERR_ENVD_TIA FORMAT "%3.0"
 /begin AXIS_DESCR COM_AXIS online_dummy _CNV_A_R_LINEAR_____22_CM 4 0. 3. FORMAT "%2.0" AXIS_PTS_REF ldp_fmy_envd /end AXIS_DESCR
/end CHARACTERISTIC
/begin CHARACTERISTIC fmy_id_amp.dtc "" CURVE 0x01c00 _REC_CUR_20_u2_u2 65535. _CNV_A_R_LINEAR_____1_CM 0. 65535. DISPLAY_IDENTIFIER ID_ERR_DTC_AMP FORMAT "%5.0"
 /begin AXIS_DESCR COM_AXIS online_dummy _CNV_A_R_LINEAR_____22_CM 6 0. 5. FORMAT "%2.0" AXIS_PTS_REF ldp_fmy_dtc /end AXIS_DESCR
/end CHARACTERISTIC
/begin CHARACTERISTIC fmy_id_amp.envd "" CURVE 0x01c0c _REC_CUR_20_u1_u1 255. _CNV_A_R_LINEAR_____1_CM 0. 255. DISPLAY_IDENTIFIER ID_ERR_ENVD_AMP FORMAT "%3.0"
 /begin AXIS_DESCR COM_AXIS online_dummy _CNV_A_R_LINEAR_____22_CM 4 0. 3. FORMAT "%2.0" AXIS_PTS_REF ldp_fmy_envd /end AXIS_DESCR
/end CHARACTERISTIC
/begin CHARACTERISTIC fmy_id_maf.dtc "" CURVE 0x01c12 _REC_CUR_20_u2_u2 65535. _CNV_A_R_LINEAR_____1_CM 0. 65535. DISPLAY_IDENTIFIER ID_ERR_DTC_MAF FORMAT "%5.0"
 /begin AXIS_DESCR COM_AXIS online_dummy _CNV_A_R_LINEAR_____22_CM 6 0. 5. FORMAT "%2.0" AXIS_PTS_REF ldp_fmy_dtc /end AXIS_DESCR
/end CHARACTERISTIC
/begin CHARACTERISTIC fmy_id_maf.envd "" CURVE 0x01c1e _REC_CUR_20_u1_u1 255. _CNV_A_R_LINEAR_____1_CM 0. 255. DISPLAY_IDENTIFIER ID_ERR_ENVD_MAF FORMAT "%3.0"
 /begin AXIS_DESCR COM_AXIS online_dummy _CNV_A_R_LINEAR_____22_CM 4 0. 3. FORMAT "%2.0" AXIS_PTS_REF ldp_fmy_envd /end AXIS_DESCR
/end CHARACTERISTIC
/begin CHARACTERISTIC fmy_id_vls_down_max_1.dtc "" CURVE 0x01c24 _REC_CUR_20_u2_u2 65535. _CNV_A_R_LINEAR_____1_CM 0. 65535. DISPLAY_IDENTIFIER ID_ERR_DTC_VLS_DOWN_MAX_1 FORMAT "%5.0"
 /begin AXIS_DESCR COM_AXIS online_dummy _CNV_A_R_LINEAR_____22_CM 6 0. 5. FORMAT "%2.0" AXIS_PTS_REF ldp_fmy_dtc /end AXIS_DESCR
/end CHARACTERISTIC
/begin CHARACTERISTIC fmy_id_vls_down_max_1.envd "" CURVE 0x01c30 _REC_CUR_20_u1_u1 255. _CNV_A_R_LINEAR_____1_CM 0. 255. DISPLAY_IDENTIFIER ID_ERR_ENVD_VLS_DOWN_MAX_1 FORMAT "%3.0"
 /begin AXIS_DESCR COM_AXIS online_dummy _CNV_A_R_LINEAR_____22_CM 4 0. 3. FORMAT "%2.0" AXIS_PTS_REF ldp_fmy_envd /end AXIS_DESCR
/end CHARACTERISTIC
/begin CHARACTERISTIC fmy_id_vls_down_max_2.dtc "" CURVE 0x01c36 _REC_CUR_20_u2_u2 65535. _CNV_A_R_LINEAR_____1_CM 0. 65535. DISPLAY_IDENTIFIER ID_ERR_DTC_VLS_DOWN_MAX_2 FORMAT "%5.0"
 /begin AXIS_DESCR COM_AXIS online_dummy _CNV_A_R_LINEAR_____22_CM 6 0. 5. FORMAT "%2.0" AXIS_PTS_REF ldp_fmy_dtc /end AXIS_DESCR
/end CHARACTERISTIC
/begin CHARACTERISTIC fmy_id_vls_down_max_2.envd "" CURVE 0x01c42 _REC_CUR_20_u1_u1 255. _CNV_A_R_LINEAR_____1_CM 0. 255. DISPLAY_IDENTIFIER ID_ERR_ENVD_VLS_DOWN_MAX_2 FORMAT "%3.0"
 /begin AXIS_DESCR COM_AXIS online_dummy _CNV_A_R_LINEAR_____22_CM 4 0. 3. FORMAT "%2.0" AXIS_PTS_REF ldp_fmy_envd /end AXIS_DESCR
/end CHARACTERISTIC
/begin CHARACTERISTIC fmy_id_vls_down_min_cold_1.dtc "" CURVE 0x01c48 _REC_CUR_20_u2_u2 65535. _CNV_A_R_LINEAR_____1_CM 0. 65535. DISPLAY_IDENTIFIER ID_ERR_DTC_VLS_DOWN_MIN_COLD_1 FORMAT "%5.0"
 /begin AXIS_DESCR COM_AXIS online_dummy _CNV_A_R_LINEAR_____22_CM 6 0. 5. FORMAT "%2.0" AXIS_PTS_REF ldp_fmy_dtc /end AXIS_DESCR
/end CHARACTERISTIC
/begin CHARACTERISTIC fmy_id_vls_down_min_cold_1.envd "" CURVE 0x01c54 _REC_CUR_20_u1_u1 255. _CNV_A_R_LINEAR_____1_CM 0. 255. DISPLAY_IDENTIFIER ID_ERR_ENVD_VLS_DOWN_MIN_COLD_1 FORMAT "%3.0"
 /begin AXIS_DESCR COM_AXIS online_dummy _CNV_A_R_LINEAR_____22_CM 4 0. 3. FORMAT "%2.0" AXIS_PTS_REF ldp_fmy_envd /end AXIS_DESCR
/end CHARACTERISTIC
/begin CHARACTERISTIC fmy_id_vls_down_min_cold_2.dtc "" CURVE 0x01c5a _REC_CUR_20_u2_u2 65535. _CNV_A_R_LINEAR_____1_CM 0. 65535. DISPLAY_IDENTIFIER ID_ERR_DTC_VLS_DOWN_MIN_COLD_2 FORMAT "%5.0"
 /begin AXIS_DESCR COM_AXIS online_dummy _CNV_A_R_LINEAR_____22_CM 6 0. 5. FORMAT "%2.0" AXIS_PTS_REF ldp_fmy_dtc /end AXIS_DESCR
/end CHARACTERISTIC
/begin CHARACTERISTIC fmy_id_vls_down_min_cold_2.envd "" CURVE 0x01c66 _REC_CUR_20_u1_u1 255. _CNV_A_R_LINEAR_____1_CM 0. 255. DISPLAY_IDENTIFIER ID_ERR_ENVD_VLS_DOWN_MIN_COLD_2 FORMAT "%3.0"
 /begin AXIS_DESCR COM_AXIS online_dummy _CNV_A_R_LINEAR_____22_CM 4 0. 3. FORMAT "%2.0" AXIS_PTS_REF ldp_fmy_envd /end AXIS_DESCR
/end CHARACTERISTIC
/begin CHARACTERISTIC fmy_id_vls_down_min_1.dtc "" CURVE 0x01c6c _REC_CUR_20_u2_u2 65535. _CNV_A_R_LINEAR_____1_CM 0. 65535. DISPLAY_IDENTIFIER ID_ERR_DTC_VLS_DOWN_MIN_1 FORMAT "%5.0"
 /begin AXIS_DESCR COM_AXIS online_dummy _CNV_A_R_LINEAR_____22_CM 6 0. 5. FORMAT "%2.0" AXIS_PTS_REF ldp_fmy_dtc /end AXIS_DESCR
/end CHARACTERISTIC
/begin CHARACTERISTIC fmy_id_vls_down_min_1.envd "" CURVE 0x01c78 _REC_CUR_20_u1_u1 255. _CNV_A_R_LINEAR_____1_CM 0. 255. DISPLAY_IDENTIFIER ID_ERR_ENVD_VLS_DOWN_MIN_1 FORMAT "%3.0"
 /begin AXIS_DESCR COM_AXIS online_dummy _CNV_A_R_LINEAR_____22_CM 4 0. 3. FORMAT "%2.0" AXIS_PTS_REF ldp_fmy_envd /end AXIS_DESCR
/end CHARACTERISTIC
/begin CHARACTERISTIC fmy_id_vls_down_min_2.dtc "" CURVE 0x01c7e _REC_CUR_20_u2_u2 65535. _CNV_A_R_LINEAR_____1_CM 0. 65535. DISPLAY_IDENTIFIER ID_ERR_DTC_VLS_DOWN_MIN_2 FORMAT "%5.0"
 /begin AXIS_DESCR COM_AXIS online_dummy _CNV_A_R_LINEAR_____22_CM 6 0. 5. FORMAT "%2.0" AXIS_PTS_REF ldp_fmy_dtc /end AXIS_DESCR
/end CHARACTERISTIC
/begin CHARACTERISTIC fmy_id_vls_down_min_2.envd "" CURVE 0x01c8a _REC_CUR_20_u1_u1 255. _CNV_A_R_LINEAR_____1_CM 0. 255. DISPLAY_IDENTIFIER ID_ERR_ENVD_VLS_DOWN_MIN_2 FORMAT "%3.0"
 /begin AXIS_DESCR COM_AXIS online_dummy _CNV_A_R_LINEAR_____22_CM 4 0. 3. FORMAT "%2.0" AXIS_PTS_REF ldp_fmy_envd /end AXIS_DESCR
/end CHARACTERISTIC
/begin CHARACTERISTIC fmy_id_vls_down_oc_1.dtc "" CURVE 0x01c90 _REC_CUR_20_u2_u2 65535. _CNV_A_R_LINEAR_____1_CM 0. 65535. DISPLAY_IDENTIFIER ID_ERR_DTC_VLS_DOWN_OC_1 FORMAT "%5.0"
 /begin AXIS_DESCR COM_AXIS online_dummy _CNV_A_R_LINEAR_____22_CM 6 0. 5. FORMAT "%2.0" AXIS_PTS_REF ldp_fmy_dtc /end AXIS_DESCR
/end CHARACTERISTIC
/begin CHARACTERISTIC fmy_id_vls_down_oc_1.envd "" CURVE 0x01c9c _REC_CUR_20_u1_u1 255. _CNV_A_R_LINEAR_____1_CM 0. 255. DISPLAY_IDENTIFIER ID_ERR_ENVD_VLS_DOWN_OC_1 FORMAT "%3.0"
 /begin AXIS_DESCR COM_AXIS online_dummy _CNV_A_R_LINEAR_____22_CM 4 0. 3. FORMAT "%2.0" AXIS_PTS_REF ldp_fmy_envd /end AXIS_DESCR
/end CHARACTERISTIC
/begin CHARACTERISTIC fmy_id_vls_down_oc_2.dtc "" CURVE 0x01ca2 _REC_CUR_20_u2_u2 65535. _CNV_A_R_LINEAR_____1_CM 0. 65535. DISPLAY_IDENTIFIER ID_ERR_DTC_VLS_DOWN_OC_2 FORMAT "%5.0"
 /begin AXIS_DESCR COM_AXIS online_dummy _CNV_A_R_LINEAR_____22_CM 6 0. 5. FORMAT "%2.0" AXIS_PTS_REF ldp_fmy_dtc /end AXIS_DESCR
/end CHARACTERISTIC
/begin CHARACTERISTIC fmy_id_vls_down_oc_2.envd "" CURVE 0x01cae _REC_CUR_20_u1_u1 255. _CNV_A_R_LINEAR_____1_CM 0. 255. DISPLAY_IDENTIFIER ID_ERR_ENVD_VLS_DOWN_OC_2 FORMAT "%3.0"
 /begin AXIS_DESCR COM_AXIS online_dummy _CNV_A_R_LINEAR_____22_CM 4 0. 3. FORMAT "%2.0" AXIS_PTS_REF ldp_fmy_envd /end AXIS_DESCR
/end CHARACTERISTIC
/begin CHARACTERISTIC fmy_id_iv_0.dtc "" CURVE 0x01cb4 _REC_CUR_20_u2_u2 65535. _CNV_A_R_LINEAR_____1_CM 0. 65535. DISPLAY_IDENTIFIER ID_ERR_DTC_IV_0 FORMAT "%5.0"
 /begin AXIS_DESCR COM_AXIS online_dummy _CNV_A_R_LINEAR_____22_CM 6 0. 5. FORMAT "%2.0" AXIS_PTS_REF ldp_fmy_dtc /end AXIS_DESCR
/end CHARACTERISTIC
/begin CHARACTERISTIC fmy_id_iv_0.envd "" CURVE 0x01cc0 _REC_CUR_20_u1_u1 255. _CNV_A_R_LINEAR_____1_CM 0. 255. DISPLAY_IDENTIFIER ID_ERR_ENVD_IV_0 FORMAT "%3.0"
 /begin AXIS_DESCR COM_AXIS online_dummy _CNV_A_R_LINEAR_____22_CM 4 0. 3. FORMAT "%2.0" AXIS_PTS_REF ldp_fmy_envd /end AXIS_DESCR
/end CHARACTERISTIC
/begin CHARACTERISTIC fmy_id_iv_1.dtc "" CURVE 0x01cc6 _REC_CUR_20_u2_u2 65535. _CNV_A_R_LINEAR_____1_CM 0. 65535. DISPLAY_IDENTIFIER ID_ERR_DTC_IV_1 FORMAT "%5.0"
 /begin AXIS_DESCR COM_AXIS online_dummy _CNV_A_R_LINEAR_____22_CM 6 0. 5. FORMAT "%2.0" AXIS_PTS_REF ldp_fmy_dtc /end AXIS_DESCR
/end CHARACTERISTIC
/begin CHARACTERISTIC fmy_id_iv_1.envd "" CURVE 0x01cd2 _REC_CUR_20_u1_u1 255. _CNV_A_R_LINEAR_____1_CM 0. 255. DISPLAY_IDENTIFIER ID_ERR_ENVD_IV_1 FORMAT "%3.0"
 /begin AXIS_DESCR COM_AXIS online_dummy _CNV_A_R_LINEAR_____22_CM 4 0. 3. FORMAT "%2.0" AXIS_PTS_REF ldp_fmy_envd /end AXIS_DESCR
/end CHARACTERISTIC
/begin CHARACTERISTIC fmy_id_iv_2.dtc "" CURVE 0x01cd8 _REC_CUR_20_u2_u2 65535. _CNV_A_R_LINEAR_____1_CM 0. 65535. DISPLAY_IDENTIFIER ID_ERR_DTC_IV_2 FORMAT "%5.0"
 /begin AXIS_DESCR COM_AXIS online_dummy _CNV_A_R_LINEAR_____22_CM 6 0. 5. FORMAT "%2.0" AXIS_PTS_REF ldp_fmy_dtc /end AXIS_DESCR
/end CHARACTERISTIC
/begin CHARACTERISTIC fmy_id_iv_2.envd "" CURVE 0x01ce4 _REC_CUR_20_u1_u1 255. _CNV_A_R_LINEAR_____1_CM 0. 255. DISPLAY_IDENTIFIER ID_ERR_ENVD_IV_2 FORMAT "%3.0"
 /begin AXIS_DESCR COM_AXIS online_dummy _CNV_A_R_LINEAR_____22_CM 4 0. 3. FORMAT "%2.0" AXIS_PTS_REF ldp_fmy_envd /end AXIS_DESCR
/end CHARACTERISTIC
/begin CHARACTERISTIC fmy_id_iv_3.dtc "" CURVE 0x01cea _REC_CUR_20_u2_u2 65535. _CNV_A_R_LINEAR_____1_CM 0. 65535. DISPLAY_IDENTIFIER ID_ERR_DTC_IV_3 FORMAT "%5.0"
 /begin AXIS_DESCR COM_AXIS online_dummy _CNV_A_R_LINEAR_____22_CM 6 0. 5. FORMAT "%2.0" AXIS_PTS_REF ldp_fmy_dtc /end AXIS_DESCR
/end CHARACTERISTIC
/begin CHARACTERISTIC fmy_id_iv_3.envd "" CURVE 0x01cf6 _REC_CUR_20_u1_u1 255. _CNV_A_R_LINEAR_____1_CM 0. 255. DISPLAY_IDENTIFIER ID_ERR_ENVD_IV_3 FORMAT "%3.0"
 /begin AXIS_DESCR COM_AXIS online_dummy _CNV_A_R_LINEAR_____22_CM 4 0. 3. FORMAT "%2.0" AXIS_PTS_REF ldp_fmy_envd /end AXIS_DESCR
/end CHARACTERISTIC
/begin CHARACTERISTIC fmy_id_iv_4.dtc "" CURVE 0x01cfc _REC_CUR_20_u2_u2 65535. _CNV_A_R_LINEAR_____1_CM 0. 65535. DISPLAY_IDENTIFIER ID_ERR_DTC_IV_4 FORMAT "%5.0"
 /begin AXIS_DESCR COM_AXIS online_dummy _CNV_A_R_LINEAR_____22_CM 6 0. 5. FORMAT "%2.0" AXIS_PTS_REF ldp_fmy_dtc /end AXIS_DESCR
/end CHARACTERISTIC
/begin CHARACTERISTIC fmy_id_iv_4.envd "" CURVE 0x01d08 _REC_CUR_20_u1_u1 255. _CNV_A_R_LINEAR_____1_CM 0. 255. DISPLAY_IDENTIFIER ID_ERR_ENVD_IV_4 FORMAT "%3.0"
 /begin AXIS_DESCR COM_AXIS online_dummy _CNV_A_R_LINEAR_____22_CM 4 0. 3. FORMAT "%2.0" AXIS_PTS_REF ldp_fmy_envd /end AXIS_DESCR
/end CHARACTERISTIC
/begin CHARACTERISTIC fmy_id_iv_5.dtc "" CURVE 0x01d0e _REC_CUR_20_u2_u2 65535. _CNV_A_R_LINEAR_____1_CM 0. 65535. DISPLAY_IDENTIFIER ID_ERR_DTC_IV_5 FORMAT "%5.0"
 /begin AXIS_DESCR COM_AXIS online_dummy _CNV_A_R_LINEAR_____22_CM 6 0. 5. FORMAT "%2.0" AXIS_PTS_REF ldp_fmy_dtc /end AXIS_DESCR
/end CHARACTERISTIC
/begin CHARACTERISTIC fmy_id_iv_5.envd "" CURVE 0x01d1a _REC_CUR_20_u1_u1 255. _CNV_A_R_LINEAR_____1_CM 0. 255. DISPLAY_IDENTIFIER ID_ERR_ENVD_IV_5 FORMAT "%3.0"
 /begin AXIS_DESCR COM_AXIS online_dummy _CNV_A_R_LINEAR_____22_CM 4 0. 3. FORMAT "%2.0" AXIS_PTS_REF ldp_fmy_envd /end AXIS_DESCR
/end CHARACTERISTIC
/begin CHARACTERISTIC fmy_id_lsh_up_1.dtc "" CURVE 0x01d20 _REC_CUR_20_u2_u2 65535. _CNV_A_R_LINEAR_____1_CM 0. 65535. DISPLAY_IDENTIFIER ID_ERR_DTC_LSH_UP_1 FORMAT "%5.0"
 /begin AXIS_DESCR COM_AXIS online_dummy _CNV_A_R_LINEAR_____22_CM 6 0. 5. FORMAT "%2.0" AXIS_PTS_REF ldp_fmy_dtc /end AXIS_DESCR
/end CHARACTERISTIC
/begin CHARACTERISTIC fmy_id_lsh_up_1.envd "" CURVE 0x01d2c _REC_CUR_20_u1_u1 255. _CNV_A_R_LINEAR_____1_CM 0. 255. DISPLAY_IDENTIFIER ID_ERR_ENVD_LSH_UP_1 FORMAT "%3.0"
 /begin AXIS_DESCR COM_AXIS online_dummy _CNV_A_R_LINEAR_____22_CM 4 0. 3. FORMAT "%2.0" AXIS_PTS_REF ldp_fmy_envd /end AXIS_DESCR
/end CHARACTERISTIC
/begin CHARACTERISTIC fmy_id_lsh_up_2.dtc "" CURVE 0x01d32 _REC_CUR_20_u2_u2 65535. _CNV_A_R_LINEAR_____1_CM 0. 65535. DISPLAY_IDENTIFIER ID_ERR_DTC_LSH_UP_2 FORMAT "%5.0"
 /begin AXIS_DESCR COM_AXIS online_dummy _CNV_A_R_LINEAR_____22_CM 6 0. 5. FORMAT "%2.0" AXIS_PTS_REF ldp_fmy_dtc /end AXIS_DESCR
/end CHARACTERISTIC
/begin CHARACTERISTIC fmy_id_lsh_up_2.envd "" CURVE 0x01d3e _REC_CUR_20_u1_u1 255. _CNV_A_R_LINEAR_____1_CM 0. 255. DISPLAY_IDENTIFIER ID_ERR_ENVD_LSH_UP_2 FORMAT "%3.0"
 /begin AXIS_DESCR COM_AXIS online_dummy _CNV_A_R_LINEAR_____22_CM 4 0. 3. FORMAT "%2.0" AXIS_PTS_REF ldp_fmy_envd /end AXIS_DESCR
/end CHARACTERISTIC
/begin CHARACTERISTIC fmy_id_lsh_down_1.dtc "" CURVE 0x01d44 _REC_CUR_20_u2_u2 65535. _CNV_A_R_LINEAR_____1_CM 0. 65535. DISPLAY_IDENTIFIER ID_ERR_DTC_LSH_DOWN_1 FORMAT "%5.0"
 /begin AXIS_DESCR COM_AXIS online_dummy _CNV_A_R_LINEAR_____22_CM 6 0. 5. FORMAT "%2.0" AXIS_PTS_REF ldp_fmy_dtc /end AXIS_DESCR
/end CHARACTERISTIC
/begin CHARACTERISTIC fmy_id_lsh_down_1.envd "" CURVE 0x01d50 _REC_CUR_20_u1_u1 255. _CNV_A_R_LINEAR_____1_CM 0. 255. DISPLAY_IDENTIFIER ID_ERR_ENVD_LSH_DOWN_1 FORMAT "%3.0"
 /begin AXIS_DESCR COM_AXIS online_dummy _CNV_A_R_LINEAR_____22_CM 4 0. 3. FORMAT "%2.0" AXIS_PTS_REF ldp_fmy_envd /end AXIS_DESCR
/end CHARACTERISTIC
/begin CHARACTERISTIC fmy_id_lsh_down_2.dtc "" CURVE 0x01d56 _REC_CUR_20_u2_u2 65535. _CNV_A_R_LINEAR_____1_CM 0. 65535. DISPLAY_IDENTIFIER ID_ERR_DTC_LSH_DOWN_2 FORMAT "%5.0"
 /begin AXIS_DESCR COM_AXIS online_dummy _CNV_A_R_LINEAR_____22_CM 6 0. 5. FORMAT "%2.0" AXIS_PTS_REF ldp_fmy_dtc /end AXIS_DESCR
/end CHARACTERISTIC
/begin CHARACTERISTIC fmy_id_lsh_down_2.envd "" CURVE 0x01d62 _REC_CUR_20_u1_u1 255. _CNV_A_R_LINEAR_____1_CM 0. 255. DISPLAY_IDENTIFIER ID_ERR_ENVD_LSH_DOWN_2 FORMAT "%3.0"
 /begin AXIS_DESCR COM_AXIS online_dummy _CNV_A_R_LINEAR_____22_CM 4 0. 3. FORMAT "%2.0" AXIS_PTS_REF ldp_fmy_envd /end AXIS_DESCR
/end CHARACTERISTIC
/begin CHARACTERISTIC fmy_id_rly_efp.dtc "" CURVE 0x01d68 _REC_CUR_20_u2_u2 65535. _CNV_A_R_LINEAR_____1_CM 0. 65535. DISPLAY_IDENTIFIER ID_ERR_DTC_RLY_EFP FORMAT "%5.0"
 /begin AXIS_DESCR COM_AXIS online_dummy _CNV_A_R_LINEAR_____22_CM 6 0. 5. FORMAT "%2.0" AXIS_PTS_REF ldp_fmy_dtc /end AXIS_DESCR
/end CHARACTERISTIC
/begin CHARACTERISTIC fmy_id_rly_efp.envd "" CURVE 0x01d74 _REC_CUR_20_u1_u1 255. _CNV_A_R_LINEAR_____1_CM 0. 255. DISPLAY_IDENTIFIER ID_ERR_ENVD_RLY_EFP FORMAT "%3.0"
 /begin AXIS_DESCR COM_AXIS online_dummy _CNV_A_R_LINEAR_____22_CM 4 0. 3. FORMAT "%2.0" AXIS_PTS_REF ldp_fmy_envd /end AXIS_DESCR
/end CHARACTERISTIC
/begin CHARACTERISTIC fmy_id_cps.dtc "" CURVE 0x01d7a _REC_CUR_20_u2_u2 65535. _CNV_A_R_LINEAR_____1_CM 0. 65535. DISPLAY_IDENTIFIER ID_ERR_DTC_CPS FORMAT "%5.0"
 /begin AXIS_DESCR COM_AXIS online_dummy _CNV_A_R_LINEAR_____22_CM 6 0. 5. FORMAT "%2.0" AXIS_PTS_REF ldp_fmy_dtc /end AXIS_DESCR
/end CHARACTERISTIC
/begin CHARACTERISTIC fmy_id_cps.envd "" CURVE 0x01d86 _REC_CUR_20_u1_u1 255. _CNV_A_R_LINEAR_____1_CM 0. 255. DISPLAY_IDENTIFIER ID_ERR_ENVD_CPS FORMAT "%3.0"
 /begin AXIS_DESCR COM_AXIS online_dummy _CNV_A_R_LINEAR_____22_CM 4 0. 3. FORMAT "%2.0" AXIS_PTS_REF ldp_fmy_envd /end AXIS_DESCR
/end CHARACTERISTIC
/begin CHARACTERISTIC fmy_id_mec_ivvt_in_1.dtc "" CURVE 0x01d8c _REC_CUR_20_u2_u2 65535. _CNV_A_R_LINEAR_____1_CM 0. 65535. DISPLAY_IDENTIFIER ID_ERR_DTC_MEC_IVVT_IN_1 FORMAT "%5.0"
 /begin AXIS_DESCR COM_AXIS online_dummy _CNV_A_R_LINEAR_____22_CM 6 0. 5. FORMAT "%2.0" AXIS_PTS_REF ldp_fmy_dtc /end AXIS_DESCR
/end CHARACTERISTIC
/begin CHARACTERISTIC fmy_id_mec_ivvt_in_1.envd "" CURVE 0x01d98 _REC_CUR_20_u1_u1 255. _CNV_A_R_LINEAR_____1_CM 0. 255. DISPLAY_IDENTIFIER ID_ERR_ENVD_MEC_IVVT_IN_1 FORMAT "%3.0"
 /begin AXIS_DESCR COM_AXIS online_dummy _CNV_A_R_LINEAR_____22_CM 4 0. 3. FORMAT "%2.0" AXIS_PTS_REF ldp_fmy_envd /end AXIS_DESCR
/end CHARACTERISTIC
/begin CHARACTERISTIC fmy_id_mec_ivvt_ex_1.dtc "" CURVE 0x01d9e _REC_CUR_20_u2_u2 65535. _CNV_A_R_LINEAR_____1_CM 0. 65535. DISPLAY_IDENTIFIER ID_ERR_DTC_MEC_IVVT_EX_1 FORMAT "%5.0"
 /begin AXIS_DESCR COM_AXIS online_dummy _CNV_A_R_LINEAR_____22_CM 6 0. 5. FORMAT "%2.0" AXIS_PTS_REF ldp_fmy_dtc /end AXIS_DESCR
/end CHARACTERISTIC
/begin CHARACTERISTIC fmy_id_mec_ivvt_ex_1.envd "" CURVE 0x01daa _REC_CUR_20_u1_u1 255. _CNV_A_R_LINEAR_____1_CM 0. 255. DISPLAY_IDENTIFIER ID_ERR_ENVD_MEC_IVVT_EX_1 FORMAT "%3.0"
 /begin AXIS_DESCR COM_AXIS online_dummy _CNV_A_R_LINEAR_____22_CM 4 0. 3. FORMAT "%2.0" AXIS_PTS_REF ldp_fmy_envd /end AXIS_DESCR
/end CHARACTERISTIC
/begin CHARACTERISTIC fmy_id_ref_ivvt_in_1.dtc "" CURVE 0x01db0 _REC_CUR_20_u2_u2 65535. _CNV_A_R_LINEAR_____1_CM 0. 65535. DISPLAY_IDENTIFIER ID_ERR_DTC_REF_IVVT_IN_1 FORMAT "%5.0"
 /begin AXIS_DESCR COM_AXIS online_dummy _CNV_A_R_LINEAR_____22_CM 6 0. 5. FORMAT "%2.0" AXIS_PTS_REF ldp_fmy_dtc /end AXIS_DESCR
/end CHARACTERISTIC
/begin CHARACTERISTIC fmy_id_ref_ivvt_in_1.envd "" CURVE 0x01dbc _REC_CUR_20_u1_u1 255. _CNV_A_R_LINEAR_____1_CM 0. 255. DISPLAY_IDENTIFIER ID_ERR_ENVD_REF_IVVT_IN_1 FORMAT "%3.0"
 /begin AXIS_DESCR COM_AXIS online_dummy _CNV_A_R_LINEAR_____22_CM 4 0. 3. FORMAT "%2.0" AXIS_PTS_REF ldp_fmy_envd /end AXIS_DESCR
/end CHARACTERISTIC
/begin CHARACTERISTIC fmy_id_ref_ivvt_ex_1.dtc "" CURVE 0x01dc2 _REC_CUR_20_u2_u2 65535. _CNV_A_R_LINEAR_____1_CM 0. 65535. DISPLAY_IDENTIFIER ID_ERR_DTC_REF_IVVT_EX_1 FORMAT "%5.0"
 /begin AXIS_DESCR COM_AXIS online_dummy _CNV_A_R_LINEAR_____22_CM 6 0. 5. FORMAT "%2.0" AXIS_PTS_REF ldp_fmy_dtc /end AXIS_DESCR
/end CHARACTERISTIC
/begin CHARACTERISTIC fmy_id_ref_ivvt_ex_1.envd "" CURVE 0x01dce _REC_CUR_20_u1_u1 255. _CNV_A_R_LINEAR_____1_CM 0. 255. DISPLAY_IDENTIFIER ID_ERR_ENVD_REF_IVVT_EX_1 FORMAT "%3.0"
 /begin AXIS_DESCR COM_AXIS online_dummy _CNV_A_R_LINEAR_____22_CM 4 0. 3. FORMAT "%2.0" AXIS_PTS_REF ldp_fmy_envd /end AXIS_DESCR
/end CHARACTERISTIC
/begin CHARACTERISTIC fmy_id_slv_ivvt_in_1.dtc "" CURVE 0x01dd4 _REC_CUR_20_u2_u2 65535. _CNV_A_R_LINEAR_____1_CM 0. 65535. DISPLAY_IDENTIFIER ID_ERR_DTC_SLV_IVVT_IN_1 FORMAT "%5.0"
 /begin AXIS_DESCR COM_AXIS online_dummy _CNV_A_R_LINEAR_____22_CM 6 0. 5. FORMAT "%2.0" AXIS_PTS_REF ldp_fmy_dtc /end AXIS_DESCR
/end CHARACTERISTIC
/begin CHARACTERISTIC fmy_id_slv_ivvt_in_1.envd "" CURVE 0x01de0 _REC_CUR_20_u1_u1 255. _CNV_A_R_LINEAR_____1_CM 0. 255. DISPLAY_IDENTIFIER ID_ERR_ENVD_SLV_IVVT_IN_1 FORMAT "%3.0"
 /begin AXIS_DESCR COM_AXIS online_dummy _CNV_A_R_LINEAR_____22_CM 4 0. 3. FORMAT "%2.0" AXIS_PTS_REF ldp_fmy_envd /end AXIS_DESCR
/end CHARACTERISTIC
/begin CHARACTERISTIC fmy_id_slv_ivvt_ex_1.dtc "" CURVE 0x01de6 _REC_CUR_20_u2_u2 65535. _CNV_A_R_LINEAR_____1_CM 0. 65535. DISPLAY_IDENTIFIER ID_ERR_DTC_SLV_IVVT_EX_1 FORMAT "%5.0"
 /begin AXIS_DESCR COM_AXIS online_dummy _CNV_A_R_LINEAR_____22_CM 6 0. 5. FORMAT "%2.0" AXIS_PTS_REF ldp_fmy_dtc /end AXIS_DESCR
/end CHARACTERISTIC
/begin CHARACTERISTIC fmy_id_slv_ivvt_ex_1.envd "" CURVE 0x01df2 _REC_CUR_20_u1_u1 255. _CNV_A_R_LINEAR_____1_CM 0. 255. DISPLAY_IDENTIFIER ID_ERR_ENVD_SLV_IVVT_EX_1 FORMAT "%3.0"
 /begin AXIS_DESCR COM_AXIS online_dummy _CNV_A_R_LINEAR_____22_CM 4 0. 3. FORMAT "%2.0" AXIS_PTS_REF ldp_fmy_envd /end AXIS_DESCR
/end CHARACTERISTIC
/begin CHARACTERISTIC fmy_id_park_ivvt_in_1.dtc "" CURVE 0x01df8 _REC_CUR_20_u2_u2 65535. _CNV_A_R_LINEAR_____1_CM 0. 65535. DISPLAY_IDENTIFIER ID_ERR_DTC_PARK_IVVT_IN_1 FORMAT "%5.0"
 /begin AXIS_DESCR COM_AXIS online_dummy _CNV_A_R_LINEAR_____22_CM 6 0. 5. FORMAT "%2.0" AXIS_PTS_REF ldp_fmy_dtc /end AXIS_DESCR
/end CHARACTERISTIC
/begin CHARACTERISTIC fmy_id_park_ivvt_in_1.envd "" CURVE 0x01e04 _REC_CUR_20_u1_u1 255. _CNV_A_R_LINEAR_____1_CM 0. 255. DISPLAY_IDENTIFIER ID_ERR_ENVD_PARK_IVVT_IN_1 FORMAT "%3.0"
 /begin AXIS_DESCR COM_AXIS online_dummy _CNV_A_R_LINEAR_____22_CM 4 0. 3. FORMAT "%2.0" AXIS_PTS_REF ldp_fmy_envd /end AXIS_DESCR
/end CHARACTERISTIC
/begin CHARACTERISTIC fmy_id_park_ivvt_ex_1.dtc "" CURVE 0x01e0a _REC_CUR_20_u2_u2 65535. _CNV_A_R_LINEAR_____1_CM 0. 65535. DISPLAY_IDENTIFIER ID_ERR_DTC_PARK_IVVT_EX_1 FORMAT "%5.0"
 /begin AXIS_DESCR COM_AXIS online_dummy _CNV_A_R_LINEAR_____22_CM 6 0. 5. FORMAT "%2.0" AXIS_PTS_REF ldp_fmy_dtc /end AXIS_DESCR
/end CHARACTERISTIC
/begin CHARACTERISTIC fmy_id_park_ivvt_ex_1.envd "" CURVE 0x01e16 _REC_CUR_20_u1_u1 255. _CNV_A_R_LINEAR_____1_CM 0. 255. DISPLAY_IDENTIFIER ID_ERR_ENVD_PARK_IVVT_EX_1 FORMAT "%3.0"
 /begin AXIS_DESCR COM_AXIS online_dummy _CNV_A_R_LINEAR_____22_CM 4 0. 3. FORMAT "%2.0" AXIS_PTS_REF ldp_fmy_envd /end AXIS_DESCR
/end CHARACTERISTIC
/begin CHARACTERISTIC fmy_id_ecu_cks.dtc "" CURVE 0x01e1c _REC_CUR_20_u2_u2 65535. _CNV_A_R_LINEAR_____1_CM 0. 65535. DISPLAY_IDENTIFIER ID_ERR_DTC_ECU_CKS FORMAT "%5.0"
 /begin AXIS_DESCR COM_AXIS online_dummy _CNV_A_R_LINEAR_____22_CM 6 0. 5. FORMAT "%2.0" AXIS_PTS_REF ldp_fmy_dtc /end AXIS_DESCR
/end CHARACTERISTIC
/begin CHARACTERISTIC fmy_id_ecu_cks.envd "" CURVE 0x01e28 _REC_CUR_20_u1_u1 255. _CNV_A_R_LINEAR_____1_CM 0. 255. DISPLAY_IDENTIFIER ID_ERR_ENVD_ECU_CKS FORMAT "%3.0"
 /begin AXIS_DESCR COM_AXIS online_dummy _CNV_A_R_LINEAR_____22_CM 4 0. 3. FORMAT "%2.0" AXIS_PTS_REF ldp_fmy_envd /end AXIS_DESCR
/end CHARACTERISTIC
/begin CHARACTERISTIC fmy_id_toil_level.dtc "" CURVE 0x01e2e _REC_CUR_20_u2_u2 65535. _CNV_A_R_LINEAR_____1_CM 0. 65535. DISPLAY_IDENTIFIER ID_ERR_DTC_TOIL_LEVEL FORMAT "%5.0"
 /begin AXIS_DESCR COM_AXIS online_dummy _CNV_A_R_LINEAR_____22_CM 6 0. 5. FORMAT "%2.0" AXIS_PTS_REF ldp_fmy_dtc /end AXIS_DESCR
/end CHARACTERISTIC
/begin CHARACTERISTIC fmy_id_toil_level.envd "" CURVE 0x01e3a _REC_CUR_20_u1_u1 255. _CNV_A_R_LINEAR_____1_CM 0. 255. DISPLAY_IDENTIFIER ID_ERR_ENVD_TOIL_LEVEL FORMAT "%3.0"
 /begin AXIS_DESCR COM_AXIS online_dummy _CNV_A_R_LINEAR_____22_CM 4 0. 3. FORMAT "%2.0" AXIS_PTS_REF ldp_fmy_envd /end AXIS_DESCR
/end CHARACTERISTIC
/begin CHARACTERISTIC fmy_id_tout_etcu_1.dtc "" CURVE 0x01e40 _REC_CUR_20_u2_u2 65535. _CNV_A_R_LINEAR_____1_CM 0. 65535. DISPLAY_IDENTIFIER ID_ERR_DTC_TOUT_ETCU_1 FORMAT "%5.0"
 /begin AXIS_DESCR COM_AXIS online_dummy _CNV_A_R_LINEAR_____22_CM 6 0. 5. FORMAT "%2.0" AXIS_PTS_REF ldp_fmy_dtc /end AXIS_DESCR
/end CHARACTERISTIC
/begin CHARACTERISTIC fmy_id_tout_etcu_1.envd "" CURVE 0x01e4c _REC_CUR_20_u1_u1 255. _CNV_A_R_LINEAR_____1_CM 0. 255. DISPLAY_IDENTIFIER ID_ERR_ENVD_TOUT_ETCU_1 FORMAT "%3.0"
 /begin AXIS_DESCR COM_AXIS online_dummy _CNV_A_R_LINEAR_____22_CM 4 0. 3. FORMAT "%2.0" AXIS_PTS_REF ldp_fmy_envd /end AXIS_DESCR
/end CHARACTERISTIC
/begin CHARACTERISTIC fmy_id_tout_etcu_2.dtc "" CURVE 0x01e52 _REC_CUR_20_u2_u2 65535. _CNV_A_R_LINEAR_____1_CM 0. 65535. DISPLAY_IDENTIFIER ID_ERR_DTC_TOUT_ETCU_2 FORMAT "%5.0"
 /begin AXIS_DESCR COM_AXIS online_dummy _CNV_A_R_LINEAR_____22_CM 6 0. 5. FORMAT "%2.0" AXIS_PTS_REF ldp_fmy_dtc /end AXIS_DESCR
/end CHARACTERISTIC
/begin CHARACTERISTIC fmy_id_tout_etcu_2.envd "" CURVE 0x01e5e _REC_CUR_20_u1_u1 255. _CNV_A_R_LINEAR_____1_CM 0. 255. DISPLAY_IDENTIFIER ID_ERR_ENVD_TOUT_ETCU_2 FORMAT "%3.0"
 /begin AXIS_DESCR COM_AXIS online_dummy _CNV_A_R_LINEAR_____22_CM 4 0. 3. FORMAT "%2.0" AXIS_PTS_REF ldp_fmy_envd /end AXIS_DESCR
/end CHARACTERISTIC
/begin CHARACTERISTIC fmy_id_tout_icl_2.dtc "" CURVE 0x01e64 _REC_CUR_20_u2_u2 65535. _CNV_A_R_LINEAR_____1_CM 0. 65535. DISPLAY_IDENTIFIER ID_ERR_DTC_TOUT_ICL_2 FORMAT "%5.0"
 /begin AXIS_DESCR COM_AXIS online_dummy _CNV_A_R_LINEAR_____22_CM 6 0. 5. FORMAT "%2.0" AXIS_PTS_REF ldp_fmy_dtc /end AXIS_DESCR
/end CHARACTERISTIC
/begin CHARACTERISTIC fmy_id_tout_icl_2.envd "" CURVE 0x01e70 _REC_CUR_20_u1_u1 255. _CNV_A_R_LINEAR_____1_CM 0. 255. DISPLAY_IDENTIFIER ID_ERR_ENVD_TOUT_ICL_2 FORMAT "%3.0"
 /begin AXIS_DESCR COM_AXIS online_dummy _CNV_A_R_LINEAR_____22_CM 4 0. 3. FORMAT "%2.0" AXIS_PTS_REF ldp_fmy_envd /end AXIS_DESCR
/end CHARACTERISTIC
/begin CHARACTERISTIC fmy_id_tout_icl_3.dtc "" CURVE 0x01e76 _REC_CUR_20_u2_u2 65535. _CNV_A_R_LINEAR_____1_CM 0. 65535. DISPLAY_IDENTIFIER ID_ERR_DTC_TOUT_ICL_3 FORMAT "%5.0"
 /begin AXIS_DESCR COM_AXIS online_dummy _CNV_A_R_LINEAR_____22_CM 6 0. 5. FORMAT "%2.0" AXIS_PTS_REF ldp_fmy_dtc /end AXIS_DESCR
/end CHARACTERISTIC
/begin CHARACTERISTIC fmy_id_tout_icl_3.envd "" CURVE 0x01e82 _REC_CUR_20_u1_u1 255. _CNV_A_R_LINEAR_____1_CM 0. 255. DISPLAY_IDENTIFIER ID_ERR_ENVD_TOUT_ICL_3 FORMAT "%3.0"
 /begin AXIS_DESCR COM_AXIS online_dummy _CNV_A_R_LINEAR_____22_CM 4 0. 3. FORMAT "%2.0" AXIS_PTS_REF ldp_fmy_envd /end AXIS_DESCR
/end CHARACTERISTIC
/begin CHARACTERISTIC fmy_id_tout_asr_1.dtc "" CURVE 0x01e88 _REC_CUR_20_u2_u2 65535. _CNV_A_R_LINEAR_____1_CM 0. 65535. DISPLAY_IDENTIFIER ID_ERR_DTC_TOUT_ASR_1 FORMAT "%5.0"
 /begin AXIS_DESCR COM_AXIS online_dummy _CNV_A_R_LINEAR_____22_CM 6 0. 5. FORMAT "%2.0" AXIS_PTS_REF ldp_fmy_dtc /end AXIS_DESCR
/end CHARACTERISTIC
/begin CHARACTERISTIC fmy_id_tout_asr_1.envd "" CURVE 0x01e94 _REC_CUR_20_u1_u1 255. _CNV_A_R_LINEAR_____1_CM 0. 255. DISPLAY_IDENTIFIER ID_ERR_ENVD_TOUT_ASR_1 FORMAT "%3.0"
 /begin AXIS_DESCR COM_AXIS online_dummy _CNV_A_R_LINEAR_____22_CM 4 0. 3. FORMAT "%2.0" AXIS_PTS_REF ldp_fmy_envd /end AXIS_DESCR
/end CHARACTERISTIC
/begin CHARACTERISTIC fmy_id_tout_asr_3.dtc "" CURVE 0x01e9a _REC_CUR_20_u2_u2 65535. _CNV_A_R_LINEAR_____1_CM 0. 65535. DISPLAY_IDENTIFIER ID_ERR_DTC_TOUT_ASR_3 FORMAT "%5.0"
 /begin AXIS_DESCR COM_AXIS online_dummy _CNV_A_R_LINEAR_____22_CM 6 0. 5. FORMAT "%2.0" AXIS_PTS_REF ldp_fmy_dtc /end AXIS_DESCR
/end CHARACTERISTIC
/begin CHARACTERISTIC fmy_id_tout_asr_3.envd "" CURVE 0x01ea6 _REC_CUR_20_u1_u1 255. _CNV_A_R_LINEAR_____1_CM 0. 255. DISPLAY_IDENTIFIER ID_ERR_ENVD_TOUT_ASR_3 FORMAT "%3.0"
 /begin AXIS_DESCR COM_AXIS online_dummy _CNV_A_R_LINEAR_____22_CM 4 0. 3. FORMAT "%2.0" AXIS_PTS_REF ldp_fmy_envd /end AXIS_DESCR
/end CHARACTERISTIC
/begin CHARACTERISTIC fmy_id_tout_asr_4.dtc "" CURVE 0x01eac _REC_CUR_20_u2_u2 65535. _CNV_A_R_LINEAR_____1_CM 0. 65535. DISPLAY_IDENTIFIER ID_ERR_DTC_TOUT_ASR_4 FORMAT "%5.0"
 /begin AXIS_DESCR COM_AXIS online_dummy _CNV_A_R_LINEAR_____22_CM 6 0. 5. FORMAT "%2.0" AXIS_PTS_REF ldp_fmy_dtc /end AXIS_DESCR
/end CHARACTERISTIC
/begin CHARACTERISTIC fmy_id_tout_asr_4.envd "" CURVE 0x01eb8 _REC_CUR_20_u1_u1 255. _CNV_A_R_LINEAR_____1_CM 0. 255. DISPLAY_IDENTIFIER ID_ERR_ENVD_TOUT_ASR_4 FORMAT "%3.0"
 /begin AXIS_DESCR COM_AXIS online_dummy _CNV_A_R_LINEAR_____22_CM 4 0. 3. FORMAT "%2.0" AXIS_PTS_REF ldp_fmy_envd /end AXIS_DESCR
/end CHARACTERISTIC
/begin CHARACTERISTIC fmy_id_tout_pste_1.dtc "" CURVE 0x01ebe _REC_CUR_20_u2_u2 65535. _CNV_A_R_LINEAR_____1_CM 0. 65535. DISPLAY_IDENTIFIER ID_ERR_DTC_TOUT_PSTE_1 FORMAT "%5.0"
 /begin AXIS_DESCR COM_AXIS online_dummy _CNV_A_R_LINEAR_____22_CM 6 0. 5. FORMAT "%2.0" AXIS_PTS_REF ldp_fmy_dtc /end AXIS_DESCR
/end CHARACTERISTIC
/begin CHARACTERISTIC fmy_id_tout_pste_1.envd "" CURVE 0x01eca _REC_CUR_20_u1_u1 255. _CNV_A_R_LINEAR_____1_CM 0. 255. DISPLAY_IDENTIFIER ID_ERR_ENVD_TOUT_PSTE_1 FORMAT "%3.0"
 /begin AXIS_DESCR COM_AXIS online_dummy _CNV_A_R_LINEAR_____22_CM 4 0. 3. FORMAT "%2.0" AXIS_PTS_REF ldp_fmy_envd /end AXIS_DESCR
/end CHARACTERISTIC
/begin CHARACTERISTIC fmy_id_tout_amt_1.dtc "" CURVE 0x01ed0 _REC_CUR_20_u2_u2 65535. _CNV_A_R_LINEAR_____1_CM 0. 65535. DISPLAY_IDENTIFIER ID_ERR_DTC_TOUT_AMT_1 FORMAT "%5.0"
 /begin AXIS_DESCR COM_AXIS online_dummy _CNV_A_R_LINEAR_____22_CM 6 0. 5. FORMAT "%2.0" AXIS_PTS_REF ldp_fmy_dtc /end AXIS_DESCR
/end CHARACTERISTIC
/begin CHARACTERISTIC fmy_id_tout_amt_1.envd "" CURVE 0x01edc _REC_CUR_20_u1_u1 255. _CNV_A_R_LINEAR_____1_CM 0. 255. DISPLAY_IDENTIFIER ID_ERR_ENVD_TOUT_AMT_1 FORMAT "%3.0"
 /begin AXIS_DESCR COM_AXIS online_dummy _CNV_A_R_LINEAR_____22_CM 4 0. 3. FORMAT "%2.0" AXIS_PTS_REF ldp_fmy_envd /end AXIS_DESCR
/end CHARACTERISTIC
/begin CHARACTERISTIC fmy_id_vs.dtc "" CURVE 0x01ee2 _REC_CUR_20_u2_u2 65535. _CNV_A_R_LINEAR_____1_CM 0. 65535. DISPLAY_IDENTIFIER ID_ERR_DTC_VS FORMAT "%5.0"
 /begin AXIS_DESCR COM_AXIS online_dummy _CNV_A_R_LINEAR_____22_CM 6 0. 5. FORMAT "%2.0" AXIS_PTS_REF ldp_fmy_dtc /end AXIS_DESCR
/end CHARACTERISTIC
/begin CHARACTERISTIC fmy_id_vs.envd "" CURVE 0x01eee _REC_CUR_20_u1_u1 255. _CNV_A_R_LINEAR_____1_CM 0. 255. DISPLAY_IDENTIFIER ID_ERR_ENVD_VS FORMAT "%3.0"
 /begin AXIS_DESCR COM_AXIS online_dummy _CNV_A_R_LINEAR_____22_CM 4 0. 3. FORMAT "%2.0" AXIS_PTS_REF ldp_fmy_envd /end AXIS_DESCR
/end CHARACTERISTIC
/begin CHARACTERISTIC fmy_id_knks_1.dtc "" CURVE 0x01ef4 _REC_CUR_20_u2_u2 65535. _CNV_A_R_LINEAR_____1_CM 0. 65535. DISPLAY_IDENTIFIER ID_ERR_DTC_KNKS_1 FORMAT "%5.0"
 /begin AXIS_DESCR COM_AXIS online_dummy _CNV_A_R_LINEAR_____22_CM 6 0. 5. FORMAT "%2.0" AXIS_PTS_REF ldp_fmy_dtc /end AXIS_DESCR
/end CHARACTERISTIC
/begin CHARACTERISTIC fmy_id_knks_1.envd "" CURVE 0x01f00 _REC_CUR_20_u1_u1 255. _CNV_A_R_LINEAR_____1_CM 0. 255. DISPLAY_IDENTIFIER ID_ERR_ENVD_KNKS_1 FORMAT "%3.0"
 /begin AXIS_DESCR COM_AXIS online_dummy _CNV_A_R_LINEAR_____22_CM 4 0. 3. FORMAT "%2.0" AXIS_PTS_REF ldp_fmy_envd /end AXIS_DESCR
/end CHARACTERISTIC
/begin CHARACTERISTIC fmy_id_knks_2.dtc "" CURVE 0x01f06 _REC_CUR_20_u2_u2 65535. _CNV_A_R_LINEAR_____1_CM 0. 65535. DISPLAY_IDENTIFIER ID_ERR_DTC_KNKS_2 FORMAT "%5.0"
 /begin AXIS_DESCR COM_AXIS online_dummy _CNV_A_R_LINEAR_____22_CM 6 0. 5. FORMAT "%2.0" AXIS_PTS_REF ldp_fmy_dtc /end AXIS_DESCR
/end CHARACTERISTIC
/begin CHARACTERISTIC fmy_id_knks_2.envd "" CURVE 0x01f12 _REC_CUR_20_u1_u1 255. _CNV_A_R_LINEAR_____1_CM 0. 255. DISPLAY_IDENTIFIER ID_ERR_ENVD_KNKS_2 FORMAT "%3.0"
 /begin AXIS_DESCR COM_AXIS online_dummy _CNV_A_R_LINEAR_____22_CM 4 0. 3. FORMAT "%2.0" AXIS_PTS_REF ldp_fmy_envd /end AXIS_DESCR
/end CHARACTERISTIC
/begin CHARACTERISTIC fmy_id_td_igc_cut_0.dtc "" CURVE 0x01f18 _REC_CUR_20_u2_u2 65535. _CNV_A_R_LINEAR_____1_CM 0. 65535. DISPLAY_IDENTIFIER ID_ERR_DTC_TD_IGC_CUT_0 FORMAT "%5.0"
 /begin AXIS_DESCR COM_AXIS online_dummy _CNV_A_R_LINEAR_____22_CM 6 0. 5. FORMAT "%2.0" AXIS_PTS_REF ldp_fmy_dtc /end AXIS_DESCR
/end CHARACTERISTIC
/begin CHARACTERISTIC fmy_id_td_igc_cut_0.envd "" CURVE 0x01f24 _REC_CUR_20_u1_u1 255. _CNV_A_R_LINEAR_____1_CM 0. 255. DISPLAY_IDENTIFIER ID_ERR_ENVD_TD_IGC_CUT_0 FORMAT "%3.0"
 /begin AXIS_DESCR COM_AXIS online_dummy _CNV_A_R_LINEAR_____22_CM 4 0. 3. FORMAT "%2.0" AXIS_PTS_REF ldp_fmy_envd /end AXIS_DESCR
/end CHARACTERISTIC
/begin CHARACTERISTIC fmy_id_td_igc_cut_1.dtc "" CURVE 0x01f2a _REC_CUR_20_u2_u2 65535. _CNV_A_R_LINEAR_____1_CM 0. 65535. DISPLAY_IDENTIFIER ID_ERR_DTC_TD_IGC_CUT_1 FORMAT "%5.0"
 /begin AXIS_DESCR COM_AXIS online_dummy _CNV_A_R_LINEAR_____22_CM 6 0. 5. FORMAT "%2.0" AXIS_PTS_REF ldp_fmy_dtc /end AXIS_DESCR
/end CHARACTERISTIC
/begin CHARACTERISTIC fmy_id_td_igc_cut_1.envd "" CURVE 0x01f36 _REC_CUR_20_u1_u1 255. _CNV_A_R_LINEAR_____1_CM 0. 255. DISPLAY_IDENTIFIER ID_ERR_ENVD_TD_IGC_CUT_1 FORMAT "%3.0"
 /begin AXIS_DESCR COM_AXIS online_dummy _CNV_A_R_LINEAR_____22_CM 4 0. 3. FORMAT "%2.0" AXIS_PTS_REF ldp_fmy_envd /end AXIS_DESCR
/end CHARACTERISTIC
/begin CHARACTERISTIC fmy_id_td_igc_cut_2.dtc "" CURVE 0x01f3c _REC_CUR_20_u2_u2 65535. _CNV_A_R_LINEAR_____1_CM 0. 65535. DISPLAY_IDENTIFIER ID_ERR_DTC_TD_IGC_CUT_2 FORMAT "%5.0"
 /begin AXIS_DESCR COM_AXIS online_dummy _CNV_A_R_LINEAR_____22_CM 6 0. 5. FORMAT "%2.0" AXIS_PTS_REF ldp_fmy_dtc /end AXIS_DESCR
/end CHARACTERISTIC
/begin CHARACTERISTIC fmy_id_td_igc_cut_2.envd "" CURVE 0x01f48 _REC_CUR_20_u1_u1 255. _CNV_A_R_LINEAR_____1_CM 0. 255. DISPLAY_IDENTIFIER ID_ERR_ENVD_TD_IGC_CUT_2 FORMAT "%3.0"
 /begin AXIS_DESCR COM_AXIS online_dummy _CNV_A_R_LINEAR_____22_CM 4 0. 3. FORMAT "%2.0" AXIS_PTS_REF ldp_fmy_envd /end AXIS_DESCR
/end CHARACTERISTIC
/begin CHARACTERISTIC fmy_id_td_igc_cut_3.dtc "" CURVE 0x01f4e _REC_CUR_20_u2_u2 65535. _CNV_A_R_LINEAR_____1_CM 0. 65535. DISPLAY_IDENTIFIER ID_ERR_DTC_TD_IGC_CUT_3 FORMAT "%5.0"
 /begin AXIS_DESCR COM_AXIS online_dummy _CNV_A_R_LINEAR_____22_CM 6 0. 5. FORMAT "%2.0" AXIS_PTS_REF ldp_fmy_dtc /end AXIS_DESCR
/end CHARACTERISTIC
/begin CHARACTERISTIC fmy_id_td_igc_cut_3.envd "" CURVE 0x01f5a _REC_CUR_20_u1_u1 255. _CNV_A_R_LINEAR_____1_CM 0. 255. DISPLAY_IDENTIFIER ID_ERR_ENVD_TD_IGC_CUT_3 FORMAT "%3.0"
 /begin AXIS_DESCR COM_AXIS online_dummy _CNV_A_R_LINEAR_____22_CM 4 0. 3. FORMAT "%2.0" AXIS_PTS_REF ldp_fmy_envd /end AXIS_DESCR
/end CHARACTERISTIC
/begin CHARACTERISTIC fmy_id_td_igc_cut_4.dtc "" CURVE 0x01f60 _REC_CUR_20_u2_u2 65535. _CNV_A_R_LINEAR_____1_CM 0. 65535. DISPLAY_IDENTIFIER ID_ERR_DTC_TD_IGC_CUT_4 FORMAT "%5.0"
 /begin AXIS_DESCR COM_AXIS online_dummy _CNV_A_R_LINEAR_____22_CM 6 0. 5. FORMAT "%2.0" AXIS_PTS_REF ldp_fmy_dtc /end AXIS_DESCR
/end CHARACTERISTIC
/begin CHARACTERISTIC fmy_id_td_igc_cut_4.envd "" CURVE 0x01f6c _REC_CUR_20_u1_u1 255. _CNV_A_R_LINEAR_____1_CM 0. 255. DISPLAY_IDENTIFIER ID_ERR_ENVD_TD_IGC_CUT_4 FORMAT "%3.0"
 /begin AXIS_DESCR COM_AXIS online_dummy _CNV_A_R_LINEAR_____22_CM 4 0. 3. FORMAT "%2.0" AXIS_PTS_REF ldp_fmy_envd /end AXIS_DESCR
/end CHARACTERISTIC
/begin CHARACTERISTIC fmy_id_td_igc_cut_5.dtc "" CURVE 0x01f72 _REC_CUR_20_u2_u2 65535. _CNV_A_R_LINEAR_____1_CM 0. 65535. DISPLAY_IDENTIFIER ID_ERR_DTC_TD_IGC_CUT_5 FORMAT "%5.0"
 /begin AXIS_DESCR COM_AXIS online_dummy _CNV_A_R_LINEAR_____22_CM 6 0. 5. FORMAT "%2.0" AXIS_PTS_REF ldp_fmy_dtc /end AXIS_DESCR
/end CHARACTERISTIC
/begin CHARACTERISTIC fmy_id_td_igc_cut_5.envd "" CURVE 0x01f7e _REC_CUR_20_u1_u1 255. _CNV_A_R_LINEAR_____1_CM 0. 255. DISPLAY_IDENTIFIER ID_ERR_ENVD_TD_IGC_CUT_5 FORMAT "%3.0"
 /begin AXIS_DESCR COM_AXIS online_dummy _CNV_A_R_LINEAR_____22_CM 4 0. 3. FORMAT "%2.0" AXIS_PTS_REF ldp_fmy_envd /end AXIS_DESCR
/end CHARACTERISTIC
/begin CHARACTERISTIC fmy_id_dur_igc_0.dtc "" CURVE 0x01f84 _REC_CUR_20_u2_u2 65535. _CNV_A_R_LINEAR_____1_CM 0. 65535. DISPLAY_IDENTIFIER ID_ERR_DTC_DUR_IGC_0 FORMAT "%5.0"
 /begin AXIS_DESCR COM_AXIS online_dummy _CNV_A_R_LINEAR_____22_CM 6 0. 5. FORMAT "%2.0" AXIS_PTS_REF ldp_fmy_dtc /end AXIS_DESCR
/end CHARACTERISTIC
/begin CHARACTERISTIC fmy_id_dur_igc_0.envd "" CURVE 0x01f90 _REC_CUR_20_u1_u1 255. _CNV_A_R_LINEAR_____1_CM 0. 255. DISPLAY_IDENTIFIER ID_ERR_ENVD_DUR_IGC_0 FORMAT "%3.0"
 /begin AXIS_DESCR COM_AXIS online_dummy _CNV_A_R_LINEAR_____22_CM 4 0. 3. FORMAT "%2.0" AXIS_PTS_REF ldp_fmy_envd /end AXIS_DESCR
/end CHARACTERISTIC
/begin CHARACTERISTIC fmy_id_dur_igc_1.dtc "" CURVE 0x01f96 _REC_CUR_20_u2_u2 65535. _CNV_A_R_LINEAR_____1_CM 0. 65535. DISPLAY_IDENTIFIER ID_ERR_DTC_DUR_IGC_1 FORMAT "%5.0"
 /begin AXIS_DESCR COM_AXIS online_dummy _CNV_A_R_LINEAR_____22_CM 6 0. 5. FORMAT "%2.0" AXIS_PTS_REF ldp_fmy_dtc /end AXIS_DESCR
/end CHARACTERISTIC
/begin CHARACTERISTIC fmy_id_dur_igc_1.envd "" CURVE 0x01fa2 _REC_CUR_20_u1_u1 255. _CNV_A_R_LINEAR_____1_CM 0. 255. DISPLAY_IDENTIFIER ID_ERR_ENVD_DUR_IGC_1 FORMAT "%3.0"
 /begin AXIS_DESCR COM_AXIS online_dummy _CNV_A_R_LINEAR_____22_CM 4 0. 3. FORMAT "%2.0" AXIS_PTS_REF ldp_fmy_envd /end AXIS_DESCR
/end CHARACTERISTIC
/begin CHARACTERISTIC fmy_id_dur_igc_2.dtc "" CURVE 0x01fa8 _REC_CUR_20_u2_u2 65535. _CNV_A_R_LINEAR_____1_CM 0. 65535. DISPLAY_IDENTIFIER ID_ERR_DTC_DUR_IGC_2 FORMAT "%5.0"
 /begin AXIS_DESCR COM_AXIS online_dummy _CNV_A_R_LINEAR_____22_CM 6 0. 5. FORMAT "%2.0" AXIS_PTS_REF ldp_fmy_dtc /end AXIS_DESCR
/end CHARACTERISTIC
/begin CHARACTERISTIC fmy_id_dur_igc_2.envd "" CURVE 0x01fb4 _REC_CUR_20_u1_u1 255. _CNV_A_R_LINEAR_____1_CM 0. 255. DISPLAY_IDENTIFIER ID_ERR_ENVD_DUR_IGC_2 FORMAT "%3.0"
 /begin AXIS_DESCR COM_AXIS online_dummy _CNV_A_R_LINEAR_____22_CM 4 0. 3. FORMAT "%2.0" AXIS_PTS_REF ldp_fmy_envd /end AXIS_DESCR
/end CHARACTERISTIC
/begin CHARACTERISTIC fmy_id_dur_igc_3.dtc "" CURVE 0x01fba _REC_CUR_20_u2_u2 65535. _CNV_A_R_LINEAR_____1_CM 0. 65535. DISPLAY_IDENTIFIER ID_ERR_DTC_DUR_IGC_3 FORMAT "%5.0"
 /begin AXIS_DESCR COM_AXIS online_dummy _CNV_A_R_LINEAR_____22_CM 6 0. 5. FORMAT "%2.0" AXIS_PTS_REF ldp_fmy_dtc /end AXIS_DESCR
/end CHARACTERISTIC
/begin CHARACTERISTIC fmy_id_dur_igc_3.envd "" CURVE 0x01fc6 _REC_CUR_20_u1_u1 255. _CNV_A_R_LINEAR_____1_CM 0. 255. DISPLAY_IDENTIFIER ID_ERR_ENVD_DUR_IGC_3 FORMAT "%3.0"
 /begin AXIS_DESCR COM_AXIS online_dummy _CNV_A_R_LINEAR_____22_CM 4 0. 3. FORMAT "%2.0" AXIS_PTS_REF ldp_fmy_envd /end AXIS_DESCR
/end CHARACTERISTIC
/begin CHARACTERISTIC fmy_id_dur_igc_4.dtc "" CURVE 0x01fcc _REC_CUR_20_u2_u2 65535. _CNV_A_R_LINEAR_____1_CM 0. 65535. DISPLAY_IDENTIFIER ID_ERR_DTC_DUR_IGC_4 FORMAT "%5.0"
 /begin AXIS_DESCR COM_AXIS online_dummy _CNV_A_R_LINEAR_____22_CM 6 0. 5. FORMAT "%2.0" AXIS_PTS_REF ldp_fmy_dtc /end AXIS_DESCR
/end CHARACTERISTIC
/begin CHARACTERISTIC fmy_id_dur_igc_4.envd "" CURVE 0x01fd8 _REC_CUR_20_u1_u1 255. _CNV_A_R_LINEAR_____1_CM 0. 255. DISPLAY_IDENTIFIER ID_ERR_ENVD_DUR_IGC_4 FORMAT "%3.0"
 /begin AXIS_DESCR COM_AXIS online_dummy _CNV_A_R_LINEAR_____22_CM 4 0. 3. FORMAT "%2.0" AXIS_PTS_REF ldp_fmy_envd /end AXIS_DESCR
/end CHARACTERISTIC
/begin CHARACTERISTIC fmy_id_dur_igc_5.dtc "" CURVE 0x01fde _REC_CUR_20_u2_u2 65535. _CNV_A_R_LINEAR_____1_CM 0. 65535. DISPLAY_IDENTIFIER ID_ERR_DTC_DUR_IGC_5 FORMAT "%5.0"
 /begin AXIS_DESCR COM_AXIS online_dummy _CNV_A_R_LINEAR_____22_CM 6 0. 5. FORMAT "%2.0" AXIS_PTS_REF ldp_fmy_dtc /end AXIS_DESCR
/end CHARACTERISTIC
/begin CHARACTERISTIC fmy_id_dur_igc_5.envd "" CURVE 0x01fea _REC_CUR_20_u1_u1 255. _CNV_A_R_LINEAR_____1_CM 0. 255. DISPLAY_IDENTIFIER ID_ERR_ENVD_DUR_IGC_5 FORMAT "%3.0"
 /begin AXIS_DESCR COM_AXIS online_dummy _CNV_A_R_LINEAR_____22_CM 4 0. 3. FORMAT "%2.0" AXIS_PTS_REF ldp_fmy_envd /end AXIS_DESCR
/end CHARACTERISTIC
/begin CHARACTERISTIC fmy_id_tps_1.dtc "" CURVE 0x01ff0 _REC_CUR_20_u2_u2 65535. _CNV_A_R_LINEAR_____1_CM 0. 65535. DISPLAY_IDENTIFIER ID_ERR_DTC_TPS_1 FORMAT "%5.0"
 /begin AXIS_DESCR COM_AXIS online_dummy _CNV_A_R_LINEAR_____22_CM 6 0. 5. FORMAT "%2.0" AXIS_PTS_REF ldp_fmy_dtc /end AXIS_DESCR
/end CHARACTERISTIC
/begin CHARACTERISTIC fmy_id_tps_1.envd "" CURVE 0x01ffc _REC_CUR_20_u1_u1 255. _CNV_A_R_LINEAR_____1_CM 0. 255. DISPLAY_IDENTIFIER ID_ERR_ENVD_TPS_1 FORMAT "%3.0"
 /begin AXIS_DESCR COM_AXIS online_dummy _CNV_A_R_LINEAR_____22_CM 4 0. 3. FORMAT "%2.0" AXIS_PTS_REF ldp_fmy_envd /end AXIS_DESCR
/end CHARACTERISTIC
/begin CHARACTERISTIC fmy_id_tps_2.dtc "" CURVE 0x02002 _REC_CUR_20_u2_u2 65535. _CNV_A_R_LINEAR_____1_CM 0. 65535. DISPLAY_IDENTIFIER ID_ERR_DTC_TPS_2 FORMAT "%5.0"
 /begin AXIS_DESCR COM_AXIS online_dummy _CNV_A_R_LINEAR_____22_CM 6 0. 5. FORMAT "%2.0" AXIS_PTS_REF ldp_fmy_dtc /end AXIS_DESCR
/end CHARACTERISTIC
/begin CHARACTERISTIC fmy_id_tps_2.envd "" CURVE 0x0200e _REC_CUR_20_u1_u1 255. _CNV_A_R_LINEAR_____1_CM 0. 255. DISPLAY_IDENTIFIER ID_ERR_ENVD_TPS_2 FORMAT "%3.0"
 /begin AXIS_DESCR COM_AXIS online_dummy _CNV_A_R_LINEAR_____22_CM 4 0. 3. FORMAT "%2.0" AXIS_PTS_REF ldp_fmy_envd /end AXIS_DESCR
/end CHARACTERISTIC
/begin CHARACTERISTIC fmy_id_tps_maf_1.dtc "" CURVE 0x02014 _REC_CUR_20_u2_u2 65535. _CNV_A_R_LINEAR_____1_CM 0. 65535. DISPLAY_IDENTIFIER ID_ERR_DTC_TPS_MAF_1 FORMAT "%5.0"
 /begin AXIS_DESCR COM_AXIS online_dummy _CNV_A_R_LINEAR_____22_CM 6 0. 5. FORMAT "%2.0" AXIS_PTS_REF ldp_fmy_dtc /end AXIS_DESCR
/end CHARACTERISTIC
/begin CHARACTERISTIC fmy_id_tps_maf_1.envd "" CURVE 0x02020 _REC_CUR_20_u1_u1 255. _CNV_A_R_LINEAR_____1_CM 0. 255. DISPLAY_IDENTIFIER ID_ERR_ENVD_TPS_MAF_1 FORMAT "%3.0"
 /begin AXIS_DESCR COM_AXIS online_dummy _CNV_A_R_LINEAR_____22_CM 4 0. 3. FORMAT "%2.0" AXIS_PTS_REF ldp_fmy_envd /end AXIS_DESCR
/end CHARACTERISTIC
/begin CHARACTERISTIC fmy_id_tps_maf_2.dtc "" CURVE 0x02026 _REC_CUR_20_u2_u2 65535. _CNV_A_R_LINEAR_____1_CM 0. 65535. DISPLAY_IDENTIFIER ID_ERR_DTC_TPS_MAF_2 FORMAT "%5.0"
 /begin AXIS_DESCR COM_AXIS online_dummy _CNV_A_R_LINEAR_____22_CM 6 0. 5. FORMAT "%2.0" AXIS_PTS_REF ldp_fmy_dtc /end AXIS_DESCR
/end CHARACTERISTIC
/begin CHARACTERISTIC fmy_id_tps_maf_2.envd "" CURVE 0x02032 _REC_CUR_20_u1_u1 255. _CNV_A_R_LINEAR_____1_CM 0. 255. DISPLAY_IDENTIFIER ID_ERR_ENVD_TPS_MAF_2 FORMAT "%3.0"
 /begin AXIS_DESCR COM_AXIS online_dummy _CNV_A_R_LINEAR_____22_CM 4 0. 3. FORMAT "%2.0" AXIS_PTS_REF ldp_fmy_envd /end AXIS_DESCR
/end CHARACTERISTIC
/begin CHARACTERISTIC fmy_id_v_ref_1.dtc "" CURVE 0x02038 _REC_CUR_20_u2_u2 65535. _CNV_A_R_LINEAR_____1_CM 0. 65535. DISPLAY_IDENTIFIER ID_ERR_DTC_V_REF_1 FORMAT "%5.0"
 /begin AXIS_DESCR COM_AXIS online_dummy _CNV_A_R_LINEAR_____22_CM 6 0. 5. FORMAT "%2.0" AXIS_PTS_REF ldp_fmy_dtc /end AXIS_DESCR
/end CHARACTERISTIC
/begin CHARACTERISTIC fmy_id_v_ref_1.envd "" CURVE 0x02044 _REC_CUR_20_u1_u1 255. _CNV_A_R_LINEAR_____1_CM 0. 255. DISPLAY_IDENTIFIER ID_ERR_ENVD_V_REF_1 FORMAT "%3.0"
 /begin AXIS_DESCR COM_AXIS online_dummy _CNV_A_R_LINEAR_____22_CM 4 0. 3. FORMAT "%2.0" AXIS_PTS_REF ldp_fmy_envd /end AXIS_DESCR
/end CHARACTERISTIC
/begin CHARACTERISTIC fmy_id_v_ref_2.dtc "" CURVE 0x0204a _REC_CUR_20_u2_u2 65535. _CNV_A_R_LINEAR_____1_CM 0. 65535. DISPLAY_IDENTIFIER ID_ERR_DTC_V_REF_2 FORMAT "%5.0"
 /begin AXIS_DESCR COM_AXIS online_dummy _CNV_A_R_LINEAR_____22_CM 6 0. 5. FORMAT "%2.0" AXIS_PTS_REF ldp_fmy_dtc /end AXIS_DESCR
/end CHARACTERISTIC
/begin CHARACTERISTIC fmy_id_v_ref_2.envd "" CURVE 0x02056 _REC_CUR_20_u1_u1 255. _CNV_A_R_LINEAR_____1_CM 0. 255. DISPLAY_IDENTIFIER ID_ERR_ENVD_V_REF_2 FORMAT "%3.0"
 /begin AXIS_DESCR COM_AXIS online_dummy _CNV_A_R_LINEAR_____22_CM 4 0. 3. FORMAT "%2.0" AXIS_PTS_REF ldp_fmy_envd /end AXIS_DESCR
/end CHARACTERISTIC
/begin CHARACTERISTIC fmy_id_pvs_1.dtc "" CURVE 0x0205c _REC_CUR_20_u2_u2 65535. _CNV_A_R_LINEAR_____1_CM 0. 65535. DISPLAY_IDENTIFIER ID_ERR_DTC_PVS_1 FORMAT "%5.0"
 /begin AXIS_DESCR COM_AXIS online_dummy _CNV_A_R_LINEAR_____22_CM 6 0. 5. FORMAT "%2.0" AXIS_PTS_REF ldp_fmy_dtc /end AXIS_DESCR
/end CHARACTERISTIC
/begin CHARACTERISTIC fmy_id_pvs_1.envd "" CURVE 0x02068 _REC_CUR_20_u1_u1 255. _CNV_A_R_LINEAR_____1_CM 0. 255. DISPLAY_IDENTIFIER ID_ERR_ENVD_PVS_1 FORMAT "%3.0"
 /begin AXIS_DESCR COM_AXIS online_dummy _CNV_A_R_LINEAR_____22_CM 4 0. 3. FORMAT "%2.0" AXIS_PTS_REF ldp_fmy_envd /end AXIS_DESCR
/end CHARACTERISTIC
/begin CHARACTERISTIC fmy_id_pvs_2.dtc "" CURVE 0x0206e _REC_CUR_20_u2_u2 65535. _CNV_A_R_LINEAR_____1_CM 0. 65535. DISPLAY_IDENTIFIER ID_ERR_DTC_PVS_2 FORMAT "%5.0"
 /begin AXIS_DESCR COM_AXIS online_dummy _CNV_A_R_LINEAR_____22_CM 6 0. 5. FORMAT "%2.0" AXIS_PTS_REF ldp_fmy_dtc /end AXIS_DESCR
/end CHARACTERISTIC
/begin CHARACTERISTIC fmy_id_pvs_2.envd "" CURVE 0x0207a _REC_CUR_20_u1_u1 255. _CNV_A_R_LINEAR_____1_CM 0. 255. DISPLAY_IDENTIFIER ID_ERR_ENVD_PVS_2 FORMAT "%3.0"
 /begin AXIS_DESCR COM_AXIS online_dummy _CNV_A_R_LINEAR_____22_CM 4 0. 3. FORMAT "%2.0" AXIS_PTS_REF ldp_fmy_envd /end AXIS_DESCR
/end CHARACTERISTIC
/begin CHARACTERISTIC fmy_id_pvs_ratio.dtc "" CURVE 0x02080 _REC_CUR_20_u2_u2 65535. _CNV_A_R_LINEAR_____1_CM 0. 65535. DISPLAY_IDENTIFIER ID_ERR_DTC_PVS_RATIO FORMAT "%5.0"
 /begin AXIS_DESCR COM_AXIS online_dummy _CNV_A_R_LINEAR_____22_CM 6 0. 5. FORMAT "%2.0" AXIS_PTS_REF ldp_fmy_dtc /end AXIS_DESCR
/end CHARACTERISTIC
/begin CHARACTERISTIC fmy_id_pvs_ratio.envd "" CURVE 0x0208c _REC_CUR_20_u1_u1 255. _CNV_A_R_LINEAR_____1_CM 0. 255. DISPLAY_IDENTIFIER ID_ERR_ENVD_PVS_RATIO FORMAT "%3.0"
 /begin AXIS_DESCR COM_AXIS online_dummy _CNV_A_R_LINEAR_____22_CM 4 0. 3. FORMAT "%2.0" AXIS_PTS_REF ldp_fmy_envd /end AXIS_DESCR
/end CHARACTERISTIC
/begin CHARACTERISTIC fmy_id_pvs_double.dtc "" CURVE 0x02092 _REC_CUR_20_u2_u2 65535. _CNV_A_R_LINEAR_____1_CM 0. 65535. DISPLAY_IDENTIFIER ID_ERR_DTC_PVS_DOUBLE FORMAT "%5.0"
 /begin AXIS_DESCR COM_AXIS online_dummy _CNV_A_R_LINEAR_____22_CM 6 0. 5. FORMAT "%2.0" AXIS_PTS_REF ldp_fmy_dtc /end AXIS_DESCR
/end CHARACTERISTIC
/begin CHARACTERISTIC fmy_id_pvs_double.envd "" CURVE 0x0209e _REC_CUR_20_u1_u1 255. _CNV_A_R_LINEAR_____1_CM 0. 255. DISPLAY_IDENTIFIER ID_ERR_ENVD_PVS_DOUBLE FORMAT "%3.0"
 /begin AXIS_DESCR COM_AXIS online_dummy _CNV_A_R_LINEAR_____22_CM 4 0. 3. FORMAT "%2.0" AXIS_PTS_REF ldp_fmy_envd /end AXIS_DESCR
/end CHARACTERISTIC
/begin CHARACTERISTIC fmy_id_pvs_bls_not_plaus.dtc "" CURVE 0x020a4 _REC_CUR_20_u2_u2 65535. _CNV_A_R_LINEAR_____1_CM 0. 65535. DISPLAY_IDENTIFIER ID_ERR_DTC_PVS_BLS_NOT_PLAUS FORMAT "%5.0"
 /begin AXIS_DESCR COM_AXIS online_dummy _CNV_A_R_LINEAR_____22_CM 6 0. 5. FORMAT "%2.0" AXIS_PTS_REF ldp_fmy_dtc /end AXIS_DESCR
/end CHARACTERISTIC
/begin CHARACTERISTIC fmy_id_pvs_bls_not_plaus.envd "" CURVE 0x020b0 _REC_CUR_20_u1_u1 255. _CNV_A_R_LINEAR_____1_CM 0. 255. DISPLAY_IDENTIFIER ID_ERR_ENVD_PVS_BLS_NOT_PLAUS FORMAT "%3.0"
 /begin AXIS_DESCR COM_AXIS online_dummy _CNV_A_R_LINEAR_____22_CM 4 0. 3. FORMAT "%2.0" AXIS_PTS_REF ldp_fmy_envd /end AXIS_DESCR
/end CHARACTERISTIC
/begin CHARACTERISTIC fmy_id_mtc_dr.dtc "" CURVE 0x020b6 _REC_CUR_20_u2_u2 65535. _CNV_A_R_LINEAR_____1_CM 0. 65535. DISPLAY_IDENTIFIER ID_ERR_DTC_MTC_DR FORMAT "%5.0"
 /begin AXIS_DESCR COM_AXIS online_dummy _CNV_A_R_LINEAR_____22_CM 6 0. 5. FORMAT "%2.0" AXIS_PTS_REF ldp_fmy_dtc /end AXIS_DESCR
/end CHARACTERISTIC
/begin CHARACTERISTIC fmy_id_mtc_dr.envd "" CURVE 0x020c2 _REC_CUR_20_u1_u1 255. _CNV_A_R_LINEAR_____1_CM 0. 255. DISPLAY_IDENTIFIER ID_ERR_ENVD_MTC_DR FORMAT "%3.0"
 /begin AXIS_DESCR COM_AXIS online_dummy _CNV_A_R_LINEAR_____22_CM 4 0. 3. FORMAT "%2.0" AXIS_PTS_REF ldp_fmy_envd /end AXIS_DESCR
/end CHARACTERISTIC
/begin CHARACTERISTIC fmy_id_mtc_ctl_1.dtc "" CURVE 0x020c8 _REC_CUR_20_u2_u2 65535. _CNV_A_R_LINEAR_____1_CM 0. 65535. DISPLAY_IDENTIFIER ID_ERR_DTC_MTC_CTL_1 FORMAT "%5.0"
 /begin AXIS_DESCR COM_AXIS online_dummy _CNV_A_R_LINEAR_____22_CM 6 0. 5. FORMAT "%2.0" AXIS_PTS_REF ldp_fmy_dtc /end AXIS_DESCR
/end CHARACTERISTIC
/begin CHARACTERISTIC fmy_id_mtc_ctl_1.envd "" CURVE 0x020d4 _REC_CUR_20_u1_u1 255. _CNV_A_R_LINEAR_____1_CM 0. 255. DISPLAY_IDENTIFIER ID_ERR_ENVD_MTC_CTL_1 FORMAT "%3.0"
 /begin AXIS_DESCR COM_AXIS online_dummy _CNV_A_R_LINEAR_____22_CM 4 0. 3. FORMAT "%2.0" AXIS_PTS_REF ldp_fmy_envd /end AXIS_DESCR
/end CHARACTERISTIC
/begin CHARACTERISTIC fmy_id_mtc_ctl_2.dtc "" CURVE 0x020da _REC_CUR_20_u2_u2 65535. _CNV_A_R_LINEAR_____1_CM 0. 65535. DISPLAY_IDENTIFIER ID_ERR_DTC_MTC_CTL_2 FORMAT "%5.0"
 /begin AXIS_DESCR COM_AXIS online_dummy _CNV_A_R_LINEAR_____22_CM 6 0. 5. FORMAT "%2.0" AXIS_PTS_REF ldp_fmy_dtc /end AXIS_DESCR
/end CHARACTERISTIC
/begin CHARACTERISTIC fmy_id_mtc_ctl_2.envd "" CURVE 0x020e6 _REC_CUR_20_u1_u1 255. _CNV_A_R_LINEAR_____1_CM 0. 255. DISPLAY_IDENTIFIER ID_ERR_ENVD_MTC_CTL_2 FORMAT "%3.0"
 /begin AXIS_DESCR COM_AXIS online_dummy _CNV_A_R_LINEAR_____22_CM 4 0. 3. FORMAT "%2.0" AXIS_PTS_REF ldp_fmy_envd /end AXIS_DESCR
/end CHARACTERISTIC
/begin CHARACTERISTIC fmy_id_mtc_ctl_3.dtc "" CURVE 0x020ec _REC_CUR_20_u2_u2 65535. _CNV_A_R_LINEAR_____1_CM 0. 65535. DISPLAY_IDENTIFIER ID_ERR_DTC_MTC_CTL_3 FORMAT "%5.0"
 /begin AXIS_DESCR COM_AXIS online_dummy _CNV_A_R_LINEAR_____22_CM 6 0. 5. FORMAT "%2.0" AXIS_PTS_REF ldp_fmy_dtc /end AXIS_DESCR
/end CHARACTERISTIC
/begin CHARACTERISTIC fmy_id_mtc_ctl_3.envd "" CURVE 0x020f8 _REC_CUR_20_u1_u1 255. _CNV_A_R_LINEAR_____1_CM 0. 255. DISPLAY_IDENTIFIER ID_ERR_ENVD_MTC_CTL_3 FORMAT "%3.0"
 /begin AXIS_DESCR COM_AXIS online_dummy _CNV_A_R_LINEAR_____22_CM 4 0. 3. FORMAT "%2.0" AXIS_PTS_REF ldp_fmy_envd /end AXIS_DESCR
/end CHARACTERISTIC
/begin CHARACTERISTIC fmy_id_tps_ad.dtc "" CURVE 0x020fe _REC_CUR_20_u2_u2 65535. _CNV_A_R_LINEAR_____1_CM 0. 65535. DISPLAY_IDENTIFIER ID_ERR_DTC_TPS_AD FORMAT "%5.0"
 /begin AXIS_DESCR COM_AXIS online_dummy _CNV_A_R_LINEAR_____22_CM 6 0. 5. FORMAT "%2.0" AXIS_PTS_REF ldp_fmy_dtc /end AXIS_DESCR
/end CHARACTERISTIC
/begin CHARACTERISTIC fmy_id_tps_ad.envd "" CURVE 0x0210a _REC_CUR_20_u1_u1 255. _CNV_A_R_LINEAR_____1_CM 0. 255. DISPLAY_IDENTIFIER ID_ERR_ENVD_TPS_AD FORMAT "%3.0"
 /begin AXIS_DESCR COM_AXIS online_dummy _CNV_A_R_LINEAR_____22_CM 4 0. 3. FORMAT "%2.0" AXIS_PTS_REF ldp_fmy_envd /end AXIS_DESCR
/end CHARACTERISTIC
/begin CHARACTERISTIC fmy_id_tps_ad_bol.dtc "" CURVE 0x02110 _REC_CUR_20_u2_u2 65535. _CNV_A_R_LINEAR_____1_CM 0. 65535. DISPLAY_IDENTIFIER ID_ERR_DTC_TPS_AD_BOL FORMAT "%5.0"
 /begin AXIS_DESCR COM_AXIS online_dummy _CNV_A_R_LINEAR_____22_CM 6 0. 5. FORMAT "%2.0" AXIS_PTS_REF ldp_fmy_dtc /end AXIS_DESCR
/end CHARACTERISTIC
/begin CHARACTERISTIC fmy_id_tps_ad_bol.envd "" CURVE 0x0211c _REC_CUR_20_u1_u1 255. _CNV_A_R_LINEAR_____1_CM 0. 255. DISPLAY_IDENTIFIER ID_ERR_ENVD_TPS_AD_BOL FORMAT "%3.0"
 /begin AXIS_DESCR COM_AXIS online_dummy _CNV_A_R_LINEAR_____22_CM 4 0. 3. FORMAT "%2.0" AXIS_PTS_REF ldp_fmy_envd /end AXIS_DESCR
/end CHARACTERISTIC
/begin CHARACTERISTIC fmy_id_tps_st_chk_1.dtc "" CURVE 0x02122 _REC_CUR_20_u2_u2 65535. _CNV_A_R_LINEAR_____1_CM 0. 65535. DISPLAY_IDENTIFIER ID_ERR_DTC_TPS_ST_CHK_1 FORMAT "%5.0"
 /begin AXIS_DESCR COM_AXIS online_dummy _CNV_A_R_LINEAR_____22_CM 6 0. 5. FORMAT "%2.0" AXIS_PTS_REF ldp_fmy_dtc /end AXIS_DESCR
/end CHARACTERISTIC
/begin CHARACTERISTIC fmy_id_tps_st_chk_1.envd "" CURVE 0x0212e _REC_CUR_20_u1_u1 255. _CNV_A_R_LINEAR_____1_CM 0. 255. DISPLAY_IDENTIFIER ID_ERR_ENVD_TPS_ST_CHK_1 FORMAT "%3.0"
 /begin AXIS_DESCR COM_AXIS online_dummy _CNV_A_R_LINEAR_____22_CM 4 0. 3. FORMAT "%2.0" AXIS_PTS_REF ldp_fmy_envd /end AXIS_DESCR
/end CHARACTERISTIC
/begin CHARACTERISTIC fmy_id_tps_st_chk_2.dtc "" CURVE 0x02134 _REC_CUR_20_u2_u2 65535. _CNV_A_R_LINEAR_____1_CM 0. 65535. DISPLAY_IDENTIFIER ID_ERR_DTC_TPS_ST_CHK_2 FORMAT "%5.0"
 /begin AXIS_DESCR COM_AXIS online_dummy _CNV_A_R_LINEAR_____22_CM 6 0. 5. FORMAT "%2.0" AXIS_PTS_REF ldp_fmy_dtc /end AXIS_DESCR
/end CHARACTERISTIC
/begin CHARACTERISTIC fmy_id_tps_st_chk_2.envd "" CURVE 0x02140 _REC_CUR_20_u1_u1 255. _CNV_A_R_LINEAR_____1_CM 0. 255. DISPLAY_IDENTIFIER ID_ERR_ENVD_TPS_ST_CHK_2 FORMAT "%3.0"
 /begin AXIS_DESCR COM_AXIS online_dummy _CNV_A_R_LINEAR_____22_CM 4 0. 3. FORMAT "%2.0" AXIS_PTS_REF ldp_fmy_envd /end AXIS_DESCR
/end CHARACTERISTIC
/begin CHARACTERISTIC fmy_id_gen.dtc "" CURVE 0x02146 _REC_CUR_20_u2_u2 65535. _CNV_A_R_LINEAR_____1_CM 0. 65535. DISPLAY_IDENTIFIER ID_ERR_DTC_GEN FORMAT "%5.0"
 /begin AXIS_DESCR COM_AXIS online_dummy _CNV_A_R_LINEAR_____22_CM 6 0. 5. FORMAT "%2.0" AXIS_PTS_REF ldp_fmy_dtc /end AXIS_DESCR
/end CHARACTERISTIC
/begin CHARACTERISTIC fmy_id_gen.envd "" CURVE 0x02152 _REC_CUR_20_u1_u1 255. _CNV_A_R_LINEAR_____1_CM 0. 255. DISPLAY_IDENTIFIER ID_ERR_ENVD_GEN FORMAT "%3.0"
 /begin AXIS_DESCR COM_AXIS online_dummy _CNV_A_R_LINEAR_____22_CM 4 0. 3. FORMAT "%2.0" AXIS_PTS_REF ldp_fmy_envd /end AXIS_DESCR
/end CHARACTERISTIC
/begin CHARACTERISTIC fmy_id_gen_if.dtc "" CURVE 0x02158 _REC_CUR_20_u2_u2 65535. _CNV_A_R_LINEAR_____1_CM 0. 65535. DISPLAY_IDENTIFIER ID_ERR_DTC_GEN_IF FORMAT "%5.0"
 /begin AXIS_DESCR COM_AXIS online_dummy _CNV_A_R_LINEAR_____22_CM 6 0. 5. FORMAT "%2.0" AXIS_PTS_REF ldp_fmy_dtc /end AXIS_DESCR
/end CHARACTERISTIC
/begin CHARACTERISTIC fmy_id_gen_if.envd "" CURVE 0x02164 _REC_CUR_20_u1_u1 255. _CNV_A_R_LINEAR_____1_CM 0. 255. DISPLAY_IDENTIFIER ID_ERR_ENVD_GEN_IF FORMAT "%3.0"
 /begin AXIS_DESCR COM_AXIS online_dummy _CNV_A_R_LINEAR_____22_CM 4 0. 3. FORMAT "%2.0" AXIS_PTS_REF ldp_fmy_envd /end AXIS_DESCR
/end CHARACTERISTIC
/begin CHARACTERISTIC fmy_id_gen_diag.dtc "" CURVE 0x0216a _REC_CUR_20_u2_u2 65535. _CNV_A_R_LINEAR_____1_CM 0. 65535. DISPLAY_IDENTIFIER ID_ERR_DTC_GEN_DIAG FORMAT "%5.0"
 /begin AXIS_DESCR COM_AXIS online_dummy _CNV_A_R_LINEAR_____22_CM 6 0. 5. FORMAT "%2.0" AXIS_PTS_REF ldp_fmy_dtc /end AXIS_DESCR
/end CHARACTERISTIC
/begin CHARACTERISTIC fmy_id_gen_diag.envd "" CURVE 0x02176 _REC_CUR_20_u1_u1 255. _CNV_A_R_LINEAR_____1_CM 0. 255. DISPLAY_IDENTIFIER ID_ERR_ENVD_GEN_DIAG FORMAT "%3.0"
 /begin AXIS_DESCR COM_AXIS online_dummy _CNV_A_R_LINEAR_____22_CM 4 0. 3. FORMAT "%2.0" AXIS_PTS_REF ldp_fmy_envd /end AXIS_DESCR
/end CHARACTERISTIC
/begin CHARACTERISTIC fmy_id_vim.dtc "" CURVE 0x0217c _REC_CUR_20_u2_u2 65535. _CNV_A_R_LINEAR_____1_CM 0. 65535. DISPLAY_IDENTIFIER ID_ERR_DTC_VIM FORMAT "%5.0"
 /begin AXIS_DESCR COM_AXIS online_dummy _CNV_A_R_LINEAR_____22_CM 6 0. 5. FORMAT "%2.0" AXIS_PTS_REF ldp_fmy_dtc /end AXIS_DESCR
/end CHARACTERISTIC
/begin CHARACTERISTIC fmy_id_vim.envd "" CURVE 0x02188 _REC_CUR_20_u1_u1 255. _CNV_A_R_LINEAR_____1_CM 0. 255. DISPLAY_IDENTIFIER ID_ERR_ENVD_VIM FORMAT "%3.0"
 /begin AXIS_DESCR COM_AXIS online_dummy _CNV_A_R_LINEAR_____22_CM 4 0. 3. FORMAT "%2.0" AXIS_PTS_REF ldp_fmy_envd /end AXIS_DESCR
/end CHARACTERISTIC
/begin CHARACTERISTIC fmy_id_cam_per_0.dtc "" CURVE 0x0218e _REC_CUR_20_u2_u2 65535. _CNV_A_R_LINEAR_____1_CM 0. 65535. DISPLAY_IDENTIFIER ID_ERR_DTC_CAM_PER_0 FORMAT "%5.0"
 /begin AXIS_DESCR COM_AXIS online_dummy _CNV_A_R_LINEAR_____22_CM 6 0. 5. FORMAT "%2.0" AXIS_PTS_REF ldp_fmy_dtc /end AXIS_DESCR
/end CHARACTERISTIC
/begin CHARACTERISTIC fmy_id_cam_per_0.envd "" CURVE 0x0219a _REC_CUR_20_u1_u1 255. _CNV_A_R_LINEAR_____1_CM 0. 255. DISPLAY_IDENTIFIER ID_ERR_ENVD_CAM_PER_0 FORMAT "%3.0"
 /begin AXIS_DESCR COM_AXIS online_dummy _CNV_A_R_LINEAR_____22_CM 4 0. 3. FORMAT "%2.0" AXIS_PTS_REF ldp_fmy_envd /end AXIS_DESCR
/end CHARACTERISTIC
/begin CHARACTERISTIC fmy_id_cam_per_1.dtc "" CURVE 0x021a0 _REC_CUR_20_u2_u2 65535. _CNV_A_R_LINEAR_____1_CM 0. 65535. DISPLAY_IDENTIFIER ID_ERR_DTC_CAM_PER_1 FORMAT "%5.0"
 /begin AXIS_DESCR COM_AXIS online_dummy _CNV_A_R_LINEAR_____22_CM 6 0. 5. FORMAT "%2.0" AXIS_PTS_REF ldp_fmy_dtc /end AXIS_DESCR
/end CHARACTERISTIC
/begin CHARACTERISTIC fmy_id_cam_per_1.envd "" CURVE 0x021ac _REC_CUR_20_u1_u1 255. _CNV_A_R_LINEAR_____1_CM 0. 255. DISPLAY_IDENTIFIER ID_ERR_ENVD_CAM_PER_1 FORMAT "%3.0"
 /begin AXIS_DESCR COM_AXIS online_dummy _CNV_A_R_LINEAR_____22_CM 4 0. 3. FORMAT "%2.0" AXIS_PTS_REF ldp_fmy_envd /end AXIS_DESCR
/end CHARACTERISTIC
/begin CHARACTERISTIC fmy_id_cam_psn_0.dtc "" CURVE 0x021b2 _REC_CUR_20_u2_u2 65535. _CNV_A_R_LINEAR_____1_CM 0. 65535. DISPLAY_IDENTIFIER ID_ERR_DTC_CAM_PSN_0 FORMAT "%5.0"
 /begin AXIS_DESCR COM_AXIS online_dummy _CNV_A_R_LINEAR_____22_CM 6 0. 5. FORMAT "%2.0" AXIS_PTS_REF ldp_fmy_dtc /end AXIS_DESCR
/end CHARACTERISTIC
/begin CHARACTERISTIC fmy_id_cam_psn_0.envd "" CURVE 0x021be _REC_CUR_20_u1_u1 255. _CNV_A_R_LINEAR_____1_CM 0. 255. DISPLAY_IDENTIFIER ID_ERR_ENVD_CAM_PSN_0 FORMAT "%3.0"
 /begin AXIS_DESCR COM_AXIS online_dummy _CNV_A_R_LINEAR_____22_CM 4 0. 3. FORMAT "%2.0" AXIS_PTS_REF ldp_fmy_envd /end AXIS_DESCR
/end CHARACTERISTIC
/begin CHARACTERISTIC fmy_id_cam_psn_1.dtc "" CURVE 0x021c4 _REC_CUR_20_u2_u2 65535. _CNV_A_R_LINEAR_____1_CM 0. 65535. DISPLAY_IDENTIFIER ID_ERR_DTC_CAM_PSN_1 FORMAT "%5.0"
 /begin AXIS_DESCR COM_AXIS online_dummy _CNV_A_R_LINEAR_____22_CM 6 0. 5. FORMAT "%2.0" AXIS_PTS_REF ldp_fmy_dtc /end AXIS_DESCR
/end CHARACTERISTIC
/begin CHARACTERISTIC fmy_id_cam_psn_1.envd "" CURVE 0x021d0 _REC_CUR_20_u1_u1 255. _CNV_A_R_LINEAR_____1_CM 0. 255. DISPLAY_IDENTIFIER ID_ERR_ENVD_CAM_PSN_1 FORMAT "%3.0"
 /begin AXIS_DESCR COM_AXIS online_dummy _CNV_A_R_LINEAR_____22_CM 4 0. 3. FORMAT "%2.0" AXIS_PTS_REF ldp_fmy_envd /end AXIS_DESCR
/end CHARACTERISTIC
/begin CHARACTERISTIC fmy_id_cam_0_not_plaus.dtc "" CURVE 0x021d6 _REC_CUR_20_u2_u2 65535. _CNV_A_R_LINEAR_____1_CM 0. 65535. DISPLAY_IDENTIFIER ID_ERR_DTC_CAM_0_NOT_PLAUS FORMAT "%5.0"
 /begin AXIS_DESCR COM_AXIS online_dummy _CNV_A_R_LINEAR_____22_CM 6 0. 5. FORMAT "%2.0" AXIS_PTS_REF ldp_fmy_dtc /end AXIS_DESCR
/end CHARACTERISTIC
/begin CHARACTERISTIC fmy_id_cam_0_not_plaus.envd "" CURVE 0x021e2 _REC_CUR_20_u1_u1 255. _CNV_A_R_LINEAR_____1_CM 0. 255. DISPLAY_IDENTIFIER ID_ERR_ENVD_CAM_0_NOT_PLAUS FORMAT "%3.0"
 /begin AXIS_DESCR COM_AXIS online_dummy _CNV_A_R_LINEAR_____22_CM 4 0. 3. FORMAT "%2.0" AXIS_PTS_REF ldp_fmy_envd /end AXIS_DESCR
/end CHARACTERISTIC
/begin CHARACTERISTIC fmy_id_cam_1_not_plaus.dtc "" CURVE 0x021e8 _REC_CUR_20_u2_u2 65535. _CNV_A_R_LINEAR_____1_CM 0. 65535. DISPLAY_IDENTIFIER ID_ERR_DTC_CAM_1_NOT_PLAUS FORMAT "%5.0"
 /begin AXIS_DESCR COM_AXIS online_dummy _CNV_A_R_LINEAR_____22_CM 6 0. 5. FORMAT "%2.0" AXIS_PTS_REF ldp_fmy_dtc /end AXIS_DESCR
/end CHARACTERISTIC
/begin CHARACTERISTIC fmy_id_cam_1_not_plaus.envd "" CURVE 0x021f4 _REC_CUR_20_u1_u1 255. _CNV_A_R_LINEAR_____1_CM 0. 255. DISPLAY_IDENTIFIER ID_ERR_ENVD_CAM_1_NOT_PLAUS FORMAT "%3.0"
 /begin AXIS_DESCR COM_AXIS online_dummy _CNV_A_R_LINEAR_____22_CM 4 0. 3. FORMAT "%2.0" AXIS_PTS_REF ldp_fmy_envd /end AXIS_DESCR
/end CHARACTERISTIC
/begin CHARACTERISTIC fmy_id_eng_psn.dtc "" CURVE 0x021fa _REC_CUR_20_u2_u2 65535. _CNV_A_R_LINEAR_____1_CM 0. 65535. DISPLAY_IDENTIFIER ID_ERR_DTC_ENG_PSN FORMAT "%5.0"
 /begin AXIS_DESCR COM_AXIS online_dummy _CNV_A_R_LINEAR_____22_CM 6 0. 5. FORMAT "%2.0" AXIS_PTS_REF ldp_fmy_dtc /end AXIS_DESCR
/end CHARACTERISTIC
/begin CHARACTERISTIC fmy_id_eng_psn.envd "" CURVE 0x02206 _REC_CUR_20_u1_u1 255. _CNV_A_R_LINEAR_____1_CM 0. 255. DISPLAY_IDENTIFIER ID_ERR_ENVD_ENG_PSN FORMAT "%3.0"
 /begin AXIS_DESCR COM_AXIS online_dummy _CNV_A_R_LINEAR_____22_CM 4 0. 3. FORMAT "%2.0" AXIS_PTS_REF ldp_fmy_envd /end AXIS_DESCR
/end CHARACTERISTIC
/begin CHARACTERISTIC fmy_id_tooth_per.dtc "" CURVE 0x0220c _REC_CUR_20_u2_u2 65535. _CNV_A_R_LINEAR_____1_CM 0. 65535. DISPLAY_IDENTIFIER ID_ERR_DTC_TOOTH_PER FORMAT "%5.0"
 /begin AXIS_DESCR COM_AXIS online_dummy _CNV_A_R_LINEAR_____22_CM 6 0. 5. FORMAT "%2.0" AXIS_PTS_REF ldp_fmy_dtc /end AXIS_DESCR
/end CHARACTERISTIC
/begin CHARACTERISTIC fmy_id_tooth_per.envd "" CURVE 0x02218 _REC_CUR_20_u1_u1 255. _CNV_A_R_LINEAR_____1_CM 0. 255. DISPLAY_IDENTIFIER ID_ERR_ENVD_TOOTH_PER FORMAT "%3.0"
 /begin AXIS_DESCR COM_AXIS online_dummy _CNV_A_R_LINEAR_____22_CM 4 0. 3. FORMAT "%2.0" AXIS_PTS_REF ldp_fmy_envd /end AXIS_DESCR
/end CHARACTERISTIC
/begin CHARACTERISTIC fmy_id_tpu_syn.dtc "" CURVE 0x0221e _REC_CUR_20_u2_u2 65535. _CNV_A_R_LINEAR_____1_CM 0. 65535. DISPLAY_IDENTIFIER ID_ERR_DTC_TPU_SYN FORMAT "%5.0"
 /begin AXIS_DESCR COM_AXIS online_dummy _CNV_A_R_LINEAR_____22_CM 6 0. 5. FORMAT "%2.0" AXIS_PTS_REF ldp_fmy_dtc /end AXIS_DESCR
/end CHARACTERISTIC
/begin CHARACTERISTIC fmy_id_tpu_syn.envd "" CURVE 0x0222a _REC_CUR_20_u1_u1 255. _CNV_A_R_LINEAR_____1_CM 0. 255. DISPLAY_IDENTIFIER ID_ERR_ENVD_TPU_SYN FORMAT "%3.0"
 /begin AXIS_DESCR COM_AXIS online_dummy _CNV_A_R_LINEAR_____22_CM 4 0. 3. FORMAT "%2.0" AXIS_PTS_REF ldp_fmy_envd /end AXIS_DESCR
/end CHARACTERISTIC
/begin CHARACTERISTIC fmy_id_crk_not_plaus.dtc "" CURVE 0x02230 _REC_CUR_20_u2_u2 65535. _CNV_A_R_LINEAR_____1_CM 0. 65535. DISPLAY_IDENTIFIER ID_ERR_DTC_CRK_NOT_PLAUS FORMAT "%5.0"
 /begin AXIS_DESCR COM_AXIS online_dummy _CNV_A_R_LINEAR_____22_CM 6 0. 5. FORMAT "%2.0" AXIS_PTS_REF ldp_fmy_dtc /end AXIS_DESCR
/end CHARACTERISTIC
/begin CHARACTERISTIC fmy_id_crk_not_plaus.envd "" CURVE 0x0223c _REC_CUR_20_u1_u1 255. _CNV_A_R_LINEAR_____1_CM 0. 255. DISPLAY_IDENTIFIER ID_ERR_ENVD_CRK_NOT_PLAUS FORMAT "%3.0"
 /begin AXIS_DESCR COM_AXIS online_dummy _CNV_A_R_LINEAR_____22_CM 4 0. 3. FORMAT "%2.0" AXIS_PTS_REF ldp_fmy_envd /end AXIS_DESCR
/end CHARACTERISTIC
/begin CHARACTERISTIC fmy_id_tout_txu_1.dtc "" CURVE 0x02242 _REC_CUR_20_u2_u2 65535. _CNV_A_R_LINEAR_____1_CM 0. 65535. DISPLAY_IDENTIFIER ID_ERR_DTC_TOUT_TXU_1 FORMAT "%5.0"
 /begin AXIS_DESCR COM_AXIS online_dummy _CNV_A_R_LINEAR_____22_CM 6 0. 5. FORMAT "%2.0" AXIS_PTS_REF ldp_fmy_dtc /end AXIS_DESCR
/end CHARACTERISTIC
/begin CHARACTERISTIC fmy_id_tout_txu_1.envd "" CURVE 0x0224e _REC_CUR_20_u1_u1 255. _CNV_A_R_LINEAR_____1_CM 0. 255. DISPLAY_IDENTIFIER ID_ERR_ENVD_TOUT_TXU_1 FORMAT "%3.0"
 /begin AXIS_DESCR COM_AXIS online_dummy _CNV_A_R_LINEAR_____22_CM 4 0. 3. FORMAT "%2.0" AXIS_PTS_REF ldp_fmy_envd /end AXIS_DESCR
/end CHARACTERISTIC
/begin CHARACTERISTIC fmy_id_can_boff.dtc "" CURVE 0x02254 _REC_CUR_20_u2_u2 65535. _CNV_A_R_LINEAR_____1_CM 0. 65535. DISPLAY_IDENTIFIER ID_ERR_DTC_CAN_BOFF FORMAT "%5.0"
 /begin AXIS_DESCR COM_AXIS online_dummy _CNV_A_R_LINEAR_____22_CM 6 0. 5. FORMAT "%2.0" AXIS_PTS_REF ldp_fmy_dtc /end AXIS_DESCR
/end CHARACTERISTIC
/begin CHARACTERISTIC fmy_id_can_boff.envd "" CURVE 0x02260 _REC_CUR_20_u1_u1 255. _CNV_A_R_LINEAR_____1_CM 0. 255. DISPLAY_IDENTIFIER ID_ERR_ENVD_CAN_BOFF FORMAT "%3.0"
 /begin AXIS_DESCR COM_AXIS online_dummy _CNV_A_R_LINEAR_____22_CM 4 0. 3. FORMAT "%2.0" AXIS_PTS_REF ldp_fmy_envd /end AXIS_DESCR
/end CHARACTERISTIC
/begin CHARACTERISTIC fmy_id_rly_main.dtc "" CURVE 0x02266 _REC_CUR_20_u2_u2 65535. _CNV_A_R_LINEAR_____1_CM 0. 65535. DISPLAY_IDENTIFIER ID_ERR_DTC_RLY_MAIN FORMAT "%5.0"
 /begin AXIS_DESCR COM_AXIS online_dummy _CNV_A_R_LINEAR_____22_CM 6 0. 5. FORMAT "%2.0" AXIS_PTS_REF ldp_fmy_dtc /end AXIS_DESCR
/end CHARACTERISTIC
/begin CHARACTERISTIC fmy_id_rly_main.envd "" CURVE 0x02272 _REC_CUR_20_u1_u1 255. _CNV_A_R_LINEAR_____1_CM 0. 255. DISPLAY_IDENTIFIER ID_ERR_ENVD_RLY_MAIN FORMAT "%3.0"
 /begin AXIS_DESCR COM_AXIS online_dummy _CNV_A_R_LINEAR_____22_CM 4 0. 3. FORMAT "%2.0" AXIS_PTS_REF ldp_fmy_envd /end AXIS_DESCR
/end CHARACTERISTIC
/begin CHARACTERISTIC fmy_id_rly_main_dly.dtc "" CURVE 0x02278 _REC_CUR_20_u2_u2 65535. _CNV_A_R_LINEAR_____1_CM 0. 65535. DISPLAY_IDENTIFIER ID_ERR_DTC_RLY_MAIN_DLY FORMAT "%5.0"
 /begin AXIS_DESCR COM_AXIS online_dummy _CNV_A_R_LINEAR_____22_CM 6 0. 5. FORMAT "%2.0" AXIS_PTS_REF ldp_fmy_dtc /end AXIS_DESCR
/end CHARACTERISTIC
/begin CHARACTERISTIC fmy_id_rly_main_dly.envd "" CURVE 0x02284 _REC_CUR_20_u1_u1 255. _CNV_A_R_LINEAR_____1_CM 0. 255. DISPLAY_IDENTIFIER ID_ERR_ENVD_RLY_MAIN_DLY FORMAT "%3.0"
 /begin AXIS_DESCR COM_AXIS online_dummy _CNV_A_R_LINEAR_____22_CM 4 0. 3. FORMAT "%2.0" AXIS_PTS_REF ldp_fmy_envd /end AXIS_DESCR
/end CHARACTERISTIC
/begin CHARACTERISTIC fmy_id_rly_accout.dtc "" CURVE 0x0228a _REC_CUR_20_u2_u2 65535. _CNV_A_R_LINEAR_____1_CM 0. 65535. DISPLAY_IDENTIFIER ID_ERR_DTC_RLY_ACCOUT FORMAT "%5.0"
 /begin AXIS_DESCR COM_AXIS online_dummy _CNV_A_R_LINEAR_____22_CM 6 0. 5. FORMAT "%2.0" AXIS_PTS_REF ldp_fmy_dtc /end AXIS_DESCR
/end CHARACTERISTIC
/begin CHARACTERISTIC fmy_id_rly_accout.envd "" CURVE 0x02296 _REC_CUR_20_u1_u1 255. _CNV_A_R_LINEAR_____1_CM 0. 255. DISPLAY_IDENTIFIER ID_ERR_ENVD_RLY_ACCOUT FORMAT "%3.0"
 /begin AXIS_DESCR COM_AXIS online_dummy _CNV_A_R_LINEAR_____22_CM 4 0. 3. FORMAT "%2.0" AXIS_PTS_REF ldp_fmy_envd /end AXIS_DESCR
/end CHARACTERISTIC
/begin CHARACTERISTIC fmy_id_sap.dtc "" CURVE 0x0229c _REC_CUR_20_u2_u2 65535. _CNV_A_R_LINEAR_____1_CM 0. 65535. DISPLAY_IDENTIFIER ID_ERR_DTC_SAP FORMAT "%5.0"
 /begin AXIS_DESCR COM_AXIS online_dummy _CNV_A_R_LINEAR_____22_CM 6 0. 5. FORMAT "%2.0" AXIS_PTS_REF ldp_fmy_dtc /end AXIS_DESCR
/end CHARACTERISTIC
/begin CHARACTERISTIC fmy_id_sap.envd "" CURVE 0x022a8 _REC_CUR_20_u1_u1 255. _CNV_A_R_LINEAR_____1_CM 0. 255. DISPLAY_IDENTIFIER ID_ERR_ENVD_SAP FORMAT "%3.0"
 /begin AXIS_DESCR COM_AXIS online_dummy _CNV_A_R_LINEAR_____22_CM 4 0. 3. FORMAT "%2.0" AXIS_PTS_REF ldp_fmy_envd /end AXIS_DESCR
/end CHARACTERISTIC
/begin CHARACTERISTIC fmy_id_sav.dtc "" CURVE 0x022ae _REC_CUR_20_u2_u2 65535. _CNV_A_R_LINEAR_____1_CM 0. 65535. DISPLAY_IDENTIFIER ID_ERR_DTC_SAV FORMAT "%5.0"
 /begin AXIS_DESCR COM_AXIS online_dummy _CNV_A_R_LINEAR_____22_CM 6 0. 5. FORMAT "%2.0" AXIS_PTS_REF ldp_fmy_dtc /end AXIS_DESCR
/end CHARACTERISTIC
/begin CHARACTERISTIC fmy_id_sav.envd "" CURVE 0x022ba _REC_CUR_20_u1_u1 255. _CNV_A_R_LINEAR_____1_CM 0. 255. DISPLAY_IDENTIFIER ID_ERR_ENVD_SAV FORMAT "%3.0"
 /begin AXIS_DESCR COM_AXIS online_dummy _CNV_A_R_LINEAR_____22_CM 4 0. 3. FORMAT "%2.0" AXIS_PTS_REF ldp_fmy_envd /end AXIS_DESCR
/end CHARACTERISTIC
/begin CHARACTERISTIC fmy_id_ecf.dtc "" CURVE 0x022c0 _REC_CUR_20_u2_u2 65535. _CNV_A_R_LINEAR_____1_CM 0. 65535. DISPLAY_IDENTIFIER ID_ERR_DTC_ECF FORMAT "%5.0"
 /begin AXIS_DESCR COM_AXIS online_dummy _CNV_A_R_LINEAR_____22_CM 6 0. 5. FORMAT "%2.0" AXIS_PTS_REF ldp_fmy_dtc /end AXIS_DESCR
/end CHARACTERISTIC
/begin CHARACTERISTIC fmy_id_ecf.envd "" CURVE 0x022cc _REC_CUR_20_u1_u1 255. _CNV_A_R_LINEAR_____1_CM 0. 255. DISPLAY_IDENTIFIER ID_ERR_ENVD_ECF FORMAT "%3.0"
 /begin AXIS_DESCR COM_AXIS online_dummy _CNV_A_R_LINEAR_____22_CM 4 0. 3. FORMAT "%2.0" AXIS_PTS_REF ldp_fmy_envd /end AXIS_DESCR
/end CHARACTERISTIC
/begin CHARACTERISTIC fmy_id_tco_plaus.dtc "" CURVE 0x022d2 _REC_CUR_20_u2_u2 65535. _CNV_A_R_LINEAR_____1_CM 0. 65535. DISPLAY_IDENTIFIER ID_ERR_DTC_TCO_PLAUS FORMAT "%5.0"
 /begin AXIS_DESCR COM_AXIS online_dummy _CNV_A_R_LINEAR_____22_CM 6 0. 5. FORMAT "%2.0" AXIS_PTS_REF ldp_fmy_dtc /end AXIS_DESCR
/end CHARACTERISTIC
/begin CHARACTERISTIC fmy_id_tco_plaus.envd "" CURVE 0x022de _REC_CUR_20_u1_u1 255. _CNV_A_R_LINEAR_____1_CM 0. 255. DISPLAY_IDENTIFIER ID_ERR_ENVD_TCO_PLAUS FORMAT "%3.0"
 /begin AXIS_DESCR COM_AXIS online_dummy _CNV_A_R_LINEAR_____22_CM 4 0. 3. FORMAT "%2.0" AXIS_PTS_REF ldp_fmy_envd /end AXIS_DESCR
/end CHARACTERISTIC
/begin CHARACTERISTIC fmy_id_tco_el.dtc "" CURVE 0x022e4 _REC_CUR_20_u2_u2 65535. _CNV_A_R_LINEAR_____1_CM 0. 65535. DISPLAY_IDENTIFIER ID_ERR_DTC_TCO_EL FORMAT "%5.0"
 /begin AXIS_DESCR COM_AXIS online_dummy _CNV_A_R_LINEAR_____22_CM 6 0. 5. FORMAT "%2.0" AXIS_PTS_REF ldp_fmy_dtc /end AXIS_DESCR
/end CHARACTERISTIC
/begin CHARACTERISTIC fmy_id_tco_el.envd "" CURVE 0x022f0 _REC_CUR_20_u1_u1 255. _CNV_A_R_LINEAR_____1_CM 0. 255. DISPLAY_IDENTIFIER ID_ERR_ENVD_TCO_EL FORMAT "%3.0"
 /begin AXIS_DESCR COM_AXIS online_dummy _CNV_A_R_LINEAR_____22_CM 4 0. 3. FORMAT "%2.0" AXIS_PTS_REF ldp_fmy_envd /end AXIS_DESCR
/end CHARACTERISTIC
/begin CHARACTERISTIC fmy_id_tco_grd.dtc "" CURVE 0x022f6 _REC_CUR_20_u2_u2 65535. _CNV_A_R_LINEAR_____1_CM 0. 65535. DISPLAY_IDENTIFIER ID_ERR_DTC_TCO_GRD FORMAT "%5.0"
 /begin AXIS_DESCR COM_AXIS online_dummy _CNV_A_R_LINEAR_____22_CM 6 0. 5. FORMAT "%2.0" AXIS_PTS_REF ldp_fmy_dtc /end AXIS_DESCR
/end CHARACTERISTIC
/begin CHARACTERISTIC fmy_id_tco_grd.envd "" CURVE 0x02302 _REC_CUR_20_u1_u1 255. _CNV_A_R_LINEAR_____1_CM 0. 255. DISPLAY_IDENTIFIER ID_ERR_ENVD_TCO_GRD FORMAT "%3.0"
 /begin AXIS_DESCR COM_AXIS online_dummy _CNV_A_R_LINEAR_____22_CM 4 0. 3. FORMAT "%2.0" AXIS_PTS_REF ldp_fmy_envd /end AXIS_DESCR
/end CHARACTERISTIC
/begin CHARACTERISTIC fmy_id_tco_stuck.dtc "" CURVE 0x02308 _REC_CUR_20_u2_u2 65535. _CNV_A_R_LINEAR_____1_CM 0. 65535. DISPLAY_IDENTIFIER ID_ERR_DTC_TCO_STUCK FORMAT "%5.0"
 /begin AXIS_DESCR COM_AXIS online_dummy _CNV_A_R_LINEAR_____22_CM 6 0. 5. FORMAT "%2.0" AXIS_PTS_REF ldp_fmy_dtc /end AXIS_DESCR
/end CHARACTERISTIC
/begin CHARACTERISTIC fmy_id_tco_stuck.envd "" CURVE 0x02314 _REC_CUR_20_u1_u1 255. _CNV_A_R_LINEAR_____1_CM 0. 255. DISPLAY_IDENTIFIER ID_ERR_ENVD_TCO_STUCK FORMAT "%3.0"
 /begin AXIS_DESCR COM_AXIS online_dummy _CNV_A_R_LINEAR_____22_CM 4 0. 3. FORMAT "%2.0" AXIS_PTS_REF ldp_fmy_envd /end AXIS_DESCR
/end CHARACTERISTIC
/begin CHARACTERISTIC fmy_id_ect_el.dtc "" CURVE 0x0231a _REC_CUR_20_u2_u2 65535. _CNV_A_R_LINEAR_____1_CM 0. 65535. DISPLAY_IDENTIFIER ID_ERR_DTC_ECT_EL FORMAT "%5.0"
 /begin AXIS_DESCR COM_AXIS online_dummy _CNV_A_R_LINEAR_____22_CM 6 0. 5. FORMAT "%2.0" AXIS_PTS_REF ldp_fmy_dtc /end AXIS_DESCR
/end CHARACTERISTIC
/begin CHARACTERISTIC fmy_id_ect_el.envd "" CURVE 0x02326 _REC_CUR_20_u1_u1 255. _CNV_A_R_LINEAR_____1_CM 0. 255. DISPLAY_IDENTIFIER ID_ERR_ENVD_ECT_EL FORMAT "%3.0"
 /begin AXIS_DESCR COM_AXIS online_dummy _CNV_A_R_LINEAR_____22_CM 4 0. 3. FORMAT "%2.0" AXIS_PTS_REF ldp_fmy_envd /end AXIS_DESCR
/end CHARACTERISTIC
/begin CHARACTERISTIC fmy_id_ect_mec.dtc "" CURVE 0x0232c _REC_CUR_20_u2_u2 65535. _CNV_A_R_LINEAR_____1_CM 0. 65535. DISPLAY_IDENTIFIER ID_ERR_DTC_ECT_MEC FORMAT "%5.0"
 /begin AXIS_DESCR COM_AXIS online_dummy _CNV_A_R_LINEAR_____22_CM 6 0. 5. FORMAT "%2.0" AXIS_PTS_REF ldp_fmy_dtc /end AXIS_DESCR
/end CHARACTERISTIC
/begin CHARACTERISTIC fmy_id_ect_mec.envd "" CURVE 0x02338 _REC_CUR_20_u1_u1 255. _CNV_A_R_LINEAR_____1_CM 0. 255. DISPLAY_IDENTIFIER ID_ERR_ENVD_ECT_MEC FORMAT "%3.0"
 /begin AXIS_DESCR COM_AXIS online_dummy _CNV_A_R_LINEAR_____22_CM 4 0. 3. FORMAT "%2.0" AXIS_PTS_REF ldp_fmy_envd /end AXIS_DESCR
/end CHARACTERISTIC
/begin CHARACTERISTIC fmy_id_isc.dtc "" CURVE 0x0233e _REC_CUR_20_u2_u2 65535. _CNV_A_R_LINEAR_____1_CM 0. 65535. DISPLAY_IDENTIFIER ID_ERR_DTC_ISC FORMAT "%5.0"
 /begin AXIS_DESCR COM_AXIS online_dummy _CNV_A_R_LINEAR_____22_CM 6 0. 5. FORMAT "%2.0" AXIS_PTS_REF ldp_fmy_dtc /end AXIS_DESCR
/end CHARACTERISTIC
/begin CHARACTERISTIC fmy_id_isc.envd "" CURVE 0x0234a _REC_CUR_20_u1_u1 255. _CNV_A_R_LINEAR_____1_CM 0. 255. DISPLAY_IDENTIFIER ID_ERR_ENVD_ISC FORMAT "%3.0"
 /begin AXIS_DESCR COM_AXIS online_dummy _CNV_A_R_LINEAR_____22_CM 4 0. 3. FORMAT "%2.0" AXIS_PTS_REF ldp_fmy_envd /end AXIS_DESCR
/end CHARACTERISTIC
/begin CHARACTERISTIC fmy_id_im_bls_plaus.dtc "" CURVE 0x02350 _REC_CUR_20_u2_u2 65535. _CNV_A_R_LINEAR_____1_CM 0. 65535. DISPLAY_IDENTIFIER ID_ERR_DTC_IM_BLS_PLAUS FORMAT "%5.0"
 /begin AXIS_DESCR COM_AXIS online_dummy _CNV_A_R_LINEAR_____22_CM 6 0. 5. FORMAT "%2.0" AXIS_PTS_REF ldp_fmy_dtc /end AXIS_DESCR
/end CHARACTERISTIC
/begin CHARACTERISTIC fmy_id_im_bls_plaus.envd "" CURVE 0x0235c _REC_CUR_20_u1_u1 255. _CNV_A_R_LINEAR_____1_CM 0. 255. DISPLAY_IDENTIFIER ID_ERR_ENVD_IM_BLS_PLAUS FORMAT "%3.0"
 /begin AXIS_DESCR COM_AXIS online_dummy _CNV_A_R_LINEAR_____22_CM 4 0. 3. FORMAT "%2.0" AXIS_PTS_REF ldp_fmy_envd /end AXIS_DESCR
/end CHARACTERISTIC
/begin CHARACTERISTIC fmy_id_im_bts_plaus.dtc "" CURVE 0x02362 _REC_CUR_20_u2_u2 65535. _CNV_A_R_LINEAR_____1_CM 0. 65535. DISPLAY_IDENTIFIER ID_ERR_DTC_IM_BTS_PLAUS FORMAT "%5.0"
 /begin AXIS_DESCR COM_AXIS online_dummy _CNV_A_R_LINEAR_____22_CM 6 0. 5. FORMAT "%2.0" AXIS_PTS_REF ldp_fmy_dtc /end AXIS_DESCR
/end CHARACTERISTIC
/begin CHARACTERISTIC fmy_id_im_bts_plaus.envd "" CURVE 0x0236e _REC_CUR_20_u1_u1 255. _CNV_A_R_LINEAR_____1_CM 0. 255. DISPLAY_IDENTIFIER ID_ERR_ENVD_IM_BTS_PLAUS FORMAT "%3.0"
 /begin AXIS_DESCR COM_AXIS online_dummy _CNV_A_R_LINEAR_____22_CM 4 0. 3. FORMAT "%2.0" AXIS_PTS_REF ldp_fmy_envd /end AXIS_DESCR
/end CHARACTERISTIC
/begin CHARACTERISTIC fmy_id_msw_tog.dtc "" CURVE 0x02374 _REC_CUR_20_u2_u2 65535. _CNV_A_R_LINEAR_____1_CM 0. 65535. DISPLAY_IDENTIFIER ID_ERR_DTC_MSW_TOG FORMAT "%5.0"
 /begin AXIS_DESCR COM_AXIS online_dummy _CNV_A_R_LINEAR_____22_CM 6 0. 5. FORMAT "%2.0" AXIS_PTS_REF ldp_fmy_dtc /end AXIS_DESCR
/end CHARACTERISTIC
/begin CHARACTERISTIC fmy_id_msw_tog.envd "" CURVE 0x02380 _REC_CUR_20_u1_u1 255. _CNV_A_R_LINEAR_____1_CM 0. 255. DISPLAY_IDENTIFIER ID_ERR_ENVD_MSW_TOG FORMAT "%3.0"
 /begin AXIS_DESCR COM_AXIS online_dummy _CNV_A_R_LINEAR_____22_CM 4 0. 3. FORMAT "%2.0" AXIS_PTS_REF ldp_fmy_envd /end AXIS_DESCR
/end CHARACTERISTIC
/begin CHARACTERISTIC fmy_id_msw_2.dtc "" CURVE 0x02386 _REC_CUR_20_u2_u2 65535. _CNV_A_R_LINEAR_____1_CM 0. 65535. DISPLAY_IDENTIFIER ID_ERR_DTC_MSW_2 FORMAT "%5.0"
 /begin AXIS_DESCR COM_AXIS online_dummy _CNV_A_R_LINEAR_____22_CM 6 0. 5. FORMAT "%2.0" AXIS_PTS_REF ldp_fmy_dtc /end AXIS_DESCR
/end CHARACTERISTIC
/begin CHARACTERISTIC fmy_id_msw_2.envd "" CURVE 0x02392 _REC_CUR_20_u1_u1 255. _CNV_A_R_LINEAR_____1_CM 0. 255. DISPLAY_IDENTIFIER ID_ERR_ENVD_MSW_2 FORMAT "%3.0"
 /begin AXIS_DESCR COM_AXIS online_dummy _CNV_A_R_LINEAR_____22_CM 4 0. 3. FORMAT "%2.0" AXIS_PTS_REF ldp_fmy_envd /end AXIS_DESCR
/end CHARACTERISTIC
/begin CHARACTERISTIC fmy_id_msw_3.dtc "" CURVE 0x02398 _REC_CUR_20_u2_u2 65535. _CNV_A_R_LINEAR_____1_CM 0. 65535. DISPLAY_IDENTIFIER ID_ERR_DTC_MSW_3 FORMAT "%5.0"
 /begin AXIS_DESCR COM_AXIS online_dummy _CNV_A_R_LINEAR_____22_CM 6 0. 5. FORMAT "%2.0" AXIS_PTS_REF ldp_fmy_dtc /end AXIS_DESCR
/end CHARACTERISTIC
/begin CHARACTERISTIC fmy_id_msw_3.envd "" CURVE 0x023a4 _REC_CUR_20_u1_u1 255. _CNV_A_R_LINEAR_____1_CM 0. 255. DISPLAY_IDENTIFIER ID_ERR_ENVD_MSW_3 FORMAT "%3.0"
 /begin AXIS_DESCR COM_AXIS online_dummy _CNV_A_R_LINEAR_____22_CM 4 0. 3. FORMAT "%2.0" AXIS_PTS_REF ldp_fmy_envd /end AXIS_DESCR
/end CHARACTERISTIC
/begin CHARACTERISTIC fmy_id_isa_1.dtc "" CURVE 0x023aa _REC_CUR_20_u2_u2 65535. _CNV_A_R_LINEAR_____1_CM 0. 65535. DISPLAY_IDENTIFIER ID_ERR_DTC_ISA_1 FORMAT "%5.0"
 /begin AXIS_DESCR COM_AXIS online_dummy _CNV_A_R_LINEAR_____22_CM 6 0. 5. FORMAT "%2.0" AXIS_PTS_REF ldp_fmy_dtc /end AXIS_DESCR
/end CHARACTERISTIC
/begin CHARACTERISTIC fmy_id_isa_1.envd "" CURVE 0x023b6 _REC_CUR_20_u1_u1 255. _CNV_A_R_LINEAR_____1_CM 0. 255. DISPLAY_IDENTIFIER ID_ERR_ENVD_ISA_1 FORMAT "%3.0"
 /begin AXIS_DESCR COM_AXIS online_dummy _CNV_A_R_LINEAR_____22_CM 4 0. 3. FORMAT "%2.0" AXIS_PTS_REF ldp_fmy_envd /end AXIS_DESCR
/end CHARACTERISTIC
/begin CHARACTERISTIC fmy_id_isa_2.dtc "" CURVE 0x023bc _REC_CUR_20_u2_u2 65535. _CNV_A_R_LINEAR_____1_CM 0. 65535. DISPLAY_IDENTIFIER ID_ERR_DTC_ISA_2 FORMAT "%5.0"
 /begin AXIS_DESCR COM_AXIS online_dummy _CNV_A_R_LINEAR_____22_CM 6 0. 5. FORMAT "%2.0" AXIS_PTS_REF ldp_fmy_dtc /end AXIS_DESCR
/end CHARACTERISTIC
/begin CHARACTERISTIC fmy_id_isa_2.envd "" CURVE 0x023c8 _REC_CUR_20_u1_u1 255. _CNV_A_R_LINEAR_____1_CM 0. 255. DISPLAY_IDENTIFIER ID_ERR_ENVD_ISA_2 FORMAT "%3.0"
 /begin AXIS_DESCR COM_AXIS online_dummy _CNV_A_R_LINEAR_____22_CM 4 0. 3. FORMAT "%2.0" AXIS_PTS_REF ldp_fmy_envd /end AXIS_DESCR
/end CHARACTERISTIC
/begin CHARACTERISTIC fmy_id_seg_t_ad.dtc "" CURVE 0x023ce _REC_CUR_20_u2_u2 65535. _CNV_A_R_LINEAR_____1_CM 0. 65535. DISPLAY_IDENTIFIER ID_ERR_DTC_SEG_T_AD FORMAT "%5.0"
 /begin AXIS_DESCR COM_AXIS online_dummy _CNV_A_R_LINEAR_____22_CM 6 0. 5. FORMAT "%2.0" AXIS_PTS_REF ldp_fmy_dtc /end AXIS_DESCR
/end CHARACTERISTIC
/begin CHARACTERISTIC fmy_id_seg_t_ad.envd "" CURVE 0x023da _REC_CUR_20_u1_u1 255. _CNV_A_R_LINEAR_____1_CM 0. 255. DISPLAY_IDENTIFIER ID_ERR_ENVD_SEG_T_AD FORMAT "%3.0"
 /begin AXIS_DESCR COM_AXIS online_dummy _CNV_A_R_LINEAR_____22_CM 4 0. 3. FORMAT "%2.0" AXIS_PTS_REF ldp_fmy_envd /end AXIS_DESCR
/end CHARACTERISTIC
/begin CHARACTERISTIC fmy_id_seg_t.dtc "" CURVE 0x023e0 _REC_CUR_20_u2_u2 65535. _CNV_A_R_LINEAR_____1_CM 0. 65535. DISPLAY_IDENTIFIER ID_ERR_DTC_SEG_T FORMAT "%5.0"
 /begin AXIS_DESCR COM_AXIS online_dummy _CNV_A_R_LINEAR_____22_CM 6 0. 5. FORMAT "%2.0" AXIS_PTS_REF ldp_fmy_dtc /end AXIS_DESCR
/end CHARACTERISTIC
/begin CHARACTERISTIC fmy_id_seg_t.envd "" CURVE 0x023ec _REC_CUR_20_u1_u1 255. _CNV_A_R_LINEAR_____1_CM 0. 255. DISPLAY_IDENTIFIER ID_ERR_ENVD_SEG_T FORMAT "%3.0"
 /begin AXIS_DESCR COM_AXIS online_dummy _CNV_A_R_LINEAR_____22_CM 4 0. 3. FORMAT "%2.0" AXIS_PTS_REF ldp_fmy_envd /end AXIS_DESCR
/end CHARACTERISTIC
/begin CHARACTERISTIC fmy_id_mis_0.dtc "" CURVE 0x023f2 _REC_CUR_20_u2_u2 65535. _CNV_A_R_LINEAR_____1_CM 0. 65535. DISPLAY_IDENTIFIER ID_ERR_DTC_MIS_0 FORMAT "%5.0"
 /begin AXIS_DESCR COM_AXIS online_dummy _CNV_A_R_LINEAR_____22_CM 6 0. 5. FORMAT "%2.0" AXIS_PTS_REF ldp_fmy_dtc /end AXIS_DESCR
/end CHARACTERISTIC
/begin CHARACTERISTIC fmy_id_mis_0.envd "" CURVE 0x023fe _REC_CUR_20_u1_u1 255. _CNV_A_R_LINEAR_____1_CM 0. 255. DISPLAY_IDENTIFIER ID_ERR_ENVD_MIS_0 FORMAT "%3.0"
 /begin AXIS_DESCR COM_AXIS online_dummy _CNV_A_R_LINEAR_____22_CM 4 0. 3. FORMAT "%2.0" AXIS_PTS_REF ldp_fmy_envd /end AXIS_DESCR
/end CHARACTERISTIC
/begin CHARACTERISTIC fmy_id_mis_1.dtc "" CURVE 0x02404 _REC_CUR_20_u2_u2 65535. _CNV_A_R_LINEAR_____1_CM 0. 65535. DISPLAY_IDENTIFIER ID_ERR_DTC_MIS_1 FORMAT "%5.0"
 /begin AXIS_DESCR COM_AXIS online_dummy _CNV_A_R_LINEAR_____22_CM 6 0. 5. FORMAT "%2.0" AXIS_PTS_REF ldp_fmy_dtc /end AXIS_DESCR
/end CHARACTERISTIC
/begin CHARACTERISTIC fmy_id_mis_1.envd "" CURVE 0x02410 _REC_CUR_20_u1_u1 255. _CNV_A_R_LINEAR_____1_CM 0. 255. DISPLAY_IDENTIFIER ID_ERR_ENVD_MIS_1 FORMAT "%3.0"
 /begin AXIS_DESCR COM_AXIS online_dummy _CNV_A_R_LINEAR_____22_CM 4 0. 3. FORMAT "%2.0" AXIS_PTS_REF ldp_fmy_envd /end AXIS_DESCR
/end CHARACTERISTIC
/begin CHARACTERISTIC fmy_id_mis_2.dtc "" CURVE 0x02416 _REC_CUR_20_u2_u2 65535. _CNV_A_R_LINEAR_____1_CM 0. 65535. DISPLAY_IDENTIFIER ID_ERR_DTC_MIS_2 FORMAT "%5.0"
 /begin AXIS_DESCR COM_AXIS online_dummy _CNV_A_R_LINEAR_____22_CM 6 0. 5. FORMAT "%2.0" AXIS_PTS_REF ldp_fmy_dtc /end AXIS_DESCR
/end CHARACTERISTIC
/begin CHARACTERISTIC fmy_id_mis_2.envd "" CURVE 0x02422 _REC_CUR_20_u1_u1 255. _CNV_A_R_LINEAR_____1_CM 0. 255. DISPLAY_IDENTIFIER ID_ERR_ENVD_MIS_2 FORMAT "%3.0"
 /begin AXIS_DESCR COM_AXIS online_dummy _CNV_A_R_LINEAR_____22_CM 4 0. 3. FORMAT "%2.0" AXIS_PTS_REF ldp_fmy_envd /end AXIS_DESCR
/end CHARACTERISTIC
/begin CHARACTERISTIC fmy_id_mis_3.dtc "" CURVE 0x02428 _REC_CUR_20_u2_u2 65535. _CNV_A_R_LINEAR_____1_CM 0. 65535. DISPLAY_IDENTIFIER ID_ERR_DTC_MIS_3 FORMAT "%5.0"
 /begin AXIS_DESCR COM_AXIS online_dummy _CNV_A_R_LINEAR_____22_CM 6 0. 5. FORMAT "%2.0" AXIS_PTS_REF ldp_fmy_dtc /end AXIS_DESCR
/end CHARACTERISTIC
/begin CHARACTERISTIC fmy_id_mis_3.envd "" CURVE 0x02434 _REC_CUR_20_u1_u1 255. _CNV_A_R_LINEAR_____1_CM 0. 255. DISPLAY_IDENTIFIER ID_ERR_ENVD_MIS_3 FORMAT "%3.0"
 /begin AXIS_DESCR COM_AXIS online_dummy _CNV_A_R_LINEAR_____22_CM 4 0. 3. FORMAT "%2.0" AXIS_PTS_REF ldp_fmy_envd /end AXIS_DESCR
/end CHARACTERISTIC
/begin CHARACTERISTIC fmy_id_mis_4.dtc "" CURVE 0x0243a _REC_CUR_20_u2_u2 65535. _CNV_A_R_LINEAR_____1_CM 0. 65535. DISPLAY_IDENTIFIER ID_ERR_DTC_MIS_4 FORMAT "%5.0"
 /begin AXIS_DESCR COM_AXIS online_dummy _CNV_A_R_LINEAR_____22_CM 6 0. 5. FORMAT "%2.0" AXIS_PTS_REF ldp_fmy_dtc /end AXIS_DESCR
/end CHARACTERISTIC
/begin CHARACTERISTIC fmy_id_mis_4.envd "" CURVE 0x02446 _REC_CUR_20_u1_u1 255. _CNV_A_R_LINEAR_____1_CM 0. 255. DISPLAY_IDENTIFIER ID_ERR_ENVD_MIS_4 FORMAT "%3.0"
 /begin AXIS_DESCR COM_AXIS online_dummy _CNV_A_R_LINEAR_____22_CM 4 0. 3. FORMAT "%2.0" AXIS_PTS_REF ldp_fmy_envd /end AXIS_DESCR
/end CHARACTERISTIC
/begin CHARACTERISTIC fmy_id_mis_5.dtc "" CURVE 0x0244c _REC_CUR_20_u2_u2 65535. _CNV_A_R_LINEAR_____1_CM 0. 65535. DISPLAY_IDENTIFIER ID_ERR_DTC_MIS_5 FORMAT "%5.0"
 /begin AXIS_DESCR COM_AXIS online_dummy _CNV_A_R_LINEAR_____22_CM 6 0. 5. FORMAT "%2.0" AXIS_PTS_REF ldp_fmy_dtc /end AXIS_DESCR
/end CHARACTERISTIC
/begin CHARACTERISTIC fmy_id_mis_5.envd "" CURVE 0x02458 _REC_CUR_20_u1_u1 255. _CNV_A_R_LINEAR_____1_CM 0. 255. DISPLAY_IDENTIFIER ID_ERR_ENVD_MIS_5 FORMAT "%3.0"
 /begin AXIS_DESCR COM_AXIS online_dummy _CNV_A_R_LINEAR_____22_CM 4 0. 3. FORMAT "%2.0" AXIS_PTS_REF ldp_fmy_envd /end AXIS_DESCR
/end CHARACTERISTIC
/begin CHARACTERISTIC fmy_id_mis_low_fuel.dtc "" CURVE 0x0245e _REC_CUR_20_u2_u2 65535. _CNV_A_R_LINEAR_____1_CM 0. 65535. DISPLAY_IDENTIFIER ID_ERR_DTC_MIS_LOW_FUEL FORMAT "%5.0"
 /begin AXIS_DESCR COM_AXIS online_dummy _CNV_A_R_LINEAR_____22_CM 6 0. 5. FORMAT "%2.0" AXIS_PTS_REF ldp_fmy_dtc /end AXIS_DESCR
/end CHARACTERISTIC
/begin CHARACTERISTIC fmy_id_mis_low_fuel.envd "" CURVE 0x0246a _REC_CUR_20_u1_u1 255. _CNV_A_R_LINEAR_____1_CM 0. 255. DISPLAY_IDENTIFIER ID_ERR_ENVD_MIS_LOW_FUEL FORMAT "%3.0"
 /begin AXIS_DESCR COM_AXIS online_dummy _CNV_A_R_LINEAR_____22_CM 4 0. 3. FORMAT "%2.0" AXIS_PTS_REF ldp_fmy_envd /end AXIS_DESCR
/end CHARACTERISTIC
/begin CHARACTERISTIC fmy_id_mis_mpl.dtc "" CURVE 0x02470 _REC_CUR_20_u2_u2 65535. _CNV_A_R_LINEAR_____1_CM 0. 65535. DISPLAY_IDENTIFIER ID_ERR_DTC_MIS_MPL FORMAT "%5.0"
 /begin AXIS_DESCR COM_AXIS online_dummy _CNV_A_R_LINEAR_____22_CM 6 0. 5. FORMAT "%2.0" AXIS_PTS_REF ldp_fmy_dtc /end AXIS_DESCR
/end CHARACTERISTIC
/begin CHARACTERISTIC fmy_id_mis_mpl.envd "" CURVE 0x0247c _REC_CUR_20_u1_u1 255. _CNV_A_R_LINEAR_____1_CM 0. 255. DISPLAY_IDENTIFIER ID_ERR_ENVD_MIS_MPL FORMAT "%3.0"
 /begin AXIS_DESCR COM_AXIS online_dummy _CNV_A_R_LINEAR_____22_CM 4 0. 3. FORMAT "%2.0" AXIS_PTS_REF ldp_fmy_envd /end AXIS_DESCR
/end CHARACTERISTIC
/begin CHARACTERISTIC fmy_id_conv_mon_1.dtc "" CURVE 0x02482 _REC_CUR_20_u2_u2 65535. _CNV_A_R_LINEAR_____1_CM 0. 65535. DISPLAY_IDENTIFIER ID_ERR_DTC_CONV_MON_1 FORMAT "%5.0"
 /begin AXIS_DESCR COM_AXIS online_dummy _CNV_A_R_LINEAR_____22_CM 6 0. 5. FORMAT "%2.0" AXIS_PTS_REF ldp_fmy_dtc /end AXIS_DESCR
/end CHARACTERISTIC
/begin CHARACTERISTIC fmy_id_conv_mon_1.envd "" CURVE 0x0248e _REC_CUR_20_u1_u1 255. _CNV_A_R_LINEAR_____1_CM 0. 255. DISPLAY_IDENTIFIER ID_ERR_ENVD_CONV_MON_1 FORMAT "%3.0"
 /begin AXIS_DESCR COM_AXIS online_dummy _CNV_A_R_LINEAR_____22_CM 4 0. 3. FORMAT "%2.0" AXIS_PTS_REF ldp_fmy_envd /end AXIS_DESCR
/end CHARACTERISTIC
/begin CHARACTERISTIC fmy_id_n_32_mon_1.dtc "" CURVE 0x02494 _REC_CUR_20_u2_u2 65535. _CNV_A_R_LINEAR_____1_CM 0. 65535. DISPLAY_IDENTIFIER ID_ERR_DTC_N_32_MON_1 FORMAT "%5.0"
 /begin AXIS_DESCR COM_AXIS online_dummy _CNV_A_R_LINEAR_____22_CM 6 0. 5. FORMAT "%2.0" AXIS_PTS_REF ldp_fmy_dtc /end AXIS_DESCR
/end CHARACTERISTIC
/begin CHARACTERISTIC fmy_id_n_32_mon_1.envd "" CURVE 0x024a0 _REC_CUR_20_u1_u1 255. _CNV_A_R_LINEAR_____1_CM 0. 255. DISPLAY_IDENTIFIER ID_ERR_ENVD_N_32_MON_1 FORMAT "%3.0"
 /begin AXIS_DESCR COM_AXIS online_dummy _CNV_A_R_LINEAR_____22_CM 4 0. 3. FORMAT "%2.0" AXIS_PTS_REF ldp_fmy_envd /end AXIS_DESCR
/end CHARACTERISTIC
/begin CHARACTERISTIC fmy_id_pvs_mon_1.dtc "" CURVE 0x024a6 _REC_CUR_20_u2_u2 65535. _CNV_A_R_LINEAR_____1_CM 0. 65535. DISPLAY_IDENTIFIER ID_ERR_DTC_PVS_MON_1 FORMAT "%5.0"
 /begin AXIS_DESCR COM_AXIS online_dummy _CNV_A_R_LINEAR_____22_CM 6 0. 5. FORMAT "%2.0" AXIS_PTS_REF ldp_fmy_dtc /end AXIS_DESCR
/end CHARACTERISTIC
/begin CHARACTERISTIC fmy_id_pvs_mon_1.envd "" CURVE 0x024b2 _REC_CUR_20_u1_u1 255. _CNV_A_R_LINEAR_____1_CM 0. 255. DISPLAY_IDENTIFIER ID_ERR_ENVD_PVS_MON_1 FORMAT "%3.0"
 /begin AXIS_DESCR COM_AXIS online_dummy _CNV_A_R_LINEAR_____22_CM 4 0. 3. FORMAT "%2.0" AXIS_PTS_REF ldp_fmy_envd /end AXIS_DESCR
/end CHARACTERISTIC
/begin CHARACTERISTIC fmy_id_maf_tps_mon_1.dtc "" CURVE 0x024b8 _REC_CUR_20_u2_u2 65535. _CNV_A_R_LINEAR_____1_CM 0. 65535. DISPLAY_IDENTIFIER ID_ERR_DTC_MAF_TPS_MON_1 FORMAT "%5.0"
 /begin AXIS_DESCR COM_AXIS online_dummy _CNV_A_R_LINEAR_____22_CM 6 0. 5. FORMAT "%2.0" AXIS_PTS_REF ldp_fmy_dtc /end AXIS_DESCR
/end CHARACTERISTIC
/begin CHARACTERISTIC fmy_id_maf_tps_mon_1.envd "" CURVE 0x024c4 _REC_CUR_20_u1_u1 255. _CNV_A_R_LINEAR_____1_CM 0. 255. DISPLAY_IDENTIFIER ID_ERR_ENVD_MAF_TPS_MON_1 FORMAT "%3.0"
 /begin AXIS_DESCR COM_AXIS online_dummy _CNV_A_R_LINEAR_____22_CM 4 0. 3. FORMAT "%2.0" AXIS_PTS_REF ldp_fmy_envd /end AXIS_DESCR
/end CHARACTERISTIC
/begin CHARACTERISTIC fmy_id_tq_dif_isc_mon_1.dtc "" CURVE 0x024ca _REC_CUR_20_u2_u2 65535. _CNV_A_R_LINEAR_____1_CM 0. 65535. DISPLAY_IDENTIFIER ID_ERR_DTC_TQ_DIF_ISC_MON_1 FORMAT "%5.0"
 /begin AXIS_DESCR COM_AXIS online_dummy _CNV_A_R_LINEAR_____22_CM 6 0. 5. FORMAT "%2.0" AXIS_PTS_REF ldp_fmy_dtc /end AXIS_DESCR
/end CHARACTERISTIC
/begin CHARACTERISTIC fmy_id_tq_dif_isc_mon_1.envd "" CURVE 0x024d6 _REC_CUR_20_u1_u1 255. _CNV_A_R_LINEAR_____1_CM 0. 255. DISPLAY_IDENTIFIER ID_ERR_ENVD_TQ_DIF_ISC_MON_1 FORMAT "%3.0"
 /begin AXIS_DESCR COM_AXIS online_dummy _CNV_A_R_LINEAR_____22_CM 4 0. 3. FORMAT "%2.0" AXIS_PTS_REF ldp_fmy_envd /end AXIS_DESCR
/end CHARACTERISTIC
/begin CHARACTERISTIC fmy_id_tq_req_mon_1.dtc "" CURVE 0x024dc _REC_CUR_20_u2_u2 65535. _CNV_A_R_LINEAR_____1_CM 0. 65535. DISPLAY_IDENTIFIER ID_ERR_DTC_TQ_REQ_MON_1 FORMAT "%5.0"
 /begin AXIS_DESCR COM_AXIS online_dummy _CNV_A_R_LINEAR_____22_CM 6 0. 5. FORMAT "%2.0" AXIS_PTS_REF ldp_fmy_dtc /end AXIS_DESCR
/end CHARACTERISTIC
/begin CHARACTERISTIC fmy_id_tq_req_mon_1.envd "" CURVE 0x024e8 _REC_CUR_20_u1_u1 255. _CNV_A_R_LINEAR_____1_CM 0. 255. DISPLAY_IDENTIFIER ID_ERR_ENVD_TQ_REQ_MON_1 FORMAT "%3.0"
 /begin AXIS_DESCR COM_AXIS online_dummy _CNV_A_R_LINEAR_____22_CM 4 0. 3. FORMAT "%2.0" AXIS_PTS_REF ldp_fmy_envd /end AXIS_DESCR
/end CHARACTERISTIC
/begin CHARACTERISTIC fmy_id_tq_ext_mon_1.dtc "" CURVE 0x024ee _REC_CUR_20_u2_u2 65535. _CNV_A_R_LINEAR_____1_CM 0. 65535. DISPLAY_IDENTIFIER ID_ERR_DTC_TQ_EXT_MON_1 FORMAT "%5.0"
 /begin AXIS_DESCR COM_AXIS online_dummy _CNV_A_R_LINEAR_____22_CM 6 0. 5. FORMAT "%2.0" AXIS_PTS_REF ldp_fmy_dtc /end AXIS_DESCR
/end CHARACTERISTIC
/begin CHARACTERISTIC fmy_id_tq_ext_mon_1.envd "" CURVE 0x024fa _REC_CUR_20_u1_u1 255. _CNV_A_R_LINEAR_____1_CM 0. 255. DISPLAY_IDENTIFIER ID_ERR_ENVD_TQ_EXT_MON_1 FORMAT "%3.0"
 /begin AXIS_DESCR COM_AXIS online_dummy _CNV_A_R_LINEAR_____22_CM 4 0. 3. FORMAT "%2.0" AXIS_PTS_REF ldp_fmy_envd /end AXIS_DESCR
/end CHARACTERISTIC
/begin CHARACTERISTIC fmy_id_tqi_av_mon_1.dtc "" CURVE 0x02500 _REC_CUR_20_u2_u2 65535. _CNV_A_R_LINEAR_____1_CM 0. 65535. DISPLAY_IDENTIFIER ID_ERR_DTC_TQI_AV_MON_1 FORMAT "%5.0"
 /begin AXIS_DESCR COM_AXIS online_dummy _CNV_A_R_LINEAR_____22_CM 6 0. 5. FORMAT "%2.0" AXIS_PTS_REF ldp_fmy_dtc /end AXIS_DESCR
/end CHARACTERISTIC
/begin CHARACTERISTIC fmy_id_tqi_av_mon_1.envd "" CURVE 0x0250c _REC_CUR_20_u1_u1 255. _CNV_A_R_LINEAR_____1_CM 0. 255. DISPLAY_IDENTIFIER ID_ERR_ENVD_TQI_AV_MON_1 FORMAT "%3.0"
 /begin AXIS_DESCR COM_AXIS online_dummy _CNV_A_R_LINEAR_____22_CM 4 0. 3. FORMAT "%2.0" AXIS_PTS_REF ldp_fmy_envd /end AXIS_DESCR
/end CHARACTERISTIC
/begin CHARACTERISTIC fmy_id_tqi_n_max_mon_1.dtc "" CURVE 0x02512 _REC_CUR_20_u2_u2 65535. _CNV_A_R_LINEAR_____1_CM 0. 65535. DISPLAY_IDENTIFIER ID_ERR_DTC_TQI_N_MAX_MON_1 FORMAT "%5.0"
 /begin AXIS_DESCR COM_AXIS online_dummy _CNV_A_R_LINEAR_____22_CM 6 0. 5. FORMAT "%2.0" AXIS_PTS_REF ldp_fmy_dtc /end AXIS_DESCR
/end CHARACTERISTIC
/begin CHARACTERISTIC fmy_id_tqi_n_max_mon_1.envd "" CURVE 0x0251e _REC_CUR_20_u1_u1 255. _CNV_A_R_LINEAR_____1_CM 0. 255. DISPLAY_IDENTIFIER ID_ERR_ENVD_TQI_N_MAX_MON_1 FORMAT "%3.0"
 /begin AXIS_DESCR COM_AXIS online_dummy _CNV_A_R_LINEAR_____22_CM 4 0. 3. FORMAT "%2.0" AXIS_PTS_REF ldp_fmy_envd /end AXIS_DESCR
/end CHARACTERISTIC
/begin CHARACTERISTIC fmy_id_cru_inh_mon_1.dtc "" CURVE 0x02524 _REC_CUR_20_u2_u2 65535. _CNV_A_R_LINEAR_____1_CM 0. 65535. DISPLAY_IDENTIFIER ID_ERR_DTC_CRU_INH_MON_1 FORMAT "%5.0"
 /begin AXIS_DESCR COM_AXIS online_dummy _CNV_A_R_LINEAR_____22_CM 6 0. 5. FORMAT "%2.0" AXIS_PTS_REF ldp_fmy_dtc /end AXIS_DESCR
/end CHARACTERISTIC
/begin CHARACTERISTIC fmy_id_cru_inh_mon_1.envd "" CURVE 0x02530 _REC_CUR_20_u1_u1 255. _CNV_A_R_LINEAR_____1_CM 0. 255. DISPLAY_IDENTIFIER ID_ERR_ENVD_CRU_INH_MON_1 FORMAT "%3.0"
 /begin AXIS_DESCR COM_AXIS online_dummy _CNV_A_R_LINEAR_____22_CM 4 0. 3. FORMAT "%2.0" AXIS_PTS_REF ldp_fmy_envd /end AXIS_DESCR
/end CHARACTERISTIC
/begin CHARACTERISTIC fmy_id_tqi_n_max_nvmy_mon.dtc "" CURVE 0x02536 _REC_CUR_20_u2_u2 65535. _CNV_A_R_LINEAR_____1_CM 0. 65535. DISPLAY_IDENTIFIER ID_ERR_DTC_TQI_N_MAX_NVMY_MON FORMAT "%5.0"
 /begin AXIS_DESCR COM_AXIS online_dummy _CNV_A_R_LINEAR_____22_CM 6 0. 5. FORMAT "%2.0" AXIS_PTS_REF ldp_fmy_dtc /end AXIS_DESCR
/end CHARACTERISTIC
/begin CHARACTERISTIC fmy_id_tqi_n_max_nvmy_mon.envd "" CURVE 0x02542 _REC_CUR_20_u1_u1 255. _CNV_A_R_LINEAR_____1_CM 0. 255. DISPLAY_IDENTIFIER ID_ERR_ENVD_TQI_N_MAX_NVMY_MON FORMAT "%3.0"
 /begin AXIS_DESCR COM_AXIS online_dummy _CNV_A_R_LINEAR_____22_CM 4 0. 3. FORMAT "%2.0" AXIS_PTS_REF ldp_fmy_envd /end AXIS_DESCR
/end CHARACTERISTIC
/begin CHARACTERISTIC fmy_id_sa_safm.dtc "" CURVE 0x02548 _REC_CUR_20_u2_u2 65535. _CNV_A_R_LINEAR_____1_CM 0. 65535. DISPLAY_IDENTIFIER ID_ERR_DTC_SA_SAFM FORMAT "%5.0"
 /begin AXIS_DESCR COM_AXIS online_dummy _CNV_A_R_LINEAR_____22_CM 6 0. 5. FORMAT "%2.0" AXIS_PTS_REF ldp_fmy_dtc /end AXIS_DESCR
/end CHARACTERISTIC
/begin CHARACTERISTIC fmy_id_sa_safm.envd "" CURVE 0x02554 _REC_CUR_20_u1_u1 255. _CNV_A_R_LINEAR_____1_CM 0. 255. DISPLAY_IDENTIFIER ID_ERR_ENVD_SA_SAFM FORMAT "%3.0"
 /begin AXIS_DESCR COM_AXIS online_dummy _CNV_A_R_LINEAR_____22_CM 4 0. 3. FORMAT "%2.0" AXIS_PTS_REF ldp_fmy_envd /end AXIS_DESCR
/end CHARACTERISTIC
/begin CHARACTERISTIC fmy_id_sa_sap.dtc "" CURVE 0x0255a _REC_CUR_20_u2_u2 65535. _CNV_A_R_LINEAR_____1_CM 0. 65535. DISPLAY_IDENTIFIER ID_ERR_DTC_SA_SAP FORMAT "%5.0"
 /begin AXIS_DESCR COM_AXIS online_dummy _CNV_A_R_LINEAR_____22_CM 6 0. 5. FORMAT "%2.0" AXIS_PTS_REF ldp_fmy_dtc /end AXIS_DESCR
/end CHARACTERISTIC
/begin CHARACTERISTIC fmy_id_sa_sap.envd "" CURVE 0x02566 _REC_CUR_20_u1_u1 255. _CNV_A_R_LINEAR_____1_CM 0. 255. DISPLAY_IDENTIFIER ID_ERR_ENVD_SA_SAP FORMAT "%3.0"
 /begin AXIS_DESCR COM_AXIS online_dummy _CNV_A_R_LINEAR_____22_CM 4 0. 3. FORMAT "%2.0" AXIS_PTS_REF ldp_fmy_envd /end AXIS_DESCR
/end CHARACTERISTIC
/begin CHARACTERISTIC fmy_id_sa_sys.dtc "" CURVE 0x0256c _REC_CUR_20_u2_u2 65535. _CNV_A_R_LINEAR_____1_CM 0. 65535. DISPLAY_IDENTIFIER ID_ERR_DTC_SA_SYS FORMAT "%5.0"
 /begin AXIS_DESCR COM_AXIS online_dummy _CNV_A_R_LINEAR_____22_CM 6 0. 5. FORMAT "%2.0" AXIS_PTS_REF ldp_fmy_dtc /end AXIS_DESCR
/end CHARACTERISTIC
/begin CHARACTERISTIC fmy_id_sa_sys.envd "" CURVE 0x02578 _REC_CUR_20_u1_u1 255. _CNV_A_R_LINEAR_____1_CM 0. 255. DISPLAY_IDENTIFIER ID_ERR_ENVD_SA_SYS FORMAT "%3.0"
 /begin AXIS_DESCR COM_AXIS online_dummy _CNV_A_R_LINEAR_____22_CM 4 0. 3. FORMAT "%2.0" AXIS_PTS_REF ldp_fmy_envd /end AXIS_DESCR
/end CHARACTERISTIC
/begin CHARACTERISTIC fmy_id_sa_sav.dtc "" CURVE 0x0257e _REC_CUR_20_u2_u2 65535. _CNV_A_R_LINEAR_____1_CM 0. 65535. DISPLAY_IDENTIFIER ID_ERR_DTC_SA_SAV FORMAT "%5.0"
 /begin AXIS_DESCR COM_AXIS online_dummy _CNV_A_R_LINEAR_____22_CM 6 0. 5. FORMAT "%2.0" AXIS_PTS_REF ldp_fmy_dtc /end AXIS_DESCR
/end CHARACTERISTIC
/begin CHARACTERISTIC fmy_id_sa_sav.envd "" CURVE 0x0258a _REC_CUR_20_u1_u1 255. _CNV_A_R_LINEAR_____1_CM 0. 255. DISPLAY_IDENTIFIER ID_ERR_ENVD_SA_SAV FORMAT "%3.0"
 /begin AXIS_DESCR COM_AXIS online_dummy _CNV_A_R_LINEAR_____22_CM 4 0. 3. FORMAT "%2.0" AXIS_PTS_REF ldp_fmy_envd /end AXIS_DESCR
/end CHARACTERISTIC
/begin CHARACTERISTIC fmy_id_imob_1.dtc "" CURVE 0x02590 _REC_CUR_20_u2_u2 65535. _CNV_A_R_LINEAR_____1_CM 0. 65535. DISPLAY_IDENTIFIER ID_ERR_DTC_IMOB_1 FORMAT "%5.0"
 /begin AXIS_DESCR COM_AXIS online_dummy _CNV_A_R_LINEAR_____22_CM 6 0. 5. FORMAT "%2.0" AXIS_PTS_REF ldp_fmy_dtc /end AXIS_DESCR
/end CHARACTERISTIC
/begin CHARACTERISTIC fmy_id_imob_1.envd "" CURVE 0x0259c _REC_CUR_20_u1_u1 255. _CNV_A_R_LINEAR_____1_CM 0. 255. DISPLAY_IDENTIFIER ID_ERR_ENVD_IMOB_1 FORMAT "%3.0"
 /begin AXIS_DESCR COM_AXIS online_dummy _CNV_A_R_LINEAR_____22_CM 4 0. 3. FORMAT "%2.0" AXIS_PTS_REF ldp_fmy_envd /end AXIS_DESCR
/end CHARACTERISTIC
/begin CHARACTERISTIC fmy_id_imob_2.dtc "" CURVE 0x025a2 _REC_CUR_20_u2_u2 65535. _CNV_A_R_LINEAR_____1_CM 0. 65535. DISPLAY_IDENTIFIER ID_ERR_DTC_IMOB_2 FORMAT "%5.0"
 /begin AXIS_DESCR COM_AXIS online_dummy _CNV_A_R_LINEAR_____22_CM 6 0. 5. FORMAT "%2.0" AXIS_PTS_REF ldp_fmy_dtc /end AXIS_DESCR
/end CHARACTERISTIC
/begin CHARACTERISTIC fmy_id_imob_2.envd "" CURVE 0x025ae _REC_CUR_20_u1_u1 255. _CNV_A_R_LINEAR_____1_CM 0. 255. DISPLAY_IDENTIFIER ID_ERR_ENVD_IMOB_2 FORMAT "%3.0"
 /begin AXIS_DESCR COM_AXIS online_dummy _CNV_A_R_LINEAR_____22_CM 4 0. 3. FORMAT "%2.0" AXIS_PTS_REF ldp_fmy_envd /end AXIS_DESCR
/end CHARACTERISTIC
/begin CHARACTERISTIC fmy_id_imob_3.dtc "" CURVE 0x025b4 _REC_CUR_20_u2_u2 65535. _CNV_A_R_LINEAR_____1_CM 0. 65535. DISPLAY_IDENTIFIER ID_ERR_DTC_IMOB_3 FORMAT "%5.0"
 /begin AXIS_DESCR COM_AXIS online_dummy _CNV_A_R_LINEAR_____22_CM 6 0. 5. FORMAT "%2.0" AXIS_PTS_REF ldp_fmy_dtc /end AXIS_DESCR
/end CHARACTERISTIC
/begin CHARACTERISTIC fmy_id_imob_3.envd "" CURVE 0x025c0 _REC_CUR_20_u1_u1 255. _CNV_A_R_LINEAR_____1_CM 0. 255. DISPLAY_IDENTIFIER ID_ERR_ENVD_IMOB_3 FORMAT "%3.0"
 /begin AXIS_DESCR COM_AXIS online_dummy _CNV_A_R_LINEAR_____22_CM 4 0. 3. FORMAT "%2.0" AXIS_PTS_REF ldp_fmy_envd /end AXIS_DESCR
/end CHARACTERISTIC
/begin CHARACTERISTIC fmy_id_fsd_1.dtc "" CURVE 0x025c6 _REC_CUR_20_u2_u2 65535. _CNV_A_R_LINEAR_____1_CM 0. 65535. DISPLAY_IDENTIFIER ID_ERR_DTC_FSD_1 FORMAT "%5.0"
 /begin AXIS_DESCR COM_AXIS online_dummy _CNV_A_R_LINEAR_____22_CM 6 0. 5. FORMAT "%2.0" AXIS_PTS_REF ldp_fmy_dtc /end AXIS_DESCR
/end CHARACTERISTIC
/begin CHARACTERISTIC fmy_id_fsd_1.envd "" CURVE 0x025d2 _REC_CUR_20_u1_u1 255. _CNV_A_R_LINEAR_____1_CM 0. 255. DISPLAY_IDENTIFIER ID_ERR_ENVD_FSD_1 FORMAT "%3.0"
 /begin AXIS_DESCR COM_AXIS online_dummy _CNV_A_R_LINEAR_____22_CM 4 0. 3. FORMAT "%2.0" AXIS_PTS_REF ldp_fmy_envd /end AXIS_DESCR
/end CHARACTERISTIC
/begin CHARACTERISTIC fmy_id_fsd_2.dtc "" CURVE 0x025d8 _REC_CUR_20_u2_u2 65535. _CNV_A_R_LINEAR_____1_CM 0. 65535. DISPLAY_IDENTIFIER ID_ERR_DTC_FSD_2 FORMAT "%5.0"
 /begin AXIS_DESCR COM_AXIS online_dummy _CNV_A_R_LINEAR_____22_CM 6 0. 5. FORMAT "%2.0" AXIS_PTS_REF ldp_fmy_dtc /end AXIS_DESCR
/end CHARACTERISTIC
/begin CHARACTERISTIC fmy_id_fsd_2.envd "" CURVE 0x025e4 _REC_CUR_20_u1_u1 255. _CNV_A_R_LINEAR_____1_CM 0. 255. DISPLAY_IDENTIFIER ID_ERR_ENVD_FSD_2 FORMAT "%3.0"
 /begin AXIS_DESCR COM_AXIS online_dummy _CNV_A_R_LINEAR_____22_CM 4 0. 3. FORMAT "%2.0" AXIS_PTS_REF ldp_fmy_envd /end AXIS_DESCR
/end CHARACTERISTIC
/begin CHARACTERISTIC fmy_id_ls_down_swt_1.dtc "" CURVE 0x025ea _REC_CUR_20_u2_u2 65535. _CNV_A_R_LINEAR_____1_CM 0. 65535. DISPLAY_IDENTIFIER ID_ERR_DTC_LS_DOWN_SWT_1 FORMAT "%5.0"
 /begin AXIS_DESCR COM_AXIS online_dummy _CNV_A_R_LINEAR_____22_CM 6 0. 5. FORMAT "%2.0" AXIS_PTS_REF ldp_fmy_dtc /end AXIS_DESCR
/end CHARACTERISTIC
/begin CHARACTERISTIC fmy_id_ls_down_swt_1.envd "" CURVE 0x025f6 _REC_CUR_20_u1_u1 255. _CNV_A_R_LINEAR_____1_CM 0. 255. DISPLAY_IDENTIFIER ID_ERR_ENVD_LS_DOWN_SWT_1 FORMAT "%3.0"
 /begin AXIS_DESCR COM_AXIS online_dummy _CNV_A_R_LINEAR_____22_CM 4 0. 3. FORMAT "%2.0" AXIS_PTS_REF ldp_fmy_envd /end AXIS_DESCR
/end CHARACTERISTIC
/begin CHARACTERISTIC fmy_id_ls_down_swt_2.dtc "" CURVE 0x025fc _REC_CUR_20_u2_u2 65535. _CNV_A_R_LINEAR_____1_CM 0. 65535. DISPLAY_IDENTIFIER ID_ERR_DTC_LS_DOWN_SWT_2 FORMAT "%5.0"
 /begin AXIS_DESCR COM_AXIS online_dummy _CNV_A_R_LINEAR_____22_CM 6 0. 5. FORMAT "%2.0" AXIS_PTS_REF ldp_fmy_dtc /end AXIS_DESCR
/end CHARACTERISTIC
/begin CHARACTERISTIC fmy_id_ls_down_swt_2.envd "" CURVE 0x02608 _REC_CUR_20_u1_u1 255. _CNV_A_R_LINEAR_____1_CM 0. 255. DISPLAY_IDENTIFIER ID_ERR_ENVD_LS_DOWN_SWT_2 FORMAT "%3.0"
 /begin AXIS_DESCR COM_AXIS online_dummy _CNV_A_R_LINEAR_____22_CM 4 0. 3. FORMAT "%2.0" AXIS_PTS_REF ldp_fmy_envd /end AXIS_DESCR
/end CHARACTERISTIC
/begin CHARACTERISTIC fmy_id_ls_down_pue_1.dtc "" CURVE 0x0260e _REC_CUR_20_u2_u2 65535. _CNV_A_R_LINEAR_____1_CM 0. 65535. DISPLAY_IDENTIFIER ID_ERR_DTC_LS_DOWN_PUE_1 FORMAT "%5.0"
 /begin AXIS_DESCR COM_AXIS online_dummy _CNV_A_R_LINEAR_____22_CM 6 0. 5. FORMAT "%2.0" AXIS_PTS_REF ldp_fmy_dtc /end AXIS_DESCR
/end CHARACTERISTIC
/begin CHARACTERISTIC fmy_id_ls_down_pue_1.envd "" CURVE 0x0261a _REC_CUR_20_u1_u1 255. _CNV_A_R_LINEAR_____1_CM 0. 255. DISPLAY_IDENTIFIER ID_ERR_ENVD_LS_DOWN_PUE_1 FORMAT "%3.0"
 /begin AXIS_DESCR COM_AXIS online_dummy _CNV_A_R_LINEAR_____22_CM 4 0. 3. FORMAT "%2.0" AXIS_PTS_REF ldp_fmy_envd /end AXIS_DESCR
/end CHARACTERISTIC
/begin CHARACTERISTIC fmy_id_ls_down_pue_2.dtc "" CURVE 0x02620 _REC_CUR_20_u2_u2 65535. _CNV_A_R_LINEAR_____1_CM 0. 65535. DISPLAY_IDENTIFIER ID_ERR_DTC_LS_DOWN_PUE_2 FORMAT "%5.0"
 /begin AXIS_DESCR COM_AXIS online_dummy _CNV_A_R_LINEAR_____22_CM 6 0. 5. FORMAT "%2.0" AXIS_PTS_REF ldp_fmy_dtc /end AXIS_DESCR
/end CHARACTERISTIC
/begin CHARACTERISTIC fmy_id_ls_down_pue_2.envd "" CURVE 0x0262c _REC_CUR_20_u1_u1 255. _CNV_A_R_LINEAR_____1_CM 0. 255. DISPLAY_IDENTIFIER ID_ERR_ENVD_LS_DOWN_PUE_2 FORMAT "%3.0"
 /begin AXIS_DESCR COM_AXIS online_dummy _CNV_A_R_LINEAR_____22_CM 4 0. 3. FORMAT "%2.0" AXIS_PTS_REF ldp_fmy_envd /end AXIS_DESCR
/end CHARACTERISTIC
/begin CHARACTERISTIC fmy_id_ef.dtc "" CURVE 0x02632 _REC_CUR_20_u2_u2 65535. _CNV_A_R_LINEAR_____1_CM 0. 65535. DISPLAY_IDENTIFIER ID_ERR_DTC_EF FORMAT "%5.0"
 /begin AXIS_DESCR COM_AXIS online_dummy _CNV_A_R_LINEAR_____22_CM 6 0. 5. FORMAT "%2.0" AXIS_PTS_REF ldp_fmy_dtc /end AXIS_DESCR
/end CHARACTERISTIC
/begin CHARACTERISTIC fmy_id_ef.envd "" CURVE 0x0263e _REC_CUR_20_u1_u1 255. _CNV_A_R_LINEAR_____1_CM 0. 255. DISPLAY_IDENTIFIER ID_ERR_ENVD_EF FORMAT "%3.0"
 /begin AXIS_DESCR COM_AXIS online_dummy _CNV_A_R_LINEAR_____22_CM 4 0. 3. FORMAT "%2.0" AXIS_PTS_REF ldp_fmy_envd /end AXIS_DESCR
/end CHARACTERISTIC
/begin CHARACTERISTIC fmy_id_tecu.dtc "" CURVE 0x02644 _REC_CUR_20_u2_u2 65535. _CNV_A_R_LINEAR_____1_CM 0. 65535. DISPLAY_IDENTIFIER ID_ERR_DTC_TECU FORMAT "%5.0"
 /begin AXIS_DESCR COM_AXIS online_dummy _CNV_A_R_LINEAR_____22_CM 6 0. 5. FORMAT "%2.0" AXIS_PTS_REF ldp_fmy_dtc /end AXIS_DESCR
/end CHARACTERISTIC
/begin CHARACTERISTIC fmy_id_tecu.envd "" CURVE 0x02650 _REC_CUR_20_u1_u1 255. _CNV_A_R_LINEAR_____1_CM 0. 255. DISPLAY_IDENTIFIER ID_ERR_ENVD_TECU FORMAT "%3.0"
 /begin AXIS_DESCR COM_AXIS online_dummy _CNV_A_R_LINEAR_____22_CM 4 0. 3. FORMAT "%2.0" AXIS_PTS_REF ldp_fmy_envd /end AXIS_DESCR
/end CHARACTERISTIC
/begin CHARACTERISTIC fmy_id_ebox_cfa.dtc "" CURVE 0x02656 _REC_CUR_20_u2_u2 65535. _CNV_A_R_LINEAR_____1_CM 0. 65535. DISPLAY_IDENTIFIER ID_ERR_DTC_EBOX_CFA FORMAT "%5.0"
 /begin AXIS_DESCR COM_AXIS online_dummy _CNV_A_R_LINEAR_____22_CM 6 0. 5. FORMAT "%2.0" AXIS_PTS_REF ldp_fmy_dtc /end AXIS_DESCR
/end CHARACTERISTIC
/begin CHARACTERISTIC fmy_id_ebox_cfa.envd "" CURVE 0x02662 _REC_CUR_20_u1_u1 255. _CNV_A_R_LINEAR_____1_CM 0. 255. DISPLAY_IDENTIFIER ID_ERR_ENVD_EBOX_CFA FORMAT "%3.0"
 /begin AXIS_DESCR COM_AXIS online_dummy _CNV_A_R_LINEAR_____22_CM 4 0. 3. FORMAT "%2.0" AXIS_PTS_REF ldp_fmy_envd /end AXIS_DESCR
/end CHARACTERISTIC
/begin CHARACTERISTIC fmy_id_ecu_ram.dtc "" CURVE 0x02668 _REC_CUR_20_u2_u2 65535. _CNV_A_R_LINEAR_____1_CM 0. 65535. DISPLAY_IDENTIFIER ID_ERR_DTC_ECU_RAM FORMAT "%5.0"
 /begin AXIS_DESCR COM_AXIS online_dummy _CNV_A_R_LINEAR_____22_CM 6 0. 5. FORMAT "%2.0" AXIS_PTS_REF ldp_fmy_dtc /end AXIS_DESCR
/end CHARACTERISTIC
/begin CHARACTERISTIC fmy_id_ecu_ram.envd "" CURVE 0x02674 _REC_CUR_20_u1_u1 255. _CNV_A_R_LINEAR_____1_CM 0. 255. DISPLAY_IDENTIFIER ID_ERR_ENVD_ECU_RAM FORMAT "%3.0"
 /begin AXIS_DESCR COM_AXIS online_dummy _CNV_A_R_LINEAR_____22_CM 4 0. 3. FORMAT "%2.0" AXIS_PTS_REF ldp_fmy_envd /end AXIS_DESCR
/end CHARACTERISTIC
/begin CHARACTERISTIC fmy_id_tqi_lim.dtc "" CURVE 0x0267a _REC_CUR_20_u2_u2 65535. _CNV_A_R_LINEAR_____1_CM 0. 65535. DISPLAY_IDENTIFIER ID_ERR_DTC_TQI_LIM FORMAT "%5.0"
 /begin AXIS_DESCR COM_AXIS online_dummy _CNV_A_R_LINEAR_____22_CM 6 0. 5. FORMAT "%2.0" AXIS_PTS_REF ldp_fmy_dtc /end AXIS_DESCR
/end CHARACTERISTIC
/begin CHARACTERISTIC fmy_id_tqi_lim.envd "" CURVE 0x02686 _REC_CUR_20_u1_u1 255. _CNV_A_R_LINEAR_____1_CM 0. 255. DISPLAY_IDENTIFIER ID_ERR_ENVD_TQI_LIM FORMAT "%3.0"
 /begin AXIS_DESCR COM_AXIS online_dummy _CNV_A_R_LINEAR_____22_CM 4 0. 3. FORMAT "%2.0" AXIS_PTS_REF ldp_fmy_envd /end AXIS_DESCR
/end CHARACTERISTIC
/begin CHARACTERISTIC fmy_id_obd2_lsh_down_1.dtc "" CURVE 0x0268c _REC_CUR_20_u2_u2 65535. _CNV_A_R_LINEAR_____1_CM 0. 65535. DISPLAY_IDENTIFIER ID_ERR_DTC_OBD2_LSH_DOWN_1 FORMAT "%5.0"
 /begin AXIS_DESCR COM_AXIS online_dummy _CNV_A_R_LINEAR_____22_CM 6 0. 5. FORMAT "%2.0" AXIS_PTS_REF ldp_fmy_dtc /end AXIS_DESCR
/end CHARACTERISTIC
/begin CHARACTERISTIC fmy_id_obd2_lsh_down_1.envd "" CURVE 0x02698 _REC_CUR_20_u1_u1 255. _CNV_A_R_LINEAR_____1_CM 0. 255. DISPLAY_IDENTIFIER ID_ERR_ENVD_OBD2_LSH_DOWN_1 FORMAT "%3.0"
 /begin AXIS_DESCR COM_AXIS online_dummy _CNV_A_R_LINEAR_____22_CM 4 0. 3. FORMAT "%2.0" AXIS_PTS_REF ldp_fmy_envd /end AXIS_DESCR
/end CHARACTERISTIC
/begin CHARACTERISTIC fmy_id_obd2_lsh_down_2.dtc "" CURVE 0x0269e _REC_CUR_20_u2_u2 65535. _CNV_A_R_LINEAR_____1_CM 0. 65535. DISPLAY_IDENTIFIER ID_ERR_DTC_OBD2_LSH_DOWN_2 FORMAT "%5.0"
 /begin AXIS_DESCR COM_AXIS online_dummy _CNV_A_R_LINEAR_____22_CM 6 0. 5. FORMAT "%2.0" AXIS_PTS_REF ldp_fmy_dtc /end AXIS_DESCR
/end CHARACTERISTIC
/begin CHARACTERISTIC fmy_id_obd2_lsh_down_2.envd "" CURVE 0x026aa _REC_CUR_20_u1_u1 255. _CNV_A_R_LINEAR_____1_CM 0. 255. DISPLAY_IDENTIFIER ID_ERR_ENVD_OBD2_LSH_DOWN_2 FORMAT "%3.0"
 /begin AXIS_DESCR COM_AXIS online_dummy _CNV_A_R_LINEAR_____22_CM 4 0. 3. FORMAT "%2.0" AXIS_PTS_REF ldp_fmy_envd /end AXIS_DESCR
/end CHARACTERISTIC
/begin CHARACTERISTIC fmy_id_dmtls.dtc "" CURVE 0x026b0 _REC_CUR_20_u2_u2 65535. _CNV_A_R_LINEAR_____1_CM 0. 65535. DISPLAY_IDENTIFIER ID_ERR_DTC_DMTLS FORMAT "%5.0"
 /begin AXIS_DESCR COM_AXIS online_dummy _CNV_A_R_LINEAR_____22_CM 6 0. 5. FORMAT "%2.0" AXIS_PTS_REF ldp_fmy_dtc /end AXIS_DESCR
/end CHARACTERISTIC
/begin CHARACTERISTIC fmy_id_dmtls.envd "" CURVE 0x026bc _REC_CUR_20_u1_u1 255. _CNV_A_R_LINEAR_____1_CM 0. 255. DISPLAY_IDENTIFIER ID_ERR_ENVD_DMTLS FORMAT "%3.0"
 /begin AXIS_DESCR COM_AXIS online_dummy _CNV_A_R_LINEAR_____22_CM 4 0. 3. FORMAT "%2.0" AXIS_PTS_REF ldp_fmy_envd /end AXIS_DESCR
/end CHARACTERISTIC
/begin CHARACTERISTIC fmy_id_dmtl_pump.dtc "" CURVE 0x026c2 _REC_CUR_20_u2_u2 65535. _CNV_A_R_LINEAR_____1_CM 0. 65535. DISPLAY_IDENTIFIER ID_ERR_DTC_DMTL_PUMP FORMAT "%5.0"
 /begin AXIS_DESCR COM_AXIS online_dummy _CNV_A_R_LINEAR_____22_CM 6 0. 5. FORMAT "%2.0" AXIS_PTS_REF ldp_fmy_dtc /end AXIS_DESCR
/end CHARACTERISTIC
/begin CHARACTERISTIC fmy_id_dmtl_pump.envd "" CURVE 0x026ce _REC_CUR_20_u1_u1 255. _CNV_A_R_LINEAR_____1_CM 0. 255. DISPLAY_IDENTIFIER ID_ERR_ENVD_DMTL_PUMP FORMAT "%3.0"
 /begin AXIS_DESCR COM_AXIS online_dummy _CNV_A_R_LINEAR_____22_CM 4 0. 3. FORMAT "%2.0" AXIS_PTS_REF ldp_fmy_envd /end AXIS_DESCR
/end CHARACTERISTIC
/begin CHARACTERISTIC fmy_id_dmtlm.dtc "" CURVE 0x026d4 _REC_CUR_20_u2_u2 65535. _CNV_A_R_LINEAR_____1_CM 0. 65535. DISPLAY_IDENTIFIER ID_ERR_DTC_DMTLM FORMAT "%5.0"
 /begin AXIS_DESCR COM_AXIS online_dummy _CNV_A_R_LINEAR_____22_CM 6 0. 5. FORMAT "%2.0" AXIS_PTS_REF ldp_fmy_dtc /end AXIS_DESCR
/end CHARACTERISTIC
/begin CHARACTERISTIC fmy_id_dmtlm.envd "" CURVE 0x026e0 _REC_CUR_20_u1_u1 255. _CNV_A_R_LINEAR_____1_CM 0. 255. DISPLAY_IDENTIFIER ID_ERR_ENVD_DMTLM FORMAT "%3.0"
 /begin AXIS_DESCR COM_AXIS online_dummy _CNV_A_R_LINEAR_____22_CM 4 0. 3. FORMAT "%2.0" AXIS_PTS_REF ldp_fmy_envd /end AXIS_DESCR
/end CHARACTERISTIC
/begin CHARACTERISTIC fmy_id_dmtl_leak.dtc "" CURVE 0x026e6 _REC_CUR_20_u2_u2 65535. _CNV_A_R_LINEAR_____1_CM 0. 65535. DISPLAY_IDENTIFIER ID_ERR_DTC_DMTL_LEAK FORMAT "%5.0"
 /begin AXIS_DESCR COM_AXIS online_dummy _CNV_A_R_LINEAR_____22_CM 6 0. 5. FORMAT "%2.0" AXIS_PTS_REF ldp_fmy_dtc /end AXIS_DESCR
/end CHARACTERISTIC
/begin CHARACTERISTIC fmy_id_dmtl_leak.envd "" CURVE 0x026f2 _REC_CUR_20_u1_u1 255. _CNV_A_R_LINEAR_____1_CM 0. 255. DISPLAY_IDENTIFIER ID_ERR_ENVD_DMTL_LEAK FORMAT "%3.0"
 /begin AXIS_DESCR COM_AXIS online_dummy _CNV_A_R_LINEAR_____22_CM 4 0. 3. FORMAT "%2.0" AXIS_PTS_REF ldp_fmy_envd /end AXIS_DESCR
/end CHARACTERISTIC
/begin CHARACTERISTIC fmy_id_sof.dtc "" CURVE 0x026f8 _REC_CUR_20_u2_u2 65535. _CNV_A_R_LINEAR_____1_CM 0. 65535. DISPLAY_IDENTIFIER ID_ERR_DTC_SOF FORMAT "%5.0"
 /begin AXIS_DESCR COM_AXIS online_dummy _CNV_A_R_LINEAR_____22_CM 6 0. 5. FORMAT "%2.0" AXIS_PTS_REF ldp_fmy_dtc /end AXIS_DESCR
/end CHARACTERISTIC
/begin CHARACTERISTIC fmy_id_sof.envd "" CURVE 0x02704 _REC_CUR_20_u1_u1 255. _CNV_A_R_LINEAR_____1_CM 0. 255. DISPLAY_IDENTIFIER ID_ERR_ENVD_SOF FORMAT "%3.0"
 /begin AXIS_DESCR COM_AXIS online_dummy _CNV_A_R_LINEAR_____22_CM 4 0. 3. FORMAT "%2.0" AXIS_PTS_REF ldp_fmy_envd /end AXIS_DESCR
/end CHARACTERISTIC
/begin CHARACTERISTIC fmy_id_sof_req.dtc "" CURVE 0x0270a _REC_CUR_20_u2_u2 65535. _CNV_A_R_LINEAR_____1_CM 0. 65535. DISPLAY_IDENTIFIER ID_ERR_DTC_SOF_REQ FORMAT "%5.0"
 /begin AXIS_DESCR COM_AXIS online_dummy _CNV_A_R_LINEAR_____22_CM 6 0. 5. FORMAT "%2.0" AXIS_PTS_REF ldp_fmy_dtc /end AXIS_DESCR
/end CHARACTERISTIC
/begin CHARACTERISTIC fmy_id_sof_req.envd "" CURVE 0x02716 _REC_CUR_20_u1_u1 255. _CNV_A_R_LINEAR_____1_CM 0. 255. DISPLAY_IDENTIFIER ID_ERR_ENVD_SOF_REQ FORMAT "%3.0"
 /begin AXIS_DESCR COM_AXIS online_dummy _CNV_A_R_LINEAR_____22_CM 4 0. 3. FORMAT "%2.0" AXIS_PTS_REF ldp_fmy_envd /end AXIS_DESCR
/end CHARACTERISTIC
/begin CHARACTERISTIC fmy_id_rly_st.dtc "" CURVE 0x0271c _REC_CUR_20_u2_u2 65535. _CNV_A_R_LINEAR_____1_CM 0. 65535. DISPLAY_IDENTIFIER ID_ERR_DTC_RLY_ST FORMAT "%5.0"
 /begin AXIS_DESCR COM_AXIS online_dummy _CNV_A_R_LINEAR_____22_CM 6 0. 5. FORMAT "%2.0" AXIS_PTS_REF ldp_fmy_dtc /end AXIS_DESCR
/end CHARACTERISTIC
/begin CHARACTERISTIC fmy_id_rly_st.envd "" CURVE 0x02728 _REC_CUR_20_u1_u1 255. _CNV_A_R_LINEAR_____1_CM 0. 255. DISPLAY_IDENTIFIER ID_ERR_ENVD_RLY_ST FORMAT "%3.0"
 /begin AXIS_DESCR COM_AXIS online_dummy _CNV_A_R_LINEAR_____22_CM 4 0. 3. FORMAT "%2.0" AXIS_PTS_REF ldp_fmy_envd /end AXIS_DESCR
/end CHARACTERISTIC
/begin CHARACTERISTIC fmy_id_bsd.dtc "" CURVE 0x0272e _REC_CUR_20_u2_u2 65535. _CNV_A_R_LINEAR_____1_CM 0. 65535. DISPLAY_IDENTIFIER ID_ERR_DTC_BSD FORMAT "%5.0"
 /begin AXIS_DESCR COM_AXIS online_dummy _CNV_A_R_LINEAR_____22_CM 6 0. 5. FORMAT "%2.0" AXIS_PTS_REF ldp_fmy_dtc /end AXIS_DESCR
/end CHARACTERISTIC
/begin CHARACTERISTIC fmy_id_bsd.envd "" CURVE 0x0273a _REC_CUR_20_u1_u1 255. _CNV_A_R_LINEAR_____1_CM 0. 255. DISPLAY_IDENTIFIER ID_ERR_ENVD_BSD FORMAT "%3.0"
 /begin AXIS_DESCR COM_AXIS online_dummy _CNV_A_R_LINEAR_____22_CM 4 0. 3. FORMAT "%2.0" AXIS_PTS_REF ldp_fmy_envd /end AXIS_DESCR
/end CHARACTERISTIC
/begin CHARACTERISTIC fmy_id_poil_swi.dtc "" CURVE 0x02740 _REC_CUR_20_u2_u2 65535. _CNV_A_R_LINEAR_____1_CM 0. 65535. DISPLAY_IDENTIFIER ID_ERR_DTC_POIL_SWI FORMAT "%5.0"
 /begin AXIS_DESCR COM_AXIS online_dummy _CNV_A_R_LINEAR_____22_CM 6 0. 5. FORMAT "%2.0" AXIS_PTS_REF ldp_fmy_dtc /end AXIS_DESCR
/end CHARACTERISTIC
/begin CHARACTERISTIC fmy_id_poil_swi.envd "" CURVE 0x0274c _REC_CUR_20_u1_u1 255. _CNV_A_R_LINEAR_____1_CM 0. 255. DISPLAY_IDENTIFIER ID_ERR_ENVD_POIL_SWI FORMAT "%3.0"
 /begin AXIS_DESCR COM_AXIS online_dummy _CNV_A_R_LINEAR_____22_CM 4 0. 3. FORMAT "%2.0" AXIS_PTS_REF ldp_fmy_envd /end AXIS_DESCR
/end CHARACTERISTIC
/begin CHARACTERISTIC fmy_id_tout_efp.dtc "" CURVE 0x02752 _REC_CUR_20_u2_u2 65535. _CNV_A_R_LINEAR_____1_CM 0. 65535. DISPLAY_IDENTIFIER ID_ERR_DTC_TOUT_EFP FORMAT "%5.0"
 /begin AXIS_DESCR COM_AXIS online_dummy _CNV_A_R_LINEAR_____22_CM 6 0. 5. FORMAT "%2.0" AXIS_PTS_REF ldp_fmy_dtc /end AXIS_DESCR
/end CHARACTERISTIC
/begin CHARACTERISTIC fmy_id_tout_efp.envd "" CURVE 0x0275e _REC_CUR_20_u1_u1 255. _CNV_A_R_LINEAR_____1_CM 0. 255. DISPLAY_IDENTIFIER ID_ERR_ENVD_TOUT_EFP FORMAT "%3.0"
 /begin AXIS_DESCR COM_AXIS online_dummy _CNV_A_R_LINEAR_____22_CM 4 0. 3. FORMAT "%2.0" AXIS_PTS_REF ldp_fmy_envd /end AXIS_DESCR
/end CHARACTERISTIC
/begin CHARACTERISTIC fmy_id_diagcps.dtc "" CURVE 0x02764 _REC_CUR_20_u2_u2 65535. _CNV_A_R_LINEAR_____1_CM 0. 65535. DISPLAY_IDENTIFIER ID_ERR_DTC_DIAGCPS FORMAT "%5.0"
 /begin AXIS_DESCR COM_AXIS online_dummy _CNV_A_R_LINEAR_____22_CM 6 0. 5. FORMAT "%2.0" AXIS_PTS_REF ldp_fmy_dtc /end AXIS_DESCR
/end CHARACTERISTIC
/begin CHARACTERISTIC fmy_id_diagcps.envd "" CURVE 0x02770 _REC_CUR_20_u1_u1 255. _CNV_A_R_LINEAR_____1_CM 0. 255. DISPLAY_IDENTIFIER ID_ERR_ENVD_DIAGCPS FORMAT "%3.0"
 /begin AXIS_DESCR COM_AXIS online_dummy _CNV_A_R_LINEAR_____22_CM 4 0. 3. FORMAT "%2.0" AXIS_PTS_REF ldp_fmy_envd /end AXIS_DESCR
/end CHARACTERISTIC
/begin CHARACTERISTIC fmy_id_tq_gs_inc_plaus.dtc "" CURVE 0x02776 _REC_CUR_20_u2_u2 65535. _CNV_A_R_LINEAR_____1_CM 0. 65535. DISPLAY_IDENTIFIER ID_ERR_DTC_TQ_GS_INC_PLAUS FORMAT "%5.0"
 /begin AXIS_DESCR COM_AXIS online_dummy _CNV_A_R_LINEAR_____22_CM 6 0. 5. FORMAT "%2.0" AXIS_PTS_REF ldp_fmy_dtc /end AXIS_DESCR
/end CHARACTERISTIC
/begin CHARACTERISTIC fmy_id_tq_gs_inc_plaus.envd "" CURVE 0x02782 _REC_CUR_20_u1_u1 255. _CNV_A_R_LINEAR_____1_CM 0. 255. DISPLAY_IDENTIFIER ID_ERR_ENVD_TQ_GS_INC_PLAUS FORMAT "%3.0"
 /begin AXIS_DESCR COM_AXIS online_dummy _CNV_A_R_LINEAR_____22_CM 4 0. 3. FORMAT "%2.0" AXIS_PTS_REF ldp_fmy_envd /end AXIS_DESCR
/end CHARACTERISTIC
/begin CHARACTERISTIC fmy_id_dcc.dtc "" CURVE 0x02788 _REC_CUR_20_u2_u2 65535. _CNV_A_R_LINEAR_____1_CM 0. 65535. DISPLAY_IDENTIFIER ID_ERR_DTC_DCC FORMAT "%5.0"
 /begin AXIS_DESCR COM_AXIS online_dummy _CNV_A_R_LINEAR_____22_CM 6 0. 5. FORMAT "%2.0" AXIS_PTS_REF ldp_fmy_dtc /end AXIS_DESCR
/end CHARACTERISTIC
/begin CHARACTERISTIC fmy_id_dcc.envd "" CURVE 0x02794 _REC_CUR_20_u1_u1 255. _CNV_A_R_LINEAR_____1_CM 0. 255. DISPLAY_IDENTIFIER ID_ERR_ENVD_DCC FORMAT "%3.0"
 /begin AXIS_DESCR COM_AXIS online_dummy _CNV_A_R_LINEAR_____22_CM 4 0. 3. FORMAT "%2.0" AXIS_PTS_REF ldp_fmy_envd /end AXIS_DESCR
/end CHARACTERISTIC
/begin CHARACTERISTIC fmy_id_ecras.dtc "" CURVE 0x0279a _REC_CUR_20_u2_u2 65535. _CNV_A_R_LINEAR_____1_CM 0. 65535. DISPLAY_IDENTIFIER ID_ERR_DTC_ECRAS FORMAT "%5.0"
 /begin AXIS_DESCR COM_AXIS online_dummy _CNV_A_R_LINEAR_____22_CM 6 0. 5. FORMAT "%2.0" AXIS_PTS_REF ldp_fmy_dtc /end AXIS_DESCR
/end CHARACTERISTIC
/begin CHARACTERISTIC fmy_id_ecras.envd "" CURVE 0x027a6 _REC_CUR_20_u1_u1 255. _CNV_A_R_LINEAR_____1_CM 0. 255. DISPLAY_IDENTIFIER ID_ERR_ENVD_ECRAS FORMAT "%3.0"
 /begin AXIS_DESCR COM_AXIS online_dummy _CNV_A_R_LINEAR_____22_CM 4 0. 3. FORMAT "%2.0" AXIS_PTS_REF ldp_fmy_envd /end AXIS_DESCR
/end CHARACTERISTIC
/begin CHARACTERISTIC fmy_id_dmtlh.dtc "" CURVE 0x027ac _REC_CUR_20_u2_u2 65535. _CNV_A_R_LINEAR_____1_CM 0. 65535. DISPLAY_IDENTIFIER ID_ERR_DTC_DMTLH FORMAT "%5.0"
 /begin AXIS_DESCR COM_AXIS online_dummy _CNV_A_R_LINEAR_____22_CM 6 0. 5. FORMAT "%2.0" AXIS_PTS_REF ldp_fmy_dtc /end AXIS_DESCR
/end CHARACTERISTIC
/begin CHARACTERISTIC fmy_id_dmtlh.envd "" CURVE 0x027b8 _REC_CUR_20_u1_u1 255. _CNV_A_R_LINEAR_____1_CM 0. 255. DISPLAY_IDENTIFIER ID_ERR_ENVD_DMTLH FORMAT "%3.0"
 /begin AXIS_DESCR COM_AXIS online_dummy _CNV_A_R_LINEAR_____22_CM 4 0. 3. FORMAT "%2.0" AXIS_PTS_REF ldp_fmy_envd /end AXIS_DESCR
/end CHARACTERISTIC
/begin CHARACTERISTIC fmy_id_cs.dtc "" CURVE 0x027be _REC_CUR_20_u2_u2 65535. _CNV_A_R_LINEAR_____1_CM 0. 65535. DISPLAY_IDENTIFIER ID_ERR_DTC_CS FORMAT "%5.0"
 /begin AXIS_DESCR COM_AXIS online_dummy _CNV_A_R_LINEAR_____22_CM 6 0. 5. FORMAT "%2.0" AXIS_PTS_REF ldp_fmy_dtc /end AXIS_DESCR
/end CHARACTERISTIC
/begin CHARACTERISTIC fmy_id_cs.envd "" CURVE 0x027ca _REC_CUR_20_u1_u1 255. _CNV_A_R_LINEAR_____1_CM 0. 255. DISPLAY_IDENTIFIER ID_ERR_ENVD_CS FORMAT "%3.0"
 /begin AXIS_DESCR COM_AXIS online_dummy _CNV_A_R_LINEAR_____22_CM 4 0. 3. FORMAT "%2.0" AXIS_PTS_REF ldp_fmy_envd /end AXIS_DESCR
/end CHARACTERISTIC
/begin CHARACTERISTIC fmy_id_spi_mps.dtc "" CURVE 0x027d0 _REC_CUR_20_u2_u2 65535. _CNV_A_R_LINEAR_____1_CM 0. 65535. DISPLAY_IDENTIFIER ID_ERR_DTC_SPI_MPS FORMAT "%5.0"
 /begin AXIS_DESCR COM_AXIS online_dummy _CNV_A_R_LINEAR_____22_CM 6 0. 5. FORMAT "%2.0" AXIS_PTS_REF ldp_fmy_dtc /end AXIS_DESCR
/end CHARACTERISTIC
/begin CHARACTERISTIC fmy_id_spi_mps.envd "" CURVE 0x027dc _REC_CUR_20_u1_u1 255. _CNV_A_R_LINEAR_____1_CM 0. 255. DISPLAY_IDENTIFIER ID_ERR_ENVD_SPI_MPS FORMAT "%3.0"
 /begin AXIS_DESCR COM_AXIS online_dummy _CNV_A_R_LINEAR_____22_CM 4 0. 3. FORMAT "%2.0" AXIS_PTS_REF ldp_fmy_envd /end AXIS_DESCR
/end CHARACTERISTIC
/begin CHARACTERISTIC fmy_id_spi_knk.dtc "" CURVE 0x027e2 _REC_CUR_20_u2_u2 65535. _CNV_A_R_LINEAR_____1_CM 0. 65535. DISPLAY_IDENTIFIER ID_ERR_DTC_SPI_KNK FORMAT "%5.0"
 /begin AXIS_DESCR COM_AXIS online_dummy _CNV_A_R_LINEAR_____22_CM 6 0. 5. FORMAT "%2.0" AXIS_PTS_REF ldp_fmy_dtc /end AXIS_DESCR
/end CHARACTERISTIC
/begin CHARACTERISTIC fmy_id_spi_knk.envd "" CURVE 0x027ee _REC_CUR_20_u1_u1 255. _CNV_A_R_LINEAR_____1_CM 0. 255. DISPLAY_IDENTIFIER ID_ERR_ENVD_SPI_KNK FORMAT "%3.0"
 /begin AXIS_DESCR COM_AXIS online_dummy _CNV_A_R_LINEAR_____22_CM 4 0. 3. FORMAT "%2.0" AXIS_PTS_REF ldp_fmy_envd /end AXIS_DESCR
/end CHARACTERISTIC
/begin CHARACTERISTIC fmy_id_bn_tq_dcc.dtc "" CURVE 0x027f4 _REC_CUR_20_u2_u2 65535. _CNV_A_R_LINEAR_____1_CM 0. 65535. DISPLAY_IDENTIFIER ID_ERR_DTC_BN_TQ_DCC FORMAT "%5.0"
 /begin AXIS_DESCR COM_AXIS online_dummy _CNV_A_R_LINEAR_____22_CM 6 0. 5. FORMAT "%2.0" AXIS_PTS_REF ldp_fmy_dtc /end AXIS_DESCR
/end CHARACTERISTIC
/begin CHARACTERISTIC fmy_id_bn_tq_dcc.envd "" CURVE 0x02800 _REC_CUR_20_u1_u1 255. _CNV_A_R_LINEAR_____1_CM 0. 255. DISPLAY_IDENTIFIER ID_ERR_ENVD_BN_TQ_DCC FORMAT "%3.0"
 /begin AXIS_DESCR COM_AXIS online_dummy _CNV_A_R_LINEAR_____22_CM 4 0. 3. FORMAT "%2.0" AXIS_PTS_REF ldp_fmy_envd /end AXIS_DESCR
/end CHARACTERISTIC
/begin CHARACTERISTIC fmy_id_bn_tq_pste_2.dtc "" CURVE 0x02806 _REC_CUR_20_u2_u2 65535. _CNV_A_R_LINEAR_____1_CM 0. 65535. DISPLAY_IDENTIFIER ID_ERR_DTC_BN_TQ_PSTE_2 FORMAT "%5.0"
 /begin AXIS_DESCR COM_AXIS online_dummy _CNV_A_R_LINEAR_____22_CM 6 0. 5. FORMAT "%2.0" AXIS_PTS_REF ldp_fmy_dtc /end AXIS_DESCR
/end CHARACTERISTIC
/begin CHARACTERISTIC fmy_id_bn_tq_pste_2.envd "" CURVE 0x02812 _REC_CUR_20_u1_u1 255. _CNV_A_R_LINEAR_____1_CM 0. 255. DISPLAY_IDENTIFIER ID_ERR_ENVD_BN_TQ_PSTE_2 FORMAT "%3.0"
 /begin AXIS_DESCR COM_AXIS online_dummy _CNV_A_R_LINEAR_____22_CM 4 0. 3. FORMAT "%2.0" AXIS_PTS_REF ldp_fmy_envd /end AXIS_DESCR
/end CHARACTERISTIC
/begin CHARACTERISTIC fmy_id_bn_ars.dtc "" CURVE 0x02818 _REC_CUR_20_u2_u2 65535. _CNV_A_R_LINEAR_____1_CM 0. 65535. DISPLAY_IDENTIFIER ID_ERR_DTC_BN_ARS FORMAT "%5.0"
 /begin AXIS_DESCR COM_AXIS online_dummy _CNV_A_R_LINEAR_____22_CM 6 0. 5. FORMAT "%2.0" AXIS_PTS_REF ldp_fmy_dtc /end AXIS_DESCR
/end CHARACTERISTIC
/begin CHARACTERISTIC fmy_id_bn_ars.envd "" CURVE 0x02824 _REC_CUR_20_u1_u1 255. _CNV_A_R_LINEAR_____1_CM 0. 255. DISPLAY_IDENTIFIER ID_ERR_ENVD_BN_ARS FORMAT "%3.0"
 /begin AXIS_DESCR COM_AXIS online_dummy _CNV_A_R_LINEAR_____22_CM 4 0. 3. FORMAT "%2.0" AXIS_PTS_REF ldp_fmy_envd /end AXIS_DESCR
/end CHARACTERISTIC
/begin CHARACTERISTIC fmy_id_bn_cas.dtc "" CURVE 0x0282a _REC_CUR_20_u2_u2 65535. _CNV_A_R_LINEAR_____1_CM 0. 65535. DISPLAY_IDENTIFIER ID_ERR_DTC_BN_CAS FORMAT "%5.0"
 /begin AXIS_DESCR COM_AXIS online_dummy _CNV_A_R_LINEAR_____22_CM 6 0. 5. FORMAT "%2.0" AXIS_PTS_REF ldp_fmy_dtc /end AXIS_DESCR
/end CHARACTERISTIC
/begin CHARACTERISTIC fmy_id_bn_cas.envd "" CURVE 0x02836 _REC_CUR_20_u1_u1 255. _CNV_A_R_LINEAR_____1_CM 0. 255. DISPLAY_IDENTIFIER ID_ERR_ENVD_BN_CAS FORMAT "%3.0"
 /begin AXIS_DESCR COM_AXIS online_dummy _CNV_A_R_LINEAR_____22_CM 4 0. 3. FORMAT "%2.0" AXIS_PTS_REF ldp_fmy_envd /end AXIS_DESCR
/end CHARACTERISTIC
/begin CHARACTERISTIC fmy_id_bn_tq_tcs.dtc "" CURVE 0x0283c _REC_CUR_20_u2_u2 65535. _CNV_A_R_LINEAR_____1_CM 0. 65535. DISPLAY_IDENTIFIER ID_ERR_DTC_BN_TQ_TCS FORMAT "%5.0"
 /begin AXIS_DESCR COM_AXIS online_dummy _CNV_A_R_LINEAR_____22_CM 6 0. 5. FORMAT "%2.0" AXIS_PTS_REF ldp_fmy_dtc /end AXIS_DESCR
/end CHARACTERISTIC
/begin CHARACTERISTIC fmy_id_bn_tq_tcs.envd "" CURVE 0x02848 _REC_CUR_20_u1_u1 255. _CNV_A_R_LINEAR_____1_CM 0. 255. DISPLAY_IDENTIFIER ID_ERR_ENVD_BN_TQ_TCS FORMAT "%3.0"
 /begin AXIS_DESCR COM_AXIS online_dummy _CNV_A_R_LINEAR_____22_CM 4 0. 3. FORMAT "%2.0" AXIS_PTS_REF ldp_fmy_envd /end AXIS_DESCR
/end CHARACTERISTIC
/begin CHARACTERISTIC fmy_id_bn_vs_tcs.dtc "" CURVE 0x0284e _REC_CUR_20_u2_u2 65535. _CNV_A_R_LINEAR_____1_CM 0. 65535. DISPLAY_IDENTIFIER ID_ERR_DTC_BN_VS_TCS FORMAT "%5.0"
 /begin AXIS_DESCR COM_AXIS online_dummy _CNV_A_R_LINEAR_____22_CM 6 0. 5. FORMAT "%2.0" AXIS_PTS_REF ldp_fmy_dtc /end AXIS_DESCR
/end CHARACTERISTIC
/begin CHARACTERISTIC fmy_id_bn_vs_tcs.envd "" CURVE 0x0285a _REC_CUR_20_u1_u1 255. _CNV_A_R_LINEAR_____1_CM 0. 255. DISPLAY_IDENTIFIER ID_ERR_ENVD_BN_VS_TCS FORMAT "%3.0"
 /begin AXIS_DESCR COM_AXIS online_dummy _CNV_A_R_LINEAR_____22_CM 4 0. 3. FORMAT "%2.0" AXIS_PTS_REF ldp_fmy_envd /end AXIS_DESCR
/end CHARACTERISTIC
/begin CHARACTERISTIC fmy_id_bn_tcs.dtc "" CURVE 0x02860 _REC_CUR_20_u2_u2 65535. _CNV_A_R_LINEAR_____1_CM 0. 65535. DISPLAY_IDENTIFIER ID_ERR_DTC_BN_TCS FORMAT "%5.0"
 /begin AXIS_DESCR COM_AXIS online_dummy _CNV_A_R_LINEAR_____22_CM 6 0. 5. FORMAT "%2.0" AXIS_PTS_REF ldp_fmy_dtc /end AXIS_DESCR
/end CHARACTERISTIC
/begin CHARACTERISTIC fmy_id_bn_tcs.envd "" CURVE 0x0286c _REC_CUR_20_u1_u1 255. _CNV_A_R_LINEAR_____1_CM 0. 255. DISPLAY_IDENTIFIER ID_ERR_ENVD_BN_TCS FORMAT "%3.0"
 /begin AXIS_DESCR COM_AXIS online_dummy _CNV_A_R_LINEAR_____22_CM 4 0. 3. FORMAT "%2.0" AXIS_PTS_REF ldp_fmy_envd /end AXIS_DESCR
/end CHARACTERISTIC
/begin CHARACTERISTIC fmy_id_bn_tq_etcu.dtc "" CURVE 0x02872 _REC_CUR_20_u2_u2 65535. _CNV_A_R_LINEAR_____1_CM 0. 65535. DISPLAY_IDENTIFIER ID_ERR_DTC_BN_TQ_ETCU FORMAT "%5.0"
 /begin AXIS_DESCR COM_AXIS online_dummy _CNV_A_R_LINEAR_____22_CM 6 0. 5. FORMAT "%2.0" AXIS_PTS_REF ldp_fmy_dtc /end AXIS_DESCR
/end CHARACTERISTIC
/begin CHARACTERISTIC fmy_id_bn_tq_etcu.envd "" CURVE 0x0287e _REC_CUR_20_u1_u1 255. _CNV_A_R_LINEAR_____1_CM 0. 255. DISPLAY_IDENTIFIER ID_ERR_ENVD_BN_TQ_ETCU FORMAT "%3.0"
 /begin AXIS_DESCR COM_AXIS online_dummy _CNV_A_R_LINEAR_____22_CM 4 0. 3. FORMAT "%2.0" AXIS_PTS_REF ldp_fmy_envd /end AXIS_DESCR
/end CHARACTERISTIC
/begin CHARACTERISTIC fmy_id_bn_etcu.dtc "" CURVE 0x02884 _REC_CUR_20_u2_u2 65535. _CNV_A_R_LINEAR_____1_CM 0. 65535. DISPLAY_IDENTIFIER ID_ERR_DTC_BN_ETCU FORMAT "%5.0"
 /begin AXIS_DESCR COM_AXIS online_dummy _CNV_A_R_LINEAR_____22_CM 6 0. 5. FORMAT "%2.0" AXIS_PTS_REF ldp_fmy_dtc /end AXIS_DESCR
/end CHARACTERISTIC
/begin CHARACTERISTIC fmy_id_bn_etcu.envd "" CURVE 0x02890 _REC_CUR_20_u1_u1 255. _CNV_A_R_LINEAR_____1_CM 0. 255. DISPLAY_IDENTIFIER ID_ERR_ENVD_BN_ETCU FORMAT "%3.0"
 /begin AXIS_DESCR COM_AXIS online_dummy _CNV_A_R_LINEAR_____22_CM 4 0. 3. FORMAT "%2.0" AXIS_PTS_REF ldp_fmy_envd /end AXIS_DESCR
/end CHARACTERISTIC
/begin CHARACTERISTIC fmy_id_bn_tq_amt.dtc "" CURVE 0x02896 _REC_CUR_20_u2_u2 65535. _CNV_A_R_LINEAR_____1_CM 0. 65535. DISPLAY_IDENTIFIER ID_ERR_DTC_BN_TQ_AMT FORMAT "%5.0"
 /begin AXIS_DESCR COM_AXIS online_dummy _CNV_A_R_LINEAR_____22_CM 6 0. 5. FORMAT "%2.0" AXIS_PTS_REF ldp_fmy_dtc /end AXIS_DESCR
/end CHARACTERISTIC
/begin CHARACTERISTIC fmy_id_bn_tq_amt.envd "" CURVE 0x028a2 _REC_CUR_20_u1_u1 255. _CNV_A_R_LINEAR_____1_CM 0. 255. DISPLAY_IDENTIFIER ID_ERR_ENVD_BN_TQ_AMT FORMAT "%3.0"
 /begin AXIS_DESCR COM_AXIS online_dummy _CNV_A_R_LINEAR_____22_CM 4 0. 3. FORMAT "%2.0" AXIS_PTS_REF ldp_fmy_envd /end AXIS_DESCR
/end CHARACTERISTIC
/begin CHARACTERISTIC fmy_id_bn_acc.dtc "" CURVE 0x028a8 _REC_CUR_20_u2_u2 65535. _CNV_A_R_LINEAR_____1_CM 0. 65535. DISPLAY_IDENTIFIER ID_ERR_DTC_BN_ACC FORMAT "%5.0"
 /begin AXIS_DESCR COM_AXIS online_dummy _CNV_A_R_LINEAR_____22_CM 6 0. 5. FORMAT "%2.0" AXIS_PTS_REF ldp_fmy_dtc /end AXIS_DESCR
/end CHARACTERISTIC
/begin CHARACTERISTIC fmy_id_bn_acc.envd "" CURVE 0x028b4 _REC_CUR_20_u1_u1 255. _CNV_A_R_LINEAR_____1_CM 0. 255. DISPLAY_IDENTIFIER ID_ERR_ENVD_BN_ACC FORMAT "%3.0"
 /begin AXIS_DESCR COM_AXIS online_dummy _CNV_A_R_LINEAR_____22_CM 4 0. 3. FORMAT "%2.0" AXIS_PTS_REF ldp_fmy_envd /end AXIS_DESCR
/end CHARACTERISTIC
/begin CHARACTERISTIC fmy_id_bn_t_icl.dtc "" CURVE 0x028ba _REC_CUR_20_u2_u2 65535. _CNV_A_R_LINEAR_____1_CM 0. 65535. DISPLAY_IDENTIFIER ID_ERR_DTC_BN_T_ICL FORMAT "%5.0"
 /begin AXIS_DESCR COM_AXIS online_dummy _CNV_A_R_LINEAR_____22_CM 6 0. 5. FORMAT "%2.0" AXIS_PTS_REF ldp_fmy_dtc /end AXIS_DESCR
/end CHARACTERISTIC
/begin CHARACTERISTIC fmy_id_bn_t_icl.envd "" CURVE 0x028c6 _REC_CUR_20_u1_u1 255. _CNV_A_R_LINEAR_____1_CM 0. 255. DISPLAY_IDENTIFIER ID_ERR_ENVD_BN_T_ICL FORMAT "%3.0"
 /begin AXIS_DESCR COM_AXIS online_dummy _CNV_A_R_LINEAR_____22_CM 4 0. 3. FORMAT "%2.0" AXIS_PTS_REF ldp_fmy_envd /end AXIS_DESCR
/end CHARACTERISTIC
/begin CHARACTERISTIC fmy_id_bn_veh_mod.dtc "" CURVE 0x028cc _REC_CUR_20_u2_u2 65535. _CNV_A_R_LINEAR_____1_CM 0. 65535. DISPLAY_IDENTIFIER ID_ERR_DTC_BN_VEH_MOD FORMAT "%5.0"
 /begin AXIS_DESCR COM_AXIS online_dummy _CNV_A_R_LINEAR_____22_CM 6 0. 5. FORMAT "%2.0" AXIS_PTS_REF ldp_fmy_dtc /end AXIS_DESCR
/end CHARACTERISTIC
/begin CHARACTERISTIC fmy_id_bn_veh_mod.envd "" CURVE 0x028d8 _REC_CUR_20_u1_u1 255. _CNV_A_R_LINEAR_____1_CM 0. 255. DISPLAY_IDENTIFIER ID_ERR_ENVD_BN_VEH_MOD FORMAT "%3.0"
 /begin AXIS_DESCR COM_AXIS online_dummy _CNV_A_R_LINEAR_____22_CM 4 0. 3. FORMAT "%2.0" AXIS_PTS_REF ldp_fmy_envd /end AXIS_DESCR
/end CHARACTERISTIC
/begin CHARACTERISTIC fmy_id_bn_km_icl.dtc "" CURVE 0x028de _REC_CUR_20_u2_u2 65535. _CNV_A_R_LINEAR_____1_CM 0. 65535. DISPLAY_IDENTIFIER ID_ERR_DTC_BN_KM_ICL FORMAT "%5.0"
 /begin AXIS_DESCR COM_AXIS online_dummy _CNV_A_R_LINEAR_____22_CM 6 0. 5. FORMAT "%2.0" AXIS_PTS_REF ldp_fmy_dtc /end AXIS_DESCR
/end CHARACTERISTIC
/begin CHARACTERISTIC fmy_id_bn_km_icl.envd "" CURVE 0x028ea _REC_CUR_20_u1_u1 255. _CNV_A_R_LINEAR_____1_CM 0. 255. DISPLAY_IDENTIFIER ID_ERR_ENVD_BN_KM_ICL FORMAT "%3.0"
 /begin AXIS_DESCR COM_AXIS online_dummy _CNV_A_R_LINEAR_____22_CM 4 0. 3. FORMAT "%2.0" AXIS_PTS_REF ldp_fmy_envd /end AXIS_DESCR
/end CHARACTERISTIC
/begin CHARACTERISTIC fmy_id_bn_icl.dtc "" CURVE 0x028f0 _REC_CUR_20_u2_u2 65535. _CNV_A_R_LINEAR_____1_CM 0. 65535. DISPLAY_IDENTIFIER ID_ERR_DTC_BN_ICL FORMAT "%5.0"
 /begin AXIS_DESCR COM_AXIS online_dummy _CNV_A_R_LINEAR_____22_CM 6 0. 5. FORMAT "%2.0" AXIS_PTS_REF ldp_fmy_dtc /end AXIS_DESCR
/end CHARACTERISTIC
/begin CHARACTERISTIC fmy_id_bn_icl.envd "" CURVE 0x028fc _REC_CUR_20_u1_u1 255. _CNV_A_R_LINEAR_____1_CM 0. 255. DISPLAY_IDENTIFIER ID_ERR_ENVD_BN_ICL FORMAT "%3.0"
 /begin AXIS_DESCR COM_AXIS online_dummy _CNV_A_R_LINEAR_____22_CM 4 0. 3. FORMAT "%2.0" AXIS_PTS_REF ldp_fmy_envd /end AXIS_DESCR
/end CHARACTERISTIC
/begin CHARACTERISTIC fmy_id_bn_pow_vb.dtc "" CURVE 0x02902 _REC_CUR_20_u2_u2 65535. _CNV_A_R_LINEAR_____1_CM 0. 65535. DISPLAY_IDENTIFIER ID_ERR_DTC_BN_POW_VB FORMAT "%5.0"
 /begin AXIS_DESCR COM_AXIS online_dummy _CNV_A_R_LINEAR_____22_CM 6 0. 5. FORMAT "%2.0" AXIS_PTS_REF ldp_fmy_dtc /end AXIS_DESCR
/end CHARACTERISTIC
/begin CHARACTERISTIC fmy_id_bn_pow_vb.envd "" CURVE 0x0290e _REC_CUR_20_u1_u1 255. _CNV_A_R_LINEAR_____1_CM 0. 255. DISPLAY_IDENTIFIER ID_ERR_ENVD_BN_POW_VB FORMAT "%3.0"
 /begin AXIS_DESCR COM_AXIS online_dummy _CNV_A_R_LINEAR_____22_CM 4 0. 3. FORMAT "%2.0" AXIS_PTS_REF ldp_fmy_envd /end AXIS_DESCR
/end CHARACTERISTIC
/begin CHARACTERISTIC fmy_id_bn_pow_gen.dtc "" CURVE 0x02914 _REC_CUR_20_u2_u2 65535. _CNV_A_R_LINEAR_____1_CM 0. 65535. DISPLAY_IDENTIFIER ID_ERR_DTC_BN_POW_GEN FORMAT "%5.0"
 /begin AXIS_DESCR COM_AXIS online_dummy _CNV_A_R_LINEAR_____22_CM 6 0. 5. FORMAT "%2.0" AXIS_PTS_REF ldp_fmy_dtc /end AXIS_DESCR
/end CHARACTERISTIC
/begin CHARACTERISTIC fmy_id_bn_pow_gen.envd "" CURVE 0x02920 _REC_CUR_20_u1_u1 255. _CNV_A_R_LINEAR_____1_CM 0. 255. DISPLAY_IDENTIFIER ID_ERR_ENVD_BN_POW_GEN FORMAT "%3.0"
 /begin AXIS_DESCR COM_AXIS online_dummy _CNV_A_R_LINEAR_____22_CM 4 0. 3. FORMAT "%2.0" AXIS_PTS_REF ldp_fmy_envd /end AXIS_DESCR
/end CHARACTERISTIC
/begin CHARACTERISTIC fmy_id_bn_msw.dtc "" CURVE 0x02926 _REC_CUR_20_u2_u2 65535. _CNV_A_R_LINEAR_____1_CM 0. 65535. DISPLAY_IDENTIFIER ID_ERR_DTC_BN_MSW FORMAT "%5.0"
 /begin AXIS_DESCR COM_AXIS online_dummy _CNV_A_R_LINEAR_____22_CM 6 0. 5. FORMAT "%2.0" AXIS_PTS_REF ldp_fmy_dtc /end AXIS_DESCR
/end CHARACTERISTIC
/begin CHARACTERISTIC fmy_id_bn_msw.envd "" CURVE 0x02932 _REC_CUR_20_u1_u1 255. _CNV_A_R_LINEAR_____1_CM 0. 255. DISPLAY_IDENTIFIER ID_ERR_ENVD_BN_MSW FORMAT "%3.0"
 /begin AXIS_DESCR COM_AXIS online_dummy _CNV_A_R_LINEAR_____22_CM 4 0. 3. FORMAT "%2.0" AXIS_PTS_REF ldp_fmy_envd /end AXIS_DESCR
/end CHARACTERISTIC
/begin CHARACTERISTIC fmy_id_bn_ang_pste.dtc "" CURVE 0x02938 _REC_CUR_20_u2_u2 65535. _CNV_A_R_LINEAR_____1_CM 0. 65535. DISPLAY_IDENTIFIER ID_ERR_DTC_BN_ANG_PSTE FORMAT "%5.0"
 /begin AXIS_DESCR COM_AXIS online_dummy _CNV_A_R_LINEAR_____22_CM 6 0. 5. FORMAT "%2.0" AXIS_PTS_REF ldp_fmy_dtc /end AXIS_DESCR
/end CHARACTERISTIC
/begin CHARACTERISTIC fmy_id_bn_ang_pste.envd "" CURVE 0x02944 _REC_CUR_20_u1_u1 255. _CNV_A_R_LINEAR_____1_CM 0. 255. DISPLAY_IDENTIFIER ID_ERR_ENVD_BN_ANG_PSTE FORMAT "%3.0"
 /begin AXIS_DESCR COM_AXIS online_dummy _CNV_A_R_LINEAR_____22_CM 4 0. 3. FORMAT "%2.0" AXIS_PTS_REF ldp_fmy_envd /end AXIS_DESCR
/end CHARACTERISTIC
/begin CHARACTERISTIC fmy_id_bn_efp.dtc "" CURVE 0x0294a _REC_CUR_20_u2_u2 65535. _CNV_A_R_LINEAR_____1_CM 0. 65535. DISPLAY_IDENTIFIER ID_ERR_DTC_BN_EFP FORMAT "%5.0"
 /begin AXIS_DESCR COM_AXIS online_dummy _CNV_A_R_LINEAR_____22_CM 6 0. 5. FORMAT "%2.0" AXIS_PTS_REF ldp_fmy_dtc /end AXIS_DESCR
/end CHARACTERISTIC
/begin CHARACTERISTIC fmy_id_bn_efp.envd "" CURVE 0x02956 _REC_CUR_20_u1_u1 255. _CNV_A_R_LINEAR_____1_CM 0. 255. DISPLAY_IDENTIFIER ID_ERR_ENVD_BN_EFP FORMAT "%3.0"
 /begin AXIS_DESCR COM_AXIS online_dummy _CNV_A_R_LINEAR_____22_CM 4 0. 3. FORMAT "%2.0" AXIS_PTS_REF ldp_fmy_envd /end AXIS_DESCR
/end CHARACTERISTIC
/begin CHARACTERISTIC fmy_id_load_tps_plaus.dtc "" CURVE 0x0295c _REC_CUR_20_u2_u2 65535. _CNV_A_R_LINEAR_____1_CM 0. 65535. DISPLAY_IDENTIFIER ID_ERR_DTC_LOAD_TPS_PLAUS FORMAT "%5.0"
 /begin AXIS_DESCR COM_AXIS online_dummy _CNV_A_R_LINEAR_____22_CM 6 0. 5. FORMAT "%2.0" AXIS_PTS_REF ldp_fmy_dtc /end AXIS_DESCR
/end CHARACTERISTIC
/begin CHARACTERISTIC fmy_id_load_tps_plaus.envd "" CURVE 0x02968 _REC_CUR_20_u1_u1 255. _CNV_A_R_LINEAR_____1_CM 0. 255. DISPLAY_IDENTIFIER ID_ERR_ENVD_LOAD_TPS_PLAUS FORMAT "%3.0"
 /begin AXIS_DESCR COM_AXIS online_dummy _CNV_A_R_LINEAR_____22_CM 4 0. 3. FORMAT "%2.0" AXIS_PTS_REF ldp_fmy_envd /end AXIS_DESCR
/end CHARACTERISTIC
/begin CHARACTERISTIC fmy_id_efp_crash.dtc "" CURVE 0x0296e _REC_CUR_20_u2_u2 65535. _CNV_A_R_LINEAR_____1_CM 0. 65535. DISPLAY_IDENTIFIER ID_ERR_DTC_EFP_CRASH FORMAT "%5.0"
 /begin AXIS_DESCR COM_AXIS online_dummy _CNV_A_R_LINEAR_____22_CM 6 0. 5. FORMAT "%2.0" AXIS_PTS_REF ldp_fmy_dtc /end AXIS_DESCR
/end CHARACTERISTIC
/begin CHARACTERISTIC fmy_id_efp_crash.envd "" CURVE 0x0297a _REC_CUR_20_u1_u1 255. _CNV_A_R_LINEAR_____1_CM 0. 255. DISPLAY_IDENTIFIER ID_ERR_ENVD_EFP_CRASH FORMAT "%3.0"
 /begin AXIS_DESCR COM_AXIS online_dummy _CNV_A_R_LINEAR_____22_CM 4 0. 3. FORMAT "%2.0" AXIS_PTS_REF ldp_fmy_envd /end AXIS_DESCR
/end CHARACTERISTIC
/begin CHARACTERISTIC fmy_id_efp.dtc "" CURVE 0x02980 _REC_CUR_20_u2_u2 65535. _CNV_A_R_LINEAR_____1_CM 0. 65535. DISPLAY_IDENTIFIER ID_ERR_DTC_EFP FORMAT "%5.0"
 /begin AXIS_DESCR COM_AXIS online_dummy _CNV_A_R_LINEAR_____22_CM 6 0. 5. FORMAT "%2.0" AXIS_PTS_REF ldp_fmy_dtc /end AXIS_DESCR
/end CHARACTERISTIC
/begin CHARACTERISTIC fmy_id_efp.envd "" CURVE 0x0298c _REC_CUR_20_u1_u1 255. _CNV_A_R_LINEAR_____1_CM 0. 255. DISPLAY_IDENTIFIER ID_ERR_ENVD_EFP FORMAT "%3.0"
 /begin AXIS_DESCR COM_AXIS online_dummy _CNV_A_R_LINEAR_____22_CM 4 0. 3. FORMAT "%2.0" AXIS_PTS_REF ldp_fmy_envd /end AXIS_DESCR
/end CHARACTERISTIC
/begin CHARACTERISTIC fmy_id_locan_boff.dtc "" CURVE 0x02992 _REC_CUR_20_u2_u2 65535. _CNV_A_R_LINEAR_____1_CM 0. 65535. DISPLAY_IDENTIFIER ID_ERR_DTC_LOCAN_BOFF FORMAT "%5.0"
 /begin AXIS_DESCR COM_AXIS online_dummy _CNV_A_R_LINEAR_____22_CM 6 0. 5. FORMAT "%2.0" AXIS_PTS_REF ldp_fmy_dtc /end AXIS_DESCR
/end CHARACTERISTIC
/begin CHARACTERISTIC fmy_id_locan_boff.envd "" CURVE 0x0299e _REC_CUR_20_u1_u1 255. _CNV_A_R_LINEAR_____1_CM 0. 255. DISPLAY_IDENTIFIER ID_ERR_ENVD_LOCAN_BOFF FORMAT "%3.0"
 /begin AXIS_DESCR COM_AXIS online_dummy _CNV_A_R_LINEAR_____22_CM 4 0. 3. FORMAT "%2.0" AXIS_PTS_REF ldp_fmy_envd /end AXIS_DESCR
/end CHARACTERISTIC
/begin CHARACTERISTIC fmy_id_chg_ls_up.dtc "" CURVE 0x029a4 _REC_CUR_20_u2_u2 65535. _CNV_A_R_LINEAR_____1_CM 0. 65535. DISPLAY_IDENTIFIER ID_ERR_DTC_CHG_LS_UP FORMAT "%5.0"
 /begin AXIS_DESCR COM_AXIS online_dummy _CNV_A_R_LINEAR_____22_CM 6 0. 5. FORMAT "%2.0" AXIS_PTS_REF ldp_fmy_dtc /end AXIS_DESCR
/end CHARACTERISTIC
/begin CHARACTERISTIC fmy_id_chg_ls_up.envd "" CURVE 0x029b0 _REC_CUR_20_u1_u1 255. _CNV_A_R_LINEAR_____1_CM 0. 255. DISPLAY_IDENTIFIER ID_ERR_ENVD_CHG_LS_UP FORMAT "%3.0"
 /begin AXIS_DESCR COM_AXIS online_dummy _CNV_A_R_LINEAR_____22_CM 4 0. 3. FORMAT "%2.0" AXIS_PTS_REF ldp_fmy_envd /end AXIS_DESCR
/end CHARACTERISTIC
/begin CHARACTERISTIC fmy_id_chg_ls_down.dtc "" CURVE 0x029b6 _REC_CUR_20_u2_u2 65535. _CNV_A_R_LINEAR_____1_CM 0. 65535. DISPLAY_IDENTIFIER ID_ERR_DTC_CHG_LS_DOWN FORMAT "%5.0"
 /begin AXIS_DESCR COM_AXIS online_dummy _CNV_A_R_LINEAR_____22_CM 6 0. 5. FORMAT "%2.0" AXIS_PTS_REF ldp_fmy_dtc /end AXIS_DESCR
/end CHARACTERISTIC
/begin CHARACTERISTIC fmy_id_chg_ls_down.envd "" CURVE 0x029c2 _REC_CUR_20_u1_u1 255. _CNV_A_R_LINEAR_____1_CM 0. 255. DISPLAY_IDENTIFIER ID_ERR_ENVD_CHG_LS_DOWN FORMAT "%3.0"
 /begin AXIS_DESCR COM_AXIS online_dummy _CNV_A_R_LINEAR_____22_CM 4 0. 3. FORMAT "%2.0" AXIS_PTS_REF ldp_fmy_envd /end AXIS_DESCR
/end CHARACTERISTIC
/begin CHARACTERISTIC fmy_id_qoil_sens.dtc "" CURVE 0x029c8 _REC_CUR_20_u2_u2 65535. _CNV_A_R_LINEAR_____1_CM 0. 65535. DISPLAY_IDENTIFIER ID_ERR_DTC_QOIL_SENS FORMAT "%5.0"
 /begin AXIS_DESCR COM_AXIS online_dummy _CNV_A_R_LINEAR_____22_CM 6 0. 5. FORMAT "%2.0" AXIS_PTS_REF ldp_fmy_dtc /end AXIS_DESCR
/end CHARACTERISTIC
/begin CHARACTERISTIC fmy_id_qoil_sens.envd "" CURVE 0x029d4 _REC_CUR_20_u1_u1 255. _CNV_A_R_LINEAR_____1_CM 0. 255. DISPLAY_IDENTIFIER ID_ERR_ENVD_QOIL_SENS FORMAT "%3.0"
 /begin AXIS_DESCR COM_AXIS online_dummy _CNV_A_R_LINEAR_____22_CM 4 0. 3. FORMAT "%2.0" AXIS_PTS_REF ldp_fmy_envd /end AXIS_DESCR
/end CHARACTERISTIC
/begin CHARACTERISTIC fmy_id_bat_sens.dtc "" CURVE 0x029da _REC_CUR_20_u2_u2 65535. _CNV_A_R_LINEAR_____1_CM 0. 65535. DISPLAY_IDENTIFIER ID_ERR_DTC_BAT_SENS FORMAT "%5.0"
 /begin AXIS_DESCR COM_AXIS online_dummy _CNV_A_R_LINEAR_____22_CM 6 0. 5. FORMAT "%2.0" AXIS_PTS_REF ldp_fmy_dtc /end AXIS_DESCR
/end CHARACTERISTIC
/begin CHARACTERISTIC fmy_id_bat_sens.envd "" CURVE 0x029e6 _REC_CUR_20_u1_u1 255. _CNV_A_R_LINEAR_____1_CM 0. 255. DISPLAY_IDENTIFIER ID_ERR_ENVD_BAT_SENS FORMAT "%3.0"
 /begin AXIS_DESCR COM_AXIS online_dummy _CNV_A_R_LINEAR_____22_CM 4 0. 3. FORMAT "%2.0" AXIS_PTS_REF ldp_fmy_envd /end AXIS_DESCR
/end CHARACTERISTIC
/begin CHARACTERISTIC fmy_id_bat_sens_it.dtc "" CURVE 0x029ec _REC_CUR_20_u2_u2 65535. _CNV_A_R_LINEAR_____1_CM 0. 65535. DISPLAY_IDENTIFIER ID_ERR_DTC_BAT_SENS_IT FORMAT "%5.0"
 /begin AXIS_DESCR COM_AXIS online_dummy _CNV_A_R_LINEAR_____22_CM 6 0. 5. FORMAT "%2.0" AXIS_PTS_REF ldp_fmy_dtc /end AXIS_DESCR
/end CHARACTERISTIC
/begin CHARACTERISTIC fmy_id_bat_sens_it.envd "" CURVE 0x029f8 _REC_CUR_20_u1_u1 255. _CNV_A_R_LINEAR_____1_CM 0. 255. DISPLAY_IDENTIFIER ID_ERR_ENVD_BAT_SENS_IT FORMAT "%3.0"
 /begin AXIS_DESCR COM_AXIS online_dummy _CNV_A_R_LINEAR_____22_CM 4 0. 3. FORMAT "%2.0" AXIS_PTS_REF ldp_fmy_envd /end AXIS_DESCR
/end CHARACTERISTIC
/begin CHARACTERISTIC fmy_id_bat_sens_it_el.dtc "" CURVE 0x029fe _REC_CUR_20_u2_u2 65535. _CNV_A_R_LINEAR_____1_CM 0. 65535. DISPLAY_IDENTIFIER ID_ERR_DTC_BAT_SENS_IT_EL FORMAT "%5.0"
 /begin AXIS_DESCR COM_AXIS online_dummy _CNV_A_R_LINEAR_____22_CM 6 0. 5. FORMAT "%2.0" AXIS_PTS_REF ldp_fmy_dtc /end AXIS_DESCR
/end CHARACTERISTIC
/begin CHARACTERISTIC fmy_id_bat_sens_it_el.envd "" CURVE 0x02a0a _REC_CUR_20_u1_u1 255. _CNV_A_R_LINEAR_____1_CM 0. 255. DISPLAY_IDENTIFIER ID_ERR_ENVD_BAT_SENS_IT_EL FORMAT "%3.0"
 /begin AXIS_DESCR COM_AXIS online_dummy _CNV_A_R_LINEAR_____22_CM 4 0. 3. FORMAT "%2.0" AXIS_PTS_REF ldp_fmy_envd /end AXIS_DESCR
/end CHARACTERISTIC
/begin CHARACTERISTIC fmy_id_ecu_nvmy.dtc "" CURVE 0x02a10 _REC_CUR_20_u2_u2 65535. _CNV_A_R_LINEAR_____1_CM 0. 65535. DISPLAY_IDENTIFIER ID_ERR_DTC_ECU_NVMY FORMAT "%5.0"
 /begin AXIS_DESCR COM_AXIS online_dummy _CNV_A_R_LINEAR_____22_CM 6 0. 5. FORMAT "%2.0" AXIS_PTS_REF ldp_fmy_dtc /end AXIS_DESCR
/end CHARACTERISTIC
/begin CHARACTERISTIC fmy_id_ecu_nvmy.envd "" CURVE 0x02a1c _REC_CUR_20_u1_u1 255. _CNV_A_R_LINEAR_____1_CM 0. 255. DISPLAY_IDENTIFIER ID_ERR_ENVD_ECU_NVMY FORMAT "%3.0"
 /begin AXIS_DESCR COM_AXIS online_dummy _CNV_A_R_LINEAR_____22_CM 4 0. 3. FORMAT "%2.0" AXIS_PTS_REF ldp_fmy_envd /end AXIS_DESCR
/end CHARACTERISTIC
/begin CHARACTERISTIC fmy_id_gs.dtc "" CURVE 0x02a22 _REC_CUR_20_u2_u2 65535. _CNV_A_R_LINEAR_____1_CM 0. 65535. DISPLAY_IDENTIFIER ID_ERR_DTC_GS FORMAT "%5.0"
 /begin AXIS_DESCR COM_AXIS online_dummy _CNV_A_R_LINEAR_____22_CM 6 0. 5. FORMAT "%2.0" AXIS_PTS_REF ldp_fmy_dtc /end AXIS_DESCR
/end CHARACTERISTIC
/begin CHARACTERISTIC fmy_id_gs.envd "" CURVE 0x02a2e _REC_CUR_20_u1_u1 255. _CNV_A_R_LINEAR_____1_CM 0. 255. DISPLAY_IDENTIFIER ID_ERR_ENVD_GS FORMAT "%3.0"
 /begin AXIS_DESCR COM_AXIS online_dummy _CNV_A_R_LINEAR_____22_CM 4 0. 3. FORMAT "%2.0" AXIS_PTS_REF ldp_fmy_envd /end AXIS_DESCR
/end CHARACTERISTIC
/begin CHARACTERISTIC fmy_id_obd2_lsh_up_1.dtc "" CURVE 0x02a46 _REC_CUR_20_u2_u2 65535. _CNV_A_R_LINEAR_____1_CM 0. 65535. DISPLAY_IDENTIFIER ID_ERR_DTC_OBD2_LSH_UP_1 FORMAT "%5.0"
 /begin AXIS_DESCR COM_AXIS online_dummy _CNV_A_R_LINEAR_____22_CM 6 0. 5. FORMAT "%2.0" AXIS_PTS_REF ldp_fmy_dtc /end AXIS_DESCR
/end CHARACTERISTIC
/begin CHARACTERISTIC fmy_id_obd2_lsh_up_1.envd "" CURVE 0x02a52 _REC_CUR_20_u1_u1 255. _CNV_A_R_LINEAR_____1_CM 0. 255. DISPLAY_IDENTIFIER ID_ERR_ENVD_OBD2_LSH_UP_1 FORMAT "%3.0"
 /begin AXIS_DESCR COM_AXIS online_dummy _CNV_A_R_LINEAR_____22_CM 4 0. 3. FORMAT "%2.0" AXIS_PTS_REF ldp_fmy_envd /end AXIS_DESCR
/end CHARACTERISTIC
/begin CHARACTERISTIC fmy_id_obd2_lsh_up_2.dtc "" CURVE 0x02a58 _REC_CUR_20_u2_u2 65535. _CNV_A_R_LINEAR_____1_CM 0. 65535. DISPLAY_IDENTIFIER ID_ERR_DTC_OBD2_LSH_UP_2 FORMAT "%5.0"
 /begin AXIS_DESCR COM_AXIS online_dummy _CNV_A_R_LINEAR_____22_CM 6 0. 5. FORMAT "%2.0" AXIS_PTS_REF ldp_fmy_dtc /end AXIS_DESCR
/end CHARACTERISTIC
/begin CHARACTERISTIC fmy_id_obd2_lsh_up_2.envd "" CURVE 0x02a64 _REC_CUR_20_u1_u1 255. _CNV_A_R_LINEAR_____1_CM 0. 255. DISPLAY_IDENTIFIER ID_ERR_ENVD_OBD2_LSH_UP_2 FORMAT "%3.0"
 /begin AXIS_DESCR COM_AXIS online_dummy _CNV_A_R_LINEAR_____22_CM 4 0. 3. FORMAT "%2.0" AXIS_PTS_REF ldp_fmy_envd /end AXIS_DESCR
/end CHARACTERISTIC
/begin CHARACTERISTIC fmy_id_cat_diag_1.dtc "" CURVE 0x02a6a _REC_CUR_20_u2_u2 65535. _CNV_A_R_LINEAR_____1_CM 0. 65535. DISPLAY_IDENTIFIER ID_ERR_DTC_CAT_DIAG_1 FORMAT "%5.0"
 /begin AXIS_DESCR COM_AXIS online_dummy _CNV_A_R_LINEAR_____22_CM 6 0. 5. FORMAT "%2.0" AXIS_PTS_REF ldp_fmy_dtc /end AXIS_DESCR
/end CHARACTERISTIC
/begin CHARACTERISTIC fmy_id_cat_diag_1.envd "" CURVE 0x02a76 _REC_CUR_20_u1_u1 255. _CNV_A_R_LINEAR_____1_CM 0. 255. DISPLAY_IDENTIFIER ID_ERR_ENVD_CAT_DIAG_1 FORMAT "%3.0"
 /begin AXIS_DESCR COM_AXIS online_dummy _CNV_A_R_LINEAR_____22_CM 4 0. 3. FORMAT "%2.0" AXIS_PTS_REF ldp_fmy_envd /end AXIS_DESCR
/end CHARACTERISTIC
/begin CHARACTERISTIC fmy_id_cat_diag_2.dtc "" CURVE 0x02a7c _REC_CUR_20_u2_u2 65535. _CNV_A_R_LINEAR_____1_CM 0. 65535. DISPLAY_IDENTIFIER ID_ERR_DTC_CAT_DIAG_2 FORMAT "%5.0"
 /begin AXIS_DESCR COM_AXIS online_dummy _CNV_A_R_LINEAR_____22_CM 6 0. 5. FORMAT "%2.0" AXIS_PTS_REF ldp_fmy_dtc /end AXIS_DESCR
/end CHARACTERISTIC
/begin CHARACTERISTIC fmy_id_cat_diag_2.envd "" CURVE 0x02a88 _REC_CUR_20_u1_u1 255. _CNV_A_R_LINEAR_____1_CM 0. 255. DISPLAY_IDENTIFIER ID_ERR_ENVD_CAT_DIAG_2 FORMAT "%3.0"
 /begin AXIS_DESCR COM_AXIS online_dummy _CNV_A_R_LINEAR_____22_CM 4 0. 3. FORMAT "%2.0" AXIS_PTS_REF ldp_fmy_envd /end AXIS_DESCR
/end CHARACTERISTIC
/begin CHARACTERISTIC fmy_id_chk_ls_down_1.dtc "" CURVE 0x02a8e _REC_CUR_20_u2_u2 65535. _CNV_A_R_LINEAR_____1_CM 0. 65535. DISPLAY_IDENTIFIER ID_ERR_DTC_CHK_LS_DOWN_1 FORMAT "%5.0"
 /begin AXIS_DESCR COM_AXIS online_dummy _CNV_A_R_LINEAR_____22_CM 6 0. 5. FORMAT "%2.0" AXIS_PTS_REF ldp_fmy_dtc /end AXIS_DESCR
/end CHARACTERISTIC
/begin CHARACTERISTIC fmy_id_chk_ls_down_1.envd "" CURVE 0x02a9a _REC_CUR_20_u1_u1 255. _CNV_A_R_LINEAR_____1_CM 0. 255. DISPLAY_IDENTIFIER ID_ERR_ENVD_CHK_LS_DOWN_1 FORMAT "%3.0"
 /begin AXIS_DESCR COM_AXIS online_dummy _CNV_A_R_LINEAR_____22_CM 4 0. 3. FORMAT "%2.0" AXIS_PTS_REF ldp_fmy_envd /end AXIS_DESCR
/end CHARACTERISTIC
/begin CHARACTERISTIC fmy_id_chk_ls_down_2.dtc "" CURVE 0x02aa0 _REC_CUR_20_u2_u2 65535. _CNV_A_R_LINEAR_____1_CM 0. 65535. DISPLAY_IDENTIFIER ID_ERR_DTC_CHK_LS_DOWN_2 FORMAT "%5.0"
 /begin AXIS_DESCR COM_AXIS online_dummy _CNV_A_R_LINEAR_____22_CM 6 0. 5. FORMAT "%2.0" AXIS_PTS_REF ldp_fmy_dtc /end AXIS_DESCR
/end CHARACTERISTIC
/begin CHARACTERISTIC fmy_id_chk_ls_down_2.envd "" CURVE 0x02aac _REC_CUR_20_u1_u1 255. _CNV_A_R_LINEAR_____1_CM 0. 255. DISPLAY_IDENTIFIER ID_ERR_ENVD_CHK_LS_DOWN_2 FORMAT "%3.0"
 /begin AXIS_DESCR COM_AXIS online_dummy _CNV_A_R_LINEAR_____22_CM 4 0. 3. FORMAT "%2.0" AXIS_PTS_REF ldp_fmy_envd /end AXIS_DESCR
/end CHARACTERISTIC
/begin CHARACTERISTIC fmy_id_vls_up_min_cold_1.dtc "" CURVE 0x02ab2 _REC_CUR_20_u2_u2 65535. _CNV_A_R_LINEAR_____1_CM 0. 65535. DISPLAY_IDENTIFIER ID_ERR_DTC_VLS_UP_MIN_COLD_1 FORMAT "%5.0"
 /begin AXIS_DESCR COM_AXIS online_dummy _CNV_A_R_LINEAR_____22_CM 6 0. 5. FORMAT "%2.0" AXIS_PTS_REF ldp_fmy_dtc /end AXIS_DESCR
/end CHARACTERISTIC
/begin CHARACTERISTIC fmy_id_vls_up_min_cold_1.envd "" CURVE 0x02abe _REC_CUR_20_u1_u1 255. _CNV_A_R_LINEAR_____1_CM 0. 255. DISPLAY_IDENTIFIER ID_ERR_ENVD_VLS_UP_MIN_COLD_1 FORMAT "%3.0"
 /begin AXIS_DESCR COM_AXIS online_dummy _CNV_A_R_LINEAR_____22_CM 4 0. 3. FORMAT "%2.0" AXIS_PTS_REF ldp_fmy_envd /end AXIS_DESCR
/end CHARACTERISTIC
/begin CHARACTERISTIC fmy_id_vls_up_min_cold_2.dtc "" CURVE 0x02ac4 _REC_CUR_20_u2_u2 65535. _CNV_A_R_LINEAR_____1_CM 0. 65535. DISPLAY_IDENTIFIER ID_ERR_DTC_VLS_UP_MIN_COLD_2 FORMAT "%5.0"
 /begin AXIS_DESCR COM_AXIS online_dummy _CNV_A_R_LINEAR_____22_CM 6 0. 5. FORMAT "%2.0" AXIS_PTS_REF ldp_fmy_dtc /end AXIS_DESCR
/end CHARACTERISTIC
/begin CHARACTERISTIC fmy_id_vls_up_min_cold_2.envd "" CURVE 0x02ad0 _REC_CUR_20_u1_u1 255. _CNV_A_R_LINEAR_____1_CM 0. 255. DISPLAY_IDENTIFIER ID_ERR_ENVD_VLS_UP_MIN_COLD_2 FORMAT "%3.0"
 /begin AXIS_DESCR COM_AXIS online_dummy _CNV_A_R_LINEAR_____22_CM 4 0. 3. FORMAT "%2.0" AXIS_PTS_REF ldp_fmy_envd /end AXIS_DESCR
/end CHARACTERISTIC
/begin CHARACTERISTIC fmy_id_vls_up_min_1.dtc "" CURVE 0x02ad6 _REC_CUR_20_u2_u2 65535. _CNV_A_R_LINEAR_____1_CM 0. 65535. DISPLAY_IDENTIFIER ID_ERR_DTC_VLS_UP_MIN_1 FORMAT "%5.0"
 /begin AXIS_DESCR COM_AXIS online_dummy _CNV_A_R_LINEAR_____22_CM 6 0. 5. FORMAT "%2.0" AXIS_PTS_REF ldp_fmy_dtc /end AXIS_DESCR
/end CHARACTERISTIC
/begin CHARACTERISTIC fmy_id_vls_up_min_1.envd "" CURVE 0x02ae2 _REC_CUR_20_u1_u1 255. _CNV_A_R_LINEAR_____1_CM 0. 255. DISPLAY_IDENTIFIER ID_ERR_ENVD_VLS_UP_MIN_1 FORMAT "%3.0"
 /begin AXIS_DESCR COM_AXIS online_dummy _CNV_A_R_LINEAR_____22_CM 4 0. 3. FORMAT "%2.0" AXIS_PTS_REF ldp_fmy_envd /end AXIS_DESCR
/end CHARACTERISTIC
/begin CHARACTERISTIC fmy_id_vls_up_min_2.dtc "" CURVE 0x02ae8 _REC_CUR_20_u2_u2 65535. _CNV_A_R_LINEAR_____1_CM 0. 65535. DISPLAY_IDENTIFIER ID_ERR_DTC_VLS_UP_MIN_2 FORMAT "%5.0"
 /begin AXIS_DESCR COM_AXIS online_dummy _CNV_A_R_LINEAR_____22_CM 6 0. 5. FORMAT "%2.0" AXIS_PTS_REF ldp_fmy_dtc /end AXIS_DESCR
/end CHARACTERISTIC
/begin CHARACTERISTIC fmy_id_vls_up_min_2.envd "" CURVE 0x02af4 _REC_CUR_20_u1_u1 255. _CNV_A_R_LINEAR_____1_CM 0. 255. DISPLAY_IDENTIFIER ID_ERR_ENVD_VLS_UP_MIN_2 FORMAT "%3.0"
 /begin AXIS_DESCR COM_AXIS online_dummy _CNV_A_R_LINEAR_____22_CM 4 0. 3. FORMAT "%2.0" AXIS_PTS_REF ldp_fmy_envd /end AXIS_DESCR
/end CHARACTERISTIC
/begin CHARACTERISTIC fmy_id_vls_up_max_1.dtc "" CURVE 0x02afa _REC_CUR_20_u2_u2 65535. _CNV_A_R_LINEAR_____1_CM 0. 65535. DISPLAY_IDENTIFIER ID_ERR_DTC_VLS_UP_MAX_1 FORMAT "%5.0"
 /begin AXIS_DESCR COM_AXIS online_dummy _CNV_A_R_LINEAR_____22_CM 6 0. 5. FORMAT "%2.0" AXIS_PTS_REF ldp_fmy_dtc /end AXIS_DESCR
/end CHARACTERISTIC
/begin CHARACTERISTIC fmy_id_vls_up_max_1.envd "" CURVE 0x02b06 _REC_CUR_20_u1_u1 255. _CNV_A_R_LINEAR_____1_CM 0. 255. DISPLAY_IDENTIFIER ID_ERR_ENVD_VLS_UP_MAX_1 FORMAT "%3.0"
 /begin AXIS_DESCR COM_AXIS online_dummy _CNV_A_R_LINEAR_____22_CM 4 0. 3. FORMAT "%2.0" AXIS_PTS_REF ldp_fmy_envd /end AXIS_DESCR
/end CHARACTERISTIC
/begin CHARACTERISTIC fmy_id_vls_up_max_2.dtc "" CURVE 0x02b0c _REC_CUR_20_u2_u2 65535. _CNV_A_R_LINEAR_____1_CM 0. 65535. DISPLAY_IDENTIFIER ID_ERR_DTC_VLS_UP_MAX_2 FORMAT "%5.0"
 /begin AXIS_DESCR COM_AXIS online_dummy _CNV_A_R_LINEAR_____22_CM 6 0. 5. FORMAT "%2.0" AXIS_PTS_REF ldp_fmy_dtc /end AXIS_DESCR
/end CHARACTERISTIC
/begin CHARACTERISTIC fmy_id_vls_up_max_2.envd "" CURVE 0x02b18 _REC_CUR_20_u1_u1 255. _CNV_A_R_LINEAR_____1_CM 0. 255. DISPLAY_IDENTIFIER ID_ERR_ENVD_VLS_UP_MAX_2 FORMAT "%3.0"
 /begin AXIS_DESCR COM_AXIS online_dummy _CNV_A_R_LINEAR_____22_CM 4 0. 3. FORMAT "%2.0" AXIS_PTS_REF ldp_fmy_envd /end AXIS_DESCR
/end CHARACTERISTIC
/begin CHARACTERISTIC fmy_id_vls_up_oc_1.dtc "" CURVE 0x02b1e _REC_CUR_20_u2_u2 65535. _CNV_A_R_LINEAR_____1_CM 0. 65535. DISPLAY_IDENTIFIER ID_ERR_DTC_VLS_UP_OC_1 FORMAT "%5.0"
 /begin AXIS_DESCR COM_AXIS online_dummy _CNV_A_R_LINEAR_____22_CM 6 0. 5. FORMAT "%2.0" AXIS_PTS_REF ldp_fmy_dtc /end AXIS_DESCR
/end CHARACTERISTIC
/begin CHARACTERISTIC fmy_id_vls_up_oc_1.envd "" CURVE 0x02b2a _REC_CUR_20_u1_u1 255. _CNV_A_R_LINEAR_____1_CM 0. 255. DISPLAY_IDENTIFIER ID_ERR_ENVD_VLS_UP_OC_1 FORMAT "%3.0"
 /begin AXIS_DESCR COM_AXIS online_dummy _CNV_A_R_LINEAR_____22_CM 4 0. 3. FORMAT "%2.0" AXIS_PTS_REF ldp_fmy_envd /end AXIS_DESCR
/end CHARACTERISTIC
/begin CHARACTERISTIC fmy_id_vls_up_oc_2.dtc "" CURVE 0x02b30 _REC_CUR_20_u2_u2 65535. _CNV_A_R_LINEAR_____1_CM 0. 65535. DISPLAY_IDENTIFIER ID_ERR_DTC_VLS_UP_OC_2 FORMAT "%5.0"
 /begin AXIS_DESCR COM_AXIS online_dummy _CNV_A_R_LINEAR_____22_CM 6 0. 5. FORMAT "%2.0" AXIS_PTS_REF ldp_fmy_dtc /end AXIS_DESCR
/end CHARACTERISTIC
/begin CHARACTERISTIC fmy_id_vls_up_oc_2.envd "" CURVE 0x02b3c _REC_CUR_20_u1_u1 255. _CNV_A_R_LINEAR_____1_CM 0. 255. DISPLAY_IDENTIFIER ID_ERR_ENVD_VLS_UP_OC_2 FORMAT "%3.0"
 /begin AXIS_DESCR COM_AXIS online_dummy _CNV_A_R_LINEAR_____22_CM 4 0. 3. FORMAT "%2.0" AXIS_PTS_REF ldp_fmy_envd /end AXIS_DESCR
/end CHARACTERISTIC
/begin CHARACTERISTIC fmy_id_vls_up_puc_1.dtc "" CURVE 0x02b42 _REC_CUR_20_u2_u2 65535. _CNV_A_R_LINEAR_____1_CM 0. 65535. DISPLAY_IDENTIFIER ID_ERR_DTC_VLS_UP_PUC_1 FORMAT "%5.0"
 /begin AXIS_DESCR COM_AXIS online_dummy _CNV_A_R_LINEAR_____22_CM 6 0. 5. FORMAT "%2.0" AXIS_PTS_REF ldp_fmy_dtc /end AXIS_DESCR
/end CHARACTERISTIC
/begin CHARACTERISTIC fmy_id_vls_up_puc_1.envd "" CURVE 0x02b4e _REC_CUR_20_u1_u1 255. _CNV_A_R_LINEAR_____1_CM 0. 255. DISPLAY_IDENTIFIER ID_ERR_ENVD_VLS_UP_PUC_1 FORMAT "%3.0"
 /begin AXIS_DESCR COM_AXIS online_dummy _CNV_A_R_LINEAR_____22_CM 4 0. 3. FORMAT "%2.0" AXIS_PTS_REF ldp_fmy_envd /end AXIS_DESCR
/end CHARACTERISTIC
/begin CHARACTERISTIC fmy_id_vls_up_puc_2.dtc "" CURVE 0x02b54 _REC_CUR_20_u2_u2 65535. _CNV_A_R_LINEAR_____1_CM 0. 65535. DISPLAY_IDENTIFIER ID_ERR_DTC_VLS_UP_PUC_2 FORMAT "%5.0"
 /begin AXIS_DESCR COM_AXIS online_dummy _CNV_A_R_LINEAR_____22_CM 6 0. 5. FORMAT "%2.0" AXIS_PTS_REF ldp_fmy_dtc /end AXIS_DESCR
/end CHARACTERISTIC
/begin CHARACTERISTIC fmy_id_vls_up_puc_2.envd "" CURVE 0x02b60 _REC_CUR_20_u1_u1 255. _CNV_A_R_LINEAR_____1_CM 0. 255. DISPLAY_IDENTIFIER ID_ERR_ENVD_VLS_UP_PUC_2 FORMAT "%3.0"
 /begin AXIS_DESCR COM_AXIS online_dummy _CNV_A_R_LINEAR_____22_CM 4 0. 3. FORMAT "%2.0" AXIS_PTS_REF ldp_fmy_envd /end AXIS_DESCR
/end CHARACTERISTIC
/begin CHARACTERISTIC fmy_id_vls_up_stk_1.dtc "" CURVE 0x02b66 _REC_CUR_20_u2_u2 65535. _CNV_A_R_LINEAR_____1_CM 0. 65535. DISPLAY_IDENTIFIER ID_ERR_DTC_VLS_UP_STK_1 FORMAT "%5.0"
 /begin AXIS_DESCR COM_AXIS online_dummy _CNV_A_R_LINEAR_____22_CM 6 0. 5. FORMAT "%2.0" AXIS_PTS_REF ldp_fmy_dtc /end AXIS_DESCR
/end CHARACTERISTIC
/begin CHARACTERISTIC fmy_id_vls_up_stk_1.envd "" CURVE 0x02b72 _REC_CUR_20_u1_u1 255. _CNV_A_R_LINEAR_____1_CM 0. 255. DISPLAY_IDENTIFIER ID_ERR_ENVD_VLS_UP_STK_1 FORMAT "%3.0"
 /begin AXIS_DESCR COM_AXIS online_dummy _CNV_A_R_LINEAR_____22_CM 4 0. 3. FORMAT "%2.0" AXIS_PTS_REF ldp_fmy_envd /end AXIS_DESCR
/end CHARACTERISTIC
/begin CHARACTERISTIC fmy_id_vls_up_stk_2.dtc "" CURVE 0x02b78 _REC_CUR_20_u2_u2 65535. _CNV_A_R_LINEAR_____1_CM 0. 65535. DISPLAY_IDENTIFIER ID_ERR_DTC_VLS_UP_STK_2 FORMAT "%5.0"
 /begin AXIS_DESCR COM_AXIS online_dummy _CNV_A_R_LINEAR_____22_CM 6 0. 5. FORMAT "%2.0" AXIS_PTS_REF ldp_fmy_dtc /end AXIS_DESCR
/end CHARACTERISTIC
/begin CHARACTERISTIC fmy_id_vls_up_stk_2.envd "" CURVE 0x02b84 _REC_CUR_20_u1_u1 255. _CNV_A_R_LINEAR_____1_CM 0. 255. DISPLAY_IDENTIFIER ID_ERR_ENVD_VLS_UP_STK_2 FORMAT "%3.0"
 /begin AXIS_DESCR COM_AXIS online_dummy _CNV_A_R_LINEAR_____22_CM 4 0. 3. FORMAT "%2.0" AXIS_PTS_REF ldp_fmy_envd /end AXIS_DESCR
/end CHARACTERISTIC
/begin CHARACTERISTIC fmy_id_lam_dly_1.dtc "" CURVE 0x02b8a _REC_CUR_20_u2_u2 65535. _CNV_A_R_LINEAR_____1_CM 0. 65535. DISPLAY_IDENTIFIER ID_ERR_DTC_LAM_DLY_1 FORMAT "%5.0"
 /begin AXIS_DESCR COM_AXIS online_dummy _CNV_A_R_LINEAR_____22_CM 6 0. 5. FORMAT "%2.0" AXIS_PTS_REF ldp_fmy_dtc /end AXIS_DESCR
/end CHARACTERISTIC
/begin CHARACTERISTIC fmy_id_lam_dly_1.envd "" CURVE 0x02b96 _REC_CUR_20_u1_u1 255. _CNV_A_R_LINEAR_____1_CM 0. 255. DISPLAY_IDENTIFIER ID_ERR_ENVD_LAM_DLY_1 FORMAT "%3.0"
 /begin AXIS_DESCR COM_AXIS online_dummy _CNV_A_R_LINEAR_____22_CM 4 0. 3. FORMAT "%2.0" AXIS_PTS_REF ldp_fmy_envd /end AXIS_DESCR
/end CHARACTERISTIC
/begin CHARACTERISTIC fmy_id_lam_dly_2.dtc "" CURVE 0x02b9c _REC_CUR_20_u2_u2 65535. _CNV_A_R_LINEAR_____1_CM 0. 65535. DISPLAY_IDENTIFIER ID_ERR_DTC_LAM_DLY_2 FORMAT "%5.0"
 /begin AXIS_DESCR COM_AXIS online_dummy _CNV_A_R_LINEAR_____22_CM 6 0. 5. FORMAT "%2.0" AXIS_PTS_REF ldp_fmy_dtc /end AXIS_DESCR
/end CHARACTERISTIC
/begin CHARACTERISTIC fmy_id_lam_dly_2.envd "" CURVE 0x02ba8 _REC_CUR_20_u1_u1 255. _CNV_A_R_LINEAR_____1_CM 0. 255. DISPLAY_IDENTIFIER ID_ERR_ENVD_LAM_DLY_2 FORMAT "%3.0"
 /begin AXIS_DESCR COM_AXIS online_dummy _CNV_A_R_LINEAR_____22_CM 4 0. 3. FORMAT "%2.0" AXIS_PTS_REF ldp_fmy_envd /end AXIS_DESCR
/end CHARACTERISTIC
/begin CHARACTERISTIC fmy_id_ls_up_swt_1.dtc "" CURVE 0x02bae _REC_CUR_20_u2_u2 65535. _CNV_A_R_LINEAR_____1_CM 0. 65535. DISPLAY_IDENTIFIER ID_ERR_DTC_LS_UP_SWT_1 FORMAT "%5.0"
 /begin AXIS_DESCR COM_AXIS online_dummy _CNV_A_R_LINEAR_____22_CM 6 0. 5. FORMAT "%2.0" AXIS_PTS_REF ldp_fmy_dtc /end AXIS_DESCR
/end CHARACTERISTIC
/begin CHARACTERISTIC fmy_id_ls_up_swt_1.envd "" CURVE 0x02bba _REC_CUR_20_u1_u1 255. _CNV_A_R_LINEAR_____1_CM 0. 255. DISPLAY_IDENTIFIER ID_ERR_ENVD_LS_UP_SWT_1 FORMAT "%3.0"
 /begin AXIS_DESCR COM_AXIS online_dummy _CNV_A_R_LINEAR_____22_CM 4 0. 3. FORMAT "%2.0" AXIS_PTS_REF ldp_fmy_envd /end AXIS_DESCR
/end CHARACTERISTIC
/begin CHARACTERISTIC fmy_id_ls_up_swt_2.dtc "" CURVE 0x02bc0 _REC_CUR_20_u2_u2 65535. _CNV_A_R_LINEAR_____1_CM 0. 65535. DISPLAY_IDENTIFIER ID_ERR_DTC_LS_UP_SWT_2 FORMAT "%5.0"
 /begin AXIS_DESCR COM_AXIS online_dummy _CNV_A_R_LINEAR_____22_CM 6 0. 5. FORMAT "%2.0" AXIS_PTS_REF ldp_fmy_dtc /end AXIS_DESCR
/end CHARACTERISTIC
/begin CHARACTERISTIC fmy_id_ls_up_swt_2.envd "" CURVE 0x02bcc _REC_CUR_20_u1_u1 255. _CNV_A_R_LINEAR_____1_CM 0. 255. DISPLAY_IDENTIFIER ID_ERR_ENVD_LS_UP_SWT_2 FORMAT "%3.0"
 /begin AXIS_DESCR COM_AXIS online_dummy _CNV_A_R_LINEAR_____22_CM 4 0. 3. FORMAT "%2.0" AXIS_PTS_REF ldp_fmy_envd /end AXIS_DESCR
/end CHARACTERISTIC
/begin CHARACTERISTIC fmy_id_ls_up_frq_1.dtc "" CURVE 0x02bd2 _REC_CUR_20_u2_u2 65535. _CNV_A_R_LINEAR_____1_CM 0. 65535. DISPLAY_IDENTIFIER ID_ERR_DTC_LS_UP_FRQ_1 FORMAT "%5.0"
 /begin AXIS_DESCR COM_AXIS online_dummy _CNV_A_R_LINEAR_____22_CM 6 0. 5. FORMAT "%2.0" AXIS_PTS_REF ldp_fmy_dtc /end AXIS_DESCR
/end CHARACTERISTIC
/begin CHARACTERISTIC fmy_id_ls_up_frq_1.envd "" CURVE 0x02bde _REC_CUR_20_u1_u1 255. _CNV_A_R_LINEAR_____1_CM 0. 255. DISPLAY_IDENTIFIER ID_ERR_ENVD_LS_UP_FRQ_1 FORMAT "%3.0"
 /begin AXIS_DESCR COM_AXIS online_dummy _CNV_A_R_LINEAR_____22_CM 4 0. 3. FORMAT "%2.0" AXIS_PTS_REF ldp_fmy_envd /end AXIS_DESCR
/end CHARACTERISTIC
/begin CHARACTERISTIC fmy_id_ls_up_frq_2.dtc "" CURVE 0x02be4 _REC_CUR_20_u2_u2 65535. _CNV_A_R_LINEAR_____1_CM 0. 65535. DISPLAY_IDENTIFIER ID_ERR_DTC_LS_UP_FRQ_2 FORMAT "%5.0"
 /begin AXIS_DESCR COM_AXIS online_dummy _CNV_A_R_LINEAR_____22_CM 6 0. 5. FORMAT "%2.0" AXIS_PTS_REF ldp_fmy_dtc /end AXIS_DESCR
/end CHARACTERISTIC
/begin CHARACTERISTIC fmy_id_ls_up_frq_2.envd "" CURVE 0x02bf0 _REC_CUR_20_u1_u1 255. _CNV_A_R_LINEAR_____1_CM 0. 255. DISPLAY_IDENTIFIER ID_ERR_ENVD_LS_UP_FRQ_2 FORMAT "%3.0"
 /begin AXIS_DESCR COM_AXIS online_dummy _CNV_A_R_LINEAR_____22_CM 4 0. 3. FORMAT "%2.0" AXIS_PTS_REF ldp_fmy_envd /end AXIS_DESCR
/end CHARACTERISTIC
/begin MEASUREMENT fmy_ram_dyn[0].dtc_cod "" UWORD _CNV_A_R_LINEAR_____22_CM 1 100. 0. 65535. DISPLAY_IDENTIFIER DTC_COD_0 ECU_ADDRESS 0x3fb7a0 BYTE_ORDER MSB_LAST FORMAT "%6.0" /end MEASUREMENT
/begin MEASUREMENT fmy_ram_dyn[0].err_info_dyn.bit_0_3 "" UWORD _CNV_S_6_RANGE_ERR__383_CM 1 100. 0. 15. DISPLAY_IDENTIFIER ERR_SYM_MEM_0 ECU_ADDRESS 0x3fb7a4 BYTE_ORDER MSB_LAST BIT_MASK 0xF /end MEASUREMENT
/begin MEASUREMENT fmy_ram_dyn[1].dtc_cod "" UWORD _CNV_A_R_LINEAR_____22_CM 1 100. 0. 65535. DISPLAY_IDENTIFIER DTC_COD_1 ECU_ADDRESS 0x3fb7aa BYTE_ORDER MSB_LAST FORMAT "%6.0" /end MEASUREMENT
/begin MEASUREMENT fmy_ram_dyn[1].err_info_dyn.bit_0_3 "" UWORD _CNV_S_6_RANGE_ERR__383_CM 1 100. 0. 15. DISPLAY_IDENTIFIER ERR_SYM_MEM_1 ECU_ADDRESS 0x3fb7ae BYTE_ORDER MSB_LAST BIT_MASK 0xF /end MEASUREMENT
/begin MEASUREMENT fmy_ram_dyn[2].dtc_cod "" UWORD _CNV_A_R_LINEAR_____22_CM 1 100. 0. 65535. DISPLAY_IDENTIFIER DTC_COD_2 ECU_ADDRESS 0x3fb7b4 BYTE_ORDER MSB_LAST FORMAT "%6.0" /end MEASUREMENT
/begin MEASUREMENT fmy_ram_dyn[2].err_info_dyn.bit_0_3 "" UWORD _CNV_S_6_RANGE_ERR__383_CM 1 100. 0. 15. DISPLAY_IDENTIFIER ERR_SYM_MEM_2 ECU_ADDRESS 0x3fb7b8 BYTE_ORDER MSB_LAST BIT_MASK 0xF /end MEASUREMENT
/begin MEASUREMENT fmy_ram_dyn[3].dtc_cod "" UWORD _CNV_A_R_LINEAR_____22_CM 1 100. 0. 65535. DISPLAY_IDENTIFIER DTC_COD_3 ECU_ADDRESS 0x3fb7be BYTE_ORDER MSB_LAST FORMAT "%6.0" /end MEASUREMENT
/begin MEASUREMENT fmy_ram_dyn[3].err_info_dyn.bit_0_3 "" UWORD _CNV_S_6_RANGE_ERR__383_CM 1 100. 0. 15. DISPLAY_IDENTIFIER ERR_SYM_MEM_3 ECU_ADDRESS 0x3fb7c2 BYTE_ORDER MSB_LAST BIT_MASK 0xF /end MEASUREMENT
/begin MEASUREMENT fmy_ram_dyn[4].dtc_cod "" UWORD _CNV_A_R_LINEAR_____22_CM 1 100. 0. 65535. DISPLAY_IDENTIFIER DTC_COD_4 ECU_ADDRESS 0x3fb7c8 BYTE_ORDER MSB_LAST FORMAT "%6.0" /end MEASUREMENT
/begin MEASUREMENT fmy_ram_dyn[4].err_info_dyn.bit_0_3 "" UWORD _CNV_S_6_RANGE_ERR__383_CM 1 100. 0. 15. DISPLAY_IDENTIFIER ERR_SYM_MEM_4 ECU_ADDRESS 0x3fb7cc BYTE_ORDER MSB_LAST BIT_MASK 0xF /end MEASUREMENT
/begin MEASUREMENT fmy_ram_dyn[5].dtc_cod "" UWORD _CNV_A_R_LINEAR_____22_CM 1 100. 0. 65535. DISPLAY_IDENTIFIER DTC_COD_5 ECU_ADDRESS 0x3fb7d2 BYTE_ORDER MSB_LAST FORMAT "%6.0" /end MEASUREMENT
/begin MEASUREMENT fmy_ram_dyn[5].err_info_dyn.bit_0_3 "" UWORD _CNV_S_6_RANGE_ERR__383_CM 1 100. 0. 15. DISPLAY_IDENTIFIER ERR_SYM_MEM_5 ECU_ADDRESS 0x3fb7d6 BYTE_ORDER MSB_LAST BIT_MASK 0xF /end MEASUREMENT
/begin MEASUREMENT fmy_ram_dyn[6].dtc_cod "" UWORD _CNV_A_R_LINEAR_____22_CM 1 100. 0. 65535. DISPLAY_IDENTIFIER DTC_COD_6 ECU_ADDRESS 0x3fb7dc BYTE_ORDER MSB_LAST FORMAT "%6.0" /end MEASUREMENT
/begin MEASUREMENT fmy_ram_dyn[6].err_info_dyn.bit_0_3 "" UWORD _CNV_S_6_RANGE_ERR__383_CM 1 100. 0. 15. DISPLAY_IDENTIFIER ERR_SYM_MEM_6 ECU_ADDRESS 0x3fb7e0 BYTE_ORDER MSB_LAST BIT_MASK 0xF /end MEASUREMENT
/begin MEASUREMENT fmy_ram_dyn[7].dtc_cod "" UWORD _CNV_A_R_LINEAR_____22_CM 1 100. 0. 65535. DISPLAY_IDENTIFIER DTC_COD_7 ECU_ADDRESS 0x3fb7e6 BYTE_ORDER MSB_LAST FORMAT "%6.0" /end MEASUREMENT
/begin MEASUREMENT fmy_ram_dyn[7].err_info_dyn.bit_0_3 "" UWORD _CNV_S_6_RANGE_ERR__383_CM 1 100. 0. 15. DISPLAY_IDENTIFIER ERR_SYM_MEM_7 ECU_ADDRESS 0x3fb7ea BYTE_ORDER MSB_LAST BIT_MASK 0xF /end MEASUREMENT
/begin MEASUREMENT fmy_ram_dyn[8].dtc_cod "" UWORD _CNV_A_R_LINEAR_____22_CM 1 100. 0. 65535. DISPLAY_IDENTIFIER DTC_COD_8 ECU_ADDRESS 0x3fb7f0 BYTE_ORDER MSB_LAST FORMAT "%6.0" /end MEASUREMENT
/begin MEASUREMENT fmy_ram_dyn[8].err_info_dyn.bit_0_3 "" UWORD _CNV_S_6_RANGE_ERR__383_CM 1 100. 0. 15. DISPLAY_IDENTIFIER ERR_SYM_MEM_8 ECU_ADDRESS 0x3fb7f4 BYTE_ORDER MSB_LAST BIT_MASK 0xF /end MEASUREMENT
/begin MEASUREMENT fmy_ram_dyn[9].dtc_cod "" UWORD _CNV_A_R_LINEAR_____22_CM 1 100. 0. 65535. DISPLAY_IDENTIFIER DTC_COD_9 ECU_ADDRESS 0x3fb7fa BYTE_ORDER MSB_LAST FORMAT "%6.0" /end MEASUREMENT
/begin MEASUREMENT fmy_ram_dyn[9].err_info_dyn.bit_0_3 "" UWORD _CNV_S_6_RANGE_ERR__383_CM 1 100. 0. 15. DISPLAY_IDENTIFIER ERR_SYM_MEM_9 ECU_ADDRESS 0x3fb7fe BYTE_ORDER MSB_LAST BIT_MASK 0xF /end MEASUREMENT
/begin CHARACTERISTIC id_err_dtc_mis "DTC table declaration for diagnosis misfiring" MAP 0x082d0 _REC_MAP_20_u2_u2_u2 65535. _CNV_A_R_LINEAR_____1_CM 0. 65535. DISPLAY_IDENTIFIER ID_ERR_DTC_MIS FORMAT "%5.0"
 /begin AXIS_DESCR COM_AXIS online_dummy _CNV_A_R_LINEAR_____1_CM 2 0. 65535. FORMAT "%5.0" AXIS_PTS_REF ldp_1_id_err_dtc_mis /end AXIS_DESCR
 /begin AXIS_DESCR COM_AXIS online_dummy _CNV_A_R_LINEAR_____1_CM 8 0. 65535. FORMAT "%5.0" AXIS_PTS_REF ldp_2_id_err_dtc_mis /end AXIS_DESCR
/end CHARACTERISTIC
/begin AXIS_PTS ldp_2_id_err_dtc_mis "" 0x1086a online_dummy _REC_AXS_20_u2 65535. _CNV_A_R_LINEAR_____1_CM 8 0. 65535. DISPLAY_IDENTIFIER LDP_2_ID_ERR_DTC_MIS FORMAT "%5.0" /end AXIS_PTS
/begin AXIS_PTS ldp_1_id_err_dtc_mis "" 0x01b8c online_dummy _REC_AXS_20_u2 65535. _CNV_A_R_LINEAR_____1_CM 2 0. 65535. DISPLAY_IDENTIFIER LDP_1_ID_ERR_DTC_MIS FORMAT "%5.0" /end AXIS_PTS
/begin AXIS_PTS ldp_fmy_dtc "" 0x10ade online_dummy _REC_AXS_20_u2 5. _CNV_A_R_LINEAR_____22_CM 6 0. 5. DISPLAY_IDENTIFIER LDP_FMY_DTC FORMAT "%2.0" /end AXIS_PTS
/begin AXIS_PTS ldp_fmy_envd "" 0x00fbe online_dummy _REC_AXS_20_u1 3. _CNV_A_R_LINEAR_____22_CM 4 0. 3. DISPLAY_IDENTIFIER LDP_FMY_ENVD FORMAT "%2.0" /end AXIS_PTS
/begin COMPU_METHOD _CNV_A_R_LINEAR_____1_CM "" RAT_FUNC "%6.3" "-" COEFFS 0 1. 0. 0 0 1 /end COMPU_METHOD
/begin COMPU_METHOD _CNV_A_R_LINEAR_____22_CM "" RAT_FUNC "%6.3" "[-]" COEFFS 0 1. 0. 0 0 1 /end COMPU_METHOD
/begin COMPU_METHOD _CNV_S_6_RANGE_ERR__383_CM "" TAB_VERB "%6.3" "[-]" COMPU_TAB_REF _CNV_S_6_RANGE_ERR__383 /end COMPU_METHOD
/begin COMPU_VTAB _CNV_S_6_RANGE_ERR__383 "" TAB_VERB 6 0 "NO_SYM" 1 "SYM_0" 2 "SYM_1" 4 "SYM_2" 8 "SYM_3" 15 "BENCH_MODE" /end COMPU_VTAB
/begin RECORD_LAYOUT _REC_AXS_20_u1 NO_AXIS_PTS_X 1 UBYTE AXIS_PTS_X 2 UBYTE INDEX_INCR DIRECT /end RECORD_LAYOUT
/begin RECORD_LAYOUT _REC_CUR_20_u1_u1 FNC_VALUES 1 UBYTE COLUMN_DIR DIRECT /end RECORD_LAYOUT
/begin RECORD_LAYOUT _REC_AXS_20_u2 NO_AXIS_PTS_X 1 UWORD AXIS_PTS_X 2 UWORD INDEX_INCR DIRECT /end RECORD_LAYOUT
/begin RECORD_LAYOUT _REC_CUR_20_u2_u2 FNC_VALUES 1 UWORD COLUMN_DIR DIRECT /end RECORD_LAYOUT
/begin RECORD_LAYOUT _REC_MAP_20_u2_u2_u2 FNC_VALUES 1 UWORD COLUMN_DIR DIRECT /end RECORD_LAYOUT
/begin FUNCTION OBD_Environmental_Data "_Environmental Data"
 /begin DEF_CHARACTERISTIC fmy_id_toil.envd fmy_id_tco_ex.envd fmy_id_tia.envd fmy_id_amp.envd fmy_id_maf.envd fmy_id_vls_down_max_1.envd fmy_id_vls_down_max_2.envd fmy_id_vls_down_min_cold_1.envd fmy_id_vls_down_min_cold_2.envd fmy_id_vls_down_min_1.envd fmy_id_vls_down_min_2.envd fmy_id_vls_down_oc_1.envd fmy_id_vls_down_oc_2.envd fmy_id_iv_0.envd fmy_id_iv_1.envd fmy_id_iv_2.envd fmy_id_iv_3.envd fmy_id_iv_4.envd fmy_id_iv_5.envd fmy_id_lsh_up_1.envd fmy_id_lsh_up_2.envd fmy_id_lsh_down_1.envd fmy_id_lsh_down_2.envd fmy_id_rly_efp.envd fmy_id_cps.envd fmy_id_mec_ivvt_in_1.envd fmy_id_mec_ivvt_ex_1.envd fmy_id_ref_ivvt_in_1.envd fmy_id_ref_ivvt_ex_1.envd fmy_id_slv_ivvt_in_1.envd fmy_id_slv_ivvt_ex_1.envd fmy_id_park_ivvt_in_1.envd fmy_id_park_ivvt_ex_1.envd fmy_id_ecu_cks.envd fmy_id_toil_level.envd fmy_id_tout_etcu_1.envd fmy_id_tout_etcu_2.envd fmy_id_tout_icl_2.envd fmy_id_tout_icl_3.envd fmy_id_tout_asr_1.envd fmy_id_tout_asr_3.envd fmy_id_tout_asr_4.envd fmy_id_tout_pste_1.envd fmy_id_tout_amt_1.envd fmy_id_vs.envd fmy_id_knks_1.envd fmy_id_knks_2.envd fmy_id_td_igc_cut_0.envd fmy_id_td_igc_cut_1.envd fmy_id_td_igc_cut_2.envd fmy_id_td_igc_cut_3.envd fmy_id_td_igc_cut_4.envd fmy_id_td_igc_cut_5.envd fmy_id_dur_igc_0.envd fmy_id_dur_igc_1.envd fmy_id_dur_igc_2.envd fmy_id_dur_igc_3.envd fmy_id_dur_igc_4.envd fmy_id_dur_igc_5.envd fmy_id_tps_1.envd fmy_id_tps_2.envd fmy_id_tps_maf_1.envd fmy_id_tps_maf_2.envd fmy_id_v_ref_1.envd fmy_id_v_ref_2.envd fmy_id_pvs_1.envd fmy_id_pvs_2.envd fmy_id_pvs_ratio.envd fmy_id_pvs_double.envd fmy_id_pvs_bls_not_plaus.envd fmy_id_mtc_dr.envd fmy_id_mtc_ctl_1.envd fmy_id_mtc_ctl_2.envd fmy_id_mtc_ctl_3.envd fmy_id_tps_ad.envd fmy_id_tps_ad_bol.envd fmy_id_tps_st_chk_1.envd fmy_id_tps_st_chk_2.envd fmy_id_gen.envd fmy_id_gen_if.envd fmy_id_gen_diag.envd fmy_id_vim.envd fmy_id_cam_per_0.envd fmy_id_cam_per_1.envd fmy_id_cam_psn_0.envd fmy_id_cam_psn_1.envd fmy_id_cam_0_not_plaus.envd fmy_id_cam_1_not_plaus.envd fmy_id_eng_psn.envd fmy_id_tooth_per.envd fmy_id_tpu_syn.envd fmy_id_crk_not_plaus.envd fmy_id_tout_txu_1.envd fmy_id_can_boff.envd fmy_id_rly_main.envd fmy_id_rly_main_dly.envd fmy_id_rly_accout.envd fmy_id_sap.envd fmy_id_sav.envd fmy_id_ecf.envd fmy_id_tco_plaus.envd fmy_id_tco_el.envd fmy_id_tco_grd.envd fmy_id_tco_stuck.envd fmy_id_ect_el.envd fmy_id_ect_mec.envd fmy_id_isc.envd fmy_id_im_bls_plaus.envd fmy_id_im_bts_plaus.envd fmy_id_msw_tog.envd fmy_id_msw_2.envd fmy_id_msw_3.envd fmy_id_isa_1.envd fmy_id_isa_2.envd fmy_id_seg_t_ad.envd fmy_id_seg_t.envd fmy_id_mis_0.envd fmy_id_mis_1.envd fmy_id_mis_2.envd fmy_id_mis_3.envd fmy_id_mis_4.envd fmy_id_mis_5.envd fmy_id_mis_low_fuel.envd fmy_id_mis_mpl.envd fmy_id_conv_mon_1.envd fmy_id_n_32_mon_1.envd fmy_id_pvs_mon_1.envd fmy_id_maf_tps_mon_1.envd fmy_id_tq_dif_isc_mon_1.envd fmy_id_tq_req_mon_1.envd fmy_id_tq_ext_mon_1.envd fmy_id_tqi_av_mon_1.envd fmy_id_tqi_n_max_mon_1.envd fmy_id_cru_inh_mon_1.envd fmy_id_tqi_n_max_nvmy_mon.envd fmy_id_sa_safm.envd fmy_id_sa_sap.envd fmy_id_sa_sys.envd fmy_id_sa_sav.envd fmy_id_imob_1.envd fmy_id_imob_2.envd fmy_id_imob_3.envd fmy_id_fsd_1.envd fmy_id_fsd_2.envd fmy_id_ls_down_swt_1.envd fmy_id_ls_down_swt_2.envd fmy_id_ls_down_pue_1.envd fmy_id_ls_down_pue_2.envd fmy_id_ef.envd fmy_id_tecu.envd fmy_id_ebox_cfa.envd fmy_id_ecu_ram.envd fmy_id_tqi_lim.envd fmy_id_obd2_lsh_down_1.envd fmy_id_obd2_lsh_down_2.envd fmy_id_dmtls.envd fmy_id_dmtl_pump.envd fmy_id_dmtlm.envd fmy_id_dmtl_leak.envd fmy_id_sof.envd fmy_id_sof_req.envd fmy_id_rly_st.envd fmy_id_bsd.envd fmy_id_poil_swi.envd fmy_id_tout_efp.envd fmy_id_diagcps.envd fmy_id_tq_gs_inc_plaus.envd fmy_id_dcc.envd fmy_id_ecras.envd fmy_id_dmtlh.envd fmy_id_cs.envd fmy_id_spi_mps.envd fmy_id_spi_knk.envd fmy_id_bn_tq_dcc.envd fmy_id_bn_tq_pste_2.envd fmy_id_bn_ars.envd fmy_id_bn_cas.envd fmy_id_bn_tq_tcs.envd fmy_id_bn_vs_tcs.envd fmy_id_bn_tcs.envd fmy_id_bn_tq_etcu.envd fmy_id_bn_etcu.envd fmy_id_bn_tq_amt.envd fmy_id_bn_acc.envd fmy_id_bn_t_icl.envd fmy_id_bn_veh_mod.envd fmy_id_bn_km_icl.envd fmy_id_bn_icl.envd fmy_id_bn_pow_vb.envd fmy_id_bn_pow_gen.envd fmy_id_bn_msw.envd fmy_id_bn_ang_pste.envd fmy_id_bn_efp.envd fmy_id_load_tps_plaus.envd fmy_id_efp_crash.envd fmy_id_efp.envd fmy_id_locan_boff.envd fmy_id_chg_ls_up.envd fmy_id_chg_ls_down.envd fmy_id_qoil_sens.envd fmy_id_bat_sens.envd fmy_id_bat_sens_it.envd fmy_id_bat_sens_it_el.envd fmy_id_ecu_nvmy.envd fmy_id_gs.envd fmy_id_obd2_lsh_up_1.envd fmy_id_obd2_lsh_up_2.envd fmy_id_cat_diag_1.envd fmy_id_cat_diag_2.envd fmy_id_chk_ls_down_1.envd fmy_id_chk_ls_down_2.envd fmy_id_vls_up_min_cold_1.envd fmy_id_vls_up_min_cold_2.envd fmy_id_vls_up_min_1.envd fmy_id_vls_up_min_2.envd fmy_id_vls_up_max_1.envd fmy_id_vls_up_max_2.envd fmy_id_vls_up_oc_1.envd fmy_id_vls_up_oc_2.envd fmy_id_vls_up_puc_1.envd fmy_id_vls_up_puc_2.envd fmy_id_vls_up_stk_1.envd fmy_id_vls_up_stk_2.envd fmy_id_lam_dly_1.envd fmy_id_lam_dly_2.envd fmy_id_ls_up_swt_1.envd fmy_id_ls_up_swt_2.envd fmy_id_ls_up_frq_1.envd fmy_id_ls_up_frq_2.envd /end DEF_CHARACTERISTIC
/end FUNCTION
/begin FUNCTION OBD_Diagnostic_Trouble_Code "_Diagnostic Trouble Code"
 /begin DEF_CHARACTERISTIC fmy_id_toil.dtc fmy_id_tco_ex.dtc fmy_id_tia.dtc fmy_id_amp.dtc fmy_id_maf.dtc fmy_id_vls_down_max_1.dtc fmy_id_vls_down_max_2.dtc fmy_id_vls_down_min_cold_1.dtc fmy_id_vls_down_min_cold_2.dtc fmy_id_vls_down_min_1.dtc fmy_id_vls_down_min_2.dtc fmy_id_vls_down_oc_1.dtc fmy_id_vls_down_oc_2.dtc fmy_id_iv_0.dtc fmy_id_iv_1.dtc fmy_id_iv_2.dtc fmy_id_iv_3.dtc fmy_id_iv_4.dtc fmy_id_iv_5.dtc fmy_id_lsh_up_1.dtc fmy_id_lsh_up_2.dtc fmy_id_lsh_down_1.dtc fmy_id_lsh_down_2.dtc fmy_id_rly_efp.dtc fmy_id_cps.dtc fmy_id_mec_ivvt_in_1.dtc fmy_id_mec_ivvt_ex_1.dtc fmy_id_ref_ivvt_in_1.dtc fmy_id_ref_ivvt_ex_1.dtc fmy_id_slv_ivvt_in_1.dtc fmy_id_slv_ivvt_ex_1.dtc fmy_id_park_ivvt_in_1.dtc fmy_id_park_ivvt_ex_1.dtc fmy_id_ecu_cks.dtc fmy_id_toil_level.dtc fmy_id_tout_etcu_1.dtc fmy_id_tout_etcu_2.dtc fmy_id_tout_icl_2.dtc fmy_id_tout_icl_3.dtc fmy_id_tout_asr_1.dtc fmy_id_tout_asr_3.dtc fmy_id_tout_asr_4.dtc fmy_id_tout_pste_1.dtc fmy_id_tout_amt_1.dtc fmy_id_vs.dtc fmy_id_knks_1.dtc fmy_id_knks_2.dtc fmy_id_td_igc_cut_0.dtc fmy_id_td_igc_cut_1.dtc fmy_id_td_igc_cut_2.dtc fmy_id_td_igc_cut_3.dtc fmy_id_td_igc_cut_4.dtc fmy_id_td_igc_cut_5.dtc fmy_id_dur_igc_0.dtc fmy_id_dur_igc_1.dtc fmy_id_dur_igc_2.dtc fmy_id_dur_igc_3.dtc fmy_id_dur_igc_4.dtc fmy_id_dur_igc_5.dtc fmy_id_tps_1.dtc fmy_id_tps_2.dtc fmy_id_tps_maf_1.dtc fmy_id_tps_maf_2.dtc fmy_id_v_ref_1.dtc fmy_id_v_ref_2.dtc fmy_id_pvs_1.dtc fmy_id_pvs_2.dtc fmy_id_pvs_ratio.dtc fmy_id_pvs_double.dtc fmy_id_pvs_bls_not_plaus.dtc fmy_id_mtc_dr.dtc fmy_id_mtc_ctl_1.dtc fmy_id_mtc_ctl_2.dtc fmy_id_mtc_ctl_3.dtc fmy_id_tps_ad.dtc fmy_id_tps_ad_bol.dtc fmy_id_tps_st_chk_1.dtc fmy_id_tps_st_chk_2.dtc fmy_id_gen.dtc fmy_id_gen_if.dtc fmy_id_gen_diag.dtc fmy_id_vim.dtc fmy_id_cam_per_0.dtc fmy_id_cam_per_1.dtc fmy_id_cam_psn_0.dtc fmy_id_cam_psn_1.dtc fmy_id_cam_0_not_plaus.dtc fmy_id_cam_1_not_plaus.dtc fmy_id_eng_psn.dtc fmy_id_tooth_per.dtc fmy_id_tpu_syn.dtc fmy_id_crk_not_plaus.dtc fmy_id_tout_txu_1.dtc fmy_id_can_boff.dtc fmy_id_rly_main.dtc fmy_id_rly_main_dly.dtc fmy_id_rly_accout.dtc fmy_id_sap.dtc fmy_id_sav.dtc fmy_id_ecf.dtc fmy_id_tco_plaus.dtc fmy_id_tco_el.dtc fmy_id_tco_grd.dtc fmy_id_tco_stuck.dtc fmy_id_ect_el.dtc fmy_id_ect_mec.dtc fmy_id_isc.dtc fmy_id_im_bls_plaus.dtc fmy_id_im_bts_plaus.dtc fmy_id_msw_tog.dtc fmy_id_msw_2.dtc fmy_id_msw_3.dtc fmy_id_isa_1.dtc fmy_id_isa_2.dtc fmy_id_seg_t_ad.dtc fmy_id_seg_t.dtc fmy_id_mis_0.dtc fmy_id_mis_1.dtc fmy_id_mis_2.dtc fmy_id_mis_3.dtc fmy_id_mis_4.dtc fmy_id_mis_5.dtc fmy_id_mis_low_fuel.dtc fmy_id_mis_mpl.dtc fmy_id_conv_mon_1.dtc fmy_id_n_32_mon_1.dtc fmy_id_pvs_mon_1.dtc fmy_id_maf_tps_mon_1.dtc fmy_id_tq_dif_isc_mon_1.dtc fmy_id_tq_req_mon_1.dtc fmy_id_tq_ext_mon_1.dtc fmy_id_tqi_av_mon_1.dtc fmy_id_tqi_n_max_mon_1.dtc fmy_id_cru_inh_mon_1.dtc fmy_id_tqi_n_max_nvmy_mon.dtc fmy_id_sa_safm.dtc fmy_id_sa_sap.dtc fmy_id_sa_sys.dtc fmy_id_sa_sav.dtc fmy_id_imob_1.dtc fmy_id_imob_2.dtc fmy_id_imob_3.dtc fmy_id_fsd_1.dtc fmy_id_fsd_2.dtc fmy_id_ls_down_swt_1.dtc fmy_id_ls_down_swt_2.dtc fmy_id_ls_down_pue_1.dtc fmy_id_ls_down_pue_2.dtc fmy_id_ef.dtc fmy_id_tecu.dtc fmy_id_ebox_cfa.dtc fmy_id_ecu_ram.dtc fmy_id_tqi_lim.dtc fmy_id_obd2_lsh_down_1.dtc fmy_id_obd2_lsh_down_2.dtc fmy_id_dmtls.dtc fmy_id_dmtl_pump.dtc fmy_id_dmtlm.dtc fmy_id_dmtl_leak.dtc fmy_id_sof.dtc fmy_id_sof_req.dtc fmy_id_rly_st.dtc fmy_id_bsd.dtc fmy_id_poil_swi.dtc fmy_id_tout_efp.dtc fmy_id_diagcps.dtc fmy_id_tq_gs_inc_plaus.dtc fmy_id_dcc.dtc fmy_id_ecras.dtc fmy_id_dmtlh.dtc fmy_id_cs.dtc fmy_id_spi_mps.dtc fmy_id_spi_knk.dtc fmy_id_bn_tq_dcc.dtc fmy_id_bn_tq_pste_2.dtc fmy_id_bn_ars.dtc fmy_id_bn_cas.dtc fmy_id_bn_tq_tcs.dtc fmy_id_bn_vs_tcs.dtc fmy_id_bn_tcs.dtc fmy_id_bn_tq_etcu.dtc fmy_id_bn_etcu.dtc fmy_id_bn_tq_amt.dtc fmy_id_bn_acc.dtc fmy_id_bn_t_icl.dtc fmy_id_bn_veh_mod.dtc fmy_id_bn_km_icl.dtc fmy_id_bn_icl.dtc fmy_id_bn_pow_vb.dtc fmy_id_bn_pow_gen.dtc fmy_id_bn_msw.dtc fmy_id_bn_ang_pste.dtc fmy_id_bn_efp.dtc fmy_id_load_tps_plaus.dtc fmy_id_efp_crash.dtc fmy_id_efp.dtc fmy_id_locan_boff.dtc fmy_id_chg_ls_up.dtc fmy_id_chg_ls_down.dtc fmy_id_qoil_sens.dtc fmy_id_bat_sens.dtc fmy_id_bat_sens_it.dtc fmy_id_bat_sens_it_el.dtc fmy_id_ecu_nvmy.dtc fmy_id_gs.dtc fmy_id_obd2_lsh_up_1.dtc fmy_id_obd2_lsh_up_2.dtc fmy_id_cat_diag_1.dtc fmy_id_cat_diag_2.dtc fmy_id_chk_ls_down_1.dtc fmy_id_chk_ls_down_2.dtc fmy_id_vls_up_min_cold_1.dtc fmy_id_vls_up_min_cold_2.dtc fmy_id_vls_up_min_1.dtc fmy_id_vls_up_min_2.dtc fmy_id_vls_up_max_1.dtc fmy_id_vls_up_max_2.dtc fmy_id_vls_up_oc_1.dtc fmy_id_vls_up_oc_2.dtc fmy_id_vls_up_puc_1.dtc fmy_id_vls_up_puc_2.dtc fmy_id_vls_up_stk_1.dtc fmy_id_vls_up_stk_2.dtc fmy_id_lam_dly_1.dtc fmy_id_lam_dly_2.dtc fmy_id_ls_up_swt_1.dtc fmy_id_ls_up_swt_2.dtc fmy_id_ls_up_frq_1.dtc fmy_id_ls_up_frq_2.dtc id_err_dtc_mis /end DEF_CHARACTERISTIC
 /begin OUT_MEASUREMENT fmy_ram_dyn[0].dtc_cod fmy_ram_dyn[0].err_info_dyn.bit_0_3 fmy_ram_dyn[1].dtc_cod fmy_ram_dyn[1].err_info_dyn.bit_0_3 fmy_ram_dyn[2].dtc_cod fmy_ram_dyn[2].err_info_dyn.bit_0_3 fmy_ram_dyn[3].dtc_cod fmy_ram_dyn[3].err_info_dyn.bit_0_3 fmy_ram_dyn[4].dtc_cod fmy_ram_dyn[4].err_info_dyn.bit_0_3 fmy_ram_dyn[5].dtc_cod fmy_ram_dyn[5].err_info_dyn.bit_0_3 fmy_ram_dyn[6].dtc_cod fmy_ram_dyn[6].err_info_dyn.bit_0_3 fmy_ram_dyn[7].dtc_cod fmy_ram_dyn[7].err_info_dyn.bit_0_3 fmy_ram_dyn[8].dtc_cod fmy_ram_dyn[8].err_info_dyn.bit_0_3 fmy_ram_dyn[9].dtc_cod fmy_ram_dyn[9].err_info_dyn.bit_0_3 /end OUT_MEASUREMENT
/end FUNCTION
/end MODULE
/end PROJECT
