ASAP2_VERSION 1 3
/begin PROJECT P390 "BMW DDE6.2 6-Zylinder VR0.1 15.03.2004 CAN11/12H"
/begin HEADER "" VERSION "VR0.1_6Z_CAN11/12H" PROJECT_NO P390 /end HEADER
/begin MODULE DIM ""
/begin MOD_COMMON "" BYTE_ORDER MSB_FIRST ALIGNMENT_BYTE 1 ALIGNMENT_WORD 2 ALIGNMENT_LONG 4 ALIGNMENT_FLOAT32_IEEE 4 /end MOD_COMMON
/begin CHARACTERISTIC DSM_EnvDfp_Layer_TANS_C "Fehlerpfad spezifische Umweltbedingungen fuer Fehlerpfad Dfp_Layer_TANS" VAL_BLK 0xCB28F Kwb_Wu8 255.000000000 SigName 0.00 255.000000000 FORMAT "%13.9" NUMBER 10 /end CHARACTERISTIC
/begin CHARACTERISTIC DSM_EnvDfp_ACCDCmpr_C "Fehlerpfad spezifische Umweltbedingungen fuer Fehlerpfad Dfp_ACCDCmpr" VAL_BLK 0xCB299 Kwb_Wu8 255.000000000 SigName 0.00 255.000000000 FORMAT "%13.9" NUMBER 10 /end CHARACTERISTIC
/begin CHARACTERISTIC DSM_EnvDfp_ACCDPres_C "Fehlerpfad spezifische Umweltbedingungen fuer Fehlerpfad Dfp_ACCDPres" VAL_BLK 0xCB2A3 Kwb_Wu8 255.000000000 SigName 0.00 255.000000000 FORMAT "%13.9" NUMBER 10 /end CHARACTERISTIC
/begin CHARACTERISTIC DSM_EnvDfp_ACCDPres1_C "Fehlerpfad spezifische Umweltbedingungen fuer Fehlerpfad Dfp_ACCDPres1" VAL_BLK 0xCB2AD Kwb_Wu8 255.000000000 SigName 0.00 255.000000000 FORMAT "%13.9" NUMBER 10 /end CHARACTERISTIC
/begin CHARACTERISTIC DSM_EnvDfp_ACCDPresAna_C "Fehlerpfad spezifische Umweltbedingungen fuer Fehlerpfad Dfp_ACCDPresAna" VAL_BLK 0xCB2B7 Kwb_Wu8 255.000000000 SigName 0.00 255.000000000 FORMAT "%13.9" NUMBER 10 /end CHARACTERISTIC
/begin CHARACTERISTIC DSM_EnvDfp_ACCDSwtin_C "Fehlerpfad spezifische Umweltbedingungen fuer Fehlerpfad Dfp_ACCDSwtin" VAL_BLK 0xCB2C1 Kwb_Wu8 255.000000000 SigName 0.00 255.000000000 FORMAT "%13.9" NUMBER 10 /end CHARACTERISTIC
/begin CHARACTERISTIC DSM_EnvDfp_ACC_PlausTrqDes_C "Fehlerpfad spezifische Umweltbedingungen fuer Fehlerpfad Dfp_ACC_PlausTrqDes" VAL_BLK 0xCB2CB Kwb_Wu8 255.000000000 SigName 0.00 255.000000000 FORMAT "%13.9" NUMBER 10 /end CHARACTERISTIC
/begin CHARACTERISTIC DSM_EnvDfp_ACC_trqInr_C "Fehlerpfad spezifische Umweltbedingungen fuer Fehlerpfad Dfp_ACC_trqInr" VAL_BLK 0xCB2D5 Kwb_Wu8 255.000000000 SigName 0.00 255.000000000 FORMAT "%13.9" NUMBER 10 /end CHARACTERISTIC
/begin CHARACTERISTIC DSM_EnvDfp_ACTrq_C "Fehlerpfad spezifische Umweltbedingungen fuer Fehlerpfad Dfp_ACTrq" VAL_BLK 0xCB2DF Kwb_Wu8 255.000000000 SigName 0.00 255.000000000 FORMAT "%13.9" NUMBER 10 /end CHARACTERISTIC
/begin CHARACTERISTIC DSM_EnvDfp_ADCMon_C "Fehlerpfad spezifische Umweltbedingungen fuer Fehlerpfad Dfp_ADCMon" VAL_BLK 0xCB2E9 Kwb_Wu8 255.000000000 SigName 0.00 255.000000000 FORMAT "%13.9" NUMBER 10 /end CHARACTERISTIC
/begin CHARACTERISTIC DSM_EnvDfp_AFSCDIdlAdjVal_C "Fehlerpfad spezifische Umweltbedingungen fuer Fehlerpfad Dfp_AFSCDIdlAdjVal" VAL_BLK 0xCB2F3 Kwb_Wu8 255.000000000 SigName 0.00 255.000000000 FORMAT "%13.9" NUMBER 10 /end CHARACTERISTIC
/begin CHARACTERISTIC DSM_EnvDfp_AFSCDLdAdjVal_C "Fehlerpfad spezifische Umweltbedingungen fuer Fehlerpfad Dfp_AFSCDLdAdjVal" VAL_BLK 0xCB2FD Kwb_Wu8 255.000000000 SigName 0.00 255.000000000 FORMAT "%13.9" NUMBER 10 /end CHARACTERISTIC
/begin CHARACTERISTIC DSM_EnvDfp_AFSCD_AirTempDcyc_C "Fehlerpfad spezifische Umweltbedingungen fuer Fehlerpfad Dfp_AFSCD_AirTempDcyc" VAL_BLK 0xCB307 Kwb_Wu8 255.000000000 SigName 0.00 255.000000000 FORMAT "%13.9" NUMBER 10 /end CHARACTERISTIC
/begin CHARACTERISTIC DSM_EnvDfp_AFSCD_PlOffsDrft_C "Fehlerpfad spezifische Umweltbedingungen fuer Fehlerpfad Dfp_AFSCD_PlOffsDrft" VAL_BLK 0xCB311 Kwb_Wu8 255.000000000 SigName 0.00 255.000000000 FORMAT "%13.9" NUMBER 10 /end CHARACTERISTIC
/begin CHARACTERISTIC DSM_EnvDfp_AFSCD_PlSetyDrft_C "Fehlerpfad spezifische Umweltbedingungen fuer Fehlerpfad Dfp_AFSCD_PlSetyDrft" VAL_BLK 0xCB31B Kwb_Wu8 255.000000000 SigName 0.00 255.000000000 FORMAT "%13.9" NUMBER 10 /end CHARACTERISTIC
/begin CHARACTERISTIC DSM_EnvDfp_AFSCD_SRCAirTemp_C "Fehlerpfad spezifische Umweltbedingungen fuer Fehlerpfad Dfp_AFSCD_SRCAirTemp" VAL_BLK 0xCB325 Kwb_Wu8 255.000000000 SigName 0.00 255.000000000 FORMAT "%13.9" NUMBER 10 /end CHARACTERISTIC
/begin CHARACTERISTIC DSM_EnvDfp_AFSCD_SRCBatt_C "Fehlerpfad spezifische Umweltbedingungen fuer Fehlerpfad Dfp_AFSCD_SRCBatt" VAL_BLK 0xCB32F Kwb_Wu8 255.000000000 SigName 0.00 255.000000000 FORMAT "%13.9" NUMBER 10 /end CHARACTERISTIC
/begin CHARACTERISTIC DSM_EnvDfp_AFSCD_SRCCorrAirm_C "Fehlerpfad spezifische Umweltbedingungen fuer Fehlerpfad Dfp_AFSCD_SRCCorrAirm" VAL_BLK 0xCB339 Kwb_Wu8 255.000000000 SigName 0.00 255.000000000 FORMAT "%13.9" NUMBER 10 /end CHARACTERISTIC
/begin CHARACTERISTIC DSM_EnvDfp_AFSCD_SRCRawAirm_C "Fehlerpfad spezifische Umweltbedingungen fuer Fehlerpfad Dfp_AFSCD_SRCRawAirm" VAL_BLK 0xCB343 Kwb_Wu8 255.000000000 SigName 0.00 255.000000000 FORMAT "%13.9" NUMBER 10 /end CHARACTERISTIC
/begin CHARACTERISTIC DSM_EnvDfp_Layer_TUMG_C "Fehlerpfad spezifische Umweltbedingungen fuer Fehlerpfad Dfp_Layer_TUMG" VAL_BLK 0xCB34D Kwb_Wu8 255.000000000 SigName 0.00 255.000000000 FORMAT "%13.9" NUMBER 10 /end CHARACTERISTIC
/begin CHARACTERISTIC DSM_EnvDfp_AFSCD_SRCRefSigPer_C "Fehlerpfad spezifische Umweltbedingungen fuer Fehlerpfad Dfp_AFSCD_SRCRefSigPer" VAL_BLK 0xCB357 Kwb_Wu8 255.000000000 SigName 0.00 255.000000000 FORMAT "%13.9" NUMBER 10 /end CHARACTERISTIC
/begin CHARACTERISTIC DSM_EnvDfp_AOHtCD_C "Fehlerpfad spezifische Umweltbedingungen fuer Fehlerpfad Dfp_AOHtCD" VAL_BLK 0xCB361 Kwb_Wu8 255.000000000 SigName 0.00 255.000000000 FORMAT "%13.9" NUMBER 10 /end CHARACTERISTIC
/begin CHARACTERISTIC DSM_EnvDfp_Layer_GEN_C "Fehlerpfad spezifische Umweltbedingungen fuer Fehlerpfad Dfp_Layer_GEN" VAL_BLK 0xCB36B Kwb_Wu8 255.000000000 SigName 0.00 255.000000000 FORMAT "%13.9" NUMBER 10 /end CHARACTERISTIC
/begin CHARACTERISTIC DSM_EnvDfp_Layer_BSD_C "Fehlerpfad spezifische Umweltbedingungen fuer Fehlerpfad Dfp_Layer_BSD" VAL_BLK 0xCB375 Kwb_Wu8 255.000000000 SigName 0.00 255.000000000 FORMAT "%13.9" NUMBER 10 /end CHARACTERISTIC
/begin CHARACTERISTIC DSM_EnvDfp_AOHtCD_AOHtDia1_C "Fehlerpfad spezifische Umweltbedingungen fuer Fehlerpfad Dfp_AOHtCD_AOHtDia1" VAL_BLK 0xCB37F Kwb_Wu8 255.000000000 SigName 0.00 255.000000000 FORMAT "%13.9" NUMBER 10 /end CHARACTERISTIC
/begin CHARACTERISTIC DSM_EnvDfp_AOHtCD_AOHtDia2_C "Fehlerpfad spezifische Umweltbedingungen fuer Fehlerpfad Dfp_AOHtCD_AOHtDia2" VAL_BLK 0xCB389 Kwb_Wu8 255.000000000 SigName 0.00 255.000000000 FORMAT "%13.9" NUMBER 10 /end CHARACTERISTIC
/begin CHARACTERISTIC DSM_EnvDfp_AOHtCD_AOHtDia3_C "Fehlerpfad spezifische Umweltbedingungen fuer Fehlerpfad Dfp_AOHtCD_AOHtDia3" VAL_BLK 0xCB393 Kwb_Wu8 255.000000000 SigName 0.00 255.000000000 FORMAT "%13.9" NUMBER 10 /end CHARACTERISTIC
/begin CHARACTERISTIC DSM_EnvDfp_APP1_C "Fehlerpfad spezifische Umweltbedingungen fuer Fehlerpfad Dfp_APP1" VAL_BLK 0xCB39D Kwb_Wu8 255.000000000 SigName 0.00 255.000000000 FORMAT "%13.9" NUMBER 10 /end CHARACTERISTIC
/begin CHARACTERISTIC DSM_EnvDfp_APP2_C "Fehlerpfad spezifische Umweltbedingungen fuer Fehlerpfad Dfp_APP2" VAL_BLK 0xCB3A7 Kwb_Wu8 255.000000000 SigName 0.00 255.000000000 FORMAT "%13.9" NUMBER 10 /end CHARACTERISTIC
/begin CHARACTERISTIC DSM_EnvDfp_APPSync_C "Fehlerpfad spezifische Umweltbedingungen fuer Fehlerpfad Dfp_APPSync" VAL_BLK 0xCB3B1 Kwb_Wu8 255.000000000 SigName 0.00 255.000000000 FORMAT "%13.9" NUMBER 10 /end CHARACTERISTIC
/begin CHARACTERISTIC DSM_EnvDfp_APSCD_C "Fehlerpfad spezifische Umweltbedingungen fuer Fehlerpfad Dfp_APSCD" VAL_BLK 0xCB3BB Kwb_Wu8 255.000000000 SigName 0.00 255.000000000 FORMAT "%13.9" NUMBER 10 /end CHARACTERISTIC
/begin CHARACTERISTIC DSM_EnvDfp_ARS_C "Fehlerpfad spezifische Umweltbedingungen fuer Fehlerpfad Dfp_ARS" VAL_BLK 0xCB3C5 Kwb_Wu8 255.000000000 SigName 0.00 255.000000000 FORMAT "%13.9" NUMBER 10 /end CHARACTERISTIC
/begin CHARACTERISTIC DSM_EnvDfp_AccPedPlausBrk_C "Fehlerpfad spezifische Umweltbedingungen fuer Fehlerpfad Dfp_AccPedPlausBrk" VAL_BLK 0xCB3CF Kwb_Wu8 255.000000000 SigName 0.00 255.000000000 FORMAT "%13.9" NUMBER 10 /end CHARACTERISTIC
/begin CHARACTERISTIC DSM_EnvDfp_AirCtlGvnrDvtRgnMax_C "Fehlerpfad spezifische Umweltbedingungen fuer Fehlerpfad Dfp_AirCtlGvnrDvtRgnMax" VAL_BLK 0xCB3D9 Kwb_Wu8 255.000000000 SigName 0.00 255.000000000 FORMAT "%13.9" NUMBER 10 /end CHARACTERISTIC
/begin CHARACTERISTIC DSM_EnvDfp_Layer_QLT_C "Fehlerpfad spezifische Umweltbedingungen fuer Fehlerpfad Dfp_Layer_QLT" VAL_BLK 0xCB3E3 Kwb_Wu8 255.000000000 SigName 0.00 255.000000000 FORMAT "%13.9" NUMBER 10 /end CHARACTERISTIC
/begin CHARACTERISTIC DSM_EnvDfp_AirCtlGvnrDvtRgnMax2_C "" VAL_BLK 0xCB3ED Kwb_Wu8 255.000000000 SigName 0.00 255.000000000 FORMAT "%13.9" NUMBER 10 /end CHARACTERISTIC
/begin CHARACTERISTIC DSM_EnvDfp_Layer_IBS1_C "Fehlerpfad spezifische Umweltbedingungen fuer Fehlerpfad Dfp_Layer_IBS1" VAL_BLK 0xCB3F7 Kwb_Wu8 255.000000000 SigName 0.00 255.000000000 FORMAT "%13.9" NUMBER 10 /end CHARACTERISTIC
/begin CHARACTERISTIC DSM_EnvDfp_Layer_IBS2_C "Fehlerpfad spezifische Umweltbedingungen fuer Fehlerpfad Dfp_Layer_IBS2" VAL_BLK 0xCB401 Kwb_Wu8 255.000000000 SigName 0.00 255.000000000 FORMAT "%13.9" NUMBER 10 /end CHARACTERISTIC
/begin CHARACTERISTIC DSM_EnvDfp_Layer_IBS3_C "Fehlerpfad spezifische Umweltbedingungen fuer Fehlerpfad Dfp_Layer_IBS3" VAL_BLK 0xCB40B Kwb_Wu8 255.000000000 SigName 0.00 255.000000000 FORMAT "%13.9" NUMBER 10 /end CHARACTERISTIC
/begin CHARACTERISTIC DSM_EnvDfp_Layer_PMBN_C "Fehlerpfad spezifische Umweltbedingungen fuer Fehlerpfad Dfp_Layer_PMBN" VAL_BLK 0xCB415 Kwb_Wu8 255.000000000 SigName 0.00 255.000000000 FORMAT "%13.9" NUMBER 10 /end CHARACTERISTIC
/begin CHARACTERISTIC DSM_EnvDfp_Layer_PMBATT_C "Fehlerpfad spezifische Umweltbedingungen fuer Fehlerpfad Dfp_Layer_PMBATT" VAL_BLK 0xCB41F Kwb_Wu8 255.000000000 SigName 0.00 255.000000000 FORMAT "%13.9" NUMBER 10 /end CHARACTERISTIC
/begin CHARACTERISTIC DSM_EnvDfp_AirCtlGvnrDvtRgnMin_C "Fehlerpfad spezifische Umweltbedingungen fuer Fehlerpfad Dfp_AirCtlGvnrDvtRgnMin" VAL_BLK 0xCB429 Kwb_Wu8 255.000000000 SigName 0.00 255.000000000 FORMAT "%13.9" NUMBER 10 /end CHARACTERISTIC
/begin CHARACTERISTIC DSM_EnvDfp_AirCtlGvnrDvtRgnMin2_C "" VAL_BLK 0xCB433 Kwb_Wu8 255.000000000 SigName 0.00 255.000000000 FORMAT "%13.9" NUMBER 10 /end CHARACTERISTIC
/begin CHARACTERISTIC DSM_EnvDfp_AirCtlPlateBreak_C "DSM variable for Dfp_AirCtlPlateBreak_mp" VAL_BLK 0xCB43D Kwb_Wu8 255.000000000 SigName 0.00 255.000000000 FORMAT "%13.9" NUMBER 10 /end CHARACTERISTIC
/begin CHARACTERISTIC DSM_EnvDfp_AirCtlRmpTO_C "Fehlerpfad spezifische Umweltbedingungen fuer Fehlerpfad Dfp_AirCtlRmpTO" VAL_BLK 0xCB447 Kwb_Wu8 255.000000000 SigName 0.00 255.000000000 FORMAT "%13.9" NUMBER 10 /end CHARACTERISTIC
/begin CHARACTERISTIC DSM_EnvDfp_AirCtl_GovNegDev_C "Fehlerpfad spezifische Umweltbedingungen fuer Fehlerpfad Dfp_AirCtl_GovNegDev" VAL_BLK 0xCB451 Kwb_Wu8 255.000000000 SigName 0.00 255.000000000 FORMAT "%13.9" NUMBER 10 /end CHARACTERISTIC
/begin CHARACTERISTIC DSM_EnvDfp_AirCtl_GovNegDev2_C "Fehlerpfad spezifische Umweltbedingungen fuer Fehlerpfad Dfp_AirCtl_GovNegDev2" VAL_BLK 0xCB45B Kwb_Wu8 255.000000000 SigName 0.00 255.000000000 FORMAT "%13.9" NUMBER 10 /end CHARACTERISTIC
/begin CHARACTERISTIC DSM_EnvDfp_AirCtl_GovPosDev_C "Fehlerpfad spezifische Umweltbedingungen fuer Fehlerpfad Dfp_AirCtl_GovPosDev" VAL_BLK 0xCB465 Kwb_Wu8 255.000000000 SigName 0.00 255.000000000 FORMAT "%13.9" NUMBER 10 /end CHARACTERISTIC
/begin CHARACTERISTIC DSM_EnvDfp_AirCtl_GovPosDev2_C "Fehlerpfad spezifische Umweltbedingungen fuer Fehlerpfad Dfp_AirCtl_GovPosDev2" VAL_BLK 0xCB46F Kwb_Wu8 255.000000000 SigName 0.00 255.000000000 FORMAT "%13.9" NUMBER 10 /end CHARACTERISTIC
/begin CHARACTERISTIC DSM_EnvDfp_AltCD_C "Fehlerpfad spezifische Umweltbedingungen fuer Fehlerpfad Dfp_AltCD" VAL_BLK 0xCB479 Kwb_Wu8 255.000000000 SigName 0.00 255.000000000 FORMAT "%13.9" NUMBER 10 /end CHARACTERISTIC
/begin CHARACTERISTIC DSM_EnvDfp_AltCD_Load_C "Fehlerpfad spezifische Umweltbedingungen fuer Fehlerpfad Dfp_AltCD_Load" VAL_BLK 0xCB483 Kwb_Wu8 255.000000000 SigName 0.00 255.000000000 FORMAT "%13.9" NUMBER 10 /end CHARACTERISTIC
/begin CHARACTERISTIC DSM_EnvDfp_BPACD_BPADia1_C "Fehlerpfad spezifische Umweltbedingungen fuer Fehlerpfad Dfp_BPACD_BPADia1" VAL_BLK 0xCB48D Kwb_Wu8 255.000000000 SigName 0.00 255.000000000 FORMAT "%13.9" NUMBER 10 /end CHARACTERISTIC
/begin CHARACTERISTIC DSM_EnvDfp_BPACD_BPADia2_C "Fehlerpfad spezifische Umweltbedingungen fuer Fehlerpfad Dfp_BPACD_BPADia2" VAL_BLK 0xCB497 Kwb_Wu8 255.000000000 SigName 0.00 255.000000000 FORMAT "%13.9" NUMBER 10 /end CHARACTERISTIC
/begin CHARACTERISTIC DSM_EnvDfp_BPACD_BPADia3_C "Fehlerpfad spezifische Umweltbedingungen fuer Fehlerpfad Dfp_BPACD_BPADia3" VAL_BLK 0xCB4A1 Kwb_Wu8 255.000000000 SigName 0.00 255.000000000 FORMAT "%13.9" NUMBER 10 /end CHARACTERISTIC
/begin CHARACTERISTIC DSM_EnvDfp_BPACD_Max_C "Fehlerpfad spezifische Umweltbedingungen fuer Fehlerpfad Dfp_BPACD_Max" VAL_BLK 0xCB4AB Kwb_Wu8 255.000000000 SigName 0.00 255.000000000 FORMAT "%13.9" NUMBER 10 /end CHARACTERISTIC
/begin CHARACTERISTIC DSM_EnvDfp_BPACD_Min_C "Fehlerpfad spezifische Umweltbedingungen fuer Fehlerpfad Dfp_BPACD_Min" VAL_BLK 0xCB4B5 Kwb_Wu8 255.000000000 SigName 0.00 255.000000000 FORMAT "%13.9" NUMBER 10 /end CHARACTERISTIC
/begin CHARACTERISTIC DSM_EnvDfp_BPACD_SigNpl_C "Fehlerpfad spezifische Umweltbedingungen fuer Fehlerpfad Dfp_BPACD_SigNpl" VAL_BLK 0xCB4BF Kwb_Wu8 255.000000000 SigName 0.00 255.000000000 FORMAT "%13.9" NUMBER 10 /end CHARACTERISTIC
/begin CHARACTERISTIC DSM_EnvDfp_BPSCD_C "Fehlerpfad spezifische Umweltbedingungen fuer Fehlerpfad Dfp_BPSCD" VAL_BLK 0xCB4C9 Kwb_Wu8 255.000000000 SigName 0.00 255.000000000 FORMAT "%13.9" NUMBER 10 /end CHARACTERISTIC
/begin CHARACTERISTIC DSM_EnvDfp_BattCD_C "Fehlerpfad spezifische Umweltbedingungen fuer Fehlerpfad Dfp_BattCD" VAL_BLK 0xCB4D3 Kwb_Wu8 255.000000000 SigName 0.00 255.000000000 FORMAT "%13.9" NUMBER 10 /end CHARACTERISTIC
/begin CHARACTERISTIC DSM_EnvDfp_BrkCD_C "Fehlerpfad spezifische Umweltbedingungen fuer Fehlerpfad Dfp_BrkCD" VAL_BLK 0xCB4DD Kwb_Wu8 255.000000000 SigName 0.00 255.000000000 FORMAT "%13.9" NUMBER 10 /end CHARACTERISTIC
/begin CHARACTERISTIC DSM_EnvDfp_Bss_C "Fehlerpfad spezifische Umweltbedingungen fuer Fehlerpfad Dfp_Bss" VAL_BLK 0xCB4E7 Kwb_Wu8 255.000000000 SigName 0.00 255.000000000 FORMAT "%13.9" NUMBER 10 /end CHARACTERISTIC
/begin CHARACTERISTIC DSM_EnvDfp_CBACD_C "Fehlerpfad spezifische Umweltbedingungen fuer Fehlerpfad Dfp_CBACD" VAL_BLK 0xCB4F1 Kwb_Wu8 255.000000000 SigName 0.00 255.000000000 FORMAT "%13.9" NUMBER 10 /end CHARACTERISTIC
/begin CHARACTERISTIC DSM_EnvDfp_CTSCD_C "Fehlerpfad spezifische Umweltbedingungen fuer Fehlerpfad Dfp_CTSCD" VAL_BLK 0xCB4FB Kwb_Wu8 255.000000000 SigName 0.00 255.000000000 FORMAT "%13.9" NUMBER 10 /end CHARACTERISTIC
/begin CHARACTERISTIC DSM_EnvDfp_Clg_DynTst_C "Fehlerpfad spezifische Umweltbedingungen fuer Fehlerpfad Dfp_Clg_DynTst" VAL_BLK 0xCB505 Kwb_Wu8 255.000000000 SigName 0.00 255.000000000 FORMAT "%13.9" NUMBER 10 /end CHARACTERISTIC
/begin CHARACTERISTIC DSM_EnvDfp_CmbChbMisfire1_C "Fehlerpfad spezifische Umweltbedingungen fuer Fehlerpfad Dfp_CmbChbMisfire1" VAL_BLK 0xCB50F Kwb_Wu8 255.000000000 SigName 0.00 255.000000000 FORMAT "%13.9" NUMBER 10 /end CHARACTERISTIC
/begin CHARACTERISTIC DSM_EnvDfp_CmbChbMisfire2_C "Fehlerpfad spezifische Umweltbedingungen fuer Fehlerpfad Dfp_CmbChbMisfire2" VAL_BLK 0xCB519 Kwb_Wu8 255.000000000 SigName 0.00 255.000000000 FORMAT "%13.9" NUMBER 10 /end CHARACTERISTIC
/begin CHARACTERISTIC DSM_EnvDfp_CmbChbMisfire3_C "Fehlerpfad spezifische Umweltbedingungen fuer Fehlerpfad Dfp_CmbChbMisfire3" VAL_BLK 0xCB523 Kwb_Wu8 255.000000000 SigName 0.00 255.000000000 FORMAT "%13.9" NUMBER 10 /end CHARACTERISTIC
/begin CHARACTERISTIC DSM_EnvDfp_CmbChbMisfire4_C "Fehlerpfad spezifische Umweltbedingungen fuer Fehlerpfad Dfp_CmbChbMisfire4" VAL_BLK 0xCB52D Kwb_Wu8 255.000000000 SigName 0.00 255.000000000 FORMAT "%13.9" NUMBER 10 /end CHARACTERISTIC
/begin CHARACTERISTIC DSM_EnvDfp_CmbChbMisfire5_C "Fehlerpfad spezifische Umweltbedingungen fuer Fehlerpfad Dfp_CmbChbMisfire5" VAL_BLK 0xCB537 Kwb_Wu8 255.000000000 SigName 0.00 255.000000000 FORMAT "%13.9" NUMBER 10 /end CHARACTERISTIC
/begin CHARACTERISTIC DSM_EnvDfp_CmbChbMisfire6_C "Fehlerpfad spezifische Umweltbedingungen fuer Fehlerpfad Dfp_CmbChbMisfire6" VAL_BLK 0xCB541 Kwb_Wu8 255.000000000 SigName 0.00 255.000000000 FORMAT "%13.9" NUMBER 10 /end CHARACTERISTIC
/begin CHARACTERISTIC DSM_EnvDfp_CmbChbMisfireMul_C "Fehlerpfad spezifische Umweltbedingungen fuer Fehlerpfad Dfp_CmbChbMisfireMul" VAL_BLK 0xCB54B Kwb_Wu8 255.000000000 SigName 0.00 255.000000000 FORMAT "%13.9" NUMBER 10 /end CHARACTERISTIC
/begin CHARACTERISTIC DSM_EnvDfp_CoVMDCSh_C "Fehlerpfad spezifische Umweltbedingungen fuer Fehlerpfad Dfp_CoVMDCSh" VAL_BLK 0xCB555 Kwb_Wu8 255.000000000 SigName 0.00 255.000000000 FORMAT "%13.9" NUMBER 10 /end CHARACTERISTIC
/begin CHARACTERISTIC DSM_EnvDfp_ConvCD_C "Fehlerpfad spezifische Umweltbedingungen fuer Fehlerpfad Dfp_ConvCD" VAL_BLK 0xCB55F Kwb_Wu8 255.000000000 SigName 0.00 255.000000000 FORMAT "%13.9" NUMBER 10 /end CHARACTERISTIC
/begin CHARACTERISTIC DSM_EnvDfp_Layer_PMRUHVERL_C "Fehlerpfad spezifische Umweltbedingungen fuer Fehlerpfad Dfp_Layer_PMRUHVERL" VAL_BLK 0xCB569 Kwb_Wu8 255.000000000 SigName 0.00 255.000000000 FORMAT "%13.9" NUMBER 10 /end CHARACTERISTIC
/begin CHARACTERISTIC DSM_EnvDfp_CrCCDMFL_C "Fehlerpfad spezifische Umweltbedingungen fuer Fehlerpfad Dfp_CrCCDMFL" VAL_BLK 0xCB573 Kwb_Wu8 255.000000000 SigName 0.00 255.000000000 FORMAT "%13.9" NUMBER 10 /end CHARACTERISTIC
/begin CHARACTERISTIC DSM_EnvDfp_CrCtl_vCrCtl_C "Fehlerpfad spezifische Umweltbedingungen fuer Fehlerpfad Dfp_CrCtl_vCrCtl" VAL_BLK 0xCB57D Kwb_Wu8 255.000000000 SigName 0.00 255.000000000 FORMAT "%13.9" NUMBER 10 /end CHARACTERISTIC
/begin CHARACTERISTIC DSM_EnvDfp_DCC_PlausTrqDes_C "Fehlerpfad spezifische Umweltbedingungen fuer Fehlerpfad Dfp_DCC_PlausTrqDes" VAL_BLK 0xCB587 Kwb_Wu8 255.000000000 SigName 0.00 255.000000000 FORMAT "%13.9" NUMBER 10 /end CHARACTERISTIC
/begin CHARACTERISTIC DSM_EnvDfp_Dummy1_C "Fehlerpfad spezifische Umweltbedingungen fuer Fehlerpfad Dfp_Dummy1" VAL_BLK 0xCB591 Kwb_Wu8 255.000000000 SigName 0.00 255.000000000 FORMAT "%13.9" NUMBER 10 /end CHARACTERISTIC
/begin CHARACTERISTIC DSM_EnvDfp_Layer_TOENS_C "Fehlerpfad spezifische Umweltbedingungen fuer Fehlerpfad Dfp_Layer_TOENS" VAL_BLK 0xCB59B Kwb_Wu8 255.000000000 SigName 0.00 255.000000000 FORMAT "%13.9" NUMBER 10 /end CHARACTERISTIC
/begin CHARACTERISTIC DSM_EnvDfp_Layer_MANHYDR_C "Fehlerpfad spezifische Umweltbedingungen fuer Fehlerpfad Dfp_Layer_MANHYDR" VAL_BLK 0xCB5A5 Kwb_Wu8 255.000000000 SigName 0.00 255.000000000 FORMAT "%13.9" NUMBER 10 /end CHARACTERISTIC
/begin CHARACTERISTIC DSM_EnvDfp_Layer_MANLUFT_C "Fehlerpfad spezifische Umweltbedingungen fuer Fehlerpfad Dfp_Layer_MANLUFT" VAL_BLK 0xCB5AF Kwb_Wu8 255.000000000 SigName 0.00 255.000000000 FORMAT "%13.9" NUMBER 10 /end CHARACTERISTIC
/begin CHARACTERISTIC DSM_EnvDfp_EATSCD_C "Fehlerpfad spezifische Umweltbedingungen fuer Fehlerpfad Dfp_EATSCD" VAL_BLK 0xCB5B9 Kwb_Wu8 255.000000000 SigName 0.00 255.000000000 FORMAT "%13.9" NUMBER 10 /end CHARACTERISTIC
/begin CHARACTERISTIC DSM_EnvDfp_EBAFCD_C "Fehlerpfad spezifische Umweltbedingungen fuer Fehlerpfad Dfp_EBAFCD" VAL_BLK 0xCB5C3 Kwb_Wu8 255.000000000 SigName 0.00 255.000000000 FORMAT "%13.9" NUMBER 10 /end CHARACTERISTIC
/begin CHARACTERISTIC DSM_EnvDfp_EBFCD_C "Fehlerpfad spezifische Umweltbedingungen fuer Fehlerpfad Dfp_EBFCD" VAL_BLK 0xCB5CD Kwb_Wu8 255.000000000 SigName 0.00 255.000000000 FORMAT "%13.9" NUMBER 10 /end CHARACTERISTIC
/begin CHARACTERISTIC DSM_EnvDfp_EBTSCD_C "Fehlerpfad spezifische Umweltbedingungen fuer Fehlerpfad Dfp_EBTSCD" VAL_BLK 0xCB5D7 Kwb_Wu8 255.000000000 SigName 0.00 255.000000000 FORMAT "%13.9" NUMBER 10 /end CHARACTERISTIC
/begin CHARACTERISTIC DSM_EnvDfp_EBTSCD_OvrTemp_C "Fehlerpfad spezifische Umweltbedingungen fuer Fehlerpfad Dfp_EBTSCD_OvrTemp" VAL_BLK 0xCB5E1 Kwb_Wu8 255.000000000 SigName 0.00 255.000000000 FORMAT "%13.9" NUMBER 10 /end CHARACTERISTIC
/begin CHARACTERISTIC DSM_EnvDfp_EEPCDVarMng_C "Fehlerpfad spezifische Umweltbedingungen fuer Fehlerpfad Dfp_EEPCDVarMng" VAL_BLK 0xCB5EB Kwb_Wu8 255.000000000 SigName 0.00 255.000000000 FORMAT "%13.9" NUMBER 10 /end CHARACTERISTIC
/begin CHARACTERISTIC DSM_EnvDfp_EGPpCD_C "Fehlerpfad spezifische Umweltbedingungen fuer Fehlerpfad Dfp_EGPpCD" VAL_BLK 0xCB5F5 Kwb_Wu8 255.000000000 SigName 0.00 255.000000000 FORMAT "%13.9" NUMBER 10 /end CHARACTERISTIC
/begin CHARACTERISTIC DSM_EnvDfp_EGPpCDTPreTrbn_C "Fehlerpfad spezifische Umweltbedingungen fuer Fehlerpfad Dfp_EgPpCDTPreTrbn" VAL_BLK 0xCB5FF Kwb_Wu8 255.000000000 SigName 0.00 255.000000000 FORMAT "%13.9" NUMBER 10 /end CHARACTERISTIC
/begin CHARACTERISTIC DSM_EnvDfp_EGRCD_Max_C "Fehlerpfad spezifische Umweltbedingungen fuer Fehlerpfad Dfp_EGRCD_Max" VAL_BLK 0xCB609 Kwb_Wu8 255.000000000 SigName 0.00 255.000000000 FORMAT "%13.9" NUMBER 10 /end CHARACTERISTIC
/begin CHARACTERISTIC DSM_EnvDfp_EGRCD_Min_C "Fehlerpfad spezifische Umweltbedingungen fuer Fehlerpfad Dfp_EGRCD_Min" VAL_BLK 0xCB613 Kwb_Wu8 255.000000000 SigName 0.00 255.000000000 FORMAT "%13.9" NUMBER 10 /end CHARACTERISTIC
/begin CHARACTERISTIC DSM_EnvDfp_EGRCD_SigNpl_C "Fehlerpfad spezifische Umweltbedingungen fuer Fehlerpfad Dfp_EGRCD_SigNpl" VAL_BLK 0xCB61D Kwb_Wu8 255.000000000 SigName 0.00 255.000000000 FORMAT "%13.9" NUMBER 10 /end CHARACTERISTIC
/begin CHARACTERISTIC DSM_EnvDfp_EGTRgnOilDil_C "Fehlerpfad spezifische Umweltbedingungen fuer Fehlerpfad Dfp_EGTRgnOilDil" VAL_BLK 0xCB627 Kwb_Wu8 255.000000000 SigName 0.00 255.000000000 FORMAT "%13.9" NUMBER 10 /end CHARACTERISTIC
/begin CHARACTERISTIC DSM_EnvDfp_EMCCDNoLoad1_C "Fehlerpfad spezifische Umweltbedingungen fuer Fehlerpfad Dfp_EMCCDNoLoad1" VAL_BLK 0xCB631 Kwb_Wu8 255.000000000 SigName 0.00 255.000000000 FORMAT "%13.9" NUMBER 10 /end CHARACTERISTIC
/begin CHARACTERISTIC DSM_EnvDfp_EMCCDNoLoad2_C "Fehlerpfad spezifische Umweltbedingungen fuer Fehlerpfad Dfp_EMCCDNoLoad2" VAL_BLK 0xCB63B Kwb_Wu8 255.000000000 SigName 0.00 255.000000000 FORMAT "%13.9" NUMBER 10 /end CHARACTERISTIC
/begin CHARACTERISTIC DSM_EnvDfp_EMCCDSCBat1_C "Fehlerpfad spezifische Umweltbedingungen fuer Fehlerpfad Dfp_EMCCDSCBat1" VAL_BLK 0xCB645 Kwb_Wu8 255.000000000 SigName 0.00 255.000000000 FORMAT "%13.9" NUMBER 10 /end CHARACTERISTIC
/begin CHARACTERISTIC DSM_EnvDfp_EMCCDSCBat2_C "Fehlerpfad spezifische Umweltbedingungen fuer Fehlerpfad Dfp_EMCCDSCBat2" VAL_BLK 0xCB64F Kwb_Wu8 255.000000000 SigName 0.00 255.000000000 FORMAT "%13.9" NUMBER 10 /end CHARACTERISTIC
/begin CHARACTERISTIC DSM_EnvDfp_EMCCDSCGnd1_C "Fehlerpfad spezifische Umweltbedingungen fuer Fehlerpfad Dfp_EMCCDSCGnd1" VAL_BLK 0xCB659 Kwb_Wu8 255.000000000 SigName 0.00 255.000000000 FORMAT "%13.9" NUMBER 10 /end CHARACTERISTIC
/begin CHARACTERISTIC DSM_EnvDfp_EMCCDSCGnd2_C "Fehlerpfad spezifische Umweltbedingungen fuer Fehlerpfad Dfp_EMCCDSCGnd2" VAL_BLK 0xCB663 Kwb_Wu8 255.000000000 SigName 0.00 255.000000000 FORMAT "%13.9" NUMBER 10 /end CHARACTERISTIC
/begin CHARACTERISTIC DSM_EnvDfp_EMCCD_ADC1_C "Fehlerpfad spezifische Umweltbedingungen fuer Fehlerpfad Dfp_EMCCD_ADC1" VAL_BLK 0xCB66D Kwb_Wu8 255.000000000 SigName 0.00 255.000000000 FORMAT "%13.9" NUMBER 10 /end CHARACTERISTIC
/begin CHARACTERISTIC DSM_EnvDfp_EMCCD_ADC2_C "Fehlerpfad spezifische Umweltbedingungen fuer Fehlerpfad Dfp_EMCCD_ADC2" VAL_BLK 0xCB677 Kwb_Wu8 255.000000000 SigName 0.00 255.000000000 FORMAT "%13.9" NUMBER 10 /end CHARACTERISTIC
/begin CHARACTERISTIC DSM_EnvDfp_ETClbETFltInj1_C "Fehlerpfad spezifische Umweltbedingungen fuer Fehlerpfad Dfp_ETClbETFltInj1" VAL_BLK 0xCB681 Kwb_Wu8 255.000000000 SigName 0.00 255.000000000 FORMAT "%13.9" NUMBER 10 /end CHARACTERISTIC
/begin CHARACTERISTIC DSM_EnvDfp_ETClbETFltInj2_C "Fehlerpfad spezifische Umweltbedingungen fuer Fehlerpfad Dfp_ETClbETFltInj2" VAL_BLK 0xCB68B Kwb_Wu8 255.000000000 SigName 0.00 255.000000000 FORMAT "%13.9" NUMBER 10 /end CHARACTERISTIC
/begin CHARACTERISTIC DSM_EnvDfp_ETClbETFltInj3_C "Fehlerpfad spezifische Umweltbedingungen fuer Fehlerpfad Dfp_ETClbETFltInj3" VAL_BLK 0xCB695 Kwb_Wu8 255.000000000 SigName 0.00 255.000000000 FORMAT "%13.9" NUMBER 10 /end CHARACTERISTIC
/begin CHARACTERISTIC DSM_EnvDfp_ETClbETFltInj4_C "Fehlerpfad spezifische Umweltbedingungen fuer Fehlerpfad Dfp_ETClbETFltInj4" VAL_BLK 0xCB69F Kwb_Wu8 255.000000000 SigName 0.00 255.000000000 FORMAT "%13.9" NUMBER 10 /end CHARACTERISTIC
/begin CHARACTERISTIC DSM_EnvDfp_ETClbETFltInj5_C "Fehlerpfad spezifische Umweltbedingungen fuer Fehlerpfad Dfp_ETClbETFltInj5" VAL_BLK 0xCB6A9 Kwb_Wu8 255.000000000 SigName 0.00 255.000000000 FORMAT "%13.9" NUMBER 10 /end CHARACTERISTIC
/begin CHARACTERISTIC DSM_EnvDfp_ETClbETFltInj6_C "Fehlerpfad spezifische Umweltbedingungen fuer Fehlerpfad Dfp_ETClbETFltInj6" VAL_BLK 0xCB6B3 Kwb_Wu8 255.000000000 SigName 0.00 255.000000000 FORMAT "%13.9" NUMBER 10 /end CHARACTERISTIC
/begin CHARACTERISTIC DSM_EnvDfp_ETClbInj1_C "Fehlerpfad spezifische Umweltbedingungen fuer Fehlerpfad Dfp_ETClbInj1" VAL_BLK 0xCB6BD Kwb_Wu8 255.000000000 SigName 0.00 255.000000000 FORMAT "%13.9" NUMBER 10 /end CHARACTERISTIC
/begin CHARACTERISTIC DSM_EnvDfp_ETClbInj2_C "Fehlerpfad spezifische Umweltbedingungen fuer Fehlerpfad Dfp_ETClbInj2" VAL_BLK 0xCB6C7 Kwb_Wu8 255.000000000 SigName 0.00 255.000000000 FORMAT "%13.9" NUMBER 10 /end CHARACTERISTIC
/begin CHARACTERISTIC DSM_EnvDfp_ETClbInj3_C "Fehlerpfad spezifische Umweltbedingungen fuer Fehlerpfad Dfp_ETClbInj3" VAL_BLK 0xCB6D1 Kwb_Wu8 255.000000000 SigName 0.00 255.000000000 FORMAT "%13.9" NUMBER 10 /end CHARACTERISTIC
/begin CHARACTERISTIC DSM_EnvDfp_ETClbInj4_C "Fehlerpfad spezifische Umweltbedingungen fuer Fehlerpfad Dfp_ETClbInj4" VAL_BLK 0xCB6DB Kwb_Wu8 255.000000000 SigName 0.00 255.000000000 FORMAT "%13.9" NUMBER 10 /end CHARACTERISTIC
/begin CHARACTERISTIC DSM_EnvDfp_ETClbInj5_C "Fehlerpfad spezifische Umweltbedingungen fuer Fehlerpfad Dfp_ETClbInj5" VAL_BLK 0xCB6E5 Kwb_Wu8 255.000000000 SigName 0.00 255.000000000 FORMAT "%13.9" NUMBER 10 /end CHARACTERISTIC
/begin CHARACTERISTIC DSM_EnvDfp_ETClbInj6_C "Fehlerpfad spezifische Umweltbedingungen fuer Fehlerpfad Dfp_ETClbInj6" VAL_BLK 0xCB6EF Kwb_Wu8 255.000000000 SigName 0.00 255.000000000 FORMAT "%13.9" NUMBER 10 /end CHARACTERISTIC
/begin CHARACTERISTIC DSM_EnvDfp_EngMCaS1_C "Fehlerpfad spezifische Umweltbedingungen fuer Fehlerpfad Dfp_EngMCaS1" VAL_BLK 0xCB6F9 Kwb_Wu8 255.000000000 SigName 0.00 255.000000000 FORMAT "%13.9" NUMBER 10 /end CHARACTERISTIC
/begin CHARACTERISTIC DSM_EnvDfp_EngMCrS1_C "Fehlerpfad spezifische Umweltbedingungen fuer Fehlerpfad Dfp_EngMCrS1" VAL_BLK 0xCB703 Kwb_Wu8 255.000000000 SigName 0.00 255.000000000 FORMAT "%13.9" NUMBER 10 /end CHARACTERISTIC
/begin CHARACTERISTIC DSM_EnvDfp_EngMOfsCaSCrS_C "Fehlerpfad spezifische Umweltbedingungen fuer Fehlerpfad Dfp_EngMOfsCaSCrS" VAL_BLK 0xCB70D Kwb_Wu8 255.000000000 SigName 0.00 255.000000000 FORMAT "%13.9" NUMBER 10 /end CHARACTERISTIC
/begin CHARACTERISTIC DSM_EnvDfp_EngPrtFWODet_C "Fehlerpfad spezifische Umweltbedingungen fuer Fehlerpfad Dfp_EngPrtFWODet" VAL_BLK 0xCB717 Kwb_Wu8 255.000000000 SigName 0.00 255.000000000 FORMAT "%13.9" NUMBER 10 /end CHARACTERISTIC
/begin CHARACTERISTIC DSM_EnvDfp_FBCqDvt_C "Fehlerpfad spezifische Umweltbedingungen fuer Fehlerpfad Dfp_FBCqDvt" VAL_BLK 0xCB721 Kwb_Wu8 255.000000000 SigName 0.00 255.000000000 FORMAT "%13.9" NUMBER 10 /end CHARACTERISTIC
/begin CHARACTERISTIC DSM_EnvDfp_FMTC_NonMonotonMap_C "Fehlerpfad spezifische Umweltbedingungen fuer Fehlerpfad Dfp_FMTC_NonMonotonMap" VAL_BLK 0xCB72B Kwb_Wu8 255.000000000 SigName 0.00 255.000000000 FORMAT "%13.9" NUMBER 10 /end CHARACTERISTIC
/begin CHARACTERISTIC DSM_EnvDfp_FTSCD_C "Fehlerpfad spezifische Umweltbedingungen fuer Fehlerpfad Dfp_FTSCD" VAL_BLK 0xCB735 Kwb_Wu8 255.000000000 SigName 0.00 255.000000000 FORMAT "%13.9" NUMBER 10 /end CHARACTERISTIC
/begin CHARACTERISTIC DSM_EnvDfp_FanCD_C "Fehlerpfad spezifische Umweltbedingungen fuer Fehlerpfad Dfp_FanCD" VAL_BLK 0xCB73F Kwb_Wu8 255.000000000 SigName 0.00 255.000000000 FORMAT "%13.9" NUMBER 10 /end CHARACTERISTIC
/begin CHARACTERISTIC DSM_EnvDfp_FanCD_FanCtlr1_C "Fehlerpfad spezifische Umweltbedingungen fuer Fehlerpfad Dfp_FanCD_FanCtlr1" VAL_BLK 0xCB749 Kwb_Wu8 255.000000000 SigName 0.00 255.000000000 FORMAT "%13.9" NUMBER 10 /end CHARACTERISTIC
/begin CHARACTERISTIC DSM_EnvDfp_FanCD_FanCtlr2_C "Fehlerpfad spezifische Umweltbedingungen fuer Fehlerpfad Dfp_FanCD_FanCtlr2" VAL_BLK 0xCB753 Kwb_Wu8 255.000000000 SigName 0.00 255.000000000 FORMAT "%13.9" NUMBER 10 /end CHARACTERISTIC
/begin CHARACTERISTIC DSM_EnvDfp_FanCD_FanCtlr3_C "Fehlerpfad spezifische Umweltbedingungen fuer Fehlerpfad Dfp_FanCD_FanCtlr3" VAL_BLK 0xCB75D Kwb_Wu8 255.000000000 SigName 0.00 255.000000000 FORMAT "%13.9" NUMBER 10 /end CHARACTERISTIC
/begin CHARACTERISTIC DSM_EnvDfp_FlFCD_C "Fehlerpfad spezifische Umweltbedingungen fuer Fehlerpfad Dfp_FlFCD" VAL_BLK 0xCB767 Kwb_Wu8 255.000000000 SigName 0.00 255.000000000 FORMAT "%13.9" NUMBER 10 /end CHARACTERISTIC
/begin CHARACTERISTIC DSM_EnvDfp_FlMngSmkDefect_C "Fehlerpfad spezifische Umweltbedingungen fuer Fehlerpfad Dfp_FlMngSmkDefect" VAL_BLK 0xCB771 Kwb_Wu8 255.000000000 SigName 0.00 255.000000000 FORMAT "%13.9" NUMBER 10 /end CHARACTERISTIC
/begin CHARACTERISTIC DSM_EnvDfp_FrmMngANFRADMOMPT_C "Fehlerpfad spezifische Umweltbedingungen fuer Fehlerpfad Dfp_FrmMngANFRADMOMPT" VAL_BLK 0xCB77B Kwb_Wu8 255.000000000 SigName 0.00 255.000000000 FORMAT "%13.9" NUMBER 10 /end CHARACTERISTIC
/begin CHARACTERISTIC DSM_EnvDfp_FrmMngASC1_C "Fehlerpfad spezifische Umweltbedingungen fuer Fehlerpfad Dfp_FrmMngASC1" VAL_BLK 0xCB785 Kwb_Wu8 255.000000000 SigName 0.00 255.000000000 FORMAT "%13.9" NUMBER 10 /end CHARACTERISTIC
/begin CHARACTERISTIC DSM_EnvDfp_FrmMngASC2_C "Fehlerpfad spezifische Umweltbedingungen fuer Fehlerpfad Dfp_FrmMngASC2" VAL_BLK 0xCB78F Kwb_Wu8 255.000000000 SigName 0.00 255.000000000 FORMAT "%13.9" NUMBER 10 /end CHARACTERISTIC
/begin CHARACTERISTIC DSM_EnvDfp_FrmMngASC3_C "Fehlerpfad spezifische Umweltbedingungen fuer Fehlerpfad Dfp_FrmMngASC3" VAL_BLK 0xCB799 Kwb_Wu8 255.000000000 SigName 0.00 255.000000000 FORMAT "%13.9" NUMBER 10 /end CHARACTERISTIC
/begin CHARACTERISTIC DSM_EnvDfp_FrmMngASC4_C "Fehlerpfad spezifische Umweltbedingungen fuer Fehlerpfad Dfp_FrmMngASC4" VAL_BLK 0xCB7A3 Kwb_Wu8 255.000000000 SigName 0.00 255.000000000 FORMAT "%13.9" NUMBER 10 /end CHARACTERISTIC
/begin CHARACTERISTIC DSM_EnvDfp_FrmMngBOS_RESET_C "Fehlerpfad spezifische Umweltbedingungen fuer Fehlerpfad Dfp_FrmMngBOS_RESET" VAL_BLK 0xCB7AD Kwb_Wu8 255.000000000 SigName 0.00 255.000000000 FORMAT "%13.9" NUMBER 10 /end CHARACTERISTIC
/begin CHARACTERISTIC DSM_EnvDfp_FrmMngBOS_RESET_2_C "" VAL_BLK 0xCB7B7 Kwb_Wu8 255.000000000 SigName 0.00 255.000000000 FORMAT "%13.9" NUMBER 10 /end CHARACTERISTIC
/begin CHARACTERISTIC DSM_EnvDfp_FrmMngDMANFAFS_C "Fehlerpfad spezifische Umweltbedingungen fuer Fehlerpfad Dfp_FrmMngDMANFAFS" VAL_BLK 0xCB7C1 Kwb_Wu8 255.000000000 SigName 0.00 255.000000000 FORMAT "%13.9" NUMBER 10 /end CHARACTERISTIC
/begin CHARACTERISTIC DSM_EnvDfp_FrmMngDRMANFSSG_C "Fehlerpfad spezifische Umweltbedingungen fuer Fehlerpfad Dfp_FrmMngDRMANFSSG" VAL_BLK 0xCB7CB Kwb_Wu8 255.000000000 SigName 0.00 255.000000000 FORMAT "%13.9" NUMBER 10 /end CHARACTERISTIC
/begin CHARACTERISTIC DSM_EnvDfp_FrmMngEGS1_C "Fehlerpfad spezifische Umweltbedingungen fuer Fehlerpfad Dfp_FrmMngEGS1" VAL_BLK 0xCB7D5 Kwb_Wu8 255.000000000 SigName 0.00 255.000000000 FORMAT "%13.9" NUMBER 10 /end CHARACTERISTIC
/begin CHARACTERISTIC DSM_EnvDfp_FrmMngEGS2_C "Fehlerpfad spezifische Umweltbedingungen fuer Fehlerpfad Dfp_FrmMngEGS2" VAL_BLK 0xCB7DF Kwb_Wu8 255.000000000 SigName 0.00 255.000000000 FORMAT "%13.9" NUMBER 10 /end CHARACTERISTIC
/begin CHARACTERISTIC DSM_EnvDfp_FrmMngGEARBX_DATA_C "environment conditions (customerspecific) for path" VAL_BLK 0xCB7E9 Kwb_Wu8 255.000000000 SigName 0.00 255.000000000 FORMAT "%13.9" NUMBER 10 /end CHARACTERISTIC
/begin CHARACTERISTIC DSM_EnvDfp_FrmMngGEARBX_DATA2_C "Fehlerpfad spezifische Umweltbedingungen fuer Fehlerpfad Dfp_FrmMngGEARBX_DATA2" VAL_BLK 0xCB7F3 Kwb_Wu8 255.000000000 SigName 0.00 255.000000000 FORMAT "%13.9" NUMBER 10 /end CHARACTERISTIC
/begin CHARACTERISTIC DSM_EnvDfp_FrmMngHEAT_AC_C "environment conditions (customerspecific) for path" VAL_BLK 0xCB7FD Kwb_Wu8 255.000000000 SigName 0.00 255.000000000 FORMAT "%13.9" NUMBER 10 /end CHARACTERISTIC
/begin CHARACTERISTIC DSM_EnvDfp_FrmMngINSTR2_C "Fehlerpfad spezifische Umweltbedingungen fuer Fehlerpfad Dfp_FrmMngINSTR2" VAL_BLK 0xCB807 Kwb_Wu8 255.000000000 SigName 0.00 255.000000000 FORMAT "%13.9" NUMBER 10 /end CHARACTERISTIC
/begin CHARACTERISTIC DSM_EnvDfp_FrmMngINSTR3_C "Fehlerpfad spezifische Umweltbedingungen fuer Fehlerpfad Dfp_FrmMngINSTR3" VAL_BLK 0xCB811 Kwb_Wu8 255.000000000 SigName 0.00 255.000000000 FORMAT "%13.9" NUMBER 10 /end CHARACTERISTIC
/begin CHARACTERISTIC DSM_EnvDfp_FrmMngLENKRADWINKEL_C "Fehlerpfad spezifische Umweltbedingungen fuer Fehlerpfad Dfp_FrmMngLENKRADWINKEL" VAL_BLK 0xCB81B Kwb_Wu8 255.000000000 SigName 0.00 255.000000000 FORMAT "%13.9" NUMBER 10 /end CHARACTERISTIC
/begin CHARACTERISTIC DSM_EnvDfp_FrmMngMILEAGE_RANGE_C "Fehlerpfad spezifische Umweltbedingungen fuer Fehlerpfad Dfp_FrmMngMILEAGE_RANGE" VAL_BLK 0xCB825 Kwb_Wu8 255.000000000 SigName 0.00 255.000000000 FORMAT "%13.9" NUMBER 10 /end CHARACTERISTIC
/begin CHARACTERISTIC DSM_EnvDfp_FrmMngOPCRCTLACC_C "Fehlerpfad spezifische Umweltbedingungen fuer Fehlerpfad Dfp_FrmMngOPCRCTLACC" VAL_BLK 0xCB82F Kwb_Wu8 255.000000000 SigName 0.00 255.000000000 FORMAT "%13.9" NUMBER 10 /end CHARACTERISTIC
/begin CHARACTERISTIC DSM_EnvDfp_FrmMngPRGG_CCTR_C "Fehlerpfad spezifische Umweltbedingungen fuer Fehlerpfad Dfp_FrmMngPRGG_CCTR" VAL_BLK 0xCB839 Kwb_Wu8 255.000000000 SigName 0.00 255.000000000 FORMAT "%13.9" NUMBER 10 /end CHARACTERISTIC
/begin CHARACTERISTIC DSM_EnvDfp_FrmMngPWRMNG_LOADV_C "Fehlerpfad spezifische Umweltbedingungen fuer Fehlerpfad Dfp_FrmMngPWRMNG_LOADV" VAL_BLK 0xCB843 Kwb_Wu8 255.000000000 SigName 0.00 255.000000000 FORMAT "%13.9" NUMBER 10 /end CHARACTERISTIC
/begin CHARACTERISTIC DSM_EnvDfp_FrmMngParkConsumer_C "Fehlerpfad spezifische Umweltbedinungen fuer Fehlerpfad Dfp_FrmMngParkConsumer" VAL_BLK 0xCB84D Kwb_Wu8 255.000000000 SigName 0.00 255.000000000 FORMAT "%13.9" NUMBER 10 /end CHARACTERISTIC
/begin CHARACTERISTIC DSM_EnvDfp_FrmMngRQSTGEFAN_C "RQ_STG_EFAN - CAN-message related errors" VAL_BLK 0xCB857 Kwb_Wu8 255.000000000 SigName 0.00 255.000000000 FORMAT "%13.9" NUMBER 10 /end CHARACTERISTIC
/begin CHARACTERISTIC DSM_EnvDfp_FrmMngSSGErr_C "Fehlerpfad spezifische Umweltbedingungen fuer Fehlerpfad Dfp_FrmMngSSGErr" VAL_BLK 0xCB861 Kwb_Wu8 255.000000000 SigName 0.00 255.000000000 FORMAT "%13.9" NUMBER 10 /end CHARACTERISTIC
/begin CHARACTERISTIC DSM_EnvDfp_FrmMngSSGShOff_C "Fehlerpfad spezifische Umweltbedingungen fuer Fehlerpfad Dfp_FrmMngSSGShOff" VAL_BLK 0xCB86B Kwb_Wu8 255.000000000 SigName 0.00 255.000000000 FORMAT "%13.9" NUMBER 10 /end CHARACTERISTIC
/begin CHARACTERISTIC DSM_EnvDfp_FrmMngSTAT_ANH_C "Fehlerpfad spezifische Umweltbedingungen fuer Fehlerpfad Dfp_FrmMngSTAT_ANH" VAL_BLK 0xCB875 Kwb_Wu8 255.000000000 SigName 0.00 255.000000000 FORMAT "%13.9" NUMBER 10 /end CHARACTERISTIC
/begin CHARACTERISTIC DSM_EnvDfp_FrmMngSTAT_ARS_C "environment conditions (customerspecific) for path" VAL_BLK 0xCB87F Kwb_Wu8 255.000000000 SigName 0.00 255.000000000 FORMAT "%13.9" NUMBER 10 /end CHARACTERISTIC
/begin CHARACTERISTIC DSM_EnvDfp_FrmMngSTAT_DSC_C "environment conditions (customerspecific) for path" VAL_BLK 0xCB889 Kwb_Wu8 255.000000000 SigName 0.00 255.000000000 FORMAT "%13.9" NUMBER 10 /end CHARACTERISTIC
/begin CHARACTERISTIC DSM_EnvDfp_FrmMngSTAT_EKP_C "Fehlerpfad spezifische Umweltbedingungen fuer Fehlerpfad Dfp_FrmMngSTAT_EKP" VAL_BLK 0xCB893 Kwb_Wu8 255.000000000 SigName 0.00 255.000000000 FORMAT "%13.9" NUMBER 10 /end CHARACTERISTIC
/begin CHARACTERISTIC DSM_EnvDfp_FrmMngSTAT_KOMBI_C "Fehlerpfad spezifische Umweltbedingungen fuer Fehlerpfad Dfp_FrmMngSTAT_KOMBI" VAL_BLK 0xCB89D Kwb_Wu8 255.000000000 SigName 0.00 255.000000000 FORMAT "%13.9" NUMBER 10 /end CHARACTERISTIC
/begin CHARACTERISTIC DSM_EnvDfp_FrmMngSTAT_SITZ_C "Fehlerpfad spezifische Umweltbedingungen fuer Fehlerpfad  Dfp_FrmMngSTAT_SITZ" VAL_BLK 0xCB8A7 Kwb_Wu8 255.000000000 SigName 0.00 255.000000000 FORMAT "%13.9" NUMBER 10 /end CHARACTERISTIC
/begin CHARACTERISTIC DSM_EnvDfp_FrmMngStOBDGbxMilOf_C "Fehlerpfad spezifische Umweltbedingungen fuer Fehlerpfad Dfp_FrmMngStOBDGbxMilOf" VAL_BLK 0xCB8B1 Kwb_Wu8 255.000000000 SigName 0.00 255.000000000 FORMAT "%13.9" NUMBER 10 /end CHARACTERISTIC
/begin CHARACTERISTIC DSM_EnvDfp_FrmMngStOBDGbxMilOn_C "Fehlerpfad spezifische Umweltbedingungen fuer Fehlerpfad Dfp_FrmMngStOBDGbxMilOn" VAL_BLK 0xCB8BB Kwb_Wu8 255.000000000 SigName 0.00 255.000000000 FORMAT "%13.9" NUMBER 10 /end CHARACTERISTIC
/begin CHARACTERISTIC DSM_EnvDfp_FrmMngTEMPRELTIME_C "Fehlerpfad spezifische Umweltbedingungen fuer Fehlerpfad Dfp_FrmMngTEMPRELTIME" VAL_BLK 0xCB8C5 Kwb_Wu8 255.000000000 SigName 0.00 255.000000000 FORMAT "%13.9" NUMBER 10 /end CHARACTERISTIC
/begin CHARACTERISTIC DSM_EnvDfp_FrmMngTERMINAL_C "environment conditions (customerspecific) for path" VAL_BLK 0xCB8CF Kwb_Wu8 255.000000000 SigName 0.00 255.000000000 FORMAT "%13.9" NUMBER 10 /end CHARACTERISTIC
/begin CHARACTERISTIC DSM_EnvDfp_FrmMngTIME_DATE_C "Fehlerpfad spezifische Umweltbedingungen fuer Fehlerpfad Dfp_FrmMngTIME_DATE" VAL_BLK 0xCB8D9 Kwb_Wu8 255.000000000 SigName 0.00 255.000000000 FORMAT "%13.9" NUMBER 10 /end CHARACTERISTIC
/begin CHARACTERISTIC DSM_EnvDfp_FrmMngTORQUE_DSC_C "environment conditions (customerspecific) for path" VAL_BLK 0xCB8E3 Kwb_Wu8 255.000000000 SigName 0.00 255.000000000 FORMAT "%13.9" NUMBER 10 /end CHARACTERISTIC
/begin CHARACTERISTIC DSM_EnvDfp_FrmMngTORQUE_GEARBX_C "environment conditions (customerspecific) for path" VAL_BLK 0xCB8ED Kwb_Wu8 255.000000000 SigName 0.00 255.000000000 FORMAT "%13.9" NUMBER 10 /end CHARACTERISTIC
/begin CHARACTERISTIC DSM_EnvDfp_FrmMngTrq_ReqACC_C "Fehlerpfad spezifische Umweltbedingungen fuer Fehlerpfad Dfp_FrmMngTrq_ReqACC" VAL_BLK 0xCB8F7 Kwb_Wu8 255.000000000 SigName 0.00 255.000000000 FORMAT "%13.9" NUMBER 10 /end CHARACTERISTIC
/begin CHARACTERISTIC DSM_EnvDfp_FrmMngVEH_MOD_C "VEH_MOD - CAN-message related errors" VAL_BLK 0xCB901 Kwb_Wu8 255.000000000 SigName 0.00 255.000000000 FORMAT "%13.9" NUMBER 10 /end CHARACTERISTIC
/begin CHARACTERISTIC DSM_EnvDfp_FrmMngVELOCITY_C "environment conditions (customerspecific) for path" VAL_BLK 0xCB90B Kwb_Wu8 255.000000000 SigName 0.00 255.000000000 FORMAT "%13.9" NUMBER 10 /end CHARACTERISTIC
/begin CHARACTERISTIC DSM_EnvDfp_FrmMngWHEEL_SPEED_C "Fehlerpfad spezifische Umweltbedingungen fuer Fehlerpfad Dfp_FrmMngWHEEL_SPEED" VAL_BLK 0xCB915 Kwb_Wu8 255.000000000 SigName 0.00 255.000000000 FORMAT "%13.9" NUMBER 10 /end CHARACTERISTIC
/begin CHARACTERISTIC DSM_EnvDfp_FrmMngstCurr_C "Umweltbedingung für Dfp_FrmMngstCurr" VAL_BLK 0xCB91F Kwb_Wu8 255.000000000 SigName 0.00 255.000000000 FORMAT "%13.9" NUMBER 10 /end CHARACTERISTIC
/begin CHARACTERISTIC DSM_EnvDfp_FrmMngswtPSPOff_C "Umweltbedingung für Dfp_FrmMngswtPSPOff" VAL_BLK 0xCB929 Kwb_Wu8 255.000000000 SigName 0.00 255.000000000 FORMAT "%13.9" NUMBER 10 /end CHARACTERISTIC
/begin CHARACTERISTIC DSM_EnvDfp_GearbxIncMax_C "Fehlerpfad spezifische Umweltbedingungen fuer Fehlerpfad Dfp_GearbxIncMax" VAL_BLK 0xCB933 Kwb_Wu8 255.000000000 SigName 0.00 255.000000000 FORMAT "%13.9" NUMBER 10 /end CHARACTERISTIC
/begin CHARACTERISTIC DSM_EnvDfp_GlwCD_C "Fehlerpfad spezifische Umweltbedingungen fuer Fehlerpfad Dfp_GlwCD" VAL_BLK 0xCB93D Kwb_Wu8 255.000000000 SigName 0.00 255.000000000 FORMAT "%13.9" NUMBER 10 /end CHARACTERISTIC
/begin CHARACTERISTIC DSM_EnvDfp_GlwCDGlwCirc1_C "Fehlerpfad spezifische Umweltbedingungen fuer Fehlerpfad Dfp_GlwCDGlwCirc1" VAL_BLK 0xCB947 Kwb_Wu8 255.000000000 SigName 0.00 255.000000000 FORMAT "%13.9" NUMBER 10 /end CHARACTERISTIC
/begin CHARACTERISTIC DSM_EnvDfp_GlwCDGlwCirc2_C "Fehlerpfad spezifische Umweltbedingungen fuer Fehlerpfad Dfp_GlwCDGlwCirc2" VAL_BLK 0xCB951 Kwb_Wu8 255.000000000 SigName 0.00 255.000000000 FORMAT "%13.9" NUMBER 10 /end CHARACTERISTIC
/begin CHARACTERISTIC DSM_EnvDfp_GlwCDGlwCirc3_C "Fehlerpfad spezifische Umweltbedingungen fuer Fehlerpfad Dfp_GlwCDGlwCirc3" VAL_BLK 0xCB95B Kwb_Wu8 255.000000000 SigName 0.00 255.000000000 FORMAT "%13.9" NUMBER 10 /end CHARACTERISTIC
/begin CHARACTERISTIC DSM_EnvDfp_GlwCDGlwCirc4_C "Fehlerpfad spezifische Umweltbedingungen fuer Fehlerpfad Dfp_GlwCDGlwCirc4" VAL_BLK 0xCB965 Kwb_Wu8 255.000000000 SigName 0.00 255.000000000 FORMAT "%13.9" NUMBER 10 /end CHARACTERISTIC
/begin CHARACTERISTIC DSM_EnvDfp_GlwCDGlwCirc5_C "Fehlerpfad spezifische Umweltbedingungen fuer Fehlerpfad Dfp_GlwCDGlwCirc5" VAL_BLK 0xCB96F Kwb_Wu8 255.000000000 SigName 0.00 255.000000000 FORMAT "%13.9" NUMBER 10 /end CHARACTERISTIC
/begin CHARACTERISTIC DSM_EnvDfp_GlwCDGlwCirc6_C "Fehlerpfad spezifische Umweltbedingungen fuer Fehlerpfad Dfp_GlwCDGlwCirc6" VAL_BLK 0xCB979 Kwb_Wu8 255.000000000 SigName 0.00 255.000000000 FORMAT "%13.9" NUMBER 10 /end CHARACTERISTIC
/begin CHARACTERISTIC DSM_EnvDfp_GlwCDGlwCirc7_C "Fehlerpfad spezifische Umweltbedingungen fuer Fehlerpfad Dfp_GlwCDGlwCirc7" VAL_BLK 0xCB983 Kwb_Wu8 255.000000000 SigName 0.00 255.000000000 FORMAT "%13.9" NUMBER 10 /end CHARACTERISTIC
/begin CHARACTERISTIC DSM_EnvDfp_GlwCDGlwCirc8_C "Fehlerpfad spezifische Umweltbedingungen fuer Fehlerpfad Dfp_GlwCDGlwCirc8" VAL_BLK 0xCB98D Kwb_Wu8 255.000000000 SigName 0.00 255.000000000 FORMAT "%13.9" NUMBER 10 /end CHARACTERISTIC
/begin CHARACTERISTIC DSM_EnvDfp_GlwCtl_C "Fehlerpfad spezifische Umweltbedingungen fuer Fehlerpfad Dfp_GlwCtl" VAL_BLK 0xCB997 Kwb_Wu8 255.000000000 SigName 0.00 255.000000000 FORMAT "%13.9" NUMBER 10 /end CHARACTERISTIC
/begin CHARACTERISTIC DSM_EnvDfp_HWEMonCom_C "Fehlerpfad spezifische Umweltbedingungen fuer Fehlerpfad Dfp_HWEMonCom" VAL_BLK 0xCB9A1 Kwb_Wu8 255.000000000 SigName 0.00 255.000000000 FORMAT "%13.9" NUMBER 10 /end CHARACTERISTIC
/begin CHARACTERISTIC DSM_EnvDfp_HWEMonEEPROM_C "Fehlerpfad spezifische Umweltbedingungen fuer Fehlerpfad Dfp_HWEMonEEPROM" VAL_BLK 0xCB9AB Kwb_Wu8 255.000000000 SigName 0.00 255.000000000 FORMAT "%13.9" NUMBER 10 /end CHARACTERISTIC
/begin CHARACTERISTIC DSM_EnvDfp_HWEMonRcyLocked_C "Fehlerpfad spezifische Umweltbedingungen fuer Fehlerpfad Dfp_HWEMonRcyLocked" VAL_BLK 0xCB9B5 Kwb_Wu8 255.000000000 SigName 0.00 255.000000000 FORMAT "%13.9" NUMBER 10 /end CHARACTERISTIC
/begin CHARACTERISTIC DSM_EnvDfp_HWEMonRcySuppressed_C "Fehlerpfad spezifische Umweltbedingungen fuer Fehlerpfad Dfp_HWEMonRcySuppressed" VAL_BLK 0xCB9BF Kwb_Wu8 255.000000000 SigName 0.00 255.000000000 FORMAT "%13.9" NUMBER 10 /end CHARACTERISTIC
/begin CHARACTERISTIC DSM_EnvDfp_HWEMonRcyVisible_C "Fehlerpfad spezifische Umweltbedingungen fuer Fehlerpfad Dfp_HWEMonRcyVisible" VAL_BLK 0xCB9C9 Kwb_Wu8 255.000000000 SigName 0.00 255.000000000 FORMAT "%13.9" NUMBER 10 /end CHARACTERISTIC
/begin CHARACTERISTIC DSM_EnvDfp_HWEMonUMaxSupply_C "Fehlerpfad spezifische Umweltbedingungen fuer Fehlerpfad Dfp_HWEMonUMaxSupply" VAL_BLK 0xCB9D3 Kwb_Wu8 255.000000000 SigName 0.00 255.000000000 FORMAT "%13.9" NUMBER 10 /end CHARACTERISTIC
/begin CHARACTERISTIC DSM_EnvDfp_HWEMonUMinSupply_C "Fehlerpfad spezifische Umweltbedingungen fuer Fehlerpfad Dfp_HWEMonUMinSupply" VAL_BLK 0xCB9DD Kwb_Wu8 255.000000000 SigName 0.00 255.000000000 FORMAT "%13.9" NUMBER 10 /end CHARACTERISTIC
/begin CHARACTERISTIC DSM_EnvDfp_IATSCD_C "Fehlerpfad spezifische Umweltbedingungen fuer Fehlerpfad Dfp_IATSCD" VAL_BLK 0xCB9E7 Kwb_Wu8 255.000000000 SigName 0.00 255.000000000 FORMAT "%13.9" NUMBER 10 /end CHARACTERISTIC
/begin CHARACTERISTIC DSM_EnvDfp_IATSCD_CATS_C "Fehlerpfad spezifische Umweltbedingungen fuer Fehlerpfad Dfp_IATSCD_CATS" VAL_BLK 0xCB9F1 Kwb_Wu8 255.000000000 SigName 0.00 255.000000000 FORMAT "%13.9" NUMBER 10 /end CHARACTERISTIC
/begin CHARACTERISTIC DSM_EnvDfp_ImmCtlImmCD_C "Fehlerpfad spezifische Umweltbedingungen fuer Fehlerpfad Dfp_ImmCtlImmCD" VAL_BLK 0xCB9FB Kwb_Wu8 255.000000000 SigName 0.00 255.000000000 FORMAT "%13.9" NUMBER 10 /end CHARACTERISTIC
/begin CHARACTERISTIC DSM_EnvDfp_ImmCtlImmEep_C "Fehlerpfad spezifische Umweltbedingungen fuer Fehlerpfad Dfp_ImmCtlImmEep" VAL_BLK 0xCBA05 Kwb_Wu8 255.000000000 SigName 0.00 255.000000000 FORMAT "%13.9" NUMBER 10 /end CHARACTERISTIC
/begin CHARACTERISTIC DSM_EnvDfp_ImmCtlMpl_C "Fehlerpfad spezifische Umweltbedingungen fuer Fehlerpfad Dfp_ImmCtlMpl" VAL_BLK 0xCBA0F Kwb_Wu8 255.000000000 SigName 0.00 255.000000000 FORMAT "%13.9" NUMBER 10 /end CHARACTERISTIC
/begin CHARACTERISTIC DSM_EnvDfp_IndSys1_C "Fehlerpfad spezifische Umweltbedingungen fuer Fehlerpfad Dfp_IndSys1" VAL_BLK 0xCBA19 Kwb_Wu8 255.000000000 SigName 0.00 255.000000000 FORMAT "%13.9" NUMBER 10 /end CHARACTERISTIC
/begin CHARACTERISTIC DSM_EnvDfp_IndSys2_C "Fehlerpfad spezifische Umweltbedingungen fuer Fehlerpfad Dfp_IndSys2" VAL_BLK 0xCBA23 Kwb_Wu8 255.000000000 SigName 0.00 255.000000000 FORMAT "%13.9" NUMBER 10 /end CHARACTERISTIC
/begin CHARACTERISTIC DSM_EnvDfp_InjCrv_InjLim_C "Fehlerpfad spezifische Umweltbedingungen fuer Fehlerpfad Dfp_InjCrv_InjLim" VAL_BLK 0xCBA2D Kwb_Wu8 255.000000000 SigName 0.00 255.000000000 FORMAT "%13.9" NUMBER 10 /end CHARACTERISTIC
/begin CHARACTERISTIC DSM_EnvDfp_InjCtlAdjQnt_C "Fehlerpfad spezifische Umweltbedingungen fuer Fehlerpfad Dfp_InjCtlAdjQnt" VAL_BLK 0xCBA37 Kwb_Wu8 255.000000000 SigName 0.00 255.000000000 FORMAT "%13.9" NUMBER 10 /end CHARACTERISTIC
/begin CHARACTERISTIC DSM_EnvDfp_InjCtlDrift_C "Fehlerpfad spezifische Umweltbedingungen fuer Fehlerpfad Dfp_InjCtlDrift" VAL_BLK 0xCBA41 Kwb_Wu8 255.000000000 SigName 0.00 255.000000000 FORMAT "%13.9" NUMBER 10 /end CHARACTERISTIC
/begin CHARACTERISTIC DSM_EnvDfp_InjVCDActrChrg_C "Fehlerpfad spezifische Umweltbedingungen fuer Fehlerpfad Dfp_InjVCDActrChrg" VAL_BLK 0xCBA4B Kwb_Wu8 255.000000000 SigName 0.00 255.000000000 FORMAT "%13.9" NUMBER 10 /end CHARACTERISTIC
/begin CHARACTERISTIC DSM_EnvDfp_InjVCDActrEnrg1_C "Fehlerpfad spezifische Umweltbedingungen fuer Fehlerpfad Dfp_InjVCDActrEnrg1" VAL_BLK 0xCBA55 Kwb_Wu8 255.000000000 SigName 0.00 255.000000000 FORMAT "%13.9" NUMBER 10 /end CHARACTERISTIC
/begin CHARACTERISTIC DSM_EnvDfp_InjVCDActrEnrg2_C "Fehlerpfad spezifische Umweltbedingungen fuer Fehlerpfad Dfp_InjVCDActrEnrg2" VAL_BLK 0xCBA5F Kwb_Wu8 255.000000000 SigName 0.00 255.000000000 FORMAT "%13.9" NUMBER 10 /end CHARACTERISTIC
/begin CHARACTERISTIC DSM_EnvDfp_InjVCDActrEnrg3_C "Fehlerpfad spezifische Umweltbedingungen fuer Fehlerpfad Dfp_InjVCDActrEnrg3" VAL_BLK 0xCBA69 Kwb_Wu8 255.000000000 SigName 0.00 255.000000000 FORMAT "%13.9" NUMBER 10 /end CHARACTERISTIC
/begin CHARACTERISTIC DSM_EnvDfp_InjVCDActrEnrg4_C "Fehlerpfad spezifische Umweltbedingungen fuer Fehlerpfad Dfp_InjVCDActrEnrg4" VAL_BLK 0xCBA73 Kwb_Wu8 255.000000000 SigName 0.00 255.000000000 FORMAT "%13.9" NUMBER 10 /end CHARACTERISTIC
/begin CHARACTERISTIC DSM_EnvDfp_InjVCDActrEnrg5_C "Fehlerpfad spezifische Umweltbedingungen fuer Fehlerpfad Dfp_InjVCDActrEnrg5" VAL_BLK 0xCBA7D Kwb_Wu8 255.000000000 SigName 0.00 255.000000000 FORMAT "%13.9" NUMBER 10 /end CHARACTERISTIC
/begin CHARACTERISTIC DSM_EnvDfp_InjVCDActrEnrg6_C "Fehlerpfad spezifische Umweltbedingungen fuer Fehlerpfad Dfp_InjVCDActrEnrg6" VAL_BLK 0xCBA87 Kwb_Wu8 255.000000000 SigName 0.00 255.000000000 FORMAT "%13.9" NUMBER 10 /end CHARACTERISTIC
/begin CHARACTERISTIC DSM_EnvDfp_InjVCDActrEnrg7_C "Fehlerpfad spezifische Umweltbedingungen fuer Fehlerpfad Dfp_InjVCDActrEnrg7" VAL_BLK 0xCBA91 Kwb_Wu8 255.000000000 SigName 0.00 255.000000000 FORMAT "%13.9" NUMBER 10 /end CHARACTERISTIC
/begin CHARACTERISTIC DSM_EnvDfp_InjVCDActrEnrg8_C "Fehlerpfad spezifische Umweltbedingungen fuer Fehlerpfad Dfp_InjVCDActrEnrg8" VAL_BLK 0xCBA9B Kwb_Wu8 255.000000000 SigName 0.00 255.000000000 FORMAT "%13.9" NUMBER 10 /end CHARACTERISTIC
/begin CHARACTERISTIC DSM_EnvDfp_InjVCDActrVolt_C "Fehlerpfad spezifische Umweltbedingungen fuer Fehlerpfad Dfp_InjVCDActrVolt" VAL_BLK 0xCBAA5 Kwb_Wu8 255.000000000 SigName 0.00 255.000000000 FORMAT "%13.9" NUMBER 10 /end CHARACTERISTIC
/begin CHARACTERISTIC DSM_EnvDfp_InjVCDClsBank1_C "Fehlerpfad spezifische Umweltbedingungen fuer Fehlerpfad Dfp_InjVCDClsBank1" VAL_BLK 0xCBAAF Kwb_Wu8 255.000000000 SigName 0.00 255.000000000 FORMAT "%13.9" NUMBER 10 /end CHARACTERISTIC
/begin CHARACTERISTIC DSM_EnvDfp_InjVCDClsBank2_C "Fehlerpfad spezifische Umweltbedingungen fuer Fehlerpfad Dfp_InjVCDClsBank2" VAL_BLK 0xCBAB9 Kwb_Wu8 255.000000000 SigName 0.00 255.000000000 FORMAT "%13.9" NUMBER 10 /end CHARACTERISTIC
/begin CHARACTERISTIC DSM_EnvDfp_InjVCDMonCab_C "Fehlerpfad spezifische Umweltbedingungen fuer Fehlerpfad Dfp_InjVCDMonCab" VAL_BLK 0xCBAC3 Kwb_Wu8 255.000000000 SigName 0.00 255.000000000 FORMAT "%13.9" NUMBER 10 /end CHARACTERISTIC
/begin CHARACTERISTIC DSM_EnvDfp_InjVCDMonSwt_C "Fehlerpfad spezifische Umweltbedingungen fuer Fehlerpfad Dfp_InjVCDMonSwt" VAL_BLK 0xCBACD Kwb_Wu8 255.000000000 SigName 0.00 255.000000000 FORMAT "%13.9" NUMBER 10 /end CHARACTERISTIC
/begin CHARACTERISTIC DSM_EnvDfp_InjVCDShOffDCDC_C "Fehlerpfad spezifische Umweltbedingungen fuer Fehlerpfad Dfp_InjVCDShOffDCDC" VAL_BLK 0xCBAD7 Kwb_Wu8 255.000000000 SigName 0.00 255.000000000 FORMAT "%13.9" NUMBER 10 /end CHARACTERISTIC
/begin CHARACTERISTIC DSM_EnvDfp_InjVCDUBuf_C "Fehlerpfad spezifische Umweltbedingungen fuer Fehlerpfad Dfp_InjVCDUBuf" VAL_BLK 0xCBAE1 Kwb_Wu8 255.000000000 SigName 0.00 255.000000000 FORMAT "%13.9" NUMBER 10 /end CHARACTERISTIC
/begin CHARACTERISTIC DSM_EnvDfp_InjVCD_CY370Ampl_C "Fehlerpfad spezifische Umweltbedingungen fuer Fehlerpfad Dfp_InjVCD_CY370Ampl" VAL_BLK 0xCBAEB Kwb_Wu8 255.000000000 SigName 0.00 255.000000000 FORMAT "%13.9" NUMBER 10 /end CHARACTERISTIC
/begin CHARACTERISTIC DSM_EnvDfp_InjVlvBnk1A_C "Fehlerpfad spezifische Umweltbedingungen fuer Fehlerpfad Dfp_InjVlvBnk1A" VAL_BLK 0xCBAF5 Kwb_Wu8 255.000000000 SigName 0.00 255.000000000 FORMAT "%13.9" NUMBER 10 /end CHARACTERISTIC
/begin CHARACTERISTIC DSM_EnvDfp_InjVlvBnk1B_C "Fehlerpfad spezifische Umweltbedingungen fuer Fehlerpfad Dfp_InjVlvBnk1B" VAL_BLK 0xCBAFF Kwb_Wu8 255.000000000 SigName 0.00 255.000000000 FORMAT "%13.9" NUMBER 10 /end CHARACTERISTIC
/begin CHARACTERISTIC DSM_EnvDfp_InjVlvBnk2A_C "Fehlerpfad spezifische Umweltbedingungen fuer Fehlerpfad Dfp_InjVlvBnk2A" VAL_BLK 0xCBB09 Kwb_Wu8 255.000000000 SigName 0.00 255.000000000 FORMAT "%13.9" NUMBER 10 /end CHARACTERISTIC
/begin CHARACTERISTIC DSM_EnvDfp_InjVlvBnk2B_C "Fehlerpfad spezifische Umweltbedingungen fuer Fehlerpfad Dfp_InjVlvBnk2B" VAL_BLK 0xCBB13 Kwb_Wu8 255.000000000 SigName 0.00 255.000000000 FORMAT "%13.9" NUMBER 10 /end CHARACTERISTIC
/begin CHARACTERISTIC DSM_EnvDfp_InjVlvChipA_C "Fehlerpfad spezifische Umweltbedingungen fuer Fehlerpfad Dfp_InjVlvChipA" VAL_BLK 0xCBB1D Kwb_Wu8 255.000000000 SigName 0.00 255.000000000 FORMAT "%13.9" NUMBER 10 /end CHARACTERISTIC
/begin CHARACTERISTIC DSM_EnvDfp_InjVlvChipB_C "Fehlerpfad spezifische Umweltbedingungen fuer Fehlerpfad Dfp_InjVlvChipB" VAL_BLK 0xCBB27 Kwb_Wu8 255.000000000 SigName 0.00 255.000000000 FORMAT "%13.9" NUMBER 10 /end CHARACTERISTIC
/begin CHARACTERISTIC DSM_EnvDfp_InjVlvCyl1A_C "Fehlerpfad spezifische Umweltbedingungen fuer Fehlerpfad Dfp_InjVlvCyl1A" VAL_BLK 0xCBB31 Kwb_Wu8 255.000000000 SigName 0.00 255.000000000 FORMAT "%13.9" NUMBER 10 /end CHARACTERISTIC
/begin CHARACTERISTIC DSM_EnvDfp_InjVlvCyl1B_C "Fehlerpfad spezifische Umweltbedingungen fuer Fehlerpfad Dfp_InjVlvCyl1B" VAL_BLK 0xCBB3B Kwb_Wu8 255.000000000 SigName 0.00 255.000000000 FORMAT "%13.9" NUMBER 10 /end CHARACTERISTIC
/begin CHARACTERISTIC DSM_EnvDfp_InjVlvCyl1C_C "Fehlerpfad spezifische Umweltbedingungen fuer Fehlerpfad Dfp_InjVlvCyl1C" VAL_BLK 0xCBB45 Kwb_Wu8 255.000000000 SigName 0.00 255.000000000 FORMAT "%13.9" NUMBER 10 /end CHARACTERISTIC
/begin CHARACTERISTIC DSM_EnvDfp_InjVlvCyl2A_C "Fehlerpfad spezifische Umweltbedingungen fuer Fehlerpfad Dfp_InjVlvCyl2A" VAL_BLK 0xCBB4F Kwb_Wu8 255.000000000 SigName 0.00 255.000000000 FORMAT "%13.9" NUMBER 10 /end CHARACTERISTIC
/begin CHARACTERISTIC DSM_EnvDfp_InjVlvCyl2B_C "Fehlerpfad spezifische Umweltbedingungen fuer Fehlerpfad Dfp_InjVlvCyl2B" VAL_BLK 0xCBB59 Kwb_Wu8 255.000000000 SigName 0.00 255.000000000 FORMAT "%13.9" NUMBER 10 /end CHARACTERISTIC
/begin CHARACTERISTIC DSM_EnvDfp_InjVlvCyl2C_C "Fehlerpfad spezifische Umweltbedingungen fuer Fehlerpfad Dfp_InjVlvCyl2C" VAL_BLK 0xCBB63 Kwb_Wu8 255.000000000 SigName 0.00 255.000000000 FORMAT "%13.9" NUMBER 10 /end CHARACTERISTIC
/begin CHARACTERISTIC DSM_EnvDfp_InjVlvCyl3A_C "Fehlerpfad spezifische Umweltbedingungen fuer Fehlerpfad Dfp_InjVlvCyl3A" VAL_BLK 0xCBB6D Kwb_Wu8 255.000000000 SigName 0.00 255.000000000 FORMAT "%13.9" NUMBER 10 /end CHARACTERISTIC
/begin CHARACTERISTIC DSM_EnvDfp_InjVlvCyl3B_C "Fehlerpfad spezifische Umweltbedingungen fuer Fehlerpfad Dfp_InjVlvCyl3B" VAL_BLK 0xCBB77 Kwb_Wu8 255.000000000 SigName 0.00 255.000000000 FORMAT "%13.9" NUMBER 10 /end CHARACTERISTIC
/begin CHARACTERISTIC DSM_EnvDfp_InjVlvCyl3C_C "Fehlerpfad spezifische Umweltbedingungen fuer Fehlerpfad Dfp_InjVlvCyl3C" VAL_BLK 0xCBB81 Kwb_Wu8 255.000000000 SigName 0.00 255.000000000 FORMAT "%13.9" NUMBER 10 /end CHARACTERISTIC
/begin CHARACTERISTIC DSM_EnvDfp_InjVlvCyl4A_C "Fehlerpfad spezifische Umweltbedingungen fuer Fehlerpfad Dfp_InjVlvCyl4A" VAL_BLK 0xCBB8B Kwb_Wu8 255.000000000 SigName 0.00 255.000000000 FORMAT "%13.9" NUMBER 10 /end CHARACTERISTIC
/begin CHARACTERISTIC DSM_EnvDfp_InjVlvCyl4B_C "Fehlerpfad spezifische Umweltbedingungen fuer Fehlerpfad Dfp_InjVlvCyl4B" VAL_BLK 0xCBB95 Kwb_Wu8 255.000000000 SigName 0.00 255.000000000 FORMAT "%13.9" NUMBER 10 /end CHARACTERISTIC
/begin CHARACTERISTIC DSM_EnvDfp_InjVlvCyl4C_C "Fehlerpfad spezifische Umweltbedingungen fuer Fehlerpfad Dfp_InjVlvCyl4C" VAL_BLK 0xCBB9F Kwb_Wu8 255.000000000 SigName 0.00 255.000000000 FORMAT "%13.9" NUMBER 10 /end CHARACTERISTIC
/begin CHARACTERISTIC DSM_EnvDfp_InjVlvCyl5A_C "Fehlerpfad spezifische Umweltbedingungen fuer Fehlerpfad Dfp_InjVlvCyl5A" VAL_BLK 0xCBBA9 Kwb_Wu8 255.000000000 SigName 0.00 255.000000000 FORMAT "%13.9" NUMBER 10 /end CHARACTERISTIC
/begin CHARACTERISTIC DSM_EnvDfp_InjVlvCyl5B_C "Fehlerpfad spezifische Umweltbedingungen fuer Fehlerpfad Dfp_InjVlvCyl5B" VAL_BLK 0xCBBB3 Kwb_Wu8 255.000000000 SigName 0.00 255.000000000 FORMAT "%13.9" NUMBER 10 /end CHARACTERISTIC
/begin CHARACTERISTIC DSM_EnvDfp_InjVlvCyl5C_C "Fehlerpfad spezifische Umweltbedingungen fuer Fehlerpfad Dfp_InjVlvCyl5C" VAL_BLK 0xCBBBD Kwb_Wu8 255.000000000 SigName 0.00 255.000000000 FORMAT "%13.9" NUMBER 10 /end CHARACTERISTIC
/begin CHARACTERISTIC DSM_EnvDfp_InjVlvCyl6A_C "Fehlerpfad spezifische Umweltbedingungen fuer Fehlerpfad Dfp_InjVlvCyl6A" VAL_BLK 0xCBBC7 Kwb_Wu8 255.000000000 SigName 0.00 255.000000000 FORMAT "%13.9" NUMBER 10 /end CHARACTERISTIC
/begin CHARACTERISTIC DSM_EnvDfp_InjVlvCyl6B_C "Fehlerpfad spezifische Umweltbedingungen fuer Fehlerpfad Dfp_InjVlvCyl6B" VAL_BLK 0xCBBD1 Kwb_Wu8 255.000000000 SigName 0.00 255.000000000 FORMAT "%13.9" NUMBER 10 /end CHARACTERISTIC
/begin CHARACTERISTIC DSM_EnvDfp_InjVlvCyl6C_C "Fehlerpfad spezifische Umweltbedingungen fuer Fehlerpfad Dfp_InjVlvCyl6C" VAL_BLK 0xCBBDB Kwb_Wu8 255.000000000 SigName 0.00 255.000000000 FORMAT "%13.9" NUMBER 10 /end CHARACTERISTIC
/begin CHARACTERISTIC DSM_EnvDfp_InjVlvCyl7A_C "Fehlerpfad spezifische Umweltbedingungen fuer Fehlerpfad Dfp_InjVlvCyl7A" VAL_BLK 0xCBBE5 Kwb_Wu8 255.000000000 SigName 0.00 255.000000000 FORMAT "%13.9" NUMBER 10 /end CHARACTERISTIC
/begin CHARACTERISTIC DSM_EnvDfp_InjVlvCyl7B_C "Fehlerpfad spezifische Umweltbedingungen fuer Fehlerpfad Dfp_InjVlvCyl7B" VAL_BLK 0xCBBEF Kwb_Wu8 255.000000000 SigName 0.00 255.000000000 FORMAT "%13.9" NUMBER 10 /end CHARACTERISTIC
/begin CHARACTERISTIC DSM_EnvDfp_InjVlvCyl7C_C "Fehlerpfad spezifische Umweltbedingungen fuer Fehlerpfad Dfp_InjVlvCyl7C" VAL_BLK 0xCBBF9 Kwb_Wu8 255.000000000 SigName 0.00 255.000000000 FORMAT "%13.9" NUMBER 10 /end CHARACTERISTIC
/begin CHARACTERISTIC DSM_EnvDfp_InjVlvCyl8A_C "Fehlerpfad spezifische Umweltbedingungen fuer Fehlerpfad Dfp_InjVlvCyl8A" VAL_BLK 0xCBC03 Kwb_Wu8 255.000000000 SigName 0.00 255.000000000 FORMAT "%13.9" NUMBER 10 /end CHARACTERISTIC
/begin CHARACTERISTIC DSM_EnvDfp_InjVlvCyl8B_C "Fehlerpfad spezifische Umweltbedingungen fuer Fehlerpfad Dfp_InjVlvCyl8B" VAL_BLK 0xCBC0D Kwb_Wu8 255.000000000 SigName 0.00 255.000000000 FORMAT "%13.9" NUMBER 10 /end CHARACTERISTIC
/begin CHARACTERISTIC DSM_EnvDfp_InjVlvCyl8C_C "Fehlerpfad spezifische Umweltbedingungen fuer Fehlerpfad Dfp_InjVlvCyl8C" VAL_BLK 0xCBC17 Kwb_Wu8 255.000000000 SigName 0.00 255.000000000 FORMAT "%13.9" NUMBER 10 /end CHARACTERISTIC
/begin CHARACTERISTIC DSM_EnvDfp_InjVlvNVC1_C "Fehlerpfad spezifische Umweltbedingungen fuer Fehlerpfad Dfp_InjVlvNVC1" VAL_BLK 0xCBC21 Kwb_Wu8 255.000000000 SigName 0.00 255.000000000 FORMAT "%13.9" NUMBER 10 /end CHARACTERISTIC
/begin CHARACTERISTIC DSM_EnvDfp_InjVlvNVC2_C "Fehlerpfad spezifische Umweltbedingungen fuer Fehlerpfad Dfp_InjVlvNVC2" VAL_BLK 0xCBC2B Kwb_Wu8 255.000000000 SigName 0.00 255.000000000 FORMAT "%13.9" NUMBER 10 /end CHARACTERISTIC
/begin CHARACTERISTIC DSM_EnvDfp_InjVlvNVC3_C "Fehlerpfad spezifische Umweltbedingungen fuer Fehlerpfad Dfp_InjVlvNVC3" VAL_BLK 0xCBC35 Kwb_Wu8 255.000000000 SigName 0.00 255.000000000 FORMAT "%13.9" NUMBER 10 /end CHARACTERISTIC
/begin CHARACTERISTIC DSM_EnvDfp_InjVlvNVC4_C "Fehlerpfad spezifische Umweltbedingungen fuer Fehlerpfad Dfp_InjVlvNVC4" VAL_BLK 0xCBC3F Kwb_Wu8 255.000000000 SigName 0.00 255.000000000 FORMAT "%13.9" NUMBER 10 /end CHARACTERISTIC
/begin CHARACTERISTIC DSM_EnvDfp_InjVlvNVC5_C "Fehlerpfad spezifische Umweltbedingungen fuer Fehlerpfad Dfp_InjVlvNVC5" VAL_BLK 0xCBC49 Kwb_Wu8 255.000000000 SigName 0.00 255.000000000 FORMAT "%13.9" NUMBER 10 /end CHARACTERISTIC
/begin CHARACTERISTIC DSM_EnvDfp_InjVlvNVC6_C "Fehlerpfad spezifische Umweltbedingungen fuer Fehlerpfad Dfp_InjVlvNVC6" VAL_BLK 0xCBC53 Kwb_Wu8 255.000000000 SigName 0.00 255.000000000 FORMAT "%13.9" NUMBER 10 /end CHARACTERISTIC
/begin CHARACTERISTIC DSM_EnvDfp_InjVlvNVC7_C "Fehlerpfad spezifische Umweltbedingungen fuer Fehlerpfad Dfp_InjVlvNVC7" VAL_BLK 0xCBC5D Kwb_Wu8 255.000000000 SigName 0.00 255.000000000 FORMAT "%13.9" NUMBER 10 /end CHARACTERISTIC
/begin CHARACTERISTIC DSM_EnvDfp_InjVlvNVC8_C "Fehlerpfad spezifische Umweltbedingungen fuer Fehlerpfad Dfp_InjVlvNVC8" VAL_BLK 0xCBC67 Kwb_Wu8 255.000000000 SigName 0.00 255.000000000 FORMAT "%13.9" NUMBER 10 /end CHARACTERISTIC
/begin CHARACTERISTIC DSM_EnvDfp_LPACD_Max_C "Fehlerpfad spezifische Umweltbedingungen fuer Fehlerpfad Dfp_LPACD_Max" VAL_BLK 0xCBC71 Kwb_Wu8 255.000000000 SigName 0.00 255.000000000 FORMAT "%13.9" NUMBER 10 /end CHARACTERISTIC
/begin CHARACTERISTIC DSM_EnvDfp_LPACD_Min_C "Fehlerpfad spezifische Umweltbedingungen fuer Fehlerpfad Dfp_LPACD_Min" VAL_BLK 0xCBC7B Kwb_Wu8 255.000000000 SigName 0.00 255.000000000 FORMAT "%13.9" NUMBER 10 /end CHARACTERISTIC
/begin CHARACTERISTIC DSM_EnvDfp_LPACD_SigNpl_C "Fehlerpfad spezifische Umweltbedingungen fuer Fehlerpfad Dfp_LPACD_SigNpl" VAL_BLK 0xCBC85 Kwb_Wu8 255.000000000 SigName 0.00 255.000000000 FORMAT "%13.9" NUMBER 10 /end CHARACTERISTIC
/begin CHARACTERISTIC DSM_EnvDfp_LSUCDCircNernst0_C "Fehlerpfad spezifische Umweltbedingungen fuer Fehlerpfad Dfp_LSUCDCircNernst0" VAL_BLK 0xCBC8F Kwb_Wu8 255.000000000 SigName 0.00 255.000000000 FORMAT "%13.9" NUMBER 10 /end CHARACTERISTIC
/begin CHARACTERISTIC DSM_EnvDfp_LSUCDCircPumpCur0_C "Fehlerpfad spezifische Umweltbedingungen fuer Fehlerpfad Dfp_LSUCDCircPumpCur0" VAL_BLK 0xCBC99 Kwb_Wu8 255.000000000 SigName 0.00 255.000000000 FORMAT "%13.9" NUMBER 10 /end CHARACTERISTIC
/begin CHARACTERISTIC DSM_EnvDfp_LSUCDCircVirtGnd0_C "Fehlerpfad spezifische Umweltbedingungen fuer Fehlerpfad Dfp_LSUCDCircVirtGnd0" VAL_BLK 0xCBCA3 Kwb_Wu8 255.000000000 SigName 0.00 255.000000000 FORMAT "%13.9" NUMBER 10 /end CHARACTERISTIC
/begin CHARACTERISTIC DSM_EnvDfp_LSUCDHeater0_C "Fehlerpfad spezifische Umweltbedingungen fuer Fehlerpfad Dfp_LSUCDHeater0" VAL_BLK 0xCBCAD Kwb_Wu8 255.000000000 SigName 0.00 255.000000000 FORMAT "%13.9" NUMBER 10 /end CHARACTERISTIC
/begin CHARACTERISTIC DSM_EnvDfp_LSUCDHtCoup0_C "Fehlerpfad spezifische Umweltbedingungen fuer Fehlerpfad Dfp_LSUCDHtCoup0" VAL_BLK 0xCBCB7 Kwb_Wu8 255.000000000 SigName 0.00 255.000000000 FORMAT "%13.9" NUMBER 10 /end CHARACTERISTIC
/begin CHARACTERISTIC DSM_EnvDfp_LSUCDO20_C "Fehlerpfad spezifische Umweltbedingungen fuer Fehlerpfad Dfp_LSUCDO20" VAL_BLK 0xCBCC1 Kwb_Wu8 255.000000000 SigName 0.00 255.000000000 FORMAT "%13.9" NUMBER 10 /end CHARACTERISTIC
/begin CHARACTERISTIC DSM_EnvDfp_LSUCDO2Clb0_C "Fehlerpfad spezifische Umweltbedingungen fuer Fehlerpfad Dfp_LSUCDO2Clb0" VAL_BLK 0xCBCCB Kwb_Wu8 255.000000000 SigName 0.00 255.000000000 FORMAT "%13.9" NUMBER 10 /end CHARACTERISTIC
/begin CHARACTERISTIC DSM_EnvDfp_LSUCDRiClb0_C "Fehlerpfad spezifische Umweltbedingungen fuer Fehlerpfad Dfp_LSUCDRiClb0" VAL_BLK 0xCBCD5 Kwb_Wu8 255.000000000 SigName 0.00 255.000000000 FORMAT "%13.9" NUMBER 10 /end CHARACTERISTIC
/begin CHARACTERISTIC DSM_EnvDfp_LSUCDSPI0_C "Fehlerpfad spezifische Umweltbedingungen fuer Fehlerpfad Dfp_LSUCDSPI0" VAL_BLK 0xCBCDF Kwb_Wu8 255.000000000 SigName 0.00 255.000000000 FORMAT "%13.9" NUMBER 10 /end CHARACTERISTIC
/begin CHARACTERISTIC DSM_EnvDfp_LSUCDSPIBattLow0_C "Fehlerpfad spezifische Umweltbedingungen fuer Fehlerpfad Dfp_LSUCDSPIBattLow0" VAL_BLK 0xCBCE9 Kwb_Wu8 255.000000000 SigName 0.00 255.000000000 FORMAT "%13.9" NUMBER 10 /end CHARACTERISTIC
/begin CHARACTERISTIC DSM_EnvDfp_LSUCDWireIP0_C "Fehlerpfad spezifische Umweltbedingungen fuer Fehlerpfad Dfp_LSUCDWireIP0" VAL_BLK 0xCBCF3 Kwb_Wu8 255.000000000 SigName 0.00 255.000000000 FORMAT "%13.9" NUMBER 10 /end CHARACTERISTIC
/begin CHARACTERISTIC DSM_EnvDfp_LSUCtlRiExc0_C "Fehlerpfad spezifische Umweltbedingungen fuer Fehlerpfad Dfp_LSUCtlRiExc0" VAL_BLK 0xCBCFD Kwb_Wu8 255.000000000 SigName 0.00 255.000000000 FORMAT "%13.9" NUMBER 10 /end CHARACTERISTIC
/begin CHARACTERISTIC DSM_EnvDfp_LSUMon1Sens_C "Fehlerpfad spezifische Umweltbedingungen fuer Fehlerpfad Dfp_LSUMon1Sens" VAL_BLK 0xCBD07 Kwb_Wu8 255.000000000 SigName 0.00 255.000000000 FORMAT "%13.9" NUMBER 10 /end CHARACTERISTIC
/begin CHARACTERISTIC DSM_EnvDfp_LSUMon2Sens_C "Fehlerpfad spezifische Umweltbedingungen fuer Fehlerpfad Dfp_LSUMon2Sens" VAL_BLK 0xCBD11 Kwb_Wu8 255.000000000 SigName 0.00 255.000000000 FORMAT "%13.9" NUMBER 10 /end CHARACTERISTIC
/begin CHARACTERISTIC DSM_EnvDfp_MIL_C "Fehlerpfad spezifische Umweltbedingungen fuer Fehlerpfad Dfp_MIL" VAL_BLK 0xCBD1B Kwb_Wu8 255.000000000 SigName 0.00 255.000000000 FORMAT "%13.9" NUMBER 10 /end CHARACTERISTIC
/begin CHARACTERISTIC DSM_EnvDfp_MRlyCD_C "Fehlerpfad spezifische Umweltbedingungen fuer Fehlerpfad Dfp_MRlyCD" VAL_BLK 0xCBD25 Kwb_Wu8 255.000000000 SigName 0.00 255.000000000 FORMAT "%13.9" NUMBER 10 /end CHARACTERISTIC
/begin CHARACTERISTIC DSM_EnvDfp_MSidCD_Comm_C "Fehlerpfad spezifische Umweltbedingungen fuer Fehlerpfad Dfp_MSidCD_Comm" VAL_BLK 0xCBD2F Kwb_Wu8 255.000000000 SigName 0.00 255.000000000 FORMAT "%13.9" NUMBER 10 /end CHARACTERISTIC
/begin CHARACTERISTIC DSM_EnvDfp_MSidCD_Pin_C "Fehlerpfad spezifische Umweltbedingungen fuer Fehlerpfad Dfp_MSidCD_Pin" VAL_BLK 0xCBD39 Kwb_Wu8 255.000000000 SigName 0.00 255.000000000 FORMAT "%13.9" NUMBER 10 /end CHARACTERISTIC
/begin CHARACTERISTIC DSM_EnvDfp_MSidCD_Sel_INI_C "Fehlerpfad spezifische Umweltbedingungen fuer Fehlerpfad Dfp_MSidCD_Sel_INI" VAL_BLK 0xCBD43 Kwb_Wu8 255.000000000 SigName 0.00 255.000000000 FORMAT "%13.9" NUMBER 10 /end CHARACTERISTIC
/begin CHARACTERISTIC DSM_EnvDfp_MSidCD_Select_C "Fehlerpfad spezifische Umweltbedingungen fuer Fehlerpfad Dfp_MSidCD_Select" VAL_BLK 0xCBD4D Kwb_Wu8 255.000000000 SigName 0.00 255.000000000 FORMAT "%13.9" NUMBER 10 /end CHARACTERISTIC
/begin CHARACTERISTIC DSM_EnvDfp_MeUnCDNoLoad_C "Fehlerpfad spezifische Umweltbedingungen fuer Fehlerpfad Dfp_MeUnCDNoLoad" VAL_BLK 0xCBD57 Kwb_Wu8 255.000000000 SigName 0.00 255.000000000 FORMAT "%13.9" NUMBER 10 /end CHARACTERISTIC
/begin CHARACTERISTIC DSM_EnvDfp_MeUnCDSCBat_C "Fehlerpfad spezifische Umweltbedingungen fuer Fehlerpfad Dfp_MeUnCDSCBat" VAL_BLK 0xCBD61 Kwb_Wu8 255.000000000 SigName 0.00 255.000000000 FORMAT "%13.9" NUMBER 10 /end CHARACTERISTIC
/begin CHARACTERISTIC DSM_EnvDfp_MeUnCDSCGnd_C "Fehlerpfad spezifische Umweltbedingungen fuer Fehlerpfad Dfp_MeUnCDSCGnd" VAL_BLK 0xCBD6B Kwb_Wu8 255.000000000 SigName 0.00 255.000000000 FORMAT "%13.9" NUMBER 10 /end CHARACTERISTIC
/begin CHARACTERISTIC DSM_EnvDfp_MeUnCD_ADC_C "Fehlerpfad spezifische Umweltbedingungen fuer Fehlerpfad Dfp_MeUnCD_ADC" VAL_BLK 0xCBD75 Kwb_Wu8 255.000000000 SigName 0.00 255.000000000 FORMAT "%13.9" NUMBER 10 /end CHARACTERISTIC
/begin CHARACTERISTIC DSM_EnvDfp_MeUnCD_SigTst_C "Fehlerpfad spezifische Umweltbedingungen fuer Fehlerpfad Dfp_MeUnCD_SigTst" VAL_BLK 0xCBD7F Kwb_Wu8 255.000000000 SigName 0.00 255.000000000 FORMAT "%13.9" NUMBER 10 /end CHARACTERISTIC
/begin CHARACTERISTIC DSM_EnvDfp_Montr_C "Fehlerpfad spezifische Umweltbedingungen fuer Fehlerpfad Dfp_Montr" VAL_BLK 0xCBD89 Kwb_Wu8 255.000000000 SigName 0.00 255.000000000 FORMAT "%13.9" NUMBER 10 /end CHARACTERISTIC
/begin CHARACTERISTIC DSM_EnvDfp_NetMngDeviceA_C "Fehlerpfad spezifische Umweltbedingungen fuer Fehlerpfad Dfp_NetMngDeviceA" VAL_BLK 0xCBD93 Kwb_Wu8 255.000000000 SigName 0.00 255.000000000 FORMAT "%13.9" NUMBER 10 /end CHARACTERISTIC
/begin CHARACTERISTIC DSM_EnvDfp_NetMngDeviceB_C "Fehlerpfad spezifische Umweltbedingungen fuer Fehlerpfad Dfp_NetMngDeviceB" VAL_BLK 0xCBD9D Kwb_Wu8 255.000000000 SigName 0.00 255.000000000 FORMAT "%13.9" NUMBER 10 /end CHARACTERISTIC
/begin CHARACTERISTIC DSM_EnvDfp_NetMngDeviceC_C "Fehlerpfad spezifische Umweltbedingungen fuer Fehlerpfad Dfp_NetMngDeviceC" VAL_BLK 0xCBDA7 Kwb_Wu8 255.000000000 SigName 0.00 255.000000000 FORMAT "%13.9" NUMBER 10 /end CHARACTERISTIC
/begin CHARACTERISTIC DSM_EnvDfp_OPSCD_Lamp_C "Fehlerpfad spezifische Umweltbedingungen fuer Fehlerpfad Dfp_OPSCD_Lamp" VAL_BLK 0xCBDB1 Kwb_Wu8 255.000000000 SigName 0.00 255.000000000 FORMAT "%13.9" NUMBER 10 /end CHARACTERISTIC
/begin CHARACTERISTIC DSM_EnvDfp_OPSCD_anain_C "Fehlerpfad spezifische Umweltbedingungen fuer Fehlerpfad Dfp_OPSCD_anain" VAL_BLK 0xCBDBB Kwb_Wu8 255.000000000 SigName 0.00 255.000000000 FORMAT "%13.9" NUMBER 10 /end CHARACTERISTIC
/begin CHARACTERISTIC DSM_EnvDfp_OTSCD_C "Fehlerpfad spezifische Umweltbedingungen fuer Fehlerpfad Dfp_OTSCD" VAL_BLK 0xCBDC5 Kwb_Wu8 255.000000000 SigName 0.00 255.000000000 FORMAT "%13.9" NUMBER 10 /end CHARACTERISTIC
/begin CHARACTERISTIC DSM_EnvDfp_OvRMon_C "Fehlerpfad spezifische Umweltbedingungen fuer Fehlerpfad Dfp_OvRMon" VAL_BLK 0xCBDCF Kwb_Wu8 255.000000000 SigName 0.00 255.000000000 FORMAT "%13.9" NUMBER 10 /end CHARACTERISTIC
/begin CHARACTERISTIC DSM_EnvDfp_OvRMonBrk_C "path specific environment  condition for fault path Dfp_OvRMonBrk" VAL_BLK 0xCBDD9 Kwb_Wu8 255.000000000 SigName 0.00 255.000000000 FORMAT "%13.9" NUMBER 10 /end CHARACTERISTIC
/begin CHARACTERISTIC DSM_EnvDfp_OvRMonSigA_C "Fehlerpfad spezifische Umweltbedingungen fuer Fehlerpfad Dfp_OvRMonSigA" VAL_BLK 0xCBDE3 Kwb_Wu8 255.000000000 SigName 0.00 255.000000000 FORMAT "%13.9" NUMBER 10 /end CHARACTERISTIC
/begin CHARACTERISTIC DSM_EnvDfp_OxiCCDTPre_C "Fehlerpfad spezifische Umweltbedingungen fuer Fehlerpfad Dfp_OxiCCDTPre" VAL_BLK 0xCBDED Kwb_Wu8 255.000000000 SigName 0.00 255.000000000 FORMAT "%13.9" NUMBER 10 /end CHARACTERISTIC
/begin CHARACTERISTIC DSM_EnvDfp_PCR_GovDevNeg_C "Fehlerpfad spezifische Umweltbedingungen fuer Fehlerpfad Dfp_PCR_GovDevNeg" VAL_BLK 0xCBDF7 Kwb_Wu8 255.000000000 SigName 0.00 255.000000000 FORMAT "%13.9" NUMBER 10 /end CHARACTERISTIC
/begin CHARACTERISTIC DSM_EnvDfp_PCR_GovDevPos_C "Fehlerpfad spezifische Umweltbedingungen fuer Fehlerpfad Dfp_PCR_GovDevPos" VAL_BLK 0xCBE01 Kwb_Wu8 255.000000000 SigName 0.00 255.000000000 FORMAT "%13.9" NUMBER 10 /end CHARACTERISTIC
/begin CHARACTERISTIC DSM_EnvDfp_PCR_LPGvnrDvtNeg_C "Fehlerpfad spezifische Umweltbedingungen fuer Fehlerpfad Dfp_PCR_LPGvnrDvtNeg" VAL_BLK 0xCBE0B Kwb_Wu8 255.000000000 SigName 0.00 255.000000000 FORMAT "%13.9" NUMBER 10 /end CHARACTERISTIC
/begin CHARACTERISTIC DSM_EnvDfp_PCR_LPGvnrDvtPos_C "Fehlerpfad spezifische Umweltbedingungen fuer Fehlerpfad Dfp_PCR_LPGvnrDvtPos" VAL_BLK 0xCBE15 Kwb_Wu8 255.000000000 SigName 0.00 255.000000000 FORMAT "%13.9" NUMBER 10 /end CHARACTERISTIC
/begin CHARACTERISTIC DSM_EnvDfp_PCVCDNoLoad_C "Fehlerpfad spezifische Umweltbedingungen fuer Fehlerpfad Dfp_PCVCDNoLoad" VAL_BLK 0xCBE1F Kwb_Wu8 255.000000000 SigName 0.00 255.000000000 FORMAT "%13.9" NUMBER 10 /end CHARACTERISTIC
/begin CHARACTERISTIC DSM_EnvDfp_PCVCDSCBat_C "Fehlerpfad spezifische Umweltbedingungen fuer Fehlerpfad Dfp_PCVCDSCBat" VAL_BLK 0xCBE29 Kwb_Wu8 255.000000000 SigName 0.00 255.000000000 FORMAT "%13.9" NUMBER 10 /end CHARACTERISTIC
/begin CHARACTERISTIC DSM_EnvDfp_PCVCDSCGnd_C "Fehlerpfad spezifische Umweltbedingungen fuer Fehlerpfad Dfp_PCVCDSCGnd" VAL_BLK 0xCBE33 Kwb_Wu8 255.000000000 SigName 0.00 255.000000000 FORMAT "%13.9" NUMBER 10 /end CHARACTERISTIC
/begin CHARACTERISTIC DSM_EnvDfp_PCVCD_ADC_C "Fehlerpfad spezifische Umweltbedingungen fuer Fehlerpfad Dfp_PCVCD_ADC" VAL_BLK 0xCBE3D Kwb_Wu8 255.000000000 SigName 0.00 255.000000000 FORMAT "%13.9" NUMBER 10 /end CHARACTERISTIC
/begin CHARACTERISTIC DSM_EnvDfp_PCVCD_SigTst_C "Fehlerpfad spezifische Umweltbedingungen fuer Fehlerpfad Dfp_PCVCD_SigTst" VAL_BLK 0xCBE47 Kwb_Wu8 255.000000000 SigName 0.00 255.000000000 FORMAT "%13.9" NUMBER 10 /end CHARACTERISTIC
/begin CHARACTERISTIC DSM_EnvDfp_PFltAPSPlaus_C "Fehlerpfad spezifische Umweltbedingungen fuer Fehlerpfad Dfp_PFltAPSPlaus" VAL_BLK 0xCBE51 Kwb_Wu8 255.000000000 SigName 0.00 255.000000000 FORMAT "%13.9" NUMBER 10 /end CHARACTERISTIC
/begin CHARACTERISTIC DSM_EnvDfp_PFltAPSens_C "Fehlerpfad spezifische Umweltbedingungen fuer Fehlerpfad Dfp_PFltAPSens" VAL_BLK 0xCBE5B Kwb_Wu8 255.000000000 SigName 0.00 255.000000000 FORMAT "%13.9" NUMBER 10 /end CHARACTERISTIC
/begin CHARACTERISTIC DSM_EnvDfp_PFltBPSPlaus_C "Fehlerpfad spezifische Umweltbedingungen fuer Fehlerpfad Dfp_PFltBPSPlaus" VAL_BLK 0xCBE65 Kwb_Wu8 255.000000000 SigName 0.00 255.000000000 FORMAT "%13.9" NUMBER 10 /end CHARACTERISTIC
/begin CHARACTERISTIC DSM_EnvDfp_PFltCDPPre_C "Fehlerpfad spezifische Umweltbedingungen fuer Fehlerpfad Dfp_PFltCDPPre" VAL_BLK 0xCBE6F Kwb_Wu8 255.000000000 SigName 0.00 255.000000000 FORMAT "%13.9" NUMBER 10 /end CHARACTERISTIC
/begin CHARACTERISTIC DSM_EnvDfp_PFltCDTempPre_C "Fehlerpfad spezifische Umweltbedingungen fuer Fehlerpfad Dfp_PFltCDTempPre" VAL_BLK 0xCBE79 Kwb_Wu8 255.000000000 SigName 0.00 255.000000000 FORMAT "%13.9" NUMBER 10 /end CHARACTERISTIC
/begin CHARACTERISTIC DSM_EnvDfp_PFltChar_C "Fehlerpfad spezifische Umweltbedingungen fuer Fehlerpfad Dfp_PFltChar" VAL_BLK 0xCBE83 Kwb_Wu8 255.000000000 SigName 0.00 255.000000000 FORMAT "%13.9" NUMBER 10 /end CHARACTERISTIC
/begin CHARACTERISTIC DSM_EnvDfp_PFltEngPrt_C "Fehlerpfad spezifische Umweltbedingungen fuer Fehlerpfad Dfp_PFltEngPrt" VAL_BLK 0xCBE8D Kwb_Wu8 255.000000000 SigName 0.00 255.000000000 FORMAT "%13.9" NUMBER 10 /end CHARACTERISTIC
/begin CHARACTERISTIC DSM_EnvDfp_PFltPresDynPlaus_C "Fehlerpfad spezifische Umweltbedingungen fuer Fehlerpfad Dfp_PFltPresDynPlaus" VAL_BLK 0xCBE97 Kwb_Wu8 255.000000000 SigName 0.00 255.000000000 FORMAT "%13.9" NUMBER 10 /end CHARACTERISTIC
/begin CHARACTERISTIC DSM_EnvDfp_PFltPresPlaus_C "Fehlerpfad spezifische Umweltbedingungen fuer Fehlerpfad Dfp_PFltPresPlaus" VAL_BLK 0xCBEA1 Kwb_Wu8 255.000000000 SigName 0.00 255.000000000 FORMAT "%13.9" NUMBER 10 /end CHARACTERISTIC
/begin CHARACTERISTIC DSM_EnvDfp_PFltPresSens_C "Fehlerpfad spezifische Umweltbedingungen fuer Fehlerpfad Dfp_PFltPresSens" VAL_BLK 0xCBEAB Kwb_Wu8 255.000000000 SigName 0.00 255.000000000 FORMAT "%13.9" NUMBER 10 /end CHARACTERISTIC
/begin CHARACTERISTIC DSM_EnvDfp_PFltPresSensFrz_C "Fehlerpfad spezifische Umweltbedingungen fuer Fehlerpfad Dfp_PFltPresSensFrz" VAL_BLK 0xCBEB5 Kwb_Wu8 255.000000000 SigName 0.00 255.000000000 FORMAT "%13.9" NUMBER 10 /end CHARACTERISTIC
/begin CHARACTERISTIC DSM_EnvDfp_PFltPresSensHsLn_C "Fehlerpfad spezifische Umweltbedingungen fuer Fehlerpfad Dfp_PFltPresSensHsLn" VAL_BLK 0xCBEBF Kwb_Wu8 255.000000000 SigName 0.00 255.000000000 FORMAT "%13.9" NUMBER 10 /end CHARACTERISTIC
/begin CHARACTERISTIC DSM_EnvDfp_PFltPresSensSot_C "Fehlerpfad spezifische Umweltbedingungen fuer Fehlerpfad Dfp_PFltPresSensSot" VAL_BLK 0xCBEC9 Kwb_Wu8 255.000000000 SigName 0.00 255.000000000 FORMAT "%13.9" NUMBER 10 /end CHARACTERISTIC
/begin CHARACTERISTIC DSM_EnvDfp_PFltRgnPerm_C "Fehlerpfad spezifische Umweltbedingungen fuer Fehlerpfad Dfp_PFltRgnPerm" VAL_BLK 0xCBED3 Kwb_Wu8 255.000000000 SigName 0.00 255.000000000 FORMAT "%13.9" NUMBER 10 /end CHARACTERISTIC
/begin CHARACTERISTIC DSM_EnvDfp_PFltTempDwnStrm_C "Fehlerpfad spezifische Umweltbedingungen fuer Fehlerpfad Dfp_PFltTempDwnStrm" VAL_BLK 0xCBEDD Kwb_Wu8 255.000000000 SigName 0.00 255.000000000 FORMAT "%13.9" NUMBER 10 /end CHARACTERISTIC
/begin CHARACTERISTIC DSM_EnvDfp_PFltTempSens_C "Fehlerpfad spezifische Umweltbedingungen fuer Fehlerpfad Dfp_PFltTempSens" VAL_BLK 0xCBEE7 Kwb_Wu8 255.000000000 SigName 0.00 255.000000000 FORMAT "%13.9" NUMBER 10 /end CHARACTERISTIC
/begin CHARACTERISTIC DSM_EnvDfp_PFltTempUpStrm_C "Fehlerpfad spezifische Umweltbedingungen fuer Fehlerpfad Dfp_PFltTempUpStrm" VAL_BLK 0xCBEF1 Kwb_Wu8 255.000000000 SigName 0.00 255.000000000 FORMAT "%13.9" NUMBER 10 /end CHARACTERISTIC
/begin CHARACTERISTIC DSM_EnvDfp_PFltmSotDiffMax_C "Fehlerpfad spezifische Umweltbedingungen fuer Fehlerpfad Dfp_PFltmSotDiffMax" VAL_BLK 0xCBEFB Kwb_Wu8 255.000000000 SigName 0.00 255.000000000 FORMAT "%13.9" NUMBER 10 /end CHARACTERISTIC
/begin CHARACTERISTIC DSM_EnvDfp_PSPCD_Actr_C "Fehlerpfad spezifische Umweltbedingungen fuer Fehlerpfad Dfp_PSPCD_Actr" VAL_BLK 0xCBF05 Kwb_Wu8 255.000000000 SigName 0.00 255.000000000 FORMAT "%13.9" NUMBER 10 /end CHARACTERISTIC
/begin CHARACTERISTIC DSM_EnvDfp_PresPlausDblDef_C "Fehlerpfad spezifische Umweltbedingungen fuer Fehlerpfad Dfp_PresPlausDblDef" VAL_BLK 0xCBF0F Kwb_Wu8 255.000000000 SigName 0.00 255.000000000 FORMAT "%13.9" NUMBER 10 /end CHARACTERISTIC
/begin CHARACTERISTIC DSM_EnvDfp_QLTCD_C "Fehlerpfad spezifische Umweltbedingungen fuer Fehlerpfad Dfp_QLTCD" VAL_BLK 0xCBF19 Kwb_Wu8 255.000000000 SigName 0.00 255.000000000 FORMAT "%13.9" NUMBER 10 /end CHARACTERISTIC
/begin CHARACTERISTIC DSM_EnvDfp_RailCD_C "Fehlerpfad spezifische Umweltbedingungen fuer Fehlerpfad Dfp_RailCD" VAL_BLK 0xCBF23 Kwb_Wu8 255.000000000 SigName 0.00 255.000000000 FORMAT "%13.9" NUMBER 10 /end CHARACTERISTIC
/begin CHARACTERISTIC DSM_EnvDfp_RailCDOfsTst_C "Fehlerpfad spezifische Umweltbedingungen fuer Fehlerpfad Dfp_RailCDOfsTst" VAL_BLK 0xCBF2D Kwb_Wu8 255.000000000 SigName 0.00 255.000000000 FORMAT "%13.9" NUMBER 10 /end CHARACTERISTIC
/begin CHARACTERISTIC DSM_EnvDfp_RailCD_PMonStrt_C "Fehlerpfad spezifische Umweltbedingungen fuer Fehlerpfad Dfp_RailCD_PMonStrt" VAL_BLK 0xCBF37 Kwb_Wu8 255.000000000 SigName 0.00 255.000000000 FORMAT "%13.9" NUMBER 10 /end CHARACTERISTIC
/begin CHARACTERISTIC DSM_EnvDfp_RailCtlModeMeUnDiag_C "Fehlerpfad spezifische Umweltbedingungen fuer Fehlerpfad Dfp_RailCtlModeMeUnDiag" VAL_BLK 0xCBF41 Kwb_Wu8 255.000000000 SigName 0.00 255.000000000 FORMAT "%13.9" NUMBER 10 /end CHARACTERISTIC
/begin CHARACTERISTIC DSM_EnvDfp_RailCtlModePCVDiag_C "Fehlerpfad spezifische Umweltbedingungen fuer Fehlerpfad Dfp_RailCtlModePCVDiag" VAL_BLK 0xCBF4B Kwb_Wu8 255.000000000 SigName 0.00 255.000000000 FORMAT "%13.9" NUMBER 10 /end CHARACTERISTIC
/begin CHARACTERISTIC DSM_EnvDfp_RailMeUn0_C "Fehlerpfad spezifische Umweltbedingungen fuer Fehlerpfad Dfp_RailMeUn0" VAL_BLK 0xCBF55 Kwb_Wu8 255.000000000 SigName 0.00 255.000000000 FORMAT "%13.9" NUMBER 10 /end CHARACTERISTIC
/begin CHARACTERISTIC DSM_EnvDfp_RailMeUn1_C "Fehlerpfad spezifische Umweltbedingungen fuer Fehlerpfad Dfp_RailMeUn1" VAL_BLK 0xCBF5F Kwb_Wu8 255.000000000 SigName 0.00 255.000000000 FORMAT "%13.9" NUMBER 10 /end CHARACTERISTIC
/begin CHARACTERISTIC DSM_EnvDfp_RailMeUn2_C "Fehlerpfad spezifische Umweltbedingungen fuer Fehlerpfad Dfp_RailMeUn2" VAL_BLK 0xCBF69 Kwb_Wu8 255.000000000 SigName 0.00 255.000000000 FORMAT "%13.9" NUMBER 10 /end CHARACTERISTIC
/begin CHARACTERISTIC DSM_EnvDfp_RailMeUn3_C "Fehlerpfad spezifische Umweltbedingungen fuer Fehlerpfad Dfp_RailMeUn3" VAL_BLK 0xCBF73 Kwb_Wu8 255.000000000 SigName 0.00 255.000000000 FORMAT "%13.9" NUMBER 10 /end CHARACTERISTIC
/begin CHARACTERISTIC DSM_EnvDfp_RailMeUn4_C "Fehlerpfad spezifische Umweltbedingungen fuer Fehlerpfad Dfp_RailMeUn4" VAL_BLK 0xCBF7D Kwb_Wu8 255.000000000 SigName 0.00 255.000000000 FORMAT "%13.9" NUMBER 10 /end CHARACTERISTIC
/begin CHARACTERISTIC DSM_EnvDfp_RailPCV0_C "Fehlerpfad spezifische Umweltbedingungen fuer Fehlerpfad Dfp_RailPCV0" VAL_BLK 0xCBF87 Kwb_Wu8 255.000000000 SigName 0.00 255.000000000 FORMAT "%13.9" NUMBER 10 /end CHARACTERISTIC
/begin CHARACTERISTIC DSM_EnvDfp_RailPCV1_C "Fehlerpfad spezifische Umweltbedingungen fuer Fehlerpfad Dfp_RailPCV1" VAL_BLK 0xCBF91 Kwb_Wu8 255.000000000 SigName 0.00 255.000000000 FORMAT "%13.9" NUMBER 10 /end CHARACTERISTIC
/begin CHARACTERISTIC DSM_EnvDfp_RailPCV2_C "Fehlerpfad spezifische Umweltbedingungen fuer Fehlerpfad Dfp_RailPCV2" VAL_BLK 0xCBF9B Kwb_Wu8 255.000000000 SigName 0.00 255.000000000 FORMAT "%13.9" NUMBER 10 /end CHARACTERISTIC
/begin CHARACTERISTIC DSM_EnvDfp_RailPCV3_C "Fehlerpfad spezifische Umweltbedingungen fuer Fehlerpfad Dfp_RailPCV3" VAL_BLK 0xCBFA5 Kwb_Wu8 255.000000000 SigName 0.00 255.000000000 FORMAT "%13.9" NUMBER 10 /end CHARACTERISTIC
/begin CHARACTERISTIC DSM_EnvDfp_RailPCV4_C "Fehlerpfad spezifische Umweltbedingungen fuer Fehlerpfad Dfp_RailPCV4" VAL_BLK 0xCBFAF Kwb_Wu8 255.000000000 SigName 0.00 255.000000000 FORMAT "%13.9" NUMBER 10 /end CHARACTERISTIC
/begin CHARACTERISTIC DSM_EnvDfp_RailPCV5_C "Fehlerpfad spezifische Umweltbedingungen fuer Fehlerpfad Dfp_RailPCV5" VAL_BLK 0xCBFB9 Kwb_Wu8 255.000000000 SigName 0.00 255.000000000 FORMAT "%13.9" NUMBER 10 /end CHARACTERISTIC
/begin CHARACTERISTIC DSM_EnvDfp_SOPTst_C "Fehlerpfad spezifische Umweltbedingungen fuer Fehlerpfad Dfp_SOPTst" VAL_BLK 0xCBFC3 Kwb_Wu8 255.000000000 SigName 0.00 255.000000000 FORMAT "%13.9" NUMBER 10 /end CHARACTERISTIC
/begin CHARACTERISTIC DSM_EnvDfp_SSpMon1_C "Fehlerpfad spezifische Umweltbedingungen fuer Fehlerpfad Dfp_SSpMon1" VAL_BLK 0xCBFCD Kwb_Wu8 255.000000000 SigName 0.00 255.000000000 FORMAT "%13.9" NUMBER 10 /end CHARACTERISTIC
/begin CHARACTERISTIC DSM_EnvDfp_SSpMon2_C "Fehlerpfad spezifische Umweltbedingungen fuer Fehlerpfad Dfp_SSpMon2" VAL_BLK 0xCBFD7 Kwb_Wu8 255.000000000 SigName 0.00 255.000000000 FORMAT "%13.9" NUMBER 10 /end CHARACTERISTIC
/begin CHARACTERISTIC DSM_EnvDfp_SSpMon3_C "Fehlerpfad spezifische Umweltbedingungen fuer Fehlerpfad Dfp_SSpMon3" VAL_BLK 0xCBFE1 Kwb_Wu8 255.000000000 SigName 0.00 255.000000000 FORMAT "%13.9" NUMBER 10 /end CHARACTERISTIC
/begin CHARACTERISTIC DSM_EnvDfp_SWChk_CycSigChkDat_C "Fehlerpfad spezifische Umweltbedingungen fuer Fehlerpfad Dfp_SWChk_CycSigChkDat" VAL_BLK 0xCBFEB Kwb_Wu8 255.000000000 SigName 0.00 255.000000000 FORMAT "%13.9" NUMBER 10 /end CHARACTERISTIC
/begin CHARACTERISTIC DSM_EnvDfp_SWChk_CycSigChkPrg_C "Fehlerpfad spezifische Umweltbedingungen fuer Fehlerpfad Dfp_SWChk_CycSigChkPrg" VAL_BLK 0xCBFF5 Kwb_Wu8 255.000000000 SigName 0.00 255.000000000 FORMAT "%13.9" NUMBER 10 /end CHARACTERISTIC
/begin CHARACTERISTIC DSM_EnvDfp_ShutCD_C "Fehlerpfad spezifische Umweltbedingungen fuer Fehlerpfad Dfp_ShutCD" VAL_BLK 0xCBFFF Kwb_Wu8 255.000000000 SigName 0.00 255.000000000 FORMAT "%13.9" NUMBER 10 /end CHARACTERISTIC
/begin CHARACTERISTIC DSM_EnvDfp_StSysTrqShutOff_C "Fehlerpfad spezifische Umweltbedingungen fuer Fehlerpfad Dfp_StSysTrqShutOff" VAL_BLK 0xCC009 Kwb_Wu8 255.000000000 SigName 0.00 255.000000000 FORMAT "%13.9" NUMBER 10 /end CHARACTERISTIC
/begin CHARACTERISTIC DSM_EnvDfp_StrtCD_Actr_C "Fehlerpfad spezifische Umweltbedingungen fuer Fehlerpfad Dfp_StrtCD_Actr" VAL_BLK 0xCC013 Kwb_Wu8 255.000000000 SigName 0.00 255.000000000 FORMAT "%13.9" NUMBER 10 /end CHARACTERISTIC
/begin CHARACTERISTIC DSM_EnvDfp_SysLamp_C "Fehlerpfad spezifische Umweltbedingungen fuer Fehlerpfad Dfp_SysLamp" VAL_BLK 0xCC01D Kwb_Wu8 255.000000000 SigName 0.00 255.000000000 FORMAT "%13.9" NUMBER 10 /end CHARACTERISTIC
/begin CHARACTERISTIC DSM_EnvDfp_T15CD_C "Fehlerpfad spezifische Umweltbedingungen fuer Fehlerpfad Dfp_T15CD" VAL_BLK 0xCC027 Kwb_Wu8 255.000000000 SigName 0.00 255.000000000 FORMAT "%13.9" NUMBER 10 /end CHARACTERISTIC
/begin CHARACTERISTIC DSM_EnvDfp_TGearbx_C "Fehlerpfad spezifische Umweltbedingungen fuer Fehlerpfad Dfp_TGearbx" VAL_BLK 0xCC031 Kwb_Wu8 255.000000000 SigName 0.00 255.000000000 FORMAT "%13.9" NUMBER 10 /end CHARACTERISTIC
/begin CHARACTERISTIC DSM_EnvDfp_TPUMon_C "Fehlerpfad spezifische Umweltbedingungen fuer Fehlerpfad Dfp_TPUMon" VAL_BLK 0xCC03B Kwb_Wu8 255.000000000 SigName 0.00 255.000000000 FORMAT "%13.9" NUMBER 10 /end CHARACTERISTIC
/begin CHARACTERISTIC DSM_EnvDfp_TVACD_Max_C "Fehlerpfad spezifische Umweltbedingungen fuer Fehlerpfad Dfp_TVACD_Max" VAL_BLK 0xCC045 Kwb_Wu8 255.000000000 SigName 0.00 255.000000000 FORMAT "%13.9" NUMBER 10 /end CHARACTERISTIC
/begin CHARACTERISTIC DSM_EnvDfp_TVACD_Min_C "Fehlerpfad spezifische Umweltbedingungen fuer Fehlerpfad Dfp_TVACD_Min" VAL_BLK 0xCC04F Kwb_Wu8 255.000000000 SigName 0.00 255.000000000 FORMAT "%13.9" NUMBER 10 /end CHARACTERISTIC
/begin CHARACTERISTIC DSM_EnvDfp_TVACD_SigNpl_C "Fehlerpfad spezifische Umweltbedingungen fuer Fehlerpfad Dfp_TVACD_SigNpl" VAL_BLK 0xCC059 Kwb_Wu8 255.000000000 SigName 0.00 255.000000000 FORMAT "%13.9" NUMBER 10 /end CHARACTERISTIC
/begin CHARACTERISTIC DSM_EnvDfp_TVACD_TVADia1_C "Fehlerpfad spezifische Umweltbedingungen fuer Fehlerpfad Dfp_TVACD_TVADia1" VAL_BLK 0xCC063 Kwb_Wu8 255.000000000 SigName 0.00 255.000000000 FORMAT "%13.9" NUMBER 10 /end CHARACTERISTIC
/begin CHARACTERISTIC DSM_EnvDfp_TVACD_TVADia2_C "Fehlerpfad spezifische Umweltbedingungen fuer Fehlerpfad Dfp_TVACD_TVADia2" VAL_BLK 0xCC06D Kwb_Wu8 255.000000000 SigName 0.00 255.000000000 FORMAT "%13.9" NUMBER 10 /end CHARACTERISTIC
/begin CHARACTERISTIC DSM_EnvDfp_TVACD_TVADia3_C "Fehlerpfad spezifische Umweltbedingungen fuer Fehlerpfad Dfp_TVACD_TVADia3" VAL_BLK 0xCC077 Kwb_Wu8 255.000000000 SigName 0.00 255.000000000 FORMAT "%13.9" NUMBER 10 /end CHARACTERISTIC
/begin CHARACTERISTIC DSM_EnvDfp_TVACD_TVADia4_C "Fehlerpfad spezifische Umweltbedingungen fuer Fehlerpfad Dfp_TVACD_TVADia4" VAL_BLK 0xCC081 Kwb_Wu8 255.000000000 SigName 0.00 255.000000000 FORMAT "%13.9" NUMBER 10 /end CHARACTERISTIC
/begin CHARACTERISTIC DSM_EnvDfp_VSACD_DioInDia1_C "Fehlerpfad spezifische Umweltbedingungen fuer Fehlerpfad Dfp_VSACD_DioInDia1" VAL_BLK 0xCC08B Kwb_Wu8 255.000000000 SigName 0.00 255.000000000 FORMAT "%13.9" NUMBER 10 /end CHARACTERISTIC
/begin CHARACTERISTIC DSM_EnvDfp_VSACD_DioInDia2_C "Fehlerpfad spezifische Umweltbedingungen fuer Fehlerpfad Dfp_VSACD_DioInDia2" VAL_BLK 0xCC095 Kwb_Wu8 255.000000000 SigName 0.00 255.000000000 FORMAT "%13.9" NUMBER 10 /end CHARACTERISTIC
/begin CHARACTERISTIC DSM_EnvDfp_VSACD_DioInDia3_C "Fehlerpfad spezifische Umweltbedingungen fuer Fehlerpfad Dfp_VSACD_DioInDia3" VAL_BLK 0xCC09F Kwb_Wu8 255.000000000 SigName 0.00 255.000000000 FORMAT "%13.9" NUMBER 10 /end CHARACTERISTIC
/begin CHARACTERISTIC DSM_EnvDfp_VSACD_DioInDia4_C "Fehlerpfad spezifische Umweltbedingungen fuer Fehlerpfad Dfp_VSACD_DioInDia4" VAL_BLK 0xCC0A9 Kwb_Wu8 255.000000000 SigName 0.00 255.000000000 FORMAT "%13.9" NUMBER 10 /end CHARACTERISTIC
/begin CHARACTERISTIC DSM_EnvDfp_VSACD_DioInMin_C "Fehlerpfad spezifische Umweltbedingungen fuer Fehlerpfad Dfp_VSACD_DioInMin" VAL_BLK 0xCC0B3 Kwb_Wu8 255.000000000 SigName 0.00 255.000000000 FORMAT "%13.9" NUMBER 10 /end CHARACTERISTIC
/begin CHARACTERISTIC DSM_EnvDfp_VSACD_Max_C "Fehlerpfad spezifische Umweltbedingungen fuer Fehlerpfad Dfp_VSACD_Max" VAL_BLK 0xCC0BD Kwb_Wu8 255.000000000 SigName 0.00 255.000000000 FORMAT "%13.9" NUMBER 10 /end CHARACTERISTIC
/begin CHARACTERISTIC DSM_EnvDfp_VSACD_Min_C "Fehlerpfad spezifische Umweltbedingungen fuer Fehlerpfad Dfp_VSACD_Min" VAL_BLK 0xCC0C7 Kwb_Wu8 255.000000000 SigName 0.00 255.000000000 FORMAT "%13.9" NUMBER 10 /end CHARACTERISTIC
/begin CHARACTERISTIC DSM_EnvDfp_VSACD_SigNpl_C "Fehlerpfad spezifische Umweltbedingungen fuer Fehlerpfad Dfp_VSACD_SigNpl" VAL_BLK 0xCC0D1 Kwb_Wu8 255.000000000 SigName 0.00 255.000000000 FORMAT "%13.9" NUMBER 10 /end CHARACTERISTIC
/begin CHARACTERISTIC DSM_EnvDfp_VSACD_VSADia1_C "Fehlerpfad spezifische Umweltbedingungen fuer Fehlerpfad Dfp_VSACD_VSADia1" VAL_BLK 0xCC0DB Kwb_Wu8 255.000000000 SigName 0.00 255.000000000 FORMAT "%13.9" NUMBER 10 /end CHARACTERISTIC
/begin CHARACTERISTIC DSM_EnvDfp_VSACD_VSADia2_C "Fehlerpfad spezifische Umweltbedingungen fuer Fehlerpfad Dfp_VSACD_VSADia2" VAL_BLK 0xCC0E5 Kwb_Wu8 255.000000000 SigName 0.00 255.000000000 FORMAT "%13.9" NUMBER 10 /end CHARACTERISTIC
/begin CHARACTERISTIC DSM_EnvDfp_VSACD_VSADia3_C "Fehlerpfad spezifische Umweltbedingungen fuer Fehlerpfad Dfp_VSACD_VSADia3" VAL_BLK 0xCC0EF Kwb_Wu8 255.000000000 SigName 0.00 255.000000000 FORMAT "%13.9" NUMBER 10 /end CHARACTERISTIC
/begin CHARACTERISTIC DSM_EnvDfp_VSACD_VSADia4_C "Fehlerpfad spezifische Umweltbedingungen fuer Fehlerpfad Dfp_VSACD_VSADia4" VAL_BLK 0xCC0F9 Kwb_Wu8 255.000000000 SigName 0.00 255.000000000 FORMAT "%13.9" NUMBER 10 /end CHARACTERISTIC
/begin CHARACTERISTIC DSM_EnvDfp_VSSCD1_C "Fehlerpfad spezifische Umweltbedingungen fuer Fehlerpfad Dfp_VSSCD1" VAL_BLK 0xCC103 Kwb_Wu8 255.000000000 SigName 0.00 255.000000000 FORMAT "%13.9" NUMBER 10 /end CHARACTERISTIC
/begin CHARACTERISTIC DSM_EnvDfp_VSSCD2_C "Fehlerpfad spezifische Umweltbedingungen fuer Fehlerpfad Dfp_VSSCD2" VAL_BLK 0xCC10D Kwb_Wu8 255.000000000 SigName 0.00 255.000000000 FORMAT "%13.9" NUMBER 10 /end CHARACTERISTIC
/begin CHARACTERISTIC DSM_EnvDfp_WdCom_C "Fehlerpfad spezifische Umweltbedingungen fuer Fehlerpfad Dfp_WdCom" VAL_BLK 0xCC117 Kwb_Wu8 255.000000000 SigName 0.00 255.000000000 FORMAT "%13.9" NUMBER 10 /end CHARACTERISTIC
/begin MEASUREMENT Dfp_ACCDCmpr_mp "Messpunkt fuer Fehlerpfad  Dfp_ACCDCmpr" UWORD OneToOne 1 100 0.00 65535.00 FORMAT "%8.2" ECU_ADDRESS 0x8FE606 /end MEASUREMENT
/begin MEASUREMENT Dfp_ACCDPres1_mp "Messpunkt fuer Fehlerpfad  Dfp_ACCDPres1" UWORD OneToOne 1 100 0.00 65535.00 FORMAT "%8.2" ECU_ADDRESS 0x8FE608 /end MEASUREMENT
/begin MEASUREMENT Dfp_ACCDPresAna_mp "Messpunkt fuer Fehlerpfad  Dfp_ACCDPresAna" UWORD OneToOne 1 100 0.00 65535.00 FORMAT "%8.2" ECU_ADDRESS 0x8FE60A /end MEASUREMENT
/begin MEASUREMENT Dfp_ACCDPres_mp "Messpunkt fuer Fehlerpfad  Dfp_ACCDPres" UWORD OneToOne 1 100 0.00 65535.00 FORMAT "%8.2" ECU_ADDRESS 0x8FE60C /end MEASUREMENT
/begin MEASUREMENT Dfp_ACCDSwtin_mp "Messpunkt fuer Fehlerpfad  Dfp_ACCDSwtin" UWORD OneToOne 1 100 0.00 65535.00 FORMAT "%8.2" ECU_ADDRESS 0x8FE60E /end MEASUREMENT
/begin MEASUREMENT Dfp_AccPedPlausBrk_mp "Fehlerpfad für Unplausibilität AccPed-Brk" UWORD OneToOne 1 100 0.00 65535.00 FORMAT "%8.2" ECU_ADDRESS 0x8FE610 /end MEASUREMENT
/begin MEASUREMENT Dfp_ACC_PlausTrqDes_mp "Bremse ist ACC_PlausTrqTmrDead_C [s] getreten & ACC fordert noch immer Moment." UWORD OneToOne 1 100 0.00 65535.00 FORMAT "%8.2" ECU_ADDRESS 0x8FE612 /end MEASUREMENT
/begin MEASUREMENT Dfp_ACC_trqInr_mp "Too much Torque ACC" UWORD OneToOne 1 100 0.00 65535.00 FORMAT "%8.2" ECU_ADDRESS 0x8FE614 /end MEASUREMENT
/begin MEASUREMENT Dfp_ACTrq_mp "Messpunkt fuer Fehlerpfad  Dfp_ACTrq" UWORD OneToOne 1 100 0.00 65535.00 FORMAT "%8.2" ECU_ADDRESS 0x8FE616 /end MEASUREMENT
/begin MEASUREMENT Dfp_ADCMon_mp "Messpunkt fuer Fehlerpfad  Dfp_ADCMon" UWORD OneToOne 1 100 0.00 65535.00 FORMAT "%8.2" ECU_ADDRESS 0x8FE618 /end MEASUREMENT
/begin MEASUREMENT Dfp_AFSCDIdlAdjVal_mp "Messpunkt fuer Fehlerpfad  Dfp_AFSCDIdlAdjVal" UWORD OneToOne 1 100 0.00 65535.00 FORMAT "%8.2" ECU_ADDRESS 0x8FE61A /end MEASUREMENT
/begin MEASUREMENT Dfp_AFSCDLdAdjVal_mp "Messpunkt fuer Fehlerpfad  Dfp_AFSCDLdAdjVal" UWORD OneToOne 1 100 0.00 65535.00 FORMAT "%8.2" ECU_ADDRESS 0x8FE61C /end MEASUREMENT
/begin MEASUREMENT Dfp_AFSCD_AirTempDcyc_mp "Messpunkt fuer Fehlerpfad  Dfp_AFSCD_AirTempDcyc" UWORD OneToOne 1 100 0.00 65535.00 FORMAT "%8.2" ECU_ADDRESS 0x8FE61E /end MEASUREMENT
/begin MEASUREMENT Dfp_AFSCD_PlOffsDrft_mp "Messpunkt fuer Fehlerpfad  Dfp_AFSCD_PlOffsDrft" UWORD OneToOne 1 100 0.00 65535.00 FORMAT "%8.2" ECU_ADDRESS 0x8FE620 /end MEASUREMENT
/begin MEASUREMENT Dfp_AFSCD_PlSetyDrft_mp "Messpunkt fuer Fehlerpfad  Dfp_AFSCD_PlSetyDrft" UWORD OneToOne 1 100 0.00 65535.00 FORMAT "%8.2" ECU_ADDRESS 0x8FE622 /end MEASUREMENT
/begin MEASUREMENT Dfp_AFSCD_SRCAirTemp_mp "Fehlerpfad für Prüfung auf optimal Lufttemperatur" UWORD OneToOne 1 100 0.00 65535.00 FORMAT "%8.2" ECU_ADDRESS 0x8FE624 /end MEASUREMENT
/begin MEASUREMENT Dfp_AFSCD_SRCBatt_mp "Fehlerpfad für Prüfung auf optimale Batteriespannung" UWORD OneToOne 1 100 0.00 65535.00 FORMAT "%8.2" ECU_ADDRESS 0x8FE626 /end MEASUREMENT
/begin MEASUREMENT Dfp_AFSCD_SRCCorrAirm_mp "Fehlerpfad für SRC des korrigierten Sensorsignals (HFM6)" UWORD OneToOne 1 100 0.00 65535.00 FORMAT "%8.2" ECU_ADDRESS 0x8FE628 /end MEASUREMENT
/begin MEASUREMENT Dfp_AFSCD_SRCRawAirm_mp "Fehlerpfad für SRC des unkorrigierten Sensorsignals (HFM6)" UWORD OneToOne 1 100 0.00 65535.00 FORMAT "%8.2" ECU_ADDRESS 0x8FE62A /end MEASUREMENT
/begin MEASUREMENT Dfp_AFSCD_SRCRefSigPer_mp "Fehlerpfad für SRC des Referenzsignals (Lufttemperatur-Periodendauer beim HFM6)" UWORD OneToOne 1 100 0.00 65535.00 FORMAT "%8.2" ECU_ADDRESS 0x8FE62C /end MEASUREMENT
/begin MEASUREMENT Dfp_AirCtlGvnrDvtRgnMax2_mp "" UWORD OneToOne 1 100 0.00 65535.00 FORMAT "%8.2" ECU_ADDRESS 0x8FE62E /end MEASUREMENT
/begin MEASUREMENT Dfp_AirCtlGvnrDvtRgnMax_mp "Regelabweichung in Regeneration zu groß" UWORD OneToOne 1 100 0.00 65535.00 FORMAT "%8.2" ECU_ADDRESS 0x8FE630 /end MEASUREMENT
/begin MEASUREMENT Dfp_AirCtlGvnrDvtRgnMin2_mp "" UWORD OneToOne 1 100 0.00 65535.00 FORMAT "%8.2" ECU_ADDRESS 0x8FE632 /end MEASUREMENT
/begin MEASUREMENT Dfp_AirCtlGvnrDvtRgnMin_mp "Regelabweichung in Regeneration zu klein" UWORD OneToOne 1 100 0.00 65535.00 FORMAT "%8.2" ECU_ADDRESS 0x8FE634 /end MEASUREMENT
/begin MEASUREMENT Dfp_AirCtlPlateBreak_mp "Dfp for plate break monitoring" UWORD OneToOne 1 100 0.00 65535.00 FORMAT "%8.2" ECU_ADDRESS 0x8FE636 /end MEASUREMENT
/begin MEASUREMENT Dfp_AirCtlRmpTO_mp "Fehlerpfadmeßpunkt für Zeitüberschreitung der Übergangsphase von Regenerations- zum Normalbetrieb" UWORD OneToOne 1 100 0.00 65535.00 FORMAT "%8.2" ECU_ADDRESS 0x8FE638 /end MEASUREMENT
/begin MEASUREMENT Dfp_AirCtl_GovNegDev2_mp "AirCtl permanent governor2 negative deviatio" UWORD OneToOne 1 100 0.00 65535.00 FORMAT "%8.2" ECU_ADDRESS 0x8FE63A /end MEASUREMENT
/begin MEASUREMENT Dfp_AirCtl_GovNegDev_mp "Messpunkt fuer Fehlerpfad  Dfp_AirCtl_GovNegDev" UWORD OneToOne 1 100 0.00 65535.00 FORMAT "%8.2" ECU_ADDRESS 0x8FE63C /end MEASUREMENT
/begin MEASUREMENT Dfp_AirCtl_GovPosDev2_mp "AirCtl permanent governor2 positive deviation" UWORD OneToOne 1 100 0.00 65535.00 FORMAT "%8.2" ECU_ADDRESS 0x8FE63E /end MEASUREMENT
/begin MEASUREMENT Dfp_AirCtl_GovPosDev_mp "Messpunkt fuer Fehlerpfad  Dfp_AirCtl_GovPosDev" UWORD OneToOne 1 100 0.00 65535.00 FORMAT "%8.2" ECU_ADDRESS 0x8FE640 /end MEASUREMENT
/begin MEASUREMENT Dfp_AltCD_Load_mp "Messpunkt fuer Fehlerpfad  Dfp_AltCD_Load" UWORD OneToOne 1 100 0.00 65535.00 FORMAT "%8.2" ECU_ADDRESS 0x8FE642 /end MEASUREMENT
/begin MEASUREMENT Dfp_AltCD_mp "Fehlerpfad des Generators (Kommunikationsfehler)" UWORD OneToOne 1 100 0.00 65535.00 FORMAT "%8.2" ECU_ADDRESS 0x8FE644 /end MEASUREMENT
/begin MEASUREMENT Dfp_AOHtCD_AOHtDia1_mp "Messpunkt fuer Fehlerpfad  Dfp_AOHtCD_AOHtDia1" UWORD OneToOne 1 100 0.00 65535.00 FORMAT "%8.2" ECU_ADDRESS 0x8FE646 /end MEASUREMENT
/begin MEASUREMENT Dfp_AOHtCD_AOHtDia2_mp "Messpunkt fuer Fehlerpfad  Dfp_AOHtCD_AOHtDia2" UWORD OneToOne 1 100 0.00 65535.00 FORMAT "%8.2" ECU_ADDRESS 0x8FE648 /end MEASUREMENT
/begin MEASUREMENT Dfp_AOHtCD_AOHtDia3_mp "Messpunkt fuer Fehlerpfad  Dfp_AOHtCD_AOHtDia3" UWORD OneToOne 1 100 0.00 65535.00 FORMAT "%8.2" ECU_ADDRESS 0x8FE64A /end MEASUREMENT
/begin MEASUREMENT Dfp_AOHtCD_mp "Messpunkt fuer Fehlerpfad bei PWM Endstufenfehler" UWORD OneToOne 1 100 0.00 65535.00 FORMAT "%8.2" ECU_ADDRESS 0x8FE64C /end MEASUREMENT
/begin MEASUREMENT Dfp_APP1_mp "Messpunkt fuer Fehlerpfad  Dfp_APP1" UWORD OneToOne 1 100 0.00 65535.00 FORMAT "%8.2" ECU_ADDRESS 0x8FE64E /end MEASUREMENT
/begin MEASUREMENT Dfp_APP2_mp "Messpunkt fuer Fehlerpfad  Dfp_APP2" UWORD OneToOne 1 100 0.00 65535.00 FORMAT "%8.2" ECU_ADDRESS 0x8FE650 /end MEASUREMENT
/begin MEASUREMENT Dfp_APPSync_mp "Messpunkt für Fehlerpfad Dfp_APPSync" UWORD OneToOne 1 100 0.00 65535.00 FORMAT "%8.2" ECU_ADDRESS 0x8FE652 /end MEASUREMENT
/begin MEASUREMENT Dfp_APSCD_mp "Messpunkt fuer Fehlerpfad  Dfp_APSCD" UWORD OneToOne 1 100 0.00 65535.00 FORMAT "%8.2" ECU_ADDRESS 0x8FE654 /end MEASUREMENT
/begin MEASUREMENT Dfp_ARS_mp "Fault path for ARS" UWORD OneToOne 1 100 0.00 65535.00 FORMAT "%8.2" ECU_ADDRESS 0x8FE656 /end MEASUREMENT
/begin MEASUREMENT Dfp_BattCD_mp "Messpunkt fuer Fehlerpfad  Dfp_BattCD" UWORD OneToOne 1 100 0.00 65535.00 FORMAT "%8.2" ECU_ADDRESS 0x8FE658 /end MEASUREMENT
/begin MEASUREMENT Dfp_BPACD_BPADia1_mp "Messpunkt fuer Fehlerpfad  Dfp_BPACD_BPADia1" UWORD OneToOne 1 100 0.00 65535.00 FORMAT "%8.2" ECU_ADDRESS 0x8FE65A /end MEASUREMENT
/begin MEASUREMENT Dfp_BPACD_BPADia2_mp "Messpunkt fuer Fehlerpfad  Dfp_BPACD_BPADia2" UWORD OneToOne 1 100 0.00 65535.00 FORMAT "%8.2" ECU_ADDRESS 0x8FE65C /end MEASUREMENT
/begin MEASUREMENT Dfp_BPACD_BPADia3_mp "Messpunkt fuer Fehlerpfad  Dfp_BPACD_BPADia3" UWORD OneToOne 1 100 0.00 65535.00 FORMAT "%8.2" ECU_ADDRESS 0x8FE65E /end MEASUREMENT
/begin MEASUREMENT Dfp_BPACD_Max_mp "Fehlerpfad für Kurzschluss nach Batteriespannung des Ladedruckstrellers" UWORD OneToOne 1 100 0.00 65535.00 FORMAT "%8.2" ECU_ADDRESS 0x8FE660 /end MEASUREMENT
/begin MEASUREMENT Dfp_BPACD_Min_mp "Fehlerpfad für Kurzschluss nach Masse des Ladedruckstellers" UWORD OneToOne 1 100 0.00 65535.00 FORMAT "%8.2" ECU_ADDRESS 0x8FE662 /end MEASUREMENT
/begin MEASUREMENT Dfp_BPACD_SigNpl_mp "Fehlerpfad für Lastabfall und Übertemperatur des Ladedruckstellers" UWORD OneToOne 1 100 0.00 65535.00 FORMAT "%8.2" ECU_ADDRESS 0x8FE664 /end MEASUREMENT
/begin MEASUREMENT Dfp_BPSCD_mp "Messpunkt fuer Fehlerpfad  Dfp_BPSCD" UWORD OneToOne 1 100 0.00 65535.00 FORMAT "%8.2" ECU_ADDRESS 0x8FE666 /end MEASUREMENT
/begin MEASUREMENT Dfp_BrkCD_mp "Messpunkt fuer Fehlerpfad  Dfp_BrkCD" UWORD OneToOne 1 100 0.00 65535.00 FORMAT "%8.2" ECU_ADDRESS 0x8FE668 /end MEASUREMENT
/begin MEASUREMENT Dfp_Bss_mp "Messpunkt fuer Fehlerpfad  Dfp_Bss" UWORD OneToOne 1 100 0.00 65535.00 FORMAT "%8.2" ECU_ADDRESS 0x8FE66A /end MEASUREMENT
/begin MEASUREMENT Dfp_CBACD_mp "Messpunkt fuer Fehlerpfad  Dfp_CBACD" UWORD OneToOne 1 100 0.00 65535.00 FORMAT "%8.2" ECU_ADDRESS 0x8FE66C /end MEASUREMENT
/begin MEASUREMENT Dfp_Clg_DynTst_mp "Messpunkt fuer Fehlerpfad  Dfp_Clg_DynTst" UWORD OneToOne 1 100 0.00 65535.00 FORMAT "%8.2" ECU_ADDRESS 0x8FE66E /end MEASUREMENT
/begin MEASUREMENT Dfp_CmbChbMisfire1_mp "Fehlerpfad Zündaussetzer in Zylinder 1" UWORD OneToOne 1 100 0.00 65535.00 FORMAT "%8.2" ECU_ADDRESS 0x8FE670 /end MEASUREMENT
/begin MEASUREMENT Dfp_CmbChbMisfire2_mp "Fehlerpfad Zündaussetzer in Zylinder 2" UWORD OneToOne 1 100 0.00 65535.00 FORMAT "%8.2" ECU_ADDRESS 0x8FE672 /end MEASUREMENT
/begin MEASUREMENT Dfp_CmbChbMisfire3_mp "Fehlerpfad Zündaussetzer in Zylinder 3" UWORD OneToOne 1 100 0.00 65535.00 FORMAT "%8.2" ECU_ADDRESS 0x8FE674 /end MEASUREMENT
/begin MEASUREMENT Dfp_CmbChbMisfire4_mp "Fehlerpfad Zündaussetzer in Zylinder 4" UWORD OneToOne 1 100 0.00 65535.00 FORMAT "%8.2" ECU_ADDRESS 0x8FE676 /end MEASUREMENT
/begin MEASUREMENT Dfp_CmbChbMisfire5_mp "Fehlerpfad Zündaussetzer in Zylinder 5" UWORD OneToOne 1 100 0.00 65535.00 FORMAT "%8.2" ECU_ADDRESS 0x8FE678 /end MEASUREMENT
/begin MEASUREMENT Dfp_CmbChbMisfire6_mp "Fehlerpfad Zündaussetzer in Zylinder 6" UWORD OneToOne 1 100 0.00 65535.00 FORMAT "%8.2" ECU_ADDRESS 0x8FE67A /end MEASUREMENT
/begin MEASUREMENT Dfp_CmbChbMisfireMul_mp "Fehlerpfad Zündaussetzer in mehreren Zylindern" UWORD OneToOne 1 100 0.00 65535.00 FORMAT "%8.2" ECU_ADDRESS 0x8FE67C /end MEASUREMENT
/begin MEASUREMENT Dfp_ConvCD_mp "Messpunkt fuer Fehlerpfad  Dfp_ConvCD" UWORD OneToOne 1 100 0.00 65535.00 FORMAT "%8.2" ECU_ADDRESS 0x8FE67E /end MEASUREMENT
/begin MEASUREMENT Dfp_CoVMDCSh_mp "Fehlerpfade physikalische Unplausibilität der  Motorschlupfregelung" UWORD OneToOne 1 100 0.00 65535.00 FORMAT "%8.2" ECU_ADDRESS 0x8FE680 /end MEASUREMENT
/begin MEASUREMENT Dfp_CrCCDMFL_mp "Messpunkt fuer Fehlerpfad  Dfp_CrCCDMFL" UWORD OneToOne 1 100 0.00 65535.00 FORMAT "%8.2" ECU_ADDRESS 0x8FE682 /end MEASUREMENT
/begin MEASUREMENT Dfp_CrCtl_vCrCtl_mp "Erkennung gefilterte Offset-Geschwindigkeit über Grenze beim Stufentempomat" UWORD OneToOne 1 100 0.00 65535.00 FORMAT "%8.2" ECU_ADDRESS 0x8FE684 /end MEASUREMENT
/begin MEASUREMENT Dfp_CTSCD_mp "Messpunkt fuer Fehlerpfad  Dfp_CTSCD" UWORD OneToOne 1 100 0.00 65535.00 FORMAT "%8.2" ECU_ADDRESS 0x8FE686 /end MEASUREMENT
/begin MEASUREMENT Dfp_DCC_PlausTrqDes_mp "Messpunkt fuer Fehlerpfad  Dfp_DCC_PlausTrqDes" UWORD OneToOne 1 100 0.00 65535.00 FORMAT "%8.2" ECU_ADDRESS 0x8FE688 /end MEASUREMENT
/begin MEASUREMENT Dfp_Dummy1_mp "Messpunkt fuer Fehlerpfad  Dfp_Dummy1" UWORD OneToOne 1 100 0.00 65535.00 FORMAT "%8.2" ECU_ADDRESS 0x8FE68A /end MEASUREMENT
/begin MEASUREMENT Dfp_EATSCD_mp "Messpunkt fuer Fehlerpfad  Dfp_EATSCD" UWORD OneToOne 1 100 0.00 65535.00 FORMAT "%8.2" ECU_ADDRESS 0x8FE68C /end MEASUREMENT
/begin MEASUREMENT Dfp_EBAFCD_mp "Messpunkt fuer Fehlerpfad  Dfp_EBAFCD" UWORD OneToOne 1 100 0.00 65535.00 FORMAT "%8.2" ECU_ADDRESS 0x8FE68E /end MEASUREMENT
/begin MEASUREMENT Dfp_EBFCD_mp "Messpunkt fuer Fehlerpfad  Dfp_EBFCD" UWORD OneToOne 1 100 0.00 65535.00 FORMAT "%8.2" ECU_ADDRESS 0x8FE690 /end MEASUREMENT
/begin MEASUREMENT Dfp_EBTSCD_mp "Messpunkt fuer Fehlerpfad  Dfp_EBTSCD" UWORD OneToOne 1 100 0.00 65535.00 FORMAT "%8.2" ECU_ADDRESS 0x8FE692 /end MEASUREMENT
/begin MEASUREMENT Dfp_EBTSCD_OvrTemp_mp "Messpunkt fuer Fehlerpfad  Dfp_EBTSCD_OvrTemp" UWORD OneToOne 1 100 0.00 65535.00 FORMAT "%8.2" ECU_ADDRESS 0x8FE694 /end MEASUREMENT
/begin MEASUREMENT Dfp_EEPCDVarMng_mp "Messpunkt fuer Fehlerpfad  Dfp_EEPCDVarMng" UWORD OneToOne 1 100 0.00 65535.00 FORMAT "%8.2" ECU_ADDRESS 0x8FE696 /end MEASUREMENT
/begin MEASUREMENT Dfp_EGPpCDTPreTrbn_mp "Messpunkt fuer Fehlerpfad  Dfp_EgPpCD" UWORD OneToOne 1 100 0.00 65535.00 FORMAT "%8.2" ECU_ADDRESS 0x8FE698 /end MEASUREMENT
/begin MEASUREMENT Dfp_EGPpCD_mp "Messpunkt fuer Fehlerpfad  Dfp_EGPpCD" UWORD OneToOne 1 100 0.00 65535.00 FORMAT "%8.2" ECU_ADDRESS 0x8FE69A /end MEASUREMENT
/begin MEASUREMENT Dfp_EGRCD_Max_mp "Fehlerpfad für Kurzschluss nach Batteriespannung des Abgasrückführstellers" UWORD OneToOne 1 100 0.00 65535.00 FORMAT "%8.2" ECU_ADDRESS 0x8FE69C /end MEASUREMENT
/begin MEASUREMENT Dfp_EGRCD_Min_mp "Fehlerpfad für Kurzschluss nach Masse des Abgasrückführstellers" UWORD OneToOne 1 100 0.00 65535.00 FORMAT "%8.2" ECU_ADDRESS 0x8FE69E /end MEASUREMENT
/begin MEASUREMENT Dfp_EGRCD_SigNpl_mp "Fehlerpfad für Lastabfall und Übertemperatur des Abgasrückführstellers" UWORD OneToOne 1 100 0.00 65535.00 FORMAT "%8.2" ECU_ADDRESS 0x8FE6A0 /end MEASUREMENT
/begin MEASUREMENT Dfp_EGTRgnOilDil_mp "Fehlerpfad maximale Zeit für Ölverdünnung überschritten" UWORD OneToOne 1 100 0.00 65535.00 FORMAT "%8.2" ECU_ADDRESS 0x8FE6A2 /end MEASUREMENT
/begin MEASUREMENT Dfp_EMCCDNoLoad1_mp "" UWORD OneToOne 1 100 0.00 65535.00 FORMAT "%8.2" ECU_ADDRESS 0x8FE6A4 /end MEASUREMENT
/begin MEASUREMENT Dfp_EMCCDNoLoad2_mp "" UWORD OneToOne 1 100 0.00 65535.00 FORMAT "%8.2" ECU_ADDRESS 0x8FE6A6 /end MEASUREMENT
/begin MEASUREMENT Dfp_EMCCDSCBat1_mp "" UWORD OneToOne 1 100 0.00 65535.00 FORMAT "%8.2" ECU_ADDRESS 0x8FE6A8 /end MEASUREMENT
/begin MEASUREMENT Dfp_EMCCDSCBat2_mp "" UWORD OneToOne 1 100 0.00 65535.00 FORMAT "%8.2" ECU_ADDRESS 0x8FE6AA /end MEASUREMENT
/begin MEASUREMENT Dfp_EMCCDSCGnd1_mp "" UWORD OneToOne 1 100 0.00 65535.00 FORMAT "%8.2" ECU_ADDRESS 0x8FE6AC /end MEASUREMENT
/begin MEASUREMENT Dfp_EMCCDSCGnd2_mp "" UWORD OneToOne 1 100 0.00 65535.00 FORMAT "%8.2" ECU_ADDRESS 0x8FE6AE /end MEASUREMENT
/begin MEASUREMENT Dfp_EMCCD_ADC1_mp "" UWORD OneToOne 1 100 0.00 65535.00 FORMAT "%8.2" ECU_ADDRESS 0x8FE6B0 /end MEASUREMENT
/begin MEASUREMENT Dfp_EMCCD_ADC2_mp "" UWORD OneToOne 1 100 0.00 65535.00 FORMAT "%8.2" ECU_ADDRESS 0x8FE6B2 /end MEASUREMENT
/begin MEASUREMENT Dfp_EngMCaS1_mp "Meßpunkt für Fehlerpfad Dfp_EngMCaS1" UWORD OneToOne 1 100 0.00 65535.00 FORMAT "%8.2" ECU_ADDRESS 0x8FE6B4 /end MEASUREMENT
/begin MEASUREMENT Dfp_EngMCrS1_mp "Meßpunkt für Fehlerpfad Dfp_EngMCrS1" UWORD OneToOne 1 100 0.00 65535.00 FORMAT "%8.2" ECU_ADDRESS 0x8FE6B6 /end MEASUREMENT
/begin MEASUREMENT Dfp_EngMOfsCaSCrS_mp "Meßpunkt fuer Fehlerpfad Dfp_EngMOfsCaSCrS" UWORD OneToOne 1 100 0.00 65535.00 FORMAT "%8.2" ECU_ADDRESS 0x8FE6B8 /end MEASUREMENT
/begin MEASUREMENT Dfp_EngPrtFWODet_mp "Messpunkt fuer Fehlerpfad  Dfp_EngPrtFWODet" UWORD OneToOne 1 100 0.00 65535.00 FORMAT "%8.2" ECU_ADDRESS 0x8FE6BA /end MEASUREMENT
/begin MEASUREMENT Dfp_ETClbETFltInj1_mp "Messpunkt fuer Fehlerpfad  Dfp_ETClbETFltInj1" UWORD OneToOne 1 100 0.00 65535.00 FORMAT "%8.2" ECU_ADDRESS 0x8FE6BC /end MEASUREMENT
/begin MEASUREMENT Dfp_ETClbETFltInj2_mp "Messpunkt fuer Fehlerpfad  Dfp_ETClbETFltInj2" UWORD OneToOne 1 100 0.00 65535.00 FORMAT "%8.2" ECU_ADDRESS 0x8FE6BE /end MEASUREMENT
/begin MEASUREMENT Dfp_ETClbETFltInj3_mp "Messpunkt fuer Fehlerpfad  Dfp_ETClbETFltInj3" UWORD OneToOne 1 100 0.00 65535.00 FORMAT "%8.2" ECU_ADDRESS 0x8FE6C0 /end MEASUREMENT
/begin MEASUREMENT Dfp_ETClbETFltInj4_mp "Messpunkt fuer Fehlerpfad  Dfp_ETClbETFltInj4" UWORD OneToOne 1 100 0.00 65535.00 FORMAT "%8.2" ECU_ADDRESS 0x8FE6C2 /end MEASUREMENT
/begin MEASUREMENT Dfp_ETClbETFltInj5_mp "Messpunkt fuer Fehlerpfad  Dfp_ETClbETFltInj5" UWORD OneToOne 1 100 0.00 65535.00 FORMAT "%8.2" ECU_ADDRESS 0x8FE6C4 /end MEASUREMENT
/begin MEASUREMENT Dfp_ETClbETFltInj6_mp "Messpunkt fuer Fehlerpfad  Dfp_ETClbETFltInj6" UWORD OneToOne 1 100 0.00 65535.00 FORMAT "%8.2" ECU_ADDRESS 0x8FE6C6 /end MEASUREMENT
/begin MEASUREMENT Dfp_ETClbInj1_mp "Messpunkt fuer Fehlerpfad  Dfp_ETClbInj1" UWORD OneToOne 1 100 0.00 65535.00 FORMAT "%8.2" ECU_ADDRESS 0x8FE6C8 /end MEASUREMENT
/begin MEASUREMENT Dfp_ETClbInj2_mp "Messpunkt fuer Fehlerpfad  Dfp_ETClbInj2" UWORD OneToOne 1 100 0.00 65535.00 FORMAT "%8.2" ECU_ADDRESS 0x8FE6CA /end MEASUREMENT
/begin MEASUREMENT Dfp_ETClbInj3_mp "Messpunkt fuer Fehlerpfad  Dfp_ETClbInj3" UWORD OneToOne 1 100 0.00 65535.00 FORMAT "%8.2" ECU_ADDRESS 0x8FE6CC /end MEASUREMENT
/begin MEASUREMENT Dfp_ETClbInj4_mp "Messpunkt fuer Fehlerpfad  Dfp_ETClbInj4" UWORD OneToOne 1 100 0.00 65535.00 FORMAT "%8.2" ECU_ADDRESS 0x8FE6CE /end MEASUREMENT
/begin MEASUREMENT Dfp_ETClbInj5_mp "Messpunkt fuer Fehlerpfad  Dfp_ETClbInj5" UWORD OneToOne 1 100 0.00 65535.00 FORMAT "%8.2" ECU_ADDRESS 0x8FE6D0 /end MEASUREMENT
/begin MEASUREMENT Dfp_ETClbInj6_mp "Messpunkt fuer Fehlerpfad  Dfp_ETClbInj6" UWORD OneToOne 1 100 0.00 65535.00 FORMAT "%8.2" ECU_ADDRESS 0x8FE6D2 /end MEASUREMENT
/begin MEASUREMENT Dfp_FanCD_FanCtlr1_mp "Messpunkt fuer Fehlerpfad  Dfp_FanCD_FanCtlr1" UWORD OneToOne 1 100 0.00 65535.00 FORMAT "%8.2" ECU_ADDRESS 0x8FE6D4 /end MEASUREMENT
/begin MEASUREMENT Dfp_FanCD_FanCtlr2_mp "Messpunkt fuer Fehlerpfad  Dfp_FanCD_FanCtlr2" UWORD OneToOne 1 100 0.00 65535.00 FORMAT "%8.2" ECU_ADDRESS 0x8FE6D6 /end MEASUREMENT
/begin MEASUREMENT Dfp_FanCD_FanCtlr3_mp "Messpunkt fuer Fehlerpfad  Dfp_FanCD_FanCtlr3" UWORD OneToOne 1 100 0.00 65535.00 FORMAT "%8.2" ECU_ADDRESS 0x8FE6D8 /end MEASUREMENT
/begin MEASUREMENT Dfp_FanCD_mp "Fehlerpfad signalisiert Fehler in der Zuleitung zum Lüfter" UWORD OneToOne 1 100 0.00 65535.00 FORMAT "%8.2" ECU_ADDRESS 0x8FE6DA /end MEASUREMENT
/begin MEASUREMENT Dfp_FBCqDvt_mp "Messpunkt fuer Fehlerpfad  Dfp_FBCqDvt" UWORD OneToOne 1 100 0.00 65535.00 FORMAT "%8.2" ECU_ADDRESS 0x8FE6DC /end MEASUREMENT
/begin MEASUREMENT Dfp_FlFCD_mp "Messpunkt fuer Fehlerpfad  Dfp_FlFCD" UWORD OneToOne 1 100 0.00 65535.00 FORMAT "%8.2" ECU_ADDRESS 0x8FE6DE /end MEASUREMENT
/begin MEASUREMENT Dfp_FlMngSmkDefect_mp "Messpunkt fuer Fehlerpfad  Dfp_FlMngSmkDefect" UWORD OneToOne 1 100 0.00 65535.00 FORMAT "%8.2" ECU_ADDRESS 0x8FE6E0 /end MEASUREMENT
/begin MEASUREMENT Dfp_FMTC_NonMonotonMap_mp "Prüfung Monotonie der Mengenstützpunkte über Moment in FMTC_trq2qBas_MAP" UWORD OneToOne 1 100 0.00 65535.00 FORMAT "%8.2" ECU_ADDRESS 0x8FE6E2 /end MEASUREMENT
/begin MEASUREMENT Dfp_FrmMngANFRADMOMPT_mp "Messpunkt fuer Fehlerpfad  Dfp_FrmMngANFRADMOMPT" UWORD OneToOne 1 100 0.00 65535.00 FORMAT "%8.2" ECU_ADDRESS 0x8FE6E4 /end MEASUREMENT
/begin MEASUREMENT Dfp_FrmMngASC1_mp "Messpunkt fuer Fehlerpfad  Dfp_FrmMngASC1" UWORD OneToOne 1 100 0.00 65535.00 FORMAT "%8.2" ECU_ADDRESS 0x8FE6E6 /end MEASUREMENT
/begin MEASUREMENT Dfp_FrmMngASC2_mp "Messpunkt fuer Fehlerpfad  Dfp_FrmMngASC2" UWORD OneToOne 1 100 0.00 65535.00 FORMAT "%8.2" ECU_ADDRESS 0x8FE6E8 /end MEASUREMENT
/begin MEASUREMENT Dfp_FrmMngASC3_mp "Messpunkt fuer Fehlerpfad  Dfp_FrmMngASC3" UWORD OneToOne 1 100 0.00 65535.00 FORMAT "%8.2" ECU_ADDRESS 0x8FE6EA /end MEASUREMENT
/begin MEASUREMENT Dfp_FrmMngASC4_mp "Messpunkt fuer Fehlerpfad  Dfp_FrmMngASC4" UWORD OneToOne 1 100 0.00 65535.00 FORMAT "%8.2" ECU_ADDRESS 0x8FE6EC /end MEASUREMENT
/begin MEASUREMENT Dfp_FrmMngBOS_RESET_2_mp "Messpunkt fuer Fehlerpfad  Dfp_FrmMngBOS_RESET_2" UWORD OneToOne 1 100 0.00 65535.00 FORMAT "%8.2" ECU_ADDRESS 0x8FE6EE /end MEASUREMENT
/begin MEASUREMENT Dfp_FrmMngBOS_RESET_mp "BOS_RESET - CAN-message related errors" UWORD OneToOne 1 100 0.00 65535.00 FORMAT "%8.2" ECU_ADDRESS 0x8FE6F0 /end MEASUREMENT
/begin MEASUREMENT Dfp_FrmMngDMANFAFS_mp "Messpunkt fuer Fehlerpfad  Dfp_FrmMngDMANFAFS" UWORD OneToOne 1 100 0.00 65535.00 FORMAT "%8.2" ECU_ADDRESS 0x8FE6F2 /end MEASUREMENT
/begin MEASUREMENT Dfp_FrmMngDRMANFSSG_mp "Messpunkt fuer Fehlerpfad  Dfp_FrmMngDRMANFSSG" UWORD OneToOne 1 100 0.00 65535.00 FORMAT "%8.2" ECU_ADDRESS 0x8FE6F4 /end MEASUREMENT
/begin MEASUREMENT Dfp_FrmMngEGS1_mp "Fehleerpfad für die EGS1 Botschaft" UWORD OneToOne 1 100 0.00 65535.00 FORMAT "%8.2" ECU_ADDRESS 0x8FE6F6 /end MEASUREMENT
/begin MEASUREMENT Dfp_FrmMngEGS2_mp "Messpunkt fuer Fehlerpfad  Dfp_FrmMngEGS2" UWORD OneToOne 1 100 0.00 65535.00 FORMAT "%8.2" ECU_ADDRESS 0x8FE6F8 /end MEASUREMENT
/begin MEASUREMENT Dfp_FrmMngGEARBX_DATA2_mp "Messpunkt fuer Fehlerpfad  Dfp_FrmMngGEARBX_DATA2" UWORD OneToOne 1 100 0.00 65535.00 FORMAT "%8.2" ECU_ADDRESS 0x8FE6FA /end MEASUREMENT
/begin MEASUREMENT Dfp_FrmMngGEARBX_DATA_mp "GEARBX_DATA CAN12h-message related faults" UWORD OneToOne 1 100 0.00 65535.00 FORMAT "%8.2" ECU_ADDRESS 0x8FE6FC /end MEASUREMENT
/begin MEASUREMENT Dfp_FrmMngHEAT_AC_mp "HEAT_AC CAN12h-message related faults" UWORD OneToOne 1 100 0.00 65535.00 FORMAT "%8.2" ECU_ADDRESS 0x8FE6FE /end MEASUREMENT
/begin MEASUREMENT Dfp_FrmMngINSTR2_mp "Messpunkt fuer Fehlerpfad  Dfp_FrmMngINSTR2" UWORD OneToOne 1 100 0.00 65535.00 FORMAT "%8.2" ECU_ADDRESS 0x8FE700 /end MEASUREMENT
/begin MEASUREMENT Dfp_FrmMngINSTR3_mp "Messpunkt fuer Fehlerpfad  Dfp_FrmMngINSTR3" UWORD OneToOne 1 100 0.00 65535.00 FORMAT "%8.2" ECU_ADDRESS 0x8FE702 /end MEASUREMENT
/begin MEASUREMENT Dfp_FrmMngLENKRADWINKEL_mp "Messpunkt fuer Fehlerpfad  Dfp_FrmMngLENKRADWINKEL" UWORD OneToOne 1 100 0.00 65535.00 FORMAT "%8.2" ECU_ADDRESS 0x8FE704 /end MEASUREMENT
/begin MEASUREMENT Dfp_FrmMngMILEAGE_RANGE_mp "Messpunkt fuer Fehlerpfad  Dfp_FrmMngMILEAGE_RANGE" UWORD OneToOne 1 100 0.00 65535.00 FORMAT "%8.2" ECU_ADDRESS 0x8FE706 /end MEASUREMENT
/begin MEASUREMENT Dfp_FrmMngOPCRCTLACC_mp "Messpunkt fuer Fehlerpfad  Dfp_FrmMngOPCRCTLACC" UWORD OneToOne 1 100 0.00 65535.00 FORMAT "%8.2" ECU_ADDRESS 0x8FE708 /end MEASUREMENT
/begin MEASUREMENT Dfp_FrmMngParkConsumer_mp "Messpunkt fuer Fehlerpfad  Dfp_FrmMngParkConsumer" UWORD OneToOne 1 100 0.00 65535.00 FORMAT "%8.2" ECU_ADDRESS 0x8FE70A /end MEASUREMENT
/begin MEASUREMENT Dfp_FrmMngPRGG_CCTR_mp "Messpunkt fuer Fehlerpfad  Dfp_FrmMngPRGG_CCTR" UWORD OneToOne 1 100 0.00 65535.00 FORMAT "%8.2" ECU_ADDRESS 0x8FE70C /end MEASUREMENT
/begin MEASUREMENT Dfp_FrmMngPWRMNG_LOADV_mp "Messpunkt fuer Fehlerpfad  Dfp_FrmMngPWRMNG_LOADV" UWORD OneToOne 1 100 0.00 65535.00 FORMAT "%8.2" ECU_ADDRESS 0x8FE70E /end MEASUREMENT
/begin MEASUREMENT Dfp_FrmMngRQSTGEFAN_mp "RQ_STG_EFAN - CAN-message related errors" UWORD OneToOne 1 100 0.00 65535.00 FORMAT "%8.2" ECU_ADDRESS 0x8FE710 /end MEASUREMENT
/begin MEASUREMENT Dfp_FrmMngSSGErr_mp "Messpunkt fuer Fehlerpfad  Dfp_FrmMngSSGErr" UWORD OneToOne 1 100 0.00 65535.00 FORMAT "%8.2" ECU_ADDRESS 0x8FE712 /end MEASUREMENT
/begin MEASUREMENT Dfp_FrmMngSSGShOff_mp "Messpunkt fuer Fehlerpfad  Dfp_FrmMngSSGShOff" UWORD OneToOne 1 100 0.00 65535.00 FORMAT "%8.2" ECU_ADDRESS 0x8FE714 /end MEASUREMENT
/begin MEASUREMENT Dfp_FrmMngSTAT_ANH_mp "Messpunkt fuer Fehlerpfad  Dfp_FrmMngSTAT_ANH" UWORD OneToOne 1 100 0.00 65535.00 FORMAT "%8.2" ECU_ADDRESS 0x8FE716 /end MEASUREMENT
/begin MEASUREMENT Dfp_FrmMngSTAT_ARS_mp "STAT_ARS CAN12h-message related faults" UWORD OneToOne 1 100 0.00 65535.00 FORMAT "%8.2" ECU_ADDRESS 0x8FE718 /end MEASUREMENT
/begin MEASUREMENT Dfp_FrmMngSTAT_DSC_mp "STAT_DSC CAN12h-message related faults" UWORD OneToOne 1 100 0.00 65535.00 FORMAT "%8.2" ECU_ADDRESS 0x8FE71A /end MEASUREMENT
/begin MEASUREMENT Dfp_FrmMngSTAT_EKP_mp "Fehlerpfad für STAT_EKP" UWORD OneToOne 1 100 0.00 65535.00 FORMAT "%8.2" ECU_ADDRESS 0x8FE71C /end MEASUREMENT
/begin MEASUREMENT Dfp_FrmMngSTAT_KOMBI_mp "STAT_KOMBI - CAN-message related errors" UWORD OneToOne 1 100 0.00 65535.00 FORMAT "%8.2" ECU_ADDRESS 0x8FE71E /end MEASUREMENT
/begin MEASUREMENT Dfp_FrmMngSTAT_SITZ_mp "Defect fault path for STAT_SITZBELEGUNG_GURT - CAN-message related errors" UWORD OneToOne 1 100 0.00 65535.00 FORMAT "%8.2" ECU_ADDRESS 0x8FE720 /end MEASUREMENT
/begin MEASUREMENT Dfp_FrmMngstCurr_mp "Messpunkt für Dfp von FrmMng_stCurr Botschaft" UWORD OneToOne 1 100 0.00 65535.00 FORMAT "%8.2" ECU_ADDRESS 0x8FE722 /end MEASUREMENT
/begin MEASUREMENT Dfp_FrmMngStOBDGbxMilOf_mp "error path of Gear Box MIL OFF" UWORD OneToOne 1 100 0.00 65535.00 FORMAT "%8.2" ECU_ADDRESS 0x8FE724 /end MEASUREMENT
/begin MEASUREMENT Dfp_FrmMngStOBDGbxMilOn_mp "error path of Gear Box MIL ON" UWORD OneToOne 1 100 0.00 65535.00 FORMAT "%8.2" ECU_ADDRESS 0x8FE726 /end MEASUREMENT
/begin MEASUREMENT Dfp_FrmMngswtPSPOff_mp "Messpunkt für Dfp von FrmMng_swtPSPOff Botschaft" UWORD OneToOne 1 100 0.00 65535.00 FORMAT "%8.2" ECU_ADDRESS 0x8FE728 /end MEASUREMENT
/begin MEASUREMENT Dfp_FrmMngTEMPRELTIME_mp "A_TEMP_RELATIVZEIT - CAN-message related errors" UWORD OneToOne 1 100 0.00 65535.00 FORMAT "%8.2" ECU_ADDRESS 0x8FE72A /end MEASUREMENT
/begin MEASUREMENT Dfp_FrmMngTERMINAL_mp "TERMINAL CAN12h-message related faults" UWORD OneToOne 1 100 0.00 65535.00 FORMAT "%8.2" ECU_ADDRESS 0x8FE72C /end MEASUREMENT
/begin MEASUREMENT Dfp_FrmMngTIME_DATE_mp "Messpunkt fuer Fehlerpfad  Dfp_FrmMngTIME_DATE" UWORD OneToOne 1 100 0.00 65535.00 FORMAT "%8.2" ECU_ADDRESS 0x8FE72E /end MEASUREMENT
/begin MEASUREMENT Dfp_FrmMngTORQUE_DSC_mp "TORQUE_DSC CAN12h-message related faults" UWORD OneToOne 1 100 0.00 65535.00 FORMAT "%8.2" ECU_ADDRESS 0x8FE730 /end MEASUREMENT
/begin MEASUREMENT Dfp_FrmMngTORQUE_GEARBX_mp "TORQUE_GEARBX CAN12h-message related faults" UWORD OneToOne 1 100 0.00 65535.00 FORMAT "%8.2" ECU_ADDRESS 0x8FE732 /end MEASUREMENT
/begin MEASUREMENT Dfp_FrmMngTrq_ReqACC_mp "Messpunkt fuer Fehlerpfad  Dfp_FrmMngTrq_ReqACC" UWORD OneToOne 1 100 0.00 65535.00 FORMAT "%8.2" ECU_ADDRESS 0x8FE734 /end MEASUREMENT
/begin MEASUREMENT Dfp_FrmMngVEH_MOD_mp "VEH_MOD - CAN-message related errors" UWORD OneToOne 1 100 0.00 65535.00 FORMAT "%8.2" ECU_ADDRESS 0x8FE736 /end MEASUREMENT
/begin MEASUREMENT Dfp_FrmMngVELOCITY_mp "VELOCITY CAN12h-message related faults" UWORD OneToOne 1 100 0.00 65535.00 FORMAT "%8.2" ECU_ADDRESS 0x8FE738 /end MEASUREMENT
/begin MEASUREMENT Dfp_FrmMngWHEEL_SPEED_mp "WHEEL_SPEED - CAN-message related errors" UWORD OneToOne 1 100 0.00 65535.00 FORMAT "%8.2" ECU_ADDRESS 0x8FE73A /end MEASUREMENT
/begin MEASUREMENT Dfp_FTSCD_mp "Messpunkt fuer Fehlerpfad  Dfp_FTSCD" UWORD OneToOne 1 100 0.00 65535.00 FORMAT "%8.2" ECU_ADDRESS 0x8FE73C /end MEASUREMENT
/begin MEASUREMENT Dfp_GearbxIncMax_mp "Fehlerpfad  physikalische Unplausibilität des erhöhenden Getriebeeingriffs" UWORD OneToOne 1 100 0.00 65535.00 FORMAT "%8.2" ECU_ADDRESS 0x8FE73E /end MEASUREMENT
/begin MEASUREMENT Dfp_GlwCDGlwCirc1_mp "Messpunkt fuer Fehlerpfad  Dfp_GlwCDGlwCirc1" UWORD OneToOne 1 100 0.00 65535.00 FORMAT "%8.2" ECU_ADDRESS 0x8FE740 /end MEASUREMENT
/begin MEASUREMENT Dfp_GlwCDGlwCirc2_mp "Messpunkt fuer Fehlerpfad  Dfp_GlwCDGlwCirc2" UWORD OneToOne 1 100 0.00 65535.00 FORMAT "%8.2" ECU_ADDRESS 0x8FE742 /end MEASUREMENT
/begin MEASUREMENT Dfp_GlwCDGlwCirc3_mp "Messpunkt fuer Fehlerpfad  Dfp_GlwCDGlwCirc3" UWORD OneToOne 1 100 0.00 65535.00 FORMAT "%8.2" ECU_ADDRESS 0x8FE744 /end MEASUREMENT
/begin MEASUREMENT Dfp_GlwCDGlwCirc4_mp "Messpunkt fuer Fehlerpfad  Dfp_GlwCDGlwCirc4" UWORD OneToOne 1 100 0.00 65535.00 FORMAT "%8.2" ECU_ADDRESS 0x8FE746 /end MEASUREMENT
/begin MEASUREMENT Dfp_GlwCDGlwCirc5_mp "Messpunkt fuer Fehlerpfad  Dfp_GlwCDGlwCirc5" UWORD OneToOne 1 100 0.00 65535.00 FORMAT "%8.2" ECU_ADDRESS 0x8FE748 /end MEASUREMENT
/begin MEASUREMENT Dfp_GlwCDGlwCirc6_mp "Messpunkt fuer Fehlerpfad  Dfp_GlwCDGlwCirc6" UWORD OneToOne 1 100 0.00 65535.00 FORMAT "%8.2" ECU_ADDRESS 0x8FE74A /end MEASUREMENT
/begin MEASUREMENT Dfp_GlwCDGlwCirc7_mp "Messpunkt fuer Fehlerpfad  Dfp_GlwCDGlwCirc7" UWORD OneToOne 1 100 0.00 65535.00 FORMAT "%8.2" ECU_ADDRESS 0x8FE74C /end MEASUREMENT
/begin MEASUREMENT Dfp_GlwCDGlwCirc8_mp "Messpunkt fuer Fehlerpfad  Dfp_GlwCDGlwCirc8" UWORD OneToOne 1 100 0.00 65535.00 FORMAT "%8.2" ECU_ADDRESS 0x8FE74E /end MEASUREMENT
/begin MEASUREMENT Dfp_GlwCD_mp "Messpunkt fuer Fehlerpfad  Dfp_GlwCD" UWORD OneToOne 1 100 0.00 65535.00 FORMAT "%8.2" ECU_ADDRESS 0x8FE750 /end MEASUREMENT
/begin MEASUREMENT Dfp_GlwCtl_mp "Glüh-Steuerungs-Rückmeldungs-Fehler" UWORD OneToOne 1 100 0.00 65535.00 FORMAT "%8.2" ECU_ADDRESS 0x8FE752 /end MEASUREMENT
/begin MEASUREMENT Dfp_HWEMonCom_mp "Messpunkt fuer Fehlerpfad  Dfp_HWEMonCom" UWORD OneToOne 1 100 0.00 65535.00 FORMAT "%8.2" ECU_ADDRESS 0x8FE754 /end MEASUREMENT
/begin MEASUREMENT Dfp_HWEMonEEPROM_mp "Messpunkt fuer Fehlerpfad  Dfp_HWEMonEEPROM" UWORD OneToOne 1 100 0.00 65535.00 FORMAT "%8.2" ECU_ADDRESS 0x8FE756 /end MEASUREMENT
/begin MEASUREMENT Dfp_HWEMonRcyLocked_mp "Messpunkt fuer Fehlerpfad  Dfp_HWEMonRcyLocked" UWORD OneToOne 1 100 0.00 65535.00 FORMAT "%8.2" ECU_ADDRESS 0x8FE758 /end MEASUREMENT
/begin MEASUREMENT Dfp_HWEMonRcySuppressed_mp "Messpunkt fuer Fehlerpfad  Dfp_HWEMonRcySuppressed" UWORD OneToOne 1 100 0.00 65535.00 FORMAT "%8.2" ECU_ADDRESS 0x8FE75A /end MEASUREMENT
/begin MEASUREMENT Dfp_HWEMonRcyVisible_mp "Messpunkt fuer Fehlerpfad  Dfp_HWEMonRcyVisible" UWORD OneToOne 1 100 0.00 65535.00 FORMAT "%8.2" ECU_ADDRESS 0x8FE75C /end MEASUREMENT
/begin MEASUREMENT Dfp_HWEMonUMaxSupply_mp "Messpunkt fuer Fehlerpfad  Dfp_HWEMonUMaxSupply" UWORD OneToOne 1 100 0.00 65535.00 FORMAT "%8.2" ECU_ADDRESS 0x8FE75E /end MEASUREMENT
/begin MEASUREMENT Dfp_HWEMonUMinSupply_mp "Messpunkt fuer Fehlerpfad  Dfp_HWEMonUMinSupply" UWORD OneToOne 1 100 0.00 65535.00 FORMAT "%8.2" ECU_ADDRESS 0x8FE760 /end MEASUREMENT
/begin MEASUREMENT Dfp_IATSCD_CATS_mp "Fehlerpfad Ladelufttemperaturwert nach Ladeluftkühler" UWORD OneToOne 1 100 0.00 65535.00 FORMAT "%8.2" ECU_ADDRESS 0x8FE762 /end MEASUREMENT
/begin MEASUREMENT Dfp_IATSCD_mp "Messpunkt fuer Fehlerpfad  Dfp_IATSCD" UWORD OneToOne 1 100 0.00 65535.00 FORMAT "%8.2" ECU_ADDRESS 0x8FE764 /end MEASUREMENT
/begin MEASUREMENT Dfp_ImmCtlImmCD_mp "Messpunkt fuer Fehlerpfad  Dfp_ImmCtlImmCD" UWORD OneToOne 1 100 0.00 65535.00 FORMAT "%8.2" ECU_ADDRESS 0x8FE766 /end MEASUREMENT
/begin MEASUREMENT Dfp_ImmCtlImmEep_mp "Messpunkt fuer Fehlerpfad  Dfp_ImmCtlImmEep" UWORD OneToOne 1 100 0.00 65535.00 FORMAT "%8.2" ECU_ADDRESS 0x8FE768 /end MEASUREMENT
/begin MEASUREMENT Dfp_ImmCtlMpl_mp "Messpunkt fuer Fehlerpfad  Dfp_ImmCtlMpl" UWORD OneToOne 1 100 0.00 65535.00 FORMAT "%8.2" ECU_ADDRESS 0x8FE76A /end MEASUREMENT
/begin MEASUREMENT Dfp_IndSys1_mp "IndSys1 defect path" UWORD OneToOne 1 100 0.00 65535.00 FORMAT "%8.2" ECU_ADDRESS 0x8FE76C /end MEASUREMENT
/begin MEASUREMENT Dfp_IndSys2_mp "IndSys2 defect path" UWORD OneToOne 1 100 0.00 65535.00 FORMAT "%8.2" ECU_ADDRESS 0x8FE76E /end MEASUREMENT
/begin MEASUREMENT Dfp_InjCrv_InjLim_mp "Messpunkt fuer Fehlerpfad Dfp_InjCrv_InjLim" UWORD OneToOne 1 100 0.00 65535.00 FORMAT "%8.2" ECU_ADDRESS 0x8FE770 /end MEASUREMENT
/begin MEASUREMENT Dfp_InjCtlAdjQnt_mp "Messpunkt fuer Fehlerpfad  Dfp_InjCtlAdjQnt" UWORD OneToOne 1 100 0.00 65535.00 FORMAT "%8.2" ECU_ADDRESS 0x8FE772 /end MEASUREMENT
/begin MEASUREMENT Dfp_InjCtlDrift_mp "Messpunkt fuer Fehlerpfad  Dfp_InjCtlDrift" UWORD OneToOne 1 100 0.00 65535.00 FORMAT "%8.2" ECU_ADDRESS 0x8FE774 /end MEASUREMENT
/begin MEASUREMENT Dfp_InjVCDActrChrg_mp "Messpunkt fuer Fehlerpfad  Dfp_InjVCDActrChrg" UWORD OneToOne 1 100 0.00 65535.00 FORMAT "%8.2" ECU_ADDRESS 0x8FE776 /end MEASUREMENT
/begin MEASUREMENT Dfp_InjVCDActrEnrg1_mp "Messpunkt fuer Fehlerpfad  Dfp_InjVCDActrEnrg1" UWORD OneToOne 1 100 0.00 65535.00 FORMAT "%8.2" ECU_ADDRESS 0x8FE778 /end MEASUREMENT
/begin MEASUREMENT Dfp_InjVCDActrEnrg2_mp "Messpunkt fuer Fehlerpfad  Dfp_InjVCDActrEnrg2" UWORD OneToOne 1 100 0.00 65535.00 FORMAT "%8.2" ECU_ADDRESS 0x8FE77A /end MEASUREMENT
/begin MEASUREMENT Dfp_InjVCDActrEnrg3_mp "Messpunkt fuer Fehlerpfad  Dfp_InjVCDActrEnrg3" UWORD OneToOne 1 100 0.00 65535.00 FORMAT "%8.2" ECU_ADDRESS 0x8FE77C /end MEASUREMENT
/begin MEASUREMENT Dfp_InjVCDActrEnrg4_mp "Messpunkt fuer Fehlerpfad  Dfp_InjVCDActrEnrg4" UWORD OneToOne 1 100 0.00 65535.00 FORMAT "%8.2" ECU_ADDRESS 0x8FE77E /end MEASUREMENT
/begin MEASUREMENT Dfp_InjVCDActrEnrg5_mp "Messpunkt fuer Fehlerpfad  Dfp_InjVCDActrEnrg5" UWORD OneToOne 1 100 0.00 65535.00 FORMAT "%8.2" ECU_ADDRESS 0x8FE780 /end MEASUREMENT
/begin MEASUREMENT Dfp_InjVCDActrEnrg6_mp "Messpunkt fuer Fehlerpfad  Dfp_InjVCDActrEnrg6" UWORD OneToOne 1 100 0.00 65535.00 FORMAT "%8.2" ECU_ADDRESS 0x8FE782 /end MEASUREMENT
/begin MEASUREMENT Dfp_InjVCDActrEnrg7_mp "Messpunkt fuer Fehlerpfad  Dfp_InjVCDActrEnrg7" UWORD OneToOne 1 100 0.00 65535.00 FORMAT "%8.2" ECU_ADDRESS 0x8FE784 /end MEASUREMENT
/begin MEASUREMENT Dfp_InjVCDActrEnrg8_mp "Messpunkt fuer Fehlerpfad  Dfp_InjVCDActrEnrg8" UWORD OneToOne 1 100 0.00 65535.00 FORMAT "%8.2" ECU_ADDRESS 0x8FE786 /end MEASUREMENT
/begin MEASUREMENT Dfp_InjVCDActrVolt_mp "Messpunkt fuer Fehlerpfad  Dfp_InjVCDActrVolt" UWORD OneToOne 1 100 0.00 65535.00 FORMAT "%8.2" ECU_ADDRESS 0x8FE788 /end MEASUREMENT
/begin MEASUREMENT Dfp_InjVCDClsBank1_mp "Messpunkt fuer Fehlerpfad  Dfp_InjVCDClsBank1" UWORD OneToOne 1 100 0.00 65535.00 FORMAT "%8.2" ECU_ADDRESS 0x8FE78A /end MEASUREMENT
/begin MEASUREMENT Dfp_InjVCDClsBank2_mp "Messpunkt fuer Fehlerpfad  Dfp_InjVCDClsBank2" UWORD OneToOne 1 100 0.00 65535.00 FORMAT "%8.2" ECU_ADDRESS 0x8FE78C /end MEASUREMENT
/begin MEASUREMENT Dfp_InjVCDMonCab_mp "Messpunkt fuer Fehlerpfad  Dfp_InjVCDMonCab" UWORD OneToOne 1 100 0.00 65535.00 FORMAT "%8.2" ECU_ADDRESS 0x8FE78E /end MEASUREMENT
/begin MEASUREMENT Dfp_InjVCDMonSwt_mp "Messpunkt fuer Fehlerpfad  Dfp_InjVCDMonSwt" UWORD OneToOne 1 100 0.00 65535.00 FORMAT "%8.2" ECU_ADDRESS 0x8FE790 /end MEASUREMENT
/begin MEASUREMENT Dfp_InjVCDShOffDCDC_mp "Fehlerpfad ""Ladeschalterkurzschluss""" UWORD OneToOne 1 100 0.00 65535.00 FORMAT "%8.2" ECU_ADDRESS 0x8FE792 /end MEASUREMENT
/begin MEASUREMENT Dfp_InjVCDUBuf_mp "Messpunkt fuer Fehlerpfad  Dfp_InjVCDUBuf" UWORD OneToOne 1 100 0.00 65535.00 FORMAT "%8.2" ECU_ADDRESS 0x8FE794 /end MEASUREMENT
/begin MEASUREMENT Dfp_InjVCD_CY370Ampl_mp "Fehlerpfad für Verstärkerabgleich vom CY370" UWORD OneToOne 1 100 0.00 65535.00 FORMAT "%8.2" ECU_ADDRESS 0x8FE796 /end MEASUREMENT
/begin MEASUREMENT Dfp_InjVlvBnk1A_mp "A Fehlerpfad für Bank 1" UWORD OneToOne 1 100 0.00 65535.00 FORMAT "%8.2" ECU_ADDRESS 0x8FE798 /end MEASUREMENT
/begin MEASUREMENT Dfp_InjVlvBnk1B_mp "B Fehlerpfad für Bank 1" UWORD OneToOne 1 100 0.00 65535.00 FORMAT "%8.2" ECU_ADDRESS 0x8FE79A /end MEASUREMENT
/begin MEASUREMENT Dfp_InjVlvBnk2A_mp "A Fehlerpfad für Bank 2" UWORD OneToOne 1 100 0.00 65535.00 FORMAT "%8.2" ECU_ADDRESS 0x8FE79C /end MEASUREMENT
/begin MEASUREMENT Dfp_InjVlvBnk2B_mp "B Fehlerpfad für Bank 2" UWORD OneToOne 1 100 0.00 65535.00 FORMAT "%8.2" ECU_ADDRESS 0x8FE79E /end MEASUREMENT
/begin MEASUREMENT Dfp_InjVlvChipA_mp "A Fehlerpfad  für Baustein" UWORD OneToOne 1 100 0.00 65535.00 FORMAT "%8.2" ECU_ADDRESS 0x8FE7A0 /end MEASUREMENT
/begin MEASUREMENT Dfp_InjVlvChipB_mp "B Fehlerpfad für Baustein" UWORD OneToOne 1 100 0.00 65535.00 FORMAT "%8.2" ECU_ADDRESS 0x8FE7A2 /end MEASUREMENT
/begin MEASUREMENT Dfp_InjVlvCyl1A_mp "A Fehlerpfad  für Zylinder 1" UWORD OneToOne 1 100 0.00 65535.00 FORMAT "%8.2" ECU_ADDRESS 0x8FE7A4 /end MEASUREMENT
/begin MEASUREMENT Dfp_InjVlvCyl1B_mp "B Fehlerpfad  für Zylinder 1" UWORD OneToOne 1 100 0.00 65535.00 FORMAT "%8.2" ECU_ADDRESS 0x8FE7A6 /end MEASUREMENT
/begin MEASUREMENT Dfp_InjVlvCyl1C_mp "Messpunkt fuer Fehlerpfad  Dfp_InjVlvCyl1C" UWORD OneToOne 1 100 0.00 65535.00 FORMAT "%8.2" ECU_ADDRESS 0x8FE7A8 /end MEASUREMENT
/begin MEASUREMENT Dfp_InjVlvCyl2A_mp "A Fehlerpfad  für Zylinder 2" UWORD OneToOne 1 100 0.00 65535.00 FORMAT "%8.2" ECU_ADDRESS 0x8FE7AA /end MEASUREMENT
/begin MEASUREMENT Dfp_InjVlvCyl2B_mp "B Fehlerpfad  für Zylinder 2" UWORD OneToOne 1 100 0.00 65535.00 FORMAT "%8.2" ECU_ADDRESS 0x8FE7AC /end MEASUREMENT
/begin MEASUREMENT Dfp_InjVlvCyl2C_mp "Messpunkt fuer Fehlerpfad  Dfp_InjVlvCyl2C" UWORD OneToOne 1 100 0.00 65535.00 FORMAT "%8.2" ECU_ADDRESS 0x8FE7AE /end MEASUREMENT
/begin MEASUREMENT Dfp_InjVlvCyl3A_mp "A Fehlerpfad  für Zylinder 3" UWORD OneToOne 1 100 0.00 65535.00 FORMAT "%8.2" ECU_ADDRESS 0x8FE7B0 /end MEASUREMENT
/begin MEASUREMENT Dfp_InjVlvCyl3B_mp "B Fehlerpfad  für Zylinder 3" UWORD OneToOne 1 100 0.00 65535.00 FORMAT "%8.2" ECU_ADDRESS 0x8FE7B2 /end MEASUREMENT
/begin MEASUREMENT Dfp_InjVlvCyl3C_mp "Messpunkt fuer Fehlerpfad  Dfp_InjVlvCyl3C" UWORD OneToOne 1 100 0.00 65535.00 FORMAT "%8.2" ECU_ADDRESS 0x8FE7B4 /end MEASUREMENT
/begin MEASUREMENT Dfp_InjVlvCyl4A_mp "A Fehlerpfad  für Zylinder 4" UWORD OneToOne 1 100 0.00 65535.00 FORMAT "%8.2" ECU_ADDRESS 0x8FE7B6 /end MEASUREMENT
/begin MEASUREMENT Dfp_InjVlvCyl4B_mp "B Fehlerpfad  für Zylinder 4" UWORD OneToOne 1 100 0.00 65535.00 FORMAT "%8.2" ECU_ADDRESS 0x8FE7B8 /end MEASUREMENT
/begin MEASUREMENT Dfp_InjVlvCyl4C_mp "Messpunkt fuer Fehlerpfad  Dfp_InjVlvCyl4C" UWORD OneToOne 1 100 0.00 65535.00 FORMAT "%8.2" ECU_ADDRESS 0x8FE7BA /end MEASUREMENT
/begin MEASUREMENT Dfp_InjVlvCyl5A_mp "A Fehlerpfad  für Zylinder 5" UWORD OneToOne 1 100 0.00 65535.00 FORMAT "%8.2" ECU_ADDRESS 0x8FE7BC /end MEASUREMENT
/begin MEASUREMENT Dfp_InjVlvCyl5B_mp "B Fehlerpfad  für Zylinder 5" UWORD OneToOne 1 100 0.00 65535.00 FORMAT "%8.2" ECU_ADDRESS 0x8FE7BE /end MEASUREMENT
/begin MEASUREMENT Dfp_InjVlvCyl5C_mp "Messpunkt fuer Fehlerpfad  Dfp_InjVlvCyl5C" UWORD OneToOne 1 100 0.00 65535.00 FORMAT "%8.2" ECU_ADDRESS 0x8FE7C0 /end MEASUREMENT
/begin MEASUREMENT Dfp_InjVlvCyl6A_mp "A Fehlerpfad  für Zylinder 6" UWORD OneToOne 1 100 0.00 65535.00 FORMAT "%8.2" ECU_ADDRESS 0x8FE7C2 /end MEASUREMENT
/begin MEASUREMENT Dfp_InjVlvCyl6B_mp "B Fehlerpfad  für Zylinder 6" UWORD OneToOne 1 100 0.00 65535.00 FORMAT "%8.2" ECU_ADDRESS 0x8FE7C4 /end MEASUREMENT
/begin MEASUREMENT Dfp_InjVlvCyl6C_mp "Messpunkt fuer Fehlerpfad  Dfp_InjVlvCyl6C" UWORD OneToOne 1 100 0.00 65535.00 FORMAT "%8.2" ECU_ADDRESS 0x8FE7C6 /end MEASUREMENT
/begin MEASUREMENT Dfp_InjVlvCyl7A_mp "A Fehlerpfad  für Zylinder 7" UWORD OneToOne 1 100 0.00 65535.00 FORMAT "%8.2" ECU_ADDRESS 0x8FE7C8 /end MEASUREMENT
/begin MEASUREMENT Dfp_InjVlvCyl7B_mp "B Fehlerpfad  für Zylinder 7" UWORD OneToOne 1 100 0.00 65535.00 FORMAT "%8.2" ECU_ADDRESS 0x8FE7CA /end MEASUREMENT
/begin MEASUREMENT Dfp_InjVlvCyl7C_mp "Messpunkt fuer Fehlerpfad  Dfp_InjVlvCyl7C" UWORD OneToOne 1 100 0.00 65535.00 FORMAT "%8.2" ECU_ADDRESS 0x8FE7CC /end MEASUREMENT
/begin MEASUREMENT Dfp_InjVlvCyl8A_mp "A Fehlerpfad  für Zylinder 8" UWORD OneToOne 1 100 0.00 65535.00 FORMAT "%8.2" ECU_ADDRESS 0x8FE7CE /end MEASUREMENT
/begin MEASUREMENT Dfp_InjVlvCyl8B_mp "B Fehlerpfad  für Zylinder 8" UWORD OneToOne 1 100 0.00 65535.00 FORMAT "%8.2" ECU_ADDRESS 0x8FE7D0 /end MEASUREMENT
/begin MEASUREMENT Dfp_InjVlvCyl8C_mp "Messpunkt fuer Fehlerpfad  Dfp_InjVlvCyl8C" UWORD OneToOne 1 100 0.00 65535.00 FORMAT "%8.2" ECU_ADDRESS 0x8FE7D2 /end MEASUREMENT
/begin MEASUREMENT Dfp_InjVlvNVC1_mp "Messpunkt für Fehlerpfad Dfp_InjVlvNVC1" UWORD OneToOne 1 100 0.00 65535.00 FORMAT "%8.2" ECU_ADDRESS 0x8FE7D4 /end MEASUREMENT
/begin MEASUREMENT Dfp_InjVlvNVC2_mp "Messpunkt für Fehlerpfad Dfp_InjVlvNVC2" UWORD OneToOne 1 100 0.00 65535.00 FORMAT "%8.2" ECU_ADDRESS 0x8FE7D6 /end MEASUREMENT
/begin MEASUREMENT Dfp_InjVlvNVC3_mp "Messpunkt für Fehlerpfad Dfp_InjVlvNVC3" UWORD OneToOne 1 100 0.00 65535.00 FORMAT "%8.2" ECU_ADDRESS 0x8FE7D8 /end MEASUREMENT
/begin MEASUREMENT Dfp_InjVlvNVC4_mp "Messpunkt für Fehlerpfad Dfp_InjVlvNVC4" UWORD OneToOne 1 100 0.00 65535.00 FORMAT "%8.2" ECU_ADDRESS 0x8FE7DA /end MEASUREMENT
/begin MEASUREMENT Dfp_InjVlvNVC5_mp "Messpunkt für Fehlerpfad Dfp_InjVlvNVC5" UWORD OneToOne 1 100 0.00 65535.00 FORMAT "%8.2" ECU_ADDRESS 0x8FE7DC /end MEASUREMENT
/begin MEASUREMENT Dfp_InjVlvNVC6_mp "Messpunkt für Fehlerpfad Dfp_InjVlvNVC6" UWORD OneToOne 1 100 0.00 65535.00 FORMAT "%8.2" ECU_ADDRESS 0x8FE7DE /end MEASUREMENT
/begin MEASUREMENT Dfp_InjVlvNVC7_mp "Messpunkt für Fehlerpfad Dfp_InjVlvNVC7" UWORD OneToOne 1 100 0.00 65535.00 FORMAT "%8.2" ECU_ADDRESS 0x8FE7E0 /end MEASUREMENT
/begin MEASUREMENT Dfp_InjVlvNVC8_mp "Messpunkt für Fehlerpfad Dfp_InjVlvNVC8" UWORD OneToOne 1 100 0.00 65535.00 FORMAT "%8.2" ECU_ADDRESS 0x8FE7E2 /end MEASUREMENT
/begin MEASUREMENT Dfp_Layer_BSD_mp "Messpunkt fuer Fehlerpfad  Dfp_Layer_BSD" UWORD OneToOne 1 100 0.00 65535.00 FORMAT "%8.2" ECU_ADDRESS 0x8FE7E4 /end MEASUREMENT
/begin MEASUREMENT Dfp_Layer_GEN_mp "Messpunkt fuer Fehlerpfad  Dfp_Layer_GEN" UWORD OneToOne 1 100 0.00 65535.00 FORMAT "%8.2" ECU_ADDRESS 0x8FE7E6 /end MEASUREMENT
/begin MEASUREMENT Dfp_Layer_IBS1_mp "Messpunkt fuer Fehlerpfad  Dfp_Layer_IBS1" UWORD OneToOne 1 100 0.00 65535.00 FORMAT "%8.2" ECU_ADDRESS 0x8FE7E8 /end MEASUREMENT
/begin MEASUREMENT Dfp_Layer_IBS2_mp "Messpunkt fuer Fehlerpfad  Dfp_Layer_IBS2" UWORD OneToOne 1 100 0.00 65535.00 FORMAT "%8.2" ECU_ADDRESS 0x8FE7EA /end MEASUREMENT
/begin MEASUREMENT Dfp_Layer_IBS3_mp "Messpunkt fuer Fehlerpfad  Dfp_Layer_IBS3" UWORD OneToOne 1 100 0.00 65535.00 FORMAT "%8.2" ECU_ADDRESS 0x8FE7EC /end MEASUREMENT
/begin MEASUREMENT Dfp_Layer_MANHYDR_mp "Messpunkt fuer Fehlerpfad  Dfp_Layer_MANHYDR" UWORD OneToOne 1 100 0.00 65535.00 FORMAT "%8.2" ECU_ADDRESS 0x8FE7EE /end MEASUREMENT
/begin MEASUREMENT Dfp_Layer_MANLUFT_mp "Messpunkt fuer Fehlerpfad  Dfp_Layer_MANLUFT" UWORD OneToOne 1 100 0.00 65535.00 FORMAT "%8.2" ECU_ADDRESS 0x8FE7F0 /end MEASUREMENT
/begin MEASUREMENT Dfp_Layer_PMBATT_mp "Messpunkt fuer Fehlerpfad  Dfp_Layer_PMBATT" UWORD OneToOne 1 100 0.00 65535.00 FORMAT "%8.2" ECU_ADDRESS 0x8FE7F2 /end MEASUREMENT
/begin MEASUREMENT Dfp_Layer_PMBN_mp "Messpunkt fuer Fehlerpfad  Dfp_Layer_PMBN" UWORD OneToOne 1 100 0.00 65535.00 FORMAT "%8.2" ECU_ADDRESS 0x8FE7F4 /end MEASUREMENT
/begin MEASUREMENT Dfp_Layer_PMRUHVERL_mp "Messpunkt fuer Fehlerpfad  Dfp_Layer_PMRUHVERL" UWORD OneToOne 1 100 0.00 65535.00 FORMAT "%8.2" ECU_ADDRESS 0x8FE7F6 /end MEASUREMENT
/begin MEASUREMENT Dfp_Layer_QLT_mp "Messpunkt fuer Fehlerpfad  Dfp_Layer_QLT" UWORD OneToOne 1 100 0.00 65535.00 FORMAT "%8.2" ECU_ADDRESS 0x8FE7F8 /end MEASUREMENT
/begin MEASUREMENT Dfp_Layer_TANS_mp "Messpunkt fuer Fehlerpfad  Dfp_Layer_TANS" UWORD OneToOne 1 100 0.00 65535.00 FORMAT "%8.2" ECU_ADDRESS 0x8FE7FA /end MEASUREMENT
/begin MEASUREMENT Dfp_Layer_TOENS_mp "Messpunkt fuer Fehlerpfad  Dfp_Layer_TOENS" UWORD OneToOne 1 100 0.00 65535.00 FORMAT "%8.2" ECU_ADDRESS 0x8FE7FC /end MEASUREMENT
/begin MEASUREMENT Dfp_Layer_TUMG_mp "Messpunkt fuer Fehlerpfad  Dfp_Layer_TUMG" UWORD OneToOne 1 100 0.00 65535.00 FORMAT "%8.2" ECU_ADDRESS 0x8FE7FE /end MEASUREMENT
/begin MEASUREMENT Dfp_LPACD_Max_mp "Messpunkt fuer Fehlerpfad  Dfp_LPACD_Max" UWORD OneToOne 1 100 0.00 65535.00 FORMAT "%8.2" ECU_ADDRESS 0x8FE800 /end MEASUREMENT
/begin MEASUREMENT Dfp_LPACD_Min_mp "Messpunkt fuer Fehlerpfad  Dfp_LPACD_Min" UWORD OneToOne 1 100 0.00 65535.00 FORMAT "%8.2" ECU_ADDRESS 0x8FE802 /end MEASUREMENT
/begin MEASUREMENT Dfp_LPACD_SigNpl_mp "Messpunkt fuer Fehlerpfad  Dfp_LPACD_SigNpl" UWORD OneToOne 1 100 0.00 65535.00 FORMAT "%8.2" ECU_ADDRESS 0x8FE804 /end MEASUREMENT
/begin MEASUREMENT Dfp_LSUCDCircNernst0_mp "Messpunkt fuer Fehlerpfad  Dfp_LSUCDCircNernst0" UWORD OneToOne 1 100 0.00 65535.00 FORMAT "%8.2" ECU_ADDRESS 0x8FE806 /end MEASUREMENT
/begin MEASUREMENT Dfp_LSUCDCircPumpCur0_mp "Messpunkt fuer Fehlerpfad  Dfp_LSUCDCircPumpCur0" UWORD OneToOne 1 100 0.00 65535.00 FORMAT "%8.2" ECU_ADDRESS 0x8FE808 /end MEASUREMENT
/begin MEASUREMENT Dfp_LSUCDCircVirtGnd0_mp "Messpunkt fuer Fehlerpfad  Dfp_LSUCDCircVirtGnd0" UWORD OneToOne 1 100 0.00 65535.00 FORMAT "%8.2" ECU_ADDRESS 0x8FE80A /end MEASUREMENT
/begin MEASUREMENT Dfp_LSUCDHeater0_mp "Messpunkt fuer Fehlerpfad  Dfp_LSUCDHeater0" UWORD OneToOne 1 100 0.00 65535.00 FORMAT "%8.2" ECU_ADDRESS 0x8FE80C /end MEASUREMENT
/begin MEASUREMENT Dfp_LSUCDHtCoup0_mp "Messpunkt fuer Fehlerpfad  Dfp_LSUCDHtCoup0" UWORD OneToOne 1 100 0.00 65535.00 FORMAT "%8.2" ECU_ADDRESS 0x8FE80E /end MEASUREMENT
/begin MEASUREMENT Dfp_LSUCDO20_mp "Messpunkt fuer Fehlerpfad  Dfp_LSUCDO20" UWORD OneToOne 1 100 0.00 65535.00 FORMAT "%8.2" ECU_ADDRESS 0x8FE810 /end MEASUREMENT
/begin MEASUREMENT Dfp_LSUCDO2Clb0_mp "Messpunkt fuer Fehlerpfad  Dfp_LSUCDO2Clb0" UWORD OneToOne 1 100 0.00 65535.00 FORMAT "%8.2" ECU_ADDRESS 0x8FE812 /end MEASUREMENT
/begin MEASUREMENT Dfp_LSUCDRiClb0_mp "Messpunkt fuer Fehlerpfad  Dfp_LSUCDRiClb0" UWORD OneToOne 1 100 0.00 65535.00 FORMAT "%8.2" ECU_ADDRESS 0x8FE814 /end MEASUREMENT
/begin MEASUREMENT Dfp_LSUCDSPI0_mp "Messpunkt fuer Fehlerpfad  Dfp_LSUCDSPI0" UWORD OneToOne 1 100 0.00 65535.00 FORMAT "%8.2" ECU_ADDRESS 0x8FE816 /end MEASUREMENT
/begin MEASUREMENT Dfp_LSUCDSPIBattLow0_mp "Fehlerpfad für niedrige Batteriespannung" UWORD OneToOne 1 100 0.00 65535.00 FORMAT "%8.2" ECU_ADDRESS 0x8FE818 /end MEASUREMENT
/begin MEASUREMENT Dfp_LSUCDWireIP0_mp "Messpunkt fuer Fehlerpfad  Dfp_LSUCDWireIP0" UWORD OneToOne 1 100 0.00 65535.00 FORMAT "%8.2" ECU_ADDRESS 0x8FE81A /end MEASUREMENT
/begin MEASUREMENT Dfp_LSUCtlRiExc0_mp "Messpunkt fuer Fehlerpfad  Dfp_LSUCtlRiExc0" UWORD OneToOne 1 100 0.00 65535.00 FORMAT "%8.2" ECU_ADDRESS 0x8FE81C /end MEASUREMENT
/begin MEASUREMENT Dfp_LSUMon1Sens_mp "Messpunkt fuer Fehlerpfad  Dfp_LSUMon1Sens" UWORD OneToOne 1 100 0.00 65535.00 FORMAT "%8.2" ECU_ADDRESS 0x8FE81E /end MEASUREMENT
/begin MEASUREMENT Dfp_LSUMon2Sens_mp "Messpunkt fuer Fehlerpfad  Dfp_LSUMon2Sens" UWORD OneToOne 1 100 0.00 65535.00 FORMAT "%8.2" ECU_ADDRESS 0x8FE820 /end MEASUREMENT
/begin MEASUREMENT Dfp_MeUnCDNoLoad_mp "Fehlerpfad für Lastabfall der Zumesseinheit" UWORD OneToOne 1 100 0.00 65535.00 FORMAT "%8.2" ECU_ADDRESS 0x8FE822 /end MEASUREMENT
/begin MEASUREMENT Dfp_MeUnCDSCBat_mp "Fehlerpfad für Kurzschluss zur Batteriespannung der Zumesseinheit" UWORD OneToOne 1 100 0.00 65535.00 FORMAT "%8.2" ECU_ADDRESS 0x8FE824 /end MEASUREMENT
/begin MEASUREMENT Dfp_MeUnCDSCGnd_mp "Fehlerpfad für Kurzschluss nach Masse der Zumesseinheit" UWORD OneToOne 1 100 0.00 65535.00 FORMAT "%8.2" ECU_ADDRESS 0x8FE826 /end MEASUREMENT
/begin MEASUREMENT Dfp_MeUnCD_ADC_mp "Fehlerpfad für die Signalerfassung des Stroms durch die Zumesseinheit" UWORD OneToOne 1 100 0.00 65535.00 FORMAT "%8.2" ECU_ADDRESS 0x8FE828 /end MEASUREMENT
/begin MEASUREMENT Dfp_MeUnCD_SigTst_mp "Messpunkt fuer Fehlerpfad  Dfp_MeUnCD_SigTst" UWORD OneToOne 1 100 0.00 65535.00 FORMAT "%8.2" ECU_ADDRESS 0x8FE82A /end MEASUREMENT
/begin MEASUREMENT Dfp_MIL_mp "Messpunkt fuer Fehlerpfad  Dfp_MIL" UWORD OneToOne 1 100 0.00 65535.00 FORMAT "%8.2" ECU_ADDRESS 0x8FE82C /end MEASUREMENT
/begin MEASUREMENT Dfp_Montr_mp "Messpunkt fuer Fehlerpfad  Dfp_Montr" UWORD OneToOne 1 100 0.00 65535.00 FORMAT "%8.2" ECU_ADDRESS 0x8FE82E /end MEASUREMENT
/begin MEASUREMENT Dfp_MRlyCD_mp "Messpunkt fuer Fehlerpfad  Dfp_MRlyCD" UWORD OneToOne 1 100 0.00 65535.00 FORMAT "%8.2" ECU_ADDRESS 0x8FE830 /end MEASUREMENT
/begin MEASUREMENT Dfp_MSidCD_Comm_mp "Messpunkt fuer Fehlerpfad  Dfp_MSidCD_Comm" UWORD OneToOne 1 100 0.00 65535.00 FORMAT "%8.2" ECU_ADDRESS 0x8FE832 /end MEASUREMENT
/begin MEASUREMENT Dfp_MSidCD_Pin_mp "Messpunkt fuer Fehlerpfad  Dfp_MSidCD_Pin" UWORD OneToOne 1 100 0.00 65535.00 FORMAT "%8.2" ECU_ADDRESS 0x8FE834 /end MEASUREMENT
/begin MEASUREMENT Dfp_MSidCD_Select_mp "Messpunkt fuer Fehlerpfad  Dfp_MSidCD_Select" UWORD OneToOne 1 100 0.00 65535.00 FORMAT "%8.2" ECU_ADDRESS 0x8FE836 /end MEASUREMENT
/begin MEASUREMENT Dfp_MSidCD_Sel_INI_mp "Messpunkt fuer Fehlerpfad  Dfp_MSidCD_Sel_INI" UWORD OneToOne 1 100 0.00 65535.00 FORMAT "%8.2" ECU_ADDRESS 0x8FE838 /end MEASUREMENT
/begin MEASUREMENT Dfp_NetMngDeviceA_mp "Fehlerpfad für CAN Baustein A" UWORD OneToOne 1 100 0.00 65535.00 FORMAT "%8.2" ECU_ADDRESS 0x8FE83A /end MEASUREMENT
/begin MEASUREMENT Dfp_NetMngDeviceB_mp "Fehlerpfad für CAN Baustein B" UWORD OneToOne 1 100 0.00 65535.00 FORMAT "%8.2" ECU_ADDRESS 0x8FE83C /end MEASUREMENT
/begin MEASUREMENT Dfp_NetMngDeviceC_mp "Messpunkt fuer Fehlerpfad  Dfp_NetMngDeviceC" UWORD OneToOne 1 100 0.00 65535.00 FORMAT "%8.2" ECU_ADDRESS 0x8FE83E /end MEASUREMENT
/begin MEASUREMENT Dfp_OPSCD_anain_mp "Messpunkt fuer Fehlerpfad  Dfp_OPSCD_anain" UWORD OneToOne 1 100 0.00 65535.00 FORMAT "%8.2" ECU_ADDRESS 0x8FE840 /end MEASUREMENT
/begin MEASUREMENT Dfp_OPSCD_Lamp_mp "Fehlerpfad Endstufenfehler Öllampe" UWORD OneToOne 1 100 0.00 65535.00 FORMAT "%8.2" ECU_ADDRESS 0x8FE842 /end MEASUREMENT
/begin MEASUREMENT Dfp_OTSCD_mp "Fehlerpfad Öltemperaturwert" UWORD OneToOne 1 100 0.00 65535.00 FORMAT "%8.2" ECU_ADDRESS 0x8FE844 /end MEASUREMENT
/begin MEASUREMENT Dfp_OvRMonBrk_mp "measurment point for fault path Dfp_OvRMonBrk" UWORD OneToOne 1 100 0.00 65535.00 FORMAT "%8.2" ECU_ADDRESS 0x8FE846 /end MEASUREMENT
/begin MEASUREMENT Dfp_OvRMonSigA_mp "Fehlerpfad für Drehzahlplausibilisierung in der Schubüberwachung" UWORD OneToOne 1 100 0.00 65535.00 FORMAT "%8.2" ECU_ADDRESS 0x8FE848 /end MEASUREMENT
/begin MEASUREMENT Dfp_OvRMon_mp "Messpunkt fuer Fehlerpfad  Dfp_OvRMon" UWORD OneToOne 1 100 0.00 65535.00 FORMAT "%8.2" ECU_ADDRESS 0x8FE84A /end MEASUREMENT
/begin MEASUREMENT Dfp_OxiCCDTPre_mp "Messpunkt fuer Fehlerpfad  Dfp_OxiCCDTPre" UWORD OneToOne 1 100 0.00 65535.00 FORMAT "%8.2" ECU_ADDRESS 0x8FE84C /end MEASUREMENT
/begin MEASUREMENT Dfp_PCR_GovDevNeg_mp "Messpunkt fuer Fehlerpfad  Dfp_PCR_GovDevNeg" UWORD OneToOne 1 100 0.00 65535.00 FORMAT "%8.2" ECU_ADDRESS 0x8FE84E /end MEASUREMENT
/begin MEASUREMENT Dfp_PCR_GovDevPos_mp "Messpunkt fuer Fehlerpfad  Dfp_PCR_GovDevPos" UWORD OneToOne 1 100 0.00 65535.00 FORMAT "%8.2" ECU_ADDRESS 0x8FE850 /end MEASUREMENT
/begin MEASUREMENT Dfp_PCR_LPGvnrDvtNeg_mp "Fehlerpfadmeßpunkt neg. Regelabweichung PCR-LP" UWORD OneToOne 1 100 0.00 65535.00 FORMAT "%8.2" ECU_ADDRESS 0x8FE852 /end MEASUREMENT
/begin MEASUREMENT Dfp_PCR_LPGvnrDvtPos_mp "Fehlerpfadmeßpunkt pos. Regelabweichung PCR-LP" UWORD OneToOne 1 100 0.00 65535.00 FORMAT "%8.2" ECU_ADDRESS 0x8FE854 /end MEASUREMENT
/begin MEASUREMENT Dfp_PCVCDNoLoad_mp "Messpunkt fuer Fehlerpfad Lastabfall des Druckregelventils" UWORD OneToOne 1 100 0.00 65535.00 FORMAT "%8.2" ECU_ADDRESS 0x8FE856 /end MEASUREMENT
/begin MEASUREMENT Dfp_PCVCDSCBat_mp "Messpunkt für Fehlerpfad Kurzschluss zur Batteriespannung des Druckregelventils" UWORD OneToOne 1 100 0.00 65535.00 FORMAT "%8.2" ECU_ADDRESS 0x8FE858 /end MEASUREMENT
/begin MEASUREMENT Dfp_PCVCDSCGnd_mp "Messpunkt für Fehlerpfad Kurzschluss nach Masse des Druckregelventils" UWORD OneToOne 1 100 0.00 65535.00 FORMAT "%8.2" ECU_ADDRESS 0x8FE85A /end MEASUREMENT
/begin MEASUREMENT Dfp_PCVCD_ADC_mp "Messpunkt fuer Fehlerpfad  Dfp_PCVCD_ADC" UWORD OneToOne 1 100 0.00 65535.00 FORMAT "%8.2" ECU_ADDRESS 0x8FE85C /end MEASUREMENT
/begin MEASUREMENT Dfp_PCVCD_SigTst_mp "Messpunkt fuer Fehlerpfad  Dfp_PCVCD_SigTst" UWORD OneToOne 1 100 0.00 65535.00 FORMAT "%8.2" ECU_ADDRESS 0x8FE85E /end MEASUREMENT
/begin MEASUREMENT Dfp_PFltAPSens_mp "Fehlerfad für Atmosphärendrucksensor" UWORD OneToOne 1 100 0.00 65535.00 FORMAT "%8.2" ECU_ADDRESS 0x8FE860 /end MEASUREMENT
/begin MEASUREMENT Dfp_PFltAPSPlaus_mp "" UWORD OneToOne 1 100 0.00 65535.00 FORMAT "%8.2" ECU_ADDRESS 0x8FE862 /end MEASUREMENT
/begin MEASUREMENT Dfp_PFltBPSPlaus_mp "" UWORD OneToOne 1 100 0.00 65535.00 FORMAT "%8.2" ECU_ADDRESS 0x8FE864 /end MEASUREMENT
/begin MEASUREMENT Dfp_PFltCDPPre_mp "Messpunkt fuer Fehlerpfad  Dfp_PFltCDPPre" UWORD OneToOne 1 100 0.00 65535.00 FORMAT "%8.2" ECU_ADDRESS 0x8FE866 /end MEASUREMENT
/begin MEASUREMENT Dfp_PFltCDTempPre_mp "Fehlerpfad der Abgastemperatur vor dem Partikelfilter" UWORD OneToOne 1 100 0.00 65535.00 FORMAT "%8.2" ECU_ADDRESS 0x8FE868 /end MEASUREMENT
/begin MEASUREMENT Dfp_PFltChar_mp "Digitaler Fehlerpfad für Fliesswiderstand Partikelfilter" UWORD OneToOne 1 100 0.00 65535.00 FORMAT "%8.2" ECU_ADDRESS 0x8FE86A /end MEASUREMENT
/begin MEASUREMENT Dfp_PFltEngPrt_mp "Messpunkt fuer Fehlerpfad  Dfp_PFltEngPrt" UWORD OneToOne 1 100 0.00 65535.00 FORMAT "%8.2" ECU_ADDRESS 0x8FE86C /end MEASUREMENT
/begin MEASUREMENT Dfp_PFltmSotDiffMax_mp "Messpunkt fuer Fehlerpfad  Dfp_PFltmSotDiffMax" UWORD OneToOne 1 100 0.00 65535.00 FORMAT "%8.2" ECU_ADDRESS 0x8FE86E /end MEASUREMENT
/begin MEASUREMENT Dfp_PFltPresDynPlaus_mp "Messpunkt fuer Fehlerpfad  Dfp_PFltPresDynPlaus" UWORD OneToOne 1 100 0.00 65535.00 FORMAT "%8.2" ECU_ADDRESS 0x8FE870 /end MEASUREMENT
/begin MEASUREMENT Dfp_PFltPresPlaus_mp "" UWORD OneToOne 1 100 0.00 65535.00 FORMAT "%8.2" ECU_ADDRESS 0x8FE872 /end MEASUREMENT
/begin MEASUREMENT Dfp_PFltPresSensFrz_mp "Messpunkt fuer Fehlerpfad  Dfp_PFltPresSensFrz" UWORD OneToOne 1 100 0.00 65535.00 FORMAT "%8.2" ECU_ADDRESS 0x8FE874 /end MEASUREMENT
/begin MEASUREMENT Dfp_PFltPresSensHsLn_mp "Messpunkt fuer Fehlerpfad  Dfp_PFltPresSensHsLn" UWORD OneToOne 1 100 0.00 65535.00 FORMAT "%8.2" ECU_ADDRESS 0x8FE876 /end MEASUREMENT
/begin MEASUREMENT Dfp_PFltPresSensSot_mp "Messpunkt fuer Fehlerpfad  Dfp_PFltPresSensSot" UWORD OneToOne 1 100 0.00 65535.00 FORMAT "%8.2" ECU_ADDRESS 0x8FE878 /end MEASUREMENT
/begin MEASUREMENT Dfp_PFltPresSens_mp "Messpunkt fuer Fehlerpfad  Dfp_PFltPresSens" UWORD OneToOne 1 100 0.00 65535.00 FORMAT "%8.2" ECU_ADDRESS 0x8FE87A /end MEASUREMENT
/begin MEASUREMENT Dfp_PFltRgnPerm_mp "Messpunkt fuer Fehlerpfad  Dfp_PFltRgnPerm" UWORD OneToOne 1 100 0.00 65535.00 FORMAT "%8.2" ECU_ADDRESS 0x8FE87C /end MEASUREMENT
/begin MEASUREMENT Dfp_PFltTempDwnStrm_mp "Digitaler Fehlerpfad für zweiten Abgastemperatursensor" UWORD OneToOne 1 100 0.00 65535.00 FORMAT "%8.2" ECU_ADDRESS 0x8FE87E /end MEASUREMENT
/begin MEASUREMENT Dfp_PFltTempSens_mp "Messpunkt fuer Fehlerpfad  Dfp_PFltTempSens" UWORD OneToOne 1 100 0.00 65535.00 FORMAT "%8.2" ECU_ADDRESS 0x8FE880 /end MEASUREMENT
/begin MEASUREMENT Dfp_PFltTempUpStrm_mp "Digitaler Fehlerpfad für ersten Abgastemperatursensor" UWORD OneToOne 1 100 0.00 65535.00 FORMAT "%8.2" ECU_ADDRESS 0x8FE882 /end MEASUREMENT
/begin MEASUREMENT Dfp_PresPlausDblDef_mp "" UWORD OneToOne 1 100 0.00 65535.00 FORMAT "%8.2" ECU_ADDRESS 0x8FE884 /end MEASUREMENT
/begin MEASUREMENT Dfp_PSPCD_Actr_mp "Messpunkt fuer Fehlerpfad  Dfp_PSPCD_Actr" UWORD OneToOne 1 100 0.00 65535.00 FORMAT "%8.2" ECU_ADDRESS 0x8FE886 /end MEASUREMENT
/begin MEASUREMENT Dfp_QLTCD_mp "Messpunkt fuer Fehlerpfad  Dfp_QLTCD" UWORD OneToOne 1 100 0.00 65535.00 FORMAT "%8.2" ECU_ADDRESS 0x8FE888 /end MEASUREMENT
/begin MEASUREMENT Dfp_RailCDOfsTst_mp "Fehlerpfad für Offset-Überwachung des Raildrucksensors" UWORD OneToOne 1 100 0.00 65535.00 FORMAT "%8.2" ECU_ADDRESS 0x8FE88A /end MEASUREMENT
/begin MEASUREMENT Dfp_RailCD_mp "Messpunkt fuer Fehlerpfad  Dfp_RailCD" UWORD OneToOne 1 100 0.00 65535.00 FORMAT "%8.2" ECU_ADDRESS 0x8FE88C /end MEASUREMENT
/begin MEASUREMENT Dfp_RailCD_PMonStrt_mp "Messpunkt fuer Fehlerpfad  Dfp_RailCD_PMonStrt" UWORD OneToOne 1 100 0.00 65535.00 FORMAT "%8.2" ECU_ADDRESS 0x8FE88E /end MEASUREMENT
/begin MEASUREMENT Dfp_RailCtlModeMeUnDiag_mp "Messpunkt fuer Fehlerpfad  Dfp_RailCtlModeMeUnDiag" UWORD OneToOne 1 100 0.00 65535.00 FORMAT "%8.2" ECU_ADDRESS 0x8FE890 /end MEASUREMENT
/begin MEASUREMENT Dfp_RailCtlModePCVDiag_mp "Messpunkt fuer Fehlerpfad  Dfp_RailCtlModePCVDiag" UWORD OneToOne 1 100 0.00 65535.00 FORMAT "%8.2" ECU_ADDRESS 0x8FE892 /end MEASUREMENT
/begin MEASUREMENT Dfp_RailMeUn0_mp "Fehlerpfad für Überwachung auf positive Regelabweichung" UWORD OneToOne 1 100 0.00 65535.00 FORMAT "%8.2" ECU_ADDRESS 0x8FE894 /end MEASUREMENT
/begin MEASUREMENT Dfp_RailMeUn1_mp "Fehlerpfad für Überwachung auf positive Regelabweichung und Sollwert des Volumenstroms durch die Zumesseinheit" UWORD OneToOne 1 100 0.00 65535.00 FORMAT "%8.2" ECU_ADDRESS 0x8FE896 /end MEASUREMENT
/begin MEASUREMENT Dfp_RailMeUn2_mp "Fehlerpfad für Überwachung auf negative Regelabweichung bei Nullförderung" UWORD OneToOne 1 100 0.00 65535.00 FORMAT "%8.2" ECU_ADDRESS 0x8FE898 /end MEASUREMENT
/begin MEASUREMENT Dfp_RailMeUn3_mp "Fehlerpfad für Überwachung auf minimalen Raildruck" UWORD OneToOne 1 100 0.00 65535.00 FORMAT "%8.2" ECU_ADDRESS 0x8FE89A /end MEASUREMENT
/begin MEASUREMENT Dfp_RailMeUn4_mp "Fehlerpfad für Überwachung auf maximalen Raildruck" UWORD OneToOne 1 100 0.00 65535.00 FORMAT "%8.2" ECU_ADDRESS 0x8FE89C /end MEASUREMENT
/begin MEASUREMENT Dfp_RailPCV0_mp "Fehlerpfad für Überwachung auf positive Regelabweichung" UWORD OneToOne 1 100 0.00 65535.00 FORMAT "%8.2" ECU_ADDRESS 0x8FE89E /end MEASUREMENT
/begin MEASUREMENT Dfp_RailPCV1_mp "Fehlerpfad für Überwachung auf positive Regelabweichung kombiniert mit Stellgröße des Druckregelventils" UWORD OneToOne 1 100 0.00 65535.00 FORMAT "%8.2" ECU_ADDRESS 0x8FE8A0 /end MEASUREMENT
/begin MEASUREMENT Dfp_RailPCV2_mp "Fehlerpfad für Überwachung auf negative Regelabweichung kombiniert mit Stellgröße des Druckregelventils" UWORD OneToOne 1 100 0.00 65535.00 FORMAT "%8.2" ECU_ADDRESS 0x8FE8A2 /end MEASUREMENT
/begin MEASUREMENT Dfp_RailPCV3_mp "Fehlerpfad für Überwachung auf minimalen Raildruck" UWORD OneToOne 1 100 0.00 65535.00 FORMAT "%8.2" ECU_ADDRESS 0x8FE8A4 /end MEASUREMENT
/begin MEASUREMENT Dfp_RailPCV4_mp "Fehlerpfad für Überwachung auf maximalen Raildruck" UWORD OneToOne 1 100 0.00 65535.00 FORMAT "%8.2" ECU_ADDRESS 0x8FE8A6 /end MEASUREMENT
/begin MEASUREMENT Dfp_RailPCV5_mp "Fehlerpfad für Plausibilisierung des Raildrucks mit dem Strom durch das Druckregelventil" UWORD OneToOne 1 100 0.00 65535.00 FORMAT "%8.2" ECU_ADDRESS 0x8FE8A8 /end MEASUREMENT
/begin MEASUREMENT Dfp_ShutCD_mp "Messpunkt fuer Fehlerpfad  Dfp_ShutCD" UWORD OneToOne 1 100 0.00 65535.00 FORMAT "%8.2" ECU_ADDRESS 0x8FE8AA /end MEASUREMENT
/begin MEASUREMENT Dfp_SOPTst_mp "Messpunkt fuer Fehlerpfad  Dfp_SOPTst" UWORD OneToOne 1 100 0.00 65535.00 FORMAT "%8.2" ECU_ADDRESS 0x8FE8AC /end MEASUREMENT
/begin MEASUREMENT Dfp_SSpMon1_mp "Meßpunkt des Fehlerpfades für Sensorversorgungsspannung 1" UWORD OneToOne 1 100 0.00 65535.00 FORMAT "%8.2" ECU_ADDRESS 0x8FE8AE /end MEASUREMENT
/begin MEASUREMENT Dfp_SSpMon2_mp "Meßpunkt des Fehlerpfades für Sensorversorgungsspannung 2" UWORD OneToOne 1 100 0.00 65535.00 FORMAT "%8.2" ECU_ADDRESS 0x8FE8B0 /end MEASUREMENT
/begin MEASUREMENT Dfp_SSpMon3_mp "Meßpunkt des Fehlerpfades für Sensorversorgungsspannung 3" UWORD OneToOne 1 100 0.00 65535.00 FORMAT "%8.2" ECU_ADDRESS 0x8FE8B2 /end MEASUREMENT
/begin MEASUREMENT Dfp_StrtCD_Actr_mp "Fehlerpfad für Starterrelais Endstufe" UWORD OneToOne 1 100 0.00 65535.00 FORMAT "%8.2" ECU_ADDRESS 0x8FE8B4 /end MEASUREMENT
/begin MEASUREMENT Dfp_StSysTrqShutOff_mp "Zustand Fehlerpfad Start o. Kl.50" UWORD OneToOne 1 100 0.00 65535.00 FORMAT "%8.2" ECU_ADDRESS 0x8FE8B6 /end MEASUREMENT
/begin MEASUREMENT Dfp_SWChk_CycSigChkDat_mp "Messpunkt fuer Fehlerpfad  Dfp_SWChk_CycSigChkDat" UWORD OneToOne 1 100 0.00 65535.00 FORMAT "%8.2" ECU_ADDRESS 0x8FE8B8 /end MEASUREMENT
/begin MEASUREMENT Dfp_SWChk_CycSigChkPrg_mp "Messpunkt fuer Fehlerpfad  Dfp_SWChk_CycSigChkPrg" UWORD OneToOne 1 100 0.00 65535.00 FORMAT "%8.2" ECU_ADDRESS 0x8FE8BA /end MEASUREMENT
/begin MEASUREMENT Dfp_SysLamp_mp "Messpunkt fuer Fehlerpfad  Dfp_SysLamp" UWORD OneToOne 1 100 0.00 65535.00 FORMAT "%8.2" ECU_ADDRESS 0x8FE8BC /end MEASUREMENT
/begin MEASUREMENT Dfp_T15CD_mp "Messpunkt fuer Fehlerpfad  Dfp_T15CD" UWORD OneToOne 1 100 0.00 65535.00 FORMAT "%8.2" ECU_ADDRESS 0x8FE8BE /end MEASUREMENT
/begin MEASUREMENT Dfp_TGearbx_mp "Messpunkt fuer Fehlerpfad  Dfp_TGearbx" UWORD OneToOne 1 100 0.00 65535.00 FORMAT "%8.2" ECU_ADDRESS 0x8FE8C0 /end MEASUREMENT
/begin MEASUREMENT Dfp_TPUMon_mp "Messpunkt fuer Fehlerpfad  Dfp_TPUMon" UWORD OneToOne 1 100 0.00 65535.00 FORMAT "%8.2" ECU_ADDRESS 0x8FE8C2 /end MEASUREMENT
/begin MEASUREMENT Dfp_TVACD_Max_mp "Fehlerpfad für Kurzschluss nach Batteriespannung des Drosselklappenstellers" UWORD OneToOne 1 100 0.00 65535.00 FORMAT "%8.2" ECU_ADDRESS 0x8FE8C4 /end MEASUREMENT
/begin MEASUREMENT Dfp_TVACD_Min_mp "Fehlerpfad für Kurzschluss nach Masse des Drosselklappenstellers" UWORD OneToOne 1 100 0.00 65535.00 FORMAT "%8.2" ECU_ADDRESS 0x8FE8C6 /end MEASUREMENT
/begin MEASUREMENT Dfp_TVACD_SigNpl_mp "Fehlerpfad für Lastabfall und Übertemperatur des Drosselklappenstellers" UWORD OneToOne 1 100 0.00 65535.00 FORMAT "%8.2" ECU_ADDRESS 0x8FE8C8 /end MEASUREMENT
/begin MEASUREMENT Dfp_TVACD_TVADia1_mp "Messpunkt für Fehlerpfad Dfp_TVACD_TVADia1" UWORD OneToOne 1 100 0.00 65535.00 FORMAT "%8.2" ECU_ADDRESS 0x8FE8CA /end MEASUREMENT
/begin MEASUREMENT Dfp_TVACD_TVADia2_mp "Messpunkt für Fehlerpfad Dfp_TVACD_TVADia2" UWORD OneToOne 1 100 0.00 65535.00 FORMAT "%8.2" ECU_ADDRESS 0x8FE8CC /end MEASUREMENT
/begin MEASUREMENT Dfp_TVACD_TVADia3_mp "Messpunkt für Fehlerpfad Dfp_TVACD_TVADia3" UWORD OneToOne 1 100 0.00 65535.00 FORMAT "%8.2" ECU_ADDRESS 0x8FE8CE /end MEASUREMENT
/begin MEASUREMENT Dfp_TVACD_TVADia4_mp "Fehlerpfad für Drosselklappensteller Diagnose viertes Fenster" UWORD OneToOne 1 100 0.00 65535.00 FORMAT "%8.2" ECU_ADDRESS 0x8FE8D0 /end MEASUREMENT
/begin MEASUREMENT Dfp_VSACD_DioInDia1_mp "Messpunkt fuer Fehlerpfad  Dfp_VSACD_DioInDia1" UWORD OneToOne 1 100 0.00 65535.00 FORMAT "%8.2" ECU_ADDRESS 0x8FE8D2 /end MEASUREMENT
/begin MEASUREMENT Dfp_VSACD_DioInDia2_mp "Messpunkt fuer Fehlerpfad  Dfp_VSACD_DioInDia2" UWORD OneToOne 1 100 0.00 65535.00 FORMAT "%8.2" ECU_ADDRESS 0x8FE8D4 /end MEASUREMENT
/begin MEASUREMENT Dfp_VSACD_DioInDia3_mp "Messpunkt fuer Fehlerpfad  Dfp_VSACD_DioInDia3" UWORD OneToOne 1 100 0.00 65535.00 FORMAT "%8.2" ECU_ADDRESS 0x8FE8D6 /end MEASUREMENT
/begin MEASUREMENT Dfp_VSACD_DioInDia4_mp "Messpunkt fuer Fehlerpfad  Dfp_VSACD_DioInDia4" UWORD OneToOne 1 100 0.00 65535.00 FORMAT "%8.2" ECU_ADDRESS 0x8FE8D8 /end MEASUREMENT
/begin MEASUREMENT Dfp_VSACD_DioInMin_mp "Messpunkt fuer Fehlerpfad  Dfp_VSACD_DioInMin" UWORD OneToOne 1 100 0.00 65535.00 FORMAT "%8.2" ECU_ADDRESS 0x8FE8DA /end MEASUREMENT
/begin MEASUREMENT Dfp_VSACD_Max_mp "Fehlerpfad für Kurzschluss nach Batteriespannung des Drallniveaustellers" UWORD OneToOne 1 100 0.00 65535.00 FORMAT "%8.2" ECU_ADDRESS 0x8FE8DC /end MEASUREMENT
/begin MEASUREMENT Dfp_VSACD_Min_mp "Fehlerpfad für Kurzschluss nach Masse des Drallniveaustellers" UWORD OneToOne 1 100 0.00 65535.00 FORMAT "%8.2" ECU_ADDRESS 0x8FE8DE /end MEASUREMENT
/begin MEASUREMENT Dfp_VSACD_SigNpl_mp "Fehlerpfad für Lastabfall und Übertemperatur des Drallniveaustellers" UWORD OneToOne 1 100 0.00 65535.00 FORMAT "%8.2" ECU_ADDRESS 0x8FE8E0 /end MEASUREMENT
/begin MEASUREMENT Dfp_VSACD_VSADia1_mp "Messpunkt fuer Fehlerpfad  Dfp_VSACD_VSADia1" UWORD OneToOne 1 100 0.00 65535.00 FORMAT "%8.2" ECU_ADDRESS 0x8FE8E2 /end MEASUREMENT
/begin MEASUREMENT Dfp_VSACD_VSADia2_mp "Messpunkt fuer Fehlerpfad  Dfp_VSACD_VSADia2" UWORD OneToOne 1 100 0.00 65535.00 FORMAT "%8.2" ECU_ADDRESS 0x8FE8E4 /end MEASUREMENT
/begin MEASUREMENT Dfp_VSACD_VSADia3_mp "Messpunkt fuer Fehlerpfad  Dfp_VSACD_VSADia3" UWORD OneToOne 1 100 0.00 65535.00 FORMAT "%8.2" ECU_ADDRESS 0x8FE8E6 /end MEASUREMENT
/begin MEASUREMENT Dfp_VSACD_VSADia4_mp "Fehlerpfad für Drallklappensteller Diagnose viertes Fenster" UWORD OneToOne 1 100 0.00 65535.00 FORMAT "%8.2" ECU_ADDRESS 0x8FE8E8 /end MEASUREMENT
/begin MEASUREMENT Dfp_VSSCD1_mp "Messpunkt fuer Fehlerpfad  Dfp_VSSCD1" UWORD OneToOne 1 100 0.00 65535.00 FORMAT "%8.2" ECU_ADDRESS 0x8FE8EA /end MEASUREMENT
/begin MEASUREMENT Dfp_VSSCD2_mp "Messpunkt fuer Fehlerpfad  Dfp_VSSCD2" UWORD OneToOne 1 100 0.00 65535.00 FORMAT "%8.2" ECU_ADDRESS 0x8FE8EC /end MEASUREMENT
/begin MEASUREMENT Dfp_WdCom_mp "Messpunkt fuer Fehlerpfad  Dfp_WdCom" UWORD OneToOne 1 100 0.00 65535.00 FORMAT "%8.2" ECU_ADDRESS 0x8FE8EE /end MEASUREMENT
/begin FUNCTION dsm_auto_dfpmp ""
 /begin OUT_MEASUREMENT Dfp_ACCDCmpr_mp Dfp_ACCDPres1_mp Dfp_ACCDPresAna_mp Dfp_ACCDPres_mp Dfp_ACCDSwtin_mp Dfp_AccPedPlausBrk_mp Dfp_ACC_PlausTrqDes_mp Dfp_ACC_trqInr_mp Dfp_ACTrq_mp Dfp_ADCMon_mp Dfp_AFSCDIdlAdjVal_mp Dfp_AFSCDLdAdjVal_mp Dfp_AFSCD_AirTempDcyc_mp Dfp_AFSCD_PlOffsDrft_mp Dfp_AFSCD_PlSetyDrft_mp Dfp_AFSCD_SRCAirTemp_mp Dfp_AFSCD_SRCBatt_mp Dfp_AFSCD_SRCCorrAirm_mp Dfp_AFSCD_SRCRawAirm_mp Dfp_AFSCD_SRCRefSigPer_mp Dfp_AirCtlGvnrDvtRgnMax2_mp Dfp_AirCtlGvnrDvtRgnMax_mp Dfp_AirCtlGvnrDvtRgnMin2_mp Dfp_AirCtlGvnrDvtRgnMin_mp Dfp_AirCtlPlateBreak_mp Dfp_AirCtlRmpTO_mp Dfp_AirCtl_GovNegDev2_mp Dfp_AirCtl_GovNegDev_mp Dfp_AirCtl_GovPosDev2_mp Dfp_AirCtl_GovPosDev_mp Dfp_AltCD_Load_mp Dfp_AltCD_mp Dfp_AOHtCD_AOHtDia1_mp Dfp_AOHtCD_AOHtDia2_mp Dfp_AOHtCD_AOHtDia3_mp Dfp_AOHtCD_mp Dfp_APP1_mp Dfp_APP2_mp Dfp_APPSync_mp Dfp_APSCD_mp Dfp_ARS_mp Dfp_BattCD_mp Dfp_BPACD_BPADia1_mp Dfp_BPACD_BPADia2_mp Dfp_BPACD_BPADia3_mp Dfp_BPACD_Max_mp Dfp_BPACD_Min_mp Dfp_BPACD_SigNpl_mp Dfp_BPSCD_mp Dfp_BrkCD_mp Dfp_Bss_mp Dfp_CBACD_mp Dfp_Clg_DynTst_mp Dfp_CmbChbMisfire1_mp Dfp_CmbChbMisfire2_mp Dfp_CmbChbMisfire3_mp Dfp_CmbChbMisfire4_mp Dfp_CmbChbMisfire5_mp Dfp_CmbChbMisfire6_mp Dfp_CmbChbMisfireMul_mp Dfp_ConvCD_mp Dfp_CoVMDCSh_mp Dfp_CrCCDMFL_mp Dfp_CrCtl_vCrCtl_mp Dfp_CTSCD_mp Dfp_DCC_PlausTrqDes_mp Dfp_Dummy1_mp Dfp_EATSCD_mp Dfp_EBAFCD_mp Dfp_EBFCD_mp Dfp_EBTSCD_mp Dfp_EBTSCD_OvrTemp_mp Dfp_EEPCDVarMng_mp Dfp_EGPpCDTPreTrbn_mp Dfp_EGPpCD_mp Dfp_EGRCD_Max_mp Dfp_EGRCD_Min_mp Dfp_EGRCD_SigNpl_mp Dfp_EGTRgnOilDil_mp Dfp_EMCCDNoLoad1_mp Dfp_EMCCDNoLoad2_mp Dfp_EMCCDSCBat1_mp Dfp_EMCCDSCBat2_mp Dfp_EMCCDSCGnd1_mp Dfp_EMCCDSCGnd2_mp Dfp_EMCCD_ADC1_mp Dfp_EMCCD_ADC2_mp Dfp_EngMCaS1_mp Dfp_EngMCrS1_mp Dfp_EngMOfsCaSCrS_mp Dfp_EngPrtFWODet_mp Dfp_ETClbETFltInj1_mp Dfp_ETClbETFltInj2_mp Dfp_ETClbETFltInj3_mp Dfp_ETClbETFltInj4_mp Dfp_ETClbETFltInj5_mp Dfp_ETClbETFltInj6_mp Dfp_ETClbInj1_mp Dfp_ETClbInj2_mp Dfp_ETClbInj3_mp Dfp_ETClbInj4_mp Dfp_ETClbInj5_mp Dfp_ETClbInj6_mp Dfp_FanCD_FanCtlr1_mp Dfp_FanCD_FanCtlr2_mp Dfp_FanCD_FanCtlr3_mp Dfp_FanCD_mp Dfp_FBCqDvt_mp Dfp_FlFCD_mp Dfp_FlMngSmkDefect_mp Dfp_FMTC_NonMonotonMap_mp Dfp_FrmMngANFRADMOMPT_mp Dfp_FrmMngASC1_mp Dfp_FrmMngASC2_mp Dfp_FrmMngASC3_mp Dfp_FrmMngASC4_mp Dfp_FrmMngBOS_RESET_2_mp Dfp_FrmMngBOS_RESET_mp Dfp_FrmMngDMANFAFS_mp Dfp_FrmMngDRMANFSSG_mp Dfp_FrmMngEGS1_mp Dfp_FrmMngEGS2_mp Dfp_FrmMngGEARBX_DATA2_mp Dfp_FrmMngGEARBX_DATA_mp Dfp_FrmMngHEAT_AC_mp Dfp_FrmMngINSTR2_mp Dfp_FrmMngINSTR3_mp Dfp_FrmMngLENKRADWINKEL_mp Dfp_FrmMngMILEAGE_RANGE_mp Dfp_FrmMngOPCRCTLACC_mp Dfp_FrmMngParkConsumer_mp Dfp_FrmMngPRGG_CCTR_mp Dfp_FrmMngPWRMNG_LOADV_mp Dfp_FrmMngRQSTGEFAN_mp Dfp_FrmMngSSGErr_mp Dfp_FrmMngSSGShOff_mp Dfp_FrmMngSTAT_ANH_mp Dfp_FrmMngSTAT_ARS_mp Dfp_FrmMngSTAT_DSC_mp Dfp_FrmMngSTAT_EKP_mp Dfp_FrmMngSTAT_KOMBI_mp Dfp_FrmMngSTAT_SITZ_mp Dfp_FrmMngstCurr_mp Dfp_FrmMngStOBDGbxMilOf_mp Dfp_FrmMngStOBDGbxMilOn_mp Dfp_FrmMngswtPSPOff_mp Dfp_FrmMngTEMPRELTIME_mp Dfp_FrmMngTERMINAL_mp Dfp_FrmMngTIME_DATE_mp Dfp_FrmMngTORQUE_DSC_mp Dfp_FrmMngTORQUE_GEARBX_mp Dfp_FrmMngTrq_ReqACC_mp Dfp_FrmMngVEH_MOD_mp Dfp_FrmMngVELOCITY_mp Dfp_FrmMngWHEEL_SPEED_mp Dfp_FTSCD_mp Dfp_GearbxIncMax_mp Dfp_GlwCDGlwCirc1_mp Dfp_GlwCDGlwCirc2_mp Dfp_GlwCDGlwCirc3_mp Dfp_GlwCDGlwCirc4_mp Dfp_GlwCDGlwCirc5_mp Dfp_GlwCDGlwCirc6_mp Dfp_GlwCDGlwCirc7_mp Dfp_GlwCDGlwCirc8_mp Dfp_GlwCD_mp Dfp_GlwCtl_mp Dfp_HWEMonCom_mp Dfp_HWEMonEEPROM_mp Dfp_HWEMonRcyLocked_mp Dfp_HWEMonRcySuppressed_mp Dfp_HWEMonRcyVisible_mp Dfp_HWEMonUMaxSupply_mp Dfp_HWEMonUMinSupply_mp Dfp_IATSCD_CATS_mp Dfp_IATSCD_mp Dfp_ImmCtlImmCD_mp Dfp_ImmCtlImmEep_mp Dfp_ImmCtlMpl_mp Dfp_IndSys1_mp Dfp_IndSys2_mp Dfp_InjCrv_InjLim_mp Dfp_InjCtlAdjQnt_mp Dfp_InjCtlDrift_mp Dfp_InjVCDActrChrg_mp Dfp_InjVCDActrEnrg1_mp Dfp_InjVCDActrEnrg2_mp Dfp_InjVCDActrEnrg3_mp Dfp_InjVCDActrEnrg4_mp Dfp_InjVCDActrEnrg5_mp Dfp_InjVCDActrEnrg6_mp Dfp_InjVCDActrEnrg7_mp Dfp_InjVCDActrEnrg8_mp Dfp_InjVCDActrVolt_mp Dfp_InjVCDClsBank1_mp Dfp_InjVCDClsBank2_mp Dfp_InjVCDMonCab_mp Dfp_InjVCDMonSwt_mp Dfp_InjVCDShOffDCDC_mp Dfp_InjVCDUBuf_mp Dfp_InjVCD_CY370Ampl_mp Dfp_InjVlvBnk1A_mp Dfp_InjVlvBnk1B_mp Dfp_InjVlvBnk2A_mp Dfp_InjVlvBnk2B_mp Dfp_InjVlvChipA_mp Dfp_InjVlvChipB_mp Dfp_InjVlvCyl1A_mp Dfp_InjVlvCyl1B_mp Dfp_InjVlvCyl1C_mp Dfp_InjVlvCyl2A_mp Dfp_InjVlvCyl2B_mp Dfp_InjVlvCyl2C_mp Dfp_InjVlvCyl3A_mp Dfp_InjVlvCyl3B_mp Dfp_InjVlvCyl3C_mp Dfp_InjVlvCyl4A_mp Dfp_InjVlvCyl4B_mp Dfp_InjVlvCyl4C_mp Dfp_InjVlvCyl5A_mp Dfp_InjVlvCyl5B_mp Dfp_InjVlvCyl5C_mp Dfp_InjVlvCyl6A_mp Dfp_InjVlvCyl6B_mp Dfp_InjVlvCyl6C_mp Dfp_InjVlvCyl7A_mp Dfp_InjVlvCyl7B_mp Dfp_InjVlvCyl7C_mp Dfp_InjVlvCyl8A_mp Dfp_InjVlvCyl8B_mp Dfp_InjVlvCyl8C_mp Dfp_InjVlvNVC1_mp Dfp_InjVlvNVC2_mp Dfp_InjVlvNVC3_mp Dfp_InjVlvNVC4_mp Dfp_InjVlvNVC5_mp Dfp_InjVlvNVC6_mp Dfp_InjVlvNVC7_mp Dfp_InjVlvNVC8_mp Dfp_Layer_BSD_mp Dfp_Layer_GEN_mp Dfp_Layer_IBS1_mp Dfp_Layer_IBS2_mp Dfp_Layer_IBS3_mp Dfp_Layer_MANHYDR_mp Dfp_Layer_MANLUFT_mp Dfp_Layer_PMBATT_mp Dfp_Layer_PMBN_mp Dfp_Layer_PMRUHVERL_mp Dfp_Layer_QLT_mp Dfp_Layer_TANS_mp Dfp_Layer_TOENS_mp Dfp_Layer_TUMG_mp Dfp_LPACD_Max_mp Dfp_LPACD_Min_mp Dfp_LPACD_SigNpl_mp Dfp_LSUCDCircNernst0_mp Dfp_LSUCDCircPumpCur0_mp Dfp_LSUCDCircVirtGnd0_mp Dfp_LSUCDHeater0_mp Dfp_LSUCDHtCoup0_mp Dfp_LSUCDO20_mp Dfp_LSUCDO2Clb0_mp Dfp_LSUCDRiClb0_mp Dfp_LSUCDSPI0_mp Dfp_LSUCDSPIBattLow0_mp Dfp_LSUCDWireIP0_mp Dfp_LSUCtlRiExc0_mp Dfp_LSUMon1Sens_mp Dfp_LSUMon2Sens_mp Dfp_MeUnCDNoLoad_mp Dfp_MeUnCDSCBat_mp Dfp_MeUnCDSCGnd_mp Dfp_MeUnCD_ADC_mp Dfp_MeUnCD_SigTst_mp Dfp_MIL_mp Dfp_Montr_mp Dfp_MRlyCD_mp Dfp_MSidCD_Comm_mp Dfp_MSidCD_Pin_mp Dfp_MSidCD_Select_mp Dfp_MSidCD_Sel_INI_mp Dfp_NetMngDeviceA_mp Dfp_NetMngDeviceB_mp Dfp_NetMngDeviceC_mp Dfp_OPSCD_anain_mp Dfp_OPSCD_Lamp_mp Dfp_OTSCD_mp Dfp_OvRMonBrk_mp Dfp_OvRMonSigA_mp Dfp_OvRMon_mp Dfp_OxiCCDTPre_mp Dfp_PCR_GovDevNeg_mp Dfp_PCR_GovDevPos_mp Dfp_PCR_LPGvnrDvtNeg_mp Dfp_PCR_LPGvnrDvtPos_mp Dfp_PCVCDNoLoad_mp Dfp_PCVCDSCBat_mp Dfp_PCVCDSCGnd_mp Dfp_PCVCD_ADC_mp Dfp_PCVCD_SigTst_mp Dfp_PFltAPSens_mp Dfp_PFltAPSPlaus_mp Dfp_PFltBPSPlaus_mp Dfp_PFltCDPPre_mp Dfp_PFltCDTempPre_mp Dfp_PFltChar_mp Dfp_PFltEngPrt_mp Dfp_PFltmSotDiffMax_mp Dfp_PFltPresDynPlaus_mp Dfp_PFltPresPlaus_mp Dfp_PFltPresSensFrz_mp Dfp_PFltPresSensHsLn_mp Dfp_PFltPresSensSot_mp Dfp_PFltPresSens_mp Dfp_PFltRgnPerm_mp Dfp_PFltTempDwnStrm_mp Dfp_PFltTempSens_mp Dfp_PFltTempUpStrm_mp Dfp_PresPlausDblDef_mp Dfp_PSPCD_Actr_mp Dfp_QLTCD_mp Dfp_RailCDOfsTst_mp Dfp_RailCD_mp Dfp_RailCD_PMonStrt_mp Dfp_RailCtlModeMeUnDiag_mp Dfp_RailCtlModePCVDiag_mp Dfp_RailMeUn0_mp Dfp_RailMeUn1_mp Dfp_RailMeUn2_mp Dfp_RailMeUn3_mp Dfp_RailMeUn4_mp Dfp_RailPCV0_mp Dfp_RailPCV1_mp Dfp_RailPCV2_mp Dfp_RailPCV3_mp Dfp_RailPCV4_mp Dfp_RailPCV5_mp Dfp_ShutCD_mp Dfp_SOPTst_mp Dfp_SSpMon1_mp Dfp_SSpMon2_mp Dfp_SSpMon3_mp Dfp_StrtCD_Actr_mp Dfp_StSysTrqShutOff_mp Dfp_SWChk_CycSigChkDat_mp Dfp_SWChk_CycSigChkPrg_mp Dfp_SysLamp_mp Dfp_T15CD_mp Dfp_TGearbx_mp Dfp_TPUMon_mp Dfp_TVACD_Max_mp Dfp_TVACD_Min_mp Dfp_TVACD_SigNpl_mp Dfp_TVACD_TVADia1_mp Dfp_TVACD_TVADia2_mp Dfp_TVACD_TVADia3_mp Dfp_TVACD_TVADia4_mp Dfp_VSACD_DioInDia1_mp Dfp_VSACD_DioInDia2_mp Dfp_VSACD_DioInDia3_mp Dfp_VSACD_DioInDia4_mp Dfp_VSACD_DioInMin_mp Dfp_VSACD_Max_mp Dfp_VSACD_Min_mp Dfp_VSACD_SigNpl_mp Dfp_VSACD_VSADia1_mp Dfp_VSACD_VSADia2_mp Dfp_VSACD_VSADia3_mp Dfp_VSACD_VSADia4_mp Dfp_VSSCD1_mp Dfp_VSSCD2_mp Dfp_WdCom_mp /end OUT_MEASUREMENT
/end FUNCTION
/begin FUNCTION dsm_auto_env16 "" /end FUNCTION
/begin FUNCTION dsm_auto_env8 ""
 /begin DEF_CHARACTERISTIC DSM_EnvDfp_Layer_TANS_C DSM_EnvDfp_ACCDCmpr_C DSM_EnvDfp_ACCDPres_C DSM_EnvDfp_ACCDPres1_C DSM_EnvDfp_ACCDPresAna_C DSM_EnvDfp_ACCDSwtin_C DSM_EnvDfp_ACC_PlausTrqDes_C DSM_EnvDfp_ACC_trqInr_C DSM_EnvDfp_ACTrq_C DSM_EnvDfp_ADCMon_C DSM_EnvDfp_AFSCDIdlAdjVal_C DSM_EnvDfp_AFSCDLdAdjVal_C DSM_EnvDfp_AFSCD_AirTempDcyc_C DSM_EnvDfp_AFSCD_PlOffsDrft_C DSM_EnvDfp_AFSCD_PlSetyDrft_C DSM_EnvDfp_AFSCD_SRCAirTemp_C DSM_EnvDfp_AFSCD_SRCBatt_C DSM_EnvDfp_AFSCD_SRCCorrAirm_C DSM_EnvDfp_AFSCD_SRCRawAirm_C DSM_EnvDfp_Layer_TUMG_C DSM_EnvDfp_AFSCD_SRCRefSigPer_C DSM_EnvDfp_AOHtCD_C DSM_EnvDfp_Layer_GEN_C DSM_EnvDfp_Layer_BSD_C DSM_EnvDfp_AOHtCD_AOHtDia1_C DSM_EnvDfp_AOHtCD_AOHtDia2_C DSM_EnvDfp_AOHtCD_AOHtDia3_C DSM_EnvDfp_APP1_C DSM_EnvDfp_APP2_C DSM_EnvDfp_APPSync_C DSM_EnvDfp_APSCD_C DSM_EnvDfp_ARS_C DSM_EnvDfp_AccPedPlausBrk_C DSM_EnvDfp_AirCtlGvnrDvtRgnMax_C DSM_EnvDfp_Layer_QLT_C DSM_EnvDfp_AirCtlGvnrDvtRgnMax2_C DSM_EnvDfp_Layer_IBS1_C DSM_EnvDfp_Layer_IBS2_C DSM_EnvDfp_Layer_IBS3_C DSM_EnvDfp_Layer_PMBN_C DSM_EnvDfp_Layer_PMBATT_C DSM_EnvDfp_AirCtlGvnrDvtRgnMin_C DSM_EnvDfp_AirCtlGvnrDvtRgnMin2_C DSM_EnvDfp_AirCtlPlateBreak_C DSM_EnvDfp_AirCtlRmpTO_C DSM_EnvDfp_AirCtl_GovNegDev_C DSM_EnvDfp_AirCtl_GovNegDev2_C DSM_EnvDfp_AirCtl_GovPosDev_C DSM_EnvDfp_AirCtl_GovPosDev2_C DSM_EnvDfp_AltCD_C DSM_EnvDfp_AltCD_Load_C DSM_EnvDfp_BPACD_BPADia1_C DSM_EnvDfp_BPACD_BPADia2_C DSM_EnvDfp_BPACD_BPADia3_C DSM_EnvDfp_BPACD_Max_C DSM_EnvDfp_BPACD_Min_C DSM_EnvDfp_BPACD_SigNpl_C DSM_EnvDfp_BPSCD_C DSM_EnvDfp_BattCD_C DSM_EnvDfp_BrkCD_C DSM_EnvDfp_Bss_C DSM_EnvDfp_CBACD_C DSM_EnvDfp_CTSCD_C DSM_EnvDfp_Clg_DynTst_C DSM_EnvDfp_CmbChbMisfire1_C DSM_EnvDfp_CmbChbMisfire2_C DSM_EnvDfp_CmbChbMisfire3_C DSM_EnvDfp_CmbChbMisfire4_C DSM_EnvDfp_CmbChbMisfire5_C DSM_EnvDfp_CmbChbMisfire6_C DSM_EnvDfp_CmbChbMisfireMul_C DSM_EnvDfp_CoVMDCSh_C DSM_EnvDfp_ConvCD_C DSM_EnvDfp_Layer_PMRUHVERL_C DSM_EnvDfp_CrCCDMFL_C DSM_EnvDfp_CrCtl_vCrCtl_C DSM_EnvDfp_DCC_PlausTrqDes_C DSM_EnvDfp_Dummy1_C DSM_EnvDfp_Layer_TOENS_C DSM_EnvDfp_Layer_MANHYDR_C DSM_EnvDfp_Layer_MANLUFT_C DSM_EnvDfp_EATSCD_C DSM_EnvDfp_EBAFCD_C DSM_EnvDfp_EBFCD_C DSM_EnvDfp_EBTSCD_C DSM_EnvDfp_EBTSCD_OvrTemp_C DSM_EnvDfp_EEPCDVarMng_C DSM_EnvDfp_EGPpCD_C DSM_EnvDfp_EGPpCDTPreTrbn_C DSM_EnvDfp_EGRCD_Max_C DSM_EnvDfp_EGRCD_Min_C DSM_EnvDfp_EGRCD_SigNpl_C DSM_EnvDfp_EGTRgnOilDil_C DSM_EnvDfp_EMCCDNoLoad1_C DSM_EnvDfp_EMCCDNoLoad2_C DSM_EnvDfp_EMCCDSCBat1_C DSM_EnvDfp_EMCCDSCBat2_C DSM_EnvDfp_EMCCDSCGnd1_C DSM_EnvDfp_EMCCDSCGnd2_C DSM_EnvDfp_EMCCD_ADC1_C DSM_EnvDfp_EMCCD_ADC2_C DSM_EnvDfp_ETClbETFltInj1_C DSM_EnvDfp_ETClbETFltInj2_C DSM_EnvDfp_ETClbETFltInj3_C DSM_EnvDfp_ETClbETFltInj4_C DSM_EnvDfp_ETClbETFltInj5_C DSM_EnvDfp_ETClbETFltInj6_C DSM_EnvDfp_ETClbInj1_C DSM_EnvDfp_ETClbInj2_C DSM_EnvDfp_ETClbInj3_C DSM_EnvDfp_ETClbInj4_C DSM_EnvDfp_ETClbInj5_C DSM_EnvDfp_ETClbInj6_C DSM_EnvDfp_EngMCaS1_C DSM_EnvDfp_EngMCrS1_C DSM_EnvDfp_EngMOfsCaSCrS_C DSM_EnvDfp_EngPrtFWODet_C DSM_EnvDfp_FBCqDvt_C DSM_EnvDfp_FMTC_NonMonotonMap_C DSM_EnvDfp_FTSCD_C DSM_EnvDfp_FanCD_C DSM_EnvDfp_FanCD_FanCtlr1_C DSM_EnvDfp_FanCD_FanCtlr2_C DSM_EnvDfp_FanCD_FanCtlr3_C DSM_EnvDfp_FlFCD_C DSM_EnvDfp_FlMngSmkDefect_C DSM_EnvDfp_FrmMngANFRADMOMPT_C DSM_EnvDfp_FrmMngASC1_C DSM_EnvDfp_FrmMngASC2_C DSM_EnvDfp_FrmMngASC3_C DSM_EnvDfp_FrmMngASC4_C DSM_EnvDfp_FrmMngBOS_RESET_C DSM_EnvDfp_FrmMngBOS_RESET_2_C DSM_EnvDfp_FrmMngDMANFAFS_C DSM_EnvDfp_FrmMngDRMANFSSG_C DSM_EnvDfp_FrmMngEGS1_C DSM_EnvDfp_FrmMngEGS2_C DSM_EnvDfp_FrmMngGEARBX_DATA_C DSM_EnvDfp_FrmMngGEARBX_DATA2_C DSM_EnvDfp_FrmMngHEAT_AC_C DSM_EnvDfp_FrmMngINSTR2_C DSM_EnvDfp_FrmMngINSTR3_C DSM_EnvDfp_FrmMngLENKRADWINKEL_C DSM_EnvDfp_FrmMngMILEAGE_RANGE_C DSM_EnvDfp_FrmMngOPCRCTLACC_C DSM_EnvDfp_FrmMngPRGG_CCTR_C DSM_EnvDfp_FrmMngPWRMNG_LOADV_C DSM_EnvDfp_FrmMngParkConsumer_C DSM_EnvDfp_FrmMngRQSTGEFAN_C DSM_EnvDfp_FrmMngSSGErr_C DSM_EnvDfp_FrmMngSSGShOff_C DSM_EnvDfp_FrmMngSTAT_ANH_C DSM_EnvDfp_FrmMngSTAT_ARS_C DSM_EnvDfp_FrmMngSTAT_DSC_C DSM_EnvDfp_FrmMngSTAT_EKP_C DSM_EnvDfp_FrmMngSTAT_KOMBI_C DSM_EnvDfp_FrmMngSTAT_SITZ_C DSM_EnvDfp_FrmMngStOBDGbxMilOf_C DSM_EnvDfp_FrmMngStOBDGbxMilOn_C DSM_EnvDfp_FrmMngTEMPRELTIME_C DSM_EnvDfp_FrmMngTERMINAL_C DSM_EnvDfp_FrmMngTIME_DATE_C DSM_EnvDfp_FrmMngTORQUE_DSC_C DSM_EnvDfp_FrmMngTORQUE_GEARBX_C DSM_EnvDfp_FrmMngTrq_ReqACC_C DSM_EnvDfp_FrmMngVEH_MOD_C DSM_EnvDfp_FrmMngVELOCITY_C DSM_EnvDfp_FrmMngWHEEL_SPEED_C DSM_EnvDfp_FrmMngstCurr_C DSM_EnvDfp_FrmMngswtPSPOff_C DSM_EnvDfp_GearbxIncMax_C DSM_EnvDfp_GlwCD_C DSM_EnvDfp_GlwCDGlwCirc1_C DSM_EnvDfp_GlwCDGlwCirc2_C DSM_EnvDfp_GlwCDGlwCirc3_C DSM_EnvDfp_GlwCDGlwCirc4_C DSM_EnvDfp_GlwCDGlwCirc5_C DSM_EnvDfp_GlwCDGlwCirc6_C DSM_EnvDfp_GlwCDGlwCirc7_C DSM_EnvDfp_GlwCDGlwCirc8_C DSM_EnvDfp_GlwCtl_C DSM_EnvDfp_HWEMonCom_C DSM_EnvDfp_HWEMonEEPROM_C DSM_EnvDfp_HWEMonRcyLocked_C DSM_EnvDfp_HWEMonRcySuppressed_C DSM_EnvDfp_HWEMonRcyVisible_C DSM_EnvDfp_HWEMonUMaxSupply_C DSM_EnvDfp_HWEMonUMinSupply_C DSM_EnvDfp_IATSCD_C DSM_EnvDfp_IATSCD_CATS_C DSM_EnvDfp_ImmCtlImmCD_C DSM_EnvDfp_ImmCtlImmEep_C DSM_EnvDfp_ImmCtlMpl_C DSM_EnvDfp_IndSys1_C DSM_EnvDfp_IndSys2_C DSM_EnvDfp_InjCrv_InjLim_C DSM_EnvDfp_InjCtlAdjQnt_C DSM_EnvDfp_InjCtlDrift_C DSM_EnvDfp_InjVCDActrChrg_C DSM_EnvDfp_InjVCDActrEnrg1_C DSM_EnvDfp_InjVCDActrEnrg2_C DSM_EnvDfp_InjVCDActrEnrg3_C DSM_EnvDfp_InjVCDActrEnrg4_C DSM_EnvDfp_InjVCDActrEnrg5_C DSM_EnvDfp_InjVCDActrEnrg6_C DSM_EnvDfp_InjVCDActrEnrg7_C DSM_EnvDfp_InjVCDActrEnrg8_C DSM_EnvDfp_InjVCDActrVolt_C DSM_EnvDfp_InjVCDClsBank1_C DSM_EnvDfp_InjVCDClsBank2_C DSM_EnvDfp_InjVCDMonCab_C DSM_EnvDfp_InjVCDMonSwt_C DSM_EnvDfp_InjVCDShOffDCDC_C DSM_EnvDfp_InjVCDUBuf_C DSM_EnvDfp_InjVCD_CY370Ampl_C DSM_EnvDfp_InjVlvBnk1A_C DSM_EnvDfp_InjVlvBnk1B_C DSM_EnvDfp_InjVlvBnk2A_C DSM_EnvDfp_InjVlvBnk2B_C DSM_EnvDfp_InjVlvChipA_C DSM_EnvDfp_InjVlvChipB_C DSM_EnvDfp_InjVlvCyl1A_C DSM_EnvDfp_InjVlvCyl1B_C DSM_EnvDfp_InjVlvCyl1C_C DSM_EnvDfp_InjVlvCyl2A_C DSM_EnvDfp_InjVlvCyl2B_C DSM_EnvDfp_InjVlvCyl2C_C DSM_EnvDfp_InjVlvCyl3A_C DSM_EnvDfp_InjVlvCyl3B_C DSM_EnvDfp_InjVlvCyl3C_C DSM_EnvDfp_InjVlvCyl4A_C DSM_EnvDfp_InjVlvCyl4B_C DSM_EnvDfp_InjVlvCyl4C_C DSM_EnvDfp_InjVlvCyl5A_C DSM_EnvDfp_InjVlvCyl5B_C DSM_EnvDfp_InjVlvCyl5C_C DSM_EnvDfp_InjVlvCyl6A_C DSM_EnvDfp_InjVlvCyl6B_C DSM_EnvDfp_InjVlvCyl6C_C DSM_EnvDfp_InjVlvCyl7A_C DSM_EnvDfp_InjVlvCyl7B_C DSM_EnvDfp_InjVlvCyl7C_C DSM_EnvDfp_InjVlvCyl8A_C DSM_EnvDfp_InjVlvCyl8B_C DSM_EnvDfp_InjVlvCyl8C_C DSM_EnvDfp_InjVlvNVC1_C DSM_EnvDfp_InjVlvNVC2_C DSM_EnvDfp_InjVlvNVC3_C DSM_EnvDfp_InjVlvNVC4_C DSM_EnvDfp_InjVlvNVC5_C DSM_EnvDfp_InjVlvNVC6_C DSM_EnvDfp_InjVlvNVC7_C DSM_EnvDfp_InjVlvNVC8_C DSM_EnvDfp_LPACD_Max_C DSM_EnvDfp_LPACD_Min_C DSM_EnvDfp_LPACD_SigNpl_C DSM_EnvDfp_LSUCDCircNernst0_C DSM_EnvDfp_LSUCDCircPumpCur0_C DSM_EnvDfp_LSUCDCircVirtGnd0_C DSM_EnvDfp_LSUCDHeater0_C DSM_EnvDfp_LSUCDHtCoup0_C DSM_EnvDfp_LSUCDO20_C DSM_EnvDfp_LSUCDO2Clb0_C DSM_EnvDfp_LSUCDRiClb0_C DSM_EnvDfp_LSUCDSPI0_C DSM_EnvDfp_LSUCDSPIBattLow0_C DSM_EnvDfp_LSUCDWireIP0_C DSM_EnvDfp_LSUCtlRiExc0_C DSM_EnvDfp_LSUMon1Sens_C DSM_EnvDfp_LSUMon2Sens_C DSM_EnvDfp_MIL_C DSM_EnvDfp_MRlyCD_C DSM_EnvDfp_MSidCD_Comm_C DSM_EnvDfp_MSidCD_Pin_C DSM_EnvDfp_MSidCD_Sel_INI_C DSM_EnvDfp_MSidCD_Select_C DSM_EnvDfp_MeUnCDNoLoad_C DSM_EnvDfp_MeUnCDSCBat_C DSM_EnvDfp_MeUnCDSCGnd_C DSM_EnvDfp_MeUnCD_ADC_C DSM_EnvDfp_MeUnCD_SigTst_C DSM_EnvDfp_Montr_C DSM_EnvDfp_NetMngDeviceA_C DSM_EnvDfp_NetMngDeviceB_C DSM_EnvDfp_NetMngDeviceC_C DSM_EnvDfp_OPSCD_Lamp_C DSM_EnvDfp_OPSCD_anain_C DSM_EnvDfp_OTSCD_C DSM_EnvDfp_OvRMon_C DSM_EnvDfp_OvRMonBrk_C DSM_EnvDfp_OvRMonSigA_C DSM_EnvDfp_OxiCCDTPre_C DSM_EnvDfp_PCR_GovDevNeg_C DSM_EnvDfp_PCR_GovDevPos_C DSM_EnvDfp_PCR_LPGvnrDvtNeg_C DSM_EnvDfp_PCR_LPGvnrDvtPos_C DSM_EnvDfp_PCVCDNoLoad_C DSM_EnvDfp_PCVCDSCBat_C DSM_EnvDfp_PCVCDSCGnd_C DSM_EnvDfp_PCVCD_ADC_C DSM_EnvDfp_PCVCD_SigTst_C DSM_EnvDfp_PFltAPSPlaus_C DSM_EnvDfp_PFltAPSens_C DSM_EnvDfp_PFltBPSPlaus_C DSM_EnvDfp_PFltCDPPre_C DSM_EnvDfp_PFltCDTempPre_C DSM_EnvDfp_PFltChar_C DSM_EnvDfp_PFltEngPrt_C DSM_EnvDfp_PFltPresDynPlaus_C DSM_EnvDfp_PFltPresPlaus_C DSM_EnvDfp_PFltPresSens_C DSM_EnvDfp_PFltPresSensFrz_C DSM_EnvDfp_PFltPresSensHsLn_C DSM_EnvDfp_PFltPresSensSot_C DSM_EnvDfp_PFltRgnPerm_C DSM_EnvDfp_PFltTempDwnStrm_C DSM_EnvDfp_PFltTempSens_C DSM_EnvDfp_PFltTempUpStrm_C DSM_EnvDfp_PFltmSotDiffMax_C DSM_EnvDfp_PSPCD_Actr_C DSM_EnvDfp_PresPlausDblDef_C DSM_EnvDfp_QLTCD_C DSM_EnvDfp_RailCD_C DSM_EnvDfp_RailCDOfsTst_C DSM_EnvDfp_RailCD_PMonStrt_C DSM_EnvDfp_RailCtlModeMeUnDiag_C DSM_EnvDfp_RailCtlModePCVDiag_C DSM_EnvDfp_RailMeUn0_C DSM_EnvDfp_RailMeUn1_C DSM_EnvDfp_RailMeUn2_C DSM_EnvDfp_RailMeUn3_C DSM_EnvDfp_RailMeUn4_C DSM_EnvDfp_RailPCV0_C DSM_EnvDfp_RailPCV1_C DSM_EnvDfp_RailPCV2_C DSM_EnvDfp_RailPCV3_C DSM_EnvDfp_RailPCV4_C DSM_EnvDfp_RailPCV5_C DSM_EnvDfp_SOPTst_C DSM_EnvDfp_SSpMon1_C DSM_EnvDfp_SSpMon2_C DSM_EnvDfp_SSpMon3_C DSM_EnvDfp_SWChk_CycSigChkDat_C DSM_EnvDfp_SWChk_CycSigChkPrg_C DSM_EnvDfp_ShutCD_C DSM_EnvDfp_StSysTrqShutOff_C DSM_EnvDfp_StrtCD_Actr_C DSM_EnvDfp_SysLamp_C DSM_EnvDfp_T15CD_C DSM_EnvDfp_TGearbx_C DSM_EnvDfp_TPUMon_C DSM_EnvDfp_TVACD_Max_C DSM_EnvDfp_TVACD_Min_C DSM_EnvDfp_TVACD_SigNpl_C DSM_EnvDfp_TVACD_TVADia1_C DSM_EnvDfp_TVACD_TVADia2_C DSM_EnvDfp_TVACD_TVADia3_C DSM_EnvDfp_TVACD_TVADia4_C DSM_EnvDfp_VSACD_DioInDia1_C DSM_EnvDfp_VSACD_DioInDia2_C DSM_EnvDfp_VSACD_DioInDia3_C DSM_EnvDfp_VSACD_DioInDia4_C DSM_EnvDfp_VSACD_DioInMin_C DSM_EnvDfp_VSACD_Max_C DSM_EnvDfp_VSACD_Min_C DSM_EnvDfp_VSACD_SigNpl_C DSM_EnvDfp_VSACD_VSADia1_C DSM_EnvDfp_VSACD_VSADia2_C DSM_EnvDfp_VSACD_VSADia3_C DSM_EnvDfp_VSACD_VSADia4_C DSM_EnvDfp_VSSCD1_C DSM_EnvDfp_VSSCD2_C DSM_EnvDfp_WdCom_C /end DEF_CHARACTERISTIC
/end FUNCTION
/begin FUNCTION dsm_auto_fid_scd "" /end FUNCTION
/begin FUNCTION dsm_auto_fid_scd_msg "" /end FUNCTION
/begin COMPU_METHOD FactHigh "Faktor mit Auflösung 1/4096, hauptsächlich für einen Faktorenbereich 0.1...10 verwendet" RAT_FUNC "%6.5" "-" COEFFS 0 8192 0 0 0 1 /end COMPU_METHOD
/begin COMPU_METHOD OneToOne "eins zu eins (physikalischer Wert ist gleich dem internen Wert)" RAT_FUNC "%6.2" "-" COEFFS 0 1 0 0 0 1 /end COMPU_METHOD
/begin COMPU_METHOD SigName "Verbale Umrechnung für Signal Referenz Nummern" TAB_VERB "%6.3" "-" COMPU_TAB_REF SigName /end COMPU_METHOD
/begin COMPU_VTAB SigName "Verbale Umrechnung für Signal Referenz Nummern" TAB_VERB 117 0 "Sig_unused" 4 "CoEng_rTrq__Carb_r_DLen1" 5 "CTSCD_tClntLin__Carb_t_DLen1" 11 "BPSCD_pLin__Carb_p_DLen1" 12 "Eng_nAvrg__Carb_n_DLen2" 13 "VSSCD_vSensVal__Carb_v_DLen1" 15 "AFSCD_tAir_mp__Carb_t_DLen1" 16 "AFSCD_dmAirRawPerTime__Carb_mAirTim_DLen2" 28 "Signals_PID0x1C_C__OneToOne_DLen1" 33 "DSMDur_ctDfctDur1__Carb_l_DLen2" 128 "AFSCD_dmAirPerTime__mAirTim_DLen2" 129 "AFSCD_mAirPerCyl__mAirCyl_DLen2" 131 "AFSCD_rAir__dcyc_DLen2" 133 "AOHtCD_rOut_mp__dcyc_DLen2" 134 "APPCD_rFlt__r_DLen2" 137 "APPCD_uRawAPP1__u_DLen2" 138 "APPCD_uRawAPP2__u_DLen2" 139 "APSCD_pVal__p_DLen2" 140 "APSCD_uRaw__u_DLen2" 141 "AirCtl_mDesVal__mAirCyl_DLen2" 142 "AltCD_rAltLoad__r_DLen2" 143 "BPACD_rOut__dcyc_DLen2" 145 "BPSCD_pOutVal__p_DLen2" 146 "BPSCD_uRawVal__u_DLen2" 147 "BattCD_u__uBatt_DLen2" 148 "CBACD_stLogicOut_mp__OneToOne_DLen1" 149 "CTSCD_tClnt__t_DLen2" 150 "CTSCD_uRaw__u_DLen2" 151 "CoEng_trq__trq_DLen2" 152 "EBAFCD_stSigOut__OneToOne_DLen1" 153 "EGRCD_rOut__dcyc_DLen2" 155 "EGT_st__ShftRght0Byte_DLen2" 156 "EngM_stOut__OneToOne_DLen1" 157 "EngM_stSync__OneToOne_DLen1" 158 "Eng_nAvrg__n_DLen2" 159 "FMTC_trqInr__trq_DLen2" 160 "FTSCD_tFuel__t_DLen2" 161 "FTSCD_uRaw__u_DLen2" 162 "FanCD_dcycRaw_mp__dcyc_DLen2" 163 "FlFCD_stFlFltRawVal__OneToOne_DLen1" 164 "FrmMng_nPSP__nPSPSpd_DLen2" 165 "FrmMng_rPSPSetPoint__r_DLen2" 166 "GlwCtl_rPwrOut__OneToOne_DLen1" 167 "GlwCtl_stLampOut__OneToOne_DLen1" 168 "HWEMon_numRecovery__ShftRght0Byte_DLen2" 169 "HWEMon_numRecovery__ShftRght1Byte_DLen2" 170 "HWEMon_recLocLow_mp__ShftRght0Byte_DLen2" 171 "HWEMon_recLocLow_mp__ShftRght1Byte_DLen2" 172 "HWEMon_recLocHigh_mp__ShftRght0Byte_DLen2" 173 "IATSCD_tAir__t_DLen2" 174 "IATSCD_tAirCats__t_DLen2" 176 "IATSCD_uRawCats__u_DLen2" 178 "Tn_abstell__DezUwQ1_DLen2" 179 "U_gen__UUwQ0p1_DLen2" 181 "InjCtl_qCurr__qInjMassCyc_DLen2" 182 "InjCtl_qSetUnBal__qInjMassCyc_DLen2" 183 "LIGov_nSetpoint__n_DLen2" 184 "LIGov_trq__trq_DLen2" 185 "LPACD_rOut__dcyc_DLen2" 186 "LSUCD_rO2Raw[0]__O2_DLen2" 187 "LSUCD_uO2Raw[0]__u_DLen2" 188 "LSU_rLmbd[0]__Lambda_DLen2" 189 "LSU_rO2Adpt[0]__O2_DLen2" 190 "MeUnCD_dcycOut_mp__dcyc_DLen2" 191 "OPSCD_stSigOut__OneToOne_DLen1" 192 "OPSCD_stpOEL__OneToOne_DLen1" 193 "OTSCD_tEngOil__t_DLen2" 194 "OxiCCD_tPre__tExhaustgas_DLen2" 196 "OxiCCD_uRawTempPre__u_DLen2" 198 "PCR_pDesVal__p_DLen2" 199 "PCVCD_dcycOut_mp__dcyc_DLen2" 200 "PFltCD_pPre__p_DLen2" 202 "PFltCD_tPre__tExhaustgas_DLen2" 204 "PFltCD_uRawPresPre_mp__u_DLen2" 206 "PFltCD_uRawTempPre__u_DLen2" 208 "PFlt_dvol__volph_DLen2" 209 "PFlt_lSnceRgnu16_mp__lenrgnu16PFlt_DLen2" 211 "PFlt_mAshOil__mSoot_DLen2" 212 "PFlt_mSot__mSoot_DLen2" 213 "PFlt_mSotSim__mSoot_DLen2" 214 "PFlt_numEngPOp__OneToOne_DLen1" 215 "PFlt_numRgn_mp__OneToOne_DLen1" 216 "PFlt_pDiff__p_DLen2" 217 "PFlt_qFl_mp__FlConPFlt_DLen2" 219 "PFlt_stEngPOp__OneToOne_DLen1" 220 "PFlt_stIntr_mp__OneToOne_DLen1" 221 "PFlt_stLck_mp__OneToOne_DLen1" 222 "PSPCD_dvolOut__FlCon_DLen2" 223 "RailCD_pPeak__pRail_DLen2" 224 "RailCD_uPeakRaw__u_DLen2" 225 "Rail_pSetPoint__pRail_DLen2" 226 "TVACD_rOut__dcyc_DLen2" 228 "VSACD_rOut__dcyc_DLen2" 229 "VSSCD_v__v_DLen2" 230 "VehDa_tiEngOn__timEng_DLen2" 231 "PFlt_pPreCorr_mp__p_DLen2" 232 "PFlt_stPresPlaus_mp__OneToOne_DLen1" 236 "OvRMon_tiTDCAvrg__InjTim_DLen2" 237 "OvRMon_tiOvRMonActive_mp__tims_DLen2" 238 "CoEng_trqInrSet__trq_DLen2" 239 "InjCtl_qSet__qInjMassCyc_DLen2" 240 "Absch_korr__FSwQ0p00153_DLen2" 241 "D_soc__FSwB100_DLen2" 242 "I_batt__IUwQ0p08O200_DLen2" 243 "Oz_oelkm__KmUwQ10_DLen2" 244 "Oz_oelnivkurz__TdUbQ0p5_DLen1" 245 "Oz_oelnivnorm__TdUbQ0p5_DLen1" 246 "Oz_oelnivori__TdUbQ0p5_DLen1" 247 "Pm_klemmstat__DezUbQ1_DLen1" 248 "Stat_sv_reg1__DezUbQ1_DLen1" 249 "Stat_sv_reg2__DezUbQ1_DLen1" 250 "T2histshort__TdUbQ14p9333_DLen1" 251 "T3histshort__TdUbQ14p9333_DLen1" 252 "T4histshort__TdUbQ14p9333_DLen1" 253 "Toel__TSwQ0p1_DLen2" 254 "T_batt__TSwQ0p1_DLen2" 255 "U_batt__UUwQ0p25em3_DLen2" /end COMPU_VTAB
/begin RECORD_LAYOUT Kwb_Wu8 FNC_VALUES 1 UBYTE COLUMN_DIR DIRECT /end RECORD_LAYOUT
/end MODULE
/end PROJECT
