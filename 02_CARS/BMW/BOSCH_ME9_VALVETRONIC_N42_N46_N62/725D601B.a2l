ASAP2_VERSION 1 3
/begin PROJECT _725D601B "725D601B"
/begin HEADER "" VERSION "_725D601B" PROJECT_NO _725D601B /end HEADER
/begin MODULE DIM ""
/begin MOD_COMMON "" BYTE_ORDER MSB_FIRST ALIGNMENT_BYTE 1 ALIGNMENT_WORD 2 ALIGNMENT_LONG 2 ALIGNMENT_FLOAT32_IEEE 4 /end MOD_COMMON
/begin CHARACTERISTIC ADCY "Anzahl DCY zum Initialisieren der Dauerlaufz‰hler" VALUE 0xFC1D18 KwWU8 255.0 dez 0.00 255.0 FORMAT "%5.1" /end CHARACTERISTIC
/begin CHARACTERISTIC AHEAGW "Aussetzerh‰ufigkeit zum Erreichen der gesetzlichen Abgaslimits" VALUE 0xFC1D0A KwWU16 65535.00 dez 0.00 65535.00 FORMAT "%8.2" /end CHARACTERISTIC
/begin CHARACTERISTIC AHEAGWS "Aussetzerh‰ufigkeit zum Erreichen der gesetzlichen Abgaslimits" VALUE 0xFC1D0C KwWU16 65535.00 dez 0.00 65535.00 FORMAT "%8.2" /end CHARACTERISTIC
/begin CHARACTERISTIC AHEARV "Aussetzerh‰ufigkeit zum Erreichen der Ausblendung weiterer Funktionen" VALUE 0xFC1D0E KwWU16 65535.00 dez 0.00 65535.00 FORMAT "%8.2" /end CHARACTERISTIC
/begin CHARACTERISTIC AHEKABB "Aussetzerh‰ufigkeit pro Bank zum Erreichen einer Kraftstoffabschaltung" VAL_BLK 0xFC1CFE KwbWU16 65535.00 dez 0.00 65535.00 FORMAT "%8.2" NUMBER 4 /end CHARACTERISTIC
/begin CHARACTERISTIC AHEKS1B1 "Aussetzerh‰ufigkeit zum Erreichen einer Katsch‰digung im 1. Intervall Bank 1" VALUE 0xFC1D10 KwWU16 65535.00 dez 0.00 65535.00 FORMAT "%8.2" /end CHARACTERISTIC
/begin CHARACTERISTIC AHEKS1B2 "Aussetzerh‰ufigkeit zum Erreichen einer Katsch‰digung im 1. Intervall Bank 2" VALUE 0xFC1D12 KwWU16 65535.00 dez 0.00 65535.00 FORMAT "%8.2" /end CHARACTERISTIC
/begin CHARACTERISTIC AHEKSB1 "Aussetzerh‰ufigkeit zum Erreichen einer Katalysatorsch‰digung Bank 1" VALUE 0xFC1D14 KwWU16 65535.00 dez 0.00 65535.00 FORMAT "%8.2" /end CHARACTERISTIC
/begin CHARACTERISTIC AHEKSB2 "Aussetzerh‰ufigkeit zum Erreichen einer Katalysatorsch‰digung Bank 2" VALUE 0xFC1D16 KwWU16 65535.00 dez 0.00 65535.00 FORMAT "%8.2" /end CHARACTERISTIC
/begin CHARACTERISTIC AINTKAN "Anzahl Intervalle mit Katsch‰digung f¸r Ti-Abschaltung" CURVE 0xFC1CC4 GklWU8 255.0 dez 0.00 255.0 FORMAT "%5.1"
 /begin AXIS_DESCR COM_AXIS nmot nmot_ub_q40 8 0.00 10200. FORMAT "%5.0" AXIS_PTS_REF SNM08DMUB /end AXIS_DESCR
/end CHARACTERISTIC
/begin CHARACTERISTIC ALFO "Anfangswert f¸r Lernfilter bei fuel-on/fuel-off Adaption" VALUE 0xFC1738 KwWR32 20000.000000000000 fak_r32_1 -10000.000000000000 10000.000000000000 FORMAT "%27.21" /end CHARACTERISTIC
/begin CHARACTERISTIC ALFOF "Anfangswert f¸r Lernfilter bei fuel-off Adaption" VALUE 0xFC1660 KwWR32 20000.000000000000 fak_r32_1 -10000.000000000000 10000.000000000000 FORMAT "%27.21" /end CHARACTERISTIC
/begin CHARACTERISTIC ANALUN "Anzahl Verbrennungen f¸r Ausblendungen nach erkanntem Auss., drehzahlabh‰ngig" CURVE 0xFC176C GklWU8 255.0 dez 0.00 255.0 FORMAT "%5.1"
 /begin AXIS_DESCR COM_AXIS nmot nmot_ub_q40 8 0.00 10200. FORMAT "%5.0" AXIS_PTS_REF SNM08DMUB /end AXIS_DESCR
/end CHARACTERISTIC
/begin CHARACTERISTIC ANALUST "Anzahl Verbrennungen f¸r Ausblendungen nach erkanntem Auss., nach Start" VALUE 0xFC1774 KwWU8 255.0 dez 0.00 255.0 FORMAT "%5.1" /end CHARACTERISTIC
/begin CHARACTERISTIC ANWFOHE "Anzahl NW-Umdr. f¸r Heilung" VALUE 0xFC1734 KwWU16 65535.00 dez 0.00 65535.00 FORMAT "%8.2" /end CHARACTERISTIC
/begin CHARACTERISTIC ANWFOST "Anzahl NW-Umdr. f¸r Reaktivierung fuel-on/-off Adaption nach Ausblendung" VALUE 0xFC1658 KwWU16 32767.00 dez 0.00 32767.00 FORMAT "%8.2" /end CHARACTERISTIC
/begin CHARACTERISTIC ANWSTP "Anzahl NW-Umdr., die fuel-off Adaption lernt (nachdem eingeschwungen)" VALUE 0xFC165A KwWU16 32767.00 dez 0.00 32767.00 FORMAT "%8.2" /end CHARACTERISTIC
/begin CHARACTERISTIC AVRALU "Anzahl NW-Umdr./Verbrenng. f. Reaktivierung Aussetzererkennung nach Ausblendung" VALUE 0xFC1D52 KwWU8 255.0 DEZ 0.00 255.0 FORMAT "%5.1" /end CHARACTERISTIC
/begin CHARACTERISTIC AVRALUSSG "Anzahl NW-Umdr./Verbrenng. f. Reaktivierung Aussetzererkennung nach Ausblendung-" VALUE 0xFC1D53 KwWU8 255.0 DEZ 0.00 255.0 FORMAT "%5.1" /end CHARACTERISTIC
/begin CHARACTERISTIC AZSTLU "Verl‰ngerung der Ausblendanforderung bei Motorstart in Anzahl Z¸ndungen" VALUE 0xFC1D54 KwWU8 255.0 DEZ 0.00 255.0 FORMAT "%5.1" /end CHARACTERISTIC
/begin CHARACTERISTIC AZSTPON "Umschaltung von Ausblendanforderung nach Motorstart in Anzahl Z¸ndungen" VALUE 0xFC1D55 KwWU8 255.0 DEZ 0.00 255.0 FORMAT "%5.1" /end CHARACTERISTIC
/begin CHARACTERISTIC AZYTIABB "Max. Anzahl von Zylindern mit Ti-Abschaltung aufgrund von Aussetzern, pro Bank" VAL_BLK 0xFC1D06 KwbWU8 255.0 dez 0.00 255.0 FORMAT "%5.1" NUMBER 4 /end CHARACTERISTIC
/begin CHARACTERISTIC CDFO "Codewort zum Ausschalten und R¸cksetzen der Adaption" VALUE 0xFC165C KwWU8 255.0 dez 0.00 255.0 FORMAT "%5.1" /end CHARACTERISTIC
/begin CHARACTERISTIC CDFOMOD "Codewort zum Festlegen des Modus der Fuel-on/-off Adaption" VALUE 0xFC165D KwWU8 255.0 dez 0.00 255.0 FORMAT "%5.1" /end CHARACTERISTIC
/begin CHARACTERISTIC CWDALA "Codewort DMDMIL Dauerlaufz‰hler" VALUE 0xFC1D19 KwWU8 255.0 dez 0.00 255.0 FORMAT "%5.1" /end CHARACTERISTIC
/begin CHARACTERISTIC CWDMDE "Codewort f¸r EOBD-Appl. DMDMIL" VALUE 0xFC1D1A KwWU8 255.0 dez 0.00 255.0 FORMAT "%5.1" /end CHARACTERISTIC
/begin CHARACTERISTIC CWDMDZAG "Codewort DMDZAG Konfiguration" VALUE 0xFC1D59 KwWU8 255.0 DEZ 0.00 255.0 FORMAT "%5.1" /end CHARACTERISTIC
/begin CHARACTERISTIC CWDSLSA "Codewort in der Diagnose Sekund‰rluftsystem" VALUE 0xFD541E KwUb 255.0 dez 0.00 255.0 FORMAT "%5.1" /end CHARACTERISTIC
/begin CHARACTERISTIC CWDSLSAD "Codewort in der Diagnose der Sekund‰rluftsteuerung f¸r aktiv Diagnose" VALUE 0xFD541F KwUb 255.0 dez 0.00 255.0 FORMAT "%5.1" /end CHARACTERISTIC
/begin CHARACTERISTIC CWDSLSY "Codewort in der Diagnose Sekund‰rluftsystem" VALUE 0xFD5420 KwUb 255.0 dez 0.00 255.0 FORMAT "%5.1" /end CHARACTERISTIC
/begin CHARACTERISTIC CWKATVAR "Codewort f¸r KAT-Umschaltung" VALUE 0xFCF93D KwUb 255.0 dez 0.00 255.0 FORMAT "%5.1" /end CHARACTERISTIC
/begin CHARACTERISTIC CWMILCOD "Codewort MIL-Codierung aktiv" VALUE 0xFCF93E KwUb 255.0 dez 0.00 255.0 FORMAT "%5.1" /end CHARACTERISTIC
/begin CHARACTERISTIC CWNOMIL "Codewort MIL-Ansteuerung nicht aktiv" VALUE 0xFCF93F KwUb 255.0 dez 0.00 255.0 FORMAT "%5.1" /end CHARACTERISTIC
/begin CHARACTERISTIC CWPLLSU "Codewort Plausibilit‰tsdiagnose LSU" VALUE 0xFD03BA KwUb 255.0 dez 0.00 255.0 FORMAT "%5.1" /end CHARACTERISTIC
/begin CHARACTERISTIC CWPSMLE "Codewort f¸r L¸fterendstufe" VALUE 0xFD0574 KwWU8 255.0 dez 0.00 255.0 FORMAT "%5.1" /end CHARACTERISTIC
/begin CHARACTERISTIC CWPSNWSAE "Kodewort zum Abschalten der Endstufediagnose NWS Auslass" VALUE 0xFD058C KwWU8 255.0 dez 0.00 255.0 FORMAT "%5.1" /end CHARACTERISTIC
/begin CHARACTERISTIC CWPSNWSEE "Kodewort zum Abschalten der Endstufediagnose NWS Einlass" VALUE 0xFD0586 KwWU8 255.0 dez 0.00 255.0 FORMAT "%5.1" /end CHARACTERISTIC
/begin CHARACTERISTIC CWPSSLPE "Kodewort zum Abschalten der Endstufediagnose" VALUE 0xFD0578 KwWU8 255.0 dez 0.00 255.0 FORMAT "%5.1" /end CHARACTERISTIC
/begin CHARACTERISTIC CWPSSUE "Codewort f¸r Endstufendiagnose Saugrohrumschaltung" VALUE 0xFC2234 KwWU8 255.0 dez 0.00 255.0 FORMAT "%5.1" /end CHARACTERISTIC
/begin CHARACTERISTIC CWSTDMD "Codewort zur Auswahl Startfreigabe: 1 -> B_st, 0 -> nmot" VALUE 0xFC1D56 KwWU8 255.0 DEZ 0.00 255.0 FORMAT "%5.1" /end CHARACTERISTIC
/begin CHARACTERISTIC CWSTPCNF "Codewort Ausblendkriterien 1 -> Kriterium aktiv" VALUE 0xFC1D57 KwWU8 255.0 DEZ 0.00 255.0 FORMAT "%5.1" /end CHARACTERISTIC
/begin CHARACTERISTIC CW_DR_ERR1 "" VALUE 0xFD6AE8 KwWU16 65535.00 dez 0.00 65535.00 FORMAT "%8.2" /end CHARACTERISTIC
/begin CHARACTERISTIC CW_DR_ERR2 "" VALUE 0xFD6AEA KwWU16 65535.00 dez 0.00 65535.00 FORMAT "%8.2" /end CHARACTERISTIC
/begin CHARACTERISTIC CW_DR_ERR_ID "" VALUE 0xFD6AEC KwWU8 255.0 dez 0.00 255.0 FORMAT "%5.1" /end CHARACTERISTIC
/begin CHARACTERISTIC CW_MAXKERR "Fehlerparameter f¸r L¸ftervariante 1" VALUE 0xFD0575 KwWU8 255.0 dez 0.00 255.0 FORMAT "%5.1" /end CHARACTERISTIC
/begin CHARACTERISTIC CW_MINKERR "Fehlerparameter f¸r L¸ftervariante 2" VALUE 0xFD0576 KwWU8 255.0 dez 0.00 255.0 FORMAT "%5.1" /end CHARACTERISTIC
/begin CHARACTERISTIC CW_MINSEND "Mindestsendeversuche VE E-L¸fter" VALUE 0xFD0577 KwWU8 255.0 dez 0.00 255.0 FORMAT "%5.1" /end CHARACTERISTIC
/begin CHARACTERISTIC DFRMOFNX "frm-Offset-Schwelle (negativ): Kontrolle Vorsteuerproblem" VALUE 0xFD5456 KwSw 1.999969 fak_sw_b1 -1.000000 0.9999695 FORMAT "%8.6" /end CHARACTERISTIC
/begin CHARACTERISTIC DFRMOFNXKT "frm-Offset-Schwelle (negativ): Kontrolle Vorsteuerproblem (Kurztest)" VALUE 0xFD5458 KwSw 1.999969 fak_sw_b1 -1.000000 0.9999695 FORMAT "%8.6" /end CHARACTERISTIC
/begin CHARACTERISTIC DFRMOFPX "frm-Offset-Schwelle (positiv): Kontrolle Vorsteuerproblem" VALUE 0xFD545A KwSw 1.999969 fak_sw_b1 -1.000000 0.9999695 FORMAT "%8.6" /end CHARACTERISTIC
/begin CHARACTERISTIC DFRMOFPXKT "frm-Offset-Schwelle (positiv): Kontrolle Vorsteuerproblem (Kurztest)" VALUE 0xFD545C KwSw 1.999969 fak_sw_b1 -1.000000 0.9999695 FORMAT "%8.6" /end CHARACTERISTIC
/begin CHARACTERISTIC DFSEFON1 "drehzahlabh. max. plausible Abweichungen der FSE-Werte" VAL_BLK 0xFC16E8 KwbWR32 20000.000000000000 fak_r32_1 -10000.000000000000 10000.000000000000 FORMAT "%27.21" NUMBER 8 /end CHARACTERISTIC
/begin CHARACTERISTIC DFSERES "Differenz der Adaptionswerte zum Auslˆsen eines Reset der fuel-on/-off adaption" VALUE 0xFC173C KwWR32 20000.000000000000 fak_r32_1 -10000.000000000000 10000.000000000000 FORMAT "%27.21" /end CHARACTERISTIC
/begin CHARACTERISTIC DLAHPPLMN "minimale DLAHP-Schwelle zum Setzen des Plausfehlers ""B""" VALUE 0xFD03C2 KwSw 1.999969 fak_sw_b1 -1.000000 0.9999695 FORMAT "%8.6" /end CHARACTERISTIC
/begin CHARACTERISTIC DLAHPPLMN2 "minimale DLAHP-Schwelle zum Setzen des Plausfehlers ""B""  (Bank2)" VALUE 0xFD03C4 KwSw 1.999969 fak_sw_b1 -1.000000 0.9999695 FORMAT "%8.6" /end CHARACTERISTIC
/begin CHARACTERISTIC DMDSEGL "Segmentl‰nge f¸r Aussetzererkennung" VALUE 0xFC7FE8 KwWU16 393210.0 kw_tooth_sy 0.00 393210.0 FORMAT "%8.1" /end CHARACTERISTIC
/begin CHARACTERISTIC DMSDRLTM "Delta-rl-Schwelle in Abh‰ngigkeit von tmot f¸r Sperre Bedingung B_dslmes" CURVE 0xFD545E KlAUbSstUbWUw 1535.977 rel_uw_q0p0234 0.00 1535.977 FORMAT "%8.3"
 /begin AXIS_DESCR STD_AXIS tmot temp_ub_q0p75_o48 4 -48.00 143.3 FORMAT "%5.1" DEPOSIT ABSOLUTE /end AXIS_DESCR
/end CHARACTERISTIC
/begin CHARACTERISTIC DMXRFL "Begrenzung bei max. Filter-Laufunruhe-Referenzwert-ƒnderung" VALUE 0xFC1CC0 KwWR32 20000.000000000000 fak_r32_1 -10000.000000000000 10000.000000000000 FORMAT "%27.21" /end CHARACTERISTIC
/begin CHARACTERISTIC DMXRLU "Begrenzung bei max. Laufunruhe-Referenzwert-ƒnderung" VALUE 0xFC1B34 KwWR32 2.000000000000E+037 fak_r32_1 -1.000000000000E+037 1.000000000000E+037 FORMAT "%27.0" /end CHARACTERISTIC
/begin CHARACTERISTIC DNVRBUP "Delta NVRAM Backup Z‰hler Aktualit‰ts-‹berwachung" VALUE 0xFCC9D6 KwWU8 255.0 dez 0.00 255.0 FORMAT "%5.1" /end CHARACTERISTIC
/begin CHARACTERISTIC DRLSOLA "Misfire Detection : Schwelle Lastdynamik f¸r Ausblendung" CURVE 0xFC1D20 GklWS16 1535.977 relNWU_q0p0234 -768.0000 767.9766 FORMAT "%8.4"
 /begin AXIS_DESCR COM_AXIS midmd rel_ub_b99p6 8 0.00 99.61 FORMAT "%5.2" AXIS_PTS_REF SMI08DMUB /end AXIS_DESCR
/end CHARACTERISTIC
/begin CHARACTERISTIC DRLSOLST "Misfire Detection : Schwelle Lastdynamik f¸r Ausblendung nach Start" VALUE 0xFC1D48 KwWS16 1535.977 relNWU_q0p0234 -768.0000 767.9766 FORMAT "%8.4" /end CHARACTERISTIC
/begin CHARACTERISTIC DSLVFZMN "vfzg-Schwelle:  Aktivieren Phase 4 durch B_ll-Bedingung" VALUE 0xFD5421 KwUb 318.8 vfzg_ub_q1p25 0.00 318.8 FORMAT "%5.1" /end CHARACTERISTIC
/begin CHARACTERISTIC DTMDSLA "Temperaturdifferenz zwischen Abstellen und Neustart f¸r Zusatzdiagnose" VALUE 0xFD5422 KwUb 191.3 temp_ub_b191p25 0.00 191.3 FORMAT "%5.1" /end CHARACTERISTIC
/begin CHARACTERISTIC ERRCOLDO "Schwelle f¸r den Fehlerz‰hler der Diagnose des ÷ldruckschalters" VALUE 0xFD0536 KwUb 255.0 dez 0.00 255.0 FORMAT "%5.1" /end CHARACTERISTIC
/begin CHARACTERISTIC FABSALU "Abregelfaktor Beschleunigungssignal bei Schlechtwegstrecken-Erkennung" VALUE 0xFC2166 KwUb 553.4 accgrd_ub_b555p55 0.00 553.4 FORMAT "%5.1" /end CHARACTERISTIC
/begin CHARACTERISTIC FAINTEN "Anzahl Intervalle zur Freigabe Ti - Abschaltung" VALUE 0xFC1D1B KwWU8 255.0 dez 0.00 255.0 FORMAT "%5.1" /end CHARACTERISTIC
/begin CHARACTERISTIC FASKIV1 "Faktor f¸r Verl‰ngerung 1. KAT-Intervall, Aussetzererkennung" VALUE 0xFC1D1C KwWU8 255.0 dez 0.00 255.0 FORMAT "%5.1" /end CHARACTERISTIC
/begin CHARACTERISTIC FHODSL "minimaler Hˆhenfaktor f¸r DSLS" VALUE 0xFD546C KwUw 3.999939 fak_uw_b4 0.00 3.999939 FORMAT "%8.6" /end CHARACTERISTIC
/begin CHARACTERISTIC FIAMALU "Anhebungsfaktor f¸r Filter Mehrfachaussetzererkennung" VALUE 0xFC1B38 KwWR32 2.000000000000E+037 fak_r32_1 -1.000000000000E+037 1.000000000000E+037 FORMAT "%27.0" /end CHARACTERISTIC
/begin CHARACTERISTIC FIBSALU "Filterfaktor Beschleunigungssignal bei Schlechtwegstrecken-Erkennung" VALUE 0xFC2167 KwUb 0.9961 fak_ub_b1 0.00 0.9961 /end CHARACTERISTIC
/begin CHARACTERISTIC FIMALU "Filterfaktor Mehrfachaussetzererkennung" VALUE 0xFC1B3C KwWR32 2.000000000000E+037 fak_r32_1 -1.000000000000E+037 1.000000000000E+037 FORMAT "%27.0" /end CHARACTERISTIC
/begin CHARACTERISTIC FLFO "Filterfaktor Lernfilter der fuel-on/-off Adaption" VALUE 0xFC1740 KwWR32 20000.000000000000 fak_r32_1 -10000.000000000000 10000.000000000000 FORMAT "%27.21" /end CHARACTERISTIC
/begin CHARACTERISTIC FLFOF "Filterfaktor Lernfilter der fuel-off Adaption" VALUE 0xFC1664 KwWR32 20000.000000000000 fak_r32_1 -10000.000000000000 10000.000000000000 FORMAT "%27.21" /end CHARACTERISTIC
/begin CHARACTERISTIC FLUTN "Filterfaktor Laufunruhe-Filter" CURVE 0xFCF948 KlAxU8SstxR32WR32 20000.000000000000 fak_r32_1 -10000.000000000000 10000.000000000000 FORMAT "%27.21"
 /begin AXIS_DESCR STD_AXIS nmot_f fak_r32_1 4 -10000.000000000000 10000.000000000000 FORMAT "%27.21" DEPOSIT ABSOLUTE /end AXIS_DESCR
/end CHARACTERISTIC
/begin CHARACTERISTIC FLUV1 "Schalter der Modifikation 1 der Laufunruhe-Berechnung" VALUE 0xFC177A KwWU8 255.0 dez 0.00 255.0 FORMAT "%5.1" /end CHARACTERISTIC
/begin CHARACTERISTIC FMSLAMN "minimaler Adaptionsfaktor Sekund‰rluftmasse" VALUE 0xFD5423 KwUb 1.992 fak_ub_b2 0.00 1.992 FORMAT "%5.3" /end CHARACTERISTIC
/begin CHARACTERISTIC FMSLAMX "maximaler Adaptionsfaktor Sekund‰rluftmasse" VALUE 0xFD5424 KwUb 1.992 fak_ub_b2 0.00 1.992 FORMAT "%5.3" /end CHARACTERISTIC
/begin CHARACTERISTIC FOFAKT "Codewort zum Anhalten der Fuel-off Adaption" VALUE 0xFC165E KwWU8 255.0 dez 0.00 255.0 FORMAT "%5.1" /end CHARACTERISTIC
/begin CHARACTERISTIC FS1FO "Filterfaktor Segmentzeit-Filter 1 der fuel-on/-off Adaption" VALUE 0xFC1744 KwWR32 20000.000000000000 fak_r32_1 -10000.000000000000 10000.000000000000 FORMAT "%27.21" /end CHARACTERISTIC
/begin CHARACTERISTIC FS1FOF "Filterfaktor Segmentzeit-Filter 1 der fuel-off Adaption" VALUE 0xFC1668 KwWR32 20000.000000000000 fak_r32_1 -10000.000000000000 10000.000000000000 FORMAT "%27.21" /end CHARACTERISTIC
/begin CHARACTERISTIC FS2FO "Filterfaktor Segmentzeit-Filter 2 der fuel-on/-off Adaption" VALUE 0xFC1748 KwWR32 20000.000000000000 fak_r32_1 -10000.000000000000 10000.000000000000 FORMAT "%27.21" /end CHARACTERISTIC
/begin CHARACTERISTIC FS2FOF "Filterfaktor Segmentzeit-Filter 2 der fuel-off Adaption" VALUE 0xFC166C KwWR32 20000.000000000000 fak_r32_1 -10000.000000000000 10000.000000000000 FORMAT "%27.21" /end CHARACTERISTIC
/begin CHARACTERISTIC FSWALUV "Erkennungsschwelle Schlechtwegstrecke abh‰ngig von Fz.geschwindigkeit" CURVE 0xFC2168 KlAUbSstUbWUb 55.34 acc_ub_b55p55 0.00 55.34 FORMAT "%5.2"
 /begin AXIS_DESCR STD_AXIS vfzg vfzg_ub_q1p25 4 0.00 318.8 FORMAT "%5.1" DEPOSIT ABSOLUTE /end AXIS_DESCR
/end CHARACTERISTIC
/begin CHARACTERISTIC IMLATDSL "min. Luftmassenfluﬂ f¸r Adaption/Zusatzdiagnose" VALUE 0xFD546E KwUw 23.30133 m_uw_b23p3 0.00 23.30133 FORMAT "%8.5" /end CHARACTERISTIC
/begin CHARACTERISTIC IMLATDSLK "min. Luftmassenfluﬂ f¸r Kurztest" VALUE 0xFD5470 KwUw 23.30133 m_uw_b23p3 0.00 23.30133 FORMAT "%8.5" /end CHARACTERISTIC
/begin CHARACTERISTIC IMLDSL "minimale durchgestrˆmte Luftmasse" VALUE 0xFD5425 KwUb 0.9961 fak_ub_b1 0.00 0.9961 /end CHARACTERISTIC
/begin CHARACTERISTIC IMLHEMN "Minimale integierte Luftmasse zum Heilen eines Fehlers" VALUE 0xFD03C6 KwUw 1.820417 m_q2p777Em5_kg 0.00 1.820417 FORMAT "%8.6" /end CHARACTERISTIC
/begin CHARACTERISTIC IMLHEMN2 "Minimale integierte Luftmasse zum Heilen eines Fehlers  (Bank2)" VALUE 0xFD03C8 KwUw 1.820417 m_q2p777Em5_kg 0.00 1.820417 FORMAT "%8.6" /end CHARACTERISTIC
/begin CHARACTERISTIC IMLHEMNFA "Minimale integierte Luftmasse zum Heilen eines Fehlers, bei Bandendepr¸fung" VALUE 0xFD03CA KwUw 1.820417 m_q2p777Em5_kg 0.00 1.820417 FORMAT "%8.6" /end CHARACTERISTIC
/begin CHARACTERISTIC IMLHEMNFA2 "Minimale integierte Luftmasse zum Heilen eines Fehlers, bei Bandendepr¸fung (B2)" VALUE 0xFD03CC KwUw 1.820417 m_q2p777Em5_kg 0.00 1.820417 FORMAT "%8.6" /end CHARACTERISTIC
/begin CHARACTERISTIC IMLPLCMN "minimale integrierte Luftmasse f¸r den Plausibilit‰tscheck" VALUE 0xFD03CE KwUw 1.820417 m_q2p777Em5_kg 0.00 1.820417 FORMAT "%8.6" /end CHARACTERISTIC
/begin CHARACTERISTIC IMLPLCMN2 "minimale integrierte Luftmasse f¸r den Plausibilit‰tscheck  (Bank2)" VALUE 0xFD03D0 KwUw 1.820417 m_q2p777Em5_kg 0.00 1.820417 FORMAT "%8.6" /end CHARACTERISTIC
/begin CHARACTERISTIC IMLPLCMNB "minimale integrierte Luftmasse f¸r den erweiterten Plausibilit‰tscheck" VALUE 0xFD03D2 KwUw 1.820417 m_q2p777Em5_kg 0.00 1.820417 FORMAT "%8.6" /end CHARACTERISTIC
/begin CHARACTERISTIC IMLPLCMNB2 "minimale integrierte Luftmasse f¸r den erweiterten Plausibilit‰tscheck" VALUE 0xFD03D4 KwUw 1.820417 m_q2p777Em5_kg 0.00 1.820417 FORMAT "%8.6" /end CHARACTERISTIC
/begin CHARACTERISTIC KAMFZ "Segment- bzw. Messfensterbeginn bei Segmentzeiterfassung Aussetzererkennung" VALUE 0xFC7FEA KwWU16 393210.0 kw_tooth_sy 0.00 393210.0 FORMAT "%8.1" /end CHARACTERISTIC
/begin CHARACTERISTIC KFAMAL "Kennfeld Absenkungsfaktor f¸r Lur-Wert bei erkannten Mehrfachaussetzern" MAP 0xFC19FC GkfWU8 0.9961 fak_ub_b1 0.00 0.9961
 /begin AXIS_DESCR COM_AXIS midmd rel_ub_b99p6 8 0.00 99.61 FORMAT "%5.2" AXIS_PTS_REF SMI08DMUB /end AXIS_DESCR
 /begin AXIS_DESCR COM_AXIS nmot nmot_ub_q40 8 0.00 10200. FORMAT "%5.0" AXIS_PTS_REF SNM08DMUB /end AXIS_DESCR
/end CHARACTERISTIC
/begin CHARACTERISTIC KFAMAL1 "Kennfeld Absenkungsfaktor f¸r Lur-Wert bei erkannten Mehrfachaussetzern" MAP 0xFC1A3C GkfWU8 0.9961 fak_ub_b1 0.00 0.9961
 /begin AXIS_DESCR COM_AXIS midmd rel_ub_b99p6 8 0.00 99.61 FORMAT "%5.2" AXIS_PTS_REF SMI08DMUB /end AXIS_DESCR
 /begin AXIS_DESCR COM_AXIS nmot nmot_ub_q40 8 0.00 10200. FORMAT "%5.0" AXIS_PTS_REF SNM08DMUB /end AXIS_DESCR
/end CHARACTERISTIC
/begin CHARACTERISTIC KFAMAL2 "Kennfeld Absenkungsfaktor f¸r Lur-Wert bei erkannten Mehrfachaussetzern" MAP 0xFC1A7C GkfWU8 0.9961 fak_ub_b1 0.00 0.9961
 /begin AXIS_DESCR COM_AXIS midmd rel_ub_b99p6 8 0.00 99.61 FORMAT "%5.2" AXIS_PTS_REF SMI08DMUB /end AXIS_DESCR
 /begin AXIS_DESCR COM_AXIS nmot nmot_ub_q40 8 0.00 10200. FORMAT "%5.0" AXIS_PTS_REF SNM08DMUB /end AXIS_DESCR
/end CHARACTERISTIC
/begin CHARACTERISTIC KFCFO1 "Kennfeld zur Definition der Bereichseigenschaften (dominant..)" MAP 0xFC167C GkfWU8 255.0 dez 0.00 255.0 FORMAT "%5.1"
 /begin AXIS_DESCR COM_AXIS nmot_w nmot_uw_q0p25 10 0.00 16383.75 FORMAT "%8.2" AXIS_PTS_REF SNM10DMUW1 /end AXIS_DESCR
 /begin AXIS_DESCR COM_AXIS midmd rel_ub_b99p6 5 0.00 191.4 FORMAT "%5.1" AXIS_PTS_REF SMI05DMUB1 /end AXIS_DESCR
/end CHARACTERISTIC
/begin CHARACTERISTIC KFKSWFS "Kennfeld f¸r Kat.-Schutz-Wichtungsfaktoren mit Momentenreferenz" MAP 0xFC1CCC KfAxU8AyU8SstxU8SstyU8WU8 255.0 dez 0.00 255.0 FORMAT "%5.1"
 /begin AXIS_DESCR STD_AXIS midmd rel_ub_b99p6 6 0.00 99.61 FORMAT "%5.2" DEPOSIT ABSOLUTE /end AXIS_DESCR
 /begin AXIS_DESCR STD_AXIS nmot nmot_ub_q40 6 0.00 10200. FORMAT "%5.0" DEPOSIT ABSOLUTE /end AXIS_DESCR
/end CHARACTERISTIC
/begin CHARACTERISTIC KFLUAR "Kennfeld f¸r Laufunruhe-Abstandsmass-Referenzwert" MAP 0xFC1B40 GkfWU16 181.8962 luquant_w 0.00 181.8962 FORMAT "%8.4"
 /begin AXIS_DESCR COM_AXIS midmd rel_ub_b99p6 8 0.00 99.61 FORMAT "%5.2" AXIS_PTS_REF SMI08DMUB /end AXIS_DESCR
 /begin AXIS_DESCR COM_AXIS nmot nmot_ub_q40 8 0.00 10200. FORMAT "%5.0" AXIS_PTS_REF SNM08DMUB /end AXIS_DESCR
/end CHARACTERISTIC
/begin CHARACTERISTIC KFLUAR1 "Kennfeld f¸r Laufunruhe-Abstandsmass-Referenzwert" MAP 0xFC1BC0 GkfWU16 181.8962 luquant_w 0.00 181.8962 FORMAT "%8.4"
 /begin AXIS_DESCR COM_AXIS midmd rel_ub_b99p6 8 0.00 99.61 FORMAT "%5.2" AXIS_PTS_REF SMI08DMUB /end AXIS_DESCR
 /begin AXIS_DESCR COM_AXIS nmot nmot_ub_q40 8 0.00 10200. FORMAT "%5.0" AXIS_PTS_REF SNM08DMUB /end AXIS_DESCR
/end CHARACTERISTIC
/begin CHARACTERISTIC KFLUAR2 "Kennfeld f¸r Laufunruhe-Abstandsmass-Referenzwert" MAP 0xFC1C40 GkfWU16 181.8962 luquant_w 0.00 181.8962 FORMAT "%8.4"
 /begin AXIS_DESCR COM_AXIS midmd rel_ub_b99p6 8 0.00 99.61 FORMAT "%5.2" AXIS_PTS_REF SMI08DMUB /end AXIS_DESCR
 /begin AXIS_DESCR COM_AXIS nmot nmot_ub_q40 8 0.00 10200. FORMAT "%5.0" AXIS_PTS_REF SNM08DMUB /end AXIS_DESCR
/end CHARACTERISTIC
/begin CHARACTERISTIC KFLURB "Kennfeld f¸r Laufunruhe-Referenz-Basiswert" MAP 0xFC177C GkfWU16 181.8962 luquant_w 0.00 181.8962 FORMAT "%8.4"
 /begin AXIS_DESCR COM_AXIS midmd rel_ub_b99p6 8 0.00 99.61 FORMAT "%5.2" AXIS_PTS_REF SMI08DMUB /end AXIS_DESCR
 /begin AXIS_DESCR COM_AXIS nmot nmot_ub_q40 8 0.00 10200. FORMAT "%5.0" AXIS_PTS_REF SNM08DMUB /end AXIS_DESCR
/end CHARACTERISTIC
/begin CHARACTERISTIC KFLURB1 "Kennfeld f¸r Laufunruhe-Referenz-Basiswert" MAP 0xFC17FC GkfWU16 181.8962 luquant_w 0.00 181.8962 FORMAT "%8.4"
 /begin AXIS_DESCR COM_AXIS midmd rel_ub_b99p6 8 0.00 99.61 FORMAT "%5.2" AXIS_PTS_REF SMI08DMUB /end AXIS_DESCR
 /begin AXIS_DESCR COM_AXIS nmot nmot_ub_q40 8 0.00 10200. FORMAT "%5.0" AXIS_PTS_REF SNM08DMUB /end AXIS_DESCR
/end CHARACTERISTIC
/begin CHARACTERISTIC KFLURB2 "Kennfeld f¸r Laufunruhe-Referenz-Basiswert" MAP 0xFC187C GkfWU16 181.8962 luquant_w 0.00 181.8962 FORMAT "%8.4"
 /begin AXIS_DESCR COM_AXIS midmd rel_ub_b99p6 8 0.00 99.61 FORMAT "%5.2" AXIS_PTS_REF SMI08DMUB /end AXIS_DESCR
 /begin AXIS_DESCR COM_AXIS nmot nmot_ub_q40 8 0.00 10200. FORMAT "%5.0" AXIS_PTS_REF SNM08DMUB /end AXIS_DESCR
/end CHARACTERISTIC
/begin CHARACTERISTIC KFLURM "Kennfeld f¸r Laufunruhe-Referenzwert zur Mehrfachaussetzererkennung ->Lum-Vergl." MAP 0xFC18FC GkfWU16 181.8962 luquant_w 0.00 181.8962 FORMAT "%8.4"
 /begin AXIS_DESCR COM_AXIS midmd rel_ub_b99p6 8 0.00 99.61 FORMAT "%5.2" AXIS_PTS_REF SMI08DMUB /end AXIS_DESCR
 /begin AXIS_DESCR COM_AXIS nmot nmot_ub_q40 8 0.00 10200. FORMAT "%5.0" AXIS_PTS_REF SNM08DMUB /end AXIS_DESCR
/end CHARACTERISTIC
/begin CHARACTERISTIC KFLURM1 "Kennfeld f¸r Laufunruhe-Referenzwert zur Mehrfachaussetzererkennung ->Lum-Vergl." MAP 0xFC197C GkfWU16 181.8962 luquant_w 0.00 181.8962 FORMAT "%8.4"
 /begin AXIS_DESCR COM_AXIS midmd rel_ub_b99p6 8 0.00 99.61 FORMAT "%5.2" AXIS_PTS_REF SMI08DMUB /end AXIS_DESCR
 /begin AXIS_DESCR COM_AXIS nmot nmot_ub_q40 8 0.00 10200. FORMAT "%5.0" AXIS_PTS_REF SNM08DMUB /end AXIS_DESCR
/end CHARACTERISTIC
/begin CHARACTERISTIC KFMODI "Kennfeld f¸r Aussetzermodi und deren Parameter" MAP 0xFCF97C KfAxU8AyU8SstxU16SstyU16WU16 65535.00 DEZ 0.00 65535.00 FORMAT "%8.2"
 /begin AXIS_DESCR STD_AXIS xkfmodi DEZ 6 0.00 65535. FORMAT "%5.0" DEPOSIT ABSOLUTE /end AXIS_DESCR
 /begin AXIS_DESCR STD_AXIS ykfmodi DEZ 8 0.00 65535. FORMAT "%5.0" DEPOSIT ABSOLUTE /end AXIS_DESCR
/end CHARACTERISTIC
/begin CHARACTERISTIC KLIDXFOMI1 "Kennlinie zur Definition des Bereichsindex" CURVE 0xFC16CE GklWU8 255.0 dez 0.00 255.0 FORMAT "%5.1"
 /begin AXIS_DESCR COM_AXIS midmd rel_ub_b99p6 5 0.00 191.4 FORMAT "%5.1" AXIS_PTS_REF SMI05DMUB1 /end AXIS_DESCR
/end CHARACTERISTIC
/begin CHARACTERISTIC KLIDXFOMII1 "" CURVE 0xFC16D3 GklWU8 255.0 dez 0.00 255.0 FORMAT "%5.1"
 /begin AXIS_DESCR COM_AXIS midmd rel_ub_b99p6 3 0.00 191.4 FORMAT "%5.1" AXIS_PTS_REF SMI03DMUB1 /end AXIS_DESCR
/end CHARACTERISTIC
/begin CHARACTERISTIC KLIDXFONN1 "Kennlinie zur Definition des Bereichsindex" CURVE 0xFC16D6 GklWU8 255.0 dez 0.00 255.0 FORMAT "%5.1"
 /begin AXIS_DESCR COM_AXIS nmot_w nmot_uw_q0p25 10 0.00 16383.75 FORMAT "%8.2" AXIS_PTS_REF SNM10DMUW1 /end AXIS_DESCR
/end CHARACTERISTIC
/begin CHARACTERISTIC KLIDXFONNI1 "" CURVE 0xFC16E0 GklWU8 255.0 dez 0.00 255.0 FORMAT "%5.1"
 /begin AXIS_DESCR COM_AXIS nmot_w nmot_uw_q0p25 8 0.00 16383.75 FORMAT "%8.2" AXIS_PTS_REF SNM08DMUW1 /end AXIS_DESCR
/end CHARACTERISTIC
/begin CHARACTERISTIC KLTALUST "Zeitdauer Ausblendung der Aussetzererkennung nach Motorstart" CURVE 0xFCF96C KlAxU8SstxU8WU16 655.3500 t10msxs_uw_b655p35 0.00 655.3500 FORMAT "%8.4"
 /begin AXIS_DESCR STD_AXIS tmst temp_ub_q0p75_o48 4 -48.00 143.3 FORMAT "%5.1" DEPOSIT ABSOLUTE /end AXIS_DESCR
/end CHARACTERISTIC
/begin CHARACTERISTIC LAMMN "Untere Plausibilit‰tsschwelle f¸r Lambda" VALUE 0xFD03D6 KwUw 15.99976 fak_uw_b16 0.00 15.99976 FORMAT "%8.5" /end CHARACTERISTIC
/begin CHARACTERISTIC LAMMX "Obere Plausibilit‰tsschwelle f¸r Lambda" VALUE 0xFD03D8 KwUw 15.99976 fak_uw_b16 0.00 15.99976 FORMAT "%8.5" /end CHARACTERISTIC
/begin CHARACTERISTIC LASPLCFT "Fettschwelle f¸r den Sollwert von Lambda f¸r den Plausibilit‰tscheck" VALUE 0xFD03DA KwUw 15.99976 fak_uw_b16 0.00 15.99976 FORMAT "%8.5" /end CHARACTERISTIC
/begin CHARACTERISTIC LASPLCMR "Magerschwelle f¸r den Sollwert von Lambda f¸r den Plausibilit‰tscheck" VALUE 0xFD03DC KwUw 15.99976 fak_uw_b16 0.00 15.99976 FORMAT "%8.5" /end CHARACTERISTIC
/begin CHARACTERISTIC LSUNAMN "untere Schwelle f¸r LSU nicht aktiv" VALUE 0xFD03DE KwUw 15.99976 fak_uw_b16 0.00 15.99976 FORMAT "%8.5" /end CHARACTERISTIC
/begin CHARACTERISTIC LSUNAMX "obere Schwelle f¸r LSU nicht aktiv" VALUE 0xFD03E0 KwUw 15.99976 fak_uw_b16 0.00 15.99976 FORMAT "%8.5" /end CHARACTERISTIC
/begin CHARACTERISTIC LURBMI "Laufunruhe-Referenzwert bei Fahrzeug steht" CURVE 0xFC1AEC KlAxU8SstxU16WU16 181.8962 luquant_w 0.00 181.8962 FORMAT "%8.4"
 /begin AXIS_DESCR STD_AXIS midmd_w rel_uw_b100 4 0.00 99.99847 FORMAT "%8.5" DEPOSIT ABSOLUTE /end AXIS_DESCR
/end CHARACTERISTIC
/begin CHARACTERISTIC LURFOST "Laufruhe-Referenzwert f¸r stop fuel-on/-off Adaption, Vergleich mit lunw" VALUE 0xFC1670 KwWR32 20000.000000000000 fak_r32_1 -10000.000000000000 10000.000000000000 FORMAT "%27.21" /end CHARACTERISTIC
/begin CHARACTERISTIC LURKTM "Tmot-abh‰ngiger Laufunruhe-Referenz-Korrekturwert" CURVE 0xFC1B18 KlAxU8SstxU8WU16 181.8962 luquant_w 0.00 181.8962 FORMAT "%8.4"
 /begin AXIS_DESCR STD_AXIS tmot temp_ub_q0p75_o48 8 -48.00 143.3 FORMAT "%5.1" DEPOSIT ABSOLUTE /end AXIS_DESCR
/end CHARACTERISTIC
/begin CHARACTERISTIC LURMIN1 "Drehzahlabh. Laufunruhe-Referenz-Minimalwert 1" CURVE 0xFC1ABC GklWU16 181.8962 luquant_w 0.00 181.8962 FORMAT "%8.4"
 /begin AXIS_DESCR COM_AXIS nmot nmot_ub_q40 8 0.00 10200. FORMAT "%5.0" AXIS_PTS_REF SNM08DMUB /end AXIS_DESCR
/end CHARACTERISTIC
/begin CHARACTERISTIC LURMIN2 "Drehzahlabh. Laufunruhe-Referenz-Minimalwert 2" CURVE 0xFC1ACC GklWU16 181.8962 luquant_w 0.00 181.8962 FORMAT "%8.4"
 /begin AXIS_DESCR COM_AXIS nmot nmot_ub_q40 8 0.00 10200. FORMAT "%5.0" AXIS_PTS_REF SNM08DMUB /end AXIS_DESCR
/end CHARACTERISTIC
/begin CHARACTERISTIC LURMIN3 "Drehzahlabh. Laufunruhe-Referenz-Minimalwert 3" CURVE 0xFC1ADC GklWU16 181.8962 luquant_w 0.00 181.8962 FORMAT "%8.4"
 /begin AXIS_DESCR COM_AXIS nmot nmot_ub_q40 8 0.00 10200. FORMAT "%5.0" AXIS_PTS_REF SNM08DMUB /end AXIS_DESCR
/end CHARACTERISTIC
/begin CHARACTERISTIC LURST "Laufunruhe-Referenzwertkorrektur nach Start" CURVE 0xFC1AFE KlAxU8SstxU16WU16 181.8962 luquant_w 0.00 181.8962 FORMAT "%8.4"
 /begin AXIS_DESCR STD_AXIS tnst_w t10msxs_uw_b655p35 6 0.00 655.3500 FORMAT "%8.4" DEPOSIT ABSOLUTE /end AXIS_DESCR
/end CHARACTERISTIC
/begin CHARACTERISTIC MDERKFON "Anzahl Aussetzer f¸r Adaptionsstop (Heilung)" VALUE 0xFC1736 KwWU16 65535.00 dez 0.00 65535.00 FORMAT "%8.2" /end CHARACTERISTIC
/begin CHARACTERISTIC MILANTI "MIL ist bei ti-Abschaltung an, auch im 1.dcy" VALUE 0xFC1D1D KwWU8 255.0 dez 0.00 255.0 FORMAT "%5.1" /end CHARACTERISTIC
/begin CHARACTERISTIC MISALULL "Momentschwelle zur Schuberkennung f¸r Ausblendung der Aussetzererkennung im LL" VALUE 0xFC1D58 KwWU8 99.61 rel_ub_b99p6 0.00 99.61 FORMAT "%5.2" /end CHARACTERISTIC
/begin CHARACTERISTIC MISALUN "Momentschwelle zur Schuberkennung f¸r Ausblendung der Aussetzererkennung" CURVE 0xFC1D40 GklWU8 99.61 rel_ub_b99p6 0.00 99.61 FORMAT "%5.2"
 /begin AXIS_DESCR COM_AXIS nmot nmot_ub_q40 8 0.00 10200. FORMAT "%5.0" AXIS_PTS_REF SNM08DMUB /end AXIS_DESCR
/end CHARACTERISTIC
/begin CHARACTERISTIC MLWDSLAMN "min. Luftmasse f¸r Bedingung Adaption/Zusatzdiagnose (16 Bit)" VALUE 0xFD5472 KwUw 6553.500 m_uw_b6553p5 0.00 6553.500 FORMAT "%8.3" /end CHARACTERISTIC
/begin CHARACTERISTIC MLWDSLAMX "max. Luftmasse f¸r Bedingung Adaption/Zusatzdiagnose (16 Bit)" VALUE 0xFD5474 KwUw 6553.500 m_uw_b6553p5 0.00 6553.500 FORMAT "%8.3" /end CHARACTERISTIC
/begin CHARACTERISTIC MLWDSLKMN "min. Luftmasse f¸r Bedingung Kurztest-Diagnose (16 Bit)" VALUE 0xFD5476 KwUw 6553.500 m_uw_b6553p5 0.00 6553.500 FORMAT "%8.3" /end CHARACTERISTIC
/begin CHARACTERISTIC MLWDSLKMX "max. Luftmasse f¸r Bedingung Kurztest-Diagnose (16 Bit)" VALUE 0xFD5478 KwUw 6553.500 m_uw_b6553p5 0.00 6553.500 FORMAT "%8.3" /end CHARACTERISTIC
/begin CHARACTERISTIC MLWDSLMN "min. Luftmasse f¸r Bedingung Diagnose (16 Bit)" VALUE 0xFD547A KwUw 6553.500 m_uw_b6553p5 0.00 6553.500 FORMAT "%8.3" /end CHARACTERISTIC
/begin CHARACTERISTIC MLWDSLMX "max. Luftmasse f¸r Bedingung Diagnose (16 Bit)" VALUE 0xFD547C KwUw 6553.500 m_uw_b6553p5 0.00 6553.500 FORMAT "%8.3" /end CHARACTERISTIC
/begin CHARACTERISTIC MLWDSLOMN "min. Luftmasse f¸r Bedingung frm-Offset-Messung (16 Bit)" VALUE 0xFD547E KwUw 6553.500 m_uw_b6553p5 0.00 6553.500 FORMAT "%8.3" /end CHARACTERISTIC
/begin CHARACTERISTIC MLWDSLOMX "max. Luftmasse f¸r Bedingung frm-Offset-Messung (16 Bit)" VALUE 0xFD5480 KwUw 6553.500 m_uw_b6553p5 0.00 6553.500 FORMAT "%8.3" /end CHARACTERISTIC
/begin CHARACTERISTIC MSLBAS "Ini.- Sekund‰rluftmasse" VALUE 0xFD5426 KwUb 102.0 m_q0p4 0.00 102.0 FORMAT "%5.1" /end CHARACTERISTIC
/begin CHARACTERISTIC MSLVMX "Diagnoseschwelle f¸r Ventildichtheitspr¸fung" VALUE 0xFD5482 KwUw 102.3984 m_q0p0015625 0.00 102.3984 FORMAT "%8.4" /end CHARACTERISTIC
/begin CHARACTERISTIC MSLVMXX "Diagnoseschwelle f¸r absoluten Fehler Ventildichtheit" VALUE 0xFD5484 KwUw 102.3984 m_q0p0015625 0.00 102.3984 FORMAT "%8.4" /end CHARACTERISTIC
/begin CHARACTERISTIC NDSTA "Drehzahlschwelle f¸r Diagnose Startautomatik" VALUE 0xFC2162 KwUb 10200. nmot_ub_q40 0.00 10200. FORMAT "%5.0" /end CHARACTERISTIC
/begin CHARACTERISTIC NDSTS "Drehzahlschwelle f¸r Diagnose Startsignal" VALUE 0xFD053E KwWU16 16383.75 nmot_uw_q0p25 0.00 16383.75 FORMAT "%8.2" /end CHARACTERISTIC
/begin CHARACTERISTIC NFLUV "Drehzahlschwelle der Modifikation der Laufunruhe-Berechnung" VALUE 0xFC177B KwWU8 10200. nmot_ub_q40 0.00 10200. FORMAT "%5.0" /end CHARACTERISTIC
/begin CHARACTERISTIC NGALUN "Misfire Detection : Schwelle Drehzahl‰nderung f¸r Ausblendung" CURVE 0xFC1D30 GklWS16 25599.94 nmotg_sw_q0p39 -12800.16 12799.77 FORMAT "%8.2"
 /begin AXIS_DESCR COM_AXIS nmot nmot_ub_q40 8 0.00 10200. FORMAT "%5.0" AXIS_PTS_REF SNM08DMUB /end AXIS_DESCR
/end CHARACTERISTIC
/begin CHARACTERISTIC NGALUST "Misfire Detection : Schwelle Drehzahl‰nderung f¸r Ausblendung nach Start" VALUE 0xFC1D4A KwWS16 25599.94 nmotg_sw_q0p39 -12800.16 12799.77 FORMAT "%8.2" /end CHARACTERISTIC
/begin CHARACTERISTIC NINITSK "Initialisierungswert f¸r Segmentzeitarray auf Drehzahlbasis" VALUE 0xFC1776 KwWU16 16383.75 nmot_uw_q0p25 0.00 16383.75 FORMAT "%8.2" /end CHARACTERISTIC
/begin CHARACTERISTIC NLRFKEFDMX "Anzahl des Eigenfrequenzumschaltungen zur Freigabe des Diagnose" VALUE 0xFD03BB KwUb 255.0 dez 0.00 255.0 FORMAT "%5.1" /end CHARACTERISTIC
/begin CHARACTERISTIC NMIALU "Min. Drehzahl f¸r Ausblendung der Aussetzererkennung" VALUE 0xFC1D4C KwWU16 16383.75 nmot_uw_q0p25 0.00 16383.75 FORMAT "%8.2" /end CHARACTERISTIC
/begin CHARACTERISTIC NMNTKOMP "Drehzahlbegrenzung der Gradientenkorrektur nach Start, Minimalwert" VALUE 0xFC1778 KwWU16 16383.75 nmot_uw_q0p25 0.00 16383.75 FORMAT "%8.2" /end CHARACTERISTIC
/begin CHARACTERISTIC NMXALU "Max. Drehzahl f¸r Ausblendung der Aussetzererkennung" VALUE 0xFC1D4E KwWU16 16383.75 nmot_uw_q0p25 0.00 16383.75 FORMAT "%8.2" /end CHARACTERISTIC
/begin CHARACTERISTIC NOFOF "Obere Drehzahlgrenze f¸r Lernbereich fuel-off Adaption" VALUE 0xFCF942 KwWU16 16383.75 nmot_uw_q0p25 0.00 16383.75 FORMAT "%8.2" /end CHARACTERISTIC
/begin CHARACTERISTIC NSTDMD "Max. Drehzahl f¸r Ausblendung der Aussetzererkennung nach Start" VALUE 0xFC1D50 KwWU16 16383.75 nmot_uw_q0p25 0.00 16383.75 FORMAT "%8.2" /end CHARACTERISTIC
/begin CHARACTERISTIC NUFOF "Untere Drehzahlgrenze f¸r Lernbereich fuel-off Adaption" VALUE 0xFCF944 KwWU16 16383.75 nmot_uw_q0p25 0.00 16383.75 FORMAT "%8.2" /end CHARACTERISTIC
/begin CHARACTERISTIC OZDIAGNMOT "Motordrehzahl, unterhalb der die Diagnose ausgeblendet wird" VALUE 0xFD4048 KwWU8 10200. nmot_ub_q40 0.00 10200. FORMAT "%5.0" /end CHARACTERISTIC
/begin CHARACTERISTIC OZDIAGSPG "Spannung, unterhalb der die Diagnose ausgeblendet wird" VALUE 0xFD4049 KwWU8 24.02 spg_ubatt 0.00 24.02 FORMAT "%5.2" /end CHARACTERISTIC
/begin CHARACTERISTIC OZERRD "Entprellzeit Sensor- und Kommunikationsfehler" VALUE 0xFD4042 KwWU16 65535.00 t1sxs_uw_b65535 0.00 65535.00 FORMAT "%8.2" /end CHARACTERISTIC
/begin CHARACTERISTIC OZHEAL "Entprellzeit Fehler-Healing" VALUE 0xFD4044 KwWU16 65535.00 t1sxs_uw_b65535 0.00 65535.00 FORMAT "%8.2" /end CHARACTERISTIC
/begin CHARACTERISTIC OZSTZYK "Startzyklenz‰hler" VALUE 0xFD4046 KwWU16 65535.00 t1sxs_uw_b65535 0.00 65535.00 FORMAT "%8.2" /end CHARACTERISTIC
/begin CHARACTERISTIC PGPRIO "Array mit Priorisierung der Phasengeber f¸r Synchronisation" VAL_BLK 0xFCFA30 KwbWU8 255.0 dez 0.00 255.0 FORMAT "%5.1" NUMBER 4 /end CHARACTERISTIC
/begin CHARACTERISTIC PHBM "Obergrenze f¸r die Entprellung der Bezugsmarkenfehler" VALUE 0xFC1D9F KwWU8 60.00 dez 0.00 60.00 FORMAT "%5.2" /end CHARACTERISTIC
/begin CHARACTERISTIC PHNOKA "Anfangswert f¸r Z‰hler Phasensignal nicht ok" VALUE 0xFC1DA0 KwWU8 125.0 dez 0.00 125.0 FORMAT "%5.1" /end CHARACTERISTIC
/begin CHARACTERISTIC PHPOSERR "Obergrenze f¸r die Entprellung der Phasenflankenfehler" VALUE 0xFC1DA1 KwWU8 60.00 dez 0.00 60.00 FORMAT "%5.2" /end CHARACTERISTIC
/begin CHARACTERISTIC RANDSEED "Startwert Zufallsgenerator" VALUE 0xFCF9FC KwWU16 65535.00 DEZ 0.00 65535.00 FORMAT "%8.2" /end CHARACTERISTIC
/begin CHARACTERISTIC RMSLMN "Diagnoseschwelle: verringerte Sekund‰rluftmasse (Fehlerhaft)" VALUE 0xFD5427 KwUb 1.992 fak_ub_b2 0.00 1.992 FORMAT "%5.3" /end CHARACTERISTIC
/begin CHARACTERISTIC RMSLMNK "Diagnoseschwelle Bandendetest: verringerte Sekund‰rluftmasse" VALUE 0xFD5428 KwUb 1.992 fak_ub_b2 0.00 1.992 FORMAT "%5.3" /end CHARACTERISTIC
/begin CHARACTERISTIC RMSLPMN "Diagnoseschwelle: Fehler Sekund‰rluftpumpe, nur Pulse Air" VALUE 0xFD5429 KwUb 1.992 fak_ub_b2 0.00 1.992 FORMAT "%5.3" /end CHARACTERISTIC
/begin CHARACTERISTIC RMSLSUMN "Diagnoseschwelle: verringerte Sekund‰rluftmasse; Summengrenzwert" VALUE 0xFD542A KwUb 1.992 fak_ub_b2 0.00 1.992 FORMAT "%5.3" /end CHARACTERISTIC
/begin CHARACTERISTIC RMSLTMN "Schwelle: sehr geringe Sekund‰rluftmasse, ohne Offset" VALUE 0xFD542B KwUb 1.992 fak_ub_b2 0.00 1.992 FORMAT "%5.3" /end CHARACTERISTIC
/begin CHARACTERISTIC SDLAOFMN "minimale (untere) Fehlerschwelle f¸r dlahii_w" VALUE 0xFD03E2 KwSw 1.999969 fak_sw_b1 -1.000000 0.9999695 FORMAT "%8.6" /end CHARACTERISTIC
/begin CHARACTERISTIC SDLAOFMN2 "minimale (untere) Fehlerschwelle f¸r dlahii_w, Bank 2" VALUE 0xFD03E4 KwSw 1.999969 fak_sw_b1 -1.000000 0.9999695 FORMAT "%8.6" /end CHARACTERISTIC
/begin CHARACTERISTIC SDLAOFMX "maximale (obere) Fehlerschwelle f¸r dlahii_w" VALUE 0xFD03E6 KwSw 1.999969 fak_sw_b1 -1.000000 0.9999695 FORMAT "%8.6" /end CHARACTERISTIC
/begin CHARACTERISTIC SDLAOFMX2 "maximale (obere) Fehlerschwelle f¸r dlahii_w, Bank 2" VALUE 0xFD03E8 KwSw 1.999969 fak_sw_b1 -1.000000 0.9999695 FORMAT "%8.6" /end CHARACTERISTIC
/begin CHARACTERISTIC SFONTM "Schwellwert tmot f¸r fuel-on Adaption aktiv" VALUE 0xFCF97A KwWU8 191.3 temp_ub_q0p75_o48 -48.00 143.3 FORMAT "%5.1" /end CHARACTERISTIC
/begin CHARACTERISTIC SIMI03DMF1 "St¸tzstellen KF Fuel-on-Adaption" VAL_BLK 0xFC1708 KwbWR32 20000.000000000000 fak_r32_1 -10000.000000000000 10000.000000000000 FORMAT "%27.21" NUMBER 3 /end CHARACTERISTIC
/begin CHARACTERISTIC SIN08DMFL1 "St¸tzstellen KF Fuel-on-Adaption" VAL_BLK 0xFC1714 KwbWR32 20000.000000000000 fak_r32_1 -10000.000000000000 10000.000000000000 FORMAT "%27.21" NUMBER 8 /end CHARACTERISTIC
/begin CHARACTERISTIC SLFOO1N "Obere Schwelle (Schwellwert-KL) f¸r Lernfilterwert bei fuel-on/-off Adaption" CURVE 0xFC16AE GklWU16 181.8962 luquant_w 0.00 181.8962 FORMAT "%8.4"
 /begin AXIS_DESCR COM_AXIS nmot_w nmot_uw_q0p25 8 0.00 16383.75 FORMAT "%8.2" AXIS_PTS_REF SNM08DMUW1 /end AXIS_DESCR
/end CHARACTERISTIC
/begin CHARACTERISTIC SLFOOF_F "Obere Schwelle f¸r Lernfilterwert bei fuel-off Adaption" VALUE 0xFC1674 KwWR32 20000.000000000000 fak_r32_1 -10000.000000000000 10000.000000000000 FORMAT "%27.21" /end CHARACTERISTIC
/begin CHARACTERISTIC SLFOU1N "Untere Schwelle (Schwellwert-KL) f¸r Lernfilterwert bei fuel-on/-off Adaption" CURVE 0xFC16BE GklWU16 181.8962 luquant_w 0.00 181.8962 FORMAT "%8.4"
 /begin AXIS_DESCR COM_AXIS nmot_w nmot_uw_q0p25 8 0.00 16383.75 FORMAT "%8.2" AXIS_PTS_REF SNM08DMUW1 /end AXIS_DESCR
/end CHARACTERISTIC
/begin CHARACTERISTIC SLFOUF_F "Untere Schwelle f¸r Lernfilterwert bei fuel-off Adaption" VALUE 0xFC1678 KwWR32 20000.000000000000 fak_r32_1 -10000.000000000000 10000.000000000000 FORMAT "%27.21" /end CHARACTERISTIC
/begin AXIS_PTS SMI03DMUB1 "Lastst¸tzstellenverteilung zur Interpolation ¸ber Last" 0xFC1762 midmd SstAU8SstU8 191.3 rel_ub_b99p6 3 0.00 191.4 FORMAT "%5.1" DEPOSIT ABSOLUTE /end AXIS_PTS
/begin AXIS_PTS SMI05DMUB1 "Bereichsgrenzen KF Fuel-on-Adaption" 0xFC1766 midmd SstAU8SstU8 191.3 rel_ub_b99p6 5 0.00 191.4 FORMAT "%5.1" DEPOSIT ABSOLUTE /end AXIS_PTS
/begin AXIS_PTS SMI08DMUB "SST-Verteilung in DMD, 8 Moment-SST" 0xFC1D6C midmd SstAU8SstU8 99.61 rel_ub_b99p6 8 0.00 99.61 FORMAT "%5.2" DEPOSIT ABSOLUTE /end AXIS_PTS
/begin AXIS_PTS SNM08DMUB "SST-Verteilung in DMD, 8 Drehzahl-SST" 0xFC1D75 nmot SstAU8SstU8 10200. nmot_ub_q40 8 0.00 10200. FORMAT "%5.0" DEPOSIT ABSOLUTE /end AXIS_PTS
/begin AXIS_PTS SNM08DMUW1 "St¸tzstellen KF Fuel-on-Adaption" 0xFC1D5A nmot_w SstAU8SstU16 16383.75 nmot_uw_q0p25 8 0.00 16383.75 FORMAT "%8.2" DEPOSIT ABSOLUTE /end AXIS_PTS
/begin AXIS_PTS SNM10DMUW1 "Bereichsgrenzen KF Fuel-on-Adaption" 0xFC174C nmot_w SstAU8SstU16 16383.75 nmot_uw_q0p25 10 0.00 16383.75 FORMAT "%8.2" DEPOSIT ABSOLUTE /end AXIS_PTS
/begin CHARACTERISTIC TALOLDAB "Auslaufzeit f¸r den ÷ldruckabfall" VALUE 0xFD0538 KwUw 6553.500 t100msxs_uw_b6553p5 0.00 6553.500 FORMAT "%8.3" /end CHARACTERISTIC
/begin CHARACTERISTIC TAMIALU "Minimale Ansauglufttemperatur f¸r Ausblendung der Aussetzererkennung" VALUE 0xFCF97B KwWU8 191.3 temp_ub_q0p75_o48 -48.00 143.3 FORMAT "%5.1" /end CHARACTERISTIC
/begin CHARACTERISTIC TANDSLMN "min. Ansauglufttemperatur f¸r SL- Diagnose" VALUE 0xFD542C KwUb 191.3 temp_ub_q0p75_o48 -48.00 143.3 FORMAT "%5.1" /end CHARACTERISTIC
/begin CHARACTERISTIC TANDSLMX "max. Ansauglufttemperatur f¸r SL- Diagnose" VALUE 0xFD542D KwUb 191.3 temp_ub_q0p75_o48 -48.00 143.3 FORMAT "%5.1" /end CHARACTERISTIC
/begin CHARACTERISTIC TANWASTMN "minimales Tastverh‰ltnis f¸r setzen Zyklusflag Endstufendiagnose Nockenwelle" VALUE 0xFD0588 KwWU16 655.350 vnstv_q0p01 0.00 655.350 FORMAT "%7.3" /end CHARACTERISTIC
/begin CHARACTERISTIC TANWASTMX "maximales Tastverh‰ltnis f¸r setzen Zyklusflag Endstufendiagnose Nockenwelle" VALUE 0xFD058A KwWU16 655.350 vnstv_q0p01 0.00 655.350 FORMAT "%7.3" /end CHARACTERISTIC
/begin CHARACTERISTIC TANWESTMN "minimales Tastverh‰ltnis f¸r setzen Zyklusflag Endstufendiagnose Nockenwelle" VALUE 0xFD0582 KwWU16 655.350 vnstv_q0p01 0.00 655.350 FORMAT "%7.3" /end CHARACTERISTIC
/begin CHARACTERISTIC TANWESTMX "maximales Tastverh‰ltnis f¸r setzen Zyklusflag Endstufendiagnose Nockenwelle" VALUE 0xFD0584 KwWU16 655.350 vnstv_q0p01 0.00 655.350 FORMAT "%7.3" /end CHARACTERISTIC
/begin CHARACTERISTIC TC6CSL "Mode 6: Component ID f¸r Pr¸fung Sekund‰rluftsystem" VALUE 0xFD542E KwUb 127.0 dez 0.00 127.0 FORMAT "%5.1" /end CHARACTERISTIC
/begin CHARACTERISTIC TC6CSL2 "Mode 6: Component ID f¸r Pr¸fung Sekund‰rluftsystem, Bank 2" VALUE 0xFD542F KwUb 127.0 dez 0.00 127.0 FORMAT "%5.1" /end CHARACTERISTIC
/begin CHARACTERISTIC TC6CSLK "Mode 6: Component ID f¸r Pr¸fung Sekund‰rluftsystem; Kurztest" VALUE 0xFD5430 KwUb 127.0 dez 0.00 127.0 FORMAT "%5.1" /end CHARACTERISTIC
/begin CHARACTERISTIC TC6CSLK2 "Mode 6: Component ID f¸r Pr¸fung Sekund‰rluftsystem, Bank 2; Kurztest" VALUE 0xFD5431 KwUb 127.0 dez 0.00 127.0 FORMAT "%5.1" /end CHARACTERISTIC
/begin CHARACTERISTIC TC6CSLN "Mode 6: Component ID f¸r Pr¸fung minimale Sekund‰rluft in Phase 1" VALUE 0xFD5432 KwUb 127.0 dez 0.00 127.0 FORMAT "%5.1" /end CHARACTERISTIC
/begin CHARACTERISTIC TC6CSLN2 "Mode 6: Component ID f¸r Pr¸fung minimale Sekund‰rluft in Phase 1, Bank 2" VALUE 0xFD5433 KwUb 127.0 dez 0.00 127.0 FORMAT "%5.1" /end CHARACTERISTIC
/begin CHARACTERISTIC TC6CSLV "Mode 6: Component ID f¸r Pr¸fung Dichtheit SL-Ventil" VALUE 0xFD5434 KwUb 127.0 dez 0.00 127.0 FORMAT "%5.1" /end CHARACTERISTIC
/begin CHARACTERISTIC TC6CSLV2 "Mode 6: Component ID f¸r Pr¸fung Dichtheit SL-Ventil, Bank 2" VALUE 0xFD5435 KwUb 127.0 dez 0.00 127.0 FORMAT "%5.1" /end CHARACTERISTIC
/begin CHARACTERISTIC TDDNWSHL "Entprellzeit f¸r Heilung des Fehler NWS" VALUE 0xFCCAC8 KwWU8 25.50 t100msxs_ub_b25p5 0.00 25.50 FORMAT "%5.2" /end CHARACTERISTIC
/begin CHARACTERISTIC TDDNWSMN "Entprellzeit f¸r Setzen des min.-Fehlers der NWS" VALUE 0xFCCAC9 KwWU8 25.50 t100msxs_ub_b25p5 0.00 25.50 FORMAT "%5.2" /end CHARACTERISTIC
/begin CHARACTERISTIC TDDNWSNP "Entprellzeit f¸r Setzen des Fehlers f¸r unplausible Stellung d.NW" VALUE 0xFCCACA KwWU8 25.50 t100msxs_ub_b25p5 0.00 25.50 FORMAT "%5.2" /end CHARACTERISTIC
/begin CHARACTERISTIC TDGDST "Zeitverzˆgerung f¸r Freigabe der Messbereitschaft nach fallender Flanke B_gdst" VALUE 0xFD5436 KwUb 25.50 t100msxs_ub_b25p5 0.00 25.50 FORMAT "%5.2" /end CHARACTERISTIC
/begin CHARACTERISTIC TDMSLMN1 "Mindestmeﬂzeit Sekund‰rluftmasse, Phase 1" VALUE 0xFD5437 KwUb 25.50 t100msxs_ub_b25p5 0.00 25.50 FORMAT "%5.2" /end CHARACTERISTIC
/begin CHARACTERISTIC TDMSLMN4 "Mindestmeﬂzeit Sekund‰rluftmasse, Phase 4" VALUE 0xFD5438 KwUb 25.50 t100msxs_ub_b25p5 0.00 25.50 FORMAT "%5.2" /end CHARACTERISTIC
/begin CHARACTERISTIC TDMSLMNK "Mindestmeﬂzeit Sekund‰rluftmasse, Phase 1 bei Kurztest" VALUE 0xFD5439 KwUb 25.50 t100msxs_ub_b25p5 0.00 25.50 FORMAT "%5.2" /end CHARACTERISTIC
/begin CHARACTERISTIC TDMSLOF3 "Meﬂzeit Offset Sekund‰rluftmasse, Phase 3" VALUE 0xFD543A KwUb 25.50 t100msxs_ub_b25p5 0.00 25.50 FORMAT "%5.2" /end CHARACTERISTIC
/begin CHARACTERISTIC TDMSLOF5 "Meﬂzeit Offset sekund‰rluftmasse, Phase 5" VALUE 0xFD543B KwUb 25.50 t100msxs_ub_b25p5 0.00 25.50 FORMAT "%5.2" /end CHARACTERISTIC
/begin CHARACTERISTIC TDMSLOFK "Meﬂzeit Offset Sekund‰rluftmasse, Phase 3 bei Kurztest" VALUE 0xFD543C KwUb 25.50 t100msxs_ub_b25p5 0.00 25.50 FORMAT "%5.2" /end CHARACTERISTIC
/begin CHARACTERISTIC TDMSLV "Messzeit f¸r Ventildichtheitspr¸fung" VALUE 0xFD543D KwUb 25.50 t100msxs_ub_b25p5 0.00 25.50 FORMAT "%5.2" /end CHARACTERISTIC
/begin CHARACTERISTIC TDMSLVK "Meﬂzeit f¸r Ventildichtheitspr¸fung bei Kurztest" VALUE 0xFD543E KwUb 25.50 t100msxs_ub_b25p5 0.00 25.50 FORMAT "%5.2" /end CHARACTERISTIC
/begin CHARACTERISTIC TDPH2SLOF "Zeit Einschaltverzˆgerung von Phase 2 nach Phase 3" VALUE 0xFD543F KwUb 25.50 t100msxs_ub_b25p5 0.00 25.50 FORMAT "%5.2" /end CHARACTERISTIC
/begin CHARACTERISTIC TDPHSLOF "Zeit Einschaltverzˆgerung Bit B_slsoff in Phase 2, 3 und 5 nach" VALUE 0xFD5440 KwUb 25.50 t100msxs_ub_b25p5 0.00 25.50 FORMAT "%5.2" /end CHARACTERISTIC
/begin CHARACTERISTIC TDPHSLOFK "Zeit Einschaltverzˆgerung Bit B_slsoff in Phase 2, 3 und 5  (Kurztest)" VALUE 0xFD5441 KwUb 25.50 t100msxs_ub_b25p5 0.00 25.50 FORMAT "%5.2" /end CHARACTERISTIC
/begin CHARACTERISTIC TDSLMDRL "Einschaltverzˆgerung Delta-rl-Sperre bei Bildung B_dslmes" VALUE 0xFD5442 KwUb 25.50 t100msxs_ub_b25p5 0.00 25.50 FORMAT "%5.2" /end CHARACTERISTIC
/begin CHARACTERISTIC TDSLMVBA "Einschaltverzˆgerung BA-/VA-Sperre bei Bildung B_dslmes" VALUE 0xFD5443 KwUb 25.50 t100msxs_ub_b25p5 0.00 25.50 FORMAT "%5.2" /end CHARACTERISTIC
/begin CHARACTERISTIC TDSUE "Wartezeit bis Fehlereintrag Endstufe Saugrohrumschaltung" VALUE 0xFC2235 KwWU8 25.50 t100msxs_ub_b25p5 0.00 25.50 FORMAT "%5.2" /end CHARACTERISTIC
/begin CHARACTERISTIC TDSUEH "Wartezeit bis Fehlerheilung Endstufe Saugrohrumschaltung" VALUE 0xFC2236 KwWU8 25.50 t100msxs_ub_b25p5 0.00 25.50 FORMAT "%5.2" /end CHARACTERISTIC
/begin CHARACTERISTIC TDSUEMN "Wartezeit bis min. Tastverhaeltnis  Saugrohrumschaltung gueltig" VALUE 0xFC2237 KwWU8 25.50 t100msxs_ub_b25p5 0.00 25.50 FORMAT "%5.2" /end CHARACTERISTIC
/begin CHARACTERISTIC TDSUEMX "Wartezeit bis max. Tastverhaeltnis  Saugrohrumschaltung gueltig" VALUE 0xFC2238 KwWU8 25.50 t100msxs_ub_b25p5 0.00 25.50 FORMAT "%5.2" /end CHARACTERISTIC
/begin CHARACTERISTIC TFIMSLI "Zeitkonstante f¸r msli- und msln-Filter" VALUE 0xFD5444 KwUb 12.6996 zk100msxs_ub_b25p5 0.100392 12.8000 FORMAT "%7.4" /end CHARACTERISTIC
/begin CHARACTERISTIC TFIMSLIK "Zeitkonstante f¸r msli- und msln-Filter bei Kurztest" VALUE 0xFD5445 KwUb 12.6996 zk100msxs_ub_b25p5 0.100392 12.8000 FORMAT "%7.4" /end CHARACTERISTIC
/begin CHARACTERISTIC TFIMSLO "Zeitkonstante f¸r mslo- Filter" VALUE 0xFD5446 KwUb 12.6996 zk100msxs_ub_b25p5 0.100392 12.8000 FORMAT "%7.4" /end CHARACTERISTIC
/begin CHARACTERISTIC TFIMSLOK "Zeitkonstante f¸r mslo- Filter bei Kurztest" VALUE 0xFD5447 KwUb 12.6996 zk100msxs_ub_b25p5 0.100392 12.8000 FORMAT "%7.4" /end CHARACTERISTIC
/begin CHARACTERISTIC TFIMSLV "Zeitkonstante f¸r mslv- Filter" VALUE 0xFD5448 KwUb 12.6996 zk100msxs_ub_b25p5 0.100392 12.8000 FORMAT "%7.4" /end CHARACTERISTIC
/begin CHARACTERISTIC TFIMSLVK "Zeitkonstante f¸r mslv- Filter bei Kurztest" VALUE 0xFD5449 KwUb 12.6996 zk100msxs_ub_b25p5 0.100392 12.8000 FORMAT "%7.4" /end CHARACTERISTIC
/begin CHARACTERISTIC THP "" VALUE 0xFD0561 KwUb 24.50 t_q0p1 1.000 25.50 FORMAT "%5.2" /end CHARACTERISTIC
/begin CHARACTERISTIC TKATDSL "maximale Katalysatortemperatur f¸r Freigabe SLS-Diagnose" VALUE 0xFD544A KwUb 1275. temp_ub_q5_o50 -50.00 1225. FORMAT "%5.0" /end CHARACTERISTIC
/begin CHARACTERISTIC TLAED "Wartezeit bis Fehlerlampe aus nach Start" VALUE 0xFCF940 KwUb 51.00 t200msxs_ub_b51 0.00 51.00 FORMAT "%5.2" /end CHARACTERISTIC
/begin CHARACTERISTIC TLAEDI "Wartezeit bis Fehlerlampe aus nach INI" VALUE 0xFCF941 KwUb 51.00 t200msxs_ub_b51 0.00 51.00 FORMAT "%5.2" /end CHARACTERISTIC
/begin CHARACTERISTIC TMASKIV1 "Temperaturschwelle f¸r Verl‰gerung 1. KAT-Intervall, Aussetzererkennung" VALUE 0xFC1D1E KwWU8 191.3 temp_ub_q0p75_o48 -48.00 143.3 FORMAT "%5.1" /end CHARACTERISTIC
/begin CHARACTERISTIC TMDSLAMN "min. Motortemperatur f¸r Zusatzdiagnose" VALUE 0xFD544B KwUb 191.3 temp_ub_q0p75_o48 -48.00 143.3 FORMAT "%5.1" /end CHARACTERISTIC
/begin CHARACTERISTIC TMDSLMN "min. Motortemperatur f¸r DSLS" VALUE 0xFD544C KwUb 191.3 temp_ub_q0p75_o48 -48.00 143.3 FORMAT "%5.1" /end CHARACTERISTIC
/begin CHARACTERISTIC TMDSLMX "max. Motortemperatur f¸r DSLS" VALUE 0xFD544D KwUb 191.3 temp_ub_q0p75_o48 -48.00 143.3 FORMAT "%5.1" /end CHARACTERISTIC
/begin CHARACTERISTIC TMSLADAP "Sperrzeit f¸r Wiederholung Adaption" VALUE 0xFD5486 KwUw 6553.500 t100msxs_uw_b6553p5 0.00 6553.500 FORMAT "%8.3" /end CHARACTERISTIC
/begin CHARACTERISTIC TMSLIFT "Wartezeit f¸r f¸r mslift-Filter (Aufbau Drehmomentenreserve)" VALUE 0xFD5488 KwUw 6553.500 t100msxs_uw_b6553p5 0.00 6553.500 FORMAT "%8.3" /end CHARACTERISTIC
/begin CHARACTERISTIC TMSLIFT1 "Wartezeit f¸r mslift-Filter (Aufbau Drehmomentenreserve) in Phase 1" VALUE 0xFD548A KwUw 6553.500 t100msxs_uw_b6553p5 0.00 6553.500 FORMAT "%8.3" /end CHARACTERISTIC
/begin CHARACTERISTIC TMSLIFTK "Wartezeit f¸r mslift-Filter (Aufbau Drehmomentenreserve) in Phase 1 w‰hrend Kurz" VALUE 0xFD548C KwUw 6553.500 t100msxs_uw_b6553p5 0.00 6553.500 FORMAT "%8.3" /end CHARACTERISTIC
/begin CHARACTERISTIC TNALU "Testphasenl‰nge nach erkanntem Aussetzer" VALUE 0xFC1775 KwWU8 255.0 dez 0.00 255.0 FORMAT "%5.1" /end CHARACTERISTIC
/begin CHARACTERISTIC TNOMF2 "zul‰ssige Zeit auﬂerhalb Meﬂfenster, Phase 2" VALUE 0xFD544E KwUb 25.50 t100msxs_ub_b25p5 0.00 25.50 FORMAT "%5.2" /end CHARACTERISTIC
/begin CHARACTERISTIC TNOMF3 "zul‰ssige Zeit auﬂerhalb Meﬂfenster, Phase 3" VALUE 0xFD544F KwUb 25.50 t100msxs_ub_b25p5 0.00 25.50 FORMAT "%5.2" /end CHARACTERISTIC
/begin CHARACTERISTIC TNOMF5 "zul‰ssige Zeit auﬂerhalb Meﬂfenster, Phase 5" VALUE 0xFD5450 KwUb 25.50 t100msxs_ub_b25p5 0.00 25.50 FORMAT "%5.2" /end CHARACTERISTIC
/begin CHARACTERISTIC TNSTDSL "Schwelle Zeit nach Start f¸r aktivieren Phase 4" VALUE 0xFD548E KwUw 655.3500 t10msxs_uw_b655p35 0.00 655.3500 FORMAT "%8.4" /end CHARACTERISTIC
/begin CHARACTERISTIC TOELMND "÷ltemperaturuntergrenze f¸r die Diagnosefreigabe" VALUE 0xFD053A KwUw 49151.25 temp_ub_q0p75_o48 -48.00000 49103.25 FORMAT "%8.2" /end CHARACTERISTIC
/begin CHARACTERISTIC TOELMXD "÷ltemperaturobergrenze f¸r die Diagnosefreigabe" VALUE 0xFD053C KwUw 49151.25 temp_ub_q0p75_o48 -48.00000 49103.25 FORMAT "%8.2" /end CHARACTERISTIC
/begin CHARACTERISTIC TPDSTA "Entprellzeit f¸r Diagnose Startautomatik" VALUE 0xFC2164 KwUw 655.3500 t10msxs_uw_b655p35 0.00 655.3500 FORMAT "%8.4" /end CHARACTERISTIC
/begin CHARACTERISTIC TSBINVALID "Anzahl der Synchros mit Initialisierungswert von tsroh_f" VALUE 0xFC7FEC KwWU8 255.0 dez 0.00 255.0 FORMAT "%5.1" /end CHARACTERISTIC
/begin CHARACTERISTIC TSBSEGINI "Initialisierungswert der Segmentzeit bezogen auf 360 Grad KW" VALUE 0xFC7FF0 KwWR32 20000.000000000000 fak_r32_1 -10000.000000000000 10000.000000000000 FORMAT "%27.21" /end CHARACTERISTIC
/begin CHARACTERISTIC TSBVDSLTMS "Verzˆgerung Messbeginn DSLSLRS nach Sondenbetriebsbereitschaft" CURVE 0xFD5490 KlAUbSstUbWUw 6553.500 t100msxs_uw_b6553p5 0.00 6553.500 FORMAT "%8.3"
 /begin AXIS_DESCR STD_AXIS tmst temp_ub_q0p75_o48 6 -48.00 143.3 FORMAT "%5.1" DEPOSIT ABSOLUTE /end AXIS_DESCR
/end CHARACTERISTIC
/begin CHARACTERISTIC TVHELSUF "‹berbr¸ckungszeit bei kurzfristige Wegfall B_lrhkp" VALUE 0xFD03BC KwUb 25.50 t100msxs_ub_b25p5 0.00 25.50 FORMAT "%5.2" /end CHARACTERISTIC
/begin CHARACTERISTIC TVLSUEK "Verzˆgerungszeit f¸r Fehlerkorrektur stetige Lambdasonde LSU" VALUE 0xFD03EA KwUw 6553.500 t100msxs_uw_b6553p5 0.00 6553.500 FORMAT "%8.3" /end CHARACTERISTIC
/begin CHARACTERISTIC TVLSUEK2 "Verzˆgerungszeit f¸r Fehlerkorrektur stetige Lambdasonde LSU (Bank2)" VALUE 0xFD03EC KwUw 6553.500 t100msxs_uw_b6553p5 0.00 6553.500 FORMAT "%8.3" /end CHARACTERISTIC
/begin CHARACTERISTIC TVLSUOF "Verzˆgerungszeit f¸r Fehler stetige Lambdasonde LSU ""Offset""" VALUE 0xFD03EE KwUw 6553.500 t100msxs_uw_b6553p5 0.00 6553.500 FORMAT "%8.3" /end CHARACTERISTIC
/begin CHARACTERISTIC TVLSUOF2 "Verzˆgerungszeit f¸r Fehler stetige Lambdasonde LSU ""Offset"" (Bank2)" VALUE 0xFD03F0 KwUw 6553.500 t100msxs_uw_b6553p5 0.00 6553.500 FORMAT "%8.3" /end CHARACTERISTIC
/begin CHARACTERISTIC TVLSUPER "Verzˆgerungszeit f¸r B_lsuftb und B_lsumrb" VALUE 0xFD03BD KwUb 25.50 t100msxs_ub_b25p5 0.00 25.50 FORMAT "%5.2" /end CHARACTERISTIC
/begin CHARACTERISTIC TVLSUPER2 "Verzˆgerungszeit f¸r B_lsuftb und B_lsumrb (Bank2)" VALUE 0xFD03BE KwUb 25.50 t100msxs_ub_b25p5 0.00 25.50 FORMAT "%5.2" /end CHARACTERISTIC
/begin CHARACTERISTIC TVP "Verzˆgerungszeit Fehlerverifizierung Endstufendiagnose ME(D) 7/9" VALUE 0xFD0562 KwUb 25.00 t_q0p1 0.5000 25.50 FORMAT "%5.2" /end CHARACTERISTIC
/begin CHARACTERISTIC TVRDISAMN "minimales Tastverh‰ltnis DISA geregelt" VALUE 0xFD057A KwSw 199.997 vnstv_q0p00305 -100.000 99.9969 FORMAT "%7.3" /end CHARACTERISTIC
/begin CHARACTERISTIC TVRDISAMX "maximales Tastverh‰ltnis DISA geregelt" VALUE 0xFD057C KwSw 199.997 vnstv_q0p00305 -100.000 99.9969 FORMAT "%7.3" /end CHARACTERISTIC
/begin CHARACTERISTIC TVSDISAMN "minimales Tastverh‰ltnis DISA geschaltet" VALUE 0xFC2232 KwWU16 655.3500 di_uw_q0p01 0.00 655.3500 FORMAT "%8.4" /end CHARACTERISTIC
/begin CHARACTERISTIC TVSDISAMX "maximales Tastverh‰ltnis DISA geschaltet" VALUE 0xFD057E KwUw 655.3500 di_uw_q0p01 0.00 655.3500 FORMAT "%8.4" /end CHARACTERISTIC
/begin CHARACTERISTIC TVSNPF "Verzˆgerungszeit in der Stˆrungen bei der Entprellung unterdr¸ckt werden" VALUE 0xFD03BF KwUb 25.50 t100msxs_ub_b25p5 0.00 25.50 FORMAT "%5.2" /end CHARACTERISTIC
/begin CHARACTERISTIC TVSNPF2 "Verzˆgerungszeit in der Stˆrungen bei der Entprellung unterdr¸ckt werden (Bank2)" VALUE 0xFD03C0 KwUb 25.50 t100msxs_ub_b25p5 0.00 25.50 FORMAT "%5.2" /end CHARACTERISTIC
/begin CHARACTERISTIC TWDSLTM "tmot- Entprellzeit f¸r Adaption/Zusatudiagnose" VALUE 0xFD5451 KwUb 25.40 t100msxs_ub_b25p5 0.1000 25.50 FORMAT "%5.2" /end CHARACTERISTIC
/begin CHARACTERISTIC TWDSTA "Wartezeit f¸r Diagnose Startautomatik" VALUE 0xFC2163 KwUb 2.550 t10msxs_ub_b2p55 0.00 2.550 FORMAT "%5.3" /end CHARACTERISTIC
/begin CHARACTERISTIC TWDSTS "Wartezeit f¸r Diagnose Startsignal" VALUE 0xFD0540 KwWU16 6553.500 t_q0p1 0.00 6553.500 FORMAT "%8.3" /end CHARACTERISTIC
/begin CHARACTERISTIC TWHLSLP "Wartezeit f¸r Hochlauf Sekund‰rluftpumpe" VALUE 0xFD5452 KwUb 25.50 t100msxs_ub_b25p5 0.00 25.50 FORMAT "%5.2" /end CHARACTERISTIC
/begin CHARACTERISTIC TWMLFE "Mindestzeit f¸r ml im Diagnosebereich" VALUE 0xFD5453 KwUb 25.50 t100msxs_ub_b25p5 0.00 25.50 FORMAT "%5.2" /end CHARACTERISTIC
/begin CHARACTERISTIC TWMSLMIN "Entprellzeit f¸r Fehlermeldung B_mslmin" VALUE 0xFD5454 KwUb 25.50 t100msxs_ub_b25p5 0.00 25.50 FORMAT "%5.2" /end CHARACTERISTIC
/begin CHARACTERISTIC TWSLPSLA "Freigabe der Aktivdiagnose f¸r Sekund‰rluft" VALUE 0xFD54A4 KwUw 1535.977 temp_q0p0234_o273 -273.1500 1262.827 FORMAT "%8.3" /end CHARACTERISTIC
/begin CHARACTERISTIC USHKFT "Sondenspannungs-Schwelle f¸r Erkennung ""Abgas fett"" hinter Kat" VALUE 0xFD03F2 KwUw 319.9951 spg_uw_q0p00488_o1 -1.000000 318.9951 FORMAT "%8.4" /end CHARACTERISTIC
/begin CHARACTERISTIC USHKMR "Sondenspannungs-Schwelle f¸r Erkennung ""Abgas mager"" hinter Kat" VALUE 0xFD03F4 KwUw 319.9951 spg_uw_q0p00488_o1 -1.000000 318.9951 FORMAT "%8.4" /end CHARACTERISTIC
/begin CHARACTERISTIC ZAGRUN "Start des Aussetzergenerators" VALUE 0xFCF9FE KwWU8 255.0 DEZ 0.00 255.0 FORMAT "%5.1" /end CHARACTERISTIC
/begin CHARACTERISTIC ZDSLAMX "Maximale Anzahl Wiederholungen aktive Zusatzdiagnose (Phasen 4+5)" VALUE 0xFD5455 KwUb 255.0 dez 0.00 255.0 FORMAT "%5.1" /end CHARACTERISTIC
/begin CHARACTERISTIC ZLAMFT "Zeitkonstante f¸r Filterung von lamsoni" VALUE 0xFC207C KwUw 6553.4999985 zk100msxs_uw_b6553 0.10000152590 6553.6000000 FORMAT "%12.7" /end CHARACTERISTIC
/begin CHARACTERISTIC ZYLKOR "Wert zur Zylinderkorrektur (tsroh zu zzyldmd)" VALUE 0xFC7FED KwWU8 255.0 dez 0.00 255.0 FORMAT "%5.1" /end CHARACTERISTIC
/begin MEASUREMENT abgsmw_w "Mittelwert Abgas-relevante Aussetzer ¸ber alle Zylinder" UWORD dez 1 100 0 12000 FORMAT "%8.2" ECU_ADDRESS 0x402938 /end MEASUREMENT
/begin MEASUREMENT afmimn "Bereichsfenster Aussetzer , minimale Last" UBYTE rel_ub_q0p75 1 100 0 191.25 FORMAT "%5.1" ECU_ADDRESS 0x3FE038 /end MEASUREMENT
/begin MEASUREMENT afmimx "Bereichsfenster Aussetzer , maximale Last" UBYTE rel_ub_q0p75 1 100 0 191.25 FORMAT "%5.1" ECU_ADDRESS 0x3FE039 /end MEASUREMENT
/begin MEASUREMENT afnmn "Bereichsfenster Aussetzer, minimale Drehzahl" UBYTE nmot_ub_q40 1 100 0 10200 FORMAT "%5.0" ECU_ADDRESS 0x3FE03A /end MEASUREMENT
/begin MEASUREMENT afnmx "Bereichsfenster Aussetzer, maximale Drehzahl" UBYTE nmot_ub_q40 1 100 0 10200 FORMAT "%5.0" ECU_ADDRESS 0x3FE03B /end MEASUREMENT
/begin MEASUREMENT aftmimn "Bereichsfenster Aussetzer, minimale Last" UBYTE rel_ub_q0p75 1 100 0 191.25 FORMAT "%5.1" ECU_ADDRESS 0x40385D /end MEASUREMENT
/begin MEASUREMENT aftmimx "Bereichsfenster Aussetzer, maximale Last" UBYTE rel_ub_q0p75 1 100 0 191.25 FORMAT "%5.1" ECU_ADDRESS 0x40385E /end MEASUREMENT
/begin MEASUREMENT aftnmn "Bereichsfenster Aussetzer, minimale Drehzahl, tempor‰r" UBYTE nmot_ub_q40 1 100 0 10200 FORMAT "%5.0" ECU_ADDRESS 0x40385F /end MEASUREMENT
/begin MEASUREMENT aftnmx "Bereichsfenster Aussetzer, maximale Drehzahl, tempor‰r" UBYTE nmot_ub_q40 1 100 0 10200 FORMAT "%5.0" ECU_ADDRESS 0x403860 /end MEASUREMENT
/begin MEASUREMENT ahearv_w "Aussetzerh‰ufigkeit zum Erreichen der Ausblendung anderer Funktionen (aus AHEARV" UWORD dez 1 100 0 65535 FORMAT "%8.2" ECU_ADDRESS 0x40293A /end MEASUREMENT
/begin MEASUREMENT aint_zyl "Z‰hler f¸r Intervalle mit katsch‰digenden Aussetzern f¸r TI-Abschaltung" UBYTE dez 1 100 0 255 FORMAT "%5.1" ARRAY_SIZE 12 ECU_ADDRESS 0x403861 /end MEASUREMENT
/begin MEASUREMENT anwfofs "z‰hlt Anzahl der NW-Umdr. von Bedingungen f¸r Adaption erf¸llt bis Lernbeginn" UWORD dez 1 100 0 65535 FORMAT "%8.2" ECU_ADDRESS 0x402878 /end MEASUREMENT
/begin MEASUREMENT anwfoh_w "z‰hlt Anzahl der NW-Umdr. f¸r Heilung der fuel-on/-off Adaption" UWORD dez 1 100 0 65535 FORMAT "%8.2" ECU_ADDRESS 0x404382 /end MEASUREMENT
/begin MEASUREMENT anwfos_w "z‰hlt Anzahl der NW-Umdr. von Bedingungen f¸r Adaption erf¸llt bis Lernbeginn" UWORD dez 1 100 0 65535 FORMAT "%8.2" ECU_ADDRESS 0x404384 /end MEASUREMENT
/begin MEASUREMENT anwst "z‰hlt Anzahl der NW-Umdr. bei denen fuel-off Adaption nach Fertiglernen aktiv" UWORD dez 1 100 0 65535 FORMAT "%8.2" ECU_ADDRESS 0x40287A /end MEASUREMENT
/begin MEASUREMENT anzinten "Za‰hler der Intervalle zur Freigabe TI-Abschaltung" UBYTE dez 1 100 0 255 FORMAT "%5.1" ECU_ADDRESS 0x40386D /end MEASUREMENT
/begin MEASUREMENT azycntb "Z‰hler f¸r aussetzende Zylinder/Bank" UBYTE dez 1 100 0 255 FORMAT "%5.1" ARRAY_SIZE 4 ECU_ADDRESS 0x40386E /end MEASUREMENT
/begin MEASUREMENT bankindex "" UBYTE dez 1 100 0 255 FORMAT "%5.1" ECU_ADDRESS 0x403872 /end MEASUREMENT
/begin MEASUREMENT bbsp1 "Byte f¸r Bedingung B_sp1 als Triggerevent in DCLA" UBYTE dez 1 100 0 255 FORMAT "%5.1" ECU_ADDRESS 0x403873 /end MEASUREMENT
/begin MEASUREMENT bbsp2 "Byte f¸r Bedingung B_sp2 als Triggerevent in DCLA" UBYTE dez 1 100 0 255 FORMAT "%5.1" ECU_ADDRESS 0x403874 /end MEASUREMENT
/begin MEASUREMENT bfmimn "" UBYTE rel_ub_q0p75 1 100 0 191.25 FORMAT "%5.1" ECU_ADDRESS 0x402942 /end MEASUREMENT
/begin MEASUREMENT bfmimx "" UBYTE rel_ub_q0p75 1 100 0 191.25 FORMAT "%5.1" ECU_ADDRESS 0x402943 /end MEASUREMENT
/begin MEASUREMENT bfnmn "Bereichsfenster Motorbetrieb, minimale Drehzahl" UBYTE nmot_ub_q40 1 100 0 10200 FORMAT "%5.0" ECU_ADDRESS 0x402944 /end MEASUREMENT
/begin MEASUREMENT bfnmx "Bereichsfenster Motorbetrieb, maximale Drehzahl" UBYTE nmot_ub_q40 1 100 0 10200 FORMAT "%5.0" ECU_ADDRESS 0x402945 /end MEASUREMENT
/begin MEASUREMENT bssp "Speicherwert Signal Beschleunigungssensor" UWORD acc_uw_b55p55 1 100 0 55.5547 FORMAT "%8.5" ECU_ADDRESS 0x403EFC /end MEASUREMENT
/begin MEASUREMENT B_afklt "Bereichsfenster Aussetzer, Bedingung kalt, TMOT<TMWUC" UBYTE B_TRUE 1 100 0 1 BIT_MASK 0x1 FORMAT "%13.11" ECU_ADDRESS 0x3FE018 /end MEASUREMENT
/begin MEASUREMENT B_aftklt "Bereichsfenster Aussetzer, tempor‰r, Bedingung kalt, TMOT<TMWUC" UBYTE B_TRUE 1 100 0 1 BIT_MASK 0x1 FORMAT "%13.11" ECU_ADDRESS 0x3FBF0E /end MEASUREMENT
/begin MEASUREMENT B_aftwrm "Bereichsfenster Aussetzer, tempor‰r, Bedingung warm, TMOT>TMWUC" UBYTE B_TRUE 1 100 0 1 BIT_MASK 0x1 FORMAT "%13.11" ECU_ADDRESS 0x3FBF0F /end MEASUREMENT
/begin MEASUREMENT B_afwrm "Bereichsfenster Aussetzer, Bedingung warm, TMOT>TMWUC" UBYTE B_TRUE 1 100 0 1 BIT_MASK 0x1 FORMAT "%13.11" ECU_ADDRESS 0x3FE019 /end MEASUREMENT
/begin MEASUREMENT B_ainten "Bedingung Intervallende katsch‰digende Aussetzer" UBYTE B_TRUE 1 100 0 1 BIT_MASK 0x1 FORMAT "%13.11" ECU_ADDRESS 0x3FBF10 /end MEASUREMENT
/begin MEASUREMENT B_analu "Ausblendung nach dem ersten erkannten Aussetzer l‰uft" UBYTE B_TRUE 1 100 0 1 BIT_MASK 0x1 FORMAT "%13.11" ECU_ADDRESS 0x40384C /end MEASUREMENT
/begin MEASUREMENT B_awmslsum "Bedingung Auswertung des Summengrenzwert f¸r gesamte Sekund‰rluft" UWORD B_TRUE 1 100 0 1 BIT_MASK 0x8 FORMAT "%13.11" ECU_ADDRESS 0x403736 /end MEASUREMENT
/begin MEASUREMENT B_bfklt "Bereichsfenster Motorbetrieb, Bedingung kalt, TMOT<TMWUC" UBYTE B_TRUE 1 100 0 1 BIT_MASK 0x1 FORMAT "%13.11" ECU_ADDRESS 0x3FBF11 /end MEASUREMENT
/begin MEASUREMENT B_bfwrm "Bereichsfenster Motorbetrieb, Bedingung warm, TMOT>TMWUC" UBYTE B_TRUE 1 100 0 1 BIT_MASK 0x1 FORMAT "%13.11" ECU_ADDRESS 0x3FBF12 /end MEASUREMENT
/begin MEASUREMENT B_blkeb "MIL-Ansteuerung blinkend eigenbestimmt" UBYTE B_TRUE 1 100 0 1 BIT_MASK 0x4 FORMAT "%13.11" ECU_ADDRESS 0x403B2E /end MEASUREMENT
/begin MEASUREMENT B_blkmd "MIL-Ansteuerung blinkend durch Aussetzererkennung" UBYTE B_TRUE 1 100 0 1 BIT_MASK 0x1 FORMAT "%13.11" ECU_ADDRESS 0x403787 /end MEASUREMENT
/begin MEASUREMENT B_cdfo "Bedingung Ausschalten und R¸cksetzen der Adaption" UBYTE B_TRUE 1 100 0 1 BIT_MASK 0x1 FORMAT "%13.11" ECU_ADDRESS 0x3FBEFD /end MEASUREMENT
/begin MEASUREMENT B_clradfof "Bedingung: Adaptionswerte Fuel-Off/-On selektiv loeschen" UBYTE B_TRUE 1 100 0 1 BIT_MASK 0x1 FORMAT "%13.11" ECU_ADDRESS 0x3FBEFE /end MEASUREMENT
/begin MEASUREMENT B_com1 "Allgemeine Stopbits f¸r LU und FON" UBYTE B_TRUE 1 100 0 1 BIT_MASK 0x1 FORMAT "%13.11" ECU_ADDRESS 0x3FBF21 /end MEASUREMENT
/begin MEASUREMENT B_com2 "Allgemeine Stopbits f¸r LU, FON und FOF" UBYTE B_TRUE 1 100 0 1 BIT_MASK 0x1 FORMAT "%13.11" ECU_ADDRESS 0x3FBF22 /end MEASUREMENT
/begin MEASUREMENT B_cwdslt "Bedingung: Freigabe Ventildichtheitspr¸fung" UBYTE B_TRUE 1 100 0 1 BIT_MASK 0x1 FORMAT "%13.11" ECU_ADDRESS 0x40371A /end MEASUREMENT
/begin MEASUREMENT B_cwdslty "Bedingung rdy-Flag ohne Z_slp bei aktiver Pr¸fung" UBYTE B_TRUE 1 100 0 1 BIT_MASK 0x1 FORMAT "%13.11" ECU_ADDRESS 0x3FC37F /end MEASUREMENT
/begin MEASUREMENT B_cwsla "Bedingung: Freigabe der Adaptionsphase/Zusatzdiagnose" UBYTE B_TRUE 1 100 0 1 BIT_MASK 0x1 FORMAT "%13.11" ECU_ADDRESS 0x40371C /end MEASUREMENT
/begin MEASUREMENT B_danws "Aktive Diagnose: Nockenwellensteuerung (Auslaﬂseite, Bank1)" UBYTE B_TRUE 1 100 0 1 BIT_MASK 0x1 FORMAT "%13.11" ECU_ADDRESS 0x40368F /end MEASUREMENT
/begin MEASUREMENT B_danws2 "Aktive Diagnose: Nockenwellensteuerung (Auslaﬂseite, Bank2)" UBYTE B_TRUE 1 100 0 1 BIT_MASK 0x2 FORMAT "%13.11" ECU_ADDRESS 0x40368F /end MEASUREMENT
/begin MEASUREMENT B_denws "Aktive Diagnose: Nockenwellensteuerung (Einlaﬂseite, Bank1)" UBYTE B_TRUE 1 100 0 1 BIT_MASK 0x1 FORMAT "%13.11" ECU_ADDRESS 0x403690 /end MEASUREMENT
/begin MEASUREMENT B_denws2 "Aktive Diagnose: Nockenwellensteuerung (Einlaﬂseite, Bank2)" UBYTE B_TRUE 1 100 0 1 BIT_MASK 0x2 FORMAT "%13.11" ECU_ADDRESS 0x403690 /end MEASUREMENT
/begin MEASUREMENT B_dfrmoe "Bedingung Messung und Bewertung frm-Offset l‰uft (dfrmoff_w, B_dfrmoff)" UWORD B_TRUE 1 100 0 1 BIT_MASK 0x1 FORMAT "%13.11" ECU_ADDRESS 0x403736 /end MEASUREMENT
/begin MEASUREMENT B_dfrmoe2 "Bedingung Messung und Bewertung frm-Offset l‰uft (dfrmoff_w, B_dfrmoff); Bank2)" UBYTE B_TRUE 1 100 0 1 BIT_MASK 0x2 FORMAT "%13.11" ECU_ADDRESS 0x403721 /end MEASUREMENT
/begin MEASUREMENT B_dfrmoff "frm-Offset-Schwelle ¸berschritten: zeigt Vorsteuerproblem" UBYTE B_TRUE 1 100 0 1 BIT_MASK 0x80 FORMAT "%13.11" ECU_ADDRESS 0x40371E /end MEASUREMENT
/begin MEASUREMENT B_dfrmoff2 "frm-Offset-Schwelle ¸berschritten: zeigt Vorsteuerproblem Bank 2" UBYTE B_TRUE 1 100 0 1 BIT_MASK 0x1 FORMAT "%13.11" ECU_ADDRESS 0x40371F /end MEASUREMENT
/begin MEASUREMENT B_disae "Bedingung Fehler Endstufe Saugrohrumschaltung" UBYTE B_TRUE 1 100 0 1 BIT_MASK 0x1 FORMAT "%13.11" ECU_ADDRESS 0x402BFA /end MEASUREMENT
/begin MEASUREMENT B_disaok "Bedingung DISA-Signal ok" UBYTE B_TRUE 1 100 0 1 BIT_MASK 0x2 FORMAT "%13.11" ECU_ADDRESS 0x402BFA /end MEASUREMENT
/begin MEASUREMENT B_dlahimn "Bedingung: dlahii_w < SDLAOFMN" UBYTE B_TRUE 1 100 0 1 BIT_MASK 0x1 FORMAT "%13.11" ECU_ADDRESS 0x403B97 /end MEASUREMENT
/begin MEASUREMENT B_dlahimn2 "Bedingung: dlahii2_w < SDLAOFMN2, Bank 2" UBYTE B_TRUE 1 100 0 1 BIT_MASK 0x1 FORMAT "%13.11" ECU_ADDRESS 0x403B96 /end MEASUREMENT
/begin MEASUREMENT B_dlahimx "Bedingung: dlahii_w > SDLAOFMX" UBYTE B_TRUE 1 100 0 1 BIT_MASK 0x2 FORMAT "%13.11" ECU_ADDRESS 0x403B97 /end MEASUREMENT
/begin MEASUREMENT B_dlahimx2 "Bedingung: dlahii_w > SDLAOFMX2, Bank 2" UBYTE B_TRUE 1 100 0 1 BIT_MASK 0x2 FORMAT "%13.11" ECU_ADDRESS 0x403B96 /end MEASUREMENT
/begin MEASUREMENT B_dodsnl "Bedingung ob die Diagnose des Oeldruckschalters im Nachlauf noch zu rechnen ist" UBYTE B_TRUE 1 100 0 1 BIT_MASK 0x1 FORMAT "%13.11" ECU_ADDRESS 0x402BEC /end MEASUREMENT
/begin MEASUREMENT B_dsl "Bedingung Diagnoseanforderung" UBYTE B_TRUE 1 100 0 1 BIT_MASK 0x20 FORMAT "%13.11" ECU_ADDRESS 0x40371B /end MEASUREMENT
/begin MEASUREMENT B_dsl1 "Diagnose Phase 1: Bestimmung Sekund‰rluftmasse" UBYTE B_TRUE 1 100 0 1 BIT_MASK 0x1 FORMAT "%13.11" ECU_ADDRESS 0x3FC380 /end MEASUREMENT
/begin MEASUREMENT B_dsl1ab "Diagnose Phase 1: Abbruch Phase 1" UBYTE B_TRUE 1 100 0 1 BIT_MASK 0x20 FORMAT "%13.11" ECU_ADDRESS 0x40371C /end MEASUREMENT
/begin MEASUREMENT B_dsl1e "Diagnose Phase 1, Meﬂfreigabe Sekund‰rluftmasse" UBYTE B_TRUE 1 100 0 1 BIT_MASK 0x40 FORMAT "%13.11" ECU_ADDRESS 0x40371C /end MEASUREMENT
/begin MEASUREMENT B_dsl2 "Diagnose Phase 2: Ventildichtheit" UBYTE B_TRUE 1 100 0 1 BIT_MASK 0x80 FORMAT "%13.11" ECU_ADDRESS 0x40371C /end MEASUREMENT
/begin MEASUREMENT B_dsl2ab "Diagnose Phase 2: Abbruch Phase 2" UBYTE B_TRUE 1 100 0 1 BIT_MASK 0x1 FORMAT "%13.11" ECU_ADDRESS 0x40371D /end MEASUREMENT
/begin MEASUREMENT B_dsl2e "Diagnose Phase 2: Freigabe Messung" UBYTE B_TRUE 1 100 0 1 BIT_MASK 0x2 FORMAT "%13.11" ECU_ADDRESS 0x40371D /end MEASUREMENT
/begin MEASUREMENT B_dsl3 "Diagnose Phase3: Offset Sekund‰rluftmasse" UBYTE B_TRUE 1 100 0 1 BIT_MASK 0x4 FORMAT "%13.11" ECU_ADDRESS 0x40371D /end MEASUREMENT
/begin MEASUREMENT B_dsl3ab "Diagnose Phase 3: Abbruch" UBYTE B_TRUE 1 100 0 1 BIT_MASK 0x8 FORMAT "%13.11" ECU_ADDRESS 0x40371D /end MEASUREMENT
/begin MEASUREMENT B_dsl3e "Diagnose Phase 3: Freigabe Messung" UBYTE B_TRUE 1 100 0 1 BIT_MASK 0x10 FORMAT "%13.11" ECU_ADDRESS 0x40371D /end MEASUREMENT
/begin MEASUREMENT B_dsl4 "Bedingung Phase 4: Sekund‰rluftmasse aus Adaption/Zusatzdiagnose" UBYTE B_TRUE 1 100 0 1 BIT_MASK 0x1 FORMAT "%13.11" ECU_ADDRESS 0x3FC381 /end MEASUREMENT
/begin MEASUREMENT B_dsl45 "Diagnose Phase 4 oder Phase 5 aktiv" UBYTE B_TRUE 1 100 0 1 BIT_MASK 0x4 FORMAT "%13.11" ECU_ADDRESS 0x40371F /end MEASUREMENT
/begin MEASUREMENT B_dsl4ab "Bedingung: Abbruch Phase 4" UBYTE B_TRUE 1 100 0 1 BIT_MASK 0x80 FORMAT "%13.11" ECU_ADDRESS 0x40371D /end MEASUREMENT
/begin MEASUREMENT B_dsl4e "Bedingung: Phase 4 Freigabe Messung" UBYTE B_TRUE 1 100 0 1 BIT_MASK 0x1 FORMAT "%13.11" ECU_ADDRESS 0x40371E /end MEASUREMENT
/begin MEASUREMENT B_dsl5 "Diagnose Phase 5: Offset Sekund‰rluftmasse" UBYTE B_TRUE 1 100 0 1 BIT_MASK 0x2 FORMAT "%13.11" ECU_ADDRESS 0x40371E /end MEASUREMENT
/begin MEASUREMENT B_dsl5ab "Diagnose Phase 5: Abbruch" UBYTE B_TRUE 1 100 0 1 BIT_MASK 0x4 FORMAT "%13.11" ECU_ADDRESS 0x40371E /end MEASUREMENT
/begin MEASUREMENT B_dsl5dly "Verzˆgerung nach Diagnose Phase 5" UBYTE B_TRUE 1 100 0 1 BIT_MASK 0x2 FORMAT "%13.11" ECU_ADDRESS 0x40371F /end MEASUREMENT
/begin MEASUREMENT B_dsl5e "Diagnose Phase 5: Freigabe Messung" UBYTE B_TRUE 1 100 0 1 BIT_MASK 0x8 FORMAT "%13.11" ECU_ADDRESS 0x40371E /end MEASUREMENT
/begin MEASUREMENT B_dsla "Adaptionsphase: Bestimmung Sekund‰rluftmasse" UBYTE B_TRUE 1 100 0 1 BIT_MASK 0x1 FORMAT "%13.11" ECU_ADDRESS 0x3FC382 /end MEASUREMENT
/begin MEASUREMENT B_dslerr "Zusammenfassung Abbruchmerkmale Sekund‰rluftdiagnose" UBYTE B_TRUE 1 100 0 1 BIT_MASK 0x8 FORMAT "%13.11" ECU_ADDRESS 0x40371A /end MEASUREMENT
/begin MEASUREMENT B_dslfa "Bedingung: Anforderung SL-System f¸r Kurztest" UBYTE B_TRUE 1 100 0 1 BIT_MASK 0x1 FORMAT "%13.11" ECU_ADDRESS 0x3FC383 /end MEASUREMENT
/begin MEASUREMENT B_dslm "Diagnose Sekund‰rluftmasse" UBYTE B_TRUE 1 100 0 1 BIT_MASK 0x10 FORMAT "%13.11" ECU_ADDRESS 0x40371A /end MEASUREMENT
/begin MEASUREMENT B_dslmab "Diagnose Sekund‰rluftmasse, Meﬂabbruch" UBYTE B_TRUE 1 100 0 1 BIT_MASK 0x20 FORMAT "%13.11" ECU_ADDRESS 0x40371A /end MEASUREMENT
/begin MEASUREMENT B_dslme "Diagnose Sekund‰rluftmasse, Meﬂfreigabe" UBYTE B_TRUE 1 100 0 1 BIT_MASK 0x40 FORMAT "%13.11" ECU_ADDRESS 0x40371A /end MEASUREMENT
/begin MEASUREMENT B_dslmes "Bedingung: Freigabe Meﬂfenster" UBYTE B_TRUE 1 100 0 1 BIT_MASK 0x80 FORMAT "%13.11" ECU_ADDRESS 0x40371A /end MEASUREMENT
/begin MEASUREMENT B_dslo "Diagnose Sekund‰rluftmassenoffset" UBYTE B_TRUE 1 100 0 1 BIT_MASK 0x1 FORMAT "%13.11" ECU_ADDRESS 0x40371B /end MEASUREMENT
/begin MEASUREMENT B_dsloab "Diagnose Sekund‰rluftoffset, Meﬂabbruch" UBYTE B_TRUE 1 100 0 1 BIT_MASK 0x2 FORMAT "%13.11" ECU_ADDRESS 0x40371B /end MEASUREMENT
/begin MEASUREMENT B_dsloe "Diagnose Sekund‰rluftoffset, Meﬂfreigabe" UBYTE B_TRUE 1 100 0 1 BIT_MASK 0x4 FORMAT "%13.11" ECU_ADDRESS 0x40371B /end MEASUREMENT
/begin MEASUREMENT B_dslp4 "Bedingung  Phase 4 mindestens einmal eingeleitet" UBYTE B_TRUE 1 100 0 1 BIT_MASK 0x8 FORMAT "%13.11" ECU_ADDRESS 0x40371B /end MEASUREMENT
/begin MEASUREMENT B_dslp42 "Bedingung  Phase 4 mindestens einmal eingeleitet" UBYTE B_TRUE 1 100 0 1 BIT_MASK 0x1 FORMAT "%13.11" ECU_ADDRESS 0x403721 /end MEASUREMENT
/begin MEASUREMENT B_dsls "Aktive Diagnose: Sekund‰rluft-System" UBYTE B_TRUE 1 100 0 1 BIT_MASK 0x1 FORMAT "%13.11" ECU_ADDRESS 0x3FC384 /end MEASUREMENT
/begin MEASUREMENT B_dslsp4 "Bedingung: Anforderung SL-System f¸r Sekund‰rluftadaption/Zusatzdiagnose" UBYTE B_TRUE 1 100 0 1 BIT_MASK 0x1 FORMAT "%13.11" ECU_ADDRESS 0x3FC385 /end MEASUREMENT
/begin MEASUREMENT B_dsltab "Diagnose Ventilichtheit, Meﬂabbruch" UBYTE B_TRUE 1 100 0 1 BIT_MASK 0x80 FORMAT "%13.11" ECU_ADDRESS 0x40371B /end MEASUREMENT
/begin MEASUREMENT B_dslte "Diagnose Ventildichtheit, Meﬂfreigabe" UBYTE B_TRUE 1 100 0 1 BIT_MASK 0x2 FORMAT "%13.11" ECU_ADDRESS 0x40371C /end MEASUREMENT
/begin MEASUREMENT B_dspe "Bedingung Diagnose Sekund‰rluft ein" UBYTE B_TRUE 1 100 0 1 BIT_MASK 0x1 FORMAT "%13.11" ECU_ADDRESS 0x3FC386 /end MEASUREMENT
/begin MEASUREMENT B_dsper "Bedingung R¸cksetzen ESP ein" UBYTE B_TRUE 1 100 0 1 BIT_MASK 0x4 FORMAT "%13.11" ECU_ADDRESS 0x40371C /end MEASUREMENT
/begin MEASUREMENT B_dspes "Bedingung Setzen ESP ein" UBYTE B_TRUE 1 100 0 1 BIT_MASK 0x8 FORMAT "%13.11" ECU_ADDRESS 0x40371C /end MEASUREMENT
/begin MEASUREMENT B_dstaen "Bedingung Diagnose Startautomatik freigegeben" UBYTE B_TRUE 1 100 0 1 BIT_MASK 0x1 FORMAT "%13.11" ECU_ADDRESS 0x3FC043 /end MEASUREMENT
/begin MEASUREMENT B_edges "" UBYTE B_TRUE 1 100 0 1 BIT_MASK 0x1 FORMAT "%13.11" ECU_ADDRESS 0x3FBF23 /end MEASUREMENT
/begin MEASUREMENT B_elaof "Bedingung Error Lambda-Offset LSU" UBYTE B_TRUE 1 100 0 1 BIT_MASK 0x1 FORMAT "%13.11" ECU_ADDRESS 0x403B91 /end MEASUREMENT
/begin MEASUREMENT B_elaof2 "Bedingung Error Lambda-Offset LSU2" UBYTE B_TRUE 1 100 0 1 BIT_MASK 0x8 FORMAT "%13.11" ECU_ADDRESS 0x403B91 /end MEASUREMENT
/begin MEASUREMENT B_elaofmn "Bedingung: Fehler Offsetpr¸fung LSU zu fett" UBYTE B_TRUE 1 100 0 1 BIT_MASK 0x40 FORMAT "%13.11" ECU_ADDRESS 0x403B94 /end MEASUREMENT
/begin MEASUREMENT B_elaofmn2 "Bedingung: Fehler Offsetpr¸fung LSU zu fett, Bank 2" UBYTE B_TRUE 1 100 0 1 BIT_MASK 0x40 FORMAT "%13.11" ECU_ADDRESS 0x403B95 /end MEASUREMENT
/begin MEASUREMENT B_elaofmx "Bedingung: Fehler Offsetpr¸fung LSU zu mager" UBYTE B_TRUE 1 100 0 1 BIT_MASK 0x80 FORMAT "%13.11" ECU_ADDRESS 0x403B94 /end MEASUREMENT
/begin MEASUREMENT B_elaofmx2 "Bedingung: Fehler Offsetpr¸fung LSU zu mager, Bank 2" UBYTE B_TRUE 1 100 0 1 BIT_MASK 0x80 FORMAT "%13.11" ECU_ADDRESS 0x403B95 /end MEASUREMENT
/begin MEASUREMENT B_elue600 "Bedingung Variante E-L¸fter 600W" UBYTE B_TRUE 1 100 0 1 BIT_MASK 0x4 FORMAT "%13.11" ECU_ADDRESS 0x3FE0BF /end MEASUREMENT
/begin MEASUREMENT B_eluedet "Variantenerkennung E-L¸fter durchgef¸hrt" UBYTE B_TRUE 1 100 0 1 BIT_MASK 0x1 FORMAT "%13.11" ECU_ADDRESS 0x3FE0BF /end MEASUREMENT
/begin MEASUREMENT B_eluevar "Variantenbit f¸r E-L¸fter vorhanden" UBYTE B_TRUE 1 100 0 1 BIT_MASK 0x2 FORMAT "%13.11" ECU_ADDRESS 0x3FE0BF /end MEASUREMENT
/begin MEASUREMENT B_emnslve "Bendingung Kurzschluﬂ nach Masse Endstufe Sekund‰rluftventil" UWORD B_TRUE 1 100 0 1 BIT_MASK 0x200 FORMAT "%13.11" ECU_ADDRESS 0x403736 /end MEASUREMENT
/begin MEASUREMENT B_enph2bm "Freigabe der Phasenpegel¸berwachung an BM f¸r PG2 (nur Master)" UBYTE B_TRUE 1 100 0 1 BIT_MASK 0x2 FORMAT "%13.11" ECU_ADDRESS 0x403896 /end MEASUREMENT
/begin MEASUREMENT B_enph3bm "Freigabe der Phasenpegel¸berwachung an BM f¸r PG3 (nur Master)" UBYTE B_TRUE 1 100 0 1 BIT_MASK 0x4 FORMAT "%13.11" ECU_ADDRESS 0x403896 /end MEASUREMENT
/begin MEASUREMENT B_enph4bm "Freigabe der Phasenpegel¸berwachung an BM f¸r PG4 (nur Master)" UBYTE B_TRUE 1 100 0 1 BIT_MASK 0x8 FORMAT "%13.11" ECU_ADDRESS 0x403896 /end MEASUREMENT
/begin MEASUREMENT B_enphbm "Freigabe der Phasenpegel¸berwachung an BM f¸r PG1 (nur Master)" UBYTE B_TRUE 1 100 0 1 BIT_MASK 0x1 FORMAT "%13.11" ECU_ADDRESS 0x403896 /end MEASUREMENT
/begin MEASUREMENT B_enws "Bedingung Fehler Nockenwellenansteuerung liegt vor" UBYTE B_TRUE 1 100 0 1 BIT_MASK 0x1 FORMAT "%13.11" ECU_ADDRESS 0x403813 /end MEASUREMENT
/begin MEASUREMENT B_enwsa "Bedingung Error Nockenwelle (Auslaﬂsietig)" UBYTE B_TRUE 1 100 0 1 BIT_MASK 0x1 FORMAT "%13.11" ECU_ADDRESS 0x403814 /end MEASUREMENT
/begin MEASUREMENT B_enwse "Bedingung Error Nockenwelle (Einlaﬂseitig)" UBYTE B_TRUE 1 100 0 1 BIT_MASK 0x1 FORMAT "%13.11" ECU_ADDRESS 0x403815 /end MEASUREMENT
/begin MEASUREMENT B_errofs "Bedingung: zul‰ssige Sekund‰rluftmassen-Offset ¸berschritten" UBYTE B_TRUE 1 100 0 1 BIT_MASK 0x10 FORMAT "%13.11" ECU_ADDRESS 0x40371C /end MEASUREMENT
/begin MEASUREMENT B_errofs2 "Bedingung: max. zul‰ssiger Offsetwert ¸berschritten, Bank 2" UBYTE B_TRUE 1 100 0 1 BIT_MASK 0x1 FORMAT "%13.11" ECU_ADDRESS 0x403720 /end MEASUREMENT
/begin MEASUREMENT B_error1 "" UBYTE B_TRUE 1 100 0 1 BIT_MASK 0x1 FORMAT "%13.11" ECU_ADDRESS 0x3FBF24 /end MEASUREMENT
/begin MEASUREMENT B_error26 "" UBYTE B_TRUE 1 100 0 1 BIT_MASK 0x1 FORMAT "%13.11" ECU_ADDRESS 0x3FBF25 /end MEASUREMENT
/begin MEASUREMENT B_error3 "" UBYTE B_TRUE 1 100 0 1 BIT_MASK 0x1 FORMAT "%13.11" ECU_ADDRESS 0x3FBF26 /end MEASUREMENT
/begin MEASUREMENT B_error5 "" UBYTE B_TRUE 1 100 0 1 BIT_MASK 0x1 FORMAT "%13.11" ECU_ADDRESS 0x3FBF27 /end MEASUREMENT
/begin MEASUREMENT B_error7 "" UBYTE B_TRUE 1 100 0 1 BIT_MASK 0x1 FORMAT "%13.11" ECU_ADDRESS 0x3FBF28 /end MEASUREMENT
/begin MEASUREMENT B_error8 "" UBYTE B_TRUE 1 100 0 1 BIT_MASK 0x1 FORMAT "%13.11" ECU_ADDRESS 0x3FBF29 /end MEASUREMENT
/begin MEASUREMENT B_eslpe "Bedingung Endstufenfehler Sekund‰rluftpumpe" UWORD B_TRUE 1 100 0 1 BIT_MASK 0x80 FORMAT "%13.11" ECU_ADDRESS 0x403736 /end MEASUREMENT
/begin MEASUREMENT B_esls "Bedingung Falschluft durch Fehler im Sekund‰rluftsystem" UBYTE B_TRUE 1 100 0 1 BIT_MASK 0x1 FORMAT "%13.11" ECU_ADDRESS 0x3FC387 /end MEASUREMENT
/begin MEASUREMENT B_eslsp "lokales Errorflag: Sekund‰rluft-System" UBYTE B_TRUE 1 100 0 1 BIT_MASK 0x10 FORMAT "%13.11" ECU_ADDRESS 0x40371F /end MEASUREMENT
/begin MEASUREMENT B_eslsp2 "lokales Errorflag: Sekund‰rluft-System, Bank 2" UBYTE B_TRUE 1 100 0 1 BIT_MASK 0x8 FORMAT "%13.11" ECU_ADDRESS 0x403720 /end MEASUREMENT
/begin MEASUREMENT B_eslv1tst "Slavetest 1 ist ein/ausgeschaltet" UBYTE B_TRUE 1 100 0 1 BIT_MASK 0x4 FORMAT "%13.11" ECU_ADDRESS 0x40297F /end MEASUREMENT
/begin MEASUREMENT B_eslv2tst "Slavetest 2 ist ein/ausgeschaltet" UBYTE B_TRUE 1 100 0 1 BIT_MASK 0x20 FORMAT "%13.11" ECU_ADDRESS 0x40297F /end MEASUREMENT
/begin MEASUREMENT B_eslv3tst "Slavetest 3 ist ein/ausgeschaltet" UBYTE B_TRUE 1 100 0 1 BIT_MASK 0x1 FORMAT "%13.11" ECU_ADDRESS 0x402980 /end MEASUREMENT
/begin MEASUREMENT B_eslv4tst "Slavetest 4 ist ein/ausgeschaltet" UBYTE B_TRUE 1 100 0 1 BIT_MASK 0x8 FORMAT "%13.11" ECU_ADDRESS 0x402980 /end MEASUREMENT
/begin MEASUREMENT B_eslve "Bedingung Endstufenfehler Sekund‰rluftventil" UWORD B_TRUE 1 100 0 1 BIT_MASK 0x100 FORMAT "%13.11" ECU_ADDRESS 0x403736 /end MEASUREMENT
/begin MEASUREMENT B_eslvp "lokale Errorflag: Sekund‰rluftventil" UBYTE B_TRUE 1 100 0 1 BIT_MASK 0x20 FORMAT "%13.11" ECU_ADDRESS 0x40371D /end MEASUREMENT
/begin MEASUREMENT B_eslvp2 "lokale Errorflag: Sekund‰rluftventil, Bank 2" UBYTE B_TRUE 1 100 0 1 BIT_MASK 0x40 FORMAT "%13.11" ECU_ADDRESS 0x403720 /end MEASUREMENT
/begin MEASUREMENT B_ez "Verbot des gesamten Motorlaufs (MOTRONIC bleibt in Zahnentprellphase" UBYTE B_TRUE 1 100 0 1 BIT_MASK 0x1 FORMAT "%13.11" ECU_ADDRESS 0x3FE91E /end MEASUREMENT
/begin MEASUREMENT B_faslarq "Bedingung: lokale Anforderung Testdurchlauf Sekund‰rluft starten" UBYTE B_TRUE 1 100 0 1 BIT_MASK 0x40 FORMAT "%13.11" ECU_ADDRESS 0x40371E /end MEASUREMENT
/begin MEASUREMENT B_fodon "Bedingung fuel-on Adaption in drehzahldominantem Bereich aktiv" UBYTE B_TRUE 1 100 0 1 BIT_MASK 0x20 FORMAT "%13.11" ECU_ADDRESS 0x40383B /end MEASUREMENT
/begin MEASUREMENT B_fofdr "Bedingung fuel-off Adaption im dominanten Drehzahlbereich ready" UBYTE B_TRUE 1 100 0 1 BIT_MASK 0x1 FORMAT "%13.11" ECU_ADDRESS 0x3FDF0C /end MEASUREMENT
/begin MEASUREMENT B_fofr "Bedingung fuel-off Adaption im aktuellen Drehzahlbereich ready" UBYTE B_TRUE 1 100 0 1 BIT_MASK 0x1 FORMAT "%13.11" ECU_ADDRESS 0x3FBEFF /end MEASUREMENT
/begin MEASUREMENT B_fofr1 "Drehzahlbereich 1 fertig gelernt (ready)" UBYTE B_TRUE 1 100 0 1 BIT_MASK 0x1 FORMAT "%13.11" ECU_ADDRESS 0x3FDF0D /end MEASUREMENT
/begin MEASUREMENT B_fofrun "Status fuel-off Adaption aktiv" UBYTE B_TRUE 1 100 0 1 BIT_MASK 0x1 FORMAT "%13.11" ECU_ADDRESS 0x3FBF00 /end MEASUREMENT
/begin MEASUREMENT B_fofrun0 "Bedingungen f¸r Fuel-off Adaption erf¸llt" UBYTE B_TRUE 1 100 0 1 BIT_MASK 0x1 FORMAT "%13.11" ECU_ADDRESS 0x3FBF01 /end MEASUREMENT
/begin MEASUREMENT B_fofstp "Bedingung fuel-off Adaption gestoppt" UBYTE B_TRUE 1 100 0 1 BIT_MASK 0x1 FORMAT "%13.11" ECU_ADDRESS 0x3FBF2A /end MEASUREMENT
/begin MEASUREMENT B_fohe "aktueller Bereich ist ein Heilbereich" UBYTE B_TRUE 1 100 0 1 BIT_MASK 0x40 FORMAT "%13.11" ECU_ADDRESS 0x40383B /end MEASUREMENT
/begin MEASUREMENT B_fohold "fuel-on Adaption angehalten" UBYTE B_TRUE 1 100 0 1 BIT_MASK 0x80 FORMAT "%13.11" ECU_ADDRESS 0x40383B /end MEASUREMENT
/begin MEASUREMENT B_fokstp "Bedingung fuel-on Adaption gestoppt (Adaption + Korrektur)" UBYTE B_TRUE 1 100 0 1 BIT_MASK 0x1 FORMAT "%13.11" ECU_ADDRESS 0x3FBF2B /end MEASUREMENT
/begin MEASUREMENT B_folunw "Bedingung Laufunruhe zu groﬂ f¸r fuel-on/-off Adaption" UBYTE B_TRUE 1 100 0 1 BIT_MASK 0x1 FORMAT "%13.11" ECU_ADDRESS 0x3FBF02 /end MEASUREMENT
/begin MEASUREMENT B_fomod "zeigt Modus der fuel-on/-off Adaption (Codewort CDFOMOD)" UBYTE B_TRUE 1 100 0 1 BIT_MASK 0x1 FORMAT "%13.11" ECU_ADDRESS 0x3FBF03 /end MEASUREMENT
/begin MEASUREMENT B_fondis "Bedingung fuel-on Adaption gestoppt" UBYTE B_TRUE 1 100 0 1 BIT_MASK 0x1 FORMAT "%13.11" ECU_ADDRESS 0x40383C /end MEASUREMENT
/begin MEASUREMENT B_fonresd "Anforderung Reset der Fuel-On Adaption durchf¸hren" UBYTE B_TRUE 1 100 0 1 BIT_MASK 0x1 FORMAT "%13.11" ECU_ADDRESS 0x3FBF04 /end MEASUREMENT
/begin MEASUREMENT B_fonresf "Reset der Fuel-On Adaption durchgef¸hrt" UBYTE B_TRUE 1 100 0 1 BIT_MASK 0x1 FORMAT "%13.11" ECU_ADDRESS 0x3FBF09 /end MEASUREMENT
/begin MEASUREMENT B_fonrset "Reset der fuel-on Adaption" UBYTE B_TRUE 1 100 0 1 BIT_MASK 0x4 FORMAT "%13.11" ECU_ADDRESS 0x40383C /end MEASUREMENT
/begin MEASUREMENT B_fonstp "Bedingung fuel-on Adaption gestoppt" UBYTE B_TRUE 1 100 0 1 BIT_MASK 0x1 FORMAT "%13.11" ECU_ADDRESS 0x3FBF2C /end MEASUREMENT
/begin MEASUREMENT B_fontm "Motortemperatur gen¸gend hoch f¸r fuel-on-Adaption" UBYTE B_TRUE 1 100 0 1 BIT_MASK 0x1 FORMAT "%13.11" ECU_ADDRESS 0x3FBF2D /end MEASUREMENT
/begin MEASUREMENT B_for "Bedingung fuel-on/-off Adaption aktuell ready" UBYTE B_TRUE 1 100 0 1 BIT_MASK 0x10 FORMAT "%13.11" ECU_ADDRESS 0x40383B /end MEASUREMENT
/begin MEASUREMENT B_fora "Bedingung fuel-on Adaption aktuell ready (Array)" UBYTE default 1 100 0 1 FORMAT "%5.3" ARRAY_SIZE 24 ECU_ADDRESS 0x3FDFD4 /end MEASUREMENT
/begin MEASUREMENT B_fora_old "" SBYTE default 1 100 0 1 FORMAT "%5.3" ARRAY_SIZE 24 ECU_ADDRESS 0x3FDFEC /end MEASUREMENT
/begin MEASUREMENT B_forn "Bedingung fuel-on/-off Adaption aktueller Drehzahlbereich ready" UBYTE B_TRUE 1 100 0 1 BIT_MASK 0x8 FORMAT "%13.11" ECU_ADDRESS 0x40383B /end MEASUREMENT
/begin MEASUREMENT B_forna "Bedingung fuel-on Adaption aktueller Drehzahlbereich ready (Array)" UBYTE default 1 100 0 1 FORMAT "%5.3" ARRAY_SIZE 9 ECU_ADDRESS 0x3FE004 /end MEASUREMENT
/begin MEASUREMENT B_forun "Status fuel-on/-off Adaption aktiv" UBYTE B_TRUE 1 100 0 1 BIT_MASK 0x4 FORMAT "%13.11" ECU_ADDRESS 0x40383B /end MEASUREMENT
/begin MEASUREMENT B_forun0 "Status fuel-on/-off Adaption aktiv" UBYTE B_TRUE 1 100 0 1 BIT_MASK 0x2 FORMAT "%13.11" ECU_ADDRESS 0x40383B /end MEASUREMENT
/begin MEASUREMENT B_fph1bm "Fehler des Phasenpegels an der Bezugsmarke von PG1" UBYTE B_TRUE 1 100 0 1 BIT_MASK 0x4 FORMAT "%13.11" ECU_ADDRESS 0x40297E /end MEASUREMENT
/begin MEASUREMENT B_fph2bm "Fehler des Phasenpegels an der Bezugsmarke von PG2" UBYTE B_TRUE 1 100 0 1 BIT_MASK 0x8 FORMAT "%13.11" ECU_ADDRESS 0x40297E /end MEASUREMENT
/begin MEASUREMENT B_fph3bm "Fehler des Phasenpegels an der Bezugsmarke von PG3" UBYTE B_TRUE 1 100 0 1 BIT_MASK 0x10 FORMAT "%13.11" ECU_ADDRESS 0x40297E /end MEASUREMENT
/begin MEASUREMENT B_fph4bm "Fehler des Phasenpegels an der Bezugsmarke von PG4" UBYTE B_TRUE 1 100 0 1 BIT_MASK 0x20 FORMAT "%13.11" ECU_ADDRESS 0x40297E /end MEASUREMENT
/begin MEASUREMENT B_healed1 "Signalfehler zu PH1 wurde schon einmal geheilt" UBYTE B_TRUE 1 100 0 1 BIT_MASK 0x10 FORMAT "%13.11" ECU_ADDRESS 0x40297F /end MEASUREMENT
/begin MEASUREMENT B_healed2 "Signalfehler zu PH2 wurde schon einmal geheilt" UBYTE B_TRUE 1 100 0 1 BIT_MASK 0x40 FORMAT "%13.11" ECU_ADDRESS 0x40297F /end MEASUREMENT
/begin MEASUREMENT B_healed3 "Signalfehler zu PH3 wurde schon einmal geheilt" UBYTE B_TRUE 1 100 0 1 BIT_MASK 0x2 FORMAT "%13.11" ECU_ADDRESS 0x402980 /end MEASUREMENT
/begin MEASUREMENT B_healed4 "Signalfehler zu PH4 wurde schon einmal geheilt" UBYTE B_TRUE 1 100 0 1 BIT_MASK 0x10 FORMAT "%13.11" ECU_ADDRESS 0x402980 /end MEASUREMENT
/begin MEASUREMENT B_helsuf "Bedingung Freigabe Heilung LSU" UBYTE B_TRUE 1 100 0 1 BIT_MASK 0x1 FORMAT "%13.11" ECU_ADDRESS 0x403B92 /end MEASUREMENT
/begin MEASUREMENT B_helsuf2 "Bedingung Freigabe Heilung LSU 2" UBYTE B_TRUE 1 100 0 1 BIT_MASK 0x1 FORMAT "%13.11" ECU_ADDRESS 0x403B93 /end MEASUREMENT
/begin MEASUREMENT B_hepllsu "Bedingung: Heilung Plausibilit‰tsdiagnose der LSU" UBYTE B_TRUE 1 100 0 1 BIT_MASK 0x2 FORMAT "%13.11" ECU_ADDRESS 0x403B92 /end MEASUREMENT
/begin MEASUREMENT B_hepllsu2 "Bedingung: Heilung Plausibilit‰tsdiagnose der LSU, Bank 2" UBYTE B_TRUE 1 100 0 1 BIT_MASK 0x2 FORMAT "%13.11" ECU_ADDRESS 0x403B93 /end MEASUREMENT
/begin MEASUREMENT B_hpllsue "Bedingung, Heizung im DPLLSU l‰uft" UBYTE B_TRUE 1 100 0 1 BIT_MASK 0x4 FORMAT "%13.11" ECU_ADDRESS 0x403B97 /end MEASUREMENT
/begin MEASUREMENT B_hpllsue2 "Bedingung, Heizung im DPLLSU l‰uft, Bank2" UBYTE B_TRUE 1 100 0 1 BIT_MASK 0x4 FORMAT "%13.11" ECU_ADDRESS 0x403B96 /end MEASUREMENT
/begin MEASUREMENT B_idxfof1 "Bedingung Betriebspunkt im 1. Drehzahhlbereich" UBYTE B_TRUE 1 100 0 1 BIT_MASK 0x1 FORMAT "%13.11" ECU_ADDRESS 0x3FBF05 /end MEASUREMENT
/begin MEASUREMENT B_ivzabg1 "Erstes 1000 KWU Intervall nach Start aktiv" UBYTE B_TRUE 1 100 0 1 BIT_MASK 0x1 FORMAT "%13.11" ECU_ADDRESS 0x3FBF13 /end MEASUREMENT
/begin MEASUREMENT B_ivzkat1 "Bedingung Intervallende ersten 200 KWU" UBYTE B_TRUE 1 100 0 1 BIT_MASK 0x1 FORMAT "%13.11" ECU_ADDRESS 0x3FBF14 /end MEASUREMENT
/begin MEASUREMENT B_katvar "Bit Umschaltung von KAT Variante" UBYTE B_TRUE 1 100 0 1 BIT_MASK 0x1 FORMAT "%13.11" ECU_ADDRESS 0x3FBEF5 /end MEASUREMENT
/begin MEASUREMENT B_kmmil "MIL-Ansteuerung mit Relevanz zu Kilometererfassung" UBYTE B_TRUE 1 100 0 1 BIT_MASK 0x1 FORMAT "%13.11" ECU_ADDRESS 0x3FBEF6 /end MEASUREMENT
/begin MEASUREMENT B_kuppssg "Bedingung Kupplungspedal fallende Flanke" UBYTE B_TRUE 1 100 0 1 BIT_MASK 0x1 FORMAT "%13.11" ECU_ADDRESS 0x3FBF2E /end MEASUREMENT
/begin MEASUREMENT B_lcmnanw "lokales Bit f¸r min.Fehler der NWS (Auslaﬂ, Bank1)" UBYTE B_TRUE 1 100 0 1 BIT_MASK 0x4 FORMAT "%13.11" ECU_ADDRESS 0x40368F /end MEASUREMENT
/begin MEASUREMENT B_lcmnanw2 "lokales Bit f¸r min.Fehler der NWS (Auslaﬂ, Bank2)" UBYTE B_TRUE 1 100 0 1 BIT_MASK 0x10 FORMAT "%13.11" ECU_ADDRESS 0x40368F /end MEASUREMENT
/begin MEASUREMENT B_lcmnenw "lokales Bit f¸r min.Fehler der NWS (Einlaﬂ, Bank1)" UBYTE B_TRUE 1 100 0 1 BIT_MASK 0x4 FORMAT "%13.11" ECU_ADDRESS 0x403690 /end MEASUREMENT
/begin MEASUREMENT B_lcmnenw2 "lokales Bit f¸r min.Fehler der NWS (Einlaﬂ, Bank2)" UBYTE B_TRUE 1 100 0 1 BIT_MASK 0x10 FORMAT "%13.11" ECU_ADDRESS 0x403690 /end MEASUREMENT
/begin MEASUREMENT B_lcnpanw "lokales Bit f¸r NP-Fehler der NWS (Auslaﬂ, Bank1)" UBYTE B_TRUE 1 100 0 1 BIT_MASK 0x8 FORMAT "%13.11" ECU_ADDRESS 0x40368F /end MEASUREMENT
/begin MEASUREMENT B_lcnpanw2 "lokales Bit f¸r NP-Fehler der NWS (Auslaﬂ, Bank2)" UBYTE B_TRUE 1 100 0 1 BIT_MASK 0x20 FORMAT "%13.11" ECU_ADDRESS 0x40368F /end MEASUREMENT
/begin MEASUREMENT B_lcnpenw "Lokales Bit f¸r NP-Fehler der NWS (Einlaﬂ, Bank1)" UBYTE B_TRUE 1 100 0 1 BIT_MASK 0x8 FORMAT "%13.11" ECU_ADDRESS 0x403690 /end MEASUREMENT
/begin MEASUREMENT B_lcnpenw2 "lokales Bit f¸r NP-Fehler der NWS (Einlaﬂ, Bank2)" UBYTE B_TRUE 1 100 0 1 BIT_MASK 0x20 FORMAT "%13.11" ECU_ADDRESS 0x403690 /end MEASUREMENT
/begin MEASUREMENT B_lshkpft "Bedingung Lambdasondensignal hinter dem Kat. plausibel fett" UBYTE B_TRUE 1 100 0 1 BIT_MASK 0x8 FORMAT "%13.11" ECU_ADDRESS 0x403B92 /end MEASUREMENT
/begin MEASUREMENT B_lshkpft2 "Bedingung Lambdasondensignal hinter dem Kat. plausibel fett, Bank 2" UBYTE B_TRUE 1 100 0 1 BIT_MASK 0x8 FORMAT "%13.11" ECU_ADDRESS 0x403B93 /end MEASUREMENT
/begin MEASUREMENT B_lshkpmr "Bedingung Lambdasondensignal hinter dem Kat. plausibel mager" UBYTE B_TRUE 1 100 0 1 BIT_MASK 0x10 FORMAT "%13.11" ECU_ADDRESS 0x403B92 /end MEASUREMENT
/begin MEASUREMENT B_lshkpmr2 "Bedingung Lambdasondensignal hinter dem Kat. plausibel mager, Bank 2" UBYTE B_TRUE 1 100 0 1 BIT_MASK 0x10 FORMAT "%13.11" ECU_ADDRESS 0x403B93 /end MEASUREMENT
/begin MEASUREMENT B_lsuft "LSU Bank1 fett, nicht plausibel" UBYTE B_TRUE 1 100 0 1 BIT_MASK 0x20 FORMAT "%13.11" ECU_ADDRESS 0x403B92 /end MEASUREMENT
/begin MEASUREMENT B_lsuft2 "LSU Bank2 fett, nicht plausibel" UBYTE B_TRUE 1 100 0 1 BIT_MASK 0x20 FORMAT "%13.11" ECU_ADDRESS 0x403B93 /end MEASUREMENT
/begin MEASUREMENT B_lsufta "LSU Bank1 fett, nicht plausibel" UBYTE B_TRUE 1 100 0 1 BIT_MASK 0x40 FORMAT "%13.11" ECU_ADDRESS 0x403B92 /end MEASUREMENT
/begin MEASUREMENT B_lsufta2 "LSU Bank2 fett, nicht plausibel" UBYTE B_TRUE 1 100 0 1 BIT_MASK 0x40 FORMAT "%13.11" ECU_ADDRESS 0x403B93 /end MEASUREMENT
/begin MEASUREMENT B_lsuftb "LSU Bank1 fett, nicht plausibel" UBYTE B_TRUE 1 100 0 1 BIT_MASK 0x80 FORMAT "%13.11" ECU_ADDRESS 0x403B92 /end MEASUREMENT
/begin MEASUREMENT B_lsuftb2 "LSU Bank2 fett, nicht plausibel" UBYTE B_TRUE 1 100 0 1 BIT_MASK 0x80 FORMAT "%13.11" ECU_ADDRESS 0x403B93 /end MEASUREMENT
/begin MEASUREMENT B_lsulone "Bedingung Lambdasondensignal ist Lambda = 1" UBYTE B_TRUE 1 100 0 1 BIT_MASK 0x4 FORMAT "%13.11" ECU_ADDRESS 0x403B91 /end MEASUREMENT
/begin MEASUREMENT B_lsulone2 "Bedingung Lambdasondensignal ist Lambda = 1, Bank 2" UBYTE B_TRUE 1 100 0 1 BIT_MASK 0x20 FORMAT "%13.11" ECU_ADDRESS 0x403B91 /end MEASUREMENT
/begin MEASUREMENT B_lsumr "LSU Bank1 mager, nicht plausibel" UBYTE B_TRUE 1 100 0 1 BIT_MASK 0x1 FORMAT "%13.11" ECU_ADDRESS 0x403B94 /end MEASUREMENT
/begin MEASUREMENT B_lsumr2 "LSU Bank2 mager, nicht plausibel" UBYTE B_TRUE 1 100 0 1 BIT_MASK 0x1 FORMAT "%13.11" ECU_ADDRESS 0x403B95 /end MEASUREMENT
/begin MEASUREMENT B_lsumra "LSU Bank1 mager, nicht plausibel" UBYTE B_TRUE 1 100 0 1 BIT_MASK 0x2 FORMAT "%13.11" ECU_ADDRESS 0x403B94 /end MEASUREMENT
/begin MEASUREMENT B_lsumra2 "LSU Bank2 mager, nicht plausibel" UBYTE B_TRUE 1 100 0 1 BIT_MASK 0x2 FORMAT "%13.11" ECU_ADDRESS 0x403B95 /end MEASUREMENT
/begin MEASUREMENT B_lsumrb "LSU Bank1 mager, nicht plausibel" UBYTE B_TRUE 1 100 0 1 BIT_MASK 0x4 FORMAT "%13.11" ECU_ADDRESS 0x403B94 /end MEASUREMENT
/begin MEASUREMENT B_lsumrb2 "LSU Bank2 mager, nicht plausibel" UBYTE B_TRUE 1 100 0 1 BIT_MASK 0x4 FORMAT "%13.11" ECU_ADDRESS 0x403B95 /end MEASUREMENT
/begin MEASUREMENT B_lsuoffe "Bedingung, Zeitentprellung f¸r Offsetdiagnose abgelaufen" UBYTE B_TRUE 1 100 0 1 BIT_MASK 0x8 FORMAT "%13.11" ECU_ADDRESS 0x403B97 /end MEASUREMENT
/begin MEASUREMENT B_lsuoffe2 "Bedingung, Zeitentprellung f¸r Offsetdiagnose abgelaufen, Bank2" UBYTE B_TRUE 1 100 0 1 BIT_MASK 0x8 FORMAT "%13.11" ECU_ADDRESS 0x403B96 /end MEASUREMENT
/begin MEASUREMENT B_lsuoffs "Bedingung: Offsetfehler bei der LSU" UBYTE B_TRUE 1 100 0 1 BIT_MASK 0x8 FORMAT "%13.11" ECU_ADDRESS 0x403B94 /end MEASUREMENT
/begin MEASUREMENT B_lsuoffs2 "Bedingung: Offsetfehler bei der LSU, Bank 2" UBYTE B_TRUE 1 100 0 1 BIT_MASK 0x8 FORMAT "%13.11" ECU_ADDRESS 0x403B95 /end MEASUREMENT
/begin MEASUREMENT B_lsupft "Bedingung Lambdasondensignal plausibel fett" UBYTE B_TRUE 1 100 0 1 BIT_MASK 0x10 FORMAT "%13.11" ECU_ADDRESS 0x403B94 /end MEASUREMENT
/begin MEASUREMENT B_lsupft2 "Bedingung Lambdasondensignal plausibel fett, Bank 2" UBYTE B_TRUE 1 100 0 1 BIT_MASK 0x10 FORMAT "%13.11" ECU_ADDRESS 0x403B95 /end MEASUREMENT
/begin MEASUREMENT B_lsupmr "Bedingung Lambdasondensignal plausibel mager" UBYTE B_TRUE 1 100 0 1 BIT_MASK 0x20 FORMAT "%13.11" ECU_ADDRESS 0x403B94 /end MEASUREMENT
/begin MEASUREMENT B_lsupmr2 "Bedingung Lambdasondensignal plausibel mager, Bank 2" UBYTE B_TRUE 1 100 0 1 BIT_MASK 0x20 FORMAT "%13.11" ECU_ADDRESS 0x403B95 /end MEASUREMENT
/begin MEASUREMENT B_luaerk "Aussetzer erkannt ¸ber Laufunruhe Abstandsmass, aus DMDLUA" UBYTE B_TRUE 1 100 0 1 BIT_MASK 0x1 FORMAT "%13.11" ECU_ADDRESS 0x403786 /end MEASUREMENT
/begin MEASUREMENT B_luerk "Aussetzer erkannt, aus DMDLU" UBYTE B_TRUE 1 100 0 1 BIT_MASK 0x1 FORMAT "%13.11" ECU_ADDRESS 0x3FBF0C /end MEASUREMENT
/begin MEASUREMENT B_lustop "Laufunruhe-Berechnung gesperrt" UBYTE B_TRUE 1 100 0 1 BIT_MASK 0x1 FORMAT "%13.11" ECU_ADDRESS 0x3FBF2F /end MEASUREMENT
/begin MEASUREMENT B_lustops "Laufunruhe-Berechnung gesperrt, nicht synchronisiert mit luts delay" UBYTE B_TRUE 1 100 0 1 BIT_MASK 0x1 FORMAT "%13.11" ECU_ADDRESS 0x3FBF30 /end MEASUREMENT
/begin MEASUREMENT B_mdarv "kritische Aussetzerrate vorhanden" UBYTE B_TRUE 1 100 0 1 BIT_MASK 0x1 FORMAT "%13.11" ECU_ADDRESS 0x403788 /end MEASUREMENT
/begin MEASUREMENT B_mddrla "Bedingung Misfire Detection Lastgradient f¸r Aussetzererkennung" UBYTE B_TRUE 1 100 0 1 BIT_MASK 0x1 FORMAT "%13.11" ECU_ADDRESS 0x3FBF31 /end MEASUREMENT
/begin MEASUREMENT B_mderk "Aussetzer erkannt, Verkn¸pfung mehrerer Funktionen" UBYTE B_TRUE 1 100 0 1 BIT_MASK 0x2 FORMAT "%13.11" ECU_ADDRESS 0x40384C /end MEASUREMENT
/begin MEASUREMENT B_mdkat "Katsch‰digende Aussetzerrate ¸berschritten (zur Ausblendung anderer Funktionen)" UBYTE B_TRUE 1 100 0 1 BIT_MASK 0x1 FORMAT "%13.11" ECU_ADDRESS 0x403789 /end MEASUREMENT
/begin MEASUREMENT B_mdmi "Bedingung Misfire Detection untere Lastgrenze" UBYTE B_TRUE 1 100 0 1 BIT_MASK 0x1 FORMAT "%13.11" ECU_ADDRESS 0x3FBF32 /end MEASUREMENT
/begin MEASUREMENT B_mdng "Bedingung Misfire Detection Drehzahlgradient f¸r Aussetzererkennung" UBYTE B_TRUE 1 100 0 1 BIT_MASK 0x1 FORMAT "%13.11" ECU_ADDRESS 0x3FBF33 /end MEASUREMENT
/begin MEASUREMENT B_mdnmn "Bedingung Misfire Detection untere Drehzahlgrenze" UBYTE B_TRUE 1 100 0 1 BIT_MASK 0x1 FORMAT "%13.11" ECU_ADDRESS 0x3FBF34 /end MEASUREMENT
/begin MEASUREMENT B_mdnmx "Bedingung Misfire Detection obere Drehzahlgrenze" UBYTE B_TRUE 1 100 0 1 BIT_MASK 0x1 FORMAT "%13.11" ECU_ADDRESS 0x3FBF35 /end MEASUREMENT
/begin MEASUREMENT B_mdstim "Z¸ndungs-Aussetzer eingestellt, Stimuli-Signal vom Aussetzergenerator" UBYTE B_TRUE 1 100 0 1 BIT_MASK 0x1 FORMAT "%13.11" ECU_ADDRESS 0x40384E /end MEASUREMENT
/begin MEASUREMENT B_mdstop "Misfire Detection gesperrt" UBYTE B_TRUE 1 100 0 1 BIT_MASK 0x1 FORMAT "%13.11" ECU_ADDRESS 0x3FBF36 /end MEASUREMENT
/begin MEASUREMENT B_mdtnst "Bedingung Misfire Detection Zeit nach Startende" UBYTE B_TRUE 1 100 0 1 BIT_MASK 0x1 FORMAT "%13.11" ECU_ADDRESS 0x3FBF37 /end MEASUREMENT
/begin MEASUREMENT B_mdzag "Bedingung Aussetzer angefordert, Stimuli-Signal vom SW - Aussetzergenerator" UBYTE B_TRUE 1 100 0 1 BIT_MASK 0x1 FORMAT "%13.11" ECU_ADDRESS 0x3FBF70 /end MEASUREMENT
/begin MEASUREMENT B_mdzgstp "Aussetzererkennung und Zylindergleichstellung gesperrt" UBYTE B_TRUE 1 100 0 1 BIT_MASK 0x1 FORMAT "%13.11" ECU_ADDRESS 0x3FBF38 /end MEASUREMENT
/begin MEASUREMENT B_mdzyl1 "Zyl.-Kennung (f. Zeit>TALUST), LU-Berechng. gesperrt (f. Zeit<TALUST)" UBYTE B_TRUE 1 100 0 1 BIT_MASK 0x1 FORMAT "%13.11" ECU_ADDRESS 0x3FBF06 /end MEASUREMENT
/begin MEASUREMENT B_meaoper "ml-/nmot-/rl-Bedingung: Freigabe Meﬂfenster in Block MEASURE" UBYTE B_TRUE 1 100 0 1 BIT_MASK 0x80 FORMAT "%13.11" ECU_ADDRESS 0x40371F /end MEASUREMENT
/begin MEASUREMENT B_mil "MIL-Ansteuerung" UBYTE B_TRUE 1 100 0 1 BIT_MASK 0x1 FORMAT "%13.11" ECU_ADDRESS 0x3FBEF7 /end MEASUREMENT
/begin MEASUREMENT B_milblk "MIL-Ansteuerung blinkend" UBYTE B_TRUE 1 100 0 1 BIT_MASK 0x8 FORMAT "%13.11" ECU_ADDRESS 0x403B2E /end MEASUREMENT
/begin MEASUREMENT B_mileb "MIL-Ansteuerung eigenbestimmt" UBYTE B_TRUE 1 100 0 1 BIT_MASK 0x2 FORMAT "%13.11" ECU_ADDRESS 0x403B2E /end MEASUREMENT
/begin MEASUREMENT B_milmd "MIL-Ansteuerung an durch Aussetzererkennung, bei ti-Abschaltung" UBYTE B_TRUE 1 100 0 1 BIT_MASK 0x1 FORMAT "%13.11" ECU_ADDRESS 0x40378A /end MEASUREMENT
/begin MEASUREMENT B_milst "MIL-Ansteuerung Prueffunktion bei Start" UBYTE B_TRUE 1 100 0 1 BIT_MASK 0x1 FORMAT "%13.11" ECU_ADDRESS 0x403B2E /end MEASUREMENT
/begin MEASUREMENT B_milstat "MIL - Status f¸r Scan Tool Mode $01 PID $01" UBYTE B_TRUE 1 100 0 1 BIT_MASK 0x1 FORMAT "%13.11" ECU_ADDRESS 0x3FBEF8 /end MEASUREMENT
/begin MEASUREMENT B_milstp "Auswertung Aussetzererkennung (%DMDMIL) gesperrt" UBYTE B_TRUE 1 100 0 1 BIT_MASK 0x1 FORMAT "%13.11" ECU_ADDRESS 0x3FBF39 /end MEASUREMENT
/begin MEASUREMENT B_milstps "Auswertung Aussetzererkennung (%DMDMIL) gesperrt, nicht synchronisiert mit luts" UBYTE B_TRUE 1 100 0 1 BIT_MASK 0x1 FORMAT "%13.11" ECU_ADDRESS 0x3FBF3A /end MEASUREMENT
/begin MEASUREMENT B_mnslspr "Fehlerart lokal: Sekund‰rluftmasse zu gering" UBYTE B_TRUE 1 100 0 1 BIT_MASK 0x8 FORMAT "%13.11" ECU_ADDRESS 0x40371F /end MEASUREMENT
/begin MEASUREMENT B_mnslspr2 "Fehlerart lokal: Sekund‰rluftmasse zu gering, Bank 2" UBYTE B_TRUE 1 100 0 1 BIT_MASK 0x4 FORMAT "%13.11" ECU_ADDRESS 0x403720 /end MEASUREMENT
/begin MEASUREMENT B_mslmin "Bedingung sehr geringe Sekund‰rluftmasse aus Meﬂphase" UBYTE B_TRUE 1 100 0 1 BIT_MASK 0x2 FORMAT "%13.11" ECU_ADDRESS 0x40371A /end MEASUREMENT
/begin MEASUREMENT B_mslmin2 "Bedingung sehr geringe Sekund‰rluftmasse aus Meﬂphase (Bank 2)" UBYTE B_TRUE 1 100 0 1 BIT_MASK 0x2 FORMAT "%13.11" ECU_ADDRESS 0x403720 /end MEASUREMENT
/begin MEASUREMENT B_mslmn "Bedingung zu wenig Sekund‰rluftmasse" UBYTE B_TRUE 1 100 0 1 BIT_MASK 0x1 FORMAT "%13.11" ECU_ADDRESS 0x3FC388 /end MEASUREMENT
/begin MEASUREMENT B_mslpmn "Fehlerbedingung: keine Sekund‰rluftpumpe, nur Pulse Air" UBYTE B_TRUE 1 100 0 1 BIT_MASK 0x1 FORMAT "%13.11" ECU_ADDRESS 0x3FC389 /end MEASUREMENT
/begin MEASUREMENT B_mslpmn2 "Fehlerbedingung: keine Sekund‰rluftpumpe, nur Pulse Air, Bank 2" UBYTE B_TRUE 1 100 0 1 BIT_MASK 0x1 FORMAT "%13.11" ECU_ADDRESS 0x3FC38A /end MEASUREMENT
/begin MEASUREMENT B_mslsum "Bedingung Summengrenzwert f¸r gesamte Sekund‰rluft unterschritten" UWORD B_TRUE 1 100 0 1 BIT_MASK 0x2 FORMAT "%13.11" ECU_ADDRESS 0x403736 /end MEASUREMENT
/begin MEASUREMENT B_mslsumn "Bedingung Summengrenzwert f¸r gesamte Sekund‰rluft u. Bank1 unterschritten" UWORD B_TRUE 1 100 0 1 BIT_MASK 0x4 FORMAT "%13.11" ECU_ADDRESS 0x403736 /end MEASUREMENT
/begin MEASUREMENT B_mslsumn2 "Bedingung Summengrenzwert f¸r gesamte Sekund‰rluft u. Bank2 unterschritten" UWORD B_TRUE 1 100 0 1 BIT_MASK 0x40 FORMAT "%13.11" ECU_ADDRESS 0x403736 /end MEASUREMENT
/begin MEASUREMENT B_mslsumt "Bedingung Summengrenzwert f¸r gesamte Sekund‰rluft unterschritten (tempor‰r)" UWORD B_TRUE 1 100 0 1 BIT_MASK 0x20 FORMAT "%13.11" ECU_ADDRESS 0x403736 /end MEASUREMENT
/begin MEASUREMENT B_mxslvpr "Fehlerart lokal: Sekund‰rluftmasse bei Ventildichtheitspr¸fung zu groﬂ" UBYTE B_TRUE 1 100 0 1 BIT_MASK 0x40 FORMAT "%13.11" ECU_ADDRESS 0x40371F /end MEASUREMENT
/begin MEASUREMENT B_mxslvpr2 "Fehlerart lokal: Sekund‰rluftmasse bei Ventildichtheitspr¸fung zu groﬂ, Bank 2" UBYTE B_TRUE 1 100 0 1 BIT_MASK 0x20 FORMAT "%13.11" ECU_ADDRESS 0x403720 /end MEASUREMENT
/begin MEASUREMENT B_niverrb "Bedingung Messfehler Niveau vom Sensor entprellt" UBYTE B_TRUE 1 100 0 1 BIT_MASK 0x2 FORMAT "%13.11" ECU_ADDRESS 0x403108 /end MEASUREMENT
/begin MEASUREMENT B_nmntkomp "" UBYTE B_TRUE 1 100 0 1 BIT_MASK 0x1 FORMAT "%13.11" ECU_ADDRESS 0x402924 /end MEASUREMENT
/begin MEASUREMENT B_nomil "MIL-Ansteuerung verriegelt" UBYTE B_TRUE 1 100 0 1 BIT_MASK 0x1 FORMAT "%13.11" ECU_ADDRESS 0x3FBEF9 /end MEASUREMENT
/begin MEASUREMENT B_nopg "Kein Phasengeber funktionst¸chtig" UBYTE B_TRUE 1 100 0 1 BIT_MASK 0x1 FORMAT "%13.11" ECU_ADDRESS 0x40297E /end MEASUREMENT
/begin MEASUREMENT B_nvrbupok "Erfolgreiches NVRAM-Backup im Flash" UBYTE B_TRUE 1 100 0 1 BIT_MASK 0x1 FORMAT "%13.11" ECU_ADDRESS 0x3FC337 /end MEASUREMENT
/begin MEASUREMENT B_nvrbuprq "Bedingung NVRAM-Backup-Request Z‰hler-Inkrement" UBYTE B_TRUE 1 100 0 1 BIT_MASK 0x1 FORMAT "%13.11" ECU_ADDRESS 0x3FC338 /end MEASUREMENT
/begin MEASUREMENT B_ozdiagok "Bedingung Diagnosebedingungen erf¸llt" UWORD B_TRUE 1 100 0 1 BIT_MASK 0x1 FORMAT "%13.11" ECU_ADDRESS 0x403106 /end MEASUREMENT
/begin MEASUREMENT B_ozfsheal "Bedingung Healing f¸r Fehlerspeicher" UWORD B_TRUE 1 100 0 1 BIT_MASK 0x4 FORMAT "%13.11" ECU_ADDRESS 0x403106 /end MEASUREMENT
/begin MEASUREMENT B_ozlerr "Bedingung Niveaumessfehler vom ÷lzustandssensor" UWORD B_TRUE 1 100 0 1 BIT_MASK 0x8 FORMAT "%13.11" ECU_ADDRESS 0x403106 /end MEASUREMENT
/begin MEASUREMENT B_ozlerrb "Bedingung Messfehler Niveau vom Sensor entprellt" UWORD B_TRUE 1 100 0 1 BIT_MASK 0x40 FORMAT "%13.11" ECU_ADDRESS 0x403106 /end MEASUREMENT
/begin MEASUREMENT B_ozqerr "Bedingung Permittivit‰tsmessfehler vom ÷lzustandssensor" UWORD B_TRUE 1 100 0 1 BIT_MASK 0x10 FORMAT "%13.11" ECU_ADDRESS 0x403106 /end MEASUREMENT
/begin MEASUREMENT B_ozqerrb "Bedingung Messfehler Permittivit‰t vom Sensor entprellt" UWORD B_TRUE 1 100 0 1 BIT_MASK 0x80 FORMAT "%13.11" ECU_ADDRESS 0x403106 /end MEASUREMENT
/begin MEASUREMENT B_ozsierrb "Bedingung Kommunikationsfehler entprellt" UWORD B_TRUE 1 100 0 1 BIT_MASK 0x200 FORMAT "%13.11" ECU_ADDRESS 0x403106 /end MEASUREMENT
/begin MEASUREMENT B_oztemic "Bedingung ÷lzustandssensor von Temic ist verbaut" UWORD B_TRUE 1 100 0 1 BIT_MASK 0x400 FORMAT "%13.11" ECU_ADDRESS 0x403106 /end MEASUREMENT
/begin MEASUREMENT B_ozterr "Bedingung Temperaturmessfehler vom ÷lzustandssensor" UWORD B_TRUE 1 100 0 1 BIT_MASK 0x20 FORMAT "%13.11" ECU_ADDRESS 0x403106 /end MEASUREMENT
/begin MEASUREMENT B_ozterrb "Bedingung Messfehler Temperatur vom Sensor entprellt" UWORD B_TRUE 1 100 0 1 BIT_MASK 0x100 FORMAT "%13.11" ECU_ADDRESS 0x403106 /end MEASUREMENT
/begin MEASUREMENT B_ozwertok "Bedingung alle Werte vom ÷lsensor in Ordnung" UWORD B_TRUE 1 100 0 1 BIT_MASK 0x2 FORMAT "%13.11" ECU_ADDRESS 0x403106 /end MEASUREMENT
/begin MEASUREMENT B_permerrb "Bedingung Messfehler Permittivit‰t vom Sensor entprellt" UBYTE B_TRUE 1 100 0 1 BIT_MASK 0x4 FORMAT "%13.11" ECU_ADDRESS 0x403108 /end MEASUREMENT
/begin MEASUREMENT B_ph2flok "Keine Abweichung der Phasenflanken im Arbeitsspiel f¸r PG2" UBYTE B_TRUE 1 100 0 1 BIT_MASK 0x2 FORMAT "%13.11" ECU_ADDRESS 0x403895 /end MEASUREMENT
/begin MEASUREMENT B_ph3flok "Keine Abweichung der Phasenflanken im Arbeitsspiel f¸r PG3" UBYTE B_TRUE 1 100 0 1 BIT_MASK 0x4 FORMAT "%13.11" ECU_ADDRESS 0x403895 /end MEASUREMENT
/begin MEASUREMENT B_ph4flok "Keine Abweichung der Phasenflanken im Arbeitsspiel f¸r PG4" UBYTE B_TRUE 1 100 0 1 BIT_MASK 0x8 FORMAT "%13.11" ECU_ADDRESS 0x403895 /end MEASUREMENT
/begin MEASUREMENT B_phflok "Keine Abweichung der Phasenflanken im Arbeitsspiel f¸r PG1" UBYTE B_TRUE 1 100 0 1 BIT_MASK 0x1 FORMAT "%13.11" ECU_ADDRESS 0x403895 /end MEASUREMENT
/begin MEASUREMENT B_plenvh "Freigabe DLSU Plauspfad" UBYTE B_TRUE 1 100 0 1 BIT_MASK 0x4 FORMAT "%13.11" ECU_ADDRESS 0x403B92 /end MEASUREMENT
/begin MEASUREMENT B_plenvh2 "Freigabe DLSU Plauspfad 2" UBYTE B_TRUE 1 100 0 1 BIT_MASK 0x4 FORMAT "%13.11" ECU_ADDRESS 0x403B93 /end MEASUREMENT
/begin MEASUREMENT B_plok "Plausibilit‰t der FSE-Werte in allen Drehzahlbereichen gegeben" UBYTE B_TRUE 1 100 0 1 BIT_MASK 0x2 FORMAT "%13.11" ECU_ADDRESS 0x40383C /end MEASUREMENT
/begin MEASUREMENT B_ploka "Plausibilit‰t der FSE-Werte in allen Drehzahlbereichen gegeben (Array)" UBYTE default 1 100 0 1 FORMAT "%5.3" ARRAY_SIZE 9 ECU_ADDRESS 0x3FE00D /end MEASUREMENT
/begin MEASUREMENT B_range "Betriebszustand innerhalb vom durch MISALUN + NMIALU + NMXALU gegebenem Betriebs" UBYTE B_TRUE 1 100 0 1 BIT_MASK 0x1 FORMAT "%13.11" ECU_ADDRESS 0x3FBF3B /end MEASUREMENT
/begin MEASUREMENT B_readap "Reset der fuel-off Adaption" UBYTE B_TRUE 1 100 0 1 BIT_MASK 0x1 FORMAT "%13.11" ECU_ADDRESS 0x3FBF07 /end MEASUREMENT
/begin MEASUREMENT B_reini "Bedingung Reinitialisierung des Aussetzergenerators" UBYTE B_TRUE 1 100 0 1 BIT_MASK 0x1 FORMAT "%13.11" ECU_ADDRESS 0x402958 /end MEASUREMENT
/begin MEASUREMENT B_rmsl "Bedingung Berechnung der relativen Sekund‰rluftmasse," UBYTE B_TRUE 1 100 0 1 BIT_MASK 0x1 FORMAT "%13.11" ECU_ADDRESS 0x3FC38B /end MEASUREMENT
/begin MEASUREMENT B_rmsl2 "Bedingung Berechnung der relativen Sekund‰rluftmasse, Bank2" UBYTE B_TRUE 1 100 0 1 BIT_MASK 0x1 FORMAT "%13.11" ECU_ADDRESS 0x3FC38C /end MEASUREMENT
/begin MEASUREMENT B_rmslsm "Bedingung f¸r Auswertung der Summe der rel.Sekund‰rluftmassen von 2 Abgasb‰nken" UBYTE B_TRUE 1 100 0 1 BIT_MASK 0x1 FORMAT "%13.11" ECU_ADDRESS 0x3FC38D /end MEASUREMENT
/begin MEASUREMENT B_rmslsm2 "Bedingung f¸r Auswertung der Summe der rel.Sekund‰rluftmassen von 2 Abgasb‰nken" UBYTE B_TRUE 1 100 0 1 BIT_MASK 0x1 FORMAT "%13.11" ECU_ADDRESS 0x3FC38E /end MEASUREMENT
/begin MEASUREMENT B_rmslsmg "Bedingung f¸r Auswertung der Summe der rel.Sekund‰rluftmassen von Bank1 und 2" UWORD B_TRUE 1 100 0 1 BIT_MASK 0x10 FORMAT "%13.11" ECU_ADDRESS 0x403736 /end MEASUREMENT
/begin MEASUREMENT B_rst1ph "Heilung f¸r Phasenfehler PG1 (falsche Anzahl Flanken/AS)" UBYTE B_TRUE 1 100 0 1 BIT_MASK 0x2 FORMAT "%13.11" ECU_ADDRESS 0x403897 /end MEASUREMENT
/begin MEASUREMENT B_rst1ph2 "Heilung f¸r Phasenfehler PG2 (falsche Anzahl Flanken/AS)" UBYTE B_TRUE 1 100 0 1 BIT_MASK 0x1 FORMAT "%13.11" ECU_ADDRESS 0x403898 /end MEASUREMENT
/begin MEASUREMENT B_rst1ph3 "Heilung f¸r Phasenfehler PG3 (falsche Anzahl Flanken/AS)" UBYTE B_TRUE 1 100 0 1 BIT_MASK 0x10 FORMAT "%13.11" ECU_ADDRESS 0x403898 /end MEASUREMENT
/begin MEASUREMENT B_rst1ph4 "Heilung f¸r Phasenfehler PG4 (falsche Anzahl Flanken/AS)" UBYTE B_TRUE 1 100 0 1 BIT_MASK 0x1 FORMAT "%13.11" ECU_ADDRESS 0x403899 /end MEASUREMENT
/begin MEASUREMENT B_rst3ph "Heilung f¸r Phasenfehler PG1 (falscher Pegel an BM)" UBYTE B_TRUE 1 100 0 1 BIT_MASK 0x8 FORMAT "%13.11" ECU_ADDRESS 0x40297F /end MEASUREMENT
/begin MEASUREMENT B_rst3ph2 "Heilung f¸r Phasenfehler PG2 (falscher Pegel an BM)" UBYTE B_TRUE 1 100 0 1 BIT_MASK 0x80 FORMAT "%13.11" ECU_ADDRESS 0x40297F /end MEASUREMENT
/begin MEASUREMENT B_rst3ph3 "Heilung f¸r Phasenfehler PG3 (falscher Pegel an BM)" UBYTE B_TRUE 1 100 0 1 BIT_MASK 0x4 FORMAT "%13.11" ECU_ADDRESS 0x402980 /end MEASUREMENT
/begin MEASUREMENT B_rst3ph4 "Heilung f¸r Phasenfehler PG4 (falscher Pegel an BM)" UBYTE B_TRUE 1 100 0 1 BIT_MASK 0x20 FORMAT "%13.11" ECU_ADDRESS 0x402980 /end MEASUREMENT
/begin MEASUREMENT B_sigb "Bedingung Kommunikationsfehler entprellt" UBYTE B_TRUE 1 100 0 1 BIT_MASK 0x8 FORMAT "%13.11" ECU_ADDRESS 0x403108 /end MEASUREMENT
/begin MEASUREMENT B_sla "Anforderung Sekund‰rluftadaptionsphase" UBYTE B_TRUE 1 100 0 1 BIT_MASK 0x1 FORMAT "%13.11" ECU_ADDRESS 0x3FC38F /end MEASUREMENT
/begin MEASUREMENT B_slar "Anforderung Sekund‰rluftadaptionsphase zur¸cksetzen" UBYTE B_TRUE 1 100 0 1 BIT_MASK 0x20 FORMAT "%13.11" ECU_ADDRESS 0x40371E /end MEASUREMENT
/begin MEASUREMENT B_slarq "Gespeicherte Anforderung Sekund‰rluftadaptionsphase" UBYTE B_TRUE 1 100 0 1 BIT_MASK 0x40 FORMAT "%13.11" ECU_ADDRESS 0x40371B /end MEASUREMENT
/begin MEASUREMENT B_slas "Anforderung Sekund‰rluftadaptionsphase setzen" UBYTE B_TRUE 1 100 0 1 BIT_MASK 0x10 FORMAT "%13.11" ECU_ADDRESS 0x40371E /end MEASUREMENT
/begin MEASUREMENT B_slsofw "Lokale Bit: B_slsoff um TDPHSLOF verzˆgert" UBYTE B_TRUE 1 100 0 1 BIT_MASK 0x40 FORMAT "%13.11" ECU_ADDRESS 0x40371D /end MEASUREMENT
/begin MEASUREMENT B_sp1 "FLC-Trigger der Aussetzererkennung" UBYTE B_TRUE 1 100 0 1 BIT_MASK 0x1 FORMAT "%13.11" ECU_ADDRESS 0x403873 /end MEASUREMENT
/begin MEASUREMENT B_sp2 "HLC-Trigger der Aussetzererkennung" UBYTE B_TRUE 1 100 0 1 BIT_MASK 0x1 FORMAT "%13.11" ECU_ADDRESS 0x403874 /end MEASUREMENT
/begin MEASUREMENT B_staerr "Bedingung Startautomatikfehler erkannt" UBYTE B_TRUE 1 100 0 1 BIT_MASK 0x1 FORMAT "%13.11" ECU_ADDRESS 0x3FC044 /end MEASUREMENT
/begin MEASUREMENT B_staok "Bedingung Start in Ordnung" UBYTE B_TRUE 1 100 0 1 BIT_MASK 0x1 FORMAT "%13.11" ECU_ADDRESS 0x3FC045 /end MEASUREMENT
/begin MEASUREMENT B_stdmd "Bedingung Aussetzererkennung w‰hrend Starthochlauf gesperrt" UBYTE B_TRUE 1 100 0 1 BIT_MASK 0x1 FORMAT "%13.11" ECU_ADDRESS 0x3FBF3C /end MEASUREMENT
/begin MEASUREMENT B_stimhelp "Z¸ndungs-Aussetzer eingestellt, Stimuli-Signal vom Aussetzergenerator" UBYTE B_TRUE 1 100 0 1 BIT_MASK 0x1 FORMAT "%13.11" ECU_ADDRESS 0x4037D4 /end MEASUREMENT
/begin MEASUREMENT B_stpon "Bedingung Umschaltung nach Start aktiv (Startgradienten)" UBYTE B_TRUE 1 100 0 1 BIT_MASK 0x1 FORMAT "%13.11" ECU_ADDRESS 0x3FBF3D /end MEASUREMENT
/begin MEASUREMENT B_su2tmp "" UBYTE B_TRUE 1 100 0 1 BIT_MASK 0x1 FORMAT "%13.11" ECU_ADDRESS 0x3FBF3E /end MEASUREMENT
/begin MEASUREMENT B_sutmp "" UBYTE B_TRUE 1 100 0 1 BIT_MASK 0x1 FORMAT "%13.11" ECU_ADDRESS 0x3FBF3F /end MEASUREMENT
/begin MEASUREMENT B_swe "Bedingung Schlechtwegstrecke erkannt" UBYTE B_TRUE 1 100 0 1 BIT_MASK 0x1 FORMAT "%13.11" ECU_ADDRESS 0x3FBF40 /end MEASUREMENT
/begin MEASUREMENT B_swe_c "Bedingung Schlechtwegstrecke erkannt aus %DSWEC" UBYTE B_TRUE 1 100 0 1 BIT_MASK 0x1 FORMAT "%13.11" ECU_ADDRESS 0x3FC046 /end MEASUREMENT
/begin MEASUREMENT B_synph "Bedingung Synchronisation Phase" UBYTE B_TRUE 1 100 0 1 BIT_MASK 0x2 FORMAT "%13.11" ECU_ADDRESS 0x40297E /end MEASUREMENT
/begin MEASUREMENT B_synphab "Synchronisation abgeschlossen" UBYTE B_TRUE 1 100 0 1 BIT_MASK 0x2 FORMAT "%13.11" ECU_ADDRESS 0x40297F /end MEASUREMENT
/begin MEASUREMENT B_szsls "Bedingung Diagnose Sekund‰rluftsystem durchgef¸hrt, Summe" UBYTE B_TRUE 1 100 0 1 BIT_MASK 0x10 FORMAT "%13.11" ECU_ADDRESS 0x40371B /end MEASUREMENT
/begin MEASUREMENT B_temperrb "Bedingung Messfehler Temperatur vom Sensor entprellt" UBYTE B_TRUE 1 100 0 1 BIT_MASK 0x1 FORMAT "%13.11" ECU_ADDRESS 0x403108 /end MEASUREMENT
/begin MEASUREMENT B_ti1stamp "" UBYTE B_TRUE 1 100 0 1 BIT_MASK 0x1 FORMAT "%13.11" ECU_ADDRESS 0x4037D5 /end MEASUREMENT
/begin MEASUREMENT B_ti2stamp "" UBYTE B_TRUE 1 100 0 1 BIT_MASK 0x1 FORMAT "%13.11" ECU_ADDRESS 0x4037D6 /end MEASUREMENT
/begin MEASUREMENT B_tnalu "Testphase nach erkanntem Aussetzer l‰uft" UBYTE B_TRUE 1 100 0 1 BIT_MASK 0x4 FORMAT "%13.11" ECU_ADDRESS 0x40384C /end MEASUREMENT
/begin MEASUREMENT B_trfasla "Trigger (stegende Flanke) von B_FASLA" UBYTE B_TRUE 1 100 0 1 BIT_MASK 0x1 FORMAT "%13.11" ECU_ADDRESS 0x403722 /end MEASUREMENT
/begin MEASUREMENT B_ts1delay "Timestamp last segmentmark 1 of Slave" UBYTE B_TRUE 1 100 0 1 BIT_MASK 0x1 FORMAT "%13.11" ECU_ADDRESS 0x4037D7 /end MEASUREMENT
/begin MEASUREMENT B_tsbcalc "" UBYTE B_TRUE 1 100 0 1 BIT_MASK 0x1 FORMAT "%13.11" ECU_ADDRESS 0x4037D8 /end MEASUREMENT
/begin MEASUREMENT B_tsbready "Bedingung Segmentzeit g¸ltig" UBYTE B_TRUE 1 100 0 1 BIT_MASK 0x1 FORMAT "%13.11" ECU_ADDRESS 0x4037D9 /end MEASUREMENT
/begin MEASUREMENT B_velueakt "Bedingung Variantenerkennung E-L¸fter Ansteuerung aktiv" UBYTE B_TRUE 1 100 0 1 BIT_MASK 0x1 FORMAT "%13.11" ECU_ADDRESS 0x3FC053 /end MEASUREMENT
/begin MEASUREMENT B_vlsuftb "Bedingung: LSU hat Kennlinienverschiebung nach fett (zeigt zu fett an)" UBYTE B_TRUE 1 100 0 1 BIT_MASK 0x1 FORMAT "%13.11" ECU_ADDRESS 0x3FE0A6 /end MEASUREMENT
/begin MEASUREMENT B_vlsuftb2 "Bedingung: LSU hat Kennlinienverschiebung nach fett (zeigt zu fett an) (B2)" UBYTE B_TRUE 1 100 0 1 BIT_MASK 0x10 FORMAT "%13.11" ECU_ADDRESS 0x3FE0A6 /end MEASUREMENT
/begin MEASUREMENT B_vlsumrb "Bedingung: LSU hat Kennlinienverschiebung nach mager (zeigt zu mager an)" UBYTE B_TRUE 1 100 0 1 BIT_MASK 0x2 FORMAT "%13.11" ECU_ADDRESS 0x3FE0A6 /end MEASUREMENT
/begin MEASUREMENT B_vlsumrb2 "Bedingung: LSU hat Kennlinienverschiebung nach mager (zeigt zu mager an) (B2)" UBYTE B_TRUE 1 100 0 1 BIT_MASK 0x20 FORMAT "%13.11" ECU_ADDRESS 0x3FE0A6 /end MEASUREMENT
/begin MEASUREMENT B_vlsunp "Verdacht : Lambdasonde Signal ist unplausibel" UBYTE B_TRUE 1 100 0 1 BIT_MASK 0x2 FORMAT "%13.11" ECU_ADDRESS 0x403B91 /end MEASUREMENT
/begin MEASUREMENT B_vlsunp2 "Verdacht : Lambdasonde Signal ist unplausibel Bank2" UBYTE B_TRUE 1 100 0 1 BIT_MASK 0x10 FORMAT "%13.11" ECU_ADDRESS 0x403B91 /end MEASUREMENT
/begin MEASUREMENT B_zagrun "Bedingung Start des Aussetzergenerators" UBYTE B_TRUE 1 100 0 1 BIT_MASK 0x2 FORMAT "%13.11" ECU_ADDRESS 0x402958 /end MEASUREMENT
/begin MEASUREMENT B_zagstp "Bedingung Aussetzergenerator gestoppt" UBYTE B_TRUE 1 100 0 1 BIT_MASK 0x1 FORMAT "%13.11" ECU_ADDRESS 0x3FBF71 /end MEASUREMENT
/begin MEASUREMENT B_zslsp "lokales Zyklusflag: Sekund‰rluft-System" UBYTE B_TRUE 1 100 0 1 BIT_MASK 0x20 FORMAT "%13.11" ECU_ADDRESS 0x40371F /end MEASUREMENT
/begin MEASUREMENT B_zslsp2 "lokales Zyklusflag: Sekund‰rluft-System, Bank 2" UBYTE B_TRUE 1 100 0 1 BIT_MASK 0x10 FORMAT "%13.11" ECU_ADDRESS 0x403720 /end MEASUREMENT
/begin MEASUREMENT B_zslvp "lokales Zyklusflag: Sekund‰rluftventil" UBYTE B_TRUE 1 100 0 1 BIT_MASK 0x4 FORMAT "%13.11" ECU_ADDRESS 0x40371A /end MEASUREMENT
/begin MEASUREMENT B_zslvp2 "lokales Zyklusflag: Sekund‰rluftventil, Bank 2" UBYTE B_TRUE 1 100 0 1 BIT_MASK 0x80 FORMAT "%13.11" ECU_ADDRESS 0x403720 /end MEASUREMENT
/begin MEASUREMENT B_zylind "zeigt, ob zylinderindividuelles (1) oder segmentweises (0) Lernen (nur fuel-off)" UBYTE B_TRUE 1 100 0 1 BIT_MASK 0x1 FORMAT "%13.11" ECU_ADDRESS 0x3FBF08 /end MEASUREMENT
/begin MEASUREMENT cdcy "Z‰hler DCY f¸r Init Dauerlaufz‰hler" UBYTE dez 1 100 0 255 FORMAT "%5.1" ECU_ADDRESS 0x3FE03C /end MEASUREMENT
/begin MEASUREMENT cfoxx "zeigt die Eigenschaften des aktuellen KF-Bereiches der Fuel-on/-off Adaption" UBYTE dez 1 100 0 255 FORMAT "%5.1" ECU_ADDRESS 0x40383A /end MEASUREMENT
/begin MEASUREMENT convert_f "" FLOAT32_IEEE fak_r32_1 1 100 -10000 10000 FORMAT "%27.21" ECU_ADDRESS 0x402928 /end MEASUREMENT
/begin MEASUREMENT ctrlustp_w "Counter Laufunruhe-Berechnung gesperrt, nicht synchronisiert mit luts delay" UWORD DEZ 1 100 0 65535 FORMAT "%8.2" ECU_ADDRESS 0x4043EA /end MEASUREMENT
/begin MEASUREMENT dfrmoff2_w "frm-Offset: zur Kontrolle von Problemen der Vorsteuerung, Bank 2" SWORD fak_sw_b1 1 100 -1 0.999969 FORMAT "%8.6" ECU_ADDRESS 0x403730 /end MEASUREMENT
/begin MEASUREMENT dfrmoff_w "frm-Offset: zur Kontrolle von Problemen der Vorsteuerung" SWORD fak_sw_b1 1 100 -1 0.999969 FORMAT "%8.6" ECU_ADDRESS 0x403732 /end MEASUREMENT
/begin MEASUREMENT dfseresz_w "Resetz‰hler Plausibilit‰tspr¸fung FSE" UWORD dez 1 100 0 65535 FORMAT "%8.2" ECU_ADDRESS 0x3FDFD0 /end MEASUREMENT
/begin MEASUREMENT dfse_f "Differenz Adaptionswerte der fuel-on Adaption in bestimmtem Drehzahlbereich" FLOAT32_IEEE fak_r32_1 1 100 -10000 10000 FORMAT "%27.21" ARRAY_SIZE 9 ECU_ADDRESS 0x3FA9E0 /end MEASUREMENT
/begin MEASUREMENT dlutsk_f "Laufunruhedifferenz-Testgrˆﬂe, korrigiert" FLOAT32_IEEE fak_r32_1 1 100 -10000 10000 FORMAT "%27.21" ECU_ADDRESS 0x3FAB40 /end MEASUREMENT
/begin MEASUREMENT dluts_f "Laufunruhedifferenz-Testgrˆﬂe, signed" FLOAT32_IEEE fak_r32_1 1 100 -10000 10000 FORMAT "%27.21" ECU_ADDRESS 0x3FAA4C /end MEASUREMENT
/begin MEASUREMENT dmdappBits_100ms "" UBYTE dez 1 100 0 255 FORMAT "%5.1" ECU_ADDRESS 0x402958 /end MEASUREMENT
/begin MEASUREMENT dmdladAusBitsSyn "" UBYTE dez 1 100 0 255 FORMAT "%5.1" ECU_ADDRESS 0x40384C /end MEASUREMENT
/begin MEASUREMENT dmdlfbLokBits "" UBYTE dez 1 100 0 255 FORMAT "%5.1" ECU_ADDRESS 0x402924 /end MEASUREMENT
/begin MEASUREMENT dmdlfbLokBitsSyn "" UBYTE dez 1 100 0 255 FORMAT "%5.1" ECU_ADDRESS 0x40384E /end MEASUREMENT
/begin MEASUREMENT dmdsegl_w "Segmentl‰nge f¸r Aussetzererkennung" UWORD kw_tooth_sy 1 100 0 393210 FORMAT "%8.1" ECU_ADDRESS 0x404682 /end MEASUREMENT
/begin MEASUREMENT dmlseAusBitsNov "" UBYTE dez 1 100 0 255 FORMAT "%5.1" ECU_ADDRESS 0x3FE0BF /end MEASUREMENT
/begin MEASUREMENT dmsldrl_w "Delta relative Luftf¸llung (Word)" UWORD rel_uw_q0p0234 1 100 0 1535.98 FORMAT "%8.3" ECU_ADDRESS 0x403734 /end MEASUREMENT
/begin MEASUREMENT dnvrbupctr "Delta Non Volatile RAM Backup Counter" UBYTE dez 1 100 0 255 FORMAT "%5.1" ECU_ADDRESS 0x4035D4 /end MEASUREMENT
/begin MEASUREMENT dnwsausBits_100ms "" UBYTE dez 1 100 0 255 FORMAT "%5.1" ECU_ADDRESS 0x40368F /end MEASUREMENT
/begin MEASUREMENT dnwseinBits_100ms "" UBYTE dez 1 100 0 255 FORMAT "%5.1" ECU_ADDRESS 0x403690 /end MEASUREMENT
/begin MEASUREMENT dodsnlBits "" UBYTE dez 1 100 0 255 FORMAT "%5.1" ECU_ADDRESS 0x402BEC /end MEASUREMENT
/begin MEASUREMENT dphAusBitsKoop "" UBYTE dez 1 100 0 255 FORMAT "%5.1" ECU_ADDRESS 0x40297E /end MEASUREMENT
/begin MEASUREMENT dphAusBitssyn "" UBYTE dez 1 100 0 255 FORMAT "%5.1" ECU_ADDRESS 0x403895 /end MEASUREMENT
/begin MEASUREMENT dphLokBitsKoop "" UBYTE dez 1 100 0 255 FORMAT "%5.1" ECU_ADDRESS 0x40297F /end MEASUREMENT
/begin MEASUREMENT dphLokBitsKoop2 "" UBYTE dez 1 100 0 255 FORMAT "%5.1" ECU_ADDRESS 0x402980 /end MEASUREMENT
/begin MEASUREMENT dphLokBitsph "" UBYTE dez 1 100 0 255 FORMAT "%5.1" ECU_ADDRESS 0x403896 /end MEASUREMENT
/begin MEASUREMENT dphLokBitssyn "" UBYTE dez 1 100 0 255 FORMAT "%5.1" ECU_ADDRESS 0x403897 /end MEASUREMENT
/begin MEASUREMENT dphLokBitssyn2 "" UBYTE dez 1 100 0 255 FORMAT "%5.1" ECU_ADDRESS 0x403898 /end MEASUREMENT
/begin MEASUREMENT dphLokBitssyn3 "" UBYTE dez 1 100 0 255 FORMAT "%5.1" ECU_ADDRESS 0x403899 /end MEASUREMENT
/begin MEASUREMENT dqltBits1_1s "" UBYTE dez 1 100 0 255 FORMAT "%5.1" ECU_ADDRESS 0x403108 /end MEASUREMENT
/begin MEASUREMENT dqltBits2_1s "" UWORD dez 1 100 0 65535 FORMAT "%8.2" ECU_ADDRESS 0x403106 /end MEASUREMENT
/begin MEASUREMENT dr_errArray "" UWORD dez 1 100 0 65535 FORMAT "%8.2" ARRAY_SIZE 22 ECU_ADDRESS 0x4063F2 /end MEASUREMENT
/begin MEASUREMENT dr_errCounter "" UWORD dez 1 100 0 65535 FORMAT "%8.2" ECU_ADDRESS 0x3FB930 /end MEASUREMENT
/begin MEASUREMENT dr_errId "" UWORD dez 1 100 0 65535 FORMAT "%8.2" ECU_ADDRESS 0x3FB932 /end MEASUREMENT
/begin MEASUREMENT dr_errInfoh "" UWORD dez 1 100 0 65535 FORMAT "%8.2" ECU_ADDRESS 0x4063EA /end MEASUREMENT
/begin MEASUREMENT dr_errInfol "" UWORD dez 1 100 0 65535 FORMAT "%8.2" ECU_ADDRESS 0x4063EC /end MEASUREMENT
/begin MEASUREMENT dr_errMin "" UWORD tmin_uw_q1 1 100 0 65535 FORMAT "%8.2" ECU_ADDRESS 0x4063EE /end MEASUREMENT
/begin MEASUREMENT dr_errSec "" UWORD t_q0p1 1 100 0 6553.5 FORMAT "%8.3" ECU_ADDRESS 0x4063F0 /end MEASUREMENT
/begin MEASUREMENT dr_errType "" UWORD dez 1 100 0 65535 FORMAT "%8.2" ECU_ADDRESS 0x3FB934 /end MEASUREMENT
/begin MEASUREMENT DSLSLRSlokBits1 "" UBYTE dez 1 100 0 255 FORMAT "%5.1" ECU_ADDRESS 0x40371A /end MEASUREMENT
/begin MEASUREMENT DSLSLRSlokBits1a "" UBYTE dez 1 100 0 255 FORMAT "%5.1" ECU_ADDRESS 0x40371B /end MEASUREMENT
/begin MEASUREMENT DSLSLRSlokBits2 "" UBYTE dez 1 100 0 255 FORMAT "%5.1" ECU_ADDRESS 0x40371C /end MEASUREMENT
/begin MEASUREMENT DSLSLRSlokBits2a "" UBYTE dez 1 100 0 255 FORMAT "%5.1" ECU_ADDRESS 0x40371D /end MEASUREMENT
/begin MEASUREMENT DSLSLRSlokBits3 "" UBYTE dez 1 100 0 255 FORMAT "%5.1" ECU_ADDRESS 0x40371E /end MEASUREMENT
/begin MEASUREMENT DSLSLRSlokBits3a "" UBYTE dez 1 100 0 255 FORMAT "%5.1" ECU_ADDRESS 0x40371F /end MEASUREMENT
/begin MEASUREMENT DSLSLRSlokBits4 "" UBYTE dez 1 100 0 255 FORMAT "%5.1" ECU_ADDRESS 0x403720 /end MEASUREMENT
/begin MEASUREMENT DSLSLRSlokBits4a "" UBYTE dez 1 100 0 255 FORMAT "%5.1" ECU_ADDRESS 0x403721 /end MEASUREMENT
/begin MEASUREMENT DSLSLRSlokBits5 "" UWORD dez 1 100 0 65535 FORMAT "%8.2" ECU_ADDRESS 0x403736 /end MEASUREMENT
/begin MEASUREMENT DSLSLRSlokBits6 "" UBYTE dez 1 100 0 255 FORMAT "%5.1" ECU_ADDRESS 0x403722 /end MEASUREMENT
/begin MEASUREMENT dsueBits "" UBYTE dez 1 100 0 255 FORMAT "%5.1" ECU_ADDRESS 0x402BFA /end MEASUREMENT
/begin MEASUREMENT dtsarray_f "Differenzen zur Medianbildung/Dynamikkompensation, DMD" FLOAT32_IEEE fak_r32_1 1 100 -10000 10000 FORMAT "%27.21" ARRAY_SIZE 5 ECU_ADDRESS 0x3FAA50 /end MEASUREMENT
/begin MEASUREMENT eepnvrbctr "NVRAM-Backup-Z‰hler serielles EEPROM" UWORD dez 1 100 0 65535 FORMAT "%8.2" ECU_ADDRESS 0x4035D2 /end MEASUREMENT
/begin MEASUREMENT eluekctr "Z‰hler Variantenerkennung E-L¸fter (Kurzschlussz‰hler)" UBYTE dez 1 100 0 255 FORMAT "%5.1" ECU_ADDRESS 0x402BF8 /end MEASUREMENT
/begin MEASUREMENT erg1 "" FLOAT32_IEEE fak_r32_1 1 100 -10000 10000 FORMAT "%27.21" ECU_ADDRESS 0x3FAA04 /end MEASUREMENT
/begin MEASUREMENT erg2 "" FLOAT32_IEEE fak_r32_1 1 100 -10000 10000 FORMAT "%27.21" ECU_ADDRESS 0x3FAA08 /end MEASUREMENT
/begin MEASUREMENT esst_smi03dmub1 "" ULONG dez 1 100 0 4.29497e+009 FORMAT "%13.2" ECU_ADDRESS 0x4049C0 /end MEASUREMENT
/begin MEASUREMENT esst_smi05dmub1 "" ULONG dez 1 100 0 4.29497e+009 FORMAT "%13.2" ECU_ADDRESS 0x4049C4 /end MEASUREMENT
/begin MEASUREMENT esst_snm10dmuw1 "" ULONG dez 1 100 0 4.29497e+009 FORMAT "%13.2" ECU_ADDRESS 0x4049C8 /end MEASUREMENT
/begin MEASUREMENT E_abg_zyl "zyl.-individuelle Abgas-relevante Aussetzer-Fehler" UBYTE default 1 100 0 1 FORMAT "%5.3" ARRAY_SIZE 12 ECU_ADDRESS 0x402947 /end MEASUREMENT
/begin MEASUREMENT E_nwkwa2_loc "" UBYTE B_TRUE 1 100 0 1 BIT_MASK 0x1 FORMAT "%13.11" ECU_ADDRESS 0x3FBF6C /end MEASUREMENT
/begin MEASUREMENT E_nwkwa_loc "" UBYTE B_TRUE 1 100 0 1 BIT_MASK 0x1 FORMAT "%13.11" ECU_ADDRESS 0x3FBF6D /end MEASUREMENT
/begin MEASUREMENT E_nwkwe2_loc "" UBYTE B_TRUE 1 100 0 1 BIT_MASK 0x1 FORMAT "%13.11" ECU_ADDRESS 0x3FBF6E /end MEASUREMENT
/begin MEASUREMENT E_sue2_loc "" UBYTE B_TRUE 1 100 0 1 BIT_MASK 0x1 FORMAT "%13.11" ECU_ADDRESS 0x3FBF6F /end MEASUREMENT
/begin MEASUREMENT famalwk_f "Absenkungsfaktor f¸r Laufunruheschwellwert bei Mehrfachaussetzern" FLOAT32_IEEE fak_r32_1 1 100 -1e+037 1e+037 FORMAT "%27.0" ECU_ADDRESS 0x3FABCC /end MEASUREMENT
/begin MEASUREMENT famal_f "Faktor zur Absenkung des LUR-Wertes bei Mehrfachaussetzern, aus KFFAMALU" FLOAT32_IEEE fak_r32_1 1 100 -1e+037 1e+037 FORMAT "%27.0" ECU_ADDRESS 0x3FABD0 /end MEASUREMENT
/begin MEASUREMENT fanalun "" UBYTE dez 1 100 0 255 FORMAT "%5.1" ECU_ADDRESS 0x40384D /end MEASUREMENT
/begin MEASUREMENT favralu_w "Anzahl Verbrenng. f. Reaktivierung Aussetzererkennung nach Ausblendung" UWORD DEZ 1 100 0 65535 FORMAT "%8.2" ECU_ADDRESS 0x4043F0 /end MEASUREMENT
/begin MEASUREMENT fflutn_f "Filterfaktor ¸ber n f¸r Filterung der Laufunruhe" FLOAT32_IEEE fak_r32_1 1 100 -10000 10000 FORMAT "%27.21" ECU_ADDRESS 0x40292C /end MEASUREMENT
/begin MEASUREMENT ffon1 "Statusbyte 1 ‹bersicht fuel-on Adaption" UBYTE dez 1 100 0 255 FORMAT "%5.1" ECU_ADDRESS 0x40383B /end MEASUREMENT
/begin MEASUREMENT ffon2 "Statusbyte 2 ‹bersicht fuel-on Adaption" UBYTE dez 1 100 0 255 FORMAT "%5.1" ECU_ADDRESS 0x40383C /end MEASUREMENT
/begin MEASUREMENT fgtiabmd_w "" UWORD dez 1 100 0 65535 FORMAT "%8.2" ECU_ADDRESS 0x4043A2 /end MEASUREMENT
/begin MEASUREMENT fivzabg "Intervallz‰hler abgasrelevante Aussetzer" UBYTE dez 1 100 0 255 FORMAT "%5.1" ECU_ADDRESS 0x402954 /end MEASUREMENT
/begin MEASUREMENT fkfamal1_f "Absenkungsfaktor f¸r Laufunruheschwellwert bei Mehrfachaussetzern, aus KFAMAL" FLOAT32_IEEE fak_r32_1 1 100 -1e+037 1e+037 FORMAT "%27.0" ECU_ADDRESS 0x3FABD4 /end MEASUREMENT
/begin MEASUREMENT fkfamal2_f "Absenkungsfaktor f¸r Laufunruheschwellwert bei Mehrfachaussetzern, aus KFAMAL" FLOAT32_IEEE fak_r32_1 1 100 -1e+037 1e+037 FORMAT "%27.0" ECU_ADDRESS 0x3FABD8 /end MEASUREMENT
/begin MEASUREMENT fkfamal_f "Absenkungsfaktor f¸r Laufunruheschwellwert bei Mehrfachaussetzern, aus KFAMAL" FLOAT32_IEEE fak_r32_1 1 100 -1e+037 1e+037 FORMAT "%27.0" ECU_ADDRESS 0x3FABDC /end MEASUREMENT
/begin MEASUREMENT fkfluar1_f "Basis Schwellwert f¸r Laufunruhe-Abstandsmass, Faktor aus KFLUAR1" FLOAT32_IEEE fak_r32_1 1 100 -10000 10000 FORMAT "%27.21" ECU_ADDRESS 0x3FAC3C /end MEASUREMENT
/begin MEASUREMENT fkfluar2_f "Basis Schwellwert f¸r Laufunruhe-Abstandsmass, Faktor aus KFLUAR2" FLOAT32_IEEE fak_r32_1 1 100 -10000 10000 FORMAT "%27.21" ECU_ADDRESS 0x3FAC40 /end MEASUREMENT
/begin MEASUREMENT fkfluar_f "Basis Schwellwert f¸r Laufunruhe-Abstandsmass, Faktor aus KFLUAR" FLOAT32_IEEE fak_r32_1 1 100 -10000 10000 FORMAT "%27.21" ECU_ADDRESS 0x3FAC44 /end MEASUREMENT
/begin MEASUREMENT fkflurb1_f "Basis Schwellwert f¸r Laufunruhe, Faktor aus KFLURB1" FLOAT32_IEEE fak_r32_1 1 100 -1e+037 1e+037 FORMAT "%27.0" ECU_ADDRESS 0x3FABE0 /end MEASUREMENT
/begin MEASUREMENT fkflurb2_f "Basis Schwellwert f¸r Laufunruhe, Faktor aus KFLURB2" FLOAT32_IEEE fak_r32_1 1 100 -1e+037 1e+037 FORMAT "%27.0" ECU_ADDRESS 0x3FABE4 /end MEASUREMENT
/begin MEASUREMENT fkflurb_f "Basis Schwellwert f¸r Laufunruhe, Faktor aus KFLURB" FLOAT32_IEEE fak_r32_1 1 100 -1e+037 1e+037 FORMAT "%27.0" ECU_ADDRESS 0x3FABE8 /end MEASUREMENT
/begin MEASUREMENT fkflurm1_f "Faktor f¸r Laufunruhe-Referenzwert zur Mehrfachaussetzererkennung ->Lum-Vergl." FLOAT32_IEEE fak_r32_1 1 100 -1e+037 1e+037 FORMAT "%27.0" ECU_ADDRESS 0x3FABEC /end MEASUREMENT
/begin MEASUREMENT fkflurm_f "Faktor f¸r Laufunruhe-Referenzwert zur Mehrfachaussetzererkennung ->Lum-Vergl." FLOAT32_IEEE fak_r32_1 1 100 -1e+037 1e+037 FORMAT "%27.0" ECU_ADDRESS 0x3FABF0 /end MEASUREMENT
/begin MEASUREMENT flgkat_w "Statusflag kat.sch‰digende Aussetzerraten oder ti-Abschaltung" UWORD dez 1 100 0 65535 FORMAT "%8.2" ECU_ADDRESS 0x4043A4 /end MEASUREMENT
/begin MEASUREMENT flgstign_w "flagword f¸r stimulierte Z¸ndaussetzer" UWORD DEZ 1 100 0 65535 FORMAT "%8.2" ECU_ADDRESS 0x4043F2 /end MEASUREMENT
/begin MEASUREMENT flgstinj_w "flagword f¸r stimulierte Einspritzaussetzer" UWORD DEZ 1 100 0 65535 FORMAT "%8.2" ECU_ADDRESS 0x4043F4 /end MEASUREMENT
/begin MEASUREMENT flgstloc_w "" UWORD DEZ 1 100 0 65535 FORMAT "%8.2" ECU_ADDRESS 0x4043F6 /end MEASUREMENT
/begin MEASUREMENT flgst_w "flagword f¸r stimulierten Aussetzer" UWORD DEZ 1 100 0 65535 FORMAT "%8.2" ECU_ADDRESS 0x4043F8 /end MEASUREMENT
/begin MEASUREMENT flgtiab "Statusflag ti-Abschaltung bei kat.sch‰digenden Aussetzerraten" UBYTE dez 1 100 0 255 FORMAT "%5.1" ECU_ADDRESS 0x403876 /end MEASUREMENT
/begin MEASUREMENT flgtiabm_w "" UWORD dez 1 100 0 65535 FORMAT "%8.2" ECU_ADDRESS 0x4043A6 /end MEASUREMENT
/begin MEASUREMENT flmxof_f "aktuell maximaler Lernfilterwert" FLOAT32_IEEE fak_r32_1 1 100 -10000 10000 FORMAT "%27.21" ECU_ADDRESS 0x402880 /end MEASUREMENT
/begin MEASUREMENT flmx_f "aktuell maximaler Lernfilterwert" FLOAT32_IEEE fak_r32_1 1 100 -10000 10000 FORMAT "%27.21" ECU_ADDRESS 0x3FAA0C /end MEASUREMENT
/begin MEASUREMENT fln00_f "Lernfilterwert, negativ, Zyl. 0" FLOAT32_IEEE fak_r32_1 1 100 -10000 10000 FORMAT "%27.21" ARRAY_SIZE 24 ECU_ADDRESS 0x3FD1A4 /end MEASUREMENT
/begin MEASUREMENT fln01_f "Lernfilterwert, negativ, Zyl. 1" FLOAT32_IEEE fak_r32_1 1 100 -10000 10000 FORMAT "%27.21" ARRAY_SIZE 24 ECU_ADDRESS 0x3FD204 /end MEASUREMENT
/begin MEASUREMENT fln02_f "Lernfilterwert, negativ, Zyl. 2" FLOAT32_IEEE fak_r32_1 1 100 -10000 10000 FORMAT "%27.21" ARRAY_SIZE 24 ECU_ADDRESS 0x3FD264 /end MEASUREMENT
/begin MEASUREMENT fln03_f "Lernfilterwert, negativ, Zyl. 3" FLOAT32_IEEE fak_r32_1 1 100 -10000 10000 FORMAT "%27.21" ARRAY_SIZE 24 ECU_ADDRESS 0x3FD2C4 /end MEASUREMENT
/begin MEASUREMENT fln04_f "Lernfilterwert, negativ, Zyl. 4" FLOAT32_IEEE fak_r32_1 1 100 -10000 10000 FORMAT "%27.21" ARRAY_SIZE 24 ECU_ADDRESS 0x3FD324 /end MEASUREMENT
/begin MEASUREMENT fln05_f "Lernfilterwert, negativ, Zyl. 5" FLOAT32_IEEE fak_r32_1 1 100 -10000 10000 FORMAT "%27.21" ARRAY_SIZE 24 ECU_ADDRESS 0x3FD384 /end MEASUREMENT
/begin MEASUREMENT fln06_f "Lernfilterwert, negativ, Zyl. 6" FLOAT32_IEEE fak_r32_1 1 100 -10000 10000 FORMAT "%27.21" ARRAY_SIZE 24 ECU_ADDRESS 0x3FD3E4 /end MEASUREMENT
/begin MEASUREMENT fln07_f "Lernfilterwert, negativ, Zyl. 7" FLOAT32_IEEE fak_r32_1 1 100 -10000 10000 FORMAT "%27.21" ARRAY_SIZE 24 ECU_ADDRESS 0x3FD444 /end MEASUREMENT
/begin MEASUREMENT flnof1_f "Lernfilterwert, negativ, Drehzahlbereich 1" FLOAT32_IEEE fak_r32_1 1 100 -10000 10000 FORMAT "%27.21" ARRAY_SIZE 12 ECU_ADDRESS 0x3FDF10 /end MEASUREMENT
/begin MEASUREMENT flp00_f "Lernfilterwert, positiv, Zyl. 0" FLOAT32_IEEE fak_r32_1 1 100 -10000 10000 FORMAT "%27.21" ARRAY_SIZE 24 ECU_ADDRESS 0x3FD4A4 /end MEASUREMENT
/begin MEASUREMENT flp01_f "Lernfilterwert, positiv, Zyl. 1" FLOAT32_IEEE fak_r32_1 1 100 -10000 10000 FORMAT "%27.21" ARRAY_SIZE 24 ECU_ADDRESS 0x3FD504 /end MEASUREMENT
/begin MEASUREMENT flp02_f "Lernfilterwert, positiv, Zyl. 2" FLOAT32_IEEE fak_r32_1 1 100 -10000 10000 FORMAT "%27.21" ARRAY_SIZE 24 ECU_ADDRESS 0x3FD564 /end MEASUREMENT
/begin MEASUREMENT flp03_f "Lernfilterwert, positiv, Zyl. 3" FLOAT32_IEEE fak_r32_1 1 100 -10000 10000 FORMAT "%27.21" ARRAY_SIZE 24 ECU_ADDRESS 0x3FD5C4 /end MEASUREMENT
/begin MEASUREMENT flp04_f "Lernfilterwert, positiv, Zyl. 4" FLOAT32_IEEE fak_r32_1 1 100 -10000 10000 FORMAT "%27.21" ARRAY_SIZE 24 ECU_ADDRESS 0x3FD624 /end MEASUREMENT
/begin MEASUREMENT flp05_f "Lernfilterwert, positiv, Zyl. 5" FLOAT32_IEEE fak_r32_1 1 100 -10000 10000 FORMAT "%27.21" ARRAY_SIZE 24 ECU_ADDRESS 0x3FD684 /end MEASUREMENT
/begin MEASUREMENT flp06_f "Lernfilterwert, positiv, Zyl. 6" FLOAT32_IEEE fak_r32_1 1 100 -10000 10000 FORMAT "%27.21" ARRAY_SIZE 24 ECU_ADDRESS 0x3FD6E4 /end MEASUREMENT
/begin MEASUREMENT flp07_f "Lernfilterwert, positiv, Zyl. 7" FLOAT32_IEEE fak_r32_1 1 100 -10000 10000 FORMAT "%27.21" ARRAY_SIZE 24 ECU_ADDRESS 0x3FD744 /end MEASUREMENT
/begin MEASUREMENT flpof1_f "Lernfilterwert, positiv, Drehzahlbereich 1" FLOAT32_IEEE fak_r32_1 1 100 -10000 10000 FORMAT "%27.21" ARRAY_SIZE 12 ECU_ADDRESS 0x3FDF40 /end MEASUREMENT
/begin MEASUREMENT fluartmp_f "Tempor‰rer Basis Schwellwert f¸r Laufunruhe-Abstandsmass" FLOAT32_IEEE default 1 100 -10000 10000 FORMAT "%10.4" ECU_ADDRESS 0x3FAC48 /end MEASUREMENT
/begin MEASUREMENT fluar_f "Basis Schwellwert f¸r Laufunruhe-Abstandsmass" FLOAT32_IEEE fak_r32_1 1 100 -10000 10000 FORMAT "%27.21" ECU_ADDRESS 0x3FAC4C /end MEASUREMENT
/begin MEASUREMENT flurbmi_f "" FLOAT32_IEEE fak_r32_1 1 100 -1e+037 1e+037 FORMAT "%27.0" ECU_ADDRESS 0x3FABF4 /end MEASUREMENT
/begin MEASUREMENT flurb_f "Schwellwert f¸r Laufunruhe" FLOAT32_IEEE fak_r32_1 1 100 -1e+037 1e+037 FORMAT "%27.0" ECU_ADDRESS 0x3FABF8 /end MEASUREMENT
/begin MEASUREMENT flurktm_f "tmot-abh‰ngiger offset zum Laufunruhe-Referenzwert lurs/dlurs" FLOAT32_IEEE fak_r32_1 1 100 -1e+037 1e+037 FORMAT "%27.0" ECU_ADDRESS 0x3FABFC /end MEASUREMENT
/begin MEASUREMENT flurmin1_f "Drehzahlabh. Laufunruhe-Referenz-Minimalwert 1" FLOAT32_IEEE fak_r32_1 1 100 -1e+037 1e+037 FORMAT "%27.0" ECU_ADDRESS 0x3FAC00 /end MEASUREMENT
/begin MEASUREMENT flurmin2_f "Drehzahlabh. Laufunruhe-Referenz-Minimalwert 2" FLOAT32_IEEE fak_r32_1 1 100 -1e+037 1e+037 FORMAT "%27.0" ECU_ADDRESS 0x3FAC04 /end MEASUREMENT
/begin MEASUREMENT flurmin3_f "Drehzahlabh. Laufunruhe-Referenz-Minimalwert 3" FLOAT32_IEEE fak_r32_1 1 100 -1e+037 1e+037 FORMAT "%27.0" ECU_ADDRESS 0x3FAC08 /end MEASUREMENT
/begin MEASUREMENT flurmin_f "Wert von LUR falls Adaption nicht abgeschlossen, Wert aus LURMINN" FLOAT32_IEEE fak_r32_1 1 100 -1e+037 1e+037 FORMAT "%27.0" ECU_ADDRESS 0x3FAC0C /end MEASUREMENT
/begin MEASUREMENT flurmwk_f "Faktor f¸r Laufunruhe-Refernzwert zur Mehrfachaussetzererkennung" FLOAT32_IEEE fak_r32_1 1 100 -1e+037 1e+037 FORMAT "%27.0" ECU_ADDRESS 0x3FAC10 /end MEASUREMENT
/begin MEASUREMENT flurst_f "Korrekturfaktor f¸r Schwellwert Laufunruhe nach Start, Faktor aus LURST" FLOAT32_IEEE fak_r32_1 1 100 -1e+037 1e+037 FORMAT "%27.0" ECU_ADDRESS 0x3FAC14 /end MEASUREMENT
/begin MEASUREMENT flutskzy_f "Filter der Laufunruhe-Testgrˆﬂe, korrigiert, Array ¸ber alle Zylinder" FLOAT32_IEEE fak_r32_1 1 100 -10000 10000 FORMAT "%27.21" ARRAY_SIZE 12 ECU_ADDRESS 0x3FAB44 /end MEASUREMENT
/begin MEASUREMENT flutsk_f "Filter der Laufunruhe-Testgrˆﬂe, korrigiert" FLOAT32_IEEE fak_r32_1 1 100 -10000 10000 FORMAT "%27.21" ECU_ADDRESS 0x3FAB74 /end MEASUREMENT
/begin MEASUREMENT flutszyl_f "Filter der Laufunruhe-Testgrˆﬂe, Array ¸ber alle Zylinder" FLOAT32_IEEE fak_r32_1 1 100 -10000 10000 FORMAT "%27.21" ARRAY_SIZE 12 ECU_ADDRESS 0x3FAA64 /end MEASUREMENT
/begin MEASUREMENT fluts_f "Filter der Laufunruhe-Testgrˆﬂe" FLOAT32_IEEE fak_r32_1 1 100 -10000 10000 FORMAT "%27.21" ECU_ADDRESS 0x3FAA94 /end MEASUREMENT
/begin MEASUREMENT fmsla "Korrekturfaktor Sekund‰rluftmasse adaptiv" UBYTE fak_ub_b2 1 100 0 1.99219 FORMAT "%5.3" ECU_ADDRESS 0x403723 /end MEASUREMENT
/begin MEASUREMENT fmsla2 "Korrekturfaktor Sekund‰rluftmasse adaptiv Bank 2" UBYTE fak_ub_b2 1 100 0 1.99219 FORMAT "%5.3" ECU_ADDRESS 0x403724 /end MEASUREMENT
/begin MEASUREMENT fmslav "Adaptionsfaktor Sekund‰rluftmasse" UBYTE fak_ub_b2 1 100 0 1.99219 FORMAT "%5.3" ECU_ADDRESS 0x3FE38E /end MEASUREMENT
/begin MEASUREMENT fmslav2 "Adaptionsfaktor Sekund‰rluftmasse, Bank 2" UBYTE fak_ub_b2 1 100 0 1.99219 FORMAT "%5.3" ECU_ADDRESS 0x3FE38F /end MEASUREMENT
/begin MEASUREMENT fofresz "Resetz‰hler Lernfilterwert weggelaufen (Fuel-on Adaption)" UWORD dez 1 100 0 65535 FORMAT "%8.2" ECU_ADDRESS 0x3FDF0E /end MEASUREMENT
/begin MEASUREMENT fofstat "Status der fuel-off Adaption im aktuellen Betriebsbereich" UBYTE dez 1 100 0 2 FORMAT "%5.3" ECU_ADDRESS 0x403839 /end MEASUREMENT
/begin MEASUREMENT fofstat_loc "" UBYTE dez 1 100 0 255 FORMAT "%5.1" ECU_ADDRESS 0x40385B /end MEASUREMENT
/begin MEASUREMENT fonstat "Status der fuel-on Adaption im aktuellen Betriebsbereich" UBYTE dez 1 100 0 255 FORMAT "%5.1" ECU_ADDRESS 0x3FE016 /end MEASUREMENT
/begin MEASUREMENT fonstat_loc "" UBYTE dez 1 100 0 255 FORMAT "%5.1" ECU_ADDRESS 0x40385C /end MEASUREMENT
/begin MEASUREMENT fs00_f "Filterwert Laufunruheabweichung, Zyl. 0" FLOAT32_IEEE fak_r32_1 1 100 -10000 10000 FORMAT "%27.21" ARRAY_SIZE 24 ECU_ADDRESS 0x3FD7A4 /end MEASUREMENT
/begin MEASUREMENT fs01_f "Filterwert Segmentabweichung, Zyl. 1" FLOAT32_IEEE fak_r32_1 1 100 -10000 10000 FORMAT "%27.21" ARRAY_SIZE 24 ECU_ADDRESS 0x3FD804 /end MEASUREMENT
/begin MEASUREMENT fs02_f "Filterwert Laufunruheabweichung, Zyl. 2" FLOAT32_IEEE fak_r32_1 1 100 -10000 10000 FORMAT "%27.21" ARRAY_SIZE 24 ECU_ADDRESS 0x3FD864 /end MEASUREMENT
/begin MEASUREMENT fs03_f "Filterwert Laufunruheabweichung, Zyl. 3" FLOAT32_IEEE fak_r32_1 1 100 -10000 10000 FORMAT "%27.21" ARRAY_SIZE 24 ECU_ADDRESS 0x3FD8C4 /end MEASUREMENT
/begin MEASUREMENT fs04_f "Filterwert Laufunruheabweichung, Zyl. 4" FLOAT32_IEEE default 1 100 -10000 10000 FORMAT "%10.4" ARRAY_SIZE 24 ECU_ADDRESS 0x3FD924 /end MEASUREMENT
/begin MEASUREMENT fs05_f "Filterwert Laufunruheabweichung, Zyl. 5" FLOAT32_IEEE fak_r32_1 1 100 -10000 10000 FORMAT "%27.21" ARRAY_SIZE 24 ECU_ADDRESS 0x3FD984 /end MEASUREMENT
/begin MEASUREMENT fs06_f "Filterwert Laufunruheabweichung, Zyl. 6" FLOAT32_IEEE fak_r32_1 1 100 -10000 10000 FORMAT "%27.21" ARRAY_SIZE 24 ECU_ADDRESS 0x3FD9E4 /end MEASUREMENT
/begin MEASUREMENT fs07_f "Filterwert Laufunruheabweichung, Zyl. 7" FLOAT32_IEEE fak_r32_1 1 100 -10000 10000 FORMAT "%27.21" ARRAY_SIZE 24 ECU_ADDRESS 0x3FDA44 /end MEASUREMENT
/begin MEASUREMENT fse00_f "Filterwert Laufunruheabweichung, eingerechnet, Zyl. 0" FLOAT32_IEEE fak_r32_1 1 100 -10000 10000 FORMAT "%27.21" ARRAY_SIZE 24 ECU_ADDRESS 0x3FDAA4 /end MEASUREMENT
/begin MEASUREMENT fse01_f "Filterwert Laufunruheabweichung, eingerechnet, Zyl. 1" FLOAT32_IEEE fak_r32_1 1 100 -10000 10000 FORMAT "%27.21" ARRAY_SIZE 24 ECU_ADDRESS 0x3FDB04 /end MEASUREMENT
/begin MEASUREMENT fse02_f "Filterwert Laufunruheabweichung, eingerechnet, Zyl. 2" FLOAT32_IEEE fak_r32_1 1 100 -10000 10000 FORMAT "%27.21" ARRAY_SIZE 24 ECU_ADDRESS 0x3FDB64 /end MEASUREMENT
/begin MEASUREMENT fse03_f "Filterwert Laufunruheabweichung, eingerechnet, Zyl. 3" FLOAT32_IEEE fak_r32_1 1 100 -10000 10000 FORMAT "%27.21" ARRAY_SIZE 24 ECU_ADDRESS 0x3FDBC4 /end MEASUREMENT
/begin MEASUREMENT fse04_f "Filterwert Laufunruheabweichung, eingerechnet, Zyl. 4" FLOAT32_IEEE fak_r32_1 1 100 -10000 10000 FORMAT "%27.21" ARRAY_SIZE 24 ECU_ADDRESS 0x3FDC24 /end MEASUREMENT
/begin MEASUREMENT fse05_f "Filterwert Laufunruheabweichung, eingerechnet, Zyl. 5" FLOAT32_IEEE fak_r32_1 1 100 -10000 10000 FORMAT "%27.21" ARRAY_SIZE 24 ECU_ADDRESS 0x3FDC84 /end MEASUREMENT
/begin MEASUREMENT fse06_f "Filterwert Laufunruheabweichung, eingerechnet, Zyl. 6" FLOAT32_IEEE fak_r32_1 1 100 -10000 10000 FORMAT "%27.21" ARRAY_SIZE 24 ECU_ADDRESS 0x3FDCE4 /end MEASUREMENT
/begin MEASUREMENT fse07_f "Filterwert Laufunruheabweichung, eingerechnet, Zyl. 7" FLOAT32_IEEE fak_r32_1 1 100 -10000 10000 FORMAT "%27.21" ARRAY_SIZE 24 ECU_ADDRESS 0x3FDD44 /end MEASUREMENT
/begin MEASUREMENT fsearray_f "" FLOAT32_IEEE fak_r32_1 1 100 -10000 10000 FORMAT "%27.21" ARRAY_SIZE 6 ECU_ADDRESS 0x3FAB78 /end MEASUREMENT
/begin MEASUREMENT fsenmz2_f "" FLOAT32_IEEE fak_r32_1 1 100 -10000 10000 FORMAT "%27.21" ECU_ADDRESS 0x3FAB90 /end MEASUREMENT
/begin MEASUREMENT fseof1_f "aktueller Filterwert Segmentabweichung, zur Segmentzeit-Korrektur, Bereich 1" FLOAT32_IEEE fak_r32_1 1 100 -10000 10000 FORMAT "%27.21" ARRAY_SIZE 12 ECU_ADDRESS 0x3FDF70 /end MEASUREMENT
/begin MEASUREMENT fseofkor_f "aktueller Faktor zur Segmentzeit-Korrektur" FLOAT32_IEEE fak_r32_1 1 100 -10000 10000 FORMAT "%27.21" ECU_ADDRESS 0x3FA9C4 /end MEASUREMENT
/begin MEASUREMENT fse_f "aktueller Korrekturwert Fuel-on Adaption" FLOAT32_IEEE fak_r32_1 1 100 -10000 10000 FORMAT "%27.21" ECU_ADDRESS 0x3FAA10 /end MEASUREMENT
/begin MEASUREMENT fsof1_f "Filterwert Segmentabweichung, Betriebsbereich 1" FLOAT32_IEEE fak_r32_1 1 100 -10000 10000 FORMAT "%27.21" ARRAY_SIZE 12 ECU_ADDRESS 0x3FDFA0 /end MEASUREMENT
/begin MEASUREMENT fswares "Erkennungsschwellwert Schlechtwegstrecke (aus einer KL)" UBYTE acc_ub_b55p55 1 100 0 55.335 FORMAT "%5.2" ECU_ADDRESS 0x403BB3 /end MEASUREMENT
/begin MEASUREMENT fzabgs_w "Fehlerz‰hler Summe, z‰hlt abgasrelevante Aussetzer ¸ber alle Zylinder" UWORD dez 1 100 0 65535 FORMAT "%8.2" ECU_ADDRESS 0x4043A8 /end MEASUREMENT
/begin MEASUREMENT fzabgzyl_w "Aussetzerz‰hler" UWORD dez 1 100 0 65535 FORMAT "%8.2" ARRAY_SIZE 12 ECU_ADDRESS 0x4043AA /end MEASUREMENT
/begin MEASUREMENT fzarv_w "Fehlerz‰hler, z‰hlt Aussetzer ¸ber alle Zylinder" UWORD dez 1 100 0 65535 FORMAT "%8.2" ECU_ADDRESS 0x4043C2 /end MEASUREMENT
/begin MEASUREMENT fzkatsb_w "" UWORD dez 1 100 0 65535 FORMAT "%8.2" ARRAY_SIZE 2 ECU_ADDRESS 0x4043C4 /end MEASUREMENT
/begin MEASUREMENT fzkats_w "Fehlerz‰hler Summe, z‰hlt katsch‰digende Aussetzer ¸ber alle Zylinder" UWORD dez 1 100 0 65535 FORMAT "%8.2" ECU_ADDRESS 0x4043C8 /end MEASUREMENT
/begin MEASUREMENT fzkatzyl_w "Freeze frame f¸r DFFTK: Aussetzerz‰hler, katsch‰digende" UWORD dez 1 100 0 65535 FORMAT "%8.2" ARRAY_SIZE 12 ECU_ADDRESS 0x4043CA /end MEASUREMENT
/begin MEASUREMENT fzmdzyl_w "Array  f¸r Anzahl der Aussetzer pro Zylinder" UWORD dez 1 100 0 65535 FORMAT "%8.2" ARRAY_SIZE 12 ECU_ADDRESS 0x3FE01A /end MEASUREMENT
/begin MEASUREMENT hcount "" UBYTE dez 1 100 0 255 FORMAT "%5.1" ECU_ADDRESS 0x402914 /end MEASUREMENT
/begin MEASUREMENT hdfse_f "" FLOAT32_IEEE fak_r32_1 1 100 -10000 10000 FORMAT "%27.21" ECU_ADDRESS 0x3FAA14 /end MEASUREMENT
/begin MEASUREMENT hflmx_f "" FLOAT32_IEEE fak_r32_1 1 100 -10000 10000 FORMAT "%27.21" ECU_ADDRESS 0x402918 /end MEASUREMENT
/begin MEASUREMENT idxfob "Index: Kennzeichnet den aktuellen KF-Bereich (Drehz., Last)" UBYTE dez 1 100 0 255 FORMAT "%5.1" ECU_ADDRESS 0x40383D /end MEASUREMENT
/begin MEASUREMENT idxfomi "Momentenindex f¸r Betriebsbereich der fuel-on Adaption" UBYTE dez 1 100 0 255 FORMAT "%5.1" ECU_ADDRESS 0x40383E /end MEASUREMENT
/begin MEASUREMENT idxfomii "" UBYTE dez 1 100 0 255 FORMAT "%5.1" ECU_ADDRESS 0x40383F /end MEASUREMENT
/begin MEASUREMENT idxfomit "" UBYTE dez 1 100 0 255 FORMAT "%5.1" ECU_ADDRESS 0x403840 /end MEASUREMENT
/begin MEASUREMENT idxfon "Drehzahlindex f¸r Betriebsbereich der fuel-on Adaption" UBYTE dez 1 100 0 255 FORMAT "%5.1" ECU_ADDRESS 0x403841 /end MEASUREMENT
/begin MEASUREMENT idxfoni "" UBYTE dez 1 100 0 255 FORMAT "%5.1" ECU_ADDRESS 0x403842 /end MEASUREMENT
/begin MEASUREMENT idxfont "" UBYTE dez 1 100 0 255 FORMAT "%5.1" ECU_ADDRESS 0x403843 /end MEASUREMENT
/begin MEASUREMENT idx_base "" UBYTE dez 1 100 0 255 FORMAT "%5.1" ECU_ADDRESS 0x403844 /end MEASUREMENT
/begin MEASUREMENT idx_right "" UBYTE dez 1 100 0 255 FORMAT "%5.1" ECU_ADDRESS 0x403845 /end MEASUREMENT
/begin MEASUREMENT idx_up "" UBYTE dez 1 100 0 255 FORMAT "%5.1" ECU_ADDRESS 0x403846 /end MEASUREMENT
/begin MEASUREMENT idx_up_right "" UBYTE dez 1 100 0 255 FORMAT "%5.1" ECU_ADDRESS 0x403847 /end MEASUREMENT
/begin MEASUREMENT ignitioz_w "Anzahl Z¸ndung, ‹bergabe an Zustandsautomat" UWORD DEZ 1 100 0 65535 FORMAT "%8.2" ECU_ADDRESS 0x4043FA /end MEASUREMENT
/begin MEASUREMENT imlfta2_w "Integrierte Luftmasse zum Setzen des Fehlers LSU fett (Typa), Bank 2" UWORD m_q2p777Em5_kg 1 100 0 1.82042 FORMAT "%8.6" ECU_ADDRESS 0x402B24 /end MEASUREMENT
/begin MEASUREMENT imlfta_w "Integrierte Luftmasse zum Setzen des Fehlers LSU fett (Typa)" UWORD m_q2p777Em5_kg 1 100 0 1.82042 FORMAT "%8.6" ECU_ADDRESS 0x402B26 /end MEASUREMENT
/begin MEASUREMENT imlftb2_w "Integrierte Luftmasse zum Setzen des Fehlers LSU fett (Typ b), Bank 2" UWORD m_q2p777Em5_kg 1 100 0 1.82042 FORMAT "%8.6" ECU_ADDRESS 0x3FE09E /end MEASUREMENT
/begin MEASUREMENT imlftb_w "Integrierte Luftmasse zum Setzen des Fehlers LSU fett (Typ b)" UWORD m_q2p777Em5_kg 1 100 0 1.82042 FORMAT "%8.6" ECU_ADDRESS 0x3FE0A0 /end MEASUREMENT
/begin MEASUREMENT imlmra2_w "Integrierte Luftmasse zum Setzen des Fehlers LSU mager (Typ a), Bank 2" UWORD m_q2p777Em5_kg 1 100 0 1.82042 FORMAT "%8.6" ECU_ADDRESS 0x402B28 /end MEASUREMENT
/begin MEASUREMENT imlmra_w "Integrierte Luftmasse zum Setzen des Fehlers LSU mager (Typ a)" UWORD m_q2p777Em5_kg 1 100 0 1.82042 FORMAT "%8.6" ECU_ADDRESS 0x402B2A /end MEASUREMENT
/begin MEASUREMENT imlmrb2_w "Integrierte Luftmasse zum Setzen des Fehlers LSU mager (Typ b), Bank 2" UWORD m_q2p777Em5_kg 1 100 0 1.82042 FORMAT "%8.6" ECU_ADDRESS 0x3FE0A2 /end MEASUREMENT
/begin MEASUREMENT imlmrb_w "Integrierte Luftmasse zum Setzen des Fehlers LSU mager (Typ b)" UWORD m_q2p777Em5_kg 1 100 0 1.82042 FORMAT "%8.6" ECU_ADDRESS 0x3FE0A4 /end MEASUREMENT
/begin MEASUREMENT imlplhe2_w "Integrierte Luftmasse zum Heilen/Zyklusflag setzen in der Funktion DPLLSU, B2" UWORD m_q2p777Em5_kg 1 100 0 1.82042 FORMAT "%8.6" ECU_ADDRESS 0x402B2C /end MEASUREMENT
/begin MEASUREMENT imlplhe_w "Integrierte Luftmasse zum Heilen/Zyklusflag setzen in der Funktion DPLLSU" UWORD m_q2p777Em5_kg 1 100 0 1.82042 FORMAT "%8.6" ECU_ADDRESS 0x402B2E /end MEASUREMENT
/begin MEASUREMENT ivzabg_w "Intervallz‰hler f¸r abgasrelevante Aussetzer (0-1000 KW-Umdr. bzw. 0-500 NW-Um.)" UWORD dez 1 100 0 65535 FORMAT "%8.2" ECU_ADDRESS 0x4043E2 /end MEASUREMENT
/begin MEASUREMENT ivzaint_w "Intervallz‰hler f¸r Freigabe ti-Abschaltung (0-200 Kw-Umdr.)" UWORD dez 1 100 0 65535 FORMAT "%8.2" ECU_ADDRESS 0x4043E4 /end MEASUREMENT
/begin MEASUREMENT ivzarv_w "Intervallz‰hler f¸r Aussetzer (0-60 KW-Umdr.), zur Ausblendung weiterer Funktion" UWORD dez 1 100 0 65535 FORMAT "%8.2" ECU_ADDRESS 0x4043E6 /end MEASUREMENT
/begin MEASUREMENT ivzkat_w "Intervallz‰hler f¸r katsch‰digende Aussetzer (0-200 Kw-Umdr. bzw. 0-100 NW-Um.)" UWORD dez 1 100 0 65535 FORMAT "%8.2" ECU_ADDRESS 0x4043E8 /end MEASUREMENT
/begin MEASUREMENT kamfz_w "" UWORD kw_tooth_sy 1 100 0 393210 FORMAT "%8.1" ECU_ADDRESS 0x404684 /end MEASUREMENT
/begin MEASUREMENT kswf "Kat.-Schutz-Wichtungsfaktoren, aus KFKSWF" UBYTE dez 1 100 0 255 FORMAT "%5.1" ECU_ADDRESS 0x402955 /end MEASUREMENT
/begin MEASUREMENT lastmodz_w "Status letzter Modus im Durchlauf des Aussetzerprogrammes" UWORD DEZ 1 100 0 65535 FORMAT "%8.2" ECU_ADDRESS 0x4043FC /end MEASUREMENT
/begin MEASUREMENT luaralt_f "Laufunruhe-Abstandsmass-Referenzwert offset (alter Wert)" FLOAT32_IEEE fak_r32_1 1 100 -10000 10000 FORMAT "%27.21" ECU_ADDRESS 0x3FAC50 /end MEASUREMENT
/begin MEASUREMENT luarmn_f "Laufunruhe-Abstandsmass-Referenzwert Minimun" FLOAT32_IEEE fak_r32_1 1 100 -10000 10000 FORMAT "%27.21" ECU_ADDRESS 0x3FAC54 /end MEASUREMENT
/begin MEASUREMENT luaroff_f "Laufunruhe-Abstandsmass-Referenzwert offset" FLOAT32_IEEE fak_r32_1 1 100 -10000 10000 FORMAT "%27.21" ECU_ADDRESS 0x3FAC58 /end MEASUREMENT
/begin MEASUREMENT luar_f "Laufunruhe-Abstandsmass-Referenzwert" FLOAT32_IEEE fak_r32_1 1 100 -10000 10000 FORMAT "%27.21" ECU_ADDRESS 0x3FAC5C /end MEASUREMENT
/begin MEASUREMENT lums_f "Laufunruhe-Mittelwert f¸r Erkennung Mehrfachaussetzer, signed" FLOAT32_IEEE fak_r32_1 1 100 -1e+037 1e+037 FORMAT "%27.0" ECU_ADDRESS 0x3FAC18 /end MEASUREMENT
/begin MEASUREMENT lunw_f "Laufunruhe ¸ber 1 NW-Umdr." FLOAT32_IEEE fak_r32_1 1 100 -10000 10000 FORMAT "%27.21" ECU_ADDRESS 0x3FAA98 /end MEASUREMENT
/begin MEASUREMENT lurmsalt_f "vorangegangener Wert von lurms_f" FLOAT32_IEEE fak_r32_1 1 100 -1e+037 1e+037 FORMAT "%27.0" ECU_ADDRESS 0x3FAC1C /end MEASUREMENT
/begin MEASUREMENT lurms_f "Laufunruhe-Referenzwert f¸r Mehrfachaussetzererkennung, -> Vgl. mit Lum, signed" FLOAT32_IEEE fak_r32_1 1 100 -1e+037 1e+037 FORMAT "%27.0" ECU_ADDRESS 0x3FAC20 /end MEASUREMENT
/begin MEASUREMENT lursalt_f "vorangegangener Wert von lurs_f" FLOAT32_IEEE fak_r32_1 1 100 -1e+037 1e+037 FORMAT "%27.0" ECU_ADDRESS 0x3FAC24 /end MEASUREMENT
/begin MEASUREMENT lurs_f "Laufunruhe-Referenzwert, signed" FLOAT32_IEEE fak_r32_1 1 100 -1e+037 1e+037 FORMAT "%27.0" ECU_ADDRESS 0x3FAC28 /end MEASUREMENT
/begin MEASUREMENT lutsdarray_f "" FLOAT32_IEEE fak_r32_1 1 100 -10000 10000 FORMAT "%27.21" ARRAY_SIZE 6 ECU_ADDRESS 0x3FAA9C /end MEASUREMENT
/begin MEASUREMENT lutsknm1 "" FLOAT32_IEEE fak_r32_1 1 100 -1e+037 1e+037 FORMAT "%27.0" ECU_ADDRESS 0x3FAC2C /end MEASUREMENT
/begin MEASUREMENT lutsknm2 "" FLOAT32_IEEE fak_r32_1 1 100 -1e+037 1e+037 FORMAT "%27.0" ECU_ADDRESS 0x3FAC30 /end MEASUREMENT
/begin MEASUREMENT lutskzyl_f "Laufunruhe-Testgrˆﬂe, signed, korrigiert, Array ¸ber alle Zylinder" FLOAT32_IEEE fak_r32_1 1 100 -10000 10000 FORMAT "%27.21" ARRAY_SIZE 12 ECU_ADDRESS 0x3FAB94 /end MEASUREMENT
/begin MEASUREMENT lutsk_f "Laufunruhe-Testgrˆﬂe, signed, korrigiert, Monitor" FLOAT32_IEEE fak_r32_1 1 100 -10000 10000 FORMAT "%27.21" ECU_ADDRESS 0x3FABC4 /end MEASUREMENT
/begin MEASUREMENT lutszyl_f "Laufunruhe-Testgrˆﬂe, Array ¸ber alle Zylinder" FLOAT32_IEEE fak_r32_1 1 100 -10000 10000 FORMAT "%27.21" ARRAY_SIZE 12 ECU_ADDRESS 0x3FAAB4 /end MEASUREMENT
/begin MEASUREMENT luts_f "Laufunruhe-Testgrˆﬂe" FLOAT32_IEEE fak_r32_1 1 100 -10000 10000 FORMAT "%27.21" ECU_ADDRESS 0x3FAAE4 /end MEASUREMENT
/begin MEASUREMENT m6amsl "Mode 6 - Speicher: Anzahl Werteblˆcke bei Pr¸fung Sekund‰rluftmasse" UBYTE dez 1 100 0 255 FORMAT "%5.1" ECU_ADDRESS 0x3FE390 /end MEASUREMENT
/begin MEASUREMENT m6cmsl "Mode 6 - Speicher: Component ID f¸r Pr¸fung Sekund‰rluftsystem" UBYTE dez 1 100 0 255 FORMAT "%5.1" ECU_ADDRESS 0x3FE391 /end MEASUREMENT
/begin MEASUREMENT m6cmsl2 "Mode 6 - Speicher: Component ID f¸r Pr¸fung Sekund‰rluftsystem (Bank 2)" UBYTE dez 1 100 0 255 FORMAT "%5.1" ECU_ADDRESS 0x3FE392 /end MEASUREMENT
/begin MEASUREMENT m6cmslv "Mode 6 - Speicher: Component ID f¸r Pr¸fung Dichtheit Sekund‰rluftsystem" UBYTE dez 1 100 0 255 FORMAT "%5.1" ECU_ADDRESS 0x3FE393 /end MEASUREMENT
/begin MEASUREMENT m6cmslv2 "Mode 6 - Speicher: Component ID f¸r Pr¸fung Dichtheit Sekund‰rluftsystem" UBYTE dez 1 100 0 255 FORMAT "%5.1" ECU_ADDRESS 0x3FE394 /end MEASUREMENT
/begin MEASUREMENT m6smsl2_w "Mode 6 - Speicher: Schwellwert bei Pr¸fung Sekund‰rluftmasse, Bank 2" UWORD dez 1 100 0 65535 FORMAT "%8.2" ECU_ADDRESS 0x3FE398 /end MEASUREMENT
/begin MEASUREMENT m6smslv2_w "Mode 6 - Speicher: Schwellwert bei Ventildichtheitspr¸fung, Bank 2" UWORD dez 1 100 0 65535 FORMAT "%8.2" ECU_ADDRESS 0x3FE39A /end MEASUREMENT
/begin MEASUREMENT m6smslv_w "Mode 6 - Speicher: Schwellwert bei Ventildichtheitspr¸fung" UWORD dez 1 100 0 65535 FORMAT "%8.2" ECU_ADDRESS 0x3FE39C /end MEASUREMENT
/begin MEASUREMENT m6smsl_w "Mode 6 - Speicher: Schwellwert bei Pr¸fung Sekund‰rluftmasse" UWORD dez 1 100 0 65535 FORMAT "%8.2" ECU_ADDRESS 0x3FE39E /end MEASUREMENT
/begin MEASUREMENT m6wmsl2_w "Mode 6 - Speicher: Messwert Sekund‰rluftmasse bei SL-Einblasung, Bank 2" UWORD dez 1 100 0 65535 FORMAT "%8.2" ECU_ADDRESS 0x3FE3A0 /end MEASUREMENT
/begin MEASUREMENT m6wmslv2_w "Mode 6 - Speicher: Messwert Ventildichtheit, Bank 2" UWORD dez 1 100 0 65535 FORMAT "%8.2" ECU_ADDRESS 0x3FE3A2 /end MEASUREMENT
/begin MEASUREMENT m6wmslv_w "Mode 6 - Speicher: Messwert Ventildichtheit" UWORD dez 1 100 0 65535 FORMAT "%8.2" ECU_ADDRESS 0x3FE3A4 /end MEASUREMENT
/begin MEASUREMENT m6wmsl_w "Mode 6 - Speicher: Messwert Sekund‰rluftmasse bei SL-Einblasung" UWORD dez 1 100 0 65535 FORMAT "%8.2" ECU_ADDRESS 0x3FE3A6 /end MEASUREMENT
/begin MEASUREMENT maxfse_f "" FLOAT32_IEEE fak_r32_1 1 100 -10000 10000 FORMAT "%27.21" ECU_ADDRESS 0x3FAA18 /end MEASUREMENT
/begin MEASUREMENT milstat "" UBYTE dez 1 100 0 255 FORMAT "%5.1" ECU_ADDRESS 0x403B2E /end MEASUREMENT
/begin MEASUREMENT minfse_f "" FLOAT32_IEEE fak_r32_1 1 100 -10000 10000 FORMAT "%27.21" ECU_ADDRESS 0x3FAA1C /end MEASUREMENT
/begin MEASUREMENT misfirez_w "Anzahl Aussetzer, ‹bergabe an Zustandsautomat" UWORD DEZ 1 100 0 65535 FORMAT "%8.2" ECU_ADDRESS 0x4043FE /end MEASUREMENT
/begin MEASUREMENT mi_base "" UBYTE dez 1 100 0 255 FORMAT "%5.1" ECU_ADDRESS 0x403848 /end MEASUREMENT
/begin MEASUREMENT mi_up "" UBYTE dez 1 100 0 255 FORMAT "%5.1" ECU_ADDRESS 0x403849 /end MEASUREMENT
/begin MEASUREMENT mle_error "Errorstatus f¸r MLE" UBYTE dez 1 100 0 255 FORMAT "%5.1" ECU_ADDRESS 0x402BF9 /end MEASUREMENT
/begin MEASUREMENT modez_w "aktuell abgearbeiteter Aussetzermode" UWORD DEZ 1 100 0 65535 FORMAT "%8.2" ECU_ADDRESS 0x404400 /end MEASUREMENT
/begin MEASUREMENT mslift "Istwert Sekund‰rluftmasse, gefiltert, tempor‰r" UBYTE m_q0p4 1 100 0 102 FORMAT "%5.1" ECU_ADDRESS 0x403725 /end MEASUREMENT
/begin MEASUREMENT mslift2 "Istwert Sekund‰rluftmasse, gefiltert, tempor‰r (Bank 2)" UBYTE m_q0p4 1 100 0 102 FORMAT "%5.1" ECU_ADDRESS 0x403726 /end MEASUREMENT
/begin MEASUREMENT mslnenn "Nennwert Sekund‰rluftmasse" UBYTE m_q0p4 1 100 0 102 FORMAT "%5.1" ECU_ADDRESS 0x3FE395 /end MEASUREMENT
/begin MEASUREMENT mslnenn2 "Nennwert Sekund‰rluftmasse, Bank 2" UBYTE m_q0p4 1 100 0 102 FORMAT "%5.1" ECU_ADDRESS 0x3FE396 /end MEASUREMENT
/begin MEASUREMENT mslnf "Nenn-Sekund‰rluftmasse, gefiltert" UBYTE m_q0p4 1 100 0 102 FORMAT "%5.1" ECU_ADDRESS 0x403727 /end MEASUREMENT
/begin MEASUREMENT mslnf2 "Nenn-Sekund‰rluftmasse, gefiltert, Bank 2" UBYTE m_q0p4 1 100 0 102 FORMAT "%5.1" ECU_ADDRESS 0x403728 /end MEASUREMENT
/begin MEASUREMENT mslnt "Nenn-Sekund‰rluftmasse, tempor‰r" UBYTE m_q0p4 1 100 0 102 FORMAT "%5.1" ECU_ADDRESS 0x403729 /end MEASUREMENT
/begin MEASUREMENT mslnt2 "Nenn-Sekund‰rluftmasse,tempor‰r, Bank 2" UBYTE m_q0p4 1 100 0 102 FORMAT "%5.1" ECU_ADDRESS 0x40372A /end MEASUREMENT
/begin MEASUREMENT mslt2_w "tempor‰re Sekund‰rluftmasse, Bank 2" UWORD m_uw_b6553p5 1 100 0 6553.5 FORMAT "%8.3" ECU_ADDRESS 0x403738 /end MEASUREMENT
/begin MEASUREMENT mslt_w "tempor‰re Sekund‰rluftmasse" UWORD m_uw_b6553p5 1 100 0 6553.5 FORMAT "%8.3" ECU_ADDRESS 0x40373A /end MEASUREMENT
/begin MEASUREMENT mslv2_w "Sekund‰rluftmasse f¸r Ventildichtheitspr¸fung (word); Bank 2" UWORD m_q0p0015625 1 100 0 102.398 FORMAT "%8.4" ECU_ADDRESS 0x40373C /end MEASUREMENT
/begin MEASUREMENT mslvft2_w "" SWORD m_q0p0015625 1 100 -51.2 51.1984 FORMAT "%8.5" ECU_ADDRESS 0x40373E /end MEASUREMENT
/begin MEASUREMENT mslvft_w "Sekund‰rluftventilundichtheit, gefiltert, tempor‰r (word)" SWORD m_q0p0015625 1 100 -51.2 51.1984 FORMAT "%8.5" ECU_ADDRESS 0x403740 /end MEASUREMENT
/begin MEASUREMENT mslvt2_w "tempor‰re Ventilleckage, Bank 2" SWORD m_sw_q0p1 1 100 -3276.8 3276.7 FORMAT "%8.3" ECU_ADDRESS 0x403742 /end MEASUREMENT
/begin MEASUREMENT mslvt_w "tempor‰re Ventilleckage" SWORD m_sw_q0p1 1 100 -3276.8 3276.7 FORMAT "%8.3" ECU_ADDRESS 0x403744 /end MEASUREMENT
/begin MEASUREMENT mslv_w "Sekund‰rluftmasse f¸r Ventildichtheitspr¸fung (word)" UWORD m_q0p0015625 1 100 0 102.398 FORMAT "%8.4" ECU_ADDRESS 0x403746 /end MEASUREMENT
/begin MEASUREMENT n1 "Drehzahl 1 U/min/Inkrement" UBYTE dez 1 100 0 255 FORMAT "%5.1" ECU_ADDRESS 0x40384A /end MEASUREMENT
/begin MEASUREMENT n2 "Drehzahl (2-Byte-Adresse)" UBYTE dez 1 100 0 255 FORMAT "%5.1" ECU_ADDRESS 0x40384B /end MEASUREMENT
/begin MEASUREMENT nvrbactctr "NVRAM-Backup-Z‰hler Flash" UWORD dez 1 100 0 65535 FORMAT "%8.2" ECU_ADDRESS 0x3FE29C /end MEASUREMENT
/begin MEASUREMENT nwnumbz_w "Anzahl Nockenwellenumdrehungen, ‹bergabe an Zustandsautomat" UWORD DEZ 1 100 0 65535 FORMAT "%8.2" ECU_ADDRESS 0x404402 /end MEASUREMENT
/begin MEASUREMENT olderrc "Fehlerz‰hler f¸r die Diagnose des ÷ldruckschalters" UBYTE dez 1 100 0 255 FORMAT "%5.1" ECU_ADDRESS 0x3FE0B7 /end MEASUREMENT
/begin MEASUREMENT ozniverrz "Z‰hler f¸r anliegenden Niv-Fehler" UBYTE DEZ 1 100 0 255 FORMAT "%5.1" ECU_ADDRESS 0x3FE968 /end MEASUREMENT
/begin MEASUREMENT ozpermerrz "Z‰hler f¸r anliegenden Perm-Fehler" UBYTE DEZ 1 100 0 255 FORMAT "%5.1" ECU_ADDRESS 0x3FE969 /end MEASUREMENT
/begin MEASUREMENT ozsigerrz "Z‰hler f¸r anliegenden Signalfehler" UBYTE DEZ 1 100 0 255 FORMAT "%5.1" ECU_ADDRESS 0x3FE96A /end MEASUREMENT
/begin MEASUREMENT oztemperrz "Z‰hler f¸r anliegenden Temp-Fehler" UBYTE DEZ 1 100 0 255 FORMAT "%5.1" ECU_ADDRESS 0x3FE96B /end MEASUREMENT
/begin MEASUREMENT pausez_w "Anzahl Pausensegmente, ‹bergabe an Zustandsautomat" UWORD DEZ 1 100 0 65535 FORMAT "%8.2" ECU_ADDRESS 0x404404 /end MEASUREMENT
/begin MEASUREMENT pgmaster "Nummer des Phasengebers welcher Master ist" UBYTE dez 1 100 0 255 FORMAT "%5.1" ECU_ADDRESS 0x3FE068 /end MEASUREMENT
/begin MEASUREMENT ph1edpos_w "Array mit Phasenflankenwinkeln des PG1 vom Hardwaretreiber" UWORD kw_q0p1 1 100 0 6553.5 FORMAT "%8.3" ARRAY_SIZE 9 ECU_ADDRESS 0x40445A /end MEASUREMENT
/begin MEASUREMENT ph2bmerr "Summierer f¸r falschen Phasenpegel an BM bei PG2" SBYTE fak_q0p5 1 100 -64 63.5 FORMAT "%5.2" ECU_ADDRESS 0x4038A9 /end MEASUREMENT
/begin MEASUREMENT ph2edpos_w "Array mit Phasenflankenwinkeln des PG2 vom Hardwaretreiber" UWORD kw_q0p1 1 100 0 6553.5 FORMAT "%8.3" ARRAY_SIZE 9 ECU_ADDRESS 0x40446C /end MEASUREMENT
/begin MEASUREMENT ph3bmerr "Summierer f¸r falschen Phasenpegel an BM bei PG3" SBYTE fak_q0p5 1 100 -64 63.5 FORMAT "%5.2" ECU_ADDRESS 0x4038AA /end MEASUREMENT
/begin MEASUREMENT ph3edpos_w "Array mit Phasenflankenwinkeln des PG3 vom Hardwaretreiber" UWORD kw_q0p1 1 100 0 6553.5 FORMAT "%8.3" ARRAY_SIZE 9 ECU_ADDRESS 0x40447E /end MEASUREMENT
/begin MEASUREMENT ph4bmerr "Summierer f¸r falschen Phasenpegel an BM bei PG4" SBYTE fak_q0p5 1 100 -64 63.5 FORMAT "%5.2" ECU_ADDRESS 0x4038AB /end MEASUREMENT
/begin MEASUREMENT ph4edpos_w "Array mit Phasenflankenwinkeln des PG4 vom Hardwaretreiber" UWORD kw_q0p1 1 100 0 6553.5 FORMAT "%8.3" ARRAY_SIZE 9 ECU_ADDRESS 0x404490 /end MEASUREMENT
/begin MEASUREMENT phbmerr "Summierer f¸r falschen Phasenpegel an BM bei PG1" SBYTE fak_q0p5 1 100 -64 63.5 FORMAT "%5.2" ECU_ADDRESS 0x4038AC /end MEASUREMENT
/begin MEASUREMENT randreg_w "Startwert Zufallsgenerator" UWORD DEZ 1 100 0 65535 FORMAT "%8.2" ECU_ADDRESS 0x404406 /end MEASUREMENT
/begin MEASUREMENT rmsl "relative Sekund‰rluftmasse" UBYTE fak_ub_b2 1 100 0 1.99219 FORMAT "%5.3" ECU_ADDRESS 0x40372B /end MEASUREMENT
/begin MEASUREMENT rmsl2 "relative Sekund‰rluftmasse, Bank 2" UBYTE fak_ub_b2 1 100 0 1.99219 FORMAT "%5.3" ECU_ADDRESS 0x40372C /end MEASUREMENT
/begin MEASUREMENT rmslt "relative Sekund‰rluftmasse ohne Offset- Korrektur" UBYTE fak_ub_b2 1 100 0 1.99219 FORMAT "%5.3" ECU_ADDRESS 0x40372D /end MEASUREMENT
/begin MEASUREMENT rmslt2 "relative Sekund‰rluftmasse ohne Offset- Korrektur, Bank 2" UBYTE fak_ub_b2 1 100 0 1.99219 FORMAT "%5.3" ECU_ADDRESS 0x40372E /end MEASUREMENT
/begin MEASUREMENT seg1BegD_w "Offset Softwarebezugsmarke zu Segmentbeginn" UWORD kw_tooth_sy 1 100 0 393210 FORMAT "%8.1" ECU_ADDRESS 0x404686 /end MEASUREMENT
/begin MEASUREMENT seg2BegD_w "Offset Softwarebezugsmarke zu Segmentende" UWORD kw_tooth_sy 1 100 0 393210 FORMAT "%8.1" ECU_ADDRESS 0x404688 /end MEASUREMENT
/begin MEASUREMENT SfpMin_EVzyl "" UBYTE default 1 100 0 1 FORMAT "%5.3" ARRAY_SIZE 8 ECU_ADDRESS 0x403877 /end MEASUREMENT
/begin MEASUREMENT slfoo_f "obere Schwelle f¸r flmx_f, aus Kennlinie SLFOO1/2N" FLOAT32_IEEE fak_r32_1 1 100 -10000 10000 FORMAT "%27.21" ECU_ADDRESS 0x40291C /end MEASUREMENT
/begin MEASUREMENT slfou_f "untere Schwelle f¸r flmx_f, aus Kennlinie SLFOU1/2N" FLOAT32_IEEE fak_r32_1 1 100 -10000 10000 FORMAT "%27.21" ECU_ADDRESS 0x402920 /end MEASUREMENT
/begin MEASUREMENT sls2fft1 "festgehaltener Umweltwert 1  f¸r SLS Bank 2 Diagnose: entspricht frm2_u" UBYTE fak_ub_b2 1 100 0 1.99219 FORMAT "%5.3" ECU_ADDRESS 0x403D54 /end MEASUREMENT
/begin MEASUREMENT sls2fft2 "festgehaltener Umweltwert 2  f¸r SLS Bank 2 Diagnose: entspricht lamsons2_u" UBYTE fak_ub_b16 1 100 0 15.9375 FORMAT "%5.2" ECU_ADDRESS 0x403D55 /end MEASUREMENT
/begin MEASUREMENT sls2fft3 "festgehaltener Umweltwert 3  f¸r SLS Bank 2 Diagnose: entspricht fho_u" UBYTE fak_q0p015625 1 100 0 3.98438 FORMAT "%5.3" ECU_ADDRESS 0x403D56 /end MEASUREMENT
/begin MEASUREMENT sls2fft4 "festgehaltener Umweltwert 4  f¸r SLS Bank 2 Diagnose: entspricht tmst" UBYTE temp_ub_q0p75_o48 1 100 -48 143.25 FORMAT "%5.1" ECU_ADDRESS 0x403D57 /end MEASUREMENT
/begin MEASUREMENT slsfft1 "festgehaltener Umweltwert 1  f¸r SLS Diagnose: entspricht frm_u" UBYTE fak_ub_b2 1 100 0 1.99219 FORMAT "%5.3" ECU_ADDRESS 0x403D58 /end MEASUREMENT
/begin MEASUREMENT slsfft2 "festgehaltener Umweltwert 2  f¸r SLS Diagnose: entspricht lamsons_u" UBYTE fak_ub_b16 1 100 0 15.9375 FORMAT "%5.2" ECU_ADDRESS 0x403D59 /end MEASUREMENT
/begin MEASUREMENT slsfft3 "festgehaltener Umweltwert 3  f¸r SLS Diagnose: entspricht fho_u" UBYTE fak_q0p015625 1 100 0 3.98438 FORMAT "%5.3" ECU_ADDRESS 0x403D5A /end MEASUREMENT
/begin MEASUREMENT slsfft4 "festgehaltener Umweltwert 4  f¸r SLS Diagnose: entspricht tmst" UBYTE temp_ub_q0p75_o48 1 100 -48 143.25 FORMAT "%5.1" ECU_ADDRESS 0x403D5B /end MEASUREMENT
/begin MEASUREMENT slv1tst "Zustandsz‰hler f¸r Slavetest  1 Zustandsautomat" UBYTE dez 1 100 0 255 FORMAT "%5.1" ECU_ADDRESS 0x402981 /end MEASUREMENT
/begin MEASUREMENT slv2tst "Zustandsz‰hler f¸r Slavetest  2 Zustandsautomat" UBYTE dez 1 100 0 255 FORMAT "%5.1" ECU_ADDRESS 0x402982 /end MEASUREMENT
/begin MEASUREMENT slv3tst "Zustandsz‰hler f¸r Slavetest  3 Zustandsautomat" UBYTE dez 1 100 0 255 FORMAT "%5.1" ECU_ADDRESS 0x402983 /end MEASUREMENT
/begin MEASUREMENT slv4tst "Zustandsz‰hler f¸r Slavetest  4 Zustandsautomat" UBYTE dez 1 100 0 255 FORMAT "%5.1" ECU_ADDRESS 0x402984 /end MEASUREMENT
/begin MEASUREMENT sph2flok "Summierer f¸r Phasenflanken an richtiger Position bei PG2" SBYTE fak_q0p5 1 100 -64 63.5 FORMAT "%5.2" ECU_ADDRESS 0x4038AD /end MEASUREMENT
/begin MEASUREMENT sph3flok "Summierer f¸r Phasenflanken an richtiger Position bei PG3" SBYTE fak_q0p5 1 100 -64 63.5 FORMAT "%5.2" ECU_ADDRESS 0x4038AE /end MEASUREMENT
/begin MEASUREMENT sph4flok "Summierer f¸r Phasenflanken an richtiger Position bei PG4" SBYTE fak_q0p5 1 100 -64 63.5 FORMAT "%5.2" ECU_ADDRESS 0x4038AF /end MEASUREMENT
/begin MEASUREMENT sphflok "Summierer f¸r Phasenflanken an richtiger Position bei PG1" SBYTE fak_q0p5 1 100 -64 63.5 FORMAT "%5.2" ECU_ADDRESS 0x4038B0 /end MEASUREMENT
/begin MEASUREMENT tdkomp_f "Dynamikkompensation zur Laufunruheberechnung, DMD" FLOAT32_IEEE fak_r32_1 1 100 -10000 10000 FORMAT "%27.21" ECU_ADDRESS 0x3FAAE8 /end MEASUREMENT
/begin MEASUREMENT tdsta_ctr "Timer Startautomatik" UBYTE dez 1 100 0 255 FORMAT "%5.1" ECU_ADDRESS 0x4038C3 /end MEASUREMENT
/begin MEASUREMENT tdsuectr "" UBYTE t100msxs_ub_b25p5 1 100 0 25.5 FORMAT "%5.2" ECU_ADDRESS 0x402BFB /end MEASUREMENT
/begin MEASUREMENT tdsuehctr "" UBYTE t100msxs_ub_b25p5 1 100 0 25.5 FORMAT "%5.2" ECU_ADDRESS 0x402BFC /end MEASUREMENT
/begin MEASUREMENT tdsuemnctr "" UBYTE t100msxs_ub_b25p5 1 100 0 25.5 FORMAT "%5.2" ECU_ADDRESS 0x402BFD /end MEASUREMENT
/begin MEASUREMENT tdsuemxctr "" UBYTE t100msxs_ub_b25p5 1 100 0 25.5 FORMAT "%5.2" ECU_ADDRESS 0x402BFE /end MEASUREMENT
/begin MEASUREMENT tsbsyctr "Synchroz‰hler f¸r DMDTSB (Wertebereich TSBINVALID + 1)" UBYTE dez 1 100 0 255 FORMAT "%5.1" ECU_ADDRESS 0x403923 /end MEASUREMENT
/begin MEASUREMENT tsegDmd_l "" ULONG dez 1 100 0 4.29497e+009 FORMAT "%13.2" ECU_ADDRESS 0x404A88 /end MEASUREMENT
/begin MEASUREMENT tsip1_f "" FLOAT32_IEEE fak_r32_1 1 100 -10000 10000 FORMAT "%27.21" ARRAY_SIZE 12 ECU_ADDRESS 0x402884 /end MEASUREMENT
/begin MEASUREMENT tsi_f "" FLOAT32_IEEE fak_r32_1 1 100 -10000 10000 FORMAT "%27.21" ARRAY_SIZE 12 ECU_ADDRESS 0x4028B4 /end MEASUREMENT
/begin MEASUREMENT tskarray_f "korrigierte Segmentdauer, Array ¸ber die letzten Werte" FLOAT32_IEEE fak_r32_1 1 100 -10000 10000 FORMAT "%27.21" ARRAY_SIZE 32 ECU_ADDRESS 0x404C30 /end MEASUREMENT
/begin MEASUREMENT tskdelay "DMD Verzˆgerung Auswertung Segmentzeit" UBYTE default 1 100 0 16 FORMAT "%5.2" ECU_ADDRESS 0x403852 /end MEASUREMENT
/begin MEASUREMENT tskdiffwidx "" UBYTE dez 1 100 0 255 FORMAT "%5.1" ECU_ADDRESS 0x403853 /end MEASUREMENT
/begin MEASUREMENT tskdnarray_f "" FLOAT32_IEEE fak_r32_1 1 100 -10000 10000 FORMAT "%27.21" ARRAY_SIZE 6 ECU_ADDRESS 0x3FAAEC /end MEASUREMENT
/begin MEASUREMENT tskdyarray_f "" FLOAT32_IEEE fak_r32_1 1 100 -10000 10000 FORMAT "%27.21" ARRAY_SIZE 7 ECU_ADDRESS 0x3FAB04 /end MEASUREMENT
/begin MEASUREMENT tskiwri "Index korrigierte Segmentzeit 'aktuell', DMD" UBYTE dez 1 100 0 100 FORMAT "%5.1" ECU_ADDRESS 0x403854 /end MEASUREMENT
/begin MEASUREMENT tskixmz "Index korrigierte Segmentzeit 'x-ZYLAZ/2', DMD" UBYTE dez 1 100 0 100 FORMAT "%5.1" ECU_ADDRESS 0x403855 /end MEASUREMENT
/begin MEASUREMENT tskiyp2 "Index korrigierte Segmentzeit 'y+2', DMD" UBYTE dez 1 100 0 100 FORMAT "%5.1" ECU_ADDRESS 0x403856 /end MEASUREMENT
/begin MEASUREMENT tskiyp3 "Index korrigierte Segmentzeit 'y+3', DMD" UBYTE dez 1 100 0 100 FORMAT "%5.1" ECU_ADDRESS 0x403857 /end MEASUREMENT
/begin MEASUREMENT tsklen "DMD L‰nge tsk-Array" UBYTE dez 1 100 0 100 FORMAT "%5.1" ECU_ADDRESS 0x402925 /end MEASUREMENT
/begin MEASUREMENT tsklend "" UBYTE dez 1 100 0 200 FORMAT "%5.1" ECU_ADDRESS 0x402926 /end MEASUREMENT
/begin MEASUREMENT tskll_f "" FLOAT32_IEEE fak_r32_1 1 100 -10000 10000 FORMAT "%27.21" ECU_ADDRESS 0x3FAB20 /end MEASUREMENT
/begin MEASUREMENT tsknx3_f "korrigierte Segmentdauer 'n'^3" FLOAT32_IEEE fak_r32_1 1 100 -10000 10000 FORMAT "%27.21" ECU_ADDRESS 0x3FAB24 /end MEASUREMENT
/begin MEASUREMENT tskyx3_f "korrigierte Segmentdauer 'y'^3" FLOAT32_IEEE fak_r32_1 1 100 -10000 10000 FORMAT "%27.21" ECU_ADDRESS 0x3FAB28 /end MEASUREMENT
/begin MEASUREMENT tsk_f "korrigierte Segmentdauer" FLOAT32_IEEE fak_r32_1 1 100 -10000 10000 FORMAT "%27.21" ECU_ADDRESS 0x3FA9C8 /end MEASUREMENT
/begin MEASUREMENT tSlave1_l "TPU-timestamp segmentmark 1 of Slave [TPU_Timer_Tick]" ULONG dez 1 100 0 4.29497e+009 FORMAT "%13.2" ECU_ADDRESS 0x404A8C /end MEASUREMENT
/begin MEASUREMENT tSlave2_l "TPU-timestamp segmentmark 2 of Slave [TPU_Timer_Tick]" ULONG dez 1 100 0 4.29497e+009 FORMAT "%13.2" ECU_ADDRESS 0x404A90 /end MEASUREMENT
/begin MEASUREMENT tsmxkomp_f "Maximalwertbegrenzung der Segmentzeiten f¸r Kompensationsverfahren nach Start" FLOAT32_IEEE fak_r32_1 1 100 -10000 10000 FORMAT "%27.21" ECU_ADDRESS 0x402930 /end MEASUREMENT
/begin MEASUREMENT tsroh_f "Segmentzeit unkorrigiert" FLOAT32_IEEE fak_r32_1 1 100 -1e+010 1e+010 FORMAT "%27.15" ECU_ADDRESS 0x3FB17C /end MEASUREMENT
/begin MEASUREMENT uzold2_w "lokale Kopie des Umdrehungsz‰hlers" UWORD dez 1 100 0 65535 FORMAT "%8.2" ECU_ADDRESS 0x402976 /end MEASUREMENT
/begin MEASUREMENT uzold3_w "lokale Kopie des Umdrehungsz‰hlers" UWORD dez 1 100 0 65535 FORMAT "%8.2" ECU_ADDRESS 0x402978 /end MEASUREMENT
/begin MEASUREMENT uzold4_w "lokale Kopie des Umdrehungsz‰hlers" UWORD dez 1 100 0 65535 FORMAT "%8.2" ECU_ADDRESS 0x40297A /end MEASUREMENT
/begin MEASUREMENT uzold_w "lokale Kopie des Umdrehungsz‰hlers" UWORD dez 1 100 0 65535 FORMAT "%8.2" ECU_ADDRESS 0x40297C /end MEASUREMENT
/begin MEASUREMENT wkfmodi_w "Statusword Aussetzermodi aus KFMODI" UWORD DEZ 1 100 0 65535 FORMAT "%8.2" ECU_ADDRESS 0x402956 /end MEASUREMENT
/begin MEASUREMENT wmdzag_l "" ULONG dez 1 100 0 4.29497e+009 FORMAT "%13.2" ECU_ADDRESS 0x4049D0 /end MEASUREMENT
/begin MEASUREMENT xkfmodi "Parameterkoordinate f¸r die Aussetzermodi in KFMODI" UBYTE DEZ 1 100 0 255 FORMAT "%5.1" ECU_ADDRESS 0x402959 /end MEASUREMENT
/begin MEASUREMENT xs_f "aktueller Meﬂwert Basisgrˆﬂe f¸r Faktor Segmentzeitkorrektur" FLOAT32_IEEE fak_r32_1 1 100 -10000 10000 FORMAT "%27.21" ARRAY_SIZE 12 ECU_ADDRESS 0x4028E4 /end MEASUREMENT
/begin MEASUREMENT ykfmodi "Modekoordinate der Aussetzermodi in KFMODI" UBYTE DEZ 1 100 0 255 FORMAT "%5.1" ECU_ADDRESS 0x40295A /end MEASUREMENT
/begin MEASUREMENT z2_f "1/(ZYLZA/2)^2, float" FLOAT32_IEEE fak_r32_1 1 100 -10000 10000 FORMAT "%27.21" ECU_ADDRESS 0x402934 /end MEASUREMENT
/begin MEASUREMENT zgstresz_w "" UWORD dez 1 100 0 65535 FORMAT "%8.2" ECU_ADDRESS 0x3FDFD2 /end MEASUREMENT
/begin MEASUREMENT zphnok "Z‰hler Fehler auf Phasensignal" UBYTE dez 1 100 0 255 FORMAT "%5.1" ECU_ADDRESS 0x4038B1 /end MEASUREMENT
/begin MEASUREMENT zphnok2 "Z‰hler Fehler auf Phasensignal 2" UBYTE dez 1 100 0 255 FORMAT "%5.1" ECU_ADDRESS 0x4038B2 /end MEASUREMENT
/begin MEASUREMENT zphnok3 "Z‰hler Fehler auf Phasensignal 3" UBYTE dez 1 100 0 255 FORMAT "%5.1" ECU_ADDRESS 0x4038B3 /end MEASUREMENT
/begin MEASUREMENT zphnok4 "Z‰hler Fehler auf Phasensignal 4" UBYTE dez 1 100 0 255 FORMAT "%5.1" ECU_ADDRESS 0x4038B4 /end MEASUREMENT
/begin MEASUREMENT zrph2diff0 "Phasenflanken im Arbeitsspiel bei PG2" UBYTE dez 1 100 0 255 FORMAT "%5.1" ECU_ADDRESS 0x4038B5 /end MEASUREMENT
/begin MEASUREMENT zrph3diff0 "Phasenflanken im Arbeitsspiel bei PG3" UBYTE dez 1 100 0 255 FORMAT "%5.1" ECU_ADDRESS 0x4038B6 /end MEASUREMENT
/begin MEASUREMENT zrph4diff0 "Phasenflanken im Arbeitsspiel bei PG4" UBYTE dez 1 100 0 255 FORMAT "%5.1" ECU_ADDRESS 0x4038B7 /end MEASUREMENT
/begin MEASUREMENT zrphdiff0 "Phasenflanken im Arbeitsspiel bei PG1" UBYTE dez 1 100 0 255 FORMAT "%5.1" ECU_ADDRESS 0x4038B8 /end MEASUREMENT
/begin MEASUREMENT zyl2 "" UBYTE dez 1 100 0 12 FORMAT "%5.2" ECU_ADDRESS 0x40287C /end MEASUREMENT
/begin MEASUREMENT zzuend_l "Z¸ndungsz‰hler" ULONG dez 1 100 0 4.29497e+009 FORMAT "%13.2" ECU_ADDRESS 0x3FE034 /end MEASUREMENT
/begin MEASUREMENT zzyldmd "SW-Zylinderz‰hler f¸r DMD" SBYTE dez_sb 1 100 -128 127 FORMAT "%5.1" ECU_ADDRESS 0x402F40 /end MEASUREMENT
/begin MEASUREMENT zzyldmd_f "SW-Zylinderz‰hler f¸r DMD" FLOAT32_IEEE fak_r32_1 1 100 -1e+010 1e+010 FORMAT "%27.15" ECU_ADDRESS 0x3FB180 /end MEASUREMENT
/begin MEASUREMENT zzyllfb "SW-Zylinderz‰hler f¸r DMD" SBYTE dez_sb 1 100 -16 24 FORMAT "%5.2" ECU_ADDRESS 0x403858 /end MEASUREMENT
/begin MEASUREMENT zzylzag "SW-Zylinderz‰hler f¸r DMDZAG" UBYTE DEZ 1 100 0 255 FORMAT "%5.1" ECU_ADDRESS 0x40387F /end MEASUREMENT
/begin FUNCTION DMDFOF "5.10      Diagnosis Misfire Detection Fuel-off Adaptation"
 /begin DEF_CHARACTERISTIC ALFOF ANWFOST ANWSTP CDFO CDFOMOD FLFOF FOFAKT FS1FOF FS2FOF LURFOST NOFOF NUFOF SLFOOF_F SLFOUF_F /end DEF_CHARACTERISTIC
 /begin IN_MEASUREMENT B_fofstp B_fonresf B_mdzgstp B_pwf lunw_f nmot_w tsroh_f zzyldmd zzyldmd_f /end IN_MEASUREMENT
 /begin OUT_MEASUREMENT B_cdfo B_clradfof B_fofr1 B_fofrun B_folunw B_fomod B_fonresd B_readap fofresz fofstat fseofkor_f tsk_f /end OUT_MEASUREMENT
 /begin LOC_MEASUREMENT anwfofs anwst B_fofdr B_fofr B_fofrun0 B_idxfof1 B_mdzyl1 B_zylind flmxof_f flnof1_f flpof1_f fseof1_f fsof1_f tsip1_f tsi_f xs_f zyl2 /end LOC_MEASUREMENT
/end FUNCTION
/begin FUNCTION DMDFON "12.40     Diagnosis Misfire Detection Fuel-on Adaptation"
 /begin DEF_CHARACTERISTIC ALFO ANWFOHE DFSEFON1 DFSERES FLFO FS1FO FS2FO KFCFO1 KLIDXFOMI1 KLIDXFOMII1 KLIDXFONN1 KLIDXFONNI1 MDERKFON SIMI03DMF1 SIN08DMFL1 SLFOO1N SLFOU1N SMI03DMUB1 SMI05DMUB1 SNM10DMUW1 /end DEF_CHARACTERISTIC
 /begin REF_CHARACTERISTIC ANWFOST CDFO CDFOMOD SNM08DMUW1 /end REF_CHARACTERISTIC
 /begin IN_MEASUREMENT B_fofr1 B_folunw B_fomod B_fonresd B_fonresv B_fonstp B_lustop B_mderk B_mdstop B_milstp B_pwf esst_snm08dmuw1 fzabgs_w luts_f midmd midmd_f nmot_f nmot_w zzyllfb /end IN_MEASUREMENT
 /begin OUT_MEASUREMENT B_fonresf B_fonrset B_for B_forn B_forun dfseresz_w fonstat fse_f idxfob /end OUT_MEASUREMENT
 /begin LOC_MEASUREMENT anwfoh_w anwfos_w B_fodon B_fohe B_fohold B_fondis B_fora B_fora_old B_forna B_forun0 B_plok B_ploka cfoxx dfse_f erg1 erg2 esst_smi03dmub1 esst_smi05dmub1 esst_snm10dmuw1 ffon1 ffon2 flmx_f fln00_f fln01_f fln02_f fln03_f fln04_f fln05_f fln06_f fln07_f flp00_f flp01_f flp02_f flp03_f flp04_f flp05_f flp06_f flp07_f fs00_f fs01_f fs02_f fs03_f fs04_f fs05_f fs06_f fs07_f fse00_f fse01_f fse02_f fse03_f fse04_f fse05_f fse06_f fse07_f hcount hdfse_f hflmx_f idxfomi idxfomii idxfomit idxfon idxfoni idxfont idx_base idx_right idx_up idx_up_right maxfse_f minfse_f mi_base mi_up n1 n2 slfoo_f slfou_f zgstresz_w /end LOC_MEASUREMENT
/end FUNCTION
/begin FUNCTION DMDLAD "8.10      Logic and Delay; Log. Verkn¸pfung versch. Blˆcke zur Aussetzererkennung" /begin DEF_CHARACTERISTIC ANALUN ANALUST TNALU /end DEF_CHARACTERISTIC /begin REF_CHARACTERISTIC SNM08DMUB /end REF_CHARACTERISTIC
 /begin IN_MEASUREMENT B_dluerk B_dopzue B_luaerk B_luerk B_lustop B_mdstop B_optpherk B_stpon esst_snm08dmub nmot /end IN_MEASUREMENT
 /begin OUT_MEASUREMENT B_analu B_mderk B_tnalu dmdladAusBitsSyn /end OUT_MEASUREMENT
 /begin LOC_MEASUREMENT fanalun /end LOC_MEASUREMENT
/end FUNCTION
/begin FUNCTION DMDLFB "4.40      Diagnose Misfire Detection Berechnung Laufunruhe luts und gefilterte fluts" /begin DEF_CHARACTERISTIC FLUTN FLUV1 NFLUV NINITSK NMNTKOMP /end DEF_CHARACTERISTIC
 /begin IN_MEASUREMENT B_lustop B_mdzag B_mdzgstp B_zagrun dmdsegl_w nmot nmot_f tnst_w tsk_f zzyldmd /end IN_MEASUREMENT
 /begin OUT_MEASUREMENT dluts_f flutszyl_f fluts_f lunw_f lutszyl_f luts_f tskdelay tsknx3_f tsmxkomp_f z2_f zzyllfb /end OUT_MEASUREMENT
 /begin LOC_MEASUREMENT B_mdstim B_nmntkomp convert_f dmdlfbLokBits dmdlfbLokBitsSyn dtsarray_f fflutn_f lutsdarray_f tdkomp_f tskarray_f tskdiffwidx tskdnarray_f tskdyarray_f tskiwri tskixmz tskiyp2 tskiyp3 tsklen tsklend tskll_f tskyx3_f wmdzag_l /end LOC_MEASUREMENT
/end FUNCTION
/begin FUNCTION DMDLFK "4.30      Diagnose Misfire Detection Korrektur der Laufunruhe luts und fluts" /begin IN_MEASUREMENT B_fokstp B_mdstop dluts_f fluts_f fse_f luts_f zzyllfb /end IN_MEASUREMENT /begin OUT_MEASUREMENT dlutsk_f flutskzy_f flutsk_f lutskzyl_f lutsk_f /end OUT_MEASUREMENT /begin LOC_MEASUREMENT fsearray_f fsenmz2_f /end LOC_MEASUREMENT /end FUNCTION
/begin FUNCTION DMDLU "25.10     Diagnose misfire detection; Laufunruhe"
 /begin DEF_CHARACTERISTIC DMXRLU FIAMALU FIMALU KFAMAL KFAMAL1 KFAMAL2 KFLURB KFLURB1 KFLURB2 KFLURM KFLURM1 LURBMI LURKTM LURMIN1 LURMIN2 LURMIN3 LURST /end DEF_CHARACTERISTIC
 /begin REF_CHARACTERISTIC SMI08DMUB SNM08DMUB /end REF_CHARACTERISTIC
 /begin IN_MEASUREMENT B_analu B_fokstp B_ll B_lustop B_mdstop B_vvtnlf B_wk B_wkr esst_smi08dmub esst_snm08dmub fofstat fonstat lurminstat lutskzyl_f lutsk_f midmd midmd_w nmot tmot tnst_w vfzg z2_f zzyllfb /end IN_MEASUREMENT
 /begin OUT_MEASUREMENT B_luerk flurktm_f flurmin1_f flurmin2_f flurmin3_f flurmin_f fofstat_loc fonstat_loc lums_f lurms_f lurs_f /end OUT_MEASUREMENT
 /begin LOC_MEASUREMENT famalwk_f famal_f fkfamal1_f fkfamal2_f fkfamal_f fkflurb1_f fkflurb2_f fkflurb_f fkflurm1_f fkflurm_f flurbmi_f flurb_f flurmwk_f flurst_f lurmsalt_f lursalt_f lutsknm1 lutsknm2 /end LOC_MEASUREMENT
/end FUNCTION
/begin FUNCTION DMDLUA "10.20     Diagnose Misfire Detection Laufunruhe Abstandsmass" /begin DEF_CHARACTERISTIC DMXRFL KFLUAR KFLUAR1 KFLUAR2 /end DEF_CHARACTERISTIC /begin REF_CHARACTERISTIC SMI08DMUB SNM08DMUB /end REF_CHARACTERISTIC
 /begin IN_MEASUREMENT B_lustop B_mdstop B_wk B_wkr esst_smi08dmub esst_snm08dmub flurmin_f flutskzy_f flutsk_f midmd nmot zzyllfb /end IN_MEASUREMENT
 /begin OUT_MEASUREMENT B_luaerk /end OUT_MEASUREMENT
 /begin LOC_MEASUREMENT fkfluar1_f fkfluar2_f fkfluar_f fluartmp_f fluar_f luaralt_f luarmn_f luaroff_f luar_f /end LOC_MEASUREMENT
/end FUNCTION
/begin FUNCTION DMDMIL "12.50     Fehlerbehandlung der Aussetzererkennung, Ansteuerung der MIL und Heilung"
 /begin DEF_CHARACTERISTIC ADCY AHEAGW AHEAGWS AHEARV AHEKABB AHEKS1B1 AHEKS1B2 AHEKSB1 AHEKSB2 AINTKAN AZYTIABB CWDALA CWDMDE FAINTEN FASKIV1 KFKSWFS MILANTI TMASKIV1 /end DEF_CHARACTERISTIC
 /begin REF_CHARACTERISTIC SNM08DMUB TMWUC /end REF_CHARACTERISTIC
 /begin IN_MEASUREMENT bbdcy B_mderk B_mdstop B_milstp B_pwf B_sch B_synph esst_snm08dmub midmd nmot nsllm tmot zzyllfb /end IN_MEASUREMENT
 /begin OUT_MEASUREMENT afmimn afmimx afnmn afnmx aftmimn aftmimx aftnmn aftnmx ahearv_w bbsp1 bbsp2 B_afwrm B_blkmd B_mdarv B_mdkat B_milmd B_sp1 B_sp2 flgtiab fzabgs_w fzabgzyl_w fzmdzyl_w ivzabg_w /end OUT_MEASUREMENT
 /begin LOC_MEASUREMENT abgsmw_w aint_zyl anzinten azycntb bankindex bfmimn bfmimx bfnmn bfnmx B_afklt B_aftklt B_aftwrm B_ainten B_bfklt B_bfwrm B_ivzabg1 B_ivzkat1 cdcy E_abg_zyl fgtiabmd_w fivzabg flgkat_w flgtiabm_w fzarv_w fzkatsb_w fzkats_w fzkatzyl_w ivzaint_w ivzarv_w ivzkat_w kswf SfpMin_EVzyl zzuend_l /end LOC_MEASUREMENT
 /begin SUB_FUNCTION DFPM_DMDMIL INDEX_DMDMIL /end SUB_FUNCTION
/end FUNCTION
/begin FUNCTION DMDSTP "34.10     Diagnose Misfire Detection; Stopbedingungen"
 /begin DEF_CHARACTERISTIC AVRALU AVRALUSSG AZSTLU AZSTPON CWSTDMD CWSTPCNF DRLSOLA DRLSOLST KLTALUST MISALULL MISALUN NGALUN NGALUST NMIALU NMXALU NSTDMD SFONTM TAMIALU /end DEF_CHARACTERISTIC
 /begin REF_CHARACTERISTIC SMI08DMUB SNM08DMUB /end REF_CHARACTERISTIC
 /begin IN_MEASUREMENT B_asc_reg B_autget B_cdmd B_dkpu B_dtest B_edkvs B_edkvs2 B_eev B_enws B_evasel B_evloc B_fbm B_fomod B_fonrset B_koe B_kuppl B_ll B_mdarv B_mdein B_mderk B_nldg B_nws B_phsnl B_readap B_sa B_st B_sta B_swe_c B_synph B_tehb B_tsbready B_vvtnlf B_wk B_wkr codget esst_smi08dmub esst_snm08dmub midmd ngfil_w nmot nmot_w rlgas_w tadtea tans tmot tmst tnst_w tskdelay vfzg /end IN_MEASUREMENT
 /begin OUT_MEASUREMENT B_fofstp B_fokstp B_fonstp B_lustop B_mdstop B_mdzgstp B_milstp B_stpon B_swe /end OUT_MEASUREMENT
 /begin LOC_MEASUREMENT B_com1 B_com2 B_edges B_error1 B_error26 B_error3 B_error5 B_error7 B_error8 B_fontm B_kuppssg B_lustops B_mddrla B_mdmi B_mdng B_mdnmn B_mdnmx B_mdtnst B_milstps B_range B_stdmd B_su2tmp B_sutmp ctrlustp_w E_nwkwa2_loc E_nwkwa_loc E_nwkwe2_loc E_sue2_loc favralu_w /end LOC_MEASUREMENT
/end FUNCTION
/begin FUNCTION DMDTSB "10.20     Diagnosis Misfire Detection Segmentzeitbildung" /begin DEF_CHARACTERISTIC DMDSEGL KAMFZ TSBINVALID TSBSEGINI ZYLKOR /end DEF_CHARACTERISTIC /begin IN_MEASUREMENT zzyl /end IN_MEASUREMENT
 /begin OUT_MEASUREMENT B_stimhelp B_ti1stamp B_ti2stamp B_ts1delay B_tsbcalc B_tsbready dmdsegl_w kamfz_w seg1BegD_w seg2BegD_w tsbsyctr tsegDmd_l tSlave1_l tSlave2_l tsroh_f zzyldmd zzyldmd_f /end OUT_MEASUREMENT
/end FUNCTION
/begin FUNCTION DMDZAG "3.20      Diagnose misfire detection: Aussetzergenerator" /begin DEF_CHARACTERISTIC CWDMDZAG KFMODI RANDSEED ZAGRUN /end DEF_CHARACTERISTIC /begin IN_MEASUREMENT B_mdstop zzyldmd /end IN_MEASUREMENT
 /begin OUT_MEASUREMENT B_mdzag B_reini B_zagrun B_zagstp dmdappBits_100ms flgstign_w flgstinj_w flgst_w ignitioz_w lastmodz_w misfirez_w modez_w nwnumbz_w pausez_w randreg_w zzylzag /end OUT_MEASUREMENT
 /begin LOC_MEASUREMENT flgstloc_w wkfmodi_w xkfmodi ykfmodi /end LOC_MEASUREMENT
/end FUNCTION
/begin FUNCTION DMIL "OBDII; MIL-Ansteuerung" /begin DEF_CHARACTERISTIC CWKATVAR CWMILCOD CWNOMIL TLAED TLAEDI /end DEF_CHARACTERISTIC
 /begin IN_MEASUREMENT B_blkfb B_blkmd B_bt B_btemil B_btmil B_milfb B_milmd B_nmot B_nokatfz dfpmMilState /end IN_MEASUREMENT
 /begin OUT_MEASUREMENT B_katvar B_kmmil B_mil B_milblk B_milst B_milstat B_nomil milstat /end OUT_MEASUREMENT
 /begin LOC_MEASUREMENT B_blkeb B_mileb /end LOC_MEASUREMENT
/end FUNCTION
/begin FUNCTION DMLSE "24.10     Diagnose; Endstufenpr¸fung elektrischer Motorl¸fter" /begin DEF_CHARACTERISTIC CWPSMLE CW_MAXKERR CW_MINKERR CW_MINSEND /end DEF_CHARACTERISTIC /begin REF_CHARACTERISTIC TAMLSMN TAMLSMX TVP /end REF_CHARACTERISTIC /begin IN_MEASUREMENT B_desee eluectr taml /end IN_MEASUREMENT
 /begin OUT_MEASUREMENT B_elue600 B_eluedet B_eluevar B_velueakt dmlseAusBitsNov eluekctr /end OUT_MEASUREMENT
 /begin LOC_MEASUREMENT mle_error /end LOC_MEASUREMENT
 /begin SUB_FUNCTION DFPM_DMLSE /end SUB_FUNCTION
/end FUNCTION
/begin FUNCTION DNVRBUP "2.10      Diagnose NVRAM Backup" /begin DEF_CHARACTERISTIC DNVRBUP /end DEF_CHARACTERISTIC
 /begin IN_MEASUREMENT B_eemrdy B_eepwf B_nlEEPR B_pwf B_restore B_restoreok B_rqnvrbup eeeExitStatus /end IN_MEASUREMENT
 /begin OUT_MEASUREMENT B_nvrbupok B_nvrbuprq dnvrbupctr eepnvrbctr nvrbactctr /end OUT_MEASUREMENT
/end FUNCTION
/begin FUNCTION DNWSAUS "2.20      Diagnose Nockenwellensteuerung (Auslaﬂseitig)" /begin REF_CHARACTERISTIC SPRZG_AN TDDNWSHL TDDNWSMN TDDNWSNP /end REF_CHARACTERISTIC
 /begin IN_MEASUREMENT B_anwmn B_anwmn2 B_anwpnp B_anwpnp2 B_cdanws B_fanwsaa B_phad3 B_phad4 Vsa2sprs Vsa_sprs /end IN_MEASUREMENT
 /begin OUT_MEASUREMENT B_danws B_danws2 dnwsausBits_100ms /end OUT_MEASUREMENT
 /begin LOC_MEASUREMENT B_lcmnanw B_lcmnanw2 B_lcnpanw B_lcnpanw2 /end LOC_MEASUREMENT
 /begin SUB_FUNCTION DFPM_DNWSAUS INDEX_DNWSAUS /end SUB_FUNCTION
/end FUNCTION
/begin FUNCTION DNWSEAUS "6.10      Diagnose: Endstufe Nockenwellensteuerung (Auslaﬂseitig)" /begin DEF_CHARACTERISTIC CWPSNWSAE TANWASTMN TANWASTMX /end DEF_CHARACTERISTIC /begin REF_CHARACTERISTIC TVP /end REF_CHARACTERISTIC /begin IN_MEASUREMENT B_desee Vsa2tv Vsa_tv /end IN_MEASUREMENT /begin SUB_FUNCTION DFPM_DNWSEAUS /end SUB_FUNCTION /end FUNCTION
/begin FUNCTION DNWSEEIN "7.10      Diagnose der Nockenwellenendstufe (einlaﬂseitig)" /begin DEF_CHARACTERISTIC CWPSNWSEE TANWESTMN TANWESTMX /end DEF_CHARACTERISTIC /begin REF_CHARACTERISTIC TVP /end REF_CHARACTERISTIC /begin IN_MEASUREMENT B_desee Vse2tv Vse_tv /end IN_MEASUREMENT /begin SUB_FUNCTION DFPM_DNWSEEIN /end SUB_FUNCTION /end FUNCTION
/begin FUNCTION DNWSEIN "2.20      Diagnose Nockenwellensteuerung (Einlaﬂseitig)" /begin DEF_CHARACTERISTIC TDDNWSHL TDDNWSMN TDDNWSNP /end DEF_CHARACTERISTIC /begin REF_CHARACTERISTIC SPRZG_AN /end REF_CHARACTERISTIC
 /begin IN_MEASUREMENT B_cdenws B_enwmn B_enwmn2 B_enwpnp B_enwpnp2 B_fanwsea B_phad B_phad2 Vse2sprs Vse_sprs /end IN_MEASUREMENT
 /begin OUT_MEASUREMENT B_denws B_denws2 dnwseinBits_100ms /end OUT_MEASUREMENT
 /begin LOC_MEASUREMENT B_lcmnenw B_lcmnenw2 B_lcnpenw B_lcnpenw2 /end LOC_MEASUREMENT
 /begin SUB_FUNCTION DFPM_DNWSEIN INDEX_DNWSEIN /end SUB_FUNCTION
/end FUNCTION
/begin FUNCTION DNWSZF "2.10      Diagnose Nockenwellensteuerung Fehlerzusammenfassung"
 /begin IN_MEASUREMENT B_lcmnanw B_lcmnanw2 B_lcmnenw B_lcmnenw2 B_lcnpanw B_lcnpanw2 B_lcnpenw B_lcnpenw2 /end IN_MEASUREMENT
 /begin OUT_MEASUREMENT B_enws B_enwsa B_enwse /end OUT_MEASUREMENT
/end FUNCTION
/begin FUNCTION DODSNL "1.30      Diagnose des ÷ldruckschalters im Nachlauf" /begin DEF_CHARACTERISTIC ERRCOLDO TALOLDAB TOELMND TOELMXD /end DEF_CHARACTERISTIC /begin IN_MEASUREMENT B_oeldr tnachl_w toel_w /end IN_MEASUREMENT /begin OUT_MEASUREMENT B_dodsnl dodsnlBits olderrc /end OUT_MEASUREMENT /end FUNCTION
/begin FUNCTION DPH "24.100    Diagnose; Plausibilit‰tspr¸fung Phasensensor" /begin DEF_CHARACTERISTIC PGPRIO PHBM PHNOKA PHPOSERR /end DEF_CHARACTERISTIC /begin REF_CHARACTERISTIC CWPG1 CWPG2 CWPG3 CWPG4 NMXPHPOS /end REF_CHARACTERISTIC
 /begin IN_MEASUREMENT B_checkpg B_checkpg2 B_checkpg3 B_checkpg4 B_nldg B_st inisynmon nmot synstate uzkw_w zphfl2ct_w zphfl3ct_w zphfl4ct_w zphflct_w zrph2_l zrph3_l zrph4_l zrph_l zzyl /end IN_MEASUREMENT
 /begin OUT_MEASUREMENT B_fph1bm B_fph2bm B_fph3bm B_fph4bm B_nopg B_ph2flok B_ph3flok B_ph4flok B_phflok B_synph dphAusBitsKoop dphAusBitssyn pgmaster /end OUT_MEASUREMENT
 /begin LOC_MEASUREMENT B_enph2bm B_enph3bm B_enph4bm B_enphbm B_eslv1tst B_eslv2tst B_eslv3tst B_eslv4tst B_healed1 B_healed2 B_healed3 B_healed4 B_rst1ph B_rst1ph2 B_rst1ph3 B_rst1ph4 B_rst3ph B_rst3ph2 B_rst3ph3 B_rst3ph4 B_synphab dphLokBitsKoop dphLokBitsKoop2 dphLokBitsph dphLokBitssyn dphLokBitssyn2 dphLokBitssyn3 ph1edpos_w ph2bmerr ph2edpos_w ph3bmerr ph3edpos_w ph4bmerr ph4edpos_w phbmerr slv1tst slv2tst slv3tst slv4tst sph2flok sph3flok sph4flok sphflok uzold2_w uzold3_w uzold4_w uzold_w zphnok zphnok2 zphnok3 zphnok4 zrph2diff0 zrph3diff0 zrph4diff0 zrphdiff0 /end LOC_MEASUREMENT
 /begin SUB_FUNCTION DFPM_DPH /end SUB_FUNCTION
/end FUNCTION
/begin FUNCTION DPLLSU "1.90      Plausibilit‰tsdiagnose LSU"
 /begin DEF_CHARACTERISTIC CWPLLSU DLAHPPLMN DLAHPPLMN2 IMLHEMN IMLHEMN2 IMLHEMNFA IMLHEMNFA2 IMLPLCMN IMLPLCMN2 IMLPLCMNB IMLPLCMNB2 LAMMN LAMMX LASPLCFT LASPLCMR LSUNAMN LSUNAMX NLRFKEFDMX SDLAOFMN SDLAOFMN2 SDLAOFMX SDLAOFMX2 TVHELSUF TVLSUEK TVLSUEK2 TVLSUOF TVLSUOF2 TVLSUPER TVLSUPER2 TVSNPF TVSNPF2 USHKFT USHKMR ZLAMFT /end DEF_CHARACTERISTIC
 /begin IN_MEASUREMENT B_cdpllsu B_fa B_fapllsu B_frmax B_frmax2 B_frmin B_frmin2 B_lamverg B_lamverg2 B_lrhk B_lrhk2 B_lrhkp B_lrhkp2 B_lrka B_lrka2 B_lrs B_lrs2 B_lshswok B_lshswok2 B_lsudip B_lsudip2 B_maxlavh B_maxlavh2 B_sbbhk B_sbbhk2 B_sbbvk B_sbbvk2 B_stend dlahi2_w dlahi_w dlahp2_w dlahp_w lamsoni2_w lamsoni_w lamsons2_w lamsons_w msabg2_w msabg_w ushk2_w ushk_w /end IN_MEASUREMENT
 /begin OUT_MEASUREMENT B_elaof B_elaof2 B_lsulone B_lsulone2 B_vlsuftb B_vlsuftb2 B_vlsumrb B_vlsumrb2 B_vlsunp B_vlsunp2 /end OUT_MEASUREMENT
 /begin LOC_MEASUREMENT B_dlahimn B_dlahimn2 B_dlahimx B_dlahimx2 B_elaofmn B_elaofmn2 B_elaofmx B_elaofmx2 B_helsuf B_helsuf2 B_hepllsu B_hepllsu2 B_hpllsue B_hpllsue2 B_lshkpft B_lshkpft2 B_lshkpmr B_lshkpmr2 B_lsuft B_lsuft2 B_lsufta B_lsufta2 B_lsuftb B_lsuftb2 B_lsumr B_lsumr2 B_lsumra B_lsumra2 B_lsumrb B_lsumrb2 B_lsuoffe B_lsuoffe2 B_lsuoffs B_lsuoffs2 B_lsupft B_lsupft2 B_lsupmr B_lsupmr2 B_plenvh B_plenvh2 imlfta2_w imlfta_w imlftb2_w imlftb_w imlmra2_w imlmra_w imlmrb2_w imlmrb_w imlplhe2_w imlplhe_w /end LOC_MEASUREMENT
/end FUNCTION
/begin FUNCTION DPS_TMP "" /begin DEF_CHARACTERISTIC THP TVP /end DEF_CHARACTERISTIC /end FUNCTION
/begin FUNCTION DQLT "1.20      Diagnose ÷lzustandssensor" /begin DEF_CHARACTERISTIC OZDIAGNMOT OZDIAGSPG OZERRD OZHEAL OZSTZYK /end DEF_CHARACTERISTIC /begin IN_MEASUREMENT B_ozclfsp B_ozfbsd nmot oznivr ozstatus ub /end IN_MEASUREMENT
 /begin OUT_MEASUREMENT B_ozdiagok B_ozfsheal B_ozlerr B_ozlerrb B_ozqerr B_ozqerrb B_ozsierrb B_oztemic B_ozterr B_ozterrb B_ozwertok dqltBits2_1s ozpermerrz /end OUT_MEASUREMENT
 /begin LOC_MEASUREMENT B_niverrb B_permerrb B_sigb B_temperrb dqltBits1_1s ozniverrz ozsigerrz oztemperrz /end LOC_MEASUREMENT
/end FUNCTION
/begin FUNCTION dr_showerr "" /begin DEF_CHARACTERISTIC CW_DR_ERR1 CW_DR_ERR2 CW_DR_ERR_ID /end DEF_CHARACTERISTIC
 /begin OUT_MEASUREMENT dr_errArray dr_errCounter dr_errId dr_errInfoh dr_errInfol dr_errMin dr_errSec dr_errType /end OUT_MEASUREMENT
/end FUNCTION
/begin FUNCTION DSLPE "11.20     Diagnose; Sekund‰rluftpumpe Endstufe" /begin DEF_CHARACTERISTIC CWPSSLPE /end DEF_CHARACTERISTIC /begin REF_CHARACTERISTIC TVP /end REF_CHARACTERISTIC /begin IN_MEASUREMENT B_desee B_katvar B_slp /end IN_MEASUREMENT /begin SUB_FUNCTION DFPM_DSLPE /end SUB_FUNCTION /end FUNCTION
/begin FUNCTION DSLSFFTK "1.10      Diagnose Sekund‰rluftsystem Kundenspezifischen Freeze Frame Daten"
 /begin IN_MEASUREMENT B_eslsp B_eslsp2 B_zslsp B_zslsp2 fho_u frm2_u frm_u lamsons2_u lamsons_u tmst /end IN_MEASUREMENT
 /begin OUT_MEASUREMENT sls2fft1 sls2fft2 sls2fft3 sls2fft4 slsfft1 slsfft2 slsfft3 slsfft4 /end OUT_MEASUREMENT
/end FUNCTION
/begin FUNCTION DSLSLRS "10.40     Diagnose Sekund‰rluftsystem mit stetiger Lambdaregelung"
 /begin DEF_CHARACTERISTIC CWDSLSA CWDSLSAD CWDSLSY DFRMOFNX DFRMOFNXKT DFRMOFPX DFRMOFPXKT DMSDRLTM DSLVFZMN DTMDSLA FHODSL FMSLAMN FMSLAMX IMLATDSL IMLATDSLK IMLDSL MLWDSLAMN MLWDSLAMX MLWDSLKMN MLWDSLKMX MLWDSLMN MLWDSLMX MLWDSLOMN MLWDSLOMX MSLBAS MSLVMX MSLVMXX RMSLMN RMSLMNK RMSLPMN RMSLSUMN RMSLTMN TANDSLMN TANDSLMX TC6CSL TC6CSL2 TC6CSLK TC6CSLK2 TC6CSLN TC6CSLN2 TC6CSLV TC6CSLV2 TDGDST TDMSLMN1 TDMSLMN4 TDMSLMNK TDMSLOF3 TDMSLOF5 TDMSLOFK TDMSLV TDMSLVK TDPH2SLOF TDPHSLOF TDPHSLOFK TDSLMDRL TDSLMVBA TFIMSLI TFIMSLIK TFIMSLO TFIMSLOK TFIMSLV TFIMSLVK TKATDSL TMDSLAMN TMDSLMN TMDSLMX TMSLADAP TMSLIFT TMSLIFT1 TMSLIFTK TNOMF2 TNOMF3 TNOMF5 TNSTDSL TSBVDSLTMS TWDSLTM TWHLSLP TWMLFE TWMSLMIN TWSLPSLA ZDSLAMX /end DEF_CHARACTERISTIC
 /begin REF_CHARACTERISTIC CWSLS2 /end REF_CHARACTERISTIC
 /begin IN_MEASUREMENT anzslp B_anzslpmx B_bag B_bkvleer B_cdsls B_dvvtobd B_edkvs B_edkvs2 B_evloc B_fa B_fasla B_gdst B_hag B_kh B_kha B_ll B_lrs B_lrs2 B_mdarv B_nmot B_pwf B_sbblsu B_sbblsu2 B_slp B_sls B_slsadap B_slsfz B_slsoff B_st B_stend B_te B_vag E_lm E_slpe E_slve E_ta E_tes E_tm fho_w frm2_w frm_w imlatm_w imlpr lamsbg2_w lamsbg_w lamsoni2_w lamsoni_w mlbb2_w mlbb_w ml_w msl msl2 rl_w tans tikatm tkatm tmot tmotab tmst tnst_w twslp_w vfzg /end IN_MEASUREMENT
 /begin OUT_MEASUREMENT B_cwdslt B_cwdslty B_dsl1 B_dsl2e B_dsl4 B_dsla B_dslerr B_dslfa B_dslo B_dsloab B_dsls B_dslsp4 B_dspe B_esls B_mslmn B_mslpmn B_mslpmn2 B_rmsl B_rmsl2 B_rmslsm B_rmslsm2 B_sla B_szsls fmsla fmsla2 m6amsl m6cmsl m6cmsl2 m6cmslv m6cmslv2 m6smsl2_w m6smslv2_w m6smslv_w m6smsl_w m6wmsl2_w m6wmslv2_w m6wmslv_w m6wmsl_w rmsl /end OUT_MEASUREMENT
 /begin LOC_MEASUREMENT B_awmslsum B_cwsla B_dfrmoe B_dfrmoe2 B_dfrmoff B_dfrmoff2 B_dsl B_dsl1ab B_dsl1e B_dsl2 B_dsl2ab B_dsl3 B_dsl3ab B_dsl3e B_dsl45 B_dsl4ab B_dsl4e B_dsl5 B_dsl5ab B_dsl5dly B_dsl5e B_dslm B_dslmab B_dslme B_dslmes B_dsloe B_dslp4 B_dslp42 B_dsltab B_dslte B_dsper B_dspes B_emnslve B_errofs B_errofs2 B_eslpe B_eslsp B_eslsp2 B_eslve B_eslvp B_eslvp2 B_faslarq B_meaoper B_mnslspr B_mnslspr2 B_mslmin B_mslmin2 B_mslsum B_mslsumn B_mslsumn2 B_mslsumt B_mxslvpr B_mxslvpr2 B_rmslsmg B_slar B_slarq B_slas B_slsofw B_trfasla B_zslsp B_zslsp2 B_zslvp B_zslvp2 dfrmoff2_w dfrmoff_w dmsldrl_w DSLSLRSlokBits1 DSLSLRSlokBits1a DSLSLRSlokBits2 DSLSLRSlokBits2a DSLSLRSlokBits3 DSLSLRSlokBits3a DSLSLRSlokBits4 DSLSLRSlokBits4a DSLSLRSlokBits5 DSLSLRSlokBits6 fmslav fmslav2 mslift mslift2 mslnenn mslnenn2 mslnf mslnf2 mslnt mslnt2 mslt2_w mslt_w mslv2_w mslvft2_w mslvft_w mslvt2_w mslvt_w mslv_w rmsl2 rmslt rmslt2 /end LOC_MEASUREMENT
/end FUNCTION
/begin FUNCTION DSTA "4.30      Diagnose; Startautomatik Ansteuerung" /begin DEF_CHARACTERISTIC NDSTA TPDSTA TWDSTA /end DEF_CHARACTERISTIC /begin REF_CHARACTERISTIC CWSTAEN /end REF_CHARACTERISTIC /begin IN_MEASUREMENT B_estart B_kl15 B_pwf B_stprel nmot /end IN_MEASUREMENT /begin OUT_MEASUREMENT B_dstaen B_ez B_staerr B_staok tdsta_ctr /end OUT_MEASUREMENT /end FUNCTION
/begin FUNCTION DSTS "1.30      Diagnose; Startautomatik Signaleingang" /begin DEF_CHARACTERISTIC NDSTS TWDSTS /end DEF_CHARACTERISTIC /begin REF_CHARACTERISTIC CWSTAEN /end REF_CHARACTERISTIC /begin IN_MEASUREMENT B_estart nmot_w tnse_w /end IN_MEASUREMENT /begin SUB_FUNCTION DFPM_DSTS /end SUB_FUNCTION /end FUNCTION
/begin FUNCTION DSUE "10.20     Diagnose; Saugrohrumschaltung Endstufe"
 /begin DEF_CHARACTERISTIC CWPSSUE TDSUE TDSUEH TDSUEMN TDSUEMX TVRDISAMN TVRDISAMX TVSDISAMN TVSDISAMX /end DEF_CHARACTERISTIC
 /begin REF_CHARACTERISTIC DI_SCHALT /end REF_CHARACTERISTIC
 /begin IN_MEASUREMENT Disaaus_w Ditv_aus ES_sfdisa /end IN_MEASUREMENT
 /begin OUT_MEASUREMENT tdsuectr tdsuehctr tdsuemnctr tdsuemxctr /end OUT_MEASUREMENT
 /begin LOC_MEASUREMENT B_disae B_disaok dsueBits /end LOC_MEASUREMENT
/end FUNCTION
/begin FUNCTION DSWEC "5.20      Schlechtwegerk. aus Rad-Beschl.,-> mittels CAN von ABS SG zu Motronic" /begin DEF_CHARACTERISTIC FABSALU FIBSALU FSWALUV /end DEF_CHARACTERISTIC /begin IN_MEASUREMENT bsc B_cdswe cd_bits1_w vfzg /end IN_MEASUREMENT /begin OUT_MEASUREMENT B_swe_c /end OUT_MEASUREMENT /begin LOC_MEASUREMENT bssp fswares /end LOC_MEASUREMENT /end FUNCTION
/begin COMPU_METHOD accgrd_ub_b555p55 "" RAT_FUNC "%6.2" "m/(s^3)" COEFFS 0 1 0 0 0 2.17 /end COMPU_METHOD
/begin COMPU_METHOD acc_ub_b55p55 "" RAT_FUNC "%6.3" "m/(s^2)" COEFFS 0 1 0 0 0 0.217 /end COMPU_METHOD
/begin COMPU_METHOD acc_uw_b55p55 "" RAT_FUNC "%6.5" "m/(s^2)" COEFFS 0 147456 0 0 0 125 /end COMPU_METHOD
/begin COMPU_METHOD B_TRUE "boolsche Zust‰nde, positive Logik" TAB_VERB "%6.3" "" COMPU_TAB_REF B_TRUE /end COMPU_METHOD
/begin COMPU_VTAB B_TRUE "boolsche Zust‰nde, positive Logik" TAB_VERB 2 0 "----" 1 "TRUE" /end COMPU_VTAB
/begin COMPU_METHOD DEZ "1 : 1 Umrechnug (dez/hex)" RAT_FUNC "%6.2" "" COEFFS 0 1 0 0 0 1 /end COMPU_METHOD
/begin COMPU_METHOD dez "1 : 1 Umrechnug (dez/hex)" RAT_FUNC "%6.2" "" COEFFS 0 1 0 0 0 1 /end COMPU_METHOD
/begin COMPU_METHOD dez_sb "" RAT_FUNC "%6.2" "Anzahl" COEFFS 0 1 0 0 0 1 /end COMPU_METHOD
/begin COMPU_METHOD di_uw_q0p01 "" RAT_FUNC "%6.4" "" COEFFS 0 100 0 0 0 1 /end COMPU_METHOD
/begin COMPU_METHOD fak_q0p015625 "" RAT_FUNC "%6.4" "-" COEFFS 0 64 0 0 0 1 /end COMPU_METHOD
/begin COMPU_METHOD fak_q0p5 "" RAT_FUNC "%6.3" "-" COEFFS 0 1 0 0 0 0.5 /end COMPU_METHOD
/begin COMPU_METHOD fak_r32_1 "" RAT_FUNC "%27.13" "-" COEFFS 0 1 0 0 0 1 /end COMPU_METHOD
/begin COMPU_METHOD fak_sw_b1 "" RAT_FUNC "%7.6" "-" COEFFS 0 65536 0 0 0 2 /end COMPU_METHOD
/begin COMPU_METHOD fak_ub_b1 "" RAT_FUNC "%6.4" "-" COEFFS 0 256 0 0 0 1 /end COMPU_METHOD
/begin COMPU_METHOD fak_ub_b16 "" RAT_FUNC "%6.4" "-" COEFFS 0 256 0 0 0 16 /end COMPU_METHOD
/begin COMPU_METHOD fak_ub_b2 "" RAT_FUNC "%6.4" "-" COEFFS 0 256 0 0 0 2 /end COMPU_METHOD
/begin COMPU_METHOD fak_uw_b16 "" RAT_FUNC "%6.5" "-" COEFFS 0 65536 0 0 0 16 /end COMPU_METHOD
/begin COMPU_METHOD fak_uw_b4 "" RAT_FUNC "%7.6" "-" COEFFS 0 65536 0 0 0 4 /end COMPU_METHOD
/begin COMPU_METHOD kw_q0p1 "" RAT_FUNC "%6.3" "Grad KW" COEFFS 0 10 0 0 0 1 /end COMPU_METHOD
/begin COMPU_METHOD kw_tooth_sy "" RAT_FUNC "%6.2" "∞KW" COEFFS 0 0.166666666666667 0 0 0 1 /end COMPU_METHOD
/begin COMPU_METHOD luquant_w "Umrechnung Laufunruhe Word-Grˆﬂen in DMD" RAT_FUNC "%6.4" "(1/min/s)^2" COEFFS 0 256 0 0 0 0.710543 /end COMPU_METHOD
/begin COMPU_METHOD m_q0p0015625 "" RAT_FUNC "%6.4" "kg/h" COEFFS 0 640 0 0 0 1 /end COMPU_METHOD
/begin COMPU_METHOD m_q0p4 "" RAT_FUNC "%6.3" "kg/h" COEFFS 0 1 0 0 0 0.4 /end COMPU_METHOD
/begin COMPU_METHOD m_q2p777Em5_kg "" RAT_FUNC "%7.6" "kg" COEFFS 0 3600 0 0 0 0.1 /end COMPU_METHOD
/begin COMPU_METHOD m_sw_q0p1 "" RAT_FUNC "%6.3" "kg/h" COEFFS 0 1 0 0 0 0.1 /end COMPU_METHOD
/begin COMPU_METHOD m_uw_b23p3 "" RAT_FUNC "%6.5" "kg" COEFFS 0 2812.5 0 0 0 1 /end COMPU_METHOD
/begin COMPU_METHOD m_uw_b6553p5 "" RAT_FUNC "%6.3" "kg/h" COEFFS 0 1 0 0 0 0.1 /end COMPU_METHOD
/begin COMPU_METHOD nmotg_sw_q0p39 "" RAT_FUNC "%6.3" "1/min/s" COEFFS 0 1 0 0 0 0.39063 /end COMPU_METHOD
/begin COMPU_METHOD nmot_ub_q40 "" RAT_FUNC "%6.1" "1/min" COEFFS 0 1 0 0 0 40 /end COMPU_METHOD
/begin COMPU_METHOD nmot_uw_q0p25 "" RAT_FUNC "%6.3" "1/min" COEFFS 0 1 0 0 0 0.25 /end COMPU_METHOD
/begin COMPU_METHOD relNWU_q0p0234 "" RAT_FUNC "%6.4" "%/NWU" COEFFS 0 32 0 0 0 0.75 /end COMPU_METHOD
/begin COMPU_METHOD rel_ub_b99p6 "" RAT_FUNC "%6.3" "%" COEFFS 0 256 0 0 0 100 /end COMPU_METHOD
/begin COMPU_METHOD rel_ub_q0p75 "" RAT_FUNC "%6.3" "%" COEFFS 0 1 0 0 0 0.75 /end COMPU_METHOD
/begin COMPU_METHOD rel_uw_b100 "" RAT_FUNC "%6.4" "%" COEFFS 0 65536 0 0 0 100 /end COMPU_METHOD
/begin COMPU_METHOD rel_uw_q0p0234 "" RAT_FUNC "%6.4" "%" COEFFS 0 32 0 0 0 0.75 /end COMPU_METHOD
/begin COMPU_METHOD spg_ubatt "" RAT_FUNC "%6.3" "V" COEFFS 0 1 0 0 0 0.0942 /end COMPU_METHOD
/begin COMPU_METHOD spg_uw_q0p00488_o1 "" RAT_FUNC "%6.3" "V" COEFFS 0 1024 1024 0 0 5 /end COMPU_METHOD
/begin COMPU_METHOD t100msxs_ub_b25p5 "" RAT_FUNC "%6.3" "s" COEFFS 0 1 0 0 0 0.1 /end COMPU_METHOD
/begin COMPU_METHOD t100msxs_uw_b6553p5 "" RAT_FUNC "%6.3" "s" COEFFS 0 1 0 0 0 0.1 /end COMPU_METHOD
/begin COMPU_METHOD t10msxs_ub_b2p55 "" RAT_FUNC "%6.4" "s" COEFFS 0 1 0 0 0 0.01 /end COMPU_METHOD
/begin COMPU_METHOD t10msxs_uw_b655p35 "" RAT_FUNC "%6.4" "s" COEFFS 0 1 0 0 0 0.01 /end COMPU_METHOD
/begin COMPU_METHOD t1sxs_uw_b65535 "" RAT_FUNC "%6.2" "s" COEFFS 0 1 0 0 0 1 /end COMPU_METHOD
/begin COMPU_METHOD t200msxs_ub_b51 "" RAT_FUNC "%6.3" "s" COEFFS 0 1 0 0 0 0.2 /end COMPU_METHOD
/begin COMPU_METHOD temp_q0p0234_o273 "" RAT_FUNC "%6.1" "Grad C" COEFFS 0 1 273.15 0 0 0.0234375 /end COMPU_METHOD
/begin COMPU_METHOD temp_ub_b191p25 "" RAT_FUNC "%6.3" "Grad C" COEFFS 0 1 0 0 0 0.75 /end COMPU_METHOD
/begin COMPU_METHOD temp_ub_q0p75_o48 "" RAT_FUNC "%6.2" "Grad C" COEFFS 0 1 48 0 0 0.75 /end COMPU_METHOD
/begin COMPU_METHOD temp_ub_q5_o50 "" RAT_FUNC "%6.2" "Grad C" COEFFS 0 1 50 0 0 5 /end COMPU_METHOD
/begin COMPU_METHOD tmin_uw_q1 "" RAT_FUNC "%6.2" "min" COEFFS 0 1 0 0 0 1 /end COMPU_METHOD
/begin COMPU_METHOD t_q0p1 "" RAT_FUNC "%6.3" "s" COEFFS 0 10 0 0 0 1 /end COMPU_METHOD
/begin COMPU_METHOD vfzg_ub_q1p25 "" RAT_FUNC "%6.2" "km/h" COEFFS 0 1 0 0 0 1.25 /end COMPU_METHOD
/begin COMPU_METHOD vnstv_q0p00305 "" RAT_FUNC "%7.5" "%" COEFFS 0 327.68 0 0 0 1 /end COMPU_METHOD
/begin COMPU_METHOD vnstv_q0p01 "" RAT_FUNC "%7.5" "%" COEFFS 0 100 0 0 0 1 /end COMPU_METHOD
/begin COMPU_METHOD zk100msxs_ub_b25p5 "" RAT_FUNC "%6.3" "s" COEFFS 0 0 256 0 10 0 /end COMPU_METHOD
/begin COMPU_METHOD zk100msxs_uw_b6553 "" RAT_FUNC "%6.1" "s" COEFFS 0 0 65536 0 10 0 /end COMPU_METHOD
/begin COMPU_METHOD default "" RAT_FUNC "%6.2" "" COEFFS 0 1 0 0 0 1 /end COMPU_METHOD
/begin RECORD_LAYOUT GkfWU16 FNC_VALUES 1 UWORD COLUMN_DIR DIRECT /end RECORD_LAYOUT
/begin RECORD_LAYOUT GkfWU8 FNC_VALUES 1 UBYTE COLUMN_DIR DIRECT /end RECORD_LAYOUT
/begin RECORD_LAYOUT GklWS16 FNC_VALUES 1 SWORD COLUMN_DIR DIRECT /end RECORD_LAYOUT
/begin RECORD_LAYOUT GklWU16 FNC_VALUES 1 UWORD COLUMN_DIR DIRECT /end RECORD_LAYOUT
/begin RECORD_LAYOUT GklWU8 FNC_VALUES 1 UBYTE COLUMN_DIR DIRECT /end RECORD_LAYOUT
/begin RECORD_LAYOUT KfAxU8AyU8SstxU16SstyU16WU16 NO_AXIS_PTS_X 1 UWORD NO_AXIS_PTS_Y 2 UWORD AXIS_PTS_X 3 UWORD INDEX_INCR DIRECT AXIS_PTS_Y 4 UWORD INDEX_INCR DIRECT FNC_VALUES 5 UWORD COLUMN_DIR DIRECT /end RECORD_LAYOUT
/begin RECORD_LAYOUT KfAxU8AyU8SstxU8SstyU8WU8 NO_AXIS_PTS_X 1 UBYTE NO_AXIS_PTS_Y 2 UBYTE AXIS_PTS_X 3 UBYTE INDEX_INCR DIRECT AXIS_PTS_Y 4 UBYTE INDEX_INCR DIRECT FNC_VALUES 5 UBYTE COLUMN_DIR DIRECT /end RECORD_LAYOUT
/begin RECORD_LAYOUT KlAUbSstUbWUb NO_AXIS_PTS_X 1 UBYTE AXIS_PTS_X 2 UBYTE INDEX_INCR DIRECT FNC_VALUES 3 UBYTE COLUMN_DIR DIRECT /end RECORD_LAYOUT
/begin RECORD_LAYOUT KlAUbSstUbWUw NO_AXIS_PTS_X 1 UBYTE AXIS_PTS_X 2 UBYTE INDEX_INCR DIRECT FNC_VALUES 3 UWORD COLUMN_DIR DIRECT /end RECORD_LAYOUT
/begin RECORD_LAYOUT KlAxU8SstxR32WR32 NO_AXIS_PTS_X 1 ULONG AXIS_PTS_X 2 FLOAT32_IEEE INDEX_INCR DIRECT FNC_VALUES 3 FLOAT32_IEEE COLUMN_DIR DIRECT /end RECORD_LAYOUT
/begin RECORD_LAYOUT KlAxU8SstxU16WU16 NO_AXIS_PTS_X 1 UWORD AXIS_PTS_X 2 UWORD INDEX_INCR DIRECT FNC_VALUES 3 UWORD COLUMN_DIR DIRECT /end RECORD_LAYOUT
/begin RECORD_LAYOUT KlAxU8SstxU8WU16 NO_AXIS_PTS_X 1 UBYTE AXIS_PTS_X 2 UBYTE INDEX_INCR DIRECT FNC_VALUES 3 UWORD COLUMN_DIR DIRECT /end RECORD_LAYOUT
/begin RECORD_LAYOUT KwbWR32 FNC_VALUES 1 FLOAT32_IEEE COLUMN_DIR DIRECT /end RECORD_LAYOUT
/begin RECORD_LAYOUT KwbWU16 FNC_VALUES 1 UWORD COLUMN_DIR DIRECT /end RECORD_LAYOUT
/begin RECORD_LAYOUT KwbWU8 FNC_VALUES 1 UBYTE COLUMN_DIR DIRECT /end RECORD_LAYOUT
/begin RECORD_LAYOUT KwSw FNC_VALUES 1 SWORD COLUMN_DIR DIRECT /end RECORD_LAYOUT
/begin RECORD_LAYOUT KwUb FNC_VALUES 1 UBYTE COLUMN_DIR DIRECT /end RECORD_LAYOUT
/begin RECORD_LAYOUT KwUw FNC_VALUES 1 UWORD COLUMN_DIR DIRECT /end RECORD_LAYOUT
/begin RECORD_LAYOUT KwWR32 FNC_VALUES 1 FLOAT32_IEEE COLUMN_DIR DIRECT /end RECORD_LAYOUT
/begin RECORD_LAYOUT KwWS16 FNC_VALUES 1 SWORD COLUMN_DIR DIRECT /end RECORD_LAYOUT
/begin RECORD_LAYOUT KwWU16 FNC_VALUES 1 UWORD COLUMN_DIR DIRECT /end RECORD_LAYOUT
/begin RECORD_LAYOUT KwWU8 FNC_VALUES 1 UBYTE COLUMN_DIR DIRECT /end RECORD_LAYOUT
/begin RECORD_LAYOUT SstAU8SstU16 NO_AXIS_PTS_X 1 UWORD AXIS_PTS_X 2 UWORD INDEX_INCR DIRECT /end RECORD_LAYOUT
/begin RECORD_LAYOUT SstAU8SstU8 NO_AXIS_PTS_X 1 UBYTE AXIS_PTS_X 2 UBYTE INDEX_INCR DIRECT /end RECORD_LAYOUT
/end MODULE
/end PROJECT
