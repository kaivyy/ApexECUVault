ASAP2_VERSION 1 41
/begin PROJECT MSD85 "Spray Guided DI-System with Piezo Injectors for 8-Cylinder"
/begin HEADER "_default_HeaderComment" PROJECT_NO _91 /end HEADER
/begin MODULE _default_ModuleName "_default_ModuleLongIdentifier"
/begin MOD_COMMON "_default_ModCommonComment" DEPOSIT ABSOLUTE BYTE_ORDER MSB_LAST ALIGNMENT_BYTE 1 ALIGNMENT_WORD 2 ALIGNMENT_LONG 2 ALIGNMENT_FLOAT32_IEEE 2 ALIGNMENT_FLOAT64_IEEE 4 /end MOD_COMMON
/begin AXIS_PTS ldpm_tco_1_laco "" 0xa08067f2 tco _REC_AXS_20_u1 190.5 _CNV_A_R_LINEAR_____17_CM 6 -48. 142.5 FORMAT "%6.2" /end AXIS_PTS
/begin AXIS_PTS ldpm_tco_2_laco "" 0xa08067fa tco _REC_AXS_20_u1 190.5 _CNV_A_R_LINEAR_____17_CM 5 -48. 142.5 FORMAT "%6.2" /end AXIS_PTS
/begin AXIS_PTS ldpm_tco_3_laco "" 0xa0806800 tco _REC_AXS_20_u1 190.5 _CNV_A_R_LINEAR_____17_CM 6 -48. 142.5 FORMAT "%6.2" /end AXIS_PTS
/begin AXIS_PTS ldpm_fac_lam_ad_1_laco "" 0xa0806734 online_dummy _REC_AXS_20_u2 99.99847412 _CNV_A_R_LINEAR_____178_CM 5 -50. 49.99847412 FORMAT "%7.3" /end AXIS_PTS
/begin MEASUREMENT laco[0].laco_struct_reqgncdn0.crk_dif_soi_lsl_pos "crank shaft angle difference between the start of injection and the end of the exhaust cycle" UWORD _CNV_A_R_LINEAR_____112_CM 1 100. 0. 1620. DISPLAY_IDENTIFIER CRK_DIF_SOI_LSL_POS[1] ECU_ADDRESS 0xd0006134 FORMAT "%6.1" /end MEASUREMENT
/begin MEASUREMENT laco[0].laco_struct_reqgncdn0.maf_int_lam_reac "air mass flow for lambda controller reactivation after stop mode" UWORD _CNV_A_R_LINEAR_____287_CM 1 100. 0. 1820.41666666667 DISPLAY_IDENTIFIER MAF_INT_LAM_REAC[1] ECU_ADDRESS 0xd0006136 FORMAT "%7.2" /end MEASUREMENT
/begin MEASUREMENT laco[0].laco_struct_reqgncdn0.t_lam_reac "time counter for lambda controller reactivation after stop mode " UBYTE _CNV_A_R_LINEAR_____110_CM 1 100. 0. 5.1 DISPLAY_IDENTIFIER T_LAM_REAC[1] ECU_ADDRESS 0xd0006138 FORMAT "%4.2" /end MEASUREMENT
/begin MEASUREMENT laco[0].laco_struct_reqgncdn0.lv_lam_stop "activation signal for the lambda controller stop mode" UBYTE _CNV_S_2_RANGE__0___1_CM 1 100. 0. 1. DISPLAY_IDENTIFIER LV_LAM_STOP[1] ECU_ADDRESS 0xd0006139 BIT_MASK 0x1 /end MEASUREMENT
/begin MEASUREMENT laco[0].laco_struct_reqgncdn0.lv_lam_stop_sho_per "activation signal for the controller stop mode while active offset adjustment" UBYTE _CNV_S_2_RANGE__0___1_CM 1 100. 0. 1. DISPLAY_IDENTIFIER LV_LAM_STOP_SHO_PER[1] ECU_ADDRESS 0xd000613a BIT_MASK 0x1 /end MEASUREMENT
/begin MEASUREMENT laco[0].laco_struct_reqgncdn0.lv_lam_act_dc "closed loop had been enabled for at least one time" UBYTE _CNV_S_2_RANGE__0___1_CM 1 100. 0. 1. DISPLAY_IDENTIFIER LV_LAM_ACT_DC[1] ECU_ADDRESS 0xd000613b BIT_MASK 0x1 /end MEASUREMENT
/begin MEASUREMENT laco[0].laco_struct_reqgncdn0.state_ls "Fuel system status" UBYTE _CNV_S_5_LACO_RANGE_375_CM 1 100. 1. 16. DISPLAY_IDENTIFIER STATE_LS[1] ECU_ADDRESS 0xd000613c /end MEASUREMENT
/begin MEASUREMENT laco[0].laco_struct_reqgntrcdn0.maf_int_lam_adj_cdn "air mass flow integral for condition detection of WRAF sensor characterisitc line adaptation" UWORD _CNV_A_R_LINEAR_____287_CM 1 100. 0. 1820.41666666667 DISPLAY_IDENTIFIER MAF_INT_LAM_ADJ_CDN[1] ECU_ADDRESS 0xd0006140 FORMAT "%7.2" /end MEASUREMENT
/begin MEASUREMENT laco[0].laco_struct_reqgntrcdn0.lv_lam_adj_ad_cdn_ok "flag indicating good conditions for WRAF sensor characteristic line adaptation" UBYTE _CNV_S_2_RANGE__0___1_CM 1 100. 0. 1. DISPLAY_IDENTIFIER LV_LAM_ADJ_AD_CDN_OK[1] ECU_ADDRESS 0xd0006142 BIT_MASK 0x1 /end MEASUREMENT
/begin MEASUREMENT laco[0].laco_struct_reqgntrimad0.lamb_delta_dif_i_lam_adj_ad "trim controI I share shift in case of new adaptation value for WRAF sensor characteristic line shift" SWORD _CNV_A_R_LINEAR_____24_CM 1 100. -0.125 0.125 DISPLAY_IDENTIFIER LAMB_DELTA_DIF_I_LAM_ADJ_AD[1] ECU_ADDRESS 0xd0006144 FORMAT "%8.5" /end MEASUREMENT
/begin MEASUREMENT laco[0].laco_struct_reqgntrimad0.lamb_delta_sum_lam_adj_ad "total characteristic line shift of WRAF sensor" SWORD _CNV_A_R_LINEAR_____24_CM 1 100. -0.125 0.125 DISPLAY_IDENTIFIER LAMB_DELTA_SUM_LAM_ADJ_AD[1] ECU_ADDRESS 0xd0006146 FORMAT "%8.5" /end MEASUREMENT
/begin MEASUREMENT laco[0].laco_struct_reqgntrimad0.lamb_delta_ad_lam_adj "adaptation value for WRAF sensor characteritic line shift" SWORD _CNV_A_R_LINEAR_____24_CM 1 100. -0.125 0.125 DISPLAY_IDENTIFIER LAMB_DELTA_AD_LAM_ADJ[1] ECU_ADDRESS 0xd0006148 FORMAT "%8.5" /end MEASUREMENT
/begin MEASUREMENT laco[0].laco_struct_reqgntrimad0.lamb_delta_bas_lam_adj_ad "basic characteristic line shift of WRAF sensor" SWORD _CNV_A_R_LINEAR_____24_CM 1 100. -0.125 0.125 DISPLAY_IDENTIFIER LAMB_DELTA_BAS_LAM_ADJ_AD[1] ECU_ADDRESS 0xd000614a FORMAT "%8.5" /end MEASUREMENT
/begin MEASUREMENT laco[0].laco_struct_reqgntrimad0.ctr_raf_chg_lam_adj "counter for lean <-> rich air fuel ratio changes" UBYTE _CNV_A_R_LINEAR_____0_CM 1 100. 0. 255. DISPLAY_IDENTIFIER CTR_RAF_CHG_LAM_ADJ[1] ECU_ADDRESS 0xd000614c FORMAT "%3.0" /end MEASUREMENT
/begin MEASUREMENT laco[0].laco_struct_reqgntrimad0.lv_lam_adj_ad_req "request for trim control I share shift due to new adaptation value learning" UBYTE _CNV_S_2_RANGE__0___1_CM 1 100. 0. 1. DISPLAY_IDENTIFIER LV_LAM_ADJ_AD_REQ[1] ECU_ADDRESS 0xd000614d BIT_MASK 0x1 /end MEASUREMENT
/begin MEASUREMENT laco[0].laco_struct_ispcladaw0.fac_lam_tco_min "Lambda controller output at TCO_MIN_LAM_AD_WUP" SWORD _CNV_A_R_LINEAR_____113_CM 1 100. -50. 49.9984741210938 DISPLAY_IDENTIFIER FAC_LAM_TCO_MIN[1] ECU_ADDRESS 0xd0006150 FORMAT "%7.3" /end MEASUREMENT
/begin MEASUREMENT laco[0].laco_struct_ispcladaw0.fac_lam_ad_wup "Fuel mass set point factor of lambda adaptation in warm up phase" SWORD _CNV_A_R_LINEAR_____113_CM 1 100. -50. 49.9984741210938 DISPLAY_IDENTIFIER FAC_LAM_AD_WUP[1] ECU_ADDRESS 0xd0006152 FORMAT "%7.3" /end MEASUREMENT
/begin MEASUREMENT laco[0].laco_struct_ispcladaw0.fac_lam_adj_lam_ad_wup "Output value from lambda adaptation in warm up phase for the lambda controller shift" SWORD _CNV_A_R_LINEAR_____113_CM 1 100. -50. 49.9984741210938 DISPLAY_IDENTIFIER FAC_LAM_ADJ_LAM_AD_WUP[1] ECU_ADDRESS 0xd0006154 FORMAT "%7.3" /end MEASUREMENT
/begin MEASUREMENT laco[0].laco_struct_ispcladaw0.fac_lam_dif_lam_ad_wup_mv "Average value of Lambda controller output for Lambda adaptation in warm up phase" SWORD _CNV_A_R_LINEAR_____113_CM 1 100. -50. 49.9984741210938 DISPLAY_IDENTIFIER FAC_LAM_DIF_LAM_AD_WUP_MV[1] ECU_ADDRESS 0xd0006156 FORMAT "%7.3" /end MEASUREMENT
/begin MEASUREMENT laco[0].laco_struct_ispcladaw0.fac_lam_tco_a "Lambda controller output at C_TCO_A_LAM_AD_WUP" SWORD _CNV_A_R_LINEAR_____113_CM 1 100. -50. 49.9984741210938 DISPLAY_IDENTIFIER FAC_LAM_TCO_A[1] ECU_ADDRESS 0xd0006158 FORMAT "%7.3" /end MEASUREMENT
/begin MEASUREMENT laco[0].laco_struct_ispcladaw0.fac_lam_tco_b "Lambda controller output at C_TCO_B_LAM_AD_WUP" SWORD _CNV_A_R_LINEAR_____113_CM 1 100. -50. 49.9984741210938 DISPLAY_IDENTIFIER FAC_LAM_TCO_B[1] ECU_ADDRESS 0xd000615a FORMAT "%7.3" /end MEASUREMENT
/begin MEASUREMENT laco[0].laco_struct_ispcladaw0.fac_lam_tco_c "Lambda controller output at C_TCO_C_LAM_AD_WUP" SWORD _CNV_A_R_LINEAR_____113_CM 1 100. -50. 49.9984741210938 DISPLAY_IDENTIFIER FAC_LAM_TCO_C[1] ECU_ADDRESS 0xd000615c FORMAT "%7.3" /end MEASUREMENT
/begin MEASUREMENT laco[0].laco_struct_ispcladaw0.fac_lam_tco_d "Lambda controller output at C_TCO_D_LAM_AD_WUP" SWORD _CNV_A_R_LINEAR_____113_CM 1 100. -50. 49.9984741210938 DISPLAY_IDENTIFIER FAC_LAM_TCO_D[1] ECU_ADDRESS 0xd000615e FORMAT "%7.3" /end MEASUREMENT
/begin MEASUREMENT laco[0].laco_struct_ispcladaw0.fac_lam_tco_e "Lambda controller output at C_TCO_E_LAM_AD_WUP" SWORD _CNV_A_R_LINEAR_____113_CM 1 100. -50. 49.9984741210938 DISPLAY_IDENTIFIER FAC_LAM_TCO_E[1] ECU_ADDRESS 0xd0006160 FORMAT "%7.3" /end MEASUREMENT
/begin MEASUREMENT laco[0].laco_struct_ispcladaw0.fac_lam_ad_wup_shift "shift value of lambda adaptation in warm up phase after 1st learning" SWORD _CNV_A_R_LINEAR_____113_CM 1 100. -50. 49.9984741210938 DISPLAY_IDENTIFIER FAC_LAM_AD_WUP_SHIFT[1] ECU_ADDRESS 0xd0006162 FORMAT "%7.3" /end MEASUREMENT
/begin MEASUREMENT laco[0].laco_struct_ispcladaw0.fac_beg_l_rng_lam_ad "Lambda adaptation value in low range after reset and after auto shift" SWORD _CNV_A_R_LINEAR_____113_CM 1 100. -50. 49.9984741210938 DISPLAY_IDENTIFIER FAC_BEG_L_RNG_LAM_AD[1] ECU_ADDRESS 0xd0006164 FORMAT "%7.3" /end MEASUREMENT
/begin MEASUREMENT laco[0].laco_struct_ispcladaw0.fac_lam_add_chg_fq_det "additive shift of adaptation values if change in fuel quality is detected" SWORD _CNV_A_R_LINEAR_____113_CM 1 100. -50. 49.9984741210938 DISPLAY_IDENTIFIER FAC_LAM_ADD_CHG_FQ_DET[1] ECU_ADDRESS 0xd0006166 FORMAT "%7.3" /end MEASUREMENT
/begin MEASUREMENT laco[0].laco_struct_ispcladaw0.t_lam_ad_wup_ldc "timer to have valid limited dynamic phase for Lambda adaptation in warm up phase (partial load)" UWORD _CNV_A_R_LINEAR_____4_CM 1 100. 0. 6553.5 DISPLAY_IDENTIFIER T_LAM_AD_WUP_LDC[1] ECU_ADDRESS 0xd0006168 FORMAT "%6.1" /end MEASUREMENT
/begin MEASUREMENT laco[0].laco_struct_ispcladaw0.t_lam_ad_wup_tra_pha "timer indicating transient phase of Lambda adaptation in warm up phase" UWORD _CNV_A_R_LINEAR_____4_CM 1 100. 0. 6553.5 DISPLAY_IDENTIFIER T_LAM_AD_WUP_TRA_PHA[1] ECU_ADDRESS 0xd000616a FORMAT "%6.1" /end MEASUREMENT
/begin MEASUREMENT laco[0].laco_struct_ispcladaw0.tco_min_lam_ad_wup "minimum TCO of all driving cycles where learning conditions for Lambda adaptation in warm up phase (partial load) are fulfilled" UBYTE _CNV_A_R_LINEAR_____17_CM 1 100. -48. 142.5 DISPLAY_IDENTIFIER TCO_MIN_LAM_AD_WUP[1] ECU_ADDRESS 0xd000616c FORMAT "%6.2" /end MEASUREMENT
/begin MEASUREMENT laco[0].laco_struct_ispcladaw0.tco_min_inter_lam_ad_wup "Minimum TCO of current driving cycles where learning conditions for Lambda adaptation in warm up phase are fulfilled" UBYTE _CNV_A_R_LINEAR_____17_CM 1 100. -48. 142.5 DISPLAY_IDENTIFIER TCO_MIN_INTER_LAM_AD_WUP[1] ECU_ADDRESS 0xd000616d FORMAT "%6.2" /end MEASUREMENT
/begin MEASUREMENT laco[0].laco_struct_ispcladaw0.tco_a_lam_ad_wup "actual coolant temperature in range around point A at which adaptation value was learnt" UBYTE _CNV_A_R_LINEAR_____17_CM 1 100. -48. 142.5 DISPLAY_IDENTIFIER TCO_A_LAM_AD_WUP[1] ECU_ADDRESS 0xd000616e FORMAT "%6.2" /end MEASUREMENT
/begin MEASUREMENT laco[0].laco_struct_ispcladaw0.tco_b_lam_ad_wup "actual coolant temperature in range around point B at which adaptation value was learnt" UBYTE _CNV_A_R_LINEAR_____17_CM 1 100. -48. 142.5 DISPLAY_IDENTIFIER TCO_B_LAM_AD_WUP[1] ECU_ADDRESS 0xd000616f FORMAT "%6.2" /end MEASUREMENT
/begin MEASUREMENT laco[0].laco_struct_ispcladaw0.tco_c_lam_ad_wup "actual coolant temperature in range around point C at which adaptation value was learnt" UBYTE _CNV_A_R_LINEAR_____17_CM 1 100. -48. 142.5 DISPLAY_IDENTIFIER TCO_C_LAM_AD_WUP[1] ECU_ADDRESS 0xd0006170 FORMAT "%6.2" /end MEASUREMENT
/begin MEASUREMENT laco[0].laco_struct_ispcladaw0.tco_d_lam_ad_wup "actual coolant temperature in range around point D at which adaptation value was learnt" UBYTE _CNV_A_R_LINEAR_____17_CM 1 100. -48. 142.5 DISPLAY_IDENTIFIER TCO_D_LAM_AD_WUP[1] ECU_ADDRESS 0xd0006171 FORMAT "%6.2" /end MEASUREMENT
/begin MEASUREMENT laco[0].laco_struct_ispcladaw0.tco_e_lam_ad_wup "actual coolant temperature in range around point E at which adaptation value was learnt" UBYTE _CNV_A_R_LINEAR_____17_CM 1 100. -48. 142.5 DISPLAY_IDENTIFIER TCO_E_LAM_AD_WUP[1] ECU_ADDRESS 0xd0006172 FORMAT "%6.2" /end MEASUREMENT
/begin MEASUREMENT laco[0].laco_struct_ispcladaw0.ctr_tco_min_inter "Counter for detection of TCO_MIN_INTER_LAM_AD_WUP" UBYTE _CNV_A_R_LINEAR_____0_CM 1 100. 0. 255. DISPLAY_IDENTIFIER CTR_TCO_MIN_INTER[1] ECU_ADDRESS 0xd0006173 FORMAT "%3.0" /end MEASUREMENT
/begin MEASUREMENT laco[0].laco_struct_ispcladaw0.crlc_fac_lam_tco_x "correlation factor for updating FAC_LAM_TCO_X" UBYTE _CNV_A_R_LINEAR_____103_CM 1 100. 0. 1.9921875 DISPLAY_IDENTIFIER CRLC_FAC_LAM_TCO_X[1] ECU_ADDRESS 0xd0006174 FORMAT "%8.6" /end MEASUREMENT
/begin MEASUREMENT laco[0].laco_struct_ispcladaw0.lv_tco_a_lam_ad_wup "Flag indicating that Lambda adaptation value in warm up phase at C_TCO_A_LAM_AD_WUP was updated" UBYTE _CNV_A_R_LINEAR_____0_CM 1 100. 0. 1. DISPLAY_IDENTIFIER LV_TCO_A_LAM_AD_WUP[1] ECU_ADDRESS 0xd0006175 FORMAT "%1.0" BIT_MASK 0x1 /end MEASUREMENT
/begin MEASUREMENT laco[0].laco_struct_ispcladaw0.lv_tco_b_lam_ad_wup "Flag indicating that Lambda adaptation value in warm up phase at C_TCO_B_LAM_AD_WUP was updated" UBYTE _CNV_A_R_LINEAR_____0_CM 1 100. 0. 1. DISPLAY_IDENTIFIER LV_TCO_B_LAM_AD_WUP[1] ECU_ADDRESS 0xd0006176 FORMAT "%1.0" BIT_MASK 0x1 /end MEASUREMENT
/begin MEASUREMENT laco[0].laco_struct_ispcladaw0.lv_tco_c_lam_ad_wup "Flag indicating that Lambda adaptation value in warm up phase at C_TCO_C_LAM_AD_WUP was updated" UBYTE _CNV_A_R_LINEAR_____0_CM 1 100. 0. 1. DISPLAY_IDENTIFIER LV_TCO_C_LAM_AD_WUP[1] ECU_ADDRESS 0xd0006177 FORMAT "%1.0" BIT_MASK 0x1 /end MEASUREMENT
/begin MEASUREMENT laco[0].laco_struct_ispcladaw0.lv_tco_d_lam_ad_wup "Flag indicating that Lambda adaptation value in warm up phase at C_TCO_D_LAM_AD_WUP was updated" UBYTE _CNV_A_R_LINEAR_____0_CM 1 100. 0. 1. DISPLAY_IDENTIFIER LV_TCO_D_LAM_AD_WUP[1] ECU_ADDRESS 0xd0006178 FORMAT "%1.0" BIT_MASK 0x1 /end MEASUREMENT
/begin MEASUREMENT laco[0].laco_struct_ispcladaw0.lv_tco_e_lam_ad_wup "Flag indicating that Lambda adaptation value in warm up phase at C_TCO_E_LAM_AD_WUP was updated" UBYTE _CNV_A_R_LINEAR_____0_CM 1 100. 0. 1. DISPLAY_IDENTIFIER LV_TCO_E_LAM_AD_WUP[1] ECU_ADDRESS 0xd0006179 FORMAT "%1.0" BIT_MASK 0x1 /end MEASUREMENT
/begin MEASUREMENT laco[0].laco_struct_ispcladaw0.lv_tco_min_lam_ad_wup "Flag indicating that Lambda adaptation value in warm up phase at TCO_MIN_LAM_AD_WUP was updated" UBYTE _CNV_S_2_RANGE__0___1_CM 1 100. 0. 1. DISPLAY_IDENTIFIER LV_TCO_MIN_LAM_AD_WUP[1] ECU_ADDRESS 0xd000617a BIT_MASK 0x1 /end MEASUREMENT
/begin MEASUREMENT laco[0].laco_struct_ispcladaw0.lv_tco_min_inter_lam_ad_wup "Flag indicating that learning conditions for Lambda adaptation value in warm up phase are fulfilled" UBYTE _CNV_S_2_RANGE__0___1_CM 1 100. 0. 1. DISPLAY_IDENTIFIER LV_TCO_MIN_INTER_LAM_AD_WUP[1] ECU_ADDRESS 0xd000617b BIT_MASK 0x1 /end MEASUREMENT
/begin MEASUREMENT laco[0].laco_struct_ispcladaw0.lv_fac_lam_adj_lam_ad_wup "Flag to request lambda controller shift from Lambda adaptation in warm up phase" UBYTE _CNV_S_2_RANGE__0___1_CM 1 100. 0. 1. DISPLAY_IDENTIFIER LV_FAC_LAM_ADJ_LAM_AD_WUP[1] ECU_ADDRESS 0xd000617c BIT_MASK 0x1 /end MEASUREMENT
/begin MEASUREMENT laco[0].laco_struct_ispcladaw0.lv_lam_ad_wup_stop "Logical variable indicating need of Lambda controller shift to mirror shift in Lambda adaptation in warm up phase" UBYTE _CNV_S_2_RANGE__0___1_CM 1 100. 0. 1. DISPLAY_IDENTIFIER LV_LAM_AD_WUP_STOP[1] ECU_ADDRESS 0xd000617d BIT_MASK 0x1 /end MEASUREMENT
/begin MEASUREMENT laco[0].laco_struct_ispcladaw0.lv_load_vld "flag indicating that conditions for valid learning are fulfilled" UBYTE _CNV_S_2_RANGE__0___1_CM 1 100. 0. 1. DISPLAY_IDENTIFIER LV_LOAD_VLD[1] ECU_ADDRESS 0xd000617e BIT_MASK 0x1 /end MEASUREMENT
/begin MEASUREMENT laco[0].laco_struct_ispcladaw0.lv_ctr_max_tco_min_inter "flag indicating that counter based criteria for transient phase has expired" UBYTE _CNV_S_2_RANGE__0___1_CM 1 100. 0. 1. DISPLAY_IDENTIFIER LV_CTR_MAX_TCO_MIN_INTER[1] ECU_ADDRESS 0xd000617f BIT_MASK 0x1 /end MEASUREMENT
/begin MEASUREMENT laco[0].laco_struct_ispcladaw0.lv_t_max_lam_ad_wup_tra_pha "flag indicating that time dependent criteria for transient phase has expired" UBYTE _CNV_S_2_RANGE__0___1_CM 1 100. 0. 1. DISPLAY_IDENTIFIER LV_T_MAX_LAM_AD_WUP_TRA_PHA[1] ECU_ADDRESS 0xd0006180 BIT_MASK 0x1 /end MEASUREMENT
/begin MEASUREMENT laco[0].laco_struct_ispcladaw0.lv_lam_ad_wup_chg_fq_det "flag indicating that change in fuel quality was detected in this driving cycle" UBYTE _CNV_S_2_RANGE__0___1_CM 1 100. 0. 1. DISPLAY_IDENTIFIER LV_LAM_AD_WUP_CHG_FQ_DET[1] ECU_ADDRESS 0xd0006181 BIT_MASK 0x1 /end MEASUREMENT
/begin MEASUREMENT laco[0].laco_struct_fctdgfsda0.lv_fsd_act "Global activation flag for fuel system diagnosis" UBYTE _CNV_S_2_RANGE__0___1_CM 1 100. 0. 1. DISPLAY_IDENTIFIER LV_FSD_ACT[1] ECU_ADDRESS 0xd0006184 BIT_MASK 0x1 /end MEASUREMENT
/begin MEASUREMENT laco[0].laco_struct_fctdgfsd0.t_sum_end_diag_win_fsd_add "Counter for the diagnosis window - additive adaptation learning area" UWORD _CNV_A_R_LINEAR_____110_CM 1 100. 0. 1310.7 DISPLAY_IDENTIFIER T_SUM_END_DIAG_WIN_FSD_ADD[1] ECU_ADDRESS 0xd0006188 FORMAT "%7.2" /end MEASUREMENT
/begin MEASUREMENT laco[0].laco_struct_fctdgfsd0.t_lam_ad_act_fsd "Timer indicating the forced lambda adaptation is running" UWORD _CNV_A_R_LINEAR_____110_CM 1 100. 0. 1310.7 DISPLAY_IDENTIFIER T_LAM_AD_ACT_FSD[1] ECU_ADDRESS 0xd000618a FORMAT "%7.2" /end MEASUREMENT
/begin MEASUREMENT laco[0].laco_struct_fctdgfsd0.t_lam_lim_lam_ad_req "Timer for forced lambda adaptation" UWORD _CNV_A_R_LINEAR_____110_CM 1 100. 0. 1310.7 DISPLAY_IDENTIFIER T_LAM_LIM_LAM_AD_REQ[1] ECU_ADDRESS 0xd000618c FORMAT "%7.2" /end MEASUREMENT
/begin MEASUREMENT laco[0].laco_struct_fctdgfsd0.t_sum_end_diag_win_fsd "Counter for the diagnosis window - relevant to MIL" UWORD _CNV_A_R_LINEAR_____110_CM 1 100. 0. 1310.7 DISPLAY_IDENTIFIER T_SUM_END_DIAG_WIN_FSD[1] ECU_ADDRESS 0xd000618e FORMAT "%7.2" /end MEASUREMENT
/begin MEASUREMENT laco[0].laco_struct_fctdgfsd0.t_sum_end_diag_win_fsd_h_rng "Counter for the diagnosis window - upper multiplicative adaptation learning area" UWORD _CNV_A_R_LINEAR_____110_CM 1 100. 0. 1310.7 DISPLAY_IDENTIFIER T_SUM_END_DIAG_WIN_FSD_H_RNG[1] ECU_ADDRESS 0xd0006190 FORMAT "%7.2" /end MEASUREMENT
/begin MEASUREMENT laco[0].laco_struct_fctdgfsd0.t_sum_end_diag_win_fsd_lam "Counter for the diagnosis window - lambda control in dead stop" UWORD _CNV_A_R_LINEAR_____110_CM 1 100. 0. 1310.7 DISPLAY_IDENTIFIER T_SUM_END_DIAG_WIN_FSD_LAM[1] ECU_ADDRESS 0xd0006192 FORMAT "%7.2" /end MEASUREMENT
/begin MEASUREMENT laco[0].laco_struct_fctdgfsd0.t_sum_max_fsd "Total duration of LV_MFF_ADD_LIM_MAX_LAM_AD[i] = 1 or LV_FAC_L_RNG_LIM_MAX_LAM_AD[i] = 1" UWORD _CNV_A_R_LINEAR_____110_CM 1 100. 0. 1310.7 DISPLAY_IDENTIFIER T_SUM_MAX_FSD[1] ECU_ADDRESS 0xd0006194 FORMAT "%7.2" /end MEASUREMENT
/begin MEASUREMENT laco[0].laco_struct_fctdgfsd0.t_sum_max_fsd_h_rng "Total duration of LV_FAC_H_RNG_LIM_MAX_LAM_AD[i] = 1" UWORD _CNV_A_R_LINEAR_____110_CM 1 100. 0. 1310.7 DISPLAY_IDENTIFIER T_SUM_MAX_FSD_H_RNG[1] ECU_ADDRESS 0xd0006196 FORMAT "%7.2" /end MEASUREMENT
/begin MEASUREMENT laco[0].laco_struct_fctdgfsd0.t_sum_max_fsd_lam_lim "Total duration of LV_FAC_LAM_LIM_MAX[i] = 1" UWORD _CNV_A_R_LINEAR_____110_CM 1 100. 0. 1310.7 DISPLAY_IDENTIFIER T_SUM_MAX_FSD_LAM_LIM[1] ECU_ADDRESS 0xd0006198 FORMAT "%7.2" /end MEASUREMENT
/begin MEASUREMENT laco[0].laco_struct_fctdgfsd0.t_sum_min_fsd "Total duration of LV_MFF_ADD_LIM_MIN_LAM_AD[i] = 1 or LV_FAC_L_RNG_LIM_MIN_LAM_AD[i] = 1" UWORD _CNV_A_R_LINEAR_____110_CM 1 100. 0. 1310.7 DISPLAY_IDENTIFIER T_SUM_MIN_FSD[1] ECU_ADDRESS 0xd000619a FORMAT "%7.2" /end MEASUREMENT
/begin MEASUREMENT laco[0].laco_struct_fctdgfsd0.t_sum_min_fsd_h_rng "Total duration of LV_FAC_H_RNG_LIM_MIN_LAM_AD[i] = 1" UWORD _CNV_A_R_LINEAR_____110_CM 1 100. 0. 1310.7 DISPLAY_IDENTIFIER T_SUM_MIN_FSD_H_RNG[1] ECU_ADDRESS 0xd000619c FORMAT "%7.2" /end MEASUREMENT
/begin MEASUREMENT laco[0].laco_struct_fctdgfsd0.t_sum_min_fsd_lam_lim "Total duration of LV_FAC_LAM_LIM_MIN[i] = 1" UWORD _CNV_A_R_LINEAR_____110_CM 1 100. 0. 1310.7 DISPLAY_IDENTIFIER T_SUM_MIN_FSD_LAM_LIM[1] ECU_ADDRESS 0xd000619e FORMAT "%7.2" /end MEASUREMENT
/begin MEASUREMENT laco[0].laco_struct_fctdgfsd0.t_sum_rst_fsd "Timer to reset the counter of total duration in MIL - area" UWORD _CNV_A_R_LINEAR_____110_CM 1 100. 0. 1310.7 DISPLAY_IDENTIFIER T_SUM_RST_FSD[1] ECU_ADDRESS 0xd00061a0 FORMAT "%7.2" /end MEASUREMENT
/begin MEASUREMENT laco[0].laco_struct_fctdgfsd0.t_sum_rst_fsd_h_rng "Timer to reset the counter of total duration in H_RNG - area" UWORD _CNV_A_R_LINEAR_____110_CM 1 100. 0. 1310.7 DISPLAY_IDENTIFIER T_SUM_RST_FSD_H_RNG[1] ECU_ADDRESS 0xd00061a2 FORMAT "%7.2" /end MEASUREMENT
/begin MEASUREMENT laco[0].laco_struct_fctdgfsd0.t_sum_rst_fsd_lam_lim "Timer to reset the counter of total duration for lambda control in dead stop" UWORD _CNV_A_R_LINEAR_____110_CM 1 100. 0. 1310.7 DISPLAY_IDENTIFIER T_SUM_RST_FSD_LAM_LIM[1] ECU_ADDRESS 0xd00061a4 FORMAT "%7.2" /end MEASUREMENT
/begin MEASUREMENT laco[0].laco_struct_fctdgfsd0.t_sum_end_diag_win_fsd_fac_l "Counter for the diagnosis window - lower multiplicative adaptation learning area" UWORD _CNV_A_R_LINEAR_____110_CM 1 100. 0. 1310.7 DISPLAY_IDENTIFIER T_SUM_END_DIAG_WIN_FSD_FAC_L[1] ECU_ADDRESS 0xd00061a6 FORMAT "%7.2" /end MEASUREMENT
/begin MEASUREMENT laco[0].laco_struct_fctdgfsd0.lv_err_fsd "Failure of lambda adaptation monitoring - relevant to malfunction indication light" UBYTE _CNV_S_2_RANGE__0___1_CM 1 100. 0. 1. DISPLAY_IDENTIFIER LV_ERR_FSD[1] ECU_ADDRESS 0xd00061a8 BIT_MASK 0x1 /end MEASUREMENT
/begin MEASUREMENT laco[0].laco_struct_fctdgfsd0.lv_err_fsd_lam_lim "Failure for lambda controller in dead stop - relevant to malfunction indication light" UBYTE _CNV_S_2_RANGE__0___1_CM 1 100. 0. 1. DISPLAY_IDENTIFIER LV_ERR_FSD_LAM_LIM[1] ECU_ADDRESS 0xd00061a9 BIT_MASK 0x1 /end MEASUREMENT
/begin MEASUREMENT laco[0].laco_struct_fctdgfsd0.lv_err_fsd_h_rng "Failure in upper multiplicative adaptation learning area" UBYTE _CNV_S_2_RANGE__0___1_CM 1 100. 0. 1. DISPLAY_IDENTIFIER LV_ERR_FSD_H_RNG[1] ECU_ADDRESS 0xd00061aa BIT_MASK 0x1 /end MEASUREMENT
/begin MEASUREMENT laco[0].laco_struct_fctdgfsd0.lv_end_diag_win_fsd "End of diagnosis cycle for similar conditions window in additive adaptation learning area" UBYTE _CNV_S_2_RANGE__0___1_CM 1 100. 0. 1. DISPLAY_IDENTIFIER LV_END_DIAG_WIN_FSD[1] ECU_ADDRESS 0xd00061ab BIT_MASK 0x1 /end MEASUREMENT
/begin MEASUREMENT laco[0].laco_struct_fctdgfsd0.lv_end_diag_win_fsd_lam_lim "End of diagnosis cycle for similar conditions window in case of lambda control in dead stop" UBYTE _CNV_S_2_RANGE__0___1_CM 1 100. 0. 1. DISPLAY_IDENTIFIER LV_END_DIAG_WIN_FSD_LAM_LIM[1] ECU_ADDRESS 0xd00061ac BIT_MASK 0x1 /end MEASUREMENT
/begin MEASUREMENT laco[0].laco_struct_fctdgfsd0.lv_lam_lim_lam_ad "Request for forced lambda adaptation" UBYTE _CNV_S_2_RANGE__0___1_CM 1 100. 0. 1. DISPLAY_IDENTIFIER LV_LAM_LIM_LAM_AD[1] ECU_ADDRESS 0xd00061ad BIT_MASK 0x1 /end MEASUREMENT
/begin MEASUREMENT laco[0].laco_struct_fctdgfsdi0.lv_inh_diag_fsd "Inhibition flag for fuel system diagnosis" UBYTE _CNV_S_2_RANGE__0___1_CM 1 100. 0. 1. DISPLAY_IDENTIFIER LV_INH_DIAG_FSD[1] ECU_ADDRESS 0xd00061b0 BIT_MASK 0x1 /end MEASUREMENT
/begin MEASUREMENT laco[0].laco_struct_fctdgfsdi0.lv_inh_diag_fsd_cp "Inhibition flag for fuel system diagnosis due to internal states of canister purge function" UBYTE _CNV_S_2_RANGE__0___1_CM 1 100. 0. 1. DISPLAY_IDENTIFIER LV_INH_DIAG_FSD_CP[1] ECU_ADDRESS 0xd00061b1 BIT_MASK 0x1 /end MEASUREMENT
/begin MEASUREMENT laco[0].laco_struct_fctdgfsdi0.lv_fac_l_rng_lim_min_fsd "Flag indicating minimum limitation of lambda adaptation used by fuel system diagnosis" UBYTE _CNV_S_2_RANGE__0___1_CM 1 100. 0. 1. DISPLAY_IDENTIFIER LV_FAC_L_RNG_LIM_MIN_FSD[1] ECU_ADDRESS 0xd00061b2 BIT_MASK 0x1 /end MEASUREMENT
/begin MEASUREMENT laco[0].laco_struct_fctdgfsdi0.lv_fac_l_rng_lim_max_fsd "Flag indicating maximum limitation of lambda adaptation used by fuel system diagnosis" UBYTE _CNV_S_2_RANGE__0___1_CM 1 100. 0. 1. DISPLAY_IDENTIFIER LV_FAC_L_RNG_LIM_MAX_FSD[1] ECU_ADDRESS 0xd00061b3 BIT_MASK 0x1 /end MEASUREMENT
/begin MEASUREMENT laco[1].laco_struct_reqgncdn0.crk_dif_soi_lsl_pos "crank shaft angle difference between the start of injection and the end of the exhaust cycle" UWORD _CNV_A_R_LINEAR_____112_CM 1 100. 0. 1620. DISPLAY_IDENTIFIER CRK_DIF_SOI_LSL_POS[2] ECU_ADDRESS 0xd0006300 FORMAT "%6.1" /end MEASUREMENT
/begin MEASUREMENT laco[1].laco_struct_reqgncdn0.maf_int_lam_reac "air mass flow for lambda controller reactivation after stop mode" UWORD _CNV_A_R_LINEAR_____287_CM 1 100. 0. 1820.41666666667 DISPLAY_IDENTIFIER MAF_INT_LAM_REAC[2] ECU_ADDRESS 0xd0006302 FORMAT "%7.2" /end MEASUREMENT
/begin MEASUREMENT laco[1].laco_struct_reqgncdn0.t_lam_reac "time counter for lambda controller reactivation after stop mode " UBYTE _CNV_A_R_LINEAR_____110_CM 1 100. 0. 5.1 DISPLAY_IDENTIFIER T_LAM_REAC[2] ECU_ADDRESS 0xd0006304 FORMAT "%4.2" /end MEASUREMENT
/begin MEASUREMENT laco[1].laco_struct_reqgncdn0.lv_lam_stop "activation signal for the lambda controller stop mode" UBYTE _CNV_S_2_RANGE__0___1_CM 1 100. 0. 1. DISPLAY_IDENTIFIER LV_LAM_STOP[2] ECU_ADDRESS 0xd0006305 BIT_MASK 0x1 /end MEASUREMENT
/begin MEASUREMENT laco[1].laco_struct_reqgncdn0.lv_lam_stop_sho_per "activation signal for the controller stop mode while active offset adjustment" UBYTE _CNV_S_2_RANGE__0___1_CM 1 100. 0. 1. DISPLAY_IDENTIFIER LV_LAM_STOP_SHO_PER[2] ECU_ADDRESS 0xd0006306 BIT_MASK 0x1 /end MEASUREMENT
/begin MEASUREMENT laco[1].laco_struct_reqgncdn0.lv_lam_act_dc "closed loop had been enabled for at least one time" UBYTE _CNV_S_2_RANGE__0___1_CM 1 100. 0. 1. DISPLAY_IDENTIFIER LV_LAM_ACT_DC[2] ECU_ADDRESS 0xd0006307 BIT_MASK 0x1 /end MEASUREMENT
/begin MEASUREMENT laco[1].laco_struct_reqgncdn0.state_ls "Fuel system status" UBYTE _CNV_S_5_LACO_RANGE_375_CM 1 100. 1. 16. DISPLAY_IDENTIFIER STATE_LS[2] ECU_ADDRESS 0xd0006308 /end MEASUREMENT
/begin MEASUREMENT laco[1].laco_struct_reqgntrcdn0.maf_int_lam_adj_cdn "air mass flow integral for condition detection of WRAF sensor characterisitc line adaptation" UWORD _CNV_A_R_LINEAR_____287_CM 1 100. 0. 1820.41666666667 DISPLAY_IDENTIFIER MAF_INT_LAM_ADJ_CDN[2] ECU_ADDRESS 0xd000630c FORMAT "%7.2" /end MEASUREMENT
/begin MEASUREMENT laco[1].laco_struct_reqgntrcdn0.lv_lam_adj_ad_cdn_ok "flag indicating good conditions for WRAF sensor characteristic line adaptation" UBYTE _CNV_S_2_RANGE__0___1_CM 1 100. 0. 1. DISPLAY_IDENTIFIER LV_LAM_ADJ_AD_CDN_OK[2] ECU_ADDRESS 0xd000630e BIT_MASK 0x1 /end MEASUREMENT
/begin MEASUREMENT laco[1].laco_struct_reqgntrimad0.lamb_delta_dif_i_lam_adj_ad "trim controI I share shift in case of new adaptation value for WRAF sensor characteristic line shift" SWORD _CNV_A_R_LINEAR_____24_CM 1 100. -0.125 0.125 DISPLAY_IDENTIFIER LAMB_DELTA_DIF_I_LAM_ADJ_AD[2] ECU_ADDRESS 0xd0006310 FORMAT "%8.5" /end MEASUREMENT
/begin MEASUREMENT laco[1].laco_struct_reqgntrimad0.lamb_delta_sum_lam_adj_ad "total characteristic line shift of WRAF sensor" SWORD _CNV_A_R_LINEAR_____24_CM 1 100. -0.125 0.125 DISPLAY_IDENTIFIER LAMB_DELTA_SUM_LAM_ADJ_AD[2] ECU_ADDRESS 0xd0006312 FORMAT "%8.5" /end MEASUREMENT
/begin MEASUREMENT laco[1].laco_struct_reqgntrimad0.lamb_delta_ad_lam_adj "adaptation value for WRAF sensor characteritic line shift" SWORD _CNV_A_R_LINEAR_____24_CM 1 100. -0.125 0.125 DISPLAY_IDENTIFIER LAMB_DELTA_AD_LAM_ADJ[2] ECU_ADDRESS 0xd0006314 FORMAT "%8.5" /end MEASUREMENT
/begin MEASUREMENT laco[1].laco_struct_reqgntrimad0.lamb_delta_bas_lam_adj_ad "basic characteristic line shift of WRAF sensor" SWORD _CNV_A_R_LINEAR_____24_CM 1 100. -0.125 0.125 DISPLAY_IDENTIFIER LAMB_DELTA_BAS_LAM_ADJ_AD[2] ECU_ADDRESS 0xd0006316 FORMAT "%8.5" /end MEASUREMENT
/begin MEASUREMENT laco[1].laco_struct_reqgntrimad0.ctr_raf_chg_lam_adj "counter for lean <-> rich air fuel ratio changes" UBYTE _CNV_A_R_LINEAR_____0_CM 1 100. 0. 255. DISPLAY_IDENTIFIER CTR_RAF_CHG_LAM_ADJ[2] ECU_ADDRESS 0xd0006318 FORMAT "%3.0" /end MEASUREMENT
/begin MEASUREMENT laco[1].laco_struct_reqgntrimad0.lv_lam_adj_ad_req "request for trim control I share shift due to new adaptation value learning" UBYTE _CNV_S_2_RANGE__0___1_CM 1 100. 0. 1. DISPLAY_IDENTIFIER LV_LAM_ADJ_AD_REQ[2] ECU_ADDRESS 0xd0006319 BIT_MASK 0x1 /end MEASUREMENT
/begin MEASUREMENT laco[1].laco_struct_ispcladaw0.fac_lam_tco_min "Lambda controller output at TCO_MIN_LAM_AD_WUP" SWORD _CNV_A_R_LINEAR_____113_CM 1 100. -50. 49.9984741210938 DISPLAY_IDENTIFIER FAC_LAM_TCO_MIN[2] ECU_ADDRESS 0xd000631c FORMAT "%7.3" /end MEASUREMENT
/begin MEASUREMENT laco[1].laco_struct_ispcladaw0.fac_lam_ad_wup "Fuel mass set point factor of lambda adaptation in warm up phase" SWORD _CNV_A_R_LINEAR_____113_CM 1 100. -50. 49.9984741210938 DISPLAY_IDENTIFIER FAC_LAM_AD_WUP[2] ECU_ADDRESS 0xd000631e FORMAT "%7.3" /end MEASUREMENT
/begin MEASUREMENT laco[1].laco_struct_ispcladaw0.fac_lam_adj_lam_ad_wup "Output value from lambda adaptation in warm up phase for the lambda controller shift" SWORD _CNV_A_R_LINEAR_____113_CM 1 100. -50. 49.9984741210938 DISPLAY_IDENTIFIER FAC_LAM_ADJ_LAM_AD_WUP[2] ECU_ADDRESS 0xd0006320 FORMAT "%7.3" /end MEASUREMENT
/begin MEASUREMENT laco[1].laco_struct_ispcladaw0.fac_lam_dif_lam_ad_wup_mv "Average value of Lambda controller output for Lambda adaptation in warm up phase" SWORD _CNV_A_R_LINEAR_____113_CM 1 100. -50. 49.9984741210938 DISPLAY_IDENTIFIER FAC_LAM_DIF_LAM_AD_WUP_MV[2] ECU_ADDRESS 0xd0006322 FORMAT "%7.3" /end MEASUREMENT
/begin MEASUREMENT laco[1].laco_struct_ispcladaw0.fac_lam_tco_a "Lambda controller output at C_TCO_A_LAM_AD_WUP" SWORD _CNV_A_R_LINEAR_____113_CM 1 100. -50. 49.9984741210938 DISPLAY_IDENTIFIER FAC_LAM_TCO_A[2] ECU_ADDRESS 0xd0006324 FORMAT "%7.3" /end MEASUREMENT
/begin MEASUREMENT laco[1].laco_struct_ispcladaw0.fac_lam_tco_b "Lambda controller output at C_TCO_B_LAM_AD_WUP" SWORD _CNV_A_R_LINEAR_____113_CM 1 100. -50. 49.9984741210938 DISPLAY_IDENTIFIER FAC_LAM_TCO_B[2] ECU_ADDRESS 0xd0006326 FORMAT "%7.3" /end MEASUREMENT
/begin MEASUREMENT laco[1].laco_struct_ispcladaw0.fac_lam_tco_c "Lambda controller output at C_TCO_C_LAM_AD_WUP" SWORD _CNV_A_R_LINEAR_____113_CM 1 100. -50. 49.9984741210938 DISPLAY_IDENTIFIER FAC_LAM_TCO_C[2] ECU_ADDRESS 0xd0006328 FORMAT "%7.3" /end MEASUREMENT
/begin MEASUREMENT laco[1].laco_struct_ispcladaw0.fac_lam_tco_d "Lambda controller output at C_TCO_D_LAM_AD_WUP" SWORD _CNV_A_R_LINEAR_____113_CM 1 100. -50. 49.9984741210938 DISPLAY_IDENTIFIER FAC_LAM_TCO_D[2] ECU_ADDRESS 0xd000632a FORMAT "%7.3" /end MEASUREMENT
/begin MEASUREMENT laco[1].laco_struct_ispcladaw0.fac_lam_tco_e "Lambda controller output at C_TCO_E_LAM_AD_WUP" SWORD _CNV_A_R_LINEAR_____113_CM 1 100. -50. 49.9984741210938 DISPLAY_IDENTIFIER FAC_LAM_TCO_E[2] ECU_ADDRESS 0xd000632c FORMAT "%7.3" /end MEASUREMENT
/begin MEASUREMENT laco[1].laco_struct_ispcladaw0.fac_lam_ad_wup_shift "shift value of lambda adaptation in warm up phase after 1st learning" SWORD _CNV_A_R_LINEAR_____113_CM 1 100. -50. 49.9984741210938 DISPLAY_IDENTIFIER FAC_LAM_AD_WUP_SHIFT[2] ECU_ADDRESS 0xd000632e FORMAT "%7.3" /end MEASUREMENT
/begin MEASUREMENT laco[1].laco_struct_ispcladaw0.fac_beg_l_rng_lam_ad "Lambda adaptation value in low range after reset and after auto shift" SWORD _CNV_A_R_LINEAR_____113_CM 1 100. -50. 49.9984741210938 DISPLAY_IDENTIFIER FAC_BEG_L_RNG_LAM_AD[2] ECU_ADDRESS 0xd0006330 FORMAT "%7.3" /end MEASUREMENT
/begin MEASUREMENT laco[1].laco_struct_ispcladaw0.fac_lam_add_chg_fq_det "additive shift of adaptation values if change in fuel quality is detected" SWORD _CNV_A_R_LINEAR_____113_CM 1 100. -50. 49.9984741210938 DISPLAY_IDENTIFIER FAC_LAM_ADD_CHG_FQ_DET[2] ECU_ADDRESS 0xd0006332 FORMAT "%7.3" /end MEASUREMENT
/begin MEASUREMENT laco[1].laco_struct_ispcladaw0.t_lam_ad_wup_ldc "timer to have valid limited dynamic phase for Lambda adaptation in warm up phase (partial load)" UWORD _CNV_A_R_LINEAR_____4_CM 1 100. 0. 6553.5 DISPLAY_IDENTIFIER T_LAM_AD_WUP_LDC[2] ECU_ADDRESS 0xd0006334 FORMAT "%6.1" /end MEASUREMENT
/begin MEASUREMENT laco[1].laco_struct_ispcladaw0.t_lam_ad_wup_tra_pha "timer indicating transient phase of Lambda adaptation in warm up phase" UWORD _CNV_A_R_LINEAR_____4_CM 1 100. 0. 6553.5 DISPLAY_IDENTIFIER T_LAM_AD_WUP_TRA_PHA[2] ECU_ADDRESS 0xd0006336 FORMAT "%6.1" /end MEASUREMENT
/begin MEASUREMENT laco[1].laco_struct_ispcladaw0.tco_min_lam_ad_wup "minimum TCO of all driving cycles where learning conditions for Lambda adaptation in warm up phase (partial load) are fulfilled" UBYTE _CNV_A_R_LINEAR_____17_CM 1 100. -48. 142.5 DISPLAY_IDENTIFIER TCO_MIN_LAM_AD_WUP[2] ECU_ADDRESS 0xd0006338 FORMAT "%6.2" /end MEASUREMENT
/begin MEASUREMENT laco[1].laco_struct_ispcladaw0.tco_min_inter_lam_ad_wup "Minimum TCO of current driving cycles where learning conditions for Lambda adaptation in warm up phase are fulfilled" UBYTE _CNV_A_R_LINEAR_____17_CM 1 100. -48. 142.5 DISPLAY_IDENTIFIER TCO_MIN_INTER_LAM_AD_WUP[2] ECU_ADDRESS 0xd0006339 FORMAT "%6.2" /end MEASUREMENT
/begin MEASUREMENT laco[1].laco_struct_ispcladaw0.tco_a_lam_ad_wup "actual coolant temperature in range around point A at which adaptation value was learnt" UBYTE _CNV_A_R_LINEAR_____17_CM 1 100. -48. 142.5 DISPLAY_IDENTIFIER TCO_A_LAM_AD_WUP[2] ECU_ADDRESS 0xd000633a FORMAT "%6.2" /end MEASUREMENT
/begin MEASUREMENT laco[1].laco_struct_ispcladaw0.tco_b_lam_ad_wup "actual coolant temperature in range around point B at which adaptation value was learnt" UBYTE _CNV_A_R_LINEAR_____17_CM 1 100. -48. 142.5 DISPLAY_IDENTIFIER TCO_B_LAM_AD_WUP[2] ECU_ADDRESS 0xd000633b FORMAT "%6.2" /end MEASUREMENT
/begin MEASUREMENT laco[1].laco_struct_ispcladaw0.tco_c_lam_ad_wup "actual coolant temperature in range around point C at which adaptation value was learnt" UBYTE _CNV_A_R_LINEAR_____17_CM 1 100. -48. 142.5 DISPLAY_IDENTIFIER TCO_C_LAM_AD_WUP[2] ECU_ADDRESS 0xd000633c FORMAT "%6.2" /end MEASUREMENT
/begin MEASUREMENT laco[1].laco_struct_ispcladaw0.tco_d_lam_ad_wup "actual coolant temperature in range around point D at which adaptation value was learnt" UBYTE _CNV_A_R_LINEAR_____17_CM 1 100. -48. 142.5 DISPLAY_IDENTIFIER TCO_D_LAM_AD_WUP[2] ECU_ADDRESS 0xd000633d FORMAT "%6.2" /end MEASUREMENT
/begin MEASUREMENT laco[1].laco_struct_ispcladaw0.tco_e_lam_ad_wup "actual coolant temperature in range around point E at which adaptation value was learnt" UBYTE _CNV_A_R_LINEAR_____17_CM 1 100. -48. 142.5 DISPLAY_IDENTIFIER TCO_E_LAM_AD_WUP[2] ECU_ADDRESS 0xd000633e FORMAT "%6.2" /end MEASUREMENT
/begin MEASUREMENT laco[1].laco_struct_ispcladaw0.ctr_tco_min_inter "Counter for detection of TCO_MIN_INTER_LAM_AD_WUP" UBYTE _CNV_A_R_LINEAR_____0_CM 1 100. 0. 255. DISPLAY_IDENTIFIER CTR_TCO_MIN_INTER[2] ECU_ADDRESS 0xd000633f FORMAT "%3.0" /end MEASUREMENT
/begin MEASUREMENT laco[1].laco_struct_ispcladaw0.crlc_fac_lam_tco_x "correlation factor for updating FAC_LAM_TCO_X" UBYTE _CNV_A_R_LINEAR_____103_CM 1 100. 0. 1.9921875 DISPLAY_IDENTIFIER CRLC_FAC_LAM_TCO_X[2] ECU_ADDRESS 0xd0006340 FORMAT "%8.6" /end MEASUREMENT
/begin MEASUREMENT laco[1].laco_struct_ispcladaw0.lv_tco_a_lam_ad_wup "Flag indicating that Lambda adaptation value in warm up phase at C_TCO_A_LAM_AD_WUP was updated" UBYTE _CNV_A_R_LINEAR_____0_CM 1 100. 0. 1. DISPLAY_IDENTIFIER LV_TCO_A_LAM_AD_WUP[2] ECU_ADDRESS 0xd0006341 FORMAT "%1.0" BIT_MASK 0x1 /end MEASUREMENT
/begin MEASUREMENT laco[1].laco_struct_ispcladaw0.lv_tco_b_lam_ad_wup "Flag indicating that Lambda adaptation value in warm up phase at C_TCO_B_LAM_AD_WUP was updated" UBYTE _CNV_A_R_LINEAR_____0_CM 1 100. 0. 1. DISPLAY_IDENTIFIER LV_TCO_B_LAM_AD_WUP[2] ECU_ADDRESS 0xd0006342 FORMAT "%1.0" BIT_MASK 0x1 /end MEASUREMENT
/begin MEASUREMENT laco[1].laco_struct_ispcladaw0.lv_tco_c_lam_ad_wup "Flag indicating that Lambda adaptation value in warm up phase at C_TCO_C_LAM_AD_WUP was updated" UBYTE _CNV_A_R_LINEAR_____0_CM 1 100. 0. 1. DISPLAY_IDENTIFIER LV_TCO_C_LAM_AD_WUP[2] ECU_ADDRESS 0xd0006343 FORMAT "%1.0" BIT_MASK 0x1 /end MEASUREMENT
/begin MEASUREMENT laco[1].laco_struct_ispcladaw0.lv_tco_d_lam_ad_wup "Flag indicating that Lambda adaptation value in warm up phase at C_TCO_D_LAM_AD_WUP was updated" UBYTE _CNV_A_R_LINEAR_____0_CM 1 100. 0. 1. DISPLAY_IDENTIFIER LV_TCO_D_LAM_AD_WUP[2] ECU_ADDRESS 0xd0006344 FORMAT "%1.0" BIT_MASK 0x1 /end MEASUREMENT
/begin MEASUREMENT laco[1].laco_struct_ispcladaw0.lv_tco_e_lam_ad_wup "Flag indicating that Lambda adaptation value in warm up phase at C_TCO_E_LAM_AD_WUP was updated" UBYTE _CNV_A_R_LINEAR_____0_CM 1 100. 0. 1. DISPLAY_IDENTIFIER LV_TCO_E_LAM_AD_WUP[2] ECU_ADDRESS 0xd0006345 FORMAT "%1.0" BIT_MASK 0x1 /end MEASUREMENT
/begin MEASUREMENT laco[1].laco_struct_ispcladaw0.lv_tco_min_lam_ad_wup "Flag indicating that Lambda adaptation value in warm up phase at TCO_MIN_LAM_AD_WUP was updated" UBYTE _CNV_S_2_RANGE__0___1_CM 1 100. 0. 1. DISPLAY_IDENTIFIER LV_TCO_MIN_LAM_AD_WUP[2] ECU_ADDRESS 0xd0006346 BIT_MASK 0x1 /end MEASUREMENT
/begin MEASUREMENT laco[1].laco_struct_ispcladaw0.lv_tco_min_inter_lam_ad_wup "Flag indicating that learning conditions for Lambda adaptation value in warm up phase are fulfilled" UBYTE _CNV_S_2_RANGE__0___1_CM 1 100. 0. 1. DISPLAY_IDENTIFIER LV_TCO_MIN_INTER_LAM_AD_WUP[2] ECU_ADDRESS 0xd0006347 BIT_MASK 0x1 /end MEASUREMENT
/begin MEASUREMENT laco[1].laco_struct_ispcladaw0.lv_fac_lam_adj_lam_ad_wup "Flag to request lambda controller shift from Lambda adaptation in warm up phase" UBYTE _CNV_S_2_RANGE__0___1_CM 1 100. 0. 1. DISPLAY_IDENTIFIER LV_FAC_LAM_ADJ_LAM_AD_WUP[2] ECU_ADDRESS 0xd0006348 BIT_MASK 0x1 /end MEASUREMENT
/begin MEASUREMENT laco[1].laco_struct_ispcladaw0.lv_lam_ad_wup_stop "Logical variable indicating need of Lambda controller shift to mirror shift in Lambda adaptation in warm up phase" UBYTE _CNV_S_2_RANGE__0___1_CM 1 100. 0. 1. DISPLAY_IDENTIFIER LV_LAM_AD_WUP_STOP[2] ECU_ADDRESS 0xd0006349 BIT_MASK 0x1 /end MEASUREMENT
/begin MEASUREMENT laco[1].laco_struct_ispcladaw0.lv_load_vld "flag indicating that conditions for valid learning are fulfilled" UBYTE _CNV_S_2_RANGE__0___1_CM 1 100. 0. 1. DISPLAY_IDENTIFIER LV_LOAD_VLD[2] ECU_ADDRESS 0xd000634a BIT_MASK 0x1 /end MEASUREMENT
/begin MEASUREMENT laco[1].laco_struct_ispcladaw0.lv_ctr_max_tco_min_inter "flag indicating that counter based criteria for transient phase has expired" UBYTE _CNV_S_2_RANGE__0___1_CM 1 100. 0. 1. DISPLAY_IDENTIFIER LV_CTR_MAX_TCO_MIN_INTER[2] ECU_ADDRESS 0xd000634b BIT_MASK 0x1 /end MEASUREMENT
/begin MEASUREMENT laco[1].laco_struct_ispcladaw0.lv_t_max_lam_ad_wup_tra_pha "flag indicating that time dependent criteria for transient phase has expired" UBYTE _CNV_S_2_RANGE__0___1_CM 1 100. 0. 1. DISPLAY_IDENTIFIER LV_T_MAX_LAM_AD_WUP_TRA_PHA[2] ECU_ADDRESS 0xd000634c BIT_MASK 0x1 /end MEASUREMENT
/begin MEASUREMENT laco[1].laco_struct_ispcladaw0.lv_lam_ad_wup_chg_fq_det "flag indicating that change in fuel quality was detected in this driving cycle" UBYTE _CNV_S_2_RANGE__0___1_CM 1 100. 0. 1. DISPLAY_IDENTIFIER LV_LAM_AD_WUP_CHG_FQ_DET[2] ECU_ADDRESS 0xd000634d BIT_MASK 0x1 /end MEASUREMENT
/begin MEASUREMENT laco[1].laco_struct_fctdgfsda0.lv_fsd_act "Global activation flag for fuel system diagnosis" UBYTE _CNV_S_2_RANGE__0___1_CM 1 100. 0. 1. DISPLAY_IDENTIFIER LV_FSD_ACT[2] ECU_ADDRESS 0xd0006350 BIT_MASK 0x1 /end MEASUREMENT
/begin MEASUREMENT laco[1].laco_struct_fctdgfsd0.t_sum_end_diag_win_fsd_add "Counter for the diagnosis window - additive adaptation learning area" UWORD _CNV_A_R_LINEAR_____110_CM 1 100. 0. 1310.7 DISPLAY_IDENTIFIER T_SUM_END_DIAG_WIN_FSD_ADD[2] ECU_ADDRESS 0xd0006354 FORMAT "%7.2" /end MEASUREMENT
/begin MEASUREMENT laco[1].laco_struct_fctdgfsd0.t_lam_ad_act_fsd "Timer indicating the forced lambda adaptation is running" UWORD _CNV_A_R_LINEAR_____110_CM 1 100. 0. 1310.7 DISPLAY_IDENTIFIER T_LAM_AD_ACT_FSD[2] ECU_ADDRESS 0xd0006356 FORMAT "%7.2" /end MEASUREMENT
/begin MEASUREMENT laco[1].laco_struct_fctdgfsd0.t_lam_lim_lam_ad_req "Timer for forced lambda adaptation" UWORD _CNV_A_R_LINEAR_____110_CM 1 100. 0. 1310.7 DISPLAY_IDENTIFIER T_LAM_LIM_LAM_AD_REQ[2] ECU_ADDRESS 0xd0006358 FORMAT "%7.2" /end MEASUREMENT
/begin MEASUREMENT laco[1].laco_struct_fctdgfsd0.t_sum_end_diag_win_fsd "Counter for the diagnosis window - relevant to MIL" UWORD _CNV_A_R_LINEAR_____110_CM 1 100. 0. 1310.7 DISPLAY_IDENTIFIER T_SUM_END_DIAG_WIN_FSD[2] ECU_ADDRESS 0xd000635a FORMAT "%7.2" /end MEASUREMENT
/begin MEASUREMENT laco[1].laco_struct_fctdgfsd0.t_sum_end_diag_win_fsd_h_rng "Counter for the diagnosis window - upper multiplicative adaptation learning area" UWORD _CNV_A_R_LINEAR_____110_CM 1 100. 0. 1310.7 DISPLAY_IDENTIFIER T_SUM_END_DIAG_WIN_FSD_H_RNG[2] ECU_ADDRESS 0xd000635c FORMAT "%7.2" /end MEASUREMENT
/begin MEASUREMENT laco[1].laco_struct_fctdgfsd0.t_sum_end_diag_win_fsd_lam "Counter for the diagnosis window - lambda control in dead stop" UWORD _CNV_A_R_LINEAR_____110_CM 1 100. 0. 1310.7 DISPLAY_IDENTIFIER T_SUM_END_DIAG_WIN_FSD_LAM[2] ECU_ADDRESS 0xd000635e FORMAT "%7.2" /end MEASUREMENT
/begin MEASUREMENT laco[1].laco_struct_fctdgfsd0.t_sum_max_fsd "Total duration of LV_MFF_ADD_LIM_MAX_LAM_AD[i] = 1 or LV_FAC_L_RNG_LIM_MAX_LAM_AD[i] = 1" UWORD _CNV_A_R_LINEAR_____110_CM 1 100. 0. 1310.7 DISPLAY_IDENTIFIER T_SUM_MAX_FSD[2] ECU_ADDRESS 0xd0006360 FORMAT "%7.2" /end MEASUREMENT
/begin MEASUREMENT laco[1].laco_struct_fctdgfsd0.t_sum_max_fsd_h_rng "Total duration of LV_FAC_H_RNG_LIM_MAX_LAM_AD[i] = 1" UWORD _CNV_A_R_LINEAR_____110_CM 1 100. 0. 1310.7 DISPLAY_IDENTIFIER T_SUM_MAX_FSD_H_RNG[2] ECU_ADDRESS 0xd0006362 FORMAT "%7.2" /end MEASUREMENT
/begin MEASUREMENT laco[1].laco_struct_fctdgfsd0.t_sum_max_fsd_lam_lim "Total duration of LV_FAC_LAM_LIM_MAX[i] = 1" UWORD _CNV_A_R_LINEAR_____110_CM 1 100. 0. 1310.7 DISPLAY_IDENTIFIER T_SUM_MAX_FSD_LAM_LIM[2] ECU_ADDRESS 0xd0006364 FORMAT "%7.2" /end MEASUREMENT
/begin MEASUREMENT laco[1].laco_struct_fctdgfsd0.t_sum_min_fsd "Total duration of LV_MFF_ADD_LIM_MIN_LAM_AD[i] = 1 or LV_FAC_L_RNG_LIM_MIN_LAM_AD[i] = 1" UWORD _CNV_A_R_LINEAR_____110_CM 1 100. 0. 1310.7 DISPLAY_IDENTIFIER T_SUM_MIN_FSD[2] ECU_ADDRESS 0xd0006366 FORMAT "%7.2" /end MEASUREMENT
/begin MEASUREMENT laco[1].laco_struct_fctdgfsd0.t_sum_min_fsd_h_rng "Total duration of LV_FAC_H_RNG_LIM_MIN_LAM_AD[i] = 1" UWORD _CNV_A_R_LINEAR_____110_CM 1 100. 0. 1310.7 DISPLAY_IDENTIFIER T_SUM_MIN_FSD_H_RNG[2] ECU_ADDRESS 0xd0006368 FORMAT "%7.2" /end MEASUREMENT
/begin MEASUREMENT laco[1].laco_struct_fctdgfsd0.t_sum_min_fsd_lam_lim "Total duration of LV_FAC_LAM_LIM_MIN[i] = 1" UWORD _CNV_A_R_LINEAR_____110_CM 1 100. 0. 1310.7 DISPLAY_IDENTIFIER T_SUM_MIN_FSD_LAM_LIM[2] ECU_ADDRESS 0xd000636a FORMAT "%7.2" /end MEASUREMENT
/begin MEASUREMENT laco[1].laco_struct_fctdgfsd0.t_sum_rst_fsd "Timer to reset the counter of total duration in MIL - area" UWORD _CNV_A_R_LINEAR_____110_CM 1 100. 0. 1310.7 DISPLAY_IDENTIFIER T_SUM_RST_FSD[2] ECU_ADDRESS 0xd000636c FORMAT "%7.2" /end MEASUREMENT
/begin MEASUREMENT laco[1].laco_struct_fctdgfsd0.t_sum_rst_fsd_h_rng "Timer to reset the counter of total duration in H_RNG - area" UWORD _CNV_A_R_LINEAR_____110_CM 1 100. 0. 1310.7 DISPLAY_IDENTIFIER T_SUM_RST_FSD_H_RNG[2] ECU_ADDRESS 0xd000636e FORMAT "%7.2" /end MEASUREMENT
/begin MEASUREMENT laco[1].laco_struct_fctdgfsd0.t_sum_rst_fsd_lam_lim "Timer to reset the counter of total duration for lambda control in dead stop" UWORD _CNV_A_R_LINEAR_____110_CM 1 100. 0. 1310.7 DISPLAY_IDENTIFIER T_SUM_RST_FSD_LAM_LIM[2] ECU_ADDRESS 0xd0006370 FORMAT "%7.2" /end MEASUREMENT
/begin MEASUREMENT laco[1].laco_struct_fctdgfsd0.t_sum_end_diag_win_fsd_fac_l "Counter for the diagnosis window - lower multiplicative adaptation learning area" UWORD _CNV_A_R_LINEAR_____110_CM 1 100. 0. 1310.7 DISPLAY_IDENTIFIER T_SUM_END_DIAG_WIN_FSD_FAC_L[2] ECU_ADDRESS 0xd0006372 FORMAT "%7.2" /end MEASUREMENT
/begin MEASUREMENT laco[1].laco_struct_fctdgfsd0.lv_err_fsd "Failure of lambda adaptation monitoring - relevant to malfunction indication light" UBYTE _CNV_S_2_RANGE__0___1_CM 1 100. 0. 1. DISPLAY_IDENTIFIER LV_ERR_FSD[2] ECU_ADDRESS 0xd0006374 BIT_MASK 0x1 /end MEASUREMENT
/begin MEASUREMENT laco[1].laco_struct_fctdgfsd0.lv_err_fsd_lam_lim "Failure for lambda controller in dead stop - relevant to malfunction indication light" UBYTE _CNV_S_2_RANGE__0___1_CM 1 100. 0. 1. DISPLAY_IDENTIFIER LV_ERR_FSD_LAM_LIM[2] ECU_ADDRESS 0xd0006375 BIT_MASK 0x1 /end MEASUREMENT
/begin MEASUREMENT laco[1].laco_struct_fctdgfsd0.lv_err_fsd_h_rng "Failure in upper multiplicative adaptation learning area" UBYTE _CNV_S_2_RANGE__0___1_CM 1 100. 0. 1. DISPLAY_IDENTIFIER LV_ERR_FSD_H_RNG[2] ECU_ADDRESS 0xd0006376 BIT_MASK 0x1 /end MEASUREMENT
/begin MEASUREMENT laco[1].laco_struct_fctdgfsd0.lv_end_diag_win_fsd "End of diagnosis cycle for similar conditions window in additive adaptation learning area" UBYTE _CNV_S_2_RANGE__0___1_CM 1 100. 0. 1. DISPLAY_IDENTIFIER LV_END_DIAG_WIN_FSD[2] ECU_ADDRESS 0xd0006377 BIT_MASK 0x1 /end MEASUREMENT
/begin MEASUREMENT laco[1].laco_struct_fctdgfsd0.lv_end_diag_win_fsd_lam_lim "End of diagnosis cycle for similar conditions window in case of lambda control in dead stop" UBYTE _CNV_S_2_RANGE__0___1_CM 1 100. 0. 1. DISPLAY_IDENTIFIER LV_END_DIAG_WIN_FSD_LAM_LIM[2] ECU_ADDRESS 0xd0006378 BIT_MASK 0x1 /end MEASUREMENT
/begin MEASUREMENT laco[1].laco_struct_fctdgfsd0.lv_lam_lim_lam_ad "Request for forced lambda adaptation" UBYTE _CNV_S_2_RANGE__0___1_CM 1 100. 0. 1. DISPLAY_IDENTIFIER LV_LAM_LIM_LAM_AD[2] ECU_ADDRESS 0xd0006379 BIT_MASK 0x1 /end MEASUREMENT
/begin MEASUREMENT laco[1].laco_struct_fctdgfsdi0.lv_inh_diag_fsd "Inhibition flag for fuel system diagnosis" UBYTE _CNV_S_2_RANGE__0___1_CM 1 100. 0. 1. DISPLAY_IDENTIFIER LV_INH_DIAG_FSD[2] ECU_ADDRESS 0xd000637c BIT_MASK 0x1 /end MEASUREMENT
/begin MEASUREMENT laco[1].laco_struct_fctdgfsdi0.lv_inh_diag_fsd_cp "Inhibition flag for fuel system diagnosis due to internal states of canister purge function" UBYTE _CNV_S_2_RANGE__0___1_CM 1 100. 0. 1. DISPLAY_IDENTIFIER LV_INH_DIAG_FSD_CP[2] ECU_ADDRESS 0xd000637d BIT_MASK 0x1 /end MEASUREMENT
/begin MEASUREMENT laco[1].laco_struct_fctdgfsdi0.lv_fac_l_rng_lim_min_fsd "Flag indicating minimum limitation of lambda adaptation used by fuel system diagnosis" UBYTE _CNV_S_2_RANGE__0___1_CM 1 100. 0. 1. DISPLAY_IDENTIFIER LV_FAC_L_RNG_LIM_MIN_FSD[2] ECU_ADDRESS 0xd000637e BIT_MASK 0x1 /end MEASUREMENT
/begin MEASUREMENT laco[1].laco_struct_fctdgfsdi0.lv_fac_l_rng_lim_max_fsd "Flag indicating maximum limitation of lambda adaptation used by fuel system diagnosis" UBYTE _CNV_S_2_RANGE__0___1_CM 1 100. 0. 1. DISPLAY_IDENTIFIER LV_FAC_L_RNG_LIM_MAX_FSD[2] ECU_ADDRESS 0xd000637f BIT_MASK 0x1 /end MEASUREMENT
/begin MEASUREMENT lv_lam_not_stat_cdn "flag for stop mode activation of lambda controller by wall film" UBYTE _CNV_S_2_RANGE__0___1_CM 1 100. 0. 1. DISPLAY_IDENTIFIER LV_LAM_NOT_STAT_CDN ECU_ADDRESS 0xd000768e BIT_MASK 0x1 /end MEASUREMENT
/begin MEASUREMENT t_lam_not_stat_cdn "time counter for lambda controller reactivation after wall film" UWORD _CNV_A_R_LINEAR_____110_CM 1 100. 0. 1310.7 DISPLAY_IDENTIFIER T_LAM_NOT_STAT_CDN ECU_ADDRESS 0xd00034fe FORMAT "%7.2" /end MEASUREMENT
/begin CHARACTERISTIC c_maf_int_min_lam_reac "threshold for the air mass flow integral for reactivation of the lambda controller" VALUE 0xa0806c86 _REC_VAL_20_u2 1820.41666666667 _CNV_A_R_LINEAR_____287_CM 0. 1820.41666666667 DISPLAY_IDENTIFIER C_MAF_INT_MIN_LAM_REAC FORMAT "%7.2" /end CHARACTERISTIC
/begin CHARACTERISTIC ip_t_lam_not_stat_cdn "time threshold to reactivate the lambda controller after wall film" CURVE 0xa0806b94 _REC_CUR_20_u2_u1 1310.7 _CNV_A_R_LINEAR_____110_CM 0. 1310.7 DISPLAY_IDENTIFIER IP_T_LAM_NOT_STAT_CDN FORMAT "%7.2"
 /begin AXIS_DESCR COM_AXIS tco _CNV_A_R_LINEAR_____17_CM 6 -48. 142.5 FORMAT "%6.2" AXIS_PTS_REF ldpm_tco_1_laco /end AXIS_DESCR
/end CHARACTERISTIC
/begin CHARACTERISTIC c_t_min_lam_reac "time delay for lambda controller reactivation after stop mode" VALUE 0xa0806cc2 _REC_VAL_20_u1 5.1 _CNV_A_R_LINEAR_____110_CM 0. 5.1 DISPLAY_IDENTIFIER C_T_MIN_LAM_REAC FORMAT "%4.2" /end CHARACTERISTIC
/begin CHARACTERISTIC ip_fac_neut_max_not_stat_cdn "maximum threshold for detection of non stationary conditions for lambda controller" CURVE 0xa0806a68 _REC_CUR_20_u2_u1 1.999969482421875 _CNV_A_R_LACO_LINEA_376_CM -1. 0.999969482421875 DISPLAY_IDENTIFIER IP_FAC_NEUT_MAX_NOT_STAT_CDN FORMAT "%8.5"
 /begin AXIS_DESCR COM_AXIS tco _CNV_A_R_LINEAR_____17_CM 6 -48. 142.5 FORMAT "%6.2" AXIS_PTS_REF ldpm_tco_1_laco /end AXIS_DESCR
/end CHARACTERISTIC
/begin CHARACTERISTIC ip_fac_neut_min_not_stat_cdn "minimum threshold for detection of non stationary conditions for lambda controller" CURVE 0xa0806a74 _REC_CUR_20_u2_u1 1.999969482421875 _CNV_A_R_LACO_LINEA_376_CM -1. 0.999969482421875 DISPLAY_IDENTIFIER IP_FAC_NEUT_MIN_NOT_STAT_CDN FORMAT "%8.5"
 /begin AXIS_DESCR COM_AXIS tco _CNV_A_R_LINEAR_____17_CM 6 -48. 142.5 FORMAT "%6.2" AXIS_PTS_REF ldpm_tco_1_laco /end AXIS_DESCR
/end CHARACTERISTIC
/begin CHARACTERISTIC c_maf_int_min_lam_reac_opt "Optional threshold for the air mass flow integral for reactivation of the lambda controller" VALUE 0xa0806c88 _REC_VAL_20_u2 1820.41666666667 _CNV_A_R_LINEAR_____287_CM 0. 1820.41666666667 DISPLAY_IDENTIFIER C_MAF_INT_MIN_LAM_REAC_OPT FORMAT "%7.2" /end CHARACTERISTIC
/begin CHARACTERISTIC c_crlc_lamb_delta_ad_lam_adj "correlation constant of trim control adaptation value calculation" VALUE 0xa0806bd8 _REC_VAL_20_u2 0.9999847412109381 _CNV_A_R_LINEAR_____89_CM 0. 0.9999847412109381 DISPLAY_IDENTIFIER C_CRLC_LAMB_DELTA_AD_LAM_ADJ FORMAT "%7.5" /end CHARACTERISTIC
/begin CHARACTERISTIC c_lamb_delta_max_lam_adj_ad "maximum value for WRAF sensor characteristic line shift offset" VALUE 0xa0806c36 _REC_VAL_20_s2 0.25 _CNV_A_R_LINEAR_____24_CM -0.125 0.125 DISPLAY_IDENTIFIER C_LAMB_DELTA_MAX_LAM_ADJ_AD FORMAT "%8.5" /end CHARACTERISTIC
/begin CHARACTERISTIC c_lamb_delta_min_lam_adj_ad "minimum value for WRAF sensor characteristic line shift offset" VALUE 0xa0806c38 _REC_VAL_20_s2 0.25 _CNV_A_R_LINEAR_____24_CM -0.125 0.125 DISPLAY_IDENTIFIER C_LAMB_DELTA_MIN_LAM_ADJ_AD FORMAT "%8.5" /end CHARACTERISTIC
/begin CHARACTERISTIC c_nr_raf_chg_wait_lam_adj "number of lean <-> rich air fuel ratio changes between two adpatation cycles" VALUE 0xa0806cb6 _REC_VAL_20_u1 254. _CNV_A_R_LINEAR_____0_CM 1. 255. DISPLAY_IDENTIFIER C_NR_RAF_CHG_WAIT_LAM_ADJ FORMAT "%3.0" /end CHARACTERISTIC
/begin CHARACTERISTIC c_lamb_delta_bas_lam_adj_is[0] "basic characteristic line shift of WRAF sensor in case of idle speed" VALUE 0xa0806c2c _REC_VAL_20_s2 0.25 _CNV_A_R_LINEAR_____24_CM -0.125 0.125 DISPLAY_IDENTIFIER C_LAMB_DELTA_BAS_LAM_ADJ_IS[1] FORMAT "%8.5" /end CHARACTERISTIC
/begin CHARACTERISTIC c_lamb_delta_bas_lam_adj_is[1] "basic characteristic line shift of WRAF sensor in case of idle speed" VALUE 0xa0806c2e _REC_VAL_20_s2 0.25 _CNV_A_R_LINEAR_____24_CM -0.125 0.125 DISPLAY_IDENTIFIER C_LAMB_DELTA_BAS_LAM_ADJ_IS[2] FORMAT "%8.5" /end CHARACTERISTIC
/begin AXIS_PTS ldp_maf_ip_lamb_delta_bas "" 0xa0806640 maf _REC_AXS_20_u2 1389. _CNV_A_R_LINEAR_____111_CM 8 0. 1389. FORMAT "%7.2" /end AXIS_PTS
/begin AXIS_PTS ldp_n_32_ip_lamb_delta_bas "" 0xa08066a8 n_32 _REC_AXS_20_u1 8160. _CNV_A_R_LINEAR_____10_CM 8 0. 8160. FORMAT "%4.0" /end AXIS_PTS
/begin CHARACTERISTIC ip_lamb_delta_bas_lam_adj[0] "basic characteric line shift of WRAF sensor" MAP 0xa0811e34 _REC_MAP_20_u2_u2_u1 0.25 _CNV_A_R_LACO_LINEA_378_CM -0.125 0.125 DISPLAY_IDENTIFIER IP_LAMB_DELTA_BAS_LAM_ADJ[1] FORMAT "%8.5"
 /begin AXIS_DESCR COM_AXIS maf _CNV_A_R_LINEAR_____111_CM 8 0. 1389. FORMAT "%7.2" AXIS_PTS_REF ldp_maf_ip_lamb_delta_bas /end AXIS_DESCR
 /begin AXIS_DESCR COM_AXIS n_32 _CNV_A_R_LINEAR_____10_CM 8 0. 8160. FORMAT "%4.0" AXIS_PTS_REF ldp_n_32_ip_lamb_delta_bas /end AXIS_DESCR
/end CHARACTERISTIC
/begin CHARACTERISTIC ip_lamb_delta_bas_lam_adj[1] "basic characteric line shift of WRAF sensor" MAP 0xa0811eb4 _REC_MAP_20_u2_u2_u1 0.25 _CNV_A_R_LACO_LINEA_378_CM -0.125 0.125 DISPLAY_IDENTIFIER IP_LAMB_DELTA_BAS_LAM_ADJ[2] FORMAT "%8.5"
 /begin AXIS_DESCR COM_AXIS maf _CNV_A_R_LINEAR_____111_CM 8 0. 1389. FORMAT "%7.2" AXIS_PTS_REF ldp_maf_ip_lamb_delta_bas /end AXIS_DESCR
 /begin AXIS_DESCR COM_AXIS n_32 _CNV_A_R_LINEAR_____10_CM 8 0. 8160. FORMAT "%4.0" AXIS_PTS_REF ldp_n_32_ip_lamb_delta_bas /end AXIS_DESCR
/end CHARACTERISTIC
/begin CHARACTERISTIC c_lamb_delta_dif_i_mmv_lam_adj "difference between I share and moving mean value to allow WRAF sensor characteristic line adaptation" VALUE 0xa0806c30 _REC_VAL_20_s2 0.25 _CNV_A_R_LINEAR_____24_CM -0.125 0.125 DISPLAY_IDENTIFIER C_LAMB_DELTA_DIF_I_MMV_LAM_ADJ FORMAT "%8.5" /end CHARACTERISTIC
/begin CHARACTERISTIC c_lamb_delta_p_max_lam_adj_cdn "maximum trim control P share for WRAF sensor characteristric line adaptation" VALUE 0xa0806c3a _REC_VAL_20_s2 0.25 _CNV_A_R_LINEAR_____24_CM -0.125 0.125 DISPLAY_IDENTIFIER C_LAMB_DELTA_P_MAX_LAM_ADJ_CDN FORMAT "%8.5" /end CHARACTERISTIC
/begin CHARACTERISTIC c_lamb_delta_p_min_lam_adj_cdn "minimum trim control P share for WRAF sensor characteristric line adaptation" VALUE 0xa0806c3c _REC_VAL_20_s2 0.25 _CNV_A_R_LINEAR_____24_CM -0.125 0.125 DISPLAY_IDENTIFIER C_LAMB_DELTA_P_MIN_LAM_ADJ_CDN FORMAT "%8.5" /end CHARACTERISTIC
/begin CHARACTERISTIC c_maf_int_thd_lam_adj_cdn "air mass flow integral threshold for stationary condition definition for WRAF sensor characteristic line adaptation" VALUE 0xa0806c8a _REC_VAL_20_u2 1820.41666666667 _CNV_A_R_LINEAR_____287_CM 0. 1820.41666666667 DISPLAY_IDENTIFIER C_MAF_INT_THD_LAM_ADJ_CDN FORMAT "%7.2" /end CHARACTERISTIC
/begin CHARACTERISTIC c_maf_max_lam_adj_cdn "maximum air mass flow threshold for WRAF sensor characteristic line adaptation" VALUE 0xa0806c92 _REC_VAL_20_u1 1389. _CNV_A_R_LINEAR_____15_CM 0. 1389. DISPLAY_IDENTIFIER C_MAF_MAX_LAM_ADJ_CDN FORMAT "%4.0" /end CHARACTERISTIC
/begin CHARACTERISTIC c_maf_min_lam_adj_cdn "minimum air mass flow threshold for WRAF sensor characteristic line adaptation" VALUE 0xa0806c96 _REC_VAL_20_u1 1389. _CNV_A_R_LINEAR_____15_CM 0. 1389. DISPLAY_IDENTIFIER C_MAF_MIN_LAM_ADJ_CDN FORMAT "%4.0" /end CHARACTERISTIC
/begin CHARACTERISTIC c_n_max_lam_adj_cdn "maximum engine speed threshold for WRAF sensor characteristic line adaptation" VALUE 0xa0806caa _REC_VAL_20_u1 8160. _CNV_A_R_LINEAR_____10_CM 0. 8160. DISPLAY_IDENTIFIER C_N_MAX_LAM_ADJ_CDN FORMAT "%4.0" /end CHARACTERISTIC
/begin CHARACTERISTIC c_n_min_lam_adj_cdn "minimum engine speed threshold for WRAF sensor characteristic line adaptation" VALUE 0xa0806cae _REC_VAL_20_u1 8160. _CNV_A_R_LINEAR_____10_CM 0. 8160. DISPLAY_IDENTIFIER C_N_MIN_LAM_ADJ_CDN FORMAT "%4.0" /end CHARACTERISTIC
/begin AXIS_PTS ldpm_n_32_2_enrd "" 0xa0801bf6 n_32 _REC_AXS_20_u1 8160. _CNV_A_R_LINEAR_____10_CM 6 0. 8160. FORMAT "%4.0" /end AXIS_PTS
/begin AXIS_PTS ldpm_n_32_3_enrd "" 0xa0801bfe n_32 _REC_AXS_20_u1 8160. _CNV_A_R_LINEAR_____10_CM 6 0. 8160. FORMAT "%4.0" /end AXIS_PTS
/begin AXIS_PTS ldpm_n_32_4_enrd "" 0xa0801c06 n_32 _REC_AXS_20_u1 8160. _CNV_A_R_LINEAR_____10_CM 6 0. 8160. FORMAT "%4.0" /end AXIS_PTS
/begin AXIS_PTS ldpm_n_32_5_enrd "" 0xa0801c0e n_32 _REC_AXS_20_u1 8160. _CNV_A_R_LINEAR_____10_CM 6 0. 8160. FORMAT "%4.0" /end AXIS_PTS
/begin MEASUREMENT delta_crk_dif_max_er "Limitation of adaptation range (mech. Tolerance)" UWORD _CNV_A_R_ENRD_LINEA_380_CM 1 100. 0. 1001.899 DISPLAY_IDENTIFIER DELTA_CRK_DIF_MAX_ER ECU_ADDRESS 0xd0002488 FORMAT "%8.3" /end MEASUREMENT
/begin MEASUREMENT seg_ad_raw_mmv_er[0] "ER Filtered adaptive values used for learning process monitoring (for each segment)" SWORD _CNV_A_R_ENRD_LINEA_381_CM 1 100. -7.8125 7.8123 DISPLAY_IDENTIFIER SEG_AD_RAW_MMV_ER[0] ECU_ADDRESS 0xd0002490 FORMAT "%7.4" /end MEASUREMENT
/begin MEASUREMENT seg_ad_raw_mmv_er[1] "ER Filtered adaptive values used for learning process monitoring (for each segment)" SWORD _CNV_A_R_ENRD_LINEA_381_CM 1 100. -7.8125 7.8123 DISPLAY_IDENTIFIER SEG_AD_RAW_MMV_ER[1] ECU_ADDRESS 0xd0002492 FORMAT "%7.4" /end MEASUREMENT
/begin MEASUREMENT seg_ad_raw_mmv_er[2] "ER Filtered adaptive values used for learning process monitoring (for each segment)" SWORD _CNV_A_R_ENRD_LINEA_381_CM 1 100. -7.8125 7.8123 DISPLAY_IDENTIFIER SEG_AD_RAW_MMV_ER[2] ECU_ADDRESS 0xd0002494 FORMAT "%7.4" /end MEASUREMENT
/begin MEASUREMENT seg_ad_raw_mmv_er[3] "ER Filtered adaptive values used for learning process monitoring (for each segment)" SWORD _CNV_A_R_ENRD_LINEA_381_CM 1 100. -7.8125 7.8123 DISPLAY_IDENTIFIER SEG_AD_RAW_MMV_ER[3] ECU_ADDRESS 0xd0002496 FORMAT "%7.4" /end MEASUREMENT
/begin MEASUREMENT seg_ad_raw_mmv_er[4] "ER Filtered adaptive values used for learning process monitoring (for each segment)" SWORD _CNV_A_R_ENRD_LINEA_381_CM 1 100. -7.8125 7.8123 DISPLAY_IDENTIFIER SEG_AD_RAW_MMV_ER[4] ECU_ADDRESS 0xd0002498 FORMAT "%7.4" /end MEASUREMENT
/begin MEASUREMENT seg_ad_raw_mmv_er[5] "ER Filtered adaptive values used for learning process monitoring (for each segment)" SWORD _CNV_A_R_ENRD_LINEA_381_CM 1 100. -7.8125 7.8123 DISPLAY_IDENTIFIER SEG_AD_RAW_MMV_ER[5] ECU_ADDRESS 0xd000249a FORMAT "%7.4" /end MEASUREMENT
/begin MEASUREMENT seg_ad_raw_mmv_er[6] "ER Filtered adaptive values used for learning process monitoring (for each segment)" SWORD _CNV_A_R_ENRD_LINEA_381_CM 1 100. -7.8125 7.8123 DISPLAY_IDENTIFIER SEG_AD_RAW_MMV_ER[6] ECU_ADDRESS 0xd000249c FORMAT "%7.4" /end MEASUREMENT
/begin MEASUREMENT seg_ad_raw_mmv_er[7] "ER Filtered adaptive values used for learning process monitoring (for each segment)" SWORD _CNV_A_R_ENRD_LINEA_381_CM 1 100. -7.8125 7.8123 DISPLAY_IDENTIFIER SEG_AD_RAW_MMV_ER[7] ECU_ADDRESS 0xd000249e FORMAT "%7.4" /end MEASUREMENT
/begin CHARACTERISTIC c_crk_dif_max_er "Limitation of adaptation range ( mechanical tolerance)" VALUE 0xa0801d1e _REC_VAL_20_u2 7.8125 _CNV_A_R_ENRD_LINEA_382_CM 0. 7.8125 DISPLAY_IDENTIFIER C_CRK_DIF_MAX_ER FORMAT "%6.4" /end CHARACTERISTIC
/begin CHARACTERISTIC c_seg_ad_max_er "Limitation of ER segment adaptation range ( mechanical tolerance)" VALUE 0xa0801d54 _REC_VAL_20_u2 7.8123 _CNV_A_R_ENRD_LINEA_383_CM 0. 7.8123 DISPLAY_IDENTIFIER C_SEG_AD_MAX_ER FORMAT "%6.4" /end CHARACTERISTIC
/begin MEASUREMENT seg_ad_dif_er_0 "ER adaptive values difference on same physical segment (Segment 0 & identical)" UWORD _CNV_A_R_ENRD_LINEA_383_CM 1 100. 0. 7.8123 DISPLAY_IDENTIFIER SEG_AD_DIF_ER_0 ECU_ADDRESS 0xd000248c FORMAT "%6.4" /end MEASUREMENT
/begin MEASUREMENT seg_ad_dif_er_1 "ER adaptive values difference on same physical segment (Segment 1 & identical)" UWORD _CNV_A_R_ENRD_LINEA_383_CM 1 100. 0. 7.8123 DISPLAY_IDENTIFIER SEG_AD_DIF_ER_1 ECU_ADDRESS 0xd000248e FORMAT "%6.4" /end MEASUREMENT
/begin MEASUREMENT seg_ad_dif_er_2 "ER adaptive values difference on same physical segment (Segment 2 & identical)" UWORD _CNV_A_R_ENRD_LINEA_383_CM 1 100. 0. 7.8123 DISPLAY_IDENTIFIER SEG_AD_DIF_ER_2 ECU_ADDRESS 0xd0002474 FORMAT "%6.4" /end MEASUREMENT
/begin MEASUREMENT seg_ad_dif_er_3 "ER adaptive values difference on same physical segment (Segment 3 & identical)" UWORD _CNV_A_R_ENRD_LINEA_383_CM 1 100. 0. 7.8123 DISPLAY_IDENTIFIER SEG_AD_DIF_ER_3 ECU_ADDRESS 0xd0002476 FORMAT "%6.4" /end MEASUREMENT
/begin CHARACTERISTIC c_seg_ad_dif_max_er "Maximum range for difference between same physical segment adaptive values" VALUE 0xa0801d52 _REC_VAL_20_u2 7.8123 _CNV_A_R_ENRD_LINEA_383_CM 0. 7.8123 DISPLAY_IDENTIFIER C_SEG_AD_DIF_MAX_ER FORMAT "%6.4" /end CHARACTERISTIC
/begin MEASUREMENT thd_ad_er "Engine roughness threshold correction factor during segment adaptation learning process" ULONG _CNV_A_R_ENRD_LINEA_384_CM 1 100. 0. 1999999.7 DISPLAY_IDENTIFIER THD_AD_ER ECU_ADDRESS 0xd0005f64 FORMAT "%10.6" /end MEASUREMENT
/begin MEASUREMENT lv_seg_ad_fdout_er "Boolean for segment adaptation fade out condition" UBYTE _CNV_S_2_RANGE__0___1_CM 1 100. 0. 1. DISPLAY_IDENTIFIER LV_SEG_AD_FDOUT_ER ECU_ADDRESS 0xd0002500 BIT_MASK 0x1 /end MEASUREMENT
/begin MEASUREMENT lv_seg_ad_dif_max_er "Boolean for maximum ER adaptive values difference on same physical segment  allowed" UBYTE _CNV_S_2_RANGE__0___1_CM 1 100. 0. 1. DISPLAY_IDENTIFIER LV_SEG_AD_DIF_MAX_ER ECU_ADDRESS 0xd000748f BIT_MASK 0x1 /end MEASUREMENT
/begin AXIS_PTS ldp_maf_ip_maf_dif_max_er_ad "" 0xa0801b88 maf _REC_AXS_20_u2 1389. _CNV_A_R_LINEAR_____111_CM 6 0. 1389. FORMAT "%7.2" /end AXIS_PTS
/begin AXIS_PTS ldp_load_mis_ip_load_grd_er_ad "" 0xa0801b78 load_mis _REC_AXS_20_u2 99.9969482421875 _CNV_A_R_LINEAR_____212_CM 6 0. 99.9969482421875 FORMAT "%7.3" /end AXIS_PTS
/begin AXIS_PTS ldp_tps_av_ip_tps_grd_max_er "" 0xa0801be0 tps_av_mv _REC_AXS_20_u2 119.5 _CNV_A_R_LINEAR_____227_CM 6 0. 119.5 FORMAT "%7.3" /end AXIS_PTS
/begin CHARACTERISTIC c_t_maf_dif_dly_er_ad "Fade out duration when maximum air-mass gradient has been detected" VALUE 0xa0801d66 _REC_VAL_20_u2 655.35 _CNV_A_R_LINEAR_____3_CM 0. 655.35 DISPLAY_IDENTIFIER C_T_MAF_DIF_DLY_ER_AD FORMAT "%6.2" /end CHARACTERISTIC
/begin CHARACTERISTIC c_t_load_grd_dly_er_ad "Fade out duration when maximum actual torque gradient has been detected" VALUE 0xa0801d64 _REC_VAL_20_u2 655.35 _CNV_A_R_LINEAR_____3_CM 0. 655.35 DISPLAY_IDENTIFIER C_T_LOAD_GRD_DLY_ER_AD FORMAT "%6.2" /end CHARACTERISTIC
/begin CHARACTERISTIC c_t_tps_grd_dly_er_ad "Fade out duration when maximum throttle gradient has been detected" VALUE 0xa0801d68 _REC_VAL_20_u2 655.34 _CNV_A_R_LINEAR_____3_CM 1.e-002 655.35 DISPLAY_IDENTIFIER C_T_TPS_GRD_DLY_ER_AD FORMAT "%6.2" /end CHARACTERISTIC
/begin CHARACTERISTIC c_t_accout_dly_er_ad "Fade out duration when air-conditioning compressor has been switched on or off" VALUE 0xa0801d60 _REC_VAL_20_u2 655.35 _CNV_A_R_LINEAR_____3_CM 0. 655.35 DISPLAY_IDENTIFIER C_T_ACCOUT_DLY_ER_AD FORMAT "%6.2" /end CHARACTERISTIC
/begin MEASUREMENT lv_seg_ad_fdout_er_eol "EOL specific request for ER segment adaptive learning process" UBYTE _CNV_S_2_RANGE__0___1_CM 1 100. 0. 1. DISPLAY_IDENTIFIER LV_SEG_AD_FDOUT_ER_EOL ECU_ADDRESS 0xd0002501 BIT_MASK 0x1 /end MEASUREMENT
/begin CHARACTERISTIC c_drv1_max_seg_ad_er_eol "Maximum value of DRV1_ER (dynamic part of engine roughness) for crankshaft target wheel learning for EOL request mode" VALUE 0xa0801d2e _REC_VAL_20_u4 1.9965 _CNV_A_R_LINEAR_____385_CM 0. 1.9965 DISPLAY_IDENTIFIER C_DRV1_MAX_SEG_AD_ER_EOL FORMAT "%8.6" /end CHARACTERISTIC
/begin CHARACTERISTIC c_nr_seg_ad_act_min_er_eol "Minimum segments number in fuel cut-off mode before triggering ER segment adaptive learning process for EOL request mode" VALUE 0xa0801d4d _REC_VAL_20_u1 255. _CNV_A_R_LINEAR_____0_CM 0. 255. DISPLAY_IDENTIFIER C_NR_SEG_AD_ACT_MIN_ER_EOL FORMAT "%3.0" /end CHARACTERISTIC
/begin CHARACTERISTIC c_nr_seg_drv1_min_er_eol "Minimum number of segments for engine roughness dynamic part for EOL request mode" VALUE 0xa0801d51 _REC_VAL_20_u1 255. _CNV_A_R_LINEAR_____0_CM 0. 255. DISPLAY_IDENTIFIER C_NR_SEG_DRV1_MIN_ER_EOL FORMAT "%3.0" /end CHARACTERISTIC
/begin CHARACTERISTIC lc_seg_ad_er_req_eol "Specific EOL request enable flag for ER segment adaptive value learning process" VALUE 0xa0801d6b _REC_VAL_20_u1 1. _CNV_S_2_RANGE__0___1_CM 0. 1. DISPLAY_IDENTIFIER LC_SEG_AD_ER_REQ_EOL BIT_MASK 0x1 /end CHARACTERISTIC
/begin MEASUREMENT crlc_seg_ad_er "ER segment adaptive values filtering coefficient" UWORD _CNV_A_R_LINEAR_____89_CM 1 100. 0. 0.9999847412109381 DISPLAY_IDENTIFIER CRLC_SEG_AD_ER ECU_ADDRESS 0xd0002484 FORMAT "%7.5" /end MEASUREMENT
/begin MEASUREMENT ctr_seg_ad_er "Counter of ER segment adaptation learning process" UWORD _CNV_A_R_LINEAR_____0_CM 1 100. 0. 65535. DISPLAY_IDENTIFIER CTR_SEG_AD_ER ECU_ADDRESS 0xd0002486 FORMAT "%5.0" /end MEASUREMENT
/begin MEASUREMENT lv_seg_ad_avl_er "Segment adaptation process state : no adaptive process executed (=0) fast adaptive process executed (=1)" UBYTE _CNV_S_2_RANGE__0___1_CM 1 100. 0. 1. DISPLAY_IDENTIFIER LV_SEG_AD_AVL_ER ECU_ADDRESS 0xd000748e BIT_MASK 0x1 /end MEASUREMENT
/begin MEASUREMENT lv_seg_ad_raw_er "ER segment adaptation process monitoring enable" UBYTE _CNV_S_2_RANGE__0___1_CM 1 100. 0. 1. DISPLAY_IDENTIFIER LV_SEG_AD_RAW_ER ECU_ADDRESS 0xd0002502 BIT_MASK 0x1 /end MEASUREMENT
/begin CHARACTERISTIC c_n_seg_t_ad_raw_max_er "Maximum engine speed threshold for crankshaft target wheel monitoring" VALUE 0xa0801d4a _REC_VAL_20_u1 8160. _CNV_A_R_LINEAR_____10_CM 0. 8160. DISPLAY_IDENTIFIER C_N_SEG_T_AD_RAW_MAX_ER FORMAT "%4.0" /end CHARACTERISTIC
/begin CHARACTERISTIC c_n_seg_t_ad_raw_min_er "Minimum engine speed threshold for crankshaft target wheel monitoring" VALUE 0xa0801d4b _REC_VAL_20_u1 8160. _CNV_A_R_LINEAR_____10_CM 0. 8160. DISPLAY_IDENTIFIER C_N_SEG_T_AD_RAW_MIN_ER FORMAT "%4.0" /end CHARACTERISTIC
/begin CHARACTERISTIC c_drv1_max_seg_ad_er "Maximum value of DRV1_ER (dynamic part of engine roughness) for crankshaft target wheel learning" VALUE 0xa0801d2a _REC_VAL_20_u4 1.9965 _CNV_A_R_LINEAR_____385_CM 0. 1.9965 DISPLAY_IDENTIFIER C_DRV1_MAX_SEG_AD_ER FORMAT "%8.6" /end CHARACTERISTIC
/begin CHARACTERISTIC c_nr_seg_ad_act_min_er "Minimum segments number in fuel cut-off mode before triggering ER segment adaptive learning process" VALUE 0xa0801d4c _REC_VAL_20_u1 255. _CNV_A_R_LINEAR_____0_CM 0. 255. DISPLAY_IDENTIFIER C_NR_SEG_AD_ACT_MIN_ER FORMAT "%3.0" /end CHARACTERISTIC
/begin CHARACTERISTIC c_nr_seg_drv1_min_er "Minimum number of segments for engine roughness dynamic part" VALUE 0xa0801d50 _REC_VAL_20_u1 255. _CNV_A_R_LINEAR_____0_CM 0. 255. DISPLAY_IDENTIFIER C_NR_SEG_DRV1_MIN_ER FORMAT "%3.0" /end CHARACTERISTIC
/begin CHARACTERISTIC c_crlc_seg_ad_er "Nominal ER segment adaptive values filtering coefficient" VALUE 0xa0801d24 _REC_VAL_20_u2 0.9999847412109381 _CNV_A_R_LINEAR_____89_CM 0. 0.9999847412109381 DISPLAY_IDENTIFIER C_CRLC_SEG_AD_ER FORMAT "%7.5" /end CHARACTERISTIC
/begin CHARACTERISTIC c_crlc_seg_ad_er_eol "EOL specific filtering coefficient for ER segment adaptive values learning process" VALUE 0xa0801d26 _REC_VAL_20_u2 0.9999847412109381 _CNV_A_R_LINEAR_____89_CM 0. 0.9999847412109381 DISPLAY_IDENTIFIER C_CRLC_SEG_AD_ER_EOL FORMAT "%7.5" /end CHARACTERISTIC
/begin CHARACTERISTIC c_nr_seg_ad_avl_er "Number of engine cycle (720°Crk) to achieve the fast ER adaptive learning process stage" VALUE 0xa0801d4e _REC_VAL_20_u2 65535. _CNV_A_R_LINEAR_____0_CM 0. 65535. DISPLAY_IDENTIFIER C_NR_SEG_AD_AVL_ER FORMAT "%5.0" /end CHARACTERISTIC
/begin MEASUREMENT lv_seg_ad_lim_er "ER filtered adaptative values out of range" UBYTE _CNV_S_2_RANGE__0___1_CM 1 100. 0. 1. DISPLAY_IDENTIFIER LV_SEG_AD_LIM_ER ECU_ADDRESS 0xd0007490 BIT_MASK 0x1 /end MEASUREMENT
/begin CHARACTERISTIC lc_seg_ad_lim_reac_er "Reactivation  of the ER segment adaptation range check at each learning phase" VALUE 0xa0801d6c _REC_VAL_20_u1 1. _CNV_S_2_RANGE__0___1_CM 0. 1. DISPLAY_IDENTIFIER LC_SEG_AD_LIM_REAC_ER BIT_MASK 0x1 /end CHARACTERISTIC
/begin CHARACTERISTIC c_crlc_fast_seg_ad_er "Fast ER segment adaptive values filtering coefficient (fast learning phase)" VALUE 0xa0801d22 _REC_VAL_20_u2 0.9999847412109381 _CNV_A_R_LINEAR_____89_CM 0. 0.9999847412109381 DISPLAY_IDENTIFIER C_CRLC_FAST_SEG_AD_ER FORMAT "%7.5" /end CHARACTERISTIC
/begin CHARACTERISTIC c_crlc_seg_ad_raw_er "" VALUE 0xa0801d28 _REC_VAL_20_u2 0.9999847412109381 _CNV_A_R_LINEAR_____89_CM 0. 0.9999847412109381 DISPLAY_IDENTIFIER C_CRLC_SEG_AD_RAW_ER FORMAT "%7.5" /end CHARACTERISTIC
/begin CHARACTERISTIC ip_maf_dif_max_er_ad "Maximum air-mass gradient per SEG for fade out condition" CURVE 0xa0801cf0 _REC_CUR_20_u2_u2 1389. _CNV_A_R_LINEAR_____111_CM 0. 1389. DISPLAY_IDENTIFIER IP_MAF_DIF_MAX_ER_AD FORMAT "%7.2"
 /begin AXIS_DESCR COM_AXIS maf _CNV_A_R_LINEAR_____111_CM 6 0. 1389. FORMAT "%7.2" AXIS_PTS_REF ldp_maf_ip_maf_dif_max_er_ad /end AXIS_DESCR
/end CHARACTERISTIC
/begin CHARACTERISTIC ip_load_grd_er_ad "Maximum actual torque gradient fade out condition" CURVE 0xa0801ce4 _REC_CUR_20_u2_u2 99.9969482421875 _CNV_A_R_LINEAR_____212_CM 0. 99.9969482421875 DISPLAY_IDENTIFIER IP_LOAD_GRD_ER_AD FORMAT "%7.3"
 /begin AXIS_DESCR COM_AXIS load_mis _CNV_A_R_LINEAR_____212_CM 6 0. 99.9969482421875 FORMAT "%7.3" AXIS_PTS_REF ldp_load_mis_ip_load_grd_er_ad /end AXIS_DESCR
/end CHARACTERISTIC
/begin CHARACTERISTIC ip_tps_grd_max_er_ad "Maximum throttle gradient threshold for fade out condition" CURVE 0xa0801d14 _REC_CUR_20_u1_u2 2987.5 _CNV_A_R_LINEAR_____386_CM 0. 2987.5 DISPLAY_IDENTIFIER IP_TPS_GRD_MAX_ER_AD FORMAT "%6.1"
 /begin AXIS_DESCR COM_AXIS tps_av_mv _CNV_A_R_LINEAR_____227_CM 6 0. 119.5 FORMAT "%7.3" AXIS_PTS_REF ldp_tps_av_ip_tps_grd_max_er /end AXIS_DESCR
/end CHARACTERISTIC
/begin MEASUREMENT seg_ad_fdout_er_cdn "Segment adaptation fade out conditions carrier byte (before masking)" UBYTE _CNV_A_R_LINEAR_____0_CM 1 100. 0. 255. DISPLAY_IDENTIFIER SEG_AD_FDOUT_ER_CDN ECU_ADDRESS 0xd00024fc FORMAT "%3.0" /end MEASUREMENT
/begin MEASUREMENT seg_ad_fdout_er_cdn.lv_inh_maf_dif_er_ad "ER adaptive process fade out request flag due to MAF transient condition" UBYTE _CNV_A_R_LINEAR_____0_CM 1 100. 0. 255. DISPLAY_IDENTIFIER LV_INH_MAF_DIF_ER_AD ECU_ADDRESS 0xd00024fc FORMAT "%3.0" BIT_MASK 0x1 /end MEASUREMENT
/begin MEASUREMENT seg_ad_fdout_er_cdn.lv_inh_load_grd_max_er_ad "ER adaptive process fade out request flag due to engine load transient condition" UBYTE _CNV_A_R_LINEAR_____0_CM 1 100. 0. 255. DISPLAY_IDENTIFIER LV_INH_LOAD_GRD_MAX_ER_AD ECU_ADDRESS 0xd00024fc FORMAT "%3.0" BIT_MASK 0x2 /end MEASUREMENT
/begin MEASUREMENT seg_ad_fdout_er_cdn.lv_inh_tps_grd_er_ad "ER adaptive process fade out request flag due to TPS transient condition" UBYTE _CNV_A_R_LINEAR_____0_CM 1 100. 0. 255. DISPLAY_IDENTIFIER LV_INH_TPS_GRD_ER_AD ECU_ADDRESS 0xd00024fc FORMAT "%3.0" BIT_MASK 0x4 /end MEASUREMENT
/begin MEASUREMENT seg_ad_fdout_er_cdn.lv_inh_acc_er_ad "ER adaptive process fade out request flag due to air conditioner activation" UBYTE _CNV_A_R_LINEAR_____0_CM 1 100. 0. 255. DISPLAY_IDENTIFIER LV_INH_ACC_ER_AD ECU_ADDRESS 0xd00024fc FORMAT "%3.0" BIT_MASK 0x8 /end MEASUREMENT
/begin MEASUREMENT seg_ad_fdout_er_cdn_nr "Segment adaptation fade out conditions number (after masking)" UBYTE _CNV_A_R_LINEAR_____0_CM 1 100. 0. 8. DISPLAY_IDENTIFIER SEG_AD_FDOUT_ER_CDN_NR ECU_ADDRESS 0xd00024fd FORMAT "%3.0" /end MEASUREMENT
/begin CHARACTERISTIC c_mask_seg_ad_fdout_er "Configuration mask for SEG_AD_FDOUT_ER_CDN fade out carrier structure" VALUE 0xa0801d35 _REC_VAL_20_u1 255. _CNV_A_R_LINEAR_____0_CM 0. 255. DISPLAY_IDENTIFIER C_MASK_SEG_AD_FDOUT_ER FORMAT "%3.0" /end CHARACTERISTIC
/begin CHARACTERISTIC c_n_max_seg_ad_er_eol_mt "Maximum engine speed threshold for crankshaft target wheel learning for EOL request mode im MT" VALUE 0xa0801d43 _REC_VAL_20_u1 8160. _CNV_A_R_LINEAR_____10_CM 0. 8160. DISPLAY_IDENTIFIER C_N_MAX_SEG_AD_ER_EOL_MT FORMAT "%4.0" /end CHARACTERISTIC
/begin CHARACTERISTIC c_n_max_seg_ad_er_eol_at "Maximum engine speed threshold for crankshaft target wheel learning for EOL request mode im AT" VALUE 0xa0801d42 _REC_VAL_20_u1 8160. _CNV_A_R_LINEAR_____10_CM 0. 8160. DISPLAY_IDENTIFIER C_N_MAX_SEG_AD_ER_EOL_AT FORMAT "%4.0" /end CHARACTERISTIC
/begin CHARACTERISTIC c_n_min_seg_ad_er_eol_mt "Minimum engine speed threshold for crankshaft target wheel learning for EOL request mode im MT" VALUE 0xa0801d49 _REC_VAL_20_u1 8160. _CNV_A_R_LINEAR_____10_CM 0. 8160. DISPLAY_IDENTIFIER C_N_MIN_SEG_AD_ER_EOL_MT FORMAT "%4.0" /end CHARACTERISTIC
/begin CHARACTERISTIC c_n_min_seg_ad_er_eol_at "Minimum engine speed threshold for crankshaft target wheel learning for EOL request mode im AT" VALUE 0xa0801d48 _REC_VAL_20_u1 8160. _CNV_A_R_LINEAR_____10_CM 0. 8160. DISPLAY_IDENTIFIER C_N_MIN_SEG_AD_ER_EOL_AT FORMAT "%4.0" /end CHARACTERISTIC
/begin MEASUREMENT lv_seg_ad_er "ER segment adaptation process enable" UBYTE _CNV_S_2_RANGE__0___1_CM 1 100. 0. 1. DISPLAY_IDENTIFIER LV_SEG_AD_ER ECU_ADDRESS 0xd0007489 BIT_MASK 0x1 /end MEASUREMENT
/begin MEASUREMENT lv_seg_ad_n_vld "ER segment adaptation process enable vs N" UBYTE _CNV_S_2_RANGE__0___1_CM 1 100. 0. 1. DISPLAY_IDENTIFIER LV_SEG_AD_N_VLD ECU_ADDRESS 0xd000748a BIT_MASK 0x1 /end MEASUREMENT
/begin CHARACTERISTIC c_n_min_l_seg_ad_er_at "Minimum engine speed threshold for crankshaft target wheel learning in low range with AT" VALUE 0xa0801d46 _REC_VAL_20_u1 8160. _CNV_A_R_LINEAR_____10_CM 0. 8160. DISPLAY_IDENTIFIER C_N_MIN_L_SEG_AD_ER_AT FORMAT "%4.0" /end CHARACTERISTIC
/begin CHARACTERISTIC c_n_min_l_seg_ad_er_mt "Minimum engine speed threshold for crankshaft target wheel learning in low range with MT" VALUE 0xa0801d47 _REC_VAL_20_u1 8160. _CNV_A_R_LINEAR_____10_CM 0. 8160. DISPLAY_IDENTIFIER C_N_MIN_L_SEG_AD_ER_MT FORMAT "%4.0" /end CHARACTERISTIC
/begin CHARACTERISTIC c_n_max_h_seg_ad_er_at "Maximum engine speed threshold for crankshaft target wheel learning in high range with AT" VALUE 0xa0801d3c _REC_VAL_20_u1 8160. _CNV_A_R_LINEAR_____10_CM 0. 8160. DISPLAY_IDENTIFIER C_N_MAX_H_SEG_AD_ER_AT FORMAT "%4.0" /end CHARACTERISTIC
/begin CHARACTERISTIC c_n_max_mid_seg_ad_er_at "Maximum engine speed threshold for crankshaft target wheel learning in mid range with AT" VALUE 0xa0801d40 _REC_VAL_20_u1 8160. _CNV_A_R_LINEAR_____10_CM 0. 8160. DISPLAY_IDENTIFIER C_N_MAX_MID_SEG_AD_ER_AT FORMAT "%4.0" /end CHARACTERISTIC
/begin CHARACTERISTIC c_n_max_l_seg_ad_er_at "Maximum engine speed threshold for crankshaft target wheel learning in low range with AT" VALUE 0xa0801d3e _REC_VAL_20_u1 8160. _CNV_A_R_LINEAR_____10_CM 0. 8160. DISPLAY_IDENTIFIER C_N_MAX_L_SEG_AD_ER_AT FORMAT "%4.0" /end CHARACTERISTIC
/begin CHARACTERISTIC c_n_max_h_seg_ad_er_mt "Maximum engine speed threshold for crankshaft target wheel learning in high range with MT" VALUE 0xa0801d3d _REC_VAL_20_u1 8160. _CNV_A_R_LINEAR_____10_CM 0. 8160. DISPLAY_IDENTIFIER C_N_MAX_H_SEG_AD_ER_MT FORMAT "%4.0" /end CHARACTERISTIC
/begin CHARACTERISTIC c_n_max_mid_seg_ad_er_mt "Maximum engine speed threshold for crankshaft target wheel learning in mid range with MT" VALUE 0xa0801d41 _REC_VAL_20_u1 8160. _CNV_A_R_LINEAR_____10_CM 0. 8160. DISPLAY_IDENTIFIER C_N_MAX_MID_SEG_AD_ER_MT FORMAT "%4.0" /end CHARACTERISTIC
/begin CHARACTERISTIC c_n_max_l_seg_ad_er_mt "Maximum engine speed threshold for crankshaft target wheel learning in low range with MT" VALUE 0xa0801d3f _REC_VAL_20_u1 8160. _CNV_A_R_LINEAR_____10_CM 0. 8160. DISPLAY_IDENTIFIER C_N_MAX_L_SEG_AD_ER_MT FORMAT "%4.0" /end CHARACTERISTIC
/begin MEASUREMENT seg_ad_mmv_er[0] "ER Filtered adaptive values used for learning process (for each segment)" SWORD _CNV_A_R_ENRD_LINEA_381_CM 1 100. -7.8125 7.8123 DISPLAY_IDENTIFIER SEG_AD_MMV_ER[0] ECU_ADDRESS 0xd0006614 FORMAT "%7.4" /end MEASUREMENT
/begin MEASUREMENT seg_ad_mmv_er[1] "ER Filtered adaptive values used for learning process (for each segment)" SWORD _CNV_A_R_ENRD_LINEA_381_CM 1 100. -7.8125 7.8123 DISPLAY_IDENTIFIER SEG_AD_MMV_ER[1] ECU_ADDRESS 0xd0006616 FORMAT "%7.4" /end MEASUREMENT
/begin MEASUREMENT seg_ad_mmv_er[2] "ER Filtered adaptive values used for learning process (for each segment)" SWORD _CNV_A_R_ENRD_LINEA_381_CM 1 100. -7.8125 7.8123 DISPLAY_IDENTIFIER SEG_AD_MMV_ER[2] ECU_ADDRESS 0xd0006618 FORMAT "%7.4" /end MEASUREMENT
/begin MEASUREMENT seg_ad_mmv_er[3] "ER Filtered adaptive values used for learning process (for each segment)" SWORD _CNV_A_R_ENRD_LINEA_381_CM 1 100. -7.8125 7.8123 DISPLAY_IDENTIFIER SEG_AD_MMV_ER[3] ECU_ADDRESS 0xd000661a FORMAT "%7.4" /end MEASUREMENT
/begin MEASUREMENT seg_ad_mmv_er[4] "ER Filtered adaptive values used for learning process (for each segment)" SWORD _CNV_A_R_ENRD_LINEA_381_CM 1 100. -7.8125 7.8123 DISPLAY_IDENTIFIER SEG_AD_MMV_ER[4] ECU_ADDRESS 0xd000661c FORMAT "%7.4" /end MEASUREMENT
/begin MEASUREMENT seg_ad_mmv_er[5] "ER Filtered adaptive values used for learning process (for each segment)" SWORD _CNV_A_R_ENRD_LINEA_381_CM 1 100. -7.8125 7.8123 DISPLAY_IDENTIFIER SEG_AD_MMV_ER[5] ECU_ADDRESS 0xd000661e FORMAT "%7.4" /end MEASUREMENT
/begin MEASUREMENT seg_ad_mmv_er[6] "ER Filtered adaptive values used for learning process (for each segment)" SWORD _CNV_A_R_ENRD_LINEA_381_CM 1 100. -7.8125 7.8123 DISPLAY_IDENTIFIER SEG_AD_MMV_ER[6] ECU_ADDRESS 0xd0006620 FORMAT "%7.4" /end MEASUREMENT
/begin MEASUREMENT seg_ad_mmv_er[7] "ER Filtered adaptive values used for learning process (for each segment)" SWORD _CNV_A_R_ENRD_LINEA_381_CM 1 100. -7.8125 7.8123 DISPLAY_IDENTIFIER SEG_AD_MMV_ER[7] ECU_ADDRESS 0xd0006622 FORMAT "%7.4" /end MEASUREMENT
/begin MEASUREMENT seg_ad_mmv_er_l[0] "ER Filtered adaptive values used for learning process (for each segment) versus low engine speed" SWORD _CNV_A_R_ENRD_LINEA_381_CM 1 100. -7.8125 7.8123 DISPLAY_IDENTIFIER SEG_AD_MMV_ER_L[0] ECU_ADDRESS 0xd0006644 FORMAT "%7.4" /end MEASUREMENT
/begin MEASUREMENT seg_ad_mmv_er_l[1] "ER Filtered adaptive values used for learning process (for each segment) versus low engine speed" SWORD _CNV_A_R_ENRD_LINEA_381_CM 1 100. -7.8125 7.8123 DISPLAY_IDENTIFIER SEG_AD_MMV_ER_L[1] ECU_ADDRESS 0xd0006646 FORMAT "%7.4" /end MEASUREMENT
/begin MEASUREMENT seg_ad_mmv_er_l[2] "ER Filtered adaptive values used for learning process (for each segment) versus low engine speed" SWORD _CNV_A_R_ENRD_LINEA_381_CM 1 100. -7.8125 7.8123 DISPLAY_IDENTIFIER SEG_AD_MMV_ER_L[2] ECU_ADDRESS 0xd0006648 FORMAT "%7.4" /end MEASUREMENT
/begin MEASUREMENT seg_ad_mmv_er_l[3] "ER Filtered adaptive values used for learning process (for each segment) versus low engine speed" SWORD _CNV_A_R_ENRD_LINEA_381_CM 1 100. -7.8125 7.8123 DISPLAY_IDENTIFIER SEG_AD_MMV_ER_L[3] ECU_ADDRESS 0xd000664a FORMAT "%7.4" /end MEASUREMENT
/begin MEASUREMENT seg_ad_mmv_er_l[4] "ER Filtered adaptive values used for learning process (for each segment) versus low engine speed" SWORD _CNV_A_R_ENRD_LINEA_381_CM 1 100. -7.8125 7.8123 DISPLAY_IDENTIFIER SEG_AD_MMV_ER_L[4] ECU_ADDRESS 0xd000664c FORMAT "%7.4" /end MEASUREMENT
/begin MEASUREMENT seg_ad_mmv_er_l[5] "ER Filtered adaptive values used for learning process (for each segment) versus low engine speed" SWORD _CNV_A_R_ENRD_LINEA_381_CM 1 100. -7.8125 7.8123 DISPLAY_IDENTIFIER SEG_AD_MMV_ER_L[5] ECU_ADDRESS 0xd000664e FORMAT "%7.4" /end MEASUREMENT
/begin MEASUREMENT seg_ad_mmv_er_l[6] "ER Filtered adaptive values used for learning process (for each segment) versus low engine speed" SWORD _CNV_A_R_ENRD_LINEA_381_CM 1 100. -7.8125 7.8123 DISPLAY_IDENTIFIER SEG_AD_MMV_ER_L[6] ECU_ADDRESS 0xd0006650 FORMAT "%7.4" /end MEASUREMENT
/begin MEASUREMENT seg_ad_mmv_er_l[7] "ER Filtered adaptive values used for learning process (for each segment) versus low engine speed" SWORD _CNV_A_R_ENRD_LINEA_381_CM 1 100. -7.8125 7.8123 DISPLAY_IDENTIFIER SEG_AD_MMV_ER_L[7] ECU_ADDRESS 0xd0006652 FORMAT "%7.4" /end MEASUREMENT
/begin MEASUREMENT seg_ad_mmv_er_mid[0] "ER Filtered adaptive values used for learning process (for each segment) versus midde engine speed" SWORD _CNV_A_R_ENRD_LINEA_381_CM 1 100. -7.8125 7.8123 DISPLAY_IDENTIFIER SEG_AD_MMV_ER_MID[0] ECU_ADDRESS 0xd0006654 FORMAT "%7.4" /end MEASUREMENT
/begin MEASUREMENT seg_ad_mmv_er_mid[1] "ER Filtered adaptive values used for learning process (for each segment) versus midde engine speed" SWORD _CNV_A_R_ENRD_LINEA_381_CM 1 100. -7.8125 7.8123 DISPLAY_IDENTIFIER SEG_AD_MMV_ER_MID[1] ECU_ADDRESS 0xd0006656 FORMAT "%7.4" /end MEASUREMENT
/begin MEASUREMENT seg_ad_mmv_er_mid[2] "ER Filtered adaptive values used for learning process (for each segment) versus midde engine speed" SWORD _CNV_A_R_ENRD_LINEA_381_CM 1 100. -7.8125 7.8123 DISPLAY_IDENTIFIER SEG_AD_MMV_ER_MID[2] ECU_ADDRESS 0xd0006658 FORMAT "%7.4" /end MEASUREMENT
/begin MEASUREMENT seg_ad_mmv_er_mid[3] "ER Filtered adaptive values used for learning process (for each segment) versus midde engine speed" SWORD _CNV_A_R_ENRD_LINEA_381_CM 1 100. -7.8125 7.8123 DISPLAY_IDENTIFIER SEG_AD_MMV_ER_MID[3] ECU_ADDRESS 0xd000665a FORMAT "%7.4" /end MEASUREMENT
/begin MEASUREMENT seg_ad_mmv_er_mid[4] "ER Filtered adaptive values used for learning process (for each segment) versus midde engine speed" SWORD _CNV_A_R_ENRD_LINEA_381_CM 1 100. -7.8125 7.8123 DISPLAY_IDENTIFIER SEG_AD_MMV_ER_MID[4] ECU_ADDRESS 0xd000665c FORMAT "%7.4" /end MEASUREMENT
/begin MEASUREMENT seg_ad_mmv_er_mid[5] "ER Filtered adaptive values used for learning process (for each segment) versus midde engine speed" SWORD _CNV_A_R_ENRD_LINEA_381_CM 1 100. -7.8125 7.8123 DISPLAY_IDENTIFIER SEG_AD_MMV_ER_MID[5] ECU_ADDRESS 0xd000665e FORMAT "%7.4" /end MEASUREMENT
/begin MEASUREMENT seg_ad_mmv_er_mid[6] "ER Filtered adaptive values used for learning process (for each segment) versus midde engine speed" SWORD _CNV_A_R_ENRD_LINEA_381_CM 1 100. -7.8125 7.8123 DISPLAY_IDENTIFIER SEG_AD_MMV_ER_MID[6] ECU_ADDRESS 0xd0006660 FORMAT "%7.4" /end MEASUREMENT
/begin MEASUREMENT seg_ad_mmv_er_mid[7] "ER Filtered adaptive values used for learning process (for each segment) versus midde engine speed" SWORD _CNV_A_R_ENRD_LINEA_381_CM 1 100. -7.8125 7.8123 DISPLAY_IDENTIFIER SEG_AD_MMV_ER_MID[7] ECU_ADDRESS 0xd0006662 FORMAT "%7.4" /end MEASUREMENT
/begin MEASUREMENT seg_ad_mmv_er_h[0] "ER Filtered adaptive values used for learning process (for each segment) versus high engine speed" SWORD _CNV_A_R_ENRD_LINEA_381_CM 1 100. -7.8125 7.8123 DISPLAY_IDENTIFIER SEG_AD_MMV_ER_H[0] ECU_ADDRESS 0xd0006634 FORMAT "%7.4" /end MEASUREMENT
/begin MEASUREMENT seg_ad_mmv_er_h[1] "ER Filtered adaptive values used for learning process (for each segment) versus high engine speed" SWORD _CNV_A_R_ENRD_LINEA_381_CM 1 100. -7.8125 7.8123 DISPLAY_IDENTIFIER SEG_AD_MMV_ER_H[1] ECU_ADDRESS 0xd0006636 FORMAT "%7.4" /end MEASUREMENT
/begin MEASUREMENT seg_ad_mmv_er_h[2] "ER Filtered adaptive values used for learning process (for each segment) versus high engine speed" SWORD _CNV_A_R_ENRD_LINEA_381_CM 1 100. -7.8125 7.8123 DISPLAY_IDENTIFIER SEG_AD_MMV_ER_H[2] ECU_ADDRESS 0xd0006638 FORMAT "%7.4" /end MEASUREMENT
/begin MEASUREMENT seg_ad_mmv_er_h[3] "ER Filtered adaptive values used for learning process (for each segment) versus high engine speed" SWORD _CNV_A_R_ENRD_LINEA_381_CM 1 100. -7.8125 7.8123 DISPLAY_IDENTIFIER SEG_AD_MMV_ER_H[3] ECU_ADDRESS 0xd000663a FORMAT "%7.4" /end MEASUREMENT
/begin MEASUREMENT seg_ad_mmv_er_h[4] "ER Filtered adaptive values used for learning process (for each segment) versus high engine speed" SWORD _CNV_A_R_ENRD_LINEA_381_CM 1 100. -7.8125 7.8123 DISPLAY_IDENTIFIER SEG_AD_MMV_ER_H[4] ECU_ADDRESS 0xd000663c FORMAT "%7.4" /end MEASUREMENT
/begin MEASUREMENT seg_ad_mmv_er_h[5] "ER Filtered adaptive values used for learning process (for each segment) versus high engine speed" SWORD _CNV_A_R_ENRD_LINEA_381_CM 1 100. -7.8125 7.8123 DISPLAY_IDENTIFIER SEG_AD_MMV_ER_H[5] ECU_ADDRESS 0xd000663e FORMAT "%7.4" /end MEASUREMENT
/begin MEASUREMENT seg_ad_mmv_er_h[6] "ER Filtered adaptive values used for learning process (for each segment) versus high engine speed" SWORD _CNV_A_R_ENRD_LINEA_381_CM 1 100. -7.8125 7.8123 DISPLAY_IDENTIFIER SEG_AD_MMV_ER_H[6] ECU_ADDRESS 0xd0006640 FORMAT "%7.4" /end MEASUREMENT
/begin MEASUREMENT seg_ad_mmv_er_h[7] "ER Filtered adaptive values used for learning process (for each segment) versus high engine speed" SWORD _CNV_A_R_ENRD_LINEA_381_CM 1 100. -7.8125 7.8123 DISPLAY_IDENTIFIER SEG_AD_MMV_ER_H[7] ECU_ADDRESS 0xd0006642 FORMAT "%7.4" /end MEASUREMENT
/begin MEASUREMENT drv0_er "Engine roughness static component" SLONG _CNV_P_3_ENRD_LINEA_I_387_CM 1 100. -512000000. 511999999.7 DISPLAY_IDENTIFIER DRV0_ER ECU_ADDRESS 0xd0005f68 FORMAT "%13.7" /end MEASUREMENT
/begin MEASUREMENT seg_nr_er "ER segment counter for segment identification (0...NC_CYL_NR - 1)" UBYTE _CNV_A_R_LINEAR_____0_CM 1 100. 0. 11. DISPLAY_IDENTIFIER SEG_NR_ER ECU_ADDRESS 0xd0007483 FORMAT "%3.0" /end MEASUREMENT
/begin MEASUREMENT lv_ena_er "Engine roughness valid calculation control flag" UBYTE _CNV_S_2_RANGE__0___1_CM 1 100. 0. 1. DISPLAY_IDENTIFIER LV_ENA_ER ECU_ADDRESS 0xd000748c BIT_MASK 0x1 /end MEASUREMENT
/begin CHARACTERISTIC c_n_max_er "Maximum engine speed for engine roughness calculation" VALUE 0xa0801d38 _REC_VAL_20_u2 8160. _CNV_A_R_LINEAR_____14_CM 0. 8160. DISPLAY_IDENTIFIER C_N_MAX_ER FORMAT "%4.0" /end CHARACTERISTIC
/begin CHARACTERISTIC c_n_min_er "Minimum engine speed for engine roughness calculation" VALUE 0xa0801d44 _REC_VAL_20_u2 8160. _CNV_A_R_LINEAR_____14_CM 0. 8160. DISPLAY_IDENTIFIER C_N_MIN_ER FORMAT "%4.0" /end CHARACTERISTIC
/begin MEASUREMENT fac_gain_er[0] "ER multiplicative correction components" UWORD _CNV_A_R_LINEAR_____28_CM 1 100. 0. 1.99609375 DISPLAY_IDENTIFIER FAC_GAIN_ER[0] ECU_ADDRESS 0xd00024a0 FORMAT "%5.3" /end MEASUREMENT
/begin MEASUREMENT fac_gain_er[1] "ER multiplicative correction components" UWORD _CNV_A_R_LINEAR_____28_CM 1 100. 0. 1.99609375 DISPLAY_IDENTIFIER FAC_GAIN_ER[1] ECU_ADDRESS 0xd00024a2 FORMAT "%5.3" /end MEASUREMENT
/begin MEASUREMENT fac_gain_er[2] "ER multiplicative correction components" UWORD _CNV_A_R_LINEAR_____28_CM 1 100. 0. 1.99609375 DISPLAY_IDENTIFIER FAC_GAIN_ER[2] ECU_ADDRESS 0xd00024a4 FORMAT "%5.3" /end MEASUREMENT
/begin MEASUREMENT fac_gain_er[3] "ER multiplicative correction components" UWORD _CNV_A_R_LINEAR_____28_CM 1 100. 0. 1.99609375 DISPLAY_IDENTIFIER FAC_GAIN_ER[3] ECU_ADDRESS 0xd00024a6 FORMAT "%5.3" /end MEASUREMENT
/begin MEASUREMENT fac_gain_er[4] "ER multiplicative correction components" UWORD _CNV_A_R_LINEAR_____28_CM 1 100. 0. 1.99609375 DISPLAY_IDENTIFIER FAC_GAIN_ER[4] ECU_ADDRESS 0xd00024a8 FORMAT "%5.3" /end MEASUREMENT
/begin MEASUREMENT fac_gain_er[5] "ER multiplicative correction components" UWORD _CNV_A_R_LINEAR_____28_CM 1 100. 0. 1.99609375 DISPLAY_IDENTIFIER FAC_GAIN_ER[5] ECU_ADDRESS 0xd00024aa FORMAT "%5.3" /end MEASUREMENT
/begin MEASUREMENT fac_gain_er[6] "ER multiplicative correction components" UWORD _CNV_A_R_LINEAR_____28_CM 1 100. 0. 1.99609375 DISPLAY_IDENTIFIER FAC_GAIN_ER[6] ECU_ADDRESS 0xd00024ac FORMAT "%5.3" /end MEASUREMENT
/begin MEASUREMENT fac_gain_er[7] "ER multiplicative correction components" UWORD _CNV_A_R_LINEAR_____28_CM 1 100. 0. 1.99609375 DISPLAY_IDENTIFIER FAC_GAIN_ER[7] ECU_ADDRESS 0xd00024ae FORMAT "%5.3" /end MEASUREMENT
/begin MEASUREMENT fac_add_er[0] "ER additive correction components" SLONG _CNV_P_3_ENRD_LINEA_I_387_CM 1 100. -512000000. 511999999.7 DISPLAY_IDENTIFIER FAC_ADD_ER[0] ECU_ADDRESS 0xd0005efc FORMAT "%13.7" /end MEASUREMENT
/begin MEASUREMENT fac_add_er[1] "ER additive correction components" SLONG _CNV_P_3_ENRD_LINEA_I_387_CM 1 100. -512000000. 511999999.7 DISPLAY_IDENTIFIER FAC_ADD_ER[1] ECU_ADDRESS 0xd0005f00 FORMAT "%13.7" /end MEASUREMENT
/begin MEASUREMENT fac_add_er[2] "ER additive correction components" SLONG _CNV_P_3_ENRD_LINEA_I_387_CM 1 100. -512000000. 511999999.7 DISPLAY_IDENTIFIER FAC_ADD_ER[2] ECU_ADDRESS 0xd0005f04 FORMAT "%13.7" /end MEASUREMENT
/begin MEASUREMENT fac_add_er[3] "ER additive correction components" SLONG _CNV_P_3_ENRD_LINEA_I_387_CM 1 100. -512000000. 511999999.7 DISPLAY_IDENTIFIER FAC_ADD_ER[3] ECU_ADDRESS 0xd0005f08 FORMAT "%13.7" /end MEASUREMENT
/begin MEASUREMENT fac_add_er[4] "ER additive correction components" SLONG _CNV_P_3_ENRD_LINEA_I_387_CM 1 100. -512000000. 511999999.7 DISPLAY_IDENTIFIER FAC_ADD_ER[4] ECU_ADDRESS 0xd0005f0c FORMAT "%13.7" /end MEASUREMENT
/begin MEASUREMENT fac_add_er[5] "ER additive correction components" SLONG _CNV_P_3_ENRD_LINEA_I_387_CM 1 100. -512000000. 511999999.7 DISPLAY_IDENTIFIER FAC_ADD_ER[5] ECU_ADDRESS 0xd0005f10 FORMAT "%13.7" /end MEASUREMENT
/begin MEASUREMENT fac_add_er[6] "ER additive correction components" SLONG _CNV_P_3_ENRD_LINEA_I_387_CM 1 100. -512000000. 511999999.7 DISPLAY_IDENTIFIER FAC_ADD_ER[6] ECU_ADDRESS 0xd0005f14 FORMAT "%13.7" /end MEASUREMENT
/begin MEASUREMENT fac_add_er[7] "ER additive correction components" SLONG _CNV_P_3_ENRD_LINEA_I_387_CM 1 100. -512000000. 511999999.7 DISPLAY_IDENTIFIER FAC_ADD_ER[7] ECU_ADDRESS 0xd0005f18 FORMAT "%13.7" /end MEASUREMENT
/begin CHARACTERISTIC ip_fac_gain_er_mt_0 "ER cylinder 0 multiplicative segment dependent factor for torsion correction with MT" CURVE 0xa0801e84 _REC_CUR_20_u2_u1 1.99609375 _CNV_A_R_LINEAR_____28_CM 0. 1.99609375 DISPLAY_IDENTIFIER IP_FAC_GAIN_ER_MT_0 FORMAT "%5.3"
 /begin AXIS_DESCR COM_AXIS n_32 _CNV_A_R_LINEAR_____10_CM 6 0. 8160. FORMAT "%4.0" AXIS_PTS_REF ldpm_n_32_2_enrd /end AXIS_DESCR
/end CHARACTERISTIC
/begin CHARACTERISTIC ip_fac_gain_er_mt_1 "ER cylinder 1 multiplicative segment dependent factor for torsion correction with MT" CURVE 0xa0801e90 _REC_CUR_20_u2_u1 1.99609375 _CNV_A_R_LINEAR_____28_CM 0. 1.99609375 DISPLAY_IDENTIFIER IP_FAC_GAIN_ER_MT_1 FORMAT "%5.3"
 /begin AXIS_DESCR COM_AXIS n_32 _CNV_A_R_LINEAR_____10_CM 6 0. 8160. FORMAT "%4.0" AXIS_PTS_REF ldpm_n_32_2_enrd /end AXIS_DESCR
/end CHARACTERISTIC
/begin CHARACTERISTIC ip_fac_gain_er_mt_2 "ER cylinder 2 multiplicative segment dependent factor for torsion correction with MT" CURVE 0xa0801e9c _REC_CUR_20_u2_u1 1.99609375 _CNV_A_R_LINEAR_____28_CM 0. 1.99609375 DISPLAY_IDENTIFIER IP_FAC_GAIN_ER_MT_2 FORMAT "%5.3"
 /begin AXIS_DESCR COM_AXIS n_32 _CNV_A_R_LINEAR_____10_CM 6 0. 8160. FORMAT "%4.0" AXIS_PTS_REF ldpm_n_32_2_enrd /end AXIS_DESCR
/end CHARACTERISTIC
/begin CHARACTERISTIC ip_fac_gain_er_mt_6 "ER cylinder 6 multiplicative segment dependent factor for torsion correction with MT" CURVE 0xa0802048 _REC_CUR_20_u2_u1 1.99609375 _CNV_A_R_LINEAR_____28_CM 0. 1.99609375 DISPLAY_IDENTIFIER IP_FAC_GAIN_ER_MT_6 FORMAT "%5.3"
 /begin AXIS_DESCR COM_AXIS n_32 _CNV_A_R_LINEAR_____10_CM 6 0. 8160. FORMAT "%4.0" AXIS_PTS_REF ldpm_n_32_2_enrd /end AXIS_DESCR
/end CHARACTERISTIC
/begin CHARACTERISTIC ip_fac_gain_er_mt_3 "ER cylinder 3 multiplicative segment dependent factor for torsion correction with MT" CURVE 0xa0801ef4 _REC_CUR_20_u2_u1 1.99609375 _CNV_A_R_LINEAR_____28_CM 0. 1.99609375 DISPLAY_IDENTIFIER IP_FAC_GAIN_ER_MT_3 FORMAT "%5.3"
 /begin AXIS_DESCR COM_AXIS n_32 _CNV_A_R_LINEAR_____10_CM 6 0. 8160. FORMAT "%4.0" AXIS_PTS_REF ldpm_n_32_2_enrd /end AXIS_DESCR
/end CHARACTERISTIC
/begin CHARACTERISTIC ip_fac_gain_er_mt_4 "ER cylinder 4 multiplicative segment dependent factor for torsion correction with MT" CURVE 0xa0801f4c _REC_CUR_20_u2_u1 1.99609375 _CNV_A_R_LINEAR_____28_CM 0. 1.99609375 DISPLAY_IDENTIFIER IP_FAC_GAIN_ER_MT_4 FORMAT "%5.3"
 /begin AXIS_DESCR COM_AXIS n_32 _CNV_A_R_LINEAR_____10_CM 6 0. 8160. FORMAT "%4.0" AXIS_PTS_REF ldpm_n_32_2_enrd /end AXIS_DESCR
/end CHARACTERISTIC
/begin CHARACTERISTIC ip_fac_gain_er_mt_5 "ER cylinder 5 multiplicative segment dependent factor for torsion correction with MT" CURVE 0xa0801fa4 _REC_CUR_20_u2_u1 1.99609375 _CNV_A_R_LINEAR_____28_CM 0. 1.99609375 DISPLAY_IDENTIFIER IP_FAC_GAIN_ER_MT_5 FORMAT "%5.3"
 /begin AXIS_DESCR COM_AXIS n_32 _CNV_A_R_LINEAR_____10_CM 6 0. 8160. FORMAT "%4.0" AXIS_PTS_REF ldpm_n_32_2_enrd /end AXIS_DESCR
/end CHARACTERISTIC
/begin AXIS_PTS ldp_load_ip_fac_add_er_mt_1 "" 0xa0801de0 load_mis _REC_AXS_20_u2 99.9969482421875 _CNV_A_R_LINEAR_____212_CM 6 0. 99.9969482421875 FORMAT "%7.3" /end AXIS_PTS
/begin AXIS_PTS ldp_load_ip_fac_add_er_at_1 "" 0xa0801db0 load_mis _REC_AXS_20_u2 99.9969482421875 _CNV_A_R_LINEAR_____212_CM 6 0. 99.9969482421875 FORMAT "%7.3" /end AXIS_PTS
/begin AXIS_PTS ldp_load_ip_fac_add_er_at_2 "" 0xa0801dc0 load_mis _REC_AXS_20_u2 99.9969482421875 _CNV_A_R_LINEAR_____212_CM 6 0. 99.9969482421875 FORMAT "%7.3" /end AXIS_PTS
/begin AXIS_PTS ldp_load_ip_fac_add_er_mt_4 "" 0xa0801f10 load_mis _REC_AXS_20_u2 99.9969482421875 _CNV_A_R_LINEAR_____212_CM 6 0. 99.9969482421875 FORMAT "%7.3" /end AXIS_PTS
/begin AXIS_PTS ldp_load_ip_fac_add_er_at_6 "" 0xa0801fb0 load_mis _REC_AXS_20_u2 99.9969482421875 _CNV_A_R_LINEAR_____212_CM 6 0. 99.9969482421875 FORMAT "%7.3" /end AXIS_PTS
/begin AXIS_PTS ldp_load_ip_fac_add_er_at_3 "" 0xa0801ea8 load_mis _REC_AXS_20_u2 99.9969482421875 _CNV_A_R_LINEAR_____212_CM 6 0. 99.9969482421875 FORMAT "%7.3" /end AXIS_PTS
/begin AXIS_PTS ldp_load_ip_fac_add_er_mt_7 "" 0xa0801fe0 load_mis _REC_AXS_20_u2 99.9969482421875 _CNV_A_R_LINEAR_____212_CM 6 0. 99.9969482421875 FORMAT "%7.3" /end AXIS_PTS
/begin AXIS_PTS ldp_load_ip_fac_add_er_mt_3 "" 0xa0801eb8 load_mis _REC_AXS_20_u2 99.9969482421875 _CNV_A_R_LINEAR_____212_CM 6 0. 99.9969482421875 FORMAT "%7.3" /end AXIS_PTS
/begin AXIS_PTS ldp_load_ip_fac_add_er_at_7 "" 0xa0801fc0 load_mis _REC_AXS_20_u2 99.9969482421875 _CNV_A_R_LINEAR_____212_CM 6 0. 99.9969482421875 FORMAT "%7.3" /end AXIS_PTS
/begin AXIS_PTS ldp_load_ip_fac_add_er_at_4 "" 0xa0801f00 load_mis _REC_AXS_20_u2 99.9969482421875 _CNV_A_R_LINEAR_____212_CM 6 0. 99.9969482421875 FORMAT "%7.3" /end AXIS_PTS
/begin AXIS_PTS ldp_load_ip_fac_add_er_mt_5 "" 0xa0801f68 load_mis _REC_AXS_20_u2 99.9969482421875 _CNV_A_R_LINEAR_____212_CM 6 0. 99.9969482421875 FORMAT "%7.3" /end AXIS_PTS
/begin AXIS_PTS ldp_load_ip_fac_add_er_at_5 "" 0xa0801f58 load_mis _REC_AXS_20_u2 99.9969482421875 _CNV_A_R_LINEAR_____212_CM 6 0. 99.9969482421875 FORMAT "%7.3" /end AXIS_PTS
/begin AXIS_PTS ldp_load_ip_fac_add_er_mt_2 "" 0xa0801df0 load_mis _REC_AXS_20_u2 99.9969482421875 _CNV_A_R_LINEAR_____212_CM 6 0. 99.9969482421875 FORMAT "%7.3" /end AXIS_PTS
/begin AXIS_PTS ldp_load_ip_fac_add_er_mt_6 "" 0xa0801fd0 load_mis _REC_AXS_20_u2 99.9969482421875 _CNV_A_R_LINEAR_____212_CM 6 0. 99.9969482421875 FORMAT "%7.3" /end AXIS_PTS
/begin MEASUREMENT drv1_er "Engine roughness dynamic component" SLONG _CNV_P_3_ENRD_LINEA_I_387_CM 1 100. -512000000. 511999999.7 DISPLAY_IDENTIFIER DRV1_ER ECU_ADDRESS 0xd0005f6c FORMAT "%13.7" /end MEASUREMENT
/begin MEASUREMENT drv2_er "Engine roughness curvature component" SLONG _CNV_P_3_ENRD_LINEA_I_387_CM 1 100. -512000000. 511999999.7 DISPLAY_IDENTIFIER DRV2_ER ECU_ADDRESS 0xd00024b0 FORMAT "%13.7" /end MEASUREMENT
/begin MEASUREMENT drv2_mmv_er "Averaged engine roughness curvature component" SLONG _CNV_P_3_ENRD_LINEA_I_387_CM 1 100. -512000000. 511999999.7 DISPLAY_IDENTIFIER DRV2_MMV_ER ECU_ADDRESS 0xd00024b4 FORMAT "%13.7" /end MEASUREMENT
/begin MEASUREMENT er_raw "Engine roughness without curvature component" SLONG _CNV_P_3_ENRD_LINEA_I_387_CM 1 100. -512000000. 511999999.7 DISPLAY_IDENTIFIER ER_RAW ECU_ADDRESS 0xd0005ef8 FORMAT "%13.7" /end MEASUREMENT
/begin MEASUREMENT er "Engine roughness" SLONG _CNV_P_3_ENRD_LINEA_I_387_CM 1 100. -512000000. 511999999.7 DISPLAY_IDENTIFIER ER ECU_ADDRESS 0xd0005f70 FORMAT "%13.7" /end MEASUREMENT
/begin MEASUREMENT er_stnd "Normalized engine roughness" SLONG _CNV_P_3_ENRD_LINEA_I_387_CM 1 100. -512000000. 511999999.7 DISPLAY_IDENTIFIER ER_STND ECU_ADDRESS 0xd0005f74 FORMAT "%13.7" /end MEASUREMENT
/begin MEASUREMENT er_stnd_cyl[0] "Cylinder normalized engine roughness values" SLONG _CNV_P_3_ENRD_LINEA_I_387_CM 1 100. -512000000. 511999999.7 DISPLAY_IDENTIFIER ER_STND_CYL[0] ECU_ADDRESS 0xd00024d8 FORMAT "%13.7" /end MEASUREMENT
/begin MEASUREMENT er_stnd_cyl[1] "Cylinder normalized engine roughness values" SLONG _CNV_P_3_ENRD_LINEA_I_387_CM 1 100. -512000000. 511999999.7 DISPLAY_IDENTIFIER ER_STND_CYL[1] ECU_ADDRESS 0xd00024dc FORMAT "%13.7" /end MEASUREMENT
/begin MEASUREMENT er_stnd_cyl[2] "Cylinder normalized engine roughness values" SLONG _CNV_P_3_ENRD_LINEA_I_387_CM 1 100. -512000000. 511999999.7 DISPLAY_IDENTIFIER ER_STND_CYL[2] ECU_ADDRESS 0xd00024e0 FORMAT "%13.7" /end MEASUREMENT
/begin MEASUREMENT er_stnd_cyl[3] "Cylinder normalized engine roughness values" SLONG _CNV_P_3_ENRD_LINEA_I_387_CM 1 100. -512000000. 511999999.7 DISPLAY_IDENTIFIER ER_STND_CYL[3] ECU_ADDRESS 0xd00024e4 FORMAT "%13.7" /end MEASUREMENT
/begin MEASUREMENT er_stnd_cyl[4] "Cylinder normalized engine roughness values" SLONG _CNV_P_3_ENRD_LINEA_I_387_CM 1 100. -512000000. 511999999.7 DISPLAY_IDENTIFIER ER_STND_CYL[4] ECU_ADDRESS 0xd00024e8 FORMAT "%13.7" /end MEASUREMENT
/begin MEASUREMENT er_stnd_cyl[5] "Cylinder normalized engine roughness values" SLONG _CNV_P_3_ENRD_LINEA_I_387_CM 1 100. -512000000. 511999999.7 DISPLAY_IDENTIFIER ER_STND_CYL[5] ECU_ADDRESS 0xd00024ec FORMAT "%13.7" /end MEASUREMENT
/begin MEASUREMENT er_stnd_cyl[6] "Cylinder normalized engine roughness values" SLONG _CNV_P_3_ENRD_LINEA_I_387_CM 1 100. -512000000. 511999999.7 DISPLAY_IDENTIFIER ER_STND_CYL[6] ECU_ADDRESS 0xd00024f0 FORMAT "%13.7" /end MEASUREMENT
/begin MEASUREMENT er_stnd_cyl[7] "Cylinder normalized engine roughness values" SLONG _CNV_P_3_ENRD_LINEA_I_387_CM 1 100. -512000000. 511999999.7 DISPLAY_IDENTIFIER ER_STND_CYL[7] ECU_ADDRESS 0xd00024f4 FORMAT "%13.7" /end MEASUREMENT
/begin CHARACTERISTIC c_fac_sca_er_stnd "Scaling factor used for normalized engine roughness calculation" VALUE 0xa0801d32 _REC_VAL_20_s1 255. _CNV_A_R_LINEAR_____0_CM -128. 127. DISPLAY_IDENTIFIER C_FAC_SCA_ER_STND FORMAT "%5.2" /end CHARACTERISTIC
/begin CHARACTERISTIC c_n_max_er_stnd "Maximum engine speed to compute normalised engine roughness" VALUE 0xa0801d3a _REC_VAL_20_u2 8160. _CNV_A_R_LINEAR_____14_CM 0. 8160. DISPLAY_IDENTIFIER C_N_MAX_ER_STND FORMAT "%4.0" /end CHARACTERISTIC
/begin MEASUREMENT er_cyl[0] "Cylinder Engine roughness values" SLONG _CNV_P_3_ENRD_LINEA_I_387_CM 1 100. -512000000. 511999999.7 DISPLAY_IDENTIFIER ER_CYL[0] ECU_ADDRESS 0xd00024b8 FORMAT "%13.7" /end MEASUREMENT
/begin MEASUREMENT er_cyl[1] "Cylinder Engine roughness values" SLONG _CNV_P_3_ENRD_LINEA_I_387_CM 1 100. -512000000. 511999999.7 DISPLAY_IDENTIFIER ER_CYL[1] ECU_ADDRESS 0xd00024bc FORMAT "%13.7" /end MEASUREMENT
/begin MEASUREMENT er_cyl[2] "Cylinder Engine roughness values" SLONG _CNV_P_3_ENRD_LINEA_I_387_CM 1 100. -512000000. 511999999.7 DISPLAY_IDENTIFIER ER_CYL[2] ECU_ADDRESS 0xd00024c0 FORMAT "%13.7" /end MEASUREMENT
/begin MEASUREMENT er_cyl[3] "Cylinder Engine roughness values" SLONG _CNV_P_3_ENRD_LINEA_I_387_CM 1 100. -512000000. 511999999.7 DISPLAY_IDENTIFIER ER_CYL[3] ECU_ADDRESS 0xd00024c4 FORMAT "%13.7" /end MEASUREMENT
/begin MEASUREMENT er_cyl[4] "Cylinder Engine roughness values" SLONG _CNV_P_3_ENRD_LINEA_I_387_CM 1 100. -512000000. 511999999.7 DISPLAY_IDENTIFIER ER_CYL[4] ECU_ADDRESS 0xd00024c8 FORMAT "%13.7" /end MEASUREMENT
/begin MEASUREMENT er_cyl[5] "Cylinder Engine roughness values" SLONG _CNV_P_3_ENRD_LINEA_I_387_CM 1 100. -512000000. 511999999.7 DISPLAY_IDENTIFIER ER_CYL[5] ECU_ADDRESS 0xd00024cc FORMAT "%13.7" /end MEASUREMENT
/begin MEASUREMENT er_cyl[6] "Cylinder Engine roughness values" SLONG _CNV_P_3_ENRD_LINEA_I_387_CM 1 100. -512000000. 511999999.7 DISPLAY_IDENTIFIER ER_CYL[6] ECU_ADDRESS 0xd00024d0 FORMAT "%13.7" /end MEASUREMENT
/begin MEASUREMENT er_cyl[7] "Cylinder Engine roughness values" SLONG _CNV_P_3_ENRD_LINEA_I_387_CM 1 100. -512000000. 511999999.7 DISPLAY_IDENTIFIER ER_CYL[7] ECU_ADDRESS 0xd00024d4 FORMAT "%13.7" /end MEASUREMENT
/begin CHARACTERISTIC ip_fac_gain_er_at_0 "ER cylinder 0 multiplicative segment dependent factor for torsion correction with AT" CURVE 0xa0801e60 _REC_CUR_20_u2_u1 1.99609375 _CNV_A_R_LINEAR_____28_CM 0. 1.99609375 DISPLAY_IDENTIFIER IP_FAC_GAIN_ER_AT_0 FORMAT "%5.3"
 /begin AXIS_DESCR COM_AXIS n_32 _CNV_A_R_LINEAR_____10_CM 6 0. 8160. FORMAT "%4.0" AXIS_PTS_REF ldpm_n_32_4_enrd /end AXIS_DESCR
/end CHARACTERISTIC
/begin CHARACTERISTIC ip_fac_gain_er_at_1 "ER cylinder 1 multiplicative segment dependent factor for torsion correction with AT" CURVE 0xa0801e6c _REC_CUR_20_u2_u1 1.99609375 _CNV_A_R_LINEAR_____28_CM 0. 1.99609375 DISPLAY_IDENTIFIER IP_FAC_GAIN_ER_AT_1 FORMAT "%5.3"
 /begin AXIS_DESCR COM_AXIS n_32 _CNV_A_R_LINEAR_____10_CM 6 0. 8160. FORMAT "%4.0" AXIS_PTS_REF ldpm_n_32_4_enrd /end AXIS_DESCR
/end CHARACTERISTIC
/begin CHARACTERISTIC ip_fac_gain_er_at_2 "ER cylinder 2 multiplicative segment dependent factor for torsion correction with AT" CURVE 0xa0801e78 _REC_CUR_20_u2_u1 1.99609375 _CNV_A_R_LINEAR_____28_CM 0. 1.99609375 DISPLAY_IDENTIFIER IP_FAC_GAIN_ER_AT_2 FORMAT "%5.3"
 /begin AXIS_DESCR COM_AXIS n_32 _CNV_A_R_LINEAR_____10_CM 6 0. 8160. FORMAT "%4.0" AXIS_PTS_REF ldpm_n_32_4_enrd /end AXIS_DESCR
/end CHARACTERISTIC
/begin CHARACTERISTIC ip_fac_gain_er_at_6 "ER cylinder 6 multiplicative segment dependent factor for torsion correction with AT" CURVE 0xa0802030 _REC_CUR_20_u2_u1 1.99609375 _CNV_A_R_LINEAR_____28_CM 0. 1.99609375 DISPLAY_IDENTIFIER IP_FAC_GAIN_ER_AT_6 FORMAT "%5.3"
 /begin AXIS_DESCR COM_AXIS n_32 _CNV_A_R_LINEAR_____10_CM 6 0. 8160. FORMAT "%4.0" AXIS_PTS_REF ldpm_n_32_4_enrd /end AXIS_DESCR
/end CHARACTERISTIC
/begin CHARACTERISTIC ip_fac_gain_er_at_3 "ER cylinder 3 multiplicative segment dependent factor for torsion correction with AT" CURVE 0xa0801ee8 _REC_CUR_20_u2_u1 1.99609375 _CNV_A_R_LINEAR_____28_CM 0. 1.99609375 DISPLAY_IDENTIFIER IP_FAC_GAIN_ER_AT_3 FORMAT "%5.3"
 /begin AXIS_DESCR COM_AXIS n_32 _CNV_A_R_LINEAR_____10_CM 6 0. 8160. FORMAT "%4.0" AXIS_PTS_REF ldpm_n_32_4_enrd /end AXIS_DESCR
/end CHARACTERISTIC
/begin CHARACTERISTIC ip_fac_gain_er_at_4 "ER cylinder 4 multiplicative segment dependent factor for torsion correction with AT" CURVE 0xa0801f40 _REC_CUR_20_u2_u1 1.99609375 _CNV_A_R_LINEAR_____28_CM 0. 1.99609375 DISPLAY_IDENTIFIER IP_FAC_GAIN_ER_AT_4 FORMAT "%5.3"
 /begin AXIS_DESCR COM_AXIS n_32 _CNV_A_R_LINEAR_____10_CM 6 0. 8160. FORMAT "%4.0" AXIS_PTS_REF ldpm_n_32_4_enrd /end AXIS_DESCR
/end CHARACTERISTIC
/begin CHARACTERISTIC ip_fac_gain_er_at_5 "ER cylinder 5 multiplicative segment dependent factor for torsion correction with AT" CURVE 0xa0801f98 _REC_CUR_20_u2_u1 1.99609375 _CNV_A_R_LINEAR_____28_CM 0. 1.99609375 DISPLAY_IDENTIFIER IP_FAC_GAIN_ER_AT_5 FORMAT "%5.3"
 /begin AXIS_DESCR COM_AXIS n_32 _CNV_A_R_LINEAR_____10_CM 6 0. 8160. FORMAT "%4.0" AXIS_PTS_REF ldpm_n_32_4_enrd /end AXIS_DESCR
/end CHARACTERISTIC
/begin CHARACTERISTIC ip_fac_add_er_mt_1 "ER cylinder 1 additive segment dependent factor for torsion correction with MT" MAP 0xa080df90 _REC_MAP_20_u4_u1_u2 3999999.7 _CNV_A_R_ENRD_LINEA_388_CM -2000000. 1999999.7 DISPLAY_IDENTIFIER IP_FAC_ADD_ER_MT_1 FORMAT "%13.7"
 /begin AXIS_DESCR COM_AXIS n_32 _CNV_A_R_LINEAR_____10_CM 6 0. 8160. FORMAT "%4.0" AXIS_PTS_REF ldpm_n_32_3_enrd /end AXIS_DESCR
 /begin AXIS_DESCR COM_AXIS load_mis _CNV_A_R_LINEAR_____212_CM 6 0. 99.9969482421875 FORMAT "%7.3" AXIS_PTS_REF ldp_load_ip_fac_add_er_mt_1 /end AXIS_DESCR
/end CHARACTERISTIC
/begin CHARACTERISTIC ip_fac_add_er_mt_2 "ER cylinder 2 additive segment dependent factor for torsion correction with MT" MAP 0xa080e020 _REC_MAP_20_u4_u1_u2 3999999.7 _CNV_A_R_ENRD_LINEA_388_CM -2000000. 1999999.7 DISPLAY_IDENTIFIER IP_FAC_ADD_ER_MT_2 FORMAT "%13.7"
 /begin AXIS_DESCR COM_AXIS n_32 _CNV_A_R_LINEAR_____10_CM 6 0. 8160. FORMAT "%4.0" AXIS_PTS_REF ldpm_n_32_3_enrd /end AXIS_DESCR
 /begin AXIS_DESCR COM_AXIS load_mis _CNV_A_R_LINEAR_____212_CM 6 0. 99.9969482421875 FORMAT "%7.3" AXIS_PTS_REF ldp_load_ip_fac_add_er_mt_2 /end AXIS_DESCR
/end CHARACTERISTIC
/begin CHARACTERISTIC ip_fac_add_er_mt_6 "ER cylinder 6 additive segment dependent factor for torsion correction with MT" MAP 0xa080e530 _REC_MAP_20_u4_u1_u2 3999999.7 _CNV_A_R_ENRD_LINEA_388_CM -2000000. 1999999.7 DISPLAY_IDENTIFIER IP_FAC_ADD_ER_MT_6 FORMAT "%13.7"
 /begin AXIS_DESCR COM_AXIS n_32 _CNV_A_R_LINEAR_____10_CM 6 0. 8160. FORMAT "%4.0" AXIS_PTS_REF ldpm_n_32_3_enrd /end AXIS_DESCR
 /begin AXIS_DESCR COM_AXIS load_mis _CNV_A_R_LINEAR_____212_CM 6 0. 99.9969482421875 FORMAT "%7.3" AXIS_PTS_REF ldp_load_ip_fac_add_er_mt_6 /end AXIS_DESCR
/end CHARACTERISTIC
/begin CHARACTERISTIC ip_fac_add_er_mt_4 "ER cylinder 4 additive segment dependent factor for torsion correction with MT" MAP 0xa080e260 _REC_MAP_20_u4_u1_u2 3999999.7 _CNV_A_R_ENRD_LINEA_388_CM -2000000. 1999999.7 DISPLAY_IDENTIFIER IP_FAC_ADD_ER_MT_4 FORMAT "%13.7"
 /begin AXIS_DESCR COM_AXIS n_32 _CNV_A_R_LINEAR_____10_CM 6 0. 8160. FORMAT "%4.0" AXIS_PTS_REF ldpm_n_32_3_enrd /end AXIS_DESCR
 /begin AXIS_DESCR COM_AXIS load_mis _CNV_A_R_LINEAR_____212_CM 6 0. 99.9969482421875 FORMAT "%7.3" AXIS_PTS_REF ldp_load_ip_fac_add_er_mt_4 /end AXIS_DESCR
/end CHARACTERISTIC
/begin CHARACTERISTIC ip_fac_add_er_mt_3 "ER cylinder 3 additive segment dependent factor for torsion correction with MT" MAP 0xa080e140 _REC_MAP_20_u4_u1_u2 3999999.7 _CNV_A_R_ENRD_LINEA_388_CM -2000000. 1999999.7 DISPLAY_IDENTIFIER IP_FAC_ADD_ER_MT_3 FORMAT "%13.7"
 /begin AXIS_DESCR COM_AXIS n_32 _CNV_A_R_LINEAR_____10_CM 6 0. 8160. FORMAT "%4.0" AXIS_PTS_REF ldpm_n_32_3_enrd /end AXIS_DESCR
 /begin AXIS_DESCR COM_AXIS load_mis _CNV_A_R_LINEAR_____212_CM 6 0. 99.9969482421875 FORMAT "%7.3" AXIS_PTS_REF ldp_load_ip_fac_add_er_mt_3 /end AXIS_DESCR
/end CHARACTERISTIC
/begin CHARACTERISTIC ip_fac_add_er_mt_7 "ER cylinder 7 additive segment dependent factor for torsion correction with MT" MAP 0xa080e5c0 _REC_MAP_20_u4_u1_u2 3999999.7 _CNV_A_R_ENRD_LINEA_388_CM -2000000. 1999999.7 DISPLAY_IDENTIFIER IP_FAC_ADD_ER_MT_7 FORMAT "%13.7"
 /begin AXIS_DESCR COM_AXIS n_32 _CNV_A_R_LINEAR_____10_CM 6 0. 8160. FORMAT "%4.0" AXIS_PTS_REF ldpm_n_32_3_enrd /end AXIS_DESCR
 /begin AXIS_DESCR COM_AXIS load_mis _CNV_A_R_LINEAR_____212_CM 6 0. 99.9969482421875 FORMAT "%7.3" AXIS_PTS_REF ldp_load_ip_fac_add_er_mt_7 /end AXIS_DESCR
/end CHARACTERISTIC
/begin CHARACTERISTIC ip_fac_add_er_mt_5 "ER cylinder 5 additive segment dependent factor for torsion correction with MT" MAP 0xa080e380 _REC_MAP_20_u4_u1_u2 3999999.7 _CNV_A_R_ENRD_LINEA_388_CM -2000000. 1999999.7 DISPLAY_IDENTIFIER IP_FAC_ADD_ER_MT_5 FORMAT "%13.7"
 /begin AXIS_DESCR COM_AXIS n_32 _CNV_A_R_LINEAR_____10_CM 6 0. 8160. FORMAT "%4.0" AXIS_PTS_REF ldpm_n_32_3_enrd /end AXIS_DESCR
 /begin AXIS_DESCR COM_AXIS load_mis _CNV_A_R_LINEAR_____212_CM 6 0. 99.9969482421875 FORMAT "%7.3" AXIS_PTS_REF ldp_load_ip_fac_add_er_mt_5 /end AXIS_DESCR
/end CHARACTERISTIC
/begin CHARACTERISTIC ip_fac_add_er_at_0 "ER cylinder 0 additive segment dependent factor for torsion correction with AT" MAP 0xa080dd50 _REC_MAP_20_u4_u1_u2 3999999.7 _CNV_A_R_ENRD_LINEA_388_CM -2000000. 1999999.7 DISPLAY_IDENTIFIER IP_FAC_ADD_ER_AT_0 FORMAT "%13.7"
 /begin AXIS_DESCR COM_AXIS n_32 _CNV_A_R_LINEAR_____10_CM 6 0. 8160. FORMAT "%4.0" AXIS_PTS_REF ldpm_n_32_5_enrd /end AXIS_DESCR
 /begin AXIS_DESCR COM_AXIS load_mis _CNV_A_R_LINEAR_____212_CM 6 0. 99.9969482421875 FORMAT "%7.3" AXIS_PTS_REF ldp_load_ip_fac_add_er_at_0 /end AXIS_DESCR
/end CHARACTERISTIC
/begin CHARACTERISTIC ip_fac_add_er_at_1 "ER cylinder 1 additive segment dependent factor for torsion correction with AT" MAP 0xa080dde0 _REC_MAP_20_u4_u1_u2 3999999.7 _CNV_A_R_ENRD_LINEA_388_CM -2000000. 1999999.7 DISPLAY_IDENTIFIER IP_FAC_ADD_ER_AT_1 FORMAT "%13.7"
 /begin AXIS_DESCR COM_AXIS n_32 _CNV_A_R_LINEAR_____10_CM 6 0. 8160. FORMAT "%4.0" AXIS_PTS_REF ldpm_n_32_5_enrd /end AXIS_DESCR
 /begin AXIS_DESCR COM_AXIS load_mis _CNV_A_R_LINEAR_____212_CM 6 0. 99.9969482421875 FORMAT "%7.3" AXIS_PTS_REF ldp_load_ip_fac_add_er_at_1 /end AXIS_DESCR
/end CHARACTERISTIC
/begin CHARACTERISTIC ip_fac_add_er_at_2 "ER cylinder 2 additive segment dependent factor for torsion correction with AT" MAP 0xa080de70 _REC_MAP_20_u4_u1_u2 3999999.7 _CNV_A_R_ENRD_LINEA_388_CM -2000000. 1999999.7 DISPLAY_IDENTIFIER IP_FAC_ADD_ER_AT_2 FORMAT "%13.7"
 /begin AXIS_DESCR COM_AXIS n_32 _CNV_A_R_LINEAR_____10_CM 6 0. 8160. FORMAT "%4.0" AXIS_PTS_REF ldpm_n_32_5_enrd /end AXIS_DESCR
 /begin AXIS_DESCR COM_AXIS load_mis _CNV_A_R_LINEAR_____212_CM 6 0. 99.9969482421875 FORMAT "%7.3" AXIS_PTS_REF ldp_load_ip_fac_add_er_at_2 /end AXIS_DESCR
/end CHARACTERISTIC
/begin CHARACTERISTIC ip_fac_add_er_at_6 "ER cylinder 6 additive segment dependent factor for torsion correction with AT" MAP 0xa080e410 _REC_MAP_20_u4_u1_u2 3999999.7 _CNV_A_R_ENRD_LINEA_388_CM -2000000. 1999999.7 DISPLAY_IDENTIFIER IP_FAC_ADD_ER_AT_6 FORMAT "%13.7"
 /begin AXIS_DESCR COM_AXIS n_32 _CNV_A_R_LINEAR_____10_CM 6 0. 8160. FORMAT "%4.0" AXIS_PTS_REF ldpm_n_32_5_enrd /end AXIS_DESCR
 /begin AXIS_DESCR COM_AXIS load_mis _CNV_A_R_LINEAR_____212_CM 6 0. 99.9969482421875 FORMAT "%7.3" AXIS_PTS_REF ldp_load_ip_fac_add_er_at_6 /end AXIS_DESCR
/end CHARACTERISTIC
/begin CHARACTERISTIC ip_fac_add_er_at_3 "ER cylinder 3 additive segment dependent factor for torsion correction with AT" MAP 0xa080e0b0 _REC_MAP_20_u4_u1_u2 3999999.7 _CNV_A_R_ENRD_LINEA_388_CM -2000000. 1999999.7 DISPLAY_IDENTIFIER IP_FAC_ADD_ER_AT_3 FORMAT "%13.7"
 /begin AXIS_DESCR COM_AXIS n_32 _CNV_A_R_LINEAR_____10_CM 6 0. 8160. FORMAT "%4.0" AXIS_PTS_REF ldpm_n_32_5_enrd /end AXIS_DESCR
 /begin AXIS_DESCR COM_AXIS load_mis _CNV_A_R_LINEAR_____212_CM 6 0. 99.9969482421875 FORMAT "%7.3" AXIS_PTS_REF ldp_load_ip_fac_add_er_at_3 /end AXIS_DESCR
/end CHARACTERISTIC
/begin CHARACTERISTIC ip_fac_add_er_at_4 "ER cylinder 4 additive segment dependet factor for torsion correction with AT" MAP 0xa080e1d0 _REC_MAP_20_u4_u1_u2 3999999.7 _CNV_A_R_ENRD_LINEA_388_CM -2000000. 1999999.7 DISPLAY_IDENTIFIER IP_FAC_ADD_ER_AT_4 FORMAT "%13.7"
 /begin AXIS_DESCR COM_AXIS n_32 _CNV_A_R_LINEAR_____10_CM 6 0. 8160. FORMAT "%4.0" AXIS_PTS_REF ldpm_n_32_5_enrd /end AXIS_DESCR
 /begin AXIS_DESCR COM_AXIS load_mis _CNV_A_R_LINEAR_____212_CM 6 0. 99.9969482421875 FORMAT "%7.3" AXIS_PTS_REF ldp_load_ip_fac_add_er_at_4 /end AXIS_DESCR
/end CHARACTERISTIC
/begin CHARACTERISTIC ip_fac_add_er_at_5 "ER cylinder 5 additive segment dependent factor for torsion correction with AT" MAP 0xa080e2f0 _REC_MAP_20_u4_u1_u2 3999999.7 _CNV_A_R_ENRD_LINEA_388_CM -2000000. 1999999.7 DISPLAY_IDENTIFIER IP_FAC_ADD_ER_AT_5 FORMAT "%13.7"
 /begin AXIS_DESCR COM_AXIS n_32 _CNV_A_R_LINEAR_____10_CM 6 0. 8160. FORMAT "%4.0" AXIS_PTS_REF ldpm_n_32_5_enrd /end AXIS_DESCR
 /begin AXIS_DESCR COM_AXIS load_mis _CNV_A_R_LINEAR_____212_CM 6 0. 99.9969482421875 FORMAT "%7.3" AXIS_PTS_REF ldp_load_ip_fac_add_er_at_5 /end AXIS_DESCR
/end CHARACTERISTIC
/begin CHARACTERISTIC c_seg_dly_er "Delay of ER segment reference" VALUE 0xa0801d56 _REC_VAL_20_u1 12. _CNV_A_R_LINEAR_____0_CM 0. 12. DISPLAY_IDENTIFIER C_SEG_DLY_ER FORMAT "%3.0" /end CHARACTERISTIC
/begin AXIS_PTS ldp_n_32_2_enrd_0 "" 0xa0801dfe n_32 _REC_AXS_20_u1 8160. _CNV_A_R_LINEAR_____10_CM 6 0. 8160. FORMAT "%4.0" /end AXIS_PTS
/begin AXIS_PTS ldp_n_32_2_enrd_1 "" 0xa0801e06 n_32 _REC_AXS_20_u1 8160. _CNV_A_R_LINEAR_____10_CM 6 0. 8160. FORMAT "%4.0" /end AXIS_PTS
/begin AXIS_PTS ldp_n_32_2_enrd_2 "" 0xa0801e0e n_32 _REC_AXS_20_u1 8160. _CNV_A_R_LINEAR_____10_CM 6 0. 8160. FORMAT "%4.0" /end AXIS_PTS
/begin AXIS_PTS ldp_n_32_2_enrd_3 "" 0xa0801ec6 n_32 _REC_AXS_20_u1 8160. _CNV_A_R_LINEAR_____10_CM 6 0. 8160. FORMAT "%4.0" /end AXIS_PTS
/begin AXIS_PTS ldp_n_32_2_enrd_4 "" 0xa0801f1e n_32 _REC_AXS_20_u1 8160. _CNV_A_R_LINEAR_____10_CM 6 0. 8160. FORMAT "%4.0" /end AXIS_PTS
/begin AXIS_PTS ldp_n_32_2_enrd_5 "" 0xa0801f76 n_32 _REC_AXS_20_u1 8160. _CNV_A_R_LINEAR_____10_CM 6 0. 8160. FORMAT "%4.0" /end AXIS_PTS
/begin AXIS_PTS ldp_n_32_2_enrd_6 "" 0xa0801fee n_32 _REC_AXS_20_u1 8160. _CNV_A_R_LINEAR_____10_CM 6 0. 8160. FORMAT "%4.0" /end AXIS_PTS
/begin AXIS_PTS ldp_n_32_3_enrd_1 "" 0xa0801e1e n_32 _REC_AXS_20_u1 8160. _CNV_A_R_LINEAR_____10_CM 6 0. 8160. FORMAT "%4.0" /end AXIS_PTS
/begin AXIS_PTS ldp_n_32_3_enrd_2 "" 0xa0801e26 n_32 _REC_AXS_20_u1 8160. _CNV_A_R_LINEAR_____10_CM 6 0. 8160. FORMAT "%4.0" /end AXIS_PTS
/begin AXIS_PTS ldp_n_32_3_enrd_3 "" 0xa0801ece n_32 _REC_AXS_20_u1 8160. _CNV_A_R_LINEAR_____10_CM 6 0. 8160. FORMAT "%4.0" /end AXIS_PTS
/begin AXIS_PTS ldp_n_32_3_enrd_4 "" 0xa0801f26 n_32 _REC_AXS_20_u1 8160. _CNV_A_R_LINEAR_____10_CM 6 0. 8160. FORMAT "%4.0" /end AXIS_PTS
/begin AXIS_PTS ldp_n_32_3_enrd_5 "" 0xa0801f7e n_32 _REC_AXS_20_u1 8160. _CNV_A_R_LINEAR_____10_CM 6 0. 8160. FORMAT "%4.0" /end AXIS_PTS
/begin AXIS_PTS ldp_n_32_3_enrd_6 "" 0xa0801ffe n_32 _REC_AXS_20_u1 8160. _CNV_A_R_LINEAR_____10_CM 6 0. 8160. FORMAT "%4.0" /end AXIS_PTS
/begin AXIS_PTS ldp_n_32_3_enrd_7 "" 0xa0802006 n_32 _REC_AXS_20_u1 8160. _CNV_A_R_LINEAR_____10_CM 6 0. 8160. FORMAT "%4.0" /end AXIS_PTS
/begin AXIS_PTS ldp_n_32_4_enrd_0 "" 0xa0801e2e n_32 _REC_AXS_20_u1 8160. _CNV_A_R_LINEAR_____10_CM 6 0. 8160. FORMAT "%4.0" /end AXIS_PTS
/begin AXIS_PTS ldp_n_32_4_enrd_1 "" 0xa0801e36 n_32 _REC_AXS_20_u1 8160. _CNV_A_R_LINEAR_____10_CM 6 0. 8160. FORMAT "%4.0" /end AXIS_PTS
/begin AXIS_PTS ldp_n_32_4_enrd_2 "" 0xa0801e3e n_32 _REC_AXS_20_u1 8160. _CNV_A_R_LINEAR_____10_CM 6 0. 8160. FORMAT "%4.0" /end AXIS_PTS
/begin AXIS_PTS ldp_n_32_4_enrd_3 "" 0xa0801ed6 n_32 _REC_AXS_20_u1 8160. _CNV_A_R_LINEAR_____10_CM 6 0. 8160. FORMAT "%4.0" /end AXIS_PTS
/begin AXIS_PTS ldp_n_32_4_enrd_4 "" 0xa0801f2e n_32 _REC_AXS_20_u1 8160. _CNV_A_R_LINEAR_____10_CM 6 0. 8160. FORMAT "%4.0" /end AXIS_PTS
/begin AXIS_PTS ldp_n_32_4_enrd_5 "" 0xa0801f86 n_32 _REC_AXS_20_u1 8160. _CNV_A_R_LINEAR_____10_CM 6 0. 8160. FORMAT "%4.0" /end AXIS_PTS
/begin AXIS_PTS ldp_n_32_4_enrd_6 "" 0xa080200e n_32 _REC_AXS_20_u1 8160. _CNV_A_R_LINEAR_____10_CM 6 0. 8160. FORMAT "%4.0" /end AXIS_PTS
/begin AXIS_PTS ldp_n_32_5_enrd_1 "" 0xa0801e4e n_32 _REC_AXS_20_u1 8160. _CNV_A_R_LINEAR_____10_CM 6 0. 8160. FORMAT "%4.0" /end AXIS_PTS
/begin AXIS_PTS ldp_n_32_5_enrd_2 "" 0xa0801e56 n_32 _REC_AXS_20_u1 8160. _CNV_A_R_LINEAR_____10_CM 6 0. 8160. FORMAT "%4.0" /end AXIS_PTS
/begin AXIS_PTS ldp_n_32_5_enrd_3 "" 0xa0801ede n_32 _REC_AXS_20_u1 8160. _CNV_A_R_LINEAR_____10_CM 6 0. 8160. FORMAT "%4.0" /end AXIS_PTS
/begin AXIS_PTS ldp_n_32_5_enrd_4 "" 0xa0801f36 n_32 _REC_AXS_20_u1 8160. _CNV_A_R_LINEAR_____10_CM 6 0. 8160. FORMAT "%4.0" /end AXIS_PTS
/begin AXIS_PTS ldp_n_32_5_enrd_5 "" 0xa0801f8e n_32 _REC_AXS_20_u1 8160. _CNV_A_R_LINEAR_____10_CM 6 0. 8160. FORMAT "%4.0" /end AXIS_PTS
/begin AXIS_PTS ldp_n_32_5_enrd_6 "" 0xa080201e n_32 _REC_AXS_20_u1 8160. _CNV_A_R_LINEAR_____10_CM 6 0. 8160. FORMAT "%4.0" /end AXIS_PTS
/begin AXIS_PTS ldp_n_32_5_enrd_7 "" 0xa0802026 n_32 _REC_AXS_20_u1 8160. _CNV_A_R_LINEAR_____10_CM 6 0. 8160. FORMAT "%4.0" /end AXIS_PTS
/begin AXIS_PTS ldp_n_32_5_enrd_0 "" 0xa0801e46 n_32 _REC_AXS_20_u1 8160. _CNV_A_R_LINEAR_____10_CM 6 0. 8160. FORMAT "%4.0" /end AXIS_PTS
/begin AXIS_PTS ldp_load_ip_fac_add_er_at_0 "" 0xa0801da0 load_mis _REC_AXS_20_u2 99.9969482421875 _CNV_A_R_LINEAR_____212_CM 6 0. 99.9969482421875 FORMAT "%7.3" /end AXIS_PTS
/begin AXIS_PTS ldp_n_32_3_enrd_0 "" 0xa0801e16 n_32 _REC_AXS_20_u1 8160. _CNV_A_R_LINEAR_____10_CM 6 0. 8160. FORMAT "%4.0" /end AXIS_PTS
/begin AXIS_PTS ldp_load_ip_fac_add_er_mt_0 "" 0xa0801dd0 load_mis _REC_AXS_20_u2 99.9969482421875 _CNV_A_R_LINEAR_____212_CM 6 0. 99.9969482421875 FORMAT "%7.3" /end AXIS_PTS
/begin CHARACTERISTIC ip_fac_add_er_at_7 "ER cylinder 7 additive segment dependent factor for torsion correction with AT" MAP 0xa080e4a0 _REC_MAP_20_u4_u1_u2 3999999.7 _CNV_A_R_ENRD_LINEA_388_CM -2000000. 1999999.7 DISPLAY_IDENTIFIER IP_FAC_ADD_ER_AT_7 FORMAT "%13.7"
 /begin AXIS_DESCR COM_AXIS n_32 _CNV_A_R_LINEAR_____10_CM 6 0. 8160. FORMAT "%4.0" AXIS_PTS_REF ldpm_n_32_5_enrd /end AXIS_DESCR
 /begin AXIS_DESCR COM_AXIS load_mis _CNV_A_R_LINEAR_____212_CM 6 0. 99.9969482421875 FORMAT "%7.3" AXIS_PTS_REF ldp_load_ip_fac_add_er_at_7 /end AXIS_DESCR
/end CHARACTERISTIC
/begin CHARACTERISTIC ip_fac_add_er_mt_0 "ER cylinder 0 additive segment dependent factor for torsion correction with MT" MAP 0xa080df00 _REC_MAP_20_u4_u1_u2 3999999.7 _CNV_A_R_ENRD_LINEA_388_CM -2000000. 1999999.7 DISPLAY_IDENTIFIER IP_FAC_ADD_ER_MT_0 FORMAT "%13.7"
 /begin AXIS_DESCR COM_AXIS n_32 _CNV_A_R_LINEAR_____10_CM 6 0. 8160. FORMAT "%4.0" AXIS_PTS_REF ldpm_n_32_3_enrd /end AXIS_DESCR
 /begin AXIS_DESCR COM_AXIS load_mis _CNV_A_R_LINEAR_____212_CM 6 0. 99.9969482421875 FORMAT "%7.3" AXIS_PTS_REF ldp_load_ip_fac_add_er_mt_0 /end AXIS_DESCR
/end CHARACTERISTIC
/begin AXIS_PTS ldp_n_32_4_enrd_7 "" 0xa0802016 n_32 _REC_AXS_20_u1 8160. _CNV_A_R_LINEAR_____10_CM 6 0. 8160. FORMAT "%4.0" /end AXIS_PTS
/begin CHARACTERISTIC ip_fac_gain_er_at_7 "ER cylinder 7 multiplicative segment dependent factor for torsion correction with AT" CURVE 0xa080203c _REC_CUR_20_u2_u1 1.99609375 _CNV_A_R_LINEAR_____28_CM 0. 1.99609375 DISPLAY_IDENTIFIER IP_FAC_GAIN_ER_AT_7 FORMAT "%5.3"
 /begin AXIS_DESCR COM_AXIS n_32 _CNV_A_R_LINEAR_____10_CM 6 0. 8160. FORMAT "%4.0" AXIS_PTS_REF ldpm_n_32_4_enrd /end AXIS_DESCR
/end CHARACTERISTIC
/begin CHARACTERISTIC ip_fac_gain_er_mt_7 "ER cylinder 7 multiplicative segment dependent factor for torsion correction with MT" CURVE 0xa0802054 _REC_CUR_20_u2_u1 1.99609375 _CNV_A_R_LINEAR_____28_CM 0. 1.99609375 DISPLAY_IDENTIFIER IP_FAC_GAIN_ER_MT_7 FORMAT "%5.3"
 /begin AXIS_DESCR COM_AXIS n_32 _CNV_A_R_LINEAR_____10_CM 6 0. 8160. FORMAT "%4.0" AXIS_PTS_REF ldpm_n_32_2_enrd /end AXIS_DESCR
/end CHARACTERISTIC
/begin AXIS_PTS ldp_n_32_2_enrd_7 "" 0xa0801ff6 n_32 _REC_AXS_20_u1 8160. _CNV_A_R_LINEAR_____10_CM 6 0. 8160. FORMAT "%4.0" /end AXIS_PTS
/begin MEASUREMENT lv_inh_app_er_ad "ER segment adaptive process inhibition flag relative application specific conditions" UBYTE _CNV_S_2_RANGE__0___1_CM 1 100. 0. 1. DISPLAY_IDENTIFIER LV_INH_APP_ER_AD ECU_ADDRESS 0xd0007484 BIT_MASK 0x1 /end MEASUREMENT
/begin MEASUREMENT lv_inh_obd_er_ad "ER segment adaptive process inhibition flag linked to OBD I errors" UBYTE _CNV_S_2_RANGE__0___1_CM 1 100. 0. 1. DISPLAY_IDENTIFIER LV_INH_OBD_ER_AD ECU_ADDRESS 0xd0007487 BIT_MASK 0x1 /end MEASUREMENT
/begin MEASUREMENT lv_seg_ad_rst_er_eol "EOL specific request to reset ER segment adaptive values" UBYTE _CNV_S_2_RANGE__0___1_CM 1 100. 0. 1. DISPLAY_IDENTIFIER LV_SEG_AD_RST_ER_EOL ECU_ADDRESS 0xd000748b BIT_MASK 0x1 /end MEASUREMENT
/begin CHARACTERISTIC lc_seg_ad_rst_ena_eol "Specific EOL request enable flag to reset ER segment adaptive values & learning process" VALUE 0xa0801d6d _REC_VAL_20_u1 1. _CNV_S_2_RANGE__0___1_CM 0. 1. DISPLAY_IDENTIFIER LC_SEG_AD_RST_ENA_EOL BIT_MASK 0x1 /end CHARACTERISTIC
/begin CHARACTERISTIC c_gr_inh_er_ad_at "Bitfield used to inhibit engine roughness adaptive according current AT gear ratio " VALUE 0xa0801d33 _REC_VAL_20_u1 255. _CNV_A_R_LINEAR_____0_CM 0. 255. DISPLAY_IDENTIFIER C_GR_INH_ER_AD_AT FORMAT "%3.0" /end CHARACTERISTIC
/begin CHARACTERISTIC c_gr_inh_er_ad_mt "Bitfield used to inhabit engine roughness adaptive according current MT gear ratio " VALUE 0xa0801d34 _REC_VAL_20_u1 255. _CNV_A_R_LINEAR_____0_CM 0. 255. DISPLAY_IDENTIFIER C_GR_INH_ER_AD_MT FORMAT "%3.0" /end CHARACTERISTIC
/begin MEASUREMENT lv_req_seg_ad_mmv_er_app "Flag indicating request to reload stored segment adaptive values" UBYTE _CNV_S_2_RANGE__0___1_CM 1 100. 0. 1. DISPLAY_IDENTIFIER LV_REQ_SEG_AD_MMV_ER_APP ECU_ADDRESS 0xd0007488 BIT_MASK 0x1 /end MEASUREMENT
/begin MEASUREMENT seg_ad_mmv_er_app[0] "ER filtered adaptive values used for reload (for each segment) if segment adaptive process not valid" SWORD _CNV_A_R_ENRD_LINEA_381_CM 1 100. -7.8125 7.8123 DISPLAY_IDENTIFIER SEG_AD_MMV_ER_APP[0] ECU_ADDRESS 0xd0006624 FORMAT "%7.4" /end MEASUREMENT
/begin MEASUREMENT seg_ad_mmv_er_app[1] "ER filtered adaptive values used for reload (for each segment) if segment adaptive process not valid" SWORD _CNV_A_R_ENRD_LINEA_381_CM 1 100. -7.8125 7.8123 DISPLAY_IDENTIFIER SEG_AD_MMV_ER_APP[1] ECU_ADDRESS 0xd0006626 FORMAT "%7.4" /end MEASUREMENT
/begin MEASUREMENT seg_ad_mmv_er_app[2] "ER filtered adaptive values used for reload (for each segment) if segment adaptive process not valid" SWORD _CNV_A_R_ENRD_LINEA_381_CM 1 100. -7.8125 7.8123 DISPLAY_IDENTIFIER SEG_AD_MMV_ER_APP[2] ECU_ADDRESS 0xd0006628 FORMAT "%7.4" /end MEASUREMENT
/begin MEASUREMENT seg_ad_mmv_er_app[3] "ER filtered adaptive values used for reload (for each segment) if segment adaptive process not valid" SWORD _CNV_A_R_ENRD_LINEA_381_CM 1 100. -7.8125 7.8123 DISPLAY_IDENTIFIER SEG_AD_MMV_ER_APP[3] ECU_ADDRESS 0xd000662a FORMAT "%7.4" /end MEASUREMENT
/begin MEASUREMENT seg_ad_mmv_er_app[4] "ER filtered adaptive values used for reload (for each segment) if segment adaptive process not valid" SWORD _CNV_A_R_ENRD_LINEA_381_CM 1 100. -7.8125 7.8123 DISPLAY_IDENTIFIER SEG_AD_MMV_ER_APP[4] ECU_ADDRESS 0xd000662c FORMAT "%7.4" /end MEASUREMENT
/begin MEASUREMENT seg_ad_mmv_er_app[5] "ER filtered adaptive values used for reload (for each segment) if segment adaptive process not valid" SWORD _CNV_A_R_ENRD_LINEA_381_CM 1 100. -7.8125 7.8123 DISPLAY_IDENTIFIER SEG_AD_MMV_ER_APP[5] ECU_ADDRESS 0xd000662e FORMAT "%7.4" /end MEASUREMENT
/begin MEASUREMENT seg_ad_mmv_er_app[6] "ER filtered adaptive values used for reload (for each segment) if segment adaptive process not valid" SWORD _CNV_A_R_ENRD_LINEA_381_CM 1 100. -7.8125 7.8123 DISPLAY_IDENTIFIER SEG_AD_MMV_ER_APP[6] ECU_ADDRESS 0xd0006630 FORMAT "%7.4" /end MEASUREMENT
/begin MEASUREMENT seg_ad_mmv_er_app[7] "ER filtered adaptive values used for reload (for each segment) if segment adaptive process not valid" SWORD _CNV_A_R_ENRD_LINEA_381_CM 1 100. -7.8125 7.8123 DISPLAY_IDENTIFIER SEG_AD_MMV_ER_APP[7] ECU_ADDRESS 0xd0006632 FORMAT "%7.4" /end MEASUREMENT
/begin MEASUREMENT er_av_quo "Quotient ofER/ZHD_ER (to simply calibration and testing)" UBYTE _CNV_A_R_EGCP_LINEA_354_CM 1 100. 0. 2.55 DISPLAY_IDENTIFIER ER_AV_QUO ECU_ADDRESS 0xd0007481 /end MEASUREMENT
/begin MEASUREMENT crlc_drv2_er "Correlation factor for engine roughness curvature component calculation" UBYTE _CNV_A_R_LINEAR_____28_CM 1 100. 0. 0.99609375 DISPLAY_IDENTIFIER CRLC_DRV2_ER ECU_ADDRESS 0xd0007480 FORMAT "%5.3" /end MEASUREMENT
/begin MEASUREMENT fac_drv2_er "Weighting factor for engine roughness curvative component calculation (correction amount)" UWORD _CNV_A_R_ENRD_LINEA_389_CM 1 100. 0. 4. DISPLAY_IDENTIFIER FAC_DRV2_ER ECU_ADDRESS 0xd0006610 FORMAT "%6.5" /end MEASUREMENT
/begin CHARACTERISTIC c_crlc_drv2_zdly_er "Correlation factor for engine roughness curvature component calculation after start" VALUE 0xa0801d20 _REC_VAL_20_u1 0.99609375 _CNV_A_R_LINEAR_____28_CM 0. 0.99609375 DISPLAY_IDENTIFIER C_CRLC_DRV2_ZDLY_ER FORMAT "%5.3" /end CHARACTERISTIC
/begin CHARACTERISTIC c_t_drv2_zdly_er "Delay for specific curvative component calculation during after start" VALUE 0xa0801d62 _REC_VAL_20_u2 655.35 _CNV_A_R_LINEAR_____3_CM 0. 655.35 DISPLAY_IDENTIFIER C_T_DRV2_ZDLY_ER FORMAT "%6.2" /end CHARACTERISTIC
/begin CHARACTERISTIC c_n_32_max_drv2_er_is "Maximum engine speed to apply DRV2 specific weighting factor in idle speed" VALUE 0xa0801d36 _REC_VAL_20_u1 8160. _CNV_A_R_LINEAR_____10_CM 0. 8160. DISPLAY_IDENTIFIER C_N_32_MAX_DRV2_ER_IS FORMAT "%4.0" /end CHARACTERISTIC
/begin AXIS_PTS ldp_n_32_ip_fac_n_drv2_er_at "" 0xa0801bae n_32 _REC_AXS_20_u1 8160. _CNV_A_R_LINEAR_____10_CM 6 0. 8160. FORMAT "%4.0" /end AXIS_PTS
/begin AXIS_PTS ldp_load_mis_ip_fac_drv2_er_at "" 0xa0801b60 load_mis _REC_AXS_20_u2 99.9969482421875 _CNV_A_R_LINEAR_____212_CM 4 0. 99.9969482421875 FORMAT "%7.3" /end AXIS_PTS
/begin CHARACTERISTIC ip_fac_drv2_er_at "Weighting factor for DRV2 component calculation  - AT vehicle" MAP 0xa0801c38 _REC_MAP_20_u2_u1_u2 4. _CNV_A_R_ENRD_LINEA_389_CM 0. 4. DISPLAY_IDENTIFIER IP_FAC_DRV2_ER_AT FORMAT "%6.5"
 /begin AXIS_DESCR COM_AXIS n_32 _CNV_A_R_LINEAR_____10_CM 6 0. 8160. FORMAT "%4.0" AXIS_PTS_REF ldp_n_32_ip_fac_n_drv2_er_at /end AXIS_DESCR
 /begin AXIS_DESCR COM_AXIS load_mis _CNV_A_R_LINEAR_____212_CM 4 0. 99.9969482421875 FORMAT "%7.3" AXIS_PTS_REF ldp_load_mis_ip_fac_drv2_er_at /end AXIS_DESCR
/end CHARACTERISTIC
/begin AXIS_PTS ldp_n_ip_fac_n_drv2_er_is_at "" 0xa0801bc0 n _REC_AXS_20_u2 8160. _CNV_A_R_LINEAR_____14_CM 4 0. 8160. FORMAT "%4.0" /end AXIS_PTS
/begin AXIS_PTS ldp_load_ip_fac_drv2_er_is_at "" 0xa0801b48 load_mis _REC_AXS_20_u2 99.9969482421875 _CNV_A_R_LINEAR_____212_CM 4 0. 99.9969482421875 FORMAT "%7.3" /end AXIS_PTS
/begin CHARACTERISTIC ip_fac_drv2_er_is_at "Weighting factor for DRV2 component calculation - AT vehicle in idle speed" MAP 0xa0801c68 _REC_MAP_20_u2_u2_u2 4. _CNV_A_R_ENRD_LINEA_389_CM 0. 4. DISPLAY_IDENTIFIER IP_FAC_DRV2_ER_IS_AT FORMAT "%6.5"
 /begin AXIS_DESCR COM_AXIS n _CNV_A_R_LINEAR_____14_CM 4 0. 8160. FORMAT "%4.0" AXIS_PTS_REF ldp_n_ip_fac_n_drv2_er_is_at /end AXIS_DESCR
 /begin AXIS_DESCR COM_AXIS load_mis _CNV_A_R_LINEAR_____212_CM 4 0. 99.9969482421875 FORMAT "%7.3" AXIS_PTS_REF ldp_load_ip_fac_drv2_er_is_at /end AXIS_DESCR
/end CHARACTERISTIC
/begin AXIS_PTS ldp_n_32_ip_crlc_drv2_er_at "" 0xa0801b98 n_32 _REC_AXS_20_u1 8160. _CNV_A_R_LINEAR_____10_CM 9 0. 8160. FORMAT "%4.0" /end AXIS_PTS
/begin CHARACTERISTIC ip_crlc_drv2_er_at "Correlation factor for engine roughness curvature component calculation (correction duration) - AT vehicle" CURVE 0xa0801c20 _REC_CUR_20_u1_u1 0.99609375 _CNV_A_R_LINEAR_____28_CM 0. 0.99609375 DISPLAY_IDENTIFIER IP_CRLC_DRV2_ER_AT FORMAT "%5.3"
 /begin AXIS_DESCR COM_AXIS n_32 _CNV_A_R_LINEAR_____10_CM 9 0. 8160. FORMAT "%4.0" AXIS_PTS_REF ldp_n_32_ip_crlc_drv2_er_at /end AXIS_DESCR
/end CHARACTERISTIC
/begin AXIS_PTS ldp_n_32_ip_fac_n_drv2_er_mt "" 0xa0801bb6 n_32 _REC_AXS_20_u1 8160. _CNV_A_R_LINEAR_____10_CM 6 0. 8160. FORMAT "%4.0" /end AXIS_PTS
/begin AXIS_PTS ldp_load_mis_ip_fac_drv2_er_mt "" 0xa0801b6c load_mis _REC_AXS_20_u2 99.9969482421875 _CNV_A_R_LINEAR_____212_CM 4 0. 99.9969482421875 FORMAT "%7.3" /end AXIS_PTS
/begin CHARACTERISTIC ip_fac_drv2_er_mt "Weighting factor for DRV2 component calculation  - MT vehicle" MAP 0xa0801ca8 _REC_MAP_20_u2_u1_u2 4. _CNV_A_R_ENRD_LINEA_389_CM 0. 4. DISPLAY_IDENTIFIER IP_FAC_DRV2_ER_MT FORMAT "%6.5"
 /begin AXIS_DESCR COM_AXIS n_32 _CNV_A_R_LINEAR_____10_CM 6 0. 8160. FORMAT "%4.0" AXIS_PTS_REF ldp_n_32_ip_fac_n_drv2_er_mt /end AXIS_DESCR
 /begin AXIS_DESCR COM_AXIS load_mis _CNV_A_R_LINEAR_____212_CM 4 0. 99.9969482421875 FORMAT "%7.3" AXIS_PTS_REF ldp_load_mis_ip_fac_drv2_er_mt /end AXIS_DESCR
/end CHARACTERISTIC
/begin AXIS_PTS ldp_n_ip_fac_n_drv2_er_is_mt "" 0xa0801bcc n _REC_AXS_20_u2 8160. _CNV_A_R_LINEAR_____14_CM 4 0. 8160. FORMAT "%4.0" /end AXIS_PTS
/begin AXIS_PTS ldp_load_ip_fac_drv2_er_is_mt "" 0xa0801b54 load_mis _REC_AXS_20_u2 99.9969482421875 _CNV_A_R_LINEAR_____212_CM 4 0. 99.9969482421875 FORMAT "%7.3" /end AXIS_PTS
/begin CHARACTERISTIC ip_fac_drv2_er_is_mt "Weighting factor for DRV2 component calculation  - MT vehicle in idle speed" MAP 0xa0801c88 _REC_MAP_20_u2_u2_u2 4. _CNV_A_R_ENRD_LINEA_389_CM 0. 4. DISPLAY_IDENTIFIER IP_FAC_DRV2_ER_IS_MT FORMAT "%6.5"
 /begin AXIS_DESCR COM_AXIS n _CNV_A_R_LINEAR_____14_CM 4 0. 8160. FORMAT "%4.0" AXIS_PTS_REF ldp_n_ip_fac_n_drv2_er_is_mt /end AXIS_DESCR
 /begin AXIS_DESCR COM_AXIS load_mis _CNV_A_R_LINEAR_____212_CM 4 0. 99.9969482421875 FORMAT "%7.3" AXIS_PTS_REF ldp_load_ip_fac_drv2_er_is_mt /end AXIS_DESCR
/end CHARACTERISTIC
/begin AXIS_PTS ldp_n_32_ip_crlc_drv2_er_mt "" 0xa0801ba4 n_32 _REC_AXS_20_u1 8160. _CNV_A_R_LINEAR_____10_CM 9 0. 8160. FORMAT "%4.0" /end AXIS_PTS
/begin CHARACTERISTIC ip_crlc_drv2_er_mt "Correlation factor for engine roughness curvature component calculation (correction duration) - MT vehicle" CURVE 0xa0801c2c _REC_CUR_20_u1_u1 0.99609375 _CNV_A_R_LINEAR_____28_CM 0. 0.99609375 DISPLAY_IDENTIFIER IP_CRLC_DRV2_ER_MT FORMAT "%5.3"
 /begin AXIS_DESCR COM_AXIS n_32 _CNV_A_R_LINEAR_____10_CM 9 0. 8160. FORMAT "%4.0" AXIS_PTS_REF ldp_n_32_ip_crlc_drv2_er_mt /end AXIS_DESCR
/end CHARACTERISTIC
/begin AXIS_PTS ldp_tco_ip_fac_drv2_zdly_er "" 0xa0801bd6 tco _REC_AXS_20_u1 190.5 _CNV_A_R_LINEAR_____17_CM 6 -48. 142.5 FORMAT "%6.2" /end AXIS_PTS
/begin CHARACTERISTIC ip_fac_drv2_zdly_er "Weighting factor for engine roughness curvative component calculation (correction amount) after start" CURVE 0xa0801cd8 _REC_CUR_20_u2_u1 4. _CNV_A_R_ENRD_LINEA_389_CM 0. 4. DISPLAY_IDENTIFIER IP_FAC_DRV2_ZDLY_ER FORMAT "%6.5"
 /begin AXIS_DESCR COM_AXIS tco _CNV_A_R_LINEAR_____17_CM 6 -48. 142.5 FORMAT "%6.2" AXIS_PTS_REF ldp_tco_ip_fac_drv2_zdly_er /end AXIS_DESCR
/end CHARACTERISTIC
/begin MEASUREMENT seg_ad_cor_er "ER segment adaptive values correction versus engine speed (for each segment)" SWORD _CNV_A_R_ENRD_LINEA_381_CM 1 100. -7.8125 7.8123 DISPLAY_IDENTIFIER SEG_AD_COR_ER ECU_ADDRESS 0xd000248a FORMAT "%7.4" /end MEASUREMENT
/begin MEASUREMENT seg_nr_mes "Phasing reference of ER segment acquisition" UBYTE _CNV_A_R_LINEAR_____0_CM 1 100. 0. 11. DISPLAY_IDENTIFIER SEG_NR_MES ECU_ADDRESS 0xd0007482 FORMAT "%3.0" /end MEASUREMENT
/begin MEASUREMENT seg_t_mes "Engine roughness raw segment time relative to former TDC" ULONG _CNV_A_R_ENRD_LINEA_384_CM 1 100. 0. 1999999.7 DISPLAY_IDENTIFIER SEG_T_MES ECU_ADDRESS 0xd00024f8 FORMAT "%10.6" /end MEASUREMENT
/begin CHARACTERISTIC c_seg_t_mes_max "ER maximum valid segment time" VALUE 0xa0801d58 _REC_VAL_20_u4 1999999.7 _CNV_A_R_ENRD_LINEA_384_CM 0. 1999999.7 DISPLAY_IDENTIFIER C_SEG_T_MES_MAX FORMAT "%10.6" /end CHARACTERISTIC
/begin CHARACTERISTIC c_seg_t_mes_min "ER minimum valid segment time" VALUE 0xa0801d5c _REC_VAL_20_u4 1999999.7 _CNV_A_R_ENRD_LINEA_384_CM 0. 1999999.7 DISPLAY_IDENTIFIER C_SEG_T_MES_MIN FORMAT "%10.6" /end CHARACTERISTIC
/begin MEASUREMENT seg_t_cor_buf[0] "ER corrected segment times buffer (after adaptation)" ULONG _CNV_A_R_ENRD_LINEA_384_CM 1 100. 0. 1999999.7 DISPLAY_IDENTIFIER SEG_T_COR_BUF[0] ECU_ADDRESS 0xd0005f20 FORMAT "%10.6" /end MEASUREMENT
/begin MEASUREMENT seg_t_cor_buf[1] "ER corrected segment times buffer (after adaptation)" ULONG _CNV_A_R_ENRD_LINEA_384_CM 1 100. 0. 1999999.7 DISPLAY_IDENTIFIER SEG_T_COR_BUF[1] ECU_ADDRESS 0xd0005f24 FORMAT "%10.6" /end MEASUREMENT
/begin MEASUREMENT seg_t_cor_buf[2] "ER corrected segment times buffer (after adaptation)" ULONG _CNV_A_R_ENRD_LINEA_384_CM 1 100. 0. 1999999.7 DISPLAY_IDENTIFIER SEG_T_COR_BUF[2] ECU_ADDRESS 0xd0005f28 FORMAT "%10.6" /end MEASUREMENT
/begin MEASUREMENT seg_t_cor_buf[3] "ER corrected segment times buffer (after adaptation)" ULONG _CNV_A_R_ENRD_LINEA_384_CM 1 100. 0. 1999999.7 DISPLAY_IDENTIFIER SEG_T_COR_BUF[3] ECU_ADDRESS 0xd0005f2c FORMAT "%10.6" /end MEASUREMENT
/begin MEASUREMENT seg_t_cor_buf[4] "ER corrected segment times buffer (after adaptation)" ULONG _CNV_A_R_ENRD_LINEA_384_CM 1 100. 0. 1999999.7 DISPLAY_IDENTIFIER SEG_T_COR_BUF[4] ECU_ADDRESS 0xd0005f30 FORMAT "%10.6" /end MEASUREMENT
/begin MEASUREMENT seg_t_cor_buf[5] "ER corrected segment times buffer (after adaptation)" ULONG _CNV_A_R_ENRD_LINEA_384_CM 1 100. 0. 1999999.7 DISPLAY_IDENTIFIER SEG_T_COR_BUF[5] ECU_ADDRESS 0xd0005f34 FORMAT "%10.6" /end MEASUREMENT
/begin MEASUREMENT seg_t_cor_buf[6] "ER corrected segment times buffer (after adaptation)" ULONG _CNV_A_R_ENRD_LINEA_384_CM 1 100. 0. 1999999.7 DISPLAY_IDENTIFIER SEG_T_COR_BUF[6] ECU_ADDRESS 0xd0005f38 FORMAT "%10.6" /end MEASUREMENT
/begin MEASUREMENT seg_t_cor_buf[7] "ER corrected segment times buffer (after adaptation)" ULONG _CNV_A_R_ENRD_LINEA_384_CM 1 100. 0. 1999999.7 DISPLAY_IDENTIFIER SEG_T_COR_BUF[7] ECU_ADDRESS 0xd0005f3c FORMAT "%10.6" /end MEASUREMENT
/begin MEASUREMENT seg_t_cor_buf[8] "ER corrected segment times buffer (after adaptation)" ULONG _CNV_A_R_ENRD_LINEA_384_CM 1 100. 0. 1999999.7 DISPLAY_IDENTIFIER SEG_T_COR_BUF[8] ECU_ADDRESS 0xd0005f40 FORMAT "%10.6" /end MEASUREMENT
/begin MEASUREMENT seg_t_cor "Current ER corrected segment time" ULONG _CNV_A_R_ENRD_LINEA_384_CM 1 100. 0. 1999999.7 DISPLAY_IDENTIFIER SEG_T_COR ECU_ADDRESS 0xd0005f1c FORMAT "%10.6" /end MEASUREMENT
/begin MEASUREMENT lv_ena_seg_t_mes "Engine roughness segment time validity flag" UBYTE _CNV_S_2_RANGE__0___1_CM 1 100. 0. 1. DISPLAY_IDENTIFIER LV_ENA_SEG_T_MES ECU_ADDRESS 0xd000748d BIT_MASK 0x1 /end MEASUREMENT
/begin MEASUREMENT seg_t_mes_cyl[0] "Buffer of cylinder engine roughness raw segment times" ULONG _CNV_A_R_ENRD_LINEA_384_CM 1 100. 0. 1999999.7 DISPLAY_IDENTIFIER SEG_T_MES_CYL[0] ECU_ADDRESS 0xd0005f44 FORMAT "%10.6" /end MEASUREMENT
/begin MEASUREMENT seg_t_mes_cyl[1] "Buffer of cylinder engine roughness raw segment times" ULONG _CNV_A_R_ENRD_LINEA_384_CM 1 100. 0. 1999999.7 DISPLAY_IDENTIFIER SEG_T_MES_CYL[1] ECU_ADDRESS 0xd0005f48 FORMAT "%10.6" /end MEASUREMENT
/begin MEASUREMENT seg_t_mes_cyl[2] "Buffer of cylinder engine roughness raw segment times" ULONG _CNV_A_R_ENRD_LINEA_384_CM 1 100. 0. 1999999.7 DISPLAY_IDENTIFIER SEG_T_MES_CYL[2] ECU_ADDRESS 0xd0005f4c FORMAT "%10.6" /end MEASUREMENT
/begin MEASUREMENT seg_t_mes_cyl[3] "Buffer of cylinder engine roughness raw segment times" ULONG _CNV_A_R_ENRD_LINEA_384_CM 1 100. 0. 1999999.7 DISPLAY_IDENTIFIER SEG_T_MES_CYL[3] ECU_ADDRESS 0xd0005f50 FORMAT "%10.6" /end MEASUREMENT
/begin MEASUREMENT seg_t_mes_cyl[4] "Buffer of cylinder engine roughness raw segment times" ULONG _CNV_A_R_ENRD_LINEA_384_CM 1 100. 0. 1999999.7 DISPLAY_IDENTIFIER SEG_T_MES_CYL[4] ECU_ADDRESS 0xd0005f54 FORMAT "%10.6" /end MEASUREMENT
/begin MEASUREMENT seg_t_mes_cyl[5] "Buffer of cylinder engine roughness raw segment times" ULONG _CNV_A_R_ENRD_LINEA_384_CM 1 100. 0. 1999999.7 DISPLAY_IDENTIFIER SEG_T_MES_CYL[5] ECU_ADDRESS 0xd0005f58 FORMAT "%10.6" /end MEASUREMENT
/begin MEASUREMENT seg_t_mes_cyl[6] "Buffer of cylinder engine roughness raw segment times" ULONG _CNV_A_R_ENRD_LINEA_384_CM 1 100. 0. 1999999.7 DISPLAY_IDENTIFIER SEG_T_MES_CYL[6] ECU_ADDRESS 0xd0005f5c FORMAT "%10.6" /end MEASUREMENT
/begin MEASUREMENT seg_t_mes_cyl[7] "Buffer of cylinder engine roughness raw segment times" ULONG _CNV_A_R_ENRD_LINEA_384_CM 1 100. 0. 1999999.7 DISPLAY_IDENTIFIER SEG_T_MES_CYL[7] ECU_ADDRESS 0xd0005f60 FORMAT "%10.6" /end MEASUREMENT
/begin AXIS_PTS ldpm_n_32_6_enrd "" 0xa0801c16 n_32 _REC_AXS_20_u1 8160. _CNV_A_R_LINEAR_____10_CM 6 0. 8160. FORMAT "%4.0" /end AXIS_PTS
/begin CHARACTERISTIC ip_seg_ad_cor_er_mt_1 "Adaptive value correction versus engine speed in MT for segment 1" CURVE 0xa0801d08 _REC_CUR_20_u2_u1 15.6248 _CNV_A_R_ENRD_LINEA_390_CM -7.8125 7.8123 DISPLAY_IDENTIFIER IP_SEG_AD_COR_ER_MT_1 FORMAT "%7.4"
 /begin AXIS_DESCR COM_AXIS n_32 _CNV_A_R_LINEAR_____10_CM 6 0. 8160. FORMAT "%4.0" AXIS_PTS_REF ldpm_n_32_1_enrd /end AXIS_DESCR
/end CHARACTERISTIC
/begin CHARACTERISTIC ip_seg_ad_cor_er_at_1 "Adaptive value correction versus engine speed in AT for segment 1" CURVE 0xa0801cfc _REC_CUR_20_u2_u1 15.6248 _CNV_A_R_ENRD_LINEA_390_CM -7.8125 7.8123 DISPLAY_IDENTIFIER IP_SEG_AD_COR_ER_AT_1 FORMAT "%7.4"
 /begin AXIS_DESCR COM_AXIS n_32 _CNV_A_R_LINEAR_____10_CM 6 0. 8160. FORMAT "%4.0" AXIS_PTS_REF ldpm_n_32_6_enrd /end AXIS_DESCR
/end CHARACTERISTIC
/begin CHARACTERISTIC ip_seg_ad_cor_er_mt_2 "Adaptive value correction versus engine speed in MT for segment 2" CURVE 0xa0801d7c _REC_CUR_20_u2_u1 15.6248 _CNV_A_R_ENRD_LINEA_390_CM -7.8125 7.8123 DISPLAY_IDENTIFIER IP_SEG_AD_COR_ER_MT_2 FORMAT "%7.4"
 /begin AXIS_DESCR COM_AXIS n_32 _CNV_A_R_LINEAR_____10_CM 6 0. 8160. FORMAT "%4.0" AXIS_PTS_REF ldpm_n_32_1_enrd /end AXIS_DESCR
/end CHARACTERISTIC
/begin CHARACTERISTIC ip_seg_ad_cor_er_at_2 "Adaptive value correction versus engine speed in AT for segment 2" CURVE 0xa0801d70 _REC_CUR_20_u2_u1 15.6248 _CNV_A_R_ENRD_LINEA_390_CM -7.8125 7.8123 DISPLAY_IDENTIFIER IP_SEG_AD_COR_ER_AT_2 FORMAT "%7.4"
 /begin AXIS_DESCR COM_AXIS n_32 _CNV_A_R_LINEAR_____10_CM 6 0. 8160. FORMAT "%4.0" AXIS_PTS_REF ldpm_n_32_6_enrd /end AXIS_DESCR
/end CHARACTERISTIC
/begin CHARACTERISTIC ip_seg_ad_cor_er_mt_3 "Adaptive value correction versus engine speed in MT for segment 3" CURVE 0xa0801d94 _REC_CUR_20_u2_u1 15.6248 _CNV_A_R_ENRD_LINEA_390_CM -7.8125 7.8123 DISPLAY_IDENTIFIER IP_SEG_AD_COR_ER_MT_3 FORMAT "%7.4"
 /begin AXIS_DESCR COM_AXIS n_32 _CNV_A_R_LINEAR_____10_CM 6 0. 8160. FORMAT "%4.0" AXIS_PTS_REF ldpm_n_32_1_enrd /end AXIS_DESCR
/end CHARACTERISTIC
/begin CHARACTERISTIC ip_seg_ad_cor_er_at_3 "Adaptive value correction versus engine speed in AT for segment 3" CURVE 0xa0801d88 _REC_CUR_20_u2_u1 15.6248 _CNV_A_R_ENRD_LINEA_390_CM -7.8125 7.8123 DISPLAY_IDENTIFIER IP_SEG_AD_COR_ER_AT_3 FORMAT "%7.4"
 /begin AXIS_DESCR COM_AXIS n_32 _CNV_A_R_LINEAR_____10_CM 6 0. 8160. FORMAT "%4.0" AXIS_PTS_REF ldpm_n_32_6_enrd /end AXIS_DESCR
/end CHARACTERISTIC
/begin AXIS_PTS ldpm_n_32_1_enrd "" 0xa0801bee n_32 _REC_AXS_20_u1 8160. _CNV_A_R_LINEAR_____10_CM 6 0. 8160. FORMAT "%4.0" /end AXIS_PTS
/begin MEASUREMENT lv_err_t_seg_er "Present failure for segment time adaptive values" UBYTE _CNV_S_2_RANGE__0___1_CM 1 100. 0. 1. DISPLAY_IDENTIFIER LV_ERR_T_SEG_ER ECU_ADDRESS 0xd0007fd9 BIT_MASK 0x1 /end MEASUREMENT
/begin MEASUREMENT lv_err_seg_ad_er "Present failure for segment time adaptive values" UBYTE _CNV_S_2_RANGE__0___1_CM 1 100. 0. 1. DISPLAY_IDENTIFIER LV_ERR_SEG_AD_ER ECU_ADDRESS 0xd0007fda BIT_MASK 0x1 /end MEASUREMENT
/begin CHARACTERISTIC lc_cdn_diag_seg_ad_er "Diagnosis co,dition mode of ER segment time adaptive  values" VALUE 0xa0801d6a _REC_VAL_20_u1 1. _CNV_S_2_RANGE__0___1_CM 0. 1. DISPLAY_IDENTIFIER LC_CDN_DIAG_SEG_AD_ER BIT_MASK 0x1 /end CHARACTERISTIC
/begin CHARACTERISTIC c_abc_inc_seg_ad_er "Antibounce counter increment" VALUE 0xa0801d1a _REC_VAL_20_u1 255. _CNV_A_R_LINEAR_____0_CM 0. 255. DISPLAY_IDENTIFIER C_ABC_INC_SEG_AD_ER FORMAT "%3.0" /end CHARACTERISTIC
/begin CHARACTERISTIC c_abc_inc_t_seg_er "Antibounce counter increment" VALUE 0xa0801d1b _REC_VAL_20_u1 255. _CNV_A_R_LINEAR_____0_CM 0. 255. DISPLAY_IDENTIFIER C_ABC_INC_T_SEG_ER FORMAT "%3.0" /end CHARACTERISTIC
/begin CHARACTERISTIC c_abc_max_seg_ad_er "Maximum value of the antibounce counter" VALUE 0xa0801d1c _REC_VAL_20_u1 254. _CNV_A_R_LINEAR_____0_CM 1. 255. DISPLAY_IDENTIFIER C_ABC_MAX_SEG_AD_ER FORMAT "%3.0" /end CHARACTERISTIC
/begin CHARACTERISTIC c_abc_max_t_seg_er "Maximum value of the antibounce counter" VALUE 0xa0801d1d _REC_VAL_20_u1 254. _CNV_A_R_LINEAR_____0_CM 1. 255. DISPLAY_IDENTIFIER C_ABC_MAX_T_SEG_ER FORMAT "%3.0" /end CHARACTERISTIC
/begin AXIS_PTS ldpm_n_32_1_ensd "" 0xa080253c n_32 _REC_AXS_20_u1 8160. _CNV_A_R_LINEAR_____10_CM 16 0. 8160. FORMAT "%4.0" /end AXIS_PTS
/begin AXIS_PTS ldpm_n_32_2_ensd "" 0xa080254e n_32 _REC_AXS_20_u1 8160. _CNV_A_R_LINEAR_____10_CM 6 0. 8160. FORMAT "%4.0" /end AXIS_PTS
/begin MEASUREMENT lv_run_eng "Boolean information for engine running detection" UBYTE _CNV_S_2_RANGE__0___1_CM 1 100. 0. 1. DISPLAY_IDENTIFIER LV_RUN_ENG ECU_ADDRESS 0xd00074e4 BIT_MASK 0x1 /end MEASUREMENT
/begin MEASUREMENT lv_syn_eng "Boolean information for engine synchronization completed" UBYTE _CNV_S_2_RANGE__0___1_CM 1 100. 0. 1. DISPLAY_IDENTIFIER LV_SYN_ENG ECU_ADDRESS 0xd00074e7 BIT_MASK 0x1 /end MEASUREMENT
/begin MEASUREMENT lv_syn_vld "Boolean information for engine synchronization validated" UBYTE _CNV_S_2_RANGE__0___1_CM 1 100. 0. 1. DISPLAY_IDENTIFIER LV_SYN_VLD ECU_ADDRESS 0xd00074e8 BIT_MASK 0x1 /end MEASUREMENT
/begin MEASUREMENT lv_lih_err_crk "Boolean information for limp home mode with crankshaft sensor failure" UBYTE _CNV_S_2_RANGE__0___1_CM 1 100. 0. 1. DISPLAY_IDENTIFIER LV_LIH_ERR_CRK ECU_ADDRESS 0xd00074e0 BIT_MASK 0x1 /end MEASUREMENT
/begin MEASUREMENT lv_lih_err_cam "Camshaft limp-home mode (failure on all camshaft sensors)" UBYTE _CNV_S_2_RANGE__0___1_CM 1 100. 0. 1. DISPLAY_IDENTIFIER LV_LIH_ERR_CAM ECU_ADDRESS 0xd00025ca BIT_MASK 0x1 /end MEASUREMENT
/begin MEASUREMENT lv_act_crk "Crankshaft acquisition active" UBYTE _CNV_S_2_RANGE__0___1_CM 1 100. 0. 1. DISPLAY_IDENTIFIER LV_ACT_CRK ECU_ADDRESS 0xd00074c4 BIT_MASK 0x1 /end MEASUREMENT
/begin MEASUREMENT lv_err_lih_crk_cam "No more camshaft sensor available for crankshaft limp-home mode" UBYTE _CNV_S_2_RANGE__0___1_CM 1 100. 0. 1. DISPLAY_IDENTIFIER LV_ERR_LIH_CRK_CAM ECU_ADDRESS 0xd00025c9 BIT_MASK 0x1 /end MEASUREMENT
/begin MEASUREMENT ctr_vld_cam_syn_crk "Counter for validation of camshaft signal for crankshaft synchronization" UBYTE _CNV_A_R_LINEAR_____0_CM 1 100. 0. 255. DISPLAY_IDENTIFIER CTR_VLD_CAM_SYN_CRK ECU_ADDRESS 0xd00025c5 FORMAT "%3.0" /end MEASUREMENT
/begin CHARACTERISTIC lc_inh_lih_crk "Inhibition of crankshaft limp-home mode" VALUE 0xa08025b7 _REC_VAL_20_u1 1. _CNV_A_R_LINEAR_____0_CM 0. 1. DISPLAY_IDENTIFIER LC_INH_LIH_CRK FORMAT "%1.0" /end CHARACTERISTIC
/begin CHARACTERISTIC lc_inh_lih_cam "Inhibition of camshaft limp-home mode" VALUE 0xa08025b6 _REC_VAL_20_u1 1. _CNV_A_R_LINEAR_____0_CM 0. 1. DISPLAY_IDENTIFIER LC_INH_LIH_CAM FORMAT "%1.0" /end CHARACTERISTIC
/begin MEASUREMENT lv_first_vld_tooth "Boolean information for detection of first tooth after engine stop" UBYTE _CNV_S_2_RANGE__0___1_CM 1 100. 0. 1. DISPLAY_IDENTIFIER LV_FIRST_VLD_TOOTH ECU_ADDRESS 0xd00074d2 BIT_MASK 0x1 /end MEASUREMENT
/begin MEASUREMENT lv_timeout_cam_syn_crk "Boolean information for time-out detection on the camshaft selected for the CRK/CAM synchronization" UBYTE _CNV_S_2_RANGE__0___1_CM 1 100. 0. 1. DISPLAY_IDENTIFIER LV_TIMEOUT_CAM_SYN_CRK ECU_ADDRESS 0xd00074eb BIT_MASK 0x1 /end MEASUREMENT
/begin MEASUREMENT idx_n_ctl_ex[0].lv_act_cam "self synchronization activated on exhaust camshaft 1" UBYTE _CNV_S_2_RANGE__0___1_CM 1 100. 0. 1. DISPLAY_IDENTIFIER LV_ACT_CAM_EX_1 ECU_ADDRESS 0xd0007534 BIT_MASK 0x1 /end MEASUREMENT
/begin MEASUREMENT idx_n_ctl_ex[0].lv_act_lih_crk_cam "crankshaft limp home operating mode activated on exhaust camshaft 1" UBYTE _CNV_S_2_RANGE__0___1_CM 1 100. 0. 1. DISPLAY_IDENTIFIER LV_ACT_LIH_CRK_CAM_EX_1 ECU_ADDRESS 0xd0007535 BIT_MASK 0x1 /end MEASUREMENT
/begin MEASUREMENT idx_n_ctl_ex[0].lv_act_syn_crk_cam "crankshaft synchronization operating mode activated on exhaust camshaft 1" UBYTE _CNV_S_2_RANGE__0___1_CM 1 100. 0. 1. DISPLAY_IDENTIFIER LV_ACT_SYN_CRK_CAM_EX_1 ECU_ADDRESS 0xd0007536 BIT_MASK 0x1 /end MEASUREMENT
/begin MEASUREMENT idx_n_ctl_ex[1].lv_act_cam "self synchronization activated on exhaust camshaft 2" UBYTE _CNV_S_2_RANGE__0___1_CM 1 100. 0. 1. DISPLAY_IDENTIFIER LV_ACT_CAM_EX_2 ECU_ADDRESS 0xd0007538 BIT_MASK 0x1 /end MEASUREMENT
/begin MEASUREMENT idx_n_ctl_ex[1].lv_act_lih_crk_cam "crankshaft limp home operating mode activated on exhaust camshaft 2" UBYTE _CNV_S_2_RANGE__0___1_CM 1 100. 0. 1. DISPLAY_IDENTIFIER LV_ACT_LIH_CRK_CAM_EX_2 ECU_ADDRESS 0xd0007539 BIT_MASK 0x1 /end MEASUREMENT
/begin MEASUREMENT idx_n_ctl_ex[1].lv_act_syn_crk_cam "crankshaft synchronization operating mode activated on exhaust camshaft 2" UBYTE _CNV_S_2_RANGE__0___1_CM 1 100. 0. 1. DISPLAY_IDENTIFIER LV_ACT_SYN_CRK_CAM_EX_2 ECU_ADDRESS 0xd000753a BIT_MASK 0x1 /end MEASUREMENT
/begin MEASUREMENT idx_n_ctl_in[0].lv_act_cam "self synchronization activated on intake camshaft 1" UBYTE _CNV_S_2_RANGE__0___1_CM 1 100. 0. 1. DISPLAY_IDENTIFIER LV_ACT_CAM_IN_1 ECU_ADDRESS 0xd0007504 BIT_MASK 0x1 /end MEASUREMENT
/begin MEASUREMENT idx_n_ctl_in[0].lv_act_lih_crk_cam "crankshaft limp home operating mode activated on intake camshaft 1" UBYTE _CNV_S_2_RANGE__0___1_CM 1 100. 0. 1. DISPLAY_IDENTIFIER LV_ACT_LIH_CRK_CAM_IN_1 ECU_ADDRESS 0xd0007505 BIT_MASK 0x1 /end MEASUREMENT
/begin MEASUREMENT idx_n_ctl_in[0].lv_act_syn_crk_cam "crankshaft synchronization operating mode activated on intake camshaft 1" UBYTE _CNV_S_2_RANGE__0___1_CM 1 100. 0. 1. DISPLAY_IDENTIFIER LV_ACT_SYN_CRK_CAM_IN_1 ECU_ADDRESS 0xd0007506 BIT_MASK 0x1 /end MEASUREMENT
/begin MEASUREMENT idx_n_ctl_in[1].lv_act_cam "self synchronization activated on intake camshaft 2" UBYTE _CNV_S_2_RANGE__0___1_CM 1 100. 0. 1. DISPLAY_IDENTIFIER LV_ACT_CAM_IN_2 ECU_ADDRESS 0xd0007508 BIT_MASK 0x1 /end MEASUREMENT
/begin MEASUREMENT idx_n_ctl_in[1].lv_act_lih_crk_cam "crankshaft limp home operating mode activated on intake camshaft 2" UBYTE _CNV_S_2_RANGE__0___1_CM 1 100. 0. 1. DISPLAY_IDENTIFIER LV_ACT_LIH_CRK_CAM_IN_2 ECU_ADDRESS 0xd0007509 BIT_MASK 0x1 /end MEASUREMENT
/begin MEASUREMENT idx_n_ctl_in[1].lv_act_syn_crk_cam "crankshaft synchronization operating mode activated on intake camshaft 2" UBYTE _CNV_S_2_RANGE__0___1_CM 1 100. 0. 1. DISPLAY_IDENTIFIER LV_ACT_SYN_CRK_CAM_IN_2 ECU_ADDRESS 0xd000750a BIT_MASK 0x1 /end MEASUREMENT
/begin MEASUREMENT lv_err_cam "Failure on all camshaft sensor signals in normal mode" UBYTE _CNV_S_2_RANGE__0___1_CM 1 100. 0. 1. DISPLAY_IDENTIFIER LV_ERR_CAM ECU_ADDRESS 0xd00074ce BIT_MASK 0x1 /end MEASUREMENT
/begin MEASUREMENT lv_eng_back_det "Engine backwards rotation detected" UBYTE _CNV_S_2_RANGE__0___1_CM 1 100. 0. 1. DISPLAY_IDENTIFIER LV_ENG_BACK_DET ECU_ADDRESS 0xd00074cd BIT_MASK 0x1 /end MEASUREMENT
/begin MEASUREMENT lv_eng_back_cfm "Engine backwards rotation confirmed" UBYTE _CNV_S_2_RANGE__0___1_CM 1 100. 0. 1. DISPLAY_IDENTIFIER LV_ENG_BACK_CFM ECU_ADDRESS 0xd00074cc BIT_MASK 0x1 /end MEASUREMENT
/begin MEASUREMENT lv_crk_miss_run_eng "Boolean information engine running after engine stop request" UBYTE _CNV_S_2_RANGE__0___1_CM 1 100. 0. 1. DISPLAY_IDENTIFIER LV_CRK_MISS_RUN_ENG ECU_ADDRESS 0xd00074c7 BIT_MASK 0x1 /end MEASUREMENT
/begin CHARACTERISTIC c_t_dly_stop_eng "Delay time for engine running after engine stop request" VALUE 0xa08025ac _REC_VAL_20_u1 2.55 _CNV_A_R_LINEAR_____3_CM 0. 2.55 DISPLAY_IDENTIFIER C_T_DLY_STOP_ENG FORMAT "%4.2" /end CHARACTERISTIC
/begin CHARACTERISTIC id_nr_vld_cam_syn_crk "Number of camshaft signal edges to validate cam/crk synchronization" CURVE 0xa080258e _REC_CUR_20_u1_u2 255. _CNV_A_R_LINEAR_____0_CM 0. 255. DISPLAY_IDENTIFIER ID_NR_VLD_CAM_SYN_CRK FORMAT "%3.0"
 /begin AXIS_DESCR COM_AXIS n _CNV_A_R_LINEAR_____14_CM 2 0. 8160. FORMAT "%4.0" AXIS_PTS_REF ldp_n_id_nr_vld_cam_syn_crk /end AXIS_DESCR
/end CHARACTERISTIC
/begin AXIS_PTS ldp_n_id_nr_vld_cam_syn_crk "" 0xa0802536 n _REC_AXS_20_u2 8160. _CNV_A_R_LINEAR_____14_CM 2 0. 8160. FORMAT "%4.0" /end AXIS_PTS
/begin CHARACTERISTIC lc_inh_fsd_man_deac "Manual deactivation of fuel system diagnosis inhibition" VALUE 0xa0806cfb _REC_VAL_20_u1 1. _CNV_A_R_LINEAR_____0_CM 0. 1. DISPLAY_IDENTIFIER LC_INH_FSD_MAN_DEAC FORMAT "%1.0" /end CHARACTERISTIC
/begin CHARACTERISTIC c_cl_mmv_max_fsd "Maximum value for CL_MMV to permit FSD" VALUE 0xa0806bc4 _REC_VAL_20_u2 1.99996948242188 _CNV_A_R_LINEAR_____9_CM 0. 1.99996948242188 DISPLAY_IDENTIFIER C_CL_MMV_MAX_FSD FORMAT "%7.5" /end CHARACTERISTIC
/begin CHARACTERISTIC c_fac_lam_out_max_fsd "The upper limit of lambda controller output to request forced lambda adaptation" VALUE 0xa0806c0a _REC_VAL_20_s2 99.99847412109381 _CNV_A_R_LINEAR_____113_CM -50. 49.9984741210938 DISPLAY_IDENTIFIER C_FAC_LAM_OUT_MAX_FSD FORMAT "%7.3" /end CHARACTERISTIC
/begin CHARACTERISTIC c_fac_lam_out_min_fsd "The lower limit of lambda controller output to request forced lambda adaptation" VALUE 0xa0806c12 _REC_VAL_20_s2 99.99847412109381 _CNV_A_R_LINEAR_____113_CM -50. 49.9984741210938 DISPLAY_IDENTIFIER C_FAC_LAM_OUT_MIN_FSD FORMAT "%7.3" /end CHARACTERISTIC
/begin CHARACTERISTIC c_crlc_t_sum_win_fsd_rst "Minimal fraction of counter threshold that must be spent in ADD as well as L_RNG for error healing" VALUE 0xa0806be0 _REC_VAL_20_u1 0.99609375 _CNV_A_R_LINEAR_____28_CM 0. 0.99609375 DISPLAY_IDENTIFIER C_CRLC_T_SUM_WIN_FSD_RST FORMAT "%5.3" /end CHARACTERISTIC
/begin CHARACTERISTIC c_t_lam_ad_act_min_fsd "Minimum threshold of active forced lambda adaptation to reset the request flag" VALUE 0xa0806cba _REC_VAL_20_u2 1310.68 _CNV_A_R_LINEAR_____110_CM 2.e-002 1310.7 DISPLAY_IDENTIFIER C_T_LAM_AD_ACT_MIN_FSD FORMAT "%7.2" /end CHARACTERISTIC
/begin CHARACTERISTIC c_t_lam_lim_lam_ad_req "Time counter threshold for forced activation of lambda adaptation" VALUE 0xa0806cbc _REC_VAL_20_u2 1310.68 _CNV_A_R_LINEAR_____110_CM 2.e-002 1310.7 DISPLAY_IDENTIFIER C_T_LAM_LIM_LAM_AD_REQ FORMAT "%7.2" /end CHARACTERISTIC
/begin CHARACTERISTIC c_t_sum_min_thd_fsd "Maximum value of counter for ADD,  FAC_L and FAC_H adaptation area (lower limit)" VALUE 0xa0806cca _REC_VAL_20_u2 1310.68 _CNV_A_R_LINEAR_____110_CM 2.e-002 1310.7 DISPLAY_IDENTIFIER C_T_SUM_MIN_THD_FSD FORMAT "%7.2" /end CHARACTERISTIC
/begin CHARACTERISTIC c_t_sum_max_thd_fsd_lam_lim "Maximum value of counter in case of lambda control - dead stop (upper limit)" VALUE 0xa0806cc8 _REC_VAL_20_u2 1310.68 _CNV_A_R_LINEAR_____110_CM 2.e-002 1310.7 DISPLAY_IDENTIFIER C_T_SUM_MAX_THD_FSD_LAM_LIM FORMAT "%7.2" /end CHARACTERISTIC
/begin CHARACTERISTIC c_t_sum_min_thd_fsd_lam_lim "Maximum value of counter in case of lambda control - dead stop (lower limit)" VALUE 0xa0806ccc _REC_VAL_20_u2 1310.68 _CNV_A_R_LINEAR_____110_CM 2.e-002 1310.7 DISPLAY_IDENTIFIER C_T_SUM_MIN_THD_FSD_LAM_LIM FORMAT "%7.2" /end CHARACTERISTIC
/begin CHARACTERISTIC c_t_sum_max_thd_fsd "Maximum value of counter for ADD,  FAC_L and FAC_H adaptation area (upper limit)" VALUE 0xa0806cc6 _REC_VAL_20_u2 1310.68 _CNV_A_R_LINEAR_____110_CM 2.e-002 1310.7 DISPLAY_IDENTIFIER C_T_SUM_MAX_THD_FSD FORMAT "%7.2" /end CHARACTERISTIC
/begin CHARACTERISTIC c_t_sum_rst_fsd "Calibration threshold to reset anti-bounce timers" VALUE 0xa0806cce _REC_VAL_20_u2 1310.68 _CNV_A_R_LINEAR_____110_CM 2.e-002 1310.7 DISPLAY_IDENTIFIER C_T_SUM_RST_FSD FORMAT "%7.2" /end CHARACTERISTIC
/begin CHARACTERISTIC c_amp_min_fsd "Minimum ambient pressure threshold for fuel system diagnosis" VALUE 0xa0806bc0 _REC_VAL_20_u2 5434. _CNV_A_R_LINEAR_____27_CM 0. 5434. DISPLAY_IDENTIFIER C_AMP_MIN_FSD FORMAT "%7.2" /end CHARACTERISTIC
/begin CHARACTERISTIC c_maf_min_fsd "Mass air flow threshold for fuel system diagnosis" VALUE 0xa0806c95 _REC_VAL_20_u1 1389. _CNV_A_R_LINEAR_____15_CM 0. 1389. DISPLAY_IDENTIFIER C_MAF_MIN_FSD FORMAT "%4.0" /end CHARACTERISTIC
/begin CHARACTERISTIC c_n_min_fsd "Engine speed threshold for fuel system diagnosis" VALUE 0xa0806cad _REC_VAL_20_u1 8160. _CNV_A_R_LINEAR_____10_CM 0. 8160. DISPLAY_IDENTIFIER C_N_MIN_FSD FORMAT "%4.0" /end CHARACTERISTIC
/begin MEASUREMENT ctr_stop_fsd "Counter value as a measure of the oil dilution under cold start conditions" UBYTE _CNV_A_R_LINEAR_____0_CM 1 100. 0. 255. DISPLAY_IDENTIFIER CTR_STOP_FSD ECU_ADDRESS 0xd0007688 FORMAT "%3.0" /end MEASUREMENT
/begin MEASUREMENT lv_inh_fsd_stop_oil "Inhibition flag for fuel system diagnosis due to oil dilution under cold start conditions" UBYTE _CNV_S_2_RANGE__0___1_CM 1 100. 0. 1. DISPLAY_IDENTIFIER LV_INH_FSD_STOP_OIL ECU_ADDRESS 0xd0007689 BIT_MASK 0x1 /end MEASUREMENT
/begin CHARACTERISTIC c_ctr_max_fsd_stop_oil "Maximum value for the debounce counter for oil dilution detection in fuel system diagnosis" VALUE 0xa0806be2 _REC_VAL_20_u1 255. _CNV_A_R_LINEAR_____0_CM 0. 255. DISPLAY_IDENTIFIER C_CTR_MAX_FSD_STOP_OIL FORMAT "%3.0" /end CHARACTERISTIC
/begin CHARACTERISTIC c_tia_min_fsd "Minimum intake air temperature threshold for fuel system diagnosis" VALUE 0xa0806ced _REC_VAL_20_u1 190.5 _CNV_A_R_LINEAR_____17_CM -48. 142.5 DISPLAY_IDENTIFIER C_TIA_MIN_FSD FORMAT "%6.2" /end CHARACTERISTIC
/begin AXIS_PTS ldp_tco_st_id_ctr_inc_fsd_stop "" 0xa08066e6 tco_st _REC_AXS_20_u1 190.5 _CNV_A_R_LINEAR_____17_CM 4 -48. 142.5 FORMAT "%6.2" /end AXIS_PTS
/begin CHARACTERISTIC id_ctr_inc_fsd_stop_oil "Increasing value for the debounce counter for oil dilution detection in fuel system diagnosis" CURVE 0xa080685a _REC_CUR_20_u1_u1 255. _CNV_A_R_LINEAR_____0_CM 0. 255. DISPLAY_IDENTIFIER ID_CTR_INC_FSD_STOP_OIL FORMAT "%3.0"
 /begin AXIS_DESCR COM_AXIS tco_st _CNV_A_R_LINEAR_____17_CM 4 -48. 142.5 FORMAT "%6.2" AXIS_PTS_REF ldp_tco_st_id_ctr_inc_fsd_stop /end AXIS_DESCR
/end CHARACTERISTIC
/begin MEASUREMENT dly_dec_fsd_stop_oil "Time delay for decreasing the debounce counter for oil dilution detection in fuel system diagnosis" UBYTE _CNV_A_R_LINEAR_____36_CM 1 100. 0. 255. DISPLAY_IDENTIFIER DLY_DEC_FSD_STOP_OIL ECU_ADDRESS 0xd0003500 FORMAT "%3.0" /end MEASUREMENT
/begin MEASUREMENT t_dec_fsd_stop_oil "Timer for decreasing the debounce counter for oil dilution detection in fuel system diagnosis" UBYTE _CNV_A_R_LINEAR_____36_CM 1 100. 0. 255. DISPLAY_IDENTIFIER T_DEC_FSD_STOP_OIL ECU_ADDRESS 0xd0003501 FORMAT "%3.0" /end MEASUREMENT
/begin CHARACTERISTIC c_tco_min_fsd "Minimum threshold of TCO for fuel system diagnosis" VALUE 0xa0806ce0 _REC_VAL_20_u1 190.5 _CNV_A_R_LINEAR_____17_CM -48. 142.5 DISPLAY_IDENTIFIER C_TCO_MIN_FSD FORMAT "%6.2" /end CHARACTERISTIC
/begin CHARACTERISTIC c_tam_min_fsd "Minimum ambient temperature threshold for fuel system diagnosis" VALUE 0xa0806cd4 _REC_VAL_20_u1 190.5 _CNV_A_R_LINEAR_____17_CM -48. 142.5 DISPLAY_IDENTIFIER C_TAM_MIN_FSD FORMAT "%6.2" /end CHARACTERISTIC
/begin AXIS_PTS ldp_toil_id_dly_dec_fsd_oil "" 0xa08066ec toil _REC_AXS_20_u1 200. _CNV_A_R_LINEAR_____26_CM 4 -40. 160. FORMAT "%3.0" /end AXIS_PTS
/begin CHARACTERISTIC id_dly_dec_fsd_stop_oil "Time delay for decreasing the debounce counter for oil dilution detection in fuel system diagnosis" CURVE 0xa080685e _REC_CUR_20_u1_u1 255. _CNV_A_R_LINEAR_____36_CM 0. 255. DISPLAY_IDENTIFIER ID_DLY_DEC_FSD_STOP_OIL FORMAT "%3.0"
 /begin AXIS_DESCR COM_AXIS toil _CNV_A_R_LINEAR_____26_CM 4 -40. 160. FORMAT "%3.0" AXIS_PTS_REF ldp_toil_id_dly_dec_fsd_oil /end AXIS_DESCR
/end CHARACTERISTIC
/begin CHARACTERISTIC c_crlc_global_fac_lam_ad_wup "Correlation constant for calculation of adaptation value in warm up phase" VALUE 0xa0806bd0 _REC_VAL_20_u1 1. _CNV_A_R_LINEAR_____103_CM 0. 1. DISPLAY_IDENTIFIER C_CRLC_GLOBAL_FAC_LAM_AD_WUP FORMAT "%8.6" /end CHARACTERISTIC
/begin CHARACTERISTIC c_ctr_tco_min_inter "Counter threshold for detecting minimum temperature for valid learning of adapatation value in warm up phase for current driving cycle" VALUE 0xa0806be4 _REC_VAL_20_u2 8191. _CNV_A_R_LINEAR_____0_CM 0. 8191. DISPLAY_IDENTIFIER C_CTR_TCO_MIN_INTER FORMAT "%5.0" /end CHARACTERISTIC
/begin CHARACTERISTIC c_fac_lam_ad_wup_delta "Delta of applied adaptation value in warm up phase to ramp the signal to new value" VALUE 0xa0806be8 _REC_VAL_20_u2 49.9984741210938 _CNV_A_R_LINEAR_____8_CM 0. 49.9984741210938 DISPLAY_IDENTIFIER C_FAC_LAM_AD_WUP_DELTA /end CHARACTERISTIC
/begin CHARACTERISTIC c_fac_lam_ad_wup_min_gap "Minimum (absolute) gap between old and new adaptation value in warm up phase necessary to update adaptation values" VALUE 0xa0806bee _REC_VAL_20_u2 49.9984741210938 _CNV_A_R_LINEAR_____8_CM 0. 49.9984741210938 DISPLAY_IDENTIFIER C_FAC_LAM_AD_WUP_MIN_GAP /end CHARACTERISTIC
/begin CHARACTERISTIC c_fac_lam_ad_wup_max_inter "Maximum value for adaptation value in warm up phase while in transient phase before valid learning is possible" VALUE 0xa0806bea _REC_VAL_20_s2 99.99847412109381 _CNV_A_R_LINEAR_____113_CM -50. 49.9984741210938 DISPLAY_IDENTIFIER C_FAC_LAM_AD_WUP_MAX_INTER FORMAT "%7.3" /end CHARACTERISTIC
/begin CHARACTERISTIC c_fac_lam_ad_wup_min_inter "Minimum value for adaptation value in warm up phase while in transient phase before valid learning is possible" VALUE 0xa0806bf0 _REC_VAL_20_s2 99.99847412109381 _CNV_A_R_LINEAR_____113_CM -50. 49.9984741210938 DISPLAY_IDENTIFIER C_FAC_LAM_AD_WUP_MIN_INTER FORMAT "%7.3" /end CHARACTERISTIC
/begin CHARACTERISTIC c_fac_lam_ad_wup_max_lscl_off "Maximum value for adaptation value in warm up phase while Lambda controller is off" VALUE 0xa0806bec _REC_VAL_20_s2 99.99847412109381 _CNV_A_R_LINEAR_____113_CM -50. 49.9984741210938 DISPLAY_IDENTIFIER C_FAC_LAM_AD_WUP_MAX_LSCL_OFF FORMAT "%7.3" /end CHARACTERISTIC
/begin CHARACTERISTIC c_tco_a_lam_ad_wup "Coolant temperature of point A for Lambda adaptation in warm up phase" VALUE 0xa0806cd6 _REC_VAL_20_u1 190.5 _CNV_A_R_LINEAR_____17_CM -48. 142.5 DISPLAY_IDENTIFIER C_TCO_A_LAM_AD_WUP FORMAT "%6.2" /end CHARACTERISTIC
/begin CHARACTERISTIC c_tco_b_lam_ad_wup "Coolant temperature of point B for Lambda adaptation in warm up phase" VALUE 0xa0806cd7 _REC_VAL_20_u1 190.5 _CNV_A_R_LINEAR_____17_CM -48. 142.5 DISPLAY_IDENTIFIER C_TCO_B_LAM_AD_WUP FORMAT "%6.2" /end CHARACTERISTIC
/begin CHARACTERISTIC c_tco_c_lam_ad_wup "Coolant temperature of point C for Lambda adaptation in warm up phase" VALUE 0xa0806cd8 _REC_VAL_20_u1 190.5 _CNV_A_R_LINEAR_____17_CM -48. 142.5 DISPLAY_IDENTIFIER C_TCO_C_LAM_AD_WUP FORMAT "%6.2" /end CHARACTERISTIC
/begin CHARACTERISTIC c_tco_d_lam_ad_wup "Coolant temperature of point D for Lambda adaptation in warm up phase" VALUE 0xa0806cd9 _REC_VAL_20_u1 190.5 _CNV_A_R_LINEAR_____17_CM -48. 142.5 DISPLAY_IDENTIFIER C_TCO_D_LAM_AD_WUP FORMAT "%6.2" /end CHARACTERISTIC
/begin CHARACTERISTIC c_tco_e_lam_ad_wup "Coolant temperature of point E for Lambda adaptation in warm up phase" VALUE 0xa0806cda _REC_VAL_20_u1 190.5 _CNV_A_R_LINEAR_____17_CM -48. 142.5 DISPLAY_IDENTIFIER C_TCO_E_LAM_AD_WUP FORMAT "%6.2" /end CHARACTERISTIC
/begin CHARACTERISTIC c_tco_f_lam_ad_wup "Coolant temperature of point F for Lambda adaptation in warm up phase" VALUE 0xa0806cdb _REC_VAL_20_u1 190.5 _CNV_A_R_LINEAR_____17_CM -48. 142.5 DISPLAY_IDENTIFIER C_TCO_F_LAM_AD_WUP FORMAT "%6.2" /end CHARACTERISTIC
/begin CHARACTERISTIC id_mff_sp_bol_lam_ad_wup "minimum fuel mass set point for lambda adaptation in warm up phase (partial load)" CURVE 0xa08068a8 _REC_CUR_20_u2_u1 1389. _CNV_A_R_LINEAR_____111_CM 0. 1389. DISPLAY_IDENTIFIER ID_MFF_SP_BOL_LAM_AD_WUP FORMAT "%7.2"
 /begin AXIS_DESCR COM_AXIS n_32 _CNV_A_R_LINEAR_____10_CM 4 0. 8160. FORMAT "%4.0" AXIS_PTS_REF ldp_n_32_id_mff_bol_lam_ad_wup /end AXIS_DESCR
/end CHARACTERISTIC
/begin CHARACTERISTIC c_mff_sp_tol_lam_ad_wup "maximum fuel mass set point for lambda adaptation in warm up phase (partial speed)" VALUE 0xa0806ca0 _REC_VAL_20_u2 1389. _CNV_A_R_LINEAR_____111_CM 0. 1389. DISPLAY_IDENTIFIER C_MFF_SP_TOL_LAM_AD_WUP FORMAT "%7.2" /end CHARACTERISTIC
/begin CHARACTERISTIC c_n_tol_lam_ad_wup "maximum engine speed for lambda adaptation in warm up phase (partial load)" VALUE 0xa0806cb5 _REC_VAL_20_u1 8160. _CNV_A_R_LINEAR_____10_CM 0. 8160. DISPLAY_IDENTIFIER C_N_TOL_LAM_AD_WUP FORMAT "%4.0" /end CHARACTERISTIC
/begin CHARACTERISTIC c_n_bol_lam_ad_wup "minimum engine speed for lambda adaptation in warm up phase (partial load)" VALUE 0xa0806ca4 _REC_VAL_20_u1 8160. _CNV_A_R_LINEAR_____10_CM 0. 8160. DISPLAY_IDENTIFIER C_N_BOL_LAM_AD_WUP FORMAT "%4.0" /end CHARACTERISTIC
/begin CHARACTERISTIC c_crlc_fac_dif_lam_ad_wup_mv "Correlation constant for calculation of the controller deviation in warm up phase" VALUE 0xa0806bc6 _REC_VAL_20_u1 1. _CNV_A_R_LINEAR_____103_CM 0. 1. DISPLAY_IDENTIFIER C_CRLC_FAC_DIF_LAM_AD_WUP_MV FORMAT "%8.6" /end CHARACTERISTIC
/begin CHARACTERISTIC c_t_max_lam_ad_wup_ldc "threshold for elasped time with limited dynamics for learning of adaptation value in warm up phase under load" VALUE 0xa0806cbe _REC_VAL_20_u2 6553.5 _CNV_A_R_LINEAR_____4_CM 0. 6553.5 DISPLAY_IDENTIFIER C_T_MAX_LAM_AD_WUP_LDC FORMAT "%6.1" /end CHARACTERISTIC
/begin CHARACTERISTIC c_t_max_lam_ad_wup_tra_pha "threshold for timer indicating transient phase of Lambda adaptation in warm up phase" VALUE 0xa0806cc0 _REC_VAL_20_u2 6553.5 _CNV_A_R_LINEAR_____4_CM 0. 6553.5 DISPLAY_IDENTIFIER C_T_MAX_LAM_AD_WUP_TRA_PHA FORMAT "%6.1" /end CHARACTERISTIC
/begin CHARACTERISTIC c_tco_lam_ad_wup_rng "Temperature window for learning of adaptations value in warm up pahse" VALUE 0xa0806cdc _REC_VAL_20_u2 190.5 _CNV_A_R_ENTE_LINEA_440_CM 0. 190.5 DISPLAY_IDENTIFIER C_TCO_LAM_AD_WUP_RNG FORMAT "%7.3" /end CHARACTERISTIC
/begin CHARACTERISTIC c_crlc_fac_lam_tco_x "correlation constant for updating FAC_LAM_TCO_X" VALUE 0xa0806bcc _REC_VAL_20_u1 1. _CNV_A_R_LINEAR_____103_CM 0. 1. DISPLAY_IDENTIFIER C_CRLC_FAC_LAM_TCO_X FORMAT "%8.6" /end CHARACTERISTIC
/begin CHARACTERISTIC c_crlc_fac_lam_tco_x_first_dc "correlation constant for updating FAC_LAM_TCO_X in first driving cycle" VALUE 0xa0806bcd _REC_VAL_20_u1 1. _CNV_A_R_LINEAR_____103_CM 0. 1. DISPLAY_IDENTIFIER C_CRLC_FAC_LAM_TCO_X_FIRST_DC FORMAT "%8.6" /end CHARACTERISTIC
/begin CHARACTERISTIC c_fac_lam_ad_wup_min_lscl_off "Miniimum value for adaptation value in warm up phase while Lambda controller is off" VALUE 0xa0806bf2 _REC_VAL_20_s2 99.99847412109381 _CNV_A_R_LINEAR_____113_CM -50. 49.9984741210938 DISPLAY_IDENTIFIER C_FAC_LAM_AD_WUP_MIN_LSCL_OFF FORMAT "%7.3" /end CHARACTERISTIC
/begin CHARACTERISTIC c_thd_dif_l_rng_lam_ad "threshold value of change in low range adaptation factor to force auto shift" VALUE 0xa0806ce8 _REC_VAL_20_s2 99.99847412109381 _CNV_A_R_LINEAR_____113_CM -50. 49.9984741210938 DISPLAY_IDENTIFIER C_THD_DIF_L_RNG_LAM_AD FORMAT "%7.3" /end CHARACTERISTIC
/begin CHARACTERISTIC c_thd_fac_delta_l_rng "threshold of lambda adaptation difference in low range to allow auto shift" VALUE 0xa0806cea _REC_VAL_20_s2 99.99847412109381 _CNV_A_R_LINEAR_____113_CM -50. 49.9984741210938 DISPLAY_IDENTIFIER C_THD_FAC_DELTA_L_RNG FORMAT "%7.3" /end CHARACTERISTIC
/begin CHARACTERISTIC lc_fac_raw_lam_ad_wup_lim_act "logical calibration to force FAC_LAM_AD_WUP to FAC_LAM_TCO_MIN at temperature below TCO_MIN" VALUE 0xa0806cf8 _REC_VAL_20_u1 1. _CNV_A_R_LINEAR_____0_CM 0. 1. DISPLAY_IDENTIFIER LC_FAC_RAW_LAM_AD_WUP_LIM_ACT FORMAT "%1.0" /end CHARACTERISTIC
/begin CHARACTERISTIC lc_lam_ad_wup_shift_act "logical calibration to enable auto shift in Lambda adaptation in warm up phase in all driving cycles" VALUE 0xa0806d00 _REC_VAL_20_u1 1. _CNV_A_R_LINEAR_____0_CM 0. 1. DISPLAY_IDENTIFIER LC_LAM_AD_WUP_SHIFT_ACT FORMAT "%1.0" /end CHARACTERISTIC
/begin CHARACTERISTIC lc_lam_ad_wup_clr_inh "Inhibit initialization of NVMY data (for application purposes only)" VALUE 0xa0806cfd _REC_VAL_20_u1 1. _CNV_A_R_LINEAR_____0_CM 0. 1. DISPLAY_IDENTIFIER LC_LAM_AD_WUP_CLR_INH FORMAT "%1.0" /end CHARACTERISTIC
/begin AXIS_PTS ldp_n_32_id_mff_bol_lam_ad_wup "" 0xa0806672 n_32 _REC_AXS_20_u1 8160. _CNV_A_R_LINEAR_____10_CM 4 0. 8160. FORMAT "%4.0" /end AXIS_PTS
/begin CHARACTERISTIC id_fac_thd_chg_fq_det "threshold of difference in Lambda adaptation to detect change in fuel quality during warm up phase" CURVE 0xa080687c _REC_CUR_20_u2_u1 99.99847412 _CNV_A_R_LINEAR_____178_CM -50. 49.99847412 DISPLAY_IDENTIFIER ID_FAC_THD_CHG_FQ_DET FORMAT "%7.3"
 /begin AXIS_DESCR COM_AXIS tco _CNV_A_R_LINEAR_____17_CM 6 -48. 142.5 FORMAT "%6.2" AXIS_PTS_REF ldpm_tco_3_laco /end AXIS_DESCR
/end CHARACTERISTIC
/begin CHARACTERISTIC ip_fac_lam_ad_wup_max "maximum value for adaptation value in warm up phase" CURVE 0xa08069f4 _REC_CUR_20_u2_u1 99.99847412 _CNV_A_R_LINEAR_____178_CM -50. 49.99847412 DISPLAY_IDENTIFIER IP_FAC_LAM_AD_WUP_MAX FORMAT "%7.3"
 /begin AXIS_DESCR COM_AXIS tco _CNV_A_R_LINEAR_____17_CM 6 -48. 142.5 FORMAT "%6.2" AXIS_PTS_REF ldpm_tco_3_laco /end AXIS_DESCR
/end CHARACTERISTIC
/begin CHARACTERISTIC ip_fac_chg_fq_det_sca "scaling factor to shift adaptation values in warm up phase after detection of change in fuel quality" CURVE 0xa080696c _REC_CUR_20_u1_u1 1. _CNV_A_R_LINEAR_____103_CM 0. 1. DISPLAY_IDENTIFIER IP_FAC_CHG_FQ_DET_SCA FORMAT "%8.6"
 /begin AXIS_DESCR COM_AXIS tco _CNV_A_R_LINEAR_____17_CM 6 -48. 142.5 FORMAT "%6.2" AXIS_PTS_REF ldpm_tco_3_laco /end AXIS_DESCR
/end CHARACTERISTIC
/begin CHARACTERISTIC ip_fac_lam_ad_wup_min "minimum value for adaptation value in warm up phase" CURVE 0xa0806a00 _REC_CUR_20_u2_u1 99.99847412 _CNV_A_R_LINEAR_____178_CM -50. 49.99847412 DISPLAY_IDENTIFIER IP_FAC_LAM_AD_WUP_MIN FORMAT "%7.3"
 /begin AXIS_DESCR COM_AXIS tco _CNV_A_R_LINEAR_____17_CM 6 -48. 142.5 FORMAT "%6.2" AXIS_PTS_REF ldpm_tco_3_laco /end AXIS_DESCR
/end CHARACTERISTIC
/begin CHARACTERISTIC ip_fac_wup_fac_lam_ad_wup "copy of IP_FAC_WUP_FAC_LAM_AD used im Lambda adaptation in warm up phase" MAP 0xa0806a9c _REC_MAP_20_u1_u1_u2 1. _CNV_A_R_LINEAR_____103_CM 0. 1. DISPLAY_IDENTIFIER IP_FAC_WUP_FAC_LAM_AD_WUP FORMAT "%8.6"
 /begin AXIS_DESCR COM_AXIS tco _CNV_A_R_LINEAR_____17_CM 5 -48. 142.5 FORMAT "%6.2" AXIS_PTS_REF ldpm_tco_2_laco /end AXIS_DESCR
 /begin AXIS_DESCR COM_AXIS online_dummy _CNV_A_R_LINEAR_____178_CM 5 -50. 49.99847412 FORMAT "%7.3" AXIS_PTS_REF ldpm_fac_lam_ad_1_laco /end AXIS_DESCR
/end CHARACTERISTIC
/begin CHARACTERISTIC c_tco_rng_wr_down_lam_ad_wup "temperature window in which first learnt adaptation value can be written down to next lower point" VALUE 0xa0806ce4 _REC_VAL_20_u2 190.5 _CNV_A_R_ENTE_LINEA_440_CM 0. 190.5 DISPLAY_IDENTIFIER C_TCO_RNG_WR_DOWN_LAM_AD_WUP FORMAT "%7.3" /end CHARACTERISTIC
/begin CHARACTERISTIC lc_fac_wr_down_lam_ad_wup "First learnt adaptation values shall be written down to next lower interpolation" VALUE 0xa0806cf9 _REC_VAL_20_u1 1. _CNV_A_R_LINEAR_____0_CM 0. 1. DISPLAY_IDENTIFIER LC_FAC_WR_DOWN_LAM_AD_WUP FORMAT "%1.0" /end CHARACTERISTIC
/begin COMPU_METHOD _CNV_A_R_LINEAR_____0_CM "" RAT_FUNC "%6.3" "-" COEFFS 0 1. 0. 0 0 1 /end COMPU_METHOD
/begin COMPU_METHOD _CNV_S_2_RANGE__0___1_CM "" TAB_VERB "%6.3" "-" COMPU_TAB_REF _CNV_S_2_RANGE__0___1 /end COMPU_METHOD
/begin COMPU_VTAB _CNV_S_2_RANGE__0___1 "" TAB_VERB 2 0 "0" 1 "1" /end COMPU_VTAB
/begin COMPU_METHOD _CNV_A_R_LINEAR_____3_CM "" RAT_FUNC "%6.3" "s" COEFFS 0 100. 0. 0 0 1 /end COMPU_METHOD
/begin COMPU_METHOD _CNV_A_R_LINEAR_____4_CM "" RAT_FUNC "%6.3" "s" COEFFS 0 10. 0. 0 0 1 /end COMPU_METHOD
/begin COMPU_METHOD _CNV_A_R_LINEAR_____8_CM "" RAT_FUNC "%6.3" "%" COEFFS 0 655.3599999999997 0. 0 0 1 /end COMPU_METHOD
/begin COMPU_METHOD _CNV_A_R_LINEAR_____9_CM "" RAT_FUNC "%6.3" "-" COEFFS 0 32767.99999999992 0. 0 0 1 /end COMPU_METHOD
/begin COMPU_METHOD _CNV_A_R_LINEAR_____10_CM "" RAT_FUNC "%6.3" "rpm" COEFFS 0 3.125e-002 0. 0 0 1 /end COMPU_METHOD
/begin COMPU_METHOD _CNV_A_R_LINEAR_____14_CM "" RAT_FUNC "%6.3" "rpm" COEFFS 0 1. 0. 0 0 1 /end COMPU_METHOD
/begin COMPU_METHOD _CNV_A_R_LINEAR_____15_CM "" RAT_FUNC "%6.3" "mg/stk" COEFFS 0 0.183585313174946 0. 0 0 1 /end COMPU_METHOD
/begin COMPU_METHOD _CNV_A_R_LINEAR_____17_CM "" RAT_FUNC "%6.3" "°C" COEFFS 0 1.333333333333333 64. 0 0 1 /end COMPU_METHOD
/begin COMPU_METHOD _CNV_A_R_LINEAR_____24_CM "" RAT_FUNC "%6.3" "-" COEFFS 0 16384. 0. 0 0 1 /end COMPU_METHOD
/begin COMPU_METHOD _CNV_A_R_LINEAR_____26_CM "" RAT_FUNC "%6.3" "°C" COEFFS 0 1. 40. 0 0 1 /end COMPU_METHOD
/begin COMPU_METHOD _CNV_A_R_LINEAR_____27_CM "" RAT_FUNC "%6.3" "hPa" COEFFS 0 12.06017666543982 0. 0 0 1 /end COMPU_METHOD
/begin COMPU_METHOD _CNV_A_R_LINEAR_____28_CM "" RAT_FUNC "%6.3" "-" COEFFS 0 256. 0. 0 0 1 /end COMPU_METHOD
/begin COMPU_METHOD _CNV_A_R_LINEAR_____36_CM "" RAT_FUNC "%6.3" "s" COEFFS 0 1. 0. 0 0 1 /end COMPU_METHOD
/begin COMPU_METHOD _CNV_A_R_LINEAR_____89_CM "" RAT_FUNC "%6.3" "-" COEFFS 0 65535.99999999996 0. 0 0 1 /end COMPU_METHOD
/begin COMPU_METHOD _CNV_A_R_LINEAR_____103_CM "" RAT_FUNC "%6.3" "-" COEFFS 0 128. 0. 0 0 1 /end COMPU_METHOD
/begin COMPU_METHOD _CNV_A_R_LINEAR_____110_CM "" RAT_FUNC "%6.3" "s" COEFFS 0 50. 0. 0 0 1 /end COMPU_METHOD
/begin COMPU_METHOD _CNV_A_R_LINEAR_____111_CM "" RAT_FUNC "%6.3" "mg/stk" COEFFS 0 47.18142548596112 0. 0 0 1 /end COMPU_METHOD
/begin COMPU_METHOD _CNV_A_R_LINEAR_____112_CM "" RAT_FUNC "%6.3" "°CRK" COEFFS 0 0.1666666666666667 0. 0 0 1 /end COMPU_METHOD
/begin COMPU_METHOD _CNV_A_R_LINEAR_____113_CM "" RAT_FUNC "%6.3" "%" COEFFS 0 655.3599999999997 -1.455191522836685e-011 0 0 1 /end COMPU_METHOD
/begin COMPU_METHOD _CNV_A_R_LINEAR_____178_CM "" RAT_FUNC "%6.3" "%" COEFFS 0 655.3600000071681 32768.00000035841 0 0 1 /end COMPU_METHOD
/begin COMPU_METHOD _CNV_A_R_LINEAR_____212_CM "" RAT_FUNC "%6.3" "%" COEFFS 0 327.68 0. 0 0 1 /end COMPU_METHOD
/begin COMPU_METHOD _CNV_A_R_LINEAR_____227_CM "" RAT_FUNC "%6.3" "°TPS" COEFFS 0 137.0962343096234 0. 0 0 1 /end COMPU_METHOD
/begin COMPU_METHOD _CNV_A_R_LINEAR_____287_CM "" RAT_FUNC "%6.3" "g" COEFFS 0 35.99999999999994 0. 0 0 1 /end COMPU_METHOD
/begin COMPU_METHOD _CNV_A_R_EGCP_LINEA_354_CM "" RAT_FUNC "%6.3" "-" COEFFS 0 100. 0. 0 0 1 /end COMPU_METHOD
/begin COMPU_METHOD _CNV_S_5_LACO_RANGE_375_CM "" TAB_VERB "%6.3" "-" COMPU_TAB_REF _CNV_S_5_LACO_RANGE_375 /end COMPU_METHOD
/begin COMPU_VTAB _CNV_S_5_LACO_RANGE_375 "" TAB_VERB 5 1 "1:OL_CDN" 2 "2:CL" 4 "4:OL_INTR" 8 "8:OL_ERR" 16 "10:CL_ERR" /end COMPU_VTAB
/begin COMPU_METHOD _CNV_A_R_LACO_LINEA_376_CM "" RAT_FUNC "%6.3" "-" COEFFS 0 32768. 32768. 0 0 1 /end COMPU_METHOD
/begin COMPU_METHOD _CNV_A_R_LACO_LINEA_378_CM "" RAT_FUNC "%6.3" "-" COEFFS 0 16384. 2048. 0 0 1 /end COMPU_METHOD
/begin COMPU_METHOD _CNV_A_R_ENRD_LINEA_380_CM "" RAT_FUNC "%6.3" "%." COEFFS 0 65.41078491943799 0. 0 0 1 /end COMPU_METHOD
/begin COMPU_METHOD _CNV_A_R_ENRD_LINEA_381_CM "" RAT_FUNC "%6.3" "%." COEFFS 0 4194.293686959193 -8.057063130399911e-002 0 0 1 /end COMPU_METHOD
/begin COMPU_METHOD _CNV_A_R_ENRD_LINEA_382_CM "" RAT_FUNC "%6.3" "%." COEFFS 0 65.408 0. 0 0 1 /end COMPU_METHOD
/begin COMPU_METHOD _CNV_A_R_ENRD_LINEA_383_CM "" RAT_FUNC "%6.3" "%." COEFFS 0 4194.283373654366 0. 0 0 1 /end COMPU_METHOD
/begin COMPU_METHOD _CNV_A_R_ENRD_LINEA_384_CM "" RAT_FUNC "%6.3" "µs" COEFFS 0 4.194304129145619 0. 0 0 1 /end COMPU_METHOD
/begin COMPU_METHOD _CNV_A_R_LINEAR_____385_CM "" RAT_FUNC "%6.3" "s" COEFFS 0 4201656.398697721 0. 0 0 1 /end COMPU_METHOD
/begin COMPU_METHOD _CNV_A_R_LINEAR_____386_CM "" RAT_FUNC "%6.3" "°TPS/s" COEFFS 0 8.535564853556485e-002 0. 0 0 1 /end COMPU_METHOD
/begin COMPU_METHOD _CNV_P_3_ENRD_LINEA_I_387_CM "" TAB_INTP "%6.3" "µs" COMPU_TAB_REF _CNV_P_3_ENRD_LINEA_I_387 /end COMPU_METHOD
/begin COMPU_TAB _CNV_P_3_ENRD_LINEA_I_387 "" TAB_INTP 3 -2147483648 -512000000. 0 0. 2147483647 511999999.7 /end COMPU_TAB
/begin COMPU_METHOD _CNV_A_R_ENRD_LINEA_388_CM "" RAT_FUNC "%6.3" "µs" COEFFS 0 4.194304000252187 2147483648.129146 0 0 1 /end COMPU_METHOD
/begin COMPU_METHOD _CNV_A_R_ENRD_LINEA_389_CM "" RAT_FUNC "%6.3" "-" COEFFS 0 255. 0. 0 0 1 /end COMPU_METHOD
/begin COMPU_METHOD _CNV_A_R_ENRD_LINEA_390_CM "" RAT_FUNC "%6.3" "%." COEFFS 0 4194.293686959193 32767.9194293687 0 0 1 /end COMPU_METHOD
/begin COMPU_METHOD _CNV_A_R_ENTE_LINEA_440_CM "" RAT_FUNC "%6.3" "°C" COEFFS 0 341.3333333333333 0. 0 0 1 /end COMPU_METHOD
/begin RECORD_LAYOUT _REC_VAL_20_u1 FNC_VALUES 1 UBYTE COLUMN_DIR DIRECT /end RECORD_LAYOUT
/begin RECORD_LAYOUT _REC_VAL_20_u2 FNC_VALUES 1 UWORD COLUMN_DIR DIRECT /end RECORD_LAYOUT
/begin RECORD_LAYOUT _REC_AXS_20_u1 NO_AXIS_PTS_X 1 UBYTE AXIS_PTS_X 2 UBYTE INDEX_INCR DIRECT /end RECORD_LAYOUT
/begin RECORD_LAYOUT _REC_CUR_20_u1_u1 FNC_VALUES 1 UBYTE COLUMN_DIR DIRECT /end RECORD_LAYOUT
/begin RECORD_LAYOUT _REC_VAL_20_s2 FNC_VALUES 1 SWORD COLUMN_DIR DIRECT /end RECORD_LAYOUT
/begin RECORD_LAYOUT _REC_MAP_20_u2_u2_u1 FNC_VALUES 1 UWORD COLUMN_DIR DIRECT /end RECORD_LAYOUT
/begin RECORD_LAYOUT _REC_AXS_20_u2 NO_AXIS_PTS_X 1 UWORD AXIS_PTS_X 2 UWORD INDEX_INCR DIRECT /end RECORD_LAYOUT
/begin RECORD_LAYOUT _REC_CUR_20_u2_u1 FNC_VALUES 1 UWORD COLUMN_DIR DIRECT /end RECORD_LAYOUT
/begin RECORD_LAYOUT _REC_CUR_20_u2_u2 FNC_VALUES 1 UWORD COLUMN_DIR DIRECT /end RECORD_LAYOUT
/begin RECORD_LAYOUT _REC_VAL_20_s1 FNC_VALUES 1 SBYTE COLUMN_DIR DIRECT /end RECORD_LAYOUT
/begin RECORD_LAYOUT _REC_CUR_20_u1_u2 FNC_VALUES 1 UBYTE COLUMN_DIR DIRECT /end RECORD_LAYOUT
/begin RECORD_LAYOUT _REC_MAP_20_u2_u2_u2 FNC_VALUES 1 UWORD COLUMN_DIR DIRECT /end RECORD_LAYOUT
/begin RECORD_LAYOUT _REC_MAP_20_u2_u1_u2 FNC_VALUES 1 UWORD COLUMN_DIR DIRECT /end RECORD_LAYOUT
/begin RECORD_LAYOUT _REC_VAL_20_u4 FNC_VALUES 1 ULONG COLUMN_DIR DIRECT /end RECORD_LAYOUT
/begin RECORD_LAYOUT _REC_MAP_20_u1_u1_u2 FNC_VALUES 1 UBYTE COLUMN_DIR DIRECT /end RECORD_LAYOUT
/begin RECORD_LAYOUT _REC_MAP_20_u4_u1_u2 FNC_VALUES 1 ULONG COLUMN_DIR DIRECT /end RECORD_LAYOUT
/begin FUNCTION LACO_Lambda_control_conditions "Lambda_control_conditions"
 /begin DEF_CHARACTERISTIC c_maf_int_min_lam_reac ip_t_lam_not_stat_cdn c_t_min_lam_reac ip_fac_neut_max_not_stat_cdn ip_fac_neut_min_not_stat_cdn c_maf_int_min_lam_reac_opt /end DEF_CHARACTERISTIC
 /begin OUT_MEASUREMENT laco[0].laco_struct_reqgncdn0.crk_dif_soi_lsl_pos laco[0].laco_struct_reqgncdn0.maf_int_lam_reac laco[0].laco_struct_reqgncdn0.t_lam_reac laco[0].laco_struct_reqgncdn0.lv_lam_stop laco[0].laco_struct_reqgncdn0.lv_lam_stop_sho_per laco[0].laco_struct_reqgncdn0.lv_lam_act_dc laco[0].laco_struct_reqgncdn0.state_ls laco[1].laco_struct_reqgncdn0.crk_dif_soi_lsl_pos laco[1].laco_struct_reqgncdn0.maf_int_lam_reac laco[1].laco_struct_reqgncdn0.t_lam_reac laco[1].laco_struct_reqgncdn0.lv_lam_stop laco[1].laco_struct_reqgncdn0.lv_lam_stop_sho_per laco[1].laco_struct_reqgncdn0.lv_lam_act_dc laco[1].laco_struct_reqgncdn0.state_ls lv_lam_not_stat_cdn t_lam_not_stat_cdn /end OUT_MEASUREMENT
/end FUNCTION
/begin FUNCTION LACO_Vld_cdn_chk_WRAF_char_ad "Vld_cdn_chk_WRAF_char_ad"
 /begin DEF_CHARACTERISTIC c_lamb_delta_dif_i_mmv_lam_adj c_lamb_delta_p_max_lam_adj_cdn c_lamb_delta_p_min_lam_adj_cdn c_maf_int_thd_lam_adj_cdn c_maf_max_lam_adj_cdn c_maf_min_lam_adj_cdn c_n_max_lam_adj_cdn c_n_min_lam_adj_cdn /end DEF_CHARACTERISTIC
 /begin OUT_MEASUREMENT laco[0].laco_struct_reqgntrcdn0.maf_int_lam_adj_cdn laco[0].laco_struct_reqgntrcdn0.lv_lam_adj_ad_cdn_ok laco[1].laco_struct_reqgntrcdn0.maf_int_lam_adj_cdn laco[1].laco_struct_reqgntrcdn0.lv_lam_adj_ad_cdn_ok /end OUT_MEASUREMENT
/end FUNCTION
/begin FUNCTION LACO_WRAF_sens_char_ad_trim_ctl "WRAF_sens_char_ad_tri_ctl"
 /begin DEF_CHARACTERISTIC c_crlc_lamb_delta_ad_lam_adj c_lamb_delta_max_lam_adj_ad c_lamb_delta_min_lam_adj_ad c_nr_raf_chg_wait_lam_adj c_lamb_delta_bas_lam_adj_is[0] c_lamb_delta_bas_lam_adj_is[1] ldp_maf_ip_lamb_delta_bas ldp_n_32_ip_lamb_delta_bas ip_lamb_delta_bas_lam_adj[0] ip_lamb_delta_bas_lam_adj[1] /end DEF_CHARACTERISTIC
 /begin OUT_MEASUREMENT laco[0].laco_struct_reqgntrimad0.lamb_delta_dif_i_lam_adj_ad laco[0].laco_struct_reqgntrimad0.lamb_delta_sum_lam_adj_ad laco[0].laco_struct_reqgntrimad0.lamb_delta_ad_lam_adj laco[0].laco_struct_reqgntrimad0.lamb_delta_bas_lam_adj_ad laco[0].laco_struct_reqgntrimad0.ctr_raf_chg_lam_adj laco[0].laco_struct_reqgntrimad0.lv_lam_adj_ad_req laco[1].laco_struct_reqgntrimad0.lamb_delta_dif_i_lam_adj_ad laco[1].laco_struct_reqgntrimad0.lamb_delta_sum_lam_adj_ad laco[1].laco_struct_reqgntrimad0.lamb_delta_ad_lam_adj laco[1].laco_struct_reqgntrimad0.lamb_delta_bas_lam_adj_ad laco[1].laco_struct_reqgntrimad0.ctr_raf_chg_lam_adj laco[1].laco_struct_reqgntrimad0.lv_lam_adj_ad_req /end OUT_MEASUREMENT
/end FUNCTION
/begin FUNCTION LACO_Lambda_adaptation_WUP "Lambda_adaptation_WUP"
 /begin DEF_CHARACTERISTIC c_crlc_global_fac_lam_ad_wup c_ctr_tco_min_inter c_fac_lam_ad_wup_delta c_fac_lam_ad_wup_min_gap c_fac_lam_ad_wup_max_inter c_fac_lam_ad_wup_min_inter c_fac_lam_ad_wup_max_lscl_off c_tco_a_lam_ad_wup c_tco_b_lam_ad_wup c_tco_c_lam_ad_wup c_tco_d_lam_ad_wup c_tco_e_lam_ad_wup c_tco_f_lam_ad_wup id_mff_sp_bol_lam_ad_wup c_mff_sp_tol_lam_ad_wup c_n_tol_lam_ad_wup c_n_bol_lam_ad_wup c_crlc_fac_dif_lam_ad_wup_mv c_t_max_lam_ad_wup_ldc c_t_max_lam_ad_wup_tra_pha c_tco_lam_ad_wup_rng c_crlc_fac_lam_tco_x c_crlc_fac_lam_tco_x_first_dc c_fac_lam_ad_wup_min_lscl_off c_thd_dif_l_rng_lam_ad c_thd_fac_delta_l_rng lc_fac_raw_lam_ad_wup_lim_act lc_lam_ad_wup_shift_act lc_lam_ad_wup_clr_inh ldp_n_32_id_mff_bol_lam_ad_wup id_fac_thd_chg_fq_det ip_fac_lam_ad_wup_max ip_fac_chg_fq_det_sca ip_fac_lam_ad_wup_min ip_fac_wup_fac_lam_ad_wup c_tco_rng_wr_down_lam_ad_wup lc_fac_wr_down_lam_ad_wup /end DEF_CHARACTERISTIC
 /begin OUT_MEASUREMENT laco[0].laco_struct_ispcladaw0.fac_lam_tco_min laco[0].laco_struct_ispcladaw0.fac_lam_ad_wup laco[0].laco_struct_ispcladaw0.fac_lam_adj_lam_ad_wup laco[0].laco_struct_ispcladaw0.fac_lam_dif_lam_ad_wup_mv laco[0].laco_struct_ispcladaw0.fac_lam_tco_a laco[0].laco_struct_ispcladaw0.fac_lam_tco_b laco[0].laco_struct_ispcladaw0.fac_lam_tco_c laco[0].laco_struct_ispcladaw0.fac_lam_tco_d laco[0].laco_struct_ispcladaw0.fac_lam_tco_e laco[0].laco_struct_ispcladaw0.fac_lam_ad_wup_shift laco[0].laco_struct_ispcladaw0.fac_beg_l_rng_lam_ad laco[0].laco_struct_ispcladaw0.fac_lam_add_chg_fq_det laco[0].laco_struct_ispcladaw0.t_lam_ad_wup_ldc laco[0].laco_struct_ispcladaw0.t_lam_ad_wup_tra_pha laco[0].laco_struct_ispcladaw0.tco_min_lam_ad_wup laco[0].laco_struct_ispcladaw0.tco_min_inter_lam_ad_wup laco[0].laco_struct_ispcladaw0.tco_a_lam_ad_wup laco[0].laco_struct_ispcladaw0.tco_b_lam_ad_wup laco[0].laco_struct_ispcladaw0.tco_c_lam_ad_wup laco[0].laco_struct_ispcladaw0.tco_d_lam_ad_wup laco[0].laco_struct_ispcladaw0.tco_e_lam_ad_wup laco[0].laco_struct_ispcladaw0.ctr_tco_min_inter laco[0].laco_struct_ispcladaw0.crlc_fac_lam_tco_x laco[0].laco_struct_ispcladaw0.lv_tco_a_lam_ad_wup laco[0].laco_struct_ispcladaw0.lv_tco_b_lam_ad_wup laco[0].laco_struct_ispcladaw0.lv_tco_c_lam_ad_wup laco[0].laco_struct_ispcladaw0.lv_tco_d_lam_ad_wup laco[0].laco_struct_ispcladaw0.lv_tco_e_lam_ad_wup laco[0].laco_struct_ispcladaw0.lv_tco_min_lam_ad_wup laco[0].laco_struct_ispcladaw0.lv_tco_min_inter_lam_ad_wup laco[0].laco_struct_ispcladaw0.lv_fac_lam_adj_lam_ad_wup laco[0].laco_struct_ispcladaw0.lv_lam_ad_wup_stop laco[0].laco_struct_ispcladaw0.lv_load_vld laco[0].laco_struct_ispcladaw0.lv_ctr_max_tco_min_inter laco[0].laco_struct_ispcladaw0.lv_t_max_lam_ad_wup_tra_pha laco[0].laco_struct_ispcladaw0.lv_lam_ad_wup_chg_fq_det laco[1].laco_struct_ispcladaw0.fac_lam_tco_min laco[1].laco_struct_ispcladaw0.fac_lam_ad_wup laco[1].laco_struct_ispcladaw0.fac_lam_adj_lam_ad_wup laco[1].laco_struct_ispcladaw0.fac_lam_dif_lam_ad_wup_mv laco[1].laco_struct_ispcladaw0.fac_lam_tco_a laco[1].laco_struct_ispcladaw0.fac_lam_tco_b laco[1].laco_struct_ispcladaw0.fac_lam_tco_c laco[1].laco_struct_ispcladaw0.fac_lam_tco_d laco[1].laco_struct_ispcladaw0.fac_lam_tco_e laco[1].laco_struct_ispcladaw0.fac_lam_ad_wup_shift laco[1].laco_struct_ispcladaw0.fac_beg_l_rng_lam_ad laco[1].laco_struct_ispcladaw0.fac_lam_add_chg_fq_det laco[1].laco_struct_ispcladaw0.t_lam_ad_wup_ldc laco[1].laco_struct_ispcladaw0.t_lam_ad_wup_tra_pha laco[1].laco_struct_ispcladaw0.tco_min_lam_ad_wup laco[1].laco_struct_ispcladaw0.tco_min_inter_lam_ad_wup laco[1].laco_struct_ispcladaw0.tco_a_lam_ad_wup laco[1].laco_struct_ispcladaw0.tco_b_lam_ad_wup laco[1].laco_struct_ispcladaw0.tco_c_lam_ad_wup laco[1].laco_struct_ispcladaw0.tco_d_lam_ad_wup laco[1].laco_struct_ispcladaw0.tco_e_lam_ad_wup laco[1].laco_struct_ispcladaw0.ctr_tco_min_inter laco[1].laco_struct_ispcladaw0.crlc_fac_lam_tco_x laco[1].laco_struct_ispcladaw0.lv_tco_a_lam_ad_wup laco[1].laco_struct_ispcladaw0.lv_tco_b_lam_ad_wup laco[1].laco_struct_ispcladaw0.lv_tco_c_lam_ad_wup laco[1].laco_struct_ispcladaw0.lv_tco_d_lam_ad_wup laco[1].laco_struct_ispcladaw0.lv_tco_e_lam_ad_wup laco[1].laco_struct_ispcladaw0.lv_tco_min_lam_ad_wup laco[1].laco_struct_ispcladaw0.lv_tco_min_inter_lam_ad_wup laco[1].laco_struct_ispcladaw0.lv_fac_lam_adj_lam_ad_wup laco[1].laco_struct_ispcladaw0.lv_lam_ad_wup_stop laco[1].laco_struct_ispcladaw0.lv_load_vld laco[1].laco_struct_ispcladaw0.lv_ctr_max_tco_min_inter laco[1].laco_struct_ispcladaw0.lv_t_max_lam_ad_wup_tra_pha laco[1].laco_struct_ispcladaw0.lv_lam_ad_wup_chg_fq_det /end OUT_MEASUREMENT
/end FUNCTION
/begin FUNCTION C_B_LACO ""
 /begin SUB_FUNCTION LACO_Fuel_system_monitoring LACO_Activation_fuel_system_mon LACO_Fuel_system_monitoring_AI /end SUB_FUNCTION
/end FUNCTION
/begin FUNCTION LACO_Fuel_system_monitoring "Fuel_system_monitoring"
 /begin DEF_CHARACTERISTIC c_fac_lam_out_max_fsd c_fac_lam_out_min_fsd c_crlc_t_sum_win_fsd_rst c_t_lam_ad_act_min_fsd c_t_lam_lim_lam_ad_req c_t_sum_min_thd_fsd c_t_sum_max_thd_fsd_lam_lim c_t_sum_min_thd_fsd_lam_lim c_t_sum_max_thd_fsd c_t_sum_rst_fsd /end DEF_CHARACTERISTIC
 /begin OUT_MEASUREMENT laco[0].laco_struct_fctdgfsd0.t_sum_end_diag_win_fsd_add laco[0].laco_struct_fctdgfsd0.t_lam_ad_act_fsd laco[0].laco_struct_fctdgfsd0.t_lam_lim_lam_ad_req laco[0].laco_struct_fctdgfsd0.t_sum_end_diag_win_fsd laco[0].laco_struct_fctdgfsd0.t_sum_end_diag_win_fsd_h_rng laco[0].laco_struct_fctdgfsd0.t_sum_end_diag_win_fsd_lam laco[0].laco_struct_fctdgfsd0.t_sum_max_fsd laco[0].laco_struct_fctdgfsd0.t_sum_max_fsd_h_rng laco[0].laco_struct_fctdgfsd0.t_sum_max_fsd_lam_lim laco[0].laco_struct_fctdgfsd0.t_sum_min_fsd laco[0].laco_struct_fctdgfsd0.t_sum_min_fsd_h_rng laco[0].laco_struct_fctdgfsd0.t_sum_min_fsd_lam_lim laco[0].laco_struct_fctdgfsd0.t_sum_rst_fsd laco[0].laco_struct_fctdgfsd0.t_sum_rst_fsd_h_rng laco[0].laco_struct_fctdgfsd0.t_sum_rst_fsd_lam_lim laco[0].laco_struct_fctdgfsd0.t_sum_end_diag_win_fsd_fac_l laco[0].laco_struct_fctdgfsd0.lv_err_fsd laco[0].laco_struct_fctdgfsd0.lv_err_fsd_lam_lim laco[0].laco_struct_fctdgfsd0.lv_err_fsd_h_rng laco[0].laco_struct_fctdgfsd0.lv_end_diag_win_fsd laco[0].laco_struct_fctdgfsd0.lv_end_diag_win_fsd_lam_lim laco[0].laco_struct_fctdgfsd0.lv_lam_lim_lam_ad laco[1].laco_struct_fctdgfsd0.t_sum_end_diag_win_fsd_add laco[1].laco_struct_fctdgfsd0.t_lam_ad_act_fsd laco[1].laco_struct_fctdgfsd0.t_lam_lim_lam_ad_req laco[1].laco_struct_fctdgfsd0.t_sum_end_diag_win_fsd laco[1].laco_struct_fctdgfsd0.t_sum_end_diag_win_fsd_h_rng laco[1].laco_struct_fctdgfsd0.t_sum_end_diag_win_fsd_lam laco[1].laco_struct_fctdgfsd0.t_sum_max_fsd laco[1].laco_struct_fctdgfsd0.t_sum_max_fsd_h_rng laco[1].laco_struct_fctdgfsd0.t_sum_max_fsd_lam_lim laco[1].laco_struct_fctdgfsd0.t_sum_min_fsd laco[1].laco_struct_fctdgfsd0.t_sum_min_fsd_h_rng laco[1].laco_struct_fctdgfsd0.t_sum_min_fsd_lam_lim laco[1].laco_struct_fctdgfsd0.t_sum_rst_fsd laco[1].laco_struct_fctdgfsd0.t_sum_rst_fsd_h_rng laco[1].laco_struct_fctdgfsd0.t_sum_rst_fsd_lam_lim laco[1].laco_struct_fctdgfsd0.t_sum_end_diag_win_fsd_fac_l laco[1].laco_struct_fctdgfsd0.lv_err_fsd laco[1].laco_struct_fctdgfsd0.lv_err_fsd_lam_lim laco[1].laco_struct_fctdgfsd0.lv_err_fsd_h_rng laco[1].laco_struct_fctdgfsd0.lv_end_diag_win_fsd laco[1].laco_struct_fctdgfsd0.lv_end_diag_win_fsd_lam_lim laco[1].laco_struct_fctdgfsd0.lv_lam_lim_lam_ad /end OUT_MEASUREMENT
/end FUNCTION
/begin FUNCTION LACO_Activation_fuel_system_mon "Activation_fuel_system_mon"
 /begin DEF_CHARACTERISTIC c_amp_min_fsd c_maf_min_fsd c_n_min_fsd c_ctr_max_fsd_stop_oil c_tia_min_fsd ldp_tco_st_id_ctr_inc_fsd_stop id_ctr_inc_fsd_stop_oil c_tco_min_fsd c_tam_min_fsd ldp_toil_id_dly_dec_fsd_oil id_dly_dec_fsd_stop_oil /end DEF_CHARACTERISTIC
 /begin OUT_MEASUREMENT laco[0].laco_struct_fctdgfsda0.lv_fsd_act laco[1].laco_struct_fctdgfsda0.lv_fsd_act ctr_stop_fsd lv_inh_fsd_stop_oil dly_dec_fsd_stop_oil t_dec_fsd_stop_oil /end OUT_MEASUREMENT
/end FUNCTION
/begin FUNCTION LACO_Fuel_system_monitoring_AI "Fuel_system_monitoring_AI" /begin DEF_CHARACTERISTIC lc_inh_fsd_man_deac c_cl_mmv_max_fsd /end DEF_CHARACTERISTIC
 /begin OUT_MEASUREMENT laco[0].laco_struct_fctdgfsdi0.lv_inh_diag_fsd laco[0].laco_struct_fctdgfsdi0.lv_inh_diag_fsd_cp laco[0].laco_struct_fctdgfsdi0.lv_fac_l_rng_lim_min_fsd laco[0].laco_struct_fctdgfsdi0.lv_fac_l_rng_lim_max_fsd laco[1].laco_struct_fctdgfsdi0.lv_inh_diag_fsd laco[1].laco_struct_fctdgfsdi0.lv_inh_diag_fsd_cp laco[1].laco_struct_fctdgfsdi0.lv_fac_l_rng_lim_min_fsd laco[1].laco_struct_fctdgfsdi0.lv_fac_l_rng_lim_max_fsd /end OUT_MEASUREMENT
/end FUNCTION
/begin FUNCTION C_4_ENRD ""
 /begin SUB_FUNCTION ENRD_Calculation ENRD_Calculation_Appli_Inci ENRD_Segment_Time_Correction ENRD_Adaptive_Learning_Process /end SUB_FUNCTION
/end FUNCTION
/begin FUNCTION ENRD_Calculation ""
 /begin DEF_CHARACTERISTIC c_n_max_er c_n_min_er ip_fac_gain_er_mt_0 ip_fac_gain_er_mt_1 ip_fac_gain_er_mt_2 ip_fac_gain_er_mt_6 ip_fac_gain_er_mt_3 ip_fac_gain_er_mt_4 ip_fac_gain_er_mt_5 ldp_load_ip_fac_add_er_mt_1 ldp_load_ip_fac_add_er_at_1 ldp_load_ip_fac_add_er_at_2 ldp_load_ip_fac_add_er_mt_4 ldp_load_ip_fac_add_er_at_6 ldp_load_ip_fac_add_er_at_3 ldp_load_ip_fac_add_er_mt_7 ldp_load_ip_fac_add_er_mt_3 ldp_load_ip_fac_add_er_at_7 ldp_load_ip_fac_add_er_at_4 ldp_load_ip_fac_add_er_mt_5 ldp_load_ip_fac_add_er_at_5 ldp_load_ip_fac_add_er_mt_2 ldp_load_ip_fac_add_er_mt_6 c_fac_sca_er_stnd c_n_max_er_stnd ip_fac_gain_er_at_0 ip_fac_gain_er_at_1 ip_fac_gain_er_at_2 ip_fac_gain_er_at_6 ip_fac_gain_er_at_3 ip_fac_gain_er_at_4 ip_fac_gain_er_at_5 ip_fac_add_er_mt_1 ip_fac_add_er_mt_2 ip_fac_add_er_mt_6 ip_fac_add_er_mt_4 ip_fac_add_er_mt_3 ip_fac_add_er_mt_7 ip_fac_add_er_mt_5 ip_fac_add_er_at_0 ip_fac_add_er_at_1 ip_fac_add_er_at_2 ip_fac_add_er_at_6 ip_fac_add_er_at_3 ip_fac_add_er_at_4 ip_fac_add_er_at_5 c_seg_dly_er ldp_n_32_2_enrd_0 ldp_n_32_2_enrd_1 ldp_n_32_2_enrd_2 ldp_n_32_2_enrd_3 ldp_n_32_2_enrd_4 ldp_n_32_2_enrd_5 ldp_n_32_2_enrd_6 ldp_n_32_3_enrd_1 ldp_n_32_3_enrd_2 ldp_n_32_3_enrd_3 ldp_n_32_3_enrd_4 ldp_n_32_3_enrd_5 ldp_n_32_3_enrd_6 ldp_n_32_3_enrd_7 ldp_n_32_4_enrd_0 ldp_n_32_4_enrd_1 ldp_n_32_4_enrd_2 ldp_n_32_4_enrd_3 ldp_n_32_4_enrd_4 ldp_n_32_4_enrd_5 ldp_n_32_4_enrd_6 ldp_n_32_5_enrd_1 ldp_n_32_5_enrd_2 ldp_n_32_5_enrd_3 ldp_n_32_5_enrd_4 ldp_n_32_5_enrd_5 ldp_n_32_5_enrd_6 ldp_n_32_5_enrd_7 ldp_n_32_5_enrd_0 ldp_load_ip_fac_add_er_at_0 ldp_n_32_3_enrd_0 ldp_load_ip_fac_add_er_mt_0 ip_fac_add_er_at_7 ip_fac_add_er_mt_0 ldp_n_32_4_enrd_7 ip_fac_gain_er_at_7 ip_fac_gain_er_mt_7 ldp_n_32_2_enrd_7 /end DEF_CHARACTERISTIC
 /begin OUT_MEASUREMENT drv0_er seg_nr_er lv_ena_er fac_gain_er[0] fac_gain_er[1] fac_gain_er[2] fac_gain_er[3] fac_gain_er[4] fac_gain_er[5] fac_gain_er[6] fac_gain_er[7] fac_add_er[0] fac_add_er[1] fac_add_er[2] fac_add_er[3] fac_add_er[4] fac_add_er[5] fac_add_er[6] fac_add_er[7] drv1_er drv2_er drv2_mmv_er er_raw er er_stnd er_stnd_cyl[0] er_stnd_cyl[1] er_stnd_cyl[2] er_stnd_cyl[3] er_stnd_cyl[4] er_stnd_cyl[5] er_stnd_cyl[6] er_stnd_cyl[7] er_cyl[0] er_cyl[1] er_cyl[2] er_cyl[3] er_cyl[4] er_cyl[5] er_cyl[6] er_cyl[7] /end OUT_MEASUREMENT
/end FUNCTION
/begin FUNCTION ENRD_Calculation_Appli_Inci ""
 /begin DEF_CHARACTERISTIC lc_seg_ad_rst_ena_eol c_gr_inh_er_ad_at c_gr_inh_er_ad_mt c_crlc_drv2_zdly_er c_t_drv2_zdly_er c_n_32_max_drv2_er_is ldp_n_32_ip_fac_n_drv2_er_at ldp_load_mis_ip_fac_drv2_er_at ip_fac_drv2_er_at ldp_n_ip_fac_n_drv2_er_is_at ldp_load_ip_fac_drv2_er_is_at ip_fac_drv2_er_is_at ldp_n_32_ip_crlc_drv2_er_at ip_crlc_drv2_er_at ldp_n_32_ip_fac_n_drv2_er_mt ldp_load_mis_ip_fac_drv2_er_mt ip_fac_drv2_er_mt ldp_n_ip_fac_n_drv2_er_is_mt ldp_load_ip_fac_drv2_er_is_mt ip_fac_drv2_er_is_mt ldp_n_32_ip_crlc_drv2_er_mt ip_crlc_drv2_er_mt ldp_tco_ip_fac_drv2_zdly_er ip_fac_drv2_zdly_er /end DEF_CHARACTERISTIC
 /begin OUT_MEASUREMENT lv_inh_app_er_ad lv_inh_obd_er_ad lv_seg_ad_rst_er_eol lv_req_seg_ad_mmv_er_app seg_ad_mmv_er_app[0] seg_ad_mmv_er_app[1] seg_ad_mmv_er_app[2] seg_ad_mmv_er_app[3] seg_ad_mmv_er_app[4] seg_ad_mmv_er_app[5] seg_ad_mmv_er_app[6] seg_ad_mmv_er_app[7] er_av_quo crlc_drv2_er fac_drv2_er /end OUT_MEASUREMENT
/end FUNCTION
/begin FUNCTION ENRD_Segment_Time_Correction ""
 /begin DEF_CHARACTERISTIC ldpm_n_32_2_enrd ldpm_n_32_3_enrd ldpm_n_32_4_enrd ldpm_n_32_5_enrd c_seg_t_mes_max c_seg_t_mes_min ldpm_n_32_6_enrd ip_seg_ad_cor_er_mt_1 ip_seg_ad_cor_er_at_1 ip_seg_ad_cor_er_mt_2 ip_seg_ad_cor_er_at_2 ip_seg_ad_cor_er_mt_3 ip_seg_ad_cor_er_at_3 ldpm_n_32_1_enrd /end DEF_CHARACTERISTIC
 /begin OUT_MEASUREMENT seg_ad_cor_er seg_nr_mes seg_t_mes seg_t_cor_buf[0] seg_t_cor_buf[1] seg_t_cor_buf[2] seg_t_cor_buf[3] seg_t_cor_buf[4] seg_t_cor_buf[5] seg_t_cor_buf[6] seg_t_cor_buf[7] seg_t_cor_buf[8] seg_t_cor lv_ena_seg_t_mes seg_t_mes_cyl[0] seg_t_mes_cyl[1] seg_t_mes_cyl[2] seg_t_mes_cyl[3] seg_t_mes_cyl[4] seg_t_mes_cyl[5] seg_t_mes_cyl[6] seg_t_mes_cyl[7] /end OUT_MEASUREMENT
/end FUNCTION
/begin FUNCTION ENRD_Adaptive_Learning_Process ""
 /begin DEF_CHARACTERISTIC c_crk_dif_max_er c_seg_ad_max_er c_seg_ad_dif_max_er ldp_maf_ip_maf_dif_max_er_ad ldp_load_mis_ip_load_grd_er_ad ldp_tps_av_ip_tps_grd_max_er c_t_maf_dif_dly_er_ad c_t_load_grd_dly_er_ad c_t_tps_grd_dly_er_ad c_t_accout_dly_er_ad c_drv1_max_seg_ad_er_eol c_nr_seg_ad_act_min_er_eol c_nr_seg_drv1_min_er_eol lc_seg_ad_er_req_eol c_n_seg_t_ad_raw_max_er c_n_seg_t_ad_raw_min_er c_drv1_max_seg_ad_er c_nr_seg_ad_act_min_er c_nr_seg_drv1_min_er c_crlc_seg_ad_er c_crlc_seg_ad_er_eol c_nr_seg_ad_avl_er lc_seg_ad_lim_reac_er c_crlc_fast_seg_ad_er c_crlc_seg_ad_raw_er ip_maf_dif_max_er_ad ip_load_grd_er_ad ip_tps_grd_max_er_ad c_mask_seg_ad_fdout_er c_n_max_seg_ad_er_eol_mt c_n_max_seg_ad_er_eol_at c_n_min_seg_ad_er_eol_mt c_n_min_seg_ad_er_eol_at c_n_min_l_seg_ad_er_at c_n_min_l_seg_ad_er_mt c_n_max_h_seg_ad_er_at c_n_max_mid_seg_ad_er_at c_n_max_l_seg_ad_er_at c_n_max_h_seg_ad_er_mt c_n_max_mid_seg_ad_er_mt c_n_max_l_seg_ad_er_mt /end DEF_CHARACTERISTIC
 /begin OUT_MEASUREMENT delta_crk_dif_max_er seg_ad_raw_mmv_er[0] seg_ad_raw_mmv_er[1] seg_ad_raw_mmv_er[2] seg_ad_raw_mmv_er[3] seg_ad_raw_mmv_er[4] seg_ad_raw_mmv_er[5] seg_ad_raw_mmv_er[6] seg_ad_raw_mmv_er[7] seg_ad_dif_er_0 seg_ad_dif_er_1 seg_ad_dif_er_2 seg_ad_dif_er_3 thd_ad_er lv_seg_ad_fdout_er lv_seg_ad_dif_max_er lv_seg_ad_fdout_er_eol crlc_seg_ad_er ctr_seg_ad_er lv_seg_ad_avl_er lv_seg_ad_raw_er lv_seg_ad_lim_er seg_ad_fdout_er_cdn seg_ad_fdout_er_cdn.lv_inh_maf_dif_er_ad seg_ad_fdout_er_cdn.lv_inh_load_grd_max_er_ad seg_ad_fdout_er_cdn.lv_inh_tps_grd_er_ad seg_ad_fdout_er_cdn.lv_inh_acc_er_ad seg_ad_fdout_er_cdn_nr lv_seg_ad_er lv_seg_ad_n_vld seg_ad_mmv_er[0] seg_ad_mmv_er[1] seg_ad_mmv_er[2] seg_ad_mmv_er[3] seg_ad_mmv_er[4] seg_ad_mmv_er[5] seg_ad_mmv_er[6] seg_ad_mmv_er[7] seg_ad_mmv_er_l[0] seg_ad_mmv_er_l[1] seg_ad_mmv_er_l[2] seg_ad_mmv_er_l[3] seg_ad_mmv_er_l[4] seg_ad_mmv_er_l[5] seg_ad_mmv_er_l[6] seg_ad_mmv_er_l[7] seg_ad_mmv_er_mid[0] seg_ad_mmv_er_mid[1] seg_ad_mmv_er_mid[2] seg_ad_mmv_er_mid[3] seg_ad_mmv_er_mid[4] seg_ad_mmv_er_mid[5] seg_ad_mmv_er_mid[6] seg_ad_mmv_er_mid[7] seg_ad_mmv_er_h[0] seg_ad_mmv_er_h[1] seg_ad_mmv_er_h[2] seg_ad_mmv_er_h[3] seg_ad_mmv_er_h[4] seg_ad_mmv_er_h[5] seg_ad_mmv_er_h[6] seg_ad_mmv_er_h[7] /end OUT_MEASUREMENT
/end FUNCTION
/begin FUNCTION C_A_ENRD "" /begin SUB_FUNCTION ENRD_Diagnosis ENRD_Diagnosis_Appli_Inci /end SUB_FUNCTION /end FUNCTION
/begin FUNCTION ENRD_Diagnosis ""
 /begin DEF_CHARACTERISTIC lc_cdn_diag_seg_ad_er c_abc_inc_seg_ad_er c_abc_inc_t_seg_er c_abc_max_seg_ad_er c_abc_max_t_seg_er /end DEF_CHARACTERISTIC
 /begin OUT_MEASUREMENT lv_err_t_seg_er lv_err_seg_ad_er /end OUT_MEASUREMENT
/end FUNCTION
/begin FUNCTION ENRD_Diagnosis_Appli_Inci "" /end FUNCTION
/begin FUNCTION C_4_ENSD "C_4_ENSD" /begin DEF_CHARACTERISTIC ldpm_n_32_1_ensd ldpm_n_32_2_ensd /end DEF_CHARACTERISTIC
 /begin SUB_FUNCTION ENSD_Engine_position_control ENSD_Engine_pos_speed_calc ENSD_Camshaft_adaptation ENSD_Synchro_det_in_Cam_LH /end SUB_FUNCTION
/end FUNCTION
/begin FUNCTION ENSD_Engine_position_control "Engine_position_control"
 /begin DEF_CHARACTERISTIC lc_inh_lih_crk lc_inh_lih_cam c_t_dly_stop_eng id_nr_vld_cam_syn_crk ldp_n_id_nr_vld_cam_syn_crk /end DEF_CHARACTERISTIC
 /begin OUT_MEASUREMENT lv_run_eng lv_syn_eng lv_syn_vld lv_lih_err_crk lv_lih_err_cam lv_act_crk lv_err_lih_crk_cam ctr_vld_cam_syn_crk lv_first_vld_tooth lv_timeout_cam_syn_crk idx_n_ctl_ex[0].lv_act_cam idx_n_ctl_ex[0].lv_act_lih_crk_cam idx_n_ctl_ex[0].lv_act_syn_crk_cam idx_n_ctl_ex[1].lv_act_cam idx_n_ctl_ex[1].lv_act_lih_crk_cam idx_n_ctl_ex[1].lv_act_syn_crk_cam idx_n_ctl_in[0].lv_act_cam idx_n_ctl_in[0].lv_act_lih_crk_cam idx_n_ctl_in[0].lv_act_syn_crk_cam idx_n_ctl_in[1].lv_act_cam idx_n_ctl_in[1].lv_act_lih_crk_cam idx_n_ctl_in[1].lv_act_syn_crk_cam lv_err_cam lv_eng_back_det lv_eng_back_cfm lv_crk_miss_run_eng /end OUT_MEASUREMENT
/end FUNCTION
/end MODULE
/end PROJECT
