ASAP2_VERSION 1 3
/begin PROJECT _725D601B "725D601B"
/begin HEADER "" VERSION "_725D601B" PROJECT_NO _725D601B /end HEADER
/begin MODULE DIM ""
/begin MOD_COMMON "" BYTE_ORDER MSB_FIRST ALIGNMENT_BYTE 1 ALIGNMENT_WORD 2 ALIGNMENT_LONG 2 ALIGNMENT_FLOAT32_IEEE 4 /end MOD_COMMON
/begin CHARACTERISTIC APPTBATINI "Enable Applikation Initwert Batterietemperatur" VALUE 0xFCBFEC KwWU8 255.0 dez 0.00 255.0 FORMAT "%5.1" /end CHARACTERISTIC
/begin CHARACTERISTIC BATTHTAUVG "Zeitkonstante Batterie hinten bei VFZG>" VALUE 0xFCBFFC KwWR32 1.000000000000000 fak_r32_1 0.00 1.000000000000000 FORMAT "%27.25" /end CHARACTERISTIC
/begin CHARACTERISTIC BATTHTAUVK "Zeitkonstante Batterie hinten bei VFZG<" VALUE 0xFCC000 KwWR32 1.000000000000000 fak_r32_1 0.00 1.000000000000000 FORMAT "%27.25" /end CHARACTERISTIC
/begin CHARACTERISTIC BATTORT0 "Batterieeinbauort No1" VALUE 0xFCBFED KwWU8 255.0 dez 0.00 255.0 FORMAT "%5.1" /end CHARACTERISTIC
/begin CHARACTERISTIC BATTORT2 "Batterieeinbauort No2" VALUE 0xFCBFEE KwWU8 255.0 dez 0.00 255.0 FORMAT "%5.1" /end CHARACTERISTIC
/begin CHARACTERISTIC BATTVTAUVG "Zeitkonstante Batterie vorne bei VFZG>" VALUE 0xFCC004 KwWR32 1.000000000000000 fak_r32_1 0.00 1.000000000000000 FORMAT "%27.25" /end CHARACTERISTIC
/begin CHARACTERISTIC BATTVTAUVK "Zeitkonstante Batterie bei VFZG<Zeitkonstante Batterie bei VFZG>" VALUE 0xFCC008 KwWR32 1.000000000000000 fak_r32_1 0.00 1.000000000000000 FORMAT "%27.25" /end CHARACTERISTIC
/begin CHARACTERISTIC BATT_ALFAH "Alphatau-Wert Batterie hinten" VALUE 0xFCC00C KwWR32 0.999990000000000 fak_r32_1 0.000010000000000 1.000000000000000 FORMAT "%27.25" /end CHARACTERISTIC
/begin CHARACTERISTIC BATT_ALFAV "Alphatau-Wert Batterie vorne" VALUE 0xFCC010 KwWR32 0.999990000000000 fak_r32_1 0.000010000000000 1.000000000000000 FORMAT "%27.25" /end CHARACTERISTIC
/begin CHARACTERISTIC BATT_BETAV "Beta-Wert Batterie vorne" VALUE 0xFCC014 KwWR32 0.999990000000000 fak_r32_1 0.000010000000000 1.000000000000000 FORMAT "%27.25" /end CHARACTERISTIC
/begin CHARACTERISTIC BATVFZGTAU "VFZG-Umschaltschwelle TAU Batterie" VALUE 0xFCBFEF KwWU8 318.8 vfzg_ub_q1p25 0.00 318.8 FORMAT "%5.1" /end CHARACTERISTIC
/begin CHARACTERISTIC B_APP_LLAH "" VALUE 0xFCC055 KwWU8 255.0 dez 0.00 255.0 FORMAT "%5.1" /end CHARACTERISTIC
/begin CHARACTERISTIC B_IFBSAKAP "Appl-para. f¸r Bedingung Fehler vom BSD" VALUE 0xFCC106 KwWU8 255.0 DEZ 0.00 255.0 FORMAT "%5.1" /end CHARACTERISTIC
/begin CHARACTERISTIC B_IFUPLAAP "Apll-par. f¸r Bedg. Fehler vom IBS" VALUE 0xFCC107 KwWU8 255.0 DEZ 0.00 255.0 FORMAT "%5.1" /end CHARACTERISTIC
/begin CHARACTERISTIC CNFKUPPL "Konfigurationsflag f¸r die Auswertung des Kuplg.schalters in der LLR" VALUE 0xFD312D KwUb 255.0 dez 0.00 255.0 FORMAT "%5.1" /end CHARACTERISTIC
/begin CHARACTERISTIC CWBATTCOD "" VALUE 0xFCBFF0 KwWU8 1.000 DEZ 0.00 1.000 FORMAT "%5.3" /end CHARACTERISTIC
/begin CHARACTERISTIC CWGENPROT "" VALUE 0xFC8118 KwWU8 255.0 default 0.00 255.0 FORMAT "%5.1" /end CHARACTERISTIC
/begin CHARACTERISTIC CWLAKH "Codewort f¸r Funktion %LAKH" VALUE 0xFD2B2C KwUb 255.0 dez 0.00 255.0 FORMAT "%5.1" /end CHARACTERISTIC
/begin CHARACTERISTIC CWLAMKH "Codewort Lambdakoordination bei Kat-heizen" VALUE 0xFC7695 KwUb 255.0 dez 0.00 255.0 FORMAT "%5.1" /end CHARACTERISTIC
/begin CHARACTERISTIC CWLLRBB "Codewort zur Abschaltung des pd-Anteils in Teillast wenn dn>0" VALUE 0xFD312E KwUb 255.0 dez 0.00 255.0 FORMAT "%5.1" /end CHARACTERISTIC
/begin CHARACTERISTIC CWLLRMR "Codewort f¸r LLR-Momentenreserve" VALUE 0xFC8A86 KwUb 255.0 dez 0.00 255.0 FORMAT "%5.1" /end CHARACTERISTIC
/begin CHARACTERISTIC CW_BNSFSMN "" VALUE 0xFC87B0 KwWU8 255.0 default 0.00 255.0 FORMAT "%5.1" /end CHARACTERISTIC
/begin CHARACTERISTIC CW_BNSLLMN "" VALUE 0xFC87B1 KwWU8 255.0 default 0.00 255.0 FORMAT "%5.1" /end CHARACTERISTIC
/begin CHARACTERISTIC CW_BNS_LR "" VALUE 0xFCC0EE KwWU8 255.0 DEZ 0.00 255.0 FORMAT "%5.1" /end CHARACTERISTIC
/begin CHARACTERISTIC DELTADFFMX "" VALUE 0xFC87B6 KwSb 99.61 rel_ub_b100 -50.00 49.61 FORMAT "%5.2" /end CHARACTERISTIC
/begin CHARACTERISTIC DFFLIM "" VALUE 0xFC87B7 KwUb 99.61 rel_ub_b100 0.00 99.61 FORMAT "%5.2" /end CHARACTERISTIC
/begin CHARACTERISTIC DFFLLANH "" VALUE 0xFC87B8 KwUb 99.61 rel_ub_b100 0.00 99.61 FORMAT "%5.2" /end CHARACTERISTIC
/begin CHARACTERISTIC DFFSCHZMX "" VALUE 0xFC87B9 KwUb 255.0 dez 0.00 255.0 FORMAT "%5.1" /end CHARACTERISTIC
/begin CHARACTERISTIC DFLLMIN "DF unterhalb derer die LLDZanh. zurueckgenommen wird." VALUE 0xFCC108 KwWU8 100.0 rel_ub_b100 0.00 100.0 FORMAT "%5.1" /end CHARACTERISTIC
/begin CHARACTERISTIC DFMODE "DF-Mode-Schalter themermisch/elektrisch" VALUE 0xFCC050 KwWU8 255.0 dez 0.00 255.0 FORMAT "%5.1" /end CHARACTERISTIC
/begin CHARACTERISTIC DFS_MAX "DF-Auslastung Maximalschwelle" VALUE 0xFCC051 KwWU8 99.61 PCENT 0.00 99.61 FORMAT "%5.2" /end CHARACTERISTIC
/begin CHARACTERISTIC DFS_MIN "DF-Auslastung Minimalschwelle" VALUE 0xFCC052 KwWU8 99.61 PCENT 0.00 99.61 FORMAT "%5.2" /end CHARACTERISTIC
/begin CHARACTERISTIC DFS_MITT "DF-Auslastung Mittelschwelle" VALUE 0xFCC053 KwWU8 99.61 PCENT 0.00 99.61 FORMAT "%5.2" /end CHARACTERISTIC
/begin CHARACTERISTIC DI1000DT "" VALUE 0xFD40CB KwUb 12.75 t50msxs_q0p05 0.00 12.75 FORMAT "%5.2" /end CHARACTERISTIC
/begin CHARACTERISTIC DI1000STG "" VALUE 0xFD40CC KwUb 20.400 i_ub_q0p08 0.00 20.400 /end CHARACTERISTIC
/begin CHARACTERISTIC DI1000TGRZ "" VALUE 0xFD40CD KwUb 255.0 t1sxs_ub_b255 0.00 255.0 FORMAT "%5.1" /end CHARACTERISTIC
/begin CHARACTERISTIC DI200DT "" VALUE 0xFD40CE KwUb 12.75 t50msxs_q0p05 0.00 12.75 FORMAT "%5.2" /end CHARACTERISTIC
/begin CHARACTERISTIC DI200STG "" VALUE 0xFD40CF KwUb 5.10000 i_ub_q0p02 0.00 5.10000 FORMAT "%7.5" /end CHARACTERISTIC
/begin CHARACTERISTIC DIHIGHGRZ "" VALUE 0xFD40D0 KwUb 20.400 i_ub_q0p08 0.00 20.400 /end CHARACTERISTIC
/begin CHARACTERISTIC DILOWGRZ "" VALUE 0xFD40D1 KwUb 5.10000 i_ub_q0p02 0.00 5.10000 FORMAT "%7.5" /end CHARACTERISTIC
/begin CHARACTERISTIC DIPL5 "" VALUE 0xFD40D2 KwUb 255.0 dez 0.00 255.0 FORMAT "%5.1" /end CHARACTERISTIC
/begin CHARACTERISTIC DIPL6 "" VALUE 0xFD40D3 KwUb 255.0 dez 0.00 255.0 FORMAT "%5.1" /end CHARACTERISTIC
/begin CHARACTERISTIC DIPL7 "" VALUE 0xFD40D4 KwUb 255.0 dez 0.00 255.0 FORMAT "%5.1" /end CHARACTERISTIC
/begin CHARACTERISTIC DIPL8 "" VALUE 0xFD40D5 KwUb 255.0 dez 0.00 255.0 FORMAT "%5.1" /end CHARACTERISTIC
/begin CHARACTERISTIC DKL15FIL "" VALUE 0xFD40D6 KwUb 1.5938 t_q0p00625 0.00 1.5938 /end CHARACTERISTIC
/begin CHARACTERISTIC DMLLRIMXN "Sicherheitskonzept: obere Begrenzung f¸r dmllri" CURVE 0xFC8984 GklWUb 99.61 rel_ub_b99p6 0.00 99.61 FORMAT "%5.2"
 /begin AXIS_DESCR COM_AXIS nmot nmot_ub_q40 6 0.00 10200. FORMAT "%5.0" AXIS_PTS_REF SNM06LLUB /end AXIS_DESCR
/end CHARACTERISTIC
/begin CHARACTERISTIC DMLLRMN "Untere Begrenzung f¸r dmllr_w" VALUE 0xFC8A56 KwSw 199.9969 rel_sw_b100 -100.0000 99.99695 FORMAT "%8.4" /end CHARACTERISTIC
/begin CHARACTERISTIC DMLLRMXN "Sicherheitskonzept: obere Begrenzung f¸r dmllr" CURVE 0xFC898A GklWUb 99.61 rel_ub_b99p6 0.00 99.61 FORMAT "%5.2"
 /begin AXIS_DESCR COM_AXIS nmot nmot_ub_q40 6 0.00 10200. FORMAT "%5.0" AXIS_PTS_REF SNM06LLUB /end AXIS_DESCR
/end CHARACTERISTIC
/begin CHARACTERISTIC DMLLRZMN "untere Begrenzung f¸r dmllrz_w" VALUE 0xFC8A58 KwSw 199.9969 rel_sw_b100 -100.0000 99.99695 FORMAT "%8.4" /end CHARACTERISTIC
/begin CHARACTERISTIC DMLLRZMXN "obere Begrenzung f¸r dmllrz_w" CURVE 0xFC8990 GklWUb 99.61 rel_ub_b99p6 0.00 99.61 FORMAT "%5.2"
 /begin AXIS_DESCR COM_AXIS nmot nmot_ub_q40 6 0.00 10200. FORMAT "%5.0" AXIS_PTS_REF SNM06LLUB /end AXIS_DESCR
/end CHARACTERISTIC
/begin CHARACTERISTIC DMRESFS "LLR: Abbaugeschwindigkeit der erhˆhten Drehmomentreserve" VALUE 0xFC8A87 KwUb 4.845 relgrad_20ms_qn0p019 -4.845 0.00 FORMAT "%5.3" /end CHARACTERISTIC
/begin CHARACTERISTIC DMRESLL "LLR: Abbaugeschwindigkeit der erhˆhten Drehmomentreserve" VALUE 0xFC8A88 KwUb 4.845 relgrad_20ms_qn0p019 -4.845 0.00 FORMAT "%5.3" /end CHARACTERISTIC
/begin CHARACTERISTIC DNLLR "Drehzahlband oberhalb nstat f¸r LLR-Freigabe" VALUE 0xFD312F KwUb 2550. nmot_ub_q10 0.00 2550. FORMAT "%5.0" /end CHARACTERISTIC
/begin CHARACTERISTIC DNLLRES "LLR: Unterdrehzahlschwelle zur Erhˆhung der Momentenreserve im LL" VALUE 0xFC8A89 KwSb 2550. nmotd_sb_q10 -1280. 1270. FORMAT "%5.0" /end CHARACTERISTIC
/begin CHARACTERISTIC DNMNI "Kleinstmˆglicher Wert f¸r dn beim I-Anteil" VALUE 0xFC8996 KwSb 2550. nmotd_sb_q10 -1280. 1270. FORMAT "%5.0" /end CHARACTERISTIC
/begin CHARACTERISTIC DNSNFX "Offset zur Bestimmung der oberen Grenze f¸r die Solldrehzahlnachf¸hrung" VALUE 0xFC87BA KwUb 2550. nmot_ub_q10 0.00 2550. FORMAT "%5.0" /end CHARACTERISTIC
/begin CHARACTERISTIC DSOCLLANH "Delta zur Startfaehigkeitsgrenze, bei der die LLDZanh aktiviert wird." VALUE 0xFCC102 KwWU16 100.000 fak_q0p004_o100 0.00 100.000 /end CHARACTERISTIC
/begin CHARACTERISTIC DTANSKOR "Ansaugluftmodelloffset Aussentemperatur" VALUE 0xFCBFF1 KwWS8 255.0 temp_q1 -128.0 127.0 FORMAT "%5.1" /end CHARACTERISTIC
/begin CHARACTERISTIC DTANSLL "Hysterese Ansauglufttemperaturschwelle f¸r erhˆhte Leerlaufdrehzahl" VALUE 0xFC87BB KwUb 191.3 temp_ub_q0p75_o48 -48.00 143.3 FORMAT "%5.1" /end CHARACTERISTIC
/begin CHARACTERISTIC DTMAXGRZI "" VALUE 0xFD40D7 KwUb 255.0 t1sxs_ub_b255 0.00 255.0 FORMAT "%5.1" /end CHARACTERISTIC
/begin CHARACTERISTIC DUIGRZ "" VALUE 0xFD40D8 KwUb 5.10000 i_ub_q0p02 0.00 5.10000 FORMAT "%7.5" /end CHARACTERISTIC
/begin CHARACTERISTIC DUMINTGRZ "" VALUE 0xFD40D9 KwUb 12.75 t50msxs_q0p05 0.00 12.75 FORMAT "%5.2" /end CHARACTERISTIC
/begin CHARACTERISTIC DUREFMAX "" VALUE 0xFD40DA KwUb 4.9980 spg_ub_q0p0196 0.00 4.9980 /end CHARACTERISTIC
/begin CHARACTERISTIC DUREFMINI "" VALUE 0xFD40DB KwUb 4.9980 spg_ub_q0p0196 0.00 4.9980 /end CHARACTERISTIC
/begin CHARACTERISTIC DVNG "LLR: D-Verst‰rkung abh. von ngfil bei stehendem Fahrzeug" CURVE 0xFC8997 GklWUb 0.1245 rel_ub_bn0p125 -0.1245 0.00 FORMAT "%6.4"
 /begin AXIS_DESCR COM_AXIS ngfil nmotg_sb_q100 6 -12800. 12700. FORMAT "%5.0" AXIS_PTS_REF SNG06LLSB /end AXIS_DESCR
/end CHARACTERISTIC
/begin CHARACTERISTIC DVNGT "" CURVE 0xFC899D GklWUb 0.1245 rel_ub_bn0p125 -0.1245 0.00 FORMAT "%6.4"
 /begin AXIS_DESCR COM_AXIS ngfil nmotg_sb_q100 6 -12800. 12700. FORMAT "%5.0" AXIS_PTS_REF SNG06LLTSB /end AXIS_DESCR
/end CHARACTERISTIC
/begin CHARACTERISTIC DVNGV "LLR: D-Verst‰rkung abh. von ngfil bei rollendem Fahrzeug" CURVE 0xFC89A3 GklWUb 0.1245 rel_ub_bn0p125 -0.1245 0.00 FORMAT "%6.4"
 /begin AXIS_DESCR COM_AXIS ngfil nmotg_sb_q100 6 -12800. 12700. FORMAT "%5.0" AXIS_PTS_REF SNG06LLSB /end AXIS_DESCR
/end CHARACTERISTIC
/begin CHARACTERISTIC DVNGVT "" CURVE 0xFC89A9 GklWUb 0.1245 rel_ub_bn0p125 -0.1245 0.00 FORMAT "%6.4"
 /begin AXIS_DESCR COM_AXIS ngfil nmotg_sb_q100 6 -12800. 12700. FORMAT "%5.0" AXIS_PTS_REF SNG06LLTSB /end AXIS_DESCR
/end CHARACTERISTIC
/begin CHARACTERISTIC DVZNG "LLR: D-Z¸ndungsanteil abh. vom ngfil bei stehendem Fzg." CURVE 0xFC89AF GklWUb 0.1245 rel_ub_bn0p125 -0.1245 0.00 FORMAT "%6.4"
 /begin AXIS_DESCR COM_AXIS ngfil nmotg_sb_q100 6 -12800. 12700. FORMAT "%5.0" AXIS_PTS_REF SNG06LLSB /end AXIS_DESCR
/end CHARACTERISTIC
/begin CHARACTERISTIC DVZNGT "" CURVE 0xFC89B5 GklWUb 0.1245 rel_ub_bn0p125 -0.1245 0.00 FORMAT "%6.4"
 /begin AXIS_DESCR COM_AXIS ngfil nmotg_sb_q100 6 -12800. 12700. FORMAT "%5.0" AXIS_PTS_REF SNG06LLTSB /end AXIS_DESCR
/end CHARACTERISTIC
/begin CHARACTERISTIC DVZNGV "LLR: D-Z¸ndungsanteil abh. vom ngfil bei rollendem Fzg." CURVE 0xFC89BB GklWUb 0.1245 rel_ub_bn0p125 -0.1245 0.00 FORMAT "%6.4"
 /begin AXIS_DESCR COM_AXIS ngfil nmotg_sb_q100 6 -12800. 12700. FORMAT "%5.0" AXIS_PTS_REF SNG06LLSB /end AXIS_DESCR
/end CHARACTERISTIC
/begin CHARACTERISTIC DVZNGVT "" CURVE 0xFC89C1 GklWUb 0.1245 rel_ub_bn0p125 -0.1245 0.00 FORMAT "%6.4"
 /begin AXIS_DESCR COM_AXIS ngfil nmotg_sb_q100 6 -12800. 12700. FORMAT "%5.0" AXIS_PTS_REF SNG06LLTSB /end AXIS_DESCR
/end CHARACTERISTIC
/begin CHARACTERISTIC ENABSDIBS "" VALUE 0xFD40DC KwUb 255.0 dez 0.00 255.0 FORMAT "%5.1" /end CHARACTERISTIC
/begin CHARACTERISTIC ENAPPLGOFF "Enable Generatorauschaltsteuerung" VALUE 0xFCC0EF KwWU8 255.0 dez 0.00 255.0 FORMAT "%5.1" /end CHARACTERISTIC
/begin CHARACTERISTIC ENAPPLRESP "Enable Handsteuerung Loadresponse" VALUE 0xFCC0F0 KwWU8 255.0 dez 0.00 255.0 FORMAT "%5.1" /end CHARACTERISTIC
/begin CHARACTERISTIC ENISOC0 "" VALUE 0xFD40DD KwUb 5.10000 i_ub_q0p02 0.00 5.10000 FORMAT "%7.5" /end CHARACTERISTIC
/begin CHARACTERISTIC ENUSOC0 "" VALUE 0xFD40DE KwUb 16.320 spg_ub_q0p064_o6 6.0000 22.320 /end CHARACTERISTIC
/begin CHARACTERISTIC ERREPEAT "" VALUE 0xFD40DF KwUb 255.0 dez 0.00 255.0 FORMAT "%5.1" /end CHARACTERISTIC
/begin CHARACTERISTIC FDDN "LLR: Gewichtungsfaktor f¸r D-Verst‰rkung" CURVE 0xFC89C7 GklWUb 0.9961 fak_ub_b1 0.00 0.9961
 /begin AXIS_DESCR COM_AXIS dns nmotd_sb_q10 6 -1280. 1270. FORMAT "%5.0" AXIS_PTS_REF SNS06LLSB /end AXIS_DESCR
/end CHARACTERISTIC
/begin CHARACTERISTIC FDDNT "" CURVE 0xFC89CD GklWUb 0.9961 fak_ub_b1 0.00 0.9961
 /begin AXIS_DESCR COM_AXIS dns nmotd_sb_q10 6 -1280. 1270. FORMAT "%5.0" AXIS_PTS_REF SNS06LLTSB /end AXIS_DESCR
/end CHARACTERISTIC
/begin CHARACTERISTIC FDDZN "LLR: Gewichtungsfaktor f¸r D-Z¸ndungsanteil" CURVE 0xFC89D3 GklWUb 0.9961 fak_ub_b1 0.00 0.9961
 /begin AXIS_DESCR COM_AXIS dns nmotd_sb_q10 6 -1280. 1270. FORMAT "%5.0" AXIS_PTS_REF SNS06LLSB /end AXIS_DESCR
/end CHARACTERISTIC
/begin CHARACTERISTIC FDDZNT "" CURVE 0xFC89D9 GklWUb 0.9961 fak_ub_b1 0.00 0.9961
 /begin AXIS_DESCR COM_AXIS dns nmotd_sb_q10 6 -1280. 1270. FORMAT "%5.0" AXIS_PTS_REF SNS06LLTSB /end AXIS_DESCR
/end CHARACTERISTIC
/begin CHARACTERISTIC FHOGNMN "minimaler Wichtungsfaktor fuer minimale HFM-Luftmassen Schwelle in Abhaengigkeit" VALUE 0xFCC0F1 KwWU8 3.984 fak_ub_b4 0.00 3.984 FORMAT "%5.3" /end CHARACTERISTIC
/begin CHARACTERISTIC FKVAUM "Umrechnungsfaktor Einspritzzeit in Kraftstoffverbrauch" VALUE 0xFCED22 KwWU16 312.5000 tefuel_uw_b312p5 0.00 312.5000 FORMAT "%8.4" /end CHARACTERISTIC
/begin CHARACTERISTIC FNSNF "Faktor f¸r Solldrehzahlnachf¸hrung" VALUE 0xFC87BC KwUb 0.9961 rel_ub_b1p0 0.00 0.9961 /end CHARACTERISTIC
/begin CHARACTERISTIC FNSNFT "Faktor f¸r Solldrehzahlnachf¸hrung gedrosselt" VALUE 0xFC87BD KwUb 0.9961 rel_ub_b1p0 0.00 0.9961 /end CHARACTERISTIC
/begin CHARACTERISTIC FNSSTM "Faktor zur Wichtung der Solldrehzahl im Start" CURVE 0xFD3167 KlAUbSstUbWUb 1.992 fak_ub_b2 0.00 1.992 FORMAT "%5.3"
 /begin AXIS_DESCR STD_AXIS tmot temp_ub_q0p75_o48 6 -48.00 143.3 FORMAT "%5.1" DEPOSIT ABSOLUTE /end AXIS_DESCR
/end CHARACTERISTIC
/begin CHARACTERISTIC FNSSTMT "Faktor zur Wichtung der Solldrehzahl im Start gedrosselt" CURVE 0xFD3174 KlAUbSstUbWUb 1.992 fak_ub_b2 0.00 1.992 FORMAT "%5.3"
 /begin AXIS_DESCR STD_AXIS tmot temp_ub_q0p75_o48 6 -48.00 143.3 FORMAT "%5.1" DEPOSIT ABSOLUTE /end AXIS_DESCR
/end CHARACTERISTIC
/begin CHARACTERISTIC FWVFZG "Geschwindigkeitsschwelle f¸r Erkennung falsche Rollrichtung" VALUE 0xFC8816 KwUw 511.9922 vfzg_uw_b512 0.00 511.9922 FORMAT "%8.4" /end CHARACTERISTIC
/begin CHARACTERISTIC GELIBDFAPP "" VALUE 0xFC87B2 KwWU8 1.000 dez 0.00 1.000 FORMAT "%5.3" /end CHARACTERISTIC
/begin CHARACTERISTIC GELIDFAPP "" VALUE 0xFC87B3 KwWU8 99.61 rel_ub_b100 0.00 99.61 FORMAT "%5.2" /end CHARACTERISTIC
/begin CHARACTERISTIC GELIDFZK "" VALUE 0xFC8818 KwUw 655.34999985 zk10msxs_uw_b655 0.010000152590 655.36000000 FORMAT "%12.8" /end CHARACTERISTIC
/begin CHARACTERISTIC GELIKMDF "" VALUE 0xFC87B4 KwWU8 1.992 fak_ub_b2 0.00 1.992 FORMAT "%5.3" /end CHARACTERISTIC
/begin CHARACTERISTIC GELISETAPP "" VALUE 0xFC87B5 KwWU8 1.000 dez 0.00 1.000 FORMAT "%5.3" /end CHARACTERISTIC
/begin CHARACTERISTIC GELIVMAX "" VALUE 0xFC881A KwUw 511.9922 vfzg_uw_b512 0.00 511.9922 FORMAT "%8.4" /end CHARACTERISTIC
/begin CHARACTERISTIC GENLDDFMAX "Schwell Anzeige maximaler Auslastungsgrad Generator" VALUE 0xFCC054 KwWU8 99.61 PCENT 0.00 99.61 FORMAT "%5.2" /end CHARACTERISTIC
/begin CHARACTERISTIC GENLLAHAPP "" VALUE 0xFCC056 KwWU8 255.0 dez 0.00 255.0 FORMAT "%5.1" /end CHARACTERISTIC
/begin CHARACTERISTIC IBSTSTERR "" VALUE 0xFD40E0 KwUb 255.0 dez 0.00 255.0 FORMAT "%5.1" /end CHARACTERISTIC
/begin CHARACTERISTIC IBSVERSION "" VAL_BLK 0xFCBE57 KwbWU8 255.0 dez 0.00 255.0 FORMAT "%5.1" NUMBER 16 /end CHARACTERISTIC
/begin CHARACTERISTIC IBTEMPMAXI "" VALUE 0xFD40E1 KwUb 255.0 dez 0.00 255.0 FORMAT "%5.1" /end CHARACTERISTIC
/begin CHARACTERISTIC IBTEMPMINI "" VALUE 0xFD40E2 KwUb 255.0 dez 0.00 255.0 FORMAT "%5.1" /end CHARACTERISTIC
/begin CHARACTERISTIC IBUNPLADEL "" VALUE 0xFD40E3 KwUb 255.0 dez 0.00 255.0 FORMAT "%5.1" /end CHARACTERISTIC
/begin CHARACTERISTIC ILMINUMG "integrierte Lufmassenschwelle Aussentemperaturmodell" VALUE 0xFCBFF2 KwWU8 23.21 m_ub_b23p3 0.00 23.21 FORMAT "%5.2" /end CHARACTERISTIC
/begin CHARACTERISTIC IMLLASKH "imlpr-Schwelle f¸r ‹bergang auf Lambda-Abgas-Vorgabe" VALUE 0xFD2B2D KwUb 0.9961 fak_ub_b1 0.00 0.9961 /end CHARACTERISTIC
/begin CHARACTERISTIC ISLEEPGRZ "" VALUE 0xFD40E4 KwUb 5.10000 i_ub_q0p02 0.00 5.10000 FORMAT "%7.5" /end CHARACTERISTIC
/begin CHARACTERISTIC ISTARTTRIG "" VALUE 0xFD40E5 KwUb 1306. i_ub_q5p12 0.00 1306. FORMAT "%5.0" /end CHARACTERISTIC
/begin CHARACTERISTIC IVDN "LLR: I-Verst‰rkung bei stehendem Fahrzeug" CURVE 0xFC89DF GklWUb 0.9961 rel_ub_b1p0 0.00 0.9961
 /begin AXIS_DESCR COM_AXIS dn_w nmotd_sw_q0p25 8 -8192.000 8191.750 FORMAT "%8.3" AXIS_PTS_REF SDN08LLSW /end AXIS_DESCR
/end CHARACTERISTIC
/begin CHARACTERISTIC IVDNT "" CURVE 0xFC89E7 GklWUb 0.9961 rel_ub_b1p0 0.00 0.9961
 /begin AXIS_DESCR COM_AXIS dn_w nmotd_sw_q0p25 8 -8192.000 8191.750 FORMAT "%8.3" AXIS_PTS_REF SDN08LLTSW /end AXIS_DESCR
/end CHARACTERISTIC
/begin CHARACTERISTIC IVDNTV "" CURVE 0xFC89EF GklWUb 0.9961 rel_ub_b1p0 0.00 0.9961
 /begin AXIS_DESCR COM_AXIS dn_w nmotd_sw_q0p25 8 -8192.000 8191.750 FORMAT "%8.3" AXIS_PTS_REF SDN08LLTSW /end AXIS_DESCR
/end CHARACTERISTIC
/begin CHARACTERISTIC IVDNV "LLR: I-Verst‰rkung bei rollendem Fahrzeug" CURVE 0xFC89F7 GklWUb 0.9961 rel_ub_b1p0 0.00 0.9961
 /begin AXIS_DESCR COM_AXIS dn_w nmotd_sw_q0p25 8 -8192.000 8191.750 FORMAT "%8.3" AXIS_PTS_REF SDN08LLSW /end AXIS_DESCR
/end CHARACTERISTIC
/begin CHARACTERISTIC KFLAMFA "Kennfeld Lambda Fahrerwunsch" MAP 0xFD215A KfAxUbAyUbSstxUbSstyUbWUb 1.992 fak_ub_b2 0.00 1.992 FORMAT "%5.3"
 /begin AXIS_DESCR STD_AXIS nmot nmot_ub_q40 4 0.00 10200. FORMAT "%5.0" DEPOSIT ABSOLUTE /end AXIS_DESCR
 /begin AXIS_DESCR STD_AXIS rl rel_ub_q0p75 4 0.00 191.3 FORMAT "%5.1" DEPOSIT ABSOLUTE /end AXIS_DESCR
/end CHARACTERISTIC
/begin CHARACTERISTIC KFLANSKH "Kennfeld Lambda-Motor-Vorgabe bei Katheizen im Nachstart" MAP 0xFD2B44 KfAxUbAyUbSstxUbSstyUwWUw 15.89990 fak_q0p000244 0.09985352 15.99976 FORMAT "%8.5"
 /begin AXIS_DESCR STD_AXIS tmst temp_ub_q0p75_o48 4 -48.00 143.3 FORMAT "%5.1" DEPOSIT ABSOLUTE /end AXIS_DESCR
 /begin AXIS_DESCR STD_AXIS anztib_w dez 4 0.00 65535.00 FORMAT "%8.2" DEPOSIT ABSOLUTE /end AXIS_DESCR
/end CHARACTERISTIC
/begin CHARACTERISTIC KFLASKH "Kennfeld Lambda-Abgas-Soll bei Katheizen" MAP 0xFD2B72 KfAxUwAyUwSstxUwSstyUwWUw 15.99976 fak_q0p000244 0.00 15.99976 FORMAT "%8.5"
 /begin AXIS_DESCR STD_AXIS nmot_w nmot_uw_q0p25 4 0.00 16383.75 FORMAT "%8.2" DEPOSIT ABSOLUTE /end AXIS_DESCR
 /begin AXIS_DESCR STD_AXIS rl_w rel_uw_q0p0234 4 0.00 1535.977 FORMAT "%8.3" DEPOSIT ABSOLUTE /end AXIS_DESCR
/end CHARACTERISTIC
/begin CHARACTERISTIC KFLMSKHKST "Kennfeld Lambda-Motor-Soll bei Katheizen mit tmst kleiner als TMSTLMS" MAP 0xFD2BA6 KfAxUwAyUwSstxUwSstyUwWUw 15.99976 fak_q0p000244 0.00 15.99976 FORMAT "%8.5"
 /begin AXIS_DESCR STD_AXIS nmot_w nmot_uw_q0p25 8 0.00 16383.75 FORMAT "%8.2" DEPOSIT ABSOLUTE /end AXIS_DESCR
 /begin AXIS_DESCR STD_AXIS rl_w rel_uw_q0p0234 8 0.00 1535.977 FORMAT "%8.3" DEPOSIT ABSOLUTE /end AXIS_DESCR
/end CHARACTERISTIC
/begin CHARACTERISTIC KFLMSKHMAG "Kennfeld Lambda-Motor-Soll bei Katheizen (Mager -Konzept)" MAP 0xFD2C4A KfAxUwAyUwSstxUwSstyUwWUw 15.99976 fak_q0p000244 0.00 15.99976 FORMAT "%8.5"
 /begin AXIS_DESCR STD_AXIS nmot_w nmot_uw_q0p25 8 0.00 16383.75 FORMAT "%8.2" DEPOSIT ABSOLUTE /end AXIS_DESCR
 /begin AXIS_DESCR STD_AXIS rl_w rel_uw_q0p0234 8 0.00 1535.977 FORMAT "%8.3" DEPOSIT ABSOLUTE /end AXIS_DESCR
/end CHARACTERISTIC
/begin CHARACTERISTIC KFLMSKHSLP "Kennfeld Lambda-Motor-Soll bei Katheizen (Fett-Konzept)" MAP 0xFD2CEE KfAxUwAyUwSstxUwSstyUwWUw 15.99976 fak_q0p000244 0.00 15.99976 FORMAT "%8.5"
 /begin AXIS_DESCR STD_AXIS nmot_w nmot_uw_q0p25 8 0.00 16383.75 FORMAT "%8.2" DEPOSIT ABSOLUTE /end AXIS_DESCR
 /begin AXIS_DESCR STD_AXIS rl_w rel_uw_q0p0234 8 0.00 1535.977 FORMAT "%8.3" DEPOSIT ABSOLUTE /end AXIS_DESCR
/end CHARACTERISTIC
/begin CHARACTERISTIC KFLORESP "Kennfeld Loadresponse ueber Motordrehzahl und rel. Luftmasse" MAP 0xFCC0AA KfAxU8AyU8SstxU8SstyU8WU8 25.50 t100msxs_ub_b25p5 0.00 25.50 FORMAT "%5.2"
 /begin AXIS_DESCR STD_AXIS nmot nmot_ub_q40 6 0.00 10200. FORMAT "%5.0" DEPOSIT ABSOLUTE /end AXIS_DESCR
 /begin AXIS_DESCR STD_AXIS rl rel_ub_q0p75 6 0.00 191.3 FORMAT "%5.1" DEPOSIT ABSOLUTE /end AXIS_DESCR
/end CHARACTERISTIC
/begin CHARACTERISTIC KFMRES "LLR: Basis Momentenreserve im LL und ll-nahem Bereich" MAP 0xFC8A8A GkfWUb 24.90 rel_ub_b24p9 0.00 24.90 FORMAT "%5.2"
 /begin AXIS_DESCR COM_AXIS dns nmotd_sb_q10 6 -1280. 1270. FORMAT "%5.0" AXIS_PTS_REF SNS06LLSB /end AXIS_DESCR
 /begin AXIS_DESCR COM_AXIS tans temp_ub_q0p75_o48 4 -48.00 143.3 FORMAT "%5.1" AXIS_PTS_REF STA04SAUB /end AXIS_DESCR
/end CHARACTERISTIC
/begin CHARACTERISTIC KFMRESFS "LLR: Basis Momentenreserve im LL und LL-nahem Bereich bei B_fs=1" MAP 0xFC8AA2 GkfWUb 24.90 rel_ub_b24p9 0.00 24.90 FORMAT "%5.2"
 /begin AXIS_DESCR COM_AXIS dns nmotd_sb_q10 6 -1280. 1270. FORMAT "%5.0" AXIS_PTS_REF SNS06LLSB /end AXIS_DESCR
 /begin AXIS_DESCR COM_AXIS tans temp_ub_q0p75_o48 4 -48.00 143.3 FORMAT "%5.1" AXIS_PTS_REF STA04SAUB /end AXIS_DESCR
/end CHARACTERISTIC
/begin CHARACTERISTIC KFMRESFST "" MAP 0xFC8ABA GkfWUb 24.90 rel_ub_b24p9 0.00 24.90 FORMAT "%5.2"
 /begin AXIS_DESCR COM_AXIS dns nmotd_sb_q10 6 -1280. 1270. FORMAT "%5.0" AXIS_PTS_REF SNS06LLSB /end AXIS_DESCR
 /begin AXIS_DESCR COM_AXIS tmot temp_ub_q0p75_o48 4 -48.00 143.3 FORMAT "%5.1" AXIS_PTS_REF STM04SAUB /end AXIS_DESCR
/end CHARACTERISTIC
/begin CHARACTERISTIC KFMRESKUP "" MAP 0xFD31D8 KfAxUwAyUwSstxUwSstyUwWUw 6399.300 rel_q0p09726 0.00 6399.300 FORMAT "%8.3"
 /begin AXIS_DESCR STD_AXIS vfzg_w vfzg_uw_b512 4 0.00 511.9922 FORMAT "%8.4" DEPOSIT ABSOLUTE /end AXIS_DESCR
 /begin AXIS_DESCR STD_AXIS nmot_w nmot_uw_q0p25 8 0.00 16383.75 FORMAT "%8.2" DEPOSIT ABSOLUTE /end AXIS_DESCR
/end CHARACTERISTIC
/begin CHARACTERISTIC KFMREST "" MAP 0xFC8AD2 GkfWUb 24.90 rel_ub_b24p9 0.00 24.90 FORMAT "%5.2"
 /begin AXIS_DESCR COM_AXIS dns nmotd_sb_q10 6 -1280. 1270. FORMAT "%5.0" AXIS_PTS_REF SNS06LLSB /end AXIS_DESCR
 /begin AXIS_DESCR COM_AXIS tmot temp_ub_q0p75_o48 4 -48.00 143.3 FORMAT "%5.1" AXIS_PTS_REF STM04SAUB /end AXIS_DESCR
/end CHARACTERISTIC
/begin CHARACTERISTIC KFMRESTDO "" MAP 0xFD3234 KfAxUwAyUwSstxUwSstyUwWSw 6399.300 rel_ub_b24p9 -3199.699 3199.601 FORMAT "%8.3"
 /begin AXIS_DESCR STD_AXIS minhub_w hub_uw_q0p001 8 0.00 65.53500 FORMAT "%8.5" DEPOSIT ABSOLUTE /end AXIS_DESCR
 /begin AXIS_DESCR STD_AXIS dpssol_uw p_q0p039 8 0.00 2559.961 FORMAT "%8.3" DEPOSIT ABSOLUTE /end AXIS_DESCR
/end CHARACTERISTIC
/begin CHARACTERISTIC KFTDLLRD "Abregelung des D-Anteils je nach Grad der Teildrosselung" MAP 0xFC883C KfAxU8AyU8SstxU16SstyU16WU16 1.000000 fak_uw_b2 0.00 1.000000 FORMAT "%8.6"
 /begin AXIS_DESCR STD_AXIS minhub_w hub_uw_q0p001 8 0.00 65.53500 FORMAT "%8.5" DEPOSIT ABSOLUTE /end AXIS_DESCR
 /begin AXIS_DESCR STD_AXIS dpssol_uw p_q0p039 8 0.00 2559.961 FORMAT "%8.3" DEPOSIT ABSOLUTE /end AXIS_DESCR
/end CHARACTERISTIC
/begin CHARACTERISTIC KFTDLLRDZ "Abregelung des Z¸ndungs D-Anteils je nach Grad der Teildrosselung" MAP 0xFC88E0 KfAxU8AyU8SstxU16SstyU16WU16 1.000000 fak_uw_b2 0.00 1.000000 FORMAT "%8.6"
 /begin AXIS_DESCR STD_AXIS minhub_w hub_uw_q0p001 8 0.00 65.53500 FORMAT "%8.5" DEPOSIT ABSOLUTE /end AXIS_DESCR
 /begin AXIS_DESCR STD_AXIS dpssol_uw p_q0p039 8 0.00 2559.961 FORMAT "%8.3" DEPOSIT ABSOLUTE /end AXIS_DESCR
/end CHARACTERISTIC
/begin CHARACTERISTIC KFZLRESOF "Kennfeld Generatorausschaltzeit bei Stillstand" MAP 0xFCC05A KfAxU8AyU8SstxU8SstyU16WU8 255.0 t1sxs_ub_q1 0.00 255.0 FORMAT "%5.1"
 /begin AXIS_DESCR STD_AXIS tmst temp_ub_q0p75_o48 6 -48.00 143.3 FORMAT "%5.1" DEPOSIT ABSOLUTE /end AXIS_DESCR
 /begin AXIS_DESCR STD_AXIS kmstand km_uw_q10 4 0.00 655350.0 FORMAT "%8.1" DEPOSIT ABSOLUTE /end AXIS_DESCR
/end CHARACTERISTIC
/begin CHARACTERISTIC KFZLRRESOFV "" MAP 0xFCC082 KfAxU8AyU8SstxU8SstyU16WU8 255.0 t1sxs_ub_q1 0.00 255.0 FORMAT "%5.1"
 /begin AXIS_DESCR STD_AXIS tmst temp_ub_q0p75_o48 6 -48.00 143.3 FORMAT "%5.1" DEPOSIT ABSOLUTE /end AXIS_DESCR
 /begin AXIS_DESCR STD_AXIS kmstand km_uw_q10 4 0.00 655350.0 FORMAT "%8.1" DEPOSIT ABSOLUTE /end AXIS_DESCR
/end CHARACTERISTIC
/begin CHARACTERISTIC KLBATTLSTR "Geschwindigkeitsfaktor Batterieumgebungstemperatur" CURVE 0xFCBE6C KlAxU8SstxR32WR32 65534.900000000001 fak_r32_1 0.100000000000000 65535.000000000000 FORMAT "%27.21"
 /begin AXIS_DESCR STD_AXIS vfzgf fak_r32_1 6 0.00 65535.000000000000 FORMAT "%27.21" DEPOSIT ABSOLUTE /end AXIS_DESCR
/end CHARACTERISTIC
/begin CHARACTERISTIC KLEXPALH "Funktion EXP(-ALPHA*tabst_w) hinten" CURVE 0xFCBEA0 KlAxU8SstxR32WR32 1.000000000000000 fak_r32_1 0.00 1.000000000000000 FORMAT "%27.25"
 /begin AXIS_DESCR STD_AXIS tabst_fl fak_r32_1 11 0.00 65535.000000000000 FORMAT "%27.21" DEPOSIT ABSOLUTE /end AXIS_DESCR
/end CHARACTERISTIC
/begin CHARACTERISTIC KLEXPALV "Funktion EXP(-ALPHA*tabst_w)" CURVE 0xFCBEFC KlAxU8SstxR32WR32 1.000000000000000 fak_r32_1 0.00 1.000000000000000 FORMAT "%27.25"
 /begin AXIS_DESCR STD_AXIS tabst_fl fak_r32_1 11 0.00 65535.000000000000 FORMAT "%27.21" DEPOSIT ABSOLUTE /end AXIS_DESCR
/end CHARACTERISTIC
/begin CHARACTERISTIC KLEXPBETAV "Funktion EXP (-BETA*tabst_w)" CURVE 0xFCBF58 KlAxU8SstxR32WR32 1.000000000000000 fak_r32_1 0.00 1.000000000000000 FORMAT "%27.25"
 /begin AXIS_DESCR STD_AXIS tabst_fl fak_r32_1 11 0.00 65535.000000000000 FORMAT "%27.21" DEPOSIT ABSOLUTE /end AXIS_DESCR
/end CHARACTERISTIC
/begin CHARACTERISTIC KLGENLDST "Auslastungsgrad Generator" CURVE 0xFCC034 KlAxU8SstxU16WU16 100.0000 PCENT 0.00 100.0000 FORMAT "%8.4"
 /begin AXIS_DESCR STD_AXIS gentemp temp_uw_q0p75_o48 6 -48.00000 336.0000 FORMAT "%8.4" DEPOSIT ABSOLUTE /end AXIS_DESCR
/end CHARACTERISTIC
/begin CHARACTERISTIC KLIBSTEMP1 "" CURVE 0xFCBE4C KlAxU8SstxU8WU8 191.3 temp_ub_q0p75_o48 -48.00 143.3 FORMAT "%5.1"
 /begin AXIS_DESCR STD_AXIS tbatt_tmp dez 5 0.00 255.0 FORMAT "%5.1" DEPOSIT ABSOLUTE /end AXIS_DESCR
/end CHARACTERISTIC
/begin CHARACTERISTIC KLLAKHFH "Umgebungsdruckkorrektur Lambda Katheizen" CURVE 0xFD2D92 KlAUwSstUwWUw 1.999969 fak_uw_b2 0.00 1.999969 FORMAT "%8.6"
 /begin AXIS_DESCR STD_AXIS fho_w fak_uw_b4 4 0.00 3.999939 FORMAT "%8.6" DEPOSIT ABSOLUTE /end AXIS_DESCR
/end CHARACTERISTIC
/begin CHARACTERISTIC KLLORESPM "Motorabh‰ngiger Loadresponse-Faktor" CURVE 0xFCC0DC KlAxU8SstxU8WU8 3.984 fak_ub_b4 0.00 3.984 FORMAT "%5.3"
 /begin AXIS_DESCR STD_AXIS tmot temp_ub_q0p75_o48 6 -48.00 143.3 FORMAT "%5.1" DEPOSIT ABSOLUTE /end AXIS_DESCR
/end CHARACTERISTIC
/begin CHARACTERISTIC KLNWPOSN "NW_POS Drehzahlkorrektur variable Nockenwellverstellung" CURVE 0xFC80D6 KlAxU8SstxU8WU8 25.50 sprzi_q0p1o12p8 -12.80 12.70 FORMAT "%5.2"
 /begin AXIS_DESCR STD_AXIS nmot nmot_ub_q40 6 0.00 10200. FORMAT "%5.0" DEPOSIT ABSOLUTE /end AXIS_DESCR
/end CHARACTERISTIC
/begin CHARACTERISTIC KLNWPOST "NW_POS Motortemperaturkorrektur variable Nockenwellenverstellung" CURVE 0xFC80E3 KlAxU8SstxU8WU8 25.50 sprzi_q0p1o12p8 -12.80 12.70 FORMAT "%5.2"
 /begin AXIS_DESCR STD_AXIS tmot temp_ub_q0p75_o48 6 -48.00 143.3 FORMAT "%5.1" DEPOSIT ABSOLUTE /end AXIS_DESCR
/end CHARACTERISTIC
/begin CHARACTERISTIC KLTKORRKU "" CURVE 0xFC8AF8 KlAUbSstUbWUb 3.984 fak_ub_b4 0.00 3.984 FORMAT "%5.3"
 /begin AXIS_DESCR STD_AXIS tmot temp_ub_q0p75_o48 4 -48.00 143.3 FORMAT "%5.1" DEPOSIT ABSOLUTE /end AXIS_DESCR
/end CHARACTERISTIC
/begin CHARACTERISTIC KNSNF "Sperrband f¸r Solldrehzahlnachf¸hrung" VALUE 0xFC87BE KwUb 2550. nmot_ub_q10 0.00 2550. FORMAT "%5.0" /end CHARACTERISTIC
/begin CHARACTERISTIC KNSNFT "Sperrband f¸r Solldrehzahlnachf¸hrung gedrosselt" VALUE 0xFC87BF KwUb 2550. nmot_ub_q10 0.00 2550. FORMAT "%5.0" /end CHARACTERISTIC
/begin CHARACTERISTIC KTMTIMINT "" VAL_BLK 0xFC812A KwbWU16 65535.00 dez 0.00 65535.00 FORMAT "%8.2" NUMBER 8 /end CHARACTERISTIC
/begin CHARACTERISTIC LADEKENNL "Batterieladespannungskennlinie" CURVE 0xFCBFB4 KlAxU8SstxR32WR32 16.000000000000000 fak_r32_1 0.00 16.000000000000000 FORMAT "%27.24"
 /begin AXIS_DESCR STD_AXIS t_battabst fak_r32_1 6 -1.000000000000E+037 1.000000000000E+037 FORMAT "%27.0" DEPOSIT ABSOLUTE /end AXIS_DESCR
/end CHARACTERISTIC
/begin CHARACTERISTIC LAMFAVL "Lambdawunsch Vollast" CURVE 0xFD2174 KlAUbSstUbWUb 1.992 fak_ub_b2 0.00 1.992 FORMAT "%5.3"
 /begin AXIS_DESCR STD_AXIS nmot nmot_ub_q40 16 0.00 10200. FORMAT "%5.0" DEPOSIT ABSOLUTE /end AXIS_DESCR
/end CHARACTERISTIC
/begin CHARACTERISTIC LAMFLGSL "Lambda Motorlaufgrenze  fett bei Sekund‰rlufteinblasung" CURVE 0xFD2197 KlAUbSstUbWUb 1.992 fak_ub_b2 0.00 1.992 FORMAT "%5.3"
 /begin AXIS_DESCR STD_AXIS imlatm m_ub_b23p3 6 0.00 23.21 FORMAT "%5.2" DEPOSIT ABSOLUTE /end AXIS_DESCR
/end CHARACTERISTIC
/begin CHARACTERISTIC LAMLGFKT "Laufgrenze ""fett"" im Kurz Test" VALUE 0xFD21A4 KwUb 1.992 fak_ub_b2 0.00 1.992 FORMAT "%5.3" /end CHARACTERISTIC
/begin CHARACTERISTIC LAMLGFTM "Lambda Motorlaufgrenze fett" CURVE 0xFD21A5 GklWUb 1.992 fak_ub_b2 0.00 1.992 FORMAT "%5.3"
 /begin AXIS_DESCR COM_AXIS tmot temp_ub_q0p75_o48 12 -48.00 143.3 FORMAT "%5.1" AXIS_PTS_REF STM12ESUB /end AXIS_DESCR
/end CHARACTERISTIC
/begin CHARACTERISTIC LAMLGMKT "Laufgrenze ""mager"" im Kurz Test" VALUE 0xFD21B1 KwUb 1.992 fak_ub_b2 0.00 1.992 FORMAT "%5.3" /end CHARACTERISTIC
/begin CHARACTERISTIC LAMLGMTM "Laufgrenze ""mager""" CURVE 0xFD21B2 GklWUb 1.992 fak_ub_b2 0.00 1.992 FORMAT "%5.3"
 /begin AXIS_DESCR COM_AXIS tmot temp_ub_q0p75_o48 12 -48.00 143.3 FORMAT "%5.1" AXIS_PTS_REF STM12ESUB /end AXIS_DESCR
/end CHARACTERISTIC
/begin CHARACTERISTIC LAMSOSOF "Lambdasonde Soll Obergrenze f¸r 1.0-Fenster" VALUE 0xFC7696 KwUw 15.99976 fak_uw_b16 0.00 15.99976 FORMAT "%8.5" /end CHARACTERISTIC
/begin CHARACTERISTIC LAMSOSUF "Lambdasonde Soll Untergrenze f¸r 1.0-Fenster" VALUE 0xFC7698 KwUw 15.99976 fak_uw_b16 0.00 15.99976 FORMAT "%8.5" /end CHARACTERISTIC
/begin CHARACTERISTIC LASDSLA "Lambda-Abgas-Soll bei Sekund‰rluftadaption/Kurztest" CURVE 0xFD2DA4 KlAUwSstUwWUw 15.99976 fak_q0p000244 0.00 15.99976 FORMAT "%8.5"
 /begin AXIS_DESCR STD_AXIS ml_w m_uw_b6553p5 4 0.00 6553.500 FORMAT "%8.3" DEPOSIT ABSOLUTE /end AXIS_DESCR
/end CHARACTERISTIC
/begin CHARACTERISTIC LASOABML "Lambdasollwert bei Bankabschaltung" CURVE 0xFC7688 KlAxU8SstxU8WU8 1.992 fak_ub_b2 0.00 1.992 FORMAT "%5.3"
 /begin AXIS_DESCR STD_AXIS ml m_ub_b1020 6 0.00 1020. FORMAT "%5.0" DEPOSIT ABSOLUTE /end AXIS_DESCR
/end CHARACTERISTIC
/begin CHARACTERISTIC LASTMOT "Motortemp.-Korrektur von Lambda-Abgas-Soll" CURVE 0xFD2B2E KlAUbSstUbWUb 1.992 fak_ub_b2 0.00 1.992 FORMAT "%5.3"
 /begin AXIS_DESCR STD_AXIS tmot temp_ub_q0p75_o48 4 -48.00 143.3 FORMAT "%5.1" DEPOSIT ABSOLUTE /end AXIS_DESCR
/end CHARACTERISTIC
/begin CHARACTERISTIC LBATTMAX "maximale Batterieladespannung Licht aus" VALUE 0xFCC018 KwWR32 16.000000000000000 fak_r32_1 0.00 16.000000000000000 FORMAT "%27.24" /end CHARACTERISTIC
/begin CHARACTERISTIC LBATTMIN "minmale Batterieladespannung Licht an" VALUE 0xFCC01C KwWR32 16.000000000000000 fak_r32_1 0.00 16.000000000000000 FORMAT "%27.24" /end CHARACTERISTIC
/begin CHARACTERISTIC LIMN "Untere Integratorbegrenzung bei stehendem Fahrzeug" VALUE 0xFC89FF KwUb 24.90 rel_ub_bn24p9 -24.90 0.00 FORMAT "%5.2" /end CHARACTERISTIC
/begin CHARACTERISTIC LIMNDLLR "Untere Integratorbegrenzung bei Diagnose Leerlaufregelung" VALUE 0xFC8A00 KwUb 24.90 rel_ub_bn24p9 -24.90 0.00 FORMAT "%5.2" /end CHARACTERISTIC
/begin CHARACTERISTIC LIMNDTES "Untere Integratorbegrenzung bei DTES" VALUE 0xFC8A01 KwUb 24.90 rel_ub_bn24p9 -24.90 0.00 FORMAT "%5.2" /end CHARACTERISTIC
/begin CHARACTERISTIC LIMNV "Untere Integratorbegrenzung bei rollendem Fahrzeug" VALUE 0xFC8A02 KwUb 24.90 rel_ub_bn24p9 -24.90 0.00 FORMAT "%5.2" /end CHARACTERISTIC
/begin CHARACTERISTIC LIMX "Obere Integratorbegrenzung bei stehendem Fahrzeug" VALUE 0xFC8A03 KwUb 24.90 rel_ub_b24p9 0.00 24.90 FORMAT "%5.2" /end CHARACTERISTIC
/begin CHARACTERISTIC LIMXV "Obere Integratorbegrenzung bei rollendem Fahrzeug" VALUE 0xFC8A04 KwUb 24.90 rel_ub_b24p9 0.00 24.90 FORMAT "%5.2" /end CHARACTERISTIC
/begin CHARACTERISTIC LISTM "Wert des Leerlaufintegrators im Start" CURVE 0xFD31C8 GklWUb 24.90 rel_ub_b24p9 0.00 24.90 FORMAT "%5.2"
 /begin AXIS_DESCR COM_AXIS tmot temp_ub_q0p75_o48 6 -48.00 143.3 FORMAT "%5.1" AXIS_PTS_REF STM06LLUB /end AXIS_DESCR
/end CHARACTERISTIC
/begin CHARACTERISTIC LISTMT "" CURVE 0xFD31CE GklWUb 24.90 rel_ub_b24p9 0.00 24.90 FORMAT "%5.2"
 /begin AXIS_DESCR COM_AXIS tmot temp_ub_q0p75_o48 6 -48.00 143.3 FORMAT "%5.1" AXIS_PTS_REF STM06LLTUB /end AXIS_DESCR
/end CHARACTERISTIC
/begin CHARACTERISTIC LLANHAPP "LLDZanh.-level, falls Generator fehlerhaft ist." VALUE 0xFCC109 KwWU8 255.0 DEZ 0.00 255.0 FORMAT "%5.1" /end CHARACTERISTIC
/begin CHARACTERISTIC LLPMAPP "Handsteuerung Leerlaufdrehzahlvorgabe von LC-Powermanagement" VALUE 0xFCC10A KwWU8 255.0 DEZ 0.00 255.0 FORMAT "%5.1" /end CHARACTERISTIC
/begin CHARACTERISTIC LLRICNF "Configurationsbyte f¸r LLR Integrator" VALUE 0xFC8A05 KwUb 255.0 dez 0.00 255.0 FORMAT "%5.1" /end CHARACTERISTIC
/begin CHARACTERISTIC LLWDNMAX "" VALUE 0xFC881C KwSw 16383.75 nmotd_sw_q0p25 -8192.000 8191.750 FORMAT "%8.3" /end CHARACTERISTIC
/begin CHARACTERISTIC LLWDNMIN "" VALUE 0xFC881E KwSw 16383.75 nmotd_sw_q0p25 -8192.000 8191.750 FORMAT "%8.3" /end CHARACTERISTIC
/begin CHARACTERISTIC LMSTMOT "Motortemp.-Korrektur von Lambda-Motor-Soll" CURVE 0xFD2B37 KlAUbSstUbWUb 1.992 fak_ub_b2 0.00 1.992 FORMAT "%5.3"
 /begin AXIS_DESCR STD_AXIS tmot temp_ub_q0p75_o48 4 -48.00 143.3 FORMAT "%5.1" DEPOSIT ABSOLUTE /end AXIS_DESCR
/end CHARACTERISTIC
/begin CHARACTERISTIC LRBNS "" VALUE 0xFCC0F2 KwWU8 25.50 t100msxs_ub_b25p5 0.00 25.50 FORMAT "%5.2" /end CHARACTERISTIC
/begin CHARACTERISTIC LRESPAPP "Load-Response Applikation" VALUE 0xFCC0F3 KwWU8 25.50 t100msxs_ub_b25p5 0.00 25.50 FORMAT "%5.2" /end CHARACTERISTIC
/begin CHARACTERISTIC MCOBATTORT "Codierung Hand Batterieeinbauort" VALUE 0xFCBFF3 KwWU8 2.000 dez 0.00 2.000 FORMAT "%5.3" /end CHARACTERISTIC
/begin CHARACTERISTIC MINHUBTDNS "Hub f¸r Anhebung der LL-Solldrehzahl" VALUE 0xFC87AE KwWU16 65.53500 hub_uw_q0p001 0.00 65.53500 FORMAT "%8.5" /end CHARACTERISTIC
/begin CHARACTERISTIC MRESFSM "LLR: Erhˆhte Momentenreserve im LL nach einlegen der Fahrstufe" CURVE 0xFC8AEA GklWUb 24.90 rel_ub_b24p9 0.00 24.90 FORMAT "%5.2"
 /begin AXIS_DESCR COM_AXIS tmot temp_ub_q0p75_o48 4 -48.00 143.3 FORMAT "%5.1" AXIS_PTS_REF STM04SAUB /end AXIS_DESCR
/end CHARACTERISTIC
/begin CHARACTERISTIC MRESFSSMG "" CURVE 0xFC8AEE GklWUb 24.90 rel_ub_b24p9 0.00 24.90 FORMAT "%5.2"
 /begin AXIS_DESCR COM_AXIS tmot temp_ub_q0p75_o48 4 -48.00 143.3 FORMAT "%5.1" AXIS_PTS_REF STM04SAUB /end AXIS_DESCR
/end CHARACTERISTIC
/begin CHARACTERISTIC MRESLLM "LLR: Erhˆhte Momentenreserve im LL nach Drehzahleinbruch" CURVE 0xFC8AF2 GklWUb 24.90 rel_ub_b24p9 0.00 24.90 FORMAT "%5.2"
 /begin AXIS_DESCR COM_AXIS tmot temp_ub_q0p75_o48 4 -48.00 143.3 FORMAT "%5.1" AXIS_PTS_REF STM04SAUB /end AXIS_DESCR
/end CHARACTERISTIC
/begin CHARACTERISTIC MRESTEV "Momentenreserve bei TEV-Drehzahlcheck" VALUE 0xFC8AF6 KwSb 24.90 rel_sb_q0p0976 -12.50 12.40 FORMAT "%5.2" /end CHARACTERISTIC
/begin CHARACTERISTIC NDSU "Differenzdrehzahl f¸r Integratorreset" VALUE 0xFC8A5A KwSw 8191.750 nmotd_sw_q0p25 0.00 8191.750 FORMAT "%8.3" /end CHARACTERISTIC
/begin CHARACTERISTIC NFHZ "Solldrehzahl bei eingeschalteter Frontscheibenheizung" VALUE 0xFC87C0 KwUb 2550. nmot_ub_q10 0.00 2550. FORMAT "%5.0" /end CHARACTERISTIC
/begin CHARACTERISTIC NFHZFS "Solldrehzahl bei eingeschalteter Frontscheibenheizung und B_fs=1" VALUE 0xFC87C1 KwUb 2550. nmot_ub_q10 0.00 2550. FORMAT "%5.0" /end CHARACTERISTIC
/begin CHARACTERISTIC NFSACVMN "Einstellbare Solldrehzahl bei AC und FS Minimum" VALUE 0xFD3120 KwSb 2550. nmotd_sb_q10 -1280. 1270. FORMAT "%5.0" /end CHARACTERISTIC
/begin CHARACTERISTIC NFSACVMX "Einstellbare Solldrehzahl bei AC und FS Maximum" VALUE 0xFD3121 KwSb 2550. nmotd_sb_q10 -1280. 1270. FORMAT "%5.0" /end CHARACTERISTIC
/begin CHARACTERISTIC NFSM "Solldrehzahl Fahrstufenschalter ein" CURVE 0xFD3181 GklWUb 2550. nmot_ub_q10 0.00 2550. FORMAT "%5.0"
 /begin AXIS_DESCR COM_AXIS tmot temp_ub_q0p75_o48 6 -48.00 143.3 FORMAT "%5.1" AXIS_PTS_REF STM06LLUB /end AXIS_DESCR
/end CHARACTERISTIC
/begin CHARACTERISTIC NFSMHZ "Solldrehzahl Fahrstufenschalter ein bei Heizleistungsteigerung" CURVE 0xFD3187 GklWUb 2550. nmot_ub_q10 0.00 2550. FORMAT "%5.0"
 /begin AXIS_DESCR COM_AXIS tmot temp_ub_q0p75_o48 6 -48.00 143.3 FORMAT "%5.1" AXIS_PTS_REF STM06LLUB /end AXIS_DESCR
/end CHARACTERISTIC
/begin CHARACTERISTIC NFSMVMN "Einstellbare Solldrehzahl Minimum bei FS" VALUE 0xFD3122 KwSb 2550. nmotd_sb_q10 -1280. 1270. FORMAT "%5.0" /end CHARACTERISTIC
/begin CHARACTERISTIC NFSMVMX "Einstellbare Solldrehzahl Maximum bei FS" VALUE 0xFD3123 KwSb 2550. nmotd_sb_q10 -1280. 1270. FORMAT "%5.0" /end CHARACTERISTIC
/begin CHARACTERISTIC NGETNOTL "" VALUE 0xFC87C2 KwUb 2550. nmot_ub_q10 0.00 2550. FORMAT "%5.0" /end CHARACTERISTIC
/begin CHARACTERISTIC NGNSNF "Drehzahlgradientenschwelle zur Auslˆsung der Drehzahlnachf¸hrung" VALUE 0xFC87C3 KwUb 25500. nmotg_ub_q100 0.00 25500. FORMAT "%5.0" /end CHARACTERISTIC
/begin CHARACTERISTIC NINJO "Drehzahlschwelle f¸r Laufzeitreduzierung Einspritzung" VALUE 0xFD27FB KwUb 10200. nmot_ub_q40 0.00 10200. FORMAT "%5.0" /end CHARACTERISTIC
/begin CHARACTERISTIC NLLM "Solldrehzahl" CURVE 0xFD318D GklWUb 2550. nmot_ub_q10 0.00 2550. FORMAT "%5.0"
 /begin AXIS_DESCR COM_AXIS tmot temp_ub_q0p75_o48 6 -48.00 143.3 FORMAT "%5.1" AXIS_PTS_REF STM06LLUB /end AXIS_DESCR
/end CHARACTERISTIC
/begin CHARACTERISTIC NLLMHZ "Solldrehzahl bei Heizleistungssteigerung" CURVE 0xFD3193 GklWUb 2550. nmot_ub_q10 0.00 2550. FORMAT "%5.0"
 /begin AXIS_DESCR COM_AXIS tmot temp_ub_q0p75_o48 6 -48.00 143.3 FORMAT "%5.1" AXIS_PTS_REF STM06LLUB /end AXIS_DESCR
/end CHARACTERISTIC
/begin CHARACTERISTIC NLLMIN "Minimale zul‰ssige Solldrehzahl" VALUE 0xFCC104 KwWU16 10000.00 nmot_uw_q0p25 0.00 10000.00 FORMAT "%8.2" /end CHARACTERISTIC
/begin CHARACTERISTIC NLLMKUPP "" CURVE 0xFD3199 GklWUb 2550. nmot_ub_q10 0.00 2550. FORMAT "%5.0"
 /begin AXIS_DESCR COM_AXIS tmot temp_ub_q0p75_o48 6 -48.00 143.3 FORMAT "%5.1" AXIS_PTS_REF STM06LLUB /end AXIS_DESCR
/end CHARACTERISTIC
/begin CHARACTERISTIC NLLMVMN "Einstellbare LL-Solldrehzal Minimum" VALUE 0xFD3124 KwSb 2550. nmotd_sb_q10 -1280. 1270. FORMAT "%5.0" /end CHARACTERISTIC
/begin CHARACTERISTIC NLLMVMX "Einstellbare LL-Solldrehzal Maximum" VALUE 0xFD3125 KwSb 2550. nmotd_sb_q10 -1280. 1270. FORMAT "%5.0" /end CHARACTERISTIC
/begin CHARACTERISTIC NMAXKU "" VALUE 0xFC8B02 KwUw 16383.50 nmot_uw_q0p25 0.2500000 16383.75 FORMAT "%8.2" /end CHARACTERISTIC
/begin CHARACTERISTIC NMINUMG "Drehzahlschwelle Aussentemperaturmodell" VALUE 0xFCBFF4 KwWU8 10200. nmot_ub_q40 0.00 10200. FORMAT "%5.0" /end CHARACTERISTIC
/begin CHARACTERISTIC NMNTA "Solldrehzahl bei hoher Ansauglufttemperatur" VALUE 0xFC87C4 KwUb 2550. nmot_ub_q10 0.00 2550. FORMAT "%5.0" /end CHARACTERISTIC
/begin CHARACTERISTIC NMNTAFS "Solldrehzahl bei hoher Ansauglufttemperatur und eingelegter Fahrstufe" VALUE 0xFC87C5 KwUb 2550. nmot_ub_q10 0.00 2550. FORMAT "%5.0" /end CHARACTERISTIC
/begin CHARACTERISTIC NMOTLLANH "" VALUE 0xFC8820 KwUw 16383.75 nmot_uw_q0p25 0.00 16383.75 FORMAT "%8.2" /end CHARACTERISTIC
/begin CHARACTERISTIC NMXGENOF "Motordrehzahlschwelle f¸r Generatorzuschaltung" VALUE 0xFCC0F4 KwWU8 10200. nmot_ub_q40 0.00 10200. FORMAT "%5.0" /end CHARACTERISTIC
/begin CHARACTERISTIC NSAC "Solldrehzahl bei Klimaanlage ein (S_AC = 1)" VALUE 0xFC87C6 KwUb 2550. nmot_ub_q10 0.00 2550. FORMAT "%5.0" /end CHARACTERISTIC
/begin CHARACTERISTIC NSACFS "Solldrehzahl bei Klimaanlage ein (S_AC = 1) und eingelegter Fahrstufe (S_fs=1)" VALUE 0xFC87C7 KwUb 2550. nmot_ub_q10 0.00 2550. FORMAT "%5.0" /end CHARACTERISTIC
/begin CHARACTERISTIC NSACMVMN "Einstellbare LL-Solldrehzal Minimum bei AC" VALUE 0xFD3126 KwSb 2550. nmotd_sb_q10 -1280. 1270. FORMAT "%5.0" /end CHARACTERISTIC
/begin CHARACTERISTIC NSACMVMX "Einstellbare LL-Solldrehzal Maximum bei AC" VALUE 0xFD3127 KwSb 2550. nmotd_sb_q10 -1280. 1270. FORMAT "%5.0" /end CHARACTERISTIC
/begin CHARACTERISTIC NSDFFGEN "" VALUE 0xFC87C8 KwUb 2550. nmot_ub_q10 0.00 2550. FORMAT "%5.0" /end CHARACTERISTIC
/begin CHARACTERISTIC NSFSHLS "Solldrehzahlanhebung bei Heizleistungssteigerung und B_fs = 1" VALUE 0xFC87C9 KwUb 2550. nmot_ub_q10 0.00 2550. FORMAT "%5.0" /end CHARACTERISTIC
/begin CHARACTERISTIC NSFSR "Solldrehzahlanhebung bei falscher Rollrichtung" VALUE 0xFC87CA KwUb 2550. nmot_ub_q10 0.00 2550. FORMAT "%5.0" /end CHARACTERISTIC
/begin CHARACTERISTIC NSHLS "Solldrehzahlanhebung bei Heizleistungssteigerung" VALUE 0xFC87CB KwUb 2550. nmot_ub_q10 0.00 2550. FORMAT "%5.0" /end CHARACTERISTIC
/begin CHARACTERISTIC NSKAT "Solldrehzahlanhebung bei Funktionstest Kat" VALUE 0xFC87CC KwUb 2550. nmot_ub_q10 0.00 2550. FORMAT "%5.0" /end CHARACTERISTIC
/begin CHARACTERISTIC NSLBVMN "Einstellbare LL-Solldrehzal Minimum bei Unterspannung" VALUE 0xFD3128 KwSb 2550. nmotd_sb_q10 -1280. 1270. FORMAT "%5.0" /end CHARACTERISTIC
/begin CHARACTERISTIC NSLBVMX "Einstellbare LL-Solldrehzal Maximum bei Unterspannung" VALUE 0xFD3129 KwSb 2550. nmotd_sb_q10 -1280. 1270. FORMAT "%5.0" /end CHARACTERISTIC
/begin CHARACTERISTIC NSLFADY "Solldrehzahl bei Kurztrip Dynamikdiagnose der LSU" VALUE 0xFC87CD KwUb 2550. nmot_ub_q10 0.00 2550. FORMAT "%5.0" /end CHARACTERISTIC
/begin CHARACTERISTIC NSLPP "Solldrehzahl abh‰ngig vom Pumpendruck der Servolenkung" CURVE 0xFD319F KlAUbSstUbWUb 2550. nmot_ub_q10 0.00 2550. FORMAT "%5.0"
 /begin AXIS_DESCR STD_AXIS psl dez 4 0.00 255.0 FORMAT "%5.1" DEPOSIT ABSOLUTE /end AXIS_DESCR
/end CHARACTERISTIC
/begin CHARACTERISTIC NSLPPFS "Solldrehzahl abh‰ngig vom Pumpendruck der Servolenkung bei B_fs=1" CURVE 0xFD31A8 KlAUbSstUbWUb 2550. nmot_ub_q10 0.00 2550. FORMAT "%5.0"
 /begin AXIS_DESCR STD_AXIS psl dez 4 0.00 255.0 FORMAT "%5.1" DEPOSIT ABSOLUTE /end AXIS_DESCR
/end CHARACTERISTIC
/begin CHARACTERISTIC NSMNBNS "" VALUE 0xFC87CE KwUb 2550. nmot_ub_q10 0.00 2550. FORMAT "%5.0" /end CHARACTERISTIC
/begin CHARACTERISTIC NSMNBNSFS "" VALUE 0xFC87CF KwUb 2550. nmot_ub_q10 0.00 2550. FORMAT "%5.0" /end CHARACTERISTIC
/begin CHARACTERISTIC NSMNEGS "Soll-Drehzahlschwelle f¸r Getriebesteuerung B_nsmin" VALUE 0xFC87D0 KwUb 2550. nmot_ub_q10 0.00 2550. FORMAT "%5.0" /end CHARACTERISTIC
/begin CHARACTERISTIC NSMNGD "Solldrehzahlanhebung bei gedrosselten Betrieb (B_gdvhub)" VALUE 0xFC87D1 KwUb 2550. nmot_ub_q10 0.00 2550. FORMAT "%5.0" /end CHARACTERISTIC
/begin CHARACTERISTIC NSMNGDFS "Solldrehzahlanhebung bei gedrosselten Betrieb (B_gdvhub) und Fahrstufe" VALUE 0xFC87D2 KwUb 2550. nmot_ub_q10 0.00 2550. FORMAT "%5.0" /end CHARACTERISTIC
/begin CHARACTERISTIC NSMNNLDG "" VALUE 0xFC87D3 KwUb 2550. nmot_ub_q10 0.00 2550. FORMAT "%5.0" /end CHARACTERISTIC
/begin CHARACTERISTIC NSMNNLDGFS "" VALUE 0xFC87D4 KwUb 2550. nmot_ub_q10 0.00 2550. FORMAT "%5.0" /end CHARACTERISTIC
/begin CHARACTERISTIC NSMNTD "Solldrehzahl bei Teildrosselung" VALUE 0xFC87D5 KwUb 2550. nmot_ub_q10 0.00 2550. FORMAT "%5.0" /end CHARACTERISTIC
/begin CHARACTERISTIC NSMNTDFS "Solldrehzahl bei Teildrosselung und B_fs = 1" VALUE 0xFC87D6 KwUb 2550. nmot_ub_q10 0.00 2550. FORMAT "%5.0" /end CHARACTERISTIC
/begin CHARACTERISTIC NSNOT "Solldrehzahlanhebung bei Drosselklappenfehler" VALUE 0xFC87D7 KwUb 2550. nmot_ub_q10 0.00 2550. FORMAT "%5.0" /end CHARACTERISTIC
/begin CHARACTERISTIC NSNOT1 "Solldrehzahlanhebung bei Notlauf" VALUE 0xFC87D8 KwUb 2550. nmot_ub_q10 0.00 2550. FORMAT "%5.0" /end CHARACTERISTIC
/begin CHARACTERISTIC NSNOT1FS "Solldrehzahlanhebung bei Notlauf und Fahrstufe EIN" VALUE 0xFC87D9 KwUb 2550. nmot_ub_q10 0.00 2550. FORMAT "%5.0" /end CHARACTERISTIC
/begin CHARACTERISTIC NSNOTFS "Solldrehzahlanhebung bei Pedalfehler" VALUE 0xFC87DA KwUb 2550. nmot_ub_q10 0.00 2550. FORMAT "%5.0" /end CHARACTERISTIC
/begin CHARACTERISTIC NSOELH "Solldrehzahl bei hoher ÷ltemperatur" VALUE 0xFC87DB KwUb 2550. nmot_ub_q10 0.00 2550. FORMAT "%5.0" /end CHARACTERISTIC
/begin CHARACTERISTIC NSOELHFS "Solldrehzahl bei hoher ÷ltemperatur und Fahrstufe eingelegt" VALUE 0xFC87DC KwUb 2550. nmot_ub_q10 0.00 2550. FORMAT "%5.0" /end CHARACTERISTIC
/begin CHARACTERISTIC NSTATLLANH "" VALUE 0xFC87DD KwUb 2550. nmot_ub_q10 0.00 2550. FORMAT "%5.0" /end CHARACTERISTIC
/begin CHARACTERISTIC NSUBO "nsoll bei Batterieladebilanz zu niedrig" VALUE 0xFCC057 KwWU8 2550. nmot_ub_q10 0.00 2550. FORMAT "%5.0" /end CHARACTERISTIC
/begin CHARACTERISTIC NSUBU "nsoll bei Batterieladebilanz iO" VALUE 0xFCC058 KwWU8 2550. nmot_ub_q10 0.00 2550. FORMAT "%5.0" /end CHARACTERISTIC
/begin CHARACTERISTIC NSVFZG "LL-Drehzahlanhebung geschwindigkeitabh‰ngig" VALUE 0xFC87DE KwUb 2550. nmot_ub_q10 0.00 2550. FORMAT "%5.0" /end CHARACTERISTIC
/begin CHARACTERISTIC NTEB "Angehobene Solldrehzahl bei stark beladenem AKF" VALUE 0xFC87DF KwUb 2550. nmot_ub_q10 0.00 2550. FORMAT "%5.0" /end CHARACTERISTIC
/begin CHARACTERISTIC NTEBFS "Angehobene Solldrehzahl bei stark beladenem AKF und B_fs=1" VALUE 0xFC87E0 KwUb 2550. nmot_ub_q10 0.00 2550. FORMAT "%5.0" /end CHARACTERISTIC
/begin CHARACTERISTIC NW0FLANKE "Flankenkorrektur Einlass Bank 1" VAL_BLK 0xFC80F0 KwbUw 6553.500 sprzi_q0p1 0.00 6553.500 FORMAT "%8.3" NUMBER 4 /end CHARACTERISTIC
/begin CHARACTERISTIC NW1FLANKE "Flankenkorrektur Einlass Bank 2" VAL_BLK 0xFC80F8 KwbUw 6553.500 sprzi_q0p1 0.00 6553.500 FORMAT "%8.3" NUMBER 4 /end CHARACTERISTIC
/begin CHARACTERISTIC NW2FLANKE "Flankenkorrektur Einlass Bank 3" VAL_BLK 0xFC8100 KwbUw 6553.500 sprzi_q0p1 0.00 6553.500 FORMAT "%8.3" NUMBER 4 /end CHARACTERISTIC
/begin CHARACTERISTIC NW3FLANKE "Flankenkorrektur Einlass Bank 4" VAL_BLK 0xFC8108 KwbUw 6553.500 sprzi_q0p1 0.00 6553.500 FORMAT "%8.3" NUMBER 4 /end CHARACTERISTIC
/begin CHARACTERISTIC NWSEGOFFS "Vanos Segmentoffset zur Flankenidentifikation" VAL_BLK 0xFC8110 KwbUw 180.0000 sprzi_q0p1 0.00 180.0000 FORMAT "%8.4" NUMBER 4 /end CHARACTERISTIC
/begin CHARACTERISTIC OFTUMGCAN "Offset Umgebungstemperatur CAN" VALUE 0xFCBFF5 KwWS8 255.0 temp_q1 -128.0 127.0 FORMAT "%5.1" /end CHARACTERISTIC
/begin CHARACTERISTIC OFULADE "" VALUE 0xFCC020 KwWR32 16.000000000000000 fak_r32_1 0.00 16.000000000000000 FORMAT "%27.24" /end CHARACTERISTIC
/begin CHARACTERISTIC OFWINK2AP "Sollwertoffset f¸r Bank 2" VALUE 0xFC815C KwWU16 230.0000 wink_uw_q0p1 0.00 230.0000 FORMAT "%8.4" /end CHARACTERISTIC
/begin CHARACTERISTIC OFWINKAP "Sollwertoffset f¸r Bank 1" VALUE 0xFC815E KwWU16 230.0000 wink_uw_q0p1 0.00 230.0000 FORMAT "%8.4" /end CHARACTERISTIC
/begin CHARACTERISTIC OUINIGEN "Initialisierungswert Offset Generatorspannung (%00000!)" VALUE 0xFC8119 KwWU8 255.0 default 0.00 255.0 FORMAT "%5.1" /end CHARACTERISTIC
/begin CHARACTERISTIC PLBATTUMG "Plausibilisierung-Schwelle Batterieumgebungstemperatur" VALUE 0xFCC024 KwWR32 10300.000000000000 fak_r32_1 -300.00000000000000 10000.000000000000 FORMAT "%27.21" /end CHARACTERISTIC
/begin CHARACTERISTIC PVDN "LLR: P-Verst‰rkung bei stehendem Fahrzeug" CURVE 0xFC8A06 GklWUb 0.7782 rel_ub_b0p78 0.00 0.7782
 /begin AXIS_DESCR COM_AXIS dn_w nmotd_sw_q0p25 8 -8192.000 8191.750 FORMAT "%8.3" AXIS_PTS_REF SDN08LLSW /end AXIS_DESCR
/end CHARACTERISTIC
/begin CHARACTERISTIC PVDNT "" CURVE 0xFC8A0E GklWUb 0.7782 rel_ub_b0p78 0.00 0.7782
 /begin AXIS_DESCR COM_AXIS dn_w nmotd_sw_q0p25 8 -8192.000 8191.750 FORMAT "%8.3" AXIS_PTS_REF SDN08LLTSW /end AXIS_DESCR
/end CHARACTERISTIC
/begin CHARACTERISTIC PVDNTV "" CURVE 0xFC8A16 GklWUb 0.7782 rel_ub_b0p78 0.00 0.7782
 /begin AXIS_DESCR COM_AXIS dn_w nmotd_sw_q0p25 8 -8192.000 8191.750 FORMAT "%8.3" AXIS_PTS_REF SDN08LLTSW /end AXIS_DESCR
/end CHARACTERISTIC
/begin CHARACTERISTIC PVDNV "LLR: P-Verst‰rkung bei rollendem Fahrzeug" CURVE 0xFC8A1E GklWUb 0.7782 rel_ub_b0p78 0.00 0.7782
 /begin AXIS_DESCR COM_AXIS dn_w nmotd_sw_q0p25 8 -8192.000 8191.750 FORMAT "%8.3" AXIS_PTS_REF SDN08LLSW /end AXIS_DESCR
/end CHARACTERISTIC
/begin CHARACTERISTIC PVDNVZ "LLR: P-Z¸ndungsanteilverst‰rkung bei rollendem Fzg." CURVE 0xFC8A26 GklWUb 0.7782 rel_ub_b0p78 0.00 0.7782
 /begin AXIS_DESCR COM_AXIS dn_w nmotd_sw_q0p25 8 -8192.000 8191.750 FORMAT "%8.3" AXIS_PTS_REF SDN08LLSW /end AXIS_DESCR
/end CHARACTERISTIC
/begin CHARACTERISTIC PVDNVZT "" CURVE 0xFC8A2E GklWUb 0.7782 rel_ub_b0p78 0.00 0.7782
 /begin AXIS_DESCR COM_AXIS dn_w nmotd_sw_q0p25 8 -8192.000 8191.750 FORMAT "%8.3" AXIS_PTS_REF SDN08LLTSW /end AXIS_DESCR
/end CHARACTERISTIC
/begin CHARACTERISTIC PVDNZ "LLR: P-Z¸ndungsanteilverst‰rkung bei stehendem Fzg." CURVE 0xFC8A36 GklWUb 0.7782 rel_ub_b0p78 0.00 0.7782
 /begin AXIS_DESCR COM_AXIS dn_w nmotd_sw_q0p25 8 -8192.000 8191.750 FORMAT "%8.3" AXIS_PTS_REF SDN08LLSW /end AXIS_DESCR
/end CHARACTERISTIC
/begin CHARACTERISTIC PVDNZT "" CURVE 0xFC8A3E GklWUb 0.7782 rel_ub_b0p78 0.00 0.7782
 /begin AXIS_DESCR COM_AXIS dn_w nmotd_sw_q0p25 8 -8192.000 8191.750 FORMAT "%8.3" AXIS_PTS_REF SDN08LLTSW /end AXIS_DESCR
/end CHARACTERISTIC
/begin CHARACTERISTIC QKORRDF "Umquantisierung f¸r DF-Signal auf 0,39%" VALUE 0xFC811A KwWU8 255.0 default 0.00 255.0 FORMAT "%5.1" /end CHARACTERISTIC
/begin CHARACTERISTIC QKORRLR "Umquantisierung f¸r Load Responsewert auf 0,1sec" VALUE 0xFC811B KwWU8 255.0 default 0.00 255.0 FORMAT "%5.1" /end CHARACTERISTIC
/begin CHARACTERISTIC RLMXGENOF "relative Luftf¸llungschwelle f¸r Generatorzuschaltung" VALUE 0xFCC0F5 KwWU8 191.3 rel_ub_q0p75 0.00 191.3 FORMAT "%5.1" /end CHARACTERISTIC
/begin AXIS_PTS SDN08LLSW "St¸tzstellenvert., Solldrehzahlabw., 08 Sst., LL-Regel." 0xFC8A5C dn_w SstASwSstSw 16383.75 nmotd_sw_q0p25 8 -8192.000 8191.750 FORMAT "%8.3" DEPOSIT ABSOLUTE /end AXIS_PTS
/begin AXIS_PTS SDN08LLTSW "St¸tzstellenvert., Solldrehzahlabw., 08 Sst., LL-Regel." 0xFC8A6E dn_w SstASwSstSw 16383.75 nmotd_sw_q0p25 8 -8192.000 8191.750 FORMAT "%8.3" DEPOSIT ABSOLUTE /end AXIS_PTS
/begin AXIS_PTS SNG06LLSB "St¸tzstellenverteilung Drehzahlgradient, 6 Sst." 0xFC137F ngfil SstAUbSstSb 25500. nmotg_sb_q100 6 -12800. 12700. FORMAT "%5.0" DEPOSIT ABSOLUTE /end AXIS_PTS
/begin AXIS_PTS SNG06LLTSB "St¸tzstellenverteilung Drehzahlgradient, 6 Sst." 0xFC1386 ngfil SstAUbSstSb 25500. nmotg_sb_q100 6 -12800. 12700. FORMAT "%5.0" DEPOSIT ABSOLUTE /end AXIS_PTS
/begin AXIS_PTS SNM06LLUB "S¸tzstellenverteilung f¸r Motordrehzahl" 0xFC138D nmot SstAUbSstUb 10200. nmot_ub_q40 6 0.00 10200. FORMAT "%5.0" DEPOSIT ABSOLUTE /end AXIS_PTS
/begin AXIS_PTS SNS06LLSB "St¸tzstellenvert., Solldrehzahlabw., 06 Sst., LL-Regel." 0xFC87E1 dns SstAUbSstSb 2550. nmotd_sb_q10 6 -1280. 1270. FORMAT "%5.0" DEPOSIT ABSOLUTE /end AXIS_PTS
/begin AXIS_PTS SNS06LLTSB "St¸tzstellenvert., Solldrehzahlabw., 06 Sst., LL-Regel." 0xFC87E8 dns SstAUbSstSb 2550. nmotd_sb_q10 6 -1280. 1270. FORMAT "%5.0" DEPOSIT ABSOLUTE /end AXIS_PTS
/begin AXIS_PTS STA04SAUB "SST-Verteilung f¸r die Ansauglufttemperatur" 0xFC142F tans SstAUbSstUb 191.3 temp_ub_q0p75_o48 4 -48.00 143.3 FORMAT "%5.1" DEPOSIT ABSOLUTE /end AXIS_PTS
/begin AXIS_PTS STM04SAUB "St¸tzstellenverteilung Motortemperatur, 4 Sst." 0xFC1439 tmot SstAUbSstUb 191.3 temp_ub_q0p75_o48 4 -48.00 143.3 FORMAT "%5.1" DEPOSIT ABSOLUTE /end AXIS_PTS
/begin AXIS_PTS STM06LLTUB "St¸tzstellenverteilung Motortemperatur, 6 Sst." 0xFCF874 tmot SstAUbSstUb 191.3 temp_ub_q0p75_o48 6 -48.00 143.3 FORMAT "%5.1" DEPOSIT ABSOLUTE /end AXIS_PTS
/begin AXIS_PTS STM06LLUB "St¸tzstellenverteilung Motortemperatur, 6 Sst." 0xFCF87B tmot SstAUbSstUb 191.3 temp_ub_q0p75_o48 6 -48.00 143.3 FORMAT "%5.1" DEPOSIT ABSOLUTE /end AXIS_PTS
/begin AXIS_PTS STM12ESUB "SST-Verteilung f¸r die Motortemperatur tmot" 0xFCF89C tmot SstAUbSstUb 191.3 temp_ub_q0p75_o48 12 -48.00 143.3 FORMAT "%5.1" DEPOSIT ABSOLUTE /end AXIS_PTS
/begin CHARACTERISTIC S_B_IFBSAK "manueller Schalter f¸r Fehler BSD" VALUE 0xFCC10B KwWU8 255.0 DEZ 0.00 255.0 FORMAT "%5.1" /end CHARACTERISTIC
/begin CHARACTERISTIC S_B_IFPLAK "manueller Schalter f¸r Fehler IBS" VALUE 0xFCC10C KwWU8 255.0 DEZ 0.00 255.0 FORMAT "%5.1" /end CHARACTERISTIC
/begin CHARACTERISTIC S_CLERRIBS "" VALUE 0xFD40E6 KwUb 255.0 dez 0.00 255.0 FORMAT "%5.1" /end CHARACTERISTIC
/begin CHARACTERISTIC S_KURESAUS "" VALUE 0xFD31D4 KwUb 255.0 dez 0.00 255.0 FORMAT "%5.1" /end CHARACTERISTIC
/begin CHARACTERISTIC S_LORESLL "Schalter Kennlinienausschaltzeit" VALUE 0xFCC0F6 KwWU8 255.0 DEZ 0.00 255.0 FORMAT "%5.1" /end CHARACTERISTIC
/begin CHARACTERISTIC S_N_IDLIBS "Schalter zum manuellen Setzen von LL aktiv" VALUE 0xFCC10D KwWU8 255.0 DEZ 0.00 255.0 FORMAT "%5.1" /end CHARACTERISTIC
/begin CHARACTERISTIC S_RDGENTYP "Schalter APK zum Auslesen Generator Hersteller und Typ" VALUE 0xFC811C KwWU8 1.000 dez 0.00 1.000 FORMAT "%5.3" /end CHARACTERISTIC
/begin CHARACTERISTIC S_RD_REG0 "" VALUE 0xFC811D KwWU8 1.000 default 0.00 1.000 FORMAT "%5.3" /end CHARACTERISTIC
/begin CHARACTERISTIC S_RD_REG1 "" VALUE 0xFC811E KwWU8 1.000 default 0.00 1.000 FORMAT "%5.3" /end CHARACTERISTIC
/begin CHARACTERISTIC T1SCHWELLE "" VALUE 0xFD40E7 KwUb 10.20 i_ub_q0p04 0.00 10.20 FORMAT "%5.2" /end CHARACTERISTIC
/begin CHARACTERISTIC T1SOC0 "" VALUE 0xFD40E8 KwUb 65280. t_q256 0.00 65280. FORMAT "%5.0" /end CHARACTERISTIC
/begin CHARACTERISTIC T2SCHWELLE "" VALUE 0xFD40E9 KwUb 10.20 i_ub_q0p04 0.00 10.20 FORMAT "%5.2" /end CHARACTERISTIC
/begin CHARACTERISTIC T2SOC0 "" VALUE 0xFD40EA KwUb 65280. t_q256 0.00 65280. FORMAT "%5.0" /end CHARACTERISTIC
/begin CHARACTERISTIC T3SCHWELLE "" VALUE 0xFD40EB KwUb 10.20 i_ub_q0p04 0.00 10.20 FORMAT "%5.2" /end CHARACTERISTIC
/begin CHARACTERISTIC T3SOC0 "" VALUE 0xFD40EC KwUb 65280. t_q256 0.00 65280. FORMAT "%5.0" /end CHARACTERISTIC
/begin CHARACTERISTIC TABSTGNMN "minimale Abstellzeit f¸r Generatorreduzierung" VALUE 0xFCC0EA KwWU16 65535.00 t1sxs_uw_q1 0.00 65535.00 FORMAT "%8.2" /end CHARACTERISTIC
/begin CHARACTERISTIC TABSTGNMX "maximale Abstellzeit f¸r Generatorreduzierung" VALUE 0xFCC0EC KwWU16 65535.00 t1sxs_uw_q1 0.00 65535.00 FORMAT "%8.2" /end CHARACTERISTIC
/begin CHARACTERISTIC TANSLL "Ansauglufttemperaturschwelle f¸r erhˆhte Leerlaufdrehzahl" VALUE 0xFC87EF KwUb 191.3 temp_ub_q0p75_o48 -48.00 143.3 FORMAT "%5.1" /end CHARACTERISTIC
/begin CHARACTERISTIC TATMGENOF "Motordrehzahlschwelle  Katalysatortemperatur" VALUE 0xFCC0F7 KwWU8 1275. temp_ub_q5_o50 -50.00 1225. FORMAT "%5.0" /end CHARACTERISTIC
/begin CHARACTERISTIC TBATINIMAN "Applikation INITWERT Batterietemperatur" VALUE 0xFCBFF6 KwWU8 191.3 temp_ub_q0p75_o48 -48.00 143.3 FORMAT "%5.1" /end CHARACTERISTIC
/begin CHARACTERISTIC TBATTFTAUV "Zeitkonstante 5*Tau Batterievorne" VALUE 0xFCBFE8 KwWU16 65535.00 t1sxs_uw_q1 0.00 65535.00 FORMAT "%8.2" /end CHARACTERISTIC
/begin CHARACTERISTIC TBATTTAUFH "Zeitkonstante Batterie 5*Tau hinten" VALUE 0xFCC028 KwWR32 65535.000000000000 fak_r32_1 0.00 65535.000000000000 FORMAT "%27.21" /end CHARACTERISTIC
/begin CHARACTERISTIC TDFDTMAX "" VALUE 0xFC8822 KwUw 13107.00 t200msxs_uw_q0p2 0.00 13107.00 FORMAT "%8.2" /end CHARACTERISTIC
/begin CHARACTERISTIC TDFFABLF "" VALUE 0xFC8824 KwUw 13107.00 t200msxs_uw_q0p2 0.00 13107.00 FORMAT "%8.2" /end CHARACTERISTIC
/begin CHARACTERISTIC TDFFMAX "" VALUE 0xFC8826 KwUw 13107.00 t200msxs_uw_q0p2 0.00 13107.00 FORMAT "%8.2" /end CHARACTERISTIC
/begin CHARACTERISTIC TDFFMIN "" VALUE 0xFC8828 KwUw 13107.00 t200msxs_uw_q0p2 0.00 13107.00 FORMAT "%8.2" /end CHARACTERISTIC
/begin CHARACTERISTIC TDMRESLL "Sperrzeit f¸r die erhˆhte Momentenreserve nach dem Start" VALUE 0xFD31D5 KwUb 51.00 t200msxs_ub_b51 0.00 51.00 FORMAT "%5.2" /end CHARACTERISTIC
/begin CHARACTERISTIC TDNHOLD "" VALUE 0xFC882A KwUw 13107.00 t200msxs_uw_q0p2 0.00 13107.00 FORMAT "%8.2" /end CHARACTERISTIC
/begin CHARACTERISTIC TDWRGENREG0 "" VALUE 0xFC8122 KwUw 65535.00 t1msxms_q1 0.00 65535.00 FORMAT "%8.2" /end CHARACTERISTIC
/begin CHARACTERISTIC TDWRGENREG2 "" VALUE 0xFC8124 KwUw 2500.000 t1msxms_q1 0.00 2500.000 FORMAT "%8.3" /end CHARACTERISTIC
/begin CHARACTERISTIC TFWLMKHKST "Zeitkonstante f¸r Kennfeld¸bergang bei Lambda-Katheizen" VALUE 0xFD2B40 KwUb 25.4996 zk100msxs_ub_b25p5 0.100392 25.6000 FORMAT "%7.4" /end CHARACTERISTIC
/begin CHARACTERISTIC TGENIDLE "Idlezeit f¸r Generatorschnittstelle bis zum n‰chsten Initialisierungsversuch" VALUE 0xFC8126 KwUw 1310.700 t20msxs_uw_q0p02 0.00 1310.700 FORMAT "%8.3" /end CHARACTERISTIC
/begin CHARACTERISTIC TGENOFVL "Generatorsabschaltzeit bei Vollastbeschleunigung" VALUE 0xFCC0F8 KwWU8 255.0 t1sxs_ub_q1 0.00 255.0 FORMAT "%5.1" /end CHARACTERISTIC
/begin CHARACTERISTIC TGETNOTL "" VALUE 0xFC87F0 KwUb 5.100 t20msxs_ub_b5p1 0.00 5.100 FORMAT "%5.3" /end CHARACTERISTIC
/begin CHARACTERISTIC TKWPERIOD "" VALUE 0xFC8128 KwWS16 6553.500 t_q0p1ms -3276.800 3276.700 FORMAT "%8.3" /end CHARACTERISTIC
/begin CHARACTERISTIC TLAFA "Vezˆgerungszeit bis Lambda Fahrerwunsch aktiv" VALUE 0xFD2195 KwUb 25.50 t100msxs_ub_b25p5 0.00 25.50 FORMAT "%5.2" /end CHARACTERISTIC
/begin CHARACTERISTIC TLORESPST "Startloadresponse" VALUE 0xFCC0F9 KwWU8 25.50 t100msxs_ub_b25p5 0.00 25.50 FORMAT "%5.2" /end CHARACTERISTIC
/begin CHARACTERISTIC TMLLRNS "Motortemperaturschwelle f¸r Solldrehzahlverstellung ¸ber Tester" VALUE 0xFD312A KwUb 191.3 temp_ub_q0p75_o48 -48.00 143.3 FORMAT "%5.1" /end CHARACTERISTIC
/begin CHARACTERISTIC TMNV "Temperaturschwelle f¸r DS2-Nsoll-Verstellung bei FS=0" VALUE 0xFD312B KwUb 191.3 temp_ub_q0p75_o48 -48.00 143.3 FORMAT "%5.1" /end CHARACTERISTIC
/begin CHARACTERISTIC TMNVFS "Temperaturschwelle f¸r DS2-Nsoll-Verstellung bei FS=1" VALUE 0xFD312C KwUb 191.3 temp_ub_q0p75_o48 -48.00 143.3 FORMAT "%5.1" /end CHARACTERISTIC
/begin CHARACTERISTIC TMOTABGNMN "minimale Motorabstelltemperatur f¸r Generatorreduzierung" VALUE 0xFCC0FA KwWU8 191.3 temp_ub_q0p75_o48 -48.00 143.3 FORMAT "%5.1" /end CHARACTERISTIC
/begin CHARACTERISTIC TMOTLLANH "" VALUE 0xFC87F1 KwUb 191.3 temp_ub_q0p75_o48 -48.00 143.3 FORMAT "%5.1" /end CHARACTERISTIC
/begin CHARACTERISTIC TMPCOM_DIV "" VALUE 0xFD40ED KwUb 255.0 dez 0.00 255.0 FORMAT "%5.1" /end CHARACTERISTIC
/begin CHARACTERISTIC TMPCOM_MUL "" VALUE 0xFD40EE KwUb 255.0 dez 0.00 255.0 FORMAT "%5.1" /end CHARACTERISTIC
/begin CHARACTERISTIC TMSTLMS "Schwellwert Motorstarttemperatur f¸r Auswahl des KF f¸r Motorlambda" VALUE 0xFD2B41 KwUb 191.3 temp_ub_q0p75_o48 -48.00 143.3 FORMAT "%5.1" /end CHARACTERISTIC
/begin CHARACTERISTIC TMVL "Motortemperaturschwelle f¸r Vollasterkennung" VALUE 0xFD2196 KwUb 191.3 temp_ub_q0p75_o48 -48.00 143.3 FORMAT "%5.1" /end CHARACTERISTIC
/begin CHARACTERISTIC TNNSTART "Zeittriggerschwelle nach Motorstart" VALUE 0xFCC04E KwWU16 655.3500 t10msxs_uw_b655p35 0.00 655.3500 FORMAT "%8.4" /end CHARACTERISTIC
/begin CHARACTERISTIC TNSELLANH "" VALUE 0xFC882C KwUw 6553.500 t100msxs_uw_b6553p5 0.00 6553.500 FORMAT "%8.3" /end CHARACTERISTIC
/begin CHARACTERISTIC TNUSTART "" VALUE 0xFD40EF KwUb 3.1875 t_q0p0125 0.00 3.1875 /end CHARACTERISTIC
/begin CHARACTERISTIC TNUSTARTFL "" VALUE 0xFD40F0 KwUb 0.5100 t_q0p002_o01 0.01000 0.5200 /end CHARACTERISTIC
/begin CHARACTERISTIC TPT1TICO "" VALUE 0xFCBE68 KwWU16 3276.750 t50msxs_q0p05 0.00 3276.750 FORMAT "%8.3" /end CHARACTERISTIC
/begin CHARACTERISTIC TSLEEPRUH "" VALUE 0xFD40F1 KwUb 4080.00 t_q16p0 0.00 4080.00 /end CHARACTERISTIC
/begin CHARACTERISTIC TUMGGNMN "minimale Umgebungstemperatur f¸r Generatorreduzierung" VALUE 0xFCC0FB KwWU8 191.3 temp_ub_q0p75_o48 -48.00 143.3 FORMAT "%5.1" /end CHARACTERISTIC
/begin CHARACTERISTIC TUMGGNMX "maximale Umgebungstemperatur f¸r Generatorreduzierung" VALUE 0xFCC0FC KwWU8 191.3 temp_ub_q0p75_o48 -48.00 143.3 FORMAT "%5.1" /end CHARACTERISTIC
/begin CHARACTERISTIC TUMGINI "Initialisierungswert Aussentemperaturmodell" VALUE 0xFCBFF7 KwWS8 255.0 temp_q1 -128.0 127.0 FORMAT "%5.1" /end CHARACTERISTIC
/begin CHARACTERISTIC TUMGTAU "Zeitkonstante 5*Tau Aussentemperatur" VALUE 0xFCBFEA KwWU16 65535.00 t1sxs_uw_q1 0.00 65535.00 FORMAT "%8.2" /end CHARACTERISTIC
/begin CHARACTERISTIC TVDK "Verzˆgerungszeit nach Schlieﬂen der Drosselklappe" VALUE 0xFD3130 KwUb 5.100 t20msxs_ub_b5p1 0.00 5.100 FORMAT "%5.3" /end CHARACTERISTIC
/begin CHARACTERISTIC TVKUPPL "Verzˆgerungszeit f¸r die Information des Kupplungsschalter" VALUE 0xFD3131 KwUb 5.100 t20msxs_ub_b5p1 0.00 5.100 FORMAT "%5.3" /end CHARACTERISTIC
/begin CHARACTERISTIC TVLISTUM "Verbotszeit f¸r negativen Integratoranteil nach Start" CURVE 0xFC8A46 KlAUbSstUbWUb 5.100 t20msxs_ub_b5p1 0.00 5.100 FORMAT "%5.3"
 /begin AXIS_DESCR STD_AXIS tmot temp_ub_q0p75_o48 3 -48.00 143.3 FORMAT "%5.1" DEPOSIT ABSOLUTE /end AXIS_DESCR
/end CHARACTERISTIC
/begin CHARACTERISTIC TVLISTUMT "" CURVE 0xFC8A4D KlAUbSstUbWUb 5.100 t20msxs_ub_b5p1 0.00 5.100 FORMAT "%5.3"
 /begin AXIS_DESCR STD_AXIS tmot temp_ub_q0p75_o48 3 -48.00 143.3 FORMAT "%5.1" DEPOSIT ABSOLUTE /end AXIS_DESCR
/end CHARACTERISTIC
/begin CHARACTERISTIC TVLLRI "Verzˆgerungszeit f¸r Freigabe I-Anteil nach Start" CURVE 0xFD3132 KlAUbSstUbWUb 5.100 t20msxs_ub_b5p1 0.00 5.100 FORMAT "%5.3"
 /begin AXIS_DESCR STD_AXIS tmot temp_ub_q0p75_o48 6 -48.00 143.3 FORMAT "%5.1" DEPOSIT ABSOLUTE /end AXIS_DESCR
/end CHARACTERISTIC
/begin CHARACTERISTIC TVLLRIT "Verzˆgerungszeit f¸r Freigabe I-Anteil nach Start (VVT-Betrieb)" CURVE 0xFD313F KlAUbSstUbWUb 5.100 t20msxs_ub_b5p1 0.00 5.100 FORMAT "%5.3"
 /begin AXIS_DESCR STD_AXIS tmot temp_ub_q0p75_o48 6 -48.00 143.3 FORMAT "%5.1" DEPOSIT ABSOLUTE /end AXIS_DESCR
/end CHARACTERISTIC
/begin CHARACTERISTIC TVLLRMRTEV "Verzˆgerungszeit MD-Reserve Wegnahme nach TEV-Drehzahlpr¸." VALUE 0xFC8AF7 KwUb 51.00 t200msxs_ub_b51 0.00 51.00 FORMAT "%5.2" /end CHARACTERISTIC
/begin CHARACTERISTIC TVLLRPD "Maximale Verzˆgerungszeit f¸r Freigabe PD-Anteil nach Start" CURVE 0xFD314C KlAUbSstUbWUb 5.100 t20msxs_ub_b5p1 0.00 5.100 FORMAT "%5.3"
 /begin AXIS_DESCR STD_AXIS tmot temp_ub_q0p75_o48 6 -48.00 143.3 FORMAT "%5.1" DEPOSIT ABSOLUTE /end AXIS_DESCR
/end CHARACTERISTIC
/begin CHARACTERISTIC TVLLRPDT "Maximale Verzˆgerungszeit f¸r Freigabe PD-Anteil nach Start (VVT-Betrieb)" CURVE 0xFD3159 KlAUbSstUbWUb 5.100 t20msxs_ub_b5p1 0.00 5.100 FORMAT "%5.3"
 /begin AXIS_DESCR STD_AXIS tmot temp_ub_q0p75_o48 6 -48.00 143.3 FORMAT "%5.1" DEPOSIT ABSOLUTE /end AXIS_DESCR
/end CHARACTERISTIC
/begin CHARACTERISTIC TVLOFHYST "Hysterese Generatorvollastabschaltung" VALUE 0xFCC0FD KwWU8 255.0 t1sxs_ub_q1 0.00 255.0 FORMAT "%5.1" /end CHARACTERISTIC
/begin CHARACTERISTIC TVRESFS "Haltezeit f¸r die erhˆhte Momentenrerserve nach Einlegen der Fahrstufe" VALUE 0xFD31D6 KwUb 51.00 t200msxs_ub_b51 0.00 51.00 FORMAT "%5.2" /end CHARACTERISTIC
/begin CHARACTERISTIC TVRESLL "Haltezeit f¸r die erhˆhte Momentenrerserve nach Drehzahleinbruch" VALUE 0xFD31D7 KwUb 51.00 t200msxs_ub_b51 0.00 51.00 FORMAT "%5.2" /end CHARACTERISTIC
/begin CHARACTERISTIC T_CLERRIBS "" VALUE 0xFD40F2 KwUb 255.0 dez 0.00 255.0 FORMAT "%5.1" /end CHARACTERISTIC
/begin CHARACTERISTIC T_UTIEFSET "" VALUE 0xFD40F3 KwUb 255.0 t1sxs_ub_b255 0.00 255.0 FORMAT "%5.1" /end CHARACTERISTIC
/begin CHARACTERISTIC UBATTNORM "Batterienormspannung" VALUE 0xFCC02C KwWR32 1100.0000000000000 fak_r32_1 -100.00000000000000 1000.0000000000000 FORMAT "%27.22" /end CHARACTERISTIC
/begin CHARACTERISTIC UBWCNTINC "" VALUE 0xFC87F2 KwUb 255.0 dez 0.00 255.0 FORMAT "%5.1" /end CHARACTERISTIC
/begin CHARACTERISTIC UBWDELAY "" VALUE 0xFC882E KwUw 655.3500 t10msxs_uw_b655p35 0.00 655.3500 FORMAT "%8.4" /end CHARACTERISTIC
/begin CHARACTERISTIC UBWDFMAX "" VALUE 0xFC87F3 KwUb 99.61 rel_ub_b100 0.00 99.61 FORMAT "%5.2" /end CHARACTERISTIC
/begin CHARACTERISTIC UBWDFMIN "" VALUE 0xFC87F4 KwUb 99.61 rel_ub_b100 0.00 99.61 FORMAT "%5.2" /end CHARACTERISTIC
/begin CHARACTERISTIC UBWSCHZMX "" VALUE 0xFC87F5 KwUb 255.0 dez 0.00 255.0 FORMAT "%5.1" /end CHARACTERISTIC
/begin CHARACTERISTIC UBWTABL "" VALUE 0xFC8830 KwUw 655.3500 t10msxs_uw_b655p35 0.00 655.3500 FORMAT "%8.4" /end CHARACTERISTIC
/begin CHARACTERISTIC UBWTNSTART "" VALUE 0xFC8832 KwUw 6553.500 t100msxs_uw_b6553p5 0.00 6553.500 FORMAT "%8.3" /end CHARACTERISTIC
/begin CHARACTERISTIC UBWULMIN "" VALUE 0xFC87F6 KwUb 9.985 spg_ubatt 9.985 19.97 FORMAT "%5.2" /end CHARACTERISTIC
/begin CHARACTERISTIC UBWULOFFS "" CURVE 0xFD31B2 KlAUbSstUbWSb 24.02 spg_ubatt -12.06 11.96 FORMAT "%5.2"
 /begin AXIS_DESCR STD_AXIS ufgen spg_ugen 5 10.60 36.10 FORMAT "%5.2" DEPOSIT ABSOLUTE /end AXIS_DESCR
/end CHARACTERISTIC
/begin CHARACTERISTIC UBWUSMIN "" VALUE 0xFC87F7 KwUb 9.985 spg_ubatt 9.985 19.97 FORMAT "%5.2" /end CHARACTERISTIC
/begin CHARACTERISTIC UBWUSOFFS "" CURVE 0xFD31BD KlAUbSstUbWSb 24.02 spg_ubatt -12.06 11.96 FORMAT "%5.2"
 /begin AXIS_DESCR STD_AXIS ufgen spg_ugen 5 10.60 36.10 FORMAT "%5.2" DEPOSIT ABSOLUTE /end AXIS_DESCR
/end CHARACTERISTIC
/begin CHARACTERISTIC UBWZKL "" VALUE 0xFC87F8 KwUb 255.0 dez 0.00 255.0 FORMAT "%5.1" /end CHARACTERISTIC
/begin CHARACTERISTIC UBWZKS "" VALUE 0xFC87F9 KwUb 255.0 dez 0.00 255.0 FORMAT "%5.1" /end CHARACTERISTIC
/begin CHARACTERISTIC UGENTYP "typische Generator-Sollspannung (default = 13,8V)" VALUE 0xFC811F KwWU8 25.50 spg_ugen 10.60 36.10 FORMAT "%5.2" /end CHARACTERISTIC
/begin CHARACTERISTIC UGMN "Minimaler Sollspannungswert Generator (normalerweise 10,7V)" VALUE 0xFC8120 KwWU8 25.50 spg_ugen 10.60 36.10 FORMAT "%5.2" /end CHARACTERISTIC
/begin CHARACTERISTIC UGMX "Maximalwert Generatorsollspannung" VALUE 0xFC8121 KwWU8 25.50 spg_ugen 10.60 36.10 FORMAT "%5.2" /end CHARACTERISTIC
/begin CHARACTERISTIC ULADE_TAU "Batterieladespannungs Zeitkonstante" VALUE 0xFCC030 KwWR32 1.000000000000000 fak_r32_1 0.00 1.000000000000000 FORMAT "%27.25" /end CHARACTERISTIC
/begin CHARACTERISTIC UTIEFAPP "" VALUE 0xFD40F4 KwUb 16.320 spg_ub_q0p064_o6 6.0000 22.320 /end CHARACTERISTIC
/begin CHARACTERISTIC VFZGLLANH "" VALUE 0xFC8834 KwUw 511.9922 vfzg_uw_b512 0.00 511.9922 FORMAT "%8.4" /end CHARACTERISTIC
/begin CHARACTERISTIC VFZGLLRNS1 "untere Geschwindigkeitsschwelle f¸r Drehzahlanhebung" VALUE 0xFC8836 KwUw 511.9922 vfzg_uw_b512 0.00 511.9922 FORMAT "%8.4" /end CHARACTERISTIC
/begin CHARACTERISTIC VFZGLLRNS2 "obere Geschwindigkeitsschwelle f¸r Drehzahlanhebung" VALUE 0xFC8838 KwUw 511.9922 vfzg_uw_b512 0.00 511.9922 FORMAT "%8.4" /end CHARACTERISTIC
/begin CHARACTERISTIC VGENOFMN "Geschwindigkeitgeneratorabschaltschwelle bei Vollastbeschleunigung" VALUE 0xFCC0FE KwWU8 318.8 vfzg_ub_q1p25 0.00 318.8 FORMAT "%5.1" /end CHARACTERISTIC
/begin CHARACTERISTIC VGENOGMX "Geschwindigkeitgeneratorzuschaltschwelle bei Vollastbeschleunigung" VALUE 0xFCC0FF KwWU8 318.8 vfzg_ub_q1p25 0.00 318.8 FORMAT "%5.1" /end CHARACTERISTIC
/begin CHARACTERISTIC VLLR "Fahrzeuggeschwindigkeitsschwelle f¸r Leerlaufregelung" VALUE 0xFD3166 KwUb 318.8 vfzg_ub_q1p25 0.00 318.8 FORMAT "%5.1" /end CHARACTERISTIC
/begin CHARACTERISTIC VMINUMG "Fahrzeuggeschwindigkeitsschwelle Aussentemperaturmodell" VALUE 0xFCBFF8 KwWU8 318.8 vfzg_ub_q1p25 0.00 318.8 FORMAT "%5.1" /end CHARACTERISTIC
/begin CHARACTERISTIC VZLORESOFV "Geschwindigkeitsschwelle f¸r Generatorzuschaltung" VALUE 0xFCC100 KwWU8 318.8 vfzg_ub_q1p25 0.00 318.8 FORMAT "%5.1" /end CHARACTERISTIC
/begin CHARACTERISTIC WPEDKURES "" VALUE 0xFC8B04 KwUw 99.99847 relPED_uw_b100 0.001525902 100.0000 FORMAT "%8.4" /end CHARACTERISTIC
/begin CHARACTERISTIC WPEDLLANH "" VALUE 0xFC883A KwUw 100.0000 relPED_uw_b100 0.00 100.0000 FORMAT "%8.4" /end CHARACTERISTIC
/begin CHARACTERISTIC ZDMRLLRMRF "Zeitkonstante f¸r Momentenreserve im LL" CURVE 0xFC8B06 KlAUwSstUwWUw 127.9980 rel_q0p00195 0.00 127.9980 FORMAT "%8.4"
 /begin AXIS_DESCR STD_AXIS mrfa_w rel_uw_b200 4 0.00 199.9969 FORMAT "%8.4" DEPOSIT ABSOLUTE /end AXIS_DESCR
/end CHARACTERISTIC
/begin CHARACTERISTIC ZFLASKH "Zeitkonstante f¸r ‹bergang auf Lambda-Abgas-Vorgabe" VALUE 0xFD2B42 KwUb 25.4996 zk100msxs_ub_b25p5 0.100392 25.6000 FORMAT "%7.4" /end CHARACTERISTIC
/begin CHARACTERISTIC ZKFNSTA "Zeitkonstante f¸r nsta-Filter" VALUE 0xFC87FA KwUb 5.08000 zk20msxs_ub_b5p1 0.0200000 5.10000 FORMAT "%7.5" /end CHARACTERISTIC
/begin CHARACTERISTIC ZKLLRD "Zeitkonstante f¸r die Abregelung des D-Anteils" VALUE 0xFC8A80 KwUw 1309.9800107 zk20msxs_uw_b1310 0.019989318685 1310.0000000 FORMAT "%12.7" /end CHARACTERISTIC
/begin CHARACTERISTIC ZKLLRDT "" VALUE 0xFC8A82 KwUw 1309.9800107 zk20msxs_uw_b1310 0.019989318685 1310.0000000 FORMAT "%12.7" /end CHARACTERISTIC
/begin CHARACTERISTIC ZKLLRDZ "Zeitkonstante zum Abregeln des D-Z¸ndungsanteils" VALUE 0xFC8A84 KwUw 1309.9800107 zk20msxs_uw_b1310 0.019989318685 1310.0000000 FORMAT "%12.7" /end CHARACTERISTIC
/begin CHARACTERISTIC ZKNS "Zeitkonstante f¸r Solldrehzahl bei Umschaltung" VALUE 0xFC87FB KwUb 5.08000 zk20msxs_ub_b5p1 0.0200000 5.10000 FORMAT "%7.5" /end CHARACTERISTIC
/begin CHARACTERISTIC ZKNSKUPP "" VALUE 0xFC87FC KwUb 5.08000 zk20msxs_ub_b5p1 0.0200000 5.10000 FORMAT "%7.5" /end CHARACTERISTIC
/begin CHARACTERISTIC ZKRESKUP_N "" VALUE 0xFC8B18 KwUw 1309.9800107 zk20msxs_uw_b1310 0.019989318685 1310.0000000 FORMAT "%12.7" /end CHARACTERISTIC
/begin CHARACTERISTIC ZKRESKUP_P "" VALUE 0xFC8B1A KwUw 1309.9800107 zk20msxs_uw_b1310 0.019989318685 1310.0000000 FORMAT "%12.7" /end CHARACTERISTIC
/begin CHARACTERISTIC ZLIBG "Filterzeitkonstante f¸r die Nachf¸hrung der Integratorgrenzen" VALUE 0xFC8A54 KwUb 5.08000 zk20msxs_ub_b5p1 0.0200000 5.10000 FORMAT "%7.5" /end CHARACTERISTIC
/begin CHARACTERISTIC ZNSM "Zeitkonstante f¸r Solldrehzahlabregelung" CURVE 0xFC87FD GklWUb 5.08000 zk20msxs_ub_b5p1 0.0200000 5.10000 FORMAT "%7.5"
 /begin AXIS_DESCR COM_AXIS tmot temp_ub_q0p75_o48 6 -48.00 143.3 FORMAT "%5.1" AXIS_PTS_REF STM06LLUB /end AXIS_DESCR
/end CHARACTERISTIC
/begin CHARACTERISTIC ZNSMFS "Zeitkonstante f¸r Solldrehzahlabregelung bei B_fs" CURVE 0xFC8803 GklWUb 5.08000 zk20msxs_ub_b5p1 0.0200000 5.10000 FORMAT "%7.5"
 /begin AXIS_DESCR COM_AXIS tmot temp_ub_q0p75_o48 6 -48.00 143.3 FORMAT "%5.1" AXIS_PTS_REF STM06LLUB /end AXIS_DESCR
/end CHARACTERISTIC
/begin CHARACTERISTIC ZNSMT "Zeitkonstante f¸r Solldrehzahlabregelung gedrosselt" CURVE 0xFC8809 GklWUb 5.08000 zk20msxs_ub_b5p1 0.0200000 5.10000 FORMAT "%7.5"
 /begin AXIS_DESCR COM_AXIS tmot temp_ub_q0p75_o48 6 -48.00 143.3 FORMAT "%5.1" AXIS_PTS_REF STM06LLTUB /end AXIS_DESCR
/end CHARACTERISTIC
/begin CHARACTERISTIC ZNSMTFS "Zeitkonstante f¸r Solldrehzahlabregelung gedrosselt bei B_fs" CURVE 0xFC880F GklWUb 5.08000 zk20msxs_ub_b5p1 0.0200000 5.10000 FORMAT "%7.5"
 /begin AXIS_DESCR COM_AXIS tmot temp_ub_q0p75_o48 6 -48.00 143.3 FORMAT "%5.1" AXIS_PTS_REF STM06LLTUB /end AXIS_DESCR
/end CHARACTERISTIC
/begin CHARACTERISTIC ZNSUB "Zeitkonstante f¸r Mindestsolldrehzahl bei Unterspannung" VALUE 0xFD31B1 KwUb 50.9992 zk200msxs_ub_b51p2 0.200784 51.2000 FORMAT "%7.4" /end CHARACTERISTIC
/begin MEASUREMENT abbwevz "Abbruchwinkel Einspritzung" SWORD kw_q1 1 100 -32768 32767 FORMAT "%8.2" ARRAY_SIZE 8 ECU_ADDRESS 0x40472A /end MEASUREMENT
/begin MEASUREMENT anzti "ti-Einspritzz‰hler" UBYTE dez 1 100 0 255 FORMAT "%5.1" ECU_ADDRESS 0x40394D /end MEASUREMENT
/begin MEASUREMENT anzti_w "ti-Einspritzz‰hler" UWORD dez 1 100 0 65535 FORMAT "%8.2" ECU_ADDRESS 0x40473A /end MEASUREMENT
/begin MEASUREMENT battort "Batterieeinbauort" UBYTE dez 1 100 0 255 FORMAT "%5.1" ECU_ADDRESS 0x403386 /end MEASUREMENT
/begin MEASUREMENT batto_a "Temp-Variable" FLOAT32_IEEE fak_r32_1 1 100 -100000 100000 FORMAT "%27.20" ECU_ADDRESS 0x4023EC /end MEASUREMENT
/begin MEASUREMENT batto_a1 "Temp-Variable" FLOAT32_IEEE fak_r32_1 1 100 -100000 100000 FORMAT "%27.20" ECU_ADDRESS 0x4023F0 /end MEASUREMENT
/begin MEASUREMENT batto_b "Temp-Variable" FLOAT32_IEEE fak_r32_1 1 100 -100000 100000 FORMAT "%27.20" ECU_ADDRESS 0x4023F4 /end MEASUREMENT
/begin MEASUREMENT batto_c "Temp-Variable" FLOAT32_IEEE fak_r32_1 1 100 -100000 100000 FORMAT "%27.20" ECU_ADDRESS 0x4023F8 /end MEASUREMENT
/begin MEASUREMENT batto_c1 "Temp-Variable" FLOAT32_IEEE fak_r32_1 1 100 -100000 100000 FORMAT "%27.20" ECU_ADDRESS 0x4023FC /end MEASUREMENT
/begin MEASUREMENT batto_c2 "Temp-Variable" FLOAT32_IEEE fak_r32_1 1 100 -100000 100000 FORMAT "%27.20" ECU_ADDRESS 0x402400 /end MEASUREMENT
/begin MEASUREMENT batto_c3 "Temp-Variable" FLOAT32_IEEE fak_r32_1 1 100 -100000 100000 FORMAT "%27.20" ECU_ADDRESS 0x402404 /end MEASUREMENT
/begin MEASUREMENT batto_c4 "Temp-Variable" FLOAT32_IEEE fak_r32_1 1 100 -100000 100000 FORMAT "%27.20" ECU_ADDRESS 0x402408 /end MEASUREMENT
/begin MEASUREMENT batto_c6 "Temp-Variable" FLOAT32_IEEE fak_r32_1 1 100 -100000 100000 FORMAT "%27.20" ECU_ADDRESS 0x40240C /end MEASUREMENT
/begin MEASUREMENT batto_c7 "Temp-Variable" FLOAT32_IEEE fak_r32_1 1 100 -100000 100000 FORMAT "%27.20" ECU_ADDRESS 0x402410 /end MEASUREMENT
/begin MEASUREMENT batt_a1 "Temp-Variable" FLOAT32_IEEE fak_r32_1 1 100 -100000 100000 FORMAT "%27.20" ECU_ADDRESS 0x402414 /end MEASUREMENT
/begin MEASUREMENT batt_a2 "Temp-Variable" FLOAT32_IEEE fak_r32_1 1 100 -100000 100000 FORMAT "%27.20" ECU_ADDRESS 0x402418 /end MEASUREMENT
/begin MEASUREMENT batt_c10 "Temp-Variable" FLOAT32_IEEE fak_r32_1 1 100 -100000 100000 FORMAT "%27.20" ECU_ADDRESS 0x40241C /end MEASUREMENT
/begin MEASUREMENT batt_c11 "Temp-Variable" FLOAT32_IEEE fak_r32_1 1 100 -100000 100000 FORMAT "%27.20" ECU_ADDRESS 0x402420 /end MEASUREMENT
/begin MEASUREMENT batt_c12 "Temp-Variable" FLOAT32_IEEE fak_r32_1 1 100 -100000 100000 FORMAT "%27.20" ECU_ADDRESS 0x402424 /end MEASUREMENT
/begin MEASUREMENT batt_c13 "Temp-Variable" FLOAT32_IEEE fak_r32_1 1 100 -100000 100000 FORMAT "%27.20" ECU_ADDRESS 0x402428 /end MEASUREMENT
/begin MEASUREMENT batt_c14 "Temp-Variable" FLOAT32_IEEE fak_r32_1 1 100 -100000 100000 FORMAT "%27.20" ECU_ADDRESS 0x40242C /end MEASUREMENT
/begin MEASUREMENT batt_c8 "Temp-Variable" FLOAT32_IEEE fak_r32_1 1 100 -100000 100000 FORMAT "%27.20" ECU_ADDRESS 0x402430 /end MEASUREMENT
/begin MEASUREMENT batt_c9 "Temp-Variable" FLOAT32_IEEE fak_r32_1 1 100 -100000 100000 FORMAT "%27.20" ECU_ADDRESS 0x402434 /end MEASUREMENT
/begin MEASUREMENT batt_d1 "Temp-Variable" FLOAT32_IEEE fak_r32_1 1 100 -100000 100000 FORMAT "%27.20" ECU_ADDRESS 0x402438 /end MEASUREMENT
/begin MEASUREMENT batt_e1 "Temp-Variable" FLOAT32_IEEE fak_r32_1 1 100 -100000 100000 FORMAT "%27.20" ECU_ADDRESS 0x40243C /end MEASUREMENT
/begin MEASUREMENT batt_e2 "Temp-Variable" FLOAT32_IEEE fak_r32_1 1 100 -100000 100000 FORMAT "%27.20" ECU_ADDRESS 0x402440 /end MEASUREMENT
/begin MEASUREMENT batt_e3 "Temp-Variable" FLOAT32_IEEE fak_r32_1 1 100 -100000 100000 FORMAT "%27.20" ECU_ADDRESS 0x402444 /end MEASUREMENT
/begin MEASUREMENT batt_e4 "Temp-Variable" FLOAT32_IEEE fak_r32_1 1 100 -100000 100000 FORMAT "%27.20" ECU_ADDRESS 0x402448 /end MEASUREMENT
/begin MEASUREMENT batt_e5 "Temp-Variable" FLOAT32_IEEE fak_r32_1 1 100 -100000 100000 FORMAT "%27.20" ECU_ADDRESS 0x40244C /end MEASUREMENT
/begin MEASUREMENT batt_e6 "Temp-Variable" FLOAT32_IEEE fak_r32_1 1 100 -100000 100000 FORMAT "%27.20" ECU_ADDRESS 0x402450 /end MEASUREMENT
/begin MEASUREMENT batt_tfil "Zeitkonstante Batterie" FLOAT32_IEEE fak_r32_1 1 100 0 1 FORMAT "%27.25" ECU_ADDRESS 0x402454 /end MEASUREMENT
/begin MEASUREMENT batt_w0 "Temp-Variable" FLOAT32_IEEE fak_r32_1 1 100 -100000 100000 FORMAT "%27.20" ECU_ADDRESS 0x402458 /end MEASUREMENT
/begin MEASUREMENT bsdgencv "" UBYTE dez 1 100 0 255 FORMAT "%5.1" ECU_ADDRESS 0x402F7E /end MEASUREMENT
/begin MEASUREMENT bsdgencv2 "Chipversion Generatorregler 2" UBYTE dez 1 100 0 255 FORMAT "%5.1" ECU_ADDRESS 0x402F7F /end MEASUREMENT
/begin MEASUREMENT bsdgenregv "Reglerversion on Generator 1" UBYTE dez 1 100 0 255 FORMAT "%5.1" ECU_ADDRESS 0x402F80 /end MEASUREMENT
/begin MEASUREMENT bsdgenrgv2 "Reglerversion on Generator 2" UBYTE dez 1 100 0 255 FORMAT "%5.1" ECU_ADDRESS 0x402F81 /end MEASUREMENT
/begin MEASUREMENT bwrackreg0 "" UBYTE dez 1 100 0 255 FORMAT "%5.1" ARRAY_SIZE 2 ECU_ADDRESS 0x402F82 /end MEASUREMENT
/begin MEASUREMENT bwrackreg1 "" UBYTE dez 1 100 0 255 FORMAT "%5.1" ARRAY_SIZE 2 ECU_ADDRESS 0x402F84 /end MEASUREMENT
/begin MEASUREMENT B_action "" UBYTE B_TRUE 1 100 0 1 BIT_MASK 0x1 FORMAT "%13.11" ECU_ADDRESS 0x40394A /end MEASUREMENT
/begin MEASUREMENT B_awget "" UBYTE B_TRUE 1 100 0 1 BIT_MASK 0x1 FORMAT "%13.11" ECU_ADDRESS 0x3FC227 /end MEASUREMENT
/begin MEASUREMENT B_bsd1prot2 "" UBYTE B_TRUE 1 100 0 1 BIT_MASK 0x1 FORMAT "%13.11" ECU_ADDRESS 0x402F68 /end MEASUREMENT
/begin MEASUREMENT B_bsd2prot2 "" UBYTE B_TRUE 1 100 0 1 BIT_MASK 0x1 FORMAT "%13.11" ECU_ADDRESS 0x402F69 /end MEASUREMENT
/begin MEASUREMENT B_bsdbrake "" UBYTE B_TRUE 1 100 0 1 BIT_MASK 0x10 FORMAT "%13.11" ECU_ADDRESS 0x40394C /end MEASUREMENT
/begin MEASUREMENT B_bsdgenv "" UBYTE B_TRUE 1 100 0 1 BIT_MASK 0x1 FORMAT "%13.11" ECU_ADDRESS 0x402F6A /end MEASUREMENT
/begin MEASUREMENT B_bsdgenv2 "" UBYTE B_TRUE 1 100 0 1 BIT_MASK 0x1 FORMAT "%13.11" ECU_ADDRESS 0x402F6B /end MEASUREMENT
/begin MEASUREMENT B_bsdprot1 "Bedingung BSD Protokollinhalt f¸r BSD1 Regler" UBYTE B_TRUE 1 100 0 1 BIT_MASK 0x1 FORMAT "%13.11" ECU_ADDRESS 0x402F6C /end MEASUREMENT
/begin MEASUREMENT B_bsdprot2 "Bedingung BSD Protokollinhalt f¸r BSD2 Regler" UBYTE B_TRUE 1 100 0 1 BIT_MASK 0x1 FORMAT "%13.11" ECU_ADDRESS 0x402F6D /end MEASUREMENT
/begin MEASUREMENT B_dffaktiv "" UBYTE B_TRUE 1 100 0 1 BIT_MASK 0x1 FORMAT "%13.11" ECU_ADDRESS 0x3FC228 /end MEASUREMENT
/begin MEASUREMENT B_dflim "" UBYTE B_TRUE 1 100 0 1 BIT_MASK 0x2 FORMAT "%13.11" ECU_ADDRESS 0x40394C /end MEASUREMENT
/begin MEASUREMENT B_dslafa "Anfoderung Kurztest oder Adaption in DSLSXXX" UBYTE B_TRUE 1 100 0 1 BIT_MASK 0x1 FORMAT "%13.11" ECU_ADDRESS 0x403C37 /end MEASUREMENT
/begin MEASUREMENT B_dzbuf "" UBYTE B_TRUE 1 100 0 1 BIT_MASK 0x1 FORMAT "%13.11" ECU_ADDRESS 0x4037E9 /end MEASUREMENT
/begin MEASUREMENT B_dzen "" UBYTE B_TRUE 1 100 0 1 BIT_MASK 0x1 FORMAT "%13.11" ECU_ADDRESS 0x4037EA /end MEASUREMENT
/begin MEASUREMENT B_dzrts "Bedingung Komponententreiber Diagnose Zuendung ready to send" UBYTE B_TRUE 1 100 0 1 BIT_MASK 0x1 FORMAT "%13.11" ECU_ADDRESS 0x4037EB /end MEASUREMENT
/begin MEASUREMENT B_eb_busy "" UBYTE B_TRUE 1 100 0 1 BIT_MASK 0x1 FORMAT "%13.11" ECU_ADDRESS 0x4032E0 /end MEASUREMENT
/begin MEASUREMENT B_eb_txok "" UBYTE B_TRUE 1 100 0 1 BIT_MASK 0x1 FORMAT "%13.11" ECU_ADDRESS 0x4032E1 /end MEASUREMENT
/begin MEASUREMENT B_eb_write "" UBYTE B_TRUE 1 100 0 1 BIT_MASK 0x1 FORMAT "%13.11" ECU_ADDRESS 0x4032E2 /end MEASUREMENT
/begin MEASUREMENT B_fallsa "Bedingung: Funktionsanforderung Drehzahl‰nderung durch Tester aktiv" UBYTE B_TRUE 1 100 0 1 BIT_MASK 0x1 FORMAT "%13.11" ECU_ADDRESS 0x3FC229 /end MEASUREMENT
/begin MEASUREMENT B_fsclr "" UBYTE B_TRUE 1 100 0 1 BIT_MASK 0x1 FORMAT "%13.11" ECU_ADDRESS 0x4032E3 /end MEASUREMENT
/begin MEASUREMENT B_geli "" UBYTE B_TRUE 1 100 0 1 BIT_MASK 0x1 FORMAT "%13.11" ECU_ADDRESS 0x3FC22A /end MEASUREMENT
/begin MEASUREMENT B_genacti2 "Bedingung Generatorinterface2 aktiv" UBYTE B_TRUE 1 100 0 1 BIT_MASK 0x1 FORMAT "%13.11" ECU_ADDRESS 0x402F6E /end MEASUREMENT
/begin MEASUREMENT B_genactiv "Bedingung Generatorinterface aktiv" UBYTE B_TRUE 1 100 0 1 BIT_MASK 0x1 FORMAT "%13.11" ECU_ADDRESS 0x402F6F /end MEASUREMENT
/begin MEASUREMENT B_genfbsd "Bedingung Kommunikationsverlust BSD-Generator" UBYTE B_TRUE 1 100 0 1 BIT_MASK 0x1 FORMAT "%13.11" ECU_ADDRESS 0x402F70 /end MEASUREMENT
/begin MEASUREMENT B_genfbsd2 "Bedingung Kommunikationsverlust BSD-Generator 2" UBYTE B_TRUE 1 100 0 1 BIT_MASK 0x1 FORMAT "%13.11" ECU_ADDRESS 0x402F71 /end MEASUREMENT
/begin MEASUREMENT B_genfel "Bedingung: Generatorfehler elektrisch" UBYTE B_TRUE 1 100 0 1 BIT_MASK 0x1 FORMAT "%13.11" ECU_ADDRESS 0x402F72 /end MEASUREMENT
/begin MEASUREMENT B_genfel2 "Bedingung: Generatorfehler elektrisch (Generator 2)" UBYTE B_TRUE 1 100 0 1 BIT_MASK 0x1 FORMAT "%13.11" ECU_ADDRESS 0x402F73 /end MEASUREMENT
/begin MEASUREMENT B_genfht "Bedingung: Generatorzustand 'hohe Temperatur'" UBYTE B_TRUE 1 100 0 1 BIT_MASK 0x1 FORMAT "%13.11" ECU_ADDRESS 0x402F74 /end MEASUREMENT
/begin MEASUREMENT B_genfht2 "Bedingung: Generatorzustand 'hohe Temperatur'" UBYTE B_TRUE 1 100 0 1 BIT_MASK 0x1 FORMAT "%13.11" ECU_ADDRESS 0x402F75 /end MEASUREMENT
/begin MEASUREMENT B_genfme "Bedingung: Generatorfehler mechanisch" UBYTE B_TRUE 1 100 0 1 BIT_MASK 0x1 FORMAT "%13.11" ECU_ADDRESS 0x402F76 /end MEASUREMENT
/begin MEASUREMENT B_genfme2 "Bedingung: Generatorfehler mechanisch" UBYTE B_TRUE 1 100 0 1 BIT_MASK 0x1 FORMAT "%13.11" ECU_ADDRESS 0x402F77 /end MEASUREMENT
/begin MEASUREMENT B_genoffst "Bedingung Generatorabschaltung im Start" UBYTE B_TRUE 1 100 0 1 FORMAT "%13.11" ECU_ADDRESS 0x403394 /end MEASUREMENT
/begin MEASUREMENT B_genoffvl "Bedingung Generatorabschaltung bei Vollast" UBYTE B_TRUE 1 100 0 1 FORMAT "%13.11" ECU_ADDRESS 0x403395 /end MEASUREMENT
/begin MEASUREMENT B_ibfbsd "IBS_DME Kommunikationsfehler allgemein" UBYTE B_TRUE 1 100 0 1 BIT_MASK 0x1 FORMAT "%13.11" ECU_ADDRESS 0x4032E4 /end MEASUREMENT
/begin MEASUREMENT B_ibfebsd "IBS_DME Fehler erweiterte Kommunikation" UBYTE B_TRUE 1 100 0 1 BIT_MASK 0x1 FORMAT "%13.11" ECU_ADDRESS 0x4032E5 /end MEASUREMENT
/begin MEASUREMENT B_ibspwf "" UBYTE B_TRUE 1 100 0 1 BIT_MASK 0x1 FORMAT "%13.11" ECU_ADDRESS 0x4032E6 /end MEASUREMENT
/begin MEASUREMENT B_ibsweck "" UBYTE B_TRUE 1 100 0 1 BIT_MASK 0x1 FORMAT "%13.11" ECU_ADDRESS 0x4032E7 /end MEASUREMENT
/begin MEASUREMENT B_ibunplau "Fehler IBS SW unplausibel" UBYTE B_TRUE 1 100 0 1 BIT_MASK 0x1 FORMAT "%13.11" ECU_ADDRESS 0x4032E8 /end MEASUREMENT
/begin MEASUREMENT B_idlgspec "" UBYTE B_TRUE 1 100 0 1 FORMAT "%13.11" ECU_ADDRESS 0x4037FF /end MEASUREMENT
/begin MEASUREMENT B_ifbsa7 "" UBYTE B_TRUE 1 100 0 1 FORMAT "%13.11" ECU_ADDRESS 0x403397 /end MEASUREMENT
/begin MEASUREMENT B_ifupla7 "" UBYTE B_TRUE 1 100 0 1 FORMAT "%13.11" ECU_ADDRESS 0x403398 /end MEASUREMENT
/begin MEASUREMENT B_inibumg "Hilfsbedingung Batterietemperaturumgebungsberechung" UBYTE B_TRUE 1 100 0 1 FORMAT "%13.11" ECU_ADDRESS 0x403384 /end MEASUREMENT
/begin MEASUREMENT B_iwfalse "Bedingung kein g¸ltiger Exzenterwinkelwert Bank1" UBYTE B_TRUE 1 100 0 1 BIT_MASK 0x1 FORMAT "%13.11" ECU_ADDRESS 0x4037EC /end MEASUREMENT
/begin MEASUREMENT B_iwfalse2 "Bedingung kein g¸ltiger Exzenterwinkelwert Bank2" UBYTE B_TRUE 1 100 0 1 BIT_MASK 0x1 FORMAT "%13.11" ECU_ADDRESS 0x4037ED /end MEASUREMENT
/begin MEASUREMENT B_lalgf "Bedingung Laufgrenze ""Lambda fett"" aktiv" UWORD B_TRUE 1 100 0 1 BIT_MASK 0x1 FORMAT "%13.11" ECU_ADDRESS 0x3FC0C9 /end MEASUREMENT
/begin MEASUREMENT B_lalgf2 "Bedingung Laufgrenze ""Lambda fett"" aktiv" UWORD B_TRUE 1 100 0 1 BIT_MASK 0x1 FORMAT "%13.11" ECU_ADDRESS 0x3FC0CA /end MEASUREMENT
/begin MEASUREMENT B_lamdiag "Lambdasoll von Diagnosefunktionen angefordert" UWORD B_TRUE 1 100 0 1 BIT_MASK 0x1 FORMAT "%13.11" ECU_ADDRESS 0x3FC0CB /end MEASUREMENT
/begin MEASUREMENT B_lamdiag2 "Lambdasoll von Diagnosefunktionen angefordert Bank2" UWORD B_TRUE 1 100 0 1 BIT_MASK 0x1 FORMAT "%13.11" ECU_ADDRESS 0x3FC0CC /end MEASUREMENT
/begin MEASUREMENT B_lamkh "Bedingung Lambdasoll f¸r Katheizen aktiv" UWORD B_TRUE 1 100 0 1 BIT_MASK 0x1 FORMAT "%13.11" ECU_ADDRESS 0x3FC0CD /end MEASUREMENT
/begin MEASUREMENT B_lamkhe "keine Lambdaanforderung seitens LAKH" UBYTE B_TRUE 1 100 0 1 BIT_MASK 0x1 FORMAT "%13.11" ECU_ADDRESS 0x3FC1A0 /end MEASUREMENT
/begin MEASUREMENT B_lamnswl "Lambda-Motor-Soll f¸r Nachstart und Warmlauf aktiv" UWORD B_TRUE 1 100 0 1 BIT_MASK 0x1 FORMAT "%13.11" ECU_ADDRESS 0x3FC0CE /end MEASUREMENT
/begin MEASUREMENT B_lamsdef "Bedingung : definierte Soll-Lambda" UWORD B_TRUE 1 100 0 1 BIT_MASK 0x1 FORMAT "%13.11" ECU_ADDRESS 0x3FC0CF /end MEASUREMENT
/begin MEASUREMENT B_ldef "Bedingung : definierte Soll-Lambda Bank1" UWORD B_TRUE 1 100 0 1 BIT_MASK 0x1 FORMAT "%13.11" ECU_ADDRESS 0x3FC0D0 /end MEASUREMENT
/begin MEASUREMENT B_ldef2 "Bedingung : definierte Soll-Lambda Bank2" UWORD B_TRUE 1 100 0 1 BIT_MASK 0x1 FORMAT "%13.11" ECU_ADDRESS 0x3FC0D1 /end MEASUREMENT
/begin MEASUREMENT B_llr "Bedingung Leerlaufregelung" UBYTE B_TRUE 1 100 0 1 BIT_MASK 0x2 FORMAT "%13.11" ECU_ADDRESS 0x40398D /end MEASUREMENT
/begin MEASUREMENT B_llrein "Bedingung LLR Betriebsbereit nach Start" UBYTE B_TRUE 1 100 0 1 BIT_MASK 0x1 FORMAT "%13.11" ECU_ADDRESS 0x40398D /end MEASUREMENT
/begin MEASUREMENT B_llri "Bedingung I-Anteil der LLR aktiv" UBYTE B_TRUE 1 100 0 1 BIT_MASK 0x4 FORMAT "%13.11" ECU_ADDRESS 0x40398D /end MEASUREMENT
/begin MEASUREMENT B_llrimx "Bedingung dmllri hat Sicherheitsgrenze erreicht" UBYTE B_TRUE 1 100 0 1 BIT_MASK 0x1 FORMAT "%13.11" ECU_ADDRESS 0x3FC232 /end MEASUREMENT
/begin MEASUREMENT B_llrpd "Bedingung PD-Anteil der LLR aktiv" UBYTE B_TRUE 1 100 0 1 BIT_MASK 0x10 FORMAT "%13.11" ECU_ADDRESS 0x40398D /end MEASUREMENT
/begin MEASUREMENT B_lltdff "" UBYTE B_TRUE 1 100 0 1 BIT_MASK 0x1 FORMAT "%13.11" ECU_ADDRESS 0x3FC22B /end MEASUREMENT
/begin MEASUREMENT B_lrfoff "Drehzahlschwelle f¸r LR-Funktion Generator 1 aktiv" UBYTE B_TRUE 1 100 0 1 BIT_MASK 0x1 FORMAT "%13.11" ECU_ADDRESS 0x402F78 /end MEASUREMENT
/begin MEASUREMENT B_lrfoff2 "Drehzahlschwelle f¸r LR-Funktion Generator 2 aktiv" UBYTE B_TRUE 1 100 0 1 BIT_MASK 0x1 FORMAT "%13.11" ECU_ADDRESS 0x402F79 /end MEASUREMENT
/begin MEASUREMENT B_lrreg1ak "LR-Register 1 aktiv Generator1" UBYTE B_TRUE 1 100 0 1 BIT_MASK 0x1 FORMAT "%13.11" ECU_ADDRESS 0x402F7A /end MEASUREMENT
/begin MEASUREMENT B_lrreg1ak2 "" UBYTE B_TRUE 1 100 0 1 BIT_MASK 0x1 FORMAT "%13.11" ECU_ADDRESS 0x402F7B /end MEASUREMENT
/begin MEASUREMENT B_lsuiamn "Bedingung: Lambdasensorsignal an Bond IA kleiner als Schwellwert" UBYTE B_TRUE 1 100 0 1 BIT_MASK 0x4 FORMAT "%13.11" ECU_ADDRESS 0x402F5A /end MEASUREMENT
/begin MEASUREMENT B_lsuiamn2 "Bedingung: Lambdasensorsignal an Bond IA kleiner als Schwellwert, Bank 2" UBYTE B_TRUE 1 100 0 1 BIT_MASK 0x4 FORMAT "%13.11" ECU_ADDRESS 0x402F5B /end MEASUREMENT
/begin MEASUREMENT B_lsuiamx "Bedingung: Lambdasensorsignal an Bond IA grˆﬂer als Schwellwert" UBYTE B_TRUE 1 100 0 1 BIT_MASK 0x20 FORMAT "%13.11" ECU_ADDRESS 0x402F5A /end MEASUREMENT
/begin MEASUREMENT B_lsuiamx2 "Bedingung: Lambdasensorsignal an Bond IA grˆﬂer als Schwellwert, Bank 2" UBYTE B_TRUE 1 100 0 1 BIT_MASK 0x20 FORMAT "%13.11" ECU_ADDRESS 0x402F5B /end MEASUREMENT
/begin MEASUREMENT B_lsuicif "Bedingung Schreibfehler auf INIT-Register des Auswerte IC der LSU" UBYTE B_TRUE 1 100 0 1 BIT_MASK 0x1 FORMAT "%13.11" ECU_ADDRESS 0x3FC184 /end MEASUREMENT
/begin MEASUREMENT B_lsuicif2 "Bedingung Schreibfehler auf INIT-Register des Auswerte IC der LSU, Bank 2" UBYTE B_TRUE 1 100 0 1 BIT_MASK 0x1 FORMAT "%13.11" ECU_ADDRESS 0x3FC185 /end MEASUREMENT
/begin MEASUREMENT B_lsuickf "Bedingung Kommunikationsfehler der SPI Schnittstelle zum Auswerte IC" UBYTE B_TRUE 1 100 0 1 BIT_MASK 0x1 FORMAT "%13.11" ECU_ADDRESS 0x3FC186 /end MEASUREMENT
/begin MEASUREMENT B_lsuickf2 "Bedingung Kommunikationsfehler der SPI Schnittstelle zum Auswerte IC, Bank 2" UBYTE B_TRUE 1 100 0 1 BIT_MASK 0x1 FORMAT "%13.11" ECU_ADDRESS 0x3FC187 /end MEASUREMENT
/begin MEASUREMENT B_lsuube "Bedingung Betriebsspannung am LSU-Auswerte-IC zu klein" UBYTE B_TRUE 1 100 0 1 BIT_MASK 0x40 FORMAT "%13.11" ECU_ADDRESS 0x402F5A /end MEASUREMENT
/begin MEASUREMENT B_lsuube2 "Bedingung Betriebsspannung am LSU-Auswerte-IC zu klein, Bank 2" UBYTE B_TRUE 1 100 0 1 BIT_MASK 0x40 FORMAT "%13.11" ECU_ADDRESS 0x402F5B /end MEASUREMENT
/begin MEASUREMENT B_lsuunmn "Bedingung: Lambdasensorsignal an Bond UN kleiner als Schwellwert" UBYTE B_TRUE 1 100 0 1 BIT_MASK 0x2 FORMAT "%13.11" ECU_ADDRESS 0x402F5A /end MEASUREMENT
/begin MEASUREMENT B_lsuunmn2 "Bedingung: Lambdasensorsignal an Bond UN kleiner als Schwellwert, Bank 2" UBYTE B_TRUE 1 100 0 1 BIT_MASK 0x2 FORMAT "%13.11" ECU_ADDRESS 0x402F5B /end MEASUREMENT
/begin MEASUREMENT B_lsuunmx "Bedingung: Lambdasensorsignal an Bond UN grˆﬂer als Schwellwert" UBYTE B_TRUE 1 100 0 1 BIT_MASK 0x10 FORMAT "%13.11" ECU_ADDRESS 0x402F5A /end MEASUREMENT
/begin MEASUREMENT B_lsuunmx2 "Bedingung: Lambdasensorsignal an Bond UN grˆﬂer als Schwellwert, Bank 2" UBYTE B_TRUE 1 100 0 1 BIT_MASK 0x10 FORMAT "%13.11" ECU_ADDRESS 0x402F5B /end MEASUREMENT
/begin MEASUREMENT B_lsuvmmn "Bedingung: Lambdasensorsignal an Bond VM kleiner als Schwellwert" UBYTE B_TRUE 1 100 0 1 BIT_MASK 0x1 FORMAT "%13.11" ECU_ADDRESS 0x402F5A /end MEASUREMENT
/begin MEASUREMENT B_lsuvmmn2 "Bedingung: Lambdasensorsignal an Bond VM kleiner als Schwellwert, Bank 2" UBYTE B_TRUE 1 100 0 1 BIT_MASK 0x1 FORMAT "%13.11" ECU_ADDRESS 0x402F5B /end MEASUREMENT
/begin MEASUREMENT B_lsuvmmx "Bedingung: Lambdasensorsignal an Bond VM grˆﬂer als Schwellwert" UBYTE B_TRUE 1 100 0 1 BIT_MASK 0x8 FORMAT "%13.11" ECU_ADDRESS 0x402F5A /end MEASUREMENT
/begin MEASUREMENT B_lsuvmmx2 "Bedingung: Lambdasensorsignal an Bond VM grˆﬂer als Schwellwert, Bank 2" UBYTE B_TRUE 1 100 0 1 BIT_MASK 0x8 FORMAT "%13.11" ECU_ADDRESS 0x402F5B /end MEASUREMENT
/begin MEASUREMENT B_mn_ia "Diagnoseregister CJ125:  Kurzschluﬂ nach Masse an Sensorleitung IA (10ms)" UWORD B_TRUE 1 100 0 1 BIT_MASK 0x1 FORMAT "%13.11" ECU_ADDRESS 0x3FC188 /end MEASUREMENT
/begin MEASUREMENT B_mn_ia2 "Diagnoseregister CJ125:  Kurzschluﬂ nach Masse an Sensorleitung IA (10ms), Bank2" UWORD B_TRUE 1 100 0 1 BIT_MASK 0x1 FORMAT "%13.11" ECU_ADDRESS 0x3FC189 /end MEASUREMENT
/begin MEASUREMENT B_mn_un "Diagnoseregister CJ125:  Kurzschluﬂ nach Masse an Sensorleitung  UN (10ms)" UWORD B_TRUE 1 100 0 1 BIT_MASK 0x1 FORMAT "%13.11" ECU_ADDRESS 0x3FC18A /end MEASUREMENT
/begin MEASUREMENT B_mn_un2 "Diagnoseregister CJ125:  Kurzschluﬂ nach Masse an Sensorleitung  UN (10ms), B2" UWORD B_TRUE 1 100 0 1 BIT_MASK 0x1 FORMAT "%13.11" ECU_ADDRESS 0x3FC18B /end MEASUREMENT
/begin MEASUREMENT B_mn_vm "Diagnoseregister CJ125:  Kurzschluﬂ nach Masse an Sensorleitung  VM (10ms)" UWORD B_TRUE 1 100 0 1 BIT_MASK 0x1 FORMAT "%13.11" ECU_ADDRESS 0x3FC18C /end MEASUREMENT
/begin MEASUREMENT B_mn_vm2 "Diagnoseregister CJ125:  Kurzschluﬂ nach Masse an Sensorleitung  VM (10ms), B2" UWORD B_TRUE 1 100 0 1 BIT_MASK 0x1 FORMAT "%13.11" ECU_ADDRESS 0x3FC18D /end MEASUREMENT
/begin MEASUREMENT B_mx_ia "Diagnoseregister CJ125:  Kurzschluﬂ nach U-Batt an Sensorleitung IA (10ms)" UWORD B_TRUE 1 100 0 1 BIT_MASK 0x1 FORMAT "%13.11" ECU_ADDRESS 0x3FC18E /end MEASUREMENT
/begin MEASUREMENT B_mx_ia2 "Diagnoseregister CJ125:  Kurzschluﬂ nach U-Batt an Sensorleitung IA (10ms), B2" UWORD B_TRUE 1 100 0 1 BIT_MASK 0x1 FORMAT "%13.11" ECU_ADDRESS 0x3FC18F /end MEASUREMENT
/begin MEASUREMENT B_mx_un "Diagnoseregister CJ125:  Kurzschluﬂ nach U-Batt an Sensorleitung UN (10ms)" UWORD B_TRUE 1 100 0 1 BIT_MASK 0x1 FORMAT "%13.11" ECU_ADDRESS 0x3FC190 /end MEASUREMENT
/begin MEASUREMENT B_mx_un2 "Diagnoseregister CJ125:  Kurzschluﬂ nach U-Batt an Sensorleitung UN (10ms), B2" UWORD B_TRUE 1 100 0 1 BIT_MASK 0x1 FORMAT "%13.11" ECU_ADDRESS 0x3FC191 /end MEASUREMENT
/begin MEASUREMENT B_mx_vm "Diagnoseregister CJ125:  Kurzschluﬂ nach U-Batt an Sensorleitung VM (10ms)" UWORD B_TRUE 1 100 0 1 BIT_MASK 0x1 FORMAT "%13.11" ECU_ADDRESS 0x3FC192 /end MEASUREMENT
/begin MEASUREMENT B_mx_vm2 "Diagnoseregister CJ125:  Kurzschluﬂ nach U-Batt an Sensorleitung VM (10ms), B2" UWORD B_TRUE 1 100 0 1 BIT_MASK 0x1 FORMAT "%13.11" ECU_ADDRESS 0x3FC193 /end MEASUREMENT
/begin MEASUREMENT B_nivns "Bedingung niedrige Solldrehzahl" UBYTE B_TRUE 1 100 0 1 BIT_MASK 0x1 FORMAT "%13.11" ECU_ADDRESS 0x3FC22C /end MEASUREMENT
/begin MEASUREMENT B_nsabg "Bedingung Abgleich Solldrehzahl" UBYTE B_TRUE 1 100 0 1 BIT_MASK 0x1 FORMAT "%13.11" ECU_ADDRESS 0x3FC226 /end MEASUREMENT
/begin MEASUREMENT B_nsub "Bedingung f¸r Solldrehzahlanhebung bei niedriger Batteriespannung" UBYTE B_TRUE 1 100 0 1 FORMAT "%13.11" ECU_ADDRESS 0x403800 /end MEASUREMENT
/begin MEASUREMENT B_nsubgen "" UBYTE B_TRUE 1 100 0 1 BIT_MASK 0x1 FORMAT "%13.11" ECU_ADDRESS 0x3FC22D /end MEASUREMENT
/begin MEASUREMENT B_nsubgen1 "" UBYTE B_TRUE 1 100 0 1 BIT_MASK 0x1 FORMAT "%13.11" ECU_ADDRESS 0x3FC22E /end MEASUREMENT
/begin MEASUREMENT B_nsvfzghy "" UBYTE B_TRUE 1 100 0 1 BIT_MASK 0x1 FORMAT "%13.11" ECU_ADDRESS 0x3FC22F /end MEASUREMENT
/begin MEASUREMENT B_ozfbsd "Fehler BSD-Kommunikation" UBYTE B_TRUE 1 100 0 1 BIT_MASK 0x1 FORMAT "%13.11" ECU_ADDRESS 0x402FA4 /end MEASUREMENT
/begin MEASUREMENT B_rdackreg0 "" UBYTE B_TRUE 1 100 0 1 BIT_MASK 0x2 FORMAT "%13.11" ECU_ADDRESS 0x40394A /end MEASUREMENT
/begin MEASUREMENT B_rdackreg1 "" UBYTE B_TRUE 1 100 0 1 BIT_MASK 0x4 FORMAT "%13.11" ECU_ADDRESS 0x40394A /end MEASUREMENT
/begin MEASUREMENT B_rdackreg2 "" UBYTE B_TRUE 1 100 0 1 BIT_MASK 0x8 FORMAT "%13.11" ECU_ADDRESS 0x40394A /end MEASUREMENT
/begin MEASUREMENT B_rdackreg3 "" UBYTE B_TRUE 1 100 0 1 BIT_MASK 0x10 FORMAT "%13.11" ECU_ADDRESS 0x40394A /end MEASUREMENT
/begin MEASUREMENT B_rdackreg5 "" UBYTE B_TRUE 1 100 0 1 BIT_MASK 0x20 FORMAT "%13.11" ECU_ADDRESS 0x40394A /end MEASUREMENT
/begin MEASUREMENT B_rdackreg6 "" UBYTE B_TRUE 1 100 0 1 BIT_MASK 0x40 FORMAT "%13.11" ECU_ADDRESS 0x40394A /end MEASUREMENT
/begin MEASUREMENT B_rdackreg7 "" UBYTE B_TRUE 1 100 0 1 BIT_MASK 0x80 FORMAT "%13.11" ECU_ADDRESS 0x40394A /end MEASUREMENT
/begin MEASUREMENT B_readreg2 "" UBYTE B_TRUE 1 100 0 1 BIT_MASK 0x4 FORMAT "%13.11" ECU_ADDRESS 0x40394C /end MEASUREMENT
/begin MEASUREMENT B_readreg3 "" UBYTE B_TRUE 1 100 0 1 BIT_MASK 0x1 FORMAT "%13.11" ECU_ADDRESS 0x40394B /end MEASUREMENT
/begin MEASUREMENT B_startfgk "" UBYTE B_TRUE 1 100 0 1 BIT_MASK 0x1 FORMAT "%13.11" ECU_ADDRESS 0x4032E9 /end MEASUREMENT
/begin MEASUREMENT B_strtaw "" UBYTE B_TRUE 1 100 0 1 BIT_MASK 0x1 FORMAT "%13.11" ECU_ADDRESS 0x4032EA /end MEASUREMENT
/begin MEASUREMENT B_tevtini "TEV timer wurde neu initialisiert" UBYTE B_TRUE 1 100 0 1 BIT_MASK 0x1 FORMAT "%13.11" ECU_ADDRESS 0x3FC196 /end MEASUREMENT
/begin MEASUREMENT B_tiefset "" UBYTE B_TRUE 1 100 0 1 BIT_MASK 0x1 FORMAT "%13.11" ECU_ADDRESS 0x4032EB /end MEASUREMENT
/begin MEASUREMENT B_ube_lsu "Diagnoseregister CJ125:  Betriebsspannung am LSU-Auswerte-IC zu klein (10ms)" UWORD B_TRUE 1 100 0 1 BIT_MASK 0x1 FORMAT "%13.11" ECU_ADDRESS 0x3FC194 /end MEASUREMENT
/begin MEASUREMENT B_ube_lsu2 "Diagnoseregister CJ125:  Betriebsspannung am LSU-Auswerte-IC zu klein (10ms), B2" UWORD B_TRUE 1 100 0 1 BIT_MASK 0x1 FORMAT "%13.11" ECU_ADDRESS 0x3FC195 /end MEASUREMENT
/begin MEASUREMENT B_ubwdl "" UBYTE B_TRUE 1 100 0 1 BIT_MASK 0x1 FORMAT "%13.11" ECU_ADDRESS 0x3FC230 /end MEASUREMENT
/begin MEASUREMENT B_ubwulow "" UBYTE B_TRUE 1 100 0 1 BIT_MASK 0x1 FORMAT "%13.11" ECU_ADDRESS 0x3FC231 /end MEASUREMENT
/begin MEASUREMENT B_vdia1cok "Bedingung LOCAN-Botschaft VVT_DME_DIAG_1 vorhanden" UBYTE B_TRUE 1 100 0 1 BIT_MASK 0x1 FORMAT "%13.11" ECU_ADDRESS 0x4037EE /end MEASUREMENT
/begin MEASUREMENT B_vdia1new "Bedingung LOCAN-Botschaft VVT_DME_DIAG_1 i.O. empfangen" UBYTE B_TRUE 1 100 0 1 BIT_MASK 0x1 FORMAT "%13.11" ECU_ADDRESS 0x4037EF /end MEASUREMENT
/begin MEASUREMENT B_vdia2cok "Bedingung LOCAN-Botschaft VVT_DME_DIAG_2 vorhanden" UBYTE B_TRUE 1 100 0 1 BIT_MASK 0x1 FORMAT "%13.11" ECU_ADDRESS 0x4037F0 /end MEASUREMENT
/begin MEASUREMENT B_vdia2new "Bedingung LOCAN-Botschaft VVT_DME_DIAG_2 i.O. empfangen" UBYTE B_TRUE 1 100 0 1 BIT_MASK 0x1 FORMAT "%13.11" ECU_ADDRESS 0x4037F1 /end MEASUREMENT
/begin MEASUREMENT B_vla "Bedingung Vollastanreicherung > 1.0" UBYTE B_TRUE 1 100 0 1 BIT_MASK 0x1 FORMAT "%13.11" ECU_ADDRESS 0x3FC0C8 /end MEASUREMENT
/begin MEASUREMENT B_vllr "Bedingung Fahrzeug rollt mit eingelegtem Gang" UBYTE B_TRUE 1 100 0 1 BIT_MASK 0x8 FORMAT "%13.11" ECU_ADDRESS 0x40398D /end MEASUREMENT
/begin MEASUREMENT B_vvt1chso "Checksummen.- und Alivepr¸fung der Botschaft VVT_DME_1 in Ordnung" UBYTE B_TRUE 1 100 0 1 BIT_MASK 0x1 FORMAT "%13.11" ECU_ADDRESS 0x4037F2 /end MEASUREMENT
/begin MEASUREMENT B_vvt1cok "Bedingung LOCAN-Botschaft VVT_DME_1 vorhanden" UBYTE B_TRUE 1 100 0 1 BIT_MASK 0x1 FORMAT "%13.11" ECU_ADDRESS 0x4037F3 /end MEASUREMENT
/begin MEASUREMENT B_vvt1new "Bedingung LOCAN-Botschaft VVT_DME_1 i.O. empfangen" UBYTE B_TRUE 1 100 0 1 BIT_MASK 0x1 FORMAT "%13.11" ECU_ADDRESS 0x4037F4 /end MEASUREMENT
/begin MEASUREMENT B_vvt2chso "Checksummen.- und Alivepr¸fung der Botschaft VVT_DME_2 in Ordnung" UBYTE B_TRUE 1 100 0 1 BIT_MASK 0x1 FORMAT "%13.11" ECU_ADDRESS 0x4037F5 /end MEASUREMENT
/begin MEASUREMENT B_vvt2cok "Bedingung LOCAN-Botschaft VVT_DME_2 vorhanden" UBYTE B_TRUE 1 100 0 1 BIT_MASK 0x1 FORMAT "%13.11" ECU_ADDRESS 0x4037F6 /end MEASUREMENT
/begin MEASUREMENT B_vvt2new "Bedingung LOCAN-Botschaft VVT_DME_2 i.O. empfangen" UBYTE B_TRUE 1 100 0 1 BIT_MASK 0x1 FORMAT "%13.11" ECU_ADDRESS 0x4037F7 /end MEASUREMENT
/begin MEASUREMENT B_wrablauf1 "" UBYTE B_TRUE 1 100 0 1 BIT_MASK 0x20 FORMAT "%13.11" ECU_ADDRESS 0x40394B /end MEASUREMENT
/begin MEASUREMENT B_wrablauf2 "" UBYTE B_TRUE 1 100 0 1 BIT_MASK 0x40 FORMAT "%13.11" ECU_ADDRESS 0x40394B /end MEASUREMENT
/begin MEASUREMENT B_wrablauf3 "" UBYTE B_TRUE 1 100 0 1 BIT_MASK 0x80 FORMAT "%13.11" ECU_ADDRESS 0x40394B /end MEASUREMENT
/begin MEASUREMENT B_wrackreg2 "" UBYTE B_TRUE 1 100 0 1 BIT_MASK 0x8 FORMAT "%13.11" ECU_ADDRESS 0x40394C /end MEASUREMENT
/begin MEASUREMENT B_wrackreg3 "" UBYTE B_TRUE 1 100 0 1 BIT_MASK 0x2 FORMAT "%13.11" ECU_ADDRESS 0x40394B /end MEASUREMENT
/begin MEASUREMENT B_wrierrgrenz "" UBYTE B_TRUE 1 100 0 1 BIT_MASK 0x10 FORMAT "%13.11" ECU_ADDRESS 0x40394B /end MEASUREMENT
/begin MEASUREMENT B_wrierrgrenzoff "" UBYTE B_TRUE 1 100 0 1 BIT_MASK 0x1 FORMAT "%13.11" ECU_ADDRESS 0x40394C /end MEASUREMENT
/begin MEASUREMENT B_wrtlrgen "" UBYTE B_TRUE 1 100 0 1 BIT_MASK 0x8 FORMAT "%13.11" ECU_ADDRESS 0x40394B /end MEASUREMENT
/begin MEASUREMENT B_wrugen "" UBYTE B_TRUE 1 100 0 1 BIT_MASK 0x4 FORMAT "%13.11" ECU_ADDRESS 0x40394B /end MEASUREMENT
/begin MEASUREMENT caseVar "Variable fuer Case-Kontrollstruktur im Komponententreiber KT_DICLSU" UBYTE dez 1 100 0 255 FORMAT "%5.1" ECU_ADDRESS 0x403C1F /end MEASUREMENT
/begin MEASUREMENT caseVar2 "Variable fuer Case-Kontrollstruktur im Komponententreiber KT_DICLSU, B2" UBYTE dez 1 100 0 255 FORMAT "%5.1" ECU_ADDRESS 0x403C20 /end MEASUREMENT
/begin MEASUREMENT chipErrCtr1 "" UBYTE dez 1 100 0 255 FORMAT "%5.1" ECU_ADDRESS 0x403C21 /end MEASUREMENT
/begin MEASUREMENT chipErrCtr2 "" UBYTE dez 1 100 0 255 FORMAT "%5.1" ECU_ADDRESS 0x403C22 /end MEASUREMENT
/begin MEASUREMENT chk16_ibs "" UWORD default 1 100 0 65535 FORMAT "%8.2" ECU_ADDRESS 0x4032F0 /end MEASUREMENT
/begin MEASUREMENT chkbfgen "Speicherzelle f¸r Check-Byte von Generatorschnittstelle" UBYTE dez 1 100 0 255 FORMAT "%5.1" ARRAY_SIZE 2 ECU_ADDRESS 0x402F86 /end MEASUREMENT
/begin MEASUREMENT chkpara "" UWORD default 1 100 0 65535 FORMAT "%8.2" ECU_ADDRESS 0x4032F2 /end MEASUREMENT
/begin MEASUREMENT chsdmevvt1 "Checksumme f¸r Botschaft  DME_VVT_1" UBYTE dez 1 100 0 255 FORMAT "%5.1" ECU_ADDRESS 0x40395C /end MEASUREMENT
/begin MEASUREMENT chsdmevvt2 "Checksumme f¸r Botschaft DME_VVT_2" UBYTE dez 1 100 0 255 FORMAT "%5.1" ECU_ADDRESS 0x40395D /end MEASUREMENT
/begin MEASUREMENT chsvvtdme1 "Checksumme f¸r Botschaft VVT_DME_1" UBYTE dez 1 100 0 255 FORMAT "%5.1" ECU_ADDRESS 0x403960 /end MEASUREMENT
/begin MEASUREMENT chsvvtdme2 "Checksumme f¸r Botschaft VVT_DME_2" UBYTE dez 1 100 0 255 FORMAT "%5.1" ECU_ADDRESS 0x403961 /end MEASUREMENT
/begin MEASUREMENT cobattort "Codierzelle Batterieeinbauort" UBYTE dez 1 100 0 255 FORMAT "%5.1" ECU_ADDRESS 0x403387 /end MEASUREMENT
/begin MEASUREMENT ComControl "" UBYTE dez 1 100 0 255 FORMAT "%5.1" ECU_ADDRESS 0x403330 /end MEASUREMENT
/begin MEASUREMENT count_ablx "" UBYTE dez 1 100 0 255 FORMAT "%5.1" ECU_ADDRESS 0x402F88 /end MEASUREMENT
/begin MEASUREMENT ctrgenutar "Generatorsollspannung" UBYTE spg_gencan 1 100 10.6 16.975 FORMAT "%5.2" ECU_ADDRESS 0x4039A5 /end MEASUREMENT
/begin MEASUREMENT data2_init2 "" UBYTE dez 1 100 0 255 FORMAT "%5.1" ECU_ADDRESS 0x403C23 /end MEASUREMENT
/begin MEASUREMENT data2_s "Init-Register 1 (Send) Bank 2" UBYTE dez 1 100 0 255 FORMAT "%5.1" ECU_ADDRESS 0x403C24 /end MEASUREMENT
/begin MEASUREMENT data_init2 "" UBYTE dez 1 100 0 255 FORMAT "%5.1" ECU_ADDRESS 0x403C25 /end MEASUREMENT
/begin MEASUREMENT data_s "Init-Register 1 (Send) Bank 1" UBYTE dez 1 100 0 255 FORMAT "%5.1" ECU_ADDRESS 0x403C26 /end MEASUREMENT
/begin MEASUREMENT dbetalf_t "Temp-Variable" FLOAT32_IEEE fak_r32_1 1 100 -10000 10000 FORMAT "%27.21" ECU_ADDRESS 0x40245C /end MEASUREMENT
/begin MEASUREMENT dbet_alf "Batterieaplphawert" FLOAT32_IEEE fak_r32_1 1 100 -10000 10000 FORMAT "%27.21" ECU_ADDRESS 0x402460 /end MEASUREMENT
/begin MEASUREMENT deltadff "" SBYTE rel_ub_b100 1 100 -50 49.6094 FORMAT "%5.2" ECU_ADDRESS 0x4030AF /end MEASUREMENT
/begin MEASUREMENT dffgen "vom Generator empfangenes Lastsignal" UBYTE rel_ub_b100 1 100 0 99.6094 FORMAT "%5.2" ECU_ADDRESS 0x402F89 /end MEASUREMENT
/begin MEASUREMENT dffgen2 "vom Generator 2 empfangenes Lastsignal" UBYTE rel_ub_b100 1 100 0 99.6094 FORMAT "%5.2" ECU_ADDRESS 0x402F8A /end MEASUREMENT
/begin MEASUREMENT dffgenflo "DF-Signal temp" FLOAT32_IEEE fak_r32_1 1 100 0 10000 FORMAT "%27.21" ECU_ADDRESS 0x403390 /end MEASUREMENT
/begin MEASUREMENT dffgenschz "" UBYTE dez 1 100 0 255 FORMAT "%5.1" ECU_ADDRESS 0x403C9C /end MEASUREMENT
/begin MEASUREMENT dffgen_alt "" UBYTE rel_ub_b100 1 100 0 99.6094 FORMAT "%5.2" ECU_ADDRESS 0x4030B0 /end MEASUREMENT
/begin MEASUREMENT dfmonitor "DF-Monitor f¸r Batterie-Ladezustand in %" UBYTE PCENT 1 100 0 99.6094 FORMAT "%5.2" ECU_ADDRESS 0x3FE218 /end MEASUREMENT
/begin MEASUREMENT dfsumme "DFMonitor Summe FASTA" FLOAT32_IEEE fak_r32_1 1 100 0 3e+020 FORMAT "%27.5" ECU_ADDRESS 0x3FE21C /end MEASUREMENT
/begin MEASUREMENT dfwanzahl "DF-Wertez‰hler" FLOAT32_IEEE fak_r32_1 1 100 1 10000 FORMAT "%27.21" ECU_ADDRESS 0x3FE220 /end MEASUREMENT
/begin MEASUREMENT dlsu1_ia_err "" UWORD dez 1 100 0 65535 FORMAT "%8.2" ECU_ADDRESS 0x402F5C /end MEASUREMENT
/begin MEASUREMENT dlsu1_un_err "" UWORD dez 1 100 0 65535 FORMAT "%8.2" ECU_ADDRESS 0x402F5E /end MEASUREMENT
/begin MEASUREMENT dlsu1_vm_err "" UWORD dez 1 100 0 65535 FORMAT "%8.2" ECU_ADDRESS 0x402F60 /end MEASUREMENT
/begin MEASUREMENT dlsu2_ia_err "" UWORD dez 1 100 0 65535 FORMAT "%8.2" ECU_ADDRESS 0x402F62 /end MEASUREMENT
/begin MEASUREMENT dlsu2_un_err "" UWORD dez 1 100 0 65535 FORMAT "%8.2" ECU_ADDRESS 0x402F64 /end MEASUREMENT
/begin MEASUREMENT dlsu2_vm_err "" UWORD dez 1 100 0 65535 FORMAT "%8.2" ECU_ADDRESS 0x402F66 /end MEASUREMENT
/begin MEASUREMENT dmdresdtev "Delta-Momentenreserve f¸r TEV Drehzahlcheck" SBYTE rel_sb_q0p0976 1 100 -12.4988 12.4012 FORMAT "%5.2" ECU_ADDRESS 0x403CAC /end MEASUREMENT
/begin MEASUREMENT dmdresfs "dyn. Delta-Moment nach eingelegter Fahrstufe" UBYTE rel_ub_b24p9 1 100 0 24.9 FORMAT "%5.2" ECU_ADDRESS 0x403CAD /end MEASUREMENT
/begin MEASUREMENT dmlllmn_w "Reservemomentschwelle f¸r Lufteingriffe" SWORD rel_sw_b100 1 100 -100 99.9969 FORMAT "%8.4" ECU_ADDRESS 0x404126 /end MEASUREMENT
/begin MEASUREMENT dmllrdz_w "geforderte Drehmoment‰nderung von der LLR (D-Z¸ndungsanteil)" SWORD rel_sw_b100 1 100 -100 99.9969 FORMAT "%8.4" ECU_ADDRESS 0x404110 /end MEASUREMENT
/begin MEASUREMENT dmllrd_w "geforderte Drehmoment‰nderung von der LLR (D-Anteil)" SWORD rel_sw_b100 1 100 -100 99.9969 FORMAT "%8.4" ECU_ADDRESS 0x404112 /end MEASUREMENT
/begin MEASUREMENT dmllri_w "geforderte Drehmoment‰nderung von der LLR (I-Anteil)" SWORD rel_sw_b100 1 100 -100 99.9969 FORMAT "%8.4" ECU_ADDRESS 0x404114 /end MEASUREMENT
/begin MEASUREMENT dmllrpz_w "geforderte Drehmoment‰nderung von der LLR (P-Z¸ndungsanteil)" SWORD rel_sw_b100 1 100 -100 99.9969 FORMAT "%8.4" ECU_ADDRESS 0x404116 /end MEASUREMENT
/begin MEASUREMENT dmllrp_w "geforderte Drehmoment‰nderung von der LLR (P-Anteil)" SWORD rel_sw_b100 1 100 -100 99.9969 FORMAT "%8.4" ECU_ADDRESS 0x404118 /end MEASUREMENT
/begin MEASUREMENT dmllrzf_w "geforderte MD-ƒnderung (LLR  PD-Z¸ndungsanteil) fest bei B_dtei" SWORD rel_sw_b100 1 100 -100 99.9969 FORMAT "%8.4" ECU_ADDRESS 0x40411A /end MEASUREMENT
/begin MEASUREMENT dmllrz_w "geforderte MD-ƒnderung von der LLR (PD-Z¸ndungsanteil)" SWORD rel_sw_b100 1 100 -100 99.9969 FORMAT "%8.4" ECU_ADDRESS 0x40411C /end MEASUREMENT
/begin MEASUREMENT dmllr_w "geforderte Drehmoment‰nderung von der LLR (PD-Anteil)" SWORD rel_sw_b100 1 100 -100 99.9969 FORMAT "%8.4" ECU_ADDRESS 0x40411E /end MEASUREMENT
/begin MEASUREMENT dmrllrku_temp "" UWORD rel_q0p09726 1 100 0 6399.3 FORMAT "%8.3" ECU_ADDRESS 0x404128 /end MEASUREMENT
/begin MEASUREMENT dmrllrku_w "BMW" UWORD rel_q0p09726 1 100 0 6399.3 FORMAT "%8.3" ECU_ADDRESS 0x40412A /end MEASUREMENT
/begin MEASUREMENT dmrllr_w "Momenten-Reserve f¸r Leerlaufregelung" UWORD rel_q0p09726 1 100 0 6399.3 FORMAT "%8.3" ECU_ADDRESS 0x40412C /end MEASUREMENT
/begin MEASUREMENT dn "Drehzahlabweichung bei Leerlaufregelung" SBYTE nmotd_sb_q10 1 100 -1280 1270 FORMAT "%5.0" ECU_ADDRESS 0x403CAA /end MEASUREMENT
/begin MEASUREMENT dnfsacmv "LLRNS: Delta-Solldrehzahl von DS2-Kommunikator, AC mit FS" SBYTE nmotd_sb_q10 1 100 -1280 1270 FORMAT "%5.0" ECU_ADDRESS 0x4030A6 /end MEASUREMENT
/begin MEASUREMENT dnfsmv "LLRNS: Delta-Solldrehzahl von DS2-Kommunikator, mit FS" SBYTE nmotd_sb_q10 1 100 -1280 1270 FORMAT "%5.0" ECU_ADDRESS 0x4030A7 /end MEASUREMENT
/begin MEASUREMENT dnllmv "LLRNS: Delta-Solldrehzahl von DS2-Kommunikator" SBYTE nmotd_sb_q10 1 100 -1280 1270 FORMAT "%5.0" ECU_ADDRESS 0x4030A8 /end MEASUREMENT
/begin MEASUREMENT dns "LLR: Drehzahlabweichung zur station‰ren Solldrehzahl" SBYTE nmotd_sb_q10 1 100 -1280 1270 FORMAT "%5.0" ECU_ADDRESS 0x403C9D /end MEASUREMENT
/begin MEASUREMENT dnsacmv "LLRNS: Delta-Solldrehzahl von DS2-Kommunikator, AC ohne FS" SBYTE nmotd_sb_q10 1 100 -1280 1270 FORMAT "%5.0" ECU_ADDRESS 0x4030A9 /end MEASUREMENT
/begin MEASUREMENT dnslbv "LLRNS: Delta-Solldrehzahl von DS2-Kommunikator, aus LLRUB" SBYTE nmotd_sb_q10 1 100 -1280 1270 FORMAT "%5.0" ECU_ADDRESS 0x4030AA /end MEASUREMENT
/begin MEASUREMENT dn_w "Drehzahlabweichung bei Leerlaufregelung" SWORD nmotd_sw_q0p25 1 100 -8192 8191.75 FORMAT "%8.3" ECU_ADDRESS 0x404120 /end MEASUREMENT
/begin MEASUREMENT dt_tumg "delta T-Umgebung" FLOAT32_IEEE fak_r32_1 1 100 -300 10000 FORMAT "%27.21" ECU_ADDRESS 0x402464 /end MEASUREMENT
/begin MEASUREMENT dzkflag "Flagbyte Diagnoseflags" UBYTE dez 1 100 0 255 FORMAT "%5.1" ARRAY_SIZE 8 ECU_ADDRESS 0x40393E /end MEASUREMENT
/begin MEASUREMENT eavzrph2_l "Absolutz‰hler Raster Phasensignal NW 2" ULONG dez 1 100 0 4.29497e+009 FORMAT "%13.2" ECU_ADDRESS 0x404ABC /end MEASUREMENT
/begin MEASUREMENT eavzrph3_l "Absolutz‰hler Raster Phasensignal NW 3" ULONG dez 1 100 0 4.29497e+009 FORMAT "%13.2" ECU_ADDRESS 0x404AC0 /end MEASUREMENT
/begin MEASUREMENT eavzrph4_l "Absolutz‰hler Raster Phasensignal NW 4" ULONG dez 1 100 0 4.29497e+009 FORMAT "%13.2" ECU_ADDRESS 0x404AC4 /end MEASUREMENT
/begin MEASUREMENT eavzrph_l "Absolutz‰hler Raster Phasensignal" ULONG dez 1 100 0 4.29497e+009 FORMAT "%13.2" ECU_ADDRESS 0x404AC8 /end MEASUREMENT
/begin MEASUREMENT ebsd_adr "" UBYTE default 1 100 0 255 FORMAT "%5.1" ECU_ADDRESS 0x403331 /end MEASUREMENT
/begin MEASUREMENT ebsd_errdir "" UBYTE B_TRUE 1 100 0 1 BIT_MASK 0x1 FORMAT "%13.11" ECU_ADDRESS 0x4032EC /end MEASUREMENT
/begin MEASUREMENT ebsd_errep "" UBYTE dez 1 100 0 255 FORMAT "%5.1" ECU_ADDRESS 0x403332 /end MEASUREMENT
/begin MEASUREMENT ebsd_errin "" UBYTE dez 1 100 0 255 FORMAT "%5.1" ECU_ADDRESS 0x403333 /end MEASUREMENT
/begin MEASUREMENT ebsd_nbyt "" UBYTE default 1 100 0 255 FORMAT "%5.1" ECU_ADDRESS 0x403334 /end MEASUREMENT
/begin MEASUREMENT ebsd_timo "" UBYTE dez 1 100 0 255 FORMAT "%5.1" ECU_ADDRESS 0x403335 /end MEASUREMENT
/begin MEASUREMENT ebsd_varin "" UBYTE default 1 100 0 255 FORMAT "%5.1" ECU_ADDRESS 0x403336 /end MEASUREMENT
/begin MEASUREMENT end_init "Temp-Variable Initialisierungsende" UBYTE B_TRUE 1 100 0 1 FORMAT "%13.11" ECU_ADDRESS 0x403385 /end MEASUREMENT
/begin MEASUREMENT Err_get_1 "" UWORD dez 1 100 0 65535 FORMAT "%8.2" ECU_ADDRESS 0x4040E2 /end MEASUREMENT
/begin MEASUREMENT Err_get_2 "" UWORD dez 1 100 0 65535 FORMAT "%8.2" ECU_ADDRESS 0x4040E4 /end MEASUREMENT
/begin MEASUREMENT Err_set_1 "" UWORD dez 1 100 0 65535 FORMAT "%8.2" ECU_ADDRESS 0x4040E6 /end MEASUREMENT
/begin MEASUREMENT Err_set_2 "" UWORD dez 1 100 0 65535 FORMAT "%8.2" ECU_ADDRESS 0x4040E8 /end MEASUREMENT
/begin MEASUREMENT esst_sdn08llsw "" ULONG dez 1 100 0 4.29497e+009 FORMAT "%13.2" ECU_ADDRESS 0x404AD8 /end MEASUREMENT
/begin MEASUREMENT esst_sdn08lltsw "" ULONG dez 1 100 0 4.29497e+009 FORMAT "%13.2" ECU_ADDRESS 0x404ADC /end MEASUREMENT
/begin MEASUREMENT esst_sns06llsb "" ULONG dez 1 100 0 4.29497e+009 FORMAT "%13.2" ECU_ADDRESS 0x404AD0 /end MEASUREMENT
/begin MEASUREMENT esst_sns06lltsb "" ULONG dez 1 100 0 4.29497e+009 FORMAT "%13.2" ECU_ADDRESS 0x404AD4 /end MEASUREMENT
/begin MEASUREMENT exwnki2_w "Istwert Exzenterwinkel VVT Bank 2" UWORD wink_uw_q0p1 1 100 0 230 FORMAT "%8.4" ECU_ADDRESS 0x40475A /end MEASUREMENT
/begin MEASUREMENT exwnki_w "Istwert Exzenterwinkel VVT" UWORD wink_uw_q0p1 1 100 0 230 FORMAT "%8.4" ECU_ADDRESS 0x40475C /end MEASUREMENT
/begin MEASUREMENT fkvaum_ee "EEPROM Ablage von FKVAUM" UWORD tefuel_uw_b312p5 1 100 0 312.5 FORMAT "%8.4" ECU_ADDRESS 0x3FE958 /end MEASUREMENT
/begin MEASUREMENT flags_w "" UWORD dez 1 100 0 65535 FORMAT "%8.2" ECU_ADDRESS 0x4046F8 /end MEASUREMENT
/begin MEASUREMENT flaskh "Faktor ‹bergang zu Lambda-Abgas bei Sekund‰rluft" UBYTE fak_ub_b1 1 100 0 0.996094 ECU_ADDRESS 0x403002 /end MEASUREMENT
/begin MEASUREMENT flmsslkh "Faktor Lambda-Motor-Soll-Sekund‰rluftanteil, resultierend" UBYTE fak_ub_b1 1 100 0 0.996094 ECU_ADDRESS 0x403003 /end MEASUREMENT
/begin MEASUREMENT fsclctr "" UBYTE dez 1 100 0 255 FORMAT "%5.1" ECU_ADDRESS 0x403337 /end MEASUREMENT
/begin MEASUREMENT fslsdyn "Faktor Dynamikbeschreibung Sekund‰rluftsystem" UBYTE fak_ub_b1 1 100 0 0.996094 ECU_ADDRESS 0x403004 /end MEASUREMENT
/begin MEASUREMENT fwlmkhkst "Faktor f¸r Wichtung des Motorlambdas bei Katheizen" UBYTE fak_ub_b1 1 100 0 0.996094 ECU_ADDRESS 0x403005 /end MEASUREMENT
/begin MEASUREMENT geli_dflim "" UBYTE rel_ub_b100 1 100 0 99.6094 FORMAT "%5.2" ECU_ADDRESS 0x403C9E /end MEASUREMENT
/begin MEASUREMENT geli_fdflim "" UBYTE rel_ub_b100 1 100 0 99.6094 FORMAT "%5.2" ECU_ADDRESS 0x402F8B /end MEASUREMENT
/begin MEASUREMENT geli_fdflim2 "" UBYTE rel_ub_b100 1 100 0 99.6094 FORMAT "%5.2" ECU_ADDRESS 0x402F8C /end MEASUREMENT
/begin MEASUREMENT genmanufa2 "Kennung Generator Hersteller (Generator 2)" UBYTE dez 1 100 0 255 FORMAT "%5.1" ECU_ADDRESS 0x402F8D /end MEASUREMENT
/begin MEASUREMENT genmanufak "Kennung Generator Hersteller" UBYTE dez 1 100 0 255 FORMAT "%5.1" ECU_ADDRESS 0x402F8E /end MEASUREMENT
/begin MEASUREMENT gentypken2 "Kennung Generatortyp (Generator 2)" UBYTE dez 1 100 0 255 FORMAT "%5.1" ECU_ADDRESS 0x402F8F /end MEASUREMENT
/begin MEASUREMENT gentypkenn "Kennung Generatortyp" UBYTE dez 1 100 0 255 FORMAT "%5.1" ECU_ADDRESS 0x402F90 /end MEASUREMENT
/begin MEASUREMENT ibattar_w "" UWORD i_uw_q0p02_o200 1 100 -200 1110.7 ECU_ADDRESS 0x4032F4 /end MEASUREMENT
/begin MEASUREMENT ibatt_w "aktueller Batteriestrom" UWORD i_uw_q0p08_o200 1 100 -200 5042.8 ECU_ADDRESS 0x4032F6 /end MEASUREMENT
/begin MEASUREMENT ibhwversi "Hardware Index Intelligenter Batteriesensor" UBYTE dez 1 100 0 255 FORMAT "%5.1" ECU_ADDRESS 0x403338 /end MEASUREMENT
/begin MEASUREMENT ibsbclctr "" UBYTE dez 1 100 0 255 FORMAT "%5.1" ECU_ADDRESS 0x403339 /end MEASUREMENT
/begin MEASUREMENT ibsbclctri "" UBYTE dez 1 100 0 255 FORMAT "%5.1" ECU_ADDRESS 0x40333A /end MEASUREMENT
/begin MEASUREMENT ibsborctr "" UWORD dez 1 100 0 65535 FORMAT "%8.2" ECU_ADDRESS 0x4032F8 /end MEASUREMENT
/begin MEASUREMENT ibsdncsctr "" UBYTE dez 1 100 0 255 FORMAT "%5.1" ECU_ADDRESS 0x40333B /end MEASUREMENT
/begin MEASUREMENT ibseromctr "" UBYTE dez 1 100 0 255 FORMAT "%5.1" ECU_ADDRESS 0x40333C /end MEASUREMENT
/begin MEASUREMENT ibsiicctr "" UBYTE dez 1 100 0 255 FORMAT "%5.1" ECU_ADDRESS 0x40333D /end MEASUREMENT
/begin MEASUREMENT ibsiicctri "" UBYTE dez 1 100 0 255 FORMAT "%5.1" ECU_ADDRESS 0x40333E /end MEASUREMENT
/begin MEASUREMENT ibslvdctr "" UWORD dez 1 100 0 65535 FORMAT "%8.2" ECU_ADDRESS 0x4032FA /end MEASUREMENT
/begin MEASUREMENT ibsporctr "" UWORD dez 1 100 0 65535 FORMAT "%8.2" ECU_ADDRESS 0x4032FC /end MEASUREMENT
/begin MEASUREMENT ibspromctr "" UBYTE dez 1 100 0 255 FORMAT "%5.1" ECU_ADDRESS 0x40333F /end MEASUREMENT
/begin MEASUREMENT ibsptyctr "" UWORD dez 1 100 0 65535 FORMAT "%8.2" ECU_ADDRESS 0x4032FE /end MEASUREMENT
/begin MEASUREMENT ibsramctr "" UBYTE dez 1 100 0 255 FORMAT "%5.1" ECU_ADDRESS 0x403340 /end MEASUREMENT
/begin MEASUREMENT ibswbase "Software Baseline Intelligenter Batteriesensor" UBYTE dez 1 100 0 255 FORMAT "%5.1" ECU_ADDRESS 0x403341 /end MEASUREMENT
/begin MEASUREMENT ibswchang "Software Index Intelligenter Batteriesensor" UBYTE dez 1 100 0 255 FORMAT "%5.1" ECU_ADDRESS 0x403342 /end MEASUREMENT
/begin MEASUREMENT ibswdtctr "" UWORD dez 1 100 0 65535 FORMAT "%8.2" ECU_ADDRESS 0x403300 /end MEASUREMENT
/begin MEASUREMENT ibs_errors "" UBYTE dez 1 100 0 255 FORMAT "%5.1" ECU_ADDRESS 0x403343 /end MEASUREMENT
/begin MEASUREMENT ibs_msgind "EBSD Listen Index, Blocktransfer" UBYTE dez 1 100 0 255 FORMAT "%5.1" ECU_ADDRESS 0x403344 /end MEASUREMENT
/begin MEASUREMENT ibs_msgrdy "Bedingung EBSD data erfolgreich aus Sensor gelesen" UBYTE B_TRUE 1 100 0 1 BIT_MASK 0x1 FORMAT "%13.11" ECU_ADDRESS 0x4032ED /end MEASUREMENT
/begin MEASUREMENT ibs_msgsta "IBS Kommunikation Fehlerstatus" UBYTE dez 1 100 0 255 FORMAT "%5.1" ECU_ADDRESS 0x403345 /end MEASUREMENT
/begin MEASUREMENT ibs_msgwri "Bedingung EBSD zum Sensor schreiben" UBYTE B_TRUE 1 100 0 1 BIT_MASK 0x1 FORMAT "%13.11" ECU_ADDRESS 0x4032EE /end MEASUREMENT
/begin MEASUREMENT ibs_reg4 "" UBYTE default 1 100 0 255 FORMAT "%5.1" ECU_ADDRESS 0x403346 /end MEASUREMENT
/begin MEASUREMENT ibs_reg5 "" UBYTE default 1 100 0 255 FORMAT "%5.1" ECU_ADDRESS 0x403347 /end MEASUREMENT
/begin MEASUREMENT ibs_start "IBS Kommunikationsstatus" UBYTE dez 1 100 0 255 FORMAT "%5.1" ECU_ADDRESS 0x403348 /end MEASUREMENT
/begin MEASUREMENT ib_chk16 "" UWORD dez 1 100 0 65535 FORMAT "%8.2" ECU_ADDRESS 0x403302 /end MEASUREMENT
/begin MEASUREMENT ib_parlen "" UBYTE default 1 100 0 255 FORMAT "%5.1" ECU_ADDRESS 0x403349 /end MEASUREMENT
/begin MEASUREMENT ignbuf "" UBYTE default 1 100 0 255 FORMAT "%5.1" ECU_ADDRESS 0x403946 /end MEASUREMENT
/begin MEASUREMENT ignchan "" UBYTE dez 1 100 0 255 FORMAT "%5.1" ECU_ADDRESS 0x403947 /end MEASUREMENT
/begin MEASUREMENT ignFadeStatBits "" UBYTE dez 1 100 0 255 FORMAT "%5.1" ECU_ADDRESS 0x40394E /end MEASUREMENT
/begin MEASUREMENT ignfdostat "zylinderindividuelle Zuendausblendanforderung f¸r Handshakebetrieb" UBYTE dez 1 100 0 255 FORMAT "%5.1" ECU_ADDRESS 0x40394F /end MEASUREMENT
/begin MEASUREMENT ignFdReqStat "" UBYTE dez 1 100 0 255 FORMAT "%5.1" ECU_ADDRESS 0x403950 /end MEASUREMENT
/begin MEASUREMENT ignStpStat "zylinderindividuelle Zuendausblendanforderung (1=stop 0=ein)" UBYTE dez 1 100 0 255 FORMAT "%5.1" ECU_ADDRESS 0x403951 /end MEASUREMENT
/begin MEASUREMENT initErrCtr1 "" UBYTE dez 1 100 0 255 FORMAT "%5.1" ECU_ADDRESS 0x403C27 /end MEASUREMENT
/begin MEASUREMENT initErrCtr2 "" UBYTE dez 1 100 0 255 FORMAT "%5.1" ECU_ADDRESS 0x403C28 /end MEASUREMENT
/begin MEASUREMENT injec_error_abb "" UWORD dez 1 100 0 65535 FORMAT "%8.2" ARRAY_SIZE 8 ECU_ADDRESS 0x40473C /end MEASUREMENT
/begin MEASUREMENT isoc0 "" UWORD i_uw_q0p02_o200 1 100 -200 1110.7 ECU_ADDRESS 0x403304 /end MEASUREMENT
/begin MEASUREMENT itnstart "Batteriestrom w‰hrend des Starts" UWORD i_ub_q0p02 1 100 0 1310.7 FORMAT "%7.2" ECU_ADDRESS 0x403306 /end MEASUREMENT
/begin MEASUREMENT ivorstart "Batteriestrom vorm Start" UWORD i_uw_q0p02_o200 1 100 -200 1110.7 ECU_ADDRESS 0x403308 /end MEASUREMENT
/begin MEASUREMENT ktgen_locBits20ms "" UBYTE dez 1 100 0 255 FORMAT "%5.1" ECU_ADDRESS 0x40394A /end MEASUREMENT
/begin MEASUREMENT ktgen_locBits20ms2 "" UBYTE dez 1 100 0 255 FORMAT "%5.1" ECU_ADDRESS 0x40394B /end MEASUREMENT
/begin MEASUREMENT ktgen_locBits20ms3 "" UBYTE dez 1 100 0 255 FORMAT "%5.1" ECU_ADDRESS 0x40394C /end MEASUREMENT
/begin MEASUREMENT ktib_chk16 "" UWORD dez 1 100 0 65535 FORMAT "%8.2" ECU_ADDRESS 0x40330A /end MEASUREMENT
/begin MEASUREMENT ktupcsctr "" UWORD dez 1 100 0 65535 FORMAT "%8.2" ECU_ADDRESS 0x3FE204 /end MEASUREMENT
/begin MEASUREMENT kt_diclsu1_bits "" UBYTE dez 1 100 0 255 FORMAT "%5.1" ECU_ADDRESS 0x402F5A /end MEASUREMENT
/begin MEASUREMENT kt_diclsu2_bits "" UBYTE dez 1 100 0 255 FORMAT "%5.1" ECU_ADDRESS 0x402F5B /end MEASUREMENT
/begin MEASUREMENT kt_GenStatus "" UBYTE spg_ugen 1 100 10.6 36.1 FORMAT "%5.2" ARRAY_SIZE 2 ECU_ADDRESS 0x402F91 /end MEASUREMENT
/begin MEASUREMENT kt_IbsStatus "" UBYTE dez 1 100 0 255 FORMAT "%5.1" ECU_ADDRESS 0x40334A /end MEASUREMENT
/begin MEASUREMENT kt_zuen_fdOutPattern_u8 "" UBYTE dez 1 100 0 255 FORMAT "%5.1" ECU_ADDRESS 0x403952 /end MEASUREMENT
/begin MEASUREMENT kt_zuen_fdPatArray_u8 "" UBYTE dez 1 100 0 255 FORMAT "%5.1" ARRAY_SIZE 8 ECU_ADDRESS 0x403953 /end MEASUREMENT
/begin MEASUREMENT kt_zuen_fdReq_u16 "" UWORD dez 1 100 0 65535 FORMAT "%8.2" ECU_ADDRESS 0x40474C /end MEASUREMENT
/begin MEASUREMENT kt_zuen_lastzkvek "" UBYTE dez 1 100 0 255 FORMAT "%5.1" ECU_ADDRESS 0x403C2B /end MEASUREMENT
/begin MEASUREMENT kt_zuen_lastzzyl "" UBYTE dez 1 100 0 255 FORMAT "%5.1" ECU_ADDRESS 0x403C2C /end MEASUREMENT
/begin MEASUREMENT kt_zuen_zkvek "" UBYTE dez 1 100 0 255 FORMAT "%5.1" ECU_ADDRESS 0x403C2D /end MEASUREMENT
/begin MEASUREMENT kvarest "KVA-Rest" UWORD fuel_uw_b1 1 100 0 0.999985 FORMAT "%9.7" ECU_ADDRESS 0x40488E /end MEASUREMENT
/begin MEASUREMENT kvaverbr "Verbrauchte Kraftstoffmenge ¸ber CAN; normiert in u-Liter" UWORD fuel_uw_b65535 1 100 0 65535 FORMAT "%8.2" ECU_ADDRESS 0x404890 /end MEASUREMENT
/begin MEASUREMENT kva_korr "Korrekturfaktor f¸r die Kraftstoffmenge" SBYTE rel_uw_q0p001 1 100 -0.128 0.127 FORMAT "%6.4" ECU_ADDRESS 0x3FE95A /end MEASUREMENT
/begin MEASUREMENT LAKHlokBits_10ms "" UBYTE dez 1 100 0 255 FORMAT "%5.1" ECU_ADDRESS 0x403C37 /end MEASUREMENT
/begin MEASUREMENT lambas "Basis-Lambda" UBYTE fak_ub_b2 1 100 0 1.99219 FORMAT "%5.3" ECU_ADDRESS 0x403BDD /end MEASUREMENT
/begin MEASUREMENT lamdiag2_w "Lambdasoll von Dignosefunktionen Bank2" UWORD fak_uw_b16 1 100 0 15.9998 FORMAT "%8.5" ECU_ADDRESS 0x404058 /end MEASUREMENT
/begin MEASUREMENT lamdiag_w "Lambdasoll von Diagnosefunktionen" UWORD fak_uw_b16 1 100 0 15.9998 FORMAT "%8.5" ECU_ADDRESS 0x40405A /end MEASUREMENT
/begin MEASUREMENT lamfa_w "Lambdasoll Fahrerwunsch (word)" UWORD fak_uw_b16 1 100 0 15.9998 FORMAT "%8.5" ECU_ADDRESS 0x402DA2 /end MEASUREMENT
/begin MEASUREMENT lamkh2_w "Lambda-Motor-Soll bei Katheizen, Bank 2 (word)" UWORD fak_q0p000244 1 100 0 15.9998 FORMAT "%8.5" ECU_ADDRESS 0x4040F0 /end MEASUREMENT
/begin MEASUREMENT lamkhe2_w "Lambda-Motor-Soll bei Katheizen, effektiv, Bank 2" UWORD fak_uw_b16 1 100 0 15.9998 FORMAT "%8.5" ECU_ADDRESS 0x40405C /end MEASUREMENT
/begin MEASUREMENT lamkhe_w "Lambda-Motor-Soll bei Katheizen, effektiv" UWORD fak_uw_b16 1 100 0 15.9998 FORMAT "%8.5" ECU_ADDRESS 0x40405E /end MEASUREMENT
/begin MEASUREMENT lamkhg2_w "Lambda-Motor-Soll bei Katheizen (word) gewichtet mit flakh, Bank 2" UWORD fak_q0p000244 1 100 0 15.9998 FORMAT "%8.5" ECU_ADDRESS 0x4040F2 /end MEASUREMENT
/begin MEASUREMENT lamkhg_w "Lambda-Motor-Soll bei Katheizen (word) gewichtet mit flakh" UWORD fak_q0p000244 1 100 0 15.9998 FORMAT "%8.5" ECU_ADDRESS 0x4040F4 /end MEASUREMENT
/begin MEASUREMENT lamkhr2_w "Lambda-Motor-Soll resultierend bei Katheizen, Bank 2 (word)" UWORD fak_q0p000244 1 100 0 15.9998 FORMAT "%8.5" ECU_ADDRESS 0x403006 /end MEASUREMENT
/begin MEASUREMENT lamkhr_w "Lambda-Motor-Soll resultierend bei Katheizen (word)" UWORD fak_q0p000244 1 100 0 15.9998 FORMAT "%8.5" ECU_ADDRESS 0x403008 /end MEASUREMENT
/begin MEASUREMENT lamkh_w "Lambda-Motor-Soll bei Katheizen (word)" UWORD fak_q0p000244 1 100 0 15.9998 FORMAT "%8.5" ECU_ADDRESS 0x4040F6 /end MEASUREMENT
/begin MEASUREMENT lamlgfmn "Lambda Motorlaufgrenze fett" UBYTE fak_ub_b2 1 100 0 1.99219 FORMAT "%5.3" ECU_ADDRESS 0x402DA4 /end MEASUREMENT
/begin MEASUREMENT lamlgm "Laufgrenze ""Lambda mager""" UBYTE fak_ub_b2 1 100 0 1.99219 FORMAT "%5.3" ECU_ADDRESS 0x402DA5 /end MEASUREMENT
/begin MEASUREMENT lams2_w "Lambda-Sollwert, Bank 2" UWORD fak_uw_b16 1 100 0 15.9998 FORMAT "%8.5" ECU_ADDRESS 0x404060 /end MEASUREMENT
/begin MEASUREMENT lamsbg2_w "Lambdasoll Begrenzung (word) Bank2" UWORD fak_uw_b16 1 100 0 15.9998 FORMAT "%8.5" ECU_ADDRESS 0x404062 /end MEASUREMENT
/begin MEASUREMENT lamsbg_w "Lambdasoll Begrenzung (word)" UWORD fak_uw_b16 1 100 0 15.9998 FORMAT "%8.5" ECU_ADDRESS 0x404064 /end MEASUREMENT
/begin MEASUREMENT lamsons2_w "Lambda-Sollwert bezogen auf Einbauort Lambda-Sensor Bank2" UWORD fak_uw_b16 1 100 0 15.9998 FORMAT "%8.5" ECU_ADDRESS 0x404066 /end MEASUREMENT
/begin MEASUREMENT lamsons_w "Lambda-Sollwert bezogen auf Einbauort Lambda-Sensor" UWORD fak_uw_b16 1 100 0 15.9998 FORMAT "%8.5" ECU_ADDRESS 0x404068 /end MEASUREMENT
/begin MEASUREMENT lamsos2_w "Lambda-Sollwert bezogen auf Einbauort Lambda-Sensor Bank2" UWORD fak_uw_b16 1 100 0 15.9998 FORMAT "%8.5" ECU_ADDRESS 0x40406A /end MEASUREMENT
/begin MEASUREMENT lamsos_w "Lambda-Sollwert bezogen auf Einbauort Lambda-Sensor" UWORD fak_uw_b16 1 100 0 15.9998 FORMAT "%8.5" ECU_ADDRESS 0x40406C /end MEASUREMENT
/begin MEASUREMENT lamsubg2_w "Lambdasoll unbegrenzt (word)" UWORD fak_uw_b16 1 100 0 15.9998 FORMAT "%8.5" ECU_ADDRESS 0x40406E /end MEASUREMENT
/begin MEASUREMENT lamsubg_w "Lambdasoll unbegrenzt (word)" UWORD fak_uw_b16 1 100 0 15.9998 FORMAT "%8.5" ECU_ADDRESS 0x404070 /end MEASUREMENT
/begin MEASUREMENT lams_w "Lambda-Sollwert" UWORD fak_uw_b16 1 100 0 15.9998 FORMAT "%8.5" ECU_ADDRESS 0x404072 /end MEASUREMENT
/begin MEASUREMENT lamvoa2_w "Lambdavorsteuerung ohne additive Anteile" UWORD fak_uw_b16 1 100 0 15.9998 FORMAT "%8.5" ECU_ADDRESS 0x404074 /end MEASUREMENT
/begin MEASUREMENT lamvoa_w "Lambdavorsteuerung ohne additive Anteile" UWORD fak_uw_b16 1 100 0 15.9998 FORMAT "%8.5" ECU_ADDRESS 0x404076 /end MEASUREMENT
/begin MEASUREMENT lanskh_w "Lambda-Motor-Soll im Nachstart bei Katheizen" UWORD fak_q0p000244 1 100 0 15.9998 FORMAT "%8.5" ECU_ADDRESS 0x40300A /end MEASUREMENT
/begin MEASUREMENT lasdslg2_w "Lambda-Abgas-Soll f¸r Sekund‰rluftdiagnose Bank 2 gewichtet mit flamsl2" UWORD fak_q0p000244 1 100 0 15.9998 FORMAT "%8.5" ECU_ADDRESS 0x40300C /end MEASUREMENT
/begin MEASUREMENT lasdslg_w "Lambda-Abgas-Soll f¸r Sekund‰rluftdiagnose gewichtet mit flamsl" UWORD fak_q0p000244 1 100 0 15.9998 FORMAT "%8.5" ECU_ADDRESS 0x40300E /end MEASUREMENT
/begin MEASUREMENT lasdsl_w "Lambda-Abgas-Soll f¸r Sekund‰rluftdiagnose" UWORD fak_q0p000244 1 100 0 15.9998 FORMAT "%8.5" ECU_ADDRESS 0x403010 /end MEASUREMENT
/begin MEASUREMENT laskh_w "Lambda-Abgas-Soll bei Katheizen (word)" UWORD fak_q0p000244 1 100 0 15.9998 FORMAT "%8.5" ECU_ADDRESS 0x403012 /end MEASUREMENT
/begin MEASUREMENT lasoabv "Lambdasollwert bei ausgeblendetem(n) EV" UBYTE fak_ub_b2 1 100 0 1.99219 FORMAT "%5.3" ECU_ADDRESS 0x402DA6 /end MEASUREMENT
/begin MEASUREMENT limax_w "LLR-Integrator-Maximalwert" SWORD rel_sw_b100 1 100 -100 99.9969 FORMAT "%8.4" ECU_ADDRESS 0x404122 /end MEASUREMENT
/begin MEASUREMENT limin_w "LLR-Integrator-Minimalwert" SWORD rel_sw_b100 1 100 -100 99.9969 FORMAT "%8.4" ECU_ADDRESS 0x404124 /end MEASUREMENT
/begin MEASUREMENT limnst "LLR-Integrator-Minimalwert w‰hrend Nachstart" UBYTE rel_ub_b24p9 1 100 0 24.9 FORMAT "%5.2" ECU_ADDRESS 0x403CAB /end MEASUREMENT
/begin MEASUREMENT llsstat "Funktionsstatus LLRNS bei Anforderung Systemcheck" UBYTE dez 1 100 0 255 FORMAT "%5.1" ECU_ADDRESS 0x4030AB /end MEASUREMENT
/begin MEASUREMENT lmskh_w "Lambda-Motor-Soll bei katheizen (word)" UWORD fak_q0p000244 1 100 0 15.9998 FORMAT "%8.5" ECU_ADDRESS 0x403014 /end MEASUREMENT
/begin MEASUREMENT lmssl2_w "Lambda-Motor-Soll wegen Sekund‰rluft bei Kathezen, Bank 2" UWORD fak_q0p000244 1 100 0 15.9998 FORMAT "%8.5" ECU_ADDRESS 0x403016 /end MEASUREMENT
/begin MEASUREMENT lmssl_w "Lambda-Motor-Soll wegen Sekund‰rluft bei Katheizen (word)" UWORD fak_q0p000244 1 100 0 15.9998 FORMAT "%8.5" ECU_ADDRESS 0x403018 /end MEASUREMENT
/begin MEASUREMENT loadresp "gerechnete Loadresponse" UBYTE t100msxs_ub_b25p5 1 100 0 25.5 FORMAT "%5.2" ECU_ADDRESS 0x4039A8 /end MEASUREMENT
/begin MEASUREMENT lrfgen "Zwischenspeicher f¸r Load-Response-Zeit,wenn DATA1=0" UBYTE tlr_q3 1 100 0 765 FORMAT "%5.1" ARRAY_SIZE 2 ECU_ADDRESS 0x402F93 /end MEASUREMENT
/begin MEASUREMENT lrfgen1 "" UBYTE tlr_q3 1 100 0 765 FORMAT "%5.1" ARRAY_SIZE 2 ECU_ADDRESS 0x402F95 /end MEASUREMENT
/begin MEASUREMENT lufgen "" UBYTE spg_ugen 1 100 10.6 36.1 FORMAT "%5.2" ARRAY_SIZE 2 ECU_ADDRESS 0x402F97 /end MEASUREMENT
/begin MEASUREMENT nllmku "" UBYTE nmot_ub_q10 1 100 0 2550 FORMAT "%5.0" ECU_ADDRESS 0x403C9F /end MEASUREMENT
/begin MEASUREMENT nnstart "Motordrehzahl nach Motorstart" UWORD nmot_uw_q0p25 1 100 0 16383.8 FORMAT "%8.2" ECU_ADDRESS 0x4047A6 /end MEASUREMENT
/begin MEASUREMENT nsfsm "LLR: Motortemperaturabh‰ngige Solldrehzahl im LL bei S_fs=1" UBYTE nmot_ub_q10 1 100 0 2550 FORMAT "%5.0" ECU_ADDRESS 0x4030AC /end MEASUREMENT
/begin MEASUREMENT nsfsmn "LLR: Minimale Solldrehzahl bei eingelegter Fahrstufe" UBYTE nmot_ub_q10 1 100 0 2550 FORMAT "%5.0" ECU_ADDRESS 0x403CA0 /end MEASUREMENT
/begin MEASUREMENT nslb "Nsoll Korrektur von Ladebilanz Batterie" UBYTE nmot_ub_q10 1 100 0 2550 FORMAT "%5.0" ECU_ADDRESS 0x4039A7 /end MEASUREMENT
/begin MEASUREMENT nslbz "Solldrehtahl abh‰ngig von lbz" UBYTE nmot_ub_q10 1 100 0 2550 FORMAT "%5.0" ECU_ADDRESS 0x4030AD /end MEASUREMENT
/begin MEASUREMENT nsllm "LLR: Motortemperaturabh‰ngige Solldrehzahl im LL" UBYTE nmot_ub_q10 1 100 0 2550 FORMAT "%5.0" ECU_ADDRESS 0x4030AE /end MEASUREMENT
/begin MEASUREMENT nsllmn "LLR: Minimale Solldrehzahl im LL" UBYTE nmot_ub_q10 1 100 0 2550 FORMAT "%5.0" ECU_ADDRESS 0x403CA1 /end MEASUREMENT
/begin MEASUREMENT nsnf "LLR: Nachgef¸hrte Solldrehzahl" UBYTE nmot_ub_q10 1 100 0 2550 FORMAT "%5.0" ECU_ADDRESS 0x403CA2 /end MEASUREMENT
/begin MEASUREMENT nsol "Leerlaufsolldrehzahl" UBYTE nmot_ub_q10 1 100 0 2550 FORMAT "%5.0" ECU_ADDRESS 0x403CA3 /end MEASUREMENT
/begin MEASUREMENT nsol_w "Leerlaufsolldrehzahl" UWORD nmot_uw_q0p25 1 100 0 16383.8 FORMAT "%8.2" ECU_ADDRESS 0x404108 /end MEASUREMENT
/begin MEASUREMENT nsst "Initialisierungswert der Solldrehzahl im Start" UBYTE nmot_ub_q10 1 100 0 2550 FORMAT "%5.0" ECU_ADDRESS 0x403CA4 /end MEASUREMENT
/begin MEASUREMENT nsta "Leerlaufsolldrehzahl bei hoher Ansauglufttemperatur" UBYTE nmot_ub_q10 1 100 0 2550 FORMAT "%5.0" ECU_ADDRESS 0x403CA5 /end MEASUREMENT
/begin MEASUREMENT nstat "Solldrehzahl station‰r" UBYTE nmot_ub_q10 1 100 0 2550 FORMAT "%5.0" ECU_ADDRESS 0x403CA6 /end MEASUREMENT
/begin MEASUREMENT nwpos_nkor "Ausg. Vanos NW_POS Drehzahlkorrektur" SBYTE sprzi_q0p1 1 100 -12.8 12.7 FORMAT "%5.2" ECU_ADDRESS 0x403948 /end MEASUREMENT
/begin MEASUREMENT nwpos_tkor "Ausg. Vanos NW_POS Motortemperaturkorrektur" SBYTE sprzi_q0p1 1 100 -12.8 12.7 FORMAT "%5.2" ECU_ADDRESS 0x403949 /end MEASUREMENT
/begin MEASUREMENT n_idlibs "Leerlaufdrehzahlvorgabe von LC-Powermanagement" UBYTE DEZ 1 100 0 255 FORMAT "%5.1" ECU_ADDRESS 0x403399 /end MEASUREMENT
/begin MEASUREMENT oznivr "Sensorrohwert ÷lniveau" UWORD default 1 100 0 65535 FORMAT "%8.2" ECU_ADDRESS 0x402FA6 /end MEASUREMENT
/begin MEASUREMENT ozpermr_w "Sensorrohwert Permittivit‰t" UWORD default 1 100 0 65535 FORMAT "%8.2" ECU_ADDRESS 0x402FA8 /end MEASUREMENT
/begin MEASUREMENT ozstatus "Status ÷lzustandssensor" UWORD default 1 100 0 65535 FORMAT "%8.2" ECU_ADDRESS 0x402FAA /end MEASUREMENT
/begin MEASUREMENT oztempr "Sensorrohwert ÷ltemperatur" UWORD default 1 100 0 65535 FORMAT "%8.2" ECU_ADDRESS 0x402FAC /end MEASUREMENT
/begin MEASUREMENT oz_count "Flag f¸r die Berechnung der Permitivit‰t" UWORD default 1 100 0 65535 FORMAT "%8.2" ECU_ADDRESS 0x402FAE /end MEASUREMENT
/begin MEASUREMENT oz_permh_r "empfangene Permitivit‰t high byte" UWORD default 1 100 0 65535 FORMAT "%8.2" ECU_ADDRESS 0x402FB0 /end MEASUREMENT
/begin MEASUREMENT oz_perml_r "empfangene Permitivit‰t low byte" UWORD default 1 100 0 65535 FORMAT "%8.2" ECU_ADDRESS 0x402FB2 /end MEASUREMENT
/begin MEASUREMENT qelad "" UWORD qlad_uw_q0p0182 1 100 0 1193.03 FORMAT "%6.1" ECU_ADDRESS 0x40330C /end MEASUREMENT
/begin MEASUREMENT qeladsoc0 "" UWORD qlad_uw_q0p0182 1 100 0 1193.03 FORMAT "%6.1" ECU_ADDRESS 0x40330E /end MEASUREMENT
/begin MEASUREMENT qlad "" UWORD qlad_uw_q0p0182 1 100 0 1193.03 FORMAT "%6.1" ECU_ADDRESS 0x403310 /end MEASUREMENT
/begin MEASUREMENT qladsoc0 "" UWORD qlad_uw_q0p0182 1 100 0 1193.03 FORMAT "%6.1" ECU_ADDRESS 0x403312 /end MEASUREMENT
/begin MEASUREMENT r5cyctim "" UBYTE dez 1 100 0 255 FORMAT "%5.1" ECU_ADDRESS 0x40334B /end MEASUREMENT
/begin MEASUREMENT resdiff "BMW" SLONG rel_ub_b24p9 1 100 -2.09695e+008 2.09695e+008 FORMAT "%13.3" ECU_ADDRESS 0x404AE0 /end MEASUREMENT
/begin MEASUREMENT snibs "Seriennummer Intelligenter Batteriesensor" ULONG dez 1 100 0 4.29497e+009 FORMAT "%13.2" ECU_ADDRESS 0x40332C /end MEASUREMENT
/begin MEASUREMENT spiErrCtr1 "" UBYTE dez 1 100 0 255 FORMAT "%5.1" ECU_ADDRESS 0x403C29 /end MEASUREMENT
/begin MEASUREMENT spiErrCtr2 "" UBYTE dez 1 100 0 255 FORMAT "%5.1" ECU_ADDRESS 0x403C2A /end MEASUREMENT
/begin MEASUREMENT st_ldstgen "Lastzustand Generator elektrisch/thermisch" UBYTE dez 1 100 0 255 FORMAT "%5.1" ECU_ADDRESS 0x4039A6 /end MEASUREMENT
/begin MEASUREMENT svvtansch "Status mechanischer VVT Anschlag" UBYTE dez 1 100 0 255 FORMAT "%5.1" ECU_ADDRESS 0x403962 /end MEASUREMENT
/begin MEASUREMENT svvtansch2 "Status mechanischer VVT Anschlag Bank 2" UBYTE dez 1 100 0 255 FORMAT "%5.1" ECU_ADDRESS 0x403963 /end MEASUREMENT
/begin MEASUREMENT S_rdgentp "Schalter APK zum Auslesen Hersteller und Generatortyp" UBYTE B_TRUE 1 100 0 1 BIT_MASK 0x1 FORMAT "%13.11" ECU_ADDRESS 0x402F7C /end MEASUREMENT
/begin MEASUREMENT S_rdgentp2 "" UBYTE B_TRUE 1 100 0 1 BIT_MASK 0x1 FORMAT "%13.11" ECU_ADDRESS 0x402F7D /end MEASUREMENT
/begin MEASUREMENT t1histiruh "" UWORD dez 1 100 0 65535 FORMAT "%8.2" ECU_ADDRESS 0x403314 /end MEASUREMENT
/begin MEASUREMENT t2histiruh "" UWORD dez 1 100 0 65535 FORMAT "%8.2" ECU_ADDRESS 0x403316 /end MEASUREMENT
/begin MEASUREMENT t3histiruh "" UWORD dez 1 100 0 65535 FORMAT "%8.2" ECU_ADDRESS 0x403318 /end MEASUREMENT
/begin MEASUREMENT t4histiruh "" UWORD dez 1 100 0 65535 FORMAT "%8.2" ECU_ADDRESS 0x40331A /end MEASUREMENT
/begin MEASUREMENT tabst_fl "Abstellzeit in float" FLOAT32_IEEE fak_r32_1 1 100 -10000 10000 FORMAT "%27.21" ECU_ADDRESS 0x402468 /end MEASUREMENT
/begin MEASUREMENT tansf "Ansaugluft in float" FLOAT32_IEEE fak_r32_1 1 100 -10000 10000 FORMAT "%27.21" ECU_ADDRESS 0x40246C /end MEASUREMENT
/begin MEASUREMENT ta_w "Einschaltzeit bis zum Erreichen der 2A-Prim‰rstromschwelle" UWORD txms_uw_q0p001 1 100 0 65.535 FORMAT "%8.5" ARRAY_SIZE 8 ECU_ADDRESS 0x4046FA /end MEASUREMENT
/begin MEASUREMENT tbatinmanf "Initwert Batterietmperatur Hand temp." FLOAT32_IEEE fak_r32_1 1 100 -10000 10000 FORMAT "%27.21" ECU_ADDRESS 0x402470 /end MEASUREMENT
/begin MEASUREMENT tbatstiniv "Starttemperatur Batterie vorne" FLOAT32_IEEE fak_r32_1 1 100 -300 10000 FORMAT "%27.21" ECU_ADDRESS 0x402474 /end MEASUREMENT
/begin MEASUREMENT tbatt "Batterietemperatur" UBYTE temp_ub_q0p75_o48 1 100 -48 143.25 FORMAT "%5.1" ECU_ADDRESS 0x40334C /end MEASUREMENT
/begin MEASUREMENT tbattsoc0 "" UBYTE temp_ub_q0p75_o48 1 100 -48 143.25 FORMAT "%5.1" ECU_ADDRESS 0x40334D /end MEASUREMENT
/begin MEASUREMENT tbatt_lb "Batterietemperatur LB" UBYTE temp_ub_q0p75_o48 1 100 -48 143.25 FORMAT "%5.1" ECU_ADDRESS 0x403388 /end MEASUREMENT
/begin MEASUREMENT tbatt_max "maximale Batterietemperatur" UBYTE temp_ub_q0p75_o48 1 100 -48 143.25 FORMAT "%5.1" ECU_ADDRESS 0x40334E /end MEASUREMENT
/begin MEASUREMENT tbatt_maxi "" UBYTE dez 1 100 0 255 FORMAT "%5.1" ECU_ADDRESS 0x40334F /end MEASUREMENT
/begin MEASUREMENT tbatt_min "minimale Batterietemperatur" UBYTE temp_ub_q0p75_o48 1 100 -48 143.25 FORMAT "%5.1" ECU_ADDRESS 0x403350 /end MEASUREMENT
/begin MEASUREMENT tbatt_mini "" UBYTE dez 1 100 0 255 FORMAT "%5.1" ECU_ADDRESS 0x403351 /end MEASUREMENT
/begin MEASUREMENT tbatt_tmp "" UBYTE dez 1 100 0 255 FORMAT "%5.1" ECU_ADDRESS 0x403352 /end MEASUREMENT
/begin MEASUREMENT tc_w "Zeit f¸r l‰ngsten Spannungsimpulse" UWORD txms_uw_q0p001 1 100 0 65.535 FORMAT "%8.5" ARRAY_SIZE 8 ECU_ADDRESS 0x40470A /end MEASUREMENT
/begin MEASUREMENT tdffgen "" UWORD t200msxs_uw_q0p2 1 100 0 13107 FORMAT "%8.2" ECU_ADDRESS 0x40410A /end MEASUREMENT
/begin MEASUREMENT tdffngen_w "" UWORD t200msxs_uw_q0p2 1 100 0 13107 FORMAT "%8.2" ECU_ADDRESS 0x40410C /end MEASUREMENT
/begin MEASUREMENT td_f_ierr "Filterzeit Erregerstrom aus Timingkoordinator" UBYTE t10msxs_ub_b2p55 1 100 0 2.55 FORMAT "%5.3" ECU_ADDRESS 0x402F99 /end MEASUREMENT
/begin MEASUREMENT td_f_ierr2 "" UBYTE t10msxs_ub_b2p55 1 100 0 2.55 FORMAT "%5.3" ECU_ADDRESS 0x402F9A /end MEASUREMENT
/begin MEASUREMENT td_rdgen2reg2 "" UBYTE t10msxs_ub_b2p55 1 100 0 2.55 FORMAT "%5.3" ECU_ADDRESS 0x402F9B /end MEASUREMENT
/begin MEASUREMENT tesum_l "Summe effektive Einspritzzeit long word" ULONG t_q0p001_ms 1 100 0 4.29497e+006 FORMAT "%13.5" ECU_ADDRESS 0x404ACC /end MEASUREMENT
/begin MEASUREMENT te_ges "" UWORD t3p2usxms_uw_b209p7 1 100 0 209.748 FORMAT "%8.4" ECU_ADDRESS 0x404892 /end MEASUREMENT
/begin MEASUREMENT tlrfgen "vom Generator empfangene Load response Zeit (Kopie gesendeter Wert)" UBYTE t100msxs_ub_b25p5 1 100 0 25.5 FORMAT "%5.2" ECU_ADDRESS 0x402F9C /end MEASUREMENT
/begin MEASUREMENT tlrfgen2 "vom Generator 2 empfangene Load response Zeit (Kopie gesendeter Wert)" UBYTE t100msxs_ub_b25p5 1 100 0 25.5 FORMAT "%5.2" ECU_ADDRESS 0x402F9D /end MEASUREMENT
/begin MEASUREMENT tlrgen "physikal. Eingangswert (sec.) f¸r Load response Zeit" UBYTE t100msxs_ub_b25p5 1 100 0 25.5 FORMAT "%5.2" ECU_ADDRESS 0x4039A9 /end MEASUREMENT
/begin MEASUREMENT tlrgen2 "Sollwert Load- Response- Zeit Generator2" UBYTE t100msxs_ub_b25p5 1 100 0 25.5 FORMAT "%5.2" ECU_ADDRESS 0x403396 /end MEASUREMENT
/begin MEASUREMENT ts_w "Tats‰chliche Schlieﬂzeit" UWORD txms_uw_q0p001 1 100 0 65.535 FORMAT "%8.5" ARRAY_SIZE 8 ECU_ADDRESS 0x40471A /end MEASUREMENT
/begin MEASUREMENT tumgbatold "vorherige Batterieumgebungstemperatur" FLOAT32_IEEE fak_r32_1 1 100 -10000 10000 FORMAT "%27.21" ECU_ADDRESS 0x402478 /end MEASUREMENT
/begin MEASUREMENT tumgbattab "Abstell-Umgebungstemperatur Batterie" FLOAT32_IEEE fak_r32_1 1 100 -300 10000 FORMAT "%27.21" ECU_ADDRESS 0x3FE210 /end MEASUREMENT
/begin MEASUREMENT tumgcanf "aktuelle Aussentemperatur float" FLOAT32_IEEE fak_r32_1 1 100 -300 100000 FORMAT "%27.20" ECU_ADDRESS 0x40247C /end MEASUREMENT
/begin MEASUREMENT tumgtemp "Umgebungstemperatur Ersatz" SBYTE temp_q1 1 100 -128 127 FORMAT "%5.1" ECU_ADDRESS 0x403389 /end MEASUREMENT
/begin MEASUREMENT tumg_ers "Aussentemperatur oder Ersatzwert" SBYTE temp_q1 1 100 -128 127 FORMAT "%5.1" ECU_ADDRESS 0x40338A /end MEASUREMENT
/begin MEASUREMENT tvdfrfgen "Zwischenspeicher f¸r DF-Signal (Gen.-Last), wenn DATA1=2" UBYTE rel_ub_b31 1 100 0 822.581 FORMAT "%5.1" ECU_ADDRESS 0x402F9E /end MEASUREMENT
/begin MEASUREMENT tvdfrfgen2 "Zwischenspeicher f¸r DF-Signal (Gen.-Last), wenn DATA1=2 (Generator 2)" UBYTE rel_ub_b31 1 100 0 822.581 FORMAT "%5.1" ECU_ADDRESS 0x402F9F /end MEASUREMENT
/begin MEASUREMENT t_battabst "Batterieabstelltemperatur" FLOAT32_IEEE fak_r32_1 1 100 -300 10000 FORMAT "%27.21" ECU_ADDRESS 0x3FE214 /end MEASUREMENT
/begin MEASUREMENT t_batt_ini "Startwert Batterietemperatur" FLOAT32_IEEE fak_r32_1 1 100 -300 10000 FORMAT "%27.21" ECU_ADDRESS 0x402480 /end MEASUREMENT
/begin MEASUREMENT t_umgabst "Abstell-Aussentemperatur" SBYTE temp_q1 1 100 -128 127 FORMAT "%5.1" ECU_ADDRESS 0x3FE20C /end MEASUREMENT
/begin MEASUREMENT t_umgabstf "letzte Aussentemperatur" FLOAT32_IEEE fak_r32_1 1 100 -10000 10000 FORMAT "%27.21" ECU_ADDRESS 0x402484 /end MEASUREMENT
/begin MEASUREMENT u1soc0 "" UWORD spg_uw_q0p25em3_o6 1 100 6 22.3837 FORMAT "%9.6" ECU_ADDRESS 0x40331C /end MEASUREMENT
/begin MEASUREMENT u2soc0 "" UWORD spg_uw_q0p25em3_o6 1 100 6 22.3837 FORMAT "%9.6" ECU_ADDRESS 0x40331E /end MEASUREMENT
/begin MEASUREMENT u3soc0 "" UWORD spg_uw_q0p25em3_o6 1 100 6 22.3837 FORMAT "%9.6" ECU_ADDRESS 0x403320 /end MEASUREMENT
/begin MEASUREMENT ubattar_w "" UWORD spg_uw_q0p25em3_o6 1 100 6 22.3837 FORMAT "%9.6" ECU_ADDRESS 0x403322 /end MEASUREMENT
/begin MEASUREMENT ubatt_w "aktuelle Batteriespannung" UWORD spg_uw_q0p25em3_o6 1 100 6 22.3837 FORMAT "%9.6" ECU_ADDRESS 0x403324 /end MEASUREMENT
/begin MEASUREMENT ubwschz "" UBYTE dez 1 100 0 255 FORMAT "%5.1" ECU_ADDRESS 0x403CA7 /end MEASUREMENT
/begin MEASUREMENT ubwtime_w "" UWORD t10msxs_uw_b655p35 1 100 0 655.35 FORMAT "%8.4" ECU_ADDRESS 0x40410E /end MEASUREMENT
/begin MEASUREMENT ufgen "vom Generator empfangene Generatorsollspannung (Kopie gesendeter Wert)" UBYTE spg_ugen 1 100 10.6 36.1 FORMAT "%5.2" ECU_ADDRESS 0x402FA0 /end MEASUREMENT
/begin MEASUREMENT ufgen2 "vom Generator 2 empfangene Generatorsollspannung (Kopie gesendeter Wert)" UBYTE spg_ugen 1 100 10.6 36.1 FORMAT "%5.2" ECU_ADDRESS 0x402FA1 /end MEASUREMENT
/begin MEASUREMENT ulcount "" UBYTE dez 1 100 0 255 FORMAT "%5.1" ECU_ADDRESS 0x403CA8 /end MEASUREMENT
/begin MEASUREMENT unind "" UBYTE default 1 100 0 255 FORMAT "%5.1" ECU_ADDRESS 0x403353 /end MEASUREMENT
/begin MEASUREMENT uregnom "Nominalspannung Regler Generator 1" UBYTE spg_ugen 1 100 10.6 36.1 FORMAT "%5.2" ECU_ADDRESS 0x402FA2 /end MEASUREMENT
/begin MEASUREMENT uregnom2 "Nominalspannung Regler Generator 2" UBYTE spg_ugen 1 100 10.6 36.1 FORMAT "%5.2" ECU_ADDRESS 0x402FA3 /end MEASUREMENT
/begin MEASUREMENT uscount "" UBYTE dez 1 100 0 255 FORMAT "%5.1" ECU_ADDRESS 0x403CA9 /end MEASUREMENT
/begin MEASUREMENT utnstart "Batteriespannung w‰hrend des Starts" UWORD spg_uw_q0p25em3_o6 1 100 6 22.3837 FORMAT "%9.6" ECU_ADDRESS 0x403326 /end MEASUREMENT
/begin MEASUREMENT uvorstart "Batteriespannung vor dem Start" UWORD spg_uw_q0p25em3_o6 1 100 6 22.3837 FORMAT "%9.6" ECU_ADDRESS 0x403328 /end MEASUREMENT
/begin MEASUREMENT vfzgf "gefilterte Fahrzeuggeschwindigkeit" FLOAT32_IEEE fak_r32_1 1 100 0 65535 FORMAT "%27.21" ECU_ADDRESS 0x40338C /end MEASUREMENT
/begin MEASUREMENT vvt1err_ctr "" UBYTE dez 1 100 0 255 FORMAT "%5.1" ECU_ADDRESS 0x403964 /end MEASUREMENT
/begin MEASUREMENT vvt2err_ctr "" UBYTE dez 1 100 0 255 FORMAT "%5.1" ECU_ADDRESS 0x403965 /end MEASUREMENT
/begin MEASUREMENT vvt_alern "Fehlerart Anschlaglernen Bank1" UBYTE dez 1 100 0 255 FORMAT "%5.1" ECU_ADDRESS 0x402FCE /end MEASUREMENT
/begin MEASUREMENT vvt_alern2 "Fehlerart Anschlaglernen Bank2" UBYTE dez 1 100 0 255 FORMAT "%5.1" ECU_ADDRESS 0x402FCF /end MEASUREMENT
/begin MEASUREMENT vvt_ansio "Status gelernte Anschl‰ge Bank1" UBYTE dez 1 100 0 255 FORMAT "%5.1" ECU_ADDRESS 0x403966 /end MEASUREMENT
/begin MEASUREMENT vvt_ansio2 "Status gelernte Anschl‰ge Bank2" UBYTE dez 1 100 0 255 FORMAT "%5.1" ECU_ADDRESS 0x403967 /end MEASUREMENT
/begin MEASUREMENT vvt_can "Fehlerart VVT-CAN-Kommunikation Bank1" UBYTE dez 1 100 0 255 FORMAT "%5.1" ECU_ADDRESS 0x402FD0 /end MEASUREMENT
/begin MEASUREMENT vvt_can2 "Fehlerart VVT-CAN-Kommunikation Bank2" UBYTE dez 1 100 0 255 FORMAT "%5.1" ECU_ADDRESS 0x402FD1 /end MEASUREMENT
/begin MEASUREMENT vvt_enab "Status des empfangenen Enable Signals Bank1" UBYTE dez 1 100 0 255 FORMAT "%5.1" ECU_ADDRESS 0x403968 /end MEASUREMENT
/begin MEASUREMENT vvt_enab2 "Status des empfangenen Enable Signals Bank2" UBYTE dez 1 100 0 255 FORMAT "%5.1" ECU_ADDRESS 0x403969 /end MEASUREMENT
/begin MEASUREMENT vvt_endst "Fehlerart VVT-Endstufe Bank1" UBYTE dez 1 100 0 255 FORMAT "%5.1" ECU_ADDRESS 0x402FD2 /end MEASUREMENT
/begin MEASUREMENT vvt_endst2 "Fehlerart VVT-Endstufe Bank2" UBYTE dez 1 100 0 255 FORMAT "%5.1" ECU_ADDRESS 0x402FD3 /end MEASUREMENT
/begin MEASUREMENT vvt_errst "Fehlerstatus VVT SG" UBYTE dez 1 100 0 255 FORMAT "%5.1" ECU_ADDRESS 0x40396A /end MEASUREMENT
/begin MEASUREMENT vvt_errst2 "Fehlerstatus VVT SG Bank 2" UBYTE dez 1 100 0 255 FORMAT "%5.1" ECU_ADDRESS 0x40396B /end MEASUREMENT
/begin MEASUREMENT vvt_es "Strombedarf des VVT-System Bank1" UBYTE i_vvt_ub_q0p50_om63p50 1 100 -63.5 64 FORMAT "%5.2" ECU_ADDRESS 0x40396C /end MEASUREMENT
/begin MEASUREMENT vvt_es2 "Strombedarf des VVT-System Bank2" UBYTE i_vvt_ub_q0p50_om63p50 1 100 -63.5 64 FORMAT "%5.2" ECU_ADDRESS 0x40396D /end MEASUREMENT
/begin MEASUREMENT vvt_ffs "Fehlerart F¸hrungssensor Bank1" UBYTE dez 1 100 0 255 FORMAT "%5.1" ECU_ADDRESS 0x402FD4 /end MEASUREMENT
/begin MEASUREMENT vvt_ffs2 "Fehlerart F¸hrungssensor Bank2" UBYTE dez 1 100 0 255 FORMAT "%5.1" ECU_ADDRESS 0x402FD5 /end MEASUREMENT
/begin MEASUREMENT vvt_frs "Fehlerart Referenzsensor Bank1" UBYTE dez 1 100 0 255 FORMAT "%5.1" ECU_ADDRESS 0x402FD6 /end MEASUREMENT
/begin MEASUREMENT vvt_frs2 "Fehlerart Referenzsensor Bank2" UBYTE dez 1 100 0 255 FORMAT "%5.1" ECU_ADDRESS 0x402FD7 /end MEASUREMENT
/begin MEASUREMENT vvt_iw "VVT-Istwert in % bzgl. Verstellbereich Bank1" UWORD rel_b99p9985 1 100 0 99.9985 FORMAT "%8.5" ECU_ADDRESS 0x40475E /end MEASUREMENT
/begin MEASUREMENT vvt_iw2 "VVT-Istwert in % bzgl. Verstellbereich Bank2" UWORD rel_b99p9985 1 100 0 99.9985 FORMAT "%8.5" ECU_ADDRESS 0x404760 /end MEASUREMENT
/begin MEASUREMENT vvt_luft "Status Anforderung L¸fter E-Box VVT1" UBYTE dez 1 100 0 255 FORMAT "%5.1" ECU_ADDRESS 0x402FD8 /end MEASUREMENT
/begin MEASUREMENT vvt_luft2 "Status Anforderung L¸fter E-Box VVT2" UBYTE dez 1 100 0 255 FORMAT "%5.1" ECU_ADDRESS 0x402FD9 /end MEASUREMENT
/begin MEASUREMENT vvt_mux "Multiplexer f¸r Botschaft VVT1" UBYTE dez 1 100 0 255 FORMAT "%5.1" ECU_ADDRESS 0x402FDA /end MEASUREMENT
/begin MEASUREMENT vvt_mux2 "Multiplexer f¸r Botschaft VVT2" UBYTE dez 1 100 0 255 FORMAT "%5.1" ECU_ADDRESS 0x402FDB /end MEASUREMENT
/begin MEASUREMENT vvt_ntanf "Anforderung des VVT-System fuer Notfahren Bank1" UBYTE dez 1 100 0 255 FORMAT "%5.1" ECU_ADDRESS 0x40396E /end MEASUREMENT
/begin MEASUREMENT vvt_ntanf2 "Anforderung des VVT-System fuer Notfahren Bank2" UBYTE dez 1 100 0 255 FORMAT "%5.1" ECU_ADDRESS 0x40396F /end MEASUREMENT
/begin MEASUREMENT vvt_ovrld "Status Fehler ‹berlast VVT1" UBYTE dez 1 100 0 255 FORMAT "%5.1" ECU_ADDRESS 0x402FDC /end MEASUREMENT
/begin MEASUREMENT vvt_ovrld2 "Status Fehler ‹berlast VVT2" UBYTE dez 1 100 0 255 FORMAT "%5.1" ECU_ADDRESS 0x402FDD /end MEASUREMENT
/begin MEASUREMENT vvt_plsen "Fehlerart Sensorplausibilisierung Bank1" UBYTE dez 1 100 0 255 FORMAT "%5.1" ECU_ADDRESS 0x402FDE /end MEASUREMENT
/begin MEASUREMENT vvt_plsen2 "Fehlerart Sensorplausibilisierung Bank2" UBYTE dez 1 100 0 255 FORMAT "%5.1" ECU_ADDRESS 0x402FDF /end MEASUREMENT
/begin MEASUREMENT vvt_ready "VVT-Online Bank1" UBYTE dez 1 100 0 255 FORMAT "%5.1" ECU_ADDRESS 0x403970 /end MEASUREMENT
/begin MEASUREMENT vvt_ready2 "VVT-Online Bank2" UBYTE dez 1 100 0 255 FORMAT "%5.1" ECU_ADDRESS 0x403971 /end MEASUREMENT
/begin MEASUREMENT vvt_sg "Fehlerart VVT-Steuerger‰t Bank1" UBYTE dez 1 100 0 255 FORMAT "%5.1" ECU_ADDRESS 0x402FE0 /end MEASUREMENT
/begin MEASUREMENT vvt_sg2 "Fehlerart VVT-Steuerger‰t Bank2" UBYTE dez 1 100 0 255 FORMAT "%5.1" ECU_ADDRESS 0x402FE1 /end MEASUREMENT
/begin MEASUREMENT vvt_stell "Fehlerart Stellglied¸berwachung Bank1" UBYTE dez 1 100 0 255 FORMAT "%5.1" ECU_ADDRESS 0x402FE2 /end MEASUREMENT
/begin MEASUREMENT vvt_stell2 "Fehlerart Stellglied¸berwachung Bank2" UBYTE dez 1 100 0 255 FORMAT "%5.1" ECU_ADDRESS 0x402FE3 /end MEASUREMENT
/begin MEASUREMENT vvt_sw "VVT-Sollwert in % bzgl Verstellbereich Bank1" UWORD rel_b99p9985 1 100 0 99.9985 FORMAT "%8.5" ECU_ADDRESS 0x404756 /end MEASUREMENT
/begin MEASUREMENT vvt_sw2 "VVT-Sollwert in % bzgl Verstellbereich Bank 2" UWORD rel_b99p9985 1 100 0 99.9985 FORMAT "%8.5" ECU_ADDRESS 0x404758 /end MEASUREMENT
/begin MEASUREMENT vvt_tv "Stellgrˆﬂe Tastverh‰ltnis E-Motor VVT-System Bank1" UBYTE rel_ub_b100 1 100 0 99.6094 FORMAT "%5.2" ECU_ADDRESS 0x403972 /end MEASUREMENT
/begin MEASUREMENT vvt_tv2 "Stellgrˆﬂe Tastverh‰ltnis E-Motor VVT-System Bank2" UBYTE rel_ub_b100 1 100 0 99.6094 FORMAT "%5.2" ECU_ADDRESS 0x403973 /end MEASUREMENT
/begin MEASUREMENT vvt_uleis "Fehlerart VVT-Leistungsversorgung Bank1" UBYTE dez 1 100 0 255 FORMAT "%5.1" ECU_ADDRESS 0x402FE4 /end MEASUREMENT
/begin MEASUREMENT vvt_uleis2 "Fehlerart VVT-Leistungsversorgung Bank2" UBYTE dez 1 100 0 255 FORMAT "%5.1" ECU_ADDRESS 0x402FE5 /end MEASUREMENT
/begin MEASUREMENT vvt_usen "Fehlerart Versorgungsspannung Sensor Bank1" UBYTE dez 1 100 0 255 FORMAT "%5.1" ECU_ADDRESS 0x402FE6 /end MEASUREMENT
/begin MEASUREMENT vvt_usen2 "Fehlerart Versorgungsspannung Sensor Bank2" UBYTE dez 1 100 0 255 FORMAT "%5.1" ECU_ADDRESS 0x402FE7 /end MEASUREMENT
/begin MEASUREMENT zalvdmv1 "Alive-Counter f¸r Botschaft DME_VVT_1" UBYTE dez 1 100 0 255 FORMAT "%5.1" ECU_ADDRESS 0x40395E /end MEASUREMENT
/begin MEASUREMENT zalvdmv2 "Alive-Counter f¸r Botschaft DME_VVT_2" UBYTE dez 1 100 0 255 FORMAT "%5.1" ECU_ADDRESS 0x40395F /end MEASUREMENT
/begin MEASUREMENT zalvvdm1 "Alive-Counter f¸r Botschaft VVT_DME_1" UBYTE dez 1 100 0 255 FORMAT "%5.1" ECU_ADDRESS 0x403974 /end MEASUREMENT
/begin MEASUREMENT zalvvdm2 "Alive-Counter f¸r Botschaft VVT_DME_2" UBYTE dez 1 100 0 255 FORMAT "%5.1" ECU_ADDRESS 0x403975 /end MEASUREMENT
/begin MEASUREMENT zbibs "BMW Teilenummer Intelligenter Batteriesensor" ULONG dez 1 100 0 4.29497e+009 FORMAT "%13.2" ECU_ADDRESS 0x3FE208 /end MEASUREMENT
/begin MEASUREMENT zzylzue "SW-Zylinderz‰hler f¸r Z¸ndungsberechnung" UBYTE dez 1 100 0 255 FORMAT "%5.1" ECU_ADDRESS 0x403C2E /end MEASUREMENT
/begin FUNCTION KT_DICLSU ""
 /begin IN_MEASUREMENT B_diagia B_diagia2 B_enscun B_enscun2 B_fklanf B_fklanf2 B_iclsabg B_iclsabg2 B_nmot B_pusab B_pusab2 B_rinabg B_rinabg2 B_rineza B_rineza2 B_spf3k B_spf3k2 B_stend iprefanf iprefanf2 /end IN_MEASUREMENT
 /begin OUT_MEASUREMENT B_lsuiamn B_lsuiamn2 B_lsuiamx B_lsuiamx2 B_lsuicif B_lsuicif2 B_lsuickf B_lsuickf2 B_lsuube B_lsuube2 B_lsuunmn B_lsuunmn2 B_lsuunmx B_lsuunmx2 B_lsuvmmn B_lsuvmmn2 B_lsuvmmx B_lsuvmmx2 /end OUT_MEASUREMENT
 /begin LOC_MEASUREMENT B_mn_ia B_mn_ia2 B_mn_un B_mn_un2 B_mn_vm B_mn_vm2 B_mx_ia B_mx_ia2 B_mx_un B_mx_un2 B_mx_vm B_mx_vm2 B_ube_lsu B_ube_lsu2 caseVar caseVar2 chipErrCtr1 chipErrCtr2 data2_init2 data2_s data_init2 data_s dlsu1_ia_err dlsu1_un_err dlsu1_vm_err dlsu2_ia_err dlsu2_un_err dlsu2_vm_err Err_get_1 Err_get_2 Err_set_1 Err_set_2 initErrCtr1 initErrCtr2 kt_diclsu1_bits kt_diclsu2_bits spiErrCtr1 spiErrCtr2 /end LOC_MEASUREMENT
/end FUNCTION
/begin FUNCTION kt_dzku "Hardware-Interface f¸r DZKU-Funktion" /begin IN_MEASUREMENT B_dzack B_dzenable /end IN_MEASUREMENT /begin OUT_MEASUREMENT B_dzrts dzkflag ta_w tc_w ts_w /end OUT_MEASUREMENT /begin LOC_MEASUREMENT B_dzbuf B_dzen flags_w ignbuf ignchan /end LOC_MEASUREMENT /end FUNCTION
/begin FUNCTION KT_EAVNS "Komponententreiber EAVanos"
 /begin DEF_CHARACTERISTIC KLNWPOSN KLNWPOST NW0FLANKE NW1FLANKE NW2FLANKE NW3FLANKE NWSEGOFFS /end DEF_CHARACTERISTIC
 /begin IN_MEASUREMENT nmot synstate tmot tnwia2_l tnwia_l tnwie2_l tnwie_l wnwkwa2_w wnwkwa_w wnwkwe2_w wnwkwe_w zrph2_l zrph3_l zrph4_l zrph_l /end IN_MEASUREMENT
 /begin OUT_MEASUREMENT eavzrph2_l eavzrph3_l eavzrph4_l eavzrph_l nwpos_nkor nwpos_tkor /end OUT_MEASUREMENT
/end FUNCTION
/begin FUNCTION KT_GEN "6.10      Komponententreiber f¸r den/die Generator/en an der BSD"
 /begin DEF_CHARACTERISTIC CWGENPROT OUINIGEN QKORRDF QKORRLR S_RDGENTYP S_RD_REG0 S_RD_REG1 TDWRGENREG0 TDWRGENREG2 TGENIDLE UGENTYP UGMN UGMX /end DEF_CHARACTERISTIC
 /begin REF_CHARACTERISTIC CWGEN /end REF_CHARACTERISTIC
 /begin IN_MEASUREMENT B_genoff B_lroff B_lroff2 geli_dflim geli_dflim2 r1msCtr tlrgen tlrgen2 ugen ugen2 /end IN_MEASUREMENT
 /begin OUT_MEASUREMENT bsdgencv bsdgencv2 bsdgenregv bsdgenrgv2 B_bsd1prot2 B_bsd2prot2 B_bsdgenv B_bsdgenv2 B_bsdprot1 B_bsdprot2 B_genacti2 B_genactiv B_genfbsd B_genfbsd2 B_genfel B_genfel2 B_genfht B_genfht2 B_genfme B_genfme2 B_lrfoff B_lrfoff2 B_lrreg1ak B_lrreg1ak2 dffgen dffgen2 geli_fdflim geli_fdflim2 genmanufa2 genmanufak gentypken2 gentypkenn S_rdgentp S_rdgentp2 td_f_ierr td_f_ierr2 td_rdgen2reg2 tlrfgen tlrfgen2 tvdfrfgen tvdfrfgen2 ufgen ufgen2 uregnom uregnom2 /end OUT_MEASUREMENT
 /begin LOC_MEASUREMENT bwrackreg0 bwrackreg1 B_action B_bsdbrake B_dflim B_rdackreg0 B_rdackreg1 B_rdackreg2 B_rdackreg3 B_rdackreg5 B_rdackreg6 B_rdackreg7 B_readreg2 B_readreg3 B_wrablauf1 B_wrablauf2 B_wrablauf3 B_wrackreg2 B_wrackreg3 B_wrierrgrenz B_wrierrgrenzoff B_wrtlrgen B_wrugen chkbfgen count_ablx ktgen_locBits20ms ktgen_locBits20ms2 ktgen_locBits20ms3 kt_GenStatus lrfgen lrfgen1 lufgen /end LOC_MEASUREMENT
/end FUNCTION
/begin FUNCTION KT_IBS "1.70"
 /begin DEF_CHARACTERISTIC DI1000DT DI1000STG DI1000TGRZ DI200DT DI200STG DIHIGHGRZ DILOWGRZ DIPL5 DIPL6 DIPL7 DIPL8 DKL15FIL DTMAXGRZI DUIGRZ DUMINTGRZ DUREFMAX DUREFMINI ENABSDIBS ENISOC0 ENUSOC0 ERREPEAT IBSTSTERR IBSVERSION IBTEMPMAXI IBTEMPMINI IBUNPLADEL ISLEEPGRZ ISTARTTRIG KLIBSTEMP1 S_CLERRIBS T1SCHWELLE T1SOC0 T2SCHWELLE T2SOC0 T3SCHWELLE T3SOC0 TMPCOM_DIV TMPCOM_MUL TNUSTART TNUSTARTFL TPT1TICO TSLEEPRUH T_CLERRIBS T_UTIEFSET UTIEFAPP /end DEF_CHARACTERISTIC
 /begin IN_MEASUREMENT BsdControl BsdData BsdRegAdr B_enwakeup B_ibsactiv B_kl15 B_nmot B_pwf B_tiefrset ibserstat2 ibserstat3 iwakeupgrz q_startfgk tumg ub /end IN_MEASUREMENT
 /begin OUT_MEASUREMENT B_eb_busy B_eb_txok B_eb_write B_fsclr B_ibfbsd B_ibfebsd B_ibspwf B_ibsweck B_ibunplau B_startfgk B_strtaw B_tiefset chk16_ibs chkpara ComControl ebsd_adr ebsd_errdir ebsd_errep ebsd_errin ebsd_nbyt ebsd_timo ebsd_varin fsclctr ibattar_w ibatt_w ibhwversi ibsbclctr ibsbclctri ibsborctr ibsdncsctr ibseromctr ibsiicctr ibsiicctri ibslvdctr ibsporctr ibspromctr ibsptyctr ibsramctr ibswbase ibswchang ibswdtctr ibs_errors ibs_msgind ibs_msgrdy ibs_msgsta ibs_msgwri ibs_reg4 ibs_reg5 ibs_start ib_chk16 ib_parlen isoc0 itnstart ivorstart ktib_chk16 ktupcsctr kt_IbsStatus qelad qeladsoc0 qlad qladsoc0 r5cyctim snibs t1histiruh t2histiruh t3histiruh t4histiruh tbatt tbattsoc0 tbatt_max tbatt_maxi tbatt_min tbatt_mini tbatt_tmp u1soc0 u2soc0 u3soc0 ubattar_w ubatt_w unind utnstart uvorstart zbibs /end OUT_MEASUREMENT
/end FUNCTION
/begin FUNCTION KT_INJEC "Komponententreiber Einspritzung ME 9" /begin DEF_CHARACTERISTIC NINJO /end DEF_CHARACTERISTIC /begin REF_CHARACTERISTIC DTEMN /end REF_CHARACTERISTIC
 /begin IN_MEASUREMENT B_eculock B_esbnb B_esbst B_nmin B_stend nmot tez_l tvu_w wea wes wvesp zzyl /end IN_MEASUREMENT
 /begin OUT_MEASUREMENT anzti anzti_w injec_error_abb tesum_l /end OUT_MEASUREMENT
 /begin LOC_MEASUREMENT abbwevz /end LOC_MEASUREMENT
/end FUNCTION
/begin FUNCTION KT_KFT "" /begin DEF_CHARACTERISTIC TKWPERIOD /end DEF_CHARACTERISTIC /begin IN_MEASUREMENT tkwpwm /end IN_MEASUREMENT /end FUNCTION
/begin FUNCTION KT_MANAG "1.10      Priorit‰tensteuerung f¸r Bitserielle Schnittstelle" /begin DEF_CHARACTERISTIC KTMTIMINT /end DEF_CHARACTERISTIC /begin IN_MEASUREMENT r1ms_all_Ctr /end IN_MEASUREMENT /end FUNCTION
/begin FUNCTION KT_MLS "" /begin IN_MEASUREMENT fqml taml /end IN_MEASUREMENT /end FUNCTION
/begin FUNCTION KT_OZ ""
 /begin OUT_MEASUREMENT B_ozfbsd oznivr ozpermr_w ozstatus oztempr oz_count oz_permh_r oz_perml_r /end OUT_MEASUREMENT
/end FUNCTION
/begin FUNCTION KT_PORTSOFF "" /end FUNCTION
/begin FUNCTION KT_TEV "" /begin IN_MEASUREMENT B_bttev B_tevet B_tevtstp tateout tevper /end IN_MEASUREMENT /begin OUT_MEASUREMENT B_tevtini /end OUT_MEASUREMENT /end FUNCTION
/begin FUNCTION KT_ZUEN "3.10      Komponententreiber Z¸ndung Masterfunktion f¸r ME9"
 /begin IN_MEASUREMENT B_ff B_llrein B_nmin ffzanz ffztld_w ffztof_w flgstign_w szout_w zwoutar zzyl /end IN_MEASUREMENT
 /begin OUT_MEASUREMENT ignFadeStatBits ignfdostat ignFdReqStat ignStpStat kt_zuen_fdOutPattern_u8 kt_zuen_fdPatArray_u8 kt_zuen_fdReq_u16 kt_zuen_lastzkvek kt_zuen_lastzzyl kt_zuen_zkvek zzylzue /end OUT_MEASUREMENT
/end FUNCTION
/begin FUNCTION KVA "50.30     Ausgangssignal: Kraftstoff-Verbrauchs-Anzeige" /begin DEF_CHARACTERISTIC FKVAUM /end DEF_CHARACTERISTIC /begin REF_CHARACTERISTIC FRLFSDP KLKRKTE /end REF_CHARACTERISTIC /begin IN_MEASUREMENT B_eemrdy B_eepwf dps_w rkte_w rk_w tesum_l /end IN_MEASUREMENT /begin OUT_MEASUREMENT fkvaum_ee kvarest kvaverbr kva_korr te_ges /end OUT_MEASUREMENT /end FUNCTION
/begin FUNCTION LAKH "4.90      Lambda-Koordination bei Katheizen"
 /begin DEF_CHARACTERISTIC CWLAKH IMLLASKH KFLANSKH KFLASKH KFLMSKHKST KFLMSKHMAG KFLMSKHSLP KLLAKHFH LASDSLA LASTMOT LMSTMOT TFWLMKHKST TMSTLMS ZFLASKH /end DEF_CHARACTERISTIC
 /begin IN_MEASUREMENT anztib_w B_dsla B_fasla B_fs B_kh B_nstabk B_sls fho_w flakh flamsl2_w flamsl_w flmssl fmsldyn fslpdyn imlpr ml_w nmot_w rl_w tmot tmst /end IN_MEASUREMENT
 /begin OUT_MEASUREMENT B_lamkhe lamkh2_w lamkh_w /end OUT_MEASUREMENT
 /begin LOC_MEASUREMENT B_dslafa flaskh flmsslkh fslsdyn fwlmkhkst LAKHlokBits_10ms lamkhg2_w lamkhg_w lamkhr2_w lamkhr_w lanskh_w lasdslg2_w lasdslg_w lasdsl_w laskh_w lmskh_w lmssl2_w lmssl_w /end LOC_MEASUREMENT
/end FUNCTION
/begin FUNCTION LAMFAW "3.30      Lambda Fahrerwunsch" /begin DEF_CHARACTERISTIC KFLAMFA LAMFAVL TLAFA TMVL /end DEF_CHARACTERISTIC /begin IN_MEASUREMENT B_vl nmot rl tmot /end IN_MEASUREMENT /begin OUT_MEASUREMENT B_vla lamfa_w /end OUT_MEASUREMENT /end FUNCTION
/begin FUNCTION LAMKO "17.60     Lambdakoordination"
 /begin DEF_CHARACTERISTIC CWLAMKH LAMFLGSL LAMLGFKT LAMLGFTM LAMLGMKT LAMLGMTM LAMSOSOF LAMSOSUF LASOABML /end DEF_CHARACTERISTIC
 /begin REF_CHARACTERISTIC STM12ESUB /end REF_CHARACTERISTIC
 /begin IN_MEASUREMENT B_bevab B_bevab2 B_dsla B_evloc B_fa B_falsh B_falsh2 B_fasla B_kh B_lamdkt B_lamdkt2 B_lamka B_lamka2 B_lamkhe B_lamlash B_lamlash2 B_lamnse B_ldeffw B_sls B_slsfz esst_stm12esub flamkh flamsl2_w flamsl_w imlatm lamatb2_w lamatb_w lamdkt2_w lamdkt_w lamelsh2_w lamelsh_w lamfa_w lamka2_w lamka_w lamkh2_w lamkh_w lamlash2_w lamlash_w lamnswl_w ml tmot /end IN_MEASUREMENT
 /begin OUT_MEASUREMENT B_lalgf B_lalgf2 B_lamdiag B_lamdiag2 B_lamsdef lambas lamdiag2_w lamdiag_w lamsbg2_w lamsbg_w lamsons2_w lamsons_w lamvoa2_w lamvoa_w /end OUT_MEASUREMENT
 /begin LOC_MEASUREMENT B_lamkh B_lamnswl B_ldef B_ldef2 lamkhe2_w lamkhe_w lamlgfmn lamlgm lams2_w lamsos2_w lamsos_w lamsubg2_w lamsubg_w lams_w lasoabv /end LOC_MEASUREMENT
/end FUNCTION
/begin FUNCTION LBATTCAL "1.80      Berechnung Batterieladespannung"
 /begin DEF_CHARACTERISTIC APPTBATINI BATTHTAUVG BATTHTAUVK BATTORT0 BATTORT2 BATTVTAUVG BATTVTAUVK BATT_ALFAH BATT_ALFAV BATT_BETAV BATVFZGTAU CWBATTCOD DTANSKOR ILMINUMG KLBATTLSTR KLEXPALH KLEXPALV KLEXPBETAV LADEKENNL LBATTMAX LBATTMIN MCOBATTORT NMINUMG OFTUMGCAN OFULADE PLBATTUMG TBATINIMAN TBATTFTAUV TBATTTAUFH TUMGINI TUMGTAU UBATTNORM ULADE_TAU VMINUMG /end DEF_CHARACTERISTIC
 /begin IN_MEASUREMENT B_etum B_pwf B_taerr B_tns B_tumers imlatm nmot tabst_w tans tumgcan vfzg /end IN_MEASUREMENT
 /begin OUT_MEASUREMENT battort batt_tfil cobattort ctrgenutar tbatstiniv tbatt_lb tumgbattab tumg_ers t_battabst t_batt_ini t_umgabst /end OUT_MEASUREMENT
 /begin LOC_MEASUREMENT batto_a batto_a1 batto_b batto_c batto_c1 batto_c2 batto_c3 batto_c4 batto_c6 batto_c7 batt_a1 batt_a2 batt_c10 batt_c11 batt_c12 batt_c13 batt_c14 batt_c8 batt_c9 batt_d1 batt_e1 batt_e2 batt_e3 batt_e4 batt_e5 batt_e6 batt_w0 B_inibumg dbetalf_t dbet_alf dt_tumg end_init tabst_fl tansf tbatinmanf tumgbatold tumgcanf tumgtemp t_umgabstf vfzgf /end LOC_MEASUREMENT
/end FUNCTION
/begin FUNCTION LDSTGEN "1.50      Berechnung Lastzustand Generator"
 /begin DEF_CHARACTERISTIC DFMODE DFS_MAX DFS_MIN DFS_MITT GENLDDFMAX KLGENLDST TNNSTART /end DEF_CHARACTERISTIC
 /begin IN_MEASUREMENT B_genfprl B_genoff B_noctrgen B_pwf B_sta B_stend dffgen gentemp nmot_w /end IN_MEASUREMENT
 /begin OUT_MEASUREMENT dfmonitor dfsumme dfwanzahl nnstart st_ldstgen /end OUT_MEASUREMENT
 /begin LOC_MEASUREMENT dffgenflo /end LOC_MEASUREMENT
/end FUNCTION
/begin FUNCTION LLPMCTRL "1.40"
 /begin DEF_CHARACTERISTIC B_IFBSAKAP B_IFUPLAAP DFLLMIN DSOCLLANH LLANHAPP LLPMAPP NLLMIN S_B_IFBSAK S_B_IFPLAK S_N_IDLIBS /end DEF_CHARACTERISTIC
 /begin REF_CHARACTERISTIC DFMAX DSOCHYST /end REF_CHARACTERISTIC
 /begin IN_MEASUREMENT B_genfprl B_ifbsak B_ifebsak B_ifisak B_ifsysak B_iftempak B_ifuplak B_ifusak B_ll B_soc_npl dfgenfilt d_soc nmot_w /end IN_MEASUREMENT
 /begin OUT_MEASUREMENT n_idlibs /end OUT_MEASUREMENT
 /begin LOC_MEASUREMENT B_ifbsa7 B_ifupla7 /end LOC_MEASUREMENT
/end FUNCTION
/begin FUNCTION LLRABG "1.30      Leerlaufregelung-Solldrehzahl Korrektur mit Tester"
 /begin DEF_CHARACTERISTIC NFSACVMN NFSACVMX NFSMVMN NFSMVMX NLLMVMN NLLMVMX NSACMVMN NSACMVMX NSLBVMN NSLBVMX TMLLRNS TMNV TMNVFS /end DEF_CHARACTERISTIC
 /begin IN_MEASUREMENT B_eepdif B_ll tmot /end IN_MEASUREMENT
 /begin OUT_MEASUREMENT B_nsabg dnfsacmv dnfsmv dnllmv dnsacmv dnslbv /end OUT_MEASUREMENT
/end FUNCTION
/begin FUNCTION LLRANH "1.50      Leerlauf-Anhebung" /begin DEF_CHARACTERISTIC B_APP_LLAH GENLLAHAPP NSUBO NSUBU /end DEF_CHARACTERISTIC
 /begin IN_MEASUREMENT B_fs B_ll B_ulcp lv_var_bn lv_var_veh nsllm n_idlgspec n_idlibs n_idlms vfzg /end IN_MEASUREMENT
 /begin OUT_MEASUREMENT B_idlgspec B_nsub nslb /end OUT_MEASUREMENT
/end FUNCTION
/begin FUNCTION LLRBB "7.70      Leerlaufregelung Betriebsbedingungen"
 /begin DEF_CHARACTERISTIC CNFKUPPL CWLLRBB DNLLR TVDK TVKUPPL TVLLRI TVLLRIT TVLLRPD TVLLRPDT VLLR /end DEF_CHARACTERISTIC
 /begin IN_MEASUREMENT B_dash B_fil B_fs B_gd B_kuppl B_ll B_mdein B_nmot B_sa B_sab B_stend dmllri_w dn gangi mill_w mistt nmot nmotll nstat tmot vfzg /end IN_MEASUREMENT
 /begin OUT_MEASUREMENT B_llr B_llrein B_llri B_llrpd B_vllr /end OUT_MEASUREMENT
/end FUNCTION
/begin FUNCTION LLRMR "15.60     Momentenreserve Leerlaufregelung"
 /begin DEF_CHARACTERISTIC CWLLRMR DMRESFS DMRESLL DNLLRES KFMRES KFMRESFS KFMRESFST KFMRESKUP KFMREST KFMRESTDO KLTKORRKU MRESFSM MRESFSSMG MRESLLM MRESTEV NMAXKU S_KURESAUS TDMRESLL TVLLRMRTEV TVRESFS TVRESLL WPEDKURES ZDMRLLRMRF ZKRESKUP_N ZKRESKUP_P /end DEF_CHARACTERISTIC
 /begin REF_CHARACTERISTIC SNS06LLSB STA04SAUB STM04SAUB /end REF_CHARACTERISTIC
 /begin IN_MEASUREMENT B_dtebn B_fs B_kuppl B_ll B_nswo1 B_ssgvar B_stend dmrac dmrkrll dns dpsfak dpssol_uw esst_sns06llsb esst_sta04saub esst_stm04saub mdafsmr_w minhub_w mrfa_w nmot_w tans tmot vfzg_w wped_w /end IN_MEASUREMENT
 /begin OUT_MEASUREMENT dmdresdtev dmdresfs dmlllmn_w dmrllrku_temp dmrllrku_w dmrllr_w resdiff /end OUT_MEASUREMENT
/end FUNCTION
/begin FUNCTION LLRNS "556.150   Leerlaufregelung-Solldrehzahl"
 /begin DEF_CHARACTERISTIC CW_BNSFSMN CW_BNSLLMN DELTADFFMX DFFLIM DFFLLANH DFFSCHZMX DNSNFX DTANSLL FNSNF FNSNFT FNSSTM FNSSTMT FWVFZG GELIBDFAPP GELIDFAPP GELIDFZK GELIKMDF GELISETAPP GELIVMAX KNSNF KNSNFT LLWDNMAX LLWDNMIN MINHUBTDNS NFHZ NFHZFS NFSM NFSMHZ NGETNOTL NGNSNF NLLM NLLMHZ NLLMKUPP NMNTA NMNTAFS NMOTLLANH NSAC NSACFS NSDFFGEN NSFSHLS NSFSR NSHLS NSKAT NSLFADY NSLPP NSLPPFS NSMNBNS NSMNBNSFS NSMNEGS NSMNGD NSMNGDFS NSMNNLDG NSMNNLDGFS NSMNTD NSMNTDFS NSNOT NSNOT1 NSNOT1FS NSNOTFS NSOELH NSOELHFS NSTATLLANH NSVFZG NTEB NTEBFS SNS06LLSB SNS06LLTSB TANSLL TDFDTMAX TDFFABLF TDFFMAX TDFFMIN TDNHOLD TGETNOTL TMOTLLANH TNSELLANH UBWCNTINC UBWDELAY UBWDFMAX UBWDFMIN UBWSCHZMX UBWTABL UBWTNSTART UBWULMIN UBWULOFFS UBWUSMIN UBWUSOFFS UBWZKL UBWZKS VFZGLLANH VFZGLLRNS1 VFZGLLRNS2 WPEDLLANH ZKFNSTA ZKNS ZKNSKUPP ZNSM ZNSMFS ZNSMT ZNSMTFS ZNSUB /end DEF_CHARACTERISTIC
 /begin REF_CHARACTERISTIC CWGENPROT STM06LLTUB STM06LLUB /end REF_CHARACTERISTIC
 /begin IN_MEASUREMENT B_autget B_bns B_dknolu B_dkpu B_egs1cok B_egs2cok B_egscok B_fadylsu B_fakat B_fakat2 B_falls B_fhz B_fs B_gd B_gdvhub B_got B_got2 B_hkwnll B_HLSKW B_hz B_kuppl B_ll B_llrein B_lltd B_nac B_nftev B_nldg B_nmot B_nnot B_nsub B_nswo1 B_oelh B_pn B_ssgschlt B_ssgvar B_stend codcan codget dffgen dnfsacmv dnfsmv dnllmv dnsacmv dnslbv dn_w dpsfak esst_stm06lltub esst_stm06llub gangauti minhub_w nfskh ngfil nllkh nmotll nmot_w nslb nsolfa psl stvfzg tans tmot tnse_w ub_w ufgen vfzgk_w vfzgv1_w vfzg_w vsns wped_w /end IN_MEASUREMENT
 /begin OUT_MEASUREMENT B_dffaktiv B_fallsa B_geli B_lltdff B_nivns B_nsubgen B_nsubgen1 B_nsvfzghy B_ubwdl B_ubwulow deltadff dffgenschz dffgen_alt dns esst_sns06llsb esst_sns06lltsb geli_dflim llsstat nllmku nsfsm nsllm nsol nsol_w nsst nstat tdffgen tdffngen_w ubwschz ubwtime_w ulcount uscount /end OUT_MEASUREMENT
 /begin LOC_MEASUREMENT B_awget nsfsmn nslbz nsllmn nsnf nsta /end LOC_MEASUREMENT
/end FUNCTION
/begin FUNCTION LLRRM "506.50    Leerlaufregelung Reglereingriff Drehmoment"
 /begin DEF_CHARACTERISTIC DMLLRIMXN DMLLRMN DMLLRMXN DMLLRZMN DMLLRZMXN DNMNI DVNG DVNGT DVNGV DVNGVT DVZNG DVZNGT DVZNGV DVZNGVT FDDN FDDNT FDDZN FDDZNT IVDN IVDNT IVDNTV IVDNV KFTDLLRD KFTDLLRDZ LIMN LIMNDLLR LIMNDTES LIMNV LIMX LIMXV LISTM LISTMT LLRICNF NDSU PVDN PVDNT PVDNTV PVDNV PVDNVZ PVDNVZT PVDNZ PVDNZT SDN08LLSW SDN08LLTSW TVLISTUM TVLISTUMT ZKLLRD ZKLLRDT ZKLLRDZ ZLIBG /end DEF_CHARACTERISTIC
 /begin REF_CHARACTERISTIC SNG06LLSB SNG06LLTSB SNM06LLUB SNS06LLSB SNS06LLTSB STM06LLTUB STM06LLUB /end REF_CHARACTERISTIC
 /begin IN_MEASUREMENT B_cdnozwte B_dllr B_dtei B_dtes B_gd B_llr B_llrein B_llri B_llrpd B_mdmin B_nswo1 B_st B_stend B_vllr dns dpsfak dpssol_uw dpssol_w esst_sng06llsb esst_sng06lltsb esst_snm06llub esst_sns06llsb esst_sns06lltsb esst_stm06lltub esst_stm06llub minhub_w ngfil nmot nmot_w nsol nsol_w tmot /end IN_MEASUREMENT
 /begin OUT_MEASUREMENT dmllri_w dmllrzf_w dmllrz_w dmllr_w dn dn_w esst_sdn08llsw esst_sdn08lltsw limax_w limin_w /end OUT_MEASUREMENT
 /begin LOC_MEASUREMENT B_llrimx dmllrdz_w dmllrd_w dmllrpz_w dmllrp_w limnst /end LOC_MEASUREMENT
/end FUNCTION
/begin FUNCTION LOADRESP "1.60      BMW Funktion"
 /begin DEF_CHARACTERISTIC CW_BNS_LR ENAPPLGOFF ENAPPLRESP FHOGNMN KFLORESP KFZLRESOF KFZLRRESOFV KLLORESPM LRBNS LRESPAPP NMXGENOF RLMXGENOF S_LORESLL TABSTGNMN TABSTGNMX TATMGENOF TGENOFVL TLORESPST TMOTABGNMN TUMGGNMN TUMGGNMX TVLOFHYST VGENOFMN VGENOGMX VZLORESOFV /end DEF_CHARACTERISTIC
 /begin IN_MEASUREMENT B_bns B_genoffmd B_ll B_llrein B_stend B_vl fho kmstand nmot rl tabst_w tkatm tmot tmotab tmst tumg vfzg /end IN_MEASUREMENT
 /begin OUT_MEASUREMENT B_genoffst B_genoffvl tlrgen tlrgen2 /end OUT_MEASUREMENT
 /begin LOC_MEASUREMENT loadresp /end LOC_MEASUREMENT
/end FUNCTION
/begin FUNCTION LOCANDME "1.160     Local-CAN Botschafts- und Signaldefinition DME" /begin DEF_CHARACTERISTIC OFWINK2AP OFWINKAP /end DEF_CHARACTERISTIC
 /begin IN_MEASUREMENT B_kl15 B_oeltemp B_tabunpl B_vvtslow dme_errfb dme_errfb2 dvvtwnkmx dvvtwnkmx2 exwinks_w nmot_w ofwnkbg1 ofwnkbg2 swvvtnot tabst_w tmot toel_w tumgcan vvtal vvtfkt vvtlernan vvtlernan2 /end IN_MEASUREMENT
 /begin OUT_MEASUREMENT chsdmevvt1 chsdmevvt2 vvt_sw vvt_sw2 zalvdmv1 zalvdmv2 /end OUT_MEASUREMENT
/end FUNCTION
/begin FUNCTION LOCANVVT "1.130     Local-CAN Botschafts- und Signaldefinition VVT" /begin IN_MEASUREMENT ofwnkbg1 ofwnkbg2 /end IN_MEASUREMENT
 /begin OUT_MEASUREMENT B_iwfalse B_iwfalse2 B_vdia1cok B_vdia1new B_vdia2cok B_vdia2new B_vvt1chso B_vvt1cok B_vvt1new B_vvt2chso B_vvt2cok B_vvt2new chsvvtdme1 chsvvtdme2 exwnki2_w exwnki_w svvtansch svvtansch2 vvt1err_ctr vvt2err_ctr vvt_alern vvt_alern2 vvt_ansio vvt_ansio2 vvt_can vvt_can2 vvt_enab vvt_enab2 vvt_endst vvt_endst2 vvt_errst vvt_errst2 vvt_es vvt_es2 vvt_ffs vvt_ffs2 vvt_frs vvt_frs2 vvt_iw vvt_iw2 vvt_luft vvt_luft2 vvt_mux vvt_mux2 vvt_ntanf vvt_ntanf2 vvt_ovrld vvt_ovrld2 vvt_plsen vvt_plsen2 vvt_ready vvt_ready2 vvt_sg vvt_sg2 vvt_stell vvt_stell2 vvt_tv vvt_tv2 vvt_uleis vvt_uleis2 vvt_usen vvt_usen2 zalvvdm1 zalvvdm2 /end OUT_MEASUREMENT
/end FUNCTION
/begin COMPU_METHOD B_TRUE "boolsche Zust‰nde, positive Logik" TAB_VERB "%6.3" "" COMPU_TAB_REF B_TRUE /end COMPU_METHOD
/begin COMPU_VTAB B_TRUE "boolsche Zust‰nde, positive Logik" TAB_VERB 2 0 "----" 1 "TRUE" /end COMPU_VTAB
/begin COMPU_METHOD DEZ "1 : 1 Umrechnug (dez/hex)" RAT_FUNC "%6.2" "" COEFFS 0 1 0 0 0 1 /end COMPU_METHOD
/begin COMPU_METHOD dez "1 : 1 Umrechnug (dez/hex)" RAT_FUNC "%6.2" "" COEFFS 0 1 0 0 0 1 /end COMPU_METHOD
/begin COMPU_METHOD fak_q0p000244 "" RAT_FUNC "%6.5" "-" COEFFS 0 65536 0 0 0 16 /end COMPU_METHOD
/begin COMPU_METHOD fak_q0p004_o100 "" RAT_FUNC "%7.3" "%" COEFFS 0 1 100 0 0 0.004 /end COMPU_METHOD
/begin COMPU_METHOD fak_r32_1 "" RAT_FUNC "%27.13" "-" COEFFS 0 1 0 0 0 1 /end COMPU_METHOD
/begin COMPU_METHOD fak_ub_b1 "" RAT_FUNC "%6.4" "-" COEFFS 0 256 0 0 0 1 /end COMPU_METHOD
/begin COMPU_METHOD fak_ub_b2 "" RAT_FUNC "%6.4" "-" COEFFS 0 256 0 0 0 2 /end COMPU_METHOD
/begin COMPU_METHOD fak_ub_b4 "" RAT_FUNC "%6.4" "-" COEFFS 0 256 0 0 0 4 /end COMPU_METHOD
/begin COMPU_METHOD fak_uw_b16 "" RAT_FUNC "%6.5" "-" COEFFS 0 65536 0 0 0 16 /end COMPU_METHOD
/begin COMPU_METHOD fak_uw_b2 "" RAT_FUNC "%7.6" "-" COEFFS 0 65536 0 0 0 2 /end COMPU_METHOD
/begin COMPU_METHOD fak_uw_b4 "" RAT_FUNC "%7.6" "-" COEFFS 0 65536 0 0 0 4 /end COMPU_METHOD
/begin COMPU_METHOD fuel_uw_b1 "" RAT_FUNC "%7.6" "ul" COEFFS 0 65536 0 0 0 1 /end COMPU_METHOD
/begin COMPU_METHOD fuel_uw_b65535 "" RAT_FUNC "%6.2" "ul" COEFFS 0 1 0 0 0 1 /end COMPU_METHOD
/begin COMPU_METHOD hub_uw_q0p001 "" RAT_FUNC "%6.5" "mm" COEFFS 0 1000 0 0 0 1 /end COMPU_METHOD
/begin COMPU_METHOD i_ub_q0p02 "" RAT_FUNC "%7.4" "A" COEFFS 0 1 0 0 0 0.02 /end COMPU_METHOD
/begin COMPU_METHOD i_ub_q0p04 "" RAT_FUNC "%5.3" "A" COEFFS 0 1 0 0 0 0.04 /end COMPU_METHOD
/begin COMPU_METHOD i_ub_q0p08 "" RAT_FUNC "%6.3" "A" COEFFS 0 1 0 0 0 0.08 /end COMPU_METHOD
/begin COMPU_METHOD i_ub_q5p12 "" RAT_FUNC "%5.2" "A" COEFFS 0 100 0 0 0 512 /end COMPU_METHOD
/begin COMPU_METHOD i_uw_q0p02_o200 "" RAT_FUNC "%6.1" "A" COEFFS 0 1 200 0 0 0.02 /end COMPU_METHOD
/begin COMPU_METHOD i_uw_q0p08_o200 "" RAT_FUNC "%7.2" "A" COEFFS 0 1 200 0 0 0.08 /end COMPU_METHOD
/begin COMPU_METHOD i_vvt_ub_q0p50_om63p50 "" RAT_FUNC "%6.4" "" COEFFS 0 1 63.5 0 0 0.5 /end COMPU_METHOD
/begin COMPU_METHOD km_uw_q10 "" RAT_FUNC "%6.1" "km" COEFFS 0 1 0 0 0 10 /end COMPU_METHOD
/begin COMPU_METHOD kw_q1 "" RAT_FUNC "%6.2" "Grad KW" COEFFS 0 1 0 0 0 1 /end COMPU_METHOD
/begin COMPU_METHOD m_ub_b1020 "" RAT_FUNC "%6.2" "kg/h" COEFFS 0 1 0 0 0 4 /end COMPU_METHOD
/begin COMPU_METHOD m_ub_b23p3 "" RAT_FUNC "%6.3" "kg" COEFFS 0 2812.5 0 0 0 256 /end COMPU_METHOD
/begin COMPU_METHOD m_uw_b6553p5 "" RAT_FUNC "%6.3" "kg/h" COEFFS 0 1 0 0 0 0.1 /end COMPU_METHOD
/begin COMPU_METHOD nmotd_sb_q10 "" RAT_FUNC "%6.1" "1/min" COEFFS 0 1 0 0 0 10 /end COMPU_METHOD
/begin COMPU_METHOD nmotd_sw_q0p25 "" RAT_FUNC "%6.3" "1/min" COEFFS 0 1 0 0 0 0.25 /end COMPU_METHOD
/begin COMPU_METHOD nmotg_sb_q100 "" RAT_FUNC "%6.0" "1/min/s" COEFFS 0 1 0 0 0 100 /end COMPU_METHOD
/begin COMPU_METHOD nmotg_ub_q100 "" RAT_FUNC "%6.0" "1/min/s" COEFFS 0 1 0 0 0 100 /end COMPU_METHOD
/begin COMPU_METHOD nmot_ub_q10 "" RAT_FUNC "%6.1" "1/min" COEFFS 0 1 0 0 0 10 /end COMPU_METHOD
/begin COMPU_METHOD nmot_ub_q40 "" RAT_FUNC "%6.1" "1/min" COEFFS 0 1 0 0 0 40 /end COMPU_METHOD
/begin COMPU_METHOD nmot_uw_q0p25 "" RAT_FUNC "%6.3" "1/min" COEFFS 0 1 0 0 0 0.25 /end COMPU_METHOD
/begin COMPU_METHOD PCENT "Prozent" RAT_FUNC "%6.3" "%" COEFFS 0 256 0 0 0 100 /end COMPU_METHOD
/begin COMPU_METHOD p_q0p039 "" RAT_FUNC "%6.4" "hPa" COEFFS 0 256 0 0 0 10 /end COMPU_METHOD
/begin COMPU_METHOD qlad_uw_q0p0182 "" RAT_FUNC "%6.4" "Ah" COEFFS 0 3600000 0 0 0 65536 /end COMPU_METHOD
/begin COMPU_METHOD relgrad_20ms_qn0p019 "" RAT_FUNC "%6.5" "%/s" COEFFS 0 -1 0 0 0 0.019 /end COMPU_METHOD
/begin COMPU_METHOD relPED_uw_b100 "" RAT_FUNC "%6.4" "%PED" COEFFS 0 65535 0 0 0 100 /end COMPU_METHOD
/begin COMPU_METHOD rel_b99p9985 "" RAT_FUNC "%6.4" "%" COEFFS 0 65535 0 0 0 99.9985 /end COMPU_METHOD
/begin COMPU_METHOD rel_q0p00195 "" RAT_FUNC "%6.4" "%" COEFFS 0 65536 0 0 0 128 /end COMPU_METHOD
/begin COMPU_METHOD rel_q0p09726 "" RAT_FUNC "%6.3" "%" COEFFS 0 255 0 0 0 24.9 /end COMPU_METHOD
/begin COMPU_METHOD rel_sb_q0p0976 "" RAT_FUNC "%6.3" "%" COEFFS 0 1 0 0 0 0.097647 /end COMPU_METHOD
/begin COMPU_METHOD rel_sw_b100 "" RAT_FUNC "%6.4" "%" COEFFS 0 32768 0 0 0 100 /end COMPU_METHOD
/begin COMPU_METHOD rel_ub_b0p78 "" RAT_FUNC "%6.4" "%" COEFFS 0 256 0 0 0 0.78125 /end COMPU_METHOD
/begin COMPU_METHOD rel_ub_b100 "" RAT_FUNC "%6.3" "%" COEFFS 0 256 0 0 0 100 /end COMPU_METHOD
/begin COMPU_METHOD rel_ub_b1p0 "" RAT_FUNC "%6.4" "%" COEFFS 0 256 0 0 0 1 /end COMPU_METHOD
/begin COMPU_METHOD rel_ub_b24p9 "" RAT_FUNC "%6.3" "%" COEFFS 0 255 0 0 0 24.9 /end COMPU_METHOD
/begin COMPU_METHOD rel_ub_b31 "" RAT_FUNC "%6.2" "%" COEFFS 0 31 0 0 0 100 /end COMPU_METHOD
/begin COMPU_METHOD rel_ub_b99p6 "" RAT_FUNC "%6.3" "%" COEFFS 0 256 0 0 0 100 /end COMPU_METHOD
/begin COMPU_METHOD rel_ub_bn0p125 "" RAT_FUNC "%8.7" "%" COEFFS 0 -256 0 0 0 0.125 /end COMPU_METHOD
/begin COMPU_METHOD rel_ub_bn24p9 "" RAT_FUNC "%6.5" "%" COEFFS 0 -255 0 0 0 24.9 /end COMPU_METHOD
/begin COMPU_METHOD rel_ub_q0p75 "" RAT_FUNC "%6.3" "%" COEFFS 0 1 0 0 0 0.75 /end COMPU_METHOD
/begin COMPU_METHOD rel_uw_b200 "" RAT_FUNC "%6.4" "%" COEFFS 0 65536 0 0 0 200 /end COMPU_METHOD
/begin COMPU_METHOD rel_uw_q0p001 "" RAT_FUNC "%6.5" "%" COEFFS 0 1000 0 0 0 1 /end COMPU_METHOD
/begin COMPU_METHOD rel_uw_q0p0234 "" RAT_FUNC "%6.4" "%" COEFFS 0 32 0 0 0 0.75 /end COMPU_METHOD
/begin COMPU_METHOD spg_gencan "" RAT_FUNC "%6.2" "V" COEFFS 0 40 -424 0 0 1 /end COMPU_METHOD
/begin COMPU_METHOD spg_ubatt "" RAT_FUNC "%6.3" "V" COEFFS 0 1 0 0 0 0.0942 /end COMPU_METHOD
/begin COMPU_METHOD spg_ub_q0p0196 "" RAT_FUNC "%6.4" "V" COEFFS 0 1 0 0 0 0.0196 /end COMPU_METHOD
/begin COMPU_METHOD spg_ub_q0p064_o6 "" RAT_FUNC "%6.3" "V" COEFFS 0 1 -6 0 0 0.064 /end COMPU_METHOD
/begin COMPU_METHOD spg_ugen "" RAT_FUNC "%6.2" "V" COEFFS 0 10 -106 0 0 1 /end COMPU_METHOD
/begin COMPU_METHOD spg_uw_q0p25em3_o6 "" RAT_FUNC "%9.5" "V" COEFFS 0 1 -6 0 0 0.00025 /end COMPU_METHOD
/begin COMPU_METHOD sprzi_q0p1 "" RAT_FUNC "%6.3" "Grad KW" COEFFS 0 10 0 0 0 1 /end COMPU_METHOD
/begin COMPU_METHOD sprzi_q0p1o12p8 "" RAT_FUNC "%6.5" "Grad KW" COEFFS 0 10 128 0 0 1 /end COMPU_METHOD
/begin COMPU_METHOD t100msxs_ub_b25p5 "" RAT_FUNC "%6.3" "s" COEFFS 0 1 0 0 0 0.1 /end COMPU_METHOD
/begin COMPU_METHOD t100msxs_uw_b6553p5 "" RAT_FUNC "%6.3" "s" COEFFS 0 1 0 0 0 0.1 /end COMPU_METHOD
/begin COMPU_METHOD t10msxs_ub_b2p55 "" RAT_FUNC "%6.4" "s" COEFFS 0 1 0 0 0 0.01 /end COMPU_METHOD
/begin COMPU_METHOD t10msxs_uw_b655p35 "" RAT_FUNC "%6.4" "s" COEFFS 0 1 0 0 0 0.01 /end COMPU_METHOD
/begin COMPU_METHOD t1msxms_q1 "" RAT_FUNC "%6.2" "ms" COEFFS 0 1 0 0 0 1 /end COMPU_METHOD
/begin COMPU_METHOD t1sxs_ub_b255 "" RAT_FUNC "%6.2" "s" COEFFS 0 1 0 0 0 1 /end COMPU_METHOD
/begin COMPU_METHOD t1sxs_ub_q1 "" RAT_FUNC "%6.2" "s" COEFFS 0 1 0 0 0 1 /end COMPU_METHOD
/begin COMPU_METHOD t1sxs_uw_q1 "" RAT_FUNC "%6.2" "s" COEFFS 0 1 0 0 0 1 /end COMPU_METHOD
/begin COMPU_METHOD t200msxs_ub_b51 "" RAT_FUNC "%6.3" "s" COEFFS 0 1 0 0 0 0.2 /end COMPU_METHOD
/begin COMPU_METHOD t200msxs_uw_q0p2 "" RAT_FUNC "%6.3" "s" COEFFS 0 1 0 0 0 0.2 /end COMPU_METHOD
/begin COMPU_METHOD t20msxs_ub_b5p1 "" RAT_FUNC "%6.4" "s" COEFFS 0 1 0 0 0 0.02 /end COMPU_METHOD
/begin COMPU_METHOD t20msxs_uw_q0p02 "" RAT_FUNC "%6.4" "s" COEFFS 0 1 0 0 0 0.02 /end COMPU_METHOD
/begin COMPU_METHOD t3p2usxms_uw_b209p7 "" RAT_FUNC "%6.4" "ms" COEFFS 0 65536 0 0 0 209.751 /end COMPU_METHOD
/begin COMPU_METHOD t50msxs_q0p05 "" RAT_FUNC "%6.4" "s" COEFFS 0 1 0 0 0 0.05 /end COMPU_METHOD
/begin COMPU_METHOD tefuel_uw_b312p5 "" RAT_FUNC "%6.4" "ul/ms" COEFFS 0 65535 0 0 0 312.5 /end COMPU_METHOD
/begin COMPU_METHOD temp_q1 "" RAT_FUNC "%6.2" "Grad C" COEFFS 0 1 0 0 0 1 /end COMPU_METHOD
/begin COMPU_METHOD temp_ub_q0p75_o48 "" RAT_FUNC "%6.2" "Grad C" COEFFS 0 1 48 0 0 0.75 /end COMPU_METHOD
/begin COMPU_METHOD temp_ub_q5_o50 "" RAT_FUNC "%6.2" "Grad C" COEFFS 0 1 50 0 0 5 /end COMPU_METHOD
/begin COMPU_METHOD temp_uw_q0p75_o48 "" RAT_FUNC "%6.2" "Grad C" COEFFS 0 1 48 0 0 0.75 /end COMPU_METHOD
/begin COMPU_METHOD tlr_q3 "" RAT_FUNC "%6.2" "s" COEFFS 0 1 0 0 0 3 /end COMPU_METHOD
/begin COMPU_METHOD txms_uw_q0p001 "" RAT_FUNC "%6.5" "ms" COEFFS 0 1000 0 0 0 1 /end COMPU_METHOD
/begin COMPU_METHOD t_q0p001_ms "" RAT_FUNC "%6.5" "ms" COEFFS 0 1 0 0 0 0.001 /end COMPU_METHOD
/begin COMPU_METHOD t_q0p002_o01 "" RAT_FUNC "%6.4" "s" COEFFS 0 500 -5 0 0 1 /end COMPU_METHOD
/begin COMPU_METHOD t_q0p00625 "" RAT_FUNC "%6.4" "s" COEFFS 0 160 0 0 0 1 /end COMPU_METHOD
/begin COMPU_METHOD t_q0p0125 "" RAT_FUNC "%6.4" "s" COEFFS 0 80 0 0 0 1 /end COMPU_METHOD
/begin COMPU_METHOD t_q0p1ms "" RAT_FUNC "%6.3" "ms" COEFFS 0 10 0 0 0 1 /end COMPU_METHOD
/begin COMPU_METHOD t_q16p0 "" RAT_FUNC "%7.2" "s" COEFFS 0 1 0 0 0 16 /end COMPU_METHOD
/begin COMPU_METHOD t_q256 "" RAT_FUNC "%6.0" "s" COEFFS 0 1 0 0 0 256 /end COMPU_METHOD
/begin COMPU_METHOD vfzg_ub_q1p25 "" RAT_FUNC "%6.2" "km/h" COEFFS 0 1 0 0 0 1.25 /end COMPU_METHOD
/begin COMPU_METHOD vfzg_uw_b512 "" RAT_FUNC "%6.4" "km/h" COEFFS 0 65536 0 0 0 512 /end COMPU_METHOD
/begin COMPU_METHOD wink_uw_q0p1 "" RAT_FUNC "%6.3" "Grad" COEFFS 0 10 0 0 0 1 /end COMPU_METHOD
/begin COMPU_METHOD zk100msxs_ub_b25p5 "" RAT_FUNC "%6.3" "s" COEFFS 0 0 256 0 10 0 /end COMPU_METHOD
/begin COMPU_METHOD zk10msxs_uw_b655 "" RAT_FUNC "%6.2" "s" COEFFS 0 0 65536 0 100 0 /end COMPU_METHOD
/begin COMPU_METHOD zk200msxs_ub_b51p2 "" RAT_FUNC "%6.3" "s" COEFFS 0 0 51.2 0 1 0 /end COMPU_METHOD
/begin COMPU_METHOD zk20msxs_ub_b5p1 "" RAT_FUNC "%6.4" "s" COEFFS 0 0 5.1 0 1 0 /end COMPU_METHOD
/begin COMPU_METHOD zk20msxs_uw_b1310 "" RAT_FUNC "%6.1" "s" COEFFS 0 0 1310 0 1 0 /end COMPU_METHOD
/begin COMPU_METHOD default "" RAT_FUNC "%6.2" "" COEFFS 0 1 0 0 0 1 /end COMPU_METHOD
/begin RECORD_LAYOUT GkfWUb FNC_VALUES 1 UBYTE COLUMN_DIR DIRECT /end RECORD_LAYOUT
/begin RECORD_LAYOUT GklWUb FNC_VALUES 1 UBYTE COLUMN_DIR DIRECT /end RECORD_LAYOUT
/begin RECORD_LAYOUT KfAxU8AyU8SstxU16SstyU16WU16 NO_AXIS_PTS_X 1 UWORD NO_AXIS_PTS_Y 2 UWORD AXIS_PTS_X 3 UWORD INDEX_INCR DIRECT AXIS_PTS_Y 4 UWORD INDEX_INCR DIRECT FNC_VALUES 5 UWORD COLUMN_DIR DIRECT /end RECORD_LAYOUT
/begin RECORD_LAYOUT KfAxU8AyU8SstxU8SstyU16WU8 NO_AXIS_PTS_X 1 UBYTE NO_AXIS_PTS_Y 2 UBYTE AXIS_PTS_X 3 UBYTE INDEX_INCR DIRECT AXIS_PTS_Y 4 UWORD INDEX_INCR DIRECT FNC_VALUES 5 UBYTE COLUMN_DIR DIRECT /end RECORD_LAYOUT
/begin RECORD_LAYOUT KfAxU8AyU8SstxU8SstyU8WU8 NO_AXIS_PTS_X 1 UBYTE NO_AXIS_PTS_Y 2 UBYTE AXIS_PTS_X 3 UBYTE INDEX_INCR DIRECT AXIS_PTS_Y 4 UBYTE INDEX_INCR DIRECT FNC_VALUES 5 UBYTE COLUMN_DIR DIRECT /end RECORD_LAYOUT
/begin RECORD_LAYOUT KfAxUbAyUbSstxUbSstyUbWUb NO_AXIS_PTS_X 1 UBYTE NO_AXIS_PTS_Y 2 UBYTE AXIS_PTS_X 3 UBYTE INDEX_INCR DIRECT AXIS_PTS_Y 4 UBYTE INDEX_INCR DIRECT FNC_VALUES 5 UBYTE COLUMN_DIR DIRECT /end RECORD_LAYOUT
/begin RECORD_LAYOUT KfAxUbAyUbSstxUbSstyUwWUw NO_AXIS_PTS_X 1 UBYTE NO_AXIS_PTS_Y 2 UBYTE AXIS_PTS_X 3 UBYTE INDEX_INCR DIRECT AXIS_PTS_Y 4 UWORD INDEX_INCR DIRECT FNC_VALUES 5 UWORD COLUMN_DIR DIRECT /end RECORD_LAYOUT
/begin RECORD_LAYOUT KfAxUwAyUwSstxUwSstyUwWSw NO_AXIS_PTS_X 1 UWORD NO_AXIS_PTS_Y 2 UWORD AXIS_PTS_X 3 UWORD INDEX_INCR DIRECT AXIS_PTS_Y 4 UWORD INDEX_INCR DIRECT FNC_VALUES 5 SWORD COLUMN_DIR DIRECT /end RECORD_LAYOUT
/begin RECORD_LAYOUT KfAxUwAyUwSstxUwSstyUwWUw NO_AXIS_PTS_X 1 UWORD NO_AXIS_PTS_Y 2 UWORD AXIS_PTS_X 3 UWORD INDEX_INCR DIRECT AXIS_PTS_Y 4 UWORD INDEX_INCR DIRECT FNC_VALUES 5 UWORD COLUMN_DIR DIRECT /end RECORD_LAYOUT
/begin RECORD_LAYOUT KlAUbSstUbWSb NO_AXIS_PTS_X 1 UBYTE AXIS_PTS_X 2 UBYTE INDEX_INCR DIRECT FNC_VALUES 3 SBYTE COLUMN_DIR DIRECT /end RECORD_LAYOUT
/begin RECORD_LAYOUT KlAUbSstUbWUb NO_AXIS_PTS_X 1 UBYTE AXIS_PTS_X 2 UBYTE INDEX_INCR DIRECT FNC_VALUES 3 UBYTE COLUMN_DIR DIRECT /end RECORD_LAYOUT
/begin RECORD_LAYOUT KlAUwSstUwWUw NO_AXIS_PTS_X 1 UWORD AXIS_PTS_X 2 UWORD INDEX_INCR DIRECT FNC_VALUES 3 UWORD COLUMN_DIR DIRECT /end RECORD_LAYOUT
/begin RECORD_LAYOUT KlAxU8SstxR32WR32 NO_AXIS_PTS_X 1 ULONG AXIS_PTS_X 2 FLOAT32_IEEE INDEX_INCR DIRECT FNC_VALUES 3 FLOAT32_IEEE COLUMN_DIR DIRECT /end RECORD_LAYOUT
/begin RECORD_LAYOUT KlAxU8SstxU16WU16 NO_AXIS_PTS_X 1 UWORD AXIS_PTS_X 2 UWORD INDEX_INCR DIRECT FNC_VALUES 3 UWORD COLUMN_DIR DIRECT /end RECORD_LAYOUT
/begin RECORD_LAYOUT KlAxU8SstxU8WU8 NO_AXIS_PTS_X 1 UBYTE AXIS_PTS_X 2 UBYTE INDEX_INCR DIRECT FNC_VALUES 3 UBYTE COLUMN_DIR DIRECT /end RECORD_LAYOUT
/begin RECORD_LAYOUT KwbUw FNC_VALUES 1 UWORD COLUMN_DIR DIRECT /end RECORD_LAYOUT
/begin RECORD_LAYOUT KwbWU16 FNC_VALUES 1 UWORD COLUMN_DIR DIRECT /end RECORD_LAYOUT
/begin RECORD_LAYOUT KwbWU8 FNC_VALUES 1 UBYTE COLUMN_DIR DIRECT /end RECORD_LAYOUT
/begin RECORD_LAYOUT KwSb FNC_VALUES 1 SBYTE COLUMN_DIR DIRECT /end RECORD_LAYOUT
/begin RECORD_LAYOUT KwSw FNC_VALUES 1 SWORD COLUMN_DIR DIRECT /end RECORD_LAYOUT
/begin RECORD_LAYOUT KwUb FNC_VALUES 1 UBYTE COLUMN_DIR DIRECT /end RECORD_LAYOUT
/begin RECORD_LAYOUT KwUw FNC_VALUES 1 UWORD COLUMN_DIR DIRECT /end RECORD_LAYOUT
/begin RECORD_LAYOUT KwWR32 FNC_VALUES 1 FLOAT32_IEEE COLUMN_DIR DIRECT /end RECORD_LAYOUT
/begin RECORD_LAYOUT KwWS16 FNC_VALUES 1 SWORD COLUMN_DIR DIRECT /end RECORD_LAYOUT
/begin RECORD_LAYOUT KwWS8 FNC_VALUES 1 SBYTE COLUMN_DIR DIRECT /end RECORD_LAYOUT
/begin RECORD_LAYOUT KwWU16 FNC_VALUES 1 UWORD COLUMN_DIR DIRECT /end RECORD_LAYOUT
/begin RECORD_LAYOUT KwWU8 FNC_VALUES 1 UBYTE COLUMN_DIR DIRECT /end RECORD_LAYOUT
/begin RECORD_LAYOUT SstASwSstSw NO_AXIS_PTS_X 1 SWORD AXIS_PTS_X 2 SWORD INDEX_INCR DIRECT /end RECORD_LAYOUT
/begin RECORD_LAYOUT SstAUbSstSb NO_AXIS_PTS_X 1 UBYTE AXIS_PTS_X 2 SBYTE INDEX_INCR DIRECT /end RECORD_LAYOUT
/begin RECORD_LAYOUT SstAUbSstUb NO_AXIS_PTS_X 1 UBYTE AXIS_PTS_X 2 UBYTE INDEX_INCR DIRECT /end RECORD_LAYOUT
/end MODULE
/end PROJECT
