ASAP2_VERSION 1 31
/begin PROJECT MS45 "BMW Motorsteuerung R6"
/begin HEADER "_default_HeaderComment" PROJECT_NO _57 /end HEADER
/begin MODULE _default_ModuleName "_default_ModuleLongIdentifier"
/begin MOD_COMMON "_default_ModCommonComment" DEPOSIT ABSOLUTE BYTE_ORDER MSB_FIRST ALIGNMENT_BYTE 1 ALIGNMENT_WORD 2 ALIGNMENT_LONG 4 ALIGNMENT_FLOAT32_IEEE 4 ALIGNMENT_FLOAT64_IEEE 8 /end MOD_COMMON
/begin MEASUREMENT lv_err_bn_msw "Present error BN2000" UBYTE _CNV_S_2_RANGE______1_R_CM 1 100. 0. 255. DISPLAY_IDENTIFIER LV_ERR_BN_MSW ECU_ADDRESS 0x3fbaf0 /end MEASUREMENT
/begin CHARACTERISTIC c_amp_hys "maximum value between two acquired ambient pressure values" VALUE 0xffe414e8 _REC_VAL_20_u2 5434. _CNV_A_R_LINEAR_____49_CM 0. 5434. DISPLAY_IDENTIFIER C_AMP_HYS FORMAT "%7.2" /end CHARACTERISTIC
/begin CHARACTERISTIC ip_amp_raw_cor__vs "correlation table for the linearization of the ambient pressure with the vehicle speed" CURVE 0xffe48f08 _REC_CUR_20_u2_u1 5434. _CNV_A_R_LINEAR_____49_CM 0. 5434. DISPLAY_IDENTIFIER IP_AMP_RAW_COR__VS FORMAT "%7.2"
 /begin AXIS_DESCR COM_AXIS vs _CNV_A_R_LINEAR_____23_CM 8 0. 255. FORMAT "%3.0" AXIS_PTS_REF ldp_vs__amp_raw_cor /end AXIS_DESCR
/end CHARACTERISTIC
/begin MEASUREMENT amp_mes "valid ambient pressure" UWORD _CNV_A_R_LINEAR_____49_CM 1 100. 0. 5434. DISPLAY_IDENTIFIER AMP_MES ECU_ADDRESS 0x3fd7a0 BYTE_ORDER MSB_LAST FORMAT "%7.2" /end MEASUREMENT
/begin CHARACTERISTIC c_amp_crlc "correlation value for the compensation of the noise signal of the ambient pressure signal" VALUE 0xffe4062b _REC_VAL_20_u1 0.9960940000000002 _CNV_A_R_LINEAR_____50_CM 0. 0.996094 DISPLAY_IDENTIFIER C_AMP_CRLC FORMAT "%5.3" /end CHARACTERISTIC
/begin CHARACTERISTIC c_fac_amp_min "BOT for FAC_AMP" VALUE 0xffe415f0 _REC_VAL_20_u2 1.99996948 _CNV_A_R_LINEAR_____20_CM 0. 1.99996948 DISPLAY_IDENTIFIER C_FAC_AMP_MIN FORMAT "%7.5" /end CHARACTERISTIC
/begin CHARACTERISTIC c_fac_amp_max "TOP for FAC_AMP" VALUE 0xffe415ee _REC_VAL_20_u2 1.99996948 _CNV_A_R_LINEAR_____20_CM 0. 1.99996948 DISPLAY_IDENTIFIER C_FAC_AMP_MAX FORMAT "%7.5" /end CHARACTERISTIC
/begin MEASUREMENT fac_amp "factor of the ambient pressure related to the reference ambient pressure" UWORD _CNV_A_R_LINEAR_____20_CM 1 100. 0. 1.99996948 DISPLAY_IDENTIFIER FAC_AMP ECU_ADDRESS 0x3fd7a2 BYTE_ORDER MSB_LAST FORMAT "%7.5" /end MEASUREMENT
/begin AXIS_PTS ldp_vs__amp_raw_cor "" 0xffe4833e vs _REC_AXS_20_u1 255. _CNV_A_R_LINEAR_____23_CM 8 0. 255. DISPLAY_IDENTIFIER LDP_VS__AMP_RAW_COR FORMAT "%3.0" /end AXIS_PTS
/begin AXIS_PTS ldp_v_amp_1__amp_raw "" 0xffe51584 v_amp _REC_AXS_20_u2 4.99511719 _CNV_A_R_LINEAR_____3_CM 8 0. 4.99511719 DISPLAY_IDENTIFIER LDP_V_AMP_1__AMP_RAW FORMAT "%5.3" /end AXIS_PTS
/begin AXIS_PTS ldp_v_amp_2__amp_raw "" 0xffe51596 v_amp _REC_AXS_20_u2 4.99511719 _CNV_A_R_LINEAR_____3_CM 8 0. 4.99511719 DISPLAY_IDENTIFIER LDP_V_AMP_2__AMP_RAW FORMAT "%5.3" /end AXIS_PTS
/begin CHARACTERISTIC ip_amp_raw_2__v_amp "correlation table for the linearization of the ambient pressure value acquisition with Infineon sensor" CURVE 0xffe48ef8 _REC_CUR_20_u2_u2 5434. _CNV_A_R_LINEAR_____49_CM 0. 5434. DISPLAY_IDENTIFIER IP_AMP_RAW_2 FORMAT "%7.2"
 /begin AXIS_DESCR COM_AXIS v_amp _CNV_A_R_LINEAR_____3_CM 8 0. 4.99511719 FORMAT "%5.3" AXIS_PTS_REF ldp_v_amp_2__amp_raw /end AXIS_DESCR
/end CHARACTERISTIC
/begin CHARACTERISTIC ip_amp_raw_1__v_amp "correlation table for the linearization of the ambient pressure value acquisition with Motorola sensor" CURVE 0xffe48ee8 _REC_CUR_20_u2_u2 5434. _CNV_A_R_LINEAR_____49_CM 0. 5434. DISPLAY_IDENTIFIER IP_AMP_RAW_1 FORMAT "%7.2"
 /begin AXIS_DESCR COM_AXIS v_amp _CNV_A_R_LINEAR_____3_CM 8 0. 4.99511719 FORMAT "%5.3" AXIS_PTS_REF ldp_v_amp_1__amp_raw /end AXIS_DESCR
/end CHARACTERISTIC
/begin MEASUREMENT tq_loss_ars_av_can "torque loss actual value ARS from CAN" SWORD _CNV_A_R_LINEAR_____55_CM 1 100. -1024. 1023.96875 DISPLAY_IDENTIFIER TQ_LOSS_ARS_AV_CAN ECU_ADDRESS 0x3fd0b8 BYTE_ORDER MSB_LAST FORMAT "%8.2" /end MEASUREMENT
/begin MEASUREMENT tq_loss_ars_sp_can "torque loss setpoint ARS from CAN" SWORD _CNV_A_R_LINEAR_____55_CM 1 100. -1024. 1023.96875 DISPLAY_IDENTIFIER TQ_LOSS_ARS_SP_CAN ECU_ADDRESS 0x3fd0ba BYTE_ORDER MSB_LAST FORMAT "%8.2" /end MEASUREMENT
/begin MEASUREMENT veh_key_nr "vehicle key number" UBYTE _CNV_A_R_LINEAR_____0_CM 1 100. 0. 15. DISPLAY_IDENTIFIER VEH_KEY_NR ECU_ADDRESS 0x3fe0b8 FORMAT "%2.0" /end MEASUREMENT
/begin MEASUREMENT state_ars_can "status anti roll stabilization via CAN" UBYTE _CNV_S_3_STATE_ARS__56_CM 1 100. 0. 3. DISPLAY_IDENTIFIER STATE_ARS_CAN ECU_ADDRESS 0x3fe088 /end MEASUREMENT
/begin MEASUREMENT state_igk_can "status ignition key via CAN" UBYTE _CNV_S_3_STATE_IGK__57_CM 1 100. 0. 2. DISPLAY_IDENTIFIER STATE_IGK_CAN ECU_ADDRESS 0x3fe089 /end MEASUREMENT
/begin MEASUREMENT lv_tcs_lih_can "logical variable traction control system limp home" UBYTE _CNV_S_2_RANGE______2_CM 1 100. 0. 1. DISPLAY_IDENTIFIER LV_TCS_LIH_CAN ECU_ADDRESS 0x3fe0a5 /end MEASUREMENT
/begin MEASUREMENT state_tcs_intv "status traction control system via CAN" UBYTE _CNV_S_4_STATE_TCS__58_CM 1 100. 0. 3. DISPLAY_IDENTIFIER STATE_TCS_INTV ECU_ADDRESS 0x3fe08b /end MEASUREMENT
/begin MEASUREMENT state_wal_can "logical variable fuel reserve" UBYTE _CNV_S_3_STATE_WAL__59_CM 1 100. 0. 3. DISPLAY_IDENTIFIER STATE_WAL_CAN ECU_ADDRESS 0x3fe0d4 /end MEASUREMENT
/begin MEASUREMENT t_ctr_rel_can "relative time counter (reseted at Kl. 30 OFF)" ULONG _CNV_A_R_LINEAR_____30_CM 1 100. 0. 4294967294. DISPLAY_IDENTIFIER T_CTR_REL_CAN ECU_ADDRESS 0x3fbedc BYTE_ORDER MSB_LAST FORMAT "%11.0" /end MEASUREMENT
/begin MEASUREMENT v_sp_gen "target generator voltage " UBYTE _CNV_A_R_LINEAR_____60_CM 1 100. 0. 26. DISPLAY_IDENTIFIER V_SP_GEN ECU_ADDRESS 0x3fe0d8 FORMAT "%4.1" /end MEASUREMENT
/begin MEASUREMENT t_can "day counter absolute (counts the days at sufficient mains voltage )" UWORD _CNV_A_R_LINEAR_____61_CM 1 100. 0. 65534. DISPLAY_IDENTIFIER T_CAN ECU_ADDRESS 0x3fd0d0 BYTE_ORDER MSB_LAST FORMAT "%5.0" /end MEASUREMENT
/begin CHARACTERISTIC c_t_cyc_disp_icl_can "recurrence for transmission of  check control message" VALUE 0xffe4086a _REC_VAL_20_u1 15. _CNV_A_R_LINEAR_____30_CM 0. 15. DISPLAY_IDENTIFIER C_T_CYC_DISP_ICL_CAN FORMAT "%2.0" /end CHARACTERISTIC
/begin MEASUREMENT state_tcs_ctl "status closed looped control via CAN" UBYTE _CNV_S_9_STATE_TCS__62_CM 1 100. 0. 255. DISPLAY_IDENTIFIER STATE_TCS_CTL ECU_ADDRESS 0x3fe08c /end MEASUREMENT
/begin MEASUREMENT state_tcs_dece "status closed loop control via CAN" UBYTE _CNV_S_5_STATE_TCS__63_CM 1 100. 0. 15. DISPLAY_IDENTIFIER STATE_TCS_DECE ECU_ADDRESS 0x3fe08d /end MEASUREMENT
/begin MEASUREMENT ac_veh_lgt_tcs "vehicle acceleration (longitudinal) TCS" SWORD _CNV_A_R_LINEAR_____64_CM 1 100. -51.175 51.175 DISPLAY_IDENTIFIER AC_VEH_LGT_TCS ECU_ADDRESS 0x3fd0c0 BYTE_ORDER MSB_LAST FORMAT "%8.3" /end MEASUREMENT
/begin MEASUREMENT ac_veh_trv_tcs "vehicle acceleration (transversal) TCS" SWORD _CNV_A_R_LINEAR_____64_CM 1 100. -51.175 51.175 DISPLAY_IDENTIFIER AC_VEH_TRV_TCS ECU_ADDRESS 0x3fd0c2 BYTE_ORDER MSB_LAST FORMAT "%8.3" /end MEASUREMENT
/begin MEASUREMENT state_mod_gb "State mode gearbox : SSC (Sleeping Starter Clutch), SBC (Stand By Control)" UBYTE _CNV_S_5_STATE_MOD__65_CM 1 100. 0. 7. DISPLAY_IDENTIFIER STATE_MOD_GB ECU_ADDRESS 0x3fe092 /end MEASUREMENT
/begin MEASUREMENT state_tcs_can "status traction control system via CAN" UBYTE _CNV_S_6_STATE_TCS__66_CM 1 100. 0. 7. DISPLAY_IDENTIFIER STATE_TCS_CAN ECU_ADDRESS 0x3fe0c1 /end MEASUREMENT
/begin MEASUREMENT state_temp_gb "State overtemperature gearbox  (AT)- request for cooling (overheating protection) via ECT" UBYTE _CNV_S_4_STATE_TEMP_67_CM 1 100. 0. 3. DISPLAY_IDENTIFIER STATE_TEMP_GB ECU_ADDRESS 0x3fe090 /end MEASUREMENT
/begin MEASUREMENT temp_gb "Temperature gearbox (AT) - request for cooling (overheating protection) via ECF" UBYTE _CNV_A_R_LINEAR_____14_CM 1 100. -40. 215. DISPLAY_IDENTIFIER TEMP_GB ECU_ADDRESS 0x3fe091 FORMAT "%3.0" /end MEASUREMENT
/begin CHARACTERISTIC c_temp_gb_sub "Default temperature for automatic gearbox in case of error TEMP_GB" VALUE 0xffe40947 _REC_VAL_20_u1 255. _CNV_A_R_LINEAR_____14_CM -40. 215. DISPLAY_IDENTIFIER C_TEMP_GB_SUB FORMAT "%3.0" /end CHARACTERISTIC
/begin MEASUREMENT vs_icl_disp "displayed vehicle speed (speedometer)" UWORD _CNV_A_R_LINEAR_____68_CM 1 100. 0. 409.4 DISPLAY_IDENTIFIER VS_ICL_DISP ECU_ADDRESS 0x3fd0cc BYTE_ORDER MSB_LAST FORMAT "%5.1" /end MEASUREMENT
/begin MEASUREMENT lv_dcc_lih_can "LV indicating DCC intervention limp home" UBYTE _CNV_S_2_RANGE______2_CM 1 100. 0. 1. DISPLAY_IDENTIFIER LV_DCC_LIH_CAN ECU_ADDRESS 0x3fe0a0 /end MEASUREMENT
/begin MEASUREMENT lv_dcc_puc_inh "inhibitation of PUC required by DCC" UBYTE _CNV_S_2_RANGE______2_CM 1 100. 0. 1. DISPLAY_IDENTIFIER LV_DCC_PUC_INH ECU_ADDRESS 0x3fe0a2 /end MEASUREMENT
/begin MEASUREMENT tq_dcc_slow_bn "torque target (slow) for DCC via CAN interface" SWORD _CNV_A_R_LINEAR_____55_CM 1 100. -1024. 1023.96875 DISPLAY_IDENTIFIER TQ_DCC_SLOW_BN ECU_ADDRESS 0x3fd0b2 BYTE_ORDER MSB_LAST FORMAT "%8.2" /end MEASUREMENT
/begin MEASUREMENT tq_dcc_fast_bn "torque target (fast) for DCC via CAN interface" SWORD _CNV_A_R_LINEAR_____55_CM 1 100. -1024. 1023.96875 DISPLAY_IDENTIFIER TQ_DCC_FAST_BN ECU_ADDRESS 0x3fd0b0 BYTE_ORDER MSB_LAST FORMAT "%8.2" /end MEASUREMENT
/begin MEASUREMENT state_etcu_intv "status traction control system via CAN" UBYTE _CNV_S_4_STATE_ETCU_69_CM 1 100. 0. 3. DISPLAY_IDENTIFIER STATE_ETCU_INTV ECU_ADDRESS 0x3fe08f /end MEASUREMENT
/begin MEASUREMENT state_dcc_intv "status torque target DCC via CAN interface" UBYTE _CNV_S_4_STATE_DCC__70_CM 1 100. 0. 3. DISPLAY_IDENTIFIER STATE_DCC_INTV ECU_ADDRESS 0x3fe083 /end MEASUREMENT
/begin MEASUREMENT state_dcc_puc_inh "status request PUC-inhibitation via CAN interface - DCC" UBYTE _CNV_S_3_STATE_DCC__71_CM 1 100. 0. 3. DISPLAY_IDENTIFIER STATE_DCC_PUC_INH ECU_ADDRESS 0x3fe084 /end MEASUREMENT
/begin MEASUREMENT state_dcc_off_req "status switch-off DCC" UBYTE _CNV_S_4_STATE_DCC__72_CM 1 100. 0. 3. DISPLAY_IDENTIFIER STATE_DCC_OFF_REQ ECU_ADDRESS 0x3fe085 /end MEASUREMENT
/begin MEASUREMENT state_dcc "Status DCC" UBYTE _CNV_S_8_STATE_DCC_73_CM 1 100. 0. 7. DISPLAY_IDENTIFIER STATE_DCC ECU_ADDRESS 0x3fe086 /end MEASUREMENT
/begin MEASUREMENT lv_dcc_off_ack "Acknowledge bit for switch-off DCC" UBYTE _CNV_S_2_RANGE______2_CM 1 100. 0. 1. DISPLAY_IDENTIFIER LV_DCC_OFF_ACK ECU_ADDRESS 0x3fe0a1 /end MEASUREMENT
/begin MEASUREMENT lv_err_tq_loss_ars_av_can "interface bit for TQ_LOSS_ARS calculation in case of error via CAN" UBYTE _CNV_S_2_RANGE______2_CM 1 100. 0. 1. DISPLAY_IDENTIFIER LV_ERR_TQ_LOSS_ARS_AV_CAN ECU_ADDRESS 0x3fe0a4 /end MEASUREMENT
/begin MEASUREMENT lv_err_tq_loss_ars_sp_can "interface bit for TQ_LOSS_ARS calculation in case of error via CAN" UBYTE _CNV_S_2_RANGE______2_CM 1 100. 0. 1. DISPLAY_IDENTIFIER LV_ERR_TQ_LOSS_ARS_SP_CAN ECU_ADDRESS 0x3fe0a3 /end MEASUREMENT
/begin MEASUREMENT lv_rly_st_can "status starter relay" UBYTE _CNV_S_2_RANGE______2_CM 1 100. 0. 1. DISPLAY_IDENTIFIER LV_RLY_ST_CAN ECU_ADDRESS 0x3fe0e3 /end MEASUREMENT
/begin MEASUREMENT lv_key_aux "status Kl. R" UBYTE _CNV_S_2_RANGE______2_CM 1 100. 0. 1. DISPLAY_IDENTIFIER LV_KEY_AUX ECU_ADDRESS 0x3fe0e4 /end MEASUREMENT
/begin MEASUREMENT tcc_can_cas "free running test cycle counter CAS (alive counter)" UBYTE _CNV_A_R_LINEAR_____22_CM 1 100. 0. 14. DISPLAY_IDENTIFIER TCC_CAN_CAS ECU_ADDRESS 0x3fe0bb FORMAT "%2.0" /end MEASUREMENT
/begin MEASUREMENT tq_tcs_fast_bn "torque target (fast) due to TCS via CAN" SWORD _CNV_A_R_LINEAR_____55_CM 1 100. -1024. 1023.96875 DISPLAY_IDENTIFIER TQ_TCS_FAST_BN ECU_ADDRESS 0x3fd0bc BYTE_ORDER MSB_LAST FORMAT "%8.2" /end MEASUREMENT
/begin MEASUREMENT tcc_can_tq_dcc "free running test cycle counter TQ_DCC (alive counter)" UBYTE _CNV_A_R_LINEAR_____22_CM 1 100. 0. 14. DISPLAY_IDENTIFIER TCC_CAN_TQ_DCC ECU_ADDRESS 0x3fe0b0 FORMAT "%2.0" /end MEASUREMENT
/begin MEASUREMENT tq_tcs_slow_bn "torque target (slow) due to TCS via CAN" SWORD _CNV_A_R_LINEAR_____55_CM 1 100. -1024. 1023.96875 DISPLAY_IDENTIFIER TQ_TCS_SLOW_BN ECU_ADDRESS 0x3fd0be BYTE_ORDER MSB_LAST FORMAT "%8.2" /end MEASUREMENT
/begin MEASUREMENT tq_gs_slow_bn "torque target (slow) for GS via CAN interface" SWORD _CNV_A_R_LINEAR_____55_CM 1 100. -1024. 1023.96875 DISPLAY_IDENTIFIER TQ_GS_SLOW_BN ECU_ADDRESS 0x3fd0c6 BYTE_ORDER MSB_LAST FORMAT "%8.2" /end MEASUREMENT
/begin MEASUREMENT tcc_can_tq_tcs "free running test cycle counter TQ_TCS (alive counter)" UBYTE _CNV_A_R_LINEAR_____22_CM 1 100. 0. 14. DISPLAY_IDENTIFIER TCC_CAN_TQ_TCS ECU_ADDRESS 0x3fe0c4 FORMAT "%2.0" /end MEASUREMENT
/begin MEASUREMENT lv_tq_dcc_inc_req "LV indicating torque increse required by DCC" UBYTE _CNV_S_2_RANGE______2_CM 1 100. 0. 1. DISPLAY_IDENTIFIER LV_TQ_DCC_INC_REQ ECU_ADDRESS 0x3fe09e /end MEASUREMENT
/begin MEASUREMENT tq_gs_fast_bn "torque target (fast) for GS via CAN interface " SWORD _CNV_A_R_LINEAR_____55_CM 1 100. -1024. 1023.96875 DISPLAY_IDENTIFIER TQ_GS_FAST_BN ECU_ADDRESS 0x3fd0c4 BYTE_ORDER MSB_LAST FORMAT "%8.2" /end MEASUREMENT
/begin MEASUREMENT tq_amt_fast_bn "torque target (fast) for AMT via CAN interface " SWORD _CNV_A_R_LINEAR_____55_CM 1 100. -1024. 1023.96875 DISPLAY_IDENTIFIER TQ_AMT_FAST_BN ECU_ADDRESS 0x3fd0c8 BYTE_ORDER MSB_LAST FORMAT "%8.2" /end MEASUREMENT
/begin MEASUREMENT tq_amt_slow_bn "torque target (slow) for AMT via CAN interface " SWORD _CNV_A_R_LINEAR_____55_CM 1 100. -1024. 1023.96875 DISPLAY_IDENTIFIER TQ_AMT_SLOW_BN ECU_ADDRESS 0x3fd0ca BYTE_ORDER MSB_LAST FORMAT "%8.2" /end MEASUREMENT
/begin MEASUREMENT tcc_can_tq_etcu "free running test cycle counter TQ_ETCU (alive counter)" UBYTE _CNV_A_R_LINEAR_____22_CM 1 100. 0. 14. DISPLAY_IDENTIFIER TCC_CAN_TQ_ETCU ECU_ADDRESS 0x3fe0c8 FORMAT "%2.0" /end MEASUREMENT
/begin MEASUREMENT state_etcu_obd_err "status OBD-relevamt error - ETCU" UBYTE _CNV_S_3_STATE_ETCU_74_CM 1 100. 0. 2. DISPLAY_IDENTIFIER STATE_ETCU_OBD_ERR ECU_ADDRESS 0x3fe08e /end MEASUREMENT
/begin MEASUREMENT state_amt_intv "status torque target AMT via CAN" UBYTE _CNV_S_4_STATE_ETCU_69_CM 1 100. 0. 3. DISPLAY_IDENTIFIER STATE_AMT_INTV ECU_ADDRESS 0x3fe094 /end MEASUREMENT
/begin MEASUREMENT state_acin_can "state air-conditioning request signal CAN" UBYTE _CNV_A_R_LINEAR_____0_CM 1 100. 0. 7. DISPLAY_IDENTIFIER STATE_ACIN_CAN ECU_ADDRESS 0x3fe0d3 FORMAT "%1.0" /end MEASUREMENT
/begin MEASUREMENT ctr_km_bn "vehicle kilometer BN reading from Kombi - for OBD" ULONG _CNV_A_R_LINEAR_____75_CM 1 100. 0. 16777215. DISPLAY_IDENTIFIER CTR_KM_BN ECU_ADDRESS 0x3fbed8 BYTE_ORDER MSB_LAST FORMAT "%8.0" /end MEASUREMENT
/begin MEASUREMENT tcc_can_tq_amt "free running test cycle counter TQ_AMT (alive counter)" UBYTE _CNV_A_R_LINEAR_____22_CM 1 100. 0. 14. DISPLAY_IDENTIFIER TCC_CAN_TQ_AMT ECU_ADDRESS 0x3fe0cc FORMAT "%2.0" /end MEASUREMENT
/begin MEASUREMENT t_ctr_swi_off_vb "shutdown counter battery-main-switch" UBYTE _CNV_A_R_LINEAR_____30_CM 1 100. 0. 255. DISPLAY_IDENTIFIER T_CTR_SWI_OFF_VB ECU_ADDRESS 0x3fe09d FORMAT "%3.0" /end MEASUREMENT
/begin MEASUREMENT ctrgenms "target generator voltage " UBYTE _CNV_R_R_spg_gencan_76_CM 1 100. 10.6 16.975 ECU_ADDRESS 0x3fe099 FORMAT "%8.4" /end MEASUREMENT
/begin MEASUREMENT n_idlms "request IS-increase" UBYTE _CNV_A_R_LINEAR_____0_CM 1 100. 0. 255. ECU_ADDRESS 0x3fe098 FORMAT "%3.0" /end MEASUREMENT
/begin CHARACTERISTIC c_t_ctr_swi_off_vb_min "Threshold shutdown counter battery-main-switch" VALUE 0xffe40867 _REC_VAL_20_u1 255. _CNV_A_R_LINEAR_____30_CM 0. 255. DISPLAY_IDENTIFIER C_T_CTR_SWI_OFF_VB_MIN FORMAT "%3.0" /end CHARACTERISTIC
/begin CHARACTERISTIC c_v_sp_gen "Generator voltage (substitute value in case of  invalid signal from CAN)" VALUE 0xffe409a0 _REC_VAL_20_u1 6.375000000000003 _CNV_R_R_spg_gencan_76_CM 10.6 16.975 DISPLAY_IDENTIFIER C_V_SP_GEN FORMAT "%8.4" /end CHARACTERISTIC
/begin MEASUREMENT tcc_can_icl "free running test cycle counter instrument cluster (alive counter)" UBYTE _CNV_A_R_LINEAR_____22_CM 1 100. 0. 14. DISPLAY_IDENTIFIER TCC_CAN_ICL ECU_ADDRESS 0x3fe0d5 FORMAT "%2.0" /end MEASUREMENT
/begin MEASUREMENT tcc_can_msw "alive counter MSW - SZL" UBYTE _CNV_A_R_LINEAR_____22_CM 1 100. 0. 14. DISPLAY_IDENTIFIER TCC_CAN_MSW ECU_ADDRESS 0x3fe0d0 FORMAT "%2.0" /end MEASUREMENT
/begin MEASUREMENT state_bn_msw "Status MSW BN (CAN)" UBYTE _CNV_S_13_STATE_BN_M_77_CM 1 100. 0. 127. DISPLAY_IDENTIFIER STATE_BN_MSW ECU_ADDRESS 0x3fe096 /end MEASUREMENT
/begin MEASUREMENT lv_err_ang_pste_can "interface bit for TQ_LOSS_PSTE calculation in case of error via CAN" UBYTE _CNV_S_2_RANGE______2_CM 1 100. 0. 1. DISPLAY_IDENTIFIER LV_ERR_ANG_PSTE_CAN ECU_ADDRESS 0x3fe0a8 /end MEASUREMENT
/begin MEASUREMENT lv_temp_eng_1 "engine temperature - pre-indication overtemperature" UBYTE _CNV_S_2_RANGE______2_CM 1 100. 0. 1. DISPLAY_IDENTIFIER LV_TEMP_ENG_1 ECU_ADDRESS 0x3fe0e5 /end MEASUREMENT
/begin MEASUREMENT lv_temp_eng_2 "engine temperature - indication overtemperature" UBYTE _CNV_S_2_RANGE______2_CM 1 100. 0. 1. DISPLAY_IDENTIFIER LV_TEMP_ENG_2 ECU_ADDRESS 0x3fe0e6 /end MEASUREMENT
/begin MEASUREMENT lv_toil_gs "Request GS due to high TOIL" UBYTE _CNV_S_2_RANGE______2_CM 1 100. 0. 1. DISPLAY_IDENTIFIER LV_TOIL_GS ECU_ADDRESS 0x3fe0e7 /end MEASUREMENT
/begin MEASUREMENT tcc_can_ecu "free running test cycle counter ECU1 (alive counter)" UBYTE _CNV_A_R_LINEAR_____22_CM 1 100. 0. 14. DISPLAY_IDENTIFIER TCC_CAN_ECU ECU_ADDRESS 0x3fe0d9 FORMAT "%2.0" /end MEASUREMENT
/begin MEASUREMENT tcc_can_ecu1 "free running test cycle counter ECU1 (alive counter)" UBYTE _CNV_A_R_LINEAR_____22_CM 1 100. 0. 14. DISPLAY_IDENTIFIER TCC_CAN_ECU1 ECU_ADDRESS 0x3fe0da FORMAT "%2.0" /end MEASUREMENT
/begin MEASUREMENT tcc_can_ecu2 "free running test cycle counter ECU2 (alive counter)" UBYTE _CNV_A_R_LINEAR_____22_CM 1 100. 0. 14. DISPLAY_IDENTIFIER TCC_CAN_ECU2 ECU_ADDRESS 0x3fe0db FORMAT "%2.0" /end MEASUREMENT
/begin MEASUREMENT tcc_can_ecu3 "free running test cycle counter ECU3 (alive counter)" UBYTE _CNV_A_R_LINEAR_____22_CM 1 100. 0. 14. DISPLAY_IDENTIFIER TCC_CAN_ECU3 ECU_ADDRESS 0x3fe0dc FORMAT "%2.0" /end MEASUREMENT
/begin CHARACTERISTIC c_icl_disp_frq "calibratable constant for display messages on ICL" VALUE 0xffe4075d _REC_VAL_20_u1 3. _CNV_A_R_LINEAR_____0_CM 0. 3. DISPLAY_IDENTIFIER C_ICL_DISP_FRQ FORMAT "%2.0" /end CHARACTERISTIC
/begin CHARACTERISTIC c_toil_gs_max "Temperature threshold for actuating the pre-warning light (orange) for overtemperature " VALUE 0xffe4096e _REC_VAL_20_u1 200. _CNV_A_R_LINEAR_____14_CM -40. 160. DISPLAY_IDENTIFIER C_TOIL_GS_MAX FORMAT "%3.0" /end CHARACTERISTIC
/begin CHARACTERISTIC c_tco_chk_ctl_1 "Temperature threshold for actuating the pre-warning light (orange) for overtemperature " VALUE 0xffe408ee _REC_VAL_20_u1 190.5 _CNV_A_R_LINEAR_____11_CM -48. 142.5 DISPLAY_IDENTIFIER C_TCO_CHK_CTL_1 FORMAT "%5.1" /end CHARACTERISTIC
/begin CHARACTERISTIC c_tco_chk_ctl_2 "Temperature threshold for actuating the warning light (red) for overtemperature " VALUE 0xffe408ef _REC_VAL_20_u1 190.5 _CNV_A_R_LINEAR_____11_CM -48. 142.5 DISPLAY_IDENTIFIER C_TCO_CHK_CTL_2 FORMAT "%5.1" /end CHARACTERISTIC
/begin CHARACTERISTIC c_tco_sum_hys_1 "Hysteresis for temperature threshold C_TCO_CHK_CTL_1" VALUE 0xffe40931 _REC_VAL_20_u1 190.5 _CNV_A_R_LINEAR_____12_CM 0. 190.5 DISPLAY_IDENTIFIER C_TCO_SUM_HYS_1 FORMAT "%5.1" /end CHARACTERISTIC
/begin CHARACTERISTIC c_tco_sum_hys_2 "Hysteresis for temperature threshold C_TCO_CHK_CTL_2" VALUE 0xffe40932 _REC_VAL_20_u1 190.5 _CNV_A_R_LINEAR_____12_CM 0. 190.5 DISPLAY_IDENTIFIER C_TCO_SUM_HYS_2 FORMAT "%5.1" /end CHARACTERISTIC
/begin CHARACTERISTIC c_tq_max_acc "torque limitation for torque loss ACC" VALUE 0xffe4098c _REC_VAL_20_u1 127. _CNV_A_R_LINEAR_____78_CM 0. 127. DISPLAY_IDENTIFIER C_TQ_MAX_ACC FORMAT "%5.1" /end CHARACTERISTIC
/begin MEASUREMENT tcc_can_ars "free running test cycle counter ARS (alive counter)" UBYTE _CNV_A_R_LINEAR_____22_CM 1 100. 0. 14. DISPLAY_IDENTIFIER TCC_CAN_ARS ECU_ADDRESS 0x3fe0b6 FORMAT "%2.0" /end MEASUREMENT
/begin MEASUREMENT lv_etcu_lih_can "logical variable ETCU gear shift intervention limp home" UBYTE _CNV_S_2_RANGE______2_CM 1 100. 0. 1. DISPLAY_IDENTIFIER LV_ETCU_LIH_CAN ECU_ADDRESS 0x3fe0a6 /end MEASUREMENT
/begin MEASUREMENT lv_amt_lih_can "logical variable AMT intervention limp home" UBYTE _CNV_S_2_RANGE______2_CM 1 100. 0. 1. DISPLAY_IDENTIFIER LV_AMT_LIH_CAN ECU_ADDRESS 0x3fe0a7 /end MEASUREMENT
/begin MEASUREMENT state_st_tq_lim_gs "State starting torque limitation" UBYTE _CNV_S_3_STATE_ST_T_79_CM 1 100. 0. 3. DISPLAY_IDENTIFIER STATE_ST_TQ_LIM_GS ECU_ADDRESS 0x3fe093 /end MEASUREMENT
/begin MEASUREMENT state_st_tq_lim_amt "State starting torque limitation for AMT" UBYTE _CNV_S_3_STATE_ST_T_79_CM 1 100. 0. 3. DISPLAY_IDENTIFIER STATE_ST_TQ_LIM_AMT ECU_ADDRESS 0x3fe095 /end MEASUREMENT
/begin MEASUREMENT lv_var_etcu "BN(SSG or EGS)-transmission recognized" UBYTE _CNV_S_2_RANGE______2_CM 1 100. 0. 1. DISPLAY_IDENTIFIER LV_VAR_ETCU ECU_ADDRESS 0x3fe70a /end MEASUREMENT
/begin MEASUREMENT lv_var_bn_msw "LV cruise control detected - BN2000" UBYTE _CNV_S_2_RANGE______2_CM 1 100. 0. 1. DISPLAY_IDENTIFIER LV_VAR_BN_MSW ECU_ADDRESS 0x3fe708 /end MEASUREMENT
/begin MEASUREMENT lv_var_dcc "LV distance cruise control detected - BN2000" UBYTE _CNV_S_2_RANGE______2_CM 1 100. 0. 1. DISPLAY_IDENTIFIER LV_VAR_DCC ECU_ADDRESS 0x3fe709 /end MEASUREMENT
/begin MEASUREMENT lv_var_ars "LV anti-roll-stabilisation detected - BN2000" UBYTE _CNV_S_2_RANGE______2_CM 1 100. 0. 1. DISPLAY_IDENTIFIER LV_VAR_ARS ECU_ADDRESS 0x3fe707 /end MEASUREMENT
/begin MEASUREMENT state_veh_mod "vehicle mode" UBYTE _CNV_A_R_LINEAR_____0_CM 1 100. 0. 15. DISPLAY_IDENTIFIER STATE_VEH_MOD ECU_ADDRESS 0x3fe08a FORMAT "%2.0" /end MEASUREMENT
/begin CHARACTERISTIC c_cc_mess "ID2 check-control message standard ID2_CC_MESS_STD (Standard CC-report)" VALUE 0xffe40652 _REC_VAL_20_u1 255. _CNV_A_R_LINEAR_____0_CM 0. 255. DISPLAY_IDENTIFIER C_CC_MESS FORMAT "%3.0" /end CHARACTERISTIC
/begin MEASUREMENT state_vs_icl_disp "status scaling of speedometer (displayed vehicle speed)" UBYTE _CNV_S_3_STATE_VS_I_80_CM 1 100. 0. 3. DISPLAY_IDENTIFIER STATE_VS_ICL_DISP ECU_ADDRESS 0x3fe081 /end MEASUREMENT
/begin MEASUREMENT tcc_can_veh_mod "free running test cycle counter VEH_MOD (alive counter)" UBYTE _CNV_A_R_LINEAR_____22_CM 1 100. 0. 14. DISPLAY_IDENTIFIER TCC_CAN_VEH_MOD ECU_ADDRESS 0x3fe0bf FORMAT "%2.0" /end MEASUREMENT
/begin MEASUREMENT state_if_icl_bn_msw "status interface ICL/cruise control" UBYTE _CNV_A_R_LINEAR_____0_CM 1 100. 0. 7. DISPLAY_IDENTIFIER STATE_IF_ICL_BN_MSW ECU_ADDRESS 0x3fe082 FORMAT "%1.0" /end MEASUREMENT
/begin MEASUREMENT cc_id "Checkcontrol ID" UWORD _CNV_A_R_LINEAR_____0_CM 1 100. 0. 65535. DISPLAY_IDENTIFIER CC_ID ECU_ADDRESS 0x3fd0e4 BYTE_ORDER MSB_LAST FORMAT "%5.0" /end MEASUREMENT
/begin MEASUREMENT lv_mil_fll "bit for MIL flash light" UBYTE _CNV_S_2_RANGE______2_CM 1 100. 0. 1. DISPLAY_IDENTIFIER LV_MIL_FLL ECU_ADDRESS 0x3fe0ea /end MEASUREMENT
/begin CHARACTERISTIC c_tq_accin "Minimum torque ACCIN" VALUE 0xffe40989 _REC_VAL_20_u1 127. _CNV_A_R_LINEAR_____78_CM 0. 127. DISPLAY_IDENTIFIER C_TQ_ACCIN FORMAT "%5.1" /end CHARACTERISTIC
/begin MEASUREMENT tq_ems_bn "actual engine torque - driver's choice (converted for BN)" SWORD _CNV_A_R_LINEAR_____55_CM 1 100. -1024. 1023.96875 DISPLAY_IDENTIFIER TQ_EMS_BN ECU_ADDRESS 0x3fd0dc BYTE_ORDER MSB_LAST FORMAT "%8.2" /end MEASUREMENT
/begin MEASUREMENT tq_maf "actual engine torque - spare, positive (converted for BN)" SWORD _CNV_A_R_LINEAR_____55_CM 1 100. -1024. 1023.96875 DISPLAY_IDENTIFIER TQ_MAF ECU_ADDRESS 0x3fd0d6 BYTE_ORDER MSB_LAST FORMAT "%8.2" /end MEASUREMENT
/begin CHARACTERISTIC c_n_32_thd_cc_poil_swi "N_32-Threshold for activating CC-message LV_POIL_SWI" VALUE 0xffe407c7 _REC_VAL_20_u1 8160. _CNV_A_R_LINEAR_____15_CM 0. 8160. DISPLAY_IDENTIFIER C_N_32_THD_CC_POIL_SWI FORMAT "%4.0" /end CHARACTERISTIC
/begin CHARACTERISTIC ip_t_dly_poil_swi_can__toil "Delay-time for first activation of CC-message LV_POIL_SWI" CURVE 0xffe4e86a _REC_CUR_20_u2_u1 6553.5 _CNV_A_R_LINEAR_____24_CM 0. 6553.5 DISPLAY_IDENTIFIER IP_T_DLY_POIL_SWI_CAN__TOIL FORMAT "%6.1"
 /begin AXIS_DESCR COM_AXIS toil _CNV_A_R_LINEAR_____14_CM 6 -40. 160. FORMAT "%3.0" AXIS_PTS_REF ldp_toil__t_dly_poil_swi_can /end AXIS_DESCR
/end CHARACTERISTIC
/begin AXIS_PTS ldp_toil__t_dly_poil_swi_can "" 0xffe412bc toil _REC_AXS_20_u1 200. _CNV_A_R_LINEAR_____14_CM 6 -40. 160. DISPLAY_IDENTIFIER LDP_TOIL__T_DLY_POIL_SWI_CAN FORMAT "%3.0" /end AXIS_PTS
/begin CHARACTERISTIC c_n_sp_is_thd_can "engine speed setpoint threshold for reconition of ST_SW_LEV_RPM condition" VALUE 0xffe41838 _REC_VAL_20_u2 8159. _CNV_A_R_LINEAR_____10_CM 1. 8160. DISPLAY_IDENTIFIER C_N_SP_IS_THD_CAN FORMAT "%4.0" /end CHARACTERISTIC
/begin MEASUREMENT tcc_can_tq_pste_2 "free running test cycle counter TQ_PSTE_2 (alive counter)" UBYTE _CNV_A_R_LINEAR_____22_CM 1 100. 0. 14. DISPLAY_IDENTIFIER TCC_CAN_TQ_PSTE_2 ECU_ADDRESS 0x3fe0b4 FORMAT "%2.0" /end MEASUREMENT
/begin MEASUREMENT state_pste_2_intv "status torque target PSTE_2 via CAN interface" UBYTE _CNV_S_4_STATE_PSTE_81_CM 1 100. 0. 3. DISPLAY_IDENTIFIER STATE_PSTE_2_INTV ECU_ADDRESS 0x3fe087 /end MEASUREMENT
/begin MEASUREMENT tq_loss_pste_2_av_can "torque loss actual value PSTE_2 from CAN" SWORD _CNV_A_R_LINEAR_____55_CM 1 100. -1024. 1023.96875 DISPLAY_IDENTIFIER TQ_LOSS_PSTE_2_AV_CAN ECU_ADDRESS 0x3fd0b4 BYTE_ORDER MSB_LAST FORMAT "%8.2" /end MEASUREMENT
/begin MEASUREMENT tq_loss_pste_2_sp_can "torque loss setpoint PSTE_2 from CAN" SWORD _CNV_A_R_LINEAR_____55_CM 1 100. -1024. 1023.96875 DISPLAY_IDENTIFIER TQ_LOSS_PSTE_2_SP_CAN ECU_ADDRESS 0x3fd0b6 BYTE_ORDER MSB_LAST FORMAT "%8.2" /end MEASUREMENT
/begin MEASUREMENT lv_pste_2_err "LV indicating AFS error (sent by AFS via CAN)" UBYTE _CNV_S_2_RANGE______2_CM 1 100. 0. 1. DISPLAY_IDENTIFIER LV_PSTE_2_ERR ECU_ADDRESS 0x3fe0aa /end MEASUREMENT
/begin MEASUREMENT state_brake_prs "status brake pressure via CAN" UBYTE _CNV_A_R_LINEAR_____0_CM 1 100. 0. 3. DISPLAY_IDENTIFIER STATE_BRAKE_PRS ECU_ADDRESS 0x3fe097 FORMAT "%1.0" /end MEASUREMENT
/begin MEASUREMENT lv_var_pste_2 "LV power steering detected - BN2000" UBYTE _CNV_S_2_RANGE______2_CM 1 100. 0. 1. DISPLAY_IDENTIFIER LV_VAR_PSTE_2 ECU_ADDRESS 0x3fe70b /end MEASUREMENT
/begin MEASUREMENT state_cru_bn "Status of Cruise Control for BN-CAN" UBYTE _CNV_A_R_LINEAR_____0_CM 1 100. 0. 255. DISPLAY_IDENTIFIER STATE_CRU_BN ECU_ADDRESS 0x3fe0e0 FORMAT "%3.0" /end MEASUREMENT
/begin MEASUREMENT ctr_diag_tcc_can_cas "Diagnosis counter for alive counter error symptom detection" UBYTE _CNV_A_R_LINEAR_____0_CM 1 100. 0. 255. DISPLAY_IDENTIFIER CTR_DIAG_TCC_CAN_CAS ECU_ADDRESS 0x3fe121 FORMAT "%3.0" /end MEASUREMENT
/begin MEASUREMENT ctr_diag_tcc_can_tq_tcs "Diagnosis counter for alive counter error symptom detection" UBYTE _CNV_A_R_LINEAR_____0_CM 1 100. 0. 255. DISPLAY_IDENTIFIER CTR_DIAG_TCC_CAN_TQ_TCS ECU_ADDRESS 0x3fe106 FORMAT "%3.0" /end MEASUREMENT
/begin MEASUREMENT ctr_diag_tcc_can_tq_etcu "Diagnosis counter for alive counter error symptom detection" UBYTE _CNV_A_R_LINEAR_____0_CM 1 100. 0. 255. DISPLAY_IDENTIFIER CTR_DIAG_TCC_CAN_TQ_ETCU ECU_ADDRESS 0x3fe109 FORMAT "%3.0" /end MEASUREMENT
/begin MEASUREMENT ctr_diag_tcc_can_tq_amt "Diagnosis counter for alive counter error symptom detection" UBYTE _CNV_A_R_LINEAR_____0_CM 1 100. 0. 255. DISPLAY_IDENTIFIER CTR_DIAG_TCC_CAN_TQ_AMT ECU_ADDRESS 0x3fe115 FORMAT "%3.0" /end MEASUREMENT
/begin MEASUREMENT ctr_diag_tcc_can_icl "Diagnosis counter for alive counter error symptom detection" UBYTE _CNV_A_R_LINEAR_____0_CM 1 100. 0. 255. DISPLAY_IDENTIFIER CTR_DIAG_TCC_CAN_ICL ECU_ADDRESS 0x3fe127 FORMAT "%3.0" /end MEASUREMENT
/begin MEASUREMENT ctr_diag_tcc_can_ars "Diagnosis counter for alive counter error symptom detection" UBYTE _CNV_A_R_LINEAR_____0_CM 1 100. 0. 255. DISPLAY_IDENTIFIER CTR_DIAG_TCC_CAN_ARS ECU_ADDRESS 0x3fe118 FORMAT "%3.0" /end MEASUREMENT
/begin MEASUREMENT ctr_diag_tcc_can_msw "Diagnosis counter for alive counter error symptom detection" UBYTE _CNV_A_R_LINEAR_____0_CM 1 100. 0. 255. DISPLAY_IDENTIFIER CTR_DIAG_TCC_CAN_MSW ECU_ADDRESS 0x3fe124 FORMAT "%3.0" /end MEASUREMENT
/begin MEASUREMENT ctr_diag_tcc_can_tq_dcc "Diagnosis counter for alive counter error symptom detection" UBYTE _CNV_A_R_LINEAR_____0_CM 1 100. 0. 255. DISPLAY_IDENTIFIER CTR_DIAG_TCC_CAN_TQ_DCC ECU_ADDRESS 0x3fe100 FORMAT "%3.0" /end MEASUREMENT
/begin MEASUREMENT ctr_diag_cks_cas "Diagnosis counter for checksum counter error symptom detection" UBYTE _CNV_A_R_LINEAR_____0_CM 1 100. 0. 255. DISPLAY_IDENTIFIER CTR_DIAG_CKS_CAS ECU_ADDRESS 0x3fe122 FORMAT "%3.0" /end MEASUREMENT
/begin MEASUREMENT ctr_diag_cks_tq_tcs "Diagnosis counter for checksum counter error symptom detection" UBYTE _CNV_A_R_LINEAR_____0_CM 1 100. 0. 255. DISPLAY_IDENTIFIER CTR_DIAG_CKS_TQ_TCS ECU_ADDRESS 0x3fe107 FORMAT "%3.0" /end MEASUREMENT
/begin MEASUREMENT ctr_diag_cks_tq_etcu "Diagnosis counter for checksum counter error symptom detection" UBYTE _CNV_A_R_LINEAR_____0_CM 1 100. 0. 255. DISPLAY_IDENTIFIER CTR_DIAG_CKS_TQ_ETCU ECU_ADDRESS 0x3fe10a FORMAT "%3.0" /end MEASUREMENT
/begin MEASUREMENT ctr_diag_cks_tq_amt "Diagnosis counter for checksum counter error symptom detection" UBYTE _CNV_A_R_LINEAR_____0_CM 1 100. 0. 255. DISPLAY_IDENTIFIER CTR_DIAG_CKS_TQ_AMT ECU_ADDRESS 0x3fe116 FORMAT "%3.0" /end MEASUREMENT
/begin MEASUREMENT ctr_diag_cks_msw "Diagnosis counter for checksum counter error symptom detection" UBYTE _CNV_A_R_LINEAR_____0_CM 1 100. 0. 255. DISPLAY_IDENTIFIER CTR_DIAG_CKS_MSW ECU_ADDRESS 0x3fe125 FORMAT "%3.0" /end MEASUREMENT
/begin MEASUREMENT ctr_diag_cks_tq_dcc "Diagnosis counter for checksum counter error symptom detection" UBYTE _CNV_A_R_LINEAR_____0_CM 1 100. 0. 255. DISPLAY_IDENTIFIER CTR_DIAG_CKS_TQ_DCC ECU_ADDRESS 0x3fe101 FORMAT "%3.0" /end MEASUREMENT
/begin MEASUREMENT ctr_diag_tout_ars "Diagnosis counter for timeout counter error symptom detection" UBYTE _CNV_A_R_LINEAR_____0_CM 1 100. 0. 255. DISPLAY_IDENTIFIER CTR_DIAG_TOUT_ARS ECU_ADDRESS 0x3fe11a FORMAT "%3.0" /end MEASUREMENT
/begin MEASUREMENT ctr_diag_tout_cas "Diagnosis counter for timeout counter error symptom detection" UBYTE _CNV_A_R_LINEAR_____0_CM 1 100. 0. 255. DISPLAY_IDENTIFIER CTR_DIAG_TOUT_CAS ECU_ADDRESS 0x3fe123 FORMAT "%3.0" /end MEASUREMENT
/begin MEASUREMENT ctr_diag_tout_tq_tcs "Diagnosis counter for timeout counter error symptom detection" UBYTE _CNV_A_R_LINEAR_____0_CM 1 100. 0. 255. DISPLAY_IDENTIFIER CTR_DIAG_TOUT_TQ_TCS ECU_ADDRESS 0x3fe108 FORMAT "%3.0" /end MEASUREMENT
/begin MEASUREMENT ctr_diag_tout_vs_tcs "Diagnosis counter for timeout counter error symptom detection" UBYTE _CNV_A_R_LINEAR_____0_CM 1 100. 0. 255. DISPLAY_IDENTIFIER CTR_DIAG_TOUT_VS_TCS ECU_ADDRESS 0x3fe114 FORMAT "%3.0" /end MEASUREMENT
/begin MEASUREMENT ctr_diag_tout_tcs "Diagnosis counter for timeout counter error symptom detection" UBYTE _CNV_A_R_LINEAR_____0_CM 1 100. 0. 255. DISPLAY_IDENTIFIER CTR_DIAG_TOUT_TCS ECU_ADDRESS 0x3fe11d FORMAT "%3.0" /end MEASUREMENT
/begin MEASUREMENT ctr_diag_tout_tq_etcu "Diagnosis counter for timeout counter error symptom detection" UBYTE _CNV_A_R_LINEAR_____0_CM 1 100. 0. 255. DISPLAY_IDENTIFIER CTR_DIAG_TOUT_TQ_ETCU ECU_ADDRESS 0x3fe10b FORMAT "%3.0" /end MEASUREMENT
/begin MEASUREMENT ctr_diag_tout_etcu "Diagnosis counter for timeout counter error symptom detection" UBYTE _CNV_A_R_LINEAR_____0_CM 1 100. 0. 255. DISPLAY_IDENTIFIER CTR_DIAG_TOUT_ETCU ECU_ADDRESS 0x3fe10e FORMAT "%3.0" /end MEASUREMENT
/begin MEASUREMENT ctr_diag_tout_tq_amt "Diagnosis counter for timeout counter error symptom detection" UBYTE _CNV_A_R_LINEAR_____0_CM 1 100. 0. 255. DISPLAY_IDENTIFIER CTR_DIAG_TOUT_TQ_AMT ECU_ADDRESS 0x3fe117 FORMAT "%3.0" /end MEASUREMENT
/begin MEASUREMENT ctr_diag_tout_tq_dcc "Diagnosis counter for timeout counter error symptom detection" UBYTE _CNV_A_R_LINEAR_____0_CM 1 100. 0. 255. DISPLAY_IDENTIFIER CTR_DIAG_TOUT_TQ_DCC ECU_ADDRESS 0x3fe102 FORMAT "%3.0" /end MEASUREMENT
/begin MEASUREMENT ctr_diag_tout_acc "Diagnosis counter for timeout counter error symptom detection" UBYTE _CNV_A_R_LINEAR_____0_CM 1 100. 0. 255. DISPLAY_IDENTIFIER CTR_DIAG_TOUT_ACC ECU_ADDRESS 0x3fe12c FORMAT "%3.0" /end MEASUREMENT
/begin MEASUREMENT ctr_diag_tout_km_icl "Diagnosis counter for timeout counter error symptom detection" UBYTE _CNV_A_R_LINEAR_____0_CM 1 100. 0. 255. DISPLAY_IDENTIFIER CTR_DIAG_TOUT_KM_ICL ECU_ADDRESS 0x3fe135 FORMAT "%3.0" /end MEASUREMENT
/begin MEASUREMENT ctr_diag_tout_icl "Diagnosis counter for timeout counter error symptom detection" UBYTE _CNV_A_R_LINEAR_____0_CM 1 100. 0. 255. DISPLAY_IDENTIFIER CTR_DIAG_TOUT_ICL ECU_ADDRESS 0x3fe129 FORMAT "%3.0" /end MEASUREMENT
/begin MEASUREMENT ctr_diag_tout_pow_vb "Diagnosis counter for timeout counter error symptom detection" UBYTE _CNV_A_R_LINEAR_____0_CM 1 100. 0. 255. DISPLAY_IDENTIFIER CTR_DIAG_TOUT_POW_VB ECU_ADDRESS 0x3fe13e FORMAT "%3.0" /end MEASUREMENT
/begin MEASUREMENT ctr_diag_tout_pow_gen "Diagnosis counter for timeout counter error symptom detection" UBYTE _CNV_A_R_LINEAR_____0_CM 1 100. 0. 255. DISPLAY_IDENTIFIER CTR_DIAG_TOUT_POW_GEN ECU_ADDRESS 0x3fe138 FORMAT "%3.0" /end MEASUREMENT
/begin MEASUREMENT ctr_diag_tout_msw "Diagnosis counter for timeout counter error symptom detection" UBYTE _CNV_A_R_LINEAR_____0_CM 1 100. 0. 255. DISPLAY_IDENTIFIER CTR_DIAG_TOUT_MSW ECU_ADDRESS 0x3fe126 FORMAT "%3.0" /end MEASUREMENT
/begin MEASUREMENT ctr_diag_tout_t_icl "Diagnosis counter for timeout counter error symptom detection" UBYTE _CNV_A_R_LINEAR_____0_CM 1 100. 0. 255. DISPLAY_IDENTIFIER CTR_DIAG_TOUT_T_ICL ECU_ADDRESS 0x3fe12f FORMAT "%3.0" /end MEASUREMENT
/begin MEASUREMENT ctr_diag_tout_ang_pste "Diagnosis counter for timeout counter error symptom detection" UBYTE _CNV_A_R_LINEAR_____0_CM 1 100. 0. 255. DISPLAY_IDENTIFIER CTR_DIAG_TOUT_ANG_PSTE ECU_ADDRESS 0x3fe111 FORMAT "%3.0" /end MEASUREMENT
/begin MEASUREMENT ctr_diag_tcc_can_veh_mod "Diagnosis counter for alive counter error symptom detection" UBYTE _CNV_A_R_LINEAR_____0_CM 1 100. 0. 255. DISPLAY_IDENTIFIER CTR_DIAG_TCC_CAN_VEH_MOD ECU_ADDRESS 0x3fe130 FORMAT "%3.0" /end MEASUREMENT
/begin MEASUREMENT ctr_diag_cks_veh_mod "Diagnosis counter for checksum counter error symptom detection" UBYTE _CNV_A_R_LINEAR_____0_CM 1 100. 0. 255. DISPLAY_IDENTIFIER CTR_DIAG_CKS_VEH_MOD ECU_ADDRESS 0x3fe131 FORMAT "%3.0" /end MEASUREMENT
/begin MEASUREMENT ctr_diag_tout_veh_mod "Diagnosis counter for timeout counter error symptom detection" UBYTE _CNV_A_R_LINEAR_____0_CM 1 100. 0. 255. DISPLAY_IDENTIFIER CTR_DIAG_TOUT_VEH_MOD ECU_ADDRESS 0x3fe132 FORMAT "%3.0" /end MEASUREMENT
/begin MEASUREMENT ctr_diag_tcc_can_tq_pste_2 "Diagnosis counter for alive counter error symptom detection" UBYTE _CNV_A_R_LINEAR_____0_CM 1 100. 0. 255. DISPLAY_IDENTIFIER CTR_DIAG_TCC_CAN_TQ_PSTE_2 ECU_ADDRESS 0x3fe103 FORMAT "%3.0" /end MEASUREMENT
/begin MEASUREMENT ctr_diag_cks_tq_pste_2 "Diagnosis counter for checksum counter error symptom detection" UBYTE _CNV_A_R_LINEAR_____0_CM 1 100. 0. 255. DISPLAY_IDENTIFIER CTR_DIAG_CKS_TQ_PSTE_2 ECU_ADDRESS 0x3fe104 FORMAT "%3.0" /end MEASUREMENT
/begin MEASUREMENT ctr_diag_tout_tq_pste_2 "Diagnosis counter for timeout counter error symptom detection" UBYTE _CNV_A_R_LINEAR_____0_CM 1 100. 0. 255. DISPLAY_IDENTIFIER CTR_DIAG_TOUT_TQ_PSTE_2 ECU_ADDRESS 0x3fe105 FORMAT "%3.0" /end MEASUREMENT
/begin MEASUREMENT ctr_diag_tout_efp "Diagnosis counter for timeout counter error symptom detection" UBYTE _CNV_A_R_LINEAR_____0_CM 1 100. 0. 255. DISPLAY_IDENTIFIER CTR_DIAG_TOUT_EFP ECU_ADDRESS 0x3fe13b FORMAT "%3.0" /end MEASUREMENT
/begin MEASUREMENT lv_err_bn_acc "Present error BN2000" UBYTE _CNV_S_2_RANGE______1_R_CM 1 100. 0. 255. DISPLAY_IDENTIFIER LV_ERR_BN_ACC ECU_ADDRESS 0x3fbad4 /end MEASUREMENT
/begin MEASUREMENT lv_err_bn_cas "Present error BN2000" UBYTE _CNV_S_2_RANGE______1_R_CM 1 100. 0. 255. DISPLAY_IDENTIFIER LV_ERR_BN_CAS ECU_ADDRESS 0x3fbab8 /end MEASUREMENT
/begin MEASUREMENT lv_err_bn_icl "Present error BN2000" UBYTE _CNV_S_2_RANGE______1_R_CM 1 100. 0. 255. DISPLAY_IDENTIFIER LV_ERR_BN_ICL ECU_ADDRESS 0x3fbae4 /end MEASUREMENT
/begin MEASUREMENT lv_err_bn_km_icl "Present error BN2000" UBYTE _CNV_S_2_RANGE______1_R_CM 1 100. 0. 255. DISPLAY_IDENTIFIER LV_ERR_BN_KM_ICL ECU_ADDRESS 0x3fbae0 /end MEASUREMENT
/begin MEASUREMENT lv_err_bn_pow_gen "Present error BN2000" UBYTE _CNV_S_2_RANGE______1_R_CM 1 100. 0. 255. DISPLAY_IDENTIFIER LV_ERR_BN_POW_GEN ECU_ADDRESS 0x3fbaec /end MEASUREMENT
/begin MEASUREMENT lv_err_bn_pow_vb "Present error BN2000" UBYTE _CNV_S_2_RANGE______1_R_CM 1 100. 0. 255. DISPLAY_IDENTIFIER LV_ERR_BN_POW_VB ECU_ADDRESS 0x3fbae8 /end MEASUREMENT
/begin MEASUREMENT lv_err_bn_t_icl "Present error BN2000" UBYTE _CNV_S_2_RANGE______1_R_CM 1 100. 0. 255. DISPLAY_IDENTIFIER LV_ERR_BN_T_ICL ECU_ADDRESS 0x3fbad8 /end MEASUREMENT
/begin MEASUREMENT lv_err_bn_tq_pste_2 "Present error BN2000" UBYTE _CNV_S_2_RANGE______1_R_CM 1 100. 0. 255. DISPLAY_IDENTIFIER LV_ERR_BN_TQ_PSTE_2 ECU_ADDRESS 0x3fbab0 /end MEASUREMENT
/begin MEASUREMENT lv_err_bn_efp "Present error BN2000" UBYTE _CNV_S_2_RANGE______1_R_CM 1 100. 0. 255. DISPLAY_IDENTIFIER LV_ERR_BN_EFP ECU_ADDRESS 0x3fbaf8 /end MEASUREMENT
/begin MEASUREMENT tqi_msr_can "relative indicated engine torque requested by MSR" UBYTE _CNV_A_R_LINEAR_____9_CM 1 100. 0. 99.609375 DISPLAY_IDENTIFIER TQI_MSR_CAN ECU_ADDRESS 0x3fe2e1 FORMAT "%5.1" /end MEASUREMENT
/begin MEASUREMENT vs_can "vehicle speed signal from CAN" UBYTE _CNV_A_R_LINEAR_____23_CM 1 100. 0. 255. DISPLAY_IDENTIFIER VS_CAN ECU_ADDRESS 0x3fe2e3 FORMAT "%3.0" /end MEASUREMENT
/begin MEASUREMENT wheel "vehicle speed signal from CAN for cruise control" UWORD _CNV_A_R_LINEAR_____85_CM 1 100. 0. 511.99218 DISPLAY_IDENTIFIER WHEEL ECU_ADDRESS 0x3fd112 BYTE_ORDER MSB_LAST FORMAT "%7.3" /end MEASUREMENT
/begin MEASUREMENT lv_plaus_asr_ctl "logical variable for ASR intervention is active" UBYTE _CNV_S_2_RANGE______2_CM 1 100. 0. 1. DISPLAY_IDENTIFIER LV_PLAUS_ASR_CTL ECU_ADDRESS 0x3fe2e8 /end MEASUREMENT
/begin MEASUREMENT lv_plaus_esp_ctl "logical variable for DSC intervention is active" UBYTE _CNV_S_2_RANGE______2_CM 1 100. 0. 1. DISPLAY_IDENTIFIER LV_PLAUS_ESP_CTL ECU_ADDRESS 0x3fe2ea /end MEASUREMENT
/begin MEASUREMENT tqi_asr_fast_can "relative indicated engine torque requested by ASR (fast path)" UBYTE _CNV_A_R_LINEAR_____9_CM 1 100. 0. 99.609375 DISPLAY_IDENTIFIER TQI_ASR_FAST_CAN ECU_ADDRESS 0x3fe2e0 FORMAT "%5.1" /end MEASUREMENT
/begin MEASUREMENT lv_err_vs_can "logical variable for VS_CAN error" UBYTE _CNV_S_2_RANGE______1_R_CM 1 100. 0. 255. DISPLAY_IDENTIFIER LV_ERR_VS_CAN ECU_ADDRESS 0x3fe2e7 /end MEASUREMENT
/begin CHARACTERISTIC c_max_msg_miss_asr_can "maximum number of mised ASC messages (default value 10)" VALUE 0xffe4079b _REC_VAL_20_u1 255. _CNV_A_R_LINEAR_____0_CM 0. 255. DISPLAY_IDENTIFIER C_MAX_MSG_MISS_ASR_CAN FORMAT "%3.0" /end CHARACTERISTIC
/begin MEASUREMENT tqi_asr_fast_req_can "Relative indicated engine torque request by ASR (fast path)" SWORD _CNV_A_R_LINEAR_____55_CM 1 100. -1024. 1023.96875 DISPLAY_IDENTIFIER TQI_ASR_FAST_REQ_CAN ECU_ADDRESS 0x3fd10c BYTE_ORDER MSB_LAST FORMAT "%8.2" /end MEASUREMENT
/begin MEASUREMENT tqi_msr_req_can "Relative indicated engine torque request by MSR" SWORD _CNV_A_R_LINEAR_____55_CM 1 100. -1024. 1023.96875 DISPLAY_IDENTIFIER TQI_MSR_REQ_CAN ECU_ADDRESS 0x3fd10e BYTE_ORDER MSB_LAST FORMAT "%8.2" /end MEASUREMENT
/begin MEASUREMENT tqi_asr_slow_can "relative indicated engine torque requested by ASR (slow path)" UBYTE _CNV_A_R_LINEAR_____9_CM 1 100. 0. 99.609375 DISPLAY_IDENTIFIER TQI_ASR_SLOW_CAN ECU_ADDRESS 0x3fe2e2 FORMAT "%5.1" /end MEASUREMENT
/begin MEASUREMENT tqi_asr_slow_req_can "Relative indicated engine torque request by ASR (slow path)" SWORD _CNV_A_R_LINEAR_____55_CM 1 100. -1024. 1023.96875 DISPLAY_IDENTIFIER TQI_ASR_SLOW_REQ_CAN ECU_ADDRESS 0x3fd110 BYTE_ORDER MSB_LAST FORMAT "%8.2" /end MEASUREMENT
/begin MEASUREMENT lv_tq_asr_req "logical variable for ASR request" UBYTE _CNV_S_2_RANGE______2_CM 1 100. 0. 1. DISPLAY_IDENTIFIER LV_TQ_ASR_REQ ECU_ADDRESS 0x3fe2e5 /end MEASUREMENT
/begin MEASUREMENT lv_tq_msr_req "logical variable for MSR request" UBYTE _CNV_S_2_RANGE______2_CM 1 100. 0. 1. DISPLAY_IDENTIFIER LV_TQ_MSR_REQ ECU_ADDRESS 0x3fe2e6 /end MEASUREMENT
/begin MEASUREMENT brake_prs "Brake pressure" UBYTE _CNV_A_R_LINEAR_____86_CM 1 100. 0. 255. DISPLAY_IDENTIFIER BRAKE_PRS ECU_ADDRESS 0x3fe2e4 FORMAT "%3.0" /end MEASUREMENT
/begin CHARACTERISTIC c_tmot_sum_hys "Hysteresis for temperature threshold C_TCO_TMOT_STA" VALUE 0xffe4096c _REC_VAL_20_u1 190.5 _CNV_A_R_LINEAR_____12_CM 0. 190.5 DISPLAY_IDENTIFIER C_TMOT_SUM_HYS FORMAT "%5.1" /end CHARACTERISTIC
/begin CHARACTERISTIC c_t_tco_can_ast "Time condition for transmitting the coolant temperature to the CAN" VALUE 0xffe41a06 _REC_VAL_20_u2 6553.5 _CNV_A_R_LINEAR_____24_CM 0. 6553.5 DISPLAY_IDENTIFIER C_T_TCO_CAN_AST FORMAT "%6.1" /end CHARACTERISTIC
/begin CHARACTERISTIC c_tco_swi_wup "TCO condition for setting the bit S_WL" VALUE 0xffe40933 _REC_VAL_20_u1 190.5 _CNV_A_R_LINEAR_____11_CM -48. 142.5 DISPLAY_IDENTIFIER C_TCO_SWI_WUP FORMAT "%5.1" /end CHARACTERISTIC
/begin MEASUREMENT lv_ack_tcs "Logical variable TCS acknowledge" UBYTE _CNV_S_2_RANGE______2_CM 1 100. 0. 1. DISPLAY_IDENTIFIER LV_ACK_TCS ECU_ADDRESS 0x3fe306 BIT_MASK 0x1 /end MEASUREMENT
/begin CHARACTERISTIC c_t_ctr_max_asr_can "maximum value timeout counter ASC message (default value 10)" VALUE 0xffe40866 _REC_VAL_20_u1 2.55 _CNV_A_R_LINEAR_____4_CM 0. 2.55 DISPLAY_IDENTIFIER C_T_CTR_MAX_ASR_CAN FORMAT "%4.2" /end CHARACTERISTIC
/begin CHARACTERISTIC c_tco_tmot_sta "Temperature threshold for actuating the overtemperature warning light" VALUE 0xffe4093a _REC_VAL_20_u1 190.5 _CNV_A_R_LINEAR_____11_CM -48. 142.5 DISPLAY_IDENTIFIER C_TCO_TMOT_STA FORMAT "%5.1" /end CHARACTERISTIC
/begin CHARACTERISTIC c_fac_mff_fco "Transition factor MFF to FCO" VALUE 0xffe41616 _REC_VAL_20_u2 0.99998474 _CNV_A_R_LINEAR_____37_CM 0. 0.99998474 DISPLAY_IDENTIFIER C_FAC_MFF_FCO FORMAT "%7.5" /end CHARACTERISTIC
/begin MEASUREMENT fco "integrated fuel consumption" ULONG _CNV_A_R_LINEAR_____87_CM 1 100. 0. 4294967295. DISPLAY_IDENTIFIER FCO ECU_ADDRESS 0x3fbf00 BYTE_ORDER MSB_LAST FORMAT "%11.0" /end MEASUREMENT
/begin MEASUREMENT lv_wup_can "Indication for CAT heating ended" UBYTE _CNV_S_2_RANGE______21_CM 1 100. 0. 1. DISPLAY_IDENTIFIER LV_WUP_CAN ECU_ADDRESS 0x3fe2fb /end MEASUREMENT
/begin CHARACTERISTIC ip_t_ast_swi_wup__ctr_km_can "time condition for setting the bit S_WL" CURVE 0xffe41ca8 _REC_CUR_20_u2_u2 6553.5 _CNV_A_R_LINEAR_____24_CM 0. 6553.5 DISPLAY_IDENTIFIER IP_T_AST_SWI_WUP__CTR_KM_CAN FORMAT "%6.1"
 /begin AXIS_DESCR COM_AXIS ctr_km_can _CNV_A_R_LINEAR_____88_CM 4 0. 655340. FORMAT "%6.0" AXIS_PTS_REF ldpm_ctr_km_can /end AXIS_DESCR
/end CHARACTERISTIC
/begin CHARACTERISTIC c_pv_can_diag "limitation of PV_CAN at MTC error is active" VALUE 0xffe4082b _REC_VAL_20_u1 99.609375 _CNV_A_R_LINEAR_____9_CM 0. 99.609375 DISPLAY_IDENTIFIER C_PV_CAN_DIAG FORMAT "%4.1" /end CHARACTERISTIC
/begin CHARACTERISTIC c_eng_etcu "?????" VALUE 0xffe40722 _REC_VAL_20_u1 255. _CNV_A_R_LINEAR_____0_CM 0. 255. DISPLAY_IDENTIFIER C_ENG_ETCU FORMAT "%3.0" /end CHARACTERISTIC
/begin MEASUREMENT ctl_shift_lock_can "control shift-lock" UBYTE _CNV_A_R_LINEAR_____0_CM 1 100. 0. 3. DISPLAY_IDENTIFIER CTL_SHIFT_LOCK_CAN ECU_ADDRESS 0x3fe2fa FORMAT "%1.0" /end MEASUREMENT
/begin MEASUREMENT lv_level_is "status switch level rpm" UBYTE _CNV_S_2_RANGE______2_CM 1 100. 0. 1. DISPLAY_IDENTIFIER LV_LEVEL_IS ECU_ADDRESS 0x3fe2fc /end MEASUREMENT
/begin AXIS_PTS ldpm_ctr_km_can "" 0xffe5179a ctr_km_can _REC_AXS_20_u2 655340. _CNV_A_R_LINEAR_____88_CM 4 0. 655340. DISPLAY_IDENTIFIER LDPM_CTR_KM_CAN FORMAT "%6.0" /end AXIS_PTS
/begin MEASUREMENT tqi_maf "indicated engine torque after charging interventions (converted for CAN)" SWORD _CNV_A_R_LINEAR_____55_CM 1 100. -1024. 1023.96875 DISPLAY_IDENTIFIER TQI_MAF ECU_ADDRESS 0x3fd108 BYTE_ORDER MSB_LAST FORMAT "%8.2" /end MEASUREMENT
/begin MEASUREMENT tqi_av_can "actual indicated engine torque (converted for CAN)" UBYTE _CNV_A_R_LINEAR_____9_CM 1 100. 0. 99.609375 DISPLAY_IDENTIFIER TQI_AV_CAN ECU_ADDRESS 0x3fe302 FORMAT "%4.1" /end MEASUREMENT
/begin MEASUREMENT tqi_ems_can "requested indicated engine torque without external interventions (converted for CAN)" UBYTE _CNV_A_R_LINEAR_____9_CM 1 100. 0. 99.609375 DISPLAY_IDENTIFIER TQI_EMS_CAN ECU_ADDRESS 0x3fe303 FORMAT "%4.1" /end MEASUREMENT
/begin MEASUREMENT tqi_maf_can "indicated engine torque after charging interventions (converted for CAN)" UBYTE _CNV_A_R_LINEAR_____9_CM 1 100. 0. 99.609375 DISPLAY_IDENTIFIER TQI_MAF_CAN ECU_ADDRESS 0x3fe304 FORMAT "%4.1" /end MEASUREMENT
/begin MEASUREMENT lv_crul_ack "LV indicating if L_FGR-signal has been sent - for KWP-Service" UBYTE _CNV_S_2_RANGE______2_CM 1 100. 0. 1. DISPLAY_IDENTIFIER LV_CRUL_ACK ECU_ADDRESS 0x3fe2fd /end MEASUREMENT
/begin MEASUREMENT fco_av_mmv "Moving mean value of the integrated fuel consumption" UWORD _CNV_A_R_LINEAR_____87_CM 1 100. 0. 65535. DISPLAY_IDENTIFIER FCO_AV_MMV ECU_ADDRESS 0x3fd114 BYTE_ORDER MSB_LAST FORMAT "%5.0" /end MEASUREMENT
/begin CHARACTERISTIC c_crlc_fco_av "Correlation constant for moving mean value calculation of FCO" VALUE 0xffe40681 _REC_VAL_20_u1 0.99610001 _CNV_A_R_LINEAR_____29_CM 0. 0.99610001 DISPLAY_IDENTIFIER C_CRLC_FCO_AV FORMAT "%5.3" /end CHARACTERISTIC
/begin MEASUREMENT gear_sel_disp "Gear stick position" UBYTE _CNV_A_R_LINEAR_____0_CM 1 100. 0. 15. DISPLAY_IDENTIFIER GEAR_SEL_DISP ECU_ADDRESS 0x3fe321 FORMAT "%2.0" /end MEASUREMENT
/begin MEASUREMENT tqi_gs_req_can "Relative torque request during gearshift intervention" UBYTE _CNV_A_R_LINEAR_____50_CM 1 100. 0. 0.996094 DISPLAY_IDENTIFIER TQI_GS_REQ_CAN ECU_ADDRESS 0x3fe319 FORMAT "%5.3" /end MEASUREMENT
/begin MEASUREMENT tq_gear_can "Torque from ETCU" UBYTE _CNV_A_R_LINEAR_____50_CM 1 100. 0. 0.996094 DISPLAY_IDENTIFIER TQ_GEAR_CAN ECU_ADDRESS 0x3fe31c FORMAT "%5.3" /end MEASUREMENT
/begin MEASUREMENT tqi_gs_req "Absolute torque request during gearshift intervention" SWORD _CNV_A_R_LINEAR_____55_CM 1 100. -1024. 1023.96875 DISPLAY_IDENTIFIER TQI_GS_REQ ECU_ADDRESS 0x3fd118 BYTE_ORDER MSB_LAST FORMAT "%8.2" /end MEASUREMENT
/begin MEASUREMENT lv_tq_gs_inc_req "logical variable indicating torque increase due to gear shift intervention" UBYTE _CNV_S_2_RANGE______2_CM 1 100. 0. 1. DISPLAY_IDENTIFIER LV_TQ_GS_INC_REQ ECU_ADDRESS 0x3fe31f /end MEASUREMENT
/begin MEASUREMENT lv_tq_gs_dec_req "logical variable indicating torque decrese due to gear shift intervention " UBYTE _CNV_S_2_RANGE______2_CM 1 100. 0. 1. DISPLAY_IDENTIFIER LV_TQ_GS_DEC_REQ ECU_ADDRESS 0x3fe31e /end MEASUREMENT
/begin CHARACTERISTIC c_tq_stnd "Standard torque" VALUE 0xffe404dc _REC_VAL_20_s2 2047.96875 _CNV_A_R_LINEAR_____55_CM -1024. 1023.96875 DISPLAY_IDENTIFIER C_TQ_STND FORMAT "%8.2" /end CHARACTERISTIC
/begin MEASUREMENT gear_info "Gear information from EGS-ECU" UBYTE _CNV_A_R_LINEAR_____0_CM 1 100. 0. 7. DISPLAY_IDENTIFIER GEAR_INFO ECU_ADDRESS 0x3fe31a FORMAT "%2.0" /end MEASUREMENT
/begin MEASUREMENT tq_conv_can "converter torque from ETCU" SWORD _CNV_A_R_LINEAR_____55_CM 1 100. -1024. 1023.96875 DISPLAY_IDENTIFIER TQ_CONV_CAN ECU_ADDRESS 0x3fd116 BYTE_ORDER MSB_LAST FORMAT "%6.2" /end MEASUREMENT
/begin MEASUREMENT state_cc "state of converter clutch (CC)" UBYTE _CNV_S_4_RANGE_STAT_92_CM 1 100. 0. 3. DISPLAY_IDENTIFIER STATE_CC ECU_ADDRESS 0x3fe31b /end MEASUREMENT
/begin MEASUREMENT state_etcu_obd "status OBD gearbox" UBYTE _CNV_S_9_STATE_ETCU_93_CM 1 100. 0. 15. DISPLAY_IDENTIFIER STATE_ETCU_OBD ECU_ADDRESS 0x3fe31d /end MEASUREMENT
/begin MEASUREMENT n_gb "input shaft speed turbine/gearbox (AT) " UWORD _CNV_A_R_LINEAR_____94_CM 1 100. 0. 8191.75 DISPLAY_IDENTIFIER N_GB ECU_ADDRESS 0x3fd11a BYTE_ORDER MSB_LAST FORMAT "%7.2" /end MEASUREMENT
/begin MEASUREMENT tq_accin_can "ACC-torque from CAN" UBYTE _CNV_A_R_LINEAR_____95_CM 1 100. 0. 31. DISPLAY_IDENTIFIER TQ_ACCIN_CAN ECU_ADDRESS 0x3fe32e FORMAT "%3.0" /end MEASUREMENT
/begin MEASUREMENT state_efp_crash_can "Request for switch off fuel pump after crash" UBYTE _CNV_A_R_LINEAR_____0_CM 1 100. 0. 3. DISPLAY_IDENTIFIER STATE_EFP_CRASH_CAN ECU_ADDRESS 0x3fe32d FORMAT "%2.0" /end MEASUREMENT
/begin MEASUREMENT lv_req_heat "LV increased heater power request" UBYTE _CNV_S_2_RANGE______21_CM 1 100. 0. 1. DISPLAY_IDENTIFIER LV_REQ_HEAT ECU_ADDRESS 0x3fe33b BIT_MASK 0x1 /end MEASUREMENT
/begin MEASUREMENT lv_ltg_swi_can "logical variable for day- (0)or night lighting (1)" UBYTE _CNV_S_2_RANGE______2_CM 1 100. 0. 1. DISPLAY_IDENTIFIER LV_LTG_SWI_CAN ECU_ADDRESS 0x3fe339 /end MEASUREMENT
/begin MEASUREMENT lv_tam_can_err "logical variable for erroneous ambient temperature signal" UBYTE _CNV_S_2_RANGE______2_CM 1 100. 0. 1. DISPLAY_IDENTIFIER LV_TAM_CAN_ERR ECU_ADDRESS 0x3fe334 /end MEASUREMENT
/begin MEASUREMENT state_gear_rev_can "state reverse gear: 0 inactiv, 1 activ" UBYTE _CNV_S_2_RANGE______2_CM 1 100. 0. 1. DISPLAY_IDENTIFIER STATE_GEAR_REV_CAN ECU_ADDRESS 0x3fe33a /end MEASUREMENT
/begin MEASUREMENT ftl "fuel tank level" UBYTE _CNV_A_R_LINEAR_____96_CM 1 100. 0. 127. DISPLAY_IDENTIFIER FTL ECU_ADDRESS 0x3fe32a FORMAT "%3.0" /end MEASUREMENT
/begin MEASUREMENT lv_ftl_can_err "logical value erroneous fuel tank level signal" UBYTE _CNV_S_2_RANGE______2_CM 1 100. 0. 1. DISPLAY_IDENTIFIER LV_FTL_CAN_ERR ECU_ADDRESS 0x3fe336 /end MEASUREMENT
/begin CHARACTERISTIC c_tam_sub "substitute TAM-temperature in case of TAM-failure" VALUE 0xffe408e1 _REC_VAL_20_u1 190.5 _CNV_A_R_LINEAR_____11_CM -48. 142.5 DISPLAY_IDENTIFIER C_TAM_SUB FORMAT "%5.1" /end CHARACTERISTIC
/begin CHARACTERISTIC lc_tam_man_as "Logical constant switch TAM from CAN or application system" VALUE 0xffe40fe2 _REC_VAL_20_u1 1. _CNV_A_R_LINEAR_____22_CM 0. 1. DISPLAY_IDENTIFIER LC_TAM_MAN_AS FORMAT "%1.0" /end CHARACTERISTIC
/begin CHARACTERISTIC c_tam_man_as "Ambient temperature TAM by application system" VALUE 0xffe408d9 _REC_VAL_20_u1 190.5 _CNV_A_R_LINEAR_____11_CM -48. 142.5 DISPLAY_IDENTIFIER C_TAM_MAN_AS FORMAT "%5.1" /end CHARACTERISTIC
/begin MEASUREMENT n_ecf "Setpoint step of electric cooling fan speed" UBYTE _CNV_A_R_LINEAR_____0_CM 1 100. 0. 15. DISPLAY_IDENTIFIER N_ECF ECU_ADDRESS 0x3fe329 FORMAT "%2.0" /end MEASUREMENT
/begin MEASUREMENT lv_req_tco_l "LV requirement for low coolant temperature" UBYTE _CNV_S_2_RANGE______21_CM 1 100. 0. 1. DISPLAY_IDENTIFIER LV_REQ_TCO_L ECU_ADDRESS 0x3fe333 BIT_MASK 0x1 /end MEASUREMENT
/begin MEASUREMENT lv_accin "LV ACC request" UBYTE _CNV_S_2_RANGE______21_CM 1 100. 0. 1. DISPLAY_IDENTIFIER LV_ACCIN ECU_ADDRESS 0x3fe332 BIT_MASK 0x1 /end MEASUREMENT
/begin MEASUREMENT ctr_km_can "vehicle kilometer reading from CAN message INSTR2" UWORD _CNV_A_R_LINEAR_____88_CM 1 100. 0. 655350. DISPLAY_IDENTIFIER CTR_KM_CAN ECU_ADDRESS 0x3fd11c BYTE_ORDER MSB_LAST FORMAT "%7.0" /end MEASUREMENT
/begin MEASUREMENT t_rel_can "relative time counter" UWORD _CNV_A_R_LINEAR_____97_CM 1 100. 0. 65535. DISPLAY_IDENTIFIER T_REL_CAN ECU_ADDRESS 0x3fd11e BYTE_ORDER MSB_LAST FORMAT "%5.0" /end MEASUREMENT
/begin MEASUREMENT tam "Ambient temperature" UBYTE _CNV_A_R_LINEAR_____11_CM 1 100. -48. 142.5 DISPLAY_IDENTIFIER TAM ECU_ADDRESS 0x3fe328 FORMAT "%5.1" /end MEASUREMENT
/begin MEASUREMENT lv_acin "LV switch ACC readiness" UBYTE _CNV_S_2_RANGE______21_CM 1 100. 0. 1. DISPLAY_IDENTIFIER LV_ACIN ECU_ADDRESS 0x3fe331 BIT_MASK 0x1 /end MEASUREMENT
/begin MEASUREMENT lv_ftl_le_can_err "logical variable erroneous fuel tank level (left) signal" UBYTE _CNV_S_2_RANGE______2_CM 1 100. 0. 1. DISPLAY_IDENTIFIER LV_FTL_LE_CAN_ERR ECU_ADDRESS 0x3fe337 /end MEASUREMENT
/begin MEASUREMENT lv_ftl_ri_can_err "logical variable erroneous fuel tank level (right) signal" UBYTE _CNV_S_2_RANGE______2_CM 1 100. 0. 1. DISPLAY_IDENTIFIER LV_FTL_RI_CAN_ERR ECU_ADDRESS 0x3fe338 /end MEASUREMENT
/begin MEASUREMENT lv_ftl_obd_inh_l "logical variable fuel reserve" UBYTE _CNV_S_2_RANGE______2_CM 1 100. 0. 1. DISPLAY_IDENTIFIER LV_FTL_OBD_INH_L ECU_ADDRESS 0x3fe335 /end MEASUREMENT
/begin MEASUREMENT ftl_le "fuel tank level left" UBYTE _CNV_A_R_LINEAR_____96_CM 1 100. 0. 127. DISPLAY_IDENTIFIER FTL_LE ECU_ADDRESS 0x3fe32b FORMAT "%3.0" /end MEASUREMENT
/begin MEASUREMENT ftl_ri "fuel tank level right" UBYTE _CNV_A_R_LINEAR_____96_CM 1 100. 0. 127. DISPLAY_IDENTIFIER FTL_RI ECU_ADDRESS 0x3fe32c FORMAT "%3.0" /end MEASUREMENT
/begin CHARACTERISTIC c_tout_efp_crash "" VALUE 0xffe40983 _REC_VAL_20_u1 51. _CNV_A_R_LINEAR_____98_CM 0. 51. DISPLAY_IDENTIFIER C_TOUT_EFP_CRASH FORMAT "%4.1" /end CHARACTERISTIC
/begin MEASUREMENT vel_ang_pste "sttering wheel sensor velocity" SWORD _CNV_A_R_LINEAR_____99_CM 1 100. -1439.98976 1439.945815 DISPLAY_IDENTIFIER VEL_ANG_PSTE ECU_ADDRESS 0x3fd128 BYTE_ORDER MSB_LAST FORMAT "%8.3" /end MEASUREMENT
/begin MEASUREMENT state_sens_ang_pste "status of wheel sensor" UBYTE _CNV_A_R_LINEAR_____0_CM 1 100. 0. 7. DISPLAY_IDENTIFIER STATE_SENS_ANG_PSTE ECU_ADDRESS 0x3fe341 FORMAT "%2.0" /end MEASUREMENT
/begin MEASUREMENT lv_var_pste "LV power steering detected - BN2000" UBYTE _CNV_S_2_RANGE______2_CM 1 100. 0. 1. DISPLAY_IDENTIFIER LV_VAR_PSTE ECU_ADDRESS 0x3fe343 /end MEASUREMENT
/begin MEASUREMENT ang_pste "sttering wheel sensor angle" SWORD _CNV_A_R_LINEAR_____100_CM 1 100. -1439.98976 1439.945815 DISPLAY_IDENTIFIER ANG_PSTE ECU_ADDRESS 0x3fd126 BYTE_ORDER MSB_LAST FORMAT "%8.3" /end MEASUREMENT
/begin MEASUREMENT lv_city "sttering wheel sensor angle" UBYTE _CNV_S_2_RANGE______2_CM 1 100. 0. 1. DISPLAY_IDENTIFIER LV_CITY ECU_ADDRESS 0x3fe358 /end MEASUREMENT
/begin MEASUREMENT tqi_slow_amt_req_can "torque request (slow) SSG via CAN" UBYTE _CNV_A_R_LINEAR_____9_CM 1 100. 0. 99.609375 DISPLAY_IDENTIFIER TQI_SLOW_AMT_REQ_CAN ECU_ADDRESS 0x3fe354 FORMAT "%5.1" /end MEASUREMENT
/begin MEASUREMENT tqi_amt_req " torque request SSG" SWORD _CNV_A_R_LINEAR_____55_CM 1 100. -1024. 1023.96875 DISPLAY_IDENTIFIER TQI_AMT_REQ ECU_ADDRESS 0x3fd140 BYTE_ORDER MSB_LAST FORMAT "%8.2" /end MEASUREMENT
/begin MEASUREMENT tqi_slow_amt_req " torque request (slow) SSG" SWORD _CNV_A_R_LINEAR_____55_CM 1 100. -1024. 1023.96875 DISPLAY_IDENTIFIER TQI_SLOW_AMT_REQ ECU_ADDRESS 0x3fd142 BYTE_ORDER MSB_LAST FORMAT "%8.2" /end MEASUREMENT
/begin MEASUREMENT tqi_amt_req_can "torque requested SSG via CAN" UBYTE _CNV_A_R_LINEAR_____9_CM 1 100. 0. 99.609375 DISPLAY_IDENTIFIER TQI_AMT_REQ_CAN ECU_ADDRESS 0x3fe353 FORMAT "%5.1" /end MEASUREMENT
/begin MEASUREMENT tqi_amt_cpl_can "complement SSG via CAN" UBYTE _CNV_A_R_LINEAR_____9_CM 1 100. 0. 99.609375 DISPLAY_IDENTIFIER TQI_AMT_CPL_CAN ECU_ADDRESS 0x3fe355 FORMAT "%5.1" /end MEASUREMENT
/begin MEASUREMENT tcc_can_amt_1 "alive counter SSG" UBYTE _CNV_A_R_LINEAR_____22_CM 1 100. 0. 14. DISPLAY_IDENTIFIER TCC_CAN_AMT_1 ECU_ADDRESS 0x3fe357 FORMAT "%2.0" /end MEASUREMENT
/begin MEASUREMENT state_amt_obd_err "status OBD-relevant error - AMT" UBYTE _CNV_S_3_STATE_ETCU_74_CM 1 100. 0. 2. DISPLAY_IDENTIFIER STATE_AMT_OBD_ERR ECU_ADDRESS 0x3fe350 /end MEASUREMENT
/begin MEASUREMENT state_amt "status shift-process AMT via CAN" UBYTE _CNV_S_5_STATE_AMT_106_CM 1 100. 0. 7. DISPLAY_IDENTIFIER STATE_AMT ECU_ADDRESS 0x3fe352 /end MEASUREMENT
/begin MEASUREMENT state_clu_amt "status shift-process AMT via CAN" UBYTE _CNV_S_5_STATE_CLU__107_CM 1 100. 0. 7. DISPLAY_IDENTIFIER STATE_CLU_AMT ECU_ADDRESS 0x3fe356 /end MEASUREMENT
/begin MEASUREMENT lv_tq_amt_dec_req "logical variable indicating torque decrease due to AMT intervention" UBYTE _CNV_S_2_RANGE______2_CM 1 100. 0. 1. DISPLAY_IDENTIFIER LV_TQ_AMT_DEC_REQ ECU_ADDRESS 0x3fe35d /end MEASUREMENT
/begin MEASUREMENT lv_tq_amt_inc_req "logical variable indicating torque increase due to AMT intervention" UBYTE _CNV_S_2_RANGE______2_CM 1 100. 0. 1. DISPLAY_IDENTIFIER LV_TQ_AMT_INC_REQ ECU_ADDRESS 0x3fe35e /end MEASUREMENT
/begin MEASUREMENT n_max_amt_can "engine speed limit AMT via CAN" UWORD _CNV_A_R_LINEAR_____10_CM 1 100. 0. 8160. DISPLAY_IDENTIFIER N_MAX_AMT_CAN ECU_ADDRESS 0x3fd144 BYTE_ORDER MSB_LAST FORMAT "%4.0" /end MEASUREMENT
/begin MEASUREMENT lv_amt_es "LV indicating engine stop via CAN" UBYTE _CNV_S_2_RANGE______2_CM 1 100. 0. 1. DISPLAY_IDENTIFIER LV_AMT_ES ECU_ADDRESS 0x3fe35a /end MEASUREMENT
/begin MEASUREMENT lv_gs "LV indicating GS - AMT" UBYTE _CNV_S_2_RANGE______2_CM 1 100. 0. 1. DISPLAY_IDENTIFIER LV_GS ECU_ADDRESS 0x3fe359 /end MEASUREMENT
/begin MEASUREMENT lv_gp "LV  indicating mode gearbox - AMT" UBYTE _CNV_S_2_RANGE______2_CM 1 100. 0. 1. DISPLAY_IDENTIFIER LV_GP ECU_ADDRESS 0x3fe35b /end MEASUREMENT
/begin MEASUREMENT state_amt_obd "status OBD gearbox" UBYTE _CNV_S_9_STATE_ETCU_93_CM 1 100. 0. 15. DISPLAY_IDENTIFIER STATE_AMT_OBD ECU_ADDRESS 0x3fe351 /end MEASUREMENT
/begin MEASUREMENT lv_pump_amt_on "LV  indicating status of hydraulic pump - AMT" UBYTE _CNV_S_2_RANGE______2_CM 1 100. 0. 1. DISPLAY_IDENTIFIER LV_PUMP_AMT_ON ECU_ADDRESS 0x3fe35c /end MEASUREMENT
/begin MEASUREMENT lv_var_amt "SSG transmission recognized" UBYTE _CNV_S_2_RANGE______2_CM 1 100. 0. 1. DISPLAY_IDENTIFIER LV_VAR_AMT ECU_ADDRESS 0x3fe35f /end MEASUREMENT
/begin MEASUREMENT state_txu_cr "Current range state" UBYTE _CNV_A_R_LINEAR_____0_CM 1 100. 0. 7. DISPLAY_IDENTIFIER STATE_TXU_CR ECU_ADDRESS 0x3fe366 FORMAT "%2.0" /end MEASUREMENT
/begin MEASUREMENT state_txu_tr "Target range state" UBYTE _CNV_A_R_LINEAR_____0_CM 1 100. 0. 7. DISPLAY_IDENTIFIER STATE_TXU_TR ECU_ADDRESS 0x3fe368 FORMAT "%2.0" /end MEASUREMENT
/begin MEASUREMENT state_txu_err "TXU error status" UBYTE _CNV_A_R_LINEAR_____0_CM 1 100. 0. 15. DISPLAY_IDENTIFIER STATE_TXU_ERR ECU_ADDRESS 0x3fe369 FORMAT "%2.0" /end MEASUREMENT
/begin MEASUREMENT state_txu "TXU status" UBYTE _CNV_A_R_LINEAR_____0_CM 1 100. 0. 15. DISPLAY_IDENTIFIER STATE_TXU ECU_ADDRESS 0x3fe36a FORMAT "%2.0" /end MEASUREMENT
/begin MEASUREMENT state_txu_mt "status manual transmission" UBYTE _CNV_A_R_LINEAR_____0_CM 1 100. 0. 1. DISPLAY_IDENTIFIER STATE_TXU_MT ECU_ADDRESS 0x3fe36c FORMAT "%2.0" /end MEASUREMENT
/begin MEASUREMENT txu_wal "Warning light transfer case control unit" UBYTE _CNV_A_R_LINEAR_____0_CM 1 100. 0. 1. DISPLAY_IDENTIFIER TXU_WAL ECU_ADDRESS 0x3fe36d FORMAT "%2.0" /end MEASUREMENT
/begin MEASUREMENT txu_disp_cogs_sum "Display transfer case cogs" UBYTE _CNV_A_R_LINEAR_____0_CM 1 100. 0. 3. DISPLAY_IDENTIFIER TXU_DISP_COGS_SUM ECU_ADDRESS 0x3fe36e FORMAT "%2.0" /end MEASUREMENT
/begin MEASUREMENT txu_disp_rng_sum "Display transfer case range" UBYTE _CNV_A_R_LINEAR_____0_CM 1 100. 0. 3. DISPLAY_IDENTIFIER TXU_DISP_RNG_SUM ECU_ADDRESS 0x3fe36f FORMAT "%2.0" /end MEASUREMENT
/begin MEASUREMENT txu_disp_gear_sum "Display transfer case gear" UBYTE _CNV_A_R_LINEAR_____0_CM 1 100. 0. 15. DISPLAY_IDENTIFIER TXU_DISP_GEAR_SUM ECU_ADDRESS 0x3fe370 FORMAT "%2.0" /end MEASUREMENT
/begin MEASUREMENT tqi_txu "Torque override for TXU function" UBYTE _CNV_A_R_LINEAR_____9_CM 1 100. 0. 99.609375 DISPLAY_IDENTIFIER TQI_TXU ECU_ADDRESS 0x3fe36b FORMAT "%5.2" /end MEASUREMENT
/begin MEASUREMENT lv_ct "Logical variable detection of driver passive" UBYTE _CNV_S_2_RANGE______2_CM 1 100. 0. 1. DISPLAY_IDENTIFIER LV_CT ECU_ADDRESS 0x3fe750 BIT_MASK 0x1 /end MEASUREMENT
/begin CHARACTERISTIC c_fac_tq_req_clu_is_hys "Hysteresis on threshold on FAC_TQ_REQ_CLU_for IS detection" VALUE 0xffe41642 _REC_VAL_20_u2 1.99996948 _CNV_A_R_LINEAR_____20_CM 0. 1.99996948 DISPLAY_IDENTIFIER C_FAC_TQ_REQ_CLU_IS_HYS FORMAT "%7.5" /end CHARACTERISTIC
/begin CHARACTERISTIC ip_fac_tq_req_clu_is__n_32 "Threshold on FAC_TQ_REQ_CLU for IS detection" CURVE 0xffe41c44 _REC_CUR_20_u2_u1 1.99996948 _CNV_A_R_LINEAR_____20_CM 0. 1.99996948 DISPLAY_IDENTIFIER IP_FAC_TQ_REQ_CLU_IS__N_32 FORMAT "%7.5"
 /begin AXIS_DESCR COM_AXIS n_32 _CNV_A_R_LINEAR_____15_CM 3 0. 8160. FORMAT "%4.0" AXIS_PTS_REF ldp_n_32__fac_tq_req_clu_is /end AXIS_DESCR
/end CHARACTERISTIC
/begin AXIS_PTS ldp_n_32__fac_tq_req_clu_is "" 0xffe41098 n_32 _REC_AXS_20_u1 8160. _CNV_A_R_LINEAR_____15_CM 3 0. 8160. DISPLAY_IDENTIFIER LDP_N_32__FAC_TQ_REQ_CLU_IS FORMAT "%4.0" /end AXIS_PTS
/begin MEASUREMENT fast_ecu_tran_pwl_ctr "fast transition counter for transition from SYN_ENG_IGK_OFF to PWL despite engine running" UWORD _CNV_A_R_LINEAR_____4_CM 1 100. 0. 655.35 DISPLAY_IDENTIFIER FAST_ECU_TRAN_PWL_CTR ECU_ADDRESS 0x3fd774 BYTE_ORDER MSB_LAST FORMAT "%6.2" /end MEASUREMENT
/begin MEASUREMENT lv_ebr_det_act "Engine back rotation detection active" UBYTE _CNV_S_2_RANGE______2_CM 1 100. 0. 1. DISPLAY_IDENTIFIER LV_EBR_DET_ACT ECU_ADDRESS 0x3fe697 BIT_MASK 0x1 /end MEASUREMENT
/begin MEASUREMENT lv_ebr_det_cam "Engine back rotation detected by CAM_0" UBYTE _CNV_S_2_RANGE______2_CM 1 100. 0. 1. DISPLAY_IDENTIFIER LV_EBR_DET_CAM ECU_ADDRESS 0x3fe6a2 BIT_MASK 0x1 /end MEASUREMENT
/begin MEASUREMENT lv_ebr_det_tooth "Engine back rotation detected by tooth duration check" UBYTE _CNV_S_2_RANGE______2_CM 1 100. 0. 1. DISPLAY_IDENTIFIER LV_EBR_DET_TOOTH ECU_ADDRESS 0x3fe6a3 BIT_MASK 0x1 /end MEASUREMENT
/begin MEASUREMENT ctr_ebr_det_cam "Counter EBR detected by CAM_0" UBYTE _CNV_A_R_LINEAR_____0_CM 1 100. 0. 255. DISPLAY_IDENTIFIER CTR_EBR_DET_CAM ECU_ADDRESS 0x3fe698 FORMAT "%3.0" /end MEASUREMENT
/begin MEASUREMENT ctr_cam_plaus_fail "Counter CAM not plausible at synchronizations" UBYTE _CNV_A_R_LINEAR_____0_CM 1 100. 0. 255. DISPLAY_IDENTIFIER CTR_CAM_PLAUS_FAIL ECU_ADDRESS 0x3fe69a FORMAT "%3.0" /end MEASUREMENT
/begin MEASUREMENT ctr_ebr_det_tooth "Counter EBR detected by tooth duration check" UBYTE _CNV_A_R_LINEAR_____0_CM 1 100. 0. 255. DISPLAY_IDENTIFIER CTR_EBR_DET_TOOTH ECU_ADDRESS 0x3fe699 FORMAT "%3.0" /end MEASUREMENT
/begin MEASUREMENT t_ebr_sync_lock "Synchronization lock time caused by engine back rotation detection (CAM/TOOTH)" UBYTE _CNV_A_R_LINEAR_____4_CM 1 100. 0. 2.55 DISPLAY_IDENTIFIER T_EBR_SYNC_LOCK ECU_ADDRESS 0x3fe69f FORMAT "%4.2" /end MEASUREMENT
/begin MEASUREMENT t_ebr_tooth_max "Maximum allowed tooth time for detection of engine back rotation" UBYTE _CNV_A_R_LINEAR_____142_CM 1 100. 0. 255. DISPLAY_IDENTIFIER T_EBR_TOOTH_MAX ECU_ADDRESS 0x3fe69c FORMAT "%3.0" /end MEASUREMENT
/begin MEASUREMENT t_ebr_tooth_per "Calculated tooth time by sampling algorithm" UBYTE _CNV_A_R_LINEAR_____142_CM 1 100. 0. 255. DISPLAY_IDENTIFIER T_EBR_TOOTH_PER ECU_ADDRESS 0x3fe69b FORMAT "%3.0" /end MEASUREMENT
/begin MEASUREMENT t_ebr_es_sync_max "Engine stop time after EBR detection (CAM/TOOTH)" UWORD _CNV_A_R_LINEAR_____4_CM 1 100. 0. 655.35 DISPLAY_IDENTIFIER T_EBR_ES_SYNC_MAX ECU_ADDRESS 0x3fd776 BYTE_ORDER MSB_LAST FORMAT "%6.2" /end MEASUREMENT
/begin CHARACTERISTIC c_t_sync_lock_tooth "Synchronization lock time caused by engine back rotation (TOOTH)" VALUE 0xffe408cc _REC_VAL_20_u1 2.55 _CNV_A_R_LINEAR_____4_CM 0. 2.55 DISPLAY_IDENTIFIER C_T_SYNC_LOCK_TOOTH FORMAT "%4.2" /end CHARACTERISTIC
/begin CHARACTERISTIC c_crk_vld_tooth_sync_lock "Delay synchronization for this number of teeth after EBR is detected (CAM/TOOTH)" VALUE 0xffe40673 _REC_VAL_20_u1 52. _CNV_A_R_LINEAR_____0_CM 4. 56. DISPLAY_IDENTIFIER C_CRK_VLD_TOOTH_SYNC_LOCK FORMAT "%2.0" /end CHARACTERISTIC
/begin CHARACTERISTIC c_t_es_sync_max "Maximum engine stop time after EBR detection (CAM/TOOTH) then switching to default  sync parameters" VALUE 0xffe41972 _REC_VAL_20_u2 655.35 _CNV_A_R_LINEAR_____4_CM 0. 655.35 DISPLAY_IDENTIFIER C_T_ES_SYNC_MAX FORMAT "%5.2" /end CHARACTERISTIC
/begin CHARACTERISTIC lc_ebr_det_tooth "Detection of engine back rotation with tooth time (0 = inactive, 1 = active)" VALUE 0xffe40f4f _REC_VAL_20_u1 1. _CNV_A_R_LINEAR_____0_CM 0. 1. DISPLAY_IDENTIFIER LC_EBR_DET_TOOTH FORMAT "%2.0" /end CHARACTERISTIC
/begin CHARACTERISTIC lc_ebr_det_cam "Detection of engine back rotation with crk/cam plausibility (0 = inactive, 1 = active)" VALUE 0xffe40f4e _REC_VAL_20_u1 1. _CNV_A_R_LINEAR_____0_CM 0. 1. DISPLAY_IDENTIFIER LC_EBR_DET_CAM FORMAT "%2.0" /end CHARACTERISTIC
/begin CHARACTERISTIC c_t_sync_lock_cam "Synchronization lock time caused by engine back rotation (CAM)" VALUE 0xffe408cb _REC_VAL_20_u1 2.55 _CNV_A_R_LINEAR_____4_CM 0. 2.55 DISPLAY_IDENTIFIER C_T_SYNC_LOCK_CAM FORMAT "%4.2" /end CHARACTERISTIC
/begin CHARACTERISTIC c_cam_plaus_fail_max "MAx. trials for synchronization in case of wrong cam-level" VALUE 0xffe40648 _REC_VAL_20_u1 255. _CNV_A_R_LINEAR_____0_CM 0. 255. DISPLAY_IDENTIFIER C_CAM_PLAUS_FAIL_MAX FORMAT "%3.0" /end CHARACTERISTIC
/begin AXIS_PTS ldp_tco__t_tooth_max "" 0xffe411ec tco _REC_AXS_20_u1 190.5 _CNV_A_R_LINEAR_____11_CM 6 -48. 142.5 DISPLAY_IDENTIFIER LDP_TCO__T_TOOTH_MAX FORMAT "%5.1" /end AXIS_PTS
/begin AXIS_PTS ldp_vb__t_tooth_max "" 0xffe412e6 tco _REC_AXS_20_u1 26. _CNV_A_R_LINEAR_____60_CM 6 0. 26. DISPLAY_IDENTIFIER LDP_VB__T_TOOTH_MAX FORMAT "%4.1" /end AXIS_PTS
/begin CHARACTERISTIC ip_t_tooth_max__vb_tco "Max. tooth-time for EBR detection" MAP 0xffe4795b _REC_MAP_20_u1_u1_u1 255. _CNV_A_R_LINEAR_____142_CM 0. 255. DISPLAY_IDENTIFIER IP_T_TOOTH_MAX__VB_TCO FORMAT "%3.0"
 /begin AXIS_DESCR COM_AXIS tco _CNV_A_R_LINEAR_____60_CM 6 0. 26. FORMAT "%4.1" AXIS_PTS_REF ldp_vb__t_tooth_max /end AXIS_DESCR
 /begin AXIS_DESCR COM_AXIS tco _CNV_A_R_LINEAR_____11_CM 6 -48. 142.5 FORMAT "%5.1" AXIS_PTS_REF ldp_tco__t_tooth_max /end AXIS_DESCR
/end CHARACTERISTIC
/begin MEASUREMENT fup "fuel pressure value" UWORD _CNV_A_R_LINEAR_____199_CM 1 100. 0. 173888. DISPLAY_IDENTIFIER FUP ECU_ADDRESS 0x3fd22c BYTE_ORDER MSB_LAST FORMAT "%6.0" /end MEASUREMENT
/begin CHARACTERISTIC c_fup_nom "Nominal fuel pressure" VALUE 0xffe4166c _REC_VAL_20_u2 5434. _CNV_A_R_LINEAR_____49_CM 0. 5434. DISPLAY_IDENTIFIER C_FUP_NOM FORMAT "%7.2" /end CHARACTERISTIC
/begin MEASUREMENT gear "" UBYTE _CNV_A_R_LINEAR_____0_CM 1 100. 0. 255. DISPLAY_IDENTIFIER GEAR ECU_ADDRESS 0x3fe747 FORMAT "%3.0" /end MEASUREMENT
/begin MEASUREMENT lv_err_bn_tq_etcu "Present error BN2000" UBYTE _CNV_S_2_RANGE______1_R_CM 1 100. 0. 255. DISPLAY_IDENTIFIER LV_ERR_BN_TQ_ETCU ECU_ADDRESS 0x3fbac8 /end MEASUREMENT
/begin MEASUREMENT lam_bank_1.lsl_temp_up.bf.lv_ttip_ls_up_mes_vld "Boolean flag indicating validity of oxygen sensor ceramic temperature TTIP_LS_UP_MES_1" ULONG _CNV_S_2_RANGE______2_CM 1 100. 0. 1. DISPLAY_IDENTIFIER LV_TTIP_LS_UP_MES_VLD_1 ECU_ADDRESS 0x3fc4e4 BYTE_ORDER MSB_LAST BIT_MASK 0x10000000 /end MEASUREMENT
/begin MEASUREMENT lam_bank_1.lsl_temp_up.bf.lv_v_temp_ls_up_mes_ofs_vld "Boolean flag indicating offset in resistance measurement mode valid" ULONG _CNV_S_2_RANGE______2_CM 1 100. 0. 1. DISPLAY_IDENTIFIER LV_V_TEMP_LS_UP_MES_OFS_VLD_1 ECU_ADDRESS 0x3fc4e4 BYTE_ORDER MSB_LAST BIT_MASK 0x80000000 /end MEASUREMENT
/begin MEASUREMENT lam_bank_1.lsl_temp_up.bf.lv_v_temp_ls_up_adj_ofs_vld "Boolean flag indicating offset in resistance adjust mode valid" ULONG _CNV_S_2_RANGE______2_CM 1 100. 0. 1. DISPLAY_IDENTIFIER LV_V_TEMP_LS_UP_ADJ_OFS_VLD_1 ECU_ADDRESS 0x3fc4e4 BYTE_ORDER MSB_LAST BIT_MASK 0x40000000 /end MEASUREMENT
/begin MEASUREMENT lam_bank_1.lsl_temp_up.bf.lv_gain_temp_ls_up_vld "Boolean flag indicating measured gain valid" ULONG _CNV_S_2_RANGE______2_CM 1 100. 0. 1. DISPLAY_IDENTIFIER LV_GAIN_TEMP_LS_UP_VLD_1 ECU_ADDRESS 0x3fc4e4 BYTE_ORDER MSB_LAST BIT_MASK 0x20000000 /end MEASUREMENT
/begin MEASUREMENT lam_bank_1.lsl_temp_up.bf.lv_v_temp_ls_up_ref_vld "Boolean flag indicating internal resistance determination circuit references valid" ULONG _CNV_S_2_RANGE______2_CM 1 100. 0. 1. DISPLAY_IDENTIFIER LV_V_TEMP_LS_UP_REF_VLD_1 ECU_ADDRESS 0x3fc4e4 BYTE_ORDER MSB_LAST BIT_MASK 0x8000000 /end MEASUREMENT
/begin MEASUREMENT lam_bank_1.lsl_temp_up.ttip_ls_up_mes "Oxygen sensor ceramic temperature" SWORD _CNV_A_R_LINEAR_____303_CM 1 100. -2048. 2047.938 DISPLAY_IDENTIFIER TTIP_LS_UP_MES_1 ECU_ADDRESS 0x3fc4e8 BYTE_ORDER MSB_LAST FORMAT "%8.2" /end MEASUREMENT
/begin MEASUREMENT lam_bank_1.lsl_temp_up.r_up_ls "Oxygen sensor element internal resistance" UWORD _CNV_A_R_LINEAR_____304_CM 1 100. 0. 16383.75 DISPLAY_IDENTIFIER R_UP_LS_1 ECU_ADDRESS 0x3fc4ea BYTE_ORDER MSB_LAST FORMAT "%8.1" /end MEASUREMENT
/begin MEASUREMENT lam_bank_1.lsl_temp_up.state_ttip_ls_up "State_variable indicating current state of function" UBYTE _CNV_S_5_RANGE_STAT_305_CM 1 100. 0. 4. DISPLAY_IDENTIFIER STATE_TTIP_LS_UP_1 ECU_ADDRESS 0x3fc504 /end MEASUREMENT
/begin MEASUREMENT lam_bank_1.lsl_temp_up.v_temp_ls_up_mes_ofs "Internal resistance determination circuit offset in resistance measurement mode" UWORD _CNV_A_R_LINEAR_____306_CM 1 100. 0. 4.995 DISPLAY_IDENTIFIER V_TEMP_LS_UP_MES_OFS_1 ECU_ADDRESS 0x3fc4ec BYTE_ORDER MSB_LAST FORMAT "%5.3" /end MEASUREMENT
/begin MEASUREMENT lam_bank_1.lsl_temp_up.v_temp_ls_up_adj_ofs "Internal resistance determination circuit offset in resistance adjust mode" UWORD _CNV_A_R_LINEAR_____306_CM 1 100. 0. 4.995 DISPLAY_IDENTIFIER V_TEMP_LS_UP_ADJ_OFS_1 ECU_ADDRESS 0x3fc4ee BYTE_ORDER MSB_LAST FORMAT "%5.3" /end MEASUREMENT
/begin MEASUREMENT lam_bank_1.lsl_temp_up.gain_temp_ls_up "Gain of oxygen sensor internal resistance determination circuit" UWORD _CNV_A_R_LINEAR_____307_CM 1 100. 0. 19.99969 DISPLAY_IDENTIFIER GAIN_TEMP_LS_UP_1 ECU_ADDRESS 0x3fc4f0 BYTE_ORDER MSB_LAST FORMAT "%7.4" /end MEASUREMENT
/begin MEASUREMENT lam_bank_1.lsl_temp_up.tcc_v_temp_ls_up_mes_ofs "Counter incremented for every measured offset voltage in resistance measurement mode" UWORD _CNV_A_R_LINEAR_____0_CM 1 100. 0. 65535. DISPLAY_IDENTIFIER TCC_V_TEMP_LS_UP_MES_OFS_1 ECU_ADDRESS 0x3fc4f2 BYTE_ORDER MSB_LAST FORMAT "%5.0" /end MEASUREMENT
/begin MEASUREMENT lam_bank_1.lsl_temp_up.tcc_v_temp_ls_up_adj_ofs "Counter incremented for every offset voltage in resistance adjust mode" UWORD _CNV_A_R_LINEAR_____0_CM 1 100. 0. 65535. DISPLAY_IDENTIFIER TCC_V_TEMP_LS_UP_ADJ_OFS_1 ECU_ADDRESS 0x3fc4f4 BYTE_ORDER MSB_LAST FORMAT "%5.0" /end MEASUREMENT
/begin MEASUREMENT lam_bank_1.lsl_temp_up.tcc_gain_temp_ls_up "Counter incremented for every gain adjust measurement" UWORD _CNV_A_R_LINEAR_____0_CM 1 100. 0. 65535. DISPLAY_IDENTIFIER TCC_GAIN_TEMP_LS_UP_1 ECU_ADDRESS 0x3fc4f6 BYTE_ORDER MSB_LAST FORMAT "%5.0" /end MEASUREMENT
/begin MEASUREMENT lam_bank_1.lsl_temp_up.frc_err_v_temp_ls_up_mes_ofs "Counter incremented for every invalid offset voltage in resistance measurement mode" UWORD _CNV_A_R_LINEAR_____0_CM 1 100. 0. 65535. DISPLAY_IDENTIFIER FRC_ERR_V_TEMP_LS_UP_MES_OFS_1 ECU_ADDRESS 0x3fc4f8 BYTE_ORDER MSB_LAST FORMAT "%5.0" /end MEASUREMENT
/begin MEASUREMENT lam_bank_1.lsl_temp_up.frc_err_v_temp_ls_up_adj_ofs "Counter incremented for every invalid offset voltage in resistance adjust mode" UWORD _CNV_A_R_LINEAR_____0_CM 1 100. 0. 65535. DISPLAY_IDENTIFIER FRC_ERR_V_TEMP_LS_UP_ADJ_OFS_1 ECU_ADDRESS 0x3fc4fa BYTE_ORDER MSB_LAST FORMAT "%5.0" /end MEASUREMENT
/begin MEASUREMENT lam_bank_1.lsl_temp_up.frc_err_gain_temp_ls_up "Counter incremented for every invalid gain adjust measurement" UWORD _CNV_A_R_LINEAR_____0_CM 1 100. 0. 65535. DISPLAY_IDENTIFIER FRC_ERR_GAIN_TEMP_LS_UP_1 ECU_ADDRESS 0x3fc4fc BYTE_ORDER MSB_LAST FORMAT "%5.0" /end MEASUREMENT
/begin MEASUREMENT lam_bank_1.ls_up_spi.bf.lv_lsl_if_spi_rst_end "Boolean flag indicating that CJ120 has been initialised after RESET" ULONG _CNV_S_2_RANGE______2_CM 1 100. 0. 1. DISPLAY_IDENTIFIER LV_LSL_IF_SPI_RST_END_1 ECU_ADDRESS 0x3fc5c0 BYTE_ORDER MSB_LAST BIT_MASK 0x80000000 /end MEASUREMENT
/begin MEASUREMENT lam_bank_2.lsl_temp_up.bf.lv_ttip_ls_up_mes_vld "Boolean flag indicating validity of oxygen sensor ceramic temperature TTIP_LS_UP_MES_1" ULONG _CNV_S_2_RANGE______2_CM 1 100. 0. 1. DISPLAY_IDENTIFIER LV_TTIP_LS_UP_MES_VLD_2 ECU_ADDRESS 0x3fc99c BYTE_ORDER MSB_LAST BIT_MASK 0x10000000 /end MEASUREMENT
/begin MEASUREMENT lam_bank_2.lsl_temp_up.bf.lv_v_temp_ls_up_mes_ofs_vld "Boolean flag indicating offset in resistance measurement mode valid" ULONG _CNV_S_2_RANGE______2_CM 1 100. 0. 1. DISPLAY_IDENTIFIER LV_V_TEMP_LS_UP_MES_OFS_VLD_2 ECU_ADDRESS 0x3fc99c BYTE_ORDER MSB_LAST BIT_MASK 0x80000000 /end MEASUREMENT
/begin MEASUREMENT lam_bank_2.lsl_temp_up.bf.lv_v_temp_ls_up_adj_ofs_vld "Boolean flag indicating offset in resistance adjust mode valid" ULONG _CNV_S_2_RANGE______2_CM 1 100. 0. 1. DISPLAY_IDENTIFIER LV_V_TEMP_LS_UP_ADJ_OFS_VLD_2 ECU_ADDRESS 0x3fc99c BYTE_ORDER MSB_LAST BIT_MASK 0x40000000 /end MEASUREMENT
/begin MEASUREMENT lam_bank_2.lsl_temp_up.bf.lv_gain_temp_ls_up_vld "Boolean flag indicating measured gain valid" ULONG _CNV_S_2_RANGE______2_CM 1 100. 0. 1. DISPLAY_IDENTIFIER LV_GAIN_TEMP_LS_UP_VLD_2 ECU_ADDRESS 0x3fc99c BYTE_ORDER MSB_LAST BIT_MASK 0x20000000 /end MEASUREMENT
/begin MEASUREMENT lam_bank_2.lsl_temp_up.bf.lv_v_temp_ls_up_ref_vld "Boolean flag indicating internal resistance determination circuit references valid" ULONG _CNV_S_2_RANGE______2_CM 1 100. 0. 1. DISPLAY_IDENTIFIER LV_V_TEMP_LS_UP_REF_VLD_2 ECU_ADDRESS 0x3fc99c BYTE_ORDER MSB_LAST BIT_MASK 0x8000000 /end MEASUREMENT
/begin MEASUREMENT lam_bank_2.lsl_temp_up.ttip_ls_up_mes "Oxygen sensor ceramic temperature" SWORD _CNV_A_R_LINEAR_____303_CM 1 100. -2048. 2047.938 DISPLAY_IDENTIFIER TTIP_LS_UP_MES_2 ECU_ADDRESS 0x3fc9a0 BYTE_ORDER MSB_LAST FORMAT "%8.2" /end MEASUREMENT
/begin MEASUREMENT lam_bank_2.lsl_temp_up.r_up_ls "Oxygen sensor element internal resistance" UWORD _CNV_A_R_LINEAR_____304_CM 1 100. 0. 16383.75 DISPLAY_IDENTIFIER R_UP_LS_2 ECU_ADDRESS 0x3fc9a2 BYTE_ORDER MSB_LAST FORMAT "%8.1" /end MEASUREMENT
/begin MEASUREMENT lam_bank_2.lsl_temp_up.state_ttip_ls_up "State_variable indicating current state of function" UBYTE _CNV_S_5_RANGE_STAT_305_CM 1 100. 0. 4. DISPLAY_IDENTIFIER STATE_TTIP_LS_UP_2 ECU_ADDRESS 0x3fc9bc /end MEASUREMENT
/begin MEASUREMENT lam_bank_2.lsl_temp_up.v_temp_ls_up_mes_ofs "Internal resistance determination circuit offset in resistance measurement mode" UWORD _CNV_A_R_LINEAR_____306_CM 1 100. 0. 4.995 DISPLAY_IDENTIFIER V_TEMP_LS_UP_MES_OFS_2 ECU_ADDRESS 0x3fc9a4 BYTE_ORDER MSB_LAST FORMAT "%5.3" /end MEASUREMENT
/begin MEASUREMENT lam_bank_2.lsl_temp_up.v_temp_ls_up_adj_ofs "Internal resistance determination circuit offset in resistance adjust mode" UWORD _CNV_A_R_LINEAR_____306_CM 1 100. 0. 4.995 DISPLAY_IDENTIFIER V_TEMP_LS_UP_ADJ_OFS_2 ECU_ADDRESS 0x3fc9a6 BYTE_ORDER MSB_LAST FORMAT "%5.3" /end MEASUREMENT
/begin MEASUREMENT lam_bank_2.lsl_temp_up.gain_temp_ls_up "Gain of oxygen sensor internal resistance determination circuit" UWORD _CNV_A_R_LINEAR_____307_CM 1 100. 0. 19.99969 DISPLAY_IDENTIFIER GAIN_TEMP_LS_UP_2 ECU_ADDRESS 0x3fc9a8 BYTE_ORDER MSB_LAST FORMAT "%7.4" /end MEASUREMENT
/begin MEASUREMENT lam_bank_2.lsl_temp_up.tcc_v_temp_ls_up_mes_ofs "Counter incremented for every measured offset voltage in resistance measurement mode" UWORD _CNV_A_R_LINEAR_____0_CM 1 100. 0. 65535. DISPLAY_IDENTIFIER TCC_V_TEMP_LS_UP_MES_OFS_2 ECU_ADDRESS 0x3fc9aa BYTE_ORDER MSB_LAST FORMAT "%5.0" /end MEASUREMENT
/begin MEASUREMENT lam_bank_2.lsl_temp_up.tcc_v_temp_ls_up_adj_ofs "Counter incremented for every offset voltage in resistance adjust mode" UWORD _CNV_A_R_LINEAR_____0_CM 1 100. 0. 65535. DISPLAY_IDENTIFIER TCC_V_TEMP_LS_UP_ADJ_OFS_2 ECU_ADDRESS 0x3fc9ac BYTE_ORDER MSB_LAST FORMAT "%5.0" /end MEASUREMENT
/begin MEASUREMENT lam_bank_2.lsl_temp_up.tcc_gain_temp_ls_up "Counter incremented for every gain adjust measurement" UWORD _CNV_A_R_LINEAR_____0_CM 1 100. 0. 65535. DISPLAY_IDENTIFIER TCC_GAIN_TEMP_LS_UP_2 ECU_ADDRESS 0x3fc9ae BYTE_ORDER MSB_LAST FORMAT "%5.0" /end MEASUREMENT
/begin MEASUREMENT lam_bank_2.lsl_temp_up.frc_err_v_temp_ls_up_mes_ofs "Counter incremented for every invalid offset voltage in resistance measurement mode" UWORD _CNV_A_R_LINEAR_____0_CM 1 100. 0. 65535. DISPLAY_IDENTIFIER FRC_ERR_V_TEMP_LS_UP_MES_OFS_2 ECU_ADDRESS 0x3fc9b0 BYTE_ORDER MSB_LAST FORMAT "%5.0" /end MEASUREMENT
/begin MEASUREMENT lam_bank_2.lsl_temp_up.frc_err_v_temp_ls_up_adj_ofs "Counter incremented for every invalid offset voltage in resistance adjust mode" UWORD _CNV_A_R_LINEAR_____0_CM 1 100. 0. 65535. DISPLAY_IDENTIFIER FRC_ERR_V_TEMP_LS_UP_ADJ_OFS_2 ECU_ADDRESS 0x3fc9b2 BYTE_ORDER MSB_LAST FORMAT "%5.0" /end MEASUREMENT
/begin MEASUREMENT lam_bank_2.lsl_temp_up.frc_err_gain_temp_ls_up "Counter incremented for every invalid gain adjust measurement" UWORD _CNV_A_R_LINEAR_____0_CM 1 100. 0. 65535. DISPLAY_IDENTIFIER FRC_ERR_GAIN_TEMP_LS_UP_2 ECU_ADDRESS 0x3fc9b4 BYTE_ORDER MSB_LAST FORMAT "%5.0" /end MEASUREMENT
/begin MEASUREMENT lam_bank_2.ls_up_spi.bf.lv_lsl_if_spi_rst_end "Boolean flag indicating that CJ120 has been initialised after RESET" ULONG _CNV_S_2_RANGE______2_CM 1 100. 0. 1. DISPLAY_IDENTIFIER LV_LSL_IF_SPI_RST_END_2 ECU_ADDRESS 0x3fca78 BYTE_ORDER MSB_LAST BIT_MASK 0x80000000 /end MEASUREMENT
/begin MEASUREMENT maf_mdl "Deviation of model air mass flow" UWORD _CNV_A_R_LINEAR_____115_CM 1 100. 0. 2047.96875 DISPLAY_IDENTIFIER MAF_MDL ECU_ADDRESS 0x3fd2da BYTE_ORDER MSB_LAST FORMAT "%7.2" /end MEASUREMENT
/begin MEASUREMENT map_mdl "Deviation between measured and callculated manifold pressure" UWORD _CNV_A_R_LINEAR_____49_CM 1 100. 0. 5434. DISPLAY_IDENTIFIER MAP_MDL ECU_ADDRESS 0x3fd2dc BYTE_ORDER MSB_LAST FORMAT "%7.2" /end MEASUREMENT
/begin CHARACTERISTIC c_crlc_amp_ad "Correlation constants for the ambient pressure Adaptation" VALUE 0xffe40675 _REC_VAL_20_u1 0.9960940000000002 _CNV_A_R_LINEAR_____50_CM 0. 0.996094 DISPLAY_IDENTIFIER C_CRLC_AMP_AD FORMAT "%5.3" /end CHARACTERISTIC
/begin CHARACTERISTIC c_tco_thd_amp_ad "Threshold of TCO in case of no working load sensor" VALUE 0xffe40938 _REC_VAL_20_u1 190.5 _CNV_A_R_LINEAR_____11_CM -48. 142.5 DISPLAY_IDENTIFIER C_TCO_THD_AMP_AD FORMAT "%5.1" /end CHARACTERISTIC
/begin MEASUREMENT amp "Ambient pressure (measured or adapted)" UWORD _CNV_A_R_LINEAR_____49_CM 1 100. 0. 5434. DISPLAY_IDENTIFIER AMP ECU_ADDRESS 0x3fd2bc BYTE_ORDER MSB_LAST FORMAT "%7.2" /end MEASUREMENT
/begin MEASUREMENT amp_mdl_dif_i_mmv "Moving mean I-value of the closed loop control of ambient pressure" SWORD _CNV_A_R_LINEAR_____110_CM 1 100. -2717.04 2716.96 DISPLAY_IDENTIFIER AMP_MDL_DIF_I_MMV ECU_ADDRESS 0x3fd2c2 BYTE_ORDER MSB_LAST FORMAT "%8.2" /end MEASUREMENT
/begin MEASUREMENT amp_mdl_dif_i "I-value of the closed loop control of ambient pressure" SWORD _CNV_A_R_LINEAR_____383_CM 1 100. -339.625 339.614635 DISPLAY_IDENTIFIER AMP_MDL_DIF_I ECU_ADDRESS 0x3fd2c0 BYTE_ORDER MSB_LAST FORMAT "%7.2" /end MEASUREMENT
/begin MEASUREMENT amp_mdl_dif_p "P-value of the closed loop control of ambient pressure" SWORD _CNV_A_R_LINEAR_____110_CM 1 100. -2717.04 2716.96 DISPLAY_IDENTIFIER AMP_MDL_DIF_P ECU_ADDRESS 0x3fd2ec BYTE_ORDER MSB_LAST FORMAT "%8.2" /end MEASUREMENT
/begin MEASUREMENT amp_estim "Estimated ambient pressure" UWORD _CNV_A_R_LINEAR_____49_CM 1 100. 0. 5434. DISPLAY_IDENTIFIER AMP_ESTIM ECU_ADDRESS 0x3fd2ea BYTE_ORDER MSB_LAST FORMAT "%7.2" /end MEASUREMENT
/begin MEASUREMENT amp_ad_dif "Change of the adapted ambient pressure" SWORD _CNV_A_R_LINEAR_____110_CM 1 100. -2717.04 2716.96 DISPLAY_IDENTIFIER AMP_AD_DIF ECU_ADDRESS 0x3fd2e8 BYTE_ORDER MSB_LAST FORMAT "%8.2" /end MEASUREMENT
/begin MEASUREMENT amp_ad "Adapted ambient pressure" UWORD _CNV_A_R_LINEAR_____49_CM 1 100. 0. 5434. DISPLAY_IDENTIFIER AMP_AD ECU_ADDRESS 0x3fd2c4 BYTE_ORDER MSB_LAST FORMAT "%7.2" /end MEASUREMENT
/begin MEASUREMENT ar_red_bas_mmv "Moving mean value of the basic reduced area" UWORD _CNV_A_R_LINEAR_____382_CM 1 100. 0. 58.592855 DISPLAY_IDENTIFIER AR_RED_BAS_MMV ECU_ADDRESS 0x3fd2f2 BYTE_ORDER MSB_LAST FORMAT "%7.4" /end MEASUREMENT
/begin MEASUREMENT maf_kgh_mmv "Moving mean value of the mass air flow" UWORD _CNV_A_R_LINEAR_____115_CM 1 100. 0. 2047.96875 DISPLAY_IDENTIFIER MAF_KGH_MMV ECU_ADDRESS 0x3fd2f4 BYTE_ORDER MSB_LAST FORMAT "%7.2" /end MEASUREMENT
/begin MEASUREMENT seg_ctr_amp_ad_pl "Segment counter for ambient pressure Adaptation during part load" UWORD _CNV_A_R_LINEAR_____0_CM 1 100. 0. 65535. DISPLAY_IDENTIFIER SEG_CTR_AMP_AD_PL ECU_ADDRESS 0x3fd2ee BYTE_ORDER MSB_LAST FORMAT "%5.0" /end MEASUREMENT
/begin CHARACTERISTIC c_amp_ad_pl_hys "hyteresis for ambient pressure Adaptation during part load" VALUE 0xffe414e4 _REC_VAL_20_u2 5434. _CNV_A_R_LINEAR_____49_CM 0. 5434. DISPLAY_IDENTIFIER C_AMP_AD_PL_HYS FORMAT "%7.2" /end CHARACTERISTIC
/begin CHARACTERISTIC c_amp_ad_dif_neg "Negative correction of the ambient pressure Adaptation during part load" VALUE 0xffe403a2 _REC_VAL_20_s2 5434. _CNV_A_R_LINEAR_____110_CM -2717.04 2716.96 DISPLAY_IDENTIFIER C_AMP_AD_DIF_NEG FORMAT "%8.2" /end CHARACTERISTIC
/begin CHARACTERISTIC c_amp_ad_dif_pos "Positive correction of the ambient pressure Adaptation during part load" VALUE 0xffe403a4 _REC_VAL_20_s2 5434. _CNV_A_R_LINEAR_____110_CM -2717.04 2716.96 DISPLAY_IDENTIFIER C_AMP_AD_DIF_POS FORMAT "%8.2" /end CHARACTERISTIC
/begin CHARACTERISTIC c_amp_dif_ti_lam_pos "positive correction of the ambient pressure Adaptation with lambda controller" VALUE 0xffe403a8 _REC_VAL_20_s2 5434. _CNV_A_R_LINEAR_____110_CM -2717.04 2716.96 DISPLAY_IDENTIFIER C_AMP_DIF_TI_LAM_POS FORMAT "%8.2" /end CHARACTERISTIC
/begin CHARACTERISTIC c_amp_max "maximum value for ambient pressure" VALUE 0xffe414f0 _REC_VAL_20_u2 5434. _CNV_A_R_LINEAR_____49_CM 0. 5434. DISPLAY_IDENTIFIER C_AMP_MAX FORMAT "%7.2" /end CHARACTERISTIC
/begin CHARACTERISTIC c_amp_min " minimum value for ambient pressure" VALUE 0xffe414f2 _REC_VAL_20_u2 5434. _CNV_A_R_LINEAR_____49_CM 0. 5434. DISPLAY_IDENTIFIER C_AMP_MIN FORMAT "%7.2" /end CHARACTERISTIC
/begin CHARACTERISTIC c_amp_ini "initial value for the ambient pressure" VALUE 0xffe414ee _REC_VAL_20_u2 5434. _CNV_A_R_LINEAR_____49_CM 0. 5434. DISPLAY_IDENTIFIER C_AMP_INI FORMAT "%7.2" /end CHARACTERISTIC
/begin CHARACTERISTIC c_amp_i_1 "I -value for the ambient pressure correction (LV_MAF_CTL = 1)" VALUE 0xffe414ea _REC_VAL_20_u2 7293750. _CNV_A_R_LINEAR_____384_CM 0. 7293750. DISPLAY_IDENTIFIER C_AMP_I_1 FORMAT "%8.0" /end CHARACTERISTIC
/begin CHARACTERISTIC c_amp_dif_ti_lam_neg "Negative correction of the ambient pressure Adaptation with lambda controller" VALUE 0xffe403a6 _REC_VAL_20_s2 5434. _CNV_A_R_LINEAR_____110_CM -2717.04 2716.96 DISPLAY_IDENTIFIER C_AMP_DIF_TI_LAM_NEG FORMAT "%8.2" /end CHARACTERISTIC
/begin CHARACTERISTIC c_amp_mdl_dif_i_min "Lower threshold of integral part of pressure controller" VALUE 0xffe403ac _REC_VAL_20_s2 679.239635 _CNV_A_R_LINEAR_____383_CM -339.625 339.614635 DISPLAY_IDENTIFIER C_AMP_MDL_DIF_I_MIN FORMAT "%7.2" /end CHARACTERISTIC
/begin CHARACTERISTIC c_amp_p_1 "P - Value for ambient pressure control (LV_MAF_CTL = 1)" VALUE 0xffe414fc _REC_VAL_20_u2 42.51956000000001 _CNV_A_R_LINEAR_____385_CM 0. 42.51956 DISPLAY_IDENTIFIER C_AMP_P_1 FORMAT "%8.5" /end CHARACTERISTIC
/begin CHARACTERISTIC c_amp_p_2 "P - Value for ambient pressure control (LV_MAP_CTL = 1)" VALUE 0xffe414fe _REC_VAL_20_u2 0.99998474 _CNV_A_R_LINEAR_____37_CM 0. 0.99998474 DISPLAY_IDENTIFIER C_AMP_P_2 FORMAT "%7.5" /end CHARACTERISTIC
/begin CHARACTERISTIC c_crlc_maf_kgh_amp_ad_pl "correlation constant for moving mean value calculation of MAF_KGH" VALUE 0xffe4068d _REC_VAL_20_u1 0.9960940000000002 _CNV_A_R_LINEAR_____50_CM 0. 0.996094 DISPLAY_IDENTIFIER C_CRLC_MAF_KGH_AMP_AD_PL FORMAT "%5.3" /end CHARACTERISTIC
/begin CHARACTERISTIC c_crlc_amp_mdl_dif_i_mmv "Correlation constant for moving mean value calculation of AMP_MDL_DIF_I" VALUE 0xffe40676 _REC_VAL_20_u1 0.9960940000000002 _CNV_A_R_LINEAR_____50_CM 0. 0.996094 DISPLAY_IDENTIFIER C_CRLC_AMP_MDL_DIF_I_MMV FORMAT "%5.3" /end CHARACTERISTIC
/begin CHARACTERISTIC c_map_drv1_max_amp_ad_pl "maximum value of the first derivative of manifold pressure for ambient pressure Adaptation part load" VALUE 0xffe417d0 _REC_VAL_20_u2 82.91626000000001 _CNV_A_R_LINEAR_____386_CM 0. 82.91625999999999 DISPLAY_IDENTIFIER C_MAP_DRV1_MAX_AMP_AD_PL FORMAT "%5.3" /end CHARACTERISTIC
/begin CHARACTERISTIC c_n_amp_ad_min "Minimum engine speed for ambient pressure learning" VALUE 0xffe407ca _REC_VAL_20_u1 8160. _CNV_A_R_LINEAR_____15_CM 0. 8160. DISPLAY_IDENTIFIER C_N_AMP_AD_MIN FORMAT "%4.0" /end CHARACTERISTIC
/begin CHARACTERISTIC c_n_amp_ad_max "Maximum engine speed for ambient pressure learning" VALUE 0xffe407c9 _REC_VAL_20_u1 8160. _CNV_A_R_LINEAR_____15_CM 0. 8160. DISPLAY_IDENTIFIER C_N_AMP_AD_MAX FORMAT "%4.0" /end CHARACTERISTIC
/begin CHARACTERISTIC c_n_min_amp_ad_pl "minimum value of the engine speed for ambient pressure Adaptation part load" VALUE 0xffe407f1 _REC_VAL_20_u1 8160. _CNV_A_R_LINEAR_____15_CM 0. 8160. DISPLAY_IDENTIFIER C_N_MIN_AMP_AD_PL FORMAT "%4.0" /end CHARACTERISTIC
/begin CHARACTERISTIC c_pq_amp_ad "pressure quotient for Adaptation ambient pressure" VALUE 0xffe41860 _REC_VAL_20_u2 0.99998474 _CNV_A_R_LINEAR_____37_CM 0. 0.99998474 DISPLAY_IDENTIFIER C_PQ_AMP_AD FORMAT "%7.5" /end CHARACTERISTIC
/begin CHARACTERISTIC c_pq_amp_ad_pl "pressure quotient for Adaptation ambient pressure at PL" VALUE 0xffe41862 _REC_VAL_20_u2 0.99998474 _CNV_A_R_LINEAR_____37_CM 0. 0.99998474 DISPLAY_IDENTIFIER C_PQ_AMP_AD_PL FORMAT "%7.5" /end CHARACTERISTIC
/begin CHARACTERISTIC c_seg_ctr_amp_ad "Segment counter of waiting time before allowing Adaptation of ambient pressure (typical value ³ 200)" VALUE 0xffe418a4 _REC_VAL_20_u2 65535. _CNV_A_R_LINEAR_____0_CM 0. 65535. DISPLAY_IDENTIFIER C_SEG_CTR_AMP_AD FORMAT "%5.0" /end CHARACTERISTIC
/begin CHARACTERISTIC c_seg_ctr_amp_ad_pl "segment counter for moving mean value calculation of AR_RED_BAS, MAF_KGH_MMV" VALUE 0xffe418a6 _REC_VAL_20_u2 65535. _CNV_A_R_LINEAR_____0_CM 0. 65535. DISPLAY_IDENTIFIER C_SEG_CTR_AMP_AD_PL FORMAT "%5.0" /end CHARACTERISTIC
/begin CHARACTERISTIC c_t_ast_amp_ctl_deac "Time for deactivation of pressure control after start" VALUE 0xffe418d2 _REC_VAL_20_u2 6553.5 _CNV_A_R_LINEAR_____24_CM 0. 6553.5 DISPLAY_IDENTIFIER C_T_AST_AMP_CTL_DEAC FORMAT "%6.1" /end CHARACTERISTIC
/begin CHARACTERISTIC c_ti_lam_maf_puls_max "positive threshold of the ambient pressure Adaptation in pulsation" VALUE 0xffe4049a _REC_VAL_20_s2 99.99847412 _CNV_A_R_LINEAR_____111_CM -50. 49.99847412 DISPLAY_IDENTIFIER C_TI_LAM_MAF_PULS_MAX FORMAT "%6.2" /end CHARACTERISTIC
/begin CHARACTERISTIC c_ti_lam_maf_puls_min "negative threshold of the ambient pressure Adaptation in pulsation" VALUE 0xffe4049c _REC_VAL_20_s2 99.99847412 _CNV_A_R_LINEAR_____111_CM -50. 49.99847412 DISPLAY_IDENTIFIER C_TI_LAM_MAF_PULS_MIN FORMAT "%6.2" /end CHARACTERISTIC
/begin CHARACTERISTIC c_tps_min_amp_ad_pl "minimum value of the throttle position for ambient pressure Adaptation part load" VALUE 0xffe41a9a _REC_VAL_20_u2 119.5 _CNV_A_R_LINEAR_____53_CM 0. 119.5 DISPLAY_IDENTIFIER C_TPS_MIN_AMP_AD_PL /end CHARACTERISTIC
/begin MEASUREMENT ar_red_dif_i_rel_mmv "Moving mean I-value (relative) of the closed loop control reduced throttle area" SWORD _CNV_A_R_LINEAR_____111_CM 1 100. -50. 49.99847412 DISPLAY_IDENTIFIER AR_RED_DIF_I_REL_MMV ECU_ADDRESS 0x3fd2a2 BYTE_ORDER MSB_LAST FORMAT "%7.3" /end MEASUREMENT
/begin MEASUREMENT ar_red_dif_p_rel "P-value (relative) of the closed loop control reduced throttle area" SWORD _CNV_A_R_LINEAR_____111_CM 1 100. -50. 49.99847412 DISPLAY_IDENTIFIER AR_RED_DIF_P_REL ECU_ADDRESS 0x3fd2de BYTE_ORDER MSB_LAST FORMAT "%7.3" /end MEASUREMENT
/begin MEASUREMENT map_mdl_mv "Mean value of the model manifold pressure" UWORD _CNV_A_R_LINEAR_____49_CM 1 100. 0. 5434. DISPLAY_IDENTIFIER MAP_MDL_MV ECU_ADDRESS 0x3fd2b8 BYTE_ORDER MSB_LAST FORMAT "%7.2" /end MEASUREMENT
/begin MEASUREMENT map_mdl_dif "Deviation between measured and callculated manifold pressure" SWORD _CNV_A_R_LINEAR_____110_CM 1 100. -2717.04 2716.96 DISPLAY_IDENTIFIER MAP_MDL_DIF ECU_ADDRESS 0x3fd2ba BYTE_ORDER MSB_LAST FORMAT "%8.2" /end MEASUREMENT
/begin MEASUREMENT maf_mdl_mv "Model air mass flow mean value" UWORD _CNV_A_R_LINEAR_____115_CM 1 100. 0. 2047.96875 DISPLAY_IDENTIFIER MAF_MDL_MV ECU_ADDRESS 0x3fd2b2 BYTE_ORDER MSB_LAST FORMAT "%7.2" /end MEASUREMENT
/begin MEASUREMENT maf_mdl_dif "Deviation of model air mass flow" SWORD _CNV_A_R_LINEAR_____115_CM 1 100. -1024. 1023.96875 DISPLAY_IDENTIFIER MAF_MDL_DIF ECU_ADDRESS 0x3fd2b6 BYTE_ORDER MSB_LAST FORMAT "%6.2" /end MEASUREMENT
/begin CHARACTERISTIC c_amp_i_2 "I - Value for the ambient pressure correction(LV_MAF_CTL = 1)" VALUE 0xffe414ec _REC_VAL_20_u2 61.034223 _CNV_A_R_LINEAR_____387_CM 0. 61.034223 DISPLAY_IDENTIFIER C_AMP_I_2 FORMAT "%7.4" /end CHARACTERISTIC
/begin CHARACTERISTIC c_ar_red_ad_add_min "Minimum allowed value for additive reduced area Adaptation" VALUE 0xffe403b4 _REC_VAL_20_s2 58.59285547 _CNV_A_R_LINEAR_____388_CM -29.296875 29.29598047 DISPLAY_IDENTIFIER C_AR_RED_AD_ADD_MIN FORMAT "%8.4" /end CHARACTERISTIC
/begin CHARACTERISTIC c_ar_red_ad_fac_max "Maximum allowed value for multiplicative reduced area Adaptation" VALUE 0xffe403b6 _REC_VAL_20_s2 99.99847412 _CNV_A_R_LINEAR_____111_CM -50. 49.99847412 DISPLAY_IDENTIFIER C_AR_RED_AD_FAC_MAX FORMAT "%7.3" /end CHARACTERISTIC
/begin CHARACTERISTIC c_ar_red_ad_fac_min "Minimum allowed value for multiplicative reduced area Adaptation" VALUE 0xffe403b8 _REC_VAL_20_s2 99.99847412 _CNV_A_R_LINEAR_____111_CM -50. 49.99847412 DISPLAY_IDENTIFIER C_AR_RED_AD_FAC_MIN FORMAT "%7.3" /end CHARACTERISTIC
/begin CHARACTERISTIC c_ar_red_dif_i_rel_min "Minimum value for AR_RED_ DIF_I_REL" VALUE 0xffe403c0 _REC_VAL_20_s2 99.99847412 _CNV_A_R_LINEAR_____111_CM -50. 49.99847412 DISPLAY_IDENTIFIER C_AR_RED_DIF_I_REL_MIN FORMAT "%7.3" /end CHARACTERISTIC
/begin CHARACTERISTIC c_crlc_ar_red_bas_amp_ad_pl "correlation constant for moving mean value calculation of AR_RED_BAS" VALUE 0xffe40679 _REC_VAL_20_u1 0.9960940000000002 _CNV_A_R_LINEAR_____50_CM 0. 0.996094 DISPLAY_IDENTIFIER C_CRLC_AR_RED_BAS_AMP_AD_PL FORMAT "%5.3" /end CHARACTERISTIC
/begin CHARACTERISTIC c_crlc_ar_red_dif_i_rel_mmv "Correlation constant for the moving mean value calculation of AR_RED_DIF_I_REL" VALUE 0xffe4067a _REC_VAL_20_u1 0.9960940000000002 _CNV_A_R_LINEAR_____50_CM 0. 0.996094 DISPLAY_IDENTIFIER C_CRLC_AR_RED_DIF_I_REL_MMV FORMAT "%5.3" /end CHARACTERISTIC
/begin CHARACTERISTIC c_n_ar_red_ad_add_max "Maximum engine speed for learning of additive Adaptation value" VALUE 0xffe407cb _REC_VAL_20_u1 8160. _CNV_A_R_LINEAR_____15_CM 0. 8160. DISPLAY_IDENTIFIER C_N__AR_RED__AD_ADD_MAX FORMAT "%4.0" /end CHARACTERISTIC
/begin CHARACTERISTIC c_n_ar_red_ad_fac_min "Minimum engine speed for learning of multiplicative Adaptation value" VALUE 0xffe407ce _REC_VAL_20_u1 8160. _CNV_A_R_LINEAR_____15_CM 0. 8160. DISPLAY_IDENTIFIER C_N__AR_RED__AD_FAC_MIN FORMAT "%4.0" /end CHARACTERISTIC
/begin CHARACTERISTIC c_n_ar_red_ad_fac_max "Maximum engine speed for learning of multiplicative Adaptation value" VALUE 0xffe407cd _REC_VAL_20_u1 8160. _CNV_A_R_LINEAR_____15_CM 0. 8160. DISPLAY_IDENTIFIER C_N__AR_RED__AD_FAC_MAX FORMAT "%4.0" /end CHARACTERISTIC
/begin CHARACTERISTIC c_pq_ar_red_ad_fac_max "Maximum pressure quotient for learning of multiplicative Adaptation value" VALUE 0xffe4186a _REC_VAL_20_u2 0.99998474 _CNV_A_R_LINEAR_____37_CM 0. 0.99998474 DISPLAY_IDENTIFIER C_PQ__AR_RED__AD_FAC_MAX FORMAT "%7.5" /end CHARACTERISTIC
/begin CHARACTERISTIC c_pq_ar_red_ad_fac_min "Minimum pressure quotient for learning of multiplicative Adaptation value" VALUE 0xffe4186c _REC_VAL_20_u2 0.99998474 _CNV_A_R_LINEAR_____37_CM 0. 0.99998474 DISPLAY_IDENTIFIER C_PQ__AR_RED__AD_FAC_MIN FORMAT "%7.5" /end CHARACTERISTIC
/begin CHARACTERISTIC c_pq_ar_red_ad_add_max "Maximum pressure quotient for learning of additive Adaptation value" VALUE 0xffe41868 _REC_VAL_20_u2 0.99998474 _CNV_A_R_LINEAR_____37_CM 0. 0.99998474 DISPLAY_IDENTIFIER C_PQ__AR_RED__AD_ADD_MAX FORMAT "%7.5" /end CHARACTERISTIC
/begin CHARACTERISTIC c_t_ast_ar_red_ctl_deac "Time to deactivate reduced area control after engine start" VALUE 0xffe418d4 _REC_VAL_20_u2 6553.5 _CNV_A_R_LINEAR_____24_CM 0. 6553.5 DISPLAY_IDENTIFIER C_T_AST_AR_RED_CTL_DEAC FORMAT "%6.1" /end CHARACTERISTIC
/begin CHARACTERISTIC ip_ar_red_i_rel_1__n__pq "I-value (relative) reduced throttle area (MAF-controlled)" MAP 0xffe48f90 _REC_MAP_20_u2_u1_u2 171660. _CNV_A_R_LINEAR_____389_CM 0. 171660. DISPLAY_IDENTIFIER IP_AR_RED_I_REL_1__N__PQ FORMAT "%6.0"
 /begin AXIS_DESCR COM_AXIS n_32 _CNV_A_R_LINEAR_____15_CM 6 0. 8160. FORMAT "%4.0" AXIS_PTS_REF ldpm_n_ar_red /end AXIS_DESCR
 /begin AXIS_DESCR COM_AXIS pq _CNV_A_R_LINEAR_____37_CM 4 0. 0.99998474 FORMAT "%7.5" AXIS_PTS_REF ldpm_pq_ar_red /end AXIS_DESCR
/end CHARACTERISTIC
/begin CHARACTERISTIC ip_ar_red_i_rel_2__n__pq "I-value reduced throttle area (MAP-controlled)" MAP 0xffe48fc0 _REC_MAP_20_u2_u1_u2 2.24636 _CNV_A_R_LINEAR_____390_CM 0. 2.24636 DISPLAY_IDENTIFIER IP_AR_RED_I_REL_2__N__PQ FORMAT "%6.4"
 /begin AXIS_DESCR COM_AXIS n_32 _CNV_A_R_LINEAR_____15_CM 6 0. 8160. FORMAT "%4.0" AXIS_PTS_REF ldpm_n_ar_red /end AXIS_DESCR
 /begin AXIS_DESCR COM_AXIS pq _CNV_A_R_LINEAR_____37_CM 4 0. 0.99998474 FORMAT "%7.5" AXIS_PTS_REF ldpm_pq_ar_red /end AXIS_DESCR
/end CHARACTERISTIC
/begin CHARACTERISTIC ip_ar_red_p_rel_2__n__pq "P-value reduced throttle area (MAP-controlled)" MAP 0xffe49040 _REC_MAP_20_u2_u1_u2 0.5888600000000001 _CNV_A_R_LINEAR_____391_CM 0. 0.5888600000000001 DISPLAY_IDENTIFIER IP_AR_RED_P_REL_2__N__PQ FORMAT "%7.5"
 /begin AXIS_DESCR COM_AXIS n_32 _CNV_A_R_LINEAR_____15_CM 6 0. 8160. FORMAT "%4.0" AXIS_PTS_REF ldpm_n_ar_red /end AXIS_DESCR
 /begin AXIS_DESCR COM_AXIS pq _CNV_A_R_LINEAR_____37_CM 4 0. 0.99998474 FORMAT "%7.5" AXIS_PTS_REF ldpm_pq_ar_red /end AXIS_DESCR
/end CHARACTERISTIC
/begin CHARACTERISTIC ip_t_1_hfm__maf_kgh "time constant hot film air mass meter" CURVE 0xffe41ca0 _REC_CUR_20_u2_u2 65.535 _CNV_A_R_LINEAR_____392_CM 0. 65.535 DISPLAY_IDENTIFIER IP_T_1_HFM
 /begin AXIS_DESCR COM_AXIS maf_kgh _CNV_A_R_LINEAR_____115_CM 4 0. 2047.96875 FORMAT "%7.2" AXIS_PTS_REF ldpm_maf_kgh_t_1_hfm /end AXIS_DESCR
/end CHARACTERISTIC
/begin CHARACTERISTIC c_lgrd_amp_mdl_dif_tra "Linear negative gradient of ambient pressure control during reduced area control" VALUE 0xffe41700 _REC_VAL_20_u2 5434. _CNV_A_R_LINEAR_____49_CM 0. 5434. DISPLAY_IDENTIFIER C_LGRD_AMP_MDL_DIF_TRA FORMAT "%7.2" /end CHARACTERISTIC
/begin CHARACTERISTIC c_lgrd_ar_red_dif_tra "Linear negative gradient of reduced area control during ambient pressure control" VALUE 0xffe41702 _REC_VAL_20_u2 99.99847412 _CNV_A_R_LINEAR_____8_CM 0. 99.99847412 DISPLAY_IDENTIFIER C_LGRD_AR_RED_DIF_TRA /end CHARACTERISTIC
/begin CHARACTERISTIC c_crlc_ar_red_ad_add "Factor for the additive reduced area Adaptation" VALUE 0xffe40677 _REC_VAL_20_u1 0.9960940000000002 _CNV_A_R_LINEAR_____50_CM 0. 0.996094 DISPLAY_IDENTIFIER C_CRLC_AR_RED_AD_ADD FORMAT "%5.3" /end CHARACTERISTIC
/begin CHARACTERISTIC c_crlc_ar_red_ad_fac "Factor for the multiplicative reduced area Adaptation" VALUE 0xffe40678 _REC_VAL_20_u1 0.9960940000000002 _CNV_A_R_LINEAR_____50_CM 0. 0.996094 DISPLAY_IDENTIFIER C_CRLC_AR_RED_AD_FAC FORMAT "%5.3" /end CHARACTERISTIC
/begin CHARACTERISTIC c_ar_red_dif_i_rel_max "Maximum value for AR_RED_ DIF_I_REL" VALUE 0xffe403be _REC_VAL_20_s2 99.99847412 _CNV_A_R_LINEAR_____111_CM -50. 49.99847412 DISPLAY_IDENTIFIER C_AR_RED_DIF_I_REL_MAX FORMAT "%7.3" /end CHARACTERISTIC
/begin CHARACTERISTIC c_ar_red_ad_add_max "Maximum allowed value for additive reduced area Adaptation" VALUE 0xffe403b2 _REC_VAL_20_s2 58.59285547 _CNV_A_R_LINEAR_____388_CM -29.296875 29.29598047 DISPLAY_IDENTIFIER C_AR_RED_AD_ADD_MAX FORMAT "%8.4" /end CHARACTERISTIC
/begin CHARACTERISTIC lc_ar_red_ad_ena "Logical variable enabled for permission of adaptive values for PUC" VALUE 0xffe40f39 _REC_VAL_20_u1 1. _CNV_A_R_LINEAR_____22_CM 0. 1. DISPLAY_IDENTIFIER LC_AR_RED_AD_ENA FORMAT "%1.0" /end CHARACTERISTIC
/begin MEASUREMENT ar_red "Reduced area at the throttle" UWORD _CNV_A_R_LINEAR_____382_CM 1 100. 0. 58.592855 DISPLAY_IDENTIFIER AR_RED ECU_ADDRESS 0x3fd29c BYTE_ORDER MSB_LAST FORMAT "%7.4" /end MEASUREMENT
/begin CHARACTERISTIC ip_ar_red_p_rel_1__n__pq "P-value reduced throttle area (MAF-controlled)" MAP 0xffe49010 _REC_MAP_20_u2_u1_u2 12.5005 _CNV_A_R_LINEAR_____393_CM 0. 12.5005 DISPLAY_IDENTIFIER IP_AR_RED_P_REL_1__N__PQ FORMAT "%7.4"
 /begin AXIS_DESCR COM_AXIS n_32 _CNV_A_R_LINEAR_____15_CM 6 0. 8160. FORMAT "%4.0" AXIS_PTS_REF ldpm_n_ar_red /end AXIS_DESCR
 /begin AXIS_DESCR COM_AXIS pq _CNV_A_R_LINEAR_____37_CM 4 0. 0.99998474 FORMAT "%7.5" AXIS_PTS_REF ldpm_pq_ar_red /end AXIS_DESCR
/end CHARACTERISTIC
/begin MEASUREMENT ar_red_dif_i_rel "I-value (relative) of the closed loop control reduced throttle area" SWORD _CNV_A_R_LINEAR_____111_CM 1 100. -50. 49.99847412 DISPLAY_IDENTIFIER AR_RED_DIF_I_REL ECU_ADDRESS 0x3fd2a0 BYTE_ORDER MSB_LAST FORMAT "%7.3" /end MEASUREMENT
/begin MEASUREMENT ar_red_dif_rel "Correction of reduced throttle area" SWORD _CNV_A_R_LINEAR_____111_CM 1 100. -50. 49.99847412 DISPLAY_IDENTIFIER AR_RED_DIF_REL ECU_ADDRESS 0x3fd29e BYTE_ORDER MSB_LAST FORMAT "%7.3" /end MEASUREMENT
/begin MEASUREMENT ar_red_isa_dif_rel "Correction of reduced throttle area" SWORD _CNV_A_R_LINEAR_____111_CM 1 100. -50. 49.99847412 DISPLAY_IDENTIFIER AR_RED_ISA_DIF_REL ECU_ADDRESS 0x3fd2cc BYTE_ORDER MSB_LAST FORMAT "%7.3" /end MEASUREMENT
/begin MEASUREMENT amp_mdl_dif "Value of the closed loop control of ambient pressure (sum of I and P part)" SWORD _CNV_A_R_LINEAR_____110_CM 1 100. -2717.04 2716.96 DISPLAY_IDENTIFIER AMP_MDL_DIF ECU_ADDRESS 0x3fd2c6 BYTE_ORDER MSB_LAST FORMAT "%8.2" /end MEASUREMENT
/begin CHARACTERISTIC c_crlc_map_mdl "correlation constant for model manifold pressure" VALUE 0xffe4068e _REC_VAL_20_u1 0.9960940000000002 _CNV_A_R_LINEAR_____50_CM 0. 0.996094 DISPLAY_IDENTIFIER C_CRLC_MAP_MDL FORMAT "%5.3" /end CHARACTERISTIC
/begin MEASUREMENT ar_red_isa_ad_add "Additive adaptive factor for ISA" SWORD _CNV_A_R_LINEAR_____388_CM 1 100. -29.296875 29.29598047 DISPLAY_IDENTIFIER AR_RED_ISA_AD_ADD ECU_ADDRESS 0x3fd2d6 BYTE_ORDER MSB_LAST FORMAT "%8.4" /end MEASUREMENT
/begin MEASUREMENT ar_red_ad_fac "Multiplicative adaptive factor" SWORD _CNV_A_R_LINEAR_____111_CM 1 100. -50. 49.99847412 DISPLAY_IDENTIFIER AR_RED_AD_FAC ECU_ADDRESS 0x3fd2a6 BYTE_ORDER MSB_LAST FORMAT "%7.3" /end MEASUREMENT
/begin MEASUREMENT ar_red_isa_ad_fac "Multiplicative adaptive factor for ISA" SWORD _CNV_A_R_LINEAR_____111_CM 1 100. -50. 49.99847412 DISPLAY_IDENTIFIER AR_RED_ISA_AD_FAC ECU_ADDRESS 0x3fd2d8 BYTE_ORDER MSB_LAST FORMAT "%7.3" /end MEASUREMENT
/begin MEASUREMENT ar_red_ad_fac_cor "Correction factor for entire adaptive factor" SWORD _CNV_A_R_LINEAR_____111_CM 1 100. -50. 49.99847412 DISPLAY_IDENTIFIER AR_RED_AD_FAC_COR ECU_ADDRESS 0x3fd2a8 BYTE_ORDER MSB_LAST FORMAT "%7.3" /end MEASUREMENT
/begin MEASUREMENT ar_red_isa_ad_fac_cor "Correction factor for entire adaptive factor for ISA" SWORD _CNV_A_R_LINEAR_____111_CM 1 100. -50. 49.99847412 DISPLAY_IDENTIFIER AR_RED_ISA_AD_FAC_COR ECU_ADDRESS 0x3fd2d4 BYTE_ORDER MSB_LAST FORMAT "%7.3" /end MEASUREMENT
/begin CHARACTERISTIC c_n_ar_red_ad_add_min "Minimum engine speed for learning of additive Adaptation value" VALUE 0xffe407cc _REC_VAL_20_u1 8160. _CNV_A_R_LINEAR_____15_CM 0. 8160. DISPLAY_IDENTIFIER C_N__AR_RED__AD_ADD_MIN FORMAT "%4.0" /end CHARACTERISTIC
/begin CHARACTERISTIC c_n_ar_red_isa_ad_add_min "Minimum engine speed for learning of additive Adaptation value of ISA" VALUE 0xffe407d0 _REC_VAL_20_u1 8160. _CNV_A_R_LINEAR_____15_CM 0. 8160. DISPLAY_IDENTIFIER C_N_AR_RED_ISA_AD_ADD_MIN FORMAT "%4.0" /end CHARACTERISTIC
/begin CHARACTERISTIC c_n_ar_red_isa_ad_add_max "Maximum engine speed for learning of additive Adaptation value of ISA" VALUE 0xffe407cf _REC_VAL_20_u1 8160. _CNV_A_R_LINEAR_____15_CM 0. 8160. DISPLAY_IDENTIFIER C_N_AR_RED_ISA_AD_ADD_MAX FORMAT "%4.0" /end CHARACTERISTIC
/begin CHARACTERISTIC c_ar_red_bas_ad_add_max "Maximum AR_RED_BAS for learning of additive Adaptation value of THR" VALUE 0xffe41502 _REC_VAL_20_u2 58.592855 _CNV_A_R_LINEAR_____382_CM 0. 58.592855 DISPLAY_IDENTIFIER C_AR_RED_BAS_AD_ADD_MAX FORMAT "%7.4" /end CHARACTERISTIC
/begin CHARACTERISTIC c_ar_red_bas_isa_ad_add_max "Maximum AR_RED_BAS for learning of additive Adaptation value of ISA" VALUE 0xffe41504 _REC_VAL_20_u2 58.592855 _CNV_A_R_LINEAR_____382_CM 0. 58.592855 DISPLAY_IDENTIFIER C_AR_RED_BAS_ISA_AD_ADD_MAX FORMAT "%7.4" /end CHARACTERISTIC
/begin CHARACTERISTIC c_crlc_ar_red_isa_ad_add "Filter factor for the addidive reduced area Adaptation of ISA" VALUE 0xffe4067b _REC_VAL_20_u1 0.9960940000000002 _CNV_A_R_LINEAR_____50_CM 0. 0.996094 DISPLAY_IDENTIFIER C_CRLC_AR_RED_ISA_AD_ADD FORMAT "%5.3" /end CHARACTERISTIC
/begin CHARACTERISTIC c_ar_red_isa_ad_add_min "Minimum allowed value for additive reduced area Adaptation of ISA" VALUE 0xffe403c4 _REC_VAL_20_s2 58.59285547 _CNV_A_R_LINEAR_____388_CM -29.296875 29.29598047 DISPLAY_IDENTIFIER C_AR_RED_ISA_AD_ADD_MIN FORMAT "%8.4" /end CHARACTERISTIC
/begin CHARACTERISTIC c_ar_red_isa_ad_add_max "Maximum allowed value for additive reduced area Adaptation of ISA" VALUE 0xffe403c2 _REC_VAL_20_s2 58.59285547 _CNV_A_R_LINEAR_____388_CM -29.296875 29.29598047 DISPLAY_IDENTIFIER C_AR_RED_ISA_AD_ADD_MAX FORMAT "%8.4" /end CHARACTERISTIC
/begin CHARACTERISTIC c_n_ar_red_isa_ad_fac_min "Minimum engine speed for learning of multiplicative Adaptation value of ISA" VALUE 0xffe407d2 _REC_VAL_20_u1 8160. _CNV_A_R_LINEAR_____15_CM 0. 8160. DISPLAY_IDENTIFIER C_N_AR_RED_ISA_AD_FAC_MIN FORMAT "%4.0" /end CHARACTERISTIC
/begin CHARACTERISTIC c_n_ar_red_isa_ad_fac_max "Maximum engine speed for learning of multiplicative Adaptation value of ISA" VALUE 0xffe407d1 _REC_VAL_20_u1 8160. _CNV_A_R_LINEAR_____15_CM 0. 8160. DISPLAY_IDENTIFIER C_N_AR_RED_ISA_AD_FAC_MAX FORMAT "%4.0" /end CHARACTERISTIC
/begin CHARACTERISTIC c_pq_ar_red_isa_ad_add_max "Maximum pressure quotient for learning of additive Adaptation value of ISA" VALUE 0xffe4186e _REC_VAL_20_u2 0.99998474 _CNV_A_R_LINEAR_____37_CM 0. 0.99998474 DISPLAY_IDENTIFIER C_PQ_AR_RED_ISA_AD_ADD_MAX FORMAT "%7.5" /end CHARACTERISTIC
/begin CHARACTERISTIC c_pq_ar_red_isa_ad_fac_min "Minimum pressure quotient for learning of multiplicative Adaptation value of ISA" VALUE 0xffe41872 _REC_VAL_20_u2 0.99998474 _CNV_A_R_LINEAR_____37_CM 0. 0.99998474 DISPLAY_IDENTIFIER C_PQ_AR_RED_ISA_AD_FAC_MIN FORMAT "%7.5" /end CHARACTERISTIC
/begin CHARACTERISTIC c_pq_ar_red_isa_ad_fac_max "Maximum pressure quotient for learning of multiplicative Adaptation value of ISA" VALUE 0xffe41870 _REC_VAL_20_u2 0.99998474 _CNV_A_R_LINEAR_____37_CM 0. 0.99998474 DISPLAY_IDENTIFIER C_PQ_AR_RED_ISA_AD_FAC_MAX FORMAT "%7.5" /end CHARACTERISTIC
/begin CHARACTERISTIC c_ar_red_bas_ad_fac_min "Minimum AR_RED_BAS for learning of multiplicative Adaptation value of THR" VALUE 0xffe403bc _REC_VAL_20_s2 58.59285547 _CNV_A_R_LINEAR_____388_CM -29.296875 29.29598047 DISPLAY_IDENTIFIER C_AR_RED_BAS_AD_FAC_MIN FORMAT "%8.4" /end CHARACTERISTIC
/begin CHARACTERISTIC c_ar_red_bas_ad_fac_max "Maximum AR_RED_BAS for learning of multiplicative Adaptation value of ISA" VALUE 0xffe403ba _REC_VAL_20_s2 58.59285547 _CNV_A_R_LINEAR_____388_CM -29.296875 29.29598047 DISPLAY_IDENTIFIER C_AR_RED_BAS_AD_FAC_MAX FORMAT "%8.4" /end CHARACTERISTIC
/begin CHARACTERISTIC c_crlc_ar_red_isa_ad_fac "Filter factor for the multiplicative reduced area Adaptation of THR" VALUE 0xffe4067c _REC_VAL_20_u1 0.9960940000000002 _CNV_A_R_LINEAR_____50_CM 0. 0.996094 DISPLAY_IDENTIFIER C_CRLC_AR_RED_ISA_AD_FAC FORMAT "%5.3" /end CHARACTERISTIC
/begin CHARACTERISTIC c_ar_red_isa_bas_ad_min "Minimum AR_RED_ISA_BAS for learning of multiplicative Adaptation value of ISA" VALUE 0xffe403cc _REC_VAL_20_s2 58.59285547 _CNV_A_R_LINEAR_____388_CM -29.296875 29.29598047 DISPLAY_IDENTIFIER C_AR_RED_ISA_BAS_AD_MIN FORMAT "%8.4" /end CHARACTERISTIC
/begin CHARACTERISTIC c_ar_red_isa_bas_ad_max "Maximum AR_RED_ISA_BAS for learning of multiplicative Adaptation value of ISA" VALUE 0xffe403ca _REC_VAL_20_s2 58.59285547 _CNV_A_R_LINEAR_____388_CM -29.296875 29.29598047 DISPLAY_IDENTIFIER C_AR_RED_ISA_BAS_AD_MAX FORMAT "%8.4" /end CHARACTERISTIC
/begin CHARACTERISTIC c_ar_red_isa_ad_fac_min "Minimum allowed value for multiplicative reduced area Adaptation of ISA" VALUE 0xffe403c8 _REC_VAL_20_s2 99.99847412 _CNV_A_R_LINEAR_____111_CM -50. 49.99847412 DISPLAY_IDENTIFIER C_AR_RED_ISA_AD_FAC_MIN FORMAT "%7.3" /end CHARACTERISTIC
/begin CHARACTERISTIC c_ar_red_isa_ad_fac_max "Maximum allowed value for multiplicative reduced area Adaptation of ISA" VALUE 0xffe403c6 _REC_VAL_20_s2 99.99847412 _CNV_A_R_LINEAR_____111_CM -50. 49.99847412 DISPLAY_IDENTIFIER C_AR_RED_ISA_AD_FAC_MAX FORMAT "%7.3" /end CHARACTERISTIC
/begin CHARACTERISTIC ip_fac_ar_red_cor__pq "Weighting function for decreasing multiplicative learning controller value during PQ>C_PQ_AMP_CTL" CURVE 0xffe40b23 _REC_CUR_20_u1_u2 0.9960940000000002 _CNV_A_R_LINEAR_____50_CM 0. 0.996094 DISPLAY_IDENTIFIER IP_FAC_AR_RED_COR__PQ FORMAT "%5.3"
 /begin AXIS_DESCR COM_AXIS pq _CNV_A_R_LINEAR_____37_CM 8 0. 0.99998474 FORMAT "%7.5" AXIS_PTS_REF ldpm_pq__fac_ar_red_cor /end AXIS_DESCR
/end CHARACTERISTIC
/begin CHARACTERISTIC ip_fac_ar_red_isa_cor__pq "Weighting function for decreasing multiplicative Adaptation of ISA during PQ>C_PQ_AMP_CTL" CURVE 0xffe40b33 _REC_CUR_20_u1_u2 0.9960940000000002 _CNV_A_R_LINEAR_____50_CM 0. 0.996094 DISPLAY_IDENTIFIER IP_FAC_AR_RED_ISA_COR__PQ FORMAT "%5.3"
 /begin AXIS_DESCR COM_AXIS pq _CNV_A_R_LINEAR_____37_CM 8 0. 0.99998474 FORMAT "%7.5" AXIS_PTS_REF ldpm_pq__fac_ar_red_cor /end AXIS_DESCR
/end CHARACTERISTIC
/begin CHARACTERISTIC ip_crlc_hfm__t_seg_t_1_ratio "correlation constant for the first order time delay of the calculated air mass flow at the throttle" CURVE 0xffe49158 _REC_CUR_20_u2_u2 0.99998474 _CNV_A_R_LINEAR_____37_CM 0. 0.99998474 DISPLAY_IDENTIFIER IP_CRLC_HFM FORMAT "%7.5"
 /begin AXIS_DESCR COM_AXIS online_dummy _CNV_A_R_LINEAR_____394_CM 6 0. 7.99987793 FORMAT "%6.4" AXIS_PTS_REF ldp_t_seg_t_1_ratio_crlc_hfm /end AXIS_DESCR
/end CHARACTERISTIC
/begin CHARACTERISTIC ip_crlc_ar_red_ad_add_mmv "Averaging constant for the calculation of the mean value AR_RED_AD_ADD_MMV" CURVE 0xffe40acb _REC_CUR_20_u1_u2 0.9960940000000002 _CNV_A_R_LINEAR_____50_CM 0. 0.996094 DISPLAY_IDENTIFIER IP_CRLC_AR_RED_AD_ADD_MMV FORMAT "%5.3"
 /begin AXIS_DESCR COM_AXIS ar_red_ad_add_dif _CNV_A_R_LINEAR_____382_CM 4 0. 58.592855 FORMAT "%7.4" AXIS_PTS_REF ldp_ar_red_ad_add_dif /end AXIS_DESCR
/end CHARACTERISTIC
/begin MEASUREMENT ar_red_ad_add "Additive adaptive factor" SWORD _CNV_A_R_LINEAR_____388_CM 1 100. -29.296875 29.29598047 DISPLAY_IDENTIFIER AR_RED_AD_ADD ECU_ADDRESS 0x3fd2a4 BYTE_ORDER MSB_LAST FORMAT "%8.4" /end MEASUREMENT
/begin MEASUREMENT ar_red_ad_add_mmv "Moving mean value of the addirive adaptive parameter" SWORD _CNV_A_R_LINEAR_____388_CM 1 100. -29.296875 29.29598047 DISPLAY_IDENTIFIER AR_RED_AD_ADD_MMV ECU_ADDRESS 0x3fd2ac BYTE_ORDER MSB_LAST FORMAT "%8.4" /end MEASUREMENT
/begin MEASUREMENT ar_red_ad_add_dif "Adaptation demand during current driving cycle" UWORD _CNV_A_R_LINEAR_____382_CM 1 100. 0. 58.592855 DISPLAY_IDENTIFIER AR_RED_AD_ADD_DIF ECU_ADDRESS 0x3fd2ae BYTE_ORDER MSB_LAST FORMAT "%7.4" /end MEASUREMENT
/begin MEASUREMENT lv_act_ar_red_ad_add "Conditions for reduced throttle area adaptation are fullfilled" UBYTE _CNV_S_2_RANGE______2_CM 1 100. 0. 1. DISPLAY_IDENTIFIER LV_ACT_AR_RED_AD_ADD ECU_ADDRESS 0x3fe48a /end MEASUREMENT
/begin MEASUREMENT ar_red_isa_dif_i_rel_mmv "moving mean I-value (relative) of the closed loop control reduced ISA valve area" SWORD _CNV_A_R_LINEAR_____111_CM 1 100. -50. 49.99847412 DISPLAY_IDENTIFIER AR_RED_ISA_DIF_I_REL_MMV ECU_ADDRESS 0x3fd2d0 BYTE_ORDER MSB_LAST FORMAT "%7.3" /end MEASUREMENT
/begin MEASUREMENT ar_red_thr_dif_i_rel_mmv "moving mean I-value (relative) of the closed loop control reduced throttle area" SWORD _CNV_A_R_LINEAR_____111_CM 1 100. -50. 49.99847412 DISPLAY_IDENTIFIER AR_RED_THR_DIF_I_REL_MMV ECU_ADDRESS 0x3fd2ce BYTE_ORDER MSB_LAST FORMAT "%7.3" /end MEASUREMENT
/begin MEASUREMENT ar_red_isa "Reduced area at the ISA" UWORD _CNV_A_R_LINEAR_____382_CM 1 100. 0. 58.592855 DISPLAY_IDENTIFIER AR_RED_ISA ECU_ADDRESS 0x3fd2ca BYTE_ORDER MSB_LAST FORMAT "%7.4" /end MEASUREMENT
/begin MEASUREMENT ar_red_isa_max "Maximum reduced area at the ISA, with AR_RED-controller and -Adaptation" UWORD _CNV_A_R_LINEAR_____382_CM 1 100. 0. 58.592855 DISPLAY_IDENTIFIER AR_RED_ISA_MAX ECU_ADDRESS 0x3fd2d2 BYTE_ORDER MSB_LAST FORMAT "%7.4" /end MEASUREMENT
/begin AXIS_PTS ldpm_pq_ar_red "" 0xffe51c56 pq _REC_AXS_20_u2 0.99998474 _CNV_A_R_LINEAR_____37_CM 4 0. 0.99998474 DISPLAY_IDENTIFIER LDPM_PQ_AR_RED FORMAT "%7.5" /end AXIS_PTS
/begin AXIS_PTS ldpm_maf_kgh_t_1_hfm "" 0xffe519c2 maf_kgh _REC_AXS_20_u2 204.796875 _CNV_A_R_LINEAR_____115_CM 4 0. 2047.96875 DISPLAY_IDENTIFIER LDPM_MAF_KGH_T_1_HFM FORMAT "%7.2" /end AXIS_PTS
/begin AXIS_PTS ldpm_n_ar_red "" 0xffe413f6 n_32 _REC_AXS_20_u1 8160. _CNV_A_R_LINEAR_____15_CM 6 0. 8160. DISPLAY_IDENTIFIER LDPM_N_AR_RED FORMAT "%4.0" /end AXIS_PTS
/begin AXIS_PTS ldpm_pq__fac_ar_red_cor "" 0xffe51c44 pq _REC_AXS_20_u2 0.99998474 _CNV_A_R_LINEAR_____37_CM 8 0. 0.99998474 DISPLAY_IDENTIFIER LDPM_PQ__FAC_AR_RED_COR FORMAT "%7.5" /end AXIS_PTS
/begin AXIS_PTS ldp_t_seg_t_1_ratio_crlc_hfm "" 0xffe512ee online_dummy _REC_AXS_20_u2 7.99987793 _CNV_A_R_LINEAR_____394_CM 6 0. 7.99987793 DISPLAY_IDENTIFIER LDP_T_SEG_T_1_RATIO_CRLC_HFM FORMAT "%6.4" /end AXIS_PTS
/begin AXIS_PTS ldp_ar_red_ad_add_dif "" 0xffe50a30 ar_red_ad_add_dif _REC_AXS_20_u2 58.592855 _CNV_A_R_LINEAR_____382_CM 4 0. 58.592855 DISPLAY_IDENTIFIER LDP_AR_RED_AD_ADD_DIF FORMAT "%7.4" /end AXIS_PTS
/begin MEASUREMENT amp_mdl "Ambient pressure used for model adjustment (virtual value)" UWORD _CNV_A_R_LINEAR_____49_CM 1 100. 0. 5434. DISPLAY_IDENTIFIER AMP_MDL ECU_ADDRESS 0x3fd2be BYTE_ORDER MSB_LAST FORMAT "%7.2" /end MEASUREMENT
/begin MEASUREMENT ar_red_dif_i_rel_ini "Initial value for integral value of closed loop control during part load" SWORD _CNV_A_R_LINEAR_____111_CM 1 100. -50. 49.99847412 DISPLAY_IDENTIFIER AR_RED_DIF_I_REL_INI ECU_ADDRESS 0x3fd2c8 BYTE_ORDER MSB_LAST FORMAT "%7.3" /end MEASUREMENT
/begin CHARACTERISTIC c_amp_mdl_dif_i_max "Upper threshold of integral part of pressure controller" VALUE 0xffe403aa _REC_VAL_20_s2 679.239635 _CNV_A_R_LINEAR_____383_CM -339.625 339.614635 DISPLAY_IDENTIFIER C_AMP_MDL_DIF_I_MAX FORMAT "%7.2" /end CHARACTERISTIC
/begin CHARACTERISTIC c_fac_ar_red_dif_i_rel_ini "Scalling factor for part of AMP_MDL_DIF_I which is transformed to AR_RED_DIF_I_REL_INI" VALUE 0xffe40731 _REC_VAL_20_u1 1.9921875 _CNV_A_R_LINEAR_____117_CM 0. 1.9921875 DISPLAY_IDENTIFIER C_FAC_AR_RED_DIF_I_REL_INI FORMAT "%5.3" /end CHARACTERISTIC
/begin MEASUREMENT fac_ar_red_dif "Weighting factor for reduced area share to THR and ISA" UBYTE _CNV_A_R_LINEAR_____50_CM 1 100. 0. 0.996094 DISPLAY_IDENTIFIER FAC_AR_RED_DIF ECU_ADDRESS 0x3fe488 FORMAT "%5.3" /end MEASUREMENT
/begin MEASUREMENT amp_mdl_dif_i_ini "Initialization value for integral part of pressure controller" SWORD _CNV_A_R_LINEAR_____383_CM 1 100. -339.625 339.614635 DISPLAY_IDENTIFIER AMP_MDL_DIF_I_INI ECU_ADDRESS 0x3fd2b4 BYTE_ORDER MSB_LAST FORMAT "%7.2" /end MEASUREMENT
/begin CHARACTERISTIC c_ar_red_isa_max "maximum reduced area at full opened idle speed actuator valve" VALUE 0xffe41506 _REC_VAL_20_u2 58.592855 _CNV_A_R_LINEAR_____382_CM 0. 58.592855 DISPLAY_IDENTIFIER C_AR_RED_ISA_MAX FORMAT "%7.4" /end CHARACTERISTIC
/begin CHARACTERISTIC lc_ar_red_dif_tra "Logical variable for enable initialization of integral controller part" VALUE 0xffe40f3a _REC_VAL_20_u1 1. _CNV_A_R_LINEAR_____0_CM 0. 1. DISPLAY_IDENTIFIER LC_AR_RED_DIF_TRA FORMAT "%2.0" /end CHARACTERISTIC
/begin CHARACTERISTIC c_amp_ad_cor_clrc "Correlation constant for ambient pressure learning" VALUE 0xffe4062a _REC_VAL_20_u1 0.9960940000000002 _CNV_A_R_LINEAR_____50_CM 0. 0.996094 DISPLAY_IDENTIFIER C_AMP_AD_COR_CLRC FORMAT "%5.3" /end CHARACTERISTIC
/begin CHARACTERISTIC ip_ar_red_egr__n_32__stk_av_egr "reduced area at the EGR-valve" MAP 0xffe48f30 _REC_MAP_20_u2_u1_u1 58.592855 _CNV_A_R_LINEAR_____382_CM 0. 58.592855 DISPLAY_IDENTIFIER IP_AR_RED_EGR__N_32__STK_AV_EGR FORMAT "%7.4"
 /begin AXIS_DESCR COM_AXIS n_32 _CNV_A_R_LINEAR_____15_CM 6 0. 8160. FORMAT "%4.0" AXIS_PTS_REF ldp_n_32_ar_red_egr /end AXIS_DESCR
 /begin AXIS_DESCR COM_AXIS stk_av_egr _CNV_A_R_LINEAR_____9_CM 8 0. 99.609375 FORMAT "%5.2" AXIS_PTS_REF ldp_stk_av_egr_ar_red_egr /end AXIS_DESCR
/end CHARACTERISTIC
/begin MEASUREMENT prs_ex "Pressure in the exhaust system" UWORD _CNV_A_R_LINEAR_____49_CM 1 100. 0. 5434. DISPLAY_IDENTIFIER PRS_EX ECU_ADDRESS 0x3fd2fc BYTE_ORDER MSB_LAST FORMAT "%7.2" /end MEASUREMENT
/begin MEASUREMENT prs_ex_inc "increase of exhaust pressure in comparison to ambient pressure" UWORD _CNV_A_R_LINEAR_____49_CM 1 100. 0. 5434. DISPLAY_IDENTIFIER PRS_EX_INC ECU_ADDRESS 0x3fd2fe BYTE_ORDER MSB_LAST FORMAT "%7.2" /end MEASUREMENT
/begin CHARACTERISTIC ip_prs_ex_inc "pressure increase in the exhaust pipe" CURVE 0xffe4ddf6 _REC_CUR_20_u2_u2 5434. _CNV_A_R_LINEAR_____49_CM 0. 5434. DISPLAY_IDENTIFIER IP_PRS_EX_INC FORMAT "%7.2"
 /begin AXIS_DESCR COM_AXIS maf_cyl _CNV_A_R_LINEAR_____115_CM 8 0. 2047.96875 FORMAT "%6.2" AXIS_PTS_REF ldpm_maf_cyl_ex /end AXIS_DESCR
/end CHARACTERISTIC
/begin CHARACTERISTIC ip_teg_egr__maf_cyl "Temperature on the exhaust side of the EGR-Valve" CURVE 0xffe4edb6 _REC_CUR_20_u2_u2 2047. _CNV_A_R_LINEAR_____6_CM 0. 2047. DISPLAY_IDENTIFIER IP_TEG_EGR__MAF_CYL FORMAT "%7.2"
 /begin AXIS_DESCR COM_AXIS maf_cyl _CNV_A_R_LINEAR_____115_CM 8 0. 2047.96875 FORMAT "%6.2" AXIS_PTS_REF ldpm_maf_cyl_ex /end AXIS_DESCR
/end CHARACTERISTIC
/begin MEASUREMENT teg_egr "Temperature on the exhaust side of the EGR-valve" UWORD _CNV_A_R_LINEAR_____6_CM 1 100. 0. 2047. DISPLAY_IDENTIFIER TEG_EGR ECU_ADDRESS 0x3fd300 BYTE_ORDER MSB_LAST FORMAT "%7.2" /end MEASUREMENT
/begin MEASUREMENT ar_red_egr "Reduced area at the EGR - valve (is only calculated if NC_EGR_CONF = 1)" UWORD _CNV_A_R_LINEAR_____382_CM 1 100. 0. 58.592855 DISPLAY_IDENTIFIER AR_RED_EGR ECU_ADDRESS 0x3fd2fa BYTE_ORDER MSB_LAST FORMAT "%7.4" /end MEASUREMENT
/begin AXIS_PTS ldp_n_32_ar_red_egr "" 0xffe410df n_32 _REC_AXS_20_u1 816. _CNV_A_R_LINEAR_____15_CM 6 0. 8160. DISPLAY_IDENTIFIER LDP_N_32_AR_RED_EGR FORMAT "%4.0" /end AXIS_PTS
/begin AXIS_PTS ldp_stk_av_egr_ar_red_egr "" 0xffe4818c stk_av_egr _REC_AXS_20_u1 99.609375 _CNV_A_R_LINEAR_____9_CM 8 0. 99.609375 DISPLAY_IDENTIFIER LDP_STK_AV_EGR_AR_RED_EGR FORMAT "%5.2" /end AXIS_PTS
/begin AXIS_PTS ldpm_maf_cyl_ex "" 0xffe51936 maf_cyl _REC_AXS_20_u2 2047.96875 _CNV_A_R_LINEAR_____115_CM 8 0. 2047.96875 DISPLAY_IDENTIFIER LDPM_MAF_CYL_EX FORMAT "%6.2" /end AXIS_PTS
/begin MEASUREMENT lv_amp_ad_stop "Adaptation of ambient pressure is stopped" UBYTE _CNV_S_2_RANGE______2_CM 1 100. 0. 1. DISPLAY_IDENTIFIER LV_AMP_AD_STOP ECU_ADDRESS 0x3fe48f BIT_MASK 0x1 /end MEASUREMENT
/begin MEASUREMENT lv_amp_ctl_stop "Ambient pressure controller is stopped" UBYTE _CNV_S_2_RANGE______2_CM 1 100. 0. 1. DISPLAY_IDENTIFIER LV_AMP_CTL_STOP ECU_ADDRESS 0x3fe48d BIT_MASK 0x1 /end MEASUREMENT
/begin MEASUREMENT lv_ar_red_ad_rst "Adaptation of reduced area is reseted to \"0\"" UBYTE _CNV_S_2_RANGE______2_CM 1 100. 0. 1. DISPLAY_IDENTIFIER LV_AR_RED_AD_RST ECU_ADDRESS 0x3fe492 BIT_MASK 0x1 /end MEASUREMENT
/begin MEASUREMENT lv_ar_red_ad_stop "Adaptation of reduced area is stopped" UBYTE _CNV_S_2_RANGE______2_CM 1 100. 0. 1. DISPLAY_IDENTIFIER LV_AR_RED_AD_STOP ECU_ADDRESS 0x3fe491 BIT_MASK 0x1 /end MEASUREMENT
/begin MEASUREMENT lv_ar_red_ctl_stop "Reduced area controller is stopped" UBYTE _CNV_S_2_RANGE______2_CM 1 100. 0. 1. DISPLAY_IDENTIFIER LV_AR_RED_CTL_STOP ECU_ADDRESS 0x3fe48e BIT_MASK 0x1 /end MEASUREMENT
/begin MEASUREMENT maf_kgh_mes_fac "Correction factor for MAF_KGH_MES" UBYTE _CNV_A_R_LINEAR_____39_CM 1 100. 0. 1.99220002 DISPLAY_IDENTIFIER MAF_KGH_MES_FAC ECU_ADDRESS 0x3fe48b FORMAT "%5.3" /end MEASUREMENT
/begin CHARACTERISTIC ip_fac_maf_kgh_cor "Correction for MAF_KGH_MES depending on MAF_KGH_MES_BAS" CURVE 0xffe45446 _REC_CUR_20_u1_u2 1.9921875 _CNV_A_R_LINEAR_____117_CM 0. 1.9921875 DISPLAY_IDENTIFIER IP_FAC_MAF_KGH_COR FORMAT "%5.3"
 /begin AXIS_DESCR COM_AXIS maf_kgh_mes_bas _CNV_A_R_LINEAR_____115_CM 16 0. 2047.96875 FORMAT "%7.2" AXIS_PTS_REF ldp_maf_kgh_mes_bas /end AXIS_DESCR
/end CHARACTERISTIC
/begin MEASUREMENT ar_red_bas "Basic reduced opening area" UWORD _CNV_A_R_LINEAR_____382_CM 1 100. 0. 58.592855 DISPLAY_IDENTIFIER AR_RED_BAS ECU_ADDRESS 0x3fd302 BYTE_ORDER MSB_LAST FORMAT "%7.4" /end MEASUREMENT
/begin MEASUREMENT lv_map_ctl "MAP controlled system" UBYTE _CNV_S_2_RANGE______2_CM 1 100. 0. 1. DISPLAY_IDENTIFIER LV_MAP_CTL ECU_ADDRESS 0x3fe494 BIT_MASK 0x1 /end MEASUREMENT
/begin MEASUREMENT lv_amp_ad_rst "Adaptation of ambient pressure is reseted to \"0\"" UBYTE _CNV_S_2_RANGE______2_CM 1 100. 0. 1. DISPLAY_IDENTIFIER LV_AMP_AD_RST ECU_ADDRESS 0x3fe490 BIT_MASK 0x1 /end MEASUREMENT
/begin MEASUREMENT lv_maf_ctl "MAF controlled system" UBYTE _CNV_S_2_RANGE______2_CM 1 100. 0. 1. DISPLAY_IDENTIFIER LV_MAF_CTL ECU_ADDRESS 0x3fe493 BIT_MASK 0x1 /end MEASUREMENT
/begin MEASUREMENT ar_red_isa_bas "Basic reduced opening area at the idle speed actuator" UWORD _CNV_A_R_LINEAR_____382_CM 1 100. 0. 58.592855 DISPLAY_IDENTIFIER AR_RED_ISA_BAS ECU_ADDRESS 0x3fd314 BYTE_ORDER MSB_LAST FORMAT "%7.4" /end MEASUREMENT
/begin AXIS_PTS ldp_maf_kgh_mes_bas "" 0xffe50e72 maf_kgh_mes_bas _REC_AXS_20_u2 2047.96875 _CNV_A_R_LINEAR_____115_CM 16 0. 2047.96875 DISPLAY_IDENTIFIER LDP_MAF_KGH_MES_BAS FORMAT "%7.2" /end AXIS_PTS
/begin MEASUREMENT map_mes "measured manifold air pressure" UWORD _CNV_A_R_LINEAR_____49_CM 1 100. 0. 5434. DISPLAY_IDENTIFIER MAP_MES ECU_ADDRESS 0x3fd316 BYTE_ORDER MSB_LAST FORMAT "%7.2" /end MEASUREMENT
/begin MEASUREMENT state_ctl_insy "State_of intake manifold model adaption" UBYTE _CNV_S_3_STATE_CTL__398_CM 1 100. 0. 2. DISPLAY_IDENTIFIER STATE_CTL_INSY ECU_ADDRESS 0x3fe48c /end MEASUREMENT
/begin CHARACTERISTIC c_pq_amp_ctl "Pressure quotient to switch from area to pressure control" VALUE 0xffe41864 _REC_VAL_20_u2 0.99998474 _CNV_A_R_LINEAR_____37_CM 0. 0.99998474 DISPLAY_IDENTIFIER C_PQ_AMP_CTL FORMAT "%7.5" /end CHARACTERISTIC
/begin CHARACTERISTIC c_pq_amp_ctl_hys "Hysteresis around pressure ratio to switch from area to pressure control" VALUE 0xffe41866 _REC_VAL_20_u2 0.99998474 _CNV_A_R_LINEAR_____37_CM 0. 0.99998474 DISPLAY_IDENTIFIER C_PQ_AMP_CTL_HYS FORMAT "%7.5" /end CHARACTERISTIC
/begin CHARACTERISTIC ip_ar_red_thr "reduced area at the throttle" CURVE 0xffe49070 _REC_CUR_20_u2_u2 58.592855 _CNV_A_R_LINEAR_____382_CM 0. 58.592855 DISPLAY_IDENTIFIER IP_AR_RED_THR FORMAT "%7.4"
 /begin AXIS_DESCR COM_AXIS tps_seg _CNV_A_R_LINEAR_____53_CM 16 0. 119.5 AXIS_PTS_REF ldp_tps_seg_ar_red_thr /end AXIS_DESCR
/end CHARACTERISTIC
/begin AXIS_PTS ldp_tps_seg_ar_red_thr "" 0xffe51416 tps_seg _REC_AXS_20_u2 119.5 _CNV_A_R_LINEAR_____53_CM 16 0. 119.5 DISPLAY_IDENTIFIER LDP_TPS_SEG_AR_RED_THR /end AXIS_PTS
/begin CHARACTERISTIC ip_ar_red_isa "reduced area at the idle speed actuator" CURVE 0xffe48ff0 _REC_CUR_20_u2_u2 58.592855 _CNV_A_R_LINEAR_____382_CM 0. 58.592855 DISPLAY_IDENTIFIER IP_AR_RED_ISA FORMAT "%7.4"
 /begin AXIS_DESCR COM_AXIS isapwm_mmv _CNV_A_R_LINEAR_____8_CM 16 0. 99.99847412 AXIS_PTS_REF ldp_isapwm_mmv /end AXIS_DESCR
/end CHARACTERISTIC
/begin AXIS_PTS ldp_isapwm_mmv "" 0xffe50c12 isapwm_mmv _REC_AXS_20_u2 99.99847412 _CNV_A_R_LINEAR_____8_CM 16 0. 99.99847412 DISPLAY_IDENTIFIER LDP_ISAPWM_MMV /end AXIS_PTS
/begin MEASUREMENT v_map "Voltage of the intake manifold pressure sensor (for diagnosis)" UWORD _CNV_A_R_LINEAR_____269_CM 1 100. 0. 5. DISPLAY_IDENTIFIER V_MAP ECU_ADDRESS 0x3fd342 BYTE_ORDER MSB_LAST FORMAT "%5.3" /end MEASUREMENT
/begin CHARACTERISTIC ip_map_mes_bas__v_map "Conversion characteristic for MAP_MES_BAS" CURVE 0xffe41c72 _REC_CUR_20_u2_u2 5434. _CNV_A_R_LINEAR_____49_CM 0. 5434. DISPLAY_IDENTIFIER IP_MAP_MES_BAS__V_MAP FORMAT "%7.2"
 /begin AXIS_DESCR COM_AXIS v_map _CNV_A_R_LINEAR_____269_CM 2 0. 5. FORMAT "%5.3" AXIS_PTS_REF ldp_v_map_map_mes_bas /end AXIS_DESCR
/end CHARACTERISTIC
/begin MEASUREMENT map_mes_bas "Intake manifold air pressure per segment measured" UWORD _CNV_A_R_LINEAR_____49_CM 1 100. 0. 5434. DISPLAY_IDENTIFIER MAP_MES_BAS ECU_ADDRESS 0x3fd340 BYTE_ORDER MSB_LAST FORMAT "%7.2" /end MEASUREMENT
/begin AXIS_PTS ldp_v_map_map_mes_bas "" 0xffe41d16 v_map _REC_AXS_20_u2 4.5 _CNV_A_R_LINEAR_____269_CM 2 0. 5. DISPLAY_IDENTIFIER LDP_V_MAP_MAP_MES_BAS FORMAT "%5.3" /end AXIS_PTS
/begin MEASUREMENT n_32 "engine speed with a resolution of 32rpm" UBYTE _CNV_A_R_LINEAR_____15_CM 1 100. 0. 8160. DISPLAY_IDENTIFIER N_32 ECU_ADDRESS 0x3fe5bf FORMAT "%4.0" /end MEASUREMENT
/begin MEASUREMENT t_seg_av "Current segment-time" UWORD _CNV_A_R_LINEAR_____165_CM 1 100. 0. 262.14 DISPLAY_IDENTIFIER T_SEG_AV ECU_ADDRESS 0x3fd5a8 BYTE_ORDER MSB_LAST FORMAT "%7.3" /end MEASUREMENT
/begin MEASUREMENT n_grd "Engine speed gradient" SBYTE _CNV_A_R_LINEAR_____416_CM 1 100. -4096. 4064. DISPLAY_IDENTIFIER N_GRD ECU_ADDRESS 0x3fe5c0 FORMAT "%4.0" /end MEASUREMENT
/begin MEASUREMENT n "engine speed with a resolution of 1rpm" UWORD _CNV_A_R_LINEAR_____10_CM 1 100. 0. 8160. DISPLAY_IDENTIFIER N ECU_ADDRESS 0x3fd5a4 BYTE_ORDER MSB_LAST FORMAT "%4.0" /end MEASUREMENT
/begin MEASUREMENT n_tooth "Engine speed during start (calculated at every tooth period" UWORD _CNV_A_R_LINEAR_____10_CM 1 100. 0. 8160. DISPLAY_IDENTIFIER N_TOOTH ECU_ADDRESS 0x3fd5a6 BYTE_ORDER MSB_LAST FORMAT "%4.0" /end MEASUREMENT
/begin MEASUREMENT lv_load_ratio_chk "" UBYTE _CNV_S_2_RANGE______21_CM 1 100. 0. 1. DISPLAY_IDENTIFIER LV_LOAD_RATIO_CHK ECU_ADDRESS 0x3fe73f /end MEASUREMENT
/begin CHARACTERISTIC c_t_es_tco_plaus_max "Threshold for maximum T_ES time" VALUE 0xffe41974 _REC_VAL_20_u2 65535. _CNV_A_R_LINEAR_____97_CM 0. 65535. DISPLAY_IDENTIFIER C_T_ES_TCO_PLAUS_MAX FORMAT "%5.0" /end CHARACTERISTIC
/begin CHARACTERISTIC c_t_es_tco_plaus_min "Threshold for minimum T_ES time" VALUE 0xffe41976 _REC_VAL_20_u2 65535. _CNV_A_R_LINEAR_____97_CM 0. 65535. DISPLAY_IDENTIFIER C_T_ES_TCO_PLAUS_MIN FORMAT "%5.0" /end CHARACTERISTIC
/begin CHARACTERISTIC c_tco_stop_t_es_plaus_min "Threshold for minimum differences of cooling temperature " VALUE 0xffe4092d _REC_VAL_20_u1 190.5 _CNV_A_R_LINEAR_____12_CM 0. 190.5 DISPLAY_IDENTIFIER C_TCO_STOP_T_ES_PLAUS_MIN FORMAT "%5.1" /end CHARACTERISTIC
/begin CHARACTERISTIC c_t_es_sub "substitute value of T_ES" VALUE 0xffe4196e _REC_VAL_20_u2 65535. _CNV_A_R_LINEAR_____97_CM 0. 65535. DISPLAY_IDENTIFIER C_T_ES_SUB FORMAT "%5.0" /end CHARACTERISTIC
/begin CHARACTERISTIC c_tco_stop_t_es_plaus_max "Threshold for maximum differences of cooling temperature" VALUE 0xffe4092c _REC_VAL_20_u1 190.5 _CNV_A_R_LINEAR_____12_CM 0. 190.5 DISPLAY_IDENTIFIER C_TCO_STOP_T_ES_PLAUS_MAX FORMAT "%5.1" /end CHARACTERISTIC
/begin CHARACTERISTIC c_tco_stop_t_es_min "Threshold for minimum cooling temperature at engine stop" VALUE 0xffe4092b _REC_VAL_20_u1 190.5 _CNV_A_R_LINEAR_____11_CM -48. 142.5 DISPLAY_IDENTIFIER C_TCO_STOP_T_ES_MIN FORMAT "%5.1" /end CHARACTERISTIC
/begin MEASUREMENT t_es "Engine off duration" UWORD _CNV_A_R_LINEAR_____97_CM 1 100. 0. 65535. DISPLAY_IDENTIFIER T_ES ECU_ADDRESS 0x3fd844 BYTE_ORDER MSB_LAST FORMAT "%5.0" /end MEASUREMENT
/begin MEASUREMENT t_rel_can_es "Time counter value at the start of engine off phase" UWORD _CNV_A_R_LINEAR_____97_CM 1 100. 0. 65535. DISPLAY_IDENTIFIER T_REL_CAN_ES ECU_ADDRESS 0x3fd846 BYTE_ORDER MSB_LAST FORMAT "%5.0" /end MEASUREMENT
/begin MEASUREMENT t_rel_can_st "Time counter value at the end of engine off phase" UWORD _CNV_A_R_LINEAR_____97_CM 1 100. 0. 65535. DISPLAY_IDENTIFIER T_REL_CAN_ST ECU_ADDRESS 0x3fd848 BYTE_ORDER MSB_LAST FORMAT "%5.0" /end MEASUREMENT
/begin MEASUREMENT lv_t_rel_can_reg "T_REL_CAN receiving of INSTR2 message" UBYTE _CNV_S_2_RANGE______2_CM 1 100. 0. 1. DISPLAY_IDENTIFIER LV_T_REL_CAN_REG ECU_ADDRESS 0x3fe76c /end MEASUREMENT
/begin MEASUREMENT lv_t_es_not_plaus "T_ES not plausible" UBYTE _CNV_S_2_RANGE______2_CM 1 100. 0. 1. DISPLAY_IDENTIFIER LV_T_ES_NOT_PLAUS ECU_ADDRESS 0x3fe76d /end MEASUREMENT
/begin MEASUREMENT ctr_stc_tecu_1 "statistic counter 1 for TECU monitoring" UWORD _CNV_A_R_LINEAR_____0_CM 1 100. 0. 65535. DISPLAY_IDENTIFIER CTR_STC_TECU_1 ECU_ADDRESS 0x3fd734 BYTE_ORDER MSB_LAST FORMAT "%5.0" /end MEASUREMENT
/begin MEASUREMENT ctr_stc_tecu_2 "statistic counter 2 for TECU monitoring" UWORD _CNV_A_R_LINEAR_____0_CM 1 100. 0. 65535. DISPLAY_IDENTIFIER CTR_STC_TECU_2 ECU_ADDRESS 0x3fd736 BYTE_ORDER MSB_LAST FORMAT "%5.0" /end MEASUREMENT
/begin MEASUREMENT ctr_stc_tecu_3 "statistic counter 3 for TECU monitoring" UWORD _CNV_A_R_LINEAR_____0_CM 1 100. 0. 65535. DISPLAY_IDENTIFIER CTR_STC_TECU_3 ECU_ADDRESS 0x3fd738 BYTE_ORDER MSB_LAST FORMAT "%5.0" /end MEASUREMENT
/begin CHARACTERISTIC ip_tecu "NTC characteristic" CURVE 0xffe4798f _REC_CUR_20_u1_u2 190.5 _CNV_A_R_LINEAR_____11_CM -48. 142.5 DISPLAY_IDENTIFIER IP_TECU FORMAT "%5.1"
 /begin AXIS_DESCR COM_AXIS v_tecu _CNV_A_R_LINEAR_____3_CM 16 0. 4.99511719 FORMAT "%5.3" AXIS_PTS_REF ldp_v_tecu__tecu /end AXIS_DESCR
/end CHARACTERISTIC
/begin CHARACTERISTIC c_tecu_sub "TECU substitute value" VALUE 0xffe40940 _REC_VAL_20_u1 190.5 _CNV_A_R_LINEAR_____11_CM -48. 142.5 DISPLAY_IDENTIFIER C_TECU_SUB FORMAT "%5.1" /end CHARACTERISTIC
/begin CHARACTERISTIC c_tecu_thd_1 "ETCU threshold 1" VALUE 0xffe41a34 _REC_VAL_20_u2 65535. _CNV_A_R_LINEAR_____0_CM 0. 65535. DISPLAY_IDENTIFIER C_TECU_THD_1 FORMAT "%5.0" /end CHARACTERISTIC
/begin CHARACTERISTIC c_tecu_thd_2 "ETCU threshold 2" VALUE 0xffe41a36 _REC_VAL_20_u2 65535. _CNV_A_R_LINEAR_____0_CM 0. 65535. DISPLAY_IDENTIFIER C_TECU_THD_2 FORMAT "%5.0" /end CHARACTERISTIC
/begin CHARACTERISTIC c_tecu_thd_3 "ETCU threshold 3" VALUE 0xffe41a38 _REC_VAL_20_u2 65535. _CNV_A_R_LINEAR_____0_CM 0. 65535. DISPLAY_IDENTIFIER C_TECU_THD_3 FORMAT "%5.0" /end CHARACTERISTIC
/begin CHARACTERISTIC c_trt_dif_tecu "TRT difference for ETCU statistic" VALUE 0xffe414ac _REC_VAL_20_u4 119304.6471 _CNV_A_R_LINEAR_____172_CM 0. 119304.6471 DISPLAY_IDENTIFIER C_TRT_DIF_TECU FORMAT "%12.5" /end CHARACTERISTIC
/begin MEASUREMENT tecu "ECU temperature" UBYTE _CNV_A_R_LINEAR_____11_CM 1 100. -48. 142.5 DISPLAY_IDENTIFIER TECU ECU_ADDRESS 0x3fe683 FORMAT "%5.1" /end MEASUREMENT
/begin MEASUREMENT tecu_mes "???" UBYTE _CNV_A_R_LINEAR_____11_CM 1 100. -48. 142.5 DISPLAY_IDENTIFIER TECU_MES ECU_ADDRESS 0x3fe684 FORMAT "%5.1" /end MEASUREMENT
/begin AXIS_PTS ldp_v_tecu__tecu "" 0xffe515ec v_tecu _REC_AXS_20_u2 4.495605471 _CNV_A_R_LINEAR_____3_CM 16 0. 4.99511719 DISPLAY_IDENTIFIER LDP_V_TECU__TECU FORMAT "%5.3" /end AXIS_PTS
/begin CHARACTERISTIC ip_ttip_ls_up "Oxygen sensor temperature vs. internal resistance characteristic" CURVE 0xffe50606 _REC_CUR_20_u2_u2 2047.96875 _CNV_A_R_LINEAR_____367_CM 0. 2047.96875 DISPLAY_IDENTIFIER IP_TTIP_LS_UP FORMAT "%7.2"
 /begin AXIS_DESCR COM_AXIS online_dummy _CNV_A_R_LINEAR_____304_CM 8 0. 16383.75 FORMAT "%8.1" AXIS_PTS_REF ldp_r_up_ls_ip_ttip_ls_up /end AXIS_DESCR
/end CHARACTERISTIC
/begin CHARACTERISTIC c_t_dly_adj_gain_ttip_ls_up "Delay required from switching oscillator on prior to taking voltage samples for internal resistance" VALUE 0xffe40873 _REC_VAL_20_u1 2.55 _CNV_A_R_LINEAR_____4_CM 0. 2.55 DISPLAY_IDENTIFIER C_T_DLY_ADJ_GAIN_TTIP_LS_UP FORMAT "%4.2" /end CHARACTERISTIC
/begin CHARACTERISTIC c_t_dly_mes_ofs_ttip_ls_up "Delay required from switching oscillator off prior to taking voltage samples for offset adjustment" VALUE 0xffe40889 _REC_VAL_20_u1 2.55 _CNV_A_R_LINEAR_____4_CM 0. 2.55 DISPLAY_IDENTIFIER C_T_DLY_MES_OFS_TTIP_LS_UP FORMAT "%4.2" /end CHARACTERISTIC
/begin CHARACTERISTIC c_t_dly_adj_ofs_ttip_ls_up "Delay required from switching internal resistance adjust mode on prior to taking voltage samples" VALUE 0xffe40874 _REC_VAL_20_u1 2.55 _CNV_A_R_LINEAR_____4_CM 0. 2.55 DISPLAY_IDENTIFIER C_T_DLY_ADJ_OFS_TTIP_LS_UP FORMAT "%4.2" /end CHARACTERISTIC
/begin CHARACTERISTIC c_t_dly_mes_ttip_ls_up "Delay required from switching internal resistance adjust mode off prior to taking voltage samples" VALUE 0xffe4088a _REC_VAL_20_u1 2.55 _CNV_A_R_LINEAR_____4_CM 0. 2.55 DISPLAY_IDENTIFIER C_T_DLY_MES_TTIP_LS_UP FORMAT "%4.2" /end CHARACTERISTIC
/begin CHARACTERISTIC c_t_lim_v_temp_ls_up_mes_ofs "Maximum permitted time for offset measurement in measurement mode" VALUE 0xffe41988 _REC_VAL_20_u2 655.3200000000001 _CNV_A_R_LINEAR_____364_CM 0. 655.3200000000001 DISPLAY_IDENTIFIER C_T_LIM_V_TEMP_LS_UP_MES_OFS FORMAT "%6.2" /end CHARACTERISTIC
/begin CHARACTERISTIC c_t_lim_v_temp_ls_up_adj_ofs "Maximum permitted time for offset measurement in measurement mode" VALUE 0xffe41986 _REC_VAL_20_u2 655.3200000000001 _CNV_A_R_LINEAR_____364_CM 0. 655.3200000000001 DISPLAY_IDENTIFIER C_T_LIM_V_TEMP_LS_UP_ADJ_OFS FORMAT "%6.2" /end CHARACTERISTIC
/begin CHARACTERISTIC c_t_lim_gain_temp_ls_up "Maximum permitted time for gain adjust measurement" VALUE 0xffe41984 _REC_VAL_20_u2 655.3200000000001 _CNV_A_R_LINEAR_____364_CM 0. 655.3200000000001 DISPLAY_IDENTIFIER C_T_LIM_GAIN_TEMP_LS_UP FORMAT "%6.2" /end CHARACTERISTIC
/begin CHARACTERISTIC c_v_temp_ls_up_mes_ofs_dif "Maximum permitted deviation of V_TEMP_LS_UP_MES_OFS_i to nominal reference value" VALUE 0xffe41b12 _REC_VAL_20_u2 4.995 _CNV_A_R_LINEAR_____306_CM 0. 4.995 DISPLAY_IDENTIFIER C_V_TEMP_LS_UP_MES_OFS_DIF FORMAT "%5.3" /end CHARACTERISTIC
/begin CHARACTERISTIC c_v_temp_ls_up_adj_ofs_dif "Maximum permitted deviation of V_TEMP_LS_UP_ADJ_OFS_i to nominal reference value" VALUE 0xffe41b10 _REC_VAL_20_u2 4.995 _CNV_A_R_LINEAR_____306_CM 0. 4.995 DISPLAY_IDENTIFIER C_V_TEMP_LS_UP_ADJ_OFS_DIF FORMAT "%5.3" /end CHARACTERISTIC
/begin CHARACTERISTIC c_gain_temp_ls_up_dif "Maximum permitted deviation of measured GAIN_TEMP_LS_UP_i from nominal reference value" VALUE 0xffe4166e _REC_VAL_20_u2 19.99969 _CNV_A_R_LINEAR_____307_CM 0. 19.99969 DISPLAY_IDENTIFIER C_GAIN_TEMP_LS_UP_DIF FORMAT "%7.4" /end CHARACTERISTIC
/begin CHARACTERISTIC lc_v_temp_ls_up_ref "Boolean flag enabling internal resistance determination circuit reference measurement" VALUE 0xffe41003 _REC_VAL_20_u1 1. _CNV_A_R_LINEAR_____0_CM 0. 1. DISPLAY_IDENTIFIER LC_V_TEMP_LS_UP_REF FORMAT "%2.0" /end CHARACTERISTIC
/begin AXIS_PTS ldp_r_up_ls_ip_ttip_ls_up "" 0xffe51264 online_dummy _REC_AXS_20_u2 16383.75 _CNV_A_R_LINEAR_____304_CM 8 0. 16383.75 DISPLAY_IDENTIFIER LDP_R_UP_LS_IP_TTIP_LS_UP FORMAT "%8.1" /end AXIS_PTS
/begin CHARACTERISTIC ip_fac_ar_red_dif "P-value reduced throttle area (MAF-controlled)" CURVE 0xffe40b2b _REC_CUR_20_u1_u1 0.99610001 _CNV_A_R_LINEAR_____29_CM 0. 0.99610001 DISPLAY_IDENTIFIER IP_FAC_AR_RED_DIF FORMAT "%5.3"
 /begin AXIS_DESCR COM_AXIS maf_turb_ratio _CNV_A_R_LINEAR_____29_CM 8 0. 0.99610001 FORMAT "%5.3" AXIS_PTS_REF ldp_maf_turb_ratio /end AXIS_DESCR
/end CHARACTERISTIC
/begin AXIS_PTS ldp_maf_turb_ratio "" 0xffe47fd3 maf_turb_ratio _REC_AXS_20_u1 0.99610001 _CNV_A_R_LINEAR_____29_CM 8 0. 0.99610001 DISPLAY_IDENTIFIER LDP_MAF_TURB_RATIO FORMAT "%5.3" /end AXIS_PTS
/begin MEASUREMENT tps_av_1 "Opening angle of the throttle valve of TPS-Poti 1" UWORD _CNV_A_R_LINEAR_____53_CM 1 100. 0. 119.5 DISPLAY_IDENTIFIER TPS_AV_1 ECU_ADDRESS 0x3fdc88 BYTE_ORDER MSB_LAST FORMAT "%7.3" /end MEASUREMENT
/begin MEASUREMENT tps_av_2 "Opening angle of the throttle valve of TPS-Poti 2" UWORD _CNV_A_R_LINEAR_____53_CM 1 100. 0. 119.5 DISPLAY_IDENTIFIER TPS_AV_2 ECU_ADDRESS 0x3fdc8a BYTE_ORDER MSB_LAST FORMAT "%7.3" /end MEASUREMENT
/begin MEASUREMENT tps_grd "Throttle position gradient, absolute value" UBYTE _CNV_A_R_LINEAR_____52_CM 1 100. 0. 2987.5 DISPLAY_IDENTIFIER TPS_GRD ECU_ADDRESS 0x3fea85 FORMAT "%4.0" /end MEASUREMENT
/begin MEASUREMENT tps_seg "Segment synchronous measured throttle valve position" UWORD _CNV_A_R_LINEAR_____53_CM 1 100. 0. 119.5 DISPLAY_IDENTIFIER TPS_SEG ECU_ADDRESS 0x3fdc90 BYTE_ORDER MSB_LAST FORMAT "%7.3" /end MEASUREMENT
/begin MEASUREMENT tps_seg_1 "Segment synchronous measured throttle valve position channel 1" UWORD _CNV_A_R_LINEAR_____53_CM 1 100. 0. 119.5 DISPLAY_IDENTIFIER TPS_SEG_1 ECU_ADDRESS 0x3fdc92 BYTE_ORDER MSB_LAST FORMAT "%7.3" /end MEASUREMENT
/begin MEASUREMENT tps_seg_2 "Segment synchronous measured throttle valve position channel 2" UWORD _CNV_A_R_LINEAR_____53_CM 1 100. 0. 119.5 DISPLAY_IDENTIFIER TPS_SEG_2 ECU_ADDRESS 0x3fdc94 BYTE_ORDER MSB_LAST FORMAT "%7.3" /end MEASUREMENT
/begin MEASUREMENT tps_seg_gain_1 "Segment synchronous measured throttle valve position amplified channel 1" UWORD _CNV_A_R_LINEAR_____53_CM 1 100. 0. 119.5 DISPLAY_IDENTIFIER TPS_SEG_GAIN_1 ECU_ADDRESS 0x3fdc96 BYTE_ORDER MSB_LAST FORMAT "%7.3" /end MEASUREMENT
/begin MEASUREMENT tps_av_gain_1 "Opening angle of the throttle valve of amplified TPS-Poti 1" UWORD _CNV_A_R_LINEAR_____53_CM 1 100. 0. 119.5 DISPLAY_IDENTIFIER TPS_AV_GAIN_1 ECU_ADDRESS 0x3fdc9c BYTE_ORDER MSB_LAST FORMAT "%7.3" /end MEASUREMENT
/begin MEASUREMENT v_tps_gain_tol_ena_1 "TPS1-voltage to switch from amplified to non-amplified sensor signal" UWORD _CNV_A_R_LINEAR_____3_CM 1 100. 0. 4.99511719 DISPLAY_IDENTIFIER V_TPS_GAIN_TOL_ENA_1 ECU_ADDRESS 0x3fdc9e BYTE_ORDER MSB_LAST FORMAT "%5.3" /end MEASUREMENT
/begin MEASUREMENT v_tps_gain_bol_ena_1 "TPS1-voltage to switch from non-amplified to amplified sensor signal" UWORD _CNV_A_R_LINEAR_____3_CM 1 100. 0. 4.99511719 DISPLAY_IDENTIFIER V_TPS_GAIN_BOL_ENA_1 ECU_ADDRESS 0x3fdca0 BYTE_ORDER MSB_LAST FORMAT "%5.3" /end MEASUREMENT
/begin CHARACTERISTIC c_v_tps_swi_gain_1 "" VALUE 0xffe41b24 _REC_VAL_20_u2 4.99511719 _CNV_A_R_LINEAR_____3_CM 0. 4.99511719 DISPLAY_IDENTIFIER C_V_TPS_SWI_GAIN_1 FORMAT "%5.3" /end CHARACTERISTIC
/begin CHARACTERISTIC c_v_tps_hys_gain_1 "" VALUE 0xffe41b18 _REC_VAL_20_u2 4.99511719 _CNV_A_R_LINEAR_____3_CM 0. 4.99511719 DISPLAY_IDENTIFIER C_V_TPS_HYS_GAIN_1 FORMAT "%5.3" /end CHARACTERISTIC
/begin MEASUREMENT tps_lih "Limp home position of the throttle valve" UWORD _CNV_A_R_LINEAR_____53_CM 1 100. 0. 119.5 DISPLAY_IDENTIFIER TPS_LIH ECU_ADDRESS 0x3fdc8e BYTE_ORDER MSB_LAST FORMAT "%7.3" /end MEASUREMENT
/begin MEASUREMENT tps_av "Opening angle of the throttle valve" UWORD _CNV_A_R_LINEAR_____53_CM 1 100. 0. 119.5 DISPLAY_IDENTIFIER TPS_AV ECU_ADDRESS 0x3fdc86 BYTE_ORDER MSB_LAST FORMAT "%7.3" /end MEASUREMENT
/begin MEASUREMENT tps_av_ctl "Control opening angle of the throttle valve" SWORD _CNV_A_R_LINEAR_____413_CM 1 100. -119.5 119.5 DISPLAY_IDENTIFIER TPS_AV_CTL ECU_ADDRESS 0x3fdc8c BYTE_ORDER MSB_LAST FORMAT "%8.3" /end MEASUREMENT
/begin MEASUREMENT tps_av_ctl_1 "Control opening angle of the throttle valve of TPS-Poti 1" SWORD _CNV_A_R_LINEAR_____413_CM 1 100. -119.5 119.5 DISPLAY_IDENTIFIER TPS_AV_CTL_1 ECU_ADDRESS 0x3fdc98 BYTE_ORDER MSB_LAST FORMAT "%8.3" /end MEASUREMENT
/begin MEASUREMENT tps_av_ctl_2 "Control opening angle of the throttle valve of TPS-Poti 2" SWORD _CNV_A_R_LINEAR_____413_CM 1 100. -119.5 119.5 DISPLAY_IDENTIFIER TPS_AV_CTL_2 ECU_ADDRESS 0x3fdc9a BYTE_ORDER MSB_LAST FORMAT "%8.3" /end MEASUREMENT
/begin MEASUREMENT tps_av_ctl_gain_1 "Control opening angle of the throttle valve of amplified TPS-Poti 1" SWORD _CNV_A_R_LINEAR_____413_CM 1 100. -119.5 119.5 DISPLAY_IDENTIFIER TPS_AV_CTL_GAIN_1 ECU_ADDRESS 0x3fdca8 BYTE_ORDER MSB_LAST FORMAT "%8.3" /end MEASUREMENT
/begin CHARACTERISTIC c_v_tps_grd_max "" VALUE 0xffe41b16 _REC_VAL_20_u2 4.99511719 _CNV_A_R_LINEAR_____3_CM 0. 4.99511719 DISPLAY_IDENTIFIER C_V_TPS_GRD_MAX FORMAT "%5.3" /end CHARACTERISTIC
/begin CHARACTERISTIC c_v_tps_gain_grd_max "TPS voltage gradient limitation" VALUE 0xffe41b14 _REC_VAL_20_u2 4.99511719 _CNV_A_R_LINEAR_____3_CM 0. 4.99511719 DISPLAY_IDENTIFIER C_V_TPS_GAIN_GRD_MAX FORMAT "%5.3" /end CHARACTERISTIC
/begin MEASUREMENT lv_tps_gain_act_1 "Logical variable for TPS_AV based on amplified TPS 1 " UBYTE _CNV_S_2_RANGE______2_CM 1 100. 0. 1. DISPLAY_IDENTIFIER LV_TPS_GAIN_ACT_1 ECU_ADDRESS 0x3fea86 BIT_MASK 0x1 /end MEASUREMENT
/begin MEASUREMENT lv_tps_grd_up "Logical variable for throttle position gradient direction" UBYTE _CNV_S_2_RANGE______2_CM 1 100. 0. 1. DISPLAY_IDENTIFIER LV_TPS_GRD_UP ECU_ADDRESS 0x3fea87 /end MEASUREMENT
/begin CHARACTERISTIC c_tps_slop "" VALUE 0xffe41a9c _REC_VAL_20_u2 48. _CNV_A_R_LINEAR_____499_CM 0. 48. DISPLAY_IDENTIFIER C_TPS_SLOP FORMAT "%7.4" /end CHARACTERISTIC
/begin CHARACTERISTIC c_tps_max "Maximum mechanical opening angle of the throttle valve in degree" VALUE 0xffe41a96 _REC_VAL_20_u2 119.5 _CNV_A_R_LINEAR_____53_CM 0. 119.5 DISPLAY_IDENTIFIER C_TPS_MAX /end CHARACTERISTIC
/begin CHARACTERISTIC ip_tq_loss_acc_inp "ACC torque loss due to engine-speed and ACC torque demand" MAP 0xffe4fbea _REC_MAP_20_u2_u1_u1 2047.96875 _CNV_A_R_LINEAR_____187_CM -1024. 1023.96875 DISPLAY_IDENTIFIER IP_TQ_LOSS_ACC_INP FORMAT "%6.2"
 /begin AXIS_DESCR COM_AXIS n_32 _CNV_A_R_LINEAR_____15_CM 6 0. 8160. FORMAT "%4.0" AXIS_PTS_REF ldp_n_32__tq_loss_acc /end AXIS_DESCR
 /begin AXIS_DESCR COM_AXIS tq_accin_can _CNV_A_R_LINEAR_____95_CM 6 0. 31. FORMAT "%3.0" AXIS_PTS_REF ldp_tq_accin_can__tq_loss_acc /end AXIS_DESCR
/end CHARACTERISTIC
/begin AXIS_PTS ldp_n_32__tq_loss_acc "" 0xffe410cc n_32 _REC_AXS_20_u1 8160. _CNV_A_R_LINEAR_____15_CM 6 0. 8160. DISPLAY_IDENTIFIER LDP_N_32__TQ_LOSS_ACC FORMAT "%4.0" /end AXIS_PTS
/begin AXIS_PTS ldp_tq_accin_can__tq_loss_acc "" 0xffe412d6 tq_accin_can _REC_AXS_20_u1 31. _CNV_A_R_LINEAR_____95_CM 6 0. 31. DISPLAY_IDENTIFIER LDP_TQ_ACCIN_CAN__TQ_LOSS_ACC FORMAT "%3.0" /end AXIS_PTS
/begin MEASUREMENT lv_err_bn_etcu "Present error BN2000" UBYTE _CNV_S_2_RANGE______1_R_CM 1 100. 0. 255. DISPLAY_IDENTIFIER LV_ERR_BN_ETCU ECU_ADDRESS 0x3fbacc /end MEASUREMENT
/begin MEASUREMENT lv_err_bn_tq_amt "Present error BN2000" UBYTE _CNV_S_2_RANGE______1_R_CM 1 100. 0. 255. DISPLAY_IDENTIFIER LV_ERR_BN_TQ_AMT ECU_ADDRESS 0x3fbad0 /end MEASUREMENT
/begin MEASUREMENT lv_err_bn_ars "Present error BN2000" UBYTE _CNV_S_2_RANGE______1_R_CM 1 100. 0. 255. DISPLAY_IDENTIFIER LV_ERR_BN_ARS ECU_ADDRESS 0x3fbab4 /end MEASUREMENT
/begin MEASUREMENT lv_err_bn_tq_dcc "Present error BN2000" UBYTE _CNV_S_2_RANGE______1_R_CM 1 100. 0. 255. DISPLAY_IDENTIFIER LV_ERR_BN_TQ_DCC ECU_ADDRESS 0x3fbaac /end MEASUREMENT
/begin MEASUREMENT lv_err_bn_tq_tcs "Present error BN2000" UBYTE _CNV_S_2_RANGE______1_R_CM 1 100. 0. 255. DISPLAY_IDENTIFIER LV_ERR_BN_TQ_TCS ECU_ADDRESS 0x3fbabc /end MEASUREMENT
/begin MEASUREMENT lv_err_bn_vs_tcs "Present error BN2000" UBYTE _CNV_S_2_RANGE______1_R_CM 1 100. 0. 255. DISPLAY_IDENTIFIER LV_ERR_BN_VS_TCS ECU_ADDRESS 0x3fbac0 /end MEASUREMENT
/begin MEASUREMENT lv_err_bn_tcs "Present error BN2000" UBYTE _CNV_S_2_RANGE______1_R_CM 1 100. 0. 255. DISPLAY_IDENTIFIER LV_ERR_BN_TCS ECU_ADDRESS 0x3fbac4 /end MEASUREMENT
/begin MEASUREMENT lv_err_bn_ang_pste "Present error BN2000" UBYTE _CNV_S_2_RANGE______1_R_CM 1 100. 0. 255. DISPLAY_IDENTIFIER LV_ERR_BN_ANG_PSTE ECU_ADDRESS 0x3fbaf4 /end MEASUREMENT
/begin MEASUREMENT trt "total running time" ULONG _CNV_A_R_LINEAR_____172_CM 1 100. 0. 119304.6471 DISPLAY_IDENTIFIER TRT ECU_ADDRESS 0x3fcf7c BYTE_ORDER MSB_LAST FORMAT "%12.5" /end MEASUREMENT
/begin CHARACTERISTIC lc_var_bn2000 "" VALUE 0xffe41005 _REC_VAL_20_u1 1. _CNV_A_R_LINEAR_____0_CM 0. 1. DISPLAY_IDENTIFIER LC_VAR_BN FORMAT "%2.0" /end CHARACTERISTIC
/begin MEASUREMENT lv_var_bn "BN2000 recognized" UBYTE _CNV_S_2_RANGE______2_CM 1 100. 0. 1. DISPLAY_IDENTIFIER LV_VAR_BN ECU_ADDRESS 0x3fe706 /end MEASUREMENT
/begin MEASUREMENT lv_var_bn_efp "EFP via CAN recognized (BN2000 only)" UBYTE _CNV_S_2_RANGE______2_CM 1 100. 0. 1. DISPLAY_IDENTIFIER LV_VAR_BN_EFP ECU_ADDRESS 0x3fe70c /end MEASUREMENT
/begin CHARACTERISTIC lc_var_veh "Vehicle Variant (E60/E65) - BN2000" VALUE 0xffe41009 _REC_VAL_20_u1 1. _CNV_A_R_LINEAR_____0_CM 0. 1. DISPLAY_IDENTIFIER LC_VAR_VEH FORMAT "%2.0" /end CHARACTERISTIC
/begin MEASUREMENT lv_var_veh "LV Vehicle Variant (E60/E65) recognized - BN2000" UBYTE _CNV_S_2_RANGE______2_CM 1 100. 0. 1. DISPLAY_IDENTIFIER LV_VAR_VEH ECU_ADDRESS 0x3fe70d /end MEASUREMENT
/begin MEASUREMENT state_lrn_amp "Predicted variant for ambient pressure sensor recognition" UBYTE _CNV_S_3_STATE_LRN__536_CM 1 100. 0. 2. DISPLAY_IDENTIFIER STATE_LRN_AMP ECU_ADDRESS 0x3fe70e /end MEASUREMENT
/begin MEASUREMENT lv_wake_up "Wake up signal detected" UBYTE _CNV_S_2_RANGE______2_CM 1 100. 0. 1. DISPLAY_IDENTIFIER LV_WAKE_UP ECU_ADDRESS 0x3fe778 /end MEASUREMENT
/begin CHARACTERISTIC GEN_APP_TLR "generator load response time setpoint" VALUE 0xffe4052e _REC_VAL_20_u1 25.5 _CNV_A_R_LINEAR_____24_CM 0. 25.5 FORMAT "%4.1" /end CHARACTERISTIC
/begin CHARACTERISTIC c_maf_ref "reference air mass flow for rl" VALUE 0xffe417ca _REC_VAL_20_u2 1389. _CNV_A_R_LINEAR_____108_CM 0. 1389. DISPLAY_IDENTIFIER C_MAF_REF FORMAT "%7.2" /end CHARACTERISTIC
/begin CHARACTERISTIC lc_gen_clu "Generator clutch" VALUE 0xffe40f6a _REC_VAL_20_u1 1. _CNV_A_R_LINEAR_____0_CM 0. 1. DISPLAY_IDENTIFIER LC_GEN_CLU FORMAT "%2.0" /end CHARACTERISTIC
/begin MEASUREMENT lv_gen_err_plaus "Typ of alternator not  plausible" UBYTE _CNV_S_2_RANGE______1_R_CM 1 100. 0. 255. DISPLAY_IDENTIFIER LV_GEN_ERR_PLAUS ECU_ADDRESS 0x3fe3fe /end MEASUREMENT
/begin MEASUREMENT lv_gen_err_el "Electrical alternator error output out of powermanagement" UBYTE _CNV_S_2_RANGE______1_R_CM 1 100. 0. 255. DISPLAY_IDENTIFIER LV_GEN_ERR_EL ECU_ADDRESS 0x3fe3ff /end MEASUREMENT
/begin MEASUREMENT lv_gen_err_mec "mechanical alternator error output out of powermanagement" UBYTE _CNV_S_2_RANGE______1_R_CM 1 100. 0. 255. DISPLAY_IDENTIFIER LV_GEN_ERR_MEC ECU_ADDRESS 0x3fe400 /end MEASUREMENT
/begin MEASUREMENT lv_gen_err_temp "High temperature run at  alternator output out of powermanagement" UBYTE _CNV_S_2_RANGE______1_R_CM 1 100. 0. 255. DISPLAY_IDENTIFIER LV_GEN_ERR_TEMP ECU_ADDRESS 0x3fe401 /end MEASUREMENT
/begin MEASUREMENT lv_gen_err_tout "Alternator comunication interupted" UBYTE _CNV_S_2_RANGE______1_R_CM 1 100. 0. 255. DISPLAY_IDENTIFIER LV_GEN_ERR_TOUT ECU_ADDRESS 0x3fe402 /end MEASUREMENT
/begin MEASUREMENT state_gen_err "Conditions of alternator error output out of powermanagement" UBYTE _CNV_A_R_LINEAR_____0_CM 1 100. 0. 255. DISPLAY_IDENTIFIER STATE_GEN_ERR ECU_ADDRESS 0x3fe3e7 FORMAT "%3.0" /end MEASUREMENT
/begin MEASUREMENT state_gen_err_if "Conditions of BSD interface alternator error output out of powermanagement" UBYTE _CNV_A_R_LINEAR_____0_CM 1 100. 0. 255. DISPLAY_IDENTIFIER STATE_GEN_ERR_IF ECU_ADDRESS 0x3fe3e8 FORMAT "%3.0" /end MEASUREMENT
/begin MEASUREMENT B_master "" UBYTE _CNV_A_R_LINEAR_____22_CM 1 100. 0. 255. DISPLAY_IDENTIFIER B_MASTER ECU_ADDRESS 0x3fe3e2 BIT_MASK 0x1 /end MEASUREMENT
/begin MEASUREMENT taml "Tastverhältnis E-Lüfter" UBYTE _CNV_R_R_rel_ub_b10_574_CM 1 100. 0. 100. ECU_ADDRESS 0x3fe3d5 FORMAT "%8.4" /end MEASUREMENT
/begin MEASUREMENT vvt_es "VVT-Strom Bank 1 bzw. 4 Zylinder" UBYTE _CNV_R_R_i_vvt_ub_q_542_CM 1 100. -63.5 64. ECU_ADDRESS 0x3fe3da FORMAT "%8.4" /end MEASUREMENT
/begin MEASUREMENT vvt_es2 "VVT-Strom Bank2" UBYTE _CNV_R_R_i_vvt_ub_q_542_CM 1 100. -63.5 64. ECU_ADDRESS 0x3fe3db FORMAT "%8.4" /end MEASUREMENT
/begin MEASUREMENT nsllm "Normdrehzahl" UBYTE _CNV_R_R_nmot_ub_q1_626_CM 1 100. 0. 2550. ECU_ADDRESS 0x3fe3d9 FORMAT "%8.4" /end MEASUREMENT
/begin MEASUREMENT tq_loss_alter_1 "Torque losses by alternator" SWORD _CNV_A_R_LINEAR_____55_CM 1 100. -1024. 1023.96875 DISPLAY_IDENTIFIER TQ_LOSS_ALTER_1 ECU_ADDRESS 0x3fd208 BYTE_ORDER MSB_LAST FORMAT "%8.2" /end MEASUREMENT
/begin MEASUREMENT state_alter "Status of alternator diagnosis" UBYTE _CNV_A_R_LINEAR_____0_CM 1 100. 0. 3. DISPLAY_IDENTIFIER STATE_ALTER ECU_ADDRESS 0x3fe3e3 FORMAT "%2.0" /end MEASUREMENT
/begin MEASUREMENT n_sp_is_pow_1 "nominal idle speed setpoint by powermanagement" UWORD _CNV_A_R_LINEAR_____10_CM 1 100. 0. 8160. DISPLAY_IDENTIFIER N_SP_IS_POW_1 ECU_ADDRESS 0x3fd204 BYTE_ORDER MSB_LAST FORMAT "%4.0" /end MEASUREMENT
/begin MEASUREMENT MDNORM "Maximales indiziertes Motormoment für Moment-Normierung" UBYTE _CNV_R_R_md_ub_q16_627_CM 1 100. 16. 1008. DISPLAY_IDENTIFIER mdnorm ECU_ADDRESS 0x3fe3dc FORMAT "%4.0" /end MEASUREMENT
/begin MEASUREMENT lv_n_sp_is_pow_act "nominal idle speed setpoint by powermanagement" UBYTE _CNV_S_2_RANGE______2_CM 1 100. 0. 1. DISPLAY_IDENTIFIER LV_N_SP_IS_POW_ACT ECU_ADDRESS 0x3fe3e6 /end MEASUREMENT
/begin MEASUREMENT B_gfhtak "High temperature run at  alternator output out of powermanagement active" UBYTE _CNV_S_2_RANGE______2_CM 1 100. 0. 1. DISPLAY_IDENTIFIER B_GFHTAK ECU_ADDRESS 0x3fe3ec /end MEASUREMENT
/begin MEASUREMENT B_ifbsak "lv_err_bat_sens error active and in FMY due to BSD" UBYTE _CNV_S_2_RANGE______2_CM 1 100. 0. 1. DISPLAY_IDENTIFIER B_IFBSAK ECU_ADDRESS 0x3fe40f /end MEASUREMENT
/begin MEASUREMENT B_ifebsak "lv_err_bat_sens error active and in FMY due to EBSD" UBYTE _CNV_S_2_RANGE______2_CM 1 100. 0. 1. DISPLAY_IDENTIFIER B_IFEBSAK ECU_ADDRESS 0x3fe410 /end MEASUREMENT
/begin MEASUREMENT B_ibsfprl "lv_err_bat_sens error active and in FMY" UBYTE _CNV_S_2_RANGE______2_CM 1 100. 0. 1. DISPLAY_IDENTIFIER B_IBSFPRL ECU_ADDRESS 0x3fe412 /end MEASUREMENT
/begin MEASUREMENT B_iftempak "lv_err_bat_sens_it error active and in FMY due to temperature" UBYTE _CNV_S_2_RANGE______2_CM 1 100. 0. 1. DISPLAY_IDENTIFIER B_IFTEMPAK ECU_ADDRESS 0x3fe413 /end MEASUREMENT
/begin MEASUREMENT B_ifuplak "lv_err_bat_sens error active and in FMY due to IBS-plausibility" UBYTE _CNV_S_2_RANGE______2_CM 1 100. 0. 1. DISPLAY_IDENTIFIER B_IFUPLAK ECU_ADDRESS 0x3fe411 /end MEASUREMENT
/begin MEASUREMENT B_ifusak "lv_err_bat_sens_it error active and in FMY due to voltage" UBYTE _CNV_S_2_RANGE______2_CM 1 100. 0. 1. DISPLAY_IDENTIFIER B_IFUSAK ECU_ADDRESS 0x3fe415 /end MEASUREMENT
/begin MEASUREMENT B_ifisak "lv_err_bat_sens_it error active and in FMY due to current" UBYTE _CNV_S_2_RANGE______2_CM 1 100. 0. 1. DISPLAY_IDENTIFIER B_IFISAK ECU_ADDRESS 0x3fe414 /end MEASUREMENT
/begin MEASUREMENT B_ifkl15ak "lv_err_bat_sens_it_el error active and in FMY due to shortcut" UBYTE _CNV_S_2_RANGE______2_CM 1 100. 0. 1. DISPLAY_IDENTIFIER B_IFKL15AK ECU_ADDRESS 0x3fe416 /end MEASUREMENT
/begin MEASUREMENT B_ifsysak "lv_err_bat_sens_it_el error active and in FMY due to system" UBYTE _CNV_S_2_RANGE______2_CM 1 100. 0. 1. DISPLAY_IDENTIFIER B_IFSYSAK ECU_ADDRESS 0x3fe417 /end MEASUREMENT
/begin MEASUREMENT B_slp "Condition secondary air pump" UBYTE _CNV_S_2_RANGE______2_CM 1 100. 0. 1. DISPLAY_IDENTIFIER B_SLP ECU_ADDRESS 0x3fe3f3 /end MEASUREMENT
/begin MEASUREMENT B_genfprl "Alternator error active" UBYTE _CNV_S_2_RANGE______2_CM 1 100. 0. 1. DISPLAY_IDENTIFIER B_GENFPRL ECU_ADDRESS 0x3fe3ee /end MEASUREMENT
/begin MEASUREMENT B_ll "Logic idle" UBYTE _CNV_S_2_RANGE______2_CM 1 100. 0. 1. DISPLAY_IDENTIFIER B_LL ECU_ADDRESS 0x3fe3d4 /end MEASUREMENT
/begin MEASUREMENT B_kl15 "Logic ignition key" UBYTE _CNV_S_2_RANGE______2_CM 1 100. 0. 1. DISPLAY_IDENTIFIER B_KL15 ECU_ADDRESS 0x3fe3d7 /end MEASUREMENT
/begin MEASUREMENT B_nmot "LV detected engine speed" UBYTE _CNV_S_2_RANGE______2_CM 1 100. 0. 1. DISPLAY_IDENTIFIER B_NMOT ECU_ADDRESS 0x3fe3cb /end MEASUREMENT
/begin MEASUREMENT B_sta "Condition after start" UBYTE _CNV_S_2_RANGE______2_CM 1 100. 0. 1. DISPLAY_IDENTIFIER B_STA ECU_ADDRESS 0x3fe3f2 /end MEASUREMENT
/begin MEASUREMENT B_pwf "LV powerfail, loss of adapted values" UBYTE _CNV_S_2_RANGE______2_CM 1 100. 0. 1. DISPLAY_IDENTIFIER B_PWF ECU_ADDRESS 0x3fe3cc /end MEASUREMENT
/begin MEASUREMENT ecu_state "Information on ECU state" UBYTE _CNV_S_6_RANGE_ECU__629_CM 1 100. 0. 5. DISPLAY_IDENTIFIER ECU_STATE ECU_ADDRESS 0x3f9c43 /end MEASUREMENT
/begin MEASUREMENT state_err_vglsl_2 "Verified OBDI signal fault information for virtual ground fault detection" UBYTE _CNV_S_4_RANGE_STAT_630_CM 1 100. 0. 3. DISPLAY_IDENTIFIER STATE_ERR_VGLSL_2 ECU_ADDRESS 0x3fed6e /end MEASUREMENT
/begin MEASUREMENT state_err_vglsl_1 "Verified OBDI signal fault information for virtual ground fault detection" UBYTE _CNV_S_4_RANGE_STAT_630_CM 1 100. 0. 3. DISPLAY_IDENTIFIER STATE_ERR_VGLSL_1 ECU_ADDRESS 0x3fed64 /end MEASUREMENT
/begin MEASUREMENT state_err_vnlsl_1 "Verified OBDI signal fault information for reference voltage cell fault detection" UBYTE _CNV_S_4_RANGE_STAT_630_CM 1 100. 0. 3. DISPLAY_IDENTIFIER STATE_ERR_VNLSL_1 ECU_ADDRESS 0x3fed65 /end MEASUREMENT
/begin MEASUREMENT state_err_vnlsl_2 "Verified OBDI signal fault information for reference voltage cell fault detection" UBYTE _CNV_S_4_RANGE_STAT_630_CM 1 100. 0. 3. DISPLAY_IDENTIFIER STATE_ERR_VNLSL_2 ECU_ADDRESS 0x3fed6f /end MEASUREMENT
/begin MEASUREMENT state_err_iplsl_1 "Verified OBDI signal fault information for pump cell fault detection" UBYTE _CNV_S_4_RANGE_STAT_630_CM 1 100. 0. 3. DISPLAY_IDENTIFIER STATE_ERR_IPLSL_1 ECU_ADDRESS 0x3fed66 /end MEASUREMENT
/begin MEASUREMENT state_err_iplsl_2 "Verified OBDI signal fault information for pump cell fault detection" UBYTE _CNV_S_4_RANGE_STAT_630_CM 1 100. 0. 3. DISPLAY_IDENTIFIER STATE_ERR_IPLSL_2 ECU_ADDRESS 0x3fed70 /end MEASUREMENT
/begin MEASUREMENT ctr_err_lsl_if_spi_wr_1 "Counter indicating number of invalied INIT_REG write validation cycles detected" UBYTE _CNV_A_R_LINEAR_____0_CM 1 100. 0. 255. DISPLAY_IDENTIFIER CTR_ERR_LSL_IF_SPI_WR_1 ECU_ADDRESS 0x3fed6a FORMAT "%3.0" /end MEASUREMENT
/begin MEASUREMENT ctr_err_lsl_if_spi_wr_2 "Counter indicating number of invalied INIT_REG write validation cycles detected" UBYTE _CNV_A_R_LINEAR_____0_CM 1 100. 0. 255. DISPLAY_IDENTIFIER CTR_ERR_LSL_IF_SPI_WR_2 ECU_ADDRESS 0x3fed74 FORMAT "%3.0" /end MEASUREMENT
/begin MEASUREMENT lsl_if_spi_wr_1 "Bitfield mapping of contents to be written to CJ120 INIT_REG" UBYTE _CNV_A_R_LINEAR_____0_CM 1 100. 0. 255. DISPLAY_IDENTIFIER LSL_IF_SPI_WR_1 ECU_ADDRESS 0x3fed63 FORMAT "%3.0" /end MEASUREMENT
/begin MEASUREMENT lsl_if_spi_wr_1.Bit_0 "Boolean flag requesting WRAF sensor interface gain selection" UBYTE _CNV_A_R_LINEAR_____0_CM 1 100. 0. 255. DISPLAY_IDENTIFIER LV_LSL_IF_GAIN_SWI_1 ECU_ADDRESS 0x3fed63 FORMAT "%3.0" BIT_MASK 0x1 /end MEASUREMENT
/begin MEASUREMENT lsl_if_spi_wr_1.Bit_1 "Boolean flag requesting WRAF sensor interface mode activation" UBYTE _CNV_A_R_LINEAR_____0_CM 1 100. 0. 255. DISPLAY_IDENTIFIER LV_LSL_IF_TEST_ENA_1 ECU_ADDRESS 0x3fed63 FORMAT "%3.0" BIT_MASK 0x2 /end MEASUREMENT
/begin MEASUREMENT lsl_if_spi_wr_1.Bit_2 "Boolean flag requesting WRAF sensor interface to use external oscillator" UBYTE _CNV_A_R_LINEAR_____0_CM 1 100. 0. 255. DISPLAY_IDENTIFIER LV_LSL_IF_EXT_OSC_1 ECU_ADDRESS 0x3fed63 FORMAT "%3.0" BIT_MASK 0x4 /end MEASUREMENT
/begin MEASUREMENT lsl_if_spi_wr_1.Bit_3 "Boolean flag requesting WRAF sensor interface to hold pump current control" UBYTE _CNV_A_R_LINEAR_____0_CM 1 100. 0. 255. DISPLAY_IDENTIFIER LV_LSL_IF_IPLSL_CTL_1 ECU_ADDRESS 0x3fed63 FORMAT "%3.0" BIT_MASK 0x8 /end MEASUREMENT
/begin MEASUREMENT lsl_if_spi_wr_1.Bit_4 "Boolean flag requesting WRAF sensor interface to enable pump current hold" UBYTE _CNV_A_R_LINEAR_____0_CM 1 100. 0. 255. DISPLAY_IDENTIFIER LV_LSL_IF_IPLSL_HLD_ENA_1 ECU_ADDRESS 0x3fed63 FORMAT "%3.0" BIT_MASK 0x10 /end MEASUREMENT
/begin MEASUREMENT lsl_if_spi_wr_2 "Bitfield mapping of contents to be written to CJ120 INIT_REG" UBYTE _CNV_A_R_LINEAR_____0_CM 1 100. 0. 255. DISPLAY_IDENTIFIER LSL_IF_SPI_WR_2 ECU_ADDRESS 0x3fed6d FORMAT "%3.0" /end MEASUREMENT
/begin MEASUREMENT lsl_if_spi_wr_2.Bit_0 "Boolean flag requesting WRAF sensor interface gain selection" UBYTE _CNV_A_R_LINEAR_____0_CM 1 100. 0. 255. DISPLAY_IDENTIFIER LV_LSL_IF_GAIN_SWI_2 ECU_ADDRESS 0x3fed6d FORMAT "%3.0" BIT_MASK 0x1 /end MEASUREMENT
/begin MEASUREMENT lsl_if_spi_wr_2.Bit_1 "Boolean flag requesting WRAF sensor interface mode activation" UBYTE _CNV_A_R_LINEAR_____0_CM 1 100. 0. 255. DISPLAY_IDENTIFIER LV_LSL_IF_TEST_ENA_2 ECU_ADDRESS 0x3fed6d FORMAT "%3.0" BIT_MASK 0x2 /end MEASUREMENT
/begin MEASUREMENT lsl_if_spi_wr_2.Bit_2 "Boolean flag requesting WRAF sensor interface to use external oscillator" UBYTE _CNV_A_R_LINEAR_____0_CM 1 100. 0. 255. DISPLAY_IDENTIFIER LV_LSL_IF_EXT_OSC_2 ECU_ADDRESS 0x3fed6d FORMAT "%3.0" BIT_MASK 0x4 /end MEASUREMENT
/begin MEASUREMENT lsl_if_spi_wr_2.Bit_3 "Boolean flag requesting WRAF sensor interface to hold pump current control" UBYTE _CNV_A_R_LINEAR_____0_CM 1 100. 0. 255. DISPLAY_IDENTIFIER LV_LSL_IF_IPLSL_CTL_2 ECU_ADDRESS 0x3fed6d FORMAT "%3.0" BIT_MASK 0x8 /end MEASUREMENT
/begin MEASUREMENT lsl_if_spi_wr_2.Bit_4 "Boolean flag requesting WRAF sensor interface to enable pump current hold" UBYTE _CNV_A_R_LINEAR_____0_CM 1 100. 0. 255. DISPLAY_IDENTIFIER LV_LSL_IF_IPLSL_HLD_ENA_2 ECU_ADDRESS 0x3fed6d FORMAT "%3.0" BIT_MASK 0x10 /end MEASUREMENT
/begin MEASUREMENT lsl_if_spi_rd_1 "Bit-field mapping verified contents of CJ120 INIT_REG" UBYTE _CNV_A_R_LINEAR_____0_CM 1 100. 0. 255. DISPLAY_IDENTIFIER LSL_IF_SPI_RD_1 ECU_ADDRESS 0x3fed62 FORMAT "%3.0" /end MEASUREMENT
/begin MEASUREMENT lsl_if_spi_rd_2 "Bit-field mapping verified contents of CJ120 INIT_REG" UBYTE _CNV_A_R_LINEAR_____0_CM 1 100. 0. 255. DISPLAY_IDENTIFIER LSL_IF_SPI_RD_2 ECU_ADDRESS 0x3fed6c FORMAT "%3.0" /end MEASUREMENT
/begin MEASUREMENT lsl_if_ic_info_1 "CJ120 index number & IC number information" UBYTE _CNV_A_R_LINEAR_____0_CM 1 100. 0. 255. DISPLAY_IDENTIFIER LSL_IF_IC_INFO_1 ECU_ADDRESS 0x3fed61 FORMAT "%3.0" /end MEASUREMENT
/begin MEASUREMENT lsl_if_ic_info_2 "CJ120 index number & IC number information" UBYTE _CNV_A_R_LINEAR_____0_CM 1 100. 0. 255. DISPLAY_IDENTIFIER LSL_IF_IC_INFO_2 ECU_ADDRESS 0x3fed6b FORMAT "%3.0" /end MEASUREMENT
/begin MEASUREMENT lv_lsl_deac_1 "Boolean flag indicating OBDII signal fault pending" UBYTE _CNV_S_2_RANGE______21_CM 1 100. 0. 1. DISPLAY_IDENTIFIER LV_LSL_DEAC_1 ECU_ADDRESS 0x3fed67 BIT_MASK 0x1 /end MEASUREMENT
/begin MEASUREMENT lv_lsl_deac_2 "Boolean flag indicating OBDII signal fault pending" UBYTE _CNV_S_2_RANGE______21_CM 1 100. 0. 1. DISPLAY_IDENTIFIER LV_LSL_DEAC_2 ECU_ADDRESS 0x3fed71 BIT_MASK 0x1 /end MEASUREMENT
/begin MEASUREMENT toil "Oil temperature" UBYTE _CNV_A_R_LINEAR_____14_CM 1 100. -40. 160. DISPLAY_IDENTIFIER TOIL ECU_ADDRESS 0x3fe676 FORMAT "%3.0" /end MEASUREMENT
/begin MEASUREMENT toil_mes "???" UBYTE _CNV_A_R_LINEAR_____14_CM 1 100. -40. 160. DISPLAY_IDENTIFIER TOIL_MES ECU_ADDRESS 0x3fe677 FORMAT "%3.0" /end MEASUREMENT
/begin MEASUREMENT toil_stop "Oil temperature at transition to ES" UBYTE _CNV_A_R_LINEAR_____14_CM 1 100. -40. 160. DISPLAY_IDENTIFIER TOIL_STOP ECU_ADDRESS 0x3fe678 FORMAT "%3.0" /end MEASUREMENT
/begin CHARACTERISTIC ip_toil__v_toil "Conversion table for linearization of TOIL value acquisition" CURVE 0xffe47e7f _REC_CUR_20_u1_u1 200. _CNV_A_R_LINEAR_____14_CM -40. 160. DISPLAY_IDENTIFIER IP_TOIL FORMAT "%3.0"
 /begin AXIS_DESCR COM_AXIS v_toil _CNV_A_R_LINEAR_____44_CM 16 0. 4.998 FORMAT "%6.4" AXIS_PTS_REF ldp_v_toil__toil /end AXIS_DESCR
/end CHARACTERISTIC
/begin AXIS_PTS ldp_v_toil__toil "" 0xffe482f7 v_toil _REC_AXS_20_u1 4.998 _CNV_A_R_LINEAR_____44_CM 16 0. 4.998 DISPLAY_IDENTIFIER LDP_V_TOIL__TOIL FORMAT "%6.4" /end AXIS_PTS
/begin CHARACTERISTIC c_toil_sub_diag "Substitude value for TOIL" VALUE 0xffe4097e _REC_VAL_20_u1 200. _CNV_A_R_LINEAR_____14_CM -40. 160. DISPLAY_IDENTIFIER C_TOIL_SUB_DIAG FORMAT "%3.0" /end CHARACTERISTIC
/begin CHARACTERISTIC c_toil_grd_max_diag "Max. permissible oil temperature gradient" VALUE 0xffe4096d _REC_VAL_20_u1 255. _CNV_A_R_LINEAR_____631_CM 0. 255. DISPLAY_IDENTIFIER C_TOIL_GRD_MAX_DIAG FORMAT "%3.0" /end CHARACTERISTIC
/begin MEASUREMENT dist "Distance accumulation [100m]" ULONG _CNV_A_R_LINEAR_____16_CM 1 100. 0. 429496729500. DISPLAY_IDENTIFIER DIST ECU_ADDRESS 0x3fcf70 BYTE_ORDER MSB_LAST FORMAT "%13.0" /end MEASUREMENT
/begin COMPU_METHOD _CNV_A_R_LINEAR_____0_CM "" RAT_FUNC "%6.3" "-" COEFFS 0 1. 0. 0 0 1 /end COMPU_METHOD
/begin COMPU_METHOD _CNV_S_2_RANGE______1_R_CM "" TAB_VERB "%6.3" "[-]" COMPU_TAB_REF _CNV_S_2_RANGE______1_R /end COMPU_METHOD
/begin COMPU_VTAB_RANGE _CNV_S_2_RANGE______1_R "" 2 0 0 "0" 1 255 "1" /end COMPU_VTAB_RANGE
/begin COMPU_METHOD _CNV_S_2_RANGE______2_CM "" TAB_VERB "%6.3" "[-]" COMPU_TAB_REF _CNV_S_2_RANGE______2 /end COMPU_METHOD
/begin COMPU_VTAB _CNV_S_2_RANGE______2 "" TAB_VERB 2 0 "0" 1 "1" /end COMPU_VTAB
/begin COMPU_METHOD _CNV_A_R_LINEAR_____3_CM "" RAT_FUNC "%6.3" "V" COEFFS 0 204.7999998974999 0. 0 0 1 /end COMPU_METHOD
/begin COMPU_METHOD _CNV_A_R_LINEAR_____4_CM "" RAT_FUNC "%6.3" "s" COEFFS 0 100. 0. 0 0 1 /end COMPU_METHOD
/begin COMPU_METHOD _CNV_A_R_LINEAR_____6_CM "" RAT_FUNC "%6.3" "°C" COEFFS 0 16. 0. 0 0 1 /end COMPU_METHOD
/begin COMPU_METHOD _CNV_A_R_LINEAR_____8_CM "" RAT_FUNC "%6.3" "%" COEFFS 0 655.3600000071681 0. 0 0 1 /end COMPU_METHOD
/begin COMPU_METHOD _CNV_A_R_LINEAR_____9_CM "" RAT_FUNC "%6.3" "%" COEFFS 0 2.56 0. 0 0 1 /end COMPU_METHOD
/begin COMPU_METHOD _CNV_A_R_LINEAR_____10_CM "" RAT_FUNC "%6.3" "rpm" COEFFS 0 1. 0. 0 0 1 /end COMPU_METHOD
/begin COMPU_METHOD _CNV_A_R_LINEAR_____11_CM "" RAT_FUNC "%6.3" "°C" COEFFS 0 1.333333333333333 64. 0 0 1 /end COMPU_METHOD
/begin COMPU_METHOD _CNV_A_R_LINEAR_____12_CM "" RAT_FUNC "%6.3" "°C" COEFFS 0 1.333333333333333 0. 0 0 1 /end COMPU_METHOD
/begin COMPU_METHOD _CNV_A_R_LINEAR_____14_CM "" RAT_FUNC "%6.3" "°C" COEFFS 0 1. 40. 0 0 1 /end COMPU_METHOD
/begin COMPU_METHOD _CNV_A_R_LINEAR_____15_CM "" RAT_FUNC "%6.3" "rpm" COEFFS 0 3.125e-002 0. 0 0 1 /end COMPU_METHOD
/begin COMPU_METHOD _CNV_A_R_LINEAR_____16_CM "" RAT_FUNC "%6.3" "m" COEFFS 0 1.e-002 0. 0 0 1 /end COMPU_METHOD
/begin COMPU_METHOD _CNV_A_R_LINEAR_____20_CM "" RAT_FUNC "%6.3" "-" COEFFS 0 32768.00003968061 0. 0 0 1 /end COMPU_METHOD
/begin COMPU_METHOD _CNV_S_2_RANGE______21_CM "" TAB_VERB "%6.3" "-" COMPU_TAB_REF _CNV_S_2_RANGE______21 /end COMPU_METHOD
/begin COMPU_VTAB _CNV_S_2_RANGE______21 "" TAB_VERB 2 0 "0" 1 "1" /end COMPU_VTAB
/begin COMPU_METHOD _CNV_A_R_LINEAR_____22_CM "" RAT_FUNC "%6.3" "[-]" COEFFS 0 1. 0. 0 0 1 /end COMPU_METHOD
/begin COMPU_METHOD _CNV_A_R_LINEAR_____23_CM "" RAT_FUNC "%6.3" "km/h" COEFFS 0 1. 0. 0 0 1 /end COMPU_METHOD
/begin COMPU_METHOD _CNV_A_R_LINEAR_____24_CM "" RAT_FUNC "%6.3" "s" COEFFS 0 10. 0. 0 0 1 /end COMPU_METHOD
/begin COMPU_METHOD _CNV_A_R_LINEAR_____29_CM "" RAT_FUNC "%6.3" "-" COEFFS 0 255.9983911655618 0. 0 0 1 /end COMPU_METHOD
/begin COMPU_METHOD _CNV_A_R_LINEAR_____30_CM "" RAT_FUNC "%6.3" "s" COEFFS 0 1. 0. 0 0 1 /end COMPU_METHOD
/begin COMPU_METHOD _CNV_A_R_LINEAR_____37_CM "" RAT_FUNC "%6.3" "-" COEFFS 0 65536.00007936121 0. 0 0 1 /end COMPU_METHOD
/begin COMPU_METHOD _CNV_A_R_LINEAR_____39_CM "" RAT_FUNC "%6.3" "-" COEFFS 0 127.9991955827809 0. 0 0 1 /end COMPU_METHOD
/begin COMPU_METHOD _CNV_A_R_LINEAR_____44_CM "" RAT_FUNC "%6.3" "V" COEFFS 0 51.0204081632653 0. 0 0 1 /end COMPU_METHOD
/begin COMPU_METHOD _CNV_A_R_LINEAR_____49_CM "" RAT_FUNC "%6.3" "hPa" COEFFS 0 12.06017666543982 0. 0 0 1 /end COMPU_METHOD
/begin COMPU_METHOD _CNV_A_R_LINEAR_____50_CM "" RAT_FUNC "%6.3" "[-]" COEFFS 0 255.9999357490357 0. 0 0 1 /end COMPU_METHOD
/begin COMPU_METHOD _CNV_A_R_LINEAR_____52_CM "" RAT_FUNC "%6.3" "°TPS/s" COEFFS 0 8.535564853556485e-002 0. 0 0 1 /end COMPU_METHOD
/begin COMPU_METHOD _CNV_A_R_LINEAR_____53_CM "" RAT_FUNC "%6.3" "°TPS" COEFFS 0 137.0962343096234 0. 0 0 1 /end COMPU_METHOD
/begin COMPU_METHOD _CNV_A_R_LINEAR_____55_CM "" RAT_FUNC "%6.3" "Nm" COEFFS 0 32. 0. 0 0 1 /end COMPU_METHOD
/begin COMPU_METHOD _CNV_S_3_STATE_ARS__56_CM "" TAB_VERB "%6.3" "[-]" COMPU_TAB_REF _CNV_S_3_STATE_ARS__56 /end COMPU_METHOD
/begin COMPU_VTAB _CNV_S_3_STATE_ARS__56 "" TAB_VERB 3 0 "INACTIVE" 1 "ACTIVE" 3 "INVALID SIGNAL" /end COMPU_VTAB
/begin COMPU_METHOD _CNV_S_3_STATE_IGK__57_CM "" TAB_VERB "%6.3" "[-]" COMPU_TAB_REF _CNV_S_3_STATE_IGK__57 /end COMPU_METHOD
/begin COMPU_VTAB _CNV_S_3_STATE_IGK__57 "" TAB_VERB 3 0 "IGK OFF" 1 "IGK ON" 2 "INVALID SIGNAL" /end COMPU_VTAB
/begin COMPU_METHOD _CNV_S_4_STATE_TCS__58_CM "" TAB_VERB "%6.3" "[-]" COMPU_TAB_REF _CNV_S_4_STATE_TCS__58 /end COMPU_METHOD
/begin COMPU_VTAB _CNV_S_4_STATE_TCS__58 "" TAB_VERB 4 0 "NO INTERVENTION" 1 "MSR INTERVENTION" 2 "ASR INTERVENTION" 3 "INTERFACE LOCKED" /end COMPU_VTAB
/begin COMPU_METHOD _CNV_S_3_STATE_WAL__59_CM "" TAB_VERB "%6.3" "[-]" COMPU_TAB_REF _CNV_S_3_STATE_WAL__59 /end COMPU_METHOD
/begin COMPU_VTAB _CNV_S_3_STATE_WAL__59 "" TAB_VERB 3 0 "OFF" 1 "YELLOW" 3 "signal invalid" /end COMPU_VTAB
/begin COMPU_METHOD _CNV_A_R_LINEAR_____60_CM "" RAT_FUNC "%6.3" "V" COEFFS 0 9.807692307692308 0. 0 0 1 /end COMPU_METHOD
/begin COMPU_METHOD _CNV_A_R_LINEAR_____61_CM "" RAT_FUNC "%6.3" "Day" COEFFS 0 1. 0. 0 0 1 /end COMPU_METHOD
/begin COMPU_METHOD _CNV_S_9_STATE_TCS__62_CM "" TAB_VERB "%6.3" "[-]" COMPU_TAB_REF _CNV_S_9_STATE_TCS__62 /end COMPU_METHOD
/begin COMPU_VTAB _CNV_S_9_STATE_TCS__62 "" TAB_VERB 9 0 "NO_CONTROL" 1 "ABS_CONTROL" 2 "ASR_CONTROL" 4 "TCS_CONTROL" 8 "HBA_CONTROL" 16 "MSR_CONTROL" 32 "EBV_CONTROL" 64 "DYNO_ACTIVE" 255 "SIGNAL INVALID" /end COMPU_VTAB
/begin COMPU_METHOD _CNV_S_5_STATE_TCS__63_CM "" TAB_VERB "%6.3" "[-]" COMPU_TAB_REF _CNV_S_5_STATE_TCS__63 /end COMPU_METHOD
/begin COMPU_VTAB _CNV_S_5_STATE_TCS__63 "" TAB_VERB 5 0 "NO_INTERVENTION" 1 "DCC_INTV_ACCEPTED" 2 "EMF_INTV_ACCEPTED" 3 "HBA_INTV_ACCEPTED" 15 "SIGNAL INVALID" /end COMPU_VTAB
/begin COMPU_METHOD _CNV_A_R_LINEAR_____64_CM "" RAT_FUNC "%6.3" "m/s²" COEFFS 0 640. 0. 0 0 1 /end COMPU_METHOD
/begin COMPU_METHOD _CNV_S_5_STATE_MOD__65_CM "" TAB_VERB "%6.3" "[-]" COMPU_TAB_REF _CNV_S_5_STATE_MOD__65 /end COMPU_METHOD
/begin COMPU_VTAB _CNV_S_5_STATE_MOD__65 "" TAB_VERB 5 0 "SSC_SBC_OFF" 1 "SSC_ON" 2 "SBC_ON" 3 "SSC_SBC_ON" 7 "INVALID_SIGNAL" /end COMPU_VTAB
/begin COMPU_METHOD _CNV_S_6_STATE_TCS__66_CM "" TAB_VERB "%6.3" "[-]" COMPU_TAB_REF _CNV_S_6_STATE_TCS__66 /end COMPU_METHOD
/begin COMPU_VTAB _CNV_S_6_STATE_TCS__66 "" TAB_VERB 6 0 "VALID" 1 "PASSIV" 2 "DEFECTIVE" 4 "TRACTION MODE" 6 "UNDERVOLTAGE_TCS" 7 "INVALID SIGNAL" /end COMPU_VTAB
/begin COMPU_METHOD _CNV_S_4_STATE_TEMP_67_CM "" TAB_VERB "%6.3" "[-]" COMPU_TAB_REF _CNV_S_4_STATE_TEMP_67 /end COMPU_METHOD
/begin COMPU_VTAB _CNV_S_4_STATE_TEMP_67 "" TAB_VERB 4 0 "NO_REQUEST" 1 "ACTIVE_STEP_1" 2 "ACTIVE_STEP_2" 3 "INVALID_SIGNAL" /end COMPU_VTAB
/begin COMPU_METHOD _CNV_A_R_LINEAR_____68_CM "" RAT_FUNC "%6.3" "km/h" COEFFS 0 10. 0. 0 0 1 /end COMPU_METHOD
/begin COMPU_METHOD _CNV_S_4_STATE_ETCU_69_CM "" TAB_VERB "%6.3" "[-]" COMPU_TAB_REF _CNV_S_4_STATE_ETCU_69 /end COMPU_METHOD
/begin COMPU_VTAB _CNV_S_4_STATE_ETCU_69 "" TAB_VERB 4 0 "NO INTERVENTION" 1 "TORQUE_INCREASE" 2 "TORQUE_DECREASE" 3 "INTERFACE LOCKED" /end COMPU_VTAB
/begin COMPU_METHOD _CNV_S_4_STATE_DCC__70_CM "" TAB_VERB "%6.3" "[-]" COMPU_TAB_REF _CNV_S_4_STATE_DCC__70 /end COMPU_METHOD
/begin COMPU_VTAB _CNV_S_4_STATE_DCC__70 "" TAB_VERB 4 0 "NO_INTERVENTION" 1 "TORQUE_INCREASE" 2 "INVALID_SIGNAL" 3 "INVALID_SIGNAL" /end COMPU_VTAB
/begin COMPU_METHOD _CNV_S_3_STATE_DCC__71_CM "" TAB_VERB "%6.3" "[-]" COMPU_TAB_REF _CNV_S_3_STATE_DCC__71 /end COMPU_METHOD
/begin COMPU_VTAB _CNV_S_3_STATE_DCC__71 "" TAB_VERB 3 0 "NO_REQUEST" 1 "INHIBIT_PUC" 3 "INVALID_SIGNAL" /end COMPU_VTAB
/begin COMPU_METHOD _CNV_S_4_STATE_DCC__72_CM "" TAB_VERB "%6.3" "[-]" COMPU_TAB_REF _CNV_S_4_STATE_DCC__72 /end COMPU_METHOD
/begin COMPU_VTAB _CNV_S_4_STATE_DCC__72 "" TAB_VERB 4 0 "reserved" 1 "SYS_OFF" 2 "SYS_OK" 3 "INVALID_SIGNAL" /end COMPU_VTAB
/begin COMPU_METHOD _CNV_S_8_STATE_DCC_73_CM "" TAB_VERB "%6.3" "[-]" COMPU_TAB_REF _CNV_S_8_STATE_DCC_73 /end COMPU_METHOD
/begin COMPU_VTAB _CNV_S_8_STATE_DCC_73 "" TAB_VERB 8 0 "INACTIVE" 1 "STAND_BY" 2 "NORMAL" 3 "RESERVE" 4 "BRAKE_ACTIVE" 5 "DRIVER_ACTIVE" 6 "RESERVE" 7 "INVALID_SIGNAL" /end COMPU_VTAB
/begin COMPU_METHOD _CNV_S_3_STATE_ETCU_74_CM "" TAB_VERB "%6.3" "[-]" COMPU_TAB_REF _CNV_S_3_STATE_ETCU_74 /end COMPU_METHOD
/begin COMPU_VTAB _CNV_S_3_STATE_ETCU_74 "" TAB_VERB 3 0 "NO_OBD_ERROR" 1 "OBD_ERROR" 2 "INVALID_SIGNAL" /end COMPU_VTAB
/begin COMPU_METHOD _CNV_A_R_LINEAR_____75_CM "" RAT_FUNC "%6.3" "km" COEFFS 0 1. 0. 0 0 1 /end COMPU_METHOD
/begin COMPU_METHOD _CNV_R_R_spg_gencan_76_CM "" RAT_FUNC "%6.3" "V" COEFFS 0. 40. -424. 0. 0. 1. /end COMPU_METHOD
/begin COMPU_METHOD _CNV_S_13_STATE_BN_M_77_CM "" TAB_VERB "%6.3" "[-]" COMPU_TAB_REF _CNV_S_13_STATE_BN_M_77 /end COMPU_METHOD
/begin COMPU_VTAB _CNV_S_13_STATE_BN_M_77 "" TAB_VERB 13 0 "NO_ACTION" 1 "TIP_PRE" 2 "TIP_POST" 4 "PRESS_PRE" 8 "PRESS_POST" 16 "TIP UP or DOWN" 64 "TIP_AXIAL" 65 "TIP_AXIAL" 66 "TIP_AXIAL" 68 "TIP_POST" 72 "PRESS_POST" 80 "TIP UP or DOWN" 127 "INVALID SIGNAL" /end COMPU_VTAB
/begin COMPU_METHOD _CNV_A_R_LINEAR_____78_CM "" RAT_FUNC "%6.3" "Nm" COEFFS 0 2. 0. 0 0 1 /end COMPU_METHOD
/begin COMPU_METHOD _CNV_S_3_STATE_ST_T_79_CM "" TAB_VERB "%6.3" "[-]" COMPU_TAB_REF _CNV_S_3_STATE_ST_T_79 /end COMPU_METHOD
/begin COMPU_VTAB _CNV_S_3_STATE_ST_T_79 "" TAB_VERB 3 0 "NO_INTERVENTION" 1 "INTERVENTION" 3 "INVALID_SIGNAL" /end COMPU_VTAB
/begin COMPU_METHOD _CNV_S_3_STATE_VS_I_80_CM "" TAB_VERB "%6.3" "[-]" COMPU_TAB_REF _CNV_S_3_STATE_VS_I_80 /end COMPU_METHOD
/begin COMPU_VTAB _CNV_S_3_STATE_VS_I_80 "" TAB_VERB 3 0 "km/h" 1 "mph" 3 "INVALID SIGNAL" /end COMPU_VTAB
/begin COMPU_METHOD _CNV_S_4_STATE_PSTE_81_CM "" TAB_VERB "%6.3" "[-]" COMPU_TAB_REF _CNV_S_4_STATE_PSTE_81 /end COMPU_METHOD
/begin COMPU_VTAB _CNV_S_4_STATE_PSTE_81 "" TAB_VERB 4 0 "NO INTERVENTION" 1 "TORQUE INCREASE" 2 "TORQUE DECREASE" 3 "INVALID SIGNAL" /end COMPU_VTAB
/begin COMPU_METHOD _CNV_A_R_LINEAR_____85_CM "" RAT_FUNC "%6.3" "km/h" COEFFS 0 128.0000018750286 0. 0 0 1 /end COMPU_METHOD
/begin COMPU_METHOD _CNV_A_R_LINEAR_____86_CM "" RAT_FUNC "%6.3" "bar" COEFFS 0 1. 0. 0 0 1 /end COMPU_METHOD
/begin COMPU_METHOD _CNV_A_R_LINEAR_____87_CM "" RAT_FUNC "%6.3" "µl" COEFFS 0 1. 0. 0 0 1 /end COMPU_METHOD
/begin COMPU_METHOD _CNV_A_R_LINEAR_____88_CM "" RAT_FUNC "%6.3" "km" COEFFS 0 0.1 0. 0 0 1 /end COMPU_METHOD
/begin COMPU_METHOD _CNV_S_4_RANGE_STAT_92_CM "" TAB_VERB "%6.3" "[-]" COMPU_TAB_REF _CNV_S_4_RANGE_STAT_92 /end COMPU_METHOD
/begin COMPU_VTAB _CNV_S_4_RANGE_STAT_92 "" TAB_VERB 4 0 "CC open" 1 "CC controlled" 2 "CC closed" 3 "not defined" /end COMPU_VTAB
/begin COMPU_METHOD _CNV_S_9_STATE_ETCU_93_CM "" TAB_VERB "%6.3" "[-]" COMPU_TAB_REF _CNV_S_9_STATE_ETCU_93 /end COMPU_METHOD
/begin COMPU_VTAB _CNV_S_9_STATE_ETCU_93 "" TAB_VERB 9 0 "MIL_OFF" 2 "MIL_OFF" 4 "MIL_ON" 6 "MIL_ON" 8 "MIL_FLL" 10 "MIL_FLL" 12 "IDLE" 14 "INI_VALUE" 15 "INVALID_SIGNAL" /end COMPU_VTAB
/begin COMPU_METHOD _CNV_A_R_LINEAR_____94_CM "" RAT_FUNC "%6.3" "rpm" COEFFS 0 8. 0. 0 0 1 /end COMPU_METHOD
/begin COMPU_METHOD _CNV_A_R_LINEAR_____95_CM "" RAT_FUNC "%6.3" "Nm" COEFFS 0 1. 0. 0 0 1 /end COMPU_METHOD
/begin COMPU_METHOD _CNV_A_R_LINEAR_____96_CM "" RAT_FUNC "%6.3" "l" COEFFS 0 1. 0. 0 0 1 /end COMPU_METHOD
/begin COMPU_METHOD _CNV_A_R_LINEAR_____97_CM "" RAT_FUNC "%6.3" "min" COEFFS 0 1. 0. 0 0 1 /end COMPU_METHOD
/begin COMPU_METHOD _CNV_A_R_LINEAR_____98_CM "" RAT_FUNC "%6.3" "s" COEFFS 0 5. 0. 0 0 1 /end COMPU_METHOD
/begin COMPU_METHOD _CNV_A_R_LINEAR_____99_CM "" RAT_FUNC "%6.3" "°STW/s" COEFFS 0 22.75571737399022 0. 0 0 1 /end COMPU_METHOD
/begin COMPU_METHOD _CNV_A_R_LINEAR_____100_CM "" RAT_FUNC "%6.3" "°STW" COEFFS 0 22.75571737399022 0. 0 0 1 /end COMPU_METHOD
/begin COMPU_METHOD _CNV_S_5_STATE_AMT_106_CM "" TAB_VERB "%6.3" "[-]" COMPU_TAB_REF _CNV_S_5_STATE_AMT_106 /end COMPU_METHOD
/begin COMPU_VTAB _CNV_S_5_STATE_AMT_106 "" TAB_VERB 5 0 "NO INTERVENTION" 1 "TORQUE_DECREASE" 2 "N_REGULATION" 3 "TORQUE_INCREASE" 7 "INVALID_SIGNAL" /end COMPU_VTAB
/begin COMPU_METHOD _CNV_S_5_STATE_CLU__107_CM "" TAB_VERB "%6.3" "[-]" COMPU_TAB_REF _CNV_S_5_STATE_CLU__107 /end COMPU_METHOD
/begin COMPU_VTAB _CNV_S_5_STATE_CLU__107 "" TAB_VERB 5 0 "CLU_OPEN" 1 "CREEPING" 2 "DRIVE_OFF" 3 "CLU_CLOSED" 7 "INVALID_SIGNAL" /end COMPU_VTAB
/begin COMPU_METHOD _CNV_A_R_LINEAR_____108_CM "" RAT_FUNC "%6.3" "mg/stk" COEFFS 0 47.18142548596112 0. 0 0 1 /end COMPU_METHOD
/begin COMPU_METHOD _CNV_A_R_LINEAR_____110_CM "" RAT_FUNC "%6.3" "hPa" COEFFS 0 12.06017666543982 -1.759293338545831e-002 0 0 1 /end COMPU_METHOD
/begin COMPU_METHOD _CNV_A_R_LINEAR_____111_CM "" RAT_FUNC "%6.3" "%" COEFFS 0 655.3600000071681 3.584063961170614e-007 0 0 1 /end COMPU_METHOD
/begin COMPU_METHOD _CNV_A_R_LINEAR_____115_CM "" RAT_FUNC "%6.3" "kg/h" COEFFS 0 32. 0. 0 0 1 /end COMPU_METHOD
/begin COMPU_METHOD _CNV_A_R_LINEAR_____117_CM "" RAT_FUNC "%6.3" "-" COEFFS 0 128. 0. 0 0 1 /end COMPU_METHOD
/begin COMPU_METHOD _CNV_A_R_LINEAR_____142_CM "" RAT_FUNC "%6.3" "ms" COEFFS 0 1. 0. 0 0 1 /end COMPU_METHOD
/begin COMPU_METHOD _CNV_A_R_LINEAR_____165_CM "" RAT_FUNC "%6.3" "ms" COEFFS 0 250. 0. 0 0 1 /end COMPU_METHOD
/begin COMPU_METHOD _CNV_A_R_LINEAR_____172_CM "" RAT_FUNC "%6.3" "h" COEFFS 0 35999.99999497086 0. 0 0 1 /end COMPU_METHOD
/begin COMPU_METHOD _CNV_A_R_LINEAR_____187_CM "" RAT_FUNC "%6.3" "Nm" COEFFS 0 32. 32768. 0 0 1 /end COMPU_METHOD
/begin COMPU_METHOD _CNV_A_R_LINEAR_____199_CM "" RAT_FUNC "%6.3" "hPa" COEFFS 0 0.3768805207949945 0. 0 0 1 /end COMPU_METHOD
/begin COMPU_METHOD _CNV_A_R_LINEAR_____269_CM "" RAT_FUNC "%6.3" "V" COEFFS 0 204.8 0. 0 0 1 /end COMPU_METHOD
/begin COMPU_METHOD _CNV_A_R_LINEAR_____303_CM "" RAT_FUNC "%6.3" "°C" COEFFS 0 15.99999804684544 -4.000060547696194e-003 0 0 1 /end COMPU_METHOD
/begin COMPU_METHOD _CNV_A_R_LINEAR_____304_CM "" RAT_FUNC "%6.3" "ohm" COEFFS 0 4. 0. 0 0 1 /end COMPU_METHOD
/begin COMPU_METHOD _CNV_S_5_RANGE_STAT_305_CM "" TAB_VERB "%6.3" "[-]" COMPU_TAB_REF _CNV_S_5_RANGE_STAT_305 /end COMPU_METHOD
/begin COMPU_VTAB _CNV_S_5_RANGE_STAT_305 "" TAB_VERB 5 0 "Off" 1 "MES_OFS" 2 "ADJ_OFS" 3 "ADJ_GAIN" 4 "MES" /end COMPU_VTAB
/begin COMPU_METHOD _CNV_A_R_LINEAR_____306_CM "" RAT_FUNC "%6.3" "V" COEFFS 0 819.2192192192192 0. 0 0 1 /end COMPU_METHOD
/begin COMPU_METHOD _CNV_A_R_LINEAR_____307_CM "" RAT_FUNC "%6.3" "-" COEFFS 0 3276.800790412251 0. 0 0 1 /end COMPU_METHOD
/begin COMPU_METHOD _CNV_A_R_LINEAR_____364_CM "" RAT_FUNC "%6.3" "s" COEFFS 0 100.0015259720442 0. 0 0 1 /end COMPU_METHOD
/begin COMPU_METHOD _CNV_A_R_LINEAR_____367_CM "" RAT_FUNC "%6.3" "°C" COEFFS 0 15.99975585564965 0. 0 0 1 /end COMPU_METHOD
/begin COMPU_METHOD _CNV_A_R_LINEAR_____382_CM "" RAT_FUNC "%6.3" "cm²" COEFFS 0 1118.481084425738 0. 0 0 1 /end COMPU_METHOD
/begin COMPU_METHOD _CNV_A_R_LINEAR_____383_CM "" RAT_FUNC "%6.3" "hPa" COEFFS 0 96.48288560192751 2.255463186884299e-005 0 0 1 /end COMPU_METHOD
/begin COMPU_METHOD _CNV_A_R_LINEAR_____384_CM "" RAT_FUNC "%6.3" "Pa/kg" COEFFS 0 8.985089974293059e-003 0. 0 0 1 /end COMPU_METHOD
/begin COMPU_METHOD _CNV_A_R_LINEAR_____385_CM "" RAT_FUNC "%6.3" "hPa" COEFFS 0 1541.2906436473 0. 0 0 1 /end COMPU_METHOD
/begin COMPU_METHOD _CNV_A_R_LINEAR_____386_CM "" RAT_FUNC "%6.3" "hPa/ms" COEFFS 0 395.1818376757466 0. 0 0 1 /end COMPU_METHOD
/begin COMPU_METHOD _CNV_A_R_LINEAR_____387_CM "" RAT_FUNC "%6.3" "1/s" COEFFS 0 1073.741857908145 0. 0 0 1 /end COMPU_METHOD
/begin COMPU_METHOD _CNV_A_R_LINEAR_____388_CM "" RAT_FUNC "%6.3" "cm²" COEFFS 0 1118.481075453891 2.574382087914273e-004 0 0 1 /end COMPU_METHOD
/begin COMPU_METHOD _CNV_A_R_LINEAR_____389_CM "" RAT_FUNC "%6.3" "%/kg" COEFFS 0 0.3817721076546662 0. 0 0 1 /end COMPU_METHOD
/begin COMPU_METHOD _CNV_A_R_LINEAR_____390_CM "" RAT_FUNC "%6.3" "%/(hPa*s)" COEFFS 0 29173.86349472035 0. 0 0 1 /end COMPU_METHOD
/begin COMPU_METHOD _CNV_A_R_LINEAR_____391_CM "" RAT_FUNC "%6.3" "%/hPa" COEFFS 0 111291.3086302347 0. 0 0 1 /end COMPU_METHOD
/begin COMPU_METHOD _CNV_A_R_LINEAR_____392_CM "" RAT_FUNC "%6.3" "ms" COEFFS 0 1000. 0. 0 0 1 /end COMPU_METHOD
/begin COMPU_METHOD _CNV_A_R_LINEAR_____393_CM "" RAT_FUNC "%6.3" "(%*h)/kg" COEFFS 0 5242.590296388145 0. 0 0 1 /end COMPU_METHOD
/begin COMPU_METHOD _CNV_A_R_LINEAR_____394_CM "" RAT_FUNC "%6.3" "-" COEFFS 0 8191.999999679995 0. 0 0 1 /end COMPU_METHOD
/begin COMPU_METHOD _CNV_S_3_STATE_CTL__398_CM "" TAB_VERB "%6.3" "[-]" COMPU_TAB_REF _CNV_S_3_STATE_CTL__398 /end COMPU_METHOD
/begin COMPU_VTAB _CNV_S_3_STATE_CTL__398 "" TAB_VERB 3 0 "INSY_OPL" 1 "INSY_AR_CTL" 2 "INSY_AMP_CTL" /end COMPU_VTAB
/begin COMPU_METHOD _CNV_A_R_LINEAR_____413_CM "" RAT_FUNC "%6.3" "°TPS" COEFFS 0 137.0962343096234 1.818989403545857e-012 0 0 1 /end COMPU_METHOD
/begin COMPU_METHOD _CNV_A_R_LINEAR_____416_CM "" RAT_FUNC "%6.3" "1/min/s" COEFFS 0 3.125e-002 0. 0 0 1 /end COMPU_METHOD
/begin COMPU_METHOD _CNV_A_R_LINEAR_____499_CM "" RAT_FUNC "%6.3" "°TPS/V" COEFFS 0 1365.3125 0. 0 0 1 /end COMPU_METHOD
/begin COMPU_METHOD _CNV_S_3_STATE_LRN__536_CM "" TAB_VERB "%6.3" "[-]" COMPU_TAB_REF _CNV_S_3_STATE_LRN__536 /end COMPU_METHOD
/begin COMPU_VTAB _CNV_S_3_STATE_LRN__536 "" TAB_VERB 3 0 "Variant unknown" 1 "Motorola sensor" 2 "KP120 - sensor" /end COMPU_VTAB
/begin COMPU_METHOD _CNV_R_R_i_vvt_ub_q_542_CM "" RAT_FUNC "%6.3" "A" COEFFS 0. 1. 63.5 0. 0. 0.5 /end COMPU_METHOD
/begin COMPU_METHOD _CNV_R_R_rel_ub_b10_574_CM "" RAT_FUNC "%6.3" "%" COEFFS 0. 255. 0. 0. 0. 100. /end COMPU_METHOD
/begin COMPU_METHOD _CNV_R_R_nmot_ub_q1_626_CM "" RAT_FUNC "%6.3" "rpm" COEFFS 0. 1. 0. 0. 0. 10. /end COMPU_METHOD
/begin COMPU_METHOD _CNV_R_R_md_ub_q16_627_CM "" RAT_FUNC "%6.3" "Nm" COEFFS 0. 1. 0. 0. 0. 16. /end COMPU_METHOD
/begin COMPU_METHOD _CNV_S_6_RANGE_ECU__629_CM "" TAB_VERB "%6.3" "[-]" COMPU_TAB_REF _CNV_S_6_RANGE_ECU__629 /end COMPU_METHOD
/begin COMPU_VTAB _CNV_S_6_RANGE_ECU__629 "" TAB_VERB 6 0 "ENG_STOP" 1 "RUN_ENG" 2 "SYN_ENG_IGK_ON" 3 "SYN_ENG_IGK_OFF" 4 "PWL" 5 "ENG_LOCK" /end COMPU_VTAB
/begin COMPU_METHOD _CNV_S_4_RANGE_STAT_630_CM "" TAB_VERB "%6.3" "[-]" COMPU_TAB_REF _CNV_S_4_RANGE_STAT_630 /end COMPU_METHOD
/begin COMPU_VTAB _CNV_S_4_RANGE_STAT_630 "" TAB_VERB 4 0 "SCG" 1 "VB_LOW" 2 "SCB" 3 "NO_FAULT" /end COMPU_VTAB
/begin COMPU_METHOD _CNV_A_R_LINEAR_____631_CM "" RAT_FUNC "%6.3" "°C/s" COEFFS 0 1. 0. 0 0 1 /end COMPU_METHOD
/begin RECORD_LAYOUT _REC_VAL_20_u1 FNC_VALUES 1 UBYTE COLUMN_DIR DIRECT /end RECORD_LAYOUT
/begin RECORD_LAYOUT _REC_VAL_20_u2 FNC_VALUES 1 UWORD COLUMN_DIR DIRECT /end RECORD_LAYOUT
/begin RECORD_LAYOUT _REC_CUR_20_u2_u1 FNC_VALUES 1 UWORD COLUMN_DIR DIRECT /end RECORD_LAYOUT
/begin RECORD_LAYOUT _REC_AXS_20_u1 NO_AXIS_PTS_X 1 UBYTE AXIS_PTS_X 2 UBYTE INDEX_INCR DIRECT /end RECORD_LAYOUT
/begin RECORD_LAYOUT _REC_MAP_20_u1_u1_u1 FNC_VALUES 1 UBYTE COLUMN_DIR DIRECT /end RECORD_LAYOUT
/begin RECORD_LAYOUT _REC_CUR_20_u1_u1 FNC_VALUES 1 UBYTE COLUMN_DIR DIRECT /end RECORD_LAYOUT
/begin RECORD_LAYOUT _REC_AXS_20_u2 NO_AXIS_PTS_X 1 UWORD AXIS_PTS_X 2 UWORD INDEX_INCR DIRECT /end RECORD_LAYOUT
/begin RECORD_LAYOUT _REC_CUR_20_u1_u2 FNC_VALUES 1 UBYTE COLUMN_DIR DIRECT /end RECORD_LAYOUT
/begin RECORD_LAYOUT _REC_MAP_20_u2_u1_u1 FNC_VALUES 1 UWORD COLUMN_DIR DIRECT /end RECORD_LAYOUT
/begin RECORD_LAYOUT _REC_CUR_20_u2_u2 FNC_VALUES 1 UWORD COLUMN_DIR DIRECT /end RECORD_LAYOUT
/begin RECORD_LAYOUT _REC_VAL_20_u4 FNC_VALUES 1 ULONG COLUMN_DIR DIRECT /end RECORD_LAYOUT
/begin RECORD_LAYOUT _REC_VAL_20_s2 FNC_VALUES 1 SWORD COLUMN_DIR DIRECT /end RECORD_LAYOUT
/begin RECORD_LAYOUT _REC_MAP_20_u2_u1_u2 FNC_VALUES 1 UWORD COLUMN_DIR DIRECT /end RECORD_LAYOUT
/begin FUNCTION SYS_Input_messages "_Input messages"
 /begin DEF_CHARACTERISTIC c_temp_gb_sub c_t_ctr_swi_off_vb_min c_v_sp_gen c_tq_accin c_tq_stnd c_tam_sub lc_tam_man_as c_tam_man_as c_tout_efp_crash ip_tq_loss_acc_inp /end DEF_CHARACTERISTIC
 /begin OUT_MEASUREMENT lv_err_bn_msw tq_loss_ars_av_can tq_loss_ars_sp_can veh_key_nr state_ars_can state_igk_can lv_tcs_lih_can state_tcs_intv state_wal_can t_ctr_rel_can v_sp_gen t_can state_tcs_ctl state_tcs_dece ac_veh_lgt_tcs ac_veh_trv_tcs state_mod_gb state_tcs_can state_temp_gb temp_gb vs_icl_disp lv_dcc_lih_can lv_dcc_puc_inh tq_dcc_slow_bn tq_dcc_fast_bn state_etcu_intv state_dcc_intv state_dcc_puc_inh state_dcc_off_req state_dcc lv_dcc_off_ack lv_err_tq_loss_ars_av_can lv_err_tq_loss_ars_sp_can lv_rly_st_can lv_key_aux tcc_can_cas tq_tcs_fast_bn tcc_can_tq_dcc tq_tcs_slow_bn tq_gs_slow_bn tcc_can_tq_tcs lv_tq_dcc_inc_req tq_gs_fast_bn tq_amt_fast_bn tq_amt_slow_bn tcc_can_tq_etcu state_etcu_obd_err state_amt_intv state_acin_can ctr_km_bn tcc_can_tq_amt t_ctr_swi_off_vb ctrgenms n_idlms tcc_can_icl tcc_can_msw state_bn_msw lv_err_ang_pste_can tcc_can_ars lv_etcu_lih_can lv_amt_lih_can state_st_tq_lim_gs state_st_tq_lim_amt lv_var_etcu lv_var_bn_msw lv_var_dcc lv_var_ars state_veh_mod state_vs_icl_disp tcc_can_veh_mod state_if_icl_bn_msw tcc_can_tq_pste_2 state_pste_2_intv tq_loss_pste_2_av_can tq_loss_pste_2_sp_can lv_pste_2_err state_brake_prs lv_var_pste_2 state_cru_bn ctr_diag_tcc_can_cas ctr_diag_tcc_can_tq_tcs ctr_diag_tcc_can_tq_etcu ctr_diag_tcc_can_tq_amt ctr_diag_tcc_can_icl ctr_diag_tcc_can_ars ctr_diag_tcc_can_msw ctr_diag_tcc_can_tq_dcc ctr_diag_cks_cas ctr_diag_cks_tq_tcs ctr_diag_cks_tq_etcu ctr_diag_cks_tq_amt ctr_diag_cks_msw ctr_diag_cks_tq_dcc ctr_diag_tout_ars ctr_diag_tout_cas ctr_diag_tout_tq_tcs ctr_diag_tout_vs_tcs ctr_diag_tout_tcs ctr_diag_tout_tq_etcu ctr_diag_tout_etcu ctr_diag_tout_tq_amt ctr_diag_tout_tq_dcc ctr_diag_tout_acc ctr_diag_tout_km_icl ctr_diag_tout_icl ctr_diag_tout_pow_vb ctr_diag_tout_pow_gen ctr_diag_tout_msw ctr_diag_tout_t_icl ctr_diag_tout_ang_pste ctr_diag_tcc_can_veh_mod ctr_diag_cks_veh_mod ctr_diag_tout_veh_mod ctr_diag_tcc_can_tq_pste_2 ctr_diag_cks_tq_pste_2 ctr_diag_tout_tq_pste_2 ctr_diag_tout_efp lv_err_bn_acc lv_err_bn_cas lv_err_bn_icl lv_err_bn_km_icl lv_err_bn_pow_gen lv_err_bn_pow_vb lv_err_bn_t_icl lv_err_bn_tq_pste_2 lv_err_bn_efp tqi_msr_can vs_can wheel lv_plaus_asr_ctl lv_plaus_esp_ctl tqi_asr_fast_can lv_err_vs_can tqi_asr_fast_req_can tqi_msr_req_can tqi_asr_slow_can tqi_asr_slow_req_can lv_tq_asr_req lv_tq_msr_req brake_prs gear_sel_disp tqi_gs_req_can tq_gear_can tqi_gs_req lv_tq_gs_inc_req lv_tq_gs_dec_req gear_info tq_conv_can state_cc state_etcu_obd n_gb tq_accin_can state_efp_crash_can lv_req_heat lv_ltg_swi_can lv_tam_can_err state_gear_rev_can ftl lv_ftl_can_err n_ecf lv_req_tco_l lv_accin ctr_km_can t_rel_can tam lv_acin lv_ftl_le_can_err lv_ftl_ri_can_err lv_ftl_obd_inh_l ftl_le ftl_ri vel_ang_pste state_sens_ang_pste lv_var_pste ang_pste lv_city tqi_slow_amt_req_can tqi_amt_req tqi_slow_amt_req tqi_amt_req_can tqi_amt_cpl_can tcc_can_amt_1 state_amt_obd_err state_amt state_clu_amt lv_tq_amt_dec_req lv_tq_amt_inc_req n_max_amt_can lv_amt_es lv_gs lv_gp state_amt_obd lv_pump_amt_on lv_var_amt state_txu_cr state_txu_tr state_txu_err state_txu state_txu_mt txu_wal txu_disp_cogs_sum txu_disp_rng_sum txu_disp_gear_sum tqi_txu gear lv_err_bn_tq_etcu lv_err_bn_etcu lv_err_bn_tq_amt lv_err_bn_ars lv_err_bn_tq_dcc lv_err_bn_tq_tcs lv_err_bn_vs_tcs lv_err_bn_tcs lv_err_bn_ang_pste lv_var_bn lv_var_bn_efp lv_var_veh lv_wake_up dist /end OUT_MEASUREMENT
/end FUNCTION
/begin FUNCTION SYS_Oil_temperature "_Oil temperature" /begin DEF_CHARACTERISTIC ip_toil__v_toil c_toil_sub_diag c_toil_grd_max_diag /end DEF_CHARACTERISTIC /begin OUT_MEASUREMENT toil toil_mes toil_stop /end OUT_MEASUREMENT /end FUNCTION
/begin FUNCTION SYS_Ambient_pressure_variables "_Ambient pressure variables"
 /begin DEF_CHARACTERISTIC c_amp_hys ip_amp_raw_cor__vs c_amp_crlc c_fac_amp_min c_fac_amp_max ip_amp_raw_2__v_amp ip_amp_raw_1__v_amp /end DEF_CHARACTERISTIC
 /begin OUT_MEASUREMENT amp_mes fac_amp /end OUT_MEASUREMENT
/end FUNCTION
/begin FUNCTION SYS_System_variables_in_the_exha "_System variables in the exhaust pipe"
 /begin DEF_CHARACTERISTIC ip_ar_red_egr__n_32__stk_av_egr ip_prs_ex_inc ip_teg_egr__maf_cyl /end DEF_CHARACTERISTIC
 /begin OUT_MEASUREMENT prs_ex prs_ex_inc teg_egr ar_red_egr /end OUT_MEASUREMENT
/end FUNCTION
/begin FUNCTION SYS_Reduced_area_controller "_Reduced area controller"
 /begin DEF_CHARACTERISTIC c_ar_red_ad_add_min c_ar_red_ad_fac_max c_ar_red_ad_fac_min c_ar_red_dif_i_rel_min c_crlc_ar_red_dif_i_rel_mmv c_n_ar_red_ad_add_max c_n_ar_red_ad_fac_min c_n_ar_red_ad_fac_max c_pq_ar_red_ad_fac_max c_pq_ar_red_ad_fac_min c_pq_ar_red_ad_add_max c_t_ast_ar_red_ctl_deac ip_ar_red_i_rel_1__n__pq ip_ar_red_i_rel_2__n__pq ip_ar_red_p_rel_2__n__pq ip_t_1_hfm__maf_kgh c_lgrd_ar_red_dif_tra c_crlc_ar_red_ad_add c_crlc_ar_red_ad_fac c_ar_red_dif_i_rel_max c_ar_red_ad_add_max ip_ar_red_p_rel_1__n__pq c_crlc_map_mdl c_n_ar_red_ad_add_min c_n_ar_red_isa_ad_add_min c_n_ar_red_isa_ad_add_max c_ar_red_bas_ad_add_max c_ar_red_bas_isa_ad_add_max c_crlc_ar_red_isa_ad_add c_ar_red_isa_ad_add_min c_ar_red_isa_ad_add_max c_n_ar_red_isa_ad_fac_min c_n_ar_red_isa_ad_fac_max c_pq_ar_red_isa_ad_add_max c_pq_ar_red_isa_ad_fac_min c_pq_ar_red_isa_ad_fac_max c_ar_red_bas_ad_fac_min c_ar_red_bas_ad_fac_max c_crlc_ar_red_isa_ad_fac c_ar_red_isa_bas_ad_min c_ar_red_isa_bas_ad_max c_ar_red_isa_ad_fac_min c_ar_red_isa_ad_fac_max ip_fac_ar_red_cor__pq ip_fac_ar_red_isa_cor__pq ip_crlc_hfm__t_seg_t_1_ratio ip_crlc_ar_red_ad_add_mmv c_ar_red_isa_max lc_ar_red_dif_tra ip_fac_ar_red_dif /end DEF_CHARACTERISTIC
 /begin OUT_MEASUREMENT maf_mdl map_mdl ar_red_dif_i_rel_mmv ar_red_dif_p_rel map_mdl_mv map_mdl_dif maf_mdl_mv maf_mdl_dif ar_red ar_red_dif_i_rel ar_red_dif_rel ar_red_isa_dif_rel ar_red_isa_ad_add ar_red_ad_fac ar_red_isa_ad_fac ar_red_ad_fac_cor ar_red_isa_ad_fac_cor ar_red_ad_add ar_red_ad_add_mmv ar_red_ad_add_dif lv_act_ar_red_ad_add ar_red_isa_dif_i_rel_mmv ar_red_thr_dif_i_rel_mmv ar_red_isa ar_red_isa_max fac_ar_red_dif amp_mdl_dif_i_ini /end OUT_MEASUREMENT
/end FUNCTION
/begin FUNCTION SYS_Ambient_Pressure_Control "_Ambient Pressure Control"
 /begin DEF_CHARACTERISTIC c_crlc_amp_ad c_tco_thd_amp_ad c_amp_ad_pl_hys c_amp_ad_dif_neg c_amp_ad_dif_pos c_amp_dif_ti_lam_pos c_amp_max c_amp_min c_amp_ini c_amp_i_1 c_amp_dif_ti_lam_neg c_amp_mdl_dif_i_min c_amp_p_1 c_amp_p_2 c_crlc_maf_kgh_amp_ad_pl c_crlc_amp_mdl_dif_i_mmv c_map_drv1_max_amp_ad_pl c_n_amp_ad_min c_n_amp_ad_max c_n_min_amp_ad_pl c_pq_amp_ad c_pq_amp_ad_pl c_seg_ctr_amp_ad c_seg_ctr_amp_ad_pl c_t_ast_amp_ctl_deac c_ti_lam_maf_puls_max c_ti_lam_maf_puls_min c_tps_min_amp_ad_pl c_amp_i_2 c_crlc_ar_red_bas_amp_ad_pl c_lgrd_amp_mdl_dif_tra lc_ar_red_ad_ena c_amp_mdl_dif_i_max c_fac_ar_red_dif_i_rel_ini c_amp_ad_cor_clrc /end DEF_CHARACTERISTIC
 /begin OUT_MEASUREMENT amp amp_mdl_dif_i_mmv amp_mdl_dif_i amp_mdl_dif_p amp_estim amp_ad_dif amp_ad ar_red_bas_mmv maf_kgh_mmv seg_ctr_amp_ad_pl amp_mdl_dif amp_mdl ar_red_dif_i_rel_ini /end OUT_MEASUREMENT
/end FUNCTION
/begin FUNCTION SYS_Engine_speed_calculation "_Engine speed calculation" /begin OUT_MEASUREMENT n_32 t_seg_av n_grd n n_tooth /end OUT_MEASUREMENT /end FUNCTION
/begin FUNCTION SYS_Fuel_pressure_acquisition "_Fuel pressure acquisition" /begin DEF_CHARACTERISTIC c_fup_nom /end DEF_CHARACTERISTIC /begin OUT_MEASUREMENT fup /end OUT_MEASUREMENT /end FUNCTION
/begin FUNCTION SYS_Detection_of_Driver_Passive "_Detection of Driver Passive" /begin DEF_CHARACTERISTIC c_fac_tq_req_clu_is_hys ip_fac_tq_req_clu_is__n_32 /end DEF_CHARACTERISTIC /begin OUT_MEASUREMENT lv_ct /end OUT_MEASUREMENT /end FUNCTION
/begin FUNCTION SYS_System_variables_for_and_fro "_System variables for and from CUS" /begin DEF_CHARACTERISTIC GEN_APP_TLR c_maf_ref lc_gen_clu /end DEF_CHARACTERISTIC
 /begin OUT_MEASUREMENT lv_gen_err_plaus lv_gen_err_el lv_gen_err_mec lv_gen_err_temp lv_gen_err_tout state_gen_err state_gen_err_if B_master taml vvt_es vvt_es2 nsllm tq_loss_alter_1 state_alter n_sp_is_pow_1 MDNORM lv_n_sp_is_pow_act B_gfhtak B_ifbsak B_ifebsak B_ibsfprl B_iftempak B_ifuplak B_ifusak B_ifisak B_ifkl15ak B_ifsysak B_slp B_genfprl B_ll B_kl15 B_nmot B_sta B_pwf /end OUT_MEASUREMENT
/end FUNCTION
/begin FUNCTION SYS_ECU_state "_ECU state"
 /begin DEF_CHARACTERISTIC c_t_sync_lock_tooth c_crk_vld_tooth_sync_lock c_t_es_sync_max lc_ebr_det_tooth lc_ebr_det_cam c_t_sync_lock_cam c_cam_plaus_fail_max ip_t_tooth_max__vb_tco /end DEF_CHARACTERISTIC
 /begin OUT_MEASUREMENT fast_ecu_tran_pwl_ctr lv_ebr_det_act lv_ebr_det_cam lv_ebr_det_tooth ctr_ebr_det_cam ctr_cam_plaus_fail ctr_ebr_det_tooth t_ebr_sync_lock t_ebr_tooth_max t_ebr_tooth_per t_ebr_es_sync_max ecu_state /end OUT_MEASUREMENT
/end FUNCTION
/begin FUNCTION SYS_Pressure_Variables "_Pressure Variables" /begin DEF_CHARACTERISTIC ip_map_mes_bas__v_map /end DEF_CHARACTERISTIC /begin OUT_MEASUREMENT v_map map_mes_bas lv_load_ratio_chk /end OUT_MEASUREMENT /end FUNCTION
/begin FUNCTION SYS_Engine_off_duration "_Engine off duration"
 /begin DEF_CHARACTERISTIC c_t_es_tco_plaus_max c_t_es_tco_plaus_min c_tco_stop_t_es_plaus_min c_t_es_sub c_tco_stop_t_es_plaus_max c_tco_stop_t_es_min /end DEF_CHARACTERISTIC
 /begin OUT_MEASUREMENT t_es t_rel_can_es t_rel_can_st lv_t_rel_can_reg lv_t_es_not_plaus /end OUT_MEASUREMENT
/end FUNCTION
/begin FUNCTION SYS_Calculation_of_the_basic_red "_Calculation of the basic reduced area" /begin DEF_CHARACTERISTIC ip_ar_red_thr ip_ar_red_isa /end DEF_CHARACTERISTIC /begin OUT_MEASUREMENT ar_red_bas ar_red_isa_bas /end OUT_MEASUREMENT /end FUNCTION
/begin FUNCTION SYS_Total_running_time "_Total running time" /begin OUT_MEASUREMENT trt /end OUT_MEASUREMENT /end FUNCTION
/begin FUNCTION SYS_Determination_of_Throttle_Po "_Determination of Throttle Position"
 /begin DEF_CHARACTERISTIC c_v_tps_swi_gain_1 c_v_tps_hys_gain_1 c_v_tps_grd_max c_v_tps_gain_grd_max c_tps_slop c_tps_max /end DEF_CHARACTERISTIC
 /begin OUT_MEASUREMENT tps_av_1 tps_av_2 tps_grd tps_seg tps_seg_1 tps_seg_2 tps_seg_gain_1 tps_av_gain_1 v_tps_gain_tol_ena_1 v_tps_gain_bol_ena_1 tps_lih tps_av tps_av_ctl tps_av_ctl_1 tps_av_ctl_2 tps_av_ctl_gain_1 lv_tps_gain_act_1 lv_tps_grd_up /end OUT_MEASUREMENT
/end FUNCTION
/begin FUNCTION _Intake_manifold_model "_Appl. Inc. Intake manifold model" /begin DEF_CHARACTERISTIC ip_fac_maf_kgh_cor c_pq_amp_ctl c_pq_amp_ctl_hys /end DEF_CHARACTERISTIC
 /begin OUT_MEASUREMENT lv_amp_ad_stop lv_amp_ctl_stop lv_ar_red_ad_rst lv_ar_red_ad_stop lv_ar_red_ctl_stop maf_kgh_mes_fac lv_map_ctl lv_amp_ad_rst lv_maf_ctl map_mes state_ctl_insy /end OUT_MEASUREMENT
/end FUNCTION
/begin FUNCTION SYS_ECU_Temperature "_ECU Temperature"
 /begin DEF_CHARACTERISTIC ip_tecu c_tecu_sub c_tecu_thd_1 c_tecu_thd_2 c_tecu_thd_3 c_trt_dif_tecu /end DEF_CHARACTERISTIC
 /begin OUT_MEASUREMENT ctr_stc_tecu_1 ctr_stc_tecu_2 ctr_stc_tecu_3 tecu tecu_mes /end OUT_MEASUREMENT
/end FUNCTION
/begin FUNCTION SYS_Vol_Eff_Cor_due_to_Port_Flap "_Vol Eff Cor due to Port Flap Influences" /end FUNCTION
/begin FUNCTION SYS_Output_signals_of_the_DME_to "_Output signals of the DME to the CAN bus"
 /begin DEF_CHARACTERISTIC c_t_cyc_disp_icl_can c_icl_disp_frq c_toil_gs_max c_tco_chk_ctl_1 c_tco_chk_ctl_2 c_tco_sum_hys_1 c_tco_sum_hys_2 c_tq_max_acc c_cc_mess c_n_32_thd_cc_poil_swi ip_t_dly_poil_swi_can__toil c_n_sp_is_thd_can c_max_msg_miss_asr_can c_tmot_sum_hys c_t_tco_can_ast c_tco_swi_wup c_t_ctr_max_asr_can c_tco_tmot_sta c_fac_mff_fco ip_t_ast_swi_wup__ctr_km_can c_pv_can_diag c_eng_etcu c_crlc_fco_av lc_var_bn2000 lc_var_veh /end DEF_CHARACTERISTIC
 /begin OUT_MEASUREMENT lv_temp_eng_1 lv_temp_eng_2 lv_toil_gs tcc_can_ecu tcc_can_ecu1 tcc_can_ecu2 tcc_can_ecu3 cc_id lv_mil_fll tq_ems_bn tq_maf lv_ack_tcs fco lv_wup_can ctl_shift_lock_can lv_level_is tqi_maf tqi_av_can tqi_ems_can tqi_maf_can lv_crul_ack fco_av_mmv state_lrn_amp /end OUT_MEASUREMENT
/end FUNCTION
/begin FUNCTION SYS__BSW__Wide_Range_Air_Fuel_se "_(BSW) Wide Range Air-Fuel sensor interface"
 /begin OUT_MEASUREMENT state_err_vglsl_2 state_err_vglsl_1 state_err_vnlsl_1 state_err_vnlsl_2 state_err_iplsl_1 state_err_iplsl_2 ctr_err_lsl_if_spi_wr_1 ctr_err_lsl_if_spi_wr_2 lsl_if_spi_rd_1 lsl_if_spi_rd_2 lsl_if_ic_info_1 lsl_if_ic_info_2 lv_lsl_deac_1 lv_lsl_deac_2 /end OUT_MEASUREMENT
/end FUNCTION
/begin FUNCTION SYS__ASW__Wide_Range_Air_Fuel_se "_(ASW) Wide Range Air-Fuel sensor interface"
 /begin OUT_MEASUREMENT lam_bank_1.ls_up_spi.bf.lv_lsl_if_spi_rst_end lam_bank_2.ls_up_spi.bf.lv_lsl_if_spi_rst_end lsl_if_spi_wr_1 lsl_if_spi_wr_1.Bit_0 lsl_if_spi_wr_1.Bit_1 lsl_if_spi_wr_1.Bit_2 lsl_if_spi_wr_1.Bit_3 lsl_if_spi_wr_1.Bit_4 lsl_if_spi_wr_2 lsl_if_spi_wr_2.Bit_0 lsl_if_spi_wr_2.Bit_1 lsl_if_spi_wr_2.Bit_2 lsl_if_spi_wr_2.Bit_3 lsl_if_spi_wr_2.Bit_4 /end OUT_MEASUREMENT
/end FUNCTION
/begin FUNCTION SYS_Oxygen_sensor_ceramic_temper "_Oxygen sensor ceramic temperature"
 /begin DEF_CHARACTERISTIC ip_ttip_ls_up c_t_dly_adj_gain_ttip_ls_up c_t_dly_mes_ofs_ttip_ls_up c_t_dly_adj_ofs_ttip_ls_up c_t_dly_mes_ttip_ls_up c_t_lim_v_temp_ls_up_mes_ofs c_t_lim_v_temp_ls_up_adj_ofs c_t_lim_gain_temp_ls_up c_v_temp_ls_up_mes_ofs_dif c_v_temp_ls_up_adj_ofs_dif c_gain_temp_ls_up_dif lc_v_temp_ls_up_ref /end DEF_CHARACTERISTIC
 /begin OUT_MEASUREMENT lam_bank_1.lsl_temp_up.bf.lv_ttip_ls_up_mes_vld lam_bank_1.lsl_temp_up.bf.lv_v_temp_ls_up_mes_ofs_vld lam_bank_1.lsl_temp_up.bf.lv_v_temp_ls_up_adj_ofs_vld lam_bank_1.lsl_temp_up.bf.lv_gain_temp_ls_up_vld lam_bank_1.lsl_temp_up.bf.lv_v_temp_ls_up_ref_vld lam_bank_1.lsl_temp_up.ttip_ls_up_mes lam_bank_1.lsl_temp_up.r_up_ls lam_bank_1.lsl_temp_up.state_ttip_ls_up lam_bank_1.lsl_temp_up.v_temp_ls_up_mes_ofs lam_bank_1.lsl_temp_up.v_temp_ls_up_adj_ofs lam_bank_1.lsl_temp_up.gain_temp_ls_up lam_bank_1.lsl_temp_up.tcc_v_temp_ls_up_mes_ofs lam_bank_1.lsl_temp_up.tcc_v_temp_ls_up_adj_ofs lam_bank_1.lsl_temp_up.tcc_gain_temp_ls_up lam_bank_1.lsl_temp_up.frc_err_v_temp_ls_up_mes_ofs lam_bank_1.lsl_temp_up.frc_err_v_temp_ls_up_adj_ofs lam_bank_1.lsl_temp_up.frc_err_gain_temp_ls_up lam_bank_2.lsl_temp_up.bf.lv_ttip_ls_up_mes_vld lam_bank_2.lsl_temp_up.bf.lv_v_temp_ls_up_mes_ofs_vld lam_bank_2.lsl_temp_up.bf.lv_v_temp_ls_up_adj_ofs_vld lam_bank_2.lsl_temp_up.bf.lv_gain_temp_ls_up_vld lam_bank_2.lsl_temp_up.bf.lv_v_temp_ls_up_ref_vld lam_bank_2.lsl_temp_up.ttip_ls_up_mes lam_bank_2.lsl_temp_up.r_up_ls lam_bank_2.lsl_temp_up.state_ttip_ls_up lam_bank_2.lsl_temp_up.v_temp_ls_up_mes_ofs lam_bank_2.lsl_temp_up.v_temp_ls_up_adj_ofs lam_bank_2.lsl_temp_up.gain_temp_ls_up lam_bank_2.lsl_temp_up.tcc_v_temp_ls_up_mes_ofs lam_bank_2.lsl_temp_up.tcc_v_temp_ls_up_adj_ofs lam_bank_2.lsl_temp_up.tcc_gain_temp_ls_up lam_bank_2.lsl_temp_up.frc_err_v_temp_ls_up_mes_ofs lam_bank_2.lsl_temp_up.frc_err_v_temp_ls_up_adj_ofs lam_bank_2.lsl_temp_up.frc_err_gain_temp_ls_up /end OUT_MEASUREMENT
/end FUNCTION
/end MODULE
/end PROJECT
