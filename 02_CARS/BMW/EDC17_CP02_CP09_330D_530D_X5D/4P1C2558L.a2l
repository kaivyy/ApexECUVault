ASAP2_VERSION 1 4
/begin PROJECT P_558 "EDC17_CP02"
/begin HEADER "" VERSION "V1C1" PROJECT_NO P_558 /end HEADER
/begin MODULE DIM ""
/begin MOD_COMMON "" BYTE_ORDER MSB_LAST ALIGNMENT_BYTE 1 ALIGNMENT_WORD 2 ALIGNMENT_LONG 4 ALIGNMENT_FLOAT32_IEEE 4 /end MOD_COMMON
/begin CHARACTERISTIC K_CW_OZ "" VALUE 0x80043F66 TKW_VV_VV_UW 100.0 Def_dez_uw_q1 0.0 65535.0000 /end CHARACTERISTIC
/begin CHARACTERISTIC K_OZVERLORI "Schwelle für Orientierungswert Ölniveau (Verlustwarnung)" VALUE 0x80043F96 TKW_VV_VV_UB 100.0 Def_niv_ub_b75 0.0 74.7070 /end CHARACTERISTIC
/begin CHARACTERISTIC KL_OZBEFKL "Befüllkennlinie" CURVE 0x80043FCE TKL_UB_VV_UB 100.0 Def_niv_ub_q0p1 0.0 25.5000 /begin AXIS_DESCR STD_AXIS Oz_nivkrzt Def_niv_ub_b75 6 0.0 74.7070 /end AXIS_DESCR /end CHARACTERISTIC
/begin CHARACTERISTIC K_OZMAXSLOPE "Maximale erlaubte Steigung" VALUE 0x80043F68 TKW_VV_VV_SW 100.0 Def_f_sw_b64 -64.0000 63.9980 FORMAT "%6.3" /end CHARACTERISTIC
/begin CHARACTERISTIC K_OZMINSLOPE "Kleinste erlaubte Steigung (<0)" VALUE 0x80043F6A TKW_VV_VV_SW 100.0 Def_f_sw_b64 -64.0000 63.9980 FORMAT "%6.3" /end CHARACTERISTIC
/begin CHARACTERISTIC K_OZNMOTMAX "obere Drehzahlgrenze für drehzahlkorrigierten Niveaumittelwert" VALUE 0x80043F6C TKW_VV_VV_SW 100.0 Def_n_sw_q1p0 -32768.0000 32767.0000 /end CHARACTERISTIC
/begin CHARACTERISTIC K_OZNMOTMIN "untere Drehzahlgrenze für drehzahlkorrigierten Niveaumittelwert" VALUE 0x80043F6E TKW_VV_VV_SW 100.0 Def_n_sw_q1p0 -32768.0000 32767.0000 /end CHARACTERISTIC
/begin CHARACTERISTIC K_OZTEMPBW "Temperaturschwelle Öltemperatur Motor betriebswarm" VALUE 0x80043F70 TKW_VV_VV_SW 100.0 Def_t_sw_q0p1 -3276.8000 3276.7000 FORMAT "%4.1" /end CHARACTERISTIC
/begin CHARACTERISTIC K_OZTORMIN "Mindest Temperatur für OrientierungMw QLT" VALUE 0x80043F72 TKW_VV_VV_SW 100.0 Def_t_sw_q0p01 -327.6800 327.6700 FORMAT "%5.2" /end CHARACTERISTIC
/begin CHARACTERISTIC K_OZUEFNST "Maximale negative Steigung für die Überfüllungserkenung" VALUE 0x80043F74 TKW_VV_VV_SW 100.0 Def_f_sw_b64 -64.0000 63.9980 FORMAT "%6.3" /end CHARACTERISTIC
/begin CHARACTERISTIC K_OZUEFODZ "Obere Drehzahlgrenze für die Überfüllungserkennung" VALUE 0x80043F76 TKW_VV_VV_SW 100.0 Def_n_sw_q1p0 -32768.0000 32767.0000 /end CHARACTERISTIC
/begin CHARACTERISTIC K_OZUEFPST "Maximale positive Steigung für die Überfüllungserkenung" VALUE 0x80043F78 TKW_VV_VV_SW 100.0 Def_f_sw_b64 -64.0000 63.9980 FORMAT "%6.3" /end CHARACTERISTIC
/begin CHARACTERISTIC K_OZUEFTEM "Mindestöltemperatur für die Überfüllungserkennung" VALUE 0x80043F7A TKW_VV_VV_SW 100.0 Def_t_sw_q0p1 -3276.8000 3276.7000 FORMAT "%4.1" /end CHARACTERISTIC
/begin CHARACTERISTIC K_OZUEFUDZ "Untere Drehzahlgrenze für die Überfüllungserkennung" VALUE 0x80043F7C TKW_VV_VV_SW 100.0 Def_n_sw_q1p0 -32768.0000 32767.0000 /end CHARACTERISTIC
/begin CHARACTERISTIC K_OZVORMV "Korrektur von Vormw für Peilstab" VALUE 0x80043F7E TKW_VV_VV_SW 100.0 Def_f_sw_b32 -32.0000 31.9990 FORMAT "%7.4" /end CHARACTERISTIC
/begin CHARACTERISTIC K_OZABSTELL "Mindestwert für die Übernahme der Abstellzeit" VALUE 0x80043F80 TKW_VV_VV_UW 100.0 Def_tn_uw_q1 0.0 65535.0000 FORMAT "%5.2" /end CHARACTERISTIC
/begin CHARACTERISTIC K_OZALTANZABZ "Abstellzeit für die Ausgabe der letzten Anzeige nach dem Ölcheck" VALUE 0x80043F82 TKW_VV_VV_UW 100.0 Def_tn_uw_q1 0.0 65535.0000 FORMAT "%5.2" /end CHARACTERISTIC
/begin CHARACTERISTIC K_OZLUFTMAX "Plausibel max luftsprung" VALUE 0x80043F84 TKW_VV_VV_UW 100.0 Def_p_uw_q039 0.0 2559.9609 FORMAT "%6.3" /end CHARACTERISTIC
/begin CHARACTERISTIC K_OZMWL "Anzahl der Messwerte für Langzeit-Mittelwert Niveau" VALUE 0x80043F86 TKW_VV_VV_UW 100.0 Def_dez_uw_q1 0.0 65535.0000 /end CHARACTERISTIC
/begin CHARACTERISTIC K_OZMWOR "Anzahl der Messwerte für Orientierungsmessung" VALUE 0x80043F88 TKW_VV_VV_UW 100.0 Def_dez_uw_q1 0.0 65535.0000 /end CHARACTERISTIC
/begin CHARACTERISTIC K_OZMWV "Anzahl der Messwerte für vorgezogenen Mittelwert Niveau" VALUE 0x80043F8A TKW_VV_VV_UW 100.0 Def_dez_uw_q1 0.0 65535.0000 /end CHARACTERISTIC
/begin CHARACTERISTIC K_OZOELCABZ "Minimale Abstellzeit für den ÖlCheck" VALUE 0x80043F8C TKW_VV_VV_UW 100.0 Def_tn_uw_q1 0.0 65535.0000 FORMAT "%5.2" /end CHARACTERISTIC
/begin CHARACTERISTIC K_OZOELVERB "Ölverbrauch" VALUE 0x80043F8E TKW_VV_VV_UW 100.0 Def_dez_uw_q1 0.0 65535.0000 /end CHARACTERISTIC
/begin CHARACTERISTIC K_OZSTARTABZ "Mindestlaufzeit für die Übernahme der Abstellzeit" VALUE 0x80043F90 TKW_VV_VV_UW 100.0 Def_td_uw_q0p01 0.0 655.3500 FORMAT "%5.2" /end CHARACTERISTIC
/begin CHARACTERISTIC K_OZSTMINW "Minimale Strecke für die Steigungserkennung" VALUE 0x80043F92 TKW_VV_VV_UW 100.0 Def_f_uw_b10 0.0 9.9998 FORMAT "%7.4" /end CHARACTERISTIC
/begin CHARACTERISTIC K_OZVERBDKM "Delta km für die Ölverbrauch-Berechnung" VALUE 0x80043F94 TKW_VV_VV_UW 100.0 Def_km_uw_q10 0.0 655350.0000 /end CHARACTERISTIC
/begin CHARACTERISTIC K_OZLBESCHN "Negative Längsbeschleunigung Ausblendung-Schwelle " VALUE 0x80043F97 TKW_VV_VV_SB 100.0 Def_ac_sb_q0p25 -32.0000 31.7500 /end CHARACTERISTIC
/begin CHARACTERISTIC K_OZLBESCHORI "Längsbeschleunigung Ausblendung-Schwelle beim OriMw" VALUE 0x80043F98 TKW_VV_VV_SB 100.0 Def_ac_sb_q0p25 -32.0000 31.7500 /end CHARACTERISTIC
/begin CHARACTERISTIC K_OZLBESCHP "Positive Längsbeschleunigung Ausblendung-Schwelle " VALUE 0x80043F99 TKW_VV_VV_SB 100.0 Def_ac_sb_q0p25 -32.0000 31.7500 /end CHARACTERISTIC
/begin CHARACTERISTIC K_OZLBESCHST "Längsbeschleunigung Ausblendung-Schwelle im Stand" VALUE 0x80043F9A TKW_VV_VV_SB 100.0 Def_ac_sb_q0p25 -32.0000 31.7500 /end CHARACTERISTIC
/begin CHARACTERISTIC K_OZQBESCHN "Negative Querbeschleunigung Ausblendung-Schwelle " VALUE 0x80043F9B TKW_VV_VV_SB 100.0 Def_ac_sb_q0p25 -32.0000 31.7500 /end CHARACTERISTIC
/begin CHARACTERISTIC K_OZQBESCHORI "Querbeschleunigung Ausblendung-Schwelle Beim OriMw" VALUE 0x80043F9C TKW_VV_VV_SB 100.0 Def_ac_sb_q0p25 -32.0000 31.7500 /end CHARACTERISTIC
/begin CHARACTERISTIC K_OZQBESCHP "Positive Querbeschleunigung Ausblendung-Schwelle " VALUE 0x80043F9D TKW_VV_VV_SB 100.0 Def_ac_sb_q0p25 -32.0000 31.7500 /end CHARACTERISTIC
/begin CHARACTERISTIC K_OZQBESCHST "Querbeschleunigung Ausblendung-Schwelle im Stand" VALUE 0x80043F9E TKW_VV_VV_SB 100.0 Def_ac_sb_q0p25 -32.0000 31.7500 /end CHARACTERISTIC
/begin CHARACTERISTIC K_OZUEFNLB "Negative Längsbeschleunigungsgrenze für die Überfüllung" VALUE 0x80043F9F TKW_VV_VV_SB 100.0 Def_ac_sb_q0p25 -32.0000 31.7500 /end CHARACTERISTIC
/begin CHARACTERISTIC K_OZUEFNQB "Negative Querbeschleunigungsgrenze für die Überfüllung" VALUE 0x80043FA0 TKW_VV_VV_SB 100.0 Def_ac_sb_q0p25 -32.0000 31.7500 /end CHARACTERISTIC
/begin CHARACTERISTIC K_OZUEFPLB "Positive Längsbeschleunigungsgrenze für die Überfüllung" VALUE 0x80043FA1 TKW_VV_VV_SB 100.0 Def_ac_sb_q0p25 -32.0000 31.7500 /end CHARACTERISTIC
/begin CHARACTERISTIC K_OZUEFPQB "Positive Querbeschleunigungsgrenze für die Überfüllung" VALUE 0x80043FA2 TKW_VV_VV_SB 100.0 Def_ac_sb_q0p25 -32.0000 31.7500 /end CHARACTERISTIC
/begin CHARACTERISTIC K_NACHFUELL12 "Nachfüll Erste Balken von Peistab" VALUE 0x80043FA3 TKW_VV_VV_UB 100.0 Def_dez_ub_q1 0.0 255.0000 /end CHARACTERISTIC
/begin CHARACTERISTIC K_NACHFUELL25 "Nachfüll Zweite Balken von Peistab" VALUE 0x80043FA4 TKW_VV_VV_UB 100.0 Def_dez_ub_q1 0.0 255.0000 /end CHARACTERISTIC
/begin CHARACTERISTIC K_NACHFUELL38 "Nachfüll Dritte Balken von Peistab" VALUE 0x80043FA5 TKW_VV_VV_UB 100.0 Def_dez_ub_q1 0.0 255.0000 /end CHARACTERISTIC
/begin CHARACTERISTIC K_NACHFUELL53 "Nachfüll Vierte Balken von Peistab" VALUE 0x80043FA6 TKW_VV_VV_UB 100.0 Def_dez_ub_q1 0.0 255.0000 /end CHARACTERISTIC
/begin CHARACTERISTIC K_NACHFUELL69 "Nachfüll Fünfte Balken von Peistab" VALUE 0x80043FA7 TKW_VV_VV_UB 100.0 Def_dez_ub_q1 0.0 255.0000 /end CHARACTERISTIC
/begin CHARACTERISTIC K_NACHFUELL85 "Nachfüll Sechte Balken von Peistab" VALUE 0x80043FA8 TKW_VV_VV_UB 100.0 Def_dez_ub_q1 0.0 255.0000 /end CHARACTERISTIC
/begin CHARACTERISTIC K_NACHFUELL95 "Nachfüll Siebte Balken von Peistab" VALUE 0x80043FA9 TKW_VV_VV_UB 100.0 Def_dez_ub_q1 0.0 255.0000 /end CHARACTERISTIC
/begin CHARACTERISTIC K_OZBESCHAUS "Zahl Ausgeblendet bei Lengsbescheunigung" VALUE 0x80043FAA TKW_VV_VV_UB 100.0 Def_dez_ub_q1 0.0 255.0000 /end CHARACTERISTIC
/begin CHARACTERISTIC K_OZDKNIVN "Ersatzwert für die Drehzahlkorrektur bei Oz_peilaltanz = 0" VALUE 0x80043FAB TKW_VV_VV_UB 100.0 Def_niv_ub_b75 0.0 74.7070 /end CHARACTERISTIC
/begin CHARACTERISTIC K_OZMWK "Anzahl der Messwerte für Kurzzeit-Mittelwert Niveau" VALUE 0x80043FAC TKW_VV_VV_UB 100.0 Def_dez_ub_q1 0.0 255.0000 /end CHARACTERISTIC
/begin CHARACTERISTIC K_OZNFERR "Nachfüllmengenanzeige bei PreCheck OK" VALUE 0x80043FAD TKW_VV_VV_UB 100.0 Def_dez_ub_q1 0.0 255.0000 /end CHARACTERISTIC
/begin CHARACTERISTIC K_OZNFML "Nachfüllmengenanzeige bei " VALUE 0x80043FAE TKW_VV_VV_UB 100.0 Def_dez_ub_q1 0.0 255.0000 /end CHARACTERISTIC
/begin CHARACTERISTIC K_OZNFOELCKO "Nachfüllmengenanzeige bei PreCheck KO" VALUE 0x80043FAF TKW_VV_VV_UB 100.0 Def_dez_ub_q1 0.0 255.0000 /end CHARACTERISTIC
/begin CHARACTERISTIC K_OZNFOELCOK "Nachfüllmengenanzeige bei PreCheck OK" VALUE 0x80043FB0 TKW_VV_VV_UB 100.0 Def_dez_ub_q1 0.0 255.0000 /end CHARACTERISTIC
/begin CHARACTERISTIC K_OZOELCOK "PreDriveCheck-Schwelle" VALUE 0x80043FB1 TKW_VV_VV_UB 100.0 Def_niv_ub_b75 0.0 74.7070 /end CHARACTERISTIC
/begin CHARACTERISTIC K_OZOELCVERZ "Verzögerung für den Ölcheck" VALUE 0x80043FB2 TKW_VV_VV_UB 100.0 Def_dez_ub_q1 0.0 255.0000 /end CHARACTERISTIC
/begin CHARACTERISTIC K_OZORIPEILTZO "Ausgabeniveau für die tote Zone Orientierung-Check Peilstab mit alter Anzeige >= Mitte" VALUE 0x80043FB3 TKW_VV_VV_UB 100.0 Def_niv_ub_b75 0.0 74.7070 /end CHARACTERISTIC
/begin CHARACTERISTIC K_OZORIPEILTZU "Ausgabeniveau für die tote Zone Orientierung-Check Peilstab mit alter Anzeige < Mitte" VALUE 0x80043FB4 TKW_VV_VV_UB 100.0 Def_niv_ub_b75 0.0 74.7070 /end CHARACTERISTIC
/begin CHARACTERISTIC K_OZPEIL12 "Erste Balken von Peistab" VALUE 0x80043FB5 TKW_VV_VV_UB 100.0 Def_niv_ub_b75 0.0 74.7070 /end CHARACTERISTIC
/begin CHARACTERISTIC K_OZPEIL25 "Zweite Balken von Peistab" VALUE 0x80043FB6 TKW_VV_VV_UB 100.0 Def_niv_ub_b75 0.0 74.7070 /end CHARACTERISTIC
/begin CHARACTERISTIC K_OZPEIL38 "Dritte Balken von Peistab" VALUE 0x80043FB7 TKW_VV_VV_UB 100.0 Def_niv_ub_b75 0.0 74.7070 /end CHARACTERISTIC
/begin CHARACTERISTIC K_OZPEIL53 "Vierte Balken von Peistab" VALUE 0x80043FB8 TKW_VV_VV_UB 100.0 Def_niv_ub_b75 0.0 74.7070 /end CHARACTERISTIC
/begin CHARACTERISTIC K_OZPEIL69 "Fünfte Balken von Peistab" VALUE 0x80043FB9 TKW_VV_VV_UB 100.0 Def_niv_ub_b75 0.0 74.7070 /end CHARACTERISTIC
/begin CHARACTERISTIC K_OZPEIL85 "Sechte Balken von Peistab" VALUE 0x80043FBA TKW_VV_VV_UB 100.0 Def_niv_ub_b75 0.0 74.7070 /end CHARACTERISTIC
/begin CHARACTERISTIC K_OZPEILDO "Delta + Hysterese Peilstab" VALUE 0x80043FBB TKW_VV_VV_UB 100.0 Def_niv_ub_b75 0.0 74.7070 /end CHARACTERISTIC
/begin CHARACTERISTIC K_OZPEILDOMIN "Delta + Hysterese Peilstab bei Min" VALUE 0x80043FBC TKW_VV_VV_UB 100.0 Def_niv_ub_b75 0.0 74.7070 /end CHARACTERISTIC
/begin CHARACTERISTIC K_OZPEILDU "Delta - Hysterese Peilstab" VALUE 0x80043FBD TKW_VV_VV_UB 100.0 Def_niv_ub_b75 0.0 74.7070 /end CHARACTERISTIC
/begin CHARACTERISTIC K_OZPEILDU38 "Delta - Hysterese Peilstab bei 1/4" VALUE 0x80043FBE TKW_VV_VV_UB 100.0 Def_niv_ub_b75 0.0 74.7070 /end CHARACTERISTIC
/begin CHARACTERISTIC K_OZPEILERR "Balkenanzeige im Fehlerfall" VALUE 0x80043FBF TKW_VV_VV_UB 100.0 Def_dez_ub_q1 0.0 255.0000 /end CHARACTERISTIC
/begin CHARACTERISTIC K_OZPEILKSPR "Max zulässiger Niveau-Unterschied zwischen alten Anzeige und VorMw" VALUE 0x80043FC0 TKW_VV_VV_UB 100.0 Def_niv_ub_b75 0.0 74.7070 /end CHARACTERISTIC
/begin CHARACTERISTIC K_OZPEILLP85 "Bankenanzeige für Niveau bei 85%" VALUE 0x80043FC1 TKW_VV_VV_UB 100.0 Def_dez_ub_q1 0.0 255.0000 /end CHARACTERISTIC
/begin CHARACTERISTIC K_OZPEILML "Balkenanzeige bei Messung läuft" VALUE 0x80043FC2 TKW_VV_VV_UB 100.0 Def_dez_ub_q1 0.0 255.0000 /end CHARACTERISTIC
/begin CHARACTERISTIC K_OZPEILOELCKO "Balkenanzeige bei ÖlCheck KO" VALUE 0x80043FC3 TKW_VV_VV_UB 100.0 Def_dez_ub_q1 0.0 255.0000 /end CHARACTERISTIC
/begin CHARACTERISTIC K_OZPEILOELCOK "Balkenanzeige bei ÖlCheck OK" VALUE 0x80043FC4 TKW_VV_VV_UB 100.0 Def_dez_ub_q1 0.0 255.0000 /end CHARACTERISTIC
/begin CHARACTERISTIC K_OZPEILSPRUNG "Max zulässiger Niveau-Unterschied zwischen LangMw" VALUE 0x80043FC5 TKW_VV_VV_UB 100.0 Def_niv_ub_b75 0.0 74.7070 /end CHARACTERISTIC
/begin CHARACTERISTIC K_OZSTANDVERZ "Verzögerung für Fahrzeug steht" VALUE 0x80043FC6 TKW_VV_VV_UB 100.0 Def_dez_ub_q1 0.0 255.0000 /end CHARACTERISTIC
/begin CHARACTERISTIC K_OZSTARTVERZ "QLT Start Verzögerung nach Drehzal" VALUE 0x80043FC7 TKW_VV_VV_UB 100.0 Def_dez_ub_q1 0.0 255.0000 /end CHARACTERISTIC
/begin CHARACTERISTIC K_OZUEBERF "Schwelle für die Überfüllung" VALUE 0x80043FC8 TKW_VV_VV_UB 100.0 Def_niv_ub_b75 0.0 74.7070 /end CHARACTERISTIC
/begin CHARACTERISTIC K_OZUEFCNT "Anzahl Werte für Überfüllung" VALUE 0x80043FC9 TKW_VV_VV_UB 100.0 Def_dez_ub_q1 0.0 255.0000 /end CHARACTERISTIC
/begin CHARACTERISTIC K_OZUEFVERZ "Verzögerung für erkennung Überfüllung" VALUE 0x80043FCA TKW_VV_VV_UB 100.0 Def_dez_ub_q1 0.0 255.0000 /end CHARACTERISTIC
/begin CHARACTERISTIC K_OZVERBFAK "Faktor für die Anpassung des Ölverbrauches" VALUE 0x80043FCB TKW_VV_VV_UB 100.0 Def_f_ub_b8 0.0 7.9687 /end CHARACTERISTIC
/begin CHARACTERISTIC K_OZVERZERRBSD "Verzögerung für Peilstab-Fehlerfall beim BSD-Fehler" VALUE 0x80043FCC TKW_VV_VV_UB 100.0 Def_dez_ub_q1 0.0 255.0000 /end CHARACTERISTIC
/begin CHARACTERISTIC K_OZVORPEILMIN "Niveau Ausgabe (für die Peilstabanzeige) bei VorMw auf min und LangMw über 1/4" VALUE 0x80043FCD TKW_VV_VV_UB 100.0 Def_niv_ub_b75 0.0 74.7070 /end CHARACTERISTIC
/begin CHARACTERISTIC KL_OZLN "y = ln x" CURVE 0x80043FDC TKL_UW_VV_SW 100.0 Def_f_sw_b1 -1.0000 9.99969482421875e-1 /begin AXIS_DESCR STD_AXIS Oz_pzdivp Def_f_uw_b2 6 0.0 1.9999 /end AXIS_DESCR /end CHARACTERISTIC
/begin CHARACTERISTIC KL_OZKRZMW2 "Anzahl 10er Pakete für Steigungsberechnung in Abhängigkeit von der gefahrenen Strecke" CURVE 0x80043FF6 TKL_UW_VV_UB 100.0 Def_dez_ub_q1 0.0 255.0000 /begin AXIS_DESCR STD_AXIS Oz_dkm Def_f_uw_b10 4 0.0 9.9998 FORMAT "%7.4" /end AXIS_DESCR /end CHARACTERISTIC
/begin CHARACTERISTIC KL_OZORBERO "Toleranz für Orientierungsmessung nach oben in mm" CURVE 0x80044004 TKL_UB_VV_UB 100.0 Def_niv_ub_b75 0.0 74.7070 /begin AXIS_DESCR STD_AXIS Oz_peillang Def_niv_ub_b75 6 0.0 74.7070 /end AXIS_DESCR /end CHARACTERISTIC
/begin CHARACTERISTIC KL_OZLBNIV "Korrektur der Längbeschleunigungseffekte beim 10er Paket QLT" CURVE 0x80044012 TKL_SB_VV_SB 100.0 Def_niv_sb_b37p5 -37.5000 37.2070 /begin AXIS_DESCR STD_AXIS Oz_lbmw Def_f_sb_b2 8 -2.0000 1.9843 /end AXIS_DESCR /end CHARACTERISTIC
/begin CHARACTERISTIC KL_OZNFDELTA "Delta für die Nachfüllerkennung" CURVE 0x80044024 TKL_UB_VV_UB 100.0 Def_niv_ub_b75 0.0 74.7070 /begin AXIS_DESCR STD_AXIS Oz_peillang Def_niv_ub_b75 6 0.0 74.7070 /end AXIS_DESCR /end CHARACTERISTIC
/begin CHARACTERISTIC KL_OZQBNIV "Korrektur der Querbeschleunigungseffekte beim 10er Paket QLT" CURVE 0x80044032 TKL_SB_VV_SB 100.0 Def_niv_sb_b37p5 -37.5000 37.2070 /begin AXIS_DESCR STD_AXIS Oz_qbmw Def_f_sb_b2 8 -2.0000 1.9843 /end AXIS_DESCR /end CHARACTERISTIC
/begin CHARACTERISTIC KL_OZSTNIV "Korrektur der Steigungseffekte beim 20er Paket QLT" CURVE 0x80044044 TKL_SW_VV_SW 100.0 Def_niv_sw_q0p293 -37.5000 37.5000
 /begin AXIS_DESCR STD_AXIS Oz_steigung Def_f_sw_b64 8 -64.0000 63.9980 FORMAT "%6.3" /end AXIS_DESCR
 FORMAT "%5.2" /end CHARACTERISTIC
/begin CHARACTERISTIC KF_OZKORRORI "Kennfeld für die Korrektur des OriMw mit Abstellzeit und Öltemperatur" MAP 0x80044066 TKF_UW_SW_SW 100.0 Def_niv_sw_b37p5 -37.5000 37.2070
 /begin AXIS_DESCR STD_AXIS Toel Def_t_sw_q0p1 4 -3276.8000 3276.7000 FORMAT "%4.1" /end AXIS_DESCR
 /begin AXIS_DESCR STD_AXIS Tn_abstellm Def_tn_uw_q1 3 0.0 65535.0000 FORMAT "%5.2" /end AXIS_DESCR
 FORMAT "%5.2" /end CHARACTERISTIC
/begin CHARACTERISTIC KF_OZDREHKOR "Drehzahlkorrektur Niveau" MAP 0x8004408E TKF_UW_SW_SW 100.0 Def_niv_sw_q0p146 -37.5000 37.5000 /begin AXIS_DESCR STD_AXIS N_ozmw Def_n_sw_q1p0 16 -32768.0000 32767.0000 /end AXIS_DESCR
 /begin AXIS_DESCR STD_AXIS NO_INPUT_QUANTITY Def_niv_uw_q0p293 3 0.0 19199.7070 FORMAT "%5.2" /end AXIS_DESCR
 FORMAT "%5.2" /end CHARACTERISTIC
/begin CHARACTERISTIC KF_OZKORRNIV "Niveaukorrektur nach Startzeit und Temperatur" MAP 0x80044116 TKF_UW_SW_SW 100.0 Def_niv_sw_q0p293 -37.5000 37.5000
 /begin AXIS_DESCR STD_AXIS Oz_tempf Def_t_sw_q0p1 6 -3276.8000 3276.7000 FORMAT "%4.1" /end AXIS_DESCR
 /begin AXIS_DESCR STD_AXIS Oz_nivzeit Def_td_uw_q0p01 4 0.0 655.3500 FORMAT "%5.2" /end AXIS_DESCR
 FORMAT "%5.2" /end CHARACTERISTIC
/begin CHARACTERISTIC KF_OZZEIT "Zusammenführüng Abstellzeit und Startzeit" MAP 0x8004415C TKF_UW_UW_UW 100.0 Def_td_uw_q0p01 0.0 655.3500
 /begin AXIS_DESCR STD_AXIS Tn_start_10 Def_td_uw_q0p01 6 0.0 655.3500 FORMAT "%5.2" /end AXIS_DESCR
 /begin AXIS_DESCR STD_AXIS Oz_abstellm Def_tn_uw_q1 4 0.0 65535.0000 FORMAT "%5.2" /end AXIS_DESCR
 FORMAT "%5.2" /end CHARACTERISTIC
/begin CHARACTERISTIC K_OZPERMNK3 "Drehzahlschwelle für Er-Ausblendung" VALUE 0x800441A2 TKW_VV_VV_SW 100.0 Def_n_sw_q1p0 -32768.0000 32767.0000 /end CHARACTERISTIC
/begin CHARACTERISTIC K_OZPERMTK12 "Untere Temperaturgrenze Messfenster Permittivität" VALUE 0x800441A4 TKW_VV_VV_SW 100.0 Def_t_sw_q0p1 -3276.8000 3276.7000 FORMAT "%4.1" /end CHARACTERISTIC
/begin CHARACTERISTIC K_OZPERMTK13 "Obere Temperaturgrenze Messfenster Permittivität" VALUE 0x800441A6 TKW_VV_VV_SW 100.0 Def_t_sw_q0p1 -3276.8000 3276.7000 FORMAT "%4.1" /end CHARACTERISTIC
/begin CHARACTERISTIC K_OZPERMTK7 "Ausheiztemperatur" VALUE 0x800441A8 TKW_VV_VV_SW 100.0 Def_t_sw_q0p1 -3276.8000 3276.7000 FORMAT "%4.1" /end CHARACTERISTIC
/begin CHARACTERISTIC K_OZOELKMPL "gefahrene Strecke nach Ölwechsel, ab wo Er-Auswertung erfolgt" VALUE 0x800441AA TKW_VV_VV_UW 100.0 Def_km_uw_q10 0.0 655350.0000 /end CHARACTERISTIC
/begin CHARACTERISTIC K_OZPERMCOK5 "minimale Anzahl der Messwerte für einen gültigen Permittivitätswert" VALUE 0x800441AC TKW_VV_VV_UW 100.0 Def_dez_uw_q1 0.0 65535.0000 /end CHARACTERISTIC
/begin CHARACTERISTIC K_OZPERMMIN "minimaler Permittivitätswert für gültige Auswertung" VALUE 0x800441AE TKW_VV_VV_UW 100.0 Def_perm_uw_b6 0.0 5.9999 /end CHARACTERISTIC
/begin CHARACTERISTIC K_OZPERMTIK6 "Mittelungszeitraum Permittivität" VALUE 0x800441B0 TKW_VV_VV_UW 100.0 Def_td_uw_q1 0.0 65535.0000 /end CHARACTERISTIC
/begin CHARACTERISTIC K_OZPERMTIK8 "Ausheizzeit" VALUE 0x800441B2 TKW_VV_VV_UW 100.0 Def_td_uw_q1 0.0 65535.0000 /end CHARACTERISTIC
/begin CHARACTERISTIC K_OZPERMTIK9 "maximale Zeit nach B_ozpermpl = true, Neustart und oztempf < OZPERMTI in der eine gültige Messung erfolgen kann (Kaltzeitschwelle)" VALUE 0x800441B4 TKW_VV_VV_UW 100.0 Def_td_uw_q1 0.0 65535.0000 /end CHARACTERISTIC
/begin CHARACTERISTIC K_OZPERMTK4 "Abklingzeit Drehzahlschwelle" VALUE 0x800441B6 TKW_VV_VV_UW 100.0 Def_td_uw_q1 0.0 65535.0000 /end CHARACTERISTIC
/begin CHARACTERISTIC K_OZPERMMNIV "Niveauschwelle für gültige Permittivitätsauswertung" VALUE 0x800441B8 TKW_VV_VV_UB 100.0 Def_niv_ub_b75 0.0 74.7070 /end CHARACTERISTIC
/begin CHARACTERISTIC K_OZZEITFAKT "Bereich der gesamten Laufstrecke wo die Berechnung des Zeit-RW Beainfluss hat" VALUE 0x800441B9 TKW_VV_VV_UB 100.0 Def_f_ub_b1 0.0 0.9960 /end CHARACTERISTIC
/begin CHARACTERISTIC K_OZUEBERTEMP "Schwelle für die Ölsübertemperatur-Kontrolle" VALUE 0x800441C4 TKW_VV_VV_SW 100.0 Def_t_sw_q0p1 -3276.8000 3276.7000 FORMAT "%4.1" /end CHARACTERISTIC
/begin CHARACTERISTIC K_OZANFANZ "BOS-Startanzeigewert Restlaufstrecke" VALUE 0x800441C6 TKW_VV_VV_UW 100.0 Def_km_uw_q10 0.0 655350.0000 /end CHARACTERISTIC
/begin CHARACTERISTIC K_OZKMMAXK11 "Maximalintervall" VALUE 0x800441C8 TKW_VV_VV_UW 100.0 Def_km_uw_q10 0.0 655350.0000 /end CHARACTERISTIC
/begin CHARACTERISTIC K_OZKVBMXK18 "maximal zulässige Gesamtkraftstoffbonusmenge" VALUE 0x800441CA TKW_VV_VV_UW 100.0 Def_dez_uw_q1 0.0 65535.0000 /end CHARACTERISTIC
/begin CHARACTERISTIC K_OZKVBOK16 "Kraftstoffbonusmenge in [l] je 0,5l Ölnachfüllung" VALUE 0x800441CC TKW_VV_VV_UW 100.0 Def_dez_uw_q1 0.0 65535.0000 /end CHARACTERISTIC
/begin CHARACTERISTIC K_OZMNKMBO "Wegstrecke ab der eine Bonuszuteilung erfolgt" VALUE 0x800441CE TKW_VV_VV_UW 100.0 Def_km_uw_q10 0.0 655350.0000 /end CHARACTERISTIC
/begin CHARACTERISTIC K_OZMXOHK15 "Max Tage für den Ölservice" VALUE 0x800441D0 TKW_VV_VV_UW 100.0 Def_dez_uw_q1 0.0 65535.0000 /end CHARACTERISTIC
/begin CHARACTERISTIC K_OZPERBOK17 "Er-Bonusbetrag je 0,5l Ölnachfüllung" VALUE 0x800441D2 TKW_VV_VV_UW 100.0 Def_perm_uw_b6 0.0 5.9999 /end CHARACTERISTIC
/begin CHARACTERISTIC K_OZPERXK10 "zulässige Permittivitätsänderung im Ölwechselintervall" VALUE 0x800441D4 TKW_VV_VV_UW 100.0 Def_perm_uw_b6 0.0 5.9999 /end CHARACTERISTIC
/begin CHARACTERISTIC K_OZTAGCTERR "Wert für unplausibel Tagezähler" VALUE 0x800441D6 TKW_VV_VV_UW 100.0 Def_dez_uw_q1 0.0 65535.0000 /end CHARACTERISTIC
/begin CHARACTERISTIC K_OZDAEMPF "" VALUE 0x800441BA TKW_VV_VV_UB 100.0 Def_f_ub_b0p25 0.0 0.2490 /end CHARACTERISTIC
/begin CHARACTERISTIC K_OZKVB96 "Typprüfkraftstoffverbrauch" VALUE 0x800441BB TKW_VV_VV_UB 100.0 Def_f_ub_b32 0.0 31.8750 /end CHARACTERISTIC
/begin CHARACTERISTIC K_OZKVB96A "Typprüfkraftstoffverbrauch Automatikgetriebe" VALUE 0x800441BC TKW_VV_VV_UB 100.0 Def_f_ub_b32 0.0 31.8750 /end CHARACTERISTIC
/begin CHARACTERISTIC K_OZLF1 "Länderfaktor 1 Festwert" VALUE 0x800441BD TKW_VV_VV_UB 100.0 Def_lf_ub_q0p01 0.0 2.5500 /end CHARACTERISTIC
/begin CHARACTERISTIC K_OZLF2 "Länderfaktor 2 Festwert" VALUE 0x800441BE TKW_VV_VV_UB 100.0 Def_lf_ub_q0p01 0.0 2.5500 /end CHARACTERISTIC
/begin CHARACTERISTIC K_OZOELMEN "Ölmenge für den Dieseleintrag" VALUE 0x800441BF TKW_VV_VV_UB 100.0 Def_niv_ub_q0p1 0.0 25.5000 /end CHARACTERISTIC
/begin CHARACTERISTIC K_OZPERBRK14 "Begrenzungsfaktor für Restweg aus der Permittivität" VALUE 0x800441C0 TKW_VV_VV_UB 100.0 Def_kw_ub_q0p0234 0.0 5.9765 /end CHARACTERISTIC
/begin CHARACTERISTIC K_OZUTFAK "Faktor für den Kraftstoffverbrauch bei Übertemperatur" VALUE 0x800441C1 TKW_VV_VV_UB 100.0 Def_dez_ub_q1 0.0 255.0000 /end CHARACTERISTIC
/begin CHARACTERISTIC K_OZZEITINT "Zeitintervall für Ölwechsel in Monate (CBS4)" VALUE 0x800441C2 TKW_VV_VV_UB 100.0 Def_dez_ub_q1 0.0 255.0000 /end CHARACTERISTIC
/begin CHARACTERISTIC KL_OZVERDFAK "Verdünnungsfaktor von Dieseleintrag" CURVE 0x800441D8 TKL_UW_VV_UW 100.0 Def_f_uw_b1 0.0 9.99984741210938e-1 /begin AXIS_DESCR STD_AXIS NO_INPUT_QUANTITY Def_f_uw_b1 5 0.0 0.9999 /end AXIS_DESCR /end CHARACTERISTIC
/begin CHARACTERISTIC K_OZTLPF "Faktor für den LowPass-Filter Öltemperatur" VALUE 0x800441EE TKW_VV_VV_UW 100.0 Def_f_uw_b100 0.0 99.9984 FORMAT "%6.3" /end CHARACTERISTIC
/begin CHARACTERISTIC K_OZTLPFMDL "Faktor für den LowPass-Filter Öltemperatur beim Modelltemperatur" VALUE 0x800441F0 TKW_VV_VV_UW 100.0 Def_f_uw_b100 0.0 99.9984 FORMAT "%6.3" /end CHARACTERISTIC
/begin CHARACTERISTIC KF_OZTEMPMDL "Öl-Modelltemperatur" MAP 0x800441F2 TKF_SW_SW_SW 100.0 Def_t_sw_q0p1 -3276.8000 3276.7000
 /begin AXIS_DESCR STD_AXIS Tmot Def_t_sw_q0p01 4 -327.6800 327.6700 FORMAT "%5.2" /end AXIS_DESCR
 /begin AXIS_DESCR STD_AXIS Nkw Def_n_sw_q1p0 4 -32768.0000 32767.0000 /end AXIS_DESCR
 FORMAT "%4.1" /end CHARACTERISTIC
/begin CHARACTERISTIC K_LLWDNMAX "Obere Schwelle Drehzahlabweichung im Leerlauf für Erkennung Generatorlastschwankung" VALUE 0x80044224 TKW_VV_VV_SW 100.0 Def_n_sw_q1p0 -32768.0000 32767.0000 /end CHARACTERISTIC
/begin CHARACTERISTIC K_LLWDNMIN "Untere Schwelle Drehzahlabweichung im Leerlauf für Erkennung Generatorlastschwankung" VALUE 0x80044226 TKW_VV_VV_SW 100.0 Def_n_sw_q1p0 -32768.0000 32767.0000 /end CHARACTERISTIC
/begin CHARACTERISTIC K_NMOTLLANH "Motordrehzahlschwelle für Rücksetzen der Leerlaufanhebung Generatorlast" VALUE 0x80044228 TKW_VV_VV_SW 100.0 Def_n_sw_q1p0 -32768.0000 32767.0000 /end CHARACTERISTIC
/begin CHARACTERISTIC K_NSTATLLANH "Schwelle Leerlaufsolldrehzahl zum Aktivieren der Leerlaufanhebung Generatorlast" VALUE 0x8004422A TKW_VV_VV_SW 100.0 Def_n_sw_q1p0 -32768.0000 32767.0000 /end CHARACTERISTIC
/begin CHARACTERISTIC K_PWGLLANH "Fahrpedalwinkel-Schwelle für Rücksetzen der Leerlaufanhebung Generatorlast" VALUE 0x8004422C TKW_VV_VV_SW 100.0 Def_wdk_sw_q0p0244 -800.0000 799.9755 FORMAT "%5.2" /end CHARACTERISTIC
/begin CHARACTERISTIC K_TMOTLLANH "Motortemperatur-Schwelle zum Aktivieren der Leerlaufanhebung Generatorlast" VALUE 0x8004422E TKW_VV_VV_SW 100.0 Def_t_sw_q0p01 -327.6800 327.6700 FORMAT "%5.2" /end CHARACTERISTIC
/begin CHARACTERISTIC K_GELIVMAX "Maximale Fahrzeuggeschwindigkeit für Generatorlastbegrenzung" VALUE 0x80044230 TKW_VV_VV_UW 100.0 Def_v_uw_q0p1 0.0 6553.5000 FORMAT "%5.2" /end CHARACTERISTIC
/begin CHARACTERISTIC K_TDFDTMAX "Zeitschwelle zum Erkennen Drehzahlabweichung durch Generatorlastschwankung" VALUE 0x80044232 TKW_VV_VV_UW 100.0 Def_td_uw_q0p2 0.0 13107.0000 FORMAT "%4.1" /end CHARACTERISTIC
/begin CHARACTERISTIC K_TDFFABLF "Zeitschwelle (Tdffgen) zum Rücksetzen der Leerlaufanhebung" VALUE 0x80044234 TKW_VV_VV_UW 100.0 Def_td_uw_q0p2 0.0 13107.0000 FORMAT "%4.1" /end CHARACTERISTIC
/begin CHARACTERISTIC K_TDFFMAX "Maximale Periodendauer Generatorlastschwankungen  für Leerlaufstabilisierung" VALUE 0x80044236 TKW_VV_VV_UW 100.0 Def_td_uw_q0p2 0.0 13107.0000 FORMAT "%4.1" /end CHARACTERISTIC
/begin CHARACTERISTIC K_TDFFMIN "Minimale Periodendauer Generatorlastschwankungen für Leerlaufstabilisierung" VALUE 0x80044238 TKW_VV_VV_UW 100.0 Def_td_uw_q0p2 0.0 13107.0000 FORMAT "%4.1" /end CHARACTERISTIC
/begin CHARACTERISTIC K_TNSTLLANH "Zeitschwelle nach Startende zum Aktivieren der Leerlaufanhebung Generatorlast" VALUE 0x8004423A TKW_VV_VV_UW 100.0 Def_td_uw_q0p01 0.0 655.3500 FORMAT "%5.2" /end CHARACTERISTIC
/begin CHARACTERISTIC K_VFZGGENFIL "Filterkonstante Filterung V" VALUE 0x8004423C TKW_VV_VV_UW 100.0 Def_f_uw_b1 1.52587890625e-5 9.99984741210938e-1 /end CHARACTERISTIC
/begin CHARACTERISTIC K_VFZGLLANH "Fahrgeschwindigkeits-Schwelle ¨ fur R¨ ucksetzen der Leerlaufanhebung Generatorlast" VALUE 0x8004423E TKW_VV_VV_UW 100.0 Def_v_uw_q1p0 0.0 65535.0000 /end CHARACTERISTIC
/begin CHARACTERISTIC K_DELTADFFMX "Gradientenschwelle des Generator-Lastsignals für Leerlauf-Solldrehzahlanhebung" VALUE 0x80044240 TKW_VV_VV_SB 100.0 Def_f_sb_b64 -64.0000 63.5000 /end CHARACTERISTIC
/begin CHARACTERISTIC K_DFFLIM "Schwelle für Generatorlast zum Rücksetzen der Leerlauf-Solldrehzahlanhebung" VALUE 0x80044241 TKW_VV_VV_UB 100.0 Def_f_ub_b100 0.0 99.6093 /end CHARACTERISTIC
/begin CHARACTERISTIC K_DFFLLANH "Schwelle für Generatorlast zum Aktivieren der Leerlauf-Solldrehzahlanhebung" VALUE 0x80044242 TKW_VV_VV_UB 100.0 Def_f_ub_b100 0.0 99.6093 /end CHARACTERISTIC
/begin CHARACTERISTIC K_DFFSCHZMX "Zählerschwelle für Aktivieren der Leerlauf-Solldrehzahlanhebung bei Generatorlastschw." VALUE 0x80044243 TKW_VV_VV_UB 100.0 Def_dez_ub_q1 0.0 255.0000 /end CHARACTERISTIC
/begin CHARACTERISTIC K_GELIIEAPP "Applikationswert Generatorlastbegrenzung für Leerlaufsolldrehzahlberechnung" VALUE 0x80044244 TKW_VV_VV_UB 100.0 Def_i_ub_q0p125 0.0 31.8750 /end CHARACTERISTIC
/begin CHARACTERISTIC K_GELIIEZK "Zeitkonstante für Filterung Generatorlastsignal (Leerlaufsolldrehzahlberechnung)" VALUE 0x80044245 TKW_VV_VV_UB 100.0 Def_f_ub_b1 0.0 0.9960 /end CHARACTERISTIC
/begin CHARACTERISTIC K_GELISETAPP "Aoolikationswert Generatorlastbegrenzung für Leerlaufstabilisierung" VALUE 0x80044246 TKW_VV_VV_UB 100.0 Identity 0.0 1.0000 /end CHARACTERISTIC
/begin CHARACTERISTIC K_PR_IERRLLRED "Prio Erregerstrombegrenzung durch LL Sägen" VALUE 0x80044247 TKW_VV_VV_UB 100.0 Def_dez_ub_q1 0.0 255.0000 /end CHARACTERISTIC
/begin CHARACTERISTIC K_TDNHOLD "Haltezeit für Bedingung Drehzahlabweichung durch Generatorlastschwankung" VALUE 0x80044248 TKW_VV_VV_UB 100.0 Def_td_ub_q0p2 0.0 51.0000 /end CHARACTERISTIC
/begin CHARACTERISTIC K_VFZGGENKOR "Korrekturfaktor für V" VALUE 0x80044249 TKW_VV_VV_UB 100.0 Def_f_ub_b8 0.0 7.9687 /end CHARACTERISTIC
/begin CHARACTERISTIC S_GELIBIEAPP "Applikation Generatorlastbegrenzung für Leerlaufstabilisierung" VALUE 0x8004424A TKW_VV_VV_UB 100.0 Identity 0.0 1.0000 /end CHARACTERISTIC
/begin CHARACTERISTIC S_PGENLL_AKT "Aktivierung Leistungsreduzierung Generator durch Generatorlastschwankung" VALUE 0x8004424B TKW_VV_VV_UB 100.0 Identity 0.0 1.0000 /end CHARACTERISTIC
/begin CHARACTERISTIC KL_GELIKMIE "Faktor für Generatorlastbegrenzung für Leerlaufstabilisierung" CURVE 0x8004424C TKL_UB_VV_UB 100.0 Def_f_ub_b2 0.0 1.9921 /begin AXIS_DESCR STD_AXIS Ierr Def_i_ub_q0p125 6 0.0 31.8750 /end AXIS_DESCR /end CHARACTERISTIC
/begin CHARACTERISTIC K_GENMXGRADH "Maximal zulässiger Gradient Chiptemperatur" VALUE 0x8004425A TKW_VV_VV_SW 100.0 Def_t_sw_q0p1 -3276.8000 3276.7000 FORMAT "%4.1" /end CHARACTERISTIC
/begin CHARACTERISTIC K_NGENHTMN1 "Untere Drehzahlschwelle für kritischen Bereich Didentemparatur" VALUE 0x8004425C TKW_VV_VV_SW 100.0 Def_n_sw_q1p0 0.0 32767.0000 /end CHARACTERISTIC
/begin CHARACTERISTIC K_NGENHTMX1 "Obere Drehzahlschwelle für kritischen Bereich Didentemparatur" VALUE 0x8004425E TKW_VV_VV_SW 100.0 Def_n_sw_q1p0 0.0 32767.0000 /end CHARACTERISTIC
/begin CHARACTERISTIC K_TGENMXGRAD "Schwellwert für Erkennung mayimaler Gradient" VALUE 0x80044260 TKW_VV_VV_SW 100.0 Def_t_sw_q0p1 -3276.8000 3276.7000 FORMAT "%4.1" /end CHARACTERISTIC
/begin CHARACTERISTIC K_TGENMXTHD "Schwellwert für überhöhte Temparatur Generator" VALUE 0x80044262 TKW_VV_VV_SW 100.0 Def_t_sw_q0p1 -3276.8000 3276.7000 FORMAT "%4.1" /end CHARACTERISTIC
/begin CHARACTERISTIC K_TGENRSHT "Reset bei unterschrittener Chiptemperatur" VALUE 0x80044264 TKW_VV_VV_SW 100.0 Def_t_sw_q0p1 -3276.8000 3276.7000 FORMAT "%4.1" /end CHARACTERISTIC
/begin CHARACTERISTIC K_TCHIPFIL "Filterkonstante schneller Tchip Filter" VALUE 0x80044266 TKW_VV_VV_UW 100.0 Def_f_uw_b1 0.0 9.99984741210938e-1 /end CHARACTERISTIC
/begin CHARACTERISTIC K_TFTDIODE "Filterkonstante Deltatemparatur Diode" VALUE 0x80044268 TKW_VV_VV_UW 100.0 Def_f_uw_b1 1.52587890625e-5 9.99984741210938e-1 /end CHARACTERISTIC
/begin CHARACTERISTIC K_UGENHTMN "Schwellwert Bordnetzspannung Reset Generatorstrombefrenzung durch Hochtemperatur" VALUE 0x8004426A TKW_VV_VV_UW 100.0 Def_u_uw_q0p0942 0.0 6173.3970 FORMAT "%4.1" /end CHARACTERISTIC
/begin CHARACTERISTIC K_HTGENDFGRO "Schwelle Generaorauslastung zur E-Lüfteranforderung" VALUE 0x8004426C TKW_VV_VV_UB 100.0 Def_st_ub_q1 0.0 255.0000 /end CHARACTERISTIC
/begin CHARACTERISTIC K_I_VERTEIL "Stromverteilung" VALUE 0x8004426D TKW_VV_VV_UB 100.0 Def_f_ub_b4 0.0157 3.9843 /end CHARACTERISTIC
/begin CHARACTERISTIC K_PR_IERRTRED "Prio Erregerstromanforderung wegen Hochtemperatur" VALUE 0x8004426E TKW_VV_VV_UB 100.0 Def_st_ub_q1 0.0 255.0000 /end CHARACTERISTIC
/begin CHARACTERISTIC K_TDNGENKRIT "Verzögerung Generator im kritischen Drehzahlbereich" VALUE 0x8004426F TKW_VV_VV_UB 100.0 Def_td_ub_q1 0.0 255.0000 /end CHARACTERISTIC
/begin CHARACTERISTIC K_TDTCHIPKRI "Verzögerung Generatorhochtemperatur" VALUE 0x80044270 TKW_VV_VV_UB 100.0 Def_td_ub_q1 0.0 255.0000 /end CHARACTERISTIC
/begin CHARACTERISTIC K_TDTCHIPMX "Verzögerung erhöhte Chiptemperatur" VALUE 0x80044271 TKW_VV_VV_UB 100.0 Def_st_ub_q1 0.0 255.0000 /end CHARACTERISTIC
/begin CHARACTERISTIC K_TDUBFZMN "Verzögerung Bordnetzschwelle" VALUE 0x80044272 TKW_VV_VV_UB 100.0 Def_td_ub_q1 0.0 255.0000 /end CHARACTERISTIC
/begin CHARACTERISTIC K_TFIGENHT "Filterkonstante verteilter Generatorstrom" VALUE 0x80044273 TKW_VV_VV_UB 100.0 Def_f_ub_b1 0.0040 0.9960 /end CHARACTERISTIC
/begin CHARACTERISTIC K_TLCHTEP "Entprellung Hochtemperatur Generator" VALUE 0x80044274 TKW_VV_VV_UB 100.0 Def_td_ub_q1 0.0 255.0000 /end CHARACTERISTIC
/begin CHARACTERISTIC S_HTDETEC "Schalter zur Aktivierung Überwachung Diodentemparatur" VALUE 0x80044275 TKW_VV_VV_UB 100.0 Identity 0.0 1.0000 /end CHARACTERISTIC
/begin CHARACTERISTIC KL_NELUEFTGE "E-Lüfteranforderung Generator" CURVE 0x80044276 TKL_UB_VV_UB 100.0 Def_tv_ub_q0p390625 0.0 99.6093 /begin AXIS_DESCR STD_AXIS Gen_awnumm Def_st_ub_q1 6 0.0 255.0000 /end AXIS_DESCR /end CHARACTERISTIC
/begin CHARACTERISTIC KL_TMAXDIODE "Zulässige Diodenmaximaltemperatur" CURVE 0x80044284 TKL_UB_VV_SW 100.0 Def_t_sw_q0p1 -3276.8000 3276.7000 /begin AXIS_DESCR STD_AXIS Gen_awnumm Def_st_ub_q1 6 0.0 255.0000 /end AXIS_DESCR FORMAT "%4.1" /end CHARACTERISTIC
/begin CHARACTERISTIC KL_RTHJADIOD "Temperaturkoeffizient der Diode" CURVE 0x80044298 TKL_UB_VV_UW 100.0 Def_f_uw_b100 0.0 99.9984 /begin AXIS_DESCR STD_AXIS Gen_awnumm Def_st_ub_q1 6 0.0 255.0000 /end AXIS_DESCR FORMAT "%6.3" /end CHARACTERISTIC
/begin CHARACTERISTIC KL_TCHIPOFFS "Offset zur gemessenen Chiptemperatur Herstellerspezifisch" CURVE 0x800442AC TKL_UB_VV_SW 100.0 Def_t_sw_q0p1 -3276.8000 3276.7000 /begin AXIS_DESCR STD_AXIS Gen_manufak Def_st_ub_q1 8 0.0 255.0000 /end AXIS_DESCR FORMAT "%4.1" /end CHARACTERISTIC
/begin CHARACTERISTIC KF_UFDIODE "Kennfeld für Diodenvorwärtsspannung" MAP 0x800442C6 TKF_UB_SW_UW 100.0 Def_u_uw_q0p00488 0.0 319.9951
 /begin AXIS_DESCR STD_AXIS Tans_gen Def_t_sw_q0p1 2 -3276.8000 3276.7000 FORMAT "%4.1" /end AXIS_DESCR
 /begin AXIS_DESCR STD_AXIS Gen_awnumm Def_st_ub_q1 6 0.0 255.0000 /end AXIS_DESCR
 FORMAT "%6.3" /end CHARACTERISTIC
/begin CHARACTERISTIC KF_IERRGREHT "Generatorstrombegrenzung bei Generatorhochtemparatur" MAP 0x800442EA TKF_SW_SW_UB 100.0 Def_i_ub_q0p125 0.0 31.8750 /begin AXIS_DESCR STD_AXIS N_gen Def_n_sw_q1p0 3 -32768.0000 32767.0000 /end AXIS_DESCR /begin AXIS_DESCR STD_AXIS Gen_awnumm Def_st_sw_q1 6 -32768.0000 32767.0000 /end AXIS_DESCR /end CHARACTERISTIC
/begin CHARACTERISTIC KF_TANSGENKO "Kennfeld zur Bestimmung Ansauglufttemparatur Generator" MAP 0x80044310 TKF_SW_SW_SW 100.0 Def_t_sw_q0p1 -3276.8000 3276.7000
 /begin AXIS_DESCR STD_AXIS Tchip_fil_l Def_t_sw_q0p1 4 -3276.8000 3276.7000 FORMAT "%4.1" /end AXIS_DESCR
 /begin AXIS_DESCR STD_AXIS N_gen Def_n_sw_q1p0 4 -32768.0000 32767.0000 /end AXIS_DESCR
 FORMAT "%4.1" /end CHARACTERISTIC
/begin MEASUREMENT St_oznivdl0.B_oznivb "" UBYTE Def_bit_ub_0 0 0 0.0 255.0 ECU_ADDRESS 0xD0000753 BIT_MASK 0x1 /end MEASUREMENT
/begin MEASUREMENT St_oznivdl0.B_ozkrzkor "Bedingung drehzahlkorrigierter Kurzzeit Niveaumittelwert berechnet" UBYTE Def_bit_ub_1 0 0 0.0 255.0 ECU_ADDRESS 0xD0000753 BIT_MASK 0x2 /end MEASUREMENT
/begin MEASUREMENT St_oznivdl0.B_ozlangmw "Bedingung Langzeit-Mittelwert berechnet" UBYTE Def_bit_ub_2 0 0 0.0 255.0 ECU_ADDRESS 0xD0000753 BIT_MASK 0x4 /end MEASUREMENT
/begin MEASUREMENT St_oznivdl0.B_ozor "Bedingung Orientierungsmessung erfolgt" UBYTE Def_bit_ub_3 0 0 0.0 255.0 ECU_ADDRESS 0xD0000753 BIT_MASK 0x8 /end MEASUREMENT
/begin MEASUREMENT St_oznivdl0.B_ozvormw "Bedingung vorgezogener Mittelwert berechnet" UBYTE Def_bit_ub_4 0 0 0.0 255.0 ECU_ADDRESS 0xD0000753 BIT_MASK 0x10 /end MEASUREMENT
/begin MEASUREMENT St_oznivdl0.B_ozkrzlkor "" UBYTE Def_bit_ub_5 0 0 0.0 255.0 ECU_ADDRESS 0xD0000753 BIT_MASK 0x20 /end MEASUREMENT
/begin MEASUREMENT St_oznivdl0.B_ozluft "Umgebungsluftdruck plausibel / Steigungserkennung aktiv" UBYTE Def_bit_ub_6 0 0 0.0 255.0 ECU_ADDRESS 0xD0000753 BIT_MASK 0x40 /end MEASUREMENT
/begin MEASUREMENT St_oznivdl0.B_ozkrzl "" UBYTE Def_bit_ub_7 0 0 0.0 255.0 ECU_ADDRESS 0xD0000753 BIT_MASK 0x80 /end MEASUREMENT
/begin MEASUREMENT St_oznivdl0 "Statuswort" UBYTE Def_st_ub_q1 0 0 0.0 255.0000 ECU_ADDRESS 0xD0000753 /end MEASUREMENT
/begin MEASUREMENT St_oznivdl1.B_ozkrzkor2 "Ein Mittelwert von zwei KurzMw ist da" UBYTE Def_bit_ub_0 0 0 0.0 255.0 ECU_ADDRESS 0xD0000754 BIT_MASK 0x1 /end MEASUREMENT
/begin MEASUREMENT St_oznivdl1.B_ozkrzkornb "Bedingung drehzahlkorrigierter Kurzzeit Niveaumittelwert und nicht drehzahlbegrenzt berechnet" UBYTE Def_bit_ub_1 0 0 0.0 255.0 ECU_ADDRESS 0xD0000754 BIT_MASK 0x2 /end MEASUREMENT
/begin MEASUREMENT St_oznivdl1.B_ozoelcheck "" UBYTE Def_bit_ub_2 0 0 0.0 255.0 ECU_ADDRESS 0xD0000754 BIT_MASK 0x4 /end MEASUREMENT
/begin MEASUREMENT St_oznivdl1.B_ozoelchok "" UBYTE Def_bit_ub_3 0 0 0.0 255.0 ECU_ADDRESS 0xD0000754 BIT_MASK 0x8 /end MEASUREMENT
/begin MEASUREMENT St_oznivdl1.B_ozfahrt "Das Fahrzeug hat sich bewegt" UBYTE Def_bit_ub_4 0 0 0.0 255.0 ECU_ADDRESS 0xD0000754 BIT_MASK 0x10 /end MEASUREMENT
/begin MEASUREMENT St_oznivdl1.B_ozueberf "Überfüllung entdeckt" UBYTE Def_bit_ub_5 0 0 0.0 255.0 ECU_ADDRESS 0xD0000754 BIT_MASK 0x20 /end MEASUREMENT
/begin MEASUREMENT St_oznivdl1.B_ozml "Anforderung Messung läuft" UBYTE Def_bit_ub_6 0 0 0.0 255.0 ECU_ADDRESS 0xD0000754 BIT_MASK 0x40 /end MEASUREMENT
/begin MEASUREMENT St_oznivdl1.B_ozmreset "Reset der Messungen (beim INI2-Sprung)" UBYTE Def_bit_ub_7 0 0 0.0 255.0 ECU_ADDRESS 0xD0000754 BIT_MASK 0x80 /end MEASUREMENT
/begin MEASUREMENT St_oznivdl1 "Statuswort" UBYTE Def_st_ub_q1 0 0 0.0 255.0000 ECU_ADDRESS 0xD0000754 /end MEASUREMENT
/begin MEASUREMENT St_oznivdl_nv0.B_ozpeilerr "" UBYTE Def_bit_ub_1 0 0 0.0 255.0 ECU_ADDRESS 0xD0009E9A BIT_MASK 0x2 /end MEASUREMENT
/begin MEASUREMENT St_oznivdl_nv0.B_ozlmwneu "Langzeit-Mittelwert berechnet in der letzten Fahrt" UBYTE Def_bit_ub_2 0 0 0.0 255.0 ECU_ADDRESS 0xD0009E9A BIT_MASK 0x4 /end MEASUREMENT
/begin MEASUREMENT St_oznivdl_nv0.B_oznachf "Nachfüllung erkannt" UBYTE Def_bit_ub_3 0 0 0.0 255.0 ECU_ADDRESS 0xD0009E9A BIT_MASK 0x8 /end MEASUREMENT
/begin MEASUREMENT St_oznivdl_nv0.B_ozoelwech "Ölwechsel für die Peilstabanzeige" UBYTE Def_bit_ub_4 0 0 0.0 255.0 ECU_ADDRESS 0xD0009E9A BIT_MASK 0x10 /end MEASUREMENT
/begin MEASUREMENT St_oznivdl_nv0.B_ozabzlang "Abstellzeit zu lang für die anzeige des letzten Wertes" UBYTE Def_bit_ub_5 0 0 0.0 255.0 ECU_ADDRESS 0xD0009E9A BIT_MASK 0x20 /end MEASUREMENT
/begin MEASUREMENT St_oznivdl_nv0 "Statuswort" UBYTE Def_st_ub_q1 0 0 0.0 255.0000 ECU_ADDRESS 0xD0009E9A /end MEASUREMENT
/begin MEASUREMENT Oz_krzor "kurzzeitiger Mittelwert Orientierungsmessung Niveau" UBYTE Def_niv_ub_b75 0 0 0.0 74.7070 ECU_ADDRESS 0xD0001E58 /end MEASUREMENT
/begin MEASUREMENT Oz_lp "oz level picture" UBYTE Def_dez_ub_q1 0 0 0.0 255.0000 ECU_ADDRESS 0xD0001E59 /end MEASUREMENT
/begin MEASUREMENT Oz_lv "oz level value" UBYTE Def_dez_ub_q1 0 0 0.0 255.0000 ECU_ADDRESS 0xD0001E5A /end MEASUREMENT
/begin MEASUREMENT Oz_nivakt "Aktuelles Niveau für den Tester" UBYTE Def_niv_ub_b75 0 0 0.0 74.7070 ECU_ADDRESS 0xD0001E5B /end MEASUREMENT
/begin MEASUREMENT Oz_nivkrzt "Kurzmittelwert-Niveau für den Tester" UBYTE Def_niv_ub_b75 0 0 0.0 74.7070 ECU_ADDRESS 0xD0001E5C /end MEASUREMENT
/begin MEASUREMENT Oz_nivlit "Ölniveau in Liter" UBYTE Def_niv_ub_q0p1 0 0 0.0 25.5000 ECU_ADDRESS 0xD0001E5D /end MEASUREMENT
/begin MEASUREMENT Oz_nivnfm "Nachfüllmenge" UBYTE Def_niv_ub_b8 0 0 0.0 7.9687 ECU_ADDRESS 0xD0001E5E /end MEASUREMENT
/begin MEASUREMENT Oz_orikor "OriMw korrigiert" UBYTE Def_niv_ub_b75 0 0 0.0 74.7070 ECU_ADDRESS 0xD0001E5F /end MEASUREMENT
/begin MEASUREMENT Oz_vormw "vorgezogener Mittelwert Niveau" UBYTE Def_niv_ub_b75 0 0 0.0 74.7070 ECU_ADDRESS 0xD0001E60 /end MEASUREMENT
/begin MEASUREMENT Oz_rwpeil "Restweg laut Peilstab" SWORD Def_km_sw_q10 0 0 -327680.0000 327670.0000 ECU_ADDRESS 0xD0009EA0 /end MEASUREMENT
/begin MEASUREMENT Oz_abstellm "Abstellzeit für OZ" UWORD Def_tn_uw_q1 0 0 0.0 65535.0000 ECU_ADDRESS 0xD0009EA2 /end MEASUREMENT
/begin MEASUREMENT Oz_oelverbr "Berechneter Ölverbrauch" UWORD Def_dez_uw_q1 0 0 0.0 65535.0000 ECU_ADDRESS 0xD0009EA4 /end MEASUREMENT
/begin MEASUREMENT Oz_peilkmalt "Km Stand beim 1. Sensorfehler" UWORD Def_km_uw_q10 0 0 0.0 655350.0000 ECU_ADDRESS 0xD0009EA6 /end MEASUREMENT
/begin MEASUREMENT Oz_verbkmalt "Km-Stand letzter Ölverbrauch-Berechnung" UWORD Def_km_uw_q10 0 0 0.0 655350.0000 ECU_ADDRESS 0xD0009EA8 /end MEASUREMENT
/begin MEASUREMENT Oz_langmw "Langzeitmittelwert berechnet" UBYTE Def_niv_ub_b75 0 0 0.0 74.7070 ECU_ADDRESS 0xD0009E9B /end MEASUREMENT
/begin MEASUREMENT Oz_nivlangt "Langmittelwert für den Tester" UBYTE Def_niv_ub_b75 0 0 0.0 74.7070 ECU_ADDRESS 0xD0009E9C /end MEASUREMENT
/begin MEASUREMENT Oz_peilaltanz "Letzter Wert, der die Anzeige geändert hat" UBYTE Def_niv_ub_b75 0 0 0.0 74.7070 ECU_ADDRESS 0xD0009E9D /end MEASUREMENT
/begin MEASUREMENT Oz_peillang "Letzter angeforderter Wert für die Peilstabanzeige" UBYTE Def_niv_ub_b75 0 0 0.0 74.7070 ECU_ADDRESS 0xD0009E9E /end MEASUREMENT
/begin MEASUREMENT Oz_verbnivalt "Ölniveau letzter Ölverbrauch-Berechnung" UBYTE Def_niv_ub_b75 0 0 0.0 74.7070 ECU_ADDRESS 0xD0009E9F /end MEASUREMENT
/begin MEASUREMENT N_ozmw "kurzzeitiger Mittelwert Drehzahl" SWORD Def_n_sw_q1p0 0 0 -32767.0000 32767.0000 ECU_ADDRESS 0xD0001E74 /end MEASUREMENT
/begin MEASUREMENT Oz_hoehe "" SWORD Def_f_sw_b8 0 0 -8.0000 7.9997 ECU_ADDRESS 0xD0001E76 /end MEASUREMENT
/begin MEASUREMENT Oz_steigung "" SWORD Def_f_sw_b64 0 0 -64.0000 63.9980 ECU_ADDRESS 0xD0001E78 /end MEASUREMENT
/begin MEASUREMENT Oz_testtoel2 "" SWORD Def_t_sw_q0p1 0 0 -3276.8000 3276.7000 ECU_ADDRESS 0xD0001E7A /end MEASUREMENT
/begin MEASUREMENT Oz_dkm "" UWORD Def_f_uw_b10 0 0 0.0 9.9998 ECU_ADDRESS 0xD0001E7C /end MEASUREMENT
/begin MEASUREMENT Oz_nivzeit "Zeit nach dem KF_OZZEIT" UWORD Def_td_uw_q0p01 0 0 0.0 655.3500 ECU_ADDRESS 0xD0001E7E /end MEASUREMENT
/begin MEASUREMENT Oz_peilkm "Max Ziel km im Fehlerfall" UWORD Def_km_uw_q10 0 0 0.0 655350.0000 ECU_ADDRESS 0xD0001E80 /end MEASUREMENT
/begin MEASUREMENT Oz_pzdivp "Verhältnis oz_luftalt/oz_luftneu" UWORD Def_f_uw_b2 0 0 0.0 1.9999 ECU_ADDRESS 0xD0001E82 /end MEASUREMENT
/begin MEASUREMENT Oz_lbmw "" SBYTE Def_f_sb_b2 0 0 -2.0000 1.9843 ECU_ADDRESS 0xD0001E61 /end MEASUREMENT
/begin MEASUREMENT Oz_qbmw "" SBYTE Def_f_sb_b2 0 0 -2.0000 1.9843 ECU_ADDRESS 0xD0001E62 /end MEASUREMENT
/begin MEASUREMENT Oz_uefzcnt "Zwischenzähler Überfüllung" SBYTE Def_dez_sb_q1 0 0 -128.0000 127.0000 ECU_ADDRESS 0xD0001E63 /end MEASUREMENT
/begin MEASUREMENT Oz_beschcnt "Zähler Beschleunigungsausblendung" UBYTE Def_dez_ub_q1 0 0 0.0 255.0000 ECU_ADDRESS 0xD0001E64 /end MEASUREMENT
/begin MEASUREMENT Oz_krz2cnt "KurzMw 2 Zähler" UBYTE Def_dez_ub_q1 0 0 0.0 255.0000 ECU_ADDRESS 0xD0001E65 /end MEASUREMENT
/begin MEASUREMENT Oz_krzcnt "" UBYTE Def_dez_ub_q1 0 0 0.0 255.0000 ECU_ADDRESS 0xD0001E66 /end MEASUREMENT
/begin MEASUREMENT Oz_krzkor2 "Mittelwert von zwei KurzMw" UBYTE Def_niv_ub_b75 0 0 0.0 74.7070 ECU_ADDRESS 0xD0001E67 /end MEASUREMENT
/begin MEASUREMENT Oz_krzkor2k "Mittelwert von zwei KurzMw Steigungs korrigiert" UBYTE Def_niv_ub_b75 0 0 0.0 74.7070 ECU_ADDRESS 0xD0001E68 /end MEASUREMENT
/begin MEASUREMENT Oz_krzmw "" UBYTE Def_niv_ub_b75 0 0 0.0 74.7070 ECU_ADDRESS 0xD0001E69 /end MEASUREMENT
/begin MEASUREMENT Oz_krzmwkor "" UBYTE Def_niv_ub_b75 0 0 0.0 74.7070 ECU_ADDRESS 0xD0001E6A /end MEASUREMENT
/begin MEASUREMENT Oz_lgmwcnt "" UBYTE Def_dez_ub_q1 0 0 0.0 255.0000 ECU_ADDRESS 0xD0001E6B /end MEASUREMENT
/begin MEASUREMENT Oz_nivkor "Aktuelles Niveau Temperatur korrigiert" UBYTE Def_niv_ub_b75 0 0 0.0 74.7070 ECU_ADDRESS 0xD0001E6C /end MEASUREMENT
/begin MEASUREMENT Oz_oricnt "Orientierungszähler" UBYTE Def_dez_ub_q1 0 0 0.0 255.0000 ECU_ADDRESS 0xD0001E6D /end MEASUREMENT
/begin MEASUREMENT Oz_peil "" UBYTE Def_niv_ub_b75 0 0 0.0 74.7070 ECU_ADDRESS 0xD0001E6E /end MEASUREMENT
/begin MEASUREMENT Oz_peiloben "Obere Grenze aktuelles Balkens" UBYTE Def_niv_ub_b75 0 0 0.0 74.7070 ECU_ADDRESS 0xD0001E6F /end MEASUREMENT
/begin MEASUREMENT Oz_peilunten "Obere Grenze aktuelles Balkens" UBYTE Def_niv_ub_b75 0 0 0.0 74.7070 ECU_ADDRESS 0xD0001E70 /end MEASUREMENT
/begin MEASUREMENT Oz_uefcnt "Zähler Überfüllung" UBYTE Def_dez_ub_q1 0 0 0.0 255.0000 ECU_ADDRESS 0xD0001E71 /end MEASUREMENT
/begin MEASUREMENT Oz_vormwcnt "" UBYTE Def_dez_ub_q1 0 0 0.0 255.0000 ECU_ADDRESS 0xD0001E72 /end MEASUREMENT
/begin MEASUREMENT St_ozperm0.B_calcdper "Bedingung für Berechnung Restweg aus Er" UBYTE Def_bit_ub_0 0 0 0.0 255.0 ECU_ADDRESS 0xD0000755 BIT_MASK 0x1 /end MEASUREMENT
/begin MEASUREMENT St_ozperm0.B_ozpermgl "" UBYTE Def_bit_ub_1 0 0 0.0 255.0 ECU_ADDRESS 0xD0000755 BIT_MASK 0x2 /end MEASUREMENT
/begin MEASUREMENT St_ozperm0.B_ozpermpl "" UBYTE Def_bit_ub_2 0 0 0.0 255.0 ECU_ADDRESS 0xD0000755 BIT_MASK 0x4 /end MEASUREMENT
/begin MEASUREMENT St_ozperm0.B_ozpermpld "" UBYTE Def_bit_ub_3 0 0 0.0 255.0 ECU_ADDRESS 0xD0000755 BIT_MASK 0x8 /end MEASUREMENT
/begin MEASUREMENT St_ozperm0 "Statuswort" UBYTE Def_st_ub_q1 0 0 0.0 255.0000 ECU_ADDRESS 0xD0000755 /end MEASUREMENT
/begin MEASUREMENT St_ozperm_nv0.B_ozper0ok "Bedingung, dass gültiger Start-Permittivitätswert vorliegt" UBYTE Def_bit_ub_0 0 0 0.0 255.0 ECU_ADDRESS 0xD0009EAA BIT_MASK 0x1 /end MEASUREMENT
/begin MEASUREMENT St_ozperm_nv0.B_ozeranz "Bedingung für Anzeige Restweg aus Er" UBYTE Def_bit_ub_1 0 0 0.0 255.0 ECU_ADDRESS 0xD0009EAA BIT_MASK 0x2 /end MEASUREMENT
/begin MEASUREMENT St_ozperm_nv0.B_ozregstg "Bedingung Schieberegistersteuerung" UBYTE Def_bit_ub_2 0 0 0.0 255.0 ECU_ADDRESS 0xD0009EAA BIT_MASK 0x4 /end MEASUREMENT
/begin MEASUREMENT St_ozperm_nv0.B_ozer0ok "Bedingung Permittivität beim letztem Ölwechsel endgültig berechnet" UBYTE Def_bit_ub_3 0 0 0.0 255.0 ECU_ADDRESS 0xD0009EAA BIT_MASK 0x8 /end MEASUREMENT
/begin MEASUREMENT St_ozperm_nv0.B_ozdperm "Bedingung Delta Er-Ermittlung aktiv" UBYTE Def_bit_ub_4 0 0 0.0 255.0 ECU_ADDRESS 0xD0009EAA BIT_MASK 0x10 /end MEASUREMENT
/begin MEASUREMENT St_ozperm_nv0.B_ozerplt "Bedingung Ausheizzeit erfüllt" UBYTE Def_bit_ub_5 0 0 0.0 255.0 ECU_ADDRESS 0xD0009EAA BIT_MASK 0x20 /end MEASUREMENT
/begin MEASUREMENT St_ozperm_nv0 "Statuswort" UBYTE Def_st_ub_q1 0 0 0.0 255.0000 ECU_ADDRESS 0xD0009EAA /end MEASUREMENT
/begin MEASUREMENT Oz_permoff "Offset für Permittivitätskorrektur" UWORD Def_perm_uw_b6 0 0 0.0 5.9999 ECU_ADDRESS 0xD0001F00 /end MEASUREMENT
/begin MEASUREMENT Oz_permoff_oz "Offset für Permittivitätskorrektur" SWORD Def_perm_sw_b6 0 0 -6.0000 5.9998 ECU_ADDRESS 0xD0009EAC /end MEASUREMENT
/begin MEASUREMENT Oz_kmreg "Schieberegister Kilometerstand" UWORD Def_km_uw_q10 0 0 0.0 655350.0000 ECU_ADDRESS 0xD0009EAE ARRAY_SIZE 15 /end MEASUREMENT
/begin MEASUREMENT Oz_nivkm "letzter Kilometerstand bei dem ein neuer Langzeitmittelwert Niveau vorlag und kein Öl nachgefüllt wurde" UWORD Def_km_uw_q10 0 0 0.0 655350.0000 ECU_ADDRESS 0xD0009ECC /end MEASUREMENT
/begin MEASUREMENT Oz_permex "Permittivität für Bewertung aufbereitet (extrapoliert)" UWORD Def_perm_uw_b6 0 0 0.0 5.9999 ECU_ADDRESS 0xD0009ECE /end MEASUREMENT
/begin MEASUREMENT Oz_permlow "aufbereitete Permittivität bei letztem Ölwechsel" UWORD Def_perm_uw_b6 0 0 0.0 5.9999 ECU_ADDRESS 0xD0009ED0 /end MEASUREMENT
/begin MEASUREMENT Oz_permreg "Schieberegister Permittivität" UWORD Def_perm_uw_b6 0 0 0.0 5.9999 ECU_ADDRESS 0xD0009ED2 ARRAY_SIZE 15 /end MEASUREMENT
/begin MEASUREMENT Oz_prfstrg "Zähler für Delta Er-Ermittlung" UWORD Def_dez_uw_q1 0 0 0.0 65535.0000 ECU_ADDRESS 0xD0009EF0 /end MEASUREMENT
/begin MEASUREMENT Oz_todeltime "Zähler Ausheizzeit (nichtflüchtig)" UWORD Def_td_uw_q1 0 0 0.0 65535.0000 ECU_ADDRESS 0xD0009EF2 /end MEASUREMENT
/begin MEASUREMENT Oz_permanz "Anzahl der Messwerte im Schieberegister" SBYTE Def_dez_sb_q1 0 0 -128.0000 127.0000 ECU_ADDRESS 0xD0009EAB /end MEASUREMENT
/begin MEASUREMENT Oz_dpermsi "" SBYTE Def_dez_sb_q1 0 0 -128.0000 127.0000 ECU_ADDRESS 0xD0001F04 /end MEASUREMENT
/begin MEASUREMENT St_ozrestkm_0.B_oznoperm "Keine Berechnung von Permittivität für die Restlaufstrecke" UBYTE Def_bit_ub_0 0 0 0.0 255.0 ECU_ADDRESS 0xD0000756 BIT_MASK 0x1 /end MEASUREMENT
/begin MEASUREMENT St_ozrestkm_0 "Statuswort" UBYTE Def_st_ub_q1 0 0 0.0 255.0000 ECU_ADDRESS 0xD0000756 /end MEASUREMENT
/begin MEASUREMENT St_ozrestkm_nv0.B_rwanz0 "Bedingung für Restweganzeige = Null" UBYTE Def_bit_ub_0 0 0 0.0 255.0 ECU_ADDRESS 0xD0009EF4 BIT_MASK 0x1 /end MEASUREMENT
/begin MEASUREMENT St_ozrestkm_nv0.B_ozvfk "" UBYTE Def_bit_ub_1 0 0 0.0 255.0 ECU_ADDRESS 0xD0009EF4 BIT_MASK 0x2 /end MEASUREMENT
/begin MEASUREMENT St_ozrestkm_nv0.B_ozini "" UBYTE Def_bit_ub_2 0 0 0.0 255.0 ECU_ADDRESS 0xD0009EF4 BIT_MASK 0x4 /end MEASUREMENT
/begin MEASUREMENT St_ozrestkm_nv0.B_ozcntini "Tageberechnung initialisiert" UBYTE Def_bit_ub_3 0 0 0.0 255.0 ECU_ADDRESS 0xD0009EF4 BIT_MASK 0x8 /end MEASUREMENT
/begin MEASUREMENT St_ozrestkm_nv0 "Statuswort" UBYTE Def_st_ub_q1 0 0 0.0 255.0000 ECU_ADDRESS 0xD0009EF4 /end MEASUREMENT
/begin MEASUREMENT Oz_rwkvb "" SWORD Def_km_sw_q10 0 0 -327680.0000 327670.0000 ECU_ADDRESS 0xD0001F5C /end MEASUREMENT
/begin MEASUREMENT Oz_rwperm "Restweg aus Permittivität abgeleitet" SWORD Def_km_sw_q10 0 0 -327680.0000 327670.0000 ECU_ADDRESS 0xD0001F5E /end MEASUREMENT
/begin MEASUREMENT Oz_rwzeit "Restweg laut Zeitverlauf" SWORD Def_km_sw_q10 0 0 -327680.0000 327670.0000 ECU_ADDRESS 0xD0001F60 /end MEASUREMENT
/begin MEASUREMENT Oz_oelzeit "Öl-Alter in Monate" UWORD Def_dez_uw_q1 0 0 0.0 65535.0000 ECU_ADDRESS 0xD0001F62 /end MEASUREMENT
/begin MEASUREMENT Oz_oelzeitt "Öl-Alter in Tage" UWORD Def_dez_uw_q1 0 0 0.0 65535.0000 ECU_ADDRESS 0xD0001F64 /end MEASUREMENT
/begin MEASUREMENT Oz_rwprog "Prognose_Intervall_Weg_BOS_Meldung_2" UWORD Def_km_uw_q10 0 0 0.0 655350.0000 ECU_ADDRESS 0xD0001F66 /end MEASUREMENT
/begin MEASUREMENT Oz_intprog "Prognose_Intervall_Zeit_BOS_Meldung_2" UBYTE Def_dez_ub_q1 0 0 0.0 255.0000 ECU_ADDRESS 0xD0001F76 /end MEASUREMENT
/begin MEASUREMENT Oz_vfanz "anzuzeigende Verfügbarkeit" UBYTE Def_lf_ub_q0p01 0 0 0.0 2.5500 ECU_ADDRESS 0xD0001F77 /end MEASUREMENT
/begin MEASUREMENT Oz_kvbmw "" ULONG Def_fuel_ul_q0p000122 0 0 0.0 100.0000 ECU_ADDRESS 0xD0009EFC /end MEASUREMENT
/begin MEASUREMENT Oz_kvbsm_ul "" ULONG Def_fuel_ul_q0p000122 0 0 0.0 524287.9998 ECU_ADDRESS 0xD0009F00 /end MEASUREMENT
/begin MEASUREMENT Oz_cttagini "Tag beim Ölwechsel" SWORD Def_dez_sw_q1 0 0 -32768.0000 32767.0000 ECU_ADDRESS 0xD0009F04 /end MEASUREMENT
/begin MEASUREMENT Oz_rwanz "anzuzeigender Restweg" SWORD Def_km_sw_q10 0 0 -327680.0000 327670.0000 ECU_ADDRESS 0xD0009F06 /end MEASUREMENT
/begin MEASUREMENT Oz_kmstrw0 "Kilometerstand bei Restweg = Null" UWORD Def_km_uw_q10 0 0 0.0 655350.0000 ECU_ADDRESS 0xD0009F08 /end MEASUREMENT
/begin MEASUREMENT Oz_kvbog "zugeteilte Bonuskraftstoffmenge" UWORD Def_dez_uw_q1 0 0 0.0 65535.0000 ECU_ADDRESS 0xD0009F0A /end MEASUREMENT
/begin MEASUREMENT Oz_permbog "zugeteilter Permittivitätsbonus" UWORD Def_perm_uw_b6 0 0 0.0 5.9999 ECU_ADDRESS 0xD0009F0C /end MEASUREMENT
/begin MEASUREMENT Oz_utzeit "Zeit Öl in Übertemperatur" UWORD Def_dez_uw_q1 0 0 0.0 65535.0000 ECU_ADDRESS 0xD0009F0E /end MEASUREMENT
/begin MEASUREMENT Oz_lf1t "Länderfaktor 1" UBYTE Def_lf_ub_q0p01 0 0 0.0 2.5500 ECU_ADDRESS 0xD0009EF5 /end MEASUREMENT
/begin MEASUREMENT Oz_lf2t "Länderfaktor 2" UBYTE Def_lf_ub_q0p01 0 0 0.0 2.5500 ECU_ADDRESS 0xD0009EF6 /end MEASUREMENT
/begin MEASUREMENT Oz_zieljahr "" UBYTE Def_dez_ub_q1 0 0 0.0 255.0000 ECU_ADDRESS 0xD0009EF7 /end MEASUREMENT
/begin MEASUREMENT Oz_zielmon "" UBYTE Def_dez_ub_q1 0 0 0.0 255.0000 ECU_ADDRESS 0xD0009EF8 /end MEASUREMENT
/begin MEASUREMENT Oz_kvbdiff "" ULONG Def_fuel_ul_q0p000122 0 0 0.0 100.0000 ECU_ADDRESS 0xD0001F54 /end MEASUREMENT
/begin MEASUREMENT Oz_kvbsm "" ULONG Def_fuel_ul_q0p000122 0 0 0.0 10000.0000 ECU_ADDRESS 0xD0001F58 /end MEASUREMENT
/begin MEASUREMENT Oz_rwde "Restweg laut Dieseleintrag" SWORD Def_km_sw_q10 0 0 -327680.0000 327670.0000 ECU_ADDRESS 0xD0001F68 /end MEASUREMENT
/begin MEASUREMENT Oz_rwp "Zwischengröße Restwegberechnung" SWORD Def_km_sw_q10 0 0 -327680.0000 327670.0000 ECU_ADDRESS 0xD0001F6A /end MEASUREMENT
/begin MEASUREMENT Oz_deabzug "Abzug durch Dieseleintrag" UWORD Def_km_uw_q10 0 0 0.0 655350.0000 ECU_ADDRESS 0xD0001F6C /end MEASUREMENT
/begin MEASUREMENT Oz_kvbmwtmp "" UWORD Def_f_uw_b64 0 0 0.0 63.9990 ECU_ADDRESS 0xD0001F6E /end MEASUREMENT
/begin MEASUREMENT Oz_kvbmx "" UWORD Def_dez_uw_q1 0 0 0.0 65535.0000 ECU_ADDRESS 0xD0001F70 /end MEASUREMENT
/begin MEASUREMENT Oz_kvbtmp2 "" UWORD Def_km_uw_q10 0 0 0.0 655350.0000 ECU_ADDRESS 0xD0001F72 /end MEASUREMENT
/begin MEASUREMENT Oz_litges "Gesamtverbrauch für Ölwechsel" UWORD Def_dez_uw_q1 0 0 0.0 65535.0000 ECU_ADDRESS 0xD0001F74 /end MEASUREMENT
/begin MEASUREMENT Oz_nivlanglit "LangMw in Liter" UBYTE Def_niv_ub_q0p1 0 0 0.0 25.5000 ECU_ADDRESS 0xD0001F78 /end MEASUREMENT
/begin MEASUREMENT Oz_vfkvb "Verfügbarkeit aus Kraftstoffverbrauch" UBYTE Def_lf_ub_q0p01 0 0 0.0 2.5500 ECU_ADDRESS 0xD0001F79 /end MEASUREMENT
/begin MEASUREMENT Oz_vfperm "Verfügbarkeit aus der Permittivität" UBYTE Def_lf_ub_q0p01 0 0 0.0 2.5500 ECU_ADDRESS 0xD0001F7A /end MEASUREMENT
/begin MEASUREMENT Oz_vfzeit "Verfügbarkeit aus Zeit" UBYTE Def_lf_ub_q0p01 0 0 0.0 2.5500 ECU_ADDRESS 0xD0001F7B /end MEASUREMENT
/begin MEASUREMENT Oz_tempf "" SWORD Def_t_sw_q0p1 0 0 -3276.8000 3276.7000 ECU_ADDRESS 0xD0001F84 /end MEASUREMENT
/begin MEASUREMENT Oz_tempmdl "Interne Modelltemperatur (NG6)" SWORD Def_t_sw_q0p1 0 0 -3276.8000 3276.7000 ECU_ADDRESS 0xD0001F86 /end MEASUREMENT
/begin MEASUREMENT Oz_visc_dum "" UBYTE Def_dez_ub_q1 0 0 0.0 255.0000 ECU_ADDRESS 0xD0001F88 /end MEASUREMENT
/begin MEASUREMENT St_pgenllred.B_nsubgen "Bedingung Leerlaufsolldrehzahlanhebung bei erkannten Generatorlastschwankung" UBYTE Def_bit_ub_0 0 0 0.0 255.0 ECU_ADDRESS 0xD00007A0 BIT_MASK 0x1 /end MEASUREMENT
/begin MEASUREMENT St_pgenllred.B_geli "Bedingung Generatorlastbegrenzung für Leerlaufstabilisierung" UBYTE Def_bit_ub_1 0 0 0.0 255.0 ECU_ADDRESS 0xD00007A0 BIT_MASK 0x2 /end MEASUREMENT
/begin MEASUREMENT St_pgenllred.B_pgenllerk "Bedingung Generatorlimitierung wegen LL-Sägen erkannt" UBYTE Def_bit_ub_2 0 0 0.0 255.0 ECU_ADDRESS 0xD00007A0 BIT_MASK 0x4 /end MEASUREMENT
/begin MEASUREMENT St_pgenllred "Statuswort" UBYTE Def_st_ub_q1 0 0 0.0 255.0000 ECU_ADDRESS 0xD00007A0 /end MEASUREMENT
/begin MEASUREMENT St_pgenllred_200ms.B_pgenredllve "Bedingung Fehler Fahrzeuggeschwindigkeit erkannt" UBYTE Def_bit_ub_0 0 0 0.0 255.0 ECU_ADDRESS 0xD0001F89 BIT_MASK 0x1 /end MEASUREMENT
/begin MEASUREMENT St_pgenllred_200ms.B_dffaktiv "Bedingung Auswertung des Generatorlastsignals für Leerlaufregelung aktiv" UBYTE Def_bit_ub_1 0 0 0.0 255.0 ECU_ADDRESS 0xD0001F89 BIT_MASK 0x2 /end MEASUREMENT
/begin MEASUREMENT St_pgenllred_200ms.B_nsubg_r "Resetbedingung für LL Anhebung GEN" UBYTE Def_bit_ub_2 0 0 0.0 255.0 ECU_ADDRESS 0xD0001F89 BIT_MASK 0x4 /end MEASUREMENT
/begin MEASUREMENT St_pgenllred_200ms.B_nsubgen1 "Temporäre Zwischengröße für LL Anhebung Generator" UBYTE Def_bit_ub_3 0 0 0.0 255.0 ECU_ADDRESS 0xD0001F89 BIT_MASK 0x8 /end MEASUREMENT
/begin MEASUREMENT St_pgenllred_200ms.B_pgenllfa "Bedingung für Rücksetzen erkanntes LL-Sägen durch Generator" UBYTE Def_bit_ub_4 0 0 0.0 255.0 ECU_ADDRESS 0xD0001F89 BIT_MASK 0x10 /end MEASUREMENT
/begin MEASUREMENT St_pgenllred_200ms "Statuswort" UBYTE Def_st_ub_q1 0 0 0.0 255.0000 ECU_ADDRESS 0xD0001F89 /end MEASUREMENT
/begin MEASUREMENT Ierrgrenz_ll "Grenzerregerstrombegrenzung Generator" UBYTE Def_i_ub_q0p125 0 0 0.0 31.8750 ECU_ADDRESS 0xD00007A1 /end MEASUREMENT
/begin MEASUREMENT Pr_ierrllred "Prio Erregerstrombegrenzung durch LL Sägen" UBYTE Def_dez_ub_q1 0 0 0.0 255.0000 ECU_ADDRESS 0xD00007A2 /end MEASUREMENT
/begin MEASUREMENT Dnkw "Drehzahlabweichung bei Leerlaufregelung" SWORD Def_n_sw_q1p0 0 0 -32768.0000 32767.0000 ECU_ADDRESS 0xD0001F8C /end MEASUREMENT
/begin MEASUREMENT V_pgenllkor "Fahrzeuggeschwindigkeit korrigiert" UWORD Def_v_uw_q0p1 0 0 0.0 6553.5000 ECU_ADDRESS 0xD00007A4 /end MEASUREMENT
/begin MEASUREMENT Tdffgen "Zeitzähler für Erkennung Generatorlastschwankung für Leerlaufanhebung" UWORD Def_td_uw_q0p2 0 0 0.0 13107.0000 ECU_ADDRESS 0xD0001F8E /end MEASUREMENT
/begin MEASUREMENT Deltadff "Gradient des vom Generator empfangenen Lastsignals" SBYTE Def_f_sb_b64 0 0 -64.0000 63.5000 ECU_ADDRESS 0xD0001F8A /end MEASUREMENT
/begin MEASUREMENT Dffgenschz "Zähler für Generatorlastschwnkungen zur Leerlauf-Solldrehzahlanhebung" UBYTE Def_dez_ub_q1 0 0 0.0 255.0000 ECU_ADDRESS 0xD0001F8B /end MEASUREMENT
/begin MEASUREMENT St_pgenred_1s.B_genht "Bedingung Generator Hochtemperatur" UBYTE Def_bit_ub_0 0 0 0.0 255.0 ECU_ADDRESS 0xD0001FB8 BIT_MASK 0x1 /end MEASUREMENT
/begin MEASUREMENT St_pgenred_1s.B_genhtkrit "" UBYTE Def_bit_ub_1 0 0 0.0 255.0 ECU_ADDRESS 0xD0001FB8 BIT_MASK 0x2 /end MEASUREMENT
/begin MEASUREMENT St_pgenred_1s.B_genhtkritv "Bedingung kritische Temparatur vor Entprellung" UBYTE Def_bit_ub_2 0 0 0.0 255.0 ECU_ADDRESS 0xD0001FB8 BIT_MASK 0x4 /end MEASUREMENT
/begin MEASUREMENT St_pgenred_1s.B_tdiodekrit "Diodentemparatur im kritischen Bereich" UBYTE Def_bit_ub_3 0 0 0.0 255.0 ECU_ADDRESS 0xD0001FB8 BIT_MASK 0x8 /end MEASUREMENT
/begin MEASUREMENT St_pgenred_1s.B_genhtmxgra "Maximale Gradient Chiptemparatur überstiegen" UBYTE Def_bit_ub_4 0 0 0.0 255.0 ECU_ADDRESS 0xD0001FB8 BIT_MASK 0x10 /end MEASUREMENT
/begin MEASUREMENT St_pgenred_1s.B_ierrgrenzh "Grenzstrom aus Hochtemperatur Generator aktiv" UBYTE Def_bit_ub_5 0 0 0.0 255.0 ECU_ADDRESS 0xD0001FB8 BIT_MASK 0x20 /end MEASUREMENT
/begin MEASUREMENT St_pgenred_1s "Statuswort" UBYTE Def_st_ub_q1 0 0 0.0 255.0000 ECU_ADDRESS 0xD0001FB8 /end MEASUREMENT
/begin MEASUREMENT Tchip_fil_l "Wirkliche Chiptemperatur vom Generatorregler als Mittelwert gefiltert" SWORD Def_t_sw_q0p1 0 0 -3276.8000 3276.7000 ECU_ADDRESS 0xD00007A6 /end MEASUREMENT
/begin MEASUREMENT Tchip_fil_s "Wirkliche Chiptemperatur vom Generatorregler als Mittelwert gefiltert" SWORD Def_t_sw_q0p1 0 0 -3276.8000 3276.7000 ECU_ADDRESS 0xD00007A8 /end MEASUREMENT
/begin MEASUREMENT Nelueft_gen "Drehzahlanforderung E-Lüfter Generator" UBYTE Def_tv_ub_q0p390625 0 0 0.0 99.6093 ECU_ADDRESS 0xD0001FB9 /end MEASUREMENT
/begin MEASUREMENT Ierrgrenz_ht "Grenzerregerstrom durch Überhitzung Dioden" UBYTE Def_i_ub_q0p125 0 0 0.0 31.8750 ECU_ADDRESS 0xD00007AA /end MEASUREMENT
/begin MEASUREMENT Pr_ierrtred "Prio Erregerstromanforderung wegen Hochtemperatur" UBYTE Def_st_ub_q1 0 0 0.0 255.0000 ECU_ADDRESS 0xD00007AB /end MEASUREMENT
/begin MEASUREMENT T_chipfilsdt "Differenzenquotient schnellgefilterte Chiptemparatur" SWORD Def_t_sw_q0p1 0 0 -3276.8000 3276.7000 ECU_ADDRESS 0xD0001FD8 /end MEASUREMENT
/begin MEASUREMENT T_diode "Diodentemparatur" SWORD Def_t_sw_q0p1 0 0 -3276.8000 3276.7000 ECU_ADDRESS 0xD0001FDA /end MEASUREMENT
/begin MEASUREMENT T_diodedelta "Deltatemparatur Diode" SWORD Def_t_sw_q0p1 0 0 -3276.8000 3276.7000 ECU_ADDRESS 0xD0001FDC /end MEASUREMENT
/begin MEASUREMENT Tans_gen "Ansauglufttemparatur Generator" SWORD Def_t_sw_q0p1 0 0 -3276.8000 3276.7000 ECU_ADDRESS 0xD0001FDE /end MEASUREMENT
/begin MEASUREMENT Tchip_ist "Wirkliche Chiptemperatur vom Generatorregler" SWORD Def_t_sw_q0p1 0 0 -3276.8000 3276.7000 ECU_ADDRESS 0xD0001FE0 /end MEASUREMENT
/begin MEASUREMENT Tchip_mwa "Array zur Mittelwerbildung Tchip_ist" SWORD Def_t_sw_q0p1 0 0 -3276.8000 3276.7000 ECU_ADDRESS 0xD0001FE2 ARRAY_SIZE 16 /end MEASUREMENT
/begin MEASUREMENT Tchip_sum "Summenwert Tchip zur Mittelwertbildung" SWORD Def_t_sw_q0p1 0 0 -3276.8000 3276.7000 ECU_ADDRESS 0xD0002002 /end MEASUREMENT
/begin MEASUREMENT P_totdiode "Verlustleistung der Diode" UWORD Def_f_uw_b256 0 0 0.0 255.9960 ECU_ADDRESS 0xD0002004 /end MEASUREMENT
/begin MEASUREMENT U_vordiode "Diodenvorwärtsspannung" UWORD Def_u_uw_q0p00488 0 0 0.0 319.9951 ECU_ADDRESS 0xD0002006 /end MEASUREMENT
/begin MEASUREMENT Z_tchip "Zaehler für Mittelwerbildung Tchip_ist" UBYTE Def_st_ub_q1 0 0 0.0 255.0000 ECU_ADDRESS 0xD0001FBA /end MEASUREMENT
/begin FUNCTION OZNIVDL ""
 /begin DEF_CHARACTERISTIC KF_OZDREHKOR KF_OZKORRNIV KF_OZKORRORI KF_OZZEIT KL_OZBEFKL KL_OZKRZMW2 KL_OZLBNIV KL_OZLN KL_OZNFDELTA KL_OZORBERO KL_OZQBNIV KL_OZSTNIV K_CW_OZ K_NACHFUELL12 K_NACHFUELL25 K_NACHFUELL38 K_NACHFUELL53 K_NACHFUELL69 K_NACHFUELL85 K_NACHFUELL95 K_OZABSTELL K_OZALTANZABZ K_OZBESCHAUS K_OZDKNIVN K_OZLBESCHN K_OZLBESCHORI K_OZLBESCHP K_OZLBESCHST K_OZLUFTMAX K_OZMAXSLOPE K_OZMINSLOPE K_OZMWK K_OZMWL K_OZMWOR K_OZMWV K_OZNFERR K_OZNFML K_OZNFOELCKO K_OZNFOELCOK K_OZNMOTMAX K_OZNMOTMIN K_OZOELCABZ K_OZOELCOK K_OZOELCVERZ K_OZOELVERB K_OZORIPEILTZO K_OZORIPEILTZU K_OZPEIL12 K_OZPEIL25 K_OZPEIL38 K_OZPEIL53 K_OZPEIL69 K_OZPEIL85 K_OZPEILDO K_OZPEILDOMIN K_OZPEILDU K_OZPEILDU38 K_OZPEILERR K_OZPEILKSPR K_OZPEILLP85 K_OZPEILML K_OZPEILOELCKO K_OZPEILOELCOK K_OZPEILSPRUNG K_OZQBESCHN K_OZQBESCHORI K_OZQBESCHP K_OZQBESCHST K_OZSTANDVERZ K_OZSTARTABZ K_OZSTARTVERZ K_OZSTMINW K_OZTEMPBW K_OZTORMIN K_OZUEBERF K_OZUEFCNT K_OZUEFNLB K_OZUEFNQB K_OZUEFNST K_OZUEFODZ K_OZUEFPLB K_OZUEFPQB K_OZUEFPST K_OZUEFTEM K_OZUEFUDZ K_OZUEFVERZ K_OZVERBDKM K_OZVERBFAK K_OZVERLORI K_OZVERZERRBSD K_OZVORMV K_OZVORPEILMIN /end DEF_CHARACTERISTIC
 /begin REF_CHARACTERISTIC /end REF_CHARACTERISTIC
 /begin IN_MEASUREMENT /end IN_MEASUREMENT
 /begin OUT_MEASUREMENT N_ozmw Oz_abstellm Oz_beschcnt Oz_dkm Oz_hoehe Oz_krz2cnt Oz_krzcnt Oz_krzkor2 Oz_krzkor2k Oz_krzmw Oz_krzmwkor Oz_krzor Oz_langmw Oz_lbmw Oz_lgmwcnt Oz_lp Oz_lv Oz_nivakt Oz_nivkor Oz_nivkrzt Oz_nivlangt Oz_nivlit Oz_nivnfm Oz_nivzeit Oz_oelverbr Oz_oricnt Oz_orikor Oz_peil Oz_peilaltanz Oz_peilkm Oz_peilkmalt Oz_peillang Oz_peiloben Oz_peilunten Oz_pzdivp Oz_qbmw Oz_rwpeil Oz_steigung Oz_testtoel2 Oz_uefcnt Oz_uefzcnt Oz_verbkmalt Oz_verbnivalt Oz_vormw Oz_vormwcnt St_oznivdl0 St_oznivdl0.B_ozkrzkor St_oznivdl0.B_ozkrzl St_oznivdl0.B_ozkrzlkor St_oznivdl0.B_ozlangmw St_oznivdl0.B_ozluft St_oznivdl0.B_oznivb St_oznivdl0.B_ozor St_oznivdl0.B_ozvormw St_oznivdl1 St_oznivdl1.B_ozfahrt St_oznivdl1.B_ozkrzkor2 St_oznivdl1.B_ozkrzkornb St_oznivdl1.B_ozml St_oznivdl1.B_ozmreset St_oznivdl1.B_ozoelcheck St_oznivdl1.B_ozoelchok St_oznivdl1.B_ozueberf St_oznivdl_nv0 St_oznivdl_nv0.B_ozabzlang St_oznivdl_nv0.B_ozlmwneu St_oznivdl_nv0.B_oznachf St_oznivdl_nv0.B_ozoelwech St_oznivdl_nv0.B_ozpeilerr /end OUT_MEASUREMENT
/end FUNCTION
/begin FUNCTION OZPERM ""
 /begin DEF_CHARACTERISTIC K_OZOELKMPL K_OZPERMCOK5 K_OZPERMMIN K_OZPERMMNIV K_OZPERMNK3 K_OZPERMTIK6 K_OZPERMTIK8 K_OZPERMTIK9 K_OZPERMTK12 K_OZPERMTK13 K_OZPERMTK4 K_OZPERMTK7 /end DEF_CHARACTERISTIC
 /begin REF_CHARACTERISTIC /end REF_CHARACTERISTIC
 /begin IN_MEASUREMENT /end IN_MEASUREMENT
 /begin OUT_MEASUREMENT Oz_dpermsi Oz_kmreg Oz_nivkm Oz_permanz Oz_permex Oz_permlow Oz_permoff Oz_permoff_oz Oz_permreg Oz_prfstrg Oz_todeltime St_ozperm0 St_ozperm0.B_calcdper St_ozperm0.B_ozpermgl St_ozperm0.B_ozpermpl St_ozperm0.B_ozpermpld St_ozperm_nv0 St_ozperm_nv0.B_ozdperm St_ozperm_nv0.B_ozer0ok St_ozperm_nv0.B_ozeranz St_ozperm_nv0.B_ozerplt St_ozperm_nv0.B_ozper0ok St_ozperm_nv0.B_ozregstg /end OUT_MEASUREMENT
/end FUNCTION
/begin FUNCTION OZRESTKM ""
 /begin DEF_CHARACTERISTIC KL_OZVERDFAK K_OZANFANZ K_OZDAEMPF K_OZKMMAXK11 K_OZKVB96 K_OZKVB96A K_OZKVBMXK18 K_OZKVBOK16 K_OZLF1 K_OZLF2 K_OZMNKMBO K_OZMXOHK15 K_OZOELMEN K_OZPERBOK17 K_OZPERBRK14 K_OZPERXK10 K_OZTAGCTERR K_OZUEBERTEMP K_OZUTFAK K_OZZEITFAKT K_OZZEITINT /end DEF_CHARACTERISTIC
 /begin REF_CHARACTERISTIC /end REF_CHARACTERISTIC
 /begin IN_MEASUREMENT /end IN_MEASUREMENT
 /begin OUT_MEASUREMENT Oz_cttagini Oz_deabzug Oz_intprog Oz_kmstrw0 Oz_kvbdiff Oz_kvbmw Oz_kvbmwtmp Oz_kvbmx Oz_kvbog Oz_kvbsm Oz_kvbsm_ul Oz_kvbtmp2 Oz_lf1t Oz_lf2t Oz_litges Oz_nivlanglit Oz_oelzeit Oz_oelzeitt Oz_permbog Oz_rwanz Oz_rwde Oz_rwkvb Oz_rwp Oz_rwperm Oz_rwprog Oz_rwzeit Oz_utzeit Oz_vfanz Oz_vfkvb Oz_vfperm Oz_vfzeit Oz_zieljahr Oz_zielmon St_ozrestkm_0 St_ozrestkm_0.B_oznoperm St_ozrestkm_nv0 St_ozrestkm_nv0.B_ozcntini St_ozrestkm_nv0.B_ozini St_ozrestkm_nv0.B_ozvfk St_ozrestkm_nv0.B_rwanz0 /end OUT_MEASUREMENT
/end FUNCTION
/begin FUNCTION OZTEMP "" /begin DEF_CHARACTERISTIC KF_OZTEMPMDL K_OZTLPF K_OZTLPFMDL /end DEF_CHARACTERISTIC /begin REF_CHARACTERISTIC /end REF_CHARACTERISTIC /begin IN_MEASUREMENT /end IN_MEASUREMENT /begin OUT_MEASUREMENT Oz_tempf Oz_tempmdl /end OUT_MEASUREMENT /end FUNCTION
/begin FUNCTION OZVISC "" /begin DEF_CHARACTERISTIC /end DEF_CHARACTERISTIC /begin REF_CHARACTERISTIC /end REF_CHARACTERISTIC /begin IN_MEASUREMENT /end IN_MEASUREMENT /begin OUT_MEASUREMENT Oz_visc_dum /end OUT_MEASUREMENT /end FUNCTION
/begin FUNCTION PGENLLRED ""
 /begin DEF_CHARACTERISTIC KL_GELIKMIE K_DELTADFFMX K_DFFLIM K_DFFLLANH K_DFFSCHZMX K_GELIIEAPP K_GELIIEZK K_GELISETAPP K_GELIVMAX K_LLWDNMAX K_LLWDNMIN K_NMOTLLANH K_NSTATLLANH K_PR_IERRLLRED K_PWGLLANH K_TDFDTMAX K_TDFFABLF K_TDFFMAX K_TDFFMIN K_TDNHOLD K_TMOTLLANH K_TNSTLLANH K_VFZGGENFIL K_VFZGGENKOR K_VFZGLLANH S_GELIBIEAPP S_PGENLL_AKT /end DEF_CHARACTERISTIC
 /begin REF_CHARACTERISTIC /end REF_CHARACTERISTIC
 /begin IN_MEASUREMENT /end IN_MEASUREMENT
 /begin OUT_MEASUREMENT Deltadff Dffgenschz Dnkw Ierrgrenz_ll Pr_ierrllred St_pgenllred St_pgenllred.B_geli St_pgenllred.B_nsubgen St_pgenllred.B_pgenllerk St_pgenllred_200ms St_pgenllred_200ms.B_dffaktiv St_pgenllred_200ms.B_nsubg_r St_pgenllred_200ms.B_nsubgen1 St_pgenllred_200ms.B_pgenllfa St_pgenllred_200ms.B_pgenredllve Tdffgen V_pgenllkor /end OUT_MEASUREMENT
/end FUNCTION
/begin FUNCTION PGENTRED ""
 /begin DEF_CHARACTERISTIC KF_IERRGREHT KF_TANSGENKO KF_UFDIODE KL_NELUEFTGE KL_RTHJADIOD KL_TCHIPOFFS KL_TMAXDIODE K_GENMXGRADH K_HTGENDFGRO K_I_VERTEIL K_NGENHTMN1 K_NGENHTMX1 K_PR_IERRTRED K_TCHIPFIL K_TDNGENKRIT K_TDTCHIPKRI K_TDTCHIPMX K_TDUBFZMN K_TFIGENHT K_TFTDIODE K_TGENMXGRAD K_TGENMXTHD K_TGENRSHT K_TLCHTEP K_UGENHTMN S_HTDETEC /end DEF_CHARACTERISTIC
 /begin REF_CHARACTERISTIC /end REF_CHARACTERISTIC
 /begin IN_MEASUREMENT /end IN_MEASUREMENT
 /begin OUT_MEASUREMENT Ierrgrenz_ht Nelueft_gen P_totdiode Pr_ierrtred St_pgenred_1s St_pgenred_1s.B_genht St_pgenred_1s.B_genhtkrit St_pgenred_1s.B_genhtkritv St_pgenred_1s.B_genhtmxgra St_pgenred_1s.B_ierrgrenzh St_pgenred_1s.B_tdiodekrit T_chipfilsdt T_diode T_diodedelta Tans_gen Tchip_fil_l Tchip_fil_s Tchip_ist Tchip_mwa Tchip_sum U_vordiode Z_tchip /end OUT_MEASUREMENT
/end FUNCTION
/begin COMPU_METHOD Def_ac_sb_q0p25 "Def_ac_sb_q0p25" RAT_FUNC "%4.1" "-" COEFFS 0 4 0 0 0 1 /end COMPU_METHOD
/begin COMPU_METHOD Def_dez_ub_q1 "Def_dez_ub_q1" RAT_FUNC "%3.0" "-" COEFFS 0 1 0 0 0 1 /end COMPU_METHOD
/begin COMPU_METHOD Def_dez_uw_q1 "Def_dez_uw_q1" RAT_FUNC "%5.0" "-" COEFFS 0 1 0 0 0 1 /end COMPU_METHOD
/begin COMPU_METHOD Def_st_ub_q1 "Def_st_ub_q1" RAT_FUNC "%3.0" "-" COEFFS 0 1 0 0 0 1 /end COMPU_METHOD
/begin COMPU_METHOD Def_dez_sw_q1 "Def_dez_sw_q1" RAT_FUNC "%5.0" "-" COEFFS 0 1 0 0 0 1 /end COMPU_METHOD
/begin COMPU_METHOD Def_f_ub_b100 "Def_f_ub_b100" RAT_FUNC "%5.2" "%" COEFFS 0 256 0 0 0 100 /end COMPU_METHOD
/begin COMPU_METHOD Def_f_uw_b2 "Def_f_uw_b2" RAT_FUNC "%14.5" "-" COEFFS 0 65536 0 0 0 2 /end COMPU_METHOD
/begin COMPU_METHOD Def_i_ub_q0p125 "Def_i_ub_q0p125" RAT_FUNC "%6.3" "A" COEFFS 0 8 0 0 0 1 /end COMPU_METHOD
/begin COMPU_METHOD Def_km_uw_q10 "Def_km_uw_q10" RAT_FUNC "%5.0" "km" COEFFS 0 1 0 0 0 10 /end COMPU_METHOD
/begin COMPU_METHOD Def_tv_ub_q0p390625 "Def_tv_ub_q0p390625" RAT_FUNC "%5.2" "%" COEFFS 0 256 0 0 0 100 /end COMPU_METHOD
/begin COMPU_METHOD Def_f_ub_b2 "Def_f_ub_b2" RAT_FUNC "%6.3" "-" COEFFS 0 256 0 0 0 2 /end COMPU_METHOD
/begin COMPU_METHOD Def_n_sw_q1p0 "Def_n_sw_q1p0" RAT_FUNC "%5.0" "Upm" COEFFS 0 1 0 0 0 1 /end COMPU_METHOD
/begin COMPU_METHOD Def_lf_ub_q0p01 "Def_lf_ub_q0p01" RAT_FUNC "%5.2" "-" COEFFS 0 100 0 0 0 1 /end COMPU_METHOD
/begin COMPU_METHOD Def_km_sw_q10 "Def_km_sw_q10" RAT_FUNC "%6.1" "km" COEFFS 0 1 0 0 0 10 /end COMPU_METHOD
/begin COMPU_METHOD Def_wdk_sw_q0p0244 "Def_wdk_sw_q0p0244" RAT_FUNC "%7.2" "%" COEFFS 0 4096 0 0 0 100 /end COMPU_METHOD
/begin COMPU_METHOD Def_bit_ub_1 "Def_bit_ub_1" TAB_VERB "%5.2" "-" COMPU_TAB_REF Def_bit_ub_1_VTAB /end COMPU_METHOD
/begin COMPU_METHOD Def_bit_ub_2 "Def_bit_ub_2" TAB_VERB "%5.2" "-" COMPU_TAB_REF Def_bit_ub_2_VTAB /end COMPU_METHOD
/begin COMPU_METHOD Def_bit_ub_0 "Def_bit_ub_0" TAB_VERB "%5.2" "-" COMPU_TAB_REF Def_bit_ub_0_VTAB /end COMPU_METHOD
/begin COMPU_METHOD Def_bit_ub_3 "Def_bit_ub_3" TAB_VERB "%5.2" "-" COMPU_TAB_REF Def_bit_ub_3_VTAB /end COMPU_METHOD
/begin COMPU_METHOD Def_bit_ub_4 "Def_bit_ub_4" TAB_VERB "%5.2" "-" COMPU_TAB_REF Def_bit_ub_4_VTAB /end COMPU_METHOD
/begin COMPU_METHOD Def_bit_ub_5 "Def_bit_ub_5" TAB_VERB "%5.2" "-" COMPU_TAB_REF Def_bit_ub_5_VTAB /end COMPU_METHOD
/begin COMPU_METHOD Def_bit_ub_6 "Def_bit_ub_6" TAB_VERB "%5.2" "-" COMPU_TAB_REF Def_bit_ub_6_VTAB /end COMPU_METHOD
/begin COMPU_METHOD Def_bit_ub_7 "Def_bit_ub_7" TAB_VERB "%5.2" "-" COMPU_TAB_REF Def_bit_ub_7_VTAB /end COMPU_METHOD
/begin COMPU_METHOD Def_t_sw_q0p1 "Def_t_sw_q0p1" RAT_FUNC "%6.1" "°C" COEFFS 0 10 0 0 0 1 /end COMPU_METHOD
/begin COMPU_METHOD Def_td_uw_q0p01 "Def_td_uw_q0p01" RAT_FUNC "%7.2" "s" COEFFS 0 100 0 0 0 1 /end COMPU_METHOD
/begin COMPU_METHOD Def_t_sw_q0p01 "Def_t_sw_q0p01" RAT_FUNC "%7.2" "°C" COEFFS 0 100 0 0 0 1 /end COMPU_METHOD
/begin COMPU_METHOD Def_tn_uw_q1 "Def_tn_uw_q1" RAT_FUNC "%7.2" "min" COEFFS 0 1 0 0 0 1 /end COMPU_METHOD
/begin COMPU_METHOD Def_u_uw_q0p0942 "Def_u_uw_q0p0942" RAT_FUNC "%6.1" "V" COEFFS 0 1 0 0 0 0.0942 /end COMPU_METHOD
/begin COMPU_METHOD Def_v_uw_q1p0 "Def_v_uw_q1p0" RAT_FUNC "%5.0" "km/h" COEFFS 0 1 0 0 0 1 /end COMPU_METHOD
/begin COMPU_METHOD Def_v_uw_q0p1 "Def_v_uw_q0p1" RAT_FUNC "%7.2" "km/h" COEFFS 0 10 0 0 0 1 /end COMPU_METHOD
/begin COMPU_METHOD Def_bit_ub_0 "Def_bit_ub_0" TAB_VERB "%5.2" "-" COMPU_TAB_REF Def_bit_ub_0_VTAB /end COMPU_METHOD
/begin COMPU_METHOD Def_bit_ub_1 "Def_bit_ub_1" TAB_VERB "%5.2" "-" COMPU_TAB_REF Def_bit_ub_1_VTAB /end COMPU_METHOD
/begin COMPU_METHOD Def_bit_ub_2 "Def_bit_ub_2" TAB_VERB "%5.2" "-" COMPU_TAB_REF Def_bit_ub_2_VTAB /end COMPU_METHOD
/begin COMPU_METHOD Def_bit_ub_3 "Def_bit_ub_3" TAB_VERB "%5.2" "-" COMPU_TAB_REF Def_bit_ub_3_VTAB /end COMPU_METHOD
/begin COMPU_METHOD Def_st_ub_q1 "Def_st_ub_q1" RAT_FUNC "%3.0" "-" COEFFS 0 1 0 0 0 1 /end COMPU_METHOD
/begin COMPU_METHOD Def_wdk_sw_q0p0244 "Def_wdk_sw_q0p0244" RAT_FUNC "%7.2" "%" COEFFS 0 4096 0 0 0 100 /end COMPU_METHOD
/begin COMPU_METHOD Def_v_uw_q1p0 "Def_v_uw_q1p0" RAT_FUNC "%5.0" "km/h" COEFFS 0 1 0 0 0 1 /end COMPU_METHOD
/begin COMPU_METHOD Def_bit_ub_0 "Def_bit_ub_0" TAB_VERB "%5.2" "-" COMPU_TAB_REF Def_bit_ub_0_VTAB /end COMPU_METHOD
/begin COMPU_METHOD Def_st_ub_q1 "Def_st_ub_q1" RAT_FUNC "%3.0" "-" COEFFS 0 1 0 0 0 1 /end COMPU_METHOD
/begin COMPU_METHOD Def_dez_ub_q1 "Def_dez_ub_q1" RAT_FUNC "%3.0" "-" COEFFS 0 1 0 0 0 1 /end COMPU_METHOD
/begin COMPU_METHOD Def_t_sw_q0p1 "Def_t_sw_q0p1" RAT_FUNC "%6.1" "°C" COEFFS 0 10 0 0 0 1 /end COMPU_METHOD
/begin COMPU_METHOD Def_t_sw_q0p01 "Def_t_sw_q0p01" RAT_FUNC "%7.2" "°C" COEFFS 0 100 0 0 0 1 /end COMPU_METHOD
/begin COMPU_METHOD Def_bit_ub_0 "Def_bit_ub_0" TAB_VERB "%5.2" "-" COMPU_TAB_REF Def_bit_ub_0_VTAB /end COMPU_METHOD
/begin COMPU_METHOD Def_bit_ub_1 "Def_bit_ub_1" TAB_VERB "%5.2" "-" COMPU_TAB_REF Def_bit_ub_1_VTAB /end COMPU_METHOD
/begin COMPU_METHOD Def_bit_ub_2 "Def_bit_ub_2" TAB_VERB "%5.2" "-" COMPU_TAB_REF Def_bit_ub_2_VTAB /end COMPU_METHOD
/begin COMPU_METHOD Def_st_ub_q1 "Def_st_ub_q1" RAT_FUNC "%3.0" "-" COEFFS 0 1 0 0 0 1 /end COMPU_METHOD
/begin COMPU_METHOD Def_bit_ub_3 "Def_bit_ub_3" TAB_VERB "%5.2" "-" COMPU_TAB_REF Def_bit_ub_3_VTAB /end COMPU_METHOD
/begin COMPU_METHOD Def_bit_ub_4 "Def_bit_ub_4" TAB_VERB "%5.2" "-" COMPU_TAB_REF Def_bit_ub_4_VTAB /end COMPU_METHOD
/begin COMPU_METHOD Def_bit_ub_5 "Def_bit_ub_5" TAB_VERB "%5.2" "-" COMPU_TAB_REF Def_bit_ub_5_VTAB /end COMPU_METHOD
/begin COMPU_METHOD Def_bit_ub_6 "Def_bit_ub_6" TAB_VERB "%5.2" "-" COMPU_TAB_REF Def_bit_ub_6_VTAB /end COMPU_METHOD
/begin COMPU_METHOD Def_bit_ub_7 "Def_bit_ub_7" TAB_VERB "%5.2" "-" COMPU_TAB_REF Def_bit_ub_7_VTAB /end COMPU_METHOD
/begin COMPU_METHOD Def_v_uw_q1p0 "Def_v_uw_q1p0" RAT_FUNC "%5.0" "km/h" COEFFS 0 1 0 0 0 1 /end COMPU_METHOD
/begin COMPU_METHOD Def_n_sw_q1p0 "Def_n_sw_q1p0" RAT_FUNC "%5.0" "Upm" COEFFS 0 1 0 0 0 1 /end COMPU_METHOD
/begin COMPU_METHOD Def_dez_ub_q1 "Def_dez_ub_q1" RAT_FUNC "%3.0" "-" COEFFS 0 1 0 0 0 1 /end COMPU_METHOD
/begin COMPU_METHOD Def_bit_ub_0 "Def_bit_ub_0" TAB_VERB "%5.2" "-" COMPU_TAB_REF Def_bit_ub_0_VTAB /end COMPU_METHOD
/begin COMPU_METHOD Def_bit_ub_1 "Def_bit_ub_1" TAB_VERB "%5.2" "-" COMPU_TAB_REF Def_bit_ub_1_VTAB /end COMPU_METHOD
/begin COMPU_METHOD Def_bit_ub_2 "Def_bit_ub_2" TAB_VERB "%5.2" "-" COMPU_TAB_REF Def_bit_ub_2_VTAB /end COMPU_METHOD
/begin COMPU_METHOD Def_st_ub_q1 "Def_st_ub_q1" RAT_FUNC "%3.0" "-" COEFFS 0 1 0 0 0 1 /end COMPU_METHOD
/begin COMPU_METHOD Def_dez_ub_q1 "Def_dez_ub_q1" RAT_FUNC "%3.0" "-" COEFFS 0 1 0 0 0 1 /end COMPU_METHOD
/begin COMPU_METHOD Def_wdk_sw_q0p0244 "Def_wdk_sw_q0p0244" RAT_FUNC "%7.2" "%" COEFFS 0 4096 0 0 0 100 /end COMPU_METHOD
/begin COMPU_METHOD Def_v_uw_q1p0 "Def_v_uw_q1p0" RAT_FUNC "%5.0" "km/h" COEFFS 0 1 0 0 0 1 /end COMPU_METHOD
/begin COMPU_METHOD Def_bit_ub_0 "Def_bit_ub_0" TAB_VERB "%5.2" "-" COMPU_TAB_REF Def_bit_ub_0_VTAB /end COMPU_METHOD
/begin COMPU_METHOD Def_bit_ub_1 "Def_bit_ub_1" TAB_VERB "%5.2" "-" COMPU_TAB_REF Def_bit_ub_1_VTAB /end COMPU_METHOD
/begin COMPU_METHOD Def_st_ub_q1 "Def_st_ub_q1" RAT_FUNC "%3.0" "-" COEFFS 0 1 0 0 0 1 /end COMPU_METHOD
/begin COMPU_METHOD Def_bit_ub_0 "Def_bit_ub_0" TAB_VERB "%5.2" "-" COMPU_TAB_REF Def_bit_ub_0_VTAB /end COMPU_METHOD
/begin COMPU_METHOD Def_bit_ub_1 "Def_bit_ub_1" TAB_VERB "%5.2" "-" COMPU_TAB_REF Def_bit_ub_1_VTAB /end COMPU_METHOD
/begin COMPU_METHOD Def_st_ub_q1 "Def_st_ub_q1" RAT_FUNC "%3.0" "-" COEFFS 0 1 0 0 0 1 /end COMPU_METHOD
/begin COMPU_METHOD Def_dez_ub_q1 "Def_dez_ub_q1" RAT_FUNC "%3.0" "-" COEFFS 0 1 0 0 0 1 /end COMPU_METHOD
/begin COMPU_METHOD Def_u_uw_q0p0942 "Def_u_uw_q0p0942" RAT_FUNC "%6.1" "V" COEFFS 0 1 0 0 0 0.0942 /end COMPU_METHOD
/begin COMPU_METHOD Def_t_sw_q0p1 "Def_t_sw_q0p1" RAT_FUNC "%6.1" "°C" COEFFS 0 10 0 0 0 1 /end COMPU_METHOD
/begin COMPU_METHOD Def_u_uw_q0p0942 "Def_u_uw_q0p0942" RAT_FUNC "%6.1" "V" COEFFS 0 1 0 0 0 0.0942 /end COMPU_METHOD
/begin COMPU_METHOD Def_f_ub_b8 "Def_f_ub_b8" RAT_FUNC "%5.2" "-" COEFFS 0 256 0 0 0 8 /end COMPU_METHOD
/begin COMPU_METHOD Def_v_uw_q1p0 "Def_v_uw_q1p0" RAT_FUNC "%5.0" "km/h" COEFFS 0 1 0 0 0 1 /end COMPU_METHOD
/begin COMPU_METHOD Def_tv_ub_q0p390625 "Def_tv_ub_q0p390625" RAT_FUNC "%5.2" "%" COEFFS 0 256 0 0 0 100 /end COMPU_METHOD
/begin COMPU_METHOD Def_bit_ub_0 "Def_bit_ub_0" TAB_VERB "%5.2" "-" COMPU_TAB_REF Def_bit_ub_0_VTAB /end COMPU_METHOD
/begin COMPU_METHOD Def_st_ub_q1 "Def_st_ub_q1" RAT_FUNC "%3.0" "-" COEFFS 0 1 0 0 0 1 /end COMPU_METHOD
/begin COMPU_METHOD Def_n_sw_q1p0 "Def_n_sw_q1p0" RAT_FUNC "%5.0" "Upm" COEFFS 0 1 0 0 0 1 /end COMPU_METHOD
/begin COMPU_METHOD Def_f_ub_b100 "Def_f_ub_b100" RAT_FUNC "%5.2" "%" COEFFS 0 256 0 0 0 100 /end COMPU_METHOD
/begin COMPU_METHOD Def_i_ub_q0p125 "Def_i_ub_q0p125" RAT_FUNC "%6.3" "A" COEFFS 0 8 0 0 0 1 /end COMPU_METHOD
/begin COMPU_METHOD Def_f_ub_b1 "Def_f_ub_b1" RAT_FUNC "%6.3" "-" COEFFS 0 256 0 0 0 1 /end COMPU_METHOD
/begin COMPU_METHOD Def_t_sw_q0p1 "Def_t_sw_q0p1" RAT_FUNC "%6.1" "°C" COEFFS 0 10 0 0 0 1 /end COMPU_METHOD
/begin COMPU_METHOD Def_t_sw_q0p01 "Def_t_sw_q0p01" RAT_FUNC "%7.2" "°C" COEFFS 0 100 0 0 0 1 /end COMPU_METHOD
/begin COMPU_METHOD Def_dez_uw_q1 "Def_dez_uw_q1" RAT_FUNC "%5.0" "-" COEFFS 0 1 0 0 0 1 /end COMPU_METHOD
/begin COMPU_METHOD Def_dez_ub_q1 "Def_dez_ub_q1" RAT_FUNC "%3.0" "-" COEFFS 0 1 0 0 0 1 /end COMPU_METHOD
/begin COMPU_METHOD Def_f_ub_b1 "Def_f_ub_b1" RAT_FUNC "%6.3" "-" COEFFS 0 256 0 0 0 1 /end COMPU_METHOD
/begin COMPU_METHOD Def_n_sw_q1p0 "Def_n_sw_q1p0" RAT_FUNC "%5.0" "Upm" COEFFS 0 1 0 0 0 1 /end COMPU_METHOD
/begin COMPU_METHOD Def_bit_ub_0 "Def_bit_ub_0" TAB_VERB "%5.2" "-" COMPU_TAB_REF Def_bit_ub_0_VTAB /end COMPU_METHOD
/begin COMPU_METHOD Def_bit_ub_1 "Def_bit_ub_1" TAB_VERB "%5.2" "-" COMPU_TAB_REF Def_bit_ub_1_VTAB /end COMPU_METHOD
/begin COMPU_METHOD Def_bit_ub_2 "Def_bit_ub_2" TAB_VERB "%5.2" "-" COMPU_TAB_REF Def_bit_ub_2_VTAB /end COMPU_METHOD
/begin COMPU_METHOD Def_bit_ub_3 "Def_bit_ub_3" TAB_VERB "%5.2" "-" COMPU_TAB_REF Def_bit_ub_3_VTAB /end COMPU_METHOD
/begin COMPU_METHOD Def_bit_ub_4 "Def_bit_ub_4" TAB_VERB "%5.2" "-" COMPU_TAB_REF Def_bit_ub_4_VTAB /end COMPU_METHOD
/begin COMPU_METHOD Def_bit_ub_5 "Def_bit_ub_5" TAB_VERB "%5.2" "-" COMPU_TAB_REF Def_bit_ub_5_VTAB /end COMPU_METHOD
/begin COMPU_METHOD Def_bit_ub_6 "Def_bit_ub_6" TAB_VERB "%5.2" "-" COMPU_TAB_REF Def_bit_ub_6_VTAB /end COMPU_METHOD
/begin COMPU_METHOD Def_bit_ub_7 "Def_bit_ub_7" TAB_VERB "%5.2" "-" COMPU_TAB_REF Def_bit_ub_7_VTAB /end COMPU_METHOD
/begin COMPU_METHOD Def_st_ub_q1 "Def_st_ub_q1" RAT_FUNC "%3.0" "-" COEFFS 0 1 0 0 0 1 /end COMPU_METHOD
/begin COMPU_METHOD Identity "Identity" RAT_FUNC "%3.0" "-" COEFFS 0 1 0 0 0 1 /end COMPU_METHOD
/begin COMPU_METHOD Def_bit_ub_0 "Def_bit_ub_0" TAB_VERB "%5.2" "-" COMPU_TAB_REF Def_bit_ub_0_VTAB /end COMPU_METHOD
/begin COMPU_METHOD Def_bit_ub_1 "Def_bit_ub_1" TAB_VERB "%5.2" "-" COMPU_TAB_REF Def_bit_ub_1_VTAB /end COMPU_METHOD
/begin COMPU_METHOD Def_bit_ub_2 "Def_bit_ub_2" TAB_VERB "%5.2" "-" COMPU_TAB_REF Def_bit_ub_2_VTAB /end COMPU_METHOD
/begin COMPU_METHOD Def_bit_ub_3 "Def_bit_ub_3" TAB_VERB "%5.2" "-" COMPU_TAB_REF Def_bit_ub_3_VTAB /end COMPU_METHOD
/begin COMPU_METHOD Def_bit_ub_4 "Def_bit_ub_4" TAB_VERB "%5.2" "-" COMPU_TAB_REF Def_bit_ub_4_VTAB /end COMPU_METHOD
/begin COMPU_METHOD Def_bit_ub_5 "Def_bit_ub_5" TAB_VERB "%5.2" "-" COMPU_TAB_REF Def_bit_ub_5_VTAB /end COMPU_METHOD
/begin COMPU_METHOD Def_bit_ub_6 "Def_bit_ub_6" TAB_VERB "%5.2" "-" COMPU_TAB_REF Def_bit_ub_6_VTAB /end COMPU_METHOD
/begin COMPU_METHOD Def_bit_ub_7 "Def_bit_ub_7" TAB_VERB "%5.2" "-" COMPU_TAB_REF Def_bit_ub_7_VTAB /end COMPU_METHOD
/begin COMPU_METHOD Def_st_ub_q1 "Def_st_ub_q1" RAT_FUNC "%3.0" "-" COEFFS 0 1 0 0 0 1 /end COMPU_METHOD
/begin COMPU_METHOD Def_n_sw_q1p0 "Def_n_sw_q1p0" RAT_FUNC "%5.0" "Upm" COEFFS 0 1 0 0 0 1 /end COMPU_METHOD
/begin COMPU_METHOD Def_u_uw_q0p0942 "Def_u_uw_q0p0942" RAT_FUNC "%6.1" "V" COEFFS 0 1 0 0 0 0.0942 /end COMPU_METHOD
/begin COMPU_METHOD Identity "Identity" RAT_FUNC "%3.0" "-" COEFFS 0 1 0 0 0 1 /end COMPU_METHOD
/begin COMPU_METHOD Def_bit_ub_2 "Def_bit_ub_2" TAB_VERB "%5.2" "-" COMPU_TAB_REF Def_bit_ub_2_VTAB /end COMPU_METHOD
/begin COMPU_METHOD Def_bit_ub_3 "Def_bit_ub_3" TAB_VERB "%5.2" "-" COMPU_TAB_REF Def_bit_ub_3_VTAB /end COMPU_METHOD
/begin COMPU_METHOD Def_bit_ub_4 "Def_bit_ub_4" TAB_VERB "%5.2" "-" COMPU_TAB_REF Def_bit_ub_4_VTAB /end COMPU_METHOD
/begin COMPU_METHOD Def_st_ub_q1 "Def_st_ub_q1" RAT_FUNC "%3.0" "-" COEFFS 0 1 0 0 0 1 /end COMPU_METHOD
/begin COMPU_METHOD Def_bit_ub_0 "Def_bit_ub_0" TAB_VERB "%5.2" "-" COMPU_TAB_REF Def_bit_ub_0_VTAB /end COMPU_METHOD
/begin COMPU_METHOD Def_bit_ub_1 "Def_bit_ub_1" TAB_VERB "%5.2" "-" COMPU_TAB_REF Def_bit_ub_1_VTAB /end COMPU_METHOD
/begin COMPU_METHOD Def_bit_ub_5 "Def_bit_ub_5" TAB_VERB "%5.2" "-" COMPU_TAB_REF Def_bit_ub_5_VTAB /end COMPU_METHOD
/begin COMPU_METHOD Def_dez_uw_q1 "Def_dez_uw_q1" RAT_FUNC "%5.0" "-" COEFFS 0 1 0 0 0 1 /end COMPU_METHOD
/begin COMPU_METHOD Def_dez_ub_q1 "Def_dez_ub_q1" RAT_FUNC "%3.0" "-" COEFFS 0 1 0 0 0 1 /end COMPU_METHOD
/begin COMPU_METHOD Identity "Identity" RAT_FUNC "%3.0" "-" COEFFS 0 1 0 0 0 1 /end COMPU_METHOD
/begin COMPU_METHOD Def_bit_ub_0 "Def_bit_ub_0" TAB_VERB "%5.2" "-" COMPU_TAB_REF Def_bit_ub_0_VTAB /end COMPU_METHOD
/begin COMPU_METHOD Def_bit_ub_1 "Def_bit_ub_1" TAB_VERB "%5.2" "-" COMPU_TAB_REF Def_bit_ub_1_VTAB /end COMPU_METHOD
/begin COMPU_METHOD Def_bit_ub_2 "Def_bit_ub_2" TAB_VERB "%5.2" "-" COMPU_TAB_REF Def_bit_ub_2_VTAB /end COMPU_METHOD
/begin COMPU_METHOD Def_bit_ub_3 "Def_bit_ub_3" TAB_VERB "%5.2" "-" COMPU_TAB_REF Def_bit_ub_3_VTAB /end COMPU_METHOD
/begin COMPU_METHOD Def_bit_ub_4 "Def_bit_ub_4" TAB_VERB "%5.2" "-" COMPU_TAB_REF Def_bit_ub_4_VTAB /end COMPU_METHOD
/begin COMPU_METHOD Def_bit_ub_5 "Def_bit_ub_5" TAB_VERB "%5.2" "-" COMPU_TAB_REF Def_bit_ub_5_VTAB /end COMPU_METHOD
/begin COMPU_METHOD Def_bit_ub_6 "Def_bit_ub_6" TAB_VERB "%5.2" "-" COMPU_TAB_REF Def_bit_ub_6_VTAB /end COMPU_METHOD
/begin COMPU_METHOD Def_bit_ub_7 "Def_bit_ub_7" TAB_VERB "%5.2" "-" COMPU_TAB_REF Def_bit_ub_7_VTAB /end COMPU_METHOD
/begin COMPU_METHOD Def_st_ub_q1 "Def_st_ub_q1" RAT_FUNC "%3.0" "-" COEFFS 0 1 0 0 0 1 /end COMPU_METHOD
/begin COMPU_METHOD Def_dez_ub_q1 "Def_dez_ub_q1" RAT_FUNC "%3.0" "-" COEFFS 0 1 0 0 0 1 /end COMPU_METHOD
/begin COMPU_METHOD Def_dez_uw_q1 "Def_dez_uw_q1" RAT_FUNC "%5.0" "-" COEFFS 0 1 0 0 0 1 /end COMPU_METHOD
/begin COMPU_METHOD Def_n_sw_q1p0 "Def_n_sw_q1p0" RAT_FUNC "%5.0" "Upm" COEFFS 0 1 0 0 0 1 /end COMPU_METHOD
/begin COMPU_METHOD Def_t_sw_q0p1 "Def_t_sw_q0p1" RAT_FUNC "%6.1" "°C" COEFFS 0 10 0 0 0 1 /end COMPU_METHOD
/begin COMPU_METHOD Def_u_uw_q0p0942 "Def_u_uw_q0p0942" RAT_FUNC "%6.1" "V" COEFFS 0 1 0 0 0 0.0942 /end COMPU_METHOD
/begin COMPU_METHOD Def_td_uw_q0p01 "Def_td_uw_q0p01" RAT_FUNC "%7.2" "s" COEFFS 0 100 0 0 0 1 /end COMPU_METHOD
/begin COMPU_METHOD Def_bit_ub_0 "Def_bit_ub_0" TAB_VERB "%5.2" "-" COMPU_TAB_REF Def_bit_ub_0_VTAB /end COMPU_METHOD
/begin COMPU_METHOD Def_bit_ub_1 "Def_bit_ub_1" TAB_VERB "%5.2" "-" COMPU_TAB_REF Def_bit_ub_1_VTAB /end COMPU_METHOD
/begin COMPU_METHOD Def_bit_ub_3 "Def_bit_ub_3" TAB_VERB "%5.2" "-" COMPU_TAB_REF Def_bit_ub_3_VTAB /end COMPU_METHOD
/begin COMPU_METHOD Def_bit_ub_5 "Def_bit_ub_5" TAB_VERB "%5.2" "-" COMPU_TAB_REF Def_bit_ub_5_VTAB /end COMPU_METHOD
/begin COMPU_METHOD Def_bit_ub_6 "Def_bit_ub_6" TAB_VERB "%5.2" "-" COMPU_TAB_REF Def_bit_ub_6_VTAB /end COMPU_METHOD
/begin COMPU_METHOD Def_bit_ub_7 "Def_bit_ub_7" TAB_VERB "%5.2" "-" COMPU_TAB_REF Def_bit_ub_7_VTAB /end COMPU_METHOD
/begin COMPU_METHOD Def_st_ub_q1 "Def_st_ub_q1" RAT_FUNC "%3.0" "-" COEFFS 0 1 0 0 0 1 /end COMPU_METHOD
/begin COMPU_METHOD Def_bit_ub_2 "Def_bit_ub_2" TAB_VERB "%5.2" "-" COMPU_TAB_REF Def_bit_ub_2_VTAB /end COMPU_METHOD
/begin COMPU_METHOD Def_bit_ub_4 "Def_bit_ub_4" TAB_VERB "%5.2" "-" COMPU_TAB_REF Def_bit_ub_4_VTAB /end COMPU_METHOD
/begin COMPU_METHOD Def_dez_ub_q1 "Def_dez_ub_q1" RAT_FUNC "%3.0" "-" COEFFS 0 1 0 0 0 1 /end COMPU_METHOD
/begin COMPU_METHOD Def_n_sw_q1p0 "Def_n_sw_q1p0" RAT_FUNC "%5.0" "Upm" COEFFS 0 1 0 0 0 1 /end COMPU_METHOD
/begin COMPU_METHOD Def_wdk_sw_q0p0244 "Def_wdk_sw_q0p0244" RAT_FUNC "%7.2" "%" COEFFS 0 4096 0 0 0 100 /end COMPU_METHOD
/begin COMPU_METHOD Def_dez_uw_q1 "Def_dez_uw_q1" RAT_FUNC "%5.0" "-" COEFFS 0 1 0 0 0 1 /end COMPU_METHOD
/begin COMPU_METHOD Def_v_uw_q1p0 "Def_v_uw_q1p0" RAT_FUNC "%5.0" "km/h" COEFFS 0 1 0 0 0 1 /end COMPU_METHOD
/begin COMPU_METHOD Identity "Identity" RAT_FUNC "%3.0" "-" COEFFS 0 1 0 0 0 1 /end COMPU_METHOD
/begin COMPU_METHOD Def_t_sw_q0p01 "Def_t_sw_q0p01" RAT_FUNC "%7.2" "°C" COEFFS 0 100 0 0 0 1 /end COMPU_METHOD
/begin COMPU_METHOD Def_dez_sw_q1 "Def_dez_sw_q1" RAT_FUNC "%5.0" "-" COEFFS 0 1 0 0 0 1 /end COMPU_METHOD
/begin COMPU_METHOD Def_bit_ub_0 "Def_bit_ub_0" TAB_VERB "%5.2" "-" COMPU_TAB_REF Def_bit_ub_0_VTAB /end COMPU_METHOD
/begin COMPU_METHOD Def_bit_ub_1 "Def_bit_ub_1" TAB_VERB "%5.2" "-" COMPU_TAB_REF Def_bit_ub_1_VTAB /end COMPU_METHOD
/begin COMPU_METHOD Def_bit_ub_2 "Def_bit_ub_2" TAB_VERB "%5.2" "-" COMPU_TAB_REF Def_bit_ub_2_VTAB /end COMPU_METHOD
/begin COMPU_METHOD Def_bit_ub_4 "Def_bit_ub_4" TAB_VERB "%5.2" "-" COMPU_TAB_REF Def_bit_ub_4_VTAB /end COMPU_METHOD
/begin COMPU_METHOD Def_bit_ub_5 "Def_bit_ub_5" TAB_VERB "%5.2" "-" COMPU_TAB_REF Def_bit_ub_5_VTAB /end COMPU_METHOD
/begin COMPU_METHOD Def_st_ub_q1 "Def_st_ub_q1" RAT_FUNC "%3.0" "-" COEFFS 0 1 0 0 0 1 /end COMPU_METHOD
/begin COMPU_METHOD Def_dez_uw_q1 "Def_dez_uw_q1" RAT_FUNC "%5.0" "-" COEFFS 0 1 0 0 0 1 /end COMPU_METHOD
/begin COMPU_METHOD Def_dez_ub_q1 "Def_dez_ub_q1" RAT_FUNC "%3.0" "-" COEFFS 0 1 0 0 0 1 /end COMPU_METHOD
/begin COMPU_METHOD Def_u_uw_q0p00488 "Def_u_uw_q0p00488" RAT_FUNC "%8.3" "V" COEFFS 0 1024 0 0 0 5 /end COMPU_METHOD
/begin COMPU_METHOD Def_f_uw_b2 "Def_f_uw_b2" RAT_FUNC "%14.5" "-" COEFFS 0 65536 0 0 0 2 /end COMPU_METHOD
/begin COMPU_METHOD Def_f_uw_b100 "Def_f_uw_b100" RAT_FUNC "%8.3" "%" COEFFS 0 65536 0 0 0 100 /end COMPU_METHOD
/begin COMPU_METHOD Def_n_sw_q1p0 "Def_n_sw_q1p0" RAT_FUNC "%5.0" "Upm" COEFFS 0 1 0 0 0 1 /end COMPU_METHOD
/begin COMPU_METHOD Identity "Identity" RAT_FUNC "%3.0" "-" COEFFS 0 1 0 0 0 1 /end COMPU_METHOD
/begin COMPU_METHOD Def_f_ub_b2 "Def_f_ub_b2" RAT_FUNC "%6.3" "-" COEFFS 0 256 0 0 0 2 /end COMPU_METHOD
/begin COMPU_METHOD Def_f_ub_b32 "Def_f_ub_b32" RAT_FUNC "%5.2" "-" COEFFS 0 256 0 0 0 32 /end COMPU_METHOD
/begin COMPU_METHOD Def_bit_ub_0 "Def_bit_ub_0" TAB_VERB "%5.2" "-" COMPU_TAB_REF Def_bit_ub_0_VTAB /end COMPU_METHOD
/begin COMPU_METHOD Def_st_ub_q1 "Def_st_ub_q1" RAT_FUNC "%3.0" "-" COEFFS 0 1 0 0 0 1 /end COMPU_METHOD
/begin COMPU_METHOD Def_dez_ub_q1 "Def_dez_ub_q1" RAT_FUNC "%3.0" "-" COEFFS 0 1 0 0 0 1 /end COMPU_METHOD
/begin COMPU_METHOD Def_bit_ub_0 "Def_bit_ub_0" TAB_VERB "%5.2" "-" COMPU_TAB_REF Def_bit_ub_0_VTAB /end COMPU_METHOD
/begin COMPU_METHOD Def_bit_ub_1 "Def_bit_ub_1" TAB_VERB "%5.2" "-" COMPU_TAB_REF Def_bit_ub_1_VTAB /end COMPU_METHOD
/begin COMPU_METHOD Def_bit_ub_2 "Def_bit_ub_2" TAB_VERB "%5.2" "-" COMPU_TAB_REF Def_bit_ub_2_VTAB /end COMPU_METHOD
/begin COMPU_METHOD Def_bit_ub_3 "Def_bit_ub_3" TAB_VERB "%5.2" "-" COMPU_TAB_REF Def_bit_ub_3_VTAB /end COMPU_METHOD
/begin COMPU_METHOD Def_bit_ub_4 "Def_bit_ub_4" TAB_VERB "%5.2" "-" COMPU_TAB_REF Def_bit_ub_4_VTAB /end COMPU_METHOD
/begin COMPU_METHOD Def_st_ub_q1 "Def_st_ub_q1" RAT_FUNC "%3.0" "-" COEFFS 0 1 0 0 0 1 /end COMPU_METHOD
/begin COMPU_METHOD Def_dez_ub_q1 "Def_dez_ub_q1" RAT_FUNC "%3.0" "-" COEFFS 0 1 0 0 0 1 /end COMPU_METHOD
/begin COMPU_METHOD Def_u_uw_q0p00488 "Def_u_uw_q0p00488" RAT_FUNC "%8.3" "V" COEFFS 0 1024 0 0 0 5 /end COMPU_METHOD
/begin COMPU_METHOD Def_f_ub_b100 "Def_f_ub_b100" RAT_FUNC "%5.2" "%" COEFFS 0 256 0 0 0 100 /end COMPU_METHOD
/begin COMPU_METHOD Def_bit_ub_0 "Def_bit_ub_0" TAB_VERB "%5.2" "-" COMPU_TAB_REF Def_bit_ub_0_VTAB /end COMPU_METHOD
/begin COMPU_METHOD Def_bit_ub_1 "Def_bit_ub_1" TAB_VERB "%5.2" "-" COMPU_TAB_REF Def_bit_ub_1_VTAB /end COMPU_METHOD
/begin COMPU_METHOD Def_bit_ub_2 "Def_bit_ub_2" TAB_VERB "%5.2" "-" COMPU_TAB_REF Def_bit_ub_2_VTAB /end COMPU_METHOD
/begin COMPU_METHOD Def_bit_ub_3 "Def_bit_ub_3" TAB_VERB "%5.2" "-" COMPU_TAB_REF Def_bit_ub_3_VTAB /end COMPU_METHOD
/begin COMPU_METHOD Def_bit_ub_4 "Def_bit_ub_4" TAB_VERB "%5.2" "-" COMPU_TAB_REF Def_bit_ub_4_VTAB /end COMPU_METHOD
/begin COMPU_METHOD Def_bit_ub_5 "Def_bit_ub_5" TAB_VERB "%5.2" "-" COMPU_TAB_REF Def_bit_ub_5_VTAB /end COMPU_METHOD
/begin COMPU_METHOD Def_bit_ub_6 "Def_bit_ub_6" TAB_VERB "%5.2" "-" COMPU_TAB_REF Def_bit_ub_6_VTAB /end COMPU_METHOD
/begin COMPU_METHOD Def_bit_ub_7 "Def_bit_ub_7" TAB_VERB "%5.2" "-" COMPU_TAB_REF Def_bit_ub_7_VTAB /end COMPU_METHOD
/begin COMPU_METHOD Def_st_ub_q1 "Def_st_ub_q1" RAT_FUNC "%3.0" "-" COEFFS 0 1 0 0 0 1 /end COMPU_METHOD
/begin COMPU_METHOD Def_dez_ub_q1 "Def_dez_ub_q1" RAT_FUNC "%3.0" "-" COEFFS 0 1 0 0 0 1 /end COMPU_METHOD
/begin COMPU_METHOD Def_f_ub_b100 "Def_f_ub_b100" RAT_FUNC "%5.2" "%" COEFFS 0 256 0 0 0 100 /end COMPU_METHOD
/begin COMPU_METHOD Def_f_ub_b4 "Def_f_ub_b4" RAT_FUNC "%5.2" "-" COEFFS 0 256 0 0 0 4 /end COMPU_METHOD
/begin COMPU_METHOD Def_bit_ub_0 "Def_bit_ub_0" TAB_VERB "%5.2" "-" COMPU_TAB_REF Def_bit_ub_0_VTAB /end COMPU_METHOD
/begin COMPU_METHOD Def_bit_ub_1 "Def_bit_ub_1" TAB_VERB "%5.2" "-" COMPU_TAB_REF Def_bit_ub_1_VTAB /end COMPU_METHOD
/begin COMPU_METHOD Def_st_ub_q1 "Def_st_ub_q1" RAT_FUNC "%3.0" "-" COEFFS 0 1 0 0 0 1 /end COMPU_METHOD
/begin COMPU_METHOD Def_v_uw_q1p0 "Def_v_uw_q1p0" RAT_FUNC "%5.0" "km/h" COEFFS 0 1 0 0 0 1 /end COMPU_METHOD
/begin COMPU_METHOD Identity "Identity" RAT_FUNC "%3.0" "-" COEFFS 0 1 0 0 0 1 /end COMPU_METHOD
/begin COMPU_METHOD Def_bit_ub_1 "Def_bit_ub_1" TAB_VERB "%5.2" "-" COMPU_TAB_REF Def_bit_ub_1_VTAB /end COMPU_METHOD
/begin COMPU_METHOD Def_bit_ub_2 "Def_bit_ub_2" TAB_VERB "%5.2" "-" COMPU_TAB_REF Def_bit_ub_2_VTAB /end COMPU_METHOD
/begin COMPU_METHOD Def_bit_ub_3 "Def_bit_ub_3" TAB_VERB "%5.2" "-" COMPU_TAB_REF Def_bit_ub_3_VTAB /end COMPU_METHOD
/begin COMPU_METHOD Def_st_ub_q1 "Def_st_ub_q1" RAT_FUNC "%3.0" "-" COEFFS 0 1 0 0 0 1 /end COMPU_METHOD
/begin COMPU_METHOD Def_bit_ub_0 "Def_bit_ub_0" TAB_VERB "%5.2" "-" COMPU_TAB_REF Def_bit_ub_0_VTAB /end COMPU_METHOD
/begin COMPU_METHOD Def_t_sw_q0p1 "Def_t_sw_q0p1" RAT_FUNC "%6.1" "°C" COEFFS 0 10 0 0 0 1 /end COMPU_METHOD
/begin COMPU_METHOD Def_n_sw_q1p0 "Def_n_sw_q1p0" RAT_FUNC "%5.0" "Upm" COEFFS 0 1 0 0 0 1 /end COMPU_METHOD
/begin COMPU_METHOD Def_f_uw_b100 "Def_f_uw_b100" RAT_FUNC "%8.3" "%" COEFFS 0 65536 0 0 0 100 /end COMPU_METHOD
/begin COMPU_METHOD Def_f_ub_b4 "Def_f_ub_b4" RAT_FUNC "%5.2" "-" COEFFS 0 256 0 0 0 4 /end COMPU_METHOD
/begin COMPU_METHOD Def_f_ub_b100 "Def_f_ub_b100" RAT_FUNC "%5.2" "%" COEFFS 0 256 0 0 0 100 /end COMPU_METHOD
/begin COMPU_METHOD Def_td_uw_q0p01 "Def_td_uw_q0p01" RAT_FUNC "%7.2" "s" COEFFS 0 100 0 0 0 1 /end COMPU_METHOD
/begin COMPU_METHOD Def_f_ub_b1 "Def_f_ub_b1" RAT_FUNC "%6.3" "-" COEFFS 0 256 0 0 0 1 /end COMPU_METHOD
/begin COMPU_METHOD Def_f_uw_b1 "Def_f_uw_b1" RAT_FUNC "%14.5" "-" COEFFS 0 65536 0 0 0 1 /end COMPU_METHOD
/begin COMPU_METHOD Def_bit_ub_0 "Def_bit_ub_0" TAB_VERB "%5.2" "-" COMPU_TAB_REF Def_bit_ub_0_VTAB /end COMPU_METHOD
/begin COMPU_METHOD Def_bit_ub_1 "Def_bit_ub_1" TAB_VERB "%5.2" "-" COMPU_TAB_REF Def_bit_ub_1_VTAB /end COMPU_METHOD
/begin COMPU_METHOD Def_st_ub_q1 "Def_st_ub_q1" RAT_FUNC "%3.0" "-" COEFFS 0 1 0 0 0 1 /end COMPU_METHOD
/begin COMPU_METHOD Def_dez_ub_q1 "Def_dez_ub_q1" RAT_FUNC "%3.0" "-" COEFFS 0 1 0 0 0 1 /end COMPU_METHOD
/begin COMPU_METHOD Def_n_sw_q1p0 "Def_n_sw_q1p0" RAT_FUNC "%5.0" "Upm" COEFFS 0 1 0 0 0 1 /end COMPU_METHOD
/begin COMPU_METHOD Def_f_uw_b2 "Def_f_uw_b2" RAT_FUNC "%14.5" "-" COEFFS 0 65536 0 0 0 2 /end COMPU_METHOD
/begin COMPU_METHOD Def_td_uw_q0p01 "Def_td_uw_q0p01" RAT_FUNC "%7.2" "s" COEFFS 0 100 0 0 0 1 /end COMPU_METHOD
/begin COMPU_METHOD Def_f_uw_b1 "Def_f_uw_b1" RAT_FUNC "%14.5" "-" COEFFS 0 65536 0 0 0 1 /end COMPU_METHOD
/begin COMPU_METHOD Identity "Identity" RAT_FUNC "%3.0" "-" COEFFS 0 1 0 0 0 1 /end COMPU_METHOD
/begin COMPU_METHOD Def_i_ub_q0p125 "Def_i_ub_q0p125" RAT_FUNC "%6.3" "A" COEFFS 0 8 0 0 0 1 /end COMPU_METHOD
/begin COMPU_METHOD Def_st_ub_q1 "Def_st_ub_q1" RAT_FUNC "%3.0" "-" COEFFS 0 1 0 0 0 1 /end COMPU_METHOD
/begin COMPU_METHOD Def_bit_ub_0 "Def_bit_ub_0" TAB_VERB "%5.2" "-" COMPU_TAB_REF Def_bit_ub_0_VTAB /end COMPU_METHOD
/begin COMPU_METHOD Def_dez_ub_q1 "Def_dez_ub_q1" RAT_FUNC "%3.0" "-" COEFFS 0 1 0 0 0 1 /end COMPU_METHOD
/begin COMPU_METHOD Def_i_ub_q0p125 "Def_i_ub_q0p125" RAT_FUNC "%6.3" "A" COEFFS 0 8 0 0 0 1 /end COMPU_METHOD
/begin COMPU_METHOD Def_dez_uw_q1 "Def_dez_uw_q1" RAT_FUNC "%5.0" "-" COEFFS 0 1 0 0 0 1 /end COMPU_METHOD
/begin COMPU_METHOD Def_bit_ub_0 "Def_bit_ub_0" TAB_VERB "%5.2" "-" COMPU_TAB_REF Def_bit_ub_0_VTAB /end COMPU_METHOD
/begin COMPU_METHOD Def_bit_ub_1 "Def_bit_ub_1" TAB_VERB "%5.2" "-" COMPU_TAB_REF Def_bit_ub_1_VTAB /end COMPU_METHOD
/begin COMPU_METHOD Def_st_ub_q1 "Def_st_ub_q1" RAT_FUNC "%3.0" "-" COEFFS 0 1 0 0 0 1 /end COMPU_METHOD
/begin COMPU_METHOD Def_dez_ub_q1 "Def_dez_ub_q1" RAT_FUNC "%3.0" "-" COEFFS 0 1 0 0 0 1 /end COMPU_METHOD
/begin COMPU_METHOD Def_n_sw_q1p0 "Def_n_sw_q1p0" RAT_FUNC "%5.0" "Upm" COEFFS 0 1 0 0 0 1 /end COMPU_METHOD
/begin COMPU_METHOD Def_t_sw_q0p1 "Def_t_sw_q0p1" RAT_FUNC "%6.1" "°C" COEFFS 0 10 0 0 0 1 /end COMPU_METHOD
/begin COMPU_METHOD Def_t_sw_q0p01 "Def_t_sw_q0p01" RAT_FUNC "%7.2" "°C" COEFFS 0 100 0 0 0 1 /end COMPU_METHOD
/begin COMPU_METHOD Def_v_uw_q1p0 "Def_v_uw_q1p0" RAT_FUNC "%5.0" "km/h" COEFFS 0 1 0 0 0 1 /end COMPU_METHOD
/begin COMPU_METHOD Def_f_ub_b4 "Def_f_ub_b4" RAT_FUNC "%5.2" "-" COEFFS 0 256 0 0 0 4 /end COMPU_METHOD
/begin COMPU_METHOD Identity "Identity" RAT_FUNC "%3.0" "-" COEFFS 0 1 0 0 0 1 /end COMPU_METHOD
/begin COMPU_METHOD Def_td_ub_q1 "Def_td_ub_q1" RAT_FUNC "%5.2" "s" COEFFS 0 1 0 0 0 1 /end COMPU_METHOD
/begin COMPU_METHOD Def_km_uw_q10 "Def_km_uw_q10" RAT_FUNC "%5.0" "km" COEFFS 0 1 0 0 0 10 /end COMPU_METHOD
/begin COMPU_METHOD Def_bit_ub_0 "Def_bit_ub_0" TAB_VERB "%5.2" "-" COMPU_TAB_REF Def_bit_ub_0_VTAB /end COMPU_METHOD
/begin COMPU_METHOD Def_bit_ub_1 "Def_bit_ub_1" TAB_VERB "%5.2" "-" COMPU_TAB_REF Def_bit_ub_1_VTAB /end COMPU_METHOD
/begin COMPU_METHOD Def_st_ub_q1 "Def_st_ub_q1" RAT_FUNC "%3.0" "-" COEFFS 0 1 0 0 0 1 /end COMPU_METHOD
/begin COMPU_METHOD Def_dez_ub_q1 "Def_dez_ub_q1" RAT_FUNC "%3.0" "-" COEFFS 0 1 0 0 0 1 /end COMPU_METHOD
/begin COMPU_METHOD Identity "Identity" RAT_FUNC "%3.0" "-" COEFFS 0 1 0 0 0 1 /end COMPU_METHOD
/begin COMPU_METHOD Def_f_ub_b4 "Def_f_ub_b4" RAT_FUNC "%5.2" "-" COEFFS 0 256 0 0 0 4 /end COMPU_METHOD
/begin COMPU_METHOD Def_t_sw_q0p01 "Def_t_sw_q0p01" RAT_FUNC "%7.2" "°C" COEFFS 0 100 0 0 0 1 /end COMPU_METHOD
/begin COMPU_METHOD Def_n_sw_q1p0 "Def_n_sw_q1p0" RAT_FUNC "%5.0" "Upm" COEFFS 0 1 0 0 0 1 /end COMPU_METHOD
/begin COMPU_METHOD Def_i_ub_q0p125 "Def_i_ub_q0p125" RAT_FUNC "%6.3" "A" COEFFS 0 8 0 0 0 1 /end COMPU_METHOD
/begin COMPU_METHOD Def_st_ub_q1 "Def_st_ub_q1" RAT_FUNC "%3.0" "-" COEFFS 0 1 0 0 0 1 /end COMPU_METHOD
/begin COMPU_METHOD Def_bit_ub_0 "Def_bit_ub_0" TAB_VERB "%5.2" "-" COMPU_TAB_REF Def_bit_ub_0_VTAB /end COMPU_METHOD
/begin COMPU_METHOD Def_bit_ub_1 "Def_bit_ub_1" TAB_VERB "%5.2" "-" COMPU_TAB_REF Def_bit_ub_1_VTAB /end COMPU_METHOD
/begin COMPU_METHOD Def_bit_ub_2 "Def_bit_ub_2" TAB_VERB "%5.2" "-" COMPU_TAB_REF Def_bit_ub_2_VTAB /end COMPU_METHOD
/begin COMPU_METHOD Def_bit_ub_3 "Def_bit_ub_3" TAB_VERB "%5.2" "-" COMPU_TAB_REF Def_bit_ub_3_VTAB /end COMPU_METHOD
/begin COMPU_METHOD Def_bit_ub_4 "Def_bit_ub_4" TAB_VERB "%5.2" "-" COMPU_TAB_REF Def_bit_ub_4_VTAB /end COMPU_METHOD
/begin COMPU_METHOD Def_dez_ub_q1 "Def_dez_ub_q1" RAT_FUNC "%3.0" "-" COEFFS 0 1 0 0 0 1 /end COMPU_METHOD
/begin COMPU_METHOD Def_td_uw_q0p01 "Def_td_uw_q0p01" RAT_FUNC "%7.2" "s" COEFFS 0 100 0 0 0 1 /end COMPU_METHOD
/begin COMPU_METHOD Def_wdk_sw_q0p0244 "Def_wdk_sw_q0p0244" RAT_FUNC "%7.2" "%" COEFFS 0 4096 0 0 0 100 /end COMPU_METHOD
/begin COMPU_METHOD Def_n_sw_q1p0 "Def_n_sw_q1p0" RAT_FUNC "%5.0" "Upm" COEFFS 0 1 0 0 0 1 /end COMPU_METHOD
/begin COMPU_METHOD Def_t_sw_q0p1 "Def_t_sw_q0p1" RAT_FUNC "%6.1" "°C" COEFFS 0 10 0 0 0 1 /end COMPU_METHOD
/begin COMPU_METHOD Def_v_uw_q1p0 "Def_v_uw_q1p0" RAT_FUNC "%5.0" "km/h" COEFFS 0 1 0 0 0 1 /end COMPU_METHOD
/begin COMPU_METHOD Def_t_sw_q0p01 "Def_t_sw_q0p01" RAT_FUNC "%7.2" "°C" COEFFS 0 100 0 0 0 1 /end COMPU_METHOD
/begin COMPU_METHOD Def_dez_ub_q1 "Def_dez_ub_q1" RAT_FUNC "%3.0" "-" COEFFS 0 1 0 0 0 1 /end COMPU_METHOD
/begin COMPU_METHOD Def_st_ub_q1 "Def_st_ub_q1" RAT_FUNC "%3.0" "-" COEFFS 0 1 0 0 0 1 /end COMPU_METHOD
/begin COMPU_METHOD Def_bit_ub_0 "Def_bit_ub_0" TAB_VERB "%5.2" "-" COMPU_TAB_REF Def_bit_ub_0_VTAB /end COMPU_METHOD
/begin COMPU_METHOD Def_bit_ub_1 "Def_bit_ub_1" TAB_VERB "%5.2" "-" COMPU_TAB_REF Def_bit_ub_1_VTAB /end COMPU_METHOD
/begin COMPU_METHOD Def_bit_ub_2 "Def_bit_ub_2" TAB_VERB "%5.2" "-" COMPU_TAB_REF Def_bit_ub_2_VTAB /end COMPU_METHOD
/begin COMPU_METHOD Def_bit_ub_0 "Def_bit_ub_0" TAB_VERB "%5.2" "-" COMPU_TAB_REF Def_bit_ub_0_VTAB /end COMPU_METHOD
/begin COMPU_METHOD Def_st_ub_q1 "Def_st_ub_q1" RAT_FUNC "%3.0" "-" COEFFS 0 1 0 0 0 1 /end COMPU_METHOD
/begin COMPU_METHOD Def_bit_ub_1 "Def_bit_ub_1" TAB_VERB "%5.2" "-" COMPU_TAB_REF Def_bit_ub_1_VTAB /end COMPU_METHOD
/begin COMPU_METHOD Def_bit_ub_4 "Def_bit_ub_4" TAB_VERB "%5.2" "-" COMPU_TAB_REF Def_bit_ub_4_VTAB /end COMPU_METHOD
/begin COMPU_METHOD Def_bit_ub_5 "Def_bit_ub_5" TAB_VERB "%5.2" "-" COMPU_TAB_REF Def_bit_ub_5_VTAB /end COMPU_METHOD
/begin COMPU_METHOD Def_bit_ub_3 "Def_bit_ub_3" TAB_VERB "%5.2" "-" COMPU_TAB_REF Def_bit_ub_3_VTAB /end COMPU_METHOD
/begin COMPU_METHOD Def_dez_ub_q1 "Def_dez_ub_q1" RAT_FUNC "%3.0" "-" COEFFS 0 1 0 0 0 1 /end COMPU_METHOD
/begin COMPU_METHOD Def_bit_ub_2 "Def_bit_ub_2" TAB_VERB "%5.2" "-" COMPU_TAB_REF Def_bit_ub_2_VTAB /end COMPU_METHOD
/begin COMPU_METHOD Def_dez_uw_q1 "Def_dez_uw_q1" RAT_FUNC "%5.0" "-" COEFFS 0 1 0 0 0 1 /end COMPU_METHOD
/begin COMPU_METHOD Def_t_sw_q0p1 "Def_t_sw_q0p1" RAT_FUNC "%6.1" "°C" COEFFS 0 10 0 0 0 1 /end COMPU_METHOD
/begin COMPU_METHOD Def_td_ub_q1 "Def_td_ub_q1" RAT_FUNC "%5.2" "s" COEFFS 0 1 0 0 0 1 /end COMPU_METHOD
/begin COMPU_METHOD Def_bit_ub_0 "Def_bit_ub_0" TAB_VERB "%5.2" "-" COMPU_TAB_REF Def_bit_ub_0_VTAB /end COMPU_METHOD
/begin COMPU_METHOD Def_st_ub_q1 "Def_st_ub_q1" RAT_FUNC "%3.0" "-" COEFFS 0 1 0 0 0 1 /end COMPU_METHOD
/begin COMPU_METHOD Def_n_sw_q1p0 "Def_n_sw_q1p0" RAT_FUNC "%5.0" "Upm" COEFFS 0 1 0 0 0 1 /end COMPU_METHOD
/begin COMPU_METHOD Def_u_uw_q0p0942 "Def_u_uw_q0p0942" RAT_FUNC "%6.1" "V" COEFFS 0 1 0 0 0 0.0942 /end COMPU_METHOD
/begin COMPU_METHOD Def_f_ub_b100 "Def_f_ub_b100" RAT_FUNC "%5.2" "%" COEFFS 0 256 0 0 0 100 /end COMPU_METHOD
/begin COMPU_METHOD Def_dez_ub_q1 "Def_dez_ub_q1" RAT_FUNC "%3.0" "-" COEFFS 0 1 0 0 0 1 /end COMPU_METHOD
/begin COMPU_METHOD Def_i_ub_q0p125 "Def_i_ub_q0p125" RAT_FUNC "%6.3" "A" COEFFS 0 8 0 0 0 1 /end COMPU_METHOD
/begin COMPU_METHOD Def_td_uw_q0p01 "Def_td_uw_q0p01" RAT_FUNC "%7.2" "s" COEFFS 0 100 0 0 0 1 /end COMPU_METHOD
/begin COMPU_METHOD Def_f_ub_b1 "Def_f_ub_b1" RAT_FUNC "%6.3" "-" COEFFS 0 256 0 0 0 1 /end COMPU_METHOD
/begin COMPU_METHOD Def_t_sw_q0p1 "Def_t_sw_q0p1" RAT_FUNC "%6.1" "°C" COEFFS 0 10 0 0 0 1 /end COMPU_METHOD
/begin COMPU_METHOD Def_st_ub_q1 "Def_st_ub_q1" RAT_FUNC "%3.0" "-" COEFFS 0 1 0 0 0 1 /end COMPU_METHOD
/begin COMPU_METHOD Def_n_sw_q1p0 "Def_n_sw_q1p0" RAT_FUNC "%5.0" "Upm" COEFFS 0 1 0 0 0 1 /end COMPU_METHOD
/begin COMPU_METHOD Def_f_ub_b100 "Def_f_ub_b100" RAT_FUNC "%5.2" "%" COEFFS 0 256 0 0 0 100 /end COMPU_METHOD
/begin COMPU_METHOD Identity "Identity" RAT_FUNC "%3.0" "-" COEFFS 0 1 0 0 0 1 /end COMPU_METHOD
/begin COMPU_METHOD Def_bit_ub_0 "Def_bit_ub_0" TAB_VERB "%5.2" "-" COMPU_TAB_REF Def_bit_ub_0_VTAB /end COMPU_METHOD
/begin COMPU_METHOD Def_bit_ub_1 "Def_bit_ub_1" TAB_VERB "%5.2" "-" COMPU_TAB_REF Def_bit_ub_1_VTAB /end COMPU_METHOD
/begin COMPU_METHOD Def_bit_ub_2 "Def_bit_ub_2" TAB_VERB "%5.2" "-" COMPU_TAB_REF Def_bit_ub_2_VTAB /end COMPU_METHOD
/begin COMPU_METHOD Def_st_ub_q1 "Def_st_ub_q1" RAT_FUNC "%3.0" "-" COEFFS 0 1 0 0 0 1 /end COMPU_METHOD
/begin COMPU_METHOD Def_n_sw_q1p0 "Def_n_sw_q1p0" RAT_FUNC "%5.0" "Upm" COEFFS 0 1 0 0 0 1 /end COMPU_METHOD
/begin COMPU_METHOD Def_km_uw_q10 "Def_km_uw_q10" RAT_FUNC "%5.0" "km" COEFFS 0 1 0 0 0 10 /end COMPU_METHOD
/begin COMPU_METHOD Def_f_uw_b100 "Def_f_uw_b100" RAT_FUNC "%8.3" "%" COEFFS 0 65536 0 0 0 100 /end COMPU_METHOD
/begin COMPU_METHOD Def_dez_uw_q1 "Def_dez_uw_q1" RAT_FUNC "%5.0" "-" COEFFS 0 1 0 0 0 1 /end COMPU_METHOD
/begin COMPU_METHOD Def_dez_ub_q1 "Def_dez_ub_q1" RAT_FUNC "%3.0" "-" COEFFS 0 1 0 0 0 1 /end COMPU_METHOD
/begin COMPU_METHOD Def_f_ub_b2 "Def_f_ub_b2" RAT_FUNC "%6.3" "-" COEFFS 0 256 0 0 0 2 /end COMPU_METHOD
/begin COMPU_METHOD Def_n_sw_q1p0 "Def_n_sw_q1p0" RAT_FUNC "%5.0" "Upm" COEFFS 0 1 0 0 0 1 /end COMPU_METHOD
/begin COMPU_METHOD Def_t_sw_q0p01 "Def_t_sw_q0p01" RAT_FUNC "%7.2" "°C" COEFFS 0 100 0 0 0 1 /end COMPU_METHOD
/begin COMPU_METHOD Def_p_uw_q039 "Def_p_uw_q039" RAT_FUNC "%8.3" "hPa" COEFFS 0 256 0 0 0 10 /end COMPU_METHOD
/begin COMPU_METHOD Def_f_ub_b1 "Def_f_ub_b1" RAT_FUNC "%6.3" "-" COEFFS 0 256 0 0 0 1 /end COMPU_METHOD
/begin COMPU_METHOD Def_bit_ub_0 "Def_bit_ub_0" TAB_VERB "%5.2" "-" COMPU_TAB_REF Def_bit_ub_0_VTAB /end COMPU_METHOD
/begin COMPU_METHOD Def_st_ub_q1 "Def_st_ub_q1" RAT_FUNC "%3.0" "-" COEFFS 0 1 0 0 0 1 /end COMPU_METHOD
/begin COMPU_METHOD Def_dez_uw_q1 "Def_dez_uw_q1" RAT_FUNC "%5.0" "-" COEFFS 0 1 0 0 0 1 /end COMPU_METHOD
/begin COMPU_METHOD Def_t_sw_q0p01 "Def_t_sw_q0p01" RAT_FUNC "%7.2" "°C" COEFFS 0 100 0 0 0 1 /end COMPU_METHOD
/begin COMPU_METHOD Def_n_sw_q1p0 "Def_n_sw_q1p0" RAT_FUNC "%5.0" "Upm" COEFFS 0 1 0 0 0 1 /end COMPU_METHOD
/begin COMPU_METHOD Def_f_uw_b100 "Def_f_uw_b100" RAT_FUNC "%8.3" "%" COEFFS 0 65536 0 0 0 100 /end COMPU_METHOD
/begin COMPU_METHOD Def_u_uw_q0p0942 "Def_u_uw_q0p0942" RAT_FUNC "%6.1" "V" COEFFS 0 1 0 0 0 0.0942 /end COMPU_METHOD
/begin COMPU_METHOD Def_f_uw_b2 "Def_f_uw_b2" RAT_FUNC "%14.5" "-" COEFFS 0 65536 0 0 0 2 /end COMPU_METHOD
/begin COMPU_METHOD Def_bit_ub_0 "Def_bit_ub_0" TAB_VERB "%5.2" "-" COMPU_TAB_REF Def_bit_ub_0_VTAB /end COMPU_METHOD
/begin COMPU_METHOD Def_bit_ub_1 "Def_bit_ub_1" TAB_VERB "%5.2" "-" COMPU_TAB_REF Def_bit_ub_1_VTAB /end COMPU_METHOD
/begin COMPU_METHOD Def_bit_ub_2 "Def_bit_ub_2" TAB_VERB "%5.2" "-" COMPU_TAB_REF Def_bit_ub_2_VTAB /end COMPU_METHOD
/begin COMPU_METHOD Def_bit_ub_3 "Def_bit_ub_3" TAB_VERB "%5.2" "-" COMPU_TAB_REF Def_bit_ub_3_VTAB /end COMPU_METHOD
/begin COMPU_METHOD Def_bit_ub_4 "Def_bit_ub_4" TAB_VERB "%5.2" "-" COMPU_TAB_REF Def_bit_ub_4_VTAB /end COMPU_METHOD
/begin COMPU_METHOD Def_bit_ub_5 "Def_bit_ub_5" TAB_VERB "%5.2" "-" COMPU_TAB_REF Def_bit_ub_5_VTAB /end COMPU_METHOD
/begin COMPU_METHOD Def_bit_ub_6 "Def_bit_ub_6" TAB_VERB "%5.2" "-" COMPU_TAB_REF Def_bit_ub_6_VTAB /end COMPU_METHOD
/begin COMPU_METHOD Def_bit_ub_7 "Def_bit_ub_7" TAB_VERB "%5.2" "-" COMPU_TAB_REF Def_bit_ub_7_VTAB /end COMPU_METHOD
/begin COMPU_METHOD Def_st_ub_q1 "Def_st_ub_q1" RAT_FUNC "%3.0" "-" COEFFS 0 1 0 0 0 1 /end COMPU_METHOD
/begin COMPU_METHOD Def_t_sw_q0p1 "Def_t_sw_q0p1" RAT_FUNC "%6.1" "°C" COEFFS 0 10 0 0 0 1 /end COMPU_METHOD
/begin COMPU_METHOD Def_dez_uw_q1 "Def_dez_uw_q1" RAT_FUNC "%5.0" "-" COEFFS 0 1 0 0 0 1 /end COMPU_METHOD
/begin COMPU_METHOD Def_dez_ub_q1 "Def_dez_ub_q1" RAT_FUNC "%3.0" "-" COEFFS 0 1 0 0 0 1 /end COMPU_METHOD
/begin COMPU_METHOD Def_dez_sw_q1 "Def_dez_sw_q1" RAT_FUNC "%5.0" "-" COEFFS 0 1 0 0 0 1 /end COMPU_METHOD
/begin COMPU_METHOD Def_km_sw_q10 "Def_km_sw_q10" RAT_FUNC "%6.1" "km" COEFFS 0 1 0 0 0 10 /end COMPU_METHOD
/begin COMPU_METHOD Def_bit_ub_0 "Def_bit_ub_0" TAB_VERB "%5.2" "-" COMPU_TAB_REF Def_bit_ub_0_VTAB /end COMPU_METHOD
/begin COMPU_METHOD Def_bit_ub_1 "Def_bit_ub_1" TAB_VERB "%5.2" "-" COMPU_TAB_REF Def_bit_ub_1_VTAB /end COMPU_METHOD
/begin COMPU_METHOD Def_bit_ub_2 "Def_bit_ub_2" TAB_VERB "%5.2" "-" COMPU_TAB_REF Def_bit_ub_2_VTAB /end COMPU_METHOD
/begin COMPU_METHOD Def_bit_ub_3 "Def_bit_ub_3" TAB_VERB "%5.2" "-" COMPU_TAB_REF Def_bit_ub_3_VTAB /end COMPU_METHOD
/begin COMPU_METHOD Def_bit_ub_4 "Def_bit_ub_4" TAB_VERB "%5.2" "-" COMPU_TAB_REF Def_bit_ub_4_VTAB /end COMPU_METHOD
/begin COMPU_METHOD Def_bit_ub_5 "Def_bit_ub_5" TAB_VERB "%5.2" "-" COMPU_TAB_REF Def_bit_ub_5_VTAB /end COMPU_METHOD
/begin COMPU_METHOD Def_bit_ub_6 "Def_bit_ub_6" TAB_VERB "%5.2" "-" COMPU_TAB_REF Def_bit_ub_6_VTAB /end COMPU_METHOD
/begin COMPU_METHOD Def_bit_ub_7 "Def_bit_ub_7" TAB_VERB "%5.2" "-" COMPU_TAB_REF Def_bit_ub_7_VTAB /end COMPU_METHOD
/begin COMPU_METHOD Def_st_ub_q1 "Def_st_ub_q1" RAT_FUNC "%3.0" "-" COEFFS 0 1 0 0 0 1 /end COMPU_METHOD
/begin COMPU_METHOD Def_km_sw_q10 "Def_km_sw_q10" RAT_FUNC "%6.1" "km" COEFFS 0 1 0 0 0 10 /end COMPU_METHOD
/begin COMPU_METHOD Def_t_sw_q0p1 "Def_t_sw_q0p1" RAT_FUNC "%6.1" "°C" COEFFS 0 10 0 0 0 1 /end COMPU_METHOD
/begin COMPU_METHOD Def_perm_uw_b6 "Def_perm_uw_b6" RAT_FUNC "%14.5" "-" COEFFS 0 65536 0 0 0 6 /end COMPU_METHOD
/begin COMPU_METHOD Def_dez_ub_q1 "Def_dez_ub_q1" RAT_FUNC "%3.0" "-" COEFFS 0 1 0 0 0 1 /end COMPU_METHOD
/begin COMPU_METHOD Def_niv_ub_b75 "Def_niv_ub_b75" RAT_FUNC "%5.2" "" COEFFS 0 256 0 0 0 75 /end COMPU_METHOD
/begin COMPU_METHOD Def_km_uw_q10 "Def_km_uw_q10" RAT_FUNC "%5.0" "km" COEFFS 0 1 0 0 0 10 /end COMPU_METHOD
/begin COMPU_METHOD Def_dez_uw_q1 "Def_dez_uw_q1" RAT_FUNC "%5.0" "-" COEFFS 0 1 0 0 0 1 /end COMPU_METHOD
/begin COMPU_METHOD Def_dez_sb_q1 "Def_dez_sb_q1" RAT_FUNC "%3.0" "-" COEFFS 0 1 0 0 0 1 /end COMPU_METHOD
/begin COMPU_METHOD Def_td_uw_q0p01 "Def_td_uw_q0p01" RAT_FUNC "%7.2" "s" COEFFS 0 100 0 0 0 1 /end COMPU_METHOD
/begin COMPU_METHOD Def_dez_ub_q1 "Def_dez_ub_q1" RAT_FUNC "%3.0" "-" COEFFS 0 1 0 0 0 1 /end COMPU_METHOD
/begin COMPU_METHOD Def_bit_ub_0 "Def_bit_ub_0" TAB_VERB "%5.2" "-" COMPU_TAB_REF Def_bit_ub_0_VTAB /end COMPU_METHOD
/begin COMPU_METHOD Def_bit_ub_1 "Def_bit_ub_1" TAB_VERB "%5.2" "-" COMPU_TAB_REF Def_bit_ub_1_VTAB /end COMPU_METHOD
/begin COMPU_METHOD Def_bit_ub_2 "Def_bit_ub_2" TAB_VERB "%5.2" "-" COMPU_TAB_REF Def_bit_ub_2_VTAB /end COMPU_METHOD
/begin COMPU_METHOD Def_bit_ub_3 "Def_bit_ub_3" TAB_VERB "%5.2" "-" COMPU_TAB_REF Def_bit_ub_3_VTAB /end COMPU_METHOD
/begin COMPU_METHOD Def_bit_ub_4 "Def_bit_ub_4" TAB_VERB "%5.2" "-" COMPU_TAB_REF Def_bit_ub_4_VTAB /end COMPU_METHOD
/begin COMPU_METHOD Def_bit_ub_5 "Def_bit_ub_5" TAB_VERB "%5.2" "-" COMPU_TAB_REF Def_bit_ub_5_VTAB /end COMPU_METHOD
/begin COMPU_METHOD Def_bit_ub_6 "Def_bit_ub_6" TAB_VERB "%5.2" "-" COMPU_TAB_REF Def_bit_ub_6_VTAB /end COMPU_METHOD
/begin COMPU_METHOD Def_bit_ub_7 "Def_bit_ub_7" TAB_VERB "%5.2" "-" COMPU_TAB_REF Def_bit_ub_7_VTAB /end COMPU_METHOD
/begin COMPU_METHOD Def_st_ub_q1 "Def_st_ub_q1" RAT_FUNC "%3.0" "-" COEFFS 0 1 0 0 0 1 /end COMPU_METHOD
/begin COMPU_METHOD Def_niv_ub_b75 "Def_niv_ub_b75" RAT_FUNC "%5.2" "" COEFFS 0 256 0 0 0 75 /end COMPU_METHOD
/begin COMPU_METHOD Def_dez_ub_q1 "Def_dez_ub_q1" RAT_FUNC "%3.0" "-" COEFFS 0 1 0 0 0 1 /end COMPU_METHOD
/begin COMPU_METHOD Def_niv_ub_q0p1 "Def_niv_ub_q0p1" RAT_FUNC "%5.2" "l" COEFFS 0 10 0 0 0 1 /end COMPU_METHOD
/begin COMPU_METHOD Def_niv_ub_b8 "Def_niv_ub_b8" RAT_FUNC "%5.2" "" COEFFS 0 256 0 0 0 8 /end COMPU_METHOD
/begin COMPU_METHOD Def_km_sw_q10 "Def_km_sw_q10" RAT_FUNC "%6.1" "km" COEFFS 0 1 0 0 0 10 /end COMPU_METHOD
/begin COMPU_METHOD Def_tn_uw_q1 "Def_tn_uw_q1" RAT_FUNC "%7.2" "min" COEFFS 0 1 0 0 0 1 /end COMPU_METHOD
/begin COMPU_METHOD Def_dez_uw_q1 "Def_dez_uw_q1" RAT_FUNC "%5.0" "-" COEFFS 0 1 0 0 0 1 /end COMPU_METHOD
/begin COMPU_METHOD Def_km_uw_q10 "Def_km_uw_q10" RAT_FUNC "%5.0" "km" COEFFS 0 1 0 0 0 10 /end COMPU_METHOD
/begin COMPU_METHOD Def_n_sw_q1p0 "Def_n_sw_q1p0" RAT_FUNC "%5.0" "Upm" COEFFS 0 1 0 0 0 1 /end COMPU_METHOD
/begin COMPU_METHOD Def_f_sw_b8 "Def_f_sw_b8" RAT_FUNC "%9.4" "-" COEFFS 0 32768 0 0 0 8 /end COMPU_METHOD
/begin COMPU_METHOD Def_f_sw_b64 "Def_f_sw_b64" RAT_FUNC "%8.3" "-" COEFFS 0 32768 0 0 0 64 /end COMPU_METHOD
/begin COMPU_METHOD Def_t_sw_q0p1 "Def_t_sw_q0p1" RAT_FUNC "%6.1" "°C" COEFFS 0 10 0 0 0 1 /end COMPU_METHOD
/begin COMPU_METHOD Def_f_uw_b10 "Def_f_uw_b10" RAT_FUNC "%9.4" "%" COEFFS 0 65536 0 0 0 10 /end COMPU_METHOD
/begin COMPU_METHOD Def_td_uw_q0p01 "Def_td_uw_q0p01" RAT_FUNC "%7.2" "s" COEFFS 0 100 0 0 0 1 /end COMPU_METHOD
/begin COMPU_METHOD Def_f_uw_b2 "Def_f_uw_b2" RAT_FUNC "%14.5" "-" COEFFS 0 65536 0 0 0 2 /end COMPU_METHOD
/begin COMPU_METHOD Def_f_sb_b2 "Def_f_sb_b2" RAT_FUNC "%5.2" "-" COEFFS 0 128 0 0 0 2 /end COMPU_METHOD
/begin COMPU_METHOD Def_dez_sb_q1 "Def_dez_sb_q1" RAT_FUNC "%3.0" "-" COEFFS 0 1 0 0 0 1 /end COMPU_METHOD
/begin COMPU_METHOD Def_t_sw_q0p01 "Def_t_sw_q0p01" RAT_FUNC "%7.2" "°C" COEFFS 0 100 0 0 0 1 /end COMPU_METHOD
/begin COMPU_METHOD Def_f_sw_b32 "Def_f_sw_b32" RAT_FUNC "%9.4" "-" COEFFS 0 32768 0 0 0 32 /end COMPU_METHOD
/begin COMPU_METHOD Def_p_uw_q039 "Def_p_uw_q039" RAT_FUNC "%8.3" "hPa" COEFFS 0 256 0 0 0 10 /end COMPU_METHOD
/begin COMPU_METHOD Def_ac_sb_q0p25 "Def_ac_sb_q0p25" RAT_FUNC "%4.1" "-" COEFFS 0 4 0 0 0 1 /end COMPU_METHOD
/begin COMPU_METHOD Def_f_ub_b8 "Def_f_ub_b8" RAT_FUNC "%5.2" "-" COEFFS 0 256 0 0 0 8 /end COMPU_METHOD
/begin COMPU_METHOD Def_f_sw_b1 "Def_f_sw_b1" RAT_FUNC "%14.5" "-" COEFFS 0 65536 0 0 0 2 /end COMPU_METHOD
/begin COMPU_METHOD Def_niv_sb_b37p5 "Def_niv_sb_b37p5" RAT_FUNC "%5.2" "" COEFFS 0 256 0 0 0 75 /end COMPU_METHOD
/begin COMPU_METHOD Def_niv_sw_q0p293 "Def_niv_sw_q0p293" RAT_FUNC "%7.2" "mm" COEFFS 0 256 0 0 0 75 /end COMPU_METHOD
/begin COMPU_METHOD Def_niv_sw_b37p5 "Def_niv_sw_b37p5" RAT_FUNC "%7.2" "" COEFFS 0 256 0 0 0 75 /end COMPU_METHOD
/begin COMPU_METHOD Def_niv_sw_q0p146 "Def_niv_sw_q0p146" RAT_FUNC "%7.2" "mm" COEFFS 0 512 0 0 0 75 /end COMPU_METHOD
/begin COMPU_METHOD Def_niv_uw_q0p293 "Def_niv_uw_q0p293" RAT_FUNC "%7.2" "mm" COEFFS 0 256 0 0 0 75 /end COMPU_METHOD
/begin COMPU_METHOD Def_bit_ub_0 "Def_bit_ub_0" TAB_VERB "%5.2" "-" COMPU_TAB_REF Def_bit_ub_0_VTAB /end COMPU_METHOD
/begin COMPU_METHOD Def_bit_ub_1 "Def_bit_ub_1" TAB_VERB "%5.2" "-" COMPU_TAB_REF Def_bit_ub_1_VTAB /end COMPU_METHOD
/begin COMPU_METHOD Def_bit_ub_2 "Def_bit_ub_2" TAB_VERB "%5.2" "-" COMPU_TAB_REF Def_bit_ub_2_VTAB /end COMPU_METHOD
/begin COMPU_METHOD Def_bit_ub_3 "Def_bit_ub_3" TAB_VERB "%5.2" "-" COMPU_TAB_REF Def_bit_ub_3_VTAB /end COMPU_METHOD
/begin COMPU_METHOD Def_st_ub_q1 "Def_st_ub_q1" RAT_FUNC "%3.0" "-" COEFFS 0 1 0 0 0 1 /end COMPU_METHOD
/begin COMPU_METHOD Def_bit_ub_4 "Def_bit_ub_4" TAB_VERB "%5.2" "-" COMPU_TAB_REF Def_bit_ub_4_VTAB /end COMPU_METHOD
/begin COMPU_METHOD Def_bit_ub_5 "Def_bit_ub_5" TAB_VERB "%5.2" "-" COMPU_TAB_REF Def_bit_ub_5_VTAB /end COMPU_METHOD
/begin COMPU_METHOD Def_perm_uw_b6 "Def_perm_uw_b6" RAT_FUNC "%14.5" "-" COEFFS 0 65536 0 0 0 6 /end COMPU_METHOD
/begin COMPU_METHOD Def_perm_sw_b6 "Def_perm_sw_b6" RAT_FUNC "%9.4" "-" COEFFS 0 65536 0 0 0 12 /end COMPU_METHOD
/begin COMPU_METHOD Def_km_uw_q10 "Def_km_uw_q10" RAT_FUNC "%5.0" "km" COEFFS 0 1 0 0 0 10 /end COMPU_METHOD
/begin COMPU_METHOD Def_dez_uw_q1 "Def_dez_uw_q1" RAT_FUNC "%5.0" "-" COEFFS 0 1 0 0 0 1 /end COMPU_METHOD
/begin COMPU_METHOD Def_td_uw_q1 "Def_td_uw_q1" RAT_FUNC "%5.0" "s" COEFFS 0 1 0 0 0 1 /end COMPU_METHOD
/begin COMPU_METHOD Def_dez_sb_q1 "Def_dez_sb_q1" RAT_FUNC "%3.0" "-" COEFFS 0 1 0 0 0 1 /end COMPU_METHOD
/begin COMPU_METHOD Def_n_sw_q1p0 "Def_n_sw_q1p0" RAT_FUNC "%5.0" "Upm" COEFFS 0 1 0 0 0 1 /end COMPU_METHOD
/begin COMPU_METHOD Def_t_sw_q0p1 "Def_t_sw_q0p1" RAT_FUNC "%6.1" "°C" COEFFS 0 10 0 0 0 1 /end COMPU_METHOD
/begin COMPU_METHOD Def_niv_ub_b75 "Def_niv_ub_b75" RAT_FUNC "%5.2" "" COEFFS 0 256 0 0 0 75 /end COMPU_METHOD
/begin COMPU_METHOD Def_bit_ub_0 "Def_bit_ub_0" TAB_VERB "%5.2" "-" COMPU_TAB_REF Def_bit_ub_0_VTAB /end COMPU_METHOD
/begin COMPU_METHOD Def_st_ub_q1 "Def_st_ub_q1" RAT_FUNC "%3.0" "-" COEFFS 0 1 0 0 0 1 /end COMPU_METHOD
/begin COMPU_METHOD Def_bit_ub_1 "Def_bit_ub_1" TAB_VERB "%5.2" "-" COMPU_TAB_REF Def_bit_ub_1_VTAB /end COMPU_METHOD
/begin COMPU_METHOD Def_bit_ub_2 "Def_bit_ub_2" TAB_VERB "%5.2" "-" COMPU_TAB_REF Def_bit_ub_2_VTAB /end COMPU_METHOD
/begin COMPU_METHOD Def_bit_ub_3 "Def_bit_ub_3" TAB_VERB "%5.2" "-" COMPU_TAB_REF Def_bit_ub_3_VTAB /end COMPU_METHOD
/begin COMPU_METHOD Def_km_sw_q10 "Def_km_sw_q10" RAT_FUNC "%6.1" "km" COEFFS 0 1 0 0 0 10 /end COMPU_METHOD
/begin COMPU_METHOD Def_dez_uw_q1 "Def_dez_uw_q1" RAT_FUNC "%5.0" "-" COEFFS 0 1 0 0 0 1 /end COMPU_METHOD
/begin COMPU_METHOD Def_km_uw_q10 "Def_km_uw_q10" RAT_FUNC "%5.0" "km" COEFFS 0 1 0 0 0 10 /end COMPU_METHOD
/begin COMPU_METHOD Def_dez_ub_q1 "Def_dez_ub_q1" RAT_FUNC "%3.0" "-" COEFFS 0 1 0 0 0 1 /end COMPU_METHOD
/begin COMPU_METHOD Def_lf_ub_q0p01 "Def_lf_ub_q0p01" RAT_FUNC "%5.2" "-" COEFFS 0 100 0 0 0 1 /end COMPU_METHOD
/begin COMPU_METHOD Def_fuel_ul_q0p000122 "Def_fuel_ul_q0p000122" RAT_FUNC "%11.4" "" COEFFS 0 8192 0 0 0 1 /end COMPU_METHOD
/begin COMPU_METHOD Def_dez_sw_q1 "Def_dez_sw_q1" RAT_FUNC "%5.0" "-" COEFFS 0 1 0 0 0 1 /end COMPU_METHOD
/begin COMPU_METHOD Def_perm_uw_b6 "Def_perm_uw_b6" RAT_FUNC "%14.5" "-" COEFFS 0 65536 0 0 0 6 /end COMPU_METHOD
/begin COMPU_METHOD Def_f_ub_b1 "Def_f_ub_b1" RAT_FUNC "%6.3" "-" COEFFS 0 256 0 0 0 1 /end COMPU_METHOD
/begin COMPU_METHOD Def_f_uw_b64 "Def_f_uw_b64" RAT_FUNC "%9.4" "-" COEFFS 0 65536 0 0 0 64 /end COMPU_METHOD
/begin COMPU_METHOD Def_niv_ub_q0p1 "Def_niv_ub_q0p1" RAT_FUNC "%5.2" "l" COEFFS 0 10 0 0 0 1 /end COMPU_METHOD
/begin COMPU_METHOD Def_t_sw_q0p1 "Def_t_sw_q0p1" RAT_FUNC "%6.1" "°C" COEFFS 0 10 0 0 0 1 /end COMPU_METHOD
/begin COMPU_METHOD Def_f_ub_b0p25 "Def_f_ub_b0p25" RAT_FUNC "%7.4" "-" COEFFS 0 256 0 0 0 0.25 /end COMPU_METHOD
/begin COMPU_METHOD Def_f_ub_b32 "Def_f_ub_b32" RAT_FUNC "%5.2" "-" COEFFS 0 256 0 0 0 32 /end COMPU_METHOD
/begin COMPU_METHOD Def_kw_ub_q0p0234 "Def_kw_ub_q0p0234" RAT_FUNC "%6.3" "°KW" COEFFS 0 256 0 0 0 6 /end COMPU_METHOD
/begin COMPU_METHOD Def_f_uw_b1 "Def_f_uw_b1" RAT_FUNC "%14.5" "-" COEFFS 0 65536 0 0 0 1 /end COMPU_METHOD
/begin COMPU_METHOD Def_t_sw_q0p1 "Def_t_sw_q0p1" RAT_FUNC "%6.1" "°C" COEFFS 0 10 0 0 0 1 /end COMPU_METHOD
/begin COMPU_METHOD Def_f_uw_b100 "Def_f_uw_b100" RAT_FUNC "%8.3" "%" COEFFS 0 65536 0 0 0 100 /end COMPU_METHOD
/begin COMPU_METHOD Def_n_sw_q1p0 "Def_n_sw_q1p0" RAT_FUNC "%5.0" "Upm" COEFFS 0 1 0 0 0 1 /end COMPU_METHOD
/begin COMPU_METHOD Def_t_sw_q0p01 "Def_t_sw_q0p01" RAT_FUNC "%7.2" "°C" COEFFS 0 100 0 0 0 1 /end COMPU_METHOD
/begin COMPU_METHOD Def_dez_ub_q1 "Def_dez_ub_q1" RAT_FUNC "%3.0" "-" COEFFS 0 1 0 0 0 1 /end COMPU_METHOD
/begin COMPU_METHOD Def_bit_ub_0 "Def_bit_ub_0" TAB_VERB "%5.2" "-" COMPU_TAB_REF Def_bit_ub_0_VTAB /end COMPU_METHOD
/begin COMPU_METHOD Def_bit_ub_1 "Def_bit_ub_1" TAB_VERB "%5.2" "-" COMPU_TAB_REF Def_bit_ub_1_VTAB /end COMPU_METHOD
/begin COMPU_METHOD Def_bit_ub_2 "Def_bit_ub_2" TAB_VERB "%5.2" "-" COMPU_TAB_REF Def_bit_ub_2_VTAB /end COMPU_METHOD
/begin COMPU_METHOD Def_st_ub_q1 "Def_st_ub_q1" RAT_FUNC "%3.0" "-" COEFFS 0 1 0 0 0 1 /end COMPU_METHOD
/begin COMPU_METHOD Def_bit_ub_3 "Def_bit_ub_3" TAB_VERB "%5.2" "-" COMPU_TAB_REF Def_bit_ub_3_VTAB /end COMPU_METHOD
/begin COMPU_METHOD Def_bit_ub_4 "Def_bit_ub_4" TAB_VERB "%5.2" "-" COMPU_TAB_REF Def_bit_ub_4_VTAB /end COMPU_METHOD
/begin COMPU_METHOD Def_i_ub_q0p125 "Def_i_ub_q0p125" RAT_FUNC "%6.3" "A" COEFFS 0 8 0 0 0 1 /end COMPU_METHOD
/begin COMPU_METHOD Def_dez_ub_q1 "Def_dez_ub_q1" RAT_FUNC "%3.0" "-" COEFFS 0 1 0 0 0 1 /end COMPU_METHOD
/begin COMPU_METHOD Def_n_sw_q1p0 "Def_n_sw_q1p0" RAT_FUNC "%5.0" "Upm" COEFFS 0 1 0 0 0 1 /end COMPU_METHOD
/begin COMPU_METHOD Def_v_uw_q0p1 "Def_v_uw_q0p1" RAT_FUNC "%7.2" "km/h" COEFFS 0 10 0 0 0 1 /end COMPU_METHOD
/begin COMPU_METHOD Def_td_uw_q0p2 "Def_td_uw_q0p2" RAT_FUNC "%6.1" "s" COEFFS 0 5 0 0 0 1 /end COMPU_METHOD
/begin COMPU_METHOD Def_f_sb_b64 "Def_f_sb_b64" RAT_FUNC "%5.2" "-" COEFFS 0 128 0 0 0 64 /end COMPU_METHOD
/begin COMPU_METHOD Def_wdk_sw_q0p0244 "Def_wdk_sw_q0p0244" RAT_FUNC "%7.2" "%" COEFFS 0 4096 0 0 0 100 /end COMPU_METHOD
/begin COMPU_METHOD Def_t_sw_q0p01 "Def_t_sw_q0p01" RAT_FUNC "%7.2" "°C" COEFFS 0 100 0 0 0 1 /end COMPU_METHOD
/begin COMPU_METHOD Def_td_uw_q0p01 "Def_td_uw_q0p01" RAT_FUNC "%7.2" "s" COEFFS 0 100 0 0 0 1 /end COMPU_METHOD
/begin COMPU_METHOD Def_f_uw_b1 "Def_f_uw_b1" RAT_FUNC "%14.5" "-" COEFFS 0 65536 0 0 0 1 /end COMPU_METHOD
/begin COMPU_METHOD Def_v_uw_q1p0 "Def_v_uw_q1p0" RAT_FUNC "%5.0" "km/h" COEFFS 0 1 0 0 0 1 /end COMPU_METHOD
/begin COMPU_METHOD Def_f_ub_b100 "Def_f_ub_b100" RAT_FUNC "%5.2" "%" COEFFS 0 256 0 0 0 100 /end COMPU_METHOD
/begin COMPU_METHOD Def_f_ub_b1 "Def_f_ub_b1" RAT_FUNC "%6.3" "-" COEFFS 0 256 0 0 0 1 /end COMPU_METHOD
/begin COMPU_METHOD Identity "Identity" RAT_FUNC "%3.0" "-" COEFFS 0 1 0 0 0 1 /end COMPU_METHOD
/begin COMPU_METHOD Def_td_ub_q0p2 "Def_td_ub_q0p2" RAT_FUNC "%4.1" "s" COEFFS 0 5 0 0 0 1 /end COMPU_METHOD
/begin COMPU_METHOD Def_f_ub_b8 "Def_f_ub_b8" RAT_FUNC "%5.2" "-" COEFFS 0 256 0 0 0 8 /end COMPU_METHOD
/begin COMPU_METHOD Def_f_ub_b2 "Def_f_ub_b2" RAT_FUNC "%6.3" "-" COEFFS 0 256 0 0 0 2 /end COMPU_METHOD
/begin COMPU_METHOD Def_bit_ub_0 "Def_bit_ub_0" TAB_VERB "%5.2" "-" COMPU_TAB_REF Def_bit_ub_0_VTAB /end COMPU_METHOD
/begin COMPU_METHOD Def_bit_ub_1 "Def_bit_ub_1" TAB_VERB "%5.2" "-" COMPU_TAB_REF Def_bit_ub_1_VTAB /end COMPU_METHOD
/begin COMPU_METHOD Def_bit_ub_2 "Def_bit_ub_2" TAB_VERB "%5.2" "-" COMPU_TAB_REF Def_bit_ub_2_VTAB /end COMPU_METHOD
/begin COMPU_METHOD Def_bit_ub_3 "Def_bit_ub_3" TAB_VERB "%5.2" "-" COMPU_TAB_REF Def_bit_ub_3_VTAB /end COMPU_METHOD
/begin COMPU_METHOD Def_bit_ub_4 "Def_bit_ub_4" TAB_VERB "%5.2" "-" COMPU_TAB_REF Def_bit_ub_4_VTAB /end COMPU_METHOD
/begin COMPU_METHOD Def_bit_ub_5 "Def_bit_ub_5" TAB_VERB "%5.2" "-" COMPU_TAB_REF Def_bit_ub_5_VTAB /end COMPU_METHOD
/begin COMPU_METHOD Def_st_ub_q1 "Def_st_ub_q1" RAT_FUNC "%3.0" "-" COEFFS 0 1 0 0 0 1 /end COMPU_METHOD
/begin COMPU_METHOD Def_t_sw_q0p1 "Def_t_sw_q0p1" RAT_FUNC "%6.1" "°C" COEFFS 0 10 0 0 0 1 /end COMPU_METHOD
/begin COMPU_METHOD Def_tv_ub_q0p390625 "Def_tv_ub_q0p390625" RAT_FUNC "%5.2" "%" COEFFS 0 256 0 0 0 100 /end COMPU_METHOD
/begin COMPU_METHOD Def_i_ub_q0p125 "Def_i_ub_q0p125" RAT_FUNC "%6.3" "A" COEFFS 0 8 0 0 0 1 /end COMPU_METHOD
/begin COMPU_METHOD Def_f_uw_b256 "Def_f_uw_b256" RAT_FUNC "%8.3" "-" COEFFS 0 65536 0 0 0 256 /end COMPU_METHOD
/begin COMPU_METHOD Def_u_uw_q0p00488 "Def_u_uw_q0p00488" RAT_FUNC "%8.3" "V" COEFFS 0 1024 0 0 0 5 /end COMPU_METHOD
/begin COMPU_METHOD Def_n_sw_q1p0 "Def_n_sw_q1p0" RAT_FUNC "%5.0" "Upm" COEFFS 0 1 0 0 0 1 /end COMPU_METHOD
/begin COMPU_METHOD Def_f_uw_b1 "Def_f_uw_b1" RAT_FUNC "%14.5" "-" COEFFS 0 65536 0 0 0 1 /end COMPU_METHOD
/begin COMPU_METHOD Def_u_uw_q0p0942 "Def_u_uw_q0p0942" RAT_FUNC "%6.1" "V" COEFFS 0 1 0 0 0 0.0942 /end COMPU_METHOD
/begin COMPU_METHOD Def_f_ub_b4 "Def_f_ub_b4" RAT_FUNC "%5.2" "-" COEFFS 0 256 0 0 0 4 /end COMPU_METHOD
/begin COMPU_METHOD Def_td_ub_q1 "Def_td_ub_q1" RAT_FUNC "%5.2" "s" COEFFS 0 1 0 0 0 1 /end COMPU_METHOD
/begin COMPU_METHOD Def_f_ub_b1 "Def_f_ub_b1" RAT_FUNC "%6.3" "-" COEFFS 0 256 0 0 0 1 /end COMPU_METHOD
/begin COMPU_METHOD Identity "Identity" RAT_FUNC "%3.0" "-" COEFFS 0 1 0 0 0 1 /end COMPU_METHOD
/begin COMPU_METHOD Def_f_uw_b100 "Def_f_uw_b100" RAT_FUNC "%8.3" "%" COEFFS 0 65536 0 0 0 100 /end COMPU_METHOD
/begin COMPU_METHOD Def_st_sw_q1 "Def_st_sw_q1" RAT_FUNC "%5.0" "-" COEFFS 0 1 0 0 0 1 /end COMPU_METHOD
/begin COMPU_METHOD Def_bit_ub_0 "Def_bit_ub_0" TAB_VERB "%5.2" "-" COMPU_TAB_REF Def_bit_ub_0_VTAB /end COMPU_METHOD
/begin COMPU_METHOD Def_bit_ub_1 "Def_bit_ub_1" TAB_VERB "%5.2" "-" COMPU_TAB_REF Def_bit_ub_1_VTAB /end COMPU_METHOD
/begin COMPU_METHOD Def_bit_ub_2 "Def_bit_ub_2" TAB_VERB "%5.2" "-" COMPU_TAB_REF Def_bit_ub_2_VTAB /end COMPU_METHOD
/begin COMPU_METHOD Def_bit_ub_4 "Def_bit_ub_4" TAB_VERB "%5.2" "-" COMPU_TAB_REF Def_bit_ub_4_VTAB /end COMPU_METHOD
/begin COMPU_METHOD Def_bit_ub_5 "Def_bit_ub_5" TAB_VERB "%5.2" "-" COMPU_TAB_REF Def_bit_ub_5_VTAB /end COMPU_METHOD
/begin COMPU_METHOD Def_bit_ub_6 "Def_bit_ub_6" TAB_VERB "%5.2" "-" COMPU_TAB_REF Def_bit_ub_6_VTAB /end COMPU_METHOD
/begin COMPU_METHOD Def_bit_ub_7 "Def_bit_ub_7" TAB_VERB "%5.2" "-" COMPU_TAB_REF Def_bit_ub_7_VTAB /end COMPU_METHOD
/begin COMPU_METHOD Def_st_ub_q1 "Def_st_ub_q1" RAT_FUNC "%3.0" "-" COEFFS 0 1 0 0 0 1 /end COMPU_METHOD
/begin COMPU_METHOD Def_bit_ub_3 "Def_bit_ub_3" TAB_VERB "%5.2" "-" COMPU_TAB_REF Def_bit_ub_3_VTAB /end COMPU_METHOD
/begin COMPU_METHOD Def_t_sw_q0p1 "Def_t_sw_q0p1" RAT_FUNC "%6.1" "°C" COEFFS 0 10 0 0 0 1 /end COMPU_METHOD
/begin COMPU_METHOD Def_f_uw_b1 "Def_f_uw_b1" RAT_FUNC "%14.5" "-" COEFFS 0 65536 0 0 0 1 /end COMPU_METHOD
/begin COMPU_METHOD Def_dez_ub_q1 "Def_dez_ub_q1" RAT_FUNC "%3.0" "-" COEFFS 0 1 0 0 0 1 /end COMPU_METHOD
/begin COMPU_METHOD Def_td_ub_q1 "Def_td_ub_q1" RAT_FUNC "%5.2" "s" COEFFS 0 1 0 0 0 1 /end COMPU_METHOD
/begin COMPU_METHOD Def_n_sw_q1p0 "Def_n_sw_q1p0" RAT_FUNC "%5.0" "Upm" COEFFS 0 1 0 0 0 1 /end COMPU_METHOD
/begin COMPU_METHOD Def_v_uw_q1p0 "Def_v_uw_q1p0" RAT_FUNC "%5.0" "km/h" COEFFS 0 1 0 0 0 1 /end COMPU_METHOD
/begin COMPU_METHOD Identity "Identity" RAT_FUNC "%3.0" "-" COEFFS 0 1 0 0 0 1 /end COMPU_METHOD
/begin COMPU_METHOD Def_f_ub_b4 "Def_f_ub_b4" RAT_FUNC "%5.2" "-" COEFFS 0 256 0 0 0 4 /end COMPU_METHOD
/begin COMPU_METHOD Def_f_uw_b256 "Def_f_uw_b256" RAT_FUNC "%8.3" "-" COEFFS 0 65536 0 0 0 256 /end COMPU_METHOD
/begin COMPU_METHOD Def_f_ub_b100 "Def_f_ub_b100" RAT_FUNC "%5.2" "%" COEFFS 0 256 0 0 0 100 /end COMPU_METHOD
/begin COMPU_METHOD Def_f_uw_b100 "Def_f_uw_b100" RAT_FUNC "%8.3" "%" COEFFS 0 65536 0 0 0 100 /end COMPU_METHOD
/begin COMPU_METHOD Def_bit_ub_0 "Def_bit_ub_0" TAB_VERB "%5.2" "-" COMPU_TAB_REF Def_bit_ub_0_VTAB /end COMPU_METHOD
/begin COMPU_METHOD Def_bit_ub_1 "Def_bit_ub_1" TAB_VERB "%5.2" "-" COMPU_TAB_REF Def_bit_ub_1_VTAB /end COMPU_METHOD
/begin COMPU_METHOD Def_bit_ub_2 "Def_bit_ub_2" TAB_VERB "%5.2" "-" COMPU_TAB_REF Def_bit_ub_2_VTAB /end COMPU_METHOD
/begin COMPU_METHOD Def_bit_ub_3 "Def_bit_ub_3" TAB_VERB "%5.2" "-" COMPU_TAB_REF Def_bit_ub_3_VTAB /end COMPU_METHOD
/begin COMPU_METHOD Def_st_ub_q1 "Def_st_ub_q1" RAT_FUNC "%3.0" "-" COEFFS 0 1 0 0 0 1 /end COMPU_METHOD
/begin COMPU_METHOD Def_td_uw_q0p01 "Def_td_uw_q0p01" RAT_FUNC "%7.2" "s" COEFFS 0 100 0 0 0 1 /end COMPU_METHOD
/begin COMPU_METHOD Def_f_ub_b100 "Def_f_ub_b100" RAT_FUNC "%5.2" "%" COEFFS 0 256 0 0 0 100 /end COMPU_METHOD
/begin COMPU_METHOD Def_dez_ub_q1 "Def_dez_ub_q1" RAT_FUNC "%3.0" "-" COEFFS 0 1 0 0 0 1 /end COMPU_METHOD
/begin COMPU_METHOD Def_f_uw_b100 "Def_f_uw_b100" RAT_FUNC "%8.3" "%" COEFFS 0 65536 0 0 0 100 /end COMPU_METHOD
/begin COMPU_METHOD Identity "Identity" RAT_FUNC "%3.0" "-" COEFFS 0 1 0 0 0 1 /end COMPU_METHOD
/begin COMPU_METHOD Def_f_ub_b1 "Def_f_ub_b1" RAT_FUNC "%6.3" "-" COEFFS 0 256 0 0 0 1 /end COMPU_METHOD
/begin COMPU_METHOD Def_f_ub_b32 "Def_f_ub_b32" RAT_FUNC "%5.2" "-" COEFFS 0 256 0 0 0 32 /end COMPU_METHOD
/begin COMPU_METHOD Def_f_ub_b4 "Def_f_ub_b4" RAT_FUNC "%5.2" "-" COEFFS 0 256 0 0 0 4 /end COMPU_METHOD
/begin COMPU_METHOD Def_f_ub_b2 "Def_f_ub_b2" RAT_FUNC "%6.3" "-" COEFFS 0 256 0 0 0 2 /end COMPU_METHOD
/begin COMPU_METHOD Def_bit_ub_0 "Def_bit_ub_0" TAB_VERB "%5.2" "-" COMPU_TAB_REF Def_bit_ub_0_VTAB /end COMPU_METHOD
/begin COMPU_METHOD Def_bit_ub_1 "Def_bit_ub_1" TAB_VERB "%5.2" "-" COMPU_TAB_REF Def_bit_ub_1_VTAB /end COMPU_METHOD
/begin COMPU_METHOD Def_bit_ub_2 "Def_bit_ub_2" TAB_VERB "%5.2" "-" COMPU_TAB_REF Def_bit_ub_2_VTAB /end COMPU_METHOD
/begin COMPU_METHOD Def_bit_ub_3 "Def_bit_ub_3" TAB_VERB "%5.2" "-" COMPU_TAB_REF Def_bit_ub_3_VTAB /end COMPU_METHOD
/begin COMPU_METHOD Def_bit_ub_4 "Def_bit_ub_4" TAB_VERB "%5.2" "-" COMPU_TAB_REF Def_bit_ub_4_VTAB /end COMPU_METHOD
/begin COMPU_METHOD Def_bit_ub_5 "Def_bit_ub_5" TAB_VERB "%5.2" "-" COMPU_TAB_REF Def_bit_ub_5_VTAB /end COMPU_METHOD
/begin COMPU_METHOD Def_st_ub_q1 "Def_st_ub_q1" RAT_FUNC "%3.0" "-" COEFFS 0 1 0 0 0 1 /end COMPU_METHOD
/begin COMPU_METHOD Def_dez_sw_q1 "Def_dez_sw_q1" RAT_FUNC "%5.0" "-" COEFFS 0 1 0 0 0 1 /end COMPU_METHOD
/begin COMPU_METHOD Def_dez_uw_q1 "Def_dez_uw_q1" RAT_FUNC "%5.0" "-" COEFFS 0 1 0 0 0 1 /end COMPU_METHOD
/begin COMPU_METHOD Def_f_sb_b64 "Def_f_sb_b64" RAT_FUNC "%5.2" "-" COEFFS 0 128 0 0 0 64 /end COMPU_METHOD
/begin COMPU_METHOD Def_dez_ub_q1 "Def_dez_ub_q1" RAT_FUNC "%3.0" "-" COEFFS 0 1 0 0 0 1 /end COMPU_METHOD
/begin COMPU_METHOD Def_bit_ub_0 "Def_bit_ub_0" TAB_VERB "%5.2" "-" COMPU_TAB_REF Def_bit_ub_0_VTAB /end COMPU_METHOD
/begin COMPU_METHOD Def_bit_ub_1 "Def_bit_ub_1" TAB_VERB "%5.2" "-" COMPU_TAB_REF Def_bit_ub_1_VTAB /end COMPU_METHOD
/begin COMPU_METHOD Def_bit_ub_2 "Def_bit_ub_2" TAB_VERB "%5.2" "-" COMPU_TAB_REF Def_bit_ub_2_VTAB /end COMPU_METHOD
/begin COMPU_METHOD Def_bit_ub_3 "Def_bit_ub_3" TAB_VERB "%5.2" "-" COMPU_TAB_REF Def_bit_ub_3_VTAB /end COMPU_METHOD
/begin COMPU_METHOD Def_bit_ub_4 "Def_bit_ub_4" TAB_VERB "%5.2" "-" COMPU_TAB_REF Def_bit_ub_4_VTAB /end COMPU_METHOD
/begin COMPU_METHOD Def_bit_ub_5 "Def_bit_ub_5" TAB_VERB "%5.2" "-" COMPU_TAB_REF Def_bit_ub_5_VTAB /end COMPU_METHOD
/begin COMPU_METHOD Def_bit_ub_6 "Def_bit_ub_6" TAB_VERB "%5.2" "-" COMPU_TAB_REF Def_bit_ub_6_VTAB /end COMPU_METHOD
/begin COMPU_METHOD Def_bit_ub_7 "Def_bit_ub_7" TAB_VERB "%5.2" "-" COMPU_TAB_REF Def_bit_ub_7_VTAB /end COMPU_METHOD
/begin COMPU_METHOD Def_st_ub_q1 "Def_st_ub_q1" RAT_FUNC "%3.0" "-" COEFFS 0 1 0 0 0 1 /end COMPU_METHOD
/begin COMPU_METHOD Def_dez_uw_q1 "Def_dez_uw_q1" RAT_FUNC "%5.0" "-" COEFFS 0 1 0 0 0 1 /end COMPU_METHOD
/begin COMPU_METHOD Def_dez_ub_q1 "Def_dez_ub_q1" RAT_FUNC "%3.0" "-" COEFFS 0 1 0 0 0 1 /end COMPU_METHOD
/begin COMPU_METHOD Identity "Identity" RAT_FUNC "%3.0" "-" COEFFS 0 1 0 0 0 1 /end COMPU_METHOD
/begin COMPU_METHOD Def_bit_ub_0 "Def_bit_ub_0" TAB_VERB "%5.2" "-" COMPU_TAB_REF Def_bit_ub_0_VTAB /end COMPU_METHOD
/begin COMPU_METHOD Def_bit_ub_1 "Def_bit_ub_1" TAB_VERB "%5.2" "-" COMPU_TAB_REF Def_bit_ub_1_VTAB /end COMPU_METHOD
/begin COMPU_METHOD Def_bit_ub_2 "Def_bit_ub_2" TAB_VERB "%5.2" "-" COMPU_TAB_REF Def_bit_ub_2_VTAB /end COMPU_METHOD
/begin COMPU_METHOD Def_bit_ub_3 "Def_bit_ub_3" TAB_VERB "%5.2" "-" COMPU_TAB_REF Def_bit_ub_3_VTAB /end COMPU_METHOD
/begin COMPU_METHOD Def_bit_ub_4 "Def_bit_ub_4" TAB_VERB "%5.2" "-" COMPU_TAB_REF Def_bit_ub_4_VTAB /end COMPU_METHOD
/begin COMPU_METHOD Def_bit_ub_5 "Def_bit_ub_5" TAB_VERB "%5.2" "-" COMPU_TAB_REF Def_bit_ub_5_VTAB /end COMPU_METHOD
/begin COMPU_METHOD Def_st_ub_q1 "Def_st_ub_q1" RAT_FUNC "%3.0" "-" COEFFS 0 1 0 0 0 1 /end COMPU_METHOD
/begin COMPU_METHOD Def_bit_ub_6 "Def_bit_ub_6" TAB_VERB "%5.2" "-" COMPU_TAB_REF Def_bit_ub_6_VTAB /end COMPU_METHOD
/begin COMPU_METHOD Def_dez_ub_q1 "Def_dez_ub_q1" RAT_FUNC "%3.0" "-" COEFFS 0 1 0 0 0 1 /end COMPU_METHOD
/begin COMPU_METHOD Def_t_sw_q0p1 "Def_t_sw_q0p1" RAT_FUNC "%6.1" "°C" COEFFS 0 10 0 0 0 1 /end COMPU_METHOD
/begin COMPU_METHOD Def_dez_uw_q1 "Def_dez_uw_q1" RAT_FUNC "%5.0" "-" COEFFS 0 1 0 0 0 1 /end COMPU_METHOD
/begin COMPU_METHOD Def_f_ub_b2 "Def_f_ub_b2" RAT_FUNC "%6.3" "-" COEFFS 0 256 0 0 0 2 /end COMPU_METHOD
/begin COMPU_METHOD Def_t_sw_q0p01 "Def_t_sw_q0p01" RAT_FUNC "%7.2" "°C" COEFFS 0 100 0 0 0 1 /end COMPU_METHOD
/begin COMPU_METHOD Def_bit_ub_0 "Def_bit_ub_0" TAB_VERB "%5.2" "-" COMPU_TAB_REF Def_bit_ub_0_VTAB /end COMPU_METHOD
/begin COMPU_METHOD Def_st_ub_q1 "Def_st_ub_q1" RAT_FUNC "%3.0" "-" COEFFS 0 1 0 0 0 1 /end COMPU_METHOD
/begin COMPU_METHOD Def_dez_ub_q1 "Def_dez_ub_q1" RAT_FUNC "%3.0" "-" COEFFS 0 1 0 0 0 1 /end COMPU_METHOD
/begin COMPU_METHOD Def_dez_uw_q1 "Def_dez_uw_q1" RAT_FUNC "%5.0" "-" COEFFS 0 1 0 0 0 1 /end COMPU_METHOD
/begin COMPU_METHOD Identity "Identity" RAT_FUNC "%3.0" "-" COEFFS 0 1 0 0 0 1 /end COMPU_METHOD
/begin COMPU_METHOD Def_bit_ub_0 "Def_bit_ub_0" TAB_VERB "%5.2" "-" COMPU_TAB_REF Def_bit_ub_0_VTAB /end COMPU_METHOD
/begin COMPU_METHOD Def_bit_ub_1 "Def_bit_ub_1" TAB_VERB "%5.2" "-" COMPU_TAB_REF Def_bit_ub_1_VTAB /end COMPU_METHOD
/begin COMPU_METHOD Def_bit_ub_2 "Def_bit_ub_2" TAB_VERB "%5.2" "-" COMPU_TAB_REF Def_bit_ub_2_VTAB /end COMPU_METHOD
/begin COMPU_METHOD Def_bit_ub_3 "Def_bit_ub_3" TAB_VERB "%5.2" "-" COMPU_TAB_REF Def_bit_ub_3_VTAB /end COMPU_METHOD
/begin COMPU_METHOD Def_bit_ub_4 "Def_bit_ub_4" TAB_VERB "%5.2" "-" COMPU_TAB_REF Def_bit_ub_4_VTAB /end COMPU_METHOD
/begin COMPU_METHOD Def_bit_ub_5 "Def_bit_ub_5" TAB_VERB "%5.2" "-" COMPU_TAB_REF Def_bit_ub_5_VTAB /end COMPU_METHOD
/begin COMPU_METHOD Def_bit_ub_6 "Def_bit_ub_6" TAB_VERB "%5.2" "-" COMPU_TAB_REF Def_bit_ub_6_VTAB /end COMPU_METHOD
/begin COMPU_METHOD Def_bit_ub_7 "Def_bit_ub_7" TAB_VERB "%5.2" "-" COMPU_TAB_REF Def_bit_ub_7_VTAB /end COMPU_METHOD
/begin COMPU_METHOD Def_st_ub_q1 "Def_st_ub_q1" RAT_FUNC "%3.0" "-" COEFFS 0 1 0 0 0 1 /end COMPU_METHOD
/begin COMPU_METHOD Def_f_sw_b32 "Def_f_sw_b32" RAT_FUNC "%9.4" "-" COEFFS 0 32768 0 0 0 32 /end COMPU_METHOD
/begin COMPU_METHOD Def_dez_uw_q1 "Def_dez_uw_q1" RAT_FUNC "%5.0" "-" COEFFS 0 1 0 0 0 1 /end COMPU_METHOD
/begin COMPU_METHOD Def_f_uw_b100 "Def_f_uw_b100" RAT_FUNC "%8.3" "%" COEFFS 0 65536 0 0 0 100 /end COMPU_METHOD
/begin COMPU_METHOD Def_u_uw_q0p0942 "Def_u_uw_q0p0942" RAT_FUNC "%6.1" "V" COEFFS 0 1 0 0 0 0.0942 /end COMPU_METHOD
/begin COMPU_METHOD Def_dez_ub_q1 "Def_dez_ub_q1" RAT_FUNC "%3.0" "-" COEFFS 0 1 0 0 0 1 /end COMPU_METHOD
/begin COMPU_METHOD Def_f_ub_b100 "Def_f_ub_b100" RAT_FUNC "%5.2" "%" COEFFS 0 256 0 0 0 100 /end COMPU_METHOD
/begin COMPU_METHOD Def_n_sw_q1p0 "Def_n_sw_q1p0" RAT_FUNC "%5.0" "Upm" COEFFS 0 1 0 0 0 1 /end COMPU_METHOD
/begin COMPU_METHOD Def_f_uw_b1 "Def_f_uw_b1" RAT_FUNC "%14.5" "-" COEFFS 0 65536 0 0 0 1 /end COMPU_METHOD
/begin COMPU_METHOD Def_f_ub_b1 "Def_f_ub_b1" RAT_FUNC "%6.3" "-" COEFFS 0 256 0 0 0 1 /end COMPU_METHOD
/begin COMPU_METHOD Def_td_ub_q1 "Def_td_ub_q1" RAT_FUNC "%5.2" "s" COEFFS 0 1 0 0 0 1 /end COMPU_METHOD
/begin COMPU_METHOD Identity "Identity" RAT_FUNC "%3.0" "-" COEFFS 0 1 0 0 0 1 /end COMPU_METHOD
/begin COMPU_METHOD Def_t_sw_q0p1 "Def_t_sw_q0p1" RAT_FUNC "%6.1" "°C" COEFFS 0 10 0 0 0 1 /end COMPU_METHOD
/begin COMPU_METHOD Def_f_ub_b4 "Def_f_ub_b4" RAT_FUNC "%5.2" "-" COEFFS 0 256 0 0 0 4 /end COMPU_METHOD
/begin COMPU_METHOD Def_bit_ub_1 "Def_bit_ub_1" TAB_VERB "%5.2" "-" COMPU_TAB_REF Def_bit_ub_1_VTAB /end COMPU_METHOD
/begin COMPU_METHOD Def_bit_ub_2 "Def_bit_ub_2" TAB_VERB "%5.2" "-" COMPU_TAB_REF Def_bit_ub_2_VTAB /end COMPU_METHOD
/begin COMPU_METHOD Def_st_ub_q1 "Def_st_ub_q1" RAT_FUNC "%3.0" "-" COEFFS 0 1 0 0 0 1 /end COMPU_METHOD
/begin COMPU_METHOD Def_bit_ub_0 "Def_bit_ub_0" TAB_VERB "%5.2" "-" COMPU_TAB_REF Def_bit_ub_0_VTAB /end COMPU_METHOD
/begin COMPU_METHOD Def_t_sw_q0p1 "Def_t_sw_q0p1" RAT_FUNC "%6.1" "°C" COEFFS 0 10 0 0 0 1 /end COMPU_METHOD
/begin COMPU_METHOD Def_f_uw_b100 "Def_f_uw_b100" RAT_FUNC "%8.3" "%" COEFFS 0 65536 0 0 0 100 /end COMPU_METHOD
/begin COMPU_METHOD Def_dez_ub_q1 "Def_dez_ub_q1" RAT_FUNC "%3.0" "-" COEFFS 0 1 0 0 0 1 /end COMPU_METHOD
/begin COMPU_METHOD Def_f_ub_b8 "Def_f_ub_b8" RAT_FUNC "%5.2" "-" COEFFS 0 256 0 0 0 8 /end COMPU_METHOD
/begin COMPU_METHOD Def_f_ub_b2 "Def_f_ub_b2" RAT_FUNC "%6.3" "-" COEFFS 0 256 0 0 0 2 /end COMPU_METHOD
/begin COMPU_METHOD Def_f_ub_b4 "Def_f_ub_b4" RAT_FUNC "%5.2" "-" COEFFS 0 256 0 0 0 4 /end COMPU_METHOD
/begin COMPU_METHOD Def_f_uw_b100 "Def_f_uw_b100" RAT_FUNC "%8.3" "%" COEFFS 0 65536 0 0 0 100 /end COMPU_METHOD
/begin COMPU_METHOD Def_f_uw_b1 "Def_f_uw_b1" RAT_FUNC "%14.5" "-" COEFFS 0 65536 0 0 0 1 /end COMPU_METHOD
/begin COMPU_METHOD Def_dez_ub_q1 "Def_dez_ub_q1" RAT_FUNC "%3.0" "-" COEFFS 0 1 0 0 0 1 /end COMPU_METHOD
/begin COMPU_METHOD Def_t_sw_q0p1 "Def_t_sw_q0p1" RAT_FUNC "%6.1" "°C" COEFFS 0 10 0 0 0 1 /end COMPU_METHOD
/begin COMPU_METHOD Def_bit_ub_0 "Def_bit_ub_0" TAB_VERB "%5.2" "-" COMPU_TAB_REF Def_bit_ub_0_VTAB /end COMPU_METHOD
/begin COMPU_METHOD Def_bit_ub_1 "Def_bit_ub_1" TAB_VERB "%5.2" "-" COMPU_TAB_REF Def_bit_ub_1_VTAB /end COMPU_METHOD
/begin COMPU_METHOD Def_bit_ub_2 "Def_bit_ub_2" TAB_VERB "%5.2" "-" COMPU_TAB_REF Def_bit_ub_2_VTAB /end COMPU_METHOD
/begin COMPU_METHOD Def_bit_ub_3 "Def_bit_ub_3" TAB_VERB "%5.2" "-" COMPU_TAB_REF Def_bit_ub_3_VTAB /end COMPU_METHOD
/begin COMPU_METHOD Def_bit_ub_4 "Def_bit_ub_4" TAB_VERB "%5.2" "-" COMPU_TAB_REF Def_bit_ub_4_VTAB /end COMPU_METHOD
/begin COMPU_METHOD Def_bit_ub_5 "Def_bit_ub_5" TAB_VERB "%5.2" "-" COMPU_TAB_REF Def_bit_ub_5_VTAB /end COMPU_METHOD
/begin COMPU_METHOD Def_st_ub_q1 "Def_st_ub_q1" RAT_FUNC "%3.0" "-" COEFFS 0 1 0 0 0 1 /end COMPU_METHOD
/begin COMPU_METHOD Def_t_sw_q0p1 "Def_t_sw_q0p1" RAT_FUNC "%6.1" "°C" COEFFS 0 10 0 0 0 1 /end COMPU_METHOD
/begin COMPU_METHOD Def_f_uw_b100 "Def_f_uw_b100" RAT_FUNC "%8.3" "%" COEFFS 0 65536 0 0 0 100 /end COMPU_METHOD
/begin COMPU_METHOD Identity "Identity" RAT_FUNC "%3.0" "-" COEFFS 0 1 0 0 0 1 /end COMPU_METHOD
/begin COMPU_METHOD Def_td_uw_q1 "Def_td_uw_q1" RAT_FUNC "%5.0" "s" COEFFS 0 1 0 0 0 1 /end COMPU_METHOD
/begin COMPU_METHOD Def_dez_uw_q1 "Def_dez_uw_q1" RAT_FUNC "%5.0" "-" COEFFS 0 1 0 0 0 1 /end COMPU_METHOD
/begin COMPU_METHOD Def_dez_ub_q1 "Def_dez_ub_q1" RAT_FUNC "%3.0" "-" COEFFS 0 1 0 0 0 1 /end COMPU_METHOD
/begin COMPU_METHOD Def_bit_ub_0 "Def_bit_ub_0" TAB_VERB "%5.2" "-" COMPU_TAB_REF Def_bit_ub_0_VTAB /end COMPU_METHOD
/begin COMPU_METHOD Def_bit_ub_1 "Def_bit_ub_1" TAB_VERB "%5.2" "-" COMPU_TAB_REF Def_bit_ub_1_VTAB /end COMPU_METHOD
/begin COMPU_METHOD Def_bit_ub_2 "Def_bit_ub_2" TAB_VERB "%5.2" "-" COMPU_TAB_REF Def_bit_ub_2_VTAB /end COMPU_METHOD
/begin COMPU_METHOD Def_bit_ub_3 "Def_bit_ub_3" TAB_VERB "%5.2" "-" COMPU_TAB_REF Def_bit_ub_3_VTAB /end COMPU_METHOD
/begin COMPU_METHOD Def_st_ub_q1 "Def_st_ub_q1" RAT_FUNC "%3.0" "-" COEFFS 0 1 0 0 0 1 /end COMPU_METHOD
/begin COMPU_METHOD Def_n_sw_q1p0 "Def_n_sw_q1p0" RAT_FUNC "%5.0" "Upm" COEFFS 0 1 0 0 0 1 /end COMPU_METHOD
/begin COMPU_METHOD Def_u_uw_q0p0942 "Def_u_uw_q0p0942" RAT_FUNC "%6.1" "V" COEFFS 0 1 0 0 0 0.0942 /end COMPU_METHOD
/begin COMPU_METHOD Def_dez_ub_q1 "Def_dez_ub_q1" RAT_FUNC "%3.0" "-" COEFFS 0 1 0 0 0 1 /end COMPU_METHOD
/begin COMPU_METHOD Def_f_ub_b32 "Def_f_ub_b32" RAT_FUNC "%5.2" "-" COEFFS 0 256 0 0 0 32 /end COMPU_METHOD
/begin COMPU_METHOD Def_td_uw_q0p01 "Def_td_uw_q0p01" RAT_FUNC "%7.2" "s" COEFFS 0 100 0 0 0 1 /end COMPU_METHOD
/begin COMPU_METHOD Identity "Identity" RAT_FUNC "%3.0" "-" COEFFS 0 1 0 0 0 1 /end COMPU_METHOD
/begin COMPU_METHOD Def_t_sw_q0p1 "Def_t_sw_q0p1" RAT_FUNC "%6.1" "°C" COEFFS 0 10 0 0 0 1 /end COMPU_METHOD
/begin COMPU_METHOD Def_bit_ub_0 "Def_bit_ub_0" TAB_VERB "%5.2" "-" COMPU_TAB_REF Def_bit_ub_0_VTAB /end COMPU_METHOD
/begin COMPU_METHOD Def_bit_ub_1 "Def_bit_ub_1" TAB_VERB "%5.2" "-" COMPU_TAB_REF Def_bit_ub_1_VTAB /end COMPU_METHOD
/begin COMPU_METHOD Def_bit_ub_2 "Def_bit_ub_2" TAB_VERB "%5.2" "-" COMPU_TAB_REF Def_bit_ub_2_VTAB /end COMPU_METHOD
/begin COMPU_METHOD Def_bit_ub_3 "Def_bit_ub_3" TAB_VERB "%5.2" "-" COMPU_TAB_REF Def_bit_ub_3_VTAB /end COMPU_METHOD
/begin COMPU_METHOD Def_bit_ub_4 "Def_bit_ub_4" TAB_VERB "%5.2" "-" COMPU_TAB_REF Def_bit_ub_4_VTAB /end COMPU_METHOD
/begin COMPU_METHOD Def_st_ub_q1 "Def_st_ub_q1" RAT_FUNC "%3.0" "-" COEFFS 0 1 0 0 0 1 /end COMPU_METHOD
/begin COMPU_METHOD Def_dez_uw_q1 "Def_dez_uw_q1" RAT_FUNC "%5.0" "-" COEFFS 0 1 0 0 0 1 /end COMPU_METHOD
/begin COMPU_METHOD Def_dez_ub_q1 "Def_dez_ub_q1" RAT_FUNC "%3.0" "-" COEFFS 0 1 0 0 0 1 /end COMPU_METHOD
/begin COMPU_METHOD Def_v_uw_q1p0 "Def_v_uw_q1p0" RAT_FUNC "%5.0" "km/h" COEFFS 0 1 0 0 0 1 /end COMPU_METHOD
/begin COMPU_METHOD Def_td_uw_q0p01 "Def_td_uw_q0p01" RAT_FUNC "%7.2" "s" COEFFS 0 100 0 0 0 1 /end COMPU_METHOD
/begin COMPU_METHOD Def_f_ub_b100 "Def_f_ub_b100" RAT_FUNC "%5.2" "%" COEFFS 0 256 0 0 0 100 /end COMPU_METHOD
/begin COMPU_METHOD Def_f_ub_b2 "Def_f_ub_b2" RAT_FUNC "%6.3" "-" COEFFS 0 256 0 0 0 2 /end COMPU_METHOD
/begin COMPU_METHOD Def_bit_ub_0 "Def_bit_ub_0" TAB_VERB "%5.2" "-" COMPU_TAB_REF Def_bit_ub_0_VTAB /end COMPU_METHOD
/begin COMPU_METHOD Def_bit_ub_1 "Def_bit_ub_1" TAB_VERB "%5.2" "-" COMPU_TAB_REF Def_bit_ub_1_VTAB /end COMPU_METHOD
/begin COMPU_METHOD Def_st_ub_q1 "Def_st_ub_q1" RAT_FUNC "%3.0" "-" COEFFS 0 1 0 0 0 1 /end COMPU_METHOD
/begin COMPU_METHOD Def_dez_ub_q1 "Def_dez_ub_q1" RAT_FUNC "%3.0" "-" COEFFS 0 1 0 0 0 1 /end COMPU_METHOD
/begin COMPU_METHOD Def_bit_ub_3 "Def_bit_ub_3" TAB_VERB "%5.2" "-" COMPU_TAB_REF Def_bit_ub_3_VTAB /end COMPU_METHOD
/begin COMPU_METHOD Def_bit_ub_4 "Def_bit_ub_4" TAB_VERB "%5.2" "-" COMPU_TAB_REF Def_bit_ub_4_VTAB /end COMPU_METHOD
/begin COMPU_METHOD Def_st_ub_q1 "Def_st_ub_q1" RAT_FUNC "%3.0" "-" COEFFS 0 1 0 0 0 1 /end COMPU_METHOD
/begin COMPU_METHOD Def_bit_ub_0 "Def_bit_ub_0" TAB_VERB "%5.2" "-" COMPU_TAB_REF Def_bit_ub_0_VTAB /end COMPU_METHOD
/begin COMPU_METHOD Def_f_uw_b2 "Def_f_uw_b2" RAT_FUNC "%14.5" "-" COEFFS 0 65536 0 0 0 2 /end COMPU_METHOD
/begin COMPU_METHOD Def_dez_uw_q1 "Def_dez_uw_q1" RAT_FUNC "%5.0" "-" COEFFS 0 1 0 0 0 1 /end COMPU_METHOD
/begin COMPU_METHOD Def_dez_ub_q1 "Def_dez_ub_q1" RAT_FUNC "%3.0" "-" COEFFS 0 1 0 0 0 1 /end COMPU_METHOD
/begin COMPU_METHOD Def_f_ub_b100 "Def_f_ub_b100" RAT_FUNC "%5.2" "%" COEFFS 0 256 0 0 0 100 /end COMPU_METHOD
/begin COMPU_METHOD Def_f_ub_b32 "Def_f_ub_b32" RAT_FUNC "%5.2" "-" COEFFS 0 256 0 0 0 32 /end COMPU_METHOD
/begin COMPU_METHOD Identity "Identity" RAT_FUNC "%3.0" "-" COEFFS 0 1 0 0 0 1 /end COMPU_METHOD
/begin COMPU_METHOD Def_dez_uw_q1 "Def_dez_uw_q1" RAT_FUNC "%5.0" "-" COEFFS 0 1 0 0 0 1 /end COMPU_METHOD
/begin COMPU_METHOD Def_bit_ub_0 "Def_bit_ub_0" TAB_VERB "%5.2" "-" COMPU_TAB_REF Def_bit_ub_0_VTAB /end COMPU_METHOD
/begin COMPU_METHOD Def_bit_ub_1 "Def_bit_ub_1" TAB_VERB "%5.2" "-" COMPU_TAB_REF Def_bit_ub_1_VTAB /end COMPU_METHOD
/begin COMPU_METHOD Def_bit_ub_2 "Def_bit_ub_2" TAB_VERB "%5.2" "-" COMPU_TAB_REF Def_bit_ub_2_VTAB /end COMPU_METHOD
/begin COMPU_METHOD Def_bit_ub_3 "Def_bit_ub_3" TAB_VERB "%5.2" "-" COMPU_TAB_REF Def_bit_ub_3_VTAB /end COMPU_METHOD
/begin COMPU_METHOD Def_bit_ub_4 "Def_bit_ub_4" TAB_VERB "%5.2" "-" COMPU_TAB_REF Def_bit_ub_4_VTAB /end COMPU_METHOD
/begin COMPU_METHOD Def_bit_ub_5 "Def_bit_ub_5" TAB_VERB "%5.2" "-" COMPU_TAB_REF Def_bit_ub_5_VTAB /end COMPU_METHOD
/begin COMPU_METHOD Def_st_ub_q1 "Def_st_ub_q1" RAT_FUNC "%3.0" "-" COEFFS 0 1 0 0 0 1 /end COMPU_METHOD
/begin COMPU_METHOD Def_dez_ub_q1 "Def_dez_ub_q1" RAT_FUNC "%3.0" "-" COEFFS 0 1 0 0 0 1 /end COMPU_METHOD
/begin COMPU_METHOD Identity "Identity" RAT_FUNC "%3.0" "-" COEFFS 0 1 0 0 0 1 /end COMPU_METHOD
/begin COMPU_METHOD Def_t_sw_q0p1 "Def_t_sw_q0p1" RAT_FUNC "%6.1" "°C" COEFFS 0 10 0 0 0 1 /end COMPU_METHOD
/begin COMPU_METHOD Def_bit_ub_0 "Def_bit_ub_0" TAB_VERB "%5.2" "-" COMPU_TAB_REF Def_bit_ub_0_VTAB /end COMPU_METHOD
/begin COMPU_METHOD Def_st_ub_q1 "Def_st_ub_q1" RAT_FUNC "%3.0" "-" COEFFS 0 1 0 0 0 1 /end COMPU_METHOD
/begin COMPU_METHOD Def_dez_ub_q1 "Def_dez_ub_q1" RAT_FUNC "%3.0" "-" COEFFS 0 1 0 0 0 1 /end COMPU_METHOD
/begin COMPU_METHOD Def_dez_uw_q1 "Def_dez_uw_q1" RAT_FUNC "%5.0" "-" COEFFS 0 1 0 0 0 1 /end COMPU_METHOD
/begin COMPU_METHOD Def_bit_ub_0 "Def_bit_ub_0" TAB_VERB "%5.2" "-" COMPU_TAB_REF Def_bit_ub_0_VTAB /end COMPU_METHOD
/begin COMPU_METHOD Def_st_ub_q1 "Def_st_ub_q1" RAT_FUNC "%3.0" "-" COEFFS 0 1 0 0 0 1 /end COMPU_METHOD
/begin COMPU_METHOD Def_dez_uw_q1 "Def_dez_uw_q1" RAT_FUNC "%5.0" "-" COEFFS 0 1 0 0 0 1 /end COMPU_METHOD
/begin COMPU_METHOD Def_f_ub_b100 "Def_f_ub_b100" RAT_FUNC "%5.2" "%" COEFFS 0 256 0 0 0 100 /end COMPU_METHOD
/begin COMPU_METHOD Def_n_sw_q1p0 "Def_n_sw_q1p0" RAT_FUNC "%5.0" "Upm" COEFFS 0 1 0 0 0 1 /end COMPU_METHOD
/begin COMPU_VTAB Def_bit_ub_1_VTAB "Def_bit_ub_1_VTAB" TAB_VERB 2 0 "FALSE" 1 "TRUE" DEFAULT_VALUE "TRUE" /end COMPU_VTAB
/begin COMPU_VTAB Def_bit_ub_2_VTAB "Def_bit_ub_2_VTAB" TAB_VERB 2 0 "FALSE" 1 "TRUE" DEFAULT_VALUE "TRUE" /end COMPU_VTAB
/begin COMPU_VTAB Def_bit_ub_0_VTAB "Def_bit_ub_0_VTAB" TAB_VERB 2 0 "FALSE" 1 "TRUE" DEFAULT_VALUE "TRUE" /end COMPU_VTAB
/begin COMPU_VTAB Def_bit_ub_3_VTAB "Def_bit_ub_3_VTAB" TAB_VERB 2 0 "FALSE" 1 "TRUE" DEFAULT_VALUE "TRUE" /end COMPU_VTAB
/begin COMPU_VTAB Def_bit_ub_4_VTAB "Def_bit_ub_4_VTAB" TAB_VERB 2 0 "FALSE" 1 "TRUE" DEFAULT_VALUE "TRUE" /end COMPU_VTAB
/begin COMPU_VTAB Def_bit_ub_5_VTAB "Def_bit_ub_5_VTAB" TAB_VERB 2 0 "FALSE" 1 "TRUE" DEFAULT_VALUE "TRUE" /end COMPU_VTAB
/begin COMPU_VTAB Def_bit_ub_6_VTAB "Def_bit_ub_6_VTAB" TAB_VERB 2 0 "FALSE" 1 "TRUE" DEFAULT_VALUE "TRUE" /end COMPU_VTAB
/begin COMPU_VTAB Def_bit_ub_7_VTAB "Def_bit_ub_7_VTAB" TAB_VERB 2 0 "FALSE" 1 "TRUE" DEFAULT_VALUE "TRUE" /end COMPU_VTAB
/begin COMPU_VTAB Def_bit_ub_0_VTAB "Def_bit_ub_0_VTAB" TAB_VERB 2 0 "FALSE" 1 "TRUE" DEFAULT_VALUE "TRUE" /end COMPU_VTAB
/begin COMPU_VTAB Def_bit_ub_1_VTAB "Def_bit_ub_1_VTAB" TAB_VERB 2 0 "FALSE" 1 "TRUE" DEFAULT_VALUE "TRUE" /end COMPU_VTAB
/begin COMPU_VTAB Def_bit_ub_2_VTAB "Def_bit_ub_2_VTAB" TAB_VERB 2 0 "FALSE" 1 "TRUE" DEFAULT_VALUE "TRUE" /end COMPU_VTAB
/begin COMPU_VTAB Def_bit_ub_3_VTAB "Def_bit_ub_3_VTAB" TAB_VERB 2 0 "FALSE" 1 "TRUE" DEFAULT_VALUE "TRUE" /end COMPU_VTAB
/begin COMPU_VTAB Def_bit_ub_0_VTAB "Def_bit_ub_0_VTAB" TAB_VERB 2 0 "FALSE" 1 "TRUE" DEFAULT_VALUE "TRUE" /end COMPU_VTAB
/begin COMPU_VTAB Def_bit_ub_0_VTAB "Def_bit_ub_0_VTAB" TAB_VERB 2 0 "FALSE" 1 "TRUE" DEFAULT_VALUE "TRUE" /end COMPU_VTAB
/begin COMPU_VTAB Def_bit_ub_1_VTAB "Def_bit_ub_1_VTAB" TAB_VERB 2 0 "FALSE" 1 "TRUE" DEFAULT_VALUE "TRUE" /end COMPU_VTAB
/begin COMPU_VTAB Def_bit_ub_2_VTAB "Def_bit_ub_2_VTAB" TAB_VERB 2 0 "FALSE" 1 "TRUE" DEFAULT_VALUE "TRUE" /end COMPU_VTAB
/begin COMPU_VTAB Def_bit_ub_3_VTAB "Def_bit_ub_3_VTAB" TAB_VERB 2 0 "FALSE" 1 "TRUE" DEFAULT_VALUE "TRUE" /end COMPU_VTAB
/begin COMPU_VTAB Def_bit_ub_4_VTAB "Def_bit_ub_4_VTAB" TAB_VERB 2 0 "FALSE" 1 "TRUE" DEFAULT_VALUE "TRUE" /end COMPU_VTAB
/begin COMPU_VTAB Def_bit_ub_5_VTAB "Def_bit_ub_5_VTAB" TAB_VERB 2 0 "FALSE" 1 "TRUE" DEFAULT_VALUE "TRUE" /end COMPU_VTAB
/begin COMPU_VTAB Def_bit_ub_6_VTAB "Def_bit_ub_6_VTAB" TAB_VERB 2 0 "FALSE" 1 "TRUE" DEFAULT_VALUE "TRUE" /end COMPU_VTAB
/begin COMPU_VTAB Def_bit_ub_7_VTAB "Def_bit_ub_7_VTAB" TAB_VERB 2 0 "FALSE" 1 "TRUE" DEFAULT_VALUE "TRUE" /end COMPU_VTAB
/begin COMPU_VTAB Def_bit_ub_0_VTAB "Def_bit_ub_0_VTAB" TAB_VERB 2 0 "FALSE" 1 "TRUE" DEFAULT_VALUE "TRUE" /end COMPU_VTAB
/begin COMPU_VTAB Def_bit_ub_1_VTAB "Def_bit_ub_1_VTAB" TAB_VERB 2 0 "FALSE" 1 "TRUE" DEFAULT_VALUE "TRUE" /end COMPU_VTAB
/begin COMPU_VTAB Def_bit_ub_2_VTAB "Def_bit_ub_2_VTAB" TAB_VERB 2 0 "FALSE" 1 "TRUE" DEFAULT_VALUE "TRUE" /end COMPU_VTAB
/begin COMPU_VTAB Def_bit_ub_0_VTAB "Def_bit_ub_0_VTAB" TAB_VERB 2 0 "FALSE" 1 "TRUE" DEFAULT_VALUE "TRUE" /end COMPU_VTAB
/begin COMPU_VTAB Def_bit_ub_1_VTAB "Def_bit_ub_1_VTAB" TAB_VERB 2 0 "FALSE" 1 "TRUE" DEFAULT_VALUE "TRUE" /end COMPU_VTAB
/begin COMPU_VTAB Def_bit_ub_0_VTAB "Def_bit_ub_0_VTAB" TAB_VERB 2 0 "FALSE" 1 "TRUE" DEFAULT_VALUE "TRUE" /end COMPU_VTAB
/begin COMPU_VTAB Def_bit_ub_1_VTAB "Def_bit_ub_1_VTAB" TAB_VERB 2 0 "FALSE" 1 "TRUE" DEFAULT_VALUE "TRUE" /end COMPU_VTAB
/begin COMPU_VTAB Def_bit_ub_0_VTAB "Def_bit_ub_0_VTAB" TAB_VERB 2 0 "FALSE" 1 "TRUE" DEFAULT_VALUE "TRUE" /end COMPU_VTAB
/begin COMPU_VTAB Def_bit_ub_0_VTAB "Def_bit_ub_0_VTAB" TAB_VERB 2 0 "FALSE" 1 "TRUE" DEFAULT_VALUE "TRUE" /end COMPU_VTAB
/begin COMPU_VTAB Def_bit_ub_1_VTAB "Def_bit_ub_1_VTAB" TAB_VERB 2 0 "FALSE" 1 "TRUE" DEFAULT_VALUE "TRUE" /end COMPU_VTAB
/begin COMPU_VTAB Def_bit_ub_2_VTAB "Def_bit_ub_2_VTAB" TAB_VERB 2 0 "FALSE" 1 "TRUE" DEFAULT_VALUE "TRUE" /end COMPU_VTAB
/begin COMPU_VTAB Def_bit_ub_3_VTAB "Def_bit_ub_3_VTAB" TAB_VERB 2 0 "FALSE" 1 "TRUE" DEFAULT_VALUE "TRUE" /end COMPU_VTAB
/begin COMPU_VTAB Def_bit_ub_4_VTAB "Def_bit_ub_4_VTAB" TAB_VERB 2 0 "FALSE" 1 "TRUE" DEFAULT_VALUE "TRUE" /end COMPU_VTAB
/begin COMPU_VTAB Def_bit_ub_5_VTAB "Def_bit_ub_5_VTAB" TAB_VERB 2 0 "FALSE" 1 "TRUE" DEFAULT_VALUE "TRUE" /end COMPU_VTAB
/begin COMPU_VTAB Def_bit_ub_6_VTAB "Def_bit_ub_6_VTAB" TAB_VERB 2 0 "FALSE" 1 "TRUE" DEFAULT_VALUE "TRUE" /end COMPU_VTAB
/begin COMPU_VTAB Def_bit_ub_7_VTAB "Def_bit_ub_7_VTAB" TAB_VERB 2 0 "FALSE" 1 "TRUE" DEFAULT_VALUE "TRUE" /end COMPU_VTAB
/begin COMPU_VTAB Def_bit_ub_0_VTAB "Def_bit_ub_0_VTAB" TAB_VERB 2 0 "FALSE" 1 "TRUE" DEFAULT_VALUE "TRUE" /end COMPU_VTAB
/begin COMPU_VTAB Def_bit_ub_1_VTAB "Def_bit_ub_1_VTAB" TAB_VERB 2 0 "FALSE" 1 "TRUE" DEFAULT_VALUE "TRUE" /end COMPU_VTAB
/begin COMPU_VTAB Def_bit_ub_2_VTAB "Def_bit_ub_2_VTAB" TAB_VERB 2 0 "FALSE" 1 "TRUE" DEFAULT_VALUE "TRUE" /end COMPU_VTAB
/begin COMPU_VTAB Def_bit_ub_3_VTAB "Def_bit_ub_3_VTAB" TAB_VERB 2 0 "FALSE" 1 "TRUE" DEFAULT_VALUE "TRUE" /end COMPU_VTAB
/begin COMPU_VTAB Def_bit_ub_4_VTAB "Def_bit_ub_4_VTAB" TAB_VERB 2 0 "FALSE" 1 "TRUE" DEFAULT_VALUE "TRUE" /end COMPU_VTAB
/begin COMPU_VTAB Def_bit_ub_5_VTAB "Def_bit_ub_5_VTAB" TAB_VERB 2 0 "FALSE" 1 "TRUE" DEFAULT_VALUE "TRUE" /end COMPU_VTAB
/begin COMPU_VTAB Def_bit_ub_6_VTAB "Def_bit_ub_6_VTAB" TAB_VERB 2 0 "FALSE" 1 "TRUE" DEFAULT_VALUE "TRUE" /end COMPU_VTAB
/begin COMPU_VTAB Def_bit_ub_7_VTAB "Def_bit_ub_7_VTAB" TAB_VERB 2 0 "FALSE" 1 "TRUE" DEFAULT_VALUE "TRUE" /end COMPU_VTAB
/begin COMPU_VTAB Def_bit_ub_2_VTAB "Def_bit_ub_2_VTAB" TAB_VERB 2 0 "FALSE" 1 "TRUE" DEFAULT_VALUE "TRUE" /end COMPU_VTAB
/begin COMPU_VTAB Def_bit_ub_3_VTAB "Def_bit_ub_3_VTAB" TAB_VERB 2 0 "FALSE" 1 "TRUE" DEFAULT_VALUE "TRUE" /end COMPU_VTAB
/begin COMPU_VTAB Def_bit_ub_4_VTAB "Def_bit_ub_4_VTAB" TAB_VERB 2 0 "FALSE" 1 "TRUE" DEFAULT_VALUE "TRUE" /end COMPU_VTAB
/begin COMPU_VTAB Def_bit_ub_0_VTAB "Def_bit_ub_0_VTAB" TAB_VERB 2 0 "FALSE" 1 "TRUE" DEFAULT_VALUE "TRUE" /end COMPU_VTAB
/begin COMPU_VTAB Def_bit_ub_1_VTAB "Def_bit_ub_1_VTAB" TAB_VERB 2 0 "FALSE" 1 "TRUE" DEFAULT_VALUE "TRUE" /end COMPU_VTAB
/begin COMPU_VTAB Def_bit_ub_5_VTAB "Def_bit_ub_5_VTAB" TAB_VERB 2 0 "FALSE" 1 "TRUE" DEFAULT_VALUE "TRUE" /end COMPU_VTAB
/begin COMPU_VTAB Def_bit_ub_0_VTAB "Def_bit_ub_0_VTAB" TAB_VERB 2 0 "FALSE" 1 "TRUE" DEFAULT_VALUE "TRUE" /end COMPU_VTAB
/begin COMPU_VTAB Def_bit_ub_1_VTAB "Def_bit_ub_1_VTAB" TAB_VERB 2 0 "FALSE" 1 "TRUE" DEFAULT_VALUE "TRUE" /end COMPU_VTAB
/begin COMPU_VTAB Def_bit_ub_2_VTAB "Def_bit_ub_2_VTAB" TAB_VERB 2 0 "FALSE" 1 "TRUE" DEFAULT_VALUE "TRUE" /end COMPU_VTAB
/begin COMPU_VTAB Def_bit_ub_3_VTAB "Def_bit_ub_3_VTAB" TAB_VERB 2 0 "FALSE" 1 "TRUE" DEFAULT_VALUE "TRUE" /end COMPU_VTAB
/begin COMPU_VTAB Def_bit_ub_4_VTAB "Def_bit_ub_4_VTAB" TAB_VERB 2 0 "FALSE" 1 "TRUE" DEFAULT_VALUE "TRUE" /end COMPU_VTAB
/begin COMPU_VTAB Def_bit_ub_5_VTAB "Def_bit_ub_5_VTAB" TAB_VERB 2 0 "FALSE" 1 "TRUE" DEFAULT_VALUE "TRUE" /end COMPU_VTAB
/begin COMPU_VTAB Def_bit_ub_6_VTAB "Def_bit_ub_6_VTAB" TAB_VERB 2 0 "FALSE" 1 "TRUE" DEFAULT_VALUE "TRUE" /end COMPU_VTAB
/begin COMPU_VTAB Def_bit_ub_7_VTAB "Def_bit_ub_7_VTAB" TAB_VERB 2 0 "FALSE" 1 "TRUE" DEFAULT_VALUE "TRUE" /end COMPU_VTAB
/begin COMPU_VTAB Def_bit_ub_0_VTAB "Def_bit_ub_0_VTAB" TAB_VERB 2 0 "FALSE" 1 "TRUE" DEFAULT_VALUE "TRUE" /end COMPU_VTAB
/begin COMPU_VTAB Def_bit_ub_1_VTAB "Def_bit_ub_1_VTAB" TAB_VERB 2 0 "FALSE" 1 "TRUE" DEFAULT_VALUE "TRUE" /end COMPU_VTAB
/begin COMPU_VTAB Def_bit_ub_3_VTAB "Def_bit_ub_3_VTAB" TAB_VERB 2 0 "FALSE" 1 "TRUE" DEFAULT_VALUE "TRUE" /end COMPU_VTAB
/begin COMPU_VTAB Def_bit_ub_5_VTAB "Def_bit_ub_5_VTAB" TAB_VERB 2 0 "FALSE" 1 "TRUE" DEFAULT_VALUE "TRUE" /end COMPU_VTAB
/begin COMPU_VTAB Def_bit_ub_6_VTAB "Def_bit_ub_6_VTAB" TAB_VERB 2 0 "FALSE" 1 "TRUE" DEFAULT_VALUE "TRUE" /end COMPU_VTAB
/begin COMPU_VTAB Def_bit_ub_7_VTAB "Def_bit_ub_7_VTAB" TAB_VERB 2 0 "FALSE" 1 "TRUE" DEFAULT_VALUE "TRUE" /end COMPU_VTAB
/begin COMPU_VTAB Def_bit_ub_2_VTAB "Def_bit_ub_2_VTAB" TAB_VERB 2 0 "FALSE" 1 "TRUE" DEFAULT_VALUE "TRUE" /end COMPU_VTAB
/begin COMPU_VTAB Def_bit_ub_4_VTAB "Def_bit_ub_4_VTAB" TAB_VERB 2 0 "FALSE" 1 "TRUE" DEFAULT_VALUE "TRUE" /end COMPU_VTAB
/begin COMPU_VTAB Def_bit_ub_0_VTAB "Def_bit_ub_0_VTAB" TAB_VERB 2 0 "FALSE" 1 "TRUE" DEFAULT_VALUE "TRUE" /end COMPU_VTAB
/begin COMPU_VTAB Def_bit_ub_1_VTAB "Def_bit_ub_1_VTAB" TAB_VERB 2 0 "FALSE" 1 "TRUE" DEFAULT_VALUE "TRUE" /end COMPU_VTAB
/begin COMPU_VTAB Def_bit_ub_2_VTAB "Def_bit_ub_2_VTAB" TAB_VERB 2 0 "FALSE" 1 "TRUE" DEFAULT_VALUE "TRUE" /end COMPU_VTAB
/begin COMPU_VTAB Def_bit_ub_4_VTAB "Def_bit_ub_4_VTAB" TAB_VERB 2 0 "FALSE" 1 "TRUE" DEFAULT_VALUE "TRUE" /end COMPU_VTAB
/begin COMPU_VTAB Def_bit_ub_5_VTAB "Def_bit_ub_5_VTAB" TAB_VERB 2 0 "FALSE" 1 "TRUE" DEFAULT_VALUE "TRUE" /end COMPU_VTAB
/begin COMPU_VTAB Def_bit_ub_0_VTAB "Def_bit_ub_0_VTAB" TAB_VERB 2 0 "FALSE" 1 "TRUE" DEFAULT_VALUE "TRUE" /end COMPU_VTAB
/begin COMPU_VTAB Def_bit_ub_0_VTAB "Def_bit_ub_0_VTAB" TAB_VERB 2 0 "FALSE" 1 "TRUE" DEFAULT_VALUE "TRUE" /end COMPU_VTAB
/begin COMPU_VTAB Def_bit_ub_1_VTAB "Def_bit_ub_1_VTAB" TAB_VERB 2 0 "FALSE" 1 "TRUE" DEFAULT_VALUE "TRUE" /end COMPU_VTAB
/begin COMPU_VTAB Def_bit_ub_2_VTAB "Def_bit_ub_2_VTAB" TAB_VERB 2 0 "FALSE" 1 "TRUE" DEFAULT_VALUE "TRUE" /end COMPU_VTAB
/begin COMPU_VTAB Def_bit_ub_3_VTAB "Def_bit_ub_3_VTAB" TAB_VERB 2 0 "FALSE" 1 "TRUE" DEFAULT_VALUE "TRUE" /end COMPU_VTAB
/begin COMPU_VTAB Def_bit_ub_4_VTAB "Def_bit_ub_4_VTAB" TAB_VERB 2 0 "FALSE" 1 "TRUE" DEFAULT_VALUE "TRUE" /end COMPU_VTAB
/begin COMPU_VTAB Def_bit_ub_0_VTAB "Def_bit_ub_0_VTAB" TAB_VERB 2 0 "FALSE" 1 "TRUE" DEFAULT_VALUE "TRUE" /end COMPU_VTAB
/begin COMPU_VTAB Def_bit_ub_1_VTAB "Def_bit_ub_1_VTAB" TAB_VERB 2 0 "FALSE" 1 "TRUE" DEFAULT_VALUE "TRUE" /end COMPU_VTAB
/begin COMPU_VTAB Def_bit_ub_2_VTAB "Def_bit_ub_2_VTAB" TAB_VERB 2 0 "FALSE" 1 "TRUE" DEFAULT_VALUE "TRUE" /end COMPU_VTAB
/begin COMPU_VTAB Def_bit_ub_3_VTAB "Def_bit_ub_3_VTAB" TAB_VERB 2 0 "FALSE" 1 "TRUE" DEFAULT_VALUE "TRUE" /end COMPU_VTAB
/begin COMPU_VTAB Def_bit_ub_4_VTAB "Def_bit_ub_4_VTAB" TAB_VERB 2 0 "FALSE" 1 "TRUE" DEFAULT_VALUE "TRUE" /end COMPU_VTAB
/begin COMPU_VTAB Def_bit_ub_5_VTAB "Def_bit_ub_5_VTAB" TAB_VERB 2 0 "FALSE" 1 "TRUE" DEFAULT_VALUE "TRUE" /end COMPU_VTAB
/begin COMPU_VTAB Def_bit_ub_6_VTAB "Def_bit_ub_6_VTAB" TAB_VERB 2 0 "FALSE" 1 "TRUE" DEFAULT_VALUE "TRUE" /end COMPU_VTAB
/begin COMPU_VTAB Def_bit_ub_7_VTAB "Def_bit_ub_7_VTAB" TAB_VERB 2 0 "FALSE" 1 "TRUE" DEFAULT_VALUE "TRUE" /end COMPU_VTAB
/begin COMPU_VTAB Def_bit_ub_0_VTAB "Def_bit_ub_0_VTAB" TAB_VERB 2 0 "FALSE" 1 "TRUE" DEFAULT_VALUE "TRUE" /end COMPU_VTAB
/begin COMPU_VTAB Def_bit_ub_1_VTAB "Def_bit_ub_1_VTAB" TAB_VERB 2 0 "FALSE" 1 "TRUE" DEFAULT_VALUE "TRUE" /end COMPU_VTAB
/begin COMPU_VTAB Def_bit_ub_1_VTAB "Def_bit_ub_1_VTAB" TAB_VERB 2 0 "FALSE" 1 "TRUE" DEFAULT_VALUE "TRUE" /end COMPU_VTAB
/begin COMPU_VTAB Def_bit_ub_2_VTAB "Def_bit_ub_2_VTAB" TAB_VERB 2 0 "FALSE" 1 "TRUE" DEFAULT_VALUE "TRUE" /end COMPU_VTAB
/begin COMPU_VTAB Def_bit_ub_3_VTAB "Def_bit_ub_3_VTAB" TAB_VERB 2 0 "FALSE" 1 "TRUE" DEFAULT_VALUE "TRUE" /end COMPU_VTAB
/begin COMPU_VTAB Def_bit_ub_0_VTAB "Def_bit_ub_0_VTAB" TAB_VERB 2 0 "FALSE" 1 "TRUE" DEFAULT_VALUE "TRUE" /end COMPU_VTAB
/begin COMPU_VTAB Def_bit_ub_0_VTAB "Def_bit_ub_0_VTAB" TAB_VERB 2 0 "FALSE" 1 "TRUE" DEFAULT_VALUE "TRUE" /end COMPU_VTAB
/begin COMPU_VTAB Def_bit_ub_1_VTAB "Def_bit_ub_1_VTAB" TAB_VERB 2 0 "FALSE" 1 "TRUE" DEFAULT_VALUE "TRUE" /end COMPU_VTAB
/begin COMPU_VTAB Def_bit_ub_0_VTAB "Def_bit_ub_0_VTAB" TAB_VERB 2 0 "FALSE" 1 "TRUE" DEFAULT_VALUE "TRUE" /end COMPU_VTAB
/begin COMPU_VTAB Def_bit_ub_0_VTAB "Def_bit_ub_0_VTAB" TAB_VERB 2 0 "FALSE" 1 "TRUE" DEFAULT_VALUE "TRUE" /end COMPU_VTAB
/begin COMPU_VTAB Def_bit_ub_1_VTAB "Def_bit_ub_1_VTAB" TAB_VERB 2 0 "FALSE" 1 "TRUE" DEFAULT_VALUE "TRUE" /end COMPU_VTAB
/begin COMPU_VTAB Def_bit_ub_0_VTAB "Def_bit_ub_0_VTAB" TAB_VERB 2 0 "FALSE" 1 "TRUE" DEFAULT_VALUE "TRUE" /end COMPU_VTAB
/begin COMPU_VTAB Def_bit_ub_1_VTAB "Def_bit_ub_1_VTAB" TAB_VERB 2 0 "FALSE" 1 "TRUE" DEFAULT_VALUE "TRUE" /end COMPU_VTAB
/begin COMPU_VTAB Def_bit_ub_0_VTAB "Def_bit_ub_0_VTAB" TAB_VERB 2 0 "FALSE" 1 "TRUE" DEFAULT_VALUE "TRUE" /end COMPU_VTAB
/begin COMPU_VTAB Def_bit_ub_1_VTAB "Def_bit_ub_1_VTAB" TAB_VERB 2 0 "FALSE" 1 "TRUE" DEFAULT_VALUE "TRUE" /end COMPU_VTAB
/begin COMPU_VTAB Def_bit_ub_2_VTAB "Def_bit_ub_2_VTAB" TAB_VERB 2 0 "FALSE" 1 "TRUE" DEFAULT_VALUE "TRUE" /end COMPU_VTAB
/begin COMPU_VTAB Def_bit_ub_3_VTAB "Def_bit_ub_3_VTAB" TAB_VERB 2 0 "FALSE" 1 "TRUE" DEFAULT_VALUE "TRUE" /end COMPU_VTAB
/begin COMPU_VTAB Def_bit_ub_4_VTAB "Def_bit_ub_4_VTAB" TAB_VERB 2 0 "FALSE" 1 "TRUE" DEFAULT_VALUE "TRUE" /end COMPU_VTAB
/begin COMPU_VTAB Def_bit_ub_0_VTAB "Def_bit_ub_0_VTAB" TAB_VERB 2 0 "FALSE" 1 "TRUE" DEFAULT_VALUE "TRUE" /end COMPU_VTAB
/begin COMPU_VTAB Def_bit_ub_1_VTAB "Def_bit_ub_1_VTAB" TAB_VERB 2 0 "FALSE" 1 "TRUE" DEFAULT_VALUE "TRUE" /end COMPU_VTAB
/begin COMPU_VTAB Def_bit_ub_2_VTAB "Def_bit_ub_2_VTAB" TAB_VERB 2 0 "FALSE" 1 "TRUE" DEFAULT_VALUE "TRUE" /end COMPU_VTAB
/begin COMPU_VTAB Def_bit_ub_0_VTAB "Def_bit_ub_0_VTAB" TAB_VERB 2 0 "FALSE" 1 "TRUE" DEFAULT_VALUE "TRUE" /end COMPU_VTAB
/begin COMPU_VTAB Def_bit_ub_1_VTAB "Def_bit_ub_1_VTAB" TAB_VERB 2 0 "FALSE" 1 "TRUE" DEFAULT_VALUE "TRUE" /end COMPU_VTAB
/begin COMPU_VTAB Def_bit_ub_4_VTAB "Def_bit_ub_4_VTAB" TAB_VERB 2 0 "FALSE" 1 "TRUE" DEFAULT_VALUE "TRUE" /end COMPU_VTAB
/begin COMPU_VTAB Def_bit_ub_5_VTAB "Def_bit_ub_5_VTAB" TAB_VERB 2 0 "FALSE" 1 "TRUE" DEFAULT_VALUE "TRUE" /end COMPU_VTAB
/begin COMPU_VTAB Def_bit_ub_3_VTAB "Def_bit_ub_3_VTAB" TAB_VERB 2 0 "FALSE" 1 "TRUE" DEFAULT_VALUE "TRUE" /end COMPU_VTAB
/begin COMPU_VTAB Def_bit_ub_2_VTAB "Def_bit_ub_2_VTAB" TAB_VERB 2 0 "FALSE" 1 "TRUE" DEFAULT_VALUE "TRUE" /end COMPU_VTAB
/begin COMPU_VTAB Def_bit_ub_0_VTAB "Def_bit_ub_0_VTAB" TAB_VERB 2 0 "FALSE" 1 "TRUE" DEFAULT_VALUE "TRUE" /end COMPU_VTAB
/begin COMPU_VTAB Def_bit_ub_0_VTAB "Def_bit_ub_0_VTAB" TAB_VERB 2 0 "FALSE" 1 "TRUE" DEFAULT_VALUE "TRUE" /end COMPU_VTAB
/begin COMPU_VTAB Def_bit_ub_1_VTAB "Def_bit_ub_1_VTAB" TAB_VERB 2 0 "FALSE" 1 "TRUE" DEFAULT_VALUE "TRUE" /end COMPU_VTAB
/begin COMPU_VTAB Def_bit_ub_2_VTAB "Def_bit_ub_2_VTAB" TAB_VERB 2 0 "FALSE" 1 "TRUE" DEFAULT_VALUE "TRUE" /end COMPU_VTAB
/begin COMPU_VTAB Def_bit_ub_0_VTAB "Def_bit_ub_0_VTAB" TAB_VERB 2 0 "FALSE" 1 "TRUE" DEFAULT_VALUE "TRUE" /end COMPU_VTAB
/begin COMPU_VTAB Def_bit_ub_0_VTAB "Def_bit_ub_0_VTAB" TAB_VERB 2 0 "FALSE" 1 "TRUE" DEFAULT_VALUE "TRUE" /end COMPU_VTAB
/begin COMPU_VTAB Def_bit_ub_1_VTAB "Def_bit_ub_1_VTAB" TAB_VERB 2 0 "FALSE" 1 "TRUE" DEFAULT_VALUE "TRUE" /end COMPU_VTAB
/begin COMPU_VTAB Def_bit_ub_2_VTAB "Def_bit_ub_2_VTAB" TAB_VERB 2 0 "FALSE" 1 "TRUE" DEFAULT_VALUE "TRUE" /end COMPU_VTAB
/begin COMPU_VTAB Def_bit_ub_3_VTAB "Def_bit_ub_3_VTAB" TAB_VERB 2 0 "FALSE" 1 "TRUE" DEFAULT_VALUE "TRUE" /end COMPU_VTAB
/begin COMPU_VTAB Def_bit_ub_4_VTAB "Def_bit_ub_4_VTAB" TAB_VERB 2 0 "FALSE" 1 "TRUE" DEFAULT_VALUE "TRUE" /end COMPU_VTAB
/begin COMPU_VTAB Def_bit_ub_5_VTAB "Def_bit_ub_5_VTAB" TAB_VERB 2 0 "FALSE" 1 "TRUE" DEFAULT_VALUE "TRUE" /end COMPU_VTAB
/begin COMPU_VTAB Def_bit_ub_6_VTAB "Def_bit_ub_6_VTAB" TAB_VERB 2 0 "FALSE" 1 "TRUE" DEFAULT_VALUE "TRUE" /end COMPU_VTAB
/begin COMPU_VTAB Def_bit_ub_7_VTAB "Def_bit_ub_7_VTAB" TAB_VERB 2 0 "FALSE" 1 "TRUE" DEFAULT_VALUE "TRUE" /end COMPU_VTAB
/begin COMPU_VTAB Def_bit_ub_0_VTAB "Def_bit_ub_0_VTAB" TAB_VERB 2 0 "FALSE" 1 "TRUE" DEFAULT_VALUE "TRUE" /end COMPU_VTAB
/begin COMPU_VTAB Def_bit_ub_1_VTAB "Def_bit_ub_1_VTAB" TAB_VERB 2 0 "FALSE" 1 "TRUE" DEFAULT_VALUE "TRUE" /end COMPU_VTAB
/begin COMPU_VTAB Def_bit_ub_2_VTAB "Def_bit_ub_2_VTAB" TAB_VERB 2 0 "FALSE" 1 "TRUE" DEFAULT_VALUE "TRUE" /end COMPU_VTAB
/begin COMPU_VTAB Def_bit_ub_3_VTAB "Def_bit_ub_3_VTAB" TAB_VERB 2 0 "FALSE" 1 "TRUE" DEFAULT_VALUE "TRUE" /end COMPU_VTAB
/begin COMPU_VTAB Def_bit_ub_4_VTAB "Def_bit_ub_4_VTAB" TAB_VERB 2 0 "FALSE" 1 "TRUE" DEFAULT_VALUE "TRUE" /end COMPU_VTAB
/begin COMPU_VTAB Def_bit_ub_5_VTAB "Def_bit_ub_5_VTAB" TAB_VERB 2 0 "FALSE" 1 "TRUE" DEFAULT_VALUE "TRUE" /end COMPU_VTAB
/begin COMPU_VTAB Def_bit_ub_6_VTAB "Def_bit_ub_6_VTAB" TAB_VERB 2 0 "FALSE" 1 "TRUE" DEFAULT_VALUE "TRUE" /end COMPU_VTAB
/begin COMPU_VTAB Def_bit_ub_7_VTAB "Def_bit_ub_7_VTAB" TAB_VERB 2 0 "FALSE" 1 "TRUE" DEFAULT_VALUE "TRUE" /end COMPU_VTAB
/begin COMPU_VTAB Def_bit_ub_0_VTAB "Def_bit_ub_0_VTAB" TAB_VERB 2 0 "FALSE" 1 "TRUE" DEFAULT_VALUE "TRUE" /end COMPU_VTAB
/begin COMPU_VTAB Def_bit_ub_1_VTAB "Def_bit_ub_1_VTAB" TAB_VERB 2 0 "FALSE" 1 "TRUE" DEFAULT_VALUE "TRUE" /end COMPU_VTAB
/begin COMPU_VTAB Def_bit_ub_2_VTAB "Def_bit_ub_2_VTAB" TAB_VERB 2 0 "FALSE" 1 "TRUE" DEFAULT_VALUE "TRUE" /end COMPU_VTAB
/begin COMPU_VTAB Def_bit_ub_3_VTAB "Def_bit_ub_3_VTAB" TAB_VERB 2 0 "FALSE" 1 "TRUE" DEFAULT_VALUE "TRUE" /end COMPU_VTAB
/begin COMPU_VTAB Def_bit_ub_4_VTAB "Def_bit_ub_4_VTAB" TAB_VERB 2 0 "FALSE" 1 "TRUE" DEFAULT_VALUE "TRUE" /end COMPU_VTAB
/begin COMPU_VTAB Def_bit_ub_5_VTAB "Def_bit_ub_5_VTAB" TAB_VERB 2 0 "FALSE" 1 "TRUE" DEFAULT_VALUE "TRUE" /end COMPU_VTAB
/begin COMPU_VTAB Def_bit_ub_6_VTAB "Def_bit_ub_6_VTAB" TAB_VERB 2 0 "FALSE" 1 "TRUE" DEFAULT_VALUE "TRUE" /end COMPU_VTAB
/begin COMPU_VTAB Def_bit_ub_7_VTAB "Def_bit_ub_7_VTAB" TAB_VERB 2 0 "FALSE" 1 "TRUE" DEFAULT_VALUE "TRUE" /end COMPU_VTAB
/begin COMPU_VTAB Def_bit_ub_0_VTAB "Def_bit_ub_0_VTAB" TAB_VERB 2 0 "FALSE" 1 "TRUE" DEFAULT_VALUE "TRUE" /end COMPU_VTAB
/begin COMPU_VTAB Def_bit_ub_1_VTAB "Def_bit_ub_1_VTAB" TAB_VERB 2 0 "FALSE" 1 "TRUE" DEFAULT_VALUE "TRUE" /end COMPU_VTAB
/begin COMPU_VTAB Def_bit_ub_2_VTAB "Def_bit_ub_2_VTAB" TAB_VERB 2 0 "FALSE" 1 "TRUE" DEFAULT_VALUE "TRUE" /end COMPU_VTAB
/begin COMPU_VTAB Def_bit_ub_3_VTAB "Def_bit_ub_3_VTAB" TAB_VERB 2 0 "FALSE" 1 "TRUE" DEFAULT_VALUE "TRUE" /end COMPU_VTAB
/begin COMPU_VTAB Def_bit_ub_4_VTAB "Def_bit_ub_4_VTAB" TAB_VERB 2 0 "FALSE" 1 "TRUE" DEFAULT_VALUE "TRUE" /end COMPU_VTAB
/begin COMPU_VTAB Def_bit_ub_5_VTAB "Def_bit_ub_5_VTAB" TAB_VERB 2 0 "FALSE" 1 "TRUE" DEFAULT_VALUE "TRUE" /end COMPU_VTAB
/begin COMPU_VTAB Def_bit_ub_0_VTAB "Def_bit_ub_0_VTAB" TAB_VERB 2 0 "FALSE" 1 "TRUE" DEFAULT_VALUE "TRUE" /end COMPU_VTAB
/begin COMPU_VTAB Def_bit_ub_1_VTAB "Def_bit_ub_1_VTAB" TAB_VERB 2 0 "FALSE" 1 "TRUE" DEFAULT_VALUE "TRUE" /end COMPU_VTAB
/begin COMPU_VTAB Def_bit_ub_2_VTAB "Def_bit_ub_2_VTAB" TAB_VERB 2 0 "FALSE" 1 "TRUE" DEFAULT_VALUE "TRUE" /end COMPU_VTAB
/begin COMPU_VTAB Def_bit_ub_3_VTAB "Def_bit_ub_3_VTAB" TAB_VERB 2 0 "FALSE" 1 "TRUE" DEFAULT_VALUE "TRUE" /end COMPU_VTAB
/begin COMPU_VTAB Def_bit_ub_0_VTAB "Def_bit_ub_0_VTAB" TAB_VERB 2 0 "FALSE" 1 "TRUE" DEFAULT_VALUE "TRUE" /end COMPU_VTAB
/begin COMPU_VTAB Def_bit_ub_1_VTAB "Def_bit_ub_1_VTAB" TAB_VERB 2 0 "FALSE" 1 "TRUE" DEFAULT_VALUE "TRUE" /end COMPU_VTAB
/begin COMPU_VTAB Def_bit_ub_2_VTAB "Def_bit_ub_2_VTAB" TAB_VERB 2 0 "FALSE" 1 "TRUE" DEFAULT_VALUE "TRUE" /end COMPU_VTAB
/begin COMPU_VTAB Def_bit_ub_3_VTAB "Def_bit_ub_3_VTAB" TAB_VERB 2 0 "FALSE" 1 "TRUE" DEFAULT_VALUE "TRUE" /end COMPU_VTAB
/begin COMPU_VTAB Def_bit_ub_4_VTAB "Def_bit_ub_4_VTAB" TAB_VERB 2 0 "FALSE" 1 "TRUE" DEFAULT_VALUE "TRUE" /end COMPU_VTAB
/begin COMPU_VTAB Def_bit_ub_0_VTAB "Def_bit_ub_0_VTAB" TAB_VERB 2 0 "FALSE" 1 "TRUE" DEFAULT_VALUE "TRUE" /end COMPU_VTAB
/begin COMPU_VTAB Def_bit_ub_1_VTAB "Def_bit_ub_1_VTAB" TAB_VERB 2 0 "FALSE" 1 "TRUE" DEFAULT_VALUE "TRUE" /end COMPU_VTAB
/begin COMPU_VTAB Def_bit_ub_2_VTAB "Def_bit_ub_2_VTAB" TAB_VERB 2 0 "FALSE" 1 "TRUE" DEFAULT_VALUE "TRUE" /end COMPU_VTAB
/begin COMPU_VTAB Def_bit_ub_3_VTAB "Def_bit_ub_3_VTAB" TAB_VERB 2 0 "FALSE" 1 "TRUE" DEFAULT_VALUE "TRUE" /end COMPU_VTAB
/begin COMPU_VTAB Def_bit_ub_4_VTAB "Def_bit_ub_4_VTAB" TAB_VERB 2 0 "FALSE" 1 "TRUE" DEFAULT_VALUE "TRUE" /end COMPU_VTAB
/begin COMPU_VTAB Def_bit_ub_5_VTAB "Def_bit_ub_5_VTAB" TAB_VERB 2 0 "FALSE" 1 "TRUE" DEFAULT_VALUE "TRUE" /end COMPU_VTAB
/begin COMPU_VTAB Def_bit_ub_0_VTAB "Def_bit_ub_0_VTAB" TAB_VERB 2 0 "FALSE" 1 "TRUE" DEFAULT_VALUE "TRUE" /end COMPU_VTAB
/begin COMPU_VTAB Def_bit_ub_1_VTAB "Def_bit_ub_1_VTAB" TAB_VERB 2 0 "FALSE" 1 "TRUE" DEFAULT_VALUE "TRUE" /end COMPU_VTAB
/begin COMPU_VTAB Def_bit_ub_2_VTAB "Def_bit_ub_2_VTAB" TAB_VERB 2 0 "FALSE" 1 "TRUE" DEFAULT_VALUE "TRUE" /end COMPU_VTAB
/begin COMPU_VTAB Def_bit_ub_4_VTAB "Def_bit_ub_4_VTAB" TAB_VERB 2 0 "FALSE" 1 "TRUE" DEFAULT_VALUE "TRUE" /end COMPU_VTAB
/begin COMPU_VTAB Def_bit_ub_5_VTAB "Def_bit_ub_5_VTAB" TAB_VERB 2 0 "FALSE" 1 "TRUE" DEFAULT_VALUE "TRUE" /end COMPU_VTAB
/begin COMPU_VTAB Def_bit_ub_6_VTAB "Def_bit_ub_6_VTAB" TAB_VERB 2 0 "FALSE" 1 "TRUE" DEFAULT_VALUE "TRUE" /end COMPU_VTAB
/begin COMPU_VTAB Def_bit_ub_7_VTAB "Def_bit_ub_7_VTAB" TAB_VERB 2 0 "FALSE" 1 "TRUE" DEFAULT_VALUE "TRUE" /end COMPU_VTAB
/begin COMPU_VTAB Def_bit_ub_3_VTAB "Def_bit_ub_3_VTAB" TAB_VERB 2 0 "FALSE" 1 "TRUE" DEFAULT_VALUE "TRUE" /end COMPU_VTAB
/begin COMPU_VTAB Def_bit_ub_0_VTAB "Def_bit_ub_0_VTAB" TAB_VERB 2 0 "FALSE" 1 "TRUE" DEFAULT_VALUE "TRUE" /end COMPU_VTAB
/begin COMPU_VTAB Def_bit_ub_1_VTAB "Def_bit_ub_1_VTAB" TAB_VERB 2 0 "FALSE" 1 "TRUE" DEFAULT_VALUE "TRUE" /end COMPU_VTAB
/begin COMPU_VTAB Def_bit_ub_2_VTAB "Def_bit_ub_2_VTAB" TAB_VERB 2 0 "FALSE" 1 "TRUE" DEFAULT_VALUE "TRUE" /end COMPU_VTAB
/begin COMPU_VTAB Def_bit_ub_3_VTAB "Def_bit_ub_3_VTAB" TAB_VERB 2 0 "FALSE" 1 "TRUE" DEFAULT_VALUE "TRUE" /end COMPU_VTAB
/begin COMPU_VTAB Def_bit_ub_0_VTAB "Def_bit_ub_0_VTAB" TAB_VERB 2 0 "FALSE" 1 "TRUE" DEFAULT_VALUE "TRUE" /end COMPU_VTAB
/begin COMPU_VTAB Def_bit_ub_1_VTAB "Def_bit_ub_1_VTAB" TAB_VERB 2 0 "FALSE" 1 "TRUE" DEFAULT_VALUE "TRUE" /end COMPU_VTAB
/begin COMPU_VTAB Def_bit_ub_2_VTAB "Def_bit_ub_2_VTAB" TAB_VERB 2 0 "FALSE" 1 "TRUE" DEFAULT_VALUE "TRUE" /end COMPU_VTAB
/begin COMPU_VTAB Def_bit_ub_3_VTAB "Def_bit_ub_3_VTAB" TAB_VERB 2 0 "FALSE" 1 "TRUE" DEFAULT_VALUE "TRUE" /end COMPU_VTAB
/begin COMPU_VTAB Def_bit_ub_4_VTAB "Def_bit_ub_4_VTAB" TAB_VERB 2 0 "FALSE" 1 "TRUE" DEFAULT_VALUE "TRUE" /end COMPU_VTAB
/begin COMPU_VTAB Def_bit_ub_5_VTAB "Def_bit_ub_5_VTAB" TAB_VERB 2 0 "FALSE" 1 "TRUE" DEFAULT_VALUE "TRUE" /end COMPU_VTAB
/begin COMPU_VTAB Def_bit_ub_0_VTAB "Def_bit_ub_0_VTAB" TAB_VERB 2 0 "FALSE" 1 "TRUE" DEFAULT_VALUE "TRUE" /end COMPU_VTAB
/begin COMPU_VTAB Def_bit_ub_1_VTAB "Def_bit_ub_1_VTAB" TAB_VERB 2 0 "FALSE" 1 "TRUE" DEFAULT_VALUE "TRUE" /end COMPU_VTAB
/begin COMPU_VTAB Def_bit_ub_2_VTAB "Def_bit_ub_2_VTAB" TAB_VERB 2 0 "FALSE" 1 "TRUE" DEFAULT_VALUE "TRUE" /end COMPU_VTAB
/begin COMPU_VTAB Def_bit_ub_3_VTAB "Def_bit_ub_3_VTAB" TAB_VERB 2 0 "FALSE" 1 "TRUE" DEFAULT_VALUE "TRUE" /end COMPU_VTAB
/begin COMPU_VTAB Def_bit_ub_4_VTAB "Def_bit_ub_4_VTAB" TAB_VERB 2 0 "FALSE" 1 "TRUE" DEFAULT_VALUE "TRUE" /end COMPU_VTAB
/begin COMPU_VTAB Def_bit_ub_5_VTAB "Def_bit_ub_5_VTAB" TAB_VERB 2 0 "FALSE" 1 "TRUE" DEFAULT_VALUE "TRUE" /end COMPU_VTAB
/begin COMPU_VTAB Def_bit_ub_6_VTAB "Def_bit_ub_6_VTAB" TAB_VERB 2 0 "FALSE" 1 "TRUE" DEFAULT_VALUE "TRUE" /end COMPU_VTAB
/begin COMPU_VTAB Def_bit_ub_7_VTAB "Def_bit_ub_7_VTAB" TAB_VERB 2 0 "FALSE" 1 "TRUE" DEFAULT_VALUE "TRUE" /end COMPU_VTAB
/begin COMPU_VTAB Def_bit_ub_0_VTAB "Def_bit_ub_0_VTAB" TAB_VERB 2 0 "FALSE" 1 "TRUE" DEFAULT_VALUE "TRUE" /end COMPU_VTAB
/begin COMPU_VTAB Def_bit_ub_1_VTAB "Def_bit_ub_1_VTAB" TAB_VERB 2 0 "FALSE" 1 "TRUE" DEFAULT_VALUE "TRUE" /end COMPU_VTAB
/begin COMPU_VTAB Def_bit_ub_2_VTAB "Def_bit_ub_2_VTAB" TAB_VERB 2 0 "FALSE" 1 "TRUE" DEFAULT_VALUE "TRUE" /end COMPU_VTAB
/begin COMPU_VTAB Def_bit_ub_3_VTAB "Def_bit_ub_3_VTAB" TAB_VERB 2 0 "FALSE" 1 "TRUE" DEFAULT_VALUE "TRUE" /end COMPU_VTAB
/begin COMPU_VTAB Def_bit_ub_4_VTAB "Def_bit_ub_4_VTAB" TAB_VERB 2 0 "FALSE" 1 "TRUE" DEFAULT_VALUE "TRUE" /end COMPU_VTAB
/begin COMPU_VTAB Def_bit_ub_5_VTAB "Def_bit_ub_5_VTAB" TAB_VERB 2 0 "FALSE" 1 "TRUE" DEFAULT_VALUE "TRUE" /end COMPU_VTAB
/begin COMPU_VTAB Def_bit_ub_6_VTAB "Def_bit_ub_6_VTAB" TAB_VERB 2 0 "FALSE" 1 "TRUE" DEFAULT_VALUE "TRUE" /end COMPU_VTAB
/begin COMPU_VTAB Def_bit_ub_0_VTAB "Def_bit_ub_0_VTAB" TAB_VERB 2 0 "FALSE" 1 "TRUE" DEFAULT_VALUE "TRUE" /end COMPU_VTAB
/begin COMPU_VTAB Def_bit_ub_0_VTAB "Def_bit_ub_0_VTAB" TAB_VERB 2 0 "FALSE" 1 "TRUE" DEFAULT_VALUE "TRUE" /end COMPU_VTAB
/begin COMPU_VTAB Def_bit_ub_1_VTAB "Def_bit_ub_1_VTAB" TAB_VERB 2 0 "FALSE" 1 "TRUE" DEFAULT_VALUE "TRUE" /end COMPU_VTAB
/begin COMPU_VTAB Def_bit_ub_2_VTAB "Def_bit_ub_2_VTAB" TAB_VERB 2 0 "FALSE" 1 "TRUE" DEFAULT_VALUE "TRUE" /end COMPU_VTAB
/begin COMPU_VTAB Def_bit_ub_3_VTAB "Def_bit_ub_3_VTAB" TAB_VERB 2 0 "FALSE" 1 "TRUE" DEFAULT_VALUE "TRUE" /end COMPU_VTAB
/begin COMPU_VTAB Def_bit_ub_4_VTAB "Def_bit_ub_4_VTAB" TAB_VERB 2 0 "FALSE" 1 "TRUE" DEFAULT_VALUE "TRUE" /end COMPU_VTAB
/begin COMPU_VTAB Def_bit_ub_5_VTAB "Def_bit_ub_5_VTAB" TAB_VERB 2 0 "FALSE" 1 "TRUE" DEFAULT_VALUE "TRUE" /end COMPU_VTAB
/begin COMPU_VTAB Def_bit_ub_6_VTAB "Def_bit_ub_6_VTAB" TAB_VERB 2 0 "FALSE" 1 "TRUE" DEFAULT_VALUE "TRUE" /end COMPU_VTAB
/begin COMPU_VTAB Def_bit_ub_7_VTAB "Def_bit_ub_7_VTAB" TAB_VERB 2 0 "FALSE" 1 "TRUE" DEFAULT_VALUE "TRUE" /end COMPU_VTAB
/begin COMPU_VTAB Def_bit_ub_1_VTAB "Def_bit_ub_1_VTAB" TAB_VERB 2 0 "FALSE" 1 "TRUE" DEFAULT_VALUE "TRUE" /end COMPU_VTAB
/begin COMPU_VTAB Def_bit_ub_2_VTAB "Def_bit_ub_2_VTAB" TAB_VERB 2 0 "FALSE" 1 "TRUE" DEFAULT_VALUE "TRUE" /end COMPU_VTAB
/begin COMPU_VTAB Def_bit_ub_0_VTAB "Def_bit_ub_0_VTAB" TAB_VERB 2 0 "FALSE" 1 "TRUE" DEFAULT_VALUE "TRUE" /end COMPU_VTAB
/begin COMPU_VTAB Def_bit_ub_0_VTAB "Def_bit_ub_0_VTAB" TAB_VERB 2 0 "FALSE" 1 "TRUE" DEFAULT_VALUE "TRUE" /end COMPU_VTAB
/begin COMPU_VTAB Def_bit_ub_1_VTAB "Def_bit_ub_1_VTAB" TAB_VERB 2 0 "FALSE" 1 "TRUE" DEFAULT_VALUE "TRUE" /end COMPU_VTAB
/begin COMPU_VTAB Def_bit_ub_2_VTAB "Def_bit_ub_2_VTAB" TAB_VERB 2 0 "FALSE" 1 "TRUE" DEFAULT_VALUE "TRUE" /end COMPU_VTAB
/begin COMPU_VTAB Def_bit_ub_3_VTAB "Def_bit_ub_3_VTAB" TAB_VERB 2 0 "FALSE" 1 "TRUE" DEFAULT_VALUE "TRUE" /end COMPU_VTAB
/begin COMPU_VTAB Def_bit_ub_4_VTAB "Def_bit_ub_4_VTAB" TAB_VERB 2 0 "FALSE" 1 "TRUE" DEFAULT_VALUE "TRUE" /end COMPU_VTAB
/begin COMPU_VTAB Def_bit_ub_5_VTAB "Def_bit_ub_5_VTAB" TAB_VERB 2 0 "FALSE" 1 "TRUE" DEFAULT_VALUE "TRUE" /end COMPU_VTAB
/begin COMPU_VTAB Def_bit_ub_0_VTAB "Def_bit_ub_0_VTAB" TAB_VERB 2 0 "FALSE" 1 "TRUE" DEFAULT_VALUE "TRUE" /end COMPU_VTAB
/begin COMPU_VTAB Def_bit_ub_1_VTAB "Def_bit_ub_1_VTAB" TAB_VERB 2 0 "FALSE" 1 "TRUE" DEFAULT_VALUE "TRUE" /end COMPU_VTAB
/begin COMPU_VTAB Def_bit_ub_2_VTAB "Def_bit_ub_2_VTAB" TAB_VERB 2 0 "FALSE" 1 "TRUE" DEFAULT_VALUE "TRUE" /end COMPU_VTAB
/begin COMPU_VTAB Def_bit_ub_3_VTAB "Def_bit_ub_3_VTAB" TAB_VERB 2 0 "FALSE" 1 "TRUE" DEFAULT_VALUE "TRUE" /end COMPU_VTAB
/begin COMPU_VTAB Def_bit_ub_0_VTAB "Def_bit_ub_0_VTAB" TAB_VERB 2 0 "FALSE" 1 "TRUE" DEFAULT_VALUE "TRUE" /end COMPU_VTAB
/begin COMPU_VTAB Def_bit_ub_1_VTAB "Def_bit_ub_1_VTAB" TAB_VERB 2 0 "FALSE" 1 "TRUE" DEFAULT_VALUE "TRUE" /end COMPU_VTAB
/begin COMPU_VTAB Def_bit_ub_2_VTAB "Def_bit_ub_2_VTAB" TAB_VERB 2 0 "FALSE" 1 "TRUE" DEFAULT_VALUE "TRUE" /end COMPU_VTAB
/begin COMPU_VTAB Def_bit_ub_3_VTAB "Def_bit_ub_3_VTAB" TAB_VERB 2 0 "FALSE" 1 "TRUE" DEFAULT_VALUE "TRUE" /end COMPU_VTAB
/begin COMPU_VTAB Def_bit_ub_4_VTAB "Def_bit_ub_4_VTAB" TAB_VERB 2 0 "FALSE" 1 "TRUE" DEFAULT_VALUE "TRUE" /end COMPU_VTAB
/begin COMPU_VTAB Def_bit_ub_0_VTAB "Def_bit_ub_0_VTAB" TAB_VERB 2 0 "FALSE" 1 "TRUE" DEFAULT_VALUE "TRUE" /end COMPU_VTAB
/begin COMPU_VTAB Def_bit_ub_1_VTAB "Def_bit_ub_1_VTAB" TAB_VERB 2 0 "FALSE" 1 "TRUE" DEFAULT_VALUE "TRUE" /end COMPU_VTAB
/begin COMPU_VTAB Def_bit_ub_3_VTAB "Def_bit_ub_3_VTAB" TAB_VERB 2 0 "FALSE" 1 "TRUE" DEFAULT_VALUE "TRUE" /end COMPU_VTAB
/begin COMPU_VTAB Def_bit_ub_4_VTAB "Def_bit_ub_4_VTAB" TAB_VERB 2 0 "FALSE" 1 "TRUE" DEFAULT_VALUE "TRUE" /end COMPU_VTAB
/begin COMPU_VTAB Def_bit_ub_0_VTAB "Def_bit_ub_0_VTAB" TAB_VERB 2 0 "FALSE" 1 "TRUE" DEFAULT_VALUE "TRUE" /end COMPU_VTAB
/begin COMPU_VTAB Def_bit_ub_0_VTAB "Def_bit_ub_0_VTAB" TAB_VERB 2 0 "FALSE" 1 "TRUE" DEFAULT_VALUE "TRUE" /end COMPU_VTAB
/begin COMPU_VTAB Def_bit_ub_1_VTAB "Def_bit_ub_1_VTAB" TAB_VERB 2 0 "FALSE" 1 "TRUE" DEFAULT_VALUE "TRUE" /end COMPU_VTAB
/begin COMPU_VTAB Def_bit_ub_2_VTAB "Def_bit_ub_2_VTAB" TAB_VERB 2 0 "FALSE" 1 "TRUE" DEFAULT_VALUE "TRUE" /end COMPU_VTAB
/begin COMPU_VTAB Def_bit_ub_3_VTAB "Def_bit_ub_3_VTAB" TAB_VERB 2 0 "FALSE" 1 "TRUE" DEFAULT_VALUE "TRUE" /end COMPU_VTAB
/begin COMPU_VTAB Def_bit_ub_4_VTAB "Def_bit_ub_4_VTAB" TAB_VERB 2 0 "FALSE" 1 "TRUE" DEFAULT_VALUE "TRUE" /end COMPU_VTAB
/begin COMPU_VTAB Def_bit_ub_5_VTAB "Def_bit_ub_5_VTAB" TAB_VERB 2 0 "FALSE" 1 "TRUE" DEFAULT_VALUE "TRUE" /end COMPU_VTAB
/begin COMPU_VTAB Def_bit_ub_0_VTAB "Def_bit_ub_0_VTAB" TAB_VERB 2 0 "FALSE" 1 "TRUE" DEFAULT_VALUE "TRUE" /end COMPU_VTAB
/begin COMPU_VTAB Def_bit_ub_0_VTAB "Def_bit_ub_0_VTAB" TAB_VERB 2 0 "FALSE" 1 "TRUE" DEFAULT_VALUE "TRUE" /end COMPU_VTAB
/begin COMPU_METHOD UI_Curr "" RAT_FUNC "%6.1" "mA" COEFFS 0 0.0341 0 0 0 1 /end COMPU_METHOD
/begin RECORD_LAYOUT TKW_VV_VV_UW FNC_VALUES 1 UWORD COLUMN_DIR DIRECT /end RECORD_LAYOUT
/begin RECORD_LAYOUT TKW_VV_VV_SW FNC_VALUES 1 SWORD COLUMN_DIR DIRECT /end RECORD_LAYOUT
/begin RECORD_LAYOUT TKW_VV_VV_UB FNC_VALUES 1 UBYTE COLUMN_DIR DIRECT /end RECORD_LAYOUT
/begin RECORD_LAYOUT TKW_VV_VV_UW FNC_VALUES 1 UWORD COLUMN_DIR DIRECT /end RECORD_LAYOUT
/begin RECORD_LAYOUT TKW_VV_VV_SW FNC_VALUES 1 SWORD COLUMN_DIR DIRECT /end RECORD_LAYOUT
/begin RECORD_LAYOUT TKW_VV_VV_UB FNC_VALUES 1 UBYTE COLUMN_DIR DIRECT /end RECORD_LAYOUT
/begin RECORD_LAYOUT TKW_VV_VV_UW FNC_VALUES 1 UWORD COLUMN_DIR DIRECT /end RECORD_LAYOUT
/begin RECORD_LAYOUT TKW_VV_VV_SW FNC_VALUES 1 SWORD COLUMN_DIR DIRECT /end RECORD_LAYOUT
/begin RECORD_LAYOUT TKW_VV_VV_UB FNC_VALUES 1 UBYTE COLUMN_DIR DIRECT /end RECORD_LAYOUT
/begin RECORD_LAYOUT TKW_VV_VV_UW FNC_VALUES 1 UWORD COLUMN_DIR DIRECT /end RECORD_LAYOUT
/begin RECORD_LAYOUT TKW_VV_VV_SW FNC_VALUES 1 SWORD COLUMN_DIR DIRECT /end RECORD_LAYOUT
/begin RECORD_LAYOUT TKW_VV_VV_UB FNC_VALUES 1 UBYTE COLUMN_DIR DIRECT /end RECORD_LAYOUT
/begin RECORD_LAYOUT TKW_VV_VV_UB FNC_VALUES 1 UBYTE COLUMN_DIR DIRECT /end RECORD_LAYOUT
/begin RECORD_LAYOUT TKW_VV_VV_UW FNC_VALUES 1 UWORD COLUMN_DIR DIRECT /end RECORD_LAYOUT
/begin RECORD_LAYOUT TKW_VV_VV_UW FNC_VALUES 1 UWORD COLUMN_DIR DIRECT /end RECORD_LAYOUT
/begin RECORD_LAYOUT TKW_VV_VV_SW FNC_VALUES 1 SWORD COLUMN_DIR DIRECT /end RECORD_LAYOUT
/begin RECORD_LAYOUT TKL_UW_VV_UB NO_AXIS_PTS_X 1 UBYTE RESERVED 2 BYTE AXIS_PTS_X 3 UWORD INDEX_INCR DIRECT FNC_VALUES 4 UBYTE COLUMN_DIR DIRECT /end RECORD_LAYOUT
/begin RECORD_LAYOUT TKL_UW_VV_UW NO_AXIS_PTS_X 1 UBYTE RESERVED 2 BYTE AXIS_PTS_X 3 UWORD INDEX_INCR DIRECT FNC_VALUES 4 UWORD COLUMN_DIR DIRECT /end RECORD_LAYOUT
/begin RECORD_LAYOUT TKW_VV_VV_UB FNC_VALUES 1 UBYTE COLUMN_DIR DIRECT /end RECORD_LAYOUT
/begin RECORD_LAYOUT TKW_VV_VV_UB FNC_VALUES 1 UBYTE COLUMN_DIR DIRECT /end RECORD_LAYOUT
/begin RECORD_LAYOUT TKW_VV_VV_UW FNC_VALUES 1 UWORD COLUMN_DIR DIRECT /end RECORD_LAYOUT
/begin RECORD_LAYOUT TKW_VV_VV_SW FNC_VALUES 1 SWORD COLUMN_DIR DIRECT /end RECORD_LAYOUT
/begin RECORD_LAYOUT TKL_UW_VV_UB NO_AXIS_PTS_X 1 UBYTE RESERVED 2 BYTE AXIS_PTS_X 3 UWORD INDEX_INCR DIRECT FNC_VALUES 4 UBYTE COLUMN_DIR DIRECT /end RECORD_LAYOUT
/begin RECORD_LAYOUT TKF_SW_SW_SW NO_AXIS_PTS_X 1 UBYTE NO_AXIS_PTS_Y 2 UBYTE AXIS_PTS_X 3 SWORD INDEX_INCR DIRECT AXIS_PTS_Y 4 SWORD INDEX_INCR DIRECT FNC_VALUES 5 SWORD COLUMN_DIR DIRECT /end RECORD_LAYOUT
/begin RECORD_LAYOUT TKW_VV_VV_UB FNC_VALUES 1 UBYTE COLUMN_DIR DIRECT /end RECORD_LAYOUT
/begin RECORD_LAYOUT TKW_VV_VV_UW FNC_VALUES 1 UWORD COLUMN_DIR DIRECT /end RECORD_LAYOUT
/begin RECORD_LAYOUT TKW_VV_VV_SW FNC_VALUES 1 SWORD COLUMN_DIR DIRECT /end RECORD_LAYOUT
/begin RECORD_LAYOUT TKW_VV_VV_UB FNC_VALUES 1 UBYTE COLUMN_DIR DIRECT /end RECORD_LAYOUT
/begin RECORD_LAYOUT TKW_VV_VV_UW FNC_VALUES 1 UWORD COLUMN_DIR DIRECT /end RECORD_LAYOUT
/begin RECORD_LAYOUT TKW_VV_VV_SW FNC_VALUES 1 SWORD COLUMN_DIR DIRECT /end RECORD_LAYOUT
/begin RECORD_LAYOUT TKW_VV_VV_UB FNC_VALUES 1 UBYTE COLUMN_DIR DIRECT /end RECORD_LAYOUT
/begin RECORD_LAYOUT TKW_VV_VV_UB FNC_VALUES 1 UBYTE COLUMN_DIR DIRECT /end RECORD_LAYOUT
/begin RECORD_LAYOUT TKW_VV_VV_UW FNC_VALUES 1 UWORD COLUMN_DIR DIRECT /end RECORD_LAYOUT
/begin RECORD_LAYOUT TKW_VV_VV_SW FNC_VALUES 1 SWORD COLUMN_DIR DIRECT /end RECORD_LAYOUT
/begin RECORD_LAYOUT TKW_VV_VV_UB FNC_VALUES 1 UBYTE COLUMN_DIR DIRECT /end RECORD_LAYOUT
/begin RECORD_LAYOUT TKW_VV_VV_UW FNC_VALUES 1 UWORD COLUMN_DIR DIRECT /end RECORD_LAYOUT
/begin RECORD_LAYOUT TKW_VV_VV_SW FNC_VALUES 1 SWORD COLUMN_DIR DIRECT /end RECORD_LAYOUT
/begin RECORD_LAYOUT TKF_UW_SW_SW NO_AXIS_PTS_X 1 UBYTE NO_AXIS_PTS_Y 2 UBYTE AXIS_PTS_X 3 SWORD INDEX_INCR DIRECT AXIS_PTS_Y 4 UWORD INDEX_INCR DIRECT FNC_VALUES 5 SWORD COLUMN_DIR DIRECT /end RECORD_LAYOUT
/begin RECORD_LAYOUT TKW_VV_VV_UB FNC_VALUES 1 UBYTE COLUMN_DIR DIRECT /end RECORD_LAYOUT
/begin RECORD_LAYOUT TKW_VV_VV_UW FNC_VALUES 1 UWORD COLUMN_DIR DIRECT /end RECORD_LAYOUT
/begin RECORD_LAYOUT TKW_VV_VV_SW FNC_VALUES 1 SWORD COLUMN_DIR DIRECT /end RECORD_LAYOUT
/begin RECORD_LAYOUT TKL_UW_VV_UW NO_AXIS_PTS_X 1 UBYTE RESERVED 2 BYTE AXIS_PTS_X 3 UWORD INDEX_INCR DIRECT FNC_VALUES 4 UWORD COLUMN_DIR DIRECT /end RECORD_LAYOUT
/begin RECORD_LAYOUT TKL_UW_VV_SW NO_AXIS_PTS_X 1 UBYTE RESERVED 2 BYTE AXIS_PTS_X 3 UWORD INDEX_INCR DIRECT FNC_VALUES 4 SWORD COLUMN_DIR DIRECT /end RECORD_LAYOUT
/begin RECORD_LAYOUT TKF_UW_UW_UW NO_AXIS_PTS_X 1 UBYTE NO_AXIS_PTS_Y 2 UBYTE AXIS_PTS_X 3 UWORD INDEX_INCR DIRECT AXIS_PTS_Y 4 UWORD INDEX_INCR DIRECT FNC_VALUES 5 UWORD COLUMN_DIR DIRECT /end RECORD_LAYOUT
/begin RECORD_LAYOUT TKW_VV_VV_UB FNC_VALUES 1 UBYTE COLUMN_DIR DIRECT /end RECORD_LAYOUT
/begin RECORD_LAYOUT TKW_VV_VV_UB FNC_VALUES 1 UBYTE COLUMN_DIR DIRECT /end RECORD_LAYOUT
/begin RECORD_LAYOUT TKW_VV_VV_UW FNC_VALUES 1 UWORD COLUMN_DIR DIRECT /end RECORD_LAYOUT
/begin RECORD_LAYOUT TKW_VV_VV_SW FNC_VALUES 1 SWORD COLUMN_DIR DIRECT /end RECORD_LAYOUT
/begin RECORD_LAYOUT TKW_VV_VV_UB FNC_VALUES 1 UBYTE COLUMN_DIR DIRECT /end RECORD_LAYOUT
/begin RECORD_LAYOUT TKW_VV_VV_UB FNC_VALUES 1 UBYTE COLUMN_DIR DIRECT /end RECORD_LAYOUT
/begin RECORD_LAYOUT TKW_VV_VV_UW FNC_VALUES 1 UWORD COLUMN_DIR DIRECT /end RECORD_LAYOUT
/begin RECORD_LAYOUT TKW_VV_VV_UB FNC_VALUES 1 UBYTE COLUMN_DIR DIRECT /end RECORD_LAYOUT
/begin RECORD_LAYOUT TKW_VV_VV_UW FNC_VALUES 1 UWORD COLUMN_DIR DIRECT /end RECORD_LAYOUT
/begin RECORD_LAYOUT TKW_VV_VV_SW FNC_VALUES 1 SWORD COLUMN_DIR DIRECT /end RECORD_LAYOUT
/begin RECORD_LAYOUT TKL_UB_VV_SW NO_AXIS_PTS_X 1 UBYTE RESERVED 2 BYTE AXIS_PTS_X 3 UBYTE INDEX_INCR DIRECT FNC_VALUES 4 SWORD COLUMN_DIR DIRECT /end RECORD_LAYOUT
/begin RECORD_LAYOUT TKF_SW_SW_SW NO_AXIS_PTS_X 1 UBYTE NO_AXIS_PTS_Y 2 UBYTE AXIS_PTS_X 3 SWORD INDEX_INCR DIRECT AXIS_PTS_Y 4 SWORD INDEX_INCR DIRECT FNC_VALUES 5 SWORD COLUMN_DIR DIRECT /end RECORD_LAYOUT
/begin RECORD_LAYOUT TKW_VV_VV_UB FNC_VALUES 1 UBYTE COLUMN_DIR DIRECT /end RECORD_LAYOUT
/begin RECORD_LAYOUT TKW_VV_VV_UW FNC_VALUES 1 UWORD COLUMN_DIR DIRECT /end RECORD_LAYOUT
/begin RECORD_LAYOUT TKW_VV_VV_SW FNC_VALUES 1 SWORD COLUMN_DIR DIRECT /end RECORD_LAYOUT
/begin RECORD_LAYOUT TKL_UB_VV_SW NO_AXIS_PTS_X 1 UBYTE RESERVED 2 BYTE AXIS_PTS_X 3 UBYTE INDEX_INCR DIRECT FNC_VALUES 4 SWORD COLUMN_DIR DIRECT /end RECORD_LAYOUT
/begin RECORD_LAYOUT TKL_SW_VV_SW NO_AXIS_PTS_X 1 UBYTE RESERVED 2 BYTE AXIS_PTS_X 3 SWORD INDEX_INCR DIRECT FNC_VALUES 4 SWORD COLUMN_DIR DIRECT /end RECORD_LAYOUT
/begin RECORD_LAYOUT TKW_VV_VV_UB FNC_VALUES 1 UBYTE COLUMN_DIR DIRECT /end RECORD_LAYOUT
/begin RECORD_LAYOUT TKW_VV_VV_UB FNC_VALUES 1 UBYTE COLUMN_DIR DIRECT /end RECORD_LAYOUT
/begin RECORD_LAYOUT TKW_VV_VV_UW FNC_VALUES 1 UWORD COLUMN_DIR DIRECT /end RECORD_LAYOUT
/begin RECORD_LAYOUT TKW_VV_VV_SW FNC_VALUES 1 SWORD COLUMN_DIR DIRECT /end RECORD_LAYOUT
/begin RECORD_LAYOUT TKW_VV_VV_UB FNC_VALUES 1 UBYTE COLUMN_DIR DIRECT /end RECORD_LAYOUT
/begin RECORD_LAYOUT TKW_VV_VV_SW FNC_VALUES 1 SWORD COLUMN_DIR DIRECT /end RECORD_LAYOUT
/begin RECORD_LAYOUT TKF_SW_SW_UB NO_AXIS_PTS_X 1 UBYTE NO_AXIS_PTS_Y 2 UBYTE AXIS_PTS_X 3 SWORD INDEX_INCR DIRECT AXIS_PTS_Y 4 SWORD INDEX_INCR DIRECT FNC_VALUES 5 UBYTE COLUMN_DIR DIRECT /end RECORD_LAYOUT
/begin RECORD_LAYOUT TKW_VV_VV_UB FNC_VALUES 1 UBYTE COLUMN_DIR DIRECT /end RECORD_LAYOUT
/begin RECORD_LAYOUT TKW_VV_VV_SB FNC_VALUES 1 SBYTE COLUMN_DIR DIRECT /end RECORD_LAYOUT
/begin RECORD_LAYOUT TKW_VV_VV_UW FNC_VALUES 1 UWORD COLUMN_DIR DIRECT /end RECORD_LAYOUT
/begin RECORD_LAYOUT TKW_VV_VV_SW FNC_VALUES 1 SWORD COLUMN_DIR DIRECT /end RECORD_LAYOUT
/begin RECORD_LAYOUT TKL_UB_VV_SW NO_AXIS_PTS_X 1 UBYTE RESERVED 2 BYTE AXIS_PTS_X 3 UBYTE INDEX_INCR DIRECT FNC_VALUES 4 SWORD COLUMN_DIR DIRECT /end RECORD_LAYOUT
/begin RECORD_LAYOUT TKL_SW_VV_SW NO_AXIS_PTS_X 1 UBYTE RESERVED 2 BYTE AXIS_PTS_X 3 SWORD INDEX_INCR DIRECT FNC_VALUES 4 SWORD COLUMN_DIR DIRECT /end RECORD_LAYOUT
/begin RECORD_LAYOUT TKF_SW_SW_SW NO_AXIS_PTS_X 1 UBYTE NO_AXIS_PTS_Y 2 UBYTE AXIS_PTS_X 3 SWORD INDEX_INCR DIRECT AXIS_PTS_Y 4 SWORD INDEX_INCR DIRECT FNC_VALUES 5 SWORD COLUMN_DIR DIRECT /end RECORD_LAYOUT
/begin RECORD_LAYOUT TKW_VV_VV_UB FNC_VALUES 1 UBYTE COLUMN_DIR DIRECT /end RECORD_LAYOUT
/begin RECORD_LAYOUT TKW_VV_VV_SW FNC_VALUES 1 SWORD COLUMN_DIR DIRECT /end RECORD_LAYOUT
/begin RECORD_LAYOUT TKL_UB_VV_UB NO_AXIS_PTS_X 1 UBYTE RESERVED 2 BYTE AXIS_PTS_X 3 UBYTE INDEX_INCR DIRECT FNC_VALUES 4 UBYTE COLUMN_DIR DIRECT /end RECORD_LAYOUT
/begin RECORD_LAYOUT TKW_VV_VV_UB FNC_VALUES 1 UBYTE COLUMN_DIR DIRECT /end RECORD_LAYOUT
/begin RECORD_LAYOUT TKW_VV_VV_UW FNC_VALUES 1 UWORD COLUMN_DIR DIRECT /end RECORD_LAYOUT
/begin RECORD_LAYOUT TKW_VV_VV_UB FNC_VALUES 1 UBYTE COLUMN_DIR DIRECT /end RECORD_LAYOUT
/begin RECORD_LAYOUT TKW_VV_VV_UW FNC_VALUES 1 UWORD COLUMN_DIR DIRECT /end RECORD_LAYOUT
/begin RECORD_LAYOUT TKW_VV_VV_UB FNC_VALUES 1 UBYTE COLUMN_DIR DIRECT /end RECORD_LAYOUT
/begin RECORD_LAYOUT TKW_VV_VV_SW FNC_VALUES 1 SWORD COLUMN_DIR DIRECT /end RECORD_LAYOUT
/begin RECORD_LAYOUT TKW_VV_VV_UB FNC_VALUES 1 UBYTE COLUMN_DIR DIRECT /end RECORD_LAYOUT
/begin RECORD_LAYOUT TKW_VV_VV_SW FNC_VALUES 1 SWORD COLUMN_DIR DIRECT /end RECORD_LAYOUT
/begin RECORD_LAYOUT TKW_VV_VV_UB FNC_VALUES 1 UBYTE COLUMN_DIR DIRECT /end RECORD_LAYOUT
/begin RECORD_LAYOUT TKW_VV_VV_UW FNC_VALUES 1 UWORD COLUMN_DIR DIRECT /end RECORD_LAYOUT
/begin RECORD_LAYOUT TKW_VV_VV_SW FNC_VALUES 1 SWORD COLUMN_DIR DIRECT /end RECORD_LAYOUT
/begin RECORD_LAYOUT TKL_UW_VV_UW NO_AXIS_PTS_X 1 UBYTE RESERVED 2 BYTE AXIS_PTS_X 3 UWORD INDEX_INCR DIRECT FNC_VALUES 4 UWORD COLUMN_DIR DIRECT /end RECORD_LAYOUT
/begin RECORD_LAYOUT TKF_UW_UW_UW NO_AXIS_PTS_X 1 UBYTE NO_AXIS_PTS_Y 2 UBYTE AXIS_PTS_X 3 UWORD INDEX_INCR DIRECT AXIS_PTS_Y 4 UWORD INDEX_INCR DIRECT FNC_VALUES 5 UWORD COLUMN_DIR DIRECT /end RECORD_LAYOUT
/begin RECORD_LAYOUT TKW_VV_VV_UW FNC_VALUES 1 UWORD COLUMN_DIR DIRECT /end RECORD_LAYOUT
/begin RECORD_LAYOUT TKW_VV_VV_SW FNC_VALUES 1 SWORD COLUMN_DIR DIRECT /end RECORD_LAYOUT
/begin RECORD_LAYOUT TKF_SW_SW_SW NO_AXIS_PTS_X 1 UBYTE NO_AXIS_PTS_Y 2 UBYTE AXIS_PTS_X 3 SWORD INDEX_INCR DIRECT AXIS_PTS_Y 4 SWORD INDEX_INCR DIRECT FNC_VALUES 5 SWORD COLUMN_DIR DIRECT /end RECORD_LAYOUT
/begin RECORD_LAYOUT TKW_VV_VV_UB FNC_VALUES 1 UBYTE COLUMN_DIR DIRECT /end RECORD_LAYOUT
/begin RECORD_LAYOUT TKW_VV_VV_UW FNC_VALUES 1 UWORD COLUMN_DIR DIRECT /end RECORD_LAYOUT
/begin RECORD_LAYOUT TKW_VV_VV_UB FNC_VALUES 1 UBYTE COLUMN_DIR DIRECT /end RECORD_LAYOUT
/begin RECORD_LAYOUT TKW_VV_VV_UW FNC_VALUES 1 UWORD COLUMN_DIR DIRECT /end RECORD_LAYOUT
/begin RECORD_LAYOUT TKL_UW_VV_UW NO_AXIS_PTS_X 1 UBYTE RESERVED 2 BYTE AXIS_PTS_X 3 UWORD INDEX_INCR DIRECT FNC_VALUES 4 UWORD COLUMN_DIR DIRECT /end RECORD_LAYOUT
/begin RECORD_LAYOUT TKL_UW_VV_SW NO_AXIS_PTS_X 1 UBYTE RESERVED 2 BYTE AXIS_PTS_X 3 UWORD INDEX_INCR DIRECT FNC_VALUES 4 SWORD COLUMN_DIR DIRECT /end RECORD_LAYOUT
/begin RECORD_LAYOUT TKW_VV_VV_UB FNC_VALUES 1 UBYTE COLUMN_DIR DIRECT /end RECORD_LAYOUT
/begin RECORD_LAYOUT TKW_VV_VV_SB FNC_VALUES 1 SBYTE COLUMN_DIR DIRECT /end RECORD_LAYOUT
/begin RECORD_LAYOUT TKW_VV_VV_UW FNC_VALUES 1 UWORD COLUMN_DIR DIRECT /end RECORD_LAYOUT
/begin RECORD_LAYOUT TKW_VV_VV_SW FNC_VALUES 1 SWORD COLUMN_DIR DIRECT /end RECORD_LAYOUT
/begin RECORD_LAYOUT TKL_UB_VV_UB NO_AXIS_PTS_X 1 UBYTE RESERVED 2 BYTE AXIS_PTS_X 3 UBYTE INDEX_INCR DIRECT FNC_VALUES 4 UBYTE COLUMN_DIR DIRECT /end RECORD_LAYOUT
/begin RECORD_LAYOUT TKL_SB_VV_SB NO_AXIS_PTS_X 1 UBYTE RESERVED 2 BYTE AXIS_PTS_X 3 SBYTE INDEX_INCR DIRECT FNC_VALUES 4 SBYTE COLUMN_DIR DIRECT /end RECORD_LAYOUT
/begin RECORD_LAYOUT TKL_UW_VV_UB NO_AXIS_PTS_X 1 UBYTE RESERVED 2 BYTE AXIS_PTS_X 3 UWORD INDEX_INCR DIRECT FNC_VALUES 4 UBYTE COLUMN_DIR DIRECT /end RECORD_LAYOUT
/begin RECORD_LAYOUT TKL_UW_VV_SW NO_AXIS_PTS_X 1 UBYTE RESERVED 2 BYTE AXIS_PTS_X 3 UWORD INDEX_INCR DIRECT FNC_VALUES 4 SWORD COLUMN_DIR DIRECT /end RECORD_LAYOUT
/begin RECORD_LAYOUT TKL_SW_VV_SW NO_AXIS_PTS_X 1 UBYTE RESERVED 2 BYTE AXIS_PTS_X 3 SWORD INDEX_INCR DIRECT FNC_VALUES 4 SWORD COLUMN_DIR DIRECT /end RECORD_LAYOUT
/begin RECORD_LAYOUT TKF_UW_UW_UW NO_AXIS_PTS_X 1 UBYTE NO_AXIS_PTS_Y 2 UBYTE AXIS_PTS_X 3 UWORD INDEX_INCR DIRECT AXIS_PTS_Y 4 UWORD INDEX_INCR DIRECT FNC_VALUES 5 UWORD COLUMN_DIR DIRECT /end RECORD_LAYOUT
/begin RECORD_LAYOUT TKF_UW_SW_SW NO_AXIS_PTS_X 1 UBYTE NO_AXIS_PTS_Y 2 UBYTE AXIS_PTS_X 3 SWORD INDEX_INCR DIRECT AXIS_PTS_Y 4 UWORD INDEX_INCR DIRECT FNC_VALUES 5 SWORD COLUMN_DIR DIRECT /end RECORD_LAYOUT
/begin RECORD_LAYOUT TKW_VV_VV_UB FNC_VALUES 1 UBYTE COLUMN_DIR DIRECT /end RECORD_LAYOUT
/begin RECORD_LAYOUT TKW_VV_VV_UW FNC_VALUES 1 UWORD COLUMN_DIR DIRECT /end RECORD_LAYOUT
/begin RECORD_LAYOUT TKW_VV_VV_SW FNC_VALUES 1 SWORD COLUMN_DIR DIRECT /end RECORD_LAYOUT
/begin RECORD_LAYOUT TKW_VV_VV_UB FNC_VALUES 1 UBYTE COLUMN_DIR DIRECT /end RECORD_LAYOUT
/begin RECORD_LAYOUT TKW_VV_VV_UW FNC_VALUES 1 UWORD COLUMN_DIR DIRECT /end RECORD_LAYOUT
/begin RECORD_LAYOUT TKW_VV_VV_SW FNC_VALUES 1 SWORD COLUMN_DIR DIRECT /end RECORD_LAYOUT
/begin RECORD_LAYOUT TKL_UW_VV_UW NO_AXIS_PTS_X 1 UBYTE RESERVED 2 BYTE AXIS_PTS_X 3 UWORD INDEX_INCR DIRECT FNC_VALUES 4 UWORD COLUMN_DIR DIRECT /end RECORD_LAYOUT
/begin RECORD_LAYOUT TKW_VV_VV_UW FNC_VALUES 1 UWORD COLUMN_DIR DIRECT /end RECORD_LAYOUT
/begin RECORD_LAYOUT TKF_SW_SW_SW NO_AXIS_PTS_X 1 UBYTE NO_AXIS_PTS_Y 2 UBYTE AXIS_PTS_X 3 SWORD INDEX_INCR DIRECT AXIS_PTS_Y 4 SWORD INDEX_INCR DIRECT FNC_VALUES 5 SWORD COLUMN_DIR DIRECT /end RECORD_LAYOUT
/begin RECORD_LAYOUT TKW_VV_VV_UB FNC_VALUES 1 UBYTE COLUMN_DIR DIRECT /end RECORD_LAYOUT
/begin RECORD_LAYOUT TKW_VV_VV_SB FNC_VALUES 1 SBYTE COLUMN_DIR DIRECT /end RECORD_LAYOUT
/begin RECORD_LAYOUT TKW_VV_VV_UW FNC_VALUES 1 UWORD COLUMN_DIR DIRECT /end RECORD_LAYOUT
/begin RECORD_LAYOUT TKW_VV_VV_SW FNC_VALUES 1 SWORD COLUMN_DIR DIRECT /end RECORD_LAYOUT
/begin RECORD_LAYOUT TKL_UB_VV_UB NO_AXIS_PTS_X 1 UBYTE RESERVED 2 BYTE AXIS_PTS_X 3 UBYTE INDEX_INCR DIRECT FNC_VALUES 4 UBYTE COLUMN_DIR DIRECT /end RECORD_LAYOUT
/begin RECORD_LAYOUT TKW_VV_VV_UB FNC_VALUES 1 UBYTE COLUMN_DIR DIRECT /end RECORD_LAYOUT
/begin RECORD_LAYOUT TKW_VV_VV_UW FNC_VALUES 1 UWORD COLUMN_DIR DIRECT /end RECORD_LAYOUT
/begin RECORD_LAYOUT TKW_VV_VV_SW FNC_VALUES 1 SWORD COLUMN_DIR DIRECT /end RECORD_LAYOUT
/begin RECORD_LAYOUT TKL_UB_VV_UB NO_AXIS_PTS_X 1 UBYTE RESERVED 2 BYTE AXIS_PTS_X 3 UBYTE INDEX_INCR DIRECT FNC_VALUES 4 UBYTE COLUMN_DIR DIRECT /end RECORD_LAYOUT
/begin RECORD_LAYOUT TKL_UB_VV_UW NO_AXIS_PTS_X 1 UBYTE RESERVED 2 BYTE AXIS_PTS_X 3 UBYTE INDEX_INCR DIRECT FNC_VALUES 4 UWORD COLUMN_DIR DIRECT /end RECORD_LAYOUT
/begin RECORD_LAYOUT TKL_UB_VV_SW NO_AXIS_PTS_X 1 UBYTE RESERVED 2 BYTE AXIS_PTS_X 3 UBYTE INDEX_INCR DIRECT FNC_VALUES 4 SWORD COLUMN_DIR DIRECT /end RECORD_LAYOUT
/begin RECORD_LAYOUT TKF_UB_SW_UW NO_AXIS_PTS_X 1 UBYTE NO_AXIS_PTS_Y 2 UBYTE AXIS_PTS_X 3 SWORD INDEX_INCR DIRECT AXIS_PTS_Y 4 UBYTE INDEX_INCR DIRECT FNC_VALUES 5 UWORD COLUMN_DIR DIRECT /end RECORD_LAYOUT
/begin RECORD_LAYOUT TKF_SW_SW_UB NO_AXIS_PTS_X 1 UBYTE NO_AXIS_PTS_Y 2 UBYTE AXIS_PTS_X 3 SWORD INDEX_INCR DIRECT AXIS_PTS_Y 4 SWORD INDEX_INCR DIRECT FNC_VALUES 5 UBYTE COLUMN_DIR DIRECT /end RECORD_LAYOUT
/begin RECORD_LAYOUT TKF_SW_SW_SW NO_AXIS_PTS_X 1 UBYTE NO_AXIS_PTS_Y 2 UBYTE AXIS_PTS_X 3 SWORD INDEX_INCR DIRECT AXIS_PTS_Y 4 SWORD INDEX_INCR DIRECT FNC_VALUES 5 SWORD COLUMN_DIR DIRECT /end RECORD_LAYOUT
/begin RECORD_LAYOUT TKW_VV_VV_UB FNC_VALUES 1 UBYTE COLUMN_DIR DIRECT /end RECORD_LAYOUT
/begin RECORD_LAYOUT TKW_VV_VV_UW FNC_VALUES 1 UWORD COLUMN_DIR DIRECT /end RECORD_LAYOUT
/begin RECORD_LAYOUT TKW_VV_VV_SW FNC_VALUES 1 SWORD COLUMN_DIR DIRECT /end RECORD_LAYOUT
/begin RECORD_LAYOUT TKL_UB_VV_UB NO_AXIS_PTS_X 1 UBYTE RESERVED 2 BYTE AXIS_PTS_X 3 UBYTE INDEX_INCR DIRECT FNC_VALUES 4 UBYTE COLUMN_DIR DIRECT /end RECORD_LAYOUT
/begin RECORD_LAYOUT TKL_UB_VV_UW NO_AXIS_PTS_X 1 UBYTE RESERVED 2 BYTE AXIS_PTS_X 3 UBYTE INDEX_INCR DIRECT FNC_VALUES 4 UWORD COLUMN_DIR DIRECT /end RECORD_LAYOUT
/begin RECORD_LAYOUT TKL_UW_VV_UW NO_AXIS_PTS_X 1 UBYTE RESERVED 2 BYTE AXIS_PTS_X 3 UWORD INDEX_INCR DIRECT FNC_VALUES 4 UWORD COLUMN_DIR DIRECT /end RECORD_LAYOUT
/begin RECORD_LAYOUT TKL_SW_VV_SW NO_AXIS_PTS_X 1 UBYTE RESERVED 2 BYTE AXIS_PTS_X 3 SWORD INDEX_INCR DIRECT FNC_VALUES 4 SWORD COLUMN_DIR DIRECT /end RECORD_LAYOUT
/begin RECORD_LAYOUT TKW_VV_VV_UB FNC_VALUES 1 UBYTE COLUMN_DIR DIRECT /end RECORD_LAYOUT
/begin RECORD_LAYOUT TKW_VV_VV_UW FNC_VALUES 1 UWORD COLUMN_DIR DIRECT /end RECORD_LAYOUT
/begin RECORD_LAYOUT TKL_UW_VV_UB NO_AXIS_PTS_X 1 UBYTE RESERVED 2 BYTE AXIS_PTS_X 3 UWORD INDEX_INCR DIRECT FNC_VALUES 4 UBYTE COLUMN_DIR DIRECT /end RECORD_LAYOUT
/begin RECORD_LAYOUT TKW_VV_VV_UB FNC_VALUES 1 UBYTE COLUMN_DIR DIRECT /end RECORD_LAYOUT
/begin RECORD_LAYOUT TKW_VV_VV_UW FNC_VALUES 1 UWORD COLUMN_DIR DIRECT /end RECORD_LAYOUT
/begin RECORD_LAYOUT TKW_VV_VV_SW FNC_VALUES 1 SWORD COLUMN_DIR DIRECT /end RECORD_LAYOUT
/begin RECORD_LAYOUT TKW_VV_VV_UB FNC_VALUES 1 UBYTE COLUMN_DIR DIRECT /end RECORD_LAYOUT
/begin RECORD_LAYOUT TKW_VV_VV_UW FNC_VALUES 1 UWORD COLUMN_DIR DIRECT /end RECORD_LAYOUT
/begin RECORD_LAYOUT TKW_VV_VV_SW FNC_VALUES 1 SWORD COLUMN_DIR DIRECT /end RECORD_LAYOUT
/begin RECORD_LAYOUT TKL_UB_VV_UB NO_AXIS_PTS_X 1 UBYTE RESERVED 2 BYTE AXIS_PTS_X 3 UBYTE INDEX_INCR DIRECT FNC_VALUES 4 UBYTE COLUMN_DIR DIRECT /end RECORD_LAYOUT
/begin RECORD_LAYOUT TKL_UW_VV_UW NO_AXIS_PTS_X 1 UBYTE RESERVED 2 BYTE AXIS_PTS_X 3 UWORD INDEX_INCR DIRECT FNC_VALUES 4 UWORD COLUMN_DIR DIRECT /end RECORD_LAYOUT
/begin RECORD_LAYOUT TKW_VV_VV_UB FNC_VALUES 1 UBYTE COLUMN_DIR DIRECT /end RECORD_LAYOUT
/begin RECORD_LAYOUT TKW_VV_VV_UW FNC_VALUES 1 UWORD COLUMN_DIR DIRECT /end RECORD_LAYOUT
/begin RECORD_LAYOUT TKW_VV_VV_SW FNC_VALUES 1 SWORD COLUMN_DIR DIRECT /end RECORD_LAYOUT
/begin RECORD_LAYOUT TKW_VV_VV_UB FNC_VALUES 1 UBYTE COLUMN_DIR DIRECT /end RECORD_LAYOUT
/begin RECORD_LAYOUT TKW_VV_VV_UW FNC_VALUES 1 UWORD COLUMN_DIR DIRECT /end RECORD_LAYOUT
/begin RECORD_LAYOUT TKW_VV_VV_UB FNC_VALUES 1 UBYTE COLUMN_DIR DIRECT /end RECORD_LAYOUT
/begin RECORD_LAYOUT TKW_VV_VV_UW FNC_VALUES 1 UWORD COLUMN_DIR DIRECT /end RECORD_LAYOUT
/begin RECORD_LAYOUT TKW_VV_VV_SW FNC_VALUES 1 SWORD COLUMN_DIR DIRECT /end RECORD_LAYOUT
/begin RECORD_LAYOUT TKL_UB_VV_SW NO_AXIS_PTS_X 1 UBYTE RESERVED 2 BYTE AXIS_PTS_X 3 UBYTE INDEX_INCR DIRECT FNC_VALUES 4 SWORD COLUMN_DIR DIRECT /end RECORD_LAYOUT
/begin RECORD_LAYOUT TKL_UW_VV_UB NO_AXIS_PTS_X 1 UBYTE RESERVED 2 BYTE AXIS_PTS_X 3 UWORD INDEX_INCR DIRECT FNC_VALUES 4 UBYTE COLUMN_DIR DIRECT /end RECORD_LAYOUT
/begin RECORD_LAYOUT TKL_UW_VV_SW NO_AXIS_PTS_X 1 UBYTE RESERVED 2 BYTE AXIS_PTS_X 3 UWORD INDEX_INCR DIRECT FNC_VALUES 4 SWORD COLUMN_DIR DIRECT /end RECORD_LAYOUT
/begin RECORD_LAYOUT TKL_SW_VV_SW NO_AXIS_PTS_X 1 UBYTE RESERVED 2 BYTE AXIS_PTS_X 3 SWORD INDEX_INCR DIRECT FNC_VALUES 4 SWORD COLUMN_DIR DIRECT /end RECORD_LAYOUT
/begin RECORD_LAYOUT TKW_VV_VV_UB FNC_VALUES 1 UBYTE COLUMN_DIR DIRECT /end RECORD_LAYOUT
/begin RECORD_LAYOUT TKW_VV_VV_UW FNC_VALUES 1 UWORD COLUMN_DIR DIRECT /end RECORD_LAYOUT
/begin RECORD_LAYOUT TKW_VV_VV_UB FNC_VALUES 1 UBYTE COLUMN_DIR DIRECT /end RECORD_LAYOUT
/begin RECORD_LAYOUT TKW_VV_VV_UW FNC_VALUES 1 UWORD COLUMN_DIR DIRECT /end RECORD_LAYOUT
/begin RECORD_LAYOUT TKL_UW_VV_UW NO_AXIS_PTS_X 1 UBYTE RESERVED 2 BYTE AXIS_PTS_X 3 UWORD INDEX_INCR DIRECT FNC_VALUES 4 UWORD COLUMN_DIR DIRECT /end RECORD_LAYOUT
/begin RECORD_LAYOUT TKW_VV_VV_UB FNC_VALUES 1 UBYTE COLUMN_DIR DIRECT /end RECORD_LAYOUT
/begin RECORD_LAYOUT TKW_VV_VV_UW FNC_VALUES 1 UWORD COLUMN_DIR DIRECT /end RECORD_LAYOUT
/begin RECORD_LAYOUT TKW_VV_VV_SW FNC_VALUES 1 SWORD COLUMN_DIR DIRECT /end RECORD_LAYOUT
/begin RECORD_LAYOUT TKW_VV_VV_UB FNC_VALUES 1 UBYTE COLUMN_DIR DIRECT /end RECORD_LAYOUT
/begin RECORD_LAYOUT TKW_VV_VV_UW FNC_VALUES 1 UWORD COLUMN_DIR DIRECT /end RECORD_LAYOUT
/begin RECORD_LAYOUT TKL_UB_VV_UW NO_AXIS_PTS_X 1 UBYTE RESERVED 2 BYTE AXIS_PTS_X 3 UBYTE INDEX_INCR DIRECT FNC_VALUES 4 UWORD COLUMN_DIR DIRECT /end RECORD_LAYOUT
/begin RECORD_LAYOUT TKL_SW_VV_SW NO_AXIS_PTS_X 1 UBYTE RESERVED 2 BYTE AXIS_PTS_X 3 SWORD INDEX_INCR DIRECT FNC_VALUES 4 SWORD COLUMN_DIR DIRECT /end RECORD_LAYOUT
/begin RECORD_LAYOUT TKW_VV_VV_UB FNC_VALUES 1 UBYTE COLUMN_DIR DIRECT /end RECORD_LAYOUT
/begin RECORD_LAYOUT TKW_VV_VV_UW FNC_VALUES 1 UWORD COLUMN_DIR DIRECT /end RECORD_LAYOUT
/begin RECORD_LAYOUT TKL_UW_VV_UB NO_AXIS_PTS_X 1 UBYTE RESERVED 2 BYTE AXIS_PTS_X 3 UWORD INDEX_INCR DIRECT FNC_VALUES 4 UBYTE COLUMN_DIR DIRECT /end RECORD_LAYOUT
/begin RECORD_LAYOUT TKW_VV_VV_UB FNC_VALUES 1 UBYTE COLUMN_DIR DIRECT /end RECORD_LAYOUT
/begin RECORD_LAYOUT TKW_VV_VV_UW FNC_VALUES 1 UWORD COLUMN_DIR DIRECT /end RECORD_LAYOUT
/begin RECORD_LAYOUT TKW_VV_VV_UW FNC_VALUES 1 UWORD COLUMN_DIR DIRECT /end RECORD_LAYOUT
/begin RECORD_LAYOUT TKW_VV_VV_UB FNC_VALUES 1 UBYTE COLUMN_DIR DIRECT /end RECORD_LAYOUT
/begin RECORD_LAYOUT TKL_SW_VV_SW NO_AXIS_PTS_X 1 UBYTE RESERVED 2 BYTE AXIS_PTS_X 3 SWORD INDEX_INCR DIRECT FNC_VALUES 4 SWORD COLUMN_DIR DIRECT /end RECORD_LAYOUT
/begin RECORD_LAYOUT TKW_VV_VV_UB FNC_VALUES 1 UBYTE COLUMN_DIR DIRECT /end RECORD_LAYOUT
/begin RECORD_LAYOUT TKW_VV_VV_UW FNC_VALUES 1 UWORD COLUMN_DIR DIRECT /end RECORD_LAYOUT
/begin RECORD_LAYOUT TKW_VV_VV_SW FNC_VALUES 1 SWORD COLUMN_DIR DIRECT /end RECORD_LAYOUT
/end MODULE
/end PROJECT
