ASAP2_VERSION 1 3
/begin PROJECT _725D601B "725D601B"
/begin HEADER "" VERSION "_725D601B" PROJECT_NO _725D601B /end HEADER
/begin MODULE DIM ""
/begin MOD_COMMON "" BYTE_ORDER MSB_FIRST ALIGNMENT_BYTE 1 ALIGNMENT_WORD 2 ALIGNMENT_LONG 2 ALIGNMENT_FLOAT32_IEEE 4 /end MOD_COMMON
/begin CHARACTERISTIC AIMDTED "Schwelle f¸r Stˆrerkennung Verlustmoment" VALUE 0xFCCA24 KwUw 99.99847 rel_uw_b100 0.00 99.99847 FORMAT "%8.5" /end CHARACTERISTIC
/begin CHARACTERISTIC AIODTEX "Maximale Anzahl der i.O.-Pr¸fungen bei Tankentl¸ftungsdiagnose" VALUE 0xFD4868 KwUb 255.0 dez 0.00 255.0 FORMAT "%5.1" /end CHARACTERISTIC
/begin CHARACTERISTIC ANZTIBMX "Begrenzung ti-Einspritzz‰hler ""anztib_w""" VALUE 0xFC6A04 KwUw 50176.00 dez 0.00 50176.00 FORMAT "%8.2" /end CHARACTERISTIC
/begin CHARACTERISTIC ANZTIWS "Anzahl Einspritzungen f¸r Wiederholstarterkennung" VALUE 0xFC6B26 KwUb 255.0 dez 0.00 255.0 FORMAT "%5.1" /end CHARACTERISTIC
/begin CHARACTERISTIC APDTEX "max. Anzahl Pr¸fungen bei Tankentl¸ftungsdiagnose" VALUE 0xFD4869 KwUb 255.0 dez 0.00 255.0 FORMAT "%5.1" /end CHARACTERISTIC
/begin CHARACTERISTIC ASP2ADPWF "Adaptionswert Anschlag Auslasspreizung bei Powerfail Bank 2" VALUE 0xFD523E KwUw 6553.500 sprzi_q0p1 0.00 6553.500 FORMAT "%8.3" /end CHARACTERISTIC
/begin CHARACTERISTIC ASP_ADPWF "Adaptionswert Anschlag Auslasspreizung bei Powerfail" VALUE 0xFD5240 KwUw 6553.500 sprzi_q0p1 0.00 6553.500 FORMAT "%8.3" /end CHARACTERISTIC
/begin CHARACTERISTIC ASP_ADTV "Adaptionstastverh‰ltnis Auslasspreizung variable NWS" VALUE 0xFD5232 KwUb 255.0 dez 0.00 255.0 FORMAT "%5.1" /end CHARACTERISTIC
/begin CHARACTERISTIC ASP_BA "Betriebsartenwahlschalter Auslasspreizung variable NWS" VALUE 0xFD5233 KwUb 255.0 dez 0.00 255.0 FORMAT "%5.1" /end CHARACTERISTIC
/begin CHARACTERISTIC ASP_TVHB "Ausgabe-Tastverh‰ltnis bei Handbetrieb f¸r Auslasspreizung variable NWS" VALUE 0xFD5234 KwUb 255.0 dez 0.00 255.0 FORMAT "%5.1" /end CHARACTERISTIC
/begin CHARACTERISTIC ASP_WNWS "Sollspreizung bei Handbetrieb f¸r Auslasspreizung variable NWS" VALUE 0xFD5242 KwUw 6553.500 sprzi_q0p1 0.00 6553.500 FORMAT "%8.3" /end CHARACTERISTIC
/begin CHARACTERISTIC CIDTHS "Component-ID f¸r Thermostatdiagnose" VALUE 0xFD54A6 KwWU8 127.0 default 0.00 127.0 FORMAT "%5.1" /end CHARACTERISTIC
/begin CHARACTERISTIC CWDPCS "Codewort Tankleckdiagnose" VALUE 0xFD486A KwUb 255.0 dez 0.00 255.0 FORMAT "%5.1" /end CHARACTERISTIC
/begin CHARACTERISTIC CWDTEVN "Codeword f¸r DTEVN" VALUE 0xFD486B KwUb 255.0 dez 0.00 255.0 FORMAT "%5.1" /end CHARACTERISTIC
/begin CHARACTERISTIC CWEBDMTL "Codewort f¸r Aktivierung der Leckdiagnose (nur in Applikation)" VALUE 0xFD48C4 KwWU8 255.0 dez 0.00 255.0 FORMAT "%5.1" /end CHARACTERISTIC
/begin CHARACTERISTIC CWELS "Codewort zur Konfiguration der E-Box-L¸fter-Steuerung" VALUE 0xFCEBE2 KwWU8 255.0 dez 0.00 255.0 FORMAT "%5.1" /end CHARACTERISTIC
/begin CHARACTERISTIC CWERRVVT "Codewort SW-Schalter f¸r Applikation VVT-Fehlerarten""" VALUE 0xFC417C KwWU16 65535.00 DEZ 0.00 65535.00 FORMAT "%8.2" /end CHARACTERISTIC
/begin CHARACTERISTIC CWESSTT "Codewort zum setzen der Bits B_vbemg und B_wks" VALUE 0xFC6B27 KwUb 255.0 dez 0.00 255.0 FORMAT "%5.1" /end CHARACTERISTIC
/begin CHARACTERISTIC CWESVW "Codewort: Einspritzung Vorlagerungswinkel" VALUE 0xFC7352 KwWU8 7.000 dez 0.00 7.000 FORMAT "%5.3" /end CHARACTERISTIC
/begin CHARACTERISTIC CWLOWRA "Codewort LOWRA aktiv" VALUE 0xFD54A7 KwWU8 1.000 default 0.00 1.000 FORMAT "%5.3" /end CHARACTERISTIC
/begin CHARACTERISTIC CWPSTEVE "Kodewort zum Abschalten der Endstufediagnose" VALUE 0xFD0580 KwWU8 255.0 dez 0.00 255.0 FORMAT "%5.1" /end CHARACTERISTIC
/begin CHARACTERISTIC CWPSVVTE "Codewort f¸r VVT-Endstufe" VALUE 0xFD0581 KwWU8 255.0 dez 0.00 255.0 FORMAT "%5.1" /end CHARACTERISTIC
/begin CHARACTERISTIC CWTEVCHECK "Codewort f¸r Tevcheck" VALUE 0xFD486C KwUb 255.0 dez 0.00 255.0 FORMAT "%5.1" /end CHARACTERISTIC
/begin CHARACTERISTIC CWTLDASH "Codewort f¸r Tankleckdiagnose Stopmatrix: Abbruch bei steilem Hang" VALUE 0xFD488C KwWU16 65535.00 dez 0.00 65535.00 FORMAT "%8.2" /end CHARACTERISTIC
/begin CHARACTERISTIC CWTLDEB "Konfigurations-Codewort f¸r EBDMTL" VALUE 0xFD48C5 KwWU8 255.0 dez 0.00 255.0 FORMAT "%5.1" /end CHARACTERISTIC
/begin CHARACTERISTIC CWTLDEBH "Codewort f¸r Tankleckdiagnose Stopmatrix: hohe AKF-Beladung" VALUE 0xFD488E KwWU16 65535.00 dez 0.00 65535.00 FORMAT "%8.2" /end CHARACTERISTIC
/begin CHARACTERISTIC CWTLDEVBC "Codewort f. Tankleckdiagnose-Einschaltmatrix: Grundbedingungen" VALUE 0xFD4890 KwWU16 65535.00 dez 0.00 65535.00 FORMAT "%8.2" /end CHARACTERISTIC
/begin CHARACTERISTIC CWTLDEVCP "Codewort f. Tankleckdiagnose-Einschaltmatrix: Komponentenschutz" VALUE 0xFD4892 KwWU16 65535.00 dez 0.00 65535.00 FORMAT "%8.2" /end CHARACTERISTIC
/begin CHARACTERISTIC CWTLDEVEC "Codewort f¸r Tankleckdiagnose Einschalt-Matrix: Emissionsschutz" VALUE 0xFD4894 KwWU16 65535.00 dez 0.00 65535.00 FORMAT "%8.2" /end CHARACTERISTIC
/begin CHARACTERISTIC CWTLDEVFA "Codewort f. Tankleckdiagnose-Einschaltmatrix: Testeranforderung" VALUE 0xFD4896 KwWU16 65535.00 dez 0.00 65535.00 FORMAT "%8.2" /end CHARACTERISTIC
/begin CHARACTERISTIC CWTLDEVK15 "Codewort f. Tankleckdiagnose-Einschaltmatrix: Z¸ndung an, Motor aus" VALUE 0xFD4898 KwWU16 65535.00 dez 0.00 65535.00 FORMAT "%8.2" /end CHARACTERISTIC
/begin CHARACTERISTIC CWTLDEVMO "Codewort f. Tankleckdiagnose-Einschaltmatrix: MIL-Status" VALUE 0xFD489A KwWU16 65535.00 dez 0.00 65535.00 FORMAT "%8.2" /end CHARACTERISTIC
/begin CHARACTERISTIC CWTLDEVNL "Codewort f. Tankleckdiagnose-Einschaltmatrix: Nachlauf" VALUE 0xFD489C KwWU16 65535.00 dez 0.00 65535.00 FORMAT "%8.2" /end CHARACTERISTIC
/begin CHARACTERISTIC CWTLDEVNMT "Codewort f. Tankleckdiagnose-Einschaltmatrix: Motor an" VALUE 0xFD489E KwWU16 65535.00 dez 0.00 65535.00 FORMAT "%8.2" /end CHARACTERISTIC
/begin CHARACTERISTIC CWTLDEVOC "Codewort f. Tankleckdiagnose-Einschaltmatrix: Betriebsbedingungen" VALUE 0xFD48A0 KwWU16 65535.00 dez 0.00 65535.00 FORMAT "%8.2" /end CHARACTERISTIC
/begin CHARACTERISTIC CWTLDOBD "Codewort f¸r Spezifikation der OBD-Diagnosen" VALUE 0xFD48A2 KwWU16 65535.00 dez 0.00 65535.00 FORMAT "%8.2" /end CHARACTERISTIC
/begin CHARACTERISTIC CWTLDSES "Codewort f. Tankleckdiagnose-Einschaltmatrix: groﬂe Spannungsschwankungen" VALUE 0xFD48A4 KwWU16 65535.00 dez 0.00 65535.00 FORMAT "%8.2" /end CHARACTERISTIC
/begin CHARACTERISTIC CWTLDSPF "Codewort f. Tankleckdiagnose-Einschaltmatrix: Spannungsschwankungen" VALUE 0xFD48A6 KwWU16 65535.00 dez 0.00 65535.00 FORMAT "%8.2" /end CHARACTERISTIC
/begin CHARACTERISTIC CWTLDSRQ "Codewort f. Tankleckdiagnose-Einschaltmatrix: Abbruchanforderung wg Tankklappe" VALUE 0xFD48A8 KwWU16 65535.00 dez 0.00 65535.00 FORMAT "%8.2" /end CHARACTERISTIC
/begin CHARACTERISTIC CWTLDSTD "Codewort f¸r Tankleckdiagnose Stop-Matrix bei Tankdeckel-÷ffnen" VALUE 0xFD48AA KwWU16 65535.00 dez 0.00 65535.00 FORMAT "%8.2" /end CHARACTERISTIC
/begin CHARACTERISTIC CWTLDSTK "Codewort f¸r Tankleckdiagnose Stop-Matrix bei Betankung" VALUE 0xFD48AC KwWU16 65535.00 dez 0.00 65535.00 FORMAT "%8.2" /end CHARACTERISTIC
/begin CHARACTERISTIC CWTLDSTL "Codewort f. Tankleckdiagnose-Einschaltmatrix: Fehlerspeicherlˆschen" VALUE 0xFD48AE KwWU16 65535.00 dez 0.00 65535.00 FORMAT "%8.2" /end CHARACTERISTIC
/begin CHARACTERISTIC CWTLDSTS "Codewort f. Tankleckdiagnose-Einschaltmatrix: Maximalzeit" VALUE 0xFD48B0 KwWU16 65535.00 dez 0.00 65535.00 FORMAT "%8.2" /end CHARACTERISTIC
/begin CHARACTERISTIC CW_DTHS "Codewort DTHS" VALUE 0xFD54A8 KwWU8 1.000 DEZ 0.00 1.000 FORMAT "%5.3" /end CHARACTERISTIC
/begin CHARACTERISTIC CW_DZKU "Codewort Z¸ndkreis¸berwachung" VALUE 0xFCD946 KwWU8 255.0 dez 0.00 255.0 FORMAT "%5.1" /end CHARACTERISTIC
/begin CHARACTERISTIC CW_FADTEVN "" VALUE 0xFD486D KwUb 255.0 dez 0.00 255.0 FORMAT "%5.1" /end CHARACTERISTIC
/begin CHARACTERISTIC CW_VNSABST "CW Verhinderung der Verriegelung durch Abstand vom Anschlag" VALUE 0xFD5235 KwUb 255.0 dez 0.00 255.0 FORMAT "%5.1" /end CHARACTERISTIC
/begin CHARACTERISTIC CW_VNSDYN "Verhinderung der Verriegelung durch adapt. Druckvorsteuerung" VALUE 0xFD5236 KwUb 255.0 dez 0.00 255.0 FORMAT "%5.1" /end CHARACTERISTIC
/begin CHARACTERISTIC DELTA_AN "" VAL_BLK 0xFCCACC KwbWU16 6553.500 sprzi_q0p1 0.00 6553.500 FORMAT "%8.3" NUMBER 4 /end CHARACTERISTIC
/begin CHARACTERISTIC DIPTTEV "Stromdelta f¸r Erkennung TEV ˆffnet" VALUE 0xFD487A KwUw 399.9939 i_q6p1035_uA 0.00 399.9939 FORMAT "%8.4" /end CHARACTERISTIC
/begin CHARACTERISTIC DIPTTEVCHK "Stromdelta um das TEV vor erreichen des Referenzstroms geˆffnet wird" VALUE 0xFD487C KwUw 399.9939 i_q6p1035_uA 0.00 399.9939 FORMAT "%8.4" /end CHARACTERISTIC
/begin CHARACTERISTIC DIPTTEVGD "Stromdelta f¸r Erkennung TEV ˆffnet GD" VALUE 0xFD487E KwUw 399.9939 i_q6p1035_uA 0.00 399.9939 FORMAT "%8.4" /end CHARACTERISTIC
/begin CHARACTERISTIC DMITED "Delta Schwelle F¸llungswunsch" VALUE 0xFCCA26 KwUw 99.99847 rel_uw_b100 0.00 99.99847 FORMAT "%8.5" /end CHARACTERISTIC
/begin CHARACTERISTIC DNSTED "Schwelle Delta Nsoll f¸r Abbruch Diagnose Tankentl¸ftung" VALUE 0xFCCA20 KwUb 2550. nmot_ub_q10 0.00 2550. FORMAT "%5.0" /end CHARACTERISTIC
/begin CHARACTERISTIC DPSTDTEN "Integrationszeit f¸r den Drehzahlcheck" VALUE 0xFCCA28 KwUw 1310.700 t20msxs_uw_b1310 0.00 1310.700 FORMAT "%8.3" /end CHARACTERISTIC
/begin CHARACTERISTIC DRLTOTDK "Totzone f¸r Auslˆsung Kurzzeiteinspritzung" VALUE 0xFC716C KwUw 1535.977 rel_uw_q0p0234 0.00 1535.977 FORMAT "%8.3" /end CHARACTERISTIC
/begin CHARACTERISTIC DRLTOTDKLL "Totzone f¸r Auslˆsung Kurzzeiteinspritzung im LL" VALUE 0xFC716E KwUw 1535.977 rel_uw_q0p0234 0.00 1535.977 FORMAT "%8.3" /end CHARACTERISTIC
/begin CHARACTERISTIC DRLTOTVTLL "Totzone f¸r Auslˆsung Kurzzeiteinspritzung im LL" VALUE 0xFC6EAC KwUw 1535.977 rel_uw_q0p0234 0.00 1535.977 FORMAT "%8.3" /end CHARACTERISTIC
/begin CHARACTERISTIC DRLTOTVVT "Totzone f¸r Auslˆsung Kurzzeiteinspritzung" VALUE 0xFC6EAE KwUw 1535.977 rel_uw_q0p0234 0.00 1535.977 FORMAT "%8.3" /end CHARACTERISTIC
/begin CHARACTERISTIC DTEBLEIN "Hystherese f¸r Temperaturschwelle f¸r E-Box L¸fter Ansteuerung" VALUE 0xFD54AD KwUb 191.3 temp_ub_q0p75_o48 -48.00 143.3 FORMAT "%5.1" /end CHARACTERISTIC
/begin CHARACTERISTIC DTMWUC "Delta Motortemperaturschwelle f¸r Erf¸llung 'warm up cycle'" VALUE 0xFC14B7 KwUb 191.3 temp_ub_b191p25 0.00 191.3 FORMAT "%5.1" /end CHARACTERISTIC
/begin CHARACTERISTIC DUFBDE_T "Entprellzeit zum Setzen der Zyklusflags BDEbedingt in der Diagnose der Fkt¸ko" VALUE 0xFC0BC0 KwUw 6553.500 t100msxs_uw_b6553p6 0.00 6553.500 FORMAT "%8.3" /end CHARACTERISTIC
/begin CHARACTERISTIC DUF_T "Zeit f¸rs Setzen der Zyklusflags der Funktions¸berwachungs-Diagnose" VALUE 0xFC0BBC KwUb 25.50 t100msxs_ub_b25p5 0.00 25.50 FORMAT "%5.2" /end CHARACTERISTIC
/begin CHARACTERISTIC DUKK "Schwelle f¸r Kurzzeitanteil" VALUE 0xFC6EB0 KwSw 12287.81 rel_sw_q0p1875 -6144.000 6143.813 FORMAT "%8.3" /end CHARACTERISTIC
/begin CHARACTERISTIC DUKKDK "Schwelle f¸r Kurzzeitanteil" VALUE 0xFC7170 KwSw 12287.81 rel_sw_q0p1875 -6144.000 6143.813 FORMAT "%8.3" /end CHARACTERISTIC
/begin CHARACTERISTIC DVNS_CLR "Label zum Loeschen der Umgebungsbedingungen (INI)" VALUE 0xFCCAD4 KwWU8 255.0 dez 0.00 255.0 FORMAT "%5.1" /end CHARACTERISTIC
/begin CHARACTERISTIC DVVTDEXWK "zul‰ssige Differenz zwischen Soll- und Istwertwinkel f¸r Laufunruhecheck" VALUE 0xFC417E KwWU16 6553.500 wink_uw_q0p1 0.00 6553.500 FORMAT "%8.3" /end CHARACTERISTIC
/begin CHARACTERISTIC DVVTEEDEL "" VALUE 0xFC4180 KwWU16 65535.00 DEZ 0.00 65535.00 FORMAT "%8.2" /end CHARACTERISTIC
/begin CHARACTERISTIC DVVTEENA "Applikationsschalter um verschiedene Fehler miteinflieﬂen zu lassen" VALUE 0xFC4182 KwWU16 65535.00 DEZ 0.00 65535.00 FORMAT "%8.2" /end CHARACTERISTIC
/begin CHARACTERISTIC DVVTEXMXAN "Max. Ex-Winkel Notlauf aus Anschlaglernen VVTCHK" VALUE 0xFC4184 KwWU16 6553.500 wink_uw_q0p1 0.00 6553.500 FORMAT "%8.3" /end CHARACTERISTIC
/begin CHARACTERISTIC DVVTEXPMN "minimialer Exwinkel im NL f¸r E-Gaslampenansteuerung" VALUE 0xFC4186 KwWU16 6553.500 wink_uw_q0p1 0.00 6553.500 FORMAT "%8.3" /end CHARACTERISTIC
/begin CHARACTERISTIC DVVTEXWIOF "OFFSET zum Hochfahren des Exzenterwinkels" VALUE 0xFC4188 KwWU16 6553.500 wink_uw_q0p1 0.00 6553.500 FORMAT "%8.3" /end CHARACTERISTIC
/begin CHARACTERISTIC DVVTFLUBT "Entprellzeit Laufunruheabweichung" VALUE 0xFC41A8 KwWU8 25.50 t100msxs_ub_b25p5 0.00 25.50 FORMAT "%5.2" /end CHARACTERISTIC
/begin CHARACTERISTIC DVVTNLUMN "Minimale Drehzahl fuer Laufunruhecheck" VALUE 0xFC418A KwWU16 16383.75 nmot_uw_q0p25 0.00 16383.75 FORMAT "%8.2" /end CHARACTERISTIC
/begin CHARACTERISTIC DVVTNMXV "Wert fuer Drehzahlbegrenzung durch VVT Fehler" VALUE 0xFC418C KwWU16 16383.75 nmot_uw_q0p25 0.00 16383.75 FORMAT "%8.2" /end CHARACTERISTIC
/begin CHARACTERISTIC DVVTPVGR "Grenze Druckverhaeltnis ml-ChecK" VALUE 0xFC418E KwWU16 1.999969 fak_uw_b2 0.00 1.999969 FORMAT "%8.6" /end CHARACTERISTIC
/begin CHARACTERISTIC DVVTRLMDGR "rl-Offset bei Plausibilisierung ml-Check bei Vollast" VALUE 0xFC4190 KwWU16 1535.977 rel_uw_q0p0234 0.00 1535.977 FORMAT "%8.3" /end CHARACTERISTIC
/begin CHARACTERISTIC DVVTRLMXFA "Faktor zur Begrenzung releative Luftmasse bei VVT Fehler" VALUE 0xFC4192 KwWU16 65.53500 fak_uw_q0p001 0.00 65.53500 FORMAT "%8.5" /end CHARACTERISTIC
/begin CHARACTERISTIC DVVTSWITCH "Schalter zum Testen verschiedener Notlaufstrategieen" VALUE 0xFC4194 KwWU16 65535.00 DEZ 0.00 65535.00 FORMAT "%8.2" /end CHARACTERISTIC
/begin CHARACTERISTIC DVVTWKMXV "Wert fuer Exzenterwinkel durch VVT Fehler Bank 1" VALUE 0xFC4196 KwWU16 6553.500 wink_uw_q0p1 0.00 6553.500 FORMAT "%8.3" /end CHARACTERISTIC
/begin CHARACTERISTIC DVWKMINV "" VALUE 0xFC4198 KwWU16 6553.500 wink_uw_q0p1 0.00 6553.500 FORMAT "%8.3" /end CHARACTERISTIC
/begin CHARACTERISTIC DVZV1VAT "Zul‰ssige Deltageschwindigkeit  vfzgv1_w zu vfzgat_w" VALUE 0xFC226A KwWU16 511.9922 vfzg_uw_b512 0.00 511.9922 FORMAT "%8.4" /end CHARACTERISTIC
/begin CHARACTERISTIC DWEEMX "maximal zul‰ssige Zunahme Winkel Einspritzende pro Syncro" VALUE 0xFC7353 KwWU8 765.0 kw_q3 0.00 765.0 FORMAT "%5.1" /end CHARACTERISTIC
/begin CHARACTERISTIC DZKDMDZL "Schwellwert Entprellz‰hler Aussetzererkennung" VALUE 0xFCD947 KwWU8 255.0 dez 0.00 255.0 FORMAT "%5.1" /end CHARACTERISTIC
/begin CHARACTERISTIC DZKDUB "Maximale Spannungsschwankung" VALUE 0xFCD948 KwWU8 19.41 spg_ubatt 0.00 19.41 FORMAT "%5.2" /end CHARACTERISTIC
/begin CHARACTERISTIC DZKSUB_DZKU_IMPL "" VALUE 0xFCD949 KwWU8 255.0 dez 0.00 255.0 FORMAT "%5.1" READ_ONLY /end CHARACTERISTIC
/begin CHARACTERISTIC DZOTPERR_DZKU_IMPL "" VALUE 0xFCD94A KwWU8 255.0 dez 0.00 255.0 FORMAT "%5.1" READ_ONLY /end CHARACTERISTIC
/begin CHARACTERISTIC DZPHKSUB "Entprelltiefe harter Z¸ndkreiskurzschluss" VALUE 0xFCD94B KwWU8 255.0 dez 0.00 255.0 FORMAT "%5.1" /end CHARACTERISTIC
/begin CHARACTERISTIC DZPKSMS "Z‰hldauer des Entprellz‰hlers KS nach Masse" VALUE 0xFCD94C KwWU8 255.0 dez 0.00 255.0 FORMAT "%5.1" /end CHARACTERISTIC
/begin CHARACTERISTIC DZPKSMSR "Entprelltiefe Massekurzschluss" VALUE 0xFCD94D KwWU8 255.0 dez 0.00 255.0 FORMAT "%5.1" /end CHARACTERISTIC
/begin CHARACTERISTIC DZPKSUB "Z‰hldauer des Entprellz‰hlers KS nach UB" VALUE 0xFCD94E KwWU8 255.0 dez 0.00 255.0 FORMAT "%5.1" /end CHARACTERISTIC
/begin CHARACTERISTIC DZPKSUBR "Entprelltiefe niederimpedanter Z¸ndkreis" VALUE 0xFCD94F KwWU8 255.0 dez 0.00 255.0 FORMAT "%5.1" /end CHARACTERISTIC
/begin CHARACTERISTIC DZPOTP "Schwellwert Entprellz‰hler OTP Fehler" VALUE 0xFCD950 KwWU8 255.0 dez 0.00 255.0 FORMAT "%5.1" /end CHARACTERISTIC
/begin CHARACTERISTIC DZPSP "Z‰hldauer des Entprellz‰hlers des Spannungsfehlers" VALUE 0xFCD951 KwWU8 255.0 dez 0.00 255.0 FORMAT "%5.1" /end CHARACTERISTIC
/begin CHARACTERISTIC DZPTIM "Z‰hldauer des Entprellz‰hlers des Timoutfehlers" VALUE 0xFCD952 KwWU8 255.0 dez 0.00 255.0 FORMAT "%5.1" /end CHARACTERISTIC
/begin CHARACTERISTIC DZRELFAK "Assymetriefaktor Ta-Zeit Verh‰ltnis" VALUE 0xFCD953 KwWU8 15.00 dez 0.00 15.00 FORMAT "%5.2" /end CHARACTERISTIC
/begin CHARACTERISTIC ESP2ADPWF "Adaptionswert Anschlag Einlasspreizung bei Powerfail Bank 2" VALUE 0xFD5244 KwUw 6553.500 sprzi_q0p1 0.00 6553.500 FORMAT "%8.3" /end CHARACTERISTIC
/begin CHARACTERISTIC ESP_ADPWF "Adaptionswert Anschlag Einlasspreizung bei Powerfail" VALUE 0xFD5246 KwUw 6553.500 sprzi_q0p1 0.00 6553.500 FORMAT "%8.3" /end CHARACTERISTIC
/begin CHARACTERISTIC ESP_ADTV "Adaptionstastverh‰ltnis Einlasspreizung variable NWS" VALUE 0xFD5237 KwUb 255.0 dez 0.00 255.0 FORMAT "%5.1" /end CHARACTERISTIC
/begin CHARACTERISTIC ESP_BA "Betriebsartenwahlschalter Einlasspreizung variable NWS" VALUE 0xFD5238 KwUb 255.0 dez 0.00 255.0 FORMAT "%5.1" /end CHARACTERISTIC
/begin CHARACTERISTIC ESP_TVHB "ausgegebenes Tastverh‰ltnis bei Handbetrieb f¸r Einlasspreizung variable NWS" VALUE 0xFD5239 KwUb 255.0 dez 0.00 255.0 FORMAT "%5.1" /end CHARACTERISTIC
/begin CHARACTERISTIC ESP_WNWS "Sollspreizung bei Handbetrieb f¸r Einlasspreizung variable NWS" VALUE 0xFD5248 KwUw 6553.500 sprzi_q0p1 0.00 6553.500 FORMAT "%8.3" /end CHARACTERISTIC
/begin CHARACTERISTIC ESUKRLP "Umschalter ESUK rlsol rlp" VALUE 0xFC6DAE KwUb 1.000 dez 0.00 1.000 FORMAT "%5.3" /end CHARACTERISTIC
/begin CHARACTERISTIC FHSTT "Faktor Heiﬂstart" CURVE 0xFC6B28 KlAUbSstUbWUb 63.75 fak_ub_b64 0.00 63.75 FORMAT "%5.2"
 /begin AXIS_DESCR STD_AXIS tans temp_ub_q0p75_o48 4 -48.00 143.3 FORMAT "%5.1" DEPOSIT ABSOLUTE /end AXIS_DESCR
/end CHARACTERISTIC
/begin CHARACTERISTIC FIMHU "Faktor Impuls hart" CURVE 0xFC7354 FklWUb 1.992 fak_ub_b2 0.00 1.992 FORMAT "%5.3"
 /begin AXIS_DESCR FIX_AXIS anzwefim dez 16 0.00 15.00 FORMAT "%5.2" FIX_AXIS_PAR 0 0 16 /end AXIS_DESCR
/end CHARACTERISTIC
/begin CHARACTERISTIC FIMWU "Faktor Impuls weich" CURVE 0xFC7364 FklWUb 1.992 fak_ub_b2 0.00 1.992 FORMAT "%5.3"
 /begin AXIS_DESCR FIX_AXIS anzwefim dez 16 0.00 15.00 FORMAT "%5.2" FIX_AXIS_PAR 0 0 16 /end AXIS_DESCR
/end CHARACTERISTIC
/begin CHARACTERISTIC FKSTT "Faktor Kaltstart" CURVE 0xFC6B31 KlAUbSstUbWUb 31.88 fak_ub_b32 0.00 31.88 FORMAT "%5.2"
 /begin AXIS_DESCR STD_AXIS tmst temp_ub_q0p75_o48 12 -48.00 143.3 FORMAT "%5.1" DEPOSIT ABSOLUTE /end AXIS_DESCR
/end CHARACTERISTIC
/begin CHARACTERISTIC FKSTTGD "BMW" CURVE 0xFC6B4A KlAUbSstUbWUb 31.88 fak_ub_b32 0.00 31.88 FORMAT "%5.2"
 /begin AXIS_DESCR STD_AXIS tmst temp_ub_q0p75_o48 12 -48.00 143.3 FORMAT "%5.1" DEPOSIT ABSOLUTE /end AXIS_DESCR
/end CHARACTERISTIC
/begin CHARACTERISTIC FNSA "Nachstartanhebung" CURVE 0xFD1BD8 GklWUb 1.992 fak_ub_b2 0.00 1.992 FORMAT "%5.3"
 /begin AXIS_DESCR COM_AXIS tans temp_ub_q0p75_o48 6 -48.00 143.3 FORMAT "%5.1" AXIS_PTS_REF STA06ESUB /end AXIS_DESCR
/end CHARACTERISTIC
/begin CHARACTERISTIC FNSHO "Wichtung Nachstartanhebung" CURVE 0xFD1BDE KlAUbSstUbWUb 1.992 fak_ub_b2 0.00 1.992 FORMAT "%5.3"
 /begin AXIS_DESCR STD_AXIS fho fak_ub_b4 4 0.00 3.984 FORMAT "%5.3" DEPOSIT ABSOLUTE /end AXIS_DESCR
/end CHARACTERISTIC
/begin CHARACTERISTIC FNSSM "Nachstartanhebung" CURVE 0xFD1BE7 GklWUb 1.992 fak_ub_b2 0.00 1.992 FORMAT "%5.3"
 /begin AXIS_DESCR COM_AXIS tmst temp_ub_q0p75_o48 12 -48.00 143.3 FORMAT "%5.1" AXIS_PTS_REF STS12ESUB /end AXIS_DESCR
/end CHARACTERISTIC
/begin CHARACTERISTIC FNSSMVT "Nachstartanhebung f¸r ungedrosselten Betrieb" CURVE 0xFD1BF3 GklWUb 1.992 fak_ub_b2 0.00 1.992 FORMAT "%5.3"
 /begin AXIS_DESCR COM_AXIS tmst temp_ub_q0p75_o48 12 -48.00 143.3 FORMAT "%5.1" AXIS_PTS_REF STS12ESUB /end AXIS_DESCR
/end CHARACTERISTIC
/begin CHARACTERISTIC FRHOKRST "Kraftstofftemperatur abh‰ngiger Einspritzkorrekturfaktor" CURVE 0xFC68F0 KlAxU8SstxU8WU8 0.4980 fak_ub_b1p25_o0p75 0.7500 1.248 FORMAT "%5.3"
 /begin AXIS_DESCR STD_AXIS tkrst temp_ub_q0p75_o48 9 -48.00 143.3 FORMAT "%5.1" DEPOSIT ABSOLUTE /end AXIS_DESCR
/end CHARACTERISTIC
/begin CHARACTERISTIC FRKAP "Faktor relative Kraftstoffmasse f¸r Applikation" VALUE 0xFD1AF8 KwUb 1.992 fak_ub_b2 0.00 1.992 FORMAT "%5.3" /end CHARACTERISTIC
/begin CHARACTERISTIC FTETEDF "Beladungsschwelle Fettkorrektur f¸r Pr¸fung i.O." VALUE 0xFD4872 KwSw 127.9980 fak_sw_b64 -64.00000 63.99805 FORMAT "%8.5" /end CHARACTERISTIC
/begin CHARACTERISTIC FTETEDM "Beladungsschwelle Magerkorrektur f¸r Pr¸fung i.O." VALUE 0xFD4874 KwSw 127.9980 fak_sw_b64 -64.00000 63.99805 FORMAT "%8.5" /end CHARACTERISTIC
/begin CHARACTERISTIC FUKE "Faktor ‹K-Ersatzwert" VALUE 0xFC6EB2 KwUw 7.999878 fak_uw_b8 0.00 7.999878 FORMAT "%8.6" /end CHARACTERISTIC
/begin CHARACTERISTIC FUKEDK "Faktor ‹K-Ersatzwert" VALUE 0xFC7172 KwUw 7.999878 fak_uw_b8 0.00 7.999878 FORMAT "%8.6" /end CHARACTERISTIC
/begin CHARACTERISTIC FUKNSTHO "Hoehenfaktor ‹K im Nachstart" CURVE 0xFD1C9C KlAUbSstUbWUb 1.992 fak_ub_b2 0.00 1.992 FORMAT "%5.3"
 /begin AXIS_DESCR STD_AXIS fho fak_ub_b4 6 0.00 3.984 FORMAT "%5.3" DEPOSIT ABSOLUTE /end AXIS_DESCR
/end CHARACTERISTIC
/begin CHARACTERISTIC FUKNSTHOD "Hoehenfaktor ‹K im Nachstart" CURVE 0xFD1E28 KlAUbSstUbWUb 1.992 fak_ub_b2 0.00 1.992 FORMAT "%5.3"
 /begin AXIS_DESCR STD_AXIS fho fak_ub_b4 6 0.00 3.984 FORMAT "%5.3" DEPOSIT ABSOLUTE /end AXIS_DESCR
/end CHARACTERISTIC
/begin CHARACTERISTIC FUKNSTM "Startwert Faktor ‹K im Nachstart" CURVE 0xFD1CA9 KlAUbSstUbWUb 3.984 fak_ub_b4 0.00 3.984 FORMAT "%5.3"
 /begin AXIS_DESCR STD_AXIS tmst temp_ub_q0p75_o48 9 -48.00 143.3 FORMAT "%5.1" DEPOSIT ABSOLUTE /end AXIS_DESCR
/end CHARACTERISTIC
/begin CHARACTERISTIC FUKNSTMDK "Startwert Faktor ‹K im Nachstart" CURVE 0xFD1E35 KlAUbSstUbWUb 3.984 fak_ub_b4 0.00 3.984 FORMAT "%5.3"
 /begin AXIS_DESCR STD_AXIS tmst temp_ub_q0p75_o48 9 -48.00 143.3 FORMAT "%5.1" DEPOSIT ABSOLUTE /end AXIS_DESCR
/end CHARACTERISTIC
/begin CHARACTERISTIC FVANST "Gewichtungsfaktor VA im Nachstart" VALUE 0xFC6DAF KwUb 1.992 fak_ub_b2 0.00 1.992 FORMAT "%5.3" /end CHARACTERISTIC
/begin CHARACTERISTIC FVANSTDK "Gewichtungsfaktor VA im Nachstart" VALUE 0xFC7070 KwUb 1.992 fak_ub_b2 0.00 1.992 FORMAT "%5.3" /end CHARACTERISTIC
/begin CHARACTERISTIC FWFN "Faktor Wandfilm Drehzahleinfluss" VALUE 0xFC6DB0 KwUb 1.494 rel_ub_b1p4941 0.00 1.494 FORMAT "%5.3" /end CHARACTERISTIC
/begin CHARACTERISTIC FWFNDK "Faktor Wandfilm Drehzahleinfluss" VALUE 0xFC7071 KwUb 1.494 rel_ub_b1p4941 0.00 1.494 FORMAT "%5.3" /end CHARACTERISTIC
/begin CHARACTERISTIC FWSTAA1 "Wichtung Nachstart" CURVE 0xFC6968 GklWUb 1.992 fak_ub_b2 0.00 1.992 FORMAT "%5.3"
 /begin AXIS_DESCR COM_AXIS kstaa fak_ub_b2 6 0.00 1.992 FORMAT "%5.3" AXIS_PTS_REF SKS06ESUB /end AXIS_DESCR
/end CHARACTERISTIC
/begin CHARACTERISTIC FWSTAA2 "Wichtung Nachstart Umschaltschwelle" CURVE 0xFC696E GklWUb 1.992 fak_ub_b2 0.00 1.992 FORMAT "%5.3"
 /begin AXIS_DESCR COM_AXIS kstaa fak_ub_b2 6 0.00 1.992 FORMAT "%5.3" AXIS_PTS_REF SKS06ESUB /end AXIS_DESCR
/end CHARACTERISTIC
/begin CHARACTERISTIC FWSTAA3 "Wichtung Nachstart Abregelung Bereich 1" CURVE 0xFC6974 GklWUb 1.992 fak_ub_b2 0.00 1.992 FORMAT "%5.3"
 /begin AXIS_DESCR COM_AXIS kstaa fak_ub_b2 6 0.00 1.992 FORMAT "%5.3" AXIS_PTS_REF SKS06ESUB /end AXIS_DESCR
/end CHARACTERISTIC
/begin CHARACTERISTIC FWSTAA4 "Wichtung Nachstart Abregelung Bereich 2" CURVE 0xFC697A GklWUb 1.992 fak_ub_b2 0.00 1.992 FORMAT "%5.3"
 /begin AXIS_DESCR COM_AXIS kstaa fak_ub_b2 6 0.00 1.992 FORMAT "%5.3" AXIS_PTS_REF SKS06ESUB /end AXIS_DESCR
/end CHARACTERISTIC
/begin CHARACTERISTIC FZALIM "Schwelle des Fehlerz‰hlers der Aussetzererkennung f¸r DZK Freigabe" VALUE 0xFCD93C KwWU16 65535.00 dez 0.00 65535.00 FORMAT "%8.2" /end CHARACTERISTIC
/begin CHARACTERISTIC FZANSSA1 "Faktor f¸r z¸ndsynchrone Abregelung des Nachstartfaktors bei Heiﬂstart Bereich 1" CURVE 0xFD1BFF GklWUb 0.249023438 fak_ub_b0p25 0.00 0.249023438 FORMAT "%11.9"
 /begin AXIS_DESCR COM_AXIS tans temp_ub_q0p75_o48 6 -48.00 143.3 FORMAT "%5.1" AXIS_PTS_REF STA06ESUB /end AXIS_DESCR
/end CHARACTERISTIC
/begin CHARACTERISTIC FZANSSA1VT "Faktor z¸ndsynchr Abregelung Nachstartfaktors bei Heiﬂstart Bereich 1 VVT-Betr" CURVE 0xFD1C05 GklWUb 0.249023438 fak_ub_b0p25 0.00 0.249023438 FORMAT "%11.9"
 /begin AXIS_DESCR COM_AXIS tans temp_ub_q0p75_o48 6 -48.00 143.3 FORMAT "%5.1" AXIS_PTS_REF STA06ESUB /end AXIS_DESCR
/end CHARACTERISTIC
/begin CHARACTERISTIC FZANSSA2 "Faktor f¸r z¸ndsynchrone Abregelung des Nachstartfaktors bei Heiﬂstart Bereich 2" CURVE 0xFD1C0B GklWUb 0.249023438 fak_ub_b0p25 0.00 0.249023438 FORMAT "%11.9"
 /begin AXIS_DESCR COM_AXIS tans temp_ub_q0p75_o48 6 -48.00 143.3 FORMAT "%5.1" AXIS_PTS_REF STA06ESUB /end AXIS_DESCR
/end CHARACTERISTIC
/begin CHARACTERISTIC FZANSSA2VT "Faktor z¸ndsynchr Abregelung Nachstartfaktors bei Heiﬂstart Bereich 2 VVT-Betr" CURVE 0xFD1C11 GklWUb 0.249023438 fak_ub_b0p25 0.00 0.249023438 FORMAT "%11.9"
 /begin AXIS_DESCR COM_AXIS tans temp_ub_q0p75_o48 6 -48.00 143.3 FORMAT "%5.1" AXIS_PTS_REF STA06ESUB /end AXIS_DESCR
/end CHARACTERISTIC
/begin CHARACTERISTIC FZANSSM1 "Faktor f¸r z¸ndsynchrone Abregelung des Nachstartfaktors oberhalb Schwelle" CURVE 0xFD1C17 GklWUb 0.249023438 fak_ub_b0p25 0.00 0.249023438 FORMAT "%11.9"
 /begin AXIS_DESCR COM_AXIS tmst temp_ub_q0p75_o48 12 -48.00 143.3 FORMAT "%5.1" AXIS_PTS_REF STS12ESUB /end AXIS_DESCR
/end CHARACTERISTIC
/begin CHARACTERISTIC FZANSSM1VT "Faktor z¸ndsynchr Abregelung des Nachstartfaktors oberhalb Schwelle VVT-Betr" CURVE 0xFD1C23 GklWUb 0.249023438 fak_ub_b0p25 0.00 0.249023438 FORMAT "%11.9"
 /begin AXIS_DESCR COM_AXIS tmst temp_ub_q0p75_o48 12 -48.00 143.3 FORMAT "%5.1" AXIS_PTS_REF STS12ESUB /end AXIS_DESCR
/end CHARACTERISTIC
/begin CHARACTERISTIC FZANSSM2 "Faktor f¸r z¸ndsynchrone Abregelung des Nachstartfaktors unterhalb Schwelle" CURVE 0xFD1C2F GklWUb 0.249023438 fak_ub_b0p25 0.00 0.249023438 FORMAT "%11.9"
 /begin AXIS_DESCR COM_AXIS tmst temp_ub_q0p75_o48 12 -48.00 143.3 FORMAT "%5.1" AXIS_PTS_REF STS12ESUB /end AXIS_DESCR
/end CHARACTERISTIC
/begin CHARACTERISTIC FZANSSM2VT "Faktor z¸ndsynchr Abregelung des Nachstartfaktors unterhalb Schwelle VVT-Betr" CURVE 0xFD1C3B GklWUb 0.249023438 fak_ub_b0p25 0.00 0.249023438 FORMAT "%11.9"
 /begin AXIS_DESCR COM_AXIS tmst temp_ub_q0p75_o48 12 -48.00 143.3 FORMAT "%5.1" AXIS_PTS_REF STS12ESUB /end AXIS_DESCR
/end CHARACTERISTIC
/begin CHARACTERISTIC FZLIMUB "Schwelle f¸r Aussetzerz‰hler f¸r Freigabe Niederpedanzerkennung" VALUE 0xFCD93E KwWU16 65535.00 dez 0.00 65535.00 FORMAT "%8.2" /end CHARACTERISTIC
/begin CHARACTERISTIC HOTEDU "Untere Hˆhenschwelle f¸r Durchf¸hrung Tankentl¸ftungsdiagnose" VALUE 0xFD48B2 KwWU16 3.999939 fak_uw_b4 0.00 3.999939 FORMAT "%8.6" /end CHARACTERISTIC
/begin CHARACTERISTIC HTEDU "Untere Hˆhenschwelle f¸r Durchf¸hrung Tankentl¸ftungsdiagnose" VALUE 0xFD486E KwUb 3.984 fak_ub_b4 0.00 3.984 FORMAT "%5.3" /end CHARACTERISTIC
/begin CHARACTERISTIC IMLHS "Luftmassenintegral Heiﬂstart" VALUE 0xFC6B63 KwUb 23.21 m_ub_b23p3 0.00 23.21 FORMAT "%5.2" /end CHARACTERISTIC
/begin CHARACTERISTIC INTEDOFS "Obere Schwelle f¸r Tankentl¸ftungsdiagnose mit FS" VALUE 0xFCCA2A KwSw 16383.75 nmot_sw_q0p25 -8192.000 8191.750 FORMAT "%8.3" /end CHARACTERISTIC
/begin CHARACTERISTIC INTEDOOFS "Obere Schwelle f¸r Tankentl¸ftungsdiagnose ohne FS" VALUE 0xFCCA2C KwSw 16383.75 nmot_sw_q0p25 -8192.000 8191.750 FORMAT "%8.3" /end CHARACTERISTIC
/begin CHARACTERISTIC INTEDUFS "Untere Schwelle f¸r Tankentl¸ftungsdiagnose mit FS" VALUE 0xFCCA2E KwSw 16383.75 nmot_sw_q0p25 -8192.000 8191.750 FORMAT "%8.3" /end CHARACTERISTIC
/begin CHARACTERISTIC INTEDUOFS "Untere Schwelle f¸r Tankentl¸ftungsventil ohne FS" VALUE 0xFCCA30 KwSw 16383.75 nmot_sw_q0p25 -8192.000 8191.750 FORMAT "%8.3" /end CHARACTERISTIC
/begin CHARACTERISTIC KFABAK "Aufteilungsfaktor Wandfilm bei BA" MAP 0xFD1CBC GkfWUb 0.9961 fak_ub_b1 0.00 0.9961
 /begin AXIS_DESCR COM_AXIS tmot temp_ub_q0p75_o48 9 -48.00 143.3 FORMAT "%5.1" AXIS_PTS_REF STM09ESUB /end AXIS_DESCR
 /begin AXIS_DESCR COM_AXIS nmot nmot_ub_q40 7 0.00 10200. FORMAT "%5.0" AXIS_PTS_REF SNM07ESUB /end AXIS_DESCR
/end CHARACTERISTIC
/begin CHARACTERISTIC KFABAKDK "Aufteilungsfaktor Wandfilm bei BA" MAP 0xFD1E48 GkfWUb 0.9961 fak_ub_b1 0.00 0.9961
 /begin AXIS_DESCR COM_AXIS tmot temp_ub_q0p75_o48 9 -48.00 143.3 FORMAT "%5.1" AXIS_PTS_REF STM09ESUB /end AXIS_DESCR
 /begin AXIS_DESCR COM_AXIS nmot nmot_ub_q40 7 0.00 10200. FORMAT "%5.0" AXIS_PTS_REF SNM07ESUB /end AXIS_DESCR
/end CHARACTERISTIC
/begin CHARACTERISTIC KFAKBDK "Wichtung Kennfeldpunkt bei Beschleunigung ESAK DK Anteil" MAP 0xFC7072 KfAxUbAyUbSstxUbSstyUbWUb 2.550 fak_ub_q0p01 0.00 2.550 FORMAT "%5.3"
 /begin AXIS_DESCR STD_AXIS nmot nmot_ub_q40 8 0.00 10200. FORMAT "%5.0" DEPOSIT ABSOLUTE /end AXIS_DESCR
 /begin AXIS_DESCR STD_AXIS rl rel_ub_q0p75 6 0.00 191.3 FORMAT "%5.1" DEPOSIT ABSOLUTE /end AXIS_DESCR
/end CHARACTERISTIC
/begin CHARACTERISTIC KFAKBTD "" MAP 0xFC6C52 KfAxU8AyU8SstxU16SstyU16WU16 3.984375 fak_ub_b4 0.00 3.984375 FORMAT "%8.6"
 /begin AXIS_DESCR STD_AXIS minhub_w hub_uw_q0p001 8 0.00 65.53500 FORMAT "%8.5" DEPOSIT ABSOLUTE /end AXIS_DESCR
 /begin AXIS_DESCR STD_AXIS dpssol_uw p_q0p039 8 0.00 2559.961 FORMAT "%8.3" DEPOSIT ABSOLUTE /end AXIS_DESCR
/end CHARACTERISTIC
/begin CHARACTERISTIC KFAKBVVT "Wichtung Kennfeldpunkt bei Beschleunigung ESAK VVT Anteil" MAP 0xFC6DB1 KfAxUbAyUbSstxUbSstyUbWUb 2.550 fak_ub_q0p01 0.00 2.550 FORMAT "%5.3"
 /begin AXIS_DESCR STD_AXIS nmot nmot_ub_q40 8 0.00 10200. FORMAT "%5.0" DEPOSIT ABSOLUTE /end AXIS_DESCR
 /begin AXIS_DESCR STD_AXIS rl rel_ub_q0p75 6 0.00 191.3 FORMAT "%5.1" DEPOSIT ABSOLUTE /end AXIS_DESCR
/end CHARACTERISTIC
/begin CHARACTERISTIC KFAKTDK "" MAP 0xFC70B2 KfAxUbAyUbSstxUbSstyUbWUb 12.45 fak_ub_b12p45 0.00 12.45 FORMAT "%5.2"
 /begin AXIS_DESCR STD_AXIS tmot temp_ub_q0p75_o48 8 -48.00 143.3 FORMAT "%5.1" DEPOSIT ABSOLUTE /end AXIS_DESCR
 /begin AXIS_DESCR STD_AXIS tans temp_ub_q0p75_o48 5 -48.00 143.3 FORMAT "%5.1" DEPOSIT ABSOLUTE /end AXIS_DESCR
/end CHARACTERISTIC
/begin CHARACTERISTIC KFAKTVVT "" MAP 0xFC6DF1 KfAxUbAyUbSstxUbSstyUbWUb 12.45 fak_ub_b12p45 0.00 12.45 FORMAT "%5.2"
 /begin AXIS_DESCR STD_AXIS tmot temp_ub_q0p75_o48 8 -48.00 143.3 FORMAT "%5.1" DEPOSIT ABSOLUTE /end AXIS_DESCR
 /begin AXIS_DESCR STD_AXIS tans temp_ub_q0p75_o48 5 -48.00 143.3 FORMAT "%5.1" DEPOSIT ABSOLUTE /end AXIS_DESCR
/end CHARACTERISTIC
/begin CHARACTERISTIC KFAKVDK "Wichtung Kennfeldpunkt bei Verzˆgerung ESAK DK Anteil" MAP 0xFC70E9 KfAxUbAyUbSstxUbSstyUbWUb 2.550 fak_ub_q0p01 0.00 2.550 FORMAT "%5.3"
 /begin AXIS_DESCR STD_AXIS nmot nmot_ub_q40 8 0.00 10200. FORMAT "%5.0" DEPOSIT ABSOLUTE /end AXIS_DESCR
 /begin AXIS_DESCR STD_AXIS rl rel_ub_q0p75 6 0.00 191.3 FORMAT "%5.1" DEPOSIT ABSOLUTE /end AXIS_DESCR
/end CHARACTERISTIC
/begin CHARACTERISTIC KFAKVTD "" MAP 0xFC6CF6 KfAxU8AyU8SstxU16SstyU16WU16 3.984375 fak_ub_b4 0.00 3.984375 FORMAT "%8.6"
 /begin AXIS_DESCR STD_AXIS minhub_w hub_uw_q0p001 8 0.00 65.53500 FORMAT "%8.5" DEPOSIT ABSOLUTE /end AXIS_DESCR
 /begin AXIS_DESCR STD_AXIS dpssol_uw p_q0p039 8 0.00 2559.961 FORMAT "%8.3" DEPOSIT ABSOLUTE /end AXIS_DESCR
/end CHARACTERISTIC
/begin CHARACTERISTIC KFAKVVVT "Wichtung Kennfeldpunkt bei Verzˆgerung ESAK VVT Anteil" MAP 0xFC6E28 KfAxUbAyUbSstxUbSstyUbWUb 2.550 fak_ub_q0p01 0.00 2.550 FORMAT "%5.3"
 /begin AXIS_DESCR STD_AXIS nmot nmot_ub_q40 8 0.00 10200. FORMAT "%5.0" DEPOSIT ABSOLUTE /end AXIS_DESCR
 /begin AXIS_DESCR STD_AXIS rl rel_ub_q0p75 6 0.00 191.3 FORMAT "%5.1" DEPOSIT ABSOLUTE /end AXIS_DESCR
/end CHARACTERISTIC
/begin CHARACTERISTIC KFAKWDK "" MAP 0xFC7174 KfAxUbAyUbSstxSwSstyUbWSw 3071.953 rel_sw_b1536 -1536.000 1535.953 FORMAT "%8.3"
 /begin AXIS_DESCR STD_AXIS ddrkakdk_w rel_sw_b1536 8 -1536.000 1535.953 FORMAT "%8.3" DEPOSIT ABSOLUTE /end AXIS_DESCR
 /begin AXIS_DESCR STD_AXIS nmot nmot_ub_q40 4 0.00 10200. FORMAT "%5.0" DEPOSIT ABSOLUTE /end AXIS_DESCR
/end CHARACTERISTIC
/begin CHARACTERISTIC KFAKWVVT "" MAP 0xFC6EB4 KfAxUbAyUbSstxSwSstyUbWSw 3071.953 rel_sw_b1536 -1536.000 1535.953 FORMAT "%8.3"
 /begin AXIS_DESCR STD_AXIS ddrkakvt_w rel_sw_b1536 8 -1536.000 1535.953 FORMAT "%8.3" DEPOSIT ABSOLUTE /end AXIS_DESCR
 /begin AXIS_DESCR STD_AXIS nmot nmot_ub_q40 4 0.00 10200. FORMAT "%5.0" DEPOSIT ABSOLUTE /end AXIS_DESCR
/end CHARACTERISTIC
/begin CHARACTERISTIC KFAVAK "Aufteilungsfaktor Wandfilm bei VA" MAP 0xFD1CFB GkfWUb 0.9961 fak_ub_b1 0.00 0.9961
 /begin AXIS_DESCR COM_AXIS tmot temp_ub_q0p75_o48 9 -48.00 143.3 FORMAT "%5.1" AXIS_PTS_REF STM09ESUB /end AXIS_DESCR
 /begin AXIS_DESCR COM_AXIS nmot nmot_ub_q40 7 0.00 10200. FORMAT "%5.0" AXIS_PTS_REF SNM07ESUB /end AXIS_DESCR
/end CHARACTERISTIC
/begin CHARACTERISTIC KFAVAKDK "Aufteilungsfaktor Wandfilm bei VA" MAP 0xFD1E87 GkfWUb 0.9961 fak_ub_b1 0.00 0.9961
 /begin AXIS_DESCR COM_AXIS tmot temp_ub_q0p75_o48 9 -48.00 143.3 FORMAT "%5.1" AXIS_PTS_REF STM09ESUB /end AXIS_DESCR
 /begin AXIS_DESCR COM_AXIS nmot nmot_ub_q40 7 0.00 10200. FORMAT "%5.0" AXIS_PTS_REF SNM07ESUB /end AXIS_DESCR
/end CHARACTERISTIC
/begin CHARACTERISTIC KFBAKL "Faktor Beschleunigungsanreicherung (K+L-Anteil)" MAP 0xFD1D3A GkfWUb 15.94 fak_ub_b16 0.00 15.94 FORMAT "%5.2"
 /begin AXIS_DESCR COM_AXIS tmot temp_ub_q0p75_o48 9 -48.00 143.3 FORMAT "%5.1" AXIS_PTS_REF STM09ESUB /end AXIS_DESCR
 /begin AXIS_DESCR COM_AXIS nmot nmot_ub_q40 7 0.00 10200. FORMAT "%5.0" AXIS_PTS_REF SNM07ESUB /end AXIS_DESCR
/end CHARACTERISTIC
/begin CHARACTERISTIC KFBAKLDK "Faktor Beschleunigungsanreicherung (K+L-Anteil)" MAP 0xFD1EC6 GkfWUb 15.94 fak_ub_b16 0.00 15.94 FORMAT "%5.2"
 /begin AXIS_DESCR COM_AXIS tmot temp_ub_q0p75_o48 9 -48.00 143.3 FORMAT "%5.1" AXIS_PTS_REF STM09ESUB /end AXIS_DESCR
 /begin AXIS_DESCR COM_AXIS nmot nmot_ub_q40 7 0.00 10200. FORMAT "%5.0" AXIS_PTS_REF SNM07ESUB /end AXIS_DESCR
/end CHARACTERISTIC
/begin CHARACTERISTIC KFDVEXWO "" MAP 0xFC40AE KfAxU8AyU8SstxU16SstyU16WU16 6553.500 wink_uw_q0p1 0.00 6553.500 FORMAT "%8.3"
 /begin AXIS_DESCR STD_AXIS wnkmin_w wink_uw_q0p1 4 0.00 6553.500 FORMAT "%8.3" DEPOSIT ABSOLUTE /end AXIS_DESCR
 /begin AXIS_DESCR STD_AXIS nmot_w nmot_uw_q0p25 4 0.00 16383.75 FORMAT "%8.2" DEPOSIT ABSOLUTE /end AXIS_DESCR
/end CHARACTERISTIC
/begin CHARACTERISTIC KFFAKRL "" MAP 0xFC6E68 KfAxUbAyUbSstxUbSstyUbWUb 1.000 fak_ub_q0p00392 0.00 1.000 FORMAT "%5.3"
 /begin AXIS_DESCR STD_AXIS gangi dez 7 0.00 255.0 FORMAT "%5.1" DEPOSIT ABSOLUTE /end AXIS_DESCR
 /begin AXIS_DESCR STD_AXIS nmot nmot_ub_q40 7 0.00 10200. FORMAT "%5.0" DEPOSIT ABSOLUTE /end AXIS_DESCR
/end CHARACTERISTIC
/begin CHARACTERISTIC KFFAKRLDK "" MAP 0xFC7129 KfAxUbAyUbSstxUbSstyUbWUb 1.000 fak_ub_q0p00392 0.00 1.000 FORMAT "%5.3"
 /begin AXIS_DESCR STD_AXIS gangi dez 7 0.00 255.0 FORMAT "%5.1" DEPOSIT ABSOLUTE /end AXIS_DESCR
 /begin AXIS_DESCR STD_AXIS nmot nmot_ub_q40 7 0.00 10200. FORMAT "%5.0" DEPOSIT ABSOLUTE /end AXIS_DESCR
/end CHARACTERISTIC
/begin CHARACTERISTIC KFFNSW "" MAP 0xFC6904 KfAxU8AyU8SstxU16SstyU16WU16 3.984375 fak_ub_b4 0.00 3.984375 FORMAT "%8.6"
 /begin AXIS_DESCR STD_AXIS tmst_w temp_uw_q0p75_o48 6 -48.00000 143.2500 FORMAT "%8.4" DEPOSIT ABSOLUTE /end AXIS_DESCR
 /begin AXIS_DESCR STD_AXIS anztibstnd dez 6 0.00 65535.00 FORMAT "%8.2" DEPOSIT ABSOLUTE /end AXIS_DESCR
/end CHARACTERISTIC
/begin CHARACTERISTIC KFFWST "Faktor Wiederholstart" MAP 0xFC6BD6 KfAxUbAyUbSstxUwSstyUbWUb 0.9961 fak_ub_b1 0.00 0.9961
 /begin AXIS_DESCR STD_AXIS tmlauf_w t100msxs_uw_b6553p6 8 0.00 6553.500 FORMAT "%8.3" DEPOSIT ABSOLUTE /end AXIS_DESCR
 /begin AXIS_DESCR STD_AXIS tmotab temp_ub_q0p75_o48 8 -48.00 143.3 FORMAT "%5.1" DEPOSIT ABSOLUTE /end AXIS_DESCR
/end CHARACTERISTIC
/begin CHARACTERISTIC KFLANS "Kennfeld Lambda-Motor-Beschreibung im Nachstart" MAP 0xFC6A06 GkfWUw 15.89990 fak_uw_b16 0.09985352 15.99976 FORMAT "%8.5"
 /begin AXIS_DESCR COM_AXIS tmst temp_ub_q0p75_o48 12 -48.00 143.3 FORMAT "%5.1" AXIS_PTS_REF STS12ESUB /end AXIS_DESCR
 /begin AXIS_DESCR COM_AXIS anztib_w dez 12 0.00 65535.00 FORMAT "%8.2" AXIS_PTS_REF SAN12ESUW /end AXIS_DESCR
/end CHARACTERISTIC
/begin CHARACTERISTIC KFLF "Lambdakennfeld bei Teillast" MAP 0xFD1AF9 KfAxUbAyUbSstxUbSstyUbWUb 1.992 fak_ub_b2 0.00 1.992 FORMAT "%5.3"
 /begin AXIS_DESCR STD_AXIS nmot nmot_ub_q40 12 0.00 10200. FORMAT "%5.0" DEPOSIT ABSOLUTE /end AXIS_DESCR
 /begin AXIS_DESCR STD_AXIS rl rel_ub_q0p75 16 0.00 191.3 FORMAT "%5.1" DEPOSIT ABSOLUTE /end AXIS_DESCR
/end CHARACTERISTIC
/begin CHARACTERISTIC KFNSWRL "Wichtung Nachstartanhebung" MAP 0xFC6980 KfAxUbAyUbSstxUbSstyUbWUb 3.984 fak_ub_b4 0.00 3.984 FORMAT "%5.3"
 /begin AXIS_DESCR STD_AXIS tmst temp_ub_q0p75_o48 8 -48.00 143.3 FORMAT "%5.1" DEPOSIT ABSOLUTE /end AXIS_DESCR
 /begin AXIS_DESCR STD_AXIS rl rel_ub_q0p75 6 0.00 191.3 FORMAT "%5.1" DEPOSIT ABSOLUTE /end AXIS_DESCR
/end CHARACTERISTIC
/begin CHARACTERISTIC KFNSWRLVT "Wichtung Nachstartanhebung f¸r ungedrosselten Betrieb" MAP 0xFC69C0 KfAxUbAyUbSstxUbSstyUbWUb 3.984 fak_ub_b4 0.00 3.984 FORMAT "%5.3"
 /begin AXIS_DESCR STD_AXIS tmst temp_ub_q0p75_o48 8 -48.00 143.3 FORMAT "%5.1" DEPOSIT ABSOLUTE /end AXIS_DESCR
 /begin AXIS_DESCR STD_AXIS rl rel_ub_q0p75 6 0.00 191.3 FORMAT "%5.1" DEPOSIT ABSOLUTE /end AXIS_DESCR
/end CHARACTERISTIC
/begin CHARACTERISTIC KFVAKL "Faktor Verzˆgerungsabmagerung (K+L-Anteil)" MAP 0xFD1D79 GkfWUb 15.94 fak_ub_b16 0.00 15.94 FORMAT "%5.2"
 /begin AXIS_DESCR COM_AXIS tmot temp_ub_q0p75_o48 9 -48.00 143.3 FORMAT "%5.1" AXIS_PTS_REF STM09ESUB /end AXIS_DESCR
 /begin AXIS_DESCR COM_AXIS nmot nmot_ub_q40 7 0.00 10200. FORMAT "%5.0" AXIS_PTS_REF SNM07ESUB /end AXIS_DESCR
/end CHARACTERISTIC
/begin CHARACTERISTIC KFVAKLDK "Faktor Verzˆgerungsabmagerung (K+L-Anteil)" MAP 0xFD1F05 GkfWUb 15.94 fak_ub_b16 0.00 15.94 FORMAT "%5.2"
 /begin AXIS_DESCR COM_AXIS tmot temp_ub_q0p75_o48 9 -48.00 143.3 FORMAT "%5.1" AXIS_PTS_REF STM09ESUB /end AXIS_DESCR
 /begin AXIS_DESCR COM_AXIS nmot nmot_ub_q40 7 0.00 10200. FORMAT "%5.0" AXIS_PTS_REF SNM07ESUB /end AXIS_DESCR
/end CHARACTERISTIC
/begin CHARACTERISTIC KFWEE "Kennfeld Winkel Einspritzende" MAP 0xFC71D8 GkfWU8 765.0 kw_q3 0.00 765.0 FORMAT "%5.1"
 /begin AXIS_DESCR COM_AXIS nmot nmot_ub_q40 8 0.00 10200. FORMAT "%5.0" AXIS_PTS_REF SNM08GKUB /end AXIS_DESCR
 /begin AXIS_DESCR COM_AXIS rl rel_ub_q0p75 8 0.00 191.3 FORMAT "%5.1" AXIS_PTS_REF SRL08GKUB /end AXIS_DESCR
/end CHARACTERISTIC
/begin CHARACTERISTIC KFWEEGD "Kennfeld Winkel Einspritzende f¸r gedrosselten Betrieb" MAP 0xFC7218 GkfWU8 765.0 kw_q3 0.00 765.0 FORMAT "%5.1"
 /begin AXIS_DESCR COM_AXIS nmot nmot_ub_q40 8 0.00 10200. FORMAT "%5.0" AXIS_PTS_REF SNM08GKUB /end AXIS_DESCR
 /begin AXIS_DESCR COM_AXIS rl rel_ub_q0p75 8 0.00 191.3 FORMAT "%5.1" AXIS_PTS_REF SRL08GKUB /end AXIS_DESCR
/end CHARACTERISTIC
/begin CHARACTERISTIC KFWEEST "Kennfeld Winkel Einspritzende w‰hrend Start" MAP 0xFC7278 KfAxU8AyU8SstxU16SstyU16WU16 765.0000 kw_q3 0.00 765.0000 FORMAT "%8.4"
 /begin AXIS_DESCR STD_AXIS tmot temp_ub_q0p75_o48 8 -48.00 143.3 FORMAT "%5.1" DEPOSIT ABSOLUTE /end AXIS_DESCR
 /begin AXIS_DESCR STD_AXIS nmot nmot_ub_q40 4 0.00 10200. FORMAT "%5.0" DEPOSIT ABSOLUTE /end AXIS_DESCR
/end CHARACTERISTIC
/begin CHARACTERISTIC KFWEESTGD "Kennfeld Winkel Einspritzende im Start gedrosselt" MAP 0xFC72D4 KfAxU8AyU8SstxU16SstyU16WU16 765.0000 kw_q3 0.00 765.0000 FORMAT "%8.4"
 /begin AXIS_DESCR STD_AXIS tmot temp_ub_q0p75_o48 8 -48.00 143.3 FORMAT "%5.1" DEPOSIT ABSOLUTE /end AXIS_DESCR
 /begin AXIS_DESCR STD_AXIS nmot nmot_ub_q40 4 0.00 10200. FORMAT "%5.0" DEPOSIT ABSOLUTE /end AXIS_DESCR
/end CHARACTERISTIC
/begin CHARACTERISTIC KFWFRLDK "Kraftstoffwandfilmkennfeld" MAP 0xFC6F4C KfAxU8AyU8SstxU16SstyU16WU16 6143.906 rel_uw_b6144 0.00 6143.906 FORMAT "%8.3"
 /begin AXIS_DESCR STD_AXIS rlp_w rel_uw_q0p0234 26 0.00 1535.977 FORMAT "%8.3" DEPOSIT ABSOLUTE /end AXIS_DESCR
 /begin AXIS_DESCR STD_AXIS evhubi_w hub_uw_q0p001 4 0.00 65.53500 FORMAT "%8.5" DEPOSIT ABSOLUTE /end AXIS_DESCR
/end CHARACTERISTIC
/begin CHARACTERISTIC KFWHSTT "Wichtungskennfeld Heiﬂstart" MAP 0xFC6B64 KfAxUbAyUbSstxUbSstyUbWUb 1.992 fak_ub_b2 0.00 1.992 FORMAT "%5.3"
 /begin AXIS_DESCR STD_AXIS tans temp_ub_q0p75_o48 4 -48.00 143.3 FORMAT "%5.1" DEPOSIT ABSOLUTE /end AXIS_DESCR
 /begin AXIS_DESCR STD_AXIS anztist dez 4 0.00 255.0 FORMAT "%5.1" DEPOSIT ABSOLUTE /end AXIS_DESCR
/end CHARACTERISTIC
/begin CHARACTERISTIC KFWKSTN "Wichtungskennfeld Kaltstart" MAP 0xFC6B7E KfAxUbAyUbSstxUbSstyUbWUb 0.9961 fak_ub_b1 0.00 0.9961
 /begin AXIS_DESCR STD_AXIS tmst temp_ub_q0p75_o48 4 -48.00 143.3 FORMAT "%5.1" DEPOSIT ABSOLUTE /end AXIS_DESCR
 /begin AXIS_DESCR STD_AXIS nmotz nmot_ub_q10 4 0.00 2550. FORMAT "%5.0" DEPOSIT ABSOLUTE /end AXIS_DESCR
/end CHARACTERISTIC
/begin CHARACTERISTIC KFWKSTT "Wichtungskennfeld Kaltstart" MAP 0xFC6B98 KfAxUbAyUbSstxUbSstyUbWUb 1.992 fak_ub_b2 0.00 1.992 FORMAT "%5.3"
 /begin AXIS_DESCR STD_AXIS tmst temp_ub_q0p75_o48 6 -48.00 143.3 FORMAT "%5.1" DEPOSIT ABSOLUTE /end AXIS_DESCR
 /begin AXIS_DESCR STD_AXIS anztist dez 6 0.00 255.0 FORMAT "%5.1" DEPOSIT ABSOLUTE /end AXIS_DESCR
/end CHARACTERISTIC
/begin CHARACTERISTIC KFWWNS "Wiederholstartzeitfaktor" MAP 0xFD1C60 KfAxUbAyUbSstxUwSstyUbWUb 1.992 fak_ub_b2 0.00 1.992 FORMAT "%5.3"
 /begin AXIS_DESCR STD_AXIS tabst_w t1sxs_uw_q1 4 0.00 65535.00 FORMAT "%8.2" DEPOSIT ABSOLUTE /end AXIS_DESCR
 /begin AXIS_DESCR STD_AXIS tmst temp_ub_q0p75_o48 4 -48.00 143.3 FORMAT "%5.1" DEPOSIT ABSOLUTE /end AXIS_DESCR
/end CHARACTERISTIC
/begin CHARACTERISTIC KFWWNSVT "Wiederholstartzeitfaktor f¸r ungedrosselten Betrieb" MAP 0xFD1C7E KfAxUbAyUbSstxUwSstyUbWUb 1.992 fak_ub_b2 0.00 1.992 FORMAT "%5.3"
 /begin AXIS_DESCR STD_AXIS tabst_w t1sxs_uw_q1 4 0.00 65535.00 FORMAT "%8.2" DEPOSIT ABSOLUTE /end AXIS_DESCR
 /begin AXIS_DESCR STD_AXIS tmst temp_ub_q0p75_o48 4 -48.00 143.3 FORMAT "%5.1" DEPOSIT ABSOLUTE /end AXIS_DESCR
/end CHARACTERISTIC
/begin CHARACTERISTIC KLBATANS "" CURVE 0xFD1DB8 KlAUbSstUbWUb 1.992 fak_ub_b2 0.00 1.992 FORMAT "%5.3"
 /begin AXIS_DESCR STD_AXIS tans temp_ub_q0p75_o48 5 -48.00 143.3 FORMAT "%5.1" DEPOSIT ABSOLUTE /end AXIS_DESCR
/end CHARACTERISTIC
/begin CHARACTERISTIC KLBATANSDK "" CURVE 0xFD1F44 KlAUbSstUbWUb 1.992 fak_ub_b2 0.00 1.992 FORMAT "%5.3"
 /begin AXIS_DESCR STD_AXIS tans temp_ub_q0p75_o48 5 -48.00 143.3 FORMAT "%5.1" DEPOSIT ABSOLUTE /end AXIS_DESCR
/end CHARACTERISTIC
/begin CHARACTERISTIC KLDPSTEV "dps-Schwelle f¸r i.O-Z‰hler" CURVE 0xFCCA0E KlAxU8SstxS16WS16 10239.84 p_sw_q0p156 -5120.000 5119.844 FORMAT "%8.3"
 /begin AXIS_DESCR STD_AXIS dpsdter_w p_sw_q0p039 4 -1280.000 1279.961 FORMAT "%8.3" DEPOSIT ABSOLUTE /end AXIS_DESCR
/end CHARACTERISTIC
/begin CHARACTERISTIC KLDVFLUBGR "max. zulaessige Abweichung zwischen flub-Werte" CURVE 0xFC40E2 KlAxU8SstxU16WS16 15.99976 fak_sw_b8 -8.000000 7.999756 FORMAT "%8.6"
 /begin AXIS_DESCR STD_AXIS rl_w rel_uw_q0p0234 4 0.00 1535.977 FORMAT "%8.3" DEPOSIT ABSOLUTE /end AXIS_DESCR
/end CHARACTERISTIC
/begin CHARACTERISTIC KLDVMXMLDI "Kennlinie fuer max. zulaessige ml-Abweichung" CURVE 0xFC40F4 KlAxU8SstxU16WS16 6553.500 m_sw_q0p1 -3276.800 3276.700 FORMAT "%8.3"
 /begin AXIS_DESCR STD_AXIS nmot_w nmot_uw_q0p25 8 0.00 16383.75 FORMAT "%8.2" DEPOSIT ABSOLUTE /end AXIS_DESCR
/end CHARACTERISTIC
/begin CHARACTERISTIC KLDVVTRLMX "Kennlinie relative Luftmassenbegrenzung durch VVT Fehler" CURVE 0xFC4116 KlAxU8SstxU16WU16 1535.977 rel_uw_q0p0234 0.00 1535.977 FORMAT "%8.3"
 /begin AXIS_DESCR STD_AXIS nmot_w nmot_uw_q0p25 4 0.00 16383.75 FORMAT "%8.2" DEPOSIT ABSOLUTE /end AXIS_DESCR
/end CHARACTERISTIC
/begin CHARACTERISTIC KLDVWDKOF "Kennlinie Offset DK-Winkel beim ml-Check" CURVE 0xFC4128 KlAxU8SstxU16WS16 1599.976 rel_sw_q0p02441 -800.0000 799.9756 FORMAT "%8.4"
 /begin AXIS_DESCR STD_AXIS nmot_w nmot_uw_q0p25 8 0.00 16383.75 FORMAT "%8.2" DEPOSIT ABSOLUTE /end AXIS_DESCR
/end CHARACTERISTIC
/begin CHARACTERISTIC KLFWST "Faktor Wiederholstart" CURVE 0xFC6C30 KlAUwSstUwWUw 0.9999847 fak_uw_b1 0.00 0.9999847 FORMAT "%9.7"
 /begin AXIS_DESCR STD_AXIS tabst_w t1sxs_uw_q1 8 0.00 65535.00 FORMAT "%8.2" DEPOSIT ABSOLUTE /end AXIS_DESCR
/end CHARACTERISTIC
/begin CHARACTERISTIC KLHUBEXINV "Kennlinie Exzenterwinkel -> Hubverstellung" CURVE 0xFC414A KlAxU8SstxU16WU16 65.53500 hub_uw_q0p001 0.00 65.53500 FORMAT "%8.5"
 /begin AXIS_DESCR STD_AXIS wnkbegr wink_uw_q0p1 12 0.00 6553.500 FORMAT "%8.3" DEPOSIT ABSOLUTE /end AXIS_DESCR
/end CHARACTERISTIC
/begin CHARACTERISTIC KLIREGTMOT "Initialisierung I-Regler (tmot)" CURVE 0xFCD7C4 KlAUwSstUwWUw 199.997 vnstv_q0p00305s32768 -100.000 99.9969
 /begin AXIS_DESCR STD_AXIS tmot temp_ub_q0p75_o48 8 -48.00 143.3 FORMAT "%5.1" DEPOSIT ABSOLUTE /end AXIS_DESCR
/end CHARACTERISTIC
/begin CHARACTERISTIC KLRANWI "Kennlinie Regler I-Anteil Auslasspreizung variable NWS" CURVE 0xFCD7E6 KlAUwSstUwWUw 199.997 vnstv_q0p00305s32768 -100.000 99.9969
 /begin AXIS_DESCR STD_AXIS Vsadwnwkl sprzi_q0p1s32768 16 -3276.80 3276.70 FORMAT "%7.2" DEPOSIT ABSOLUTE /end AXIS_DESCR
/end CHARACTERISTIC
/begin CHARACTERISTIC KLRANWP "Kennlinie Regler P-Anteil Auslasspreizung variable NWS" CURVE 0xFCD828 KlAUwSstUwWUw 199.997 vnstv_q0p00305s32768 -100.000 99.9969
 /begin AXIS_DESCR STD_AXIS Vsadwnwkl sprzi_q0p1s32768 16 -3276.80 3276.70 FORMAT "%7.2" DEPOSIT ABSOLUTE /end AXIS_DESCR
/end CHARACTERISTIC
/begin CHARACTERISTIC KLRENWI "Kennlinie Regler I-Anteil Einlasspreizung variable NWS" CURVE 0xFCD86A KlAUwSstUwWUw 199.997 vnstv_q0p00305s32768 -100.000 99.9969
 /begin AXIS_DESCR STD_AXIS Vsedwnwkl sprzi_q0p1s32768 16 -3276.80 3276.70 FORMAT "%7.2" DEPOSIT ABSOLUTE /end AXIS_DESCR
/end CHARACTERISTIC
/begin CHARACTERISTIC KLRENWP "Kennlinie Regler P-Anteil Einlasspreizung variable NWS" CURVE 0xFCD8AC KlAUwSstUwWUw 199.997 vnstv_q0p00305s32768 -100.000 99.9969
 /begin AXIS_DESCR STD_AXIS Vsedwnwkl sprzi_q0p1s32768 16 -3276.80 3276.70 FORMAT "%7.2" DEPOSIT ABSOLUTE /end AXIS_DESCR
/end CHARACTERISTIC
/begin CHARACTERISTIC KLRTAMN "Schwellwert f¸r die Erkennung auf Kurzschluﬂ nach Ubatt" CURVE 0xFCD8EE KlAxU8SstxU8WU16 1.000000 rel_uw_q0p125 0.00 1.000000 FORMAT "%8.6"
 /begin AXIS_DESCR STD_AXIS ub spg_ubatt 8 0.00 19.41 FORMAT "%5.2" DEPOSIT ABSOLUTE /end AXIS_DESCR
/end CHARACTERISTIC
/begin CHARACTERISTIC KLTAMN "Schwellwert f¸r die Erkennung auf Kurzschluﬂ nach Ubatt" CURVE 0xFCD908 KlAxU8SstxU8WU16 65.53500 txms_uw_q0p001 0.00 65.53500 FORMAT "%8.5"
 /begin AXIS_DESCR STD_AXIS ub spg_ubatt 8 0.00 19.41 FORMAT "%5.2" DEPOSIT ABSOLUTE /end AXIS_DESCR
/end CHARACTERISTIC
/begin CHARACTERISTIC KLTAMX "Schwellwert f¸r die Erkennung auf Kurzschluﬂ nach Ubatt" CURVE 0xFCD922 KlAxU8SstxU8WU16 65.53500 txms_uw_q0p001 0.00 65.53500 FORMAT "%8.5"
 /begin AXIS_DESCR STD_AXIS ub spg_ubatt 8 0.00 19.41 FORMAT "%5.2" DEPOSIT ABSOLUTE /end AXIS_DESCR
/end CHARACTERISTIC
/begin CHARACTERISTIC KLVATANS "" CURVE 0xFD1DC3 KlAUbSstUbWUb 1.992 fak_ub_b2 0.00 1.992 FORMAT "%5.3"
 /begin AXIS_DESCR STD_AXIS tans temp_ub_q0p75_o48 5 -48.00 143.3 FORMAT "%5.1" DEPOSIT ABSOLUTE /end AXIS_DESCR
/end CHARACTERISTIC
/begin CHARACTERISTIC KLVATANSDK "" CURVE 0xFD1F4F KlAUbSstUbWUb 1.992 fak_ub_b2 0.00 1.992 FORMAT "%5.3"
 /begin AXIS_DESCR STD_AXIS tans temp_ub_q0p75_o48 5 -48.00 143.3 FORMAT "%5.1" DEPOSIT ABSOLUTE /end AXIS_DESCR
/end CHARACTERISTIC
/begin CHARACTERISTIC KLVNSTMOT "Korrekturkennlinie P-Anteil (tmot)" CURVE 0xFCD7AA KlAUbSstUbWUb 1.992 fak_ub_b2 0.00 1.992 FORMAT "%5.3"
 /begin AXIS_DESCR STD_AXIS tmot temp_ub_q0p75_o48 6 -48.00 143.3 FORMAT "%5.1" DEPOSIT ABSOLUTE /end AXIS_DESCR
/end CHARACTERISTIC
/begin CHARACTERISTIC KLVNSTVUB "Kennlinie ub-Abh‰ngigkeit Tastverh‰ltnis variable NWS" CURVE 0xFCD7B7 KlAUbSstUbWUb 1.992 fak_ub_b2 0.00 1.992 FORMAT "%5.3"
 /begin AXIS_DESCR STD_AXIS ub spg_ubatt 6 0.00 24.02 FORMAT "%5.2" DEPOSIT ABSOLUTE /end AXIS_DESCR
/end CHARACTERISTIC
/begin CHARACTERISTIC LURVVTSTAP "" VALUE 0xFC41A9 KwWU8 255.0 DEZ 0.00 255.0 FORMAT "%5.1" /end CHARACTERISTIC
/begin CHARACTERISTIC MRFAVW "Schwelle zur Umschaltung des Vorlagerungswinkels bei max. Fahrerwunsches" CURVE 0xFC7258 GklWU16 199.9969 rel_uw_b200 0.00 199.9969 FORMAT "%8.4"
 /begin AXIS_DESCR COM_AXIS nmot nmot_ub_q40 8 0.00 10200. FORMAT "%5.0" AXIS_PTS_REF SNM08GKUB /end AXIS_DESCR
/end CHARACTERISTIC
/begin CHARACTERISTIC MXCFCEOSD "Maximal Anzahl Leckdiagnosen: Check-Filler-Cap bei Fahrt" VALUE 0xFD48C6 KwWU8 255.0 dez 0.00 255.0 FORMAT "%5.1" /end CHARACTERISTIC
/begin CHARACTERISTIC MXCFCNL "Maximal Anzahl Leckdiagnosen: Check-Filler-Cap im Nachlauf" VALUE 0xFD48C7 KwWU8 255.0 dez 0.00 255.0 FORMAT "%5.1" /end CHARACTERISTIC
/begin CHARACTERISTIC MXDMTLLHV "Maximal Anzahl Leckdiagnosen: Heilungs- und Verifizierungspr¸fungen" VALUE 0xFD48C8 KwWU8 255.0 dez 0.00 255.0 FORMAT "%5.1" /end CHARACTERISTIC
/begin CHARACTERISTIC MXFADMET "Maximal Anzahl Leckdiagnosen: Endstufentests" VALUE 0xFD48C9 KwWU8 255.0 dez 0.00 255.0 FORMAT "%5.1" /end CHARACTERISTIC
/begin CHARACTERISTIC MXFADMTG "Maximal Anzahl Leckdiagnosen: Funktionsanforderung Grobleck (1.0mmm)" VALUE 0xFD48CA KwWU8 255.0 dez 0.00 255.0 FORMAT "%5.1" /end CHARACTERISTIC
/begin CHARACTERISTIC MXFADMTL "Maximal Anzahl Leckdiagnosen: Funktionsanforderung Feinleck (0.5mm)" VALUE 0xFD48CB KwWU8 255.0 dez 0.00 255.0 FORMAT "%5.1" /end CHARACTERISTIC
/begin CHARACTERISTIC MXFLEOBD "Maximal Anzahl Leckdiagnosen: Feinleckpr¸fung (0.5mm)" VALUE 0xFD48CC KwWU8 255.0 dez 0.00 255.0 FORMAT "%5.1" /end CHARACTERISTIC
/begin CHARACTERISTIC MXFOPR "Maximal Anzahl Leckdiagnosen: Erstaktivierung des Ventils" VALUE 0xFD48CD KwWU8 255.0 dez 0.00 255.0 FORMAT "%5.1" /end CHARACTERISTIC
/begin CHARACTERISTIC MXGLEOBD "Maximal Anzahl Leckdiagnosen: Grobleckpr¸fung 1.0mm" VALUE 0xFD48CE KwWU8 255.0 dez 0.00 255.0 FORMAT "%5.1" /end CHARACTERISTIC
/begin CHARACTERISTIC MXPRSEN "Maximal Anzahl Leckdiagnosen: Diagnose als Drucksensor" VALUE 0xFD48CF KwWU8 255.0 dez 0.00 255.0 FORMAT "%5.1" /end CHARACTERISTIC
/begin CHARACTERISTIC NDV "Fehlererkennung Tachosignal / Drehzahlschwelle minimal" VALUE 0xFD050E KwUb 10200. nmot_ub_q40 0.00 10200. FORMAT "%5.0" /end CHARACTERISTIC
/begin CHARACTERISTIC NDVO "Fehlererkennung Fz-Geschwindigkeitssignal, obere Drehzahlgrenze" VALUE 0xFD050F KwUb 10200. nmot_ub_q40 0.00 10200. FORMAT "%5.0" /end CHARACTERISTIC
/begin CHARACTERISTIC NGLACTMX "Anzahl Grobleckdiagnosen nach denen Feinleckdiagnose erfolgt" VALUE 0xFD48D0 KwWU8 255.0 dez 0.00 255.0 FORMAT "%5.1" /end CHARACTERISTIC
/begin CHARACTERISTIC NGLTDA "max. Anzahl abgebrochener check filler cap Pr¸fungen" VALUE 0xFD48D1 KwWU8 255.0 dez 0.00 255.0 FORMAT "%5.1" /end CHARACTERISTIC
/begin CHARACTERISTIC NGLTDW "max. Anzahl check filler cap Pr¸fungen" VALUE 0xFD48D2 KwWU8 255.0 dez 0.00 255.0 FORMAT "%5.1" /end CHARACTERISTIC
/begin CHARACTERISTIC NKLDIPFMX "Limit Abbruch Feinleckmessung infolge Stromschwankungen" VALUE 0xFD48D3 KwWU8 255.0 dez 0.00 255.0 FORMAT "%5.1" /end CHARACTERISTIC
/begin CHARACTERISTIC NMN_BDE "Drehzahl-Schwelle f¸rs Setzen der Zyklusflags BDEbedingt in der ‹ko-Diagnosis" VALUE 0xFC0BBD KwUb 10200. nmot_ub_q40 0.00 10200. FORMAT "%5.0" /end CHARACTERISTIC
/begin CHARACTERISTIC NMN_DUF "Drehzahl-Schwelle f¸rs Setzen der Zyklusflags der Funktions¸berwachungs-Diagnose" VALUE 0xFC0BBE KwUb 10200. nmot_ub_q40 0.00 10200. FORMAT "%5.0" /end CHARACTERISTIC
/begin CHARACTERISTIC NMOTVNSAD "Drehrahl unterhalb der die Adaption verboten ist" VALUE 0xFD523A KwUb 10200. nmot_ub_q40 0.00 10200. FORMAT "%5.0" /end CHARACTERISTIC
/begin CHARACTERISTIC NMXTHS "Maximale Motordrehzahl f¸r DTHS" VALUE 0xFD54A9 KwWU8 10200. nmot_ub_q40 0.00 10200. FORMAT "%5.0" /end CHARACTERISTIC
/begin CHARACTERISTIC NOTAERR_DZKU_IMPL "" VALUE 0xFCD954 KwWU8 255.0 dez 0.00 255.0 FORMAT "%5.1" READ_ONLY /end CHARACTERISTIC
/begin CHARACTERISTIC NSTATDTEVN "NSTAT-SCHWELLE f¸r Umschaltung der Diagnoseschwellen" VALUE 0xFCCA21 KwUb 2550. nmot_ub_q10 0.00 2550. FORMAT "%5.0" /end CHARACTERISTIC
/begin CHARACTERISTIC NSTEDMX "Maximale Solldrehzahl-Schwelle f¸r Tankentl¸ftungsdiagnose" VALUE 0xFCCA22 KwUb 2550. nmot_ub_q10 0.00 2550. FORMAT "%5.0" /end CHARACTERISTIC
/begin CHARACTERISTIC NW_MIN "Minimale Nockenwellenposition Rohwert" VAL_BLK 0xFCD79A KwbUw 6553.500 sprzi_q0p1 0.00 6553.500 FORMAT "%8.3" NUMBER 4 /end CHARACTERISTIC
/begin CHARACTERISTIC NZDIAGH "Diagnose Zuendung: obere Drehzahlschwelle der Diagnosefreigabe" VALUE 0xFCD940 KwWU16 16383.75 nmot_uw_q0p25 0.00 16383.75 FORMAT "%8.2" /end CHARACTERISTIC
/begin CHARACTERISTIC NZDIAGL "Diagnose Zuendung: untere Drehzahlschwelle der Diagnosefreigabe" VALUE 0xFCD942 KwWU16 16383.75 nmot_uw_q0p25 0.00 16383.75 FORMAT "%8.2" /end CHARACTERISTIC
/begin CHARACTERISTIC PRCFCEOSD "Priorit‰t f¸r Check-Filler-Cap bei Fahrt" VALUE 0xFD48D4 KwWU8 255.0 dez 0.00 255.0 FORMAT "%5.1" /end CHARACTERISTIC
/begin CHARACTERISTIC PRCFCNL "Priorit‰t f¸r Check-Filler-Cap im Nachlauf" VALUE 0xFD48D5 KwWU8 255.0 dez 0.00 255.0 FORMAT "%5.1" /end CHARACTERISTIC
/begin CHARACTERISTIC PRDMTLCW "Priorit‰t f¸r Leckdiagnose bei Start ¸ber Applikationscodewort" VALUE 0xFD48D6 KwWU8 255.0 dez 0.00 255.0 FORMAT "%5.1" /end CHARACTERISTIC
/begin CHARACTERISTIC PRDMTLLHV "Priorit‰t f¸r Leck-Heilungs- und Verifizierungspr¸fung" VALUE 0xFD48D7 KwWU8 255.0 dez 0.00 255.0 FORMAT "%5.1" /end CHARACTERISTIC
/begin CHARACTERISTIC PRFADMET "Priorit‰t f¸r Endstufentest" VALUE 0xFD48D8 KwWU8 255.0 dez 0.00 255.0 FORMAT "%5.1" /end CHARACTERISTIC
/begin CHARACTERISTIC PRFADMTG "Priorit‰t f¸r Funktionsanforderung 1.0mm-Test" VALUE 0xFD48D9 KwWU8 255.0 dez 0.00 255.0 FORMAT "%5.1" /end CHARACTERISTIC
/begin CHARACTERISTIC PRFADMTL "Priorit‰t f¸r Funktionsanforderung 0.5mm-Test" VALUE 0xFD48DA KwWU8 255.0 dez 0.00 255.0 FORMAT "%5.1" /end CHARACTERISTIC
/begin CHARACTERISTIC PRFLEOBD "Priorit‰t f¸r 0.5mm-Test" VALUE 0xFD48DB KwWU8 255.0 dez 0.00 255.0 FORMAT "%5.1" /end CHARACTERISTIC
/begin CHARACTERISTIC PRFOPR "Priorit‰t f¸r Erstaktivierung" VALUE 0xFD48DC KwWU8 255.0 dez 0.00 255.0 FORMAT "%5.1" /end CHARACTERISTIC
/begin CHARACTERISTIC PRGLEOBD "Priorit‰t f¸r Grobleckpr¸fung 1.0mm-Test" VALUE 0xFD48DD KwWU8 255.0 dez 0.00 255.0 FORMAT "%5.1" /end CHARACTERISTIC
/begin CHARACTERISTIC PRPRSEN "Priorit‰t f¸r Pr¸fung als Drucksensor" VALUE 0xFD48DE KwWU8 255.0 dez 0.00 255.0 FORMAT "%5.1" /end CHARACTERISTIC
/begin CHARACTERISTIC RKAKDKEMN "Minimale zus‰tzliche Kraftstoffmenge bei ESAK DK" VALUE 0xFC71CA KwSw 3071.953 rel_sw_b1536 -1536.000 1535.953 FORMAT "%8.3" /end CHARACTERISTIC
/begin CHARACTERISTIC RKAKDKEMX "Maximale zus‰tzliche Kraftstoffmenge bei ESAK DK" VALUE 0xFC71CC KwSw 3071.953 rel_sw_b1536 -1536.000 1535.953 FORMAT "%8.3" /end CHARACTERISTIC
/begin CHARACTERISTIC RKAKDKGMN "Minimaler Kurzzeitspeicher ESAK DK" VALUE 0xFC71CE KwSw 3071.953 rel_sw_b1536 -1536.000 1535.953 FORMAT "%8.3" /end CHARACTERISTIC
/begin CHARACTERISTIC RKAKDKGMX "Maximaler Kurzzeitspeicher ESAK DK" VALUE 0xFC71D0 KwSw 3071.953 rel_sw_b1536 -1536.000 1535.953 FORMAT "%8.3" /end CHARACTERISTIC
/begin CHARACTERISTIC RKAKVTEMN "Minimale zus‰tzliche Kraftstoffmenge bei ESAK VVT" VALUE 0xFC6F0A KwSw 3071.953 rel_sw_b1536 -1536.000 1535.953 FORMAT "%8.3" /end CHARACTERISTIC
/begin CHARACTERISTIC RKAKVTEMX "Maximale zus‰tzliche Kraftstoffmenge bei ESAK VVT" VALUE 0xFC6F0C KwSw 3071.953 rel_sw_b1536 -1536.000 1535.953 FORMAT "%8.3" /end CHARACTERISTIC
/begin CHARACTERISTIC RKAKVTGMN "Minimaler Kurzzeitspeicher ESAK VVT" VALUE 0xFC6F0E KwSw 3071.953 rel_sw_b1536 -1536.000 1535.953 FORMAT "%8.3" /end CHARACTERISTIC
/begin CHARACTERISTIC RKAKVTGMX "Maximaler Kurzzeitspeicher ESAK VVT" VALUE 0xFC6F10 KwSw 3071.953 rel_sw_b1536 -1536.000 1535.953 FORMAT "%8.3" /end CHARACTERISTIC
/begin CHARACTERISTIC RKBAUM "rk-Schwelle f¸r BA-Anzeige" CURVE 0xFD1DE0 GklWSw 6143.813 rel_sw_q0p1875 0.00 6143.813 FORMAT "%8.3"
 /begin AXIS_DESCR COM_AXIS tmot temp_ub_q0p75_o48 9 -48.00 143.3 FORMAT "%5.1" AXIS_PTS_REF STM09ESUB /end AXIS_DESCR
/end CHARACTERISTIC
/begin CHARACTERISTIC RKBAUMDK "rk-Schwelle f¸r BA-Anzeige gedrosselt" CURVE 0xFD1DF2 GklWSw 6143.813 rel_sw_q0p1875 0.00 6143.813 FORMAT "%8.3"
 /begin AXIS_DESCR COM_AXIS tmot temp_ub_q0p75_o48 9 -48.00 143.3 FORMAT "%5.1" AXIS_PTS_REF STM09ESUB /end AXIS_DESCR
/end CHARACTERISTIC
/begin CHARACTERISTIC RKUKKLU "Schwelle Summe Kurz-/Langzeitanteil" VALUE 0xFC6F12 KwSw 12287.81 rel_sw_q0p1875 -6144.000 6143.813 FORMAT "%8.3" /end CHARACTERISTIC
/begin CHARACTERISTIC RKUKKLUDK "Schwelle Summe Kurz-/Langzeitanteil" VALUE 0xFC71D2 KwSw 12287.81 rel_sw_q0p1875 -6144.000 6143.813 FORMAT "%8.3" /end CHARACTERISTIC
/begin CHARACTERISTIC RKVAUM "rk-Schwelle f¸r VA-Anzeige" CURVE 0xFD1E04 GklWSw 6144.000 rel_sw_q0p1875 -6144.000 0.00 FORMAT "%8.3"
 /begin AXIS_DESCR COM_AXIS tmot temp_ub_q0p75_o48 9 -48.00 143.3 FORMAT "%5.1" AXIS_PTS_REF STM09ESUB /end AXIS_DESCR
/end CHARACTERISTIC
/begin CHARACTERISTIC RKVAUMDK "rk-Schwelle f¸r VA-Anzeige gedrosselt" CURVE 0xFD1E16 GklWSw 6144.000 rel_sw_q0p1875 -6144.000 0.00 FORMAT "%8.3"
 /begin AXIS_DESCR COM_AXIS tmot temp_ub_q0p75_o48 9 -48.00 143.3 FORMAT "%5.1" AXIS_PTS_REF STM09ESUB /end AXIS_DESCR
/end CHARACTERISTIC
/begin CHARACTERISTIC RLTEDMX "Maximale rl-Schwelle f¸r Tankentl¸ftungsdiagnose" VALUE 0xFCCA23 KwUb 191.3 rel_ub_q0p75 0.00 191.3 FORMAT "%5.1" /end CHARACTERISTIC
/begin AXIS_PTS SAN12ESUW "SST-Verteilung f¸r den begrenzten Einspritzz‰hler anztib_w" 0xFC144C anztib_w SstAUwSstUw 65535.00 dez 12 0.00 65535.00 FORMAT "%8.2" DEPOSIT ABSOLUTE /end AXIS_PTS
/begin CHARACTERISTIC SFTEDA "Beladungsschwelle f¸r Verbot TE-Diagnose" VALUE 0xFD48DF KwWS8 127.5 fak_sb_b64 -64.00 63.50 FORMAT "%5.2" /end CHARACTERISTIC
/begin AXIS_PTS SKS06ESUB "SST-Verteilung f¸r den Startadaptionsfaktor kstaa" 0xFC1378 kstaa SstAUbSstUb 1.992 fak_ub_b2 6 0.00 1.992 FORMAT "%5.3" DEPOSIT ABSOLUTE /end AXIS_PTS
/begin AXIS_PTS SNM07ESUB "St¸tzstellenverteilung Drehzahl, 7 Sst." 0xFCF820 nmot SstAUbSstUb 10200. nmot_ub_q40 7 0.00 10200. FORMAT "%5.0" DEPOSIT ABSOLUTE /end AXIS_PTS
/begin AXIS_PTS SNM08GKUB "St¸tzstellenverteilung Gemischkontrolle 8 nmot St¸tzstellen" 0xFC135D nmot SstAU8SstU8 10200. nmot_ub_q40 8 0.00 10200. FORMAT "%5.0" DEPOSIT ABSOLUTE /end AXIS_PTS
/begin CHARACTERISTIC SPRZG_AN "Position der Anschlagspreizung variable NWS" VAL_BLK 0xFCD7A2 KwbUw 6553.500 sprzi_q0p1 0.00 6553.500 FORMAT "%8.3" NUMBER 4 /end CHARACTERISTIC
/begin AXIS_PTS SRL08GKUB "St¸tzstellenverteilung Gemischkontrolle 8 rl St¸tzstellen" 0xFC1366 rl SstAU8SstU8 191.3 rel_ub_q0p75 8 0.00 191.3 FORMAT "%5.1" DEPOSIT ABSOLUTE /end AXIS_PTS
/begin AXIS_PTS STA06ESUB "SST-Verteilung f¸r die Ansauglufttemperatur" 0xFCF867 tans SstAUbSstUb 191.3 temp_ub_q0p75_o48 6 -48.00 143.3 FORMAT "%5.1" DEPOSIT ABSOLUTE /end AXIS_PTS
/begin AXIS_PTS STM09ESUB "St¸tzstellenverteilung Motortemperatur, 9 Sst." 0xFCF892 tmot SstAUbSstUb 191.3 temp_ub_q0p75_o48 9 -48.00 143.3 FORMAT "%5.1" DEPOSIT ABSOLUTE /end AXIS_PTS
/begin AXIS_PTS STS12ESUB "SST-Verteilung f¸r Motorstarttemperatur" 0xFC143E tmst SstAUbSstUb 191.3 temp_ub_q0p75_o48 12 -48.00 143.3 FORMAT "%5.1" DEPOSIT ABSOLUTE /end AXIS_PTS
/begin CHARACTERISTIC SULSULUFT "Schwellwert f¸r Plausibilit‰tsfehler LSU an Luft" VALUE 0xFD03F8 KwUw 31.99951 spg_q4p88Em4 0.00 31.99951 FORMAT "%8.5" /end CHARACTERISTIC
/begin CHARACTERISTIC SULSULUFTL "Schwellwert f¸r Plausibilit‰tsfehler LSU an Luft, bei kleiner Verst‰rkung" VALUE 0xFD03FA KwUw 31.99951 spg_q4p88Em4 0.00 31.99951 FORMAT "%8.5" /end CHARACTERISTIC
/begin CHARACTERISTIC SULSUMX "Schwellwert f¸r Plausibilit‰tsfehler CJ110" VALUE 0xFD03FC KwUw 31.99951 spg_q4p88Em4 0.00 31.99951 FORMAT "%8.5" /end CHARACTERISTIC
/begin CHARACTERISTIC SULSUMXL "Schwellwert f¸r Plausibilit‰tsfehler CJ110, bei kleiner Verst‰rkung" VALUE 0xFD03FE KwUw 31.99951 spg_q4p88Em4 0.00 31.99951 FORMAT "%8.5" /end CHARACTERISTIC
/begin CHARACTERISTIC SZANSSM "Absteuerungsfaktorumschaltschwelle f¸r Nachstartfaktor" CURVE 0xFD1C47 GklWUb 0.9961 fak_ub_b1 0.00 0.9961
 /begin AXIS_DESCR COM_AXIS tmst temp_ub_q0p75_o48 12 -48.00 143.3 FORMAT "%5.1" AXIS_PTS_REF STS12ESUB /end AXIS_DESCR
/end CHARACTERISTIC
/begin CHARACTERISTIC SZANSSMVT "Absteuerungsfaktorumschaltschwelle f¸r Nachstartfaktor VVT-Betrieb" CURVE 0xFD1C53 GklWUb 0.9961 fak_ub_b1 0.00 0.9961
 /begin AXIS_DESCR COM_AXIS tmst temp_ub_q0p75_o48 12 -48.00 143.3 FORMAT "%5.1" AXIS_PTS_REF STS12ESUB /end AXIS_DESCR
/end CHARACTERISTIC
/begin CHARACTERISTIC TAINI "Initialisierungswert der 2A-Zeit" VALUE 0xFCD944 KwWU16 65.53500 txms_uw_q0p001 0.00 65.53500 FORMAT "%8.5" /end CHARACTERISTIC
/begin CHARACTERISTIC TANDT "Schwelle Temperaturdifferenz Ansaugluft f¸r Heiﬂstart" CURVE 0xFC6BCA KlAUbSstUbWUb 191.3 temp_ub_b191p25 0.00 191.3 FORMAT "%5.1"
 /begin AXIS_DESCR STD_AXIS tansab temp_ub_q0p75_o48 4 -48.00 143.3 FORMAT "%5.1" DEPOSIT ABSOLUTE /end AXIS_DESCR
/end CHARACTERISTIC
/begin CHARACTERISTIC TBTEVIO "Verzˆgerungszeit f¸r Beladungpr¸fung TEV i.O. Erkennung" VALUE 0xFD486F KwUb 25.50 t100msxs_ub_b25p5 0.00 25.50 FORMAT "%5.2" /end CHARACTERISTIC
/begin CHARACTERISTIC TDTEV "max. ÷ffnungszeit TEV bei Tevcheck" VALUE 0xFD4880 KwUw 6553.500 t100msxs_uw_b6553p5 0.00 6553.500 FORMAT "%8.3" /end CHARACTERISTIC
/begin CHARACTERISTIC TDTEVGD "max. ÷ffnungszeit TEV bei Tevcheck GD" VALUE 0xFD4882 KwUw 6553.500 t100msxs_uw_b6553p5 0.00 6553.500 FORMAT "%8.3" /end CHARACTERISTIC
/begin CHARACTERISTIC TDV "Fehlererkennung Tachosignal / Zeitdauer f¸r Abfrage" VALUE 0xFD0510 KwUb 12.75 t50msxs_ub_b12p75 0.00 12.75 FORMAT "%5.2" /end CHARACTERISTIC
/begin CHARACTERISTIC TDVAT "Fehlerentprellzeit Diganose angezeigte Fahrzeuggeschwindigkeit im Tacho" VALUE 0xFC226E KwWU8 25.50 t100msxs_ub_b25p5 0.00 25.50 FORMAT "%5.2" /end CHARACTERISTIC
/begin CHARACTERISTIC TDVATFB "Entprellzeit nach der die Diagnose weiterlaufen darf" VALUE 0xFC226F KwWU8 25.50 t100msxs_ub_b25p5 0.00 25.50 FORMAT "%5.2" /end CHARACTERISTIC
/begin CHARACTERISTIC TDVATH "Heilungstimer Diganose angezeigte Fahrzeuggeschwindigkeit im Tacho" VALUE 0xFC2270 KwWU8 25.50 t100msxs_ub_b25p5 0.00 25.50 FORMAT "%5.2" /end CHARACTERISTIC
/begin CHARACTERISTIC TDVERR "Entprellzeit fuer Fehlerstatus VVT SG" VALUE 0xFC41AA KwWU8 25.50 t100msxs_ub_b25p5 0.00 25.50 FORMAT "%5.2" /end CHARACTERISTIC
/begin CHARACTERISTIC TDVTEST "" VALUE 0xFC419A KwWU16 1310.700 t20msxs_uw_q0p02 0.00 1310.700 FORMAT "%8.3" /end CHARACTERISTIC
/begin CHARACTERISTIC TDVVTFIKO "" VALUE 0xFC419C KwWU16 1310.700 t20msxs_uw_q0p02 0.00 1310.700 FORMAT "%8.3" /end CHARACTERISTIC
/begin CHARACTERISTIC TDVVTNLCHK "" VALUE 0xFC41AB KwWU8 25.50 t100msxs_ub_b25p5 0.00 25.50 FORMAT "%5.2" /end CHARACTERISTIC
/begin CHARACTERISTIC TDVVTNLIO "Zeitdelay f¸r NL Check" VALUE 0xFC41AC KwWU8 25.50 t100msxs_ub_b25p5 0.00 25.50 FORMAT "%5.2" /end CHARACTERISTIC
/begin CHARACTERISTIC TDVVTPV "Entprellzeit f¸r ml-Check ueber DK-Winkel und Druck" VALUE 0xFC41AD KwWU8 25.50 t100msxs_ub_b25p5 0.00 25.50 FORMAT "%5.2" /end CHARACTERISTIC
/begin CHARACTERISTIC TEBLEIN "Temperaturschwelle f¸r E-Box L¸fter Ansteuerung" VALUE 0xFD54AE KwUb 191.3 temp_ub_q0p75_o48 -48.00 143.3 FORMAT "%5.1" /end CHARACTERISTIC
/begin CHARACTERISTIC TELSVVVT "Verzˆgerungszeit E-Box-L¸fteransteuerung durch VVT" VALUE 0xFD54AF KwUb 25.40 t100msxs_ub_b25p5 0.1000 25.50 FORMAT "%5.2" /end CHARACTERISTIC
/begin CHARACTERISTIC TKA_DELTA "Temperaturdifferenz f¸r Diagnosestart" VALUE 0xFD54AA KwWU8 191.3 temp_sb_q0p75 0.00 191.3 FORMAT "%5.1" /end CHARACTERISTIC
/begin CHARACTERISTIC TKDVVTGR "" VALUE 0xFC419E KwWU16 1310.700 t20msxs_uw_q0p02 0.00 1310.700 FORMAT "%8.3" /end CHARACTERISTIC
/begin CHARACTERISTIC TKDVVTKL "" VALUE 0xFC41A0 KwWU16 1310.700 t20msxs_uw_q0p02 0.00 1310.700 FORMAT "%8.3" /end CHARACTERISTIC
/begin CHARACTERISTIC TMDV "Motortemperaturschwelle f¸r Freigabe Fz-Geschwindigkeits-Diagnose" VALUE 0xFD0511 KwUb 191.3 temp_ub_q0p75_o48 -48.00 143.3 FORMAT "%5.1" /end CHARACTERISTIC
/begin CHARACTERISTIC TMH "Motortemperatur - Schwelle heiﬂ" VALUE 0xFC6BD3 KwUb 191.3 temp_ub_q0p75_o48 -48.00 143.3 FORMAT "%5.1" /end CHARACTERISTIC
/begin CHARACTERISTIC TMHSG "Motortemperatur Heiﬂstartgrenze" VALUE 0xFC6BD4 KwUb 191.3 temp_ub_q0p75_o48 -48.00 143.3 FORMAT "%5.1" /end CHARACTERISTIC
/begin CHARACTERISTIC TMOT_SOLL "Motorsolltemperatur f¸r Diagnose DTHS" VALUE 0xFD54AB KwWU8 191.3 temp_ub_q0p75_o48 -48.00 143.3 FORMAT "%5.1" /end CHARACTERISTIC
/begin CHARACTERISTIC TMSDMTLU "untere Startemperaturschwelle fuer DMTL" VALUE 0xFD48E0 KwWU8 191.3 temp_ub_q0p75_o48 -48.00 143.3 FORMAT "%5.1" /end CHARACTERISTIC
/begin CHARACTERISTIC TMSTCLST "Temperaturoffset f¸r Kaltstarterkennung" VALUE 0xFD48E1 KwWU8 191.3 temp_ub_q0p75 0.00 191.3 FORMAT "%5.1" /end CHARACTERISTIC
/begin CHARACTERISTIC TMTED "Tmot-Schwelle f¸r Tankentl¸ftungsdiagnose" VALUE 0xFD4870 KwUb 191.3 temp_ub_q0p75_o48 -48.00 143.3 FORMAT "%5.1" /end CHARACTERISTIC
/begin CHARACTERISTIC TMWUC "Motortemperaturschwelle f¸r Erf¸llung 'warm up cycle'" VALUE 0xFC14B8 KwUb 191.3 temp_ub_q0p75_o48 -48.00 143.3 FORMAT "%5.1" /end CHARACTERISTIC
/begin CHARACTERISTIC TMWUCST "max. Motortemperatur im Start f¸r Erf¸llung 'warm up cycle'" VALUE 0xFC14B9 KwUb 191.3 temp_ub_q0p75_o48 -48.00 143.3 FORMAT "%5.1" /end CHARACTERISTIC
/begin CHARACTERISTIC TNLDTE "Nachlaufverzˆgerungszeit f¸r Tankleckdiagnose" VALUE 0xFD48E2 KwWU8 25.50 t_q0p1 0.00 25.50 FORMAT "%5.2" /end CHARACTERISTIC
/begin CHARACTERISTIC TNODTEV "Zeit nach Motorstart f¸r Verbot DTEV" VALUE 0xFD4876 KwUw 6553.500 t100msxs_uw_b6553p5 0.00 6553.500 FORMAT "%8.3" /end CHARACTERISTIC
/begin CHARACTERISTIC TNODTEVT "Zeit f¸r Verbot DTEV bei Testerbetrieb" VALUE 0xFD4878 KwUw 6553.500 t100msxs_uw_b6553p5 0.00 6553.500 FORMAT "%8.3" /end CHARACTERISTIC
/begin CHARACTERISTIC TNODVATNS "Zeit nach Start in der die Diagnose VAT gesperrt ist" VALUE 0xFC226C KwWU16 655.3500 t10msxs_uw_b655p35 0.00 655.3500 FORMAT "%8.4" /end CHARACTERISTIC
/begin CHARACTERISTIC TNSTESMN "min Nachstartzeit f¸r Tankentl¸ftungsdiagnose" VALUE 0xFD48B4 KwWU16 6553.500 t_q0p1 0.00 6553.500 FORMAT "%8.3" /end CHARACTERISTIC
/begin CHARACTERISTIC TNSTLUUK "Zeit UK-Unterdr¸ckung im Nachstart bei Teillast" VALUE 0xFC6EA9 KwUb 25.50 t100msxs_ub_b25p5 0.00 25.50 FORMAT "%5.2" /end CHARACTERISTIC
/begin CHARACTERISTIC TNSUUK "Zeit UK-Unterdr¸ckung im Nachstart" VALUE 0xFC6EAA KwUb 25.50 t100msxs_ub_b25p5 0.00 25.50 FORMAT "%5.2" /end CHARACTERISTIC
/begin CHARACTERISTIC TREFDTEV "Zeit f¸r Referenzleckmessung f¸r Tevcheck" VALUE 0xFD4884 KwUw 6553.500 t100msxs_uw_b6553p5 0.00 6553.500 FORMAT "%8.3" /end CHARACTERISTIC
/begin CHARACTERISTIC TTEBL "Zeitdauer der Ansteuerung des E-Box L¸fters nach Start" VALUE 0xFD54B0 KwUb 25.40 t100msxs_ub_b25p5 0.1000 25.50 FORMAT "%5.2" /end CHARACTERISTIC
/begin CHARACTERISTIC TTEDAFS "Zeit Tankentl¸ftungsventil offen w‰hrend Diagnose mit FS" VALUE 0xFCCA32 KwUw 1310.700 t20msxs_uw_b1310 0.00 1310.700 FORMAT "%8.3" /end CHARACTERISTIC
/begin CHARACTERISTIC TTEDAOFS "Zeit Tankentl¸ftungsventil offen w‰hrend Diagnose ohne FS" VALUE 0xFCCA34 KwUw 1310.700 t20msxs_uw_b1310 0.00 1310.700 FORMAT "%8.3" /end CHARACTERISTIC
/begin CHARACTERISTIC TTEDBA "Zeitschwelle f¸r Beginn der TEV-Aufsteuerung bei Tankentl¸ftungsdiagnose" VALUE 0xFCCA36 KwUw 1310.700 t20msxs_uw_b1310 0.00 1310.700 FORMAT "%8.3" /end CHARACTERISTIC
/begin CHARACTERISTIC TTEDIVFS "Verzˆgerungszeit f¸r Drehzahlcheckbeginn mit FS" VALUE 0xFCCA38 KwUw 1310.700 t20msxs_uw_b1310 0.00 1310.700 FORMAT "%8.3" /end CHARACTERISTIC
/begin CHARACTERISTIC TTEDIVOFS "Verzˆgerungszeit f¸r Drehzahlcheck ohne FS" VALUE 0xFCCA3A KwUw 1310.700 t20msxs_uw_b1310 0.00 1310.700 FORMAT "%8.3" /end CHARACTERISTIC
/begin CHARACTERISTIC TTEDNFS "Drehzahl¸berwachungszeit bei Drehzahlcheck mit FS" VALUE 0xFCCA3C KwUw 1310.700 t20msxs_uw_b1310 0.00 1310.700 FORMAT "%8.3" /end CHARACTERISTIC
/begin CHARACTERISTIC TTEDNOFS "Drehzahl¸berwachungszeit bei Drehzahlcheck ohne FS" VALUE 0xFCCA3E KwUw 1310.700 t20msxs_uw_b1310 0.00 1310.700 FORMAT "%8.3" /end CHARACTERISTIC
/begin CHARACTERISTIC TTEDUBV "Zeitverzˆgerung f¸r Ubat-‹berwachung" VALUE 0xFD48E3 KwWU8 25.50 t_q0p1 0.00 25.50 FORMAT "%5.2" /end CHARACTERISTIC
/begin CHARACTERISTIC TTEVCHK "max. Zeit f¸r Tevcheck" VALUE 0xFD4886 KwUw 6553.500 t100msxs_uw_b6553p5 0.00 6553.500 FORMAT "%8.3" /end CHARACTERISTIC
/begin CHARACTERISTIC TUMGDMTLMN "Minimale Umgebungstemperatur f¸r Check-Filler-Cap bei Fahrt" VALUE 0xFD48E4 KwWU8 191.3 temp_ub_q0p75_o48 -48.00 143.3 FORMAT "%5.1" /end CHARACTERISTIC
/begin CHARACTERISTIC TUMTESO "obere Umgebungstemp.-Schwelle f¸r TE-Diagnose" VALUE 0xFD48E5 KwWU8 191.3 temp_ub_q0p75_o48 -48.00 143.3 FORMAT "%5.1" /end CHARACTERISTIC
/begin CHARACTERISTIC TUMTESU "untere Umgebungstemp.-Schwelle f¸r TE-Diagnose" VALUE 0xFD48E6 KwWU8 191.3 temp_ub_q0p75_o48 -48.00 143.3 FORMAT "%5.1" /end CHARACTERISTIC
/begin CHARACTERISTIC TVERZTEV "Verzˆgerungszeit nach Referenzleckmessung" VALUE 0xFD4888 KwUw 6553.500 t100msxs_uw_b6553p5 0.00 6553.500 FORMAT "%8.3" /end CHARACTERISTIC
/begin CHARACTERISTIC TVLSULUFT "Verzˆgerungszeit f¸r Fehler LSU in Luft" VALUE 0xFD03F6 KwUb 25.50 t_q0p1 0.00 25.50 FORMAT "%5.2" /end CHARACTERISTIC
/begin CHARACTERISTIC TVTKLSU "Verzˆgerungszeit beim Eintragen eines Fehlers aufgrund eines leeren Tanks" VALUE 0xFD0400 KwUw 6553.500 t_q0p1 0.00 6553.500 FORMAT "%8.3" /end CHARACTERISTIC
/begin CHARACTERISTIC TVVTOVRL "" VALUE 0xFC41A2 KwWU16 6553.500 t100msxs_uw_b6553p5 0.00 6553.500 FORMAT "%8.3" /end CHARACTERISTIC
/begin CHARACTERISTIC TVVTPMN "Entprellzeit bis Aktivierung Leistungsfehler" VALUE 0xFC41AE KwWU8 25.50 t100msxs_ub_b25p5 0.00 25.50 FORMAT "%5.2" /end CHARACTERISTIC
/begin CHARACTERISTIC TVVTTVON "Entprellzeit bis Aktivierung Tastverhaeltnisausgabe" VALUE 0xFC41AF KwWU8 25.50 t100msxs_ub_b25p5 0.00 25.50 FORMAT "%5.2" /end CHARACTERISTIC
/begin CHARACTERISTIC TWKODTE "Wartezeit nach Kompressor schalten f¸r DTEVN" VALUE 0xFD4871 KwUb 25.50 t100msxs_ub_b25p5 0.00 25.50 FORMAT "%5.2" /end CHARACTERISTIC
/begin CHARACTERISTIC TWTESNL "Nachlauf-Wartezeit bis Beginn Tankentlueftungsdiagnose" VALUE 0xFD48E7 KwWU8 25.50 t_q0p1 0.00 25.50 FORMAT "%5.2" /end CHARACTERISTIC
/begin CHARACTERISTIC TXDMTSMX "Maximalzeit f¸r eine Tankleckdiagnose" VALUE 0xFD48B6 KwWU16 6553.500 t_q0p1 0.00 6553.500 FORMAT "%8.3" /end CHARACTERISTIC
/begin CHARACTERISTIC T_SA_MAX "Maximale Schubdauer f¸r DTHS" VALUE 0xFD54AC KwWU8 255.0 t1sxs_ub_q1 0.00 255.0 FORMAT "%5.1" /end CHARACTERISTIC
/begin CHARACTERISTIC UBDCFCO "obere Batteriespannungsschwelle f¸r Check-Filler-Cap bei Fahrt" VALUE 0xFD48B8 KwWU16 25.59961 spg_q0p00039 0.00 25.59961 FORMAT "%8.5" /end CHARACTERISTIC
/begin CHARACTERISTIC UBDCFCU "untere Batteriespannungsschwelle f¸r Check-Filler-Cap bei Fahrt" VALUE 0xFD48BA KwWU16 25.59961 spg_q0p00039 0.00 25.59961 FORMAT "%8.5" /end CHARACTERISTIC
/begin CHARACTERISTIC UBDZMN "Mindestschwelle f¸r die Berechnung der DZKU" VALUE 0xFCD955 KwWU8 19.41 spg_ubatt 0.00 19.41 FORMAT "%5.2" /end CHARACTERISTIC
/begin CHARACTERISTIC UBDZMX "Maximalschwelle f¸r die Berechnung der DZKU" VALUE 0xFCD956 KwWU8 19.41 spg_ubatt 0.00 19.41 FORMAT "%5.2" /end CHARACTERISTIC
/begin CHARACTERISTIC UBTEDFAO "obere UB-Schwelle f¸r Tankentl¸ftungsdiagnose bei Funktionsanf.  ¸ber Tester" VALUE 0xFD48BC KwWU16 25.59961 spg_q0p00039 0.00 25.59961 FORMAT "%8.5" /end CHARACTERISTIC
/begin CHARACTERISTIC UBTEDFAU "untere UB-Schwelle f¸r Tankentl¸ftungsdiagnose bei Funktionsanf.  ¸ber Tester" VALUE 0xFD48BE KwWU16 25.59961 spg_q0p00039 0.00 25.59961 FORMAT "%8.5" /end CHARACTERISTIC
/begin CHARACTERISTIC UBTEDO "obere UB-Schwelle f¸r Tankentl¸ftungsdiagnose" VALUE 0xFD48C0 KwWU16 25.59961 spg_q0p00039 0.00 25.59961 FORMAT "%8.5" /end CHARACTERISTIC
/begin CHARACTERISTIC UBTEDU "untere UB-Schwelle f¸r Tankentl¸ftungsdiagnose" VALUE 0xFD48C2 KwWU16 25.59961 spg_q0p00039 0.00 25.59961 FORMAT "%8.5" /end CHARACTERISTIC
/begin CHARACTERISTIC VDMN "Geschwindigkeitsschwelle; Fehlererkennung Geschwindigkeitssignal" VALUE 0xFD0512 KwUw 511.9922 vfzg_uw_b512 0.00 511.9922 FORMAT "%8.4" /end CHARACTERISTIC
/begin CHARACTERISTIC VFZGDTEVP "Fahrzeuggeschwindigkeitsschwelle f¸r DTEVP" VALUE 0xFD488A KwUw 511.9922 vfzg_uw_b512 0.00 511.9922 FORMAT "%8.4" /end CHARACTERISTIC
/begin CHARACTERISTIC VNSKRITLOC "Fangbereich des Verriegelungspins" VALUE 0xFD523B KwUb 25.50 sprzi_q0p1 0.00 25.50 FORMAT "%5.2" /end CHARACTERISTIC
/begin CHARACTERISTIC VNSNMIN "Minimaldrehzahl zur Abstellerkennung" VALUE 0xFCCAD5 KwWU8 10200. nmot_ub_q40 0.00 10200. FORMAT "%5.0" /end CHARACTERISTIC
/begin CHARACTERISTIC VNSNMOTAN "Drehzahl unterhalb der die Einheiten Verriegeln koennen (Fliehkraefte zu klein)" VALUE 0xFD523C KwUb 10200. nmot_ub_q40 0.00 10200. FORMAT "%5.0" /end CHARACTERISTIC
/begin CHARACTERISTIC VNSRTVIMN "Reglerbegrenzung Tastverh‰ltnis I-Anteil min" VALUE 0xFD524A KwUw 199.997 vnstv_q0p00305s32768 -100.000 99.9969 /end CHARACTERISTIC
/begin CHARACTERISTIC VNSRTVIMX "Reglerbegrenzung Tastverh‰ltnis I-Anteil max" VALUE 0xFD524C KwUw 199.997 vnstv_q0p00305s32768 -100.000 99.9969 /end CHARACTERISTIC
/begin CHARACTERISTIC VNSRTVMN "Reglerbegrenzung Tastverh‰ltnis min" VALUE 0xFD524E KwSw 199.997 vnstv_q0p00305 -100.000 99.9969 FORMAT "%7.3" /end CHARACTERISTIC
/begin CHARACTERISTIC VNSRTVMX "Reglerbegrenzung Tastverh‰ltnis max" VALUE 0xFD5250 KwSw 199.997 vnstv_q0p00305 -100.000 99.9969 FORMAT "%7.3" /end CHARACTERISTIC
/begin CHARACTERISTIC VNSTVIABDY "Ablschlag vom I-Regleranteil fuer adapt. Druckvorsteuerung" VALUE 0xFD5252 KwUw 99.9969 vnstv_q0p00305s32768 0.00 99.9969 FORMAT "%7.4" /end CHARACTERISTIC
/begin CHARACTERISTIC VNS_ADEND "Zeit in der die Adaption abgeschlossen sein sollte (> VNS_ADT)" VALUE 0xFD5254 KwUw 655.3500 t100msxs_sb_q0p01 0.00 655.3500 FORMAT "%8.4" /end CHARACTERISTIC
/begin CHARACTERISTIC VNS_ADT "Adaptionszeit variable NWS" VALUE 0xFD5256 KwUw 655.3500 t100msxs_sb_q0p01 0.00 655.3500 FORMAT "%8.4" /end CHARACTERISTIC
/begin CHARACTERISTIC VNS_ANAB "Abstand vom Anschlag" VALUE 0xFD523D KwUb 25.50 sprzi_q0p1 0.00 25.50 FORMAT "%5.2" /end CHARACTERISTIC
/begin CHARACTERISTIC VNS_DYN "Aenderungsbegrenzung des TV (Druckanstiegsgeschwindigkeitsbegrenzung)" VALUE 0xFD5258 KwUw 655.350 vnstv_q0p01 0.00 655.350 FORMAT "%7.3" /end CHARACTERISTIC
/begin CHARACTERISTIC VVTOVLCAD "" VALUE 0xFC41A4 KwWU16 65535.00 DEZ 0.00 65535.00 FORMAT "%8.2" /end CHARACTERISTIC
/begin CHARACTERISTIC VVTOVLCMX "" VALUE 0xFC41A6 KwWU16 65535.00 DEZ 0.00 65535.00 FORMAT "%8.2" /end CHARACTERISTIC
/begin CHARACTERISTIC WEAN "Winkel Einspritzabbruch" CURVE 0xFC7268 GklWU8 765.0 kw_q3 0.00 765.0 FORMAT "%5.1"
 /begin AXIS_DESCR COM_AXIS nmot nmot_ub_q40 8 0.00 10200. FORMAT "%5.0" AXIS_PTS_REF SNM08GKUB /end AXIS_DESCR
/end CHARACTERISTIC
/begin CHARACTERISTIC WEEM "Vorlagerungswinkel - Korrektur" CURVE 0xFC7330 KlAxU8SstxU8WS8 765.0 kw_q3 -384.0 381.0 FORMAT "%5.1"
 /begin AXIS_DESCR STD_AXIS tmot temp_ub_q0p75_o48 8 -48.00 143.3 FORMAT "%5.1" DEPOSIT ABSOLUTE /end AXIS_DESCR
/end CHARACTERISTIC
/begin CHARACTERISTIC WEEMGD "Vorlagerungswinkel - Korrektur gedrosselt" CURVE 0xFC7341 KlAxU8SstxU8WS8 765.0 kw_q3 -384.0 381.0 FORMAT "%5.1"
 /begin AXIS_DESCR STD_AXIS tmot temp_ub_q0p75_o48 8 -48.00 143.3 FORMAT "%5.1" DEPOSIT ABSOLUTE /end AXIS_DESCR
/end CHARACTERISTIC
/begin CHARACTERISTIC WEEMRFAN "Winkel Einspritzende bei maximalem Fahrerwunsch" CURVE 0xFC7270 GklWU8 765.0 kw_q3 0.00 765.0 FORMAT "%5.1"
 /begin AXIS_DESCR COM_AXIS nmot nmot_ub_q40 8 0.00 10200. FORMAT "%5.0" AXIS_PTS_REF SNM08GKUB /end AXIS_DESCR
/end CHARACTERISTIC
/begin CHARACTERISTIC WFRL "Kraftstoffwandfilmkennlinie" CURVE 0xFC6F14 FklWUw 6143.906 rel_uw_b6144 0.00 6143.906 FORMAT "%8.3"
 /begin AXIS_DESCR FIX_AXIS rlp_w rel_uw_q0p0234 26 0.00 150.0000 FORMAT "%8.4" FIX_AXIS_PAR 0 8 26 /end AXIS_DESCR
/end CHARACTERISTIC
/begin CHARACTERISTIC ZBALM "Abregelfaktor L-Speicher (tmot) BA" CURVE 0xFD1DCE GklWUb 0.1245 fak_ub_b0p125 0.00 0.1245 FORMAT "%6.4"
 /begin AXIS_DESCR COM_AXIS tmot temp_ub_q0p75_o48 9 -48.00 143.3 FORMAT "%5.1" AXIS_PTS_REF STM09ESUB /end AXIS_DESCR
/end CHARACTERISTIC
/begin CHARACTERISTIC ZBALMDK "Abregelfaktor L-Speicher (tmot) BA" CURVE 0xFD1F5A GklWUb 0.1245 fak_ub_b0p125 0.00 0.1245 FORMAT "%6.4"
 /begin AXIS_DESCR COM_AXIS tmot temp_ub_q0p75_o48 9 -48.00 143.3 FORMAT "%5.1" AXIS_PTS_REF STM09ESUB /end AXIS_DESCR
/end CHARACTERISTIC
/begin CHARACTERISTIC ZDGZA1 "Z¸ndungszahl Abregelung Bereich 1" VALUE 0xFC6A00 KwUb 255.0 dez 0.00 255.0 FORMAT "%5.1" /end CHARACTERISTIC
/begin CHARACTERISTIC ZDGZA1VT "Z¸ndungszahl Abregelung Bereich 1 VVT-Betrieb" VALUE 0xFC6A01 KwUb 255.0 dez 0.00 255.0 FORMAT "%5.1" /end CHARACTERISTIC
/begin CHARACTERISTIC ZDGZA2 "Z¸ndungszahl Abregelung Bereich 2" VALUE 0xFC6A02 KwUb 255.0 dez 0.00 255.0 FORMAT "%5.1" /end CHARACTERISTIC
/begin CHARACTERISTIC ZDGZA2VT "Z¸ndungszahl Abregelung Bereich 2 VVT-Betrieb" VALUE 0xFC6A03 KwUb 255.0 dez 0.00 255.0 FORMAT "%5.1" /end CHARACTERISTIC
/begin CHARACTERISTIC ZKRLSOLDK "Zeitkonstante Filterung rlsol f¸r ESAK-Anteil DK" CURVE 0xFC705C KlAxU8SstxU8WU16 655.34999985 zk10msxs_uw_b655 0.010000152590 655.36000000 FORMAT "%12.8"
 /begin AXIS_DESCR STD_AXIS nmot nmot_ub_q40 6 0.00 10200. FORMAT "%5.0" DEPOSIT ABSOLUTE /end AXIS_DESCR
/end CHARACTERISTIC
/begin CHARACTERISTIC ZKRLSOLVT "Zeitkonstante Filterung rlsol f¸r ESAK-Anteil VVT" CURVE 0xFC6D9A KlAxU8SstxU8WU16 655.34999985 zk10msxs_uw_b655 0.010000152590 655.36000000 FORMAT "%12.8"
 /begin AXIS_DESCR STD_AXIS nmot nmot_ub_q40 6 0.00 10200. FORMAT "%5.0" DEPOSIT ABSOLUTE /end AXIS_DESCR
/end CHARACTERISTIC
/begin CHARACTERISTIC ZMVDTE "Zeitkonstante ‹berwachung Verlustmoment" VALUE 0xFCCA40 KwUw 3276.7499992 zk50msxs_uw_b3276p8 0.050000762951 3276.8000000 FORMAT "%12.7" /end CHARACTERISTIC
/begin CHARACTERISTIC ZNTED "Zeitkonstante Drehzahlfilterung bei TEV-Diagnose" VALUE 0xFCCA42 KwUw 655.34999985 zk10msxs_uw_b655 0.010000152590 655.36000000 FORMAT "%12.8" /end CHARACTERISTIC
/begin CHARACTERISTIC ZTEDDPS "Zeitkonstante Differenzdruck Saugrohr bei TEV-Diagnose" VALUE 0xFCCA44 KwUw 655.34999985 zk10msxs_uw_b655 0.010000152590 655.36000000 FORMAT "%12.8" /end CHARACTERISTIC
/begin CHARACTERISTIC ZTPDV1VAT "Zeitkonstante Tiefpass Deltageschwindigkeit" VALUE 0xFC2271 KwWU8 25.4996 zk100msxs_ub_b25p5 0.100392 25.6000 FORMAT "%7.4" /end CHARACTERISTIC
/begin CHARACTERISTIC ZUKE "Zeitkonstante ‹K-Ersatzwert" VALUE 0xFC6F48 KwUw 655.34999985 zk10msxs_uw_b655 0.010000152590 655.36000000 FORMAT "%12.8" /end CHARACTERISTIC
/begin CHARACTERISTIC ZUKEDK "Zeitkonstante ‹K-Ersatzwert" VALUE 0xFC71D4 KwUw 655.34999985 zk10msxs_uw_b655 0.010000152590 655.36000000 FORMAT "%12.8" /end CHARACTERISTIC
/begin CHARACTERISTIC ZUKK "Abregelfaktor Kurzzeitanteil" VALUE 0xFC6EAB KwUb 0.9961 fak_ub_b1 0.00 0.9961 /end CHARACTERISTIC
/begin CHARACTERISTIC ZUKKDK "Abregelfaktor Kurzzeitanteil" VALUE 0xFC716A KwUb 0.9961 fak_ub_b1 0.00 0.9961 /end CHARACTERISTIC
/begin CHARACTERISTIC ZUKNST "Abregelzeitkonstante ‹K-Faktor im Nachstart" VALUE 0xFC6F4A KwUw 6553.4999985 zk100msxs_uw_b6553 0.10000152590 6553.6000000 FORMAT "%12.7" /end CHARACTERISTIC
/begin CHARACTERISTIC ZUKNSTDK "Abregelzeitkonstante ‹K-Faktor im Nachstart" VALUE 0xFC71D6 KwUw 6553.4999985 zk100msxs_uw_b6553 0.10000152590 6553.6000000 FORMAT "%12.7" /end CHARACTERISTIC
/begin CHARACTERISTIC ZVALM "Abregelfaktor L-Speicher (tmot) VA" CURVE 0xFD1DD7 GklWUb 0.1245 fak_ub_b0p125 0.00 0.1245 FORMAT "%6.4"
 /begin AXIS_DESCR COM_AXIS tmot temp_ub_q0p75_o48 9 -48.00 143.3 FORMAT "%5.1" AXIS_PTS_REF STM09ESUB /end AXIS_DESCR
/end CHARACTERISTIC
/begin CHARACTERISTIC ZVALMDK "Abregelfaktor L-Speicher (tmot) VA" CURVE 0xFD1F63 GklWUb 0.1245 fak_ub_b0p125 0.00 0.1245 FORMAT "%6.4"
 /begin AXIS_DESCR COM_AXIS tmot temp_ub_q0p75_o48 9 -48.00 143.3 FORMAT "%5.1" AXIS_PTS_REF STM09ESUB /end AXIS_DESCR
/end CHARACTERISTIC
/begin MEASUREMENT abak "Aufteilungsfaktor Wandfilm bei BA" UBYTE fak_ub_b1 1 100 0 0.996094 ECU_ADDRESS 0x402D82 /end MEASUREMENT
/begin MEASUREMENT abakdk "Aufteilungsfaktor Wandfilm bei BA" UBYTE fak_ub_b1 1 100 0 0.996094 ECU_ADDRESS 0x402D92 /end MEASUREMENT
/begin MEASUREMENT abmbuf "" UBYTE dez 1 100 0 255 FORMAT "%5.1" ECU_ADDRESS 0x4039E6 /end MEASUREMENT
/begin MEASUREMENT abmznd "Einspritzausblendmuster bei Z¸ndkreisfehler" UBYTE dez 1 100 0 255 FORMAT "%5.1" ECU_ADDRESS 0x4039E7 /end MEASUREMENT
/begin MEASUREMENT aktdmtl_w "Aktivierungswort f¸r DMTL-Leckdiasgnose" UWORD dez 1 100 0 65535 FORMAT "%8.2" ECU_ADDRESS 0x40360A /end MEASUREMENT
/begin MEASUREMENT aktendo_w "beendete Tankleckdiagnosen (gespeicherter Wert)" UWORD dez 1 100 0 65535 FORMAT "%8.2" ECU_ADDRESS 0x40360C /end MEASUREMENT
/begin MEASUREMENT aktlaufn_w "laufende Tankleckdiagnosen (neuer Wert)" UWORD dez 1 100 0 65535 FORMAT "%8.2" ECU_ADDRESS 0x40360E /end MEASUREMENT
/begin MEASUREMENT aktlaufo_w "laufende Tankleckdiagnosen (alter Wert)" UWORD dez 1 100 0 65535 FORMAT "%8.2" ECU_ADDRESS 0x403610 /end MEASUREMENT
/begin MEASUREMENT aktlauft_w "laufende Tankleckdiagnosen vor Priorisierung" UWORD dez 1 100 0 65535 FORMAT "%8.2" ECU_ADDRESS 0x3FE2BE /end MEASUREMENT
/begin MEASUREMENT aktlauf_w "laufende Tankleckdiagnosen" UWORD dez 1 100 0 65535 FORMAT "%8.2" ECU_ADDRESS 0x3FE2C0 /end MEASUREMENT
/begin MEASUREMENT aktloco_w "anforderte Tankleckdiagnosen (alter Wert)" UWORD dez 1 100 0 65535 FORMAT "%8.2" ECU_ADDRESS 0x403612 /end MEASUREMENT
/begin MEASUREMENT aktloc_w "anforderte Tankleckdiagnosen (neuer Wert)" UWORD dez 1 100 0 65535 FORMAT "%8.2" ECU_ADDRESS 0x403614 /end MEASUREMENT
/begin MEASUREMENT aktnbeg_w "maximal aktivierteTankleckdiagnosen" UWORD dez 1 100 0 65535 FORMAT "%8.2" ECU_ADDRESS 0x403616 /end MEASUREMENT
/begin MEASUREMENT aktstopt_w "gestoppte Tankleckdiagnosen vor Priorisierung" UWORD dez 1 100 0 65535 FORMAT "%8.2" ECU_ADDRESS 0x403618 /end MEASUREMENT
/begin MEASUREMENT aktstop_w "gestoppte Tankleckdiagnosen mit Priorisierung" UWORD dez 1 100 0 65535 FORMAT "%8.2" ECU_ADDRESS 0x40361A /end MEASUREMENT
/begin MEASUREMENT ancldmtl "Tankleckdiagnose Abbruchz‰hler f¸r Fehlerspeicher lˆschen" UBYTE dez 1 100 0 255 FORMAT "%5.1" ECU_ADDRESS 0x3FE2C2 /end MEASUREMENT
/begin MEASUREMENT andmtirq "Abbruchz‰hler wegen geˆffneter Tankklappe f¸r Tankleckdiagnose" UBYTE dez 1 100 0 255 FORMAT "%5.1" ECU_ADDRESS 0x3FE2C3 /end MEASUREMENT
/begin MEASUREMENT andmtlash "Abbruchz‰hler f¸r Stops wegen steilem Hang" UBYTE dez 1 100 0 255 FORMAT "%5.1" ECU_ADDRESS 0x3FE2C4 /end MEASUREMENT
/begin MEASUREMENT andpf "Tankleckdiagnose: Abbruchz‰hler wegen Feuchte" UBYTE dez 1 100 0 255 FORMAT "%5.1" ECU_ADDRESS 0x3FE2C5 /end MEASUREMENT
/begin MEASUREMENT andtetd "Abbruchz‰hler f¸r Stopp der Diagnose bei Tankdeckel ˆffnen" UBYTE dez 1 100 0 255 FORMAT "%5.1" ECU_ADDRESS 0x3FE2C6 /end MEASUREMENT
/begin MEASUREMENT andtetk "Abbruchz‰hler f¸r Stopp der Diagnose bei Betankungserkennung" UBYTE dez 1 100 0 255 FORMAT "%5.1" ECU_ADDRESS 0x3FE2C7 /end MEASUREMENT
/begin MEASUREMENT andubtes "Abbruchz‰hler wegen Batteriespannungsschwankungen" UBYTE dez 1 100 0 255 FORMAT "%5.1" ECU_ADDRESS 0x3FE2C8 /end MEASUREMENT
/begin MEASUREMENT antehb "Abbruchz‰hler f¸r Stopbedingungen wegen hoher AKF-Beladung" UBYTE dez 1 100 0 255 FORMAT "%5.1" ECU_ADDRESS 0x3FE2C9 /end MEASUREMENT
/begin MEASUREMENT antxdmts "Abbruchz‰hler f¸r ‹berschreitung Maximalzeit" UBYTE dez 1 100 0 255 FORMAT "%5.1" ECU_ADDRESS 0x3FE2CA /end MEASUREMENT
/begin MEASUREMENT anztibstnd "Anzahl der Einspritzungen seit Startende" UWORD dez 1 100 0 65535 FORMAT "%8.2" ECU_ADDRESS 0x403FE8 /end MEASUREMENT
/begin MEASUREMENT anztib_w "ti-Einspritzz‰hler mit Begrenzung" UWORD dez 1 100 0 65535 FORMAT "%8.2" ECU_ADDRESS 0x403FEA /end MEASUREMENT
/begin MEASUREMENT anztis "Anzahl vom CIFI initialisierter ti's (Synchro-Abtastung)" UBYTE dez 1 100 0 255 FORMAT "%5.1" ECU_ADDRESS 0x403BD8 /end MEASUREMENT
/begin MEASUREMENT anztist "ti-Einspritzz‰hler im Start" UBYTE dez 1 100 0 255 FORMAT "%5.1" ECU_ADDRESS 0x403BD7 /end MEASUREMENT
/begin MEASUREMENT anzti_stnd "Anzahl der Einspritzungen bis Startende" UWORD dez 1 100 0 65535 FORMAT "%8.2" ECU_ADDRESS 0x403FEC /end MEASUREMENT
/begin MEASUREMENT anzwefim "Anzahl der abgearbeiteten Wiedereinsetzfaktoren" UBYTE dez 1 100 0 255 FORMAT "%5.1" ECU_ADDRESS 0x403BD9 /end MEASUREMENT
/begin MEASUREMENT avak "Aufteilungsfaktor Wandfilm bei VA" UBYTE fak_ub_b1 1 100 0 0.996094 ECU_ADDRESS 0x402D83 /end MEASUREMENT
/begin MEASUREMENT avakdk "Aufteilungsfaktor Wandfilm bei VA" UBYTE fak_ub_b1 1 100 0 0.996094 ECU_ADDRESS 0x402D93 /end MEASUREMENT
/begin MEASUREMENT azylwe "Anzahl wiedereingesetzter Zylinder" UBYTE dez 1 100 0 255 FORMAT "%5.1" ECU_ADDRESS 0x403BDA /end MEASUREMENT
/begin MEASUREMENT B2vsaadnok "Bedingung Anschlagadaption Auslasspreizung Bank 2 n.i.O." UBYTE B_TRUE 1 100 0 1 BIT_MASK 0x10 FORMAT "%13.11" ECU_ADDRESS 0x3FE370 /end MEASUREMENT
/begin MEASUREMENT B2vsaadok "" UBYTE B_TRUE 1 100 0 1 BIT_MASK 0x40 FORMAT "%13.11" ECU_ADDRESS 0x3FE370 /end MEASUREMENT
/begin MEASUREMENT B2vsaadp "Bedingung Anschlagadaption Auslasspreizung Bank 2" UBYTE B_TRUE 1 100 0 1 BIT_MASK 0x1 FORMAT "%13.11" ECU_ADDRESS 0x3FE370 /end MEASUREMENT
/begin MEASUREMENT B2vsaflan "Bedingung neue NW-Flanke Auslasspreizung Bank 2" UBYTE B_TRUE 1 100 0 1 BIT_MASK 0x20 FORMAT "%13.11" ECU_ADDRESS 0x3FE370 /end MEASUREMENT
/begin MEASUREMENT B2vsanwerr "Bedingung Fehler von der HW-Schale Auslasspreizung Bank 2" UBYTE B_TRUE 1 100 0 1 BIT_MASK 0x2 FORMAT "%13.11" ECU_ADDRESS 0x3FE370 /end MEASUREMENT
/begin MEASUREMENT B2vseadnok "Bedingung Anschlagadaption Einlasspreizung Bank 2 n.i.O." UBYTE B_TRUE 1 100 0 1 BIT_MASK 0x10 FORMAT "%13.11" ECU_ADDRESS 0x3FE37A /end MEASUREMENT
/begin MEASUREMENT B2vseadok "" UBYTE B_TRUE 1 100 0 1 BIT_MASK 0x40 FORMAT "%13.11" ECU_ADDRESS 0x3FE37A /end MEASUREMENT
/begin MEASUREMENT B2vseadp "Bedingung Anschlagadaption Einlasspreizung Bank 2" UBYTE B_TRUE 1 100 0 1 BIT_MASK 0x1 FORMAT "%13.11" ECU_ADDRESS 0x3FE37A /end MEASUREMENT
/begin MEASUREMENT B2vseflan "Bedingung neue NW-Flanke Einlasspreizung Bank 2" UBYTE B_TRUE 1 100 0 1 BIT_MASK 0x20 FORMAT "%13.11" ECU_ADDRESS 0x3FE37A /end MEASUREMENT
/begin MEASUREMENT B2vsenwerr "Bedingung Fehler von der HW-Schale Einlasspreizung Bank 2" UBYTE B_TRUE 1 100 0 1 BIT_MASK 0x2 FORMAT "%13.11" ECU_ADDRESS 0x3FE37A /end MEASUREMENT
/begin MEASUREMENT bbwuc "Byte f¸r Bedingung B_wuc als Triggerevent in DCLA" UBYTE dez 1 100 0 255 FORMAT "%5.1" ECU_ADDRESS 0x403B30 /end MEASUREMENT
/begin MEASUREMENT B_afwe "Bedingung Anzahl der Wiedereinsetzfaktoren" UBYTE B_TRUE 1 100 0 1 BIT_MASK 0x1 FORMAT "%13.11" ECU_ADDRESS 0x3FC0C5 /end MEASUREMENT
/begin MEASUREMENT B_ba "Bedingung Beschleunigungsanreicherung (Anzeige)" UBYTE B_TRUE 1 100 0 1 BIT_MASK 0x1 FORMAT "%13.11" ECU_ADDRESS 0x3FC0B7 /end MEASUREMENT
/begin MEASUREMENT B_bag "Bedingung starke Beschleunigungsanreicherung" UBYTE B_TRUE 1 100 0 1 BIT_MASK 0x1 FORMAT "%13.11" ECU_ADDRESS 0x3FC0B8 /end MEASUREMENT
/begin MEASUREMENT B_begrvvt "" UBYTE B_TRUE 1 100 0 1 FORMAT "%13.11" ECU_ADDRESS 0x402CD8 /end MEASUREMENT
/begin MEASUREMENT B_clddmtl "Fehlerspeicherlˆschen eines Fehlerpfads im DMTL-Umfeld" UBYTE B_TRUE 1 100 0 1 BIT_MASK 0x1 FORMAT "%13.11" ECU_ADDRESS 0x403656 /end MEASUREMENT
/begin MEASUREMENT B_cwdthm "Bedingung: Diagnose Thermostat Motor-K¸hlmittel eingeschaltet" UBYTE B_TRUE 1 100 0 1 BIT_MASK 0x40 FORMAT "%13.11" ECU_ADDRESS 0x403748 /end MEASUREMENT
/begin MEASUREMENT B_dmgltd "Bedingung Freigabe Grobleckpr¸fung durch check filler cap" UBYTE B_TRUE 1 100 0 1 BIT_MASK 0x1 FORMAT "%13.11" ECU_ADDRESS 0x3FE2CC /end MEASUREMENT
/begin MEASUREMENT B_dmtlrst "R¸cksetzen interner DMTL-Grˆﬂen wegen neuer Diagnose" UBYTE B_TRUE 1 100 0 1 BIT_MASK 0x1 FORMAT "%13.11" ECU_ADDRESS 0x403654 /end MEASUREMENT
/begin MEASUREMENT B_dmttnse "Bedingung f¸r DM-TL: Mindestzeit nach Start ist verstrichen" UBYTE B_TRUE 1 100 0 1 BIT_MASK 0x2 FORMAT "%13.11" ECU_ADDRESS 0x403656 /end MEASUREMENT
/begin MEASUREMENT B_dteaa "Bedingung Aufsteuerpr¸fung f¸r TEV Diagnose aktiv" UBYTE B_TRUE 1 100 0 1 BIT_MASK 0x1 FORMAT "%13.11" ECU_ADDRESS 0x3FC340 /end MEASUREMENT
/begin MEASUREMENT B_dteabr "Abbruch der TE-Diagnose durch Stˆreinfl¸sse (Beschreibungsvariable)" UBYTE B_TRUE 1 100 0 1 BIT_MASK 0x1 FORMAT "%13.11" ECU_ADDRESS 0x4035F4 /end MEASUREMENT
/begin MEASUREMENT B_dtean "Abbruch TE-Diagnose wegen ƒnderung der Solldrehzahl" UBYTE B_TRUE 1 100 0 1 BIT_MASK 0x2 FORMAT "%13.11" ECU_ADDRESS 0x4035F4 /end MEASUREMENT
/begin MEASUREMENT B_dteaq "Abbruch TE-Diagnose wegen ƒnderung der Vorsteuerluft" UBYTE B_TRUE 1 100 0 1 BIT_MASK 0x4 FORMAT "%13.11" ECU_ADDRESS 0x4035F4 /end MEASUREMENT
/begin MEASUREMENT B_dtebel "Eingangsbedingungen der Beladungspr¸fung erf¸llt" UBYTE B_TRUE 1 100 0 1 BIT_MASK 0x8 FORMAT "%13.11" ECU_ADDRESS 0x4035F4 /end MEASUREMENT
/begin MEASUREMENT B_dtebn "Beginn der Drehzahlpr¸fung" UBYTE B_TRUE 1 100 0 1 BIT_MASK 0x1 FORMAT "%13.11" ECU_ADDRESS 0x3FC341 /end MEASUREMENT
/begin MEASUREMENT B_dtegr "Freigabebit mehrerer Bedingungenf¸r Freigabe DTEVN" UBYTE B_TRUE 1 100 0 1 BIT_MASK 0x1 FORMAT "%13.11" ECU_ADDRESS 0x3FC342 /end MEASUREMENT
/begin MEASUREMENT B_dtei "Steuerbit f¸r Integrator bei Tankentl¸ftungsdiagnose" UBYTE B_TRUE 1 100 0 1 BIT_MASK 0x1 FORMAT "%13.11" ECU_ADDRESS 0x3FC343 /end MEASUREMENT
/begin MEASUREMENT B_dtes "Aktive Diagnose: Tankentl¸ftungssystem" UBYTE B_TRUE 1 100 0 1 BIT_MASK 0x1 FORMAT "%13.11" ECU_ADDRESS 0x3FC344 /end MEASUREMENT
/begin MEASUREMENT B_dtesq "Abbruch der TE-Diagnose wegen Stˆrungen der Solluft" UBYTE B_TRUE 1 100 0 1 BIT_MASK 0x10 FORMAT "%13.11" ECU_ADDRESS 0x4035F4 /end MEASUREMENT
/begin MEASUREMENT B_dtest "Start f¸r TEV-Ansteuerung" UBYTE B_TRUE 1 100 0 1 BIT_MASK 0x1 FORMAT "%13.11" ECU_ADDRESS 0x3FC345 /end MEASUREMENT
/begin MEASUREMENT B_dtev "Aktive Diagnose: Tankentl¸ftungsventil Funktion" UBYTE B_TRUE 1 100 0 1 BIT_MASK 0x1 FORMAT "%13.11" ECU_ADDRESS 0x3FC346 /end MEASUREMENT
/begin MEASUREMENT B_dtevbe "" UBYTE dez 1 100 0 255 FORMAT "%5.1" ECU_ADDRESS 0x403D0F /end MEASUREMENT
/begin MEASUREMENT B_dtevgo "Bedingung Diagnose TEV starten" UBYTE B_TRUE 1 100 0 1 BIT_MASK 0x1 FORMAT "%13.11" ECU_ADDRESS 0x3FC348 /end MEASUREMENT
/begin MEASUREMENT B_dtevio "Bedingung TEV i.O. (Beschreibungsvariable)" UBYTE B_TRUE 1 100 0 1 BIT_MASK 0x20 FORMAT "%13.11" ECU_ADDRESS 0x4035F4 /end MEASUREMENT
/begin MEASUREMENT B_dtevngd "" UBYTE dez 1 100 0 255 FORMAT "%5.1" ECU_ADDRESS 0x403D10 /end MEASUREMENT
/begin MEASUREMENT B_dtevpoe "Bedingung DTEVP ohne Ergebnis" UBYTE B_TRUE 1 100 0 1 BIT_MASK 0x1 FORMAT "%13.11" ECU_ADDRESS 0x3FC349 /end MEASUREMENT
/begin MEASUREMENT B_dths1 "Bedingung f¸r TKA-Diagnoseschwelle" UBYTE B_TRUE 1 100 0 1 BIT_MASK 0x1 FORMAT "%13.11" ECU_ADDRESS 0x403748 /end MEASUREMENT
/begin MEASUREMENT B_dthsab "Bedingung f¸r Abbruch der Diagnosefunktion" UBYTE B_TRUE 1 100 0 1 BIT_MASK 0x2 FORMAT "%13.11" ECU_ADDRESS 0x403748 /end MEASUREMENT
/begin MEASUREMENT B_dthsfr "Bedingung f¸r Freigabe der Diagnosefunktion" UBYTE B_TRUE 1 100 0 1 BIT_MASK 0x4 FORMAT "%13.11" ECU_ADDRESS 0x403748 /end MEASUREMENT
/begin MEASUREMENT B_dthsst "Bedindung f¸r Diagnosestop" UBYTE B_TRUE 1 100 0 1 BIT_MASK 0x8 FORMAT "%13.11" ECU_ADDRESS 0x403748 /end MEASUREMENT
/begin MEASUREMENT B_dufzok "Allgemeine Bedingung zum Setzen des Zyklus Flags in der Diagnose der Fkt¸ko" UWORD B_TRUE 1 100 0 1 BIT_MASK 0x1 FORMAT "%13.11" ECU_ADDRESS 0x3FBECE /end MEASUREMENT
/begin MEASUREMENT B_dvvtdex "Bedingung Abweichung Exzenterwinkel" UBYTE B_TRUE 1 100 0 1 FORMAT "%13.11" ECU_ADDRESS 0x40378E /end MEASUREMENT
/begin MEASUREMENT B_dvvteph "Bedingung Fehler Phasensensor" UBYTE B_TRUE 1 100 0 1 FORMAT "%13.11" ECU_ADDRESS 0x402CD9 /end MEASUREMENT
/begin MEASUREMENT B_dvvtobd "Bedingung VVT-OBD Notlauf" UBYTE B_TRUE 1 100 0 1 FORMAT "%13.11" ECU_ADDRESS 0x40378F /end MEASUREMENT
/begin MEASUREMENT B_dvvt_t "Bedingung Test Bank1" UBYTE B_TRUE 1 100 0 1 FORMAT "%13.11" ECU_ADDRESS 0x402CDA /end MEASUREMENT
/begin MEASUREMENT B_dzack "Bedingung Diagnose Zuendung Daten von HW Schale ¸ber Komponententreiber empfange" UBYTE B_TRUE 1 100 0 1 BIT_MASK 0x1 FORMAT "%13.11" ECU_ADDRESS 0x403816 /end MEASUREMENT
/begin MEASUREMENT B_dzappl "Bedingung unplausible Schlieﬂzeitapplikation" UBYTE default 1 100 0 1 FORMAT "%5.3" ARRAY_SIZE 8 ECU_ADDRESS 0x4039E8 /end MEASUREMENT
/begin MEASUREMENT B_dzdmden "Bedingung Freigabe Z¸ndungsdiagnose durch Aussetzererkennung" UBYTE B_TRUE 1 100 0 1 BIT_MASK 0x1 FORMAT "%13.11" ECU_ADDRESS 0x403817 /end MEASUREMENT
/begin MEASUREMENT B_dzdmdub "Bedingung Freigabe Erkennung niederimpedanter Prim‰rkreis" UBYTE default 1 100 0 1 FORMAT "%5.3" ARRAY_SIZE 8 ECU_ADDRESS 0x4039F0 /end MEASUREMENT
/begin MEASUREMENT B_dzenable "Bedingung f¸r aktive Z¸ndkreisdiagnose" UBYTE B_TRUE 1 100 0 1 BIT_MASK 0x1 FORMAT "%13.11" ECU_ADDRESS 0x403818 /end MEASUREMENT
/begin MEASUREMENT B_dzhksub "Bedingung harter Z¸ndkreiskurzschluﬂ nach ub" UBYTE default 1 100 0 1 FORMAT "%5.3" ARRAY_SIZE 8 ECU_ADDRESS 0x4039F8 /end MEASUREMENT
/begin MEASUREMENT B_dzkdmd "Bedingung : Aussetzer werden signalisiert" UBYTE default 1 100 0 1 FORMAT "%5.3" ARRAY_SIZE 8 ECU_ADDRESS 0x403A00 /end MEASUREMENT
/begin MEASUREMENT B_dzkprl "Bedingung : Auswerteentprellung f¸r Aussetzersignal" UBYTE B_TRUE 1 100 0 1 BIT_MASK 0x1 FORMAT "%13.11" ECU_ADDRESS 0x403819 /end MEASUREMENT
/begin MEASUREMENT B_dzksms "Bedingung Kurzschluﬂ nach Masse am Z¸ndkreis" UBYTE default 1 100 0 1 FORMAT "%5.3" ARRAY_SIZE 8 ECU_ADDRESS 0x403A08 /end MEASUREMENT
/begin MEASUREMENT B_dzksub "Bedingung Kurzschluﬂ nach Ub am Z¸ndkreis" UBYTE default 1 100 0 1 FORMAT "%5.3" ARRAY_SIZE 8 ECU_ADDRESS 0x403A10 /end MEASUREMENT
/begin MEASUREMENT B_dzkub "Bedingung Kurzschluﬂ nach Ub am Z¸ndkreis" UBYTE B_TRUE 1 100 0 1 BIT_MASK 0x1 FORMAT "%13.11" ECU_ADDRESS 0x40381A /end MEASUREMENT
/begin MEASUREMENT B_dzmnen "‹berpr¸fung Kurzschluss Ub Verh‰tniss aktiv" UBYTE B_TRUE 1 100 0 1 BIT_MASK 0x1 FORMAT "%13.11" ECU_ADDRESS 0x40381B /end MEASUREMENT
/begin MEASUREMENT B_dzmnrel "Bedingung Kurzschluﬂ nach Ub am Z¸ndkreis ¸ber Verh‰ltnisbildung erkannt" UBYTE B_TRUE 1 100 0 1 BIT_MASK 0x1 FORMAT "%13.11" ECU_ADDRESS 0x40381C /end MEASUREMENT
/begin MEASUREMENT B_dzmxen "Bedingung Fehlerverdacht Kurzschluﬂ nach Ubatt" UBYTE B_TRUE 1 100 0 1 BIT_MASK 0x1 FORMAT "%13.11" ECU_ADDRESS 0x40381D /end MEASUREMENT
/begin MEASUREMENT B_dzmxrel "Bedingung Kurzschluﬂ nach Masse am Z¸ndkreis ¸ber Verh‰ltnisbildung erkannt" UBYTE B_TRUE 1 100 0 1 BIT_MASK 0x1 FORMAT "%13.11" ECU_ADDRESS 0x40381E /end MEASUREMENT
/begin MEASUREMENT B_dzotp "Bedingung ‹bertemperaturfehler erkannt" UBYTE default 1 100 0 1 FORMAT "%5.3" ARRAY_SIZE 8 ECU_ADDRESS 0x403A18 /end MEASUREMENT
/begin MEASUREMENT B_dzzyk "Bedingung Z¸ndkreisdiagnosezyklen gleich Schwellwert" UBYTE B_TRUE 1 100 0 1 BIT_MASK 0x1 FORMAT "%13.11" ECU_ADDRESS 0x40381F /end MEASUREMENT
/begin MEASUREMENT B_ebl "Bedingung Ansteuerung E-Box L¸fter" UBYTE B_TRUE 1 100 0 1 BIT_MASK 0x1 FORMAT "%13.11" ECU_ADDRESS 0x3FC390 /end MEASUREMENT
/begin MEASUREMENT B_eebdtes "Zusammenfassung verschiedener Errorbits f¸r DTEVN 24.90,2" UBYTE B_TRUE 1 100 0 1 BIT_MASK 0x1 FORMAT "%13.11" ECU_ADDRESS 0x3FC347 /end MEASUREMENT
/begin MEASUREMENT B_eepdif "Plausibilit‰tspr¸fung EEPROM und FLASH-Daten" UBYTE B_TRUE 1 100 0 1 BIT_MASK 0x1 FORMAT "%13.11" ECU_ADDRESS 0x3FBFD0 /end MEASUREMENT
/begin MEASUREMENT B_eepinioz "Bedingung: Neutralwerte  EEPROM-Spiegel ozdata" UBYTE B_TRUE 1 100 0 1 BIT_MASK 0x1 FORMAT "%13.11" ECU_ADDRESS 0x3FBFD1 /end MEASUREMENT
/begin MEASUREMENT B_esbnb "Bedingung Einspritzbeginn im Normalbetrieb" UBYTE B_TRUE 1 100 0 1 BIT_MASK 0x2 FORMAT "%13.11" ECU_ADDRESS 0x4038FF /end MEASUREMENT
/begin MEASUREMENT B_esbst "Bedingung Einspritzbeginn im Start" UBYTE B_TRUE 1 100 0 1 BIT_MASK 0x1 FORMAT "%13.11" ECU_ADDRESS 0x4038FF /end MEASUREMENT
/begin MEASUREMENT B_esdmte "Bedingung DDMTL enabled bezueglich Endstufenfehler" UBYTE B_TRUE 1 100 0 1 BIT_MASK 0x2 FORMAT "%13.11" ECU_ADDRESS 0x403654 /end MEASUREMENT
/begin MEASUREMENT B_evdmtbc "grundlegende Bedingungen f¸r Tankleckdiagnose erf¸llt" UBYTE B_TRUE 1 100 0 1 BIT_MASK 0x4 FORMAT "%13.11" ECU_ADDRESS 0x403654 /end MEASUREMENT
/begin MEASUREMENT B_evdmtcp "Bedingungen f¸r Komponentenschutz erf¸llt" UBYTE B_TRUE 1 100 0 1 BIT_MASK 0x8 FORMAT "%13.11" ECU_ADDRESS 0x403654 /end MEASUREMENT
/begin MEASUREMENT B_evdmtec "Umgebungsbedinungen f¸r Leckdiagnose erf¸llt" UBYTE B_TRUE 1 100 0 1 BIT_MASK 0x10 FORMAT "%13.11" ECU_ADDRESS 0x403654 /end MEASUREMENT
/begin MEASUREMENT B_evdmtfa "Bedingung Tankleckdiagnose: keine Funktionsanforderung" UBYTE B_TRUE 1 100 0 1 BIT_MASK 0x20 FORMAT "%13.11" ECU_ADDRESS 0x403654 /end MEASUREMENT
/begin MEASUREMENT B_evdmtmo "Bedingung: MIL nicht aktiviert durch Tankleckdiagnose" UBYTE B_TRUE 1 100 0 1 BIT_MASK 0x40 FORMAT "%13.11" ECU_ADDRESS 0x403654 /end MEASUREMENT
/begin MEASUREMENT B_evdmtoc "Betriebsbedingungen f¸r Leckdiagnose erf¸llt" UBYTE B_TRUE 1 100 0 1 BIT_MASK 0x80 FORMAT "%13.11" ECU_ADDRESS 0x403654 /end MEASUREMENT
/begin MEASUREMENT B_fgdvat "Bedingung Freigabe der Diagnosefunktion erteilt" UBYTE B_TRUE 1 100 0 1 BIT_MASK 0x1 FORMAT "%13.11" ECU_ADDRESS 0x3FC05D /end MEASUREMENT
/begin MEASUREMENT B_fonresv "Anforderung Reset der Fuel-On Adaption durchf¸hren (VVT-Fehler)" UBYTE B_TRUE 1 100 0 1 FORMAT "%13.11" ECU_ADDRESS 0x403790 /end MEASUREMENT
/begin MEASUREMENT B_fwe "Bedingung Faktor Wiedereinsetzen" UBYTE B_TRUE 1 100 0 1 BIT_MASK 0x1 FORMAT "%13.11" ECU_ADDRESS 0x3FC0C6 /end MEASUREMENT
/begin MEASUREMENT B_globd "Diagnoseanforderung Grobleck (1.0mm)" UBYTE B_TRUE 1 100 0 1 BIT_MASK 0x4 FORMAT "%13.11" ECU_ADDRESS 0x403656 /end MEASUREMENT
/begin MEASUREMENT B_heaths "Bedingung Fehler DTHS geheilt" UBYTE B_TRUE 1 100 0 1 BIT_MASK 0x10 FORMAT "%13.11" ECU_ADDRESS 0x403748 /end MEASUREMENT
/begin MEASUREMENT B_heulsu "Bedingung Zyklusflag darf gesetzt werden / Fehler lˆschen" UBYTE B_TRUE 1 100 0 1 BIT_MASK 0x1 FORMAT "%13.11" ECU_ADDRESS 0x402B30 /end MEASUREMENT
/begin MEASUREMENT B_heulsu2 "Bedingung Zyklusflag darf gesetzt werden / Fehler lˆschen, Bank 2" UBYTE B_TRUE 1 100 0 1 BIT_MASK 0x10 FORMAT "%13.11" ECU_ADDRESS 0x402B30 /end MEASUREMENT
/begin MEASUREMENT B_hst "Bedingung Heiﬂstart" UBYTE B_TRUE 1 100 0 1 BIT_MASK 0x1 FORMAT "%13.11" ECU_ADDRESS 0x3FE16C /end MEASUREMENT
/begin MEASUREMENT B_klobd "Diagnoseanforderung 0.5mm" UBYTE B_TRUE 1 100 0 1 BIT_MASK 0x8 FORMAT "%13.11" ECU_ADDRESS 0x403656 /end MEASUREMENT
/begin MEASUREMENT B_lamnse "Bedingung Ende lamns_w-Berechnung" UBYTE dez 1 100 0 255 FORMAT "%5.1" ECU_ADDRESS 0x4037C0 /end MEASUREMENT
/begin MEASUREMENT B_luft "LSU an Luft" UBYTE B_TRUE 1 100 0 1 BIT_MASK 0x4 FORMAT "%13.11" ECU_ADDRESS 0x402B30 /end MEASUREMENT
/begin MEASUREMENT B_luft2 "LSU 2 an Luft" UBYTE B_TRUE 1 100 0 1 BIT_MASK 0x40 FORMAT "%13.11" ECU_ADDRESS 0x402B30 /end MEASUREMENT
/begin MEASUREMENT B_m8te "Bedingung Fkt-Anforderung Tankentl¸ftung nach SAE J1979 Mode 8 TID $01" UBYTE B_TRUE 1 100 0 1 BIT_MASK 0x1 FORMAT "%13.11" ECU_ADDRESS 0x3FBEF4 /end MEASUREMENT
/begin MEASUREMENT B_mdbegr "Bedingung Unplausibilitaet Luftmasse" UBYTE B_TRUE 1 100 0 1 FORMAT "%13.11" ECU_ADDRESS 0x402CDB /end MEASUREMENT
/begin MEASUREMENT B_mdbegrml "Bedingung Unplausibilitaet Luftmasse ¸ber DK und HFM-Signal" UBYTE B_TRUE 1 100 0 1 FORMAT "%13.11" ECU_ADDRESS 0x402CDC /end MEASUREMENT
/begin MEASUREMENT B_mdbegrps "Bedingung Unplausibilitaet Luftmasse ¸ber Druckverh‰ltnis" UBYTE B_TRUE 1 100 0 1 FORMAT "%13.11" ECU_ADDRESS 0x402CDD /end MEASUREMENT
/begin MEASUREMENT B_mdbegrvl "Bedingung Unplausibilitaet Luftmasse bei Vollast" UBYTE B_TRUE 1 100 0 1 FORMAT "%13.11" ECU_ADDRESS 0x402CDE /end MEASUREMENT
/begin MEASUREMENT B_minths "Bedingung Fehler DTHS erkannt" UBYTE B_TRUE 1 100 0 1 BIT_MASK 0x20 FORMAT "%13.11" ECU_ADDRESS 0x403748 /end MEASUREMENT
/begin MEASUREMENT B_mirdmtl "Bedingung MIL on wegen DMTL" UBYTE B_TRUE 1 100 0 1 BIT_MASK 0x1 FORMAT "%13.11" ECU_ADDRESS 0x3FE2CB /end MEASUREMENT
/begin MEASUREMENT B_mrfamx "Vorlagerungswinkel ¸ber maximales Fahrerwunschmomment aktiv" UBYTE B_TRUE 1 100 0 1 BIT_MASK 0x1 FORMAT "%13.11" ECU_ADDRESS 0x4037C6 /end MEASUREMENT
/begin MEASUREMENT B_nkfl "Obere Schwelle abgebrochener Feinleckmessungen wegen Stromschwankungen ¸berschr." UBYTE B_TRUE 1 100 0 1 BIT_MASK 0x1 FORMAT "%13.11" ECU_ADDRESS 0x403655 /end MEASUREMENT
/begin MEASUREMENT B_nkflg "Komponentenpr¸fung auf Stromschwankungen g¸ltig" UBYTE B_TRUE 1 100 0 1 BIT_MASK 0x2 FORMAT "%13.11" ECU_ADDRESS 0x403655 /end MEASUREMENT
/begin MEASUREMENT B_nldgh "" UBYTE B_TRUE 1 100 0 1 FORMAT "%13.11" ECU_ADDRESS 0x402CDF /end MEASUREMENT
/begin MEASUREMENT B_nldte "Anforderung Steuerger‰tenachlauf Diagnose Tankentl¸ftung" UBYTE B_TRUE 1 100 0 1 BIT_MASK 0x4 FORMAT "%13.11" ECU_ADDRESS 0x403655 /end MEASUREMENT
/begin MEASUREMENT B_nmoton "Bedingung Motor war w‰hrend laufender Fahrt an" UBYTE B_TRUE 1 100 0 1 BIT_MASK 0x10 FORMAT "%13.11" ECU_ADDRESS 0x403656 /end MEASUREMENT
/begin MEASUREMENT B_nowuc "Bedingung 'kein warm up cycle' erkannt" UBYTE B_TRUE 1 100 0 1 BIT_MASK 0x1 FORMAT "%13.11" ECU_ADDRESS 0x3FBEFA /end MEASUREMENT
/begin MEASUREMENT B_npos0dyn "Bedingung Fehler NW-Flanke > 720 Grad KW dynamisch E-NW 1" UBYTE B_TRUE 1 100 0 1 BIT_MASK 0x80 FORMAT "%13.11" ECU_ADDRESS 0x3FE37F /end MEASUREMENT
/begin MEASUREMENT B_npos1dyn "Bedingung Fehler NW-Flanke > 720 Grad KW dynamisch A-NW 1" UBYTE B_TRUE 1 100 0 1 BIT_MASK 0x80 FORMAT "%13.11" ECU_ADDRESS 0x3FE375 /end MEASUREMENT
/begin MEASUREMENT B_npos2dyn "Bedingung Fehler NW-Flanke > 720 Grad KW dynamisch E-NW 2" UBYTE B_TRUE 1 100 0 1 BIT_MASK 0x80 FORMAT "%13.11" ECU_ADDRESS 0x3FE37A /end MEASUREMENT
/begin MEASUREMENT B_npos3dyn "Bedingung Fehler NW-Flanke > 720 Grad KW dynamisch A-NW 2" UBYTE B_TRUE 1 100 0 1 BIT_MASK 0x80 FORMAT "%13.11" ECU_ADDRESS 0x3FE370 /end MEASUREMENT
/begin MEASUREMENT B_redkl "Freigabe Reduzierung ‹K-K- und -L-Anteil" UBYTE B_TRUE 1 100 0 1 BIT_MASK 0x1 FORMAT "%13.11" ECU_ADDRESS 0x3FC0B9 /end MEASUREMENT
/begin MEASUREMENT B_sloff "Bedingung Slave Off" UBYTE B_TRUE 1 100 0 1 BIT_MASK 0x80 FORMAT "%13.11" ECU_ADDRESS 0x403748 /end MEASUREMENT
/begin MEASUREMENT B_taini "Bedingung 2A Zeit gleich Initialisierungswert" UBYTE default 1 100 0 1 FORMAT "%5.3" ARRAY_SIZE 8 ECU_ADDRESS 0x403A20 /end MEASUREMENT
/begin MEASUREMENT B_tevcheck "Bedingung Diagnose TEV l‰uft" UBYTE B_TRUE 1 100 0 1 BIT_MASK 0x1 FORMAT "%13.11" ECU_ADDRESS 0x3FC34A /end MEASUREMENT
/begin MEASUREMENT B_tevchkon "Bedingung Referenzstrom f¸r Tevcheck ermittelt" UBYTE B_TRUE 1 100 0 1 BIT_MASK 0x1 FORMAT "%13.11" ECU_ADDRESS 0x3FC34B /end MEASUREMENT
/begin MEASUREMENT B_tevfahrt "Bedingung Tevcheck soll w‰hrend der Fahrt gestartet werden" UBYTE dez 1 100 0 255 FORMAT "%5.1" ECU_ADDRESS 0x403D11 /end MEASUREMENT
/begin MEASUREMENT B_tldinfo "Bedingung Tankleckdiagnose als Informationspr¸fung" UBYTE B_TRUE 1 100 0 1 BIT_MASK 0x8 FORMAT "%13.11" ECU_ADDRESS 0x403655 /end MEASUREMENT
/begin MEASUREMENT B_tldobd "Bedingung Tankleckdiagnose mit OBD-Relevanz" UBYTE B_TRUE 1 100 0 1 BIT_MASK 0x10 FORMAT "%13.11" ECU_ADDRESS 0x403655 /end MEASUREMENT
/begin MEASUREMENT B_tldtehb "Bedingung Tankentl¸ftung mit hoher Beladung" UBYTE B_TRUE 1 100 0 1 BIT_MASK 0x20 FORMAT "%13.11" ECU_ADDRESS 0x403655 /end MEASUREMENT
/begin MEASUREMENT B_tldtevmv "TEV-Pr¸fung mit DMTL: Anforderung zum Bestromen des Magnetventils" UBYTE B_TRUE 1 100 0 1 BIT_MASK 0x1 FORMAT "%13.11" ECU_ADDRESS 0x3FC34C /end MEASUREMENT
/begin MEASUREMENT B_tldtevpm "TEV-Pr¸fung mit DMTL: Anforderung zum Bestromen der Pumpe" UBYTE B_TRUE 1 100 0 1 BIT_MASK 0x1 FORMAT "%13.11" ECU_ADDRESS 0x3FC34D /end MEASUREMENT
/begin MEASUREMENT B_tldtevrq "Anforderung TEV-Pr¸fung mit DM-TL" UBYTE B_TRUE 1 100 0 1 BIT_MASK 0x1 FORMAT "%13.11" ECU_ADDRESS 0x3FC34E /end MEASUREMENT
/begin MEASUREMENT B_txdmts "Bedingung DMTL-Stop wegen Maximalzeit" UBYTE B_TRUE 1 100 0 1 BIT_MASK 0x40 FORMAT "%13.11" ECU_ADDRESS 0x403655 /end MEASUREMENT
/begin MEASUREMENT B_ubdmte "Bedingung DDMTL enabled bezueglich ub" UBYTE B_TRUE 1 100 0 1 BIT_MASK 0x80 FORMAT "%13.11" ECU_ADDRESS 0x403655 /end MEASUREMENT
/begin MEASUREMENT B_uk1 "Einschaltbedingung ‹bergangskompensation" UBYTE B_TRUE 1 100 0 1 BIT_MASK 0x1 FORMAT "%13.11" ECU_ADDRESS 0x3FC0BA /end MEASUREMENT
/begin MEASUREMENT B_uke "Einschaltbedingung ‹K-Ersatzwert" UBYTE B_TRUE 1 100 0 1 BIT_MASK 0x1 FORMAT "%13.11" ECU_ADDRESS 0x3FC0BB /end MEASUREMENT
/begin MEASUREMENT B_ukg "Bedingung ‹k wirkt stark" UBYTE B_TRUE 1 100 0 1 BIT_MASK 0x1 FORMAT "%13.11" ECU_ADDRESS 0x3FC0BC /end MEASUREMENT
/begin MEASUREMENT B_ukgdk "Bedingung ‹k wirkt stark" UBYTE dez 1 100 0 255 FORMAT "%5.1" ECU_ADDRESS 0x4037C1 /end MEASUREMENT
/begin MEASUREMENT B_ukk "Einschaltbedingung ‹K Kurzzeit-Anteil" UBYTE B_TRUE 1 100 0 1 BIT_MASK 0x1 FORMAT "%13.11" ECU_ADDRESS 0x3FC0BD /end MEASUREMENT
/begin MEASUREMENT B_ukkdk "Einschaltbedingung ‹K Kurzzeit-Anteil" UBYTE dez 1 100 0 255 FORMAT "%5.1" ECU_ADDRESS 0x4037C2 /end MEASUREMENT
/begin MEASUREMENT B_ukns "Einschaltbedingung ‹K nach Start" UBYTE B_TRUE 1 100 0 1 BIT_MASK 0x1 FORMAT "%13.11" ECU_ADDRESS 0x3FC0BE /end MEASUREMENT
/begin MEASUREMENT B_va "Bedingung Verzˆgerungsabmagerung (Anzeige)" UBYTE B_TRUE 1 100 0 1 BIT_MASK 0x1 FORMAT "%13.11" ECU_ADDRESS 0x3FC0BF /end MEASUREMENT
/begin MEASUREMENT B_vaau "Bedingung Verzˆgerungsabmagerung Aufteilung" UBYTE B_TRUE 1 100 0 1 BIT_MASK 0x1 FORMAT "%13.11" ECU_ADDRESS 0x3FC0C0 /end MEASUREMENT
/begin MEASUREMENT B_vaaudk "Bedingung Verzˆgerungsabmagerung Aufteilung" UBYTE dez 1 100 0 255 FORMAT "%5.1" ECU_ADDRESS 0x4037C3 /end MEASUREMENT
/begin MEASUREMENT B_vag "Bedingung starke Verzˆgerungsabmagerung" UBYTE B_TRUE 1 100 0 1 BIT_MASK 0x1 FORMAT "%13.11" ECU_ADDRESS 0x3FC0C1 /end MEASUREMENT
/begin MEASUREMENT B_vakl "Bedingung Verzˆgerungsabmagerung L- und K-Anteil" UBYTE B_TRUE 1 100 0 1 BIT_MASK 0x1 FORMAT "%13.11" ECU_ADDRESS 0x3FC0C2 /end MEASUREMENT
/begin MEASUREMENT B_vakldk "Bedingung Verzˆgerungsabmagerung L- und K-Anteil" UBYTE dez 1 100 0 255 FORMAT "%5.1" ECU_ADDRESS 0x4037C4 /end MEASUREMENT
/begin MEASUREMENT B_val "Bedingung Verzˆgerungsabmagerung L-Anteil" UBYTE B_TRUE 1 100 0 1 BIT_MASK 0x1 FORMAT "%13.11" ECU_ADDRESS 0x3FC0C3 /end MEASUREMENT
/begin MEASUREMENT B_valdk "" UBYTE dez 1 100 0 255 FORMAT "%5.1" ECU_ADDRESS 0x4037C5 /end MEASUREMENT
/begin MEASUREMENT B_vbemg "Bedingung Verbrennungserkennung mˆglich" UBYTE B_TRUE 1 100 0 1 BIT_MASK 0x1 FORMAT "%13.11" ECU_ADDRESS 0x3FC0B3 /end MEASUREMENT
/begin MEASUREMENT B_vbmg "Bedingung Verbrennung mˆglich" UBYTE B_TRUE 1 100 0 1 BIT_MASK 0x1 FORMAT "%13.11" ECU_ADDRESS 0x3FC0B4 /end MEASUREMENT
/begin MEASUREMENT B_vluft "Bedingung Verdacht auf nicht verbauterSonde im Abgasstrang" UBYTE B_TRUE 1 100 0 1 BIT_MASK 0x2 FORMAT "%13.11" ECU_ADDRESS 0x402B30 /end MEASUREMENT
/begin MEASUREMENT B_vluft2 "Bedingung Verdacht auf nicht verbauterSonde im Abgasstrang, Bank 2" UBYTE B_TRUE 1 100 0 1 BIT_MASK 0x20 FORMAT "%13.11" ECU_ADDRESS 0x402B30 /end MEASUREMENT
/begin MEASUREMENT B_vsa2an "" UBYTE B_TRUE 1 100 0 1 BIT_MASK 0x1 FORMAT "%13.11" ECU_ADDRESS 0x3FC35C /end MEASUREMENT
/begin MEASUREMENT B_vsa2nv "" UBYTE B_TRUE 1 100 0 1 BIT_MASK 0x1 FORMAT "%13.11" ECU_ADDRESS 0x3FC35D /end MEASUREMENT
/begin MEASUREMENT B_vsaadnok "Bedingung Anschlagadaption Auslasspreizung n.i.O." UBYTE B_TRUE 1 100 0 1 BIT_MASK 0x10 FORMAT "%13.11" ECU_ADDRESS 0x3FE375 /end MEASUREMENT
/begin MEASUREMENT B_vsaadok "" UBYTE B_TRUE 1 100 0 1 BIT_MASK 0x40 FORMAT "%13.11" ECU_ADDRESS 0x3FE375 /end MEASUREMENT
/begin MEASUREMENT B_vsaadp "Bedingung Anschlagadaption Auslasspreizung" UBYTE B_TRUE 1 100 0 1 BIT_MASK 0x1 FORMAT "%13.11" ECU_ADDRESS 0x3FE375 /end MEASUREMENT
/begin MEASUREMENT B_vsaflan "Bedingung neue NW-Flanke Auslasspreizung" UBYTE B_TRUE 1 100 0 1 BIT_MASK 0x20 FORMAT "%13.11" ECU_ADDRESS 0x3FE375 /end MEASUREMENT
/begin MEASUREMENT B_vsanwerr "Bedingung Fehler von der HW-Schale Auslasspreizung" UBYTE B_TRUE 1 100 0 1 BIT_MASK 0x2 FORMAT "%13.11" ECU_ADDRESS 0x3FE375 /end MEASUREMENT
/begin MEASUREMENT B_vsa_an "" UBYTE B_TRUE 1 100 0 1 BIT_MASK 0x1 FORMAT "%13.11" ECU_ADDRESS 0x3FC35E /end MEASUREMENT
/begin MEASUREMENT B_vsa_nv "" UBYTE B_TRUE 1 100 0 1 BIT_MASK 0x1 FORMAT "%13.11" ECU_ADDRESS 0x3FC35F /end MEASUREMENT
/begin MEASUREMENT B_vse2an "" UBYTE B_TRUE 1 100 0 1 BIT_MASK 0x1 FORMAT "%13.11" ECU_ADDRESS 0x3FC360 /end MEASUREMENT
/begin MEASUREMENT B_vse2nv "" UBYTE B_TRUE 1 100 0 1 BIT_MASK 0x1 FORMAT "%13.11" ECU_ADDRESS 0x3FC361 /end MEASUREMENT
/begin MEASUREMENT B_vseadnok "Bedingung Anschlagadaption Einlasspreizung n.i.O." UBYTE B_TRUE 1 100 0 1 BIT_MASK 0x10 FORMAT "%13.11" ECU_ADDRESS 0x3FE37F /end MEASUREMENT
/begin MEASUREMENT B_vseadok "Adaptionsendetimer abgelaufen" UBYTE B_TRUE 1 100 0 1 BIT_MASK 0x40 FORMAT "%13.11" ECU_ADDRESS 0x3FE37F /end MEASUREMENT
/begin MEASUREMENT B_vseadp "Bedingung Anschlagadaption Einlasspreizung" UBYTE B_TRUE 1 100 0 1 BIT_MASK 0x1 FORMAT "%13.11" ECU_ADDRESS 0x3FE37F /end MEASUREMENT
/begin MEASUREMENT B_vseflan "Bedingung neue NW-Flanke Einlasspreizung" UBYTE B_TRUE 1 100 0 1 BIT_MASK 0x20 FORMAT "%13.11" ECU_ADDRESS 0x3FE37F /end MEASUREMENT
/begin MEASUREMENT B_vsenwerr "Bedingung Fehler von der HW-Schale Einlasspreizung" UBYTE B_TRUE 1 100 0 1 BIT_MASK 0x2 FORMAT "%13.11" ECU_ADDRESS 0x3FE37F /end MEASUREMENT
/begin MEASUREMENT B_vse_an "Bedingung: E-Vanos am Anschlag" UBYTE B_TRUE 1 100 0 1 BIT_MASK 0x1 FORMAT "%13.11" ECU_ADDRESS 0x3FC362 /end MEASUREMENT
/begin MEASUREMENT B_vse_nv "Flag fuer Abspeicherung der Umgebungsbedingungen" UBYTE B_TRUE 1 100 0 1 BIT_MASK 0x1 FORMAT "%13.11" ECU_ADDRESS 0x3FC363 /end MEASUREMENT
/begin MEASUREMENT B_vvtiorem "Bedingung: VVT Notlauf i.O. zur Pr¸fung des letzten Fahrzyklusses" UBYTE B_TRUE 1 100 0 1 FORMAT "%13.11" ECU_ADDRESS 0x3FE13A /end MEASUREMENT
/begin MEASUREMENT B_vvtnlf "Bedingung Fehler beim VVT Notlauf" UBYTE B_TRUE 1 100 0 1 FORMAT "%13.11" ECU_ADDRESS 0x403791 /end MEASUREMENT
/begin MEASUREMENT B_vvtnlio "Bedingung VVT Notlauf i.o." UBYTE B_TRUE 1 100 0 1 FORMAT "%13.11" ECU_ADDRESS 0x403792 /end MEASUREMENT
/begin MEASUREMENT B_vvtnlrem "Bedingung: VVT Notlauf zur Pr¸fung des letzten Fahrzyklusses" UBYTE B_TRUE 1 100 0 1 FORMAT "%13.11" ECU_ADDRESS 0x3FE13B /end MEASUREMENT
/begin MEASUREMENT B_vvtnotl "Bedingung VVT-Notlauf" UBYTE B_TRUE 1 100 0 1 FORMAT "%13.11" ECU_ADDRESS 0x403793 /end MEASUREMENT
/begin MEASUREMENT B_vvtnotl1 "Bedingung VVT Notlauf Bank 1" UBYTE B_TRUE 1 100 0 1 FORMAT "%13.11" ECU_ADDRESS 0x402CE0 /end MEASUREMENT
/begin MEASUREMENT B_vvtnotl2 "Bedingung VVT Notlauf Bank 2" UBYTE B_TRUE 1 100 0 1 FORMAT "%13.11" ECU_ADDRESS 0x402CE1 /end MEASUREMENT
/begin MEASUREMENT B_vvtovlc "" UBYTE B_TRUE 1 100 0 1 FORMAT "%13.11" ECU_ADDRESS 0x402CE2 /end MEASUREMENT
/begin MEASUREMENT B_vvtovlc2 "" UBYTE B_TRUE 1 100 0 1 FORMAT "%13.11" ECU_ADDRESS 0x402CE3 /end MEASUREMENT
/begin MEASUREMENT B_vvttvnot "Ausgabe Tastverhaeltnis fuer Notlaufposition" UBYTE B_TRUE 1 100 0 1 FORMAT "%13.11" ECU_ADDRESS 0x402CE4 /end MEASUREMENT
/begin MEASUREMENT B_wf "Bedingung Wandfilmberechnung" UBYTE B_TRUE 1 100 0 1 BIT_MASK 0x1 FORMAT "%13.11" ECU_ADDRESS 0x3FC0C4 /end MEASUREMENT
/begin MEASUREMENT B_wks "Bedingung Wiederholkaltstart" UBYTE B_TRUE 1 100 0 1 BIT_MASK 0x1 FORMAT "%13.11" ECU_ADDRESS 0x3FC0B5 /end MEASUREMENT
/begin MEASUREMENT B_wst "Bedingung Wiederholstart" UBYTE B_TRUE 1 100 0 1 BIT_MASK 0x1 FORMAT "%13.11" ECU_ADDRESS 0x3FC0B6 /end MEASUREMENT
/begin MEASUREMENT B_wuc "Bedingung 'warm up cycle' erkannt" UBYTE B_TRUE 1 100 0 1 BIT_MASK 0x1 FORMAT "%13.11" ECU_ADDRESS 0x403B30 /end MEASUREMENT
/begin MEASUREMENT B_zkhimp "Bedingung : Bedingung hohe Impedanz im Z¸ndkreis" UBYTE default 1 100 0 1 FORMAT "%5.3" ARRAY_SIZE 8 ECU_ADDRESS 0x403A28 /end MEASUREMENT
/begin MEASUREMENT B_zkrlhmp "Bedingung hochimpedanter Z¸ndkreis relativ zu benachbarten Z¸ndkreisen" UBYTE default 1 100 0 1 FORMAT "%5.3" ARRAY_SIZE 8 ECU_ADDRESS 0x403A30 /end MEASUREMENT
/begin MEASUREMENT B_zkrlksub "Bedingung niederimpedanter Z¸ndkreis relativ zu benachbarten Z¸ndkreisen" UBYTE default 1 100 0 1 FORMAT "%5.3" ARRAY_SIZE 8 ECU_ADDRESS 0x403A38 /end MEASUREMENT
/begin MEASUREMENT ctrcfceosd "Aktivierungsz‰hler f¸r check-filler-cap bei Fahrt" UBYTE dez 1 100 0 255 FORMAT "%5.1" ECU_ADDRESS 0x40364A /end MEASUREMENT
/begin MEASUREMENT ctrcfcnl "Aktivierungsz‰hler f¸r Check-Filler-Cap im Nachlauf" UBYTE dez 1 100 0 255 FORMAT "%5.1" ECU_ADDRESS 0x40364B /end MEASUREMENT
/begin MEASUREMENT ctrdmtllhv "Aktivierungsz‰hler f¸r Heilungs- oder Verifizierungspr¸fung" UBYTE dez 1 100 0 255 FORMAT "%5.1" ECU_ADDRESS 0x40364C /end MEASUREMENT
/begin MEASUREMENT ctrfadmet "Aktivierungsz‰hler f¸r Endstufentest" UBYTE dez 1 100 0 255 FORMAT "%5.1" ECU_ADDRESS 0x40364D /end MEASUREMENT
/begin MEASUREMENT ctrfadmtg "Aktivierungsz‰hler f¸r Testeranforderung Grobleck (1.0mm)" UBYTE dez 1 100 0 255 FORMAT "%5.1" ECU_ADDRESS 0x40364E /end MEASUREMENT
/begin MEASUREMENT ctrfadmtl "Aktivierungsz‰hler f¸r Feinleck (0.5mm)" UBYTE dez 1 100 0 255 FORMAT "%5.1" ECU_ADDRESS 0x40364F /end MEASUREMENT
/begin MEASUREMENT ctrfleobd "Aktivierungsz‰hler f¸r Feinleckpr¸fung 0.5mm" UBYTE dez 1 100 0 255 FORMAT "%5.1" ECU_ADDRESS 0x403650 /end MEASUREMENT
/begin MEASUREMENT ctrfopr "Aktivierungsz‰hler f¸r Erst-Anforderung" UBYTE dez 1 100 0 255 FORMAT "%5.1" ECU_ADDRESS 0x403651 /end MEASUREMENT
/begin MEASUREMENT ctrgleobd "Aktivierungsz‰hler f¸r Grobleckpr¸fung (1.0mm)" UBYTE dez 1 100 0 255 FORMAT "%5.1" ECU_ADDRESS 0x403652 /end MEASUREMENT
/begin MEASUREMENT ctrprsen "Aktivierungsz‰hler f¸r Diagnose als Drucksensor" UBYTE dez 1 100 0 255 FORMAT "%5.1" ECU_ADDRESS 0x403653 /end MEASUREMENT
/begin MEASUREMENT cycle "Zykluszaehler Z¸ndungsdiagnose" UWORD dez 1 100 0 65535 FORMAT "%8.2" ECU_ADDRESS 0x404864 /end MEASUREMENT
/begin MEASUREMENT ddrkakdk_w "Zus‰tzliche Kurzzeiteinspritzung f¸r ESAK DK Anteil" SWORD rel_sw_b1536 1 100 -1536 1535.95 FORMAT "%8.3" ECU_ADDRESS 0x404022 /end MEASUREMENT
/begin MEASUREMENT ddrkakvt_w "Zus‰tzliche Kurzzeiteinspritzung f¸r ESAK VVT Anteil" SWORD rel_sw_b1536 1 100 -1536 1535.95 FORMAT "%8.3" ECU_ADDRESS 0x403FF6 /end MEASUREMENT
/begin MEASUREMENT dipttev_w "Stromdelta f¸r Erkennung TEV ˆffnet" UWORD i_q6p1035_uA 1 100 0 399.994 FORMAT "%8.4" ECU_ADDRESS 0x4035FC /end MEASUREMENT
/begin MEASUREMENT dme_errfb "Quittierung VVT Fehler" UBYTE DEZ 1 100 0 255 FORMAT "%5.1" ECU_ADDRESS 0x4038D0 /end MEASUREMENT
/begin MEASUREMENT dme_errfb2 "Quittierung VVT Fehler Bank 2" UBYTE DEZ 1 100 0 255 FORMAT "%5.1" ECU_ADDRESS 0x4038D1 /end MEASUREMENT
/begin MEASUREMENT dmidte "F¸llungs‰nderung bezogen auf Referenzwert" UWORD rel_uw_b100 1 100 0 99.9985 FORMAT "%8.5" ECU_ADDRESS 0x404318 /end MEASUREMENT
/begin MEASUREMENT dndte "Delta n bei Tankentl¸ftungsdiagnose" SWORD nmot_sw_q0p25 1 100 -8192 8191.75 FORMAT "%8.3" ECU_ADDRESS 0x40431A /end MEASUREMENT
/begin MEASUREMENT dnsdte "ƒnderung der Solldrehzahl bezogen auf Referenzwert" UBYTE nmot_ub_q10 1 100 0 2550 FORMAT "%5.0" ECU_ADDRESS 0x403D12 /end MEASUREMENT
/begin MEASUREMENT dpsdter_w "Tiefpaﬂgefilterter Saugrohrdruck Referenzwert" SWORD p_sw_q0p039 1 100 -1280 1279.96 FORMAT "%8.3" ECU_ADDRESS 0x404834 /end MEASUREMENT
/begin MEASUREMENT dpsdte_w "Tiefpaﬂgefilterter Saugrohrdruck" SWORD p_sw_q0p039 1 100 -1280 1279.96 FORMAT "%8.3" ECU_ADDRESS 0x404836 /end MEASUREMENT
/begin MEASUREMENT drkakdk_w "Speicher f¸r zusaetzliche Kraftstoffmasse aus ESAK DK Anteil" SWORD rel_sw_b1536 1 100 -1536 1535.95 FORMAT "%8.3" ECU_ADDRESS 0x404024 /end MEASUREMENT
/begin MEASUREMENT drkakvt_w "Speicher f¸r zusaetzliche Kraftstoffmasse aus ESAK VVT Anteil" SWORD rel_sw_b1536 1 100 -1536 1535.95 FORMAT "%8.3" ECU_ADDRESS 0x403FF8 /end MEASUREMENT
/begin MEASUREMENT drkuked_w "Delta relative Kraftstoffmasse Ersatzwert" UWORD rel_uw_q0p1875 1 100 0 12287.8 FORMAT "%8.2" ECU_ADDRESS 0x404026 /end MEASUREMENT
/begin MEASUREMENT drkuke_w "Delta relative Kraftstoffmasse Ersatzwert" UWORD rel_uw_q0p1875 1 100 0 12287.8 FORMAT "%8.2" ECU_ADDRESS 0x403FFA /end MEASUREMENT
/begin MEASUREMENT drlsoldk_seg "" SWORD rel_sw_b1536 1 100 -1536 1535.95 FORMAT "%8.3" ECU_ADDRESS 0x404028 /end MEASUREMENT
/begin MEASUREMENT drlsoldk_w "Gradient von rlsol gefilter ESAK DK Anteil" SWORD rel_sw_b1536 1 100 -1536 1535.95 FORMAT "%8.3" ECU_ADDRESS 0x40402A /end MEASUREMENT
/begin MEASUREMENT drlsolvt_seg "" SWORD rel_sw_b1536 1 100 -1536 1535.95 FORMAT "%8.3" ECU_ADDRESS 0x403FFC /end MEASUREMENT
/begin MEASUREMENT drlsolvt_w "Gradient von rlsol gefilter ESAK VVT Anteil" SWORD rel_sw_b1536 1 100 -1536 1535.95 FORMAT "%8.3" ECU_ADDRESS 0x403FFE /end MEASUREMENT
/begin MEASUREMENT DTEVNbits "" UBYTE dez 1 100 0 255 FORMAT "%5.1" ECU_ADDRESS 0x4035F4 /end MEASUREMENT
/begin MEASUREMENT dthsBits1_1000ms "" UBYTE dez 1 100 0 255 FORMAT "%5.1" ECU_ADDRESS 0x403748 /end MEASUREMENT
/begin MEASUREMENT dufbde_c "Zeitz‰hler zum Setzen der Zyklusflags der ‹ko-Diagnose bei BDE" UWORD t100msxs_uw_b6553p6 1 100 0 6553.5 FORMAT "%8.3" ECU_ADDRESS 0x403D78 /end MEASUREMENT
/begin MEASUREMENT duf_c "Zeitz‰hler f¸rs Setzen der Zyklusflags der Funktions¸berwachungs-Diagnose" UBYTE t100msxs_ub_b25p5 1 100 0 25.5 FORMAT "%5.2" ECU_ADDRESS 0x403A9C /end MEASUREMENT
/begin MEASUREMENT dv1vatf_w "gefilterte delta Fahrzeuggeschwindigkeit vfzgv1 zu vfzgat" UWORD vfzg_uw_b512 1 100 0 511.992 FORMAT "%8.4" ECU_ADDRESS 0x402C3C /end MEASUREMENT
/begin MEASUREMENT dvvterrq "VVT-Fehler Quittierung" UWORD DEZ 1 100 0 65535 FORMAT "%8.2" ECU_ADDRESS 0x404530 /end MEASUREMENT
/begin MEASUREMENT dvvterrq1 "" UWORD DEZ 1 100 0 65535 FORMAT "%8.2" ECU_ADDRESS 0x404532 /end MEASUREMENT
/begin MEASUREMENT dvvtmldif "ml Differenz zwischen Plausibisierung DK und HFM-Signal" SWORD m_sw_q0p1 1 100 -3276.8 3276.7 FORMAT "%8.3" ECU_ADDRESS 0x404534 /end MEASUREMENT
/begin MEASUREMENT dvvtnmx "Drehzahlbegrenzung durch VVT Fehler" UWORD nmot_uw_q0p25 1 100 0 16383.8 FORMAT "%8.2" ECU_ADDRESS 0x404536 /end MEASUREMENT
/begin MEASUREMENT dvvtpv_w "Druckverhaeltnis" UWORD fak_uw_b2 1 100 0 1.99997 FORMAT "%8.6" ECU_ADDRESS 0x404538 /end MEASUREMENT
/begin MEASUREMENT dvvtrlmx_w "Begrenzung relative Luftmasse durch VVT Fehler" UWORD rel_uw_q0p0234 1 100 0 1535.98 FORMAT "%8.3" ECU_ADDRESS 0x40453A /end MEASUREMENT
/begin MEASUREMENT dvvttestat "Status Testerfunktion" UBYTE DEZ 1 100 0 255 FORMAT "%5.1" ECU_ADDRESS 0x4038D2 /end MEASUREMENT
/begin MEASUREMENT dvvtwnkmx "Exzentersollwinkel durch VVT Fehler Bank1" UWORD wink_uw_q0p1 1 100 0 6553.5 FORMAT "%8.3" ECU_ADDRESS 0x40453C /end MEASUREMENT
/begin MEASUREMENT dvvtwnkmx2 "Exzentersollwinkel durch VVT Fehler Bank2" UWORD wink_uw_q0p1 1 100 0 6553.5 FORMAT "%8.3" ECU_ADDRESS 0x40453E /end MEASUREMENT
/begin MEASUREMENT dwfdk_w "Wandfilmmengendifferenz" SWORD rel_sw_q0p1875 1 100 -6144 6143.81 FORMAT "%8.3" ECU_ADDRESS 0x40402C /end MEASUREMENT
/begin MEASUREMENT dwfkdk_w "Wandfilmmengendifferenz Kurzzeitanteil" SWORD rel_sw_q0p1875 1 100 -6144 6143.81 FORMAT "%8.3" ECU_ADDRESS 0x40402E /end MEASUREMENT
/begin MEASUREMENT dwfk_w "Wandfilmmengendifferenz Kurzzeitanteil" SWORD rel_sw_q0p1875 1 100 -6144 6143.81 FORMAT "%8.3" ECU_ADDRESS 0x404000 /end MEASUREMENT
/begin MEASUREMENT dwfldk_w "Wandfilmmengendifferenz Langzeitanteil" SWORD rel_sw_q0p1875 1 100 -6144 6143.81 FORMAT "%8.3" ECU_ADDRESS 0x404030 /end MEASUREMENT
/begin MEASUREMENT dwfl_w "Wandfilmmengendifferenz Langzeitanteil" SWORD rel_sw_q0p1875 1 100 -6144 6143.81 FORMAT "%8.3" ECU_ADDRESS 0x404002 /end MEASUREMENT
/begin MEASUREMENT dwf_w "Wandfilmmengendifferenz" SWORD rel_sw_q0p1875 1 100 -6144 6143.81 FORMAT "%8.3" ECU_ADDRESS 0x404004 /end MEASUREMENT
/begin MEASUREMENT dzadrbuf0 "Adresspuffer 0 Entprellung Z¸ndungsdiagnose" UBYTE default 1 100 0 255 FORMAT "%5.1" ECU_ADDRESS 0x403A40 /end MEASUREMENT
/begin MEASUREMENT dzdmdzhl "Pufferwert des Aussetzerz‰hlers" SWORD dez 1 100 -32767 32767 FORMAT "%8.2" ARRAY_SIZE 8 ECU_ADDRESS 0x404866 /end MEASUREMENT
/begin MEASUREMENT dzhksubzl "Entprellz‰hler harte Ub Kurzschluss" UBYTE dez 1 100 0 255 FORMAT "%5.1" ARRAY_SIZE 8 ECU_ADDRESS 0x403A41 /end MEASUREMENT
/begin MEASUREMENT dzkanal "Aktuelle Z¸ndkreisnummer" UBYTE dez 1 100 0 255 FORMAT "%5.1" ECU_ADDRESS 0x403A49 /end MEASUREMENT
/begin MEASUREMENT dzksubzl "Entprellz‰hler Kurzschluﬂ nach Ub" UBYTE dez 1 100 0 255 FORMAT "%5.1" ARRAY_SIZE 8 ECU_ADDRESS 0x403A4A /end MEASUREMENT
/begin MEASUREMENT dzksubzlrl "Entprellz‰hler niederimpedanter Prim‰rkreis relativ zu Nachbarstromkreisen" UBYTE dez 1 100 0 255 FORMAT "%5.1" ARRAY_SIZE 8 ECU_ADDRESS 0x403A52 /end MEASUREMENT
/begin MEASUREMENT dzkub "Pufferwert von Ub" UBYTE spg_ubatt 1 100 0 19.4052 FORMAT "%5.2" ECU_ADDRESS 0x403A5A /end MEASUREMENT
/begin MEASUREMENT dzotpzhl "Entprellz‰hler ‹bertemperaturfehler" UBYTE dez 1 100 0 255 FORMAT "%5.1" ARRAY_SIZE 8 ECU_ADDRESS 0x403A5B /end MEASUREMENT
/begin MEASUREMENT dztimzhl "Entprellz‰hler timeout Fehler" UBYTE dez 1 100 0 255 FORMAT "%5.1" ARRAY_SIZE 8 ECU_ADDRESS 0x403A63 /end MEASUREMENT
/begin MEASUREMENT ebdmtlAusBits "" UBYTE dez 1 100 0 255 FORMAT "%5.1" ECU_ADDRESS 0x403654 /end MEASUREMENT
/begin MEASUREMENT ebdmtlAusBits2 "" UBYTE dez 1 100 0 255 FORMAT "%5.1" ECU_ADDRESS 0x403655 /end MEASUREMENT
/begin MEASUREMENT ebdmtlAusBitsNov "" UBYTE dez 1 100 0 255 FORMAT "%5.1" ECU_ADDRESS 0x3FE2CB /end MEASUREMENT
/begin MEASUREMENT ebdmtlLokBits "" UBYTE dez 1 100 0 255 FORMAT "%5.1" ECU_ADDRESS 0x403656 /end MEASUREMENT
/begin MEASUREMENT ebdmtlLokBitsNov "" UBYTE dez 1 100 0 255 FORMAT "%5.1" ECU_ADDRESS 0x3FE2CC /end MEASUREMENT
/begin MEASUREMENT egaspfad "EGAS-Pfad als Umweltbedingung f¸r Funktions¸berwachungs-Diagnoseeintrag" UBYTE dez 1 100 0 255 FORMAT "%5.1" ECU_ADDRESS 0x403A9D /end MEASUREMENT
/begin MEASUREMENT ei_dufska "Diagnose ‹berwachungsfunktion hat den 1. Fehler irreversible SKA gespeichert" UBYTE B_TRUE 1 100 0 1 BIT_MASK 0x1 FORMAT "%13.11" ECU_ADDRESS 0x3FBECF /end MEASUREMENT
/begin MEASUREMENT errorCntAskTcsort "" UBYTE dez 1 100 0 255 FORMAT "%5.1" ECU_ADDRESS 0x40284B /end MEASUREMENT
/begin MEASUREMENT ESSTTbits "Bits zur Funktion Start" UBYTE dez 1 100 0 255 FORMAT "%5.1" ECU_ADDRESS 0x3FE16C /end MEASUREMENT
/begin MEASUREMENT esvw_bit "" UBYTE dez 1 100 0 255 FORMAT "%5.1" ECU_ADDRESS 0x4038FF /end MEASUREMENT
/begin MEASUREMENT evdmtbc_w "Einschaltmatrix: Grundbedingungen" UWORD dez 1 100 0 65535 FORMAT "%8.2" ECU_ADDRESS 0x40361C /end MEASUREMENT
/begin MEASUREMENT evdmtcp_w "Einschaltmatrix: Bedingungen f¸r Komponentenschutz" UWORD dez 1 100 0 65535 FORMAT "%8.2" ECU_ADDRESS 0x40361E /end MEASUREMENT
/begin MEASUREMENT evdmtec_w "Einschaltmatrix: Umgebungsbedingungen" UWORD dez 1 100 0 65535 FORMAT "%8.2" ECU_ADDRESS 0x403620 /end MEASUREMENT
/begin MEASUREMENT evdmtfa_w "Einschaltmatrix: Bedingungen f¸r Funktionsanforderung" UWORD dez 1 100 0 65535 FORMAT "%8.2" ECU_ADDRESS 0x403622 /end MEASUREMENT
/begin MEASUREMENT evdmtkl_w "Einschaltmatrix: Zustand Z¸ndung an - Motor aus" UWORD dez 1 100 0 65535 FORMAT "%8.2" ECU_ADDRESS 0x403624 /end MEASUREMENT
/begin MEASUREMENT evdmtmo_w "Einschaltmatrix: Bedingung MIL-Status" UWORD dez 1 100 0 65535 FORMAT "%8.2" ECU_ADDRESS 0x403626 /end MEASUREMENT
/begin MEASUREMENT evdmtnl_w "Einschaltmatrix: Zustand Nachlauf" UWORD dez 1 100 0 65535 FORMAT "%8.2" ECU_ADDRESS 0x403628 /end MEASUREMENT
/begin MEASUREMENT evdmtnmt_w "Einschaltmatrix: Motorlauf" UWORD dez 1 100 0 65535 FORMAT "%8.2" ECU_ADDRESS 0x40362A /end MEASUREMENT
/begin MEASUREMENT evdmtoc_w "Einschaltmatrix: Betriebsbedingungen" UWORD dez 1 100 0 65535 FORMAT "%8.2" ECU_ADDRESS 0x40362C /end MEASUREMENT
/begin MEASUREMENT exwnkiloc "" UWORD wink_uw_q0p1 1 100 0 6553.5 FORMAT "%8.3" ECU_ADDRESS 0x404540 /end MEASUREMENT
/begin MEASUREMENT exwnkrbt_w "" UWORD wink_uw_q0p1 1 100 0 6553.5 FORMAT "%8.3" ECU_ADDRESS 0x402CF0 /end MEASUREMENT
/begin MEASUREMENT exwnksbt_w "" UWORD wink_uw_q0p1 1 100 0 6553.5 FORMAT "%8.3" ECU_ADDRESS 0x402CF2 /end MEASUREMENT
/begin MEASUREMENT E_OS_LIMIT_ctr "" ULONG dez 1 100 0 4.29497e+009 FORMAT "%13.2" ECU_ADDRESS 0x4048C0 /end MEASUREMENT
/begin MEASUREMENT E_ph2loc "" UBYTE B_TRUE 1 100 0 1 FORMAT "%13.11" ECU_ADDRESS 0x402CE5 /end MEASUREMENT
/begin MEASUREMENT E_ph3loc "" UBYTE B_TRUE 1 100 0 1 FORMAT "%13.11" ECU_ADDRESS 0x402CE6 /end MEASUREMENT
/begin MEASUREMENT E_ph4loc "" UBYTE B_TRUE 1 100 0 1 FORMAT "%13.11" ECU_ADDRESS 0x402CE7 /end MEASUREMENT
/begin MEASUREMENT E_tevddmtl "TEV-Fehler w‰hrend DDMTL erkannt" UBYTE dez 1 100 0 255 FORMAT "%5.1" ECU_ADDRESS 0x403D15 /end MEASUREMENT
/begin MEASUREMENT E_vvt_hub "" UBYTE B_TRUE 1 100 0 1 FORMAT "%13.11" ECU_ADDRESS 0x402CE8 /end MEASUREMENT
/begin MEASUREMENT E_vvt_vsa "" UBYTE B_TRUE 1 100 0 1 FORMAT "%13.11" ECU_ADDRESS 0x402CE9 /end MEASUREMENT
/begin MEASUREMENT E_vvt_vse "" UBYTE B_TRUE 1 100 0 1 FORMAT "%13.11" ECU_ADDRESS 0x402CEA /end MEASUREMENT
/begin MEASUREMENT E_vvt_zw "Notlaufbetrieb Zuendwinkelverstellung" UBYTE B_TRUE 1 100 0 1 FORMAT "%13.11" ECU_ADDRESS 0x402CEB /end MEASUREMENT
/begin MEASUREMENT fbakldk_w "Faktor K- und L-Anteil der ‹K bei BA" SWORD fak_sw_b256 1 100 -256 255.992 FORMAT "%8.4" ECU_ADDRESS 0x402D98 /end MEASUREMENT
/begin MEASUREMENT fbakl_w "Faktor K- und L-Anteil der ‹K bei BA" SWORD fak_sw_b256 1 100 -256 255.992 FORMAT "%8.4" ECU_ADDRESS 0x402D88 /end MEASUREMENT
/begin MEASUREMENT fbans "Nachstartfaktor der ‹K bei BA" UBYTE fak_ub_b8 1 100 0 7.96875 FORMAT "%5.3" ECU_ADDRESS 0x402D84 /end MEASUREMENT
/begin MEASUREMENT fbansdk "Nachstartfaktor der ‹K bei BA" UBYTE fak_ub_b8 1 100 0 7.96875 FORMAT "%5.3" ECU_ADDRESS 0x402D94 /end MEASUREMENT
/begin MEASUREMENT fbansdk_w "" UWORD fak_uw_b8 1 100 0 7.99988 FORMAT "%8.6" ECU_ADDRESS 0x402D9A /end MEASUREMENT
/begin MEASUREMENT fbans_w "Nachstartfaktor der ‹K bei BA" UWORD fak_uw_b8 1 100 0 7.99988 FORMAT "%8.6" ECU_ADDRESS 0x402D8A /end MEASUREMENT
/begin MEASUREMENT fbavst_w "Faktor ‹K-Verstellung bei Beschleunigungsanreicherung" SWORD fak_sw_b256 1 100 -256 255.992 FORMAT "%8.4" ECU_ADDRESS 0x402D8C /end MEASUREMENT
/begin MEASUREMENT ffzdfp "Fehlerpfadidentifikationsnummer (dfp) zum Freeze-Frame Zero" UBYTE dez 1 100 0 255 FORMAT "%5.1" ECU_ADDRESS 0x403B2F /end MEASUREMENT
/begin MEASUREMENT fgru "Faktor Grundvorsteuerung" UBYTE fak_ub_b2 1 100 0 1.99219 FORMAT "%5.3" ECU_ADDRESS 0x402D80 /end MEASUREMENT
/begin MEASUREMENT fktns "Nachstartanhebung" UBYTE fak_ub_b4 1 100 0 3.98438 FORMAT "%5.3" ECU_ADDRESS 0x403BCE /end MEASUREMENT
/begin MEASUREMENT fns "Faktor Nachstart" UBYTE fak_ub_b4 1 100 0 3.98438 FORMAT "%5.3" ECU_ADDRESS 0x403BCF /end MEASUREMENT
/begin MEASUREMENT fst0_w "Vorgesteuerter Startfaktor 16 Bit" UWORD fak_uw_b64 1 100 0 63.999 FORMAT "%8.5" ECU_ADDRESS 0x403FF0 /end MEASUREMENT
/begin MEASUREMENT fst_w "Faktor Starteinspritzung" UWORD fak_uw_b64 1 100 0 63.999 FORMAT "%8.5" ECU_ADDRESS 0x403FF2 /end MEASUREMENT
/begin MEASUREMENT fvakldk_w "Faktor K- und L-Anteil der ‹K bei VA" SWORD fak_sw_b256 1 100 -256 255.992 FORMAT "%8.4" ECU_ADDRESS 0x402D9C /end MEASUREMENT
/begin MEASUREMENT fvakl_w "Faktor K- und L-Anteil der ‹K bei VA" SWORD fak_sw_b256 1 100 -256 255.992 FORMAT "%8.4" ECU_ADDRESS 0x402D8E /end MEASUREMENT
/begin MEASUREMENT fvans "Nachstartfaktor der ‹K bei VA" UBYTE fak_ub_b8 1 100 0 7.96875 FORMAT "%5.3" ECU_ADDRESS 0x402D85 /end MEASUREMENT
/begin MEASUREMENT fvansdk "Nachstartfaktor der ‹K bei VA" UBYTE fak_ub_b8 1 100 0 7.96875 FORMAT "%5.3" ECU_ADDRESS 0x402D95 /end MEASUREMENT
/begin MEASUREMENT fvavst_w "Faktor ‹K-Verstellung bei Verzˆgerungsabmagerung" SWORD fak_sw_b256 1 100 -256 255.992 FORMAT "%8.4" ECU_ADDRESS 0x402D90 /end MEASUREMENT
/begin MEASUREMENT fwe "Faktor Wiedereinsetzen" UBYTE fak_ub_b2 1 100 0 1.99219 FORMAT "%5.3" ECU_ADDRESS 0x403BDB /end MEASUREMENT
/begin MEASUREMENT fzans1 "Faktor Abregelung Nachstart ohne Ber¸cksichtigung des Startmengenadaptionswerts" UBYTE fak_ub_b0p25 1 100 0 0.249023 FORMAT "%11.9" ECU_ADDRESS 0x403BD0 /end MEASUREMENT
/begin MEASUREMENT fzans1vt "Faktor Abregelung Nachst ohne Ber¸cksichtigung Startmengenadaptionsw. VVT-Betr" UBYTE fak_ub_b0p25 1 100 0 0.249023 FORMAT "%11.9" ECU_ADDRESS 0x403BD1 /end MEASUREMENT
/begin MEASUREMENT fzans2 "Faktor Abregelung Nachstart mit Ber¸cksichtigung des Startmengenadaptionswerts" UBYTE fak_ub_b0p25 1 100 0 0.249023 FORMAT "%11.9" ECU_ADDRESS 0x403BD2 /end MEASUREMENT
/begin MEASUREMENT fzaold_w "Pufferwert des DMD Z‰hlers" UWORD dez 1 100 0 1000 FORMAT "%8.3" ARRAY_SIZE 8 ECU_ADDRESS 0x404876 /end MEASUREMENT
/begin MEASUREMENT hubbegr "Hub-Begrenzung" UWORD hub_uw_q0p001 1 100 0 65.535 FORMAT "%8.5" ECU_ADDRESS 0x402CF4 /end MEASUREMENT
/begin MEASUREMENT idps_w "Integrierter Tiefpaﬂgefilterter Saugrohrdruck" SWORD p_sw_q0p156 1 100 -5120 5119.84 FORMAT "%8.3" ECU_ADDRESS 0x404838 /end MEASUREMENT
/begin MEASUREMENT indte "Integrierte Drehzahl‰nderung" SWORD nmot_sw_q0p25 1 100 -8192 8191.75 FORMAT "%8.3" ECU_ADDRESS 0x40431C /end MEASUREMENT
/begin MEASUREMENT ipttev_w "Referenzstromschwelle f¸r Tevcheck" UWORD i_q6p1035_uA 1 100 0 399.994 FORMAT "%8.4" ECU_ADDRESS 0x4035FE /end MEASUREMENT
/begin MEASUREMENT lamns_w "Lambda-Motor-Soll f¸r Nachstart" UWORD fak_uw_b16 1 100 0 15.9998 FORMAT "%8.5" ECU_ADDRESS 0x403FEE /end MEASUREMENT
/begin MEASUREMENT lurvvtstat "VVT-NL Status" UBYTE DEZ 1 100 0 255 FORMAT "%5.1" ECU_ADDRESS 0x4038D3 /end MEASUREMENT
/begin MEASUREMENT m6cthm "Mode 6 - Speicher: Component ID f¸r Thermostat-Monitoring" UBYTE DEZ 1 100 0 255 FORMAT "%5.1" ECU_ADDRESS 0x3FE3AC /end MEASUREMENT
/begin MEASUREMENT m6sthm_w "Mode 6 - Speicher: Schwellwert f¸r Thermostat-Monitoring" UWORD temp_uw_q0p75_o48 1 100 0 65535 FORMAT "%8.2" ECU_ADDRESS 0x3FE3A8 /end MEASUREMENT
/begin MEASUREMENT m6wthm_w "Mode 6 - Speicher: Meﬂwert f¸r Thermostat-Monitoring" UWORD temp_uw_q0p75_o48 1 100 0 65535 FORMAT "%8.2" ECU_ADDRESS 0x3FE3AA /end MEASUREMENT
/begin MEASUREMENT midter "" UWORD rel_uw_b100 1 100 0 99.9985 FORMAT "%8.5" ECU_ADDRESS 0x40431E /end MEASUREMENT
/begin MEASUREMENT minhubvsnv "Dauerhaft programmierter Minhub" UWORD hub_uw_q0p001 1 100 0 65.535 FORMAT "%8.5" ECU_ADDRESS 0x3FE916 /end MEASUREMENT
/begin MEASUREMENT mi_duf "Istmoment beim Ansprechen des Momentenvergleichs in der Funktions¸berwachung" UBYTE rel_ub_b99p6 1 100 0 99.6094 FORMAT "%5.2" ECU_ADDRESS 0x403A9E /end MEASUREMENT
/begin MEASUREMENT mode "Motorbetriebszustand f¸r Tankleckdiagnose" UBYTE dez 1 100 0 255 FORMAT "%5.1" ECU_ADDRESS 0x403657 /end MEASUREMENT
/begin MEASUREMENT mpfad "Momenten-Pfad in Funktion und Funktions¸berwachung als Umweltbedingung f¸r Diag." UBYTE dez 1 100 0 255 FORMAT "%5.1" ECU_ADDRESS 0x403A9F /end MEASUREMENT
/begin MEASUREMENT mvdtehp "Hochpaﬂgefiltertes Verlustmoment" UWORD rel_uw_b100 1 100 0 99.9985 FORMAT "%8.5" ECU_ADDRESS 0x404320 /end MEASUREMENT
/begin MEASUREMENT nglact "Anzahl angeforderter Groblecktests" UBYTE dez 1 100 0 255 FORMAT "%5.1" ECU_ADDRESS 0x3FE2CD /end MEASUREMENT
/begin MEASUREMENT ngltdca "Anzahl abgebrochener check filler cap Pr¸fungen" UBYTE dez 1 100 0 255 FORMAT "%5.1" ECU_ADDRESS 0x3FE2CE /end MEASUREMENT
/begin MEASUREMENT ngltdcw "Anzahl wiederholter check filler cap Pr¸fungen" UBYTE dez 1 100 0 255 FORMAT "%5.1" ECU_ADDRESS 0x3FE2CF /end MEASUREMENT
/begin MEASUREMENT nkfl "Anzahl abgebrochener Leckmessungen wegen Stromschwankungen" UBYTE dez 1 100 0 255 FORMAT "%5.1" ECU_ADDRESS 0x3FE2D0 /end MEASUREMENT
/begin MEASUREMENT nsactr "Nachstartcounter" UBYTE fak_ub_b2 1 100 0 1.99219 FORMAT "%5.3" ECU_ADDRESS 0x403BD3 /end MEASUREMENT
/begin MEASUREMENT nsactr1 "Nachstartcounter ohne Ber¸cksichtigung des Startmengenadaptionswerts" UBYTE fak_ub_b2 1 100 0 1.99219 FORMAT "%5.3" ECU_ADDRESS 0x403BD4 /end MEASUREMENT
/begin MEASUREMENT nsactr1vt "Nachstartcounter ohne Ber¸cksichtigung des Startmengenadaptionswerts VVT-Betrieb" UBYTE fak_ub_b2 1 100 0 1.99219 FORMAT "%5.3" ECU_ADDRESS 0x403BD5 /end MEASUREMENT
/begin MEASUREMENT nsactr2 "Nachstartcounter mit Ber¸cksichtigung des Startmengenadaptionswerts" UBYTE fak_ub_b2 1 100 0 1.99219 FORMAT "%5.3" ECU_ADDRESS 0x403BD6 /end MEASUREMENT
/begin MEASUREMENT nsdter "Solldrehzahl Referenz" UBYTE nmot_ub_q10 1 100 0 2550 FORMAT "%5.0" ECU_ADDRESS 0x403D13 /end MEASUREMENT
/begin MEASUREMENT ntpdte "Tiefpaﬂgefilterte Drehzahl" UWORD nmot_uw_q0p25 1 100 0 16383.8 FORMAT "%8.2" ECU_ADDRESS 0x404322 /end MEASUREMENT
/begin MEASUREMENT ntpdter "Tiefpaﬂgefilterte Drehzahl, Referenzwert" UWORD nmot_uw_q0p25 1 100 0 16383.8 FORMAT "%8.2" ECU_ADDRESS 0x404324 /end MEASUREMENT
/begin MEASUREMENT Nw_pos "Nockenwellenposition variable NWS" UWORD sprzi_q0p1 1 100 0 6553.5 FORMAT "%8.3" ARRAY_SIZE 4 ECU_ADDRESS 0x4036A8 /end MEASUREMENT
/begin MEASUREMENT reqdmtl_w "Wort der physikalisch laufbereiten und freigegebenen Diagnosen" UWORD dez 1 100 0 65535 FORMAT "%8.2" ECU_ADDRESS 0x40362E /end MEASUREMENT
/begin MEASUREMENT rkakdk_w "Zusaetzliche Kurzzeiteinspritzung gewichtet f¸r ESAK DK Anteil" SWORD rel_sw_b1536 1 100 -1536 1535.95 FORMAT "%8.3" ECU_ADDRESS 0x404032 /end MEASUREMENT
/begin MEASUREMENT rkakvvt_w "Zusaetzliche Kurzzeiteinspritzung gewichtet f¸r ESAK VVT Anteil" SWORD rel_sw_b1536 1 100 -1536 1535.95 FORMAT "%8.3" ECU_ADDRESS 0x404006 /end MEASUREMENT
/begin MEASUREMENT rkukdk_w "rel. Kraftstoffmasse ‹bergangskompensation ohne Verstelleingriffe" SWORD rel_sw_q0p1875 1 100 -6144 6143.81 FORMAT "%8.3" ECU_ADDRESS 0x404034 /end MEASUREMENT
/begin MEASUREMENT rkukdps_w "" SWORD rel_sw_q0p1875 1 100 -6144 6143.81 FORMAT "%8.3" ECU_ADDRESS 0x404008 /end MEASUREMENT
/begin MEASUREMENT rkukedk_w "rel. Kraftstoffmasse ‹bergangskompensation Ersatzwert" SWORD rel_sw_q0p1875 1 100 -6144 6143.81 FORMAT "%8.3" ECU_ADDRESS 0x404036 /end MEASUREMENT
/begin MEASUREMENT rkuke_w "rel. Kraftstoffmasse ‹bergangskompensation Ersatzwert" SWORD rel_sw_q0p1875 1 100 -6144 6143.81 FORMAT "%8.3" ECU_ADDRESS 0x40400A /end MEASUREMENT
/begin MEASUREMENT rkukgdk_w "" SWORD rel_sw_b1536 1 100 -1536 1535.95 FORMAT "%8.3" ECU_ADDRESS 0x404038 /end MEASUREMENT
/begin MEASUREMENT rkukgvt_w "Gesamter Anteil Kraftstoffmasse ‹bergangskompensation VVT Anteil" SWORD rel_sw_b1536 1 100 -1536 1535.95 FORMAT "%8.3" ECU_ADDRESS 0x40400C /end MEASUREMENT
/begin MEASUREMENT rkukg_w "rel. Kraftstoffmasse ‹bergangskompensation" SWORD rel_sw_b1536 1 100 -1536 1535.95 FORMAT "%8.3" ECU_ADDRESS 0x40400E /end MEASUREMENT
/begin MEASUREMENT rkukkdk_w "rk-Kurzzeitanteil der UK" SWORD rel_sw_q0p1875 1 100 -6144 6143.81 FORMAT "%8.3" ECU_ADDRESS 0x40403A /end MEASUREMENT
/begin MEASUREMENT rkukkld_w "Kurz- und Langzeitanteil der UK" SWORD rel_sw_q0p1875 1 100 -6144 6143.81 FORMAT "%8.3" ECU_ADDRESS 0x40403C /end MEASUREMENT
/begin MEASUREMENT rkukkl_w "Kurz- und Langzeitanteil der UK" SWORD rel_sw_q0p1875 1 100 -6144 6143.81 FORMAT "%8.3" ECU_ADDRESS 0x404010 /end MEASUREMENT
/begin MEASUREMENT rkukk_w "rk-Kurzzeitanteil der UK" SWORD rel_sw_q0p1875 1 100 -6144 6143.81 FORMAT "%8.3" ECU_ADDRESS 0x404012 /end MEASUREMENT
/begin MEASUREMENT rkukldk_w "rk-Langzeitanteil der UK" SWORD rel_sw_q0p1875 1 100 -6144 6143.81 FORMAT "%8.3" ECU_ADDRESS 0x40403E /end MEASUREMENT
/begin MEASUREMENT rkukl_w "rk-Langzeitanteil der UK" SWORD rel_sw_q0p1875 1 100 -6144 6143.81 FORMAT "%8.3" ECU_ADDRESS 0x404014 /end MEASUREMENT
/begin MEASUREMENT rkuk_w "rel. Kraftstoffmasse ‹bergangskompensation ohne Verstelleingriffe" SWORD rel_sw_q0p1875 1 100 -6144 6143.81 FORMAT "%8.3" ECU_ADDRESS 0x404016 /end MEASUREMENT
/begin MEASUREMENT rldkw_w "" UWORD rel_uw_q0p0234 1 100 0 1535.98 FORMAT "%8.3" ECU_ADDRESS 0x404040 /end MEASUREMENT
/begin MEASUREMENT rlsolfdk_w "rlsol gefiltert fuer den ESAK DK Anteil" UWORD rel_uw_q0p0234 1 100 0 1535.98 FORMAT "%8.3" ECU_ADDRESS 0x404042 /end MEASUREMENT
/begin MEASUREMENT rlsolfvt_w "rlsol gefiltert fuer den ESAK VVT Anteil" UWORD rel_uw_q0p0234 1 100 0 1535.98 FORMAT "%8.3" ECU_ADDRESS 0x404018 /end MEASUREMENT
/begin MEASUREMENT rlvtw_w "" UWORD rel_uw_q0p0234 1 100 0 1535.98 FORMAT "%8.3" ECU_ADDRESS 0x40401A /end MEASUREMENT
/begin MEASUREMENT rqdmtl2_w "physikalisch laufbereite Diagnose (nach Bitshift)" UWORD dez 1 100 0 65535 FORMAT "%8.2" ECU_ADDRESS 0x403630 /end MEASUREMENT
/begin MEASUREMENT rqdmtlo_w "physikalisch laufbereite Leckdiagnosen (alter Wert)" UWORD dez 1 100 0 65535 FORMAT "%8.2" ECU_ADDRESS 0x403632 /end MEASUREMENT
/begin MEASUREMENT rqdmtlt_w "physikalisch laufbereite Diagnose vor DSM-Freigabe" UWORD dez 1 100 0 65535 FORMAT "%8.2" ECU_ADDRESS 0x403634 /end MEASUREMENT
/begin MEASUREMENT rstMon_um "" UWORD dez 1 100 0 65535 FORMAT "%8.2" ECU_ADDRESS 0x3F9818 /end MEASUREMENT
/begin MEASUREMENT rstpfad "Reset-Pfad als Umweltbedingung f¸r Rechner¸berwachungs-Diagnoseeintrag" UBYTE dez 1 100 0 255 FORMAT "%5.1" ECU_ADDRESS 0x403A7D /end MEASUREMENT
/begin MEASUREMENT sbcldmtl_w "Codewort f¸r Stopmatrix: Abbruch bei Fehlerspeicher-Lˆschen" UWORD dez 1 100 0 65535 FORMAT "%8.2" ECU_ADDRESS 0x403636 /end MEASUREMENT
/begin MEASUREMENT sbdmtirq_w "Codewort f¸r Stopmatrix: Abbruch bei ÷ffnen der Tankklappe" UWORD dez 1 100 0 65535 FORMAT "%8.2" ECU_ADDRESS 0x403638 /end MEASUREMENT
/begin MEASUREMENT sbdmtsh_w "Control word for stop diagnosis due to steep hill condition" UWORD dez 1 100 0 65535 FORMAT "%8.2" ECU_ADDRESS 0x40363A /end MEASUREMENT
/begin MEASUREMENT sbdpf_w "Codewort f¸r Stopmatrix: Abbruch bei Stromschwankungen durch Feuchte" UWORD dez 1 100 0 65535 FORMAT "%8.2" ECU_ADDRESS 0x40363C /end MEASUREMENT
/begin MEASUREMENT sbdtetd_w "Steuerwort f¸r Stopp der Diagnose bei Tankdeckel ˆffnen" UWORD dez 1 100 0 65535 FORMAT "%8.2" ECU_ADDRESS 0x40363E /end MEASUREMENT
/begin MEASUREMENT sbdtetk_w "Steuerwort f¸r Stopp der Diagnose bei Betankungserkennung" UWORD dez 1 100 0 65535 FORMAT "%8.2" ECU_ADDRESS 0x403640 /end MEASUREMENT
/begin MEASUREMENT sbdubtes_w "Codewort f¸r Stopmatrix: Abbruch bei Batteriespannungsschwankungen" UWORD dez 1 100 0 65535 FORMAT "%8.2" ECU_ADDRESS 0x403642 /end MEASUREMENT
/begin MEASUREMENT sbtehb_w "Steuerwort f¸r Stopp der Diagnose bei hoher AKF-Beladung" UWORD dez 1 100 0 65535 FORMAT "%8.2" ECU_ADDRESS 0x403644 /end MEASUREMENT
/begin MEASUREMENT sbtxdmts_w "Codewort f¸r Stopmatrix: Abbruch bei ‹berschreiten maximaler Diagnosedauer" UWORD dez 1 100 0 65535 FORMAT "%8.2" ECU_ADDRESS 0x403646 /end MEASUREMENT
/begin MEASUREMENT sdwfkdk_w "Speicherinhalt der Wandfilmdifferenz f¸r Kurzzeitanteil" SWORD rel_sw_q0p1875 1 100 -6144 6143.81 FORMAT "%8.3" ECU_ADDRESS 0x404044 /end MEASUREMENT
/begin MEASUREMENT sdwfk_w "Speicherinhalt der Wandfilmdifferenz f¸r Kurzzeitanteil" SWORD rel_sw_q0p1875 1 100 -6144 6143.81 FORMAT "%8.3" ECU_ADDRESS 0x40401C /end MEASUREMENT
/begin MEASUREMENT sdwfldk_w "Speicherinhalt der Wandfilmdifferenz f¸r Langzeitanteil" SWORD rel_sw_q0p1875 1 100 -6144 6143.81 FORMAT "%8.3" ECU_ADDRESS 0x404046 /end MEASUREMENT
/begin MEASUREMENT sdwfl_w "Speicherinhalt der Wandfilmdifferenz f¸r Langzeitanteil" SWORD rel_sw_q0p1875 1 100 -6144 6143.81 FORMAT "%8.3" ECU_ADDRESS 0x40401E /end MEASUREMENT
/begin MEASUREMENT skapfad "SKA-Pfad als Umweltbedingung f¸r Funktions¸berwachungs-Diagnoseeintrag" UBYTE dez 1 100 0 255 FORMAT "%5.1" ECU_ADDRESS 0x403AA0 /end MEASUREMENT
/begin MEASUREMENT stcfceosd "Stopz‰hler f¸r Check Filler Cap Pr¸fung bei Fahrt" UBYTE dez 1 100 0 255 FORMAT "%5.1" ECU_ADDRESS 0x3FE2D1 /end MEASUREMENT
/begin MEASUREMENT stcfcnl "Stopz‰hler f¸r Check Filler Cap Pr¸fung im Nachlauf" UBYTE dez 1 100 0 255 FORMAT "%5.1" ECU_ADDRESS 0x3FE2D2 /end MEASUREMENT
/begin MEASUREMENT stdmtllhv "Stopz‰hler f¸r Verifizierungs- und Heilungspr¸fungen" UBYTE dez 1 100 0 255 FORMAT "%5.1" ECU_ADDRESS 0x3FE2D3 /end MEASUREMENT
/begin MEASUREMENT stfadmet "Stopz‰hler f¸r Endstufentests" UBYTE dez 1 100 0 255 FORMAT "%5.1" ECU_ADDRESS 0x3FE2D4 /end MEASUREMENT
/begin MEASUREMENT stfadmtg "Stopz‰hler f¸r Testeranforderung Grobleckpr¸fung" UBYTE dez 1 100 0 255 FORMAT "%5.1" ECU_ADDRESS 0x3FE2D5 /end MEASUREMENT
/begin MEASUREMENT stfadmtl "Stopz‰hler f¸r Testeranforderung Feinleckpr¸fung" UBYTE dez 1 100 0 255 FORMAT "%5.1" ECU_ADDRESS 0x3FE2D6 /end MEASUREMENT
/begin MEASUREMENT stfleobd "Stopz‰hler f¸r Feinleckpr¸fung" UBYTE dez 1 100 0 255 FORMAT "%5.1" ECU_ADDRESS 0x3FE2D7 /end MEASUREMENT
/begin MEASUREMENT stfopr "Stopz‰hler bei Erstaktivierung" UBYTE dez 1 100 0 255 FORMAT "%5.1" ECU_ADDRESS 0x3FE2D8 /end MEASUREMENT
/begin MEASUREMENT stgleobd "Stopz‰hler f¸r Zahl der Groblecktests" UBYTE dez 1 100 0 255 FORMAT "%5.1" ECU_ADDRESS 0x3FE2D9 /end MEASUREMENT
/begin MEASUREMENT stprsen "Stopz‰hler Diagnose als Drucksensor" UBYTE dez 1 100 0 255 FORMAT "%5.1" ECU_ADDRESS 0x3FE2DA /end MEASUREMENT
/begin MEASUREMENT swvvtnot "Sollwertinformation im Notlauf, welcher Anschlag angefahren werden soll" UBYTE DEZ 1 100 0 255 FORMAT "%5.1" ECU_ADDRESS 0x402CFE /end MEASUREMENT
/begin MEASUREMENT S_VSMNHBNV "Schalter f¸r Testereingriff" UBYTE B_TRUE 1 100 0 1 FORMAT "%13.11" ECU_ADDRESS 0x3FE918 /end MEASUREMENT
/begin MEASUREMENT tadtea "rel. TEV-÷ffnung aus Tankentl¸ftungsdiagnose" UBYTE rel_ub_b100 1 100 0 99.6094 FORMAT "%5.2" ECU_ADDRESS 0x4035F5 /end MEASUREMENT
/begin MEASUREMENT tamn "Min. Wert von Ta" UWORD txms_uw_q0p001 1 100 0 65.535 FORMAT "%8.5" ECU_ADDRESS 0x404886 /end MEASUREMENT
/begin MEASUREMENT tamx "Max. Wert von Ta" UWORD txms_uw_q0p001 1 100 0 65.535 FORMAT "%8.5" ECU_ADDRESS 0x404888 /end MEASUREMENT
/begin MEASUREMENT tanwrhf "Adaptiertes Halte-Tastverh‰ltnis (NW-Regelung)" UBYTE tv_ub_b100 1 100 0 99.6094 FORMAT "%5.2" ARRAY_SIZE 2 ECU_ADDRESS 0x403B28 /end MEASUREMENT
/begin MEASUREMENT taold_w "Alter Wert von ta" UWORD txms_uw_q0p001 1 100 0 65.535 FORMAT "%8.5" ECU_ADDRESS 0x40488A /end MEASUREMENT
/begin MEASUREMENT tarlmn "Min. Schwelle des ta Verh‰ltnisses" UWORD rel_uw_q0p125 1 100 0 1 FORMAT "%8.6" ECU_ADDRESS 0x40488C /end MEASUREMENT
/begin MEASUREMENT tarlmx "Max. Schwelle des ta Verh‰ltnisses" UBYTE rel_uw_q0p125 1 100 0 1 FORMAT "%5.3" ECU_ADDRESS 0x403A6B /end MEASUREMENT
/begin MEASUREMENT tbtevio_c "" UBYTE t100msxs_ub_b25p5 1 100 0 25.5 FORMAT "%5.2" ECU_ADDRESS 0x4035F6 /end MEASUREMENT
/begin MEASUREMENT tc6tesc "Ausgabe-Code SCAN-Tool Mode 6 aus TES-Diagnose" UBYTE dez 1 100 0 255 FORMAT "%5.1" ECU_ADDRESS 0x3FE2B8 /end MEASUREMENT
/begin MEASUREMENT tc6tess "Ausgabe Schwellwert SCAN-Tool Mode 6 aus TES-Diagnose" UWORD dez 1 100 0 65535 FORMAT "%8.2" ECU_ADDRESS 0x3FE2BA /end MEASUREMENT
/begin MEASUREMENT tc6tesw "Ausgabe Pr¸fwert SCAN-Tool Mode 6 aus TES-Diagnose" UWORD dez 1 100 0 65535 FORMAT "%8.2" ECU_ADDRESS 0x3FE2BC /end MEASUREMENT
/begin MEASUREMENT tdmtl_w "Dauer der laufenden DM-TL Diagnose" UWORD t_q0p1 1 100 0 6553.5 FORMAT "%8.3" ECU_ADDRESS 0x403648 /end MEASUREMENT
/begin MEASUREMENT tdten_w "Berechnungszeit f¸r Drehzahlcheck" UWORD t20msxs_uw_b1310 1 100 0 1310.7 FORMAT "%8.3" ECU_ADDRESS 0x4035FA /end MEASUREMENT
/begin MEASUREMENT tdtevchk_w "akt. Zeit f¸r Tevcheck" UWORD t100msxs_uw_b6553p5 1 100 0 6553.5 FORMAT "%8.3" ECU_ADDRESS 0x403600 /end MEASUREMENT
/begin MEASUREMENT tdtevmx_w "Wartezeit f¸r Ratiobildung Diagnose Tankentl¸ftungsventil" UWORD t100msxs_uw_b6553p5 1 100 0 6553.5 FORMAT "%8.3" ECU_ADDRESS 0x403602 /end MEASUREMENT
/begin MEASUREMENT tdtev_w "akt. ÷ffnungszeit TEV bei Tevcheck" UWORD t100msxs_uw_b6553p5 1 100 0 6553.5 FORMAT "%8.3" ECU_ADDRESS 0x403604 /end MEASUREMENT
/begin MEASUREMENT tesstat "Funktionsstatus DTES bei Anforderung Systemcheck" UBYTE dez 1 100 0 255 FORMAT "%5.1" ECU_ADDRESS 0x4035F7 /end MEASUREMENT
/begin MEASUREMENT tka_loc "Lokale Variable f¸r TKA-Startwertberechnung" UBYTE temp_ub_q0p75_o48 1 100 -48 143.25 FORMAT "%5.1" ECU_ADDRESS 0x403749 /end MEASUREMENT
/begin MEASUREMENT tka_start "Startwert der K¸hleraustrittstemperatur" UBYTE temp_ub_q0p75_o48 1 100 -48 143.25 FORMAT "%5.1" ECU_ADDRESS 0x40374A /end MEASUREMENT
/begin MEASUREMENT tmlauf_w "Motorlaufzeit vor dem Abstellen" UWORD t100msxs_uw_b6553p6 1 100 0 6553.5 FORMAT "%8.3" ECU_ADDRESS 0x3FE16E /end MEASUREMENT
/begin MEASUREMENT tmstem "Motortemperatur bei Startende in Memory" UBYTE temp_ub_q0p75_o48 1 100 -48 143.25 FORMAT "%5.1" ECU_ADDRESS 0x40284E /end MEASUREMENT
/begin MEASUREMENT top_w "Operating time seit powerfail" UWORD t6minxmin_q6 1 100 0 393210 FORMAT "%8.1" ECU_ADDRESS 0x40284C /end MEASUREMENT
/begin MEASUREMENT trefdtev_w "Referenzmeﬂzeit bei DM-TL Benutzung f¸r TEV-Pr¸fung" UWORD t100msxs_uw_b6553p5 1 100 0 6553.5 FORMAT "%8.3" ECU_ADDRESS 0x403606 /end MEASUREMENT
/begin MEASUREMENT tstlauf_w "Zeit seit B_st auf 1" UWORD t100msxs_uw_b6553p6 1 100 0 6553.5 FORMAT "%8.3" ECU_ADDRESS 0x403FF4 /end MEASUREMENT
/begin MEASUREMENT tverztev_w "Verzˆgerungszeit nach Referenzleckmessung" UWORD t100msxs_uw_b6553p5 1 100 0 6553.5 FORMAT "%8.3" ECU_ADDRESS 0x403608 /end MEASUREMENT
/begin MEASUREMENT twkodte_c "" UBYTE t100msxs_ub_b25p5 1 100 0 25.5 FORMAT "%5.2" ECU_ADDRESS 0x4035F8 /end MEASUREMENT
/begin MEASUREMENT t_sa "Timer Schubabschalten f¸r DTHS" UBYTE t1sxs_ub_q1 1 100 0 255 FORMAT "%5.1" ECU_ADDRESS 0x40374B /end MEASUREMENT
/begin MEASUREMENT vfzg2 "Fahrzeuggeschwindigkeit 2" UBYTE vfzg_ub_q1p25 1 100 0 318.75 FORMAT "%5.1" ECU_ADDRESS 0x403838 /end MEASUREMENT
/begin MEASUREMENT Vnsfaktmot "" UBYTE fak_ub_b2 1 100 0 1.99219 FORMAT "%5.3" ECU_ADDRESS 0x4036A6 /end MEASUREMENT
/begin MEASUREMENT Vnsfaktvub "ausgegebenes variable NWS Tastverh‰ltnis ub-abh‰ngig" UBYTE fak_ub_b2 1 100 0 1.99219 FORMAT "%5.3" ECU_ADDRESS 0x4036A7 /end MEASUREMENT
/begin MEASUREMENT Vsa2adp "Adaptionswert Anschlag Auslasspreizung variable NWS Bank 2" UWORD sprzi_q0p1 1 100 0 6553.5 FORMAT "%8.3" ECU_ADDRESS 0x3FE380 /end MEASUREMENT
/begin MEASUREMENT Vsa2adp_fl "Flankenindividuelle Adaption Auslasspreizung variable NWS Bank 2" SBYTE sprzi_q0p05 1 100 -6.4 6.35 FORMAT "%5.3" ARRAY_SIZE 4 ECU_ADDRESS 0x3FE36C /end MEASUREMENT
/begin MEASUREMENT Vsa2anz "" UBYTE dez 1 100 0 255 FORMAT "%5.1" ECU_ADDRESS 0x3FE350 /end MEASUREMENT
/begin MEASUREMENT Vsa2dwnwkl "Delta Kennlinie Auslasspreizung variable NWS Bank 2" UWORD sprzi_q0p1s32768 1 100 -3276.8 3276.7 FORMAT "%7.2" ECU_ADDRESS 0x4036B0 /end MEASUREMENT
/begin MEASUREMENT Vsa2dwnwv "" UWORD sprzi_q0p1s32768 1 100 -3276.8 3276.7 FORMAT "%7.2" ECU_ADDRESS 0x4036B2 /end MEASUREMENT
/begin MEASUREMENT Vsa2km "" UWORD km_uw_q10 1 100 0 655350 FORMAT "%8.1" ARRAY_SIZE 5 ECU_ADDRESS 0x3FE328 /end MEASUREMENT
/begin MEASUREMENT Vsa2spri "Istwert Bank 2 Auslasspreizung variable NWS" UWORD sprzi_q0p1 1 100 0 6553.5 FORMAT "%8.3" ECU_ADDRESS 0x4036B4 /end MEASUREMENT
/begin MEASUREMENT Vsa2spris "gesch‰tzter Istwert Bank 2 Auslasspreizung variable NWS" UWORD sprzi_q0p1 1 100 0 6553.5 FORMAT "%8.3" ECU_ADDRESS 0x4036B6 /end MEASUREMENT
/begin MEASUREMENT Vsa2sprs "Sollwert Bank 2 Auslasspreizung variable NWS" UWORD sprzi_q0p1 1 100 0 6553.5 FORMAT "%8.3" ECU_ADDRESS 0x4036B8 /end MEASUREMENT
/begin MEASUREMENT Vsa2stat "Status Auslasspreizung variable NWS Bank 2" UBYTE dez 1 100 0 255 FORMAT "%5.1" ECU_ADDRESS 0x3FE370 /end MEASUREMENT
/begin MEASUREMENT Vsa2tmot "" UBYTE temp_ub_q0p75_o48 1 100 -48 143.25 FORMAT "%5.1" ARRAY_SIZE 5 ECU_ADDRESS 0x3FE351 /end MEASUREMENT
/begin MEASUREMENT Vsa2tv "Tastverh‰ltnis Auslasspreizung variable NWS Bank 2" UWORD vnstv_q0p01 1 100 0 655.35 FORMAT "%7.3" ECU_ADDRESS 0x4036BA /end MEASUREMENT
/begin MEASUREMENT Vsa2tv_i "Reglerausgang I-Regler Auslasspreizung variable NWS Bank 2" UWORD vnstv_q0p00305s32768 1 100 -100 99.9969 ECU_ADDRESS 0x4036BC /end MEASUREMENT
/begin MEASUREMENT Vsa2tv_p "Reglerausgang P-Regler Auslasspreizung variable NWS Bank 2" UWORD vnstv_q0p00305s32768 1 100 -100 99.9969 ECU_ADDRESS 0x4036BE /end MEASUREMENT
/begin MEASUREMENT Vsa2vg "Verstellgeschwindigkeit Auslasspreizung variable NWS Bank 2" SWORD sprzivg_q0p781 1 100 -25600 25599.2 FORMAT "%8.2" ECU_ADDRESS 0x4036C0 /end MEASUREMENT
/begin MEASUREMENT Vsa2zeig "" UBYTE dez 1 100 0 255 FORMAT "%5.1" ECU_ADDRESS 0x3FE356 /end MEASUREMENT
/begin MEASUREMENT Vsadwnwkl "Delta Kennlinie Auslasspreizung variable NWS" UWORD sprzi_q0p1s32768 1 100 -3276.8 3276.7 FORMAT "%7.2" ECU_ADDRESS 0x4036C2 /end MEASUREMENT
/begin MEASUREMENT Vsadwnwv "" UWORD sprzi_q0p1s32768 1 100 -3276.8 3276.7 FORMAT "%7.2" ECU_ADDRESS 0x4036C4 /end MEASUREMENT
/begin MEASUREMENT Vsaspris "gesch‰tzter Istwert Auslasspreizung variable NWS" UWORD sprzi_q0p1 1 100 0 6553.5 FORMAT "%8.3" ECU_ADDRESS 0x4036C6 /end MEASUREMENT
/begin MEASUREMENT Vsa_adp "Adaptionswert Anschlag Auslasspreizung variable NWS" UWORD sprzi_q0p1 1 100 0 6553.5 FORMAT "%8.3" ECU_ADDRESS 0x3FE382 /end MEASUREMENT
/begin MEASUREMENT Vsa_adp_fl "Flankenindividuelle Adaption Auslasspreizung variable NWS" SBYTE sprzi_q0p05 1 100 -6.4 6.35 FORMAT "%5.3" ARRAY_SIZE 4 ECU_ADDRESS 0x3FE371 /end MEASUREMENT
/begin MEASUREMENT Vsa_anz "" UBYTE dez 1 100 0 255 FORMAT "%5.1" ECU_ADDRESS 0x3FE357 /end MEASUREMENT
/begin MEASUREMENT Vsa_km "" UWORD km_uw_q10 1 100 0 655350 FORMAT "%8.1" ARRAY_SIZE 5 ECU_ADDRESS 0x3FE332 /end MEASUREMENT
/begin MEASUREMENT Vsa_spri "Istwert Auslasspreizung variable NWS" UWORD sprzi_q0p1 1 100 0 6553.5 FORMAT "%8.3" ECU_ADDRESS 0x4036C8 /end MEASUREMENT
/begin MEASUREMENT Vsa_sprs "Sollwert Auslasspreizung variable NWS" UWORD sprzi_q0p1 1 100 0 6553.5 FORMAT "%8.3" ECU_ADDRESS 0x4036CA /end MEASUREMENT
/begin MEASUREMENT Vsa_stat "Status Auslasspreizung variable NWS" UBYTE dez 1 100 0 255 FORMAT "%5.1" ECU_ADDRESS 0x3FE375 /end MEASUREMENT
/begin MEASUREMENT Vsa_tmot "" UBYTE temp_ub_q0p75_o48 1 100 -48 143.25 FORMAT "%5.1" ARRAY_SIZE 5 ECU_ADDRESS 0x3FE358 /end MEASUREMENT
/begin MEASUREMENT Vsa_tv "Tastverh‰ltnis Auslasspreizung variable NWS" UWORD vnstv_q0p01 1 100 0 655.35 FORMAT "%7.3" ECU_ADDRESS 0x4036CC /end MEASUREMENT
/begin MEASUREMENT Vsa_tv_i "Reglerausgang I-Regler Auslasspreizung variable NWS" UWORD vnstv_q0p00305s32768 1 100 -100 99.9969 ECU_ADDRESS 0x4036CE /end MEASUREMENT
/begin MEASUREMENT Vsa_tv_p "Reglerausgang P-Regler Auslasspreizung variable NWS" UWORD vnstv_q0p00305s32768 1 100 -100 99.9969 ECU_ADDRESS 0x4036D0 /end MEASUREMENT
/begin MEASUREMENT Vsa_vg "Verstellgeschwindigkeit Auslasspreizung variable NWS" SWORD sprzivg_q0p781 1 100 -25600 25599.2 FORMAT "%8.2" ECU_ADDRESS 0x4036D2 /end MEASUREMENT
/begin MEASUREMENT Vsa_zeig "" UBYTE dez 1 100 0 255 FORMAT "%5.1" ECU_ADDRESS 0x3FE35D /end MEASUREMENT
/begin MEASUREMENT Vse2adp "Adaptionswert Anschlag Einlasspreizung variable NWS Bank 2" UWORD sprzi_q0p1 1 100 0 6553.5 FORMAT "%8.3" ECU_ADDRESS 0x3FE384 /end MEASUREMENT
/begin MEASUREMENT Vse2adp_fl "Flankenindividuelle Adaption Einlasspreizung variable NWS Bank 2" SBYTE sprzi_q0p05 1 100 -6.4 6.35 FORMAT "%5.3" ARRAY_SIZE 4 ECU_ADDRESS 0x3FE376 /end MEASUREMENT
/begin MEASUREMENT Vse2anz "" UBYTE dez 1 100 0 255 FORMAT "%5.1" ECU_ADDRESS 0x3FE35E /end MEASUREMENT
/begin MEASUREMENT Vse2dwnwkl "Delta Kennlinie Einlasspreizung variable NWS Bank 2" UWORD sprzi_q0p1s32768 1 100 -3276.8 3276.7 FORMAT "%7.2" ECU_ADDRESS 0x4036D4 /end MEASUREMENT
/begin MEASUREMENT Vse2dwnwv "" UWORD sprzi_q0p1s32768 1 100 -3276.8 3276.7 FORMAT "%7.2" ECU_ADDRESS 0x4036D6 /end MEASUREMENT
/begin MEASUREMENT Vse2km "" UWORD km_uw_q10 1 100 0 655350 FORMAT "%8.1" ARRAY_SIZE 5 ECU_ADDRESS 0x3FE33C /end MEASUREMENT
/begin MEASUREMENT Vse2spri "Istwert Bank 2 Einlasspreizung variable NWS" UWORD sprzi_q0p1 1 100 0 6553.5 FORMAT "%8.3" ECU_ADDRESS 0x4036D8 /end MEASUREMENT
/begin MEASUREMENT Vse2spris "gesch‰tzter Istwert Bank 2 Einlasspreizung variable NWS" UWORD sprzi_q0p1 1 100 0 6553.5 FORMAT "%8.3" ECU_ADDRESS 0x4036DA /end MEASUREMENT
/begin MEASUREMENT Vse2sprs "Sollwert Bank 2 Einlasspreizung variable NWS" UWORD sprzi_q0p1 1 100 0 6553.5 FORMAT "%8.3" ECU_ADDRESS 0x4036DC /end MEASUREMENT
/begin MEASUREMENT Vse2stat "Status Einlasspreizung variable NWS Bank 2" UBYTE dez 1 100 0 255 FORMAT "%5.1" ECU_ADDRESS 0x3FE37A /end MEASUREMENT
/begin MEASUREMENT Vse2tmot "" UBYTE temp_ub_q0p75_o48 1 100 -48 143.25 FORMAT "%5.1" ARRAY_SIZE 5 ECU_ADDRESS 0x3FE35F /end MEASUREMENT
/begin MEASUREMENT Vse2tv "Tastverh‰ltnis Einlasspreizung variable NWS Bank 2" UWORD vnstv_q0p01 1 100 0 655.35 FORMAT "%7.3" ECU_ADDRESS 0x4036DE /end MEASUREMENT
/begin MEASUREMENT Vse2tv_i "Reglerausgang I-Regler Einlasspreizung variable NWS Bank 2" UWORD vnstv_q0p00305s32768 1 100 -100 99.9969 ECU_ADDRESS 0x4036E0 /end MEASUREMENT
/begin MEASUREMENT Vse2tv_p "Reglerausgang P-Regler Einlasspreizung variable NWS Bank 2" UWORD vnstv_q0p00305s32768 1 100 -100 99.9969 ECU_ADDRESS 0x4036E2 /end MEASUREMENT
/begin MEASUREMENT Vse2vg "Verstellgeschwindigkeit Einlasspreizung variable NWS Bank 2" SWORD sprzivg_q0p781 1 100 -25600 25599.2 FORMAT "%8.2" ECU_ADDRESS 0x4036E4 /end MEASUREMENT
/begin MEASUREMENT Vse2zeig "" UBYTE dez 1 100 0 255 FORMAT "%5.1" ECU_ADDRESS 0x3FE364 /end MEASUREMENT
/begin MEASUREMENT Vsedwnwkl "Delta Kennlinie Einlasspreizung variable NWS" UWORD sprzi_q0p1s32768 1 100 -3276.8 3276.7 FORMAT "%7.2" ECU_ADDRESS 0x4036E6 /end MEASUREMENT
/begin MEASUREMENT Vsedwnwv "" UWORD sprzi_q0p1s32768 1 100 -3276.8 3276.7 FORMAT "%7.2" ECU_ADDRESS 0x4036E8 /end MEASUREMENT
/begin MEASUREMENT Vsespris "gesch‰tzter Istwert Einlasspreizung variable NWS" UWORD sprzi_q0p1 1 100 0 6553.5 FORMAT "%8.3" ECU_ADDRESS 0x4036EA /end MEASUREMENT
/begin MEASUREMENT Vse_adp "Adaptionswert Anschlag Einlasspreizung variable NWS" UWORD sprzi_q0p1 1 100 0 6553.5 FORMAT "%8.3" ECU_ADDRESS 0x3FE386 /end MEASUREMENT
/begin MEASUREMENT Vse_adp_fl "Flankenindividuelle Adaption Einlasspreizung variable NWS" SBYTE sprzi_q0p05 1 100 -6.4 6.35 FORMAT "%5.3" ARRAY_SIZE 4 ECU_ADDRESS 0x3FE37B /end MEASUREMENT
/begin MEASUREMENT Vse_anz "Array fuer Anzahl der unverriegelten Abstellungen" UBYTE dez 1 100 0 255 FORMAT "%5.1" ECU_ADDRESS 0x3FE365 /end MEASUREMENT
/begin MEASUREMENT Vse_km "Array fuer Umgebungsbedingung km-Stand" UWORD km_uw_q10 1 100 0 655350 FORMAT "%8.1" ARRAY_SIZE 5 ECU_ADDRESS 0x3FE346 /end MEASUREMENT
/begin MEASUREMENT Vse_spri "Istwert Einlasspreizung variable NWS" UWORD sprzi_q0p1 1 100 0 6553.5 FORMAT "%8.3" ECU_ADDRESS 0x4036EC /end MEASUREMENT
/begin MEASUREMENT Vse_sprs "Sollwert Einlasspreizung variable NWS" UWORD sprzi_q0p1 1 100 0 6553.5 FORMAT "%8.3" ECU_ADDRESS 0x4036EE /end MEASUREMENT
/begin MEASUREMENT Vse_stat "Status Einlasspreizung variable NWS" UBYTE dez 1 100 0 255 FORMAT "%5.1" ECU_ADDRESS 0x3FE37F /end MEASUREMENT
/begin MEASUREMENT Vse_tmot "Array fuer Umgebungsbedingung tmot" UBYTE temp_ub_q0p75_o48 1 100 -48 143.25 FORMAT "%5.1" ARRAY_SIZE 5 ECU_ADDRESS 0x3FE366 /end MEASUREMENT
/begin MEASUREMENT Vse_tv "Tastverh‰ltnis Einlasspreizung variable NWS" UWORD vnstv_q0p01 1 100 0 655.35 FORMAT "%7.3" ECU_ADDRESS 0x4036F0 /end MEASUREMENT
/begin MEASUREMENT Vse_tv_i "Reglerausgang I-Regler Einlasspreizung variable NWS" UWORD vnstv_q0p00305s32768 1 100 -100 99.9969 ECU_ADDRESS 0x4036F2 /end MEASUREMENT
/begin MEASUREMENT Vse_tv_p "Reglerausgang P-Regler Einlasspreizung variable NWS" UWORD vnstv_q0p00305s32768 1 100 -100 99.9969 ECU_ADDRESS 0x4036F4 /end MEASUREMENT
/begin MEASUREMENT Vse_vg "Verstellgeschwindigkeit Einlasspreizung variable NWS" SWORD sprzivg_q0p781 1 100 -25600 25599.2 FORMAT "%8.2" ECU_ADDRESS 0x4036F6 /end MEASUREMENT
/begin MEASUREMENT Vse_zeig "Zeiger auf zuletzt abgelegte Umgebungsbedingungen" UBYTE dez 1 100 0 255 FORMAT "%5.1" ECU_ADDRESS 0x3FE36B /end MEASUREMENT
/begin MEASUREMENT vstvvr "Erhˆhung des Sollwerts der VMAX-Regelung ¸ber Werkstatt-Tester" UBYTE dez 1 100 0 255 FORMAT "%5.1" ECU_ADDRESS 0x403B2A /end MEASUREMENT
/begin MEASUREMENT vvtovlcou "" UWORD DEZ 1 100 0 65535 FORMAT "%8.2" ECU_ADDRESS 0x3FE13C /end MEASUREMENT
/begin MEASUREMENT vvtovlcou2 "" UWORD DEZ 1 100 0 65535 FORMAT "%8.2" ECU_ADDRESS 0x3FE13E /end MEASUREMENT
/begin MEASUREMENT vvtstatus "Status VVT-System Bank 1" UWORD DEZ 1 100 0 65535 FORMAT "%8.2" ECU_ADDRESS 0x402CF6 /end MEASUREMENT
/begin MEASUREMENT vvtstatus2 "Status VVT-System Bank 2" UWORD DEZ 1 100 0 65535 FORMAT "%8.2" ECU_ADDRESS 0x402CF8 /end MEASUREMENT
/begin MEASUREMENT wea "Winkelmarke Einspritzabbruch" UBYTE kw_q3 1 100 0 765 FORMAT "%5.1" ECU_ADDRESS 0x403900 /end MEASUREMENT
/begin MEASUREMENT weemrfa "Winkel Einspritzende im maximalem Fahrerwunschmomment" UBYTE kw_q3 1 100 0 765 FORMAT "%5.1" ECU_ADDRESS 0x402D9E /end MEASUREMENT
/begin MEASUREMENT wfdk_w "Wandfilmmenge" SWORD rel_sw_q0p1875 1 100 -6144 6143.81 FORMAT "%8.3" ECU_ADDRESS 0x404048 /end MEASUREMENT
/begin MEASUREMENT wf_w "Wandfilmmenge" SWORD rel_sw_q0p1875 1 100 -6144 6143.81 FORMAT "%8.3" ECU_ADDRESS 0x404020 /end MEASUREMENT
/begin MEASUREMENT wnkbegr "Exzenterwinkelbegrenzung" UWORD wink_uw_q0p1 1 100 0 6553.5 FORMAT "%8.3" ECU_ADDRESS 0x402CFA /end MEASUREMENT
/begin MEASUREMENT wnkmin_w "" UWORD wink_uw_q0p1 1 100 0 6553.5 FORMAT "%8.3" ECU_ADDRESS 0x404542 /end MEASUREMENT
/begin MEASUREMENT wnk_soll1 "Exzentersollwinkel Bank1" UWORD wink_uw_q0p1 1 100 0 6553.5 FORMAT "%8.3" ECU_ADDRESS 0x402CFC /end MEASUREMENT
/begin MEASUREMENT wnwi_w "Istwinkel f¸r Nockenwelle (word)" SWORD wkw_sw_b128 1 100 -128 127.996 FORMAT "%8.4" ECU_ADDRESS 0x404354 /end MEASUREMENT
/begin MEASUREMENT wuccnt "Warm-up cycle - counter" UBYTE dez 1 100 0 255 FORMAT "%5.1" ECU_ADDRESS 0x3FDEF7 /end MEASUREMENT
/begin MEASUREMENT wvesp "Vorlagerungswinkel Einspritzung im Start und bei Normalbetrieb" UBYTE kw_q3 1 100 0 765 FORMAT "%5.1" ECU_ADDRESS 0x403901 /end MEASUREMENT
/begin MEASUREMENT wvespnst "Vorlagerungswinkel Einspritzung im Normalbetrieb" UBYTE kw_q3 1 100 0 765 FORMAT "%5.1" ECU_ADDRESS 0x402D9F /end MEASUREMENT
/begin MEASUREMENT wvespst "Vorlagerungswinkel Einspritzung im Start" UBYTE kw_q3 1 100 0 765 FORMAT "%5.1" ECU_ADDRESS 0x402DA0 /end MEASUREMENT
/begin MEASUREMENT zbale "Abregelfaktor Langzeitanteil bei BA" UBYTE fak_ub_b0p125 1 100 0 0.124512 FORMAT "%6.4" ECU_ADDRESS 0x402D86 /end MEASUREMENT
/begin MEASUREMENT zbaledk "Abregelfaktor Langzeitanteil bei BA" UBYTE fak_ub_b0p125 1 100 0 0.124512 FORMAT "%6.4" ECU_ADDRESS 0x402D96 /end MEASUREMENT
/begin MEASUREMENT zdteio "I.O.-Z‰hler f¸r Tankentl¸ftungsdiagnose" UBYTE dez 1 100 0 255 FORMAT "%5.1" ECU_ADDRESS 0x403D14 /end MEASUREMENT
/begin MEASUREMENT zdtev "Pr¸fungsz‰hler f¸r TEV-Diagnose" UBYTE dez 1 100 0 255 FORMAT "%5.1" ECU_ADDRESS 0x4035F9 /end MEASUREMENT
/begin MEASUREMENT zkhimpzl "Entprellz‰hler Hochimpedanzfehler" UBYTE dez 1 100 0 255 FORMAT "%5.1" ARRAY_SIZE 8 ECU_ADDRESS 0x403A6C /end MEASUREMENT
/begin MEASUREMENT zkhimpzlrl "Entprellz‰hler hochimpedanter Prim‰rkreis relativ zu Nachbarstromkreisen" UBYTE dez 1 100 0 255 FORMAT "%5.1" ARRAY_SIZE 8 ECU_ADDRESS 0x403A74 /end MEASUREMENT
/begin MEASUREMENT zvale "Abregelfaktor Langzeitanteil bei VA" UBYTE fak_ub_b0p125 1 100 0 0.124512 FORMAT "%6.4" ECU_ADDRESS 0x402D87 /end MEASUREMENT
/begin MEASUREMENT zvaledk "Abregelfaktor Langzeitanteil bei VA" UBYTE fak_ub_b0p125 1 100 0 0.124512 FORMAT "%6.4" ECU_ADDRESS 0x402D97 /end MEASUREMENT
/begin FUNCTION DTEVE "13.20     Diagnose; Tankentl¸ftungsventil - Endstufe" /begin DEF_CHARACTERISTIC CWPSTEVE /end DEF_CHARACTERISTIC /begin REF_CHARACTERISTIC TVP /end REF_CHARACTERISTIC /begin IN_MEASUREMENT B_desee tateist_w /end IN_MEASUREMENT /begin SUB_FUNCTION DFPM_DTEVE /end SUB_FUNCTION /end FUNCTION
/begin FUNCTION DTEVN "24.190    Diagnose Tankentl¸ftungsventil (OBDII)"
 /begin DEF_CHARACTERISTIC AIMDTED AIODTEX APDTEX CWDPCS CWDTEVN CWTEVCHECK CW_FADTEVN DMITED DNSTED DPSTDTEN FTETEDF FTETEDM HTEDU INTEDOFS INTEDOOFS INTEDUFS INTEDUOFS KLDPSTEV NSTATDTEVN NSTEDMX RLTEDMX TBTEVIO TMTED TNODTEV TNODTEVT TTEDAFS TTEDAOFS TTEDBA TTEDIVFS TTEDIVOFS TTEDNFS TTEDNOFS TWKODTE ZMVDTE ZNTED ZTEDDPS /end DEF_CHARACTERISTIC
 /begin REF_CHARACTERISTIC TTEGAI TTEINI /end REF_CHARACTERISTIC
 /begin IN_MEASUREMENT B_cdtes B_dmtltz B_druck B_dsls B_dtevpoe B_dvvtobd B_edkvs B_edkvs2 B_edmtl B_enws B_fa B_fates B_frao B_frau B_fs B_gdvhub B_kh B_ko B_kw B_ll B_lowra B_lr B_lr2 B_mdarv B_nldg B_pwf B_rkat B_rkaz B_stend B_tei B_tevchkon B_tldobd cd_bits1_w dpssyn_w E_tevddmtl fho ftead_w mdverl_w milsol_w mstesoll_w nmot_w nsol nstat rl tmot tnse_w vfzg /end IN_MEASUREMENT
 /begin OUT_MEASUREMENT B_dteaa B_dtebel B_dtebn B_dtegr B_dtei B_dtes B_dtest B_dtev B_dtevbe B_dtevngd B_eebdtes B_tevfahrt tadtea tbtevio_c tc6tesc tc6tess tc6tesw tesstat twkodte_c zdteio zdtev /end OUT_MEASUREMENT
 /begin LOC_MEASUREMENT B_dteabr B_dtean B_dteaq B_dtesq B_dtevio dmidte dndte dnsdte dpsdter_w dpsdte_w DTEVNbits idps_w indte midter mvdtehp nsdter ntpdte ntpdter tdten_w /end LOC_MEASUREMENT
/end FUNCTION
/begin FUNCTION DTEVP "3.40      Diagnose Tankentl¸ftungsventil Druckpr¸fung"
 /begin DEF_CHARACTERISTIC DIPTTEV DIPTTEVCHK DIPTTEVGD TDTEV TDTEVGD TREFDTEV TTEVCHK TVERZTEV VFZGDTEVP /end DEF_CHARACTERISTIC
 /begin IN_MEASUREMENT B_dmtrfm B_dtevhnd B_ll B_tevfahrt B_tldtevda dpsfak ipteskf_w iptref_w tadtea vfzg_w /end IN_MEASUREMENT
 /begin OUT_MEASUREMENT B_dtevgo B_dtevpoe B_tevcheck B_tevchkon B_tldtevmv B_tldtevpm B_tldtevrq dipttev_w E_tevddmtl ipttev_w tdtevchk_w tdtevmx_w tdtev_w trefdtev_w tverztev_w /end OUT_MEASUREMENT
/end FUNCTION
/begin FUNCTION DTHS "1.60      Diagnose Thermostat" /begin DEF_CHARACTERISTIC CIDTHS CWLOWRA CW_DTHS NMXTHS TKA_DELTA TMOT_SOLL T_SA_MAX /end DEF_CHARACTERISTIC
 /begin IN_MEASUREMENT B_hls B_kalt B_lowra B_ntkw B_pwf B_sa B_stend nmot tka tmot /end IN_MEASUREMENT
 /begin OUT_MEASUREMENT B_cwdthm B_dths1 B_dthsab B_dthsfr B_dthsst B_heaths B_minths B_sloff dthsBits1_1000ms m6cthm m6sthm_w m6wthm_w tka_start t_sa /end OUT_MEASUREMENT
 /begin LOC_MEASUREMENT tka_loc /end LOC_MEASUREMENT
 /begin SUB_FUNCTION DFPM_DTHS INDEX_DTHS /end SUB_FUNCTION
/end FUNCTION
/begin FUNCTION DTIP "1.30      OBDII; Tester-Interface Package" /begin IN_MEASUREMENT cw_erfil fcmEnd FCMTab /end IN_MEASUREMENT /begin OUT_MEASUREMENT ffzdfp /end OUT_MEASUREMENT /end FUNCTION
/begin FUNCTION DTOP "3.40      Diagnose; Betriebszeit" /begin IN_MEASUREMENT B_eemrdy B_nmot /end IN_MEASUREMENT /begin OUT_MEASUREMENT top_w /end OUT_MEASUREMENT /end FUNCTION
/begin FUNCTION DTRIG "40.10     OBDII; Ausw‰hlbare Trigger f¸r Fehlerpfad-Management" /begin IN_MEASUREMENT bbdcy bbno bbsp1 bbsp2 bbsp3 bbtim bbwuc /end IN_MEASUREMENT /end FUNCTION
/begin FUNCTION DUF "6.60      Diagnose aus der Funktions¸berwachung" /begin DEF_CHARACTERISTIC DUFBDE_T DUF_T NMN_BDE NMN_DUF /end DEF_CHARACTERISTIC
 /begin IN_MEASUREMENT B_ehfs B_fgr B_fgr_um b_flags_um B_i_ska_um B_mibeg B_msr B_nomsr_um B_nosgs_um B_notlu_fr B_pwgnotfr B_sgs B_sp1s B_sp2s B_spsmin B_ub_ok B_wdk2sel ei_adcc_um ei_adcq_um ei_dps_um ei_ipa_um ei_mver_um ei_nc_um ei_reac_um ei_rlc_um ei_rlip_um ei_spsc_um ei_vvt_um ei_zwc_um mi_um nmot_um /end IN_MEASUREMENT
 /begin OUT_MEASUREMENT egaspfad skapfad /end OUT_MEASUREMENT
 /begin LOC_MEASUREMENT B_dufzok dufbde_c duf_c ei_dufska mi_duf mpfad /end LOC_MEASUREMENT
/end FUNCTION
/begin FUNCTION DULSU "1.100     Spannungs¸berwachung stetige Lambdasonde" /begin DEF_CHARACTERISTIC SULSULUFT SULSULUFTL SULSUMX SULSUMXL TVLSULUFT TVTKLSU /end DEF_CHARACTERISTIC
 /begin IN_MEASUREMENT B_cdulsu B_evloc B_fa B_fklanf B_fklanf2 B_hstlsua B_hstlsua2 B_sls B_stend B_tal B_talval lamsons2_w lamsons_w ua10mo2_w ua10mo_w /end IN_MEASUREMENT
 /begin LOC_MEASUREMENT B_heulsu B_heulsu2 B_luft B_luft2 B_vluft B_vluft2 /end LOC_MEASUREMENT
/end FUNCTION
/begin FUNCTION DUMMY_DFPM "Dummy DFPM" /begin OUT_MEASUREMENT B_m8te errorCntAskTcsort tanwrhf vfzg2 vstvvr /end OUT_MEASUREMENT /end FUNCTION
/begin FUNCTION DUMWEX "3.20      Diagose; Erweiterte Umweltbedingumgen" /begin IN_MEASUREMENT kmstfsp_w /end IN_MEASUREMENT /end FUNCTION
/begin FUNCTION DUR "4.20      Diagnose aus der Rechner¸berwachung" /begin OUT_MEASUREMENT rstpfad /end OUT_MEASUREMENT /begin LOC_MEASUREMENT rstMon_um /end LOC_MEASUREMENT /end FUNCTION
/begin FUNCTION DVANOS "1.10      Diagnose VANOS" /begin DEF_CHARACTERISTIC DELTA_AN DVNS_CLR VNSNMIN /end DEF_CHARACTERISTIC /begin REF_CHARACTERISTIC SPRZG_AN /end REF_CHARACTERISTIC
 /begin IN_MEASUREMENT B_pwf kmstand nmot tmot Vsa2spri Vsa_spri Vse2spri Vse_spri /end IN_MEASUREMENT
 /begin OUT_MEASUREMENT B_vsa2an B_vsa2nv B_vsa_an B_vsa_nv B_vse2an B_vse2nv B_vse_an B_vse_nv Vsa2anz Vsa2km Vsa2tmot Vsa2zeig Vsa_anz Vsa_km Vsa_tmot Vsa_zeig Vse2anz Vse2km Vse2tmot Vse2zeig Vse_anz Vse_km Vse_tmot Vse_zeig /end OUT_MEASUREMENT
/end FUNCTION
/begin FUNCTION DVAT "1.30      Diagnose Angezeigte Fahrzeuggeschwindigkeit im Tacho" /begin DEF_CHARACTERISTIC DVZV1VAT TDVAT TDVATFB TDVATH TNODVATNS ZTPDV1VAT /end DEF_CHARACTERISTIC /begin REF_CHARACTERISTIC UBDCAN /end REF_CHARACTERISTIC
 /begin IN_MEASUREMENT B_asc_reg B_brems B_dsc_reg B_ins4cok dscstat tnst_w ub vfzgat_w vfzgv1_w wped_w /end IN_MEASUREMENT
 /begin OUT_MEASUREMENT B_fgdvat dv1vatf_w /end OUT_MEASUREMENT
/end FUNCTION
/begin FUNCTION DVFZ "17.10     Diagnose: Plausibilit‰tspr¸fung Fahrzeuggeschwindigkeit" /begin DEF_CHARACTERISTIC NDV NDVO TDV TMDV VDMN /end DEF_CHARACTERISTIC /begin IN_MEASUREMENT B_sa nmot tmot vfzroh_w /end IN_MEASUREMENT /end FUNCTION
/begin FUNCTION DVVT "1.160     Diagnose VVT-Steuerger‰t"
 /begin DEF_CHARACTERISTIC CWERRVVT DVVTDEXWK DVVTEEDEL DVVTEENA DVVTEXMXAN DVVTEXPMN DVVTEXWIOF DVVTFLUBT DVVTNLUMN DVVTNMXV DVVTPVGR DVVTRLMDGR DVVTRLMXFA DVVTSWITCH DVVTWKMXV DVWKMINV KFDVEXWO KLDVFLUBGR KLDVMXMLDI KLDVVTRLMX KLDVWDKOF KLHUBEXINV LURVVTSTAP TDVERR TDVTEST TDVVTFIKO TDVVTNLCHK TDVVTNLIO TDVVTPV TKDVVTGR TKDVVTKL TVVTOVRL TVVTPMN TVVTTVON VVTOVLCAD VVTOVLCMX /end DEF_CHARACTERISTIC
 /begin REF_CHARACTERISTIC KFEHUBIV MLOFS /end REF_CHARACTERISTIC
 /begin IN_MEASUREMENT Adexws bbwuc B_bns B_bt B_btvvta B_dkpu B_enws B_flub1 B_flub2 B_fofr1 B_fonresf B_iwfalse B_iwfalse2 B_kl15 B_nldg B_nmot B_stend B_ubdve B_vl B_vvtno_an dps_w exwnki2_w exwnki_w flub1_w flub2_w mlhfmf_w mlhfmm_w msdk_w nmot_w ofwnkbg1 ofwnkbg2 pu_w rlugd_w rl_w vvtaet vvt_alern vvt_alern2 vvt_can vvt_can2 vvt_endst vvt_endst2 vvt_errst vvt_errst2 vvt_ffs vvt_ffs2 vvt_frs vvt_frs2 vvt_ovrld vvt_ovrld2 vvt_plsen vvt_plsen2 vvt_ready vvt_ready2 vvt_sg vvt_sg2 vvt_stell vvt_stell2 vvt_uleis vvt_uleis2 vvt_usen vvt_usen2 wdkba_w wdkugd_w /end IN_MEASUREMENT
 /begin OUT_MEASUREMENT B_dvvtdex B_dvvtobd B_fonresv B_mdbegr B_mdbegrml B_mdbegrps B_mdbegrvl B_vvtnlf B_vvtnlio B_vvtnotl B_vvtnotl1 B_vvtnotl2 B_vvttvnot dme_errfb dme_errfb2 dvvtnmx dvvtrlmx_w dvvttestat dvvtwnkmx dvvtwnkmx2 E_vvt_hub E_vvt_vsa E_vvt_vse E_vvt_zw lurvvtstat swvvtnot vvtstatus vvtstatus2 /end OUT_MEASUREMENT
 /begin LOC_MEASUREMENT B_begrvvt B_dvvteph B_dvvt_t B_nldgh B_vvtiorem B_vvtnlrem B_vvtovlc B_vvtovlc2 dvvterrq dvvterrq1 dvvtmldif dvvtpv_w exwnkiloc exwnkrbt_w exwnksbt_w E_ph2loc E_ph3loc E_ph4loc hubbegr vvtovlcou vvtovlcou2 wnkbegr wnkmin_w wnk_soll1 /end LOC_MEASUREMENT
 /begin SUB_FUNCTION DFPM_DVVT INDEX_DVVT /end SUB_FUNCTION
/end FUNCTION
/begin FUNCTION DVVTE "2.10      Diagnose VVT-Steuerger‰t-Endstufe" /begin DEF_CHARACTERISTIC CWPSVVTE /end DEF_CHARACTERISTIC /begin REF_CHARACTERISTIC TVP /end REF_CHARACTERISTIC /begin IN_MEASUREMENT B_desee tavvtout_w /end IN_MEASUREMENT /begin SUB_FUNCTION DFPM_DVVTE /end SUB_FUNCTION /end FUNCTION
/begin FUNCTION DWUC "14.20     OBDII; Erf¸llung Bedingung 'warm up cycle'" /begin DEF_CHARACTERISTIC DTMWUC TMWUC TMWUCST /end DEF_CHARACTERISTIC /begin IN_MEASUREMENT B_pwf B_stend tmot /end IN_MEASUREMENT /begin OUT_MEASUREMENT bbwuc B_nowuc B_wuc wuccnt /end OUT_MEASUREMENT /begin LOC_MEASUREMENT tmstem /end LOC_MEASUREMENT /end FUNCTION
/begin FUNCTION DZKU "5.70      Diagnose: Z¸ndkreis¸berwachung"
 /begin DEF_CHARACTERISTIC CW_DZKU DZKDMDZL DZKDUB DZKSUB_DZKU_IMPL DZOTPERR_DZKU_IMPL DZPHKSUB DZPKSMS DZPKSMSR DZPKSUB DZPKSUBR DZPOTP DZPSP DZPTIM DZRELFAK FZALIM FZLIMUB KLRTAMN KLTAMN KLTAMX NOTAERR_DZKU_IMPL NZDIAGH NZDIAGL TAINI UBDZMN UBDZMX /end DEF_CHARACTERISTIC
 /begin IN_MEASUREMENT B_dzrts B_ff B_stend dzkflag fzabgzyl_w nmot nmot_w ta_w ub /end IN_MEASUREMENT
 /begin OUT_MEASUREMENT abmznd B_dzack B_dzenable /end OUT_MEASUREMENT
 /begin LOC_MEASUREMENT abmbuf B_dzappl B_dzdmden B_dzdmdub B_dzhksub B_dzkdmd B_dzkprl B_dzksms B_dzksub B_dzkub B_dzmnen B_dzmnrel B_dzmxen B_dzmxrel B_dzotp B_dzzyk B_taini B_zkhimp B_zkrlhmp B_zkrlksub cycle dzadrbuf0 dzdmdzhl dzhksubzl dzkanal dzksubzl dzksubzlrl dzkub dzotpzhl dztimzhl fzaold_w tamn tamx taold_w tarlmn tarlmx zkhimpzl zkhimpzlrl /end LOC_MEASUREMENT
 /begin SUB_FUNCTION DFPM_DZKU /end SUB_FUNCTION
/end FUNCTION
/begin FUNCTION EAVANOS "1.70      Ein-/Auslassvanos (BMW)"
 /begin DEF_CHARACTERISTIC ASP2ADPWF ASP_ADPWF ASP_ADTV ASP_BA ASP_TVHB ASP_WNWS CW_VNSABST CW_VNSDYN ESP2ADPWF ESP_ADPWF ESP_ADTV ESP_BA ESP_TVHB ESP_WNWS KLIREGTMOT KLRANWI KLRANWP KLRENWI KLRENWP KLVNSTMOT KLVNSTVUB NMOTVNSAD NW_MIN SPRZG_AN VNSKRITLOC VNSNMOTAN VNSRTVIMN VNSRTVIMX VNSRTVMN VNSRTVMX VNSTVIABDY VNS_ADEND VNS_ADT VNS_ANAB VNS_DYN /end DEF_CHARACTERISTIC
 /begin IN_MEASUREMENT Aspr B_nmot B_nvsaad B_nvsead B_pwf B_st Espr nmot tmot ub /end IN_MEASUREMENT
 /begin OUT_MEASUREMENT B2vsaadnok B2vsaadok B2vsaadp B2vsaflan B2vsanwerr B2vseadnok B2vseadok B2vseadp B2vseflan B2vsenwerr B_npos0dyn B_npos1dyn B_npos2dyn B_npos3dyn B_vsaadnok B_vsaadok B_vsaadp B_vsaflan B_vsanwerr B_vseadnok B_vseadok B_vseadp B_vseflan B_vsenwerr Nw_pos Vnsfaktmot Vnsfaktvub Vsa2adp Vsa2adp_fl Vsa2dwnwkl Vsa2dwnwv Vsa2spri Vsa2spris Vsa2sprs Vsa2stat Vsa2tv Vsa2tv_i Vsa2tv_p Vsa2vg Vsadwnwkl Vsadwnwv Vsaspris Vsa_adp Vsa_adp_fl Vsa_spri Vsa_sprs Vsa_stat Vsa_tv Vsa_tv_i Vsa_tv_p Vsa_vg Vse2adp Vse2adp_fl Vse2dwnwkl Vse2dwnwv Vse2spri Vse2spris Vse2sprs Vse2stat Vse2tv Vse2tv_i Vse2tv_p Vse2vg Vsedwnwkl Vsedwnwv Vsespris Vse_adp Vse_adp_fl Vse_spri Vse_sprs Vse_stat Vse_tv Vse_tv_i Vse_tv_p Vse_vg wnwi_w /end OUT_MEASUREMENT
/end FUNCTION
/begin FUNCTION EBDMTL "1.116"
 /begin DEF_CHARACTERISTIC CWEBDMTL CWTLDASH CWTLDEB CWTLDEBH CWTLDEVBC CWTLDEVCP CWTLDEVEC CWTLDEVFA CWTLDEVK15 CWTLDEVMO CWTLDEVNL CWTLDEVNMT CWTLDEVOC CWTLDOBD CWTLDSES CWTLDSPF CWTLDSRQ CWTLDSTD CWTLDSTK CWTLDSTL CWTLDSTS HOTEDU MXCFCEOSD MXCFCNL MXDMTLLHV MXFADMET MXFADMTG MXFADMTL MXFLEOBD MXFOPR MXGLEOBD MXPRSEN NGLACTMX NGLTDA NGLTDW NKLDIPFMX PRCFCEOSD PRCFCNL PRDMTLCW PRDMTLLHV PRFADMET PRFADMTG PRFADMTL PRFLEOBD PRFOPR PRGLEOBD PRPRSEN SFTEDA TMSDMTLU TMSTCLST TNLDTE TNSTESMN TTEDUBV TUMGDMTLMN TUMTESO TUMTESU TWTESNL TXDMTSMX UBDCFCO UBDCFCU UBTEDFAO UBTEDFAU UBTEDO UBTEDU /end DEF_CHARACTERISTIC
 /begin IN_MEASUREMENT aktend_w B_admtll B_airbag B_cddmtl B_cfceos B_diprfo B_dmtgv B_dmtllhv B_dpsf B_dtetd B_dtetk B_dtev B_dubtes B_edmtg B_fa B_fadmet B_fadmtg B_fadmtl B_fadtlbe B_fopr B_fstdmn B_fstdmx B_fsttg B_fsttldv B_kl15 B_nachl B_nmot B_pmedlo B_pmekso B_prsen B_tank B_tankg B_zdmtg B_zdmtgv fho_w fteadf imsteini tmst tnse_w tumg ubsq_w vfzg_w /end IN_MEASUREMENT
 /begin OUT_MEASUREMENT aktdmtl_w aktlauf_w aktnbeg_w aktstop_w B_dmtlrst B_esdmte B_evdmtbc B_evdmtcp B_evdmtec B_evdmtfa B_evdmtmo B_evdmtoc B_mirdmtl B_nkfl B_nkflg B_nldte B_tldinfo B_tldobd B_tldtehb B_txdmts B_ubdmte ebdmtlAusBits ebdmtlAusBits2 ebdmtlAusBitsNov evdmtbc_w evdmtcp_w evdmtec_w evdmtfa_w evdmtkl_w evdmtmo_w evdmtnl_w evdmtnmt_w evdmtoc_w mode nkfl reqdmtl_w sbdmtsh_w /end OUT_MEASUREMENT
 /begin LOC_MEASUREMENT aktendo_w aktlaufn_w aktlaufo_w aktlauft_w aktloco_w aktloc_w aktstopt_w ancldmtl andmtirq andmtlash andpf andtetd andtetk andubtes antehb antxdmts B_clddmtl B_dmgltd B_dmttnse B_globd B_klobd B_nmoton ctrcfceosd ctrcfcnl ctrdmtllhv ctrfadmet ctrfadmtg ctrfadmtl ctrfleobd ctrfopr ctrgleobd ctrprsen ebdmtlLokBits ebdmtlLokBitsNov nglact ngltdca ngltdcw rqdmtl2_w rqdmtlo_w rqdmtlt_w sbcldmtl_w sbdmtirq_w sbdpf_w sbdtetd_w sbdtetk_w sbdubtes_w sbtehb_w sbtxdmts_w stcfceosd stcfcnl stdmtllhv stfadmet stfadmtg stfadmtl stfleobd stfopr stgleobd stprsen tdmtl_w /end LOC_MEASUREMENT
/end FUNCTION
/begin FUNCTION EEDAT "18.10     Daten im EEPROM"
 /begin IN_MEASUREMENT bos01_w bosbtvfbk B_eemrdy B_eepwf ozbgBits2_1s ozcttagini ozggBits2_1s ozkmlow ozkmreg ozkmstrw0 ozkvbog ozkvbsm_ul ozlangmw ozlf1c ozlf1t ozlf2c ozlf2t ozlowcnt ozlowkm ozlowperex ozlowperm0 ozlowrwanz oznivBits2_1s oznivBits4_1s ozniverrz oznivkm ozoelkm ozpermanz ozpermBits1_1s ozpermBits3_1s ozpermbog ozpermerrz ozpermex ozpermlow ozpermoff ozpermreg ozprfstrg ozprref_w ozrestkmBits_1s ozrwanz ozsigerrz oztemperrz ozvfbdmew todeltime zrbosmld /end IN_MEASUREMENT
 /begin OUT_MEASUREMENT B_eepdif B_eepinioz minhubvsnv S_VSMNHBNV /end OUT_MEASUREMENT
/end FUNCTION
/begin FUNCTION ELS "1.20      E-Box L¸fter Steuerung" /begin DEF_CHARACTERISTIC CWELS DTEBLEIN TEBLEIN TELSVVVT TTEBL /end DEF_CHARACTERISTIC /begin IN_MEASUREMENT B_nmot tsg vvt_luft vvt_luft2 /end IN_MEASUREMENT /begin OUT_MEASUREMENT B_ebl /end OUT_MEASUREMENT /end FUNCTION
/begin FUNCTION ERCO_ERR "" /begin OUT_MEASUREMENT E_OS_LIMIT_ctr /end OUT_MEASUREMENT /end FUNCTION
/begin FUNCTION ESGRU "36.10     Grundeinspritzungen" /begin DEF_CHARACTERISTIC FRHOKRST FRKAP KFLF /end DEF_CHARACTERISTIC /begin IN_MEASUREMENT nmot rl tkrst vsfrk /end IN_MEASUREMENT /begin OUT_MEASUREMENT fgru /end OUT_MEASUREMENT /end FUNCTION
/begin FUNCTION ESNST "16.50     Einspritzung Nachstart"
 /begin DEF_CHARACTERISTIC ANZTIBMX FNSA FNSHO FNSSM FNSSMVT FWSTAA1 FWSTAA2 FWSTAA3 FWSTAA4 FZANSSA1 FZANSSA1VT FZANSSA2 FZANSSA2VT FZANSSM1 FZANSSM1VT FZANSSM2 FZANSSM2VT KFFNSW KFLANS KFNSWRL KFNSWRLVT KFWWNS KFWWNSVT SZANSSM SZANSSMVT ZDGZA1 ZDGZA1VT ZDGZA2 ZDGZA2VT /end DEF_CHARACTERISTIC
 /begin REF_CHARACTERISTIC SAN12ESUW SKS06ESUB STA06ESUB STS12ESUB /end REF_CHARACTERISTIC
 /begin IN_MEASUREMENT anzti_w B_frz_hub B_hst B_st B_staa B_stend B_wks ESSTTbits esst_san12esuw esst_sks06esub esst_sta06esub esst_sts12esub fho kstaa rl tabst_w tans tmst tmst_w /end IN_MEASUREMENT
 /begin OUT_MEASUREMENT anztib_w B_lamnse fns lamns_w /end OUT_MEASUREMENT
 /begin LOC_MEASUREMENT anztibstnd anzti_stnd fktns fzans1 fzans1vt fzans2 nsactr nsactr1 nsactr1vt nsactr2 /end LOC_MEASUREMENT
/end FUNCTION
/begin FUNCTION ESSTT "16.70     Einspritzzeit Start"
 /begin DEF_CHARACTERISTIC ANZTIWS CWESSTT FHSTT FKSTT FKSTTGD IMLHS KFFWST KFWHSTT KFWKSTN KFWKSTT KLFWST TANDT TMH TMHSG /end DEF_CHARACTERISTIC
 /begin IN_MEASUREMENT anzti_w B_gdst B_pwf B_st B_stend imlatm kstaa nmotz tabst_w tans tansab tistzyl tmotab tmst tnse_w zzyl /end IN_MEASUREMENT
 /begin OUT_MEASUREMENT B_hst B_vbemg B_wks B_wst ESSTTbits fst_w tmlauf_w /end OUT_MEASUREMENT
 /begin LOC_MEASUREMENT anztist B_vbmg fst0_w tstlauf_w /end LOC_MEASUREMENT
/end FUNCTION
/begin FUNCTION ESUK "14.80     Einspritzung ‹bergangskompensation"
 /begin DEF_CHARACTERISTIC DRLTOTVTLL DRLTOTVVT DUKK ESUKRLP FUKE FUKNSTHO FUKNSTM FVANST FWFN KFABAK KFAKBTD KFAKBVVT KFAKTVVT KFAKVTD KFAKVVVT KFAKWVVT KFAVAK KFBAKL KFFAKRL KFVAKL KLBATANS KLVATANS RKAKVTEMN RKAKVTEMX RKAKVTGMN RKAKVTGMX RKBAUM RKBAUMDK RKUKKLU RKVAUM RKVAUMDK TNSTLUUK TNSUUK WFRL ZBALM ZKRLSOLVT ZUKE ZUKK ZUKNST ZVALM /end DEF_CHARACTERISTIC
 /begin REF_CHARACTERISTIC SNM07ESUB STM09ESUB /end REF_CHARACTERISTIC
 /begin IN_MEASUREMENT anzti B_ll B_nswo2 B_sa B_st B_stend dpsfak dpssol_uw drlp_w drlsol_w esst_snm07esub esst_stm09esub fho fukaba_w fukava_w gangi minhub_w nmot nmot_w rkukdk_w rkukgdk_w rl rlp_w rlsol_w rl_w tans tmot tmst tseg_l /end IN_MEASUREMENT
 /begin OUT_MEASUREMENT B_ba B_bag B_redkl B_uk1 B_uke B_ukg B_va B_vag B_wf rkakvvt_w rkukgvt_w rkukg_w rkukk_w /end OUT_MEASUREMENT
 /begin LOC_MEASUREMENT abak anztis avak B_ukk B_ukns B_vaau B_vakl B_val ddrkakvt_w drkakvt_w drkuke_w drlsolvt_seg drlsolvt_w dwfk_w dwfl_w dwf_w fbakl_w fbans fbans_w fbavst_w fvakl_w fvans fvavst_w rkukdps_w rkuke_w rkukkl_w rkukl_w rkuk_w rlsolfvt_w rlvtw_w sdwfk_w sdwfl_w wf_w zbale zvale /end LOC_MEASUREMENT
/end FUNCTION
/begin FUNCTION ESUKDK "2.90      Einspritzung ‹bergangskomp. DK-Anteil"
 /begin DEF_CHARACTERISTIC DRLTOTDK DRLTOTDKLL DUKKDK FUKEDK FUKNSTHOD FUKNSTMDK FVANSTDK FWFNDK KFABAKDK KFAKBDK KFAKTDK KFAKVDK KFAKWDK KFAVAKDK KFBAKLDK KFFAKRLDK KFVAKLDK KFWFRLDK KLBATANSDK KLVATANSDK RKAKDKEMN RKAKDKEMX RKAKDKGMN RKAKDKGMX RKUKKLUDK ZBALMDK ZKRLSOLDK ZUKEDK ZUKKDK ZUKNSTDK ZVALMDK /end DEF_CHARACTERISTIC
 /begin REF_CHARACTERISTIC SNM07ESUB STM09ESUB /end REF_CHARACTERISTIC
 /begin IN_MEASUREMENT B_ll B_redkl B_sa B_st B_uk1 B_uke B_wf drlp_w esst_snm07esub esst_stm09esub evhubi_w fho gangi nmot nmot_w rl rlp_w rlsol_w rl_w tans tmot tmst tseg_l /end IN_MEASUREMENT
 /begin OUT_MEASUREMENT B_ukgdk rkakdk_w rkukgdk_w rkukkdk_w /end OUT_MEASUREMENT
 /begin LOC_MEASUREMENT abakdk avakdk B_ukkdk B_vaaudk B_vakldk B_valdk ddrkakdk_w drkakdk_w drkuked_w drlsoldk_seg drlsoldk_w dwfdk_w dwfkdk_w dwfldk_w fbakldk_w fbansdk fbansdk_w fvakldk_w fvansdk rkukdk_w rkukedk_w rkukkld_w rkukldk_w rldkw_w rlsolfdk_w sdwfkdk_w sdwfldk_w wfdk_w zbaledk zvaledk /end LOC_MEASUREMENT
/end FUNCTION
/begin FUNCTION ESVW "2.80      Einspritzung: Berechnung der Vorlagerungswinkel"
 /begin DEF_CHARACTERISTIC CWESVW DWEEMX KFWEE KFWEEGD KFWEEST KFWEESTGD MRFAVW WEAN WEEM WEEMGD WEEMRFAN /end DEF_CHARACTERISTIC
 /begin REF_CHARACTERISTIC SNM08GKUB SRL08GKUB /end REF_CHARACTERISTIC
 /begin IN_MEASUREMENT B_stend dpsfak esst_snm08gkub esst_srl08gkub mrfa_w nmot rl tmot vsvw /end IN_MEASUREMENT
 /begin OUT_MEASUREMENT B_esbnb B_esbst esvw_bit wea wvesp /end OUT_MEASUREMENT
 /begin LOC_MEASUREMENT B_mrfamx weemrfa wvespnst wvespst /end LOC_MEASUREMENT
/end FUNCTION
/begin FUNCTION ESWE "1.60      Einspritzung Schubabschalten Wiedereinsetzen" /begin DEF_CHARACTERISTIC FIMHU FIMWU /end DEF_CHARACTERISTIC /begin IN_MEASUREMENT anzti B_ll B_sa /end IN_MEASUREMENT /begin OUT_MEASUREMENT fwe /end OUT_MEASUREMENT /begin LOC_MEASUREMENT anzwefim azylwe B_afwe B_fwe /end LOC_MEASUREMENT /end FUNCTION
/begin COMPU_METHOD B_TRUE "boolsche Zust‰nde, positive Logik" TAB_VERB "%6.3" "" COMPU_TAB_REF B_TRUE /end COMPU_METHOD
/begin COMPU_VTAB B_TRUE "boolsche Zust‰nde, positive Logik" TAB_VERB 2 0 "----" 1 "TRUE" /end COMPU_VTAB
/begin COMPU_METHOD DEZ "1 : 1 Umrechnug (dez/hex)" RAT_FUNC "%6.2" "" COEFFS 0 1 0 0 0 1 /end COMPU_METHOD
/begin COMPU_METHOD dez "1 : 1 Umrechnug (dez/hex)" RAT_FUNC "%6.2" "" COEFFS 0 1 0 0 0 1 /end COMPU_METHOD
/begin COMPU_METHOD fak_sb_b64 "" RAT_FUNC "%6.3" "-" COEFFS 0 256 0 0 0 128 /end COMPU_METHOD
/begin COMPU_METHOD fak_sw_b256 "" RAT_FUNC "%6.4" "-" COEFFS 0 65536 0 0 0 512 /end COMPU_METHOD
/begin COMPU_METHOD fak_sw_b64 "" RAT_FUNC "%6.4" "-" COEFFS 0 65536 0 0 0 128 /end COMPU_METHOD
/begin COMPU_METHOD fak_sw_b8 "" RAT_FUNC "%6.5" "-" COEFFS 0 65536 0 0 0 16 /end COMPU_METHOD
/begin COMPU_METHOD fak_ub_b0p125 "" RAT_FUNC "%6.5" "-" COEFFS 0 256 0 0 0 0.125 /end COMPU_METHOD
/begin COMPU_METHOD fak_ub_b0p25 "" RAT_FUNC "%10.7" "-" COEFFS 0 256 0 0 0 0.25 /end COMPU_METHOD
/begin COMPU_METHOD fak_ub_b1 "" RAT_FUNC "%6.4" "-" COEFFS 0 256 0 0 0 1 /end COMPU_METHOD
/begin COMPU_METHOD fak_ub_b12p45 "" RAT_FUNC "%6.4" "%" COEFFS 0 2048 0 0 0 100 /end COMPU_METHOD
/begin COMPU_METHOD fak_ub_b16 "" RAT_FUNC "%6.4" "-" COEFFS 0 256 0 0 0 16 /end COMPU_METHOD
/begin COMPU_METHOD fak_ub_b1p25_o0p75 "" RAT_FUNC "%6.3" "-" COEFFS 0 1 -0.75 0 0 0.00195313 /end COMPU_METHOD
/begin COMPU_METHOD fak_ub_b2 "" RAT_FUNC "%6.4" "-" COEFFS 0 256 0 0 0 2 /end COMPU_METHOD
/begin COMPU_METHOD fak_ub_b32 "" RAT_FUNC "%6.3" "-" COEFFS 0 256 0 0 0 32 /end COMPU_METHOD
/begin COMPU_METHOD fak_ub_b4 "" RAT_FUNC "%6.4" "-" COEFFS 0 256 0 0 0 4 /end COMPU_METHOD
/begin COMPU_METHOD fak_ub_b64 "" RAT_FUNC "%6.3" "-" COEFFS 0 256 0 0 0 64 /end COMPU_METHOD
/begin COMPU_METHOD fak_ub_b8 "" RAT_FUNC "%6.4" "-" COEFFS 0 256 0 0 0 8 /end COMPU_METHOD
/begin COMPU_METHOD fak_ub_q0p00392 "" RAT_FUNC "%6.4" "-" COEFFS 0 255 0 0 0 1 /end COMPU_METHOD
/begin COMPU_METHOD fak_ub_q0p01 "" RAT_FUNC "%6.4" "-" COEFFS 0 1 0 0 0 0.01 /end COMPU_METHOD
/begin COMPU_METHOD fak_uw_b1 "" RAT_FUNC "%7.6" "-" COEFFS 0 65536 0 0 0 1 /end COMPU_METHOD
/begin COMPU_METHOD fak_uw_b16 "" RAT_FUNC "%6.5" "-" COEFFS 0 65536 0 0 0 16 /end COMPU_METHOD
/begin COMPU_METHOD fak_uw_b2 "" RAT_FUNC "%7.6" "-" COEFFS 0 65536 0 0 0 2 /end COMPU_METHOD
/begin COMPU_METHOD fak_uw_b4 "" RAT_FUNC "%7.6" "-" COEFFS 0 65536 0 0 0 4 /end COMPU_METHOD
/begin COMPU_METHOD fak_uw_b64 "" RAT_FUNC "%6.5" "-" COEFFS 0 65536 0 0 0 64 /end COMPU_METHOD
/begin COMPU_METHOD fak_uw_b8 "" RAT_FUNC "%6.5" "-" COEFFS 0 65536 0 0 0 8 /end COMPU_METHOD
/begin COMPU_METHOD fak_uw_q0p001 "" RAT_FUNC "%6.5" "-" COEFFS 0 65536 0 0 0 65.536 /end COMPU_METHOD
/begin COMPU_METHOD hub_uw_q0p001 "" RAT_FUNC "%6.5" "mm" COEFFS 0 1000 0 0 0 1 /end COMPU_METHOD
/begin COMPU_METHOD i_q6p1035_uA "" RAT_FUNC "%6.4" "mA" COEFFS 0 65536 0 0 0 400 /end COMPU_METHOD
/begin COMPU_METHOD km_uw_q10 "" RAT_FUNC "%6.1" "km" COEFFS 0 1 0 0 0 10 /end COMPU_METHOD
/begin COMPU_METHOD kw_q3 "" RAT_FUNC "%6.2" "Grad KW" COEFFS 0 1 0 0 0 3 /end COMPU_METHOD
/begin COMPU_METHOD m_sw_q0p1 "" RAT_FUNC "%6.3" "kg/h" COEFFS 0 1 0 0 0 0.1 /end COMPU_METHOD
/begin COMPU_METHOD m_ub_b23p3 "" RAT_FUNC "%6.3" "kg" COEFFS 0 2812.5 0 0 0 256 /end COMPU_METHOD
/begin COMPU_METHOD nmot_sw_q0p25 "" RAT_FUNC "%6.3" "1/min" COEFFS 0 1 0 0 0 0.25 /end COMPU_METHOD
/begin COMPU_METHOD nmot_ub_q10 "" RAT_FUNC "%6.1" "1/min" COEFFS 0 1 0 0 0 10 /end COMPU_METHOD
/begin COMPU_METHOD nmot_ub_q40 "" RAT_FUNC "%6.1" "1/min" COEFFS 0 1 0 0 0 40 /end COMPU_METHOD
/begin COMPU_METHOD nmot_uw_q0p25 "" RAT_FUNC "%6.3" "1/min" COEFFS 0 1 0 0 0 0.25 /end COMPU_METHOD
/begin COMPU_METHOD p_q0p039 "" RAT_FUNC "%6.4" "hPa" COEFFS 0 256 0 0 0 10 /end COMPU_METHOD
/begin COMPU_METHOD p_sw_q0p039 "" RAT_FUNC "%6.4" "hPa" COEFFS 0 256 0 0 0 10 /end COMPU_METHOD
/begin COMPU_METHOD p_sw_q0p156 "" RAT_FUNC "%6.3" "hPa" COEFFS 0 65536 0 0 0 10240 /end COMPU_METHOD
/begin COMPU_METHOD rel_sw_b1536 "" RAT_FUNC "%6.4" "%" COEFFS 0 65536 0 0 0 3072 /end COMPU_METHOD
/begin COMPU_METHOD rel_sw_q0p02441 "" RAT_FUNC "%6.4" "%" COEFFS 0 65536 0 0 0 1600 /end COMPU_METHOD
/begin COMPU_METHOD rel_sw_q0p1875 "" RAT_FUNC "%6.3" "%" COEFFS 0 65536 0 0 0 12288 /end COMPU_METHOD
/begin COMPU_METHOD rel_ub_b100 "" RAT_FUNC "%6.3" "%" COEFFS 0 256 0 0 0 100 /end COMPU_METHOD
/begin COMPU_METHOD rel_ub_b1p4941 "" RAT_FUNC "%6.4" "%" COEFFS 0 256 0 0 0 1.5 /end COMPU_METHOD
/begin COMPU_METHOD rel_ub_b99p6 "" RAT_FUNC "%6.3" "%" COEFFS 0 256 0 0 0 100 /end COMPU_METHOD
/begin COMPU_METHOD rel_ub_q0p75 "" RAT_FUNC "%6.3" "%" COEFFS 0 1 0 0 0 0.75 /end COMPU_METHOD
/begin COMPU_METHOD rel_uw_b100 "" RAT_FUNC "%6.4" "%" COEFFS 0 65536 0 0 0 100 /end COMPU_METHOD
/begin COMPU_METHOD rel_uw_b200 "" RAT_FUNC "%6.4" "%" COEFFS 0 65536 0 0 0 200 /end COMPU_METHOD
/begin COMPU_METHOD rel_uw_b6144 "" RAT_FUNC "%6.3" "%" COEFFS 0 65536 0 0 0 6144 /end COMPU_METHOD
/begin COMPU_METHOD rel_uw_q0p0234 "" RAT_FUNC "%6.4" "%" COEFFS 0 32 0 0 0 0.75 /end COMPU_METHOD
/begin COMPU_METHOD rel_uw_q0p125 "" RAT_FUNC "%6.3" "%" COEFFS 0 8 0 0 0 1 /end COMPU_METHOD
/begin COMPU_METHOD rel_uw_q0p1875 "" RAT_FUNC "%6.3" "%" COEFFS 0 65536 0 0 0 12288 /end COMPU_METHOD
/begin COMPU_METHOD spg_q0p00039 "" RAT_FUNC "%6.5" "V" COEFFS 0 1 0 0 0 0.000390625 /end COMPU_METHOD
/begin COMPU_METHOD spg_q4p88Em4 "" RAT_FUNC "%6.5" "V" COEFFS 0 2048 0 0 0 1 /end COMPU_METHOD
/begin COMPU_METHOD spg_ubatt "" RAT_FUNC "%6.3" "V" COEFFS 0 1 0 0 0 0.0942 /end COMPU_METHOD
/begin COMPU_METHOD sprzivg_q0p781 "" RAT_FUNC "%6.3" "Grad KW/s" COEFFS 0 1.28 0 0 0 1 /end COMPU_METHOD
/begin COMPU_METHOD sprzi_q0p05 "" RAT_FUNC "%6.4" "Grad KW" COEFFS 0 20 0 0 0 1 /end COMPU_METHOD
/begin COMPU_METHOD sprzi_q0p1 "" RAT_FUNC "%6.3" "Grad KW" COEFFS 0 10 0 0 0 1 /end COMPU_METHOD
/begin COMPU_METHOD sprzi_q0p1s32768 "" RAT_FUNC "%7.1" "Grad KW" COEFFS 0 10 32768 0 0 1 /end COMPU_METHOD
/begin COMPU_METHOD t100msxs_sb_q0p01 "" RAT_FUNC "%6.4" "s" COEFFS 0 1 0 0 0 0.01 /end COMPU_METHOD
/begin COMPU_METHOD t100msxs_ub_b25p5 "" RAT_FUNC "%6.3" "s" COEFFS 0 1 0 0 0 0.1 /end COMPU_METHOD
/begin COMPU_METHOD t100msxs_uw_b6553p5 "" RAT_FUNC "%6.3" "s" COEFFS 0 1 0 0 0 0.1 /end COMPU_METHOD
/begin COMPU_METHOD t100msxs_uw_b6553p6 "" RAT_FUNC "%6.3" "s" COEFFS 0 10 0 0 0 1 /end COMPU_METHOD
/begin COMPU_METHOD t10msxs_uw_b655p35 "" RAT_FUNC "%6.4" "s" COEFFS 0 1 0 0 0 0.01 /end COMPU_METHOD
/begin COMPU_METHOD t1sxs_ub_q1 "" RAT_FUNC "%6.2" "s" COEFFS 0 1 0 0 0 1 /end COMPU_METHOD
/begin COMPU_METHOD t1sxs_uw_q1 "" RAT_FUNC "%6.2" "s" COEFFS 0 1 0 0 0 1 /end COMPU_METHOD
/begin COMPU_METHOD t20msxs_uw_b1310 "" RAT_FUNC "%6.4" "s" COEFFS 0 1 0 0 0 0.02 /end COMPU_METHOD
/begin COMPU_METHOD t20msxs_uw_q0p02 "" RAT_FUNC "%6.4" "s" COEFFS 0 1 0 0 0 0.02 /end COMPU_METHOD
/begin COMPU_METHOD t50msxs_ub_b12p75 "" RAT_FUNC "%6.4" "s" COEFFS 0 1 0 0 0 0.05 /end COMPU_METHOD
/begin COMPU_METHOD t6minxmin_q6 "" RAT_FUNC "%6.2" "min" COEFFS 0 1 0 0 0 6 /end COMPU_METHOD
/begin COMPU_METHOD temp_sb_q0p75 "" RAT_FUNC "%6.3" "Grad C" COEFFS 0 1 0 0 0 0.75 /end COMPU_METHOD
/begin COMPU_METHOD temp_ub_b191p25 "" RAT_FUNC "%6.3" "Grad C" COEFFS 0 1 0 0 0 0.75 /end COMPU_METHOD
/begin COMPU_METHOD temp_ub_q0p75 "" RAT_FUNC "%6.3" "Grad C" COEFFS 0 1 0 0 0 0.75 /end COMPU_METHOD
/begin COMPU_METHOD temp_ub_q0p75_o48 "" RAT_FUNC "%6.2" "Grad C" COEFFS 0 1 48 0 0 0.75 /end COMPU_METHOD
/begin COMPU_METHOD temp_uw_q0p75_o48 "" RAT_FUNC "%6.2" "Grad C" COEFFS 0 1 48 0 0 0.75 /end COMPU_METHOD
/begin COMPU_METHOD tv_ub_b100 "" RAT_FUNC "%6.3" "%TV" COEFFS 0 256 0 0 0 100 /end COMPU_METHOD
/begin COMPU_METHOD txms_uw_q0p001 "" RAT_FUNC "%6.5" "ms" COEFFS 0 1000 0 0 0 1 /end COMPU_METHOD
/begin COMPU_METHOD t_q0p1 "" RAT_FUNC "%6.3" "s" COEFFS 0 10 0 0 0 1 /end COMPU_METHOD
/begin COMPU_METHOD vfzg_ub_q1p25 "" RAT_FUNC "%6.2" "km/h" COEFFS 0 1 0 0 0 1.25 /end COMPU_METHOD
/begin COMPU_METHOD vfzg_uw_b512 "" RAT_FUNC "%6.4" "km/h" COEFFS 0 65536 0 0 0 512 /end COMPU_METHOD
/begin COMPU_METHOD vnstv_q0p00305 "" RAT_FUNC "%7.5" "%" COEFFS 0 327.68 0 0 0 1 /end COMPU_METHOD
/begin COMPU_METHOD vnstv_q0p00305s32768 "" RAT_FUNC "%7.3" "%" COEFFS 0 327.68 32768 0 0 1 /end COMPU_METHOD
/begin COMPU_METHOD vnstv_q0p01 "" RAT_FUNC "%7.5" "%" COEFFS 0 100 0 0 0 1 /end COMPU_METHOD
/begin COMPU_METHOD wink_uw_q0p1 "" RAT_FUNC "%6.3" "Grad" COEFFS 0 10 0 0 0 1 /end COMPU_METHOD
/begin COMPU_METHOD wkw_sw_b128 "" RAT_FUNC "%6.4" "Grad KW" COEFFS 0 256 0 0 0 1 /end COMPU_METHOD
/begin COMPU_METHOD zk100msxs_ub_b25p5 "" RAT_FUNC "%6.3" "s" COEFFS 0 0 256 0 10 0 /end COMPU_METHOD
/begin COMPU_METHOD zk100msxs_uw_b6553 "" RAT_FUNC "%6.1" "s" COEFFS 0 0 65536 0 10 0 /end COMPU_METHOD
/begin COMPU_METHOD zk10msxs_uw_b655 "" RAT_FUNC "%6.2" "s" COEFFS 0 0 65536 0 100 0 /end COMPU_METHOD
/begin COMPU_METHOD zk50msxs_uw_b3276p8 "" RAT_FUNC "%6.1" "s" COEFFS 0 0 65536 0 20 0 /end COMPU_METHOD
/begin COMPU_METHOD default "" RAT_FUNC "%6.2" "" COEFFS 0 1 0 0 0 1 /end COMPU_METHOD
/begin RECORD_LAYOUT FklWUb FNC_VALUES 1 UBYTE COLUMN_DIR DIRECT /end RECORD_LAYOUT
/begin RECORD_LAYOUT FklWUw FNC_VALUES 1 UWORD COLUMN_DIR DIRECT /end RECORD_LAYOUT
/begin RECORD_LAYOUT GkfWU8 FNC_VALUES 1 UBYTE COLUMN_DIR DIRECT /end RECORD_LAYOUT
/begin RECORD_LAYOUT GkfWUb FNC_VALUES 1 UBYTE COLUMN_DIR DIRECT /end RECORD_LAYOUT
/begin RECORD_LAYOUT GkfWUw FNC_VALUES 1 UWORD COLUMN_DIR DIRECT /end RECORD_LAYOUT
/begin RECORD_LAYOUT GklWSw FNC_VALUES 1 SWORD COLUMN_DIR DIRECT /end RECORD_LAYOUT
/begin RECORD_LAYOUT GklWU16 FNC_VALUES 1 UWORD COLUMN_DIR DIRECT /end RECORD_LAYOUT
/begin RECORD_LAYOUT GklWU8 FNC_VALUES 1 UBYTE COLUMN_DIR DIRECT /end RECORD_LAYOUT
/begin RECORD_LAYOUT GklWUb FNC_VALUES 1 UBYTE COLUMN_DIR DIRECT /end RECORD_LAYOUT
/begin RECORD_LAYOUT KfAxU8AyU8SstxU16SstyU16WU16 NO_AXIS_PTS_X 1 UWORD NO_AXIS_PTS_Y 2 UWORD AXIS_PTS_X 3 UWORD INDEX_INCR DIRECT AXIS_PTS_Y 4 UWORD INDEX_INCR DIRECT FNC_VALUES 5 UWORD COLUMN_DIR DIRECT /end RECORD_LAYOUT
/begin RECORD_LAYOUT KfAxUbAyUbSstxSwSstyUbWSw NO_AXIS_PTS_X 1 UBYTE NO_AXIS_PTS_Y 2 UBYTE AXIS_PTS_X 3 SWORD INDEX_INCR DIRECT AXIS_PTS_Y 4 UBYTE INDEX_INCR DIRECT FNC_VALUES 5 SWORD COLUMN_DIR DIRECT /end RECORD_LAYOUT
/begin RECORD_LAYOUT KfAxUbAyUbSstxUbSstyUbWUb NO_AXIS_PTS_X 1 UBYTE NO_AXIS_PTS_Y 2 UBYTE AXIS_PTS_X 3 UBYTE INDEX_INCR DIRECT AXIS_PTS_Y 4 UBYTE INDEX_INCR DIRECT FNC_VALUES 5 UBYTE COLUMN_DIR DIRECT /end RECORD_LAYOUT
/begin RECORD_LAYOUT KfAxUbAyUbSstxUwSstyUbWUb NO_AXIS_PTS_X 1 UBYTE NO_AXIS_PTS_Y 2 UBYTE AXIS_PTS_X 3 UWORD INDEX_INCR DIRECT AXIS_PTS_Y 4 UBYTE INDEX_INCR DIRECT FNC_VALUES 5 UBYTE COLUMN_DIR DIRECT /end RECORD_LAYOUT
/begin RECORD_LAYOUT KlAUbSstUbWUb NO_AXIS_PTS_X 1 UBYTE AXIS_PTS_X 2 UBYTE INDEX_INCR DIRECT FNC_VALUES 3 UBYTE COLUMN_DIR DIRECT /end RECORD_LAYOUT
/begin RECORD_LAYOUT KlAUwSstUwWUw NO_AXIS_PTS_X 1 UWORD AXIS_PTS_X 2 UWORD INDEX_INCR DIRECT FNC_VALUES 3 UWORD COLUMN_DIR DIRECT /end RECORD_LAYOUT
/begin RECORD_LAYOUT KlAxU8SstxS16WS16 NO_AXIS_PTS_X 1 SWORD AXIS_PTS_X 2 SWORD INDEX_INCR DIRECT FNC_VALUES 3 SWORD COLUMN_DIR DIRECT /end RECORD_LAYOUT
/begin RECORD_LAYOUT KlAxU8SstxU16WS16 NO_AXIS_PTS_X 1 UWORD AXIS_PTS_X 2 UWORD INDEX_INCR DIRECT FNC_VALUES 3 SWORD COLUMN_DIR DIRECT /end RECORD_LAYOUT
/begin RECORD_LAYOUT KlAxU8SstxU16WU16 NO_AXIS_PTS_X 1 UWORD AXIS_PTS_X 2 UWORD INDEX_INCR DIRECT FNC_VALUES 3 UWORD COLUMN_DIR DIRECT /end RECORD_LAYOUT
/begin RECORD_LAYOUT KlAxU8SstxU8WS8 NO_AXIS_PTS_X 1 UBYTE AXIS_PTS_X 2 UBYTE INDEX_INCR DIRECT FNC_VALUES 3 SBYTE COLUMN_DIR DIRECT /end RECORD_LAYOUT
/begin RECORD_LAYOUT KlAxU8SstxU8WU16 NO_AXIS_PTS_X 1 UBYTE AXIS_PTS_X 2 UBYTE INDEX_INCR DIRECT FNC_VALUES 3 UWORD COLUMN_DIR DIRECT /end RECORD_LAYOUT
/begin RECORD_LAYOUT KlAxU8SstxU8WU8 NO_AXIS_PTS_X 1 UBYTE AXIS_PTS_X 2 UBYTE INDEX_INCR DIRECT FNC_VALUES 3 UBYTE COLUMN_DIR DIRECT /end RECORD_LAYOUT
/begin RECORD_LAYOUT KwbUw FNC_VALUES 1 UWORD COLUMN_DIR DIRECT /end RECORD_LAYOUT
/begin RECORD_LAYOUT KwbWU16 FNC_VALUES 1 UWORD COLUMN_DIR DIRECT /end RECORD_LAYOUT
/begin RECORD_LAYOUT KwSw FNC_VALUES 1 SWORD COLUMN_DIR DIRECT /end RECORD_LAYOUT
/begin RECORD_LAYOUT KwUb FNC_VALUES 1 UBYTE COLUMN_DIR DIRECT /end RECORD_LAYOUT
/begin RECORD_LAYOUT KwUw FNC_VALUES 1 UWORD COLUMN_DIR DIRECT /end RECORD_LAYOUT
/begin RECORD_LAYOUT KwWS8 FNC_VALUES 1 SBYTE COLUMN_DIR DIRECT /end RECORD_LAYOUT
/begin RECORD_LAYOUT KwWU16 FNC_VALUES 1 UWORD COLUMN_DIR DIRECT /end RECORD_LAYOUT
/begin RECORD_LAYOUT KwWU8 FNC_VALUES 1 UBYTE COLUMN_DIR DIRECT /end RECORD_LAYOUT
/begin RECORD_LAYOUT SstAU8SstU8 NO_AXIS_PTS_X 1 UBYTE AXIS_PTS_X 2 UBYTE INDEX_INCR DIRECT /end RECORD_LAYOUT
/begin RECORD_LAYOUT SstAUbSstUb NO_AXIS_PTS_X 1 UBYTE AXIS_PTS_X 2 UBYTE INDEX_INCR DIRECT /end RECORD_LAYOUT
/begin RECORD_LAYOUT SstAUwSstUw NO_AXIS_PTS_X 1 UWORD AXIS_PTS_X 2 UWORD INDEX_INCR DIRECT /end RECORD_LAYOUT
/end MODULE
/end PROJECT
