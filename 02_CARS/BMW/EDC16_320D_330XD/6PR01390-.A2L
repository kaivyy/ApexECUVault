ASAP2_VERSION 1 3
/begin PROJECT P390 "BMW DDE6.2 6-Zylinder VR0.1 15.03.2004 CAN11/12H"
/begin HEADER "" VERSION "VR0.1_6Z_CAN11/12H" PROJECT_NO P390 /end HEADER
/begin MODULE DIM ""
/begin MOD_COMMON "" BYTE_ORDER MSB_FIRST ALIGNMENT_BYTE 1 ALIGNMENT_WORD 2 ALIGNMENT_LONG 4 ALIGNMENT_FLOAT32_IEEE 4 /end MOD_COMMON
/begin MEASUREMENT DfpErrCol_mp "Meßpunkt der für alle Fehlerpfade die Fehlerinformation gesammelt zur Verfügung stellt." UWORD OneToOne 1 100 0.00 65535.00 FORMAT "%8.2" ARRAY_SIZE 24 ECU_ADDRESS 0x6F802A /end MEASUREMENT
/begin MEASUREMENT DFPM_stFCMChkCause "Message für DSM internen gebrauch (unterstützung bei DSM problemen)" UBYTE FCMChkCause 1 100 1.00000000000 15.0000000000 FORMAT "%13.10" ECU_ADDRESS 0x7FA6C8 /end MEASUREMENT
/begin MEASUREMENT DfpZyfCol_mp "Meßpunkt der gesammelt für alle Fehlerpfade das Zyklus Bit (getested Info) zur Verfügung stellt." UWORD OneToOne 1 100 0.00 65535.00 FORMAT "%8.2" ARRAY_SIZE 24 ECU_ADDRESS 0x6F805A /end MEASUREMENT
/begin MEASUREMENT Dfp_ACCDCmpr_mp "Messpunkt fuer Fehlerpfad  Dfp_ACCDCmpr" UWORD OneToOne 1 100 0.00 65535.00 FORMAT "%8.2" ECU_ADDRESS 0x8FE606 /end MEASUREMENT
/begin MEASUREMENT Dfp_ACCDPres1_mp "Messpunkt fuer Fehlerpfad  Dfp_ACCDPres1" UWORD OneToOne 1 100 0.00 65535.00 FORMAT "%8.2" ECU_ADDRESS 0x8FE608 /end MEASUREMENT
/begin MEASUREMENT Dfp_ACCDPresAna_mp "Messpunkt fuer Fehlerpfad  Dfp_ACCDPresAna" UWORD OneToOne 1 100 0.00 65535.00 FORMAT "%8.2" ECU_ADDRESS 0x8FE60A /end MEASUREMENT
/begin MEASUREMENT Dfp_ACCDPres_mp "Messpunkt fuer Fehlerpfad  Dfp_ACCDPres" UWORD OneToOne 1 100 0.00 65535.00 FORMAT "%8.2" ECU_ADDRESS 0x8FE60C /end MEASUREMENT
/begin MEASUREMENT Dfp_ACCDSwtin_mp "Messpunkt fuer Fehlerpfad  Dfp_ACCDSwtin" UWORD OneToOne 1 100 0.00 65535.00 FORMAT "%8.2" ECU_ADDRESS 0x8FE60E /end MEASUREMENT
/begin MEASUREMENT Dfp_AccPedPlausBrk_mp "Fehlerpfad für Unplausibilität AccPed-Brk" UWORD OneToOne 1 100 0.00 65535.00 FORMAT "%8.2" ECU_ADDRESS 0x8FE610 /end MEASUREMENT
/begin MEASUREMENT Dfp_ACC_PlausTrqDes_mp "Bremse ist ACC_PlausTrqTmrDead_C [s] getreten & ACC fordert noch immer Moment." UWORD OneToOne 1 100 0.00 65535.00 FORMAT "%8.2" ECU_ADDRESS 0x8FE612 /end MEASUREMENT
/begin MEASUREMENT Dfp_ACC_trqInr_mp "Too much Torque ACC" UWORD OneToOne 1 100 0.00 65535.00 FORMAT "%8.2" ECU_ADDRESS 0x8FE614 /end MEASUREMENT
/begin MEASUREMENT Dfp_ACTrq_mp "Messpunkt fuer Fehlerpfad  Dfp_ACTrq" UWORD OneToOne 1 100 0.00 65535.00 FORMAT "%8.2" ECU_ADDRESS 0x8FE616 /end MEASUREMENT
/begin MEASUREMENT Dfp_ADCMon_mp "Messpunkt fuer Fehlerpfad  Dfp_ADCMon" UWORD OneToOne 1 100 0.00 65535.00 FORMAT "%8.2" ECU_ADDRESS 0x8FE618 /end MEASUREMENT
/begin MEASUREMENT Dfp_AFSCDIdlAdjVal_mp "Messpunkt fuer Fehlerpfad  Dfp_AFSCDIdlAdjVal" UWORD OneToOne 1 100 0.00 65535.00 FORMAT "%8.2" ECU_ADDRESS 0x8FE61A /end MEASUREMENT
/begin MEASUREMENT Dfp_AFSCDLdAdjVal_mp "Messpunkt fuer Fehlerpfad  Dfp_AFSCDLdAdjVal" UWORD OneToOne 1 100 0.00 65535.00 FORMAT "%8.2" ECU_ADDRESS 0x8FE61C /end MEASUREMENT
/begin MEASUREMENT Dfp_AFSCD_AirTempDcyc_mp "Messpunkt fuer Fehlerpfad  Dfp_AFSCD_AirTempDcyc" UWORD OneToOne 1 100 0.00 65535.00 FORMAT "%8.2" ECU_ADDRESS 0x8FE61E /end MEASUREMENT
/begin MEASUREMENT Dfp_AFSCD_PlOffsDrft_mp "Messpunkt fuer Fehlerpfad  Dfp_AFSCD_PlOffsDrft" UWORD OneToOne 1 100 0.00 65535.00 FORMAT "%8.2" ECU_ADDRESS 0x8FE620 /end MEASUREMENT
/begin MEASUREMENT Dfp_AFSCD_PlSetyDrft_mp "Messpunkt fuer Fehlerpfad  Dfp_AFSCD_PlSetyDrft" UWORD OneToOne 1 100 0.00 65535.00 FORMAT "%8.2" ECU_ADDRESS 0x8FE622 /end MEASUREMENT
/begin MEASUREMENT Dfp_AFSCD_SRCAirTemp_mp "Fehlerpfad für Prüfung auf optimal Lufttemperatur" UWORD OneToOne 1 100 0.00 65535.00 FORMAT "%8.2" ECU_ADDRESS 0x8FE624 /end MEASUREMENT
/begin MEASUREMENT Dfp_AFSCD_SRCBatt_mp "Fehlerpfad für Prüfung auf optimale Batteriespannung" UWORD OneToOne 1 100 0.00 65535.00 FORMAT "%8.2" ECU_ADDRESS 0x8FE626 /end MEASUREMENT
/begin MEASUREMENT Dfp_AFSCD_SRCCorrAirm_mp "Fehlerpfad für SRC des korrigierten Sensorsignals (HFM6)" UWORD OneToOne 1 100 0.00 65535.00 FORMAT "%8.2" ECU_ADDRESS 0x8FE628 /end MEASUREMENT
/begin MEASUREMENT Dfp_AFSCD_SRCRawAirm_mp "Fehlerpfad für SRC des unkorrigierten Sensorsignals (HFM6)" UWORD OneToOne 1 100 0.00 65535.00 FORMAT "%8.2" ECU_ADDRESS 0x8FE62A /end MEASUREMENT
/begin MEASUREMENT Dfp_AFSCD_SRCRefSigPer_mp "Fehlerpfad für SRC des Referenzsignals (Lufttemperatur-Periodendauer beim HFM6)" UWORD OneToOne 1 100 0.00 65535.00 FORMAT "%8.2" ECU_ADDRESS 0x8FE62C /end MEASUREMENT
/begin MEASUREMENT Dfp_AirCtlGvnrDvtRgnMax2_mp "" UWORD OneToOne 1 100 0.00 65535.00 FORMAT "%8.2" ECU_ADDRESS 0x8FE62E /end MEASUREMENT
/begin MEASUREMENT Dfp_AirCtlGvnrDvtRgnMax_mp "Regelabweichung in Regeneration zu groß" UWORD OneToOne 1 100 0.00 65535.00 FORMAT "%8.2" ECU_ADDRESS 0x8FE630 /end MEASUREMENT
/begin MEASUREMENT Dfp_AirCtlGvnrDvtRgnMin2_mp "" UWORD OneToOne 1 100 0.00 65535.00 FORMAT "%8.2" ECU_ADDRESS 0x8FE632 /end MEASUREMENT
/begin MEASUREMENT Dfp_AirCtlGvnrDvtRgnMin_mp "Regelabweichung in Regeneration zu klein" UWORD OneToOne 1 100 0.00 65535.00 FORMAT "%8.2" ECU_ADDRESS 0x8FE634 /end MEASUREMENT
/begin MEASUREMENT Dfp_AirCtlPlateBreak_mp "Dfp for plate break monitoring" UWORD OneToOne 1 100 0.00 65535.00 FORMAT "%8.2" ECU_ADDRESS 0x8FE636 /end MEASUREMENT
/begin MEASUREMENT Dfp_AirCtlRmpTO_mp "Fehlerpfadmeßpunkt für Zeitüberschreitung der Übergangsphase von Regenerations- zum Normalbetrieb" UWORD OneToOne 1 100 0.00 65535.00 FORMAT "%8.2" ECU_ADDRESS 0x8FE638 /end MEASUREMENT
/begin MEASUREMENT Dfp_AirCtl_GovNegDev2_mp "AirCtl permanent governor2 negative deviatio" UWORD OneToOne 1 100 0.00 65535.00 FORMAT "%8.2" ECU_ADDRESS 0x8FE63A /end MEASUREMENT
/begin MEASUREMENT Dfp_AirCtl_GovNegDev_mp "Messpunkt fuer Fehlerpfad  Dfp_AirCtl_GovNegDev" UWORD OneToOne 1 100 0.00 65535.00 FORMAT "%8.2" ECU_ADDRESS 0x8FE63C /end MEASUREMENT
/begin MEASUREMENT Dfp_AirCtl_GovPosDev2_mp "AirCtl permanent governor2 positive deviation" UWORD OneToOne 1 100 0.00 65535.00 FORMAT "%8.2" ECU_ADDRESS 0x8FE63E /end MEASUREMENT
/begin MEASUREMENT Dfp_AirCtl_GovPosDev_mp "Messpunkt fuer Fehlerpfad  Dfp_AirCtl_GovPosDev" UWORD OneToOne 1 100 0.00 65535.00 FORMAT "%8.2" ECU_ADDRESS 0x8FE640 /end MEASUREMENT
/begin MEASUREMENT Dfp_AltCD_Load_mp "Messpunkt fuer Fehlerpfad  Dfp_AltCD_Load" UWORD OneToOne 1 100 0.00 65535.00 FORMAT "%8.2" ECU_ADDRESS 0x8FE642 /end MEASUREMENT
/begin MEASUREMENT Dfp_AltCD_mp "Fehlerpfad des Generators (Kommunikationsfehler)" UWORD OneToOne 1 100 0.00 65535.00 FORMAT "%8.2" ECU_ADDRESS 0x8FE644 /end MEASUREMENT
/begin MEASUREMENT Dfp_AOHtCD_AOHtDia1_mp "Messpunkt fuer Fehlerpfad  Dfp_AOHtCD_AOHtDia1" UWORD OneToOne 1 100 0.00 65535.00 FORMAT "%8.2" ECU_ADDRESS 0x8FE646 /end MEASUREMENT
/begin MEASUREMENT Dfp_AOHtCD_AOHtDia2_mp "Messpunkt fuer Fehlerpfad  Dfp_AOHtCD_AOHtDia2" UWORD OneToOne 1 100 0.00 65535.00 FORMAT "%8.2" ECU_ADDRESS 0x8FE648 /end MEASUREMENT
/begin MEASUREMENT Dfp_AOHtCD_AOHtDia3_mp "Messpunkt fuer Fehlerpfad  Dfp_AOHtCD_AOHtDia3" UWORD OneToOne 1 100 0.00 65535.00 FORMAT "%8.2" ECU_ADDRESS 0x8FE64A /end MEASUREMENT
/begin MEASUREMENT Dfp_AOHtCD_mp "Messpunkt fuer Fehlerpfad bei PWM Endstufenfehler" UWORD OneToOne 1 100 0.00 65535.00 FORMAT "%8.2" ECU_ADDRESS 0x8FE64C /end MEASUREMENT
/begin MEASUREMENT Dfp_APP1_mp "Messpunkt fuer Fehlerpfad  Dfp_APP1" UWORD OneToOne 1 100 0.00 65535.00 FORMAT "%8.2" ECU_ADDRESS 0x8FE64E /end MEASUREMENT
/begin MEASUREMENT Dfp_APP2_mp "Messpunkt fuer Fehlerpfad  Dfp_APP2" UWORD OneToOne 1 100 0.00 65535.00 FORMAT "%8.2" ECU_ADDRESS 0x8FE650 /end MEASUREMENT
/begin MEASUREMENT Dfp_APPSync_mp "Messpunkt für Fehlerpfad Dfp_APPSync" UWORD OneToOne 1 100 0.00 65535.00 FORMAT "%8.2" ECU_ADDRESS 0x8FE652 /end MEASUREMENT
/begin MEASUREMENT Dfp_APSCD_mp "Messpunkt fuer Fehlerpfad  Dfp_APSCD" UWORD OneToOne 1 100 0.00 65535.00 FORMAT "%8.2" ECU_ADDRESS 0x8FE654 /end MEASUREMENT
/begin MEASUREMENT Dfp_ARS_mp "Fault path for ARS" UWORD OneToOne 1 100 0.00 65535.00 FORMAT "%8.2" ECU_ADDRESS 0x8FE656 /end MEASUREMENT
/begin MEASUREMENT Dfp_BattCD_mp "Messpunkt fuer Fehlerpfad  Dfp_BattCD" UWORD OneToOne 1 100 0.00 65535.00 FORMAT "%8.2" ECU_ADDRESS 0x8FE658 /end MEASUREMENT
/begin MEASUREMENT Dfp_BPACD_BPADia1_mp "Messpunkt fuer Fehlerpfad  Dfp_BPACD_BPADia1" UWORD OneToOne 1 100 0.00 65535.00 FORMAT "%8.2" ECU_ADDRESS 0x8FE65A /end MEASUREMENT
/begin MEASUREMENT Dfp_BPACD_BPADia2_mp "Messpunkt fuer Fehlerpfad  Dfp_BPACD_BPADia2" UWORD OneToOne 1 100 0.00 65535.00 FORMAT "%8.2" ECU_ADDRESS 0x8FE65C /end MEASUREMENT
/begin MEASUREMENT Dfp_BPACD_BPADia3_mp "Messpunkt fuer Fehlerpfad  Dfp_BPACD_BPADia3" UWORD OneToOne 1 100 0.00 65535.00 FORMAT "%8.2" ECU_ADDRESS 0x8FE65E /end MEASUREMENT
/begin MEASUREMENT Dfp_BPACD_Max_mp "Fehlerpfad für Kurzschluss nach Batteriespannung des Ladedruckstrellers" UWORD OneToOne 1 100 0.00 65535.00 FORMAT "%8.2" ECU_ADDRESS 0x8FE660 /end MEASUREMENT
/begin MEASUREMENT Dfp_BPACD_Min_mp "Fehlerpfad für Kurzschluss nach Masse des Ladedruckstellers" UWORD OneToOne 1 100 0.00 65535.00 FORMAT "%8.2" ECU_ADDRESS 0x8FE662 /end MEASUREMENT
/begin MEASUREMENT Dfp_BPACD_SigNpl_mp "Fehlerpfad für Lastabfall und Übertemperatur des Ladedruckstellers" UWORD OneToOne 1 100 0.00 65535.00 FORMAT "%8.2" ECU_ADDRESS 0x8FE664 /end MEASUREMENT
/begin MEASUREMENT Dfp_BPSCD_mp "Messpunkt fuer Fehlerpfad  Dfp_BPSCD" UWORD OneToOne 1 100 0.00 65535.00 FORMAT "%8.2" ECU_ADDRESS 0x8FE666 /end MEASUREMENT
/begin MEASUREMENT Dfp_BrkCD_mp "Messpunkt fuer Fehlerpfad  Dfp_BrkCD" UWORD OneToOne 1 100 0.00 65535.00 FORMAT "%8.2" ECU_ADDRESS 0x8FE668 /end MEASUREMENT
/begin MEASUREMENT Dfp_Bss_mp "Messpunkt fuer Fehlerpfad  Dfp_Bss" UWORD OneToOne 1 100 0.00 65535.00 FORMAT "%8.2" ECU_ADDRESS 0x8FE66A /end MEASUREMENT
/begin MEASUREMENT Dfp_CBACD_mp "Messpunkt fuer Fehlerpfad  Dfp_CBACD" UWORD OneToOne 1 100 0.00 65535.00 FORMAT "%8.2" ECU_ADDRESS 0x8FE66C /end MEASUREMENT
/begin MEASUREMENT Dfp_Clg_DynTst_mp "Messpunkt fuer Fehlerpfad  Dfp_Clg_DynTst" UWORD OneToOne 1 100 0.00 65535.00 FORMAT "%8.2" ECU_ADDRESS 0x8FE66E /end MEASUREMENT
/begin MEASUREMENT Dfp_CmbChbMisfire1_mp "Fehlerpfad Zündaussetzer in Zylinder 1" UWORD OneToOne 1 100 0.00 65535.00 FORMAT "%8.2" ECU_ADDRESS 0x8FE670 /end MEASUREMENT
/begin MEASUREMENT Dfp_CmbChbMisfire2_mp "Fehlerpfad Zündaussetzer in Zylinder 2" UWORD OneToOne 1 100 0.00 65535.00 FORMAT "%8.2" ECU_ADDRESS 0x8FE672 /end MEASUREMENT
/begin MEASUREMENT Dfp_CmbChbMisfire3_mp "Fehlerpfad Zündaussetzer in Zylinder 3" UWORD OneToOne 1 100 0.00 65535.00 FORMAT "%8.2" ECU_ADDRESS 0x8FE674 /end MEASUREMENT
/begin MEASUREMENT Dfp_CmbChbMisfire4_mp "Fehlerpfad Zündaussetzer in Zylinder 4" UWORD OneToOne 1 100 0.00 65535.00 FORMAT "%8.2" ECU_ADDRESS 0x8FE676 /end MEASUREMENT
/begin MEASUREMENT Dfp_CmbChbMisfire5_mp "Fehlerpfad Zündaussetzer in Zylinder 5" UWORD OneToOne 1 100 0.00 65535.00 FORMAT "%8.2" ECU_ADDRESS 0x8FE678 /end MEASUREMENT
/begin MEASUREMENT Dfp_CmbChbMisfire6_mp "Fehlerpfad Zündaussetzer in Zylinder 6" UWORD OneToOne 1 100 0.00 65535.00 FORMAT "%8.2" ECU_ADDRESS 0x8FE67A /end MEASUREMENT
/begin MEASUREMENT Dfp_CmbChbMisfireMul_mp "Fehlerpfad Zündaussetzer in mehreren Zylindern" UWORD OneToOne 1 100 0.00 65535.00 FORMAT "%8.2" ECU_ADDRESS 0x8FE67C /end MEASUREMENT
/begin MEASUREMENT Dfp_ConvCD_mp "Messpunkt fuer Fehlerpfad  Dfp_ConvCD" UWORD OneToOne 1 100 0.00 65535.00 FORMAT "%8.2" ECU_ADDRESS 0x8FE67E /end MEASUREMENT
/begin MEASUREMENT Dfp_CoVMDCSh_mp "Fehlerpfade physikalische Unplausibilität der  Motorschlupfregelung" UWORD OneToOne 1 100 0.00 65535.00 FORMAT "%8.2" ECU_ADDRESS 0x8FE680 /end MEASUREMENT
/begin MEASUREMENT Dfp_CrCCDMFL_mp "Messpunkt fuer Fehlerpfad  Dfp_CrCCDMFL" UWORD OneToOne 1 100 0.00 65535.00 FORMAT "%8.2" ECU_ADDRESS 0x8FE682 /end MEASUREMENT
/begin MEASUREMENT Dfp_CrCtl_vCrCtl_mp "Erkennung gefilterte Offset-Geschwindigkeit über Grenze beim Stufentempomat" UWORD OneToOne 1 100 0.00 65535.00 FORMAT "%8.2" ECU_ADDRESS 0x8FE684 /end MEASUREMENT
/begin MEASUREMENT Dfp_CTSCD_mp "Messpunkt fuer Fehlerpfad  Dfp_CTSCD" UWORD OneToOne 1 100 0.00 65535.00 FORMAT "%8.2" ECU_ADDRESS 0x8FE686 /end MEASUREMENT
/begin MEASUREMENT Dfp_DCC_PlausTrqDes_mp "Messpunkt fuer Fehlerpfad  Dfp_DCC_PlausTrqDes" UWORD OneToOne 1 100 0.00 65535.00 FORMAT "%8.2" ECU_ADDRESS 0x8FE688 /end MEASUREMENT
/begin MEASUREMENT Dfp_Dummy1_mp "Messpunkt fuer Fehlerpfad  Dfp_Dummy1" UWORD OneToOne 1 100 0.00 65535.00 FORMAT "%8.2" ECU_ADDRESS 0x8FE68A /end MEASUREMENT
/begin MEASUREMENT Dfp_EATSCD_mp "Messpunkt fuer Fehlerpfad  Dfp_EATSCD" UWORD OneToOne 1 100 0.00 65535.00 FORMAT "%8.2" ECU_ADDRESS 0x8FE68C /end MEASUREMENT
/begin MEASUREMENT Dfp_EBAFCD_mp "Messpunkt fuer Fehlerpfad  Dfp_EBAFCD" UWORD OneToOne 1 100 0.00 65535.00 FORMAT "%8.2" ECU_ADDRESS 0x8FE68E /end MEASUREMENT
/begin MEASUREMENT Dfp_EBFCD_mp "Messpunkt fuer Fehlerpfad  Dfp_EBFCD" UWORD OneToOne 1 100 0.00 65535.00 FORMAT "%8.2" ECU_ADDRESS 0x8FE690 /end MEASUREMENT
/begin MEASUREMENT Dfp_EBTSCD_mp "Messpunkt fuer Fehlerpfad  Dfp_EBTSCD" UWORD OneToOne 1 100 0.00 65535.00 FORMAT "%8.2" ECU_ADDRESS 0x8FE692 /end MEASUREMENT
/begin MEASUREMENT Dfp_EBTSCD_OvrTemp_mp "Messpunkt fuer Fehlerpfad  Dfp_EBTSCD_OvrTemp" UWORD OneToOne 1 100 0.00 65535.00 FORMAT "%8.2" ECU_ADDRESS 0x8FE694 /end MEASUREMENT
/begin MEASUREMENT Dfp_EEPCDVarMng_mp "Messpunkt fuer Fehlerpfad  Dfp_EEPCDVarMng" UWORD OneToOne 1 100 0.00 65535.00 FORMAT "%8.2" ECU_ADDRESS 0x8FE696 /end MEASUREMENT
/begin MEASUREMENT Dfp_EGPpCDTPreTrbn_mp "Messpunkt fuer Fehlerpfad  Dfp_EgPpCD" UWORD OneToOne 1 100 0.00 65535.00 FORMAT "%8.2" ECU_ADDRESS 0x8FE698 /end MEASUREMENT
/begin MEASUREMENT Dfp_EGPpCD_mp "Messpunkt fuer Fehlerpfad  Dfp_EGPpCD" UWORD OneToOne 1 100 0.00 65535.00 FORMAT "%8.2" ECU_ADDRESS 0x8FE69A /end MEASUREMENT
/begin MEASUREMENT Dfp_EGRCD_Max_mp "Fehlerpfad für Kurzschluss nach Batteriespannung des Abgasrückführstellers" UWORD OneToOne 1 100 0.00 65535.00 FORMAT "%8.2" ECU_ADDRESS 0x8FE69C /end MEASUREMENT
/begin MEASUREMENT Dfp_EGRCD_Min_mp "Fehlerpfad für Kurzschluss nach Masse des Abgasrückführstellers" UWORD OneToOne 1 100 0.00 65535.00 FORMAT "%8.2" ECU_ADDRESS 0x8FE69E /end MEASUREMENT
/begin MEASUREMENT Dfp_EGRCD_SigNpl_mp "Fehlerpfad für Lastabfall und Übertemperatur des Abgasrückführstellers" UWORD OneToOne 1 100 0.00 65535.00 FORMAT "%8.2" ECU_ADDRESS 0x8FE6A0 /end MEASUREMENT
/begin MEASUREMENT Dfp_EGTRgnOilDil_mp "Fehlerpfad maximale Zeit für Ölverdünnung überschritten" UWORD OneToOne 1 100 0.00 65535.00 FORMAT "%8.2" ECU_ADDRESS 0x8FE6A2 /end MEASUREMENT
/begin MEASUREMENT Dfp_EMCCDNoLoad1_mp "" UWORD OneToOne 1 100 0.00 65535.00 FORMAT "%8.2" ECU_ADDRESS 0x8FE6A4 /end MEASUREMENT
/begin MEASUREMENT Dfp_EMCCDNoLoad2_mp "" UWORD OneToOne 1 100 0.00 65535.00 FORMAT "%8.2" ECU_ADDRESS 0x8FE6A6 /end MEASUREMENT
/begin MEASUREMENT Dfp_EMCCDSCBat1_mp "" UWORD OneToOne 1 100 0.00 65535.00 FORMAT "%8.2" ECU_ADDRESS 0x8FE6A8 /end MEASUREMENT
/begin MEASUREMENT Dfp_EMCCDSCBat2_mp "" UWORD OneToOne 1 100 0.00 65535.00 FORMAT "%8.2" ECU_ADDRESS 0x8FE6AA /end MEASUREMENT
/begin MEASUREMENT Dfp_EMCCDSCGnd1_mp "" UWORD OneToOne 1 100 0.00 65535.00 FORMAT "%8.2" ECU_ADDRESS 0x8FE6AC /end MEASUREMENT
/begin MEASUREMENT Dfp_EMCCDSCGnd2_mp "" UWORD OneToOne 1 100 0.00 65535.00 FORMAT "%8.2" ECU_ADDRESS 0x8FE6AE /end MEASUREMENT
/begin MEASUREMENT Dfp_EMCCD_ADC1_mp "" UWORD OneToOne 1 100 0.00 65535.00 FORMAT "%8.2" ECU_ADDRESS 0x8FE6B0 /end MEASUREMENT
/begin MEASUREMENT Dfp_EMCCD_ADC2_mp "" UWORD OneToOne 1 100 0.00 65535.00 FORMAT "%8.2" ECU_ADDRESS 0x8FE6B2 /end MEASUREMENT
/begin MEASUREMENT Dfp_EngMCaS1_mp "Meßpunkt für Fehlerpfad Dfp_EngMCaS1" UWORD OneToOne 1 100 0.00 65535.00 FORMAT "%8.2" ECU_ADDRESS 0x8FE6B4 /end MEASUREMENT
/begin MEASUREMENT Dfp_EngMCrS1_mp "Meßpunkt für Fehlerpfad Dfp_EngMCrS1" UWORD OneToOne 1 100 0.00 65535.00 FORMAT "%8.2" ECU_ADDRESS 0x8FE6B6 /end MEASUREMENT
/begin MEASUREMENT Dfp_EngMOfsCaSCrS_mp "Meßpunkt fuer Fehlerpfad Dfp_EngMOfsCaSCrS" UWORD OneToOne 1 100 0.00 65535.00 FORMAT "%8.2" ECU_ADDRESS 0x8FE6B8 /end MEASUREMENT
/begin MEASUREMENT Dfp_EngPrtFWODet_mp "Messpunkt fuer Fehlerpfad  Dfp_EngPrtFWODet" UWORD OneToOne 1 100 0.00 65535.00 FORMAT "%8.2" ECU_ADDRESS 0x8FE6BA /end MEASUREMENT
/begin MEASUREMENT Dfp_ETClbETFltInj1_mp "Messpunkt fuer Fehlerpfad  Dfp_ETClbETFltInj1" UWORD OneToOne 1 100 0.00 65535.00 FORMAT "%8.2" ECU_ADDRESS 0x8FE6BC /end MEASUREMENT
/begin MEASUREMENT Dfp_ETClbETFltInj2_mp "Messpunkt fuer Fehlerpfad  Dfp_ETClbETFltInj2" UWORD OneToOne 1 100 0.00 65535.00 FORMAT "%8.2" ECU_ADDRESS 0x8FE6BE /end MEASUREMENT
/begin MEASUREMENT Dfp_ETClbETFltInj3_mp "Messpunkt fuer Fehlerpfad  Dfp_ETClbETFltInj3" UWORD OneToOne 1 100 0.00 65535.00 FORMAT "%8.2" ECU_ADDRESS 0x8FE6C0 /end MEASUREMENT
/begin MEASUREMENT Dfp_ETClbETFltInj4_mp "Messpunkt fuer Fehlerpfad  Dfp_ETClbETFltInj4" UWORD OneToOne 1 100 0.00 65535.00 FORMAT "%8.2" ECU_ADDRESS 0x8FE6C2 /end MEASUREMENT
/begin MEASUREMENT Dfp_ETClbETFltInj5_mp "Messpunkt fuer Fehlerpfad  Dfp_ETClbETFltInj5" UWORD OneToOne 1 100 0.00 65535.00 FORMAT "%8.2" ECU_ADDRESS 0x8FE6C4 /end MEASUREMENT
/begin MEASUREMENT Dfp_ETClbETFltInj6_mp "Messpunkt fuer Fehlerpfad  Dfp_ETClbETFltInj6" UWORD OneToOne 1 100 0.00 65535.00 FORMAT "%8.2" ECU_ADDRESS 0x8FE6C6 /end MEASUREMENT
/begin MEASUREMENT Dfp_ETClbInj1_mp "Messpunkt fuer Fehlerpfad  Dfp_ETClbInj1" UWORD OneToOne 1 100 0.00 65535.00 FORMAT "%8.2" ECU_ADDRESS 0x8FE6C8 /end MEASUREMENT
/begin MEASUREMENT Dfp_ETClbInj2_mp "Messpunkt fuer Fehlerpfad  Dfp_ETClbInj2" UWORD OneToOne 1 100 0.00 65535.00 FORMAT "%8.2" ECU_ADDRESS 0x8FE6CA /end MEASUREMENT
/begin MEASUREMENT Dfp_ETClbInj3_mp "Messpunkt fuer Fehlerpfad  Dfp_ETClbInj3" UWORD OneToOne 1 100 0.00 65535.00 FORMAT "%8.2" ECU_ADDRESS 0x8FE6CC /end MEASUREMENT
/begin MEASUREMENT Dfp_ETClbInj4_mp "Messpunkt fuer Fehlerpfad  Dfp_ETClbInj4" UWORD OneToOne 1 100 0.00 65535.00 FORMAT "%8.2" ECU_ADDRESS 0x8FE6CE /end MEASUREMENT
/begin MEASUREMENT Dfp_ETClbInj5_mp "Messpunkt fuer Fehlerpfad  Dfp_ETClbInj5" UWORD OneToOne 1 100 0.00 65535.00 FORMAT "%8.2" ECU_ADDRESS 0x8FE6D0 /end MEASUREMENT
/begin MEASUREMENT Dfp_ETClbInj6_mp "Messpunkt fuer Fehlerpfad  Dfp_ETClbInj6" UWORD OneToOne 1 100 0.00 65535.00 FORMAT "%8.2" ECU_ADDRESS 0x8FE6D2 /end MEASUREMENT
/begin MEASUREMENT Dfp_FanCD_FanCtlr1_mp "Messpunkt fuer Fehlerpfad  Dfp_FanCD_FanCtlr1" UWORD OneToOne 1 100 0.00 65535.00 FORMAT "%8.2" ECU_ADDRESS 0x8FE6D4 /end MEASUREMENT
/begin MEASUREMENT Dfp_FanCD_FanCtlr2_mp "Messpunkt fuer Fehlerpfad  Dfp_FanCD_FanCtlr2" UWORD OneToOne 1 100 0.00 65535.00 FORMAT "%8.2" ECU_ADDRESS 0x8FE6D6 /end MEASUREMENT
/begin MEASUREMENT Dfp_FanCD_FanCtlr3_mp "Messpunkt fuer Fehlerpfad  Dfp_FanCD_FanCtlr3" UWORD OneToOne 1 100 0.00 65535.00 FORMAT "%8.2" ECU_ADDRESS 0x8FE6D8 /end MEASUREMENT
/begin MEASUREMENT Dfp_FanCD_mp "Fehlerpfad signalisiert Fehler in der Zuleitung zum Lüfter" UWORD OneToOne 1 100 0.00 65535.00 FORMAT "%8.2" ECU_ADDRESS 0x8FE6DA /end MEASUREMENT
/begin MEASUREMENT Dfp_FBCqDvt_mp "Messpunkt fuer Fehlerpfad  Dfp_FBCqDvt" UWORD OneToOne 1 100 0.00 65535.00 FORMAT "%8.2" ECU_ADDRESS 0x8FE6DC /end MEASUREMENT
/begin MEASUREMENT Dfp_FlFCD_mp "Messpunkt fuer Fehlerpfad  Dfp_FlFCD" UWORD OneToOne 1 100 0.00 65535.00 FORMAT "%8.2" ECU_ADDRESS 0x8FE6DE /end MEASUREMENT
/begin MEASUREMENT Dfp_FlMngSmkDefect_mp "Messpunkt fuer Fehlerpfad  Dfp_FlMngSmkDefect" UWORD OneToOne 1 100 0.00 65535.00 FORMAT "%8.2" ECU_ADDRESS 0x8FE6E0 /end MEASUREMENT
/begin MEASUREMENT Dfp_FMTC_NonMonotonMap_mp "Prüfung Monotonie der Mengenstützpunkte über Moment in FMTC_trq2qBas_MAP" UWORD OneToOne 1 100 0.00 65535.00 FORMAT "%8.2" ECU_ADDRESS 0x8FE6E2 /end MEASUREMENT
/begin MEASUREMENT Dfp_FrmMngANFRADMOMPT_mp "Messpunkt fuer Fehlerpfad  Dfp_FrmMngANFRADMOMPT" UWORD OneToOne 1 100 0.00 65535.00 FORMAT "%8.2" ECU_ADDRESS 0x8FE6E4 /end MEASUREMENT
/begin MEASUREMENT Dfp_FrmMngASC1_mp "Messpunkt fuer Fehlerpfad  Dfp_FrmMngASC1" UWORD OneToOne 1 100 0.00 65535.00 FORMAT "%8.2" ECU_ADDRESS 0x8FE6E6 /end MEASUREMENT
/begin MEASUREMENT Dfp_FrmMngASC2_mp "Messpunkt fuer Fehlerpfad  Dfp_FrmMngASC2" UWORD OneToOne 1 100 0.00 65535.00 FORMAT "%8.2" ECU_ADDRESS 0x8FE6E8 /end MEASUREMENT
/begin MEASUREMENT Dfp_FrmMngASC3_mp "Messpunkt fuer Fehlerpfad  Dfp_FrmMngASC3" UWORD OneToOne 1 100 0.00 65535.00 FORMAT "%8.2" ECU_ADDRESS 0x8FE6EA /end MEASUREMENT
/begin MEASUREMENT Dfp_FrmMngASC4_mp "Messpunkt fuer Fehlerpfad  Dfp_FrmMngASC4" UWORD OneToOne 1 100 0.00 65535.00 FORMAT "%8.2" ECU_ADDRESS 0x8FE6EC /end MEASUREMENT
/begin MEASUREMENT Dfp_FrmMngBOS_RESET_2_mp "Messpunkt fuer Fehlerpfad  Dfp_FrmMngBOS_RESET_2" UWORD OneToOne 1 100 0.00 65535.00 FORMAT "%8.2" ECU_ADDRESS 0x8FE6EE /end MEASUREMENT
/begin MEASUREMENT Dfp_FrmMngBOS_RESET_mp "BOS_RESET - CAN-message related errors" UWORD OneToOne 1 100 0.00 65535.00 FORMAT "%8.2" ECU_ADDRESS 0x8FE6F0 /end MEASUREMENT
/begin MEASUREMENT Dfp_FrmMngDMANFAFS_mp "Messpunkt fuer Fehlerpfad  Dfp_FrmMngDMANFAFS" UWORD OneToOne 1 100 0.00 65535.00 FORMAT "%8.2" ECU_ADDRESS 0x8FE6F2 /end MEASUREMENT
/begin MEASUREMENT Dfp_FrmMngDRMANFSSG_mp "Messpunkt fuer Fehlerpfad  Dfp_FrmMngDRMANFSSG" UWORD OneToOne 1 100 0.00 65535.00 FORMAT "%8.2" ECU_ADDRESS 0x8FE6F4 /end MEASUREMENT
/begin MEASUREMENT Dfp_FrmMngEGS1_mp "Fehleerpfad für die EGS1 Botschaft" UWORD OneToOne 1 100 0.00 65535.00 FORMAT "%8.2" ECU_ADDRESS 0x8FE6F6 /end MEASUREMENT
/begin MEASUREMENT Dfp_FrmMngEGS2_mp "Messpunkt fuer Fehlerpfad  Dfp_FrmMngEGS2" UWORD OneToOne 1 100 0.00 65535.00 FORMAT "%8.2" ECU_ADDRESS 0x8FE6F8 /end MEASUREMENT
/begin MEASUREMENT Dfp_FrmMngGEARBX_DATA2_mp "Messpunkt fuer Fehlerpfad  Dfp_FrmMngGEARBX_DATA2" UWORD OneToOne 1 100 0.00 65535.00 FORMAT "%8.2" ECU_ADDRESS 0x8FE6FA /end MEASUREMENT
/begin MEASUREMENT Dfp_FrmMngGEARBX_DATA_mp "GEARBX_DATA CAN12h-message related faults" UWORD OneToOne 1 100 0.00 65535.00 FORMAT "%8.2" ECU_ADDRESS 0x8FE6FC /end MEASUREMENT
/begin MEASUREMENT Dfp_FrmMngHEAT_AC_mp "HEAT_AC CAN12h-message related faults" UWORD OneToOne 1 100 0.00 65535.00 FORMAT "%8.2" ECU_ADDRESS 0x8FE6FE /end MEASUREMENT
/begin MEASUREMENT Dfp_FrmMngINSTR2_mp "Messpunkt fuer Fehlerpfad  Dfp_FrmMngINSTR2" UWORD OneToOne 1 100 0.00 65535.00 FORMAT "%8.2" ECU_ADDRESS 0x8FE700 /end MEASUREMENT
/begin MEASUREMENT Dfp_FrmMngINSTR3_mp "Messpunkt fuer Fehlerpfad  Dfp_FrmMngINSTR3" UWORD OneToOne 1 100 0.00 65535.00 FORMAT "%8.2" ECU_ADDRESS 0x8FE702 /end MEASUREMENT
/begin MEASUREMENT Dfp_FrmMngLENKRADWINKEL_mp "Messpunkt fuer Fehlerpfad  Dfp_FrmMngLENKRADWINKEL" UWORD OneToOne 1 100 0.00 65535.00 FORMAT "%8.2" ECU_ADDRESS 0x8FE704 /end MEASUREMENT
/begin MEASUREMENT Dfp_FrmMngMILEAGE_RANGE_mp "Messpunkt fuer Fehlerpfad  Dfp_FrmMngMILEAGE_RANGE" UWORD OneToOne 1 100 0.00 65535.00 FORMAT "%8.2" ECU_ADDRESS 0x8FE706 /end MEASUREMENT
/begin MEASUREMENT Dfp_FrmMngOPCRCTLACC_mp "Messpunkt fuer Fehlerpfad  Dfp_FrmMngOPCRCTLACC" UWORD OneToOne 1 100 0.00 65535.00 FORMAT "%8.2" ECU_ADDRESS 0x8FE708 /end MEASUREMENT
/begin MEASUREMENT Dfp_FrmMngParkConsumer_mp "Messpunkt fuer Fehlerpfad  Dfp_FrmMngParkConsumer" UWORD OneToOne 1 100 0.00 65535.00 FORMAT "%8.2" ECU_ADDRESS 0x8FE70A /end MEASUREMENT
/begin MEASUREMENT Dfp_FrmMngPRGG_CCTR_mp "Messpunkt fuer Fehlerpfad  Dfp_FrmMngPRGG_CCTR" UWORD OneToOne 1 100 0.00 65535.00 FORMAT "%8.2" ECU_ADDRESS 0x8FE70C /end MEASUREMENT
/begin MEASUREMENT Dfp_FrmMngPWRMNG_LOADV_mp "Messpunkt fuer Fehlerpfad  Dfp_FrmMngPWRMNG_LOADV" UWORD OneToOne 1 100 0.00 65535.00 FORMAT "%8.2" ECU_ADDRESS 0x8FE70E /end MEASUREMENT
/begin MEASUREMENT Dfp_FrmMngRQSTGEFAN_mp "RQ_STG_EFAN - CAN-message related errors" UWORD OneToOne 1 100 0.00 65535.00 FORMAT "%8.2" ECU_ADDRESS 0x8FE710 /end MEASUREMENT
/begin MEASUREMENT Dfp_FrmMngSSGErr_mp "Messpunkt fuer Fehlerpfad  Dfp_FrmMngSSGErr" UWORD OneToOne 1 100 0.00 65535.00 FORMAT "%8.2" ECU_ADDRESS 0x8FE712 /end MEASUREMENT
/begin MEASUREMENT Dfp_FrmMngSSGShOff_mp "Messpunkt fuer Fehlerpfad  Dfp_FrmMngSSGShOff" UWORD OneToOne 1 100 0.00 65535.00 FORMAT "%8.2" ECU_ADDRESS 0x8FE714 /end MEASUREMENT
/begin MEASUREMENT Dfp_FrmMngSTAT_ANH_mp "Messpunkt fuer Fehlerpfad  Dfp_FrmMngSTAT_ANH" UWORD OneToOne 1 100 0.00 65535.00 FORMAT "%8.2" ECU_ADDRESS 0x8FE716 /end MEASUREMENT
/begin MEASUREMENT Dfp_FrmMngSTAT_ARS_mp "STAT_ARS CAN12h-message related faults" UWORD OneToOne 1 100 0.00 65535.00 FORMAT "%8.2" ECU_ADDRESS 0x8FE718 /end MEASUREMENT
/begin MEASUREMENT Dfp_FrmMngSTAT_DSC_mp "STAT_DSC CAN12h-message related faults" UWORD OneToOne 1 100 0.00 65535.00 FORMAT "%8.2" ECU_ADDRESS 0x8FE71A /end MEASUREMENT
/begin MEASUREMENT Dfp_FrmMngSTAT_EKP_mp "Fehlerpfad für STAT_EKP" UWORD OneToOne 1 100 0.00 65535.00 FORMAT "%8.2" ECU_ADDRESS 0x8FE71C /end MEASUREMENT
/begin MEASUREMENT Dfp_FrmMngSTAT_KOMBI_mp "STAT_KOMBI - CAN-message related errors" UWORD OneToOne 1 100 0.00 65535.00 FORMAT "%8.2" ECU_ADDRESS 0x8FE71E /end MEASUREMENT
/begin MEASUREMENT Dfp_FrmMngSTAT_SITZ_mp "Defect fault path for STAT_SITZBELEGUNG_GURT - CAN-message related errors" UWORD OneToOne 1 100 0.00 65535.00 FORMAT "%8.2" ECU_ADDRESS 0x8FE720 /end MEASUREMENT
/begin MEASUREMENT Dfp_FrmMngstCurr_mp "Messpunkt für Dfp von FrmMng_stCurr Botschaft" UWORD OneToOne 1 100 0.00 65535.00 FORMAT "%8.2" ECU_ADDRESS 0x8FE722 /end MEASUREMENT
/begin MEASUREMENT Dfp_FrmMngStOBDGbxMilOf_mp "error path of Gear Box MIL OFF" UWORD OneToOne 1 100 0.00 65535.00 FORMAT "%8.2" ECU_ADDRESS 0x8FE724 /end MEASUREMENT
/begin MEASUREMENT Dfp_FrmMngStOBDGbxMilOn_mp "error path of Gear Box MIL ON" UWORD OneToOne 1 100 0.00 65535.00 FORMAT "%8.2" ECU_ADDRESS 0x8FE726 /end MEASUREMENT
/begin MEASUREMENT Dfp_FrmMngswtPSPOff_mp "Messpunkt für Dfp von FrmMng_swtPSPOff Botschaft" UWORD OneToOne 1 100 0.00 65535.00 FORMAT "%8.2" ECU_ADDRESS 0x8FE728 /end MEASUREMENT
/begin MEASUREMENT Dfp_FrmMngTEMPRELTIME_mp "A_TEMP_RELATIVZEIT - CAN-message related errors" UWORD OneToOne 1 100 0.00 65535.00 FORMAT "%8.2" ECU_ADDRESS 0x8FE72A /end MEASUREMENT
/begin MEASUREMENT Dfp_FrmMngTERMINAL_mp "TERMINAL CAN12h-message related faults" UWORD OneToOne 1 100 0.00 65535.00 FORMAT "%8.2" ECU_ADDRESS 0x8FE72C /end MEASUREMENT
/begin MEASUREMENT Dfp_FrmMngTIME_DATE_mp "Messpunkt fuer Fehlerpfad  Dfp_FrmMngTIME_DATE" UWORD OneToOne 1 100 0.00 65535.00 FORMAT "%8.2" ECU_ADDRESS 0x8FE72E /end MEASUREMENT
/begin MEASUREMENT Dfp_FrmMngTORQUE_DSC_mp "TORQUE_DSC CAN12h-message related faults" UWORD OneToOne 1 100 0.00 65535.00 FORMAT "%8.2" ECU_ADDRESS 0x8FE730 /end MEASUREMENT
/begin MEASUREMENT Dfp_FrmMngTORQUE_GEARBX_mp "TORQUE_GEARBX CAN12h-message related faults" UWORD OneToOne 1 100 0.00 65535.00 FORMAT "%8.2" ECU_ADDRESS 0x8FE732 /end MEASUREMENT
/begin MEASUREMENT Dfp_FrmMngTrq_ReqACC_mp "Messpunkt fuer Fehlerpfad  Dfp_FrmMngTrq_ReqACC" UWORD OneToOne 1 100 0.00 65535.00 FORMAT "%8.2" ECU_ADDRESS 0x8FE734 /end MEASUREMENT
/begin MEASUREMENT Dfp_FrmMngVEH_MOD_mp "VEH_MOD - CAN-message related errors" UWORD OneToOne 1 100 0.00 65535.00 FORMAT "%8.2" ECU_ADDRESS 0x8FE736 /end MEASUREMENT
/begin MEASUREMENT Dfp_FrmMngVELOCITY_mp "VELOCITY CAN12h-message related faults" UWORD OneToOne 1 100 0.00 65535.00 FORMAT "%8.2" ECU_ADDRESS 0x8FE738 /end MEASUREMENT
/begin MEASUREMENT Dfp_FrmMngWHEEL_SPEED_mp "WHEEL_SPEED - CAN-message related errors" UWORD OneToOne 1 100 0.00 65535.00 FORMAT "%8.2" ECU_ADDRESS 0x8FE73A /end MEASUREMENT
/begin MEASUREMENT Dfp_FTSCD_mp "Messpunkt fuer Fehlerpfad  Dfp_FTSCD" UWORD OneToOne 1 100 0.00 65535.00 FORMAT "%8.2" ECU_ADDRESS 0x8FE73C /end MEASUREMENT
/begin MEASUREMENT Dfp_GearbxIncMax_mp "Fehlerpfad  physikalische Unplausibilität des erhöhenden Getriebeeingriffs" UWORD OneToOne 1 100 0.00 65535.00 FORMAT "%8.2" ECU_ADDRESS 0x8FE73E /end MEASUREMENT
/begin MEASUREMENT Dfp_GlwCDGlwCirc1_mp "Messpunkt fuer Fehlerpfad  Dfp_GlwCDGlwCirc1" UWORD OneToOne 1 100 0.00 65535.00 FORMAT "%8.2" ECU_ADDRESS 0x8FE740 /end MEASUREMENT
/begin MEASUREMENT Dfp_GlwCDGlwCirc2_mp "Messpunkt fuer Fehlerpfad  Dfp_GlwCDGlwCirc2" UWORD OneToOne 1 100 0.00 65535.00 FORMAT "%8.2" ECU_ADDRESS 0x8FE742 /end MEASUREMENT
/begin MEASUREMENT Dfp_GlwCDGlwCirc3_mp "Messpunkt fuer Fehlerpfad  Dfp_GlwCDGlwCirc3" UWORD OneToOne 1 100 0.00 65535.00 FORMAT "%8.2" ECU_ADDRESS 0x8FE744 /end MEASUREMENT
/begin MEASUREMENT Dfp_GlwCDGlwCirc4_mp "Messpunkt fuer Fehlerpfad  Dfp_GlwCDGlwCirc4" UWORD OneToOne 1 100 0.00 65535.00 FORMAT "%8.2" ECU_ADDRESS 0x8FE746 /end MEASUREMENT
/begin MEASUREMENT Dfp_GlwCDGlwCirc5_mp "Messpunkt fuer Fehlerpfad  Dfp_GlwCDGlwCirc5" UWORD OneToOne 1 100 0.00 65535.00 FORMAT "%8.2" ECU_ADDRESS 0x8FE748 /end MEASUREMENT
/begin MEASUREMENT Dfp_GlwCDGlwCirc6_mp "Messpunkt fuer Fehlerpfad  Dfp_GlwCDGlwCirc6" UWORD OneToOne 1 100 0.00 65535.00 FORMAT "%8.2" ECU_ADDRESS 0x8FE74A /end MEASUREMENT
/begin MEASUREMENT Dfp_GlwCDGlwCirc7_mp "Messpunkt fuer Fehlerpfad  Dfp_GlwCDGlwCirc7" UWORD OneToOne 1 100 0.00 65535.00 FORMAT "%8.2" ECU_ADDRESS 0x8FE74C /end MEASUREMENT
/begin MEASUREMENT Dfp_GlwCDGlwCirc8_mp "Messpunkt fuer Fehlerpfad  Dfp_GlwCDGlwCirc8" UWORD OneToOne 1 100 0.00 65535.00 FORMAT "%8.2" ECU_ADDRESS 0x8FE74E /end MEASUREMENT
/begin MEASUREMENT Dfp_GlwCD_mp "Messpunkt fuer Fehlerpfad  Dfp_GlwCD" UWORD OneToOne 1 100 0.00 65535.00 FORMAT "%8.2" ECU_ADDRESS 0x8FE750 /end MEASUREMENT
/begin MEASUREMENT Dfp_GlwCtl_mp "Glüh-Steuerungs-Rückmeldungs-Fehler" UWORD OneToOne 1 100 0.00 65535.00 FORMAT "%8.2" ECU_ADDRESS 0x8FE752 /end MEASUREMENT
/begin MEASUREMENT Dfp_HWEMonCom_mp "Messpunkt fuer Fehlerpfad  Dfp_HWEMonCom" UWORD OneToOne 1 100 0.00 65535.00 FORMAT "%8.2" ECU_ADDRESS 0x8FE754 /end MEASUREMENT
/begin MEASUREMENT Dfp_HWEMonEEPROM_mp "Messpunkt fuer Fehlerpfad  Dfp_HWEMonEEPROM" UWORD OneToOne 1 100 0.00 65535.00 FORMAT "%8.2" ECU_ADDRESS 0x8FE756 /end MEASUREMENT
/begin MEASUREMENT Dfp_HWEMonRcyLocked_mp "Messpunkt fuer Fehlerpfad  Dfp_HWEMonRcyLocked" UWORD OneToOne 1 100 0.00 65535.00 FORMAT "%8.2" ECU_ADDRESS 0x8FE758 /end MEASUREMENT
/begin MEASUREMENT Dfp_HWEMonRcySuppressed_mp "Messpunkt fuer Fehlerpfad  Dfp_HWEMonRcySuppressed" UWORD OneToOne 1 100 0.00 65535.00 FORMAT "%8.2" ECU_ADDRESS 0x8FE75A /end MEASUREMENT
/begin MEASUREMENT Dfp_HWEMonRcyVisible_mp "Messpunkt fuer Fehlerpfad  Dfp_HWEMonRcyVisible" UWORD OneToOne 1 100 0.00 65535.00 FORMAT "%8.2" ECU_ADDRESS 0x8FE75C /end MEASUREMENT
/begin MEASUREMENT Dfp_HWEMonUMaxSupply_mp "Messpunkt fuer Fehlerpfad  Dfp_HWEMonUMaxSupply" UWORD OneToOne 1 100 0.00 65535.00 FORMAT "%8.2" ECU_ADDRESS 0x8FE75E /end MEASUREMENT
/begin MEASUREMENT Dfp_HWEMonUMinSupply_mp "Messpunkt fuer Fehlerpfad  Dfp_HWEMonUMinSupply" UWORD OneToOne 1 100 0.00 65535.00 FORMAT "%8.2" ECU_ADDRESS 0x8FE760 /end MEASUREMENT
/begin MEASUREMENT Dfp_IATSCD_CATS_mp "Fehlerpfad Ladelufttemperaturwert nach Ladeluftkühler" UWORD OneToOne 1 100 0.00 65535.00 FORMAT "%8.2" ECU_ADDRESS 0x8FE762 /end MEASUREMENT
/begin MEASUREMENT Dfp_IATSCD_mp "Messpunkt fuer Fehlerpfad  Dfp_IATSCD" UWORD OneToOne 1 100 0.00 65535.00 FORMAT "%8.2" ECU_ADDRESS 0x8FE764 /end MEASUREMENT
/begin MEASUREMENT Dfp_ImmCtlImmCD_mp "Messpunkt fuer Fehlerpfad  Dfp_ImmCtlImmCD" UWORD OneToOne 1 100 0.00 65535.00 FORMAT "%8.2" ECU_ADDRESS 0x8FE766 /end MEASUREMENT
/begin MEASUREMENT Dfp_ImmCtlImmEep_mp "Messpunkt fuer Fehlerpfad  Dfp_ImmCtlImmEep" UWORD OneToOne 1 100 0.00 65535.00 FORMAT "%8.2" ECU_ADDRESS 0x8FE768 /end MEASUREMENT
/begin MEASUREMENT Dfp_ImmCtlMpl_mp "Messpunkt fuer Fehlerpfad  Dfp_ImmCtlMpl" UWORD OneToOne 1 100 0.00 65535.00 FORMAT "%8.2" ECU_ADDRESS 0x8FE76A /end MEASUREMENT
/begin MEASUREMENT Dfp_IndSys1_mp "IndSys1 defect path" UWORD OneToOne 1 100 0.00 65535.00 FORMAT "%8.2" ECU_ADDRESS 0x8FE76C /end MEASUREMENT
/begin MEASUREMENT Dfp_IndSys2_mp "IndSys2 defect path" UWORD OneToOne 1 100 0.00 65535.00 FORMAT "%8.2" ECU_ADDRESS 0x8FE76E /end MEASUREMENT
/begin MEASUREMENT Dfp_InjCrv_InjLim_mp "Messpunkt fuer Fehlerpfad Dfp_InjCrv_InjLim" UWORD OneToOne 1 100 0.00 65535.00 FORMAT "%8.2" ECU_ADDRESS 0x8FE770 /end MEASUREMENT
/begin MEASUREMENT Dfp_InjCtlAdjQnt_mp "Messpunkt fuer Fehlerpfad  Dfp_InjCtlAdjQnt" UWORD OneToOne 1 100 0.00 65535.00 FORMAT "%8.2" ECU_ADDRESS 0x8FE772 /end MEASUREMENT
/begin MEASUREMENT Dfp_InjCtlDrift_mp "Messpunkt fuer Fehlerpfad  Dfp_InjCtlDrift" UWORD OneToOne 1 100 0.00 65535.00 FORMAT "%8.2" ECU_ADDRESS 0x8FE774 /end MEASUREMENT
/begin MEASUREMENT Dfp_InjVCDActrChrg_mp "Messpunkt fuer Fehlerpfad  Dfp_InjVCDActrChrg" UWORD OneToOne 1 100 0.00 65535.00 FORMAT "%8.2" ECU_ADDRESS 0x8FE776 /end MEASUREMENT
/begin MEASUREMENT Dfp_InjVCDActrEnrg1_mp "Messpunkt fuer Fehlerpfad  Dfp_InjVCDActrEnrg1" UWORD OneToOne 1 100 0.00 65535.00 FORMAT "%8.2" ECU_ADDRESS 0x8FE778 /end MEASUREMENT
/begin MEASUREMENT Dfp_InjVCDActrEnrg2_mp "Messpunkt fuer Fehlerpfad  Dfp_InjVCDActrEnrg2" UWORD OneToOne 1 100 0.00 65535.00 FORMAT "%8.2" ECU_ADDRESS 0x8FE77A /end MEASUREMENT
/begin MEASUREMENT Dfp_InjVCDActrEnrg3_mp "Messpunkt fuer Fehlerpfad  Dfp_InjVCDActrEnrg3" UWORD OneToOne 1 100 0.00 65535.00 FORMAT "%8.2" ECU_ADDRESS 0x8FE77C /end MEASUREMENT
/begin MEASUREMENT Dfp_InjVCDActrEnrg4_mp "Messpunkt fuer Fehlerpfad  Dfp_InjVCDActrEnrg4" UWORD OneToOne 1 100 0.00 65535.00 FORMAT "%8.2" ECU_ADDRESS 0x8FE77E /end MEASUREMENT
/begin MEASUREMENT Dfp_InjVCDActrEnrg5_mp "Messpunkt fuer Fehlerpfad  Dfp_InjVCDActrEnrg5" UWORD OneToOne 1 100 0.00 65535.00 FORMAT "%8.2" ECU_ADDRESS 0x8FE780 /end MEASUREMENT
/begin MEASUREMENT Dfp_InjVCDActrEnrg6_mp "Messpunkt fuer Fehlerpfad  Dfp_InjVCDActrEnrg6" UWORD OneToOne 1 100 0.00 65535.00 FORMAT "%8.2" ECU_ADDRESS 0x8FE782 /end MEASUREMENT
/begin MEASUREMENT Dfp_InjVCDActrEnrg7_mp "Messpunkt fuer Fehlerpfad  Dfp_InjVCDActrEnrg7" UWORD OneToOne 1 100 0.00 65535.00 FORMAT "%8.2" ECU_ADDRESS 0x8FE784 /end MEASUREMENT
/begin MEASUREMENT Dfp_InjVCDActrEnrg8_mp "Messpunkt fuer Fehlerpfad  Dfp_InjVCDActrEnrg8" UWORD OneToOne 1 100 0.00 65535.00 FORMAT "%8.2" ECU_ADDRESS 0x8FE786 /end MEASUREMENT
/begin MEASUREMENT Dfp_InjVCDActrVolt_mp "Messpunkt fuer Fehlerpfad  Dfp_InjVCDActrVolt" UWORD OneToOne 1 100 0.00 65535.00 FORMAT "%8.2" ECU_ADDRESS 0x8FE788 /end MEASUREMENT
/begin MEASUREMENT Dfp_InjVCDClsBank1_mp "Messpunkt fuer Fehlerpfad  Dfp_InjVCDClsBank1" UWORD OneToOne 1 100 0.00 65535.00 FORMAT "%8.2" ECU_ADDRESS 0x8FE78A /end MEASUREMENT
/begin MEASUREMENT Dfp_InjVCDClsBank2_mp "Messpunkt fuer Fehlerpfad  Dfp_InjVCDClsBank2" UWORD OneToOne 1 100 0.00 65535.00 FORMAT "%8.2" ECU_ADDRESS 0x8FE78C /end MEASUREMENT
/begin MEASUREMENT Dfp_InjVCDMonCab_mp "Messpunkt fuer Fehlerpfad  Dfp_InjVCDMonCab" UWORD OneToOne 1 100 0.00 65535.00 FORMAT "%8.2" ECU_ADDRESS 0x8FE78E /end MEASUREMENT
/begin MEASUREMENT Dfp_InjVCDMonSwt_mp "Messpunkt fuer Fehlerpfad  Dfp_InjVCDMonSwt" UWORD OneToOne 1 100 0.00 65535.00 FORMAT "%8.2" ECU_ADDRESS 0x8FE790 /end MEASUREMENT
/begin MEASUREMENT Dfp_InjVCDShOffDCDC_mp "Fehlerpfad ""Ladeschalterkurzschluss""" UWORD OneToOne 1 100 0.00 65535.00 FORMAT "%8.2" ECU_ADDRESS 0x8FE792 /end MEASUREMENT
/begin MEASUREMENT Dfp_InjVCDUBuf_mp "Messpunkt fuer Fehlerpfad  Dfp_InjVCDUBuf" UWORD OneToOne 1 100 0.00 65535.00 FORMAT "%8.2" ECU_ADDRESS 0x8FE794 /end MEASUREMENT
/begin MEASUREMENT Dfp_InjVCD_CY370Ampl_mp "Fehlerpfad für Verstärkerabgleich vom CY370" UWORD OneToOne 1 100 0.00 65535.00 FORMAT "%8.2" ECU_ADDRESS 0x8FE796 /end MEASUREMENT
/begin MEASUREMENT Dfp_InjVlvBnk1A_mp "A Fehlerpfad für Bank 1" UWORD OneToOne 1 100 0.00 65535.00 FORMAT "%8.2" ECU_ADDRESS 0x8FE798 /end MEASUREMENT
/begin MEASUREMENT Dfp_InjVlvBnk1B_mp "B Fehlerpfad für Bank 1" UWORD OneToOne 1 100 0.00 65535.00 FORMAT "%8.2" ECU_ADDRESS 0x8FE79A /end MEASUREMENT
/begin MEASUREMENT Dfp_InjVlvBnk2A_mp "A Fehlerpfad für Bank 2" UWORD OneToOne 1 100 0.00 65535.00 FORMAT "%8.2" ECU_ADDRESS 0x8FE79C /end MEASUREMENT
/begin MEASUREMENT Dfp_InjVlvBnk2B_mp "B Fehlerpfad für Bank 2" UWORD OneToOne 1 100 0.00 65535.00 FORMAT "%8.2" ECU_ADDRESS 0x8FE79E /end MEASUREMENT
/begin MEASUREMENT Dfp_InjVlvChipA_mp "A Fehlerpfad  für Baustein" UWORD OneToOne 1 100 0.00 65535.00 FORMAT "%8.2" ECU_ADDRESS 0x8FE7A0 /end MEASUREMENT
/begin MEASUREMENT Dfp_InjVlvChipB_mp "B Fehlerpfad für Baustein" UWORD OneToOne 1 100 0.00 65535.00 FORMAT "%8.2" ECU_ADDRESS 0x8FE7A2 /end MEASUREMENT
/begin MEASUREMENT Dfp_InjVlvCyl1A_mp "A Fehlerpfad  für Zylinder 1" UWORD OneToOne 1 100 0.00 65535.00 FORMAT "%8.2" ECU_ADDRESS 0x8FE7A4 /end MEASUREMENT
/begin MEASUREMENT Dfp_InjVlvCyl1B_mp "B Fehlerpfad  für Zylinder 1" UWORD OneToOne 1 100 0.00 65535.00 FORMAT "%8.2" ECU_ADDRESS 0x8FE7A6 /end MEASUREMENT
/begin MEASUREMENT Dfp_InjVlvCyl1C_mp "Messpunkt fuer Fehlerpfad  Dfp_InjVlvCyl1C" UWORD OneToOne 1 100 0.00 65535.00 FORMAT "%8.2" ECU_ADDRESS 0x8FE7A8 /end MEASUREMENT
/begin MEASUREMENT Dfp_InjVlvCyl2A_mp "A Fehlerpfad  für Zylinder 2" UWORD OneToOne 1 100 0.00 65535.00 FORMAT "%8.2" ECU_ADDRESS 0x8FE7AA /end MEASUREMENT
/begin MEASUREMENT Dfp_InjVlvCyl2B_mp "B Fehlerpfad  für Zylinder 2" UWORD OneToOne 1 100 0.00 65535.00 FORMAT "%8.2" ECU_ADDRESS 0x8FE7AC /end MEASUREMENT
/begin MEASUREMENT Dfp_InjVlvCyl2C_mp "Messpunkt fuer Fehlerpfad  Dfp_InjVlvCyl2C" UWORD OneToOne 1 100 0.00 65535.00 FORMAT "%8.2" ECU_ADDRESS 0x8FE7AE /end MEASUREMENT
/begin MEASUREMENT Dfp_InjVlvCyl3A_mp "A Fehlerpfad  für Zylinder 3" UWORD OneToOne 1 100 0.00 65535.00 FORMAT "%8.2" ECU_ADDRESS 0x8FE7B0 /end MEASUREMENT
/begin MEASUREMENT Dfp_InjVlvCyl3B_mp "B Fehlerpfad  für Zylinder 3" UWORD OneToOne 1 100 0.00 65535.00 FORMAT "%8.2" ECU_ADDRESS 0x8FE7B2 /end MEASUREMENT
/begin MEASUREMENT Dfp_InjVlvCyl3C_mp "Messpunkt fuer Fehlerpfad  Dfp_InjVlvCyl3C" UWORD OneToOne 1 100 0.00 65535.00 FORMAT "%8.2" ECU_ADDRESS 0x8FE7B4 /end MEASUREMENT
/begin MEASUREMENT Dfp_InjVlvCyl4A_mp "A Fehlerpfad  für Zylinder 4" UWORD OneToOne 1 100 0.00 65535.00 FORMAT "%8.2" ECU_ADDRESS 0x8FE7B6 /end MEASUREMENT
/begin MEASUREMENT Dfp_InjVlvCyl4B_mp "B Fehlerpfad  für Zylinder 4" UWORD OneToOne 1 100 0.00 65535.00 FORMAT "%8.2" ECU_ADDRESS 0x8FE7B8 /end MEASUREMENT
/begin MEASUREMENT Dfp_InjVlvCyl4C_mp "Messpunkt fuer Fehlerpfad  Dfp_InjVlvCyl4C" UWORD OneToOne 1 100 0.00 65535.00 FORMAT "%8.2" ECU_ADDRESS 0x8FE7BA /end MEASUREMENT
/begin MEASUREMENT Dfp_InjVlvCyl5A_mp "A Fehlerpfad  für Zylinder 5" UWORD OneToOne 1 100 0.00 65535.00 FORMAT "%8.2" ECU_ADDRESS 0x8FE7BC /end MEASUREMENT
/begin MEASUREMENT Dfp_InjVlvCyl5B_mp "B Fehlerpfad  für Zylinder 5" UWORD OneToOne 1 100 0.00 65535.00 FORMAT "%8.2" ECU_ADDRESS 0x8FE7BE /end MEASUREMENT
/begin MEASUREMENT Dfp_InjVlvCyl5C_mp "Messpunkt fuer Fehlerpfad  Dfp_InjVlvCyl5C" UWORD OneToOne 1 100 0.00 65535.00 FORMAT "%8.2" ECU_ADDRESS 0x8FE7C0 /end MEASUREMENT
/begin MEASUREMENT Dfp_InjVlvCyl6A_mp "A Fehlerpfad  für Zylinder 6" UWORD OneToOne 1 100 0.00 65535.00 FORMAT "%8.2" ECU_ADDRESS 0x8FE7C2 /end MEASUREMENT
/begin MEASUREMENT Dfp_InjVlvCyl6B_mp "B Fehlerpfad  für Zylinder 6" UWORD OneToOne 1 100 0.00 65535.00 FORMAT "%8.2" ECU_ADDRESS 0x8FE7C4 /end MEASUREMENT
/begin MEASUREMENT Dfp_InjVlvCyl6C_mp "Messpunkt fuer Fehlerpfad  Dfp_InjVlvCyl6C" UWORD OneToOne 1 100 0.00 65535.00 FORMAT "%8.2" ECU_ADDRESS 0x8FE7C6 /end MEASUREMENT
/begin MEASUREMENT Dfp_InjVlvCyl7A_mp "A Fehlerpfad  für Zylinder 7" UWORD OneToOne 1 100 0.00 65535.00 FORMAT "%8.2" ECU_ADDRESS 0x8FE7C8 /end MEASUREMENT
/begin MEASUREMENT Dfp_InjVlvCyl7B_mp "B Fehlerpfad  für Zylinder 7" UWORD OneToOne 1 100 0.00 65535.00 FORMAT "%8.2" ECU_ADDRESS 0x8FE7CA /end MEASUREMENT
/begin MEASUREMENT Dfp_InjVlvCyl7C_mp "Messpunkt fuer Fehlerpfad  Dfp_InjVlvCyl7C" UWORD OneToOne 1 100 0.00 65535.00 FORMAT "%8.2" ECU_ADDRESS 0x8FE7CC /end MEASUREMENT
/begin MEASUREMENT Dfp_InjVlvCyl8A_mp "A Fehlerpfad  für Zylinder 8" UWORD OneToOne 1 100 0.00 65535.00 FORMAT "%8.2" ECU_ADDRESS 0x8FE7CE /end MEASUREMENT
/begin MEASUREMENT Dfp_InjVlvCyl8B_mp "B Fehlerpfad  für Zylinder 8" UWORD OneToOne 1 100 0.00 65535.00 FORMAT "%8.2" ECU_ADDRESS 0x8FE7D0 /end MEASUREMENT
/begin MEASUREMENT Dfp_InjVlvCyl8C_mp "Messpunkt fuer Fehlerpfad  Dfp_InjVlvCyl8C" UWORD OneToOne 1 100 0.00 65535.00 FORMAT "%8.2" ECU_ADDRESS 0x8FE7D2 /end MEASUREMENT
/begin MEASUREMENT Dfp_InjVlvNVC1_mp "Messpunkt für Fehlerpfad Dfp_InjVlvNVC1" UWORD OneToOne 1 100 0.00 65535.00 FORMAT "%8.2" ECU_ADDRESS 0x8FE7D4 /end MEASUREMENT
/begin MEASUREMENT Dfp_InjVlvNVC2_mp "Messpunkt für Fehlerpfad Dfp_InjVlvNVC2" UWORD OneToOne 1 100 0.00 65535.00 FORMAT "%8.2" ECU_ADDRESS 0x8FE7D6 /end MEASUREMENT
/begin MEASUREMENT Dfp_InjVlvNVC3_mp "Messpunkt für Fehlerpfad Dfp_InjVlvNVC3" UWORD OneToOne 1 100 0.00 65535.00 FORMAT "%8.2" ECU_ADDRESS 0x8FE7D8 /end MEASUREMENT
/begin MEASUREMENT Dfp_InjVlvNVC4_mp "Messpunkt für Fehlerpfad Dfp_InjVlvNVC4" UWORD OneToOne 1 100 0.00 65535.00 FORMAT "%8.2" ECU_ADDRESS 0x8FE7DA /end MEASUREMENT
/begin MEASUREMENT Dfp_InjVlvNVC5_mp "Messpunkt für Fehlerpfad Dfp_InjVlvNVC5" UWORD OneToOne 1 100 0.00 65535.00 FORMAT "%8.2" ECU_ADDRESS 0x8FE7DC /end MEASUREMENT
/begin MEASUREMENT Dfp_InjVlvNVC6_mp "Messpunkt für Fehlerpfad Dfp_InjVlvNVC6" UWORD OneToOne 1 100 0.00 65535.00 FORMAT "%8.2" ECU_ADDRESS 0x8FE7DE /end MEASUREMENT
/begin MEASUREMENT Dfp_InjVlvNVC7_mp "Messpunkt für Fehlerpfad Dfp_InjVlvNVC7" UWORD OneToOne 1 100 0.00 65535.00 FORMAT "%8.2" ECU_ADDRESS 0x8FE7E0 /end MEASUREMENT
/begin MEASUREMENT Dfp_InjVlvNVC8_mp "Messpunkt für Fehlerpfad Dfp_InjVlvNVC8" UWORD OneToOne 1 100 0.00 65535.00 FORMAT "%8.2" ECU_ADDRESS 0x8FE7E2 /end MEASUREMENT
/begin MEASUREMENT Dfp_Layer_BSD_mp "Messpunkt fuer Fehlerpfad  Dfp_Layer_BSD" UWORD OneToOne 1 100 0.00 65535.00 FORMAT "%8.2" ECU_ADDRESS 0x8FE7E4 /end MEASUREMENT
/begin MEASUREMENT Dfp_Layer_GEN_mp "Messpunkt fuer Fehlerpfad  Dfp_Layer_GEN" UWORD OneToOne 1 100 0.00 65535.00 FORMAT "%8.2" ECU_ADDRESS 0x8FE7E6 /end MEASUREMENT
/begin MEASUREMENT Dfp_Layer_IBS1_mp "Messpunkt fuer Fehlerpfad  Dfp_Layer_IBS1" UWORD OneToOne 1 100 0.00 65535.00 FORMAT "%8.2" ECU_ADDRESS 0x8FE7E8 /end MEASUREMENT
/begin MEASUREMENT Dfp_Layer_IBS2_mp "Messpunkt fuer Fehlerpfad  Dfp_Layer_IBS2" UWORD OneToOne 1 100 0.00 65535.00 FORMAT "%8.2" ECU_ADDRESS 0x8FE7EA /end MEASUREMENT
/begin MEASUREMENT Dfp_Layer_IBS3_mp "Messpunkt fuer Fehlerpfad  Dfp_Layer_IBS3" UWORD OneToOne 1 100 0.00 65535.00 FORMAT "%8.2" ECU_ADDRESS 0x8FE7EC /end MEASUREMENT
/begin MEASUREMENT Dfp_Layer_MANHYDR_mp "Messpunkt fuer Fehlerpfad  Dfp_Layer_MANHYDR" UWORD OneToOne 1 100 0.00 65535.00 FORMAT "%8.2" ECU_ADDRESS 0x8FE7EE /end MEASUREMENT
/begin MEASUREMENT Dfp_Layer_MANLUFT_mp "Messpunkt fuer Fehlerpfad  Dfp_Layer_MANLUFT" UWORD OneToOne 1 100 0.00 65535.00 FORMAT "%8.2" ECU_ADDRESS 0x8FE7F0 /end MEASUREMENT
/begin MEASUREMENT Dfp_Layer_PMBATT_mp "Messpunkt fuer Fehlerpfad  Dfp_Layer_PMBATT" UWORD OneToOne 1 100 0.00 65535.00 FORMAT "%8.2" ECU_ADDRESS 0x8FE7F2 /end MEASUREMENT
/begin MEASUREMENT Dfp_Layer_PMBN_mp "Messpunkt fuer Fehlerpfad  Dfp_Layer_PMBN" UWORD OneToOne 1 100 0.00 65535.00 FORMAT "%8.2" ECU_ADDRESS 0x8FE7F4 /end MEASUREMENT
/begin MEASUREMENT Dfp_Layer_PMRUHVERL_mp "Messpunkt fuer Fehlerpfad  Dfp_Layer_PMRUHVERL" UWORD OneToOne 1 100 0.00 65535.00 FORMAT "%8.2" ECU_ADDRESS 0x8FE7F6 /end MEASUREMENT
/begin MEASUREMENT Dfp_Layer_QLT_mp "Messpunkt fuer Fehlerpfad  Dfp_Layer_QLT" UWORD OneToOne 1 100 0.00 65535.00 FORMAT "%8.2" ECU_ADDRESS 0x8FE7F8 /end MEASUREMENT
/begin MEASUREMENT Dfp_Layer_TANS_mp "Messpunkt fuer Fehlerpfad  Dfp_Layer_TANS" UWORD OneToOne 1 100 0.00 65535.00 FORMAT "%8.2" ECU_ADDRESS 0x8FE7FA /end MEASUREMENT
/begin MEASUREMENT Dfp_Layer_TOENS_mp "Messpunkt fuer Fehlerpfad  Dfp_Layer_TOENS" UWORD OneToOne 1 100 0.00 65535.00 FORMAT "%8.2" ECU_ADDRESS 0x8FE7FC /end MEASUREMENT
/begin MEASUREMENT Dfp_Layer_TUMG_mp "Messpunkt fuer Fehlerpfad  Dfp_Layer_TUMG" UWORD OneToOne 1 100 0.00 65535.00 FORMAT "%8.2" ECU_ADDRESS 0x8FE7FE /end MEASUREMENT
/begin MEASUREMENT Dfp_LPACD_Max_mp "Messpunkt fuer Fehlerpfad  Dfp_LPACD_Max" UWORD OneToOne 1 100 0.00 65535.00 FORMAT "%8.2" ECU_ADDRESS 0x8FE800 /end MEASUREMENT
/begin MEASUREMENT Dfp_LPACD_Min_mp "Messpunkt fuer Fehlerpfad  Dfp_LPACD_Min" UWORD OneToOne 1 100 0.00 65535.00 FORMAT "%8.2" ECU_ADDRESS 0x8FE802 /end MEASUREMENT
/begin MEASUREMENT Dfp_LPACD_SigNpl_mp "Messpunkt fuer Fehlerpfad  Dfp_LPACD_SigNpl" UWORD OneToOne 1 100 0.00 65535.00 FORMAT "%8.2" ECU_ADDRESS 0x8FE804 /end MEASUREMENT
/begin MEASUREMENT Dfp_LSUCDCircNernst0_mp "Messpunkt fuer Fehlerpfad  Dfp_LSUCDCircNernst0" UWORD OneToOne 1 100 0.00 65535.00 FORMAT "%8.2" ECU_ADDRESS 0x8FE806 /end MEASUREMENT
/begin MEASUREMENT Dfp_LSUCDCircPumpCur0_mp "Messpunkt fuer Fehlerpfad  Dfp_LSUCDCircPumpCur0" UWORD OneToOne 1 100 0.00 65535.00 FORMAT "%8.2" ECU_ADDRESS 0x8FE808 /end MEASUREMENT
/begin MEASUREMENT Dfp_LSUCDCircVirtGnd0_mp "Messpunkt fuer Fehlerpfad  Dfp_LSUCDCircVirtGnd0" UWORD OneToOne 1 100 0.00 65535.00 FORMAT "%8.2" ECU_ADDRESS 0x8FE80A /end MEASUREMENT
/begin MEASUREMENT Dfp_LSUCDHeater0_mp "Messpunkt fuer Fehlerpfad  Dfp_LSUCDHeater0" UWORD OneToOne 1 100 0.00 65535.00 FORMAT "%8.2" ECU_ADDRESS 0x8FE80C /end MEASUREMENT
/begin MEASUREMENT Dfp_LSUCDHtCoup0_mp "Messpunkt fuer Fehlerpfad  Dfp_LSUCDHtCoup0" UWORD OneToOne 1 100 0.00 65535.00 FORMAT "%8.2" ECU_ADDRESS 0x8FE80E /end MEASUREMENT
/begin MEASUREMENT Dfp_LSUCDO20_mp "Messpunkt fuer Fehlerpfad  Dfp_LSUCDO20" UWORD OneToOne 1 100 0.00 65535.00 FORMAT "%8.2" ECU_ADDRESS 0x8FE810 /end MEASUREMENT
/begin MEASUREMENT Dfp_LSUCDO2Clb0_mp "Messpunkt fuer Fehlerpfad  Dfp_LSUCDO2Clb0" UWORD OneToOne 1 100 0.00 65535.00 FORMAT "%8.2" ECU_ADDRESS 0x8FE812 /end MEASUREMENT
/begin MEASUREMENT Dfp_LSUCDRiClb0_mp "Messpunkt fuer Fehlerpfad  Dfp_LSUCDRiClb0" UWORD OneToOne 1 100 0.00 65535.00 FORMAT "%8.2" ECU_ADDRESS 0x8FE814 /end MEASUREMENT
/begin MEASUREMENT Dfp_LSUCDSPI0_mp "Messpunkt fuer Fehlerpfad  Dfp_LSUCDSPI0" UWORD OneToOne 1 100 0.00 65535.00 FORMAT "%8.2" ECU_ADDRESS 0x8FE816 /end MEASUREMENT
/begin MEASUREMENT Dfp_LSUCDSPIBattLow0_mp "Fehlerpfad für niedrige Batteriespannung" UWORD OneToOne 1 100 0.00 65535.00 FORMAT "%8.2" ECU_ADDRESS 0x8FE818 /end MEASUREMENT
/begin MEASUREMENT Dfp_LSUCDWireIP0_mp "Messpunkt fuer Fehlerpfad  Dfp_LSUCDWireIP0" UWORD OneToOne 1 100 0.00 65535.00 FORMAT "%8.2" ECU_ADDRESS 0x8FE81A /end MEASUREMENT
/begin MEASUREMENT Dfp_LSUCtlRiExc0_mp "Messpunkt fuer Fehlerpfad  Dfp_LSUCtlRiExc0" UWORD OneToOne 1 100 0.00 65535.00 FORMAT "%8.2" ECU_ADDRESS 0x8FE81C /end MEASUREMENT
/begin MEASUREMENT Dfp_LSUMon1Sens_mp "Messpunkt fuer Fehlerpfad  Dfp_LSUMon1Sens" UWORD OneToOne 1 100 0.00 65535.00 FORMAT "%8.2" ECU_ADDRESS 0x8FE81E /end MEASUREMENT
/begin MEASUREMENT Dfp_LSUMon2Sens_mp "Messpunkt fuer Fehlerpfad  Dfp_LSUMon2Sens" UWORD OneToOne 1 100 0.00 65535.00 FORMAT "%8.2" ECU_ADDRESS 0x8FE820 /end MEASUREMENT
/begin MEASUREMENT Dfp_MeUnCDNoLoad_mp "Fehlerpfad für Lastabfall der Zumesseinheit" UWORD OneToOne 1 100 0.00 65535.00 FORMAT "%8.2" ECU_ADDRESS 0x8FE822 /end MEASUREMENT
/begin MEASUREMENT Dfp_MeUnCDSCBat_mp "Fehlerpfad für Kurzschluss zur Batteriespannung der Zumesseinheit" UWORD OneToOne 1 100 0.00 65535.00 FORMAT "%8.2" ECU_ADDRESS 0x8FE824 /end MEASUREMENT
/begin MEASUREMENT Dfp_MeUnCDSCGnd_mp "Fehlerpfad für Kurzschluss nach Masse der Zumesseinheit" UWORD OneToOne 1 100 0.00 65535.00 FORMAT "%8.2" ECU_ADDRESS 0x8FE826 /end MEASUREMENT
/begin MEASUREMENT Dfp_MeUnCD_ADC_mp "Fehlerpfad für die Signalerfassung des Stroms durch die Zumesseinheit" UWORD OneToOne 1 100 0.00 65535.00 FORMAT "%8.2" ECU_ADDRESS 0x8FE828 /end MEASUREMENT
/begin MEASUREMENT Dfp_MeUnCD_SigTst_mp "Messpunkt fuer Fehlerpfad  Dfp_MeUnCD_SigTst" UWORD OneToOne 1 100 0.00 65535.00 FORMAT "%8.2" ECU_ADDRESS 0x8FE82A /end MEASUREMENT
/begin MEASUREMENT Dfp_MIL_mp "Messpunkt fuer Fehlerpfad  Dfp_MIL" UWORD OneToOne 1 100 0.00 65535.00 FORMAT "%8.2" ECU_ADDRESS 0x8FE82C /end MEASUREMENT
/begin MEASUREMENT Dfp_Montr_mp "Messpunkt fuer Fehlerpfad  Dfp_Montr" UWORD OneToOne 1 100 0.00 65535.00 FORMAT "%8.2" ECU_ADDRESS 0x8FE82E /end MEASUREMENT
/begin MEASUREMENT Dfp_MRlyCD_mp "Messpunkt fuer Fehlerpfad  Dfp_MRlyCD" UWORD OneToOne 1 100 0.00 65535.00 FORMAT "%8.2" ECU_ADDRESS 0x8FE830 /end MEASUREMENT
/begin MEASUREMENT Dfp_MSidCD_Comm_mp "Messpunkt fuer Fehlerpfad  Dfp_MSidCD_Comm" UWORD OneToOne 1 100 0.00 65535.00 FORMAT "%8.2" ECU_ADDRESS 0x8FE832 /end MEASUREMENT
/begin MEASUREMENT Dfp_MSidCD_Pin_mp "Messpunkt fuer Fehlerpfad  Dfp_MSidCD_Pin" UWORD OneToOne 1 100 0.00 65535.00 FORMAT "%8.2" ECU_ADDRESS 0x8FE834 /end MEASUREMENT
/begin MEASUREMENT Dfp_MSidCD_Select_mp "Messpunkt fuer Fehlerpfad  Dfp_MSidCD_Select" UWORD OneToOne 1 100 0.00 65535.00 FORMAT "%8.2" ECU_ADDRESS 0x8FE836 /end MEASUREMENT
/begin MEASUREMENT Dfp_MSidCD_Sel_INI_mp "Messpunkt fuer Fehlerpfad  Dfp_MSidCD_Sel_INI" UWORD OneToOne 1 100 0.00 65535.00 FORMAT "%8.2" ECU_ADDRESS 0x8FE838 /end MEASUREMENT
/begin MEASUREMENT Dfp_NetMngDeviceA_mp "Fehlerpfad für CAN Baustein A" UWORD OneToOne 1 100 0.00 65535.00 FORMAT "%8.2" ECU_ADDRESS 0x8FE83A /end MEASUREMENT
/begin MEASUREMENT Dfp_NetMngDeviceB_mp "Fehlerpfad für CAN Baustein B" UWORD OneToOne 1 100 0.00 65535.00 FORMAT "%8.2" ECU_ADDRESS 0x8FE83C /end MEASUREMENT
/begin MEASUREMENT Dfp_NetMngDeviceC_mp "Messpunkt fuer Fehlerpfad  Dfp_NetMngDeviceC" UWORD OneToOne 1 100 0.00 65535.00 FORMAT "%8.2" ECU_ADDRESS 0x8FE83E /end MEASUREMENT
/begin MEASUREMENT Dfp_OPSCD_anain_mp "Messpunkt fuer Fehlerpfad  Dfp_OPSCD_anain" UWORD OneToOne 1 100 0.00 65535.00 FORMAT "%8.2" ECU_ADDRESS 0x8FE840 /end MEASUREMENT
/begin MEASUREMENT Dfp_OPSCD_Lamp_mp "Fehlerpfad Endstufenfehler Öllampe" UWORD OneToOne 1 100 0.00 65535.00 FORMAT "%8.2" ECU_ADDRESS 0x8FE842 /end MEASUREMENT
/begin MEASUREMENT Dfp_OTSCD_mp "Fehlerpfad Öltemperaturwert" UWORD OneToOne 1 100 0.00 65535.00 FORMAT "%8.2" ECU_ADDRESS 0x8FE844 /end MEASUREMENT
/begin MEASUREMENT Dfp_OvRMonBrk_mp "measurment point for fault path Dfp_OvRMonBrk" UWORD OneToOne 1 100 0.00 65535.00 FORMAT "%8.2" ECU_ADDRESS 0x8FE846 /end MEASUREMENT
/begin MEASUREMENT Dfp_OvRMonSigA_mp "Fehlerpfad für Drehzahlplausibilisierung in der Schubüberwachung" UWORD OneToOne 1 100 0.00 65535.00 FORMAT "%8.2" ECU_ADDRESS 0x8FE848 /end MEASUREMENT
/begin MEASUREMENT Dfp_OvRMon_mp "Messpunkt fuer Fehlerpfad  Dfp_OvRMon" UWORD OneToOne 1 100 0.00 65535.00 FORMAT "%8.2" ECU_ADDRESS 0x8FE84A /end MEASUREMENT
/begin MEASUREMENT Dfp_OxiCCDTPre_mp "Messpunkt fuer Fehlerpfad  Dfp_OxiCCDTPre" UWORD OneToOne 1 100 0.00 65535.00 FORMAT "%8.2" ECU_ADDRESS 0x8FE84C /end MEASUREMENT
/begin MEASUREMENT Dfp_PCR_GovDevNeg_mp "Messpunkt fuer Fehlerpfad  Dfp_PCR_GovDevNeg" UWORD OneToOne 1 100 0.00 65535.00 FORMAT "%8.2" ECU_ADDRESS 0x8FE84E /end MEASUREMENT
/begin MEASUREMENT Dfp_PCR_GovDevPos_mp "Messpunkt fuer Fehlerpfad  Dfp_PCR_GovDevPos" UWORD OneToOne 1 100 0.00 65535.00 FORMAT "%8.2" ECU_ADDRESS 0x8FE850 /end MEASUREMENT
/begin MEASUREMENT Dfp_PCR_LPGvnrDvtNeg_mp "Fehlerpfadmeßpunkt neg. Regelabweichung PCR-LP" UWORD OneToOne 1 100 0.00 65535.00 FORMAT "%8.2" ECU_ADDRESS 0x8FE852 /end MEASUREMENT
/begin MEASUREMENT Dfp_PCR_LPGvnrDvtPos_mp "Fehlerpfadmeßpunkt pos. Regelabweichung PCR-LP" UWORD OneToOne 1 100 0.00 65535.00 FORMAT "%8.2" ECU_ADDRESS 0x8FE854 /end MEASUREMENT
/begin MEASUREMENT Dfp_PCVCDNoLoad_mp "Messpunkt fuer Fehlerpfad Lastabfall des Druckregelventils" UWORD OneToOne 1 100 0.00 65535.00 FORMAT "%8.2" ECU_ADDRESS 0x8FE856 /end MEASUREMENT
/begin MEASUREMENT Dfp_PCVCDSCBat_mp "Messpunkt für Fehlerpfad Kurzschluss zur Batteriespannung des Druckregelventils" UWORD OneToOne 1 100 0.00 65535.00 FORMAT "%8.2" ECU_ADDRESS 0x8FE858 /end MEASUREMENT
/begin MEASUREMENT Dfp_PCVCDSCGnd_mp "Messpunkt für Fehlerpfad Kurzschluss nach Masse des Druckregelventils" UWORD OneToOne 1 100 0.00 65535.00 FORMAT "%8.2" ECU_ADDRESS 0x8FE85A /end MEASUREMENT
/begin MEASUREMENT Dfp_PCVCD_ADC_mp "Messpunkt fuer Fehlerpfad  Dfp_PCVCD_ADC" UWORD OneToOne 1 100 0.00 65535.00 FORMAT "%8.2" ECU_ADDRESS 0x8FE85C /end MEASUREMENT
/begin MEASUREMENT Dfp_PCVCD_SigTst_mp "Messpunkt fuer Fehlerpfad  Dfp_PCVCD_SigTst" UWORD OneToOne 1 100 0.00 65535.00 FORMAT "%8.2" ECU_ADDRESS 0x8FE85E /end MEASUREMENT
/begin MEASUREMENT Dfp_PFltAPSens_mp "Fehlerfad für Atmosphärendrucksensor" UWORD OneToOne 1 100 0.00 65535.00 FORMAT "%8.2" ECU_ADDRESS 0x8FE860 /end MEASUREMENT
/begin MEASUREMENT Dfp_PFltAPSPlaus_mp "" UWORD OneToOne 1 100 0.00 65535.00 FORMAT "%8.2" ECU_ADDRESS 0x8FE862 /end MEASUREMENT
/begin MEASUREMENT Dfp_PFltBPSPlaus_mp "" UWORD OneToOne 1 100 0.00 65535.00 FORMAT "%8.2" ECU_ADDRESS 0x8FE864 /end MEASUREMENT
/begin MEASUREMENT Dfp_PFltCDPPre_mp "Messpunkt fuer Fehlerpfad  Dfp_PFltCDPPre" UWORD OneToOne 1 100 0.00 65535.00 FORMAT "%8.2" ECU_ADDRESS 0x8FE866 /end MEASUREMENT
/begin MEASUREMENT Dfp_PFltCDTempPre_mp "Fehlerpfad der Abgastemperatur vor dem Partikelfilter" UWORD OneToOne 1 100 0.00 65535.00 FORMAT "%8.2" ECU_ADDRESS 0x8FE868 /end MEASUREMENT
/begin MEASUREMENT Dfp_PFltChar_mp "Digitaler Fehlerpfad für Fliesswiderstand Partikelfilter" UWORD OneToOne 1 100 0.00 65535.00 FORMAT "%8.2" ECU_ADDRESS 0x8FE86A /end MEASUREMENT
/begin MEASUREMENT Dfp_PFltEngPrt_mp "Messpunkt fuer Fehlerpfad  Dfp_PFltEngPrt" UWORD OneToOne 1 100 0.00 65535.00 FORMAT "%8.2" ECU_ADDRESS 0x8FE86C /end MEASUREMENT
/begin MEASUREMENT Dfp_PFltmSotDiffMax_mp "Messpunkt fuer Fehlerpfad  Dfp_PFltmSotDiffMax" UWORD OneToOne 1 100 0.00 65535.00 FORMAT "%8.2" ECU_ADDRESS 0x8FE86E /end MEASUREMENT
/begin MEASUREMENT Dfp_PFltPresDynPlaus_mp "Messpunkt fuer Fehlerpfad  Dfp_PFltPresDynPlaus" UWORD OneToOne 1 100 0.00 65535.00 FORMAT "%8.2" ECU_ADDRESS 0x8FE870 /end MEASUREMENT
/begin MEASUREMENT Dfp_PFltPresPlaus_mp "" UWORD OneToOne 1 100 0.00 65535.00 FORMAT "%8.2" ECU_ADDRESS 0x8FE872 /end MEASUREMENT
/begin MEASUREMENT Dfp_PFltPresSensFrz_mp "Messpunkt fuer Fehlerpfad  Dfp_PFltPresSensFrz" UWORD OneToOne 1 100 0.00 65535.00 FORMAT "%8.2" ECU_ADDRESS 0x8FE874 /end MEASUREMENT
/begin MEASUREMENT Dfp_PFltPresSensHsLn_mp "Messpunkt fuer Fehlerpfad  Dfp_PFltPresSensHsLn" UWORD OneToOne 1 100 0.00 65535.00 FORMAT "%8.2" ECU_ADDRESS 0x8FE876 /end MEASUREMENT
/begin MEASUREMENT Dfp_PFltPresSensSot_mp "Messpunkt fuer Fehlerpfad  Dfp_PFltPresSensSot" UWORD OneToOne 1 100 0.00 65535.00 FORMAT "%8.2" ECU_ADDRESS 0x8FE878 /end MEASUREMENT
/begin MEASUREMENT Dfp_PFltPresSens_mp "Messpunkt fuer Fehlerpfad  Dfp_PFltPresSens" UWORD OneToOne 1 100 0.00 65535.00 FORMAT "%8.2" ECU_ADDRESS 0x8FE87A /end MEASUREMENT
/begin MEASUREMENT Dfp_PFltRgnPerm_mp "Messpunkt fuer Fehlerpfad  Dfp_PFltRgnPerm" UWORD OneToOne 1 100 0.00 65535.00 FORMAT "%8.2" ECU_ADDRESS 0x8FE87C /end MEASUREMENT
/begin MEASUREMENT Dfp_PFltTempDwnStrm_mp "Digitaler Fehlerpfad für zweiten Abgastemperatursensor" UWORD OneToOne 1 100 0.00 65535.00 FORMAT "%8.2" ECU_ADDRESS 0x8FE87E /end MEASUREMENT
/begin MEASUREMENT Dfp_PFltTempSens_mp "Messpunkt fuer Fehlerpfad  Dfp_PFltTempSens" UWORD OneToOne 1 100 0.00 65535.00 FORMAT "%8.2" ECU_ADDRESS 0x8FE880 /end MEASUREMENT
/begin MEASUREMENT Dfp_PFltTempUpStrm_mp "Digitaler Fehlerpfad für ersten Abgastemperatursensor" UWORD OneToOne 1 100 0.00 65535.00 FORMAT "%8.2" ECU_ADDRESS 0x8FE882 /end MEASUREMENT
/begin MEASUREMENT Dfp_PresPlausDblDef_mp "" UWORD OneToOne 1 100 0.00 65535.00 FORMAT "%8.2" ECU_ADDRESS 0x8FE884 /end MEASUREMENT
/begin MEASUREMENT Dfp_PSPCD_Actr_mp "Messpunkt fuer Fehlerpfad  Dfp_PSPCD_Actr" UWORD OneToOne 1 100 0.00 65535.00 FORMAT "%8.2" ECU_ADDRESS 0x8FE886 /end MEASUREMENT
/begin MEASUREMENT Dfp_QLTCD_mp "Messpunkt fuer Fehlerpfad  Dfp_QLTCD" UWORD OneToOne 1 100 0.00 65535.00 FORMAT "%8.2" ECU_ADDRESS 0x8FE888 /end MEASUREMENT
/begin MEASUREMENT Dfp_RailCDOfsTst_mp "Fehlerpfad für Offset-Überwachung des Raildrucksensors" UWORD OneToOne 1 100 0.00 65535.00 FORMAT "%8.2" ECU_ADDRESS 0x8FE88A /end MEASUREMENT
/begin MEASUREMENT Dfp_RailCD_mp "Messpunkt fuer Fehlerpfad  Dfp_RailCD" UWORD OneToOne 1 100 0.00 65535.00 FORMAT "%8.2" ECU_ADDRESS 0x8FE88C /end MEASUREMENT
/begin MEASUREMENT Dfp_RailCD_PMonStrt_mp "Messpunkt fuer Fehlerpfad  Dfp_RailCD_PMonStrt" UWORD OneToOne 1 100 0.00 65535.00 FORMAT "%8.2" ECU_ADDRESS 0x8FE88E /end MEASUREMENT
/begin MEASUREMENT Dfp_RailCtlModeMeUnDiag_mp "Messpunkt fuer Fehlerpfad  Dfp_RailCtlModeMeUnDiag" UWORD OneToOne 1 100 0.00 65535.00 FORMAT "%8.2" ECU_ADDRESS 0x8FE890 /end MEASUREMENT
/begin MEASUREMENT Dfp_RailCtlModePCVDiag_mp "Messpunkt fuer Fehlerpfad  Dfp_RailCtlModePCVDiag" UWORD OneToOne 1 100 0.00 65535.00 FORMAT "%8.2" ECU_ADDRESS 0x8FE892 /end MEASUREMENT
/begin MEASUREMENT Dfp_RailMeUn0_mp "Fehlerpfad für Überwachung auf positive Regelabweichung" UWORD OneToOne 1 100 0.00 65535.00 FORMAT "%8.2" ECU_ADDRESS 0x8FE894 /end MEASUREMENT
/begin MEASUREMENT Dfp_RailMeUn1_mp "Fehlerpfad für Überwachung auf positive Regelabweichung und Sollwert des Volumenstroms durch die Zumesseinheit" UWORD OneToOne 1 100 0.00 65535.00 FORMAT "%8.2" ECU_ADDRESS 0x8FE896 /end MEASUREMENT
/begin MEASUREMENT Dfp_RailMeUn2_mp "Fehlerpfad für Überwachung auf negative Regelabweichung bei Nullförderung" UWORD OneToOne 1 100 0.00 65535.00 FORMAT "%8.2" ECU_ADDRESS 0x8FE898 /end MEASUREMENT
/begin MEASUREMENT Dfp_RailMeUn3_mp "Fehlerpfad für Überwachung auf minimalen Raildruck" UWORD OneToOne 1 100 0.00 65535.00 FORMAT "%8.2" ECU_ADDRESS 0x8FE89A /end MEASUREMENT
/begin MEASUREMENT Dfp_RailMeUn4_mp "Fehlerpfad für Überwachung auf maximalen Raildruck" UWORD OneToOne 1 100 0.00 65535.00 FORMAT "%8.2" ECU_ADDRESS 0x8FE89C /end MEASUREMENT
/begin MEASUREMENT Dfp_RailPCV0_mp "Fehlerpfad für Überwachung auf positive Regelabweichung" UWORD OneToOne 1 100 0.00 65535.00 FORMAT "%8.2" ECU_ADDRESS 0x8FE89E /end MEASUREMENT
/begin MEASUREMENT Dfp_RailPCV1_mp "Fehlerpfad für Überwachung auf positive Regelabweichung kombiniert mit Stellgröße des Druckregelventils" UWORD OneToOne 1 100 0.00 65535.00 FORMAT "%8.2" ECU_ADDRESS 0x8FE8A0 /end MEASUREMENT
/begin MEASUREMENT Dfp_RailPCV2_mp "Fehlerpfad für Überwachung auf negative Regelabweichung kombiniert mit Stellgröße des Druckregelventils" UWORD OneToOne 1 100 0.00 65535.00 FORMAT "%8.2" ECU_ADDRESS 0x8FE8A2 /end MEASUREMENT
/begin MEASUREMENT Dfp_RailPCV3_mp "Fehlerpfad für Überwachung auf minimalen Raildruck" UWORD OneToOne 1 100 0.00 65535.00 FORMAT "%8.2" ECU_ADDRESS 0x8FE8A4 /end MEASUREMENT
/begin MEASUREMENT Dfp_RailPCV4_mp "Fehlerpfad für Überwachung auf maximalen Raildruck" UWORD OneToOne 1 100 0.00 65535.00 FORMAT "%8.2" ECU_ADDRESS 0x8FE8A6 /end MEASUREMENT
/begin MEASUREMENT Dfp_RailPCV5_mp "Fehlerpfad für Plausibilisierung des Raildrucks mit dem Strom durch das Druckregelventil" UWORD OneToOne 1 100 0.00 65535.00 FORMAT "%8.2" ECU_ADDRESS 0x8FE8A8 /end MEASUREMENT
/begin MEASUREMENT Dfp_ShutCD_mp "Messpunkt fuer Fehlerpfad  Dfp_ShutCD" UWORD OneToOne 1 100 0.00 65535.00 FORMAT "%8.2" ECU_ADDRESS 0x8FE8AA /end MEASUREMENT
/begin MEASUREMENT Dfp_SOPTst_mp "Messpunkt fuer Fehlerpfad  Dfp_SOPTst" UWORD OneToOne 1 100 0.00 65535.00 FORMAT "%8.2" ECU_ADDRESS 0x8FE8AC /end MEASUREMENT
/begin MEASUREMENT Dfp_SSpMon1_mp "Meßpunkt des Fehlerpfades für Sensorversorgungsspannung 1" UWORD OneToOne 1 100 0.00 65535.00 FORMAT "%8.2" ECU_ADDRESS 0x8FE8AE /end MEASUREMENT
/begin MEASUREMENT Dfp_SSpMon2_mp "Meßpunkt des Fehlerpfades für Sensorversorgungsspannung 2" UWORD OneToOne 1 100 0.00 65535.00 FORMAT "%8.2" ECU_ADDRESS 0x8FE8B0 /end MEASUREMENT
/begin MEASUREMENT Dfp_SSpMon3_mp "Meßpunkt des Fehlerpfades für Sensorversorgungsspannung 3" UWORD OneToOne 1 100 0.00 65535.00 FORMAT "%8.2" ECU_ADDRESS 0x8FE8B2 /end MEASUREMENT
/begin MEASUREMENT Dfp_StrtCD_Actr_mp "Fehlerpfad für Starterrelais Endstufe" UWORD OneToOne 1 100 0.00 65535.00 FORMAT "%8.2" ECU_ADDRESS 0x8FE8B4 /end MEASUREMENT
/begin MEASUREMENT Dfp_StSysTrqShutOff_mp "Zustand Fehlerpfad Start o. Kl.50" UWORD OneToOne 1 100 0.00 65535.00 FORMAT "%8.2" ECU_ADDRESS 0x8FE8B6 /end MEASUREMENT
/begin MEASUREMENT Dfp_SWChk_CycSigChkDat_mp "Messpunkt fuer Fehlerpfad  Dfp_SWChk_CycSigChkDat" UWORD OneToOne 1 100 0.00 65535.00 FORMAT "%8.2" ECU_ADDRESS 0x8FE8B8 /end MEASUREMENT
/begin MEASUREMENT Dfp_SWChk_CycSigChkPrg_mp "Messpunkt fuer Fehlerpfad  Dfp_SWChk_CycSigChkPrg" UWORD OneToOne 1 100 0.00 65535.00 FORMAT "%8.2" ECU_ADDRESS 0x8FE8BA /end MEASUREMENT
/begin MEASUREMENT Dfp_SysLamp_mp "Messpunkt fuer Fehlerpfad  Dfp_SysLamp" UWORD OneToOne 1 100 0.00 65535.00 FORMAT "%8.2" ECU_ADDRESS 0x8FE8BC /end MEASUREMENT
/begin MEASUREMENT Dfp_T15CD_mp "Messpunkt fuer Fehlerpfad  Dfp_T15CD" UWORD OneToOne 1 100 0.00 65535.00 FORMAT "%8.2" ECU_ADDRESS 0x8FE8BE /end MEASUREMENT
/begin MEASUREMENT Dfp_TGearbx_mp "Messpunkt fuer Fehlerpfad  Dfp_TGearbx" UWORD OneToOne 1 100 0.00 65535.00 FORMAT "%8.2" ECU_ADDRESS 0x8FE8C0 /end MEASUREMENT
/begin MEASUREMENT Dfp_TPUMon_mp "Messpunkt fuer Fehlerpfad  Dfp_TPUMon" UWORD OneToOne 1 100 0.00 65535.00 FORMAT "%8.2" ECU_ADDRESS 0x8FE8C2 /end MEASUREMENT
/begin MEASUREMENT Dfp_TVACD_Max_mp "Fehlerpfad für Kurzschluss nach Batteriespannung des Drosselklappenstellers" UWORD OneToOne 1 100 0.00 65535.00 FORMAT "%8.2" ECU_ADDRESS 0x8FE8C4 /end MEASUREMENT
/begin MEASUREMENT Dfp_TVACD_Min_mp "Fehlerpfad für Kurzschluss nach Masse des Drosselklappenstellers" UWORD OneToOne 1 100 0.00 65535.00 FORMAT "%8.2" ECU_ADDRESS 0x8FE8C6 /end MEASUREMENT
/begin MEASUREMENT Dfp_TVACD_SigNpl_mp "Fehlerpfad für Lastabfall und Übertemperatur des Drosselklappenstellers" UWORD OneToOne 1 100 0.00 65535.00 FORMAT "%8.2" ECU_ADDRESS 0x8FE8C8 /end MEASUREMENT
/begin MEASUREMENT Dfp_TVACD_TVADia1_mp "Messpunkt für Fehlerpfad Dfp_TVACD_TVADia1" UWORD OneToOne 1 100 0.00 65535.00 FORMAT "%8.2" ECU_ADDRESS 0x8FE8CA /end MEASUREMENT
/begin MEASUREMENT Dfp_TVACD_TVADia2_mp "Messpunkt für Fehlerpfad Dfp_TVACD_TVADia2" UWORD OneToOne 1 100 0.00 65535.00 FORMAT "%8.2" ECU_ADDRESS 0x8FE8CC /end MEASUREMENT
/begin MEASUREMENT Dfp_TVACD_TVADia3_mp "Messpunkt für Fehlerpfad Dfp_TVACD_TVADia3" UWORD OneToOne 1 100 0.00 65535.00 FORMAT "%8.2" ECU_ADDRESS 0x8FE8CE /end MEASUREMENT
/begin MEASUREMENT Dfp_TVACD_TVADia4_mp "Fehlerpfad für Drosselklappensteller Diagnose viertes Fenster" UWORD OneToOne 1 100 0.00 65535.00 FORMAT "%8.2" ECU_ADDRESS 0x8FE8D0 /end MEASUREMENT
/begin MEASUREMENT Dfp_VSACD_DioInDia1_mp "Messpunkt fuer Fehlerpfad  Dfp_VSACD_DioInDia1" UWORD OneToOne 1 100 0.00 65535.00 FORMAT "%8.2" ECU_ADDRESS 0x8FE8D2 /end MEASUREMENT
/begin MEASUREMENT Dfp_VSACD_DioInDia2_mp "Messpunkt fuer Fehlerpfad  Dfp_VSACD_DioInDia2" UWORD OneToOne 1 100 0.00 65535.00 FORMAT "%8.2" ECU_ADDRESS 0x8FE8D4 /end MEASUREMENT
/begin MEASUREMENT Dfp_VSACD_DioInDia3_mp "Messpunkt fuer Fehlerpfad  Dfp_VSACD_DioInDia3" UWORD OneToOne 1 100 0.00 65535.00 FORMAT "%8.2" ECU_ADDRESS 0x8FE8D6 /end MEASUREMENT
/begin MEASUREMENT Dfp_VSACD_DioInDia4_mp "Messpunkt fuer Fehlerpfad  Dfp_VSACD_DioInDia4" UWORD OneToOne 1 100 0.00 65535.00 FORMAT "%8.2" ECU_ADDRESS 0x8FE8D8 /end MEASUREMENT
/begin MEASUREMENT Dfp_VSACD_DioInMin_mp "Messpunkt fuer Fehlerpfad  Dfp_VSACD_DioInMin" UWORD OneToOne 1 100 0.00 65535.00 FORMAT "%8.2" ECU_ADDRESS 0x8FE8DA /end MEASUREMENT
/begin MEASUREMENT Dfp_VSACD_Max_mp "Fehlerpfad für Kurzschluss nach Batteriespannung des Drallniveaustellers" UWORD OneToOne 1 100 0.00 65535.00 FORMAT "%8.2" ECU_ADDRESS 0x8FE8DC /end MEASUREMENT
/begin MEASUREMENT Dfp_VSACD_Min_mp "Fehlerpfad für Kurzschluss nach Masse des Drallniveaustellers" UWORD OneToOne 1 100 0.00 65535.00 FORMAT "%8.2" ECU_ADDRESS 0x8FE8DE /end MEASUREMENT
/begin MEASUREMENT Dfp_VSACD_SigNpl_mp "Fehlerpfad für Lastabfall und Übertemperatur des Drallniveaustellers" UWORD OneToOne 1 100 0.00 65535.00 FORMAT "%8.2" ECU_ADDRESS 0x8FE8E0 /end MEASUREMENT
/begin MEASUREMENT Dfp_VSACD_VSADia1_mp "Messpunkt fuer Fehlerpfad  Dfp_VSACD_VSADia1" UWORD OneToOne 1 100 0.00 65535.00 FORMAT "%8.2" ECU_ADDRESS 0x8FE8E2 /end MEASUREMENT
/begin MEASUREMENT Dfp_VSACD_VSADia2_mp "Messpunkt fuer Fehlerpfad  Dfp_VSACD_VSADia2" UWORD OneToOne 1 100 0.00 65535.00 FORMAT "%8.2" ECU_ADDRESS 0x8FE8E4 /end MEASUREMENT
/begin MEASUREMENT Dfp_VSACD_VSADia3_mp "Messpunkt fuer Fehlerpfad  Dfp_VSACD_VSADia3" UWORD OneToOne 1 100 0.00 65535.00 FORMAT "%8.2" ECU_ADDRESS 0x8FE8E6 /end MEASUREMENT
/begin MEASUREMENT Dfp_VSACD_VSADia4_mp "Fehlerpfad für Drallklappensteller Diagnose viertes Fenster" UWORD OneToOne 1 100 0.00 65535.00 FORMAT "%8.2" ECU_ADDRESS 0x8FE8E8 /end MEASUREMENT
/begin MEASUREMENT Dfp_VSSCD1_mp "Messpunkt fuer Fehlerpfad  Dfp_VSSCD1" UWORD OneToOne 1 100 0.00 65535.00 FORMAT "%8.2" ECU_ADDRESS 0x8FE8EA /end MEASUREMENT
/begin MEASUREMENT Dfp_VSSCD2_mp "Messpunkt fuer Fehlerpfad  Dfp_VSSCD2" UWORD OneToOne 1 100 0.00 65535.00 FORMAT "%8.2" ECU_ADDRESS 0x8FE8EC /end MEASUREMENT
/begin MEASUREMENT Dfp_WdCom_mp "Messpunkt fuer Fehlerpfad  Dfp_WdCom" UWORD OneToOne 1 100 0.00 65535.00 FORMAT "%8.2" ECU_ADDRESS 0x8FE8EE /end MEASUREMENT
/begin MEASUREMENT DSCHED_numDefDfpArray_mp "Array von defekten DFPs welche einen ausgewählten FID verriegeln" UWORD DfpName 1 100 0.00 373.000000000 FORMAT "%13.9" ARRAY_SIZE 10 ECU_ADDRESS 0x8FECB2 /end MEASUREMENT
/begin MEASUREMENT DSCHED_numOkDfpArray_mp "Array von nicht defekten DFPs welche einen ausgewählten FID verriegeln" UWORD DfpName 1 100 0.00 373.000000000 FORMAT "%13.9" ARRAY_SIZE 20 ECU_ADDRESS 0x8FECC6 /end MEASUREMENT
/begin MEASUREMENT DSM_ctDfctPath "Anzahl der momentan defekten Fehlerpfade" UWORD OneToOne 1 100 0.00 65535.00 FORMAT "%8.2" ECU_ADDRESS 0x7F8BF8 /end MEASUREMENT
/begin MEASUREMENT DSM_ctFcmEntry "Anzahl der belegten Fehlerspeichereinträge" UBYTE OneToOne 1 100 0.00 255.0 FORMAT "%5.1" ECU_ADDRESS 0x7F884F /end MEASUREMENT
/begin MEASUREMENT DSM_ctFCMEntrySize_mp "Größe eines Fehlerspeichereintrages in Bytes (Inklusive Füllbyte falls vorhanden)" UBYTE OneToOne 1 100 0.00 255.0 FORMAT "%5.1" ECU_ADDRESS 0x8FECEE /end MEASUREMENT
/begin MEASUREMENT DSM_ctOBDPath "Anzahl der momentanen OBD-fehler im Fehlerspeicher" UBYTE OneToOne 1 100 0.00 255.0 FORMAT "%5.1" ECU_ADDRESS 0x7F8850 /end MEASUREMENT
/begin MEASUREMENT DSM_ctOBDValidPath "Anzahl bestätigter OBD relevanter Fehlerspeicher Einträge." UBYTE OneToOne 1 100 0.00 255.0 FORMAT "%5.1" ECU_ADDRESS 0x7F8851 /end MEASUREMENT
/begin MEASUREMENT DSM_ctPath_mp "Anzahl der existierenden Fehlerpfade" UWORD OneToOne 1 100 0.00 65535.00 FORMAT "%8.2" ECU_ADDRESS 0x8FECF0 /end MEASUREMENT
/begin MEASUREMENT DSM_ctRdyActCyc_mp "Status für jedes Readinessbit aus dem aktuellen driving cycle" UBYTE OneToOne 1 100 0.00 255.0 FORMAT "%5.1" ECU_ADDRESS 0x6F8020 /end MEASUREMENT
/begin MEASUREMENT DSM_ctRdyCycCat_mp "Anzahl der für Readiness Bit Catalyst erreichten Zyklen." UBYTE OneToOne 1 100 0.00 255.0 FORMAT "%5.1" ECU_ADDRESS 0x8FEC99 /end MEASUREMENT
/begin MEASUREMENT DSM_ctRdyCycCompr_mp "Anzahl der für Readiness Bit Comprehensive Components erreichten Zyklen." UBYTE OneToOne 1 100 0.00 255.0 FORMAT "%5.1" ECU_ADDRESS 0x8FEC9A /end MEASUREMENT
/begin MEASUREMENT DSM_ctRdyCycEGR_mp "Anzahl der für Readiness Bit EGR erreichten Zyklen." UBYTE OneToOne 1 100 0.00 255.0 FORMAT "%5.1" ECU_ADDRESS 0x8FEC9B /end MEASUREMENT
/begin MEASUREMENT DSM_ctRdyCycFuel_mp "Anzahl der für Readiness Bit Fuel System erreichten Zyklen." UBYTE OneToOne 1 100 0.00 255.0 FORMAT "%5.1" ECU_ADDRESS 0x8FEC9C /end MEASUREMENT
/begin MEASUREMENT DSM_ctRdyCycMisf_mp "Anzahl der für Readiness Bit Misfire erreichten Zyklen." UBYTE OneToOne 1 100 0.00 255.0 FORMAT "%5.1" ECU_ADDRESS 0x8FEC9D /end MEASUREMENT
/begin MEASUREMENT DSM_ctRdyCycOxSenHt_mp "Anzahl erreichter Zyklen für Readiness Bit Oxygen Sensor Heater" UBYTE OneToOne 1 100 0.00 255.0 FORMAT "%5.1" ECU_ADDRESS 0x8FEC9E /end MEASUREMENT
/begin MEASUREMENT DSM_ctRdyCycOxSen_mp "Anzahl der erreichten Zyklen für Readiness Bit Oxygen Sensor" UBYTE OneToOne 1 100 0.00 255.0 FORMAT "%5.1" ECU_ADDRESS 0x8FEC9F /end MEASUREMENT
/begin MEASUREMENT DSM_ctRdyLimCat_mp "Notwendige Anzahl Zyklen für Readiness Bit Catalyst." UBYTE OneToOne 1 100 0.00 255.0 FORMAT "%5.1" ECU_ADDRESS 0x8FECA0 /end MEASUREMENT
/begin MEASUREMENT DSM_ctRdyLimCompr_mp "Notwendige Anzahl Zyklen für Readiness Bit Comprehensive Components." UBYTE OneToOne 1 100 0.00 255.0 FORMAT "%5.1" ECU_ADDRESS 0x8FECA1 /end MEASUREMENT
/begin MEASUREMENT DSM_ctRdyLimEGR_mp "Notwendige Anzahl Zyklen für Readiness Bit EGR." UBYTE OneToOne 1 100 0.00 255.0 FORMAT "%5.1" ECU_ADDRESS 0x8FECA2 /end MEASUREMENT
/begin MEASUREMENT DSM_ctRdyLimFuel_mp "Notwendige Anzahl Zyklen für Readiness Bit Fuel System." UBYTE OneToOne 1 100 0.00 255.0 FORMAT "%5.1" ECU_ADDRESS 0x8FECA3 /end MEASUREMENT
/begin MEASUREMENT DSM_ctRdyLimMisf_mp "Notwendige Anzahl Zyklen für Readiness Bit Misfire." UBYTE OneToOne 1 100 0.00 255.0 FORMAT "%5.1" ECU_ADDRESS 0x8FECA4 /end MEASUREMENT
/begin MEASUREMENT DSM_ctRdyLimOxSenHt_mp "Notwendige Anzahl von Zyklen für Readiness Bit Oxygen Sensor Heater" UBYTE OneToOne 1 100 0.00 255.0 FORMAT "%5.1" ECU_ADDRESS 0x8FECA5 /end MEASUREMENT
/begin MEASUREMENT DSM_ctRdyLimOxSen_mp "Notwendige Anzahl Zyklen für Readiness Bit Oxygen Sensor" UBYTE OneToOne 1 100 0.00 255.0 FORMAT "%5.1" ECU_ADDRESS 0x8FECA6 /end MEASUREMENT
/begin MEASUREMENT DSM_ctRdyPathsCat_mp "Anzahl von Fehlerpfaden die zum Readiness Bit Catalyst gehören." UBYTE OneToOne 1 100 0.00 255.0 FORMAT "%5.1" ECU_ADDRESS 0x8FECA7 /end MEASUREMENT
/begin MEASUREMENT DSM_ctRdyPathsCompr_mp "Anzahl von Fehlerpfaden die zum Readiness Bit Comprehensive Components gehören." UBYTE OneToOne 1 100 0.00 255.0 FORMAT "%5.1" ECU_ADDRESS 0x8FECA8 /end MEASUREMENT
/begin MEASUREMENT DSM_ctRdyPathsEGR_mp "Anzahl von Fehlerpfaden die zum Readiness Bit EGR gehören." UBYTE OneToOne 1 100 0.00 255.0 FORMAT "%5.1" ECU_ADDRESS 0x8FECA9 /end MEASUREMENT
/begin MEASUREMENT DSM_ctRdyPathsFuel_mp "Anzahl von Fehlerpfaden die zum Readiness Bit Fuel System gehören." UBYTE OneToOne 1 100 0.00 255.0 FORMAT "%5.1" ECU_ADDRESS 0x8FECAA /end MEASUREMENT
/begin MEASUREMENT DSM_ctRdyPathsMisf_mp "Anzahl von Fehlerpfaden die zum Readiness Bit Misfire gehören." UBYTE OneToOne 1 100 0.00 255.0 FORMAT "%5.1" ECU_ADDRESS 0x8FECAB /end MEASUREMENT
/begin MEASUREMENT DSM_ctRdyPathsOxSenHt_mp "Anzahl von Fehlerpfaden, die zum Readiness Bit Oxygen Sensor Heater gehören" UBYTE OneToOne 1 100 0.00 255.0 FORMAT "%5.1" ECU_ADDRESS 0x8FECAC /end MEASUREMENT
/begin MEASUREMENT DSM_ctRdyPathsOxSen_mp "Anzahl der Fehlerpfade die zum Readiness Bit Oxygen Sensor gehören" UBYTE OneToOne 1 100 0.00 255.0 FORMAT "%5.1" ECU_ADDRESS 0x8FECAD /end MEASUREMENT
/begin MEASUREMENT DSM_ctRdyTstCat_mp "Anzahl von in diesem Zyklus getesteten Fehlerpfaden die zum Readiness Bit Catalyst gehören." UBYTE OneToOne 1 100 0.00 255.0 FORMAT "%5.1" ECU_ADDRESS 0x8FECAE /end MEASUREMENT
/begin MEASUREMENT DSM_ctRdyTstCompr_mp "Anzahl von in diesem Zyklus getesteten Fehlerpfaden die zum Readiness Bit Comprehensive Components  gehören." UBYTE OneToOne 1 100 0.00 255.0 FORMAT "%5.1" ECU_ADDRESS 0x6F8022 /end MEASUREMENT
/begin MEASUREMENT DSM_ctRdyTstEGR_mp "Anzahl von in diesem Zyklus getesteten Fehlerpfaden die zum Readiness Bit EGR gehören." UBYTE OneToOne 1 100 0.00 255.0 FORMAT "%5.1" ECU_ADDRESS 0x6F8024 /end MEASUREMENT
/begin MEASUREMENT DSM_ctRdyTstFuel_mp "Anzahl von in diesem Zyklus getesteten Fehlerpfaden die zum Readiness Bit Fuel System gehören." UBYTE OneToOne 1 100 0.00 255.0 FORMAT "%5.1" ECU_ADDRESS 0x6F8026 /end MEASUREMENT
/begin MEASUREMENT DSM_ctRdyTstMisf_mp "Anzahl von in diesem Zyklus getesteten Fehlerpfaden die zum Readiness Bit Misfire  gehören." UBYTE OneToOne 1 100 0.00 255.0 FORMAT "%5.1" ECU_ADDRESS 0x6F8028 /end MEASUREMENT
/begin MEASUREMENT DSM_ctRdyTstOxSenHt_mp "Anzahl von in diesem Zyklus getesteten Fehlerpfaden die zum Readiness Bit Oxygen Sensor Heater gehören." UBYTE OneToOne 1 100 0.00 255.0 FORMAT "%5.1" ECU_ADDRESS 0x8FECAF /end MEASUREMENT
/begin MEASUREMENT DSM_ctRdyTstOxSen_mp "Anzahl von in diesem Zyklus getesteten Fehlerpfaden die zum Readiness Bit Oxygen Sensor Heater gehören." UBYTE OneToOne 1 100 0.00 255.0 FORMAT "%5.1" ECU_ADDRESS 0x8FECB0 /end MEASUREMENT
/begin MEASUREMENT DSM_ctTstPath "Anzahl der getesteten Fehlerpfade" UWORD OneToOne 1 100 0.00 65535.00 FORMAT "%8.2" ECU_ADDRESS 0x7F8BFA /end MEASUREMENT
/begin MEASUREMENT DSM_ctWUC "Anzahl der Warm Up Cycle seit dem letzten Fehlerspeicherlöschen  (PID $30)" UBYTE OneToOne 1 100 0.00 255.0 FORMAT "%5.1" ECU_ADDRESS 0x7FEF34 /end MEASUREMENT
/begin MEASUREMENT DSM_FCM_mp "Fehlerspeicher" UBYTE OneToOne 1 100 0.00 255.0 FORMAT "%5.1" ARRAY_SIZE 644 ECU_ADDRESS 0x8FE8F0 /end MEASUREMENT
/begin MEASUREMENT DSM_lDist "Anzahl der gefahrenen Strecke seitdem letzten Fehlerspeicherlöschen (PID $31)" UWORD OneToOne 1 100 0.00 65535.00 FORMAT "%8.2" ECU_ADDRESS 0x7FEF36 /end MEASUREMENT
/begin MEASUREMENT DSM_stCycles "Status der DSM Trigger Zyklen (WUC, DC, ...)" UBYTE OneToOne 1 100 0.00 255.0 FORMAT "%5.1" ECU_ADDRESS 0x7F8852 /end MEASUREMENT
/begin MEASUREMENT DSM_stECUMasterSlave "Statusinformation ob das Steuergerät ein Master- oder ein Slave-Steuergerät ist" UBYTE OneToOne 1 100 0.00 255.0 FORMAT "%5.1" ECU_ADDRESS 0x7F8853 /end MEASUREMENT
/begin MEASUREMENT DSM_stInhDelay "Status Fehlerverriegelungs Verzögerung (1 wenn mindestens 1 Verzögerung aktiv)" UBYTE OneToOne 1 100 0.00 255.0 FORMAT "%5.1" ECU_ADDRESS 0x7F8854 /end MEASUREMENT
/begin MEASUREMENT DSM_stMIL "DSM Mil Anforderungsstatus (1 = kontinuierlich, 2 blinkend)" UBYTE OneToOne 1 100 0.00 255.0 FORMAT "%5.1" ECU_ADDRESS 0x7F8855 /end MEASUREMENT
/begin MEASUREMENT DSM_stPID41 "Readiness Status für Diagnoseschnittstelle gemäß ISO/DIS 15031-6.5, PID41" ULONG OneToOne 1 100 0.00 4294967295.00 FORMAT "%13.2" ECU_ADDRESS 0x7F91B0 /end MEASUREMENT
/begin MEASUREMENT DSM_stRdyAB "Readiness Status für Diagnoseschnittstelle gemäß SAE J1979 PID1 Byte A + B" UWORD OneToOne 1 100 0.00 65535.00 FORMAT "%8.2" ECU_ADDRESS 0x7F8BFC /end MEASUREMENT
/begin MEASUREMENT DSM_stRdyCD "Readiness Status für Diagnoseschnittstelle gemäß SAE J1979 PID1 Byte C * D" UWORD OneToOne 1 100 0.00 65535.00 FORMAT "%8.2" ECU_ADDRESS 0x7F8BFE /end MEASUREMENT
/begin MEASUREMENT DSM_stRdyCheckEnable "veroderte ready-bits der dfps, die durch die Funktion DSM_SetDfpSleep ermittelt wurden" UBYTE OneToOne 1 100 0.00 255.0 FORMAT "%5.1" ECU_ADDRESS 0x7F8856 /end MEASUREMENT
/begin MEASUREMENT DSM_stSysLamp "DSM System Lampen Anforderungsstatus (1 = kontinuierlich)" UBYTE OneToOne 1 100 0.00 255.0 FORMAT "%5.1" ECU_ADDRESS 0x7F8857 /end MEASUREMENT
/begin MEASUREMENT DSM_tiDCDelay_mp "aktuelle Zeit für Driving cycle Verzögerungszeit" UWORD OneToOne 1 100 0.00 65535.00 FORMAT "%8.2" ECU_ADDRESS 0x6F808A /end MEASUREMENT
/begin MEASUREMENT FidCol_mp "Meßpunkt der gesammelt den Zustand aller Funktionsidentifier (Fid) zur Verfügung stellt." UWORD OneToOne 1 100 0.00 65535.00 FORMAT "%8.2" ARRAY_SIZE 19 ECU_ADDRESS 0x8FECF2 /end MEASUREMENT
/begin MEASUREMENT Fid_ACCIRevErr_mp "Ist diese Fid verriegelt, so geht die ACC-Momentenschnittstelle in den Zustand ""irreversibler Fehler""" UBYTE OneToOne 1 100 0.00 255.0 FORMAT "%5.1" ECU_ADDRESS 0x8FEB74 /end MEASUREMENT
/begin MEASUREMENT Fid_AccPedBrkPres_mp "FID für defekten Bremsdruck" UBYTE OneToOne 1 100 0.00 255.0 FORMAT "%5.1" ECU_ADDRESS 0x8FEB75 /end MEASUREMENT
/begin MEASUREMENT Fid_AccPedVel_mp "Messpunkt fuer Fid_AccPedVel" UBYTE OneToOne 1 100 0.00 255.0 FORMAT "%5.1" ECU_ADDRESS 0x8FEB76 /end MEASUREMENT
/begin MEASUREMENT Fid_AccPed_Brk_mp "Verriegelung der Freigabe der Überprüfung auf Unplausibilität  bei defekter Bremse" UBYTE OneToOne 1 100 0.00 255.0 FORMAT "%5.1" ECU_ADDRESS 0x8FEB77 /end MEASUREMENT
/begin MEASUREMENT Fid_AccPed_mp "Messpunkt fuer Funktions Identifier Fid_AccPed" UBYTE OneToOne 1 100 0.00 255.0 FORMAT "%5.1" ECU_ADDRESS 0x8FEB78 /end MEASUREMENT
/begin MEASUREMENT Fid_ACCRevErr_mp "Ist diese Fid verriegelt, so geht die ACC-Momentenschnittstelle in den Zustand ""reversibler Fehler""" UBYTE OneToOne 1 100 0.00 255.0 FORMAT "%5.1" ECU_ADDRESS 0x8FEB79 /end MEASUREMENT
/begin MEASUREMENT Fid_ACCtlDflt1_mp "Messpunkt fuer Funktions Identifier Fid_ACCtlDflt1" UBYTE OneToOne 1 100 0.00 255.0 FORMAT "%5.1" ECU_ADDRESS 0x8FEB7A /end MEASUREMENT
/begin MEASUREMENT Fid_ACCtlDflt2_mp "Messpunkt fuer Funktions Identifier Fid_ACCtlDflt2" UBYTE OneToOne 1 100 0.00 255.0 FORMAT "%5.1" ECU_ADDRESS 0x8FEB7B /end MEASUREMENT
/begin MEASUREMENT Fid_ACCtl_ACTrqErr_mp "Messpunkt fuer Funktions Identifier Fid_ACCtl_ACTrqErr" UBYTE OneToOne 1 100 0.00 255.0 FORMAT "%5.1" ECU_ADDRESS 0x8FEB7C /end MEASUREMENT
/begin MEASUREMENT Fid_ACCtl_CTSErr_mp "Messpunkt fuer Funktions Identifier Fid_ACCtl_CTSErr" UBYTE OneToOne 1 100 0.00 255.0 FORMAT "%5.1" ECU_ADDRESS 0x8FEB7D /end MEASUREMENT
/begin MEASUREMENT Fid_ACCtl_FanErr_mp "Messpunkt fuer Funktions Identifier Fid_ACCtl_FanErr" UBYTE OneToOne 1 100 0.00 255.0 FORMAT "%5.1" ECU_ADDRESS 0x8FEB7E /end MEASUREMENT
/begin MEASUREMENT Fid_ACCtl_mp "Messpunkt fuer Funktions Identifier Fid_ACCtl" UBYTE OneToOne 1 100 0.00 255.0 FORMAT "%5.1" ECU_ADDRESS 0x8FEB7F /end MEASUREMENT
/begin MEASUREMENT Fid_ACCtl_TGearbxErr_mp "Messpunkt fuer Funktions Identifier Fid_ACCtl_TGearbxErr" UBYTE OneToOne 1 100 0.00 255.0 FORMAT "%5.1" ECU_ADDRESS 0x8FEB80 /end MEASUREMENT
/begin MEASUREMENT Fid_ACCtl_VSSErr_mp "Messpunkt fuer Funktions Identifier Fid_ACCtl_VSSErr" UBYTE OneToOne 1 100 0.00 255.0 FORMAT "%5.1" ECU_ADDRESS 0x8FEB81 /end MEASUREMENT
/begin MEASUREMENT Fid_ACC_AliveErr_mp "Ist diese Fid verriegelt, so geht die ACC-Momentenschnittstelle in Zustand ""irreversiler Fehler""" UBYTE OneToOne 1 100 0.00 255.0 FORMAT "%5.1" ECU_ADDRESS 0x8FEB82 /end MEASUREMENT
/begin MEASUREMENT Fid_ACC_CsErr_mp "Ist diese Fid verriegelt, so geht die ACC-Momentenschnittstelle in den Zustand ""irreversibler Fehler""" UBYTE OneToOne 1 100 0.00 255.0 FORMAT "%5.1" ECU_ADDRESS 0x8FEB83 /end MEASUREMENT
/begin MEASUREMENT Fid_ACC_TiOutErr_mp "Ist diese Fid verriegelt, so geht die ACC-Momentenschnittstelle in den Zustand ""reversibler Fehler""" UBYTE OneToOne 1 100 0.00 255.0 FORMAT "%5.1" ECU_ADDRESS 0x8FEB84 /end MEASUREMENT
/begin MEASUREMENT Fid_ACTrqC_mp "Messpunkt fuer Funktions Identifier Fid_ACTrqC" UBYTE OneToOne 1 100 0.00 255.0 FORMAT "%5.1" ECU_ADDRESS 0x8FEB85 /end MEASUREMENT
/begin MEASUREMENT Fid_AFSCD_AirPerTime_mp "Messpunkt für Funktions Identifier Fid_AFSCD_AirPerTime" UBYTE OneToOne 1 100 0.00 255.0 FORMAT "%5.1" ECU_ADDRESS 0x8FEB86 /end MEASUREMENT
/begin MEASUREMENT Fid_AFSCD_mp "Messpunkt für Funktions Identifier Fid_AFSCD" UBYTE OneToOne 1 100 0.00 255.0 FORMAT "%5.1" ECU_ADDRESS 0x8FEB87 /end MEASUREMENT
/begin MEASUREMENT Fid_AFSCD_PlOffsDrft_mp "Messpunkt fuer Funktions Identifier Fid_AFSCD_PlOffsDrft" UBYTE OneToOne 1 100 0.00 255.0 FORMAT "%5.1" ECU_ADDRESS 0x8FEB88 /end MEASUREMENT
/begin MEASUREMENT Fid_AFSCD_PlSetyDrft_mp "Messpunkt für Funktions Identifier Fid_AFSCD_PlSetyDrft" UBYTE OneToOne 1 100 0.00 255.0 FORMAT "%5.1" ECU_ADDRESS 0x8FEB89 /end MEASUREMENT
/begin MEASUREMENT Fid_AFSCD_SRCCorrAirm_mp "Fid zur Verriegelung des SRC des korrigierten Sensorsignals (HFM6)" UBYTE OneToOne 1 100 0.00 255.0 FORMAT "%5.1" ECU_ADDRESS 0x8FEB8A /end MEASUREMENT
/begin MEASUREMENT Fid_AFSCD_SRCDcyc_mp "Fid zur Verriegelung des SRC des Tastverhältnisses des Temperatursignals" UBYTE OneToOne 1 100 0.00 255.0 FORMAT "%5.1" ECU_ADDRESS 0x8FEB8B /end MEASUREMENT
/begin MEASUREMENT Fid_AFSCD_SRCRawAirm_mp "Fid zur Verriegelung des SRC des unkorrigierten Sensorsignals (HFM6)" UBYTE OneToOne 1 100 0.00 255.0 FORMAT "%5.1" ECU_ADDRESS 0x8FEB8C /end MEASUREMENT
/begin MEASUREMENT Fid_AFSCD_SRCRefSig_mp "Fid zur Verriegelung des SRC der Periodendauer des Referenz- bzw Temperatursignals" UBYTE OneToOne 1 100 0.00 255.0 FORMAT "%5.1" ECU_ADDRESS 0x8FEB8D /end MEASUREMENT
/begin MEASUREMENT Fid_AFS_CanMon_mp "Messpunkt fuer Funktions Identifier Fid_AFS_CanMon" UBYTE OneToOne 1 100 0.00 255.0 FORMAT "%5.1" ECU_ADDRESS 0x8FEB8E /end MEASUREMENT
/begin MEASUREMENT Fid_AFS_GenDisableCond_mp "Messpunkt fuer Funktions Identifier Fid_AFS_GenDisableCond" UBYTE OneToOne 1 100 0.00 255.0 FORMAT "%5.1" ECU_ADDRESS 0x8FEB8F /end MEASUREMENT
/begin MEASUREMENT Fid_AirCtlNeg2_mp "Messpunkt fuer Funktions Identifier Fid_AirCtlNeg2" UBYTE OneToOne 1 100 0.00 255.0 FORMAT "%5.1" ECU_ADDRESS 0x8FEB90 /end MEASUREMENT
/begin MEASUREMENT Fid_AirCtlNeg_mp "Messpunkt fuer Funktions Identifier Fid_AirCtlNeg" UBYTE OneToOne 1 100 0.00 255.0 FORMAT "%5.1" ECU_ADDRESS 0x8FEB91 /end MEASUREMENT
/begin MEASUREMENT Fid_AirCtlPFltEGRRed_mp "AirCtlPFltEGRRed fault identifier" UBYTE OneToOne 1 100 0.00 255.0 FORMAT "%5.1" ECU_ADDRESS 0x8FEB92 /end MEASUREMENT
/begin MEASUREMENT Fid_AirCtlPlateBreakActv_mp "Messpunkt fuer Funktions Identifier Fid_AirCtlPlateBreakActv" UBYTE OneToOne 1 100 0.00 255.0 FORMAT "%5.1" ECU_ADDRESS 0x8FEB93 /end MEASUREMENT
/begin MEASUREMENT Fid_AirCtlPlateBreak_mp "Fid for plate break monitoring" UBYTE OneToOne 1 100 0.00 255.0 FORMAT "%5.1" ECU_ADDRESS 0x8FEB94 /end MEASUREMENT
/begin MEASUREMENT Fid_AirCtlPos2_mp "Messpunkt fuer Funktions Identifier Fid_AirCtlPos2" UBYTE OneToOne 1 100 0.00 255.0 FORMAT "%5.1" ECU_ADDRESS 0x8FEB95 /end MEASUREMENT
/begin MEASUREMENT Fid_AirCtlPos_mp "Messpunkt fuer Funktions Identifier Fid_AirCtlPos" UBYTE OneToOne 1 100 0.00 255.0 FORMAT "%5.1" ECU_ADDRESS 0x8FEB96 /end MEASUREMENT
/begin MEASUREMENT Fid_AirCtl_Brk_mp "Fid zum Deaktvieren der Fehlerausblendung bei betätigter Bremse" UBYTE OneToOne 1 100 0.00 255.0 FORMAT "%5.1" ECU_ADDRESS 0x8FEB97 /end MEASUREMENT
/begin MEASUREMENT Fid_AirCtl_mp "Messpunkt fuer Funktions Identifier Fid_AirCtl" UBYTE OneToOne 1 100 0.00 255.0 FORMAT "%5.1" ECU_ADDRESS 0x8FEB98 /end MEASUREMENT
/begin MEASUREMENT Fid_AOHt_AltErr_mp "Messpunkt fuer Funktions Identifier Fid_AOHt_AltErr" UBYTE OneToOne 1 100 0.00 255.0 FORMAT "%5.1" ECU_ADDRESS 0x8FEB99 /end MEASUREMENT
/begin MEASUREMENT Fid_AOHt_ShutOffErr_mp "Messpunkt fuer Funktions Identifier Fid_AOHt_ShutOffErr" UBYTE OneToOne 1 100 0.00 255.0 FORMAT "%5.1" ECU_ADDRESS 0x8FEB9A /end MEASUREMENT
/begin MEASUREMENT Fid_APP1_mp "Messpunkt fuer Funktions Identifier Fid_APP1" UBYTE OneToOne 1 100 0.00 255.0 FORMAT "%5.1" ECU_ADDRESS 0x8FEB9B /end MEASUREMENT
/begin MEASUREMENT Fid_APP2_mp "Messpunkt fuer Funktions Identifier Fid_APP2" UBYTE OneToOne 1 100 0.00 255.0 FORMAT "%5.1" ECU_ADDRESS 0x8FEB9C /end MEASUREMENT
/begin MEASUREMENT Fid_APPKickdown_mp "Messpunkt für Fid_APPKickdown" UBYTE OneToOne 1 100 0.00 255.0 FORMAT "%5.1" ECU_ADDRESS 0x8FEB9D /end MEASUREMENT
/begin MEASUREMENT Fid_APSCD_mp "Messpunkt fuer Funktions Identifier Fid_APSCD" UBYTE OneToOne 1 100 0.00 255.0 FORMAT "%5.1" ECU_ADDRESS 0x8FEB9E /end MEASUREMENT
/begin MEASUREMENT Fid_ARSOff_mp "Fid for error reaction" UBYTE OneToOne 1 100 0.00 255.0 FORMAT "%5.1" ECU_ADDRESS 0x8FEB9F /end MEASUREMENT
/begin MEASUREMENT Fid_ASDdc_mp "Messpunkt fuer Funktions Identifier Fid_ASDdc" UBYTE OneToOne 1 100 0.00 255.0 FORMAT "%5.1" ECU_ADDRESS 0x8FEBA0 /end MEASUREMENT
/begin MEASUREMENT Fid_ASModSwtOffEng_mp "Messpunkt für function identifier Fid_ASModSwtOffEng" UBYTE OneToOne 1 100 0.00 255.0 FORMAT "%5.1" ECU_ADDRESS 0x8FEBA1 /end MEASUREMENT
/begin MEASUREMENT Fid_ASModSwtOffIndVol_mp "Meßpunkt für function identifier Fid_ASModSwtOffIndVol" UBYTE OneToOne 1 100 0.00 255.0 FORMAT "%5.1" ECU_ADDRESS 0x8FEBA2 /end MEASUREMENT
/begin MEASUREMENT Fid_BPSCDMon_mp "Messpunkt fuer Funktions Identifier Fid_BPSCDMon" UBYTE OneToOne 1 100 0.00 255.0 FORMAT "%5.1" ECU_ADDRESS 0x8FEBA3 /end MEASUREMENT
/begin MEASUREMENT Fid_ClgDynTst_mp "Messpunkt fuer Funktions Identifier Fid_ClgDynTst" UBYTE OneToOne 1 100 0.00 255.0 FORMAT "%5.1" ECU_ADDRESS 0x8FEBA4 /end MEASUREMENT
/begin MEASUREMENT Fid_CmbChb_mp "Messpunkt fuer Funktions Identifier Fid_CmbChb" UBYTE OneToOne 1 100 0.00 255.0 FORMAT "%5.1" ECU_ADDRESS 0x8FEBA5 /end MEASUREMENT
/begin MEASUREMENT Fid_CoDT_GripDeb_mp "Messpunkt fuer Funktions Identifier Fid_CoDT_GripDeb" UBYTE OneToOne 1 100 0.00 255.0 FORMAT "%5.1" ECU_ADDRESS 0x8FEBA6 /end MEASUREMENT
/begin MEASUREMENT Fid_CoEngIRevSys1_mp "Messpunkt fuer Funktions Identifier Fid_CoEngIRevSys1" UBYTE OneToOne 1 100 0.00 255.0 FORMAT "%5.1" ECU_ADDRESS 0x8FEBA7 /end MEASUREMENT
/begin MEASUREMENT Fid_CoEngIRevSys2_mp "Messpunkt fuer Funktions Identifier Fid_CoEngIRevSys2" UBYTE OneToOne 1 100 0.00 255.0 FORMAT "%5.1" ECU_ADDRESS 0x8FEBA8 /end MEASUREMENT
/begin MEASUREMENT Fid_CoEngIRevVeh_mp "Freigabe, sofern keine irreversiblen Fahrzeugfehler vorhanden" UBYTE OneToOne 1 100 0.00 255.0 FORMAT "%5.1" ECU_ADDRESS 0x8FEBA9 /end MEASUREMENT
/begin MEASUREMENT Fid_CoEngPFltErr_mp "Messpunkt fuer Funktions Identifier Fid_CoEngPFltErr" UBYTE OneToOne 1 100 0.00 255.0 FORMAT "%5.1" ECU_ADDRESS 0x8FEBAA /end MEASUREMENT
/begin MEASUREMENT Fid_CoEngRevSys1_mp "Messpunkt fuer Funktions Identifier Fid_CoEngRevSys1" UBYTE OneToOne 1 100 0.00 255.0 FORMAT "%5.1" ECU_ADDRESS 0x8FEBAB /end MEASUREMENT
/begin MEASUREMENT Fid_CoEngRevSys2_mp "Messpunkt fuer Funktions Identifier Fid_CoEngRevSys2" UBYTE OneToOne 1 100 0.00 255.0 FORMAT "%5.1" ECU_ADDRESS 0x8FEBAC /end MEASUREMENT
/begin MEASUREMENT Fid_CoEngRevVeh_mp "Freigabe, sofern keine reversiblen Fahrzeugfehler vorliegen" UBYTE OneToOne 1 100 0.00 255.0 FORMAT "%5.1" ECU_ADDRESS 0x8FEBAD /end MEASUREMENT
/begin MEASUREMENT Fid_CoEngShOffTst_mp "Messpunkt fuer Funktions Identifier Fid_CoEngShOffTst" UBYTE OneToOne 1 100 0.00 255.0 FORMAT "%5.1" ECU_ADDRESS 0x8FEBAE /end MEASUREMENT
/begin MEASUREMENT Fid_CoEngSoftShOffTV_mp "Messpunkt fuer Funktions Identifier Fid_CoEngSoftShOffTV" UBYTE OneToOne 1 100 0.00 255.0 FORMAT "%5.1" ECU_ADDRESS 0x8FEBAF /end MEASUREMENT
/begin MEASUREMENT Fid_CoEng_ActrPrt_mp "Messpunkt fuer Funktions Identifier Fid_CoEng_ActrPrt" UBYTE OneToOne 1 100 0.00 255.0 FORMAT "%5.1" ECU_ADDRESS 0x8FEBB0 /end MEASUREMENT
/begin MEASUREMENT Fid_CoEng_Nrml2Strt_mp "Messpunkt fuer Funktions Identifier Fid_CoEng_Nrml2Strt" UBYTE OneToOne 1 100 0.00 255.0 FORMAT "%5.1" ECU_ADDRESS 0x8FEBB1 /end MEASUREMENT
/begin MEASUREMENT Fid_CoEng_PwrStgEnable_mp "Messpunkt fuer Funktions Identifier Fid_CoEng_PwrStgEnable" UBYTE OneToOne 1 100 0.00 255.0 FORMAT "%5.1" ECU_ADDRESS 0x8FEBB2 /end MEASUREMENT
/begin MEASUREMENT Fid_CoEng_trqLimErr1_mp "Fid für die Aktivierung eines limitierten Moments bei fehlerhaften Raildruck" UBYTE OneToOne 1 100 0.00 255.0 FORMAT "%5.1" ECU_ADDRESS 0x8FEBB3 /end MEASUREMENT
/begin MEASUREMENT Fid_CoEng_trqLimErr2_mp "Messpunkt fuer Funktions Identifier Fid_CoEng_trqLimErr2" UBYTE OneToOne 1 100 0.00 255.0 FORMAT "%5.1" ECU_ADDRESS 0x8FEBB4 /end MEASUREMENT
/begin MEASUREMENT Fid_CoEng_trqLimErr3_mp "Messpunkt fuer Funktions Identifier Fid_CoEng_trqLimErr3" UBYTE OneToOne 1 100 0.00 255.0 FORMAT "%5.1" ECU_ADDRESS 0x8FEBB5 /end MEASUREMENT
/begin MEASUREMENT Fid_CoEng_trqLimErr4_mp "Measurement point for Function Identifier Fid_CoEng_trqLimErr4" UBYTE OneToOne 1 100 0.00 255.0 FORMAT "%5.1" ECU_ADDRESS 0x8FEBB6 /end MEASUREMENT
/begin MEASUREMENT Fid_CoEng_trqLimErr_mp "Messpunkt für Funktions Identifier Fid_CoEng_trqLimErr" UBYTE OneToOne 1 100 0.00 255.0 FORMAT "%5.1" ECU_ADDRESS 0x8FEBB7 /end MEASUREMENT
/begin MEASUREMENT Fid_CoVehtrqLimErr_mp "Messpunkt fuer Funktions Identifier Fid_CoVehtrqLimErr" UBYTE OneToOne 1 100 0.00 255.0 FORMAT "%5.1" ECU_ADDRESS 0x8FEBB8 /end MEASUREMENT
/begin MEASUREMENT Fid_CoVM_StabDem_Err_mp "Messpunkt fuer Funktions Identifier Fid_CoVM_StabDem_Err" UBYTE OneToOne 1 100 0.00 255.0 FORMAT "%5.1" ECU_ADDRESS 0x8FEBB9 /end MEASUREMENT
/begin MEASUREMENT Fid_CpBVlvOff_mp "" UBYTE OneToOne 1 100 0.00 255.0 FORMAT "%5.1" ECU_ADDRESS 0x8FEBBA /end MEASUREMENT
/begin MEASUREMENT Fid_CrCtlShutOffIr_mp "Messpunkt fuer Funktions Identifier Fid_CrCtlShutOffIr" UBYTE OneToOne 1 100 0.00 255.0 FORMAT "%5.1" ECU_ADDRESS 0x8FEBBB /end MEASUREMENT
/begin MEASUREMENT Fid_CrCtl_ASCTimeout_mp "Messpunkt fuer Funktions Identifier Fid_CrCtl_ASCTimeout" UBYTE OneToOne 1 100 0.00 255.0 FORMAT "%5.1" ECU_ADDRESS 0x8FEBBC /end MEASUREMENT
/begin MEASUREMENT Fid_CrCtl_CanDef_mp "Abschaltung CrCtl am Slave bei Fehler Privater CAN" UBYTE OneToOne 1 100 0.00 255.0 FORMAT "%5.1" ECU_ADDRESS 0x8FEBBD /end MEASUREMENT
/begin MEASUREMENT Fid_CrCtl_KombiTimeout_mp "lokale Größe" UBYTE OneToOne 1 100 0.00 255.0 FORMAT "%5.1" ECU_ADDRESS 0x8FEBBE /end MEASUREMENT
/begin MEASUREMENT Fid_CrCtl_vCrCtl_mp "Messpunkt fuer Funktions Identifier Fid_CrCtl_vCrCtl" UBYTE OneToOne 1 100 0.00 255.0 FORMAT "%5.1" ECU_ADDRESS 0x8FEBBF /end MEASUREMENT
/begin MEASUREMENT Fid_CTSCDFlTemp_mp "Messpunkt fuer Funktions Identifier Fid_CTSCDFlTemp" UBYTE OneToOne 1 100 0.00 255.0 FORMAT "%5.1" ECU_ADDRESS 0x8FEBC0 /end MEASUREMENT
/begin MEASUREMENT Fid_CTSCD_Plaus_mp "Messpunkt fuer Funktions Identifier Fid_CTSCD_Plaus" UBYTE OneToOne 1 100 0.00 255.0 FORMAT "%5.1" ECU_ADDRESS 0x8FEBC1 /end MEASUREMENT
/begin MEASUREMENT Fid_DCCIRevErr_mp "Fid fuer irreversible Störung in DCC" UBYTE OneToOne 1 100 0.00 255.0 FORMAT "%5.1" ECU_ADDRESS 0x8FEBC2 /end MEASUREMENT
/begin MEASUREMENT Fid_DCCRevErr_mp "Fid fuer reversible Störung in DCC" UBYTE OneToOne 1 100 0.00 255.0 FORMAT "%5.1" ECU_ADDRESS 0x8FEBC3 /end MEASUREMENT
/begin MEASUREMENT Fid_DCC_AliveErr_mp "Fid fuer Alive counter Störung in DCC" UBYTE OneToOne 1 100 0.00 255.0 FORMAT "%5.1" ECU_ADDRESS 0x8FEBC4 /end MEASUREMENT
/begin MEASUREMENT Fid_DCC_CsErr_mp "Fid fuer checksum Störung in DCC" UBYTE OneToOne 1 100 0.00 255.0 FORMAT "%5.1" ECU_ADDRESS 0x8FEBC5 /end MEASUREMENT
/begin MEASUREMENT Fid_DCC_PlausErr_mp "Fid fuer plausibilitaet Störung in DCC" UBYTE OneToOne 1 100 0.00 255.0 FORMAT "%5.1" ECU_ADDRESS 0x8FEBC6 /end MEASUREMENT
/begin MEASUREMENT Fid_DCC_TiOutErr_mp "Fid fuer timeout Störung in DCC" UBYTE OneToOne 1 100 0.00 255.0 FORMAT "%5.1" ECU_ADDRESS 0x8FEBC7 /end MEASUREMENT
/begin MEASUREMENT Fid_DSM_Wuc_mp "Messpunkt fuer Funktions Identifier Fid_DSM_Wuc" UBYTE OneToOne 1 100 0.00 255.0 FORMAT "%5.1" ECU_ADDRESS 0x8FEBC8 /end MEASUREMENT
/begin MEASUREMENT Fid_EATSCDTSubs_mp "Messpunkt fuer Funktions Identifier Fid_EATSCDTSubs" UBYTE OneToOne 1 100 0.00 255.0 FORMAT "%5.1" ECU_ADDRESS 0x8FEBC9 /end MEASUREMENT
/begin MEASUREMENT Fid_EBAFCD_mp "Messpunkt fuer Funktions Identifier Fid_EBAFCD" UBYTE OneToOne 1 100 0.00 255.0 FORMAT "%5.1" ECU_ADDRESS 0x8FEBCA /end MEASUREMENT
/begin MEASUREMENT Fid_EBFCD_mp "Messpunkt fuer Funktions Identifier Fid_EBFCD" UBYTE OneToOne 1 100 0.00 255.0 FORMAT "%5.1" ECU_ADDRESS 0x8FEBCB /end MEASUREMENT
/begin MEASUREMENT Fid_ECU_mp "Messpunkt fuer Funktions Identifier Fid_ECU" UBYTE OneToOne 1 100 0.00 255.0 FORMAT "%5.1" ECU_ADDRESS 0x8FEBCC /end MEASUREMENT
/begin MEASUREMENT Fid_EGSysCoLSU0_mp "Messpunkt für Function Identifier Fid_EGSysCoLSU0" UBYTE OneToOne 1 100 0.00 255.0 FORMAT "%5.1" ECU_ADDRESS 0x8FEBCD /end MEASUREMENT
/begin MEASUREMENT Fid_EGSysCoNSC_mp "Messpunkt für Function Identifier Fid_EGSysCoNSC" UBYTE OneToOne 1 100 0.00 255.0 FORMAT "%5.1" ECU_ADDRESS 0x8FEBCE /end MEASUREMENT
/begin MEASUREMENT Fid_EGSysCoOxi_mp "Messpunkt für Function Identifier Fid_EGSysCoOxi" UBYTE OneToOne 1 100 0.00 255.0 FORMAT "%5.1" ECU_ADDRESS 0x8FEBCF /end MEASUREMENT
/begin MEASUREMENT Fid_EGSysCoTrbn_mp "Messpunkt für Function Identifier Fid_EGSysCoTrbn" UBYTE OneToOne 1 100 0.00 255.0 FORMAT "%5.1" ECU_ADDRESS 0x8FEBD0 /end MEASUREMENT
/begin MEASUREMENT Fid_EGSysCoTube0_mp "Messpunkt für Function Identifier Fid_EGSysCoTube0" UBYTE OneToOne 1 100 0.00 255.0 FORMAT "%5.1" ECU_ADDRESS 0x8FEBD1 /end MEASUREMENT
/begin MEASUREMENT Fid_EGSysCoTube1_mp "Messpunkt für Function Identifier Fid_EGSysCoTube1" UBYTE OneToOne 1 100 0.00 255.0 FORMAT "%5.1" ECU_ADDRESS 0x8FEBD2 /end MEASUREMENT
/begin MEASUREMENT Fid_EGSysHtgDel_mp "Messpunkt für Function Identifier Fid_EGSysHtgDel" UBYTE OneToOne 1 100 0.00 255.0 FORMAT "%5.1" ECU_ADDRESS 0x8FEBD3 /end MEASUREMENT
/begin MEASUREMENT Fid_EGSysNSC_mp "Messpunkt für Function Identifier NSC" UBYTE OneToOne 1 100 0.00 255.0 FORMAT "%5.1" ECU_ADDRESS 0x8FEBD4 /end MEASUREMENT
/begin MEASUREMENT Fid_EGSysOxiCat_mp "Messpunkt für Function Identifier OxiCat" UBYTE OneToOne 1 100 0.00 255.0 FORMAT "%5.1" ECU_ADDRESS 0x8FEBD5 /end MEASUREMENT
/begin MEASUREMENT Fid_EGSysPresEnv_mp "Messpunkt für Function Identifier Fid_EGSysPresEnv" UBYTE OneToOne 1 100 0.00 255.0 FORMAT "%5.1" ECU_ADDRESS 0x8FEBD6 /end MEASUREMENT
/begin MEASUREMENT Fid_EGSysStrt_mp "Messpunkt für Function Identifier Fid_EGSysStrt" UBYTE OneToOne 1 100 0.00 255.0 FORMAT "%5.1" ECU_ADDRESS 0x8FEBD7 /end MEASUREMENT
/begin MEASUREMENT Fid_EGSysTemp_mp "Messpunkt für Function Identifier Fid_EGSysTemp" UBYTE OneToOne 1 100 0.00 255.0 FORMAT "%5.1" ECU_ADDRESS 0x8FEBD8 /end MEASUREMENT
/begin MEASUREMENT Fid_EGSysTrbn_mp "Messpunkt für Function Identifier Fid_EGSysTrbn" UBYTE OneToOne 1 100 0.00 255.0 FORMAT "%5.1" ECU_ADDRESS 0x8FEBD9 /end MEASUREMENT
/begin MEASUREMENT Fid_EGSysTube_mp "Messpunkt für Function Identifier Tube" UBYTE OneToOne 1 100 0.00 255.0 FORMAT "%5.1" ECU_ADDRESS 0x8FEBDA /end MEASUREMENT
/begin MEASUREMENT Fid_EGSys_AP_mp "Fehler des Atmosphärendruckfühlers" UBYTE OneToOne 1 100 0.00 255.0 FORMAT "%5.1" ECU_ADDRESS 0x8FEBDB /end MEASUREMENT
/begin MEASUREMENT Fid_EGTRgnLck_mp "Function indentifier zur Verriegelung einer Regeneration bei Überschreiten der kritischen Ölverdünnungszeit" UBYTE OneToOne 1 100 0.00 255.0 FORMAT "%5.1" ECU_ADDRESS 0x8FEBDC /end MEASUREMENT
/begin MEASUREMENT Fid_EGTTempGvnrAirCtl_mp "Fehler Erkennung für dauernde Regelabweichung des Luftmassenreglers" UBYTE OneToOne 1 100 0.00 255.0 FORMAT "%5.1" ECU_ADDRESS 0x8FEBDD /end MEASUREMENT
/begin MEASUREMENT Fid_EGTTempGvnrInr_mp "Function Identifier für Temperatur des inneren Regelkreises" UBYTE OneToOne 1 100 0.00 255.0 FORMAT "%5.1" ECU_ADDRESS 0x8FEBDE /end MEASUREMENT
/begin MEASUREMENT Fid_EGTTempGvnrOutr_mp "Function Identifier für Temperatur des äußeren Regelkreises" UBYTE OneToOne 1 100 0.00 255.0 FORMAT "%5.1" ECU_ADDRESS 0x8FEBDF /end MEASUREMENT
/begin MEASUREMENT Fid_EMCCD_ShutOff_mp "" UBYTE OneToOne 1 100 0.00 255.0 FORMAT "%5.1" ECU_ADDRESS 0x8FEBE0 /end MEASUREMENT
/begin MEASUREMENT Fid_EngCTSCD_mp "Messpunkt fuer Funktions Identifier Fid_EngCTSCD" UBYTE OneToOne 1 100 0.00 255.0 FORMAT "%5.1" ECU_ADDRESS 0x8FEBE1 /end MEASUREMENT
/begin MEASUREMENT Fid_EngMCaSBackUp_mp "Verriegelung des Betriebs nur mit Nockenwellensignal bei einem Nockenwellensignalfehler" UBYTE OneToOne 1 100 0.00 255.0 FORMAT "%5.1" ECU_ADDRESS 0x8FEBE2 /end MEASUREMENT
/begin MEASUREMENT Fid_EngMCrSBackUp_mp "sobald der Komponententreiber CrSCD einen Fehler meldet wird über diese Fid in den BackUp mode gewechselt" UBYTE OneToOne 1 100 0.00 255.0 FORMAT "%5.1" ECU_ADDRESS 0x8FEBE3 /end MEASUREMENT
/begin MEASUREMENT Fid_EngMTEng_mp "Fid for EngM_EngMntCtl subsystem" UBYTE OneToOne 1 100 0.00 255.0 FORMAT "%5.1" ECU_ADDRESS 0x8FEBE4 /end MEASUREMENT
/begin MEASUREMENT Fid_EngMTrqFrcPDiff_mp "Messpunkt für Function Identifier" UBYTE OneToOne 1 100 0.00 255.0 FORMAT "%5.1" ECU_ADDRESS 0x8FEBE5 /end MEASUREMENT
/begin MEASUREMENT Fid_EngMVVeh_mp "Fid for EngM_EngMntCtl subsystem" UBYTE OneToOne 1 100 0.00 255.0 FORMAT "%5.1" ECU_ADDRESS 0x8FEBE6 /end MEASUREMENT
/begin MEASUREMENT Fid_EngM_ChkStrtSpd_mp "Messpunkt fuer Funktions Identifier Fid_EngM_ChkStrtSpd" UBYTE OneToOne 1 100 0.00 255.0 FORMAT "%5.1" ECU_ADDRESS 0x8FEBE7 /end MEASUREMENT
/begin MEASUREMENT Fid_EngPrt_nLimErr_mp "Messpunkt für Funktions Identifier bei zusätzlicher Drezahlbegrenzung im Systemfehlerfall" UBYTE OneToOne 1 100 0.00 255.0 FORMAT "%5.1" ECU_ADDRESS 0x8FEBE8 /end MEASUREMENT
/begin MEASUREMENT Fid_ETClbCorActv_mp "Messpunkt fuer Funktions Identifier Fid_ETClbCorActv" UBYTE OneToOne 1 100 0.00 255.0 FORMAT "%5.1" ECU_ADDRESS 0x8FEBE9 /end MEASUREMENT
/begin MEASUREMENT Fid_FanCtl_mp "Messpunkt fuer Funktions Identifier Fid_FanCtl" UBYTE OneToOne 1 100 0.00 255.0 FORMAT "%5.1" ECU_ADDRESS 0x8FEBEA /end MEASUREMENT
/begin MEASUREMENT Fid_FanGbxOil_mp "fault identifier for Gear box oil temperature" UBYTE OneToOne 1 100 0.00 255.0 FORMAT "%5.1" ECU_ADDRESS 0x8FEBEB /end MEASUREMENT
/begin MEASUREMENT Fid_FBCMonI_mp "Messpunkt fuer Funktions Identifier Fid_FBCMonI" UBYTE OneToOne 1 100 0.00 255.0 FORMAT "%5.1" ECU_ADDRESS 0x8FEBEC /end MEASUREMENT
/begin MEASUREMENT Fid_FBC_mp "Messpunkt für Funktions-Identifier Fid_FBC_mp" UBYTE OneToOne 1 100 0.00 255.0 FORMAT "%5.1" ECU_ADDRESS 0x8FEBED /end MEASUREMENT
/begin MEASUREMENT Fid_FlMngFullLdRglOff_mp "Messpunkt fuer Funktions Identifier Fid_FlMngFullLdRglOff" UBYTE OneToOne 1 100 0.00 255.0 FORMAT "%5.1" ECU_ADDRESS 0x8FEBEE /end MEASUREMENT
/begin MEASUREMENT Fid_FlMngSmkDefect_mp "Messpunkt fuer Funktions Identifier Fid_FlMngSmkDefect" UBYTE OneToOne 1 100 0.00 255.0 FORMAT "%5.1" ECU_ADDRESS 0x8FEBEF /end MEASUREMENT
/begin MEASUREMENT Fid_FlSysCTSSens_mp "Fid zur Deaktivierung der Verwendung der Wassertemperatur als Kraftstoffsystemtemperatur" UBYTE OneToOne 1 100 0.00 255.0 FORMAT "%5.1" ECU_ADDRESS 0x8FEBF0 /end MEASUREMENT
/begin MEASUREMENT Fid_FlSysDens_mp "Verriegelung der Sensorerfassung für die Kraftstofftemperatur" UBYTE OneToOne 1 100 0.00 255.0 FORMAT "%5.1" ECU_ADDRESS 0x8FEBF1 /end MEASUREMENT
/begin MEASUREMENT Fid_FlSysFTSSens_mp "Fid zur Deaktivierung der Verwendung der Kraftstofftemperatur als Kraftstoffsystemtemperatur" UBYTE OneToOne 1 100 0.00 255.0 FORMAT "%5.1" ECU_ADDRESS 0x8FEBF2 /end MEASUREMENT
/begin MEASUREMENT Fid_FMASwtOff1_mp "Meßpunkt für FMA-Abschaltung bei leichten Systemfehlern (Abschaltmöglichkeit 1)" UBYTE OneToOne 1 100 0.00 255.0 FORMAT "%5.1" ECU_ADDRESS 0x8FEBF3 /end MEASUREMENT
/begin MEASUREMENT Fid_FMASwtOff3_mp "Meßpunkt für FMA-Abschaltung bei schweren Systemfehlern (Abschaltmöglichkeit 3)" UBYTE OneToOne 1 100 0.00 255.0 FORMAT "%5.1" ECU_ADDRESS 0x8FEBF4 /end MEASUREMENT
/begin MEASUREMENT Fid_FMTC_AirCorr_mp "Veriegelung der Eta-Korrektur für Luftmasse pro Zylinder" UBYTE OneToOne 1 100 0.00 255.0 FORMAT "%5.1" ECU_ADDRESS 0x8FEBF5 /end MEASUREMENT
/begin MEASUREMENT Fid_FMTC_SOECorr_mp "Veriegelung der Eta-Korrektur für den Spritzbeginn" UBYTE OneToOne 1 100 0.00 255.0 FORMAT "%5.1" ECU_ADDRESS 0x8FEBF6 /end MEASUREMENT
/begin MEASUREMENT Fid_FrmMngAddLevl_mp "Messpunkt fuer Funktions Identifier Fid_FrmMngAddLevl" UBYTE OneToOne 1 100 0.00 255.0 FORMAT "%5.1" ECU_ADDRESS 0x8FEBF7 /end MEASUREMENT
/begin MEASUREMENT Fid_FrmMngAPP_mp "Messpunkt fuer Funktions Identifier Fid_FrmMngAPP" UBYTE OneToOne 1 100 0.00 255.0 FORMAT "%5.1" ECU_ADDRESS 0x8FEBF8 /end MEASUREMENT
/begin MEASUREMENT Fid_FrmMngARS_mp "Messpunkt fuer Funktions Identifier Fid_FrmMngARS" UBYTE OneToOne 1 100 0.00 255.0 FORMAT "%5.1" ECU_ADDRESS 0x8FEBF9 /end MEASUREMENT
/begin MEASUREMENT Fid_FrmMngBrkDef_mp "Messpunkt fuer Funktions Identifier Fid_FrmMngBrkDef" UBYTE OneToOne 1 100 0.00 255.0 FORMAT "%5.1" ECU_ADDRESS 0x8FEBFA /end MEASUREMENT
/begin MEASUREMENT Fid_FrmMngBrk_mp "Messpunkt fuer Funktions Identifier Fid_FrmMngBrk" UBYTE OneToOne 1 100 0.00 255.0 FORMAT "%5.1" ECU_ADDRESS 0x8FEBFB /end MEASUREMENT
/begin MEASUREMENT Fid_FrmMngCoEng_mp "Messpunkt fuer Funktions Identifier Fid_FrmMngCoEng" UBYTE OneToOne 1 100 0.00 255.0 FORMAT "%5.1" ECU_ADDRESS 0x8FEBFC /end MEASUREMENT
/begin MEASUREMENT Fid_FrmMngCoEng_St2_mp "Messpunkt fuer Funktions Identifier Fid_FrmMngCoEng_St2" UBYTE OneToOne 1 100 0.00 255.0 FORMAT "%5.1" ECU_ADDRESS 0x8FEBFD /end MEASUREMENT
/begin MEASUREMENT Fid_FrmMngConvDef_mp "Messpunkt fuer Funktions Identifier Fid_FrmMngConvDef" UBYTE OneToOne 1 100 0.00 255.0 FORMAT "%5.1" ECU_ADDRESS 0x8FEBFE /end MEASUREMENT
/begin MEASUREMENT Fid_FrmMngEngOvrSpd_mp "Messpunkt fuer Funktions Identifier Fid_FrmMngEngOvrSpd" UBYTE OneToOne 1 100 0.00 255.0 FORMAT "%5.1" ECU_ADDRESS 0x8FEBFF /end MEASUREMENT
/begin MEASUREMENT Fid_FrmMngEngRpmTemp_mp "Messpunkt für Funktions Identifier Fid_FrmMngEngRpmTemp" UBYTE OneToOne 1 100 0.00 255.0 FORMAT "%5.1" ECU_ADDRESS 0x8FEC00 /end MEASUREMENT
/begin MEASUREMENT Fid_FrmMngEngSpd_mp "Messpunkt fuer Funktions Identifier Fid_FrmMngEngSpd" UBYTE OneToOne 1 100 0.00 255.0 FORMAT "%5.1" ECU_ADDRESS 0x8FEC01 /end MEASUREMENT
/begin MEASUREMENT Fid_FrmMngInjDU1_mp "Messpunkt fuer Funktions Identifier Fid_FrmMngInjDU1" UBYTE OneToOne 1 100 0.00 255.0 FORMAT "%5.1" ECU_ADDRESS 0x8FEC02 /end MEASUREMENT
/begin MEASUREMENT Fid_FrmMngInjDU2_mp "Messpunkt fuer Funktions Identifier Fid_FrmMngInjDU2" UBYTE OneToOne 1 100 0.00 255.0 FORMAT "%5.1" ECU_ADDRESS 0x8FEC03 /end MEASUREMENT
/begin MEASUREMENT Fid_FrmMngInjVlv_mp "Messpunkt fuer Funktions Identifier Fid_FrmMngInjVlv" UBYTE OneToOne 1 100 0.00 255.0 FORMAT "%5.1" ECU_ADDRESS 0x8FEC04 /end MEASUREMENT
/begin MEASUREMENT Fid_FrmMngnSetpoint_mp "Messpunkt fuer Funktions Identifier Fid_FrmMngnSetpoint" UBYTE OneToOne 1 100 0.00 255.0 FORMAT "%5.1" ECU_ADDRESS 0x8FEC05 /end MEASUREMENT
/begin MEASUREMENT Fid_FrmMngOBDCtl_mp "Messpunkt fuer Funktions Identifier Fid_FrmMngOBDCtl" UBYTE OneToOne 1 100 0.00 255.0 FORMAT "%5.1" ECU_ADDRESS 0x8FEC06 /end MEASUREMENT
/begin MEASUREMENT Fid_FrmMngParkConsumer_mp "Messpunkt fuer Funktions Identifier Fid_FrmMngParkConsumer" UBYTE OneToOne 1 100 0.00 255.0 FORMAT "%5.1" ECU_ADDRESS 0x8FEC07 /end MEASUREMENT
/begin MEASUREMENT Fid_FrmMngPFltDef_mp "Messpunkt fuer Funktions Identifier Fid_FrmMngPFltDef" UBYTE OneToOne 1 100 0.00 255.0 FORMAT "%5.1" ECU_ADDRESS 0x8FEC08 /end MEASUREMENT
/begin MEASUREMENT Fid_FrmMngPla_DSC_mp "Fid für FrmMng-Plaus DSC" UBYTE OneToOne 1 100 0.00 255.0 FORMAT "%5.1" ECU_ADDRESS 0x8FEC09 /end MEASUREMENT
/begin MEASUREMENT Fid_FrmMngPla_EGS_mp "Fid für FrmMng-Plaus EGS" UBYTE OneToOne 1 100 0.00 255.0 FORMAT "%5.1" ECU_ADDRESS 0x8FEC0A /end MEASUREMENT
/begin MEASUREMENT Fid_FrmMngPowerTrainCAN_mp "" UBYTE OneToOne 1 100 0.00 255.0 FORMAT "%5.1" ECU_ADDRESS 0x8FEC0B /end MEASUREMENT
/begin MEASUREMENT Fid_FrmMngpVal_mp "Messpunkt fuer Funktions Identifier Fid_FrmMngpVal" UBYTE OneToOne 1 100 0.00 255.0 FORMAT "%5.1" ECU_ADDRESS 0x8FEC0C /end MEASUREMENT
/begin MEASUREMENT Fid_FrmMngPwrMngLIGovSt_mp "Messpunkt fuer Funktions Identifier Fid_FrmMngPwrMngLIGovSt" UBYTE OneToOne 1 100 0.00 255.0 FORMAT "%5.1" ECU_ADDRESS 0x8FEC0D /end MEASUREMENT
/begin MEASUREMENT Fid_FrmMngSIG_ARS_mp "Messpunkt fuer Funktions Identifier Fid_FrmMngSIG_ARS" UBYTE OneToOne 1 100 0.00 255.0 FORMAT "%5.1" ECU_ADDRESS 0x8FEC0E /end MEASUREMENT
/begin MEASUREMENT Fid_FrmMngSIG_DSC_mp "Messpunkt fuer Funktions Identifier Fid_FrmMngSIG_DSC" UBYTE OneToOne 1 100 0.00 255.0 FORMAT "%5.1" ECU_ADDRESS 0x8FEC0F /end MEASUREMENT
/begin MEASUREMENT Fid_FrmMngSig_EGS_mp "Messpunkt fuer Funktions Identifier Fid_FrmMngSIG_EGS" UBYTE OneToOne 1 100 0.00 255.0 FORMAT "%5.1" ECU_ADDRESS 0x8FEC10 /end MEASUREMENT
/begin MEASUREMENT Fid_FrmMngtEng_mp "Messpunkt fuer Funktions Identifier Fid_FrmMngtEng" UBYTE OneToOne 1 100 0.00 255.0 FORMAT "%5.1" ECU_ADDRESS 0x8FEC11 /end MEASUREMENT
/begin MEASUREMENT Fid_FrmMngTO_ARS_mp "Messpunkt fuer Funktions Identifier Fid_FrmMngTO_ARS" UBYTE OneToOne 1 100 0.00 255.0 FORMAT "%5.1" ECU_ADDRESS 0x8FEC12 /end MEASUREMENT
/begin MEASUREMENT Fid_FrmMngTO_DSC_mp "Messpunkt fuer Funktions Identifier Fid_FrmMngTO_DSC" UBYTE OneToOne 1 100 0.00 255.0 FORMAT "%5.1" ECU_ADDRESS 0x8FEC13 /end MEASUREMENT
/begin MEASUREMENT Fid_FrmMngTo_EGS_mp "Messpunkt fuer Funktions Identifier Fid_FrmMngTO_EGS" UBYTE OneToOne 1 100 0.00 255.0 FORMAT "%5.1" ECU_ADDRESS 0x8FEC14 /end MEASUREMENT
/begin MEASUREMENT Fid_FrmMngTrqGearbx_mp "Messpunkt fuer Funktions Identifier Fid_FrmMngTrqGearbx" UBYTE OneToOne 1 100 0.00 255.0 FORMAT "%5.1" ECU_ADDRESS 0x8FEC15 /end MEASUREMENT
/begin MEASUREMENT Fid_FrmMngWaterVlv_mp "Fid for heating current defect" UBYTE OneToOne 1 100 0.00 255.0 FORMAT "%5.1" ECU_ADDRESS 0x8FEC16 /end MEASUREMENT
/begin MEASUREMENT Fid_FrmMng_stTrq_mp "Messpunkt fuer Funktions Identifier Fid_FrmMng_stTrq_mp" UBYTE OneToOne 1 100 0.00 255.0 FORMAT "%5.1" ECU_ADDRESS 0x8FEC17 /end MEASUREMENT
/begin MEASUREMENT Fid_FrmMng_ST_TORQ_mp "Messpunkt fuer Funktions Identifier Fid_FrmMng_ST_TORQ" UBYTE OneToOne 1 100 0.00 255.0 FORMAT "%5.1" ECU_ADDRESS 0x8FEC18 /end MEASUREMENT
/begin MEASUREMENT Fid_FTSCDErr_mp "Messpunkt fuer Funktions Identifier Fid_FTSCDErr" UBYTE OneToOne 1 100 0.00 255.0 FORMAT "%5.1" ECU_ADDRESS 0x8FEC19 /end MEASUREMENT
/begin MEASUREMENT Fid_FWOscDet_mp "Fid for Fly Wheel Oscillation detection" UBYTE OneToOne 1 100 0.00 255.0 FORMAT "%5.1" ECU_ADDRESS 0x8FEC1A /end MEASUREMENT
/begin MEASUREMENT Fid_GearbxDrvAwayInactiv_mp "Fid zur Deaktivierung der Anfahrmomentbegrenzung" UBYTE OneToOne 1 100 0.00 255.0 FORMAT "%5.1" ECU_ADDRESS 0x8FEC1B /end MEASUREMENT
/begin MEASUREMENT Fid_GearbxDrvAway_mp "Fid zur Aktivierung der Anfahrmomentbegrenzung" UBYTE OneToOne 1 100 0.00 255.0 FORMAT "%5.1" ECU_ADDRESS 0x8FEC1C /end MEASUREMENT
/begin MEASUREMENT Fid_GearbxPtCANErr_mp "Messpunkt fuer Funktions Identifier Fid_GearbxPtCANErr" UBYTE OneToOne 1 100 0.00 255.0 FORMAT "%5.1" ECU_ADDRESS 0x8FEC1D /end MEASUREMENT
/begin MEASUREMENT Fid_GearbxTrqLimErr_mp "Messpunkt fuer Funktions Identifier Fid_GearbxTrqLimErr" UBYTE OneToOne 1 100 0.00 255.0 FORMAT "%5.1" ECU_ADDRESS 0x8FEC1E /end MEASUREMENT
/begin MEASUREMENT Fid_Gearbx_GearDet_mp "Messpunkt fuer Funktions Identifier Fid_Gearbx_GearDet" UBYTE OneToOne 1 100 0.00 255.0 FORMAT "%5.1" ECU_ADDRESS 0x8FEC1F /end MEASUREMENT
/begin MEASUREMENT Fid_Gearbx_TrqIntv_Err_mp "Messpunkt fuer Funktions Identifier Fid_Gearbx_TrqIntv_Err" UBYTE OneToOne 1 100 0.00 255.0 FORMAT "%5.1" ECU_ADDRESS 0x8FEC20 /end MEASUREMENT
/begin MEASUREMENT Fid_GlwCtl1_mp "Freigabe der Berechnung der Nachglühzeit aus einem Kennfeld; keine Freigabe bei defektem Kühlmittel-Temperatur-Sensor" UBYTE OneToOne 1 100 0.00 255.0 FORMAT "%5.1" ECU_ADDRESS 0x8FEC21 /end MEASUREMENT
/begin MEASUREMENT Fid_HDC_mp "Messpunkt fuer Funktions Identifier Fid_HDC" UBYTE OneToOne 1 100 0.00 255.0 FORMAT "%5.1" ECU_ADDRESS 0x8FEC22 /end MEASUREMENT
/begin MEASUREMENT Fid_IndSys1_mp "Messpunkt fuer Funktions Identifier Fid_IndSys1" UBYTE OneToOne 1 100 0.00 255.0 FORMAT "%5.1" ECU_ADDRESS 0x8FEC23 /end MEASUREMENT
/begin MEASUREMENT Fid_IndSys2_mp "Messpunkt fuer Funktions Identifier Fid_IndSys2" UBYTE OneToOne 1 100 0.00 255.0 FORMAT "%5.1" ECU_ADDRESS 0x8FEC24 /end MEASUREMENT
/begin MEASUREMENT Fid_InjCrvCoErr_mp "Messpunkt fuer Funktions Identifier Fid_InjCtl_qLimErr" UBYTE OneToOne 1 100 0.00 255.0 FORMAT "%5.1" ECU_ADDRESS 0x8FEC25 /end MEASUREMENT
/begin MEASUREMENT Fid_InjCtl_qLimErr_mp "Messpunkt fuer Funktions Identifier Fid_InjCtl_qLimErr" UBYTE OneToOne 1 100 0.00 255.0 FORMAT "%5.1" ECU_ADDRESS 0x8FEC26 /end MEASUREMENT
/begin MEASUREMENT Fid_InjVCDCls_mp "Messpunkt für Funktionsidentifier Fid_InjVCDCls" UBYTE OneToOne 1 100 0.00 255.0 FORMAT "%5.1" ECU_ADDRESS 0x8FEC27 /end MEASUREMENT
/begin MEASUREMENT Fid_InjVlvActrTemp_mp "Messpunkt für Funktionsidentifier Fid_InjVlvActrTemp" UBYTE OneToOne 1 100 0.00 255.0 FORMAT "%5.1" ECU_ADDRESS 0x8FEC28 /end MEASUREMENT
/begin MEASUREMENT Fid_InjVlvInjLim_mp "Messpunkt für Funktionsidentifier Fid_InjVlvInjLim" UBYTE OneToOne 1 100 0.00 255.0 FORMAT "%5.1" ECU_ADDRESS 0x8FEC29 /end MEASUREMENT
/begin MEASUREMENT Fid_InjVlvMon_mp "Messpunkt fuer Funktions Identifier Fid_InjVlvMon" UBYTE OneToOne 1 100 0.00 255.0 FORMAT "%5.1" ECU_ADDRESS 0x8FEC2A /end MEASUREMENT
/begin MEASUREMENT Fid_InjVlvNVC_mp "Messpunkt fuer Funktions Identifier Fid_InjVlvNVC" UBYTE OneToOne 1 100 0.00 255.0 FORMAT "%5.1" ECU_ADDRESS 0x8FEC2B /end MEASUREMENT
/begin MEASUREMENT Fid_InjVlvSetUpVolt_mp "Meßpunkt für Funktionsidentifier Fid_InjVlvSetUpVolt" UBYTE OneToOne 1 100 0.00 255.0 FORMAT "%5.1" ECU_ADDRESS 0x8FEC2C /end MEASUREMENT
/begin MEASUREMENT Fid_InjVlvWvCorOff_mp "Fid der Druckwellenkorrektur" UBYTE OneToOne 1 100 0.00 255.0 FORMAT "%5.1" ECU_ADDRESS 0x8FEC2D /end MEASUREMENT
/begin MEASUREMENT Fid_Layer_FI_TANS_mp "Messpunkt fuer Funktions Identifier Fid_Layer_FI_TANS" UBYTE OneToOne 1 100 0.00 255.0 FORMAT "%5.1" ECU_ADDRESS 0x8FEC2E /end MEASUREMENT
/begin MEASUREMENT Fid_Layer_FI_TUMG_mp "Messpunkt fuer Funktions Identifier Fid_Layer_FI_TUMG" UBYTE OneToOne 1 100 0.00 255.0 FORMAT "%5.1" ECU_ADDRESS 0x8FEC2F /end MEASUREMENT
/begin MEASUREMENT Fid_Layer_MANHYDR_mp "" UBYTE OneToOne 1 100 0.00 255.0 FORMAT "%5.1" ECU_ADDRESS 0x8FEC30 /end MEASUREMENT
/begin MEASUREMENT Fid_Layer_MANLUFT_mp "" UBYTE OneToOne 1 100 0.00 255.0 FORMAT "%5.1" ECU_ADDRESS 0x8FEC31 /end MEASUREMENT
/begin MEASUREMENT Fid_LIGovSetpDrvAway_mp "Messpunkt fuer Funktions Identifier Fid_LIGovSetpDrvAway" UBYTE OneToOne 1 100 0.00 255.0 FORMAT "%5.1" ECU_ADDRESS 0x8FEC32 /end MEASUREMENT
/begin MEASUREMENT Fid_LIGovSetpointDrvAwy_mp "Messpunkt fuer Funktions Identifier Fid_LIGovSetpointDrvAwy" UBYTE OneToOne 1 100 0.00 255.0 FORMAT "%5.1" ECU_ADDRESS 0x8FEC33 /end MEASUREMENT
/begin MEASUREMENT Fid_LIGovUbr_mp "Messpunkt fuer Funktions Identifier Fid_LIGovUbr" UBYTE OneToOne 1 100 0.00 255.0 FORMAT "%5.1" ECU_ADDRESS 0x8FEC34 /end MEASUREMENT
/begin MEASUREMENT Fid_LSUCDactiv0_mp "Messpunkt fuer Funktions Identifier Fid_LSUCDactiv0" UBYTE OneToOne 1 100 0.00 255.0 FORMAT "%5.1" ECU_ADDRESS 0x8FEC35 /end MEASUREMENT
/begin MEASUREMENT Fid_LSUCDlsu0_mp "Messpunkt fuer Funktions Identifier Fid_LSUCDlsu0" UBYTE OneToOne 1 100 0.00 255.0 FORMAT "%5.1" ECU_ADDRESS 0x8FEC36 /end MEASUREMENT
/begin MEASUREMENT Fid_LSUCDMon0_mp "Messpunkt fuer Funktions Identifier Fid_LSUCDMon0" UBYTE OneToOne 1 100 0.00 255.0 FORMAT "%5.1" ECU_ADDRESS 0x8FEC37 /end MEASUREMENT
/begin MEASUREMENT Fid_LSUCDO20_mp "Messpunkt fuer Funktions Identifier Fid_LSUCDO20" UBYTE OneToOne 1 100 0.00 255.0 FORMAT "%5.1" ECU_ADDRESS 0x8FEC38 /end MEASUREMENT
/begin MEASUREMENT Fid_LSUCDRi0_mp "Messpunkt fuer Funktions Identifier Fid_LSUCDRi0" UBYTE OneToOne 1 100 0.00 255.0 FORMAT "%5.1" ECU_ADDRESS 0x8FEC39 /end MEASUREMENT
/begin MEASUREMENT Fid_LSUClbSched_mp "Fid zur Unterdrückung der CJ125-Kalibrierung im Falle einer defekten Batterie" UBYTE OneToOne 1 100 0.00 255.0 FORMAT "%5.1" ECU_ADDRESS 0x8FEC3A /end MEASUREMENT
/begin MEASUREMENT Fid_LSUCtl0_mp "Messpunkt fuer Funktions Identifier Fid_LSUCtl0" UBYTE OneToOne 1 100 0.00 255.0 FORMAT "%5.1" ECU_ADDRESS 0x8FEC3B /end MEASUREMENT
/begin MEASUREMENT Fid_LSUMonAllChecks_mp "Messpunkt fuer Funktions Identifier Fid_LSUMonAllChecks" UBYTE OneToOne 1 100 0.00 255.0 FORMAT "%5.1" ECU_ADDRESS 0x8FEC3C /end MEASUREMENT
/begin MEASUREMENT Fid_LSUMonPlausChk_mp "Messpunkt fuer Funktions Identifier Fid_LSUMonPlausChk" UBYTE OneToOne 1 100 0.00 255.0 FORMAT "%5.1" ECU_ADDRESS 0x8FEC3D /end MEASUREMENT
/begin MEASUREMENT Fid_MeUnCDCalcI_mp "Fehleridentifier um den I-Anteil des Stromreglers für die Zumesseinheit einzufrieren" UBYTE OneToOne 1 100 0.00 255.0 FORMAT "%5.1" ECU_ADDRESS 0x8FEC3E /end MEASUREMENT
/begin MEASUREMENT Fid_MSidCD_ECU_mp "Messpunkt fuer Funktions Identifier Fid_MSidCD_ECU" UBYTE OneToOne 1 100 0.00 255.0 FORMAT "%5.1" ECU_ADDRESS 0x8FEC3F /end MEASUREMENT
/begin MEASUREMENT Fid_MSidCD_Pin_mp "Messpunkt fuer Funktions Identifier Fid_MSidCD_Pin" UBYTE OneToOne 1 100 0.00 255.0 FORMAT "%5.1" ECU_ADDRESS 0x8FEC40 /end MEASUREMENT
/begin MEASUREMENT Fid_OTSCD_mp "Messpunkt fuer Funktions Identifier Fid_OTSCD" UBYTE OneToOne 1 100 0.00 255.0 FORMAT "%5.1" ECU_ADDRESS 0x8FEC41 /end MEASUREMENT
/begin MEASUREMENT Fid_PCRBalGvnr_mp "Messpunkt fuer Funktions Identifier Fid_PCRBalGvnr" UBYTE OneToOne 1 100 0.00 255.0 FORMAT "%5.1" ECU_ADDRESS 0x8FEC42 /end MEASUREMENT
/begin MEASUREMENT Fid_PCRExtnLimActr_mp "Function identifier shut-off correction of the actuator limitation because of increasing backpressure upstream from  part. filte" UBYTE OneToOne 1 100 0.00 255.0 FORMAT "%5.1" ECU_ADDRESS 0x8FEC43 /end MEASUREMENT
/begin MEASUREMENT Fid_PCRGvnrDvtNeg_mp "Messpunkt fuer Funktions Identifier Fid_PCRGvnrDvtNeg" UBYTE OneToOne 1 100 0.00 255.0 FORMAT "%5.1" ECU_ADDRESS 0x8FEC44 /end MEASUREMENT
/begin MEASUREMENT Fid_PCRGvnrDvtPos_mp "Messpunkt fuer Funktions Identifier Fid_PCRGvnrDvtPos" UBYTE OneToOne 1 100 0.00 255.0 FORMAT "%5.1" ECU_ADDRESS 0x8FEC45 /end MEASUREMENT
/begin MEASUREMENT Fid_PCRLPGvnrDvtNeg_mp "Fid fuer neg. Regelabweichung PCR-LP" UBYTE OneToOne 1 100 0.00 255.0 FORMAT "%5.1" ECU_ADDRESS 0x8FEC46 /end MEASUREMENT
/begin MEASUREMENT Fid_PCRLPGvnrDvtPos_mp "FID fürpos. Regelabweichung PCR-LP" UBYTE OneToOne 1 100 0.00 255.0 FORMAT "%5.1" ECU_ADDRESS 0x8FEC47 /end MEASUREMENT
/begin MEASUREMENT Fid_PCRSurgeLIGov_mp "Fault path identifier for Anti-Surge LIGov" UBYTE OneToOne 1 100 0.00 255.0 FORMAT "%5.1" ECU_ADDRESS 0x8FEC48 /end MEASUREMENT
/begin MEASUREMENT Fid_PCR_LPMS_mp "FID für Ladedruckregelung-Niederdruckstufe LP 8 Zyl." UBYTE OneToOne 1 100 0.00 255.0 FORMAT "%5.1" ECU_ADDRESS 0x8FEC49 /end MEASUREMENT
/begin MEASUREMENT Fid_PCR_LP_mp "FID für Ladedruckregelung-Niederdruckstufe (LP)" UBYTE OneToOne 1 100 0.00 255.0 FORMAT "%5.1" ECU_ADDRESS 0x8FEC4A /end MEASUREMENT
/begin MEASUREMENT Fid_PCR_mp "Messpunkt fuer Funktions Identifier Fid_PCR" UBYTE OneToOne 1 100 0.00 255.0 FORMAT "%5.1" ECU_ADDRESS 0x8FEC4B /end MEASUREMENT
/begin MEASUREMENT Fid_PCR_MS_mp "Messpunkt fuer Funktions Identifier Fid_PCR_MS" UBYTE OneToOne 1 100 0.00 255.0 FORMAT "%5.1" ECU_ADDRESS 0x8FEC4C /end MEASUREMENT
/begin MEASUREMENT Fid_PCR_SurgeDet_mp "Meßpunkt für Fid" UBYTE OneToOne 1 100 0.00 255.0 FORMAT "%5.1" ECU_ADDRESS 0x8FEC4D /end MEASUREMENT
/begin MEASUREMENT Fid_PCVCDCalcI_mp "Fehleridentifier um den I-Anteil des Stromreglers für das Druckregelventil einzufrieren" UBYTE OneToOne 1 100 0.00 255.0 FORMAT "%5.1" ECU_ADDRESS 0x8FEC4E /end MEASUREMENT
/begin MEASUREMENT Fid_PFltAshCorRgn_mp "function identifier zur Freigabe der Regenerationsanforderung" UBYTE OneToOne 1 100 0.00 255.0 FORMAT "%5.1" ECU_ADDRESS 0x8FEC4F /end MEASUREMENT
/begin MEASUREMENT Fid_PFltAshCor_mp "Messpunkt fuer Funktions Identifier Fid_PFltAshCor" UBYTE OneToOne 1 100 0.00 255.0 FORMAT "%5.1" ECU_ADDRESS 0x8FEC50 /end MEASUREMENT
/begin MEASUREMENT Fid_PFltBrk_mp "Function Identifier für Bremssignal" UBYTE OneToOne 1 100 0.00 255.0 FORMAT "%5.1" ECU_ADDRESS 0x8FEC51 /end MEASUREMENT
/begin MEASUREMENT Fid_PFltChar_mp "Fid für Verhinderung Resflow-SRC" UBYTE OneToOne 1 100 0.00 255.0 FORMAT "%5.1" ECU_ADDRESS 0x8FEC52 /end MEASUREMENT
/begin MEASUREMENT Fid_PFltChngPar_mp "Messpunkt fuer Funktions Identifier Fid_PFltChngPar" UBYTE OneToOne 1 100 0.00 255.0 FORMAT "%5.1" ECU_ADDRESS 0x8FEC53 /end MEASUREMENT
/begin MEASUREMENT Fid_PFltClth_mp "Function Identifier für Kupplungssignal" UBYTE OneToOne 1 100 0.00 255.0 FORMAT "%5.1" ECU_ADDRESS 0x8FEC54 /end MEASUREMENT
/begin MEASUREMENT Fid_PFltDiagRls1_mp "Messpunkt fuer Funktions Identifier Fid_PFltDiagRls" UBYTE OneToOne 1 100 0.00 255.0 FORMAT "%5.1" ECU_ADDRESS 0x8FEC55 /end MEASUREMENT
/begin MEASUREMENT Fid_PFltDiagRls2_mp "Messpunkt fuer Funktions Identifier Fid_PFltDiagRls" UBYTE OneToOne 1 100 0.00 255.0 FORMAT "%5.1" ECU_ADDRESS 0x8FEC56 /end MEASUREMENT
/begin MEASUREMENT Fid_PFltDynChk_mp "Messpunkt fuer Funktions Identifier Fid_PFltDynChk" UBYTE OneToOne 1 100 0.00 255.0 FORMAT "%5.1" ECU_ADDRESS 0x8FEC57 /end MEASUREMENT
/begin MEASUREMENT Fid_PFltEngPrtRgnMon_mp "" UBYTE OneToOne 1 100 0.00 255.0 FORMAT "%5.1" ECU_ADDRESS 0x8FEC58 /end MEASUREMENT
/begin MEASUREMENT Fid_PFltGearDet_mp "Function Identifier für Gangsignal" UBYTE OneToOne 1 100 0.00 255.0 FORMAT "%5.1" ECU_ADDRESS 0x8FEC59 /end MEASUREMENT
/begin MEASUREMENT Fid_PFltHsLnChk_mp "Messpunkt fuer Funktions Identifier Fid_PFltHsLnChk" UBYTE OneToOne 1 100 0.00 255.0 FORMAT "%5.1" ECU_ADDRESS 0x8FEC5A /end MEASUREMENT
/begin MEASUREMENT Fid_PFltLckRgnErr_mp "Messpunkt fuer Funktions Identifier Fid_PFltLckRgnErr" UBYTE OneToOne 1 100 0.00 255.0 FORMAT "%5.1" ECU_ADDRESS 0x8FEC5B /end MEASUREMENT
/begin MEASUREMENT Fid_PFltLckRgnFuel_mp "Fid für PFlt-Kraftstoff-Verriegelungsregeneration" UBYTE OneToOne 1 100 0.00 255.0 FORMAT "%5.1" ECU_ADDRESS 0x8FEC5C /end MEASUREMENT
/begin MEASUREMENT Fid_PFltNumPFltErrLck_mp "Messpunkt fuer Funktions Identifier Fid_PFltNumPFltErrLck" UBYTE OneToOne 1 100 0.00 255.0 FORMAT "%5.1" ECU_ADDRESS 0x8FEC5D /end MEASUREMENT
/begin MEASUREMENT Fid_PFltNumPFltErr_mp "Messpunkt fuer Funktions Identifier Fid_PFltNumPFltErr" UBYTE OneToOne 1 100 0.00 255.0 FORMAT "%5.1" ECU_ADDRESS 0x8FEC5E /end MEASUREMENT
/begin MEASUREMENT Fid_PFltPlausPres_mp "Messpunkt fuer Funktions Identifier Fid_PFltPlausPres" UBYTE OneToOne 1 100 0.00 255.0 FORMAT "%5.1" ECU_ADDRESS 0x8FEC5F /end MEASUREMENT
/begin MEASUREMENT Fid_PFltPlausTemp_mp "Messpunkt fuer Funktions Identifier Fid_PFltPlausTemp" UBYTE OneToOne 1 100 0.00 255.0 FORMAT "%5.1" ECU_ADDRESS 0x8FEC60 /end MEASUREMENT
/begin MEASUREMENT Fid_PFltPPreErr_mp "function identifier,Pressure sensor" UBYTE OneToOne 1 100 0.00 255.0 FORMAT "%5.1" ECU_ADDRESS 0x8FEC61 /end MEASUREMENT
/begin MEASUREMENT Fid_PFltPresPlausProj_mp "" UBYTE OneToOne 1 100 0.00 255.0 FORMAT "%5.1" ECU_ADDRESS 0x8FEC62 /end MEASUREMENT
/begin MEASUREMENT Fid_PFltPresSensFrz_mp "Messpunkt fuer Funktions Identifier Fid_PFltPresSensFrz" UBYTE OneToOne 1 100 0.00 255.0 FORMAT "%5.1" ECU_ADDRESS 0x8FEC63 /end MEASUREMENT
/begin MEASUREMENT Fid_PFltPresSensHsLn_mp "Fid für Verhinderung der Schlauchleitungsüberwachung der Drucksensoren" UBYTE OneToOne 1 100 0.00 255.0 FORMAT "%5.1" ECU_ADDRESS 0x8FEC64 /end MEASUREMENT
/begin MEASUREMENT Fid_PFltSimOn_mp "wenn aktiv wird von Beladungsmessung auf Simulation umgesch." UBYTE OneToOne 1 100 0.00 255.0 FORMAT "%5.1" ECU_ADDRESS 0x8FEC65 /end MEASUREMENT
/begin MEASUREMENT Fid_PFltSpdVeh_mp "Function Identifier für Fahrzeugsgeschwindigkeit" UBYTE OneToOne 1 100 0.00 255.0 FORMAT "%5.1" ECU_ADDRESS 0x8FEC66 /end MEASUREMENT
/begin MEASUREMENT Fid_PFltSRCPres_mp "Messpunkt fuer Funktions Identifier Fid_PFltSRCPres" UBYTE OneToOne 1 100 0.00 255.0 FORMAT "%5.1" ECU_ADDRESS 0x8FEC67 /end MEASUREMENT
/begin MEASUREMENT Fid_PFltSRCTemp_mp "Fid für Verhinderung Temperatursensor-SRC" UBYTE OneToOne 1 100 0.00 255.0 FORMAT "%5.1" ECU_ADDRESS 0x8FEC68 /end MEASUREMENT
/begin MEASUREMENT Fid_PFltSuc_mp "" UBYTE OneToOne 1 100 0.00 255.0 FORMAT "%5.1" ECU_ADDRESS 0x8FEC69 /end MEASUREMENT
/begin MEASUREMENT Fid_PFltTempAir_mp "Function Identifier für Ansaugsluft-temperatur" UBYTE OneToOne 1 100 0.00 255.0 FORMAT "%5.1" ECU_ADDRESS 0x8FEC6A /end MEASUREMENT
/begin MEASUREMENT Fid_PFltTempClnt_mp "Function identifier für Kühlflüssigkeitstemperatur" UBYTE OneToOne 1 100 0.00 255.0 FORMAT "%5.1" ECU_ADDRESS 0x8FEC6B /end MEASUREMENT
/begin MEASUREMENT Fid_PFltTempOxiPre_mp "Messpunkt fuer Funktions Identifier Fid_PFltTempOxiPre" UBYTE OneToOne 1 100 0.00 255.0 FORMAT "%5.1" ECU_ADDRESS 0x8FEC6C /end MEASUREMENT
/begin MEASUREMENT Fid_PFltTempPre_mp "Messpunkt fuer Funktions Identifier Fid_PFltTempPre" UBYTE OneToOne 1 100 0.00 255.0 FORMAT "%5.1" ECU_ADDRESS 0x8FEC6D /end MEASUREMENT
/begin MEASUREMENT Fid_PFltTempSensFrz_mp "Messpunkt fuer Funktions Identifier Fid_PFltTempSensFrz" UBYTE OneToOne 1 100 0.00 255.0 FORMAT "%5.1" ECU_ADDRESS 0x8FEC6E /end MEASUREMENT
/begin MEASUREMENT Fid_PFltVltgBatt_mp "Function Identifier für Akkumulatorspannung" UBYTE OneToOne 1 100 0.00 255.0 FORMAT "%5.1" ECU_ADDRESS 0x8FEC6F /end MEASUREMENT
/begin MEASUREMENT Fid_RailCDRPSErrChk_mp "Fid zur Reaktion auf Fehler des Kraftstoffdrucksensors: Dfp_RailCD_mp wird nicht weiter gestestet." UBYTE OneToOne 1 100 0.00 255.0 FORMAT "%5.1" ECU_ADDRESS 0x8FEC70 /end MEASUREMENT
/begin MEASUREMENT Fid_RailCDSubstVal_mp "Fid zur Reaktion auf Fehler des Kraftstoffdrucksensors" UBYTE OneToOne 1 100 0.00 255.0 FORMAT "%5.1" ECU_ADDRESS 0x8FEC71 /end MEASUREMENT
/begin MEASUREMENT Fid_RailCD_PMonStrt_mp "Messpunkt fuer Funktions Identifier Fid_RailCD_PMonStrt" UBYTE OneToOne 1 100 0.00 255.0 FORMAT "%5.1" ECU_ADDRESS 0x8FEC72 /end MEASUREMENT
/begin MEASUREMENT Fid_RailCtlMode_mp "Fehlerverriegelung allgemein für die Druckregelung" UBYTE OneToOne 1 100 0.00 255.0 FORMAT "%5.1" ECU_ADDRESS 0x8FEC73 /end MEASUREMENT
/begin MEASUREMENT Fid_RailMeUn0Blk_mp "Fehleridentifier zur Verriegelung der Überwachung auf positive Regelabweichung" UBYTE OneToOne 1 100 0.00 255.0 FORMAT "%5.1" ECU_ADDRESS 0x8FEC74 /end MEASUREMENT
/begin MEASUREMENT Fid_RailMeUn0Rls_mp "Fehleridentifier zur Freigabe der Überwachung auf positive Regelabweichung" UBYTE OneToOne 1 100 0.00 255.0 FORMAT "%5.1" ECU_ADDRESS 0x8FEC75 /end MEASUREMENT
/begin MEASUREMENT Fid_RailMeUn1Blk_mp "Fehleridentifier zur Verriegelung der Überwachung auf positive Regelabweichung und Sollwert des Volumenstroms d. Zumesseinheit" UBYTE OneToOne 1 100 0.00 255.0 FORMAT "%5.1" ECU_ADDRESS 0x8FEC76 /end MEASUREMENT
/begin MEASUREMENT Fid_RailMeUn1Rls_mp "Fehleridentifier zur Freigabe der Überwachung auf positive Regelabweichung und Sollwert des Volumenstroms d. Zumesseinheit" UBYTE OneToOne 1 100 0.00 255.0 FORMAT "%5.1" ECU_ADDRESS 0x8FEC77 /end MEASUREMENT
/begin MEASUREMENT Fid_RailMeUn2Blk_mp "Fehleridentifier zur Verriegelung der Überwachung auf negative Regelabweichung bei Nullförderung" UBYTE OneToOne 1 100 0.00 255.0 FORMAT "%5.1" ECU_ADDRESS 0x8FEC78 /end MEASUREMENT
/begin MEASUREMENT Fid_RailMeUn2Rls_mp "Fehleridentifier zur Freigabe der Überwachung auf negative Regelabweichung bei Nullförderung" UBYTE OneToOne 1 100 0.00 255.0 FORMAT "%5.1" ECU_ADDRESS 0x8FEC79 /end MEASUREMENT
/begin MEASUREMENT Fid_RailMeUn3Blk_mp "Fehleridentifier zur Verriegelung der Überwachung auf minimalen Raildruck" UBYTE OneToOne 1 100 0.00 255.0 FORMAT "%5.1" ECU_ADDRESS 0x8FEC7A /end MEASUREMENT
/begin MEASUREMENT Fid_RailMeUn3Rls_mp "Fehleridentifier zur Freigabe der Überwachung auf minimalen Raildruck" UBYTE OneToOne 1 100 0.00 255.0 FORMAT "%5.1" ECU_ADDRESS 0x8FEC7B /end MEASUREMENT
/begin MEASUREMENT Fid_RailMeUn4Blk_mp "Fehleridentifier zur Verriegelung der Überwachung auf maximalen Raildruck" UBYTE OneToOne 1 100 0.00 255.0 FORMAT "%5.1" ECU_ADDRESS 0x8FEC7C /end MEASUREMENT
/begin MEASUREMENT Fid_RailMeUn4Rls_mp "Fehleridentifier zur Freigabe der Überwachung auf maximalen Raildruck" UBYTE OneToOne 1 100 0.00 255.0 FORMAT "%5.1" ECU_ADDRESS 0x8FEC7D /end MEASUREMENT
/begin MEASUREMENT Fid_RailMeUnCtlMode_mp "Fehlerverriegelung für die Druckregelung über Zumesseinheit" UBYTE OneToOne 1 100 0.00 255.0 FORMAT "%5.1" ECU_ADDRESS 0x8FEC7E /end MEASUREMENT
/begin MEASUREMENT Fid_RailPCV0Blk_mp "Fehleridentifier zur Verriegelung der Überwachung auf positive Regelabweichung" UBYTE OneToOne 1 100 0.00 255.0 FORMAT "%5.1" ECU_ADDRESS 0x8FEC7F /end MEASUREMENT
/begin MEASUREMENT Fid_RailPCV0Rls_mp "Fehleridentifier zur Freigabe der Überwachung auf positive Regelabweichung" UBYTE OneToOne 1 100 0.00 255.0 FORMAT "%5.1" ECU_ADDRESS 0x8FEC80 /end MEASUREMENT
/begin MEASUREMENT Fid_RailPCV1Blk_mp "Fehleridentifier zur Verriegelung der Überwachung auf positive Regelabweichung kombiniert mit Stellgröße des Druckregelventils" UBYTE OneToOne 1 100 0.00 255.0 FORMAT "%5.1" ECU_ADDRESS 0x8FEC81 /end MEASUREMENT
/begin MEASUREMENT Fid_RailPCV1Rls_mp "Fehleridentifier zur Freigabe der Überwachung auf positive Regelabweichung kombiniert mit Stellgröße des Druckregelventils" UBYTE OneToOne 1 100 0.00 255.0 FORMAT "%5.1" ECU_ADDRESS 0x8FEC82 /end MEASUREMENT
/begin MEASUREMENT Fid_RailPCV2Blk_mp "Fehleridentifier zur Verriegelung der Überwachung auf negative Regelabweichung kombiniert mit Stellgröße des Druckregelventils" UBYTE OneToOne 1 100 0.00 255.0 FORMAT "%5.1" ECU_ADDRESS 0x8FEC83 /end MEASUREMENT
/begin MEASUREMENT Fid_RailPCV2Rls_mp "Fehleridentifier zur Freigabe der Überwachung auf negative Regelabweichung kombiniert mit Stellgröße des Druckregelventils" UBYTE OneToOne 1 100 0.00 255.0 FORMAT "%5.1" ECU_ADDRESS 0x8FEC84 /end MEASUREMENT
/begin MEASUREMENT Fid_RailPCV3Blk_mp "Fehleridentifier zur Verriegelung der Überwachung auf minimalen Raildruck" UBYTE OneToOne 1 100 0.00 255.0 FORMAT "%5.1" ECU_ADDRESS 0x8FEC85 /end MEASUREMENT
/begin MEASUREMENT Fid_RailPCV3Rls_mp "Fehleridentifier zur Freigabe der Überwachung auf minimalen Raildruck" UBYTE OneToOne 1 100 0.00 255.0 FORMAT "%5.1" ECU_ADDRESS 0x8FEC86 /end MEASUREMENT
/begin MEASUREMENT Fid_RailPCV4Blk_mp "Fehleridentifier zur Verriegelung der Überwachung auf maximalen Raildruck" UBYTE OneToOne 1 100 0.00 255.0 FORMAT "%5.1" ECU_ADDRESS 0x8FEC87 /end MEASUREMENT
/begin MEASUREMENT Fid_RailPCV4Rls_mp "Fehleridentifier zur Freigabe der Überwachung auf maximalen Raildruck" UBYTE OneToOne 1 100 0.00 255.0 FORMAT "%5.1" ECU_ADDRESS 0x8FEC88 /end MEASUREMENT
/begin MEASUREMENT Fid_RailPCV5Blk_mp "Fehleridentifier zur Verriegelung der Plausibilisierung des Raildruck mit dem Strom durch das Druckregelventil" UBYTE OneToOne 1 100 0.00 255.0 FORMAT "%5.1" ECU_ADDRESS 0x8FEC89 /end MEASUREMENT
/begin MEASUREMENT Fid_RailPCV5Rls_mp "Fehleridentifier zur Freigabe der Plausibilisierung des Raildruck mit dem Strom durch das Druckregelventil" UBYTE OneToOne 1 100 0.00 255.0 FORMAT "%5.1" ECU_ADDRESS 0x8FEC8A /end MEASUREMENT
/begin MEASUREMENT Fid_RailPCVCtlMode_mp "Fehlerverriegelung für die Druckregelung über Druckregelventil" UBYTE OneToOne 1 100 0.00 255.0 FORMAT "%5.1" ECU_ADDRESS 0x8FEC8B /end MEASUREMENT
/begin MEASUREMENT Fid_RailSetPointLim_mp "Fid zur Verriegelung der ""normalen"" Begrenzung des Raildruck-Sollwertes" UBYTE OneToOne 1 100 0.00 255.0 FORMAT "%5.1" ECU_ADDRESS 0x8FEC8C /end MEASUREMENT
/begin MEASUREMENT Fid_RailSetPointRed_mp "Fehlerverriegelung zur Freigabe der Solldruckabsenkung im Systemfehlerfall" UBYTE OneToOne 1 100 0.00 255.0 FORMAT "%5.1" ECU_ADDRESS 0x8FEC8D /end MEASUREMENT
/begin MEASUREMENT Fid_ShuttrCTS_mp "Messpunkt fuer Funktions Identifier Fid_ShuttrCTS" UBYTE OneToOne 1 100 0.00 255.0 FORMAT "%5.1" ECU_ADDRESS 0x8FEC8E /end MEASUREMENT
/begin MEASUREMENT Fid_ShuttrEGS_mp "Messpunkt fuer Funktions Identifier Fid_ShuttrEGS" UBYTE OneToOne 1 100 0.00 255.0 FORMAT "%5.1" ECU_ADDRESS 0x8FEC8F /end MEASUREMENT
/begin MEASUREMENT Fid_SignalsTstNLim_mp "Messpunkt fuer Funktions Identifier Fid_SignalsTstNLim" UBYTE OneToOne 1 100 0.00 255.0 FORMAT "%5.1" ECU_ADDRESS 0x8FEC90 /end MEASUREMENT
/begin MEASUREMENT Fid_StSysImmo_mp "FID WFS sperrt Starter" UBYTE OneToOne 1 100 0.00 255.0 FORMAT "%5.1" ECU_ADDRESS 0x8FEC91 /end MEASUREMENT
/begin MEASUREMENT Fid_StSysStrtTipGbxDat_mp "fid Getriebedaten für Automatik Start" UBYTE OneToOne 1 100 0.00 255.0 FORMAT "%5.1" ECU_ADDRESS 0x8FEC92 /end MEASUREMENT
/begin MEASUREMENT Fid_T15CDCanError_mp "Function Identifier für Ersatzwert bei CAN- Fehler" UBYTE OneToOne 1 100 0.00 255.0 FORMAT "%5.1" ECU_ADDRESS 0x8FEC93 /end MEASUREMENT
/begin MEASUREMENT Fid_T50CDSig_mp "Messpunkt fuer Funktions Identifier Fid_T50CDSig" UBYTE OneToOne 1 100 0.00 255.0 FORMAT "%5.1" ECU_ADDRESS 0x8FEC94 /end MEASUREMENT
/begin MEASUREMENT Fid_UsrDa_FDCOff_mp "Messpunkt fuer Funktions Identifier Fid_UsrDa_FDCOff" UBYTE OneToOne 1 100 0.00 255.0 FORMAT "%5.1" ECU_ADDRESS 0x8FEC95 /end MEASUREMENT
/begin MEASUREMENT Fid_VehDaDist_mp "Status Funktionsidentifier Fid_VehDaDist zur Verriegelung Kilometerzähler VehDa_lSum" UBYTE OneToOne 1 100 0.00 255.0 FORMAT "%5.1" ECU_ADDRESS 0x8FEC96 /end MEASUREMENT
/begin MEASUREMENT Fid_ZFCClbActv_mp "FID für Ersatzreaktion für die Nullmengenkalibrierung" UBYTE OneToOne 1 100 0.00 255.0 FORMAT "%5.1" ECU_ADDRESS 0x8FEC97 /end MEASUREMENT
/begin MEASUREMENT Fid_ZFCCldCmbCham_mp "Function Identifier für die Erkennung ausgekühlter Brennraum der Nullmengenkalibrierung" UBYTE OneToOne 1 100 0.00 255.0 FORMAT "%5.1" ECU_ADDRESS 0x8FEC98 /end MEASUREMENT
/begin FUNCTION dsm_auto_dfpmp ""
 /begin OUT_MEASUREMENT Dfp_ACCDCmpr_mp Dfp_ACCDPres1_mp Dfp_ACCDPresAna_mp Dfp_ACCDPres_mp Dfp_ACCDSwtin_mp Dfp_AccPedPlausBrk_mp Dfp_ACC_PlausTrqDes_mp Dfp_ACC_trqInr_mp Dfp_ACTrq_mp Dfp_ADCMon_mp Dfp_AFSCDIdlAdjVal_mp Dfp_AFSCDLdAdjVal_mp Dfp_AFSCD_AirTempDcyc_mp Dfp_AFSCD_PlOffsDrft_mp Dfp_AFSCD_PlSetyDrft_mp Dfp_AFSCD_SRCAirTemp_mp Dfp_AFSCD_SRCBatt_mp Dfp_AFSCD_SRCCorrAirm_mp Dfp_AFSCD_SRCRawAirm_mp Dfp_AFSCD_SRCRefSigPer_mp Dfp_AirCtlGvnrDvtRgnMax2_mp Dfp_AirCtlGvnrDvtRgnMax_mp Dfp_AirCtlGvnrDvtRgnMin2_mp Dfp_AirCtlGvnrDvtRgnMin_mp Dfp_AirCtlPlateBreak_mp Dfp_AirCtlRmpTO_mp Dfp_AirCtl_GovNegDev2_mp Dfp_AirCtl_GovNegDev_mp Dfp_AirCtl_GovPosDev2_mp Dfp_AirCtl_GovPosDev_mp Dfp_AltCD_Load_mp Dfp_AltCD_mp Dfp_AOHtCD_AOHtDia1_mp Dfp_AOHtCD_AOHtDia2_mp Dfp_AOHtCD_AOHtDia3_mp Dfp_AOHtCD_mp Dfp_APP1_mp Dfp_APP2_mp Dfp_APPSync_mp Dfp_APSCD_mp Dfp_ARS_mp Dfp_BattCD_mp Dfp_BPACD_BPADia1_mp Dfp_BPACD_BPADia2_mp Dfp_BPACD_BPADia3_mp Dfp_BPACD_Max_mp Dfp_BPACD_Min_mp Dfp_BPACD_SigNpl_mp Dfp_BPSCD_mp Dfp_BrkCD_mp Dfp_Bss_mp Dfp_CBACD_mp Dfp_Clg_DynTst_mp Dfp_CmbChbMisfire1_mp Dfp_CmbChbMisfire2_mp Dfp_CmbChbMisfire3_mp Dfp_CmbChbMisfire4_mp Dfp_CmbChbMisfire5_mp Dfp_CmbChbMisfire6_mp Dfp_CmbChbMisfireMul_mp Dfp_ConvCD_mp Dfp_CoVMDCSh_mp Dfp_CrCCDMFL_mp Dfp_CrCtl_vCrCtl_mp Dfp_CTSCD_mp Dfp_DCC_PlausTrqDes_mp Dfp_Dummy1_mp Dfp_EATSCD_mp Dfp_EBAFCD_mp Dfp_EBFCD_mp Dfp_EBTSCD_mp Dfp_EBTSCD_OvrTemp_mp Dfp_EEPCDVarMng_mp Dfp_EGPpCDTPreTrbn_mp Dfp_EGPpCD_mp Dfp_EGRCD_Max_mp Dfp_EGRCD_Min_mp Dfp_EGRCD_SigNpl_mp Dfp_EGTRgnOilDil_mp Dfp_EMCCDNoLoad1_mp Dfp_EMCCDNoLoad2_mp Dfp_EMCCDSCBat1_mp Dfp_EMCCDSCBat2_mp Dfp_EMCCDSCGnd1_mp Dfp_EMCCDSCGnd2_mp Dfp_EMCCD_ADC1_mp Dfp_EMCCD_ADC2_mp Dfp_EngMCaS1_mp Dfp_EngMCrS1_mp Dfp_EngMOfsCaSCrS_mp Dfp_EngPrtFWODet_mp Dfp_ETClbETFltInj1_mp Dfp_ETClbETFltInj2_mp Dfp_ETClbETFltInj3_mp Dfp_ETClbETFltInj4_mp Dfp_ETClbETFltInj5_mp Dfp_ETClbETFltInj6_mp Dfp_ETClbInj1_mp Dfp_ETClbInj2_mp Dfp_ETClbInj3_mp Dfp_ETClbInj4_mp Dfp_ETClbInj5_mp Dfp_ETClbInj6_mp Dfp_FanCD_FanCtlr1_mp Dfp_FanCD_FanCtlr2_mp Dfp_FanCD_FanCtlr3_mp Dfp_FanCD_mp Dfp_FBCqDvt_mp Dfp_FlFCD_mp Dfp_FlMngSmkDefect_mp Dfp_FMTC_NonMonotonMap_mp Dfp_FrmMngANFRADMOMPT_mp Dfp_FrmMngASC1_mp Dfp_FrmMngASC2_mp Dfp_FrmMngASC3_mp Dfp_FrmMngASC4_mp Dfp_FrmMngBOS_RESET_2_mp Dfp_FrmMngBOS_RESET_mp Dfp_FrmMngDMANFAFS_mp Dfp_FrmMngDRMANFSSG_mp Dfp_FrmMngEGS1_mp Dfp_FrmMngEGS2_mp Dfp_FrmMngGEARBX_DATA2_mp Dfp_FrmMngGEARBX_DATA_mp Dfp_FrmMngHEAT_AC_mp Dfp_FrmMngINSTR2_mp Dfp_FrmMngINSTR3_mp Dfp_FrmMngLENKRADWINKEL_mp Dfp_FrmMngMILEAGE_RANGE_mp Dfp_FrmMngOPCRCTLACC_mp Dfp_FrmMngParkConsumer_mp Dfp_FrmMngPRGG_CCTR_mp Dfp_FrmMngPWRMNG_LOADV_mp Dfp_FrmMngRQSTGEFAN_mp Dfp_FrmMngSSGErr_mp Dfp_FrmMngSSGShOff_mp Dfp_FrmMngSTAT_ANH_mp Dfp_FrmMngSTAT_ARS_mp Dfp_FrmMngSTAT_DSC_mp Dfp_FrmMngSTAT_EKP_mp Dfp_FrmMngSTAT_KOMBI_mp Dfp_FrmMngSTAT_SITZ_mp Dfp_FrmMngstCurr_mp Dfp_FrmMngStOBDGbxMilOf_mp Dfp_FrmMngStOBDGbxMilOn_mp Dfp_FrmMngswtPSPOff_mp Dfp_FrmMngTEMPRELTIME_mp Dfp_FrmMngTERMINAL_mp Dfp_FrmMngTIME_DATE_mp Dfp_FrmMngTORQUE_DSC_mp Dfp_FrmMngTORQUE_GEARBX_mp Dfp_FrmMngTrq_ReqACC_mp Dfp_FrmMngVEH_MOD_mp Dfp_FrmMngVELOCITY_mp Dfp_FrmMngWHEEL_SPEED_mp Dfp_FTSCD_mp Dfp_GearbxIncMax_mp Dfp_GlwCDGlwCirc1_mp Dfp_GlwCDGlwCirc2_mp Dfp_GlwCDGlwCirc3_mp Dfp_GlwCDGlwCirc4_mp Dfp_GlwCDGlwCirc5_mp Dfp_GlwCDGlwCirc6_mp Dfp_GlwCDGlwCirc7_mp Dfp_GlwCDGlwCirc8_mp Dfp_GlwCD_mp Dfp_GlwCtl_mp Dfp_HWEMonCom_mp Dfp_HWEMonEEPROM_mp Dfp_HWEMonRcyLocked_mp Dfp_HWEMonRcySuppressed_mp Dfp_HWEMonRcyVisible_mp Dfp_HWEMonUMaxSupply_mp Dfp_HWEMonUMinSupply_mp Dfp_IATSCD_CATS_mp Dfp_IATSCD_mp Dfp_ImmCtlImmCD_mp Dfp_ImmCtlImmEep_mp Dfp_ImmCtlMpl_mp Dfp_IndSys1_mp Dfp_IndSys2_mp Dfp_InjCrv_InjLim_mp Dfp_InjCtlAdjQnt_mp Dfp_InjCtlDrift_mp Dfp_InjVCDActrChrg_mp Dfp_InjVCDActrEnrg1_mp Dfp_InjVCDActrEnrg2_mp Dfp_InjVCDActrEnrg3_mp Dfp_InjVCDActrEnrg4_mp Dfp_InjVCDActrEnrg5_mp Dfp_InjVCDActrEnrg6_mp Dfp_InjVCDActrEnrg7_mp Dfp_InjVCDActrEnrg8_mp Dfp_InjVCDActrVolt_mp Dfp_InjVCDClsBank1_mp Dfp_InjVCDClsBank2_mp Dfp_InjVCDMonCab_mp Dfp_InjVCDMonSwt_mp Dfp_InjVCDShOffDCDC_mp Dfp_InjVCDUBuf_mp Dfp_InjVCD_CY370Ampl_mp Dfp_InjVlvBnk1A_mp Dfp_InjVlvBnk1B_mp Dfp_InjVlvBnk2A_mp Dfp_InjVlvBnk2B_mp Dfp_InjVlvChipA_mp Dfp_InjVlvChipB_mp Dfp_InjVlvCyl1A_mp Dfp_InjVlvCyl1B_mp Dfp_InjVlvCyl1C_mp Dfp_InjVlvCyl2A_mp Dfp_InjVlvCyl2B_mp Dfp_InjVlvCyl2C_mp Dfp_InjVlvCyl3A_mp Dfp_InjVlvCyl3B_mp Dfp_InjVlvCyl3C_mp Dfp_InjVlvCyl4A_mp Dfp_InjVlvCyl4B_mp Dfp_InjVlvCyl4C_mp Dfp_InjVlvCyl5A_mp Dfp_InjVlvCyl5B_mp Dfp_InjVlvCyl5C_mp Dfp_InjVlvCyl6A_mp Dfp_InjVlvCyl6B_mp Dfp_InjVlvCyl6C_mp Dfp_InjVlvCyl7A_mp Dfp_InjVlvCyl7B_mp Dfp_InjVlvCyl7C_mp Dfp_InjVlvCyl8A_mp Dfp_InjVlvCyl8B_mp Dfp_InjVlvCyl8C_mp Dfp_InjVlvNVC1_mp Dfp_InjVlvNVC2_mp Dfp_InjVlvNVC3_mp Dfp_InjVlvNVC4_mp Dfp_InjVlvNVC5_mp Dfp_InjVlvNVC6_mp Dfp_InjVlvNVC7_mp Dfp_InjVlvNVC8_mp Dfp_Layer_BSD_mp Dfp_Layer_GEN_mp Dfp_Layer_IBS1_mp Dfp_Layer_IBS2_mp Dfp_Layer_IBS3_mp Dfp_Layer_MANHYDR_mp Dfp_Layer_MANLUFT_mp Dfp_Layer_PMBATT_mp Dfp_Layer_PMBN_mp Dfp_Layer_PMRUHVERL_mp Dfp_Layer_QLT_mp Dfp_Layer_TANS_mp Dfp_Layer_TOENS_mp Dfp_Layer_TUMG_mp Dfp_LPACD_Max_mp Dfp_LPACD_Min_mp Dfp_LPACD_SigNpl_mp Dfp_LSUCDCircNernst0_mp Dfp_LSUCDCircPumpCur0_mp Dfp_LSUCDCircVirtGnd0_mp Dfp_LSUCDHeater0_mp Dfp_LSUCDHtCoup0_mp Dfp_LSUCDO20_mp Dfp_LSUCDO2Clb0_mp Dfp_LSUCDRiClb0_mp Dfp_LSUCDSPI0_mp Dfp_LSUCDSPIBattLow0_mp Dfp_LSUCDWireIP0_mp Dfp_LSUCtlRiExc0_mp Dfp_LSUMon1Sens_mp Dfp_LSUMon2Sens_mp Dfp_MeUnCDNoLoad_mp Dfp_MeUnCDSCBat_mp Dfp_MeUnCDSCGnd_mp Dfp_MeUnCD_ADC_mp Dfp_MeUnCD_SigTst_mp Dfp_MIL_mp Dfp_Montr_mp Dfp_MRlyCD_mp Dfp_MSidCD_Comm_mp Dfp_MSidCD_Pin_mp Dfp_MSidCD_Select_mp Dfp_MSidCD_Sel_INI_mp Dfp_NetMngDeviceA_mp Dfp_NetMngDeviceB_mp Dfp_NetMngDeviceC_mp Dfp_OPSCD_anain_mp Dfp_OPSCD_Lamp_mp Dfp_OTSCD_mp Dfp_OvRMonBrk_mp Dfp_OvRMonSigA_mp Dfp_OvRMon_mp Dfp_OxiCCDTPre_mp Dfp_PCR_GovDevNeg_mp Dfp_PCR_GovDevPos_mp Dfp_PCR_LPGvnrDvtNeg_mp Dfp_PCR_LPGvnrDvtPos_mp Dfp_PCVCDNoLoad_mp Dfp_PCVCDSCBat_mp Dfp_PCVCDSCGnd_mp Dfp_PCVCD_ADC_mp Dfp_PCVCD_SigTst_mp Dfp_PFltAPSens_mp Dfp_PFltAPSPlaus_mp Dfp_PFltBPSPlaus_mp Dfp_PFltCDPPre_mp Dfp_PFltCDTempPre_mp Dfp_PFltChar_mp Dfp_PFltEngPrt_mp Dfp_PFltmSotDiffMax_mp Dfp_PFltPresDynPlaus_mp Dfp_PFltPresPlaus_mp Dfp_PFltPresSensFrz_mp Dfp_PFltPresSensHsLn_mp Dfp_PFltPresSensSot_mp Dfp_PFltPresSens_mp Dfp_PFltRgnPerm_mp Dfp_PFltTempDwnStrm_mp Dfp_PFltTempSens_mp Dfp_PFltTempUpStrm_mp Dfp_PresPlausDblDef_mp Dfp_PSPCD_Actr_mp Dfp_QLTCD_mp Dfp_RailCDOfsTst_mp Dfp_RailCD_mp Dfp_RailCD_PMonStrt_mp Dfp_RailCtlModeMeUnDiag_mp Dfp_RailCtlModePCVDiag_mp Dfp_RailMeUn0_mp Dfp_RailMeUn1_mp Dfp_RailMeUn2_mp Dfp_RailMeUn3_mp Dfp_RailMeUn4_mp Dfp_RailPCV0_mp Dfp_RailPCV1_mp Dfp_RailPCV2_mp Dfp_RailPCV3_mp Dfp_RailPCV4_mp Dfp_RailPCV5_mp Dfp_ShutCD_mp Dfp_SOPTst_mp Dfp_SSpMon1_mp Dfp_SSpMon2_mp Dfp_SSpMon3_mp Dfp_StrtCD_Actr_mp Dfp_StSysTrqShutOff_mp Dfp_SWChk_CycSigChkDat_mp Dfp_SWChk_CycSigChkPrg_mp Dfp_SysLamp_mp Dfp_T15CD_mp Dfp_TGearbx_mp Dfp_TPUMon_mp Dfp_TVACD_Max_mp Dfp_TVACD_Min_mp Dfp_TVACD_SigNpl_mp Dfp_TVACD_TVADia1_mp Dfp_TVACD_TVADia2_mp Dfp_TVACD_TVADia3_mp Dfp_TVACD_TVADia4_mp Dfp_VSACD_DioInDia1_mp Dfp_VSACD_DioInDia2_mp Dfp_VSACD_DioInDia3_mp Dfp_VSACD_DioInDia4_mp Dfp_VSACD_DioInMin_mp Dfp_VSACD_Max_mp Dfp_VSACD_Min_mp Dfp_VSACD_SigNpl_mp Dfp_VSACD_VSADia1_mp Dfp_VSACD_VSADia2_mp Dfp_VSACD_VSADia3_mp Dfp_VSACD_VSADia4_mp Dfp_VSSCD1_mp Dfp_VSSCD2_mp Dfp_WdCom_mp /end OUT_MEASUREMENT
/end FUNCTION
/begin FUNCTION dsm_auto_env16 "" /end FUNCTION
/begin FUNCTION dsm_auto_env8 "" /begin DEF_CHARACTERISTIC /end DEF_CHARACTERISTIC /end FUNCTION
/begin FUNCTION dsm_auto_fid_scd "" /end FUNCTION
/begin FUNCTION dsm_auto_fid_scd_msg "" /end FUNCTION
/begin FUNCTION dsm_auto_inh "" /begin DEF_CHARACTERISTIC /end DEF_CHARACTERISTIC /end FUNCTION
/begin FUNCTION dsm_auto_inhdel "" /begin DEF_CHARACTERISTIC /end DEF_CHARACTERISTIC /end FUNCTION
/begin FUNCTION dsm_auto_oldas ""
 /begin OUT_MEASUREMENT DSM_FCM_mp Fid_ACCIRevErr_mp Fid_AccPedBrkPres_mp Fid_AccPedVel_mp Fid_AccPed_Brk_mp Fid_AccPed_mp Fid_ACCRevErr_mp Fid_ACCtlDflt1_mp Fid_ACCtlDflt2_mp Fid_ACCtl_ACTrqErr_mp Fid_ACCtl_CTSErr_mp Fid_ACCtl_FanErr_mp Fid_ACCtl_mp Fid_ACCtl_TGearbxErr_mp Fid_ACCtl_VSSErr_mp Fid_ACC_AliveErr_mp Fid_ACC_CsErr_mp Fid_ACC_TiOutErr_mp Fid_ACTrqC_mp Fid_AFSCD_AirPerTime_mp Fid_AFSCD_mp Fid_AFSCD_PlOffsDrft_mp Fid_AFSCD_PlSetyDrft_mp Fid_AFSCD_SRCCorrAirm_mp Fid_AFSCD_SRCDcyc_mp Fid_AFSCD_SRCRawAirm_mp Fid_AFSCD_SRCRefSig_mp Fid_AFS_CanMon_mp Fid_AFS_GenDisableCond_mp Fid_AirCtlNeg2_mp Fid_AirCtlNeg_mp Fid_AirCtlPFltEGRRed_mp Fid_AirCtlPlateBreakActv_mp Fid_AirCtlPlateBreak_mp Fid_AirCtlPos2_mp Fid_AirCtlPos_mp Fid_AirCtl_Brk_mp Fid_AirCtl_mp Fid_AOHt_AltErr_mp Fid_AOHt_ShutOffErr_mp Fid_APP1_mp Fid_APP2_mp Fid_APPKickdown_mp Fid_APSCD_mp Fid_ARSOff_mp Fid_ASDdc_mp Fid_ASModSwtOffEng_mp Fid_ASModSwtOffIndVol_mp Fid_BPSCDMon_mp Fid_ClgDynTst_mp Fid_CmbChb_mp Fid_CoDT_GripDeb_mp Fid_CoEngIRevSys1_mp Fid_CoEngIRevSys2_mp Fid_CoEngIRevVeh_mp Fid_CoEngPFltErr_mp Fid_CoEngRevSys1_mp Fid_CoEngRevSys2_mp Fid_CoEngRevVeh_mp Fid_CoEngShOffTst_mp Fid_CoEngSoftShOffTV_mp Fid_CoEng_ActrPrt_mp Fid_CoEng_Nrml2Strt_mp Fid_CoEng_PwrStgEnable_mp Fid_CoEng_trqLimErr1_mp Fid_CoEng_trqLimErr2_mp Fid_CoEng_trqLimErr3_mp Fid_CoEng_trqLimErr4_mp Fid_CoEng_trqLimErr_mp Fid_CoVehtrqLimErr_mp Fid_CoVM_StabDem_Err_mp Fid_CpBVlvOff_mp Fid_CrCtlShutOffIr_mp Fid_CrCtl_ASCTimeout_mp Fid_CrCtl_CanDef_mp Fid_CrCtl_KombiTimeout_mp Fid_CrCtl_vCrCtl_mp Fid_CTSCDFlTemp_mp Fid_CTSCD_Plaus_mp Fid_DCCIRevErr_mp Fid_DCCRevErr_mp Fid_DCC_AliveErr_mp Fid_DCC_CsErr_mp Fid_DCC_PlausErr_mp Fid_DCC_TiOutErr_mp Fid_DSM_Wuc_mp Fid_EATSCDTSubs_mp Fid_EBAFCD_mp Fid_EBFCD_mp Fid_ECU_mp Fid_EGSysCoLSU0_mp Fid_EGSysCoNSC_mp Fid_EGSysCoOxi_mp Fid_EGSysCoTrbn_mp Fid_EGSysCoTube0_mp Fid_EGSysCoTube1_mp Fid_EGSysHtgDel_mp Fid_EGSysNSC_mp Fid_EGSysOxiCat_mp Fid_EGSysPresEnv_mp Fid_EGSysStrt_mp Fid_EGSysTemp_mp Fid_EGSysTrbn_mp Fid_EGSysTube_mp Fid_EGSys_AP_mp Fid_EGTRgnLck_mp Fid_EGTTempGvnrAirCtl_mp Fid_EGTTempGvnrInr_mp Fid_EGTTempGvnrOutr_mp Fid_EMCCD_ShutOff_mp Fid_EngCTSCD_mp Fid_EngMCaSBackUp_mp Fid_EngMCrSBackUp_mp Fid_EngMTEng_mp Fid_EngMTrqFrcPDiff_mp Fid_EngMVVeh_mp Fid_EngM_ChkStrtSpd_mp Fid_EngPrt_nLimErr_mp Fid_ETClbCorActv_mp Fid_FanCtl_mp Fid_FanGbxOil_mp Fid_FBCMonI_mp Fid_FBC_mp Fid_FlMngFullLdRglOff_mp Fid_FlMngSmkDefect_mp Fid_FlSysCTSSens_mp Fid_FlSysDens_mp Fid_FlSysFTSSens_mp Fid_FMASwtOff1_mp Fid_FMASwtOff3_mp Fid_FMTC_AirCorr_mp Fid_FMTC_SOECorr_mp Fid_FrmMngAddLevl_mp Fid_FrmMngAPP_mp Fid_FrmMngARS_mp Fid_FrmMngBrkDef_mp Fid_FrmMngBrk_mp Fid_FrmMngCoEng_mp Fid_FrmMngCoEng_St2_mp Fid_FrmMngConvDef_mp Fid_FrmMngEngOvrSpd_mp Fid_FrmMngEngRpmTemp_mp Fid_FrmMngEngSpd_mp Fid_FrmMngInjDU1_mp Fid_FrmMngInjDU2_mp Fid_FrmMngInjVlv_mp Fid_FrmMngnSetpoint_mp Fid_FrmMngOBDCtl_mp Fid_FrmMngParkConsumer_mp Fid_FrmMngPFltDef_mp Fid_FrmMngPla_DSC_mp Fid_FrmMngPla_EGS_mp Fid_FrmMngPowerTrainCAN_mp Fid_FrmMngpVal_mp Fid_FrmMngPwrMngLIGovSt_mp Fid_FrmMngSIG_ARS_mp Fid_FrmMngSIG_DSC_mp Fid_FrmMngSig_EGS_mp Fid_FrmMngtEng_mp Fid_FrmMngTO_ARS_mp Fid_FrmMngTO_DSC_mp Fid_FrmMngTo_EGS_mp Fid_FrmMngTrqGearbx_mp Fid_FrmMngWaterVlv_mp Fid_FrmMng_stTrq_mp Fid_FrmMng_ST_TORQ_mp Fid_FTSCDErr_mp Fid_FWOscDet_mp Fid_GearbxDrvAwayInactiv_mp Fid_GearbxDrvAway_mp Fid_GearbxPtCANErr_mp Fid_GearbxTrqLimErr_mp Fid_Gearbx_GearDet_mp Fid_Gearbx_TrqIntv_Err_mp Fid_GlwCtl1_mp Fid_HDC_mp Fid_IndSys1_mp Fid_IndSys2_mp Fid_InjCrvCoErr_mp Fid_InjCtl_qLimErr_mp Fid_InjVCDCls_mp Fid_InjVlvActrTemp_mp Fid_InjVlvInjLim_mp Fid_InjVlvMon_mp Fid_InjVlvNVC_mp Fid_InjVlvSetUpVolt_mp Fid_InjVlvWvCorOff_mp Fid_Layer_FI_TANS_mp Fid_Layer_FI_TUMG_mp Fid_Layer_MANHYDR_mp Fid_Layer_MANLUFT_mp Fid_LIGovSetpDrvAway_mp Fid_LIGovSetpointDrvAwy_mp Fid_LIGovUbr_mp Fid_LSUCDactiv0_mp Fid_LSUCDlsu0_mp Fid_LSUCDMon0_mp Fid_LSUCDO20_mp Fid_LSUCDRi0_mp Fid_LSUClbSched_mp Fid_LSUCtl0_mp Fid_LSUMonAllChecks_mp Fid_LSUMonPlausChk_mp Fid_MeUnCDCalcI_mp Fid_MSidCD_ECU_mp Fid_MSidCD_Pin_mp Fid_OTSCD_mp Fid_PCRBalGvnr_mp Fid_PCRExtnLimActr_mp Fid_PCRGvnrDvtNeg_mp Fid_PCRGvnrDvtPos_mp Fid_PCRLPGvnrDvtNeg_mp Fid_PCRLPGvnrDvtPos_mp Fid_PCRSurgeLIGov_mp Fid_PCR_LPMS_mp Fid_PCR_LP_mp Fid_PCR_mp Fid_PCR_MS_mp Fid_PCR_SurgeDet_mp Fid_PCVCDCalcI_mp Fid_PFltAshCorRgn_mp Fid_PFltAshCor_mp Fid_PFltBrk_mp Fid_PFltChar_mp Fid_PFltChngPar_mp Fid_PFltClth_mp Fid_PFltDiagRls1_mp Fid_PFltDiagRls2_mp Fid_PFltDynChk_mp Fid_PFltEngPrtRgnMon_mp Fid_PFltGearDet_mp Fid_PFltHsLnChk_mp Fid_PFltLckRgnErr_mp Fid_PFltLckRgnFuel_mp Fid_PFltNumPFltErrLck_mp Fid_PFltNumPFltErr_mp Fid_PFltPlausPres_mp Fid_PFltPlausTemp_mp Fid_PFltPPreErr_mp Fid_PFltPresPlausProj_mp Fid_PFltPresSensFrz_mp Fid_PFltPresSensHsLn_mp Fid_PFltSimOn_mp Fid_PFltSpdVeh_mp Fid_PFltSRCPres_mp Fid_PFltSRCTemp_mp Fid_PFltSuc_mp Fid_PFltTempAir_mp Fid_PFltTempClnt_mp Fid_PFltTempOxiPre_mp Fid_PFltTempPre_mp Fid_PFltTempSensFrz_mp Fid_PFltVltgBatt_mp Fid_RailCDRPSErrChk_mp Fid_RailCDSubstVal_mp Fid_RailCD_PMonStrt_mp Fid_RailCtlMode_mp Fid_RailMeUn0Blk_mp Fid_RailMeUn0Rls_mp Fid_RailMeUn1Blk_mp Fid_RailMeUn1Rls_mp Fid_RailMeUn2Blk_mp Fid_RailMeUn2Rls_mp Fid_RailMeUn3Blk_mp Fid_RailMeUn3Rls_mp Fid_RailMeUn4Blk_mp Fid_RailMeUn4Rls_mp Fid_RailMeUnCtlMode_mp Fid_RailPCV0Blk_mp Fid_RailPCV0Rls_mp Fid_RailPCV1Blk_mp Fid_RailPCV1Rls_mp Fid_RailPCV2Blk_mp Fid_RailPCV2Rls_mp Fid_RailPCV3Blk_mp Fid_RailPCV3Rls_mp Fid_RailPCV4Blk_mp Fid_RailPCV4Rls_mp Fid_RailPCV5Blk_mp Fid_RailPCV5Rls_mp Fid_RailPCVCtlMode_mp Fid_RailSetPointLim_mp Fid_RailSetPointRed_mp Fid_ShuttrCTS_mp Fid_ShuttrEGS_mp Fid_SignalsTstNLim_mp Fid_StSysImmo_mp Fid_StSysStrtTipGbxDat_mp Fid_T15CDCanError_mp Fid_T50CDSig_mp Fid_UsrDa_FDCOff_mp Fid_VehDaDist_mp Fid_ZFCClbActv_mp Fid_ZFCCldCmbCham_mp /end OUT_MEASUREMENT
/end FUNCTION
/begin FUNCTION dsm_auto_sdw "" /begin DEF_CHARACTERISTIC /end DEF_CHARACTERISTIC /end FUNCTION
/begin FUNCTION dsm_auto_trans "" /begin DEF_CHARACTERISTIC /end DEF_CHARACTERISTIC /end FUNCTION
/begin FUNCTION dsm_auto_tsf "" /begin DEF_CHARACTERISTIC /end DEF_CHARACTERISTIC /end FUNCTION
/begin FUNCTION dsm_msg ""
 /begin OUT_MEASUREMENT DFPM_stFCMChkCause DSM_ctDfctPath DSM_ctFcmEntry DSM_ctOBDPath DSM_ctOBDValidPath DSM_ctTstPath DSM_ctWUC DSM_lDist DSM_stCycles DSM_stECUMasterSlave DSM_stInhDelay DSM_stMIL DSM_stPID41 DSM_stRdyAB DSM_stRdyCD DSM_stRdyCheckEnable DSM_stSysLamp /end OUT_MEASUREMENT
/end FUNCTION
/begin FUNCTION dsm_rdy "" /begin DEF_CHARACTERISTIC /end DEF_CHARACTERISTIC /end FUNCTION
/begin FUNCTION dsm_rdy_msg "" /end FUNCTION
/begin FUNCTION dsm_rdy_uic ""
 /begin OUT_MEASUREMENT DSM_ctRdyActCyc_mp DSM_ctRdyCycCat_mp DSM_ctRdyCycCompr_mp DSM_ctRdyCycEGR_mp DSM_ctRdyCycFuel_mp DSM_ctRdyCycMisf_mp DSM_ctRdyCycOxSenHt_mp DSM_ctRdyCycOxSen_mp DSM_ctRdyLimCat_mp DSM_ctRdyLimCompr_mp DSM_ctRdyLimEGR_mp DSM_ctRdyLimFuel_mp DSM_ctRdyLimMisf_mp DSM_ctRdyLimOxSenHt_mp DSM_ctRdyLimOxSen_mp DSM_ctRdyPathsCat_mp DSM_ctRdyPathsCompr_mp DSM_ctRdyPathsEGR_mp DSM_ctRdyPathsFuel_mp DSM_ctRdyPathsMisf_mp DSM_ctRdyPathsOxSenHt_mp DSM_ctRdyPathsOxSen_mp DSM_ctRdyTstCat_mp DSM_ctRdyTstCompr_mp DSM_ctRdyTstEGR_mp DSM_ctRdyTstFuel_mp DSM_ctRdyTstMisf_mp DSM_ctRdyTstOxSenHt_mp DSM_ctRdyTstOxSen_mp /end OUT_MEASUREMENT
/end FUNCTION
/begin FUNCTION dsm_sy_conf "" /end FUNCTION
/begin FUNCTION dsm_uic ""
 /begin OUT_MEASUREMENT DfpErrCol_mp DfpZyfCol_mp DSCHED_numDefDfpArray_mp DSCHED_numOkDfpArray_mp DSM_ctFCMEntrySize_mp DSM_ctPath_mp DSM_tiDCDelay_mp FidCol_mp /end OUT_MEASUREMENT
/end FUNCTION
/begin FUNCTION dummy "" /end FUNCTION
/begin COMPU_METHOD DfpName "Verbale Umrechnung für Fehlerpfadnamen" TAB_VERB "%6.3" "-" COMPU_TAB_REF DfpName /end COMPU_METHOD
/begin COMPU_VTAB DfpName "Verbale Umrechnung für Fehlerpfadnamen" TAB_VERB 374 0 "Dfp_unused" 1 "Dfp_Layer_TANS" 2 "Dfp_ACCDCmpr" 3 "Dfp_ACCDPres" 4 "Dfp_ACCDPres1" 5 "Dfp_ACCDPresAna" 6 "Dfp_ACCDSwtin" 7 "Dfp_ACC_PlausTrqDes" 8 "Dfp_ACC_trqInr" 9 "Dfp_ACTrq" 10 "Dfp_ADCMon" 11 "Dfp_AFSCDIdlAdjVal" 12 "Dfp_AFSCDLdAdjVal" 13 "Dfp_AFSCD_AirTempDcyc" 14 "Dfp_AFSCD_PlOffsDrft" 15 "Dfp_AFSCD_PlSetyDrft" 16 "Dfp_AFSCD_SRCAirTemp" 17 "Dfp_AFSCD_SRCBatt" 18 "Dfp_AFSCD_SRCCorrAirm" 19 "Dfp_AFSCD_SRCRawAirm" 20 "Dfp_Layer_TUMG" 21 "Dfp_AFSCD_SRCRefSigPer" 22 "Dfp_AOHtCD" 23 "Dfp_Layer_GEN" 24 "Dfp_Layer_BSD" 25 "Dfp_AOHtCD_AOHtDia1" 26 "Dfp_AOHtCD_AOHtDia2" 27 "Dfp_AOHtCD_AOHtDia3" 28 "Dfp_APP1" 29 "Dfp_APP2" 30 "Dfp_APPSync" 31 "Dfp_APSCD" 32 "Dfp_ARS" 33 "Dfp_AccPedPlausBrk" 34 "Dfp_AirCtlGvnrDvtRgnMax" 35 "Dfp_Layer_QLT" 36 "Dfp_AirCtlGvnrDvtRgnMax2" 37 "Dfp_Layer_IBS1" 38 "Dfp_Layer_IBS2" 39 "Dfp_Layer_IBS3" 40 "Dfp_Layer_PMBN" 41 "Dfp_Layer_PMBATT" 42 "Dfp_AirCtlGvnrDvtRgnMin" 43 "Dfp_AirCtlGvnrDvtRgnMin2" 44 "Dfp_AirCtlPlateBreak" 45 "Dfp_AirCtlRmpTO" 46 "Dfp_AirCtl_GovNegDev" 47 "Dfp_AirCtl_GovNegDev2" 48 "Dfp_AirCtl_GovPosDev" 49 "Dfp_AirCtl_GovPosDev2" 50 "Dfp_AltCD" 51 "Dfp_AltCD_Load" 52 "Dfp_BPACD_BPADia1" 53 "Dfp_BPACD_BPADia2" 54 "Dfp_BPACD_BPADia3" 55 "Dfp_BPACD_Max" 56 "Dfp_BPACD_Min" 57 "Dfp_BPACD_SigNpl" 58 "Dfp_BPSCD" 59 "Dfp_BattCD" 60 "Dfp_BrkCD" 61 "Dfp_Bss" 62 "Dfp_CBACD" 63 "Dfp_CTSCD" 64 "Dfp_Clg_DynTst" 65 "Dfp_CmbChbMisfire1" 66 "Dfp_CmbChbMisfire2" 67 "Dfp_CmbChbMisfire3" 68 "Dfp_CmbChbMisfire4" 69 "Dfp_CmbChbMisfire5" 70 "Dfp_CmbChbMisfire6" 71 "Dfp_CmbChbMisfireMul" 72 "Dfp_CoVMDCSh" 73 "Dfp_ConvCD" 74 "Dfp_Layer_PMRUHVERL" 75 "Dfp_CrCCDMFL" 76 "Dfp_CrCtl_vCrCtl" 77 "Dfp_DCC_PlausTrqDes" 78 "Dfp_Dummy1" 79 "Dfp_Layer_TOENS" 80 "Dfp_Layer_MANHYDR" 81 "Dfp_Layer_MANLUFT" 82 "Dfp_EATSCD" 83 "Dfp_EBAFCD" 84 "Dfp_EBFCD" 85 "Dfp_EBTSCD" 86 "Dfp_EBTSCD_OvrTemp" 87 "Dfp_EEPCDVarMng" 88 "Dfp_EGPpCD" 89 "Dfp_EGPpCDTPreTrbn" 90 "Dfp_EGRCD_Max" 91 "Dfp_EGRCD_Min" 92 "Dfp_EGRCD_SigNpl" 93 "Dfp_EGTRgnOilDil" 94 "Dfp_EMCCDNoLoad1" 95 "Dfp_EMCCDNoLoad2" 96 "Dfp_EMCCDSCBat1" 97 "Dfp_EMCCDSCBat2" 98 "Dfp_EMCCDSCGnd1" 99 "Dfp_EMCCDSCGnd2" 100 "Dfp_EMCCD_ADC1" 101 "Dfp_EMCCD_ADC2" 102 "Dfp_ETClbETFltInj1" 103 "Dfp_ETClbETFltInj2" 104 "Dfp_ETClbETFltInj3" 105 "Dfp_ETClbETFltInj4" 106 "Dfp_ETClbETFltInj5" 107 "Dfp_ETClbETFltInj6" 108 "Dfp_ETClbInj1" 109 "Dfp_ETClbInj2" 110 "Dfp_ETClbInj3" 111 "Dfp_ETClbInj4" 112 "Dfp_ETClbInj5" 113 "Dfp_ETClbInj6" 114 "Dfp_EngMCaS1" 115 "Dfp_EngMCrS1" 116 "Dfp_EngMOfsCaSCrS" 117 "Dfp_EngPrtFWODet" 118 "Dfp_FBCqDvt" 119 "Dfp_FMTC_NonMonotonMap" 120 "Dfp_FTSCD" 121 "Dfp_FanCD" 122 "Dfp_FanCD_FanCtlr1" 123 "Dfp_FanCD_FanCtlr2" 124 "Dfp_FanCD_FanCtlr3" 125 "Dfp_FlFCD" 126 "Dfp_FlMngSmkDefect" 127 "Dfp_FrmMngANFRADMOMPT" 128 "Dfp_FrmMngASC1" 129 "Dfp_FrmMngASC2" 130 "Dfp_FrmMngASC3" 131 "Dfp_FrmMngASC4" 132 "Dfp_FrmMngBOS_RESET" 133 "Dfp_FrmMngBOS_RESET_2" 134 "Dfp_FrmMngDMANFAFS" 135 "Dfp_FrmMngDRMANFSSG" 136 "Dfp_FrmMngEGS1" 137 "Dfp_FrmMngEGS2" 138 "Dfp_FrmMngGEARBX_DATA" 139 "Dfp_FrmMngGEARBX_DATA2" 140 "Dfp_FrmMngHEAT_AC" 141 "Dfp_FrmMngINSTR2" 142 "Dfp_FrmMngINSTR3" 143 "Dfp_FrmMngLENKRADWINKEL" 144 "Dfp_FrmMngMILEAGE_RANGE" 145 "Dfp_FrmMngOPCRCTLACC" 146 "Dfp_FrmMngPRGG_CCTR" 147 "Dfp_FrmMngPWRMNG_LOADV" 148 "Dfp_FrmMngParkConsumer" 149 "Dfp_FrmMngRQSTGEFAN" 150 "Dfp_FrmMngSSGErr" 151 "Dfp_FrmMngSSGShOff" 152 "Dfp_FrmMngSTAT_ANH" 153 "Dfp_FrmMngSTAT_ARS" 154 "Dfp_FrmMngSTAT_DSC" 155 "Dfp_FrmMngSTAT_EKP" 156 "Dfp_FrmMngSTAT_KOMBI" 157 "Dfp_FrmMngSTAT_SITZ" 158 "Dfp_FrmMngStOBDGbxMilOf" 159 "Dfp_FrmMngStOBDGbxMilOn" 160 "Dfp_FrmMngTEMPRELTIME" 161 "Dfp_FrmMngTERMINAL" 162 "Dfp_FrmMngTIME_DATE" 163 "Dfp_FrmMngTORQUE_DSC" 164 "Dfp_FrmMngTORQUE_GEARBX" 165 "Dfp_FrmMngTrq_ReqACC" 166 "Dfp_FrmMngVEH_MOD" 167 "Dfp_FrmMngVELOCITY" 168 "Dfp_FrmMngWHEEL_SPEED" 169 "Dfp_FrmMngstCurr" 170 "Dfp_FrmMngswtPSPOff" 171 "Dfp_GearbxIncMax" 172 "Dfp_GlwCD" 173 "Dfp_GlwCDGlwCirc1" 174 "Dfp_GlwCDGlwCirc2" 175 "Dfp_GlwCDGlwCirc3" 176 "Dfp_GlwCDGlwCirc4" 177 "Dfp_GlwCDGlwCirc5" 178 "Dfp_GlwCDGlwCirc6" 179 "Dfp_GlwCDGlwCirc7" 180 "Dfp_GlwCDGlwCirc8" 181 "Dfp_GlwCtl" 182 "Dfp_HWEMonCom" 183 "Dfp_HWEMonEEPROM" 184 "Dfp_HWEMonRcyLocked" 185 "Dfp_HWEMonRcySuppressed" 186 "Dfp_HWEMonRcyVisible" 187 "Dfp_HWEMonUMaxSupply" 188 "Dfp_HWEMonUMinSupply" 189 "Dfp_IATSCD" 190 "Dfp_IATSCD_CATS" 191 "Dfp_ImmCtlImmCD" 192 "Dfp_ImmCtlImmEep" 193 "Dfp_ImmCtlMpl" 194 "Dfp_IndSys1" 195 "Dfp_IndSys2" 196 "Dfp_InjCrv_InjLim" 197 "Dfp_InjCtlAdjQnt" 198 "Dfp_InjCtlDrift" 199 "Dfp_InjVCDActrChrg" 200 "Dfp_InjVCDActrEnrg1" 201 "Dfp_InjVCDActrEnrg2" 202 "Dfp_InjVCDActrEnrg3" 203 "Dfp_InjVCDActrEnrg4" 204 "Dfp_InjVCDActrEnrg5" 205 "Dfp_InjVCDActrEnrg6" 206 "Dfp_InjVCDActrEnrg7" 207 "Dfp_InjVCDActrEnrg8" 208 "Dfp_InjVCDActrVolt" 209 "Dfp_InjVCDClsBank1" 210 "Dfp_InjVCDClsBank2" 211 "Dfp_InjVCDMonCab" 212 "Dfp_InjVCDMonSwt" 213 "Dfp_InjVCDShOffDCDC" 214 "Dfp_InjVCDUBuf" 215 "Dfp_InjVCD_CY370Ampl" 216 "Dfp_InjVlvBnk1A" 217 "Dfp_InjVlvBnk1B" 218 "Dfp_InjVlvBnk2A" 219 "Dfp_InjVlvBnk2B" 220 "Dfp_InjVlvChipA" 221 "Dfp_InjVlvChipB" 222 "Dfp_InjVlvCyl1A" 223 "Dfp_InjVlvCyl1B" 224 "Dfp_InjVlvCyl1C" 225 "Dfp_InjVlvCyl2A" 226 "Dfp_InjVlvCyl2B" 227 "Dfp_InjVlvCyl2C" 228 "Dfp_InjVlvCyl3A" 229 "Dfp_InjVlvCyl3B" 230 "Dfp_InjVlvCyl3C" 231 "Dfp_InjVlvCyl4A" 232 "Dfp_InjVlvCyl4B" 233 "Dfp_InjVlvCyl4C" 234 "Dfp_InjVlvCyl5A" 235 "Dfp_InjVlvCyl5B" 236 "Dfp_InjVlvCyl5C" 237 "Dfp_InjVlvCyl6A" 238 "Dfp_InjVlvCyl6B" 239 "Dfp_InjVlvCyl6C" 240 "Dfp_InjVlvCyl7A" 241 "Dfp_InjVlvCyl7B" 242 "Dfp_InjVlvCyl7C" 243 "Dfp_InjVlvCyl8A" 244 "Dfp_InjVlvCyl8B" 245 "Dfp_InjVlvCyl8C" 246 "Dfp_InjVlvNVC1" 247 "Dfp_InjVlvNVC2" 248 "Dfp_InjVlvNVC3" 249 "Dfp_InjVlvNVC4" 250 "Dfp_InjVlvNVC5" 251 "Dfp_InjVlvNVC6" 252 "Dfp_InjVlvNVC7" 253 "Dfp_InjVlvNVC8" 254 "Dfp_LPACD_Max" 255 "Dfp_LPACD_Min" 256 "Dfp_LPACD_SigNpl" 257 "Dfp_LSUCDCircNernst0" 258 "Dfp_LSUCDCircPumpCur0" 259 "Dfp_LSUCDCircVirtGnd0" 260 "Dfp_LSUCDHeater0" 261 "Dfp_LSUCDHtCoup0" 262 "Dfp_LSUCDO20" 263 "Dfp_LSUCDO2Clb0" 264 "Dfp_LSUCDRiClb0" 265 "Dfp_LSUCDSPI0" 266 "Dfp_LSUCDSPIBattLow0" 267 "Dfp_LSUCDWireIP0" 268 "Dfp_LSUCtlRiExc0" 269 "Dfp_LSUMon1Sens" 270 "Dfp_LSUMon2Sens" 271 "Dfp_MIL" 272 "Dfp_MRlyCD" 273 "Dfp_MSidCD_Comm" 274 "Dfp_MSidCD_Pin" 275 "Dfp_MSidCD_Sel_INI" 276 "Dfp_MSidCD_Select" 277 "Dfp_MeUnCDNoLoad" 278 "Dfp_MeUnCDSCBat" 279 "Dfp_MeUnCDSCGnd" 280 "Dfp_MeUnCD_ADC" 281 "Dfp_MeUnCD_SigTst" 282 "Dfp_Montr" 283 "Dfp_NetMngDeviceA" 284 "Dfp_NetMngDeviceB" 285 "Dfp_NetMngDeviceC" 286 "Dfp_OPSCD_Lamp" 287 "Dfp_OPSCD_anain" 288 "Dfp_OTSCD" 289 "Dfp_OvRMon" 290 "Dfp_OvRMonBrk" 291 "Dfp_OvRMonSigA" 292 "Dfp_OxiCCDTPre" 293 "Dfp_PCR_GovDevNeg" 294 "Dfp_PCR_GovDevPos" 295 "Dfp_PCR_LPGvnrDvtNeg" 296 "Dfp_PCR_LPGvnrDvtPos" 297 "Dfp_PCVCDNoLoad" 298 "Dfp_PCVCDSCBat" 299 "Dfp_PCVCDSCGnd" 300 "Dfp_PCVCD_ADC" 301 "Dfp_PCVCD_SigTst" 302 "Dfp_PFltAPSPlaus" 303 "Dfp_PFltAPSens" 304 "Dfp_PFltBPSPlaus" 305 "Dfp_PFltCDPPre" 306 "Dfp_PFltCDTempPre" 307 "Dfp_PFltChar" 308 "Dfp_PFltEngPrt" 309 "Dfp_PFltPresDynPlaus" 310 "Dfp_PFltPresPlaus" 311 "Dfp_PFltPresSens" 312 "Dfp_PFltPresSensFrz" 313 "Dfp_PFltPresSensHsLn" 314 "Dfp_PFltPresSensSot" 315 "Dfp_PFltRgnPerm" 316 "Dfp_PFltTempDwnStrm" 317 "Dfp_PFltTempSens" 318 "Dfp_PFltTempUpStrm" 319 "Dfp_PFltmSotDiffMax" 320 "Dfp_PSPCD_Actr" 321 "Dfp_PresPlausDblDef" 322 "Dfp_QLTCD" 323 "Dfp_RailCD" 324 "Dfp_RailCDOfsTst" 325 "Dfp_RailCD_PMonStrt" 326 "Dfp_RailCtlModeMeUnDiag" 327 "Dfp_RailCtlModePCVDiag" 328 "Dfp_RailMeUn0" 329 "Dfp_RailMeUn1" 330 "Dfp_RailMeUn2" 331 "Dfp_RailMeUn3" 332 "Dfp_RailMeUn4" 333 "Dfp_RailPCV0" 334 "Dfp_RailPCV1" 335 "Dfp_RailPCV2" 336 "Dfp_RailPCV3" 337 "Dfp_RailPCV4" 338 "Dfp_RailPCV5" 339 "Dfp_SOPTst" 340 "Dfp_SSpMon1" 341 "Dfp_SSpMon2" 342 "Dfp_SSpMon3" 343 "Dfp_SWChk_CycSigChkDat" 344 "Dfp_SWChk_CycSigChkPrg" 345 "Dfp_ShutCD" 346 "Dfp_StSysTrqShutOff" 347 "Dfp_StrtCD_Actr" 348 "Dfp_SysLamp" 349 "Dfp_T15CD" 350 "Dfp_TGearbx" 351 "Dfp_TPUMon" 352 "Dfp_TVACD_Max" 353 "Dfp_TVACD_Min" 354 "Dfp_TVACD_SigNpl" 355 "Dfp_TVACD_TVADia1" 356 "Dfp_TVACD_TVADia2" 357 "Dfp_TVACD_TVADia3" 358 "Dfp_TVACD_TVADia4" 359 "Dfp_VSACD_DioInDia1" 360 "Dfp_VSACD_DioInDia2" 361 "Dfp_VSACD_DioInDia3" 362 "Dfp_VSACD_DioInDia4" 363 "Dfp_VSACD_DioInMin" 364 "Dfp_VSACD_Max" 365 "Dfp_VSACD_Min" 366 "Dfp_VSACD_SigNpl" 367 "Dfp_VSACD_VSADia1" 368 "Dfp_VSACD_VSADia2" 369 "Dfp_VSACD_VSADia3" 370 "Dfp_VSACD_VSADia4" 371 "Dfp_VSSCD1" 372 "Dfp_VSSCD2" 373 "Dfp_WdCom" /end COMPU_VTAB
/begin COMPU_METHOD FCMChkCause "Verbale Umrechnung für Message für DSM internen gebrauch (unterstützung bei DSM problemen)" TAB_VERB "%6.3" "-" COMPU_TAB_REF FCMChkCause /end COMPU_METHOD
/begin COMPU_VTAB FCMChkCause "Verbale Umrechnung für Message für DSM internen gebrauch (unterstützung bei DSM problemen)" TAB_VERB 15 1 "fcmEnd npl: fcmEnd > FCM_TAB_SIZE" 2 "Erf and Typ npl" 3 "fcmEnd npl: line == fcmEnd" 4 "Mem set but no entry" 5 "No Mem set but entry" 6 "Mem npl class blocked" 7 "class npl" 8 "Mil npl 1" 9 "Mil npl 2" 10 "Scatt npl" 11 "Flc npl" 12 "Hlc npl" 13 "Fcm blocked" 14 "complement npl" 15 "dpfToClear are blocked" /end COMPU_VTAB
/begin COMPU_METHOD FidName "Verbale Umrechnung für Fid-Namen" TAB_VERB "%6.3" "-" COMPU_TAB_REF FidName /end COMPU_METHOD
/begin COMPU_VTAB FidName "Verbale Umrechnung für Fid-Namen" TAB_VERB 1466 0 "Fid_unused" 4097 "Fid_ACCIRevErr_MAX" 4098 "Fid_ACCRevErr_MAX" 4099 "Fid_ACC_AliveErr_MAX" 4100 "Fid_ACC_CsErr_MAX" 4101 "Fid_ACC_TiOutErr_MAX" 4102 "Fid_ACCtl_MAX" 4103 "Fid_ACCtlDflt1_MAX" 4104 "Fid_ACCtlDflt2_MAX" 4105 "Fid_ACCtl_ACTrqErr_MAX" 4106 "Fid_ACCtl_CTSErr_MAX" 4107 "Fid_ACCtl_FanErr_MAX" 4108 "Fid_ACCtl_TGearbxErr_MAX" 4109 "Fid_ACCtl_VSSErr_MAX" 4110 "Fid_ACTrqC_MAX" 4111 "Fid_AFSCD_MAX" 4112 "Fid_AFSCD_AirPerTime_MAX" 4113 "Fid_AFSCD_PlOffsDrft_MAX" 4114 "Fid_AFSCD_PlSetyDrft_MAX" 4115 "Fid_AFSCD_SRCCorrAirm_MAX" 4116 "Fid_AFSCD_SRCDcyc_MAX" 4117 "Fid_AFSCD_SRCRawAirm_MAX" 4118 "Fid_AFSCD_SRCRefSig_MAX" 4119 "Fid_AFS_CanMon_MAX" 4120 "Fid_AFS_GenDisableCond_MAX" 4121 "Fid_AOHt_AltErr_MAX" 4122 "Fid_AOHt_ShutOffErr_MAX" 4123 "Fid_APP1_MAX" 4124 "Fid_APP2_MAX" 4125 "Fid_APPKickdown_MAX" 4126 "Fid_APSCD_MAX" 4127 "Fid_ARSOff_MAX" 4128 "Fid_ASDdc_MAX" 4129 "Fid_ASModSwtOffEng_MAX" 4130 "Fid_ASModSwtOffIndVol_MAX" 4131 "Fid_AccPed_MAX" 4132 "Fid_AccPedBrkPres_MAX" 4133 "Fid_AccPedVel_MAX" 4134 "Fid_AccPed_Brk_MAX" 4135 "Fid_AirCtl_MAX" 4136 "Fid_AirCtlNeg_MAX" 4137 "Fid_AirCtlNeg2_MAX" 4138 "Fid_AirCtlPFltEGRRed_MAX" 4139 "Fid_AirCtlPlateBreak_MAX" 4140 "Fid_AirCtlPlateBreakActv_MAX" 4141 "Fid_AirCtlPos_MAX" 4142 "Fid_AirCtlPos2_MAX" 4143 "Fid_AirCtl_Brk_MAX" 4144 "Fid_BPSCDMon_MAX" 4145 "Fid_CTSCDFlTemp_MAX" 4146 "Fid_CTSCD_Plaus_MAX" 4147 "Fid_ClgDynTst_MAX" 4148 "Fid_CmbChb_MAX" 4149 "Fid_CoDT_GripDeb_MAX" 4150 "Fid_CoEngIRevSys1_MAX" 4151 "Fid_CoEngIRevSys2_MAX" 4152 "Fid_CoEngIRevVeh_MAX" 4153 "Fid_CoEngPFltErr_MAX" 4154 "Fid_CoEngRevSys1_MAX" 4155 "Fid_CoEngRevSys2_MAX" 4156 "Fid_CoEngRevVeh_MAX" 4157 "Fid_CoEngShOffTst_MAX" 4158 "Fid_CoEngSoftShOffTV_MAX" 4159 "Fid_CoEng_ActrPrt_MAX" 4160 "Fid_CoEng_Nrml2Strt_MAX" 4161 "Fid_CoEng_PwrStgEnable_MAX" 4162 "Fid_CoEng_trqLimErr_MAX" 4163 "Fid_CoEng_trqLimErr1_MAX" 4164 "Fid_CoEng_trqLimErr2_MAX" 4165 "Fid_CoEng_trqLimErr3_MAX" 4166 "Fid_CoEng_trqLimErr4_MAX" 4167 "Fid_CoVM_StabDem_Err_MAX" 4168 "Fid_CoVehtrqLimErr_MAX" 4169 "Fid_CpBVlvOff_MAX" 4170 "Fid_CrCtlShutOffIr_MAX" 4171 "Fid_CrCtl_ASCTimeout_MAX" 4172 "Fid_CrCtl_CanDef_MAX" 4173 "Fid_CrCtl_KombiTimeout_MAX" 4174 "Fid_CrCtl_vCrCtl_MAX" 4175 "Fid_DCCIRevErr_MAX" 4176 "Fid_DCCRevErr_MAX" 4177 "Fid_DCC_AliveErr_MAX" 4178 "Fid_DCC_CsErr_MAX" 4179 "Fid_DCC_PlausErr_MAX" 4180 "Fid_DCC_TiOutErr_MAX" 4181 "Fid_DSM_Wuc_MAX" 4182 "Fid_EATSCDTSubs_MAX" 4183 "Fid_EBAFCD_MAX" 4184 "Fid_EBFCD_MAX" 4185 "Fid_ECU_MAX" 4186 "Fid_EGSysCoLSU0_MAX" 4187 "Fid_EGSysCoNSC_MAX" 4188 "Fid_EGSysCoOxi_MAX" 4189 "Fid_EGSysCoTrbn_MAX" 4190 "Fid_EGSysCoTube0_MAX" 4191 "Fid_EGSysCoTube1_MAX" 4192 "Fid_EGSysHtgDel_MAX" 4193 "Fid_EGSysNSC_MAX" 4194 "Fid_EGSysOxiCat_MAX" 4195 "Fid_EGSysPresEnv_MAX" 4196 "Fid_EGSysStrt_MAX" 4197 "Fid_EGSysTemp_MAX" 4198 "Fid_EGSysTrbn_MAX" 4199 "Fid_EGSysTube_MAX" 4200 "Fid_EGSys_AP_MAX" 4201 "Fid_EGTRgnLck_MAX" 4202 "Fid_EGTTempGvnrAirCtl_MAX" 4203 "Fid_EGTTempGvnrInr_MAX" 4204 "Fid_EGTTempGvnrOutr_MAX" 4205 "Fid_EMCCD_ShutOff_MAX" 4206 "Fid_ETClbCorActv_MAX" 4207 "Fid_EngCTSCD_MAX" 4208 "Fid_EngMCaSBackUp_MAX" 4209 "Fid_EngMCrSBackUp_MAX" 4210 "Fid_EngMTEng_MAX" 4211 "Fid_EngMTrqFrcPDiff_MAX" 4212 "Fid_EngMVVeh_MAX" 4213 "Fid_EngM_ChkStrtSpd_MAX" 4214 "Fid_EngPrt_nLimErr_MAX" 4215 "Fid_FBC_MAX" 4216 "Fid_FBCMonI_MAX" 4217 "Fid_FMASwtOff1_MAX" 4218 "Fid_FMASwtOff3_MAX" 4219 "Fid_FMTC_AirCorr_MAX" 4220 "Fid_FMTC_SOECorr_MAX" 4221 "Fid_FTSCDErr_MAX" 4222 "Fid_FWOscDet_MAX" 4223 "Fid_FanCtl_MAX" 4224 "Fid_FanGbxOil_MAX" 4225 "Fid_FlMngFullLdRglOff_MAX" 4226 "Fid_FlMngSmkDefect_MAX" 4227 "Fid_FlSysCTSSens_MAX" 4228 "Fid_FlSysDens_MAX" 4229 "Fid_FlSysFTSSens_MAX" 4230 "Fid_FrmMngAPP_MAX" 4231 "Fid_FrmMngARS_MAX" 4232 "Fid_FrmMngAddLevl_MAX" 4233 "Fid_FrmMngBrk_MAX" 4234 "Fid_FrmMngBrkDef_MAX" 4235 "Fid_FrmMngCoEng_MAX" 4236 "Fid_FrmMngCoEng_St2_MAX" 4237 "Fid_FrmMngConvDef_MAX" 4238 "Fid_FrmMngEngOvrSpd_MAX" 4239 "Fid_FrmMngEngRpmTemp_MAX" 4240 "Fid_FrmMngEngSpd_MAX" 4241 "Fid_FrmMngInjDU1_MAX" 4242 "Fid_FrmMngInjDU2_MAX" 4243 "Fid_FrmMngInjVlv_MAX" 4244 "Fid_FrmMngOBDCtl_MAX" 4245 "Fid_FrmMngPFltDef_MAX" 4246 "Fid_FrmMngParkConsumer_MAX" 4247 "Fid_FrmMngPla_DSC_MAX" 4248 "Fid_FrmMngPla_EGS_MAX" 4249 "Fid_FrmMngPowerTrainCAN_MAX" 4250 "Fid_FrmMngPwrMngLIGovSt_MAX" 4251 "Fid_FrmMngSIG_ARS_MAX" 4252 "Fid_FrmMngSIG_DSC_MAX" 4253 "Fid_FrmMngSig_EGS_MAX" 4254 "Fid_FrmMngTO_ARS_MAX" 4255 "Fid_FrmMngTO_DSC_MAX" 4256 "Fid_FrmMngTo_EGS_MAX" 4257 "Fid_FrmMngTrqGearbx_MAX" 4258 "Fid_FrmMngWaterVlv_MAX" 4259 "Fid_FrmMng_ST_TORQ_MAX" 4260 "Fid_FrmMng_stTrq_MAX" 4261 "Fid_FrmMngnSetpoint_MAX" 4262 "Fid_FrmMngpVal_MAX" 4263 "Fid_FrmMngtEng_MAX" 4264 "Fid_GearbxDrvAway_MAX" 4265 "Fid_GearbxDrvAwayInactiv_MAX" 4266 "Fid_GearbxPtCANErr_MAX" 4267 "Fid_GearbxTrqLimErr_MAX" 4268 "Fid_Gearbx_GearDet_MAX" 4269 "Fid_Gearbx_TrqIntv_Err_MAX" 4270 "Fid_GlwCtl1_MAX" 4271 "Fid_HDC_MAX" 4272 "Fid_IndSys1_MAX" 4273 "Fid_IndSys2_MAX" 4274 "Fid_InjCrvCoErr_MAX" 4275 "Fid_InjCtl_qLimErr_MAX" 4276 "Fid_InjVCDCls_MAX" 4277 "Fid_InjVlvActrTemp_MAX" 4278 "Fid_InjVlvInjLim_MAX" 4279 "Fid_InjVlvMon_MAX" 4280 "Fid_InjVlvNVC_MAX" 4281 "Fid_InjVlvSetUpVolt_MAX" 4282 "Fid_InjVlvWvCorOff_MAX" 4283 "Fid_LIGovSetpDrvAway_MAX" 4284 "Fid_LIGovSetpointDrvAwy_MAX" 4285 "Fid_LIGovUbr_MAX" 4286 "Fid_LSUCDMon0_MAX" 4287 "Fid_LSUCDO20_MAX" 4288 "Fid_LSUCDRi0_MAX" 4289 "Fid_LSUCDactiv0_MAX" 4290 "Fid_LSUCDlsu0_MAX" 4291 "Fid_LSUClbSched_MAX" 4292 "Fid_LSUCtl0_MAX" 4293 "Fid_LSUMonAllChecks_MAX" 4294 "Fid_LSUMonPlausChk_MAX" 4295 "Fid_Layer_FI_TANS_MAX" 4296 "Fid_Layer_FI_TUMG_MAX" 4297 "Fid_Layer_MANHYDR_MAX" 4298 "Fid_Layer_MANLUFT_MAX" 4299 "Fid_MSidCD_ECU_MAX" 4300 "Fid_MSidCD_Pin_MAX" 4301 "Fid_MeUnCDCalcI_MAX" 4302 "Fid_OTSCD_MAX" 4303 "Fid_PCR_MAX" 4304 "Fid_PCRBalGvnr_MAX" 4305 "Fid_PCRExtnLimActr_MAX" 4306 "Fid_PCRGvnrDvtNeg_MAX" 4307 "Fid_PCRGvnrDvtPos_MAX" 4308 "Fid_PCRLPGvnrDvtNeg_MAX" 4309 "Fid_PCRLPGvnrDvtPos_MAX" 4310 "Fid_PCRSurgeLIGov_MAX" 4311 "Fid_PCR_LP_MAX" 4312 "Fid_PCR_LPMS_MAX" 4313 "Fid_PCR_MS_MAX" 4314 "Fid_PCR_SurgeDet_MAX" 4315 "Fid_PCVCDCalcI_MAX" 4316 "Fid_PFltAshCor_MAX" 4317 "Fid_PFltAshCorRgn_MAX" 4318 "Fid_PFltBrk_MAX" 4319 "Fid_PFltChar_MAX" 4320 "Fid_PFltChngPar_MAX" 4321 "Fid_PFltClth_MAX" 4322 "Fid_PFltDiagRls1_MAX" 4323 "Fid_PFltDiagRls2_MAX" 4324 "Fid_PFltDynChk_MAX" 4325 "Fid_PFltEngPrtRgnMon_MAX" 4326 "Fid_PFltGearDet_MAX" 4327 "Fid_PFltHsLnChk_MAX" 4328 "Fid_PFltLckRgnErr_MAX" 4329 "Fid_PFltLckRgnFuel_MAX" 4330 "Fid_PFltNumPFltErr_MAX" 4331 "Fid_PFltNumPFltErrLck_MAX" 4332 "Fid_PFltPPreErr_MAX" 4333 "Fid_PFltPlausPres_MAX" 4334 "Fid_PFltPlausTemp_MAX" 4335 "Fid_PFltPresPlausProj_MAX" 4336 "Fid_PFltPresSensFrz_MAX" 4337 "Fid_PFltPresSensHsLn_MAX" 4338 "Fid_PFltSRCPres_MAX" 4339 "Fid_PFltSRCTemp_MAX" 4340 "Fid_PFltSimOn_MAX" 4341 "Fid_PFltSpdVeh_MAX" 4342 "Fid_PFltSuc_MAX" 4343 "Fid_PFltTempAir_MAX" 4344 "Fid_PFltTempClnt_MAX" 4345 "Fid_PFltTempOxiPre_MAX" 4346 "Fid_PFltTempPre_MAX" 4347 "Fid_PFltTempSensFrz_MAX" 4348 "Fid_PFltVltgBatt_MAX" 4349 "Fid_RailCDRPSErrChk_MAX" 4350 "Fid_RailCDSubstVal_MAX" 4351 "Fid_RailCD_PMonStrt_MAX" 4352 "Fid_RailCtlMode_MAX" 4353 "Fid_RailMeUn0Blk_MAX" 4354 "Fid_RailMeUn0Rls_MAX" 4355 "Fid_RailMeUn1Blk_MAX" 4356 "Fid_RailMeUn1Rls_MAX" 4357 "Fid_RailMeUn2Blk_MAX" 4358 "Fid_RailMeUn2Rls_MAX" 4359 "Fid_RailMeUn3Blk_MAX" 4360 "Fid_RailMeUn3Rls_MAX" 4361 "Fid_RailMeUn4Blk_MAX" 4362 "Fid_RailMeUn4Rls_MAX" 4363 "Fid_RailMeUnCtlMode_MAX" 4364 "Fid_RailPCV0Blk_MAX" 4365 "Fid_RailPCV0Rls_MAX" 4366 "Fid_RailPCV1Blk_MAX" 4367 "Fid_RailPCV1Rls_MAX" 4368 "Fid_RailPCV2Blk_MAX" 4369 "Fid_RailPCV2Rls_MAX" 4370 "Fid_RailPCV3Blk_MAX" 4371 "Fid_RailPCV3Rls_MAX" 4372 "Fid_RailPCV4Blk_MAX" 4373 "Fid_RailPCV4Rls_MAX" 4374 "Fid_RailPCV5Blk_MAX" 4375 "Fid_RailPCV5Rls_MAX" 4376 "Fid_RailPCVCtlMode_MAX" 4377 "Fid_RailSetPointLim_MAX" 4378 "Fid_RailSetPointRed_MAX" 4379 "Fid_ShuttrCTS_MAX" 4380 "Fid_ShuttrEGS_MAX" 4381 "Fid_SignalsTstNLim_MAX" 4382 "Fid_StSysImmo_MAX" 4383 "Fid_StSysStrtTipGbxDat_MAX" 4384 "Fid_T15CDCanError_MAX" 4385 "Fid_T50CDSig_MAX" 4386 "Fid_UsrDa_FDCOff_MAX" 4387 "Fid_VehDaDist_MAX" 4388 "Fid_ZFCClbActv_MAX" 4389 "Fid_ZFCCldCmbCham_MAX" 8193 "Fid_ACCIRevErr_MIN" 8194 "Fid_ACCRevErr_MIN" 8195 "Fid_ACC_AliveErr_MIN" 8196 "Fid_ACC_CsErr_MIN" 8197 "Fid_ACC_TiOutErr_MIN" 8198 "Fid_ACCtl_MIN" 8199 "Fid_ACCtlDflt1_MIN" 8200 "Fid_ACCtlDflt2_MIN" 8201 "Fid_ACCtl_ACTrqErr_MIN" 8202 "Fid_ACCtl_CTSErr_MIN" 8203 "Fid_ACCtl_FanErr_MIN" 8204 "Fid_ACCtl_TGearbxErr_MIN" 8205 "Fid_ACCtl_VSSErr_MIN" 8206 "Fid_ACTrqC_MIN" 8207 "Fid_AFSCD_MIN" 8208 "Fid_AFSCD_AirPerTime_MIN" 8209 "Fid_AFSCD_PlOffsDrft_MIN" 8210 "Fid_AFSCD_PlSetyDrft_MIN" 8211 "Fid_AFSCD_SRCCorrAirm_MIN" 8212 "Fid_AFSCD_SRCDcyc_MIN" 8213 "Fid_AFSCD_SRCRawAirm_MIN" 8214 "Fid_AFSCD_SRCRefSig_MIN" 8215 "Fid_AFS_CanMon_MIN" 8216 "Fid_AFS_GenDisableCond_MIN" 8217 "Fid_AOHt_AltErr_MIN" 8218 "Fid_AOHt_ShutOffErr_MIN" 8219 "Fid_APP1_MIN" 8220 "Fid_APP2_MIN" 8221 "Fid_APPKickdown_MIN" 8222 "Fid_APSCD_MIN" 8223 "Fid_ARSOff_MIN" 8224 "Fid_ASDdc_MIN" 8225 "Fid_ASModSwtOffEng_MIN" 8226 "Fid_ASModSwtOffIndVol_MIN" 8227 "Fid_AccPed_MIN" 8228 "Fid_AccPedBrkPres_MIN" 8229 "Fid_AccPedVel_MIN" 8230 "Fid_AccPed_Brk_MIN" 8231 "Fid_AirCtl_MIN" 8232 "Fid_AirCtlNeg_MIN" 8233 "Fid_AirCtlNeg2_MIN" 8234 "Fid_AirCtlPFltEGRRed_MIN" 8235 "Fid_AirCtlPlateBreak_MIN" 8236 "Fid_AirCtlPlateBreakActv_MIN" 8237 "Fid_AirCtlPos_MIN" 8238 "Fid_AirCtlPos2_MIN" 8239 "Fid_AirCtl_Brk_MIN" 8240 "Fid_BPSCDMon_MIN" 8241 "Fid_CTSCDFlTemp_MIN" 8242 "Fid_CTSCD_Plaus_MIN" 8243 "Fid_ClgDynTst_MIN" 8244 "Fid_CmbChb_MIN" 8245 "Fid_CoDT_GripDeb_MIN" 8246 "Fid_CoEngIRevSys1_MIN" 8247 "Fid_CoEngIRevSys2_MIN" 8248 "Fid_CoEngIRevVeh_MIN" 8249 "Fid_CoEngPFltErr_MIN" 8250 "Fid_CoEngRevSys1_MIN" 8251 "Fid_CoEngRevSys2_MIN" 8252 "Fid_CoEngRevVeh_MIN" 8253 "Fid_CoEngShOffTst_MIN" 8254 "Fid_CoEngSoftShOffTV_MIN" 8255 "Fid_CoEng_ActrPrt_MIN" 8256 "Fid_CoEng_Nrml2Strt_MIN" 8257 "Fid_CoEng_PwrStgEnable_MIN" 8258 "Fid_CoEng_trqLimErr_MIN" 8259 "Fid_CoEng_trqLimErr1_MIN" 8260 "Fid_CoEng_trqLimErr2_MIN" 8261 "Fid_CoEng_trqLimErr3_MIN" 8262 "Fid_CoEng_trqLimErr4_MIN" 8263 "Fid_CoVM_StabDem_Err_MIN" 8264 "Fid_CoVehtrqLimErr_MIN" 8265 "Fid_CpBVlvOff_MIN" 8266 "Fid_CrCtlShutOffIr_MIN" 8267 "Fid_CrCtl_ASCTimeout_MIN" 8268 "Fid_CrCtl_CanDef_MIN" 8269 "Fid_CrCtl_KombiTimeout_MIN" 8270 "Fid_CrCtl_vCrCtl_MIN" 8271 "Fid_DCCIRevErr_MIN" 8272 "Fid_DCCRevErr_MIN" 8273 "Fid_DCC_AliveErr_MIN" 8274 "Fid_DCC_CsErr_MIN" 8275 "Fid_DCC_PlausErr_MIN" 8276 "Fid_DCC_TiOutErr_MIN" 8277 "Fid_DSM_Wuc_MIN" 8278 "Fid_EATSCDTSubs_MIN" 8279 "Fid_EBAFCD_MIN" 8280 "Fid_EBFCD_MIN" 8281 "Fid_ECU_MIN" 8282 "Fid_EGSysCoLSU0_MIN" 8283 "Fid_EGSysCoNSC_MIN" 8284 "Fid_EGSysCoOxi_MIN" 8285 "Fid_EGSysCoTrbn_MIN" 8286 "Fid_EGSysCoTube0_MIN" 8287 "Fid_EGSysCoTube1_MIN" 8288 "Fid_EGSysHtgDel_MIN" 8289 "Fid_EGSysNSC_MIN" 8290 "Fid_EGSysOxiCat_MIN" 8291 "Fid_EGSysPresEnv_MIN" 8292 "Fid_EGSysStrt_MIN" 8293 "Fid_EGSysTemp_MIN" 8294 "Fid_EGSysTrbn_MIN" 8295 "Fid_EGSysTube_MIN" 8296 "Fid_EGSys_AP_MIN" 8297 "Fid_EGTRgnLck_MIN" 8298 "Fid_EGTTempGvnrAirCtl_MIN" 8299 "Fid_EGTTempGvnrInr_MIN" 8300 "Fid_EGTTempGvnrOutr_MIN" 8301 "Fid_EMCCD_ShutOff_MIN" 8302 "Fid_ETClbCorActv_MIN" 8303 "Fid_EngCTSCD_MIN" 8304 "Fid_EngMCaSBackUp_MIN" 8305 "Fid_EngMCrSBackUp_MIN" 8306 "Fid_EngMTEng_MIN" 8307 "Fid_EngMTrqFrcPDiff_MIN" 8308 "Fid_EngMVVeh_MIN" 8309 "Fid_EngM_ChkStrtSpd_MIN" 8310 "Fid_EngPrt_nLimErr_MIN" 8311 "Fid_FBC_MIN" 8312 "Fid_FBCMonI_MIN" 8313 "Fid_FMASwtOff1_MIN" 8314 "Fid_FMASwtOff3_MIN" 8315 "Fid_FMTC_AirCorr_MIN" 8316 "Fid_FMTC_SOECorr_MIN" 8317 "Fid_FTSCDErr_MIN" 8318 "Fid_FWOscDet_MIN" 8319 "Fid_FanCtl_MIN" 8320 "Fid_FanGbxOil_MIN" 8321 "Fid_FlMngFullLdRglOff_MIN" 8322 "Fid_FlMngSmkDefect_MIN" 8323 "Fid_FlSysCTSSens_MIN" 8324 "Fid_FlSysDens_MIN" 8325 "Fid_FlSysFTSSens_MIN" 8326 "Fid_FrmMngAPP_MIN" 8327 "Fid_FrmMngARS_MIN" 8328 "Fid_FrmMngAddLevl_MIN" 8329 "Fid_FrmMngBrk_MIN" 8330 "Fid_FrmMngBrkDef_MIN" 8331 "Fid_FrmMngCoEng_MIN" 8332 "Fid_FrmMngCoEng_St2_MIN" 8333 "Fid_FrmMngConvDef_MIN" 8334 "Fid_FrmMngEngOvrSpd_MIN" 8335 "Fid_FrmMngEngRpmTemp_MIN" 8336 "Fid_FrmMngEngSpd_MIN" 8337 "Fid_FrmMngInjDU1_MIN" 8338 "Fid_FrmMngInjDU2_MIN" 8339 "Fid_FrmMngInjVlv_MIN" 8340 "Fid_FrmMngOBDCtl_MIN" 8341 "Fid_FrmMngPFltDef_MIN" 8342 "Fid_FrmMngParkConsumer_MIN" 8343 "Fid_FrmMngPla_DSC_MIN" 8344 "Fid_FrmMngPla_EGS_MIN" 8345 "Fid_FrmMngPowerTrainCAN_MIN" 8346 "Fid_FrmMngPwrMngLIGovSt_MIN" 8347 "Fid_FrmMngSIG_ARS_MIN" 8348 "Fid_FrmMngSIG_DSC_MIN" 8349 "Fid_FrmMngSig_EGS_MIN" 8350 "Fid_FrmMngTO_ARS_MIN" 8351 "Fid_FrmMngTO_DSC_MIN" 8352 "Fid_FrmMngTo_EGS_MIN" 8353 "Fid_FrmMngTrqGearbx_MIN" 8354 "Fid_FrmMngWaterVlv_MIN" 8355 "Fid_FrmMng_ST_TORQ_MIN" 8356 "Fid_FrmMng_stTrq_MIN" 8357 "Fid_FrmMngnSetpoint_MIN" 8358 "Fid_FrmMngpVal_MIN" 8359 "Fid_FrmMngtEng_MIN" 8360 "Fid_GearbxDrvAway_MIN" 8361 "Fid_GearbxDrvAwayInactiv_MIN" 8362 "Fid_GearbxPtCANErr_MIN" 8363 "Fid_GearbxTrqLimErr_MIN" 8364 "Fid_Gearbx_GearDet_MIN" 8365 "Fid_Gearbx_TrqIntv_Err_MIN" 8366 "Fid_GlwCtl1_MIN" 8367 "Fid_HDC_MIN" 8368 "Fid_IndSys1_MIN" 8369 "Fid_IndSys2_MIN" 8370 "Fid_InjCrvCoErr_MIN" 8371 "Fid_InjCtl_qLimErr_MIN" 8372 "Fid_InjVCDCls_MIN" 8373 "Fid_InjVlvActrTemp_MIN" 8374 "Fid_InjVlvInjLim_MIN" 8375 "Fid_InjVlvMon_MIN" 8376 "Fid_InjVlvNVC_MIN" 8377 "Fid_InjVlvSetUpVolt_MIN" 8378 "Fid_InjVlvWvCorOff_MIN" 8379 "Fid_LIGovSetpDrvAway_MIN" 8380 "Fid_LIGovSetpointDrvAwy_MIN" 8381 "Fid_LIGovUbr_MIN" 8382 "Fid_LSUCDMon0_MIN" 8383 "Fid_LSUCDO20_MIN" 8384 "Fid_LSUCDRi0_MIN" 8385 "Fid_LSUCDactiv0_MIN" 8386 "Fid_LSUCDlsu0_MIN" 8387 "Fid_LSUClbSched_MIN" 8388 "Fid_LSUCtl0_MIN" 8389 "Fid_LSUMonAllChecks_MIN" 8390 "Fid_LSUMonPlausChk_MIN" 8391 "Fid_Layer_FI_TANS_MIN" 8392 "Fid_Layer_FI_TUMG_MIN" 8393 "Fid_Layer_MANHYDR_MIN" 8394 "Fid_Layer_MANLUFT_MIN" 8395 "Fid_MSidCD_ECU_MIN" 8396 "Fid_MSidCD_Pin_MIN" 8397 "Fid_MeUnCDCalcI_MIN" 8398 "Fid_OTSCD_MIN" 8399 "Fid_PCR_MIN" 8400 "Fid_PCRBalGvnr_MIN" 8401 "Fid_PCRExtnLimActr_MIN" 8402 "Fid_PCRGvnrDvtNeg_MIN" 8403 "Fid_PCRGvnrDvtPos_MIN" 8404 "Fid_PCRLPGvnrDvtNeg_MIN" 8405 "Fid_PCRLPGvnrDvtPos_MIN" 8406 "Fid_PCRSurgeLIGov_MIN" 8407 "Fid_PCR_LP_MIN" 8408 "Fid_PCR_LPMS_MIN" 8409 "Fid_PCR_MS_MIN" 8410 "Fid_PCR_SurgeDet_MIN" 8411 "Fid_PCVCDCalcI_MIN" 8412 "Fid_PFltAshCor_MIN" 8413 "Fid_PFltAshCorRgn_MIN" 8414 "Fid_PFltBrk_MIN" 8415 "Fid_PFltChar_MIN" 8416 "Fid_PFltChngPar_MIN" 8417 "Fid_PFltClth_MIN" 8418 "Fid_PFltDiagRls1_MIN" 8419 "Fid_PFltDiagRls2_MIN" 8420 "Fid_PFltDynChk_MIN" 8421 "Fid_PFltEngPrtRgnMon_MIN" 8422 "Fid_PFltGearDet_MIN" 8423 "Fid_PFltHsLnChk_MIN" 8424 "Fid_PFltLckRgnErr_MIN" 8425 "Fid_PFltLckRgnFuel_MIN" 8426 "Fid_PFltNumPFltErr_MIN" 8427 "Fid_PFltNumPFltErrLck_MIN" 8428 "Fid_PFltPPreErr_MIN" 8429 "Fid_PFltPlausPres_MIN" 8430 "Fid_PFltPlausTemp_MIN" 8431 "Fid_PFltPresPlausProj_MIN" 8432 "Fid_PFltPresSensFrz_MIN" 8433 "Fid_PFltPresSensHsLn_MIN" 8434 "Fid_PFltSRCPres_MIN" 8435 "Fid_PFltSRCTemp_MIN" 8436 "Fid_PFltSimOn_MIN" 8437 "Fid_PFltSpdVeh_MIN" 8438 "Fid_PFltSuc_MIN" 8439 "Fid_PFltTempAir_MIN" 8440 "Fid_PFltTempClnt_MIN" 8441 "Fid_PFltTempOxiPre_MIN" 8442 "Fid_PFltTempPre_MIN" 8443 "Fid_PFltTempSensFrz_MIN" 8444 "Fid_PFltVltgBatt_MIN" 8445 "Fid_RailCDRPSErrChk_MIN" 8446 "Fid_RailCDSubstVal_MIN" 8447 "Fid_RailCD_PMonStrt_MIN" 8448 "Fid_RailCtlMode_MIN" 8449 "Fid_RailMeUn0Blk_MIN" 8450 "Fid_RailMeUn0Rls_MIN" 8451 "Fid_RailMeUn1Blk_MIN" 8452 "Fid_RailMeUn1Rls_MIN" 8453 "Fid_RailMeUn2Blk_MIN" 8454 "Fid_RailMeUn2Rls_MIN" 8455 "Fid_RailMeUn3Blk_MIN" 8456 "Fid_RailMeUn3Rls_MIN" 8457 "Fid_RailMeUn4Blk_MIN" 8458 "Fid_RailMeUn4Rls_MIN" 8459 "Fid_RailMeUnCtlMode_MIN" 8460 "Fid_RailPCV0Blk_MIN" 8461 "Fid_RailPCV0Rls_MIN" 8462 "Fid_RailPCV1Blk_MIN" 8463 "Fid_RailPCV1Rls_MIN" 8464 "Fid_RailPCV2Blk_MIN" 8465 "Fid_RailPCV2Rls_MIN" 8466 "Fid_RailPCV3Blk_MIN" 8467 "Fid_RailPCV3Rls_MIN" 8468 "Fid_RailPCV4Blk_MIN" 8469 "Fid_RailPCV4Rls_MIN" 8470 "Fid_RailPCV5Blk_MIN" 8471 "Fid_RailPCV5Rls_MIN" 8472 "Fid_RailPCVCtlMode_MIN" 8473 "Fid_RailSetPointLim_MIN" 8474 "Fid_RailSetPointRed_MIN" 8475 "Fid_ShuttrCTS_MIN" 8476 "Fid_ShuttrEGS_MIN" 8477 "Fid_SignalsTstNLim_MIN" 8478 "Fid_StSysImmo_MIN" 8479 "Fid_StSysStrtTipGbxDat_MIN" 8480 "Fid_T15CDCanError_MIN" 8481 "Fid_T50CDSig_MIN" 8482 "Fid_UsrDa_FDCOff_MIN" 8483 "Fid_VehDaDist_MIN" 8484 "Fid_ZFCClbActv_MIN" 8485 "Fid_ZFCCldCmbCham_MIN" 16385 "Fid_ACCIRevErr_SIG" 16386 "Fid_ACCRevErr_SIG" 16387 "Fid_ACC_AliveErr_SIG" 16388 "Fid_ACC_CsErr_SIG" 16389 "Fid_ACC_TiOutErr_SIG" 16390 "Fid_ACCtl_SIG" 16391 "Fid_ACCtlDflt1_SIG" 16392 "Fid_ACCtlDflt2_SIG" 16393 "Fid_ACCtl_ACTrqErr_SIG" 16394 "Fid_ACCtl_CTSErr_SIG" 16395 "Fid_ACCtl_FanErr_SIG" 16396 "Fid_ACCtl_TGearbxErr_SIG" 16397 "Fid_ACCtl_VSSErr_SIG" 16398 "Fid_ACTrqC_SIG" 16399 "Fid_AFSCD_SIG" 16400 "Fid_AFSCD_AirPerTime_SIG" 16401 "Fid_AFSCD_PlOffsDrft_SIG" 16402 "Fid_AFSCD_PlSetyDrft_SIG" 16403 "Fid_AFSCD_SRCCorrAirm_SIG" 16404 "Fid_AFSCD_SRCDcyc_SIG" 16405 "Fid_AFSCD_SRCRawAirm_SIG" 16406 "Fid_AFSCD_SRCRefSig_SIG" 16407 "Fid_AFS_CanMon_SIG" 16408 "Fid_AFS_GenDisableCond_SIG" 16409 "Fid_AOHt_AltErr_SIG" 16410 "Fid_AOHt_ShutOffErr_SIG" 16411 "Fid_APP1_SIG" 16412 "Fid_APP2_SIG" 16413 "Fid_APPKickdown_SIG" 16414 "Fid_APSCD_SIG" 16415 "Fid_ARSOff_SIG" 16416 "Fid_ASDdc_SIG" 16417 "Fid_ASModSwtOffEng_SIG" 16418 "Fid_ASModSwtOffIndVol_SIG" 16419 "Fid_AccPed_SIG" 16420 "Fid_AccPedBrkPres_SIG" 16421 "Fid_AccPedVel_SIG" 16422 "Fid_AccPed_Brk_SIG" 16423 "Fid_AirCtl_SIG" 16424 "Fid_AirCtlNeg_SIG" 16425 "Fid_AirCtlNeg2_SIG" 16426 "Fid_AirCtlPFltEGRRed_SIG" 16427 "Fid_AirCtlPlateBreak_SIG" 16428 "Fid_AirCtlPlateBreakActv_SIG" 16429 "Fid_AirCtlPos_SIG" 16430 "Fid_AirCtlPos2_SIG" 16431 "Fid_AirCtl_Brk_SIG" 16432 "Fid_BPSCDMon_SIG" 16433 "Fid_CTSCDFlTemp_SIG" 16434 "Fid_CTSCD_Plaus_SIG" 16435 "Fid_ClgDynTst_SIG" 16436 "Fid_CmbChb_SIG" 16437 "Fid_CoDT_GripDeb_SIG" 16438 "Fid_CoEngIRevSys1_SIG" 16439 "Fid_CoEngIRevSys2_SIG" 16440 "Fid_CoEngIRevVeh_SIG" 16441 "Fid_CoEngPFltErr_SIG" 16442 "Fid_CoEngRevSys1_SIG" 16443 "Fid_CoEngRevSys2_SIG" 16444 "Fid_CoEngRevVeh_SIG" 16445 "Fid_CoEngShOffTst_SIG" 16446 "Fid_CoEngSoftShOffTV_SIG" 16447 "Fid_CoEng_ActrPrt_SIG" 16448 "Fid_CoEng_Nrml2Strt_SIG" 16449 "Fid_CoEng_PwrStgEnable_SIG" 16450 "Fid_CoEng_trqLimErr_SIG" 16451 "Fid_CoEng_trqLimErr1_SIG" 16452 "Fid_CoEng_trqLimErr2_SIG" 16453 "Fid_CoEng_trqLimErr3_SIG" 16454 "Fid_CoEng_trqLimErr4_SIG" 16455 "Fid_CoVM_StabDem_Err_SIG" 16456 "Fid_CoVehtrqLimErr_SIG" 16457 "Fid_CpBVlvOff_SIG" 16458 "Fid_CrCtlShutOffIr_SIG" 16459 "Fid_CrCtl_ASCTimeout_SIG" 16460 "Fid_CrCtl_CanDef_SIG" 16461 "Fid_CrCtl_KombiTimeout_SIG" 16462 "Fid_CrCtl_vCrCtl_SIG" 16463 "Fid_DCCIRevErr_SIG" 16464 "Fid_DCCRevErr_SIG" 16465 "Fid_DCC_AliveErr_SIG" 16466 "Fid_DCC_CsErr_SIG" 16467 "Fid_DCC_PlausErr_SIG" 16468 "Fid_DCC_TiOutErr_SIG" 16469 "Fid_DSM_Wuc_SIG" 16470 "Fid_EATSCDTSubs_SIG" 16471 "Fid_EBAFCD_SIG" 16472 "Fid_EBFCD_SIG" 16473 "Fid_ECU_SIG" 16474 "Fid_EGSysCoLSU0_SIG" 16475 "Fid_EGSysCoNSC_SIG" 16476 "Fid_EGSysCoOxi_SIG" 16477 "Fid_EGSysCoTrbn_SIG" 16478 "Fid_EGSysCoTube0_SIG" 16479 "Fid_EGSysCoTube1_SIG" 16480 "Fid_EGSysHtgDel_SIG" 16481 "Fid_EGSysNSC_SIG" 16482 "Fid_EGSysOxiCat_SIG" 16483 "Fid_EGSysPresEnv_SIG" 16484 "Fid_EGSysStrt_SIG" 16485 "Fid_EGSysTemp_SIG" 16486 "Fid_EGSysTrbn_SIG" 16487 "Fid_EGSysTube_SIG" 16488 "Fid_EGSys_AP_SIG" 16489 "Fid_EGTRgnLck_SIG" 16490 "Fid_EGTTempGvnrAirCtl_SIG" 16491 "Fid_EGTTempGvnrInr_SIG" 16492 "Fid_EGTTempGvnrOutr_SIG" 16493 "Fid_EMCCD_ShutOff_SIG" 16494 "Fid_ETClbCorActv_SIG" 16495 "Fid_EngCTSCD_SIG" 16496 "Fid_EngMCaSBackUp_SIG" 16497 "Fid_EngMCrSBackUp_SIG" 16498 "Fid_EngMTEng_SIG" 16499 "Fid_EngMTrqFrcPDiff_SIG" 16500 "Fid_EngMVVeh_SIG" 16501 "Fid_EngM_ChkStrtSpd_SIG" 16502 "Fid_EngPrt_nLimErr_SIG" 16503 "Fid_FBC_SIG" 16504 "Fid_FBCMonI_SIG" 16505 "Fid_FMASwtOff1_SIG" 16506 "Fid_FMASwtOff3_SIG" 16507 "Fid_FMTC_AirCorr_SIG" 16508 "Fid_FMTC_SOECorr_SIG" 16509 "Fid_FTSCDErr_SIG" 16510 "Fid_FWOscDet_SIG" 16511 "Fid_FanCtl_SIG" 16512 "Fid_FanGbxOil_SIG" 16513 "Fid_FlMngFullLdRglOff_SIG" 16514 "Fid_FlMngSmkDefect_SIG" 16515 "Fid_FlSysCTSSens_SIG" 16516 "Fid_FlSysDens_SIG" 16517 "Fid_FlSysFTSSens_SIG" 16518 "Fid_FrmMngAPP_SIG" 16519 "Fid_FrmMngARS_SIG" 16520 "Fid_FrmMngAddLevl_SIG" 16521 "Fid_FrmMngBrk_SIG" 16522 "Fid_FrmMngBrkDef_SIG" 16523 "Fid_FrmMngCoEng_SIG" 16524 "Fid_FrmMngCoEng_St2_SIG" 16525 "Fid_FrmMngConvDef_SIG" 16526 "Fid_FrmMngEngOvrSpd_SIG" 16527 "Fid_FrmMngEngRpmTemp_SIG" 16528 "Fid_FrmMngEngSpd_SIG" 16529 "Fid_FrmMngInjDU1_SIG" 16530 "Fid_FrmMngInjDU2_SIG" 16531 "Fid_FrmMngInjVlv_SIG" 16532 "Fid_FrmMngOBDCtl_SIG" 16533 "Fid_FrmMngPFltDef_SIG" 16534 "Fid_FrmMngParkConsumer_SIG" 16535 "Fid_FrmMngPla_DSC_SIG" 16536 "Fid_FrmMngPla_EGS_SIG" 16537 "Fid_FrmMngPowerTrainCAN_SIG" 16538 "Fid_FrmMngPwrMngLIGovSt_SIG" 16539 "Fid_FrmMngSIG_ARS_SIG" 16540 "Fid_FrmMngSIG_DSC_SIG" 16541 "Fid_FrmMngSig_EGS_SIG" 16542 "Fid_FrmMngTO_ARS_SIG" 16543 "Fid_FrmMngTO_DSC_SIG" 16544 "Fid_FrmMngTo_EGS_SIG" 16545 "Fid_FrmMngTrqGearbx_SIG" 16546 "Fid_FrmMngWaterVlv_SIG" 16547 "Fid_FrmMng_ST_TORQ_SIG" 16548 "Fid_FrmMng_stTrq_SIG" 16549 "Fid_FrmMngnSetpoint_SIG" 16550 "Fid_FrmMngpVal_SIG" 16551 "Fid_FrmMngtEng_SIG" 16552 "Fid_GearbxDrvAway_SIG" 16553 "Fid_GearbxDrvAwayInactiv_SIG" 16554 "Fid_GearbxPtCANErr_SIG" 16555 "Fid_GearbxTrqLimErr_SIG" 16556 "Fid_Gearbx_GearDet_SIG" 16557 "Fid_Gearbx_TrqIntv_Err_SIG" 16558 "Fid_GlwCtl1_SIG" 16559 "Fid_HDC_SIG" 16560 "Fid_IndSys1_SIG" 16561 "Fid_IndSys2_SIG" 16562 "Fid_InjCrvCoErr_SIG" 16563 "Fid_InjCtl_qLimErr_SIG" 16564 "Fid_InjVCDCls_SIG" 16565 "Fid_InjVlvActrTemp_SIG" 16566 "Fid_InjVlvInjLim_SIG" 16567 "Fid_InjVlvMon_SIG" 16568 "Fid_InjVlvNVC_SIG" 16569 "Fid_InjVlvSetUpVolt_SIG" 16570 "Fid_InjVlvWvCorOff_SIG" 16571 "Fid_LIGovSetpDrvAway_SIG" 16572 "Fid_LIGovSetpointDrvAwy_SIG" 16573 "Fid_LIGovUbr_SIG" 16574 "Fid_LSUCDMon0_SIG" 16575 "Fid_LSUCDO20_SIG" 16576 "Fid_LSUCDRi0_SIG" 16577 "Fid_LSUCDactiv0_SIG" 16578 "Fid_LSUCDlsu0_SIG" 16579 "Fid_LSUClbSched_SIG" 16580 "Fid_LSUCtl0_SIG" 16581 "Fid_LSUMonAllChecks_SIG" 16582 "Fid_LSUMonPlausChk_SIG" 16583 "Fid_Layer_FI_TANS_SIG" 16584 "Fid_Layer_FI_TUMG_SIG" 16585 "Fid_Layer_MANHYDR_SIG" 16586 "Fid_Layer_MANLUFT_SIG" 16587 "Fid_MSidCD_ECU_SIG" 16588 "Fid_MSidCD_Pin_SIG" 16589 "Fid_MeUnCDCalcI_SIG" 16590 "Fid_OTSCD_SIG" 16591 "Fid_PCR_SIG" 16592 "Fid_PCRBalGvnr_SIG" 16593 "Fid_PCRExtnLimActr_SIG" 16594 "Fid_PCRGvnrDvtNeg_SIG" 16595 "Fid_PCRGvnrDvtPos_SIG" 16596 "Fid_PCRLPGvnrDvtNeg_SIG" 16597 "Fid_PCRLPGvnrDvtPos_SIG" 16598 "Fid_PCRSurgeLIGov_SIG" 16599 "Fid_PCR_LP_SIG" 16600 "Fid_PCR_LPMS_SIG" 16601 "Fid_PCR_MS_SIG" 16602 "Fid_PCR_SurgeDet_SIG" 16603 "Fid_PCVCDCalcI_SIG" 16604 "Fid_PFltAshCor_SIG" 16605 "Fid_PFltAshCorRgn_SIG" 16606 "Fid_PFltBrk_SIG" 16607 "Fid_PFltChar_SIG" 16608 "Fid_PFltChngPar_SIG" 16609 "Fid_PFltClth_SIG" 16610 "Fid_PFltDiagRls1_SIG" 16611 "Fid_PFltDiagRls2_SIG" 16612 "Fid_PFltDynChk_SIG" 16613 "Fid_PFltEngPrtRgnMon_SIG" 16614 "Fid_PFltGearDet_SIG" 16615 "Fid_PFltHsLnChk_SIG" 16616 "Fid_PFltLckRgnErr_SIG" 16617 "Fid_PFltLckRgnFuel_SIG" 16618 "Fid_PFltNumPFltErr_SIG" 16619 "Fid_PFltNumPFltErrLck_SIG" 16620 "Fid_PFltPPreErr_SIG" 16621 "Fid_PFltPlausPres_SIG" 16622 "Fid_PFltPlausTemp_SIG" 16623 "Fid_PFltPresPlausProj_SIG" 16624 "Fid_PFltPresSensFrz_SIG" 16625 "Fid_PFltPresSensHsLn_SIG" 16626 "Fid_PFltSRCPres_SIG" 16627 "Fid_PFltSRCTemp_SIG" 16628 "Fid_PFltSimOn_SIG" 16629 "Fid_PFltSpdVeh_SIG" 16630 "Fid_PFltSuc_SIG" 16631 "Fid_PFltTempAir_SIG" 16632 "Fid_PFltTempClnt_SIG" 16633 "Fid_PFltTempOxiPre_SIG" 16634 "Fid_PFltTempPre_SIG" 16635 "Fid_PFltTempSensFrz_SIG" 16636 "Fid_PFltVltgBatt_SIG" 16637 "Fid_RailCDRPSErrChk_SIG" 16638 "Fid_RailCDSubstVal_SIG" 16639 "Fid_RailCD_PMonStrt_SIG" 16640 "Fid_RailCtlMode_SIG" 16641 "Fid_RailMeUn0Blk_SIG" 16642 "Fid_RailMeUn0Rls_SIG" 16643 "Fid_RailMeUn1Blk_SIG" 16644 "Fid_RailMeUn1Rls_SIG" 16645 "Fid_RailMeUn2Blk_SIG" 16646 "Fid_RailMeUn2Rls_SIG" 16647 "Fid_RailMeUn3Blk_SIG" 16648 "Fid_RailMeUn3Rls_SIG" 16649 "Fid_RailMeUn4Blk_SIG" 16650 "Fid_RailMeUn4Rls_SIG" 16651 "Fid_RailMeUnCtlMode_SIG" 16652 "Fid_RailPCV0Blk_SIG" 16653 "Fid_RailPCV0Rls_SIG" 16654 "Fid_RailPCV1Blk_SIG" 16655 "Fid_RailPCV1Rls_SIG" 16656 "Fid_RailPCV2Blk_SIG" 16657 "Fid_RailPCV2Rls_SIG" 16658 "Fid_RailPCV3Blk_SIG" 16659 "Fid_RailPCV3Rls_SIG" 16660 "Fid_RailPCV4Blk_SIG" 16661 "Fid_RailPCV4Rls_SIG" 16662 "Fid_RailPCV5Blk_SIG" 16663 "Fid_RailPCV5Rls_SIG" 16664 "Fid_RailPCVCtlMode_SIG" 16665 "Fid_RailSetPointLim_SIG" 16666 "Fid_RailSetPointRed_SIG" 16667 "Fid_ShuttrCTS_SIG" 16668 "Fid_ShuttrEGS_SIG" 16669 "Fid_SignalsTstNLim_SIG" 16670 "Fid_StSysImmo_SIG" 16671 "Fid_StSysStrtTipGbxDat_SIG" 16672 "Fid_T15CDCanError_SIG" 16673 "Fid_T50CDSig_SIG" 16674 "Fid_UsrDa_FDCOff_SIG" 16675 "Fid_VehDaDist_SIG" 16676 "Fid_ZFCClbActv_SIG" 16677 "Fid_ZFCCldCmbCham_SIG" 32769 "Fid_ACCIRevErr_NPL" 32770 "Fid_ACCRevErr_NPL" 32771 "Fid_ACC_AliveErr_NPL" 32772 "Fid_ACC_CsErr_NPL" 32773 "Fid_ACC_TiOutErr_NPL" 32774 "Fid_ACCtl_NPL" 32775 "Fid_ACCtlDflt1_NPL" 32776 "Fid_ACCtlDflt2_NPL" 32777 "Fid_ACCtl_ACTrqErr_NPL" 32778 "Fid_ACCtl_CTSErr_NPL" 32779 "Fid_ACCtl_FanErr_NPL" 32780 "Fid_ACCtl_TGearbxErr_NPL" 32781 "Fid_ACCtl_VSSErr_NPL" 32782 "Fid_ACTrqC_NPL" 32783 "Fid_AFSCD_NPL" 32784 "Fid_AFSCD_AirPerTime_NPL" 32785 "Fid_AFSCD_PlOffsDrft_NPL" 32786 "Fid_AFSCD_PlSetyDrft_NPL" 32787 "Fid_AFSCD_SRCCorrAirm_NPL" 32788 "Fid_AFSCD_SRCDcyc_NPL" 32789 "Fid_AFSCD_SRCRawAirm_NPL" 32790 "Fid_AFSCD_SRCRefSig_NPL" 32791 "Fid_AFS_CanMon_NPL" 32792 "Fid_AFS_GenDisableCond_NPL" 32793 "Fid_AOHt_AltErr_NPL" 32794 "Fid_AOHt_ShutOffErr_NPL" 32795 "Fid_APP1_NPL" 32796 "Fid_APP2_NPL" 32797 "Fid_APPKickdown_NPL" 32798 "Fid_APSCD_NPL" 32799 "Fid_ARSOff_NPL" 32800 "Fid_ASDdc_NPL" 32801 "Fid_ASModSwtOffEng_NPL" 32802 "Fid_ASModSwtOffIndVol_NPL" 32803 "Fid_AccPed_NPL" 32804 "Fid_AccPedBrkPres_NPL" 32805 "Fid_AccPedVel_NPL" 32806 "Fid_AccPed_Brk_NPL" 32807 "Fid_AirCtl_NPL" 32808 "Fid_AirCtlNeg_NPL" 32809 "Fid_AirCtlNeg2_NPL" 32810 "Fid_AirCtlPFltEGRRed_NPL" 32811 "Fid_AirCtlPlateBreak_NPL" 32812 "Fid_AirCtlPlateBreakActv_NPL" 32813 "Fid_AirCtlPos_NPL" 32814 "Fid_AirCtlPos2_NPL" 32815 "Fid_AirCtl_Brk_NPL" 32816 "Fid_BPSCDMon_NPL" 32817 "Fid_CTSCDFlTemp_NPL" 32818 "Fid_CTSCD_Plaus_NPL" 32819 "Fid_ClgDynTst_NPL" 32820 "Fid_CmbChb_NPL" 32821 "Fid_CoDT_GripDeb_NPL" 32822 "Fid_CoEngIRevSys1_NPL" 32823 "Fid_CoEngIRevSys2_NPL" 32824 "Fid_CoEngIRevVeh_NPL" 32825 "Fid_CoEngPFltErr_NPL" 32826 "Fid_CoEngRevSys1_NPL" 32827 "Fid_CoEngRevSys2_NPL" 32828 "Fid_CoEngRevVeh_NPL" 32829 "Fid_CoEngShOffTst_NPL" 32830 "Fid_CoEngSoftShOffTV_NPL" 32831 "Fid_CoEng_ActrPrt_NPL" 32832 "Fid_CoEng_Nrml2Strt_NPL" 32833 "Fid_CoEng_PwrStgEnable_NPL" 32834 "Fid_CoEng_trqLimErr_NPL" 32835 "Fid_CoEng_trqLimErr1_NPL" 32836 "Fid_CoEng_trqLimErr2_NPL" 32837 "Fid_CoEng_trqLimErr3_NPL" 32838 "Fid_CoEng_trqLimErr4_NPL" 32839 "Fid_CoVM_StabDem_Err_NPL" 32840 "Fid_CoVehtrqLimErr_NPL" 32841 "Fid_CpBVlvOff_NPL" 32842 "Fid_CrCtlShutOffIr_NPL" 32843 "Fid_CrCtl_ASCTimeout_NPL" 32844 "Fid_CrCtl_CanDef_NPL" 32845 "Fid_CrCtl_KombiTimeout_NPL" 32846 "Fid_CrCtl_vCrCtl_NPL" 32847 "Fid_DCCIRevErr_NPL" 32848 "Fid_DCCRevErr_NPL" 32849 "Fid_DCC_AliveErr_NPL" 32850 "Fid_DCC_CsErr_NPL" 32851 "Fid_DCC_PlausErr_NPL" 32852 "Fid_DCC_TiOutErr_NPL" 32853 "Fid_DSM_Wuc_NPL" 32854 "Fid_EATSCDTSubs_NPL" 32855 "Fid_EBAFCD_NPL" 32856 "Fid_EBFCD_NPL" 32857 "Fid_ECU_NPL" 32858 "Fid_EGSysCoLSU0_NPL" 32859 "Fid_EGSysCoNSC_NPL" 32860 "Fid_EGSysCoOxi_NPL" 32861 "Fid_EGSysCoTrbn_NPL" 32862 "Fid_EGSysCoTube0_NPL" 32863 "Fid_EGSysCoTube1_NPL" 32864 "Fid_EGSysHtgDel_NPL" 32865 "Fid_EGSysNSC_NPL" 32866 "Fid_EGSysOxiCat_NPL" 32867 "Fid_EGSysPresEnv_NPL" 32868 "Fid_EGSysStrt_NPL" 32869 "Fid_EGSysTemp_NPL" 32870 "Fid_EGSysTrbn_NPL" 32871 "Fid_EGSysTube_NPL" 32872 "Fid_EGSys_AP_NPL" 32873 "Fid_EGTRgnLck_NPL" 32874 "Fid_EGTTempGvnrAirCtl_NPL" 32875 "Fid_EGTTempGvnrInr_NPL" 32876 "Fid_EGTTempGvnrOutr_NPL" 32877 "Fid_EMCCD_ShutOff_NPL" 32878 "Fid_ETClbCorActv_NPL" 32879 "Fid_EngCTSCD_NPL" 32880 "Fid_EngMCaSBackUp_NPL" 32881 "Fid_EngMCrSBackUp_NPL" 32882 "Fid_EngMTEng_NPL" 32883 "Fid_EngMTrqFrcPDiff_NPL" 32884 "Fid_EngMVVeh_NPL" 32885 "Fid_EngM_ChkStrtSpd_NPL" 32886 "Fid_EngPrt_nLimErr_NPL" 32887 "Fid_FBC_NPL" 32888 "Fid_FBCMonI_NPL" 32889 "Fid_FMASwtOff1_NPL" 32890 "Fid_FMASwtOff3_NPL" 32891 "Fid_FMTC_AirCorr_NPL" 32892 "Fid_FMTC_SOECorr_NPL" 32893 "Fid_FTSCDErr_NPL" 32894 "Fid_FWOscDet_NPL" 32895 "Fid_FanCtl_NPL" 32896 "Fid_FanGbxOil_NPL" 32897 "Fid_FlMngFullLdRglOff_NPL" 32898 "Fid_FlMngSmkDefect_NPL" 32899 "Fid_FlSysCTSSens_NPL" 32900 "Fid_FlSysDens_NPL" 32901 "Fid_FlSysFTSSens_NPL" 32902 "Fid_FrmMngAPP_NPL" 32903 "Fid_FrmMngARS_NPL" 32904 "Fid_FrmMngAddLevl_NPL" 32905 "Fid_FrmMngBrk_NPL" 32906 "Fid_FrmMngBrkDef_NPL" 32907 "Fid_FrmMngCoEng_NPL" 32908 "Fid_FrmMngCoEng_St2_NPL" 32909 "Fid_FrmMngConvDef_NPL" 32910 "Fid_FrmMngEngOvrSpd_NPL" 32911 "Fid_FrmMngEngRpmTemp_NPL" 32912 "Fid_FrmMngEngSpd_NPL" 32913 "Fid_FrmMngInjDU1_NPL" 32914 "Fid_FrmMngInjDU2_NPL" 32915 "Fid_FrmMngInjVlv_NPL" 32916 "Fid_FrmMngOBDCtl_NPL" 32917 "Fid_FrmMngPFltDef_NPL" 32918 "Fid_FrmMngParkConsumer_NPL" 32919 "Fid_FrmMngPla_DSC_NPL" 32920 "Fid_FrmMngPla_EGS_NPL" 32921 "Fid_FrmMngPowerTrainCAN_NPL" 32922 "Fid_FrmMngPwrMngLIGovSt_NPL" 32923 "Fid_FrmMngSIG_ARS_NPL" 32924 "Fid_FrmMngSIG_DSC_NPL" 32925 "Fid_FrmMngSig_EGS_NPL" 32926 "Fid_FrmMngTO_ARS_NPL" 32927 "Fid_FrmMngTO_DSC_NPL" 32928 "Fid_FrmMngTo_EGS_NPL" 32929 "Fid_FrmMngTrqGearbx_NPL" 32930 "Fid_FrmMngWaterVlv_NPL" 32931 "Fid_FrmMng_ST_TORQ_NPL" 32932 "Fid_FrmMng_stTrq_NPL" 32933 "Fid_FrmMngnSetpoint_NPL" 32934 "Fid_FrmMngpVal_NPL" 32935 "Fid_FrmMngtEng_NPL" 32936 "Fid_GearbxDrvAway_NPL" 32937 "Fid_GearbxDrvAwayInactiv_NPL" 32938 "Fid_GearbxPtCANErr_NPL" 32939 "Fid_GearbxTrqLimErr_NPL" 32940 "Fid_Gearbx_GearDet_NPL" 32941 "Fid_Gearbx_TrqIntv_Err_NPL" 32942 "Fid_GlwCtl1_NPL" 32943 "Fid_HDC_NPL" 32944 "Fid_IndSys1_NPL" 32945 "Fid_IndSys2_NPL" 32946 "Fid_InjCrvCoErr_NPL" 32947 "Fid_InjCtl_qLimErr_NPL" 32948 "Fid_InjVCDCls_NPL" 32949 "Fid_InjVlvActrTemp_NPL" 32950 "Fid_InjVlvInjLim_NPL" 32951 "Fid_InjVlvMon_NPL" 32952 "Fid_InjVlvNVC_NPL" 32953 "Fid_InjVlvSetUpVolt_NPL" 32954 "Fid_InjVlvWvCorOff_NPL" 32955 "Fid_LIGovSetpDrvAway_NPL" 32956 "Fid_LIGovSetpointDrvAwy_NPL" 32957 "Fid_LIGovUbr_NPL" 32958 "Fid_LSUCDMon0_NPL" 32959 "Fid_LSUCDO20_NPL" 32960 "Fid_LSUCDRi0_NPL" 32961 "Fid_LSUCDactiv0_NPL" 32962 "Fid_LSUCDlsu0_NPL" 32963 "Fid_LSUClbSched_NPL" 32964 "Fid_LSUCtl0_NPL" 32965 "Fid_LSUMonAllChecks_NPL" 32966 "Fid_LSUMonPlausChk_NPL" 32967 "Fid_Layer_FI_TANS_NPL" 32968 "Fid_Layer_FI_TUMG_NPL" 32969 "Fid_Layer_MANHYDR_NPL" 32970 "Fid_Layer_MANLUFT_NPL" 32971 "Fid_MSidCD_ECU_NPL" 32972 "Fid_MSidCD_Pin_NPL" 32973 "Fid_MeUnCDCalcI_NPL" 32974 "Fid_OTSCD_NPL" 32975 "Fid_PCR_NPL" 32976 "Fid_PCRBalGvnr_NPL" 32977 "Fid_PCRExtnLimActr_NPL" 32978 "Fid_PCRGvnrDvtNeg_NPL" 32979 "Fid_PCRGvnrDvtPos_NPL" 32980 "Fid_PCRLPGvnrDvtNeg_NPL" 32981 "Fid_PCRLPGvnrDvtPos_NPL" 32982 "Fid_PCRSurgeLIGov_NPL" 32983 "Fid_PCR_LP_NPL" 32984 "Fid_PCR_LPMS_NPL" 32985 "Fid_PCR_MS_NPL" 32986 "Fid_PCR_SurgeDet_NPL" 32987 "Fid_PCVCDCalcI_NPL" 32988 "Fid_PFltAshCor_NPL" 32989 "Fid_PFltAshCorRgn_NPL" 32990 "Fid_PFltBrk_NPL" 32991 "Fid_PFltChar_NPL" 32992 "Fid_PFltChngPar_NPL" 32993 "Fid_PFltClth_NPL" 32994 "Fid_PFltDiagRls1_NPL" 32995 "Fid_PFltDiagRls2_NPL" 32996 "Fid_PFltDynChk_NPL" 32997 "Fid_PFltEngPrtRgnMon_NPL" 32998 "Fid_PFltGearDet_NPL" 32999 "Fid_PFltHsLnChk_NPL" 33000 "Fid_PFltLckRgnErr_NPL" 33001 "Fid_PFltLckRgnFuel_NPL" 33002 "Fid_PFltNumPFltErr_NPL" 33003 "Fid_PFltNumPFltErrLck_NPL" 33004 "Fid_PFltPPreErr_NPL" 33005 "Fid_PFltPlausPres_NPL" 33006 "Fid_PFltPlausTemp_NPL" 33007 "Fid_PFltPresPlausProj_NPL" 33008 "Fid_PFltPresSensFrz_NPL" 33009 "Fid_PFltPresSensHsLn_NPL" 33010 "Fid_PFltSRCPres_NPL" 33011 "Fid_PFltSRCTemp_NPL" 33012 "Fid_PFltSimOn_NPL" 33013 "Fid_PFltSpdVeh_NPL" 33014 "Fid_PFltSuc_NPL" 33015 "Fid_PFltTempAir_NPL" 33016 "Fid_PFltTempClnt_NPL" 33017 "Fid_PFltTempOxiPre_NPL" 33018 "Fid_PFltTempPre_NPL" 33019 "Fid_PFltTempSensFrz_NPL" 33020 "Fid_PFltVltgBatt_NPL" 33021 "Fid_RailCDRPSErrChk_NPL" 33022 "Fid_RailCDSubstVal_NPL" 33023 "Fid_RailCD_PMonStrt_NPL" 33024 "Fid_RailCtlMode_NPL" 33025 "Fid_RailMeUn0Blk_NPL" 33026 "Fid_RailMeUn0Rls_NPL" 33027 "Fid_RailMeUn1Blk_NPL" 33028 "Fid_RailMeUn1Rls_NPL" 33029 "Fid_RailMeUn2Blk_NPL" 33030 "Fid_RailMeUn2Rls_NPL" 33031 "Fid_RailMeUn3Blk_NPL" 33032 "Fid_RailMeUn3Rls_NPL" 33033 "Fid_RailMeUn4Blk_NPL" 33034 "Fid_RailMeUn4Rls_NPL" 33035 "Fid_RailMeUnCtlMode_NPL" 33036 "Fid_RailPCV0Blk_NPL" 33037 "Fid_RailPCV0Rls_NPL" 33038 "Fid_RailPCV1Blk_NPL" 33039 "Fid_RailPCV1Rls_NPL" 33040 "Fid_RailPCV2Blk_NPL" 33041 "Fid_RailPCV2Rls_NPL" 33042 "Fid_RailPCV3Blk_NPL" 33043 "Fid_RailPCV3Rls_NPL" 33044 "Fid_RailPCV4Blk_NPL" 33045 "Fid_RailPCV4Rls_NPL" 33046 "Fid_RailPCV5Blk_NPL" 33047 "Fid_RailPCV5Rls_NPL" 33048 "Fid_RailPCVCtlMode_NPL" 33049 "Fid_RailSetPointLim_NPL" 33050 "Fid_RailSetPointRed_NPL" 33051 "Fid_ShuttrCTS_NPL" 33052 "Fid_ShuttrEGS_NPL" 33053 "Fid_SignalsTstNLim_NPL" 33054 "Fid_StSysImmo_NPL" 33055 "Fid_StSysStrtTipGbxDat_NPL" 33056 "Fid_T15CDCanError_NPL" 33057 "Fid_T50CDSig_NPL" 33058 "Fid_UsrDa_FDCOff_NPL" 33059 "Fid_VehDaDist_NPL" 33060 "Fid_ZFCClbActv_NPL" 33061 "Fid_ZFCCldCmbCham_NPL" 61441 "Fid_ACCIRevErr" 61442 "Fid_ACCRevErr" 61443 "Fid_ACC_AliveErr" 61444 "Fid_ACC_CsErr" 61445 "Fid_ACC_TiOutErr" 61446 "Fid_ACCtl" 61447 "Fid_ACCtlDflt1" 61448 "Fid_ACCtlDflt2" 61449 "Fid_ACCtl_ACTrqErr" 61450 "Fid_ACCtl_CTSErr" 61451 "Fid_ACCtl_FanErr" 61452 "Fid_ACCtl_TGearbxErr" 61453 "Fid_ACCtl_VSSErr" 61454 "Fid_ACTrqC" 61455 "Fid_AFSCD" 61456 "Fid_AFSCD_AirPerTime" 61457 "Fid_AFSCD_PlOffsDrft" 61458 "Fid_AFSCD_PlSetyDrft" 61459 "Fid_AFSCD_SRCCorrAirm" 61460 "Fid_AFSCD_SRCDcyc" 61461 "Fid_AFSCD_SRCRawAirm" 61462 "Fid_AFSCD_SRCRefSig" 61463 "Fid_AFS_CanMon" 61464 "Fid_AFS_GenDisableCond" 61465 "Fid_AOHt_AltErr" 61466 "Fid_AOHt_ShutOffErr" 61467 "Fid_APP1" 61468 "Fid_APP2" 61469 "Fid_APPKickdown" 61470 "Fid_APSCD" 61471 "Fid_ARSOff" 61472 "Fid_ASDdc" 61473 "Fid_ASModSwtOffEng" 61474 "Fid_ASModSwtOffIndVol" 61475 "Fid_AccPed" 61476 "Fid_AccPedBrkPres" 61477 "Fid_AccPedVel" 61478 "Fid_AccPed_Brk" 61479 "Fid_AirCtl" 61480 "Fid_AirCtlNeg" 61481 "Fid_AirCtlNeg2" 61482 "Fid_AirCtlPFltEGRRed" 61483 "Fid_AirCtlPlateBreak" 61484 "Fid_AirCtlPlateBreakActv" 61485 "Fid_AirCtlPos" 61486 "Fid_AirCtlPos2" 61487 "Fid_AirCtl_Brk" 61488 "Fid_BPSCDMon" 61489 "Fid_CTSCDFlTemp" 61490 "Fid_CTSCD_Plaus" 61491 "Fid_ClgDynTst" 61492 "Fid_CmbChb" 61493 "Fid_CoDT_GripDeb" 61494 "Fid_CoEngIRevSys1" 61495 "Fid_CoEngIRevSys2" 61496 "Fid_CoEngIRevVeh" 61497 "Fid_CoEngPFltErr" 61498 "Fid_CoEngRevSys1" 61499 "Fid_CoEngRevSys2" 61500 "Fid_CoEngRevVeh" 61501 "Fid_CoEngShOffTst" 61502 "Fid_CoEngSoftShOffTV" 61503 "Fid_CoEng_ActrPrt" 61504 "Fid_CoEng_Nrml2Strt" 61505 "Fid_CoEng_PwrStgEnable" 61506 "Fid_CoEng_trqLimErr" 61507 "Fid_CoEng_trqLimErr1" 61508 "Fid_CoEng_trqLimErr2" 61509 "Fid_CoEng_trqLimErr3" 61510 "Fid_CoEng_trqLimErr4" 61511 "Fid_CoVM_StabDem_Err" 61512 "Fid_CoVehtrqLimErr" 61513 "Fid_CpBVlvOff" 61514 "Fid_CrCtlShutOffIr" 61515 "Fid_CrCtl_ASCTimeout" 61516 "Fid_CrCtl_CanDef" 61517 "Fid_CrCtl_KombiTimeout" 61518 "Fid_CrCtl_vCrCtl" 61519 "Fid_DCCIRevErr" 61520 "Fid_DCCRevErr" 61521 "Fid_DCC_AliveErr" 61522 "Fid_DCC_CsErr" 61523 "Fid_DCC_PlausErr" 61524 "Fid_DCC_TiOutErr" 61525 "Fid_DSM_Wuc" 61526 "Fid_EATSCDTSubs" 61527 "Fid_EBAFCD" 61528 "Fid_EBFCD" 61529 "Fid_ECU" 61530 "Fid_EGSysCoLSU0" 61531 "Fid_EGSysCoNSC" 61532 "Fid_EGSysCoOxi" 61533 "Fid_EGSysCoTrbn" 61534 "Fid_EGSysCoTube0" 61535 "Fid_EGSysCoTube1" 61536 "Fid_EGSysHtgDel" 61537 "Fid_EGSysNSC" 61538 "Fid_EGSysOxiCat" 61539 "Fid_EGSysPresEnv" 61540 "Fid_EGSysStrt" 61541 "Fid_EGSysTemp" 61542 "Fid_EGSysTrbn" 61543 "Fid_EGSysTube" 61544 "Fid_EGSys_AP" 61545 "Fid_EGTRgnLck" 61546 "Fid_EGTTempGvnrAirCtl" 61547 "Fid_EGTTempGvnrInr" 61548 "Fid_EGTTempGvnrOutr" 61549 "Fid_EMCCD_ShutOff" 61550 "Fid_ETClbCorActv" 61551 "Fid_EngCTSCD" 61552 "Fid_EngMCaSBackUp" 61553 "Fid_EngMCrSBackUp" 61554 "Fid_EngMTEng" 61555 "Fid_EngMTrqFrcPDiff" 61556 "Fid_EngMVVeh" 61557 "Fid_EngM_ChkStrtSpd" 61558 "Fid_EngPrt_nLimErr" 61559 "Fid_FBC" 61560 "Fid_FBCMonI" 61561 "Fid_FMASwtOff1" 61562 "Fid_FMASwtOff3" 61563 "Fid_FMTC_AirCorr" 61564 "Fid_FMTC_SOECorr" 61565 "Fid_FTSCDErr" 61566 "Fid_FWOscDet" 61567 "Fid_FanCtl" 61568 "Fid_FanGbxOil" 61569 "Fid_FlMngFullLdRglOff" 61570 "Fid_FlMngSmkDefect" 61571 "Fid_FlSysCTSSens" 61572 "Fid_FlSysDens" 61573 "Fid_FlSysFTSSens" 61574 "Fid_FrmMngAPP" 61575 "Fid_FrmMngARS" 61576 "Fid_FrmMngAddLevl" 61577 "Fid_FrmMngBrk" 61578 "Fid_FrmMngBrkDef" 61579 "Fid_FrmMngCoEng" 61580 "Fid_FrmMngCoEng_St2" 61581 "Fid_FrmMngConvDef" 61582 "Fid_FrmMngEngOvrSpd" 61583 "Fid_FrmMngEngRpmTemp" 61584 "Fid_FrmMngEngSpd" 61585 "Fid_FrmMngInjDU1" 61586 "Fid_FrmMngInjDU2" 61587 "Fid_FrmMngInjVlv" 61588 "Fid_FrmMngOBDCtl" 61589 "Fid_FrmMngPFltDef" 61590 "Fid_FrmMngParkConsumer" 61591 "Fid_FrmMngPla_DSC" 61592 "Fid_FrmMngPla_EGS" 61593 "Fid_FrmMngPowerTrainCAN" 61594 "Fid_FrmMngPwrMngLIGovSt" 61595 "Fid_FrmMngSIG_ARS" 61596 "Fid_FrmMngSIG_DSC" 61597 "Fid_FrmMngSig_EGS" 61598 "Fid_FrmMngTO_ARS" 61599 "Fid_FrmMngTO_DSC" 61600 "Fid_FrmMngTo_EGS" 61601 "Fid_FrmMngTrqGearbx" 61602 "Fid_FrmMngWaterVlv" 61603 "Fid_FrmMng_ST_TORQ" 61604 "Fid_FrmMng_stTrq" 61605 "Fid_FrmMngnSetpoint" 61606 "Fid_FrmMngpVal" 61607 "Fid_FrmMngtEng" 61608 "Fid_GearbxDrvAway" 61609 "Fid_GearbxDrvAwayInactiv" 61610 "Fid_GearbxPtCANErr" 61611 "Fid_GearbxTrqLimErr" 61612 "Fid_Gearbx_GearDet" 61613 "Fid_Gearbx_TrqIntv_Err" 61614 "Fid_GlwCtl1" 61615 "Fid_HDC" 61616 "Fid_IndSys1" 61617 "Fid_IndSys2" 61618 "Fid_InjCrvCoErr" 61619 "Fid_InjCtl_qLimErr" 61620 "Fid_InjVCDCls" 61621 "Fid_InjVlvActrTemp" 61622 "Fid_InjVlvInjLim" 61623 "Fid_InjVlvMon" 61624 "Fid_InjVlvNVC" 61625 "Fid_InjVlvSetUpVolt" 61626 "Fid_InjVlvWvCorOff" 61627 "Fid_LIGovSetpDrvAway" 61628 "Fid_LIGovSetpointDrvAwy" 61629 "Fid_LIGovUbr" 61630 "Fid_LSUCDMon0" 61631 "Fid_LSUCDO20" 61632 "Fid_LSUCDRi0" 61633 "Fid_LSUCDactiv0" 61634 "Fid_LSUCDlsu0" 61635 "Fid_LSUClbSched" 61636 "Fid_LSUCtl0" 61637 "Fid_LSUMonAllChecks" 61638 "Fid_LSUMonPlausChk" 61639 "Fid_Layer_FI_TANS" 61640 "Fid_Layer_FI_TUMG" 61641 "Fid_Layer_MANHYDR" 61642 "Fid_Layer_MANLUFT" 61643 "Fid_MSidCD_ECU" 61644 "Fid_MSidCD_Pin" 61645 "Fid_MeUnCDCalcI" 61646 "Fid_OTSCD" 61647 "Fid_PCR" 61648 "Fid_PCRBalGvnr" 61649 "Fid_PCRExtnLimActr" 61650 "Fid_PCRGvnrDvtNeg" 61651 "Fid_PCRGvnrDvtPos" 61652 "Fid_PCRLPGvnrDvtNeg" 61653 "Fid_PCRLPGvnrDvtPos" 61654 "Fid_PCRSurgeLIGov" 61655 "Fid_PCR_LP" 61656 "Fid_PCR_LPMS" 61657 "Fid_PCR_MS" 61658 "Fid_PCR_SurgeDet" 61659 "Fid_PCVCDCalcI" 61660 "Fid_PFltAshCor" 61661 "Fid_PFltAshCorRgn" 61662 "Fid_PFltBrk" 61663 "Fid_PFltChar" 61664 "Fid_PFltChngPar" 61665 "Fid_PFltClth" 61666 "Fid_PFltDiagRls1" 61667 "Fid_PFltDiagRls2" 61668 "Fid_PFltDynChk" 61669 "Fid_PFltEngPrtRgnMon" 61670 "Fid_PFltGearDet" 61671 "Fid_PFltHsLnChk" 61672 "Fid_PFltLckRgnErr" 61673 "Fid_PFltLckRgnFuel" 61674 "Fid_PFltNumPFltErr" 61675 "Fid_PFltNumPFltErrLck" 61676 "Fid_PFltPPreErr" 61677 "Fid_PFltPlausPres" 61678 "Fid_PFltPlausTemp" 61679 "Fid_PFltPresPlausProj" 61680 "Fid_PFltPresSensFrz" 61681 "Fid_PFltPresSensHsLn" 61682 "Fid_PFltSRCPres" 61683 "Fid_PFltSRCTemp" 61684 "Fid_PFltSimOn" 61685 "Fid_PFltSpdVeh" 61686 "Fid_PFltSuc" 61687 "Fid_PFltTempAir" 61688 "Fid_PFltTempClnt" 61689 "Fid_PFltTempOxiPre" 61690 "Fid_PFltTempPre" 61691 "Fid_PFltTempSensFrz" 61692 "Fid_PFltVltgBatt" 61693 "Fid_RailCDRPSErrChk" 61694 "Fid_RailCDSubstVal" 61695 "Fid_RailCD_PMonStrt" 61696 "Fid_RailCtlMode" 61697 "Fid_RailMeUn0Blk" 61698 "Fid_RailMeUn0Rls" 61699 "Fid_RailMeUn1Blk" 61700 "Fid_RailMeUn1Rls" 61701 "Fid_RailMeUn2Blk" 61702 "Fid_RailMeUn2Rls" 61703 "Fid_RailMeUn3Blk" 61704 "Fid_RailMeUn3Rls" 61705 "Fid_RailMeUn4Blk" 61706 "Fid_RailMeUn4Rls" 61707 "Fid_RailMeUnCtlMode" 61708 "Fid_RailPCV0Blk" 61709 "Fid_RailPCV0Rls" 61710 "Fid_RailPCV1Blk" 61711 "Fid_RailPCV1Rls" 61712 "Fid_RailPCV2Blk" 61713 "Fid_RailPCV2Rls" 61714 "Fid_RailPCV3Blk" 61715 "Fid_RailPCV3Rls" 61716 "Fid_RailPCV4Blk" 61717 "Fid_RailPCV4Rls" 61718 "Fid_RailPCV5Blk" 61719 "Fid_RailPCV5Rls" 61720 "Fid_RailPCVCtlMode" 61721 "Fid_RailSetPointLim" 61722 "Fid_RailSetPointRed" 61723 "Fid_ShuttrCTS" 61724 "Fid_ShuttrEGS" 61725 "Fid_SignalsTstNLim" 61726 "Fid_StSysImmo" 61727 "Fid_StSysStrtTipGbxDat" 61728 "Fid_T15CDCanError" 61729 "Fid_T50CDSig" 61730 "Fid_UsrDa_FDCOff" 61731 "Fid_VehDaDist" 61732 "Fid_ZFCClbActv" 61733 "Fid_ZFCCldCmbCham" /end COMPU_VTAB
/begin COMPU_METHOD Fl_Vol "Kraftstoffverbrauch pro 100 km" RAT_FUNC "%6.5" "l/100km" COEFFS 0 1000 0 0 0 1 /end COMPU_METHOD
/begin COMPU_METHOD Frequency_PA "Frequenz" RAT_FUNC "%6.2" "Hz" COEFFS 0 1 0 0 0 1 /end COMPU_METHOD
/begin COMPU_METHOD OneToOne "eins zu eins (physikalischer Wert ist gleich dem internen Wert)" RAT_FUNC "%6.2" "-" COEFFS 0 1 0 0 0 1 /end COMPU_METHOD
/end MODULE
/end PROJECT
