ASAP2_VERSION 1 31
/begin PROJECT MS45 "BMW Motorsteuerung R6"
/begin HEADER "_default_HeaderComment" PROJECT_NO _52 /end HEADER
/begin MODULE _default_ModuleName "_default_ModuleLongIdentifier"
/begin MOD_COMMON "_default_ModCommonComment" DEPOSIT ABSOLUTE BYTE_ORDER MSB_FIRST ALIGNMENT_BYTE 1 ALIGNMENT_WORD 2 ALIGNMENT_LONG 4 ALIGNMENT_FLOAT32_IEEE 4 ALIGNMENT_FLOAT64_IEEE 8 /end MOD_COMMON
/begin MEASUREMENT LV_ERR_BN_MSW "Present error BN2000" UBYTE _CNV_S_2_RANGE______21_R_CM 1 100. 0. 255. ECU_ADDRESS 0x3fd667 /end MEASUREMENT
/begin CHARACTERISTIC C_AMP_HYS "maximum value between two acquired ambient pressure values" VALUE 0x42c22 _REC_VAL_20_u2 5434. _CNV_A_R_LINEAR_____43_CM 0. 5434. FORMAT "%7.2" /end CHARACTERISTIC
/begin CHARACTERISTIC IP_AMP_RAW_COR__VS "correlation table for the linearization of the ambient pressure with the vehicle speed" CURVE 0x45fd8 _REC_CUR_20_u2_u1 5434. _CNV_A_R_LINEAR_____43_CM 0. 5434. FORMAT "%7.2"
 /begin AXIS_DESCR COM_AXIS VS _CNV_A_R_LINEAR_____13_CM 8 0. 255. FORMAT "%3.0" AXIS_PTS_REF ldp_vs__amp_raw_cor /end AXIS_DESCR
/end CHARACTERISTIC
/begin MEASUREMENT AMP_MES "valid ambient pressure" UWORD _CNV_A_R_LINEAR_____43_CM 1 100. 0. 5434. ECU_ADDRESS 0x3fcd46 FORMAT "%7.2" /end MEASUREMENT
/begin CHARACTERISTIC C_AMP_CRLC "correlation value for the compensation of the noise signal of the ambient pressure signal" VALUE 0x427bc _REC_VAL_20_u1 0.9960940000000002 _CNV_A_R_LINEAR_____44_CM 0. 0.996094 FORMAT "%5.3" /end CHARACTERISTIC
/begin CHARACTERISTIC C_FAC_AMP_MIN "BOT for FAC_AMP" VALUE 0x42d02 _REC_VAL_20_u2 1.99996948 _CNV_A_R_LINEAR_____45_CM 0. 1.99996948 FORMAT "%7.5" /end CHARACTERISTIC
/begin CHARACTERISTIC C_FAC_AMP_MAX "TOP for FAC_AMP" VALUE 0x42d00 _REC_VAL_20_u2 1.99996948 _CNV_A_R_LINEAR_____45_CM 0. 1.99996948 FORMAT "%7.5" /end CHARACTERISTIC
/begin MEASUREMENT FAC_AMP "factor of the ambient pressure related to the reference ambient pressure" UWORD _CNV_A_R_LINEAR_____45_CM 1 100. 0. 1.99996948 ECU_ADDRESS 0x3fcd48 FORMAT "%7.5" /end MEASUREMENT
/begin AXIS_PTS ldp_vs__amp_raw_cor "" 0x43b24 VS _REC_AXS_20_u1 255. _CNV_A_R_LINEAR_____13_CM 8 0. 255. FORMAT "%3.0" /end AXIS_PTS
/begin AXIS_PTS ldp_v_amp_1__amp_raw "" 0x44d02 V_AMP _REC_AXS_20_u2 4.99511719 _CNV_A_R_LINEAR_____33_CM 8 0. 4.99511719 FORMAT "%5.3" /end AXIS_PTS
/begin AXIS_PTS ldp_v_amp_2__amp_raw "" 0x44d14 V_AMP _REC_AXS_20_u2 4.99511719 _CNV_A_R_LINEAR_____33_CM 8 0. 4.99511719 FORMAT "%5.3" /end AXIS_PTS
/begin CHARACTERISTIC IP_AMP_RAW_2 "correlation table for the linearization of the ambient pressure value acquisition with Infineon sensor" CURVE 0x45fc8 _REC_CUR_20_u2_u2 5434. _CNV_A_R_LINEAR_____43_CM 0. 5434. FORMAT "%7.2"
 /begin AXIS_DESCR COM_AXIS V_AMP _CNV_A_R_LINEAR_____33_CM 8 0. 4.99511719 FORMAT "%5.3" AXIS_PTS_REF ldp_v_amp_2__amp_raw /end AXIS_DESCR
/end CHARACTERISTIC
/begin CHARACTERISTIC IP_AMP_RAW_1 "correlation table for the linearization of the ambient pressure value acquisition with Motorola sensor" CURVE 0x45fb8 _REC_CUR_20_u2_u2 5434. _CNV_A_R_LINEAR_____43_CM 0. 5434. FORMAT "%7.2"
 /begin AXIS_DESCR COM_AXIS V_AMP _CNV_A_R_LINEAR_____33_CM 8 0. 4.99511719 FORMAT "%5.3" AXIS_PTS_REF ldp_v_amp_1__amp_raw /end AXIS_DESCR
/end CHARACTERISTIC
/begin MEASUREMENT N_VS_RATIO "Engine speed / vehicle speed ratio" UBYTE _CNV_A_R_LINEAR_____46_CM 1 100. 0. 255. ECU_ADDRESS 0x3fe293 FORMAT "%3.0" /end MEASUREMENT
/begin CHARACTERISTIC ID_GR_MT "Index table for Gear Ratio detection" CURVE 0x4cd15 _REC_CUR_20_u1_u1 255. _CNV_A_R_LINEAR_____10_CM 0. 255. FORMAT "%3.0"
 /begin AXIS_DESCR COM_AXIS N_VS_RATIO _CNV_A_R_LINEAR_____10_CM 13 0. 255. FORMAT "%3.0" AXIS_PTS_REF ldp_n_vs_ratio_gr_mt /end AXIS_DESCR
/end CHARACTERISTIC
/begin MEASUREMENT LV_DRI "Logical variable for engaged drive" UBYTE _CNV_S_2_RANGE______28_CM 1 100. 0. 1. ECU_ADDRESS 0x3fcd4f BIT_MASK 0x1 /end MEASUREMENT
/begin CHARACTERISTIC C_VS_MIN_DT "Threshold for vehicle running and drive-train closed detection " VALUE 0x42b35 _REC_VAL_20_u1 255. _CNV_A_R_LINEAR_____13_CM 0. 255. FORMAT "%3.0" /end CHARACTERISTIC
/begin MEASUREMENT LV_DT "Logical variable drive train engaged" UBYTE _CNV_S_2_RANGE______28_CM 1 100. 0. 1. ECU_ADDRESS 0x3fcd51 BIT_MASK 0x1 /end MEASUREMENT
/begin MEASUREMENT LV_CS "Boolean for clutch switch detection" UBYTE _CNV_S_2_RANGE______28_CM 1 100. 0. 1. ECU_ADDRESS 0x3fcd50 BIT_MASK 0x1 /end MEASUREMENT
/begin MEASUREMENT GR_AT "Automatic transmission gear ratio" UBYTE _CNV_A_R_LINEAR_____10_CM 1 100. 0. 255. ECU_ADDRESS 0x3fcd4b FORMAT "%3.0" /end MEASUREMENT
/begin CHARACTERISTIC C_MIN_VS_RATIO "Minimum engine speed / vehicle speed ratio calculation" VALUE 0x4290b _REC_VAL_20_u1 255. _CNV_A_R_LINEAR_____13_CM 0. 255. FORMAT "%3.0" /end CHARACTERISTIC
/begin MEASUREMENT GEAR "" UBYTE _CNV_A_R_LINEAR_____10_CM 1 100. 0. 255. ECU_ADDRESS 0x3fcd4c FORMAT "%3.0" /end MEASUREMENT
/begin MEASUREMENT GR_MT "Manual transmission gear ratio" UBYTE _CNV_A_R_LINEAR_____10_CM 1 100. 0. 255. ECU_ADDRESS 0x3fcd4a FORMAT "%3.0" /end MEASUREMENT
/begin MEASUREMENT GEAR_EF "Gear ratio used for exhaust flap functionality" UBYTE _CNV_A_R_LINEAR_____10_CM 1 100. 0. 255. ECU_ADDRESS 0x3fcd4d FORMAT "%3.0" /end MEASUREMENT
/begin CHARACTERISTIC LC_RNG_L "Manual switch for low range detection" VALUE 0x42bbf _REC_VAL_20_u1 1. _CNV_A_R_LINEAR_____12_CM 0. 1. FORMAT "%1.0" /end CHARACTERISTIC
/begin MEASUREMENT LV_RNG_L "Logical variable for engaged low range" UBYTE _CNV_S_2_RANGE______28_CM 1 100. 0. 1. ECU_ADDRESS 0x3fcd53 /end MEASUREMENT
/begin MEASUREMENT STATE_GEAR_REV_AT "AT reverse gear" UBYTE _CNV_S_2_RANGE______28_CM 1 100. 0. 1. ECU_ADDRESS 0x3fcd4e /end MEASUREMENT
/begin AXIS_PTS ldp_n_vs_ratio_gr_mt "" 0x43785 N_VS_RATIO _REC_AXS_20_u1 255. _CNV_A_R_LINEAR_____10_CM 13 0. 255. FORMAT "%3.0" /end AXIS_PTS
/begin MEASUREMENT TQ_LOSS_ARS_AV_CAN "torque loss actual value ARS from CAN" SWORD _CNV_A_R_LINEAR_____48_CM 1 100. -1024. 1023.96875 ECU_ADDRESS 0x3fc402 FORMAT "%8.2" /end MEASUREMENT
/begin MEASUREMENT TQ_LOSS_ARS_SP_CAN "torque loss setpoint ARS from CAN" SWORD _CNV_A_R_LINEAR_____48_CM 1 100. -1024. 1023.96875 ECU_ADDRESS 0x3fc404 FORMAT "%8.2" /end MEASUREMENT
/begin MEASUREMENT VEH_KEY_NR "vehicle key number" UBYTE _CNV_A_R_LINEAR_____10_CM 1 100. 0. 15. ECU_ADDRESS 0x3fd79b FORMAT "%2.0" /end MEASUREMENT
/begin MEASUREMENT STATE_ARS_CAN "status anti roll stabilization via CAN" UBYTE _CNV_S_3_STATE_ARS__49_CM 1 100. 0. 3. ECU_ADDRESS 0x3fc422 /end MEASUREMENT
/begin MEASUREMENT STATE_IGK_CAN "status ignition key via CAN" UBYTE _CNV_S_3_STATE_IGK__50_CM 1 100. 0. 2. ECU_ADDRESS 0x3fc423 /end MEASUREMENT
/begin MEASUREMENT LV_TCS_LIH_CAN "logical variable traction control system limp home" UBYTE _CNV_S_2_RANGE______28_CM 1 100. 0. 1. ECU_ADDRESS 0x3fc43e /end MEASUREMENT
/begin MEASUREMENT STATE_TCS_INTV "status traction control system via CAN" UBYTE _CNV_S_4_STATE_TCS__51_CM 1 100. 0. 3. ECU_ADDRESS 0x3fc425 /end MEASUREMENT
/begin MEASUREMENT STATE_WAL_CAN "logical variable fuel reserve" UBYTE _CNV_S_3_STATE_WAL__52_CM 1 100. 0. 3. ECU_ADDRESS 0x3fd7b7 /end MEASUREMENT
/begin MEASUREMENT T_CTR_REL_CAN "relative time counter (reseted at Kl. 30 OFF)" ULONG _CNV_A_R_LINEAR_____47_CM 1 100. 0. 4294967294. ECU_ADDRESS 0x3fd780 FORMAT "%11.0" /end MEASUREMENT
/begin MEASUREMENT V_SP_GEN "target generator voltage " UBYTE _CNV_A_R_LINEAR_____53_CM 1 100. 0. 26. ECU_ADDRESS 0x3fd7bb FORMAT "%4.1" /end MEASUREMENT
/begin MEASUREMENT T_CAN "day counter absolute (counts the days at sufficient mains voltage )" UWORD _CNV_A_R_LINEAR_____54_CM 1 100. 0. 65534. ECU_ADDRESS 0x3fc41a FORMAT "%5.0" /end MEASUREMENT
/begin MEASUREMENT STATE_TCS_CTL "status closed looped control via CAN" UBYTE _CNV_S_9_STATE_TCS__55_CM 1 100. 0. 255. ECU_ADDRESS 0x3fc426 /end MEASUREMENT
/begin MEASUREMENT STATE_TCS_DECE "status closed loop control via CAN" UBYTE _CNV_S_5_STATE_TCS__56_CM 1 100. 0. 15. ECU_ADDRESS 0x3fc427 /end MEASUREMENT
/begin MEASUREMENT AC_VEH_LGT_TCS "vehicle acceleration (longitudinal) TCS" SWORD _CNV_A_R_LINEAR_____57_CM 1 100. -51.175 51.175 ECU_ADDRESS 0x3fc40a FORMAT "%8.3" /end MEASUREMENT
/begin MEASUREMENT AC_VEH_TRV_TCS "vehicle acceleration (transversal) TCS" SWORD _CNV_A_R_LINEAR_____57_CM 1 100. -51.175 51.175 ECU_ADDRESS 0x3fc40c FORMAT "%8.3" /end MEASUREMENT
/begin MEASUREMENT STATE_MOD_GB "State mode gearbox : SSC (Sleeping Starter Clutch), SBC (Stand By Control)" UBYTE _CNV_S_5_STATE_MOD__58_CM 1 100. 0. 7. ECU_ADDRESS 0x3fc42c /end MEASUREMENT
/begin MEASUREMENT STATE_TCS_CAN "status traction control system via CAN" UBYTE _CNV_S_6_STATE_TCS__59_CM 1 100. 0. 7. ECU_ADDRESS 0x3fd7a4 /end MEASUREMENT
/begin MEASUREMENT STATE_TEMP_GB "State overtemperature gearbox  (AT)- request for cooling (overheating protection) via ECT" UBYTE _CNV_S_4_STATE_TEMP_60_CM 1 100. 0. 3. ECU_ADDRESS 0x3fc42a /end MEASUREMENT
/begin MEASUREMENT TEMP_GB "Temperature gearbox (AT) - request for cooling (overheating protection) via ECF" UBYTE _CNV_A_R_LINEAR_____3_CM 1 100. -40. 215. ECU_ADDRESS 0x3fc42b FORMAT "%3.0" /end MEASUREMENT
/begin CHARACTERISTIC C_TEMP_GB_SUB "Default temperature for automatic gearbox in case of error TEMP_GB" VALUE 0x42a99 _REC_VAL_20_u1 255. _CNV_A_R_LINEAR_____3_CM -40. 215. FORMAT "%3.0" /end CHARACTERISTIC
/begin MEASUREMENT VS_ICL_DISP "displayed vehicle speed (speedometer)" UWORD _CNV_A_R_LINEAR_____61_CM 1 100. 0. 409.4 ECU_ADDRESS 0x3fc416 FORMAT "%5.1" /end MEASUREMENT
/begin MEASUREMENT LV_DCC_LIH_CAN "LV indicating DCC intervention limp home" UBYTE _CNV_S_2_RANGE______28_CM 1 100. 0. 1. ECU_ADDRESS 0x3fc439 /end MEASUREMENT
/begin MEASUREMENT LV_DCC_PUC_INH "inhibitation of PUC required by DCC" UBYTE _CNV_S_2_RANGE______28_CM 1 100. 0. 1. ECU_ADDRESS 0x3fc43b /end MEASUREMENT
/begin MEASUREMENT TQ_DCC_SLOW_BN "torque target (slow) for DCC via CAN interface" SWORD _CNV_A_R_LINEAR_____48_CM 1 100. -1024. 1023.96875 ECU_ADDRESS 0x3fc400 FORMAT "%8.2" /end MEASUREMENT
/begin MEASUREMENT TQ_DCC_FAST_BN "torque target (fast) for DCC via CAN interface" SWORD _CNV_A_R_LINEAR_____48_CM 1 100. -1024. 1023.96875 ECU_ADDRESS 0x3fc3fe FORMAT "%8.2" /end MEASUREMENT
/begin MEASUREMENT STATE_ETCU_INTV "status traction control system via CAN" UBYTE _CNV_S_4_STATE_ETCU_62_CM 1 100. 0. 3. ECU_ADDRESS 0x3fc429 /end MEASUREMENT
/begin MEASUREMENT STATE_DCC_INTV "status torque target DCC via CAN interface" UBYTE _CNV_S_4_STATE_DCC__63_CM 1 100. 0. 3. ECU_ADDRESS 0x3fc41e /end MEASUREMENT
/begin MEASUREMENT STATE_DCC_PUC_INH "status request PUC-inhibitation via CAN interface - DCC" UBYTE _CNV_S_3_STATE_DCC__64_CM 1 100. 0. 3. ECU_ADDRESS 0x3fc41f /end MEASUREMENT
/begin MEASUREMENT STATE_DCC_OFF_REQ "status switch-off DCC" UBYTE _CNV_S_4_STATE_DCC__65_CM 1 100. 0. 3. ECU_ADDRESS 0x3fc420 /end MEASUREMENT
/begin MEASUREMENT STATE_DCC "Status DCC" UBYTE _CNV_S_8_STATE_DCC_66_CM 1 100. 0. 7. ECU_ADDRESS 0x3fc421 /end MEASUREMENT
/begin MEASUREMENT LV_DCC_OFF_ACK "Acknowledge bit for switch-off DCC" UBYTE _CNV_S_2_RANGE______28_CM 1 100. 0. 1. ECU_ADDRESS 0x3fc43a /end MEASUREMENT
/begin MEASUREMENT LV_ERR_TQ_LOSS_ARS_AV_CAN "interface bit for TQ_LOSS_ARS calculation in case of error via CAN" UBYTE _CNV_S_2_RANGE______28_CM 1 100. 0. 1. ECU_ADDRESS 0x3fc43d /end MEASUREMENT
/begin MEASUREMENT LV_ERR_TQ_LOSS_ARS_SP_CAN "interface bit for TQ_LOSS_ARS calculation in case of error via CAN" UBYTE _CNV_S_2_RANGE______28_CM 1 100. 0. 1. ECU_ADDRESS 0x3fc43c /end MEASUREMENT
/begin MEASUREMENT LV_RLY_ST_CAN "status starter relay" UBYTE _CNV_S_2_RANGE______28_CM 1 100. 0. 1. ECU_ADDRESS 0x3fd7c3 /end MEASUREMENT
/begin MEASUREMENT LV_KEY_AUX "status Kl. R" UBYTE _CNV_S_2_RANGE______28_CM 1 100. 0. 1. ECU_ADDRESS 0x3fd7c4 /end MEASUREMENT
/begin MEASUREMENT TCC_CAN_CAS "free running test cycle counter CAS (alive counter)" UBYTE _CNV_A_R_LINEAR_____12_CM 1 100. 0. 14. ECU_ADDRESS 0x3fd79e FORMAT "%2.0" /end MEASUREMENT
/begin MEASUREMENT TQ_TCS_FAST_BN "torque target (fast) due to TCS via CAN" SWORD _CNV_A_R_LINEAR_____48_CM 1 100. -1024. 1023.96875 ECU_ADDRESS 0x3fc406 FORMAT "%8.2" /end MEASUREMENT
/begin MEASUREMENT TCC_CAN_TQ_DCC "free running test cycle counter TQ_DCC (alive counter)" UBYTE _CNV_A_R_LINEAR_____12_CM 1 100. 0. 14. ECU_ADDRESS 0x3fd797 FORMAT "%2.0" /end MEASUREMENT
/begin MEASUREMENT TQ_TCS_SLOW_BN "torque target (slow) due to TCS via CAN" SWORD _CNV_A_R_LINEAR_____48_CM 1 100. -1024. 1023.96875 ECU_ADDRESS 0x3fc408 FORMAT "%8.2" /end MEASUREMENT
/begin MEASUREMENT TQ_GS_SLOW_BN "torque target (slow) for GS via CAN interface" SWORD _CNV_A_R_LINEAR_____48_CM 1 100. -1024. 1023.96875 ECU_ADDRESS 0x3fc410 FORMAT "%8.2" /end MEASUREMENT
/begin MEASUREMENT TCC_CAN_TQ_TCS "free running test cycle counter TQ_TCS (alive counter)" UBYTE _CNV_A_R_LINEAR_____12_CM 1 100. 0. 14. ECU_ADDRESS 0x3fd7a7 FORMAT "%2.0" /end MEASUREMENT
/begin MEASUREMENT LV_TQ_DCC_INC_REQ "LV indicating torque increse required by DCC" UBYTE _CNV_S_2_RANGE______28_CM 1 100. 0. 1. ECU_ADDRESS 0x3fc437 /end MEASUREMENT
/begin MEASUREMENT TQ_GS_FAST_BN "torque target (fast) for GS via CAN interface " SWORD _CNV_A_R_LINEAR_____48_CM 1 100. -1024. 1023.96875 ECU_ADDRESS 0x3fc40e FORMAT "%8.2" /end MEASUREMENT
/begin MEASUREMENT TQ_AMT_FAST_BN "torque target (fast) for AMT via CAN interface " SWORD _CNV_A_R_LINEAR_____48_CM 1 100. -1024. 1023.96875 ECU_ADDRESS 0x3fc412 FORMAT "%8.2" /end MEASUREMENT
/begin MEASUREMENT TQ_AMT_SLOW_BN "torque target (slow) for AMT via CAN interface " SWORD _CNV_A_R_LINEAR_____48_CM 1 100. -1024. 1023.96875 ECU_ADDRESS 0x3fc414 FORMAT "%8.2" /end MEASUREMENT
/begin MEASUREMENT TCC_CAN_TQ_ETCU "free running test cycle counter TQ_ETCU (alive counter)" UBYTE _CNV_A_R_LINEAR_____12_CM 1 100. 0. 14. ECU_ADDRESS 0x3fd7ab FORMAT "%2.0" /end MEASUREMENT
/begin MEASUREMENT STATE_ETCU_OBD_ERR "status OBD-relevamt error - ETCU" UBYTE _CNV_S_3_STATE_ETCU_67_CM 1 100. 0. 2. ECU_ADDRESS 0x3fc428 /end MEASUREMENT
/begin MEASUREMENT STATE_AMT_INTV "status torque target AMT via CAN" UBYTE _CNV_S_4_STATE_ETCU_62_CM 1 100. 0. 3. ECU_ADDRESS 0x3fc42e /end MEASUREMENT
/begin MEASUREMENT STATE_ACIN_CAN "state air-conditioning request signal CAN" UBYTE _CNV_A_R_LINEAR_____10_CM 1 100. 0. 7. ECU_ADDRESS 0x3fd7b6 FORMAT "%1.0" /end MEASUREMENT
/begin MEASUREMENT CTR_KM_BN "vehicle kilometer BN reading from Kombi - for OBD" ULONG _CNV_A_R_LINEAR_____68_CM 1 100. 0. 16777215. ECU_ADDRESS 0x3fd77c FORMAT "%8.0" /end MEASUREMENT
/begin MEASUREMENT TCC_CAN_TQ_AMT "free running test cycle counter TQ_AMT (alive counter)" UBYTE _CNV_A_R_LINEAR_____12_CM 1 100. 0. 14. ECU_ADDRESS 0x3fd7af FORMAT "%2.0" /end MEASUREMENT
/begin MEASUREMENT T_CTR_SWI_OFF_VB "shutdown counter battery-main-switch" UBYTE _CNV_A_R_LINEAR_____47_CM 1 100. 0. 255. ECU_ADDRESS 0x3fc436 FORMAT "%3.0" /end MEASUREMENT
/begin MEASUREMENT ctrgenms "target generator voltage " UBYTE _CNV_R_R_spg_gencan_69_CM 1 100. 10.6 16.975 ECU_ADDRESS 0x3fc432 FORMAT "%8.4" /end MEASUREMENT
/begin MEASUREMENT n_idlms "request IS-increase" UBYTE _CNV_A_R_LINEAR_____10_CM 1 100. 0. 255. ECU_ADDRESS 0x3fc431 FORMAT "%3.0" /end MEASUREMENT
/begin CHARACTERISTIC C_T_CTR_SWI_OFF_VB_MIN "Threshold shutdown counter battery-main-switch" VALUE 0x429c6 _REC_VAL_20_u1 255. _CNV_A_R_LINEAR_____47_CM 0. 255. FORMAT "%3.0" /end CHARACTERISTIC
/begin CHARACTERISTIC C_V_SP_GEN "Generator voltage (substitute value in case of  invalid signal from CAN)" VALUE 0x42af3 _REC_VAL_20_u1 6.299999999999999 _CNV_A_R_LINEAR_____70_CM 10.6 16.9 FORMAT "%4.1" /end CHARACTERISTIC
/begin MEASUREMENT TCC_CAN_ICL "free running test cycle counter instrument cluster (alive counter)" UBYTE _CNV_A_R_LINEAR_____12_CM 1 100. 0. 14. ECU_ADDRESS 0x3fd7b8 FORMAT "%2.0" /end MEASUREMENT
/begin MEASUREMENT TCC_CAN_MSW "alive counter MSW - SZL" UBYTE _CNV_A_R_LINEAR_____12_CM 1 100. 0. 14. ECU_ADDRESS 0x3fd7b3 FORMAT "%2.0" /end MEASUREMENT
/begin MEASUREMENT STATE_BN_MSW "Status MSW BN (CAN)" UBYTE _CNV_S_13_STATE_BN_M_71_CM 1 100. 0. 127. ECU_ADDRESS 0x3fc430 /end MEASUREMENT
/begin MEASUREMENT LV_ERR_ANG_PSTE_CAN "interface bit for TQ_LOSS_PSTE calculation in case of error via CAN" UBYTE _CNV_S_2_RANGE______28_CM 1 100. 0. 1. ECU_ADDRESS 0x3fc441 /end MEASUREMENT
/begin MEASUREMENT TCC_CAN_ARS "free running test cycle counter ARS (alive counter)" UBYTE _CNV_A_R_LINEAR_____12_CM 1 100. 0. 14. ECU_ADDRESS 0x3fd799 FORMAT "%2.0" /end MEASUREMENT
/begin MEASUREMENT LV_ETCU_LIH_CAN "logical variable ETCU gear shift intervention limp home" UBYTE _CNV_S_2_RANGE______28_CM 1 100. 0. 1. ECU_ADDRESS 0x3fc43f /end MEASUREMENT
/begin MEASUREMENT LV_AMT_LIH_CAN "logical variable AMT intervention limp home" UBYTE _CNV_S_2_RANGE______28_CM 1 100. 0. 1. ECU_ADDRESS 0x3fc440 /end MEASUREMENT
/begin MEASUREMENT STATE_ST_TQ_LIM_GS "State starting torque limitation" UBYTE _CNV_S_3_STATE_ST_T_73_CM 1 100. 0. 3. ECU_ADDRESS 0x3fc42d /end MEASUREMENT
/begin MEASUREMENT STATE_ST_TQ_LIM_AMT "State starting torque limitation for AMT" UBYTE _CNV_S_3_STATE_ST_T_73_CM 1 100. 0. 3. ECU_ADDRESS 0x3fc42f /end MEASUREMENT
/begin MEASUREMENT LV_VAR_ETCU "BN(SSG or EGS)-transmission recognized" UBYTE _CNV_S_2_RANGE______28_CM 1 100. 0. 1. ECU_ADDRESS 0x3fc445 /end MEASUREMENT
/begin MEASUREMENT LV_VAR_BN_MSW "LV cruise control detected - BN2000" UBYTE _CNV_S_2_RANGE______28_CM 1 100. 0. 1. ECU_ADDRESS 0x3fc443 /end MEASUREMENT
/begin MEASUREMENT LV_VAR_DCC "LV distance cruise control detected - BN2000" UBYTE _CNV_S_2_RANGE______28_CM 1 100. 0. 1. ECU_ADDRESS 0x3fc444 /end MEASUREMENT
/begin MEASUREMENT LV_VAR_ARS "LV anti-roll-stabilisation detected - BN2000" UBYTE _CNV_S_2_RANGE______28_CM 1 100. 0. 1. ECU_ADDRESS 0x3fc442 /end MEASUREMENT
/begin MEASUREMENT LV_VAR_VEH "LV vehicle variant (E60/E65) detected - BN2000" UBYTE _CNV_S_2_RANGE______28_CM 1 100. 0. 1. ECU_ADDRESS 0x3fc446 /end MEASUREMENT
/begin MEASUREMENT STATE_VEH_MOD "vehicle mode" UBYTE _CNV_A_R_LINEAR_____10_CM 1 100. 0. 15. ECU_ADDRESS 0x3fc424 FORMAT "%2.0" /end MEASUREMENT
/begin MEASUREMENT STATE_VS_ICL_DISP "status scaling of speedometer (displayed vehicle speed)" UBYTE _CNV_S_3_STATE_VS_I_74_CM 1 100. 0. 3. ECU_ADDRESS 0x3fc41c /end MEASUREMENT
/begin MEASUREMENT TCC_CAN_VEH_MOD "free running test cycle counter VEH_MOD (alive counter)" UBYTE _CNV_A_R_LINEAR_____12_CM 1 100. 0. 14. ECU_ADDRESS 0x3fd7a2 FORMAT "%2.0" /end MEASUREMENT
/begin MEASUREMENT STATE_IF_ICL_BN_MSW "status interface ICL/cruise control" UBYTE _CNV_A_R_LINEAR_____10_CM 1 100. 0. 7. ECU_ADDRESS 0x3fc41d FORMAT "%1.0" /end MEASUREMENT
/begin CHARACTERISTIC C_TQ_ACCIN "Minimum torque ACCIN" VALUE 0x42ad8 _REC_VAL_20_u1 127. _CNV_A_R_LINEAR_____72_CM 0. 127. FORMAT "%5.1" /end CHARACTERISTIC
/begin MEASUREMENT CTR_DIAG_TCC_CAN_CAS "Diagnosis counter for alive counter error symptom detection" UBYTE _CNV_A_R_LINEAR_____10_CM 1 100. 0. 255. ECU_ADDRESS 0x3fd7d1 FORMAT "%3.0" /end MEASUREMENT
/begin MEASUREMENT CTR_DIAG_TCC_CAN_TQ_TCS "Diagnosis counter for alive counter error symptom detection" UBYTE _CNV_A_R_LINEAR_____10_CM 1 100. 0. 255. ECU_ADDRESS 0x3fd7d4 FORMAT "%3.0" /end MEASUREMENT
/begin MEASUREMENT CTR_DIAG_TCC_CAN_TQ_ETCU "Diagnosis counter for alive counter error symptom detection" UBYTE _CNV_A_R_LINEAR_____10_CM 1 100. 0. 255. ECU_ADDRESS 0x3fd7d9 FORMAT "%3.0" /end MEASUREMENT
/begin MEASUREMENT CTR_DIAG_TCC_CAN_TQ_AMT "Diagnosis counter for alive counter error symptom detection" UBYTE _CNV_A_R_LINEAR_____10_CM 1 100. 0. 255. ECU_ADDRESS 0x3fd7dd FORMAT "%3.0" /end MEASUREMENT
/begin MEASUREMENT CTR_DIAG_TCC_CAN_ICL "Diagnosis counter for alive counter error symptom detection" UBYTE _CNV_A_R_LINEAR_____10_CM 1 100. 0. 255. ECU_ADDRESS 0x3fd7e6 FORMAT "%3.0" /end MEASUREMENT
/begin MEASUREMENT CTR_DIAG_TCC_CAN_ARS "Diagnosis counter for alive counter error symptom detection" UBYTE _CNV_A_R_LINEAR_____10_CM 1 100. 0. 255. ECU_ADDRESS 0x3fd7cf FORMAT "%3.0" /end MEASUREMENT
/begin MEASUREMENT CTR_DIAG_TCC_CAN_MSW "Diagnosis counter for alive counter error symptom detection" UBYTE _CNV_A_R_LINEAR_____10_CM 1 100. 0. 255. ECU_ADDRESS 0x3fd7ea FORMAT "%3.0" /end MEASUREMENT
/begin MEASUREMENT CTR_DIAG_TCC_CAN_TQ_DCC "Diagnosis counter for alive counter error symptom detection" UBYTE _CNV_A_R_LINEAR_____10_CM 1 100. 0. 255. ECU_ADDRESS 0x3fd7cc FORMAT "%3.0" /end MEASUREMENT
/begin MEASUREMENT CTR_DIAG_CKS_CAS "Diagnosis counter for checksum counter error symptom detection" UBYTE _CNV_A_R_LINEAR_____10_CM 1 100. 0. 255. ECU_ADDRESS 0x3fd7d2 FORMAT "%3.0" /end MEASUREMENT
/begin MEASUREMENT CTR_DIAG_CKS_TQ_TCS "Diagnosis counter for checksum counter error symptom detection" UBYTE _CNV_A_R_LINEAR_____10_CM 1 100. 0. 255. ECU_ADDRESS 0x3fd7d5 FORMAT "%3.0" /end MEASUREMENT
/begin MEASUREMENT CTR_DIAG_CKS_TQ_ETCU "Diagnosis counter for checksum counter error symptom detection" UBYTE _CNV_A_R_LINEAR_____10_CM 1 100. 0. 255. ECU_ADDRESS 0x3fd7da FORMAT "%3.0" /end MEASUREMENT
/begin MEASUREMENT CTR_DIAG_CKS_TQ_AMT "Diagnosis counter for checksum counter error symptom detection" UBYTE _CNV_A_R_LINEAR_____10_CM 1 100. 0. 255. ECU_ADDRESS 0x3fd7de FORMAT "%3.0" /end MEASUREMENT
/begin MEASUREMENT CTR_DIAG_CKS_MSW "Diagnosis counter for checksum counter error symptom detection" UBYTE _CNV_A_R_LINEAR_____10_CM 1 100. 0. 255. ECU_ADDRESS 0x3fd7eb FORMAT "%3.0" /end MEASUREMENT
/begin MEASUREMENT CTR_DIAG_CKS_TQ_DCC "Diagnosis counter for checksum counter error symptom detection" UBYTE _CNV_A_R_LINEAR_____10_CM 1 100. 0. 255. ECU_ADDRESS 0x3fd7cd FORMAT "%3.0" /end MEASUREMENT
/begin MEASUREMENT CTR_DIAG_TOUT_ARS "Diagnosis counter for timeout counter error symptom detection" UBYTE _CNV_A_R_LINEAR_____10_CM 1 100. 0. 255. ECU_ADDRESS 0x3fd7d0 FORMAT "%3.0" /end MEASUREMENT
/begin MEASUREMENT CTR_DIAG_TOUT_CAS "Diagnosis counter for timeout counter error symptom detection" UBYTE _CNV_A_R_LINEAR_____10_CM 1 100. 0. 255. ECU_ADDRESS 0x3fd7d3 FORMAT "%3.0" /end MEASUREMENT
/begin MEASUREMENT CTR_DIAG_TOUT_TQ_TCS "Diagnosis counter for timeout counter error symptom detection" UBYTE _CNV_A_R_LINEAR_____10_CM 1 100. 0. 255. ECU_ADDRESS 0x3fd7d6 FORMAT "%3.0" /end MEASUREMENT
/begin MEASUREMENT CTR_DIAG_TOUT_VS_TCS "Diagnosis counter for timeout counter error symptom detection" UBYTE _CNV_A_R_LINEAR_____10_CM 1 100. 0. 255. ECU_ADDRESS 0x3fd7d7 FORMAT "%3.0" /end MEASUREMENT
/begin MEASUREMENT CTR_DIAG_TOUT_TCS "Diagnosis counter for timeout counter error symptom detection" UBYTE _CNV_A_R_LINEAR_____10_CM 1 100. 0. 255. ECU_ADDRESS 0x3fd7d8 FORMAT "%3.0" /end MEASUREMENT
/begin MEASUREMENT CTR_DIAG_TOUT_TQ_ETCU "Diagnosis counter for timeout counter error symptom detection" UBYTE _CNV_A_R_LINEAR_____10_CM 1 100. 0. 255. ECU_ADDRESS 0x3fd7db FORMAT "%3.0" /end MEASUREMENT
/begin MEASUREMENT CTR_DIAG_TOUT_ETCU "Diagnosis counter for timeout counter error symptom detection" UBYTE _CNV_A_R_LINEAR_____10_CM 1 100. 0. 255. ECU_ADDRESS 0x3fd7dc FORMAT "%3.0" /end MEASUREMENT
/begin MEASUREMENT CTR_DIAG_TOUT_TQ_AMT "Diagnosis counter for timeout counter error symptom detection" UBYTE _CNV_A_R_LINEAR_____10_CM 1 100. 0. 255. ECU_ADDRESS 0x3fd7df FORMAT "%3.0" /end MEASUREMENT
/begin MEASUREMENT CTR_DIAG_TOUT_TQ_DCC "Diagnosis counter for timeout counter error symptom detection" UBYTE _CNV_A_R_LINEAR_____10_CM 1 100. 0. 255. ECU_ADDRESS 0x3fd7ce FORMAT "%3.0" /end MEASUREMENT
/begin MEASUREMENT CTR_DIAG_TOUT_ACC "Diagnosis counter for timeout counter error symptom detection" UBYTE _CNV_A_R_LINEAR_____10_CM 1 100. 0. 255. ECU_ADDRESS 0x3fd7e0 FORMAT "%3.0" /end MEASUREMENT
/begin MEASUREMENT CTR_DIAG_TOUT_KM_ICL "Diagnosis counter for timeout counter error symptom detection" UBYTE _CNV_A_R_LINEAR_____10_CM 1 100. 0. 255. ECU_ADDRESS 0x3fd7e5 FORMAT "%3.0" /end MEASUREMENT
/begin MEASUREMENT CTR_DIAG_TOUT_ICL "Diagnosis counter for timeout counter error symptom detection" UBYTE _CNV_A_R_LINEAR_____10_CM 1 100. 0. 255. ECU_ADDRESS 0x3fd7e7 FORMAT "%3.0" /end MEASUREMENT
/begin MEASUREMENT CTR_DIAG_TOUT_POW_VB "Diagnosis counter for timeout counter error symptom detection" UBYTE _CNV_A_R_LINEAR_____10_CM 1 100. 0. 255. ECU_ADDRESS 0x3fd7e8 FORMAT "%3.0" /end MEASUREMENT
/begin MEASUREMENT CTR_DIAG_TOUT_POW_GEN "Diagnosis counter for timeout counter error symptom detection" UBYTE _CNV_A_R_LINEAR_____10_CM 1 100. 0. 255. ECU_ADDRESS 0x3fd7e9 FORMAT "%3.0" /end MEASUREMENT
/begin MEASUREMENT CTR_DIAG_TOUT_MSW "Diagnosis counter for timeout counter error symptom detection" UBYTE _CNV_A_R_LINEAR_____10_CM 1 100. 0. 255. ECU_ADDRESS 0x3fd7ec FORMAT "%3.0" /end MEASUREMENT
/begin MEASUREMENT CTR_DIAG_TOUT_T_ICL "Diagnosis counter for timeout counter error symptom detection" UBYTE _CNV_A_R_LINEAR_____10_CM 1 100. 0. 255. ECU_ADDRESS 0x3fd7e1 FORMAT "%3.0" /end MEASUREMENT
/begin MEASUREMENT CTR_DIAG_TOUT_ANG_PSTE "Diagnosis counter for timeout counter error symptom detection" UBYTE _CNV_A_R_LINEAR_____10_CM 1 100. 0. 255. ECU_ADDRESS 0x3fd7ed FORMAT "%3.0" /end MEASUREMENT
/begin MEASUREMENT CTR_DIAG_TCC_CAN_VEH_MOD "Diagnosis counter for alive counter error symptom detection" UBYTE _CNV_A_R_LINEAR_____10_CM 1 100. 0. 255. ECU_ADDRESS 0x3fd7e2 FORMAT "%3.0" /end MEASUREMENT
/begin MEASUREMENT CTR_DIAG_CKS_VEH_MOD "Diagnosis counter for checksum counter error symptom detection" UBYTE _CNV_A_R_LINEAR_____10_CM 1 100. 0. 255. ECU_ADDRESS 0x3fd7e3 FORMAT "%3.0" /end MEASUREMENT
/begin MEASUREMENT CTR_DIAG_TOUT_VEH_MOD "Diagnosis counter for timeout counter error symptom detection" UBYTE _CNV_A_R_LINEAR_____10_CM 1 100. 0. 255. ECU_ADDRESS 0x3fd7e4 FORMAT "%3.0" /end MEASUREMENT
/begin MEASUREMENT TQI_MSR_CAN "relative indicated engine torque requested by MSR" UBYTE _CNV_A_R_LINEAR_____4_CM 1 100. 0. 99.609375 ECU_ADDRESS 0x3fc485 FORMAT "%5.1" /end MEASUREMENT
/begin MEASUREMENT VS_CAN "vehicle speed signal from CAN" UBYTE _CNV_A_R_LINEAR_____13_CM 1 100. 0. 255. ECU_ADDRESS 0x3fc487 FORMAT "%3.0" /end MEASUREMENT
/begin MEASUREMENT WHEEL "vehicle speed signal from CAN for cruise control" UWORD _CNV_A_R_LINEAR_____78_CM 1 100. 0. 511.99218 ECU_ADDRESS 0x3fc482 FORMAT "%7.3" /end MEASUREMENT
/begin MEASUREMENT LV_PLAUS_ASR_CTL "logical variable for ASR intervention is active" UBYTE _CNV_S_2_RANGE______28_CM 1 100. 0. 1. ECU_ADDRESS 0x3fc48b /end MEASUREMENT
/begin MEASUREMENT LV_PLAUS_ESP_CTL "logical variable for DSC intervention is active" UBYTE _CNV_S_2_RANGE______28_CM 1 100. 0. 1. ECU_ADDRESS 0x3fc48d /end MEASUREMENT
/begin MEASUREMENT TQI_ASR_FAST_CAN "relative indicated engine torque requested by ASR (fast path)" UBYTE _CNV_A_R_LINEAR_____4_CM 1 100. 0. 99.609375 ECU_ADDRESS 0x3fc484 FORMAT "%5.1" /end MEASUREMENT
/begin MEASUREMENT LV_ERR_VS_CAN "logical variable for VS_CAN error" UBYTE _CNV_S_2_RANGE______21_R_CM 1 100. 0. 255. ECU_ADDRESS 0x3fc48a /end MEASUREMENT
/begin MEASUREMENT TQI_ASR_FAST_REQ_CAN "Relative indicated engine torque request by ASR (fast path)" SWORD _CNV_A_R_LINEAR_____48_CM 1 100. -1024. 1023.96875 ECU_ADDRESS 0x3fc47c FORMAT "%8.2" /end MEASUREMENT
/begin MEASUREMENT TQI_MSR_REQ_CAN "Relative indicated engine torque request by MSR" SWORD _CNV_A_R_LINEAR_____48_CM 1 100. -1024. 1023.96875 ECU_ADDRESS 0x3fc47e FORMAT "%8.2" /end MEASUREMENT
/begin MEASUREMENT TQI_ASR_SLOW_CAN "relative indicated engine torque requested by ASR (slow path)" UBYTE _CNV_A_R_LINEAR_____4_CM 1 100. 0. 99.609375 ECU_ADDRESS 0x3fc486 FORMAT "%5.1" /end MEASUREMENT
/begin MEASUREMENT TQI_ASR_SLOW_REQ_CAN "Relative indicated engine torque request by ASR (slow path)" SWORD _CNV_A_R_LINEAR_____48_CM 1 100. -1024. 1023.96875 ECU_ADDRESS 0x3fc480 FORMAT "%8.2" /end MEASUREMENT
/begin MEASUREMENT GEAR_SEL_DISP "Gear stick position" UBYTE _CNV_A_R_LINEAR_____10_CM 1 100. 0. 15. ECU_ADDRESS 0x3fd8f0 FORMAT "%2.0" /end MEASUREMENT
/begin MEASUREMENT TQI_GS_REQ_CAN "Relative torque request during gearshift intervention" UBYTE _CNV_A_R_LINEAR_____44_CM 1 100. 0. 0.996094 ECU_ADDRESS 0x3fc4a8 FORMAT "%5.3" /end MEASUREMENT
/begin MEASUREMENT TQ_GEAR_CAN "Torque from ETCU" UBYTE _CNV_A_R_LINEAR_____44_CM 1 100. 0. 0.996094 ECU_ADDRESS 0x3fc4ab FORMAT "%5.3" /end MEASUREMENT
/begin MEASUREMENT TQI_GS_REQ "Absolute torque request during gearshift intervention" SWORD _CNV_A_R_LINEAR_____48_CM 1 100. -1024. 1023.96875 ECU_ADDRESS 0x3fc4a6 FORMAT "%8.2" /end MEASUREMENT
/begin MEASUREMENT LV_TQ_GS_INC_REQ "logical variable indicating torque increase due to gear shift intervention" UBYTE _CNV_S_2_RANGE______28_CM 1 100. 0. 1. ECU_ADDRESS 0x3fc4af /end MEASUREMENT
/begin MEASUREMENT LV_TQ_GS_DEC_REQ "logical variable indicating torque decrese due to gear shift intervention " UBYTE _CNV_S_2_RANGE______28_CM 1 100. 0. 1. ECU_ADDRESS 0x3fc4ae /end MEASUREMENT
/begin MEASUREMENT TQ_ACCIN_CAN "ACC-torque from CAN" UBYTE _CNV_A_R_LINEAR_____84_CM 1 100. 0. 31. ECU_ADDRESS 0x3fc4bc FORMAT "%3.0" /end MEASUREMENT
/begin MEASUREMENT STATE_EFP_CRASH_CAN "Request for switch off fuel pump after crash" UBYTE _CNV_A_R_LINEAR_____10_CM 1 100. 0. 3. ECU_ADDRESS 0x3fc4bb FORMAT "%2.0" /end MEASUREMENT
/begin MEASUREMENT LV_REQ_HEAT "LV increased heater power request" UBYTE _CNV_S_2_RANGE______11_CM 1 100. 0. 1. ECU_ADDRESS 0x3fc4c9 BIT_MASK 0x1 /end MEASUREMENT
/begin CHARACTERISTIC C_CTR_KM_SUB "" VALUE 0x42c98 _REC_VAL_20_u2 655350. _CNV_A_R_LINEAR_____80_CM 0. 655350. FORMAT "%7.0" /end CHARACTERISTIC
/begin MEASUREMENT LV_LTG_SWI_CAN "logical variable for day- (0)or night lighting (1)" UBYTE _CNV_S_2_RANGE______28_CM 1 100. 0. 1. ECU_ADDRESS 0x3fc4c7 /end MEASUREMENT
/begin MEASUREMENT LV_TAM_CAN_ERR "logical variable for erroneous ambient temperature signal" UBYTE _CNV_S_2_RANGE______28_CM 1 100. 0. 1. ECU_ADDRESS 0x3fc4c2 /end MEASUREMENT
/begin MEASUREMENT STATE_GEAR_REV_CAN "state reverse gear: 0 inactiv, 1 activ" UBYTE _CNV_S_2_RANGE______28_CM 1 100. 0. 1. ECU_ADDRESS 0x3fc4c8 /end MEASUREMENT
/begin MEASUREMENT FTL "fuel tank level" UBYTE _CNV_A_R_LINEAR_____85_CM 1 100. 0. 127. ECU_ADDRESS 0x3fc4b8 FORMAT "%3.0" /end MEASUREMENT
/begin MEASUREMENT LV_FTL_CAN_ERR "logical value erroneous fuel tank level signal" UBYTE _CNV_S_2_RANGE______28_CM 1 100. 0. 1. ECU_ADDRESS 0x3fc4c4 /end MEASUREMENT
/begin MEASUREMENT VEL_ANG_PSTE "sttering wheel sensor velocity" SWORD _CNV_A_R_LINEAR_____86_CM 1 100. -1433.6 1433.6 ECU_ADDRESS 0x3fc4ce FORMAT "%8.3" /end MEASUREMENT
/begin MEASUREMENT STATE_SENS_ANG_PSTE "status of wheel sensor" UBYTE _CNV_A_R_LINEAR_____10_CM 1 100. 0. 7. ECU_ADDRESS 0x3fc4db FORMAT "%2.0" /end MEASUREMENT
/begin MEASUREMENT LV_VAR_PSTE "LV power steering detected - BN2000" UBYTE _CNV_S_2_RANGE______28_CM 1 100. 0. 1. ECU_ADDRESS 0x3fc4dd /end MEASUREMENT
/begin MEASUREMENT LV_CITY "sttering wheel sensor angle" UBYTE _CNV_S_2_RANGE______28_CM 1 100. 0. 1. ECU_ADDRESS 0x3fc4ec /end MEASUREMENT
/begin MEASUREMENT TQI_SLOW_AMT_REQ_CAN "torque request (slow) SSG via CAN" UBYTE _CNV_A_R_LINEAR_____4_CM 1 100. 0. 99.609375 ECU_ADDRESS 0x3fc4e8 FORMAT "%5.1" /end MEASUREMENT
/begin MEASUREMENT TQI_AMT_REQ " torque request SSG" SWORD _CNV_A_R_LINEAR_____48_CM 1 100. -1024. 1023.96875 ECU_ADDRESS 0x3fc4de FORMAT "%8.2" /end MEASUREMENT
/begin MEASUREMENT TQI_SLOW_AMT_REQ " torque request (slow) SSG" SWORD _CNV_A_R_LINEAR_____48_CM 1 100. -1024. 1023.96875 ECU_ADDRESS 0x3fc4e0 FORMAT "%8.2" /end MEASUREMENT
/begin MEASUREMENT TQI_AMT_REQ_CAN "torque requested SSG via CAN" UBYTE _CNV_A_R_LINEAR_____4_CM 1 100. 0. 99.609375 ECU_ADDRESS 0x3fc4e7 FORMAT "%5.1" /end MEASUREMENT
/begin MEASUREMENT TQI_AMT_CPL_CAN "complement SSG via CAN" UBYTE _CNV_A_R_LINEAR_____4_CM 1 100. 0. 99.609375 ECU_ADDRESS 0x3fc4e9 FORMAT "%5.1" /end MEASUREMENT
/begin MEASUREMENT TCC_CAN_AMT_1 "alive counter SSG" UBYTE _CNV_A_R_LINEAR_____12_CM 1 100. 0. 14. ECU_ADDRESS 0x3fc4eb FORMAT "%2.0" /end MEASUREMENT
/begin MEASUREMENT STATE_AMT_OBD_ERR "status OBD-relevant error - AMT" UBYTE _CNV_S_3_STATE_ETCU_67_CM 1 100. 0. 2. ECU_ADDRESS 0x3fc4e4 /end MEASUREMENT
/begin MEASUREMENT STATE_AMT "status shift-process AMT via CAN" UBYTE _CNV_S_5_STATE_AMT_91_CM 1 100. 0. 7. ECU_ADDRESS 0x3fc4e6 /end MEASUREMENT
/begin MEASUREMENT STATE_CLU_AMT "status shift-process AMT via CAN" UBYTE _CNV_S_5_STATE_CLU__92_CM 1 100. 0. 7. ECU_ADDRESS 0x3fc4ea /end MEASUREMENT
/begin MEASUREMENT LV_TQ_AMT_DEC_REQ "logical variable indicating torque decrease due to AMT intervention" UBYTE _CNV_S_2_RANGE______28_CM 1 100. 0. 1. ECU_ADDRESS 0x3fc4f1 /end MEASUREMENT
/begin MEASUREMENT LV_TQ_AMT_INC_REQ "logical variable indicating torque increase due to AMT intervention" UBYTE _CNV_S_2_RANGE______28_CM 1 100. 0. 1. ECU_ADDRESS 0x3fc4f2 /end MEASUREMENT
/begin MEASUREMENT N_MAX_AMT_CAN "engine speed limit AMT via CAN" UWORD _CNV_A_R_LINEAR_____17_CM 1 100. 0. 8160. ECU_ADDRESS 0x3fc4e2 FORMAT "%4.0" /end MEASUREMENT
/begin MEASUREMENT LV_AMT_ES "LV indicating engine stop via CAN" UBYTE _CNV_S_2_RANGE______28_CM 1 100. 0. 1. ECU_ADDRESS 0x3fc4ee /end MEASUREMENT
/begin MEASUREMENT LV_GS "LV indicating GS - AMT" UBYTE _CNV_S_2_RANGE______28_CM 1 100. 0. 1. ECU_ADDRESS 0x3fc4ed /end MEASUREMENT
/begin MEASUREMENT LV_GP "LV  indicating mode gearbox - AMT" UBYTE _CNV_S_2_RANGE______28_CM 1 100. 0. 1. ECU_ADDRESS 0x3fc4ef /end MEASUREMENT
/begin MEASUREMENT STATE_AMT_OBD "status OBD gearbox" UBYTE _CNV_S_9_STATE_AMT__93_CM 1 100. 0. 15. ECU_ADDRESS 0x3fc4e5 /end MEASUREMENT
/begin MEASUREMENT LV_PUMP_AMT_ON "LV  indicating status of hydraulic pump - AMT" UBYTE _CNV_S_2_RANGE______28_CM 1 100. 0. 1. ECU_ADDRESS 0x3fc4f0 /end MEASUREMENT
/begin MEASUREMENT LV_VAR_AMT "SSG transmission recognized" UBYTE _CNV_S_2_RANGE______28_CM 1 100. 0. 1. ECU_ADDRESS 0x3fc4f3 /end MEASUREMENT
/begin MEASUREMENT STATE_TXU_CR "Current range state" UBYTE _CNV_A_R_LINEAR_____10_CM 1 100. 0. 7. ECU_ADDRESS 0x3fc4f4 FORMAT "%2.0" /end MEASUREMENT
/begin MEASUREMENT STATE_TXU_TR "Target range state" UBYTE _CNV_A_R_LINEAR_____10_CM 1 100. 0. 7. ECU_ADDRESS 0x3fd950 FORMAT "%2.0" /end MEASUREMENT
/begin MEASUREMENT STATE_TXU_ERR "TXU error status" UBYTE _CNV_A_R_LINEAR_____10_CM 1 100. 0. 15. ECU_ADDRESS 0x3fd951 FORMAT "%2.0" /end MEASUREMENT
/begin MEASUREMENT STATE_TXU "TXU status" UBYTE _CNV_A_R_LINEAR_____10_CM 1 100. 0. 15. ECU_ADDRESS 0x3fd952 FORMAT "%2.0" /end MEASUREMENT
/begin MEASUREMENT STATE_TXU_MT "status manual transmission" UBYTE _CNV_A_R_LINEAR_____10_CM 1 100. 0. 1. ECU_ADDRESS 0x3fd954 FORMAT "%2.0" /end MEASUREMENT
/begin MEASUREMENT TXU_WAL "Warning light transfer case control unit" UBYTE _CNV_A_R_LINEAR_____10_CM 1 100. 0. 1. ECU_ADDRESS 0x3fd955 FORMAT "%2.0" /end MEASUREMENT
/begin MEASUREMENT TXU_DISP_COGS_SUM "Display transfer case cogs" UBYTE _CNV_A_R_LINEAR_____10_CM 1 100. 0. 3. ECU_ADDRESS 0x3fd956 FORMAT "%2.0" /end MEASUREMENT
/begin MEASUREMENT TXU_DISP_RNG_SUM "Display transfer case range" UBYTE _CNV_A_R_LINEAR_____10_CM 1 100. 0. 3. ECU_ADDRESS 0x3fd957 FORMAT "%2.0" /end MEASUREMENT
/begin MEASUREMENT TXU_DISP_GEAR_SUM "Display transfer case gear" UBYTE _CNV_A_R_LINEAR_____10_CM 1 100. 0. 15. ECU_ADDRESS 0x3fd958 FORMAT "%2.0" /end MEASUREMENT
/begin MEASUREMENT TQI_TXU "Torque override for TXU function" UBYTE _CNV_A_R_LINEAR_____4_CM 1 100. 0. 99.609375 ECU_ADDRESS 0x3fd953 FORMAT "%5.2" /end MEASUREMENT
/begin CHARACTERISTIC C_EXC_INI "initialization value of valve lift eccentric" VALUE 0x42cfa _REC_VAL_20_u2 99.99847412 _CNV_A_R_LINEAR_____94_CM 0. 99.99847412 /end CHARACTERISTIC
/begin CHARACTERISTIC C_STATE_VVL "Calibratable State Bit of VVL Basic Function (Command to VVL conrol unit)" VALUE 0x429a5 _REC_VAL_20_u1 7. _CNV_A_R_LINEAR_____10_CM 0. 7. FORMAT "%2.0" /end CHARACTERISTIC
/begin CHARACTERISTIC C_STATE_VVL_AD "Calibratable State Bit of Valve Lift Learning (Command to VVL conrol unit)" VALUE 0x429a6 _REC_VAL_20_u1 7. _CNV_A_R_LINEAR_____10_CM 0. 7. FORMAT "%2.0" /end CHARACTERISTIC
/begin MEASUREMENT EXC_AV_REL "" UWORD _CNV_A_R_LINEAR_____94_CM 1 100. 0. 99.99847412 ECU_ADDRESS 0x3fc4f6 /end MEASUREMENT
/begin MEASUREMENT LV_CT "Logical variable detection of driver passive" UBYTE _CNV_S_2_RANGE______28_CM 1 100. 0. 1. ECU_ADDRESS 0x3fcd54 BIT_MASK 0x1 /end MEASUREMENT
/begin MEASUREMENT FAST_ECU_TRAN_PWL_CTR "fast transition counter for transition from SYN_ENG_IGK_OFF to PWL despite engine running" UWORD _CNV_A_R_LINEAR_____27_CM 1 100. 0. 655.35 ECU_ADDRESS 0x3fe0f4 FORMAT "%6.2" /end MEASUREMENT
/begin MEASUREMENT LV_ERR_ECU_CKS "ECU_CKS error detected" UBYTE _CNV_S_2_RANGE______21_R_CM 1 100. 0. 255. ECU_ADDRESS 0x3fd3ef BIT_MASK 0x1 /end MEASUREMENT
/begin MEASUREMENT LV_ERR_ECU_RAM "Present error flag ECU_RAM" UBYTE _CNV_S_2_RANGE______21_R_CM 1 100. 0. 255. ECU_ADDRESS 0x3fd5cb BIT_MASK 0x1 /end MEASUREMENT
/begin MEASUREMENT LV_ERR_BN_CAS "Present error BN2000" UBYTE _CNV_S_2_RANGE______21_R_CM 1 100. 0. 255. ECU_ADDRESS 0x3fd62f /end MEASUREMENT
/begin MEASUREMENT LV_ERR_BN_ACC "Present error BN2000" UBYTE _CNV_S_2_RANGE______21_R_CM 1 100. 0. 255. ECU_ADDRESS 0x3fd64b /end MEASUREMENT
/begin MEASUREMENT LV_ERR_BN_T_ICL "Present error BN2000" UBYTE _CNV_S_2_RANGE______21_R_CM 1 100. 0. 255. ECU_ADDRESS 0x3fd64f /end MEASUREMENT
/begin MEASUREMENT LV_ERR_BN_KM_ICL "Present error BN2000" UBYTE _CNV_S_2_RANGE______21_R_CM 1 100. 0. 255. ECU_ADDRESS 0x3fd657 /end MEASUREMENT
/begin MEASUREMENT LV_ERR_BN_ICL "Present error BN2000" UBYTE _CNV_S_2_RANGE______21_R_CM 1 100. 0. 255. ECU_ADDRESS 0x3fd65b /end MEASUREMENT
/begin MEASUREMENT LV_ERR_BN_POW_VB "Present error BN2000" UBYTE _CNV_S_2_RANGE______21_R_CM 1 100. 0. 255. ECU_ADDRESS 0x3fd65f /end MEASUREMENT
/begin MEASUREMENT LV_ERR_BN_POW_GEN "Present error BN2000" UBYTE _CNV_S_2_RANGE______21_R_CM 1 100. 0. 255. ECU_ADDRESS 0x3fd663 /end MEASUREMENT
/begin MEASUREMENT LV_ERR_BN_VEH_MOD "Present error BN2000" UBYTE _CNV_S_2_RANGE______21_R_CM 1 100. 0. 255. ECU_ADDRESS 0x3fd653 /end MEASUREMENT
/begin MEASUREMENT LV_FUP_AFS_REQ "Logical variable for requesting homogeneous mode" UBYTE _CNV_A_R_LINEAR_____12_CM 1 100. 0. 1. ECU_ADDRESS 0x3fc5ee FORMAT "%1.0" BIT_MASK 0x1 /end MEASUREMENT
/begin MEASUREMENT LV_FUP_CLC_SWI "logical variable for fuel pressure acquisition for port injection (precontrolled) or high pressure direct injection (measured)" UBYTE _CNV_A_R_LINEAR_____12_CM 1 100. 0. 1. ECU_ADDRESS 0x3fdae3 FORMAT "%1.0" /end MEASUREMENT
/begin MEASUREMENT FUP_MES_MMV "fuel pressure moving mean value" UWORD _CNV_A_R_LINEAR_____190_CM 1 100. 0. 173888. ECU_ADDRESS 0x3fc5ec FORMAT "%6.0" /end MEASUREMENT
/begin MEASUREMENT FUP_MES "measured fuel pressure value" UWORD _CNV_A_R_LINEAR_____190_CM 1 100. 0. 173888. ECU_ADDRESS 0x3fc5ea FORMAT "%6.0" /end MEASUREMENT
/begin MEASUREMENT FUP "fuel pressure value" UWORD _CNV_A_R_LINEAR_____190_CM 1 100. 0. 173888. ECU_ADDRESS 0x3fc5e8 FORMAT "%6.0" /end MEASUREMENT
/begin CHARACTERISTIC C_FUP_NOM "Nominal fuel pressure" VALUE 0x42d8c _REC_VAL_20_u2 5434. _CNV_A_R_LINEAR_____43_CM 0. 5434. FORMAT "%7.2" /end CHARACTERISTIC
/begin CHARACTERISTIC C_FUP_MES_CRLC "Fuel pressure filter factor" VALUE 0x428cb _REC_VAL_20_u1 0.99610001 _CNV_A_R_LINEAR_____20_CM 0. 0.99610001 FORMAT "%5.3" /end CHARACTERISTIC
/begin CHARACTERISTIC IP_FUP_MES "Fuel pressure sensor linearisation table" CURVE 0x48076 _REC_CUR_20_u2_u2 173888. _CNV_A_R_LINEAR_____190_CM 0. 173888. FORMAT "%6.0"
 /begin AXIS_DESCR COM_AXIS V_FPS _CNV_A_R_LINEAR_____33_CM 8 0. 4.99511719 FORMAT "%5.3" AXIS_PTS_REF ldp_fup_bas__fup_mes /end AXIS_DESCR
/end CHARACTERISTIC
/begin CHARACTERISTIC C_FUP_AFS_REQ "Fuel pressure limit for requesting homogeneous mode" VALUE 0x42d84 _REC_VAL_20_u2 173888. _CNV_A_R_LINEAR_____190_CM 0. 173888. FORMAT "%6.0" /end CHARACTERISTIC
/begin CHARACTERISTIC C_FUP_AFS_REQ_HYS "Hysteresis for fuel pressure limit for allowing stratified mode" VALUE 0x42d86 _REC_VAL_20_u2 173888. _CNV_A_R_LINEAR_____190_CM 0. 173888. FORMAT "%6.0" /end CHARACTERISTIC
/begin AXIS_PTS ldp_fup_bas__fup_mes "" 0x443c2 FUP_BAS _REC_AXS_20_u2 4.99511719 _CNV_A_R_LINEAR_____33_CM 8 0. 4.99511719 FORMAT "%5.3" /end AXIS_PTS
/begin CHARACTERISTIC C_FUP_OFS_ST "Fuel pressure offset on FUP_SP to switch to state 2 (Pressure control)" VALUE 0x42d90 _REC_VAL_20_u2 173888. _CNV_A_R_LINEAR_____190_CM 0. 173888. FORMAT "%6.0" /end CHARACTERISTIC
/begin CHARACTERISTIC C_FUP_MAX "Fuel pressure maximum threshold" VALUE 0x42d8a _REC_VAL_20_u2 173888. _CNV_A_R_LINEAR_____190_CM 0. 173888. FORMAT "%6.0" /end CHARACTERISTIC
/begin CHARACTERISTIC C_FUP_OFS_CTL "Fuel pressure offset on FUP_SP to switch to state 1 (Fast pressure increase)" VALUE 0x42d8e _REC_VAL_20_u2 173888. _CNV_A_R_LINEAR_____190_CM 0. 173888. FORMAT "%6.0" /end CHARACTERISTIC
/begin CHARACTERISTIC C_T_DLY_ERR_FPS "Time delay for transition to STATE_FUP = 2" VALUE 0x429d9 _REC_VAL_20_u1 2550. _CNV_A_R_LINEAR_____23_CM 0. 2550. FORMAT "%4.0" /end CHARACTERISTIC
/begin CHARACTERISTIC C_T_DLY_FPA_CLL_REQ "Maximum time for staying in STATE_FUP = 1" VALUE 0x42f88 _REC_VAL_20_u2 655350. _CNV_A_R_LINEAR_____23_CM 0. 655350. FORMAT "%6.0" /end CHARACTERISTIC
/begin CHARACTERISTIC C_T_DLY_FPA_PROT "Maximum time for staying in STATE_FUP = 2 for overheat protection" VALUE 0x42f8a _REC_VAL_20_u2 655350. _CNV_A_R_LINEAR_____23_CM 0. 655350. FORMAT "%6.0" /end CHARACTERISTIC
/begin CHARACTERISTIC C_N_32_FPA "Engine speed threshold to go to STATE_FUP = 1" VALUE 0x42926 _REC_VAL_20_u1 8160. _CNV_A_R_LINEAR_____5_CM 0. 8160. FORMAT "%4.0" /end CHARACTERISTIC
/begin CHARACTERISTIC C_T_DLY_FUP_MAX "Time delay for overpressure detection" VALUE 0x429df _REC_VAL_20_u1 2540. _CNV_A_R_LINEAR_____23_CM 10. 2550. FORMAT "%4.0" /end CHARACTERISTIC
/begin MEASUREMENT LV_ERR_BN_TQ_ETCU "Present error BN2000" UBYTE _CNV_S_2_RANGE______21_R_CM 1 100. 0. 255. ECU_ADDRESS 0x3fd63f /end MEASUREMENT
/begin CHARACTERISTIC IP_FAC_IVVT__VO "relative wave overlap" CURVE 0x4e1ca _REC_CUR_20_u1_u1 0.9960940000000002 _CNV_A_R_LINEAR_____44_CM 0. 0.996094 FORMAT "%5.3"
 /begin AXIS_DESCR COM_AXIS VO _CNV_A_R_LINEAR_____75_CM 8 0. 95.625 FORMAT "%5.2" AXIS_PTS_REF ldp_vo_fac_ivvt /end AXIS_DESCR
/end CHARACTERISTIC
/begin MEASUREMENT VO_MIN "valve overlap minimum" UBYTE _CNV_A_R_LINEAR_____75_CM 1 100. 0. 95.625 ECU_ADDRESS 0x3fcb11 FORMAT "%5.2" /end MEASUREMENT
/begin MEASUREMENT VO_MAX "valve overlap maximum" UBYTE _CNV_A_R_LINEAR_____75_CM 1 100. 0. 95.625 ECU_ADDRESS 0x3fcb12 FORMAT "%5.2" /end MEASUREMENT
/begin MEASUREMENT CAM_AV_MV_IN "Average value inlet-CAM position" SWORD _CNV_A_R_LINEAR_____232_CM 1 100. -768. 767.9765625 ECU_ADDRESS 0x3fcb0e FORMAT "%7.2" /end MEASUREMENT
/begin MEASUREMENT MAF_IVVT "Feedback free engine load for IVVT setpoint calculation" UWORD _CNV_A_R_LINEAR_____95_CM 1 100. 0. 1389. ECU_ADDRESS 0x3fcb0c FORMAT "%7.2" /end MEASUREMENT
/begin MEASUREMENT VO "actual valve overlap" UBYTE _CNV_A_R_LINEAR_____75_CM 1 100. 0. 95.625 ECU_ADDRESS 0x3fcb10 FORMAT "%5.2" /end MEASUREMENT
/begin MEASUREMENT FAC_IVVT "value representing the relative valve overlap" UBYTE _CNV_A_R_LINEAR_____253_CM 1 100. 0. 0.996094 ECU_ADDRESS 0x3fcb15 FORMAT "%5.3" /end MEASUREMENT
/begin MEASUREMENT VO_2 "valve overlap cylinder bank 2" UBYTE _CNV_A_R_LINEAR_____75_CM 1 100. 0. 95.625 ECU_ADDRESS 0x3fdbf2 FORMAT "%5.2" /end MEASUREMENT
/begin MEASUREMENT VO_1 "valve overlap cylinder bank 1" UBYTE _CNV_A_R_LINEAR_____75_CM 1 100. 0. 95.625 ECU_ADDRESS 0x3fdbf1 FORMAT "%5.2" /end MEASUREMENT
/begin MEASUREMENT VO_SP "valve overlap setpoint" UBYTE _CNV_A_R_LINEAR_____75_CM 1 100. 0. 95.625 ECU_ADDRESS 0x3fcb13 FORMAT "%5.2" /end MEASUREMENT
/begin MEASUREMENT VO_SP_REF "valve overlap setpoint at reference conditions (warm engine)" UBYTE _CNV_A_R_LINEAR_____75_CM 1 100. 0. 95.625 ECU_ADDRESS 0x3fcb14 FORMAT "%5.2" /end MEASUREMENT
/begin AXIS_PTS ldp_vo_fac_ivvt "" 0x43b1b VO _REC_AXS_20_u1 95.625 _CNV_A_R_LINEAR_____75_CM 8 0. 95.625 FORMAT "%5.2" /end AXIS_PTS
/begin MEASUREMENT VLS_UP_1 "Upstream oxygen sensor voltage" UWORD _CNV_A_R_LINEAR_____33_CM 1 100. 0. 4.99511719 ECU_ADDRESS 0x3fa8ec FORMAT "%5.3" /end MEASUREMENT
/begin MEASUREMENT VLS_UP_2 "Upstream oxygen sensor voltage" UWORD _CNV_A_R_LINEAR_____33_CM 1 100. 0. 4.99511719 ECU_ADDRESS 0x3fac04 FORMAT "%5.3" /end MEASUREMENT
/begin MEASUREMENT MAF_KGH_MES_BAS "Raw air-mass flow measured (without correction, to be used for diagnosis only)" UWORD _CNV_A_R_LINEAR_____101_CM 1 100. 0. 2047.96875 ECU_ADDRESS 0x3fc60c FORMAT "%7.2" /end MEASUREMENT
/begin MEASUREMENT MAF_MES "Mass air flow per segment" UWORD _CNV_A_R_LINEAR_____95_CM 1 100. 0. 1389. ECU_ADDRESS 0x3fc60e FORMAT "%6.2" /end MEASUREMENT
/begin MEASUREMENT MAF_KGH_MES "Mass air flow per segment measured" UWORD _CNV_A_R_LINEAR_____101_CM 1 100. 0. 2047.96875 ECU_ADDRESS 0x3fc60a FORMAT "%7.2" /end MEASUREMENT
/begin MEASUREMENT MAF_CYL_STK "Air mass flow out of the intake manifold per stroke" UWORD _CNV_A_R_LINEAR_____95_CM 1 100. 0. 1389. ECU_ADDRESS 0x3fc620 FORMAT "%6.2" /end MEASUREMENT
/begin MEASUREMENT MAF_KGH_CLC "Calculated value of MAF_KGH out of manifold model" UWORD _CNV_A_R_LINEAR_____101_CM 1 100. 0. 2047.96875 ECU_ADDRESS 0x3fc61a FORMAT "%7.2" /end MEASUREMENT
/begin MEASUREMENT MAP_EGR "Residual gas partial pressure in the manifold" UWORD _CNV_A_R_LINEAR_____43_CM 1 100. 0. 5434. ECU_ADDRESS 0x3fc62e FORMAT "%7.2" /end MEASUREMENT
/begin MEASUREMENT MAP_EGR_PRED "Predicted residual gas partial manifold air pressure" UWORD _CNV_A_R_LINEAR_____43_CM 1 100. 0. 5434. ECU_ADDRESS 0x3fdb1a FORMAT "%7.2" /end MEASUREMENT
/begin MEASUREMENT MAP_FG_PRED "Predicted fresh gas partial manifold air pressure" UWORD _CNV_A_R_LINEAR_____43_CM 1 100. 0. 5434. ECU_ADDRESS 0x3fdb1c FORMAT "%7.2" /end MEASUREMENT
/begin MEASUREMENT MAP_PRED "Predicted manifold air pressure" UWORD _CNV_A_R_LINEAR_____43_CM 1 100. 0. 5434. ECU_ADDRESS 0x3fdb18 FORMAT "%7.2" /end MEASUREMENT
/begin MEASUREMENT MAP_FG "Fresh gas partial pressure in the manifold" UWORD _CNV_A_R_LINEAR_____43_CM 1 100. 0. 5434. ECU_ADDRESS 0x3fc638 FORMAT "%7.2" /end MEASUREMENT
/begin MEASUREMENT PQ "Pressure quotient at the throttle" UWORD _CNV_A_R_LINEAR_____31_CM 1 100. 0. 0.99998474 ECU_ADDRESS 0x3fc636 FORMAT "%7.5" /end MEASUREMENT
/begin MEASUREMENT PQ_EGR "Pressure quotient at the EGR - valve" UWORD _CNV_A_R_LINEAR_____31_CM 1 100. 0. 0.99998474 ECU_ADDRESS 0x3fc630 FORMAT "%7.5" /end MEASUREMENT
/begin MEASUREMENT PQ_EGR_ESTIM "Estimated pressure quotient at the EGR - valve" UWORD _CNV_A_R_LINEAR_____31_CM 1 100. 0. 0.99998474 ECU_ADDRESS 0x3fdb22 FORMAT "%7.5" /end MEASUREMENT
/begin MEASUREMENT MAF_THR "Air mass flow at the throttle" UWORD _CNV_A_R_LINEAR_____101_CM 1 100. 0. 2047.96875 ECU_ADDRESS 0x3fc61c FORMAT "%7.2" /end MEASUREMENT
/begin MEASUREMENT MAF_EGR "Air mass flow at the EGR -valve" UWORD _CNV_A_R_LINEAR_____101_CM 1 100. 0. 2047.96875 ECU_ADDRESS 0x3fc62c FORMAT "%7.2" /end MEASUREMENT
/begin MEASUREMENT MAP_DRV1 "First derivative of  intake  manifold pressure " SWORD _CNV_A_R_LINEAR_____331_CM 1 100. -82.91625999999999 82.91377 ECU_ADDRESS 0x3fc63c FORMAT "%7.3" /end MEASUREMENT
/begin MEASUREMENT MAP_EGR_DRV1 "First derivative of  intake  manifold residual gas pressure " SWORD _CNV_A_R_LINEAR_____331_CM 1 100. -82.91625999999999 82.91377 ECU_ADDRESS 0x3fdb16 FORMAT "%5.3" /end MEASUREMENT
/begin MEASUREMENT MAF_EGR_CON_1 "sqrt(2x/((x-1)*RA*TEG_EGR)) with x = kappa = 1.4" UWORD _CNV_A_R_LINEAR_____332_CM 1 100. 0. 2.06019e-002 ECU_ADDRESS 0x3fc624 FORMAT "%8.7" /end MEASUREMENT
/begin MEASUREMENT MAF_FAC_OFS "Offset of the air flow equation for the throttle air mass flow" UWORD _CNV_A_R_LINEAR_____170_CM 1 100. 0. 8.880330000000001 ECU_ADDRESS 0x3fc632 FORMAT "%6.4" /end MEASUREMENT
/begin MEASUREMENT MAF_FAC_OFS_EGR "Offset of the air flow equation for the EGR air mass flow" UWORD _CNV_A_R_LINEAR_____170_CM 1 100. 0. 8.880330000000001 ECU_ADDRESS 0x3fc626 FORMAT "%6.4" /end MEASUREMENT
/begin MEASUREMENT MAF_FAC_SLOP "Slope of the air flow equation for the throttle air mass flow" UWORD _CNV_A_R_LINEAR_____170_CM 1 100. 0. 8.880330000000001 ECU_ADDRESS 0x3fc634 FORMAT "%6.4" /end MEASUREMENT
/begin CHARACTERISTIC IP_MAF_MDL_CON_1__TIA "Temperature influence air flow function at the throttle" CURVE 0x490a6 _REC_CUR_20_u2_u1 2.06019e-002 _CNV_A_R_LINEAR_____332_CM 0. 2.06019e-002 FORMAT "%8.7"
 /begin AXIS_DESCR COM_AXIS TIA _CNV_A_R_LINEAR_____0_CM 8 -48. 142.5 FORMAT "%5.1" AXIS_PTS_REF ldpm_tia_maf_mdl_con_1 /end AXIS_DESCR
/end CHARACTERISTIC
/begin CHARACTERISTIC IP_MAF_EGR_CON_1__TEG_EGR "Temperature influence air flow function at the EGR-Valve" CURVE 0x49042 _REC_CUR_20_u2_u2 2.06019e-002 _CNV_A_R_LINEAR_____332_CM 0. 2.06019e-002 FORMAT "%8.7"
 /begin AXIS_DESCR COM_AXIS TEG_EGR _CNV_A_R_LINEAR_____211_CM 8 0. 2047. FORMAT "%7.2" AXIS_PTS_REF ldp_teg_egr_maf_egr_con_1 /end AXIS_DESCR
/end CHARACTERISTIC
/begin CHARACTERISTIC IP_PRED_FAC__N "Prediction factor" CURVE 0x4fd29 _REC_CUR_20_u1_u1 7.96875 _CNV_A_R_LINEAR_____240_CM 0. 7.96875 FORMAT "%4.2"
 /begin AXIS_DESCR COM_AXIS N_32 _CNV_A_R_LINEAR_____5_CM 6 0. 8160. FORMAT "%4.0" AXIS_PTS_REF ldpm_n_32_ar_red /end AXIS_DESCR
/end CHARACTERISTIC
/begin MEASUREMENT MAF_CYL "Mass air flow out of intake manifold" UWORD _CNV_A_R_LINEAR_____101_CM 1 100. 0. 2047.96875 ECU_ADDRESS 0x3fc61e FORMAT "%7.2" /end MEASUREMENT
/begin MEASUREMENT MAF_FG_CYL "Fresh air mass flow in the cylinder" UWORD _CNV_A_R_LINEAR_____101_CM 1 100. 0. 2047.96875 ECU_ADDRESS 0x3fc644 FORMAT "%7.2" /end MEASUREMENT
/begin MEASUREMENT MAF_FG_CYL_STK "Fresh air mass flow in the cylinder per stroke" UWORD _CNV_A_R_LINEAR_____95_CM 1 100. 0. 1389. ECU_ADDRESS 0x3fc646 FORMAT "%7.2" /end MEASUREMENT
/begin MEASUREMENT FAC_MAF_MAX "Ratio between MAF und MAX_COR" UWORD _CNV_A_R_LINEAR_____45_CM 1 100. 0. 1.99996948 ECU_ADDRESS 0x3fc64a FORMAT "%7.5" /end MEASUREMENT
/begin CHARACTERISTIC C_MAF_MMV_DIF_CRLC "MAF moving mean value filtering factor" VALUE 0x42904 _REC_VAL_20_u1 9.960940000000002e-002 _CNV_A_R_LINEAR_____44_CM 0. 0.996094 FORMAT "%5.3" /end CHARACTERISTIC
/begin MEASUREMENT MAF_FAC_SLOP_EGR "Slope of the air flow equation for the EGR mass air flow" UWORD _CNV_A_R_LINEAR_____170_CM 1 100. 0. 8.880330000000001 ECU_ADDRESS 0x3fc628 FORMAT "%6.4" /end MEASUREMENT
/begin MEASUREMENT MAF_MDL_CON_1 "sqrt(2x/((x-1)*RA*TIA)) with x = kappa = 1.4" UWORD _CNV_A_R_LINEAR_____332_CM 1 100. 0. 2.06019e-002 ECU_ADDRESS 0x3fc622 FORMAT "%8.7" /end MEASUREMENT
/begin MEASUREMENT MAF_MDL_CON_0 "sqrt(2x/((x-1)*RA*TIA)) with x = kappa = 1.4" UWORD _CNV_A_R_LINEAR_____333_CM 1 100. 0. 58352820. ECU_ADDRESS 0x3fdb24 FORMAT "%9.0" /end MEASUREMENT
/begin MEASUREMENT MAP "Manifold air pressure" UWORD _CNV_A_R_LINEAR_____43_CM 1 100. 0. 5434. ECU_ADDRESS 0x3fc63a FORMAT "%7.2" /end MEASUREMENT
/begin MEASUREMENT MAF_KGH "Mass air flow per segment" UWORD _CNV_A_R_LINEAR_____101_CM 1 100. 0. 2047.96875 ECU_ADDRESS 0x3fc640 FORMAT "%7.2" /end MEASUREMENT
/begin MEASUREMENT MAF_DIF "Mass air flow difference per segment" SWORD _CNV_A_R_LINEAR_____261_CM 1 100. -694.5 694.478806 ECU_ADDRESS 0x3fc63e FORMAT "%7.2" /end MEASUREMENT
/begin MEASUREMENT MAF_ISA_FAC_OFS "offset of the air flow equation for the throttle air mass flow for ISA" UWORD _CNV_A_R_LINEAR_____170_CM 1 100. 0. 8.880330000000001 ECU_ADDRESS 0x3fc64c FORMAT "%6.4" /end MEASUREMENT
/begin MEASUREMENT MAF_ISA_FAC_SLOP "slope of the air flow equation for the throttle air mass flow for ISA" UWORD _CNV_A_R_LINEAR_____170_CM 1 100. 0. 8.880330000000001 ECU_ADDRESS 0x3fc64e FORMAT "%6.4" /end MEASUREMENT
/begin MEASUREMENT MAF_THR_ISA_TOT "total air mass flow at the throttle and ISA valve" UWORD _CNV_A_R_LINEAR_____101_CM 1 100. 0. 2047.96875 ECU_ADDRESS 0x3fc652 FORMAT "%7.2" /end MEASUREMENT
/begin MEASUREMENT MAF_ISA "air mass flow at the ISA valve" UWORD _CNV_A_R_LINEAR_____101_CM 1 100. 0. 2047.96875 ECU_ADDRESS 0x3fc650 FORMAT "%7.2" /end MEASUREMENT
/begin AXIS_PTS ldpm_tia_maf_mdl_con_1 "" 0x44052 TIA _REC_AXS_20_u1 190.5 _CNV_A_R_LINEAR_____0_CM 8 -48. 142.5 FORMAT "%5.1" /end AXIS_PTS
/begin AXIS_PTS ldp_teg_egr_maf_egr_con_1 "" 0x44ae6 TEG_EGR _REC_AXS_20_u2 2047. _CNV_A_R_LINEAR_____211_CM 8 0. 2047. FORMAT "%7.2" /end AXIS_PTS
/begin AXIS_PTS ldpm_n_32_ar_red "" 0x43e27 N_32 _REC_AXS_20_u1 816. _CNV_A_R_LINEAR_____5_CM 6 0. 8160. FORMAT "%4.0" /end AXIS_PTS
/begin CHARACTERISTIC ID_MAF_FAC_OFS__PQ_ESTIM "Offset air flow function" CURVE 0x457ae _REC_CUR_20_u2_u2 8.880330000000001 _CNV_A_R_LINEAR_____170_CM 0. 8.880330000000001 FORMAT "%6.4"
 /begin AXIS_DESCR COM_AXIS PQ_ESTIM _CNV_A_R_LINEAR_____31_CM 16 0. 0.99998474 FORMAT "%7.5" AXIS_PTS_REF ldpm_pq_estim_id_maf_fac_ofs /end AXIS_DESCR
/end CHARACTERISTIC
/begin CHARACTERISTIC ID_MAF_FAC_SLOP__PQ_ESTIM "Slope air flow function" CURVE 0x457ce _REC_CUR_20_u2_u2 8.880330000000001 _CNV_A_R_LINEAR_____170_CM 0. 8.880330000000001 FORMAT "%6.4"
 /begin AXIS_DESCR COM_AXIS PQ_ESTIM _CNV_A_R_LINEAR_____31_CM 16 0. 0.99998474 FORMAT "%7.5" AXIS_PTS_REF ldpm_pq_estim_id_maf_fac_ofs /end AXIS_DESCR
/end CHARACTERISTIC
/begin MEASUREMENT EGR_RATIO "MAF_EGR/MAF_CYL" UWORD _CNV_A_R_LINEAR_____94_CM 1 100. 0. 99.99847412 ECU_ADDRESS 0x3fc62a /end MEASUREMENT
/begin MEASUREMENT LV_H_LOAD_MAF_THR "logical value for 'very high load'" UBYTE _CNV_S_2_RANGE______28_CM 1 100. 0. 1. ECU_ADDRESS 0x3fdb33 /end MEASUREMENT
/begin CHARACTERISTIC C_PQ_THD "Calculation threshold for manifold pressure; typical value 0,9900 (FD70H)" VALUE 0x42efc _REC_VAL_20_u2 0.99998474 _CNV_A_R_LINEAR_____31_CM 0. 0.99998474 FORMAT "%7.5" /end CHARACTERISTIC
/begin CHARACTERISTIC C_PQ_THD_HYS "hysteresis for calculation threshold for MAP and MAF" VALUE 0x42efe _REC_VAL_20_u2 0.99998474 _CNV_A_R_LINEAR_____31_CM 0. 0.99998474 FORMAT "%7.5" /end CHARACTERISTIC
/begin MEASUREMENT PQ_ESTIM "Estimated pressure quotient at the throttle" UWORD _CNV_A_R_LINEAR_____31_CM 1 100. 0. 0.99998474 ECU_ADDRESS 0x3fdb20 FORMAT "%7.5" /end MEASUREMENT
/begin MEASUREMENT MAP_ESTIM "estimated manifold pressure" UWORD _CNV_A_R_LINEAR_____43_CM 1 100. 0. 5434. ECU_ADDRESS 0x3fdb1e FORMAT "%7.2" /end MEASUREMENT
/begin AXIS_PTS ldpm_pq_estim_maf_isa_fac_ofs "" 0x453b2 PQ_ESTIM _REC_AXS_20_u2 0.99998474 _CNV_A_R_LINEAR_____31_CM 16 0. 0.99998474 FORMAT "%7.5" /end AXIS_PTS
/begin AXIS_PTS ldpm_ar_red_isa_bas_maf_isa_fac "" 0x44e74 AR_RED_ISA_BAS _REC_AXS_20_u2 58.592855 _CNV_A_R_LINEAR_____171_CM 6 0. 58.592855 FORMAT "%7.4" /end AXIS_PTS
/begin CHARACTERISTIC ID_MAF_ISA_FAC_SLOP "slope air flow function for ISA" MAP 0x458ae _REC_MAP_20_u2_u2_u2 8.880330000000001 _CNV_A_R_LINEAR_____170_CM 0. 8.880330000000001 FORMAT "%6.4"
 /begin AXIS_DESCR COM_AXIS PQ_ESTIM _CNV_A_R_LINEAR_____31_CM 16 0. 0.99998474 FORMAT "%7.5" AXIS_PTS_REF ldpm_pq_estim_maf_isa_fac_ofs /end AXIS_DESCR
 /begin AXIS_DESCR COM_AXIS AR_RED_ISA_BAS _CNV_A_R_LINEAR_____171_CM 6 0. 58.592855 FORMAT "%7.4" AXIS_PTS_REF ldpm_ar_red_isa_bas_maf_isa_fac /end AXIS_DESCR
/end CHARACTERISTIC
/begin CHARACTERISTIC ID_MAF_ISA_FAC_OFS "offset air flow function for ISA" MAP 0x457ee _REC_MAP_20_u2_u2_u2 8.880330000000001 _CNV_A_R_LINEAR_____170_CM 0. 8.880330000000001 FORMAT "%6.4"
 /begin AXIS_DESCR COM_AXIS PQ_ESTIM _CNV_A_R_LINEAR_____31_CM 16 0. 0.99998474 FORMAT "%7.5" AXIS_PTS_REF ldpm_pq_estim_maf_isa_fac_ofs /end AXIS_DESCR
 /begin AXIS_DESCR COM_AXIS AR_RED_ISA_BAS _CNV_A_R_LINEAR_____171_CM 6 0. 58.592855 FORMAT "%7.4" AXIS_PTS_REF ldpm_ar_red_isa_bas_maf_isa_fac /end AXIS_DESCR
/end CHARACTERISTIC
/begin CHARACTERISTIC C_RA "Error detection threshold for maximum deviation" VALUE 0x42f1c _REC_VAL_20_u2 574. _CNV_A_R_LINEAR_____334_CM 0. 574. FORMAT "%5.1" /end CHARACTERISTIC
/begin AXIS_PTS ldpm_maf_mes__vol_im "" 0x45144 MAF_MES _REC_AXS_20_u2 1389. _CNV_A_R_LINEAR_____95_CM 6 0. 1389. FORMAT "%7.2" /end AXIS_PTS
/begin CHARACTERISTIC IP_VOL_IM_NEG "effective intake manifold volume at decreasing load in PL and ST" MAP 0x4caec _REC_MAP_20_u2_u2_u1 48.34583154310096 _CNV_A_R_LINEAR_____335_CM 3.68860679518273e-003 241.7328463223 FORMAT "%7.3"
 /begin AXIS_DESCR COM_AXIS MAF_MES _CNV_A_R_LINEAR_____95_CM 6 0. 1389. FORMAT "%7.2" AXIS_PTS_REF ldpm_maf_mes__vol_im /end AXIS_DESCR
 /begin AXIS_DESCR COM_AXIS N_32 _CNV_A_R_LINEAR_____5_CM 8 0. 8160. FORMAT "%4.0" AXIS_PTS_REF ldpm_n_32__vol_im /end AXIS_DESCR
/end CHARACTERISTIC
/begin CHARACTERISTIC IP_VOL_IM_IS "effective intake manifold volume at increasing load in IS, PU and PUC" MAP 0x4ca5c _REC_MAP_20_u2_u2_u1 48.34583154310096 _CNV_A_R_LINEAR_____335_CM 3.68860679518273e-003 241.7328463223 FORMAT "%7.3"
 /begin AXIS_DESCR COM_AXIS MAF_MES _CNV_A_R_LINEAR_____95_CM 6 0. 1389. FORMAT "%7.2" AXIS_PTS_REF ldpm_maf_mes__vol_im /end AXIS_DESCR
 /begin AXIS_DESCR COM_AXIS N_32 _CNV_A_R_LINEAR_____5_CM 6 0. 8160. FORMAT "%4.0" AXIS_PTS_REF ldpm_n_32__vol_im_is /end AXIS_DESCR
/end CHARACTERISTIC
/begin CHARACTERISTIC IP_VOL_IM "effective intake manifold volume at increasing load in PL and ST" MAP 0x4c9fc _REC_MAP_20_u2_u2_u1 48.34583154310096 _CNV_A_R_LINEAR_____335_CM 3.68860679518273e-003 241.7328463223 FORMAT "%7.3"
 /begin AXIS_DESCR COM_AXIS MAF_MES _CNV_A_R_LINEAR_____95_CM 6 0. 1389. FORMAT "%7.2" AXIS_PTS_REF ldpm_maf_mes__vol_im /end AXIS_DESCR
 /begin AXIS_DESCR COM_AXIS N_32 _CNV_A_R_LINEAR_____5_CM 8 0. 8160. FORMAT "%4.0" AXIS_PTS_REF ldpm_n_32__vol_im /end AXIS_DESCR
/end CHARACTERISTIC
/begin CHARACTERISTIC IP_VOL_IM_IS_NEG "effective intake manifold volume at decreasing load in IS, PU and PUC" MAP 0x4caa4 _REC_MAP_20_u2_u2_u1 48.34583154310096 _CNV_A_R_LINEAR_____335_CM 3.68860679518273e-003 241.7328463223 FORMAT "%7.3"
 /begin AXIS_DESCR COM_AXIS MAF_MES _CNV_A_R_LINEAR_____95_CM 6 0. 1389. FORMAT "%7.2" AXIS_PTS_REF ldpm_maf_mes__vol_im /end AXIS_DESCR
 /begin AXIS_DESCR COM_AXIS N_32 _CNV_A_R_LINEAR_____5_CM 6 0. 8160. FORMAT "%4.0" AXIS_PTS_REF ldpm_n_32__vol_im_is /end AXIS_DESCR
/end CHARACTERISTIC
/begin MEASUREMENT MAF "Air mass (predicted) for calculation of basic fuel injection" UWORD _CNV_A_R_LINEAR_____95_CM 1 100. 0. 1389. ECU_ADDRESS 0x3fc618 FORMAT "%6.2" /end MEASUREMENT
/begin MEASUREMENT VOL_IM "effective intake manifold volume" UWORD _CNV_A_R_LINEAR_____335_CM 1 100. 3.68860679518273e-003 241.7328463223 ECU_ADDRESS 0x3fdb30 FORMAT "%7.3" /end MEASUREMENT
/begin AXIS_PTS ldpm_n_32__vol_im "" 0x43e17 N_32 _REC_AXS_20_u1 8160. _CNV_A_R_LINEAR_____5_CM 8 0. 8160. FORMAT "%4.0" /end AXIS_PTS
/begin AXIS_PTS ldpm_n_32__vol_im_is "" 0x43e20 N_32 _REC_AXS_20_u1 8160. _CNV_A_R_LINEAR_____5_CM 6 0. 8160. FORMAT "%4.0" /end AXIS_PTS
/begin AXIS_PTS ldp_n__pq_sp_puls "" 0x4480c N _REC_AXS_20_u2 816. _CNV_A_R_LINEAR_____17_CM 6 0. 8160. FORMAT "%4.0" /end AXIS_PTS
/begin CHARACTERISTIC IP_PQ_SP_PULS "PQ-threshold for LV_MAF_PULS" CURVE 0x49e30 _REC_CUR_20_u2_u2 0.99998474 _CNV_A_R_LINEAR_____31_CM 0. 0.99998474 FORMAT "%7.5"
 /begin AXIS_DESCR COM_AXIS N _CNV_A_R_LINEAR_____17_CM 6 0. 8160. FORMAT "%4.0" AXIS_PTS_REF ldp_n__pq_sp_puls /end AXIS_DESCR
/end CHARACTERISTIC
/begin CHARACTERISTIC C_MAF_MMV_HYS "Threshold for detecting raising MAF_MMV" VALUE 0x42e78 _REC_VAL_20_u2 694.5 _CNV_A_R_LINEAR_____336_CM 0. 694.5 FORMAT "%6.2" /end CHARACTERISTIC
/begin CHARACTERISTIC C_PQ_SP_HYS_PULS "Hysteresis for PQ-threshold for LV_MAF_PULS" VALUE 0x42ef4 _REC_VAL_20_u2 0.99998474 _CNV_A_R_LINEAR_____31_CM 0. 0.99998474 FORMAT "%7.5" /end CHARACTERISTIC
/begin MEASUREMENT MAF_MMV "MAF moving mean value" UWORD _CNV_A_R_LINEAR_____95_CM 1 100. 0. 1389. ECU_ADDRESS 0x3fc642 FORMAT "%6.2" /end MEASUREMENT
/begin MEASUREMENT LV_MAF_PULS "Boolean for wrong air flow acquisition" UBYTE _CNV_S_2_RANGE______28_CM 1 100. 0. 1. ECU_ADDRESS 0x3fc6c1 /end MEASUREMENT
/begin MEASUREMENT MAF_MDL "Deviation of model air mass flow" UWORD _CNV_A_R_LINEAR_____101_CM 1 100. 0. 2047.96875 ECU_ADDRESS 0x3fdb34 FORMAT "%7.2" /end MEASUREMENT
/begin MEASUREMENT MAP_MDL "Deviation between measured and callculated manifold pressure" UWORD _CNV_A_R_LINEAR_____43_CM 1 100. 0. 5434. ECU_ADDRESS 0x3fdb36 FORMAT "%7.2" /end MEASUREMENT
/begin CHARACTERISTIC C_CRLC_AMP_AD "Correlation constants for the ambient pressure Adaptation" VALUE 0x42824 _REC_VAL_20_u1 0.9960940000000002 _CNV_A_R_LINEAR_____44_CM 0. 0.996094 FORMAT "%5.3" /end CHARACTERISTIC
/begin CHARACTERISTIC C_TCO_THD_AMP_AD "Threshold of TCO in case of no working load sensor" VALUE 0x42a8b _REC_VAL_20_u1 190.5 _CNV_A_R_LINEAR_____0_CM -48. 142.5 FORMAT "%5.1" /end CHARACTERISTIC
/begin MEASUREMENT AMP "Ambient pressure (measured or adapted)" UWORD _CNV_A_R_LINEAR_____43_CM 1 100. 0. 5434. ECU_ADDRESS 0x3fc674 FORMAT "%7.2" /end MEASUREMENT
/begin MEASUREMENT AMP_MDL_DIF_I_MMV "Moving mean I-value of the closed loop control of ambient pressure" SWORD _CNV_A_R_LINEAR_____97_CM 1 100. -2717.04 2716.96 ECU_ADDRESS 0x3fc67a FORMAT "%8.2" /end MEASUREMENT
/begin MEASUREMENT AMP_MDL_DIF_I "I-value of the closed loop control of ambient pressure" SWORD _CNV_A_R_LINEAR_____337_CM 1 100. -339.625 339.614635 ECU_ADDRESS 0x3fc678 FORMAT "%7.2" /end MEASUREMENT
/begin MEASUREMENT AMP_MDL_DIF_P "P-value of the closed loop control of ambient pressure" SWORD _CNV_A_R_LINEAR_____97_CM 1 100. -2717.04 2716.96 ECU_ADDRESS 0x3fdb46 FORMAT "%8.2" /end MEASUREMENT
/begin MEASUREMENT AMP_ESTIM "Estimated ambient pressure" UWORD _CNV_A_R_LINEAR_____43_CM 1 100. 0. 5434. ECU_ADDRESS 0x3fdb44 FORMAT "%7.2" /end MEASUREMENT
/begin MEASUREMENT AMP_AD_DIF "Change of the adapted ambient pressure" SWORD _CNV_A_R_LINEAR_____97_CM 1 100. -2717.04 2716.96 ECU_ADDRESS 0x3fdb42 FORMAT "%8.2" /end MEASUREMENT
/begin MEASUREMENT AMP_AD "Adapted ambient pressure" UWORD _CNV_A_R_LINEAR_____43_CM 1 100. 0. 5434. ECU_ADDRESS 0x3fc67c FORMAT "%7.2" /end MEASUREMENT
/begin MEASUREMENT AR_RED_BAS_MMV "Moving mean value of the basic reduced area" UWORD _CNV_A_R_LINEAR_____171_CM 1 100. 0. 58.592855 ECU_ADDRESS 0x3fdb4c FORMAT "%7.4" /end MEASUREMENT
/begin MEASUREMENT MAF_KGH_MMV "Moving mean value of the mass air flow" UWORD _CNV_A_R_LINEAR_____101_CM 1 100. 0. 2047.96875 ECU_ADDRESS 0x3fdb4e FORMAT "%7.2" /end MEASUREMENT
/begin MEASUREMENT SEG_CTR_AMP_AD_PL "Segment counter for ambient pressure Adaptation during part load" UWORD _CNV_A_R_LINEAR_____10_CM 1 100. 0. 65535. ECU_ADDRESS 0x3fdb48 FORMAT "%5.0" /end MEASUREMENT
/begin CHARACTERISTIC C_AMP_AD_PL_HYS "hyteresis for ambient pressure Adaptation during part load" VALUE 0x42c1e _REC_VAL_20_u2 5434. _CNV_A_R_LINEAR_____43_CM 0. 5434. FORMAT "%7.2" /end CHARACTERISTIC
/begin CHARACTERISTIC C_AMP_AD_DIF_NEG "Negative correction of the ambient pressure Adaptation during part load" VALUE 0x431de _REC_VAL_20_s2 5434. _CNV_A_R_LINEAR_____97_CM -2717.04 2716.96 FORMAT "%8.2" /end CHARACTERISTIC
/begin CHARACTERISTIC C_AMP_AD_DIF_POS "Positive correction of the ambient pressure Adaptation during part load" VALUE 0x431e0 _REC_VAL_20_s2 5434. _CNV_A_R_LINEAR_____97_CM -2717.04 2716.96 FORMAT "%8.2" /end CHARACTERISTIC
/begin CHARACTERISTIC C_AMP_DIF_TI_LAM_POS "positive correction of the ambient pressure Adaptation with lambda controller" VALUE 0x431e4 _REC_VAL_20_s2 5434. _CNV_A_R_LINEAR_____97_CM -2717.04 2716.96 FORMAT "%8.2" /end CHARACTERISTIC
/begin CHARACTERISTIC C_AMP_MAX "maximum value for ambient pressure" VALUE 0x42c2a _REC_VAL_20_u2 5434. _CNV_A_R_LINEAR_____43_CM 0. 5434. FORMAT "%7.2" /end CHARACTERISTIC
/begin CHARACTERISTIC C_AMP_MIN " minimum value for ambient pressure" VALUE 0x42c2c _REC_VAL_20_u2 5434. _CNV_A_R_LINEAR_____43_CM 0. 5434. FORMAT "%7.2" /end CHARACTERISTIC
/begin CHARACTERISTIC C_AMP_INI "initial value for the ambient pressure" VALUE 0x42c28 _REC_VAL_20_u2 5434. _CNV_A_R_LINEAR_____43_CM 0. 5434. FORMAT "%7.2" /end CHARACTERISTIC
/begin CHARACTERISTIC C_AMP_I_1 "I -value for the ambient pressure correction (LV_MAF_CTL = 1)" VALUE 0x42c24 _REC_VAL_20_u2 7293750. _CNV_A_R_LINEAR_____338_CM 0. 7293750. FORMAT "%8.0" /end CHARACTERISTIC
/begin CHARACTERISTIC C_AMP_DIF_TI_LAM_NEG "Negative correction of the ambient pressure Adaptation with lambda controller" VALUE 0x431e2 _REC_VAL_20_s2 5434. _CNV_A_R_LINEAR_____97_CM -2717.04 2716.96 FORMAT "%8.2" /end CHARACTERISTIC
/begin CHARACTERISTIC C_AMP_MDL_DIF_I_MIN "Lower threshold of integral part of pressure controller" VALUE 0x431e8 _REC_VAL_20_s2 679.239635 _CNV_A_R_LINEAR_____337_CM -339.625 339.614635 FORMAT "%7.2" /end CHARACTERISTIC
/begin CHARACTERISTIC C_AMP_P_1 "P - Value for ambient pressure control (LV_MAF_CTL = 1)" VALUE 0x42c32 _REC_VAL_20_u2 42.51956000000001 _CNV_A_R_LINEAR_____339_CM 0. 42.51956 FORMAT "%8.5" /end CHARACTERISTIC
/begin CHARACTERISTIC C_AMP_P_2 "P - Value for ambient pressure control (LV_MAP_CTL = 1)" VALUE 0x42c34 _REC_VAL_20_u2 0.99998474 _CNV_A_R_LINEAR_____31_CM 0. 0.99998474 FORMAT "%7.5" /end CHARACTERISTIC
/begin CHARACTERISTIC C_CRLC_MAF_KGH_AMP_AD_PL "correlation constant for moving mean value calculation of MAF_KGH" VALUE 0x42834 _REC_VAL_20_u1 0.9960940000000002 _CNV_A_R_LINEAR_____44_CM 0. 0.996094 FORMAT "%5.3" /end CHARACTERISTIC
/begin CHARACTERISTIC C_CRLC_AMP_MDL_DIF_I_MMV "Correlation constant for moving mean value calculation of AMP_MDL_DIF_I" VALUE 0x42826 _REC_VAL_20_u1 0.9960940000000002 _CNV_A_R_LINEAR_____44_CM 0. 0.996094 FORMAT "%5.3" /end CHARACTERISTIC
/begin CHARACTERISTIC C_MAP_DRV1_MAX_AMP_AD_PL "maximum value of the first derivative of manifold pressure for ambient pressure Adaptation part load" VALUE 0x42e80 _REC_VAL_20_u2 82.91626000000001 _CNV_A_R_LINEAR_____340_CM 0. 82.91625999999999 FORMAT "%5.3" /end CHARACTERISTIC
/begin CHARACTERISTIC C_N_AMP_AD_MIN "Minimum engine speed for ambient pressure learning" VALUE 0x42929 _REC_VAL_20_u1 8160. _CNV_A_R_LINEAR_____5_CM 0. 8160. FORMAT "%4.0" /end CHARACTERISTIC
/begin CHARACTERISTIC C_N_AMP_AD_MAX "Maximum engine speed for ambient pressure learning" VALUE 0x42928 _REC_VAL_20_u1 8160. _CNV_A_R_LINEAR_____5_CM 0. 8160. FORMAT "%4.0" /end CHARACTERISTIC
/begin CHARACTERISTIC C_N_MIN_AMP_AD_PL "minimum value of the engine speed for ambient pressure Adaptation part load" VALUE 0x4295f _REC_VAL_20_u1 8160. _CNV_A_R_LINEAR_____5_CM 0. 8160. FORMAT "%4.0" /end CHARACTERISTIC
/begin CHARACTERISTIC C_PQ_AMP_AD "pressure quotient for Adaptation ambient pressure" VALUE 0x42edc _REC_VAL_20_u2 0.99998474 _CNV_A_R_LINEAR_____31_CM 0. 0.99998474 FORMAT "%7.5" /end CHARACTERISTIC
/begin CHARACTERISTIC C_PQ_AMP_AD_PL "pressure quotient for Adaptation ambient pressure at PL" VALUE 0x42ede _REC_VAL_20_u2 0.99998474 _CNV_A_R_LINEAR_____31_CM 0. 0.99998474 FORMAT "%7.5" /end CHARACTERISTIC
/begin CHARACTERISTIC C_SEG_CTR_AMP_AD "Segment counter of waiting time before allowing Adaptation of ambient pressure (typical value ³ 200)" VALUE 0x42f32 _REC_VAL_20_u2 65535. _CNV_A_R_LINEAR_____10_CM 0. 65535. FORMAT "%5.0" /end CHARACTERISTIC
/begin CHARACTERISTIC C_SEG_CTR_AMP_AD_PL "segment counter for moving mean value calculation of AR_RED_BAS, MAF_KGH_MMV" VALUE 0x42f34 _REC_VAL_20_u2 65535. _CNV_A_R_LINEAR_____10_CM 0. 65535. FORMAT "%5.0" /end CHARACTERISTIC
/begin CHARACTERISTIC C_T_AST_AMP_CTL_DEAC "Time for deactivation of pressure control after start" VALUE 0x42f54 _REC_VAL_20_u2 6553.5 _CNV_A_R_LINEAR_____14_CM 0. 6553.5 FORMAT "%6.1" /end CHARACTERISTIC
/begin CHARACTERISTIC C_TI_LAM_MAF_PULS_MAX "positive threshold of the ambient pressure Adaptation in pulsation" VALUE 0x432ce _REC_VAL_20_s2 99.99847412 _CNV_A_R_LINEAR_____98_CM -50. 49.99847412 FORMAT "%6.2" /end CHARACTERISTIC
/begin CHARACTERISTIC C_TI_LAM_MAF_PULS_MIN "negative threshold of the ambient pressure Adaptation in pulsation" VALUE 0x432d0 _REC_VAL_20_s2 99.99847412 _CNV_A_R_LINEAR_____98_CM -50. 49.99847412 FORMAT "%6.2" /end CHARACTERISTIC
/begin CHARACTERISTIC C_TPS_MIN_AMP_AD_PL "minimum value of the throttle position for ambient pressure Adaptation part load" VALUE 0x430be _REC_VAL_20_u2 119.5 _CNV_A_R_LINEAR_____226_CM 0. 119.5 /end CHARACTERISTIC
/begin MEASUREMENT AR_RED_DIF_I_REL_MMV "Moving mean I-value (relative) of the closed loop control reduced throttle area" SWORD _CNV_A_R_LINEAR_____98_CM 1 100. -50. 49.99847412 ECU_ADDRESS 0x3fc65a FORMAT "%7.3" /end MEASUREMENT
/begin MEASUREMENT AR_RED_DIF_P_REL "P-value (relative) of the closed loop control reduced throttle area" SWORD _CNV_A_R_LINEAR_____98_CM 1 100. -50. 49.99847412 ECU_ADDRESS 0x3fdb38 FORMAT "%7.3" /end MEASUREMENT
/begin MEASUREMENT MAP_MDL_MV "Mean value of the model manifold pressure" UWORD _CNV_A_R_LINEAR_____43_CM 1 100. 0. 5434. ECU_ADDRESS 0x3fc670 FORMAT "%7.2" /end MEASUREMENT
/begin MEASUREMENT MAP_MDL_DIF "Deviation between measured and callculated manifold pressure" SWORD _CNV_A_R_LINEAR_____97_CM 1 100. -2717.04 2716.96 ECU_ADDRESS 0x3fc672 FORMAT "%8.2" /end MEASUREMENT
/begin MEASUREMENT MAF_MDL_MV "Model air mass flow mean value" UWORD _CNV_A_R_LINEAR_____101_CM 1 100. 0. 2047.96875 ECU_ADDRESS 0x3fc66a FORMAT "%7.2" /end MEASUREMENT
/begin MEASUREMENT MAF_MDL_DIF "Deviation of model air mass flow" SWORD _CNV_A_R_LINEAR_____101_CM 1 100. -1024. 1023.96875 ECU_ADDRESS 0x3fc66e FORMAT "%6.2" /end MEASUREMENT
/begin CHARACTERISTIC C_AMP_I_2 "I - Value for the ambient pressure correction(LV_MAF_CTL = 1)" VALUE 0x42c26 _REC_VAL_20_u2 61.034223 _CNV_A_R_LINEAR_____341_CM 0. 61.034223 FORMAT "%7.4" /end CHARACTERISTIC
/begin CHARACTERISTIC C_AR_RED_AD_ADD_MIN "Minimum allowed value for additive reduced area Adaptation" VALUE 0x431f4 _REC_VAL_20_s2 58.59285547 _CNV_A_R_LINEAR_____342_CM -29.296875 29.29598047 FORMAT "%8.4" /end CHARACTERISTIC
/begin CHARACTERISTIC C_AR_RED_AD_FAC_MAX "Maximum allowed value for multiplicative reduced area Adaptation" VALUE 0x431fa _REC_VAL_20_s2 99.99847412 _CNV_A_R_LINEAR_____98_CM -50. 49.99847412 FORMAT "%7.3" /end CHARACTERISTIC
/begin CHARACTERISTIC C_AR_RED_AD_FAC_MIN "Minimum allowed value for multiplicative reduced area Adaptation" VALUE 0x431fc _REC_VAL_20_s2 99.99847412 _CNV_A_R_LINEAR_____98_CM -50. 49.99847412 FORMAT "%7.3" /end CHARACTERISTIC
/begin CHARACTERISTIC C_AR_RED_DIF_I_REL_MIN "Minimum value for AR_RED_ DIF_I_REL" VALUE 0x43208 _REC_VAL_20_s2 99.99847412 _CNV_A_R_LINEAR_____98_CM -50. 49.99847412 FORMAT "%7.3" /end CHARACTERISTIC
/begin CHARACTERISTIC C_CRLC_AR_RED_BAS_AMP_AD_PL "correlation constant for moving mean value calculation of AR_RED_BAS" VALUE 0x42829 _REC_VAL_20_u1 0.9960940000000002 _CNV_A_R_LINEAR_____44_CM 0. 0.996094 FORMAT "%5.3" /end CHARACTERISTIC
/begin CHARACTERISTIC C_CRLC_AR_RED_DIF_I_REL_MMV "Correlation constant for the moving mean value calculation of AR_RED_DIF_I_REL" VALUE 0x4282a _REC_VAL_20_u1 0.9960940000000002 _CNV_A_R_LINEAR_____44_CM 0. 0.996094 FORMAT "%5.3" /end CHARACTERISTIC
/begin CHARACTERISTIC C_N__AR_RED__AD_ADD_MAX "Maximum engine speed for learning of additive Adaptation value" VALUE 0x4292a _REC_VAL_20_u1 8160. _CNV_A_R_LINEAR_____5_CM 0. 8160. FORMAT "%4.0" /end CHARACTERISTIC
/begin CHARACTERISTIC C_N__AR_RED__AD_FAC_MIN "Minimum engine speed for learning of multiplicative Adaptation value" VALUE 0x4292d _REC_VAL_20_u1 8160. _CNV_A_R_LINEAR_____5_CM 0. 8160. FORMAT "%4.0" /end CHARACTERISTIC
/begin CHARACTERISTIC C_N__AR_RED__AD_FAC_MAX "Maximum engine speed for learning of multiplicative Adaptation value" VALUE 0x4292c _REC_VAL_20_u1 8160. _CNV_A_R_LINEAR_____5_CM 0. 8160. FORMAT "%4.0" /end CHARACTERISTIC
/begin CHARACTERISTIC C_PQ__AR_RED__AD_FAC_MAX "Maximum pressure quotient for learning of multiplicative Adaptation value" VALUE 0x42ee6 _REC_VAL_20_u2 0.99998474 _CNV_A_R_LINEAR_____31_CM 0. 0.99998474 FORMAT "%7.5" /end CHARACTERISTIC
/begin CHARACTERISTIC C_PQ__AR_RED__AD_FAC_MIN "Minimum pressure quotient for learning of multiplicative Adaptation value" VALUE 0x42ee8 _REC_VAL_20_u2 0.99998474 _CNV_A_R_LINEAR_____31_CM 0. 0.99998474 FORMAT "%7.5" /end CHARACTERISTIC
/begin CHARACTERISTIC C_PQ__AR_RED__AD_ADD_MAX "Maximum pressure quotient for learning of additive Adaptation value" VALUE 0x42ee4 _REC_VAL_20_u2 0.99998474 _CNV_A_R_LINEAR_____31_CM 0. 0.99998474 FORMAT "%7.5" /end CHARACTERISTIC
/begin CHARACTERISTIC C_T_AST_AR_RED_CTL_DEAC "Time to deactivate reduced area control after engine start" VALUE 0x42f56 _REC_VAL_20_u2 6553.5 _CNV_A_R_LINEAR_____14_CM 0. 6553.5 FORMAT "%6.1" /end CHARACTERISTIC
/begin CHARACTERISTIC IP_AR_RED_I_REL_1__N__PQ "I-value (relative) reduced throttle area (MAF-controlled)" MAP 0x46048 _REC_MAP_20_u2_u1_u2 171660. _CNV_A_R_LINEAR_____343_CM 0. 171660. FORMAT "%6.0"
 /begin AXIS_DESCR COM_AXIS N_32 _CNV_A_R_LINEAR_____5_CM 6 0. 8160. FORMAT "%4.0" AXIS_PTS_REF ldpm_n_ar_red /end AXIS_DESCR
 /begin AXIS_DESCR COM_AXIS PQ _CNV_A_R_LINEAR_____31_CM 4 0. 0.99998474 FORMAT "%7.5" AXIS_PTS_REF ldpm_pq_ar_red /end AXIS_DESCR
/end CHARACTERISTIC
/begin CHARACTERISTIC IP_AR_RED_I_REL_2__N__PQ "I-value reduced throttle area (MAP-controlled)" MAP 0x46078 _REC_MAP_20_u2_u1_u2 2.24636 _CNV_A_R_LINEAR_____344_CM 0. 2.24636 FORMAT "%6.4"
 /begin AXIS_DESCR COM_AXIS N_32 _CNV_A_R_LINEAR_____5_CM 6 0. 8160. FORMAT "%4.0" AXIS_PTS_REF ldpm_n_ar_red /end AXIS_DESCR
 /begin AXIS_DESCR COM_AXIS PQ _CNV_A_R_LINEAR_____31_CM 4 0. 0.99998474 FORMAT "%7.5" AXIS_PTS_REF ldpm_pq_ar_red /end AXIS_DESCR
/end CHARACTERISTIC
/begin CHARACTERISTIC IP_AR_RED_P_REL_2__N__PQ "P-value reduced throttle area (MAP-controlled)" MAP 0x460f8 _REC_MAP_20_u2_u1_u2 0.5888600000000001 _CNV_A_R_LINEAR_____345_CM 0. 0.5888600000000001 FORMAT "%7.5"
 /begin AXIS_DESCR COM_AXIS N_32 _CNV_A_R_LINEAR_____5_CM 6 0. 8160. FORMAT "%4.0" AXIS_PTS_REF ldpm_n_ar_red /end AXIS_DESCR
 /begin AXIS_DESCR COM_AXIS PQ _CNV_A_R_LINEAR_____31_CM 4 0. 0.99998474 FORMAT "%7.5" AXIS_PTS_REF ldpm_pq_ar_red /end AXIS_DESCR
/end CHARACTERISTIC
/begin CHARACTERISTIC IP_T_1_HFM "time constant hot film air mass meter" CURVE 0x4a4b8 _REC_CUR_20_u2_u2 65.535 _CNV_A_R_LINEAR_____346_CM 0. 65.535
 /begin AXIS_DESCR COM_AXIS MAF_KGH _CNV_A_R_LINEAR_____101_CM 4 0. 2047.96875 FORMAT "%7.2" AXIS_PTS_REF ldpm_maf_kgh_t_1_hfm /end AXIS_DESCR
/end CHARACTERISTIC
/begin CHARACTERISTIC C_LGRD_AMP_MDL_DIF_TRA "Linear negative gradient of ambient pressure control during reduced area control" VALUE 0x42de0 _REC_VAL_20_u2 5434. _CNV_A_R_LINEAR_____43_CM 0. 5434. FORMAT "%7.2" /end CHARACTERISTIC
/begin CHARACTERISTIC C_LGRD_AR_RED_DIF_TRA "Linear negative gradient of reduced area control during ambient pressure control" VALUE 0x42de2 _REC_VAL_20_u2 99.99847412 _CNV_A_R_LINEAR_____94_CM 0. 99.99847412 /end CHARACTERISTIC
/begin CHARACTERISTIC C_CRLC_AR_RED_AD_ADD "Factor for the additive reduced area Adaptation" VALUE 0x42827 _REC_VAL_20_u1 0.9960940000000002 _CNV_A_R_LINEAR_____44_CM 0. 0.996094 FORMAT "%5.3" /end CHARACTERISTIC
/begin CHARACTERISTIC C_CRLC_AR_RED_AD_FAC "Factor for the multiplicative reduced area Adaptation" VALUE 0x42828 _REC_VAL_20_u1 0.9960940000000002 _CNV_A_R_LINEAR_____44_CM 0. 0.996094 FORMAT "%5.3" /end CHARACTERISTIC
/begin CHARACTERISTIC C_AR_RED_DIF_I_REL_MAX "Maximum value for AR_RED_ DIF_I_REL" VALUE 0x43206 _REC_VAL_20_s2 99.99847412 _CNV_A_R_LINEAR_____98_CM -50. 49.99847412 FORMAT "%7.3" /end CHARACTERISTIC
/begin CHARACTERISTIC C_AR_RED_AD_ADD_MAX "Maximum allowed value for additive reduced area Adaptation" VALUE 0x431f2 _REC_VAL_20_s2 58.59285547 _CNV_A_R_LINEAR_____342_CM -29.296875 29.29598047 FORMAT "%8.4" /end CHARACTERISTIC
/begin CHARACTERISTIC LC_AR_RED_AD_ENA "Logical variable enabled for permission of adaptive values for PUC" VALUE 0x42b64 _REC_VAL_20_u1 1. _CNV_A_R_LINEAR_____12_CM 0. 1. FORMAT "%1.0" /end CHARACTERISTIC
/begin MEASUREMENT AR_RED "Reduced area at the throttle" UWORD _CNV_A_R_LINEAR_____171_CM 1 100. 0. 58.592855 ECU_ADDRESS 0x3fc654 FORMAT "%7.4" /end MEASUREMENT
/begin CHARACTERISTIC IP_AR_RED_P_REL_1__N__PQ "P-value reduced throttle area (MAF-controlled)" MAP 0x460c8 _REC_MAP_20_u2_u1_u2 12.5005 _CNV_A_R_LINEAR_____347_CM 0. 12.5005 FORMAT "%7.4"
 /begin AXIS_DESCR COM_AXIS N_32 _CNV_A_R_LINEAR_____5_CM 6 0. 8160. FORMAT "%4.0" AXIS_PTS_REF ldpm_n_ar_red /end AXIS_DESCR
 /begin AXIS_DESCR COM_AXIS PQ _CNV_A_R_LINEAR_____31_CM 4 0. 0.99998474 FORMAT "%7.5" AXIS_PTS_REF ldpm_pq_ar_red /end AXIS_DESCR
/end CHARACTERISTIC
/begin MEASUREMENT AR_RED_DIF_I_REL "I-value (relative) of the closed loop control reduced throttle area" SWORD _CNV_A_R_LINEAR_____98_CM 1 100. -50. 49.99847412 ECU_ADDRESS 0x3fc658 FORMAT "%7.3" /end MEASUREMENT
/begin MEASUREMENT AR_RED_DIF_REL "Correction of reduced throttle area" SWORD _CNV_A_R_LINEAR_____98_CM 1 100. -50. 49.99847412 ECU_ADDRESS 0x3fc656 FORMAT "%7.3" /end MEASUREMENT
/begin MEASUREMENT AR_RED_ISA_DIF_REL "Correction of reduced throttle area" SWORD _CNV_A_R_LINEAR_____98_CM 1 100. -50. 49.99847412 ECU_ADDRESS 0x3fc684 FORMAT "%7.3" /end MEASUREMENT
/begin MEASUREMENT AMP_MDL_DIF "Value of the closed loop control of ambient pressure (sum of I and P part)" SWORD _CNV_A_R_LINEAR_____97_CM 1 100. -2717.04 2716.96 ECU_ADDRESS 0x3fc67e FORMAT "%8.2" /end MEASUREMENT
/begin CHARACTERISTIC C_CRLC_MAP_MDL "correlation constant for model manifold pressure" VALUE 0x42835 _REC_VAL_20_u1 0.9960940000000002 _CNV_A_R_LINEAR_____44_CM 0. 0.996094 FORMAT "%5.3" /end CHARACTERISTIC
/begin MEASUREMENT AR_RED_ISA_AD_ADD "Additive adaptive factor for ISA" SWORD _CNV_A_R_LINEAR_____342_CM 1 100. -29.296875 29.29598047 ECU_ADDRESS 0x3fc68e FORMAT "%8.4" /end MEASUREMENT
/begin MEASUREMENT AR_RED_AD_FAC "Multiplicative adaptive factor" SWORD _CNV_A_R_LINEAR_____98_CM 1 100. -50. 49.99847412 ECU_ADDRESS 0x3fc65e FORMAT "%7.3" /end MEASUREMENT
/begin MEASUREMENT AR_RED_ISA_AD_FAC "Multiplicative adaptive factor for ISA" SWORD _CNV_A_R_LINEAR_____98_CM 1 100. -50. 49.99847412 ECU_ADDRESS 0x3fc690 FORMAT "%7.3" /end MEASUREMENT
/begin MEASUREMENT AR_RED_AD_FAC_COR "Correction factor for entire adaptive factor" SWORD _CNV_A_R_LINEAR_____98_CM 1 100. -50. 49.99847412 ECU_ADDRESS 0x3fc660 FORMAT "%7.3" /end MEASUREMENT
/begin MEASUREMENT AR_RED_ISA_AD_FAC_COR "Correction factor for entire adaptive factor for ISA" SWORD _CNV_A_R_LINEAR_____98_CM 1 100. -50. 49.99847412 ECU_ADDRESS 0x3fc68c FORMAT "%7.3" /end MEASUREMENT
/begin CHARACTERISTIC C_N__AR_RED__AD_ADD_MIN "Minimum engine speed for learning of additive Adaptation value" VALUE 0x4292b _REC_VAL_20_u1 8160. _CNV_A_R_LINEAR_____5_CM 0. 8160. FORMAT "%4.0" /end CHARACTERISTIC
/begin CHARACTERISTIC C_N_AR_RED_ISA_AD_ADD_MIN "Minimum engine speed for learning of additive Adaptation value of ISA" VALUE 0x4292f _REC_VAL_20_u1 8160. _CNV_A_R_LINEAR_____5_CM 0. 8160. FORMAT "%4.0" /end CHARACTERISTIC
/begin CHARACTERISTIC C_N_AR_RED_ISA_AD_ADD_MAX "Maximum engine speed for learning of additive Adaptation value of ISA" VALUE 0x4292e _REC_VAL_20_u1 8160. _CNV_A_R_LINEAR_____5_CM 0. 8160. FORMAT "%4.0" /end CHARACTERISTIC
/begin CHARACTERISTIC C_AR_RED_BAS_AD_ADD_MAX "Maximum AR_RED_BAS for learning of additive Adaptation value of THR" VALUE 0x42c38 _REC_VAL_20_u2 58.592855 _CNV_A_R_LINEAR_____171_CM 0. 58.592855 FORMAT "%7.4" /end CHARACTERISTIC
/begin CHARACTERISTIC C_AR_RED_BAS_ISA_AD_ADD_MAX "Maximum AR_RED_BAS for learning of additive Adaptation value of ISA" VALUE 0x42c3a _REC_VAL_20_u2 58.592855 _CNV_A_R_LINEAR_____171_CM 0. 58.592855 FORMAT "%7.4" /end CHARACTERISTIC
/begin CHARACTERISTIC C_CRLC_AR_RED_ISA_AD_ADD "Filter factor for the addidive reduced area Adaptation of ISA" VALUE 0x4282c _REC_VAL_20_u1 0.9960940000000002 _CNV_A_R_LINEAR_____44_CM 0. 0.996094 FORMAT "%5.3" /end CHARACTERISTIC
/begin CHARACTERISTIC C_AR_RED_ISA_AD_ADD_MIN "Minimum allowed value for additive reduced area Adaptation of ISA" VALUE 0x43218 _REC_VAL_20_s2 58.59285547 _CNV_A_R_LINEAR_____342_CM -29.296875 29.29598047 FORMAT "%8.4" /end CHARACTERISTIC
/begin CHARACTERISTIC C_AR_RED_ISA_AD_ADD_MAX "Maximum allowed value for additive reduced area Adaptation of ISA" VALUE 0x43216 _REC_VAL_20_s2 58.59285547 _CNV_A_R_LINEAR_____342_CM -29.296875 29.29598047 FORMAT "%8.4" /end CHARACTERISTIC
/begin CHARACTERISTIC C_N_AR_RED_ISA_AD_FAC_MIN "Minimum engine speed for learning of multiplicative Adaptation value of ISA" VALUE 0x42931 _REC_VAL_20_u1 8160. _CNV_A_R_LINEAR_____5_CM 0. 8160. FORMAT "%4.0" /end CHARACTERISTIC
/begin CHARACTERISTIC C_N_AR_RED_ISA_AD_FAC_MAX "Maximum engine speed for learning of multiplicative Adaptation value of ISA" VALUE 0x42930 _REC_VAL_20_u1 8160. _CNV_A_R_LINEAR_____5_CM 0. 8160. FORMAT "%4.0" /end CHARACTERISTIC
/begin CHARACTERISTIC C_PQ_AR_RED_ISA_AD_ADD_MAX "Maximum pressure quotient for learning of additive Adaptation value of ISA" VALUE 0x42eea _REC_VAL_20_u2 0.99998474 _CNV_A_R_LINEAR_____31_CM 0. 0.99998474 FORMAT "%7.5" /end CHARACTERISTIC
/begin CHARACTERISTIC C_PQ_AR_RED_ISA_AD_FAC_MIN "Minimum pressure quotient for learning of multiplicative Adaptation value of ISA" VALUE 0x42eee _REC_VAL_20_u2 0.99998474 _CNV_A_R_LINEAR_____31_CM 0. 0.99998474 FORMAT "%7.5" /end CHARACTERISTIC
/begin CHARACTERISTIC C_PQ_AR_RED_ISA_AD_FAC_MAX "Maximum pressure quotient for learning of multiplicative Adaptation value of ISA" VALUE 0x42eec _REC_VAL_20_u2 0.99998474 _CNV_A_R_LINEAR_____31_CM 0. 0.99998474 FORMAT "%7.5" /end CHARACTERISTIC
/begin CHARACTERISTIC C_AR_RED_BAS_AD_FAC_MIN "Minimum AR_RED_BAS for learning of multiplicative Adaptation value of THR" VALUE 0x43204 _REC_VAL_20_s2 58.59285547 _CNV_A_R_LINEAR_____342_CM -29.296875 29.29598047 FORMAT "%8.4" /end CHARACTERISTIC
/begin CHARACTERISTIC C_AR_RED_BAS_AD_FAC_MAX "Maximum AR_RED_BAS for learning of multiplicative Adaptation value of ISA" VALUE 0x43202 _REC_VAL_20_s2 58.59285547 _CNV_A_R_LINEAR_____342_CM -29.296875 29.29598047 FORMAT "%8.4" /end CHARACTERISTIC
/begin CHARACTERISTIC C_CRLC_AR_RED_ISA_AD_FAC "Filter factor for the multiplicative reduced area Adaptation of THR" VALUE 0x4282d _REC_VAL_20_u1 0.9960940000000002 _CNV_A_R_LINEAR_____44_CM 0. 0.996094 FORMAT "%5.3" /end CHARACTERISTIC
/begin CHARACTERISTIC C_AR_RED_ISA_BAS_AD_MIN "Minimum AR_RED_ISA_BAS for learning of multiplicative Adaptation value of ISA" VALUE 0x43220 _REC_VAL_20_s2 58.59285547 _CNV_A_R_LINEAR_____342_CM -29.296875 29.29598047 FORMAT "%8.4" /end CHARACTERISTIC
/begin CHARACTERISTIC C_AR_RED_ISA_BAS_AD_MAX "Maximum AR_RED_ISA_BAS for learning of multiplicative Adaptation value of ISA" VALUE 0x4321e _REC_VAL_20_s2 58.59285547 _CNV_A_R_LINEAR_____342_CM -29.296875 29.29598047 FORMAT "%8.4" /end CHARACTERISTIC
/begin CHARACTERISTIC C_AR_RED_ISA_AD_FAC_MIN "Minimum allowed value for multiplicative reduced area Adaptation of ISA" VALUE 0x4321c _REC_VAL_20_s2 99.99847412 _CNV_A_R_LINEAR_____98_CM -50. 49.99847412 FORMAT "%7.3" /end CHARACTERISTIC
/begin CHARACTERISTIC C_AR_RED_ISA_AD_FAC_MAX "Maximum allowed value for multiplicative reduced area Adaptation of ISA" VALUE 0x4321a _REC_VAL_20_s2 99.99847412 _CNV_A_R_LINEAR_____98_CM -50. 49.99847412 FORMAT "%7.3" /end CHARACTERISTIC
/begin CHARACTERISTIC IP_FAC_AR_RED_COR__PQ "Weighting function for decreasing multiplicative learning controller value during PQ>C_PQ_AMP_CTL" CURVE 0x4ddd1 _REC_CUR_20_u1_u2 0.9960940000000002 _CNV_A_R_LINEAR_____44_CM 0. 0.996094 FORMAT "%5.3"
 /begin AXIS_DESCR COM_AXIS PQ _CNV_A_R_LINEAR_____31_CM 8 0. 0.99998474 FORMAT "%7.5" AXIS_PTS_REF ldpm_pq__fac_ar_red_cor /end AXIS_DESCR
/end CHARACTERISTIC
/begin CHARACTERISTIC IP_FAC_AR_RED_ISA_COR__PQ "Weighting function for decreasing multiplicative Adaptation of ISA during PQ>C_PQ_AMP_CTL" CURVE 0x4dde1 _REC_CUR_20_u1_u2 0.9960940000000002 _CNV_A_R_LINEAR_____44_CM 0. 0.996094 FORMAT "%5.3"
 /begin AXIS_DESCR COM_AXIS PQ _CNV_A_R_LINEAR_____31_CM 8 0. 0.99998474 FORMAT "%7.5" AXIS_PTS_REF ldpm_pq__fac_ar_red_cor /end AXIS_DESCR
/end CHARACTERISTIC
/begin CHARACTERISTIC IP_CRLC_HFM "correlation constant for the first order time delay of the calculated air mass flow at the throttle" CURVE 0x4618a _REC_CUR_20_u2_u2 0.99998474 _CNV_A_R_LINEAR_____31_CM 0. 0.99998474 FORMAT "%7.5"
 /begin AXIS_DESCR COM_AXIS ONLINE_DUMMY _CNV_A_R_LINEAR_____348_CM 6 0. 7.99987793 FORMAT "%6.4" AXIS_PTS_REF ldp_t_seg_t_1_ratio_crlc_hfm /end AXIS_DESCR
/end CHARACTERISTIC
/begin CHARACTERISTIC IP_CRLC_AR_RED_AD_ADD_MMV "Averaging constant for the calculation of the mean value AR_RED_AD_ADD_MMV" CURVE 0x4da23 _REC_CUR_20_u1_u2 0.9960940000000002 _CNV_A_R_LINEAR_____44_CM 0. 0.996094 FORMAT "%5.3"
 /begin AXIS_DESCR COM_AXIS AR_RED_AD_ADD_DIF _CNV_A_R_LINEAR_____171_CM 4 0. 58.592855 FORMAT "%7.4" AXIS_PTS_REF ldp_ar_red_ad_add_dif /end AXIS_DESCR
/end CHARACTERISTIC
/begin MEASUREMENT AR_RED_AD_ADD "Additive adaptive factor" SWORD _CNV_A_R_LINEAR_____342_CM 1 100. -29.296875 29.29598047 ECU_ADDRESS 0x3fc65c FORMAT "%8.4" /end MEASUREMENT
/begin MEASUREMENT AR_RED_AD_ADD_MMV "Moving mean value of the addirive adaptive parameter" SWORD _CNV_A_R_LINEAR_____342_CM 1 100. -29.296875 29.29598047 ECU_ADDRESS 0x3fc664 FORMAT "%8.4" /end MEASUREMENT
/begin MEASUREMENT AR_RED_AD_ADD_DIF "Adaptation demand during current driving cycle" UWORD _CNV_A_R_LINEAR_____171_CM 1 100. 0. 58.592855 ECU_ADDRESS 0x3fc666 FORMAT "%7.4" /end MEASUREMENT
/begin MEASUREMENT LV_ACT_AR_RED_AD_ADD "Conditions for reduced throttle area adaptation are fullfilled" UBYTE _CNV_S_2_RANGE______28_CM 1 100. 0. 1. ECU_ADDRESS 0x3fdb55 /end MEASUREMENT
/begin MEASUREMENT AR_RED_ISA_DIF_I_REL_MMV "moving mean I-value (relative) of the closed loop control reduced ISA valve area" SWORD _CNV_A_R_LINEAR_____98_CM 1 100. -50. 49.99847412 ECU_ADDRESS 0x3fc688 FORMAT "%7.3" /end MEASUREMENT
/begin MEASUREMENT AR_RED_THR_DIF_I_REL_MMV "moving mean I-value (relative) of the closed loop control reduced throttle area" SWORD _CNV_A_R_LINEAR_____98_CM 1 100. -50. 49.99847412 ECU_ADDRESS 0x3fc686 FORMAT "%7.3" /end MEASUREMENT
/begin MEASUREMENT AR_RED_ISA "Reduced area at the ISA" UWORD _CNV_A_R_LINEAR_____171_CM 1 100. 0. 58.592855 ECU_ADDRESS 0x3fc682 FORMAT "%7.4" /end MEASUREMENT
/begin MEASUREMENT AR_RED_ISA_MAX "Maximum reduced area at the ISA, with AR_RED-controller and -Adaptation" UWORD _CNV_A_R_LINEAR_____171_CM 1 100. 0. 58.592855 ECU_ADDRESS 0x3fc68a FORMAT "%7.4" /end MEASUREMENT
/begin AXIS_PTS ldpm_pq_ar_red "" 0x45386 PQ _REC_AXS_20_u2 0.99998474 _CNV_A_R_LINEAR_____31_CM 4 0. 0.99998474 FORMAT "%7.5" /end AXIS_PTS
/begin AXIS_PTS ldpm_maf_kgh_t_1_hfm "" 0x4513a MAF_KGH _REC_AXS_20_u2 204.796875 _CNV_A_R_LINEAR_____101_CM 4 0. 2047.96875 FORMAT "%7.2" /end AXIS_PTS
/begin AXIS_PTS ldpm_n_ar_red "" 0x43ebb N_32 _REC_AXS_20_u1 8160. _CNV_A_R_LINEAR_____5_CM 6 0. 8160. FORMAT "%4.0" /end AXIS_PTS
/begin AXIS_PTS ldpm_pq__fac_ar_red_cor "" 0x45374 PQ _REC_AXS_20_u2 0.99998474 _CNV_A_R_LINEAR_____31_CM 8 0. 0.99998474 FORMAT "%7.5" /end AXIS_PTS
/begin AXIS_PTS ldp_t_seg_t_1_ratio_crlc_hfm "" 0x44aa8 T_SEG_T_1_RATIO _REC_AXS_20_u2 7.99987793 _CNV_A_R_LINEAR_____348_CM 6 0. 7.99987793 FORMAT "%6.4" /end AXIS_PTS
/begin AXIS_PTS ldp_ar_red_ad_add_dif "" 0x4418c AR_RED_AD_ADD_DIF _REC_AXS_20_u2 58.592855 _CNV_A_R_LINEAR_____171_CM 4 0. 58.592855 FORMAT "%7.4" /end AXIS_PTS
/begin MEASUREMENT AMP_MDL "Ambient pressure used for model adjustment (virtual value)" UWORD _CNV_A_R_LINEAR_____43_CM 1 100. 0. 5434. ECU_ADDRESS 0x3fc676 FORMAT "%7.2" /end MEASUREMENT
/begin MEASUREMENT AR_RED_DIF_I_REL_INI "Initial value for integral value of closed loop control during part load" SWORD _CNV_A_R_LINEAR_____98_CM 1 100. -50. 49.99847412 ECU_ADDRESS 0x3fc680 FORMAT "%7.3" /end MEASUREMENT
/begin CHARACTERISTIC C_AMP_MDL_DIF_I_MAX "Upper threshold of integral part of pressure controller" VALUE 0x431e6 _REC_VAL_20_s2 679.239635 _CNV_A_R_LINEAR_____337_CM -339.625 339.614635 FORMAT "%7.2" /end CHARACTERISTIC
/begin CHARACTERISTIC C_FAC_AR_RED_DIF_I_REL_INI "Scalling factor for part of AMP_MDL_DIF_I which is transformed to AR_RED_DIF_I_REL_INI" VALUE 0x4289f _REC_VAL_20_u1 1.9921875 _CNV_A_R_LINEAR_____103_CM 0. 1.9921875 FORMAT "%5.3" /end CHARACTERISTIC
/begin MEASUREMENT FAC_AR_RED_DIF "Weighting factor for reduced area share to THR and ISA" UBYTE _CNV_A_R_LINEAR_____44_CM 1 100. 0. 0.996094 ECU_ADDRESS 0x3fc692 FORMAT "%5.3" /end MEASUREMENT
/begin MEASUREMENT AMP_MDL_DIF_I_INI "Initialization value for integral part of pressure controller" SWORD _CNV_A_R_LINEAR_____337_CM 1 100. -339.625 339.614635 ECU_ADDRESS 0x3fc66c FORMAT "%7.2" /end MEASUREMENT
/begin CHARACTERISTIC C_AR_RED_ISA_MAX "maximum reduced area at full opened idle speed actuator valve" VALUE 0x42c3c _REC_VAL_20_u2 58.592855 _CNV_A_R_LINEAR_____171_CM 0. 58.592855 FORMAT "%7.4" /end CHARACTERISTIC
/begin CHARACTERISTIC LC_AR_RED_DIF_TRA "Logical variable for enable initialization of integral controller part" VALUE 0x42b65 _REC_VAL_20_u1 1. _CNV_A_R_LINEAR_____10_CM 0. 1. FORMAT "%2.0" /end CHARACTERISTIC
/begin CHARACTERISTIC IP_AR_RED_EGR__N_32__STK_AV_EGR "reduced area at the EGR-valve" MAP 0x45fe8 _REC_MAP_20_u2_u1_u1 58.592855 _CNV_A_R_LINEAR_____171_CM 0. 58.592855 FORMAT "%7.4"
 /begin AXIS_DESCR COM_AXIS N_32 _CNV_A_R_LINEAR_____5_CM 6 0. 8160. FORMAT "%4.0" AXIS_PTS_REF ldp_n_32_ar_red_egr /end AXIS_DESCR
 /begin AXIS_DESCR COM_AXIS STK_AV_EGR _CNV_A_R_LINEAR_____4_CM 8 0. 99.609375 FORMAT "%5.2" AXIS_PTS_REF ldp_stk_av_egr_ar_red_egr /end AXIS_DESCR
/end CHARACTERISTIC
/begin MEASUREMENT PRS_EX "Pressure in the exhaust system" UWORD _CNV_A_R_LINEAR_____43_CM 1 100. 0. 5434. ECU_ADDRESS 0x3fc696 FORMAT "%7.2" /end MEASUREMENT
/begin MEASUREMENT PRS_EX_INC "increase of exhaust pressure in comparison to ambient pressure" UWORD _CNV_A_R_LINEAR_____43_CM 1 100. 0. 5434. ECU_ADDRESS 0x3fc698 FORMAT "%7.2" /end MEASUREMENT
/begin CHARACTERISTIC IP_PRS_EX_INC "pressure increase in the exhaust pipe" CURVE 0x49e3c _REC_CUR_20_u2_u2 5434. _CNV_A_R_LINEAR_____43_CM 0. 5434. FORMAT "%7.2"
 /begin AXIS_DESCR COM_AXIS MAF_CYL _CNV_A_R_LINEAR_____101_CM 8 0. 2047.96875 FORMAT "%6.2" AXIS_PTS_REF ldpm_maf_cyl_ex /end AXIS_DESCR
/end CHARACTERISTIC
/begin CHARACTERISTIC IP_TEG_EGR__MAF_CYL "Temperature on the exhaust side of the EGR-Valve" CURVE 0x4b410 _REC_CUR_20_u2_u2 2047. _CNV_A_R_LINEAR_____211_CM 0. 2047. FORMAT "%7.2"
 /begin AXIS_DESCR COM_AXIS MAF_CYL _CNV_A_R_LINEAR_____101_CM 8 0. 2047.96875 FORMAT "%6.2" AXIS_PTS_REF ldpm_maf_cyl_ex /end AXIS_DESCR
/end CHARACTERISTIC
/begin MEASUREMENT TEG_EGR "Temperature on the exhaust side of the EGR-valve" UWORD _CNV_A_R_LINEAR_____211_CM 1 100. 0. 2047. ECU_ADDRESS 0x3fc69a FORMAT "%7.2" /end MEASUREMENT
/begin MEASUREMENT AR_RED_EGR "Reduced area at the EGR - valve (is only calculated if NC_EGR_CONF = 1)" UWORD _CNV_A_R_LINEAR_____171_CM 1 100. 0. 58.592855 ECU_ADDRESS 0x3fc694 FORMAT "%7.4" /end MEASUREMENT
/begin AXIS_PTS ldp_n_32_ar_red_egr "" 0x43656 N_32 _REC_AXS_20_u1 816. _CNV_A_R_LINEAR_____5_CM 6 0. 8160. FORMAT "%4.0" /end AXIS_PTS
/begin AXIS_PTS ldp_stk_av_egr_ar_red_egr "" 0x437f4 STK_AV_EGR _REC_AXS_20_u1 99.609375 _CNV_A_R_LINEAR_____4_CM 8 0. 99.609375 FORMAT "%5.2" /end AXIS_PTS
/begin AXIS_PTS ldpm_maf_cyl_ex "" 0x450aa MAF_CYL _REC_AXS_20_u2 2047.96875 _CNV_A_R_LINEAR_____101_CM 8 0. 2047.96875 FORMAT "%6.2" /end AXIS_PTS
/begin CHARACTERISTIC IP_T_VIM_EFF_VOL "transition time volumetric efficiency at VIM switching" CURVE 0x5078e _REC_CUR_20_u1_u1 2.55 _CNV_A_R_LINEAR_____27_CM 0. 2.55 FORMAT "%4.2"
 /begin AXIS_DESCR COM_AXIS N_32 _CNV_A_R_LINEAR_____5_CM 2 0. 8160. FORMAT "%4.0" AXIS_PTS_REF ldp_n_32__ip_t_vim_eff_vol /end AXIS_DESCR
/end CHARACTERISTIC
/begin AXIS_PTS ldp_n_32__ip_t_vim_eff_vol "" 0x43546 N_32 _REC_AXS_20_u1 8160. _CNV_A_R_LINEAR_____5_CM 2 0. 8160. FORMAT "%4.0" /end AXIS_PTS
/begin CHARACTERISTIC IP_EFF_VOL_SLOP_CAM_IN_VIM " Slope of the cylinder air-mass flow dependant on intake cam phasing, VIM_AV = 100%" MAP 0x46bec _REC_MAP_20_u2_u2_u2 12.05964 _CNV_A_R_LINEAR_____349_CM -6.029912009 6.029727991 FORMAT "%7.4"
 /begin AXIS_DESCR COM_AXIS N _CNV_A_R_LINEAR_____17_CM 18 0. 8160. FORMAT "%4.0" AXIS_PTS_REF ldpm_n__eff_vol /end AXIS_DESCR
 /begin AXIS_DESCR COM_AXIS CAM_AV_MV_IN _CNV_A_R_LINEAR_____350_CM 12 -768. 767.9765625 FORMAT "%7.2" AXIS_PTS_REF ldpm_cam_av_mv_in__eff_vol /end AXIS_DESCR
/end CHARACTERISTIC
/begin CHARACTERISTIC IP_EFF_VOL_SLOP_CAM_VO_VIM "Slope of the cylinder air-mass flow dependant on valve overlap, VIM_AV = 100%" MAP 0x46f4c _REC_MAP_20_u2_u2_u1 12.05964 _CNV_A_R_LINEAR_____349_CM -6.029912009 6.029727991 FORMAT "%7.4"
 /begin AXIS_DESCR COM_AXIS N _CNV_A_R_LINEAR_____17_CM 18 0. 8160. FORMAT "%4.0" AXIS_PTS_REF ldpm_n__eff_vol /end AXIS_DESCR
 /begin AXIS_DESCR COM_AXIS VO _CNV_A_R_LINEAR_____75_CM 12 0. 95.625 FORMAT "%5.2" AXIS_PTS_REF ldpm_vo__eff_vol /end AXIS_DESCR
/end CHARACTERISTIC
/begin CHARACTERISTIC IP_EFF_VOL_OFS_VIM "Offset of the cylinder air-mass flow, VIM_AV = 100%" MAP 0x46880 _REC_MAP_20_u2_u2_u1 2047.96875 _CNV_A_R_LINEAR_____101_CM 0. 2047.96875 FORMAT "%6.2"
 /begin AXIS_DESCR COM_AXIS N _CNV_A_R_LINEAR_____17_CM 18 0. 8160. FORMAT "%4.0" AXIS_PTS_REF ldpm_n__eff_vol /end AXIS_DESCR
 /begin AXIS_DESCR COM_AXIS VO _CNV_A_R_LINEAR_____75_CM 12 0. 95.625 FORMAT "%5.2" AXIS_PTS_REF ldpm_vo__eff_vol /end AXIS_DESCR
/end CHARACTERISTIC
/begin MEASUREMENT EFF_VOL_SLOP "slope of the volumetric efficiency" UWORD _CNV_A_R_LINEAR_____351_CM 1 100. 0. 12.05964 ECU_ADDRESS 0x3fc6a8 FORMAT "%7.4" /end MEASUREMENT
/begin CHARACTERISTIC IP_EFF_VOL_OFS "Offset of the cylinder air-mass flow, VIM_AV = 0%" MAP 0x466a0 _REC_MAP_20_u2_u2_u1 2047.96875 _CNV_A_R_LINEAR_____101_CM 0. 2047.96875 FORMAT "%6.2"
 /begin AXIS_DESCR COM_AXIS N _CNV_A_R_LINEAR_____17_CM 18 0. 8160. FORMAT "%4.0" AXIS_PTS_REF ldpm_n__eff_vol /end AXIS_DESCR
 /begin AXIS_DESCR COM_AXIS VO _CNV_A_R_LINEAR_____75_CM 12 0. 95.625 FORMAT "%5.2" AXIS_PTS_REF ldpm_vo__eff_vol /end AXIS_DESCR
/end CHARACTERISTIC
/begin CHARACTERISTIC IP_EFF_VOL_OFS_AMP "Ambient pressure correction of the offset cylinder mass air flow" CURVE 0x46850 _REC_CUR_20_u2_u2 1.99996948 _CNV_A_R_LINEAR_____45_CM 0. 1.99996948 FORMAT "%7.5"
 /begin AXIS_DESCR COM_AXIS AMP _CNV_A_R_LINEAR_____43_CM 6 0. 5434. FORMAT "%7.2" AXIS_PTS_REF ldpm_amp__eff_vol_amp /end AXIS_DESCR
/end CHARACTERISTIC
/begin CHARACTERISTIC IP_AMP_DEC__MAF_CYL "pressure decrease in the air cleaner ( max. Value 100 hPa)" CURVE 0x45fa8 _REC_CUR_20_u2_u2 5434. _CNV_A_R_LINEAR_____43_CM 0. 5434. FORMAT "%7.2"
 /begin AXIS_DESCR COM_AXIS MAF_CYL _CNV_A_R_LINEAR_____101_CM 4 0. 2047.96875 FORMAT "%6.2" AXIS_PTS_REF ldp_maf_cyl_amp_dec /end AXIS_DESCR
/end CHARACTERISTIC
/begin CHARACTERISTIC LC_AMP_INP_ENA "Default logical variable enabled for the input of the airfilter" VALUE 0x42b63 _REC_VAL_20_u1 1. _CNV_S_2_RANGE______28_CM 0. 1. /end CHARACTERISTIC
/begin MEASUREMENT PRS_UP_THR "Pressure upstream the throttle" UWORD _CNV_A_R_LINEAR_____43_CM 1 100. 0. 5434. ECU_ADDRESS 0x3fc6a2 FORMAT "%7.2" /end MEASUREMENT
/begin MEASUREMENT AR_RED_BAS "Basic reduced opening area" UWORD _CNV_A_R_LINEAR_____171_CM 1 100. 0. 58.592855 ECU_ADDRESS 0x3fc6a0 FORMAT "%7.4" /end MEASUREMENT
/begin CHARACTERISTIC C_TCYL_STND "standard temperature in cylinder" VALUE 0x42a91 _REC_VAL_20_u1 28.575 _CNV_A_R_LINEAR_____0_CM -48. 142.5 FORMAT "%5.1" /end CHARACTERISTIC
/begin CHARACTERISTIC C_TCO_STND "standard coolant temperature" VALUE 0x42a7d _REC_VAL_20_u1 28.575 _CNV_A_R_LINEAR_____0_CM -48. 142.5 FORMAT "%5.1" /end CHARACTERISTIC
/begin CHARACTERISTIC C_TIA_IM_STND "standard intake air temperature" VALUE 0x42ab0 _REC_VAL_20_u1 28.575 _CNV_A_R_LINEAR_____0_CM -48. 142.5 FORMAT "%5.1" /end CHARACTERISTIC
/begin MEASUREMENT PRS_UP_THR_MAX "Maximum pressure upstream the throttle" UWORD _CNV_A_R_LINEAR_____43_CM 1 100. 0. 5434. ECU_ADDRESS 0x3fc6a4 FORMAT "%7.2" /end MEASUREMENT
/begin MEASUREMENT EFF_VOL_TEMP_COR "volumetric efficiency correction factor due to temperature effects" UWORD _CNV_A_R_LINEAR_____45_CM 1 100. 0. 1.99996948 ECU_ADDRESS 0x3fdb58 FORMAT "%7.5" /end MEASUREMENT
/begin MEASUREMENT EFF_VOL_TEMP_COR_MMV "filtered volumetric efficiency correction factor due to temperature effects" UWORD _CNV_A_R_LINEAR_____45_CM 1 100. 0. 1.99996948 ECU_ADDRESS 0x3fdb5a FORMAT "%7.5" /end MEASUREMENT
/begin CHARACTERISTIC IP_EFF_VOL_SLOP_CAM_VO "Slope of the cylinder air-mass flow dependant on valve overlap, VIM_AV = 0%" MAP 0x46d9c _REC_MAP_20_u2_u2_u1 12.05964 _CNV_A_R_LINEAR_____349_CM -6.029912009 6.029727991 FORMAT "%7.4"
 /begin AXIS_DESCR COM_AXIS N _CNV_A_R_LINEAR_____17_CM 18 0. 8160. FORMAT "%4.0" AXIS_PTS_REF ldpm_n__eff_vol /end AXIS_DESCR
 /begin AXIS_DESCR COM_AXIS VO _CNV_A_R_LINEAR_____75_CM 12 0. 95.625 FORMAT "%5.2" AXIS_PTS_REF ldpm_vo__eff_vol /end AXIS_DESCR
/end CHARACTERISTIC
/begin CHARACTERISTIC IP_EFF_VOL_SLOP_CAM_IN "Slope of the cylinder air-mass flow dependant on intake cam phasing, VIM_AV = 0%" MAP 0x46a3c _REC_MAP_20_u2_u2_u2 12.05964 _CNV_A_R_LINEAR_____349_CM -6.029912009 6.029727991 FORMAT "%7.4"
 /begin AXIS_DESCR COM_AXIS N _CNV_A_R_LINEAR_____17_CM 18 0. 8160. FORMAT "%4.0" AXIS_PTS_REF ldpm_n__eff_vol /end AXIS_DESCR
 /begin AXIS_DESCR COM_AXIS CAM_AV_MV_IN _CNV_A_R_LINEAR_____350_CM 12 -768. 767.9765625 FORMAT "%7.2" AXIS_PTS_REF ldpm_cam_av_mv_in__eff_vol /end AXIS_DESCR
/end CHARACTERISTIC
/begin CHARACTERISTIC IP_CRLC_EFF_VOL_TEMP_COR "Volumetric efficiency filtering" CURVE 0x4da37 _REC_CUR_20_u1_u1 0.9960940000000002 _CNV_A_R_LINEAR_____44_CM 0. 0.996094 FORMAT "%5.3"
 /begin AXIS_DESCR COM_AXIS N_32 _CNV_A_R_LINEAR_____5_CM 6 0. 8160. FORMAT "%4.0" AXIS_PTS_REF ldp_n_32_ip_crlc_eff_vol_temp /end AXIS_DESCR
/end CHARACTERISTIC
/begin CHARACTERISTIC IP_EFF_TCO_FAC__N_32__MAF "Volumetric efficiency weighting factor versus cooling temperature" MAP 0x4dba7 _REC_MAP_20_u1_u1_u2 0.9960940000000002 _CNV_A_R_LINEAR_____44_CM 0. 0.996094 FORMAT "%5.3"
 /begin AXIS_DESCR COM_AXIS N_32 _CNV_A_R_LINEAR_____5_CM 8 0. 8160. FORMAT "%4.0" AXIS_PTS_REF ldpm_n_32__eff_vol_cor /end AXIS_DESCR
 /begin AXIS_DESCR COM_AXIS MAF _CNV_A_R_LINEAR_____95_CM 8 0. 1389. FORMAT "%7.2" AXIS_PTS_REF ldpm_maf__eff_vol_cor /end AXIS_DESCR
/end CHARACTERISTIC
/begin CHARACTERISTIC IP_EFF_TIA_IM_FAC__N_32__MAF "Volumetric effiency weighting factor versus intake manifold gas temperature" MAP 0x4dbe7 _REC_MAP_20_u1_u1_u2 0.9960940000000002 _CNV_A_R_LINEAR_____44_CM 0. 0.996094 FORMAT "%5.3"
 /begin AXIS_DESCR COM_AXIS N_32 _CNV_A_R_LINEAR_____5_CM 8 0. 8160. FORMAT "%4.0" AXIS_PTS_REF ldpm_n_32__eff_vol_cor /end AXIS_DESCR
 /begin AXIS_DESCR COM_AXIS MAF _CNV_A_R_LINEAR_____95_CM 8 0. 1389. FORMAT "%7.2" AXIS_PTS_REF ldpm_maf__eff_vol_cor /end AXIS_DESCR
/end CHARACTERISTIC
/begin CHARACTERISTIC IP_EFF_VOL_SLOP_AMP "Ambient pressure correction of the slope cylinder mass air flow" CURVE 0x46a30 _REC_CUR_20_u2_u2 1.99996948 _CNV_A_R_LINEAR_____45_CM 0. 1.99996948 FORMAT "%7.5"
 /begin AXIS_DESCR COM_AXIS AMP _CNV_A_R_LINEAR_____43_CM 6 0. 5434. FORMAT "%7.2" AXIS_PTS_REF ldpm_amp__eff_vol_amp /end AXIS_DESCR
/end CHARACTERISTIC
/begin CHARACTERISTIC IP_EFF_VOL_OFS_MAX "Offset of gasflow into cylinder at WOT and standard conditions" CURVE 0x4685c _REC_CUR_20_u2_u2 2047.96875 _CNV_A_R_LINEAR_____101_CM 0. 2047.96875 FORMAT "%7.2"
 /begin AXIS_DESCR COM_AXIS N _CNV_A_R_LINEAR_____17_CM 18 0. 8160. FORMAT "%4.0" AXIS_PTS_REF ldpm_n__eff_vol /end AXIS_DESCR
/end CHARACTERISTIC
/begin CHARACTERISTIC IP_EFF_VOL_SLOP_MAX "Slope of gasflow into cylinder at WOT and standard conditions" CURVE 0x470fc _REC_CUR_20_u2_u2 12.05964 _CNV_A_R_LINEAR_____351_CM 0. 12.05964 FORMAT "%7.4"
 /begin AXIS_DESCR COM_AXIS N _CNV_A_R_LINEAR_____17_CM 18 0. 8160. FORMAT "%4.0" AXIS_PTS_REF ldpm_n__eff_vol /end AXIS_DESCR
/end CHARACTERISTIC
/begin MEASUREMENT EFF_VOL_OFS_MAX_COR "max possible offset of the volumetric efficiency" UWORD _CNV_A_R_LINEAR_____101_CM 1 100. 0. 2047.96875 ECU_ADDRESS 0x3fc6aa FORMAT "%7.2" /end MEASUREMENT
/begin MEASUREMENT EFF_VOL_OFS "offset of the volumetric efficiency" UWORD _CNV_A_R_LINEAR_____101_CM 1 100. 0. 2047.96875 ECU_ADDRESS 0x3fc6a6 FORMAT "%7.2" /end MEASUREMENT
/begin MEASUREMENT EFF_VOL_SLOP_MAX_COR "max possible slope of the volumetric efficiency" UWORD _CNV_A_R_LINEAR_____351_CM 1 100. 0. 12.05964 ECU_ADDRESS 0x3fc6ac FORMAT "%7.4" /end MEASUREMENT
/begin MEASUREMENT AR_RED_ISA_BAS "Basic reduced opening area at the idle speed actuator" UWORD _CNV_A_R_LINEAR_____171_CM 1 100. 0. 58.592855 ECU_ADDRESS 0x3fc6b2 FORMAT "%7.4" /end MEASUREMENT
/begin AXIS_PTS ldp_maf_cyl_amp_dec "" 0x44532 MAF_CYL _REC_AXS_20_u2 2047.96875 _CNV_A_R_LINEAR_____101_CM 4 0. 2047.96875 FORMAT "%6.2" /end AXIS_PTS
/begin AXIS_PTS ldpm_vo__eff_vol "" 0x440b7 VO _REC_AXS_20_u1 95.625 _CNV_A_R_LINEAR_____75_CM 12 0. 95.625 FORMAT "%5.2" /end AXIS_PTS
/begin AXIS_PTS ldp_n_32_ip_crlc_eff_vol_temp "" 0x4365d N_32 _REC_AXS_20_u1 8160. _CNV_A_R_LINEAR_____5_CM 6 0. 8160. FORMAT "%4.0" /end AXIS_PTS
/begin AXIS_PTS ldpm_amp__eff_vol_amp "" 0x44e66 AMP _REC_AXS_20_u2 5434. _CNV_A_R_LINEAR_____43_CM 6 0. 5434. FORMAT "%7.2" /end AXIS_PTS
/begin AXIS_PTS ldpm_n_32__eff_vol_cor "" 0x43d80 N_32 _REC_AXS_20_u1 8160. _CNV_A_R_LINEAR_____5_CM 8 0. 8160. FORMAT "%4.0" /end AXIS_PTS
/begin AXIS_PTS ldpm_maf__eff_vol_cor "" 0x4506c MAF _REC_AXS_20_u2 1389. _CNV_A_R_LINEAR_____95_CM 8 0. 1389. FORMAT "%7.2" /end AXIS_PTS
/begin AXIS_PTS ldpm_n__eff_vol "" 0x452a2 N _REC_AXS_20_u2 8160. _CNV_A_R_LINEAR_____17_CM 18 0. 8160. FORMAT "%4.0" /end AXIS_PTS
/begin AXIS_PTS ldpm_cam_av_mv_in__eff_vol "" 0x44e82 CAM_AV_MV_IN _REC_AXS_20_u2 1535.9765625 _CNV_A_R_LINEAR_____350_CM 12 -768. 767.9765625 FORMAT "%7.2" /end AXIS_PTS
/begin MEASUREMENT EFF_VOL_OFS_BAS "Basic total value volumetric efficiency - offset" UWORD _CNV_A_R_LINEAR_____101_CM 1 100. 0. 2047.96875 ECU_ADDRESS 0x3fdb60 FORMAT "%7.2" /end MEASUREMENT
/begin MEASUREMENT EFF_VOL_SLOP_BAS "Basic total value  volumetric efficiency - slope" UWORD _CNV_A_R_LINEAR_____351_CM 1 100. 0. 12.05964 ECU_ADDRESS 0x3fdb62 FORMAT "%7.4" /end MEASUREMENT
/begin MEASUREMENT EFF_VOL_OFS_BAS_GOAL "Basic goal value volumetric efficiency - offset" UWORD _CNV_A_R_LINEAR_____101_CM 1 100. 0. 2047.96875 ECU_ADDRESS 0x3fdb64 FORMAT "%7.2" /end MEASUREMENT
/begin MEASUREMENT EFF_VOL_SLOP_BAS_GOAL "Basic goal value  volumetric efficiency - slope" UWORD _CNV_A_R_LINEAR_____351_CM 1 100. 0. 12.05964 ECU_ADDRESS 0x3fdb66 FORMAT "%7.4" /end MEASUREMENT
/begin MEASUREMENT EFF_VOL_OFS_BAS_0 "Basic value volumetric efficiency for VIM position 0 - offset" UWORD _CNV_A_R_LINEAR_____101_CM 1 100. 0. 2047.96875 ECU_ADDRESS 0x3fdb68 FORMAT "%7.2" /end MEASUREMENT
/begin MEASUREMENT EFF_VOL_SLOP_BAS_0 "Basic value  volumetric efficiency for VIM position 0 - slope" UWORD _CNV_A_R_LINEAR_____351_CM 1 100. 0. 12.05964 ECU_ADDRESS 0x3fdb6a FORMAT "%7.4" /end MEASUREMENT
/begin MEASUREMENT EFF_VOL_OFS_BAS_1 "Basic value volumetric efficiency for VIM position 1 - offset" UWORD _CNV_A_R_LINEAR_____101_CM 1 100. 0. 2047.96875 ECU_ADDRESS 0x3fdb6c FORMAT "%7.2" /end MEASUREMENT
/begin MEASUREMENT EFF_VOL_SLOP_BAS_1 "Basic value  volumetric efficiency for VIM position 1 - slope" UWORD _CNV_A_R_LINEAR_____351_CM 1 100. 0. 12.05964 ECU_ADDRESS 0x3fdb6e FORMAT "%7.4" /end MEASUREMENT
/begin MEASUREMENT V_MAP "Voltage of the intake manifold pressure sensor (for diagnosis)" UWORD _CNV_A_R_LINEAR_____358_CM 1 100. 0. 5. ECU_ADDRESS 0x3fc6ca FORMAT "%5.3" /end MEASUREMENT
/begin CHARACTERISTIC IP_MAP_MES_BAS__V_MAP "Conversion characteristic for MAP_MES_BAS" CURVE 0x49326 _REC_CUR_20_u2_u2 5434. _CNV_A_R_LINEAR_____43_CM 0. 5434. FORMAT "%7.2"
 /begin AXIS_DESCR COM_AXIS V_MAP _CNV_A_R_LINEAR_____358_CM 2 0. 5. FORMAT "%5.3" AXIS_PTS_REF ldp_v_map_map_mes_bas /end AXIS_DESCR
/end CHARACTERISTIC
/begin MEASUREMENT MAP_MES_BAS "Intake manifold air pressure per segment measured" UWORD _CNV_A_R_LINEAR_____43_CM 1 100. 0. 5434. ECU_ADDRESS 0x3fc6c8 FORMAT "%7.2" /end MEASUREMENT
/begin AXIS_PTS ldp_v_map_map_mes_bas "" 0x44d26 V_MAP _REC_AXS_20_u2 4.5 _CNV_A_R_LINEAR_____358_CM 2 0. 5. FORMAT "%5.3" /end AXIS_PTS
/begin MEASUREMENT N_32 "engine speed with a resolution of 32rpm" UBYTE _CNV_A_R_LINEAR_____5_CM 1 100. 0. 8160. ECU_ADDRESS 0x3fcc24 FORMAT "%4.0" /end MEASUREMENT
/begin MEASUREMENT T_SEG_AV "Current segment-time" UWORD _CNV_A_R_LINEAR_____208_CM 1 100. 0. 262.14 ECU_ADDRESS 0x3fcc22 FORMAT "%7.3" /end MEASUREMENT
/begin MEASUREMENT N_GRD "Engine speed gradient" SBYTE _CNV_A_R_LINEAR_____369_CM 1 100. -4096. 4064. ECU_ADDRESS 0x3fcc25 FORMAT "%4.0" /end MEASUREMENT
/begin MEASUREMENT N "engine speed with a resolution of 1rpm" UWORD _CNV_A_R_LINEAR_____17_CM 1 100. 0. 8160. ECU_ADDRESS 0x3fcc1e FORMAT "%4.0" /end MEASUREMENT
/begin MEASUREMENT N_TOOTH "Engine speed during start (calculated at every tooth period" UWORD _CNV_A_R_LINEAR_____17_CM 1 100. 0. 8160. ECU_ADDRESS 0x3fcc20 FORMAT "%4.0" /end MEASUREMENT
/begin MEASUREMENT LV_LOAD_RATIO_CHK "" UBYTE _CNV_S_2_RANGE______11_CM 1 100. 0. 1. ECU_ADDRESS 0x3fcd41 /end MEASUREMENT
/begin CHARACTERISTIC C_TOIL_GRD_MAX_DIAG "Max. permissible oil temperature gradient" VALUE 0x42abf _REC_VAL_20_u1 255. _CNV_A_R_LINEAR_____386_CM 0. 255. FORMAT "%3.0" /end CHARACTERISTIC
/begin CHARACTERISTIC IP_TOIL "Conversion table for linearization of TOIL value acquisition" CURVE 0x50ca1 _REC_CUR_20_u1_u1 200. _CNV_A_R_LINEAR_____3_CM -40. 160. FORMAT "%3.0"
 /begin AXIS_DESCR COM_AXIS V_TOIL _CNV_A_R_LINEAR_____38_CM 16 0. 4.998 FORMAT "%6.4" AXIS_PTS_REF ldp_v_toil__toil /end AXIS_DESCR
/end CHARACTERISTIC
/begin MEASUREMENT TOIL_STOP "Oil temperature at transition to ES" UBYTE _CNV_A_R_LINEAR_____3_CM 1 100. -40. 160. ECU_ADDRESS 0x3fcc9c FORMAT "%3.0" /end MEASUREMENT
/begin MEASUREMENT TOIL "Oil temperature" UBYTE _CNV_A_R_LINEAR_____3_CM 1 100. -40. 160. ECU_ADDRESS 0x3fcc9a FORMAT "%3.0" /end MEASUREMENT
/begin MEASUREMENT TOIL_MES "???" UBYTE _CNV_A_R_LINEAR_____3_CM 1 100. -40. 160. ECU_ADDRESS 0x3fcc9b FORMAT "%3.0" /end MEASUREMENT
/begin AXIS_PTS ldp_v_toil__toil "" 0x43a8f V_TOIL _REC_AXS_20_u1 4.998 _CNV_A_R_LINEAR_____38_CM 16 0. 4.998 FORMAT "%6.4" /end AXIS_PTS
/begin CHARACTERISTIC C_PV_GRD_LIH_MAX "Max. (positive) pedal gradient in case of an error" VALUE 0x42f0c _REC_VAL_20_u2 99.99847412 _CNV_A_R_LINEAR_____94_CM 0. 99.99847412 /end CHARACTERISTIC
/begin CHARACTERISTIC C_V_PVS_HYS_FIL "Area of the dejitter-filters" VALUE 0x42aee _REC_VAL_20_u1 1.24511719 _CNV_A_R_LINEAR_____177_CM 0. 1.24511719 FORMAT "%4.3" /end CHARACTERISTIC
/begin MEASUREMENT V_PVS_FIL_1 "Filtered PVS-voltage value for channel 1" UWORD _CNV_A_R_LINEAR_____33_CM 1 100. 0. 4.99511719 ECU_ADDRESS 0x3fdd9c FORMAT "%5.3" /end MEASUREMENT
/begin MEASUREMENT V_PVS_FIL_2 "Filtered PVS-voltage value for channel 2" UWORD _CNV_A_R_LINEAR_____33_CM 1 100. 0. 4.99511719 ECU_ADDRESS 0x3fdd9e FORMAT "%5.3" /end MEASUREMENT
/begin CHARACTERISTIC C_PVS_SLOP_1 "Slope value of  the pedal value 1" VALUE 0x42991 _REC_VAL_20_u1 79.6875 _CNV_A_R_LINEAR_____389_CM 0. 79.6875 FORMAT "%4.1" /end CHARACTERISTIC
/begin CHARACTERISTIC C_PVS_SLOP_2 "Slope value of  the pedal value 2" VALUE 0x42992 _REC_VAL_20_u1 79.6875 _CNV_A_R_LINEAR_____389_CM 0. 79.6875 FORMAT "%4.1" /end CHARACTERISTIC
/begin MEASUREMENT LV_KD "Flag for Kick-Down-Recognition (internally recognized from both PVS-voltages)" UBYTE _CNV_S_2_RANGE______11_CM 1 100. 0. 1. ECU_ADDRESS 0x3fcc5e BIT_MASK 0x1 /end MEASUREMENT
/begin CHARACTERISTIC C_V_PVS_OFS_1 "Offset of the pedal value 1" VALUE 0x42aef _REC_VAL_20_u1 1.24511719 _CNV_A_R_LINEAR_____177_CM 0. 1.24511719 FORMAT "%5.3" /end CHARACTERISTIC
/begin CHARACTERISTIC C_V_PVS_OFS_2 "Offset of the pedal value 2" VALUE 0x42af0 _REC_VAL_20_u1 1.24511719 _CNV_A_R_LINEAR_____177_CM 0. 1.24511719 FORMAT "%5.3" /end CHARACTERISTIC
/begin MEASUREMENT PV_AV "Global degree of activation of the accelerator pedal" UBYTE _CNV_A_R_LINEAR_____4_CM 1 100. 0. 99.609375 ECU_ADDRESS 0x3fcc58 FORMAT "%3.1" /end MEASUREMENT
/begin CHARACTERISTIC C_PV_AV_BLS_NOT_PLAUS_LGRD "Change limitation of pedal position in case of an PV_AV/Brake implausibility" VALUE 0x42f02 _REC_VAL_20_u2 99.99847412 _CNV_A_R_LINEAR_____94_CM 0. 99.99847412 /end CHARACTERISTIC
/begin CHARACTERISTIC C_PV_AV_BLS_NOT_PLAUS_HYS "Hysteresis in case of an PV_AV/Brake implausibility" VALUE 0x42982 _REC_VAL_20_u1 99.609375 _CNV_A_R_LINEAR_____4_CM 0. 99.609375 FORMAT "%4.1" /end CHARACTERISTIC
/begin MEASUREMENT PV_AV_2 "degree of activation of the accelerator pedal from PVS-channel 2" UBYTE _CNV_A_R_LINEAR_____4_CM 1 100. 0. 99.609375 ECU_ADDRESS 0x3fcc5a FORMAT "%3.1" /end MEASUREMENT
/begin MEASUREMENT PV_MAX "Maximum selection of pedal value interpretation" UBYTE _CNV_A_R_LINEAR_____4_CM 1 100. 0. 99.609375 ECU_ADDRESS 0x3fcc5d FORMAT "%3.1" /end MEASUREMENT
/begin MEASUREMENT PV_AV_GRD "Throttle position gradient before correction" UBYTE _CNV_A_R_LINEAR_____390_CM 1 100. -1250. 1240.234 ECU_ADDRESS 0x3fcc57 FORMAT "%6.1" /end MEASUREMENT
/begin CHARACTERISTIC C_PV_AV_BLS_NOT_PLAUS "Pedal position in case of an PV_AV/Brake implausibility" VALUE 0x42981 _REC_VAL_20_u1 99.609375 _CNV_A_R_LINEAR_____4_CM 0. 99.609375 FORMAT "%4.1" /end CHARACTERISTIC
/begin MEASUREMENT PV_AV_1 "degree of activation of the accelerator pedal from PVS-channel 1" UBYTE _CNV_A_R_LINEAR_____4_CM 1 100. 0. 99.609375 ECU_ADDRESS 0x3fcc59 FORMAT "%3.1" /end MEASUREMENT
/begin MEASUREMENT FAC_PV_CS_COR "Starting  correction" SWORD _CNV_A_R_LINEAR_____391_CM 1 100. -1. 0.99996948 ECU_ADDRESS 0x3fdda0 FORMAT "%8.5" /end MEASUREMENT
/begin MEASUREMENT FAC_PV_GS_COR "Gear shift correction" SWORD _CNV_A_R_LINEAR_____391_CM 1 100. -1. 0.99996948 ECU_ADDRESS 0x3fdda2 FORMAT "%8.5" /end MEASUREMENT
/begin MEASUREMENT FAC_PV_BAS_COR "basic correction" SWORD _CNV_A_R_LINEAR_____391_CM 1 100. -1. 0.99996948 ECU_ADDRESS 0x3fdda4 FORMAT "%8.5" /end MEASUREMENT
/begin MEASUREMENT FAC_PV_COR "Summation of corrections" UWORD _CNV_A_R_LINEAR_____158_CM 1 100. 0. 0.99997 ECU_ADDRESS 0x3fdda6 FORMAT "%8.6" /end MEASUREMENT
/begin MEASUREMENT PV_AV_RAW "Global degree of activation of the gas pedal" UBYTE _CNV_A_R_LINEAR_____4_CM 1 100. 0. 99.609375 ECU_ADDRESS 0x3fcc5b FORMAT "%3.1" /end MEASUREMENT
/begin CHARACTERISTIC IP_PV_LIH_MAX "Max. pedal position in case of an error" CURVE 0x4fdaf _REC_CUR_20_u1_u1 99.609375 _CNV_A_R_LINEAR_____4_CM 0. 99.609375 FORMAT "%4.1"
 /begin AXIS_DESCR COM_AXIS N_32 _CNV_A_R_LINEAR_____5_CM 6 0. 8160. FORMAT "%4.0" AXIS_PTS_REF ldp_n_32__pv_lih_max /end AXIS_DESCR
/end CHARACTERISTIC
/begin CHARACTERISTIC IP_FAC_PV_BAS_COR_MT "Basic correction" MAP 0x476f4 _REC_MAP_20_u2_u2_u1 1.99996948 _CNV_A_R_LINEAR_____392_CM -1. 0.99996948 FORMAT "%8.5"
 /begin AXIS_DESCR COM_AXIS N _CNV_A_R_LINEAR_____17_CM 6 1. 8160. FORMAT "%4.0" AXIS_PTS_REF ldpm_n__pv_fac_cor /end AXIS_DESCR
 /begin AXIS_DESCR COM_AXIS PV_AV_RAW _CNV_A_R_LINEAR_____4_CM 6 0. 99.609375 FORMAT "%4.1" AXIS_PTS_REF ldpm_pv_av_raw__pv_fac_cor /end AXIS_DESCR
/end CHARACTERISTIC
/begin CHARACTERISTIC IP_FAC_PV_BAS_COR_AT "Basic correction" MAP 0x476ac _REC_MAP_20_u2_u2_u1 1.99996948 _CNV_A_R_LINEAR_____392_CM -1. 0.99996948 FORMAT "%8.5"
 /begin AXIS_DESCR COM_AXIS N _CNV_A_R_LINEAR_____17_CM 6 1. 8160. FORMAT "%4.0" AXIS_PTS_REF ldpm_n__pv_fac_cor /end AXIS_DESCR
 /begin AXIS_DESCR COM_AXIS PV_AV_RAW _CNV_A_R_LINEAR_____4_CM 6 0. 99.609375 FORMAT "%4.1" AXIS_PTS_REF ldpm_pv_av_raw__pv_fac_cor /end AXIS_DESCR
/end CHARACTERISTIC
/begin CHARACTERISTIC IP_FAC_PV_BAS_COR_AMT "Basic correction" MAP 0x47664 _REC_MAP_20_u2_u2_u1 1.99996948 _CNV_A_R_LINEAR_____392_CM -1. 0.99996948 FORMAT "%8.5"
 /begin AXIS_DESCR COM_AXIS N _CNV_A_R_LINEAR_____17_CM 6 1. 8160. FORMAT "%4.0" AXIS_PTS_REF ldpm_n__pv_fac_cor /end AXIS_DESCR
 /begin AXIS_DESCR COM_AXIS PV_AV_RAW _CNV_A_R_LINEAR_____4_CM 6 0. 99.609375 FORMAT "%4.1" AXIS_PTS_REF ldpm_pv_av_raw__pv_fac_cor /end AXIS_DESCR
/end CHARACTERISTIC
/begin CHARACTERISTIC IP_FAC_PV_CS_COR_AMT "Clutch  intervention correction" MAP 0x4773c _REC_MAP_20_u2_u2_u1 1.99996948 _CNV_A_R_LINEAR_____392_CM -1. 0.99996948 FORMAT "%8.5"
 /begin AXIS_DESCR COM_AXIS N_DIF _CNV_A_R_LINEAR_____213_CM 6 -32768. 32767. FORMAT "%6.0" AXIS_PTS_REF ldpm_n_dif__pv_fac_cor /end AXIS_DESCR
 /begin AXIS_DESCR COM_AXIS PV_AV_RAW _CNV_A_R_LINEAR_____4_CM 6 0. 99.609375 FORMAT "%4.1" AXIS_PTS_REF ldpm_pv_av_raw__pv_fac_cor /end AXIS_DESCR
/end CHARACTERISTIC
/begin CHARACTERISTIC IP_FAC_PV_CS_COR_MT "Clutch  intervention correction" MAP 0x47784 _REC_MAP_20_u2_u2_u1 1.99996948 _CNV_A_R_LINEAR_____392_CM -1. 0.99996948 FORMAT "%8.5"
 /begin AXIS_DESCR COM_AXIS N_DIF _CNV_A_R_LINEAR_____213_CM 6 -32768. 32767. FORMAT "%6.0" AXIS_PTS_REF ldpm_n_dif__pv_fac_cor /end AXIS_DESCR
 /begin AXIS_DESCR COM_AXIS PV_AV_RAW _CNV_A_R_LINEAR_____4_CM 6 0. 99.609375 FORMAT "%4.1" AXIS_PTS_REF ldpm_pv_av_raw__pv_fac_cor /end AXIS_DESCR
/end CHARACTERISTIC
/begin CHARACTERISTIC IP_FAC_PV_GS_COR_AMT "Gear shift intervention correction" MAP 0x477cc _REC_MAP_20_u2_u2_u1 1.99996948 _CNV_A_R_LINEAR_____392_CM -1. 0.99996948 FORMAT "%8.5"
 /begin AXIS_DESCR COM_AXIS N _CNV_A_R_LINEAR_____17_CM 6 1. 8160. FORMAT "%4.0" AXIS_PTS_REF ldpm_n__pv_fac_cor /end AXIS_DESCR
 /begin AXIS_DESCR COM_AXIS PV_AV_RAW _CNV_A_R_LINEAR_____4_CM 6 0. 99.609375 FORMAT "%4.1" AXIS_PTS_REF ldpm_pv_av_raw__pv_fac_cor /end AXIS_DESCR
/end CHARACTERISTIC
/begin CHARACTERISTIC IP_FAC_PV_GS_COR_MT "Gear shift intervention correction" MAP 0x47814 _REC_MAP_20_u2_u2_u1 1.99996948 _CNV_A_R_LINEAR_____392_CM -1. 0.99996948 FORMAT "%8.5"
 /begin AXIS_DESCR COM_AXIS N _CNV_A_R_LINEAR_____17_CM 6 1. 8160. FORMAT "%4.0" AXIS_PTS_REF ldpm_n__pv_fac_cor /end AXIS_DESCR
 /begin AXIS_DESCR COM_AXIS PV_AV_RAW _CNV_A_R_LINEAR_____4_CM 6 0. 99.609375 FORMAT "%4.1" AXIS_PTS_REF ldpm_pv_av_raw__pv_fac_cor /end AXIS_DESCR
/end CHARACTERISTIC
/begin CHARACTERISTIC IP_FAC_VS_PV_GS_COR_AMT "Vehicle speed correction" CURVE 0x47fdc _REC_CUR_20_u2_u2 1.99996948 _CNV_A_R_LINEAR_____392_CM -1. 0.99996948 FORMAT "%8.5"
 /begin AXIS_DESCR COM_AXIS VS_FIL _CNV_A_R_LINEAR_____290_CM 8 0. 511.99218 FORMAT "%7.3" AXIS_PTS_REF ldpm_vs_fil__pv_fac_cor /end AXIS_DESCR
/end CHARACTERISTIC
/begin CHARACTERISTIC IP_FAC_VS_PV_GS_COR_MT "Vehicle speed correction" CURVE 0x47fec _REC_CUR_20_u2_u2 1.99996948 _CNV_A_R_LINEAR_____392_CM -1. 0.99996948 FORMAT "%8.5"
 /begin AXIS_DESCR COM_AXIS VS_FIL _CNV_A_R_LINEAR_____290_CM 8 0. 511.99218 FORMAT "%7.3" AXIS_PTS_REF ldpm_vs_fil__pv_fac_cor /end AXIS_DESCR
/end CHARACTERISTIC
/begin CHARACTERISTIC IP_FAC_VS_PV_BAS_COR_MT "Vehicle speed correction" CURVE 0x47fcc _REC_CUR_20_u2_u2 1.99996948 _CNV_A_R_LINEAR_____392_CM -1. 0.99996948 FORMAT "%8.5"
 /begin AXIS_DESCR COM_AXIS VS_FIL _CNV_A_R_LINEAR_____290_CM 8 0. 511.99218 FORMAT "%7.3" AXIS_PTS_REF ldpm_vs_fil__pv_fac_cor /end AXIS_DESCR
/end CHARACTERISTIC
/begin CHARACTERISTIC IP_FAC_VS_PV_BAS_COR_AT "Vehicle speed correction" CURVE 0x47fbc _REC_CUR_20_u2_u2 1.99996948 _CNV_A_R_LINEAR_____392_CM -1. 0.99996948 FORMAT "%8.5"
 /begin AXIS_DESCR COM_AXIS VS_FIL _CNV_A_R_LINEAR_____290_CM 8 0. 511.99218 FORMAT "%7.3" AXIS_PTS_REF ldpm_vs_fil__pv_fac_cor /end AXIS_DESCR
/end CHARACTERISTIC
/begin CHARACTERISTIC IP_FAC_VS_PV_BAS_COR_AMT "Vehicle speed correction" CURVE 0x47fac _REC_CUR_20_u2_u2 1.99996948 _CNV_A_R_LINEAR_____392_CM -1. 0.99996948 FORMAT "%8.5"
 /begin AXIS_DESCR COM_AXIS VS_FIL _CNV_A_R_LINEAR_____290_CM 8 0. 511.99218 FORMAT "%7.3" AXIS_PTS_REF ldpm_vs_fil__pv_fac_cor /end AXIS_DESCR
/end CHARACTERISTIC
/begin CHARACTERISTIC C_ADD_FAC_PV_BAS_MT "Additve correction at reverse gear" VALUE 0x42c1a _REC_VAL_20_u2 1.99996948 _CNV_A_R_LINEAR_____392_CM -1. 0.99996948 FORMAT "%8.5" /end CHARACTERISTIC
/begin CHARACTERISTIC C_ADD_FAC_PV_BAS_AT "Additve correction at reverse gear" VALUE 0x42c18 _REC_VAL_20_u2 1.99996948 _CNV_A_R_LINEAR_____392_CM -1. 0.99996948 FORMAT "%8.5" /end CHARACTERISTIC
/begin CHARACTERISTIC C_ADD_FAC_PV_BAS_AMT "Additve correction at reverse gear" VALUE 0x42c16 _REC_VAL_20_u2 1.99996948 _CNV_A_R_LINEAR_____392_CM -1. 0.99996948 FORMAT "%8.5" /end CHARACTERISTIC
/begin CHARACTERISTIC C_T_FAC_PV_GS "Timer switch off GS correction" VALUE 0x42fe6 _REC_VAL_20_u2 655.34 _CNV_A_R_LINEAR_____27_CM 1.e-002 655.35 FORMAT "%6.2" /end CHARACTERISTIC
/begin CHARACTERISTIC C_T_FAC_PV_CS "Timer switch off CS correction" VALUE 0x42fe4 _REC_VAL_20_u2 655.34 _CNV_A_R_LINEAR_____27_CM 1.e-002 655.35 FORMAT "%6.2" /end CHARACTERISTIC
/begin CHARACTERISTIC C_VS_MAX_FAC_PV_COR "Timer switch off CS correction" VALUE 0x42b2e _REC_VAL_20_u1 255. _CNV_A_R_LINEAR_____13_CM 0. 255. FORMAT "%3.0" /end CHARACTERISTIC
/begin CHARACTERISTIC C_V_PVS_THD_KD_HYS "Hysteresis of kick down recognition Channel 1" VALUE 0x42af2 _REC_VAL_20_u1 4.998 _CNV_A_R_LINEAR_____38_CM 0. 4.998 FORMAT "%6.4" /end CHARACTERISTIC
/begin CHARACTERISTIC C_V_PVS_THD_KD "Difference between C_V_PVS_SP_FL_1 and kick-down-recognition (Channel 1)" VALUE 0x42af1 _REC_VAL_20_u1 4.998 _CNV_A_R_LINEAR_____38_CM 0. 4.998 FORMAT "%6.4" /end CHARACTERISTIC
/begin MEASUREMENT PV_CRU "CRU control variable" UBYTE _CNV_A_R_LINEAR_____4_CM 1 100. 0. 99.609375 ECU_ADDRESS 0x3fcc5c FORMAT "%4.1" /end MEASUREMENT
/begin CHARACTERISTIC IP_PV_CRU_RNG_L "Scaling factor for requested torque at clutch from driver in low range mode" MAP 0x4fd6f _REC_MAP_20_u1_u1_u2 99.609375 _CNV_A_R_LINEAR_____4_CM 0. 99.609375 FORMAT "%4.1"
 /begin AXIS_DESCR COM_AXIS N_32 _CNV_A_R_LINEAR_____5_CM 8 0. 8160. FORMAT "%4.0" AXIS_PTS_REF ldpm_n_32__fac_tq_req_driv /end AXIS_DESCR
 /begin AXIS_DESCR COM_AXIS FAC_TQ_REQ_CRU _CNV_A_R_LINEAR_____45_CM 8 0. 1.99996948 FORMAT "%7.5" AXIS_PTS_REF ldpm_fac_tq_cru_dcc /end AXIS_DESCR
/end CHARACTERISTIC
/begin CHARACTERISTIC IP_PV_CRU "Scaling factor for requested torque at clutch from driver" MAP 0x4fd2f _REC_MAP_20_u1_u1_u2 99.609375 _CNV_A_R_LINEAR_____4_CM 0. 99.609375 FORMAT "%4.1"
 /begin AXIS_DESCR COM_AXIS N_32 _CNV_A_R_LINEAR_____5_CM 8 0. 8160. FORMAT "%4.0" AXIS_PTS_REF ldpm_n_32__fac_tq_req_driv /end AXIS_DESCR
 /begin AXIS_DESCR COM_AXIS FAC_TQ_REQ_CRU _CNV_A_R_LINEAR_____45_CM 8 0. 1.99996948 FORMAT "%7.5" AXIS_PTS_REF ldpm_fac_tq_cru_dcc /end AXIS_DESCR
/end CHARACTERISTIC
/begin AXIS_PTS ldp_n_32__pv_lih_max "" 0x435fa N_32 _REC_AXS_20_u1 816. _CNV_A_R_LINEAR_____5_CM 6 0. 8160. FORMAT "%4.0" /end AXIS_PTS
/begin AXIS_PTS ldpm_vs_fil__pv_fac_cor "" 0x4567a VS_FIL _REC_AXS_20_u2 51.199218 _CNV_A_R_LINEAR_____290_CM 8 0. 511.99218 FORMAT "%7.3" /end AXIS_PTS
/begin AXIS_PTS ldpm_n_dif__pv_fac_cor "" 0x452d6 N_DIF _REC_AXS_20_u2 6553.5 _CNV_A_R_LINEAR_____213_CM 6 -32768. 32767. FORMAT "%6.0" /end AXIS_PTS
/begin AXIS_PTS ldpm_n__pv_fac_cor "" 0x452c8 N _REC_AXS_20_u2 815.9 _CNV_A_R_LINEAR_____17_CM 6 1. 8160. FORMAT "%4.0" /end AXIS_PTS
/begin AXIS_PTS ldpm_pv_av_raw__pv_fac_cor "" 0x43f07 PV_AV_RAW _REC_AXS_20_u1 9.9609375 _CNV_A_R_LINEAR_____4_CM 6 0. 99.609375 FORMAT "%4.1" /end AXIS_PTS
/begin AXIS_PTS ldpm_n_32__fac_tq_req_driv "" 0x43dac N_32 _REC_AXS_20_u1 8160. _CNV_A_R_LINEAR_____5_CM 8 0. 8160. FORMAT "%4.0" /end AXIS_PTS
/begin AXIS_PTS ldpm_fac_tq_cru_dcc "" 0x44f70 FAC_TQ_REQ_CRU _REC_AXS_20_u2 1.99996948 _CNV_A_R_LINEAR_____45_CM 8 0. 1.99996948 FORMAT "%7.5" /end AXIS_PTS
/begin CHARACTERISTIC C_T_ES_TCO_PLAUS_MAX "Threshold for maximum T_ES time" VALUE 0x42fe0 _REC_VAL_20_u2 65535. _CNV_A_R_LINEAR_____35_CM 0. 65535. FORMAT "%5.0" /end CHARACTERISTIC
/begin CHARACTERISTIC C_T_ES_TCO_PLAUS_MIN "Threshold for minimum T_ES time" VALUE 0x42fe2 _REC_VAL_20_u2 65535. _CNV_A_R_LINEAR_____35_CM 0. 65535. FORMAT "%5.0" /end CHARACTERISTIC
/begin CHARACTERISTIC C_TCO_STOP_T_ES_PLAUS_MIN "Threshold for minimum differences of cooling temperature " VALUE 0x42a80 _REC_VAL_20_u1 190.5 _CNV_A_R_LINEAR_____1_CM 0. 190.5 FORMAT "%5.1" /end CHARACTERISTIC
/begin CHARACTERISTIC C_T_ES_SUB "substitute value of T_ES" VALUE 0x42fdc _REC_VAL_20_u2 65535. _CNV_A_R_LINEAR_____35_CM 0. 65535. FORMAT "%5.0" /end CHARACTERISTIC
/begin CHARACTERISTIC C_TCO_STOP_T_ES_PLAUS_MAX "Threshold for maximum differences of cooling temperature" VALUE 0x42a7f _REC_VAL_20_u1 190.5 _CNV_A_R_LINEAR_____1_CM 0. 190.5 FORMAT "%5.1" /end CHARACTERISTIC
/begin CHARACTERISTIC C_TCO_STOP_T_ES_MIN "Threshold for minimum cooling temperature at engine stop" VALUE 0x42a7e _REC_VAL_20_u1 190.5 _CNV_A_R_LINEAR_____0_CM -48. 142.5 FORMAT "%5.1" /end CHARACTERISTIC
/begin MEASUREMENT T_ES "Engine off duration" UWORD _CNV_A_R_LINEAR_____35_CM 1 100. 0. 65535. ECU_ADDRESS 0x3fcdcc FORMAT "%5.0" /end MEASUREMENT
/begin MEASUREMENT T_REL_CAN_ES "Time counter value at the start of engine off phase" UWORD _CNV_A_R_LINEAR_____35_CM 1 100. 0. 65535. ECU_ADDRESS 0x3fcdce FORMAT "%5.0" /end MEASUREMENT
/begin MEASUREMENT T_REL_CAN_ST "Time counter value at the end of engine off phase" UWORD _CNV_A_R_LINEAR_____35_CM 1 100. 0. 65535. ECU_ADDRESS 0x3fe2ce FORMAT "%5.0" /end MEASUREMENT
/begin MEASUREMENT LV_T_REL_CAN_REG "T_REL_CAN receiving of INSTR2 message" UBYTE _CNV_S_2_RANGE______28_CM 1 100. 0. 1. ECU_ADDRESS 0x3fcdd0 /end MEASUREMENT
/begin MEASUREMENT LV_T_ES_NOT_PLAUS "T_ES not plausible" UBYTE _CNV_S_2_RANGE______28_CM 1 100. 0. 1. ECU_ADDRESS 0x3fcdd1 /end MEASUREMENT
/begin CHARACTERISTIC C_T_TCO_SUB_IS_1 "max. time in IS before interrupt of TCO model" VALUE 0x43034 _REC_VAL_20_u2 65535. _CNV_A_R_LINEAR_____47_CM 0. 65535. FORMAT "%5.0" /end CHARACTERISTIC
/begin CHARACTERISTIC C_T_TCO_SUB_IS_2 "interrupt time TCO model during IS" VALUE 0x43036 _REC_VAL_20_u2 65535. _CNV_A_R_LINEAR_____47_CM 0. 65535. FORMAT "%5.0" /end CHARACTERISTIC
/begin CHARACTERISTIC C_T_TCO_SUB_PUC "interrupt time TCO model during PUC" VALUE 0x43038 _REC_VAL_20_u2 65535. _CNV_A_R_LINEAR_____47_CM 0. 65535. FORMAT "%5.0" /end CHARACTERISTIC
/begin CHARACTERISTIC C_TCO_SUB_BOL_2 "TCO substitute temperature 1 " VALUE 0x42a82 _REC_VAL_20_u1 28.575 _CNV_A_R_LINEAR_____0_CM -48. 142.5 FORMAT "%5.1" /end CHARACTERISTIC
/begin CHARACTERISTIC C_TCO_SUB_TOL "upper limit TCO substitute temperature" VALUE 0x42a83 _REC_VAL_20_u1 28.575 _CNV_A_R_LINEAR_____0_CM -48. 142.5 FORMAT "%5.1" /end CHARACTERISTIC
/begin CHARACTERISTIC C_TIA_DIAG "TIA threshold - TCO diagnosis" VALUE 0x42aaa _REC_VAL_20_u1 28.575 _CNV_A_R_LINEAR_____0_CM -48. 142.5 FORMAT "%5.1" /end CHARACTERISTIC
/begin CHARACTERISTIC IP_TCO_SUB_INC__MAF_KGH "TCO increment" CURVE 0x507ac _REC_CUR_20_u1_u2 37.95 _CNV_A_R_LINEAR_____409_CM 0.75 190.5 FORMAT "%6.2"
 /begin AXIS_DESCR COM_AXIS MAF_KGH _CNV_A_R_LINEAR_____101_CM 4 0. 2047.96875 FORMAT "%7.2" AXIS_PTS_REF ldp_maf_kgh__tco_sub_inc /end AXIS_DESCR
/end CHARACTERISTIC
/begin MEASUREMENT TCO_SUB "Substitute calculated TCO value" UBYTE _CNV_A_R_LINEAR_____0_CM 1 100. -48. 142.5 ECU_ADDRESS 0x3fcc90 FORMAT "%5.1" /end MEASUREMENT
/begin MEASUREMENT TCO_STOP "Coolant temperature at transition to ES" UBYTE _CNV_A_R_LINEAR_____0_CM 1 100. -48. 142.5 ECU_ADDRESS 0x3fcc91 FORMAT "%5.1" /end MEASUREMENT
/begin CHARACTERISTIC C_TCO_SUB_BOL_1 "TCO substitute temperature 1 " VALUE 0x42a81 _REC_VAL_20_u1 28.575 _CNV_A_R_LINEAR_____0_CM -48. 142.5 FORMAT "%5.1" /end CHARACTERISTIC
/begin MEASUREMENT TCO "coolant temperature" UBYTE _CNV_A_R_LINEAR_____0_CM 1 100. -48. 142.5 ECU_ADDRESS 0x3fcc8e FORMAT "%5.1" /end MEASUREMENT
/begin MEASUREMENT TCO_MES "measured coolant temperature" UBYTE _CNV_A_R_LINEAR_____0_CM 1 100. -48. 142.5 ECU_ADDRESS 0x3fcc8f FORMAT "%5.1" /end MEASUREMENT
/begin MEASUREMENT TCO_ST "coolant temperature at engine start" UBYTE _CNV_A_R_LINEAR_____0_CM 1 100. -48. 142.5 ECU_ADDRESS 0x3fcc92 FORMAT "%5.1" /end MEASUREMENT
/begin AXIS_PTS ldp_maf_kgh__tco_sub_inc "" 0x44614 MAF_KGH _REC_AXS_20_u2 2047.96875 _CNV_A_R_LINEAR_____101_CM 4 0. 2047.96875 FORMAT "%7.2" /end AXIS_PTS
/begin CHARACTERISTIC C_TCO_EX_DIF_DIAG "Difference between TCO and TCO - TCO_EX diagnosis" VALUE 0x42a4e _REC_VAL_20_u1 190.5 _CNV_A_R_LINEAR_____0_CM -48. 142.5 FORMAT "%5.1" /end CHARACTERISTIC
/begin MEASUREMENT TCO_EX_ST "Radiator outlet coolant temperature at engine start" UBYTE _CNV_A_R_LINEAR_____0_CM 1 100. -48. 142.5 ECU_ADDRESS 0x3fcc95 FORMAT "%5.1" /end MEASUREMENT
/begin MEASUREMENT TCO_EX "Radiator outlet temperature" UBYTE _CNV_A_R_LINEAR_____0_CM 1 100. -48. 142.5 ECU_ADDRESS 0x3fcc93 FORMAT "%5.1" /end MEASUREMENT
/begin MEASUREMENT TCO_EX_MES "Radiator outlet temperature" UBYTE _CNV_A_R_LINEAR_____0_CM 1 100. -48. 142.5 ECU_ADDRESS 0x3fcc94 FORMAT "%5.1" /end MEASUREMENT
/begin MEASUREMENT TEG_PCAT_DOWN_1 "exhaust gas temperature of precat" UWORD _CNV_A_R_LINEAR_____410_CM 1 100. 0. 1023.984375 ECU_ADDRESS 0x3fcca0 FORMAT "%6.1" /end MEASUREMENT
/begin MEASUREMENT TEG_PCAT_DOWN_2 "exhaust gas temperature of precat" UWORD _CNV_A_R_LINEAR_____410_CM 1 100. 0. 1023.984375 ECU_ADDRESS 0x3fcca6 FORMAT "%6.1" /end MEASUREMENT
/begin MEASUREMENT TEG_PCAT_DOWN_RAW_2 "exhaust gas temperature of precat,raw value i.e. not replaced by substitde value" UWORD _CNV_A_R_LINEAR_____410_CM 1 100. 0. 1023.984375 ECU_ADDRESS 0x3fcca8 FORMAT "%6.1" /end MEASUREMENT
/begin MEASUREMENT TEG_PCAT_DOWN_RAW_1 "exhaust gas temperature of precat,raw value i.e. not replaced by substitde value" UWORD _CNV_A_R_LINEAR_____410_CM 1 100. 0. 1023.984375 ECU_ADDRESS 0x3fcca2 FORMAT "%6.1" /end MEASUREMENT
/begin CHARACTERISTIC IP_TEG__V_TEG "convertion table of exhaust gas temperature" CURVE 0x4b20c _REC_CUR_20_u2_u2 1023.984375 _CNV_A_R_LINEAR_____410_CM 0. 1023.984375 FORMAT "%6.1"
 /begin AXIS_DESCR COM_AXIS ONLINE_DUMMY _CNV_A_R_LINEAR_____33_CM 16 0. 4.99511719 FORMAT "%5.3" AXIS_PTS_REF ldp_v_teg__teg /end AXIS_DESCR
/end CHARACTERISTIC
/begin AXIS_PTS ldp_v_teg__teg "" 0x44d90 V_TEG _REC_AXS_20_u2 4.99511719 _CNV_A_R_LINEAR_____33_CM 16 0. 4.99511719 FORMAT "%5.3" /end AXIS_PTS
/begin CHARACTERISTIC IP_FAC_AR_RED_DIF "P-value reduced throttle area (MAF-controlled)" CURVE 0x4ddd9 _REC_CUR_20_u1_u1 0.99610001 _CNV_A_R_LINEAR_____20_CM 0. 0.99610001 FORMAT "%5.3"
 /begin AXIS_DESCR COM_AXIS MAF_TURB_RATIO _CNV_A_R_LINEAR_____20_CM 8 0. 0.99610001 FORMAT "%5.3" AXIS_PTS_REF ldp_maf_turb_ratio /end AXIS_DESCR
/end CHARACTERISTIC
/begin AXIS_PTS ldp_maf_turb_ratio "" 0x434ae MAF_TURB_RATIO _REC_AXS_20_u1 0.99610001 _CNV_A_R_LINEAR_____20_CM 8 0. 0.99610001 FORMAT "%5.3" /end AXIS_PTS
/begin CHARACTERISTIC C_TIA_GRD_MAX_DIAG "Maximum permissible gradient for TIA" VALUE 0x42aad _REC_VAL_20_u1 38.1 _CNV_A_R_LINEAR_____436_CM 0. 190.5 FORMAT "%4.1" /end CHARACTERISTIC
/begin CHARACTERISTIC IP_TIA__V_TIA "NTC characteristic" CURVE 0x50c2d _REC_CUR_20_u1_u1 28.575 _CNV_A_R_LINEAR_____0_CM -48. 142.5 FORMAT "%5.1"
 /begin AXIS_DESCR COM_AXIS V_TIA _CNV_A_R_LINEAR_____437_CM 16 3.90625e-002 4.98046875 FORMAT "%5.3" AXIS_PTS_REF ldp_v_tia_tia /end AXIS_DESCR
/end CHARACTERISTIC
/begin MEASUREMENT TIA "Intake air temperature" UBYTE _CNV_A_R_LINEAR_____0_CM 1 100. -48. 142.5 ECU_ADDRESS 0x3fcc97 FORMAT "%5.1" /end MEASUREMENT
/begin MEASUREMENT TIA_MES "???" UBYTE _CNV_A_R_LINEAR_____0_CM 1 100. -48. 142.5 ECU_ADDRESS 0x3fcc98 FORMAT "%5.1" /end MEASUREMENT
/begin AXIS_PTS ldp_v_tia_tia "" 0x43a7e V_TIA _REC_AXS_20_u1 4.447265625 _CNV_A_R_LINEAR_____437_CM 16 3.90625e-002 4.98046875 FORMAT "%5.3" /end AXIS_PTS
/begin MEASUREMENT LV_ERR_BN_ETCU "Present error BN2000" UBYTE _CNV_S_2_RANGE______21_R_CM 1 100. 0. 255. ECU_ADDRESS 0x3fd643 /end MEASUREMENT
/begin MEASUREMENT LV_ERR_BN_TQ_AMT "Present error BN2000" UBYTE _CNV_S_2_RANGE______21_R_CM 1 100. 0. 255. ECU_ADDRESS 0x3fd647 /end MEASUREMENT
/begin MEASUREMENT LV_ERR_BN_ARS "Present error BN2000" UBYTE _CNV_S_2_RANGE______21_R_CM 1 100. 0. 255. ECU_ADDRESS 0x3fd62b /end MEASUREMENT
/begin MEASUREMENT LV_ERR_BN_TQ_DCC "Present error BN2000" UBYTE _CNV_S_2_RANGE______21_R_CM 1 100. 0. 255. ECU_ADDRESS 0x3fd627 /end MEASUREMENT
/begin MEASUREMENT LV_ERR_BN_TQ_TCS "Present error BN2000" UBYTE _CNV_S_2_RANGE______21_R_CM 1 100. 0. 255. ECU_ADDRESS 0x3fd633 /end MEASUREMENT
/begin MEASUREMENT LV_ERR_BN_VS_TCS "Present error BN2000" UBYTE _CNV_S_2_RANGE______21_R_CM 1 100. 0. 255. ECU_ADDRESS 0x3fd637 /end MEASUREMENT
/begin MEASUREMENT LV_ERR_BN_TCS "Present error BN2000" UBYTE _CNV_S_2_RANGE______21_R_CM 1 100. 0. 255. ECU_ADDRESS 0x3fd63b /end MEASUREMENT
/begin MEASUREMENT LV_ERR_BN_ANG_PSTE "Present error BN2000" UBYTE _CNV_S_2_RANGE______21_R_CM 1 100. 0. 255. ECU_ADDRESS 0x3fd66b /end MEASUREMENT
/begin MEASUREMENT TRT "total running time" ULONG _CNV_A_R_LINEAR_____155_CM 1 100. 0. 119304.6471 ECU_ADDRESS 0x3fcdd4 FORMAT "%12.5" /end MEASUREMENT
/begin MEASUREMENT LV_VAR_BN "BN2000 recognized" UBYTE _CNV_S_2_RANGE______28_CM 1 100. 0. 1. ECU_ADDRESS 0x3fcd19 /end MEASUREMENT
/begin MEASUREMENT LV_VB_JUMP "Boolean for  over voltage - ( Passive / Active )" UBYTE _CNV_S_2_RANGE______28_CM 1 100. 0. 1. ECU_ADDRESS 0x3fcddc BIT_MASK 0x1 /end MEASUREMENT
/begin CHARACTERISTIC C_CRLC_VB "Low pass filter constant for VB_MMV" VALUE 0x42845 _REC_VAL_20_u1 0.9960940000000002 _CNV_A_R_LINEAR_____44_CM 0. 0.996094 FORMAT "%5.3" /end CHARACTERISTIC
/begin MEASUREMENT VB_MMV "???" UBYTE _CNV_A_R_LINEAR_____53_CM 1 100. 0. 26. ECU_ADDRESS 0x3fcdda FORMAT "%4.1" /end MEASUREMENT
/begin MEASUREMENT LV_CDN_VB_OBD1 "Boolean for battery voltage condition fullfilled for OBD-I diagnosis" UBYTE _CNV_S_2_RANGE______28_CM 1 100. 0. 1. ECU_ADDRESS 0x3fcddd /end MEASUREMENT
/begin MEASUREMENT LV_CDN_VB_OBD2 "Boolean for battery voltage condition fullfilled for OBD-II diagnosis" UBYTE _CNV_S_2_RANGE______28_CM 1 100. 0. 1. ECU_ADDRESS 0x3fcdde /end MEASUREMENT
/begin CHARACTERISTIC C_VB_MIN_JUMP "Battery voltage threshold for over voltage detection" VALUE 0x42b11 _REC_VAL_20_u1 7.8 _CNV_A_R_LINEAR_____53_CM 0. 26. FORMAT "%4.1" /end CHARACTERISTIC
/begin CHARACTERISTIC C_VB_MIN_OBD2 "Battery voltage threshold for low voltage detection for OBD-II Variante" VALUE 0x42b14 _REC_VAL_20_u1 7.8 _CNV_A_R_LINEAR_____53_CM 0. 26. FORMAT "%4.1" /end CHARACTERISTIC
/begin CHARACTERISTIC C_VB_MIN_CAN_DIAG "VB time condition - diagnosis of timeout CAN messages" VALUE 0x42b0e _REC_VAL_20_u1 26. _CNV_A_R_LINEAR_____53_CM 0. 26. FORMAT "%4.1" /end CHARACTERISTIC
/begin MEASUREMENT LV_IGK "Boolean for ignition key status - ( Passive / Active )" UBYTE _CNV_S_2_RANGE______28_CM 1 100. 0. 1. ECU_ADDRESS 0x3fcddb BIT_MASK 0x1 /end MEASUREMENT
/begin MEASUREMENT VB "battery voltage" UBYTE _CNV_A_R_LINEAR_____53_CM 1 100. 0. 26. ECU_ADDRESS 0x3fcdd8 FORMAT "%4.1" /end MEASUREMENT
/begin MEASUREMENT VB_SECU "battery voltage secured for dwell computation" UBYTE _CNV_A_R_LINEAR_____53_CM 1 100. 0. 26. ECU_ADDRESS 0x3fe2d0 FORMAT "%4.1" /end MEASUREMENT
/begin MEASUREMENT V_IGK "Key-battery voltage" UBYTE _CNV_A_R_LINEAR_____53_CM 1 100. 0. 26. ECU_ADDRESS 0x3fcdd9 FORMAT "%4.1" /end MEASUREMENT
/begin MEASUREMENT LV_CDN_VB_MIN_DIAG "Boolean for battery voltage condition fullfilled for remaining diagnosis" UBYTE _CNV_S_2_RANGE______28_CM 1 100. 0. 1. ECU_ADDRESS 0x3fcde1 /end MEASUREMENT
/begin CHARACTERISTIC C_VB_MAX_OBD1 "Battery voltage threshold for maximum permissible battery voltage for OBD diagnosis" VALUE 0x42b0a _REC_VAL_20_u1 7.8 _CNV_A_R_LINEAR_____53_CM 0. 26. FORMAT "%4.1" /end CHARACTERISTIC
/begin CHARACTERISTIC C_VB_MIN_OBD1 "Battery voltage threshold for low voltage detection for OBD-I Variante" VALUE 0x42b13 _REC_VAL_20_u1 7.8 _CNV_A_R_LINEAR_____53_CM 0. 26. FORMAT "%4.1" /end CHARACTERISTIC
/begin CHARACTERISTIC C_VB_MAX_OBD2 "Battery voltage threshold for maximum permissible battery voltage for OBD diagnosis" VALUE 0x42b0b _REC_VAL_20_u1 7.8 _CNV_A_R_LINEAR_____53_CM 0. 26. FORMAT "%4.1" /end CHARACTERISTIC
/begin CHARACTERISTIC C_T_MIN_CAN_DIAG "VB time condition - diagnosis of timeout CAN messages" VALUE 0x42a17 _REC_VAL_20_u1 2550. _CNV_A_R_LINEAR_____23_CM 0. 2550. FORMAT "%4.0" /end CHARACTERISTIC
/begin CHARACTERISTIC C_VB_MIN_DIAG "Battery voltage threshold for low voltage detection for remaining diagnosis" VALUE 0x42b0f _REC_VAL_20_u1 7.8 _CNV_A_R_LINEAR_____53_CM 0. 26. FORMAT "%4.1" /end CHARACTERISTIC
/begin MEASUREMENT LV_CDN_VB_CAN_DIAG "Boolean for battery voltage condition fullfilled for CAN diagnosis" UBYTE _CNV_S_2_RANGE______28_CM 1 100. 0. 1. ECU_ADDRESS 0x3fcddf /end MEASUREMENT
/begin MEASUREMENT LV_WAKE_UP "Wake up signal detected" UBYTE _CNV_S_2_RANGE______28_CM 1 100. 0. 1. ECU_ADDRESS 0x3fcde2 /end MEASUREMENT
/begin CHARACTERISTIC C_VB_MIN_BN_DIAG "Battery voltage threshold for low voltage detection for BN2000 diagnosis" VALUE 0x42b0c _REC_VAL_20_u1 7.8 _CNV_A_R_LINEAR_____53_CM 0. 26. FORMAT "%4.1" /end CHARACTERISTIC
/begin MEASUREMENT LV_CDN_VB_BN_DIAG "Boolean for battery voltage condition fullfilled for BN2000 diagnosis" UBYTE _CNV_S_2_RANGE______28_CM 1 100. 0. 1. ECU_ADDRESS 0x3fcde0 /end MEASUREMENT
/begin MEASUREMENT VS_EDGE_CTR_AV "actual value of vehicle speed tooth counter" UWORD _CNV_A_R_LINEAR_____10_CM 1 100. 0. 65535. ECU_ADDRESS 0x3fe2d8 FORMAT "%5.0" /end MEASUREMENT
/begin MEASUREMENT VS_EDGE_T_AV "actual timestamp of last tooth" UWORD _CNV_A_R_LINEAR_____473_CM 1 100. 0. 524.28 ECU_ADDRESS 0x3fe2da FORMAT "%7.3" /end MEASUREMENT
/begin CHARACTERISTIC C_VS_MIN_RUN "minimum vehicle speed for detection of running vehicle" VALUE 0x42b3d _REC_VAL_20_u1 25.5 _CNV_A_R_LINEAR_____13_CM 0. 255. FORMAT "%3.0" /end CHARACTERISTIC
/begin MEASUREMENT LV_VS_RUN "Boolean for running vehicle" UBYTE _CNV_S_2_RANGE______28_CM 1 100. 0. 1. ECU_ADDRESS 0x3fcdec BIT_MASK 0x1 /end MEASUREMENT
/begin CHARACTERISTIC C_T_VST "Time delay for detection of vehicle speed" VALUE 0x42a33 _REC_VAL_20_u1 19. _CNV_A_R_LINEAR_____23_CM 10. 200. FORMAT "%3.0" /end CHARACTERISTIC
/begin CHARACTERISTIC C_VS_EDGE_SUM_MIN "Minimum number of wheel segments for evaluation of vehicle speedy gonzales" VALUE 0x42b22 _REC_VAL_20_u1 25.4 _CNV_A_R_LINEAR_____10_CM 1. 255. FORMAT "%3.0" /end CHARACTERISTIC
/begin MEASUREMENT VS_SENS "vehicle speed calculated from vehicle speed sensor" UWORD _CNV_A_R_LINEAR_____78_CM 1 100. 0. 511.99218 ECU_ADDRESS 0x3fcdea FORMAT "%7.3" /end MEASUREMENT
/begin MEASUREMENT VS_SENS_GRD "Vehicle speed gradient calculated from VS_SENS" SWORD _CNV_A_R_LINEAR_____474_CM 1 100. -256. 255.9921875 ECU_ADDRESS 0x3fe2e4 FORMAT "%8.3" /end MEASUREMENT
/begin MEASUREMENT LV_VST "boolean for stopped vehicle" UBYTE _CNV_S_2_RANGE______28_CM 1 100. 0. 1. ECU_ADDRESS 0x3fe2e8 BIT_MASK 0x1 /end MEASUREMENT
/begin CHARACTERISTIC C_VS_FAC "" VALUE 0x43370 _REC_VAL_20_u4 0.291271 _CNV_A_R_LINEAR_____475_CM 0. 0.291271 FORMAT "%10.9" /end CHARACTERISTIC
/begin MEASUREMENT VS "vehicle speed" UBYTE _CNV_A_R_LINEAR_____13_CM 1 100. 0. 255. ECU_ADDRESS 0x3fcde8 FORMAT "%3.0" /end MEASUREMENT
/begin MEASUREMENT DIST "" ULONG _CNV_A_R_LINEAR_____6_CM 1 100. 0. 429496729500. ECU_ADDRESS 0x3fcde4 FORMAT "%13.0" /end MEASUREMENT
/begin CHARACTERISTIC GEN_APP_TLR "generator load response time setpoint" VALUE 0x42b41 _REC_VAL_20_u1 25.5 _CNV_A_R_LINEAR_____14_CM 0. 25.5 FORMAT "%4.1" /end CHARACTERISTIC
/begin CHARACTERISTIC C_MAF_REF "reference air mass flow for rl" VALUE 0x42e7a _REC_VAL_20_u2 1389. _CNV_A_R_LINEAR_____95_CM 0. 1389. FORMAT "%7.2" /end CHARACTERISTIC
/begin CHARACTERISTIC LC_GEN_CLU "Generator clutch" VALUE 0x42b85 _REC_VAL_20_u1 1. _CNV_A_R_LINEAR_____10_CM 0. 1. FORMAT "%2.0" /end CHARACTERISTIC
/begin CHARACTERISTIC LC_ST_RLY_POW "Starter relay on off for PWM" VALUE 0x42bc5 _REC_VAL_20_u1 1. _CNV_A_R_LINEAR_____10_CM 0. 1. FORMAT "%2.0" /end CHARACTERISTIC
/begin MEASUREMENT TKATM "Catalyst temperature" UBYTE _CNV_A_R_LINEAR_____567_CM 1 100. -50. 1225. ECU_ADDRESS 0x3fc588 FORMAT "%5.0" /end MEASUREMENT
/begin MEASUREMENT LV_GEN_ERR_PLAUS "Typ of alternator not  plausible" UBYTE _CNV_S_2_RANGE______21_R_CM 1 100. 0. 255. ECU_ADDRESS 0x3fc591 /end MEASUREMENT
/begin MEASUREMENT LV_GEN_ERR_EL "Electrical alternator error output out of powermanagement" UBYTE _CNV_S_2_RANGE______21_R_CM 1 100. 0. 255. ECU_ADDRESS 0x3fc592 /end MEASUREMENT
/begin MEASUREMENT LV_GEN_ERR_MEC "mechanical alternator error output out of powermanagement" UBYTE _CNV_S_2_RANGE______21_R_CM 1 100. 0. 255. ECU_ADDRESS 0x3fc593 /end MEASUREMENT
/begin MEASUREMENT LV_GEN_ERR_TEMP "High temperature run at  alternator output out of powermanagement" UBYTE _CNV_S_2_RANGE______21_R_CM 1 100. 0. 255. ECU_ADDRESS 0x3fc594 /end MEASUREMENT
/begin MEASUREMENT LV_GEN_ERR_TOUT "Alternator comunication interupted" UBYTE _CNV_S_2_RANGE______21_R_CM 1 100. 0. 255. ECU_ADDRESS 0x3fc595 /end MEASUREMENT
/begin MEASUREMENT STATE_GEN_ERR "Conditions of alternator error output out of powermanagement" UBYTE _CNV_A_R_LINEAR_____10_CM 1 100. 0. 255. ECU_ADDRESS 0x3fc57a FORMAT "%3.0" /end MEASUREMENT
/begin MEASUREMENT STATE_GEN_ERR_IF "Conditions of BSD interface alternator error output out of powermanagement" UBYTE _CNV_A_R_LINEAR_____10_CM 1 100. 0. 255. ECU_ADDRESS 0x3fc57b FORMAT "%3.0" /end MEASUREMENT
/begin MEASUREMENT IMLATM "Integrated mass air flow for PWM" UBYTE _CNV_A_R_LINEAR_____568_CM 1 100. 0. 23.2106 ECU_ADDRESS 0x3fc584 FORMAT "%5.2" /end MEASUREMENT
/begin MEASUREMENT B_STA "Condition after start" UBYTE _CNV_S_2_RANGE______28_CM 1 100. 0. 1. ECU_ADDRESS 0x3fc585 /end MEASUREMENT
/begin MEASUREMENT B_SLP "Condition secondary air pump" UBYTE _CNV_S_2_RANGE______28_CM 1 100. 0. 1. ECU_ADDRESS 0x3fc586 /end MEASUREMENT
/begin MEASUREMENT B_GENFPRL "Alternator error active" UBYTE _CNV_S_2_RANGE______28_CM 1 100. 0. 1. ECU_ADDRESS 0x3fc581 /end MEASUREMENT
/begin MEASUREMENT B_TAERR "Error at intake air" UBYTE _CNV_S_2_RANGE______28_CM 1 100. 0. 1. ECU_ADDRESS 0x3fc582 /end MEASUREMENT
/begin MEASUREMENT B_TUMERS "Error at ambient temperature " UBYTE _CNV_S_2_RANGE______28_CM 1 100. 0. 1. ECU_ADDRESS 0x3fc583 /end MEASUREMENT
/begin MEASUREMENT B_MASTERHW "Master ECU (1 at MS45)" UBYTE _CNV_S_2_RANGE______28_CM 1 100. 0. 1. ECU_ADDRESS 0x3fc58a /end MEASUREMENT
/begin MEASUREMENT B_GFHTAK "High temperature run at  alternator output out of powermanagement active" UBYTE _CNV_S_2_RANGE______28_CM 1 100. 0. 1. ECU_ADDRESS 0x3fc57f /end MEASUREMENT
/begin MEASUREMENT nmot "engine speed" UBYTE _CNV_A_R_nmot_ub_q4_569_CM 1 100. 0. 10200. ECU_ADDRESS 0x3fc564 FORMAT "%8.4" /end MEASUREMENT
/begin MEASUREMENT rl "relative air charge" UBYTE _CNV_A_R_rel_ub_q0p_570_CM 1 100. 0. 191.25 ECU_ADDRESS 0x3fc566 FORMAT "%8.4" /end MEASUREMENT
/begin MEASUREMENT B_MASTER "" UBYTE _CNV_A_R_LINEAR_____12_CM 1 100. 0. 255. ECU_ADDRESS 0x3fc577 BIT_MASK 0x1 /end MEASUREMENT
/begin MEASUREMENT taml "Tastverhältnis E-Lüfter" UBYTE _CNV_R_R_rel_ub_b10_501_CM 1 100. 0. 100. ECU_ADDRESS 0x3fc56a FORMAT "%8.4" /end MEASUREMENT
/begin MEASUREMENT vvt_es "VVT-Strom Bank 1 bzw. 4 Zylinder" UBYTE _CNV_R_R_i_vvt_ub_q_476_CM 1 100. -63.5 64. ECU_ADDRESS 0x3fc56f FORMAT "%8.4" /end MEASUREMENT
/begin MEASUREMENT vvt_es2 "VVT-Strom Bank2" UBYTE _CNV_R_R_i_vvt_ub_q_476_CM 1 100. -63.5 64. ECU_ADDRESS 0x3fc570 FORMAT "%8.4" /end MEASUREMENT
/begin MEASUREMENT tumgcan "Aussentemperatur via CAN" SBYTE _CNV_R_R_temp_q1_535_CM 1 100. -128. 127. ECU_ADDRESS 0x3fc575 FORMAT "%8.4" /end MEASUREMENT
/begin MEASUREMENT nsllm "Normdrehzahl" UBYTE _CNV_R_R_nmot_ub_q1_571_CM 1 100. 0. 2550. ECU_ADDRESS 0x3fc56e FORMAT "%8.4" /end MEASUREMENT
/begin MEASUREMENT tmst "Motorstarttemperatur" UBYTE _CNV_R_R_temp_uw_q0_481_CM 1 100. -48. 143.25 ECU_ADDRESS 0x3fc574 FORMAT "%8.4" /end MEASUREMENT
/begin MEASUREMENT TQ_LOSS_ALTER_1 "Torque losses by alternator" SWORD _CNV_A_R_LINEAR_____48_CM 1 100. -1024. 1023.96875 ECU_ADDRESS 0x3fc55e FORMAT "%8.2" /end MEASUREMENT
/begin MEASUREMENT STATE_ALTER "Status of alternator diagnosis" UBYTE _CNV_A_R_LINEAR_____10_CM 1 100. 0. 3. ECU_ADDRESS 0x3fc578 FORMAT "%2.0" /end MEASUREMENT
/begin MEASUREMENT N_SP_IS_POW_1 "nominal idle speed setpoint by powermanagement" UWORD _CNV_A_R_LINEAR_____17_CM 1 100. 0. 8160. ECU_ADDRESS 0x3fc55a FORMAT "%4.0" /end MEASUREMENT
/begin MEASUREMENT mdnorm "Maximales indiziertes Motormoment für Moment-Normierung" UBYTE _CNV_R_R_md_ub_q16_572_CM 1 100. 16. 1008. ECU_ADDRESS 0x3fc571 FORMAT "%4.0" /end MEASUREMENT
/begin MEASUREMENT LV_N_SP_IS_POW_ACT "nominal idle speed setpoint by powermanagement" UBYTE _CNV_S_2_RANGE______28_CM 1 100. 0. 1. ECU_ADDRESS 0x3fc579 /end MEASUREMENT
/begin MEASUREMENT TQ_LOSS_ACC_INP "ACC-torque for torque function" SWORD _CNV_A_R_LINEAR_____48_CM 1 100. -1024. 1023.96875 ECU_ADDRESS 0x3fc4b0 FORMAT "%8.2" /end MEASUREMENT
/begin MEASUREMENT N_ECF "Setpoint step of electric cooling fan speed" UBYTE _CNV_A_R_LINEAR_____10_CM 1 100. 0. 15. ECU_ADDRESS 0x3fc4b7 FORMAT "%2.0" /end MEASUREMENT
/begin MEASUREMENT LV_REQ_TCO_L "LV requirement for low coolant temperature" UBYTE _CNV_S_2_RANGE______11_CM 1 100. 0. 1. ECU_ADDRESS 0x3fc4c1 BIT_MASK 0x1 /end MEASUREMENT
/begin CHARACTERISTIC C_TQ_STND "Standard torque" VALUE 0x4330e _REC_VAL_20_s2 2047.96875 _CNV_A_R_LINEAR_____48_CM -1024. 1023.96875 FORMAT "%8.2" /end CHARACTERISTIC
/begin CHARACTERISTIC LC_TAM_MAN_AS "Logical constant switch TAM from CAN or application system" VALUE 0x42bcf _REC_VAL_20_u1 1. _CNV_A_R_LINEAR_____12_CM 0. 1. FORMAT "%1.0" /end CHARACTERISTIC
/begin CHARACTERISTIC C_TAM_MAN_AS "Ambient temperature TAM by application system" VALUE 0x42a37 _REC_VAL_20_u1 190.5 _CNV_A_R_LINEAR_____0_CM -48. 142.5 FORMAT "%5.1" /end CHARACTERISTIC
/begin MEASUREMENT GEAR_INFO "Gear information from EGS-ECU" UBYTE _CNV_A_R_LINEAR_____10_CM 1 100. 0. 7. ECU_ADDRESS 0x3fc4a9 FORMAT "%2.0" /end MEASUREMENT
/begin CHARACTERISTIC IP_FAC_TQ_REQ_CLU_IS__N_32 "Threshold on FAC_TQ_REQ_CLU for IS detection" CURVE 0x47d2a _REC_CUR_20_u2_u1 1.99996948 _CNV_A_R_LINEAR_____45_CM 0. 1.99996948 FORMAT "%7.5"
 /begin AXIS_DESCR COM_AXIS N_32 _CNV_A_R_LINEAR_____5_CM 3 0. 8160. FORMAT "%4.0" AXIS_PTS_REF ldp_n_32__fac_tq_req_clu_is /end AXIS_DESCR
/end CHARACTERISTIC
/begin CHARACTERISTIC C_FAC_TQ_REQ_CLU_IS_HYS "Hysteresis on threshold on FAC_TQ_REQ_CLU_for IS detection" VALUE 0x42d4a _REC_VAL_20_u2 1.99996948 _CNV_A_R_LINEAR_____45_CM 0. 1.99996948 FORMAT "%7.5" /end CHARACTERISTIC
/begin MEASUREMENT LV_ACCIN "LV ACC request" UBYTE _CNV_S_2_RANGE______11_CM 1 100. 0. 1. ECU_ADDRESS 0x3fc4c0 BIT_MASK 0x1 /end MEASUREMENT
/begin MEASUREMENT CTR_KM_CAN "vehicle kilometer reading from CAN message INSTR2" UWORD _CNV_A_R_LINEAR_____80_CM 1 100. 0. 655350. ECU_ADDRESS 0x3fc4b2 FORMAT "%7.0" /end MEASUREMENT
/begin MEASUREMENT T_REL_CAN "relative time counter" UWORD _CNV_A_R_LINEAR_____35_CM 1 100. 0. 65535. ECU_ADDRESS 0x3fc4b4 FORMAT "%5.0" /end MEASUREMENT
/begin CHARACTERISTIC IP_TCO__V_TCO "Conversion table for linearization of TCO value acquisition" CURVE 0x50790 _REC_CUR_20_u1_u2 28.575 _CNV_A_R_LINEAR_____0_CM -48. 142.5 FORMAT "%5.1"
 /begin AXIS_DESCR COM_AXIS ONLINE_DUMMY _CNV_A_R_LINEAR_____578_CM 16 7.8125e-002 4.99511719 FORMAT "%5.3" AXIS_PTS_REF ldp_v_tco__tco /end AXIS_DESCR
/end CHARACTERISTIC
/begin CHARACTERISTIC IP_TQ_LOSS_ACC_INP "ACC torque loss due to engine-speed and ACC torque demand" MAP 0x4c01c _REC_MAP_20_u2_u1_u1 2047.96875 _CNV_A_R_LINEAR_____218_CM -1024. 1023.96875 FORMAT "%6.2"
 /begin AXIS_DESCR COM_AXIS N_32 _CNV_A_R_LINEAR_____5_CM 6 0. 8160. FORMAT "%4.0" AXIS_PTS_REF ldp_n_32__tq_loss_acc /end AXIS_DESCR
 /begin AXIS_DESCR COM_AXIS TQ_ACCIN_CAN _CNV_A_R_LINEAR_____84_CM 6 0. 31. FORMAT "%3.0" AXIS_PTS_REF ldp_tq_accin_can__tq_loss_acc /end AXIS_DESCR
/end CHARACTERISTIC
/begin MEASUREMENT TAM "Ambient temperature" UBYTE _CNV_A_R_LINEAR_____0_CM 1 100. -48. 142.5 ECU_ADDRESS 0x3fc4b6 FORMAT "%5.1" /end MEASUREMENT
/begin MEASUREMENT TQ_CONV_CAN "converter torque from ETCU" SWORD _CNV_A_R_LINEAR_____48_CM 1 100. -1024. 1023.96875 ECU_ADDRESS 0x3fc4a4 FORMAT "%6.2" /end MEASUREMENT
/begin MEASUREMENT STATE_CC "state of converter clutch (CC)" UBYTE _CNV_S_4_RANGE_STAT_579_CM 1 100. 0. 3. ECU_ADDRESS 0x3fc4aa /end MEASUREMENT
/begin MEASUREMENT ANG_PSTE "sttering wheel sensor angle" SWORD _CNV_A_R_LINEAR_____580_CM 1 100. -1433.6 1433.6 ECU_ADDRESS 0x3fc4cc FORMAT "%8.3" /end MEASUREMENT
/begin MEASUREMENT LV_ACIN "LV switch ACC readiness" UBYTE _CNV_S_2_RANGE______11_CM 1 100. 0. 1. ECU_ADDRESS 0x3fc4bf BIT_MASK 0x1 /end MEASUREMENT
/begin MEASUREMENT LV_FTL_LE_CAN_ERR "logical variable erroneous fuel tank level (left) signal" UBYTE _CNV_S_2_RANGE______28_CM 1 100. 0. 1. ECU_ADDRESS 0x3fc4c5 /end MEASUREMENT
/begin MEASUREMENT LV_FTL_RI_CAN_ERR "logical variable erroneous fuel tank level (right) signal" UBYTE _CNV_S_2_RANGE______28_CM 1 100. 0. 1. ECU_ADDRESS 0x3fc4c6 /end MEASUREMENT
/begin MEASUREMENT LV_FTL_OBD_INH_L "logical variable fuel reserve" UBYTE _CNV_S_2_RANGE______28_CM 1 100. 0. 1. ECU_ADDRESS 0x3fc4c3 /end MEASUREMENT
/begin MEASUREMENT FTL_RI "fuel tank level right" UBYTE _CNV_A_R_LINEAR_____85_CM 1 100. 0. 127. ECU_ADDRESS 0x3fc4ba FORMAT "%3.0" /end MEASUREMENT
/begin MEASUREMENT FTL_LE "fuel tank level left" UBYTE _CNV_A_R_LINEAR_____85_CM 1 100. 0. 127. ECU_ADDRESS 0x3fc4b9 FORMAT "%3.0" /end MEASUREMENT
/begin MEASUREMENT LV_TQ_ASR_REQ "logical variable for ASR request" UBYTE _CNV_S_2_RANGE______28_CM 1 100. 0. 1. ECU_ADDRESS 0x3fc488 /end MEASUREMENT
/begin MEASUREMENT LV_TQ_MSR_REQ "logical variable for MSR request" UBYTE _CNV_S_2_RANGE______28_CM 1 100. 0. 1. ECU_ADDRESS 0x3fc489 /end MEASUREMENT
/begin MEASUREMENT STATE_ETCU_OBD "status OBD gearbox" UBYTE _CNV_S_9_STATE_AMT__93_CM 1 100. 0. 15. ECU_ADDRESS 0x3fc4ac /end MEASUREMENT
/begin CHARACTERISTIC IP_AR_RED_THR "reduced area at the throttle" CURVE 0x46128 _REC_CUR_20_u2_u2 58.592855 _CNV_A_R_LINEAR_____171_CM 0. 58.592855 FORMAT "%7.4"
 /begin AXIS_DESCR COM_AXIS TPS_SEG _CNV_A_R_LINEAR_____226_CM 16 0. 119.5 AXIS_PTS_REF ldp_tps_seg_ar_red_thr /end AXIS_DESCR
/end CHARACTERISTIC
/begin CHARACTERISTIC IP_AR_RED_ISA "reduced area at the idle speed actuator" CURVE 0x460a8 _REC_CUR_20_u2_u2 58.592855 _CNV_A_R_LINEAR_____171_CM 0. 58.592855 FORMAT "%7.4"
 /begin AXIS_DESCR COM_AXIS ISAPWM_MMV _CNV_A_R_LINEAR_____94_CM 16 0. 99.99847412 AXIS_PTS_REF ldp_isapwm_mmv /end AXIS_DESCR
/end CHARACTERISTIC
/begin CHARACTERISTIC C_CAM_OP_EX "outlet valves total opening angle" VALUE 0x42803 _REC_VAL_20_u1 95.625 _CNV_A_R_LINEAR_____582_CM 175. 270.625 FORMAT "%5.1" /end CHARACTERISTIC
/begin CHARACTERISTIC C_CAM_OP_IN "inlet valves total opening angle" VALUE 0x42804 _REC_VAL_20_u1 95.625 _CNV_A_R_LINEAR_____582_CM 175. 270.625 FORMAT "%5.1" /end CHARACTERISTIC
/begin CHARACTERISTIC C_CAM_ADJ_RNG_MAX_IN "adjustment range of inlet camshaft" VALUE 0x427f6 _REC_VAL_20_u1 60. _CNV_A_R_LINEAR_____75_CM 0. 60. FORMAT "%4.1" /end CHARACTERISTIC
/begin CHARACTERISTIC C_CAM_ADJ_RNG_MAX_EX "adjustment range of exhaust camshaft" VALUE 0x427f5 _REC_VAL_20_u1 60. _CNV_A_R_LINEAR_____75_CM 0. 60. FORMAT "%4.1" /end CHARACTERISTIC
/begin AXIS_PTS ldp_n_32__fac_tq_req_clu_is "" 0x434fb N_32 _REC_AXS_20_u1 8160. _CNV_A_R_LINEAR_____5_CM 3 0. 8160. FORMAT "%4.0" /end AXIS_PTS
/begin AXIS_PTS ldp_tq_accin_can__tq_loss_acc "" 0x43a72 TQ_ACCIN_CAN _REC_AXS_20_u1 31. _CNV_A_R_LINEAR_____84_CM 6 0. 31. FORMAT "%3.0" /end AXIS_PTS
/begin AXIS_PTS ldp_n_32__tq_loss_acc "" 0x43643 N_32 _REC_AXS_20_u1 8160. _CNV_A_R_LINEAR_____5_CM 6 0. 8160. FORMAT "%4.0" /end AXIS_PTS
/begin AXIS_PTS ldp_v_tco__tco "" 0x44d4c V_TCO _REC_AXS_20_u2 4.425292971 _CNV_A_R_LINEAR_____578_CM 16 7.8125e-002 4.99511719 FORMAT "%5.3" /end AXIS_PTS
/begin AXIS_PTS ldp_tps_seg_ar_red_thr "" 0x44bbe TPS_SEG _REC_AXS_20_u2 119.5 _CNV_A_R_LINEAR_____226_CM 16 0. 119.5 /end AXIS_PTS
/begin AXIS_PTS ldpm_pq_estim_id_maf_fac_ofs "" 0x45390 PQ_ESTIM _REC_AXS_20_u2 0.99998474 _CNV_A_R_LINEAR_____31_CM 16 0. 0.99998474 FORMAT "%7.5" /end AXIS_PTS
/begin AXIS_PTS ldp_isapwm_mmv "" 0x44422 ISAPWM_MMV _REC_AXS_20_u2 99.99847412 _CNV_A_R_LINEAR_____94_CM 16 0. 99.99847412 /end AXIS_PTS
/begin MEASUREMENT ECU_STATE "Information on ECU state" UBYTE _CNV_S_6_RANGE_ECU__584_CM 1 100. 0. 5. ECU_ADDRESS 0x3f9c85 /end MEASUREMENT
/begin MEASUREMENT TLRGEN "generator load response time setpoint" UBYTE _CNV_A_R_LINEAR_____14_CM 1 100. 0. 25.5 ECU_ADDRESS 0x3fa479 FORMAT "%4.1" /end MEASUREMENT
/begin CHARACTERISTIC C_AMP_AD_COR_CLRC "Correlation constant for ambient pressure learning" VALUE 0x427bb _REC_VAL_20_u1 0.9960940000000002 _CNV_A_R_LINEAR_____44_CM 0. 0.996094 FORMAT "%5.3" /end CHARACTERISTIC
/begin COMPU_METHOD _CNV_A_R_LINEAR_____0_CM "" RAT_FUNC "%6.3" "°C" COEFFS 0 1.333333333333333 64. 0 0 1 /end COMPU_METHOD
/begin COMPU_METHOD _CNV_A_R_LINEAR_____1_CM "" RAT_FUNC "%6.3" "°C" COEFFS 0 1.333333333333333 0. 0 0 1 /end COMPU_METHOD
/begin COMPU_METHOD _CNV_A_R_LINEAR_____3_CM "" RAT_FUNC "%6.3" "°C" COEFFS 0 1. 40. 0 0 1 /end COMPU_METHOD
/begin COMPU_METHOD _CNV_A_R_LINEAR_____4_CM "" RAT_FUNC "%6.3" "%" COEFFS 0 2.56 0. 0 0 1 /end COMPU_METHOD
/begin COMPU_METHOD _CNV_A_R_LINEAR_____5_CM "" RAT_FUNC "%6.3" "rpm" COEFFS 0 3.125e-002 0. 0 0 1 /end COMPU_METHOD
/begin COMPU_METHOD _CNV_A_R_LINEAR_____6_CM "" RAT_FUNC "%6.3" "m" COEFFS 0 1.e-002 0. 0 0 1 /end COMPU_METHOD
/begin COMPU_METHOD _CNV_A_R_LINEAR_____10_CM "" RAT_FUNC "%6.3" "-" COEFFS 0 1. 0. 0 0 1 /end COMPU_METHOD
/begin COMPU_METHOD _CNV_S_2_RANGE______11_CM "" TAB_VERB "%6.3" "-" COMPU_TAB_REF _CNV_S_2_RANGE______11 /end COMPU_METHOD
/begin COMPU_VTAB _CNV_S_2_RANGE______11 "" TAB_VERB 2 0 "0" 1 "1" /end COMPU_VTAB
/begin COMPU_METHOD _CNV_A_R_LINEAR_____12_CM "" RAT_FUNC "%6.3" "[-]" COEFFS 0 1. 0. 0 0 1 /end COMPU_METHOD
/begin COMPU_METHOD _CNV_A_R_LINEAR_____13_CM "" RAT_FUNC "%6.3" "km/h" COEFFS 0 1. 0. 0 0 1 /end COMPU_METHOD
/begin COMPU_METHOD _CNV_A_R_LINEAR_____14_CM "" RAT_FUNC "%6.3" "s" COEFFS 0 10. 0. 0 0 1 /end COMPU_METHOD
/begin COMPU_METHOD _CNV_A_R_LINEAR_____17_CM "" RAT_FUNC "%6.3" "rpm" COEFFS 0 1. 0. 0 0 1 /end COMPU_METHOD
/begin COMPU_METHOD _CNV_A_R_LINEAR_____20_CM "" RAT_FUNC "%6.3" "-" COEFFS 0 255.9983911655618 0. 0 0 1 /end COMPU_METHOD
/begin COMPU_METHOD _CNV_S_2_RANGE______21_R_CM "" TAB_VERB "%6.3" "[-]" COMPU_TAB_REF _CNV_S_2_RANGE______21_R /end COMPU_METHOD
/begin COMPU_VTAB_RANGE _CNV_S_2_RANGE______21_R "" 2 0 0 "0" 1 255 "1" /end COMPU_VTAB_RANGE
/begin COMPU_METHOD _CNV_A_R_LINEAR_____23_CM "" RAT_FUNC "%6.3" "ms" COEFFS 0 0.1 0. 0 0 1 /end COMPU_METHOD
/begin COMPU_METHOD _CNV_A_R_LINEAR_____27_CM "" RAT_FUNC "%6.3" "s" COEFFS 0 100. 0. 0 0 1 /end COMPU_METHOD
/begin COMPU_METHOD _CNV_S_2_RANGE______28_CM "" TAB_VERB "%6.3" "[-]" COMPU_TAB_REF _CNV_S_2_RANGE______28 /end COMPU_METHOD
/begin COMPU_VTAB _CNV_S_2_RANGE______28 "" TAB_VERB 2 0 "0" 1 "1" /end COMPU_VTAB
/begin COMPU_METHOD _CNV_A_R_LINEAR_____31_CM "" RAT_FUNC "%6.3" "-" COEFFS 0 65536.00007936121 0. 0 0 1 /end COMPU_METHOD
/begin COMPU_METHOD _CNV_A_R_LINEAR_____33_CM "" RAT_FUNC "%6.3" "V" COEFFS 0 204.7999998974999 0. 0 0 1 /end COMPU_METHOD
/begin COMPU_METHOD _CNV_A_R_LINEAR_____35_CM "" RAT_FUNC "%6.3" "min" COEFFS 0 1. 0. 0 0 1 /end COMPU_METHOD
/begin COMPU_METHOD _CNV_A_R_LINEAR_____38_CM "" RAT_FUNC "%6.3" "V" COEFFS 0 51.0204081632653 0. 0 0 1 /end COMPU_METHOD
/begin COMPU_METHOD _CNV_A_R_LINEAR_____43_CM "" RAT_FUNC "%6.3" "hPa" COEFFS 0 12.06017666543982 0. 0 0 1 /end COMPU_METHOD
/begin COMPU_METHOD _CNV_A_R_LINEAR_____44_CM "" RAT_FUNC "%6.3" "[-]" COEFFS 0 255.9999357490357 0. 0 0 1 /end COMPU_METHOD
/begin COMPU_METHOD _CNV_A_R_LINEAR_____45_CM "" RAT_FUNC "%6.3" "-" COEFFS 0 32768.00003968061 0. 0 0 1 /end COMPU_METHOD
/begin COMPU_METHOD _CNV_A_R_LINEAR_____46_CM "" RAT_FUNC "%6.3" "h/(km*min)" COEFFS 0 1. 0. 0 0 1 /end COMPU_METHOD
/begin COMPU_METHOD _CNV_A_R_LINEAR_____47_CM "" RAT_FUNC "%6.3" "s" COEFFS 0 1. 0. 0 0 1 /end COMPU_METHOD
/begin COMPU_METHOD _CNV_A_R_LINEAR_____48_CM "" RAT_FUNC "%6.3" "Nm" COEFFS 0 32. 0. 0 0 1 /end COMPU_METHOD
/begin COMPU_METHOD _CNV_S_3_STATE_ARS__49_CM "" TAB_VERB "%6.3" "[-]" COMPU_TAB_REF _CNV_S_3_STATE_ARS__49 /end COMPU_METHOD
/begin COMPU_VTAB _CNV_S_3_STATE_ARS__49 "" TAB_VERB 3 0 "INACTIVE" 1 "ACTIVE" 3 "INVALID SIGNAL" /end COMPU_VTAB
/begin COMPU_METHOD _CNV_S_3_STATE_IGK__50_CM "" TAB_VERB "%6.3" "[-]" COMPU_TAB_REF _CNV_S_3_STATE_IGK__50 /end COMPU_METHOD
/begin COMPU_VTAB _CNV_S_3_STATE_IGK__50 "" TAB_VERB 3 0 "IGK OFF" 1 "IGK ON" 2 "INVALID SIGNAL" /end COMPU_VTAB
/begin COMPU_METHOD _CNV_S_4_STATE_TCS__51_CM "" TAB_VERB "%6.3" "[-]" COMPU_TAB_REF _CNV_S_4_STATE_TCS__51 /end COMPU_METHOD
/begin COMPU_VTAB _CNV_S_4_STATE_TCS__51 "" TAB_VERB 4 0 "NO INTERVENTION" 1 "MSR INTERVENTION" 2 "ASR INTERVENTION" 3 "INTERFACE LOCKED" /end COMPU_VTAB
/begin COMPU_METHOD _CNV_S_3_STATE_WAL__52_CM "" TAB_VERB "%6.3" "[-]" COMPU_TAB_REF _CNV_S_3_STATE_WAL__52 /end COMPU_METHOD
/begin COMPU_VTAB _CNV_S_3_STATE_WAL__52 "" TAB_VERB 3 0 "OFF" 1 "YELLOW" 3 "signal invalid" /end COMPU_VTAB
/begin COMPU_METHOD _CNV_A_R_LINEAR_____53_CM "" RAT_FUNC "%6.3" "V" COEFFS 0 9.807692307692308 0. 0 0 1 /end COMPU_METHOD
/begin COMPU_METHOD _CNV_A_R_LINEAR_____54_CM "" RAT_FUNC "%6.3" "Day" COEFFS 0 1. 0. 0 0 1 /end COMPU_METHOD
/begin COMPU_METHOD _CNV_S_9_STATE_TCS__55_CM "" TAB_VERB "%6.3" "[-]" COMPU_TAB_REF _CNV_S_9_STATE_TCS__55 /end COMPU_METHOD
/begin COMPU_VTAB _CNV_S_9_STATE_TCS__55 "" TAB_VERB 9 0 "NO_CONTROL" 1 "ABS_CONTROL" 2 "ASR_CONTROL" 4 "TCS_CONTROL" 8 "HBA_CONTROL" 16 "MSR_CONTROL" 32 "EBV_CONTROL" 64 "DYNO_ACTIVE" 255 "SIGNAL INVALID" /end COMPU_VTAB
/begin COMPU_METHOD _CNV_S_5_STATE_TCS__56_CM "" TAB_VERB "%6.3" "[-]" COMPU_TAB_REF _CNV_S_5_STATE_TCS__56 /end COMPU_METHOD
/begin COMPU_VTAB _CNV_S_5_STATE_TCS__56 "" TAB_VERB 5 0 "NO_INTERVENTION" 1 "DCC_INTV_ACCEPTED" 2 "EMF_INTV_ACCEPTED" 3 "HBA_INTV_ACCEPTED" 15 "SIGNAL INVALID" /end COMPU_VTAB
/begin COMPU_METHOD _CNV_A_R_LINEAR_____57_CM "" RAT_FUNC "%6.3" "m/s²" COEFFS 0 640.2931118710308 -3.637978807091713e-012 0 0 1 /end COMPU_METHOD
/begin COMPU_METHOD _CNV_S_5_STATE_MOD__58_CM "" TAB_VERB "%6.3" "[-]" COMPU_TAB_REF _CNV_S_5_STATE_MOD__58 /end COMPU_METHOD
/begin COMPU_VTAB _CNV_S_5_STATE_MOD__58 "" TAB_VERB 5 0 "SSC_SBC_OFF" 1 "SSC_ON" 2 "SBC_ON" 3 "SSC_SBC_ON" 7 "INVALID_SIGNAL" /end COMPU_VTAB
/begin COMPU_METHOD _CNV_S_6_STATE_TCS__59_CM "" TAB_VERB "%6.3" "[-]" COMPU_TAB_REF _CNV_S_6_STATE_TCS__59 /end COMPU_METHOD
/begin COMPU_VTAB _CNV_S_6_STATE_TCS__59 "" TAB_VERB 6 0 "VALID" 1 "PASSIV" 2 "DEFECTIVE" 4 "TRACTION MODE" 6 "UNDERVOLTAGE_TCS" 7 "INVALID SIGNAL" /end COMPU_VTAB
/begin COMPU_METHOD _CNV_S_4_STATE_TEMP_60_CM "" TAB_VERB "%6.3" "[-]" COMPU_TAB_REF _CNV_S_4_STATE_TEMP_60 /end COMPU_METHOD
/begin COMPU_VTAB _CNV_S_4_STATE_TEMP_60 "" TAB_VERB 4 0 "NO_REQUEST" 1 "ACTIVE_STEP_1" 2 "ACTIVE_STEP_2" 3 "INVALID_SIGNAL" /end COMPU_VTAB
/begin COMPU_METHOD _CNV_A_R_LINEAR_____61_CM "" RAT_FUNC "%6.3" "km/h" COEFFS 0 10. 0. 0 0 1 /end COMPU_METHOD
/begin COMPU_METHOD _CNV_S_4_STATE_ETCU_62_CM "" TAB_VERB "%6.3" "[-]" COMPU_TAB_REF _CNV_S_4_STATE_ETCU_62 /end COMPU_METHOD
/begin COMPU_VTAB _CNV_S_4_STATE_ETCU_62 "" TAB_VERB 4 0 "NO INTERVENTION" 1 "TORQUE_INCREASE" 2 "TORQUE_DECREASE" 3 "INTERFACE LOCKED" /end COMPU_VTAB
/begin COMPU_METHOD _CNV_S_4_STATE_DCC__63_CM "" TAB_VERB "%6.3" "[-]" COMPU_TAB_REF _CNV_S_4_STATE_DCC__63 /end COMPU_METHOD
/begin COMPU_VTAB _CNV_S_4_STATE_DCC__63 "" TAB_VERB 4 0 "NO_INTERVENTION" 1 "TORQUE_INCREASE" 2 "INVALID_SIGNAL" 3 "INVALID_SIGNAL" /end COMPU_VTAB
/begin COMPU_METHOD _CNV_S_3_STATE_DCC__64_CM "" TAB_VERB "%6.3" "[-]" COMPU_TAB_REF _CNV_S_3_STATE_DCC__64 /end COMPU_METHOD
/begin COMPU_VTAB _CNV_S_3_STATE_DCC__64 "" TAB_VERB 3 0 "NO_REQUEST" 1 "INHIBIT_PUC" 3 "INVALID_SIGNAL" /end COMPU_VTAB
/begin COMPU_METHOD _CNV_S_4_STATE_DCC__65_CM "" TAB_VERB "%6.3" "[-]" COMPU_TAB_REF _CNV_S_4_STATE_DCC__65 /end COMPU_METHOD
/begin COMPU_VTAB _CNV_S_4_STATE_DCC__65 "" TAB_VERB 4 0 "reserved" 1 "SYS_OFF" 2 "SYS_OK" 3 "INVALID_SIGNAL" /end COMPU_VTAB
/begin COMPU_METHOD _CNV_S_8_STATE_DCC_66_CM "" TAB_VERB "%6.3" "[-]" COMPU_TAB_REF _CNV_S_8_STATE_DCC_66 /end COMPU_METHOD
/begin COMPU_VTAB _CNV_S_8_STATE_DCC_66 "" TAB_VERB 8 0 "INACTIVE" 1 "STAND_BY" 2 "NORMAL" 3 "RESERVE" 4 "BRAKE_ACTIVE" 5 "DRIVER_ACTIVE" 6 "RESERVE" 7 "INVALID_SIGNAL" /end COMPU_VTAB
/begin COMPU_METHOD _CNV_S_3_STATE_ETCU_67_CM "" TAB_VERB "%6.3" "[-]" COMPU_TAB_REF _CNV_S_3_STATE_ETCU_67 /end COMPU_METHOD
/begin COMPU_VTAB _CNV_S_3_STATE_ETCU_67 "" TAB_VERB 3 0 "NO_OBD_ERROR" 1 "OBD_ERROR" 2 "INVALID_SIGNAL" /end COMPU_VTAB
/begin COMPU_METHOD _CNV_A_R_LINEAR_____68_CM "" RAT_FUNC "%6.3" "km" COEFFS 0 1. 0. 0 0 1 /end COMPU_METHOD
/begin COMPU_METHOD _CNV_R_R_spg_gencan_69_CM "" RAT_FUNC "%6.3" "V" COEFFS 0. 40. -424. 0. 0. 1. /end COMPU_METHOD
/begin COMPU_METHOD _CNV_A_R_LINEAR_____70_CM "" RAT_FUNC "%6.3" "V" COEFFS 0 10. -106. 0 0 1 /end COMPU_METHOD
/begin COMPU_METHOD _CNV_S_13_STATE_BN_M_71_CM "" TAB_VERB "%6.3" "[-]" COMPU_TAB_REF _CNV_S_13_STATE_BN_M_71 /end COMPU_METHOD
/begin COMPU_VTAB _CNV_S_13_STATE_BN_M_71 "" TAB_VERB 13 0 "NO_ACTION" 1 "TIP_PRE" 2 "TIP_POST" 4 "PRESS_PRE" 8 "PRESS_POST" 16 "TIP UP or DOWN" 64 "TIP_AXIAL" 65 "TIP_AXIAL" 66 "TIP_AXIAL" 68 "TIP_POST" 72 "PRESS_POST" 80 "TIP UP or DOWN" 127 "INVALID SIGNAL" /end COMPU_VTAB
/begin COMPU_METHOD _CNV_A_R_LINEAR_____72_CM "" RAT_FUNC "%6.3" "Nm" COEFFS 0 2. 0. 0 0 1 /end COMPU_METHOD
/begin COMPU_METHOD _CNV_S_3_STATE_ST_T_73_CM "" TAB_VERB "%6.3" "[-]" COMPU_TAB_REF _CNV_S_3_STATE_ST_T_73 /end COMPU_METHOD
/begin COMPU_VTAB _CNV_S_3_STATE_ST_T_73 "" TAB_VERB 3 0 "NO_INTERVENTION" 1 "INTERVENTION" 3 "INVALID_SIGNAL" /end COMPU_VTAB
/begin COMPU_METHOD _CNV_S_3_STATE_VS_I_74_CM "" TAB_VERB "%6.3" "[-]" COMPU_TAB_REF _CNV_S_3_STATE_VS_I_74 /end COMPU_METHOD
/begin COMPU_VTAB _CNV_S_3_STATE_VS_I_74 "" TAB_VERB 3 0 "km/h" 1 "mph" 3 "INVALID SIGNAL" /end COMPU_VTAB
/begin COMPU_METHOD _CNV_A_R_LINEAR_____75_CM "" RAT_FUNC "%6.3" "°CRK" COEFFS 0 2.666666666666667 0. 0 0 1 /end COMPU_METHOD
/begin COMPU_METHOD _CNV_A_R_LINEAR_____78_CM "" RAT_FUNC "%6.3" "km/h" COEFFS 0 128.0000018750286 0. 0 0 1 /end COMPU_METHOD
/begin COMPU_METHOD _CNV_A_R_LINEAR_____80_CM "" RAT_FUNC "%6.3" "km" COEFFS 0 0.1 0. 0 0 1 /end COMPU_METHOD
/begin COMPU_METHOD _CNV_A_R_LINEAR_____84_CM "" RAT_FUNC "%6.3" "Nm" COEFFS 0 1. 0. 0 0 1 /end COMPU_METHOD
/begin COMPU_METHOD _CNV_A_R_LINEAR_____85_CM "" RAT_FUNC "%6.3" "l" COEFFS 0 1. 0. 0 0 1 /end COMPU_METHOD
/begin COMPU_METHOD _CNV_A_R_LINEAR_____86_CM "" RAT_FUNC "%6.3" "°STW/s" COEFFS 0 22.8564453125 -3.637978807091713e-012 0 0 1 /end COMPU_METHOD
/begin COMPU_METHOD _CNV_S_5_STATE_AMT_91_CM "" TAB_VERB "%6.3" "[-]" COMPU_TAB_REF _CNV_S_5_STATE_AMT_91 /end COMPU_METHOD
/begin COMPU_VTAB _CNV_S_5_STATE_AMT_91 "" TAB_VERB 5 0 "NO INTERVENTION" 1 "TORQUE_DECREASE" 2 "N_REGULATION" 3 "TORQUE_INCREASE" 7 "INVALID_SIGNAL" /end COMPU_VTAB
/begin COMPU_METHOD _CNV_S_5_STATE_CLU__92_CM "" TAB_VERB "%6.3" "[-]" COMPU_TAB_REF _CNV_S_5_STATE_CLU__92 /end COMPU_METHOD
/begin COMPU_VTAB _CNV_S_5_STATE_CLU__92 "" TAB_VERB 5 0 "CLU_OPEN" 1 "CREEPING" 2 "DRIVE_OFF" 3 "CLU_CLOSED" 7 "INVALID_SIGNAL" /end COMPU_VTAB
/begin COMPU_METHOD _CNV_S_9_STATE_AMT__93_CM "" TAB_VERB "%6.3" "[-]" COMPU_TAB_REF _CNV_S_9_STATE_AMT__93 /end COMPU_METHOD
/begin COMPU_VTAB _CNV_S_9_STATE_AMT__93 "" TAB_VERB 9 0 "MIL_OFF" 2 "MIL_OFF" 4 "MIL_ON" 6 "MIL_ON" 8 "MIL_FLL" 10 "MIL_FLL" 12 "IDLE" 14 "INI_VALUE" 15 "INVALID_SIGNAL" /end COMPU_VTAB
/begin COMPU_METHOD _CNV_A_R_LINEAR_____94_CM "" RAT_FUNC "%6.3" "%" COEFFS 0 655.3600000071681 0. 0 0 1 /end COMPU_METHOD
/begin COMPU_METHOD _CNV_A_R_LINEAR_____95_CM "" RAT_FUNC "%6.3" "mg/stk" COEFFS 0 47.18142548596112 0. 0 0 1 /end COMPU_METHOD
/begin COMPU_METHOD _CNV_A_R_LINEAR_____97_CM "" RAT_FUNC "%6.3" "hPa" COEFFS 0 12.06017666543982 -1.759293338545831e-002 0 0 1 /end COMPU_METHOD
/begin COMPU_METHOD _CNV_A_R_LINEAR_____98_CM "" RAT_FUNC "%6.3" "%" COEFFS 0 655.3600000071681 3.584063961170614e-007 0 0 1 /end COMPU_METHOD
/begin COMPU_METHOD _CNV_A_R_LINEAR_____101_CM "" RAT_FUNC "%6.3" "kg/h" COEFFS 0 32. 0. 0 0 1 /end COMPU_METHOD
/begin COMPU_METHOD _CNV_A_R_LINEAR_____103_CM "" RAT_FUNC "%6.3" "-" COEFFS 0 128. 0. 0 0 1 /end COMPU_METHOD
/begin COMPU_METHOD _CNV_A_R_LINEAR_____155_CM "" RAT_FUNC "%6.3" "h" COEFFS 0 35999.99999497086 0. 0 0 1 /end COMPU_METHOD
/begin COMPU_METHOD _CNV_A_R_LINEAR_____158_CM "" RAT_FUNC "%6.3" "-" COEFFS 0 32767.98303949118 0. 0 0 1 /end COMPU_METHOD
/begin COMPU_METHOD _CNV_A_R_LINEAR_____170_CM "" RAT_FUNC "%6.3" "-" COEFFS 0 7379.793318491542 0. 0 0 1 /end COMPU_METHOD
/begin COMPU_METHOD _CNV_A_R_LINEAR_____171_CM "" RAT_FUNC "%6.3" "cm²" COEFFS 0 1118.481084425738 0. 0 0 1 /end COMPU_METHOD
/begin COMPU_METHOD _CNV_A_R_LINEAR_____177_CM "" RAT_FUNC "%6.3" "V" COEFFS 0 204.7999995887937 0. 0 0 1 /end COMPU_METHOD
/begin COMPU_METHOD _CNV_A_R_LINEAR_____190_CM "" RAT_FUNC "%6.3" "hPa" COEFFS 0 0.3768805207949945 0. 0 0 1 /end COMPU_METHOD
/begin COMPU_METHOD _CNV_A_R_LINEAR_____208_CM "" RAT_FUNC "%6.3" "ms" COEFFS 0 250. 0. 0 0 1 /end COMPU_METHOD
/begin COMPU_METHOD _CNV_A_R_LINEAR_____211_CM "" RAT_FUNC "%6.3" "°C" COEFFS 0 16. 0. 0 0 1 /end COMPU_METHOD
/begin COMPU_METHOD _CNV_A_R_LINEAR_____213_CM "" RAT_FUNC "%6.3" "rpm" COEFFS 0 1. 32768. 0 0 1 /end COMPU_METHOD
/begin COMPU_METHOD _CNV_A_R_LINEAR_____218_CM "" RAT_FUNC "%6.3" "Nm" COEFFS 0 32. 32768. 0 0 1 /end COMPU_METHOD
/begin COMPU_METHOD _CNV_A_R_LINEAR_____226_CM "" RAT_FUNC "%6.3" "°TPS" COEFFS 0 137.0962343096234 0. 0 0 1 /end COMPU_METHOD
/begin COMPU_METHOD _CNV_A_R_LINEAR_____232_CM "" RAT_FUNC "%6.3" "°CRK" COEFFS 0 42.66666666666666 0. 0 0 1 /end COMPU_METHOD
/begin COMPU_METHOD _CNV_A_R_LINEAR_____240_CM "" RAT_FUNC "%6.3" "-" COEFFS 0 32. 0. 0 0 1 /end COMPU_METHOD
/begin COMPU_METHOD _CNV_A_R_LINEAR_____253_CM "" RAT_FUNC "%6.3" "-" COEFFS 0 255.9999357490357 0. 0 0 1 /end COMPU_METHOD
/begin COMPU_METHOD _CNV_A_R_LINEAR_____261_CM "" RAT_FUNC "%6.3" "mg/stk" COEFFS 0 47.18214541280769 -1.080506262951531e-005 0 0 1 /end COMPU_METHOD
/begin COMPU_METHOD _CNV_A_R_LINEAR_____290_CM "" RAT_FUNC "%6.3" "kg/h" COEFFS 0 128.0000018750286 0. 0 0 1 /end COMPU_METHOD
/begin COMPU_METHOD _CNV_A_R_LINEAR_____331_CM "" RAT_FUNC "%6.3" "hPa/ms" COEFFS 0 395.1938017499002 -7.983716819580877e-003 0 0 1 /end COMPU_METHOD
/begin COMPU_METHOD _CNV_A_R_LINEAR_____332_CM "" RAT_FUNC "%6.3" "s/m" COEFFS 0 3181017.284813537 0. 0 0 1 /end COMPU_METHOD
/begin COMPU_METHOD _CNV_A_R_LINEAR_____333_CM "" RAT_FUNC "%6.3" "1/(s^2*m)" COEFFS 0 5.615152789530994e-004 0. 0 0 1 /end COMPU_METHOD
/begin COMPU_METHOD _CNV_A_R_LINEAR_____334_CM "" RAT_FUNC "%6.3" "J/(kg K)" COEFFS 0 0.89198606271777 0. 0 0 1 /end COMPU_METHOD
/begin COMPU_METHOD _CNV_A_R_LINEAR_____335_CM "" RAT_FUNC "%6.3" "dm^3" COEFFS 0 271.1050690753992 -1.110223024625157e-015 0 0 1 /end COMPU_METHOD
/begin COMPU_METHOD _CNV_A_R_LINEAR_____336_CM "" RAT_FUNC "%6.3" "mg/stk" COEFFS 0 47.18070554355651 0. 0 0 1 /end COMPU_METHOD
/begin COMPU_METHOD _CNV_A_R_LINEAR_____337_CM "" RAT_FUNC "%6.3" "hPa" COEFFS 0 96.48288560192751 2.255463186884299e-005 0 0 1 /end COMPU_METHOD
/begin COMPU_METHOD _CNV_A_R_LINEAR_____338_CM "" RAT_FUNC "%6.3" "Pa/kg" COEFFS 0 8.985089974293059e-003 0. 0 0 1 /end COMPU_METHOD
/begin COMPU_METHOD _CNV_A_R_LINEAR_____339_CM "" RAT_FUNC "%6.3" "hPa" COEFFS 0 1541.2906436473 0. 0 0 1 /end COMPU_METHOD
/begin COMPU_METHOD _CNV_A_R_LINEAR_____340_CM "" RAT_FUNC "%6.3" "hPa/ms" COEFFS 0 395.1818376757466 0. 0 0 1 /end COMPU_METHOD
/begin COMPU_METHOD _CNV_A_R_LINEAR_____341_CM "" RAT_FUNC "%6.3" "1/s" COEFFS 0 1073.741857908145 0. 0 0 1 /end COMPU_METHOD
/begin COMPU_METHOD _CNV_A_R_LINEAR_____342_CM "" RAT_FUNC "%6.3" "cm²" COEFFS 0 1118.481075453891 2.574382087914273e-004 0 0 1 /end COMPU_METHOD
/begin COMPU_METHOD _CNV_A_R_LINEAR_____343_CM "" RAT_FUNC "%6.3" "%/kg" COEFFS 0 0.3817721076546662 0. 0 0 1 /end COMPU_METHOD
/begin COMPU_METHOD _CNV_A_R_LINEAR_____344_CM "" RAT_FUNC "%6.3" "%/(hPa*s)" COEFFS 0 29173.86349472035 0. 0 0 1 /end COMPU_METHOD
/begin COMPU_METHOD _CNV_A_R_LINEAR_____345_CM "" RAT_FUNC "%6.3" "%/hPa" COEFFS 0 111291.3086302347 0. 0 0 1 /end COMPU_METHOD
/begin COMPU_METHOD _CNV_A_R_LINEAR_____346_CM "" RAT_FUNC "%6.3" "ms" COEFFS 0 1000. 0. 0 0 1 /end COMPU_METHOD
/begin COMPU_METHOD _CNV_A_R_LINEAR_____347_CM "" RAT_FUNC "%6.3" "(%*h)/kg" COEFFS 0 5242.590296388145 0. 0 0 1 /end COMPU_METHOD
/begin COMPU_METHOD _CNV_A_R_LINEAR_____348_CM "" RAT_FUNC "%6.3" "-" COEFFS 0 8191.999999679995 0. 0 0 1 /end COMPU_METHOD
/begin COMPU_METHOD _CNV_A_R_LINEAR_____349_CM "" RAT_FUNC "%6.3" "kg/(h*hPa)" COEFFS 0 5434.241818163727 32767.99999915545 0 0 1 /end COMPU_METHOD
/begin COMPU_METHOD _CNV_A_R_LINEAR_____350_CM "" RAT_FUNC "%6.3" "°CRK" COEFFS 0 42.66666666666666 32768. 0 0 1 /end COMPU_METHOD
/begin COMPU_METHOD _CNV_A_R_LINEAR_____351_CM "" RAT_FUNC "%6.3" "kg/(h*hPa)" COEFFS 0 5434.241818163727 0. 0 0 1 /end COMPU_METHOD
/begin COMPU_METHOD _CNV_A_R_LINEAR_____358_CM "" RAT_FUNC "%6.3" "V" COEFFS 0 204.8 0. 0 0 1 /end COMPU_METHOD
/begin COMPU_METHOD _CNV_A_R_LINEAR_____369_CM "" RAT_FUNC "%6.3" "1/min/s" COEFFS 0 3.125e-002 0. 0 0 1 /end COMPU_METHOD
/begin COMPU_METHOD _CNV_A_R_LINEAR_____386_CM "" RAT_FUNC "%6.3" "°C/s" COEFFS 0 1. 0. 0 0 1 /end COMPU_METHOD
/begin COMPU_METHOD _CNV_A_R_LINEAR_____389_CM "" RAT_FUNC "%6.3" "%/V" COEFFS 0 3.2 0. 0 0 1 /end COMPU_METHOD
/begin COMPU_METHOD _CNV_A_R_LINEAR_____390_CM "" RAT_FUNC "%6.3" "%/s" COEFFS 0 0.1024000154202376 128.000019275297 0 0 1 /end COMPU_METHOD
/begin COMPU_METHOD _CNV_A_R_LINEAR_____391_CM "" RAT_FUNC "%6.3" "-" COEFFS 0 32768.00003968061 3.96806062781252e-005 0 0 1 /end COMPU_METHOD
/begin COMPU_METHOD _CNV_A_R_LINEAR_____392_CM "" RAT_FUNC "%6.3" "-" COEFFS 0 32768.00003968061 32768.00003968061 0 0 1 /end COMPU_METHOD
/begin COMPU_METHOD _CNV_A_R_LINEAR_____409_CM "" RAT_FUNC "%6.3" "°C/10s" COEFFS 0 1.333333333333333 0. 0 0 1 /end COMPU_METHOD
/begin COMPU_METHOD _CNV_A_R_LINEAR_____410_CM "" RAT_FUNC "%6.3" "°C" COEFFS 0 64. 0. 0 0 1 /end COMPU_METHOD
/begin COMPU_METHOD _CNV_A_R_LINEAR_____436_CM "" RAT_FUNC "%6.3" "°C/500ms" COEFFS 0 1.333333333333333 0. 0 0 1 /end COMPU_METHOD
/begin COMPU_METHOD _CNV_A_R_LINEAR_____437_CM "" RAT_FUNC "%6.3" "V" COEFFS 0 51.2 0. 0 0 1 /end COMPU_METHOD
/begin COMPU_METHOD _CNV_A_R_LINEAR_____473_CM "" RAT_FUNC "%6.3" "ms" COEFFS 0 125. 0. 0 0 1 /end COMPU_METHOD
/begin COMPU_METHOD _CNV_A_R_LINEAR_____474_CM "" RAT_FUNC "%6.3" "(km/h)/10ms" COEFFS 0 128. 0. 0 0 1 /end COMPU_METHOD
/begin COMPU_METHOD _CNV_A_R_LINEAR_____475_CM "" RAT_FUNC "%6.3" "m" COEFFS 0 57600021.97266463 0. 0 0 1 /end COMPU_METHOD
/begin COMPU_METHOD _CNV_R_R_i_vvt_ub_q_476_CM "" RAT_FUNC "%6.3" "A" COEFFS 0. 1. 63.5 0. 0. 0.5 /end COMPU_METHOD
/begin COMPU_METHOD _CNV_R_R_temp_uw_q0_481_CM "" RAT_FUNC "%6.3" "[-]" COEFFS 0. 1. 48. 0. 0. 0.75 /end COMPU_METHOD
/begin COMPU_METHOD _CNV_R_R_rel_ub_b10_501_CM "" RAT_FUNC "%6.3" "%" COEFFS 0. 255. 0. 0. 0. 100. /end COMPU_METHOD
/begin COMPU_METHOD _CNV_R_R_temp_q1_535_CM "" RAT_FUNC "%6.3" "°C" COEFFS 0. 1. 0. 0. 0. 1. /end COMPU_METHOD
/begin COMPU_METHOD _CNV_A_R_LINEAR_____567_CM "" RAT_FUNC "%6.3" "°C" COEFFS 0 0.2 10. 0 0 1 /end COMPU_METHOD
/begin COMPU_METHOD _CNV_A_R_LINEAR_____568_CM "" RAT_FUNC "%6.3" "kg" COEFFS 0 10.98635968049081 0. 0 0 1 /end COMPU_METHOD
/begin COMPU_METHOD _CNV_A_R_nmot_ub_q4_569_CM "" RAT_FUNC "%6.3" "rpm" COEFFS 0 2.5e-002 0. 0 0 1 /end COMPU_METHOD
/begin COMPU_METHOD _CNV_A_R_rel_ub_q0p_570_CM "" RAT_FUNC "%6.3" "%" COEFFS 0 1.333333333333333 0. 0 0 1 /end COMPU_METHOD
/begin COMPU_METHOD _CNV_R_R_nmot_ub_q1_571_CM "" RAT_FUNC "%6.3" "rpm" COEFFS 0. 1. 0. 0. 0. 10. /end COMPU_METHOD
/begin COMPU_METHOD _CNV_R_R_md_ub_q16_572_CM "" RAT_FUNC "%6.3" "Nm" COEFFS 0. 1. 0. 0. 0. 16. /end COMPU_METHOD
/begin COMPU_METHOD _CNV_A_R_LINEAR_____578_CM "" RAT_FUNC "%6.3" "V" COEFFS 0 204.7999998958713 8.135057072422569e-009 0 0 1 /end COMPU_METHOD
/begin COMPU_METHOD _CNV_S_4_RANGE_STAT_579_CM "" TAB_VERB "%6.3" "[-]" COMPU_TAB_REF _CNV_S_4_RANGE_STAT_579 /end COMPU_METHOD
/begin COMPU_VTAB _CNV_S_4_RANGE_STAT_579 "" TAB_VERB 4 0 "CC open" 1 "CC controlled" 2 "CC closed" 3 "not defined" /end COMPU_VTAB
/begin COMPU_METHOD _CNV_A_R_LINEAR_____580_CM "" RAT_FUNC "%6.3" "°STW" COEFFS 0 22.8564453125 -3.637978807091713e-012 0 0 1 /end COMPU_METHOD
/begin COMPU_METHOD _CNV_A_R_LINEAR_____582_CM "" RAT_FUNC "%6.3" "°CRK" COEFFS 0 2.666666666666667 -466.6666666666666 0 0 1 /end COMPU_METHOD
/begin COMPU_METHOD _CNV_S_6_RANGE_ECU__584_CM "" TAB_VERB "%6.3" "[-]" COMPU_TAB_REF _CNV_S_6_RANGE_ECU__584 /end COMPU_METHOD
/begin COMPU_VTAB _CNV_S_6_RANGE_ECU__584 "" TAB_VERB 6 0 "ENG_STOP" 1 "RUN_ENG" 2 "SYN_ENG_IGK_ON" 3 "SYN_ENG_IGK_OFF" 4 "PWL" 5 "ENG_LOCK" /end COMPU_VTAB
/begin RECORD_LAYOUT _REC_VAL_20_u1 FNC_VALUES 1 UBYTE COLUMN_DIR DIRECT /end RECORD_LAYOUT
/begin RECORD_LAYOUT _REC_AXS_20_u1 NO_AXIS_PTS_X 1 UBYTE AXIS_PTS_X 2 UBYTE INDEX_INCR DIRECT /end RECORD_LAYOUT
/begin RECORD_LAYOUT _REC_CUR_20_u1_u1 FNC_VALUES 1 UBYTE COLUMN_DIR DIRECT /end RECORD_LAYOUT
/begin RECORD_LAYOUT _REC_MAP_20_u2_u2_u1 FNC_VALUES 1 UWORD COLUMN_DIR DIRECT /end RECORD_LAYOUT
/begin RECORD_LAYOUT _REC_AXS_20_u2 NO_AXIS_PTS_X 1 UWORD AXIS_PTS_X 2 UWORD INDEX_INCR DIRECT /end RECORD_LAYOUT
/begin RECORD_LAYOUT _REC_CUR_20_u2_u2 FNC_VALUES 1 UWORD COLUMN_DIR DIRECT /end RECORD_LAYOUT
/begin RECORD_LAYOUT _REC_VAL_20_u2 FNC_VALUES 1 UWORD COLUMN_DIR DIRECT /end RECORD_LAYOUT
/begin RECORD_LAYOUT _REC_CUR_20_u2_u1 FNC_VALUES 1 UWORD COLUMN_DIR DIRECT /end RECORD_LAYOUT
/begin RECORD_LAYOUT _REC_MAP_20_u1_u1_u2 FNC_VALUES 1 UBYTE COLUMN_DIR DIRECT /end RECORD_LAYOUT
/begin RECORD_LAYOUT _REC_CUR_20_u1_u2 FNC_VALUES 1 UBYTE COLUMN_DIR DIRECT /end RECORD_LAYOUT
/begin RECORD_LAYOUT _REC_MAP_20_u2_u1_u1 FNC_VALUES 1 UWORD COLUMN_DIR DIRECT /end RECORD_LAYOUT
/begin RECORD_LAYOUT _REC_VAL_20_u4 FNC_VALUES 1 ULONG COLUMN_DIR DIRECT /end RECORD_LAYOUT
/begin RECORD_LAYOUT _REC_MAP_20_u2_u1_u2 FNC_VALUES 1 UWORD COLUMN_DIR DIRECT /end RECORD_LAYOUT
/begin RECORD_LAYOUT _REC_VAL_20_s2 FNC_VALUES 1 SWORD COLUMN_DIR DIRECT /end RECORD_LAYOUT
/begin RECORD_LAYOUT _REC_MAP_20_u2_u2_u2 FNC_VALUES 1 UWORD COLUMN_DIR DIRECT /end RECORD_LAYOUT
/begin FUNCTION SYS_Mass_airflow_variables "_Mass airflow variables"
 /begin DEF_CHARACTERISTIC C_MAF_MMV_DIF_CRLC IP_PQ_SP_PULS C_MAF_MMV_HYS C_PQ_SP_HYS_PULS /end DEF_CHARACTERISTIC
 /begin OUT_MEASUREMENT MAF_KGH_MES_BAS MAF_MES MAF_KGH_MES MAF_KGH MAF_DIF MAF_MMV LV_MAF_PULS /end OUT_MEASUREMENT
/end FUNCTION
/begin FUNCTION SYS_Intake_manifold_model "_Intake manifold model"
 /begin DEF_CHARACTERISTIC IP_MAF_MDL_CON_1__TIA IP_MAF_EGR_CON_1__TEG_EGR IP_PRED_FAC__N ID_MAF_FAC_OFS__PQ_ESTIM ID_MAF_FAC_SLOP__PQ_ESTIM C_PQ_THD C_PQ_THD_HYS ID_MAF_ISA_FAC_SLOP ID_MAF_ISA_FAC_OFS C_RA IP_VOL_IM_NEG IP_VOL_IM_IS IP_VOL_IM IP_VOL_IM_IS_NEG /end DEF_CHARACTERISTIC
 /begin OUT_MEASUREMENT MAF_CYL_STK MAF_KGH_CLC MAP_EGR MAP_EGR_PRED MAP_FG_PRED MAP_PRED MAP_FG PQ PQ_EGR PQ_EGR_ESTIM MAF_THR MAF_EGR MAP_DRV1 MAP_EGR_DRV1 MAF_EGR_CON_1 MAF_FAC_OFS MAF_FAC_OFS_EGR MAF_FAC_SLOP MAF_CYL MAF_FG_CYL MAF_FG_CYL_STK FAC_MAF_MAX MAF_FAC_SLOP_EGR MAF_MDL_CON_1 MAF_MDL_CON_0 MAP MAF_ISA_FAC_OFS MAF_ISA_FAC_SLOP MAF_THR_ISA_TOT MAF_ISA EGR_RATIO LV_H_LOAD_MAF_THR PQ_ESTIM MAP_ESTIM MAF VOL_IM /end OUT_MEASUREMENT
/end FUNCTION
/begin FUNCTION SYS_Pressure_decrease_in_the_air "_Pressure decrease in the air filter" /begin DEF_CHARACTERISTIC IP_AMP_DEC__MAF_CYL LC_AMP_INP_ENA /end DEF_CHARACTERISTIC /begin OUT_MEASUREMENT PRS_UP_THR PRS_UP_THR_MAX /end OUT_MEASUREMENT /end FUNCTION
/begin FUNCTION SYS_Volumetric_efficiency "_Volumetric efficiency"
 /begin DEF_CHARACTERISTIC IP_T_VIM_EFF_VOL IP_EFF_VOL_SLOP_CAM_IN_VIM IP_EFF_VOL_SLOP_CAM_VO_VIM IP_EFF_VOL_OFS_VIM IP_EFF_VOL_OFS IP_EFF_VOL_OFS_AMP C_TCYL_STND C_TCO_STND C_TIA_IM_STND IP_EFF_VOL_SLOP_CAM_VO IP_EFF_VOL_SLOP_CAM_IN IP_CRLC_EFF_VOL_TEMP_COR IP_EFF_TCO_FAC__N_32__MAF IP_EFF_TIA_IM_FAC__N_32__MAF IP_EFF_VOL_SLOP_AMP IP_EFF_VOL_OFS_MAX IP_EFF_VOL_SLOP_MAX /end DEF_CHARACTERISTIC
 /begin OUT_MEASUREMENT EXC_AV_REL EFF_VOL_SLOP EFF_VOL_TEMP_COR EFF_VOL_TEMP_COR_MMV EFF_VOL_OFS_MAX_COR EFF_VOL_OFS EFF_VOL_SLOP_MAX_COR EFF_VOL_OFS_BAS EFF_VOL_SLOP_BAS EFF_VOL_OFS_BAS_GOAL EFF_VOL_SLOP_BAS_GOAL EFF_VOL_OFS_BAS_0 EFF_VOL_SLOP_BAS_0 EFF_VOL_OFS_BAS_1 EFF_VOL_SLOP_BAS_1 /end OUT_MEASUREMENT
/end FUNCTION
/begin FUNCTION SYS_Vehicle_speed_variables "_Vehicle speed variables" /begin DEF_CHARACTERISTIC C_VS_MIN_RUN C_T_VST C_VS_EDGE_SUM_MIN C_VS_FAC /end DEF_CHARACTERISTIC
 /begin OUT_MEASUREMENT VS_EDGE_CTR_AV VS_EDGE_T_AV LV_VS_RUN VS_SENS VS_SENS_GRD LV_VST VS /end OUT_MEASUREMENT
/end FUNCTION
/begin FUNCTION SYS_Battery_voltage "_Battery voltage"
 /begin DEF_CHARACTERISTIC C_CRLC_VB C_VB_MIN_JUMP C_VB_MIN_OBD2 C_VB_MIN_CAN_DIAG C_VB_MAX_OBD1 C_VB_MIN_OBD1 C_VB_MAX_OBD2 C_T_MIN_CAN_DIAG C_VB_MIN_DIAG C_VB_MIN_BN_DIAG /end DEF_CHARACTERISTIC
 /begin OUT_MEASUREMENT LV_VB_JUMP VB_MMV LV_CDN_VB_OBD1 LV_CDN_VB_OBD2 LV_IGK VB VB_SECU V_IGK LV_CDN_VB_MIN_DIAG LV_CDN_VB_CAN_DIAG LV_CDN_VB_BN_DIAG /end OUT_MEASUREMENT
/end FUNCTION
/begin FUNCTION SYS_Coolant_temperature "_Coolant temperature"
 /begin DEF_CHARACTERISTIC C_T_TCO_SUB_IS_1 C_T_TCO_SUB_IS_2 C_T_TCO_SUB_PUC C_TCO_SUB_BOL_2 C_TCO_SUB_TOL C_TIA_DIAG IP_TCO_SUB_INC__MAF_KGH C_TCO_SUB_BOL_1 C_TCO_EX_DIF_DIAG IP_TCO__V_TCO /end DEF_CHARACTERISTIC
 /begin OUT_MEASUREMENT TCO_SUB TCO_STOP TCO TCO_MES TCO_ST TCO_EX_ST TCO_EX TCO_EX_MES /end OUT_MEASUREMENT
/end FUNCTION
/begin FUNCTION SYS_Air_temperature "_Air temperature" /begin DEF_CHARACTERISTIC C_TIA_GRD_MAX_DIAG IP_TIA__V_TIA /end DEF_CHARACTERISTIC /begin OUT_MEASUREMENT TIA TIA_MES /end OUT_MEASUREMENT /end FUNCTION
/begin FUNCTION SYS_Exhaust_temperature_variable "_Exhaust temperature variables" /begin DEF_CHARACTERISTIC IP_TEG__V_TEG /end DEF_CHARACTERISTIC
 /begin OUT_MEASUREMENT TEG_PCAT_DOWN_1 TEG_PCAT_DOWN_2 TEG_PCAT_DOWN_RAW_2 TEG_PCAT_DOWN_RAW_1 /end OUT_MEASUREMENT
/end FUNCTION
/begin FUNCTION SYS_Determination_of_accelerator "_Determination of accelerator pedal value"
 /begin DEF_CHARACTERISTIC C_PV_GRD_LIH_MAX C_V_PVS_HYS_FIL C_PVS_SLOP_1 C_PVS_SLOP_2 C_V_PVS_OFS_1 C_V_PVS_OFS_2 C_PV_AV_BLS_NOT_PLAUS_LGRD C_PV_AV_BLS_NOT_PLAUS_HYS C_PV_AV_BLS_NOT_PLAUS IP_PV_LIH_MAX IP_FAC_PV_BAS_COR_MT IP_FAC_PV_BAS_COR_AT IP_FAC_PV_BAS_COR_AMT IP_FAC_PV_CS_COR_AMT IP_FAC_PV_CS_COR_MT IP_FAC_PV_GS_COR_AMT IP_FAC_PV_GS_COR_MT IP_FAC_VS_PV_GS_COR_AMT IP_FAC_VS_PV_GS_COR_MT IP_FAC_VS_PV_BAS_COR_MT IP_FAC_VS_PV_BAS_COR_AT IP_FAC_VS_PV_BAS_COR_AMT C_ADD_FAC_PV_BAS_MT C_ADD_FAC_PV_BAS_AT C_ADD_FAC_PV_BAS_AMT C_T_FAC_PV_GS C_T_FAC_PV_CS C_VS_MAX_FAC_PV_COR C_V_PVS_THD_KD_HYS C_V_PVS_THD_KD IP_PV_CRU_RNG_L IP_PV_CRU /end DEF_CHARACTERISTIC
 /begin OUT_MEASUREMENT V_PVS_FIL_1 V_PVS_FIL_2 LV_KD PV_AV PV_AV_2 PV_MAX PV_AV_GRD PV_AV_1 FAC_PV_CS_COR FAC_PV_GS_COR FAC_PV_BAS_COR FAC_PV_COR PV_AV_RAW PV_CRU /end OUT_MEASUREMENT
/end FUNCTION
/begin FUNCTION SYS_IVVT_Variables "_IVVT Variables"
 /begin DEF_CHARACTERISTIC IP_FAC_IVVT__VO C_CAM_OP_EX C_CAM_OP_IN C_CAM_ADJ_RNG_MAX_IN C_CAM_ADJ_RNG_MAX_EX /end DEF_CHARACTERISTIC
 /begin OUT_MEASUREMENT VO_MIN VO_MAX CAM_AV_MV_IN MAF_IVVT VO FAC_IVVT VO_2 VO_1 VO_SP VO_SP_REF /end OUT_MEASUREMENT
/end FUNCTION
/begin FUNCTION SYS_Gear_ratio_detection "_Gear ratio detection" /begin DEF_CHARACTERISTIC ID_GR_MT C_MIN_VS_RATIO LC_RNG_L /end DEF_CHARACTERISTIC
 /begin OUT_MEASUREMENT N_VS_RATIO LV_DRI GR_AT GR_MT GEAR_EF LV_RNG_L STATE_GEAR_REV_AT /end OUT_MEASUREMENT
/end FUNCTION
/begin FUNCTION SYS_Drive_train_engaged "_Drive train engaged" /begin DEF_CHARACTERISTIC C_VS_MIN_DT /end DEF_CHARACTERISTIC /begin OUT_MEASUREMENT LV_DT VLS_UP_1 VLS_UP_2 /end OUT_MEASUREMENT /end FUNCTION
/begin FUNCTION SYS_Clutch_switch_detection "_Clutch switch detection" /begin OUT_MEASUREMENT LV_CS /end OUT_MEASUREMENT /end FUNCTION
/begin FUNCTION SYS_Input_messages "_Input messages"
 /begin DEF_CHARACTERISTIC C_TEMP_GB_SUB C_T_CTR_SWI_OFF_VB_MIN C_V_SP_GEN C_TQ_ACCIN C_CTR_KM_SUB C_EXC_INI C_STATE_VVL C_STATE_VVL_AD C_TQ_STND LC_TAM_MAN_AS C_TAM_MAN_AS IP_TQ_LOSS_ACC_INP /end DEF_CHARACTERISTIC
 /begin OUT_MEASUREMENT LV_ERR_BN_MSW GEAR TQ_LOSS_ARS_AV_CAN TQ_LOSS_ARS_SP_CAN VEH_KEY_NR STATE_ARS_CAN STATE_IGK_CAN LV_TCS_LIH_CAN STATE_TCS_INTV STATE_WAL_CAN T_CTR_REL_CAN V_SP_GEN T_CAN STATE_TCS_CTL STATE_TCS_DECE AC_VEH_LGT_TCS AC_VEH_TRV_TCS STATE_MOD_GB STATE_TCS_CAN STATE_TEMP_GB TEMP_GB VS_ICL_DISP LV_DCC_LIH_CAN LV_DCC_PUC_INH TQ_DCC_SLOW_BN TQ_DCC_FAST_BN STATE_ETCU_INTV STATE_DCC_INTV STATE_DCC_PUC_INH STATE_DCC_OFF_REQ STATE_DCC LV_DCC_OFF_ACK LV_ERR_TQ_LOSS_ARS_AV_CAN LV_ERR_TQ_LOSS_ARS_SP_CAN LV_RLY_ST_CAN LV_KEY_AUX TCC_CAN_CAS TQ_TCS_FAST_BN TCC_CAN_TQ_DCC TQ_TCS_SLOW_BN TQ_GS_SLOW_BN TCC_CAN_TQ_TCS LV_TQ_DCC_INC_REQ TQ_GS_FAST_BN TQ_AMT_FAST_BN TQ_AMT_SLOW_BN TCC_CAN_TQ_ETCU STATE_ETCU_OBD_ERR STATE_AMT_INTV STATE_ACIN_CAN CTR_KM_BN TCC_CAN_TQ_AMT T_CTR_SWI_OFF_VB ctrgenms n_idlms TCC_CAN_ICL TCC_CAN_MSW STATE_BN_MSW LV_ERR_ANG_PSTE_CAN TCC_CAN_ARS LV_ETCU_LIH_CAN LV_AMT_LIH_CAN STATE_ST_TQ_LIM_GS STATE_ST_TQ_LIM_AMT LV_VAR_ETCU LV_VAR_BN_MSW LV_VAR_DCC LV_VAR_ARS LV_VAR_VEH STATE_VEH_MOD STATE_VS_ICL_DISP TCC_CAN_VEH_MOD STATE_IF_ICL_BN_MSW CTR_DIAG_TCC_CAN_CAS CTR_DIAG_TCC_CAN_TQ_TCS CTR_DIAG_TCC_CAN_TQ_ETCU CTR_DIAG_TCC_CAN_TQ_AMT CTR_DIAG_TCC_CAN_ICL CTR_DIAG_TCC_CAN_ARS CTR_DIAG_TCC_CAN_MSW CTR_DIAG_TCC_CAN_TQ_DCC CTR_DIAG_CKS_CAS CTR_DIAG_CKS_TQ_TCS CTR_DIAG_CKS_TQ_ETCU CTR_DIAG_CKS_TQ_AMT CTR_DIAG_CKS_MSW CTR_DIAG_CKS_TQ_DCC CTR_DIAG_TOUT_ARS CTR_DIAG_TOUT_CAS CTR_DIAG_TOUT_TQ_TCS CTR_DIAG_TOUT_VS_TCS CTR_DIAG_TOUT_TCS CTR_DIAG_TOUT_TQ_ETCU CTR_DIAG_TOUT_ETCU CTR_DIAG_TOUT_TQ_AMT CTR_DIAG_TOUT_TQ_DCC CTR_DIAG_TOUT_ACC CTR_DIAG_TOUT_KM_ICL CTR_DIAG_TOUT_ICL CTR_DIAG_TOUT_POW_VB CTR_DIAG_TOUT_POW_GEN CTR_DIAG_TOUT_MSW CTR_DIAG_TOUT_T_ICL CTR_DIAG_TOUT_ANG_PSTE CTR_DIAG_TCC_CAN_VEH_MOD CTR_DIAG_CKS_VEH_MOD CTR_DIAG_TOUT_VEH_MOD TQI_MSR_CAN VS_CAN WHEEL LV_PLAUS_ASR_CTL LV_PLAUS_ESP_CTL TQI_ASR_FAST_CAN LV_ERR_VS_CAN TQI_ASR_FAST_REQ_CAN TQI_MSR_REQ_CAN TQI_ASR_SLOW_CAN TQI_ASR_SLOW_REQ_CAN GEAR_SEL_DISP TQI_GS_REQ_CAN TQ_GEAR_CAN TQI_GS_REQ LV_TQ_GS_INC_REQ LV_TQ_GS_DEC_REQ TQ_ACCIN_CAN STATE_EFP_CRASH_CAN LV_REQ_HEAT LV_LTG_SWI_CAN LV_TAM_CAN_ERR STATE_GEAR_REV_CAN FTL LV_FTL_CAN_ERR VEL_ANG_PSTE STATE_SENS_ANG_PSTE LV_VAR_PSTE LV_CITY TQI_SLOW_AMT_REQ_CAN TQI_AMT_REQ TQI_SLOW_AMT_REQ TQI_AMT_REQ_CAN TQI_AMT_CPL_CAN TCC_CAN_AMT_1 STATE_AMT_OBD_ERR STATE_AMT STATE_CLU_AMT LV_TQ_AMT_DEC_REQ LV_TQ_AMT_INC_REQ N_MAX_AMT_CAN LV_AMT_ES LV_GS LV_GP STATE_AMT_OBD LV_PUMP_AMT_ON LV_VAR_AMT STATE_TXU_CR STATE_TXU_TR STATE_TXU_ERR STATE_TXU STATE_TXU_MT TXU_WAL TXU_DISP_COGS_SUM TXU_DISP_RNG_SUM TXU_DISP_GEAR_SUM TQI_TXU LV_ERR_BN_CAS LV_ERR_BN_ACC LV_ERR_BN_T_ICL LV_ERR_BN_KM_ICL LV_ERR_BN_ICL LV_ERR_BN_POW_VB LV_ERR_BN_POW_GEN LV_ERR_BN_VEH_MOD LV_ERR_BN_TQ_ETCU LV_ERR_BN_ETCU LV_ERR_BN_TQ_AMT LV_ERR_BN_ARS LV_ERR_BN_TQ_DCC LV_ERR_BN_TQ_TCS LV_ERR_BN_VS_TCS LV_ERR_BN_TCS LV_ERR_BN_ANG_PSTE LV_VAR_BN LV_WAKE_UP DIST TQ_LOSS_ACC_INP N_ECF LV_REQ_TCO_L GEAR_INFO LV_ACCIN CTR_KM_CAN T_REL_CAN TAM TQ_CONV_CAN STATE_CC ANG_PSTE LV_ACIN LV_FTL_LE_CAN_ERR LV_FTL_RI_CAN_ERR LV_FTL_OBD_INH_L FTL_RI FTL_LE LV_TQ_ASR_REQ LV_TQ_MSR_REQ STATE_ETCU_OBD /end OUT_MEASUREMENT
/end FUNCTION
/begin FUNCTION SYS_Oil_temperature "_Oil temperature" /begin DEF_CHARACTERISTIC C_TOIL_GRD_MAX_DIAG IP_TOIL /end DEF_CHARACTERISTIC /begin OUT_MEASUREMENT TOIL_STOP TOIL TOIL_MES /end OUT_MEASUREMENT /end FUNCTION
/begin FUNCTION SYS_Ambient_pressure_variables "_Ambient pressure variables"
 /begin DEF_CHARACTERISTIC C_AMP_HYS IP_AMP_RAW_COR__VS C_AMP_CRLC C_FAC_AMP_MIN C_FAC_AMP_MAX IP_AMP_RAW_2 IP_AMP_RAW_1 /end DEF_CHARACTERISTIC
 /begin OUT_MEASUREMENT AMP_MES FAC_AMP /end OUT_MEASUREMENT
/end FUNCTION
/begin FUNCTION SYS_System_variables_in_the_exha "_System variables in the exhaust pipe"
 /begin DEF_CHARACTERISTIC IP_AR_RED_EGR__N_32__STK_AV_EGR IP_PRS_EX_INC IP_TEG_EGR__MAF_CYL /end DEF_CHARACTERISTIC
 /begin OUT_MEASUREMENT PRS_EX PRS_EX_INC TEG_EGR AR_RED_EGR /end OUT_MEASUREMENT
/end FUNCTION
/begin FUNCTION SYS_Reduced_area_controller "_Reduced area controller"
 /begin DEF_CHARACTERISTIC C_AR_RED_AD_ADD_MIN C_AR_RED_AD_FAC_MAX C_AR_RED_AD_FAC_MIN C_AR_RED_DIF_I_REL_MIN C_CRLC_AR_RED_DIF_I_REL_MMV C_N__AR_RED__AD_ADD_MAX C_N__AR_RED__AD_FAC_MIN C_N__AR_RED__AD_FAC_MAX C_PQ__AR_RED__AD_FAC_MAX C_PQ__AR_RED__AD_FAC_MIN C_PQ__AR_RED__AD_ADD_MAX C_T_AST_AR_RED_CTL_DEAC IP_AR_RED_I_REL_1__N__PQ IP_AR_RED_I_REL_2__N__PQ IP_AR_RED_P_REL_2__N__PQ IP_T_1_HFM C_LGRD_AR_RED_DIF_TRA C_CRLC_AR_RED_AD_ADD C_CRLC_AR_RED_AD_FAC C_AR_RED_DIF_I_REL_MAX C_AR_RED_AD_ADD_MAX IP_AR_RED_P_REL_1__N__PQ C_CRLC_MAP_MDL C_N__AR_RED__AD_ADD_MIN C_N_AR_RED_ISA_AD_ADD_MIN C_N_AR_RED_ISA_AD_ADD_MAX C_AR_RED_BAS_AD_ADD_MAX C_AR_RED_BAS_ISA_AD_ADD_MAX C_CRLC_AR_RED_ISA_AD_ADD C_AR_RED_ISA_AD_ADD_MIN C_AR_RED_ISA_AD_ADD_MAX C_N_AR_RED_ISA_AD_FAC_MIN C_N_AR_RED_ISA_AD_FAC_MAX C_PQ_AR_RED_ISA_AD_ADD_MAX C_PQ_AR_RED_ISA_AD_FAC_MIN C_PQ_AR_RED_ISA_AD_FAC_MAX C_AR_RED_BAS_AD_FAC_MIN C_AR_RED_BAS_AD_FAC_MAX C_CRLC_AR_RED_ISA_AD_FAC C_AR_RED_ISA_BAS_AD_MIN C_AR_RED_ISA_BAS_AD_MAX C_AR_RED_ISA_AD_FAC_MIN C_AR_RED_ISA_AD_FAC_MAX IP_FAC_AR_RED_COR__PQ IP_FAC_AR_RED_ISA_COR__PQ IP_CRLC_HFM IP_CRLC_AR_RED_AD_ADD_MMV C_AR_RED_ISA_MAX LC_AR_RED_DIF_TRA IP_FAC_AR_RED_DIF /end DEF_CHARACTERISTIC
 /begin OUT_MEASUREMENT MAF_MDL MAP_MDL AR_RED_DIF_I_REL_MMV AR_RED_DIF_P_REL MAP_MDL_MV MAP_MDL_DIF MAF_MDL_MV MAF_MDL_DIF AR_RED AR_RED_DIF_I_REL AR_RED_DIF_REL AR_RED_ISA_DIF_REL AR_RED_ISA_AD_ADD AR_RED_AD_FAC AR_RED_ISA_AD_FAC AR_RED_AD_FAC_COR AR_RED_ISA_AD_FAC_COR AR_RED_AD_ADD AR_RED_AD_ADD_MMV AR_RED_AD_ADD_DIF LV_ACT_AR_RED_AD_ADD AR_RED_ISA_DIF_I_REL_MMV AR_RED_THR_DIF_I_REL_MMV AR_RED_ISA AR_RED_ISA_MAX FAC_AR_RED_DIF AMP_MDL_DIF_I_INI /end OUT_MEASUREMENT
/end FUNCTION
/begin FUNCTION SYS_Ambient_Pressure_Control "_Ambient Pressure Control"
 /begin DEF_CHARACTERISTIC C_CRLC_AMP_AD C_TCO_THD_AMP_AD C_AMP_AD_PL_HYS C_AMP_AD_DIF_NEG C_AMP_AD_DIF_POS C_AMP_DIF_TI_LAM_POS C_AMP_MAX C_AMP_MIN C_AMP_INI C_AMP_I_1 C_AMP_DIF_TI_LAM_NEG C_AMP_MDL_DIF_I_MIN C_AMP_P_1 C_AMP_P_2 C_CRLC_MAF_KGH_AMP_AD_PL C_CRLC_AMP_MDL_DIF_I_MMV C_MAP_DRV1_MAX_AMP_AD_PL C_N_AMP_AD_MIN C_N_AMP_AD_MAX C_N_MIN_AMP_AD_PL C_PQ_AMP_AD C_PQ_AMP_AD_PL C_SEG_CTR_AMP_AD C_SEG_CTR_AMP_AD_PL C_T_AST_AMP_CTL_DEAC C_TI_LAM_MAF_PULS_MAX C_TI_LAM_MAF_PULS_MIN C_TPS_MIN_AMP_AD_PL C_AMP_I_2 C_CRLC_AR_RED_BAS_AMP_AD_PL C_LGRD_AMP_MDL_DIF_TRA LC_AR_RED_AD_ENA C_AMP_MDL_DIF_I_MAX C_FAC_AR_RED_DIF_I_REL_INI C_AMP_AD_COR_CLRC /end DEF_CHARACTERISTIC
 /begin OUT_MEASUREMENT AMP AMP_MDL_DIF_I_MMV AMP_MDL_DIF_I AMP_MDL_DIF_P AMP_ESTIM AMP_AD_DIF AMP_AD AR_RED_BAS_MMV MAF_KGH_MMV SEG_CTR_AMP_AD_PL AMP_MDL_DIF AMP_MDL AR_RED_DIF_I_REL_INI /end OUT_MEASUREMENT
/end FUNCTION
/begin FUNCTION SYS_Engine_speed_calculation "_Engine speed calculation" /begin OUT_MEASUREMENT N_32 T_SEG_AV N_GRD N N_TOOTH /end OUT_MEASUREMENT /end FUNCTION
/begin FUNCTION SYS_Fuel_pressure_acquisition "_Fuel pressure acquisition"
 /begin DEF_CHARACTERISTIC C_FUP_NOM C_FUP_MES_CRLC IP_FUP_MES C_FUP_AFS_REQ C_FUP_AFS_REQ_HYS ldp_fup_bas__fup_mes C_FUP_OFS_ST C_FUP_MAX C_FUP_OFS_CTL C_T_DLY_ERR_FPS C_T_DLY_FPA_CLL_REQ C_T_DLY_FPA_PROT C_N_32_FPA C_T_DLY_FUP_MAX /end DEF_CHARACTERISTIC
 /begin OUT_MEASUREMENT LV_FUP_AFS_REQ LV_FUP_CLC_SWI FUP_MES_MMV FUP_MES FUP /end OUT_MEASUREMENT
/end FUNCTION
/begin FUNCTION SYS_Detection_of_Driver_Passive "_Detection of Driver Passive" /begin DEF_CHARACTERISTIC IP_FAC_TQ_REQ_CLU_IS__N_32 C_FAC_TQ_REQ_CLU_IS_HYS /end DEF_CHARACTERISTIC /begin OUT_MEASUREMENT LV_CT /end OUT_MEASUREMENT /end FUNCTION
/begin FUNCTION SYS_System_variables_for_and_fro "_System variables for and from CUS" /begin DEF_CHARACTERISTIC GEN_APP_TLR C_MAF_REF LC_GEN_CLU LC_ST_RLY_POW /end DEF_CHARACTERISTIC
 /begin OUT_MEASUREMENT TKATM LV_GEN_ERR_PLAUS LV_GEN_ERR_EL LV_GEN_ERR_MEC LV_GEN_ERR_TEMP LV_GEN_ERR_TOUT STATE_GEN_ERR STATE_GEN_ERR_IF IMLATM B_STA B_SLP B_GENFPRL B_TAERR B_TUMERS B_MASTERHW B_GFHTAK nmot rl B_MASTER taml vvt_es vvt_es2 tumgcan nsllm tmst TQ_LOSS_ALTER_1 STATE_ALTER N_SP_IS_POW_1 mdnorm LV_N_SP_IS_POW_ACT TLRGEN /end OUT_MEASUREMENT
/end FUNCTION
/begin FUNCTION SYS_ECU_state "_ECU state"
 /begin OUT_MEASUREMENT FAST_ECU_TRAN_PWL_CTR LV_ERR_ECU_CKS LV_ERR_ECU_RAM ECU_STATE /end OUT_MEASUREMENT
/end FUNCTION
/begin FUNCTION SYS_Pressure_Variables "_Pressure Variables" /begin DEF_CHARACTERISTIC IP_MAP_MES_BAS__V_MAP /end DEF_CHARACTERISTIC /begin OUT_MEASUREMENT V_MAP MAP_MES_BAS LV_LOAD_RATIO_CHK /end OUT_MEASUREMENT /end FUNCTION
/begin FUNCTION SYS_Engine_off_duration "_Engine off duration"
 /begin DEF_CHARACTERISTIC C_T_ES_TCO_PLAUS_MAX C_T_ES_TCO_PLAUS_MIN C_TCO_STOP_T_ES_PLAUS_MIN C_T_ES_SUB C_TCO_STOP_T_ES_PLAUS_MAX C_TCO_STOP_T_ES_MIN /end DEF_CHARACTERISTIC
 /begin OUT_MEASUREMENT T_ES T_REL_CAN_ES T_REL_CAN_ST LV_T_REL_CAN_REG LV_T_ES_NOT_PLAUS /end OUT_MEASUREMENT
/end FUNCTION
/begin FUNCTION SYS_Calculation_of_the_basic_red "_Calculation of the basic reduced area" /begin DEF_CHARACTERISTIC IP_AR_RED_THR IP_AR_RED_ISA /end DEF_CHARACTERISTIC /begin OUT_MEASUREMENT AR_RED_BAS AR_RED_ISA_BAS /end OUT_MEASUREMENT /end FUNCTION
/begin FUNCTION SYS_Total_running_time "_Total running time" /begin OUT_MEASUREMENT TRT /end OUT_MEASUREMENT /end FUNCTION
/end MODULE
/end PROJECT
