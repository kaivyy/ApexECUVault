ASAP2_VERSION 1 4
/begin PROJECT P_558 "EDC17_CP02"
/begin HEADER "" VERSION "V1C1" PROJECT_NO P_558 /end HEADER
/begin MODULE DIM ""
/begin MOD_COMMON "" BYTE_ORDER MSB_LAST ALIGNMENT_BYTE 1 ALIGNMENT_WORD 2 ALIGNMENT_LONG 4 ALIGNMENT_FLOAT32_IEEE 4 /end MOD_COMMON
/begin MEASUREMENT AFST_t "" SWORD Temp_Cels 1 100 -3549.940 3003.560 FORMAT "%8.3" ECU_ADDRESS 0xD000697E /end MEASUREMENT
/begin MEASUREMENT AFS_stDrftB1 "" UBYTE default 1 100 0.00 255.0 FORMAT "%5.1" ECU_ADDRESS 0xD0008EF7 /end MEASUREMENT
/begin MEASUREMENT AFS_stDrftB2 "" UBYTE default 1 100 0.00 255.0 FORMAT "%5.1" ECU_ADDRESS 0xD0008EF8 /end MEASUREMENT
/begin MEASUREMENT AirC_rClgDem "" SWORD Prc 1 100 -400.0000 399.9878 FORMAT "%8.4" ECU_ADDRESS 0xD0006B42 /end MEASUREMENT
/begin MEASUREMENT CACDsP_p "" SWORD Pres_hPa 1 100 -32768.00 3500.00 FORMAT "%8.2" ECU_ADDRESS 0xD0006C0C /end MEASUREMENT
/begin MEASUREMENT CACDsP_pUnFlt "" SWORD Pres_hPa 1 100 -32768.00 3500.00 FORMAT "%8.2" ECU_ADDRESS 0xD0006C0E /end MEASUREMENT
/begin MEASUREMENT CACDsT_dt "" SWORD Temp_Cels 1 100 -3549.940 3003.560 FORMAT "%8.3" ECU_ADDRESS 0xD0006C10 /end MEASUREMENT
/begin MEASUREMENT CACDsT_t "" SWORD Temp_Cels 1 100 -3549.940 3003.560 FORMAT "%8.3" ECU_ADDRESS 0xD0006C12 /end MEASUREMENT
/begin MEASUREMENT Com_stMILReq "" UBYTE OneToOne 1 100 0.00 255.0 FORMAT "%5.1" ECU_ADDRESS 0xD0008F94 /end MEASUREMENT
/begin MEASUREMENT Com_stSVSReq "" UBYTE OneToOne 1 100 0.00 255.0 FORMAT "%5.1" ECU_ADDRESS 0xD0008F9D /end MEASUREMENT
/begin MEASUREMENT CrC_stErr "" UWORD OneToOne 1 100 0.00 65535.00 FORMAT "%8.2" ECU_ADDRESS 0xD000764E /end MEASUREMENT
/begin MEASUREMENT CrC_stKey "" UWORD OneToOne 1 100 0.00 65535.00 FORMAT "%8.2" ECU_ADDRESS 0xD0007650 /end MEASUREMENT
/begin MEASUREMENT DFC_st.DFC_Unused "" UWORD DFC_OneToOne 1 100 0.00 65535.00 FORMAT "%8.2" ECU_ADDRESS 0xD000C99E /end MEASUREMENT
/begin MEASUREMENT DFC_st.DFC_AirCtlGovDvtEOMMax "" UWORD DFC_OneToOne 1 100 0.00 65535.00 FORMAT "%8.2" ECU_ADDRESS 0xD000C9A0 /end MEASUREMENT
/begin MEASUREMENT DFC_st.DFC_AirCtlGovDvtEOMMin "" UWORD DFC_OneToOne 1 100 0.00 65535.00 FORMAT "%8.2" ECU_ADDRESS 0xD000C9A2 /end MEASUREMENT
/begin MEASUREMENT DFC_st.DFC_AirCtlGovDvtMax "" UWORD DFC_OneToOne 1 100 0.00 65535.00 FORMAT "%8.2" ECU_ADDRESS 0xD000C9A4 /end MEASUREMENT
/begin MEASUREMENT DFC_st.DFC_AirCtlGovDvtMin "" UWORD DFC_OneToOne 1 100 0.00 65535.00 FORMAT "%8.2" ECU_ADDRESS 0xD000C9A6 /end MEASUREMENT
/begin MEASUREMENT DFC_st.DFC_Cj945SpiCom1 "" UWORD DFC_OneToOne 1 100 0.00 65535.00 FORMAT "%8.2" ECU_ADDRESS 0xD000C9A8 /end MEASUREMENT
/begin MEASUREMENT DFC_st.DFC_ComButtonMSASig "" UWORD DFC_OneToOne 1 100 0.00 65535.00 FORMAT "%8.2" ECU_ADDRESS 0xD000C9AA /end MEASUREMENT
/begin MEASUREMENT DFC_st.DFC_ComButtonMSATo "" UWORD DFC_OneToOne 1 100 0.00 65535.00 FORMAT "%8.2" ECU_ADDRESS 0xD000C9AC /end MEASUREMENT
/begin MEASUREMENT DFC_st.DFC_ComGearboxData2Sig "" UWORD DFC_OneToOne 1 100 0.00 65535.00 FORMAT "%8.2" ECU_ADDRESS 0xD000C9AE /end MEASUREMENT
/begin MEASUREMENT DFC_st.DFC_ComGearboxData2To "" UWORD DFC_OneToOne 1 100 0.00 65535.00 FORMAT "%8.2" ECU_ADDRESS 0xD000C9B0 /end MEASUREMENT
/begin MEASUREMENT DFC_st.DFC_ComGearboxDataSig "" UWORD DFC_OneToOne 1 100 0.00 65535.00 FORMAT "%8.2" ECU_ADDRESS 0xD000C9B2 /end MEASUREMENT
/begin MEASUREMENT DFC_st.DFC_ComGearboxDataTo "" UWORD DFC_OneToOne 1 100 0.00 65535.00 FORMAT "%8.2" ECU_ADDRESS 0xD000C9B4 /end MEASUREMENT
/begin MEASUREMENT DFC_st.DFC_ComHeatACSig "" UWORD DFC_OneToOne 1 100 0.00 65535.00 FORMAT "%8.2" ECU_ADDRESS 0xD000C9B6 /end MEASUREMENT
/begin MEASUREMENT DFC_st.DFC_ComHeatACTo "" UWORD DFC_OneToOne 1 100 0.00 65535.00 FORMAT "%8.2" ECU_ADDRESS 0xD000C9B8 /end MEASUREMENT
/begin MEASUREMENT DFC_st.DFC_ComLenkradwinkelSig "" UWORD DFC_OneToOne 1 100 0.00 65535.00 FORMAT "%8.2" ECU_ADDRESS 0xD000C9BA /end MEASUREMENT
/begin MEASUREMENT DFC_st.DFC_ComLenkradwinkelTo "" UWORD DFC_OneToOne 1 100 0.00 65535.00 FORMAT "%8.2" ECU_ADDRESS 0xD000C9BC /end MEASUREMENT
/begin MEASUREMENT DFC_st.DFC_ComMileageRangeSig "" UWORD DFC_OneToOne 1 100 0.00 65535.00 FORMAT "%8.2" ECU_ADDRESS 0xD000C9BE /end MEASUREMENT
/begin MEASUREMENT DFC_st.DFC_ComMileageRangeTo "" UWORD DFC_OneToOne 1 100 0.00 65535.00 FORMAT "%8.2" ECU_ADDRESS 0xD000C9C0 /end MEASUREMENT
/begin MEASUREMENT DFC_st.DFC_ComPspSig "" UWORD DFC_OneToOne 1 100 0.00 65535.00 FORMAT "%8.2" ECU_ADDRESS 0xD000C9C2 /end MEASUREMENT
/begin MEASUREMENT DFC_st.DFC_ComPspTo "" UWORD DFC_OneToOne 1 100 0.00 65535.00 FORMAT "%8.2" ECU_ADDRESS 0xD000C9C4 /end MEASUREMENT
/begin MEASUREMENT DFC_st.DFC_ComShutOffPSPSig "" UWORD DFC_OneToOne 1 100 0.00 65535.00 FORMAT "%8.2" ECU_ADDRESS 0xD000C9C6 /end MEASUREMENT
/begin MEASUREMENT DFC_st.DFC_ComShutOffPSPTo "" UWORD DFC_OneToOne 1 100 0.00 65535.00 FORMAT "%8.2" ECU_ADDRESS 0xD000C9C8 /end MEASUREMENT
/begin MEASUREMENT DFC_st.DFC_ComStKombiCtr "" UWORD DFC_OneToOne 1 100 0.00 65535.00 FORMAT "%8.2" ECU_ADDRESS 0xD000C9CA /end MEASUREMENT
/begin MEASUREMENT DFC_st.DFC_ComStKombiSig "" UWORD DFC_OneToOne 1 100 0.00 65535.00 FORMAT "%8.2" ECU_ADDRESS 0xD000C9CC /end MEASUREMENT
/begin MEASUREMENT DFC_st.DFC_ComStKombiTo "" UWORD DFC_OneToOne 1 100 0.00 65535.00 FORMAT "%8.2" ECU_ADDRESS 0xD000C9CE /end MEASUREMENT
/begin MEASUREMENT DFC_st.DFC_ComStateARSCtr "" UWORD DFC_OneToOne 1 100 0.00 65535.00 FORMAT "%8.2" ECU_ADDRESS 0xD000C9D0 /end MEASUREMENT
/begin MEASUREMENT DFC_st.DFC_ComStateARSSig "" UWORD DFC_OneToOne 1 100 0.00 65535.00 FORMAT "%8.2" ECU_ADDRESS 0xD000C9D2 /end MEASUREMENT
/begin MEASUREMENT DFC_st.DFC_ComStateARSTo "" UWORD DFC_OneToOne 1 100 0.00 65535.00 FORMAT "%8.2" ECU_ADDRESS 0xD000C9D4 /end MEASUREMENT
/begin MEASUREMENT DFC_st.DFC_ComStateDscSig "" UWORD DFC_OneToOne 1 100 0.00 65535.00 FORMAT "%8.2" ECU_ADDRESS 0xD000C9D6 /end MEASUREMENT
/begin MEASUREMENT DFC_st.DFC_ComStateDscTo "" UWORD DFC_OneToOne 1 100 0.00 65535.00 FORMAT "%8.2" ECU_ADDRESS 0xD000C9D8 /end MEASUREMENT
/begin MEASUREMENT DFC_st.DFC_ComStateSeatSig "" UWORD DFC_OneToOne 1 100 0.00 65535.00 FORMAT "%8.2" ECU_ADDRESS 0xD000C9DA /end MEASUREMENT
/begin MEASUREMENT DFC_st.DFC_ComStateSeatTo "" UWORD DFC_OneToOne 1 100 0.00 65535.00 FORMAT "%8.2" ECU_ADDRESS 0xD000C9DC /end MEASUREMENT
/begin MEASUREMENT DFC_st.DFC_ComTempRelTimeSig "" UWORD DFC_OneToOne 1 100 0.00 65535.00 FORMAT "%8.2" ECU_ADDRESS 0xD000C9DE /end MEASUREMENT
/begin MEASUREMENT DFC_st.DFC_ComTempRelTimeTo "" UWORD DFC_OneToOne 1 100 0.00 65535.00 FORMAT "%8.2" ECU_ADDRESS 0xD000C9E0 /end MEASUREMENT
/begin MEASUREMENT DFC_st.DFC_ComTerminalChk "" UWORD DFC_OneToOne 1 100 0.00 65535.00 FORMAT "%8.2" ECU_ADDRESS 0xD000C9E2 /end MEASUREMENT
/begin MEASUREMENT DFC_st.DFC_ComTerminalCtr "" UWORD DFC_OneToOne 1 100 0.00 65535.00 FORMAT "%8.2" ECU_ADDRESS 0xD000C9E4 /end MEASUREMENT
/begin MEASUREMENT DFC_st.DFC_ComTerminalSig "" UWORD DFC_OneToOne 1 100 0.00 65535.00 FORMAT "%8.2" ECU_ADDRESS 0xD000C9E6 /end MEASUREMENT
/begin MEASUREMENT DFC_st.DFC_ComTerminalTo "" UWORD DFC_OneToOne 1 100 0.00 65535.00 FORMAT "%8.2" ECU_ADDRESS 0xD000C9E8 /end MEASUREMENT
/begin MEASUREMENT DFC_st.DFC_ComTimeDateSig "" UWORD DFC_OneToOne 1 100 0.00 65535.00 FORMAT "%8.2" ECU_ADDRESS 0xD000C9EA /end MEASUREMENT
/begin MEASUREMENT DFC_st.DFC_ComTimeDateTo "" UWORD DFC_OneToOne 1 100 0.00 65535.00 FORMAT "%8.2" ECU_ADDRESS 0xD000C9EC /end MEASUREMENT
/begin MEASUREMENT DFC_st.DFC_ComTrailerSig "" UWORD DFC_OneToOne 1 100 0.00 65535.00 FORMAT "%8.2" ECU_ADDRESS 0xD000C9EE /end MEASUREMENT
/begin MEASUREMENT DFC_st.DFC_ComTrailerTo "" UWORD DFC_OneToOne 1 100 0.00 65535.00 FORMAT "%8.2" ECU_ADDRESS 0xD000C9F0 /end MEASUREMENT
/begin MEASUREMENT DFC_st.DFC_ComTrqDemandAfsChk "" UWORD DFC_OneToOne 1 100 0.00 65535.00 FORMAT "%8.2" ECU_ADDRESS 0xD000C9F2 /end MEASUREMENT
/begin MEASUREMENT DFC_st.DFC_ComTrqDemandAfsCtr "" UWORD DFC_OneToOne 1 100 0.00 65535.00 FORMAT "%8.2" ECU_ADDRESS 0xD000C9F4 /end MEASUREMENT
/begin MEASUREMENT DFC_st.DFC_ComTrqDemandAfsSig "" UWORD DFC_OneToOne 1 100 0.00 65535.00 FORMAT "%8.2" ECU_ADDRESS 0xD000C9F6 /end MEASUREMENT
/begin MEASUREMENT DFC_st.DFC_ComTrqDemandAfsTo "" UWORD DFC_OneToOne 1 100 0.00 65535.00 FORMAT "%8.2" ECU_ADDRESS 0xD000C9F8 /end MEASUREMENT
/begin MEASUREMENT DFC_st.DFC_ComTrqDemandDscChk "" UWORD DFC_OneToOne 1 100 0.00 65535.00 FORMAT "%8.2" ECU_ADDRESS 0xD000C9FA /end MEASUREMENT
/begin MEASUREMENT DFC_st.DFC_ComTrqDemandDscCtr "" UWORD DFC_OneToOne 1 100 0.00 65535.00 FORMAT "%8.2" ECU_ADDRESS 0xD000C9FC /end MEASUREMENT
/begin MEASUREMENT DFC_st.DFC_ComTrqDemandDscSig "" UWORD DFC_OneToOne 1 100 0.00 65535.00 FORMAT "%8.2" ECU_ADDRESS 0xD000C9FE /end MEASUREMENT
/begin MEASUREMENT DFC_st.DFC_ComTrqDemandDscTo "" UWORD DFC_OneToOne 1 100 0.00 65535.00 FORMAT "%8.2" ECU_ADDRESS 0xD000CA00 /end MEASUREMENT
/begin MEASUREMENT DFC_st.DFC_ComTrqDemandGbxChk "" UWORD DFC_OneToOne 1 100 0.00 65535.00 FORMAT "%8.2" ECU_ADDRESS 0xD000CA02 /end MEASUREMENT
/begin MEASUREMENT DFC_st.DFC_ComTrqDemandGbxCtr "" UWORD DFC_OneToOne 1 100 0.00 65535.00 FORMAT "%8.2" ECU_ADDRESS 0xD000CA04 /end MEASUREMENT
/begin MEASUREMENT DFC_st.DFC_ComTrqDemandGbxSig "" UWORD DFC_OneToOne 1 100 0.00 65535.00 FORMAT "%8.2" ECU_ADDRESS 0xD000CA06 /end MEASUREMENT
/begin MEASUREMENT DFC_st.DFC_ComTrqDemandGbxTo "" UWORD DFC_OneToOne 1 100 0.00 65535.00 FORMAT "%8.2" ECU_ADDRESS 0xD000CA08 /end MEASUREMENT
/begin MEASUREMENT DFC_st.DFC_ComVelocitySig "" UWORD DFC_OneToOne 1 100 0.00 65535.00 FORMAT "%8.2" ECU_ADDRESS 0xD000CA0A /end MEASUREMENT
/begin MEASUREMENT DFC_st.DFC_ComVelocityTo "" UWORD DFC_OneToOne 1 100 0.00 65535.00 FORMAT "%8.2" ECU_ADDRESS 0xD000CA0C /end MEASUREMENT
/begin MEASUREMENT DFC_st.DFC_ComWheelSpeedSig "" UWORD DFC_OneToOne 1 100 0.00 65535.00 FORMAT "%8.2" ECU_ADDRESS 0xD000CA0E /end MEASUREMENT
/begin MEASUREMENT DFC_st.DFC_ComWheelSpeedTo "" UWORD DFC_OneToOne 1 100 0.00 65535.00 FORMAT "%8.2" ECU_ADDRESS 0xD000CA10 /end MEASUREMENT
/begin MEASUREMENT DFC_st.DFC_ComZvKlappenSig "" UWORD DFC_OneToOne 1 100 0.00 65535.00 FORMAT "%8.2" ECU_ADDRESS 0xD000CA12 /end MEASUREMENT
/begin MEASUREMENT DFC_st.DFC_ComZvKlappenTo "" UWORD DFC_OneToOne 1 100 0.00 65535.00 FORMAT "%8.2" ECU_ADDRESS 0xD000CA14 /end MEASUREMENT
/begin MEASUREMENT DFC_st.DFC_Cy150SpiCom "" UWORD DFC_OneToOne 1 100 0.00 65535.00 FORMAT "%8.2" ECU_ADDRESS 0xD000CA16 /end MEASUREMENT
/begin MEASUREMENT DFC_st.DFC_Cy320SpiCom "" UWORD DFC_OneToOne 1 100 0.00 65535.00 FORMAT "%8.2" ECU_ADDRESS 0xD000CA18 /end MEASUREMENT
/begin MEASUREMENT DFC_st.DFC_ETCtlDvtInrMax "" UWORD DFC_OneToOne 1 100 0.00 65535.00 FORMAT "%8.2" ECU_ADDRESS 0xD000CA1A /end MEASUREMENT
/begin MEASUREMENT DFC_st.DFC_ETCtlDvtInrMin "" UWORD DFC_OneToOne 1 100 0.00 65535.00 FORMAT "%8.2" ECU_ADDRESS 0xD000CA1C /end MEASUREMENT
/begin MEASUREMENT DFC_st.DFC_ETCtlDvtOutrMax "" UWORD DFC_OneToOne 1 100 0.00 65535.00 FORMAT "%8.2" ECU_ADDRESS 0xD000CA1E /end MEASUREMENT
/begin MEASUREMENT DFC_st.DFC_ETCtlDvtOutrMin "" UWORD DFC_OneToOne 1 100 0.00 65535.00 FORMAT "%8.2" ECU_ADDRESS 0xD000CA20 /end MEASUREMENT
/begin MEASUREMENT DFC_st.DFC_Fan4WinErr1 "" UWORD DFC_OneToOne 1 100 0.00 65535.00 FORMAT "%8.2" ECU_ADDRESS 0xD000CA22 /end MEASUREMENT
/begin MEASUREMENT DFC_st.DFC_Fan4WinErr2 "" UWORD DFC_OneToOne 1 100 0.00 65535.00 FORMAT "%8.2" ECU_ADDRESS 0xD000CA24 /end MEASUREMENT
/begin MEASUREMENT DFC_st.DFC_Fan4WinErr3 "" UWORD DFC_OneToOne 1 100 0.00 65535.00 FORMAT "%8.2" ECU_ADDRESS 0xD000CA26 /end MEASUREMENT
/begin MEASUREMENT DFC_st.DFC_Fan4WinErr4 "" UWORD DFC_OneToOne 1 100 0.00 65535.00 FORMAT "%8.2" ECU_ADDRESS 0xD000CA28 /end MEASUREMENT
/begin MEASUREMENT DFC_st.DFC_FanSCG "" UWORD DFC_OneToOne 1 100 0.00 65535.00 FORMAT "%8.2" ECU_ADDRESS 0xD000CA2A /end MEASUREMENT
/begin MEASUREMENT DFC_st.DFC_PCRGovDvtLPMax "" UWORD DFC_OneToOne 1 100 0.00 65535.00 FORMAT "%8.2" ECU_ADDRESS 0xD000CA2C /end MEASUREMENT
/begin MEASUREMENT DFC_st.DFC_PCRGovDvtLPMin "" UWORD DFC_OneToOne 1 100 0.00 65535.00 FORMAT "%8.2" ECU_ADDRESS 0xD000CA2E /end MEASUREMENT
/begin MEASUREMENT DFC_st.DFC_PCRGovDvtMax "" UWORD DFC_OneToOne 1 100 0.00 65535.00 FORMAT "%8.2" ECU_ADDRESS 0xD000CA30 /end MEASUREMENT
/begin MEASUREMENT DFC_st.DFC_PCRGovDvtMin "" UWORD DFC_OneToOne 1 100 0.00 65535.00 FORMAT "%8.2" ECU_ADDRESS 0xD000CA32 /end MEASUREMENT
/begin MEASUREMENT DFC_st.DFC_RailCPC1 "" UWORD DFC_OneToOne 1 100 0.00 65535.00 FORMAT "%8.2" ECU_ADDRESS 0xD000CA34 /end MEASUREMENT
/begin MEASUREMENT DFC_st.DFC_RailCPC3 "" UWORD DFC_OneToOne 1 100 0.00 65535.00 FORMAT "%8.2" ECU_ADDRESS 0xD000CA36 /end MEASUREMENT
/begin MEASUREMENT DFC_st.DFC_RailCPC4 "" UWORD DFC_OneToOne 1 100 0.00 65535.00 FORMAT "%8.2" ECU_ADDRESS 0xD000CA38 /end MEASUREMENT
/begin MEASUREMENT DFC_st.DFC_RailMeUn0 "" UWORD DFC_OneToOne 1 100 0.00 65535.00 FORMAT "%8.2" ECU_ADDRESS 0xD000CA3A /end MEASUREMENT
/begin MEASUREMENT DFC_st.DFC_RailMeUn1 "" UWORD DFC_OneToOne 1 100 0.00 65535.00 FORMAT "%8.2" ECU_ADDRESS 0xD000CA3C /end MEASUREMENT
/begin MEASUREMENT DFC_st.DFC_RailMeUn2 "" UWORD DFC_OneToOne 1 100 0.00 65535.00 FORMAT "%8.2" ECU_ADDRESS 0xD000CA3E /end MEASUREMENT
/begin MEASUREMENT DFC_st.DFC_RailMeUn3 "" UWORD DFC_OneToOne 1 100 0.00 65535.00 FORMAT "%8.2" ECU_ADDRESS 0xD000CA40 /end MEASUREMENT
/begin MEASUREMENT DFC_st.DFC_RailMeUn4 "" UWORD DFC_OneToOne 1 100 0.00 65535.00 FORMAT "%8.2" ECU_ADDRESS 0xD000CA42 /end MEASUREMENT
/begin MEASUREMENT DFC_st.DFC_RailPCV0 "" UWORD DFC_OneToOne 1 100 0.00 65535.00 FORMAT "%8.2" ECU_ADDRESS 0xD000CA44 /end MEASUREMENT
/begin MEASUREMENT DFC_st.DFC_RailPCV1 "" UWORD DFC_OneToOne 1 100 0.00 65535.00 FORMAT "%8.2" ECU_ADDRESS 0xD000CA46 /end MEASUREMENT
/begin MEASUREMENT DFC_st.DFC_RailPCV2 "" UWORD DFC_OneToOne 1 100 0.00 65535.00 FORMAT "%8.2" ECU_ADDRESS 0xD000CA48 /end MEASUREMENT
/begin MEASUREMENT DFC_st.DFC_RailPCV3 "" UWORD DFC_OneToOne 1 100 0.00 65535.00 FORMAT "%8.2" ECU_ADDRESS 0xD000CA4A /end MEASUREMENT
/begin MEASUREMENT DFC_st.DFC_RailPCV4 "" UWORD DFC_OneToOne 1 100 0.00 65535.00 FORMAT "%8.2" ECU_ADDRESS 0xD000CA4C /end MEASUREMENT
/begin MEASUREMENT DFC_st.DFC_RailPMonStrt "" UWORD DFC_OneToOne 1 100 0.00 65535.00 FORMAT "%8.2" ECU_ADDRESS 0xD000CA4E /end MEASUREMENT
/begin MEASUREMENT DFC_st.DFC_SSpMon1 "" UWORD DFC_OneToOne 1 100 0.00 65535.00 FORMAT "%8.2" ECU_ADDRESS 0xD000CA50 /end MEASUREMENT
/begin MEASUREMENT DFC_st.DFC_SSpMon2 "" UWORD DFC_OneToOne 1 100 0.00 65535.00 FORMAT "%8.2" ECU_ADDRESS 0xD000CA52 /end MEASUREMENT
/begin MEASUREMENT DFC_st.DFC_SSpMon3 "" UWORD DFC_OneToOne 1 100 0.00 65535.00 FORMAT "%8.2" ECU_ADDRESS 0xD000CA54 /end MEASUREMENT
/begin MEASUREMENT DFC_st.DFC_Sia_E1 "" UWORD DFC_OneToOne 1 100 0.00 65535.00 FORMAT "%8.2" ECU_ADDRESS 0xD000CA56 /end MEASUREMENT
/begin MEASUREMENT DFC_st.DFC_Sia_E10 "" UWORD DFC_OneToOne 1 100 0.00 65535.00 FORMAT "%8.2" ECU_ADDRESS 0xD000CA58 /end MEASUREMENT
/begin MEASUREMENT DFC_st.DFC_Sia_E11 "" UWORD DFC_OneToOne 1 100 0.00 65535.00 FORMAT "%8.2" ECU_ADDRESS 0xD000CA5A /end MEASUREMENT
/begin MEASUREMENT DFC_st.DFC_Sia_E12 "" UWORD DFC_OneToOne 1 100 0.00 65535.00 FORMAT "%8.2" ECU_ADDRESS 0xD000CA5C /end MEASUREMENT
/begin MEASUREMENT DFC_st.DFC_Sia_E13 "" UWORD DFC_OneToOne 1 100 0.00 65535.00 FORMAT "%8.2" ECU_ADDRESS 0xD000CA5E /end MEASUREMENT
/begin MEASUREMENT DFC_st.DFC_Sia_E14 "" UWORD DFC_OneToOne 1 100 0.00 65535.00 FORMAT "%8.2" ECU_ADDRESS 0xD000CA60 /end MEASUREMENT
/begin MEASUREMENT DFC_st.DFC_Sia_E15 "" UWORD DFC_OneToOne 1 100 0.00 65535.00 FORMAT "%8.2" ECU_ADDRESS 0xD000CA62 /end MEASUREMENT
/begin MEASUREMENT DFC_st.DFC_Sia_E2 "" UWORD DFC_OneToOne 1 100 0.00 65535.00 FORMAT "%8.2" ECU_ADDRESS 0xD000CA64 /end MEASUREMENT
/begin MEASUREMENT DFC_st.DFC_Sia_E3 "" UWORD DFC_OneToOne 1 100 0.00 65535.00 FORMAT "%8.2" ECU_ADDRESS 0xD000CA66 /end MEASUREMENT
/begin MEASUREMENT DFC_st.DFC_Sia_E4 "" UWORD DFC_OneToOne 1 100 0.00 65535.00 FORMAT "%8.2" ECU_ADDRESS 0xD000CA68 /end MEASUREMENT
/begin MEASUREMENT DFC_st.DFC_Sia_E5 "" UWORD DFC_OneToOne 1 100 0.00 65535.00 FORMAT "%8.2" ECU_ADDRESS 0xD000CA6A /end MEASUREMENT
/begin MEASUREMENT DFC_st.DFC_Sia_E6 "" UWORD DFC_OneToOne 1 100 0.00 65535.00 FORMAT "%8.2" ECU_ADDRESS 0xD000CA6C /end MEASUREMENT
/begin MEASUREMENT DFC_st.DFC_Sia_E7 "" UWORD DFC_OneToOne 1 100 0.00 65535.00 FORMAT "%8.2" ECU_ADDRESS 0xD000CA6E /end MEASUREMENT
/begin MEASUREMENT DFC_st.DFC_Sia_E8 "" UWORD DFC_OneToOne 1 100 0.00 65535.00 FORMAT "%8.2" ECU_ADDRESS 0xD000CA70 /end MEASUREMENT
/begin MEASUREMENT DFC_st.DFC_Sia_E9 "" UWORD DFC_OneToOne 1 100 0.00 65535.00 FORMAT "%8.2" ECU_ADDRESS 0xD000CA72 /end MEASUREMENT
/begin MEASUREMENT DFC_st.DFC_ThrVlv4WinErr1 "" UWORD DFC_OneToOne 1 100 0.00 65535.00 FORMAT "%8.2" ECU_ADDRESS 0xD000CA74 /end MEASUREMENT
/begin MEASUREMENT DFC_st.DFC_ThrVlv4WinErr2 "" UWORD DFC_OneToOne 1 100 0.00 65535.00 FORMAT "%8.2" ECU_ADDRESS 0xD000CA76 /end MEASUREMENT
/begin MEASUREMENT DFC_st.DFC_ThrVlv4WinErr3 "" UWORD DFC_OneToOne 1 100 0.00 65535.00 FORMAT "%8.2" ECU_ADDRESS 0xD000CA78 /end MEASUREMENT
/begin MEASUREMENT DFC_st.DFC_ThrVlv4WinErr4 "" UWORD DFC_OneToOne 1 100 0.00 65535.00 FORMAT "%8.2" ECU_ADDRESS 0xD000CA7A /end MEASUREMENT
/begin MEASUREMENT DFC_st.DFC_ThrVlvSCG "" UWORD DFC_OneToOne 1 100 0.00 65535.00 FORMAT "%8.2" ECU_ADDRESS 0xD000CA7C /end MEASUREMENT
/begin MEASUREMENT DFC_st.DFC_TrbCh4WinErr1 "" UWORD DFC_OneToOne 1 100 0.00 65535.00 FORMAT "%8.2" ECU_ADDRESS 0xD000CA7E /end MEASUREMENT
/begin MEASUREMENT DFC_st.DFC_TrbCh4WinErr2 "" UWORD DFC_OneToOne 1 100 0.00 65535.00 FORMAT "%8.2" ECU_ADDRESS 0xD000CA80 /end MEASUREMENT
/begin MEASUREMENT DFC_st.DFC_TrbCh4WinErr3 "" UWORD DFC_OneToOne 1 100 0.00 65535.00 FORMAT "%8.2" ECU_ADDRESS 0xD000CA82 /end MEASUREMENT
/begin MEASUREMENT DFC_st.DFC_TrbCh4WinErr4 "" UWORD DFC_OneToOne 1 100 0.00 65535.00 FORMAT "%8.2" ECU_ADDRESS 0xD000CA84 /end MEASUREMENT
/begin MEASUREMENT DFC_st.DFC_TrbChSCG "" UWORD DFC_OneToOne 1 100 0.00 65535.00 FORMAT "%8.2" ECU_ADDRESS 0xD000CA86 /end MEASUREMENT
/begin MEASUREMENT DFC_st.DFC_TrbChSRCMax "" UWORD DFC_OneToOne 1 100 0.00 65535.00 FORMAT "%8.2" ECU_ADDRESS 0xD000CA88 /end MEASUREMENT
/begin MEASUREMENT DFC_st.DFC_TrbChSRCMin "" UWORD DFC_OneToOne 1 100 0.00 65535.00 FORMAT "%8.2" ECU_ADDRESS 0xD000CA8A /end MEASUREMENT
/begin MEASUREMENT DFC_st.DFC_WaHtEl4WinErr1 "" UWORD DFC_OneToOne 1 100 0.00 65535.00 FORMAT "%8.2" ECU_ADDRESS 0xD000CA8C /end MEASUREMENT
/begin MEASUREMENT DFC_st.DFC_WaHtEl4WinErr2 "" UWORD DFC_OneToOne 1 100 0.00 65535.00 FORMAT "%8.2" ECU_ADDRESS 0xD000CA8E /end MEASUREMENT
/begin MEASUREMENT DFC_st.DFC_WaHtEl4WinErr3 "" UWORD DFC_OneToOne 1 100 0.00 65535.00 FORMAT "%8.2" ECU_ADDRESS 0xD000CA90 /end MEASUREMENT
/begin MEASUREMENT DFC_st.DFC_WaHtEl4WinErr4 "" UWORD DFC_OneToOne 1 100 0.00 65535.00 FORMAT "%8.2" ECU_ADDRESS 0xD000CA92 /end MEASUREMENT
/begin MEASUREMENT DFC_st.DFC_WaHtElSCG "" UWORD DFC_OneToOne 1 100 0.00 65535.00 FORMAT "%8.2" ECU_ADDRESS 0xD000CA94 /end MEASUREMENT
/begin MEASUREMENT DFC_st.DFC_ETClbETFltMax "" UWORD DFC_OneToOne 1 100 0.00 65535.00 FORMAT "%8.2" ECU_ADDRESS 0xD000CA96 /end MEASUREMENT
/begin MEASUREMENT DFC_st.DFC_ETClbETFltMin "" UWORD DFC_OneToOne 1 100 0.00 65535.00 FORMAT "%8.2" ECU_ADDRESS 0xD000CA98 /end MEASUREMENT
/begin MEASUREMENT DFC_st.DFC_InjCrvInjLimChrgBal "" UWORD DFC_OneToOne 1 100 0.00 65535.00 FORMAT "%8.2" ECU_ADDRESS 0xD000CA9A /end MEASUREMENT
/begin MEASUREMENT DFC_st.DFC_InjCrvInjLimQntBal "" UWORD DFC_OneToOne 1 100 0.00 65535.00 FORMAT "%8.2" ECU_ADDRESS 0xD000CA9C /end MEASUREMENT
/begin MEASUREMENT DFC_st.DFC_InjCrvInjLimSys "" UWORD DFC_OneToOne 1 100 0.00 65535.00 FORMAT "%8.2" ECU_ADDRESS 0xD000CA9E /end MEASUREMENT
/begin MEASUREMENT DFC_st.DFC_InjCrvNumInjRtmLim "" UWORD DFC_OneToOne 1 100 0.00 65535.00 FORMAT "%8.2" ECU_ADDRESS 0xD000CAA0 /end MEASUREMENT
/begin MEASUREMENT DFC_st.DFC_LSUHtCoupSig_0 "" UWORD DFC_OneToOne 1 100 0.00 65535.00 FORMAT "%8.2" ECU_ADDRESS 0xD000CAA2 /end MEASUREMENT
/begin MEASUREMENT DFC_st.DFC_LSUHtCoupSig_1 "" UWORD DFC_OneToOne 1 100 0.00 65535.00 FORMAT "%8.2" ECU_ADDRESS 0xD000CAA4 /end MEASUREMENT
/begin MEASUREMENT DFC_st.DFC_LSUHtCoupSig_2 "" UWORD DFC_OneToOne 1 100 0.00 65535.00 FORMAT "%8.2" ECU_ADDRESS 0xD000CAA6 /end MEASUREMENT
/begin MEASUREMENT DFC_st.DFC_LSUHtCoupSig_3 "" UWORD DFC_OneToOne 1 100 0.00 65535.00 FORMAT "%8.2" ECU_ADDRESS 0xD000CAA8 /end MEASUREMENT
/begin MEASUREMENT DFC_st.DFC_CtT "" UWORD DFC_OneToOne 1 100 0.00 65535.00 FORMAT "%8.2" ECU_ADDRESS 0xD000CAAA /end MEASUREMENT
/begin MEASUREMENT DFC_st.DFC_DSMDummy "" UWORD DFC_OneToOne 1 100 0.00 65535.00 FORMAT "%8.2" ECU_ADDRESS 0xD000CAAC /end MEASUREMENT
/begin MEASUREMENT DFC_st.DFC_MeUnOL "" UWORD DFC_OneToOne 1 100 0.00 65535.00 FORMAT "%8.2" ECU_ADDRESS 0xD000CAAE /end MEASUREMENT
/begin MEASUREMENT DFC_st.DFC_MeUnSCB "" UWORD DFC_OneToOne 1 100 0.00 65535.00 FORMAT "%8.2" ECU_ADDRESS 0xD000CAB0 /end MEASUREMENT
/begin MEASUREMENT DFC_st.DFC_MeUnSRCMax "" UWORD DFC_OneToOne 1 100 0.00 65535.00 FORMAT "%8.2" ECU_ADDRESS 0xD000CAB2 /end MEASUREMENT
/begin MEASUREMENT DFC_st.DFC_MeUnSRCMin "" UWORD DFC_OneToOne 1 100 0.00 65535.00 FORMAT "%8.2" ECU_ADDRESS 0xD000CAB4 /end MEASUREMENT
/begin MEASUREMENT DFC_st.DFC_PCVOL "" UWORD DFC_OneToOne 1 100 0.00 65535.00 FORMAT "%8.2" ECU_ADDRESS 0xD000CAB6 /end MEASUREMENT
/begin MEASUREMENT DFC_st.DFC_PCVSCB "" UWORD DFC_OneToOne 1 100 0.00 65535.00 FORMAT "%8.2" ECU_ADDRESS 0xD000CAB8 /end MEASUREMENT
/begin MEASUREMENT DFC_st.DFC_PCVSRCMax "" UWORD DFC_OneToOne 1 100 0.00 65535.00 FORMAT "%8.2" ECU_ADDRESS 0xD000CABA /end MEASUREMENT
/begin MEASUREMENT DFC_st.DFC_PCVSRCMin "" UWORD DFC_OneToOne 1 100 0.00 65535.00 FORMAT "%8.2" ECU_ADDRESS 0xD000CABC /end MEASUREMENT
/begin MEASUREMENT DFC_st.DFC_RailPSRCMax "" UWORD DFC_OneToOne 1 100 0.00 65535.00 FORMAT "%8.2" ECU_ADDRESS 0xD000CABE /end MEASUREMENT
/begin MEASUREMENT DFC_st.DFC_RailPSRCMin "" UWORD DFC_OneToOne 1 100 0.00 65535.00 FORMAT "%8.2" ECU_ADDRESS 0xD000CAC0 /end MEASUREMENT
/begin MEASUREMENT DFC_st.DFC_IVActrVltgSRCMax "" UWORD DFC_OneToOne 1 100 0.00 65535.00 FORMAT "%8.2" ECU_ADDRESS 0xD000CAC2 /end MEASUREMENT
/begin MEASUREMENT DFC_st.DFC_IVActrVltgSRCMin "" UWORD DFC_OneToOne 1 100 0.00 65535.00 FORMAT "%8.2" ECU_ADDRESS 0xD000CAC4 /end MEASUREMENT
/begin MEASUREMENT DFC_st.DFC_IVPSplyDCDC "" UWORD DFC_OneToOne 1 100 0.00 65535.00 FORMAT "%8.2" ECU_ADDRESS 0xD000CAC6 /end MEASUREMENT
/begin MEASUREMENT DFC_st.DFC_IVPSplyVltgSRCMax "" UWORD DFC_OneToOne 1 100 0.00 65535.00 FORMAT "%8.2" ECU_ADDRESS 0xD000CAC8 /end MEASUREMENT
/begin MEASUREMENT DFC_st.DFC_IVPSplyVltgSRCMin "" UWORD DFC_OneToOne 1 100 0.00 65535.00 FORMAT "%8.2" ECU_ADDRESS 0xD000CACA /end MEASUREMENT
/begin MEASUREMENT DFC_st.DFC_AFSOffsDrftMax "" UWORD DFC_OneToOne 1 100 0.00 65535.00 FORMAT "%8.2" ECU_ADDRESS 0xD000CACC /end MEASUREMENT
/begin MEASUREMENT DFC_st.DFC_AFSOffsDrftMin "" UWORD DFC_OneToOne 1 100 0.00 65535.00 FORMAT "%8.2" ECU_ADDRESS 0xD000CACE /end MEASUREMENT
/begin MEASUREMENT DFC_st.DFC_AFSSRCCorMax "" UWORD DFC_OneToOne 1 100 0.00 65535.00 FORMAT "%8.2" ECU_ADDRESS 0xD000CAD0 /end MEASUREMENT
/begin MEASUREMENT DFC_st.DFC_AFSSRCCorMin "" UWORD DFC_OneToOne 1 100 0.00 65535.00 FORMAT "%8.2" ECU_ADDRESS 0xD000CAD2 /end MEASUREMENT
/begin MEASUREMENT DFC_st.DFC_AFSSRCRawMax "" UWORD DFC_OneToOne 1 100 0.00 65535.00 FORMAT "%8.2" ECU_ADDRESS 0xD000CAD4 /end MEASUREMENT
/begin MEASUREMENT DFC_st.DFC_AFSSRCRawMin "" UWORD DFC_OneToOne 1 100 0.00 65535.00 FORMAT "%8.2" ECU_ADDRESS 0xD000CAD6 /end MEASUREMENT
/begin MEASUREMENT DFC_st.DFC_AFSSetyDrftMax "" UWORD DFC_OneToOne 1 100 0.00 65535.00 FORMAT "%8.2" ECU_ADDRESS 0xD000CAD8 /end MEASUREMENT
/begin MEASUREMENT DFC_st.DFC_AFSSetyDrftMin "" UWORD DFC_OneToOne 1 100 0.00 65535.00 FORMAT "%8.2" ECU_ADDRESS 0xD000CADA /end MEASUREMENT
/begin MEASUREMENT DFC_st.DFC_AirCClntPAnaSRCMax "" UWORD DFC_OneToOne 1 100 0.00 65535.00 FORMAT "%8.2" ECU_ADDRESS 0xD000CADC /end MEASUREMENT
/begin MEASUREMENT DFC_st.DFC_AirCClntPAnaSRCMin "" UWORD DFC_OneToOne 1 100 0.00 65535.00 FORMAT "%8.2" ECU_ADDRESS 0xD000CADE /end MEASUREMENT
/begin MEASUREMENT DFC_st.DFC_AirCClntPPerSRCMax "" UWORD DFC_OneToOne 1 100 0.00 65535.00 FORMAT "%8.2" ECU_ADDRESS 0xD000CAE0 /end MEASUREMENT
/begin MEASUREMENT DFC_st.DFC_AirCClntPPerSRCMin "" UWORD DFC_OneToOne 1 100 0.00 65535.00 FORMAT "%8.2" ECU_ADDRESS 0xD000CAE2 /end MEASUREMENT
/begin MEASUREMENT DFC_st.DFC_AirCClntPdcycSRCMax "" UWORD DFC_OneToOne 1 100 0.00 65535.00 FORMAT "%8.2" ECU_ADDRESS 0xD000CAE4 /end MEASUREMENT
/begin MEASUREMENT DFC_st.DFC_AirCClntPdcycSRCMin "" UWORD DFC_OneToOne 1 100 0.00 65535.00 FORMAT "%8.2" ECU_ADDRESS 0xD000CAE6 /end MEASUREMENT
/begin MEASUREMENT DFC_st.DFC_AirCCmprOL "" UWORD DFC_OneToOne 1 100 0.00 65535.00 FORMAT "%8.2" ECU_ADDRESS 0xD000CAE8 /end MEASUREMENT
/begin MEASUREMENT DFC_st.DFC_AirCCmprRedTrqOL "" UWORD DFC_OneToOne 1 100 0.00 65535.00 FORMAT "%8.2" ECU_ADDRESS 0xD000CAEA /end MEASUREMENT
/begin MEASUREMENT DFC_st.DFC_AirCCmprRedTrqSCB "" UWORD DFC_OneToOne 1 100 0.00 65535.00 FORMAT "%8.2" ECU_ADDRESS 0xD000CAEC /end MEASUREMENT
/begin MEASUREMENT DFC_st.DFC_AirCCmprRedTrqSCG "" UWORD DFC_OneToOne 1 100 0.00 65535.00 FORMAT "%8.2" ECU_ADDRESS 0xD000CAEE /end MEASUREMENT
/begin MEASUREMENT DFC_st.DFC_AirCCmprSCB "" UWORD DFC_OneToOne 1 100 0.00 65535.00 FORMAT "%8.2" ECU_ADDRESS 0xD000CAF0 /end MEASUREMENT
/begin MEASUREMENT DFC_st.DFC_AirCCmprSCG "" UWORD DFC_OneToOne 1 100 0.00 65535.00 FORMAT "%8.2" ECU_ADDRESS 0xD000CAF2 /end MEASUREMENT
/begin MEASUREMENT DFC_st.DFC_AirCSwtNpl "" UWORD DFC_OneToOne 1 100 0.00 65535.00 FORMAT "%8.2" ECU_ADDRESS 0xD000CAF4 /end MEASUREMENT
/begin MEASUREMENT DFC_st.DFC_AirCSwtSig "" UWORD DFC_OneToOne 1 100 0.00 65535.00 FORMAT "%8.2" ECU_ADDRESS 0xD000CAF6 /end MEASUREMENT
/begin MEASUREMENT DFC_st.DFC_BattUSRCMax "" UWORD DFC_OneToOne 1 100 0.00 65535.00 FORMAT "%8.2" ECU_ADDRESS 0xD000CAF8 /end MEASUREMENT
/begin MEASUREMENT DFC_st.DFC_BattUSRCMin "" UWORD DFC_OneToOne 1 100 0.00 65535.00 FORMAT "%8.2" ECU_ADDRESS 0xD000CAFA /end MEASUREMENT
/begin MEASUREMENT DFC_st.DFC_BrkNpl "" UWORD DFC_OneToOne 1 100 0.00 65535.00 FORMAT "%8.2" ECU_ADDRESS 0xD000CAFC /end MEASUREMENT
/begin MEASUREMENT DFC_st.DFC_BrkPSRCMax "" UWORD DFC_OneToOne 1 100 0.00 65535.00 FORMAT "%8.2" ECU_ADDRESS 0xD000CAFE /end MEASUREMENT
/begin MEASUREMENT DFC_st.DFC_BrkPSRCMin "" UWORD DFC_OneToOne 1 100 0.00 65535.00 FORMAT "%8.2" ECU_ADDRESS 0xD000CB00 /end MEASUREMENT
/begin MEASUREMENT DFC_st.DFC_BrkSig "" UWORD DFC_OneToOne 1 100 0.00 65535.00 FORMAT "%8.2" ECU_ADDRESS 0xD000CB02 /end MEASUREMENT
/begin MEASUREMENT DFC_st.DFC_CByVlvOL "" UWORD DFC_OneToOne 1 100 0.00 65535.00 FORMAT "%8.2" ECU_ADDRESS 0xD000CB04 /end MEASUREMENT
/begin MEASUREMENT DFC_st.DFC_CByVlvSCB "" UWORD DFC_OneToOne 1 100 0.00 65535.00 FORMAT "%8.2" ECU_ADDRESS 0xD000CB06 /end MEASUREMENT
/begin MEASUREMENT DFC_st.DFC_CByVlvSCG "" UWORD DFC_OneToOne 1 100 0.00 65535.00 FORMAT "%8.2" ECU_ADDRESS 0xD000CB08 /end MEASUREMENT
/begin MEASUREMENT DFC_st.DFC_CEngDsTSRCMax "" UWORD DFC_OneToOne 1 100 0.00 65535.00 FORMAT "%8.2" ECU_ADDRESS 0xD000CB0A /end MEASUREMENT
/begin MEASUREMENT DFC_st.DFC_CEngDsTSRCMin "" UWORD DFC_OneToOne 1 100 0.00 65535.00 FORMAT "%8.2" ECU_ADDRESS 0xD000CB0C /end MEASUREMENT
/begin MEASUREMENT DFC_st.DFC_CEngDsTSig "" UWORD DFC_OneToOne 1 100 0.00 65535.00 FORMAT "%8.2" ECU_ADDRESS 0xD000CB0E /end MEASUREMENT
/begin MEASUREMENT DFC_st.DFC_CEngUsTSRCMax "" UWORD DFC_OneToOne 1 100 0.00 65535.00 FORMAT "%8.2" ECU_ADDRESS 0xD000CB10 /end MEASUREMENT
/begin MEASUREMENT DFC_st.DFC_CEngUsTSRCMin "" UWORD DFC_OneToOne 1 100 0.00 65535.00 FORMAT "%8.2" ECU_ADDRESS 0xD000CB12 /end MEASUREMENT
/begin MEASUREMENT DFC_st.DFC_CThmstOL "" UWORD DFC_OneToOne 1 100 0.00 65535.00 FORMAT "%8.2" ECU_ADDRESS 0xD000CB14 /end MEASUREMENT
/begin MEASUREMENT DFC_st.DFC_CThmstSCB "" UWORD DFC_OneToOne 1 100 0.00 65535.00 FORMAT "%8.2" ECU_ADDRESS 0xD000CB16 /end MEASUREMENT
/begin MEASUREMENT DFC_st.DFC_CThmstSCG "" UWORD DFC_OneToOne 1 100 0.00 65535.00 FORMAT "%8.2" ECU_ADDRESS 0xD000CB18 /end MEASUREMENT
/begin MEASUREMENT DFC_st.DFC_ClthSig "" UWORD DFC_OneToOne 1 100 0.00 65535.00 FORMAT "%8.2" ECU_ADDRESS 0xD000CB1A /end MEASUREMENT
/begin MEASUREMENT DFC_st.DFC_ECBVlvOL "" UWORD DFC_OneToOne 1 100 0.00 65535.00 FORMAT "%8.2" ECU_ADDRESS 0xD000CB1C /end MEASUREMENT
/begin MEASUREMENT DFC_st.DFC_ECBVlvSCB "" UWORD DFC_OneToOne 1 100 0.00 65535.00 FORMAT "%8.2" ECU_ADDRESS 0xD000CB1E /end MEASUREMENT
/begin MEASUREMENT DFC_st.DFC_ECBVlvSCG "" UWORD DFC_OneToOne 1 100 0.00 65535.00 FORMAT "%8.2" ECU_ADDRESS 0xD000CB20 /end MEASUREMENT
/begin MEASUREMENT DFC_st.DFC_ECBVlvSRCMax "" UWORD DFC_OneToOne 1 100 0.00 65535.00 FORMAT "%8.2" ECU_ADDRESS 0xD000CB22 /end MEASUREMENT
/begin MEASUREMENT DFC_st.DFC_ECBVlvSRCMin "" UWORD DFC_OneToOne 1 100 0.00 65535.00 FORMAT "%8.2" ECU_ADDRESS 0xD000CB24 /end MEASUREMENT
/begin MEASUREMENT DFC_st.DFC_EGRVlvGovDvtMax "" UWORD DFC_OneToOne 1 100 0.00 65535.00 FORMAT "%8.2" ECU_ADDRESS 0xD000CB26 /end MEASUREMENT
/begin MEASUREMENT DFC_st.DFC_EGRVlvGovDvtMin "" UWORD DFC_OneToOne 1 100 0.00 65535.00 FORMAT "%8.2" ECU_ADDRESS 0xD000CB28 /end MEASUREMENT
/begin MEASUREMENT DFC_st.DFC_EGRVlvOL "" UWORD DFC_OneToOne 1 100 0.00 65535.00 FORMAT "%8.2" ECU_ADDRESS 0xD000CB2A /end MEASUREMENT
/begin MEASUREMENT DFC_st.DFC_EGRVlvSCB "" UWORD DFC_OneToOne 1 100 0.00 65535.00 FORMAT "%8.2" ECU_ADDRESS 0xD000CB2C /end MEASUREMENT
/begin MEASUREMENT DFC_st.DFC_EGRVlvSCG "" UWORD DFC_OneToOne 1 100 0.00 65535.00 FORMAT "%8.2" ECU_ADDRESS 0xD000CB2E /end MEASUREMENT
/begin MEASUREMENT DFC_st.DFC_EGRVlvSRCMax "" UWORD DFC_OneToOne 1 100 0.00 65535.00 FORMAT "%8.2" ECU_ADDRESS 0xD000CB30 /end MEASUREMENT
/begin MEASUREMENT DFC_st.DFC_EGRVlvSRCMin "" UWORD DFC_OneToOne 1 100 0.00 65535.00 FORMAT "%8.2" ECU_ADDRESS 0xD000CB32 /end MEASUREMENT
/begin MEASUREMENT DFC_st.DFC_EMDmpOL_0 "" UWORD DFC_OneToOne 1 100 0.00 65535.00 FORMAT "%8.2" ECU_ADDRESS 0xD000CB34 /end MEASUREMENT
/begin MEASUREMENT DFC_st.DFC_EMDmpOL_1 "" UWORD DFC_OneToOne 1 100 0.00 65535.00 FORMAT "%8.2" ECU_ADDRESS 0xD000CB36 /end MEASUREMENT
/begin MEASUREMENT DFC_st.DFC_EMDmpSCB_0 "" UWORD DFC_OneToOne 1 100 0.00 65535.00 FORMAT "%8.2" ECU_ADDRESS 0xD000CB38 /end MEASUREMENT
/begin MEASUREMENT DFC_st.DFC_EMDmpSCB_1 "" UWORD DFC_OneToOne 1 100 0.00 65535.00 FORMAT "%8.2" ECU_ADDRESS 0xD000CB3A /end MEASUREMENT
/begin MEASUREMENT DFC_st.DFC_EMDmpSCG_0 "" UWORD DFC_OneToOne 1 100 0.00 65535.00 FORMAT "%8.2" ECU_ADDRESS 0xD000CB3C /end MEASUREMENT
/begin MEASUREMENT DFC_st.DFC_EMDmpSCG_1 "" UWORD DFC_OneToOne 1 100 0.00 65535.00 FORMAT "%8.2" ECU_ADDRESS 0xD000CB3E /end MEASUREMENT
/begin MEASUREMENT DFC_st.DFC_EngStAOL "" UWORD DFC_OneToOne 1 100 0.00 65535.00 FORMAT "%8.2" ECU_ADDRESS 0xD000CB40 /end MEASUREMENT
/begin MEASUREMENT DFC_st.DFC_EngStASCB "" UWORD DFC_OneToOne 1 100 0.00 65535.00 FORMAT "%8.2" ECU_ADDRESS 0xD000CB42 /end MEASUREMENT
/begin MEASUREMENT DFC_st.DFC_EngStASCG "" UWORD DFC_OneToOne 1 100 0.00 65535.00 FORMAT "%8.2" ECU_ADDRESS 0xD000CB44 /end MEASUREMENT
/begin MEASUREMENT DFC_st.DFC_EnvPSRCMax "" UWORD DFC_OneToOne 1 100 0.00 65535.00 FORMAT "%8.2" ECU_ADDRESS 0xD000CB46 /end MEASUREMENT
/begin MEASUREMENT DFC_st.DFC_EnvPSRCMin "" UWORD DFC_OneToOne 1 100 0.00 65535.00 FORMAT "%8.2" ECU_ADDRESS 0xD000CB48 /end MEASUREMENT
/begin MEASUREMENT DFC_st.DFC_EnvPSig "" UWORD DFC_OneToOne 1 100 0.00 65535.00 FORMAT "%8.2" ECU_ADDRESS 0xD000CB4A /end MEASUREMENT
/begin MEASUREMENT DFC_st.DFC_EnvTSRCMax "" UWORD DFC_OneToOne 1 100 0.00 65535.00 FORMAT "%8.2" ECU_ADDRESS 0xD000CB4C /end MEASUREMENT
/begin MEASUREMENT DFC_st.DFC_EnvTSRCMin "" UWORD DFC_OneToOne 1 100 0.00 65535.00 FORMAT "%8.2" ECU_ADDRESS 0xD000CB4E /end MEASUREMENT
/begin MEASUREMENT DFC_st.DFC_FanOL "" UWORD DFC_OneToOne 1 100 0.00 65535.00 FORMAT "%8.2" ECU_ADDRESS 0xD000CB50 /end MEASUREMENT
/begin MEASUREMENT DFC_st.DFC_FanSCB "" UWORD DFC_OneToOne 1 100 0.00 65535.00 FORMAT "%8.2" ECU_ADDRESS 0xD000CB52 /end MEASUREMENT
/begin MEASUREMENT DFC_st.DFC_FlFltSig "" UWORD DFC_OneToOne 1 100 0.00 65535.00 FORMAT "%8.2" ECU_ADDRESS 0xD000CB54 /end MEASUREMENT
/begin MEASUREMENT DFC_st.DFC_FuelTSRCMax "" UWORD DFC_OneToOne 1 100 0.00 65535.00 FORMAT "%8.2" ECU_ADDRESS 0xD000CB56 /end MEASUREMENT
/begin MEASUREMENT DFC_st.DFC_FuelTSRCMin "" UWORD DFC_OneToOne 1 100 0.00 65535.00 FORMAT "%8.2" ECU_ADDRESS 0xD000CB58 /end MEASUREMENT
/begin MEASUREMENT DFC_st.DFC_GbxNPosPPerSRCMax "" UWORD DFC_OneToOne 1 100 0.00 65535.00 FORMAT "%8.2" ECU_ADDRESS 0xD000CB5A /end MEASUREMENT
/begin MEASUREMENT DFC_st.DFC_GbxNPosPPerSRCMin "" UWORD DFC_OneToOne 1 100 0.00 65535.00 FORMAT "%8.2" ECU_ADDRESS 0xD000CB5C /end MEASUREMENT
/begin MEASUREMENT DFC_st.DFC_GbxNPosPdcycSRCMax "" UWORD DFC_OneToOne 1 100 0.00 65535.00 FORMAT "%8.2" ECU_ADDRESS 0xD000CB5E /end MEASUREMENT
/begin MEASUREMENT DFC_st.DFC_GbxNPosPdcycSRCMin "" UWORD DFC_OneToOne 1 100 0.00 65535.00 FORMAT "%8.2" ECU_ADDRESS 0xD000CB60 /end MEASUREMENT
/begin MEASUREMENT DFC_st.DFC_GbxNPosSig "" UWORD DFC_OneToOne 1 100 0.00 65535.00 FORMAT "%8.2" ECU_ADDRESS 0xD000CB62 /end MEASUREMENT
/begin MEASUREMENT DFC_st.DFC_GlwPlgBSDOL_0 "" UWORD DFC_OneToOne 1 100 0.00 65535.00 FORMAT "%8.2" ECU_ADDRESS 0xD000CB64 /end MEASUREMENT
/begin MEASUREMENT DFC_st.DFC_GlwPlgBSDOL_1 "" UWORD DFC_OneToOne 1 100 0.00 65535.00 FORMAT "%8.2" ECU_ADDRESS 0xD000CB66 /end MEASUREMENT
/begin MEASUREMENT DFC_st.DFC_GlwPlgBSDOL_2 "" UWORD DFC_OneToOne 1 100 0.00 65535.00 FORMAT "%8.2" ECU_ADDRESS 0xD000CB68 /end MEASUREMENT
/begin MEASUREMENT DFC_st.DFC_GlwPlgBSDOL_3 "" UWORD DFC_OneToOne 1 100 0.00 65535.00 FORMAT "%8.2" ECU_ADDRESS 0xD000CB6A /end MEASUREMENT
/begin MEASUREMENT DFC_st.DFC_GlwPlgBSDOL_4 "" UWORD DFC_OneToOne 1 100 0.00 65535.00 FORMAT "%8.2" ECU_ADDRESS 0xD000CB6C /end MEASUREMENT
/begin MEASUREMENT DFC_st.DFC_GlwPlgBSDOL_5 "" UWORD DFC_OneToOne 1 100 0.00 65535.00 FORMAT "%8.2" ECU_ADDRESS 0xD000CB6E /end MEASUREMENT
/begin MEASUREMENT DFC_st.DFC_GlwPlgBSDOL_6 "" UWORD DFC_OneToOne 1 100 0.00 65535.00 FORMAT "%8.2" ECU_ADDRESS 0xD000CB70 /end MEASUREMENT
/begin MEASUREMENT DFC_st.DFC_GlwPlgBSDOL_7 "" UWORD DFC_OneToOne 1 100 0.00 65535.00 FORMAT "%8.2" ECU_ADDRESS 0xD000CB72 /end MEASUREMENT
/begin MEASUREMENT DFC_st.DFC_GlwPlgBSDOT_0 "" UWORD DFC_OneToOne 1 100 0.00 65535.00 FORMAT "%8.2" ECU_ADDRESS 0xD000CB74 /end MEASUREMENT
/begin MEASUREMENT DFC_st.DFC_GlwPlgBSDOT_1 "" UWORD DFC_OneToOne 1 100 0.00 65535.00 FORMAT "%8.2" ECU_ADDRESS 0xD000CB76 /end MEASUREMENT
/begin MEASUREMENT DFC_st.DFC_GlwPlgBSDOT_2 "" UWORD DFC_OneToOne 1 100 0.00 65535.00 FORMAT "%8.2" ECU_ADDRESS 0xD000CB78 /end MEASUREMENT
/begin MEASUREMENT DFC_st.DFC_GlwPlgBSDOT_3 "" UWORD DFC_OneToOne 1 100 0.00 65535.00 FORMAT "%8.2" ECU_ADDRESS 0xD000CB7A /end MEASUREMENT
/begin MEASUREMENT DFC_st.DFC_GlwPlgBSDOT_4 "" UWORD DFC_OneToOne 1 100 0.00 65535.00 FORMAT "%8.2" ECU_ADDRESS 0xD000CB7C /end MEASUREMENT
/begin MEASUREMENT DFC_st.DFC_GlwPlgBSDOT_5 "" UWORD DFC_OneToOne 1 100 0.00 65535.00 FORMAT "%8.2" ECU_ADDRESS 0xD000CB7E /end MEASUREMENT
/begin MEASUREMENT DFC_st.DFC_GlwPlgBSDOT_6 "" UWORD DFC_OneToOne 1 100 0.00 65535.00 FORMAT "%8.2" ECU_ADDRESS 0xD000CB80 /end MEASUREMENT
/begin MEASUREMENT DFC_st.DFC_GlwPlgBSDOT_7 "" UWORD DFC_OneToOne 1 100 0.00 65535.00 FORMAT "%8.2" ECU_ADDRESS 0xD000CB82 /end MEASUREMENT
/begin MEASUREMENT DFC_st.DFC_GlwPlgBSDSC_0 "" UWORD DFC_OneToOne 1 100 0.00 65535.00 FORMAT "%8.2" ECU_ADDRESS 0xD000CB84 /end MEASUREMENT
/begin MEASUREMENT DFC_st.DFC_GlwPlgBSDSC_1 "" UWORD DFC_OneToOne 1 100 0.00 65535.00 FORMAT "%8.2" ECU_ADDRESS 0xD000CB86 /end MEASUREMENT
/begin MEASUREMENT DFC_st.DFC_GlwPlgBSDSC_2 "" UWORD DFC_OneToOne 1 100 0.00 65535.00 FORMAT "%8.2" ECU_ADDRESS 0xD000CB88 /end MEASUREMENT
/begin MEASUREMENT DFC_st.DFC_GlwPlgBSDSC_3 "" UWORD DFC_OneToOne 1 100 0.00 65535.00 FORMAT "%8.2" ECU_ADDRESS 0xD000CB8A /end MEASUREMENT
/begin MEASUREMENT DFC_st.DFC_GlwPlgBSDSC_4 "" UWORD DFC_OneToOne 1 100 0.00 65535.00 FORMAT "%8.2" ECU_ADDRESS 0xD000CB8C /end MEASUREMENT
/begin MEASUREMENT DFC_st.DFC_GlwPlgBSDSC_5 "" UWORD DFC_OneToOne 1 100 0.00 65535.00 FORMAT "%8.2" ECU_ADDRESS 0xD000CB8E /end MEASUREMENT
/begin MEASUREMENT DFC_st.DFC_GlwPlgBSDSC_6 "" UWORD DFC_OneToOne 1 100 0.00 65535.00 FORMAT "%8.2" ECU_ADDRESS 0xD000CB90 /end MEASUREMENT
/begin MEASUREMENT DFC_st.DFC_GlwPlgBSDSC_7 "" UWORD DFC_OneToOne 1 100 0.00 65535.00 FORMAT "%8.2" ECU_ADDRESS 0xD000CB92 /end MEASUREMENT
/begin MEASUREMENT DFC_st.DFC_GlwPlgComErr "" UWORD DFC_OneToOne 1 100 0.00 65535.00 FORMAT "%8.2" ECU_ADDRESS 0xD000CB94 /end MEASUREMENT
/begin MEASUREMENT DFC_st.DFC_InjVlvPresMin "" UWORD DFC_OneToOne 1 100 0.00 65535.00 FORMAT "%8.2" ECU_ADDRESS 0xD000CB96 /end MEASUREMENT
/begin MEASUREMENT DFC_st.DFC_LSUCircNernstMax_0 "" UWORD DFC_OneToOne 1 100 0.00 65535.00 FORMAT "%8.2" ECU_ADDRESS 0xD000CB98 /end MEASUREMENT
/begin MEASUREMENT DFC_st.DFC_LSUCircNernstMax_1 "" UWORD DFC_OneToOne 1 100 0.00 65535.00 FORMAT "%8.2" ECU_ADDRESS 0xD000CB9A /end MEASUREMENT
/begin MEASUREMENT DFC_st.DFC_LSUCircNernstMax_2 "" UWORD DFC_OneToOne 1 100 0.00 65535.00 FORMAT "%8.2" ECU_ADDRESS 0xD000CB9C /end MEASUREMENT
/begin MEASUREMENT DFC_st.DFC_LSUCircNernstMax_3 "" UWORD DFC_OneToOne 1 100 0.00 65535.00 FORMAT "%8.2" ECU_ADDRESS 0xD000CB9E /end MEASUREMENT
/begin MEASUREMENT DFC_st.DFC_LSUCircNernstMin_0 "" UWORD DFC_OneToOne 1 100 0.00 65535.00 FORMAT "%8.2" ECU_ADDRESS 0xD000CBA0 /end MEASUREMENT
/begin MEASUREMENT DFC_st.DFC_LSUCircNernstMin_1 "" UWORD DFC_OneToOne 1 100 0.00 65535.00 FORMAT "%8.2" ECU_ADDRESS 0xD000CBA2 /end MEASUREMENT
/begin MEASUREMENT DFC_st.DFC_LSUCircNernstMin_2 "" UWORD DFC_OneToOne 1 100 0.00 65535.00 FORMAT "%8.2" ECU_ADDRESS 0xD000CBA4 /end MEASUREMENT
/begin MEASUREMENT DFC_st.DFC_LSUCircNernstMin_3 "" UWORD DFC_OneToOne 1 100 0.00 65535.00 FORMAT "%8.2" ECU_ADDRESS 0xD000CBA6 /end MEASUREMENT
/begin MEASUREMENT DFC_st.DFC_LSUCircNernstSig_0 "" UWORD DFC_OneToOne 1 100 0.00 65535.00 FORMAT "%8.2" ECU_ADDRESS 0xD000CBA8 /end MEASUREMENT
/begin MEASUREMENT DFC_st.DFC_LSUCircNernstSig_1 "" UWORD DFC_OneToOne 1 100 0.00 65535.00 FORMAT "%8.2" ECU_ADDRESS 0xD000CBAA /end MEASUREMENT
/begin MEASUREMENT DFC_st.DFC_LSUCircNernstSig_2 "" UWORD DFC_OneToOne 1 100 0.00 65535.00 FORMAT "%8.2" ECU_ADDRESS 0xD000CBAC /end MEASUREMENT
/begin MEASUREMENT DFC_st.DFC_LSUCircNernstSig_3 "" UWORD DFC_OneToOne 1 100 0.00 65535.00 FORMAT "%8.2" ECU_ADDRESS 0xD000CBAE /end MEASUREMENT
/begin MEASUREMENT DFC_st.DFC_LSUCircPmpCurMax_0 "" UWORD DFC_OneToOne 1 100 0.00 65535.00 FORMAT "%8.2" ECU_ADDRESS 0xD000CBB0 /end MEASUREMENT
/begin MEASUREMENT DFC_st.DFC_LSUCircPmpCurMax_1 "" UWORD DFC_OneToOne 1 100 0.00 65535.00 FORMAT "%8.2" ECU_ADDRESS 0xD000CBB2 /end MEASUREMENT
/begin MEASUREMENT DFC_st.DFC_LSUCircPmpCurMax_2 "" UWORD DFC_OneToOne 1 100 0.00 65535.00 FORMAT "%8.2" ECU_ADDRESS 0xD000CBB4 /end MEASUREMENT
/begin MEASUREMENT DFC_st.DFC_LSUCircPmpCurMax_3 "" UWORD DFC_OneToOne 1 100 0.00 65535.00 FORMAT "%8.2" ECU_ADDRESS 0xD000CBB6 /end MEASUREMENT
/begin MEASUREMENT DFC_st.DFC_LSUCircPmpCurMin_0 "" UWORD DFC_OneToOne 1 100 0.00 65535.00 FORMAT "%8.2" ECU_ADDRESS 0xD000CBB8 /end MEASUREMENT
/begin MEASUREMENT DFC_st.DFC_LSUCircPmpCurMin_1 "" UWORD DFC_OneToOne 1 100 0.00 65535.00 FORMAT "%8.2" ECU_ADDRESS 0xD000CBBA /end MEASUREMENT
/begin MEASUREMENT DFC_st.DFC_LSUCircPmpCurMin_2 "" UWORD DFC_OneToOne 1 100 0.00 65535.00 FORMAT "%8.2" ECU_ADDRESS 0xD000CBBC /end MEASUREMENT
/begin MEASUREMENT DFC_st.DFC_LSUCircPmpCurMin_3 "" UWORD DFC_OneToOne 1 100 0.00 65535.00 FORMAT "%8.2" ECU_ADDRESS 0xD000CBBE /end MEASUREMENT
/begin MEASUREMENT DFC_st.DFC_LSUCircPmpCurSig_0 "" UWORD DFC_OneToOne 1 100 0.00 65535.00 FORMAT "%8.2" ECU_ADDRESS 0xD000CBC0 /end MEASUREMENT
/begin MEASUREMENT DFC_st.DFC_LSUCircPmpCurSig_1 "" UWORD DFC_OneToOne 1 100 0.00 65535.00 FORMAT "%8.2" ECU_ADDRESS 0xD000CBC2 /end MEASUREMENT
/begin MEASUREMENT DFC_st.DFC_LSUCircPmpCurSig_2 "" UWORD DFC_OneToOne 1 100 0.00 65535.00 FORMAT "%8.2" ECU_ADDRESS 0xD000CBC4 /end MEASUREMENT
/begin MEASUREMENT DFC_st.DFC_LSUCircPmpCurSig_3 "" UWORD DFC_OneToOne 1 100 0.00 65535.00 FORMAT "%8.2" ECU_ADDRESS 0xD000CBC6 /end MEASUREMENT
/begin MEASUREMENT DFC_st.DFC_LSUCircVirtGndMax_0 "" UWORD DFC_OneToOne 1 100 0.00 65535.00 FORMAT "%8.2" ECU_ADDRESS 0xD000CBC8 /end MEASUREMENT
/begin MEASUREMENT DFC_st.DFC_LSUCircVirtGndMax_1 "" UWORD DFC_OneToOne 1 100 0.00 65535.00 FORMAT "%8.2" ECU_ADDRESS 0xD000CBCA /end MEASUREMENT
/begin MEASUREMENT DFC_st.DFC_LSUCircVirtGndMax_2 "" UWORD DFC_OneToOne 1 100 0.00 65535.00 FORMAT "%8.2" ECU_ADDRESS 0xD000CBCC /end MEASUREMENT
/begin MEASUREMENT DFC_st.DFC_LSUCircVirtGndMax_3 "" UWORD DFC_OneToOne 1 100 0.00 65535.00 FORMAT "%8.2" ECU_ADDRESS 0xD000CBCE /end MEASUREMENT
/begin MEASUREMENT DFC_st.DFC_LSUCircVirtGndMin_0 "" UWORD DFC_OneToOne 1 100 0.00 65535.00 FORMAT "%8.2" ECU_ADDRESS 0xD000CBD0 /end MEASUREMENT
/begin MEASUREMENT DFC_st.DFC_LSUCircVirtGndMin_1 "" UWORD DFC_OneToOne 1 100 0.00 65535.00 FORMAT "%8.2" ECU_ADDRESS 0xD000CBD2 /end MEASUREMENT
/begin MEASUREMENT DFC_st.DFC_LSUCircVirtGndMin_2 "" UWORD DFC_OneToOne 1 100 0.00 65535.00 FORMAT "%8.2" ECU_ADDRESS 0xD000CBD4 /end MEASUREMENT
/begin MEASUREMENT DFC_st.DFC_LSUCircVirtGndMin_3 "" UWORD DFC_OneToOne 1 100 0.00 65535.00 FORMAT "%8.2" ECU_ADDRESS 0xD000CBD6 /end MEASUREMENT
/begin MEASUREMENT DFC_st.DFC_LSUCircVirtGndSig_0 "" UWORD DFC_OneToOne 1 100 0.00 65535.00 FORMAT "%8.2" ECU_ADDRESS 0xD000CBD8 /end MEASUREMENT
/begin MEASUREMENT DFC_st.DFC_LSUCircVirtGndSig_1 "" UWORD DFC_OneToOne 1 100 0.00 65535.00 FORMAT "%8.2" ECU_ADDRESS 0xD000CBDA /end MEASUREMENT
/begin MEASUREMENT DFC_st.DFC_LSUCircVirtGndSig_2 "" UWORD DFC_OneToOne 1 100 0.00 65535.00 FORMAT "%8.2" ECU_ADDRESS 0xD000CBDC /end MEASUREMENT
/begin MEASUREMENT DFC_st.DFC_LSUCircVirtGndSig_3 "" UWORD DFC_OneToOne 1 100 0.00 65535.00 FORMAT "%8.2" ECU_ADDRESS 0xD000CBDE /end MEASUREMENT
/begin MEASUREMENT DFC_st.DFC_LSUHtrMax_0 "" UWORD DFC_OneToOne 1 100 0.00 65535.00 FORMAT "%8.2" ECU_ADDRESS 0xD000CBE0 /end MEASUREMENT
/begin MEASUREMENT DFC_st.DFC_LSUHtrMax_1 "" UWORD DFC_OneToOne 1 100 0.00 65535.00 FORMAT "%8.2" ECU_ADDRESS 0xD000CBE2 /end MEASUREMENT
/begin MEASUREMENT DFC_st.DFC_LSUHtrMax_2 "" UWORD DFC_OneToOne 1 100 0.00 65535.00 FORMAT "%8.2" ECU_ADDRESS 0xD000CBE4 /end MEASUREMENT
/begin MEASUREMENT DFC_st.DFC_LSUHtrMax_3 "" UWORD DFC_OneToOne 1 100 0.00 65535.00 FORMAT "%8.2" ECU_ADDRESS 0xD000CBE6 /end MEASUREMENT
/begin MEASUREMENT DFC_st.DFC_LSUHtrMin_0 "" UWORD DFC_OneToOne 1 100 0.00 65535.00 FORMAT "%8.2" ECU_ADDRESS 0xD000CBE8 /end MEASUREMENT
/begin MEASUREMENT DFC_st.DFC_LSUHtrMin_1 "" UWORD DFC_OneToOne 1 100 0.00 65535.00 FORMAT "%8.2" ECU_ADDRESS 0xD000CBEA /end MEASUREMENT
/begin MEASUREMENT DFC_st.DFC_LSUHtrMin_2 "" UWORD DFC_OneToOne 1 100 0.00 65535.00 FORMAT "%8.2" ECU_ADDRESS 0xD000CBEC /end MEASUREMENT
/begin MEASUREMENT DFC_st.DFC_LSUHtrMin_3 "" UWORD DFC_OneToOne 1 100 0.00 65535.00 FORMAT "%8.2" ECU_ADDRESS 0xD000CBEE /end MEASUREMENT
/begin MEASUREMENT DFC_st.DFC_LSUHtrSig_0 "" UWORD DFC_OneToOne 1 100 0.00 65535.00 FORMAT "%8.2" ECU_ADDRESS 0xD000CBF0 /end MEASUREMENT
/begin MEASUREMENT DFC_st.DFC_LSUHtrSig_1 "" UWORD DFC_OneToOne 1 100 0.00 65535.00 FORMAT "%8.2" ECU_ADDRESS 0xD000CBF2 /end MEASUREMENT
/begin MEASUREMENT DFC_st.DFC_LSUHtrSig_2 "" UWORD DFC_OneToOne 1 100 0.00 65535.00 FORMAT "%8.2" ECU_ADDRESS 0xD000CBF4 /end MEASUREMENT
/begin MEASUREMENT DFC_st.DFC_LSUHtrSig_3 "" UWORD DFC_OneToOne 1 100 0.00 65535.00 FORMAT "%8.2" ECU_ADDRESS 0xD000CBF6 /end MEASUREMENT
/begin MEASUREMENT DFC_st.DFC_LSUO2Max_0 "" UWORD DFC_OneToOne 1 100 0.00 65535.00 FORMAT "%8.2" ECU_ADDRESS 0xD000CBF8 /end MEASUREMENT
/begin MEASUREMENT DFC_st.DFC_LSUO2Max_1 "" UWORD DFC_OneToOne 1 100 0.00 65535.00 FORMAT "%8.2" ECU_ADDRESS 0xD000CBFA /end MEASUREMENT
/begin MEASUREMENT DFC_st.DFC_LSUO2Max_2 "" UWORD DFC_OneToOne 1 100 0.00 65535.00 FORMAT "%8.2" ECU_ADDRESS 0xD000CBFC /end MEASUREMENT
/begin MEASUREMENT DFC_st.DFC_LSUO2Max_3 "" UWORD DFC_OneToOne 1 100 0.00 65535.00 FORMAT "%8.2" ECU_ADDRESS 0xD000CBFE /end MEASUREMENT
/begin MEASUREMENT DFC_st.DFC_LSUO2Min_0 "" UWORD DFC_OneToOne 1 100 0.00 65535.00 FORMAT "%8.2" ECU_ADDRESS 0xD000CC00 /end MEASUREMENT
/begin MEASUREMENT DFC_st.DFC_LSUO2Min_1 "" UWORD DFC_OneToOne 1 100 0.00 65535.00 FORMAT "%8.2" ECU_ADDRESS 0xD000CC02 /end MEASUREMENT
/begin MEASUREMENT DFC_st.DFC_LSUO2Min_2 "" UWORD DFC_OneToOne 1 100 0.00 65535.00 FORMAT "%8.2" ECU_ADDRESS 0xD000CC04 /end MEASUREMENT
/begin MEASUREMENT DFC_st.DFC_LSUO2Min_3 "" UWORD DFC_OneToOne 1 100 0.00 65535.00 FORMAT "%8.2" ECU_ADDRESS 0xD000CC06 /end MEASUREMENT
/begin MEASUREMENT DFC_st.DFC_LSUSPIBattLowMin_0 "" UWORD DFC_OneToOne 1 100 0.00 65535.00 FORMAT "%8.2" ECU_ADDRESS 0xD000CC08 /end MEASUREMENT
/begin MEASUREMENT DFC_st.DFC_LSUSPIBattLowMin_1 "" UWORD DFC_OneToOne 1 100 0.00 65535.00 FORMAT "%8.2" ECU_ADDRESS 0xD000CC0A /end MEASUREMENT
/begin MEASUREMENT DFC_st.DFC_LSUSPIBattLowMin_2 "" UWORD DFC_OneToOne 1 100 0.00 65535.00 FORMAT "%8.2" ECU_ADDRESS 0xD000CC0C /end MEASUREMENT
/begin MEASUREMENT DFC_st.DFC_LSUSPIBattLowMin_3 "" UWORD DFC_OneToOne 1 100 0.00 65535.00 FORMAT "%8.2" ECU_ADDRESS 0xD000CC0E /end MEASUREMENT
/begin MEASUREMENT DFC_st.DFC_LSUSPISig_0 "" UWORD DFC_OneToOne 1 100 0.00 65535.00 FORMAT "%8.2" ECU_ADDRESS 0xD000CC10 /end MEASUREMENT
/begin MEASUREMENT DFC_st.DFC_LSUSPISig_1 "" UWORD DFC_OneToOne 1 100 0.00 65535.00 FORMAT "%8.2" ECU_ADDRESS 0xD000CC12 /end MEASUREMENT
/begin MEASUREMENT DFC_st.DFC_LSUSPISig_2 "" UWORD DFC_OneToOne 1 100 0.00 65535.00 FORMAT "%8.2" ECU_ADDRESS 0xD000CC14 /end MEASUREMENT
/begin MEASUREMENT DFC_st.DFC_LSUSPISig_3 "" UWORD DFC_OneToOne 1 100 0.00 65535.00 FORMAT "%8.2" ECU_ADDRESS 0xD000CC16 /end MEASUREMENT
/begin MEASUREMENT DFC_st.DFC_LSUtExcMax_0 "" UWORD DFC_OneToOne 1 100 0.00 65535.00 FORMAT "%8.2" ECU_ADDRESS 0xD000CC18 /end MEASUREMENT
/begin MEASUREMENT DFC_st.DFC_LSUtExcMax_1 "" UWORD DFC_OneToOne 1 100 0.00 65535.00 FORMAT "%8.2" ECU_ADDRESS 0xD000CC1A /end MEASUREMENT
/begin MEASUREMENT DFC_st.DFC_LSUtExcMax_2 "" UWORD DFC_OneToOne 1 100 0.00 65535.00 FORMAT "%8.2" ECU_ADDRESS 0xD000CC1C /end MEASUREMENT
/begin MEASUREMENT DFC_st.DFC_LSUtExcMax_3 "" UWORD DFC_OneToOne 1 100 0.00 65535.00 FORMAT "%8.2" ECU_ADDRESS 0xD000CC1E /end MEASUREMENT
/begin MEASUREMENT DFC_st.DFC_LSUtExcMin_0 "" UWORD DFC_OneToOne 1 100 0.00 65535.00 FORMAT "%8.2" ECU_ADDRESS 0xD000CC20 /end MEASUREMENT
/begin MEASUREMENT DFC_st.DFC_LSUtExcMin_1 "" UWORD DFC_OneToOne 1 100 0.00 65535.00 FORMAT "%8.2" ECU_ADDRESS 0xD000CC22 /end MEASUREMENT
/begin MEASUREMENT DFC_st.DFC_LSUtExcMin_2 "" UWORD DFC_OneToOne 1 100 0.00 65535.00 FORMAT "%8.2" ECU_ADDRESS 0xD000CC24 /end MEASUREMENT
/begin MEASUREMENT DFC_st.DFC_LSUtExcMin_3 "" UWORD DFC_OneToOne 1 100 0.00 65535.00 FORMAT "%8.2" ECU_ADDRESS 0xD000CC26 /end MEASUREMENT
/begin MEASUREMENT DFC_st.DFC_MILOL "" UWORD DFC_OneToOne 1 100 0.00 65535.00 FORMAT "%8.2" ECU_ADDRESS 0xD000CC28 /end MEASUREMENT
/begin MEASUREMENT DFC_st.DFC_MILSCB "" UWORD DFC_OneToOne 1 100 0.00 65535.00 FORMAT "%8.2" ECU_ADDRESS 0xD000CC2A /end MEASUREMENT
/begin MEASUREMENT DFC_st.DFC_MILSCG "" UWORD DFC_OneToOne 1 100 0.00 65535.00 FORMAT "%8.2" ECU_ADDRESS 0xD000CC2C /end MEASUREMENT
/begin MEASUREMENT DFC_st.DFC_MeUnSCG "" UWORD DFC_OneToOne 1 100 0.00 65535.00 FORMAT "%8.2" ECU_ADDRESS 0xD000CC2E /end MEASUREMENT
/begin MEASUREMENT DFC_st.DFC_NplHsChngPPFltDiff "" UWORD DFC_OneToOne 1 100 0.00 65535.00 FORMAT "%8.2" ECU_ADDRESS 0xD000CC30 /end MEASUREMENT
/begin MEASUREMENT DFC_st.DFC_NplPAirFltDs "" UWORD DFC_OneToOne 1 100 0.00 65535.00 FORMAT "%8.2" ECU_ADDRESS 0xD000CC32 /end MEASUREMENT
/begin MEASUREMENT DFC_st.DFC_NplTPFltUs "" UWORD DFC_OneToOne 1 100 0.00 65535.00 FORMAT "%8.2" ECU_ADDRESS 0xD000CC34 /end MEASUREMENT
/begin MEASUREMENT DFC_st.DFC_OilComErr "" UWORD DFC_OneToOne 1 100 0.00 65535.00 FORMAT "%8.2" ECU_ADDRESS 0xD000CC36 /end MEASUREMENT
/begin MEASUREMENT DFC_st.DFC_OilPLmpOL "" UWORD DFC_OneToOne 1 100 0.00 65535.00 FORMAT "%8.2" ECU_ADDRESS 0xD000CC38 /end MEASUREMENT
/begin MEASUREMENT DFC_st.DFC_OilPLmpSCB "" UWORD DFC_OneToOne 1 100 0.00 65535.00 FORMAT "%8.2" ECU_ADDRESS 0xD000CC3A /end MEASUREMENT
/begin MEASUREMENT DFC_st.DFC_OilPLmpSCG "" UWORD DFC_OneToOne 1 100 0.00 65535.00 FORMAT "%8.2" ECU_ADDRESS 0xD000CC3C /end MEASUREMENT
/begin MEASUREMENT DFC_st.DFC_OilPNpl "" UWORD DFC_OneToOne 1 100 0.00 65535.00 FORMAT "%8.2" ECU_ADDRESS 0xD000CC3E /end MEASUREMENT
/begin MEASUREMENT DFC_st.DFC_OilTNpl "" UWORD DFC_OneToOne 1 100 0.00 65535.00 FORMAT "%8.2" ECU_ADDRESS 0xD000CC40 /end MEASUREMENT
/begin MEASUREMENT DFC_st.DFC_OilTSRCMax "" UWORD DFC_OneToOne 1 100 0.00 65535.00 FORMAT "%8.2" ECU_ADDRESS 0xD000CC42 /end MEASUREMENT
/begin MEASUREMENT DFC_st.DFC_OilTSRCMin "" UWORD DFC_OneToOne 1 100 0.00 65535.00 FORMAT "%8.2" ECU_ADDRESS 0xD000CC44 /end MEASUREMENT
/begin MEASUREMENT DFC_st.DFC_PCACDsEnvPPls "" UWORD DFC_OneToOne 1 100 0.00 65535.00 FORMAT "%8.2" ECU_ADDRESS 0xD000CC46 /end MEASUREMENT
/begin MEASUREMENT DFC_st.DFC_PCACDsSRCMax "" UWORD DFC_OneToOne 1 100 0.00 65535.00 FORMAT "%8.2" ECU_ADDRESS 0xD000CC48 /end MEASUREMENT
/begin MEASUREMENT DFC_st.DFC_PCACDsSRCMin "" UWORD DFC_OneToOne 1 100 0.00 65535.00 FORMAT "%8.2" ECU_ADDRESS 0xD000CC4A /end MEASUREMENT
/begin MEASUREMENT DFC_st.DFC_PCVSCG "" UWORD DFC_OneToOne 1 100 0.00 65535.00 FORMAT "%8.2" ECU_ADDRESS 0xD000CC4C /end MEASUREMENT
/begin MEASUREMENT DFC_st.DFC_PFltCharPDiffMin "" UWORD DFC_OneToOne 1 100 0.00 65535.00 FORMAT "%8.2" ECU_ADDRESS 0xD000CC4E /end MEASUREMENT
/begin MEASUREMENT DFC_st.DFC_PFltDstrMin "" UWORD DFC_OneToOne 1 100 0.00 65535.00 FORMAT "%8.2" ECU_ADDRESS 0xD000CC50 /end MEASUREMENT
/begin MEASUREMENT DFC_st.DFC_PFltEngPrt "" UWORD DFC_OneToOne 1 100 0.00 65535.00 FORMAT "%8.2" ECU_ADDRESS 0xD000CC52 /end MEASUREMENT
/begin MEASUREMENT DFC_st.DFC_PFltLmpOL "" UWORD DFC_OneToOne 1 100 0.00 65535.00 FORMAT "%8.2" ECU_ADDRESS 0xD000CC54 /end MEASUREMENT
/begin MEASUREMENT DFC_st.DFC_PFltLmpSCB "" UWORD DFC_OneToOne 1 100 0.00 65535.00 FORMAT "%8.2" ECU_ADDRESS 0xD000CC56 /end MEASUREMENT
/begin MEASUREMENT DFC_st.DFC_PFltLmpSCG "" UWORD DFC_OneToOne 1 100 0.00 65535.00 FORMAT "%8.2" ECU_ADDRESS 0xD000CC58 /end MEASUREMENT
/begin MEASUREMENT DFC_st.DFC_PFltRgnPerm "" UWORD DFC_OneToOne 1 100 0.00 65535.00 FORMAT "%8.2" ECU_ADDRESS 0xD000CC5A /end MEASUREMENT
/begin MEASUREMENT DFC_st.DFC_PFltSRCMaxFlwRstn "" UWORD DFC_OneToOne 1 100 0.00 65535.00 FORMAT "%8.2" ECU_ADDRESS 0xD000CC5C /end MEASUREMENT
/begin MEASUREMENT DFC_st.DFC_PFltSRCMinFlwRstn "" UWORD DFC_OneToOne 1 100 0.00 65535.00 FORMAT "%8.2" ECU_ADDRESS 0xD000CC5E /end MEASUREMENT
/begin MEASUREMENT DFC_st.DFC_PFltSotMsDvtMax "" UWORD DFC_OneToOne 1 100 0.00 65535.00 FORMAT "%8.2" ECU_ADDRESS 0xD000CC60 /end MEASUREMENT
/begin MEASUREMENT DFC_st.DFC_PFltSotMsDvtMin "" UWORD DFC_OneToOne 1 100 0.00 65535.00 FORMAT "%8.2" ECU_ADDRESS 0xD000CC62 /end MEASUREMENT
/begin MEASUREMENT DFC_st.DFC_PFltSotMsMax "" UWORD DFC_OneToOne 1 100 0.00 65535.00 FORMAT "%8.2" ECU_ADDRESS 0xD000CC64 /end MEASUREMENT
/begin MEASUREMENT DFC_st.DFC_PSPOL "" UWORD DFC_OneToOne 1 100 0.00 65535.00 FORMAT "%8.2" ECU_ADDRESS 0xD000CC66 /end MEASUREMENT
/begin MEASUREMENT DFC_st.DFC_PSPSCB "" UWORD DFC_OneToOne 1 100 0.00 65535.00 FORMAT "%8.2" ECU_ADDRESS 0xD000CC68 /end MEASUREMENT
/begin MEASUREMENT DFC_st.DFC_PSPSCG "" UWORD DFC_OneToOne 1 100 0.00 65535.00 FORMAT "%8.2" ECU_ADDRESS 0xD000CC6A /end MEASUREMENT
/begin MEASUREMENT DFC_st.DFC_SRCHighAPP1 "" UWORD DFC_OneToOne 1 100 0.00 65535.00 FORMAT "%8.2" ECU_ADDRESS 0xD000CC6C /end MEASUREMENT
/begin MEASUREMENT DFC_st.DFC_SRCHighAPP2 "" UWORD DFC_OneToOne 1 100 0.00 65535.00 FORMAT "%8.2" ECU_ADDRESS 0xD000CC6E /end MEASUREMENT
/begin MEASUREMENT DFC_st.DFC_SRCLowAPP1 "" UWORD DFC_OneToOne 1 100 0.00 65535.00 FORMAT "%8.2" ECU_ADDRESS 0xD000CC70 /end MEASUREMENT
/begin MEASUREMENT DFC_st.DFC_SRCLowAPP2 "" UWORD DFC_OneToOne 1 100 0.00 65535.00 FORMAT "%8.2" ECU_ADDRESS 0xD000CC72 /end MEASUREMENT
/begin MEASUREMENT DFC_st.DFC_SRCMaxPAirFltDs "" UWORD DFC_OneToOne 1 100 0.00 65535.00 FORMAT "%8.2" ECU_ADDRESS 0xD000CC74 /end MEASUREMENT
/begin MEASUREMENT DFC_st.DFC_SRCMaxPPFltUs "" UWORD DFC_OneToOne 1 100 0.00 65535.00 FORMAT "%8.2" ECU_ADDRESS 0xD000CC76 /end MEASUREMENT
/begin MEASUREMENT DFC_st.DFC_SRCMaxTECU "" UWORD DFC_OneToOne 1 100 0.00 65535.00 FORMAT "%8.2" ECU_ADDRESS 0xD000CC78 /end MEASUREMENT
/begin MEASUREMENT DFC_st.DFC_SRCMaxTOxiCatUs "" UWORD DFC_OneToOne 1 100 0.00 65535.00 FORMAT "%8.2" ECU_ADDRESS 0xD000CC7A /end MEASUREMENT
/begin MEASUREMENT DFC_st.DFC_SRCMaxTPFltUs "" UWORD DFC_OneToOne 1 100 0.00 65535.00 FORMAT "%8.2" ECU_ADDRESS 0xD000CC7C /end MEASUREMENT
/begin MEASUREMENT DFC_st.DFC_SRCMinPAirFltDs "" UWORD DFC_OneToOne 1 100 0.00 65535.00 FORMAT "%8.2" ECU_ADDRESS 0xD000CC7E /end MEASUREMENT
/begin MEASUREMENT DFC_st.DFC_SRCMinPPFltUs "" UWORD DFC_OneToOne 1 100 0.00 65535.00 FORMAT "%8.2" ECU_ADDRESS 0xD000CC80 /end MEASUREMENT
/begin MEASUREMENT DFC_st.DFC_SRCMinTECU "" UWORD DFC_OneToOne 1 100 0.00 65535.00 FORMAT "%8.2" ECU_ADDRESS 0xD000CC82 /end MEASUREMENT
/begin MEASUREMENT DFC_st.DFC_SRCMinTOxiCatUs "" UWORD DFC_OneToOne 1 100 0.00 65535.00 FORMAT "%8.2" ECU_ADDRESS 0xD000CC84 /end MEASUREMENT
/begin MEASUREMENT DFC_st.DFC_SRCMinTPFltUs "" UWORD DFC_OneToOne 1 100 0.00 65535.00 FORMAT "%8.2" ECU_ADDRESS 0xD000CC86 /end MEASUREMENT
/begin MEASUREMENT DFC_st.DFC_SVSOL "" UWORD DFC_OneToOne 1 100 0.00 65535.00 FORMAT "%8.2" ECU_ADDRESS 0xD000CC88 /end MEASUREMENT
/begin MEASUREMENT DFC_st.DFC_SVSSCB "" UWORD DFC_OneToOne 1 100 0.00 65535.00 FORMAT "%8.2" ECU_ADDRESS 0xD000CC8A /end MEASUREMENT
/begin MEASUREMENT DFC_st.DFC_SVSSCG "" UWORD DFC_OneToOne 1 100 0.00 65535.00 FORMAT "%8.2" ECU_ADDRESS 0xD000CC8C /end MEASUREMENT
/begin MEASUREMENT DFC_st.DFC_StrtOL "" UWORD DFC_OneToOne 1 100 0.00 65535.00 FORMAT "%8.2" ECU_ADDRESS 0xD000CC8E /end MEASUREMENT
/begin MEASUREMENT DFC_st.DFC_StrtSCB "" UWORD DFC_OneToOne 1 100 0.00 65535.00 FORMAT "%8.2" ECU_ADDRESS 0xD000CC90 /end MEASUREMENT
/begin MEASUREMENT DFC_st.DFC_StrtSCG "" UWORD DFC_OneToOne 1 100 0.00 65535.00 FORMAT "%8.2" ECU_ADDRESS 0xD000CC92 /end MEASUREMENT
/begin MEASUREMENT DFC_st.DFC_SyncAPP "" UWORD DFC_OneToOne 1 100 0.00 65535.00 FORMAT "%8.2" ECU_ADDRESS 0xD000CC94 /end MEASUREMENT
/begin MEASUREMENT DFC_st.DFC_T15Npl "" UWORD DFC_OneToOne 1 100 0.00 65535.00 FORMAT "%8.2" ECU_ADDRESS 0xD000CC96 /end MEASUREMENT
/begin MEASUREMENT DFC_st.DFC_TAFSDtyCycHi "" UWORD DFC_OneToOne 1 100 0.00 65535.00 FORMAT "%8.2" ECU_ADDRESS 0xD000CC98 /end MEASUREMENT
/begin MEASUREMENT DFC_st.DFC_TAFSDtyCycLo "" UWORD DFC_OneToOne 1 100 0.00 65535.00 FORMAT "%8.2" ECU_ADDRESS 0xD000CC9A /end MEASUREMENT
/begin MEASUREMENT DFC_st.DFC_TAFSPerHi "" UWORD DFC_OneToOne 1 100 0.00 65535.00 FORMAT "%8.2" ECU_ADDRESS 0xD000CC9C /end MEASUREMENT
/begin MEASUREMENT DFC_st.DFC_TAFSPerLo "" UWORD DFC_OneToOne 1 100 0.00 65535.00 FORMAT "%8.2" ECU_ADDRESS 0xD000CC9E /end MEASUREMENT
/begin MEASUREMENT DFC_st.DFC_TCACDsSRCMax "" UWORD DFC_OneToOne 1 100 0.00 65535.00 FORMAT "%8.2" ECU_ADDRESS 0xD000CCA0 /end MEASUREMENT
/begin MEASUREMENT DFC_st.DFC_TCACDsSRCMin "" UWORD DFC_OneToOne 1 100 0.00 65535.00 FORMAT "%8.2" ECU_ADDRESS 0xD000CCA2 /end MEASUREMENT
/begin MEASUREMENT DFC_st.DFC_ThrVlvOL "" UWORD DFC_OneToOne 1 100 0.00 65535.00 FORMAT "%8.2" ECU_ADDRESS 0xD000CCA4 /end MEASUREMENT
/begin MEASUREMENT DFC_st.DFC_ThrVlvSCB "" UWORD DFC_OneToOne 1 100 0.00 65535.00 FORMAT "%8.2" ECU_ADDRESS 0xD000CCA6 /end MEASUREMENT
/begin MEASUREMENT DFC_st.DFC_ThrVlvSRCMax "" UWORD DFC_OneToOne 1 100 0.00 65535.00 FORMAT "%8.2" ECU_ADDRESS 0xD000CCA8 /end MEASUREMENT
/begin MEASUREMENT DFC_st.DFC_ThrVlvSRCMin "" UWORD DFC_OneToOne 1 100 0.00 65535.00 FORMAT "%8.2" ECU_ADDRESS 0xD000CCAA /end MEASUREMENT
/begin MEASUREMENT DFC_st.DFC_TrbChLPOL "" UWORD DFC_OneToOne 1 100 0.00 65535.00 FORMAT "%8.2" ECU_ADDRESS 0xD000CCAC /end MEASUREMENT
/begin MEASUREMENT DFC_st.DFC_TrbChLPSCB "" UWORD DFC_OneToOne 1 100 0.00 65535.00 FORMAT "%8.2" ECU_ADDRESS 0xD000CCAE /end MEASUREMENT
/begin MEASUREMENT DFC_st.DFC_TrbChLPSCG "" UWORD DFC_OneToOne 1 100 0.00 65535.00 FORMAT "%8.2" ECU_ADDRESS 0xD000CCB0 /end MEASUREMENT
/begin MEASUREMENT DFC_st.DFC_TrbChOL "" UWORD DFC_OneToOne 1 100 0.00 65535.00 FORMAT "%8.2" ECU_ADDRESS 0xD000CCB2 /end MEASUREMENT
/begin MEASUREMENT DFC_st.DFC_TrbChSCB "" UWORD DFC_OneToOne 1 100 0.00 65535.00 FORMAT "%8.2" ECU_ADDRESS 0xD000CCB4 /end MEASUREMENT
/begin MEASUREMENT DFC_st.DFC_VSwVlvGovDvtMax "" UWORD DFC_OneToOne 1 100 0.00 65535.00 FORMAT "%8.2" ECU_ADDRESS 0xD000CCB6 /end MEASUREMENT
/begin MEASUREMENT DFC_st.DFC_VSwVlvGovDvtMin "" UWORD DFC_OneToOne 1 100 0.00 65535.00 FORMAT "%8.2" ECU_ADDRESS 0xD000CCB8 /end MEASUREMENT
/begin MEASUREMENT DFC_st.DFC_VSwVlvOL "" UWORD DFC_OneToOne 1 100 0.00 65535.00 FORMAT "%8.2" ECU_ADDRESS 0xD000CCBA /end MEASUREMENT
/begin MEASUREMENT DFC_st.DFC_VSwVlvSCB "" UWORD DFC_OneToOne 1 100 0.00 65535.00 FORMAT "%8.2" ECU_ADDRESS 0xD000CCBC /end MEASUREMENT
/begin MEASUREMENT DFC_st.DFC_VSwVlvSCG "" UWORD DFC_OneToOne 1 100 0.00 65535.00 FORMAT "%8.2" ECU_ADDRESS 0xD000CCBE /end MEASUREMENT
/begin MEASUREMENT DFC_st.DFC_VSwVlvSRCMax "" UWORD DFC_OneToOne 1 100 0.00 65535.00 FORMAT "%8.2" ECU_ADDRESS 0xD000CCC0 /end MEASUREMENT
/begin MEASUREMENT DFC_st.DFC_VSwVlvSRCMin "" UWORD DFC_OneToOne 1 100 0.00 65535.00 FORMAT "%8.2" ECU_ADDRESS 0xD000CCC2 /end MEASUREMENT
/begin MEASUREMENT DFC_st.DFC_VehVHW "" UWORD DFC_OneToOne 1 100 0.00 65535.00 FORMAT "%8.2" ECU_ADDRESS 0xD000CCC4 /end MEASUREMENT
/begin MEASUREMENT DFC_st.DFC_VehVMax "" UWORD DFC_OneToOne 1 100 0.00 65535.00 FORMAT "%8.2" ECU_ADDRESS 0xD000CCC6 /end MEASUREMENT
/begin MEASUREMENT DFC_st.DFC_VehVPlaus "" UWORD DFC_OneToOne 1 100 0.00 65535.00 FORMAT "%8.2" ECU_ADDRESS 0xD000CCC8 /end MEASUREMENT
/begin MEASUREMENT DFC_st.DFC_VehVSig "" UWORD DFC_OneToOne 1 100 0.00 65535.00 FORMAT "%8.2" ECU_ADDRESS 0xD000CCCA /end MEASUREMENT
/begin MEASUREMENT DFC_st.DFC_WaHtElOL "" UWORD DFC_OneToOne 1 100 0.00 65535.00 FORMAT "%8.2" ECU_ADDRESS 0xD000CCCC /end MEASUREMENT
/begin MEASUREMENT DFC_st.DFC_WaHtElSCB "" UWORD DFC_OneToOne 1 100 0.00 65535.00 FORMAT "%8.2" ECU_ADDRESS 0xD000CCCE /end MEASUREMENT
/begin MEASUREMENT DFC_st.DFC_ClthNpl "" UWORD DFC_OneToOne 1 100 0.00 65535.00 FORMAT "%8.2" ECU_ADDRESS 0xD000CCD0 /end MEASUREMENT
/begin MEASUREMENT DFC_st.DFC_ETClbETMax_0 "" UWORD DFC_OneToOne 1 100 0.00 65535.00 FORMAT "%8.2" ECU_ADDRESS 0xD000CCD2 /end MEASUREMENT
/begin MEASUREMENT DFC_st.DFC_ETClbETMax_1 "" UWORD DFC_OneToOne 1 100 0.00 65535.00 FORMAT "%8.2" ECU_ADDRESS 0xD000CCD4 /end MEASUREMENT
/begin MEASUREMENT DFC_st.DFC_ETClbETMax_2 "" UWORD DFC_OneToOne 1 100 0.00 65535.00 FORMAT "%8.2" ECU_ADDRESS 0xD000CCD6 /end MEASUREMENT
/begin MEASUREMENT DFC_st.DFC_ETClbETMax_3 "" UWORD DFC_OneToOne 1 100 0.00 65535.00 FORMAT "%8.2" ECU_ADDRESS 0xD000CCD8 /end MEASUREMENT
/begin MEASUREMENT DFC_st.DFC_ETClbETMax_4 "" UWORD DFC_OneToOne 1 100 0.00 65535.00 FORMAT "%8.2" ECU_ADDRESS 0xD000CCDA /end MEASUREMENT
/begin MEASUREMENT DFC_st.DFC_ETClbETMax_5 "" UWORD DFC_OneToOne 1 100 0.00 65535.00 FORMAT "%8.2" ECU_ADDRESS 0xD000CCDC /end MEASUREMENT
/begin MEASUREMENT DFC_st.DFC_ETClbETMin_0 "" UWORD DFC_OneToOne 1 100 0.00 65535.00 FORMAT "%8.2" ECU_ADDRESS 0xD000CCDE /end MEASUREMENT
/begin MEASUREMENT DFC_st.DFC_ETClbETMin_1 "" UWORD DFC_OneToOne 1 100 0.00 65535.00 FORMAT "%8.2" ECU_ADDRESS 0xD000CCE0 /end MEASUREMENT
/begin MEASUREMENT DFC_st.DFC_ETClbETMin_2 "" UWORD DFC_OneToOne 1 100 0.00 65535.00 FORMAT "%8.2" ECU_ADDRESS 0xD000CCE2 /end MEASUREMENT
/begin MEASUREMENT DFC_st.DFC_ETClbETMin_3 "" UWORD DFC_OneToOne 1 100 0.00 65535.00 FORMAT "%8.2" ECU_ADDRESS 0xD000CCE4 /end MEASUREMENT
/begin MEASUREMENT DFC_st.DFC_ETClbETMin_4 "" UWORD DFC_OneToOne 1 100 0.00 65535.00 FORMAT "%8.2" ECU_ADDRESS 0xD000CCE6 /end MEASUREMENT
/begin MEASUREMENT DFC_st.DFC_ETClbETMin_5 "" UWORD DFC_OneToOne 1 100 0.00 65535.00 FORMAT "%8.2" ECU_ADDRESS 0xD000CCE8 /end MEASUREMENT
/begin MEASUREMENT DFC_st.DFC_IVDiaBnkShCirBSH_0 "" UWORD DFC_OneToOne 1 100 0.00 65535.00 FORMAT "%8.2" ECU_ADDRESS 0xD000CCEA /end MEASUREMENT
/begin MEASUREMENT DFC_st.DFC_IVDiaBnkShCirBSH_1 "" UWORD DFC_OneToOne 1 100 0.00 65535.00 FORMAT "%8.2" ECU_ADDRESS 0xD000CCEC /end MEASUREMENT
/begin MEASUREMENT DFC_st.DFC_IVDiaBnkShCirChSwt_0 "" UWORD DFC_OneToOne 1 100 0.00 65535.00 FORMAT "%8.2" ECU_ADDRESS 0xD000CCEE /end MEASUREMENT
/begin MEASUREMENT DFC_st.DFC_IVDiaBnkShCirChSwt_1 "" UWORD DFC_OneToOne 1 100 0.00 65535.00 FORMAT "%8.2" ECU_ADDRESS 0xD000CCF0 /end MEASUREMENT
/begin MEASUREMENT DFC_st.DFC_IVDiaBnkShCirHSBatt_0 "" UWORD DFC_OneToOne 1 100 0.00 65535.00 FORMAT "%8.2" ECU_ADDRESS 0xD000CCF2 /end MEASUREMENT
/begin MEASUREMENT DFC_st.DFC_IVDiaBnkShCirHSBatt_1 "" UWORD DFC_OneToOne 1 100 0.00 65535.00 FORMAT "%8.2" ECU_ADDRESS 0xD000CCF4 /end MEASUREMENT
/begin MEASUREMENT DFC_st.DFC_IVDiaBnkShCirHiRstnc_0 "" UWORD DFC_OneToOne 1 100 0.00 65535.00 FORMAT "%8.2" ECU_ADDRESS 0xD000CCF6 /end MEASUREMENT
/begin MEASUREMENT DFC_st.DFC_IVDiaBnkShCirHiRstnc_1 "" UWORD DFC_OneToOne 1 100 0.00 65535.00 FORMAT "%8.2" ECU_ADDRESS 0xD000CCF8 /end MEASUREMENT
/begin MEASUREMENT DFC_st.DFC_IVDiaBnkShCirLSHSGnd_0 "" UWORD DFC_OneToOne 1 100 0.00 65535.00 FORMAT "%8.2" ECU_ADDRESS 0xD000CCFA /end MEASUREMENT
/begin MEASUREMENT DFC_st.DFC_IVDiaBnkShCirLSHSGnd_1 "" UWORD DFC_OneToOne 1 100 0.00 65535.00 FORMAT "%8.2" ECU_ADDRESS 0xD000CCFC /end MEASUREMENT
/begin MEASUREMENT DFC_st.DFC_IVDiaBnkShCirTransfer_0 "" UWORD DFC_OneToOne 1 100 0.00 65535.00 FORMAT "%8.2" ECU_ADDRESS 0xD000CCFE /end MEASUREMENT
/begin MEASUREMENT DFC_st.DFC_IVDiaBnkShCirTransfer_1 "" UWORD DFC_OneToOne 1 100 0.00 65535.00 FORMAT "%8.2" ECU_ADDRESS 0xD000CD00 /end MEASUREMENT
/begin MEASUREMENT DFC_st.DFC_IVDiaCylNoCls_0 "" UWORD DFC_OneToOne 1 100 0.00 65535.00 FORMAT "%8.2" ECU_ADDRESS 0xD000CD02 /end MEASUREMENT
/begin MEASUREMENT DFC_st.DFC_IVDiaCylNoCls_1 "" UWORD DFC_OneToOne 1 100 0.00 65535.00 FORMAT "%8.2" ECU_ADDRESS 0xD000CD04 /end MEASUREMENT
/begin MEASUREMENT DFC_st.DFC_IVDiaCylNoCls_2 "" UWORD DFC_OneToOne 1 100 0.00 65535.00 FORMAT "%8.2" ECU_ADDRESS 0xD000CD06 /end MEASUREMENT
/begin MEASUREMENT DFC_st.DFC_IVDiaCylNoCls_3 "" UWORD DFC_OneToOne 1 100 0.00 65535.00 FORMAT "%8.2" ECU_ADDRESS 0xD000CD08 /end MEASUREMENT
/begin MEASUREMENT DFC_st.DFC_IVDiaCylNoCls_4 "" UWORD DFC_OneToOne 1 100 0.00 65535.00 FORMAT "%8.2" ECU_ADDRESS 0xD000CD0A /end MEASUREMENT
/begin MEASUREMENT DFC_st.DFC_IVDiaCylNoCls_5 "" UWORD DFC_OneToOne 1 100 0.00 65535.00 FORMAT "%8.2" ECU_ADDRESS 0xD000CD0C /end MEASUREMENT
/begin MEASUREMENT DFC_st.DFC_IVDiaCylNoLd_0 "" UWORD DFC_OneToOne 1 100 0.00 65535.00 FORMAT "%8.2" ECU_ADDRESS 0xD000CD0E /end MEASUREMENT
/begin MEASUREMENT DFC_st.DFC_IVDiaCylNoLd_1 "" UWORD DFC_OneToOne 1 100 0.00 65535.00 FORMAT "%8.2" ECU_ADDRESS 0xD000CD10 /end MEASUREMENT
/begin MEASUREMENT DFC_st.DFC_IVDiaCylNoLd_2 "" UWORD DFC_OneToOne 1 100 0.00 65535.00 FORMAT "%8.2" ECU_ADDRESS 0xD000CD12 /end MEASUREMENT
/begin MEASUREMENT DFC_st.DFC_IVDiaCylNoLd_3 "" UWORD DFC_OneToOne 1 100 0.00 65535.00 FORMAT "%8.2" ECU_ADDRESS 0xD000CD14 /end MEASUREMENT
/begin MEASUREMENT DFC_st.DFC_IVDiaCylNoLd_4 "" UWORD DFC_OneToOne 1 100 0.00 65535.00 FORMAT "%8.2" ECU_ADDRESS 0xD000CD16 /end MEASUREMENT
/begin MEASUREMENT DFC_st.DFC_IVDiaCylNoLd_5 "" UWORD DFC_OneToOne 1 100 0.00 65535.00 FORMAT "%8.2" ECU_ADDRESS 0xD000CD18 /end MEASUREMENT
/begin MEASUREMENT DFC_st.DFC_IVDiaCylShCirHiRstnc_0 "" UWORD DFC_OneToOne 1 100 0.00 65535.00 FORMAT "%8.2" ECU_ADDRESS 0xD000CD1A /end MEASUREMENT
/begin MEASUREMENT DFC_st.DFC_IVDiaCylShCirHiRstnc_1 "" UWORD DFC_OneToOne 1 100 0.00 65535.00 FORMAT "%8.2" ECU_ADDRESS 0xD000CD1C /end MEASUREMENT
/begin MEASUREMENT DFC_st.DFC_IVDiaCylShCirHiRstnc_2 "" UWORD DFC_OneToOne 1 100 0.00 65535.00 FORMAT "%8.2" ECU_ADDRESS 0xD000CD1E /end MEASUREMENT
/begin MEASUREMENT DFC_st.DFC_IVDiaCylShCirHiRstnc_3 "" UWORD DFC_OneToOne 1 100 0.00 65535.00 FORMAT "%8.2" ECU_ADDRESS 0xD000CD20 /end MEASUREMENT
/begin MEASUREMENT DFC_st.DFC_IVDiaCylShCirHiRstnc_4 "" UWORD DFC_OneToOne 1 100 0.00 65535.00 FORMAT "%8.2" ECU_ADDRESS 0xD000CD22 /end MEASUREMENT
/begin MEASUREMENT DFC_st.DFC_IVDiaCylShCirHiRstnc_5 "" UWORD DFC_OneToOne 1 100 0.00 65535.00 FORMAT "%8.2" ECU_ADDRESS 0xD000CD24 /end MEASUREMENT
/begin MEASUREMENT DFC_st.DFC_IVDiaCylShCirLSBatt_0 "" UWORD DFC_OneToOne 1 100 0.00 65535.00 FORMAT "%8.2" ECU_ADDRESS 0xD000CD26 /end MEASUREMENT
/begin MEASUREMENT DFC_st.DFC_IVDiaCylShCirLSBatt_1 "" UWORD DFC_OneToOne 1 100 0.00 65535.00 FORMAT "%8.2" ECU_ADDRESS 0xD000CD28 /end MEASUREMENT
/begin MEASUREMENT DFC_st.DFC_IVDiaCylShCirLSBatt_2 "" UWORD DFC_OneToOne 1 100 0.00 65535.00 FORMAT "%8.2" ECU_ADDRESS 0xD000CD2A /end MEASUREMENT
/begin MEASUREMENT DFC_st.DFC_IVDiaCylShCirLSBatt_3 "" UWORD DFC_OneToOne 1 100 0.00 65535.00 FORMAT "%8.2" ECU_ADDRESS 0xD000CD2C /end MEASUREMENT
/begin MEASUREMENT DFC_st.DFC_IVDiaCylShCirLSBatt_4 "" UWORD DFC_OneToOne 1 100 0.00 65535.00 FORMAT "%8.2" ECU_ADDRESS 0xD000CD2E /end MEASUREMENT
/begin MEASUREMENT DFC_st.DFC_IVDiaCylShCirLSBatt_5 "" UWORD DFC_OneToOne 1 100 0.00 65535.00 FORMAT "%8.2" ECU_ADDRESS 0xD000CD30 /end MEASUREMENT
/begin MEASUREMENT DFC_st.DFC_IVDiaCylShCirLSHS_0 "" UWORD DFC_OneToOne 1 100 0.00 65535.00 FORMAT "%8.2" ECU_ADDRESS 0xD000CD32 /end MEASUREMENT
/begin MEASUREMENT DFC_st.DFC_IVDiaCylShCirLSHS_1 "" UWORD DFC_OneToOne 1 100 0.00 65535.00 FORMAT "%8.2" ECU_ADDRESS 0xD000CD34 /end MEASUREMENT
/begin MEASUREMENT DFC_st.DFC_IVDiaCylShCirLSHS_2 "" UWORD DFC_OneToOne 1 100 0.00 65535.00 FORMAT "%8.2" ECU_ADDRESS 0xD000CD36 /end MEASUREMENT
/begin MEASUREMENT DFC_st.DFC_IVDiaCylShCirLSHS_3 "" UWORD DFC_OneToOne 1 100 0.00 65535.00 FORMAT "%8.2" ECU_ADDRESS 0xD000CD38 /end MEASUREMENT
/begin MEASUREMENT DFC_st.DFC_IVDiaCylShCirLSHS_4 "" UWORD DFC_OneToOne 1 100 0.00 65535.00 FORMAT "%8.2" ECU_ADDRESS 0xD000CD3A /end MEASUREMENT
/begin MEASUREMENT DFC_st.DFC_IVDiaCylShCirLSHS_5 "" UWORD DFC_OneToOne 1 100 0.00 65535.00 FORMAT "%8.2" ECU_ADDRESS 0xD000CD3C /end MEASUREMENT
/begin MEASUREMENT DFC_st.DFC_IVDiaCylShCirLsLs_0 "" UWORD DFC_OneToOne 1 100 0.00 65535.00 FORMAT "%8.2" ECU_ADDRESS 0xD000CD3E /end MEASUREMENT
/begin MEASUREMENT DFC_st.DFC_IVDiaCylShCirLsLs_1 "" UWORD DFC_OneToOne 1 100 0.00 65535.00 FORMAT "%8.2" ECU_ADDRESS 0xD000CD40 /end MEASUREMENT
/begin MEASUREMENT DFC_st.DFC_IVDiaCylShCirLsLs_2 "" UWORD DFC_OneToOne 1 100 0.00 65535.00 FORMAT "%8.2" ECU_ADDRESS 0xD000CD42 /end MEASUREMENT
/begin MEASUREMENT DFC_st.DFC_IVDiaCylShCirLsLs_3 "" UWORD DFC_OneToOne 1 100 0.00 65535.00 FORMAT "%8.2" ECU_ADDRESS 0xD000CD44 /end MEASUREMENT
/begin MEASUREMENT DFC_st.DFC_IVDiaCylShCirLsLs_4 "" UWORD DFC_OneToOne 1 100 0.00 65535.00 FORMAT "%8.2" ECU_ADDRESS 0xD000CD46 /end MEASUREMENT
/begin MEASUREMENT DFC_st.DFC_IVDiaCylShCirLsLs_5 "" UWORD DFC_OneToOne 1 100 0.00 65535.00 FORMAT "%8.2" ECU_ADDRESS 0xD000CD48 /end MEASUREMENT
/begin MEASUREMENT DFC_st.DFC_IVDiaSPICfg "" UWORD DFC_OneToOne 1 100 0.00 65535.00 FORMAT "%8.2" ECU_ADDRESS 0xD000CD4A /end MEASUREMENT
/begin MEASUREMENT DFC_st.DFC_IVDiaSPIColl "" UWORD DFC_OneToOne 1 100 0.00 65535.00 FORMAT "%8.2" ECU_ADDRESS 0xD000CD4C /end MEASUREMENT
/begin MEASUREMENT DFC_st.DFC_IVDiaSPICtrl "" UWORD DFC_OneToOne 1 100 0.00 65535.00 FORMAT "%8.2" ECU_ADDRESS 0xD000CD4E /end MEASUREMENT
/begin MEASUREMENT DFC_st.DFC_IVDiaSPIRam "" UWORD DFC_OneToOne 1 100 0.00 65535.00 FORMAT "%8.2" ECU_ADDRESS 0xD000CD50 /end MEASUREMENT
/begin MEASUREMENT DFC_st.DFC_IVDiaSPITrans "" UWORD DFC_OneToOne 1 100 0.00 65535.00 FORMAT "%8.2" ECU_ADDRESS 0xD000CD52 /end MEASUREMENT
/begin MEASUREMENT DFC_st.DFC_LSUCmpChk_0 "" UWORD DFC_OneToOne 1 100 0.00 65535.00 FORMAT "%8.2" ECU_ADDRESS 0xD000CD54 /end MEASUREMENT
/begin MEASUREMENT DFC_st.DFC_LSUCmpChk_1 "" UWORD DFC_OneToOne 1 100 0.00 65535.00 FORMAT "%8.2" ECU_ADDRESS 0xD000CD56 /end MEASUREMENT
/begin MEASUREMENT DFC_st.DFC_LSUCmpChk_2 "" UWORD DFC_OneToOne 1 100 0.00 65535.00 FORMAT "%8.2" ECU_ADDRESS 0xD000CD58 /end MEASUREMENT
/begin MEASUREMENT DFC_st.DFC_LSUCmpChk_3 "" UWORD DFC_OneToOne 1 100 0.00 65535.00 FORMAT "%8.2" ECU_ADDRESS 0xD000CD5A /end MEASUREMENT
/begin MEASUREMENT DFC_st.DFC_LSUCmpChk_4 "" UWORD DFC_OneToOne 1 100 0.00 65535.00 FORMAT "%8.2" ECU_ADDRESS 0xD000CD5C /end MEASUREMENT
/begin MEASUREMENT DFC_st.DFC_LSUCmpChk_5 "" UWORD DFC_OneToOne 1 100 0.00 65535.00 FORMAT "%8.2" ECU_ADDRESS 0xD000CD5E /end MEASUREMENT
/begin MEASUREMENT DFC_st.DFC_LSUDynChk_0 "" UWORD DFC_OneToOne 1 100 0.00 65535.00 FORMAT "%8.2" ECU_ADDRESS 0xD000CD60 /end MEASUREMENT
/begin MEASUREMENT DFC_st.DFC_LSUDynChk_1 "" UWORD DFC_OneToOne 1 100 0.00 65535.00 FORMAT "%8.2" ECU_ADDRESS 0xD000CD62 /end MEASUREMENT
/begin MEASUREMENT DFC_st.DFC_LSUDynChk_2 "" UWORD DFC_OneToOne 1 100 0.00 65535.00 FORMAT "%8.2" ECU_ADDRESS 0xD000CD64 /end MEASUREMENT
/begin MEASUREMENT DFC_st.DFC_LSUDynChk_3 "" UWORD DFC_OneToOne 1 100 0.00 65535.00 FORMAT "%8.2" ECU_ADDRESS 0xD000CD66 /end MEASUREMENT
/begin MEASUREMENT DFC_st.DFC_LSUO2ClbMax_0 "" UWORD DFC_OneToOne 1 100 0.00 65535.00 FORMAT "%8.2" ECU_ADDRESS 0xD000CD68 /end MEASUREMENT
/begin MEASUREMENT DFC_st.DFC_LSUO2ClbMax_1 "" UWORD DFC_OneToOne 1 100 0.00 65535.00 FORMAT "%8.2" ECU_ADDRESS 0xD000CD6A /end MEASUREMENT
/begin MEASUREMENT DFC_st.DFC_LSUO2ClbMax_2 "" UWORD DFC_OneToOne 1 100 0.00 65535.00 FORMAT "%8.2" ECU_ADDRESS 0xD000CD6C /end MEASUREMENT
/begin MEASUREMENT DFC_st.DFC_LSUO2ClbMax_3 "" UWORD DFC_OneToOne 1 100 0.00 65535.00 FORMAT "%8.2" ECU_ADDRESS 0xD000CD6E /end MEASUREMENT
/begin MEASUREMENT DFC_st.DFC_LSUO2ClbMin_0 "" UWORD DFC_OneToOne 1 100 0.00 65535.00 FORMAT "%8.2" ECU_ADDRESS 0xD000CD70 /end MEASUREMENT
/begin MEASUREMENT DFC_st.DFC_LSUO2ClbMin_1 "" UWORD DFC_OneToOne 1 100 0.00 65535.00 FORMAT "%8.2" ECU_ADDRESS 0xD000CD72 /end MEASUREMENT
/begin MEASUREMENT DFC_st.DFC_LSUO2ClbMin_2 "" UWORD DFC_OneToOne 1 100 0.00 65535.00 FORMAT "%8.2" ECU_ADDRESS 0xD000CD74 /end MEASUREMENT
/begin MEASUREMENT DFC_st.DFC_LSUO2ClbMin_3 "" UWORD DFC_OneToOne 1 100 0.00 65535.00 FORMAT "%8.2" ECU_ADDRESS 0xD000CD76 /end MEASUREMENT
/begin MEASUREMENT DFC_st.DFC_LSUO2PlausMax_0 "" UWORD DFC_OneToOne 1 100 0.00 65535.00 FORMAT "%8.2" ECU_ADDRESS 0xD000CD78 /end MEASUREMENT
/begin MEASUREMENT DFC_st.DFC_LSUO2PlausMax_1 "" UWORD DFC_OneToOne 1 100 0.00 65535.00 FORMAT "%8.2" ECU_ADDRESS 0xD000CD7A /end MEASUREMENT
/begin MEASUREMENT DFC_st.DFC_LSUO2PlausMax_2 "" UWORD DFC_OneToOne 1 100 0.00 65535.00 FORMAT "%8.2" ECU_ADDRESS 0xD000CD7C /end MEASUREMENT
/begin MEASUREMENT DFC_st.DFC_LSUO2PlausMax_3 "" UWORD DFC_OneToOne 1 100 0.00 65535.00 FORMAT "%8.2" ECU_ADDRESS 0xD000CD7E /end MEASUREMENT
/begin MEASUREMENT DFC_st.DFC_LSUO2PlausMin_0 "" UWORD DFC_OneToOne 1 100 0.00 65535.00 FORMAT "%8.2" ECU_ADDRESS 0xD000CD80 /end MEASUREMENT
/begin MEASUREMENT DFC_st.DFC_LSUO2PlausMin_1 "" UWORD DFC_OneToOne 1 100 0.00 65535.00 FORMAT "%8.2" ECU_ADDRESS 0xD000CD82 /end MEASUREMENT
/begin MEASUREMENT DFC_st.DFC_LSUO2PlausMin_2 "" UWORD DFC_OneToOne 1 100 0.00 65535.00 FORMAT "%8.2" ECU_ADDRESS 0xD000CD84 /end MEASUREMENT
/begin MEASUREMENT DFC_st.DFC_LSUO2PlausMin_3 "" UWORD DFC_OneToOne 1 100 0.00 65535.00 FORMAT "%8.2" ECU_ADDRESS 0xD000CD86 /end MEASUREMENT
/begin MEASUREMENT DFC_st.DFC_LSURiClbMax_0 "" UWORD DFC_OneToOne 1 100 0.00 65535.00 FORMAT "%8.2" ECU_ADDRESS 0xD000CD88 /end MEASUREMENT
/begin MEASUREMENT DFC_st.DFC_LSURiClbMax_1 "" UWORD DFC_OneToOne 1 100 0.00 65535.00 FORMAT "%8.2" ECU_ADDRESS 0xD000CD8A /end MEASUREMENT
/begin MEASUREMENT DFC_st.DFC_LSURiClbMax_2 "" UWORD DFC_OneToOne 1 100 0.00 65535.00 FORMAT "%8.2" ECU_ADDRESS 0xD000CD8C /end MEASUREMENT
/begin MEASUREMENT DFC_st.DFC_LSURiClbMax_3 "" UWORD DFC_OneToOne 1 100 0.00 65535.00 FORMAT "%8.2" ECU_ADDRESS 0xD000CD8E /end MEASUREMENT
/begin MEASUREMENT DFC_st.DFC_LSURiClbMin_0 "" UWORD DFC_OneToOne 1 100 0.00 65535.00 FORMAT "%8.2" ECU_ADDRESS 0xD000CD90 /end MEASUREMENT
/begin MEASUREMENT DFC_st.DFC_LSURiClbMin_1 "" UWORD DFC_OneToOne 1 100 0.00 65535.00 FORMAT "%8.2" ECU_ADDRESS 0xD000CD92 /end MEASUREMENT
/begin MEASUREMENT DFC_st.DFC_LSURiClbMin_2 "" UWORD DFC_OneToOne 1 100 0.00 65535.00 FORMAT "%8.2" ECU_ADDRESS 0xD000CD94 /end MEASUREMENT
/begin MEASUREMENT DFC_st.DFC_LSURiClbMin_3 "" UWORD DFC_OneToOne 1 100 0.00 65535.00 FORMAT "%8.2" ECU_ADDRESS 0xD000CD96 /end MEASUREMENT
/begin MEASUREMENT DFC_st.DFC_LSUWireIPSig_0 "" UWORD DFC_OneToOne 1 100 0.00 65535.00 FORMAT "%8.2" ECU_ADDRESS 0xD000CD98 /end MEASUREMENT
/begin MEASUREMENT DFC_st.DFC_LSUWireIPSig_1 "" UWORD DFC_OneToOne 1 100 0.00 65535.00 FORMAT "%8.2" ECU_ADDRESS 0xD000CD9A /end MEASUREMENT
/begin MEASUREMENT DFC_st.DFC_LSUWireIPSig_2 "" UWORD DFC_OneToOne 1 100 0.00 65535.00 FORMAT "%8.2" ECU_ADDRESS 0xD000CD9C /end MEASUREMENT
/begin MEASUREMENT DFC_st.DFC_LSUWireIPSig_3 "" UWORD DFC_OneToOne 1 100 0.00 65535.00 FORMAT "%8.2" ECU_ADDRESS 0xD000CD9E /end MEASUREMENT
/begin MEASUREMENT DFC_st.DFC_AFSDrftIdlAdjVal "" UWORD DFC_OneToOne 1 100 0.00 65535.00 FORMAT "%8.2" ECU_ADDRESS 0xD000CDA0 /end MEASUREMENT
/begin MEASUREMENT DFC_st.DFC_AFSDrftLdAdjVal "" UWORD DFC_OneToOne 1 100 0.00 65535.00 FORMAT "%8.2" ECU_ADDRESS 0xD000CDA2 /end MEASUREMENT
/begin MEASUREMENT DFC_st.DFC_AdcI_ADC0_Cal "" UWORD DFC_OneToOne 1 100 0.00 65535.00 FORMAT "%8.2" ECU_ADDRESS 0xD000CDA4 /end MEASUREMENT
/begin MEASUREMENT DFC_st.DFC_AdcI_ADC0_Conv "" UWORD DFC_OneToOne 1 100 0.00 65535.00 FORMAT "%8.2" ECU_ADDRESS 0xD000CDA6 /end MEASUREMENT
/begin MEASUREMENT DFC_st.DFC_CmbChbMisfireMax_0 "" UWORD DFC_OneToOne 1 100 0.00 65535.00 FORMAT "%8.2" ECU_ADDRESS 0xD000CDA8 /end MEASUREMENT
/begin MEASUREMENT DFC_st.DFC_CmbChbMisfireMax_1 "" UWORD DFC_OneToOne 1 100 0.00 65535.00 FORMAT "%8.2" ECU_ADDRESS 0xD000CDAA /end MEASUREMENT
/begin MEASUREMENT DFC_st.DFC_CmbChbMisfireMax_2 "" UWORD DFC_OneToOne 1 100 0.00 65535.00 FORMAT "%8.2" ECU_ADDRESS 0xD000CDAC /end MEASUREMENT
/begin MEASUREMENT DFC_st.DFC_CmbChbMisfireMax_3 "" UWORD DFC_OneToOne 1 100 0.00 65535.00 FORMAT "%8.2" ECU_ADDRESS 0xD000CDAE /end MEASUREMENT
/begin MEASUREMENT DFC_st.DFC_CmbChbMisfireMax_4 "" UWORD DFC_OneToOne 1 100 0.00 65535.00 FORMAT "%8.2" ECU_ADDRESS 0xD000CDB0 /end MEASUREMENT
/begin MEASUREMENT DFC_st.DFC_CmbChbMisfireMax_5 "" UWORD DFC_OneToOne 1 100 0.00 65535.00 FORMAT "%8.2" ECU_ADDRESS 0xD000CDB2 /end MEASUREMENT
/begin MEASUREMENT DFC_st.DFC_CmbChbMisfireMul "" UWORD DFC_OneToOne 1 100 0.00 65535.00 FORMAT "%8.2" ECU_ADDRESS 0xD000CDB4 /end MEASUREMENT
/begin MEASUREMENT DFC_st.DFC_INJVLVBUSY "" UWORD DFC_OneToOne 1 100 0.00 65535.00 FORMAT "%8.2" ECU_ADDRESS 0xD000CDB6 /end MEASUREMENT
/begin MEASUREMENT DFC_st.DFC_IVAdjIVA_0 "" UWORD DFC_OneToOne 1 100 0.00 65535.00 FORMAT "%8.2" ECU_ADDRESS 0xD000CDB8 /end MEASUREMENT
/begin MEASUREMENT DFC_st.DFC_IVAdjIVA_1 "" UWORD DFC_OneToOne 1 100 0.00 65535.00 FORMAT "%8.2" ECU_ADDRESS 0xD000CDBA /end MEASUREMENT
/begin MEASUREMENT DFC_st.DFC_IVAdjIVA_2 "" UWORD DFC_OneToOne 1 100 0.00 65535.00 FORMAT "%8.2" ECU_ADDRESS 0xD000CDBC /end MEASUREMENT
/begin MEASUREMENT DFC_st.DFC_IVAdjIVA_3 "" UWORD DFC_OneToOne 1 100 0.00 65535.00 FORMAT "%8.2" ECU_ADDRESS 0xD000CDBE /end MEASUREMENT
/begin MEASUREMENT DFC_st.DFC_IVAdjIVA_4 "" UWORD DFC_OneToOne 1 100 0.00 65535.00 FORMAT "%8.2" ECU_ADDRESS 0xD000CDC0 /end MEASUREMENT
/begin MEASUREMENT DFC_st.DFC_IVAdjIVA_5 "" UWORD DFC_OneToOne 1 100 0.00 65535.00 FORMAT "%8.2" ECU_ADDRESS 0xD000CDC2 /end MEASUREMENT
/begin MEASUREMENT DFC_st.DFC_InjCtlAdjQntEEPCS "" UWORD DFC_OneToOne 1 100 0.00 65535.00 FORMAT "%8.2" ECU_ADDRESS 0xD000CDC4 /end MEASUREMENT
/begin MEASUREMENT DFC_st.DFC_InjCtlDriftEEPCS "" UWORD DFC_OneToOne 1 100 0.00 65535.00 FORMAT "%8.2" ECU_ADDRESS 0xD000CDC6 /end MEASUREMENT
/begin MEASUREMENT DFC_st.DFC_MRlyErlyOpng "" UWORD DFC_OneToOne 1 100 0.00 65535.00 FORMAT "%8.2" ECU_ADDRESS 0xD000CDC8 /end MEASUREMENT
/begin MEASUREMENT DFC_st.DFC_MRlyStk "" UWORD DFC_OneToOne 1 100 0.00 65535.00 FORMAT "%8.2" ECU_ADDRESS 0xD000CDCA /end MEASUREMENT
/begin MEASUREMENT DFC_st.DFC_SensFrzPPFltUs "" UWORD DFC_OneToOne 1 100 0.00 65535.00 FORMAT "%8.2" ECU_ADDRESS 0xD000CDCC /end MEASUREMENT
/begin MEASUREMENT DFC_st.DFC_T15Sig "" UWORD DFC_OneToOne 1 100 0.00 65535.00 FORMAT "%8.2" ECU_ADDRESS 0xD000CDCE /end MEASUREMENT
/begin MEASUREMENT DFC_st.DFC_AirCtlRmpTOut "" UWORD DFC_OneToOne 1 100 0.00 65535.00 FORMAT "%8.2" ECU_ADDRESS 0xD000CDD0 /end MEASUREMENT
/begin MEASUREMENT DFC_st.DFC_CEngDsTDynTst "" UWORD DFC_OneToOne 1 100 0.00 65535.00 FORMAT "%8.2" ECU_ADDRESS 0xD000CDD2 /end MEASUREMENT
/begin MEASUREMENT DFC_st.DFC_EGRVlvJamVlvClsd "" UWORD DFC_OneToOne 1 100 0.00 65535.00 FORMAT "%8.2" ECU_ADDRESS 0xD000CDD4 /end MEASUREMENT
/begin MEASUREMENT DFC_st.DFC_EGRVlvJamVlvOpn "" UWORD DFC_OneToOne 1 100 0.00 65535.00 FORMAT "%8.2" ECU_ADDRESS 0xD000CDD6 /end MEASUREMENT
/begin MEASUREMENT DFC_st.DFC_EGRVlvLgTDrft "" UWORD DFC_OneToOne 1 100 0.00 65535.00 FORMAT "%8.2" ECU_ADDRESS 0xD000CDD8 /end MEASUREMENT
/begin MEASUREMENT DFC_st.DFC_EGRVlvOfsLrnJamVlv "" UWORD DFC_OneToOne 1 100 0.00 65535.00 FORMAT "%8.2" ECU_ADDRESS 0xD000CDDA /end MEASUREMENT
/begin MEASUREMENT DFC_st.DFC_EGRVlvShTDrft "" UWORD DFC_OneToOne 1 100 0.00 65535.00 FORMAT "%8.2" ECU_ADDRESS 0xD000CDDC /end MEASUREMENT
/begin MEASUREMENT DFC_st.DFC_EGTRgnOilDilMax "" UWORD DFC_OneToOne 1 100 0.00 65535.00 FORMAT "%8.2" ECU_ADDRESS 0xD000CDDE /end MEASUREMENT
/begin MEASUREMENT DFC_st.DFC_EngICO "" UWORD DFC_OneToOne 1 100 0.00 65535.00 FORMAT "%8.2" ECU_ADDRESS 0xD000CDE0 /end MEASUREMENT
/begin MEASUREMENT DFC_st.DFC_EpmCaSI1ErrSig "" UWORD DFC_OneToOne 1 100 0.00 65535.00 FORMAT "%8.2" ECU_ADDRESS 0xD000CDE2 /end MEASUREMENT
/begin MEASUREMENT DFC_st.DFC_EpmCaSI1NoSig "" UWORD DFC_OneToOne 1 100 0.00 65535.00 FORMAT "%8.2" ECU_ADDRESS 0xD000CDE4 /end MEASUREMENT
/begin MEASUREMENT DFC_st.DFC_EpmCaSI1OfsErr "" UWORD DFC_OneToOne 1 100 0.00 65535.00 FORMAT "%8.2" ECU_ADDRESS 0xD000CDE6 /end MEASUREMENT
/begin MEASUREMENT DFC_st.DFC_EpmCrSErrSig "" UWORD DFC_OneToOne 1 100 0.00 65535.00 FORMAT "%8.2" ECU_ADDRESS 0xD000CDE8 /end MEASUREMENT
/begin MEASUREMENT DFC_st.DFC_EpmCrSNoSig "" UWORD DFC_OneToOne 1 100 0.00 65535.00 FORMAT "%8.2" ECU_ADDRESS 0xD000CDEA /end MEASUREMENT
/begin MEASUREMENT DFC_st.DFC_MoCADCCmp "" UWORD DFC_OneToOne 1 100 0.00 65535.00 FORMAT "%8.2" ECU_ADDRESS 0xD000CDEC /end MEASUREMENT
/begin MEASUREMENT DFC_st.DFC_MoCADCTst "" UWORD DFC_OneToOne 1 100 0.00 65535.00 FORMAT "%8.2" ECU_ADDRESS 0xD000CDEE /end MEASUREMENT
/begin MEASUREMENT DFC_st.DFC_MoCADCVltgRatio "" UWORD DFC_OneToOne 1 100 0.00 65535.00 FORMAT "%8.2" ECU_ADDRESS 0xD000CDF0 /end MEASUREMENT
/begin MEASUREMENT DFC_st.DFC_MoCSOPLoLi "" UWORD DFC_OneToOne 1 100 0.00 65535.00 FORMAT "%8.2" ECU_ADDRESS 0xD000CDF2 /end MEASUREMENT
/begin MEASUREMENT DFC_st.DFC_MoCSOPMM "" UWORD DFC_OneToOne 1 100 0.00 65535.00 FORMAT "%8.2" ECU_ADDRESS 0xD000CDF4 /end MEASUREMENT
/begin MEASUREMENT DFC_st.DFC_MoCSOPTimeOut "" UWORD DFC_OneToOne 1 100 0.00 65535.00 FORMAT "%8.2" ECU_ADDRESS 0xD000CDF6 /end MEASUREMENT
/begin MEASUREMENT DFC_st.DFC_MoCSOPUpLi "" UWORD DFC_OneToOne 1 100 0.00 65535.00 FORMAT "%8.2" ECU_ADDRESS 0xD000CDF8 /end MEASUREMENT
/begin MEASUREMENT DFC_st.DFC_MoFAPP "" UWORD DFC_OneToOne 1 100 0.00 65535.00 FORMAT "%8.2" ECU_ADDRESS 0xD000CDFA /end MEASUREMENT
/begin MEASUREMENT DFC_st.DFC_MoFESpd "" UWORD DFC_OneToOne 1 100 0.00 65535.00 FORMAT "%8.2" ECU_ADDRESS 0xD000CDFC /end MEASUREMENT
/begin MEASUREMENT DFC_st.DFC_MoFInjDatPhi "" UWORD DFC_OneToOne 1 100 0.00 65535.00 FORMAT "%8.2" ECU_ADDRESS 0xD000CDFE /end MEASUREMENT
/begin MEASUREMENT DFC_st.DFC_MoFInjDatQnt "" UWORD DFC_OneToOne 1 100 0.00 65535.00 FORMAT "%8.2" ECU_ADDRESS 0xD000CE00 /end MEASUREMENT
/begin MEASUREMENT DFC_st.DFC_MoFInjQnt "" UWORD DFC_OneToOne 1 100 0.00 65535.00 FORMAT "%8.2" ECU_ADDRESS 0xD000CE02 /end MEASUREMENT
/begin MEASUREMENT DFC_st.DFC_MoFOvR "" UWORD DFC_OneToOne 1 100 0.00 65535.00 FORMAT "%8.2" ECU_ADDRESS 0xD000CE04 /end MEASUREMENT
/begin MEASUREMENT DFC_st.DFC_MoFQntCor "" UWORD DFC_OneToOne 1 100 0.00 65535.00 FORMAT "%8.2" ECU_ADDRESS 0xD000CE06 /end MEASUREMENT
/begin MEASUREMENT DFC_st.DFC_MoFTrqCmp "" UWORD DFC_OneToOne 1 100 0.00 65535.00 FORMAT "%8.2" ECU_ADDRESS 0xD000CE08 /end MEASUREMENT
/begin MEASUREMENT DFC_st.DFC_NplTOxiCatUs "" UWORD DFC_OneToOne 1 100 0.00 65535.00 FORMAT "%8.2" ECU_ADDRESS 0xD000CE0A /end MEASUREMENT
/begin MEASUREMENT DFC_st.DFC_PhyModNonMonMapNpl "" UWORD DFC_OneToOne 1 100 0.00 65535.00 FORMAT "%8.2" ECU_ADDRESS 0xD000CE0C /end MEASUREMENT
/begin MEASUREMENT DFC_st.DFC_RailPOfsTstMax "" UWORD DFC_OneToOne 1 100 0.00 65535.00 FORMAT "%8.2" ECU_ADDRESS 0xD000CE0E /end MEASUREMENT
/begin MEASUREMENT DFC_st.DFC_RailPOfsTstMin "" UWORD DFC_OneToOne 1 100 0.00 65535.00 FORMAT "%8.2" ECU_ADDRESS 0xD000CE10 /end MEASUREMENT
/begin MEASUREMENT DFC_st.DFC_SWReset_0 "" UWORD DFC_OneToOne 1 100 0.00 65535.00 FORMAT "%8.2" ECU_ADDRESS 0xD000CE12 /end MEASUREMENT
/begin MEASUREMENT DFC_st.DFC_SWReset_1 "" UWORD DFC_OneToOne 1 100 0.00 65535.00 FORMAT "%8.2" ECU_ADDRESS 0xD000CE14 /end MEASUREMENT
/begin MEASUREMENT DFC_st.DFC_SWReset_2 "" UWORD DFC_OneToOne 1 100 0.00 65535.00 FORMAT "%8.2" ECU_ADDRESS 0xD000CE16 /end MEASUREMENT
/begin MEASUREMENT DFC_st.DFC_VSwVlvJamVlv "" UWORD DFC_OneToOne 1 100 0.00 65535.00 FORMAT "%8.2" ECU_ADDRESS 0xD000CE18 /end MEASUREMENT
/begin MEASUREMENT DFC_st.DFC_VSwVlvLgTDrft "" UWORD DFC_OneToOne 1 100 0.00 65535.00 FORMAT "%8.2" ECU_ADDRESS 0xD000CE1A /end MEASUREMENT
/begin MEASUREMENT DFC_st.DFC_VSwVlvOfsLrnJamVlv "" UWORD DFC_OneToOne 1 100 0.00 65535.00 FORMAT "%8.2" ECU_ADDRESS 0xD000CE1C /end MEASUREMENT
/begin MEASUREMENT DFC_st.DFC_VSwVlvShTDrft "" UWORD DFC_OneToOne 1 100 0.00 65535.00 FORMAT "%8.2" ECU_ADDRESS 0xD000CE1E /end MEASUREMENT
/begin MEASUREMENT DFC_stClctFault "" UWORD DFC_OneToOne 1 100 0.00 65535.00 FORMAT "%8.2" ARRAY_SIZE 37 ECU_ADDRESS 0xD0005E78 /end MEASUREMENT
/begin MEASUREMENT DFC_stClctTst "" UWORD DFC_OneToOne 1 100 0.00 65535.00 FORMAT "%8.2" ARRAY_SIZE 37 ECU_ADDRESS 0xD0005EC2 /end MEASUREMENT
/begin MEASUREMENT DSM_stMIL "" SWORD TrqPrp 1 100 -52428.80 52427.20 FORMAT "%8.2" ECU_ADDRESS 0xD0006D82 /end MEASUREMENT
/begin MEASUREMENT DSM_stRdyAB "" UBYTE OneToOne 1 100 0.00 255.0 FORMAT "%5.1" ECU_ADDRESS 0xD0008FCB /end MEASUREMENT
/begin MEASUREMENT DSM_stRdyCD "" UBYTE OneToOne 1 100 0.00 255.0 FORMAT "%5.1" ECU_ADDRESS 0xD0008FCC /end MEASUREMENT
/begin MEASUREMENT DSM_stSVS "" SWORD TrqPrp 1 100 -52428.80 52427.20 FORMAT "%8.2" ECU_ADDRESS 0xD0006D84 /end MEASUREMENT
/begin MEASUREMENT DSQ_st.DSQ_AFS "" UBYTE DFC_OneToOne 1 100 0.00 255.0000 FORMAT "%8.4" ECU_ADDRESS 0xD0008935 /end MEASUREMENT
/begin MEASUREMENT DSQ_st.DSQ_BattU "" UBYTE DFC_OneToOne 1 100 0.00 255.0000 FORMAT "%8.4" ECU_ADDRESS 0xD0008936 /end MEASUREMENT
/begin MEASUREMENT DSQ_st.DSQ_BrkP "" UBYTE DFC_OneToOne 1 100 0.00 255.0000 FORMAT "%8.4" ECU_ADDRESS 0xD0008937 /end MEASUREMENT
/begin MEASUREMENT DSQ_st.DSQ_CByVlvActr "" UBYTE DFC_OneToOne 1 100 0.00 255.0000 FORMAT "%8.4" ECU_ADDRESS 0xD0008938 /end MEASUREMENT
/begin MEASUREMENT DSQ_st.DSQ_CEngDsT "" UBYTE DFC_OneToOne 1 100 0.00 255.0000 FORMAT "%8.4" ECU_ADDRESS 0xD0008939 /end MEASUREMENT
/begin MEASUREMENT DSQ_st.DSQ_CEngUsT "" UBYTE DFC_OneToOne 1 100 0.00 255.0000 FORMAT "%8.4" ECU_ADDRESS 0xD000893A /end MEASUREMENT
/begin MEASUREMENT DSQ_st.DSQ_CThmstActr "" UBYTE DFC_OneToOne 1 100 0.00 255.0000 FORMAT "%8.4" ECU_ADDRESS 0xD000893B /end MEASUREMENT
/begin MEASUREMENT DSQ_st.DSQ_Com_aDirect "" UBYTE DFC_OneToOne 1 100 0.00 255.0000 FORMAT "%8.4" ECU_ADDRESS 0xD000893C /end MEASUREMENT
/begin MEASUREMENT DSQ_st.DSQ_Com_aSide "" UBYTE DFC_OneToOne 1 100 0.00 255.0000 FORMAT "%8.4" ECU_ADDRESS 0xD000893D /end MEASUREMENT
/begin MEASUREMENT DSQ_st.DSQ_Com_nTSC "" UBYTE DFC_OneToOne 1 100 0.00 255.0000 FORMAT "%8.4" ECU_ADDRESS 0xD000893E /end MEASUREMENT
/begin MEASUREMENT DSQ_st.DSQ_Com_pBrkSys "" UBYTE DFC_OneToOne 1 100 0.00 255.0000 FORMAT "%8.4" ECU_ADDRESS 0xD000893F /end MEASUREMENT
/begin MEASUREMENT DSQ_st.DSQ_Com_stButtonMSA "" UBYTE DFC_OneToOne 1 100 0.00 255.0000 FORMAT "%8.4" ECU_ADDRESS 0xD0008940 /end MEASUREMENT
/begin MEASUREMENT DSQ_st.DSQ_Com_stClCtr "" UBYTE DFC_OneToOne 1 100 0.00 255.0000 FORMAT "%8.4" ECU_ADDRESS 0xD0008941 /end MEASUREMENT
/begin MEASUREMENT DSQ_st.DSQ_Com_stDSC "" UBYTE DFC_OneToOne 1 100 0.00 255.0000 FORMAT "%8.4" ECU_ADDRESS 0xD0008942 /end MEASUREMENT
/begin MEASUREMENT DSQ_st.DSQ_Com_stDecellDSC "" UBYTE DFC_OneToOne 1 100 0.00 255.0000 FORMAT "%8.4" ECU_ADDRESS 0xD0008943 /end MEASUREMENT
/begin MEASUREMENT DSQ_st.DSQ_Com_stDrWghSeat "" UBYTE DFC_OneToOne 1 100 0.00 255.0000 FORMAT "%8.4" ECU_ADDRESS 0xD0008944 /end MEASUREMENT
/begin MEASUREMENT DSQ_st.DSQ_Com_stGear "" UBYTE DFC_OneToOne 1 100 0.00 255.0000 FORMAT "%8.4" ECU_ADDRESS 0xD0008945 /end MEASUREMENT
/begin MEASUREMENT DSQ_st.DSQ_Com_stKeyVld "" UBYTE DFC_OneToOne 1 100 0.00 255.0000 FORMAT "%8.4" ECU_ADDRESS 0xD0008946 /end MEASUREMENT
/begin MEASUREMENT DSQ_st.DSQ_Com_stReqMSA "" UBYTE DFC_OneToOne 1 100 0.00 255.0000 FORMAT "%8.4" ECU_ADDRESS 0xD0008947 /end MEASUREMENT
/begin MEASUREMENT DSQ_st.DSQ_Com_stT15 "" UBYTE DFC_OneToOne 1 100 0.00 255.0000 FORMAT "%8.4" ECU_ADDRESS 0xD0008948 /end MEASUREMENT
/begin MEASUREMENT DSQ_st.DSQ_Com_stT50 "" UBYTE DFC_OneToOne 1 100 0.00 255.0000 FORMAT "%8.4" ECU_ADDRESS 0xD0008949 /end MEASUREMENT
/begin MEASUREMENT DSQ_st.DSQ_Com_stTrqDSCDes "" UBYTE DFC_OneToOne 1 100 0.00 255.0000 FORMAT "%8.4" ECU_ADDRESS 0xD000894A /end MEASUREMENT
/begin MEASUREMENT DSQ_st.DSQ_Com_swtDrBltb "" UBYTE DFC_OneToOne 1 100 0.00 255.0000 FORMAT "%8.4" ECU_ADDRESS 0xD000894B /end MEASUREMENT
/begin MEASUREMENT DSQ_st.DSQ_Com_tEnvT "" UBYTE DFC_OneToOne 1 100 0.00 255.0000 FORMAT "%8.4" ECU_ADDRESS 0xD000894C /end MEASUREMENT
/begin MEASUREMENT DSQ_st.DSQ_Com_tGbxOil "" UBYTE DFC_OneToOne 1 100 0.00 255.0000 FORMAT "%8.4" ECU_ADDRESS 0xD000894D /end MEASUREMENT
/begin MEASUREMENT DSQ_st.DSQ_Com_trqAC "" UBYTE DFC_OneToOne 1 100 0.00 255.0000 FORMAT "%8.4" ECU_ADDRESS 0xD000894E /end MEASUREMENT
/begin MEASUREMENT DSQ_st.DSQ_Com_trqARSCur "" UBYTE DFC_OneToOne 1 100 0.00 255.0000 FORMAT "%8.4" ECU_ADDRESS 0xD000894F /end MEASUREMENT
/begin MEASUREMENT DSQ_st.DSQ_Com_trqARSDes "" UBYTE DFC_OneToOne 1 100 0.00 255.0000 FORMAT "%8.4" ECU_ADDRESS 0xD0008950 /end MEASUREMENT
/begin MEASUREMENT DSQ_st.DSQ_Com_trqAvlAFS "" UBYTE DFC_OneToOne 1 100 0.00 255.0000 FORMAT "%8.4" ECU_ADDRESS 0xD0008951 /end MEASUREMENT
/begin MEASUREMENT DSQ_st.DSQ_Com_trqDSCDes "" UBYTE DFC_OneToOne 1 100 0.00 255.0000 FORMAT "%8.4" ECU_ADDRESS 0xD0008952 /end MEASUREMENT
/begin MEASUREMENT DSQ_st.DSQ_Com_trqGbxDes "" UBYTE DFC_OneToOne 1 100 0.00 255.0000 FORMAT "%8.4" ECU_ADDRESS 0xD0008953 /end MEASUREMENT
/begin MEASUREMENT DSQ_st.DSQ_Com_trqGbxFrc "" UBYTE DFC_OneToOne 1 100 0.00 255.0000 FORMAT "%8.4" ECU_ADDRESS 0xD0008954 /end MEASUREMENT
/begin MEASUREMENT DSQ_st.DSQ_Com_trqGbxMax "" UBYTE DFC_OneToOne 1 100 0.00 255.0000 FORMAT "%8.4" ECU_ADDRESS 0xD0008955 /end MEASUREMENT
/begin MEASUREMENT DSQ_st.DSQ_Com_trqTarAFS "" UBYTE DFC_OneToOne 1 100 0.00 255.0000 FORMAT "%8.4" ECU_ADDRESS 0xD0008956 /end MEASUREMENT
/begin MEASUREMENT DSQ_st.DSQ_Com_v "" UBYTE DFC_OneToOne 1 100 0.00 255.0000 FORMAT "%8.4" ECU_ADDRESS 0xD0008957 /end MEASUREMENT
/begin MEASUREMENT DSQ_st.DSQ_Com_vBd "" UBYTE DFC_OneToOne 1 100 0.00 255.0000 FORMAT "%8.4" ECU_ADDRESS 0xD0008958 /end MEASUREMENT
/begin MEASUREMENT DSQ_st.DSQ_DSMInhibitAlways "" UBYTE DFC_OneToOne 1 100 0.00 255.0000 FORMAT "%8.4" ECU_ADDRESS 0xD0008959 /end MEASUREMENT
/begin MEASUREMENT DSQ_st.DSQ_ECBVlvActr "" UBYTE DFC_OneToOne 1 100 0.00 255.0000 FORMAT "%8.4" ECU_ADDRESS 0xD000895A /end MEASUREMENT
/begin MEASUREMENT DSQ_st.DSQ_ECBVlvSens "" UBYTE DFC_OneToOne 1 100 0.00 255.0000 FORMAT "%8.4" ECU_ADDRESS 0xD000895B /end MEASUREMENT
/begin MEASUREMENT DSQ_st.DSQ_EGRVlvActr "" UBYTE DFC_OneToOne 1 100 0.00 255.0000 FORMAT "%8.4" ECU_ADDRESS 0xD000895C /end MEASUREMENT
/begin MEASUREMENT DSQ_st.DSQ_EGRVlvSens "" UBYTE DFC_OneToOne 1 100 0.00 255.0000 FORMAT "%8.4" ECU_ADDRESS 0xD000895D /end MEASUREMENT
/begin MEASUREMENT DSQ_st.DSQ_EMDmp_0 "" UBYTE DFC_OneToOne 1 100 0.00 255.0000 FORMAT "%8.4" ECU_ADDRESS 0xD000895E /end MEASUREMENT
/begin MEASUREMENT DSQ_st.DSQ_EMDmp_1 "" UBYTE DFC_OneToOne 1 100 0.00 255.0000 FORMAT "%8.4" ECU_ADDRESS 0xD000895F /end MEASUREMENT
/begin MEASUREMENT DSQ_st.DSQ_EngPrtFWOsc "" UBYTE DFC_OneToOne 1 100 0.00 255.0000 FORMAT "%8.4" ECU_ADDRESS 0xD0008960 /end MEASUREMENT
/begin MEASUREMENT DSQ_st.DSQ_EnvP "" UBYTE DFC_OneToOne 1 100 0.00 255.0000 FORMAT "%8.4" ECU_ADDRESS 0xD0008961 /end MEASUREMENT
/begin MEASUREMENT DSQ_st.DSQ_EnvT "" UBYTE DFC_OneToOne 1 100 0.00 255.0000 FORMAT "%8.4" ECU_ADDRESS 0xD0008962 /end MEASUREMENT
/begin MEASUREMENT DSQ_st.DSQ_FanActr "" UBYTE DFC_OneToOne 1 100 0.00 255.0000 FORMAT "%8.4" ECU_ADDRESS 0xD0008963 /end MEASUREMENT
/begin MEASUREMENT DSQ_st.DSQ_FuelT "" UBYTE DFC_OneToOne 1 100 0.00 255.0000 FORMAT "%8.4" ECU_ADDRESS 0xD0008964 /end MEASUREMENT
/begin MEASUREMENT DSQ_st.DSQ_LAYER2EDCMSAStp "" UBYTE DFC_OneToOne 1 100 0.00 255.0000 FORMAT "%8.4" ECU_ADDRESS 0xD0008965 /end MEASUREMENT
/begin MEASUREMENT DSQ_st.DSQ_LSUO2_0 "" UBYTE DFC_OneToOne 1 100 0.00 255.0000 FORMAT "%8.4" ECU_ADDRESS 0xD0008966 /end MEASUREMENT
/begin MEASUREMENT DSQ_st.DSQ_LSUO2_1 "" UBYTE DFC_OneToOne 1 100 0.00 255.0000 FORMAT "%8.4" ECU_ADDRESS 0xD0008967 /end MEASUREMENT
/begin MEASUREMENT DSQ_st.DSQ_LSUO2_2 "" UBYTE DFC_OneToOne 1 100 0.00 255.0000 FORMAT "%8.4" ECU_ADDRESS 0xD0008968 /end MEASUREMENT
/begin MEASUREMENT DSQ_st.DSQ_LSUO2_3 "" UBYTE DFC_OneToOne 1 100 0.00 255.0000 FORMAT "%8.4" ECU_ADDRESS 0xD0008969 /end MEASUREMENT
/begin MEASUREMENT DSQ_st.DSQ_MeUnActr "" UBYTE DFC_OneToOne 1 100 0.00 255.0000 FORMAT "%8.4" ECU_ADDRESS 0xD000896A /end MEASUREMENT
/begin MEASUREMENT DSQ_st.DSQ_NSCDsRLamO2 "" UBYTE DFC_OneToOne 1 100 0.00 255.0000 FORMAT "%8.4" ECU_ADDRESS 0xD000896B /end MEASUREMENT
/begin MEASUREMENT DSQ_st.DSQ_OilStSens "" UBYTE DFC_OneToOne 1 100 0.00 255.0000 FORMAT "%8.4" ECU_ADDRESS 0xD000896C /end MEASUREMENT
/begin MEASUREMENT DSQ_st.DSQ_OilT "" UBYTE DFC_OneToOne 1 100 0.00 255.0000 FORMAT "%8.4" ECU_ADDRESS 0xD000896D /end MEASUREMENT
/begin MEASUREMENT DSQ_st.DSQ_PAirFltDs "" UBYTE DFC_OneToOne 1 100 0.00 255.0000 FORMAT "%8.4" ECU_ADDRESS 0xD000896E /end MEASUREMENT
/begin MEASUREMENT DSQ_st.DSQ_PCACDs "" UBYTE DFC_OneToOne 1 100 0.00 255.0000 FORMAT "%8.4" ECU_ADDRESS 0xD000896F /end MEASUREMENT
/begin MEASUREMENT DSQ_st.DSQ_PCVActr "" UBYTE DFC_OneToOne 1 100 0.00 255.0000 FORMAT "%8.4" ECU_ADDRESS 0xD0008970 /end MEASUREMENT
/begin MEASUREMENT DSQ_st.DSQ_PPFltUs "" UBYTE DFC_OneToOne 1 100 0.00 255.0000 FORMAT "%8.4" ECU_ADDRESS 0xD0008971 /end MEASUREMENT
/begin MEASUREMENT DSQ_st.DSQ_TAFS "" UBYTE DFC_OneToOne 1 100 0.00 255.0000 FORMAT "%8.4" ECU_ADDRESS 0xD0008972 /end MEASUREMENT
/begin MEASUREMENT DSQ_st.DSQ_TCACDs "" UBYTE DFC_OneToOne 1 100 0.00 255.0000 FORMAT "%8.4" ECU_ADDRESS 0xD0008973 /end MEASUREMENT
/begin MEASUREMENT DSQ_st.DSQ_TECU "" UBYTE DFC_OneToOne 1 100 0.00 255.0000 FORMAT "%8.4" ECU_ADDRESS 0xD0008974 /end MEASUREMENT
/begin MEASUREMENT DSQ_st.DSQ_TOxiCatUs "" UBYTE DFC_OneToOne 1 100 0.00 255.0000 FORMAT "%8.4" ECU_ADDRESS 0xD0008975 /end MEASUREMENT
/begin MEASUREMENT DSQ_st.DSQ_TPFltUs "" UBYTE DFC_OneToOne 1 100 0.00 255.0000 FORMAT "%8.4" ECU_ADDRESS 0xD0008976 /end MEASUREMENT
/begin MEASUREMENT DSQ_st.DSQ_ThrVlvActr "" UBYTE DFC_OneToOne 1 100 0.00 255.0000 FORMAT "%8.4" ECU_ADDRESS 0xD0008977 /end MEASUREMENT
/begin MEASUREMENT DSQ_st.DSQ_ThrVlvSens "" UBYTE DFC_OneToOne 1 100 0.00 255.0000 FORMAT "%8.4" ECU_ADDRESS 0xD0008978 /end MEASUREMENT
/begin MEASUREMENT DSQ_st.DSQ_TrbChActr "" UBYTE DFC_OneToOne 1 100 0.00 255.0000 FORMAT "%8.4" ECU_ADDRESS 0xD0008979 /end MEASUREMENT
/begin MEASUREMENT DSQ_st.DSQ_TrbChLPActr "" UBYTE DFC_OneToOne 1 100 0.00 255.0000 FORMAT "%8.4" ECU_ADDRESS 0xD000897A /end MEASUREMENT
/begin MEASUREMENT DSQ_st.DSQ_TrbChSens "" UBYTE DFC_OneToOne 1 100 0.00 255.0000 FORMAT "%8.4" ECU_ADDRESS 0xD000897B /end MEASUREMENT
/begin MEASUREMENT DSQ_st.DSQ_TrbnDsRLamO2 "" UBYTE DFC_OneToOne 1 100 0.00 255.0000 FORMAT "%8.4" ECU_ADDRESS 0xD000897C /end MEASUREMENT
/begin MEASUREMENT DSQ_st.DSQ_VSwVlvActr "" UBYTE DFC_OneToOne 1 100 0.00 255.0000 FORMAT "%8.4" ECU_ADDRESS 0xD000897D /end MEASUREMENT
/begin MEASUREMENT DSQ_st.DSQ_VSwVlvSens "" UBYTE DFC_OneToOne 1 100 0.00 255.0000 FORMAT "%8.4" ECU_ADDRESS 0xD000897E /end MEASUREMENT
/begin MEASUREMENT DSQ_st.DSQ_VehV "" UBYTE DFC_OneToOne 1 100 0.00 255.0000 FORMAT "%8.4" ECU_ADDRESS 0xD000897F /end MEASUREMENT
/begin MEASUREMENT DSQ_st.DSQ_WaHtElActr "" UBYTE DFC_OneToOne 1 100 0.00 255.0000 FORMAT "%8.4" ECU_ADDRESS 0xD0008980 /end MEASUREMENT
/begin MEASUREMENT DSQ_st.DSQ_stAPP "" UBYTE DFC_OneToOne 1 100 0.00 255.0000 FORMAT "%8.4" ECU_ADDRESS 0xD0008981 /end MEASUREMENT
/begin MEASUREMENT DSQ_st.DSQ_stAPP1 "" UBYTE DFC_OneToOne 1 100 0.00 255.0000 FORMAT "%8.4" ECU_ADDRESS 0xD0008982 /end MEASUREMENT
/begin MEASUREMENT DSQ_st.DSQ_stAPP2 "" UBYTE DFC_OneToOne 1 100 0.00 255.0000 FORMAT "%8.4" ECU_ADDRESS 0xD0008983 /end MEASUREMENT
/begin MEASUREMENT DSQ_st.DSQ_stLSUSrvTstDem "" UBYTE DFC_OneToOne 1 100 0.00 255.0000 FORMAT "%8.4" ECU_ADDRESS 0xD0008984 /end MEASUREMENT
/begin MEASUREMENT DSQ_stClct "" UWORD DFC_OneToOne 1 100 0.00 65535.00 FORMAT "%8.2" ARRAY_SIZE 6 ECU_ADDRESS 0xD000636C /end MEASUREMENT
/begin MEASUREMENT EGRVlv_rB1 "" UBYTE default 1 100 0.00 255.0 FORMAT "%5.1" ECU_ADDRESS 0xD0006DA0 /end MEASUREMENT
/begin MEASUREMENT EGRVlv_rB2 "" UBYTE default 1 100 0.00 255.0 FORMAT "%5.1" ECU_ADDRESS 0xD0006DA2 /end MEASUREMENT
/begin MEASUREMENT Exh_pAdapPPFltDiff "" SWORD Pres_hPa 1 100 -32768.00 3500.00 FORMAT "%8.2" ECU_ADDRESS 0xD0006E8E /end MEASUREMENT
/begin MEASUREMENT Exh_pAdapPPFltUsB1 "" UBYTE default 1 100 0.00 255.0 FORMAT "%5.1" ECU_ADDRESS 0xD0006E96 /end MEASUREMENT
/begin MEASUREMENT Exh_pAdapPPFltUsB2 "" UBYTE default 1 100 0.00 255.0 FORMAT "%5.1" ECU_ADDRESS 0xD0006E98 /end MEASUREMENT
/begin MEASUREMENT Exh_pFld "" SWORD Pres_hPa 1 100 -32768.00 3500.00 FORMAT "%8.2" ARRAY_SIZE 8 ECU_ADDRESS 0xD0006E9A /end MEASUREMENT
/begin MEASUREMENT Exh_pFltPPFltDiff "" SWORD Pres_hPa 1 100 -32768.00 3500.00 FORMAT "%8.2" ECU_ADDRESS 0xD0006EAA /end MEASUREMENT
/begin MEASUREMENT Exh_pPFltDiff "" SWORD Pres_hPa 1 100 -32768.00 3500.00 FORMAT "%8.2" ECU_ADDRESS 0xD0006EB4 /end MEASUREMENT
/begin MEASUREMENT Exh_tAdapTOxiCatDs "" SWORD Temp_Cels 1 100 -3549.940 3003.560 FORMAT "%8.3" ECU_ADDRESS 0xD0006EC0 /end MEASUREMENT
/begin MEASUREMENT Exh_tAdapTTrbnUs "" SWORD Temp_Cels 1 100 -3549.940 3003.560 FORMAT "%8.3" ECU_ADDRESS 0xD0006EC6 /end MEASUREMENT
/begin MEASUREMENT Exh_tFld "" SWORD Temp_Cels 1 100 -3549.940 3003.560 FORMAT "%8.3" ARRAY_SIZE 8 ECU_ADDRESS 0xD0006EC8 /end MEASUREMENT
/begin MEASUREMENT GlwLmp_st "Glühlampenansteuerung" UBYTE OneToOne 1 100 0.00 255.0 FORMAT "%5.1" ECU_ADDRESS 0xD000902A /end MEASUREMENT
/begin MEASUREMENT Sil_stLogic "" UWORD OneToOne 1 100 0.00 65535.00 FORMAT "%8.2" ECU_ADDRESS 0xD000768E /end MEASUREMENT
/begin MEASUREMENT StWhl_dphiAg "" SWORD AngleVelStWhl 1 100 -1024.000 1023.969 FORMAT "%8.3" ECU_ADDRESS 0xD0007538 /end MEASUREMENT
/begin MEASUREMENT StWhl_phiAg "" SWORD AngleStWhl 1 100 -1024.000 1023.969 FORMAT "%8.3" ECU_ADDRESS 0xD000753A /end MEASUREMENT
/begin MEASUREMENT ThrVlv_rB1 "" UBYTE default 1 100 0.00 255.0 FORMAT "%5.1" ECU_ADDRESS 0xD0007574 /end MEASUREMENT
/begin MEASUREMENT ThrVlv_rB2 "" UBYTE default 1 100 0.00 255.0 FORMAT "%5.1" ECU_ADDRESS 0xD0007576 /end MEASUREMENT
/begin MEASUREMENT TrbCh_rB1 "" UBYTE default 1 100 0.00 255.0 FORMAT "%5.1" ECU_ADDRESS 0xD00075A4 /end MEASUREMENT
/begin MEASUREMENT TrbCh_rB2 "" UBYTE default 1 100 0.00 255.0 FORMAT "%5.1" ECU_ADDRESS 0xD00075A6 /end MEASUREMENT
/begin MEASUREMENT WaHtEl_st "" UBYTE OneToOne 1 100 0.00 255.0 FORMAT "%5.1" ARRAY_SIZE 2 ECU_ADDRESS 0xD00091A0 /end MEASUREMENT
/begin MEASUREMENT WaHtFl_st "" UBYTE OneToOne 1 100 0.00 255.0 FORMAT "%5.1" ECU_ADDRESS 0xD00091A2 /end MEASUREMENT
/begin FUNCTION DE_Adapt ""
 /begin IN_MEASUREMENT Air_dtTCACDs Air_pCACDs Air_pUnFltPCACDs Air_tAFS Air_tCACDs /end IN_MEASUREMENT
 /begin OUT_MEASUREMENT AFST_t AFS_stDrftB1 AFS_stDrftB2 AirC_rClgDem CACDsP_p CACDsP_pUnFlt CACDsT_dt CACDsT_t Com_stMILReq Com_stSVSReq CrC_stErr CrC_stKey DSM_stMIL DSM_stRdyAB DSM_stRdyCD DSM_stSVS EGRVlv_rB1 EGRVlv_rB2 Exh_pAdapPPFltDiff Exh_pAdapPPFltUsB1 Exh_pAdapPPFltUsB2 Exh_pFld Exh_pFltPPFltDiff Exh_pPFltDiff Exh_tAdapTOxiCatDs Exh_tAdapTTrbnUs Exh_tFld GlwLmp_st Sil_stLogic StWhl_dphiAg StWhl_phiAg ThrVlv_rB1 ThrVlv_rB2 TrbCh_rB1 TrbCh_rB2 WaHtEl_st WaHtFl_st /end OUT_MEASUREMENT
/end FUNCTION
/begin FUNCTION DFC "" /end FUNCTION
/begin FUNCTION dfc_auto ""
 /begin OUT_MEASUREMENT DFC_st.DFC_Unused DFC_st.DFC_AirCtlGovDvtEOMMax DFC_st.DFC_AirCtlGovDvtEOMMin DFC_st.DFC_AirCtlGovDvtMax DFC_st.DFC_AirCtlGovDvtMin DFC_st.DFC_Cj945SpiCom1 DFC_st.DFC_ComButtonMSASig DFC_st.DFC_ComButtonMSATo DFC_st.DFC_ComGearboxData2Sig DFC_st.DFC_ComGearboxData2To DFC_st.DFC_ComGearboxDataSig DFC_st.DFC_ComGearboxDataTo DFC_st.DFC_ComHeatACSig DFC_st.DFC_ComHeatACTo DFC_st.DFC_ComLenkradwinkelSig DFC_st.DFC_ComLenkradwinkelTo DFC_st.DFC_ComMileageRangeSig DFC_st.DFC_ComMileageRangeTo DFC_st.DFC_ComPspSig DFC_st.DFC_ComPspTo DFC_st.DFC_ComShutOffPSPSig DFC_st.DFC_ComShutOffPSPTo DFC_st.DFC_ComStKombiCtr DFC_st.DFC_ComStKombiSig DFC_st.DFC_ComStKombiTo DFC_st.DFC_ComStateARSCtr DFC_st.DFC_ComStateARSSig DFC_st.DFC_ComStateARSTo DFC_st.DFC_ComStateDscSig DFC_st.DFC_ComStateDscTo DFC_st.DFC_ComStateSeatSig DFC_st.DFC_ComStateSeatTo DFC_st.DFC_ComTempRelTimeSig DFC_st.DFC_ComTempRelTimeTo DFC_st.DFC_ComTerminalChk DFC_st.DFC_ComTerminalCtr DFC_st.DFC_ComTerminalSig DFC_st.DFC_ComTerminalTo DFC_st.DFC_ComTimeDateSig DFC_st.DFC_ComTimeDateTo DFC_st.DFC_ComTrailerSig DFC_st.DFC_ComTrailerTo DFC_st.DFC_ComTrqDemandAfsChk DFC_st.DFC_ComTrqDemandAfsCtr DFC_st.DFC_ComTrqDemandAfsSig DFC_st.DFC_ComTrqDemandAfsTo DFC_st.DFC_ComTrqDemandDscChk DFC_st.DFC_ComTrqDemandDscCtr DFC_st.DFC_ComTrqDemandDscSig DFC_st.DFC_ComTrqDemandDscTo DFC_st.DFC_ComTrqDemandGbxChk DFC_st.DFC_ComTrqDemandGbxCtr DFC_st.DFC_ComTrqDemandGbxSig DFC_st.DFC_ComTrqDemandGbxTo DFC_st.DFC_ComVelocitySig DFC_st.DFC_ComVelocityTo DFC_st.DFC_ComWheelSpeedSig DFC_st.DFC_ComWheelSpeedTo DFC_st.DFC_ComZvKlappenSig DFC_st.DFC_ComZvKlappenTo DFC_st.DFC_Cy150SpiCom DFC_st.DFC_Cy320SpiCom DFC_st.DFC_ETCtlDvtInrMax DFC_st.DFC_ETCtlDvtInrMin DFC_st.DFC_ETCtlDvtOutrMax DFC_st.DFC_ETCtlDvtOutrMin DFC_st.DFC_Fan4WinErr1 DFC_st.DFC_Fan4WinErr2 DFC_st.DFC_Fan4WinErr3 DFC_st.DFC_Fan4WinErr4 DFC_st.DFC_FanSCG DFC_st.DFC_PCRGovDvtLPMax DFC_st.DFC_PCRGovDvtLPMin DFC_st.DFC_PCRGovDvtMax DFC_st.DFC_PCRGovDvtMin DFC_st.DFC_RailCPC1 DFC_st.DFC_RailCPC3 DFC_st.DFC_RailCPC4 DFC_st.DFC_RailMeUn0 DFC_st.DFC_RailMeUn1 DFC_st.DFC_RailMeUn2 DFC_st.DFC_RailMeUn3 DFC_st.DFC_RailMeUn4 DFC_st.DFC_RailPCV0 DFC_st.DFC_RailPCV1 DFC_st.DFC_RailPCV2 DFC_st.DFC_RailPCV3 DFC_st.DFC_RailPCV4 DFC_st.DFC_RailPMonStrt DFC_st.DFC_SSpMon1 DFC_st.DFC_SSpMon2 DFC_st.DFC_SSpMon3 DFC_st.DFC_Sia_E1 DFC_st.DFC_Sia_E10 DFC_st.DFC_Sia_E11 DFC_st.DFC_Sia_E12 DFC_st.DFC_Sia_E13 DFC_st.DFC_Sia_E14 DFC_st.DFC_Sia_E15 DFC_st.DFC_Sia_E2 DFC_st.DFC_Sia_E3 DFC_st.DFC_Sia_E4 DFC_st.DFC_Sia_E5 DFC_st.DFC_Sia_E6 DFC_st.DFC_Sia_E7 DFC_st.DFC_Sia_E8 DFC_st.DFC_Sia_E9 DFC_st.DFC_ThrVlv4WinErr1 DFC_st.DFC_ThrVlv4WinErr2 DFC_st.DFC_ThrVlv4WinErr3 DFC_st.DFC_ThrVlv4WinErr4 DFC_st.DFC_ThrVlvSCG DFC_st.DFC_TrbCh4WinErr1 DFC_st.DFC_TrbCh4WinErr2 DFC_st.DFC_TrbCh4WinErr3 DFC_st.DFC_TrbCh4WinErr4 DFC_st.DFC_TrbChSCG DFC_st.DFC_TrbChSRCMax DFC_st.DFC_TrbChSRCMin DFC_st.DFC_WaHtEl4WinErr1 DFC_st.DFC_WaHtEl4WinErr2 DFC_st.DFC_WaHtEl4WinErr3 DFC_st.DFC_WaHtEl4WinErr4 DFC_st.DFC_WaHtElSCG DFC_st.DFC_ETClbETFltMax DFC_st.DFC_ETClbETFltMin DFC_st.DFC_InjCrvInjLimChrgBal DFC_st.DFC_InjCrvInjLimQntBal DFC_st.DFC_InjCrvInjLimSys DFC_st.DFC_InjCrvNumInjRtmLim DFC_st.DFC_LSUHtCoupSig_0 DFC_st.DFC_LSUHtCoupSig_1 DFC_st.DFC_LSUHtCoupSig_2 DFC_st.DFC_LSUHtCoupSig_3 DFC_st.DFC_CtT DFC_st.DFC_DSMDummy DFC_st.DFC_MeUnOL DFC_st.DFC_MeUnSCB DFC_st.DFC_MeUnSRCMax DFC_st.DFC_MeUnSRCMin DFC_st.DFC_PCVOL DFC_st.DFC_PCVSCB DFC_st.DFC_PCVSRCMax DFC_st.DFC_PCVSRCMin DFC_st.DFC_RailPSRCMax DFC_st.DFC_RailPSRCMin DFC_st.DFC_IVActrVltgSRCMax DFC_st.DFC_IVActrVltgSRCMin DFC_st.DFC_IVPSplyDCDC DFC_st.DFC_IVPSplyVltgSRCMax DFC_st.DFC_IVPSplyVltgSRCMin DFC_st.DFC_AFSOffsDrftMax DFC_st.DFC_AFSOffsDrftMin DFC_st.DFC_AFSSRCCorMax DFC_st.DFC_AFSSRCCorMin DFC_st.DFC_AFSSRCRawMax DFC_st.DFC_AFSSRCRawMin DFC_st.DFC_AFSSetyDrftMax DFC_st.DFC_AFSSetyDrftMin DFC_st.DFC_AirCClntPAnaSRCMax DFC_st.DFC_AirCClntPAnaSRCMin DFC_st.DFC_AirCClntPPerSRCMax DFC_st.DFC_AirCClntPPerSRCMin DFC_st.DFC_AirCClntPdcycSRCMax DFC_st.DFC_AirCClntPdcycSRCMin DFC_st.DFC_AirCCmprOL DFC_st.DFC_AirCCmprRedTrqOL DFC_st.DFC_AirCCmprRedTrqSCB DFC_st.DFC_AirCCmprRedTrqSCG DFC_st.DFC_AirCCmprSCB DFC_st.DFC_AirCCmprSCG DFC_st.DFC_AirCSwtNpl DFC_st.DFC_AirCSwtSig DFC_st.DFC_BattUSRCMax DFC_st.DFC_BattUSRCMin DFC_st.DFC_BrkNpl DFC_st.DFC_BrkPSRCMax DFC_st.DFC_BrkPSRCMin DFC_st.DFC_BrkSig DFC_st.DFC_CByVlvOL DFC_st.DFC_CByVlvSCB DFC_st.DFC_CByVlvSCG DFC_st.DFC_CEngDsTSRCMax DFC_st.DFC_CEngDsTSRCMin DFC_st.DFC_CEngDsTSig DFC_st.DFC_CEngUsTSRCMax DFC_st.DFC_CEngUsTSRCMin DFC_st.DFC_CThmstOL DFC_st.DFC_CThmstSCB DFC_st.DFC_CThmstSCG DFC_st.DFC_ClthSig DFC_st.DFC_ECBVlvOL DFC_st.DFC_ECBVlvSCB DFC_st.DFC_ECBVlvSCG DFC_st.DFC_ECBVlvSRCMax DFC_st.DFC_ECBVlvSRCMin DFC_st.DFC_EGRVlvGovDvtMax DFC_st.DFC_EGRVlvGovDvtMin DFC_st.DFC_EGRVlvOL DFC_st.DFC_EGRVlvSCB DFC_st.DFC_EGRVlvSCG DFC_st.DFC_EGRVlvSRCMax DFC_st.DFC_EGRVlvSRCMin DFC_st.DFC_EMDmpOL_0 DFC_st.DFC_EMDmpOL_1 DFC_st.DFC_EMDmpSCB_0 DFC_st.DFC_EMDmpSCB_1 DFC_st.DFC_EMDmpSCG_0 DFC_st.DFC_EMDmpSCG_1 DFC_st.DFC_EngStAOL DFC_st.DFC_EngStASCB DFC_st.DFC_EngStASCG DFC_st.DFC_EnvPSRCMax DFC_st.DFC_EnvPSRCMin DFC_st.DFC_EnvPSig DFC_st.DFC_EnvTSRCMax DFC_st.DFC_EnvTSRCMin DFC_st.DFC_FanOL DFC_st.DFC_FanSCB DFC_st.DFC_FlFltSig DFC_st.DFC_FuelTSRCMax DFC_st.DFC_FuelTSRCMin DFC_st.DFC_GbxNPosPPerSRCMax DFC_st.DFC_GbxNPosPPerSRCMin DFC_st.DFC_GbxNPosPdcycSRCMax DFC_st.DFC_GbxNPosPdcycSRCMin DFC_st.DFC_GbxNPosSig DFC_st.DFC_GlwPlgBSDOL_0 DFC_st.DFC_GlwPlgBSDOL_1 DFC_st.DFC_GlwPlgBSDOL_2 DFC_st.DFC_GlwPlgBSDOL_3 DFC_st.DFC_GlwPlgBSDOL_4 DFC_st.DFC_GlwPlgBSDOL_5 DFC_st.DFC_GlwPlgBSDOL_6 DFC_st.DFC_GlwPlgBSDOL_7 DFC_st.DFC_GlwPlgBSDOT_0 DFC_st.DFC_GlwPlgBSDOT_1 DFC_st.DFC_GlwPlgBSDOT_2 DFC_st.DFC_GlwPlgBSDOT_3 DFC_st.DFC_GlwPlgBSDOT_4 DFC_st.DFC_GlwPlgBSDOT_5 DFC_st.DFC_GlwPlgBSDOT_6 DFC_st.DFC_GlwPlgBSDOT_7 DFC_st.DFC_GlwPlgBSDSC_0 DFC_st.DFC_GlwPlgBSDSC_1 DFC_st.DFC_GlwPlgBSDSC_2 DFC_st.DFC_GlwPlgBSDSC_3 DFC_st.DFC_GlwPlgBSDSC_4 DFC_st.DFC_GlwPlgBSDSC_5 DFC_st.DFC_GlwPlgBSDSC_6 DFC_st.DFC_GlwPlgBSDSC_7 DFC_st.DFC_GlwPlgComErr DFC_st.DFC_InjVlvPresMin DFC_st.DFC_LSUCircNernstMax_0 DFC_st.DFC_LSUCircNernstMax_1 DFC_st.DFC_LSUCircNernstMax_2 DFC_st.DFC_LSUCircNernstMax_3 DFC_st.DFC_LSUCircNernstMin_0 DFC_st.DFC_LSUCircNernstMin_1 DFC_st.DFC_LSUCircNernstMin_2 DFC_st.DFC_LSUCircNernstMin_3 DFC_st.DFC_LSUCircNernstSig_0 DFC_st.DFC_LSUCircNernstSig_1 DFC_st.DFC_LSUCircNernstSig_2 DFC_st.DFC_LSUCircNernstSig_3 DFC_st.DFC_LSUCircPmpCurMax_0 DFC_st.DFC_LSUCircPmpCurMax_1 DFC_st.DFC_LSUCircPmpCurMax_2 DFC_st.DFC_LSUCircPmpCurMax_3 DFC_st.DFC_LSUCircPmpCurMin_0 DFC_st.DFC_LSUCircPmpCurMin_1 DFC_st.DFC_LSUCircPmpCurMin_2 DFC_st.DFC_LSUCircPmpCurMin_3 DFC_st.DFC_LSUCircPmpCurSig_0 DFC_st.DFC_LSUCircPmpCurSig_1 DFC_st.DFC_LSUCircPmpCurSig_2 DFC_st.DFC_LSUCircPmpCurSig_3 DFC_st.DFC_LSUCircVirtGndMax_0 DFC_st.DFC_LSUCircVirtGndMax_1 DFC_st.DFC_LSUCircVirtGndMax_2 DFC_st.DFC_LSUCircVirtGndMax_3 DFC_st.DFC_LSUCircVirtGndMin_0 DFC_st.DFC_LSUCircVirtGndMin_1 DFC_st.DFC_LSUCircVirtGndMin_2 DFC_st.DFC_LSUCircVirtGndMin_3 DFC_st.DFC_LSUCircVirtGndSig_0 DFC_st.DFC_LSUCircVirtGndSig_1 DFC_st.DFC_LSUCircVirtGndSig_2 DFC_st.DFC_LSUCircVirtGndSig_3 DFC_st.DFC_LSUHtrMax_0 DFC_st.DFC_LSUHtrMax_1 DFC_st.DFC_LSUHtrMax_2 DFC_st.DFC_LSUHtrMax_3 DFC_st.DFC_LSUHtrMin_0 DFC_st.DFC_LSUHtrMin_1 DFC_st.DFC_LSUHtrMin_2 DFC_st.DFC_LSUHtrMin_3 DFC_st.DFC_LSUHtrSig_0 DFC_st.DFC_LSUHtrSig_1 DFC_st.DFC_LSUHtrSig_2 DFC_st.DFC_LSUHtrSig_3 DFC_st.DFC_LSUO2Max_0 DFC_st.DFC_LSUO2Max_1 DFC_st.DFC_LSUO2Max_2 DFC_st.DFC_LSUO2Max_3 DFC_st.DFC_LSUO2Min_0 DFC_st.DFC_LSUO2Min_1 DFC_st.DFC_LSUO2Min_2 DFC_st.DFC_LSUO2Min_3 DFC_st.DFC_LSUSPIBattLowMin_0 DFC_st.DFC_LSUSPIBattLowMin_1 DFC_st.DFC_LSUSPIBattLowMin_2 DFC_st.DFC_LSUSPIBattLowMin_3 DFC_st.DFC_LSUSPISig_0 DFC_st.DFC_LSUSPISig_1 DFC_st.DFC_LSUSPISig_2 DFC_st.DFC_LSUSPISig_3 DFC_st.DFC_LSUtExcMax_0 DFC_st.DFC_LSUtExcMax_1 DFC_st.DFC_LSUtExcMax_2 DFC_st.DFC_LSUtExcMax_3 DFC_st.DFC_LSUtExcMin_0 DFC_st.DFC_LSUtExcMin_1 DFC_st.DFC_LSUtExcMin_2 DFC_st.DFC_LSUtExcMin_3 DFC_st.DFC_MILOL DFC_st.DFC_MILSCB DFC_st.DFC_MILSCG DFC_st.DFC_MeUnSCG DFC_st.DFC_NplHsChngPPFltDiff DFC_st.DFC_NplPAirFltDs DFC_st.DFC_NplTPFltUs DFC_st.DFC_OilComErr DFC_st.DFC_OilPLmpOL DFC_st.DFC_OilPLmpSCB DFC_st.DFC_OilPLmpSCG DFC_st.DFC_OilPNpl DFC_st.DFC_OilTNpl DFC_st.DFC_OilTSRCMax DFC_st.DFC_OilTSRCMin DFC_st.DFC_PCACDsEnvPPls DFC_st.DFC_PCACDsSRCMax DFC_st.DFC_PCACDsSRCMin DFC_st.DFC_PCVSCG DFC_st.DFC_PFltCharPDiffMin DFC_st.DFC_PFltDstrMin DFC_st.DFC_PFltEngPrt DFC_st.DFC_PFltLmpOL DFC_st.DFC_PFltLmpSCB DFC_st.DFC_PFltLmpSCG DFC_st.DFC_PFltRgnPerm DFC_st.DFC_PFltSRCMaxFlwRstn DFC_st.DFC_PFltSRCMinFlwRstn DFC_st.DFC_PFltSotMsDvtMax DFC_st.DFC_PFltSotMsDvtMin DFC_st.DFC_PFltSotMsMax DFC_st.DFC_PSPOL DFC_st.DFC_PSPSCB DFC_st.DFC_PSPSCG DFC_st.DFC_SRCHighAPP1 DFC_st.DFC_SRCHighAPP2 DFC_st.DFC_SRCLowAPP1 DFC_st.DFC_SRCLowAPP2 DFC_st.DFC_SRCMaxPAirFltDs DFC_st.DFC_SRCMaxPPFltUs DFC_st.DFC_SRCMaxTECU DFC_st.DFC_SRCMaxTOxiCatUs DFC_st.DFC_SRCMaxTPFltUs DFC_st.DFC_SRCMinPAirFltDs DFC_st.DFC_SRCMinPPFltUs DFC_st.DFC_SRCMinTECU DFC_st.DFC_SRCMinTOxiCatUs DFC_st.DFC_SRCMinTPFltUs DFC_st.DFC_SVSOL DFC_st.DFC_SVSSCB DFC_st.DFC_SVSSCG DFC_st.DFC_StrtOL DFC_st.DFC_StrtSCB DFC_st.DFC_StrtSCG DFC_st.DFC_SyncAPP DFC_st.DFC_T15Npl DFC_st.DFC_TAFSDtyCycHi DFC_st.DFC_TAFSDtyCycLo DFC_st.DFC_TAFSPerHi DFC_st.DFC_TAFSPerLo DFC_st.DFC_TCACDsSRCMax DFC_st.DFC_TCACDsSRCMin DFC_st.DFC_ThrVlvOL DFC_st.DFC_ThrVlvSCB DFC_st.DFC_ThrVlvSRCMax DFC_st.DFC_ThrVlvSRCMin DFC_st.DFC_TrbChLPOL DFC_st.DFC_TrbChLPSCB DFC_st.DFC_TrbChLPSCG DFC_st.DFC_TrbChOL DFC_st.DFC_TrbChSCB DFC_st.DFC_VSwVlvGovDvtMax DFC_st.DFC_VSwVlvGovDvtMin DFC_st.DFC_VSwVlvOL DFC_st.DFC_VSwVlvSCB DFC_st.DFC_VSwVlvSCG DFC_st.DFC_VSwVlvSRCMax DFC_st.DFC_VSwVlvSRCMin DFC_st.DFC_VehVHW DFC_st.DFC_VehVMax DFC_st.DFC_VehVPlaus DFC_st.DFC_VehVSig DFC_st.DFC_WaHtElOL DFC_st.DFC_WaHtElSCB DFC_st.DFC_ClthNpl DFC_st.DFC_ETClbETMax_0 DFC_st.DFC_ETClbETMax_1 DFC_st.DFC_ETClbETMax_2 DFC_st.DFC_ETClbETMax_3 DFC_st.DFC_ETClbETMax_4 DFC_st.DFC_ETClbETMax_5 DFC_st.DFC_ETClbETMin_0 DFC_st.DFC_ETClbETMin_1 DFC_st.DFC_ETClbETMin_2 DFC_st.DFC_ETClbETMin_3 DFC_st.DFC_ETClbETMin_4 DFC_st.DFC_ETClbETMin_5 DFC_st.DFC_IVDiaBnkShCirBSH_0 DFC_st.DFC_IVDiaBnkShCirBSH_1 DFC_st.DFC_IVDiaBnkShCirChSwt_0 DFC_st.DFC_IVDiaBnkShCirChSwt_1 DFC_st.DFC_IVDiaBnkShCirHSBatt_0 DFC_st.DFC_IVDiaBnkShCirHSBatt_1 DFC_st.DFC_IVDiaBnkShCirHiRstnc_0 DFC_st.DFC_IVDiaBnkShCirHiRstnc_1 DFC_st.DFC_IVDiaBnkShCirLSHSGnd_0 DFC_st.DFC_IVDiaBnkShCirLSHSGnd_1 DFC_st.DFC_IVDiaBnkShCirTransfer_0 DFC_st.DFC_IVDiaBnkShCirTransfer_1 DFC_st.DFC_IVDiaCylNoCls_0 DFC_st.DFC_IVDiaCylNoCls_1 DFC_st.DFC_IVDiaCylNoCls_2 DFC_st.DFC_IVDiaCylNoCls_3 DFC_st.DFC_IVDiaCylNoCls_4 DFC_st.DFC_IVDiaCylNoCls_5 DFC_st.DFC_IVDiaCylNoLd_0 DFC_st.DFC_IVDiaCylNoLd_1 DFC_st.DFC_IVDiaCylNoLd_2 DFC_st.DFC_IVDiaCylNoLd_3 DFC_st.DFC_IVDiaCylNoLd_4 DFC_st.DFC_IVDiaCylNoLd_5 DFC_st.DFC_IVDiaCylShCirHiRstnc_0 DFC_st.DFC_IVDiaCylShCirHiRstnc_1 DFC_st.DFC_IVDiaCylShCirHiRstnc_2 DFC_st.DFC_IVDiaCylShCirHiRstnc_3 DFC_st.DFC_IVDiaCylShCirHiRstnc_4 DFC_st.DFC_IVDiaCylShCirHiRstnc_5 DFC_st.DFC_IVDiaCylShCirLSBatt_0 DFC_st.DFC_IVDiaCylShCirLSBatt_1 DFC_st.DFC_IVDiaCylShCirLSBatt_2 DFC_st.DFC_IVDiaCylShCirLSBatt_3 DFC_st.DFC_IVDiaCylShCirLSBatt_4 DFC_st.DFC_IVDiaCylShCirLSBatt_5 DFC_st.DFC_IVDiaCylShCirLSHS_0 DFC_st.DFC_IVDiaCylShCirLSHS_1 DFC_st.DFC_IVDiaCylShCirLSHS_2 DFC_st.DFC_IVDiaCylShCirLSHS_3 DFC_st.DFC_IVDiaCylShCirLSHS_4 DFC_st.DFC_IVDiaCylShCirLSHS_5 DFC_st.DFC_IVDiaCylShCirLsLs_0 DFC_st.DFC_IVDiaCylShCirLsLs_1 DFC_st.DFC_IVDiaCylShCirLsLs_2 DFC_st.DFC_IVDiaCylShCirLsLs_3 DFC_st.DFC_IVDiaCylShCirLsLs_4 DFC_st.DFC_IVDiaCylShCirLsLs_5 DFC_st.DFC_IVDiaSPICfg DFC_st.DFC_IVDiaSPIColl DFC_st.DFC_IVDiaSPICtrl DFC_st.DFC_IVDiaSPIRam DFC_st.DFC_IVDiaSPITrans DFC_st.DFC_LSUCmpChk_0 DFC_st.DFC_LSUCmpChk_1 DFC_st.DFC_LSUCmpChk_2 DFC_st.DFC_LSUCmpChk_3 DFC_st.DFC_LSUCmpChk_4 DFC_st.DFC_LSUCmpChk_5 DFC_st.DFC_LSUDynChk_0 DFC_st.DFC_LSUDynChk_1 DFC_st.DFC_LSUDynChk_2 DFC_st.DFC_LSUDynChk_3 DFC_st.DFC_LSUO2ClbMax_0 DFC_st.DFC_LSUO2ClbMax_1 DFC_st.DFC_LSUO2ClbMax_2 DFC_st.DFC_LSUO2ClbMax_3 DFC_st.DFC_LSUO2ClbMin_0 DFC_st.DFC_LSUO2ClbMin_1 DFC_st.DFC_LSUO2ClbMin_2 DFC_st.DFC_LSUO2ClbMin_3 DFC_st.DFC_LSUO2PlausMax_0 DFC_st.DFC_LSUO2PlausMax_1 DFC_st.DFC_LSUO2PlausMax_2 DFC_st.DFC_LSUO2PlausMax_3 DFC_st.DFC_LSUO2PlausMin_0 DFC_st.DFC_LSUO2PlausMin_1 DFC_st.DFC_LSUO2PlausMin_2 DFC_st.DFC_LSUO2PlausMin_3 DFC_st.DFC_LSURiClbMax_0 DFC_st.DFC_LSURiClbMax_1 DFC_st.DFC_LSURiClbMax_2 DFC_st.DFC_LSURiClbMax_3 DFC_st.DFC_LSURiClbMin_0 DFC_st.DFC_LSURiClbMin_1 DFC_st.DFC_LSURiClbMin_2 DFC_st.DFC_LSURiClbMin_3 DFC_st.DFC_LSUWireIPSig_0 DFC_st.DFC_LSUWireIPSig_1 DFC_st.DFC_LSUWireIPSig_2 DFC_st.DFC_LSUWireIPSig_3 DFC_st.DFC_AFSDrftIdlAdjVal DFC_st.DFC_AFSDrftLdAdjVal DFC_st.DFC_AdcI_ADC0_Cal DFC_st.DFC_AdcI_ADC0_Conv DFC_st.DFC_CmbChbMisfireMax_0 DFC_st.DFC_CmbChbMisfireMax_1 DFC_st.DFC_CmbChbMisfireMax_2 DFC_st.DFC_CmbChbMisfireMax_3 DFC_st.DFC_CmbChbMisfireMax_4 DFC_st.DFC_CmbChbMisfireMax_5 DFC_st.DFC_CmbChbMisfireMul DFC_st.DFC_INJVLVBUSY DFC_st.DFC_IVAdjIVA_0 DFC_st.DFC_IVAdjIVA_1 DFC_st.DFC_IVAdjIVA_2 DFC_st.DFC_IVAdjIVA_3 DFC_st.DFC_IVAdjIVA_4 DFC_st.DFC_IVAdjIVA_5 DFC_st.DFC_InjCtlAdjQntEEPCS DFC_st.DFC_InjCtlDriftEEPCS DFC_st.DFC_MRlyErlyOpng DFC_st.DFC_MRlyStk DFC_st.DFC_SensFrzPPFltUs DFC_st.DFC_T15Sig DFC_st.DFC_AirCtlRmpTOut DFC_st.DFC_CEngDsTDynTst DFC_st.DFC_EGRVlvJamVlvClsd DFC_st.DFC_EGRVlvJamVlvOpn DFC_st.DFC_EGRVlvLgTDrft DFC_st.DFC_EGRVlvOfsLrnJamVlv DFC_st.DFC_EGRVlvShTDrft DFC_st.DFC_EGTRgnOilDilMax DFC_st.DFC_EngICO DFC_st.DFC_EpmCaSI1ErrSig DFC_st.DFC_EpmCaSI1NoSig DFC_st.DFC_EpmCaSI1OfsErr DFC_st.DFC_EpmCrSErrSig DFC_st.DFC_EpmCrSNoSig DFC_st.DFC_MoCADCCmp DFC_st.DFC_MoCADCTst DFC_st.DFC_MoCADCVltgRatio DFC_st.DFC_MoCSOPLoLi DFC_st.DFC_MoCSOPMM DFC_st.DFC_MoCSOPTimeOut DFC_st.DFC_MoCSOPUpLi DFC_st.DFC_MoFAPP DFC_st.DFC_MoFESpd DFC_st.DFC_MoFInjDatPhi DFC_st.DFC_MoFInjDatQnt DFC_st.DFC_MoFInjQnt DFC_st.DFC_MoFOvR DFC_st.DFC_MoFQntCor DFC_st.DFC_MoFTrqCmp DFC_st.DFC_NplTOxiCatUs DFC_st.DFC_PhyModNonMonMapNpl DFC_st.DFC_RailPOfsTstMax DFC_st.DFC_RailPOfsTstMin DFC_st.DFC_SWReset_0 DFC_st.DFC_SWReset_1 DFC_st.DFC_SWReset_2 DFC_st.DFC_VSwVlvJamVlv DFC_st.DFC_VSwVlvLgTDrft DFC_st.DFC_VSwVlvOfsLrnJamVlv DFC_st.DFC_VSwVlvShTDrft DFC_stClctFault DFC_stClctTst DSQ_st.DSQ_AFS DSQ_st.DSQ_BattU DSQ_st.DSQ_BrkP DSQ_st.DSQ_CByVlvActr DSQ_st.DSQ_CEngDsT DSQ_st.DSQ_CEngUsT DSQ_st.DSQ_CThmstActr DSQ_st.DSQ_Com_aDirect DSQ_st.DSQ_Com_aSide DSQ_st.DSQ_Com_nTSC DSQ_st.DSQ_Com_pBrkSys DSQ_st.DSQ_Com_stButtonMSA DSQ_st.DSQ_Com_stClCtr DSQ_st.DSQ_Com_stDSC DSQ_st.DSQ_Com_stDecellDSC DSQ_st.DSQ_Com_stDrWghSeat DSQ_st.DSQ_Com_stGear DSQ_st.DSQ_Com_stKeyVld DSQ_st.DSQ_Com_stReqMSA DSQ_st.DSQ_Com_stT15 DSQ_st.DSQ_Com_stT50 DSQ_st.DSQ_Com_stTrqDSCDes DSQ_st.DSQ_Com_swtDrBltb DSQ_st.DSQ_Com_tEnvT DSQ_st.DSQ_Com_tGbxOil DSQ_st.DSQ_Com_trqAC DSQ_st.DSQ_Com_trqARSCur DSQ_st.DSQ_Com_trqARSDes DSQ_st.DSQ_Com_trqAvlAFS DSQ_st.DSQ_Com_trqDSCDes DSQ_st.DSQ_Com_trqGbxDes DSQ_st.DSQ_Com_trqGbxFrc DSQ_st.DSQ_Com_trqGbxMax DSQ_st.DSQ_Com_trqTarAFS DSQ_st.DSQ_Com_v DSQ_st.DSQ_Com_vBd DSQ_st.DSQ_DSMInhibitAlways DSQ_st.DSQ_ECBVlvActr DSQ_st.DSQ_ECBVlvSens DSQ_st.DSQ_EGRVlvActr DSQ_st.DSQ_EGRVlvSens DSQ_st.DSQ_EMDmp_0 DSQ_st.DSQ_EMDmp_1 DSQ_st.DSQ_EngPrtFWOsc DSQ_st.DSQ_EnvP DSQ_st.DSQ_EnvT DSQ_st.DSQ_FanActr DSQ_st.DSQ_FuelT DSQ_st.DSQ_LAYER2EDCMSAStp DSQ_st.DSQ_LSUO2_0 DSQ_st.DSQ_LSUO2_1 DSQ_st.DSQ_LSUO2_2 DSQ_st.DSQ_LSUO2_3 DSQ_st.DSQ_MeUnActr DSQ_st.DSQ_NSCDsRLamO2 DSQ_st.DSQ_OilStSens DSQ_st.DSQ_OilT DSQ_st.DSQ_PAirFltDs DSQ_st.DSQ_PCACDs DSQ_st.DSQ_PCVActr DSQ_st.DSQ_PPFltUs DSQ_st.DSQ_TAFS DSQ_st.DSQ_TCACDs DSQ_st.DSQ_TECU DSQ_st.DSQ_TOxiCatUs DSQ_st.DSQ_TPFltUs DSQ_st.DSQ_ThrVlvActr DSQ_st.DSQ_ThrVlvSens DSQ_st.DSQ_TrbChActr DSQ_st.DSQ_TrbChLPActr DSQ_st.DSQ_TrbChSens DSQ_st.DSQ_TrbnDsRLamO2 DSQ_st.DSQ_VSwVlvActr DSQ_st.DSQ_VSwVlvSens DSQ_st.DSQ_VehV DSQ_st.DSQ_WaHtElActr DSQ_st.DSQ_stAPP DSQ_st.DSQ_stAPP1 DSQ_st.DSQ_stAPP2 DSQ_st.DSQ_stLSUSrvTstDem DSQ_stClct /end OUT_MEASUREMENT
/end FUNCTION
/begin COMPU_METHOD AngleStWhl "" RAT_FUNC "%6.4" "deg StWhl" COEFFS 0 32 0 0 0 1 /end COMPU_METHOD
/begin COMPU_METHOD AngleVelStWhl "" RAT_FUNC "%6.4" "deg StWhl/s" COEFFS 0 32 0 0 0 1 /end COMPU_METHOD
/begin COMPU_METHOD DFC_OneToOne "" RAT_FUNC "%8.3" "-" COEFFS 0 1 0 0 0 1 /end COMPU_METHOD
/begin COMPU_METHOD OneToOne "" RAT_FUNC "%6.2" "-" COEFFS 0 1 0 0 0 1 /end COMPU_METHOD
/begin COMPU_METHOD Prc "" RAT_FUNC "%6.4" "%" COEFFS 0 81.92 0 0 0 1 /end COMPU_METHOD
/begin COMPU_METHOD Pres_hPa "" RAT_FUNC "%6.2" "hPa" COEFFS 0 1 0 0 0 1 /end COMPU_METHOD
/begin COMPU_METHOD Temp_Cels "" RAT_FUNC "%6.1" "deg C" COEFFS 0 10 2731.4 0 0 1 /end COMPU_METHOD
/begin COMPU_METHOD TrqPrp "" RAT_FUNC "%6.2" "Nm" COEFFS 0 0.625 0 0 0 1 /end COMPU_METHOD
/begin COMPU_METHOD default "" RAT_FUNC "%6.2" "-" COEFFS 0 1 0 0 0 1 /end COMPU_METHOD
/end MODULE
/end PROJECT
