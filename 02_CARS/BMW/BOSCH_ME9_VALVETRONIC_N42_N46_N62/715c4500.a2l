ASAP2_VERSION 1 3
/begin PROJECT _715C4500 "basisme9"
/begin HEADER "" VERSION "_715C4500" PROJECT_NO _715C4500 /end HEADER
/begin MODULE DIM ""
/begin MOD_COMMON "" BYTE_ORDER MSB_FIRST ALIGNMENT_BYTE 1 ALIGNMENT_WORD 2 ALIGNMENT_LONG 2 ALIGNMENT_FLOAT32_IEEE 4 /end MOD_COMMON
/begin CHARACTERISTIC AZKRLDYN "Anzahl Z¸ndungen pro Zyl. bei KR-Lastdynamik" CURVE 0xFCEB14 KlAUbSstUbWUb 254.0 dez 1.000 255.0 FORMAT "%5.1"
 /begin AXIS_DESCR STD_AXIS nmot nmot_ub_q40 16 0.00 10200. FORMAT "%5.0" DEPOSIT ABSOLUTE /end AXIS_DESCR
/end CHARACTERISTIC
/begin CHARACTERISTIC AZKRNDYN "Anzahl Z¸ndungen f¸r KR-Drehzahldynamik" CURVE 0xFCEB38 KlAUbSstUbWUb 254.0 dez 1.000 255.0 FORMAT "%5.1"
 /begin AXIS_DESCR STD_AXIS nmot nmot_ub_q40 16 0.00 10200. FORMAT "%5.0" DEPOSIT ABSOLUTE /end AXIS_DESCR
/end CHARACTERISTIC
/begin CHARACTERISTIC BBHZM_EZH "Maﬂnahmenanforderung Zuheizen bei verbautem EZH" VALUE 0xFCF262 KwWU8 255.0 DEZ 0.00 255.0 FORMAT "%5.1" /end CHARACTERISTIC
/begin CHARACTERISTIC BBHZM_NEZH "Maﬂnahmenanforderung Zuheizen bei nicht verbautem EZH" VALUE 0xFCF263 KwWU8 255.0 DEZ 0.00 255.0 FORMAT "%5.1" /end CHARACTERISTIC
/begin CHARACTERISTIC BBHZ_LRN_T "max. Anlernzeit HKW" VALUE 0xFC6C00 KwWU8 255.0 t1sxs_ul_q1 0.00 255.0 FORMAT "%5.1" /end CHARACTERISTIC
/begin CHARACTERISTIC CWANW "Codewort: Anzahl der Nockenwellen" VALUE 0xFC6422 KwWU8 3.000 dez 2.000 5.000 FORMAT "%5.3" /end CHARACTERISTIC
/begin CHARACTERISTIC CWBWEEN "Codewort zur Deaktivierung der Bewegungserkennung" VALUE 0xFC632E KwUb 255.0 dez 0.00 255.0 FORMAT "%5.1" /end CHARACTERISTIC
/begin CHARACTERISTIC CWKHMD "Codewort f¸r Drehmomentenreserve bei Katheizen" VALUE 0xFCE430 KwUb 255.0 dez 0.00 255.0 FORMAT "%5.1" /end CHARACTERISTIC
/begin CHARACTERISTIC CWPG1 "Codewort f¸r Eigenschaften des Nockenwellensignals PG1" VALUE 0xFC642A KwWU16 65535.00 dez 0.00 65535.00 FORMAT "%8.2" /end CHARACTERISTIC
/begin CHARACTERISTIC CWPG2 "Codewort f¸r Eigenschaften des Nockenwellensignals PG2" VALUE 0xFC642C KwWU16 65535.00 dez 0.00 65535.00 FORMAT "%8.2" /end CHARACTERISTIC
/begin CHARACTERISTIC CWPG3 "Codewort f¸r Eigenschaften des Nockenwellensignals PG3" VALUE 0xFC642E KwWU16 65535.00 dez 0.00 65535.00 FORMAT "%8.2" /end CHARACTERISTIC
/begin CHARACTERISTIC CWPG4 "Codewort f¸r Eigenschaften des Nockenwellensignals PG4" VALUE 0xFC6430 KwWU16 65535.00 dez 0.00 65535.00 FORMAT "%8.2" /end CHARACTERISTIC
/begin CHARACTERISTIC DOLNIV "Hyst. zum austragen der Warnflags" VALUE 0xFCE1D0 KwWU8 127.5 tog_ub_q0p5 0.00 127.5 FORMAT "%5.1" /end CHARACTERISTIC
/begin CHARACTERISTIC DPHFLFR1 "Maximale Abweichung der Phasenflanke von PG1 nach fr¸h" VALUE 0xFC6423 KwWU8 255.0 kw_q1 0.00 255.0 FORMAT "%5.1" /end CHARACTERISTIC
/begin CHARACTERISTIC DPHFLFR2 "Maximale Abweichung der Phasenflanke von PG2 nach fr¸h" VALUE 0xFC6424 KwWU8 255.0 kw_q1 0.00 255.0 FORMAT "%5.1" /end CHARACTERISTIC
/begin CHARACTERISTIC DPHFLSP1 "Maximale Abweichung der Phasenflanke von PG1 nach sp‰t" VALUE 0xFC6425 KwWU8 255.0 kw_q1 0.00 255.0 FORMAT "%5.1" /end CHARACTERISTIC
/begin CHARACTERISTIC DPHFLSP2 "Maximale Abweichung der Phasenflanke von PG2 nach sp‰t" VALUE 0xFC6426 KwWU8 255.0 kw_q1 0.00 255.0 FORMAT "%5.1" /end CHARACTERISTIC
/begin CHARACTERISTIC DTLRTML "Bewertungsfaktor Zeitdekrementierung f¸r Erreichen tmot-Einschaltschwelle LR" CURVE 0xFCE010 KlAUbSstUbWUb 99.61 rel_ub_b99p6 0.00 99.61 FORMAT "%5.2"
 /begin AXIS_DESCR STD_AXIS mll1 m_ub_b1020 7 0.00 1020. FORMAT "%5.0" DEPOSIT ABSOLUTE /end AXIS_DESCR
/end CHARACTERISTIC
/begin CHARACTERISTIC DTMDMA "Abstand Motortemperaturmodell zur Starttemperatur" VALUE 0xFCE01F KwUb 191.3 temp_ub_b191p25 0.00 191.3 FORMAT "%5.1" /end CHARACTERISTIC
/begin CHARACTERISTIC DTMDNPO "Abstand Motortemperaturmodell zur oberen Unplausibilit‰tsschwelle" VALUE 0xFCE020 KwUb 191.3 temp_ub_b191p25 0.00 191.3 FORMAT "%5.1" /end CHARACTERISTIC
/begin CHARACTERISTIC DTMOTKFT "" VALUE 0xFCC3E2 KwWU8 191.3 temp_ub_q0p75_o48 -48.00 143.3 FORMAT "%5.1" /end CHARACTERISTIC
/begin CHARACTERISTIC DTMSRT "Delta Motortemp.zu Starttemp. f.Retrigg. Modelle (Blockheater-Erkennung)" VALUE 0xFCE021 KwUb 191.3 temp_ub_b191p25 0.00 191.3 FORMAT "%5.1" /end CHARACTERISTIC
/begin CHARACTERISTIC DUPW12 "Zul‰ssige Spannungsabweichung zwischen PWG-Poti 1 und 2" VALUE 0xFC632F KwUb 4.980 spg_ub_b5 0.00 4.980 FORMAT "%5.3" /end CHARACTERISTIC
/begin CHARACTERISTIC DUPW12BE "notweniger Spannungsweg von Poti 2 zur Bewegungserkennung" VALUE 0xFC634E KwUw 4.995117 spg_uw_q0p00488 0.00 4.995117 FORMAT "%8.6" /end CHARACTERISTIC
/begin CHARACTERISTIC DUPW12TG "Zul‰ssige Spannungsabweichung zwischen PWG Poti 1 und  2 im Teilgasbereich" VALUE 0xFC6330 KwUb 4.980 spg_ub_b5 0.00 4.980 FORMAT "%5.3" /end CHARACTERISTIC
/begin CHARACTERISTIC DUPW12VG "Zul‰ssige Spannungsabweichung zwischen PWG-Poti 1 und 2 im Vollgasbereich" VALUE 0xFC6331 KwUb 4.980 spg_ub_b5 0.00 4.980 FORMAT "%5.3" /end CHARACTERISTIC
/begin CHARACTERISTIC DUPWGHY "Spannungshysterese bei Entjitterung der PWG-Spannung" VALUE 0xFC6350 KwUw 4.995117 spg_uw_q0p00488 0.00 4.995117 FORMAT "%8.6" /end CHARACTERISTIC
/begin CHARACTERISTIC DVFZBEG "Delta-Geschwindigkeit f¸r ƒnderungsbegrenzung" VALUE 0xFC659C KwWU16 511.9922 vfzg_uw_b512 0.00 511.9922 FORMAT "%8.4" /end CHARACTERISTIC
/begin CHARACTERISTIC DWPMXNB "Maximal zul‰ssige Pedalwerterhˆhung pro Rechenschritt nach Bremsbet‰tigung" VALUE 0xFC6352 KwUw 100.0000 relPED_uw_b100 0.00 100.0000 FORMAT "%8.4" /end CHARACTERISTIC
/begin CHARACTERISTIC DWPMXNOT "Maximal zul‰ssige Pedalwerterhˆhung pro Rechenschritt im PWG-Ersatzbetrieb" VALUE 0xFC6354 KwUw 100.0000 relPED_uw_b100 0.00 100.0000 FORMAT "%8.4" /end CHARACTERISTIC
/begin CHARACTERISTIC DYADMX "Max. Wert des add. Dynamikvorhalts" VALUE 0xFC67C0 KwUb 24.00 zw_ub_qn0p75 -24.00 0.00 FORMAT "%5.2" /end CHARACTERISTIC
/begin CHARACTERISTIC DYAFVS "Stufenhˆhe f¸r Abregelung des Dynamikvorhalts" VALUE 0xFC67C1 KwUb 19.50 zw_ub_q0p75 0.7500 20.25 FORMAT "%5.2" /end CHARACTERISTIC
/begin CHARACTERISTIC DYAMNV "Min. Wert des add. Dynamikvorhalts" VALUE 0xFC67C2 KwUb 24.00 zw_ub_qn0p75 -24.00 0.00 FORMAT "%5.2" /end CHARACTERISTIC
/begin CHARACTERISTIC DYAVF "Abregelkonstante f¸r Dynamikvorhalt" VALUE 0xFC67C3 KwUb 254.0 dez 1.000 255.0 FORMAT "%5.1" /end CHARACTERISTIC
/begin CHARACTERISTIC DZZST "Anzahl Z‰hne bei Zahnunterdr¸ckung im Start" VALUE 0xFC6436 KwWU8 249.0 dez 6.000 255.0 FORMAT "%5.1" /end CHARACTERISTIC
/begin CHARACTERISTIC ENGENTANS "Schwelle Motortemperatur fuer Freigabe Generaturansaugluft" VALUE 0xFC9524 KwWU8 191.3 temp_ub_q0p75_o48 -48.00 143.3 FORMAT "%5.1" /end CHARACTERISTIC
/begin CHARACTERISTIC EN_MDGEN "Enable Generatormomenteinrechung" VALUE 0xFC9525 KwWU8 255.0 DEZ 0.00 255.0 FORMAT "%5.1" /end CHARACTERISTIC
/begin CHARACTERISTIC FABSTT "Faktor Abstellzeit f¸r Modelltemparatur" CURVE 0xFCE060 KlAUwSstUwWUw 1.999969 fak_uw_b2 0.00 1.999969 FORMAT "%8.6"
 /begin AXIS_DESCR STD_AXIS tabst_w t1sxs_uw_q1 5 0.00 65535.00 FORMAT "%8.2" DEPOSIT ABSOLUTE /end AXIS_DESCR
/end CHARACTERISTIC
/begin CHARACTERISTIC FKELDYA "Korrekturfaktor f¸r Klopferkennungsschwelle bei Lastdynamikadaption" VALUE 0xFC67C4 KwUb 0.6250 fak_ub_b4 0.6250 1.250 FORMAT "%5.3" /end CHARACTERISTIC
/begin CHARACTERISTIC FMDKHFH "Hˆhenkorrektur Drehmomentenreserve f¸r Katheizen" CURVE 0xFCE448 KlAUwSstUwWUw 1.999969 fak_uw_b2 0.00 1.999969 FORMAT "%8.6"
 /begin AXIS_DESCR STD_AXIS fho_w fak_uw_b4 4 0.00 3.999939 FORMAT "%8.6" DEPOSIT ABSOLUTE /end AXIS_DESCR
/end CHARACTERISTIC
/begin CHARACTERISTIC FMDKHTMST "tmst-Korrektur Drehmomentenresrve f¸r Katheizen" CURVE 0xFCE434 KlAUbSstUbWUb 1.992 fak_ub_b2 0.00 1.992 FORMAT "%5.3"
 /begin AXIS_DESCR STD_AXIS tmst temp_ub_q0p75_o48 8 -48.00 143.3 FORMAT "%5.1" DEPOSIT ABSOLUTE /end AXIS_DESCR
/end CHARACTERISTIC
/begin CHARACTERISTIC FSYNDEL "Prozentueller Segmentanteil f¸r erstes Zwangssynchro" VALUE 0xFC6437 KwWU8 50.20 rel_ub_b100 0.00 50.20 FORMAT "%5.2" /end CHARACTERISTIC
/begin CHARACTERISTIC GENDIFAK0 "Stromfaktor Diode0" VALUE 0xFC9526 KwWU8 0.9961 fak_q0p0039 0.00 0.9961 /end CHARACTERISTIC
/begin CHARACTERISTIC GENDIFAK1 "Stromfaktor Diode1" VALUE 0xFC9527 KwWU8 0.9961 fak_q0p0039 0.00 0.9961 /end CHARACTERISTIC
/begin CHARACTERISTIC GENDIFAK2 "Stromfaktor Diode2" VALUE 0xFC9528 KwWU8 0.9961 fak_q0p0039 0.00 0.9961 /end CHARACTERISTIC
/begin CHARACTERISTIC GENDIFAK3 "Stromfaktor Diode3" VALUE 0xFC9529 KwWU8 0.9961 fak_q0p0039 0.00 0.9961 /end CHARACTERISTIC
/begin CHARACTERISTIC GENDIFAK4 "Stromfaktor Diode4" VALUE 0xFC952A KwWU8 0.9961 fak_q0p0039 0.00 0.9961 /end CHARACTERISTIC
/begin CHARACTERISTIC GENDIFAK5 "Stromfaktor Diode" VALUE 0xFC952B KwWU8 0.9961 fak_q0p0039 0.00 0.9961 /end CHARACTERISTIC
/begin CHARACTERISTIC GENDIFAK6 "Stromfaktor Diode6" VALUE 0xFC952C KwWU8 0.9961 fak_q0p0039 0.00 0.9961 /end CHARACTERISTIC
/begin CHARACTERISTIC GENDIFAK7 "Stromfaktor Diode7" VALUE 0xFC952D KwWU8 0.9961 fak_q0p0039 0.00 0.9961 /end CHARACTERISTIC
/begin CHARACTERISTIC GENITYP "Generatorstrotyp 0=gerechnet / 1=gemessen" VALUE 0xFC952E KwWU8 1.000 dez 0.00 1.000 FORMAT "%5.3" /end CHARACTERISTIC
/begin CHARACTERISTIC GENMDOF "Offset des Generatormoments" VALUE 0xFC94A4 KwWU16 99.99847 rel_uw_b100 0.00 99.99847 FORMAT "%8.5" /end CHARACTERISTIC
/begin CHARACTERISTIC GENRS0_0 "Generatorstatorwiderstand0 bei 25∞" VALUE 0xFC94A6 KwWU16 0.9999847 genrstator 0.00 0.9999847 FORMAT "%9.7" /end CHARACTERISTIC
/begin CHARACTERISTIC GENRS0_1 "Generatorstatorwiderstand1 bei 25∞" VALUE 0xFC94A8 KwWU16 0.9999847 genrstator 0.00 0.9999847 FORMAT "%9.7" /end CHARACTERISTIC
/begin CHARACTERISTIC GENRS0_2 "Generatorstatorwiderstand2 bei 25∞" VALUE 0xFC94AA KwWU16 0.9999847 genrstator 0.00 0.9999847 FORMAT "%9.7" /end CHARACTERISTIC
/begin CHARACTERISTIC GENRS0_3 "Generatorstatorwiderstand3 bei 25∞" VALUE 0xFC94AC KwWU16 0.9999847 genrstator 0.00 0.9999847 FORMAT "%9.7" /end CHARACTERISTIC
/begin CHARACTERISTIC GENRS0_4 "Generatorstatorwiderstand4 bei 25∞" VALUE 0xFC94AE KwWU16 0.9999847 genrstator 0.00 0.9999847 FORMAT "%9.7" /end CHARACTERISTIC
/begin CHARACTERISTIC GENRS0_5 "Generatorstatorwiderstand5 bei 25∞" VALUE 0xFC94B0 KwWU16 0.9999847 genrstator 0.00 0.9999847 FORMAT "%9.7" /end CHARACTERISTIC
/begin CHARACTERISTIC GENRS0_6 "Generatorstatorwiderstand6 bei 25∞" VALUE 0xFC94B2 KwWU16 0.9999847 genrstator 0.00 0.9999847 FORMAT "%9.7" /end CHARACTERISTIC
/begin CHARACTERISTIC GENRS0_7 "Generatorstatorwiderstand7 bei 25∞" VALUE 0xFC94B4 KwWU16 0.9999847 genrstator 0.00 0.9999847 FORMAT "%9.7" /end CHARACTERISTIC
/begin CHARACTERISTIC GENSTFAK0 "Stromfaktor Statorspule0" VALUE 0xFC952F KwWU8 0.9961 fak_q0p0039 0.00 0.9961 /end CHARACTERISTIC
/begin CHARACTERISTIC GENSTFAK1 "Stromfaktor Statorspule" VALUE 0xFC9530 KwWU8 0.9961 fak_q0p0039 0.00 0.9961 /end CHARACTERISTIC
/begin CHARACTERISTIC GENSTFAK2 "Stromfaktor Statorspule2" VALUE 0xFC9531 KwWU8 0.9961 fak_q0p0039 0.00 0.9961 /end CHARACTERISTIC
/begin CHARACTERISTIC GENSTFAK3 "Stromfaktor Statorspule3" VALUE 0xFC9532 KwWU8 0.9961 fak_q0p0039 0.00 0.9961 /end CHARACTERISTIC
/begin CHARACTERISTIC GENSTFAK4 "Stromfaktor Statorspule4" VALUE 0xFC9533 KwWU8 0.9961 fak_q0p0039 0.00 0.9961 /end CHARACTERISTIC
/begin CHARACTERISTIC GENSTFAK5 "Stromfaktor Statorspule5" VALUE 0xFC9534 KwWU8 0.9961 fak_q0p0039 0.00 0.9961 /end CHARACTERISTIC
/begin CHARACTERISTIC GENSTFAK6 "Stromfaktor Statorspule6" VALUE 0xFC9535 KwWU8 0.9961 fak_q0p0039 0.00 0.9961 /end CHARACTERISTIC
/begin CHARACTERISTIC GENSTFAK7 "Stromfaktor Statorspule7" VALUE 0xFC9536 KwWU8 0.9961 fak_q0p0039 0.00 0.9961 /end CHARACTERISTIC
/begin CHARACTERISTIC GENTEMPAPP "Geneeratortemperatur mauelle Vorgabe" VALUE 0xFC94B6 KwWU16 384.0000 temp_uw_q0p75_o48 -48.00000 336.0000 FORMAT "%8.4" /end CHARACTERISTIC
/begin CHARACTERISTIC GENTEMPMAN "Manuelle Generatorvorgabe" VALUE 0xFC9537 KwWU8 255.0 dez 0.00 255.0 FORMAT "%5.1" /end CHARACTERISTIC
/begin CHARACTERISTIC GENTMOTDT "Offset Generatorwassertemperatur" VALUE 0xFC9538 KwWU8 191.3 temp_ub_q0p75_o48 -48.00 143.3 FORMAT "%5.1" /end CHARACTERISTIC
/begin CHARACTERISTIC GENTMOTOF0 "" VALUE 0xFC9539 KwWU8 191.3 temp_ub_q0p75_o48 -48.00 143.3 FORMAT "%5.1" /end CHARACTERISTIC
/begin CHARACTERISTIC GENTMOTOF1 "" VALUE 0xFC953A KwWU8 191.3 temp_ub_q0p75_o48 -48.00 143.3 FORMAT "%5.1" /end CHARACTERISTIC
/begin CHARACTERISTIC GENTMOTOF2 "" VALUE 0xFC953B KwWU8 191.3 temp_ub_q0p75_o48 -48.00 143.3 FORMAT "%5.1" /end CHARACTERISTIC
/begin CHARACTERISTIC GENTMOTOF3 "" VALUE 0xFC953C KwWU8 191.3 temp_ub_q0p75_o48 -48.00 143.3 FORMAT "%5.1" /end CHARACTERISTIC
/begin CHARACTERISTIC GENTMOTOF4 "" VALUE 0xFC953D KwWU8 191.3 temp_ub_q0p75_o48 -48.00 143.3 FORMAT "%5.1" /end CHARACTERISTIC
/begin CHARACTERISTIC GENTMOTOF5 "" VALUE 0xFC953E KwWU8 191.3 temp_ub_q0p75_o48 -48.00 143.3 FORMAT "%5.1" /end CHARACTERISTIC
/begin CHARACTERISTIC GENTMOTOF6 "" VALUE 0xFC953F KwWU8 191.3 temp_ub_q0p75_o48 -48.00 143.3 FORMAT "%5.1" /end CHARACTERISTIC
/begin CHARACTERISTIC GENTMOTOF7 "" VALUE 0xFC9540 KwWU8 191.3 temp_ub_q0p75_o48 -48.00 143.3 FORMAT "%5.1" /end CHARACTERISTIC
/begin CHARACTERISTIC GENTYP "Generatortyp" VALUE 0xFC9541 KwWU8 255.0 dez 0.00 255.0 FORMAT "%5.1" /end CHARACTERISTIC
/begin CHARACTERISTIC GENTYPFELD "Generatorkennfeldzuordnung" VAL_BLK 0xFC9484 KwbWU8 255.0 DEZ 0.00 255.0 FORMAT "%5.1" NUMBER 32 /end CHARACTERISTIC
/begin CHARACTERISTIC GENUEBSETZ0 "" VALUE 0xFC9542 KwWU8 3.984 genuebsetzung2 0.00 3.984 FORMAT "%5.3" /end CHARACTERISTIC
/begin CHARACTERISTIC GENUEBSETZ1 "" VALUE 0xFC9543 KwWU8 3.984 genuebsetzung2 0.00 3.984 FORMAT "%5.3" /end CHARACTERISTIC
/begin CHARACTERISTIC GENUEBSETZ2 "" VALUE 0xFC9544 KwWU8 3.984 genuebsetzung2 0.00 3.984 FORMAT "%5.3" /end CHARACTERISTIC
/begin CHARACTERISTIC GENUEBSETZ3 "" VALUE 0xFC9545 KwWU8 3.984 genuebsetzung2 0.00 3.984 FORMAT "%5.3" /end CHARACTERISTIC
/begin CHARACTERISTIC GENUEBSETZ4 "" VALUE 0xFC9546 KwWU8 3.984 genuebsetzung2 0.00 3.984 FORMAT "%5.3" /end CHARACTERISTIC
/begin CHARACTERISTIC GENUEBSETZ5 "" VALUE 0xFC9547 KwWU8 3.984 genuebsetzung2 0.00 3.984 FORMAT "%5.3" /end CHARACTERISTIC
/begin CHARACTERISTIC GENUEBSETZ6 "" VALUE 0xFC9548 KwWU8 3.984 genuebsetzung2 0.00 3.984 FORMAT "%5.3" /end CHARACTERISTIC
/begin CHARACTERISTIC GENUEBSETZ7 "" VALUE 0xFC9549 KwWU8 3.984 genuebsetzung2 0.00 3.984 FORMAT "%5.3" /end CHARACTERISTIC
/begin CHARACTERISTIC GENUMGTYP "Generatorluftumgebung" VALUE 0xFC954A KwWU8 255.0 dez 0.00 255.0 FORMAT "%5.1" /end CHARACTERISTIC
/begin CHARACTERISTIC GENVFZGSW "geschwindigkeitsabh‰ngige Generatoransaugluftschwelle" VALUE 0xFC954B KwWU8 318.8 vfzg_ub_q1p25 0.00 318.8 FORMAT "%5.1" /end CHARACTERISTIC
/begin CHARACTERISTIC GEN_IG_OF "Offsetwert Generatorstrom" VALUE 0xFC94B8 KwWU16 254.0000 igen_uw_q0p03125 0.00 254.0000 FORMAT "%8.4" /end CHARACTERISTIC
/begin CHARACTERISTIC HKW_dT_HKW_IMPL "" VALUE 0xFC6BEE KwWU16 1.000000 fak_uw_q0p001 0.00 1.000000 FORMAT "%8.6" READ_ONLY /end CHARACTERISTIC
/begin CHARACTERISTIC HKW_IKL "I-Verst‰rkung unter HKW_IWIN" VALUE 0xFC6BF0 KwWU16 10.00000 fak_uw_q0p001 0.00 10.00000 FORMAT "%8.5" /end CHARACTERISTIC
/begin CHARACTERISTIC HKW_ING "negative I-Verst‰rkung ¸ber HKW_IWIN" VALUE 0xFC6BF2 KwWU16 10.00000 fak_uw_q0p001 0.00 10.00000 FORMAT "%8.5" /end CHARACTERISTIC
/begin CHARACTERISTIC HKW_IPG "positive I-Verst‰rkung ¸ber HKW_IWIN" VALUE 0xFC6BF4 KwWU16 10.00000 fak_uw_q0p001 0.00 10.00000 FORMAT "%8.5" /end CHARACTERISTIC
/begin CHARACTERISTIC HKW_IWIN "Schwelle zur Umschaltung I-Verst‰rkung" VALUE 0xFC6BF6 KwWS16 200.0000 rel_ub_b100 -100.0000 100.0000 FORMAT "%8.4" /end CHARACTERISTIC
/begin CHARACTERISTIC HKW_NO "oberer Schwellwert Hysterese Motordrehzahl" VALUE 0xFC6C01 KwWU8 10200. nmot_ub_q40 0.00 10200. FORMAT "%5.0" /end CHARACTERISTIC
/begin CHARACTERISTIC HKW_NSTMX "max. neg. Steigung f¸r die Heizleistung ehz_pw" VALUE 0xFC6C02 KwWU8 100.0 rel_ub_b100 0.00 100.0 FORMAT "%5.1" /end CHARACTERISTIC
/begin CHARACTERISTIC HKW_NU "unterer Schwellwert Hysterese Motordrehzahl" VALUE 0xFC6C03 KwWU8 10200. nmot_ub_q40 0.00 10200. FORMAT "%5.0" /end CHARACTERISTIC
/begin CHARACTERISTIC HKW_PIMAX "max. Begrenzung f¸r die Heizleistung ehz_pw" VALUE 0xFC6C04 KwWU8 99.61 rel_ub_b100 0.00 99.61 FORMAT "%5.2" /end CHARACTERISTIC
/begin CHARACTERISTIC HKW_PKL "P-Verst‰rkung unter HKW_PWIN" VALUE 0xFC6BF8 KwWU16 10.00000 fak_uw_q0p001 0.00 10.00000 FORMAT "%8.5" /end CHARACTERISTIC
/begin CHARACTERISTIC HKW_PNG "negative P-Verst‰rkung ¸ber HKW_PWIN" VALUE 0xFC6BFA KwWU16 10.00000 fak_uw_q0p001 0.00 10.00000 FORMAT "%8.5" /end CHARACTERISTIC
/begin CHARACTERISTIC HKW_PPG "positive P-Verst‰rkung ¸ber HKW_PWIN" VALUE 0xFC6BFC KwWU16 10.00000 fak_uw_q0p001 0.00 10.00000 FORMAT "%8.5" /end CHARACTERISTIC
/begin CHARACTERISTIC HKW_PSTMX "max. pos. Steigung f¸r die Heizleistung ehz_pw" VALUE 0xFC6C05 KwWU8 100.0 rel_ub_b100 0.00 100.0 FORMAT "%5.1" /end CHARACTERISTIC
/begin CHARACTERISTIC HKW_PWIN "Schwelle zur Umschaltung P-Verst‰rkung" VALUE 0xFC6BFE KwWS16 200.0000 rel_ub_b100 -100.0000 100.0000 FORMAT "%8.4" /end CHARACTERISTIC
/begin CHARACTERISTIC HKW_TGFVT "Verzˆgerungszeit Abschaltbedingung B_genoff" VALUE 0xFC6C06 KwWU8 255.0 t1sxs_ub_q1 0.00 255.0 FORMAT "%5.1" /end CHARACTERISTIC
/begin CHARACTERISTIC HKW_TGL "Tiefpass-Zeitkonstante f¸r Bildung der Sollgrˆﬂe Generatorlast" VALUE 0xFC6C07 KwWU8 254.0 t1sxs_ub_q1 1.000 255.0 FORMAT "%5.1" /end CHARACTERISTIC
/begin CHARACTERISTIC HKW_TRGL "Tiefpass-Zeitkonstante f¸r Bildung der Istgrˆﬂe Generatorlast" VALUE 0xFC6C08 KwWU8 254.0 t1sxs_ub_q1 1.000 255.0 FORMAT "%5.1" /end CHARACTERISTIC
/begin CHARACTERISTIC HKW_TSTTV "verzˆgertes Einschalten der EZH nach Startende" VALUE 0xFC6C09 KwWU8 255.0 t1sxs_ub_q1 0.00 255.0 FORMAT "%5.1" /end CHARACTERISTIC
/begin CHARACTERISTIC HKW_UBO "oberer Schwellwert Hysterese Batteriespg." VALUE 0xFC6C0A KwWU8 24.02 spg_ubatt 0.00 24.02 FORMAT "%5.2" /end CHARACTERISTIC
/begin CHARACTERISTIC HKW_UBU "unterer Schwellwert Hysterese Batteriespg." VALUE 0xFC6C0B KwWU8 24.02 spg_ubatt 0.00 24.02 FORMAT "%5.2" /end CHARACTERISTIC
/begin CHARACTERISTIC HKW_WTHY "Parameter zur Bildung unterer Schwellwert Hysterese K¸hlwassertemp." VALUE 0xFC6C0C KwWU8 191.3 temp_ub_q0p75_o48 -48.00 143.3 FORMAT "%5.1" /end CHARACTERISTIC
/begin CHARACTERISTIC HKW_WTOFF "Offset Kennfeldk¸hlung" VALUE 0xFC6C0D KwWU8 99.75 temp_ub_q0p75_o48 0.00 99.75 FORMAT "%5.1" /end CHARACTERISTIC
/begin CHARACTERISTIC HKW_WTOFF2 "Parameter zur Bildung unterer Schwellwert Hysterese K¸hlwassertemp. (B_hkwoff7)" VALUE 0xFC6C0E KwWU8 99.75 temp_ub_q0p75_o48 0.00 99.75 FORMAT "%5.1" /end CHARACTERISTIC
/begin CHARACTERISTIC IGBASIS "" VALUE 0xFC954C KwWU8 255.0 igen_ub_q1 0.00 255.0 FORMAT "%5.1" /end CHARACTERISTIC
/begin CHARACTERISTIC IGBASISOFF "" VALUE 0xFC954D KwWU8 255.0 igen_ub_q1 0.00 255.0 FORMAT "%5.1" /end CHARACTERISTIC
/begin CHARACTERISTIC IGNOTWERT "" VALUE 0xFC954E KwWU8 255.0 igen_ub_q1 0.00 255.0 FORMAT "%5.1" /end CHARACTERISTIC
/begin CHARACTERISTIC IMTUMGTA "Schwelle integrierte Luftmasse f¸r Bestimmung Umgebungstemperatur" VALUE 0xFCE102 KwUb 23.21 m_ub_b23p3 0.00 23.21 FORMAT "%5.2" /end CHARACTERISTIC
/begin CHARACTERISTIC KFBS "Kennfeld f¸r banksel. Gemischfaktor" MAP 0xFC4FD2 KfAxUbAyUbSstxUbSstyUbWSb 0.4980 fak_sb_b0p25 -0.2500 0.2480
 /begin AXIS_DESCR STD_AXIS nmot nmot_ub_q40 16 0.00 10200. FORMAT "%5.0" DEPOSIT ABSOLUTE /end AXIS_DESCR
 /begin AXIS_DESCR STD_AXIS rl rel_ub_q0p75 16 0.00 191.3 FORMAT "%5.1" DEPOSIT ABSOLUTE /end AXIS_DESCR
/end CHARACTERISTIC
/begin CHARACTERISTIC KFDTMTE "Kennfeld Motortemperaturgradient f¸r Ersatztemperatur" MAP 0xFCE076 KfAxUbAyUbSstxUbSstyUbWSb 0.1868 temp_sb_b0p093 -0.09375 0.09302 FORMAT "%7.5"
 /begin AXIS_DESCR STD_AXIS mll1 m_ub_b1020 5 0.00 1020. FORMAT "%5.0" DEPOSIT ABSOLUTE /end AXIS_DESCR
 /begin AXIS_DESCR STD_AXIS tmew temp_ub_q0p75_o48 4 -48.00 143.3 FORMAT "%5.1" DEPOSIT ABSOLUTE /end AXIS_DESCR
/end CHARACTERISTIC
/begin CHARACTERISTIC KFDTMTR "Kennfeld Motortemperaturgradient f¸r Referenztemperatur" MAP 0xFCE095 KfAxUbAyUbSstxUbSstyUbWSb 0.1868 temp_sb_b0p093 -0.09375 0.09302 FORMAT "%7.5"
 /begin AXIS_DESCR STD_AXIS mll1 m_ub_b1020 5 0.00 1020. FORMAT "%5.0" DEPOSIT ABSOLUTE /end AXIS_DESCR
 /begin AXIS_DESCR STD_AXIS tmrw temp_ub_q0p75_o48 4 -48.00 143.3 FORMAT "%5.1" DEPOSIT ABSOLUTE /end AXIS_DESCR
/end CHARACTERISTIC
/begin CHARACTERISTIC KFDTMTU "Kennfeld Korrekturgradient Motortemperatur bei geringer Erw‰rmung" MAP 0xFCE0B4 KfAxUbAyUbSstxUbSstyUbWSb 0.1868 temp_sb_b0p093 -0.09375 0.09302 FORMAT "%7.5"
 /begin AXIS_DESCR STD_AXIS mll1 m_ub_b1020 5 0.00 1020. FORMAT "%5.0" DEPOSIT ABSOLUTE /end AXIS_DESCR
 /begin AXIS_DESCR STD_AXIS tum temp_ub_q0p75_o48 4 -48.00 143.3 FORMAT "%5.1" DEPOSIT ABSOLUTE /end AXIS_DESCR
/end CHARACTERISTIC
/begin CHARACTERISTIC KFDYESEH "Lastdynamikerkennungsschwelle" MAP 0xFC66A0 GkfWS16 32.76700 hub_uw_q0p001 0.00 32.76700 FORMAT "%8.5"
 /begin AXIS_DESCR COM_AXIS nmot_w nmot_uw_q0p25 12 0.00 16383.75 FORMAT "%8.2" AXIS_PTS_REF SNM12KRUW /end AXIS_DESCR
 /begin AXIS_DESCR COM_AXIS evhubi_w hub_uw_q0p001 6 0.00 65.53500 FORMAT "%8.5" AXIS_PTS_REF SEH06KRUW /end AXIS_DESCR
/end CHARACTERISTIC
/begin CHARACTERISTIC KFDYESEHOF "Dynamikvorhalt Offsetschwelle" MAP 0xFC6730 GkfWS16 32.76700 hub_uw_q0p001 0.00 32.76700 FORMAT "%8.5"
 /begin AXIS_DESCR COM_AXIS nmot_w nmot_uw_q0p25 12 0.00 16383.75 FORMAT "%8.2" AXIS_PTS_REF SNM12KRUW /end AXIS_DESCR
 /begin AXIS_DESCR COM_AXIS evhubi_w hub_uw_q0p001 6 0.00 65.53500 FORMAT "%8.5" AXIS_PTS_REF SEH06KRUW /end AXIS_DESCR
/end CHARACTERISTIC
/begin CHARACTERISTIC KFDYESPF "Lastdynamikerkennungsschwelle" MAP 0xFCE994 GkfWS16 2559.961 p_sw_q0p039 -1280.000 1279.961 FORMAT "%8.3"
 /begin AXIS_DESCR COM_AXIS nmot_w nmot_uw_q0p25 12 0.00 16383.75 FORMAT "%8.2" AXIS_PTS_REF SNM12KRUW /end AXIS_DESCR
 /begin AXIS_DESCR COM_AXIS rl rel_ub_q0p75 8 0.00 191.3 FORMAT "%5.1" AXIS_PTS_REF SRL08DYUB /end AXIS_DESCR
/end CHARACTERISTIC
/begin CHARACTERISTIC KFDYESPFOF "Dynamikvorhalt Offsetschwelle" MAP 0xFCEA54 GkfWS16 2559.961 p_sw_q0p039 -1280.000 1279.961 FORMAT "%8.3"
 /begin AXIS_DESCR COM_AXIS nmot_w nmot_uw_q0p25 12 0.00 16383.75 FORMAT "%8.2" AXIS_PTS_REF SNM12KRUW /end AXIS_DESCR
 /begin AXIS_DESCR COM_AXIS rl rel_ub_q0p75 8 0.00 191.3 FORMAT "%5.1" AXIS_PTS_REF SRL08DYUB /end AXIS_DESCR
/end CHARACTERISTIC
/begin CHARACTERISTIC KFDYWVS "vorgesteuerter Dynamikvorhalt" MAP 0xFCEB5C KfAxUbAyUbSstxUbSstyUbWUb 191.3 zw_ub_qn0p75 -191.3 0.00 FORMAT "%5.1"
 /begin AXIS_DESCR STD_AXIS tans temp_ub_q0p75_o48 6 -48.00 143.3 FORMAT "%5.1" DEPOSIT ABSOLUTE /end AXIS_DESCR
 /begin AXIS_DESCR STD_AXIS nmot nmot_ub_q40 6 0.00 10200. FORMAT "%5.0" DEPOSIT ABSOLUTE /end AXIS_DESCR
/end CHARACTERISTIC
/begin CHARACTERISTIC KFGENWETA0 "Wirkungsgrad0 Generator mit 2*PI" MAP 0xFC8484 KfAxU8AyU8SstxU8SstyU16WU8 7.969 geneta_q0p03125 0.00 7.969 FORMAT "%5.3"
 /begin AXIS_DESCR STD_AXIS igm igen_ub_q1 8 0.00 255.0 FORMAT "%5.1" DEPOSIT ABSOLUTE /end AXIS_DESCR
 /begin AXIS_DESCR STD_AXIS ngen_w ngen_uw_q0p5 8 0.00 32767.50 FORMAT "%8.2" DEPOSIT ABSOLUTE /end AXIS_DESCR
/end CHARACTERISTIC
/begin CHARACTERISTIC KFGENWETA1 "Wirkungsgrad1 Generator mit 2*PI" MAP 0xFC84DE KfAxU8AyU8SstxU8SstyU16WU8 7.969 geneta_q0p03125 0.00 7.969 FORMAT "%5.3"
 /begin AXIS_DESCR STD_AXIS igm igen_ub_q1 8 0.00 255.0 FORMAT "%5.1" DEPOSIT ABSOLUTE /end AXIS_DESCR
 /begin AXIS_DESCR STD_AXIS ngen_w ngen_uw_q0p5 8 0.00 32767.50 FORMAT "%8.2" DEPOSIT ABSOLUTE /end AXIS_DESCR
/end CHARACTERISTIC
/begin CHARACTERISTIC KFGENWETA2 "Wirkungsgrad2 Generator mit 2*PI" MAP 0xFC8538 KfAxU8AyU8SstxU8SstyU16WU8 7.969 geneta_q0p03125 0.00 7.969 FORMAT "%5.3"
 /begin AXIS_DESCR STD_AXIS igm igen_ub_q1 8 0.00 255.0 FORMAT "%5.1" DEPOSIT ABSOLUTE /end AXIS_DESCR
 /begin AXIS_DESCR STD_AXIS ngen_w ngen_uw_q0p5 8 0.00 32767.50 FORMAT "%8.2" DEPOSIT ABSOLUTE /end AXIS_DESCR
/end CHARACTERISTIC
/begin CHARACTERISTIC KFGENWETA3 "Wirkungsgrad3 Generator mit 2*PI" MAP 0xFC8592 KfAxU8AyU8SstxU8SstyU16WU8 7.969 geneta_q0p03125 0.00 7.969 FORMAT "%5.3"
 /begin AXIS_DESCR STD_AXIS igm igen_ub_q1 8 0.00 255.0 FORMAT "%5.1" DEPOSIT ABSOLUTE /end AXIS_DESCR
 /begin AXIS_DESCR STD_AXIS ngen_w ngen_uw_q0p5 8 0.00 32767.50 FORMAT "%8.2" DEPOSIT ABSOLUTE /end AXIS_DESCR
/end CHARACTERISTIC
/begin CHARACTERISTIC KFGENWETA4 "Wirkungsgrad4 Generator mit 2*PI" MAP 0xFC85EC KfAxU8AyU8SstxU8SstyU16WU8 7.969 geneta_q0p03125 0.00 7.969 FORMAT "%5.3"
 /begin AXIS_DESCR STD_AXIS igm igen_ub_q1 8 0.00 255.0 FORMAT "%5.1" DEPOSIT ABSOLUTE /end AXIS_DESCR
 /begin AXIS_DESCR STD_AXIS ngen_w ngen_uw_q0p5 8 0.00 32767.50 FORMAT "%8.2" DEPOSIT ABSOLUTE /end AXIS_DESCR
/end CHARACTERISTIC
/begin CHARACTERISTIC KFGENWETA5 "Wirkungsgrad5 Generator mit 2*PI" MAP 0xFC8646 KfAxU8AyU8SstxU8SstyU16WU8 7.969 geneta_q0p03125 0.00 7.969 FORMAT "%5.3"
 /begin AXIS_DESCR STD_AXIS igm igen_ub_q1 8 0.00 255.0 FORMAT "%5.1" DEPOSIT ABSOLUTE /end AXIS_DESCR
 /begin AXIS_DESCR STD_AXIS ngen_w ngen_uw_q0p5 8 0.00 32767.50 FORMAT "%8.2" DEPOSIT ABSOLUTE /end AXIS_DESCR
/end CHARACTERISTIC
/begin CHARACTERISTIC KFGENWETA6 "Wirkungsgrad6 Generator mit 2*PI" MAP 0xFC86A0 KfAxU8AyU8SstxU8SstyU16WU8 7.969 geneta_q0p03125 0.00 7.969 FORMAT "%5.3"
 /begin AXIS_DESCR STD_AXIS igm igen_ub_q1 8 0.00 255.0 FORMAT "%5.1" DEPOSIT ABSOLUTE /end AXIS_DESCR
 /begin AXIS_DESCR STD_AXIS ngen_w ngen_uw_q0p5 8 0.00 32767.50 FORMAT "%8.2" DEPOSIT ABSOLUTE /end AXIS_DESCR
/end CHARACTERISTIC
/begin CHARACTERISTIC KFGENWETA7 "Wirkungsgrad7 Generator mit 2*PI" MAP 0xFC86FA KfAxU8AyU8SstxU8SstyU16WU8 7.969 geneta_q0p03125 0.00 7.969 FORMAT "%5.3"
 /begin AXIS_DESCR STD_AXIS igm igen_ub_q1 8 0.00 255.0 FORMAT "%5.1" DEPOSIT ABSOLUTE /end AXIS_DESCR
 /begin AXIS_DESCR STD_AXIS ngen_w ngen_uw_q0p5 8 0.00 32767.50 FORMAT "%8.2" DEPOSIT ABSOLUTE /end AXIS_DESCR
/end CHARACTERISTIC
/begin CHARACTERISTIC KFIGENDF0 "Generatorstrom0 DF-Kennfeld" MAP 0xFC8C34 KfAxU8AyU8SstxU8SstyU8WU8 255.0 igen_ub_q1 0.00 255.0 FORMAT "%5.1"
 /begin AXIS_DESCR STD_AXIS dffgen rel_ub_b100 7 0.00 99.61 FORMAT "%5.2" DEPOSIT ABSOLUTE /end AXIS_DESCR
 /begin AXIS_DESCR STD_AXIS genitemp igen_ub_q1 8 0.00 255.0 FORMAT "%5.1" DEPOSIT ABSOLUTE /end AXIS_DESCR
/end CHARACTERISTIC
/begin CHARACTERISTIC KFIGENDF1 "Generatorstrom1 DF-Kennfeld" MAP 0xFC8C80 KfAxU8AyU8SstxU8SstyU8WU8 255.0 igen_ub_q1 0.00 255.0 FORMAT "%5.1"
 /begin AXIS_DESCR STD_AXIS dffgen rel_ub_b100 7 0.00 99.61 FORMAT "%5.2" DEPOSIT ABSOLUTE /end AXIS_DESCR
 /begin AXIS_DESCR STD_AXIS genitemp igen_ub_q1 8 0.00 255.0 FORMAT "%5.1" DEPOSIT ABSOLUTE /end AXIS_DESCR
/end CHARACTERISTIC
/begin CHARACTERISTIC KFIGENDF2 "Generatorstrom2 DF-Kennfeld" MAP 0xFC8CCC KfAxU8AyU8SstxU8SstyU8WU8 255.0 igen_ub_q1 0.00 255.0 FORMAT "%5.1"
 /begin AXIS_DESCR STD_AXIS dffgen rel_ub_b100 7 0.00 99.61 FORMAT "%5.2" DEPOSIT ABSOLUTE /end AXIS_DESCR
 /begin AXIS_DESCR STD_AXIS genitemp igen_ub_q1 8 0.00 255.0 FORMAT "%5.1" DEPOSIT ABSOLUTE /end AXIS_DESCR
/end CHARACTERISTIC
/begin CHARACTERISTIC KFIGENDF3 "Generatorstrom3 DF-Kennfeld" MAP 0xFC8D18 KfAxU8AyU8SstxU8SstyU8WU8 255.0 igen_ub_q1 0.00 255.0 FORMAT "%5.1"
 /begin AXIS_DESCR STD_AXIS dffgen rel_ub_b100 7 0.00 99.61 FORMAT "%5.2" DEPOSIT ABSOLUTE /end AXIS_DESCR
 /begin AXIS_DESCR STD_AXIS genitemp igen_ub_q1 8 0.00 255.0 FORMAT "%5.1" DEPOSIT ABSOLUTE /end AXIS_DESCR
/end CHARACTERISTIC
/begin CHARACTERISTIC KFIGENDF4 "Generatorstrom4 DF-Kennfeld" MAP 0xFC8D64 KfAxU8AyU8SstxU8SstyU8WU8 255.0 igen_ub_q1 0.00 255.0 FORMAT "%5.1"
 /begin AXIS_DESCR STD_AXIS dffgen rel_ub_b100 7 0.00 99.61 FORMAT "%5.2" DEPOSIT ABSOLUTE /end AXIS_DESCR
 /begin AXIS_DESCR STD_AXIS genitemp igen_ub_q1 8 0.00 255.0 FORMAT "%5.1" DEPOSIT ABSOLUTE /end AXIS_DESCR
/end CHARACTERISTIC
/begin CHARACTERISTIC KFIGENDF5 "Generatorstrom5 DF-Kennfeld" MAP 0xFC8DB0 KfAxU8AyU8SstxU8SstyU8WU8 255.0 igen_ub_q1 0.00 255.0 FORMAT "%5.1"
 /begin AXIS_DESCR STD_AXIS dffgen rel_ub_b100 7 0.00 99.61 FORMAT "%5.2" DEPOSIT ABSOLUTE /end AXIS_DESCR
 /begin AXIS_DESCR STD_AXIS genitemp igen_ub_q1 8 0.00 255.0 FORMAT "%5.1" DEPOSIT ABSOLUTE /end AXIS_DESCR
/end CHARACTERISTIC
/begin CHARACTERISTIC KFIGENDF6 "Generatorstrom6 DF-Kennfeld" MAP 0xFC8DFC KfAxU8AyU8SstxU8SstyU8WU8 255.0 igen_ub_q1 0.00 255.0 FORMAT "%5.1"
 /begin AXIS_DESCR STD_AXIS dffgen rel_ub_b100 7 0.00 99.61 FORMAT "%5.2" DEPOSIT ABSOLUTE /end AXIS_DESCR
 /begin AXIS_DESCR STD_AXIS genitemp igen_ub_q1 8 0.00 255.0 FORMAT "%5.1" DEPOSIT ABSOLUTE /end AXIS_DESCR
/end CHARACTERISTIC
/begin CHARACTERISTIC KFIGENDF7 "Generatorstrom7 DF-Kennfeld" MAP 0xFC8E48 KfAxU8AyU8SstxU8SstyU8WU8 255.0 igen_ub_q1 0.00 255.0 FORMAT "%5.1"
 /begin AXIS_DESCR STD_AXIS dffgen rel_ub_b100 7 0.00 99.61 FORMAT "%5.2" DEPOSIT ABSOLUTE /end AXIS_DESCR
 /begin AXIS_DESCR STD_AXIS genitemp igen_ub_q1 8 0.00 255.0 FORMAT "%5.1" DEPOSIT ABSOLUTE /end AXIS_DESCR
/end CHARACTERISTIC
/begin CHARACTERISTIC KFIGENKA0 "" MAP 0xFC8754 KfAxU8AyU8SstxU8SstyU16WU8 255.0 igen_ub_q1 0.00 255.0 FORMAT "%5.1"
 /begin AXIS_DESCR STD_AXIS ugen spg_ugen 7 10.60 36.10 FORMAT "%5.2" DEPOSIT ABSOLUTE /end AXIS_DESCR
 /begin AXIS_DESCR STD_AXIS ngen_w ngen_uw_q0p5 9 0.00 32767.50 FORMAT "%8.2" DEPOSIT ABSOLUTE /end AXIS_DESCR
/end CHARACTERISTIC
/begin CHARACTERISTIC KFIGENKA1 "" MAP 0xFC87B0 KfAxU8AyU8SstxU8SstyU16WU8 255.0 igen_ub_q1 0.00 255.0 FORMAT "%5.1"
 /begin AXIS_DESCR STD_AXIS ugen spg_ugen 7 10.60 36.10 FORMAT "%5.2" DEPOSIT ABSOLUTE /end AXIS_DESCR
 /begin AXIS_DESCR STD_AXIS ngen_w ngen_uw_q0p5 9 0.00 32767.50 FORMAT "%8.2" DEPOSIT ABSOLUTE /end AXIS_DESCR
/end CHARACTERISTIC
/begin CHARACTERISTIC KFIGENKA2 "" MAP 0xFC880C KfAxU8AyU8SstxU8SstyU16WU8 255.0 igen_ub_q1 0.00 255.0 FORMAT "%5.1"
 /begin AXIS_DESCR STD_AXIS ugen spg_ugen 7 10.60 36.10 FORMAT "%5.2" DEPOSIT ABSOLUTE /end AXIS_DESCR
 /begin AXIS_DESCR STD_AXIS ngen_w ngen_uw_q0p5 9 0.00 32767.50 FORMAT "%8.2" DEPOSIT ABSOLUTE /end AXIS_DESCR
/end CHARACTERISTIC
/begin CHARACTERISTIC KFIGENKA3 "" MAP 0xFC8868 KfAxU8AyU8SstxU8SstyU16WU8 255.0 igen_ub_q1 0.00 255.0 FORMAT "%5.1"
 /begin AXIS_DESCR STD_AXIS ugen spg_ugen 7 10.60 36.10 FORMAT "%5.2" DEPOSIT ABSOLUTE /end AXIS_DESCR
 /begin AXIS_DESCR STD_AXIS ngen_w ngen_uw_q0p5 9 0.00 32767.50 FORMAT "%8.2" DEPOSIT ABSOLUTE /end AXIS_DESCR
/end CHARACTERISTIC
/begin CHARACTERISTIC KFIGENKA4 "" MAP 0xFC88C4 KfAxU8AyU8SstxU8SstyU16WU8 255.0 igen_ub_q1 0.00 255.0 FORMAT "%5.1"
 /begin AXIS_DESCR STD_AXIS ugen spg_ugen 7 10.60 36.10 FORMAT "%5.2" DEPOSIT ABSOLUTE /end AXIS_DESCR
 /begin AXIS_DESCR STD_AXIS ngen_w ngen_uw_q0p5 9 0.00 32767.50 FORMAT "%8.2" DEPOSIT ABSOLUTE /end AXIS_DESCR
/end CHARACTERISTIC
/begin CHARACTERISTIC KFIGENKA5 "" MAP 0xFC8920 KfAxU8AyU8SstxU8SstyU16WU8 255.0 igen_ub_q1 0.00 255.0 FORMAT "%5.1"
 /begin AXIS_DESCR STD_AXIS ugen spg_ugen 7 10.60 36.10 FORMAT "%5.2" DEPOSIT ABSOLUTE /end AXIS_DESCR
 /begin AXIS_DESCR STD_AXIS ngen_w ngen_uw_q0p5 9 0.00 32767.50 FORMAT "%8.2" DEPOSIT ABSOLUTE /end AXIS_DESCR
/end CHARACTERISTIC
/begin CHARACTERISTIC KFIGENKA6 "" MAP 0xFC897C KfAxU8AyU8SstxU8SstyU16WU8 255.0 igen_ub_q1 0.00 255.0 FORMAT "%5.1"
 /begin AXIS_DESCR STD_AXIS ugen spg_ugen 7 10.60 36.10 FORMAT "%5.2" DEPOSIT ABSOLUTE /end AXIS_DESCR
 /begin AXIS_DESCR STD_AXIS ngen_w ngen_uw_q0p5 9 0.00 32767.50 FORMAT "%8.2" DEPOSIT ABSOLUTE /end AXIS_DESCR
/end CHARACTERISTIC
/begin CHARACTERISTIC KFIGENKA7 "" MAP 0xFC89D8 KfAxU8AyU8SstxU8SstyU16WU8 255.0 igen_ub_q1 0.00 255.0 FORMAT "%5.1"
 /begin AXIS_DESCR STD_AXIS ugen spg_ugen 7 10.60 36.10 FORMAT "%5.2" DEPOSIT ABSOLUTE /end AXIS_DESCR
 /begin AXIS_DESCR STD_AXIS ngen_w ngen_uw_q0p5 9 0.00 32767.50 FORMAT "%8.2" DEPOSIT ABSOLUTE /end AXIS_DESCR
/end CHARACTERISTIC
/begin CHARACTERISTIC KFIGENWA0 "" MAP 0xFC8A34 KfAxU8AyU8SstxU8SstyU16WU8 255.0 igen_ub_q1 0.00 255.0 FORMAT "%5.1"
 /begin AXIS_DESCR STD_AXIS genikaltun igen_ub_q1 6 0.00 255.0 FORMAT "%5.1" DEPOSIT ABSOLUTE /end AXIS_DESCR
 /begin AXIS_DESCR STD_AXIS gentempend temp_uw_q0p75_o48 7 -48.00000 336.0000 FORMAT "%8.4" DEPOSIT ABSOLUTE /end AXIS_DESCR
/end CHARACTERISTIC
/begin CHARACTERISTIC KFIGENWA1 "" MAP 0xFC8A74 KfAxU8AyU8SstxU8SstyU16WU8 255.0 igen_ub_q1 0.00 255.0 FORMAT "%5.1"
 /begin AXIS_DESCR STD_AXIS genikaltun igen_ub_q1 6 0.00 255.0 FORMAT "%5.1" DEPOSIT ABSOLUTE /end AXIS_DESCR
 /begin AXIS_DESCR STD_AXIS gentempend temp_uw_q0p75_o48 7 -48.00000 336.0000 FORMAT "%8.4" DEPOSIT ABSOLUTE /end AXIS_DESCR
/end CHARACTERISTIC
/begin CHARACTERISTIC KFIGENWA2 "" MAP 0xFC8AB4 KfAxU8AyU8SstxU8SstyU16WU8 255.0 igen_ub_q1 0.00 255.0 FORMAT "%5.1"
 /begin AXIS_DESCR STD_AXIS genikaltun igen_ub_q1 6 0.00 255.0 FORMAT "%5.1" DEPOSIT ABSOLUTE /end AXIS_DESCR
 /begin AXIS_DESCR STD_AXIS gentempend temp_uw_q0p75_o48 7 -48.00000 336.0000 FORMAT "%8.4" DEPOSIT ABSOLUTE /end AXIS_DESCR
/end CHARACTERISTIC
/begin CHARACTERISTIC KFIGENWA3 "" MAP 0xFC8AF4 KfAxU8AyU8SstxU8SstyU16WU8 255.0 igen_ub_q1 0.00 255.0 FORMAT "%5.1"
 /begin AXIS_DESCR STD_AXIS genikaltun igen_ub_q1 6 0.00 255.0 FORMAT "%5.1" DEPOSIT ABSOLUTE /end AXIS_DESCR
 /begin AXIS_DESCR STD_AXIS gentempend temp_uw_q0p75_o48 7 -48.00000 336.0000 FORMAT "%8.4" DEPOSIT ABSOLUTE /end AXIS_DESCR
/end CHARACTERISTIC
/begin CHARACTERISTIC KFIGENWA4 "" MAP 0xFC8B34 KfAxU8AyU8SstxU8SstyU16WU8 255.0 igen_ub_q1 0.00 255.0 FORMAT "%5.1"
 /begin AXIS_DESCR STD_AXIS genikaltun igen_ub_q1 6 0.00 255.0 FORMAT "%5.1" DEPOSIT ABSOLUTE /end AXIS_DESCR
 /begin AXIS_DESCR STD_AXIS gentempend temp_uw_q0p75_o48 7 -48.00000 336.0000 FORMAT "%8.4" DEPOSIT ABSOLUTE /end AXIS_DESCR
/end CHARACTERISTIC
/begin CHARACTERISTIC KFIGENWA5 "" MAP 0xFC8B74 KfAxU8AyU8SstxU8SstyU16WU8 255.0 igen_ub_q1 0.00 255.0 FORMAT "%5.1"
 /begin AXIS_DESCR STD_AXIS genikaltun igen_ub_q1 6 0.00 255.0 FORMAT "%5.1" DEPOSIT ABSOLUTE /end AXIS_DESCR
 /begin AXIS_DESCR STD_AXIS gentempend temp_uw_q0p75_o48 7 -48.00000 336.0000 FORMAT "%8.4" DEPOSIT ABSOLUTE /end AXIS_DESCR
/end CHARACTERISTIC
/begin CHARACTERISTIC KFIGENWA6 "" MAP 0xFC8BB4 KfAxU8AyU8SstxU8SstyU16WU8 255.0 igen_ub_q1 0.00 255.0 FORMAT "%5.1"
 /begin AXIS_DESCR STD_AXIS genikaltun igen_ub_q1 6 0.00 255.0 FORMAT "%5.1" DEPOSIT ABSOLUTE /end AXIS_DESCR
 /begin AXIS_DESCR STD_AXIS gentempend temp_uw_q0p75_o48 7 -48.00000 336.0000 FORMAT "%8.4" DEPOSIT ABSOLUTE /end AXIS_DESCR
/end CHARACTERISTIC
/begin CHARACTERISTIC KFIGENWA7 "" MAP 0xFC8BF4 KfAxU8AyU8SstxU8SstyU16WU8 255.0 igen_ub_q1 0.00 255.0 FORMAT "%5.1"
 /begin AXIS_DESCR STD_AXIS genikaltun igen_ub_q1 6 0.00 255.0 FORMAT "%5.1" DEPOSIT ABSOLUTE /end AXIS_DESCR
 /begin AXIS_DESCR STD_AXIS gentempend temp_uw_q0p75_o48 7 -48.00000 336.0000 FORMAT "%8.4" DEPOSIT ABSOLUTE /end AXIS_DESCR
/end CHARACTERISTIC
/begin CHARACTERISTIC KFKWTMP "Kennfeld Drehmomentenreserve f¸r Kat warmhalten, zeitweise" MAP 0xFCE45A KfAxUwAyUwSstxUwSstyUwWUw 99.99847 rel_uw_b100 0.00 99.99847 FORMAT "%8.5"
 /begin AXIS_DESCR STD_AXIS nmot_w nmot_uw_q0p25 4 0.00 16383.75 FORMAT "%8.2" DEPOSIT ABSOLUTE /end AXIS_DESCR
 /begin AXIS_DESCR STD_AXIS mifakh_w rel_uw_b100 4 0.00 99.99847 FORMAT "%8.5" DEPOSIT ABSOLUTE /end AXIS_DESCR
/end CHARACTERISTIC
/begin CHARACTERISTIC KFMDDSLA "Kennfeld Drehmomentenreserve bei Testereingriff Sekund‰rluftdiagnose" MAP 0xFCE48E KfAxUwAyUwSstxUwSstyUwWUw 99.99847 rel_uw_b100 0.00 99.99847 FORMAT "%8.5"
 /begin AXIS_DESCR STD_AXIS nmot_w nmot_uw_q0p25 4 0.00 16383.75 FORMAT "%8.2" DEPOSIT ABSOLUTE /end AXIS_DESCR
 /begin AXIS_DESCR STD_AXIS mifakh_w rel_uw_b100 4 0.00 99.99847 FORMAT "%8.5" DEPOSIT ABSOLUTE /end AXIS_DESCR
/end CHARACTERISTIC
/begin CHARACTERISTIC KFMDKH "Kennfeld Drehmomentenreserve f¸r Katheizen" MAP 0xFCE4C2 KfAxUwAyUwSstxUwSstyUwWUw 99.99847 rel_uw_b100 0.00 99.99847 FORMAT "%8.5"
 /begin AXIS_DESCR STD_AXIS nmot_w nmot_uw_q0p25 8 0.00 16383.75 FORMAT "%8.2" DEPOSIT ABSOLUTE /end AXIS_DESCR
 /begin AXIS_DESCR STD_AXIS mifakh_w rel_uw_b100 8 0.00 99.99847 FORMAT "%8.5" DEPOSIT ABSOLUTE /end AXIS_DESCR
/end CHARACTERISTIC
/begin CHARACTERISTIC KFMDKHLL "Kennfeld Drehmomentenreserve f¸r Katheizen bei LL" MAP 0xFCE566 KfAxUwAyUwSstxUwSstyUwWUw 99.99847 rel_uw_b100 0.00 99.99847 FORMAT "%8.5"
 /begin AXIS_DESCR STD_AXIS nmot_w nmot_uw_q0p25 8 0.00 16383.75 FORMAT "%8.2" DEPOSIT ABSOLUTE /end AXIS_DESCR
 /begin AXIS_DESCR STD_AXIS mifakh_w rel_uw_b100 8 0.00 99.99847 FORMAT "%8.5" DEPOSIT ABSOLUTE /end AXIS_DESCR
/end CHARACTERISTIC
/begin CHARACTERISTIC KFTBERGI "" VALUE 0xFCC3C4 KwWU16 0.9999847 fak_uw_b1 0.00 0.9999847 FORMAT "%9.7" /end CHARACTERISTIC
/begin CHARACTERISTIC KFTKRI "Integratorsteigung KR" VALUE 0xFCC3C6 KwWU16 0.9999847 fak_uw_b1 0.00 0.9999847 FORMAT "%9.7" /end CHARACTERISTIC
/begin CHARACTERISTIC KFTKWS "" MAP 0xFCC2B4 KfAxU8AyU8SstxU16SstyU16WU16 100.0000 fak_q0p1 0.00 100.0000 FORMAT "%8.4"
 /begin AXIS_DESCR STD_AXIS rlsol_w rel_uw_q0p0234 8 0.00 1535.977 FORMAT "%8.3" DEPOSIT ABSOLUTE /end AXIS_DESCR
 /begin AXIS_DESCR STD_AXIS tkws temp_ub_q0p75_o48 8 -48.00 143.3 FORMAT "%5.1" DEPOSIT ABSOLUTE /end AXIS_DESCR
/end CHARACTERISTIC
/begin CHARACTERISTIC KFTLASTI "" VALUE 0xFCC3C8 KwWU16 0.9999847 fak_uw_b1 0.00 0.9999847 FORMAT "%9.7" /end CHARACTERISTIC
/begin CHARACTERISTIC KFTTANSI "" VALUE 0xFCC3CA KwWU16 0.9999847 fak_uw_b1 0.00 0.9999847 FORMAT "%9.7" /end CHARACTERISTIC
/begin CHARACTERISTIC KLDTMRS "Kennlinie Motortemperatur-Gradient im Schub f¸r Referenzmodell" CURVE 0xFCE0D3 KlAUbSstUbWSb 0.1868 temp_sb_b0p093 -0.09375 0.09302 FORMAT "%7.5"
 /begin AXIS_DESCR STD_AXIS tmrw temp_ub_q0p75_o48 5 -48.00 143.3 FORMAT "%5.1" DEPOSIT ABSOLUTE /end AXIS_DESCR
/end CHARACTERISTIC
/begin CHARACTERISTIC KLFPDIODE0 "Verlustleistungsfaktor eines Diodenpaars0" CURVE 0xFC8E92 KlAxU8SstxU16WU16 1.992188 fak_ub_b2 0.00 1.992188 FORMAT "%8.6"
 /begin AXIS_DESCR STD_AXIS gentemp temp_uw_q0p75_o48 5 -48.00000 336.0000 FORMAT "%8.4" DEPOSIT ABSOLUTE /end AXIS_DESCR
/end CHARACTERISTIC
/begin CHARACTERISTIC KLFPDIODE1 "Verlustleistungsfaktor eines Diodenpaars1" CURVE 0xFC8EA8 KlAxU8SstxU16WU16 1.992188 fak_ub_b2 0.00 1.992188 FORMAT "%8.6"
 /begin AXIS_DESCR STD_AXIS gentemp temp_uw_q0p75_o48 5 -48.00000 336.0000 FORMAT "%8.4" DEPOSIT ABSOLUTE /end AXIS_DESCR
/end CHARACTERISTIC
/begin CHARACTERISTIC KLFPDIODE2 "Verlustleistungsfaktor eines Diodenpaars2" CURVE 0xFC8EBE KlAxU8SstxU16WU16 1.992188 fak_ub_b2 0.00 1.992188 FORMAT "%8.6"
 /begin AXIS_DESCR STD_AXIS gentemp temp_uw_q0p75_o48 5 -48.00000 336.0000 FORMAT "%8.4" DEPOSIT ABSOLUTE /end AXIS_DESCR
/end CHARACTERISTIC
/begin CHARACTERISTIC KLFPDIODE3 "Verlustleistungsfaktor eines Diodenpaars" CURVE 0xFC8ED4 KlAxU8SstxU16WU16 1.992188 fak_ub_b2 0.00 1.992188 FORMAT "%8.6"
 /begin AXIS_DESCR STD_AXIS gentemp temp_uw_q0p75_o48 5 -48.00000 336.0000 FORMAT "%8.4" DEPOSIT ABSOLUTE /end AXIS_DESCR
/end CHARACTERISTIC
/begin CHARACTERISTIC KLFPDIODE4 "Verlustleistungsfaktor eines Diodenpaars4" CURVE 0xFC8EEA KlAxU8SstxU16WU16 1.992188 fak_ub_b2 0.00 1.992188 FORMAT "%8.6"
 /begin AXIS_DESCR STD_AXIS gentemp temp_uw_q0p75_o48 5 -48.00000 336.0000 FORMAT "%8.4" DEPOSIT ABSOLUTE /end AXIS_DESCR
/end CHARACTERISTIC
/begin CHARACTERISTIC KLFPDIODE5 "Verlustleistungsfaktor eines Diodenpaars5" CURVE 0xFC8F00 KlAxU8SstxU16WU16 1.992188 fak_ub_b2 0.00 1.992188 FORMAT "%8.6"
 /begin AXIS_DESCR STD_AXIS gentemp temp_uw_q0p75_o48 5 -48.00000 336.0000 FORMAT "%8.4" DEPOSIT ABSOLUTE /end AXIS_DESCR
/end CHARACTERISTIC
/begin CHARACTERISTIC KLFPDIODE6 "Verlustleistungsfaktor eines Diodenpaars6" CURVE 0xFC8F16 KlAxU8SstxU16WU16 1.992188 fak_ub_b2 0.00 1.992188 FORMAT "%8.6"
 /begin AXIS_DESCR STD_AXIS gentemp temp_uw_q0p75_o48 5 -48.00000 336.0000 FORMAT "%8.4" DEPOSIT ABSOLUTE /end AXIS_DESCR
/end CHARACTERISTIC
/begin CHARACTERISTIC KLFPDIODE7 "Verlustleistungsfaktor eines Diodenpaars7" CURVE 0xFC8F2C KlAxU8SstxU16WU16 1.992188 fak_ub_b2 0.00 1.992188 FORMAT "%8.6"
 /begin AXIS_DESCR STD_AXIS gentemp temp_uw_q0p75_o48 5 -48.00000 336.0000 FORMAT "%8.4" DEPOSIT ABSOLUTE /end AXIS_DESCR
/end CHARACTERISTIC
/begin CHARACTERISTIC KLGENEXP0 "Abk¸hlkurve Generator0" CURVE 0xFC8F42 KlAxU8SstxU16WU16 1.000000 genexpab_ub_q0p0039 0.00 1.000000 FORMAT "%8.6"
 /begin AXIS_DESCR STD_AXIS tabst_w t1sxs_uw_q1 13 0.00 65535.00 FORMAT "%8.2" DEPOSIT ABSOLUTE /end AXIS_DESCR
/end CHARACTERISTIC
/begin CHARACTERISTIC KLGENEXP1 "Abk¸hlkurve Generator1" CURVE 0xFC8F78 KlAxU8SstxU16WU16 1.000000 genexpab_ub_q0p0039 0.00 1.000000 FORMAT "%8.6"
 /begin AXIS_DESCR STD_AXIS tabst_w t1sxs_uw_q1 13 0.00 65535.00 FORMAT "%8.2" DEPOSIT ABSOLUTE /end AXIS_DESCR
/end CHARACTERISTIC
/begin CHARACTERISTIC KLGENEXP2 "Abk¸hlkurve Generator2" CURVE 0xFC8FAE KlAxU8SstxU16WU16 1.000000 genexpab_ub_q0p0039 0.00 1.000000 FORMAT "%8.6"
 /begin AXIS_DESCR STD_AXIS tabst_w t1sxs_uw_q1 13 0.00 65535.00 FORMAT "%8.2" DEPOSIT ABSOLUTE /end AXIS_DESCR
/end CHARACTERISTIC
/begin CHARACTERISTIC KLGENEXP3 "Abk¸hlkurve Generator3" CURVE 0xFC8FE4 KlAxU8SstxU16WU16 1.000000 genexpab_ub_q0p0039 0.00 1.000000 FORMAT "%8.6"
 /begin AXIS_DESCR STD_AXIS tabst_w t1sxs_uw_q1 13 0.00 65535.00 FORMAT "%8.2" DEPOSIT ABSOLUTE /end AXIS_DESCR
/end CHARACTERISTIC
/begin CHARACTERISTIC KLGENEXP4 "Abk¸hlkurve Generator4" CURVE 0xFC901A KlAxU8SstxU16WU16 1.000000 genexpab_ub_q0p0039 0.00 1.000000 FORMAT "%8.6"
 /begin AXIS_DESCR STD_AXIS tabst_w t1sxs_uw_q1 13 0.00 65535.00 FORMAT "%8.2" DEPOSIT ABSOLUTE /end AXIS_DESCR
/end CHARACTERISTIC
/begin CHARACTERISTIC KLGENEXP5 "Abk¸hlkurve Generator5" CURVE 0xFC9050 KlAxU8SstxU16WU16 1.000000 genexpab_ub_q0p0039 0.00 1.000000 FORMAT "%8.6"
 /begin AXIS_DESCR STD_AXIS tabst_w t1sxs_uw_q1 13 0.00 65535.00 FORMAT "%8.2" DEPOSIT ABSOLUTE /end AXIS_DESCR
/end CHARACTERISTIC
/begin CHARACTERISTIC KLGENEXP6 "Abk¸hlkurve Generator6" CURVE 0xFC9086 KlAxU8SstxU16WU16 1.000000 genexpab_ub_q0p0039 0.00 1.000000 FORMAT "%8.6"
 /begin AXIS_DESCR STD_AXIS tabst_w t1sxs_uw_q1 13 0.00 65535.00 FORMAT "%8.2" DEPOSIT ABSOLUTE /end AXIS_DESCR
/end CHARACTERISTIC
/begin CHARACTERISTIC KLGENEXP7 "Abk¸hlkurve Generator7" CURVE 0xFC90BC KlAxU8SstxU16WU16 1.000000 genexpab_ub_q0p0039 0.00 1.000000 FORMAT "%8.6"
 /begin AXIS_DESCR STD_AXIS tabst_w t1sxs_uw_q1 13 0.00 65535.00 FORMAT "%8.2" DEPOSIT ABSOLUTE /end AXIS_DESCR
/end CHARACTERISTIC
/begin CHARACTERISTIC KLGENTETA0 "Temperatur_eta_faktor Generator0" CURVE 0xFC90F2 KlAxU8SstxU16WU16 2.000000 fak_ub_b1 0.00 2.000000 FORMAT "%8.6"
 /begin AXIS_DESCR STD_AXIS gentemp temp_uw_q0p75_o48 3 -48.00000 336.0000 FORMAT "%8.4" DEPOSIT ABSOLUTE /end AXIS_DESCR
/end CHARACTERISTIC
/begin CHARACTERISTIC KLGENTETA1 "Temperatur_eta_faktor Generator1" CURVE 0xFC9100 KlAxU8SstxU16WU16 2.000000 fak_ub_b1 0.00 2.000000 FORMAT "%8.6"
 /begin AXIS_DESCR STD_AXIS gentemp temp_uw_q0p75_o48 3 -48.00000 336.0000 FORMAT "%8.4" DEPOSIT ABSOLUTE /end AXIS_DESCR
/end CHARACTERISTIC
/begin CHARACTERISTIC KLGENTETA2 "Temperatur_eta_faktor Generator2" CURVE 0xFC910E KlAxU8SstxU16WU16 2.000000 fak_ub_b1 0.00 2.000000 FORMAT "%8.6"
 /begin AXIS_DESCR STD_AXIS gentemp temp_uw_q0p75_o48 3 -48.00000 336.0000 FORMAT "%8.4" DEPOSIT ABSOLUTE /end AXIS_DESCR
/end CHARACTERISTIC
/begin CHARACTERISTIC KLGENTETA3 "Temperatur_eta_faktor Generator3" CURVE 0xFC911C KlAxU8SstxU16WU16 2.000000 fak_ub_b1 0.00 2.000000 FORMAT "%8.6"
 /begin AXIS_DESCR STD_AXIS gentemp temp_uw_q0p75_o48 3 -48.00000 336.0000 FORMAT "%8.4" DEPOSIT ABSOLUTE /end AXIS_DESCR
/end CHARACTERISTIC
/begin CHARACTERISTIC KLGENTETA4 "Temperatur_eta_faktor Generator4" CURVE 0xFC912A KlAxU8SstxU16WU16 2.000000 fak_ub_b1 0.00 2.000000 FORMAT "%8.6"
 /begin AXIS_DESCR STD_AXIS gentemp temp_uw_q0p75_o48 3 -48.00000 336.0000 FORMAT "%8.4" DEPOSIT ABSOLUTE /end AXIS_DESCR
/end CHARACTERISTIC
/begin CHARACTERISTIC KLGENTETA5 "Temperatur_eta_faktor Generator5" CURVE 0xFC9138 KlAxU8SstxU16WU16 2.000000 fak_ub_b1 0.00 2.000000 FORMAT "%8.6"
 /begin AXIS_DESCR STD_AXIS gentemp temp_uw_q0p75_o48 3 -48.00000 336.0000 FORMAT "%8.4" DEPOSIT ABSOLUTE /end AXIS_DESCR
/end CHARACTERISTIC
/begin CHARACTERISTIC KLGENTETA6 "Temperatur_eta_faktor Generator6" CURVE 0xFC9146 KlAxU8SstxU16WU16 2.000000 fak_ub_b1 0.00 2.000000 FORMAT "%8.6"
 /begin AXIS_DESCR STD_AXIS gentemp temp_uw_q0p75_o48 3 -48.00000 336.0000 FORMAT "%8.4" DEPOSIT ABSOLUTE /end AXIS_DESCR
/end CHARACTERISTIC
/begin CHARACTERISTIC KLGENTETA7 "Temperatur_eta_faktor Generator7" CURVE 0xFC9154 KlAxU8SstxU16WU16 2.000000 fak_ub_b1 0.00 2.000000 FORMAT "%8.6"
 /begin AXIS_DESCR STD_AXIS gentemp temp_uw_q0p75_o48 3 -48.00000 336.0000 FORMAT "%8.4" DEPOSIT ABSOLUTE /end AXIS_DESCR
/end CHARACTERISTIC
/begin CHARACTERISTIC KLHKWN "Kennlinie f¸r drehzahlabh. Generatorlastsollwerte" CURVE 0xFC6BC0 KlAxU8SstxU8WU8 100.0 rel_ub_b100 0.00 100.0 FORMAT "%5.1"
 /begin AXIS_DESCR STD_AXIS nmot nmot_ub_q40 10 0.00 10200. FORMAT "%5.0" DEPOSIT ABSOLUTE /end AXIS_DESCR
/end CHARACTERISTIC
/begin CHARACTERISTIC KLHKWT "Kennlinie f¸r lufttemperaturabh. Wassertemperaturschwellwerte" CURVE 0xFC6BD8 KlAxU8SstxU8WU8 191.3 temp_ub_q0p75_o48 -48.00 143.3 FORMAT "%5.1"
 /begin AXIS_DESCR STD_AXIS hkw_t temp_ub_q0p75_o48 10 -48.00 143.3 FORMAT "%5.1" DEPOSIT ABSOLUTE /end AXIS_DESCR
/end CHARACTERISTIC
/begin CHARACTERISTIC KLIGENMESS "Transferfunktion I_Generator" CURVE 0xFC9162 KlAxU8SstxU16WU16 511.9922 fak_uw_b512 0.00 511.9922 FORMAT "%8.4"
 /begin AXIS_DESCR STD_AXIS igenmess dez 4 0.00 1024.000 FORMAT "%8.3" DEPOSIT ABSOLUTE /end AXIS_DESCR
/end CHARACTERISTIC
/begin CHARACTERISTIC KLKFTBERG "" CURVE 0xFD0510 KlAxU8SstxU8WU8 191.3 rel_ub_q0p75 0.00 191.3 FORMAT "%5.1"
 /begin AXIS_DESCR STD_AXIS vfzg vfzg_ub_q1p25 8 0.00 318.8 FORMAT "%5.1" DEPOSIT ABSOLUTE /end AXIS_DESCR
/end CHARACTERISTIC
/begin CHARACTERISTIC KLKFTLAST "" CURVE 0xFD0524 KlAxU8SstxU8WU8 191.3 rel_ub_q0p75 0.00 191.3 FORMAT "%5.1"
 /begin AXIS_DESCR STD_AXIS nmot nmot_ub_q40 8 0.00 10200. FORMAT "%5.0" DEPOSIT ABSOLUTE /end AXIS_DESCR
/end CHARACTERISTIC
/begin CHARACTERISTIC KLKFTTANS "" CURVE 0xFD0538 KlAxU8SstxU8WU8 191.3 temp_ub_q0p75_o48 -48.00 143.3 FORMAT "%5.1"
 /begin AXIS_DESCR STD_AXIS vfzg vfzg_ub_q1p25 8 0.00 318.8 FORMAT "%5.1" DEPOSIT ABSOLUTE /end AXIS_DESCR
/end CHARACTERISTIC
/begin CHARACTERISTIC KLRTH0FAK0 "RTHfaktor0 ueber Generatorstrom" CURVE 0xFC9244 KlAxU8SstxU8WU8 3.984 fak_ub_b4 0.00 3.984 FORMAT "%5.3"
 /begin AXIS_DESCR STD_AXIS geni_end igen_ub_q1 11 0.00 254.0 FORMAT "%5.1" DEPOSIT ABSOLUTE /end AXIS_DESCR
/end CHARACTERISTIC
/begin CHARACTERISTIC KLRTH0FAK1 "RTHfaktor1 ueber Generatorstrom" CURVE 0xFC925C KlAxU8SstxU8WU8 3.984 fak_ub_b4 0.00 3.984 FORMAT "%5.3"
 /begin AXIS_DESCR STD_AXIS geni_end igen_ub_q1 11 0.00 254.0 FORMAT "%5.1" DEPOSIT ABSOLUTE /end AXIS_DESCR
/end CHARACTERISTIC
/begin CHARACTERISTIC KLRTH0FAK2 "RTHfaktor 2 ueber Generatorstrom" CURVE 0xFC9274 KlAxU8SstxU8WU8 3.969 fak_ub_b4 0.00 3.969 FORMAT "%5.3"
 /begin AXIS_DESCR STD_AXIS geni_end igen_ub_q1 11 0.00 254.0 FORMAT "%5.1" DEPOSIT ABSOLUTE /end AXIS_DESCR
/end CHARACTERISTIC
/begin CHARACTERISTIC KLRTH0FAK3 "RTHfaktor3 ueber Generatorstrom" CURVE 0xFC928C KlAxU8SstxU8WU8 3.984 fak_ub_b4 0.00 3.984 FORMAT "%5.3"
 /begin AXIS_DESCR STD_AXIS geni_end igen_ub_q1 11 0.00 254.0 FORMAT "%5.1" DEPOSIT ABSOLUTE /end AXIS_DESCR
/end CHARACTERISTIC
/begin CHARACTERISTIC KLRTH0FAK4 "RTHfaktor4 ueber Generatorstrom" CURVE 0xFC92A4 KlAxU8SstxU8WU8 3.984 fak_ub_b4 0.00 3.984 FORMAT "%5.3"
 /begin AXIS_DESCR STD_AXIS geni_end igen_ub_q1 11 0.00 254.0 FORMAT "%5.1" DEPOSIT ABSOLUTE /end AXIS_DESCR
/end CHARACTERISTIC
/begin CHARACTERISTIC KLRTH0FAK5 "RTHfaktor5 ueber Generatorstrom" CURVE 0xFC92BC KlAxU8SstxU8WU8 3.984 fak_ub_b4 0.00 3.984 FORMAT "%5.3"
 /begin AXIS_DESCR STD_AXIS geni_end igen_ub_q1 11 0.00 254.0 FORMAT "%5.1" DEPOSIT ABSOLUTE /end AXIS_DESCR
/end CHARACTERISTIC
/begin CHARACTERISTIC KLRTH0FAK6 "RTHfaktor6 ueber Generatorstrom" CURVE 0xFC92D4 KlAxU8SstxU8WU8 3.984 fak_ub_b4 0.00 3.984 FORMAT "%5.3"
 /begin AXIS_DESCR STD_AXIS geni_end igen_ub_q1 11 0.00 254.0 FORMAT "%5.1" DEPOSIT ABSOLUTE /end AXIS_DESCR
/end CHARACTERISTIC
/begin CHARACTERISTIC KLRTH0FAK7 "RTHfaktor7 ueber Generatorstrom" CURVE 0xFC92EC KlAxU8SstxU8WU8 3.984 fak_ub_b4 0.00 3.984 FORMAT "%5.3"
 /begin AXIS_DESCR STD_AXIS geni_end igen_ub_q1 11 0.00 254.0 FORMAT "%5.1" DEPOSIT ABSOLUTE /end AXIS_DESCR
/end CHARACTERISTIC
/begin CHARACTERISTIC KLRTHFAK0 "RTHfaktor ueber Generatorstrom" CURVE 0xFC9304 KlAxU8SstxU8WU8 3.984 fak_ub_b4 0.00 3.984 FORMAT "%5.3"
 /begin AXIS_DESCR STD_AXIS geni_end igen_ub_q1 11 0.00 254.0 FORMAT "%5.1" DEPOSIT ABSOLUTE /end AXIS_DESCR
/end CHARACTERISTIC
/begin CHARACTERISTIC KLRTHFAK1 "RTHfaktor1 ueber Generatorstrom Fahrt" CURVE 0xFC931C KlAxU8SstxU8WU8 3.984 fak_ub_b4 0.00 3.984 FORMAT "%5.3"
 /begin AXIS_DESCR STD_AXIS geni_end igen_ub_q1 11 0.00 254.0 FORMAT "%5.1" DEPOSIT ABSOLUTE /end AXIS_DESCR
/end CHARACTERISTIC
/begin CHARACTERISTIC KLRTHFAK2 "RTHfaktor2 ueber Generatorstrom Fahrt" CURVE 0xFC9334 KlAxU8SstxU8WU8 3.984 fak_ub_b4 0.00 3.984 FORMAT "%5.3"
 /begin AXIS_DESCR STD_AXIS geni_end igen_ub_q1 11 0.00 254.0 FORMAT "%5.1" DEPOSIT ABSOLUTE /end AXIS_DESCR
/end CHARACTERISTIC
/begin CHARACTERISTIC KLRTHFAK3 "RTHfaktor3 ueber Generatorstrom Fahrt" CURVE 0xFC934C KlAxU8SstxU8WU8 3.984 fak_ub_b4 0.00 3.984 FORMAT "%5.3"
 /begin AXIS_DESCR STD_AXIS geni_end igen_ub_q1 11 0.00 254.0 FORMAT "%5.1" DEPOSIT ABSOLUTE /end AXIS_DESCR
/end CHARACTERISTIC
/begin CHARACTERISTIC KLRTHFAK4 "RTHfaktor4 ueber Generatorstrom Fahrt" CURVE 0xFC9364 KlAxU8SstxU8WU8 3.984 fak_ub_b4 0.00 3.984 FORMAT "%5.3"
 /begin AXIS_DESCR STD_AXIS geni_end igen_ub_q1 11 0.00 254.0 FORMAT "%5.1" DEPOSIT ABSOLUTE /end AXIS_DESCR
/end CHARACTERISTIC
/begin CHARACTERISTIC KLRTHFAK5 "RTHfaktor5 ueber Generatorstrom Fahrt" CURVE 0xFC937C KlAxU8SstxU8WU8 3.984 fak_ub_b4 0.00 3.984 FORMAT "%5.3"
 /begin AXIS_DESCR STD_AXIS geni_end igen_ub_q1 11 0.00 254.0 FORMAT "%5.1" DEPOSIT ABSOLUTE /end AXIS_DESCR
/end CHARACTERISTIC
/begin CHARACTERISTIC KLRTHFAK6 "RTHfaktor6 ueber Generatorstrom Fahrt" CURVE 0xFC9394 KlAxU8SstxU8WU8 3.984 fak_ub_b4 0.00 3.984 FORMAT "%5.3"
 /begin AXIS_DESCR STD_AXIS geni_end igen_ub_q1 11 0.00 254.0 FORMAT "%5.1" DEPOSIT ABSOLUTE /end AXIS_DESCR
/end CHARACTERISTIC
/begin CHARACTERISTIC KLRTHFAK7 "RTHfaktor7 ueber Generatorstrom Fahrt" CURVE 0xFC93AC KlAxU8SstxU8WU8 3.984 fak_ub_b4 0.00 3.984 FORMAT "%5.3"
 /begin AXIS_DESCR STD_AXIS geni_end igen_ub_q1 11 0.00 254.0 FORMAT "%5.1" DEPOSIT ABSOLUTE /end AXIS_DESCR
/end CHARACTERISTIC
/begin CHARACTERISTIC KLRTHGEN0 "RTH-Kennfeld Generator0" CURVE 0xFC9174 KlAxU8SstxU16WU16 1.000000 fak_uw_b64 0.00 1.000000 FORMAT "%8.6"
 /begin AXIS_DESCR STD_AXIS ngen_w ngen_uw_q0p5 6 0.00 32767.50 FORMAT "%8.2" DEPOSIT ABSOLUTE /end AXIS_DESCR
/end CHARACTERISTIC
/begin CHARACTERISTIC KLRTHGEN1 "RTH-Kennfeld Generator1" CURVE 0xFC918E KlAxU8SstxU16WU16 1.000000 fak_uw_b64 0.00 1.000000 FORMAT "%8.6"
 /begin AXIS_DESCR STD_AXIS ngen_w ngen_uw_q0p5 6 0.00 32767.50 FORMAT "%8.2" DEPOSIT ABSOLUTE /end AXIS_DESCR
/end CHARACTERISTIC
/begin CHARACTERISTIC KLRTHGEN2 "RTH-Kennfeld Generator2" CURVE 0xFC91A8 KlAxU8SstxU16WU16 1.000000 fak_uw_b64 0.00 1.000000 FORMAT "%8.6"
 /begin AXIS_DESCR STD_AXIS ngen_w ngen_uw_q0p5 6 0.00 32767.50 FORMAT "%8.2" DEPOSIT ABSOLUTE /end AXIS_DESCR
/end CHARACTERISTIC
/begin CHARACTERISTIC KLRTHGEN3 "RTH-Kennfeld Generator3" CURVE 0xFC91C2 KlAxU8SstxU16WU16 1.000000 fak_uw_b64 0.00 1.000000 FORMAT "%8.6"
 /begin AXIS_DESCR STD_AXIS ngen_w ngen_uw_q0p5 6 0.00 32767.50 FORMAT "%8.2" DEPOSIT ABSOLUTE /end AXIS_DESCR
/end CHARACTERISTIC
/begin CHARACTERISTIC KLRTHGEN4 "RTH-Kennfeld Generator4" CURVE 0xFC91DC KlAxU8SstxU16WU16 1.000000 fak_uw_b64 0.00 1.000000 FORMAT "%8.6"
 /begin AXIS_DESCR STD_AXIS ngen_w ngen_uw_q0p5 6 0.00 32767.50 FORMAT "%8.2" DEPOSIT ABSOLUTE /end AXIS_DESCR
/end CHARACTERISTIC
/begin CHARACTERISTIC KLRTHGEN5 "RTH-Kennfeld Generator5" CURVE 0xFC91F6 KlAxU8SstxU16WU16 1.000000 fak_uw_b64 0.00 1.000000 FORMAT "%8.6"
 /begin AXIS_DESCR STD_AXIS ngen_w ngen_uw_q0p5 6 0.00 32767.50 FORMAT "%8.2" DEPOSIT ABSOLUTE /end AXIS_DESCR
/end CHARACTERISTIC
/begin CHARACTERISTIC KLRTHGEN6 "RTH-Kennfeld Generator6" CURVE 0xFC9210 KlAxU8SstxU16WU16 1.000000 fak_uw_b64 0.00 1.000000 FORMAT "%8.6"
 /begin AXIS_DESCR STD_AXIS ngen_w ngen_uw_q0p5 6 0.00 32767.50 FORMAT "%8.2" DEPOSIT ABSOLUTE /end AXIS_DESCR
/end CHARACTERISTIC
/begin CHARACTERISTIC KLRTHGEN7 "RTH-Kennfeld Generator7" CURVE 0xFC922A KlAxU8SstxU16WU16 1.000000 fak_uw_b64 0.00 1.000000 FORMAT "%8.6"
 /begin AXIS_DESCR STD_AXIS ngen_w ngen_uw_q0p5 6 0.00 32767.50 FORMAT "%8.2" DEPOSIT ABSOLUTE /end AXIS_DESCR
/end CHARACTERISTIC
/begin CHARACTERISTIC KLTANSGEN0 "Kennlinie Generatoransaugluft0" CURVE 0xFC93C4 KlAxU8SstxU8WU8 191.3 temp_ub_q0p75_o48 -48.00 143.3 FORMAT "%5.1"
 /begin AXIS_DESCR STD_AXIS vfzg vfzg_ub_q1p25 10 0.00 318.8 FORMAT "%5.1" DEPOSIT ABSOLUTE /end AXIS_DESCR
/end CHARACTERISTIC
/begin CHARACTERISTIC KLTANSGEN1 "Kennlinie Generatoransaugluft1" CURVE 0xFC93DC KlAxU8SstxU8WU8 191.3 temp_ub_q0p75_o48 -48.00 143.3 FORMAT "%5.1"
 /begin AXIS_DESCR STD_AXIS vfzg vfzg_ub_q1p25 10 0.00 318.8 FORMAT "%5.1" DEPOSIT ABSOLUTE /end AXIS_DESCR
/end CHARACTERISTIC
/begin CHARACTERISTIC KLTANSGEN2 "Kennlinie Generatoransaugluft2" CURVE 0xFC93F4 KlAxU8SstxU8WU8 191.3 temp_ub_q0p75_o48 -48.00 143.3 FORMAT "%5.1"
 /begin AXIS_DESCR STD_AXIS vfzg vfzg_ub_q1p25 10 0.00 318.8 FORMAT "%5.1" DEPOSIT ABSOLUTE /end AXIS_DESCR
/end CHARACTERISTIC
/begin CHARACTERISTIC KLTANSGEN3 "Kennlinie Generatoransaugluft3" CURVE 0xFC940C KlAxU8SstxU8WU8 191.3 temp_ub_q0p75_o48 -48.00 143.3 FORMAT "%5.1"
 /begin AXIS_DESCR STD_AXIS vfzg vfzg_ub_q1p25 10 0.00 318.8 FORMAT "%5.1" DEPOSIT ABSOLUTE /end AXIS_DESCR
/end CHARACTERISTIC
/begin CHARACTERISTIC KLTANSGEN4 "Kennlinie Generatoransaugluft4" CURVE 0xFC9424 KlAxU8SstxU8WU8 191.3 temp_ub_q0p75_o48 -48.00 143.3 FORMAT "%5.1"
 /begin AXIS_DESCR STD_AXIS vfzg vfzg_ub_q1p25 10 0.00 318.8 FORMAT "%5.1" DEPOSIT ABSOLUTE /end AXIS_DESCR
/end CHARACTERISTIC
/begin CHARACTERISTIC KLTANSGEN5 "Kennlinie Generatoransaugluft5" CURVE 0xFC943C KlAxU8SstxU8WU8 191.3 temp_ub_q0p75_o48 -48.00 143.3 FORMAT "%5.1"
 /begin AXIS_DESCR STD_AXIS vfzg vfzg_ub_q1p25 10 0.00 318.8 FORMAT "%5.1" DEPOSIT ABSOLUTE /end AXIS_DESCR
/end CHARACTERISTIC
/begin CHARACTERISTIC KLTANSGEN6 "Kennlinie Generatoransaugluft6" CURVE 0xFC9454 KlAxU8SstxU8WU8 191.3 temp_ub_q0p75_o48 -48.00 143.3 FORMAT "%5.1"
 /begin AXIS_DESCR STD_AXIS vfzg vfzg_ub_q1p25 10 0.00 318.8 FORMAT "%5.1" DEPOSIT ABSOLUTE /end AXIS_DESCR
/end CHARACTERISTIC
/begin CHARACTERISTIC KLTANSGEN7 "Kennlinie Generatoransaugluft7" CURVE 0xFC946C KlAxU8SstxU8WU8 191.3 temp_ub_q0p75_o48 -48.00 143.3 FORMAT "%5.1"
 /begin AXIS_DESCR STD_AXIS vfzg vfzg_ub_q1p25 10 0.00 318.8 FORMAT "%5.1" DEPOSIT ABSOLUTE /end AXIS_DESCR
/end CHARACTERISTIC
/begin CHARACTERISTIC KLTKTOENIV "KL Abkuehlzeit Oelniveau" CURVE 0xFCE16A KlAxU8SstxU16WU16 127.5000 tog_ub_q0p5 0.00 127.5000 FORMAT "%8.4"
 /begin AXIS_DESCR STD_AXIS Tog_tk t_q0p1ms 7 0.00 6553.500 FORMAT "%8.3" DEPOSIT ABSOLUTE /end AXIS_DESCR
/end CHARACTERISTIC
/begin CHARACTERISTIC KLTKWI "" CURVE 0xFCC358 KlAxU8SstxS16WS16 200.0000 fak_q0p1 -100.0000 100.0000 FORMAT "%8.4"
 /begin AXIS_DESCR STD_AXIS tkwdiff temp_ub_q0p75_o48 13 -24624.00 24527.25 FORMAT "%8.2" DEPOSIT ABSOLUTE /end AXIS_DESCR
/end CHARACTERISTIC
/begin CHARACTERISTIC KLTKWP "" CURVE 0xFCC38E KlAxU8SstxS16WS16 200.0000 fak_q0p1 -100.0000 100.0000 FORMAT "%8.4"
 /begin AXIS_DESCR STD_AXIS tkwdiff temp_ub_q0p75_o48 13 -24624.00 24527.25 FORMAT "%8.2" DEPOSIT ABSOLUTE /end AXIS_DESCR
/end CHARACTERISTIC
/begin CHARACTERISTIC KLTOGNKOR "Oelniveau, Drehzahlkorrigiert" CURVE 0xFCE1A6 KlAxU8SstxU8WS8 127.5 tog_ub_q0p5 -64.00 63.50 FORMAT "%5.2"
 /begin AXIS_DESCR STD_AXIS nmotfm nmot_ub_q40 16 0.00 10200. FORMAT "%5.0" DEPOSIT ABSOLUTE /end AXIS_DESCR
/end CHARACTERISTIC
/begin CHARACTERISTIC KLTVTOEL "Umrechnung Oel Temperatursignalzeit -> Temperatur" CURVE 0xFCE188 KlAxU8SstxU16WU16 207.7500 temp_uw_q0p75_o48 -48.00000 159.7500 FORMAT "%8.4"
 /begin AXIS_DESCR STD_AXIS Toel_t t_q0p1ms 7 0.00 6553.500 FORMAT "%8.3" DEPOSIT ABSOLUTE /end AXIS_DESCR
/end CHARACTERISTIC
/begin CHARACTERISTIC LIMTKOA "Zeitschwelle um den Kompressor unbegrenzt auszuschalten" VALUE 0xFCC3F4 KwUb 51.00 t200msxs_ub_b51 0.00 51.00 FORMAT "%5.2" /end CHARACTERISTIC
/begin CHARACTERISTIC MANAWNUMM "manuelle Kennfeldauswahlnummeroffset" VALUE 0xFC954F KwWU8 255.0 DEZ 0.00 255.0 FORMAT "%5.1" /end CHARACTERISTIC
/begin CHARACTERISTIC MDKOAN "Drehmomentschwelle um den Klimakompressor abzuschalten" CURVE 0xFCC3F8 GklWUb 99.61 rel_ub_b99p6 0.00 99.61 FORMAT "%5.2"
 /begin AXIS_DESCR COM_AXIS nmot nmot_ub_q40 8 0.00 10200. FORMAT "%5.0" AXIS_PTS_REF SNM08KOUB /end AXIS_DESCR
/end CHARACTERISTIC
/begin CHARACTERISTIC MDKOEN "Drehmomentschwelle um den Klimakompressor einzuschalten" CURVE 0xFCC400 GklWUb 99.61 rel_ub_b99p6 0.00 99.61 FORMAT "%5.2"
 /begin AXIS_DESCR COM_AXIS nmot nmot_ub_q40 8 0.00 10200. FORMAT "%5.0" AXIS_PTS_REF SNM08KOUB /end AXIS_DESCR
/end CHARACTERISTIC
/begin CHARACTERISTIC NGKRWN "Schwellwert Drehzahlgradient f¸r Dynamikerkennung" CURVE 0xFCEB90 KlAUwSstUwWUw 12799.77 nmotg_nuw_q0p39 0.00 12799.77 FORMAT "%8.2"
 /begin AXIS_DESCR STD_AXIS nmot nmot_ub_q40 16 0.00 10200. FORMAT "%5.0" DEPOSIT ABSOLUTE /end AXIS_DESCR
/end CHARACTERISTIC
/begin CHARACTERISTIC NMIN "Minimal Drehzahl" VALUE 0xFC6438 KwWU8 235.0 nmot_q1 20.00 255.0 FORMAT "%5.1" /end CHARACTERISTIC
/begin CHARACTERISTIC NMOTQSYN "Motordrehzahlschwelle zur Freigabe des Schnellstarts ¸ber PG Schnellstart" VALUE 0xFC6432 KwWU16 600.0000 nmot_q1 0.00 600.0000 FORMAT "%8.4" /end CHARACTERISTIC
/begin CHARACTERISTIC NMXPHPOS "Drehzahlschwelle f¸r des ‹berpr¸fung Geberradeinbaus" VALUE 0xFC6427 KwWU8 10200. nmot_ub_q40 0.00 10200. FORMAT "%5.0" /end CHARACTERISTIC
/begin CHARACTERISTIC NNGKRWN "Schwellwert Drehzahlgradient f¸r Dynamikerkennung" CURVE 0xFCEBD2 KlAUwSstUwWUw 25599.55 nmotg_nuw_q0p39 -12799.77 12799.77 FORMAT "%8.2"
 /begin AXIS_DESCR STD_AXIS nmot nmot_ub_q40 16 0.00 10200. FORMAT "%5.0" DEPOSIT ABSOLUTE /end AXIS_DESCR
/end CHARACTERISTIC
/begin CHARACTERISTIC NTUMGTA "Schwelle Drehzahl f¸r Bestimmung Umgebungstemperatur aus TANS" VALUE 0xFCE103 KwUb 10200. nmot_ub_q40 0.00 10200. FORMAT "%5.0" /end CHARACTERISTIC
/begin CHARACTERISTIC NWOFFSET "Offset der ersten positiven Flanke des NW-Signals zu SW-BM Zyl. 1" VAL_BLK 0xFC6410 KwbWU8 255.0 dez 0.00 255.0 FORMAT "%5.1" NUMBER 4 /end CHARACTERISTIC
/begin CHARACTERISTIC NWPMBBR "Mindestdrehzahl f¸r Pedalwertbegrenzung bei bet‰tigter Bremse" VALUE 0xFC6332 KwUb 10200. nmot_ub_q40 0.00 10200. FORMAT "%5.0" /end CHARACTERISTIC
/begin CHARACTERISTIC NWSIGNAL "Ablageschema der Nockenwelle" VAL_BLK 0xFC6414 KwbWU8 255.0 dez 0.00 255.0 FORMAT "%5.1" NUMBER 9 /end CHARACTERISTIC
/begin CHARACTERISTIC NWSIGTOL "Toleranz der Nockenwellenflanken auf KW Zahnbasis" VALUE 0xFC6428 KwWU8 255.0 dez 0.00 255.0 FORMAT "%5.1" /end CHARACTERISTIC
/begin CHARACTERISTIC OFQSYNADAP "Offset zwischen adaptierter Phasenflanke und Phasenflanke im Start" VALUE 0xFC6439 KwWS8 255.0 kw_q1 -128.0 127.0 FORMAT "%5.1" /end CHARACTERISTIC
/begin CHARACTERISTIC ORIVERZ "Zaehler ausblenden Messwerte fuer Orientierungsmessung" VALUE 0xFCE1D1 KwWU8 255.0 dez 0.00 255.0 FORMAT "%5.1" /end CHARACTERISTIC
/begin CHARACTERISTIC PRELLGTMOT "Prellzeit f¸r Tmot-Schwelle" VALUE 0xFC9550 KwWU8 255.0 t1sxs_ub_b255 0.00 255.0 FORMAT "%5.1" /end CHARACTERISTIC
/begin CHARACTERISTIC PT1NMOT "Zeitkonstante Filer Motordrehzahl TOG" VALUE 0xFCE1D2 KwWU8 100.0 rel_ub_b100 0.00 100.0 FORMAT "%5.1" /end CHARACTERISTIC
/begin CHARACTERISTIC PT1TOEL "Filterzeitkonstante Toel" VALUE 0xFCE1C8 KwWU16 99.99847 rel_uw_b100 0.00 99.99847 FORMAT "%8.5" /end CHARACTERISTIC
/begin CHARACTERISTIC PZWKRA "Prozentuale H‰ufigkeit der ZW-Ausgabe durch die KR w‰hrend Dynamikadaption" VALUE 0xFC67C5 KwUb 99.61 rel_ub_b99p6 0.00 99.61 FORMAT "%5.2" /end CHARACTERISTIC
/begin AXIS_PTS SEH06KRUW "St¸tzstellenverteilung evhubi_w, 6 Sst." 0xFCC91A evhubi_w SstASwSstSw 65.53500 hub_uw_q0p001 6 0.00 65.53500 FORMAT "%8.5" DEPOSIT ABSOLUTE /end AXIS_PTS
/begin AXIS_PTS SNM08KOUB "St¸tzstellenverteilung f¸r Klimakompressorsteuerung  8  nmot" 0xFCC408 nmot SstAUbSstUb 10200. nmot_ub_q40 8 0.00 10200. FORMAT "%5.0" DEPOSIT ABSOLUTE /end AXIS_PTS
/begin AXIS_PTS SNM12KRUW "" 0xFCC962 nmot_w SstAUwSstUw 16383.75 nmot_uw_q0p25 12 0.00 16383.75 FORMAT "%8.2" DEPOSIT ABSOLUTE /end AXIS_PTS
/begin AXIS_PTS SRL08DYUB "" 0xFC10A4 rl SstAUbSstUb 191.3 rel_ub_q0p75 8 0.00 191.3 FORMAT "%5.1" DEPOSIT ABSOLUTE /end AXIS_PTS
/begin CHARACTERISTIC STNSG1 "St¸tzstellenverteilung nmot-1 SG-Temperaturhistogramm" VALUE 0xFCE138 KwUb 10200. nmot_ub_q40 0.00 10200. FORMAT "%5.0" /end CHARACTERISTIC
/begin CHARACTERISTIC STNSG2 "St¸tzstellenverteilung nmot-2 SG-Temperaturhistogramm" VALUE 0xFCE139 KwUb 10200. nmot_ub_q40 0.00 10200. FORMAT "%5.0" /end CHARACTERISTIC
/begin CHARACTERISTIC STNSG3 "St¸tzstellenverteilung nmot-3 SG-Temperaturhistogramm" VALUE 0xFCE13A KwUb 10200. nmot_ub_q40 0.00 10200. FORMAT "%5.0" /end CHARACTERISTIC
/begin CHARACTERISTIC STNSG4 "St¸tzstellenverteilung nmot-4 SG-Temperaturhistogramm" VALUE 0xFCE13B KwUb 10200. nmot_ub_q40 0.00 10200. FORMAT "%5.0" /end CHARACTERISTIC
/begin CHARACTERISTIC STNSG5 "St¸tzstellenverteilung nmot-5 SG-Temperaturhistogramm" VALUE 0xFCE13C KwUb 10200. nmot_ub_q40 0.00 10200. FORMAT "%5.0" /end CHARACTERISTIC
/begin CHARACTERISTIC STTSG1 "St¸tzstellenverteilung 1 tsg  SG-Temperaturhistogramm" VALUE 0xFCE13D KwUb 191.3 temp_ub_q0p75_o48 -48.00 143.3 FORMAT "%5.1" /end CHARACTERISTIC
/begin CHARACTERISTIC STTSG2 "St¸tzstellenverteilung 2 tsg  SG-Temperaturhistogramm" VALUE 0xFCE13E KwUb 191.3 temp_ub_q0p75_o48 -48.00 143.3 FORMAT "%5.1" /end CHARACTERISTIC
/begin CHARACTERISTIC STTSG3 "St¸tzstellenverteilung 3 tsg  SG-Temperaturhistogramm" VALUE 0xFCE13F KwUb 191.3 temp_ub_q0p75_o48 -48.00 143.3 FORMAT "%5.1" /end CHARACTERISTIC
/begin CHARACTERISTIC STTSG4 "St¸tzstellenverteilung 4 tsg  SG-Temperaturhistogramm" VALUE 0xFCE140 KwUb 191.3 temp_ub_q0p75_o48 -48.00 143.3 FORMAT "%5.1" /end CHARACTERISTIC
/begin CHARACTERISTIC STTSG5 "St¸tzstellenverteilung 5 tsg  SG-Temperaturhistogramm" VALUE 0xFCE141 KwUb 191.3 temp_ub_q0p75_o48 -48.00 143.3 FORMAT "%5.1" /end CHARACTERISTIC
/begin CHARACTERISTIC S_IGMISCH "" VALUE 0xFC9551 KwWU8 1.000 default 0.00 1.000 FORMAT "%5.3" /end CHARACTERISTIC
/begin CHARACTERISTIC TADE "Ersatzgrˆﬂe Lufttemperatur im Fehlerfall" VALUE 0xFCDFDC KwUb 191.3 temp_ub_q0p75_o48 -48.00 143.3 FORMAT "%5.1" /end CHARACTERISTIC
/begin CHARACTERISTIC TADMM "1. Stufenbreite (Zeit) f¸r Motortemperaturmodell" VALUE 0xFCE0DE KwUw 6553.500 t100msxs_uw_b6553p5 0.00 6553.500 FORMAT "%8.3" /end CHARACTERISTIC
/begin CHARACTERISTIC TADMN "Ansauglufttemperatur min." VALUE 0xFCDFDD KwUb 191.3 temp_ub_q0p75_o48 -48.00 143.3 FORMAT "%5.1" /end CHARACTERISTIC
/begin CHARACTERISTIC TADMX "Ansauglufttemperatur max." VALUE 0xFCDFDE KwUb 191.3 temp_ub_q0p75_o48 -48.00 143.3 FORMAT "%5.1" /end CHARACTERISTIC
/begin CHARACTERISTIC TANSELI "Temperatur Ansaugluft-Erfassung u. Linearisierung, Inverskennlinie" CURVE 0xFCDFE0 KlAUbSstUbWUb 191.3 temp_ub_q0p75_o48 -48.00 143.3 FORMAT "%5.1"
 /begin AXIS_DESCR STD_AXIS wtans spg_ub_b5 20 0.00 4.980 FORMAT "%5.3" DEPOSIT ABSOLUTE /end AXIS_DESCR
/end CHARACTERISTIC
/begin CHARACTERISTIC TDAPTUBR "Wartezeit f¸r UBR-Fehler bei Abschaltpfadtest" VALUE 0xFCE1DD KwUb 25.50 t100msxs_ub_b25p5 0.00 25.50 FORMAT "%5.2" /end CHARACTERISTIC
/begin CHARACTERISTIC TDHREVAB "Entprellzeit f¸r EV-Abschaltung bei Hauptrelais- bzw. -Kontakt-Fehler" VALUE 0xFCE1DE KwUb 25.50 t100msxs_ub_b25p5 0.00 25.50 FORMAT "%5.2" /end CHARACTERISTIC
/begin CHARACTERISTIC TDNSTA "Auspufferw‰rmzeit ab Start, f¸r TANS - Diagnose" VALUE 0xFCE009 KwUb 255.0 t1sxs_ub_b255 0.00 255.0 FORMAT "%5.1" /end CHARACTERISTIC
/begin CHARACTERISTIC TDNSUB "Batterie - Erholzeit ab Start, f¸r UBATT - Diagnose" VALUE 0xFC635C KwUb 255.0 t100msxs_ub_b255 0.00 255.0 FORMAT "%5.1" /end CHARACTERISTIC
/begin CHARACTERISTIC TDTA "Entprellzeit Fehlererkennung TANS" VALUE 0xFCE00A KwUb 25.50 t100msxs_ub_b25p5 0.00 25.50 FORMAT "%5.2" /end CHARACTERISTIC
/begin CHARACTERISTIC TDTAL "TANS Fehlererkennung / Zeitsperre ab B_LL = 1" VALUE 0xFCE00B KwUb 255.0 t1sxs_ub_b255 0.00 255.0 FORMAT "%5.1" /end CHARACTERISTIC
/begin CHARACTERISTIC TDTKAUS "Entprellzeit Fehlererkennung Temperatur K¸hlerausgang" VALUE 0xFCE108 KwUb 25.50 t100msxs_ub_b25p5 0.00 25.50 FORMAT "%5.2" /end CHARACTERISTIC
/begin CHARACTERISTIC TDTM "Entprellzeit Fehlererkennung TMOT" VALUE 0xFCE0E0 KwUw 6553.500 t100msxs_uw_b6553p5 0.00 6553.500 FORMAT "%8.3" /end CHARACTERISTIC
/begin CHARACTERISTIC TDTMMA "Verzˆgerungszeit Anfangswert Motortemperaturmodell" VALUE 0xFCE0E2 KwUw 6553.500 t100msxs_uw_b6553p5 0.00 6553.500 FORMAT "%8.3" /end CHARACTERISTIC
/begin CHARACTERISTIC TDTUM "Entprellzeit Fehlererkennung Umgebungslufttemperatur TUM" VALUE 0xFCE104 KwUb 25.50 t100msxs_ub_b25p5 0.00 25.50 FORMAT "%5.2" /end CHARACTERISTIC
/begin CHARACTERISTIC TDTUMNF "Entprellzeit f¸r i.O.-Erkennung Umgebungslufttemperatur TUM" VALUE 0xFCE105 KwUb 25.50 t100msxs_ub_b25p5 0.00 25.50 FORMAT "%5.2" /end CHARACTERISTIC
/begin CHARACTERISTIC TDUB "Wartezeit f¸r UBATT-Diagnose" VALUE 0xFC635D KwUb 25.50 t100msxs_ub_b25p5 0.00 25.50 FORMAT "%5.2" /end CHARACTERISTIC
/begin CHARACTERISTIC TDUBR "Entprellzeit f¸r Diagnose UBR" VALUE 0xFCE1DF KwUb 25.50 t100msxs_ub_b25p5 0.00 25.50 FORMAT "%5.2" /end CHARACTERISTIC
/begin CHARACTERISTIC TFGRVRAB "FGR: Zeit f¸r Geschwindigkeitsabschaltung ¸ber vroh =0" VALUE 0xFC659A KwWU8 2.550 t_q0p01 0.00 2.550 FORMAT "%5.3" /end CHARACTERISTIC
/begin CHARACTERISTIC TFPWG2 "Filterzeit zur Filterung von Poti 2 bei der Bewegungserkennung" VALUE 0xFC6356 KwUw 655.34999985 zk10msxs_uw_b655 0.010000152590 655.36000000 FORMAT "%12.8" /end CHARACTERISTIC
/begin CHARACTERISTIC THEH "Zeit f¸r maximale Sondenheizung nach Start hinter Kat" VALUE 0xFCCD3A KwUw 6553.500 t100msxs_uw_b6553p6 0.00 6553.500 FORMAT "%8.3" /end CHARACTERISTIC
/begin CHARACTERISTIC THEV "Zeit f¸r maximale Sondenheizung nach Start vor Kat" VALUE 0xFCCD3C KwUw 6553.500 t100msxs_uw_b6553p6 0.00 6553.500 FORMAT "%8.3" /end CHARACTERISTIC
/begin CHARACTERISTIC THHA "Auszeit f¸r Reduzierung der Heizleistung Sonde hinter Kat bei 13V" VALUE 0xFCCD08 KwUb 2.550 t10msxs_q0p01_o0p05 -0.05000 2.500 FORMAT "%5.3" /end CHARACTERISTIC
/begin CHARACTERISTIC THHA2 "Auszeit f¸r Reduzierung der Heizleistung Sonde2 hinter Kat bei 13V" VALUE 0xFCCD09 KwUb 2.550 t10msxs_q0p01_o0p05 -0.05000 2.500 FORMAT "%5.3" /end CHARACTERISTIC
/begin CHARACTERISTIC THHAWU "Ausschaltzeit w‰hrend Leistungsreduzierung Sondenheizung hinter Kat" VALUE 0xFCCD0A KwUb 2.550 t10msxs_ub_b2p55 0.00 2.550 FORMAT "%5.3" /end CHARACTERISTIC
/begin CHARACTERISTIC THOPP1 "Fehlerzeit bei Hochohmigkeitspr¸fung Poti 1" VALUE 0xFC6333 KwUb 2.550 t10msxs_ub_b2p55 0.00 2.550 FORMAT "%5.3" /end CHARACTERISTIC
/begin CHARACTERISTIC THOPP2 "Fehlerzeit bei Hochohmigkeitspr¸fung Poti 2" VALUE 0xFC6334 KwUb 2.550 t10msxs_ub_b2p55 0.00 2.550 FORMAT "%5.3" /end CHARACTERISTIC
/begin CHARACTERISTIC THSHKTK "Kennlinie f¸r die Ausschaltdauer der Sondenheizung abh. v.d. Abgastemp. h.Kat" CURVE 0xFCCD0C KlAUbSstUbWUb 2.550 t10msxs_q0p01_o0p05 -0.05000 2.500 FORMAT "%5.3"
 /begin AXIS_DESCR STD_AXIS tkatm temp_ub_q5_o50 8 -50.00 1225. FORMAT "%5.0" DEPOSIT ABSOLUTE /end AXIS_DESCR
/end CHARACTERISTIC
/begin CHARACTERISTIC THSVKTA "Kennlinie f¸r die Ausschaltdauer der Sondenheizung abh. v.d. Abgastemp. vor Kat" CURVE 0xFCCD20 KlAUbSstUbWUb 2.550 t10msxs_q0p01_o0p05 -0.05000 2.500 FORMAT "%5.3"
 /begin AXIS_DESCR STD_AXIS tabgm temp_ub_q5_o50 8 -50.00 1225. FORMAT "%5.0" DEPOSIT ABSOLUTE /end AXIS_DESCR
/end CHARACTERISTIC
/begin CHARACTERISTIC THVA "Auszeit f¸r Reduzierung der Heizleistung Sonde vor Kat bei 13V" VALUE 0xFCCD31 KwUb 2.550 t10msxs_q0p01_o0p05 -0.05000 2.500 FORMAT "%5.3" /end CHARACTERISTIC
/begin CHARACTERISTIC THVA2 "Auszeit f¸r Reduzierung der Heizleistung Sonde2 vor Kat bei 13V" VALUE 0xFCCD32 KwUb 2.550 t10msxs_q0p01_o0p05 -0.05000 2.500 FORMAT "%5.3" /end CHARACTERISTIC
/begin CHARACTERISTIC THVAWU "Ausschaltzeit w‰hrend Leistungsreduzierung Sondenheizung vor Kat" VALUE 0xFCCD33 KwUb 2.550 t10msxs_ub_b2p55 0.00 2.550 FORMAT "%5.3" /end CHARACTERISTIC
/begin CHARACTERISTIC TIGMISCH "" VALUE 0xFC9552 KwWU8 2.550 t10msxs_ub_b2p55 0.00 2.550 FORMAT "%5.3" /end CHARACTERISTIC
/begin CHARACTERISTIC TKAELI "Temperatur K¸hlerausgang Erfassung und Linearisierung" CURVE 0xFCE10C KlAUbSstUbWUb 191.3 temp_ub_q0p75_o48 -48.00 143.3 FORMAT "%5.1"
 /begin AXIS_DESCR STD_AXIS wtka spg_ub_b5 20 0.00 4.980 FORMAT "%5.3" DEPOSIT ABSOLUTE /end AXIS_DESCR
/end CHARACTERISTIC
/begin CHARACTERISTIC TKAUSDE "Ersatzgrˆﬂe Temperatur K¸hlerausgang im Fehlerfall" VALUE 0xFCE135 KwUb 191.3 temp_ub_q0p75_o48 -48.00 143.3 FORMAT "%5.1" /end CHARACTERISTIC
/begin CHARACTERISTIC TKAUSDMN "Min. Temperatur K¸hlerausgang" VALUE 0xFCE136 KwUb 191.3 temp_ub_q0p75_o48 -48.00 143.3 FORMAT "%5.1" /end CHARACTERISTIC
/begin CHARACTERISTIC TKAUSDMX "Max. Temperatur K¸hlerausgang" VALUE 0xFCE137 KwUb 191.3 temp_ub_q0p75_o48 -48.00 143.3 FORMAT "%5.1" /end CHARACTERISTIC
/begin CHARACTERISTIC TKOAMNN "Minimale Abschaltzeit des Klimakompressors" CURVE 0xFCC414 GklWUb 51.00 t200msxs_ub_b51 0.00 51.00 FORMAT "%5.2"
 /begin AXIS_DESCR COM_AXIS nmot nmot_ub_q40 8 0.00 10200. FORMAT "%5.0" AXIS_PTS_REF SNM08KOUB /end AXIS_DESCR
/end CHARACTERISTIC
/begin CHARACTERISTIC TKOAMXN "Maximale Abschaltzeit des Klimakompressors" CURVE 0xFCC41C GklWUb 51.00 t200msxs_ub_b51 0.00 51.00 FORMAT "%5.2"
 /begin AXIS_DESCR COM_AXIS nmot nmot_ub_q40 8 0.00 10200. FORMAT "%5.0" AXIS_PTS_REF SNM08KOUB /end AXIS_DESCR
/end CHARACTERISTIC
/begin CHARACTERISTIC TKOEMNN "Minimale Einschaltzeit des Klimakompressors" CURVE 0xFCC424 GklWUb 51.00 t200msxs_ub_b51 0.00 51.00 FORMAT "%5.2"
 /begin AXIS_DESCR COM_AXIS nmot nmot_ub_q40 8 0.00 10200. FORMAT "%5.0" AXIS_PTS_REF SNM08KOUB /end AXIS_DESCR
/end CHARACTERISTIC
/begin CHARACTERISTIC TKWBERGMAX "" VALUE 0xFCC3CC KwWU16 127.996 fak_uw_b256 0.00 127.996 FORMAT "%7.3" /end CHARACTERISTIC
/begin CHARACTERISTIC TKWBERGMIN "" VALUE 0xFCC3CE KwWU16 127.996 fak_uw_b256 0.00 127.996 FORMAT "%7.3" /end CHARACTERISTIC
/begin CHARACTERISTIC TKWI "" VALUE 0xFCC3D0 KwWU16 0.9999847 fak_uw_b1 0.00 0.9999847 FORMAT "%9.7" /end CHARACTERISTIC
/begin CHARACTERISTIC TKWKRMAX "obere Integratorbegrenzung KR" VALUE 0xFCC3D2 KwWU16 127.996 fak_uw_b256 0.00 127.996 FORMAT "%7.3" /end CHARACTERISTIC
/begin CHARACTERISTIC TKWKRMIN "untere Integratorbegrenzung KR" VALUE 0xFCC3D4 KwWU16 127.996 fak_uw_b256 0.00 127.996 FORMAT "%7.3" /end CHARACTERISTIC
/begin CHARACTERISTIC TKWLASTMAX "" VALUE 0xFCC3D6 KwWU16 127.996 fak_uw_b256 0.00 127.996 FORMAT "%7.3" /end CHARACTERISTIC
/begin CHARACTERISTIC TKWLASTMIN "" VALUE 0xFCC3D8 KwWU16 127.996 fak_uw_b256 0.00 127.996 FORMAT "%7.3" /end CHARACTERISTIC
/begin CHARACTERISTIC TKWPWMMN "" VALUE 0xFCC3DA KwWS16 3376.800 fak_q0p1 -3276.800 100.0000 FORMAT "%8.3" /end CHARACTERISTIC
/begin CHARACTERISTIC TKWPWMMX "" VALUE 0xFCC3DC KwWS16 3376.800 fak_q0p1 -3276.800 100.0000 FORMAT "%8.3" /end CHARACTERISTIC
/begin CHARACTERISTIC TKWSBERG "" VALUE 0xFCC3E3 KwWU8 191.3 temp_ub_q0p75_o48 -48.00 143.3 FORMAT "%5.1" /end CHARACTERISTIC
/begin CHARACTERISTIC TKWSGOT "" VALUE 0xFCC3E4 KwWU8 191.3 temp_ub_q0p75_o48 -48.00 143.3 FORMAT "%5.1" /end CHARACTERISTIC
/begin CHARACTERISTIC TKWSKR "Solltemperatur bei B_tkwkr" VALUE 0xFCC3E5 KwWU8 191.3 temp_ub_q0p75_o48 -48.00 143.3 FORMAT "%5.1" /end CHARACTERISTIC
/begin CHARACTERISTIC TKWSLAST "" VALUE 0xFCC3E6 KwWU8 191.3 temp_ub_q0p75_o48 -48.00 143.3 FORMAT "%5.1" /end CHARACTERISTIC
/begin CHARACTERISTIC TKWSMAX "" VALUE 0xFCC3E7 KwWU8 191.3 temp_ub_q0p75_o48 -48.00 143.3 FORMAT "%5.1" /end CHARACTERISTIC
/begin CHARACTERISTIC TKWSNTKW "" VALUE 0xFCC3E8 KwWU8 191.3 temp_ub_q0p75_o48 -48.00 143.3 FORMAT "%5.1" /end CHARACTERISTIC
/begin CHARACTERISTIC TKWSTANS "" VALUE 0xFCC3E9 KwWU8 191.3 temp_ub_q0p75_o48 -48.00 143.3 FORMAT "%5.1" /end CHARACTERISTIC
/begin CHARACTERISTIC TKWSUETEMP "" VALUE 0xFCC3EA KwWU8 191.3 temp_ub_q0p75_o48 -48.00 143.3 FORMAT "%5.1" /end CHARACTERISTIC
/begin CHARACTERISTIC TKWTANSMAX "" VALUE 0xFCC3DE KwWU16 127.996 fak_uw_b256 0.00 127.996 FORMAT "%7.3" /end CHARACTERISTIC
/begin CHARACTERISTIC TKWTANSMIN "" VALUE 0xFCC3E0 KwWU16 127.996 fak_uw_b256 0.00 127.996 FORMAT "%7.3" /end CHARACTERISTIC
/begin CHARACTERISTIC TMBVH "Verzˆgerungszeit f¸r Aktivierung Miﬂbrauchsverhinderung" VALUE 0xFC6358 KwUw 655.3500 t10msxs_uw_b655p35 0.00 655.3500 FORMAT "%8.4" /end CHARACTERISTIC
/begin CHARACTERISTIC TMDMMA "Anfangstemperatur f¸r Motortemperaturmodell" VALUE 0xFCE022 KwUb 191.3 temp_ub_q0p75_o48 -48.00 143.3 FORMAT "%5.1" /end CHARACTERISTIC
/begin CHARACTERISTIC TMDMMAT "Ersatztemperatur abh. Abstellzeit w‰hrend TDTMMA" CURVE 0xFCE0E4 KlAUwSstUwWUw 191.2500 temp_uw_q0p75_o48 -48.00000 143.2500 FORMAT "%8.4"
 /begin AXIS_DESCR STD_AXIS tabst_w t1sxs_uw_q1 3 0.00 65535.00 FORMAT "%8.2" DEPOSIT ABSOLUTE /end AXIS_DESCR
/end CHARACTERISTIC
/begin CHARACTERISTIC TMDMMAU "Unterster Anfangswert aus tans f¸r Motortemperaturmodell" VALUE 0xFCE023 KwUb 191.3 temp_ub_q0p75_o48 -48.00 143.3 FORMAT "%5.1" /end CHARACTERISTIC
/begin CHARACTERISTIC TMDMMEE "Endtemperatur f¸r Ersatzwert Motortemperatur" VALUE 0xFCE024 KwUb 191.3 temp_ub_q0p75_o48 -48.00 143.3 FORMAT "%5.1" /end CHARACTERISTIC
/begin CHARACTERISTIC TMDMMER "Endtemperatur f¸r Referenzwert Motortemperatur" VALUE 0xFCE025 KwUb 191.3 temp_ub_q0p75_o48 -48.00 143.3 FORMAT "%5.1" /end CHARACTERISTIC
/begin CHARACTERISTIC TMDMN "Motortemperatur min." VALUE 0xFCE026 KwUb 191.3 temp_ub_q0p75_o48 -48.00 143.3 FORMAT "%5.1" /end CHARACTERISTIC
/begin CHARACTERISTIC TMDMX "Motortemperatur max." VALUE 0xFCE027 KwUb 191.3 temp_ub_q0p75_o48 -48.00 143.3 FORMAT "%5.1" /end CHARACTERISTIC
/begin CHARACTERISTIC TMDYNA "TMOT - Schwelle f¸r Lastdynamikadaption aktiv" VALUE 0xFC67C6 KwUb 191.3 temp_ub_q0p75_o48 -48.00 143.3 FORMAT "%5.1" /end CHARACTERISTIC
/begin CHARACTERISTIC TMKOAO "Obere Motortemperaturschwelle f¸r Kompressorabschaltung" VALUE 0xFCC42C KwUb 191.3 temp_ub_q0p75_o48 -48.00 143.3 FORMAT "%5.1" /end CHARACTERISTIC
/begin CHARACTERISTIC TMKOAU "Untere Motortemperaturschwelle f¸r Kompressorabschaltung" VALUE 0xFCC42D KwUb 191.3 temp_ub_q0p75_o48 -48.00 143.3 FORMAT "%5.1" /end CHARACTERISTIC
/begin CHARACTERISTIC TMLRTMS "Motortemperaturschwelle f¸r LR ein abh. von Starttemperatur" CURVE 0xFCE028 KlAUbSstUbWUb 191.3 temp_ub_q0p75_o48 -48.00 143.3 FORMAT "%5.1"
 /begin AXIS_DESCR STD_AXIS tmst temp_ub_q0p75_o48 4 -48.00 143.3 FORMAT "%5.1" DEPOSIT ABSOLUTE /end AXIS_DESCR
/end CHARACTERISTIC
/begin CHARACTERISTIC TMMXRT "max. Motortemperatur f. Retrigg. Modelle (Blockheater-Erkennung)" VALUE 0xFCE031 KwUb 191.3 temp_ub_q0p75_o48 -48.00 143.3 FORMAT "%5.1" /end CHARACTERISTIC
/begin CHARACTERISTIC TMOHSMN "Motortemperatur f¸r Reduzierung Sondenheizung" VALUE 0xFCCD34 KwUb 191.3 temp_ub_q0p75_o48 -48.00 143.3 FORMAT "%5.1" /end CHARACTERISTIC
/begin CHARACTERISTIC TMOTELI "Temperatur Motor Erfassung u. Linearisierung, Inverskennlinie" CURVE 0xFCE034 KlAUbSstUbWUb 191.3 temp_ub_q0p75_o48 -48.00 143.3 FORMAT "%5.1"
 /begin AXIS_DESCR STD_AXIS wtmot spg_ub_b5 20 0.00 4.980 FORMAT "%5.3" DEPOSIT ABSOLUTE /end AXIS_DESCR
/end CHARACTERISTIC
/begin CHARACTERISTIC TMOTTKWMAX "" VALUE 0xFCC3EB KwWU8 191.3 temp_ub_q0p75_o48 -48.00 143.3 FORMAT "%5.1" /end CHARACTERISTIC
/begin CHARACTERISTIC TMOTTKWMIN "" VALUE 0xFCC3EC KwWU8 191.3 temp_ub_q0p75_o48 -48.00 143.3 FORMAT "%5.1" /end CHARACTERISTIC
/begin CHARACTERISTIC TMOT_MX_ZH "max. Wassertemp. f¸r Zuheizmaﬂnahme (Klima, Heater)" VALUE 0xFC6C0F KwWU8 191.3 temp_ub_q0p75_o48 -48.00 143.3 FORMAT "%5.1" /end CHARACTERISTIC
/begin CHARACTERISTIC TNSRT "Max.-Zeit ab Start f¸r Retriggerung Berechnung Motortemperaturmodell" VALUE 0xFCE05D KwUb 255.0 t1sxs_ub_b255 0.00 255.0 FORMAT "%5.1" /end CHARACTERISTIC
/begin CHARACTERISTIC TNSTKO "Unterdr¸ckungszeit des Kompressors nach dem Start" VALUE 0xFCC42E KwUb 51.00 t200msxs_ub_b51 0.00 51.00 FORMAT "%5.2" /end CHARACTERISTIC
/begin CHARACTERISTIC TOGANZ "Anzahl Messungen Normalbetrieb" VALUE 0xFCE1CA KwWU16 2999.000 default 1.000000 3000.000 FORMAT "%8.3" /end CHARACTERISTIC
/begin CHARACTERISTIC TOGKURZANZ "Anzahl Messungen Kurzzeit" VALUE 0xFCE1CC KwWU16 999.0000 dez 1.000000 1000.000 FORMAT "%8.3" /end CHARACTERISTIC
/begin CHARACTERISTIC TOGMWK "Anzahl Messwerte fuer die Paketbildung" VALUE 0xFCE1D3 KwWU8 99.00 dez 1.000 100.0 FORMAT "%5.1" /end CHARACTERISTIC
/begin CHARACTERISTIC TOGNMOT "Drehzahlschwelle Orientieunggsmessung -> Normalbetrieb" VALUE 0xFCE1D4 KwWU8 10200. nmot_ub_q40 0.00 10200. FORMAT "%5.0" /end CHARACTERISTIC
/begin CHARACTERISTIC TOGORIANZ "Anzahl Messwerte Orientierungsmessung" VALUE 0xFCE1D5 KwWU8 254.0 dez 1.000 255.0 FORMAT "%5.1" /end CHARACTERISTIC
/begin CHARACTERISTIC TOGTMOT "Initialisierungswert Oeltemperatur" VALUE 0xFCE1D6 KwWU8 191.3 temp_uw_q0p75_o48 -48.00 143.3 FORMAT "%5.1" /end CHARACTERISTIC
/begin CHARACTERISTIC TOGTMOTORI "Temperaturschelle Orientierungsmessung" VALUE 0xFCE1D7 KwWU8 191.3 temp_ub_q0p75_o48 -48.00 143.3 FORMAT "%5.1" /end CHARACTERISTIC
/begin CHARACTERISTIC TOGVERBKZ "Oelverbrauchschwelle Kurzzeitmessung" VALUE 0xFCE1D8 KwWU8 127.5 tog_ub_q0p5 0.00 127.5 FORMAT "%5.1" /end CHARACTERISTIC
/begin CHARACTERISTIC TOGVERBNOR "Oelverbrauchschwelle Normalbetrieb" VALUE 0xFCE1D9 KwWU8 127.5 tog_ub_q0p5 0.00 127.5 FORMAT "%5.1" /end CHARACTERISTIC
/begin CHARACTERISTIC TOGVERLKZ "Oelverlustschwelle Kurzzeitmessung" VALUE 0xFCE1DA KwWU8 127.5 tog_ub_q0p5 0.00 127.5 FORMAT "%5.1" /end CHARACTERISTIC
/begin CHARACTERISTIC TOGVERLNOR "Oelverlustschwelle Normalbetrieb" VALUE 0xFCE1DB KwWU8 127.5 tog_ub_q0p5 0.00 127.5 FORMAT "%5.1" /end CHARACTERISTIC
/begin CHARACTERISTIC TOGVERLORI "Oelverlustschwelle Orientierungsmessung" VALUE 0xFCE1DC KwWU8 127.5 tog_ub_q0p5 0.00 127.5 FORMAT "%5.1" /end CHARACTERISTIC
/begin CHARACTERISTIC TPNSE1 "Pr¸fzeit nach Startende f¸r PWG-Diagnose" VALUE 0xFCDFDA KwUb 12.70 t50msxs_ub_b12p75 0.05000 12.75 FORMAT "%5.2" /end CHARACTERISTIC
/begin CHARACTERISTIC TPREL "Zahnentprellzeit in der Initialisierung" VALUE 0xFC643A KwWU8 255.0 t1msxms_q1 0.00 255.0 FORMAT "%5.1" /end CHARACTERISTIC
/begin CHARACTERISTIC TRTYP "Typische Referenzzeit TRSOLL" VALUE 0xFCE1CE KwWU16 6553.500 t_q0p1ms 0.00 6553.500 FORMAT "%8.3" /end CHARACTERISTIC
/begin CHARACTERISTIC TSGELI "Temperatur Steuerger‰t- Erfassung und Linearisierung" CURVE 0xFCE144 KlAUbSstUbWUb 191.3 temp_ub_q0p75_o48 -48.00 143.3 FORMAT "%5.1"
 /begin AXIS_DESCR STD_AXIS wtsg spg_ub_b5 18 0.00 4.980 FORMAT "%5.3" DEPOSIT ABSOLUTE /end AXIS_DESCR
/end CHARACTERISTIC
/begin CHARACTERISTIC TSTCNTEN "Enable TestCounter" VALUE 0xFC9553 KwWU8 1.000 DEZ 0.00 1.000 FORMAT "%5.3" /end CHARACTERISTIC
/begin CHARACTERISTIC TSTFIL_IN "Testfilter Eingang" VALUE 0xFC94BA KwWU16 768.0000 gendt_q0p075 0.00 768.0000 FORMAT "%8.4" /end CHARACTERISTIC
/begin CHARACTERISTIC TSTFIL_INI "Initialisierung Testfilter" VALUE 0xFC9554 KwWU8 255.0 dez 0.00 255.0 FORMAT "%5.1" /end CHARACTERISTIC
/begin CHARACTERISTIC TSTSG "Zeitintervall f¸r Erfassung SG-Temperatur-Histogramm" VALUE 0xFCE169 KwUb 254.0 t1sxs_ub_b255 1.000 255.0 FORMAT "%5.1" /end CHARACTERISTIC
/begin CHARACTERISTIC TUMDETM "Umgebungslufttemperatur-Ersatzwert f¸r Motortemperatur-Modell" VALUE 0xFCE05E KwUb 191.3 temp_ub_q0p75_o48 -48.00 143.3 FORMAT "%5.1" /end CHARACTERISTIC
/begin CHARACTERISTIC TUMGTAI "Initialisierungswert Umgebungstemperatur" VALUE 0xFCE106 KwUb 191.3 temp_ub_q0p75_o48 -48.00 143.3 FORMAT "%5.1" /end CHARACTERISTIC
/begin CHARACTERISTIC TUMGTKWBG "" VALUE 0xFCC3ED KwWU8 191.3 temp_ub_q0p75_o48 -48.00 143.3 FORMAT "%5.1" /end CHARACTERISTIC
/begin CHARACTERISTIC TUMGTKWKR "Umgebungstemperaturschwelle KR-Anforderung" VALUE 0xFCC3EE KwWU8 191.3 temp_ub_q0p75_o48 -48.00 143.3 FORMAT "%5.1" /end CHARACTERISTIC
/begin CHARACTERISTIC TUMGTKWRL "Umgebungstemperaturschwelle Hohe Last" VALUE 0xFCC3EF KwWU8 191.3 temp_ub_q0p75_o48 -48.00 143.3 FORMAT "%5.1" /end CHARACTERISTIC
/begin CHARACTERISTIC TUMGTKWTA "Umgebungstemperaturschwelle Ansauglufttemperatur" VALUE 0xFCC3F0 KwWU8 191.3 temp_ub_q0p75_o48 -48.00 143.3 FORMAT "%5.1" /end CHARACTERISTIC
/begin CHARACTERISTIC TUMG_MX_ZH "max. Umgebungstemp. f¸r Zuheizmaﬂnahme (Klima, Heater)" VALUE 0xFC6C10 KwWU8 191.3 temp_ub_q0p75_o48 -48.00 143.3 FORMAT "%5.1" /end CHARACTERISTIC
/begin CHARACTERISTIC TUPWBWF "Fehlerzeit bei Bewegungserkennung" VALUE 0xFC6335 KwUb 2.550 t10msxs_ub_b2p55 0.00 2.550 FORMAT "%5.3" /end CHARACTERISTIC
/begin CHARACTERISTIC TUPWBWV "Zeitverzˆgerung zum Einspeichern eines neuen Poti 2 Wertes" VALUE 0xFC6336 KwUb 2.550 t10msxs_ub_b2p55 0.00 2.550 FORMAT "%5.3" /end CHARACTERISTIC
/begin CHARACTERISTIC TUPWG12 "Fehlerzeit bei Vergleich von PWG-Poti 1 und 2" VALUE 0xFC6337 KwUb 2.550 t10msxs_ub_b2p55 0.00 2.550 FORMAT "%5.3" /end CHARACTERISTIC
/begin CHARACTERISTIC TUPWG1O "Fehlerzeit bei Bereichsverletzung von PWG-Poti 1 nach oben" VALUE 0xFC6338 KwUb 2.550 t10msxs_ub_b2p55 0.00 2.550 FORMAT "%5.3" /end CHARACTERISTIC
/begin CHARACTERISTIC TUPWG1U "Fehlerzeit bei Bereichsverletzung von PWG-Poti 1 nach unten" VALUE 0xFC6339 KwUb 2.550 t10msxs_ub_b2p55 0.00 2.550 FORMAT "%5.3" /end CHARACTERISTIC
/begin CHARACTERISTIC TUPWG2O "Fehlerzeit bei Bereichsverletzung von PWG-Poti 2 nach oben" VALUE 0xFC633A KwUb 2.550 t10msxs_ub_b2p55 0.00 2.550 FORMAT "%5.3" /end CHARACTERISTIC
/begin CHARACTERISTIC TUPWG2U "Fehlerzeit bei Bereichsverletzung von PWG-Poti 2 nach unten" VALUE 0xFC633B KwUb 2.550 t10msxs_ub_b2p55 0.00 2.550 FORMAT "%5.3" /end CHARACTERISTIC
/begin CHARACTERISTIC TVHSH "Einschaltverzˆgerung der Sondenheizung hinter Kat" VALUE 0xFCCD35 KwUb 25.50 t100msxs_ub_b25p5 0.00 25.50 FORMAT "%5.2" /end CHARACTERISTIC
/begin CHARACTERISTIC TVHSV "Einschaltverzˆgerung der Sondenheizung vor Kat" VALUE 0xFCCD36 KwUb 25.50 t100msxs_ub_b25p5 0.00 25.50 FORMAT "%5.2" /end CHARACTERISTIC
/begin CHARACTERISTIC TVKOE "Verzˆgerungszeit f¸r Kompressor EIN" VALUE 0xFCC42F KwUb 51.00 t200msxs_ub_b51 0.00 51.00 FORMAT "%5.2" /end CHARACTERISTIC
/begin CHARACTERISTIC TWLRTMS "Wartezeit f¸r Diagnose TMOT-Einschaltbedingung lambda-Regelung" CURVE 0xFCE0F2 KlAUbSstUbWUw 6553.500 t100msxs_uw_b6553p5 0.00 6553.500 FORMAT "%8.3"
 /begin AXIS_DESCR STD_AXIS tmst temp_ub_q0p75_o48 4 -48.00 143.3 FORMAT "%5.1" DEPOSIT ABSOLUTE /end AXIS_DESCR
/end CHARACTERISTIC
/begin CHARACTERISTIC TWPMBBR "Verzˆgerungszeit f¸r Pedalwertbegrenzung bei bet‰tigter Bremse" VALUE 0xFC633C KwUb 2.550 t10msxs_ub_b2p55 0.00 2.550 FORMAT "%5.3" /end CHARACTERISTIC
/begin CHARACTERISTIC TZVER "Z‰hlerzeit f¸r Adaptionsverzˆgerung in KRDY" VALUE 0xFCEB8E KwUb 25.50 t100msxs_ub_b25p5 0.00 25.50 FORMAT "%5.2" /end CHARACTERISTIC
/begin CHARACTERISTIC UBDE "Ubatt - Ersatzwert bei defektem AD - Kanal" VALUE 0xFC635E KwUb 24.02 spg_ubatt 0.00 24.02 FORMAT "%5.2" /end CHARACTERISTIC
/begin CHARACTERISTIC UBDMN1 "Batteriespannung min. (Netz)" VALUE 0xFC635F KwUb 24.02 spg_ubatt 0.00 24.02 FORMAT "%5.2" /end CHARACTERISTIC
/begin CHARACTERISTIC UBDMN2 "Batteriespannung min. (ADC)" VALUE 0xFC6360 KwUb 24.02 spg_ubatt 0.00 24.02 FORMAT "%5.2" /end CHARACTERISTIC
/begin CHARACTERISTIC UBDMX "Batteriespannung max." VALUE 0xFC6361 KwUb 24.02 spg_ubatt 0.00 24.02 FORMAT "%5.2" /end CHARACTERISTIC
/begin CHARACTERISTIC UBHS "Batteriespannungsschwelle f¸r Abschalten der Sondenheizung" VALUE 0xFCCD37 KwUb 24.02 spg_ubatt 0.00 24.02 FORMAT "%5.2" /end CHARACTERISTIC
/begin CHARACTERISTIC UBRDMN1 "untere Grenze Bordnetzspannung ¸ber Hauptrelais, Erkennung Lastabfall" VALUE 0xFCE1E0 KwUb 25.50 spg_q0p1 0.00 25.50 FORMAT "%5.2" /end CHARACTERISTIC
/begin CHARACTERISTIC UBRDMN2 "untere Grenze Bordnetzspannung ¸ber Hauptrelais" VALUE 0xFCE1E1 KwUb 25.50 spg_q0p1 0.00 25.50 FORMAT "%5.2" /end CHARACTERISTIC
/begin CHARACTERISTIC UBRDMX "obere Grenze Bordnetzspannung ¸ber Hauptrelais" VALUE 0xFCE1E2 KwUb 24.02 spg_ubatt 0.00 24.02 FORMAT "%5.2" /end CHARACTERISTIC
/begin CHARACTERISTIC UDIODERMS0 "RMS-Schwellspannung Generatordiode0" VALUE 0xFC9555 KwWU8 1.992 fak_ub_b2 0.00 1.992 FORMAT "%5.3" /end CHARACTERISTIC
/begin CHARACTERISTIC UDIODERMS1 "RMS-Schwellspannung Generatordiode1" VALUE 0xFC9556 KwWU8 1.992 fak_ub_b2 0.00 1.992 FORMAT "%5.3" /end CHARACTERISTIC
/begin CHARACTERISTIC UDIODERMS2 "RMS-Schwellspannung Generatordiode2" VALUE 0xFC9557 KwWU8 1.992 fak_ub_b2 0.00 1.992 FORMAT "%5.3" /end CHARACTERISTIC
/begin CHARACTERISTIC UDIODERMS3 "RMS-Schwellspannung Generatordiode3" VALUE 0xFC9558 KwWU8 1.992 fak_ub_b2 0.00 1.992 FORMAT "%5.3" /end CHARACTERISTIC
/begin CHARACTERISTIC UDIODERMS4 "RMS-Schwellspannung Generatordiode4" VALUE 0xFC9559 KwWU8 1.992 fak_ub_b2 0.00 1.992 FORMAT "%5.3" /end CHARACTERISTIC
/begin CHARACTERISTIC UDIODERMS5 "RMS-Schwellspannung Generatordiode5" VALUE 0xFC955A KwWU8 1.992 fak_ub_b2 0.00 1.992 FORMAT "%5.3" /end CHARACTERISTIC
/begin CHARACTERISTIC UDIODERMS6 "RMS-Schwellspannung Generatordiode6" VALUE 0xFC955B KwWU8 1.992 fak_ub_b2 0.00 1.992 FORMAT "%5.3" /end CHARACTERISTIC
/begin CHARACTERISTIC UDIODERMS7 "RMS-Schwellspannung Generatordiode7" VALUE 0xFC955C KwWU8 1.992 fak_ub_b2 0.00 1.992 FORMAT "%5.3" /end CHARACTERISTIC
/begin CHARACTERISTIC UHSN "Nennspannung f¸r die Sondenheizung" VALUE 0xFCCD38 KwUb 24.02 spg_ubatt 0.00 24.02 FORMAT "%5.2" /end CHARACTERISTIC
/begin CHARACTERISTIC UPW1BE "Spannung PWG-Poti 1 f¸r Durchf¸hrung der Bewegungserkennung" VALUE 0xFC633D KwUb 4.980 spg_ub_b5 0.00 4.980 FORMAT "%5.3" /end CHARACTERISTIC
/begin CHARACTERISTIC UPW1LLMX "Maximale Spannung von Poti 1 im Leergaspunkt" VALUE 0xFC633E KwUb 4.980 spg_ub_b5 0.00 4.980 FORMAT "%5.3" /end CHARACTERISTIC
/begin CHARACTERISTIC UPWG12U "Untere Begrenzung PWG-Poti-Spannung vor Vergleich Poti 1 und 2" VALUE 0xFC633F KwUb 4.980 spg_ub_b5 0.00 4.980 FORMAT "%5.3" /end CHARACTERISTIC
/begin CHARACTERISTIC UPWG1O "Obere Schranke f¸r PWG-Poti-1-Spannung" VALUE 0xFC6340 KwUb 4.980 spg_ub_b5 0.00 4.980 FORMAT "%5.3" /end CHARACTERISTIC
/begin CHARACTERISTIC UPWG1U "Untere Schranke f¸r PWG-Poti-1-Spannung" VALUE 0xFC6341 KwUb 4.980 spg_ub_b5 0.00 4.980 FORMAT "%5.3" /end CHARACTERISTIC
/begin CHARACTERISTIC UPWG2O "Obere Schranke f¸r PWG-Poti-2-Spannung" VALUE 0xFC6342 KwUb 4.980 spg_ub_b5 0.00 4.980 FORMAT "%5.3" /end CHARACTERISTIC
/begin CHARACTERISTIC UPWG2U "Untere Schranke f¸r PWG-Poti-2-Spannung" VALUE 0xFC6343 KwUb 4.980 spg_ub_b5 0.00 4.980 FORMAT "%5.3" /end CHARACTERISTIC
/begin CHARACTERISTIC UPWGO "Oberer PWG-Spannungswert f¸r Umnormierung auf Pedalwert" VALUE 0xFC6344 KwUb 4.980 spg_ub_b5 0.00 4.980 FORMAT "%5.3" /end CHARACTERISTIC
/begin CHARACTERISTIC UPWGTG "PWG-Spannungsschwelle f¸r Teilgasbereich" VALUE 0xFC6345 KwUb 4.980 spg_ub_b5 0.00 4.980 FORMAT "%5.3" /end CHARACTERISTIC
/begin CHARACTERISTIC UPWGTL "Teillastschwelle der PWG-Spannung in Hochohmigkeitspr¸fung" VALUE 0xFC6346 KwUb 4.980 spg_ub_b5 0.00 4.980 FORMAT "%5.3" /end CHARACTERISTIC
/begin CHARACTERISTIC UPWGU "Unterer PWG-Spannungswert f¸r Umnormierung auf Pedalwert" VALUE 0xFC6347 KwUb 4.980 spg_ub_b5 0.00 4.980 FORMAT "%5.3" /end CHARACTERISTIC
/begin CHARACTERISTIC UPWGUBF "Unterer Spannungswert zur Umnormierung bei erkanntem Bewegungsfehler" VALUE 0xFC6348 KwUb 4.980 spg_ub_b5 0.00 4.980 FORMAT "%5.3" /end CHARACTERISTIC
/begin CHARACTERISTIC UPWGUR "Reduzierter unterer PWG-Spannungswert f¸r Umnormierung auf Pedalwert" VALUE 0xFC6349 KwUb 4.980 spg_ub_b5 0.00 4.980 FORMAT "%5.3" /end CHARACTERISTIC
/begin CHARACTERISTIC UPWGVG "PWG-Spannungsschwelle f¸r Vollgasbereich" VALUE 0xFC634A KwUb 4.980 spg_ub_b5 0.00 4.980 FORMAT "%5.3" /end CHARACTERISTIC
/begin CHARACTERISTIC VFZMN "Erkennen Fahren-Stehen" VALUE 0xFC659E KwWU16 511.9922 vfzg_uw_b512 0.00 511.9922 FORMAT "%8.4" /end CHARACTERISTIC
/begin CHARACTERISTIC VKOAO "Obere Geschwindigkeitsschwelle f¸r Kompressorabschaltung" VALUE 0xFCC430 KwUb 318.8 vfzg_ub_q1p25 0.00 318.8 FORMAT "%5.1" /end CHARACTERISTIC
/begin CHARACTERISTIC VMDUB "Geschwindigkeitsschwelle min. f¸r Batteriespannungs-Diagnose" VALUE 0xFC6362 KwUb 318.8 vfzg_ub_q1p25 0.00 318.8 FORMAT "%5.1" /end CHARACTERISTIC
/begin CHARACTERISTIC VRFGRMN "Untere Schwelle vroh_w f¸r FGR-Abschaltung ¸ber vfzg_w = 0" VALUE 0xFC6598 KwWU16 511.9922 vfzg_uw_b512 0.00 511.9922 FORMAT "%8.4" /end CHARACTERISTIC
/begin CHARACTERISTIC VTUMGTA "Schwelle Fahrzeuggeschwindigkeit f¸r TANS -> Umgebungstemperatur" VALUE 0xFCE107 KwUb 318.8 vfzg_ub_q1p25 0.00 318.8 FORMAT "%5.1" /end CHARACTERISTIC
/begin CHARACTERISTIC VWPMBBR "Mindestgeschwindigkeit f¸r Pedalwertbegrenzung bei bet‰tigter Bremse" VALUE 0xFC634B KwUb 318.8 vfzg_ub_q1p25 0.00 318.8 FORMAT "%5.1" /end CHARACTERISTIC
/begin CHARACTERISTIC WKWALETEST "Testwert f¸r Start ¸ber Auslauferkennung" VALUE 0xFC6434 KwWU16 6553.500 kw_q0p1 0.00 6553.500 FORMAT "%8.3" /end CHARACTERISTIC
/begin CHARACTERISTIC WNWSPG1 "Sollwinkel der 1. negativen Nockenwellenflanke von PG1" VALUE 0xFC641E KwWU16 6553.500 kw_q0p1 0.00 6553.500 FORMAT "%8.3" /end CHARACTERISTIC
/begin CHARACTERISTIC WNWSPG2 "Sollwinkel der 1. negativen Nockenwellenflanke von PG2" VALUE 0xFC6420 KwWU16 6553.500 kw_q0p1 0.00 6553.500 FORMAT "%8.3" /end CHARACTERISTIC
/begin CHARACTERISTIC WPMXBR "Maximal zul‰ssiger Pedalwert bei bet‰tigter Bremse (vor Erkennung wped = 0)" VALUE 0xFC635A KwUw 100.0000 relPED_uw_b100 0.00 100.0000 FORMAT "%8.4" /end CHARACTERISTIC
/begin CHARACTERISTIC WPMXNOT "Maximal zul‰ssiger Fahrpedalwert im PWG-Notfahren" VALUE 0xFC634C KwUb 100.0 relPED_ub_b100 0.00 100.0 FORMAT "%5.1" /end CHARACTERISTIC
/begin CHARACTERISTIC ZBWF "Z‰hlerstand f¸r Fehlereintrag Bewegungserkennung" VALUE 0xFC634D KwUb 255.0 dez 0.00 255.0 FORMAT "%5.1" /end CHARACTERISTIC
/begin CHARACTERISTIC ZFTANS "Zeitkonstante Tiefpaﬂfilter Ansauglufttemperatur" VALUE 0xFCE00C KwUw 6553.50000 zk100msxs_uw_b6553 0.100001526 6553.60000 FORMAT "%10.5" /end CHARACTERISTIC
/begin CHARACTERISTIC ZFTMOT "Zeitkonstante Tiefpaﬂfilter tmot" VALUE 0xFCE100 KwUw 6553.500 t100msxs_uw_b6553p5 0.00 6553.500 FORMAT "%8.3" /end CHARACTERISTIC
/begin CHARACTERISTIC ZFV "Zeitkonstante f¸r Filterung des Geschwindigkeitssignals" VALUE 0xFC65A0 KwWU16 655.34999985 zk10msxs_uw_b655 0.010000152590 655.36000000 FORMAT "%12.8" /end CHARACTERISTIC
/begin CHARACTERISTIC ZKBKVAB "Zeitkonstante Absteuerung Momentenreserve Katheizen f¸r BKV" VALUE 0xFCE445 KwUb 25.4996 zk100msxs_ub_b25p5 0.100392 25.6000 FORMAT "%7.4" /end CHARACTERISTIC
/begin CHARACTERISTIC ZKMDKH "Filterzeitkonstante bei Wechsel von Teillast nach LL und umgekehrt" VALUE 0xFCE446 KwUb 25.4996 zk100msxs_ub_b25p5 0.100392 25.6000 FORMAT "%7.4" /end CHARACTERISTIC
/begin CHARACTERISTIC ZMGENIG "Zeitkonstante Generatorstrom" VALUE 0xFC94BC KwWU16 1.999969 genzmig_uw_q0p305em7 0.00 1.999969 FORMAT "%8.6" /end CHARACTERISTIC
/begin CHARACTERISTIC ZMGENS0HZ0 "Zeitkonstante Generatorstator0 Aufheizung im Stand" VALUE 0xFC94BE KwWU16 0.9999847 genzmst_uw_q0p152em7 0.00 0.9999847 FORMAT "%9.7" /end CHARACTERISTIC
/begin CHARACTERISTIC ZMGENS0HZ1 "Zeitkonstante Generatorstator1 Aufheizung im Stand" VALUE 0xFC94C0 KwWU16 0.9999847 genzmst_uw_q0p152em7 0.00 0.9999847 FORMAT "%9.7" /end CHARACTERISTIC
/begin CHARACTERISTIC ZMGENS0HZ2 "Zeitkonstante Generatorstator2 Aufheizung im Stand" VALUE 0xFC94C2 KwWU16 0.9999847 genzmst_uw_q0p152em7 0.00 0.9999847 FORMAT "%9.7" /end CHARACTERISTIC
/begin CHARACTERISTIC ZMGENS0HZ3 "Zeitkonstante Generatorstator3 Aufheizung im Stand" VALUE 0xFC94C4 KwWU16 0.9999847 genzmst_uw_q0p152em7 0.00 0.9999847 FORMAT "%9.7" /end CHARACTERISTIC
/begin CHARACTERISTIC ZMGENS0HZ4 "Zeitkonstante Generatorstator4 Aufheizung im Stand" VALUE 0xFC94C6 KwWU16 0.9999847 genzmst_uw_q0p152em7 0.00 0.9999847 FORMAT "%9.7" /end CHARACTERISTIC
/begin CHARACTERISTIC ZMGENS0HZ5 "Zeitkonstante Generatorstator5 Aufheizung im Stand" VALUE 0xFC94C8 KwWU16 0.9999847 genzmst_uw_q0p152em7 0.00 0.9999847 FORMAT "%9.7" /end CHARACTERISTIC
/begin CHARACTERISTIC ZMGENS0HZ6 "Zeitkonstante Generatorstator6 Aufheizung im Stand" VALUE 0xFC94CA KwWU16 0.9999847 genzmst_uw_q0p152em7 0.00 0.9999847 FORMAT "%9.7" /end CHARACTERISTIC
/begin CHARACTERISTIC ZMGENS0HZ7 "Zeitkonstante Generatorstator7 Aufheizung im Stand" VALUE 0xFC94CC KwWU16 0.9999847 genzmst_uw_q0p152em7 0.00 0.9999847 FORMAT "%9.7" /end CHARACTERISTIC
/begin CHARACTERISTIC ZMGENS0KL0 "Zeitkonstante Abk¸hlung Generator im Stand0" VALUE 0xFC94CE KwWU16 0.9999847 genzmst_uw_q0p152em7 0.00 0.9999847 FORMAT "%9.7" /end CHARACTERISTIC
/begin CHARACTERISTIC ZMGENS0KL1 "Zeitkonstante Abk¸hlung Generator im Stand1" VALUE 0xFC94D0 KwWU16 0.9999847 genzmst_uw_q0p152em7 0.00 0.9999847 FORMAT "%9.7" /end CHARACTERISTIC
/begin CHARACTERISTIC ZMGENS0KL2 "Zeitkonstante Abk¸hlung Generator im Stand2" VALUE 0xFC94D2 KwWU16 0.9999847 genzmst_uw_q0p152em7 0.00 0.9999847 FORMAT "%9.7" /end CHARACTERISTIC
/begin CHARACTERISTIC ZMGENS0KL3 "Zeitkonstante Abk¸hlung Generator im Stand3" VALUE 0xFC94D4 KwWU16 0.9999847 genzmst_uw_q0p152em7 0.00 0.9999847 FORMAT "%9.7" /end CHARACTERISTIC
/begin CHARACTERISTIC ZMGENS0KL4 "Zeitkonstante Abk¸hlung Generator im Stand4" VALUE 0xFC94D6 KwWU16 0.9999847 genzmst_uw_q0p152em7 0.00 0.9999847 FORMAT "%9.7" /end CHARACTERISTIC
/begin CHARACTERISTIC ZMGENS0KL5 "Zeitkonstante Abk¸hlung Generator im Stand5" VALUE 0xFC94D8 KwWU16 0.9999847 genzmst_uw_q0p152em7 0.00 0.9999847 FORMAT "%9.7" /end CHARACTERISTIC
/begin CHARACTERISTIC ZMGENS0KL6 "Zeitkonstante Abk¸hlung Generator im Stand6" VALUE 0xFC94DA KwWU16 0.9999847 genzmst_uw_q0p152em7 0.00 0.9999847 FORMAT "%9.7" /end CHARACTERISTIC
/begin CHARACTERISTIC ZMGENS0KL7 "Zeitkonstante Abk¸hlung Generator im Stand7" VALUE 0xFC94DC KwWU16 0.9999847 genzmst_uw_q0p152em7 0.00 0.9999847 FORMAT "%9.7" /end CHARACTERISTIC
/begin CHARACTERISTIC ZMGENSTHZ0 "Zeitkonstante Generatorstator Aufheizung im Stand" VALUE 0xFC94DE KwWU16 0.9999847 genzmst_uw_q0p152em7 0.00 0.9999847 FORMAT "%9.7" /end CHARACTERISTIC
/begin CHARACTERISTIC ZMGENSTHZ1 "Zeitkonstante Generatorstator1 Aufheizung" VALUE 0xFC94E0 KwWU16 0.9999847 genzmst_uw_q0p152em7 0.00 0.9999847 FORMAT "%9.7" /end CHARACTERISTIC
/begin CHARACTERISTIC ZMGENSTHZ2 "Zeitkonstante Generatorstator2 Aufheizung" VALUE 0xFC94E2 KwWU16 0.9999847 genzmst_uw_q0p152em7 0.00 0.9999847 FORMAT "%9.7" /end CHARACTERISTIC
/begin CHARACTERISTIC ZMGENSTHZ3 "Zeitkonstante Generatorstator3 Aufheizung" VALUE 0xFC94E4 KwWU16 0.9999847 genzmst_uw_q0p152em7 0.00 0.9999847 FORMAT "%9.7" /end CHARACTERISTIC
/begin CHARACTERISTIC ZMGENSTHZ4 "Zeitkonstante Generatorstator4 Aufheizung" VALUE 0xFC94E6 KwWU16 0.9999847 genzmst_uw_q0p152em7 0.00 0.9999847 FORMAT "%9.7" /end CHARACTERISTIC
/begin CHARACTERISTIC ZMGENSTHZ5 "Zeitkonstante Generatorstator5 Aufheizung" VALUE 0xFC94E8 KwWU16 0.9999847 genzmst_uw_q0p152em7 0.00 0.9999847 FORMAT "%9.7" /end CHARACTERISTIC
/begin CHARACTERISTIC ZMGENSTHZ6 "Zeitkonstante Generatorstator6 Aufheizung" VALUE 0xFC94EA KwWU16 0.9999847 genzmst_uw_q0p152em7 0.00 0.9999847 FORMAT "%9.7" /end CHARACTERISTIC
/begin CHARACTERISTIC ZMGENSTHZ7 "Zeitkonstante Generatorstator7 Aufheizung" VALUE 0xFC94EC KwWU16 0.9999847 genzmst_uw_q0p152em7 0.00 0.9999847 FORMAT "%9.7" /end CHARACTERISTIC
/begin CHARACTERISTIC ZMGENSTKL0 "Zeitkonstante Abk¸hlung Generator im Stand" VALUE 0xFC94EE KwWU16 0.9999847 genzmst_uw_q0p152em7 0.00 0.9999847 FORMAT "%9.7" /end CHARACTERISTIC
/begin CHARACTERISTIC ZMGENSTKL1 "Zeitkonstante Abk¸hlung Generator1" VALUE 0xFC94F0 KwWU16 0.9999847 genzmst_uw_q0p152em7 0.00 0.9999847 FORMAT "%9.7" /end CHARACTERISTIC
/begin CHARACTERISTIC ZMGENSTKL2 "Zeitkonstante Abk¸hlung Generator2" VALUE 0xFC94F2 KwWU16 0.9999847 genzmst_uw_q0p152em7 0.00 0.9999847 FORMAT "%9.7" /end CHARACTERISTIC
/begin CHARACTERISTIC ZMGENSTKL3 "Zeitkonstante Abk¸hlung Generator3" VALUE 0xFC94F4 KwWU16 0.9999847 genzmst_uw_q0p152em7 0.00 0.9999847 FORMAT "%9.7" /end CHARACTERISTIC
/begin CHARACTERISTIC ZMGENSTKL4 "Zeitkonstante Abk¸hlung Generator4" VALUE 0xFC94F6 KwWU16 0.9999847 genzmst_uw_q0p152em7 0.00 0.9999847 FORMAT "%9.7" /end CHARACTERISTIC
/begin CHARACTERISTIC ZMGENSTKL5 "Zeitkonstante Abk¸hlung Generator5" VALUE 0xFC94F8 KwWU16 0.9999847 genzmst_uw_q0p152em7 0.00 0.9999847 FORMAT "%9.7" /end CHARACTERISTIC
/begin CHARACTERISTIC ZMGENSTKL6 "Zeitkonstante Abk¸hlung Generator6" VALUE 0xFC94FA KwWU16 0.9999847 genzmst_uw_q0p152em7 0.00 0.9999847 FORMAT "%9.7" /end CHARACTERISTIC
/begin CHARACTERISTIC ZMGENSTKL7 "Zeitkonstante Abk¸hlung Generator7" VALUE 0xFC94FC KwWU16 0.9999847 genzmst_uw_q0p152em7 0.00 0.9999847 FORMAT "%9.7" /end CHARACTERISTIC
/begin CHARACTERISTIC ZMGENTWA "Zeitkonstante Generatorstatorwasser" VALUE 0xFC94FE KwWU16 0.9999847 fak_uw_b1 0.00 0.9999847 FORMAT "%9.7" /end CHARACTERISTIC
/begin CHARACTERISTIC ZMGN0TANS0 "Zeitkonstante Generatoransaugluft0 bei vfzg = 0" VALUE 0xFC9500 KwWU16 0.9999847 fak_uw_b1 0.00 0.9999847 FORMAT "%9.7" /end CHARACTERISTIC
/begin CHARACTERISTIC ZMGN0TANS1 "Zeitkonstante Generatoransaugluft1 bei vfzg = 0" VALUE 0xFC9502 KwWU16 0.9999847 fak_uw_b1 0.00 0.9999847 FORMAT "%9.7" /end CHARACTERISTIC
/begin CHARACTERISTIC ZMGN0TANS2 "Zeitkonstante Generatoransaugluft2 bei vfzg = 0" VALUE 0xFC9504 KwWU16 0.9999847 fak_uw_b1 0.00 0.9999847 FORMAT "%9.7" /end CHARACTERISTIC
/begin CHARACTERISTIC ZMGN0TANS3 "Zeitkonstante Generatoransaugluft3 bei vfzg = 0" VALUE 0xFC9506 KwWU16 0.9999847 fak_uw_b1 0.00 0.9999847 FORMAT "%9.7" /end CHARACTERISTIC
/begin CHARACTERISTIC ZMGN0TANS4 "Zeitkonstante Generatoransaugluft4 bei vfzg = 0" VALUE 0xFC9508 KwWU16 0.9999847 fak_uw_b1 0.00 0.9999847 FORMAT "%9.7" /end CHARACTERISTIC
/begin CHARACTERISTIC ZMGN0TANS5 "Zeitkonstante Generatoransaugluft5 bei vfzg = 0" VALUE 0xFC950A KwWU16 0.9999847 fak_uw_b1 0.00 0.9999847 FORMAT "%9.7" /end CHARACTERISTIC
/begin CHARACTERISTIC ZMGN0TANS6 "Zeitkonstante Generatoransaugluft6 bei vfzg = 0" VALUE 0xFC950C KwWU16 0.9999847 fak_uw_b1 0.00 0.9999847 FORMAT "%9.7" /end CHARACTERISTIC
/begin CHARACTERISTIC ZMGN0TANS7 "Zeitkonstante Generatoransaugluft7 bei vfzg = 0" VALUE 0xFC950E KwWU16 0.9999847 fak_uw_b1 0.00 0.9999847 FORMAT "%9.7" /end CHARACTERISTIC
/begin CHARACTERISTIC ZMGNTANS0 "Zeitkonstante Generatoransaugluft0" VALUE 0xFC9510 KwWU16 0.9999847 fak_uw_b1 0.00 0.9999847 FORMAT "%9.7" /end CHARACTERISTIC
/begin CHARACTERISTIC ZMGNTANS1 "Zeitkonstante Generatoransaugluft1" VALUE 0xFC9512 KwWU16 0.9999847 fak_uw_b1 0.00 0.9999847 FORMAT "%9.7" /end CHARACTERISTIC
/begin CHARACTERISTIC ZMGNTANS2 "Zeitkonstante Generatoransaugluft2" VALUE 0xFC9514 KwWU16 0.9999847 fak_uw_b1 0.00 0.9999847 FORMAT "%9.7" /end CHARACTERISTIC
/begin CHARACTERISTIC ZMGNTANS3 "Zeitkonstante Generatoransaugluft3" VALUE 0xFC9516 KwWU16 0.9999847 fak_uw_b1 0.00 0.9999847 FORMAT "%9.7" /end CHARACTERISTIC
/begin CHARACTERISTIC ZMGNTANS4 "Zeitkonstante Generatoransaugluft4" VALUE 0xFC9518 KwWU16 0.9999847 fak_uw_b1 0.00 0.9999847 FORMAT "%9.7" /end CHARACTERISTIC
/begin CHARACTERISTIC ZMGNTANS5 "Zeitkonstante Generatoransaugluft5" VALUE 0xFC951A KwWU16 0.9999847 fak_uw_b1 0.00 0.9999847 FORMAT "%9.7" /end CHARACTERISTIC
/begin CHARACTERISTIC ZMGNTANS6 "Zeitkonstante Generatoransaugluft6" VALUE 0xFC951C KwWU16 0.9999847 fak_uw_b1 0.00 0.9999847 FORMAT "%9.7" /end CHARACTERISTIC
/begin CHARACTERISTIC ZMGNTANS7 "Zeitkonstante Generatoransaugluft7" VALUE 0xFC951E KwWU16 0.9999847 fak_uw_b1 0.00 0.9999847 FORMAT "%9.7" /end CHARACTERISTIC
/begin CHARACTERISTIC ZMIGMISCH "" VALUE 0xFC9520 KwWU16 0.9999847 fak_uw_b1 0.00 0.9999847 FORMAT "%9.7" /end CHARACTERISTIC
/begin CHARACTERISTIC ZMTESTFIL "Zeitkonstante Testfilter" VALUE 0xFC9522 KwWU16 0.9999847 genzmst_uw_q0p152em7 0.00 0.9999847 FORMAT "%9.7" /end CHARACTERISTIC
/begin CHARACTERISTIC ZTPREL "Anzahl Z‰hne w‰hrend der Starterkennung" VALUE 0xFC643B KwWU8 252.0 dez 3.000 255.0 FORMAT "%5.1" /end CHARACTERISTIC
/begin MEASUREMENT azkrldy "aktueller Wert der KL AZKRLDYN" UBYTE dez 1 100 0 255 FORMAT "%5.1" ECU_ADDRESS 0x3FAF7C /end MEASUREMENT
/begin MEASUREMENT azkrndy "aktueller Wert der KL AZKRNDYN" UBYTE dez 1 100 0 255 FORMAT "%5.1" ECU_ADDRESS 0x3FAF7D /end MEASUREMENT
/begin MEASUREMENT bbhz_m "Maﬂnahmenaforderung Zuheizen" UBYTE DEZ 1 100 0 255 FORMAT "%5.1" ECU_ADDRESS 0x5B88C2 /end MEASUREMENT
/begin MEASUREMENT bbhz_sts "Status Zuheizmaﬂnahme (Klima, Heater)" UBYTE DEZ 1 100 0 2 FORMAT "%5.3" ECU_ADDRESS 0x5B88C3 /end MEASUREMENT
/begin MEASUREMENT bbhz_timer "Anlernzeit HKW" UBYTE t1sxs_ub_q1 1 100 0 255 FORMAT "%5.1" ECU_ADDRESS 0x5B88C4 /end MEASUREMENT
/begin MEASUREMENT bbhz_var "Variante\Status angelerntes externes Heizger‰t" UBYTE DEZ 1 100 0 255 FORMAT "%5.1" ECU_ADDRESS 0x3FDC7C /end MEASUREMENT
/begin MEASUREMENT bbhz_var_k "Komplement BBHZ_VAR (Sicherheitsablage)" UBYTE DEZ 1 100 0 255 FORMAT "%5.1" ECU_ADDRESS 0x3FDC7D /end MEASUREMENT
/begin MEASUREMENT bbhz_ver "Version Zuheizmaﬂnahme" UBYTE DEZ 1 100 0 255 FORMAT "%5.1" ECU_ADDRESS 0x5B88C5 /end MEASUREMENT
/begin MEASUREMENT bfzgl_b "Fahrzeugl‰ngsbeschleunigung" SBYTE bfzg_sb_q0p217 1 100 -27.776 27.559 FORMAT "%5.2" ECU_ADDRESS 0x5B8C8C /end MEASUREMENT
/begin MEASUREMENT B_acres "Bedingung f¸r Aufbau einer Drehmomentenreserve bei Klimabereitschaft" UBYTE B_TRUE 1 100 0 1 BIT_MASK 0x1 FORMAT "%13.11" ECU_ADDRESS 0x3FC00F /end MEASUREMENT
/begin MEASUREMENT B_anfw "Bedingung Anfangswert¸bernahme (TMOT-Modell)" UBYTE B_TRUE 1 100 0 1 BIT_MASK 0x1 FORMAT "%13.11" ECU_ADDRESS 0x3FBDC5 /end MEASUREMENT
/begin MEASUREMENT B_bm "Bedingung Bezugsmarke erkannt" UBYTE B_TRUE 1 100 0 1 BIT_MASK 0x1 FORMAT "%13.11" ECU_ADDRESS 0x5B8810 /end MEASUREMENT
/begin MEASUREMENT B_bwf "Bedingung: Bewegungserkennung hat Fehler erkannt" UWORD B_TRUE 1 100 0 1 BIT_MASK 0x1 FORMAT "%13.11" ECU_ADDRESS 0x5B91F6 /end MEASUREMENT
/begin MEASUREMENT B_bwunpl "Bedingung Unplausibilit‰t bei Bewegungserkennung" UWORD B_TRUE 1 100 0 1 BIT_MASK 0x2 FORMAT "%13.11" ECU_ADDRESS 0x5B91F6 /end MEASUREMENT
/begin MEASUREMENT B_checkpg "Freigabe zur ‹berpr¸fung der Nockenwellenflankenposition von PG" UBYTE B_TRUE 1 100 0 1 BIT_MASK 0x1 FORMAT "%13.11" ECU_ADDRESS 0x3FBE11 /end MEASUREMENT
/begin MEASUREMENT B_checkpg2 "Freigabe zur ‹berpr¸fung der Nockenwellenflankenposition von PG2" UBYTE B_TRUE 1 100 0 1 BIT_MASK 0x1 FORMAT "%13.11" ECU_ADDRESS 0x3FBE12 /end MEASUREMENT
/begin MEASUREMENT B_checkpg3 "Freigabe zur ‹berpr¸fung der Nockenwellenflankenposition von PG3" UBYTE B_TRUE 1 100 0 1 BIT_MASK 0x1 FORMAT "%13.11" ECU_ADDRESS 0x3FBE13 /end MEASUREMENT
/begin MEASUREMENT B_checkpg4 "Freigabe zur ‹berpr¸fung der Nockenwellenflankenposition von PG4" UBYTE B_TRUE 1 100 0 1 BIT_MASK 0x1 FORMAT "%13.11" ECU_ADDRESS 0x3FBE14 /end MEASUREMENT
/begin MEASUREMENT B_ctunp "Bedingung Fehler in CAN-Signal Umgebungstemperatur" UBYTE B_TRUE 1 100 0 1 BIT_MASK 0x1 FORMAT "%13.11" ECU_ADDRESS 0x3FBDCB /end MEASUREMENT
/begin MEASUREMENT B_drknv "handshake 10ms - KR.synchro" UBYTE B_TRUE 1 100 0 1 BIT_MASK 0x1 FORMAT "%13.11" ECU_ADDRESS 0x3FBE47 /end MEASUREMENT
/begin MEASUREMENT B_dupw "Bedingung Abweichung zwischen Poti 1 und 2 zu groﬂ" UWORD B_TRUE 1 100 0 1 BIT_MASK 0x4 FORMAT "%13.11" ECU_ADDRESS 0x5B91F6 /end MEASUREMENT
/begin MEASUREMENT B_dupw12 "Bedingung zul‰ssige Abweichung zwischen PWG-Poti 1 und 2 ¸berschritten" UWORD B_TRUE 1 100 0 1 BIT_MASK 0x8 FORMAT "%13.11" ECU_ADDRESS 0x5B91F6 /end MEASUREMENT
/begin MEASUREMENT B_etum "Bedingung Fehler in Umgebungstemperatur" UBYTE B_TRUE 1 100 0 1 BIT_MASK 0x1 FORMAT "%13.11" ECU_ADDRESS 0x3FBDCC /end MEASUREMENT
/begin MEASUREMENT B_fgdtm "Bedingung Freigabe Diagnose Tmot" UBYTE B_TRUE 1 100 0 1 BIT_MASK 0x1 FORMAT "%13.11" ECU_ADDRESS 0x3FBDC6 /end MEASUREMENT
/begin MEASUREMENT B_firstemp "Bedingung Generatorstarttemperatur-Berechnung" UBYTE B_TRUE 1 100 0 1 FORMAT "%13.11" ECU_ADDRESS 0x5B8CB6 /end MEASUREMENT
/begin MEASUREMENT B_gene "Bedingung f¸r Momentenanforderung Generator" UBYTE B_TRUE 1 100 0 1 FORMAT "%13.11" ECU_ADDRESS 0x5B8CB7 /end MEASUREMENT
/begin MEASUREMENT B_generken "Anfoderung der Generatorerkennung" UBYTE B_TRUE 1 100 0 1 FORMAT "%13.11" ECU_ADDRESS 0x5B8CB8 /end MEASUREMENT
/begin MEASUREMENT B_genfkupl "Bedingung Kommunikation unplausibel" UBYTE B_TRUE 1 100 0 1 FORMAT "%13.11" ECU_ADDRESS 0x5B8938 /end MEASUREMENT
/begin MEASUREMENT B_glf "Bedingung Gleichlauf zwischen Poti 1 und Poti 2 verletzt" UBYTE B_TRUE 1 100 0 1 BIT_MASK 0x1 FORMAT "%13.11" ECU_ADDRESS 0x3FBDBC /end MEASUREMENT
/begin MEASUREMENT B_heizen "Bedingung Generator in Heizphase" UBYTE B_TRUE 1 100 0 1 FORMAT "%13.11" ECU_ADDRESS 0x5B8CB9 /end MEASUREMENT
/begin MEASUREMENT B_hkwezhon "Bedingung Permitted Additional Load ein" UWORD B_TRUE 1 100 0 1 BIT_MASK 0x100 FORMAT "%13.11" ECU_ADDRESS 0x5B88B4 /end MEASUREMENT
/begin MEASUREMENT B_hkwlearn "Bedingung Anlernvorgang starten" UWORD B_TRUE 1 100 0 1 BIT_MASK 0x200 FORMAT "%13.11" ECU_ADDRESS 0x5B88B4 /end MEASUREMENT
/begin MEASUREMENT B_hkwnll "Bedingung Leerlaufanhebung durch HKW" UBYTE B_TRUE 1 100 0 1 BIT_MASK 0x2 FORMAT "%13.11" ECU_ADDRESS 0x5B88C7 /end MEASUREMENT
/begin MEASUREMENT B_hkwoff0 "Bedingung Wassertemperatur erreicht" UWORD B_TRUE 1 100 0 1 BIT_MASK 0x1 FORMAT "%13.11" ECU_ADDRESS 0x5B88B4 /end MEASUREMENT
/begin MEASUREMENT B_hkwoff1 "Bedingung Generator ausgelastet" UWORD B_TRUE 1 100 0 1 BIT_MASK 0x2 FORMAT "%13.11" ECU_ADDRESS 0x5B88B4 /end MEASUREMENT
/begin MEASUREMENT B_hkwoff2 "Bedingung Batteriespannung unterhalb oberer Hystereseschwelle" UWORD B_TRUE 1 100 0 1 BIT_MASK 0x4 FORMAT "%13.11" ECU_ADDRESS 0x5B88B4 /end MEASUREMENT
/begin MEASUREMENT B_hkwoff3 "Bedingung Drehzahl unterhalb oberer Hystereseschwelle" UWORD B_TRUE 1 100 0 1 BIT_MASK 0x8 FORMAT "%13.11" ECU_ADDRESS 0x5B88B4 /end MEASUREMENT
/begin MEASUREMENT B_hkwoff4 "Bedingung Startende nicht erreicht" UWORD B_TRUE 1 100 0 1 BIT_MASK 0x10 FORMAT "%13.11" ECU_ADDRESS 0x5B88B4 /end MEASUREMENT
/begin MEASUREMENT B_hkwoff5 "Bedingung Systemfehler (DFP_TUM, DFP_TM oder B_genfbsd) erkannt" UWORD B_TRUE 1 100 0 1 BIT_MASK 0x20 FORMAT "%13.11" ECU_ADDRESS 0x5B88B4 /end MEASUREMENT
/begin MEASUREMENT B_hkwoff6 "Bedingung keine Anforderung (B_azh, S_hz und B_hzl) gesetzt" UWORD B_TRUE 1 100 0 1 BIT_MASK 0x40 FORMAT "%13.11" ECU_ADDRESS 0x5B88B4 /end MEASUREMENT
/begin MEASUREMENT B_hkwoff7 "Bedingung Wassertemperatur n‰hert sich der Kennfeldk¸hlung" UWORD B_TRUE 1 100 0 1 BIT_MASK 0x80 FORMAT "%13.11" ECU_ADDRESS 0x5B88B4 /end MEASUREMENT
/begin MEASUREMENT B_hkwon "Bedingung Additional Heater EZH ein" UWORD B_TRUE 1 100 0 1 BIT_MASK 0x400 FORMAT "%13.11" ECU_ADDRESS 0x5B88B4 /end MEASUREMENT
/begin MEASUREMENT B_holp1 "Bedingung Hochohmigkeit im Leerlauf an PWG-Poti 1 erkannt" UWORD B_TRUE 1 100 0 1 BIT_MASK 0x10 FORMAT "%13.11" ECU_ADDRESS 0x5B91F6 /end MEASUREMENT
/begin MEASUREMENT B_holp1a "Bedingung Hochohmigkeit im Leerlauf an PWG-Poti 1 im aktuellen Fahrzyklus" UWORD B_TRUE 1 100 0 1 BIT_MASK 0x20 FORMAT "%13.11" ECU_ADDRESS 0x5B91F6 /end MEASUREMENT
/begin MEASUREMENT B_holp1l "Bedingung Hochohmigkeit im Leerlauf an PWG-Poti 1 im letzten Fahrzyklus" UBYTE B_TRUE 1 100 0 1 BIT_MASK 0x1 FORMAT "%13.11" ECU_ADDRESS 0x3FDC54 /end MEASUREMENT
/begin MEASUREMENT B_holp2 "Bedingung Hochohmigkeit im Leerlauf an PWG-Poti 2 erkannt" UWORD B_TRUE 1 100 0 1 BIT_MASK 0x40 FORMAT "%13.11" ECU_ADDRESS 0x5B91F6 /end MEASUREMENT
/begin MEASUREMENT B_holp2a "Bedingung Hochohmigkeit im Leerlauf an PWG-Poti 2 im aktuellen Fahrzyklus" UWORD B_TRUE 1 100 0 1 BIT_MASK 0x80 FORMAT "%13.11" ECU_ADDRESS 0x5B91F6 /end MEASUREMENT
/begin MEASUREMENT B_holp2l "Bedingung Hochohmigkeit im Leerlauf an PWG-Poti 2 im letzten Fahrzyklus" UBYTE B_TRUE 1 100 0 1 BIT_MASK 0x2 FORMAT "%13.11" ECU_ADDRESS 0x3FDC54 /end MEASUREMENT
/begin MEASUREMENT B_hop1mn "Bedingung Bereichsverletzung nach unten an Poti 1 in Hochohmigkeitspr¸fung" UWORD B_TRUE 1 100 0 1 BIT_MASK 0x100 FORMAT "%13.11" ECU_ADDRESS 0x5B91F6 /end MEASUREMENT
/begin MEASUREMENT B_hop2mn "Bedingung Bereichsverletzung nach unten an Poti 2 in Hochohmigkeitspr¸fung" UWORD B_TRUE 1 100 0 1 BIT_MASK 0x200 FORMAT "%13.11" ECU_ADDRESS 0x5B91F6 /end MEASUREMENT
/begin MEASUREMENT B_hopakt "Bedingung Hochohmigkeitspr¸fung aktiv" UWORD B_TRUE 1 100 0 1 BIT_MASK 0x400 FORMAT "%13.11" ECU_ADDRESS 0x5B91F6 /end MEASUREMENT
/begin MEASUREMENT B_hrevab "Anforderung Ev-Abschaltung bei Hauptrelaisfehler" UBYTE B_TRUE 1 100 0 1 BIT_MASK 0x1 FORMAT "%13.11" ECU_ADDRESS 0x3FBDCD /end MEASUREMENT
/begin MEASUREMENT B_hsh "Bedingung Heizung Sonde hinter Kat einschaltbereit" UBYTE B_TRUE 1 100 0 1 BIT_MASK 0x1 FORMAT "%13.11" ECU_ADDRESS 0x3FBCF4 /end MEASUREMENT
/begin MEASUREMENT B_hsh2 "Bedingung Heizung Sonde 2 hinter Kat einschaltbereit" UBYTE B_TRUE 1 100 0 1 BIT_MASK 0x1 FORMAT "%13.11" ECU_ADDRESS 0x3FBCF5 /end MEASUREMENT
/begin MEASUREMENT B_hshe "Bedingung Endstufe Sondenheizung hinter Kat angesteuert" UBYTE B_TRUE 1 100 0 1 BIT_MASK 0x1 FORMAT "%13.11" ECU_ADDRESS 0x3FBCF6 /end MEASUREMENT
/begin MEASUREMENT B_hshe2 "Bedingung Endstufe Sondenheizung2 hinter Kat angesteuert" UBYTE B_TRUE 1 100 0 1 BIT_MASK 0x1 FORMAT "%13.11" ECU_ADDRESS 0x3FBCF7 /end MEASUREMENT
/begin MEASUREMENT B_hshmx "Bedingung maximale Leistung der Sondenheizung hinter Kat" UBYTE B_TRUE 1 100 0 1 BIT_MASK 0x1 FORMAT "%13.11" ECU_ADDRESS 0x3FBCF8 /end MEASUREMENT
/begin MEASUREMENT B_hshmx2 "Bedingung maximale Leistung der Sondenheizung 2  hinter Kat" UBYTE B_TRUE 1 100 0 1 BIT_MASK 0x1 FORMAT "%13.11" ECU_ADDRESS 0x3FBCF9 /end MEASUREMENT
/begin MEASUREMENT B_hsv "Bedingung Heizung Sonde vor Kat einschaltbereit" UBYTE B_TRUE 1 100 0 1 BIT_MASK 0x1 FORMAT "%13.11" ECU_ADDRESS 0x3FBCFA /end MEASUREMENT
/begin MEASUREMENT B_hsv2 "Bedingung Heizung Sonde2 vor Kat einschaltbereit" UBYTE B_TRUE 1 100 0 1 BIT_MASK 0x1 FORMAT "%13.11" ECU_ADDRESS 0x3FBCFB /end MEASUREMENT
/begin MEASUREMENT B_hsve "Bedingung Endstufe Sondenheizung vor Kat angesteuert" UBYTE B_TRUE 1 100 0 1 BIT_MASK 0x1 FORMAT "%13.11" ECU_ADDRESS 0x3FBCFC /end MEASUREMENT
/begin MEASUREMENT B_hsve2 "Bedingung Endstufe Sondenheizung2 vor Kat angesteuert" UBYTE B_TRUE 1 100 0 1 BIT_MASK 0x1 FORMAT "%13.11" ECU_ADDRESS 0x3FBCFD /end MEASUREMENT
/begin MEASUREMENT B_hsvmx "Bedingung maximale Leistung der Sondenheizung vor Kat" UBYTE B_TRUE 1 100 0 1 BIT_MASK 0x1 FORMAT "%13.11" ECU_ADDRESS 0x3FBCFE /end MEASUREMENT
/begin MEASUREMENT B_hsvmx2 "Bedingung maximale Leistung der Sondenheizung 2 vor Kat" UBYTE B_TRUE 1 100 0 1 BIT_MASK 0x1 FORMAT "%13.11" ECU_ADDRESS 0x3FBCFF /end MEASUREMENT
/begin MEASUREMENT B_hz "Bedingung Zuheizmaﬂnahme ein (Klima, Heater)" UBYTE B_TRUE 1 100 0 1 BIT_MASK 0x1 FORMAT "%13.11" ECU_ADDRESS 0x5B88C7 /end MEASUREMENT
/begin MEASUREMENT B_kalt "K¸hlanforderung von geregeltem Kennfeldthermostat" UBYTE B_TRUE 1 100 0 1 BIT_MASK 0x1 FORMAT "%13.11" ECU_ADDRESS 0x3FC009 /end MEASUREMENT
/begin MEASUREMENT B_kldynrm "Bedingung normales Klopfen bei adapt. Lastdynamik" UBYTE B_TRUE 1 100 0 1 BIT_MASK 0x1 FORMAT "%13.11" ECU_ADDRESS 0x3FBE48 /end MEASUREMENT
/begin MEASUREMENT B_kldystk "Bedingung starkes Klopfen bei adapt. Lastdynamik" UBYTE B_TRUE 1 100 0 1 BIT_MASK 0x1 FORMAT "%13.11" ECU_ADDRESS 0x3FBE49 /end MEASUREMENT
/begin MEASUREMENT B_koe "Bedingung f¸r Kompressoreinschalten" UBYTE B_TRUE 1 100 0 1 BIT_MASK 0x1 FORMAT "%13.11" ECU_ADDRESS 0x3FC010 /end MEASUREMENT
/begin MEASUREMENT B_koena "Bedingung Kompressor freigegeben" UBYTE B_TRUE 1 100 0 1 BIT_MASK 0x1 FORMAT "%13.11" ECU_ADDRESS 0x3FC011 /end MEASUREMENT
/begin MEASUREMENT B_komnoff "Bedingung Kompresszor-Mindestabschaltzeit abgelaufen" UBYTE B_TRUE 1 100 0 1 BIT_MASK 0x1 FORMAT "%13.11" ECU_ADDRESS 0x3FC012 /end MEASUREMENT
/begin MEASUREMENT B_komnon "Bedingung Kompresszor-Mindesteinschaltzeit abgelaufen" UBYTE B_TRUE 1 100 0 1 BIT_MASK 0x1 FORMAT "%13.11" ECU_ADDRESS 0x3FC013 /end MEASUREMENT
/begin MEASUREMENT B_komxoff "Bedingung Kompresszor-Hˆchstabschaltzeit abgelaufen" UBYTE B_TRUE 1 100 0 1 BIT_MASK 0x1 FORMAT "%13.11" ECU_ADDRESS 0x3FC014 /end MEASUREMENT
/begin MEASUREMENT B_kooff "Bedingung f¸r hartes Kompressorabschalten" UBYTE B_TRUE 1 100 0 1 BIT_MASK 0x1 FORMAT "%13.11" ECU_ADDRESS 0x3FC015 /end MEASUREMENT
/begin MEASUREMENT B_kosta "Bedingung f¸r Einfrieren des aktuellen Kompressorzustandes" UBYTE B_TRUE 1 100 0 1 BIT_MASK 0x1 FORMAT "%13.11" ECU_ADDRESS 0x3FC016 /end MEASUREMENT
/begin MEASUREMENT B_krldy "Bedingung Lastdynamik f¸r Klopferkennung aktiv" UBYTE B_TRUE 1 100 0 1 BIT_MASK 0x1 FORMAT "%13.11" ECU_ADDRESS 0x3FBE4A /end MEASUREMENT
/begin MEASUREMENT B_krldya "Bedingung Lastdynamikvorhalt und -adaption aktiv" UBYTE B_TRUE 1 100 0 1 BIT_MASK 0x1 FORMAT "%13.11" ECU_ADDRESS 0x3FBE4B /end MEASUREMENT
/begin MEASUREMENT B_krldyf "Bedingung Adaption Lastdynamikvorhalt nach fr¸h freigegeben" UBYTE B_TRUE 1 100 0 1 BIT_MASK 0x1 FORMAT "%13.11" ECU_ADDRESS 0x3FBE4C /end MEASUREMENT
/begin MEASUREMENT B_krldyofok "" UBYTE B_TRUE 1 100 0 1 BIT_MASK 0x1 FORMAT "%13.11" ECU_ADDRESS 0x3FBE4D /end MEASUREMENT
/begin MEASUREMENT B_krldyok "" UBYTE B_TRUE 1 100 0 1 BIT_MASK 0x1 FORMAT "%13.11" ECU_ADDRESS 0x3FBE4E /end MEASUREMENT
/begin MEASUREMENT B_krndy "Bedingung Drehzahldynamik f¸r Klopferkennung aktiv" UBYTE B_TRUE 1 100 0 1 BIT_MASK 0x1 FORMAT "%13.11" ECU_ADDRESS 0x3FBE4F /end MEASUREMENT
/begin MEASUREMENT B_krsadyn "Bedingung Adaptions-Delay nach SA" UBYTE B_TRUE 1 100 0 1 BIT_MASK 0x1 FORMAT "%13.11" ECU_ADDRESS 0x3FBE50 /end MEASUREMENT
/begin MEASUREMENT B_mbvh "Bedingung Miﬂbrauchsverhinderung" UBYTE B_TRUE 1 100 0 1 BIT_MASK 0x1 FORMAT "%13.11" ECU_ADDRESS 0x3FBDBD /end MEASUREMENT
/begin MEASUREMENT B_mxmntm "Bedingung min-oder max-Fehler Motortemperaturf¸hler vorhanden" UBYTE B_TRUE 1 100 0 1 BIT_MASK 0x1 FORMAT "%13.11" ECU_ADDRESS 0x3FBDC7 /end MEASUREMENT
/begin MEASUREMENT B_nac "Bedingung f¸r erhˆhte LL-Drehzahl bei Klimaanlage" UBYTE B_TRUE 1 100 0 1 BIT_MASK 0x1 FORMAT "%13.11" ECU_ADDRESS 0x3FC017 /end MEASUREMENT
/begin MEASUREMENT B_nokatfz "Bedingung Nicht-KAT Fahrzeug" UBYTE B_TRUE 1 100 0 1 BIT_MASK 0x1 FORMAT "%13.11" ECU_ADDRESS 0x3FBE3C /end MEASUREMENT
/begin MEASUREMENT B_oeltemp "Bedingung f¸r CAN-Ausgabe der ÷ltemperatur" UBYTE B_TRUE 1 100 0 1 FORMAT "%13.11" ECU_ADDRESS 0x5B87E0 /end MEASUREMENT
/begin MEASUREMENT B_oelverb "Bedingung Oelverbrauch" UBYTE B_TRUE 1 100 0 1 FORMAT "%13.11" ECU_ADDRESS 0x5B87E1 /end MEASUREMENT
/begin MEASUREMENT B_oelverl "Bedingung Oelverlust" UBYTE B_TRUE 1 100 0 1 FORMAT "%13.11" ECU_ADDRESS 0x5B87E2 /end MEASUREMENT
/begin MEASUREMENT B_pg1limsw "Bereichs¸berschreitung bei Grenzen f¸r Nockenwellenflanke von PG" UBYTE B_TRUE 1 100 0 1 BIT_MASK 0x1 FORMAT "%13.11" ECU_ADDRESS 0x3FBE15 /end MEASUREMENT
/begin MEASUREMENT B_pg2limsw "Bereichs¸berschreitung bei Grenzen f¸r Nockenwellenflanke von PG2" UBYTE B_TRUE 1 100 0 1 BIT_MASK 0x1 FORMAT "%13.11" ECU_ADDRESS 0x3FBE16 /end MEASUREMENT
/begin MEASUREMENT B_pwgbwf "Bedingung PWG-Bewegungsfehler" UBYTE B_TRUE 1 100 0 1 BIT_MASK 0x80 FORMAT "%13.11" ECU_ADDRESS 0x5B8EC2 /end MEASUREMENT
/begin MEASUREMENT B_pwgnotfr "FR-Fehlerreaktion PWG-Notfahren" UBYTE B_TRUE 1 100 0 1 BIT_MASK 0x1 FORMAT "%13.11" ECU_ADDRESS 0x3FBDBE /end MEASUREMENT
/begin MEASUREMENT B_rehs "Restart Sondenheizung" UBYTE B_TRUE 1 100 0 1 BIT_MASK 0x1 FORMAT "%13.11" ECU_ADDRESS 0x3FBD00 /end MEASUREMENT
/begin MEASUREMENT B_sp1s "Mitteilung an SR: SP1S ist F¸hrungsgrˆﬂe." UBYTE B_TRUE 1 100 0 1 BIT_MASK 0x1 FORMAT "%13.11" ECU_ADDRESS 0x3FBDBF /end MEASUREMENT
/begin MEASUREMENT B_sp2s "Mitteilung an SR:Poti2 SP2S F¸hrungsgrˆﬂe,Poti1 Ober-oder Untergrenze ¸berschr." UBYTE B_TRUE 1 100 0 1 BIT_MASK 0x1 FORMAT "%13.11" ECU_ADDRESS 0x3FBDC0 /end MEASUREMENT
/begin MEASUREMENT B_spsmin "Mitteilung an SR: '1'= PWG-Notfahren mit SPSMIN" UBYTE B_TRUE 1 100 0 1 BIT_MASK 0x1 FORMAT "%13.11" ECU_ADDRESS 0x3FBDC1 /end MEASUREMENT
/begin MEASUREMENT B_stprel "Bedingung Entprellung von Drehzahlgebersignal gestartet" UBYTE B_TRUE 1 100 0 1 BIT_MASK 0x2 FORMAT "%13.11" ECU_ADDRESS 0x5B8810 /end MEASUREMENT
/begin MEASUREMENT B_tkwberg "" UBYTE B_TRUE 1 100 0 1 BIT_MASK 0x1 FORMAT "%13.11" ECU_ADDRESS 0x3FC00A /end MEASUREMENT
/begin MEASUREMENT B_tkwkr "" UBYTE B_TRUE 1 100 0 1 BIT_MASK 0x1 FORMAT "%13.11" ECU_ADDRESS 0x3FC00B /end MEASUREMENT
/begin MEASUREMENT B_tkwlast "" UBYTE B_TRUE 1 100 0 1 BIT_MASK 0x1 FORMAT "%13.11" ECU_ADDRESS 0x3FC00C /end MEASUREMENT
/begin MEASUREMENT B_tkwtans "" UBYTE B_TRUE 1 100 0 1 BIT_MASK 0x1 FORMAT "%13.11" ECU_ADDRESS 0x3FC00D /end MEASUREMENT
/begin MEASUREMENT B_tkwwarml "" UBYTE B_TRUE 1 100 0 1 BIT_MASK 0x1 FORMAT "%13.11" ECU_ADDRESS 0x3FC00E /end MEASUREMENT
/begin MEASUREMENT B_tmdmme "Bedingung Endtemperatur von Motortemperaturmodell erreicht" UBYTE B_TRUE 1 100 0 1 BIT_MASK 0x1 FORMAT "%13.11" ECU_ADDRESS 0x3FBDC8 /end MEASUREMENT
/begin MEASUREMENT B_tmmn "Bedingung: Blockheater erkannt" UBYTE B_TRUE 1 100 0 1 BIT_MASK 0x1 FORMAT "%13.11" ECU_ADDRESS 0x3FBDC9 /end MEASUREMENT
/begin MEASUREMENT B_tmsrt "Bedingung Retriggerung Motortemperaturmodell nach Start" UBYTE B_TRUE 1 100 0 1 BIT_MASK 0x1 FORMAT "%13.11" ECU_ADDRESS 0x3FBDCA /end MEASUREMENT
/begin MEASUREMENT B_tprel "Bedingung Zeitentprellung abgeschlossen" UBYTE B_TRUE 1 100 0 1 BIT_MASK 0x4 FORMAT "%13.11" ECU_ADDRESS 0x5B8810 /end MEASUREMENT
/begin MEASUREMENT B_ubrdmn1 "Bedingung Bordnetzspannung ¸ber Hauptrelais kleiner UBRDMN1" UBYTE B_TRUE 1 100 0 1 BIT_MASK 0x1 FORMAT "%13.11" ECU_ADDRESS 0x3FBDCE /end MEASUREMENT
/begin MEASUREMENT B_ubrdmn2 "Bedingung Bordnetzspannung ¸ber Hauptrelais grˆﬂer UBRDMN2" UBYTE B_TRUE 1 100 0 1 BIT_MASK 0x1 FORMAT "%13.11" ECU_ADDRESS 0x3FBDCF /end MEASUREMENT
/begin MEASUREMENT B_ubrk "Bedingung Hauptrelais Kontaktfehler" UBYTE B_TRUE 1 100 0 1 BIT_MASK 0x1 FORMAT "%13.11" ECU_ADDRESS 0x3FBDD0 /end MEASUREMENT
/begin MEASUREMENT B_ubrmax "Bedingung Bordnetzspannung ¸ber Hauptrelais hˆher als UBRDMX" UBYTE B_TRUE 1 100 0 1 BIT_MASK 0x1 FORMAT "%13.11" ECU_ADDRESS 0x3FBDD1 /end MEASUREMENT
/begin MEASUREMENT B_upw12e "Bedingung: Fehler bei Vergleich der beiden normierten PWG-Poti-Spannungen" UBYTE B_TRUE 1 100 0 1 BIT_MASK 0x4 FORMAT "%13.11" ECU_ADDRESS 0x5B8EC2 /end MEASUREMENT
/begin MEASUREMENT B_upw1mn "Bedingung: Spannung PWG-Poti 1 unterhalb Minimalwert" UBYTE B_TRUE 1 100 0 1 BIT_MASK 0x8 FORMAT "%13.11" ECU_ADDRESS 0x5B8EC2 /end MEASUREMENT
/begin MEASUREMENT B_upw1mx "Bedingung: Spannung PWG-Poti 1 oberhalb Maximalwert" UBYTE B_TRUE 1 100 0 1 BIT_MASK 0x10 FORMAT "%13.11" ECU_ADDRESS 0x5B8EC2 /end MEASUREMENT
/begin MEASUREMENT B_upw2mn "Bedingung: Spannung PWG-Poti 2 unterhalb Minimalwert" UBYTE B_TRUE 1 100 0 1 BIT_MASK 0x20 FORMAT "%13.11" ECU_ADDRESS 0x5B8EC2 /end MEASUREMENT
/begin MEASUREMENT B_upw2mx "Bedingung: Spannung PWG-Poti 2 oberhalb Maximalwert" UBYTE B_TRUE 1 100 0 1 BIT_MASK 0x40 FORMAT "%13.11" ECU_ADDRESS 0x5B8EC2 /end MEASUREMENT
/begin MEASUREMENT B_upwbwf "Bewegungserkennung hat im aktuellen Fahrzyklus einen Fehler erkannt" UBYTE B_TRUE 1 100 0 1 BIT_MASK 0x1 FORMAT "%13.11" ECU_ADDRESS 0x3FBDC2 /end MEASUREMENT
/begin MEASUREMENT B_upwg1o "Bedingung Bereichsverletzung an PWG-Poti 1 nach oben" UWORD B_TRUE 1 100 0 1 BIT_MASK 0x800 FORMAT "%13.11" ECU_ADDRESS 0x5B91F6 /end MEASUREMENT
/begin MEASUREMENT B_upwg1u "Bedingung Bereichsverletzung an PWG-Poti 1 nach unten" UWORD B_TRUE 1 100 0 1 BIT_MASK 0x1000 FORMAT "%13.11" ECU_ADDRESS 0x5B91F6 /end MEASUREMENT
/begin MEASUREMENT B_upwg2o "Bedingung Bereichsverletzung an PWG-Poti 2 nach oben" UBYTE B_TRUE 1 100 0 1 BIT_MASK 0x1 FORMAT "%13.11" ECU_ADDRESS 0x5B8EC2 /end MEASUREMENT
/begin MEASUREMENT B_upwg2u "Bedingung Bereichsverletzung an PWG-Poti 2 nach unten" UBYTE B_TRUE 1 100 0 1 BIT_MASK 0x2 FORMAT "%13.11" ECU_ADDRESS 0x5B8EC2 /end MEASUREMENT
/begin MEASUREMENT B_vnull "Bedingung Fahrzeug steht" UBYTE B_TRUE 1 100 0 1 BIT_MASK 0x1 FORMAT "%13.11" ECU_ADDRESS 0x3FBE2F /end MEASUREMENT
/begin MEASUREMENT B_wpabnb "Bedingung ƒnderungsbegrenzung des Pedalwerts nach Bremsbet‰tigung" UBYTE B_TRUE 1 100 0 1 BIT_MASK 0x1 FORMAT "%13.11" ECU_ADDRESS 0x3FBDC3 /end MEASUREMENT
/begin MEASUREMENT B_wpmbbr "Bedingung Maximalbegrenzung des Pedalwerts bei Bremsbet‰tigung" UBYTE B_TRUE 1 100 0 1 BIT_MASK 0x1 FORMAT "%13.11" ECU_ADDRESS 0x3FBDC4 /end MEASUREMENT
/begin MEASUREMENT B_zprel "Bedingung Zahnentprellung erfolgt" UBYTE B_TRUE 1 100 0 1 BIT_MASK 0x8 FORMAT "%13.11" ECU_ADDRESS 0x5B8810 /end MEASUREMENT
/begin MEASUREMENT B_zsynchro "Bedingung f¸r einmaliges Auslˆsen eines virtuellen Zwangssynchros im Start" UBYTE B_TRUE 1 100 0 1 BIT_MASK 0x10 FORMAT "%13.11" ECU_ADDRESS 0x5B8810 /end MEASUREMENT
/begin MEASUREMENT camstate "Array mit Status des Nockenwelle-Treibers f¸r jede NW" UBYTE dez 1 100 0 255 FORMAT "%5.1" ARRAY_SIZE 4 ECU_ADDRESS 0x5B8C5C /end MEASUREMENT
/begin MEASUREMENT crankstate "Status des Kurbelwellentreibers" UBYTE dez 1 100 0 255 FORMAT "%5.1" ECU_ADDRESS 0x5B8C62 /end MEASUREMENT
/begin MEASUREMENT ctrbwf "Fehlerz‰hler Bewegungserkennung" UBYTE dez 1 100 0 255 FORMAT "%5.1" ECU_ADDRESS 0x5B8EC0 /end MEASUREMENT
/begin MEASUREMENT dib_ig "" SWORD igen_ub_q1 1 100 -255 255 FORMAT "%8.4" ECU_ADDRESS 0x5B893A /end MEASUREMENT
/begin MEASUREMENT dmrdsls_w "Momentenreserve f¸r Diagnose Sekund‰rluft" UWORD rel_uw_b100 1 100 0 99.9985 FORMAT "%8.5" ECU_ADDRESS 0x5B883A /end MEASUREMENT
/begin MEASUREMENT dmrkh "Momenten-Reserve f¸r Katheizen" UBYTE rel_ub_b99p6 1 100 0 99.6094 FORMAT "%5.2" ECU_ADDRESS 0x5B8836 /end MEASUREMENT
/begin MEASUREMENT dmrkhz_w "Momentenreserve f¸r Katheizen" UWORD rel_uw_b100 1 100 0 99.9985 FORMAT "%8.5" ECU_ADDRESS 0x5B883C /end MEASUREMENT
/begin MEASUREMENT dmrkh_w "Momentenreserve f¸r Katheizen" UWORD rel_uw_b100 1 100 0 99.9985 FORMAT "%8.5" ECU_ADDRESS 0x5B883E /end MEASUREMENT
/begin MEASUREMENT dpskrmx_w "max. Wert dpsfg_w  oder dpsmp_w" SWORD p_sw_q0p039 1 100 -1280 1279.96 FORMAT "%8.3" ECU_ADDRESS 0x5B9732 /end MEASUREMENT
/begin MEASUREMENT drkwtmp_w "Momentenreserve f¸r Kat warmhalten, zeitweise" UWORD rel_uw_b100 1 100 0 99.9985 FORMAT "%8.5" ECU_ADDRESS 0x5B8840 /end MEASUREMENT
/begin MEASUREMENT dwped "Gradient des normierten Fahrpedalwinkels" SBYTE rel_sb_q0p39 1 100 -49.9968 49.6062 FORMAT "%5.2" ECU_ADDRESS 0x5B8EC1 /end MEASUREMENT
/begin MEASUREMENT dwped_w "Gradient des normierten Fahrpedalwinkels" SWORD rel_sw_b50 1 100 -50 49.9985 FORMAT "%8.5" ECU_ADDRESS 0x5B91F4 /end MEASUREMENT
/begin MEASUREMENT dyesehof_w "aktueller Wert Offset f¸r Lastdynamikerkennungsschwelle" SWORD hub_uw_q0p001 1 100 -32.768 32.767 FORMAT "%8.5" ECU_ADDRESS 0x5B92A2 /end MEASUREMENT
/begin MEASUREMENT dyesehv_w "aktueller Wert Lastdynamikerkennungsschwelle" SWORD hub_uw_q0p001 1 100 -32.768 32.767 FORMAT "%8.5" ECU_ADDRESS 0x5B92A4 /end MEASUREMENT
/begin MEASUREMENT dyespfof_w "aktueller Wert Offset f¸r Lastdynamikerkennungsschwelle" SWORD p_sw_q0p039 1 100 -1280 1279.96 FORMAT "%8.3" ECU_ADDRESS 0x5B9734 /end MEASUREMENT
/begin MEASUREMENT dyespfv_w "aktueller Wert Lastdynamikerkennungsschwelle" SWORD p_sw_q0p039 1 100 -1280 1279.96 FORMAT "%8.3" ECU_ADDRESS 0x5B9736 /end MEASUREMENT
/begin MEASUREMENT ehz_pw "Heizleistungsanforderung an EZH" UBYTE rel_ub_b100 1 100 0 99.6078 FORMAT "%5.2" ECU_ADDRESS 0x5B88C6 /end MEASUREMENT
/begin MEASUREMENT esst_snm08koub "" ULONG dez 1 100 0 4.29497e+009 FORMAT "%13.2" ECU_ADDRESS 0x5B9B70 /end MEASUREMENT
/begin MEASUREMENT fdib_ig "" SWORD igen_ub_q1 1 100 -255 255 FORMAT "%8.4" ECU_ADDRESS 0x5B893C /end MEASUREMENT
/begin MEASUREMENT fkbkvab "Faktor Reduzierung Reservemoment f¸r Bremskraftverst‰rker" UBYTE fak_ub_b1 1 100 0 0.996094 ECU_ADDRESS 0x5B8837 /end MEASUREMENT
/begin MEASUREMENT fktmsch "Korrekturfaktor f¸r Steigung Modelltemperatur bei Schichtbetrieb" UBYTE fak_ub_b2 1 100 0 1.99219 FORMAT "%5.3" ECU_ADDRESS 0x5B87BA /end MEASUREMENT
/begin MEASUREMENT fmkhfho_w "Hˆhenkorrektur der Drehmomentenreserve bei Katheizen" UWORD fak_uw_b2 1 100 0 1.99997 FORMAT "%8.6" ECU_ADDRESS 0x5B8842 /end MEASUREMENT
/begin MEASUREMENT fmkhtmst "tmst-Korrektur der Drehmomentreserve bei Katheizen" UBYTE fak_ub_b2 1 100 0 1.99219 FORMAT "%5.3" ECU_ADDRESS 0x5B8838 /end MEASUREMENT
/begin MEASUREMENT fvst_w "Faktor Vorsteuerung" UWORD fak_uw_b64 1 100 0 63.999 FORMAT "%8.5" ECU_ADDRESS 0x5B91D0 /end MEASUREMENT
/begin MEASUREMENT genalfak2 "Winderstands-Alpha-Faktor" UWORD genalfak_uw_q0p610Em7 1 100 0 2.99994 FORMAT "%8.6" ECU_ADDRESS 0x5B893E /end MEASUREMENT
/begin MEASUREMENT genawnumm "Generatorkennfeldnummer" UBYTE DEZ 1 100 0 255 FORMAT "%5.1" ECU_ADDRESS 0x3FDC94 /end MEASUREMENT
/begin MEASUREMENT gendi_spv "mittlerer quadratischer Diodenstrom" ULONG genpv_ul 1 100 0 510 FORMAT "%13.9" ECU_ADDRESS 0x5B8974 /end MEASUREMENT
/begin MEASUREMENT gendts "Temperaturerhoehung im Generatorstator" UWORD gendt_q0p075 1 100 0 768 FORMAT "%8.4" ECU_ADDRESS 0x5B8940 /end MEASUREMENT
/begin MEASUREMENT gendtsvor "Temp-Variable" UWORD gendt_q0p075 1 100 0 768 FORMAT "%8.4" ECU_ADDRESS 0x5B8942 /end MEASUREMENT
/begin MEASUREMENT gendts_s1 "Temperaturerhˆhung einer Statorspule und Diodenpaar" UWORD gendt_q0p075 1 100 0 192 FORMAT "%8.4" ECU_ADDRESS 0x5B8944 /end MEASUREMENT
/begin MEASUREMENT genfeta "Generatorwirkungsgrad Berechnnugsterm" ULONG geneta_q0p03125 1 100 0.03125 8191.88 FORMAT "%13.8" ECU_ADDRESS 0x5B8978 /end MEASUREMENT
/begin MEASUREMENT geni2_st "mittlerer quadratischer Statorstrom" UWORD dez 1 100 0 65535 FORMAT "%8.2" ECU_ADDRESS 0x5B8946 /end MEASUREMENT
/begin MEASUREMENT genig "Generatorstrom gesamt" UBYTE igen_ub_q1 1 100 0 255 FORMAT "%5.1" ECU_ADDRESS 0x5B8988 /end MEASUREMENT
/begin MEASUREMENT genikaltun "DF korrektiert ueber Generatordrehzahl" UBYTE igen_ub_q1 1 100 0 255 FORMAT "%5.1" ECU_ADDRESS 0x5B8989 /end MEASUREMENT
/begin MEASUREMENT geninafil "Generatorstrom nach Filter" UWORD igen_uw_q0p03125 1 100 0 256 FORMAT "%8.4" ECU_ADDRESS 0x5B8948 /end MEASUREMENT
/begin MEASUREMENT genitemp "korrigiertes DF Signal ueber Temperatur, Generatordrehzahl, Generatorspannung" UBYTE igen_ub_q1 1 100 0 255 FORMAT "%5.1" ECU_ADDRESS 0x5B898A /end MEASUREMENT
/begin MEASUREMENT genivorfil "Generatorstrom vor Filter" UWORD igen_uw_q0p03125 1 100 0 256 FORMAT "%8.4" ECU_ADDRESS 0x5B894A /end MEASUREMENT
/begin MEASUREMENT geni_difk "mittlerer Diodenstrom" UWORD igen_uw_q0p03125 1 100 0 255 FORMAT "%8.4" ECU_ADDRESS 0x5B894C /end MEASUREMENT
/begin MEASUREMENT geni_end "Generatorstrom gemessen / gerechnet" UBYTE igen_ub_q1 1 100 0 254 FORMAT "%5.1" ECU_ADDRESS 0x5B898B /end MEASUREMENT
/begin MEASUREMENT geni_stfk "mittlerer Statorstrom" UWORD igen_uw_q0p03125 1 100 0 255 FORMAT "%8.4" ECU_ADDRESS 0x5B894E /end MEASUREMENT
/begin MEASUREMENT gennummer "erkannte Generatornummer" UBYTE DEZ 1 100 0 255 FORMAT "%5.1" ECU_ADDRESS 0x5B898C /end MEASUREMENT
/begin MEASUREMENT genrs "Statorwiderstand" UWORD genrstator 1 100 0 0.999985 FORMAT "%9.7" ECU_ADDRESS 0x5B8950 /end MEASUREMENT
/begin MEASUREMENT genspv "Generatorstatorverlustleistung" UWORD genpv_uw_q0p03125 1 100 0 2047.97 FORMAT "%8.3" ECU_ADDRESS 0x5B8952 /end MEASUREMENT
/begin MEASUREMENT genspv_1 "Verlustleistung einer Statorspule" ULONG genpv_ul 1 100 0 0.164978 FORMAT "%13.6" ECU_ADDRESS 0x5B897C /end MEASUREMENT
/begin MEASUREMENT genspv_2 "Verlustleistung eines Diodenpaars" ULONG genpv_ul 1 100 0 0.164978 FORMAT "%13.6" ECU_ADDRESS 0x5B8980 /end MEASUREMENT
/begin MEASUREMENT gensttemp "Generatorstarttemperatur" UWORD temp_uw_q0p75_o48 1 100 -48 336 FORMAT "%8.4" ECU_ADDRESS 0x5B8954 /end MEASUREMENT
/begin MEASUREMENT gentans "Generatoransauglufttemperatur" UWORD temp_uw_q0p75_o48 1 100 -48 336 FORMAT "%8.4" ECU_ADDRESS 0x5B8956 /end MEASUREMENT
/begin MEASUREMENT gentansend "Generatoransaugluftendwert" UWORD temp_ub_q0p75_o48 1 100 -48 143.25 FORMAT "%8.4" ECU_ADDRESS 0x5B8958 /end MEASUREMENT
/begin MEASUREMENT gentemp "Generatortemperatur" UWORD temp_uw_q0p75_o48 1 100 -48 336 FORMAT "%8.4" ECU_ADDRESS 0x5B895A /end MEASUREMENT
/begin MEASUREMENT gentempab "Abstelltemperatur Generator" UWORD temp_uw_q0p75_o48 1 100 -48 336 FORMAT "%8.4" ECU_ADDRESS 0x3FDC96 /end MEASUREMENT
/begin MEASUREMENT gentempdt "Temperaturdifferenz zwischen Abstelltemperatur und Umgebungstemperatur" SWORD temp_sw_q0p75 1 100 -48 384 FORMAT "%8.4" ECU_ADDRESS 0x5B895C /end MEASUREMENT
/begin MEASUREMENT gentempend "Generatortemperatur endg¸ltig" UWORD temp_uw_q0p75_o48 1 100 -48 336 FORMAT "%8.4" ECU_ADDRESS 0x5B895E /end MEASUREMENT
/begin MEASUREMENT gentempexp "Delta Abk¸hltemperatur" SWORD temp_sw_q0p75 1 100 -48 384 FORMAT "%8.4" ECU_ADDRESS 0x5B8960 /end MEASUREMENT
/begin MEASUREMENT gentempfil "gefilterte Generatortemperatur" UWORD gendt_q0p075 1 100 0 768 FORMAT "%8.4" ECU_ADDRESS 0x5B9752 /end MEASUREMENT
/begin MEASUREMENT gen_teta "Wirkungsgrad Generator W*PI temperaturkompensiert" UWORD geneta_q0p03125 1 100 0 32 FORMAT "%8.5" ECU_ADDRESS 0x5B8962 /end MEASUREMENT
/begin MEASUREMENT gen_weta "Wirkungsgrad Generator mit Omega*PI" UBYTE geneta_q0p03125 1 100 0 7.96875 FORMAT "%5.3" ECU_ADDRESS 0x5B898D /end MEASUREMENT
/begin MEASUREMENT GGPEDlokbits "" UWORD dez 1 100 0 65535 FORMAT "%8.2" ECU_ADDRESS 0x5B91F6 /end MEASUREMENT
/begin MEASUREMENT GGPEDlokbits2 "" UBYTE dez 1 100 0 255 FORMAT "%5.1" ECU_ADDRESS 0x5B8EC2 /end MEASUREMENT
/begin MEASUREMENT GGPEDnonVolbits "" UBYTE dez 1 100 0 255 FORMAT "%5.1" ECU_ADDRESS 0x3FDC54 /end MEASUREMENT
/begin MEASUREMENT HKWBits1_1000ms "" UWORD dez 1 100 0 65535 FORMAT "%8.2" ECU_ADDRESS 0x5B88B4 /end MEASUREMENT
/begin MEASUREMENT HKWBits2_1000ms "" UBYTE dez 1 100 0 255 FORMAT "%5.1" ECU_ADDRESS 0x5B88C7 /end MEASUREMENT
/begin MEASUREMENT hkw_iant "I-Anteil" SWORD rel_ub_b100 1 100 -100 100 FORMAT "%8.4" ECU_ADDRESS 0x5B88B6 /end MEASUREMENT
/begin MEASUREMENT hkw_ki "I-Verst‰rkung" UWORD fak_uw_q0p001 1 100 0 10 FORMAT "%8.5" ECU_ADDRESS 0x5B88B8 /end MEASUREMENT
/begin MEASUREMENT hkw_kp "P-Verst‰rkung" UWORD fak_uw_q0p001 1 100 0 10 FORMAT "%8.5" ECU_ADDRESS 0x5B88BA /end MEASUREMENT
/begin MEASUREMENT hkw_lpgv "gefilterte Generatorlast" UBYTE rel_ub_b100 1 100 0 100 FORMAT "%5.1" ECU_ADDRESS 0x5B88C8 /end MEASUREMENT
/begin MEASUREMENT hkw_lpsv "gefilterte Generatorlast Sollgrˆﬂe" UBYTE rel_ub_b100 1 100 0 100 FORMAT "%5.1" ECU_ADDRESS 0x5B88C9 /end MEASUREMENT
/begin MEASUREMENT hkw_pant "P-Anteil" SWORD rel_ub_b100 1 100 -1000 1000 FORMAT "%8.3" ECU_ADDRESS 0x5B88BC /end MEASUREMENT
/begin MEASUREMENT hkw_pi "PI-Anteil" SWORD rel_ub_b100 1 100 -2000 2000 FORMAT "%8.3" ECU_ADDRESS 0x5B88BE /end MEASUREMENT
/begin MEASUREMENT hkw_rdiff "Regeldifferenz" SWORD rel_ub_b100 1 100 -100 100 FORMAT "%8.4" ECU_ADDRESS 0x5B88C0 /end MEASUREMENT
/begin MEASUREMENT hkw_sel_i "I-Verst‰rkungsauswahl" UBYTE DEZ 1 100 0 10 FORMAT "%5.2" ECU_ADDRESS 0x5B88CA /end MEASUREMENT
/begin MEASUREMENT hkw_sel_p "P-Verst‰rkungsauswahl" UBYTE DEZ 1 100 0 10 FORMAT "%5.2" ECU_ADDRESS 0x5B88CB /end MEASUREMENT
/begin MEASUREMENT hkw_sv "Sollgrˆﬂe Generatorlast" UBYTE rel_ub_b100 1 100 0 100 FORMAT "%5.1" ECU_ADDRESS 0x5B88CC /end MEASUREMENT
/begin MEASUREMENT hkw_t "Umgebungstemperatur-Eingangsgrˆﬂe f¸r KLHKWT" UBYTE temp_ub_q0p75_o48 1 100 -48 143.25 FORMAT "%5.1" ECU_ADDRESS 0x5B88CD /end MEASUREMENT
/begin MEASUREMENT hkw_to "oberer Hystereseschwellwert f¸r tsolletr - HKW_WTOFF" UBYTE temp_ub_q0p75_o48 1 100 -48 143.25 FORMAT "%5.1" ECU_ADDRESS 0x5B88CE /end MEASUREMENT
/begin MEASUREMENT hkw_ttmp "festgehaltene Umgebungstemperatur bei B_hkwon gesetzt" UBYTE temp_ub_q0p75_o48 1 100 -48 143.25 FORMAT "%5.1" ECU_ADDRESS 0x5B88CF /end MEASUREMENT
/begin MEASUREMENT ibasis "" UBYTE igen_ub_q1 1 100 0 255 FORMAT "%5.1" ECU_ADDRESS 0x5B898E /end MEASUREMENT
/begin MEASUREMENT igen400A "gemmessener Generatorstrom 400A-Bereich" UWORD fak_uw_b512 1 100 0 511.992 FORMAT "%8.4" ECU_ADDRESS 0x5B8964 /end MEASUREMENT
/begin MEASUREMENT igm "" UBYTE igen_ub_q1 1 100 0 255 FORMAT "%5.1" ECU_ADDRESS 0x5B898F /end MEASUREMENT
/begin MEASUREMENT igvor "" UBYTE igen_ub_q1 1 100 0 255 FORMAT "%5.1" ECU_ADDRESS 0x5B8990 /end MEASUREMENT
/begin MEASUREMENT integberg "" UWORD fak_uw_b256 1 100 0 255.996 FORMAT "%7.3" ECU_ADDRESS 0x5B94BE /end MEASUREMENT
/begin MEASUREMENT integkr "" UWORD fak_uw_b256 1 100 0 255.996 FORMAT "%7.3" ECU_ADDRESS 0x5B94C0 /end MEASUREMENT
/begin MEASUREMENT integlast "" UWORD fak_uw_b256 1 100 0 255.996 FORMAT "%7.3" ECU_ADDRESS 0x5B94C2 /end MEASUREMENT
/begin MEASUREMENT integtans "" UWORD fak_uw_b256 1 100 0 255.996 FORMAT "%7.3" ECU_ADDRESS 0x5B94C4 /end MEASUREMENT
/begin MEASUREMENT manftmew "Monitor Anfangswert TMEW-Bildung" UBYTE temp_ub_q0p75_o48 1 100 -48 143.25 FORMAT "%5.1" ECU_ADDRESS 0x5B87BB /end MEASUREMENT
/begin MEASUREMENT mdgenloc_w "" UWORD rel_uw_b100 1 100 0 99.9985 FORMAT "%8.5" ECU_ADDRESS 0x5B8966 /end MEASUREMENT
/begin MEASUREMENT mdgenrel_w "" UWORD rel_uw_b100 1 100 0 99.9985 FORMAT "%8.5" ECU_ADDRESS 0x5B8968 /end MEASUREMENT
/begin MEASUREMENT mdgenvf_w "" UWORD rel_uw_b100 1 100 0 99.9985 FORMAT "%8.5" ECU_ADDRESS 0x5B896A /end MEASUREMENT
/begin MEASUREMENT MDNORMTMP "tempor‰re MDNORM" UBYTE md_ub_q16 1 100 16 1008 FORMAT "%5.0" ECU_ADDRESS 0x5B8CBA /end MEASUREMENT
/begin MEASUREMENT md_gennm "Generatormoment absolut" UWORD md_ub_q0p025 1 100 0 128 FORMAT "%8.4" ECU_ADDRESS 0x5B896C /end MEASUREMENT
/begin MEASUREMENT mifakh_w "indiziertes Motormoment f¸r Katheizen" UWORD rel_uw_b100 1 100 0 99.9985 FORMAT "%8.5" ECU_ADDRESS 0x5B8844 /end MEASUREMENT
/begin MEASUREMENT mll1 "Luftmassenfluﬂ bezogen auf lambda=1" UBYTE m_ub_b1020 1 100 0 1020 FORMAT "%5.0" ECU_ADDRESS 0x3FC029 /end MEASUREMENT
/begin MEASUREMENT msttmew "Monitor Steigung TMEW-Bildung" SBYTE temp_sb_b0p093 1 100 -0.09375 0.0930176 FORMAT "%7.5" ECU_ADDRESS 0x5B87BC /end MEASUREMENT
/begin MEASUREMENT msttmrw "Monitor Steigung TMRW-Bildung" SBYTE temp_sb_b0p093 1 100 -0.09375 0.0930176 FORMAT "%7.5" ECU_ADDRESS 0x5B87BD /end MEASUREMENT
/begin MEASUREMENT ngen_w "Generatordrehzahl (= UEFNMNG * nmot)" UWORD ngen_uw_q0p5 1 100 0 32767.5 FORMAT "%8.2" ECU_ADDRESS 0x5B9754 /end MEASUREMENT
/begin MEASUREMENT ngkrv_w "aktueller Wert Drehzahldynamikschwelle" SWORD nmotg_sw_q0p39 1 100 -12800.2 12799.8 FORMAT "%8.2" ECU_ADDRESS 0x5B92A6 /end MEASUREMENT
/begin MEASUREMENT nmotf "Motordrehzahl gefiltert" UBYTE nmot_ub_q40 1 100 0 10200 FORMAT "%5.0" ECU_ADDRESS 0x5B87E3 /end MEASUREMENT
/begin MEASUREMENT nmotfm "Mittelwert gefilterte Motordrehzahl" UBYTE nmot_ub_q40 1 100 0 10200 FORMAT "%5.0" ECU_ADDRESS 0x5B87E4 /end MEASUREMENT
/begin MEASUREMENT nmotfsum "Summe: gefilterte Motordrehzahlen fuer Paketbildung" UWORD nmot_ub_q40 1 100 0 2.6214e+006 FORMAT "%8.0" ECU_ADDRESS 0x5B87CC /end MEASUREMENT
/begin MEASUREMENT nmots "Motordrehzahl U/s" UBYTE nwu_q1 1 100 0 255 FORMAT "%5.1" ECU_ADDRESS 0x5B8991 /end MEASUREMENT
/begin MEASUREMENT nngkrv_w "aktueller Wert Drehzahldynamikschwelle" SWORD nmotg_sw_q0p39 1 100 -12800.2 12799.8 FORMAT "%8.2" ECU_ADDRESS 0x5B92A8 /end MEASUREMENT
/begin MEASUREMENT nokatfz_flg "" UBYTE dez 1 100 0 255 FORMAT "%5.1" ECU_ADDRESS 0x3FDC66 /end MEASUREMENT
/begin MEASUREMENT Oelnivak "Aktuelles Oelniveau korrigiert" UBYTE tog_ub_q0p5 1 100 0 127.5 FORMAT "%5.1" ECU_ADDRESS 0x5B87E5 /end MEASUREMENT
/begin MEASUREMENT Oelnivaknk "Aktuelles Oelniveau nicht korigiert" UBYTE tog_ub_q0p5 1 100 0 127.5 FORMAT "%5.1" ECU_ADDRESS 0x5B87E6 /end MEASUREMENT
/begin MEASUREMENT Oelnivkurz "Oelniveau Kurzzeitmessung" UBYTE tog_ub_q0p5 1 100 0 127.5 FORMAT "%5.1" ECU_ADDRESS 0x5B87E7 /end MEASUREMENT
/begin MEASUREMENT Oelnivm "" UBYTE tog_ub_q0p5 1 100 0 127.5 FORMAT "%5.1" ECU_ADDRESS 0x5B87E8 /end MEASUREMENT
/begin MEASUREMENT Oelnivnksm "Summe Oelniveau nicht Korrigiert fuer Paketbildung" UWORD tog_ub_q0p5 1 100 0 32767.5 FORMAT "%8.2" ECU_ADDRESS 0x5B87CE /end MEASUREMENT
/begin MEASUREMENT Oelnivnorm "Oelniveau Normalbetrieb" UBYTE tog_ub_q0p5 1 100 0 127.5 FORMAT "%5.1" ECU_ADDRESS 0x5B87E9 /end MEASUREMENT
/begin MEASUREMENT Oelnivori "Oelniveau Orientierungsmessung" UBYTE tog_ub_q0p5 1 100 0 127.5 FORMAT "%5.1" ECU_ADDRESS 0x5B87EA /end MEASUREMENT
/begin MEASUREMENT Oelnivsum "Summe Oelniveaus Orientierungsmessung" ULONG tog_ub_q0p5 1 100 0 2.14748e+009 FORMAT "%13.2" ECU_ADDRESS 0x5B87D8 /end MEASUREMENT
/begin MEASUREMENT Oelnivsumw "Summe Oelniveaus Normalbetrieb" ULONG tog_ub_q0p5 1 100 0 2.14748e+009 FORMAT "%13.2" ECU_ADDRESS 0x5B87DC /end MEASUREMENT
/begin MEASUREMENT Oriverzz "Verzoegerungszaehler Orientierungsmessung" UBYTE dez 1 100 0 255 FORMAT "%5.1" ECU_ADDRESS 0x5B87EB /end MEASUREMENT
/begin MEASUREMENT pg1limfr_w "Maximale Fr¸hposition der Nockenwellenflanke 0 von PG" UWORD kw_q0p1 1 100 0 6553.5 FORMAT "%8.3" ECU_ADDRESS 0x5B96A4 /end MEASUREMENT
/begin MEASUREMENT pg1limsp_w "Maximale Sp‰tposition der Nockenwellenflanke 0 von PG" UWORD kw_q0p1 1 100 0 6553.5 FORMAT "%8.3" ECU_ADDRESS 0x5B96A6 /end MEASUREMENT
/begin MEASUREMENT pg2limfr_w "Maximale Fr¸hposition der Nockenwellenflanke 0 von PG2" UWORD kw_q0p1 1 100 0 6553.5 FORMAT "%8.3" ECU_ADDRESS 0x5B96A8 /end MEASUREMENT
/begin MEASUREMENT pg2limsp_w "Maximale Sp‰tposition der Nockenwellenflanke 0 von PG2" UWORD kw_q0p1 1 100 0 6553.5 FORMAT "%8.3" ECU_ADDRESS 0x5B96AA /end MEASUREMENT
/begin MEASUREMENT pgenab "elektrische Generatorleistung" ULONG genpv_uw_q0p03125 1 100 0 4096 FORMAT "%13.8" ECU_ADDRESS 0x5B8984 /end MEASUREMENT
/begin MEASUREMENT phlsnh "normierte Heizleistung der Lambdasonde hinter Kat" UBYTE fak_ub_q0p01 1 100 0 2.55 FORMAT "%5.3" ECU_ADDRESS 0x5B868B /end MEASUREMENT
/begin MEASUREMENT phlsnh2 "normierte Heizleistung der Lambdasonde 2 hinter Kat" UBYTE fak_ub_q0p01 1 100 0 2.55 FORMAT "%5.3" ECU_ADDRESS 0x5B868C /end MEASUREMENT
/begin MEASUREMENT phlsnv "normierte Heizleistung der Lambdasonde vor Kat" UBYTE fak_ub_q0p01 1 100 0 2.55 FORMAT "%5.3" ECU_ADDRESS 0x5B868D /end MEASUREMENT
/begin MEASUREMENT phlsnv2 "normierte Heizleistung der Lambdasonde 2 vor Kat" UBYTE fak_ub_q0p01 1 100 0 2.55 FORMAT "%5.3" ECU_ADDRESS 0x5B868E /end MEASUREMENT
/begin MEASUREMENT qstartinf "Infomartionsbyte f¸r aktivierte Schnellstartmethoden" UBYTE dez 1 100 0 255 FORMAT "%5.1" ECU_ADDRESS 0x5B8C63 /end MEASUREMENT
/begin MEASUREMENT rk2_w "relative Kraftstoffmasse Bank2" UWORD rel_uw_b3072 1 100 0 3071.95 FORMAT "%8.3" ECU_ADDRESS 0x5B91D2 /end MEASUREMENT
/begin MEASUREMENT rkkva2_w "relative Kraftstoffmasse (f¸r Kraftstoff-Verbrauchs-Anzeige Bank 2)" UWORD rel_uw_b3072 1 100 0 3071.95 FORMAT "%8.3" ECU_ADDRESS 0x5B91D4 /end MEASUREMENT
/begin MEASUREMENT rkkva_w "relative Kraftstoffmasse (f¸r Kraftstoff-Verbrauchs-Anzeige Bank 1)" UWORD rel_uw_b3072 1 100 0 3071.95 FORMAT "%8.3" ECU_ADDRESS 0x5B91D6 /end MEASUREMENT
/begin MEASUREMENT rk_w "relative Kraftstoffmasse" UWORD rel_uw_b3072 1 100 0 3071.95 FORMAT "%8.3" ECU_ADDRESS 0x5B91D8 /end MEASUREMENT
/begin MEASUREMENT st_i_gen "Generatorstrom" UBYTE igen_ub_q1 1 100 0 255 FORMAT "%5.1" ECU_ADDRESS 0x5B8992 /end MEASUREMENT
/begin MEASUREMENT sync_level "Meldung Synchronisations-Level des HWT" UBYTE dez 1 100 0 255 FORMAT "%5.1" ECU_ADDRESS 0x5B8C64 /end MEASUREMENT
/begin MEASUREMENT SYN_st "" UBYTE dez 1 100 0 255 FORMAT "%5.1" ECU_ADDRESS 0x5B8810 /end MEASUREMENT
/begin MEASUREMENT tans "Ansaugluft - Temperatur" UBYTE temp_ub_q0p75_o48 1 100 -48 143.25 FORMAT "%5.1" ECU_ADDRESS 0x5B8EC4 /end MEASUREMENT
/begin MEASUREMENT tansab "Ansauglufttemperatur beim Abstellen" UBYTE temp_ub_q0p75_o48 1 100 -48 143.25 FORMAT "%5.1" ECU_ADDRESS 0x3FDC58 /end MEASUREMENT
/begin MEASUREMENT tansabk_w "Ansauglufttemperatur beim Abstellen intern in Kelvin" UWORD temp_q0p0234_o273 1 100 -273.15 1262.83 FORMAT "%8.3" ECU_ADDRESS 0x3FDC5A /end MEASUREMENT
/begin MEASUREMENT tansk_w "Ansaugluft - Temperatur in GrdC,  intern in Kelvin gerechnet" UWORD temp_q0p0234_o273 1 100 -273.15 1262.83 FORMAT "%8.3" ECU_ADDRESS 0x5B9206 /end MEASUREMENT
/begin MEASUREMENT tanslin "Ansauglufttemperatur, linearisiert und umgerechnet" UBYTE temp_ub_q0p75_o48 1 100 -48 143.25 FORMAT "%5.1" ECU_ADDRESS 0x5B87B8 /end MEASUREMENT
/begin MEASUREMENT tdlrtm_w "Diagnosezeit f¸r ‹berschreitung Motortemperaturschwelle f¸r Lambda-Regelung" UWORD t100msxs_uw_b6553p5 1 100 0 6553.5 FORMAT "%8.3" ECU_ADDRESS 0x5B87C6 /end MEASUREMENT
/begin MEASUREMENT thhaist "Auszeit f¸r Sondenheizung hinter Kat" UBYTE t10msxs_ub_b2p55 1 100 0 2.55 FORMAT "%5.3" ECU_ADDRESS 0x5B868F /end MEASUREMENT
/begin MEASUREMENT thhaist2 "Auszeit f¸r Sondenheizung2 hinter Kat" UBYTE t10msxs_ub_b2p55 1 100 0 2.55 FORMAT "%5.3" ECU_ADDRESS 0x5B8690 /end MEASUREMENT
/begin MEASUREMENT thhat "unkorrigierte Ausschaltzeit der Sondenheizung hinter Kat" UBYTE t10msxs_q0p01_o0p05 1 100 -0.05 2.5 FORMAT "%5.3" ECU_ADDRESS 0x5B8691 /end MEASUREMENT
/begin MEASUREMENT thhat2 "unkorrigierte Ausschaltzeit der Sondenheizung 2 hinter Kat" UBYTE t10msxs_q0p01_o0p05 1 100 -0.05 2.5 FORMAT "%5.3" ECU_ADDRESS 0x5B8692 /end MEASUREMENT
/begin MEASUREMENT thvaist "Auszeit f¸r Sondenheizung vor Kat" UBYTE t10msxs_ub_b2p55 1 100 0 2.55 FORMAT "%5.3" ECU_ADDRESS 0x5B8693 /end MEASUREMENT
/begin MEASUREMENT thvaist2 "Auszeit f¸r Sondenheizung2 vor Kat" UBYTE t10msxs_ub_b2p55 1 100 0 2.55 FORMAT "%5.3" ECU_ADDRESS 0x5B8694 /end MEASUREMENT
/begin MEASUREMENT thvat "unkorrigierte Ausschaltzeit der Sondenheizung vor Kat" UBYTE t10msxs_q0p01_o0p05 1 100 -0.05 2.5 FORMAT "%5.3" ECU_ADDRESS 0x5B8695 /end MEASUREMENT
/begin MEASUREMENT thvat2 "unkorrigierte Ausschaltzeit der Sondenheizung 2 vor Kat" UBYTE t10msxs_q0p01_o0p05 1 100 -0.05 2.5 FORMAT "%5.3" ECU_ADDRESS 0x5B8696 /end MEASUREMENT
/begin MEASUREMENT tka "Temperatur Motork¸hlerausgang (K¸hlmittel)" UBYTE temp_ub_q0p75_o48 1 100 -48 143.25 FORMAT "%5.1" ECU_ADDRESS 0x5B8EC6 /end MEASUREMENT
/begin MEASUREMENT tkalin "Temperatur K¸hlerausgang linearisiert und umgerechnet" UBYTE temp_ub_q0p75_o48 1 100 -48 143.25 FORMAT "%5.1" ECU_ADDRESS 0x5B8EC7 /end MEASUREMENT
/begin MEASUREMENT tkwdiff "" SWORD temp_ub_q0p75_o48 1 100 -24624 24527.3 FORMAT "%8.2" ECU_ADDRESS 0x5B94C6 /end MEASUREMENT
/begin MEASUREMENT tkwi "" SWORD fak_q0p1 1 100 -3276.8 3276.7 FORMAT "%8.3" ECU_ADDRESS 0x5B94C8 /end MEASUREMENT
/begin MEASUREMENT tkwp "" SWORD fak_q0p1 1 100 -3276.8 3276.7 FORMAT "%8.3" ECU_ADDRESS 0x5B94CA /end MEASUREMENT
/begin MEASUREMENT tkwpi "" SWORD fak_q0p1 1 100 -3276.8 3276.7 FORMAT "%8.3" ECU_ADDRESS 0x5B94CC /end MEASUREMENT
/begin MEASUREMENT tkwpwm "Tastverh‰ltnis Kennfeldthermostat" SWORD fak_q0p1 1 100 -3276.8 3276.7 FORMAT "%8.3" ECU_ADDRESS 0x5B94CE /end MEASUREMENT
/begin MEASUREMENT tkws "Solltemperatur von geregeltem Kennfeldthermostat" UBYTE temp_ub_q0p75_o48 1 100 -48 143.25 FORMAT "%5.1" ECU_ADDRESS 0x5B903A /end MEASUREMENT
/begin MEASUREMENT tkwv "" SWORD fak_q0p1 1 100 -3276.8 3276.7 FORMAT "%8.3" ECU_ADDRESS 0x5B94D0 /end MEASUREMENT
/begin MEASUREMENT tmew "Motortemperatur-Ersatzwert aus Modell" UBYTE temp_ub_q0p75_o48 1 100 -48 143.25 FORMAT "%5.1" ECU_ADDRESS 0x5B87BE /end MEASUREMENT
/begin MEASUREMENT tmewab "Motortemperatur-Ersatzwert aus Modell beim Abstellen" UBYTE temp_ub_q0p75_o48 1 100 -48 143.25 FORMAT "%5.1" ECU_ADDRESS 0x3FDC5C /end MEASUREMENT
/begin MEASUREMENT tmot "Motor-Temperatur" UBYTE temp_ub_q0p75_o48 1 100 -48 143.25 FORMAT "%5.1" ECU_ADDRESS 0x5B8EC5 /end MEASUREMENT
/begin MEASUREMENT tmotab "Motortemperatur beim Abstellen" UBYTE temp_ub_q0p75_o48 1 100 -48 143.25 FORMAT "%5.1" ECU_ADDRESS 0x3FDC5D /end MEASUREMENT
/begin MEASUREMENT tmotlin "Motortemperatur, linearisiert und umgerechnet" UBYTE temp_ub_q0p75_o48 1 100 -48 143.25 FORMAT "%5.1" ECU_ADDRESS 0x5B87BF /end MEASUREMENT
/begin MEASUREMENT tmotlin_w "Motortemperatur, linearisiert und umgerechnet, 16Bit-Wort" UWORD temp_uw_q0p0029_o48 1 100 -48 143.997 FORMAT "%8.4" ECU_ADDRESS 0x5B87C8 /end MEASUREMENT
/begin MEASUREMENT tmotvt "Motortemperatur vor Tiefpaﬂfilter" UBYTE temp_ub_q0p75_o48 1 100 -48 143.25 FORMAT "%5.1" ECU_ADDRESS 0x5B87C0 /end MEASUREMENT
/begin MEASUREMENT tmrw "Motortemperatur-Referenzwert aus Modell" UBYTE temp_ub_q0p75_o48 1 100 -48 143.25 FORMAT "%5.1" ECU_ADDRESS 0x5B87C1 /end MEASUREMENT
/begin MEASUREMENT tmrwend "Endwert f¸r Referenzwert Motortemperatur-Modell" UBYTE temp_ub_q0p75_o48 1 100 -48 143.25 FORMAT "%5.1" ECU_ADDRESS 0x5B87C2 /end MEASUREMENT
/begin MEASUREMENT tmst "Motorstarttemperatur" UBYTE temp_ub_q0p75_o48 1 100 -48 143.25 FORMAT "%5.1" ECU_ADDRESS 0x5B87C3 /end MEASUREMENT
/begin MEASUREMENT tnwia_l "Zeit eines Systemtimers bei Eintreffen einer genutzten Ph.-flanke (Auslaﬂ)" ULONG t_q1p024_ms 1 100 0 4.39805e+009 FORMAT "%13.2" ECU_ADDRESS 0x5B9A3C /end MEASUREMENT
/begin MEASUREMENT tnwie_l "Zeit eines Systemtimers bei Eintreffen einer genutzten Phasenflanke" ULONG t_q1p024_ms 1 100 0 4.39805e+009 FORMAT "%13.2" ECU_ADDRESS 0x5B9A40 /end MEASUREMENT
/begin MEASUREMENT Toel_t "Oeltemperaturzeit korrigiert" UWORD t_q0p1ms 1 100 0 6553.5 FORMAT "%8.3" ECU_ADDRESS 0x5B87D0 /end MEASUREMENT
/begin MEASUREMENT toel_w "Oeltemperatur nach Filter" UWORD temp_uw_q0p75_o48 1 100 -48 200.25 FORMAT "%8.4" ECU_ADDRESS 0x5B87D2 /end MEASUREMENT
/begin MEASUREMENT togbw_i "Messwertezaehler Oelniveau Betriebswarm" UWORD dez 1 100 0 255 FORMAT "%8.4" ECU_ADDRESS 0x5B87D4 /end MEASUREMENT
/begin MEASUREMENT togk_i "Messwertezaehler Orientierungsmessung" UBYTE dez 1 100 0 255 FORMAT "%5.1" ECU_ADDRESS 0x5B87EC /end MEASUREMENT
/begin MEASUREMENT tog_i "Messwertezaehler Paketbildung" UBYTE dez 1 100 0 255 FORMAT "%5.1" ECU_ADDRESS 0x5B87ED /end MEASUREMENT
/begin MEASUREMENT tog_k "Messertezaehler Kurzzeitmessung" UBYTE B_TRUE 1 100 0 1 FORMAT "%13.11" ECU_ADDRESS 0x5B87EE /end MEASUREMENT
/begin MEASUREMENT tol "Motor-÷L-Temperatur" UBYTE temp_ub_q0p75_o48 1 100 -48 143.25 FORMAT "%5.1" ECU_ADDRESS 0x5B87EF /end MEASUREMENT
/begin MEASUREMENT tseg_l "Winkel-Segmentzeit" ULONG t_q0p0001_ms 1 100 0 429497 FORMAT "%13.6" ECU_ADDRESS 0x5B9A54 /end MEASUREMENT
/begin MEASUREMENT tsg "Steuerger‰tetemperatur" UBYTE temp_ub_q0p75_o48 1 100 -48 143.25 FORMAT "%5.1" ECU_ADDRESS 0x5B87CB /end MEASUREMENT
/begin MEASUREMENT tstcountv "Testcounter-Wert" UWORD t1sxs_ub_q1 1 100 0 65535 FORMAT "%8.2" ECU_ADDRESS 0x5B896E /end MEASUREMENT
/begin MEASUREMENT tstfil_out "Testfilter Ausgang" UWORD gendt_q0p075 1 100 0 768 FORMAT "%8.4" ECU_ADDRESS 0x5B8970 /end MEASUREMENT
/begin MEASUREMENT tstlocini "Temp-Variable" UBYTE B_TRUE 1 100 0 1 FORMAT "%13.11" ECU_ADDRESS 0x5B8CBB /end MEASUREMENT
/begin MEASUREMENT tum "Umgebungstemperatur" UBYTE temp_ub_q0p75_o48 1 100 -48 143.25 FORMAT "%5.1" ECU_ADDRESS 0x5B87C4 /end MEASUREMENT
/begin MEASUREMENT tumg "Umgebungstemperatur" UBYTE temp_ub_q0p75_o48 1 100 -48 143.25 FORMAT "%5.1" ECU_ADDRESS 0x5B87CA /end MEASUREMENT
/begin MEASUREMENT tumgta "Umgebungstemperatur aus Ansauglufttemperatur" UBYTE temp_ub_q0p75_o48 1 100 -48 143.25 FORMAT "%5.1" ECU_ADDRESS 0x3FDC5E /end MEASUREMENT
/begin MEASUREMENT ub "Batteriespannung" UBYTE spg_ubatt 1 100 0 24.021 FORMAT "%5.2" ECU_ADDRESS 0x5B8EC8 /end MEASUREMENT
/begin MEASUREMENT ubrsq "Bordnetzspannung ¸ber Hauptrelais, Standard-Quantisierung" UBYTE spg_q0p1 1 100 0 25.5 FORMAT "%5.2" ECU_ADDRESS 0x5B8ECB /end MEASUREMENT
/begin MEASUREMENT ubrsqf "" UBYTE spg_q0p1 1 100 0 25.5 FORMAT "%5.2" ECU_ADDRESS 0x5B8ECC /end MEASUREMENT
/begin MEASUREMENT ubrsqf_w "" UWORD spg_q0p00039 1 100 0 25.5996 FORMAT "%8.5" ECU_ADDRESS 0x5B920E /end MEASUREMENT
/begin MEASUREMENT ubrsq_w "Bordnetzspannung ¸ber Hauptrelais (word), Standard-Quantisierung" UWORD spg_q0p00039 1 100 0 25.5996 FORMAT "%8.5" ECU_ADDRESS 0x5B9210 /end MEASUREMENT
/begin MEASUREMENT ubsq "Bordnetzspannung, umgerechnet in Standard-Quantisierung" UBYTE spg_q0p1 1 100 0 25.5 FORMAT "%5.2" ECU_ADDRESS 0x5B8EC9 /end MEASUREMENT
/begin MEASUREMENT ubsqf "Bordnetzspannung, umgerechnet in Standard-Quantisierung und gefiltert" UBYTE spg_q0p1 1 100 0 25.5 FORMAT "%5.2" ECU_ADDRESS 0x5B8ECA /end MEASUREMENT
/begin MEASUREMENT ubsqf_w "Bordnetzspannung, umgerechnet in Standard-Quantisierung und gefiltert" UWORD spg_q0p00039 1 100 0 25.5996 FORMAT "%8.5" ECU_ADDRESS 0x5B9208 /end MEASUREMENT
/begin MEASUREMENT ubsq_w "Bordnetzspannung, umgerechnet in Standard-Quantisierung" UWORD spg_q0p00039 1 100 0 25.5996 FORMAT "%8.5" ECU_ADDRESS 0x5B920A /end MEASUREMENT
/begin MEASUREMENT ub_w "Batteriespannung" UWORD spg_ubatt 1 100 0 6173.4 FORMAT "%8.3" ECU_ADDRESS 0x5B920C /end MEASUREMENT
/begin MEASUREMENT ugen_tmp "" UWORD spg_ugen 1 100 10.6 16 FORMAT "%8.5" ECU_ADDRESS 0x5B8972 /end MEASUREMENT
/begin MEASUREMENT upw2ll_w "Spannungswert von PWG-Poti 2 vor der Bewegung" UWORD spg_uw_q0p00488 1 100 0 319.995 FORMAT "%8.4" ECU_ADDRESS 0x3FDC56 /end MEASUREMENT
/begin MEASUREMENT upwg2d_w "Verdoppelte PWG-Poti-2-Spannung (Word)" UWORD spg_uw_q0p00488 1 100 0 319.995 FORMAT "%8.4" ECU_ADDRESS 0x5B91F8 /end MEASUREMENT
/begin MEASUREMENT upwg2fil_w "Gefilterte Poti 2 Spannung" UWORD spg_uw_q0p00488 1 100 0 319.995 FORMAT "%8.4" ECU_ADDRESS 0x5B91FA /end MEASUREMENT
/begin MEASUREMENT upwgej_w "Entjitterte PWG-Poti-Spannung" UWORD spg_uw_q0p00488 1 100 0 319.995 FORMAT "%8.4" ECU_ADDRESS 0x5B91FC /end MEASUREMENT
/begin MEASUREMENT upwg_w "Resultierende PWG-Poti-Spannung nach Plausibilit‰tspr¸fung" UWORD spg_uw_q0p00488 1 100 0 319.995 FORMAT "%8.4" ECU_ADDRESS 0x5B91FE /end MEASUREMENT
/begin MEASUREMENT vfil_w "gefilterte Geschwindigkeit (16-Bit)" UWORD vfzg_uw_b512 1 100 0 511.992 FORMAT "%8.4" ECU_ADDRESS 0x5B9722 /end MEASUREMENT
/begin MEASUREMENT vfzg "Fahrzeuggeschwindigkeit" UBYTE vfzg_ub_q1p25 1 100 0 318.75 FORMAT "%5.1" ECU_ADDRESS 0x5B8C8D /end MEASUREMENT
/begin MEASUREMENT vfzg_w "Fahrzeuggeschwindigkeit" UWORD vfzg_uw_b512 1 100 0 511.992 FORMAT "%8.4" ECU_ADDRESS 0x5B9724 /end MEASUREMENT
/begin MEASUREMENT vfzroh_w "Fahrzeuggeschwindigkeit Ausgabewert an SCAN-Tool" UWORD vfzg_uw_b512 1 100 0 511.992 FORMAT "%8.4" ECU_ADDRESS 0x5B9726 /end MEASUREMENT
/begin MEASUREMENT wkrdy "Z¸ndwinkelsp‰tverstellung bei KR-Dynamik" UBYTE zw_ub_qn0p75 1 100 -191.25 0 FORMAT "%5.1" ECU_ADDRESS 0x3FC045 /end MEASUREMENT
/begin MEASUREMENT wkrdya "adaptierter Z¸ndwinkel bei KR-Dynamik" UBYTE zw_ub_qn0p75 1 100 -191.25 0 FORMAT "%5.1" ARRAY_SIZE 5 ECU_ADDRESS 0x3FDC68 /end MEASUREMENT
/begin MEASUREMENT wkrdyvs "vorgesteuerter Z¸ndwinkelsp‰tverstellung bei KR-Dynamik" UBYTE zw_ub_qn0p75 1 100 -191.25 0 FORMAT "%5.1" ECU_ADDRESS 0x3FC046 /end MEASUREMENT
/begin MEASUREMENT wkwalest_w "Startwinkel aus Motor-Abstellposition berechnet" UWORD kw_q0p1 1 100 0 6553.5 FORMAT "%8.3" ECU_ADDRESS 0x5B96B8 /end MEASUREMENT
/begin MEASUREMENT wkwas_w "Winkel Kurbelwelle im Arbeitsspiel" UWORD kw_q0p1 1 100 0 6553.5 FORMAT "%8.3" ECU_ADDRESS 0x5B96BA /end MEASUREMENT
/begin MEASUREMENT wnwkwa_w "Winkel der Auslaﬂ-NW-Flanken relativ zur Kurbelwelle" UWORD kw_q0p1 1 100 0 6553.5 FORMAT "%8.3" ECU_ADDRESS 0x5B96AC /end MEASUREMENT
/begin MEASUREMENT wnwkwe_w "Winkel der Einlaﬂ-NW-Flanken relativ zur Kurbelwelle" UWORD kw_q0p1 1 100 0 6553.5 FORMAT "%8.3" ECU_ADDRESS 0x5B96AE /end MEASUREMENT
/begin MEASUREMENT wped "Normierter Fahrpedalwinkel" UBYTE relPED_ub_b100 1 100 0 100 FORMAT "%5.1" ECU_ADDRESS 0x5B8EC3 /end MEASUREMENT
/begin MEASUREMENT wpedt_w "Pedalwert (tempor‰r) bei 2 ME-Steuerger‰ten" UWORD relPED_uw_b100 1 100 0 100 FORMAT "%8.4" ECU_ADDRESS 0x5B9200 /end MEASUREMENT
/begin MEASUREMENT wpedv_w "Normierter Fahrpedalwinkel vor Ber¸cksichtigung der Begrenzungen im Notfahren" UWORD relPED_uw_b100 1 100 0 100 FORMAT "%8.4" ECU_ADDRESS 0x5B9202 /end MEASUREMENT
/begin MEASUREMENT wped_w "Normierter Fahrpedalwinkel" UWORD relPED_uw_b100 1 100 0 100 FORMAT "%8.4" ECU_ADDRESS 0x5B9204 /end MEASUREMENT
/begin MEASUREMENT zaldy "Z¸ndungsz‰hler f¸r Abregelung Lastdynamik" UBYTE dez 1 100 0 255 FORMAT "%5.1" ECU_ADDRESS 0x5B8F0F /end MEASUREMENT
/begin MEASUREMENT zldy "Z¸ndungsz‰hler f¸r Lastdynamik" UBYTE dez 1 100 0 255 FORMAT "%5.1" ECU_ADDRESS 0x3FC047 /end MEASUREMENT
/begin MEASUREMENT zndy "Z¸ndungsz‰hler f¸r Drehzahldynamik" UBYTE dez 1 100 0 255 FORMAT "%5.1" ECU_ADDRESS 0x3FC048 /end MEASUREMENT
/begin MEASUREMENT zphfl "Z‰hler ‰quidistante Phasenflanken" SBYTE dez 1 100 -128 127 FORMAT "%5.1" ECU_ADDRESS 0x5B8C60 /end MEASUREMENT
/begin MEASUREMENT zphfl2 "Z‰hler ‰quidistante Phasenflanken 2" SBYTE dez 1 100 -128 127 FORMAT "%5.1" ECU_ADDRESS 0x5B8C61 /end MEASUREMENT
/begin MEASUREMENT zphfl2ct_w "Z‰hler f¸r Fehler bei zphfl2 Bestimmung" UWORD dez 1 100 0 65535 FORMAT "%8.2" ECU_ADDRESS 0x5B96B0 /end MEASUREMENT
/begin MEASUREMENT zphfl3ct_w "Z‰hler f¸r Fehler bei zphfl3 Bestimmung" UWORD dez 1 100 0 65535 FORMAT "%8.2" ECU_ADDRESS 0x5B96B2 /end MEASUREMENT
/begin MEASUREMENT zphfl4ct_w "Z‰hler f¸r Fehler bei zphfl4 Bestimmung" UWORD dez 1 100 0 65535 FORMAT "%8.2" ECU_ADDRESS 0x5B96B4 /end MEASUREMENT
/begin MEASUREMENT zphflct_w "Z‰hler f¸r Fehler bei zphfl Bestimmung" UWORD dez 1 100 0 65535 FORMAT "%8.2" ECU_ADDRESS 0x5B96B6 /end MEASUREMENT
/begin MEASUREMENT zrph2_l "Z‰hler Raster Phasensignal 2" ULONG dez 1 100 0 4.29497e+009 FORMAT "%13.2" ECU_ADDRESS 0x5B9A44 /end MEASUREMENT
/begin MEASUREMENT zrph3_l "Z‰hler Raster Phasensignal 3" ULONG dez 1 100 0 4.29497e+009 FORMAT "%13.2" ECU_ADDRESS 0x5B9A48 /end MEASUREMENT
/begin MEASUREMENT zrph4_l "Z‰hler Raster Phasensignal 4" ULONG dez 1 100 0 4.29497e+009 FORMAT "%13.2" ECU_ADDRESS 0x5B9A4C /end MEASUREMENT
/begin MEASUREMENT zrph_l "Z‰hler Raster Phasensignal" ULONG dez 1 100 0 4.29497e+009 FORMAT "%13.2" ECU_ADDRESS 0x5B9A50 /end MEASUREMENT
/begin MEASUREMENT zzkwas_w "Zahnz‰hler Kurbelwelle im Arbeitsspiel" UWORD dez 1 100 0 65535 FORMAT "%8.2" ECU_ADDRESS 0x5B96BC /end MEASUREMENT
/begin MEASUREMENT zzvirt "virtueller Zahnz‰hler im Start bis zur Synchronisation" UBYTE dez 1 100 0 255 FORMAT "%5.1" ECU_ADDRESS 0x5B8C65 /end MEASUREMENT
/begin MEASUREMENT zzwdykr "Z¸ndungsz‰hler bei gesetztem Bit B_zwkra=1 w‰hrend der KR-Dynamik" UWORD dez 1 100 0 65535 FORMAT "%8.2" ECU_ADDRESS 0x3FC088 /end MEASUREMENT
/begin MEASUREMENT zzwdymd "Z¸ndungsz‰hler bei nicht gesetztem Bit B_zwkra=0 w‰hrend der KR-Dynamik" UWORD dez 1 100 0 65535 FORMAT "%8.2" ECU_ADDRESS 0x3FC08A /end MEASUREMENT
/begin MEASUREMENT zzyl "SW-Zylinderz‰hler" UBYTE dez 1 100 0 255 FORMAT "%5.1" ECU_ADDRESS 0x5B8C66 /end MEASUREMENT
/begin FUNCTION GGPED "Gebergrˆﬂe Fahrpedal"
 /begin DEF_CHARACTERISTIC CWBWEEN DUPW12 DUPW12BE DUPW12TG DUPW12VG DUPWGHY DWPMXNB DWPMXNOT NWPMBBR TFPWG2 THOPP1 THOPP2 TMBVH TPNSE1 TUPWBWF TUPWBWV TUPWG12 TUPWG1O TUPWG1U TUPWG2O TUPWG2U TWPMBBR UPW1BE UPW1LLMX UPWG12U UPWG1O UPWG1U UPWG2O UPWG2U UPWGO UPWGTG UPWGTL UPWGU UPWGUBF UPWGUR UPWGVG VWPMBBR WPMXBR WPMXNOT ZBWF /end DEF_CHARACTERISTIC
 /begin IN_MEASUREMENT B_bkva B_bkvv B_br2k B_brems B_dknot B_dksbeg B_fabr B_nmax B_pwf B_pwgnotum B_stend B_ubpvg nmot upwg1_w upwg2_w vfzg /end IN_MEASUREMENT
 /begin OUT_MEASUREMENT B_pwgnotfr B_sp1s B_sp2s B_spsmin B_upwbwf dwped dwped_w upwg2d_w upwgej_w wped wpedt_w wped_w /end OUT_MEASUREMENT
 /begin LOC_MEASUREMENT B_bwf B_bwunpl B_dupw B_dupw12 B_glf B_holp1 B_holp1a B_holp1l B_holp2 B_holp2a B_holp2l B_hop1mn B_hop2mn B_hopakt B_mbvh B_pwgbwf B_upw12e B_upw1mn B_upw1mx B_upw2mn B_upw2mx B_upwg1o B_upwg1u B_upwg2o B_upwg2u B_wpabnb B_wpmbbr ctrbwf GGPEDlokbits GGPEDlokbits2 GGPEDnonVolbits upw2ll_w upwg2fil_w upwg_w wpedv_w /end LOC_MEASUREMENT
/end FUNCTION
/begin FUNCTION GGTFA "Gebergrˆﬂe TFA Temperaturf¸hler Ansaugluft" /begin DEF_CHARACTERISTIC TADE TADMN TADMX TANSELI TDNSTA TDTA TDTAL ZFTANS /end DEF_CHARACTERISTIC /begin IN_MEASUREMENT B_ll B_pwf B_sa B_stend wtans /end IN_MEASUREMENT /begin OUT_MEASUREMENT tans tansab tansabk_w tansk_w tanslin /end OUT_MEASUREMENT /end FUNCTION
/begin FUNCTION GGTFM "Gebergrˆﬂe TFM Temperaturf¸hler Motor (/-K¸hlmittel)"
 /begin DEF_CHARACTERISTIC DTLRTML DTMDMA DTMDNPO DTMSRT FABSTT KFDTMTE KFDTMTR KFDTMTU KLDTMRS TADMM TDTM TDTMMA TMDMMA TMDMMAT TMDMMAU TMDMMEE TMDMMER TMDMN TMDMX TMLRTMS TMMXRT TMOTELI TNSRT TUMDETM TWLRTMS ZFTMOT /end DEF_CHARACTERISTIC
 /begin IN_MEASUREMENT B_etol B_etum B_ins2cok B_nmin B_nmot B_nokatfz B_pwf B_sa B_st B_stend ml tabst_w tans tnst_w tol tumg wtmot /end IN_MEASUREMENT
 /begin OUT_MEASUREMENT B_anfw B_fgdtm B_mxmntm B_tmdmme B_tmmn B_tmsrt fktmsch manftmew mll1 msttmew msttmrw tdlrtm_w tmew tmewab tmot tmotab tmotlin tmotlin_w tmotvt tmrw tmrwend tmst tum /end OUT_MEASUREMENT
/end FUNCTION
/begin FUNCTION GGTFUMG "Gebergrˆﬂe TFUMG Temperaturf¸hler Umgebung (/-sluft)" /begin DEF_CHARACTERISTIC IMTUMGTA NTUMGTA TDTUM TDTUMNF TUMGTAI VTUMGTA /end DEF_CHARACTERISTIC /begin REF_CHARACTERISTIC DTUMTA /end REF_CHARACTERISTIC
 /begin IN_MEASUREMENT B_ins3cok B_pwf B_tfu B_wakeup imlatm nmot tans tumgcan vfzg /end IN_MEASUREMENT
 /begin OUT_MEASUREMENT B_ctunp B_etum tumg /end OUT_MEASUREMENT
 /begin LOC_MEASUREMENT tumgta /end LOC_MEASUREMENT
/end FUNCTION
/begin FUNCTION GGTKA "Gebergrˆﬂe TKA Temperatur K¸hlerausgang" /begin DEF_CHARACTERISTIC TDTKAUS TKAELI TKAUSDE TKAUSDMN TKAUSDMX /end DEF_CHARACTERISTIC /begin IN_MEASUREMENT wtka /end IN_MEASUREMENT /begin OUT_MEASUREMENT tka tkalin /end OUT_MEASUREMENT /end FUNCTION
/begin FUNCTION GGTOENS "GGTOENS.  Gebergrˆﬂe Temperatur, ÷lniveau-Sensor"
 /begin DEF_CHARACTERISTIC DOLNIV KLTKTOENIV KLTOGNKOR KLTVTOEL ORIVERZ PT1NMOT PT1TOEL TOGANZ TOGKURZANZ TOGMWK TOGNMOT TOGORIANZ TOGTMOT TOGTMOTORI TOGVERBKZ TOGVERBNOR TOGVERLKZ TOGVERLNOR TOGVERLORI TRTYP /end DEF_CHARACTERISTIC
 /begin REF_CHARACTERISTIC TOGVERZOEG TOG_VERS /end REF_CHARACTERISTIC
 /begin IN_MEASUREMENT B_nmot B_toel B_tog B_togerr B_togupl m_tol nmot tmot Tog_cnt Tog_tk Tog_tr Tog_tv /end IN_MEASUREMENT
 /begin OUT_MEASUREMENT B_oeltemp B_oelverb B_oelverl toel_w tol /end OUT_MEASUREMENT
 /begin LOC_MEASUREMENT nmotf nmotfm nmotfsum Oelnivak Oelnivaknk Oelnivkurz Oelnivm Oelnivnksm Oelnivnorm Oelnivori Oelnivsum Oelnivsumw Oriverzz Toel_t togbw_i togk_i tog_i tog_k /end LOC_MEASUREMENT
/end FUNCTION
/begin FUNCTION GGTSG "Gebergrˆﬂe und Dokumentation Temperatur Steuerger‰t"
 /begin DEF_CHARACTERISTIC STNSG1 STNSG2 STNSG3 STNSG4 STNSG5 STTSG1 STTSG2 STTSG3 STTSG4 STTSG5 TSGELI TSTSG /end DEF_CHARACTERISTIC
 /begin IN_MEASUREMENT nmot wtsg /end IN_MEASUREMENT
 /begin OUT_MEASUREMENT tsg /end OUT_MEASUREMENT
/end FUNCTION
/begin FUNCTION GGUB "8.10      Gebergrˆﬂe Batteriespannung, inkl.Diagnose" /begin DEF_CHARACTERISTIC TDNSUB TDUB UBDE UBDMN1 UBDMN2 UBDMX VMDUB /end DEF_CHARACTERISTIC /begin IN_MEASUREMENT B_stend B_wakeup vfzg wub /end IN_MEASUREMENT /begin OUT_MEASUREMENT ub ubsq ubsqf ubsqf_w ubsq_w ub_w /end OUT_MEASUREMENT /end FUNCTION
/begin FUNCTION GGUBR "Gebergrˆﬂe und Diagnose Bordnetzspannung ¸ber Hauptrelais" /begin DEF_CHARACTERISTIC TDAPTUBR TDHREVAB TDUBR UBRDMN1 UBRDMN2 UBRDMX /end DEF_CHARACTERISTIC /begin IN_MEASUREMENT B_stend ei_ubr_um sfpub wub /end IN_MEASUREMENT
 /begin OUT_MEASUREMENT B_hrevab B_ubrdmn1 B_ubrdmn2 B_ubrk B_ubrmax ubrsq ubrsqf ubrsqf_w ubrsq_w /end OUT_MEASUREMENT
/end FUNCTION
/begin FUNCTION GGVFZG "Gebergrˆﬂe Fahrzeuggeschwindigkeit" /begin DEF_CHARACTERISTIC DVFZBEG TFGRVRAB VFZMN VRFGRMN ZFV /end DEF_CHARACTERISTIC /begin IN_MEASUREMENT vroh_w /end IN_MEASUREMENT /begin OUT_MEASUREMENT bfzgl_b B_vnull vfzg vfzg_w vfzroh_w /end OUT_MEASUREMENT /begin LOC_MEASUREMENT vfil_w /end LOC_MEASUREMENT /end FUNCTION
/begin FUNCTION GK "Gemischkontrolle" /begin DEF_CHARACTERISTIC KFBS /end DEF_CHARACTERISTIC
 /begin IN_MEASUREMENT fgru fns fra_w fr_w fst_w fwe fwl lamnswl_w lamsbg_w nmot rkaco_w rka_w rkte_w rkukg_w rl rlp_w /end IN_MEASUREMENT
 /begin OUT_MEASUREMENT rk2_w rkkva2_w rkkva_w rk_w /end OUT_MEASUREMENT
 /begin LOC_MEASUREMENT fvst_w /end LOC_MEASUREMENT
/end FUNCTION
/begin FUNCTION HKW "HKW.exportedHeizung K¸hlwasser"
 /begin DEF_CHARACTERISTIC BBHZM_EZH BBHZM_NEZH BBHZ_LRN_T HKW_dT_HKW_IMPL HKW_IKL HKW_ING HKW_IPG HKW_IWIN HKW_NO HKW_NSTMX HKW_NU HKW_PIMAX HKW_PKL HKW_PNG HKW_PPG HKW_PSTMX HKW_PWIN HKW_TGFVT HKW_TGL HKW_TRGL HKW_TSTTV HKW_UBO HKW_UBU HKW_WTHY HKW_WTOFF HKW_WTOFF2 KLHKWN KLHKWT TMOT_MX_ZH TUMG_MX_ZH /end DEF_CHARACTERISTIC
 /begin IN_MEASUREMENT B_ac B_azh B_ezhcok B_genfbsd B_genoff B_hzl B_ko B_pwf B_stend dffgen nmot S_hz tmot tsolletr tumg ub /end IN_MEASUREMENT
 /begin OUT_MEASUREMENT bbhz_m B_hkwnll B_hkwoff0 B_hkwoff1 B_hkwoff2 B_hkwoff3 B_hkwoff4 B_hkwoff5 B_hkwoff6 B_hkwoff7 B_hz ehz_pw HKWBits1_1000ms HKWBits2_1000ms /end OUT_MEASUREMENT
 /begin LOC_MEASUREMENT bbhz_sts bbhz_timer bbhz_var bbhz_var_k bbhz_ver B_hkwezhon B_hkwlearn B_hkwon hkw_iant hkw_ki hkw_kp hkw_lpgv hkw_lpsv hkw_pant hkw_pi hkw_rdiff hkw_sel_i hkw_sel_p hkw_sv hkw_t hkw_to hkw_ttmp /end LOC_MEASUREMENT
/end FUNCTION
/begin FUNCTION HLS "Heizung Lambdasonde"
 /begin DEF_CHARACTERISTIC THEH THEV THHA THHA2 THHAWU THSHKTK THSVKTA THVA THVA2 THVAWU TMOHSMN TVHSH TVHSV UBHS UHSN /end DEF_CHARACTERISTIC
 /begin IN_MEASUREMENT B_atmtpa B_atmtpk B_sbbhk B_sbbvk B_sbbvk2 B_stend tabgm tkatm tmot ub /end IN_MEASUREMENT
 /begin OUT_MEASUREMENT B_hshe B_hshe2 B_hsve B_hsve2 phlsnh phlsnh2 phlsnv phlsnv2 /end OUT_MEASUREMENT
 /begin LOC_MEASUREMENT B_hsh B_hsh2 B_hshmx B_hshmx2 B_hsv B_hsv2 B_hsvmx B_hsvmx2 B_rehs thhaist thhaist2 thhat thhat2 thvaist thvaist2 thvat thvat2 /end LOC_MEASUREMENT
/end FUNCTION
/begin FUNCTION HT2KTPH "Umsetzungsschicht Hardewaretreiber zu Komponententreiber Nockenwelle"
 /begin DEF_CHARACTERISTIC CWANW DPHFLFR1 DPHFLFR2 DPHFLSP1 DPHFLSP2 NMXPHPOS NWOFFSET NWSIGNAL NWSIGTOL WNWSPG1 WNWSPG2 /end DEF_CHARACTERISTIC
 /begin IN_MEASUREMENT inisynmon nmot pgmaster synstate /end IN_MEASUREMENT
 /begin OUT_MEASUREMENT B_checkpg B_checkpg2 B_checkpg3 B_checkpg4 tnwia_l tnwie_l wnwkwa_w wnwkwe_w zphfl zphfl2 zphfl2ct_w zphfl3ct_w zphfl4ct_w zphflct_w zrph2_l zrph3_l zrph4_l zrph_l /end OUT_MEASUREMENT
 /begin LOC_MEASUREMENT B_pg1limsw B_pg2limsw camstate pg1limfr_w pg1limsp_w pg2limfr_w pg2limsp_w /end LOC_MEASUREMENT
/end FUNCTION
/begin FUNCTION HT2KTWNE "Umsetzungsschicht Hardwaretreiber zu Komponententreiber Kurbelwelle"
 /begin DEF_CHARACTERISTIC CWPG1 CWPG2 CWPG3 CWPG4 DZZST FSYNDEL NMIN NMOTQSYN OFQSYNADAP TPREL WKWALETEST ZTPREL /end DEF_CHARACTERISTIC
 /begin REF_CHARACTERISTIC CWALE /end REF_CHARACTERISTIC
 /begin IN_MEASUREMENT B_ale inisynmon pgmaster synstate wkwstop_w /end IN_MEASUREMENT
 /begin OUT_MEASUREMENT B_bm B_stprel B_tprel B_zprel B_zsynchro crankstate sync_level SYN_st tseg_l wkwas_w zzkwas_w zzvirt zzyl /end OUT_MEASUREMENT
 /begin LOC_MEASUREMENT qstartinf wkwalest_w /end LOC_MEASUREMENT
/end FUNCTION
/begin FUNCTION IMDGEN "IMDGEN.   Berechnung des Generatorstromes und Generatormomentes"
 /begin DEF_CHARACTERISTIC ENGENTANS EN_MDGEN GENDIFAK0 GENDIFAK1 GENDIFAK2 GENDIFAK3 GENDIFAK4 GENDIFAK5 GENDIFAK6 GENDIFAK7 GENITYP GENMDOF GENRS0_0 GENRS0_1 GENRS0_2 GENRS0_3 GENRS0_4 GENRS0_5 GENRS0_6 GENRS0_7 GENSTFAK0 GENSTFAK1 GENSTFAK2 GENSTFAK3 GENSTFAK4 GENSTFAK5 GENSTFAK6 GENSTFAK7 GENTEMPAPP GENTEMPMAN GENTMOTDT GENTMOTOF0 GENTMOTOF1 GENTMOTOF2 GENTMOTOF3 GENTMOTOF4 GENTMOTOF5 GENTMOTOF6 GENTMOTOF7 GENTYP GENTYPFELD GENUEBSETZ0 GENUEBSETZ1 GENUEBSETZ2 GENUEBSETZ3 GENUEBSETZ4 GENUEBSETZ5 GENUEBSETZ6 GENUEBSETZ7 GENUMGTYP GENVFZGSW GEN_IG_OF IGBASIS IGBASISOFF IGNOTWERT KFGENWETA0 KFGENWETA1 KFGENWETA2 KFGENWETA3 KFGENWETA4 KFGENWETA5 KFGENWETA6 KFGENWETA7 KFIGENDF0 KFIGENDF1 KFIGENDF2 KFIGENDF3 KFIGENDF4 KFIGENDF5 KFIGENDF6 KFIGENDF7 KFIGENKA0 KFIGENKA1 KFIGENKA2 KFIGENKA3 KFIGENKA4 KFIGENKA5 KFIGENKA6 KFIGENKA7 KFIGENWA0 KFIGENWA1 KFIGENWA2 KFIGENWA3 KFIGENWA4 KFIGENWA5 KFIGENWA6 KFIGENWA7 KLFPDIODE0 KLFPDIODE1 KLFPDIODE2 KLFPDIODE3 KLFPDIODE4 KLFPDIODE5 KLFPDIODE6 KLFPDIODE7 KLGENEXP0 KLGENEXP1 KLGENEXP2 KLGENEXP3 KLGENEXP4 KLGENEXP5 KLGENEXP6 KLGENEXP7 KLGENTETA0 KLGENTETA1 KLGENTETA2 KLGENTETA3 KLGENTETA4 KLGENTETA5 KLGENTETA6 KLGENTETA7 KLIGENMESS KLRTH0FAK0 KLRTH0FAK1 KLRTH0FAK2 KLRTH0FAK3 KLRTH0FAK4 KLRTH0FAK5 KLRTH0FAK6 KLRTH0FAK7 KLRTHFAK0 KLRTHFAK1 KLRTHFAK2 KLRTHFAK3 KLRTHFAK4 KLRTHFAK5 KLRTHFAK6 KLRTHFAK7 KLRTHGEN0 KLRTHGEN1 KLRTHGEN2 KLRTHGEN3 KLRTHGEN4 KLRTHGEN5 KLRTHGEN6 KLRTHGEN7 KLTANSGEN0 KLTANSGEN1 KLTANSGEN2 KLTANSGEN3 KLTANSGEN4 KLTANSGEN5 KLTANSGEN6 KLTANSGEN7 MANAWNUMM PRELLGTMOT S_IGMISCH TIGMISCH TSTCNTEN TSTFIL_IN TSTFIL_INI UDIODERMS0 UDIODERMS1 UDIODERMS2 UDIODERMS3 UDIODERMS4 UDIODERMS5 UDIODERMS6 UDIODERMS7 ZMGENIG ZMGENS0HZ0 ZMGENS0HZ1 ZMGENS0HZ2 ZMGENS0HZ3 ZMGENS0HZ4 ZMGENS0HZ5 ZMGENS0HZ6 ZMGENS0HZ7 ZMGENS0KL0 ZMGENS0KL1 ZMGENS0KL2 ZMGENS0KL3 ZMGENS0KL4 ZMGENS0KL5 ZMGENS0KL6 ZMGENS0KL7 ZMGENSTHZ0 ZMGENSTHZ1 ZMGENSTHZ2 ZMGENSTHZ3 ZMGENSTHZ4 ZMGENSTHZ5 ZMGENSTHZ6 ZMGENSTHZ7 ZMGENSTKL0 ZMGENSTKL1 ZMGENSTKL2 ZMGENSTKL3 ZMGENSTKL4 ZMGENSTKL5 ZMGENSTKL6 ZMGENSTKL7 ZMGENTWA ZMGN0TANS0 ZMGN0TANS1 ZMGN0TANS2 ZMGN0TANS3 ZMGN0TANS4 ZMGN0TANS5 ZMGN0TANS6 ZMGN0TANS7 ZMGNTANS0 ZMGNTANS1 ZMGNTANS2 ZMGNTANS3 ZMGNTANS4 ZMGNTANS5 ZMGNTANS6 ZMGNTANS7 ZMIGMISCH ZMTESTFIL /end DEF_CHARACTERISTIC
 /begin REF_CHARACTERISTIC MDNORM S_RDGENTYP /end REF_CHARACTERISTIC
 /begin IN_MEASUREMENT B_genactiv B_genoff B_gfbsupak B_gfelak B_gfmeak B_gfnobsak B_pwf B_stend dffgen genmanufak gentypkenn igenmess i_slp nmot_w st_craweng tabst_w tans tmot tumg ugen vfzg /end IN_MEASUREMENT
 /begin OUT_MEASUREMENT B_firstemp B_gene B_generken B_genfkupl B_heizen dib_ig fdib_ig genawnumm gendts genfeta genig genikaltun geninafil genitemp genivorfil geni_end gennummer genrs genspv gensttemp gentans gentansend gentemp gentempab gentempdt gentempend gentempexp gentempfil gen_teta gen_weta ibasis igen400A igm igvor mdgenloc_w mdgenrel_w mdgenvf_w md_gennm ngen_w nmots pgenab st_i_gen tstcountv tstfil_out /end OUT_MEASUREMENT
 /begin LOC_MEASUREMENT genalfak2 gendi_spv gendtsvor gendts_s1 geni2_st geni_difk geni_stfk genspv_1 genspv_2 MDNORMTMP tstlocini ugen_tmp /end LOC_MEASUREMENT
/end FUNCTION
/begin FUNCTION INDEX_BGRBS "" /end FUNCTION
/begin FUNCTION INDEX_CANEZH "" /end FUNCTION
/begin FUNCTION INDEX_DASC "" /end FUNCTION
/begin FUNCTION INDEX_DBKVPE "" /end FUNCTION
/begin FUNCTION INDEX_DCANA "" /end FUNCTION
/begin FUNCTION INDEX_DCAS "" /end FUNCTION
/begin FUNCTION INDEX_DCEZ "" /end FUNCTION
/begin FUNCTION INDEX_DCGE "" /end FUNCTION
/begin FUNCTION INDEX_DCINS "" /end FUNCTION
/begin FUNCTION INDEX_DCOD "" /end FUNCTION
/begin FUNCTION INDEX_DDG "" /end FUNCTION
/begin FUNCTION INDEX_DDVE "" /end FUNCTION
/begin FUNCTION INDEX_DEKON "" /end FUNCTION
/begin FUNCTION INDEX_DEKPE "" /end FUNCTION
/begin FUNCTION INDEX_DELSE "" /end FUNCTION
/begin FUNCTION INDEX_DETS "" /end FUNCTION
/begin FUNCTION INDEX_DEVE "" /end FUNCTION
/begin FUNCTION INDEX_DFPM "" /end FUNCTION
/begin FUNCTION INDEX_DHFM "" /end FUNCTION
/begin FUNCTION INDEX_DHLS "" /end FUNCTION
/begin FUNCTION INDEX_DISA "" /end FUNCTION
/begin FUNCTION INDEX_DKAT "" /end FUNCTION
/begin FUNCTION INDEX_DKOSE "" /end FUNCTION
/begin FUNCTION INDEX_DKRNT "" /end FUNCTION
/begin FUNCTION INDEX_DKRS "" /end FUNCTION
/begin FUNCTION INDEX_DKRTP "" /end FUNCTION
/begin FUNCTION INDEX_DKUPPL "" /end FUNCTION
/begin FUNCTION INDEX_DKVS "" /end FUNCTION
/begin FUNCTION INDEX_DLLR "" /end FUNCTION
/begin FUNCTION INDEX_DLSA "" /end FUNCTION
/begin FUNCTION INDEX_DLSAHK "" /end FUNCTION
/begin FUNCTION INDEX_DLSH "" /end FUNCTION
/begin FUNCTION INDEX_DLSV "" /end FUNCTION
/begin FUNCTION INDEX_DMDMIL "DMDMIL.exported" /end FUNCTION
/begin FUNCTION INDEX_DMLSE "" /end FUNCTION
/begin FUNCTION INDEX_DMYDFPM "" /end FUNCTION
/begin FUNCTION INDEX_DNVRBUP "" /end FUNCTION
/begin FUNCTION INDEX_DNWSAUS "DNWSAUS.exported" /end FUNCTION
/begin FUNCTION INDEX_DNWSEAUS "" /end FUNCTION
/begin FUNCTION INDEX_DNWSEEIN "" /end FUNCTION
/begin FUNCTION INDEX_DNWSEIN "DNWSEIN.exported" /end FUNCTION
/begin FUNCTION INDEX_DPH "DPH." /end FUNCTION
/begin FUNCTION INDEX_DSLPE "" /end FUNCTION
/begin FUNCTION INDEX_DSLSLR "" /end FUNCTION
/begin FUNCTION INDEX_DSUE "" /end FUNCTION
/begin FUNCTION INDEX_DTEVE "" /end FUNCTION
/begin FUNCTION INDEX_DTEVN "" /end FUNCTION
/begin FUNCTION INDEX_DTOENS "" /end FUNCTION
/begin FUNCTION INDEX_DUF "" /end FUNCTION
/begin FUNCTION INDEX_DUR "" /end FUNCTION
/begin FUNCTION INDEX_DVFZ "" /end FUNCTION
/begin FUNCTION INDEX_DZKU "" /end FUNCTION
/begin FUNCTION INDEX_EGFE "" /end FUNCTION
/begin FUNCTION INDEX_EWS3 "" /end FUNCTION
/begin FUNCTION INDEX_FSPVDGEN "FSPVDGEN.exported" /end FUNCTION
/begin FUNCTION INDEX_GGDSAS "" /end FUNCTION
/begin FUNCTION INDEX_GGEGAS "" /end FUNCTION
/begin FUNCTION INDEX_GGMFL "" /end FUNCTION
/begin FUNCTION INDEX_GGPED "" /end FUNCTION
/begin FUNCTION INDEX_GGTFA "" /end FUNCTION
/begin FUNCTION INDEX_GGTFM "" /end FUNCTION
/begin FUNCTION INDEX_GGTFUMG "" /end FUNCTION
/begin FUNCTION INDEX_GGTKA "" /end FUNCTION
/begin FUNCTION INDEX_GGUB "" /end FUNCTION
/begin FUNCTION INDEX_GGUBR "" /end FUNCTION
/begin FUNCTION INDEX_MDKOG "" /end FUNCTION
/begin FUNCTION INI_MAIN_2 "" /begin REF_CHARACTERISTIC CWPWF /end REF_CHARACTERISTIC /end FUNCTION
/begin FUNCTION KATV "Variantenerkennung (Fahrzeug mit/ohne Kat und Lambdasonden)" /begin REF_CHARACTERISTIC CDHSV UHDMX /end REF_CHARACTERISTIC /begin IN_MEASUREMENT B_clvar B_pwf uhsv uhsv2 /end IN_MEASUREMENT /begin OUT_MEASUREMENT B_nokatfz nokatfz_flg /end OUT_MEASUREMENT /end FUNCTION
/begin FUNCTION KBK2SERVI "" /begin REF_CHARACTERISTIC CODINDEX /end REF_CHARACTERISTIC /begin IN_MEASUREMENT nmot_w /end IN_MEASUREMENT /end FUNCTION
/begin FUNCTION KFT "KFT.      Kennfeld Thermostat"
 /begin DEF_CHARACTERISTIC DTMOTKFT KFTBERGI KFTKRI KFTKWS KFTLASTI KFTTANSI KLKFTBERG KLKFTLAST KLKFTTANS KLTKWI KLTKWP TKWBERGMAX TKWBERGMIN TKWI TKWKRMAX TKWKRMIN TKWLASTMAX TKWLASTMIN TKWPWMMN TKWPWMMX TKWSBERG TKWSGOT TKWSKR TKWSLAST TKWSMAX TKWSNTKW TKWSTANS TKWSUETEMP TKWTANSMAX TKWTANSMIN TMOTTKWMAX TMOTTKWMIN TUMGTKWBG TUMGTKWKR TUMGTKWRL TUMGTKWTA /end DEF_CHARACTERISTIC
 /begin IN_MEASUREMENT B_etret B_faetr B_got B_kftkr B_nachl B_ntkw B_stend nmot rl rlsol_w tans tmot tumg vfzg /end IN_MEASUREMENT
 /begin OUT_MEASUREMENT tkwpwm /end OUT_MEASUREMENT
 /begin LOC_MEASUREMENT B_kalt B_tkwberg B_tkwkr B_tkwlast B_tkwtans B_tkwwarml integberg integkr integlast integtans tkwdiff tkwi tkwp tkwpi tkws tkwv /end LOC_MEASUREMENT
/end FUNCTION
/begin FUNCTION KHMD "Berechnung Reservemoment f¸r Katheizen"
 /begin DEF_CHARACTERISTIC CWKHMD FMDKHFH FMDKHTMST KFKWTMP KFMDDSLA KFMDKH KFMDKHLL ZKBKVAB ZKMDKH /end DEF_CHARACTERISTIC
 /begin IN_MEASUREMENT B_bkvleer B_fasla B_kh B_kw B_ll dmllri_w fho_w fmdkh mifa_w nmot_w tmot tmst /end IN_MEASUREMENT
 /begin OUT_MEASUREMENT dmrdsls_w dmrkh dmrkh_w /end OUT_MEASUREMENT
 /begin LOC_MEASUREMENT dmrkhz_w drkwtmp_w fkbkvab fmkhfho_w fmkhtmst mifakh_w /end LOC_MEASUREMENT
/end FUNCTION
/begin FUNCTION KOS "Klimakompressor - Steuerung"
 /begin DEF_CHARACTERISTIC LIMTKOA MDKOAN MDKOEN SNM08KOUB TKOAMNN TKOAMXN TKOEMNN TMKOAO TMKOAU TNSTKO TVKOE VKOAO /end DEF_CHARACTERISTIC
 /begin IN_MEASUREMENT B_ac B_ko B_stend B_vl mdko mifal_w nmot tmot vfzg /end IN_MEASUREMENT
 /begin OUT_MEASUREMENT B_acres B_koe B_kosta B_nac /end OUT_MEASUREMENT
 /begin LOC_MEASUREMENT B_koena B_komnoff B_komnon B_komxoff B_kooff esst_snm08koub /end LOC_MEASUREMENT
/end FUNCTION
/begin FUNCTION KRDY "Klopfregelung Dynamik"
 /begin DEF_CHARACTERISTIC AZKRLDYN AZKRNDYN DYADMX DYAFVS DYAMNV DYAVF FKELDYA KFDYESEH KFDYESEHOF KFDYESPF KFDYESPFOF KFDYWVS NGKRWN NNGKRWN PZWKRA TMDYNA TZVER /end DEF_CHARACTERISTIC
 /begin REF_CHARACTERISTIC SEH06KRUW SNM12KRUW SRL08DYUB /end REF_CHARACTERISTIC
 /begin IN_MEASUREMENT B_clradkrd B_gdvhub B_gdvvtueb B_kl B_kr B_ll B_pwf B_sa B_tmkr B_zwkraa devhubi_w dpsfg_w esst_seh06kruw esst_snm12kruw esst_srl08dyub evhubi_w kek krfkw ngas_w nmot nmot_w rl stkrnx tans tmot virkr zzylkr /end IN_MEASUREMENT
 /begin OUT_MEASUREMENT azkrldy azkrndy B_krldy B_krldya B_krldyf B_krndy B_krsadyn dyesehof_w dyesehv_w wkrdy wkrdyvs zaldy zldy zndy zzwdykr zzwdymd /end OUT_MEASUREMENT
 /begin LOC_MEASUREMENT B_drknv B_kldynrm B_kldystk B_krldyofok B_krldyok dpskrmx_w dyespfof_w dyespfv_w ngkrv_w nngkrv_w wkrdya /end LOC_MEASUREMENT
/end FUNCTION
/begin COMPU_METHOD bfzg_sb_q0p217 "" RAT_FUNC "%6.3" "m/s^2" COEFFS 0 1 0 0 0 0.217 /end COMPU_METHOD
/begin COMPU_METHOD B_TRUE "boolsche Zust‰nde, positive Logik" TAB_VERB "%6.3" "" COMPU_TAB_REF B_TRUE /end COMPU_METHOD
/begin COMPU_VTAB B_TRUE "boolsche Zust‰nde, positive Logik" TAB_VERB 2 0 "----" 1 "TRUE" /end COMPU_VTAB
/begin COMPU_METHOD DEZ "1 : 1 Umrechnug (dez/hex)" RAT_FUNC "%6.2" "" COEFFS 0 1 0 0 0 1 /end COMPU_METHOD
/begin COMPU_METHOD dez "1 : 1 Umrechnug (dez/hex)" RAT_FUNC "%6.2" "" COEFFS 0 1 0 0 0 1 /end COMPU_METHOD
/begin COMPU_METHOD fak_q0p0039 "" RAT_FUNC "%6.4" "-" COEFFS 0 256 0 0 0 1 /end COMPU_METHOD
/begin COMPU_METHOD fak_q0p1 "" RAT_FUNC "%6.3" "-" COEFFS 0 1 0 0 0 0.1 /end COMPU_METHOD
/begin COMPU_METHOD fak_sb_b0p25 "" RAT_FUNC "%6.4" "-" COEFFS 0 256 0 0 0 0.5 /end COMPU_METHOD
/begin COMPU_METHOD fak_ub_b1 "" RAT_FUNC "%6.4" "-" COEFFS 0 256 0 0 0 1 /end COMPU_METHOD
/begin COMPU_METHOD fak_ub_b2 "" RAT_FUNC "%6.4" "-" COEFFS 0 256 0 0 0 2 /end COMPU_METHOD
/begin COMPU_METHOD fak_ub_b4 "" RAT_FUNC "%6.4" "-" COEFFS 0 256 0 0 0 4 /end COMPU_METHOD
/begin COMPU_METHOD fak_ub_q0p01 "" RAT_FUNC "%6.4" "-" COEFFS 0 1 0 0 0 0.01 /end COMPU_METHOD
/begin COMPU_METHOD fak_uw_b1 "" RAT_FUNC "%7.6" "-" COEFFS 0 65536 0 0 0 1 /end COMPU_METHOD
/begin COMPU_METHOD fak_uw_b2 "" RAT_FUNC "%7.6" "-" COEFFS 0 65536 0 0 0 2 /end COMPU_METHOD
/begin COMPU_METHOD fak_uw_b256 "" RAT_FUNC "%7.5" "-" COEFFS 0 65536 0 0 0 256 /end COMPU_METHOD
/begin COMPU_METHOD fak_uw_b4 "" RAT_FUNC "%7.6" "-" COEFFS 0 65536 0 0 0 4 /end COMPU_METHOD
/begin COMPU_METHOD fak_uw_b512 "" RAT_FUNC "%6.4" "-" COEFFS 0 65536 0 0 0 512 /end COMPU_METHOD
/begin COMPU_METHOD fak_uw_b64 "" RAT_FUNC "%6.5" "-" COEFFS 0 65536 0 0 0 64 /end COMPU_METHOD
/begin COMPU_METHOD fak_uw_q0p001 "" RAT_FUNC "%6.5" "-" COEFFS 0 65536 0 0 0 65.536 /end COMPU_METHOD
/begin COMPU_METHOD genalfak_uw_q0p610Em7 "" RAT_FUNC "%7.6" "" COEFFS 0 65536 0 0 0 4 /end COMPU_METHOD
/begin COMPU_METHOD gendt_q0p075 "" RAT_FUNC "%6.3" "" COEFFS 0 1 0 0 0 0.75 /end COMPU_METHOD
/begin COMPU_METHOD geneta_q0p03125 "" RAT_FUNC "%6.4" "" COEFFS 0 256 0 0 0 8 /end COMPU_METHOD
/begin COMPU_METHOD genexpab_ub_q0p0039 "" RAT_FUNC "%6.4" "" COEFFS 0 256 0 0 0 1 /end COMPU_METHOD
/begin COMPU_METHOD genpv_ul "" RAT_FUNC "%7.6" "" COEFFS 0 4294970000 0 0 0 262144 /end COMPU_METHOD
/begin COMPU_METHOD genpv_uw_q0p03125 "" RAT_FUNC "%6.4" "" COEFFS 0 65536 0 0 0 2048 /end COMPU_METHOD
/begin COMPU_METHOD genrstator "" RAT_FUNC "%7.6" "" COEFFS 0 65536 0 0 0 1 /end COMPU_METHOD
/begin COMPU_METHOD genuebsetzung2 "" RAT_FUNC "%6.4" "" COEFFS 0 256 0 0 0 4 /end COMPU_METHOD
/begin COMPU_METHOD genzmig_uw_q0p305em7 "" RAT_FUNC "%7.6" "" COEFFS 0 65536 0 0 0 2 /end COMPU_METHOD
/begin COMPU_METHOD genzmst_uw_q0p152em7 "" RAT_FUNC "%7.6" "" COEFFS 0 65536 0 0 0 1 /end COMPU_METHOD
/begin COMPU_METHOD hub_uw_q0p001 "" RAT_FUNC "%6.5" "mm" COEFFS 0 1000 0 0 0 1 /end COMPU_METHOD
/begin COMPU_METHOD igen_ub_q1 "" RAT_FUNC "%6.2" "" COEFFS 0 1 0 0 0 1 /end COMPU_METHOD
/begin COMPU_METHOD igen_uw_q0p03125 "" RAT_FUNC "%6.4" "" COEFFS 0 65536 0 0 0 2048 /end COMPU_METHOD
/begin COMPU_METHOD kw_q0p1 "" RAT_FUNC "%6.3" "Grad KW" COEFFS 0 10 0 0 0 1 /end COMPU_METHOD
/begin COMPU_METHOD kw_q1 "" RAT_FUNC "%6.2" "Grad KW" COEFFS 0 1 0 0 0 1 /end COMPU_METHOD
/begin COMPU_METHOD md_ub_q0p025 "" RAT_FUNC "%6.3" "Nm" COEFFS 0 1024 0 0 0 256 /end COMPU_METHOD
/begin COMPU_METHOD md_ub_q16 "" RAT_FUNC "%6.1" "Nm" COEFFS 0 1 0 0 0 16 /end COMPU_METHOD
/begin COMPU_METHOD m_ub_b1020 "" RAT_FUNC "%6.2" "kg/h" COEFFS 0 1 0 0 0 4 /end COMPU_METHOD
/begin COMPU_METHOD m_ub_b23p3 "" RAT_FUNC "%6.3" "kg" COEFFS 0 2812.5 0 0 0 256 /end COMPU_METHOD
/begin COMPU_METHOD ngen_uw_q0p5 "" RAT_FUNC "%6.3" "" COEFFS 0 1 0 0 0 0.5 /end COMPU_METHOD
/begin COMPU_METHOD nmotg_nuw_q0p39 "" RAT_FUNC "%7.0" "(1/min)/s" COEFFS 0 1 12800.16384 0 0 0.39063 /end COMPU_METHOD
/begin COMPU_METHOD nmotg_sw_q0p39 "" RAT_FUNC "%6.3" "1/min/s" COEFFS 0 1 0 0 0 0.39063 /end COMPU_METHOD
/begin COMPU_METHOD nmot_q1 "" RAT_FUNC "%6.2" "1/min" COEFFS 0 1 0 0 0 1 /end COMPU_METHOD
/begin COMPU_METHOD nmot_ub_q40 "" RAT_FUNC "%6.1" "1/min" COEFFS 0 1 0 0 0 40 /end COMPU_METHOD
/begin COMPU_METHOD nmot_uw_q0p25 "" RAT_FUNC "%6.3" "1/min" COEFFS 0 1 0 0 0 0.25 /end COMPU_METHOD
/begin COMPU_METHOD nwu_q1 "" RAT_FUNC "%6.2" "" COEFFS 0 1 0 0 0 1 /end COMPU_METHOD
/begin COMPU_METHOD p_sw_q0p039 "" RAT_FUNC "%6.4" "hPa" COEFFS 0 256 0 0 0 10 /end COMPU_METHOD
/begin COMPU_METHOD relPED_ub_b100 "" RAT_FUNC "%6.3" "%PED" COEFFS 0 255 0 0 0 100 /end COMPU_METHOD
/begin COMPU_METHOD relPED_uw_b100 "" RAT_FUNC "%6.4" "%PED" COEFFS 0 65535 0 0 0 100 /end COMPU_METHOD
/begin COMPU_METHOD rel_sb_q0p39 "" RAT_FUNC "%6.3" "%" COEFFS 0 1 0 0 0 0.3906 /end COMPU_METHOD
/begin COMPU_METHOD rel_sw_b50 "" RAT_FUNC "%6.4" "%" COEFFS 0 65536 0 0 0 100 /end COMPU_METHOD
/begin COMPU_METHOD rel_ub_b100 "" RAT_FUNC "%6.3" "%" COEFFS 0 255 0 0 0 100 /end COMPU_METHOD
/begin COMPU_METHOD rel_ub_b99p6 "" RAT_FUNC "%6.3" "%" COEFFS 0 256 0 0 0 100 /end COMPU_METHOD
/begin COMPU_METHOD rel_ub_q0p75 "" RAT_FUNC "%6.3" "%" COEFFS 0 1 0 0 0 0.75 /end COMPU_METHOD
/begin COMPU_METHOD rel_uw_b100 "" RAT_FUNC "%6.4" "%" COEFFS 0 65536 0 0 0 100 /end COMPU_METHOD
/begin COMPU_METHOD rel_uw_b3072 "" RAT_FUNC "%6.4" "%" COEFFS 0 65536 0 0 0 3072 /end COMPU_METHOD
/begin COMPU_METHOD rel_uw_q0p0234 "" RAT_FUNC "%6.4" "%" COEFFS 0 32 0 0 0 0.75 /end COMPU_METHOD
/begin COMPU_METHOD spg_q0p00039 "" RAT_FUNC "%6.5" "V" COEFFS 0 1 0 0 0 0.000390625 /end COMPU_METHOD
/begin COMPU_METHOD spg_q0p1 "" RAT_FUNC "%6.3" "V" COEFFS 0 1 0 0 0 0.1 /end COMPU_METHOD
/begin COMPU_METHOD spg_ubatt "" RAT_FUNC "%6.3" "V" COEFFS 0 1 0 0 0 0.0942 /end COMPU_METHOD
/begin COMPU_METHOD spg_ub_b5 "" RAT_FUNC "%6.4" "V" COEFFS 0 256 0 0 0 5 /end COMPU_METHOD
/begin COMPU_METHOD spg_ugen "" RAT_FUNC "%6.2" "V" COEFFS 0 10 -106 0 0 1 /end COMPU_METHOD
/begin COMPU_METHOD spg_uw_q0p00488 "" RAT_FUNC "%6.4" "V" COEFFS 0 1024 0 0 0 5 /end COMPU_METHOD
/begin COMPU_METHOD t100msxs_ub_b255 "" RAT_FUNC "%6.2" "s" COEFFS 0 1 0 0 0 1 /end COMPU_METHOD
/begin COMPU_METHOD t100msxs_ub_b25p5 "" RAT_FUNC "%6.3" "s" COEFFS 0 1 0 0 0 0.1 /end COMPU_METHOD
/begin COMPU_METHOD t100msxs_uw_b6553p5 "" RAT_FUNC "%6.3" "s" COEFFS 0 1 0 0 0 0.1 /end COMPU_METHOD
/begin COMPU_METHOD t100msxs_uw_b6553p6 "" RAT_FUNC "%6.3" "s" COEFFS 0 10 0 0 0 1 /end COMPU_METHOD
/begin COMPU_METHOD t10msxs_q0p01_o0p05 "" RAT_FUNC "%6.4" "s" COEFFS 0 1 0.05 0 0 0.01 /end COMPU_METHOD
/begin COMPU_METHOD t10msxs_ub_b2p55 "" RAT_FUNC "%6.4" "s" COEFFS 0 1 0 0 0 0.01 /end COMPU_METHOD
/begin COMPU_METHOD t10msxs_uw_b655p35 "" RAT_FUNC "%6.4" "s" COEFFS 0 1 0 0 0 0.01 /end COMPU_METHOD
/begin COMPU_METHOD t1msxms_q1 "" RAT_FUNC "%6.2" "ms" COEFFS 0 1 0 0 0 1 /end COMPU_METHOD
/begin COMPU_METHOD t1sxs_ub_b255 "" RAT_FUNC "%6.2" "s" COEFFS 0 1 0 0 0 1 /end COMPU_METHOD
/begin COMPU_METHOD t1sxs_ub_q1 "" RAT_FUNC "%6.2" "s" COEFFS 0 1 0 0 0 1 /end COMPU_METHOD
/begin COMPU_METHOD t1sxs_ul_q1 "" RAT_FUNC "%6.2" "s" COEFFS 0 1 0 0 0 1 /end COMPU_METHOD
/begin COMPU_METHOD t1sxs_uw_q1 "" RAT_FUNC "%6.2" "s" COEFFS 0 1 0 0 0 1 /end COMPU_METHOD
/begin COMPU_METHOD t200msxs_ub_b51 "" RAT_FUNC "%6.3" "s" COEFFS 0 1 0 0 0 0.2 /end COMPU_METHOD
/begin COMPU_METHOD t50msxs_ub_b12p75 "" RAT_FUNC "%6.4" "s" COEFFS 0 1 0 0 0 0.05 /end COMPU_METHOD
/begin COMPU_METHOD temp_q0p0234_o273 "" RAT_FUNC "%6.1" "Grad C" COEFFS 0 1 273.15 0 0 0.0234375 /end COMPU_METHOD
/begin COMPU_METHOD temp_sb_b0p093 "" RAT_FUNC "%6.5" "Grad C" COEFFS 0 512 0 0 0 0.375 /end COMPU_METHOD
/begin COMPU_METHOD temp_sw_q0p75 "" RAT_FUNC "%6.3" "Grad C" COEFFS 0 4 0 0 0 3 /end COMPU_METHOD
/begin COMPU_METHOD temp_ub_b191p25 "" RAT_FUNC "%6.3" "Grad C" COEFFS 0 1 0 0 0 0.75 /end COMPU_METHOD
/begin COMPU_METHOD temp_ub_q0p75_o48 "" RAT_FUNC "%6.2" "Grad C" COEFFS 0 1 48 0 0 0.75 /end COMPU_METHOD
/begin COMPU_METHOD temp_ub_q5_o50 "" RAT_FUNC "%6.2" "Grad C" COEFFS 0 1 50 0 0 5 /end COMPU_METHOD
/begin COMPU_METHOD temp_uw_q0p0029_o48 "" RAT_FUNC "%6.2" "Grad C" COEFFS 0 256 12288 0 0 0.75 /end COMPU_METHOD
/begin COMPU_METHOD temp_uw_q0p75_o48 "" RAT_FUNC "%6.2" "Grad C" COEFFS 0 1 48 0 0 0.75 /end COMPU_METHOD
/begin COMPU_METHOD tog_ub_q0p5 "" RAT_FUNC "%6.3" "" COEFFS 0 2 0 0 0 1 /end COMPU_METHOD
/begin COMPU_METHOD t_q0p0001_ms "" RAT_FUNC "%7.6" "ms" COEFFS 0 1 0 0 0 0.0001 /end COMPU_METHOD
/begin COMPU_METHOD t_q0p01 "" RAT_FUNC "%6.4" "s" COEFFS 0 100 0 0 0 1 /end COMPU_METHOD
/begin COMPU_METHOD t_q0p1ms "" RAT_FUNC "%6.3" "ms" COEFFS 0 10 0 0 0 1 /end COMPU_METHOD
/begin COMPU_METHOD t_q1p024_ms "" RAT_FUNC "%6.2" "ms" COEFFS 0 1 0 0 0 1.024 /end COMPU_METHOD
/begin COMPU_METHOD vfzg_ub_q1p25 "" RAT_FUNC "%6.2" "km/h" COEFFS 0 1 0 0 0 1.25 /end COMPU_METHOD
/begin COMPU_METHOD vfzg_uw_b512 "" RAT_FUNC "%6.4" "km/h" COEFFS 0 65536 0 0 0 512 /end COMPU_METHOD
/begin COMPU_METHOD zk100msxs_ub_b25p5 "" RAT_FUNC "%6.3" "s" COEFFS 0 0 256 0 10 0 /end COMPU_METHOD
/begin COMPU_METHOD zk100msxs_uw_b6553 "" RAT_FUNC "%10.3" "s" COEFFS 0 0 65536 0 10 0 /end COMPU_METHOD
/begin COMPU_METHOD zk10msxs_uw_b655 "" RAT_FUNC "%6.2" "s" COEFFS 0 0 65536 0 100 0 /end COMPU_METHOD
/begin COMPU_METHOD zw_ub_q0p75 "" RAT_FUNC "%6.3" "Grad KW" COEFFS 0 255 0 0 0 191.25 /end COMPU_METHOD
/begin COMPU_METHOD zw_ub_qn0p75 "" RAT_FUNC "%6.4" "Grad KW" COEFFS 0 1 0 0 0 -0.75 /end COMPU_METHOD
/begin COMPU_METHOD default "" RAT_FUNC "%6.2" "" COEFFS 0 1 0 0 0 1 /end COMPU_METHOD
/begin RECORD_LAYOUT GkfWS16 FNC_VALUES 1 SWORD COLUMN_DIR DIRECT /end RECORD_LAYOUT
/begin RECORD_LAYOUT GklWUb FNC_VALUES 1 UBYTE COLUMN_DIR DIRECT /end RECORD_LAYOUT
/begin RECORD_LAYOUT KfAxU8AyU8SstxU16SstyU16WU16 NO_AXIS_PTS_X 1 UWORD NO_AXIS_PTS_Y 2 UWORD AXIS_PTS_X 3 UWORD INDEX_INCR DIRECT AXIS_PTS_Y 4 UWORD INDEX_INCR DIRECT FNC_VALUES 5 UWORD COLUMN_DIR DIRECT /end RECORD_LAYOUT
/begin RECORD_LAYOUT KfAxU8AyU8SstxU8SstyU16WU8 NO_AXIS_PTS_X 1 UBYTE NO_AXIS_PTS_Y 2 UBYTE AXIS_PTS_X 3 UBYTE INDEX_INCR DIRECT AXIS_PTS_Y 4 UWORD INDEX_INCR DIRECT FNC_VALUES 5 UBYTE COLUMN_DIR DIRECT /end RECORD_LAYOUT
/begin RECORD_LAYOUT KfAxU8AyU8SstxU8SstyU8WU8 NO_AXIS_PTS_X 1 UBYTE NO_AXIS_PTS_Y 2 UBYTE AXIS_PTS_X 3 UBYTE INDEX_INCR DIRECT AXIS_PTS_Y 4 UBYTE INDEX_INCR DIRECT FNC_VALUES 5 UBYTE COLUMN_DIR DIRECT /end RECORD_LAYOUT
/begin RECORD_LAYOUT KfAxUbAyUbSstxUbSstyUbWSb NO_AXIS_PTS_X 1 UBYTE NO_AXIS_PTS_Y 2 UBYTE AXIS_PTS_X 3 UBYTE INDEX_INCR DIRECT AXIS_PTS_Y 4 UBYTE INDEX_INCR DIRECT FNC_VALUES 5 SBYTE COLUMN_DIR DIRECT /end RECORD_LAYOUT
/begin RECORD_LAYOUT KfAxUbAyUbSstxUbSstyUbWUb NO_AXIS_PTS_X 1 UBYTE NO_AXIS_PTS_Y 2 UBYTE AXIS_PTS_X 3 UBYTE INDEX_INCR DIRECT AXIS_PTS_Y 4 UBYTE INDEX_INCR DIRECT FNC_VALUES 5 UBYTE COLUMN_DIR DIRECT /end RECORD_LAYOUT
/begin RECORD_LAYOUT KfAxUwAyUwSstxUwSstyUwWUw NO_AXIS_PTS_X 1 UWORD NO_AXIS_PTS_Y 2 UWORD AXIS_PTS_X 3 UWORD INDEX_INCR DIRECT AXIS_PTS_Y 4 UWORD INDEX_INCR DIRECT FNC_VALUES 5 UWORD COLUMN_DIR DIRECT /end RECORD_LAYOUT
/begin RECORD_LAYOUT KlAUbSstUbWSb NO_AXIS_PTS_X 1 UBYTE AXIS_PTS_X 2 UBYTE INDEX_INCR DIRECT FNC_VALUES 3 SBYTE COLUMN_DIR DIRECT /end RECORD_LAYOUT
/begin RECORD_LAYOUT KlAUbSstUbWUb NO_AXIS_PTS_X 1 UBYTE AXIS_PTS_X 2 UBYTE INDEX_INCR DIRECT FNC_VALUES 3 UBYTE COLUMN_DIR DIRECT /end RECORD_LAYOUT
/begin RECORD_LAYOUT KlAUbSstUbWUw NO_AXIS_PTS_X 1 UBYTE AXIS_PTS_X 2 UBYTE INDEX_INCR DIRECT FNC_VALUES 3 UWORD COLUMN_DIR DIRECT /end RECORD_LAYOUT
/begin RECORD_LAYOUT KlAUwSstUwWUw NO_AXIS_PTS_X 1 UWORD AXIS_PTS_X 2 UWORD INDEX_INCR DIRECT FNC_VALUES 3 UWORD COLUMN_DIR DIRECT /end RECORD_LAYOUT
/begin RECORD_LAYOUT KlAxU8SstxS16WS16 NO_AXIS_PTS_X 1 SWORD AXIS_PTS_X 2 SWORD INDEX_INCR DIRECT FNC_VALUES 3 SWORD COLUMN_DIR DIRECT /end RECORD_LAYOUT
/begin RECORD_LAYOUT KlAxU8SstxU16WU16 NO_AXIS_PTS_X 1 UWORD AXIS_PTS_X 2 UWORD INDEX_INCR DIRECT FNC_VALUES 3 UWORD COLUMN_DIR DIRECT /end RECORD_LAYOUT
/begin RECORD_LAYOUT KlAxU8SstxU8WS8 NO_AXIS_PTS_X 1 UBYTE AXIS_PTS_X 2 UBYTE INDEX_INCR DIRECT FNC_VALUES 3 SBYTE COLUMN_DIR DIRECT /end RECORD_LAYOUT
/begin RECORD_LAYOUT KlAxU8SstxU8WU8 NO_AXIS_PTS_X 1 UBYTE AXIS_PTS_X 2 UBYTE INDEX_INCR DIRECT FNC_VALUES 3 UBYTE COLUMN_DIR DIRECT /end RECORD_LAYOUT
/begin RECORD_LAYOUT KwbWU8 FNC_VALUES 1 UBYTE COLUMN_DIR DIRECT /end RECORD_LAYOUT
/begin RECORD_LAYOUT KwUb FNC_VALUES 1 UBYTE COLUMN_DIR DIRECT /end RECORD_LAYOUT
/begin RECORD_LAYOUT KwUw FNC_VALUES 1 UWORD COLUMN_DIR DIRECT /end RECORD_LAYOUT
/begin RECORD_LAYOUT KwWS16 FNC_VALUES 1 SWORD COLUMN_DIR DIRECT /end RECORD_LAYOUT
/begin RECORD_LAYOUT KwWS8 FNC_VALUES 1 SBYTE COLUMN_DIR DIRECT /end RECORD_LAYOUT
/begin RECORD_LAYOUT KwWU16 FNC_VALUES 1 UWORD COLUMN_DIR DIRECT /end RECORD_LAYOUT
/begin RECORD_LAYOUT KwWU8 FNC_VALUES 1 UBYTE COLUMN_DIR DIRECT /end RECORD_LAYOUT
/begin RECORD_LAYOUT SstASwSstSw NO_AXIS_PTS_X 1 SWORD AXIS_PTS_X 2 SWORD INDEX_INCR DIRECT /end RECORD_LAYOUT
/begin RECORD_LAYOUT SstAUbSstUb NO_AXIS_PTS_X 1 UBYTE AXIS_PTS_X 2 UBYTE INDEX_INCR DIRECT /end RECORD_LAYOUT
/begin RECORD_LAYOUT SstAUwSstUw NO_AXIS_PTS_X 1 UWORD AXIS_PTS_X 2 UWORD INDEX_INCR DIRECT /end RECORD_LAYOUT
/end MODULE
/end PROJECT
