ASAP2_VERSION 1 41
/begin PROJECT MSD70 "Spray Guided DI-System with Piezo Injectors for 6-Cylinder"
/begin HEADER "_default_HeaderComment" PROJECT_NO _0B /end HEADER
/begin MODULE _default_ModuleName "_default_ModuleLongIdentifier"
/begin MOD_COMMON "_default_ModCommonComment" DEPOSIT ABSOLUTE BYTE_ORDER MSB_LAST ALIGNMENT_BYTE 1 ALIGNMENT_WORD 2 ALIGNMENT_LONG 2 ALIGNMENT_FLOAT32_IEEE 2 ALIGNMENT_FLOAT64_IEEE 4 /end MOD_COMMON
/begin MEASUREMENT A_quer_abs "" SWORD _CNV_R_R_Def_a_sw_b_570_CM 1 100. -64. 63.998 DISPLAY_IDENTIFIER A_QUER_ABS ECU_ADDRESS 0xd000734a FORMAT "%7.2" /end MEASUREMENT
/begin MEASUREMENT Ba_ist "Istbetriebsart" UBYTE _CNV_S_5_Def_ba_gdi_585_CM 1 100. 0. 8. DISPLAY_IDENTIFIER BA_IST ECU_ADDRESS 0xd00073a5 BIT_MASK 0xFF /end MEASUREMENT
/begin MEASUREMENT Ba_prio "Priorisierte Betriebsart" UBYTE _CNV_S_5_Def_ba_gdi_585_CM 1 100. 0. 8. DISPLAY_IDENTIFIER BA_PRIO ECU_ADDRESS 0xd00073df BIT_MASK 0xFF /end MEASUREMENT
/begin MEASUREMENT Ba_prio_neu "Priorisierte Betriebsart neue Prio" UBYTE _CNV_S_5_Def_ba_gdi_585_CM 1 100. 0. 8. DISPLAY_IDENTIFIER BA_PRIO_NEU ECU_ADDRESS 0xd00073e0 BIT_MASK 0xFF /end MEASUREMENT
/begin MEASUREMENT Ba_prio_tra "aus zweiter Prio gewonnenes Priosignal" UBYTE _CNV_S_5_Def_ba_gdi_585_CM 1 100. 0. 8. DISPLAY_IDENTIFIER BA_PRIO_TRA ECU_ADDRESS 0xd00073e1 BIT_MASK 0xFF /end MEASUREMENT
/begin MEASUREMENT Ba_soll "Sollbetriebsart" UBYTE _CNV_S_5_Def_ba_gdi_585_CM 1 100. 0. 8. DISPLAY_IDENTIFIER BA_SOLL ECU_ADDRESS 0xd00073a8 BIT_MASK 0xFF /end MEASUREMENT
/begin MEASUREMENT Ba_subist "Istbetriebsart" UBYTE _CNV_S_12_Def_ba_gdi_587_CM 1 100. 0. 15. DISPLAY_IDENTIFIER BA_SUBIST ECU_ADDRESS 0xd00073a6 BIT_MASK 0xFF /end MEASUREMENT
/begin MEASUREMENT Ba_subprio "Priorisierte Unterbetriebsart" UBYTE _CNV_S_12_Def_ba_gdi_587_CM 1 100. 0. 15. DISPLAY_IDENTIFIER BA_SUBPRIO ECU_ADDRESS 0xd00073e2 BIT_MASK 0xFF /end MEASUREMENT
/begin MEASUREMENT Ba_subprio_neu "Priorisierte Subbetriebsart neue Prio" UBYTE _CNV_S_12_Def_ba_gdi_587_CM 1 100. 0. 15. DISPLAY_IDENTIFIER BA_SUBPRIO_NEU ECU_ADDRESS 0xd00073e3 BIT_MASK 0xFF /end MEASUREMENT
/begin MEASUREMENT Ba_subprio_tra "Anforderung für Subbetriebsart aus zweiter Prio" UBYTE _CNV_S_12_Def_ba_gdi_587_CM 1 100. 0. 15. DISPLAY_IDENTIFIER BA_SUBPRIO_TRA ECU_ADDRESS 0xd0007406 BIT_MASK 0xFF /end MEASUREMENT
/begin MEASUREMENT Ba_subsoll "Sollbetriebsart" UBYTE _CNV_S_12_Def_ba_gdi_587_CM 1 100. 0. 15. DISPLAY_IDENTIFIER BA_SUBSOLL ECU_ADDRESS 0xd00073a7 BIT_MASK 0xFF /end MEASUREMENT
/begin MEASUREMENT Ba_ueb_gds "aktueller Zustand Uebergang Homogen Schicht)" ULONG _CNV_S_5_Def_ba_enu_588_CM 1 100. 0. 4. DISPLAY_IDENTIFIER BA_UEB_GDS ECU_ADDRESS 0xd00073ca /end MEASUREMENT
/begin MEASUREMENT Ba_vb_nl "Betriebsartverbote" UBYTE _CNV_S_7_Def_bvgdi_589_CM 1 100. 0. 6. DISPLAY_IDENTIFIER BA_VB_NL ECU_ADDRESS 0xd00078d4 BIT_MASK 0xFF /end MEASUREMENT
/begin MEASUREMENT Ba_wu_nl "Betriebsart" UBYTE _CNV_S_5_Def_ba_gdi_585_CM 1 100. 0. 8. DISPLAY_IDENTIFIER BA_WU_NL ECU_ADDRESS 0xd00078d3 BIT_MASK 0xFF /end MEASUREMENT
/begin MEASUREMENT Baprio_HO "Anforderung von applikation" UWORD _CNV_R_R_Def_dez_sl_575_CM 1 100. 0. 65535. DISPLAY_IDENTIFIER BAPRIO_HO ECU_ADDRESS 0xd00073e6 FORMAT "%5.0" /end MEASUREMENT
/begin MEASUREMENT Baprio_HSO "Anforderung von applikation" UWORD _CNV_R_R_Def_dez_sl_575_CM 1 100. 0. 65535. DISPLAY_IDENTIFIER BAPRIO_HSO ECU_ADDRESS 0xd00073e8 FORMAT "%5.0" /end MEASUREMENT
/begin MEASUREMENT Baprio_SO "Anforderung von applikation" UWORD _CNV_R_R_Def_dez_sl_575_CM 1 100. 0. 65535. DISPLAY_IDENTIFIER BAPRIO_SO ECU_ADDRESS 0xd00073ea FORMAT "%5.0" /end MEASUREMENT
/begin MEASUREMENT Baprio_appl "Anforderung von applikation" UWORD _CNV_R_R_Def_dez_sl_575_CM 1 100. 0. 65535. DISPLAY_IDENTIFIER BAPRIO_APPL ECU_ADDRESS 0xd00073ec FORMAT "%5.0" /end MEASUREMENT
/begin MEASUREMENT Baprio_dinotl "Anforderrung von DI Notlauf" UWORD _CNV_R_R_Def_dez_sl_575_CM 1 100. 0. 65535. DISPLAY_IDENTIFIER BAPRIO_DINOTL ECU_ADDRESS 0xd00073ee FORMAT "%5.0" /end MEASUREMENT
/begin MEASUREMENT Baprio_entschw "Eingriff für Entschwefelung" UWORD _CNV_R_R_Def_dez_sl_575_CM 1 100. 0. 65535. DISPLAY_IDENTIFIER BAPRIO_ENTSCHW ECU_ADDRESS 0xd00073f0 FORMAT "%5.0" /end MEASUREMENT
/begin MEASUREMENT Baprio_heiz "Anforderung von Heizleistungseingriff" UWORD _CNV_R_R_Def_dez_sl_575_CM 1 100. 0. 65535. DISPLAY_IDENTIFIER BAPRIO_HEIZ ECU_ADDRESS 0xd00073f2 FORMAT "%5.0" /end MEASUREMENT
/begin MEASUREMENT Baprio_katman1 "Eingriff von Momentenüberwachung" UWORD _CNV_R_R_Def_dez_sl_575_CM 1 100. 0. 65535. DISPLAY_IDENTIFIER BAPRIO_KATMAN1 ECU_ADDRESS 0xd00073f4 FORMAT "%5.0" /end MEASUREMENT
/begin MEASUREMENT Baprio_katman2 "Eingriff von Momentenüberwachung" UWORD _CNV_R_R_Def_dez_sl_575_CM 1 100. 0. 65535. DISPLAY_IDENTIFIER BAPRIO_KATMAN2 ECU_ADDRESS 0xd00073f6 FORMAT "%5.0" /end MEASUREMENT
/begin MEASUREMENT Baprio_katreg "Anforderung von applikation" UWORD _CNV_R_R_Def_dez_sl_575_CM 1 100. 0. 65535. DISPLAY_IDENTIFIER BAPRIO_KATREG ECU_ADDRESS 0xd00073f8 FORMAT "%5.0" /end MEASUREMENT
/begin MEASUREMENT Baprio_mdi "Eingriff von Momentenüberwachung" UWORD _CNV_R_R_Def_dez_sl_575_CM 1 100. 0. 65535. DISPLAY_IDENTIFIER BAPRIO_MDI ECU_ADDRESS 0xd00073fa FORMAT "%5.0" /end MEASUREMENT
/begin MEASUREMENT Baprio_pruef "Anforderung von Sensorpruefung" UWORD _CNV_R_R_Def_dez_sl_575_CM 1 100. 0. 65535. DISPLAY_IDENTIFIER BAPRIO_PRUEF ECU_ADDRESS 0xd00073fc FORMAT "%5.0" /end MEASUREMENT
/begin MEASUREMENT Baprio_stand "Standartanforderung" UWORD _CNV_R_R_Def_dez_sl_575_CM 1 100. 0. 65535. DISPLAY_IDENTIFIER BAPRIO_STAND ECU_ADDRESS 0xd00073fe FORMAT "%5.0" /end MEASUREMENT
/begin MEASUREMENT Baprio_ueh "Anforderderung von Bauteilschutz Uberhitzung" UWORD _CNV_R_R_Def_dez_sl_575_CM 1 100. 0. 65535. DISPLAY_IDENTIFIER BAPRIO_UEH ECU_ADDRESS 0xd0007400 FORMAT "%5.0" /end MEASUREMENT
/begin MEASUREMENT Bav_appl "Verbot von Applikation" UBYTE _CNV_S_7_Def_bvgdi_589_CM 1 100. 0. 6. DISPLAY_IDENTIFIER BAV_APPL ECU_ADDRESS 0xd0007407 BIT_MASK 0xFF /end MEASUREMENT
/begin MEASUREMENT Bav_dinotl "Verbot von Notlauf DI" UBYTE _CNV_S_7_Def_bvgdi_589_CM 1 100. 0. 6. DISPLAY_IDENTIFIER BAV_DINOTL ECU_ADDRESS 0xd0007408 BIT_MASK 0xFF /end MEASUREMENT
/begin MEASUREMENT Bav_mdi "Verbot von Momentenüberwachung" UBYTE _CNV_S_7_Def_bvgdi_589_CM 1 100. 0. 6. DISPLAY_IDENTIFIER BAV_MDI ECU_ADDRESS 0xd0007409 BIT_MASK 0xFF /end MEASUREMENT
/begin MEASUREMENT Bav_prio "Priorisiertes Verbot" UBYTE _CNV_S_7_Def_bvgdi_589_CM 1 100. 0. 6. DISPLAY_IDENTIFIER BAV_PRIO ECU_ADDRESS 0xd000740a BIT_MASK 0xFF /end MEASUREMENT
/begin MEASUREMENT Bav_prio_v "Priorisiertes Verbot Vorab" UBYTE _CNV_S_7_Def_bvgdi_589_CM 1 100. 0. 6. DISPLAY_IDENTIFIER BAV_PRIO_V ECU_ADDRESS 0xd000740b BIT_MASK 0xFF /end MEASUREMENT
/begin MEASUREMENT Bav_ueh "Verbot von Bauteilschutz Überhitzung" UBYTE _CNV_S_7_Def_bvgdi_589_CM 1 100. 0. 6. DISPLAY_IDENTIFIER BAV_UEH ECU_ADDRESS 0xd000740c BIT_MASK 0xFF /end MEASUREMENT
/begin MEASUREMENT Baw_appl "Gesamtwunsch aus Applikation" UBYTE _CNV_R_R_Def_dez_sl_575_CM 1 100. 0. 255. DISPLAY_IDENTIFIER BAW_APPL ECU_ADDRESS 0xd000740d FORMAT "%3.0" /end MEASUREMENT
/begin MEASUREMENT Baw_dinotl "Gesamtwunsch von DI Notlauf" UBYTE _CNV_R_R_Def_dez_sl_575_CM 1 100. 0. 255. DISPLAY_IDENTIFIER BAW_DINOTL ECU_ADDRESS 0xd000740e FORMAT "%3.0" /end MEASUREMENT
/begin MEASUREMENT Baw_entschw "Anforderung für Entschwefelung" UBYTE _CNV_R_R_Def_dez_sl_575_CM 1 100. 0. 255. DISPLAY_IDENTIFIER BAW_ENTSCHW ECU_ADDRESS 0xd000740f FORMAT "%3.0" /end MEASUREMENT
/begin MEASUREMENT Baw_gesamt "Gesamtanforderung aus erster Priorisierung" UBYTE _CNV_R_R_Def_dez_sl_575_CM 1 100. 0. 255. DISPLAY_IDENTIFIER BAW_GESAMT ECU_ADDRESS 0xd0007410 FORMAT "%3.0" /end MEASUREMENT
/begin MEASUREMENT Baw_gesamt_p2 "Gesamtanforderung aus zweiter Priorisierung" UBYTE _CNV_R_R_Def_dez_sl_575_CM 1 100. 0. 255. DISPLAY_IDENTIFIER BAW_GESAMT_P2 ECU_ADDRESS 0xd0007411 FORMAT "%3.0" /end MEASUREMENT
/begin MEASUREMENT Baw_h_hs "" UBYTE _CNV_R_R_Def_dez_sl_575_CM 1 100. 0. 255. DISPLAY_IDENTIFIER BAW_H_HS ECU_ADDRESS 0xd00073ad FORMAT "%3.0" /end MEASUREMENT
/begin MEASUREMENT Baw_h_s "" UBYTE _CNV_R_R_Def_dez_sl_575_CM 1 100. 0. 255. DISPLAY_IDENTIFIER BAW_H_S ECU_ADDRESS 0xd00073a9 FORMAT "%3.0" /end MEASUREMENT
/begin MEASUREMENT Baw_heiz "Gesamtwunsch aus Heizleistungseingriiff" UBYTE _CNV_R_R_Def_dez_sl_575_CM 1 100. 0. 255. DISPLAY_IDENTIFIER BAW_HEIZ ECU_ADDRESS 0xd0007412 FORMAT "%3.0" /end MEASUREMENT
/begin MEASUREMENT Baw_hs_h "" UBYTE _CNV_R_R_Def_dez_sl_575_CM 1 100. 0. 255. DISPLAY_IDENTIFIER BAW_HS_H ECU_ADDRESS 0xd00073ab FORMAT "%3.0" /end MEASUREMENT
/begin MEASUREMENT Baw_hs_s "" UBYTE _CNV_R_R_Def_dez_sl_575_CM 1 100. 0. 255. DISPLAY_IDENTIFIER BAW_HS_S ECU_ADDRESS 0xd00073aa FORMAT "%3.0" /end MEASUREMENT
/begin MEASUREMENT Baw_ist "" UBYTE _CNV_R_R_Def_dez_sl_575_CM 1 100. 0. 255. DISPLAY_IDENTIFIER BAW_IST ECU_ADDRESS 0xd00073af FORMAT "%3.0" /end MEASUREMENT
/begin MEASUREMENT Baw_katman1 "Gesamtwunsch aus Katmanager" UBYTE _CNV_R_R_Def_dez_sl_575_CM 1 100. 0. 255. DISPLAY_IDENTIFIER BAW_KATMAN1 ECU_ADDRESS 0xd0007413 FORMAT "%3.0" /end MEASUREMENT
/begin MEASUREMENT Baw_katman2 "Gesamtwunsch aus Katmanager" UBYTE _CNV_R_R_Def_dez_sl_575_CM 1 100. 0. 255. DISPLAY_IDENTIFIER BAW_KATMAN2 ECU_ADDRESS 0xd0007414 FORMAT "%3.0" /end MEASUREMENT
/begin MEASUREMENT Baw_katreg "Gesamtwunsch aus Kat Regeration" UBYTE _CNV_R_R_Def_dez_sl_575_CM 1 100. 0. 255. DISPLAY_IDENTIFIER BAW_KATREG ECU_ADDRESS 0xd0007415 FORMAT "%3.0" /end MEASUREMENT
/begin MEASUREMENT Baw_mdi "Gesamtwunsch aus Momentenüberwachung" UBYTE _CNV_R_R_Def_dez_sl_575_CM 1 100. 0. 255. DISPLAY_IDENTIFIER BAW_MDI ECU_ADDRESS 0xd0007416 FORMAT "%3.0" /end MEASUREMENT
/begin MEASUREMENT Baw_prio "Gesamte Anforderung aus Priorisierung" UBYTE _CNV_R_R_Def_dez_sl_575_CM 1 100. 0. 255. DISPLAY_IDENTIFIER BAW_PRIO ECU_ADDRESS 0xd00073e4 FORMAT "%3.0" /end MEASUREMENT
/begin MEASUREMENT Baw_prionotl "Wunsch durch Notlauf" UBYTE _CNV_R_R_Def_dez_sl_575_CM 1 100. 0. 255. DISPLAY_IDENTIFIER BAW_PRIONOTL ECU_ADDRESS 0xd0007417 FORMAT "%3.0" /end MEASUREMENT
/begin MEASUREMENT Baw_pruef "Gesamtanforderung aus Sensorprüfung" UBYTE _CNV_R_R_Def_dez_sl_575_CM 1 100. 0. 255. DISPLAY_IDENTIFIER BAW_PRUEF ECU_ADDRESS 0xd0007418 FORMAT "%3.0" /end MEASUREMENT
/begin MEASUREMENT Baw_s_h "" UBYTE _CNV_R_R_Def_dez_sl_575_CM 1 100. 0. 255. DISPLAY_IDENTIFIER BAW_S_H ECU_ADDRESS 0xd00073ae FORMAT "%3.0" /end MEASUREMENT
/begin MEASUREMENT Baw_s_hs "" UBYTE _CNV_R_R_Def_dez_sl_575_CM 1 100. 0. 255. DISPLAY_IDENTIFIER BAW_S_HS ECU_ADDRESS 0xd00073ac FORMAT "%3.0" /end MEASUREMENT
/begin MEASUREMENT Baw_soll "" UBYTE _CNV_R_R_Def_dez_sl_575_CM 1 100. 0. 255. DISPLAY_IDENTIFIER BAW_SOLL ECU_ADDRESS 0xd00073b0 FORMAT "%3.0" /end MEASUREMENT
/begin MEASUREMENT Baw_standart "Standartanforderung" UBYTE _CNV_R_R_Def_dez_sl_575_CM 1 100. 0. 255. DISPLAY_IDENTIFIER BAW_STANDART ECU_ADDRESS 0xd0007419 FORMAT "%3.0" /end MEASUREMENT
/begin MEASUREMENT Baw_ueh "Gesamtanforderung aus Bauteilschutz Überhitzung" UBYTE _CNV_R_R_Def_dez_sl_575_CM 1 100. 0. 255. DISPLAY_IDENTIFIER BAW_UEH ECU_ADDRESS 0xd000741a FORMAT "%3.0" /end MEASUREMENT
/begin MEASUREMENT Baw_umsnotl "Wunsch aus Notlauf" UBYTE _CNV_R_R_Def_dez_sl_575_CM 1 100. 0. 255. DISPLAY_IDENTIFIER BAW_UMSNOTL ECU_ADDRESS 0xd000741b FORMAT "%3.0" /end MEASUREMENT
/begin MEASUREMENT Cnt_ar_aus "" UBYTE _CNV_R_R_Def_dez_sl_575_CM 1 100. 0. 255. DISPLAY_IDENTIFIER CNT_AR_AUS ECU_ADDRESS 0xd00074d9 FORMAT "%3.0" /end MEASUREMENT
/begin MEASUREMENT Dm_jmot "Deltamoment aus Motormassenträgheitsmoment für Automatikgetriebe" SWORD _CNV_R_R_Def_m_sw_q_574_CM 1 100. -3276.8 3276.7 DISPLAY_IDENTIFIER DM_JMOT ECU_ADDRESS 0xd000734c FORMAT "%7.2" /end MEASUREMENT
/begin MEASUREMENT Dmd_gen "Maximaler Momentenanstieg Motor für Generator" SWORD _CNV_R_R_Def_dm_sw__610_CM 1 100. -3276.8 3276.7 DISPLAY_IDENTIFIER DMD_GEN ECU_ADDRESS 0xd00078b6 FORMAT "%7.2" /end MEASUREMENT
/begin MEASUREMENT Dmd_l_max "Maximaler Momentenanstieg Luftpfad" SWORD _CNV_R_R_Def_dm_sw__610_CM 1 100. -3276.8 3276.7 DISPLAY_IDENTIFIER DMD_L_MAX ECU_ADDRESS 0xd00078be FORMAT "%7.2" /end MEASUREMENT
/begin MEASUREMENT Dmd_max "Maximaler Momentenanstieg Motor" SWORD _CNV_R_R_Def_dm_sw__610_CM 1 100. -3276.8 3276.7 DISPLAY_IDENTIFIER DMD_MAX ECU_ADDRESS 0xd00078bc FORMAT "%7.2" /end MEASUREMENT
/begin MEASUREMENT Dmdk "Wunschkupplungsmoment mit LDM-Eingriff und Freischaltung" SWORD _CNV_R_R_Def_m_sw_q_574_CM 1 100. -3276.8 3276.7 DISPLAY_IDENTIFIER DMDK ECU_ADDRESS 0xd00074ac FORMAT "%7.2" /end MEASUREMENT
/begin MEASUREMENT Dmdk_wunsch "Delta zwischen Mdk_wunsch und Moment zur Anschlussdrehzahlregelung" SWORD _CNV_R_R_Def_m_sw_q_574_CM 1 100. -3276.8 3276.7 DISPLAY_IDENTIFIER DMDK_WUNSCH ECU_ADDRESS 0xd00074b2 FORMAT "%7.2" /end MEASUREMENT
/begin MEASUREMENT Dmdkdp "wirksamer Dashpotmomentengradient" SWORD _CNV_R_R_Def_m_sw_q_574_CM 1 100. -3276.8 3276.7 DISPLAY_IDENTIFIER DMDKDP ECU_ADDRESS 0xd000734e FORMAT "%7.2" /end MEASUREMENT
/begin MEASUREMENT Dmdklsd "wirksamer Lastschlagdämpfungsmomentengradient" SWORD _CNV_R_R_Def_m_sw_q_574_CM 1 100. -3276.8 3276.7 DISPLAY_IDENTIFIER DMDKLSD ECU_ADDRESS 0xd0007350 FORMAT "%7.2" /end MEASUREMENT
/begin MEASUREMENT Dmdkw_soll "Kurbelwellensollmoment Gradient" SWORD _CNV_R_R_Def_m_sw_q_574_CM 1 100. -3276.8 3276.7 DISPLAY_IDENTIFIER DMDKW_SOLL ECU_ADDRESS 0xd0007484 FORMAT "%7.2" /end MEASUREMENT
/begin MEASUREMENT Dmdp1 "Dashpotmomentengradient Bereich 1" SWORD _CNV_R_R_Def_m_sw_q_574_CM 1 100. -3276.8 3276.7 DISPLAY_IDENTIFIER DMDP1 ECU_ADDRESS 0xd0007352 FORMAT "%7.2" /end MEASUREMENT
/begin MEASUREMENT Dmdp2 "Dashpotmomentengradient Bereich 2" SWORD _CNV_R_R_Def_m_sw_q_574_CM 1 100. -3276.8 3276.7 DISPLAY_IDENTIFIER DMDP2 ECU_ADDRESS 0xd0007354 FORMAT "%7.2" /end MEASUREMENT
/begin MEASUREMENT Dmdp3 "Dashpotmomentengradient Bereich 3" SWORD _CNV_R_R_Def_m_sw_q_574_CM 1 100. -3276.8 3276.7 DISPLAY_IDENTIFIER DMDP3 ECU_ADDRESS 0xd0007356 FORMAT "%7.2" /end MEASUREMENT
/begin MEASUREMENT Dmdpoff "Deltamoment Dashpotende" SWORD _CNV_R_R_Def_m_sw_q_574_CM 1 100. -3276.8 3276.7 DISPLAY_IDENTIFIER DMDPOFF ECU_ADDRESS 0xd0007358 FORMAT "%7.2" /end MEASUREMENT
/begin MEASUREMENT Dmdpon "Deltamoment Dashpotauslösung" SWORD _CNV_R_R_Def_m_sw_q_574_CM 1 100. -3276.8 3276.7 DISPLAY_IDENTIFIER DMDPON ECU_ADDRESS 0xd000735a FORMAT "%7.2" /end MEASUREMENT
/begin MEASUREMENT Dmls1 "Lastschlagdämpfungsmomentengradient Bereich 1" SWORD _CNV_R_R_Def_m_sw_q_574_CM 1 100. -3276.8 3276.7 DISPLAY_IDENTIFIER DMLS1 ECU_ADDRESS 0xd000735c FORMAT "%7.2" /end MEASUREMENT
/begin MEASUREMENT Dmls2 "Lastschlagdämpfungsmomentengradient Bereich 2" SWORD _CNV_R_R_Def_m_sw_q_574_CM 1 100. -3276.8 3276.7 DISPLAY_IDENTIFIER DMLS2 ECU_ADDRESS 0xd000735e FORMAT "%7.2" /end MEASUREMENT
/begin MEASUREMENT Dmls3 "Lastschlagdämpfungsmomentengradient Bereich 3" SWORD _CNV_R_R_Def_m_sw_q_574_CM 1 100. -3276.8 3276.7 DISPLAY_IDENTIFIER DMLS3 ECU_ADDRESS 0xd0007360 FORMAT "%7.2" /end MEASUREMENT
/begin MEASUREMENT Dmlsdoff "Deltamoment Lastschlagdämpfungsende" SWORD _CNV_R_R_Def_m_sw_q_574_CM 1 100. -3276.8 3276.7 DISPLAY_IDENTIFIER DMLSDOFF ECU_ADDRESS 0xd0007362 FORMAT "%7.2" /end MEASUREMENT
/begin MEASUREMENT Dmlsdon "Deltamoment Lastschlagdämpfungsauslösung" SWORD _CNV_R_R_Def_m_sw_q_574_CM 1 100. -3276.8 3276.7 DISPLAY_IDENTIFIER DMLSDON ECU_ADDRESS 0xd0007364 FORMAT "%7.2" /end MEASUREMENT
/begin MEASUREMENT Dn_gang "Delta Anschlussdrehzahl" SWORD _CNV_R_R_Def_n_sw_q_612_CM 1 100. -32768. 32767. DISPLAY_IDENTIFIER DN_GANG ECU_ADDRESS 0xd00074aa FORMAT "%5.0" /end MEASUREMENT
/begin MEASUREMENT Dps_diff "Delta Soll-Differenz-Druck" SWORD _CNV_R_R_Def_p_sw_q_578_CM 1 100. -1280. 1279.9609 DISPLAY_IDENTIFIER DPS_DIFF ECU_ADDRESS 0xd0007420 FORMAT "%7.2" /end MEASUREMENT
/begin MEASUREMENT Dpsfaktd "Faktor Deltasaugrohrdruck UGD-TD-GD" UBYTE _CNV_R_R_Def_f_ub_b_573_CM 1 100. 0. 0.996 DISPLAY_IDENTIFIER DPSFAKTD ECU_ADDRESS 0xd000738c /end MEASUREMENT
/begin MEASUREMENT Err_notl "" UWORD _CNV_R_R_Def_dez_sl_575_CM 1 100. 0. 65535. DISPLAY_IDENTIFIER ERR_NOTL ECU_ADDRESS 0xc00026c2 FORMAT "%5.0" /end MEASUREMENT
/begin MEASUREMENT Eta_ges_ist "Wirkungsgrad" SWORD _CNV_R_R_Def_eta_sw_628_CM 1 100. 0. 100. DISPLAY_IDENTIFIER ETA_GES_IST ECU_ADDRESS 0xd000750e FORMAT "%8.3" /end MEASUREMENT
/begin MEASUREMENT Eta_hs_ist "Wirkungsgrad homogen schicht mit eingerechneter Zylinderabschaltung" UWORD _CNV_R_R_Def_eta_uw_627_CM 1 100. 0. 199.9969 DISPLAY_IDENTIFIER ETA_HS_IST ECU_ADDRESS 0xd0007514 FORMAT "%8.3" /end MEASUREMENT
/begin MEASUREMENT Eta_ist "Wirkungsgrad für Rk Ba abhängig" UWORD _CNV_R_R_Def_eta_uw_627_CM 1 100. 0. 199.9969 DISPLAY_IDENTIFIER ETA_IST ECU_ADDRESS 0xd0007518 FORMAT "%8.3" /end MEASUREMENT
/begin MEASUREMENT Eta_rk_md "Wirkungsgrad der Lambdahaken einzustellen ist" SWORD _CNV_R_R_Def_eta_sw_617_CM 1 100. -200. 199.9938 DISPLAY_IDENTIFIER ETA_RK_MD ECU_ADDRESS 0xd00078a8 FORMAT "%8.3" /end MEASUREMENT
/begin MEASUREMENT Eta_rk_mdmx "Wirkungsgrad aus La_md_soll" SWORD _CNV_R_R_Def_eta_sw_617_CM 1 100. -200. 199.9938 DISPLAY_IDENTIFIER ETA_RK_MDMX ECU_ADDRESS 0xd0007892 FORMAT "%8.3" /end MEASUREMENT
/begin MEASUREMENT Eta_s_ist "Wirkungsgrad schicht mit eingerechneter Zylinderabschaltung" UWORD _CNV_R_R_Def_eta_uw_627_CM 1 100. 0. 199.9969 DISPLAY_IDENTIFIER ETA_S_IST ECU_ADDRESS 0xd0007516 FORMAT "%8.3" /end MEASUREMENT
/begin MEASUREMENT F_dps_ba "" UBYTE _CNV_R_R_Def_f_ub_b_573_CM 1 100. 0. 0.996 DISPLAY_IDENTIFIER F_DPS_BA ECU_ADDRESS 0xd000739a /end MEASUREMENT
/begin MEASUREMENT F_etawan "" UWORD _CNV_R_R_Def_f_uw_b_579_CM 1 100. 0. 1.9999 DISPLAY_IDENTIFIER F_ETAWAN ECU_ADDRESS 0xd0007386 FORMAT "%14.5" /end MEASUREMENT
/begin MEASUREMENT F_evmod "Faktor Überblendung Mszyl" UBYTE _CNV_R_R_Def_f_ub_b_573_CM 1 100. 0. 0.996 DISPLAY_IDENTIFIER F_EVMOD ECU_ADDRESS 0xd0007399 /end MEASUREMENT
/begin MEASUREMENT F_la_zwmx "Max-Wert für F_lazw_md" UBYTE _CNV_R_R_Def_f_ub_b_573_CM 1 100. 0. 0.996 DISPLAY_IDENTIFIER F_LA_ZWMX ECU_ADDRESS 0xd0007898 /end MEASUREMENT
/begin MEASUREMENT F_lamx_fp "Verhältnis idealer zu realer Luftaufwand" UWORD _CNV_R_R_Def_f_uw_b_579_CM 1 100. 0. 1.9999 DISPLAY_IDENTIFIER F_LAMX_FP ECU_ADDRESS 0xd0007520 FORMAT "%14.5" /end MEASUREMENT
/begin MEASUREMENT F_lazw_md "Faktor Umschaltung schnelle/langsame Momentenumsetzung über Lambda" UBYTE _CNV_R_R_Def_f_ub_b_573_CM 1 100. 0. 0.996 DISPLAY_IDENTIFIER F_LAZW_MD ECU_ADDRESS 0xd0007890 /end MEASUREMENT
/begin MEASUREMENT F_llr_ba "Faktor Umschaltung Leerlaufregler" UBYTE _CNV_R_R_Def_f_ub_b_573_CM 1 100. 0. 0.996 DISPLAY_IDENTIFIER F_LLR_BA ECU_ADDRESS 0xd00073c3 /end MEASUREMENT
/begin MEASUREMENT F_mdi_ba "" UBYTE _CNV_R_R_Def_f_ub_b_573_CM 1 100. 0. 0.996 DISPLAY_IDENTIFIER F_MDI_BA ECU_ADDRESS 0xd000739c /end MEASUREMENT
/begin MEASUREMENT F_mdiop_ba "" UBYTE _CNV_R_R_Def_f_ub_b_573_CM 1 100. 0. 0.996 DISPLAY_IDENTIFIER F_MDIOP_BA ECU_ADDRESS 0xd000739b /end MEASUREMENT
/begin MEASUREMENT F_mdivl "Korrektur Md über La bei VL" SWORD _CNV_R_R_Def_f_sw_b_607_CM 1 100. -8. 7.9997 DISPLAY_IDENTIFIER F_MDIVL ECU_ADDRESS 0xd000753e FORMAT "%9.4" /end MEASUREMENT
/begin MEASUREMENT F_mdres_rgn "-" UWORD _CNV_R_R_Def_f_uw_b_591_CM 1 100. 0. 0.9999 DISPLAY_IDENTIFIER F_MDRES_RGN ECU_ADDRESS 0xd00073a2 FORMAT "%14.5" /end MEASUREMENT
/begin MEASUREMENT F_ml_ba "" UBYTE _CNV_R_R_Def_f_ub_b_573_CM 1 100. 0. 0.996 DISPLAY_IDENTIFIER F_ML_BA ECU_ADDRESS 0xd000739d /end MEASUREMENT
/begin MEASUREMENT F_nst_ba "Faktor Überblendung Nachstart" UBYTE _CNV_R_R_Def_f_ub_b_573_CM 1 100. 0. 0.996 DISPLAY_IDENTIFIER F_NST_BA ECU_ADDRESS 0xd00073c5 /end MEASUREMENT
/begin MEASUREMENT F_reib_ba "Faktor Überblendung Verlustmomente" UBYTE _CNV_R_R_Def_f_ub_b_573_CM 1 100. 0. 0.996 DISPLAY_IDENTIFIER F_REIB_BA ECU_ADDRESS 0xd00073c4 /end MEASUREMENT
/begin MEASUREMENT F_rfmx "Faktor Rf-Eingriff" UWORD _CNV_R_R_Def_f_uw_b_579_CM 1 100. 0. 1.9999 DISPLAY_IDENTIFIER F_RFMX ECU_ADDRESS 0xd0007540 FORMAT "%14.5" /end MEASUREMENT
/begin MEASUREMENT F_rfv_lamx "Faktor: Rf/Rfv_max" UWORD _CNV_R_R_Def_f_uw_b_632_CM 1 100. 0. 255.996 DISPLAY_IDENTIFIER F_RFV_LAMX ECU_ADDRESS 0xd0007526 FORMAT "%8.3" /end MEASUREMENT
/begin MEASUREMENT F_st_ba "Faktor Überblendung Start" UBYTE _CNV_R_R_Def_f_ub_b_573_CM 1 100. 0. 0.996 DISPLAY_IDENTIFIER F_ST_BA ECU_ADDRESS 0xd00073c2 /end MEASUREMENT
/begin MEASUREMENT F_vl_aus "Lastfaktor für Volllastabschaltung" UWORD _CNV_R_R_Def_f_sw_b_608_CM 1 100. 0. 3.9999 DISPLAY_IDENTIFIER F_VL_AUS ECU_ADDRESS 0xd0007522 FORMAT "%14.5" /end MEASUREMENT
/begin MEASUREMENT F_vwi_ba "Faktor Umschaltung Vorlagerungwinkel" UBYTE _CNV_R_R_Def_f_ub_b_573_CM 1 100. 0. 0.996 DISPLAY_IDENTIFIER F_VWI_BA ECU_ADDRESS 0xd000739e /end MEASUREMENT
/begin MEASUREMENT F_wl_ba "Faktor Überblendung Nachstart" UBYTE _CNV_R_R_Def_f_ub_b_573_CM 1 100. 0. 0.996 DISPLAY_IDENTIFIER F_WL_BA ECU_ADDRESS 0xd00073c6 /end MEASUREMENT
/begin MEASUREMENT F_zw_ba "Faktor Umschaltung BA Zündwinkel" UBYTE _CNV_R_R_Def_f_ub_b_573_CM 1 100. 0. 0.996 DISPLAY_IDENTIFIER F_ZW_BA ECU_ADDRESS 0xd00073c7 /end MEASUREMENT
/begin MEASUREMENT Fdmfbt "Faktor dynamische Überblendung UGD-TD-GD" UBYTE _CNV_R_R_Def_f_ub_b_573_CM 1 100. 0. 0.996 DISPLAY_IDENTIFIER FDMFBT ECU_ADDRESS 0xd000738d /end MEASUREMENT
/begin MEASUREMENT Flsdpwgl "Faktor Fahrpedaleinfluß auf Füllung bei Lastschlagdämpfung" UWORD _CNV_R_R_Def_f_uw_b_632_CM 1 100. 0. 255.996 DISPLAY_IDENTIFIER FLSDPWGL ECU_ADDRESS 0xd0007388 FORMAT "%8.3" /end MEASUREMENT
/begin MEASUREMENT Ftrq_wfl_dp "Faktor Verhältnis Moment Füllung zu Zündung bei Dashpot" UWORD _CNV_R_R_Def_f_uw_b_632_CM 1 100. 0. 255.996 DISPLAY_IDENTIFIER FTRQ_WFL_DP ECU_ADDRESS 0xd000738a FORMAT "%8.3" /end MEASUREMENT
/begin MEASUREMENT Gang_soll "" UBYTE _CNV_R_R_Def_dez_sl_575_CM 1 100. 0. 255. DISPLAY_IDENTIFIER GANG_SOLL ECU_ADDRESS 0xd000749a FORMAT "%3.0" /end MEASUREMENT
/begin MEASUREMENT Kl_kuppenable_aus "" UBYTE _CNV_R_R_Def_dez_sl_575_CM 1 100. 0. 255. DISPLAY_IDENTIFIER KL_KUPPENABLE_AUS ECU_ADDRESS 0xd000738e FORMAT "%3.0" /end MEASUREMENT
/begin MEASUREMENT Kl_tasche_aus "Nkw-offset zur Korrektur Tans-Einfluss auf Schallgeschwindigkeit" SWORD _CNV_R_R_Def_n_sw_q_612_CM 1 100. -32768. 32767. DISPLAY_IDENTIFIER KL_TASCHE_AUS ECU_ADDRESS 0xd000753c FORMAT "%5.0" /end MEASUREMENT
/begin MEASUREMENT Kl_tmze_aus "Faktor Einfluss Zylindertemp auf max Füllung" SWORD _CNV_R_R_Def_f_sw_b_607_CM 1 100. -8. 7.9997 DISPLAY_IDENTIFIER KL_TMZE_AUS ECU_ADDRESS 0xd000753a FORMAT "%9.4" /end MEASUREMENT
/begin MEASUREMENT La_md "Lambda um gewünschtes Moment einzustellen" UWORD _CNV_R_R_Def_f_uw_b_594_CM 1 100. 0. 15.9997 DISPLAY_IDENTIFIER LA_MD ECU_ADDRESS 0xd00078a2 FORMAT "%9.4" /end MEASUREMENT
/begin MEASUREMENT La_soll_md "Lambdavorgabe aus Momentenstruktur" UWORD _CNV_R_R_Def_f_uw_b_594_CM 1 100. 0. 15.9997 DISPLAY_IDENTIFIER LA_SOLL_MD ECU_ADDRESS 0xd0007894 FORMAT "%9.4" /end MEASUREMENT
/begin MEASUREMENT La_soll_notl "Lambda-Sollwert aus Notlaufmanager" UWORD _CNV_R_R_Def_f_uw_b_594_CM 1 100. 0. 15.9997 DISPLAY_IDENTIFIER LA_SOLL_NOTL ECU_ADDRESS 0xd00078dc FORMAT "%9.4" /end MEASUREMENT
/begin MEASUREMENT Md_la_mx "Momenten das nicht über Lambda eingestellt werden konnte" SWORD _CNV_R_R_Def_m_sw_q_574_CM 1 100. -3276.8 3276.7 DISPLAY_IDENTIFIER MD_LA_MX ECU_ADDRESS 0xd0007896 FORMAT "%7.2" /end MEASUREMENT
/begin MEASUREMENT Md_na "delta Moment Nebenaggregate" SWORD _CNV_R_R_Def_m_sw_q_574_CM 1 100. -3276.8 3276.7 DISPLAY_IDENTIFIER MD_NA ECU_ADDRESS 0xd00078ae FORMAT "%7.2" /end MEASUREMENT
/begin MEASUREMENT Md_na_ges "delta Moment Nebenaggregate" SWORD _CNV_R_R_Def_m_sw_q_574_CM 1 100. -3276.8 3276.7 DISPLAY_IDENTIFIER MD_NA_GES ECU_ADDRESS 0xd00078b0 FORMAT "%7.2" /end MEASUREMENT
/begin MEASUREMENT Md_na_sum "Summe der Momente aller Nebenaggregate" SWORD _CNV_R_R_Def_m_sw_q_574_CM 1 100. -3276.8 3276.7 DISPLAY_IDENTIFIER MD_NA_SUM ECU_ADDRESS 0xd00078c0 FORMAT "%7.2" /end MEASUREMENT
/begin MEASUREMENT Md_res_bn "Momentenreserve für Generatordynamik" SWORD _CNV_R_R_Def_m_sw_q_574_CM 1 100. -3276.8 3276.7 DISPLAY_IDENTIFIER MD_RES_BN ECU_ADDRESS 0xd00078b4 FORMAT "%7.2" /end MEASUREMENT
/begin MEASUREMENT Md_res_real "Aktuelle Momentenreserve des Motors" SWORD _CNV_R_R_Def_m_sw_q_574_CM 1 100. -3276.8 3276.7 DISPLAY_IDENTIFIER MD_RES_REAL ECU_ADDRESS 0xd00078b8 FORMAT "%7.2" /end MEASUREMENT
/begin MEASUREMENT Md_soll_delta "" SWORD _CNV_R_R_Def_m_sw_q_574_CM 1 100. -3276.8 3276.7 DISPLAY_IDENTIFIER MD_SOLL_DELTA ECU_ADDRESS 0xd000743e FORMAT "%7.2" /end MEASUREMENT
/begin MEASUREMENT Mdi_ar_f "" SWORD _CNV_R_R_Def_m_sw_q_574_CM 1 100. -3276.8 3276.7 DISPLAY_IDENTIFIER MDI_AR_F ECU_ADDRESS 0xd00074cc FORMAT "%7.2" /end MEASUREMENT
/begin MEASUREMENT Mdi_arll "Schneller Momenteneingrif des LL-Reglers und der AR über die Zündung" SWORD _CNV_R_R_Def_m_sw_q_574_CM 1 100. -3276.8 3276.7 DISPLAY_IDENTIFIER MDI_ARLL ECU_ADDRESS 0xd0007442 FORMAT "%7.2" /end MEASUREMENT
/begin MEASUREMENT Mdi_arll_la "Schneller Momenteneingrif des LL-Reglers und der AR über Lambda" SWORD _CNV_R_R_Def_m_sw_q_574_CM 1 100. -3276.8 3276.7 DISPLAY_IDENTIFIER MDI_ARLL_LA ECU_ADDRESS 0xd0007444 FORMAT "%7.2" /end MEASUREMENT
/begin MEASUREMENT Mdi_arll_zw "Schneller Momenteneingrif des LL-Reglers und der AR über die Zündung" SWORD _CNV_R_R_Def_m_sw_q_574_CM 1 100. -3276.8 3276.7 DISPLAY_IDENTIFIER MDI_ARLL_ZW ECU_ADDRESS 0xd0007440 FORMAT "%7.2" /end MEASUREMENT
/begin MEASUREMENT Mdi_bas_korr "Basismoment aus KF_MDIOP_x und Eta_zwve_m um Wirkungsgrad Momentenres korrigiert" SWORD _CNV_R_R_Def_m_sw_q_574_CM 1 100. -3276.8 3276.7 DISPLAY_IDENTIFIER MDI_BAS_KORR ECU_ADDRESS 0xd0007438 FORMAT "%7.2" /end MEASUREMENT
/begin MEASUREMENT Mdi_fzdyn "inneres Moment nach Fahrdynamikfilterung" SWORD _CNV_R_R_Def_m_sw_q_574_CM 1 100. -3276.8 3276.7 DISPLAY_IDENTIFIER MDI_FZDYN ECU_ADDRESS 0xd00074ca FORMAT "%7.2" /end MEASUREMENT
/begin MEASUREMENT Mdi_fzdyn_res "inneres Moment nach Fahrdynamikfilterung mit Momentenreserve" SWORD _CNV_R_R_Def_m_sw_q_574_CM 1 100. -3276.8 3276.7 DISPLAY_IDENTIFIER MDI_FZDYN_RES ECU_ADDRESS 0xd000746a FORMAT "%7.2" /end MEASUREMENT
/begin MEASUREMENT Mdi_la_soll "Momenten das über Lambda eingestellt werden soll" SWORD _CNV_R_R_Def_m_sw_q_574_CM 1 100. -3276.8 3276.7 DISPLAY_IDENTIFIER MDI_LA_SOLL ECU_ADDRESS 0xd0007428 FORMAT "%7.2" /end MEASUREMENT
/begin MEASUREMENT Mdi_la_sollbg "Momenten das über Lambda eingestellt werden soll begrenzt" SWORD _CNV_R_R_Def_m_sw_q_574_CM 1 100. -3276.8 3276.7 DISPLAY_IDENTIFIER MDI_LA_SOLLBG ECU_ADDRESS 0xd00078a6 FORMAT "%7.2" /end MEASUREMENT
/begin MEASUREMENT Mdi_max "maximales inneres Moment" SWORD _CNV_R_R_Def_m_sw_q_574_CM 1 100. -3276.8 3276.7 DISPLAY_IDENTIFIER MDI_MAX ECU_ADDRESS 0xd0007524 FORMAT "%7.2" /end MEASUREMENT
/begin MEASUREMENT Mdi_max_l1 "maximales inneres Moment bei Lambda 1" SWORD _CNV_R_R_Def_m_sw_q_574_CM 1 100. -3276.8 3276.7 DISPLAY_IDENTIFIER MDI_MAX_L1 ECU_ADDRESS 0xd000752a FORMAT "%7.2" /end MEASUREMENT
/begin MEASUREMENT Mdi_max_notl "" SWORD _CNV_R_R_Def_m_sw_q_574_CM 1 100. -3276.8 3276.7 DISPLAY_IDENTIFIER MDI_MAX_NOTL ECU_ADDRESS 0xd00078de FORMAT "%7.2" /end MEASUREMENT
/begin MEASUREMENT Mdi_max_notl_sl "" SLONG _CNV_R_R_Def_m_sw_q_659_CM 1 100. -21474836.48 21474836.47 DISPLAY_IDENTIFIER MDI_MAX_NOTL_SL ECU_ADDRESS 0xd00078e0 FORMAT "%9.2" /end MEASUREMENT
/begin MEASUREMENT Mdi_ml_soll "inneres Sollmoment-über die Luft einzustellen " SWORD _CNV_R_R_Def_m_sw_q_574_CM 1 100. -3276.8 3276.7 DISPLAY_IDENTIFIER MDI_ML_SOLL ECU_ADDRESS 0xd0007430 FORMAT "%7.2" /end MEASUREMENT
/begin MEASUREMENT Mdi_ml_sollvb "Soll-Momenten Luftpfad vor Sicherheitsbegrenzung" SWORD _CNV_R_R_Def_m_sw_q_574_CM 1 100. -3276.8 3276.7 DISPLAY_IDENTIFIER MDI_ML_SOLLVB ECU_ADDRESS 0xd0007426 FORMAT "%7.2" /end MEASUREMENT
/begin MEASUREMENT Mdi_mxnl_min "" SWORD _CNV_R_R_Def_m_sw_q_574_CM 1 100. -3276.8 3276.7 DISPLAY_IDENTIFIER MDI_MXNL_MIN ECU_ADDRESS 0xc00026c0 FORMAT "%7.2" /end MEASUREMENT
/begin MEASUREMENT Mdi_opt "optimales inneres Motormoment" SWORD _CNV_R_R_Def_m_sw_q_574_CM 1 100. -3276.8 3276.7 DISPLAY_IDENTIFIER MDI_OPT ECU_ADDRESS 0xd00078a4 FORMAT "%7.2" /end MEASUREMENT
/begin MEASUREMENT Mdi_opt_1 "optimales inneres Motormoment" SWORD _CNV_R_R_Def_m_sw_q_574_CM 1 100. -3276.8 3276.7 DISPLAY_IDENTIFIER MDI_OPT_1 ECU_ADDRESS 0xd0007510 FORMAT "%7.2" /end MEASUREMENT
/begin MEASUREMENT Mdi_opt_2 "optimales inneres Motormoment" SWORD _CNV_R_R_Def_m_sw_q_574_CM 1 100. -3276.8 3276.7 DISPLAY_IDENTIFIER MDI_OPT_2 ECU_ADDRESS 0xd0007512 FORMAT "%7.2" /end MEASUREMENT
/begin MEASUREMENT Mdi_opt_l1 "optimales inneres Motormoment" SWORD _CNV_R_R_Def_m_sw_q_574_CM 1 100. -3276.8 3276.7 DISPLAY_IDENTIFIER MDI_OPT_L1 ECU_ADDRESS 0xd0007508 FORMAT "%7.2" /end MEASUREMENT
/begin MEASUREMENT Mdi_opt_s "optimales inneres Motormoment im Schichtbetrieb" SWORD _CNV_R_R_Def_m_sw_q_574_CM 1 100. -3276.8 3276.7 DISPLAY_IDENTIFIER MDI_OPT_S ECU_ADDRESS 0xd000750a FORMAT "%7.2" /end MEASUREMENT
/begin MEASUREMENT Mdi_res_dashini "" SWORD _CNV_R_R_Def_m_sw_q_574_CM 1 100. -3276.8 3276.7 DISPLAY_IDENTIFIER MDI_RES_DASHINI ECU_ADDRESS 0xd0007366 FORMAT "%7.2" /end MEASUREMENT
/begin MEASUREMENT Mdi_res_gdi "Momentenreserve für Sprung Homgen und Schicht" SWORD _CNV_R_R_Def_m_sw_q_574_CM 1 100. -3276.8 3276.7 DISPLAY_IDENTIFIER MDI_RES_GDI ECU_ADDRESS 0xd00073a0 FORMAT "%7.2" /end MEASUREMENT
/begin MEASUREMENT Mdi_res_homo "Momentenreserve im Homogenen Betrieb" SWORD _CNV_R_R_Def_m_sw_q_574_CM 1 100. -3276.8 3276.7 DISPLAY_IDENTIFIER MDI_RES_HOMO ECU_ADDRESS 0xd00073c8 FORMAT "%7.2" /end MEASUREMENT
/begin MEASUREMENT Mdi_res_ll "inneres Moment für den Luftpfad mit Momentenreserve und p-Anteil LLR" SWORD _CNV_R_R_Def_m_sw_q_574_CM 1 100. -3276.8 3276.7 DISPLAY_IDENTIFIER MDI_RES_LL ECU_ADDRESS 0xd000744a FORMAT "%7.2" /end MEASUREMENT
/begin MEASUREMENT Mdi_res_lsini "" SWORD _CNV_R_R_Def_m_sw_q_574_CM 1 100. -3276.8 3276.7 DISPLAY_IDENTIFIER MDI_RES_LSINI ECU_ADDRESS 0xd0007368 FORMAT "%7.2" /end MEASUREMENT
/begin MEASUREMENT Mdi_res_mdar "dyn. Momentenreserve" SWORD _CNV_R_R_Def_m_sw_q_574_CM 1 100. -3276.8 3276.7 DISPLAY_IDENTIFIER MDI_RES_MDAR ECU_ADDRESS 0xd0007342 FORMAT "%7.2" /end MEASUREMENT
/begin MEASUREMENT Mdi_rk_soll "Momenten das über Lambda eingestellt werden soll" SWORD _CNV_R_R_Def_m_sw_q_574_CM 1 100. -3276.8 3276.7 DISPLAY_IDENTIFIER MDI_RK_SOLL ECU_ADDRESS 0xd0007422 FORMAT "%7.2" /end MEASUREMENT
/begin MEASUREMENT Mdi_s_istm "inneres Ist-Motormoment im Schichtbetrieb" SWORD _CNV_R_R_Def_m_sw_q_574_CM 1 100. -3276.8 3276.7 DISPLAY_IDENTIFIER MDI_S_ISTM ECU_ADDRESS 0xd000750c FORMAT "%7.2" /end MEASUREMENT
/begin MEASUREMENT Mdi_soll "inneres Sollmoment" SWORD _CNV_R_R_Def_m_sw_q_574_CM 1 100. -3276.8 3276.7 DISPLAY_IDENTIFIER MDI_SOLL ECU_ADDRESS 0xd0007432 FORMAT "%7.2" /end MEASUREMENT
/begin MEASUREMENT Mdi_soll_1 " " SWORD _CNV_R_R_Def_m_sw_q_574_CM 1 100. -3276.8 3276.7 DISPLAY_IDENTIFIER MDI_SOLL_1 ECU_ADDRESS 0xd000742a FORMAT "%7.2" /end MEASUREMENT
/begin MEASUREMENT Mdi_soll_arll "inneres Moment Zündpfad mit LL und Antiruckel" SWORD _CNV_R_R_Def_m_sw_q_574_CM 1 100. -3276.8 3276.7 DISPLAY_IDENTIFIER MDI_SOLL_ARLL ECU_ADDRESS 0xd0007448 FORMAT "%7.2" /end MEASUREMENT
/begin MEASUREMENT Mdi_soll_can "" SWORD _CNV_R_R_Def_m_sw_q_574_CM 1 100. -3276.8 3276.7 DISPLAY_IDENTIFIER MDI_SOLL_CAN ECU_ADDRESS 0xd000745a FORMAT "%7.2" /end MEASUREMENT
/begin MEASUREMENT Mdi_soll_canarll "inneres Moment Zündpfad mit LL und Antiruckel" SWORD _CNV_R_R_Def_m_sw_q_574_CM 1 100. -3276.8 3276.7 DISPLAY_IDENTIFIER MDI_SOLL_CANARLL ECU_ADDRESS 0xd0007446 FORMAT "%7.2" /end MEASUREMENT
/begin MEASUREMENT Mdi_soll_cangdi "" SWORD _CNV_R_R_Def_m_sw_q_574_CM 1 100. -3276.8 3276.7 DISPLAY_IDENTIFIER MDI_SOLL_CANGDI ECU_ADDRESS 0xd000745c FORMAT "%7.2" /end MEASUREMENT
/begin MEASUREMENT Mdi_soll_k "" SWORD _CNV_R_R_Def_m_sw_q_574_CM 1 100. -3276.8 3276.7 DISPLAY_IDENTIFIER MDI_SOLL_K ECU_ADDRESS 0xd0007460 FORMAT "%7.2" /end MEASUREMENT
/begin MEASUREMENT Mdi_soll_kc "" SWORD _CNV_R_R_Def_m_sw_q_574_CM 1 100. -3276.8 3276.7 DISPLAY_IDENTIFIER MDI_SOLL_KC ECU_ADDRESS 0xd0007488 FORMAT "%7.2" /end MEASUREMENT
/begin MEASUREMENT Mdi_soll_kdyn "" SWORD _CNV_R_R_Def_m_sw_q_574_CM 1 100. -3276.8 3276.7 DISPLAY_IDENTIFIER MDI_SOLL_KDYN ECU_ADDRESS 0xd0007462 FORMAT "%7.2" /end MEASUREMENT
/begin MEASUREMENT Mdi_soll_kdync "" SWORD _CNV_R_R_Def_m_sw_q_574_CM 1 100. -3276.8 3276.7 DISPLAY_IDENTIFIER MDI_SOLL_KDYNC ECU_ADDRESS 0xd0007464 FORMAT "%7.2" /end MEASUREMENT
/begin MEASUREMENT Mdi_soll_l "inneres Moment fuer den Luftpfad" SWORD _CNV_R_R_Def_m_sw_q_574_CM 1 100. -3276.8 3276.7 DISPLAY_IDENTIFIER MDI_SOLL_L ECU_ADDRESS 0xd0007436 FORMAT "%7.2" /end MEASUREMENT
/begin MEASUREMENT Mdi_soll_lk "inneres Soll-Moment langsamer Pfad ohne Sicherheitseingriff" SWORD _CNV_R_R_Def_m_sw_q_574_CM 1 100. -3276.8 3276.7 DISPLAY_IDENTIFIER MDI_SOLL_LK ECU_ADDRESS 0xd0007466 FORMAT "%7.2" /end MEASUREMENT
/begin MEASUREMENT Mdi_soll_lkdyn "inneres Soll-Moment langsamer Pfad ohne Sicherheitseingriff" SWORD _CNV_R_R_Def_m_sw_q_574_CM 1 100. -3276.8 3276.7 DISPLAY_IDENTIFIER MDI_SOLL_LKDYN ECU_ADDRESS 0xd0007468 FORMAT "%7.2" /end MEASUREMENT
/begin MEASUREMENT Mdi_soll_min3 "" SWORD _CNV_R_R_Def_m_sw_q_574_CM 1 100. -3276.8 3276.7 DISPLAY_IDENTIFIER MDI_SOLL_MIN3 ECU_ADDRESS 0xd000745e FORMAT "%7.2" /end MEASUREMENT
/begin MEASUREMENT Mdi_sollvb "inneres Sollmoment" SWORD _CNV_R_R_Def_m_sw_q_574_CM 1 100. -3276.8 3276.7 DISPLAY_IDENTIFIER MDI_SOLLVB ECU_ADDRESS 0xd0007434 FORMAT "%7.2" /end MEASUREMENT
/begin MEASUREMENT Mdi_wunsch "Inneres Fahrerwunschmoment mit Begrenzung ohne Eingriffe" SWORD _CNV_R_R_Def_m_sw_q_574_CM 1 100. -3276.8 3276.7 DISPLAY_IDENTIFIER MDI_WUNSCH ECU_ADDRESS 0xd000746c FORMAT "%7.2" /end MEASUREMENT
/begin MEASUREMENT Mdi_zw_rampe "" SWORD _CNV_R_R_Def_m_sw_q_574_CM 1 100. -3276.8 3276.7 DISPLAY_IDENTIFIER MDI_ZW_RAMPE ECU_ADDRESS 0xd000743c FORMAT "%7.2" /end MEASUREMENT
/begin MEASUREMENT Mdi_zw_soll "inneres Sollmoment-über den Zw einzustellen " SWORD _CNV_R_R_Def_m_sw_q_574_CM 1 100. -3276.8 3276.7 DISPLAY_IDENTIFIER MDI_ZW_SOLL ECU_ADDRESS 0xd000742c FORMAT "%7.2" /end MEASUREMENT
/begin MEASUREMENT Mdi_zw_sollcan "inneres Sollmoment-über den Zw einzustellen " SWORD _CNV_R_R_Def_m_sw_q_574_CM 1 100. -3276.8 3276.7 DISPLAY_IDENTIFIER MDI_ZW_SOLLCAN ECU_ADDRESS 0xd000742e FORMAT "%7.2" /end MEASUREMENT
/begin MEASUREMENT Mdi_zw_sollvb "Soll-Momenten Zündpfad vor Sicherheitsbegrenzung" SWORD _CNV_R_R_Def_m_sw_q_574_CM 1 100. -3276.8 3276.7 DISPLAY_IDENTIFIER MDI_ZW_SOLLVB ECU_ADDRESS 0xd0007424 FORMAT "%7.2" /end MEASUREMENT
/begin MEASUREMENT Mdk_dash "Kurbelwellenmoment Dashpot" SWORD _CNV_R_R_Def_m_sw_q_574_CM 1 100. -3276.8 3276.7 DISPLAY_IDENTIFIER MDK_DASH ECU_ADDRESS 0xd000736a FORMAT "%7.2" /end MEASUREMENT
/begin MEASUREMENT Mdk_dp_o "Schwelle Dashpotmoment > Bereich 2" SWORD _CNV_R_R_Def_m_sw_q_574_CM 1 100. -3276.8 3276.7 DISPLAY_IDENTIFIER MDK_DP_O ECU_ADDRESS 0xd000736c FORMAT "%7.2" /end MEASUREMENT
/begin MEASUREMENT Mdk_dp_u "Schwelle Dashpotmoment <= Bereich 1" SWORD _CNV_R_R_Def_m_sw_q_574_CM 1 100. -3276.8 3276.7 DISPLAY_IDENTIFIER MDK_DP_U ECU_ADDRESS 0xd000736e FORMAT "%7.2" /end MEASUREMENT
/begin MEASUREMENT Mdk_ext_min "Reduktion Gesamtmoment" SWORD _CNV_R_R_Def_m_sw_q_574_CM 1 100. -3276.8 3276.7 DISPLAY_IDENTIFIER MDK_EXT_MIN ECU_ADDRESS 0xd000747e FORMAT "%7.2" /end MEASUREMENT
/begin MEASUREMENT Mdk_fw "Wunschkupplungsmoment Fahrer/FGR" SWORD _CNV_R_R_Def_m_sw_q_574_CM 1 100. -3276.8 3276.7 DISPLAY_IDENTIFIER MDK_FW ECU_ADDRESS 0xd00074b4 FORMAT "%7.2" /end MEASUREMENT
/begin MEASUREMENT Mdk_fzdyn "Wunschkupplungsmoment vor Fahrdynamikfilterung" SWORD _CNV_R_R_Def_m_sw_q_574_CM 1 100. -3276.8 3276.7 DISPLAY_IDENTIFIER MDK_FZDYN ECU_ADDRESS 0xd00074ce FORMAT "%7.2" /end MEASUREMENT
/begin MEASUREMENT Mdk_iwfdp "Initialisierungswert Dashpotfilter" SWORD _CNV_R_R_Def_m_sw_q_574_CM 1 100. -3276.8 3276.7 DISPLAY_IDENTIFIER MDK_IWFDP ECU_ADDRESS 0xd0007370 FORMAT "%7.2" /end MEASUREMENT
/begin MEASUREMENT Mdk_iwflsd "Initialisierungswert Lastschlagdämpfungsfilter" SWORD _CNV_R_R_Def_m_sw_q_574_CM 1 100. -3276.8 3276.7 DISPLAY_IDENTIFIER MDK_IWFLSD ECU_ADDRESS 0xd0007372 FORMAT "%7.2" /end MEASUREMENT
/begin MEASUREMENT Mdk_l1 "" SWORD _CNV_R_R_Def_m_sw_q_574_CM 1 100. -3276.8 3276.7 DISPLAY_IDENTIFIER MDK_L1 ECU_ADDRESS 0xd000747a FORMAT "%7.2" /end MEASUREMENT
/begin MEASUREMENT Mdk_l2 "" SWORD _CNV_R_R_Def_m_sw_q_574_CM 1 100. -3276.8 3276.7 DISPLAY_IDENTIFIER MDK_L2 ECU_ADDRESS 0xd000747c FORMAT "%7.2" /end MEASUREMENT
/begin MEASUREMENT Mdk_lsd "Kurbelwellenmoment Lastschlagdämpfung" SWORD _CNV_R_R_Def_m_sw_q_574_CM 1 100. -3276.8 3276.7 DISPLAY_IDENTIFIER MDK_LSD ECU_ADDRESS 0xd0007374 FORMAT "%7.2" /end MEASUREMENT
/begin MEASUREMENT Mdk_lsd_ag "Kurbelwellenmoment Lastschlagdämpfung Automatikgetriebe" SWORD _CNV_R_R_Def_m_sw_q_574_CM 1 100. -3276.8 3276.7 DISPLAY_IDENTIFIER MDK_LSD_AG ECU_ADDRESS 0xd0007376 FORMAT "%7.2" /end MEASUREMENT
/begin MEASUREMENT Mdk_lsd_o "Schwelle Lastschlagdämpfungsmoment >= Bereich 2" SWORD _CNV_R_R_Def_m_sw_q_574_CM 1 100. -3276.8 3276.7 DISPLAY_IDENTIFIER MDK_LSD_O ECU_ADDRESS 0xd0007378 FORMAT "%7.2" /end MEASUREMENT
/begin MEASUREMENT Mdk_lsd_u "Schwelle Lastschlagdämpfungsbereich < Bereich 1" SWORD _CNV_R_R_Def_m_sw_q_574_CM 1 100. -3276.8 3276.7 DISPLAY_IDENTIFIER MDK_LSD_U ECU_ADDRESS 0xd000737a FORMAT "%7.2" /end MEASUREMENT
/begin MEASUREMENT Mdk_lsd_wakor "" SWORD _CNV_R_R_Def_m_sw_q_574_CM 1 100. -3276.8 3276.7 DISPLAY_IDENTIFIER MDK_LSD_WAKOR ECU_ADDRESS 0xd000737c FORMAT "%7.2" /end MEASUREMENT
/begin MEASUREMENT Mdk_max "maximales Kupplungsmoment" SWORD _CNV_R_R_Def_m_sw_q_574_CM 1 100. -3276.8 3276.7 DISPLAY_IDENTIFIER MDK_MAX ECU_ADDRESS 0xd000752c FORMAT "%7.2" /end MEASUREMENT
/begin MEASUREMENT Mdk_max_real "maximales Kupplungsmoment aus realem Luftaufwand" SWORD _CNV_R_R_Def_m_sw_q_574_CM 1 100. -3276.8 3276.7 DISPLAY_IDENTIFIER MDK_MAX_REAL ECU_ADDRESS 0xd0007532 FORMAT "%7.2" /end MEASUREMENT
/begin MEASUREMENT Mdk_min_res "min Moment mit ASR" SWORD _CNV_R_R_Def_m_sw_q_574_CM 1 100. -3276.8 3276.7 DISPLAY_IDENTIFIER MDK_MIN_RES ECU_ADDRESS 0xd0007480 FORMAT "%7.2" /end MEASUREMENT
/begin MEASUREMENT Mdk_s1 "" SWORD _CNV_R_R_Def_m_sw_q_574_CM 1 100. -3276.8 3276.7 DISPLAY_IDENTIFIER MDK_S1 ECU_ADDRESS 0xd0007476 FORMAT "%7.2" /end MEASUREMENT
/begin MEASUREMENT Mdk_s2 "" SWORD _CNV_R_R_Def_m_sw_q_574_CM 1 100. -3276.8 3276.7 DISPLAY_IDENTIFIER MDK_S2 ECU_ADDRESS 0xd0007478 FORMAT "%7.2" /end MEASUREMENT
/begin MEASUREMENT Mdk_soll "Kupplungssollmoment schnell" SWORD _CNV_R_R_Def_m_sw_q_574_CM 1 100. -3276.8 3276.7 DISPLAY_IDENTIFIER MDK_SOLL ECU_ADDRESS 0xd0007456 FORMAT "%7.2" /end MEASUREMENT
/begin MEASUREMENT Mdk_soll_l "Kupplungssollmoment langsam" SWORD _CNV_R_R_Def_m_sw_q_574_CM 1 100. -3276.8 3276.7 DISPLAY_IDENTIFIER MDK_SOLL_L ECU_ADDRESS 0xd0007458 FORMAT "%7.2" /end MEASUREMENT
/begin MEASUREMENT Mdk_soll_min1 "" SWORD _CNV_R_R_Def_m_sw_q_574_CM 1 100. -3276.8 3276.7 DISPLAY_IDENTIFIER MDK_SOLL_MIN1 ECU_ADDRESS 0xd0007472 FORMAT "%7.2" /end MEASUREMENT
/begin MEASUREMENT Mdk_soll_min1c "" SWORD _CNV_R_R_Def_m_sw_q_574_CM 1 100. -3276.8 3276.7 DISPLAY_IDENTIFIER MDK_SOLL_MIN1C ECU_ADDRESS 0xd0007474 FORMAT "%7.2" /end MEASUREMENT
/begin MEASUREMENT Mdk_soll_plus "" SWORD _CNV_R_R_Def_m_sw_q_574_CM 1 100. -3276.8 3276.7 DISPLAY_IDENTIFIER MDK_SOLL_PLUS ECU_ADDRESS 0xd0007470 FORMAT "%7.2" /end MEASUREMENT
/begin MEASUREMENT Mdk_ul_mx "" SWORD _CNV_R_R_Def_m_sw_q_574_CM 1 100. -3276.8 3276.7 DISPLAY_IDENTIFIER MDK_UL_MX ECU_ADDRESS 0xd000748a FORMAT "%7.2" /end MEASUREMENT
/begin MEASUREMENT Mdk_w_f "Wunschkurbelwellenmoment nach Fahrdynamikfilterung ohne Wandlerverlustkompensation" SWORD _CNV_R_R_Def_m_sw_q_574_CM 1 100. -3276.8 3276.7 DISPLAY_IDENTIFIER MDK_W_F ECU_ADDRESS 0xd000737e FORMAT "%7.2" /end MEASUREMENT
/begin MEASUREMENT Mdk_wunsch "Wunschkupplungsmoment vor Fahrdynamikfilterung" SWORD _CNV_R_R_Def_m_sw_q_574_CM 1 100. -3276.8 3276.7 DISPLAY_IDENTIFIER MDK_WUNSCH ECU_ADDRESS 0xd000749c FORMAT "%7.2" /end MEASUREMENT
/begin MEASUREMENT Mdk_wunsch_cnt "Schaltwahrscheinlichkeit" UBYTE _CNV_R_R_Def_dez_sl_575_CM 1 100. 0. 255. DISPLAY_IDENTIFIER MDK_WUNSCH_CNT ECU_ADDRESS 0xd00074a3 FORMAT "%3.0" /end MEASUREMENT
/begin MEASUREMENT Mdk_wunsch_d "" SWORD _CNV_R_R_Def_m_sw_q_574_CM 1 100. -3276.8 3276.7 DISPLAY_IDENTIFIER MDK_WUNSCH_D ECU_ADDRESS 0xd0007344 FORMAT "%7.2" /end MEASUREMENT
/begin MEASUREMENT Mdk_wunsch_filt "Kupplungsmoment nach Fahrdynamikfilterung" SWORD _CNV_R_R_Def_m_sw_q_574_CM 1 100. -3276.8 3276.7 DISPLAY_IDENTIFIER MDK_WUNSCH_FILT ECU_ADDRESS 0xd00074c8 FORMAT "%7.2" /end MEASUREMENT
/begin MEASUREMENT Mdk_wunsch_grad "Delta Mdk_wunsch im 10ms_Raster über 40ms gerechnet" SWORD _CNV_R_R_Def_dm_sw__610_CM 1 100. -3276.8 3276.7 DISPLAY_IDENTIFIER MDK_WUNSCH_GRAD ECU_ADDRESS 0xd00074a0 FORMAT "%7.2" /end MEASUREMENT
/begin MEASUREMENT Mdk_wunsch_gradmx "" SWORD _CNV_R_R_Def_m_sw_q_574_CM 1 100. -3276.8 3276.7 DISPLAY_IDENTIFIER MDK_WUNSCH_GRADMX ECU_ADDRESS 0xd0007380 FORMAT "%7.2" /end MEASUREMENT
/begin MEASUREMENT Mdk_wunsch_l "" SWORD _CNV_R_R_Def_m_sw_q_574_CM 1 100. -3276.8 3276.7 DISPLAY_IDENTIFIER MDK_WUNSCH_L ECU_ADDRESS 0xd0007346 FORMAT "%7.2" /end MEASUREMENT
/begin MEASUREMENT Mdk_wunsch_proz "rel Momentenwunsch" SWORD _CNV_R_R_Def_f_uw_b_579_CM 1 100. -1. 0.9999 DISPLAY_IDENTIFIER MDK_WUNSCH_PROZ ECU_ADDRESS 0xd00074a4 FORMAT "%14.5" /end MEASUREMENT
/begin MEASUREMENT Mdk_wunsch_ref_hsa "" SWORD _CNV_R_R_Def_m_sw_q_574_CM 1 100. -3276.8 3276.7 DISPLAY_IDENTIFIER MDK_WUNSCH_REF_HSA ECU_ADDRESS 0xd0007382 FORMAT "%7.2" /end MEASUREMENT
/begin MEASUREMENT Mdk_wunsch_ref_sa "" SWORD _CNV_R_R_Def_m_sw_q_574_CM 1 100. -3276.8 3276.7 DISPLAY_IDENTIFIER MDK_WUNSCH_REF_SA ECU_ADDRESS 0xd0007384 FORMAT "%7.2" /end MEASUREMENT
/begin MEASUREMENT Mdk_wunsch_vb "Wunschkupplungsmoment vor Begrenzung" SWORD _CNV_R_R_Def_m_sw_q_574_CM 1 100. -3276.8 3276.7 DISPLAY_IDENTIFIER MDK_WUNSCH_VB ECU_ADDRESS 0xd00074ae FORMAT "%7.2" /end MEASUREMENT
/begin MEASUREMENT Mdk_wunsch_vbmrad "Wunschkupplungsmoment vor Begrenzung mit Mdk_wunsch_rad" SWORD _CNV_R_R_Def_m_sw_q_574_CM 1 100. -3276.8 3276.7 DISPLAY_IDENTIFIER MDK_WUNSCH_VBMRAD ECU_ADDRESS 0xd00074b0 FORMAT "%7.2" /end MEASUREMENT
/begin MEASUREMENT Mdkw_soll "Kurbelwellensollmoment schnell" SWORD _CNV_R_R_Def_m_sw_q_574_CM 1 100. -3276.8 3276.7 DISPLAY_IDENTIFIER MDKW_SOLL ECU_ADDRESS 0xd0007482 FORMAT "%7.2" /end MEASUREMENT
/begin MEASUREMENT Mdkw_soll_l "Kurbelwellensollmoment langsam" SWORD _CNV_R_R_Def_m_sw_q_574_CM 1 100. -3276.8 3276.7 DISPLAY_IDENTIFIER MDKW_SOLL_L ECU_ADDRESS 0xd0007486 FORMAT "%7.2" /end MEASUREMENT
/begin MEASUREMENT N_filt "" SWORD _CNV_R_R_Def_n_sw_q_612_CM 1 100. -32768. 32767. DISPLAY_IDENTIFIER N_FILT ECU_ADDRESS 0xd00074e6 FORMAT "%5.0" /end MEASUREMENT
/begin MEASUREMENT N_filt_abs "" SWORD _CNV_R_R_Def_n_sw_q_612_CM 1 100. -32768. 32767. DISPLAY_IDENTIFIER N_FILT_ABS ECU_ADDRESS 0xd00074e2 FORMAT "%5.0" /end MEASUREMENT
/begin MEASUREMENT N_filt_alt "" SWORD _CNV_R_R_Def_n_sw_q_612_CM 1 100. -32768. 32767. DISPLAY_IDENTIFIER N_FILT_ALT ECU_ADDRESS 0xd00074e4 FORMAT "%5.0" /end MEASUREMENT
/begin MEASUREMENT N_filt_bp "" SWORD _CNV_R_R_Def_n_sw_q_612_CM 1 100. -32768. 32767. DISPLAY_IDENTIFIER N_FILT_BP ECU_ADDRESS 0xd00074e8 FORMAT "%5.0" /end MEASUREMENT
/begin MEASUREMENT N_filt_tp "" SWORD _CNV_R_R_Def_n_sw_q_612_CM 1 100. -32768. 32767. DISPLAY_IDENTIFIER N_FILT_TP ECU_ADDRESS 0xd00074ea FORMAT "%5.0" ARRAY_SIZE 2 MATRIX_DIM 2 1 1 /end MEASUREMENT
/begin MEASUREMENT N_gang_neu "Motordrehzahl nach Schaltung" SWORD _CNV_R_R_Def_n_sw_q_612_CM 1 100. -32768. 32767. DISPLAY_IDENTIFIER N_GANG_NEU ECU_ADDRESS 0xd000749e FORMAT "%5.0" /end MEASUREMENT
/begin MEASUREMENT Na_bnanteil "Anteil Motordynamik für Generator" UBYTE _CNV_R_R_Def_f_ub_b_625_CM 1 100. 0. 1.9921 DISPLAY_IDENTIFIER NA_BNANTEIL ECU_ADDRESS 0xd00078ad /end MEASUREMENT
/begin MEASUREMENT Na_priobn "Prio Bordnetzspannung" UWORD _CNV_R_R_Def_dez_sl_575_CM 1 100. 0. 65535. DISPLAY_IDENTIFIER NA_PRIOBN ECU_ADDRESS 0xd00078b2 FORMAT "%5.0" /end MEASUREMENT
/begin MEASUREMENT Nmax_ba "Maximale Drehzahl der Betriebsart" SWORD _CNV_R_R_Def_n_sw_q_612_CM 1 100. -32768. 32767. DISPLAY_IDENTIFIER NMAX_BA ECU_ADDRESS 0xd00073be FORMAT "%5.0" /end MEASUREMENT
/begin MEASUREMENT Nmax_notl "Maximale Drehzahl der Betriebsart aus Notlaufmanager" SWORD _CNV_R_R_Def_n_sw_q_612_CM 1 100. -32768. 32767. DISPLAY_IDENTIFIER NMAX_NOTL ECU_ADDRESS 0xd00078da FORMAT "%5.0" /end MEASUREMENT
/begin MEASUREMENT Notl_wahl "" UBYTE _CNV_R_R_Def_dez_sl_575_CM 1 100. 0. 255. DISPLAY_IDENTIFIER NOTL_WAHL ECU_ADDRESS 0xc00026bc FORMAT "%3.0" /end MEASUREMENT
/begin MEASUREMENT Ntnkw "Quotient Wandlerturbinendrehzahl/Motordrehzahl" UBYTE _CNV_R_R_Def_f_ub_b_670_CM 1 100. 0. 3.9843 DISPLAY_IDENTIFIER NTNKW ECU_ADDRESS 0xd000738f FORMAT "%5.2" /end MEASUREMENT
/begin MEASUREMENT P_ar "" UBYTE _CNV_R_R_Def_f_ub_b_670_CM 1 100. 0. 3.9843 DISPLAY_IDENTIFIER P_AR ECU_ADDRESS 0xd00074da FORMAT "%5.2" /end MEASUREMENT
/begin MEASUREMENT Prio_sieg "Priorität der ausgewählten BA" UBYTE _CNV_R_R_Def_dez_sl_575_CM 1 100. 0. 255. DISPLAY_IDENTIFIER PRIO_SIEG ECU_ADDRESS 0xd000741c FORMAT "%3.0" /end MEASUREMENT
/begin MEASUREMENT Pwg_grad "Delta Pedalwertgeber im 10ms_Raster gerechnet" SWORD _CNV_R_R_Def_pwggrd_690_CM 1 100. -20000. 19999.3896 DISPLAY_IDENTIFIER PWG_GRAD ECU_ADDRESS 0xd00074c6 FORMAT "%8.3" /end MEASUREMENT
/begin MEASUREMENT Rf_dvvt_max "" SWORD _CNV_R_R_Def_rf_sw__616_CM 1 100. -327.68 327.67 DISPLAY_IDENTIFIER RF_DVVT_MAX ECU_ADDRESS 0xd0007530 FORMAT "%9.4" /end MEASUREMENT
/begin MEASUREMENT Rf_egr_hs "" SWORD _CNV_R_R_Def_rf_sw__616_CM 1 100. -327.68 327.67 DISPLAY_IDENTIFIER RF_EGR_HS ECU_ADDRESS 0xd00073bc FORMAT "%9.4" /end MEASUREMENT
/begin MEASUREMENT Rf_tev_hs "" SWORD _CNV_R_R_Def_rf_sw__616_CM 1 100. -327.68 327.67 DISPLAY_IDENTIFIER RF_TEV_HS ECU_ADDRESS 0xd00073ba FORMAT "%9.4" /end MEASUREMENT
/begin MEASUREMENT Rf_tev_s "" SWORD _CNV_R_R_Def_rf_sw__616_CM 1 100. -327.68 327.67 DISPLAY_IDENTIFIER RF_TEV_S ECU_ADDRESS 0xd00073b8 FORMAT "%9.4" /end MEASUREMENT
/begin MEASUREMENT Rf_tim_mx "begrenztes max Rf" SWORD _CNV_R_R_Def_rf_sw__616_CM 1 100. -327.68 327.67 DISPLAY_IDENTIFIER RF_TIM_MX ECU_ADDRESS 0xd0007534 FORMAT "%9.4" /end MEASUREMENT
/begin MEASUREMENT Rf_umax "rel Fuellung bei Vollast unter Normbed vor Begrenzung" SWORD _CNV_R_R_Def_rf_sw__616_CM 1 100. -327.68 327.67 DISPLAY_IDENTIFIER RF_UMAX ECU_ADDRESS 0xd000751e FORMAT "%9.4" /end MEASUREMENT
/begin MEASUREMENT Rf_vl "rel Fuellung bei Vollast unter Normbed" SWORD _CNV_R_R_Def_rf_sw__616_CM 1 100. -327.68 327.67 DISPLAY_IDENTIFIER RF_VL ECU_ADDRESS 0xd000752e FORMAT "%9.4" /end MEASUREMENT
/begin MEASUREMENT Rf_vl_ob "rel Fuellung bei Vollast unter Normbed vor Begrenzung" SWORD _CNV_R_R_Def_rf_sw__616_CM 1 100. -327.68 327.67 DISPLAY_IDENTIFIER RF_VL_OB ECU_ADDRESS 0xd0007536 FORMAT "%9.4" /end MEASUREMENT
/begin MEASUREMENT Rf_vl_obatl "rel  Fuellung bei Vollast unter Normbed vor Begrenzung" SWORD _CNV_R_R_Def_rf_sw__616_CM 1 100. -327.68 327.67 DISPLAY_IDENTIFIER RF_VL_OBATL ECU_ADDRESS 0xd0007546 FORMAT "%9.4" /end MEASUREMENT
/begin MEASUREMENT Rfv_max "rel Fuellung bei Vollast unter Normbed mit Korrektur über Zylindertemperatur" SWORD _CNV_R_R_Def_rf_sw__616_CM 1 100. -327.68 327.67 DISPLAY_IDENTIFIER RFV_MAX ECU_ADDRESS 0xd0007538 FORMAT "%9.4" /end MEASUREMENT
/begin MEASUREMENT Rfv_vl_roh "rel Fuellung bei Vollast unter Normbed" SWORD _CNV_R_R_Def_rf_sw__616_CM 1 100. -327.68 327.67 DISPLAY_IDENTIFIER RFV_VL_ROH ECU_ADDRESS 0xd0007528 FORMAT "%9.4" /end MEASUREMENT
/begin MEASUREMENT Rk_opt_ist "" SWORD _CNV_R_R_Def_rk_sw__697_CM 1 100. -1600. 1599.9511 DISPLAY_IDENTIFIER RK_OPT_IST ECU_ADDRESS 0xd000751a FORMAT "%8.3" /end MEASUREMENT
/begin MEASUREMENT Rk_soll_kr "" SWORD _CNV_R_R_Def_rk_sw__697_CM 1 100. -1600. 1599.9511 DISPLAY_IDENTIFIER RK_SOLL_KR ECU_ADDRESS 0xd00073c0 FORMAT "%8.3" /end MEASUREMENT
/begin MEASUREMENT Rk_ueb "relativer Gemischanteil nach Sprung in Homogen mit Korrektur" SWORD _CNV_R_R_Def_rk_sw__698_CM 1 100. -16. 15.9995 DISPLAY_IDENTIFIER RK_UEB ECU_ADDRESS 0xd00073d0 FORMAT "%9.4" /end MEASUREMENT
/begin MEASUREMENT Rk_ueb_ok "relativer Gemischanteil nach Sprung in Homogen ohne Korrektur" SWORD _CNV_R_R_Def_rk_sw__698_CM 1 100. -16. 15.9995 DISPLAY_IDENTIFIER RK_UEB_OK ECU_ADDRESS 0xd00073ce FORMAT "%9.4" /end MEASUREMENT
/begin MEASUREMENT Rt_bastat_h "Relative Zeit Homogen-Betrieb aktueller Motorlauf" UWORD _CNV_R_R_Def_f_uw_b_576_CM 1 100. 0. 99.9984 DISPLAY_IDENTIFIER RT_BASTAT_H ECU_ADDRESS 0xc00026cc FORMAT "%8.3" /end MEASUREMENT
/begin MEASUREMENT Rt_bastat_hs "Relative Zeit Homogen-Schicht- Betrieb aktueller Motorlauf" UWORD _CNV_R_R_Def_f_uw_b_576_CM 1 100. 0. 99.9984 DISPLAY_IDENTIFIER RT_BASTAT_HS ECU_ADDRESS 0xc00026ce FORMAT "%8.3" /end MEASUREMENT
/begin MEASUREMENT Rt_bastat_s "Relative Zeit Schicht-Betrieb aktueller Motorlauf" UWORD _CNV_R_R_Def_f_uw_b_576_CM 1 100. 0. 99.9984 DISPLAY_IDENTIFIER RT_BASTAT_S ECU_ADDRESS 0xc00026d0 FORMAT "%8.3" /end MEASUREMENT
/begin MEASUREMENT Rt_bastat_sa "Relative Zeit Homogen-Betrieb aktueller Motorlauf" UWORD _CNV_R_R_Def_f_uw_b_576_CM 1 100. 0. 99.9984 DISPLAY_IDENTIFIER RT_BASTAT_SA ECU_ADDRESS 0xc00026d2 FORMAT "%8.3" /end MEASUREMENT
/begin MEASUREMENT Rt_bastatg_h "Relative Zeit Homogen-Betrieb gesamter Motorlauf" UWORD _CNV_R_R_Def_f_uw_b_576_CM 1 100. 0. 99.9984 DISPLAY_IDENTIFIER RT_BASTATG_H ECU_ADDRESS 0xc00026c4 FORMAT "%8.3" /end MEASUREMENT
/begin MEASUREMENT Rt_bastatg_hs "Relative Zeit Homogen-Schicht-Betrieb gesamter Motorlauf" UWORD _CNV_R_R_Def_f_uw_b_576_CM 1 100. 0. 99.9984 DISPLAY_IDENTIFIER RT_BASTATG_HS ECU_ADDRESS 0xc00026c6 FORMAT "%8.3" /end MEASUREMENT
/begin MEASUREMENT Rt_bastatg_s "Relative Zeit Schicht-Betrieb gesamter Motorlauf" UWORD _CNV_R_R_Def_f_uw_b_576_CM 1 100. 0. 99.9984 DISPLAY_IDENTIFIER RT_BASTATG_S ECU_ADDRESS 0xc00026c8 FORMAT "%8.3" /end MEASUREMENT
/begin MEASUREMENT Rt_bastatg_sa "Relative Zeit Homogen-Betrieb gesamter Motorlauf" UWORD _CNV_R_R_Def_f_uw_b_576_CM 1 100. 0. 99.9984 DISPLAY_IDENTIFIER RT_BASTATG_SA ECU_ADDRESS 0xc00026ca FORMAT "%8.3" /end MEASUREMENT
/begin MEASUREMENT Schalt_ws "Schaltwahrscheinlichkeit" SBYTE _CNV_R_R_Def_f_sb_b_699_CM 1 100. -1. 0.9921 DISPLAY_IDENTIFIER SCHALT_WS ECU_ADDRESS 0xd00074a2 /end MEASUREMENT
/begin MEASUREMENT St_ar1 "Statuswort" UBYTE _CNV_R_R_Def_dez_sl_575_CM 1 100. 0. 255. DISPLAY_IDENTIFIER ST_AR1 ECU_ADDRESS 0xd00074c4 FORMAT "%3.0" /end MEASUREMENT
/begin MEASUREMENT St_ar1.B_ar_akt "Statuswort" UBYTE _CNV_S_1_Def_bit_ub_700_CM 1 100. 0. 0. DISPLAY_IDENTIFIER B_AR_AKT ECU_ADDRESS 0xd00074c4 BIT_MASK 0x1 /end MEASUREMENT
/begin MEASUREMENT St_ar1.B_ar_ber "Statuswort" UBYTE _CNV_S_1_Def_bit_ub_700_CM 1 100. 0. 0. DISPLAY_IDENTIFIER B_AR_BER ECU_ADDRESS 0xd00074c4 BIT_MASK 0x10 /end MEASUREMENT
/begin MEASUREMENT St_ar1.B_arakt_fl "Statuswort" UBYTE _CNV_S_1_Def_bit_ub_700_CM 1 100. 0. 0. DISPLAY_IDENTIFIER B_ARAKT_FL ECU_ADDRESS 0xd00074c4 BIT_MASK 0x20 /end MEASUREMENT
/begin MEASUREMENT St_ar1.B_kein_ar "Statuswort" UBYTE _CNV_S_1_Def_bit_ub_700_CM 1 100. 0. 0. DISPLAY_IDENTIFIER B_KEIN_AR ECU_ADDRESS 0xd00074c4 BIT_MASK 0x40 /end MEASUREMENT
/begin MEASUREMENT St_ar1.B_td_arakt "Statuswort" UBYTE _CNV_S_1_Def_bit_ub_700_CM 1 100. 0. 0. DISPLAY_IDENTIFIER B_TD_ARAKT ECU_ADDRESS 0xd00074c4 BIT_MASK 0x4 /end MEASUREMENT
/begin MEASUREMENT St_ar1.B_td_kupp "Statuswort" UBYTE _CNV_S_1_Def_bit_ub_700_CM 1 100. 0. 0. DISPLAY_IDENTIFIER B_TD_KUPP ECU_ADDRESS 0xd00074c4 BIT_MASK 0x8 /end MEASUREMENT
/begin MEASUREMENT St_ar1.B_zr_ar "Statuswort" UBYTE _CNV_S_1_Def_bit_ub_700_CM 1 100. 0. 0. DISPLAY_IDENTIFIER B_ZR_AR ECU_ADDRESS 0xd00074c4 BIT_MASK 0x2 /end MEASUREMENT
/begin MEASUREMENT St_ba_agf "Statuswort fuer Umschaltung" UBYTE _CNV_R_R_Def_dez_sl_575_CM 1 100. 0. 255. DISPLAY_IDENTIFIER ST_BA_AGF ECU_ADDRESS 0xd0007398 FORMAT "%3.0" /end MEASUREMENT
/begin MEASUREMENT St_ba_agf.B_hstoech "Bedingung stoecheometrisches Verhaeltnis" UBYTE _CNV_S_1_Def_bit_ub_700_CM 1 100. 0. 0. DISPLAY_IDENTIFIER B_HSTOECH ECU_ADDRESS 0xd0007398 BIT_MASK 0x1 /end MEASUREMENT
/begin MEASUREMENT St_bano "Verbote BA für Verbrennungsregelung" UBYTE _CNV_R_R_Def_dez_sl_575_CM 1 100. 0. 255. DISPLAY_IDENTIFIER ST_BANO ECU_ADDRESS 0xd00073e5 FORMAT "%3.0" /end MEASUREMENT
/begin MEASUREMENT St_baumsch "Statuswort" UBYTE _CNV_R_R_Def_dez_sl_575_CM 1 100. 0. 255. DISPLAY_IDENTIFIER ST_BAUMSCH ECU_ADDRESS 0xd00073d8 FORMAT "%3.0" /end MEASUREMENT
/begin MEASUREMENT St_baumsch.B_ba_toggle "Anzeige Zustand Togglefunktion BA" UBYTE _CNV_S_1_Def_bit_ub_700_CM 1 100. 0. 0. DISPLAY_IDENTIFIER B_BA_TOGGLE ECU_ADDRESS 0xd00073d8 BIT_MASK 0x4 /end MEASUREMENT
/begin MEASUREMENT St_baumsch.B_ba_toggletime "Anzeige Zustand Togglefunktion BA" UBYTE _CNV_S_1_Def_bit_ub_700_CM 1 100. 0. 0. DISPLAY_IDENTIFIER B_BA_TOGGLETIME ECU_ADDRESS 0xd00073d8 BIT_MASK 0x8 /end MEASUREMENT
/begin MEASUREMENT St_baumsch.B_babr "Abbruchbedingung" UBYTE _CNV_S_1_Def_bit_ub_700_CM 1 100. 0. 0. DISPLAY_IDENTIFIER B_BABR ECU_ADDRESS 0xd00073d8 BIT_MASK 0x1 /end MEASUREMENT
/begin MEASUREMENT St_baumsch.B_prschalt "Bedingung für angeforderte Umschaltung zw schicht und homogen" UBYTE _CNV_S_1_Def_bit_ub_700_CM 1 100. 0. 0. DISPLAY_IDENTIFIER B_PRSCHALT ECU_ADDRESS 0xd00073d8 BIT_MASK 0x2 /end MEASUREMENT
/begin MEASUREMENT St_bawu "Statuswort BAWU" UBYTE _CNV_R_R_Def_dez_sl_575_CM 1 100. 0. 255. DISPLAY_IDENTIFIER ST_BAWU ECU_ADDRESS 0xd00073b6 FORMAT "%3.0" /end MEASUREMENT
/begin MEASUREMENT St_bvena "Statuswort BVENA" UBYTE _CNV_R_R_Def_dez_sl_575_CM 1 100. 0. 255. DISPLAY_IDENTIFIER ST_BVENA ECU_ADDRESS 0xd00073b3 FORMAT "%3.0" /end MEASUREMENT
/begin MEASUREMENT St_bvist "Statuswort BVIST" UBYTE _CNV_R_R_Def_dez_sl_575_CM 1 100. 0. 255. DISPLAY_IDENTIFIER ST_BVIST ECU_ADDRESS 0xd00073b1 FORMAT "%3.0" /end MEASUREMENT
/begin MEASUREMENT St_bvso "Statuswort BVIST" UBYTE _CNV_R_R_Def_dez_sl_575_CM 1 100. 0. 255. DISPLAY_IDENTIFIER ST_BVSO ECU_ADDRESS 0xd00073b2 FORMAT "%3.0" /end MEASUREMENT
/begin MEASUREMENT St_bvums "Statuswort BVUMS" UBYTE _CNV_R_R_Def_dez_sl_575_CM 1 100. 0. 255. DISPLAY_IDENTIFIER ST_BVUMS ECU_ADDRESS 0xd00073b4 FORMAT "%3.0" /end MEASUREMENT
/begin MEASUREMENT St_bvwu "Statuswort BVWU" UBYTE _CNV_R_R_Def_dez_sl_575_CM 1 100. 0. 255. DISPLAY_IDENTIFIER ST_BVWU ECU_ADDRESS 0xd00073b5 FORMAT "%3.0" /end MEASUREMENT
/begin MEASUREMENT St_disa_bmw "Statuswort fuer DISA" UBYTE _CNV_R_R_Def_dez_sl_575_CM 1 100. 0. 255. DISPLAY_IDENTIFIER ST_DISA_BMW ECU_ADDRESS 0xd0007395 FORMAT "%3.0" /end MEASUREMENT
/begin MEASUREMENT St_disa_bmw.B_disa_stopp "Bedingung DISA abschalten" UBYTE _CNV_S_1_Def_bit_ub_700_CM 1 100. 0. 0. DISPLAY_IDENTIFIER B_DISA_STOPP ECU_ADDRESS 0xd0007395 BIT_MASK 0x1 /end MEASUREMENT
/begin MEASUREMENT St_dknot "Statuswort DK-Notlauf" UBYTE _CNV_R_R_Def_dez_sl_575_CM 1 100. 0. 255. DISPLAY_IDENTIFIER ST_DKNOT ECU_ADDRESS 0xd00073a4 FORMAT "%3.0" /end MEASUREMENT
/begin MEASUREMENT St_dknot.B_vvt_dknotl "Statuswort DK-Notlauf" UBYTE _CNV_S_1_Def_bit_ub_700_CM 1 100. 0. 0. DISPLAY_IDENTIFIER B_VVT_DKNOTL ECU_ADDRESS 0xd00073a4 BIT_MASK 0x1 /end MEASUREMENT
/begin MEASUREMENT St_dp_ber "Status Momentenbereich Dashpot" UBYTE _CNV_R_R_Def_dez_sl_575_CM 1 100. 0. 255. DISPLAY_IDENTIFIER ST_DP_BER ECU_ADDRESS 0xd0007390 FORMAT "%3.0" /end MEASUREMENT
/begin MEASUREMENT St_dps "Statuswort" UBYTE _CNV_R_R_Def_dez_sl_575_CM 1 100. 0. 255. DISPLAY_IDENTIFIER ST_DPS ECU_ADDRESS 0xd00073d9 FORMAT "%3.0" /end MEASUREMENT
/begin MEASUREMENT St_dps.B_dpsadp "Bedingung Druckadaption freigegeben" UBYTE _CNV_S_1_Def_bit_ub_700_CM 1 100. 0. 0. DISPLAY_IDENTIFIER B_DPSADP ECU_ADDRESS 0xd00073d9 BIT_MASK 0x8 /end MEASUREMENT
/begin MEASUREMENT St_dps.B_gd "Bedingung gedrosselt" UBYTE _CNV_S_1_Def_bit_ub_700_CM 1 100. 0. 0. DISPLAY_IDENTIFIER B_GD ECU_ADDRESS 0xd00073d9 BIT_MASK 0x2 /end MEASUREMENT
/begin MEASUREMENT St_dps.B_gdst "Bedingung gedrosselterStart" UBYTE _CNV_S_1_Def_bit_ub_700_CM 1 100. 0. 0. DISPLAY_IDENTIFIER B_GDST ECU_ADDRESS 0xd00073d9 BIT_MASK 0x1 /end MEASUREMENT
/begin MEASUREMENT St_dps.B_gdvhub "Bedingung gedrosselt Vollhub" UBYTE _CNV_S_1_Def_bit_ub_700_CM 1 100. 0. 0. DISPLAY_IDENTIFIER B_GDVHUB ECU_ADDRESS 0xd00073d9 BIT_MASK 0x4 /end MEASUREMENT
/begin MEASUREMENT St_fw "Status Momentenreserve" UBYTE _CNV_R_R_Def_dez_sl_575_CM 1 100. 0. 255. DISPLAY_IDENTIFIER ST_FW ECU_ADDRESS 0xd0007499 FORMAT "%3.0" /end MEASUREMENT
/begin MEASUREMENT St_fw.B_hschalt_komb "Status Momentenreserve" UBYTE _CNV_S_1_Def_bit_ub_700_CM 1 100. 0. 0. DISPLAY_IDENTIFIER B_HSCHALT_KOMB ECU_ADDRESS 0xd0007499 BIT_MASK 0x20 /end MEASUREMENT
/begin MEASUREMENT St_fw.B_kupp_extalt "Status Momentenreserve" UBYTE _CNV_S_1_Def_bit_ub_700_CM 1 100. 0. 0. DISPLAY_IDENTIFIER B_KUPP_EXTALT ECU_ADDRESS 0xd0007499 BIT_MASK 0x4 /end MEASUREMENT
/begin MEASUREMENT St_fw.B_ldm_akt04 "Status Momentenreserve" UBYTE _CNV_S_1_Def_bit_ub_700_CM 1 100. 0. 0. DISPLAY_IDENTIFIER B_LDM_AKT04 ECU_ADDRESS 0xd0007499 BIT_MASK 0x1 /end MEASUREMENT
/begin MEASUREMENT St_fw.B_ldm_off "Status Momentenreserve" UBYTE _CNV_S_1_Def_bit_ub_700_CM 1 100. 0. 0. DISPLAY_IDENTIFIER B_LDM_OFF ECU_ADDRESS 0xd0007499 BIT_MASK 0x8 /end MEASUREMENT
/begin MEASUREMENT St_fw.B_ldm_offhs "Status Momentenreserve" UBYTE _CNV_S_1_Def_bit_ub_700_CM 1 100. 0. 0. DISPLAY_IDENTIFIER B_LDM_OFFHS ECU_ADDRESS 0xd0007499 BIT_MASK 0x80 /end MEASUREMENT
/begin MEASUREMENT St_fw.B_ldm_offreg "Status Momentenreserve" UBYTE _CNV_S_1_Def_bit_ub_700_CM 1 100. 0. 0. DISPLAY_IDENTIFIER B_LDM_OFFREG ECU_ADDRESS 0xd0007499 BIT_MASK 0x2 /end MEASUREMENT
/begin MEASUREMENT St_fw.B_ldm_offrs "Status Momentenreserve" UBYTE _CNV_S_1_Def_bit_ub_700_CM 1 100. 0. 0. DISPLAY_IDENTIFIER B_LDM_OFFRS ECU_ADDRESS 0xd0007499 BIT_MASK 0x40 /end MEASUREMENT
/begin MEASUREMENT St_fw.B_rschalt_komb "Status Momentenreserve" UBYTE _CNV_S_1_Def_bit_ub_700_CM 1 100. 0. 0. DISPLAY_IDENTIFIER B_RSCHALT_KOMB ECU_ADDRESS 0xd0007499 BIT_MASK 0x10 /end MEASUREMENT
/begin MEASUREMENT St_fw1 "Status Momentenreserve" UBYTE _CNV_R_R_Def_dez_sl_575_CM 1 100. 0. 255. DISPLAY_IDENTIFIER ST_FW1 ECU_ADDRESS 0xd0007498 FORMAT "%3.0" /end MEASUREMENT
/begin MEASUREMENT St_fw1.B_nschalt_akt "Status Momentenreserve" UBYTE _CNV_S_1_Def_bit_ub_700_CM 1 100. 0. 0. DISPLAY_IDENTIFIER B_NSCHALT_AKT ECU_ADDRESS 0xd0007498 BIT_MASK 0x1 /end MEASUREMENT
/begin MEASUREMENT St_kath_ena "Statuswort" UBYTE _CNV_R_R_Def_dez_sl_575_CM 1 100. 0. 255. DISPLAY_IDENTIFIER ST_KATH_ENA ECU_ADDRESS 0xd00073da FORMAT "%3.0" /end MEASUREMENT
/begin MEASUREMENT St_kath_ena.B_hsplit_ena "Bedingung Homogensplit möglich" UBYTE _CNV_S_1_Def_bit_ub_700_CM 1 100. 0. 0. DISPLAY_IDENTIFIER B_HSPLIT_ENA ECU_ADDRESS 0xd00073da BIT_MASK 0x8 /end MEASUREMENT
/begin MEASUREMENT St_kath_ena.B_nesps_ena "Bedingung Nacheinspritzung Schicht möglich" UBYTE _CNV_S_1_Def_bit_ub_700_CM 1 100. 0. 0. DISPLAY_IDENTIFIER B_NESPS_ENA ECU_ADDRESS 0xd00073da BIT_MASK 0x2 /end MEASUREMENT
/begin MEASUREMENT St_kath_ena.B_verb_h "Bedingung Verbot  Homogen" UBYTE _CNV_S_1_Def_bit_ub_700_CM 1 100. 0. 0. DISPLAY_IDENTIFIER B_VERB_H ECU_ADDRESS 0xd00073da BIT_MASK 0x4 /end MEASUREMENT
/begin MEASUREMENT St_kath_ena.B_verb_s "Bedingung Verbot  Schicht" UBYTE _CNV_S_1_Def_bit_ub_700_CM 1 100. 0. 0. DISPLAY_IDENTIFIER B_VERB_S ECU_ADDRESS 0xd00073da BIT_MASK 0x1 /end MEASUREMENT
/begin MEASUREMENT St_khaktiv "Statuswort" UBYTE _CNV_R_R_Def_dez_sl_575_CM 1 100. 0. 255. DISPLAY_IDENTIFIER ST_KHAKTIV ECU_ADDRESS 0xd00073db FORMAT "%3.0" /end MEASUREMENT
/begin MEASUREMENT St_khaktiv.B_khaktiv_h "Bedingung Katheizen Homogen" UBYTE _CNV_S_1_Def_bit_ub_700_CM 1 100. 0. 0. DISPLAY_IDENTIFIER B_KHAKTIV_H ECU_ADDRESS 0xd00073db BIT_MASK 0x1 /end MEASUREMENT
/begin MEASUREMENT St_khaktiv.B_khaktiv_s "Bedingung Katheizen Homogen" UBYTE _CNV_S_1_Def_bit_ub_700_CM 1 100. 0. 0. DISPLAY_IDENTIFIER B_KHAKTIV_S ECU_ADDRESS 0xd00073db BIT_MASK 0x2 /end MEASUREMENT
/begin MEASUREMENT St_ldm_chk "" UBYTE _CNV_R_R_Def_dez_sl_575_CM 1 100. 0. 255. DISPLAY_IDENTIFIER ST_LDM_CHK ECU_ADDRESS 0xd0007451 FORMAT "%3.0" /end MEASUREMENT
/begin MEASUREMENT St_ldm_init "" UBYTE _CNV_R_R_Def_dez_sl_575_CM 1 100. 0. 255. DISPLAY_IDENTIFIER ST_LDM_INIT ECU_ADDRESS 0xd0007453 FORMAT "%3.0" /end MEASUREMENT
/begin MEASUREMENT St_ldm_off "" UBYTE _CNV_R_R_Def_dez_sl_575_CM 1 100. 0. 255. DISPLAY_IDENTIFIER ST_LDM_OFF ECU_ADDRESS 0xd0007452 FORMAT "%3.0" /end MEASUREMENT
/begin MEASUREMENT St_ls_ber "Status Momentenbereich Lastschlagdämpfung" UBYTE _CNV_R_R_Def_dez_sl_575_CM 1 100. 0. 255. DISPLAY_IDENTIFIER ST_LS_BER ECU_ADDRESS 0xd0007391 FORMAT "%3.0" /end MEASUREMENT
/begin MEASUREMENT St_mdar0 "Statuswort" UBYTE _CNV_R_R_Def_dez_sl_575_CM 1 100. 0. 255. DISPLAY_IDENTIFIER ST_MDAR0 ECU_ADDRESS 0xd0007340 FORMAT "%3.0" /end MEASUREMENT
/begin MEASUREMENT St_mdar0.B_dmdp "Bedingung Dashpotauslöseschwelle überschritten" UBYTE _CNV_S_1_Def_bit_ub_700_CM 1 100. 0. 0. DISPLAY_IDENTIFIER B_DMDP ECU_ADDRESS 0xd0007340 BIT_MASK 0x80 /end MEASUREMENT
/begin MEASUREMENT St_mdar0.B_dmls "Bedingung Lastschlagdämpfungauslöseschwelle überschritten" UBYTE _CNV_S_1_Def_bit_ub_700_CM 1 100. 0. 0. DISPLAY_IDENTIFIER B_DMLS ECU_ADDRESS 0xd0007340 BIT_MASK 0x8 /end MEASUREMENT
/begin MEASUREMENT St_mdar0.B_dp "Bedingung Dashpot" UBYTE _CNV_S_1_Def_bit_ub_700_CM 1 100. 0. 0. DISPLAY_IDENTIFIER B_DP ECU_ADDRESS 0xd0007340 BIT_MASK 0x1 /end MEASUREMENT
/begin MEASUREMENT St_mdar0.B_edp "Bedingung enable Dashpot" UBYTE _CNV_S_1_Def_bit_ub_700_CM 1 100. 0. 0. DISPLAY_IDENTIFIER B_EDP ECU_ADDRESS 0xd0007340 BIT_MASK 0x4 /end MEASUREMENT
/begin MEASUREMENT St_mdar0.B_elsd "Bedingung enable Lastschlagdämpfung" UBYTE _CNV_S_1_Def_bit_ub_700_CM 1 100. 0. 0. DISPLAY_IDENTIFIER B_ELSD ECU_ADDRESS 0xd0007340 BIT_MASK 0x2 /end MEASUREMENT
/begin MEASUREMENT St_mdar0.B_ifdp "Bedingung Initialisierung Dashpotfilter" UBYTE _CNV_S_1_Def_bit_ub_700_CM 1 100. 0. 0. DISPLAY_IDENTIFIER B_IFDP ECU_ADDRESS 0xd0007340 BIT_MASK 0x20 /end MEASUREMENT
/begin MEASUREMENT St_mdar0.B_ls "Bedingung Lastschlagdämpfung" UBYTE _CNV_S_1_Def_bit_ub_700_CM 1 100. 0. 0. DISPLAY_IDENTIFIER B_LS ECU_ADDRESS 0xd0007340 BIT_MASK 0x10 /end MEASUREMENT
/begin MEASUREMENT St_mdar0.B_lsd "Bedingung Lastschlagdämpfungsänderungsbegrenzung aktiv" UBYTE _CNV_S_1_Def_bit_ub_700_CM 1 100. 0. 0. DISPLAY_IDENTIFIER B_LSD ECU_ADDRESS 0xd0007340 BIT_MASK 0x40 /end MEASUREMENT
/begin MEASUREMENT St_mdar1 "Statuswort" UBYTE _CNV_R_R_Def_dez_sl_575_CM 1 100. 0. 255. DISPLAY_IDENTIFIER ST_MDAR1 ECU_ADDRESS 0xd0007341 FORMAT "%3.0" /end MEASUREMENT
/begin MEASUREMENT St_mdar1.B_dash "Bedingung Dashpotänderungsbegrenzung aktiv" UBYTE _CNV_S_1_Def_bit_ub_700_CM 1 100. 0. 0. DISPLAY_IDENTIFIER B_DASH ECU_ADDRESS 0xd0007341 BIT_MASK 0x1 /end MEASUREMENT
/begin MEASUREMENT St_mdar1.B_iflsd "Bedingung Initialisierung Lastschlagdämpfungsfilter" UBYTE _CNV_S_1_Def_bit_ub_700_CM 1 100. 0. 0. DISPLAY_IDENTIFIER B_IFLSD ECU_ADDRESS 0xd0007341 BIT_MASK 0x2 /end MEASUREMENT
/begin MEASUREMENT St_mdar1.B_kf_at "Statuswort" UBYTE _CNV_S_1_Def_bit_ub_700_CM 1 100. 0. 0. DISPLAY_IDENTIFIER B_KF_AT ECU_ADDRESS 0xd0007341 BIT_MASK 0x10 /end MEASUREMENT
/begin MEASUREMENT St_mdar1.B_ll_md "Statuswort" UBYTE _CNV_S_1_Def_bit_ub_700_CM 1 100. 0. 0. DISPLAY_IDENTIFIER B_LL_MD ECU_ADDRESS 0xd0007341 BIT_MASK 0x4 /end MEASUREMENT
/begin MEASUREMENT St_mdar1.B_tl_md "Statuswort" UBYTE _CNV_S_1_Def_bit_ub_700_CM 1 100. 0. 0. DISPLAY_IDENTIFIER B_TL_MD ECU_ADDRESS 0xd0007341 BIT_MASK 0x8 /end MEASUREMENT
/begin MEASUREMENT St_mdbafak "Statuswort MDBAFAK" UBYTE _CNV_R_R_Def_dez_sl_575_CM 1 100. 0. 255. DISPLAY_IDENTIFIER ST_MDBAFAK ECU_ADDRESS 0xd0007396 FORMAT "%3.0" /end MEASUREMENT
/begin MEASUREMENT St_mdbafak.B_hmm_akt "Bedingung homogen mager aktiv" UBYTE _CNV_S_1_Def_bit_ub_700_CM 1 100. 0. 0. DISPLAY_IDENTIFIER B_HMM_AKT ECU_ADDRESS 0xd0007396 BIT_MASK 0x40 /end MEASUREMENT
/begin MEASUREMENT St_mdbafak.B_hom_akt "Bedingung Berechnung Homogen aktiv" UBYTE _CNV_S_1_Def_bit_ub_700_CM 1 100. 0. 0. DISPLAY_IDENTIFIER B_HOM_AKT ECU_ADDRESS 0xd0007396 BIT_MASK 0x2 /end MEASUREMENT
/begin MEASUREMENT St_mdbafak.B_hschicht "Statuswort MDBAFAK" UBYTE _CNV_S_1_Def_bit_ub_700_CM 1 100. 0. 0. DISPLAY_IDENTIFIER B_HSCHICHT ECU_ADDRESS 0xd0007396 BIT_MASK 0x80 /end MEASUREMENT
/begin MEASUREMENT St_mdbafak.B_la_stopp "Bedingung Lambdaregler ausschalten" UBYTE _CNV_S_1_Def_bit_ub_700_CM 1 100. 0. 0. DISPLAY_IDENTIFIER B_LA_STOPP ECU_ADDRESS 0xd0007396 BIT_MASK 0x10 /end MEASUREMENT
/begin MEASUREMENT St_mdbafak.B_la_stopp1 "Bedingung Lambdaregler  Bank1 ausschalten" UBYTE _CNV_S_1_Def_bit_ub_700_CM 1 100. 0. 0. DISPLAY_IDENTIFIER B_LA_STOPP1 ECU_ADDRESS 0xd0007396 BIT_MASK 0x8 /end MEASUREMENT
/begin MEASUREMENT St_mdbafak.B_la_stopp2 "Bedingung Lambdaregler Bank2 ausschalten" UBYTE _CNV_S_1_Def_bit_ub_700_CM 1 100. 0. 0. DISPLAY_IDENTIFIER B_LA_STOPP2 ECU_ADDRESS 0xd0007396 BIT_MASK 0x20 /end MEASUREMENT
/begin MEASUREMENT St_mdbafak.B_sch_akt "Bedingung Berechnung Schicht aktiv" UBYTE _CNV_S_1_Def_bit_ub_700_CM 1 100. 0. 0. DISPLAY_IDENTIFIER B_SCH_AKT ECU_ADDRESS 0xd0007396 BIT_MASK 0x4 /end MEASUREMENT
/begin MEASUREMENT St_mdbafak.B_schicht "Bedingung Schichtbetrieb aktiv" UBYTE _CNV_S_1_Def_bit_ub_700_CM 1 100. 0. 0. DISPLAY_IDENTIFIER B_SCHICHT ECU_ADDRESS 0xd0007396 BIT_MASK 0x1 /end MEASUREMENT
/begin MEASUREMENT St_mdbafak2 "Statuswort MDBAFAK2" UBYTE _CNV_R_R_Def_dez_sl_575_CM 1 100. 0. 255. DISPLAY_IDENTIFIER ST_MDBAFAK2 ECU_ADDRESS 0xd0007397 FORMAT "%3.0" /end MEASUREMENT
/begin MEASUREMENT St_mdbafak2.B_ba_um "Bedingung BA-Umschaltung" UBYTE _CNV_S_1_Def_bit_ub_700_CM 1 100. 0. 0. DISPLAY_IDENTIFIER B_BA_UM ECU_ADDRESS 0xd0007397 BIT_MASK 0x8 /end MEASUREMENT
/begin MEASUREMENT St_mdbafak2.B_mdres_rgn "-" UBYTE _CNV_S_1_Def_bit_ub_700_CM 1 100. 0. 0. DISPLAY_IDENTIFIER B_MDRES_RGN ECU_ADDRESS 0xd0007397 BIT_MASK 0x80 /end MEASUREMENT
/begin MEASUREMENT St_mdbafak2.B_quitt_h "Bedingung Quittung homogen" UBYTE _CNV_S_1_Def_bit_ub_700_CM 1 100. 0. 0. DISPLAY_IDENTIFIER B_QUITT_H ECU_ADDRESS 0xd0007397 BIT_MASK 0x1 /end MEASUREMENT
/begin MEASUREMENT St_mdbafak2.B_quitt_hs "Bedingung Quittung homogen-schicht" UBYTE _CNV_S_1_Def_bit_ub_700_CM 1 100. 0. 0. DISPLAY_IDENTIFIER B_QUITT_HS ECU_ADDRESS 0xd0007397 BIT_MASK 0x2 /end MEASUREMENT
/begin MEASUREMENT St_mdbafak2.B_quitt_s "Bedingung Quittung schicht" UBYTE _CNV_S_1_Def_bit_ub_700_CM 1 100. 0. 0. DISPLAY_IDENTIFIER B_QUITT_S ECU_ADDRESS 0xd0007397 BIT_MASK 0x4 /end MEASUREMENT
/begin MEASUREMENT St_mdbafak2.B_tev_stopp "Bedingung schliessen TEV angefordert" UBYTE _CNV_S_1_Def_bit_ub_700_CM 1 100. 0. 0. DISPLAY_IDENTIFIER B_TEV_STOPP ECU_ADDRESS 0xd0007397 BIT_MASK 0x20 /end MEASUREMENT
/begin MEASUREMENT St_mdbafak2.B_zwbaw "Zündwinkelfreigabe durch Betriebsartenwechsel" UBYTE _CNV_S_1_Def_bit_ub_700_CM 1 100. 0. 0. DISPLAY_IDENTIFIER B_ZWBAW ECU_ADDRESS 0xd0007397 BIT_MASK 0x40 /end MEASUREMENT
/begin MEASUREMENT St_mdbafast "Statuswort" UBYTE _CNV_R_R_Def_dez_sl_575_CM 1 100. 0. 255. DISPLAY_IDENTIFIER ST_MDBAFAST ECU_ADDRESS 0xd00073dc FORMAT "%3.0" /end MEASUREMENT
/begin MEASUREMENT St_mdbafast.B_beopt_aus "Bedingung verbrauchsoptimierte Umschaltung aus" UBYTE _CNV_S_1_Def_bit_ub_700_CM 1 100. 0. 0. DISPLAY_IDENTIFIER B_BEOPT_AUS ECU_ADDRESS 0xd00073dc BIT_MASK 0x2 /end MEASUREMENT
/begin MEASUREMENT St_mdbafast.B_ums_fast "Bedingung beschleunigte Umschaltung angefordert" UBYTE _CNV_S_1_Def_bit_ub_700_CM 1 100. 0. 0. DISPLAY_IDENTIFIER B_UMS_FAST ECU_ADDRESS 0xd00073dc BIT_MASK 0x1 /end MEASUREMENT
/begin MEASUREMENT St_mdbanl "Statuswort MDBANL" UBYTE _CNV_R_R_Def_dez_sl_575_CM 1 100. 0. 255. DISPLAY_IDENTIFIER ST_MDBANL ECU_ADDRESS 0xd00078d0 FORMAT "%3.0" /end MEASUREMENT
/begin MEASUREMENT St_mdbanl.B_agrzu_nl "Bedingung AGR schliessen aus Notlaufmanager" UBYTE _CNV_S_1_Def_bit_ub_700_CM 1 100. 0. 0. DISPLAY_IDENTIFIER B_AGRZU_NL ECU_ADDRESS 0xd00078d0 BIT_MASK 0x10 /end MEASUREMENT
/begin MEASUREMENT St_mdbanl.B_disa_nl "Bedingung DISA schliessen aus Notlaufmanager" UBYTE _CNV_S_1_Def_bit_ub_700_CM 1 100. 0. 0. DISPLAY_IDENTIFIER B_DISA_NL ECU_ADDRESS 0xd00078d0 BIT_MASK 0x20 /end MEASUREMENT
/begin MEASUREMENT St_mdbanl.B_evvt_vsa_tmp "Bedingung" UBYTE _CNV_S_1_Def_bit_ub_700_CM 1 100. 0. 0. DISPLAY_IDENTIFIER B_EVVT_VSA_TMP ECU_ADDRESS 0xd00078d0 BIT_MASK 0x2 /end MEASUREMENT
/begin MEASUREMENT St_mdbanl.B_evvt_vse_tmp "Bedingung" UBYTE _CNV_S_1_Def_bit_ub_700_CM 1 100. 0. 0. DISPLAY_IDENTIFIER B_EVVT_VSE_TMP ECU_ADDRESS 0xd00078d0 BIT_MASK 0x1 /end MEASUREMENT
/begin MEASUREMENT St_mdbanl.B_lastopp_nl "Bedingung Stopp Lambdaregler aus Notlaufmanager" UBYTE _CNV_S_1_Def_bit_ub_700_CM 1 100. 0. 0. DISPLAY_IDENTIFIER B_LASTOPP_NL ECU_ADDRESS 0xd00078d0 BIT_MASK 0x4 /end MEASUREMENT
/begin MEASUREMENT St_mdbanl.B_tevzu_nl "Bedingung TEV schliessen aus Notlaufmanager" UBYTE _CNV_S_1_Def_bit_ub_700_CM 1 100. 0. 0. DISPLAY_IDENTIFIER B_TEVZU_NL ECU_ADDRESS 0xd00078d0 BIT_MASK 0x8 /end MEASUREMENT
/begin MEASUREMENT St_mdbanl.B_wesb1h_nl "Bedingung wes aus Notlaufmanager" UBYTE _CNV_S_1_Def_bit_ub_700_CM 1 100. 0. 0. DISPLAY_IDENTIFIER B_WESB1H_NL ECU_ADDRESS 0xd00078d0 BIT_MASK 0x80 /end MEASUREMENT
/begin MEASUREMENT St_mdbanl.B_zw_nl "Bedingung Zündwinkel aus Notlaufmanager" UBYTE _CNV_S_1_Def_bit_ub_700_CM 1 100. 0. 0. DISPLAY_IDENTIFIER B_ZW_NL ECU_ADDRESS 0xd00078d0 BIT_MASK 0x40 /end MEASUREMENT
/begin MEASUREMENT St_mdbanl2 "Statuswort MDBANL2" UBYTE _CNV_R_R_Def_dez_sl_575_CM 1 100. 0. 255. DISPLAY_IDENTIFIER ST_MDBANL2 ECU_ADDRESS 0xd00078d1 FORMAT "%3.0" /end MEASUREMENT
/begin MEASUREMENT St_mdbanl2.B_vbdoe_nl "Bedingung" UBYTE _CNV_S_1_Def_bit_ub_700_CM 1 100. 0. 0. DISPLAY_IDENTIFIER B_VBDOE_NL ECU_ADDRESS 0xd00078d1 BIT_MASK 0x1 /end MEASUREMENT
/begin MEASUREMENT St_mdbanl_agr "Statuswort MDBANL2" UBYTE _CNV_R_R_Def_dez_sl_575_CM 1 100. 0. 255. DISPLAY_IDENTIFIER ST_MDBANL_AGR ECU_ADDRESS 0xd00078d2 FORMAT "%3.0" /end MEASUREMENT
/begin MEASUREMENT St_mdbanl_agr.B_agrauf_nl "Bedingung" UBYTE _CNV_S_1_Def_bit_ub_700_CM 1 100. 0. 0. DISPLAY_IDENTIFIER B_AGRAUF_NL ECU_ADDRESS 0xd00078d2 BIT_MASK 0x1 /end MEASUREMENT
/begin MEASUREMENT St_mdbanl_agr.B_fi_agr "Bedingung" UBYTE _CNV_S_1_Def_bit_ub_700_CM 1 100. 0. 0. DISPLAY_IDENTIFIER B_FI_AGR ECU_ADDRESS 0xd00078d2 BIT_MASK 0x4 /end MEASUREMENT
/begin MEASUREMENT St_mdbanl_agr.B_pos_agrzu "Bedingung" UBYTE _CNV_S_1_Def_bit_ub_700_CM 1 100. 0. 0. DISPLAY_IDENTIFIER B_POS_AGRZU ECU_ADDRESS 0xd00078d2 BIT_MASK 0x2 /end MEASUREMENT
/begin MEASUREMENT St_mdbanl_lok "Statuswort MDBANL, Lokal" UWORD _CNV_R_R_Def_dez_sl_575_CM 1 100. 0. 65535. DISPLAY_IDENTIFIER ST_MDBANL_LOK ECU_ADDRESS 0xc00026be FORMAT "%5.0" /end MEASUREMENT
/begin MEASUREMENT St_mdbanl_lok.B_mdmax_notl "Statuswort MDBANL, Lokal" UWORD _CNV_S_1_Def_bit_ub_700_CM 1 100. 0. 0. DISPLAY_IDENTIFIER B_MDMAX_NOTL ECU_ADDRESS 0xc00026be BIT_MASK 0x40 /end MEASUREMENT
/begin MEASUREMENT St_mdbanl_lok.B_nkw_prail "Statuswort MDBANL, Lokal" UWORD _CNV_S_1_Def_bit_ub_700_CM 1 100. 0. 0. DISPLAY_IDENTIFIER B_NKW_PRAIL ECU_ADDRESS 0xc00026be BIT_MASK 0x1 /end MEASUREMENT
/begin MEASUREMENT St_mdbanl_lok.B_nldgh "Statuswort MDBANL, Lokal" UWORD _CNV_S_1_Def_bit_ub_700_CM 1 100. 0. 0. DISPLAY_IDENTIFIER B_NLDGH ECU_ADDRESS 0xc00026be BIT_MASK 0x2 /end MEASUREMENT
/begin MEASUREMENT St_mdbanl_lok.B_notl3 "Statuswort MDBANL, Lokal" UWORD _CNV_S_1_Def_bit_ub_700_CM 1 100. 0. 0. DISPLAY_IDENTIFIER B_NOTL3 ECU_ADDRESS 0xc00026be BIT_MASK 0x8 /end MEASUREMENT
/begin MEASUREMENT St_mdbanl_lok.B_notldk4 "Statuswort MDBANL, Lokal" UWORD _CNV_S_1_Def_bit_ub_700_CM 1 100. 0. 0. DISPLAY_IDENTIFIER B_NOTLDK4 ECU_ADDRESS 0xc00026be BIT_MASK 0x4 /end MEASUREMENT
/begin MEASUREMENT St_mdbanl_lok.B_notldk5 "Statuswort MDBANL, Lokal" UWORD _CNV_S_1_Def_bit_ub_700_CM 1 100. 0. 0. DISPLAY_IDENTIFIER B_NOTLDK5 ECU_ADDRESS 0xc00026be BIT_MASK 0x80 /end MEASUREMENT
/begin MEASUREMENT St_mdbanl_lok.B_notlks6 "Statuswort MDBANL, Lokal" UWORD _CNV_S_1_Def_bit_ub_700_CM 1 100. 0. 0. DISPLAY_IDENTIFIER B_NOTLKS6 ECU_ADDRESS 0xc00026be BIT_MASK 0x100 /end MEASUREMENT
/begin MEASUREMENT St_mdbanl_lok.B_notlprail1 "Statuswort MDBANL, Lokal" UWORD _CNV_S_1_Def_bit_ub_700_CM 1 100. 0. 0. DISPLAY_IDENTIFIER B_NOTLPRAIL1 ECU_ADDRESS 0xc00026be BIT_MASK 0x10 /end MEASUREMENT
/begin MEASUREMENT St_mdbanl_lok.B_notlprail2 "Statuswort MDBANL, Lokal" UWORD _CNV_S_1_Def_bit_ub_700_CM 1 100. 0. 0. DISPLAY_IDENTIFIER B_NOTLPRAIL2 ECU_ADDRESS 0xc00026be BIT_MASK 0x20 /end MEASUREMENT
/begin MEASUREMENT St_mdbaprio "Statuswort" UBYTE _CNV_R_R_Def_dez_sl_575_CM 1 100. 0. 255. DISPLAY_IDENTIFIER ST_MDBAPRIO ECU_ADDRESS 0xd00073dd FORMAT "%3.0" /end MEASUREMENT
/begin MEASUREMENT St_mdbaprio.B_bastat_gee "Betriebsartstatistik Gesamtmotorlauf aktiviert" UBYTE _CNV_S_1_Def_bit_ub_700_CM 1 100. 0. 0. DISPLAY_IDENTIFIER B_BASTAT_GEE ECU_ADDRESS 0xd00073dd BIT_MASK 0x2 /end MEASUREMENT
/begin MEASUREMENT St_mdbaprio.B_bastat_mle "Betriebsartstatistik aktueller Motorlauf aktiviert" UBYTE _CNV_S_1_Def_bit_ub_700_CM 1 100. 0. 0. DISPLAY_IDENTIFIER B_BASTAT_MLE ECU_ADDRESS 0xd00073dd BIT_MASK 0x1 /end MEASUREMENT
/begin MEASUREMENT St_mdbaprio.B_katreganf "Katregeneration angefordert" UBYTE _CNV_S_1_Def_bit_ub_700_CM 1 100. 0. 0. DISPLAY_IDENTIFIER B_KATREGANF ECU_ADDRESS 0xd00073dd BIT_MASK 0x4 /end MEASUREMENT
/begin MEASUREMENT St_mdbaschalt "Status" UBYTE _CNV_R_R_Def_dez_sl_575_CM 1 100. 0. 255. DISPLAY_IDENTIFIER ST_MDBASCHALT ECU_ADDRESS 0xd000743a FORMAT "%3.0" /end MEASUREMENT
/begin MEASUREMENT St_mdbaschalt.B_mdzw_1 "Status" UBYTE _CNV_S_1_Def_bit_ub_700_CM 1 100. 0. 0. DISPLAY_IDENTIFIER B_MDZW_1 ECU_ADDRESS 0xd000743a BIT_MASK 0x1 /end MEASUREMENT
/begin MEASUREMENT St_mdbaschalt.B_mdzw_2 "Status" UBYTE _CNV_S_1_Def_bit_ub_700_CM 1 100. 0. 0. DISPLAY_IDENTIFIER B_MDZW_2 ECU_ADDRESS 0xd000743a BIT_MASK 0x2 /end MEASUREMENT
/begin MEASUREMENT St_mdbaschalt.B_mdzw_3 "Status" UBYTE _CNV_S_1_Def_bit_ub_700_CM 1 100. 0. 0. DISPLAY_IDENTIFIER B_MDZW_3 ECU_ADDRESS 0xd000743a BIT_MASK 0x4 /end MEASUREMENT
/begin MEASUREMENT St_mdbaschalt.B_mdzw_4 "Status" UBYTE _CNV_S_1_Def_bit_ub_700_CM 1 100. 0. 0. DISPLAY_IDENTIFIER B_MDZW_4 ECU_ADDRESS 0xd000743a BIT_MASK 0x8 /end MEASUREMENT
/begin MEASUREMENT St_mdbaschalt.B_mdzw_5 "Status" UBYTE _CNV_S_1_Def_bit_ub_700_CM 1 100. 0. 0. DISPLAY_IDENTIFIER B_MDZW_5 ECU_ADDRESS 0xd000743a BIT_MASK 0x10 /end MEASUREMENT
/begin MEASUREMENT St_mdbaschalt.B_mdzw_hd "Status" UBYTE _CNV_S_1_Def_bit_ub_700_CM 1 100. 0. 0. DISPLAY_IDENTIFIER B_MDZW_HD ECU_ADDRESS 0xd000743a BIT_MASK 0x20 /end MEASUREMENT
/begin MEASUREMENT St_mdinfo_ges "St_mdinfo" UBYTE _CNV_S_8_Def_st_mdi_701_CM 1 100. 0. 7. DISPLAY_IDENTIFIER ST_MDINFO_GES ECU_ADDRESS 0xd0007450 BIT_MASK 0xFF /end MEASUREMENT
/begin MEASUREMENT St_mdinfo_l "St_mdinfo" UBYTE _CNV_S_8_Def_st_mdi_701_CM 1 100. 0. 7. DISPLAY_IDENTIFIER ST_MDINFO_L ECU_ADDRESS 0xd000744e BIT_MASK 0xFF /end MEASUREMENT
/begin MEASUREMENT St_mdinfo_s "St_mdinfo" UBYTE _CNV_S_8_Def_st_mdi_701_CM 1 100. 0. 7. DISPLAY_IDENTIFIER ST_MDINFO_S ECU_ADDRESS 0xd000744f BIT_MASK 0xFF /end MEASUREMENT
/begin MEASUREMENT St_mdk "Status Momentenkoordination" UBYTE _CNV_R_R_Def_dez_sl_575_CM 1 100. 0. 255. DISPLAY_IDENTIFIER ST_MDK ECU_ADDRESS 0xd000744d FORMAT "%3.0" /end MEASUREMENT
/begin MEASUREMENT St_mdk.B_asr_akt "Bedingung ASR aktiv" UBYTE _CNV_S_1_Def_bit_ub_700_CM 1 100. 0. 0. DISPLAY_IDENTIFIER B_ASR_AKT ECU_ADDRESS 0xd000744d BIT_MASK 0x2 /end MEASUREMENT
/begin MEASUREMENT St_mdk.B_getr_plus "Bedingung B_getr_plus" UBYTE _CNV_S_1_Def_bit_ub_700_CM 1 100. 0. 0. DISPLAY_IDENTIFIER B_GETR_PLUS ECU_ADDRESS 0xd000744d BIT_MASK 0x40 /end MEASUREMENT
/begin MEASUREMENT St_mdk.B_md_dynman "Bedingung Dynamik" UBYTE _CNV_S_1_Def_bit_ub_700_CM 1 100. 0. 0. DISPLAY_IDENTIFIER B_MD_DYNMAN ECU_ADDRESS 0xd000744d BIT_MASK 0x4 /end MEASUREMENT
/begin MEASUREMENT St_mdk.B_mdk_plus "Bedingung Momentenerhöhung auf langsamen Pfad" UBYTE _CNV_S_1_Def_bit_ub_700_CM 1 100. 0. 0. DISPLAY_IDENTIFIER B_MDK_PLUS ECU_ADDRESS 0xd000744d BIT_MASK 0x1 /end MEASUREMENT
/begin MEASUREMENT St_mdk.B_msr_aktiv "Bedingung MSR" UBYTE _CNV_S_1_Def_bit_ub_700_CM 1 100. 0. 0. DISPLAY_IDENTIFIER B_MSR_AKTIV ECU_ADDRESS 0xd000744d BIT_MASK 0x10 /end MEASUREMENT
/begin MEASUREMENT St_mdk.B_san "Bedingung SA verboten" UBYTE _CNV_S_1_Def_bit_ub_700_CM 1 100. 0. 0. DISPLAY_IDENTIFIER B_SAN ECU_ADDRESS 0xd000744d BIT_MASK 0x80 /end MEASUREMENT
/begin MEASUREMENT St_mdk.B_siko_akt "Bedingung Sicherheitseingriff aktiv" UBYTE _CNV_S_1_Def_bit_ub_700_CM 1 100. 0. 0. DISPLAY_IDENTIFIER B_SIKO_AKT ECU_ADDRESS 0xd000744d BIT_MASK 0x20 /end MEASUREMENT
/begin MEASUREMENT St_mdk.B_zw_dynman "Bedingung Dynamik" UBYTE _CNV_S_1_Def_bit_ub_700_CM 1 100. 0. 0. DISPLAY_IDENTIFIER B_ZW_DYNMAN ECU_ADDRESS 0xd000744d BIT_MASK 0x8 /end MEASUREMENT
/begin MEASUREMENT St_mdk1 "Status Momentenkoordination" UWORD _CNV_R_R_Def_dez_sl_575_CM 1 100. 0. 65535. DISPLAY_IDENTIFIER ST_MDK1 ECU_ADDRESS 0xd000746e FORMAT "%5.0" /end MEASUREMENT
/begin MEASUREMENT St_mdk1.B_mdzw_min1 "Status Momentenkoordination" UWORD _CNV_S_1_Def_bit_ub_700_CM 1 100. 0. 0. DISPLAY_IDENTIFIER B_MDZW_MIN1 ECU_ADDRESS 0xd000746e BIT_MASK 0x2 /end MEASUREMENT
/begin MEASUREMENT St_mdk1.B_mdzw_min2 "Status Momentenkoordination" UWORD _CNV_S_1_Def_bit_ub_700_CM 1 100. 0. 0. DISPLAY_IDENTIFIER B_MDZW_MIN2 ECU_ADDRESS 0xd000746e BIT_MASK 0x4 /end MEASUREMENT
/begin MEASUREMENT St_mdk1.B_mdzw_plus "Status Momentenkoordination" UWORD _CNV_S_1_Def_bit_ub_700_CM 1 100. 0. 0. DISPLAY_IDENTIFIER B_MDZW_PLUS ECU_ADDRESS 0xd000746e BIT_MASK 0x1 /end MEASUREMENT
/begin MEASUREMENT St_mdk1.B_zwe_ar "Status Momentenkoordination" UWORD _CNV_S_1_Def_bit_ub_700_CM 1 100. 0. 0. DISPLAY_IDENTIFIER B_ZWE_AR ECU_ADDRESS 0xd000746e BIT_MASK 0x100 /end MEASUREMENT
/begin MEASUREMENT St_mdk1.B_zwe_fzdyn "Status Momentenkoordination" UWORD _CNV_S_1_Def_bit_ub_700_CM 1 100. 0. 0. DISPLAY_IDENTIFIER B_ZWE_FZDYN ECU_ADDRESS 0xd000746e BIT_MASK 0x20 /end MEASUREMENT
/begin MEASUREMENT St_mdk1.B_zwe_kh "Status Momentenkoordination" UWORD _CNV_S_1_Def_bit_ub_700_CM 1 100. 0. 0. DISPLAY_IDENTIFIER B_ZWE_KH ECU_ADDRESS 0xd000746e BIT_MASK 0x8 /end MEASUREMENT
/begin MEASUREMENT St_mdk1.B_zwe_kupp "Status Momentenkoordination" UWORD _CNV_S_1_Def_bit_ub_700_CM 1 100. 0. 0. DISPLAY_IDENTIFIER B_ZWE_KUPP ECU_ADDRESS 0xd000746e BIT_MASK 0x80 /end MEASUREMENT
/begin MEASUREMENT St_mdk1.B_zwe_llr "Status Momentenkoordination" UWORD _CNV_S_1_Def_bit_ub_700_CM 1 100. 0. 0. DISPLAY_IDENTIFIER B_ZWE_LLR ECU_ADDRESS 0xd000746e BIT_MASK 0x40 /end MEASUREMENT
/begin MEASUREMENT St_mdk1.B_zwe_res "Status Momentenkoordination" UWORD _CNV_S_1_Def_bit_ub_700_CM 1 100. 0. 0. DISPLAY_IDENTIFIER B_ZWE_RES ECU_ADDRESS 0xd000746e BIT_MASK 0x10 /end MEASUREMENT
/begin MEASUREMENT St_mdk1.B_zwe_resa "Status Momentenkoordination" UWORD _CNV_S_1_Def_bit_ub_700_CM 1 100. 0. 0. DISPLAY_IDENTIFIER B_ZWE_RESA ECU_ADDRESS 0xd000746e BIT_MASK 0x800 /end MEASUREMENT
/begin MEASUREMENT St_mdk1.B_zwe_sa "Status Momentenkoordination" UWORD _CNV_S_1_Def_bit_ub_700_CM 1 100. 0. 0. DISPLAY_IDENTIFIER B_ZWE_SA ECU_ADDRESS 0xd000746e BIT_MASK 0x400 /end MEASUREMENT
/begin MEASUREMENT St_mdk1.B_zwe_start "Status Momentenkoordination" UWORD _CNV_S_1_Def_bit_ub_700_CM 1 100. 0. 0. DISPLAY_IDENTIFIER B_ZWE_START ECU_ADDRESS 0xd000746e BIT_MASK 0x200 /end MEASUREMENT
/begin MEASUREMENT St_mdk2 "Status Momentenkoordination" UWORD _CNV_R_R_Def_dez_sl_575_CM 1 100. 0. 65535. DISPLAY_IDENTIFIER ST_MDK2 ECU_ADDRESS 0xd0007454 FORMAT "%5.0" /end MEASUREMENT
/begin MEASUREMENT St_mdk2.B_accl_plus "Status Momentenkoordination" UWORD _CNV_S_1_Def_bit_ub_700_CM 1 100. 0. 0. DISPLAY_IDENTIFIER B_ACCL_PLUS ECU_ADDRESS 0xd0007454 BIT_MASK 0x40 /end MEASUREMENT
/begin MEASUREMENT St_mdk2.B_accs_plus "Status Momentenkoordination" UWORD _CNV_S_1_Def_bit_ub_700_CM 1 100. 0. 0. DISPLAY_IDENTIFIER B_ACCS_PLUS ECU_ADDRESS 0xd0007454 BIT_MASK 0x2000 /end MEASUREMENT
/begin MEASUREMENT St_mdk2.B_asr_l "Status Momentenkoordination" UWORD _CNV_S_1_Def_bit_ub_700_CM 1 100. 0. 0. DISPLAY_IDENTIFIER B_ASR_L ECU_ADDRESS 0xd0007454 BIT_MASK 0x1 /end MEASUREMENT
/begin MEASUREMENT St_mdk2.B_asr_s "Status Momentenkoordination" UWORD _CNV_S_1_Def_bit_ub_700_CM 1 100. 0. 0. DISPLAY_IDENTIFIER B_ASR_S ECU_ADDRESS 0xd0007454 BIT_MASK 0x80 /end MEASUREMENT
/begin MEASUREMENT St_mdk2.B_gsl_minus "Status Momentenkoordination" UWORD _CNV_S_1_Def_bit_ub_700_CM 1 100. 0. 0. DISPLAY_IDENTIFIER B_GSL_MINUS ECU_ADDRESS 0xd0007454 BIT_MASK 0x2 /end MEASUREMENT
/begin MEASUREMENT St_mdk2.B_gsl_plus "Status Momentenkoordination" UWORD _CNV_S_1_Def_bit_ub_700_CM 1 100. 0. 0. DISPLAY_IDENTIFIER B_GSL_PLUS ECU_ADDRESS 0xd0007454 BIT_MASK 0x8 /end MEASUREMENT
/begin MEASUREMENT St_mdk2.B_gss_minus "Status Momentenkoordination" UWORD _CNV_S_1_Def_bit_ub_700_CM 1 100. 0. 0. DISPLAY_IDENTIFIER B_GSS_MINUS ECU_ADDRESS 0xd0007454 BIT_MASK 0x100 /end MEASUREMENT
/begin MEASUREMENT St_mdk2.B_gss_plus "Status Momentenkoordination" UWORD _CNV_S_1_Def_bit_ub_700_CM 1 100. 0. 0. DISPLAY_IDENTIFIER B_GSS_PLUS ECU_ADDRESS 0xd0007454 BIT_MASK 0x400 /end MEASUREMENT
/begin MEASUREMENT St_mdk2.B_mdres_wm "Status Momentenkoordination" UWORD _CNV_S_1_Def_bit_ub_700_CM 1 100. 0. 0. DISPLAY_IDENTIFIER B_MDRES_WM ECU_ADDRESS 0xd0007454 BIT_MASK 0x4000 /end MEASUREMENT
/begin MEASUREMENT St_mdk2.B_msr_l "Status Momentenkoordination" UWORD _CNV_S_1_Def_bit_ub_700_CM 1 100. 0. 0. DISPLAY_IDENTIFIER B_MSR_L ECU_ADDRESS 0xd0007454 BIT_MASK 0x20 /end MEASUREMENT
/begin MEASUREMENT St_mdk2.B_msr_s "Status Momentenkoordination" UWORD _CNV_S_1_Def_bit_ub_700_CM 1 100. 0. 0. DISPLAY_IDENTIFIER B_MSR_S ECU_ADDRESS 0xd0007454 BIT_MASK 0x1000 /end MEASUREMENT
/begin MEASUREMENT St_mdk2.B_smgl_minus "Status Momentenkoordination" UWORD _CNV_S_1_Def_bit_ub_700_CM 1 100. 0. 0. DISPLAY_IDENTIFIER B_SMGL_MINUS ECU_ADDRESS 0xd0007454 BIT_MASK 0x4 /end MEASUREMENT
/begin MEASUREMENT St_mdk2.B_smgl_plus "Status Momentenkoordination" UWORD _CNV_S_1_Def_bit_ub_700_CM 1 100. 0. 0. DISPLAY_IDENTIFIER B_SMGL_PLUS ECU_ADDRESS 0xd0007454 BIT_MASK 0x10 /end MEASUREMENT
/begin MEASUREMENT St_mdk2.B_smgs_minus "Status Momentenkoordination" UWORD _CNV_S_1_Def_bit_ub_700_CM 1 100. 0. 0. DISPLAY_IDENTIFIER B_SMGS_MINUS ECU_ADDRESS 0xd0007454 BIT_MASK 0x200 /end MEASUREMENT
/begin MEASUREMENT St_mdk2.B_smgs_plus "Status Momentenkoordination" UWORD _CNV_S_1_Def_bit_ub_700_CM 1 100. 0. 0. DISPLAY_IDENTIFIER B_SMGS_PLUS ECU_ADDRESS 0xd0007454 BIT_MASK 0x800 /end MEASUREMENT
/begin MEASUREMENT St_mdk3 "Status Momentenkoordination" UBYTE _CNV_R_R_Def_dez_sl_575_CM 1 100. 0. 255. DISPLAY_IDENTIFIER ST_MDK3 ECU_ADDRESS 0xd000744c FORMAT "%3.0" /end MEASUREMENT
/begin MEASUREMENT St_mdk3.B_hd "Status Momentenkoordination" UBYTE _CNV_S_1_Def_bit_ub_700_CM 1 100. 0. 0. DISPLAY_IDENTIFIER B_HD ECU_ADDRESS 0xd000744c BIT_MASK 0x4 /end MEASUREMENT
/begin MEASUREMENT St_mdk3.B_nwehd "Status Momentenkoordination" UBYTE _CNV_S_1_Def_bit_ub_700_CM 1 100. 0. 0. DISPLAY_IDENTIFIER B_NWEHD ECU_ADDRESS 0xd000744c BIT_MASK 0x1 /end MEASUREMENT
/begin MEASUREMENT St_mdk3.B_vhd "Status Momentenkoordination" UBYTE _CNV_S_1_Def_bit_ub_700_CM 1 100. 0. 0. DISPLAY_IDENTIFIER B_VHD ECU_ADDRESS 0xd000744c BIT_MASK 0x2 /end MEASUREMENT
/begin MEASUREMENT St_mdna "" UBYTE _CNV_R_R_Def_dez_sl_575_CM 1 100. 0. 255. DISPLAY_IDENTIFIER ST_MDNA ECU_ADDRESS 0xd00078ac FORMAT "%3.0" /end MEASUREMENT
/begin MEASUREMENT St_mdna.B_lastab "Bedingung Anforderung Lastabwurf" UBYTE _CNV_S_1_Def_bit_ub_700_CM 1 100. 0. 0. DISPLAY_IDENTIFIER B_LASTAB ECU_ADDRESS 0xd00078ac BIT_MASK 0x1 /end MEASUREMENT
/begin MEASUREMENT St_priodiag "Statuswort" UBYTE _CNV_R_R_Def_dez_sl_575_CM 1 100. 0. 255. DISPLAY_IDENTIFIER ST_PRIODIAG ECU_ADDRESS 0xd00073de FORMAT "%3.0" /end MEASUREMENT
/begin MEASUREMENT St_priodiag.B_badif_bv "Umschaltung aktiv" UBYTE _CNV_S_1_Def_bit_ub_700_CM 1 100. 0. 0. DISPLAY_IDENTIFIER B_BADIF_BV ECU_ADDRESS 0xd00073de BIT_MASK 0x2 /end MEASUREMENT
/begin MEASUREMENT St_priodiag.B_badif_prio "Setzen Ba_soll aktiv" UBYTE _CNV_S_1_Def_bit_ub_700_CM 1 100. 0. 0. DISPLAY_IDENTIFIER B_BADIF_PRIO ECU_ADDRESS 0xd00073de BIT_MASK 0x1 /end MEASUREMENT
/begin MEASUREMENT St_priodiag.B_bv_haeng "Umschaltung hängt" UBYTE _CNV_S_1_Def_bit_ub_700_CM 1 100. 0. 0. DISPLAY_IDENTIFIER B_BV_HAENG ECU_ADDRESS 0xd00073de BIT_MASK 0x8 /end MEASUREMENT
/begin MEASUREMENT St_priodiag.B_prio_haeng "Priorisierung hängt in Setzen vom Sollwert" UBYTE _CNV_S_1_Def_bit_ub_700_CM 1 100. 0. 0. DISPLAY_IDENTIFIER B_PRIO_HAENG ECU_ADDRESS 0xd00073de BIT_MASK 0x4 /end MEASUREMENT
/begin MEASUREMENT St_priodiag.B_prio_not "Notfallmassnahme wegen Zeitdauer Quittungen" UBYTE _CNV_S_1_Def_bit_ub_700_CM 1 100. 0. 0. DISPLAY_IDENTIFIER B_PRIO_NOT ECU_ADDRESS 0xd00073de BIT_MASK 0x10 /end MEASUREMENT
/begin MEASUREMENT St_priodiag.B_quit_notl "Übergehen der Quittungen durch Notlauf" UBYTE _CNV_S_1_Def_bit_ub_700_CM 1 100. 0. 0. DISPLAY_IDENTIFIER B_QUIT_NOTL ECU_ADDRESS 0xd00073de BIT_MASK 0x40 /end MEASUREMENT
/begin MEASUREMENT St_priodiag.B_ums_not "Auswahl Notfallmassnahme" UBYTE _CNV_S_1_Def_bit_ub_700_CM 1 100. 0. 0. DISPLAY_IDENTIFIER B_UMS_NOT ECU_ADDRESS 0xd00073de BIT_MASK 0x20 /end MEASUREMENT
/begin MEASUREMENT St_priodiag.B_ums_notl "Notfall Umschaltung sofort" UBYTE _CNV_S_1_Def_bit_ub_700_CM 1 100. 0. 0. DISPLAY_IDENTIFIER B_UMS_NOTL ECU_ADDRESS 0xd00073de BIT_MASK 0x80 /end MEASUREMENT
/begin MEASUREMENT St_rf1 "Status" UBYTE _CNV_R_R_Def_dez_sl_575_CM 1 100. 0. 255. DISPLAY_IDENTIFIER ST_RF1 ECU_ADDRESS 0xd0007891 FORMAT "%3.0" /end MEASUREMENT
/begin MEASUREMENT St_rf1.B_dps_lamd "Status" UBYTE _CNV_S_1_Def_bit_ub_700_CM 1 100. 0. 0. DISPLAY_IDENTIFIER B_DPS_LAMD ECU_ADDRESS 0xd0007891 BIT_MASK 0x4 /end MEASUREMENT
/begin MEASUREMENT St_rf1.B_la_md "Bedingung Lavorgabe aus Momentenstruktur" UBYTE _CNV_S_1_Def_bit_ub_700_CM 1 100. 0. 0. DISPLAY_IDENTIFIER B_LA_MD ECU_ADDRESS 0xd0007891 BIT_MASK 0x1 /end MEASUREMENT
/begin MEASUREMENT St_rf1.B_la_zwmd "Status" UBYTE _CNV_S_1_Def_bit_ub_700_CM 1 100. 0. 0. DISPLAY_IDENTIFIER B_LA_ZWMD ECU_ADDRESS 0xd0007891 BIT_MASK 0x2 /end MEASUREMENT
/begin MEASUREMENT St_rf1.B_v_lamd "Status" UBYTE _CNV_S_1_Def_bit_ub_700_CM 1 100. 0. 0. DISPLAY_IDENTIFIER B_V_LAMD ECU_ADDRESS 0xd0007891 BIT_MASK 0x8 /end MEASUREMENT
/begin MEASUREMENT St_ti_b "" UBYTE _CNV_R_R_Def_dez_sl_575_CM 1 100. 0. 255. DISPLAY_IDENTIFIER ST_TI_B ECU_ADDRESS 0xd000751c FORMAT "%3.0" /end MEASUREMENT
/begin MEASUREMENT St_ti_b.B_temxon "Rf-Begrenzung aktiv" UBYTE _CNV_S_1_Def_bit_ub_700_CM 1 100. 0. 0. DISPLAY_IDENTIFIER B_TEMXON ECU_ADDRESS 0xd000751c BIT_MASK 0x1 /end MEASUREMENT
/begin MEASUREMENT St_tiausgang "" UBYTE _CNV_R_R_Def_dez_sl_575_CM 1 100. 0. 255. DISPLAY_IDENTIFIER ST_TIAUSGANG ECU_ADDRESS 0xd0007394 FORMAT "%3.0" /end MEASUREMENT
/begin MEASUREMENT St_tiausgang.B_esp_h1 "Bedingung Einspritzung homogen - Bank 1" UBYTE _CNV_S_1_Def_bit_ub_700_CM 1 100. 0. 0. DISPLAY_IDENTIFIER B_ESP_H1 ECU_ADDRESS 0xd0007394 BIT_MASK 0x1 /end MEASUREMENT
/begin MEASUREMENT St_tiausgang.B_esp_h2 "Bedingung Einspritzung homogen - Bank 2" UBYTE _CNV_S_1_Def_bit_ub_700_CM 1 100. 0. 0. DISPLAY_IDENTIFIER B_ESP_H2 ECU_ADDRESS 0xd0007394 BIT_MASK 0x2 /end MEASUREMENT
/begin MEASUREMENT St_tiausgang.B_esp_hs1 "Bedingung Einspritzung Homogenschicht - Bank 1" UBYTE _CNV_S_1_Def_bit_ub_700_CM 1 100. 0. 0. DISPLAY_IDENTIFIER B_ESP_HS1 ECU_ADDRESS 0xd0007394 BIT_MASK 0x4 /end MEASUREMENT
/begin MEASUREMENT St_tiausgang.B_esp_hs2 "Bedingung Einspritzung Homogenschicht - Bank 2" UBYTE _CNV_S_1_Def_bit_ub_700_CM 1 100. 0. 0. DISPLAY_IDENTIFIER B_ESP_HS2 ECU_ADDRESS 0xd0007394 BIT_MASK 0x8 /end MEASUREMENT
/begin MEASUREMENT St_tiausgang.B_rw_h "Bedingung Einspritzung Homogen" UBYTE _CNV_S_1_Def_bit_ub_700_CM 1 100. 0. 0. DISPLAY_IDENTIFIER B_RW_H ECU_ADDRESS 0xd0007394 BIT_MASK 0x1 /end MEASUREMENT
/begin MEASUREMENT T_ar_aus "Aktiv-Zeit Ar" UWORD _CNV_R_R_Def_td_uw__679_CM 1 100. 0. 655.35 DISPLAY_IDENTIFIER T_AR_AUS ECU_ADDRESS 0xd00074dc FORMAT "%7.2" /end MEASUREMENT
/begin MEASUREMENT T_babr "Fehlerzähler " UBYTE _CNV_R_R_Def_dez_sl_575_CM 1 100. 0. 255. DISPLAY_IDENTIFIER T_BABR ECU_ADDRESS 0xd000741d FORMAT "%3.0" /end MEASUREMENT
/begin MEASUREMENT T_p_ar "" UWORD _CNV_R_R_Def_dez_sl_575_CM 1 100. 0. 65535. DISPLAY_IDENTIFIER T_P_AR ECU_ADDRESS 0xd00074e0 FORMAT "%5.0" /end MEASUREMENT
/begin MEASUREMENT T_quit "Zeitdauer hängende Quittierungen" UWORD _CNV_R_R_Def_td_uw__679_CM 1 100. 0. 655.35 DISPLAY_IDENTIFIER T_QUIT ECU_ADDRESS 0xd0007402 FORMAT "%7.2" /end MEASUREMENT
/begin MEASUREMENT T_tevzu "Wartezeit für TEV geschlossen nach BA Wechsel" UWORD _CNV_R_R_Def_td_uw__679_CM 1 100. 0. 655.35 DISPLAY_IDENTIFIER T_TEVZU ECU_ADDRESS 0xd00073d4 FORMAT "%7.2" /end MEASUREMENT
/begin MEASUREMENT T_umdreh_wt "Umdrehungszeit gewichtet" UWORD _CNV_R_R_Def_ti_uw__707_CM 1 100. 0. 838.848 DISPLAY_IDENTIFIER T_UMDREH_WT ECU_ADDRESS 0xd0007544 FORMAT "%8.3" /end MEASUREMENT
/begin MEASUREMENT T_umsch "Zeitdauer hängende Umschaltung" UWORD _CNV_R_R_Def_td_uw__679_CM 1 100. 0. 655.35 DISPLAY_IDENTIFIER T_UMSCH ECU_ADDRESS 0xd0007404 FORMAT "%7.2" /end MEASUREMENT
/begin MEASUREMENT T_vvt "Zeitkonstante VVT für Momentenaufbau" UBYTE _CNV_R_R_Def_t_ub_b_708_CM 1 100. 0. 0.996 DISPLAY_IDENTIFIER T_VVT ECU_ADDRESS 0xd00078ba /end MEASUREMENT
/begin MEASUREMENT Td_ar_an "Verzögerungszeit" UBYTE _CNV_R_R_Def_td_uw__679_CM 1 100. 0. 2.55 DISPLAY_IDENTIFIER TD_AR_AN ECU_ADDRESS 0xd00074d0 FORMAT "%5.2" /end MEASUREMENT
/begin MEASUREMENT Td_ar_ber "Verzögerungszeit" UWORD _CNV_R_R_Def_td_uw__679_CM 1 100. 0. 655.35 DISPLAY_IDENTIFIER TD_AR_BER ECU_ADDRESS 0xd00074d2 FORMAT "%7.2" /end MEASUREMENT
/begin MEASUREMENT Td_bastat_h "Zeit Homogen-Betrieb aktueller Motorlauf" UWORD _CNV_R_R_Def_td_ub__593_CM 1 100. 0. 6553.5 DISPLAY_IDENTIFIER TD_BASTAT_H ECU_ADDRESS 0xc00026d4 FORMAT "%6.1" /end MEASUREMENT
/begin MEASUREMENT Td_bastat_hs "Zeit Homogen-Schicht-Betrieb aktueller Motorlauf" UWORD _CNV_R_R_Def_td_ub__593_CM 1 100. 0. 6553.5 DISPLAY_IDENTIFIER TD_BASTAT_HS ECU_ADDRESS 0xc00026d6 FORMAT "%6.1" /end MEASUREMENT
/begin MEASUREMENT Td_bastat_s "Zeit Schicht-Betrieb aktueller Motorlauf" UWORD _CNV_R_R_Def_td_ub__593_CM 1 100. 0. 6553.5 DISPLAY_IDENTIFIER TD_BASTAT_S ECU_ADDRESS 0xc00026d8 FORMAT "%6.1" /end MEASUREMENT
/begin MEASUREMENT Td_bastat_sa "Zeit Schubabschalt-Betrieb aktueller Motorlauf" UWORD _CNV_R_R_Def_td_ub__593_CM 1 100. 0. 6553.5 DISPLAY_IDENTIFIER TD_BASTAT_SA ECU_ADDRESS 0xc00026da FORMAT "%6.1" /end MEASUREMENT
/begin MEASUREMENT Td_bastatg_h "Zeit Homogen-Betrieb gesamter Motorlauf" FLOAT32_IEEE _CNV_R_R_Def_dez_sl_575_CM 1 100. -3.40282346638529e+038 3.40282346638529e+038 DISPLAY_IDENTIFIER TD_BASTATG_H ECU_ADDRESS 0xc000467c FORMAT "%14.7" /end MEASUREMENT
/begin MEASUREMENT Td_bastatg_sa "Zeit Schubabschalt-Betrieb gesamter Motorlauf" FLOAT32_IEEE _CNV_R_R_Def_dez_sl_575_CM 1 100. -3.40282346638529e+038 3.40282346638529e+038 DISPLAY_IDENTIFIER TD_BASTATG_SA ECU_ADDRESS 0xc0004680 FORMAT "%14.7" /end MEASUREMENT
/begin MEASUREMENT Td_baststg_hs "Zeit Homogen-Schicht-Betrieb gesamter Motorlauf" FLOAT32_IEEE _CNV_R_R_Def_dez_sl_575_CM 1 100. -3.40282346638529e+038 3.40282346638529e+038 DISPLAY_IDENTIFIER TD_BASTSTG_HS ECU_ADDRESS 0xc0004684 FORMAT "%14.7" /end MEASUREMENT
/begin MEASUREMENT Td_baststg_s "Zeit Schicht-Betrieb gesamter Motorlauf" FLOAT32_IEEE _CNV_R_R_Def_dez_sl_575_CM 1 100. -3.40282346638529e+038 3.40282346638529e+038 DISPLAY_IDENTIFIER TD_BASTSTG_S ECU_ADDRESS 0xc0004688 FORMAT "%14.7" /end MEASUREMENT
/begin MEASUREMENT Td_kupp "Verzögerungszeit" UWORD _CNV_R_R_Def_td_uw__679_CM 1 100. 0. 655.35 DISPLAY_IDENTIFIER TD_KUPP ECU_ADDRESS 0xd00074d4 FORMAT "%7.2" /end MEASUREMENT
/begin MEASUREMENT Tddpslamd "Verzögerungszeit" UWORD _CNV_R_R_Def_td_uw__679_CM 1 100. 0. 655.35 DISPLAY_IDENTIFIER TDDPSLAMD ECU_ADDRESS 0xd000789e FORMAT "%7.2" /end MEASUREMENT
/begin MEASUREMENT Tdlamdaus "Verzögerungszeit" UWORD _CNV_R_R_Def_td_uw__679_CM 1 100. 0. 655.35 DISPLAY_IDENTIFIER TDLAMDAUS ECU_ADDRESS 0xd000789a FORMAT "%7.2" /end MEASUREMENT
/begin MEASUREMENT Tdlamdein "Verzögerungszeit" UWORD _CNV_R_R_Def_td_uw__679_CM 1 100. 0. 655.35 DISPLAY_IDENTIFIER TDLAMDEIN ECU_ADDRESS 0xd00078a0 FORMAT "%7.2" /end MEASUREMENT
/begin MEASUREMENT Tdlamdein2 "Verzögerungszeit" UWORD _CNV_R_R_Def_td_uw__679_CM 1 100. 0. 655.35 DISPLAY_IDENTIFIER TDLAMDEIN2 ECU_ADDRESS 0xd000789c FORMAT "%7.2" /end MEASUREMENT
/begin MEASUREMENT Tdmax_bawbeopt "Maximale Wartezeit für verbrauchsoptimalen BA-Wechsel" UWORD _CNV_R_R_Def_td_uw__679_CM 1 100. 0. 655.35 DISPLAY_IDENTIFIER TDMAX_BAWBEOPT ECU_ADDRESS 0xd00073d2 FORMAT "%7.2" /end MEASUREMENT
/begin MEASUREMENT Tdnschalt "Verzögerungszeit Anschlussdrehzahlrampe" UWORD _CNV_R_R_Def_td_uw__679_CM 1 100. 0. 655.35 DISPLAY_IDENTIFIER TDNSCHALT ECU_ADDRESS 0xd00074a8 FORMAT "%7.2" /end MEASUREMENT
/begin MEASUREMENT Tdschalt_max "Verzögerungszeit Abschaltung Anschlussdrehzahlregelung" UWORD _CNV_R_R_Def_td_uw__679_CM 1 100. 0. 655.35 DISPLAY_IDENTIFIER TDSCHALT_MAX ECU_ADDRESS 0xd00074a6 FORMAT "%7.2" /end MEASUREMENT
/begin MEASUREMENT Ti_quot "Quotient Tseg/Ti" UWORD _CNV_R_R_Def_f_uw_b_579_CM 1 100. 0. 1.9999 DISPLAY_IDENTIFIER TI_QUOT ECU_ADDRESS 0xd0007542 FORMAT "%14.5" /end MEASUREMENT
/begin MEASUREMENT Var_at "" UBYTE _CNV_R_R_Def_dez_sl_575_CM 1 100. 0. 1. DISPLAY_IDENTIFIER VAR_AT ECU_ADDRESS 0xd0007348 FORMAT "%3.0" /end MEASUREMENT
/begin MEASUREMENT Wandler_mu "Wirkungsgrad/Momentenüberhöhung des Wandlers" UBYTE _CNV_R_R_Def_f_ub_b_733_CM 1 100. 0. 3. DISPLAY_IDENTIFIER WANDLER_MU ECU_ADDRESS 0xd0007392 FORMAT "%5.2" /end MEASUREMENT
/begin MEASUREMENT Zr_entpr_fl "Entprellzähler für Aktivierung Flankendetektor" UBYTE _CNV_R_R_Def_dez_sl_575_CM 1 100. 0. 255. DISPLAY_IDENTIFIER ZR_ENTPR_FL ECU_ADDRESS 0xd00074d8 FORMAT "%3.0" /end MEASUREMENT
/begin MEASUREMENT Zr_fl_ar "Zähler für Flankendetektor" UBYTE _CNV_R_R_Def_dez_sl_575_CM 1 100. 0. 255. DISPLAY_IDENTIFIER ZR_FL_AR ECU_ADDRESS 0xd00074d7 FORMAT "%3.0" /end MEASUREMENT
/begin MEASUREMENT Zr_schwingung_ar "Zähler Ruckelschwingungen" UBYTE _CNV_R_R_Def_dez_sl_575_CM 1 100. 0. 255. DISPLAY_IDENTIFIER ZR_SCHWINGUNG_AR ECU_ADDRESS 0xd00074d6 FORMAT "%3.0" /end MEASUREMENT
/begin MEASUREMENT Zr_vbar "Zähler AR verboten" UWORD _CNV_R_R_Def_td_uw__679_CM 1 100. 0. 655.35 DISPLAY_IDENTIFIER ZR_VBAR ECU_ADDRESS 0xd00074de FORMAT "%7.2" /end MEASUREMENT
/begin MEASUREMENT Zw_grund_nl "Grundzündwinkel, Notlauf" SWORD _CNV_R_R_Def_zw_sw__599_CM 1 100. -50. 60. DISPLAY_IDENTIFIER ZW_GRUND_NL ECU_ADDRESS 0xd00078d6 FORMAT "%6.1" /end MEASUREMENT
/begin MEASUREMENT Zw_opt_nl "Optimalzündwinkel, Notlauf" SWORD _CNV_R_R_Def_zw_sw__599_CM 1 100. -50. 60. DISPLAY_IDENTIFIER ZW_OPT_NL ECU_ADDRESS 0xd00078d8 FORMAT "%6.1" /end MEASUREMENT
/begin CHARACTERISTIC CW_AR "Freigabe AR bei Ll, B_lsd, B_dash" VALUE 0xa101921e _REC_VAL_20_u1 99.45 _CNV_R_R_Def_dez_sl_575_CM 0. 255. FORMAT "%3.0" /end CHARACTERISTIC
/begin CHARACTERISTIC CW_BANOAPPL "Umschalten aus Applikationsswert für St_bano" VALUE 0xa101903a _REC_VAL_20_u1 1. _CNV_R_R_Def_dez_sl_575_CM 0. 1. FORMAT "%3.0" /end CHARACTERISTIC
/begin CHARACTERISTIC CW_BAWLL "Schalter um LL in BA Koordination zu Simulieren" VALUE 0xa101903b _REC_VAL_20_u1 1. _CNV_R_R_Def_dez_sl_575_CM 0. 1. FORMAT "%3.0" /end CHARACTERISTIC
/begin CHARACTERISTIC CW_BAWVL "Schalter um LL in BA Koordination zu Simulieren" VALUE 0xa101903c _REC_VAL_20_u1 1. _CNV_R_R_Def_dez_sl_575_CM 0. 1. FORMAT "%3.0" /end CHARACTERISTIC
/begin CHARACTERISTIC CW_DYNMAN "Codewort Dynamikmanager" VALUE 0xa10190de _REC_VAL_20_u2 0. _CNV_R_R_Def_dez_sl_575_CM 0. 65535. FORMAT "%5.0" /end CHARACTERISTIC
/begin CHARACTERISTIC CW_FMKNUL "Codewort Berechnungsart Bereich" VALUE 0xa1017e29 _REC_VAL_20_u1 99.45 _CNV_R_R_Def_dez_sl_575_CM 0. 255. FORMAT "%3.0" /end CHARACTERISTIC
/begin CHARACTERISTIC CW_GLAKTIV "" VALUE 0xa101901c _REC_VAL_20_u1 99.45 _CNV_R_R_Def_dez_sl_575_CM 0. 255. FORMAT "%3.0" /end CHARACTERISTIC
/begin CHARACTERISTIC CW_LLBA "Leerlauf in Schicht oder Homogen" VALUE 0xa101903d _REC_VAL_20_u1 1. _CNV_R_R_Def_dez_sl_575_CM 0. 1. FORMAT "%3.0" /end CHARACTERISTIC
/begin CHARACTERISTIC CW_MDLA_VAR "variantenabhängige Freischaltung magerer Ll" VALUE 0xa101c98c _REC_VAL_20_u1 99.45 _CNV_R_R_Def_dez_sl_575_CM 0. 255. FORMAT "%3.0" /end CHARACTERISTIC
/begin CHARACTERISTIC CW_MD_TURBO "Codeword MD Berechnung - TURBO Modus" VALUE 0xa10194f8 _REC_VAL_20_u1 99.45 _CNV_R_R_Def_dez_sl_575_CM 0. 255. FORMAT "%3.0" /end CHARACTERISTIC
/begin CHARACTERISTIC CW_NA "Codewort Nebenaggregate" VALUE 0xa101ca5d _REC_VAL_20_u1 99.45 _CNV_R_R_Def_dez_sl_575_CM 0. 255. FORMAT "%3.0" /end CHARACTERISTIC
/begin CHARACTERISTIC CW_NOTLAUF "" VALUE 0xa101cf8a _REC_VAL_20_u2 0. _CNV_R_R_Def_dez_sl_575_CM 0. 65535. FORMAT "%5.0" /end CHARACTERISTIC
/begin CHARACTERISTIC CW_RGN "Codewort Kat Regeneration" VALUE 0xa101903e _REC_VAL_20_u1 7. _CNV_R_R_Def_dez_sl_575_CM 0. 7. FORMAT "%3.0" /end CHARACTERISTIC
/begin CHARACTERISTIC CW_S_SPORT "Codewort Wirkung Sportschalter auf Momentengradientenbereich" VALUE 0xa1017e2a _REC_VAL_20_u1 99.45 _CNV_R_R_Def_dez_sl_575_CM 0. 255. FORMAT "%3.0" /end CHARACTERISTIC
/begin CHARACTERISTIC CW_TRQTR1 "Codewort Softwareschalter 1 für Änderungsbegrenzung" VALUE 0xa1017e2b _REC_VAL_20_u1 99.45 _CNV_R_R_Def_dez_sl_575_CM 0. 255. FORMAT "%3.0" /end CHARACTERISTIC
/begin CHARACTERISTIC CW_TRQTR2 "Codewort Softwareschalter 2 für Änderungsbegrenzung" VALUE 0xa1017e2c _REC_VAL_20_u1 99.45 _CNV_R_R_Def_dez_sl_575_CM 0. 255. FORMAT "%3.0" /end CHARACTERISTIC
/begin CHARACTERISTIC CW_TZKMDMX "" VALUE 0xa1019983 _REC_VAL_20_u1 99.45 _CNV_R_R_Def_dez_sl_575_CM 0. 255. FORMAT "%3.0" /end CHARACTERISTIC
/begin CHARACTERISTIC CW_UMS_FAST "Codewort zum Freischalten beschleunigte Umschaltungen" VALUE 0xa101903f _REC_VAL_20_u1 99.45 _CNV_R_R_Def_dez_sl_575_CM 0. 255. FORMAT "%3.0" /end CHARACTERISTIC
/begin CHARACTERISTIC CW_VAKTIV "Codewort zur Aktivierung Verbotsmatrix 1" VALUE 0xa1019028 _REC_VAL_20_u2 0. _CNV_R_R_Def_dez_sl_575_CM 0. 65535. FORMAT "%5.0" /end CHARACTERISTIC
/begin CHARACTERISTIC CW_VAKTIV2 "Codewort zur Aktivierung Verbotsmatrix 2" VALUE 0xa101902a _REC_VAL_20_u2 0. _CNV_R_R_Def_dez_sl_575_CM 0. 65535. FORMAT "%5.0" /end CHARACTERISTIC
/begin CHARACTERISTIC CW_VL "" VALUE 0xa1019982 _REC_VAL_20_u1 99.45 _CNV_R_R_Def_dez_sl_575_CM 0. 255. FORMAT "%3.0" /end CHARACTERISTIC
/begin CHARACTERISTIC KF_DMDP1 "Kennfeld Dashpot Momentengradient Bereich 1" MAP 0xa101802c _REC_MAP_52_UBYTE_s2_s2_u1 131.07 _CNV_R_R_Def_m_sw_q_574_CM -3276.8 3276.7 FORMAT "%5.2"
 /begin AXIS_DESCR STD_AXIS Nkw _CNV_R_R_Def_n_sw_q_612_CM 6 -32768. 32767. FORMAT "%5.0" /end AXIS_DESCR
 /begin AXIS_DESCR STD_AXIS Gangi _CNV_R_R_Def_dez_sl_575_CM 8 0. 255. FORMAT "%3.0" /end AXIS_DESCR
/end CHARACTERISTIC
/begin CHARACTERISTIC KF_DMDP1A "" MAP 0xa1018c9c _REC_MAP_52_UBYTE_s2_s2_u1 131.07 _CNV_R_R_Def_m_sw_q_574_CM -3276.8 3276.7 FORMAT "%5.2"
 /begin AXIS_DESCR STD_AXIS Nkw _CNV_R_R_Def_n_sw_q_612_CM 6 -32768. 32767. FORMAT "%5.0" /end AXIS_DESCR
 /begin AXIS_DESCR STD_AXIS Gangi _CNV_R_R_Def_dez_sl_575_CM 8 0. 255. FORMAT "%3.0" /end AXIS_DESCR
/end CHARACTERISTIC
/begin CHARACTERISTIC KF_DMDP2 "Kennfeld Dashpot Momentengradient Bereich 2" MAP 0xa1018894 _REC_MAP_52_UBYTE_s2_s2_u1 131.07 _CNV_R_R_Def_m_sw_q_574_CM -3276.8 3276.7 FORMAT "%5.2"
 /begin AXIS_DESCR STD_AXIS Nkw _CNV_R_R_Def_n_sw_q_612_CM 6 -32768. 32767. FORMAT "%5.0" /end AXIS_DESCR
 /begin AXIS_DESCR STD_AXIS Gangi _CNV_R_R_Def_dez_sl_575_CM 8 0. 255. FORMAT "%3.0" /end AXIS_DESCR
/end CHARACTERISTIC
/begin CHARACTERISTIC KF_DMDP2A "" MAP 0xa1018478 _REC_MAP_52_UBYTE_s2_s2_u1 131.07 _CNV_R_R_Def_m_sw_q_574_CM -3276.8 3276.7 FORMAT "%5.2"
 /begin AXIS_DESCR STD_AXIS Nkw _CNV_R_R_Def_n_sw_q_612_CM 6 -32768. 32767. FORMAT "%5.0" /end AXIS_DESCR
 /begin AXIS_DESCR STD_AXIS Gangi _CNV_R_R_Def_dez_sl_575_CM 8 0. 255. FORMAT "%3.0" /end AXIS_DESCR
/end CHARACTERISTIC
/begin CHARACTERISTIC KF_DMDP3 "Kennfeld Dashpot Momentengradient Bereich 3" MAP 0xa10182f8 _REC_MAP_52_UBYTE_s2_s2_u1 131.07 _CNV_R_R_Def_m_sw_q_574_CM -3276.8 3276.7 FORMAT "%5.2"
 /begin AXIS_DESCR STD_AXIS Nkw _CNV_R_R_Def_n_sw_q_612_CM 6 -32768. 32767. FORMAT "%5.0" /end AXIS_DESCR
 /begin AXIS_DESCR STD_AXIS Gangi _CNV_R_R_Def_dez_sl_575_CM 8 0. 255. FORMAT "%3.0" /end AXIS_DESCR
/end CHARACTERISTIC
/begin CHARACTERISTIC KF_DMDP3A "" MAP 0xa1018e98 _REC_MAP_52_UBYTE_s2_s2_u1 131.07 _CNV_R_R_Def_m_sw_q_574_CM -3276.8 3276.7 FORMAT "%5.2"
 /begin AXIS_DESCR STD_AXIS Nkw _CNV_R_R_Def_n_sw_q_612_CM 6 -32768. 32767. FORMAT "%5.0" /end AXIS_DESCR
 /begin AXIS_DESCR STD_AXIS Gangi _CNV_R_R_Def_dez_sl_575_CM 8 0. 255. FORMAT "%3.0" /end AXIS_DESCR
/end CHARACTERISTIC
/begin CHARACTERISTIC KF_DMDPON "Kennfeld Deltamoment Dashpotauslösung" MAP 0xa10186f4 _REC_MAP_52_UBYTE_s2_s2_u1 131.07 _CNV_R_R_Def_m_sw_q_574_CM -3276.8 3276.7 FORMAT "%5.2"
 /begin AXIS_DESCR STD_AXIS Mdk_wunsch _CNV_R_R_Def_m_sw_q_574_CM 6 -3276.8 3276.7 FORMAT "%5.2" /end AXIS_DESCR
 /begin AXIS_DESCR STD_AXIS Gangi _CNV_R_R_Def_dez_sl_575_CM 8 0. 255. FORMAT "%3.0" /end AXIS_DESCR
/end CHARACTERISTIC
/begin CHARACTERISTIC KF_DMLS1GD "Kennfeld Lastschlagdämpfung Momentengradient Bereich 1 GD" MAP 0xa1018840 _REC_MAP_52_UBYTE_s2_s2_u1 131.07 _CNV_R_R_Def_m_sw_q_574_CM -3276.8 3276.7 FORMAT "%5.2"
 /begin AXIS_DESCR STD_AXIS Nkw _CNV_R_R_Def_n_sw_q_612_CM 4 -32768. 32767. FORMAT "%5.0" /end AXIS_DESCR
 /begin AXIS_DESCR STD_AXIS Gangi _CNV_R_R_Def_dez_sl_575_CM 8 0. 255. FORMAT "%3.0" /end AXIS_DESCR
/end CHARACTERISTIC
/begin CHARACTERISTIC KF_DMLS1GDA "Kennfeld Lastschlagdämpfung Momentengradient Bereich 1 GD" MAP 0xa1018dcc _REC_MAP_52_UBYTE_s2_s2_u1 131.07 _CNV_R_R_Def_m_sw_q_574_CM -3276.8 3276.7 FORMAT "%5.2"
 /begin AXIS_DESCR STD_AXIS Nkw _CNV_R_R_Def_n_sw_q_612_CM 4 -32768. 32767. FORMAT "%5.0" /end AXIS_DESCR
 /begin AXIS_DESCR STD_AXIS Gangi _CNV_R_R_Def_dez_sl_575_CM 8 0. 255. FORMAT "%3.0" /end AXIS_DESCR
/end CHARACTERISTIC
/begin CHARACTERISTIC KF_DMLS1UD "Kennfeld Lastschlagdämpfung Momentengradient Bereich 1 UGD" MAP 0xa1018b90 _REC_MAP_52_UBYTE_s2_s2_u1 131.07 _CNV_R_R_Def_m_sw_q_574_CM -3276.8 3276.7 FORMAT "%5.2"
 /begin AXIS_DESCR STD_AXIS Nkw _CNV_R_R_Def_n_sw_q_612_CM 6 -32768. 32767. FORMAT "%5.0" /end AXIS_DESCR
 /begin AXIS_DESCR STD_AXIS Gangi _CNV_R_R_Def_dez_sl_575_CM 8 0. 255. FORMAT "%3.0" /end AXIS_DESCR
/end CHARACTERISTIC
/begin CHARACTERISTIC KF_DMLS1UDA "Kennfeld Lastschlagdämpfung Momentengradient Bereich 1 UGD" MAP 0xa1018208 _REC_MAP_52_UBYTE_s2_s2_u1 131.07 _CNV_R_R_Def_m_sw_q_574_CM -3276.8 3276.7 FORMAT "%5.2"
 /begin AXIS_DESCR STD_AXIS Nkw _CNV_R_R_Def_n_sw_q_612_CM 6 -32768. 32767. FORMAT "%5.0" /end AXIS_DESCR
 /begin AXIS_DESCR STD_AXIS Gangi _CNV_R_R_Def_dez_sl_575_CM 8 0. 255. FORMAT "%3.0" /end AXIS_DESCR
/end CHARACTERISTIC
/begin CHARACTERISTIC KF_DMLS2GD "Kennfeld Lastschlagdämpfung Momentengradient Bereich 2 GD" MAP 0xa10186a0 _REC_MAP_52_UBYTE_s2_s2_u1 131.07 _CNV_R_R_Def_m_sw_q_574_CM -3276.8 3276.7 FORMAT "%5.2"
 /begin AXIS_DESCR STD_AXIS Nkw _CNV_R_R_Def_n_sw_q_612_CM 4 -32768. 32767. FORMAT "%5.0" /end AXIS_DESCR
 /begin AXIS_DESCR STD_AXIS Gangi _CNV_R_R_Def_dez_sl_575_CM 8 0. 255. FORMAT "%3.0" /end AXIS_DESCR
/end CHARACTERISTIC
/begin CHARACTERISTIC KF_DMLS2GDA "Kennfeld Lastschlagdämpfung Momentengradient Bereich 2 GD" MAP 0xa1018c48 _REC_MAP_52_UBYTE_s2_s2_u1 131.07 _CNV_R_R_Def_m_sw_q_574_CM -3276.8 3276.7 FORMAT "%5.2"
 /begin AXIS_DESCR STD_AXIS Nkw _CNV_R_R_Def_n_sw_q_612_CM 4 -32768. 32767. FORMAT "%5.0" /end AXIS_DESCR
 /begin AXIS_DESCR STD_AXIS Gangi _CNV_R_R_Def_dez_sl_575_CM 8 0. 255. FORMAT "%3.0" /end AXIS_DESCR
/end CHARACTERISTIC
/begin CHARACTERISTIC KF_DMLS2UD "Kennfeld Lastschlagdämpfung Momentengradient Bereich 2 UGD" MAP 0xa101890c _REC_MAP_52_UBYTE_s2_s2_u1 131.07 _CNV_R_R_Def_m_sw_q_574_CM -3276.8 3276.7 FORMAT "%5.2"
 /begin AXIS_DESCR STD_AXIS Nkw _CNV_R_R_Def_n_sw_q_612_CM 6 -32768. 32767. FORMAT "%5.0" /end AXIS_DESCR
 /begin AXIS_DESCR STD_AXIS Gangi _CNV_R_R_Def_dez_sl_575_CM 8 0. 255. FORMAT "%3.0" /end AXIS_DESCR
/end CHARACTERISTIC
/begin CHARACTERISTIC KF_DMLS2UDA "Kennfeld Lastschlagdämpfung Momentengradient Bereich 2 UGD" MAP 0xa1017f10 _REC_MAP_52_UBYTE_s2_s2_u1 131.07 _CNV_R_R_Def_m_sw_q_574_CM -3276.8 3276.7 FORMAT "%5.2"
 /begin AXIS_DESCR STD_AXIS Nkw _CNV_R_R_Def_n_sw_q_612_CM 6 -32768. 32767. FORMAT "%5.0" /end AXIS_DESCR
 /begin AXIS_DESCR STD_AXIS Gangi _CNV_R_R_Def_dez_sl_575_CM 8 0. 255. FORMAT "%3.0" /end AXIS_DESCR
/end CHARACTERISTIC
/begin CHARACTERISTIC KF_DMLSDON "Kennfeld Deltamoment Lastschlagdämpfungsauslösung" MAP 0xa1018f10 _REC_MAP_52_UBYTE_s2_s2_u1 131.07 _CNV_R_R_Def_m_sw_q_574_CM -3276.8 3276.7 FORMAT "%5.2"
 /begin AXIS_DESCR STD_AXIS Mdk_w_f _CNV_R_R_Def_m_sw_q_574_CM 6 -3276.8 3276.7 FORMAT "%5.2" /end AXIS_DESCR
 /begin AXIS_DESCR STD_AXIS Gangi _CNV_R_R_Def_dez_sl_575_CM 8 0. 255. FORMAT "%3.0" /end AXIS_DESCR
/end CHARACTERISTIC
/begin CHARACTERISTIC KF_DMXLS3GD "Kennfeld Lastschlagdämpfung Momentengradient Bereich 3 GD" MAP 0xa1017f88 _REC_MAP_52_UBYTE_s2_s2_u1 131.07 _CNV_R_R_Def_m_sw_q_574_CM -3276.8 3276.7 FORMAT "%5.2"
 /begin AXIS_DESCR STD_AXIS Nkw _CNV_R_R_Def_n_sw_q_612_CM 4 -32768. 32767. FORMAT "%5.0" /end AXIS_DESCR
 /begin AXIS_DESCR STD_AXIS Gangi _CNV_R_R_Def_dez_sl_575_CM 8 0. 255. FORMAT "%3.0" /end AXIS_DESCR
/end CHARACTERISTIC
/begin CHARACTERISTIC KF_DMXLS3GDA "Kennfeld Lastschlagdämpfung Momentengradient Bereich 3 GD" MAP 0xa101864c _REC_MAP_52_UBYTE_s2_s2_u1 131.07 _CNV_R_R_Def_m_sw_q_574_CM -3276.8 3276.7 FORMAT "%5.2"
 /begin AXIS_DESCR STD_AXIS Nkw _CNV_R_R_Def_n_sw_q_612_CM 4 -32768. 32767. FORMAT "%5.0" /end AXIS_DESCR
 /begin AXIS_DESCR STD_AXIS Gangi _CNV_R_R_Def_dez_sl_575_CM 8 0. 255. FORMAT "%3.0" /end AXIS_DESCR
/end CHARACTERISTIC
/begin CHARACTERISTIC KF_DMXLS3UD "Kennfeld Lastschlagdämpfung Momentengradient Bereich 3 UGD" MAP 0xa10189fc _REC_MAP_52_UBYTE_s2_s2_u1 131.07 _CNV_R_R_Def_m_sw_q_574_CM -3276.8 3276.7 FORMAT "%5.2"
 /begin AXIS_DESCR STD_AXIS Nkw _CNV_R_R_Def_n_sw_q_612_CM 6 -32768. 32767. FORMAT "%5.0" /end AXIS_DESCR
 /begin AXIS_DESCR STD_AXIS Gangi _CNV_R_R_Def_dez_sl_575_CM 8 0. 255. FORMAT "%3.0" /end AXIS_DESCR
/end CHARACTERISTIC
/begin CHARACTERISTIC KF_DMXLS3UDA "Kennfeld Lastschlagdämpfung Momentengradient Bereich 3 UGD" MAP 0xa1018d54 _REC_MAP_52_UBYTE_s2_s2_u1 131.07 _CNV_R_R_Def_m_sw_q_574_CM -3276.8 3276.7 FORMAT "%5.2"
 /begin AXIS_DESCR STD_AXIS Nkw _CNV_R_R_Def_n_sw_q_612_CM 6 -32768. 32767. FORMAT "%5.0" /end AXIS_DESCR
 /begin AXIS_DESCR STD_AXIS Gangi _CNV_R_R_Def_dez_sl_575_CM 8 0. 255. FORMAT "%3.0" /end AXIS_DESCR
/end CHARACTERISTIC
/begin CHARACTERISTIC KF_DPSFTD "Kennfeld Faktor Saugrohrdruck UGD-TD-GD" MAP 0xa1018d14 _REC_MAP_52_u1_s2_s2 0.996 _CNV_R_R_Def_f_ub_b_573_CM 0. 0.996
 /begin AXIS_DESCR STD_AXIS Dpssolgd _CNV_R_R_Def_p_sw_q_578_CM 6 -1280. 1279.9609 FORMAT "%5.2" /end AXIS_DESCR
 /begin AXIS_DESCR STD_AXIS NO_INPUT_QUANTITY _CNV_R_R_Def_p_sw_q_578_CM 6 -1280. 1279.9609 FORMAT "%5.2" /end AXIS_DESCR
/end CHARACTERISTIC
/begin CHARACTERISTIC KF_D_PAR "" MAP 0xa1019344 _REC_MAP_52_UBYTE_s1_u1_s2 0.498 _CNV_R_R_Def_f_sb_b_738_CM -0.25 0.248
 /begin AXIS_DESCR STD_AXIS Gangi _CNV_R_R_Def_dez_sl_575_CM 8 0. 255. FORMAT "%3.0" /end AXIS_DESCR
 /begin AXIS_DESCR STD_AXIS Nkw _CNV_R_R_Def_n_sw_q_612_CM 4 -32768. 32767. FORMAT "%5.0" /end AXIS_DESCR
/end CHARACTERISTIC
/begin CHARACTERISTIC KF_D_PARA "" MAP 0xa1019378 _REC_MAP_52_UBYTE_s1_u1_s2 0.498 _CNV_R_R_Def_f_sb_b_738_CM -0.25 0.248
 /begin AXIS_DESCR STD_AXIS Gangi _CNV_R_R_Def_dez_sl_575_CM 8 0. 255. FORMAT "%3.0" /end AXIS_DESCR
 /begin AXIS_DESCR STD_AXIS Nkw _CNV_R_R_Def_n_sw_q_612_CM 4 -32768. 32767. FORMAT "%5.0" /end AXIS_DESCR
/end CHARACTERISTIC
/begin CHARACTERISTIC KF_FDASHPWG3 "" MAP 0xa10183e8 _REC_MAP_52_u1_s2_s2 3. _CNV_R_R_Def_f_ub_b_733_CM 0. 3. FORMAT "%5.2"
 /begin AXIS_DESCR STD_AXIS NO_INPUT_QUANTITY _CNV_R_R_Def_wdk_sw_691_CM 8 -800. 799.9755 FORMAT "%5.2" /end AXIS_DESCR
 /begin AXIS_DESCR STD_AXIS Pwg_grad _CNV_R_R_Def_pwggrd_690_CM 6 -20000. 19999.3896 /end AXIS_DESCR
/end CHARACTERISTIC
/begin CHARACTERISTIC KF_FDASH_TMOT "" MAP 0xa10181d4 _REC_MAP_52_UBYTE_u2_s2_s2 0.9999847412109381 _CNV_R_R_Def_f_uw_b_591_CM 0. 0.9999847412109381 FORMAT "%14.5"
 /begin AXIS_DESCR STD_AXIS Nkw _CNV_R_R_Def_n_sw_q_612_CM 4 -32768. 32767. FORMAT "%5.0" /end AXIS_DESCR
 /begin AXIS_DESCR STD_AXIS Tmot _CNV_R_R_Def_t_sw_q_620_CM 4 -327.68 327.67 FORMAT "%5.2" /end AXIS_DESCR
/end CHARACTERISTIC
/begin CHARACTERISTIC KF_FDMDPA12 "" MAP 0xa1017fdc _REC_MAP_52_u1_s2_s2 0.996 _CNV_R_R_Def_f_ub_b_573_CM 0. 0.996
 /begin AXIS_DESCR STD_AXIS A_quer_abs _CNV_R_R_Def_a_sw_b_570_CM 6 -64. 63.998 FORMAT "%5.2" /end AXIS_DESCR
 /begin AXIS_DESCR STD_AXIS NO_INPUT_QUANTITY _CNV_R_R_Def_dez_sl_575_CM 8 -32768. 32767. FORMAT "%5.0" /end AXIS_DESCR
/end CHARACTERISTIC
/begin CHARACTERISTIC KF_FDMFBT "Kennfeld Faktor dyn. Überblendung UGD-TD-GD" MAP 0xa1018568 _REC_MAP_52_u1_u1_u1 0.996 _CNV_R_R_Def_f_ub_b_573_CM 0. 0.996 /begin AXIS_DESCR STD_AXIS Dpsfaktd _CNV_R_R_Def_f_ub_b_573_CM 6 0. 0.996 /end AXIS_DESCR /begin AXIS_DESCR STD_AXIS Dpsfak _CNV_R_R_Def_f_ub_b_573_CM 2 0. 0.996 /end AXIS_DESCR /end CHARACTERISTIC
/begin CHARACTERISTIC KF_FLSDPWGL "Kennfeld Faktor Einfluß Fahrpedal auf Füllung bei Lastschlagdämpfung" MAP 0xa1018a74 _REC_MAP_52_UBYTE_u2_s2_s2 99.83844000000001 _CNV_R_R_Def_f_uw_b_632_CM 0. 255.996
 /begin AXIS_DESCR STD_AXIS NO_INPUT_QUANTITY _CNV_R_R_Def_wdk_sw_691_CM 8 -800. 799.9755 FORMAT "%5.2" /end AXIS_DESCR
 /begin AXIS_DESCR STD_AXIS Mdk_wunsch_d _CNV_R_R_Def_m_sw_q_574_CM 8 -3276.8 3276.7 FORMAT "%5.2" /end AXIS_DESCR
/end CHARACTERISTIC
/begin CHARACTERISTIC KF_FMDKWUGRAD12 "Kennfeld Wichtung Grad Dashpot Bereich12" MAP 0xa1018438 _REC_MAP_52_u1_s2_s2 3.9843 _CNV_R_R_Def_f_ub_b_670_CM 0. 3.9843 FORMAT "%5.2"
 /begin AXIS_DESCR STD_AXIS Mdk_wunsch_gradmx _CNV_R_R_Def_m_sw_q_574_CM 6 -3276.8 3276.7 FORMAT "%5.2" /end AXIS_DESCR
 /begin AXIS_DESCR STD_AXIS Mdk_wunsch_ref_sa _CNV_R_R_Def_m_sw_q_574_CM 6 -3276.8 3276.7 FORMAT "%5.2" /end AXIS_DESCR
/end CHARACTERISTIC
/begin CHARACTERISTIC KF_FMDKWUGRAD3 "Kennfeld Wichtung Grad Dashpot Bereich3" MAP 0xa1018c08 _REC_MAP_52_u1_s2_s2 3.9843 _CNV_R_R_Def_f_ub_b_670_CM 0. 3.9843 FORMAT "%5.2"
 /begin AXIS_DESCR STD_AXIS Mdk_wunsch_grad _CNV_R_R_Def_m_sw_q_574_CM 6 -3276.8 3276.7 FORMAT "%5.2" /end AXIS_DESCR
 /begin AXIS_DESCR STD_AXIS Mdk_wunsch_ref_sa _CNV_R_R_Def_m_sw_q_574_CM 6 -3276.8 3276.7 FORMAT "%5.2" /end AXIS_DESCR
/end CHARACTERISTIC
/begin CHARACTERISTIC KF_LA_MDMX "" MAP 0xa101c9f0 _REC_MAP_52_UBYTE_u2_s2_s2 15.9997 _CNV_R_R_Def_f_uw_b_594_CM 0. 15.9997 FORMAT "%7.4"
 /begin AXIS_DESCR STD_AXIS Rfv_soll _CNV_R_R_Def_rf_sw__616_CM 6 -327.68 327.67 FORMAT "%7.4" /end AXIS_DESCR
 /begin AXIS_DESCR STD_AXIS Md_res_anf _CNV_R_R_Def_m_sw_q_574_CM 6 -3276.8 3276.7 FORMAT "%5.2" /end AXIS_DESCR
/end CHARACTERISTIC
/begin CHARACTERISTIC KF_LSSPORT "" MAP 0xa101876c _REC_MAP_52_u1_u1_s2 15.9375 _CNV_R_R_Def_f_ub_b_740_CM 0. 15.9375 FORMAT "%5.2"
 /begin AXIS_DESCR STD_AXIS Gangi _CNV_R_R_Def_dez_sl_575_CM 8 0. 255. FORMAT "%3.0" /end AXIS_DESCR
 /begin AXIS_DESCR STD_AXIS Nkw _CNV_R_R_Def_n_sw_q_612_CM 8 -32768. 32767. FORMAT "%5.0" /end AXIS_DESCR
/end CHARACTERISTIC
/begin CHARACTERISTIC KF_MDIOP_1 "optimales Moment bei LA 1" MAP 0xa10194fc _REC_MAP_52_UBYTE_s2_s2_s2 131.07 _CNV_R_R_Def_m_sw_q_574_CM -3276.8 3276.7 FORMAT "%5.2"
 /begin AXIS_DESCR STD_AXIS Rf _CNV_R_R_Def_rf_sw__616_CM 16 -327.68 327.67 FORMAT "%7.4" /end AXIS_DESCR
 /begin AXIS_DESCR STD_AXIS Nkw _CNV_R_R_Def_n_sw_q_612_CM 16 -32768. 32767. FORMAT "%5.0" /end AXIS_DESCR
/end CHARACTERISTIC
/begin CHARACTERISTIC KF_MDIOP_2 "optimales Moment bei LA 1" MAP 0xa1019740 _REC_MAP_52_UBYTE_s2_s2_s2 131.07 _CNV_R_R_Def_m_sw_q_574_CM -3276.8 3276.7 FORMAT "%5.2"
 /begin AXIS_DESCR STD_AXIS Rf _CNV_R_R_Def_rf_sw__616_CM 16 -327.68 327.67 FORMAT "%7.4" /end AXIS_DESCR
 /begin AXIS_DESCR STD_AXIS Nkw _CNV_R_R_Def_n_sw_q_612_CM 16 -32768. 32767. FORMAT "%5.0" /end AXIS_DESCR
/end CHARACTERISTIC
/begin CHARACTERISTIC KF_MDKW_L "Kennfeld Fahrerwunschmoment für Füllungspfad bei Lastschlagdämpfung" MAP 0xa1018280 _REC_MAP_52_UBYTE_s2_s2_u1 131.07 _CNV_R_R_Def_m_sw_q_574_CM -3276.8 3276.7 FORMAT "%5.2"
 /begin AXIS_DESCR STD_AXIS NO_INPUT_QUANTITY _CNV_R_R_Def_m_sw_q_574_CM 6 -3276.8 3276.7 FORMAT "%5.2" /end AXIS_DESCR
 /begin AXIS_DESCR STD_AXIS Gangi _CNV_R_R_Def_dez_sl_575_CM 8 0. 255. FORMAT "%3.0" /end AXIS_DESCR
/end CHARACTERISTIC
/begin CHARACTERISTIC KF_MDKW_LGD "Kennfeld Fahrerwunschmoment für Füllungspfad bei Lastschlagdämpfung GD" MAP 0xa1018580 _REC_MAP_52_UBYTE_s2_s2_u1 131.07 _CNV_R_R_Def_m_sw_q_574_CM -3276.8 3276.7 FORMAT "%5.2"
 /begin AXIS_DESCR STD_AXIS NO_INPUT_QUANTITY _CNV_R_R_Def_m_sw_q_574_CM 6 -3276.8 3276.7 FORMAT "%5.2" /end AXIS_DESCR
 /begin AXIS_DESCR STD_AXIS Gangi _CNV_R_R_Def_dez_sl_575_CM 8 0. 255. FORMAT "%3.0" /end AXIS_DESCR
/end CHARACTERISTIC
/begin CHARACTERISTIC KF_MDK_DP_O "Kennfeld Schwelle Dashpotmoment > Bereich 2" MAP 0xa1018984 _REC_MAP_52_UBYTE_s2_s2_u1 131.07 _CNV_R_R_Def_m_sw_q_574_CM -3276.8 3276.7 FORMAT "%5.2"
 /begin AXIS_DESCR STD_AXIS Nkw _CNV_R_R_Def_n_sw_q_612_CM 6 -32768. 32767. FORMAT "%5.0" /end AXIS_DESCR
 /begin AXIS_DESCR STD_AXIS Gangi _CNV_R_R_Def_dez_sl_575_CM 8 0. 255. FORMAT "%3.0" /end AXIS_DESCR
/end CHARACTERISTIC
/begin CHARACTERISTIC KF_MDK_DP_U "Kennfeld Schwelle Dashpotmoment <= Bereich 1" MAP 0xa1018370 _REC_MAP_52_UBYTE_s2_s2_u1 131.07 _CNV_R_R_Def_m_sw_q_574_CM -3276.8 3276.7 FORMAT "%5.2"
 /begin AXIS_DESCR STD_AXIS Nkw _CNV_R_R_Def_n_sw_q_612_CM 6 -32768. 32767. FORMAT "%5.0" /end AXIS_DESCR
 /begin AXIS_DESCR STD_AXIS Gangi _CNV_R_R_Def_dez_sl_575_CM 8 0. 255. FORMAT "%3.0" /end AXIS_DESCR
/end CHARACTERISTIC
/begin CHARACTERISTIC KF_MDK_LSD_O "Kennfeld Schwelle Lastschlagdämpfungsmoment >= Bereich 2" MAP 0xa1018b18 _REC_MAP_52_UBYTE_s2_s2_u1 131.07 _CNV_R_R_Def_m_sw_q_574_CM -3276.8 3276.7 FORMAT "%5.2"
 /begin AXIS_DESCR STD_AXIS Nkw _CNV_R_R_Def_n_sw_q_612_CM 6 -32768. 32767. FORMAT "%5.0" /end AXIS_DESCR
 /begin AXIS_DESCR STD_AXIS Gangi _CNV_R_R_Def_dez_sl_575_CM 8 0. 255. FORMAT "%3.0" /end AXIS_DESCR
/end CHARACTERISTIC
/begin CHARACTERISTIC KF_MDK_LSD_U "Kennfeld Schwelle Lastschlagdämpfungsmoment < Bereich 1" MAP 0xa10184f0 _REC_MAP_52_UBYTE_s2_s2_u1 131.07 _CNV_R_R_Def_m_sw_q_574_CM -3276.8 3276.7 FORMAT "%5.2"
 /begin AXIS_DESCR STD_AXIS Nkw _CNV_R_R_Def_n_sw_q_612_CM 6 -32768. 32767. FORMAT "%5.0" /end AXIS_DESCR
 /begin AXIS_DESCR STD_AXIS Gangi _CNV_R_R_Def_dez_sl_575_CM 8 0. 255. FORMAT "%3.0" /end AXIS_DESCR
/end CHARACTERISTIC
/begin CHARACTERISTIC KF_MDSCHALT "-" MAP 0xa1019148 _REC_MAP_52_UBYTE_s2_s2_s2 131.07 _CNV_R_R_Def_m_sw_q_574_CM -3276.8 3276.7 FORMAT "%5.2"
 /begin AXIS_DESCR STD_AXIS Nkw _CNV_R_R_Def_n_sw_q_612_CM 10 -32768. 32767. FORMAT "%5.0" /end AXIS_DESCR
 /begin AXIS_DESCR STD_AXIS N_gang_neu _CNV_R_R_Def_n_sw_q_612_CM 4 -32768. 32767. FORMAT "%5.0" /end AXIS_DESCR
/end CHARACTERISTIC
/begin CHARACTERISTIC KF_PAR_NULL "" MAP 0xa10193ac _REC_MAP_52_u1_u1_s2 3.9843 _CNV_R_R_Def_f_ub_b_670_CM 0. 3.9843 FORMAT "%5.2"
 /begin AXIS_DESCR STD_AXIS Gangi _CNV_R_R_Def_dez_sl_575_CM 8 0. 255. FORMAT "%3.0" /end AXIS_DESCR
 /begin AXIS_DESCR STD_AXIS Nkw _CNV_R_R_Def_n_sw_q_612_CM 4 -32768. 32767. FORMAT "%5.0" /end AXIS_DESCR
/end CHARACTERISTIC
/begin CHARACTERISTIC KF_PAR_NULLA "" MAP 0xa10193e0 _REC_MAP_52_u1_u1_s2 3.9843 _CNV_R_R_Def_f_ub_b_670_CM 0. 3.9843 FORMAT "%5.2"
 /begin AXIS_DESCR STD_AXIS Gangi _CNV_R_R_Def_dez_sl_575_CM 8 0. 255. FORMAT "%3.0" /end AXIS_DESCR
 /begin AXIS_DESCR STD_AXIS Nkw _CNV_R_R_Def_n_sw_q_612_CM 4 -32768. 32767. FORMAT "%5.0" /end AXIS_DESCR
/end CHARACTERISTIC
/begin CHARACTERISTIC KF_PRIO_NOTL "Notfall Betriebsart bei fehlenden Quittungen" MAP 0xa1019080 _REC_MAP_52_u1_u1_u1 99.45 _CNV_R_R_Def_dez_sl_575_CM 0. 255. FORMAT "%3.0" /begin AXIS_DESCR STD_AXIS Ba_soll _CNV_S_5_Def_ba_gdi_585_CM 3 0. 8. /end AXIS_DESCR /begin AXIS_DESCR STD_AXIS Ba_prio _CNV_S_5_Def_ba_gdi_585_CM 3 0. 8. /end AXIS_DESCR /end CHARACTERISTIC
/begin CHARACTERISTIC KF_SCHALT_WS "Schaltwahrscheinlichkeit" MAP 0xa10191b8 _REC_MAP_52_UBYTE_s1_s2_s2 1.9921 _CNV_R_R_Def_f_sb_b_699_CM -1. 0.9921
 /begin AXIS_DESCR STD_AXIS Mdk_wunsch_proz _CNV_R_R_Def_f_uw_b_579_CM 8 -1. 0.9999 FORMAT "%14.5" /end AXIS_DESCR
 /begin AXIS_DESCR STD_AXIS Nkw _CNV_R_R_Def_n_sw_q_612_CM 8 -32768. 32767. FORMAT "%5.0" /end AXIS_DESCR
/end CHARACTERISTIC
/begin CHARACTERISTIC KF_SNFILT_ARAN "" MAP 0xa1019448 _REC_MAP_52_UBYTE_s2_s2_u1 0. _CNV_R_R_Def_n_sw_q_612_CM -32768. 32767. FORMAT "%5.0"
 /begin AXIS_DESCR STD_AXIS Mdk_wunsch _CNV_R_R_Def_m_sw_q_574_CM 4 -3276.8 3276.7 FORMAT "%5.2" /end AXIS_DESCR
 /begin AXIS_DESCR STD_AXIS Gangi _CNV_R_R_Def_dez_sl_575_CM 8 0. 255. FORMAT "%3.0" /end AXIS_DESCR
/end CHARACTERISTIC
/begin CHARACTERISTIC KF_SNFILT_ARAUS "" MAP 0xa101949c _REC_MAP_52_UBYTE_s2_s2_u1 0. _CNV_R_R_Def_n_sw_q_612_CM -32768. 32767. FORMAT "%5.0"
 /begin AXIS_DESCR STD_AXIS Mdk_wunsch _CNV_R_R_Def_m_sw_q_574_CM 4 -3276.8 3276.7 FORMAT "%5.2" /end AXIS_DESCR
 /begin AXIS_DESCR STD_AXIS Gangi _CNV_R_R_Def_dez_sl_575_CM 8 0. 255. FORMAT "%3.0" /end AXIS_DESCR
/end CHARACTERISTIC
/begin CHARACTERISTIC KF_TAR_AUS "" MAP 0xa101928c _REC_MAP_52_UBYTE_u2_s2_u1 98.30250000000001 _CNV_R_R_Def_td_uw__679_CM 0. 655.35 FORMAT "%5.2"
 /begin AXIS_DESCR STD_AXIS Nkw _CNV_R_R_Def_n_sw_q_612_CM 4 -32768. 32767. FORMAT "%5.0" /end AXIS_DESCR
 /begin AXIS_DESCR STD_AXIS Gangi _CNV_R_R_Def_dez_sl_575_CM 8 0. 255. FORMAT "%3.0" /end AXIS_DESCR
/end CHARACTERISTIC
/begin CHARACTERISTIC KF_TDAR "" MAP 0xa1019414 _REC_MAP_52_u1_u1_s2 2.55 _CNV_R_R_Def_td_uw__679_CM 0. 2.55 FORMAT "%5.2"
 /begin AXIS_DESCR STD_AXIS Gangi _CNV_R_R_Def_dez_sl_575_CM 8 0. 255. FORMAT "%3.0" /end AXIS_DESCR
 /begin AXIS_DESCR STD_AXIS Nkw _CNV_R_R_Def_n_sw_q_612_CM 4 -32768. 32767. FORMAT "%5.0" /end AXIS_DESCR
/end CHARACTERISTIC
/begin CHARACTERISTIC KF_UEB_MD "" MAP 0xa1018170 _REC_MAP_52_u1_s2_s2 0.996 _CNV_R_R_Def_f_ub_b_573_CM 0. 0.996
 /begin AXIS_DESCR STD_AXIS Mdk_w_f _CNV_R_R_Def_m_sw_q_574_CM 8 -3276.8 3276.7 FORMAT "%5.2" /end AXIS_DESCR
 /begin AXIS_DESCR STD_AXIS Nkw _CNV_R_R_Def_n_sw_q_612_CM 8 -32768. 32767. FORMAT "%5.0" /end AXIS_DESCR
/end CHARACTERISTIC
/begin CHARACTERISTIC KF_UMS_NOTL "Notfall Betriebsart bei höngender Umschaltung" MAP 0xa1019094 _REC_MAP_52_u1_u1_u1 99.45 _CNV_R_R_Def_dez_sl_575_CM 0. 255. FORMAT "%3.0" /begin AXIS_DESCR STD_AXIS Ba_ist _CNV_S_5_Def_ba_gdi_585_CM 3 0. 8. /end AXIS_DESCR /begin AXIS_DESCR STD_AXIS Ba_soll _CNV_S_5_Def_ba_gdi_585_CM 3 0. 8. /end AXIS_DESCR /end CHARACTERISTIC
/begin CHARACTERISTIC KF_W_ARMD "" MAP 0xa10192e0 _REC_MAP_52_UBYTE_u2_s2_s2 3.9999 _CNV_R_R_Def_f_sw_b_608_CM 0. 3.9999 FORMAT "%14.5"
 /begin AXIS_DESCR STD_AXIS Rf_soll _CNV_R_R_Def_rf_sw__616_CM 6 -327.68 327.67 FORMAT "%7.4" /end AXIS_DESCR
 /begin AXIS_DESCR STD_AXIS Nkw _CNV_R_R_Def_n_sw_q_612_CM 6 -32768. 32767. FORMAT "%5.0" /end AXIS_DESCR
/end CHARACTERISTIC
/begin CHARACTERISTIC KF_ZKDP3 "Kennfeld Zeitkonstante für Filter Dashpotmomentengradient Bereich 3" MAP 0xa1018e20 _REC_MAP_52_UBYTE_u2_s2_u1 98.30250000000001 _CNV_R_R_Def_td_uw__679_CM 0. 655.35 FORMAT "%5.2"
 /begin AXIS_DESCR STD_AXIS Nkw _CNV_R_R_Def_n_sw_q_612_CM 6 -32768. 32767. FORMAT "%5.0" /end AXIS_DESCR
 /begin AXIS_DESCR STD_AXIS Gangi _CNV_R_R_Def_dez_sl_575_CM 8 0. 255. FORMAT "%3.0" /end AXIS_DESCR
/end CHARACTERISTIC
/begin CHARACTERISTIC KF_ZKDP3A "" MAP 0xa10187c8 _REC_MAP_52_UBYTE_u2_s2_u1 98.30250000000001 _CNV_R_R_Def_td_uw__679_CM 0. 655.35 FORMAT "%5.2"
 /begin AXIS_DESCR STD_AXIS Nkw _CNV_R_R_Def_n_sw_q_612_CM 6 -32768. 32767. FORMAT "%5.0" /end AXIS_DESCR
 /begin AXIS_DESCR STD_AXIS Gangi _CNV_R_R_Def_dez_sl_575_CM 8 0. 255. FORMAT "%3.0" /end AXIS_DESCR
/end CHARACTERISTIC
/begin CHARACTERISTIC KF_ZKLS3GD "Kennfeld Zeitkonstante für Filter Lastschlagdämpfungsmomentengradient Bereich 3 GD" MAP 0xa101811c _REC_MAP_52_UBYTE_u2_s2_u1 98.30250000000001 _CNV_R_R_Def_td_uw__679_CM 0. 655.35 FORMAT "%5.2"
 /begin AXIS_DESCR STD_AXIS Nkw _CNV_R_R_Def_n_sw_q_612_CM 4 -32768. 32767. FORMAT "%5.0" /end AXIS_DESCR
 /begin AXIS_DESCR STD_AXIS Gangi _CNV_R_R_Def_dez_sl_575_CM 8 0. 255. FORMAT "%3.0" /end AXIS_DESCR
/end CHARACTERISTIC
/begin CHARACTERISTIC KF_ZKLS3GDA "Kennfeld Zeitkonstante für Filter Lastschlagdämpfungsmomentengradient Bereich 3 GD" MAP 0xa10185f8 _REC_MAP_52_UBYTE_u2_s2_u1 98.30250000000001 _CNV_R_R_Def_td_uw__679_CM 0. 655.35 FORMAT "%5.2"
 /begin AXIS_DESCR STD_AXIS Nkw _CNV_R_R_Def_n_sw_q_612_CM 4 -32768. 32767. FORMAT "%5.0" /end AXIS_DESCR
 /begin AXIS_DESCR STD_AXIS Gangi _CNV_R_R_Def_dez_sl_575_CM 8 0. 255. FORMAT "%3.0" /end AXIS_DESCR
/end CHARACTERISTIC
/begin CHARACTERISTIC KF_ZKLS3UD "Kennfeld Zeitkonstante für Filter Lastschlagdämpfungsmomentengradient Bereich 3 UGD" MAP 0xa1018f88 _REC_MAP_52_UBYTE_u2_s2_u1 98.30250000000001 _CNV_R_R_Def_td_uw__679_CM 0. 655.35 FORMAT "%5.2"
 /begin AXIS_DESCR STD_AXIS Nkw _CNV_R_R_Def_n_sw_q_612_CM 6 -32768. 32767. FORMAT "%5.0" /end AXIS_DESCR
 /begin AXIS_DESCR STD_AXIS Gangi _CNV_R_R_Def_dez_sl_575_CM 8 0. 255. FORMAT "%3.0" /end AXIS_DESCR
/end CHARACTERISTIC
/begin CHARACTERISTIC KF_ZKLS3UDA "Kennfeld Zeitkonstante für Filter Lastschlagdämpfungsmomentengradient Bereich 3 UGD" MAP 0xa10180a4 _REC_MAP_52_UBYTE_u2_s2_u1 98.30250000000001 _CNV_R_R_Def_td_uw__679_CM 0. 655.35 FORMAT "%5.2"
 /begin AXIS_DESCR STD_AXIS Nkw _CNV_R_R_Def_n_sw_q_612_CM 6 -32768. 32767. FORMAT "%5.0" /end AXIS_DESCR
 /begin AXIS_DESCR STD_AXIS Gangi _CNV_R_R_Def_dez_sl_575_CM 8 0. 255. FORMAT "%3.0" /end AXIS_DESCR
/end CHARACTERISTIC
/begin CHARACTERISTIC KF_ZWOPT_NOTL "Optimalzündwinkel, Notlauf" MAP 0xa101d088 _REC_MAP_52_UBYTE_s2_s2_s2 100.1 _CNV_R_R_Def_zw_sw__599_CM -50. 60. FORMAT "%4.1"
 /begin AXIS_DESCR STD_AXIS Rf _CNV_R_R_Def_rf_sw__616_CM 8 -327.68 327.67 FORMAT "%7.4" /end AXIS_DESCR
 /begin AXIS_DESCR STD_AXIS Nkw _CNV_R_R_Def_n_sw_q_612_CM 8 -32768. 32767. FORMAT "%5.0" /end AXIS_DESCR
/end CHARACTERISTIC
/begin CHARACTERISTIC KF_ZW_NOTL "Grundzündwinkel, Notlauf" MAP 0xa101cfe4 _REC_MAP_52_UBYTE_s2_s2_s2 100.1 _CNV_R_R_Def_zw_sw__599_CM -50. 60. FORMAT "%4.1"
 /begin AXIS_DESCR STD_AXIS Rf _CNV_R_R_Def_rf_sw__616_CM 8 -327.68 327.67 FORMAT "%7.4" /end AXIS_DESCR
 /begin AXIS_DESCR STD_AXIS Nkw _CNV_R_R_Def_n_sw_q_612_CM 8 -32768. 32767. FORMAT "%5.0" /end AXIS_DESCR
/end CHARACTERISTIC
/begin CHARACTERISTIC KL_DMDPOFF "Kennlinie Deltamoment Dashpotende" CURVE 0xa1017ee0 _REC_CUR_TKL_UW_VV__s2_u1 131.07 _CNV_R_R_Def_m_sw_q_574_CM -3276.8 3276.7 FORMAT "%5.2"
 /begin AXIS_DESCR STD_AXIS Gangi _CNV_R_R_Def_dez_sl_575_CM 8 0. 255. FORMAT "%3.0" /end AXIS_DESCR
/end CHARACTERISTIC
/begin CHARACTERISTIC KL_DMD_MAXL "-" CURVE 0xa101caa0 _REC_CUR_TKL_UW_VV__s2_s2 131.07 _CNV_R_R_Def_dm_sw__610_CM -3276.8 3276.7 FORMAT "%5.2"
 /begin AXIS_DESCR STD_AXIS Nkw _CNV_R_R_Def_n_sw_q_612_CM 6 -32768. 32767. FORMAT "%5.0" /end AXIS_DESCR
/end CHARACTERISTIC
/begin CHARACTERISTIC KL_DMD_MAXS "-" CURVE 0xa101cabc _REC_CUR_TKL_UW_VV__s2_s2 131.07 _CNV_R_R_Def_dm_sw__610_CM -3276.8 3276.7 FORMAT "%5.2"
 /begin AXIS_DESCR STD_AXIS Md_res_real _CNV_R_R_Def_m_sw_q_574_CM 6 -3276.8 3276.7 FORMAT "%5.2" /end AXIS_DESCR
/end CHARACTERISTIC
/begin CHARACTERISTIC KL_DMLSDOFF "Kennlinie Deltamoment Lastschlagdämpfungsende" CURVE 0xa1017e98 _REC_CUR_TKL_UW_VV__s2_u1 131.07 _CNV_R_R_Def_m_sw_q_574_CM -3276.8 3276.7 FORMAT "%5.2"
 /begin AXIS_DESCR STD_AXIS Gangi _CNV_R_R_Def_dez_sl_575_CM 8 0. 255. FORMAT "%3.0" /end AXIS_DESCR
/end CHARACTERISTIC
/begin CHARACTERISTIC KL_ETA_LA "Lambdahaken" CURVE 0xa101c9ac _REC_CUR_TKL_UW_VV__u2_s2 15.9997 _CNV_R_R_Def_f_uw_b_594_CM 0. 15.9997 FORMAT "%7.4"
 /begin AXIS_DESCR STD_AXIS Eta_rk_md _CNV_R_R_Def_eta_sw_617_CM 16 -200. 199.9938 /end AXIS_DESCR
/end CHARACTERISTIC
/begin CHARACTERISTIC KL_FJMOT "Kennlinie Deltamoment aus Motormassenträgheitsmoment für Automatikgetriebe" CURVE 0xa1017e84 _REC_CUR_TKL_UW_VV__s2_s1 131.07 _CNV_R_R_Def_m_sw_q_574_CM -3276.8 3276.7 FORMAT "%5.2"
 /begin AXIS_DESCR STD_AXIS Nkw_grad _CNV_R_R_Def_ngrd_s_668_CM 6 -4096. 4064. FORMAT "%5.2" /end AXIS_DESCR
/end CHARACTERISTIC
/begin CHARACTERISTIC KL_FLSDPWG12 "Kennlinie Faktor Fahrpedal zu Lastschlagdämpfungsmomentengradienten Bereich 1 und 2" CURVE 0xa1017eb4 _REC_CUR_TKL_UW_VV__u1_s2 3. _CNV_R_R_Def_f_ub_b_733_CM 0. 3. FORMAT "%5.2"
 /begin AXIS_DESCR STD_AXIS NO_INPUT_QUANTITY _CNV_R_R_Def_wdk_sw_691_CM 8 -800. 799.9755 FORMAT "%5.2" /end AXIS_DESCR
/end CHARACTERISTIC
/begin CHARACTERISTIC KL_FLSDPWG3 "Kennlinie Faktor Fahrpedal zu Lastschlagdämpfungsmomentengradienten Bereich 3" CURVE 0xa1017e4c _REC_CUR_TKL_UW_VV__u1_s2 3. _CNV_R_R_Def_f_ub_b_733_CM 0. 3. FORMAT "%5.2"
 /begin AXIS_DESCR STD_AXIS NO_INPUT_QUANTITY _CNV_R_R_Def_wdk_sw_691_CM 8 -800. 799.9755 FORMAT "%5.2" /end AXIS_DESCR
/end CHARACTERISTIC
/begin CHARACTERISTIC KL_FMDI_VL "-" CURVE 0xa1019a5c _REC_CUR_TKL_UW_VV__s2_s2 15.9997 _CNV_R_R_Def_f_sw_b_607_CM -8. 7.9997 FORMAT "%7.4"
 /begin AXIS_DESCR STD_AXIS Nkw _CNV_R_R_Def_n_sw_q_612_CM 6 -32768. 32767. FORMAT "%5.0" /end AXIS_DESCR
/end CHARACTERISTIC
/begin CHARACTERISTIC KL_FTVDK_MDMAX "Temperaturfaktor fuer Drosselventil Durchfluss" CURVE 0xa10199ac _REC_CUR_TKL_UW_VV__u1_s2 1.9921 _CNV_R_R_Def_f_ub_b_625_CM 0. 1.9921
 /begin AXIS_DESCR STD_AXIS Tans _CNV_R_R_Def_t_sw_q_618_CM 8 -3276.8 3276.7 FORMAT "%4.1" /end AXIS_DESCR
/end CHARACTERISTIC
/begin CHARACTERISTIC KL_F_UEB "" CURVE 0xa1017efc _REC_CUR_TKL_UW_VV__u1_u1 0.996 _CNV_R_R_Def_f_ub_b_573_CM 0. 0.996
 /begin AXIS_DESCR STD_AXIS Gangi _CNV_R_R_Def_dez_sl_575_CM 8 0. 255. FORMAT "%3.0" /end AXIS_DESCR
/end CHARACTERISTIC
/begin CHARACTERISTIC KL_KUPP_ENABLE "" CURVE 0xa1017ed0 _REC_CUR_TKL_UW_VV__u1_s2 99.45 _CNV_R_R_Def_dez_sl_575_CM 0. 255. FORMAT "%3.0"
 /begin AXIS_DESCR STD_AXIS NO_INPUT_QUANTITY _CNV_R_R_Def_n_sw_q_612_CM 4 -32768. 32767. FORMAT "%5.0" /end AXIS_DESCR
/end CHARACTERISTIC
/begin CHARACTERISTIC KL_LAMX "-" CURVE 0xa10199c8 _REC_CUR_TKL_UW_VV__s2_s2 98.30250000000001 _CNV_R_R_Def_rf_sw__616_CM -327.68 327.67 FORMAT "%7.4"
 /begin AXIS_DESCR STD_AXIS Nkw _CNV_R_R_Def_n_sw_q_612_CM 11 -32768. 32767. FORMAT "%5.0" /end AXIS_DESCR
/end CHARACTERISTIC
/begin CHARACTERISTIC KL_LAMX_FP "-" CURVE 0xa1019998 _REC_CUR_TKL_UW_VV__u1_s2 0.996 _CNV_R_R_Def_f_ub_b_573_CM 0. 0.996
 /begin AXIS_DESCR STD_AXIS Mdr_wunsch _CNV_R_R_Def_md_rel_660_CM 6 0. 100. FORMAT "%4.1" /end AXIS_DESCR
/end CHARACTERISTIC
/begin CHARACTERISTIC KL_LAMX_FV "-" CURVE 0xa10199f8 _REC_CUR_TKL_UW_VV__s2_s2 98.30250000000001 _CNV_R_R_Def_rf_sw__616_CM -327.68 327.67 FORMAT "%7.4"
 /begin AXIS_DESCR STD_AXIS Nkw _CNV_R_R_Def_n_sw_q_612_CM 11 -32768. 32767. FORMAT "%5.0" /end AXIS_DESCR
/end CHARACTERISTIC
/begin CHARACTERISTIC KL_LA_NL1 "Soll-lambda, Notlauf" MAP 0xa101d12c _REC_MAP_52_UBYTE_u2_s2_s2 15.9997 _CNV_R_R_Def_f_uw_b_594_CM 0. 15.9997 FORMAT "%7.4"
 /begin AXIS_DESCR STD_AXIS Rf _CNV_R_R_Def_rf_sw__616_CM 6 -327.68 327.67 FORMAT "%7.4" /end AXIS_DESCR
 /begin AXIS_DESCR STD_AXIS Nkw _CNV_R_R_Def_n_sw_q_612_CM 6 -32768. 32767. FORMAT "%5.0" /end AXIS_DESCR
/end CHARACTERISTIC
/begin CHARACTERISTIC KL_LA_NL2 "Soll-lambda, Notlauf" MAP 0xa101d190 _REC_MAP_52_UBYTE_u2_s2_s2 15.9997 _CNV_R_R_Def_f_uw_b_594_CM 0. 15.9997 FORMAT "%7.4"
 /begin AXIS_DESCR STD_AXIS Rf _CNV_R_R_Def_rf_sw__616_CM 6 -327.68 327.67 FORMAT "%7.4" /end AXIS_DESCR
 /begin AXIS_DESCR STD_AXIS Nkw _CNV_R_R_Def_n_sw_q_612_CM 6 -32768. 32767. FORMAT "%5.0" /end AXIS_DESCR
/end CHARACTERISTIC
/begin CHARACTERISTIC KL_MDKMAXUL "" CURVE 0xa1019108 _REC_CUR_TKL_UW_VV__s2_s2 131.07 _CNV_R_R_Def_m_sw_q_574_CM -3276.8 3276.7 FORMAT "%5.2"
 /begin AXIS_DESCR STD_AXIS Nkw _CNV_R_R_Def_n_sw_q_612_CM 4 -32768. 32767. FORMAT "%5.0" /end AXIS_DESCR
/end CHARACTERISTIC
/begin CHARACTERISTIC KL_MDKMINASR "" CURVE 0xa10190e4 _REC_CUR_TKL_UW_VV__s2_s2 131.07 _CNV_R_R_Def_m_sw_q_574_CM -3276.8 3276.7 FORMAT "%5.2"
 /begin AXIS_DESCR STD_AXIS Nkw _CNV_R_R_Def_n_sw_q_612_CM 8 -32768. 32767. FORMAT "%5.0" /end AXIS_DESCR
/end CHARACTERISTIC
/begin CHARACTERISTIC KL_MDMAXNL_1 "-" CURVE 0xa101cf9c _REC_CUR_TKL_UW_VV__s2_s2 131.07 _CNV_R_R_Def_m_sw_q_574_CM -3276.8 3276.7 FORMAT "%5.2"
 /begin AXIS_DESCR STD_AXIS Nkw _CNV_R_R_Def_n_sw_q_612_CM 8 -32768. 32767. FORMAT "%5.0" /end AXIS_DESCR
/end CHARACTERISTIC
/begin CHARACTERISTIC KL_MDMAXNL_2 "-" CURVE 0xa101cfc0 _REC_CUR_TKL_UW_VV__s2_s2 131.07 _CNV_R_R_Def_m_sw_q_574_CM -3276.8 3276.7 FORMAT "%5.2"
 /begin AXIS_DESCR STD_AXIS Nkw _CNV_R_R_Def_n_sw_q_612_CM 8 -32768. 32767. FORMAT "%5.0" /end AXIS_DESCR
/end CHARACTERISTIC
/begin CHARACTERISTIC KL_MU_WAN "Kennlinie Faktor Wirkungsgrad/Momentenüberhöhung Wandler" CURVE 0xa1017e3c _REC_CUR_TKL_UW_VV__u1_u1 3. _CNV_R_R_Def_f_ub_b_733_CM 0. 3. FORMAT "%5.2"
 /begin AXIS_DESCR STD_AXIS Ntnkw _CNV_R_R_Def_f_ub_b_670_CM 6 0. 3.9843 FORMAT "%5.2" /end AXIS_DESCR
/end CHARACTERISTIC
/begin CHARACTERISTIC KL_NA_BNANT "-" CURVE 0xa101ca68 _REC_CUR_TKL_UW_VV__u1_u2 1.9921 _CNV_R_R_Def_f_ub_b_625_CM 0. 1.9921
 /begin AXIS_DESCR STD_AXIS Na_priobn _CNV_R_R_Def_dez_sl_575_CM 8 0. 65535. FORMAT "%5.0" /end AXIS_DESCR
/end CHARACTERISTIC
/begin CHARACTERISTIC KL_NA_ZW "-" CURVE 0xa101ca84 _REC_CUR_TKL_UW_VV__s2_u2 131.07 _CNV_R_R_Def_m_sw_q_574_CM -3276.8 3276.7 FORMAT "%5.2"
 /begin AXIS_DESCR STD_AXIS Na_priobn _CNV_R_R_Def_dez_sl_575_CM 6 0. 65535. FORMAT "%5.0" /end AXIS_DESCR
/end CHARACTERISTIC
/begin CHARACTERISTIC KL_RFMXATLNL "-" CURVE 0xa1019a9c _REC_CUR_TKL_UW_VV__s2_s2 98.30250000000001 _CNV_R_R_Def_rf_sw__616_CM -327.68 327.67 FORMAT "%7.4"
 /begin AXIS_DESCR STD_AXIS Nkw _CNV_R_R_Def_n_sw_q_612_CM 6 -32768. 32767. FORMAT "%5.0" /end AXIS_DESCR
/end CHARACTERISTIC
/begin CHARACTERISTIC KL_TAR_KUP "-" CURVE 0xa1019264 _REC_CUR_TKL_UW_VV__u2_s2 98.30250000000001 _CNV_R_R_Def_td_uw__679_CM 0. 655.35 FORMAT "%5.2"
 /begin AXIS_DESCR STD_AXIS Nkw _CNV_R_R_Def_n_sw_q_612_CM 4 -32768. 32767. FORMAT "%5.0" /end AXIS_DESCR
/end CHARACTERISTIC
/begin CHARACTERISTIC KL_TASCHE "-" CURVE 0xa1019a40 _REC_CUR_TKL_UW_VV__s2_s2 0. _CNV_R_R_Def_n_sw_q_612_CM -32768. 6000. FORMAT "%5.0"
 /begin AXIS_DESCR STD_AXIS Tans _CNV_R_R_Def_t_sw_q_618_CM 6 -3276.8 3276.7 FORMAT "%4.1" /end AXIS_DESCR
/end CHARACTERISTIC
/begin CHARACTERISTIC KL_TMOT_ARMD "-" CURVE 0xa1019278 _REC_CUR_TKL_UW_VV__u2_s2 3.9999 _CNV_R_R_Def_f_sw_b_608_CM 0. 3.9999 FORMAT "%14.5"
 /begin AXIS_DESCR STD_AXIS Tmot _CNV_R_R_Def_t_sw_q_620_CM 4 -327.68 327.67 FORMAT "%5.2" /end AXIS_DESCR
/end CHARACTERISTIC
/begin CHARACTERISTIC KL_TMZE "-" CURVE 0xa1019a28 _REC_CUR_TKL_UW_VV__s2_s2 15.9997 _CNV_R_R_Def_f_sw_b_607_CM -8. 7.9997 FORMAT "%7.4"
 /begin AXIS_DESCR STD_AXIS Tmot _CNV_R_R_Def_t_sw_q_620_CM 5 -327.68 327.67 FORMAT "%5.2" /end AXIS_DESCR
/end CHARACTERISTIC
/begin CHARACTERISTIC KL_T_2UMDREH "Zeit eines Arbeitsspiels" CURVE 0xa1019a78 _REC_CUR_TKL_UW_VV__u2_s2 100.66176 _CNV_R_R_Def_ti_uw__707_CM 0. 838.848
 /begin AXIS_DESCR STD_AXIS Nkw _CNV_R_R_Def_n_sw_q_612_CM 4 -32768. 32767. FORMAT "%5.0" /end AXIS_DESCR
/end CHARACTERISTIC
/begin CHARACTERISTIC KL_WT_UMDREH "Wichtung Zeit eines Arbeitsspiels" CURVE 0xa1019a8c _REC_CUR_TKL_UW_VV__u1_u2 1.9921 _CNV_R_R_Def_f_ub_b_625_CM 0. 1.9921
 /begin AXIS_DESCR STD_AXIS Rk_1 _CNV_R_R_Def_rk_uw__696_CM 4 0. 31.9995 FORMAT "%7.4" /end AXIS_DESCR
/end CHARACTERISTIC
/begin CHARACTERISTIC KL_ZK_ETAWAN "Kennlinie Zeitkonstante Wandlerwirkungsgrad" CURVE 0xa1017e68 _REC_CUR_TKL_UW_VV__u2_s2 0.9999847412109381 _CNV_R_R_Def_f_uw_b_591_CM 0. 0.9999847412109381 FORMAT "%14.5"
 /begin AXIS_DESCR STD_AXIS Tget _CNV_R_R_Def_t_sw_q_620_CM 6 -327.68 327.67 FORMAT "%5.2" /end AXIS_DESCR
/end CHARACTERISTIC
/begin CHARACTERISTIC K_ALLVERBOT "Verbotsmatrix, wenn alles verboten" VALUE 0xa1019040 _REC_VAL_20_u1 2.34 _CNV_S_7_Def_bvgdi_589_CM 0. 6. BIT_MASK 0xFF /end CHARACTERISTIC
/begin CHARACTERISTIC K_AQMAX_SPS "" VALUE 0xa1017e14 _REC_VAL_20_s2 99.83843999999999 _CNV_R_R_Def_a_sw_b_570_CM -64. 63.998 FORMAT "%5.2" /end CHARACTERISTIC
/begin CHARACTERISTIC K_BANOAPPL "Applikationswert St_bano" VALUE 0xa1019041 _REC_VAL_20_u1 99.45 _CNV_R_R_Def_dez_sl_575_CM 0. 255. FORMAT "%3.0" /end CHARACTERISTIC
/begin CHARACTERISTIC K_BASTART "Betriebsart im Start bis Drehzahlschwelle" VALUE 0xa1019042 _REC_VAL_20_u1 3.12 _CNV_S_5_Def_ba_gdi_585_CM 0. 8. BIT_MASK 0xFF /end CHARACTERISTIC
/begin CHARACTERISTIC K_BAWKALT "Ba wunsch Standart bei kaltem Motor" VALUE 0xa1019043 _REC_VAL_20_u1 99.45 _CNV_R_R_Def_dez_sl_575_CM 0. 255. FORMAT "%3.0" /end CHARACTERISTIC
/begin CHARACTERISTIC K_BAWNOT "Not BA Anforderung bei Drehzahlüberschreitung" VALUE 0xa101902c _REC_VAL_20_u2 0. _CNV_R_R_Def_dez_sl_575_CM 0. 65535. FORMAT "%5.0" /end CHARACTERISTIC
/begin CHARACTERISTIC K_BAWSCHALT "Bei Umschalten von 0 auf 1 Übernahme Applikationswerte" VALUE 0xa1019044 _REC_VAL_20_u1 1. _CNV_R_R_Def_dez_sl_575_CM 0. 1. FORMAT "%3.0" /end CHARACTERISTIC
/begin CHARACTERISTIC K_BAWU_NL1 "Betriebsart" VALUE 0xa101cf7f _REC_VAL_20_u1 8. _CNV_S_5_Def_ba_gdi_585_CM 0. 8. BIT_MASK 0xFF /end CHARACTERISTIC
/begin CHARACTERISTIC K_BAWU_NL2 "Betriebsart" VALUE 0xa101cf80 _REC_VAL_20_u1 8. _CNV_S_5_Def_ba_gdi_585_CM 0. 8. BIT_MASK 0xFF /end CHARACTERISTIC
/begin CHARACTERISTIC K_BAWU_NL3 "Betriebsart" VALUE 0xa101cf81 _REC_VAL_20_u1 8. _CNV_S_5_Def_ba_gdi_585_CM 0. 8. BIT_MASK 0xFF /end CHARACTERISTIC
/begin CHARACTERISTIC K_BAW_APPL "Ba aus Appl" VALUE 0xa1019045 _REC_VAL_20_u1 8. _CNV_S_5_Def_ba_gdi_585_CM 0. 8. BIT_MASK 0xFF /end CHARACTERISTIC
/begin CHARACTERISTIC K_BAW_APPSUB "SubBa aus Appl" VALUE 0xa1019046 _REC_VAL_20_u1 15. _CNV_S_12_Def_ba_gdi_587_CM 0. 15. BIT_MASK 0xFF /end CHARACTERISTIC
/begin CHARACTERISTIC K_BAW_HOMRGN "-" VALUE 0xa1019002 _REC_VAL_20_u1 99.45 _CNV_R_R_Def_dez_sl_575_CM 0. 255. FORMAT "%3.0" /end CHARACTERISTIC
/begin CHARACTERISTIC K_BAW_KATRGN "-" VALUE 0xa1019003 _REC_VAL_20_u1 99.45 _CNV_R_R_Def_dez_sl_575_CM 0. 255. FORMAT "%3.0" /end CHARACTERISTIC
/begin CHARACTERISTIC K_BA_APPL "Applikationsbetriebsart" VALUE 0xa1019047 _REC_VAL_20_u1 3.12 _CNV_S_5_Def_ba_gdi_585_CM 0. 8. BIT_MASK 0xFF /end CHARACTERISTIC
/begin CHARACTERISTIC K_BA_LAMD "Ba bei der magerer LL zugelassen wird" VALUE 0xa101c98d _REC_VAL_20_u1 8. _CNV_S_7_Def_ba_754_CM 0. 8. BIT_MASK 0xFF /end CHARACTERISTIC
/begin CHARACTERISTIC K_BA_TOGGLE1 "Hauptbetriebsart Togglefunktion 1" VALUE 0xa1019048 _REC_VAL_20_u1 8. _CNV_S_5_Def_ba_gdi_585_CM 0. 8. BIT_MASK 0xFF /end CHARACTERISTIC
/begin CHARACTERISTIC K_BA_TOGGLE2 "Hauptbetriebsart Togglefunktion 2" VALUE 0xa1019049 _REC_VAL_20_u1 3.12 _CNV_S_5_Def_ba_gdi_585_CM 0. 8. BIT_MASK 0xFF /end CHARACTERISTIC
/begin CHARACTERISTIC K_BA_TOGSUB1 "Subbetriebsart Togglefunktion 1" VALUE 0xa101904a _REC_VAL_20_u1 15. _CNV_S_12_Def_ba_gdi_587_CM 0. 15. BIT_MASK 0xFF /end CHARACTERISTIC
/begin CHARACTERISTIC K_BA_TOGSUB2 "Subbetriebsart Togglefunktion 1" VALUE 0xa101904b _REC_VAL_20_u1 15. _CNV_S_12_Def_ba_gdi_587_CM 0. 15. BIT_MASK 0xFF /end CHARACTERISTIC
/begin CHARACTERISTIC K_CNTAR_AUS "" VALUE 0xa1019230 _REC_VAL_20_u1 99.45 _CNV_R_R_Def_dez_sl_575_CM 0. 255. FORMAT "%3.0" /end CHARACTERISTIC
/begin CHARACTERISTIC K_DINOTL "BA aus Di Notlauf" VALUE 0xa101904c _REC_VAL_20_u1 8. _CNV_S_5_Def_ba_gdi_585_CM 0. 8. BIT_MASK 0xFF /end CHARACTERISTIC
/begin CHARACTERISTIC K_DINOTLSUB "SubBa aus DI Notlauf" VALUE 0xa101904d _REC_VAL_20_u1 15. _CNV_S_12_Def_ba_gdi_587_CM 0. 15. BIT_MASK 0xFF /end CHARACTERISTIC
/begin CHARACTERISTIC K_DMDKDP_MX "" VALUE 0xa1017e16 _REC_VAL_20_s2 131.07 _CNV_R_R_Def_m_sw_q_574_CM -3276.8 3276.7 FORMAT "%5.2" /end CHARACTERISTIC
/begin CHARACTERISTIC K_DMDKLSD_MN "" VALUE 0xa1017e18 _REC_VAL_20_s2 131.07 _CNV_R_R_Def_m_sw_q_574_CM -3276.8 3276.7 FORMAT "%5.2" /end CHARACTERISTIC
/begin CHARACTERISTIC K_DMDZWO "" VALUE 0xa10190c8 _REC_VAL_20_s2 131.07 _CNV_R_R_Def_m_sw_q_574_CM -3276.8 3276.7 FORMAT "%5.2" /end CHARACTERISTIC
/begin CHARACTERISTIC K_DMDZWOHYS "" VALUE 0xa10190ca _REC_VAL_20_s2 131.07 _CNV_R_R_Def_m_sw_q_574_CM -3276.8 3276.7 FORMAT "%5.2" /end CHARACTERISTIC
/begin CHARACTERISTIC K_DMDZWOLL "" VALUE 0xa10190c4 _REC_VAL_20_s2 131.07 _CNV_R_R_Def_m_sw_q_574_CM -3276.8 3276.7 FORMAT "%5.2" /end CHARACTERISTIC
/begin CHARACTERISTIC K_DMDZWOLLHYS "" VALUE 0xa10190c6 _REC_VAL_20_s2 131.07 _CNV_R_R_Def_m_sw_q_574_CM -3276.8 3276.7 FORMAT "%5.2" /end CHARACTERISTIC
/begin CHARACTERISTIC K_DMDZWU "" VALUE 0xa10190bc _REC_VAL_20_s2 131.07 _CNV_R_R_Def_m_sw_q_574_CM -3276.8 3276.7 FORMAT "%5.2" /end CHARACTERISTIC
/begin CHARACTERISTIC K_DMDZWUHYS "" VALUE 0xa10190be _REC_VAL_20_s2 131.07 _CNV_R_R_Def_m_sw_q_574_CM -3276.8 3276.7 FORMAT "%5.2" /end CHARACTERISTIC
/begin CHARACTERISTIC K_DMDZWULL "" VALUE 0xa10190c0 _REC_VAL_20_s2 131.07 _CNV_R_R_Def_m_sw_q_574_CM -3276.8 3276.7 FORMAT "%5.2" /end CHARACTERISTIC
/begin CHARACTERISTIC K_DMDZWULLHYS "" VALUE 0xa10190c2 _REC_VAL_20_s2 131.07 _CNV_R_R_Def_m_sw_q_574_CM -3276.8 3276.7 FORMAT "%5.2" /end CHARACTERISTIC
/begin CHARACTERISTIC K_DN_SCHALT "Faktor zur Bestimmung Anschlussdrehzahlregelung" VALUE 0xa101913c _REC_VAL_20_u2 0.9999 _CNV_R_R_Def_f_uw_b_591_CM 0. 0.9999 FORMAT "%14.5" /end CHARACTERISTIC
/begin CHARACTERISTIC K_DPOS_AGRZU "Hysteresis Agrpos zu" VALUE 0xa101cf8e _REC_VAL_20_u2 99.9984 _CNV_R_R_Def_f_uw_b_576_CM 0. 99.9984 /end CHARACTERISTIC
/begin CHARACTERISTIC K_DPSVER_LAMD "" VALUE 0xa101c99c _REC_VAL_20_u2 98.30250000000001 _CNV_R_R_Def_td_uw__679_CM 0. 655.35 FORMAT "%5.2" /end CHARACTERISTIC
/begin CHARACTERISTIC K_DPS_LAMD "" VALUE 0xa101c994 _REC_VAL_20_s2 102.398436 _CNV_R_R_Def_p_sw_q_578_CM -1280. 1279.9609 FORMAT "%5.2" /end CHARACTERISTIC
/begin CHARACTERISTIC K_DTMINSCH "Hysterese für Tmot Schwelle in Standart Anforderung" VALUE 0xa1019020 _REC_VAL_20_s2 101.5777 _CNV_R_R_Def_t_sw_q_620_CM 0. 327.67 FORMAT "%5.2" /end CHARACTERISTIC
/begin CHARACTERISTIC K_D_FVLAUS "" VALUE 0xa1019984 _REC_VAL_20_u2 3.9999 _CNV_R_R_Def_f_sw_b_608_CM 0. 3.9999 FORMAT "%14.5" /end CHARACTERISTIC
/begin CHARACTERISTIC K_ENTPR_FL "Entprellung Aktivierung Flankendektor" VALUE 0xa101922d _REC_VAL_20_u1 99.45 _CNV_R_R_Def_dez_sl_575_CM 0. 255. FORMAT "%3.0" /end CHARACTERISTIC
/begin CHARACTERISTIC K_ENTPR_SCH "Entprellung Flankenzähler" VALUE 0xa101922c _REC_VAL_20_u1 99.45 _CNV_R_R_Def_dez_sl_575_CM 0. 255. FORMAT "%3.0" /end CHARACTERISTIC
/begin CHARACTERISTIC K_FGRENZ1_AR "" VALUE 0xa1019246 _REC_VAL_20_u2 0.9999 _CNV_R_R_Def_f_uw_b_591_CM 0. 0.9999 FORMAT "%14.5" /end CHARACTERISTIC
/begin CHARACTERISTIC K_FGRENZ1_ARA "" VALUE 0xa101924a _REC_VAL_20_u2 0.9999 _CNV_R_R_Def_f_uw_b_591_CM 0. 0.9999 FORMAT "%14.5" /end CHARACTERISTIC
/begin CHARACTERISTIC K_FGRENZ_AR "" VALUE 0xa1019244 _REC_VAL_20_u2 0.9999 _CNV_R_R_Def_f_uw_b_591_CM 0. 0.9999 FORMAT "%14.5" /end CHARACTERISTIC
/begin CHARACTERISTIC K_FGRENZ_ARA "" VALUE 0xa1019248 _REC_VAL_20_u2 0.9999 _CNV_R_R_Def_f_uw_b_591_CM 0. 0.9999 FORMAT "%14.5" /end CHARACTERISTIC
/begin CHARACTERISTIC K_F_RFMXFMN "min Faktor Füllungseingriff" VALUE 0xa101998a _REC_VAL_20_u2 1.9999 _CNV_R_R_Def_f_uw_b_579_CM 0. 1.9999 FORMAT "%14.5" /end CHARACTERISTIC
/begin CHARACTERISTIC K_F_RFMXLESS "Faktor Füllungseingriff bei Quotient Segzeit zu Ti < 1" VALUE 0xa101998e _REC_VAL_20_u2 1.9999 _CNV_R_R_Def_f_uw_b_579_CM 0. 1.9999 FORMAT "%14.5" /end CHARACTERISTIC
/begin CHARACTERISTIC K_F_RFMXPLUS "Faktor Füllungseingriff bei Quotient Segzeit zu Ti >= 1" VALUE 0xa101998c _REC_VAL_20_u2 1.9999 _CNV_R_R_Def_f_uw_b_579_CM 0. 1.9999 FORMAT "%14.5" /end CHARACTERISTIC
/begin CHARACTERISTIC K_F_RFMXTEHYST "Hysterese Faktor Rf-Begrenzung" VALUE 0xa1019992 _REC_VAL_20_u2 1.9999 _CNV_R_R_Def_f_uw_b_579_CM 0. 1.9999 FORMAT "%14.5" /end CHARACTERISTIC
/begin CHARACTERISTIC K_F_SPORT "Faktor Momentengradient bei Sportschalter" VAL_BLK 0xa1017e30 _REC_VAL_2_u1 1.9921 _CNV_R_R_Def_f_ub_b_625_CM 0. 1.9921 NUMBER 8 /end CHARACTERISTIC
/begin CHARACTERISTIC K_GANG_MAX "max. Gang" VALUE 0xa1019136 _REC_VAL_20_u1 99.45 _CNV_R_R_Def_dez_sl_575_CM 0. 255. FORMAT "%3.0" /end CHARACTERISTIC
/begin CHARACTERISTIC K_GANG_MINUS "Anzahl Rückschaltungen" VALUE 0xa1019133 _REC_VAL_20_u1 99.45 _CNV_R_R_Def_dez_sl_575_CM 0. 255. FORMAT "%3.0" /end CHARACTERISTIC
/begin CHARACTERISTIC K_GANG_PLUS "Anzahl Hochschaltungen" VALUE 0xa1019134 _REC_VAL_20_u1 99.45 _CNV_R_R_Def_dez_sl_575_CM 0. 255. FORMAT "%3.0" /end CHARACTERISTIC
/begin CHARACTERISTIC K_HOMBTS "Ba aus Bauteilschutz" VALUE 0xa101904e _REC_VAL_20_u1 8. _CNV_S_5_Def_ba_gdi_585_CM 0. 8. BIT_MASK 0xFF /end CHARACTERISTIC
/begin CHARACTERISTIC K_HOMBTSSUB "SubBa aus Bauteilschutz" VALUE 0xa101904f _REC_VAL_20_u1 15. _CNV_S_12_Def_ba_gdi_587_CM 0. 15. BIT_MASK 0xFF /end CHARACTERISTIC
/begin CHARACTERISTIC K_HOMHEIZ "Ba wunsch Lambda 1" VALUE 0xa1019050 _REC_VAL_20_u1 8. _CNV_S_5_Def_ba_gdi_585_CM 0. 8. BIT_MASK 0xFF /end CHARACTERISTIC
/begin CHARACTERISTIC K_HOMHEIZSUB "SubBa wunsch Lambda 1" VALUE 0xa1019051 _REC_VAL_20_u1 15. _CNV_S_12_Def_ba_gdi_587_CM 0. 15. BIT_MASK 0xFF /end CHARACTERISTIC
/begin CHARACTERISTIC K_HOMLA1 "Ba wunsch Lambda 1" VALUE 0xa101901d _REC_VAL_20_u1 8. _CNV_S_5_Def_ba_gdi_585_CM 0. 8. BIT_MASK 0xFF /end CHARACTERISTIC
/begin CHARACTERISTIC K_HOMLA1SUB "SubBa wunsch Lambda 1" VALUE 0xa101901e _REC_VAL_20_u1 15. _CNV_S_12_Def_ba_gdi_587_CM 0. 15. BIT_MASK 0xFF /end CHARACTERISTIC
/begin CHARACTERISTIC K_HOMOPT "" VALUE 0xa1019014 _REC_VAL_20_u1 99.45 _CNV_R_R_Def_dez_sl_575_CM 0. 255. FORMAT "%3.0" /end CHARACTERISTIC
/begin CHARACTERISTIC K_HOMTO2 "Ba wunsch O2 Test" VALUE 0xa1019052 _REC_VAL_20_u1 8. _CNV_S_5_Def_ba_gdi_585_CM 0. 8. BIT_MASK 0xFF /end CHARACTERISTIC
/begin CHARACTERISTIC K_HOMTO2SUB "SubBa wunsch O2 Test" VALUE 0xa1019053 _REC_VAL_20_u1 15. _CNV_S_12_Def_ba_gdi_587_CM 0. 15. BIT_MASK 0xFF /end CHARACTERISTIC
/begin CHARACTERISTIC K_HOSOPT "" VALUE 0xa1019013 _REC_VAL_20_u1 99.45 _CNV_R_R_Def_dez_sl_575_CM 0. 255. FORMAT "%3.0" /end CHARACTERISTIC
/begin CHARACTERISTIC K_HSCHALT_WS "Schwelle Wahrscheinlichkeit für Hochschaltungen" VALUE 0xa1019131 _REC_VAL_20_s1 1.9921 _CNV_R_R_Def_f_sb_b_699_CM -1. 0.9921 /end CHARACTERISTIC
/begin CHARACTERISTIC K_H_STANDART "Homogen Standartwunsch" VALUE 0xa1019054 _REC_VAL_20_u1 99.45 _CNV_R_R_Def_dez_sl_575_CM 0. 255. FORMAT "%3.0" /end CHARACTERISTIC
/begin CHARACTERISTIC K_I_GANG "" VAL_BLK 0xa1019120 _REC_VAL_2_u2 63.99900000000001 _CNV_R_R_Def_f_uw_b_580_CM 0. 63.999 FORMAT "%7.4" NUMBER 8 /end CHARACTERISTIC
/begin CHARACTERISTIC K_KATREG "BA aus Kat Regeneration" VALUE 0xa1019055 _REC_VAL_20_u1 8. _CNV_S_5_Def_ba_gdi_585_CM 0. 8. BIT_MASK 0xFF /end CHARACTERISTIC
/begin CHARACTERISTIC K_KATREGSUB "SubBa aus Kat Regeneration" VALUE 0xa1019056 _REC_VAL_20_u1 15. _CNV_S_12_Def_ba_gdi_587_CM 0. 15. BIT_MASK 0xFF /end CHARACTERISTIC
/begin CHARACTERISTIC K_KEINAR_AT "Freigabe Ar in Abhängigkeit der WK" VAL_BLK 0xa1019228 _REC_VAL_2_u1 99.45 _CNV_R_R_Def_dez_sl_575_CM 0. 255. FORMAT "%3.0" NUMBER 4 /end CHARACTERISTIC
/begin CHARACTERISTIC K_KEINAR_SMG "Freigabe Ar in Abhängigkeit der Kupplung bei SMG" VAL_BLK 0xa1019220 _REC_VAL_2_u1 99.45 _CNV_R_R_Def_dez_sl_575_CM 0. 255. FORMAT "%3.0" NUMBER 8 /end CHARACTERISTIC
/begin CHARACTERISTIC K_KEINE_BA "Keine Ba gewünscht" VALUE 0xa1019057 _REC_VAL_20_u1 3.12 _CNV_S_5_Def_ba_gdi_585_CM 0. 8. BIT_MASK 0xFF /end CHARACTERISTIC
/begin CHARACTERISTIC K_KFATHS_EIN "1: es werden die AT-KF verwendet" VAL_BLK 0xa1017e38 _REC_VAL_2_u1 1. _CNV_R_R_Def_dez_sl_575_CM 0. 1. FORMAT "%3.0" NUMBER 4 /end CHARACTERISTIC
/begin CHARACTERISTIC K_KMDZW_DASH "" VALUE 0xa10190ad _REC_VAL_20_u1 1.9921 _CNV_R_R_Def_f_ub_b_625_CM 0. 1.9921 /end CHARACTERISTIC
/begin CHARACTERISTIC K_LAMDFAK "Verbesserung des Momentes bei opt Lambda" VALUE 0xa101c991 _REC_VAL_20_u1 1.9921 _CNV_R_R_Def_f_ub_b_625_CM 0. 1.9921 /end CHARACTERISTIC
/begin CHARACTERISTIC K_LAZW_MINUS "" VALUE 0xa101c993 _REC_VAL_20_u1 0.996 _CNV_R_R_Def_f_ub_b_573_CM 0. 0.996 /end CHARACTERISTIC
/begin CHARACTERISTIC K_LAZW_PLUS "" VALUE 0xa101c992 _REC_VAL_20_u1 0.996 _CNV_R_R_Def_f_ub_b_573_CM 0. 0.996 /end CHARACTERISTIC
/begin CHARACTERISTIC K_LA_HOMM "Konstante für Grenzwert im Homogenen Betrieb beim Übergang zu Schicht" VALUE 0xa1019004 _REC_VAL_20_u2 15.9997 _CNV_R_R_Def_f_uw_b_594_CM 0. 15.9997 FORMAT "%7.4" /end CHARACTERISTIC
/begin CHARACTERISTIC K_LA_MDMN "untere Begrenzung Lambda" VALUE 0xa101c9a8 _REC_VAL_20_u2 15.9997 _CNV_R_R_Def_f_uw_b_594_CM 0. 15.9997 FORMAT "%7.4" /end CHARACTERISTIC
/begin CHARACTERISTIC K_LA_OPT "Lambda für max Leistung" VALUE 0xa101c9a4 _REC_VAL_20_u2 15.9997 _CNV_R_R_Def_f_uw_b_594_CM 0. 15.9997 FORMAT "%7.4" /end CHARACTERISTIC
/begin CHARACTERISTIC K_LLSTAND "Standartanforderung bei Leerlauf" VALUE 0xa1019058 _REC_VAL_20_u1 8. _CNV_S_5_Def_ba_gdi_585_CM 0. 8. BIT_MASK 0xFF /end CHARACTERISTIC
/begin CHARACTERISTIC K_LLSTANDSUB "Subbetriebsartanforderung  bei LL " VALUE 0xa1019059 _REC_VAL_20_u1 15. _CNV_S_12_Def_ba_gdi_587_CM 0. 15. BIT_MASK 0xFF /end CHARACTERISTIC
/begin CHARACTERISTIC K_LLSTANDSUB_1 "Subbetriebsartanforderung bei LL 1" VALUE 0xa101905a _REC_VAL_20_u1 15. _CNV_S_12_Def_ba_gdi_587_CM 0. 15. BIT_MASK 0xFF /end CHARACTERISTIC
/begin CHARACTERISTIC K_LLSTAND_1 "Standartanforderung bei Leerlauf 1" VALUE 0xa101905b _REC_VAL_20_u1 8. _CNV_S_5_Def_ba_gdi_585_CM 0. 8. BIT_MASK 0xFF /end CHARACTERISTIC
/begin CHARACTERISTIC K_MAT_MDIOP "Zuordnung Eingang Ba-Umschaltung zu Betriebsart" VAL_BLK 0xa10194f0 _REC_VAL_2_u1 99.45 _CNV_R_R_Def_dez_sl_575_CM 0. 255. FORMAT "%3.0" NUMBER 8 /end CHARACTERISTIC
/begin CHARACTERISTIC K_MA_BAWUNL "Eingang Auswahl, Ba_wu_nl" VAL_BLK 0xa101cf48 _REC_VAL_2_u1 6. _CNV_R_R_Def_dez_sl_575_CM 0. 6. FORMAT "%3.0" NUMBER 7 /end CHARACTERISTIC
/begin CHARACTERISTIC K_MA_LANL "Eingang Auswahl, La_soll_notl" VAL_BLK 0xa101cf40 _REC_VAL_2_u1 6. _CNV_R_R_Def_dez_sl_575_CM 0. 6. FORMAT "%3.0" NUMBER 7 /end CHARACTERISTIC
/begin CHARACTERISTIC K_MA_NMAXNL "Eingang Auswahl, Nmax_notl" VAL_BLK 0xa101cf38 _REC_VAL_2_u1 6. _CNV_R_R_Def_dez_sl_575_CM 0. 6. FORMAT "%3.0" NUMBER 7 /end CHARACTERISTIC
/begin CHARACTERISTIC K_MA_VBNL "Eingang Auswahl, Ba_vb_nl" VAL_BLK 0xa101cf50 _REC_VAL_2_u1 6. _CNV_R_R_Def_dez_sl_575_CM 0. 6. FORMAT "%3.0" NUMBER 7 /end CHARACTERISTIC
/begin CHARACTERISTIC K_MA_ZWNL "Eingang Auswahl, Zw_grund_nl, Zw_opt_nl" VAL_BLK 0xa101cf58 _REC_VAL_2_u1 6. _CNV_R_R_Def_dez_sl_575_CM 0. 6. FORMAT "%3.0" NUMBER 7 /end CHARACTERISTIC
/begin CHARACTERISTIC K_MDBANL_CFG "" VAL_BLK 0xa101cf70 _REC_VAL_2_u1 99.45 _CNV_R_R_Def_dez_sl_575_CM 0. 255. FORMAT "%3.0" NUMBER 7 /end CHARACTERISTIC
/begin CHARACTERISTIC K_MDBANL_CFG2 "" VAL_BLK 0xa101cf78 _REC_VAL_2_u1 99.45 _CNV_R_R_Def_dez_sl_575_CM 0. 255. FORMAT "%3.0" NUMBER 7 /end CHARACTERISTIC
/begin CHARACTERISTIC K_MDIMXNL_ARR "" VAL_BLK 0xa101cf68 _REC_VAL_2_u1 3. _CNV_R_R_Def_dez_sl_575_CM 0. 3. FORMAT "%3.0" NUMBER 7 /end CHARACTERISTIC
/begin CHARACTERISTIC K_MDIPM_HYS "Hysterese bei Übertreten durch IPM" VALUE 0xa1019144 _REC_VAL_20_s2 131.07 _CNV_R_R_Def_m_sw_q_574_CM -3276.8 3276.7 FORMAT "%5.2" /end CHARACTERISTIC
/begin CHARACTERISTIC K_MDISIKOHYST "Hysterese Sicherheitskonzept" VALUE 0xa10190b8 _REC_VAL_20_s2 131.07 _CNV_R_R_Def_m_sw_q_574_CM -3276.8 3276.7 FORMAT "%5.2" /end CHARACTERISTIC
/begin CHARACTERISTIC K_MDI_R "Konstante für Erhöhung Momentenreserve bei Übergang zu Schicht" VALUE 0xa101900c _REC_VAL_20_s2 131.07 _CNV_R_R_Def_m_sw_q_574_CM -3276.8 3276.7 FORMAT "%5.2" /end CHARACTERISTIC
/begin CHARACTERISTIC K_MDI_RESOFF "Schwelle Momentenreserve Katheizen aus" VALUE 0xa10190e2 _REC_VAL_20_s2 131.07 _CNV_R_R_Def_m_sw_q_574_CM -3276.8 3276.7 FORMAT "%5.2" /end CHARACTERISTIC
/begin CHARACTERISTIC K_MDI_RESON "Schwelle Momentenreserve Katheizen an" VALUE 0xa10190e0 _REC_VAL_20_s2 131.07 _CNV_R_R_Def_m_sw_q_574_CM -3276.8 3276.7 FORMAT "%5.2" /end CHARACTERISTIC
/begin CHARACTERISTIC K_MDI_ZWHAND "Mdi_zw_soll aus Applkonst" VALUE 0xa10190ba _REC_VAL_20_s2 131.07 _CNV_R_R_Def_m_sw_q_574_CM -3276.8 3276.7 FORMAT "%5.2" /end CHARACTERISTIC
/begin CHARACTERISTIC K_MDK_WUNSCHHYST "" VALUE 0xa1017e1a _REC_VAL_20_s2 131.07 _CNV_R_R_Def_m_sw_q_574_CM -3276.8 3276.7 FORMAT "%5.2" /end CHARACTERISTIC
/begin CHARACTERISTIC K_MDMAX_ENA "" VAL_BLK 0xa101cf60 _REC_VAL_2_u1 1. _CNV_R_R_Def_dez_sl_575_CM 0. 1. FORMAT "%3.0" NUMBER 7 /end CHARACTERISTIC
/begin CHARACTERISTIC K_MDNOTL_NEG "" VALUE 0xa101cf92 _REC_VAL_20_s2 98.30250000000001 _CNV_R_R_Def_m_sw_q_659_CM -327.68 327.67 FORMAT "%5.2" /end CHARACTERISTIC
/begin CHARACTERISTIC K_MDNOTL_POS "" VALUE 0xa101cf90 _REC_VAL_20_s2 98.30250000000001 _CNV_R_R_Def_m_sw_q_659_CM -327.68 327.67 FORMAT "%5.2" /end CHARACTERISTIC
/begin CHARACTERISTIC K_MDRES_RGN "-" VALUE 0xa1019006 _REC_VAL_20_u2 0.9999 _CNV_R_R_Def_f_uw_b_591_CM 0. 0.9999 FORMAT "%14.5" /end CHARACTERISTIC
/begin CHARACTERISTIC K_MDZWPLUS_HYS "Hysterese B_mdzw_plus" VALUE 0xa10190dc _REC_VAL_20_s2 131.07 _CNV_R_R_Def_m_sw_q_574_CM -3276.8 3276.7 FORMAT "%5.2" /end CHARACTERISTIC
/begin CHARACTERISTIC K_MDZW_LSD "" VALUE 0xa10190ae _REC_VAL_20_u1 1.9921 _CNV_R_R_Def_f_ub_b_625_CM 0. 1.9921 /end CHARACTERISTIC
/begin CHARACTERISTIC K_MD_RESMXLA "max Momentenreserve die über Lambda vernichtet werden soll" VALUE 0xa101c9a2 _REC_VAL_20_s2 131.07 _CNV_R_R_Def_m_sw_q_574_CM -3276.8 3276.7 FORMAT "%5.2" /end CHARACTERISTIC
/begin CHARACTERISTIC K_NBAHOM "Drehzahlschwelle für Startbetriebsart" VALUE 0xa1019022 _REC_VAL_20_s2 0. _CNV_R_R_Def_n_sw_q_612_CM -32768. 32767. FORMAT "%5.0" /end CHARACTERISTIC
/begin CHARACTERISTIC K_NBAWNOTMN "Drehzahlschwelle für Schichtbetrieb" VALUE 0xa1019024 _REC_VAL_20_s2 0. _CNV_R_R_Def_n_sw_q_612_CM 0. 32767. FORMAT "%5.0" /end CHARACTERISTIC
/begin CHARACTERISTIC K_NBAWNOTMX "Drehzahlschwelle für Schichtbetrieb" VALUE 0xa1019018 _REC_VAL_20_s2 0. _CNV_R_R_Def_n_sw_q_612_CM 0. 32767. FORMAT "%5.0" /end CHARACTERISTIC
/begin CHARACTERISTIC K_NFILTMN "" VALUE 0xa101923e _REC_VAL_20_s2 100. _CNV_R_R_Def_n_sw_q_612_CM -500. 500. FORMAT "%5.0" /end CHARACTERISTIC
/begin CHARACTERISTIC K_NFILTMX "" VALUE 0xa1019240 _REC_VAL_20_s2 100. _CNV_R_R_Def_n_sw_q_612_CM -500. 500. FORMAT "%5.0" /end CHARACTERISTIC
/begin CHARACTERISTIC K_NGANG_APPL "Appl Drehzahlregelung" VALUE 0xa1019138 _REC_VAL_20_s2 0. _CNV_R_R_Def_n_sw_q_612_CM -32768. 32767. FORMAT "%5.0" /end CHARACTERISTIC
/begin CHARACTERISTIC K_NGFSAWE "Schwelle Drehzahlgradient für Sperre Lastschlagdämpfung bei WE" VALUE 0xa1017e28 _REC_VAL_20_s1 81.60000000000001 _CNV_R_R_Def_ngrd_s_668_CM -4096. 4064. FORMAT "%5.2" /end CHARACTERISTIC
/begin CHARACTERISTIC K_NLWAHL_MAN "NL Auswahl Handbetrieb" VALUE 0xa101cf88 _REC_VAL_20_u1 6. _CNV_R_R_Def_dez_sl_575_CM 0. 6. FORMAT "%3.0" /end CHARACTERISTIC
/begin CHARACTERISTIC K_NMAXBA "-" VALUE 0xa1019008 _REC_VAL_20_s2 0. _CNV_R_R_Def_n_sw_q_612_CM -32768. 32767. FORMAT "%5.0" /end CHARACTERISTIC
/begin CHARACTERISTIC K_NMAX_NL1 "" VALUE 0xa101cf94 _REC_VAL_20_s2 0. _CNV_R_R_Def_n_sw_q_612_CM -32768. 32767. FORMAT "%5.0" /end CHARACTERISTIC
/begin CHARACTERISTIC K_NMAX_NL2 "" VALUE 0xa101cf96 _REC_VAL_20_s2 0. _CNV_R_R_Def_n_sw_q_612_CM -32768. 32767. FORMAT "%5.0" /end CHARACTERISTIC
/begin CHARACTERISTIC K_NMAX_NL3 "" VALUE 0xa101cf98 _REC_VAL_20_s2 0. _CNV_R_R_Def_n_sw_q_612_CM -32768. 32767. FORMAT "%5.0" /end CHARACTERISTIC
/begin CHARACTERISTIC K_NSTAT_OFF "Offset zur Berechnung der min Anschlussdrehzahl" VALUE 0xa101913a _REC_VAL_20_s2 0. _CNV_R_R_Def_n_sw_q_612_CM -32768. 32767. FORMAT "%5.0" /end CHARACTERISTIC
/begin CHARACTERISTIC K_NWEHYS "Hysterese Nwe zur Freischaltung B_md_dynman" VALUE 0xa10190d6 _REC_VAL_20_s2 0. _CNV_R_R_Def_n_sw_q_612_CM -32768. 32767. FORMAT "%5.0" /end CHARACTERISTIC
/begin CHARACTERISTIC K_N_TIMDRED "Drehzahlschwelle Füllungsbegrenzung" VALUE 0xa1019990 _REC_VAL_20_s2 0. _CNV_R_R_Def_n_sw_q_612_CM -32768. 32767. FORMAT "%5.0" /end CHARACTERISTIC
/begin CHARACTERISTIC K_ORDF_AR "" VALUE 0xa1019231 _REC_VAL_20_u1 2. _CNV_R_R_Def_dez_sl_575_CM 0. 2. FORMAT "%3.0" /end CHARACTERISTIC
/begin CHARACTERISTIC K_PAR_MAX "" VALUE 0xa1019233 _REC_VAL_20_u1 3.9843 _CNV_R_R_Def_f_ub_b_670_CM 0. 3.9843 FORMAT "%5.2" /end CHARACTERISTIC
/begin CHARACTERISTIC K_PAR_MAXA "" VALUE 0xa1019235 _REC_VAL_20_u1 3.9843 _CNV_R_R_Def_f_ub_b_670_CM 0. 3.9843 FORMAT "%5.2" /end CHARACTERISTIC
/begin CHARACTERISTIC K_PAR_MIN "" VALUE 0xa1019234 _REC_VAL_20_u1 3.9843 _CNV_R_R_Def_f_ub_b_670_CM 0. 3.9843 FORMAT "%5.2" /end CHARACTERISTIC
/begin CHARACTERISTIC K_PAR_MINA "" VALUE 0xa1019236 _REC_VAL_20_u1 3.9843 _CNV_R_R_Def_f_ub_b_670_CM 0. 3.9843 FORMAT "%5.2" /end CHARACTERISTIC
/begin CHARACTERISTIC K_PBN_GRENZAKTIV "Maximum für Bordnetzprio wenn Spannungswächter nicht aktiv ist" VALUE 0xa101ca54 _REC_VAL_20_u2 0. _CNV_R_R_Def_dez_sl_575_CM 0. 65535. FORMAT "%5.0" /end CHARACTERISTIC
/begin CHARACTERISTIC K_PBN_LASTAB "Bordnetzprio für Lastabwurf" VALUE 0xa101ca66 _REC_VAL_20_u2 0. _CNV_R_R_Def_dez_sl_575_CM 0. 65535. FORMAT "%5.0" /end CHARACTERISTIC
/begin CHARACTERISTIC K_PBN_PLUS "Erhöhungsschritt für Bordnetzprio" VALUE 0xa101ca60 _REC_VAL_20_u2 0. _CNV_R_R_Def_dez_sl_575_CM 0. 65535. FORMAT "%5.0" /end CHARACTERISTIC
/begin CHARACTERISTIC K_PBN_RED "Reduktionsschritt für Bordnetzprio" VALUE 0xa101ca62 _REC_VAL_20_u2 0. _CNV_R_R_Def_dez_sl_575_CM 0. 65535. FORMAT "%5.0" /end CHARACTERISTIC
/begin CHARACTERISTIC K_POS_AGRZU "Schwelle Agrpos zu" VALUE 0xa101cf8c _REC_VAL_20_u2 99.9984 _CNV_R_R_Def_f_uw_b_576_CM 0. 99.9984 /end CHARACTERISTIC
/begin CHARACTERISTIC K_PRIOBN_INIT "Initialisierungswert: Bordnetzprio" VALUE 0xa101ca56 _REC_VAL_20_u2 0. _CNV_R_R_Def_dez_sl_575_CM 0. 65535. FORMAT "%5.0" /end CHARACTERISTIC
/begin CHARACTERISTIC K_PRIORESET "Zeit, nach der ein automatischer Reset des Prionotlaufs stattfindet" VALUE 0xa101902e _REC_VAL_20_u2 98.30250000000001 _CNV_R_R_Def_td_uw__679_CM 0. 655.35 FORMAT "%5.2" /end CHARACTERISTIC
/begin CHARACTERISTIC K_PRIORESETK "Zeit, nach der ein automatischer Reset des Prionotlaufs stattfindet" VALUE 0xa1019030 _REC_VAL_20_u2 98.30250000000001 _CNV_R_R_Def_td_uw__679_CM 0. 655.35 FORMAT "%5.2" /end CHARACTERISTIC
/begin CHARACTERISTIC K_PRIO_BA1 "Priorisierungsvector für erste Prio" VAL_BLK 0xa1019070 _REC_VAL_2_u1 99.45 _CNV_R_R_Def_dez_sl_575_CM 0. 255. FORMAT "%3.0" NUMBER 14 /end CHARACTERISTIC
/begin CHARACTERISTIC K_PRMX_PRNOT "Priorisierungsschwelle für Notfallmassnahme" VALUE 0xa101905c _REC_VAL_20_u1 99.45 _CNV_R_R_Def_dez_sl_575_CM 0. 255. FORMAT "%3.0" /end CHARACTERISTIC
/begin CHARACTERISTIC K_PRMX_UMNOT "Priorisierungsschwelle für Notfallmassnahme" VALUE 0xa101905d _REC_VAL_20_u1 99.45 _CNV_R_R_Def_dez_sl_575_CM 0. 255. FORMAT "%3.0" /end CHARACTERISTIC
/begin CHARACTERISTIC K_PSPVDK_GDV "Schaltschwelle B_gdvhub" VALUE 0xa101900a _REC_VAL_20_u2 0.9999 _CNV_R_R_Def_f_uw_b_591_CM 0. 0.9999 FORMAT "%14.5" /end CHARACTERISTIC
/begin CHARACTERISTIC K_PWGGRAD_AR "" VALUE 0xa101923c _REC_VAL_20_s2 0. _CNV_R_R_Def_pwggrd_690_CM -20000. 19999.3896 /end CHARACTERISTIC
/begin CHARACTERISTIC K_PWGGRAD_ARN "" VALUE 0xa101923a _REC_VAL_20_s2 0. _CNV_R_R_Def_pwggrd_690_CM -20000. 19999.3896 /end CHARACTERISTIC
/begin CHARACTERISTIC K_RSCHALT_WS "Schwelle Wahrscheinlichkeit für Rückschaltungen" VALUE 0xa1019132 _REC_VAL_20_s1 1.9921 _CNV_R_R_Def_f_sb_b_699_CM -1. 0.9921 /end CHARACTERISTIC
/begin CHARACTERISTIC K_SCHOPT "" VALUE 0xa1019012 _REC_VAL_20_u1 99.45 _CNV_R_R_Def_dez_sl_575_CM 0. 255. FORMAT "%3.0" /end CHARACTERISTIC
/begin CHARACTERISTIC K_SONKW_AR "" VALUE 0xa1019260 _REC_VAL_20_s2 0. _CNV_R_R_Def_n_sw_q_612_CM -32768. 32767. FORMAT "%5.0" /end CHARACTERISTIC
/begin CHARACTERISTIC K_SSCHWINGUNG_AR "Schwelle Anzahl Schwingungen ab der die AR deaktiviert wird" VALUE 0xa1019232 _REC_VAL_20_u1 99.45 _CNV_R_R_Def_dez_sl_575_CM 0. 255. FORMAT "%3.0" /end CHARACTERISTIC
/begin CHARACTERISTIC K_STMOT_AR "" VALUE 0xa101924e _REC_VAL_20_s2 98.30250000000001 _CNV_R_R_Def_t_sw_q_620_CM -327.68 327.67 FORMAT "%5.2" /end CHARACTERISTIC
/begin CHARACTERISTIC K_ST_LDMCHK "" VALUE 0xa10190cd _REC_VAL_20_u1 99.45 _CNV_R_R_Def_dez_sl_575_CM 0. 255. FORMAT "%3.0" /end CHARACTERISTIC
/begin CHARACTERISTIC K_ST_LDMINIT "" VALUE 0xa10190cf _REC_VAL_20_u1 99.45 _CNV_R_R_Def_dez_sl_575_CM 0. 255. FORMAT "%3.0" /end CHARACTERISTIC
/begin CHARACTERISTIC K_ST_LDMKUPP "" VALUE 0xa10190cc _REC_VAL_20_u1 99.45 _CNV_R_R_Def_dez_sl_575_CM 0. 255. FORMAT "%3.0" /end CHARACTERISTIC
/begin CHARACTERISTIC K_ST_LDMOFF "" VALUE 0xa10190ce _REC_VAL_20_u1 99.45 _CNV_R_R_Def_dez_sl_575_CM 0. 255. FORMAT "%3.0" /end CHARACTERISTIC
/begin CHARACTERISTIC K_ST_MDINFOGES "" VALUE 0xa10190d0 _REC_VAL_20_u1 99.45 _CNV_R_R_Def_dez_sl_575_CM 0. 255. FORMAT "%3.0" /end CHARACTERISTIC
/begin CHARACTERISTIC K_ST_MDINFOL "" VALUE 0xa10190d1 _REC_VAL_20_u1 99.45 _CNV_R_R_Def_dez_sl_575_CM 0. 255. FORMAT "%3.0" /end CHARACTERISTIC
/begin CHARACTERISTIC K_ST_MDINFOS "" VALUE 0xa10190d2 _REC_VAL_20_u1 99.45 _CNV_R_R_Def_dez_sl_575_CM 0. 255. FORMAT "%3.0" /end CHARACTERISTIC
/begin CHARACTERISTIC K_SUNKW_AR "" VAL_BLK 0xa1019250 _REC_VAL_2_s2 0. _CNV_R_R_Def_n_sw_q_612_CM -32768. 32767. FORMAT "%5.0" NUMBER 8 /end CHARACTERISTIC
/begin CHARACTERISTIC K_SV_AR "Fz-Geschwindigkeit" VALUE 0xa101924c _REC_VAL_20_u2 100.8 _CNV_R_R_Def_v_uw_q_723_CM 0. 360. FORMAT "%5.0" /end CHARACTERISTIC
/begin CHARACTERISTIC K_TAR_AUS "" VALUE 0xa1019242 _REC_VAL_20_u2 98.30250000000001 _CNV_R_R_Def_td_uw__679_CM 0. 655.35 FORMAT "%5.2" /end CHARACTERISTIC
/begin CHARACTERISTIC K_TAR_EIN "Verzögerungszeit B_kupp" VALUE 0xa1019238 _REC_VAL_20_u2 98.30250000000001 _CNV_R_R_Def_td_uw__679_CM 0. 655.35 FORMAT "%5.2" /end CHARACTERISTIC
/begin CHARACTERISTIC K_TBA_TOGGLE "Zeitdauer Togglefunktion" VALUE 0xa1019032 _REC_VAL_20_u2 98.30250000000001 _CNV_R_R_Def_td_uw__679_CM 0. 655.35 FORMAT "%5.2" /end CHARACTERISTIC
/begin CHARACTERISTIC K_TDLAMD_AUS "" VALUE 0xa101c9a0 _REC_VAL_20_u2 98.30250000000001 _CNV_R_R_Def_td_uw__679_CM 0. 655.35 FORMAT "%5.2" /end CHARACTERISTIC
/begin CHARACTERISTIC K_TDLAMD_EIN "" VALUE 0xa101c99a _REC_VAL_20_u2 98.30250000000001 _CNV_R_R_Def_td_uw__679_CM 0. 655.35 FORMAT "%5.2" /end CHARACTERISTIC
/begin CHARACTERISTIC K_TDLAMD_EIN2 "" VALUE 0xa101c99e _REC_VAL_20_u2 98.30250000000001 _CNV_R_R_Def_td_uw__679_CM 0. 655.35 FORMAT "%5.2" /end CHARACTERISTIC
/begin CHARACTERISTIC K_TDMAX_BAWBEOPT "Maximale Wartezeit für verbrauchsoptimalen BA-Wechsel" VALUE 0xa101900e _REC_VAL_20_u2 98.30250000000001 _CNV_R_R_Def_td_uw__679_CM 0. 655.35 FORMAT "%5.2" /end CHARACTERISTIC
/begin CHARACTERISTIC K_TDNSCHALT "Verzögerungszeit Anschlussdrehzahlrampe" VALUE 0xa1019140 _REC_VAL_20_u2 98.30250000000001 _CNV_R_R_Def_td_uw__679_CM 0. 655.35 FORMAT "%5.2" /end CHARACTERISTIC
/begin CHARACTERISTIC K_TDSCHALT_MAX "Verzögerungszeit Abschaltung Anschlussdrehzahlregelung" VALUE 0xa101913e _REC_VAL_20_u2 98.30250000000001 _CNV_R_R_Def_td_uw__679_CM 0. 655.35 FORMAT "%5.2" /end CHARACTERISTIC
/begin CHARACTERISTIC K_TDTEVZU "Wartezeit für TEV geschlossen nach BA-Wechsel" VALUE 0xa1019010 _REC_VAL_20_u2 98.30250000000001 _CNV_R_R_Def_td_uw__679_CM 0. 655.35 FORMAT "%5.2" /end CHARACTERISTIC
/begin CHARACTERISTIC K_TEBGLLA_OFF "" VALUE 0xa101c996 _REC_VAL_20_s2 99.83843999999999 _CNV_R_R_Def_f_sw_b_634_CM -64. 63.998 /end CHARACTERISTIC
/begin CHARACTERISTIC K_TI1HOM "" VALUE 0xa1019986 _REC_VAL_20_u2 100.66176 _CNV_R_R_Def_ti_uw__707_CM 0. 838.848 /end CHARACTERISTIC
/begin CHARACTERISTIC K_TI2HOM "" VALUE 0xa1019988 _REC_VAL_20_u2 100.66176 _CNV_R_R_Def_ti_uw__707_CM 0. 838.848 /end CHARACTERISTIC
/begin CHARACTERISTIC K_TLMD_AUS "" VALUE 0xa1017e1c _REC_VAL_20_s2 131.07 _CNV_R_R_Def_m_sw_q_574_CM -3276.8 3276.7 FORMAT "%5.2" /end CHARACTERISTIC
/begin CHARACTERISTIC K_TLMD_EIN "" VALUE 0xa1017e1e _REC_VAL_20_s2 131.07 _CNV_R_R_Def_m_sw_q_574_CM -3276.8 3276.7 FORMAT "%5.2" /end CHARACTERISTIC
/begin CHARACTERISTIC K_TMAX_QUIT "Maximale Dauer für Quittungen" VALUE 0xa1019034 _REC_VAL_20_u2 98.30250000000001 _CNV_R_R_Def_td_uw__679_CM 0. 655.35 FORMAT "%5.2" /end CHARACTERISTIC
/begin CHARACTERISTIC K_TMAX_UMS "Maximale Dauer für Umschaltung" VALUE 0xa1019036 _REC_VAL_20_u2 98.30250000000001 _CNV_R_R_Def_td_uw__679_CM 0. 655.35 FORMAT "%5.2" /end CHARACTERISTIC
/begin CHARACTERISTIC K_TMINHOMSTA "Kennwert für Zeit zum Festsetzen auf Homogen nach Startende" VALUE 0xa1019038 _REC_VAL_20_u2 98.30250000000001 _CNV_R_R_Def_td_uw__679_CM 0. 655.35 FORMAT "%5.2" /end CHARACTERISTIC
/begin CHARACTERISTIC K_TMINSCH "Temperaturschwelle zum Umschalten Kaltwunsch auf Verbrennungswunsch in Standartanforderung" VALUE 0xa1019026 _REC_VAL_20_s2 98.30250000000001 _CNV_R_R_Def_t_sw_q_620_CM -327.68 327.67 FORMAT "%5.2" /end CHARACTERISTIC
/begin CHARACTERISTIC K_TMIN_VVT "min VVT Verstellzeit" VALUE 0xa101ca5e _REC_VAL_20_u1 0.996 _CNV_R_R_Def_t_ub_b_708_CM 0. 0.996 /end CHARACTERISTIC
/begin CHARACTERISTIC K_TMOTMAX_ZSK "Temperaturschwelle zur Erkennung Kalte Gleichstellung nicht erfolgt" VALUE 0xa101901a _REC_VAL_20_s2 98.30250000000001 _CNV_R_R_Def_t_sw_q_620_CM -327.68 327.67 FORMAT "%5.2" /end CHARACTERISTIC
/begin CHARACTERISTIC K_TOFF_VVT "Offset VVT Verstellzeit" VALUE 0xa101ca5f _REC_VAL_20_u1 0.996 _CNV_R_R_Def_t_ub_b_708_CM 0. 0.996 /end CHARACTERISTIC
/begin CHARACTERISTIC K_TVDPSTEND "Verzögerung B_startende für enable Dashpot" VALUE 0xa1017e20 _REC_VAL_20_u2 98.30250000000001 _CNV_R_R_Def_td_uw__679_CM 0. 655.35 FORMAT "%5.2" /end CHARACTERISTIC
/begin CHARACTERISTIC K_TVFSAWE "Verzögerung B_sa für enable Dashpot" VALUE 0xa1017e22 _REC_VAL_20_u2 98.30250000000001 _CNV_R_R_Def_td_uw__679_CM 0. 655.35 FORMAT "%5.2" /end CHARACTERISTIC
/begin CHARACTERISTIC K_T_LAMD "Tmot-Schwelle für Rampe F_lazw_md" VALUE 0xa101c9a6 _REC_VAL_20_s2 98.30250000000001 _CNV_R_R_Def_t_sw_q_620_CM -327.68 327.67 FORMAT "%5.2" /end CHARACTERISTIC
/begin CHARACTERISTIC K_UBW_TNSTART "Wartezeit nach Start" VALUE 0xa101ca58 _REC_VAL_20_u2 98.30250000000001 _CNV_R_R_Def_td_uw__679_CM 0. 655.35 FORMAT "%5.2" /end CHARACTERISTIC
/begin CHARACTERISTIC K_VB_APPL "Verbot aus Applikation" VALUE 0xa101905e _REC_VAL_20_u1 2.34 _CNV_S_7_Def_bvgdi_589_CM 0. 6. BIT_MASK 0xFF /end CHARACTERISTIC
/begin CHARACTERISTIC K_VB_DINOTL "Verbotsmatrix für Di Notlauf" VALUE 0xa101905f _REC_VAL_20_u1 2.34 _CNV_S_7_Def_bvgdi_589_CM 0. 6. BIT_MASK 0xFF /end CHARACTERISTIC
/begin CHARACTERISTIC K_VB_HOM "Verbot Homogen" VALUE 0xa1019060 _REC_VAL_20_u1 2.34 _CNV_S_7_Def_bvgdi_589_CM 0. 6. BIT_MASK 0xFF /end CHARACTERISTIC
/begin CHARACTERISTIC K_VB_SCH "Verbot Schichtbetreieb" VALUE 0xa1019061 _REC_VAL_20_u1 2.34 _CNV_S_7_Def_bvgdi_589_CM 0. 6. BIT_MASK 0xFF /end CHARACTERISTIC
/begin CHARACTERISTIC K_VLLZWHD "V-Schwelle zum setzen von B_md_dynman" VALUE 0xa10190d8 _REC_VAL_20_u2 100.8 _CNV_R_R_Def_v_uw_q_723_CM 0. 360. FORMAT "%5.0" /end CHARACTERISTIC
/begin CHARACTERISTIC K_VLLZWHD_HYS "V-Schwelle zum zurücksetzen von B_md_dynman" VALUE 0xa10190da _REC_VAL_20_u2 100.8 _CNV_R_R_Def_v_uw_q_723_CM 0. 360. FORMAT "%5.0" /end CHARACTERISTIC
/begin CHARACTERISTIC K_VLSTAND "Standartanforderung bei Volllast" VALUE 0xa1019062 _REC_VAL_20_u1 8. _CNV_S_5_Def_ba_gdi_585_CM 0. 8. BIT_MASK 0xFF /end CHARACTERISTIC
/begin CHARACTERISTIC K_VLSTANDSUB "Sunbetriebsartanforderung bei Volllast" VALUE 0xa1019063 _REC_VAL_20_u1 15. _CNV_S_12_Def_ba_gdi_587_CM 0. 15. BIT_MASK 0xFF /end CHARACTERISTIC
/begin CHARACTERISTIC K_VNULL "Schwelle für Fzg. steht Erkennung" VALUE 0xa1017e24 _REC_VAL_20_u2 0. _CNV_R_R_Def_v_uw_q_723_CM 0. 65535. FORMAT "%5.0" /end CHARACTERISTIC
/begin CHARACTERISTIC K_V_LAMD "Fz-Geschwindigkeit" VALUE 0xa101c998 _REC_VAL_20_u2 100.8 _CNV_R_R_Def_v_uw_q_723_CM 0. 360. FORMAT "%5.0" /end CHARACTERISTIC
/begin CHARACTERISTIC K_V_VVT "VVT Verstellgeschwindigkeit" VALUE 0xa101ca64 _REC_VAL_20_u2 63.99800000000001 _CNV_R_R_Def_vvvt_u_775_CM 1.e-003 63.999 FORMAT "%7.4" /end CHARACTERISTIC
/begin CHARACTERISTIC K_ZKRFMXATL "Zeitkonstante für gef. Max. Fuelling im Notlauf-Modus" VALUE 0xa1019994 _REC_VAL_20_u2 655.35 _CNV_R_R_Def_zk10ms_709_CM 1.e-002 655.36 FORMAT "%7.4" /end CHARACTERISTIC
/begin CHARACTERISTIC K_ZK_DMDK "Zeitkonstante zur Filterung von Dmdk_wunsch" VALUE 0xa1019142 _REC_VAL_20_u2 99.9984 _CNV_R_R_Def_f_uw_b_576_CM 0. 99.9984 /end CHARACTERISTIC
/begin CHARACTERISTIC K_ZK_MDKWUNSCH "" VALUE 0xa1017e26 _REC_VAL_20_u2 0.9999847412109381 _CNV_R_R_Def_f_uw_b_591_CM 0. 0.9999847412109381 FORMAT "%14.5" /end CHARACTERISTIC
/begin CHARACTERISTIC K_ZWRAMP_MDMAX "max Rampensteigung" VALUE 0xa10190b4 _REC_VAL_20_s2 131.07 _CNV_R_R_Def_m_sw_q_574_CM -3276.8 3276.7 FORMAT "%5.2" /end CHARACTERISTIC
/begin CHARACTERISTIC K_ZWRAMP_MIN "min Rampensteigung" VALUE 0xa10190b6 _REC_VAL_20_s2 131.07 _CNV_R_R_Def_m_sw_q_574_CM -3276.8 3276.7 FORMAT "%5.2" /end CHARACTERISTIC
/begin CHARACTERISTIC K_ZWRAMP_NMX "" VALUE 0xa10190b0 _REC_VAL_20_s2 0. _CNV_R_R_Def_n_sw_q_612_CM -32768. 32767. FORMAT "%5.0" /end CHARACTERISTIC
/begin CHARACTERISTIC K_ZWRAMP_PLUS "max Rampensteigung" VALUE 0xa10190b2 _REC_VAL_20_s2 131.07 _CNV_R_R_Def_m_sw_q_574_CM -3276.8 3276.7 FORMAT "%5.2" /end CHARACTERISTIC
/begin CHARACTERISTIC S_ARAUS "Freigabe Aktiv-Zeit AR" VALUE 0xa101921d _REC_VAL_20_u1 99.45 _CNV_R_R_Def_dez_sl_575_CM 0. 255. FORMAT "%3.0" /end CHARACTERISTIC
/begin CHARACTERISTIC S_BAPRIOSTFEST "Schalter zum Festhalten Ba_prio bis nach Startende" VALUE 0xa1019064 _REC_VAL_20_u1 1. _CNV_R_R_Def_dez_sl_575_CM 0. 1. FORMAT "%3.0" /end CHARACTERISTIC
/begin CHARACTERISTIC S_BASTATRES "Reset der aktuellen Verteilungsanzeige der Betriebsarten" VALUE 0xa1019065 _REC_VAL_20_u1 1. _CNV_R_R_Def_dez_sl_575_CM 0. 1. FORMAT "%3.0" /end CHARACTERISTIC
/begin CHARACTERISTIC S_BASTATRESG "Reset der gesamten Verteilungsanzeige der Betriebsarten" VALUE 0xa1019066 _REC_VAL_20_u1 1. _CNV_R_R_Def_dez_sl_575_CM 0. 1. FORMAT "%3.0" /end CHARACTERISTIC
/begin CHARACTERISTIC S_BA_AUTO "Umschalten auf automatische Ba Bestimmung alt" VALUE 0xa1019067 _REC_VAL_20_u1 1. _CNV_R_R_Def_dez_sl_575_CM 0. 1. FORMAT "%3.0" /end CHARACTERISTIC
/begin CHARACTERISTIC S_BA_TOGGLE "Schalter zum Einschalten Togglefunktion" VALUE 0xa1019068 _REC_VAL_20_u1 1. _CNV_R_R_Def_dez_sl_575_CM 0. 1. FORMAT "%3.0" /end CHARACTERISTIC
/begin CHARACTERISTIC S_BP_AR "" VALUE 0xa101922f _REC_VAL_20_u1 99.45 _CNV_R_R_Def_dez_sl_575_CM 0. 255. FORMAT "%3.0" /end CHARACTERISTIC
/begin CHARACTERISTIC S_CLRTBABR "Schalter zum Löschen Fehlerzähler" VALUE 0xa1019069 _REC_VAL_20_u1 1. _CNV_R_R_Def_dez_sl_575_CM 0. 1. FORMAT "%3.0" /end CHARACTERISTIC
/begin CHARACTERISTIC S_DMDZWON "true: Momenteneingriff freigegeben" VALUE 0xa10190ac _REC_VAL_20_u1 99.45 _CNV_R_R_Def_dez_sl_575_CM 0. 255. FORMAT "%3.0" /end CHARACTERISTIC
/begin CHARACTERISTIC S_ETA_RES "true: Eta_res wird eingerechnet, ansonsten 100%" VALUE 0xa10190aa _REC_VAL_20_u1 99.45 _CNV_R_R_Def_dez_sl_575_CM 0. 255. FORMAT "%3.0" /end CHARACTERISTIC
/begin CHARACTERISTIC S_FZDYN_F "true: Fahrerwunschmoment wird gefiltert" VALUE 0xa101921c _REC_VAL_20_u1 99.45 _CNV_R_R_Def_dez_sl_575_CM 0. 255. FORMAT "%3.0" /end CHARACTERISTIC
/begin CHARACTERISTIC S_GANG_MOD "" VALUE 0xa1019135 _REC_VAL_20_u1 99.45 _CNV_R_R_Def_dez_sl_575_CM 0. 255. FORMAT "%3.0" /end CHARACTERISTIC
/begin CHARACTERISTIC S_GDNKW "Notlauf bei drehender Kurbelwelle oder Startende" VALUE 0xa101901f _REC_VAL_20_u1 1. _CNV_R_R_Def_dez_sl_575_CM 0. 1. FORMAT "%3.0" /end CHARACTERISTIC
/begin CHARACTERISTIC S_GLAKTIV "Schalter zur Aktivierung Einrechnung Gleichstellung" VALUE 0xa101906a _REC_VAL_20_u1 1. _CNV_R_R_Def_dez_sl_575_CM 0. 1. FORMAT "%3.0" /end CHARACTERISTIC
/begin CHARACTERISTIC S_IPM_04 "IPM04 aktiv" VALUE 0xa101911c _REC_VAL_20_u1 99.45 _CNV_R_R_Def_dez_sl_575_CM 0. 255. FORMAT "%3.0" /end CHARACTERISTIC
/begin CHARACTERISTIC S_KATREGEN "" VALUE 0xa101c98f _REC_VAL_20_u1 99.45 _CNV_R_R_Def_dez_sl_575_CM 0. 255. FORMAT "%3.0" /end CHARACTERISTIC
/begin CHARACTERISTIC S_LASTAB_VL "1: Lastabschaltung bei Volllast (nur zu Testzwecken)" VALUE 0xa101ca5c _REC_VAL_20_u1 99.45 _CNV_R_R_Def_dez_sl_575_CM 0. 255. FORMAT "%3.0" /end CHARACTERISTIC
/begin CHARACTERISTIC S_LA_MX "Schalter Berechnung Md_la_mx" VALUE 0xa101c98e _REC_VAL_20_u1 99.45 _CNV_R_R_Def_dez_sl_575_CM 0. 255. FORMAT "%3.0" /end CHARACTERISTIC
/begin CHARACTERISTIC S_LA_ZWMD "Schalter Freigabe Rampe F_lazw_md" VALUE 0xa101c990 _REC_VAL_20_u1 99.45 _CNV_R_R_Def_dez_sl_575_CM 0. 255. FORMAT "%3.0" /end CHARACTERISTIC
/begin CHARACTERISTIC S_MDIARLL_HD "true: Mdi_arll_zw statt Mdi_ar_f" VALUE 0xa10190a9 _REC_VAL_20_u1 99.45 _CNV_R_R_Def_dez_sl_575_CM 0. 255. FORMAT "%3.0" /end CHARACTERISTIC
/begin CHARACTERISTIC S_MDI_SOLL "1: Mdi_soll wird zur Berechnung von Md_res_real verwendet" VALUE 0xa101ca5b _REC_VAL_20_u1 99.45 _CNV_R_R_Def_dez_sl_575_CM 0. 255. FORMAT "%3.0" /end CHARACTERISTIC
/begin CHARACTERISTIC S_MDI_ZWHAND "true: Mdi_zw_soll aus Applkonst" VALUE 0xa10190ab _REC_VAL_20_u1 99.45 _CNV_R_R_Def_dez_sl_575_CM 0. 255. FORMAT "%3.0" /end CHARACTERISTIC
/begin CHARACTERISTIC S_MDKMX_UL "" VALUE 0xa10190d3 _REC_VAL_20_u1 99.45 _CNV_R_R_Def_dez_sl_575_CM 0. 255. FORMAT "%3.0" /end CHARACTERISTIC
/begin CHARACTERISTIC S_MDLLALL "Umschalter für Aufteilung Momenteneingriff" VALUE 0xa10190a8 _REC_VAL_20_u1 99.45 _CNV_R_R_Def_dez_sl_575_CM 0. 255. FORMAT "%3.0" /end CHARACTERISTIC
/begin CHARACTERISTIC S_MDRESREAL "1: Md_res_real wird zur Berechnung Dmd_l_max verwendet" VALUE 0xa101ca5a _REC_VAL_20_u1 99.45 _CNV_R_R_Def_dez_sl_575_CM 0. 255. FORMAT "%3.0" /end CHARACTERISTIC
/begin CHARACTERISTIC S_NBAWNOT "Schalter zur Aktivierung der Drehzahlbegrenzung " VALUE 0xa101906b _REC_VAL_20_u1 1. _CNV_R_R_Def_dez_sl_575_CM 0. 1. FORMAT "%3.0" /end CHARACTERISTIC
/begin CHARACTERISTIC S_NGANG_APPL "Schalter Appl Drehzahlregler akt" VALUE 0xa1019130 _REC_VAL_20_u1 99.45 _CNV_R_R_Def_dez_sl_575_CM 0. 255. FORMAT "%3.0" /end CHARACTERISTIC
/begin CHARACTERISTIC S_NLDG "Schalter Notlauf GD" VALUE 0xa101cf82 _REC_VAL_20_u1 99.45 _CNV_R_R_Def_dez_sl_575_CM 0. 255. FORMAT "%3.0" /end CHARACTERISTIC
/begin CHARACTERISTIC S_NLWAHL_MAN "Schalter NL Auswahl Handbetrieb" VALUE 0xa101cf87 _REC_VAL_20_u1 99.45 _CNV_R_R_Def_dez_sl_575_CM 0. 255. FORMAT "%3.0" /end CHARACTERISTIC
/begin CHARACTERISTIC S_NOTL_DK "Schalter Aktivierung des NL Manager, DK" VALUE 0xa101cf84 _REC_VAL_20_u1 99.45 _CNV_R_R_Def_dez_sl_575_CM 0. 255. FORMAT "%3.0" /end CHARACTERISTIC
/begin CHARACTERISTIC S_NOTL_DKOBD "Schalter Aktivierung des NL Manager, DK OBD" VALUE 0xa101cf85 _REC_VAL_20_u1 99.45 _CNV_R_R_Def_dez_sl_575_CM 0. 255. FORMAT "%3.0" /end CHARACTERISTIC
/begin CHARACTERISTIC S_NOTL_KS "Schalter Aktivierung des NL Manager, KS" VALUE 0xa101cf86 _REC_VAL_20_u1 99.45 _CNV_R_R_Def_dez_sl_575_CM 0. 255. FORMAT "%3.0" /end CHARACTERISTIC
/begin CHARACTERISTIC S_NOTL_PRAIL "Schalter Aktivierung des NL Manager" VALUE 0xa101cf83 _REC_VAL_20_u1 99.45 _CNV_R_R_Def_dez_sl_575_CM 0. 255. FORMAT "%3.0" /end CHARACTERISTIC
/begin CHARACTERISTIC S_PRIONEU "Aktivierung neue Priorisierung" VALUE 0xa101906c _REC_VAL_20_u1 1. _CNV_R_R_Def_dez_sl_575_CM 0. 1. FORMAT "%3.0" /end CHARACTERISTIC
/begin CHARACTERISTIC S_PRIONOTLR "Rücksetzen der Notfallmassnahme" VALUE 0xa101906d _REC_VAL_20_u1 1. _CNV_R_R_Def_dez_sl_575_CM 0. 1. FORMAT "%3.0" /end CHARACTERISTIC
/begin CHARACTERISTIC S_PWGMAX_AKT "" VALUE 0xa1017e2d _REC_VAL_20_u1 1. _CNV_R_R_Def_dez_sl_575_CM 0. 1. FORMAT "%3.0" /end CHARACTERISTIC
/begin CHARACTERISTIC S_RGNKAT_HLA1 "-" VALUE 0xa1019000 _REC_VAL_20_u1 99.45 _CNV_R_R_Def_dez_sl_575_CM 0. 255. FORMAT "%3.0" /end CHARACTERISTIC
/begin CHARACTERISTIC S_SCHNUMS "-" VALUE 0xa1019001 _REC_VAL_20_u1 99.45 _CNV_R_R_Def_dez_sl_575_CM 0. 255. FORMAT "%3.0" /end CHARACTERISTIC
/begin CHARACTERISTIC S_SIKOAKT_ENA "Einrechnen B_siko_akt in B_zw_dynman/B_md_dynman" VALUE 0xa10190d4 _REC_VAL_20_u1 99.45 _CNV_R_R_Def_dez_sl_575_CM 0. 255. FORMAT "%3.0" /end CHARACTERISTIC
/begin CHARACTERISTIC S_UMS_VBSA "Schalter zum Abschalten Ausschalten SA bei Umschaltung" VALUE 0xa1019015 _REC_VAL_20_u1 99.45 _CNV_R_R_Def_dez_sl_575_CM 0. 255. FORMAT "%3.0" /end CHARACTERISTIC
/begin CHARACTERISTIC S_VB_BA "Schalter zum Nutzen Verbotsbits in DI Notlauf" VALUE 0xa101906e _REC_VAL_20_u1 1. _CNV_R_R_Def_dez_sl_575_CM 0. 1. FORMAT "%3.0" /end CHARACTERISTIC
/begin CHARACTERISTIC S_WL_AR "Schalter Schwingungszähler aktiv" VALUE 0xa101922e _REC_VAL_20_u1 99.45 _CNV_R_R_Def_dez_sl_575_CM 0. 255. FORMAT "%3.0" /end CHARACTERISTIC
/begin COMPU_METHOD _CNV_R_R_Def_a_sw_b_570_CM "Def_a_sw_b64" RAT_FUNC "%6.3" "m/s²" COEFFS 0. 32768. 0. 0. 0. 64. /end COMPU_METHOD
/begin COMPU_METHOD _CNV_R_R_Def_f_ub_b_573_CM "Def_f_ub_b1" RAT_FUNC "%6.3" "-" COEFFS 0. 256. 0. 0. 0. 1. /end COMPU_METHOD
/begin COMPU_METHOD _CNV_R_R_Def_m_sw_q_574_CM "Def_m_sw_q0p1" RAT_FUNC "%6.3" "Nm" COEFFS 0. 10. 0. 0. 0. 1. /end COMPU_METHOD
/begin COMPU_METHOD _CNV_R_R_Def_dez_sl_575_CM "Def_dez_sl_q1" RAT_FUNC "%6.3" "-" COEFFS 0. 1. 0. 0. 0. 1. /end COMPU_METHOD
/begin COMPU_METHOD _CNV_R_R_Def_f_uw_b_576_CM "Def_f_uw_b100" RAT_FUNC "%6.3" "%" COEFFS 0. 65536. 0. 0. 0. 100. /end COMPU_METHOD
/begin COMPU_METHOD _CNV_R_R_Def_p_sw_q_578_CM "Def_p_sw_q0p039" RAT_FUNC "%6.3" "hPa" COEFFS 0. 256. 0. 0. 0. 10. /end COMPU_METHOD
/begin COMPU_METHOD _CNV_R_R_Def_f_uw_b_579_CM "Def_f_uw_b2" RAT_FUNC "%6.3" "-" COEFFS 0. 65536. 0. 0. 0. 2. /end COMPU_METHOD
/begin COMPU_METHOD _CNV_R_R_Def_f_uw_b_580_CM "Def_f_uw_b64" RAT_FUNC "%6.3" "-" COEFFS 0. 65536. 0. 0. 0. 64. /end COMPU_METHOD
/begin COMPU_METHOD _CNV_S_5_Def_ba_gdi_585_CM "Def_ba_gdi" TAB_VERB "%6.3" "-" COMPU_TAB_REF _CNV_S_5_Def_ba_gdi_585 /end COMPU_METHOD
/begin COMPU_VTAB _CNV_S_5_Def_ba_gdi_585 "Def_ba_gdi" TAB_VERB 5 0 "KEINE" 1 "Schicht" 2 "Homogen" 3 "Homogen_Schicht" 8 "NOTLAUF" /end COMPU_VTAB
/begin COMPU_METHOD _CNV_S_12_Def_ba_gdi_587_CM "Def_ba_gdi_sub" TAB_VERB "%6.3" "-" COMPU_TAB_REF _CNV_S_12_Def_ba_gdi_587 /end COMPU_METHOD
/begin COMPU_VTAB _CNV_S_12_Def_ba_gdi_587 "Def_ba_gdi_sub" TAB_VERB 12 0 "KEINE" 1 "Optimal" 2 "Lambda_1" 3 "Test_O2" 4 "KHM_DOE" 5 "KHM_Zw_eingriff" 6 "Bauteilschutz" 7 "KHM_La_split" 8 "Desu" 9 "NOxKat_reg" 10 "KHM_Desu" 15 "NOTLAUF" /end COMPU_VTAB
/begin COMPU_METHOD _CNV_S_5_Def_ba_enu_588_CM "Def_ba_enum_q1" TAB_VERB "%6.3" "-" COMPU_TAB_REF _CNV_S_5_Def_ba_enu_588 /end COMPU_METHOD
/begin COMPU_VTAB _CNV_S_5_Def_ba_enu_588 "Def_ba_enum_q1" TAB_VERB 5 0 "RUHE" 1 "HO" 2 "MR" 3 "GS" 4 "US" /end COMPU_VTAB
/begin COMPU_METHOD _CNV_S_7_Def_bvgdi_589_CM "Def_bvgdi" TAB_VERB "%6.3" "-" COMPU_TAB_REF _CNV_S_7_Def_bvgdi_589 /end COMPU_METHOD
/begin COMPU_VTAB _CNV_S_7_Def_bvgdi_589 "Def_bvgdi" TAB_VERB 7 0 "KEINE" 1 "Verbot_Schicht" 2 "Verbot_Homogen" 3 "Verbot_Homogen_und_Schicht" 4 "Verbot_Homogenschicht" 5 "Verbot_Schicht_und_Homogenschicht" 6 "Verbot_Homogen_und_Homogenschicht" /end COMPU_VTAB
/begin COMPU_METHOD _CNV_R_R_Def_f_uw_b_591_CM "Def_f_uw_b1" RAT_FUNC "%6.3" "-" COEFFS 0. 65536. 0. 0. 0. 1. /end COMPU_METHOD
/begin COMPU_METHOD _CNV_R_R_Def_td_ub__593_CM "Def_td_ub_q0p1" RAT_FUNC "%6.3" "s" COEFFS 0. 10. 0. 0. 0. 1. /end COMPU_METHOD
/begin COMPU_METHOD _CNV_R_R_Def_f_uw_b_594_CM "Def_f_uw_b16" RAT_FUNC "%6.3" "-" COEFFS 0. 65536. 0. 0. 0. 16. /end COMPU_METHOD
/begin COMPU_METHOD _CNV_R_R_Def_zw_sw__599_CM "Def_zw_sw_q0p1" RAT_FUNC "%6.3" "°" COEFFS 0. 10. 0. 0. 0. 1. /end COMPU_METHOD
/begin COMPU_METHOD _CNV_R_R_Def_f_sw_b_607_CM "Def_f_sw_b8" RAT_FUNC "%6.3" "-" COEFFS 0. 32768. 0. 0. 0. 8. /end COMPU_METHOD
/begin COMPU_METHOD _CNV_R_R_Def_f_sw_b_608_CM "Def_f_sw_b2" RAT_FUNC "%6.3" "-" COEFFS 0. 65536. 0. 0. 0. 4. /end COMPU_METHOD
/begin COMPU_METHOD _CNV_R_R_Def_dm_sw__610_CM "Def_dm_sw_q0p1" RAT_FUNC "%6.3" "Nm/s" COEFFS 0. 10. 0. 0. 0. 1. /end COMPU_METHOD
/begin COMPU_METHOD _CNV_R_R_Def_n_sw_q_612_CM "Def_n_sw_q1p0" RAT_FUNC "%6.3" "Upm" COEFFS 0. 1. 0. 0. 0. 1. /end COMPU_METHOD
/begin COMPU_METHOD _CNV_R_R_Def_rf_sw__616_CM "Def_rf_sw_q0p01" RAT_FUNC "%6.3" "%" COEFFS 0. 100. 0. 0. 0. 1. /end COMPU_METHOD
/begin COMPU_METHOD _CNV_R_R_Def_eta_sw_617_CM "Def_eta_sw_b200" RAT_FUNC "%6.3" "%" COEFFS 0. 32768. 0. 0. 0. 200. /end COMPU_METHOD
/begin COMPU_METHOD _CNV_R_R_Def_t_sw_q_618_CM "Def_t_sw_q0p1" RAT_FUNC "%6.3" "°C" COEFFS 0. 10. 0. 0. 0. 1. /end COMPU_METHOD
/begin COMPU_METHOD _CNV_R_R_Def_t_sw_q_620_CM "Def_t_sw_q0p01" RAT_FUNC "%6.3" "°C" COEFFS 0. 100. 0. 0. 0. 1. /end COMPU_METHOD
/begin COMPU_METHOD _CNV_R_R_Def_f_ub_b_625_CM "Def_f_ub_b2" RAT_FUNC "%6.3" "-" COEFFS 0. 256. 0. 0. 0. 2. /end COMPU_METHOD
/begin COMPU_METHOD _CNV_R_R_Def_eta_uw_627_CM "Def_eta_uw_b200" RAT_FUNC "%6.3" "%" COEFFS 0. 65536. 0. 0. 0. 200. /end COMPU_METHOD
/begin COMPU_METHOD _CNV_R_R_Def_eta_sw_628_CM "Def_eta_sw_q0p00305" RAT_FUNC "%6.3" "%" COEFFS 0. 32767. 0. 0. 0. 100. /end COMPU_METHOD
/begin COMPU_METHOD _CNV_R_R_Def_f_uw_b_632_CM "Def_f_uw_b256" RAT_FUNC "%6.3" "-" COEFFS 0. 65536. 0. 0. 0. 256. /end COMPU_METHOD
/begin COMPU_METHOD _CNV_R_R_Def_f_sw_b_634_CM "Def_f_sw_b64" RAT_FUNC "%6.3" "-" COEFFS 0. 65536. 0. 0. 0. 128. /end COMPU_METHOD
/begin COMPU_METHOD _CNV_R_R_Def_m_sw_q_659_CM "Def_m_sw_q0p01" RAT_FUNC "%6.3" "Nm" COEFFS 0. 100. 0. 0. 0. 1. /end COMPU_METHOD
/begin COMPU_METHOD _CNV_R_R_Def_md_rel_660_CM "Def_md_rel_q0p1" RAT_FUNC "%6.3" "%" COEFFS 0. 10. 0. 0. 0. 1. /end COMPU_METHOD
/begin COMPU_METHOD _CNV_R_R_Def_ngrd_s_668_CM "Def_ngrd_sb_q32p0" RAT_FUNC "%6.3" "Upm/s" COEFFS 0. 1. 0. 0. 0. 32. /end COMPU_METHOD
/begin COMPU_METHOD _CNV_R_R_Def_f_ub_b_670_CM "Def_f_ub_b4" RAT_FUNC "%6.3" "-" COEFFS 0. 256. 0. 0. 0. 4. /end COMPU_METHOD
/begin COMPU_METHOD _CNV_R_R_Def_td_uw__679_CM "Def_td_uw_q0p01" RAT_FUNC "%6.3" "s" COEFFS 0. 100. 0. 0. 0. 1. /end COMPU_METHOD
/begin COMPU_METHOD _CNV_R_R_Def_pwggrd_690_CM "Def_pwggrd_sw_b2500" RAT_FUNC "%6.3" "%/s" COEFFS 0. 4096. 0. 0. 0. 2500. /end COMPU_METHOD
/begin COMPU_METHOD _CNV_R_R_Def_wdk_sw_691_CM "Def_wdk_sw_q0p0244" RAT_FUNC "%6.3" "%" COEFFS 0. 4096. 0. 0. 0. 100. /end COMPU_METHOD
/begin COMPU_METHOD _CNV_R_R_Def_rk_uw__696_CM "Def_rk_uw_b16" RAT_FUNC "%6.3" "-" COEFFS 0. 2048. 0. 0. 0. 1. /end COMPU_METHOD
/begin COMPU_METHOD _CNV_R_R_Def_rk_sw__697_CM "Def_rk_sw_b1600" RAT_FUNC "%6.3" "%" COEFFS 0. 2048. 0. 0. 0. 100. /end COMPU_METHOD
/begin COMPU_METHOD _CNV_R_R_Def_rk_sw__698_CM "Def_rk_sw_b16" RAT_FUNC "%6.3" "-" COEFFS 0. 32768. 0. 0. 0. 16. /end COMPU_METHOD
/begin COMPU_METHOD _CNV_R_R_Def_f_sb_b_699_CM "Def_f_sb_b1" RAT_FUNC "%6.3" "-" COEFFS 0. 128. 0. 0. 0. 1. /end COMPU_METHOD
/begin COMPU_METHOD _CNV_S_1_Def_bit_ub_700_CM "Def_bit_ub_0" TAB_VERB "%6.3" "-" COMPU_TAB_REF _CNV_S_1_Def_bit_ub_700 /end COMPU_METHOD
/begin COMPU_VTAB _CNV_S_1_Def_bit_ub_700 "Def_bit_ub_0" TAB_VERB 1 0 "FALSE" /end COMPU_VTAB
/begin COMPU_METHOD _CNV_S_8_Def_st_mdi_701_CM "Def_st_mdinfo" TAB_VERB "%6.3" "-" COMPU_TAB_REF _CNV_S_8_Def_st_mdi_701 /end COMPU_METHOD
/begin COMPU_VTAB _CNV_S_8_Def_st_mdi_701 "Def_st_mdinfo" TAB_VERB 8 0 "KEINE" 1 "ASR" 2 "MSR" 3 "GS_DEC" 4 "GS_INC" 5 "AMT_DEC" 6 "AMT_INC" 7 "DCC" /end COMPU_VTAB
/begin COMPU_METHOD _CNV_R_R_Def_ti_uw__707_CM "Def_ti_uw_q0p0128" RAT_FUNC "%6.3" "ms" COEFFS 0. 78.125 0. 0. 0. 1. /end COMPU_METHOD
/begin COMPU_METHOD _CNV_R_R_Def_t_ub_b_708_CM "Def_t_ub_b1" RAT_FUNC "%6.3" "s" COEFFS 0. 256. 0. 0. 0. 1. /end COMPU_METHOD
/begin COMPU_METHOD _CNV_R_R_Def_zk10ms_709_CM "Def_zk10ms_uw_b655p36" RAT_FUNC "%6.3" "s" COEFFS 0. 0. 655.36 0. 1. 0. /end COMPU_METHOD
/begin COMPU_METHOD _CNV_R_R_Def_v_uw_q_723_CM "Def_v_uw_q1p0" RAT_FUNC "%6.3" "km/h" COEFFS 0. 1. 0. 0. 0. 1. /end COMPU_METHOD
/begin COMPU_METHOD _CNV_R_R_Def_f_ub_b_733_CM "Def_f_ub_b3" RAT_FUNC "%6.3" "-" COEFFS 0. 255. 0. 0. 0. 3. /end COMPU_METHOD
/begin COMPU_METHOD _CNV_R_R_Def_f_sb_b_738_CM "Def_f_sb_b0p25" RAT_FUNC "%6.3" "-" COEFFS 0. 512. 0. 0. 0. 1. /end COMPU_METHOD
/begin COMPU_METHOD _CNV_R_R_Def_f_ub_b_740_CM "Def_f_ub_b16" RAT_FUNC "%6.3" "-" COEFFS 0. 256. 0. 0. 0. 16. /end COMPU_METHOD
/begin COMPU_METHOD _CNV_S_7_Def_ba_754_CM "Def_ba" TAB_VERB "%6.3" "-" COMPU_TAB_REF _CNV_S_7_Def_ba_754 /end COMPU_METHOD
/begin COMPU_VTAB _CNV_S_7_Def_ba_754 "Def_ba" TAB_VERB 7 0 "KEINE" 1 "UGD" 2 "GD" 3 "GD_KLEINER_HUB" 6 "DKNOTL" 7 "VVTNOTL1" 8 "VVTNOTL" /end COMPU_VTAB
/begin COMPU_METHOD _CNV_R_R_Def_vvvt_u_775_CM "Def_vvvt_uw_b64" RAT_FUNC "%6.3" "mm/s" COEFFS 0. 65536. 0. 0. 0. 64. /end COMPU_METHOD
/begin RECORD_LAYOUT _REC_VAL_20_u1 FNC_VALUES 1 UBYTE COLUMN_DIR DIRECT /end RECORD_LAYOUT
/begin RECORD_LAYOUT _REC_VAL_20_u2 FNC_VALUES 1 UWORD COLUMN_DIR DIRECT /end RECORD_LAYOUT
/begin RECORD_LAYOUT _REC_VAL_20_s2 FNC_VALUES 1 SWORD COLUMN_DIR DIRECT /end RECORD_LAYOUT
/begin RECORD_LAYOUT _REC_VAL_20_s1 FNC_VALUES 1 SBYTE COLUMN_DIR DIRECT /end RECORD_LAYOUT
/begin RECORD_LAYOUT _REC_MAP_52_UBYTE_u2_s2_s2 NO_AXIS_PTS_X 1 UBYTE NO_AXIS_PTS_Y 2 UBYTE AXIS_PTS_X 3 SWORD INDEX_INCR DIRECT AXIS_PTS_Y 4 SWORD INDEX_INCR DIRECT FNC_VALUES 5 UWORD COLUMN_DIR DIRECT /end RECORD_LAYOUT
/begin RECORD_LAYOUT _REC_MAP_52_u1_s2_s2 NO_AXIS_PTS_X 1 UBYTE NO_AXIS_PTS_Y 2 UBYTE AXIS_PTS_X 3 SWORD INDEX_INCR DIRECT AXIS_PTS_Y 4 SWORD INDEX_INCR DIRECT FNC_VALUES 5 UBYTE COLUMN_DIR DIRECT /end RECORD_LAYOUT
/begin RECORD_LAYOUT _REC_MAP_52_UBYTE_s2_s2_s2 NO_AXIS_PTS_X 1 UBYTE NO_AXIS_PTS_Y 2 UBYTE AXIS_PTS_X 3 SWORD INDEX_INCR DIRECT AXIS_PTS_Y 4 SWORD INDEX_INCR DIRECT FNC_VALUES 5 SWORD COLUMN_DIR DIRECT /end RECORD_LAYOUT
/begin RECORD_LAYOUT _REC_MAP_52_UBYTE_s2_s2_u1 NO_AXIS_PTS_X 1 UBYTE NO_AXIS_PTS_Y 2 UBYTE AXIS_PTS_X 3 SWORD INDEX_INCR DIRECT AXIS_PTS_Y 4 UBYTE INDEX_INCR DIRECT FNC_VALUES 5 SWORD COLUMN_DIR DIRECT /end RECORD_LAYOUT
/begin RECORD_LAYOUT _REC_MAP_52_UBYTE_s1_s2_s2 NO_AXIS_PTS_X 1 UBYTE NO_AXIS_PTS_Y 2 UBYTE AXIS_PTS_X 3 SWORD INDEX_INCR DIRECT AXIS_PTS_Y 4 SWORD INDEX_INCR DIRECT FNC_VALUES 5 SBYTE COLUMN_DIR DIRECT /end RECORD_LAYOUT
/begin RECORD_LAYOUT _REC_MAP_52_UBYTE_s1_u1_s2 NO_AXIS_PTS_X 1 UBYTE NO_AXIS_PTS_Y 2 UBYTE AXIS_PTS_X 3 UBYTE INDEX_INCR DIRECT AXIS_PTS_Y 4 SWORD INDEX_INCR DIRECT FNC_VALUES 5 SBYTE COLUMN_DIR DIRECT /end RECORD_LAYOUT
/begin RECORD_LAYOUT _REC_MAP_52_u1_u1_u1 NO_AXIS_PTS_X 1 UBYTE NO_AXIS_PTS_Y 2 UBYTE AXIS_PTS_X 3 UBYTE INDEX_INCR DIRECT AXIS_PTS_Y 4 UBYTE INDEX_INCR DIRECT FNC_VALUES 5 UBYTE COLUMN_DIR DIRECT /end RECORD_LAYOUT
/begin RECORD_LAYOUT _REC_MAP_52_u1_u1_s2 NO_AXIS_PTS_X 1 UBYTE NO_AXIS_PTS_Y 2 UBYTE AXIS_PTS_X 3 UBYTE INDEX_INCR DIRECT AXIS_PTS_Y 4 SWORD INDEX_INCR DIRECT FNC_VALUES 5 UBYTE COLUMN_DIR DIRECT /end RECORD_LAYOUT
/begin RECORD_LAYOUT _REC_MAP_52_UBYTE_u2_s2_u1 NO_AXIS_PTS_X 1 UBYTE NO_AXIS_PTS_Y 2 UBYTE AXIS_PTS_X 3 SWORD INDEX_INCR DIRECT AXIS_PTS_Y 4 UBYTE INDEX_INCR DIRECT FNC_VALUES 5 UWORD COLUMN_DIR DIRECT /end RECORD_LAYOUT
/begin RECORD_LAYOUT _REC_CUR_TKL_UW_VV__u2_s2 NO_AXIS_PTS_X 1 UBYTE RESERVED 2 BYTE AXIS_PTS_X 3 SWORD INDEX_INCR DIRECT FNC_VALUES 4 UWORD COLUMN_DIR DIRECT /end RECORD_LAYOUT
/begin RECORD_LAYOUT _REC_CUR_TKL_UW_VV__u1_s2 NO_AXIS_PTS_X 1 UBYTE RESERVED 2 BYTE AXIS_PTS_X 3 SWORD INDEX_INCR DIRECT FNC_VALUES 4 UBYTE COLUMN_DIR DIRECT /end RECORD_LAYOUT
/begin RECORD_LAYOUT _REC_CUR_TKL_UW_VV__u1_u2 NO_AXIS_PTS_X 1 UBYTE RESERVED 2 BYTE AXIS_PTS_X 3 UWORD INDEX_INCR DIRECT FNC_VALUES 4 UBYTE COLUMN_DIR DIRECT /end RECORD_LAYOUT
/begin RECORD_LAYOUT _REC_CUR_TKL_UW_VV__s2_u2 NO_AXIS_PTS_X 1 UBYTE RESERVED 2 BYTE AXIS_PTS_X 3 UWORD INDEX_INCR DIRECT FNC_VALUES 4 SWORD COLUMN_DIR DIRECT /end RECORD_LAYOUT
/begin RECORD_LAYOUT _REC_CUR_TKL_UW_VV__s2_s2 NO_AXIS_PTS_X 1 UBYTE RESERVED 2 BYTE AXIS_PTS_X 3 SWORD INDEX_INCR DIRECT FNC_VALUES 4 SWORD COLUMN_DIR DIRECT /end RECORD_LAYOUT
/begin RECORD_LAYOUT _REC_CUR_TKL_UW_VV__u1_u1 NO_AXIS_PTS_X 1 UBYTE RESERVED 2 BYTE AXIS_PTS_X 3 UBYTE INDEX_INCR DIRECT FNC_VALUES 4 UBYTE COLUMN_DIR DIRECT /end RECORD_LAYOUT
/begin RECORD_LAYOUT _REC_CUR_TKL_UW_VV__s2_u1 NO_AXIS_PTS_X 1 UBYTE RESERVED 2 BYTE AXIS_PTS_X 3 UBYTE INDEX_INCR DIRECT FNC_VALUES 4 SWORD COLUMN_DIR DIRECT /end RECORD_LAYOUT
/begin RECORD_LAYOUT _REC_CUR_TKL_UW_VV__s2_s1 NO_AXIS_PTS_X 1 UBYTE RESERVED 2 BYTE AXIS_PTS_X 3 SBYTE INDEX_INCR DIRECT FNC_VALUES 4 SWORD COLUMN_DIR DIRECT /end RECORD_LAYOUT
/begin RECORD_LAYOUT _REC_VAL_2_u1 FNC_VALUES 1 UBYTE COLUMN_DIR DIRECT /end RECORD_LAYOUT
/begin RECORD_LAYOUT _REC_VAL_2_u2 FNC_VALUES 1 UWORD COLUMN_DIR DIRECT /end RECORD_LAYOUT
/begin RECORD_LAYOUT _REC_VAL_2_s2 FNC_VALUES 1 SWORD COLUMN_DIR DIRECT /end RECORD_LAYOUT
/begin FUNCTION MDAR ""
 /begin DEF_CHARACTERISTIC CW_FMKNUL CW_S_SPORT CW_TRQTR1 CW_TRQTR2 KF_DMDP1 KF_DMDP1A KF_DMDP2 KF_DMDP2A KF_DMDP3 KF_DMDP3A KF_DMDPON KF_DMLS1GD KF_DMLS1GDA KF_DMLS1UD KF_DMLS1UDA KF_DMLS2GD KF_DMLS2GDA KF_DMLS2UD KF_DMLS2UDA KF_DMLSDON KF_DMXLS3GD KF_DMXLS3GDA KF_DMXLS3UD KF_DMXLS3UDA KF_DPSFTD KF_FDASHPWG3 KF_FDASH_TMOT KF_FDMDPA12 KF_FDMFBT KF_FLSDPWGL KF_FMDKWUGRAD12 KF_FMDKWUGRAD3 KF_LSSPORT KF_MDKW_L KF_MDKW_LGD KF_MDK_DP_O KF_MDK_DP_U KF_MDK_LSD_O KF_MDK_LSD_U KF_UEB_MD KF_ZKDP3 KF_ZKDP3A KF_ZKLS3GD KF_ZKLS3GDA KF_ZKLS3UD KF_ZKLS3UDA KL_DMDPOFF KL_DMLSDOFF KL_FJMOT KL_FLSDPWG12 KL_FLSDPWG3 KL_F_UEB KL_KUPP_ENABLE KL_MU_WAN KL_ZK_ETAWAN K_AQMAX_SPS K_DMDKDP_MX K_DMDKLSD_MN K_F_SPORT K_KFATHS_EIN K_MDK_WUNSCHHYST K_NGFSAWE K_TLMD_AUS K_TLMD_EIN K_TVDPSTEND K_TVFSAWE K_VNULL K_ZK_MDKWUNSCH S_PWGMAX_AKT /end DEF_CHARACTERISTIC
 /begin OUT_MEASUREMENT A_quer_abs Dm_jmot Dmdkdp Dmdklsd Dmdp1 Dmdp2 Dmdp3 Dmdpoff Dmdpon Dmls1 Dmls2 Dmls3 Dmlsdoff Dmlsdon Dpsfaktd F_etawan Fdmfbt Flsdpwgl Ftrq_wfl_dp Kl_kuppenable_aus Mdi_res_dashini Mdi_res_lsini Mdi_res_mdar Mdk_dash Mdk_dp_o Mdk_dp_u Mdk_iwfdp Mdk_iwflsd Mdk_lsd Mdk_lsd_ag Mdk_lsd_o Mdk_lsd_u Mdk_lsd_wakor Mdk_w_f Mdk_wunsch_d Mdk_wunsch_gradmx Mdk_wunsch_l Mdk_wunsch_ref_hsa Mdk_wunsch_ref_sa Ntnkw St_dp_ber St_ls_ber St_mdar0 St_mdar0.B_dmdp St_mdar0.B_dmls St_mdar0.B_dp St_mdar0.B_edp St_mdar0.B_elsd St_mdar0.B_ifdp St_mdar0.B_ls St_mdar0.B_lsd St_mdar1 St_mdar1.B_dash St_mdar1.B_iflsd St_mdar1.B_kf_at St_mdar1.B_ll_md St_mdar1.B_tl_md Var_at Wandler_mu /end OUT_MEASUREMENT
/end FUNCTION
/begin FUNCTION MDBAFAK ""
 /begin DEF_CHARACTERISTIC K_BAW_HOMRGN K_BAW_KATRGN K_HOMOPT K_HOSOPT K_LA_HOMM K_MDI_R K_MDRES_RGN K_NMAXBA K_PSPVDK_GDV K_SCHOPT K_TDMAX_BAWBEOPT K_TDTEVZU S_RGNKAT_HLA1 S_SCHNUMS S_UMS_VBSA /end DEF_CHARACTERISTIC
 /begin OUT_MEASUREMENT Ba_ist Ba_soll Ba_subist Ba_subsoll Ba_ueb_gds Baw_h_hs Baw_h_s Baw_hs_h Baw_hs_s Baw_ist Baw_s_h Baw_s_hs Baw_soll F_dps_ba F_evmod F_llr_ba F_mdi_ba F_mdiop_ba F_mdres_rgn F_ml_ba F_nst_ba F_reib_ba F_st_ba F_vwi_ba F_wl_ba F_zw_ba Mdi_res_gdi Mdi_res_homo Nmax_ba Rf_egr_hs Rf_tev_hs Rf_tev_s Rk_soll_kr Rk_ueb Rk_ueb_ok St_ba_agf St_ba_agf.B_hstoech St_bawu St_bvena St_bvist St_bvso St_bvums St_bvwu St_disa_bmw St_disa_bmw.B_disa_stopp St_dknot St_dknot.B_vvt_dknotl St_mdbafak St_mdbafak.B_hmm_akt St_mdbafak.B_hom_akt St_mdbafak.B_hschicht St_mdbafak.B_la_stopp St_mdbafak.B_la_stopp1 St_mdbafak.B_la_stopp2 St_mdbafak.B_sch_akt St_mdbafak.B_schicht St_mdbafak2 St_mdbafak2.B_ba_um St_mdbafak2.B_mdres_rgn St_mdbafak2.B_quitt_h St_mdbafak2.B_quitt_hs St_mdbafak2.B_quitt_s St_mdbafak2.B_tev_stopp St_mdbafak2.B_zwbaw St_tiausgang St_tiausgang.B_esp_h1 St_tiausgang.B_esp_h2 St_tiausgang.B_esp_hs1 St_tiausgang.B_esp_hs2 St_tiausgang.B_rw_h T_tevzu Tdmax_bawbeopt /end OUT_MEASUREMENT
/end FUNCTION
/begin FUNCTION MDBANL ""
 /begin DEF_CHARACTERISTIC CW_NOTLAUF KF_ZWOPT_NOTL KF_ZW_NOTL KL_LA_NL1 KL_LA_NL2 KL_MDMAXNL_1 KL_MDMAXNL_2 K_BAWU_NL1 K_BAWU_NL2 K_BAWU_NL3 K_DPOS_AGRZU K_MA_BAWUNL K_MA_LANL K_MA_NMAXNL K_MA_VBNL K_MA_ZWNL K_MDBANL_CFG K_MDBANL_CFG2 K_MDIMXNL_ARR K_MDMAX_ENA K_MDNOTL_NEG K_MDNOTL_POS K_NLWAHL_MAN K_NMAX_NL1 K_NMAX_NL2 K_NMAX_NL3 K_POS_AGRZU S_NLDG S_NLWAHL_MAN S_NOTL_DK S_NOTL_DKOBD S_NOTL_KS S_NOTL_PRAIL /end DEF_CHARACTERISTIC
 /begin OUT_MEASUREMENT Ba_vb_nl Ba_wu_nl Err_notl La_soll_notl Mdi_max_notl Mdi_max_notl_sl Mdi_mxnl_min Nmax_notl Notl_wahl St_mdbanl St_mdbanl.B_agrzu_nl St_mdbanl.B_disa_nl St_mdbanl.B_evvt_vsa_tmp St_mdbanl.B_evvt_vse_tmp St_mdbanl.B_lastopp_nl St_mdbanl.B_tevzu_nl St_mdbanl.B_wesb1h_nl St_mdbanl.B_zw_nl St_mdbanl2 St_mdbanl2.B_vbdoe_nl St_mdbanl_agr St_mdbanl_agr.B_agrauf_nl St_mdbanl_agr.B_fi_agr St_mdbanl_agr.B_pos_agrzu St_mdbanl_lok St_mdbanl_lok.B_mdmax_notl St_mdbanl_lok.B_nkw_prail St_mdbanl_lok.B_nldgh St_mdbanl_lok.B_notl3 St_mdbanl_lok.B_notldk4 St_mdbanl_lok.B_notldk5 St_mdbanl_lok.B_notlks6 St_mdbanl_lok.B_notlprail1 St_mdbanl_lok.B_notlprail2 Zw_grund_nl Zw_opt_nl /end OUT_MEASUREMENT
/end FUNCTION
/begin FUNCTION MDBAPRIO ""
 /begin DEF_CHARACTERISTIC CW_BANOAPPL CW_BAWLL CW_BAWVL CW_GLAKTIV CW_LLBA CW_RGN CW_UMS_FAST CW_VAKTIV CW_VAKTIV2 KF_PRIO_NOTL KF_UMS_NOTL K_ALLVERBOT K_BANOAPPL K_BASTART K_BAWKALT K_BAWNOT K_BAWSCHALT K_BAW_APPL K_BAW_APPSUB K_BA_APPL K_BA_TOGGLE1 K_BA_TOGGLE2 K_BA_TOGSUB1 K_BA_TOGSUB2 K_DINOTL K_DINOTLSUB K_DTMINSCH K_HOMBTS K_HOMBTSSUB K_HOMHEIZ K_HOMHEIZSUB K_HOMLA1 K_HOMLA1SUB K_HOMTO2 K_HOMTO2SUB K_H_STANDART K_KATREG K_KATREGSUB K_KEINE_BA K_LLSTAND K_LLSTANDSUB K_LLSTANDSUB_1 K_LLSTAND_1 K_NBAHOM K_NBAWNOTMN K_NBAWNOTMX K_PRIORESET K_PRIORESETK K_PRIO_BA1 K_PRMX_PRNOT K_PRMX_UMNOT K_TBA_TOGGLE K_TMAX_QUIT K_TMAX_UMS K_TMINHOMSTA K_TMINSCH K_TMOTMAX_ZSK K_VB_APPL K_VB_DINOTL K_VB_HOM K_VB_SCH K_VLSTAND K_VLSTANDSUB S_BAPRIOSTFEST S_BASTATRES S_BASTATRESG S_BA_AUTO S_BA_TOGGLE S_CLRTBABR S_GDNKW S_GLAKTIV S_NBAWNOT S_PRIONEU S_PRIONOTLR S_VB_BA /end DEF_CHARACTERISTIC
 /begin OUT_MEASUREMENT Ba_prio Ba_prio_neu Ba_prio_tra Ba_subprio Ba_subprio_neu Ba_subprio_tra Baprio_HO Baprio_HSO Baprio_SO Baprio_appl Baprio_dinotl Baprio_entschw Baprio_heiz Baprio_katman1 Baprio_katman2 Baprio_katreg Baprio_mdi Baprio_pruef Baprio_stand Baprio_ueh Bav_appl Bav_dinotl Bav_mdi Bav_prio Bav_prio_v Bav_ueh Baw_appl Baw_dinotl Baw_entschw Baw_gesamt Baw_gesamt_p2 Baw_heiz Baw_katman1 Baw_katman2 Baw_katreg Baw_mdi Baw_prio Baw_prionotl Baw_pruef Baw_standart Baw_ueh Baw_umsnotl Prio_sieg Rt_bastat_h Rt_bastat_hs Rt_bastat_s Rt_bastat_sa Rt_bastatg_h Rt_bastatg_hs Rt_bastatg_s Rt_bastatg_sa St_bano St_baumsch St_baumsch.B_ba_toggle St_baumsch.B_ba_toggletime St_baumsch.B_babr St_baumsch.B_prschalt St_dps St_dps.B_dpsadp St_dps.B_gd St_dps.B_gdst St_dps.B_gdvhub St_kath_ena St_kath_ena.B_hsplit_ena St_kath_ena.B_nesps_ena St_kath_ena.B_verb_h St_kath_ena.B_verb_s St_khaktiv St_khaktiv.B_khaktiv_h St_khaktiv.B_khaktiv_s St_mdbafast St_mdbafast.B_beopt_aus St_mdbafast.B_ums_fast St_mdbaprio St_mdbaprio.B_bastat_gee St_mdbaprio.B_bastat_mle St_mdbaprio.B_katreganf St_priodiag St_priodiag.B_badif_bv St_priodiag.B_badif_prio St_priodiag.B_bv_haeng St_priodiag.B_prio_haeng St_priodiag.B_prio_not St_priodiag.B_quit_notl St_priodiag.B_ums_not St_priodiag.B_ums_notl T_babr T_quit T_umsch Td_bastat_h Td_bastat_hs Td_bastat_s Td_bastat_sa Td_bastatg_h Td_bastatg_sa Td_baststg_hs Td_baststg_s /end OUT_MEASUREMENT
/end FUNCTION
/begin FUNCTION MDBASCHALT ""
 /begin DEF_CHARACTERISTIC K_DMDZWO K_DMDZWOHYS K_DMDZWOLL K_DMDZWOLLHYS K_DMDZWU K_DMDZWUHYS K_DMDZWULL K_DMDZWULLHYS K_KMDZW_DASH K_MDISIKOHYST K_MDI_ZWHAND K_MDZW_LSD K_ZWRAMP_MDMAX K_ZWRAMP_MIN K_ZWRAMP_NMX K_ZWRAMP_PLUS S_DMDZWON S_ETA_RES S_MDIARLL_HD S_MDI_ZWHAND S_MDLLALL /end DEF_CHARACTERISTIC
 /begin OUT_MEASUREMENT Dps_diff Md_soll_delta Mdi_arll Mdi_arll_la Mdi_arll_zw Mdi_bas_korr Mdi_la_soll Mdi_ml_soll Mdi_ml_sollvb Mdi_res_ll Mdi_rk_soll Mdi_soll Mdi_soll_1 Mdi_soll_arll Mdi_soll_canarll Mdi_soll_l Mdi_sollvb Mdi_zw_rampe Mdi_zw_soll Mdi_zw_sollcan Mdi_zw_sollvb St_mdbaschalt St_mdbaschalt.B_mdzw_1 St_mdbaschalt.B_mdzw_2 St_mdbaschalt.B_mdzw_3 St_mdbaschalt.B_mdzw_4 St_mdbaschalt.B_mdzw_5 St_mdbaschalt.B_mdzw_hd /end OUT_MEASUREMENT
/end FUNCTION
/begin FUNCTION MDDMK ""
 /begin DEF_CHARACTERISTIC CW_DYNMAN KL_MDKMAXUL KL_MDKMINASR K_MDI_RESOFF K_MDI_RESON K_MDZWPLUS_HYS K_NWEHYS K_ST_LDMCHK K_ST_LDMINIT K_ST_LDMKUPP K_ST_LDMOFF K_ST_MDINFOGES K_ST_MDINFOL K_ST_MDINFOS K_VLLZWHD K_VLLZWHD_HYS S_MDKMX_UL S_SIKOAKT_ENA /end DEF_CHARACTERISTIC
 /begin OUT_MEASUREMENT Dmdkw_soll Mdi_fzdyn_res Mdi_soll_can Mdi_soll_cangdi Mdi_soll_k Mdi_soll_kc Mdi_soll_kdyn Mdi_soll_kdync Mdi_soll_lk Mdi_soll_lkdyn Mdi_soll_min3 Mdi_wunsch Mdk_ext_min Mdk_l1 Mdk_l2 Mdk_min_res Mdk_s1 Mdk_s2 Mdk_soll Mdk_soll_l Mdk_soll_min1 Mdk_soll_min1c Mdk_soll_plus Mdk_ul_mx Mdkw_soll Mdkw_soll_l St_ldm_chk St_ldm_init St_ldm_off St_mdinfo_ges St_mdinfo_l St_mdinfo_s St_mdk St_mdk.B_asr_akt St_mdk.B_getr_plus St_mdk.B_md_dynman St_mdk.B_mdk_plus St_mdk.B_msr_aktiv St_mdk.B_san St_mdk.B_siko_akt St_mdk.B_zw_dynman St_mdk1 St_mdk1.B_mdzw_min1 St_mdk1.B_mdzw_min2 St_mdk1.B_mdzw_plus St_mdk1.B_zwe_ar St_mdk1.B_zwe_fzdyn St_mdk1.B_zwe_kh St_mdk1.B_zwe_kupp St_mdk1.B_zwe_llr St_mdk1.B_zwe_res St_mdk1.B_zwe_resa St_mdk1.B_zwe_sa St_mdk1.B_zwe_start St_mdk2 St_mdk2.B_accl_plus St_mdk2.B_accs_plus St_mdk2.B_asr_l St_mdk2.B_asr_s St_mdk2.B_gsl_minus St_mdk2.B_gsl_plus St_mdk2.B_gss_minus St_mdk2.B_gss_plus St_mdk2.B_mdres_wm St_mdk2.B_msr_l St_mdk2.B_msr_s St_mdk2.B_smgl_minus St_mdk2.B_smgl_plus St_mdk2.B_smgs_minus St_mdk2.B_smgs_plus St_mdk3 St_mdk3.B_hd St_mdk3.B_nwehd St_mdk3.B_vhd /end OUT_MEASUREMENT
/end FUNCTION
/begin FUNCTION MDFW ""
 /begin DEF_CHARACTERISTIC KF_MDSCHALT KF_SCHALT_WS K_DN_SCHALT K_GANG_MAX K_GANG_MINUS K_GANG_PLUS K_HSCHALT_WS K_I_GANG K_MDIPM_HYS K_NGANG_APPL K_NSTAT_OFF K_RSCHALT_WS K_TDNSCHALT K_TDSCHALT_MAX K_ZK_DMDK S_GANG_MOD S_IPM_04 S_NGANG_APPL /end DEF_CHARACTERISTIC
 /begin OUT_MEASUREMENT Dmdk Dmdk_wunsch Dn_gang Gang_soll Mdk_fw Mdk_wunsch Mdk_wunsch_cnt Mdk_wunsch_grad Mdk_wunsch_proz Mdk_wunsch_vb Mdk_wunsch_vbmrad N_gang_neu Schalt_ws St_fw St_fw.B_hschalt_komb St_fw.B_kupp_extalt St_fw.B_ldm_akt04 St_fw.B_ldm_off St_fw.B_ldm_offhs St_fw.B_ldm_offreg St_fw.B_ldm_offrs St_fw.B_rschalt_komb St_fw1 St_fw1.B_nschalt_akt Tdnschalt Tdschalt_max /end OUT_MEASUREMENT
/end FUNCTION
/begin FUNCTION MDFZDYN ""
 /begin DEF_CHARACTERISTIC CW_AR KF_D_PAR KF_D_PARA KF_PAR_NULL KF_PAR_NULLA KF_SNFILT_ARAN KF_SNFILT_ARAUS KF_TAR_AUS KF_TDAR KF_W_ARMD KL_TAR_KUP KL_TMOT_ARMD K_CNTAR_AUS K_ENTPR_FL K_ENTPR_SCH K_FGRENZ1_AR K_FGRENZ1_ARA K_FGRENZ_AR K_FGRENZ_ARA K_KEINAR_AT K_KEINAR_SMG K_NFILTMN K_NFILTMX K_ORDF_AR K_PAR_MAX K_PAR_MAXA K_PAR_MIN K_PAR_MINA K_PWGGRAD_AR K_PWGGRAD_ARN K_SONKW_AR K_SSCHWINGUNG_AR K_STMOT_AR K_SUNKW_AR K_SV_AR K_TAR_AUS K_TAR_EIN S_ARAUS S_BP_AR S_FZDYN_F S_WL_AR /end DEF_CHARACTERISTIC
 /begin OUT_MEASUREMENT Cnt_ar_aus Mdi_ar_f Mdi_fzdyn Mdk_fzdyn Mdk_wunsch_filt N_filt N_filt_abs N_filt_alt N_filt_bp N_filt_tp P_ar Pwg_grad St_ar1 St_ar1.B_ar_akt St_ar1.B_ar_ber St_ar1.B_arakt_fl St_ar1.B_kein_ar St_ar1.B_td_arakt St_ar1.B_td_kupp St_ar1.B_zr_ar T_ar_aus T_p_ar Td_ar_an Td_ar_ber Td_kupp Zr_entpr_fl Zr_fl_ar Zr_schwingung_ar Zr_vbar /end OUT_MEASUREMENT
/end FUNCTION
/begin FUNCTION MDIPMFW "" /end FUNCTION
/begin FUNCTION MDIST "" /begin DEF_CHARACTERISTIC K_MAT_MDIOP /end DEF_CHARACTERISTIC
 /begin OUT_MEASUREMENT Eta_ges_ist Eta_hs_ist Eta_ist Eta_s_ist Mdi_opt_1 Mdi_opt_2 Mdi_opt_l1 Mdi_opt_s Mdi_s_istm Rk_opt_ist /end OUT_MEASUREMENT
/end FUNCTION
/begin FUNCTION MDLA ""
 /begin DEF_CHARACTERISTIC CW_MDLA_VAR KF_LA_MDMX KL_ETA_LA K_BA_LAMD K_DPSVER_LAMD K_DPS_LAMD K_LAMDFAK K_LAZW_MINUS K_LAZW_PLUS K_LA_MDMN K_LA_OPT K_MD_RESMXLA K_TDLAMD_AUS K_TDLAMD_EIN K_TDLAMD_EIN2 K_TEBGLLA_OFF K_T_LAMD K_V_LAMD S_KATREGEN S_LA_MX S_LA_ZWMD /end DEF_CHARACTERISTIC
 /begin OUT_MEASUREMENT Eta_rk_md Eta_rk_mdmx F_la_zwmx F_lazw_md La_md La_soll_md Md_la_mx Mdi_la_sollbg Mdi_opt St_rf1 St_rf1.B_dps_lamd St_rf1.B_la_md St_rf1.B_la_zwmd St_rf1.B_v_lamd Tddpslamd Tdlamdaus Tdlamdein Tdlamdein2 /end OUT_MEASUREMENT
/end FUNCTION
/begin FUNCTION MDMAX ""
 /begin DEF_CHARACTERISTIC CW_MD_TURBO CW_TZKMDMX CW_VL KF_MDIOP_1 KF_MDIOP_2 KL_FMDI_VL KL_FTVDK_MDMAX KL_LAMX KL_LAMX_FP KL_LAMX_FV KL_RFMXATLNL KL_TASCHE KL_TMZE KL_T_2UMDREH KL_WT_UMDREH K_D_FVLAUS K_F_RFMXFMN K_F_RFMXLESS K_F_RFMXPLUS K_F_RFMXTEHYST K_N_TIMDRED K_TI1HOM K_TI2HOM K_ZKRFMXATL /end DEF_CHARACTERISTIC
 /begin OUT_MEASUREMENT F_lamx_fp F_mdivl F_rfmx F_rfv_lamx F_vl_aus Kl_tasche_aus Kl_tmze_aus Mdi_max Mdi_max_l1 Mdk_max Mdk_max_real Rf_dvvt_max Rf_tim_mx Rf_umax Rf_vl Rf_vl_ob Rf_vl_obatl Rfv_max Rfv_vl_roh St_ti_b St_ti_b.B_temxon T_umdreh_wt Ti_quot /end OUT_MEASUREMENT
/end FUNCTION
/begin FUNCTION MDNA ""
 /begin DEF_CHARACTERISTIC CW_NA KL_DMD_MAXL KL_DMD_MAXS KL_NA_BNANT KL_NA_ZW K_PBN_GRENZAKTIV K_PBN_LASTAB K_PBN_PLUS K_PBN_RED K_PRIOBN_INIT K_TMIN_VVT K_TOFF_VVT K_UBW_TNSTART K_V_VVT S_LASTAB_VL S_MDI_SOLL S_MDRESREAL /end DEF_CHARACTERISTIC
 /begin OUT_MEASUREMENT Dmd_gen Dmd_l_max Dmd_max Md_na Md_na_ges Md_na_sum Md_res_bn Md_res_real Na_bnanteil Na_priobn St_mdna St_mdna.B_lastab T_vvt /end OUT_MEASUREMENT
/end FUNCTION
/end MODULE
/end PROJECT
