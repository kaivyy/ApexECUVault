/begin PROJECT MSS65-inj "Generiert am 05.06.02 um 07:53:23"
/begin HEADER "" VERSION "R341" /end HEADER
/begin MODULE _MSS65-inj "Generiert am 05.06.02 um 07:53:23"
/begin COMPU_METHOD FORMULA_USER1 "FORMULA_USER1" RAT_FUNC "" "-" COEFFS 0 1 0 0 0 1 /end COMPU_METHOD
/* Formel fuer 1:1-Wiedergabe ohne Einheit */
/begin MEASUREMENT sys_sypcr "Watchdog-Register" ULONG FORMULA_USER1 0 0 0.0000 4294967295.0000 IF_DATA DIM 0x2FC004 INTERN LONG ECU_ADDRESS 0x2FC004 /begin FUNCTION_LIST sys_zust /end FUNCTION_LIST /end MEASUREMENT
/*----------------------------Kurbelwelle----------------------------------------------------------*/
/begin MEASUREMENT e1_konfig "TPUB_ParameterRam" UWORD FORMULA_USER1 0 0 0.0000 65535.0000 IF_DATA DIM 0x304520 INTERN LONG ECU_ADDRESS 0x304520 /begin FUNCTION_LIST tpu_ram /end FUNCTION_LIST /end MEASUREMENT
/begin MEASUREMENT tpu_e1_lt_nw_low "TPUB_ParameterRam" UWORD FORMULA_USER1 0 0 0.0000 65535.0000 IF_DATA DIM 0x304522 INTERN LONG ECU_ADDRESS 0x304522 /begin FUNCTION_LIST tpu_ram /end FUNCTION_LIST /end MEASUREMENT
/begin MEASUREMENT tpu_e1_lt_nw_high "TPUB_ParameterRam" UWORD FORMULA_USER1 0 0 0.0000 65535.0000 IF_DATA DIM 0x304524 INTERN LONG ECU_ADDRESS 0x304524 /begin FUNCTION_LIST tpu_ram /end FUNCTION_LIST /end MEASUREMENT
/begin MEASUREMENT tpu_e1_lt_kw_low "TPUB_ParameterRam" UWORD FORMULA_USER1 0 0 0.0000 65535.0000 IF_DATA DIM 0x304526 INTERN LONG ECU_ADDRESS 0x304526 /begin FUNCTION_LIST tpu_ram /end FUNCTION_LIST /end MEASUREMENT
/begin MEASUREMENT tpu_e1_lt_kw_high "TPUB_ParameterRam" UWORD FORMULA_USER1 0 0 0.0000 65535.0000 IF_DATA DIM 0x304528 INTERN LONG ECU_ADDRESS 0x304528 /begin FUNCTION_LIST tpu_ram /end FUNCTION_LIST /end MEASUREMENT
/begin MEASUREMENT tpu_e1_kw_per_high "TPUB_ParameterRam" UWORD FORMULA_USER1 0 0 0.0000 65535.0000 IF_DATA DIM 0x30452A INTERN LONG ECU_ADDRESS 0x30452A /begin FUNCTION_LIST tpu_ram /end FUNCTION_LIST /end MEASUREMENT
/begin MEASUREMENT tpu_e1_kw_per_low "TPUB_ParameterRam" UWORD FORMULA_USER1 0 0 0.0000 65535.0000 IF_DATA DIM 0x30452C INTERN LONG ECU_ADDRESS 0x30452C /begin FUNCTION_LIST tpu_ram /end FUNCTION_LIST /end MEASUREMENT
/begin MEASUREMENT tpu_e2_konfig "TPUB_ParameterRam" UWORD FORMULA_USER1 0 0 0.0000 65535.0000 IF_DATA DIM 0x304540 INTERN LONG ECU_ADDRESS 0x304540 /begin FUNCTION_LIST tpu_ram /end FUNCTION_LIST /end MEASUREMENT
/begin MEASUREMENT tpu_e2_lt_nw_low "TPUB_ParameterRam" UWORD FORMULA_USER1 0 0 0.0000 65535.0000 IF_DATA DIM 0x304542 INTERN LONG ECU_ADDRESS 0x304542 /begin FUNCTION_LIST tpu_ram /end FUNCTION_LIST /end MEASUREMENT
/begin MEASUREMENT tpu_e2_lt_nw_high "TPUB_ParameterRam" UWORD FORMULA_USER1 0 0 0.0000 65535.0000 IF_DATA DIM 0x304544 INTERN LONG ECU_ADDRESS 0x304544 /begin FUNCTION_LIST tpu_ram /end FUNCTION_LIST /end MEASUREMENT
/begin MEASUREMENT tpu_e2_lt_kw_low "TPUB_ParameterRam" UWORD FORMULA_USER1 0 0 0.0000 65535.0000 IF_DATA DIM 0x304546 INTERN LONG ECU_ADDRESS 0x304546 /begin FUNCTION_LIST tpu_ram /end FUNCTION_LIST /end MEASUREMENT
/begin MEASUREMENT tpu_e2_lt_kw_high "TPUB_ParameterRam" UWORD FORMULA_USER1 0 0 0.0000 65535.0000 IF_DATA DIM 0x304548 INTERN LONG ECU_ADDRESS 0x304548 /begin FUNCTION_LIST tpu_ram /end FUNCTION_LIST /end MEASUREMENT
/begin MEASUREMENT tpu_e2_kw_per_high "TPUB_ParameterRam" UWORD FORMULA_USER1 0 0 0.0000 65535.0000 IF_DATA DIM 0x30454A INTERN LONG ECU_ADDRESS 0x30454A /begin FUNCTION_LIST tpu_ram /end FUNCTION_LIST /end MEASUREMENT
/begin MEASUREMENT tpu_e2_kw_per_low "TPUB_ParameterRam" UWORD FORMULA_USER1 0 0 0.0000 65535.0000 IF_DATA DIM 0x30454C INTERN LONG ECU_ADDRESS 0x30454C /begin FUNCTION_LIST tpu_ram /end FUNCTION_LIST /end MEASUREMENT
/*----------------------------Kurbelwelle----------------------------------------------------------*/
/begin MEASUREMENT tpu_kw_zz_720 "TPUB_ParameterRam" UBYTE FORMULA_USER1 0 0 0.0000 200.0000 IF_DATA DIM 0x304101 INTERN LONG ECU_ADDRESS 0x304101 /begin FUNCTION_LIST tpu_ram /end FUNCTION_LIST /end MEASUREMENT
/begin MEASUREMENT tpu_kw_zz_360 "TPUB_ParameterRam" UBYTE FORMULA_USER1 0 0 0.0000 200.0000 IF_DATA DIM 0x304103 INTERN LONG ECU_ADDRESS 0x304103 /begin FUNCTION_LIST tpu_ram /end FUNCTION_LIST /end MEASUREMENT
/begin MOD_COMMON "" BYTE_ORDER MSB_FIRST /* Default byteorder (Motorola) */ /end MOD_COMMON
/begin COMPU_METHOD DEFAULT_FORMULA "DEFAULT_FORMULA" RAT_FUNC "%7.0" "" COEFFS 0 1 0 0 0 1 /end COMPU_METHOD
/* ------------------ Abschnitt erzeugt aus debug.dat ------------------ */
/begin COMPU_METHOD FORMULA_0000 "FORMULA_0000" RAT_FUNC "%5.0" "-" COEFFS 0 1 0 0 0 1 /end COMPU_METHOD
/begin COMPU_METHOD FORMULA_0001 "FORMULA_0001" RAT_FUNC "%7.0" "-" COEFFS 0 1 0 0 0 1 /end COMPU_METHOD
/* ------------------ Abschnitt erzeugt aus glob.dat ------------------ */
/begin COMPU_METHOD FORMULA_0004 "FORMULA_0004" RAT_FUNC "%8.3" "-" COEFFS 0 16384 0 0 0 1 /end COMPU_METHOD
/begin COMPU_METHOD FORMULA_0008 "FORMULA_0008" RAT_FUNC "%3.0" "-" COEFFS 0 1 0 0 0 1 /end COMPU_METHOD
/begin COMPU_METHOD FORMULA_0010 "FORMULA_0010" RAT_FUNC "%6.1" "kg/h" COEFFS 0 10 0 0 0 1 /end COMPU_METHOD
/begin COMPU_METHOD FORMULA_0011 "FORMULA_0011" RAT_FUNC "%5.0" "Upm" COEFFS 0 1 0 0 0 1 /end COMPU_METHOD
/begin COMPU_METHOD FORMULA_0012 "FORMULA_0012" RAT_FUNC "%5.0" "Upm/s" COEFFS 0 1 0 0 0 1 /end COMPU_METHOD
/begin COMPU_METHOD FORMULA_0017 "FORMULA_0017" TAB_VERB "%7.2" "-" COMPU_TAB_REF FORMULA_0017_VTAB /end COMPU_METHOD
/begin COMPU_VTAB FORMULA_0017_VTAB "FORMULA_0017_VTAB" TAB_VERB 15 0 "O.K." 1 "SH_TO_UB" 2 "SH_TO_GND" 4 "OPENLOAD" 8 "UNPLAUSIBEL" 32 "FILTER" 33 "FILTER/SH_TO_UB" 34 "FILTER/SH_TO_GND" 36 "FILTER/OPENLOAD" 40 "FILTER/UNPLAUSIBEL" 96 "FEHLER" 97 "FEHLER/SH_TO_UB" 98 "FEHLER/SH_TO_GND" 100 "FEHLER/OPENLOAD" 104 "FEHLER/UNPLAUSIBEL" /end COMPU_VTAB
/begin COMPU_METHOD FORMULA_0018 "FORMULA_0018" RAT_FUNC "%6.1" "Nm" COEFFS 0 10 0 0 0 1 /end COMPU_METHOD
/begin COMPU_METHOD FORMULA_0019 "FORMULA_0019" RAT_FUNC "%6.1" "øC" COEFFS 0 10 2732 0 0 1 /end COMPU_METHOD
/begin COMPU_METHOD FORMULA_0020 "FORMULA_0020" RAT_FUNC "%7.2" "%" COEFFS 0 16384 0 0 0 100 /end COMPU_METHOD
/begin COMPU_METHOD FORMULA_0022 "FORMULA_0022" RAT_FUNC "%6.1" "%" COEFFS 0 10 0 0 0 1 /end COMPU_METHOD
/begin COMPU_METHOD FORMULA_0024 "FORMULA_0024" RAT_FUNC "%7.2" "-" COEFFS 0 1 0 0 0 1 /end COMPU_METHOD
/begin COMPU_METHOD FORMULA_0031 "FORMULA_0031" RAT_FUNC "%6.1" "mbar" COEFFS 0 16 0 0 0 1 /end COMPU_METHOD
/begin COMPU_METHOD FORMULA_0035 "FORMULA_0035" RAT_FUNC "%8.3" "-" COEFFS 0 1024 0 0 0 1 /end COMPU_METHOD
/begin COMPU_METHOD FORMULA_0037 "FORMULA_0037" RAT_FUNC "%6.1" "ø" COEFFS 0 10 0 0 0 1 /end COMPU_METHOD
/begin COMPU_METHOD FORMULA_0045 "FORMULA_0045" RAT_FUNC "%6.1" "V" COEFFS 0 10 0 0 0 1 /end COMPU_METHOD
/* ------------------ Abschnitt erzeugt aus spi.dat ------------------ */
/begin COMPU_METHOD FORMULA_0069 "FORMULA_0069" TAB_VERB "%3.0" "-" COMPU_TAB_REF FORMULA_0069_VTAB /end COMPU_METHOD
/begin COMPU_VTAB FORMULA_0069_VTAB "FORMULA_0069_VTAB" TAB_VERB 2 0 "frei" 128 "Belegt" DEFAULT_VALUE "undefiniert" /end COMPU_VTAB
/begin COMPU_METHOD FORMULA_0070 "FORMULA_0070" TAB_VERB "%3.0" "-" COMPU_TAB_REF FORMULA_0070_VTAB /end COMPU_METHOD
/begin COMPU_VTAB FORMULA_0070_VTAB "FORMULA_0070_VTAB" TAB_VERB 4 0 "in Ordnung" 128 "queue full" 64 "queue fehler" 32 "IRQ illegal" DEFAULT_VALUE "undefiniert" /end COMPU_VTAB
/* ------------------ Abschnitt erzeugt aus sys_zust.dat ------------------ */
/begin COMPU_METHOD FORMULA_0081 "FORMULA_0081" TAB_VERB "%7.2" "-" COMPU_TAB_REF FORMULA_0081_VTAB /end COMPU_METHOD
/begin COMPU_VTAB FORMULA_0081_VTAB "FORMULA_0081_VTAB" TAB_VERB 0 /end COMPU_VTAB
/* ------------------ Abschnitt erzeugt aus version.dat ------------------ */
/begin COMPU_METHOD FORMULA_0082 "FORMULA_0082" TAB_VERB "%5.2" "-" COMPU_TAB_REF FORMULA_0082_VTAB /end COMPU_METHOD
/begin COMPU_VTAB FORMULA_0082_VTAB "FORMULA_0082_VTAB" TAB_VERB 2 1 "INJ" 2 "IGN" DEFAULT_VALUE "undefiniert" /end COMPU_VTAB
/begin COMPU_METHOD FORMULA_0083 "FORMULA_0083" TAB_VERB "%5.2" "-" COMPU_TAB_REF FORMULA_0083_VTAB /end COMPU_METHOD
/begin COMPU_VTAB FORMULA_0083_VTAB "FORMULA_0083_VTAB" TAB_VERB 23 0 "Labordaten" 1 "EE24" 2 "Ast" 3 "Prerauer" 4 "Gerum" 5 "Heiss" 6 "Lutz" 7 "Maier" 8 "Menn" 9 "Neumann" 10 "Wilke" 11 "Scherer" 12 "Scherrer" 13 "Fischer" 14 "May" 15 "ECE" 16 "US" 17 "Habermann" 18 "Moesbauer" 19 "Hartke" 20 "Renner" 21 "Stoll" 22 "Schaefer" DEFAULT_VALUE "unbekannt" /end COMPU_VTAB
/begin COMPU_METHOD FORMULA_0086 "FORMULA_0086" RAT_FUNC "%7.2" "mg" COEFFS 0 32 0 0 0 1 /end COMPU_METHOD
/begin COMPU_METHOD FORMULA_0087 "FORMULA_0087" RAT_FUNC "%9.4" "-" COEFFS 0 32768 0 0 0 1 /end COMPU_METHOD
/begin COMPU_METHOD FORMULA_0088 "FORMULA_0088" RAT_FUNC "%8.3" "mg/ASP" COEFFS 0 64 0 0 0 1 /end COMPU_METHOD
/* ------------------ Abschnitt erzeugt aus aq.dat ------------------ */
/begin COMPU_METHOD FORMULA_0091 "FORMULA_0091" RAT_FUNC "%5.0" "qmm" COEFFS 0 1 0 0 0 1 /end COMPU_METHOD
/* ------------------ Abschnitt erzeugt aus cantel.dat ------------------ */
/begin COMPU_METHOD FORMULA_0092 "FORMULA_0092" TAB_VERB "%3.0" "-" COMPU_TAB_REF FORMULA_0092_VTAB /end COMPU_METHOD
/begin COMPU_VTAB FORMULA_0092_VTAB "FORMULA_0092_VTAB" TAB_VERB 5 0 "i.O." 1 "Bus-Off" 2 "DPR" 4 "Timeout" 8 "Overflow" DEFAULT_VALUE "Mehrfach" /end COMPU_VTAB
/begin COMPU_METHOD FORMULA_0093 "FORMULA_0093" RAT_FUNC "%4.1" "s" COEFFS 0 10 0 0 0 1 /end COMPU_METHOD
/begin COMPU_METHOD FORMULA_0094 "FORMULA_0094" RAT_FUNC "%3.0" "Sufe" COEFFS 0 1 0 0 0 1 /end COMPU_METHOD
/begin COMPU_METHOD FORMULA_0095 "FORMULA_0095" RAT_FUNC "%7.2" "m/s2" COEFFS 0 40 0 0 0 1 /end COMPU_METHOD
/begin COMPU_METHOD FORMULA_0096 "FORMULA_0096" TAB_VERB "%5.2" "-" COMPU_TAB_REF FORMULA_0096_VTAB /end COMPU_METHOD
/begin COMPU_VTAB FORMULA_0096_VTAB "FORMULA_0096_VTAB" TAB_VERB 4 0 "steht" 1 "vorwaerts" 2 "rueckwaerts" 3 "faehrt" DEFAULT_VALUE "ungueltig" /end COMPU_VTAB
/begin COMPU_METHOD FORMULA_0097 "FORMULA_0097" TAB_VERB "%5.2" "-" COMPU_TAB_REF FORMULA_0097_VTAB /end COMPU_METHOD
/begin COMPU_VTAB FORMULA_0097_VTAB "FORMULA_0097_VTAB" TAB_VERB 3 0 "Inaktiv" 1 "Erhoehung" 2 "Reduktion" DEFAULT_VALUE "ungueltig" /end COMPU_VTAB
/begin COMPU_METHOD FORMULA_0098 "FORMULA_0098" TAB_VERB "%3.0" "-" COMPU_TAB_REF FORMULA_0098_VTAB /end COMPU_METHOD
/begin COMPU_VTAB FORMULA_0098_VTAB "FORMULA_0098_VTAB" TAB_VERB 2 0 "Disable" 1 "Enable" DEFAULT_VALUE "nicht definiert" /end COMPU_VTAB
/begin COMPU_METHOD FORMULA_0103 "FORMULA_0103" RAT_FUNC "%7.2" "s" COEFFS 0 100 0 0 0 1 /end COMPU_METHOD
/begin COMPU_METHOD FORMULA_0108 "FORMULA_0108" RAT_FUNC "%5.2" "s" COEFFS 0 0 25.6 0 1 0 /end COMPU_METHOD
/* ------------------ Abschnitt erzeugt aus hfm.dat ------------------ */
/begin COMPU_METHOD FORMULA_0112 "FORMULA_0112" RAT_FUNC "%5.0" "digit" COEFFS 0 1 0 0 0 1 /end COMPU_METHOD
/begin COMPU_METHOD FORMULA_0114 "FORMULA_0114" RAT_FUNC "%7.2" "s" COEFFS 0 0 25.6 0 1 0 /end COMPU_METHOD
/begin COMPU_METHOD FORMULA_0115 "FORMULA_0115" RAT_FUNC "%5.2" "s" COEFFS 0 0 2.56 0 1 0 /end COMPU_METHOD
/begin COMPU_METHOD FORMULA_0125 "FORMULA_0125" RAT_FUNC "%7.2" "mg" COEFFS 0 64 0 0 0 1 /end COMPU_METHOD
/begin COMPU_METHOD FORMULA_0127 "FORMULA_0127" RAT_FUNC "%7.2" "-" COEFFS 0 256 0 0 0 1 /end COMPU_METHOD
/begin COMPU_METHOD FORMULA_0143 "FORMULA_0143" RAT_FUNC "%8.3" "-" COEFFS 0 8192 0 0 0 1 /end COMPU_METHOD
/begin COMPU_METHOD FORMULA_0156 "FORMULA_0156" RAT_FUNC "%5.0" "s" COEFFS 0 1 0 0 0 1 /end COMPU_METHOD
/begin COMPU_METHOD FORMULA_0180 "FORMULA_0180" RAT_FUNC "%5.0" "mbar" COEFFS 0 16 0 0 0 1 /end COMPU_METHOD
/* ------------------ Abschnitt erzeugt aus pumg.dat ------------------ */
/begin COMPU_METHOD FORMULA_0181 "FORMULA_0181" RAT_FUNC "%8.3" "mbar/V" COEFFS 0 80 0 0 0 1 /end COMPU_METHOD
/begin COMPU_METHOD FORMULA_0182 "FORMULA_0182" RAT_FUNC "%8.3" "mbar" COEFFS 0 16 0 0 0 1 /end COMPU_METHOD
/begin COMPU_METHOD FORMULA_0188 "FORMULA_0188" RAT_FUNC "%6.1" "øKW" COEFFS 0 10 0 0 0 1 /end COMPU_METHOD
/* ------------------ Abschnitt erzeugt aus rps.dat ------------------ */
/begin COMPU_METHOD FORMULA_0195 "FORMULA_0195" TAB_VERB "%7.2" "-" COMPU_TAB_REF FORMULA_0195_VTAB /end COMPU_METHOD
/begin COMPU_VTAB FORMULA_0195_VTAB "FORMULA_0195_VTAB" TAB_VERB 3 1 "Regler-RESET" 2 "Regler aktiv" 4 "Regler inaktiv" /end COMPU_VTAB
/begin COMPU_METHOD FORMULA_0196 "FORMULA_0196" TAB_VERB "%7.2" "-" COMPU_TAB_REF FORMULA_0196_VTAB /end COMPU_METHOD
/begin COMPU_VTAB FORMULA_0196_VTAB "FORMULA_0196_VTAB" TAB_VERB 5 1 "LAA-RESET" 2 "LAA-AUS" 4 "LAA-F" 8 "LAA-TE-F" 16 "LAA-OFFS" /end COMPU_VTAB
/begin COMPU_METHOD FORMULA_0197 "FORMULA_0197" TAB_VERB "%5.2" "-" COMPU_TAB_REF FORMULA_0197_VTAB /end COMPU_METHOD
/begin COMPU_VTAB FORMULA_0197_VTAB "FORMULA_0197_VTAB" TAB_VERB 2 0 "kein Fehler" 1 "PKS-Fehler" /end COMPU_VTAB
/begin COMPU_METHOD FORMULA_0198 "FORMULA_0198" TAB_VERB "%5.2" "-" COMPU_TAB_REF FORMULA_0198_VTAB /end COMPU_METHOD
/begin COMPU_VTAB FORMULA_0198_VTAB "FORMULA_0198_VTAB" TAB_VERB 13 1 "Wandfilm" 2 "Lambdaregler" 3 "Lambdaadaption" 4 "Restgas" 5 "Abgasgegendruck" 6 "Ansauglufttemp" 7 "Fahrerwunsch" 8 "Leerlaufregler" 9 "Ionenstrom" 10 "Aussetzer" 11 "Vanoskatheizen" 12 "Motortemperatur" 13 "Kraftstoffdruck" DEFAULT_VALUE "Inaktiv" /end COMPU_VTAB
/* ------------------ Abschnitt erzeugt aus sa_we.dat ------------------ */
/begin COMPU_METHOD FORMULA_0199 "FORMULA_0199" RAT_FUNC "%7.2" "s" COEFFS 0 200 0 0 0 1 /end COMPU_METHOD
/* ------------------ Abschnitt erzeugt aus tm_inj.dat ------------------ */
/begin COMPU_METHOD FORMULA_0219 "FORMULA_0219" RAT_FUNC "%9.2" "ms" COEFFS 0 1000 0 0 0 1 /end COMPU_METHOD
/* ------------------ Abschnitt erzeugt aus tpu_inj.dat ------------------ */
/begin COMPU_METHOD FORMULA_0220 "FORMULA_0220" TAB_VERB "%3.0" "-" COMPU_TAB_REF FORMULA_0220_VTAB /end COMPU_METHOD
/begin COMPU_VTAB FORMULA_0220_VTAB "FORMULA_0220_VTAB" TAB_VERB 5 0 "sync - 720° Mode" 1 "sync - 360° Mode" 129 "suche Luecke" 161 "Zahnentprellung laeuft" 225 "nicht sync." /end COMPU_VTAB
/begin COMPU_METHOD FORMULA_0221 "FORMULA_0221" TAB_VERB "%3.0" "-" COMPU_TAB_REF FORMULA_0221_VTAB /end COMPU_METHOD
/begin COMPU_VTAB FORMULA_0221_VTAB "FORMULA_0221_VTAB" TAB_VERB 6 2 "krititischer Fehler" 4 "unkritischer Fehler" 8 "Unterdrehzahl" 16 "Zahninterrupt" 32 "Segmentinterrupt" 64 "Sync-Interrupt" /end COMPU_VTAB
/begin COMPU_METHOD FORMULA_0222 "FORMULA_0222" TAB_VERB "%3.0" "-" COMPU_TAB_REF FORMULA_0222_VTAB /end COMPU_METHOD
/begin COMPU_VTAB FORMULA_0222_VTAB "FORMULA_0222_VTAB" TAB_VERB 4 1 "warte Sync." 2 "Sync. laeuft" 4 "synchronisiert" 8 "nicht sync." DEFAULT_VALUE "gibts nicht" /end COMPU_VTAB
/begin COMPU_METHOD FORMULA_0223 "FORMULA_0223" TAB_VERB "%3.0" "-" COMPU_TAB_REF FORMULA_0223_VTAB /end COMPU_METHOD
/begin COMPU_VTAB FORMULA_0223_VTAB "FORMULA_0223_VTAB" TAB_VERB 2 0 "Schnellsync." 1 "sichere Sync." /end COMPU_VTAB
/* ------------------ Abschnitt erzeugt aus vanos.dat ------------------ */
/begin COMPU_METHOD FORMULA_0224 "FORMULA_0224" RAT_FUNC "%7.2" "%/øKW/s" COEFFS 0 671.08864 0 0 0 1 /end COMPU_METHOD
/begin COMPU_METHOD FORMULA_0225 "FORMULA_0225" RAT_FUNC "%7.2" "%/øKW" COEFFS 0 262.144 0 0 0 1 /end COMPU_METHOD
/begin COMPU_METHOD FORMULA_0226 "FORMULA_0226" RAT_FUNC "%9.4" "-" COEFFS 0 16384 0 0 0 1 /end COMPU_METHOD
/begin COMPU_METHOD FORMULA_0227 "FORMULA_0227" RAT_FUNC "%6.1" "øKW/10ms" COEFFS 0 10 0 0 0 1 /end COMPU_METHOD
/begin COMPU_METHOD FORMULA_0228 "FORMULA_0228" TAB_VERB "%5.2" "-" COMPU_TAB_REF FORMULA_0228_VTAB /end COMPU_METHOD
/begin COMPU_VTAB FORMULA_0228_VTAB "FORMULA_0228_VTAB" TAB_VERB 2 0 "o.k" 1 "unplausibel" DEFAULT_VALUE "undef." /end COMPU_VTAB
/begin COMPU_METHOD FORMULA_0229 "FORMULA_0229" TAB_VERB "%5.2" "-" COMPU_TAB_REF FORMULA_0229_VTAB /end COMPU_METHOD
/begin COMPU_VTAB FORMULA_0229_VTAB "FORMULA_0229_VTAB" TAB_VERB 3 0 "verriegelt" 1 "dyn begrenzt" 2 "frei" DEFAULT_VALUE "undef." /end COMPU_VTAB
/begin COMPU_METHOD FORMULA_0230 "FORMULA_0230" RAT_FUNC "%6.1" "s" COEFFS 0 100 0 0 0 1 /end COMPU_METHOD
/begin COMPU_METHOD FORMULA_0231 "FORMULA_0231" RAT_FUNC "%6.1" "%" COEFFS 0 10.24 0 0 0 1 /end COMPU_METHOD
/begin COMPU_METHOD FORMULA_0232 "FORMULA_0232" RAT_FUNC "%10.3" "%" COEFFS 0 655360 0 0 0 1 /end COMPU_METHOD
/begin COMPU_METHOD FORMULA_0233 "FORMULA_0233" RAT_FUNC "%5.2" "s" COEFFS 0 0 164 0 1 0 /end COMPU_METHOD
/begin COMPU_METHOD FORMULA_0234 "FORMULA_0234" TAB_VERB "%5.2" "-" COMPU_TAB_REF FORMULA_0234_VTAB /end COMPU_METHOD
/begin COMPU_VTAB FORMULA_0234_VTAB "FORMULA_0234_VTAB" TAB_VERB 2 0 "Flueg" 1 "Hochdr" DEFAULT_VALUE "undef." /end COMPU_VTAB
/begin COMPU_METHOD FORMULA_0235 "FORMULA_0235" RAT_FUNC "%7.2" "s" COEFFS 0 0 164 0 1 0 /end COMPU_METHOD
/begin COMPU_METHOD FORMULA_0236 "FORMULA_0236" RAT_FUNC "%6.1" "Hz" COEFFS 0 0 1000000 0 1 0 /end COMPU_METHOD
/begin COMPU_METHOD FORMULA_0237 "FORMULA_0237" TAB_VERB "%5.2" "-" COMPU_TAB_REF FORMULA_0237_VTAB /end COMPU_METHOD
/begin COMPU_VTAB FORMULA_0237_VTAB "FORMULA_0237_VTAB" TAB_VERB 2 0 "normal" 1 "invers" DEFAULT_VALUE "undef." /end COMPU_VTAB
/begin COMPU_METHOD FORMULA_0238 "FORMULA_0238" RAT_FUNC "%3.0" "KW_Zahn" COEFFS 0 1 0 0 0 1 /end COMPU_METHOD
/begin COMPU_METHOD FORMULA_0239 "FORMULA_0239" TAB_VERB "%3.0" "-" COMPU_TAB_REF FORMULA_0239_VTAB /end COMPU_METHOD
/begin COMPU_VTAB FORMULA_0239_VTAB "FORMULA_0239_VTAB" TAB_VERB 2 0 "7Zahn(S54)" 1 "6Zahn" /end COMPU_VTAB
/begin COMPU_METHOD FORMULA_0240 "FORMULA_0240" RAT_FUNC "%6.1" "%/Zahn" COEFFS 0 10.24 0 0 0 1 /end COMPU_METHOD
/begin COMPU_METHOD FORMULA_0241 "FORMULA_0241" RAT_FUNC "%5.0" "s" COEFFS 0 100 0 0 0 1 /end COMPU_METHOD
/* ------------------ Abschnitt erzeugt aus wf.dat ------------------ */
/begin COMPU_METHOD FORMULA_0242 "FORMULA_0242" RAT_FUNC "%5.0" "Segm" COEFFS 0 1 0 0 0 1 /end COMPU_METHOD
/begin COMPU_METHOD FORMULA_0243 "FORMULA_0243" RAT_FUNC "%5.0" "ASP" COEFFS 0 1 0 0 0 1 /end COMPU_METHOD
/* ------------------ Abschnitt erzeugt aus zust_inj.dat ------------------ */
/begin COMPU_METHOD FORMULA_0244 "FORMULA_0244" RAT_FUNC "%9.2" "s" COEFFS 0 100 0 0 0 1 /end COMPU_METHOD
/begin COMPU_METHOD FORMULA_0245 "FORMULA_0245" RAT_FUNC "%7.2" "ms" COEFFS 0 1 0 0 0 1 /end COMPU_METHOD
/* ------------------ Abschnitt erzeugt aus debug.dat ------------------ */
/begin MEASUREMENT hwTaskCtr "Counter" UWORD FORMULA_0000 0 0 0.0 65535.0000 ECU_ADDRESS 0x3FB61C /begin FUNCTION_LIST debug /end FUNCTION_LIST /end MEASUREMENT
/begin MEASUREMENT syncTaskCtr "Counter" UWORD FORMULA_0000 0 0 0.0 65535.0000 ECU_ADDRESS 0x3FB61E /begin FUNCTION_LIST debug /end FUNCTION_LIST /end MEASUREMENT
/begin MEASUREMENT r1msTaskCtr "Counter" UWORD FORMULA_0000 0 0 0.0 65535.0000 ECU_ADDRESS 0x3FB620 /begin FUNCTION_LIST debug /end FUNCTION_LIST /end MEASUREMENT
/begin MEASUREMENT r5msTaskCtr "Counter" UWORD FORMULA_0000 0 0 0.0 65535.0000 ECU_ADDRESS 0x3FB622 /begin FUNCTION_LIST debug /end FUNCTION_LIST /end MEASUREMENT
/begin MEASUREMENT r10msTaskCtr "Counter" ULONG FORMULA_0001 0 0 0.0 2147483647.0000 ECU_ADDRESS 0x3FB624 /begin FUNCTION_LIST debug /end FUNCTION_LIST /end MEASUREMENT
/begin MEASUREMENT r100msTaskCtr "Counter" UWORD FORMULA_0000 0 0 0.0 65535.0000 ECU_ADDRESS 0x3FB628 /begin FUNCTION_LIST debug /end FUNCTION_LIST /end MEASUREMENT
/begin MEASUREMENT r1sTaskCtr "Counter" UWORD FORMULA_0000 0 0 0.0 65535.0000 ECU_ADDRESS 0x3FB62A /begin FUNCTION_LIST debug /end FUNCTION_LIST /end MEASUREMENT
/begin MEASUREMENT bgTaskCtr "Counter" UWORD FORMULA_0000 0 0 0.0 65535.0000 ECU_ADDRESS 0x3FB62C /begin FUNCTION_LIST debug /end FUNCTION_LIST /end MEASUREMENT
/* ------------------ Abschnitt erzeugt aus os.dat ------------------ */
/begin MEASUREMENT os_err.id.cnt "OS-Err: ID" UWORD FORMULA_0000 0 0 0.0 65535.0000 ECU_ADDRESS 0x3FBA9C /begin FUNCTION_LIST os /end FUNCTION_LIST /end MEASUREMENT
/begin MEASUREMENT os_err.id.task "OS-Err: ID" UWORD FORMULA_0000 0 0 0.0 65535.0000 ECU_ADDRESS 0x3FBA9E /begin FUNCTION_LIST os /end FUNCTION_LIST /end MEASUREMENT
/begin MEASUREMENT os_err.limit.cnt "OS-Err: Limit" UWORD FORMULA_0000 0 0 0.0 65535.0000 ECU_ADDRESS 0x3FBAA0 /begin FUNCTION_LIST os /end FUNCTION_LIST /end MEASUREMENT
/begin MEASUREMENT os_err.limit.task "OS-Err: Limit" UWORD FORMULA_0000 0 0 0.0 65535.0000 ECU_ADDRESS 0x3FBAA2 /begin FUNCTION_LIST os /end FUNCTION_LIST /end MEASUREMENT
/begin MEASUREMENT os_err.tt_act.cnt "OS-Err: TT aktiv" UWORD FORMULA_0000 0 0 0.0 65535.0000 ECU_ADDRESS 0x3FBAA4 /begin FUNCTION_LIST os /end FUNCTION_LIST /end MEASUREMENT
/begin MEASUREMENT os_err.tt_act.task "OS-Err: TT aktiv" UWORD FORMULA_0000 0 0 0.0 65535.0000 ECU_ADDRESS 0x3FBAA6 /begin FUNCTION_LIST os /end FUNCTION_LIST /end MEASUREMENT
/begin MEASUREMENT os_err.no_fnc.cnt "OS-Err: No Fkt" UWORD FORMULA_0000 0 0 0.0 65535.0000 ECU_ADDRESS 0x3FBAA8 /begin FUNCTION_LIST os /end FUNCTION_LIST /end MEASUREMENT
/begin MEASUREMENT os_err.no_fnc.task "OS-Err: No Fkt" UWORD FORMULA_0000 0 0 0.0 65535.0000 ECU_ADDRESS 0x3FBAAA /begin FUNCTION_LIST os /end FUNCTION_LIST /end MEASUREMENT
/begin MEASUREMENT os_err.tt_miss.cnt "OS-Err: TT missing" UWORD FORMULA_0000 0 0 0.0 65535.0000 ECU_ADDRESS 0x3FBAAC /begin FUNCTION_LIST os /end FUNCTION_LIST /end MEASUREMENT
/begin MEASUREMENT os_err.tt_miss.task "OS-Err: TT missing" UWORD FORMULA_0000 0 0 0.0 65535.0000 ECU_ADDRESS 0x3FBAAE /begin FUNCTION_LIST os /end FUNCTION_LIST /end MEASUREMENT
/begin MEASUREMENT os_err.stack.cnt "OS-Err: Stack" UWORD FORMULA_0000 0 0 0.0 65535.0000 ECU_ADDRESS 0x3FBAB0 /begin FUNCTION_LIST os /end FUNCTION_LIST /end MEASUREMENT
/begin MEASUREMENT os_err.stack.task "OS-Err: Stack" UWORD FORMULA_0000 0 0 0.0 65535.0000 ECU_ADDRESS 0x3FBAB2 /begin FUNCTION_LIST os /end FUNCTION_LIST /end MEASUREMENT
/begin MEASUREMENT os_err.fifo.cnt "OS-Err: FIFO full" UWORD FORMULA_0000 0 0 0.0 65535.0000 ECU_ADDRESS 0x3FBAB4 /begin FUNCTION_LIST os /end FUNCTION_LIST /end MEASUREMENT
/begin MEASUREMENT os_err.fifo.task "OS-Err: FIFO full" UWORD FORMULA_0000 0 0 0.0 65535.0000 ECU_ADDRESS 0x3FBAB6 /begin FUNCTION_LIST os /end FUNCTION_LIST /end MEASUREMENT
/begin MEASUREMENT os_err.value.cnt "OS-Err: Value" UWORD FORMULA_0000 0 0 0.0 65535.0000 ECU_ADDRESS 0x3FBAB8 /begin FUNCTION_LIST os /end FUNCTION_LIST /end MEASUREMENT
/begin MEASUREMENT os_err.value.task "OS-Err: Value" UWORD FORMULA_0000 0 0 0.0 65535.0000 ECU_ADDRESS 0x3FBABA /begin FUNCTION_LIST os /end FUNCTION_LIST /end MEASUREMENT
/begin MEASUREMENT os_err.deadline.cnt "OS-Err: Deadline" UWORD FORMULA_0000 0 0 0.0 65535.0000 ECU_ADDRESS 0x3FBABC /begin FUNCTION_LIST os /end FUNCTION_LIST /end MEASUREMENT
/begin MEASUREMENT os_err.deadline.task "OS-Err: Deadline" UWORD FORMULA_0000 0 0 0.0 65535.0000 ECU_ADDRESS 0x3FBABE /begin FUNCTION_LIST os /end FUNCTION_LIST /end MEASUREMENT
/begin MEASUREMENT os_err.dflt.cnt "OS-Err: Default" UWORD FORMULA_0000 0 0 0.0 65535.0000 ECU_ADDRESS 0x3FBAC0 /begin FUNCTION_LIST os /end FUNCTION_LIST /end MEASUREMENT
/begin MEASUREMENT os_err.dflt.task "OS-Err: Default" UWORD FORMULA_0000 0 0 0.0 65535.0000 ECU_ADDRESS 0x3FBAC2 /begin FUNCTION_LIST os /end FUNCTION_LIST /end MEASUREMENT
/begin MEASUREMENT os_err.sum_cnt "OS-Err: Summe" UWORD FORMULA_0000 0 0 0.0 65535.0000 ECU_ADDRESS 0x3FBAC4 /begin FUNCTION_LIST os /end FUNCTION_LIST /end MEASUREMENT
/* ------------------ Abschnitt erzeugt aus spi.dat ------------------ */
/begin MEASUREMENT spim_errorcounter "Fehlerzaehler der Spi" UBYTE FORMULA_0008 0 0 0.0 255.0000 ECU_ADDRESS 0x3FBD02 /begin FUNCTION_LIST spi /end FUNCTION_LIST /end MEASUREMENT
/begin MEASUREMENT spim_reqcounter "Anzahl der Auftraege in der Queue" UBYTE FORMULA_0008 0 0 0.0 255.0000 ECU_ADDRESS 0x3FBD03 /begin FUNCTION_LIST spi /end FUNCTION_LIST /end MEASUREMENT
/begin MEASUREMENT spim_status "Statusvariable der SPI" UBYTE FORMULA_0069 0 0 0.0 255.0 ECU_ADDRESS 0x3FBD04 /begin FUNCTION_LIST spi /end FUNCTION_LIST /end MEASUREMENT
/begin MEASUREMENT spim_errorcode "Statusvariable der SPI" UBYTE FORMULA_0070 0 0 0.0 255.0 ECU_ADDRESS 0x3FBD05 /begin FUNCTION_LIST spi /end FUNCTION_LIST /end MEASUREMENT
/* ------------------ Abschnitt erzeugt aus sys_zust.dat ------------------ */
/begin MEASUREMENT sys_zust "Betriebszustand des Systems" UWORD FORMULA_0081 0 0 0.0 65535.0 ECU_ADDRESS 0x3FBD0C /begin FUNCTION_LIST sys_zust /end FUNCTION_LIST /end MEASUREMENT
/begin MEASUREMENT sys_rsr "Reset Status Register" UWORD FORMULA_0000 0 0 0.0 65535.0000 ECU_ADDRESS 0x3FC0CC /begin FUNCTION_LIST sys_zust /end FUNCTION_LIST /end MEASUREMENT
/begin MEASUREMENT sys_rsr_cnt.ehrs "ExtHardReset" UBYTE FORMULA_0008 0 0 0.0 255.0000 ECU_ADDRESS 0x3FC0D0 /begin FUNCTION_LIST sys_zust /end FUNCTION_LIST /end MEASUREMENT
/begin MEASUREMENT sys_rsr_cnt.esrs "ExtSoftReset" UBYTE FORMULA_0008 0 0 0.0 255.0000 ECU_ADDRESS 0x3FC0D1 /begin FUNCTION_LIST sys_zust /end FUNCTION_LIST /end MEASUREMENT
/begin MEASUREMENT sys_rsr_cnt.llrs "LossOfClockReset" UBYTE FORMULA_0008 0 0 0.0 255.0000 ECU_ADDRESS 0x3FC0D2 /begin FUNCTION_LIST sys_zust /end FUNCTION_LIST /end MEASUREMENT
/begin MEASUREMENT sys_rsr_cnt.swrs "WatchdogReset" UBYTE FORMULA_0008 0 0 0.0 255.0000 ECU_ADDRESS 0x3FC0D3 /begin FUNCTION_LIST sys_zust /end FUNCTION_LIST /end MEASUREMENT
/begin MEASUREMENT sys_rsr_cnt.csrs "ChkstopReset" UBYTE FORMULA_0008 0 0 0.0 255.0000 ECU_ADDRESS 0x3FC0D4 /begin FUNCTION_LIST sys_zust /end FUNCTION_LIST /end MEASUREMENT
/begin MEASUREMENT sys_rsr_cnt.dbhrs "DebugHardReset" UBYTE FORMULA_0008 0 0 0.0 255.0000 ECU_ADDRESS 0x3FC0D5 /begin FUNCTION_LIST sys_zust /end FUNCTION_LIST /end MEASUREMENT
/begin MEASUREMENT sys_rsr_cnt.dbsrs "DebugSoftReset" UBYTE FORMULA_0008 0 0 0.0 255.0000 ECU_ADDRESS 0x3FC0D6 /begin FUNCTION_LIST sys_zust /end FUNCTION_LIST /end MEASUREMENT
/begin MEASUREMENT sys_rsr_cnt.jtrs "JTAGReset" UBYTE FORMULA_0008 0 0 0.0 255.0000 ECU_ADDRESS 0x3FC0D7 /begin FUNCTION_LIST sys_zust /end FUNCTION_LIST /end MEASUREMENT
/begin MEASUREMENT sys_rsr_cnt.ocrs "OnChipReset" UBYTE FORMULA_0008 0 0 0.0 255.0000 ECU_ADDRESS 0x3FC0D8 /begin FUNCTION_LIST sys_zust /end FUNCTION_LIST /end MEASUREMENT
/begin MEASUREMENT sys_rsr_cnt.ilbc "IllegalBitChangeReset" UBYTE FORMULA_0008 0 0 0.0 255.0000 ECU_ADDRESS 0x3FC0D9 /begin FUNCTION_LIST sys_zust /end FUNCTION_LIST /end MEASUREMENT
/begin MEASUREMENT sys_rsr_cnt.gpor "GlitchPowerOnReset" UBYTE FORMULA_0008 0 0 0.0 255.0000 ECU_ADDRESS 0x3FC0DA /begin FUNCTION_LIST sys_zust /end FUNCTION_LIST /end MEASUREMENT
/begin MEASUREMENT sys_rsr_cnt.ghrst "GlitchHPinReset" UBYTE FORMULA_0008 0 0 0.0 255.0000 ECU_ADDRESS 0x3FC0DB /begin FUNCTION_LIST sys_zust /end FUNCTION_LIST /end MEASUREMENT
/begin MEASUREMENT sys_rsr_cnt.gsrst "GlitchSPinReset" UBYTE FORMULA_0008 0 0 0.0 255.0000 ECU_ADDRESS 0x3FC0DC /begin FUNCTION_LIST sys_zust /end FUNCTION_LIST /end MEASUREMENT
/* ------------------ Abschnitt erzeugt aus version.dat ------------------ */
/begin CHARACTERISTIC K_VERS_PROG "Programmversion" VALUE 0x60000 TKW_VV_VV_UW 100.0 FORMULA_0000 0.0 65535.0000 /begin FUNCTION_LIST Version /end FUNCTION_LIST /end CHARACTERISTIC
/begin CHARACTERISTIC K_VERS_PROZ "Prozessorkennung" VALUE 0x60002 TKW_VV_VV_UB 100.0 FORMULA_0082 0.0 255.0 /begin FUNCTION_LIST Version /end FUNCTION_LIST /end CHARACTERISTIC
/begin CHARACTERISTIC K_VERS_NAME "Applikateur" VALUE 0x60003 TKW_VV_VV_UB 100.0 FORMULA_0083 0.0 255.0 /begin FUNCTION_LIST Version /end FUNCTION_LIST /end CHARACTERISTIC
/begin CHARACTERISTIC K_VERS_DATEN "Datenversion" VALUE 0x60004 TKW_VV_VV_UW 100.0 FORMULA_0000 0.0 65535.0000 /begin FUNCTION_LIST Version /end FUNCTION_LIST /end CHARACTERISTIC
/begin MEASUREMENT vers_prog "Programmversion" UWORD FORMULA_0000 0 0 0.0 65535.0000 ECU_ADDRESS 0x3FBFEE /begin FUNCTION_LIST Version /end FUNCTION_LIST /end MEASUREMENT
/begin MEASUREMENT vers_index "Programmindex" UBYTE FORMULA_0008 0 0 0.0 255.0000 ECU_ADDRESS 0x3FBFF0 /begin FUNCTION_LIST Version /end FUNCTION_LIST /end MEASUREMENT
/* ------------------ Abschnitt erzeugt aus aq.dat ------------------ */
/begin CHARACTERISTIC K_AQ_ABS_MIN "min. Oeffnungsquerschnitt" VALUE 0x60258 TKW_VV_VV_UW 100.0 FORMULA_0091 0.0 20000.0000 /begin FUNCTION_LIST aq /end FUNCTION_LIST /end CHARACTERISTIC
/begin CHARACTERISTIC K_AQ_ABS_MAX "min. Oeffnungsquerschnitt" VALUE 0x6025A TKW_VV_VV_UW 100.0 FORMULA_0091 0.0 20000.0000 /begin FUNCTION_LIST aq /end FUNCTION_LIST /end CHARACTERISTIC
/begin CHARACTERISTIC KL_AQ_ABS_LLS "Oeffnungquerschnitt LLS (Bank)" CURVE 0x6025C TKL_SW_VV_UW 100.0 FORMULA_0091 0.0 20000.0000 /begin FUNCTION_LIST aq /end FUNCTION_LIST
 /begin AXIS_DESCR STD_AXIS wdk FORMULA_0022 8 -10.0000 120.0000 FORMAT "%4.1" /end AXIS_DESCR
/end CHARACTERISTIC
/begin CHARACTERISTIC KL_AQ_ABS_DK "Oeffnungsquerschnitt DK (Bank)" CURVE 0x6027E TKL_SW_VV_UW 100.0 FORMULA_0091 0.0 20000.0000 /begin FUNCTION_LIST aq /end FUNCTION_LIST
 /begin AXIS_DESCR STD_AXIS wdk FORMULA_0022 8 -10.0000 120.0000 FORMAT "%4.1" /end AXIS_DESCR
/end CHARACTERISTIC
/begin CHARACTERISTIC KL_AQ_REL_MAX_ENTDR "rel. Oeffnung entdr. (Bank)" CURVE 0x602A0 TKL_SW_VV_UW 100.0 FORMULA_0020 0.0 200.0000 /begin FUNCTION_LIST aq /end FUNCTION_LIST /begin AXIS_DESCR STD_AXIS n FORMULA_0011 8 0.0 10000.0000 /end AXIS_DESCR FORMAT "%5.2" /end CHARACTERISTIC
/begin MEASUREMENT aq_abs_1of2_ "Abs. Oeffnungsquerschnitt" UWORD FORMULA_0091 0 0 0.0 20000.0000 ECU_ADDRESS 0x3FB5D4 /begin FUNCTION_LIST aq /end FUNCTION_LIST /end MEASUREMENT
/begin MEASUREMENT aq_abs_2of2_ "Abs. Oeffnungsquerschnitt" UWORD FORMULA_0091 0 0 0.0 20000.0000 ECU_ADDRESS 0x3FB5D6 /begin FUNCTION_LIST aq /end FUNCTION_LIST /end MEASUREMENT
/begin MEASUREMENT aq_abs_dk_1of2_ "Abs. Oeffnungsquerschnitt Drosselklappen" UWORD FORMULA_0091 0 0 0.0 20000.0000 ECU_ADDRESS 0x3FB5D8 /begin FUNCTION_LIST aq /end FUNCTION_LIST /end MEASUREMENT
/begin MEASUREMENT aq_abs_dk_2of2_ "Abs. Oeffnungsquerschnitt Drosselklappen" UWORD FORMULA_0091 0 0 0.0 20000.0000 ECU_ADDRESS 0x3FB5DA /begin FUNCTION_LIST aq /end FUNCTION_LIST /end MEASUREMENT
/begin MEASUREMENT aq_abs_lls_1of2_ "Abs. Oeffnungsquerschnitt Leerlaufsystem" UWORD FORMULA_0091 0 0 0.0 20000.0000 ECU_ADDRESS 0x3FB5DC /begin FUNCTION_LIST aq /end FUNCTION_LIST /end MEASUREMENT
/begin MEASUREMENT aq_abs_lls_2of2_ "Abs. Oeffnungsquerschnitt Leerlaufsystem" UWORD FORMULA_0091 0 0 0.0 20000.0000 ECU_ADDRESS 0x3FB5DE /begin FUNCTION_LIST aq /end FUNCTION_LIST /end MEASUREMENT
/begin MEASUREMENT aq_rel_1of2_ "relativer Oeffnungsquerschnitt" UWORD FORMULA_0020 0 0 0.0 200.0000 ECU_ADDRESS 0x3FB5E0 /begin FUNCTION_LIST aq /end FUNCTION_LIST /end MEASUREMENT
/begin MEASUREMENT aq_rel_2of2_ "relativer Oeffnungsquerschnitt" UWORD FORMULA_0020 0 0 0.0 200.0000 ECU_ADDRESS 0x3FB5E2 /begin FUNCTION_LIST aq /end FUNCTION_LIST /end MEASUREMENT
/begin MEASUREMENT aq_rel_max_entdr "rel. Oeffnung ohne Drosselung" UWORD FORMULA_0020 0 0 0.0 200.0000 ECU_ADDRESS 0x3FB5E4 /begin FUNCTION_LIST aq /end FUNCTION_LIST /end MEASUREMENT
/begin MEASUREMENT dr_rel_roh_1of2_ "rel. Drosselung ohne korr" SWORD FORMULA_0020 0 0 0.0 199.9938 ECU_ADDRESS 0x3FB5E6 /begin FUNCTION_LIST aq /end FUNCTION_LIST /end MEASUREMENT
/begin MEASUREMENT dr_rel_roh_2of2_ "rel. Drosselung ohne korr" SWORD FORMULA_0020 0 0 0.0 199.9938 ECU_ADDRESS 0x3FB5E8 /begin FUNCTION_LIST aq /end FUNCTION_LIST /end MEASUREMENT
/* ------------------ Abschnitt erzeugt aus cantel.dat ------------------ */
/begin MEASUREMENT can_st_empf "Empfangsstatus pro SG-Zyklus" UWORD FORMULA_0000 0 0 0.0 65535.0000 ECU_ADDRESS 0x3FB5F0 /begin FUNCTION_LIST cantel /end FUNCTION_LIST /end MEASUREMENT
/begin MEASUREMENT can_st_torqdsc "Empfangsstatus TorqDSC" UBYTE FORMULA_0092 0 0 0.0 255.0 ECU_ADDRESS 0x3FB5F2 /begin FUNCTION_LIST cantel /end FUNCTION_LIST BIT_MASK 0xF /end MEASUREMENT
/begin MEASUREMENT can_st_dsc "Empfangsstatus DSC" UBYTE FORMULA_0092 0 0 0.0 255.0 ECU_ADDRESS 0x3FB5F3 /begin FUNCTION_LIST cantel /end FUNCTION_LIST BIT_MASK 0xF /end MEASUREMENT
/begin MEASUREMENT can_st_vrad "Empfangsstatus vRad" UBYTE FORMULA_0092 0 0 0.0 255.0 ECU_ADDRESS 0x3FB5F4 /begin FUNCTION_LIST cantel /end FUNCTION_LIST BIT_MASK 0xF /end MEASUREMENT
/begin MEASUREMENT can_st_vfzg "Empfangsstatus vFzg" UBYTE FORMULA_0092 0 0 0.0 255.0 ECU_ADDRESS 0x3FB5F5 /begin FUNCTION_LIST cantel /end FUNCTION_LIST BIT_MASK 0xF /end MEASUREMENT
/begin MEASUREMENT can_st_atemp "Empfangsstatus ATemp" UBYTE FORMULA_0092 0 0 0.0 255.0 ECU_ADDRESS 0x3FB5F6 /begin FUNCTION_LIST cantel /end FUNCTION_LIST BIT_MASK 0xF /end MEASUREMENT
/begin MEASUREMENT can_klst_timeout "KLST-Timeout" UBYTE FORMULA_0093 0 0 0.0 25.5000 ECU_ADDRESS 0x3FB5F8 /begin FUNCTION_LIST cantel /end FUNCTION_LIST /end MEASUREMENT
/begin MEASUREMENT can_kl_st "Klemmenstatus" UBYTE FORMULA_0008 0 0 0.0 255.0000 ECU_ADDRESS 0x3FB5F9 /begin FUNCTION_LIST cantel /end FUNCTION_LIST /end MEASUREMENT
/begin MEASUREMENT can_no_key "Schluesselnummer" UBYTE FORMULA_0008 0 0 0.0 255.0000 ECU_ADDRESS 0x3FB5FA /begin FUNCTION_LIST cantel /end FUNCTION_LIST /end MEASUREMENT
/begin MEASUREMENT can_kkos_timeout "KKOS-Timeout" UBYTE FORMULA_0093 0 0 0.0 25.5000 ECU_ADDRESS 0x3FB5FB /begin FUNCTION_LIST cantel /end FUNCTION_LIST /end MEASUREMENT
/begin MEASUREMENT can_kkos_st "Stati KKOS" UBYTE FORMULA_0008 0 0 0.0 255.0000 ECU_ADDRESS 0x3FB5FC /begin FUNCTION_LIST cantel /end FUNCTION_LIST /end MEASUREMENT
/begin MEASUREMENT can_kkos_elu "Anfoderung ELU" UBYTE FORMULA_0094 0 0 0.0 255.0000 ECU_ADDRESS 0x3FB5FD /begin FUNCTION_LIST cantel /end FUNCTION_LIST /end MEASUREMENT
/begin MEASUREMENT can_ax "Laengsbeschleunigung (roh)" SWORD FORMULA_0095 0 0 -819.2000 819.1750 ECU_ADDRESS 0x3FB5FE /begin FUNCTION_LIST cantel /end FUNCTION_LIST /end MEASUREMENT
/begin MEASUREMENT can_ay "Querbeschleunigung (roh)" SWORD FORMULA_0095 0 0 -819.2000 819.1750 ECU_ADDRESS 0x3FB600 /begin FUNCTION_LIST cantel /end FUNCTION_LIST /end MEASUREMENT
/begin MEASUREMENT can_fzg_st "Fzg-Zustand" UBYTE FORMULA_0096 0 0 0.0 255.0 ECU_ADDRESS 0x3FB602 /begin FUNCTION_LIST cantel /end FUNCTION_LIST /end MEASUREMENT
/begin MEASUREMENT can_dsc_eingr "DSC-Eingriff" UBYTE FORMULA_0097 0 0 0.0 255.0 ECU_ADDRESS 0x3FB605 /begin FUNCTION_LIST cantel /end FUNCTION_LIST /end MEASUREMENT
/begin MEASUREMENT can_dsc_md_soll_dk "DSC-Sollmoment DK" SWORD FORMULA_0018 0 0 -100.0000 1000.0000 ECU_ADDRESS 0x3FB606 /begin FUNCTION_LIST cantel /end FUNCTION_LIST /end MEASUREMENT
/begin MEASUREMENT can_dsc_md_soll_tz "DSC-Sollmoment TZ" SWORD FORMULA_0018 0 0 -100.0000 1000.0000 ECU_ADDRESS 0x3FB608 /begin FUNCTION_LIST cantel /end FUNCTION_LIST /end MEASUREMENT
/begin MEASUREMENT can_dsc_st "DSC-Status" UBYTE FORMULA_0008 0 0 0.0 255.0000 ECU_ADDRESS 0x3FB60A /begin FUNCTION_LIST cantel /end FUNCTION_LIST /end MEASUREMENT
/begin MEASUREMENT can_dsc_reg "DSC-Regelung" UBYTE FORMULA_0008 0 0 0.0 255.0000 ECU_ADDRESS 0x3FB60B /begin FUNCTION_LIST cantel /end FUNCTION_LIST /end MEASUREMENT
/begin MEASUREMENT can_lshvk_st_1 "VKAT1-LSH-Status" UWORD FORMULA_0000 0 0 0.0 65535.0000 ECU_ADDRESS 0x3FB610 /begin FUNCTION_LIST cantel /end FUNCTION_LIST /end MEASUREMENT
/begin MEASUREMENT can_lshvk_st_2 "VKAT2-LSH-Status" UWORD FORMULA_0000 0 0 0.0 65535.0000 ECU_ADDRESS 0x3FB612 /begin FUNCTION_LIST cantel /end FUNCTION_LIST /end MEASUREMENT
/begin MEASUREMENT can_atic42_ip_loop_enable_1 "ATIC42 Pumpstrom Regelung" UBYTE FORMULA_0098 0 0 0.0 1.0 ECU_ADDRESS 0x3FB614 /begin FUNCTION_LIST cantel /end FUNCTION_LIST /end MEASUREMENT
/begin MEASUREMENT can_atic42_ip_loop_enable_2 "ATIC42 Pumpstrom Regelung" UBYTE FORMULA_0098 0 0 0.0 1.0 ECU_ADDRESS 0x3FB615 /begin FUNCTION_LIST cantel /end FUNCTION_LIST /end MEASUREMENT
/* ------------------ Abschnitt erzeugt aus pabg.dat ------------------ */
/begin CHARACTERISTIC K_PABG_STAT_TAU "Filterzeitkonstante PABG" VALUE 0x607C6 TKW_VV_VV_UB 100.0 FORMULA_0115 0.0101 2.5600 /begin FUNCTION_LIST pabg /end FUNCTION_LIST /end CHARACTERISTIC
/begin CHARACTERISTIC KL_PABG_STAT_ML "Grundkennfeld relativer PABG" CURVE 0x607C8 TKL_SW_VV_SW 100.0 FORMULA_0031 0.0 1500.0000 /begin FUNCTION_LIST pabg /end FUNCTION_LIST
 /begin AXIS_DESCR STD_AXIS ml FORMULA_0010 8 -100.0000 1400.0000 FORMAT "%4.1" /end AXIS_DESCR
 FORMAT "%4.1" /end CHARACTERISTIC
/begin MEASUREMENT pabg_b1 "Abgasgegendruck gesamt" SWORD FORMULA_0031 0 0 500.0000 2000.0000 ECU_ADDRESS 0x3FBAC6 /begin FUNCTION_LIST pabg /end FUNCTION_LIST /end MEASUREMENT
/begin MEASUREMENT pabg_b2 "Abgasgegendruck gesamt" SWORD FORMULA_0031 0 0 500.0000 2000.0000 ECU_ADDRESS 0x3FBAD0 /begin FUNCTION_LIST pabg /end FUNCTION_LIST /end MEASUREMENT
/begin MEASUREMENT pabg_b1.stat_roh "Abgasgegendruck ungefiltert" SWORD FORMULA_0031 0 0 500.0000 2000.0000 ECU_ADDRESS 0x3FBAC8 /begin FUNCTION_LIST pabg /end FUNCTION_LIST /end MEASUREMENT
/begin MEASUREMENT pabg_b2.stat_roh "Abgasgegendruck ungefiltert" SWORD FORMULA_0031 0 0 500.0000 2000.0000 ECU_ADDRESS 0x3FBAD2 /begin FUNCTION_LIST pabg /end FUNCTION_LIST /end MEASUREMENT
/begin MEASUREMENT pabg_b1.dif "Diff. Abgasgegendruck zur PUMG" SWORD FORMULA_0031 0 0 500.0000 2000.0000 ECU_ADDRESS 0x3FBACA /begin FUNCTION_LIST pabg /end FUNCTION_LIST /end MEASUREMENT
/begin MEASUREMENT pabg_b2.dif "Diff. Abgasgegendruck zur PUMG" SWORD FORMULA_0031 0 0 500.0000 2000.0000 ECU_ADDRESS 0x3FBAD4 /begin FUNCTION_LIST pabg /end FUNCTION_LIST /end MEASUREMENT
/begin MEASUREMENT pabg_b1.tau "Filtertaukonstante" UWORD FORMULA_0114 0 0 0.1000 25.6000 ECU_ADDRESS 0x3FBACC /begin FUNCTION_LIST pabg /end FUNCTION_LIST /end MEASUREMENT
/begin MEASUREMENT pabg_b2.tau "Filtertaukonstante" UWORD FORMULA_0114 0 0 0.1000 25.6000 ECU_ADDRESS 0x3FBAD6 /begin FUNCTION_LIST pabg /end FUNCTION_LIST /end MEASUREMENT
/begin MEASUREMENT pabg_b1.pabg_10ms "Abgasgegendruck mit 10ms Filter berechnet" SWORD FORMULA_0031 0 0 500.0000 2000.0000 ECU_ADDRESS 0x3FBACE /begin FUNCTION_LIST pabg /end FUNCTION_LIST /end MEASUREMENT
/begin MEASUREMENT pabg_b2.pabg_10ms "Abgasgegendruck mit 10ms Filter berechnet" SWORD FORMULA_0031 0 0 500.0000 2000.0000 ECU_ADDRESS 0x3FBAD8 /begin FUNCTION_LIST pabg /end FUNCTION_LIST /end MEASUREMENT
/* ------------------ Abschnitt erzeugt aus pumg.dat ------------------ */
/begin CHARACTERISTIC K_PUMG_DIAG_MIN "Unter Grenze Umgebungsdruck" VALUE 0x60948 TKW_VV_VV_SW 100.0 FORMULA_0180 400.0000 1200.0000 /begin FUNCTION_LIST Umgebungsdruck /end FUNCTION_LIST /end CHARACTERISTIC
/begin CHARACTERISTIC K_PUMG_DIAG_MAX "Obere Grenze Umgebungsdruck" VALUE 0x6094A TKW_VV_VV_SW 100.0 FORMULA_0180 400.0000 1200.0000 /begin FUNCTION_LIST Umgebungsdruck /end FUNCTION_LIST /end CHARACTERISTIC
/begin CHARACTERISTIC K_PUMG_ERSATZ "Ersatzwert Umgebungsdruck" VALUE 0x6094C TKW_VV_VV_SW 100.0 FORMULA_0180 400.0000 1200.0000 /begin FUNCTION_LIST Umgebungsdruck /end FUNCTION_LIST /end CHARACTERISTIC
/begin CHARACTERISTIC K_PUMG_STEIGUNG "Steigung des Drucksensors" VALUE 0x6094E TKW_VV_VV_UW 100.0 FORMULA_0181 0.0 275.0000 /begin FUNCTION_LIST Umgebungsdruck /end FUNCTION_LIST FORMAT "%6.3" /end CHARACTERISTIC
/begin CHARACTERISTIC K_PUMG_OFFSET "Offset des Drucksensors" VALUE 0x60950 TKW_VV_VV_SW 100.0 FORMULA_0182 400.0000 625.0000 /begin FUNCTION_LIST Umgebungsdruck /end FUNCTION_LIST FORMAT "%6.3" /end CHARACTERISTIC
/begin CHARACTERISTIC K_PUMG_TAU "Filterkonstante fuer die Umgebungsdruckerfassung" VALUE 0x60952 TKW_VV_VV_UB 100.0 FORMULA_0108 0.1004 25.6000 /begin FUNCTION_LIST Umgebungsdruck /end FUNCTION_LIST /end CHARACTERISTIC
/begin MEASUREMENT pumg_ad "Eingelesener Spannungswert fuer Umgebungsdruck" SWORD FORMULA_0112 0 0 0.0 1023.0000 ECU_ADDRESS 0x3FBC4A /begin FUNCTION_LIST Umgebungsdruck /end FUNCTION_LIST /end MEASUREMENT
/begin MEASUREMENT pumg_roh "Ungefilterter Messwert" SWORD FORMULA_0031 0 0 400.0000 1200.0000 ECU_ADDRESS 0x3FBC4C /begin FUNCTION_LIST Umgebungsdruck /end FUNCTION_LIST /end MEASUREMENT
/* ------------------ Abschnitt erzeugt aus rps.dat ------------------ */
/begin CHARACTERISTIC K_RPS_CFG "Auswahl RPS-Modell" VALUE 0x60BA6 TKW_VV_VV_UB 100.0 FORMULA_0198 0.0 255.0 /begin FUNCTION_LIST rps /end FUNCTION_LIST /end CHARACTERISTIC
/begin MEASUREMENT rps_zust_allg_1of2_ "Allg. Zustand" UBYTE FORMULA_0008 0 0 0.0 255.0000 ECU_ADDRESS 0x3FBCA8 /begin FUNCTION_LIST rps /end FUNCTION_LIST /end MEASUREMENT
/begin MEASUREMENT rps_zust_allg_2of2_ "Allg. Zustand" UBYTE FORMULA_0008 0 0 0.0 255.0000 ECU_ADDRESS 0x3FBCA9 /begin FUNCTION_LIST rps /end FUNCTION_LIST /end MEASUREMENT
/begin MEASUREMENT rps_tan_zust "Status tan-RPS" UBYTE FORMULA_0008 0 0 0.0 255.0000 ECU_ADDRESS 0x3FBCAA /begin FUNCTION_LIST rps /end FUNCTION_LIST /end MEASUREMENT
/begin MEASUREMENT rps_tan "tan-RPS" SWORD FORMULA_0019 0 0 -50.0000 150.0000 ECU_ADDRESS 0x3FBCAC /begin FUNCTION_LIST rps /end FUNCTION_LIST /end MEASUREMENT
/begin MEASUREMENT rps_wf_mks_1of12_ "RPS-MKS aus Wandfilmmodell" SWORD FORMULA_0125 0 0 -512.0000 511.0000 ECU_ADDRESS 0x3FBCAE /begin FUNCTION_LIST rps /end FUNCTION_LIST /end MEASUREMENT
/begin MEASUREMENT rps_wf_mks_2of12_ "RPS-MKS aus Wandfilmmodell" SWORD FORMULA_0125 0 0 -512.0000 511.0000 ECU_ADDRESS 0x3FBCB0 /begin FUNCTION_LIST rps /end FUNCTION_LIST /end MEASUREMENT
/begin MEASUREMENT rps_wf_mks_3of12_ "RPS-MKS aus Wandfilmmodell" SWORD FORMULA_0125 0 0 -512.0000 511.0000 ECU_ADDRESS 0x3FBCB2 /begin FUNCTION_LIST rps /end FUNCTION_LIST /end MEASUREMENT
/begin MEASUREMENT rps_wf_mks_4of12_ "RPS-MKS aus Wandfilmmodell" SWORD FORMULA_0125 0 0 -512.0000 511.0000 ECU_ADDRESS 0x3FBCB4 /begin FUNCTION_LIST rps /end FUNCTION_LIST /end MEASUREMENT
/begin MEASUREMENT rps_wf_mks_5of12_ "RPS-MKS aus Wandfilmmodell" SWORD FORMULA_0125 0 0 -512.0000 511.0000 ECU_ADDRESS 0x3FBCB6 /begin FUNCTION_LIST rps /end FUNCTION_LIST /end MEASUREMENT
/begin MEASUREMENT rps_wf_mks_6of12_ "RPS-MKS aus Wandfilmmodell" SWORD FORMULA_0125 0 0 -512.0000 511.0000 ECU_ADDRESS 0x3FBCB8 /begin FUNCTION_LIST rps /end FUNCTION_LIST /end MEASUREMENT
/begin MEASUREMENT rps_wf_mks_7of12_ "RPS-MKS aus Wandfilmmodell" SWORD FORMULA_0125 0 0 -512.0000 511.0000 ECU_ADDRESS 0x3FBCBA /begin FUNCTION_LIST rps /end FUNCTION_LIST /end MEASUREMENT
/begin MEASUREMENT rps_wf_mks_8of12_ "RPS-MKS aus Wandfilmmodell" SWORD FORMULA_0125 0 0 -512.0000 511.0000 ECU_ADDRESS 0x3FBCBC /begin FUNCTION_LIST rps /end FUNCTION_LIST /end MEASUREMENT
/begin MEASUREMENT rps_wf_mks_9of12_ "RPS-MKS aus Wandfilmmodell" SWORD FORMULA_0125 0 0 -512.0000 511.0000 ECU_ADDRESS 0x3FBCBE /begin FUNCTION_LIST rps /end FUNCTION_LIST /end MEASUREMENT
/begin MEASUREMENT rps_wf_mks_10of12_ "RPS-MKS aus Wandfilmmodell" SWORD FORMULA_0125 0 0 -512.0000 511.0000 ECU_ADDRESS 0x3FBCC0 /begin FUNCTION_LIST rps /end FUNCTION_LIST /end MEASUREMENT
/begin MEASUREMENT rps_wf_mks_11of12_ "RPS-MKS aus Wandfilmmodell" SWORD FORMULA_0125 0 0 -512.0000 511.0000 ECU_ADDRESS 0x3FBCC2 /begin FUNCTION_LIST rps /end FUNCTION_LIST /end MEASUREMENT
/begin MEASUREMENT rps_wf_mks_12of12_ "RPS-MKS aus Wandfilmmodell" SWORD FORMULA_0125 0 0 -512.0000 511.0000 ECU_ADDRESS 0x3FBCC4 /begin FUNCTION_LIST rps /end FUNCTION_LIST /end MEASUREMENT
/begin MEASUREMENT rps_wf_st "RPS-WF-Aktiv-Status" UWORD FORMULA_0024 0 0 0.0 65535.0000 ECU_ADDRESS 0x3FBCC6 /begin FUNCTION_LIST rps /end FUNCTION_LIST /end MEASUREMENT
/begin MEASUREMENT rps_lam_reg_st_1of2_ "RPS-LA-Regler-Status" UWORD FORMULA_0195 0 0 0.0 65535.0 ECU_ADDRESS 0x3FBCC8 /begin FUNCTION_LIST rps /end FUNCTION_LIST BIT_MASK 0x7 /end MEASUREMENT
/begin MEASUREMENT rps_lam_reg_st_2of2_ "RPS-LA-Regler-Status" UWORD FORMULA_0195 0 0 0.0 65535.0 ECU_ADDRESS 0x3FBCCA /begin FUNCTION_LIST rps /end FUNCTION_LIST BIT_MASK 0x7 /end MEASUREMENT
/begin MEASUREMENT rps_lam_reg_f_1of2_ "RPS-Regeleingriff" UWORD FORMULA_0087 0 0 0.0 1.9990 ECU_ADDRESS 0x3FBCCC /begin FUNCTION_LIST rps /end FUNCTION_LIST /end MEASUREMENT
/begin MEASUREMENT rps_lam_reg_f_2of2_ "RPS-Regeleingriff" UWORD FORMULA_0087 0 0 0.0 1.9990 ECU_ADDRESS 0x3FBCCE /begin FUNCTION_LIST rps /end FUNCTION_LIST /end MEASUREMENT
/begin MEASUREMENT rps_lam_delta_lim_1of2_ "RPS-begrenzte Regelabweichung" SWORD FORMULA_0004 0 0 -2.0000 1.9999 ECU_ADDRESS 0x3FBCD0 /begin FUNCTION_LIST rps /end FUNCTION_LIST /end MEASUREMENT
/begin MEASUREMENT rps_lam_delta_lim_2of2_ "RPS-begrenzte Regelabweichung" SWORD FORMULA_0004 0 0 -2.0000 1.9999 ECU_ADDRESS 0x3FBCD2 /begin FUNCTION_LIST rps /end FUNCTION_LIST /end MEASUREMENT
/begin MEASUREMENT rps_laa_st_1of2_ "RPS-LA-Adaption-Status" UWORD FORMULA_0196 0 0 0.0 65535.0 ECU_ADDRESS 0x3FBCD4 /begin FUNCTION_LIST rps /end FUNCTION_LIST BIT_MASK 0x1F /end MEASUREMENT
/begin MEASUREMENT rps_laa_st_2of2_ "RPS-LA-Adaption-Status" UWORD FORMULA_0196 0 0 0.0 65535.0 ECU_ADDRESS 0x3FBCD6 /begin FUNCTION_LIST rps /end FUNCTION_LIST BIT_MASK 0x1F /end MEASUREMENT
/begin MEASUREMENT rps_laa_f_1of2_ "RPS-Faktor-Lambdaadaption" UWORD FORMULA_0087 0 0 0.0 1.9990 ECU_ADDRESS 0x3FBCD8 /begin FUNCTION_LIST rps /end FUNCTION_LIST /end MEASUREMENT
/begin MEASUREMENT rps_laa_f_2of2_ "RPS-Faktor-Lambdaadaption" UWORD FORMULA_0087 0 0 0.0 1.9990 ECU_ADDRESS 0x3FBCDA /begin FUNCTION_LIST rps /end FUNCTION_LIST /end MEASUREMENT
/begin MEASUREMENT rps_laa_offs_1of2_ "RPS-Offset-Lambdaadaption" SWORD FORMULA_0088 0 0 -512.0000 511.0000 ECU_ADDRESS 0x3FBCDC /begin FUNCTION_LIST rps /end FUNCTION_LIST /end MEASUREMENT
/begin MEASUREMENT rps_laa_offs_2of2_ "RPS-Offset-Lambdaadaption" SWORD FORMULA_0088 0 0 -512.0000 511.0000 ECU_ADDRESS 0x3FBCDE /begin FUNCTION_LIST rps /end FUNCTION_LIST /end MEASUREMENT
/begin MEASUREMENT rps_van_kh_st "RPS-Status Vanoskath" UWORD FORMULA_0000 0 0 0.0 65535.0000 ECU_ADDRESS 0x3FBCE0 /begin FUNCTION_LIST rps /end FUNCTION_LIST /end MEASUREMENT
/begin MEASUREMENT rps_van_soll_kh_off_1of4_ "RPS-Vanosoffset KH" SWORD FORMULA_0188 0 0 50.0000 160.0000 ECU_ADDRESS 0x3FBCE2 /begin FUNCTION_LIST rps /end FUNCTION_LIST /end MEASUREMENT
/begin MEASUREMENT rps_van_soll_kh_off_2of4_ "RPS-Vanosoffset KH" SWORD FORMULA_0188 0 0 50.0000 160.0000 ECU_ADDRESS 0x3FBCE4 /begin FUNCTION_LIST rps /end FUNCTION_LIST /end MEASUREMENT
/begin MEASUREMENT rps_van_soll_kh_off_3of4_ "RPS-Vanosoffset KH" SWORD FORMULA_0188 0 0 50.0000 160.0000 ECU_ADDRESS 0x3FBCE6 /begin FUNCTION_LIST rps /end FUNCTION_LIST /end MEASUREMENT
/begin MEASUREMENT rps_van_soll_kh_off_4of4_ "RPS-Vanosoffset KH" SWORD FORMULA_0188 0 0 50.0000 160.0000 ECU_ADDRESS 0x3FBCE8 /begin FUNCTION_LIST rps /end FUNCTION_LIST /end MEASUREMENT
/begin MEASUREMENT rps_tmot "RPS-Motortemperatur" SWORD FORMULA_0019 0 0 -50.0000 150.0000 ECU_ADDRESS 0x3FBCEA /begin FUNCTION_LIST rps /end FUNCTION_LIST /end MEASUREMENT
/begin MEASUREMENT rps_pks_st "RPS-PKS-Status" UBYTE FORMULA_0197 0 0 0.0 255.0 ECU_ADDRESS 0x3FBCEC /begin FUNCTION_LIST rps /end FUNCTION_LIST /end MEASUREMENT
/* ------------------ Abschnitt erzeugt aus sa_we.dat ------------------ */
/begin CHARACTERISTIC K_SA_MD_FW_REL_MIN "relatvie Momenentenschwelle Zugbetr. in Schubbetrieb direkt" VALUE 0x60BA8 TKW_VV_VV_SW 100.0 FORMULA_0022 0.0 100.0000 /begin FUNCTION_LIST sa_we /end FUNCTION_LIST FORMAT "%4.1" /end CHARACTERISTIC
/begin CHARACTERISTIC K_SA_MD_HYS "absolute Drehmomenthyst. fuer Erkennung SA" VALUE 0x60BAA TKW_VV_VV_SW 100.0 FORMULA_0018 -100.0000 1000.0000 /begin FUNCTION_LIST sa_we /end FUNCTION_LIST FORMAT "%4.1" /end CHARACTERISTIC
/begin CHARACTERISTIC K_SA_MD_IND_NE_MAX "max. ind. Motormoment nach Eingriff fuer direkten Ueberg. nach SA" VALUE 0x60BAC TKW_VV_VV_SW 100.0 FORMULA_0018 -100.0000 1000.0000 /begin FUNCTION_LIST sa_we /end FUNCTION_LIST FORMAT "%4.1" /end CHARACTERISTIC
/begin CHARACTERISTIC K_SA_MD_IND_NE_MIN "absolute md-Schwelle fuer Aktivierung der SA" VALUE 0x60BAE TKW_VV_VV_SW 100.0 FORMULA_0018 -100.0000 1000.0000 /begin FUNCTION_LIST sa_we /end FUNCTION_LIST FORMAT "%4.1" /end CHARACTERISTIC
/begin CHARACTERISTIC K_SA_TKAT "minimale Katalysatortemp. fuer Freigabe SA" VALUE 0x60BB0 TKW_VV_VV_SW 100.0 FORMULA_0019 -50.0000 150.0000 /begin FUNCTION_LIST sa_we /end FUNCTION_LIST FORMAT "%4.1" /end CHARACTERISTIC
/begin CHARACTERISTIC K_SA_WE_MD_HYS "absolute md-Schwelle fuer Erkennung WE" VALUE 0x60BB2 TKW_VV_VV_SW 100.0 FORMULA_0022 0.0 100.0000 /begin FUNCTION_LIST sa_we /end FUNCTION_LIST FORMAT "%4.1" /end CHARACTERISTIC
/begin CHARACTERISTIC K_SA_N_HYS "allg. Hyst. SA-Drehzahl" VALUE 0x60BB4 TKW_VV_VV_SW 100.0 FORMULA_0011 0.0 10000.0000 /begin FUNCTION_LIST sa_we /end FUNCTION_LIST /end CHARACTERISTIC
/begin CHARACTERISTIC K_SA_TZ_MIN_HYS "Hysterese für tzmin" VALUE 0x60BB6 TKW_VV_VV_SW 100.0 FORMULA_0037 -50.0000 60.0000 /begin FUNCTION_LIST sa_we /end FUNCTION_LIST FORMAT "%4.1" /end CHARACTERISTIC
/begin CHARACTERISTIC KL_SA_N_GANG "gangabhaengiger Offset fuer WE-drehzalberechnung" CURVE 0x60BB8 TKL_SW_VV_SW 100.0 FORMULA_0011 0.0 10000.0000 /begin FUNCTION_LIST sa_we /end FUNCTION_LIST /begin AXIS_DESCR STD_AXIS gang FORMULA_0000 10 -1.0000 10.0000 /end AXIS_DESCR /end CHARACTERISTIC
/begin CHARACTERISTIC KL_SA_N_TMOT "tmot abhaeng. Offset fuer WA-berechnung" CURVE 0x60BE2 TKL_SW_VV_SW 100.0 FORMULA_0011 0.0 10000.0000 /begin FUNCTION_LIST sa_we /end FUNCTION_LIST
 /begin AXIS_DESCR STD_AXIS tmot FORMULA_0019 4 -50.0000 150.0000 FORMAT "%4.1" /end AXIS_DESCR
/end CHARACTERISTIC
/begin CHARACTERISTIC KL_SA_N_DYN "Drehzalgradientenabhae. Offset fuer WA-Drezahlberechnung" CURVE 0x60BF4 TKL_SW_VV_SW 100.0 FORMULA_0011 0.0 10000.0000 /begin FUNCTION_LIST sa_we /end FUNCTION_LIST /begin AXIS_DESCR STD_AXIS dn FORMULA_0012 4 -10000.0000 10000.0000 /end AXIS_DESCR /end CHARACTERISTIC
/begin CHARACTERISTIC KL_SA_N_HYS_GANG "gangabh. Hyst. SA-Drehzahl" CURVE 0x60C06 TKL_SW_VV_SW 100.0 FORMULA_0011 0.0 10000.0000 /begin FUNCTION_LIST sa_we /end FUNCTION_LIST /begin AXIS_DESCR STD_AXIS gang FORMULA_0000 10 -1.0000 10.0000 /end AXIS_DESCR /end CHARACTERISTIC
/begin CHARACTERISTIC KF_SA_T_TRIG_MAX "Saugrohrdruckdelta" MAP 0x60C30 TKF_SW_SW_UW 100.0 FORMULA_0199 0.0 327.6750 /begin FUNCTION_LIST sa_we /end FUNCTION_LIST
 /begin AXIS_DESCR STD_AXIS tmot_loc FORMULA_0019 4 -50.0000 150.0000 FORMAT "%4.1" /end AXIS_DESCR
 /begin AXIS_DESCR STD_AXIS n FORMULA_0011 6 0.0 10000.0000 /end AXIS_DESCR
 FORMAT "%5.2" /end CHARACTERISTIC
/begin MEASUREMENT sa_n "Drehzahlschwelle fuer Schubabschalten" SWORD FORMULA_0011 0 0 0.0 10000.0000 ECU_ADDRESS 0x3FBCF0 /begin FUNCTION_LIST sa_we /end FUNCTION_LIST /end MEASUREMENT
/begin MEASUREMENT sa_n_we "Drehzahlschwelle fuer Wiedereinsetzdrehzahl" SWORD FORMULA_0011 0 0 0.0 10000.0000 ECU_ADDRESS 0x3FBCF2 /begin FUNCTION_LIST sa_we /end FUNCTION_LIST /end MEASUREMENT
/begin MEASUREMENT sa_t_sa_trig "Verweilzeit im Zustand SA-Trigger" UWORD FORMULA_0199 0 0 0.0 327.6750 ECU_ADDRESS 0x3FBCF4 /begin FUNCTION_LIST sa_we /end FUNCTION_LIST /end MEASUREMENT
/begin MEASUREMENT sa_t_sa_trig_max "Maximale Verweilzeit im Zustand SA-Trigger" UWORD FORMULA_0199 0 0 0.0 327.6750 ECU_ADDRESS 0x3FBCF6 /begin FUNCTION_LIST sa_we /end FUNCTION_LIST /end MEASUREMENT
/* ------------------ Abschnitt erzeugt aus testfunktion.dat ------------------ */
/begin CHARACTERISTIC K_TEST "Maxwert" VALUE 0x60CF8 TKW_VV_VV_UW 100.0 FORMULA_0000 0.0 65535.0000 /begin FUNCTION_LIST testfunktion /end FUNCTION_LIST /end CHARACTERISTIC
/begin CHARACTERISTIC K_TEST_X "Testwert-x" VALUE 0x60CFA TKW_VV_VV_UW 100.0 FORMULA_0000 0.0 65535.0000 /begin FUNCTION_LIST testfunktion /end FUNCTION_LIST /end CHARACTERISTIC
/begin CHARACTERISTIC K_TEST_Y "Testwert-y" VALUE 0x60CFC TKW_VV_VV_UW 100.0 FORMULA_0000 0.0 65535.0000 /begin FUNCTION_LIST testfunktion /end FUNCTION_LIST /end CHARACTERISTIC
/begin CHARACTERISTIC K_TEST_LA_BANK1 "Testarray" VALUE 0x60D00 TKW_VV_VV_UB 100.0 FORMULA_0008 0.0 255.0000 /begin FUNCTION_LIST testfunktion /end FUNCTION_LIST /end CHARACTERISTIC
/begin CHARACTERISTIC K_TEST_LA_BANK2 "Testarray" VALUE 0x60D01 TKW_VV_VV_UB 100.0 FORMULA_0008 0.0 255.0000 /begin FUNCTION_LIST testfunktion /end FUNCTION_LIST /end CHARACTERISTIC
/begin CHARACTERISTIC K_TEST_MD_ZYL1 "Testarray" VALUE 0x60D04 TKW_VV_VV_UB 100.0 FORMULA_0008 0.0 255.0000 /begin FUNCTION_LIST testfunktion /end FUNCTION_LIST /end CHARACTERISTIC
/begin CHARACTERISTIC K_TEST_MD_ZYL2 "Testarray" VALUE 0x60D05 TKW_VV_VV_UB 100.0 FORMULA_0008 0.0 255.0000 /begin FUNCTION_LIST testfunktion /end FUNCTION_LIST /end CHARACTERISTIC
/begin CHARACTERISTIC K_TEST_MD_ZYL3 "Testarray" VALUE 0x60D06 TKW_VV_VV_UB 100.0 FORMULA_0008 0.0 255.0000 /begin FUNCTION_LIST testfunktion /end FUNCTION_LIST /end CHARACTERISTIC
/begin CHARACTERISTIC K_TEST_MD_ZYL4 "Testarray" VALUE 0x60D07 TKW_VV_VV_UB 100.0 FORMULA_0008 0.0 255.0000 /begin FUNCTION_LIST testfunktion /end FUNCTION_LIST /end CHARACTERISTIC
/begin CHARACTERISTIC K_TEST_MD_ZYL5 "Testarray" VALUE 0x60D08 TKW_VV_VV_UB 100.0 FORMULA_0008 0.0 255.0000 /begin FUNCTION_LIST testfunktion /end FUNCTION_LIST /end CHARACTERISTIC
/begin CHARACTERISTIC K_TEST_MD_ZYL6 "Testarray" VALUE 0x60D09 TKW_VV_VV_UB 100.0 FORMULA_0008 0.0 255.0000 /begin FUNCTION_LIST testfunktion /end FUNCTION_LIST /end CHARACTERISTIC
/begin CHARACTERISTIC K_TEST_MD_ZYL7 "Testarray" VALUE 0x60D0A TKW_VV_VV_UB 100.0 FORMULA_0008 0.0 255.0000 /begin FUNCTION_LIST testfunktion /end FUNCTION_LIST /end CHARACTERISTIC
/begin CHARACTERISTIC K_TEST_MD_ZYL8 "Testarray" VALUE 0x60D0B TKW_VV_VV_UB 100.0 FORMULA_0008 0.0 255.0000 /begin FUNCTION_LIST testfunktion /end FUNCTION_LIST /end CHARACTERISTIC
/begin CHARACTERISTIC K_TEST_MD_ZYL9 "Testarray" VALUE 0x60D0C TKW_VV_VV_UB 100.0 FORMULA_0008 0.0 255.0000 /begin FUNCTION_LIST testfunktion /end FUNCTION_LIST /end CHARACTERISTIC
/begin CHARACTERISTIC K_TEST_MD_ZYL10 "Testarray" VALUE 0x60D0D TKW_VV_VV_UB 100.0 FORMULA_0008 0.0 255.0000 /begin FUNCTION_LIST testfunktion /end FUNCTION_LIST /end CHARACTERISTIC
/begin CHARACTERISTIC K_TEST_MD_ZYL11 "Testarray" VALUE 0x60D0E TKW_VV_VV_UB 100.0 FORMULA_0008 0.0 255.0000 /begin FUNCTION_LIST testfunktion /end FUNCTION_LIST /end CHARACTERISTIC
/begin CHARACTERISTIC K_TEST_MD_ZYL12 "Testarray" VALUE 0x60D0F TKW_VV_VV_UB 100.0 FORMULA_0008 0.0 255.0000 /begin FUNCTION_LIST testfunktion /end FUNCTION_LIST /end CHARACTERISTIC
/begin CHARACTERISTIC KL_TEST_X "Testkennlinie" CURVE 0x60D10 TKL_UW_VV_UW 100.0 FORMULA_0024 0.0 65535.0000 /begin FUNCTION_LIST testfunktion /end FUNCTION_LIST /begin AXIS_DESCR STD_AXIS ein_x FORMULA_0000 4 0.0 65535.0000 /end AXIS_DESCR FORMAT "%5.2" /end CHARACTERISTIC
/begin CHARACTERISTIC KF_TEST_XY "Testkennfeld" MAP 0x60D22 TKF_UW_UW_UW 100.0 FORMULA_0000 0.0 65535.0000 /begin FUNCTION_LIST testfunktion /end FUNCTION_LIST /begin AXIS_DESCR STD_AXIS ein_x FORMULA_0000 5 0.0 65535.0000 /end AXIS_DESCR /begin AXIS_DESCR STD_AXIS ein_y FORMULA_0000 3 0.0 65535.0000 /end AXIS_DESCR /end CHARACTERISTIC
/begin MEASUREMENT testvariable "Test" UWORD FORMULA_0000 0 0 0.0 65535.0000 ECU_ADDRESS 0x3FBD38 /begin FUNCTION_LIST testfunktion /end FUNCTION_LIST /end MEASUREMENT
/begin MEASUREMENT test_kl_ip "Test" UWORD FORMULA_0000 0 0 0.0 65535.0000 ECU_ADDRESS 0x3FBD3A /begin FUNCTION_LIST testfunktion /end FUNCTION_LIST /end MEASUREMENT
/begin MEASUREMENT test_kf_ip "Test" UWORD FORMULA_0000 0 0 0.0 65535.0000 ECU_ADDRESS 0x3FBD3C /begin FUNCTION_LIST testfunktion /end FUNCTION_LIST /end MEASUREMENT
/begin MEASUREMENT ttest_1of2_.element_1 "Test" UWORD FORMULA_0000 0 0 0.0 65535.0000 ECU_ADDRESS 0x3FBD40 /begin FUNCTION_LIST testfunktion /end FUNCTION_LIST /end MEASUREMENT
/begin MEASUREMENT ttest_2of2_.element_1 "Test" UWORD FORMULA_0000 0 0 0.0 65535.0000 ECU_ADDRESS 0x3FBD4A /begin FUNCTION_LIST testfunktion /end FUNCTION_LIST /end MEASUREMENT
/begin MEASUREMENT ttest_1of2_.help.help1 "Test" UBYTE FORMULA_0008 0 0 0.0 255.0000 ECU_ADDRESS 0x3FBD42 /begin FUNCTION_LIST testfunktion /end FUNCTION_LIST /end MEASUREMENT
/begin MEASUREMENT ttest_2of2_.help.help1 "Test" UBYTE FORMULA_0008 0 0 0.0 255.0000 ECU_ADDRESS 0x3FBD4C /begin FUNCTION_LIST testfunktion /end FUNCTION_LIST /end MEASUREMENT
/begin MEASUREMENT ttest_1of2_.help.help2 "Test" UWORD FORMULA_0000 0 0 0.0 65535.0000 ECU_ADDRESS 0x3FBD44 /begin FUNCTION_LIST testfunktion /end FUNCTION_LIST /end MEASUREMENT
/begin MEASUREMENT ttest_2of2_.help.help2 "Test" UWORD FORMULA_0000 0 0 0.0 65535.0000 ECU_ADDRESS 0x3FBD4E /begin FUNCTION_LIST testfunktion /end FUNCTION_LIST /end MEASUREMENT
/begin MEASUREMENT ttest_1of2_.array_1of2_ "Test" UBYTE FORMULA_0008 0 0 0.0 255.0000 ECU_ADDRESS 0x3FBD46 /begin FUNCTION_LIST testfunktion /end FUNCTION_LIST /end MEASUREMENT
/begin MEASUREMENT ttest_1of2_.array_2of2_ "Test" UBYTE FORMULA_0008 0 0 0.0 255.0000 ECU_ADDRESS 0x3FBD47 /begin FUNCTION_LIST testfunktion /end FUNCTION_LIST /end MEASUREMENT
/begin MEASUREMENT ttest_2of2_.array_1of2_ "Test" UBYTE FORMULA_0008 0 0 0.0 255.0000 ECU_ADDRESS 0x3FBD50 /begin FUNCTION_LIST testfunktion /end FUNCTION_LIST /end MEASUREMENT
/begin MEASUREMENT ttest_2of2_.array_2of2_ "Test" UBYTE FORMULA_0008 0 0 0.0 255.0000 ECU_ADDRESS 0x3FBD51 /begin FUNCTION_LIST testfunktion /end FUNCTION_LIST /end MEASUREMENT
/* ------------------ Abschnitt erzeugt aus tm_inj.dat ------------------ */
/begin MEASUREMENT tm_Sync1.netTime "Maxzeit" ULONG FORMULA_0219 0 0 0.0 1000.0000 ECU_ADDRESS 0x3F9F1C /begin FUNCTION_LIST Taskmonitor /end FUNCTION_LIST /end MEASUREMENT
/begin MEASUREMENT tm_Sync1.maxTime "Maxzeit" ULONG FORMULA_0219 0 0 0.0 1000.0000 ECU_ADDRESS 0x3F9F24 /begin FUNCTION_LIST Taskmonitor /end FUNCTION_LIST /end MEASUREMENT
/begin MEASUREMENT tm_Sync1.dT "Maxzeit" ULONG FORMULA_0219 0 0 0.0 1000.0000 ECU_ADDRESS 0x3F9F28 /begin FUNCTION_LIST Taskmonitor /end FUNCTION_LIST /end MEASUREMENT
/begin MEASUREMENT tm_Sync1.lastTask "Maxzeit" ULONG FORMULA_0001 0 0 0.0 1000.0000 ECU_ADDRESS 0x3F9F30 /begin FUNCTION_LIST Taskmonitor /end FUNCTION_LIST /end MEASUREMENT
/begin MEASUREMENT tm_Sync2.netTime "Maxzeit" ULONG FORMULA_0219 0 0 0.0 1000.0000 ECU_ADDRESS 0x3F9F44 /begin FUNCTION_LIST Taskmonitor /end FUNCTION_LIST /end MEASUREMENT
/begin MEASUREMENT tm_Sync2.maxTime "Maxzeit" ULONG FORMULA_0219 0 0 0.0 1000.0000 ECU_ADDRESS 0x3F9F4C /begin FUNCTION_LIST Taskmonitor /end FUNCTION_LIST /end MEASUREMENT
/begin MEASUREMENT tm_Sync2.dT "Maxzeit" ULONG FORMULA_0219 0 0 0.0 1000.0000 ECU_ADDRESS 0x3F9F50 /begin FUNCTION_LIST Taskmonitor /end FUNCTION_LIST /end MEASUREMENT
/begin MEASUREMENT tm_Sync2.lastTask "Maxzeit" ULONG FORMULA_0001 0 0 0.0 1000.0000 ECU_ADDRESS 0x3F9F58 /begin FUNCTION_LIST Taskmonitor /end FUNCTION_LIST /end MEASUREMENT
/begin MEASUREMENT tm_5ms.netTime "Maxzeit" ULONG FORMULA_0219 0 0 0.0 1000.0000 ECU_ADDRESS 0x3F9FBC /begin FUNCTION_LIST Taskmonitor /end FUNCTION_LIST /end MEASUREMENT
/begin MEASUREMENT tm_5ms.maxTime "Maxzeit" ULONG FORMULA_0219 0 0 0.0 1000.0000 ECU_ADDRESS 0x3F9FC4 /begin FUNCTION_LIST Taskmonitor /end FUNCTION_LIST /end MEASUREMENT
/begin MEASUREMENT tm_5ms.dT "Maxzeit" ULONG FORMULA_0219 0 0 0.0 1000.0000 ECU_ADDRESS 0x3F9FC8 /begin FUNCTION_LIST Taskmonitor /end FUNCTION_LIST /end MEASUREMENT
/begin MEASUREMENT tm_5ms.lastTask "Maxzeit" ULONG FORMULA_0001 0 0 0.0 1000.0000 ECU_ADDRESS 0x3F9FD0 /begin FUNCTION_LIST Taskmonitor /end FUNCTION_LIST /end MEASUREMENT
/begin MEASUREMENT tm_10ms.netTime "Maxzeit" ULONG FORMULA_0219 0 0 0.0 1000.0000 ECU_ADDRESS 0x3F9FE4 /begin FUNCTION_LIST Taskmonitor /end FUNCTION_LIST /end MEASUREMENT
/begin MEASUREMENT tm_10ms.maxTime "Maxzeit" ULONG FORMULA_0219 0 0 0.0 1000.0000 ECU_ADDRESS 0x3F9FEC /begin FUNCTION_LIST Taskmonitor /end FUNCTION_LIST /end MEASUREMENT
/begin MEASUREMENT tm_10ms.dT "Maxzeit" ULONG FORMULA_0219 0 0 0.0 1000.0000 ECU_ADDRESS 0x3F9FF0 /begin FUNCTION_LIST Taskmonitor /end FUNCTION_LIST /end MEASUREMENT
/begin MEASUREMENT tm_10ms.lastTask "Maxzeit" ULONG FORMULA_0001 0 0 0.0 1000.0000 ECU_ADDRESS 0x3F9FF8 /begin FUNCTION_LIST Taskmonitor /end FUNCTION_LIST /end MEASUREMENT
/begin MEASUREMENT tm_100ms.netTime "Maxzeit" ULONG FORMULA_0219 0 0 0.0 1000.0000 ECU_ADDRESS 0x3FA00C /begin FUNCTION_LIST Taskmonitor /end FUNCTION_LIST /end MEASUREMENT
/begin MEASUREMENT tm_100ms.maxTime "Maxzeit" ULONG FORMULA_0219 0 0 0.0 1000.0000 ECU_ADDRESS 0x3FA014 /begin FUNCTION_LIST Taskmonitor /end FUNCTION_LIST /end MEASUREMENT
/begin MEASUREMENT tm_100ms.dT "Maxzeit" ULONG FORMULA_0219 0 0 0.0 1000.0000 ECU_ADDRESS 0x3FA018 /begin FUNCTION_LIST Taskmonitor /end FUNCTION_LIST /end MEASUREMENT
/begin MEASUREMENT tm_100ms.lastTask "Maxzeit" ULONG FORMULA_0001 0 0 0.0 1000.0000 ECU_ADDRESS 0x3FA020 /begin FUNCTION_LIST Taskmonitor /end FUNCTION_LIST /end MEASUREMENT
/begin MEASUREMENT tm_bgnd.netTime "Maxzeit" ULONG FORMULA_0219 0 0 0.0 1000.0000 ECU_ADDRESS 0x3FA05C /begin FUNCTION_LIST Taskmonitor /end FUNCTION_LIST /end MEASUREMENT
/begin MEASUREMENT tm_bgnd.maxTime "Maxzeit" ULONG FORMULA_0219 0 0 0.0 1000.0000 ECU_ADDRESS 0x3FA064 /begin FUNCTION_LIST Taskmonitor /end FUNCTION_LIST /end MEASUREMENT
/begin MEASUREMENT tm_bgnd.dT "Maxzeit" ULONG FORMULA_0219 0 0 0.0 1000.0000 ECU_ADDRESS 0x3FA068 /begin FUNCTION_LIST Taskmonitor /end FUNCTION_LIST /end MEASUREMENT
/begin MEASUREMENT tm_bgnd.lastTask "Maxzeit" ULONG FORMULA_0001 0 0 0.0 1000.0000 ECU_ADDRESS 0x3FA070 /begin FUNCTION_LIST Taskmonitor /end FUNCTION_LIST /end MEASUREMENT
/* ------------------ Abschnitt erzeugt aus tpu_inj.dat ------------------ */
/begin CHARACTERISTIC K_TPU_NW_SYNC_ZAHN_INJ "Zahn bei der die NW-Synchronisation erfolgt" VALUE 0x610AC TKW_VV_VV_UB 100.0 FORMULA_0008 0.0 59.0000 /begin FUNCTION_LIST TPU_Interface /end FUNCTION_LIST /end CHARACTERISTIC
/begin CHARACTERISTIC K_NW_CONFIG "Konfigurationsparameter fuer NW-Synchronisation" VALUE 0x610AD TKW_VV_VV_UB 100.0 FORMULA_0223 0.0 255.0 /begin FUNCTION_LIST TPU_Interface /end FUNCTION_LIST /end CHARACTERISTIC
/begin CHARACTERISTIC K_NW_IO "Anzahl NW-Impulse fuer erneute NW-Synchronisation" VALUE 0x610AE TKW_VV_VV_UB 100.0 FORMULA_0008 0.0 255.0000 /begin FUNCTION_LIST TPU_Interface /end FUNCTION_LIST /end CHARACTERISTIC
/begin CHARACTERISTIC K_NW_MFMIN_1of2_ "Untergrenze NW-Messfenster" VALUE 0x610B0 TKW_VV_VV_UB 100.0 FORMULA_0008 0.0 255.0000 /begin FUNCTION_LIST TPU_Interface /end FUNCTION_LIST /end CHARACTERISTIC
/begin CHARACTERISTIC K_NW_MFMIN_2of2_ "Untergrenze NW-Messfenster" VALUE 0x610B1 TKW_VV_VV_UB 100.0 FORMULA_0008 0.0 255.0000 /begin FUNCTION_LIST TPU_Interface /end FUNCTION_LIST /end CHARACTERISTIC
/begin CHARACTERISTIC K_NW_MFMAX_1of2_ "Obergrenze NW-Messfenster" VALUE 0x610B4 TKW_VV_VV_UB 100.0 FORMULA_0008 0.0 255.0000 /begin FUNCTION_LIST TPU_Interface /end FUNCTION_LIST /end CHARACTERISTIC
/begin CHARACTERISTIC K_NW_MFMAX_2of2_ "Obergrenze NW-Messfenster" VALUE 0x610B5 TKW_VV_VV_UB 100.0 FORMULA_0008 0.0 255.0000 /begin FUNCTION_LIST TPU_Interface /end FUNCTION_LIST /end CHARACTERISTIC
/begin CHARACTERISTIC K_NW_NIO "Schwelle fehlende/falsche NW-Impulse fuer NW-Desynchronisation" VALUE 0x610B6 TKW_VV_VV_UB 100.0 FORMULA_0008 0.0 255.0000 /begin FUNCTION_LIST TPU_Interface /end FUNCTION_LIST /end CHARACTERISTIC
/begin MEASUREMENT tpu_st "Status TPU Synchronisation Einspritzprozessor" UBYTE FORMULA_0220 0 0 0.0 255.0 ECU_ADDRESS 0x3FA7AC /begin FUNCTION_LIST TPU_Interface /end FUNCTION_LIST /end MEASUREMENT
/begin MEASUREMENT tpub_st "Status TPU-B Synchronisation Einspritzprozessor" UBYTE FORMULA_0220 0 0 0.0 255.0 ECU_ADDRESS 0x3FBE70 /begin FUNCTION_LIST TPU_Interface /end FUNCTION_LIST /end MEASUREMENT
/begin MEASUREMENT tpu_zyl "aktueller Zylinder" UBYTE FORMULA_0008 0 0 0.0 12.0000 ECU_ADDRESS 0x3FBE71 /begin FUNCTION_LIST TPU_Interface /end FUNCTION_LIST /end MEASUREMENT
/begin MEASUREMENT tpu_zyl_p2 "zwei Zylinder in der Zukunft" UBYTE FORMULA_0008 0 0 0.0 12.0000 ECU_ADDRESS 0x3FBE72 /begin FUNCTION_LIST TPU_Interface /end FUNCTION_LIST /end MEASUREMENT
/begin MEASUREMENT tpu_index "Segmentindex fuer den Gesamtmotor" UBYTE FORMULA_0008 0 0 0.0 12.0000 ECU_ADDRESS 0x3FBE73 /begin FUNCTION_LIST TPU_Interface /end FUNCTION_LIST /end MEASUREMENT
/begin MEASUREMENT tpua_index "Segmentindex fuer TPU-A" UBYTE FORMULA_0008 0 0 0.0 12.0000 ECU_ADDRESS 0x3FBE74 /begin FUNCTION_LIST TPU_Interface /end FUNCTION_LIST /end MEASUREMENT
/begin MEASUREMENT tpub_index "Segmentindex fuer TPU-B" UBYTE FORMULA_0008 0 0 0.0 12.0000 ECU_ADDRESS 0x3FBE75 /begin FUNCTION_LIST TPU_Interface /end FUNCTION_LIST /end MEASUREMENT
/begin MEASUREMENT tpu_irqzahn_inj "Zahnnummer TPU Interrupt" UBYTE FORMULA_0008 0 0 0.0 255.0000 ECU_ADDRESS 0x3FBE76 /begin FUNCTION_LIST TPU_Interface /end FUNCTION_LIST /end MEASUREMENT
/begin MEASUREMENT tpub_irqzahn_inj "Zahnnummer TPU-B Interrupt" UBYTE FORMULA_0008 0 0 0.0 255.0000 ECU_ADDRESS 0x3FBE77 /begin FUNCTION_LIST TPU_Interface /end FUNCTION_LIST /end MEASUREMENT
/begin MEASUREMENT tpu_irqz_inj "TPU Interruptzaehler" UWORD FORMULA_0000 0 0 0.0 65535.0000 ECU_ADDRESS 0x3FBE78 /begin FUNCTION_LIST TPU_Interface /end FUNCTION_LIST /end MEASUREMENT
/begin MEASUREMENT tpub_irqz_inj "TPU-B Interruptzaehler" UWORD FORMULA_0000 0 0 0.0 65535.0000 ECU_ADDRESS 0x3FBE7A /begin FUNCTION_LIST TPU_Interface /end FUNCTION_LIST /end MEASUREMENT
/begin MEASUREMENT tpu_irqart_inj "Art des TPU Interrupt" UBYTE FORMULA_0221 0 0 0.0 255.0 ECU_ADDRESS 0x3FBE7C /begin FUNCTION_LIST TPU_Interface /end FUNCTION_LIST /end MEASUREMENT
/begin MEASUREMENT tpub_irqart_inj "Art des TPU-B Interrupt" UBYTE FORMULA_0221 0 0 0.0 255.0 ECU_ADDRESS 0x3FBE7D /begin FUNCTION_LIST TPU_Interface /end FUNCTION_LIST /end MEASUREMENT
/begin MEASUREMENT tpu_error_count "Anzahl Fehlerinterrupts der TPU" UWORD FORMULA_0000 0 0 0.0 65535.0000 ECU_ADDRESS 0x3FBE7E /begin FUNCTION_LIST TPU_Interface /end FUNCTION_LIST /end MEASUREMENT
/begin MEASUREMENT tpub_error_count "Anzahl Fehlerinterrupts der TPU-B" UWORD FORMULA_0000 0 0 0.0 65535.0000 ECU_ADDRESS 0x3FBE80 /begin FUNCTION_LIST TPU_Interface /end FUNCTION_LIST /end MEASUREMENT
/begin MEASUREMENT tpu_bsirq_count "Anzahl Segmentinterrupts der TPU" UWORD FORMULA_0000 0 0 0.0 65535.0000 ECU_ADDRESS 0x3FBE82 /begin FUNCTION_LIST TPU_Interface /end FUNCTION_LIST /end MEASUREMENT
/begin MEASUREMENT tpub_bsirq_count "Anzahl Segmentinterrupts der TPU-B" UWORD FORMULA_0000 0 0 0.0 65535.0000 ECU_ADDRESS 0x3FBE84 /begin FUNCTION_LIST TPU_Interface /end FUNCTION_LIST /end MEASUREMENT
/begin MEASUREMENT tpu_nw_pos_1of2_ "Position des NW-Impulses" UBYTE FORMULA_0008 0 0 0.0 255.0000 ECU_ADDRESS 0x3FBE88 /begin FUNCTION_LIST TPU_Interface /end FUNCTION_LIST /end MEASUREMENT
/begin MEASUREMENT tpu_nw_pos_2of2_ "Position des NW-Impulses" UBYTE FORMULA_0008 0 0 0.0 255.0000 ECU_ADDRESS 0x3FBE89 /begin FUNCTION_LIST TPU_Interface /end FUNCTION_LIST /end MEASUREMENT
/begin MEASUREMENT nw_zaehler "Nockenwellenzaehler" ULONG FORMULA_0001 0 0 0.0 2147483647.0000 ECU_ADDRESS 0x3FBE8C /begin FUNCTION_LIST TPU_Interface /end FUNCTION_LIST /end MEASUREMENT
/begin MEASUREMENT nw_st "Synchronisationsstatus Nockenwelle" UBYTE FORMULA_0222 0 0 0.0 255.0 ECU_ADDRESS 0x3FBE90 /begin FUNCTION_LIST TPU_Interface /end FUNCTION_LIST /end MEASUREMENT
/begin MEASUREMENT nw1_ed "Diagnosestatus Nockenwellensynchronisation Geber 1" UWORD FORMULA_0000 0 0 0.0 65535.0000 ECU_ADDRESS 0x3FBE92 /begin FUNCTION_LIST TPU_Interface /end FUNCTION_LIST /end MEASUREMENT
/begin MEASUREMENT nw2_ed "Diagnosestatus Nockenwellensynchronisation Geber 2" UWORD FORMULA_0000 0 0 0.0 65535.0000 ECU_ADDRESS 0x3FBE94 /begin FUNCTION_LIST TPU_Interface /end FUNCTION_LIST /end MEASUREMENT
/* ------------------ Abschnitt erzeugt aus vanos.dat ------------------ */
/begin CHARACTERISTIC K_VAN_BEGR_AB_FAKT "Abregelzeit Fruehbegrenzung" VALUE 0x610B8 TKW_VV_VV_UB 100.0 FORMULA_0233 164.0000 0.6431 /begin FUNCTION_LIST Vanos /end FUNCTION_LIST /end CHARACTERISTIC
/begin CHARACTERISTIC K_VAN_CFG_E1 "Konfig Vanos Steller/Geberrad" VALUE 0x610BC TKW_VV_VV_UB 100.0 FORMULA_0234 0.0 255.0 /begin FUNCTION_LIST Vanos /end FUNCTION_LIST /end CHARACTERISTIC
/begin CHARACTERISTIC K_VAN_CFG_A1 "Konfig Vanos Steller/Geberrad" VALUE 0x610BD TKW_VV_VV_UB 100.0 FORMULA_0234 0.0 255.0 /begin FUNCTION_LIST Vanos /end FUNCTION_LIST /end CHARACTERISTIC
/begin CHARACTERISTIC K_VAN_CFG_E2 "Konfig Vanos Steller/Geberrad" VALUE 0x610BE TKW_VV_VV_UB 100.0 FORMULA_0234 0.0 255.0 /begin FUNCTION_LIST Vanos /end FUNCTION_LIST /end CHARACTERISTIC
/begin CHARACTERISTIC K_VAN_CFG_A2 "Konfig Vanos Steller/Geberrad" VALUE 0x610BF TKW_VV_VV_UB 100.0 FORMULA_0234 0.0 255.0 /begin FUNCTION_LIST Vanos /end FUNCTION_LIST /end CHARACTERISTIC
/begin CHARACTERISTIC K_VAN_KATH_AB_Einlass "Katheizen Abregelzeit" VALUE 0x610C0 TKW_VV_VV_SW 100.0 FORMULA_0235 164.0000 0.0100 /begin FUNCTION_LIST Vanos /end FUNCTION_LIST FORMAT "%5.2" /end CHARACTERISTIC
/begin CHARACTERISTIC K_VAN_KATH_AB_Auslass "Katheizen Abregelzeit" VALUE 0x610C2 TKW_VV_VV_SW 100.0 FORMULA_0235 164.0000 0.0100 /begin FUNCTION_LIST Vanos /end FUNCTION_LIST FORMAT "%5.2" /end CHARACTERISTIC
/begin CHARACTERISTIC K_VAN_KATH_AUF_Einlass "Katheizen Aufregelzeit" VALUE 0x610C4 TKW_VV_VV_SW 100.0 FORMULA_0235 164.0000 0.0100 /begin FUNCTION_LIST Vanos /end FUNCTION_LIST FORMAT "%5.2" /end CHARACTERISTIC
/begin CHARACTERISTIC K_VAN_KATH_AUF_Auslass "Katheizen Aufregelzeit" VALUE 0x610C6 TKW_VV_VV_SW 100.0 FORMULA_0235 164.0000 0.0100 /begin FUNCTION_LIST Vanos /end FUNCTION_LIST FORMAT "%5.2" /end CHARACTERISTIC
/begin CHARACTERISTIC K_VAN_FREQU "PWM-Frequenz Vanos Ansteuerung" VALUE 0x610C8 TKW_VV_VV_UW 100.0 FORMULA_0236 1000000.0000 15.2590 /begin FUNCTION_LIST Vanos /end FUNCTION_LIST FORMAT "%4.1" /end CHARACTERISTIC
/begin CHARACTERISTIC K_VAN_INVERT_E1 "Vanos Regler Invert" VALUE 0x610CC TKW_VV_VV_UB 100.0 FORMULA_0237 0.0 255.0 /begin FUNCTION_LIST Vanos /end FUNCTION_LIST /end CHARACTERISTIC
/begin CHARACTERISTIC K_VAN_INVERT_A1 "Vanos Regler Invert" VALUE 0x610CD TKW_VV_VV_UB 100.0 FORMULA_0237 0.0 255.0 /begin FUNCTION_LIST Vanos /end FUNCTION_LIST /end CHARACTERISTIC
/begin CHARACTERISTIC K_VAN_INVERT_E2 "Vanos Regler Invert" VALUE 0x610CE TKW_VV_VV_UB 100.0 FORMULA_0237 0.0 255.0 /begin FUNCTION_LIST Vanos /end FUNCTION_LIST /end CHARACTERISTIC
/begin CHARACTERISTIC K_VAN_INVERT_A2 "Vanos Regler Invert" VALUE 0x610CF TKW_VV_VV_UB 100.0 FORMULA_0237 0.0 255.0 /begin FUNCTION_LIST Vanos /end FUNCTION_LIST /end CHARACTERISTIC
/begin CHARACTERISTIC K_VAN_KW_SPR_MAX_E1 "KW-Zahn bei max Spreizung" VALUE 0x610D0 TKW_VV_VV_SB 100.0 FORMULA_0238 -60.0000 60.0000 /begin FUNCTION_LIST Vanos /end FUNCTION_LIST /end CHARACTERISTIC
/begin CHARACTERISTIC K_VAN_KW_SPR_MAX_A1 "KW-Zahn bei max Spreizung" VALUE 0x610D1 TKW_VV_VV_SB 100.0 FORMULA_0238 -60.0000 60.0000 /begin FUNCTION_LIST Vanos /end FUNCTION_LIST /end CHARACTERISTIC
/begin CHARACTERISTIC K_VAN_KW_SPR_MAX_E2 "KW-Zahn bei max Spreizung" VALUE 0x610D2 TKW_VV_VV_SB 100.0 FORMULA_0238 -60.0000 60.0000 /begin FUNCTION_LIST Vanos /end FUNCTION_LIST /end CHARACTERISTIC
/begin CHARACTERISTIC K_VAN_KW_SPR_MAX_A2 "KW-Zahn bei max Spreizung" VALUE 0x610D3 TKW_VV_VV_SB 100.0 FORMULA_0238 -60.0000 60.0000 /begin FUNCTION_LIST Vanos /end FUNCTION_LIST /end CHARACTERISTIC
/begin CHARACTERISTIC K_VAN_N_OFFSET_MAX_A "AVanos n korr tabg max" VALUE 0x610D4 TKW_VV_VV_SW 100.0 FORMULA_0011 0.0 10000.0000 /begin FUNCTION_LIST Vanos /end FUNCTION_LIST /end CHARACTERISTIC
/begin CHARACTERISTIC K_VAN_N_OFFSET_MIN_A "AVanos n korr tabg min" VALUE 0x610D6 TKW_VV_VV_SW 100.0 FORMULA_0011 0.0 10000.0000 /begin FUNCTION_LIST Vanos /end FUNCTION_LIST /end CHARACTERISTIC
/begin CHARACTERISTIC K_VAN_RAD_CFG "Auslass-Geberrad Geometrie" VALUE 0x610DC TKW_VV_VV_UB 100.0 FORMULA_0239 0.0 255.0 /begin FUNCTION_LIST Vanos /end FUNCTION_LIST /end CHARACTERISTIC
/begin CHARACTERISTIC K_VAN_SPR_MAX_Einlass "Maximale Spreizung am Anschlag" VALUE 0x610E2 TKW_VV_VV_SW 100.0 FORMULA_0188 50.0000 160.0000 /begin FUNCTION_LIST Vanos /end FUNCTION_LIST FORMAT "%4.1" /end CHARACTERISTIC
/begin CHARACTERISTIC K_VAN_SPR_MAX_Auslass "Maximale Spreizung am Anschlag" VALUE 0x610E4 TKW_VV_VV_SW 100.0 FORMULA_0188 50.0000 160.0000 /begin FUNCTION_LIST Vanos /end FUNCTION_LIST FORMAT "%4.1" /end CHARACTERISTIC
/begin CHARACTERISTIC K_VAN_SPR_OFFSET_E1 "KW-Zahnflanke zu max Spreizung" VALUE 0x610E6 TKW_VV_VV_SW 100.0 FORMULA_0188 -80.0000 80.0000 /begin FUNCTION_LIST Vanos /end FUNCTION_LIST FORMAT "%4.1" /end CHARACTERISTIC
/begin CHARACTERISTIC K_VAN_SPR_OFFSET_A1 "KW-Zahnflanke zu max Spreizung" VALUE 0x610E8 TKW_VV_VV_SW 100.0 FORMULA_0188 -80.0000 80.0000 /begin FUNCTION_LIST Vanos /end FUNCTION_LIST FORMAT "%4.1" /end CHARACTERISTIC
/begin CHARACTERISTIC K_VAN_SPR_OFFSET_E2 "KW-Zahnflanke zu max Spreizung" VALUE 0x610EA TKW_VV_VV_SW 100.0 FORMULA_0188 -80.0000 80.0000 /begin FUNCTION_LIST Vanos /end FUNCTION_LIST FORMAT "%4.1" /end CHARACTERISTIC
/begin CHARACTERISTIC K_VAN_SPR_OFFSET_A2 "KW-Zahnflanke zu max Spreizung" VALUE 0x610EC TKW_VV_VV_SW 100.0 FORMULA_0188 -80.0000 80.0000 /begin FUNCTION_LIST Vanos /end FUNCTION_LIST FORMAT "%4.1" /end CHARACTERISTIC
/begin CHARACTERISTIC K_VAN_SOLL_ABSTELL_Einlass "Sollpos nach KL15 aus" VALUE 0x610EE TKW_VV_VV_SW 100.0 FORMULA_0188 50.0000 160.0000 /begin FUNCTION_LIST Vanos /end FUNCTION_LIST FORMAT "%4.1" /end CHARACTERISTIC
/begin CHARACTERISTIC K_VAN_SOLL_ABSTELL_Auslass "Sollpos nach KL15 aus" VALUE 0x610F0 TKW_VV_VV_SW 100.0 FORMULA_0188 50.0000 160.0000 /begin FUNCTION_LIST Vanos /end FUNCTION_LIST FORMAT "%4.1" /end CHARACTERISTIC
/begin CHARACTERISTIC K_VAN_SOLL_ERSATZ_Einlass "Soll-Ersatzwert" VALUE 0x610FA TKW_VV_VV_SW 100.0 FORMULA_0188 50.0000 160.0000 /begin FUNCTION_LIST Vanos /end FUNCTION_LIST FORMAT "%4.1" /end CHARACTERISTIC
/begin CHARACTERISTIC K_VAN_SOLL_ERSATZ_Auslass "Soll-Ersatzwert" VALUE 0x610FC TKW_VV_VV_SW 100.0 FORMULA_0188 50.0000 160.0000 /begin FUNCTION_LIST Vanos /end FUNCTION_LIST FORMAT "%4.1" /end CHARACTERISTIC
/begin CHARACTERISTIC K_VAN_SOLL_MAX_Einlass "max. Sollwert" VALUE 0x610FE TKW_VV_VV_SW 100.0 FORMULA_0188 50.0000 160.0000 /begin FUNCTION_LIST Vanos /end FUNCTION_LIST FORMAT "%4.1" /end CHARACTERISTIC
/begin CHARACTERISTIC K_VAN_SOLL_MAX_Auslass "max. Sollwert" VALUE 0x61100 TKW_VV_VV_SW 100.0 FORMULA_0188 50.0000 160.0000 /begin FUNCTION_LIST Vanos /end FUNCTION_LIST FORMAT "%4.1" /end CHARACTERISTIC
/begin CHARACTERISTIC K_VAN_SOLL_MIN_Einlass "min. Sollwert" VALUE 0x61102 TKW_VV_VV_SW 100.0 FORMULA_0188 50.0000 160.0000 /begin FUNCTION_LIST Vanos /end FUNCTION_LIST FORMAT "%4.1" /end CHARACTERISTIC
/begin CHARACTERISTIC K_VAN_SOLL_MIN_Auslass "min. Sollwert" VALUE 0x61104 TKW_VV_VV_SW 100.0 FORMULA_0188 50.0000 160.0000 /begin FUNCTION_LIST Vanos /end FUNCTION_LIST FORMAT "%4.1" /end CHARACTERISTIC
/begin CHARACTERISTIC K_VAN_SOLL_OFFSET_Einlass "Sollpositionsoffset" VALUE 0x61106 TKW_VV_VV_SW 100.0 FORMULA_0188 -80.0000 80.0000 /begin FUNCTION_LIST Vanos /end FUNCTION_LIST FORMAT "%4.1" /end CHARACTERISTIC
/begin CHARACTERISTIC K_VAN_SOLL_OFFSET_Auslass "Sollpositionsoffset" VALUE 0x61108 TKW_VV_VV_SW 100.0 FORMULA_0188 -80.0000 80.0000 /begin FUNCTION_LIST Vanos /end FUNCTION_LIST FORMAT "%4.1" /end CHARACTERISTIC
/begin CHARACTERISTIC K_VAN_SZ_Einlass "Steuerzeit Nockenwelle" VALUE 0x6110A TKW_VV_VV_SW 100.0 FORMULA_0188 -80.0000 350.0000 /begin FUNCTION_LIST Vanos /end FUNCTION_LIST FORMAT "%4.1" /end CHARACTERISTIC
/begin CHARACTERISTIC K_VAN_SZ_Auslass "Steuerzeit Nockenwelle" VALUE 0x6110C TKW_VV_VV_SW 100.0 FORMULA_0188 -80.0000 350.0000 /begin FUNCTION_LIST Vanos /end FUNCTION_LIST FORMAT "%4.1" /end CHARACTERISTIC
/begin CHARACTERISTIC K_VAN_TMOT_BEGR "Temp.-Schwelle Frühbegrenzung" VALUE 0x61110 TKW_VV_VV_SW 100.0 FORMULA_0019 -50.0000 150.0000 /begin FUNCTION_LIST Vanos /end FUNCTION_LIST FORMAT "%4.1" /end CHARACTERISTIC
/begin CHARACTERISTIC K_VAN_TV_I_MAX_Einlass "Regler I Anteil Maxwert" VALUE 0x61114 TKW_VV_VV_SW 100.0 FORMULA_0231 0.0 100.0000 /begin FUNCTION_LIST Vanos /end FUNCTION_LIST FORMAT "%4.1" /end CHARACTERISTIC
/begin CHARACTERISTIC K_VAN_TV_I_MAX_Auslass "Regler I Anteil Maxwert" VALUE 0x61116 TKW_VV_VV_SW 100.0 FORMULA_0231 0.0 100.0000 /begin FUNCTION_LIST Vanos /end FUNCTION_LIST FORMAT "%4.1" /end CHARACTERISTIC
/begin CHARACTERISTIC K_VAN_TV_I_MIN_Einlass "Regler I Anteil Minwert" VALUE 0x61118 TKW_VV_VV_SW 100.0 FORMULA_0231 0.0 100.0000 /begin FUNCTION_LIST Vanos /end FUNCTION_LIST FORMAT "%4.1" /end CHARACTERISTIC
/begin CHARACTERISTIC K_VAN_TV_I_MIN_Auslass "Regler I Anteil Minwert" VALUE 0x6111A TKW_VV_VV_SW 100.0 FORMULA_0231 0.0 100.0000 /begin FUNCTION_LIST Vanos /end FUNCTION_LIST FORMAT "%4.1" /end CHARACTERISTIC
/begin CHARACTERISTIC K_VAN_TV_MAX_Einlass "max. Ventil Tastverhaeltnis" VALUE 0x6111C TKW_VV_VV_SW 100.0 FORMULA_0231 0.0 100.0000 /begin FUNCTION_LIST Vanos /end FUNCTION_LIST FORMAT "%4.1" /end CHARACTERISTIC
/begin CHARACTERISTIC K_VAN_TV_MAX_Auslass "max. Ventil Tastverhaeltnis" VALUE 0x6111E TKW_VV_VV_SW 100.0 FORMULA_0231 0.0 100.0000 /begin FUNCTION_LIST Vanos /end FUNCTION_LIST FORMAT "%4.1" /end CHARACTERISTIC
/begin CHARACTERISTIC K_VAN_TV_MIN_Einlass "min. Ventil Tastverhaeltnis" VALUE 0x61120 TKW_VV_VV_SW 100.0 FORMULA_0231 0.0 100.0000 /begin FUNCTION_LIST Vanos /end FUNCTION_LIST FORMAT "%4.1" /end CHARACTERISTIC
/begin CHARACTERISTIC K_VAN_TV_MIN_Auslass "min. Ventil Tastverhaeltnis" VALUE 0x61122 TKW_VV_VV_SW 100.0 FORMULA_0231 0.0 100.0000 /begin FUNCTION_LIST Vanos /end FUNCTION_LIST FORMAT "%4.1" /end CHARACTERISTIC
/begin CHARACTERISTIC K_VAN_UNL_N_MIN_Einlass "min n bei von selbst entriegelt" VALUE 0x61124 TKW_VV_VV_SW 100.0 FORMULA_0011 0.0 10000.0000 /begin FUNCTION_LIST Vanos /end FUNCTION_LIST /end CHARACTERISTIC
/begin CHARACTERISTIC K_VAN_UNL_N_MIN_Auslass "min n bei von selbst entriegelt" VALUE 0x61126 TKW_VV_VV_SW 100.0 FORMULA_0011 0.0 10000.0000 /begin FUNCTION_LIST Vanos /end FUNCTION_LIST /end CHARACTERISTIC
/begin CHARACTERISTIC K_VAN_UNLOCK_SPR_Einlass "Pos ab der entriegelt sein muss" VALUE 0x61128 TKW_VV_VV_SW 100.0 FORMULA_0188 50.0000 160.0000 /begin FUNCTION_LIST Vanos /end FUNCTION_LIST FORMAT "%4.1" /end CHARACTERISTIC
/begin CHARACTERISTIC K_VAN_UNLOCK_SPR_Auslass "Pos ab der entriegelt sein muss" VALUE 0x6112A TKW_VV_VV_SW 100.0 FORMULA_0188 50.0000 160.0000 /begin FUNCTION_LIST Vanos /end FUNCTION_LIST FORMAT "%4.1" /end CHARACTERISTIC
/begin CHARACTERISTIC K_VAN_UNL_D_TV_Einlass "Startwert Delta zum I-Anteil" VALUE 0x6112C TKW_VV_VV_SW 100.0 FORMULA_0231 -100.0000 100.0000 /begin FUNCTION_LIST Vanos /end FUNCTION_LIST FORMAT "%4.1" /end CHARACTERISTIC
/begin CHARACTERISTIC K_VAN_UNL_D_TV_Auslass "Startwert Delta zum I-Anteil" VALUE 0x6112E TKW_VV_VV_SW 100.0 FORMULA_0231 -100.0000 100.0000 /begin FUNCTION_LIST Vanos /end FUNCTION_LIST FORMAT "%4.1" /end CHARACTERISTIC
/begin CHARACTERISTIC K_VAN_UNL_TV_DYN_Einlass "max. Dynamik TV zum Entriegeln" VALUE 0x61130 TKW_VV_VV_SW 100.0 FORMULA_0240 0.0 100.0000 /begin FUNCTION_LIST Vanos /end FUNCTION_LIST FORMAT "%4.1" /end CHARACTERISTIC
/begin CHARACTERISTIC K_VAN_UNL_TV_DYN_Auslass "max. Dynamik TV zum Entriegeln" VALUE 0x61132 TKW_VV_VV_SW 100.0 FORMULA_0240 0.0 100.0000 /begin FUNCTION_LIST Vanos /end FUNCTION_LIST FORMAT "%4.1" /end CHARACTERISTIC
/begin CHARACTERISTIC K_VAN_XD_REG_MIN "Min Abweichung Regler ungefilt" VALUE 0x61138 TKW_VV_VV_SW 100.0 FORMULA_0188 -80.0000 80.0000 /begin FUNCTION_LIST Vanos /end FUNCTION_LIST FORMAT "%4.1" /end CHARACTERISTIC
/begin CHARACTERISTIC KL_VAN_KI_A "Regler I Faktor" CURVE 0x6113A TKL_SW_VV_SW 100.0 FORMULA_0224 -48.8281 48.8266 /begin FUNCTION_LIST Vanos /end FUNCTION_LIST
 /begin AXIS_DESCR STD_AXIS van_xd FORMULA_0188 5 -80.0000 80.0000 FORMAT "%4.1" /end AXIS_DESCR
 FORMAT "%5.2" /end CHARACTERISTIC
/begin CHARACTERISTIC KL_VAN_KI_E "Regler I Faktor" CURVE 0x61150 TKL_SW_VV_SW 100.0 FORMULA_0224 -48.8281 48.8266 /begin FUNCTION_LIST Vanos /end FUNCTION_LIST
 /begin AXIS_DESCR STD_AXIS van_xd FORMULA_0188 5 -80.0000 80.0000 FORMAT "%4.1" /end AXIS_DESCR
 FORMAT "%5.2" /end CHARACTERISTIC
/begin CHARACTERISTIC KL_VAN_KP_A "Regler P Faktor" CURVE 0x61166 TKL_SW_VV_SW 100.0 FORMULA_0225 -125.0000 124.9961 /begin FUNCTION_LIST Vanos /end FUNCTION_LIST
 /begin AXIS_DESCR STD_AXIS van_xd FORMULA_0188 5 -80.0000 80.0000 FORMAT "%4.1" /end AXIS_DESCR
 FORMAT "%5.2" /end CHARACTERISTIC
/begin CHARACTERISTIC KL_VAN_KP_E "Regler P Faktor" CURVE 0x6117C TKL_SW_VV_SW 100.0 FORMULA_0225 -125.0000 124.9961 /begin FUNCTION_LIST Vanos /end FUNCTION_LIST
 /begin AXIS_DESCR STD_AXIS van_xd FORMULA_0188 5 -80.0000 80.0000 FORMAT "%4.1" /end AXIS_DESCR
 FORMAT "%5.2" /end CHARACTERISTIC
/begin CHARACTERISTIC KL_VAN_KP_KORR_TOEL "Korrektur P Faktor" CURVE 0x61192 TKL_SW_VV_SW 100.0 FORMULA_0226 0.0 1.9990 /begin FUNCTION_LIST Vanos /end FUNCTION_LIST
 /begin AXIS_DESCR STD_AXIS toel FORMULA_0019 5 -50.0000 150.0000 FORMAT "%4.1" /end AXIS_DESCR
 FORMAT "%7.4" /end CHARACTERISTIC
/begin CHARACTERISTIC KL_VAN_SOLL_BEGR "EVAN Fruehbegrenzung Kaltstart" CURVE 0x611A8 TKL_SW_VV_SW 100.0 FORMULA_0188 -80.0000 80.0000 /begin FUNCTION_LIST Vanos /end FUNCTION_LIST /begin AXIS_DESCR STD_AXIS n FORMULA_0011 5 0.0 10000.0000 /end AXIS_DESCR FORMAT "%4.1" /end CHARACTERISTIC
/begin CHARACTERISTIC KL_VAN_T_SOLL_BEGR "Fruehbegrenzungsdauer Kaltstart" CURVE 0x611BE TKL_SW_VV_SW 100.0 FORMULA_0241 -327.6800 327.6700 /begin FUNCTION_LIST Vanos /end FUNCTION_LIST
 /begin AXIS_DESCR STD_AXIS tan FORMULA_0019 6 -50.0000 150.0000 FORMAT "%4.1" /end AXIS_DESCR
/end CHARACTERISTIC
/begin CHARACTERISTIC KL_VAN_TV_I_INIT_A1 "Initialwert I_Regler" CURVE 0x611D8 TKL_SW_VV_SW 100.0 FORMULA_0231 0.0 100.0000 /begin FUNCTION_LIST Vanos /end FUNCTION_LIST
 /begin AXIS_DESCR STD_AXIS tmot FORMULA_0019 5 -50.0000 150.0000 FORMAT "%4.1" /end AXIS_DESCR
 FORMAT "%4.1" /end CHARACTERISTIC
/begin CHARACTERISTIC KL_VAN_TV_I_INIT_A2 "Initialwert I_Regler" CURVE 0x611EE TKL_SW_VV_SW 100.0 FORMULA_0231 0.0 100.0000 /begin FUNCTION_LIST Vanos /end FUNCTION_LIST
 /begin AXIS_DESCR STD_AXIS tmot FORMULA_0019 5 -50.0000 150.0000 FORMAT "%4.1" /end AXIS_DESCR
 FORMAT "%4.1" /end CHARACTERISTIC
/begin CHARACTERISTIC KL_VAN_TV_I_INIT_E1 "Initialwert I_Regler" CURVE 0x61204 TKL_SW_VV_SW 100.0 FORMULA_0231 0.0 100.0000 /begin FUNCTION_LIST Vanos /end FUNCTION_LIST
 /begin AXIS_DESCR STD_AXIS tmot FORMULA_0019 5 -50.0000 150.0000 FORMAT "%4.1" /end AXIS_DESCR
 FORMAT "%4.1" /end CHARACTERISTIC
/begin CHARACTERISTIC KL_VAN_TV_I_INIT_E2 "Initialwert I_Regler" CURVE 0x6121A TKL_SW_VV_SW 100.0 FORMULA_0231 0.0 100.0000 /begin FUNCTION_LIST Vanos /end FUNCTION_LIST
 /begin AXIS_DESCR STD_AXIS tmot FORMULA_0019 5 -50.0000 150.0000 FORMAT "%4.1" /end AXIS_DESCR
 FORMAT "%4.1" /end CHARACTERISTIC
/begin CHARACTERISTIC KL_VAN_TV_KORR_UB "Ub- Korrektur Tastverhaeltnis" CURVE 0x61230 TKL_SW_VV_SW 100.0 FORMULA_0226 0.0 1.9990 /begin FUNCTION_LIST Vanos /end FUNCTION_LIST /begin AXIS_DESCR STD_AXIS ub FORMULA_0045 5 0.0 28.0000 FORMAT "%4.1" /end AXIS_DESCR FORMAT "%7.4" /end CHARACTERISTIC
/begin CHARACTERISTIC KF_VAN_SOLL_A "Grundkennfeld Vanos Sollwert" MAP 0x61246 TKF_SW_SW_SW 100.0 FORMULA_0188 50.0000 160.0000 /begin FUNCTION_LIST Vanos /end FUNCTION_LIST /begin AXIS_DESCR STD_AXIS n FORMULA_0011 16 0.0 10000.0000 /end AXIS_DESCR
 /begin AXIS_DESCR STD_AXIS dr_rel_1of2_ FORMULA_0020 12 0.0 199.9938 FORMAT "%5.2" /end AXIS_DESCR
 FORMAT "%4.1" /end CHARACTERISTIC
/begin CHARACTERISTIC KF_VAN_SOLL_E "Grundkennfeld Vanos Sollwert" MAP 0x61400 TKF_SW_SW_SW 100.0 FORMULA_0188 50.0000 160.0000 /begin FUNCTION_LIST Vanos /end FUNCTION_LIST /begin AXIS_DESCR STD_AXIS n FORMULA_0011 16 0.0 10000.0000 /end AXIS_DESCR
 /begin AXIS_DESCR STD_AXIS dr_rel_1of2_ FORMULA_0020 12 0.0 199.9938 FORMAT "%5.2" /end AXIS_DESCR
 FORMAT "%4.1" /end CHARACTERISTIC
/begin CHARACTERISTIC KF_VAN_SOLL_KATH_A "Katheizkennfeld Vanos Sollwert" MAP 0x615BA TKF_SW_SW_SW 100.0 FORMULA_0188 50.0000 160.0000 /begin FUNCTION_LIST Vanos /end FUNCTION_LIST /begin AXIS_DESCR STD_AXIS n FORMULA_0011 16 0.0 10000.0000 /end AXIS_DESCR
 /begin AXIS_DESCR STD_AXIS dr_rel_1of2_ FORMULA_0020 12 0.0 199.9938 FORMAT "%5.2" /end AXIS_DESCR
 FORMAT "%4.1" /end CHARACTERISTIC
/begin CHARACTERISTIC KF_VAN_SOLL_KATH_E "Katheizkennfeld Vanos Sollwert" MAP 0x61774 TKF_SW_SW_SW 100.0 FORMULA_0188 50.0000 160.0000 /begin FUNCTION_LIST Vanos /end FUNCTION_LIST /begin AXIS_DESCR STD_AXIS n FORMULA_0011 16 0.0 10000.0000 /end AXIS_DESCR
 /begin AXIS_DESCR STD_AXIS dr_rel_1of2_ FORMULA_0020 12 0.0 199.9938 FORMAT "%5.2" /end AXIS_DESCR
 FORMAT "%4.1" /end CHARACTERISTIC
/begin CHARACTERISTIC KF_VAN_SOLL_DMAX_A "Aenderungsbegrenzung Sollwert" MAP 0x6192E TKF_SW_SW_SW 100.0 FORMULA_0227 -80.0000 80.0000 /begin FUNCTION_LIST Vanos /end FUNCTION_LIST /begin AXIS_DESCR STD_AXIS n FORMULA_0011 6 0.0 10000.0000 /end AXIS_DESCR
 /begin AXIS_DESCR STD_AXIS dr_rel_1of2_ FORMULA_0020 6 0.0 199.9938 FORMAT "%5.2" /end AXIS_DESCR
 FORMAT "%4.1" /end CHARACTERISTIC
/begin CHARACTERISTIC KF_VAN_SOLL_DMAX_E "Aenderungsbegrenzung Sollwert" MAP 0x61990 TKF_SW_SW_SW 100.0 FORMULA_0227 -80.0000 80.0000 /begin FUNCTION_LIST Vanos /end FUNCTION_LIST /begin AXIS_DESCR STD_AXIS n FORMULA_0011 6 0.0 10000.0000 /end AXIS_DESCR
 /begin AXIS_DESCR STD_AXIS dr_rel_1of2_ FORMULA_0020 6 0.0 199.9938 FORMAT "%5.2" /end AXIS_DESCR
 FORMAT "%4.1" /end CHARACTERISTIC
/begin MEASUREMENT van_begr_faktor "Gewichtungsfaktor Fruehbegr." SWORD FORMULA_0004 0 0 0.0 1.9999 ECU_ADDRESS 0x3FBEA0 /begin FUNCTION_LIST Vanos /end FUNCTION_LIST /end MEASUREMENT
/begin MEASUREMENT van_ed_hall_E1 "Hallgeberstatus" UWORD FORMULA_0017 0 0 0.0 111.0 ECU_ADDRESS 0x3FBEA2 /begin FUNCTION_LIST Vanos /end FUNCTION_LIST BIT_MASK 0x6F /end MEASUREMENT
/begin MEASUREMENT van_ed_hall_A1 "Hallgeberstatus" UWORD FORMULA_0017 0 0 0.0 111.0 ECU_ADDRESS 0x3FBEA4 /begin FUNCTION_LIST Vanos /end FUNCTION_LIST BIT_MASK 0x6F /end MEASUREMENT
/begin MEASUREMENT van_ed_hall_E2 "Hallgeberstatus" UWORD FORMULA_0017 0 0 0.0 111.0 ECU_ADDRESS 0x3FBEA6 /begin FUNCTION_LIST Vanos /end FUNCTION_LIST BIT_MASK 0x6F /end MEASUREMENT
/begin MEASUREMENT van_ed_hall_A2 "Hallgeberstatus" UWORD FORMULA_0017 0 0 0.0 111.0 ECU_ADDRESS 0x3FBEA8 /begin FUNCTION_LIST Vanos /end FUNCTION_LIST BIT_MASK 0x6F /end MEASUREMENT
/begin MEASUREMENT van_fpos_E1 "Feinposition" SWORD FORMULA_0188 0 0 -80.0000 80.0000 ECU_ADDRESS 0x3FBEBC /begin FUNCTION_LIST Vanos /end FUNCTION_LIST /end MEASUREMENT
/begin MEASUREMENT van_fpos_A1 "Feinposition" SWORD FORMULA_0188 0 0 -80.0000 80.0000 ECU_ADDRESS 0x3FBEBE /begin FUNCTION_LIST Vanos /end FUNCTION_LIST /end MEASUREMENT
/begin MEASUREMENT van_fpos_E2 "Feinposition" SWORD FORMULA_0188 0 0 -80.0000 80.0000 ECU_ADDRESS 0x3FBEC0 /begin FUNCTION_LIST Vanos /end FUNCTION_LIST /end MEASUREMENT
/begin MEASUREMENT van_fpos_A2 "Feinposition" SWORD FORMULA_0188 0 0 -80.0000 80.0000 ECU_ADDRESS 0x3FBEC2 /begin FUNCTION_LIST Vanos /end FUNCTION_LIST /end MEASUREMENT
/begin MEASUREMENT van_gpos_E1 "Grobposition" SWORD FORMULA_0188 0 0 -80.0000 80.0000 ECU_ADDRESS 0x3FBEC4 /begin FUNCTION_LIST Vanos /end FUNCTION_LIST /end MEASUREMENT
/begin MEASUREMENT van_gpos_A1 "Grobposition" SWORD FORMULA_0188 0 0 -80.0000 80.0000 ECU_ADDRESS 0x3FBEC6 /begin FUNCTION_LIST Vanos /end FUNCTION_LIST /end MEASUREMENT
/begin MEASUREMENT van_gpos_E2 "Grobposition" SWORD FORMULA_0188 0 0 -80.0000 80.0000 ECU_ADDRESS 0x3FBEC8 /begin FUNCTION_LIST Vanos /end FUNCTION_LIST /end MEASUREMENT
/begin MEASUREMENT van_gpos_A2 "Grobposition" SWORD FORMULA_0188 0 0 -80.0000 80.0000 ECU_ADDRESS 0x3FBECA /begin FUNCTION_LIST Vanos /end FUNCTION_LIST /end MEASUREMENT
/begin MEASUREMENT van_imp_cnt_E1 "Impulszahler fuer Abriss-Erkennung" SBYTE FORMULA_0008 0 0 0.0 7.0000 ECU_ADDRESS 0x3FBECC /begin FUNCTION_LIST Vanos /end FUNCTION_LIST /end MEASUREMENT
/begin MEASUREMENT van_imp_cnt_A1 "Impulszahler fuer Abriss-Erkennung" SBYTE FORMULA_0008 0 0 0.0 7.0000 ECU_ADDRESS 0x3FBECD /begin FUNCTION_LIST Vanos /end FUNCTION_LIST /end MEASUREMENT
/begin MEASUREMENT van_imp_cnt_E2 "Impulszahler fuer Abriss-Erkennung" SBYTE FORMULA_0008 0 0 0.0 7.0000 ECU_ADDRESS 0x3FBECE /begin FUNCTION_LIST Vanos /end FUNCTION_LIST /end MEASUREMENT
/begin MEASUREMENT van_imp_cnt_A2 "Impulszahler fuer Abriss-Erkennung" SBYTE FORMULA_0008 0 0 0.0 7.0000 ECU_ADDRESS 0x3FBECF /begin FUNCTION_LIST Vanos /end FUNCTION_LIST /end MEASUREMENT
/begin MEASUREMENT van_ist_E1 "Istposition" SWORD FORMULA_0188 0 0 50.0000 160.0000 ECU_ADDRESS 0x3FBED0 /begin FUNCTION_LIST Vanos /end FUNCTION_LIST /end MEASUREMENT
/begin MEASUREMENT van_ist_A1 "Istposition" SWORD FORMULA_0188 0 0 50.0000 160.0000 ECU_ADDRESS 0x3FBED2 /begin FUNCTION_LIST Vanos /end FUNCTION_LIST /end MEASUREMENT
/begin MEASUREMENT van_ist_E2 "Istposition" SWORD FORMULA_0188 0 0 50.0000 160.0000 ECU_ADDRESS 0x3FBED4 /begin FUNCTION_LIST Vanos /end FUNCTION_LIST /end MEASUREMENT
/begin MEASUREMENT van_ist_A2 "Istposition" SWORD FORMULA_0188 0 0 50.0000 160.0000 ECU_ADDRESS 0x3FBED6 /begin FUNCTION_LIST Vanos /end FUNCTION_LIST /end MEASUREMENT
/begin MEASUREMENT van_ist_oeff_E1 "Ventil Oeffnen vor ZOT" SWORD FORMULA_0188 0 0 -80.0000 80.0000 ECU_ADDRESS 0x3FBED8 /begin FUNCTION_LIST Vanos /end FUNCTION_LIST /end MEASUREMENT
/begin MEASUREMENT van_ist_oeff_A1 "Ventil Oeffnen vor ZOT" SWORD FORMULA_0188 0 0 -80.0000 80.0000 ECU_ADDRESS 0x3FBEDA /begin FUNCTION_LIST Vanos /end FUNCTION_LIST /end MEASUREMENT
/begin MEASUREMENT van_ist_oeff_E2 "Ventil Oeffnen vor ZOT" SWORD FORMULA_0188 0 0 -80.0000 80.0000 ECU_ADDRESS 0x3FBEDC /begin FUNCTION_LIST Vanos /end FUNCTION_LIST /end MEASUREMENT
/begin MEASUREMENT van_ist_oeff_A2 "Ventil Oeffnen vor ZOT" SWORD FORMULA_0188 0 0 -80.0000 80.0000 ECU_ADDRESS 0x3FBEDE /begin FUNCTION_LIST Vanos /end FUNCTION_LIST /end MEASUREMENT
/begin MEASUREMENT van_ist_filt_E1 "gefilterte Istposition" SWORD FORMULA_0188 0 0 50.0000 160.0000 ECU_ADDRESS 0x3FBEE8 /begin FUNCTION_LIST Vanos /end FUNCTION_LIST /end MEASUREMENT
/begin MEASUREMENT van_ist_filt_A1 "gefilterte Istposition" SWORD FORMULA_0188 0 0 50.0000 160.0000 ECU_ADDRESS 0x3FBEEA /begin FUNCTION_LIST Vanos /end FUNCTION_LIST /end MEASUREMENT
/begin MEASUREMENT van_ist_filt_E2 "gefilterte Istposition" SWORD FORMULA_0188 0 0 50.0000 160.0000 ECU_ADDRESS 0x3FBEEC /begin FUNCTION_LIST Vanos /end FUNCTION_LIST /end MEASUREMENT
/begin MEASUREMENT van_ist_filt_A2 "gefilterte Istposition" SWORD FORMULA_0188 0 0 50.0000 160.0000 ECU_ADDRESS 0x3FBEEE /begin FUNCTION_LIST Vanos /end FUNCTION_LIST /end MEASUREMENT
/begin MEASUREMENT van_ist_pos_1of4_1of7_ "Istposition Ringspeicher" SWORD FORMULA_0188 0 0 50.0000 160.0000 ECU_ADDRESS 0x3FBEF0 /begin FUNCTION_LIST Vanos /end FUNCTION_LIST /end MEASUREMENT
/begin MEASUREMENT van_ist_pos_1of4_2of7_ "Istposition Ringspeicher" SWORD FORMULA_0188 0 0 50.0000 160.0000 ECU_ADDRESS 0x3FBEF2 /begin FUNCTION_LIST Vanos /end FUNCTION_LIST /end MEASUREMENT
/begin MEASUREMENT van_ist_pos_1of4_3of7_ "Istposition Ringspeicher" SWORD FORMULA_0188 0 0 50.0000 160.0000 ECU_ADDRESS 0x3FBEF4 /begin FUNCTION_LIST Vanos /end FUNCTION_LIST /end MEASUREMENT
/begin MEASUREMENT van_ist_pos_1of4_4of7_ "Istposition Ringspeicher" SWORD FORMULA_0188 0 0 50.0000 160.0000 ECU_ADDRESS 0x3FBEF6 /begin FUNCTION_LIST Vanos /end FUNCTION_LIST /end MEASUREMENT
/begin MEASUREMENT van_ist_pos_1of4_5of7_ "Istposition Ringspeicher" SWORD FORMULA_0188 0 0 50.0000 160.0000 ECU_ADDRESS 0x3FBEF8 /begin FUNCTION_LIST Vanos /end FUNCTION_LIST /end MEASUREMENT
/begin MEASUREMENT van_ist_pos_1of4_6of7_ "Istposition Ringspeicher" SWORD FORMULA_0188 0 0 50.0000 160.0000 ECU_ADDRESS 0x3FBEFA /begin FUNCTION_LIST Vanos /end FUNCTION_LIST /end MEASUREMENT
/begin MEASUREMENT van_ist_pos_1of4_7of7_ "Istposition Ringspeicher" SWORD FORMULA_0188 0 0 50.0000 160.0000 ECU_ADDRESS 0x3FBEFC /begin FUNCTION_LIST Vanos /end FUNCTION_LIST /end MEASUREMENT
/begin MEASUREMENT van_ist_pos_2of4_1of7_ "Istposition Ringspeicher" SWORD FORMULA_0188 0 0 50.0000 160.0000 ECU_ADDRESS 0x3FBEFE /begin FUNCTION_LIST Vanos /end FUNCTION_LIST /end MEASUREMENT
/begin MEASUREMENT van_ist_pos_2of4_2of7_ "Istposition Ringspeicher" SWORD FORMULA_0188 0 0 50.0000 160.0000 ECU_ADDRESS 0x3FBF00 /begin FUNCTION_LIST Vanos /end FUNCTION_LIST /end MEASUREMENT
/begin MEASUREMENT van_ist_pos_2of4_3of7_ "Istposition Ringspeicher" SWORD FORMULA_0188 0 0 50.0000 160.0000 ECU_ADDRESS 0x3FBF02 /begin FUNCTION_LIST Vanos /end FUNCTION_LIST /end MEASUREMENT
/begin MEASUREMENT van_ist_pos_2of4_4of7_ "Istposition Ringspeicher" SWORD FORMULA_0188 0 0 50.0000 160.0000 ECU_ADDRESS 0x3FBF04 /begin FUNCTION_LIST Vanos /end FUNCTION_LIST /end MEASUREMENT
/begin MEASUREMENT van_ist_pos_2of4_5of7_ "Istposition Ringspeicher" SWORD FORMULA_0188 0 0 50.0000 160.0000 ECU_ADDRESS 0x3FBF06 /begin FUNCTION_LIST Vanos /end FUNCTION_LIST /end MEASUREMENT
/begin MEASUREMENT van_ist_pos_2of4_6of7_ "Istposition Ringspeicher" SWORD FORMULA_0188 0 0 50.0000 160.0000 ECU_ADDRESS 0x3FBF08 /begin FUNCTION_LIST Vanos /end FUNCTION_LIST /end MEASUREMENT
/begin MEASUREMENT van_ist_pos_2of4_7of7_ "Istposition Ringspeicher" SWORD FORMULA_0188 0 0 50.0000 160.0000 ECU_ADDRESS 0x3FBF0A /begin FUNCTION_LIST Vanos /end FUNCTION_LIST /end MEASUREMENT
/begin MEASUREMENT van_ist_pos_3of4_1of7_ "Istposition Ringspeicher" SWORD FORMULA_0188 0 0 50.0000 160.0000 ECU_ADDRESS 0x3FBF0C /begin FUNCTION_LIST Vanos /end FUNCTION_LIST /end MEASUREMENT
/begin MEASUREMENT van_ist_pos_3of4_2of7_ "Istposition Ringspeicher" SWORD FORMULA_0188 0 0 50.0000 160.0000 ECU_ADDRESS 0x3FBF0E /begin FUNCTION_LIST Vanos /end FUNCTION_LIST /end MEASUREMENT
/begin MEASUREMENT van_ist_pos_3of4_3of7_ "Istposition Ringspeicher" SWORD FORMULA_0188 0 0 50.0000 160.0000 ECU_ADDRESS 0x3FBF10 /begin FUNCTION_LIST Vanos /end FUNCTION_LIST /end MEASUREMENT
/begin MEASUREMENT van_ist_pos_3of4_4of7_ "Istposition Ringspeicher" SWORD FORMULA_0188 0 0 50.0000 160.0000 ECU_ADDRESS 0x3FBF12 /begin FUNCTION_LIST Vanos /end FUNCTION_LIST /end MEASUREMENT
/begin MEASUREMENT van_ist_pos_3of4_5of7_ "Istposition Ringspeicher" SWORD FORMULA_0188 0 0 50.0000 160.0000 ECU_ADDRESS 0x3FBF14 /begin FUNCTION_LIST Vanos /end FUNCTION_LIST /end MEASUREMENT
/begin MEASUREMENT van_ist_pos_3of4_6of7_ "Istposition Ringspeicher" SWORD FORMULA_0188 0 0 50.0000 160.0000 ECU_ADDRESS 0x3FBF16 /begin FUNCTION_LIST Vanos /end FUNCTION_LIST /end MEASUREMENT
/begin MEASUREMENT van_ist_pos_3of4_7of7_ "Istposition Ringspeicher" SWORD FORMULA_0188 0 0 50.0000 160.0000 ECU_ADDRESS 0x3FBF18 /begin FUNCTION_LIST Vanos /end FUNCTION_LIST /end MEASUREMENT
/begin MEASUREMENT van_ist_pos_4of4_1of7_ "Istposition Ringspeicher" SWORD FORMULA_0188 0 0 50.0000 160.0000 ECU_ADDRESS 0x3FBF1A /begin FUNCTION_LIST Vanos /end FUNCTION_LIST /end MEASUREMENT
/begin MEASUREMENT van_ist_pos_4of4_2of7_ "Istposition Ringspeicher" SWORD FORMULA_0188 0 0 50.0000 160.0000 ECU_ADDRESS 0x3FBF1C /begin FUNCTION_LIST Vanos /end FUNCTION_LIST /end MEASUREMENT
/begin MEASUREMENT van_ist_pos_4of4_3of7_ "Istposition Ringspeicher" SWORD FORMULA_0188 0 0 50.0000 160.0000 ECU_ADDRESS 0x3FBF1E /begin FUNCTION_LIST Vanos /end FUNCTION_LIST /end MEASUREMENT
/begin MEASUREMENT van_ist_pos_4of4_4of7_ "Istposition Ringspeicher" SWORD FORMULA_0188 0 0 50.0000 160.0000 ECU_ADDRESS 0x3FBF20 /begin FUNCTION_LIST Vanos /end FUNCTION_LIST /end MEASUREMENT
/begin MEASUREMENT van_ist_pos_4of4_5of7_ "Istposition Ringspeicher" SWORD FORMULA_0188 0 0 50.0000 160.0000 ECU_ADDRESS 0x3FBF22 /begin FUNCTION_LIST Vanos /end FUNCTION_LIST /end MEASUREMENT
/begin MEASUREMENT van_ist_pos_4of4_6of7_ "Istposition Ringspeicher" SWORD FORMULA_0188 0 0 50.0000 160.0000 ECU_ADDRESS 0x3FBF24 /begin FUNCTION_LIST Vanos /end FUNCTION_LIST /end MEASUREMENT
/begin MEASUREMENT van_ist_pos_4of4_7of7_ "Istposition Ringspeicher" SWORD FORMULA_0188 0 0 50.0000 160.0000 ECU_ADDRESS 0x3FBF26 /begin FUNCTION_LIST Vanos /end FUNCTION_LIST /end MEASUREMENT
/begin MEASUREMENT van_ist_schl_E1 "Ventil Schliessen vor ZOT" SWORD FORMULA_0188 0 0 -80.0000 550.0000 ECU_ADDRESS 0x3FBF28 /begin FUNCTION_LIST Vanos /end FUNCTION_LIST /end MEASUREMENT
/begin MEASUREMENT van_ist_schl_A1 "Ventil Schliessen vor ZOT" SWORD FORMULA_0188 0 0 -80.0000 550.0000 ECU_ADDRESS 0x3FBF2A /begin FUNCTION_LIST Vanos /end FUNCTION_LIST /end MEASUREMENT
/begin MEASUREMENT van_ist_schl_E2 "Ventil Schliessen vor ZOT" SWORD FORMULA_0188 0 0 -80.0000 550.0000 ECU_ADDRESS 0x3FBF2C /begin FUNCTION_LIST Vanos /end FUNCTION_LIST /end MEASUREMENT
/begin MEASUREMENT van_ist_schl_A2 "Ventil Schliessen vor ZOT" SWORD FORMULA_0188 0 0 -80.0000 550.0000 ECU_ADDRESS 0x3FBF2E /begin FUNCTION_LIST Vanos /end FUNCTION_LIST /end MEASUREMENT
/begin MEASUREMENT van_kath_dauer "Katheizdauer" UWORD FORMULA_0156 0 0 0.0 65535.0000 ECU_ADDRESS 0x3FBF30 /begin FUNCTION_LIST Vanos /end FUNCTION_LIST /end MEASUREMENT
/begin MEASUREMENT van_kath_faktor_Einlass "Gewichtungsfaktor Katheizen" SWORD FORMULA_0004 0 0 0.0 1.0000 ECU_ADDRESS 0x3FBF32 /begin FUNCTION_LIST Vanos /end FUNCTION_LIST /end MEASUREMENT
/begin MEASUREMENT van_kath_faktor_Auslass "Gewichtungsfaktor Katheizen" SWORD FORMULA_0004 0 0 0.0 1.0000 ECU_ADDRESS 0x3FBF34 /begin FUNCTION_LIST Vanos /end FUNCTION_LIST /end MEASUREMENT
/begin MEASUREMENT van_ki_E1 "Vanos-Regler I-Faktor" SWORD FORMULA_0224 0 0 -48.8281 48.8266 ECU_ADDRESS 0x3FBF36 /begin FUNCTION_LIST Vanos /end FUNCTION_LIST /end MEASUREMENT
/begin MEASUREMENT van_ki_A1 "Vanos-Regler I-Faktor" SWORD FORMULA_0224 0 0 -48.8281 48.8266 ECU_ADDRESS 0x3FBF38 /begin FUNCTION_LIST Vanos /end FUNCTION_LIST /end MEASUREMENT
/begin MEASUREMENT van_ki_E2 "Vanos-Regler I-Faktor" SWORD FORMULA_0224 0 0 -48.8281 48.8266 ECU_ADDRESS 0x3FBF3A /begin FUNCTION_LIST Vanos /end FUNCTION_LIST /end MEASUREMENT
/begin MEASUREMENT van_ki_A2 "Vanos-Regler I-Faktor" SWORD FORMULA_0224 0 0 -48.8281 48.8266 ECU_ADDRESS 0x3FBF3C /begin FUNCTION_LIST Vanos /end FUNCTION_LIST /end MEASUREMENT
/begin MEASUREMENT van_kp_E1 "Vanos-Regler P-Faktor" SWORD FORMULA_0225 0 0 -125.0000 124.9961 ECU_ADDRESS 0x3FBF3E /begin FUNCTION_LIST Vanos /end FUNCTION_LIST /end MEASUREMENT
/begin MEASUREMENT van_kp_A1 "Vanos-Regler P-Faktor" SWORD FORMULA_0225 0 0 -125.0000 124.9961 ECU_ADDRESS 0x3FBF40 /begin FUNCTION_LIST Vanos /end FUNCTION_LIST /end MEASUREMENT
/begin MEASUREMENT van_kp_E2 "Vanos-Regler P-Faktor" SWORD FORMULA_0225 0 0 -125.0000 124.9961 ECU_ADDRESS 0x3FBF42 /begin FUNCTION_LIST Vanos /end FUNCTION_LIST /end MEASUREMENT
/begin MEASUREMENT van_kp_A2 "Vanos-Regler P-Faktor" SWORD FORMULA_0225 0 0 -125.0000 124.9961 ECU_ADDRESS 0x3FBF44 /begin FUNCTION_LIST Vanos /end FUNCTION_LIST /end MEASUREMENT
/begin MEASUREMENT van_kp_korr_toel "Toel-Verstaerkungskorrektur" UWORD FORMULA_0226 0 0 0.0 2.0000 ECU_ADDRESS 0x3FBF46 /begin FUNCTION_LIST Vanos /end FUNCTION_LIST /end MEASUREMENT
/begin MEASUREMENT van_n_korr_a_1of2_ "n * tabg_lw_verh_wurzel" SWORD FORMULA_0011 0 0 0.0 10000.0000 ECU_ADDRESS 0x3FBF48 /begin FUNCTION_LIST Vanos /end FUNCTION_LIST /end MEASUREMENT
/begin MEASUREMENT van_n_korr_a_2of2_ "n * tabg_lw_verh_wurzel" SWORD FORMULA_0011 0 0 0.0 10000.0000 ECU_ADDRESS 0x3FBF4A /begin FUNCTION_LIST Vanos /end FUNCTION_LIST /end MEASUREMENT
/begin MEASUREMENT van_soll_E1 "Sollwert" SWORD FORMULA_0188 0 0 50.0000 160.0000 ECU_ADDRESS 0x3FBF4C /begin FUNCTION_LIST Vanos /end FUNCTION_LIST /end MEASUREMENT
/begin MEASUREMENT van_soll_A1 "Sollwert" SWORD FORMULA_0188 0 0 50.0000 160.0000 ECU_ADDRESS 0x3FBF4E /begin FUNCTION_LIST Vanos /end FUNCTION_LIST /end MEASUREMENT
/begin MEASUREMENT van_soll_E2 "Sollwert" SWORD FORMULA_0188 0 0 50.0000 160.0000 ECU_ADDRESS 0x3FBF50 /begin FUNCTION_LIST Vanos /end FUNCTION_LIST /end MEASUREMENT
/begin MEASUREMENT van_soll_A2 "Sollwert" SWORD FORMULA_0188 0 0 50.0000 160.0000 ECU_ADDRESS 0x3FBF52 /begin FUNCTION_LIST Vanos /end FUNCTION_LIST /end MEASUREMENT
/begin MEASUREMENT van_soll_dmax_E1 "max. Sollwertaenderung" SWORD FORMULA_0227 0 0 0.0 80.0000 ECU_ADDRESS 0x3FBF54 /begin FUNCTION_LIST Vanos /end FUNCTION_LIST /end MEASUREMENT
/begin MEASUREMENT van_soll_dmax_A1 "max. Sollwertaenderung" SWORD FORMULA_0227 0 0 0.0 80.0000 ECU_ADDRESS 0x3FBF56 /begin FUNCTION_LIST Vanos /end FUNCTION_LIST /end MEASUREMENT
/begin MEASUREMENT van_soll_dmax_E2 "max. Sollwertaenderung" SWORD FORMULA_0227 0 0 0.0 80.0000 ECU_ADDRESS 0x3FBF58 /begin FUNCTION_LIST Vanos /end FUNCTION_LIST /end MEASUREMENT
/begin MEASUREMENT van_soll_dmax_A2 "max. Sollwertaenderung" SWORD FORMULA_0227 0 0 0.0 80.0000 ECU_ADDRESS 0x3FBF5A /begin FUNCTION_LIST Vanos /end FUNCTION_LIST /end MEASUREMENT
/begin MEASUREMENT van_soll_ds2_E1 "Sollwert v. DS2" SWORD FORMULA_0188 0 0 50.0000 160.0000 ECU_ADDRESS 0x3FBF5C /begin FUNCTION_LIST Vanos /end FUNCTION_LIST /end MEASUREMENT
/begin MEASUREMENT van_soll_ds2_A1 "Sollwert v. DS2" SWORD FORMULA_0188 0 0 50.0000 160.0000 ECU_ADDRESS 0x3FBF5E /begin FUNCTION_LIST Vanos /end FUNCTION_LIST /end MEASUREMENT
/begin MEASUREMENT van_soll_ds2_E2 "Sollwert v. DS2" SWORD FORMULA_0188 0 0 50.0000 160.0000 ECU_ADDRESS 0x3FBF60 /begin FUNCTION_LIST Vanos /end FUNCTION_LIST /end MEASUREMENT
/begin MEASUREMENT van_soll_ds2_A2 "Sollwert v. DS2" SWORD FORMULA_0188 0 0 50.0000 160.0000 ECU_ADDRESS 0x3FBF62 /begin FUNCTION_LIST Vanos /end FUNCTION_LIST /end MEASUREMENT
/begin MEASUREMENT van_st_E1 "Status Vanos" UBYTE FORMULA_0008 0 0 0.0 255.0000 ECU_ADDRESS 0x3FBF64 /begin FUNCTION_LIST Vanos /end FUNCTION_LIST /end MEASUREMENT
/begin MEASUREMENT van_st_A1 "Status Vanos" UBYTE FORMULA_0008 0 0 0.0 255.0000 ECU_ADDRESS 0x3FBF65 /begin FUNCTION_LIST Vanos /end FUNCTION_LIST /end MEASUREMENT
/begin MEASUREMENT van_st_E2 "Status Vanos" UBYTE FORMULA_0008 0 0 0.0 255.0000 ECU_ADDRESS 0x3FBF66 /begin FUNCTION_LIST Vanos /end FUNCTION_LIST /end MEASUREMENT
/begin MEASUREMENT van_st_A2 "Status Vanos" UBYTE FORMULA_0008 0 0 0.0 255.0000 ECU_ADDRESS 0x3FBF67 /begin FUNCTION_LIST Vanos /end FUNCTION_LIST /end MEASUREMENT
/begin MEASUREMENT van_st_geber_E1 "Geberstatus" UBYTE FORMULA_0228 0 0 0.0 255.0 ECU_ADDRESS 0x3FBF6C /begin FUNCTION_LIST Vanos /end FUNCTION_LIST /end MEASUREMENT
/begin MEASUREMENT van_st_geber_A1 "Geberstatus" UBYTE FORMULA_0228 0 0 0.0 255.0 ECU_ADDRESS 0x3FBF6D /begin FUNCTION_LIST Vanos /end FUNCTION_LIST /end MEASUREMENT
/begin MEASUREMENT van_st_geber_E2 "Geberstatus" UBYTE FORMULA_0228 0 0 0.0 255.0 ECU_ADDRESS 0x3FBF6E /begin FUNCTION_LIST Vanos /end FUNCTION_LIST /end MEASUREMENT
/begin MEASUREMENT van_st_geber_A2 "Geberstatus" UBYTE FORMULA_0228 0 0 0.0 255.0 ECU_ADDRESS 0x3FBF6F /begin FUNCTION_LIST Vanos /end FUNCTION_LIST /end MEASUREMENT
/begin MEASUREMENT van_st_unlock_E1 "Entriegelungs-Status" UBYTE FORMULA_0229 0 0 0.0 255.0 ECU_ADDRESS 0x3FBF70 /begin FUNCTION_LIST Vanos /end FUNCTION_LIST /end MEASUREMENT
/begin MEASUREMENT van_st_unlock_A1 "Entriegelungs-Status" UBYTE FORMULA_0229 0 0 0.0 255.0 ECU_ADDRESS 0x3FBF71 /begin FUNCTION_LIST Vanos /end FUNCTION_LIST /end MEASUREMENT
/begin MEASUREMENT van_st_unlock_E2 "Entriegelungs-Status" UBYTE FORMULA_0229 0 0 0.0 255.0 ECU_ADDRESS 0x3FBF72 /begin FUNCTION_LIST Vanos /end FUNCTION_LIST /end MEASUREMENT
/begin MEASUREMENT van_st_unlock_A2 "Entriegelungs-Status" UBYTE FORMULA_0229 0 0 0.0 255.0 ECU_ADDRESS 0x3FBF73 /begin FUNCTION_LIST Vanos /end FUNCTION_LIST /end MEASUREMENT
/begin MEASUREMENT van_t_soll_begr "Dauer Sollwert Fruehbegrenzung" UWORD FORMULA_0230 0 0 0.0 655.3500 ECU_ADDRESS 0x3FBF80 /begin FUNCTION_LIST Vanos /end FUNCTION_LIST /end MEASUREMENT
/begin MEASUREMENT van_tv_E1 "Ventil Tastverhaeltnis" SWORD FORMULA_0231 0 0 0.0 100.0000 ECU_ADDRESS 0x3FBF92 /begin FUNCTION_LIST Vanos /end FUNCTION_LIST /end MEASUREMENT
/begin MEASUREMENT van_tv_A1 "Ventil Tastverhaeltnis" SWORD FORMULA_0231 0 0 0.0 100.0000 ECU_ADDRESS 0x3FBF94 /begin FUNCTION_LIST Vanos /end FUNCTION_LIST /end MEASUREMENT
/begin MEASUREMENT van_tv_E2 "Ventil Tastverhaeltnis" SWORD FORMULA_0231 0 0 0.0 100.0000 ECU_ADDRESS 0x3FBF96 /begin FUNCTION_LIST Vanos /end FUNCTION_LIST /end MEASUREMENT
/begin MEASUREMENT van_tv_A2 "Ventil Tastverhaeltnis" SWORD FORMULA_0231 0 0 0.0 100.0000 ECU_ADDRESS 0x3FBF98 /begin FUNCTION_LIST Vanos /end FUNCTION_LIST /end MEASUREMENT
/begin MEASUREMENT van_tv_i_E1 "Regler I Anteil" SLONG FORMULA_0232 0 0 0.0 100.0000 ECU_ADDRESS 0x3FBF9C /begin FUNCTION_LIST Vanos /end FUNCTION_LIST /end MEASUREMENT
/begin MEASUREMENT van_tv_i_A1 "Regler I Anteil" SLONG FORMULA_0232 0 0 0.0 100.0000 ECU_ADDRESS 0x3FBFA0 /begin FUNCTION_LIST Vanos /end FUNCTION_LIST /end MEASUREMENT
/begin MEASUREMENT van_tv_i_E2 "Regler I Anteil" SLONG FORMULA_0232 0 0 0.0 100.0000 ECU_ADDRESS 0x3FBFA4 /begin FUNCTION_LIST Vanos /end FUNCTION_LIST /end MEASUREMENT
/begin MEASUREMENT van_tv_i_A2 "Regler I Anteil" SLONG FORMULA_0232 0 0 0.0 100.0000 ECU_ADDRESS 0x3FBFA8 /begin FUNCTION_LIST Vanos /end FUNCTION_LIST /end MEASUREMENT
/begin MEASUREMENT van_tv_korr_ub "Faktor" SWORD FORMULA_0226 0 0 -2.0000 1.9990 ECU_ADDRESS 0x3FBFAC /begin FUNCTION_LIST Vanos /end FUNCTION_LIST /end MEASUREMENT
/begin MEASUREMENT van_tv_p_E1 "Regler P-Anteil" SWORD FORMULA_0231 0 0 -100.0000 100.0000 ECU_ADDRESS 0x3FBFAE /begin FUNCTION_LIST Vanos /end FUNCTION_LIST /end MEASUREMENT
/begin MEASUREMENT van_tv_p_A1 "Regler P-Anteil" SWORD FORMULA_0231 0 0 -100.0000 100.0000 ECU_ADDRESS 0x3FBFB0 /begin FUNCTION_LIST Vanos /end FUNCTION_LIST /end MEASUREMENT
/begin MEASUREMENT van_tv_p_E2 "Regler P-Anteil" SWORD FORMULA_0231 0 0 -100.0000 100.0000 ECU_ADDRESS 0x3FBFB2 /begin FUNCTION_LIST Vanos /end FUNCTION_LIST /end MEASUREMENT
/begin MEASUREMENT van_tv_p_A2 "Regler P-Anteil" SWORD FORMULA_0231 0 0 -100.0000 100.0000 ECU_ADDRESS 0x3FBFB4 /begin FUNCTION_LIST Vanos /end FUNCTION_LIST /end MEASUREMENT
/begin MEASUREMENT van_vo_filt_b1 "Ventil_Ueberschneidung" SWORD FORMULA_0188 0 0 -80.0000 80.0000 ECU_ADDRESS 0x3FBFB6 /begin FUNCTION_LIST Vanos /end FUNCTION_LIST /end MEASUREMENT
/begin MEASUREMENT van_vo_filt_b2 "Ventil_Ueberschneidung" SWORD FORMULA_0188 0 0 -80.0000 80.0000 ECU_ADDRESS 0x3FBFB8 /begin FUNCTION_LIST Vanos /end FUNCTION_LIST /end MEASUREMENT
/begin MEASUREMENT van_xd_E1 "Regeldifferenz" SWORD FORMULA_0188 0 0 -80.0000 80.0000 ECU_ADDRESS 0x3FBFBA /begin FUNCTION_LIST Vanos /end FUNCTION_LIST /end MEASUREMENT
/begin MEASUREMENT van_xd_A1 "Regeldifferenz" SWORD FORMULA_0188 0 0 -80.0000 80.0000 ECU_ADDRESS 0x3FBFBC /begin FUNCTION_LIST Vanos /end FUNCTION_LIST /end MEASUREMENT
/begin MEASUREMENT van_xd_E2 "Regeldifferenz" SWORD FORMULA_0188 0 0 -80.0000 80.0000 ECU_ADDRESS 0x3FBFBE /begin FUNCTION_LIST Vanos /end FUNCTION_LIST /end MEASUREMENT
/begin MEASUREMENT van_xd_A2 "Regeldifferenz" SWORD FORMULA_0188 0 0 -80.0000 80.0000 ECU_ADDRESS 0x3FBFC0 /begin FUNCTION_LIST Vanos /end FUNCTION_LIST /end MEASUREMENT
/begin MEASUREMENT van_xd_filt_E1 "Gefilterte Regeldifferenz" SWORD FORMULA_0188 0 0 -80.0000 80.0000 ECU_ADDRESS 0x3FBFC2 /begin FUNCTION_LIST Vanos /end FUNCTION_LIST /end MEASUREMENT
/begin MEASUREMENT van_xd_filt_A1 "Gefilterte Regeldifferenz" SWORD FORMULA_0188 0 0 -80.0000 80.0000 ECU_ADDRESS 0x3FBFC4 /begin FUNCTION_LIST Vanos /end FUNCTION_LIST /end MEASUREMENT
/begin MEASUREMENT van_xd_filt_E2 "Gefilterte Regeldifferenz" SWORD FORMULA_0188 0 0 -80.0000 80.0000 ECU_ADDRESS 0x3FBFC6 /begin FUNCTION_LIST Vanos /end FUNCTION_LIST /end MEASUREMENT
/begin MEASUREMENT van_xd_filt_A2 "Gefilterte Regeldifferenz" SWORD FORMULA_0188 0 0 -80.0000 80.0000 ECU_ADDRESS 0x3FBFC8 /begin FUNCTION_LIST Vanos /end FUNCTION_LIST /end MEASUREMENT
/begin MEASUREMENT van_zahn_cnt_E1 "Zahnzaehler fuer n-Messung" SBYTE FORMULA_0008 0 0 0.0 6.0000 ECU_ADDRESS 0x3FBFCC /begin FUNCTION_LIST Vanos /end FUNCTION_LIST /end MEASUREMENT
/begin MEASUREMENT van_zahn_cnt_A1 "Zahnzaehler fuer n-Messung" SBYTE FORMULA_0008 0 0 0.0 6.0000 ECU_ADDRESS 0x3FBFCD /begin FUNCTION_LIST Vanos /end FUNCTION_LIST /end MEASUREMENT
/begin MEASUREMENT van_zahn_ctr5ms_E1 "5ms-Ctr bei letzten Zahn" SWORD FORMULA_0000 0 0 0.0 6.0000 ECU_ADDRESS 0x3FBFCE /begin FUNCTION_LIST Vanos /end FUNCTION_LIST /end MEASUREMENT
/begin MEASUREMENT van_zahn_ctr5ms_A1 "5ms-Ctr bei letzten Zahn" SWORD FORMULA_0000 0 0 0.0 6.0000 ECU_ADDRESS 0x3FBFD0 /begin FUNCTION_LIST Vanos /end FUNCTION_LIST /end MEASUREMENT
/begin MEASUREMENT n_van_E1 "Einlass Nockenwellen-Drehzahl" SWORD FORMULA_0011 0 0 0.0 10000.0000 ECU_ADDRESS 0x3FBFD2 /begin FUNCTION_LIST Vanos /end FUNCTION_LIST /end MEASUREMENT
/begin MEASUREMENT n_van_A1 "Einlass Nockenwellen-Drehzahl" SWORD FORMULA_0011 0 0 0.0 10000.0000 ECU_ADDRESS 0x3FBFD4 /begin FUNCTION_LIST Vanos /end FUNCTION_LIST /end MEASUREMENT
/* ------------------ Abschnitt erzeugt aus wf.dat ------------------ */
/begin CHARACTERISTIC K_WF_SOLL_START_PSAU_CFG "Schaler f. realen o. appl. PSAU" VALUE 0x619F2 TKW_VV_VV_UB 100.0 FORMULA_0008 0.0 1.0000 /begin FUNCTION_LIST Wandfilm /end FUNCTION_LIST /end CHARACTERISTIC
/begin CHARACTERISTIC K_WF_SOLL_START_PSAU "appl. PSAU-Wert im Start" VALUE 0x619F4 TKW_VV_VV_SW 100.0 FORMULA_0031 0.0 2000.0000 /begin FUNCTION_LIST Wandfilm /end FUNCTION_LIST FORMAT "%4.1" /end CHARACTERISTIC
/begin CHARACTERISTIC K_WF_MKS_AUS_HYS "Hysterese f. WF-Deaktivierung" VALUE 0x619F6 TKW_VV_VV_UW 100.0 FORMULA_0086 0.0 2000.0000 /begin FUNCTION_LIST Wandfilm /end FUNCTION_LIST FORMAT "%5.2" /end CHARACTERISTIC
/begin CHARACTERISTIC K_WF_ASP_START "Anzahl ASP im START" VALUE 0x619F8 TKW_VV_VV_UW 100.0 FORMULA_0243 0.0 1279.0000 /begin FUNCTION_LIST Wandfilm /end FUNCTION_LIST /end CHARACTERISTIC
/begin CHARACTERISTIC KL_WF_DMKS_T1_MS "Abdampfzeitkonstante bei stehenden Motor" CURVE 0x619FA TKL_SW_VV_UW 100.0 FORMULA_0156 0.0 65535.0000 /begin FUNCTION_LIST Wandfilm /end FUNCTION_LIST
 /begin AXIS_DESCR STD_AXIS tsgrw FORMULA_0019 5 -50.0000 150.0000 FORMAT "%4.1" /end AXIS_DESCR
/end CHARACTERISTIC
/begin CHARACTERISTIC KL_WF_MKS_VSP_MAX "benoetigte MKS im START - VSP" CURVE 0x61A10 TKL_SW_VV_UW 100.0 FORMULA_0086 0.0 2000.0000 /begin FUNCTION_LIST Wandfilm /end FUNCTION_LIST
 /begin AXIS_DESCR STD_AXIS tsgrw FORMULA_0019 7 -50.0000 150.0000 FORMAT "%4.1" /end AXIS_DESCR
 FORMAT "%5.2" /end CHARACTERISTIC
/begin CHARACTERISTIC KL_WF_SOLL_F_TI_PHI_ENDE "WF-Korrekturfaktor Einspritzende" CURVE 0x61A2E TKL_SW_VV_UW 100.0 FORMULA_0035 0.0 4.0000 /begin FUNCTION_LIST Wandfilm /end FUNCTION_LIST
 /begin AXIS_DESCR STD_AXIS ti_phi_ende FORMULA_0188 5 -72.0000 1440.0000 FORMAT "%4.1" /end AXIS_DESCR
 FORMAT "%6.3" /end CHARACTERISTIC
/begin CHARACTERISTIC KL_WF_SOLL_F_VAN "WF-Korrekturfaktor Ventilueberschneidung" CURVE 0x61A44 TKL_SW_VV_UW 100.0 FORMULA_0035 0.0 4.0000 /begin FUNCTION_LIST Wandfilm /end FUNCTION_LIST
 /begin AXIS_DESCR STD_AXIS van_vo_filt FORMULA_0188 5 -80.0000 80.0000 FORMAT "%4.1" /end AXIS_DESCR
 FORMAT "%6.3" /end CHARACTERISTIC
/begin CHARACTERISTIC KL_WF_SOLL_F_LAM "WF-Korrekturfaktor Lambda" CURVE 0x61A5A TKL_UW_VV_UW 100.0 FORMULA_0035 0.0 4.0000 /begin FUNCTION_LIST Wandfilm /end FUNCTION_LIST /begin AXIS_DESCR STD_AXIS lam_soll FORMULA_0004 5 0.0 3.9990 FORMAT "%6.3" /end AXIS_DESCR FORMAT "%6.3" /end CHARACTERISTIC
/begin CHARACTERISTIC KL_WF_ASP_POS "Anzahl ASP f. WF-Aufbau" CURVE 0x61A70 TKL_SW_VV_UW 100.0 FORMULA_0243 0.0 1279.0000 /begin FUNCTION_LIST Wandfilm /end FUNCTION_LIST
 /begin AXIS_DESCR STD_AXIS tsgrw FORMULA_0019 6 -50.0000 150.0000 FORMAT "%4.1" /end AXIS_DESCR
/end CHARACTERISTIC
/begin CHARACTERISTIC KL_WF_ASP_NEG "Anzahl ASP f. WF-Abbau" CURVE 0x61A8A TKL_SW_VV_UW 100.0 FORMULA_0243 0.0 1279.0000 /begin FUNCTION_LIST Wandfilm /end FUNCTION_LIST
 /begin AXIS_DESCR STD_AXIS tsgrw FORMULA_0019 6 -50.0000 150.0000 FORMAT "%4.1" /end AXIS_DESCR
/end CHARACTERISTIC
/begin CHARACTERISTIC KL_WF_MKS_BEGR "max. WF-MKS" CURVE 0x61AA4 TKL_SW_VV_UW 100.0 FORMULA_0086 0.0 512.0000 /begin FUNCTION_LIST Wandfilm /end FUNCTION_LIST
 /begin AXIS_DESCR STD_AXIS tsgrw FORMULA_0019 7 -50.0000 150.0000 FORMAT "%4.1" /end AXIS_DESCR
 FORMAT "%5.2" /end CHARACTERISTIC
/begin CHARACTERISTIC KL_WF_MKS_AKTIV_SCHW "max. WF-MKS" CURVE 0x61AC2 TKL_SW_VV_UW 100.0 FORMULA_0086 0.0 512.0000 /begin FUNCTION_LIST Wandfilm /end FUNCTION_LIST
 /begin AXIS_DESCR STD_AXIS tsgrw FORMULA_0019 5 -50.0000 150.0000 FORMAT "%4.1" /end AXIS_DESCR
 FORMAT "%5.2" /end CHARACTERISTIC
/begin CHARACTERISTIC KF_WF_SOLL_GRUND "SOLL-Grundwandfilmmasse" MAP 0x61AD8 TKF_SW_SW_UW 100.0 FORMULA_0086 0.0 2000.0000 /begin FUNCTION_LIST Wandfilm /end FUNCTION_LIST
 /begin AXIS_DESCR STD_AXIS tsgrw FORMULA_0019 7 -50.0000 150.0000 FORMAT "%4.1" /end AXIS_DESCR
 /begin AXIS_DESCR STD_AXIS psau FORMULA_0031 8 0.0 2000.0000 FORMAT "%4.1" /end AXIS_DESCR
 FORMAT "%5.2" /end CHARACTERISTIC
/begin MEASUREMENT wf_bank "BANK" UWORD FORMULA_0000 0 0 0.0 65535.0000 ECU_ADDRESS 0x3FBFF2 /begin FUNCTION_LIST Wandfilm /end FUNCTION_LIST /end MEASUREMENT
/begin MEASUREMENT wf_b1.soll_grund "Grundwandfilmmasse" UWORD FORMULA_0086 0 0 0.0 2000.0000 ECU_ADDRESS 0x3FBFF4 /begin FUNCTION_LIST Wandfilm /end FUNCTION_LIST /end MEASUREMENT
/begin MEASUREMENT wf_b2.soll_grund "Grundwandfilmmasse" UWORD FORMULA_0086 0 0 0.0 2000.0000 ECU_ADDRESS 0x3FC000 /begin FUNCTION_LIST Wandfilm /end FUNCTION_LIST /end MEASUREMENT
/begin MEASUREMENT wf_b1.soll "SOLL-Wandfilmmasse" UWORD FORMULA_0086 0 0 0.0 2000.0000 ECU_ADDRESS 0x3FBFF6 /begin FUNCTION_LIST Wandfilm /end FUNCTION_LIST /end MEASUREMENT
/begin MEASUREMENT wf_b2.soll "SOLL-Wandfilmmasse" UWORD FORMULA_0086 0 0 0.0 2000.0000 ECU_ADDRESS 0x3FC002 /begin FUNCTION_LIST Wandfilm /end FUNCTION_LIST /end MEASUREMENT
/begin MEASUREMENT wf_b1.soll_f_ti "WF-Korrekturfaktor TI-Ende" UWORD FORMULA_0035 0 0 0.0 4.0000 ECU_ADDRESS 0x3FBFF8 /begin FUNCTION_LIST Wandfilm /end FUNCTION_LIST /end MEASUREMENT
/begin MEASUREMENT wf_b2.soll_f_ti "WF-Korrekturfaktor TI-Ende" UWORD FORMULA_0035 0 0 0.0 4.0000 ECU_ADDRESS 0x3FC004 /begin FUNCTION_LIST Wandfilm /end FUNCTION_LIST /end MEASUREMENT
/begin MEASUREMENT wf_b1.soll_f_van "WF-Korrekturfaktor Ventilueberschneidung" UWORD FORMULA_0035 0 0 0.0 4.0000 ECU_ADDRESS 0x3FBFFA /begin FUNCTION_LIST Wandfilm /end FUNCTION_LIST /end MEASUREMENT
/begin MEASUREMENT wf_b2.soll_f_van "WF-Korrekturfaktor Ventilueberschneidung" UWORD FORMULA_0035 0 0 0.0 4.0000 ECU_ADDRESS 0x3FC006 /begin FUNCTION_LIST Wandfilm /end FUNCTION_LIST /end MEASUREMENT
/begin MEASUREMENT wf_b1.soll_f_lam "WF-Korrekturfaktor Lambda" UWORD FORMULA_0035 0 0 0.0 4.0000 ECU_ADDRESS 0x3FBFFC /begin FUNCTION_LIST Wandfilm /end FUNCTION_LIST /end MEASUREMENT
/begin MEASUREMENT wf_b2.soll_f_lam "WF-Korrekturfaktor Lambda" UWORD FORMULA_0035 0 0 0.0 4.0000 ECU_ADDRESS 0x3FC008 /begin FUNCTION_LIST Wandfilm /end FUNCTION_LIST /end MEASUREMENT
/begin MEASUREMENT wf_vsp_st "Status-simultan/sequentielle WF-VSP" UWORD FORMULA_0024 0 0 0.0 65535.0000 ECU_ADDRESS 0x3FC00C /begin FUNCTION_LIST Wandfilm /end FUNCTION_LIST /end MEASUREMENT
/begin MEASUREMENT wf_mks_st "WF-Aktiv-Status" UWORD FORMULA_0024 0 0 0.0 65535.0000 ECU_ADDRESS 0x3FC00E /begin FUNCTION_LIST Wandfilm /end FUNCTION_LIST /end MEASUREMENT
/begin MEASUREMENT wf_dmks_t1 "wf_dmks_t1_ms/dt" UWORD FORMULA_0127 0 0 0.0 255.9960 ECU_ADDRESS 0x3FC010 /begin FUNCTION_LIST Wandfilm /end FUNCTION_LIST /end MEASUREMENT
/begin MEASUREMENT wf_mks_tau "Filterkonstante" UWORD FORMULA_0143 0 0 0.0 7.9998 ECU_ADDRESS 0x3FC012 /begin FUNCTION_LIST Wandfilm /end FUNCTION_LIST /end MEASUREMENT
/begin MEASUREMENT wf_ist_vsp_zyl1 "Wandfilrueckstand vor VSP" UWORD FORMULA_0086 0 0 0.0 2000.0000 ECU_ADDRESS 0x3FC014 /begin FUNCTION_LIST Wandfilm /end FUNCTION_LIST /end MEASUREMENT
/begin MEASUREMENT wf_ist_vsp_zyl2 "Wandfilrueckstand vor VSP" UWORD FORMULA_0086 0 0 0.0 2000.0000 ECU_ADDRESS 0x3FC016 /begin FUNCTION_LIST Wandfilm /end FUNCTION_LIST /end MEASUREMENT
/begin MEASUREMENT wf_ist_vsp_zyl3 "Wandfilrueckstand vor VSP" UWORD FORMULA_0086 0 0 0.0 2000.0000 ECU_ADDRESS 0x3FC018 /begin FUNCTION_LIST Wandfilm /end FUNCTION_LIST /end MEASUREMENT
/begin MEASUREMENT wf_ist_vsp_zyl4 "Wandfilrueckstand vor VSP" UWORD FORMULA_0086 0 0 0.0 2000.0000 ECU_ADDRESS 0x3FC01A /begin FUNCTION_LIST Wandfilm /end FUNCTION_LIST /end MEASUREMENT
/begin MEASUREMENT wf_ist_vsp_zyl5 "Wandfilrueckstand vor VSP" UWORD FORMULA_0086 0 0 0.0 2000.0000 ECU_ADDRESS 0x3FC01C /begin FUNCTION_LIST Wandfilm /end FUNCTION_LIST /end MEASUREMENT
/begin MEASUREMENT wf_ist_vsp_zyl6 "Wandfilrueckstand vor VSP" UWORD FORMULA_0086 0 0 0.0 2000.0000 ECU_ADDRESS 0x3FC01E /begin FUNCTION_LIST Wandfilm /end FUNCTION_LIST /end MEASUREMENT
/begin MEASUREMENT wf_ist_vsp_zyl7 "Wandfilrueckstand vor VSP" UWORD FORMULA_0086 0 0 0.0 2000.0000 ECU_ADDRESS 0x3FC020 /begin FUNCTION_LIST Wandfilm /end FUNCTION_LIST /end MEASUREMENT
/begin MEASUREMENT wf_ist_vsp_zyl8 "Wandfilrueckstand vor VSP" UWORD FORMULA_0086 0 0 0.0 2000.0000 ECU_ADDRESS 0x3FC022 /begin FUNCTION_LIST Wandfilm /end FUNCTION_LIST /end MEASUREMENT
/begin MEASUREMENT wf_ist_vsp_zyl9 "Wandfilrueckstand vor VSP" UWORD FORMULA_0086 0 0 0.0 2000.0000 ECU_ADDRESS 0x3FC024 /begin FUNCTION_LIST Wandfilm /end FUNCTION_LIST /end MEASUREMENT
/begin MEASUREMENT wf_ist_vsp_zyl10 "Wandfilrueckstand vor VSP" UWORD FORMULA_0086 0 0 0.0 2000.0000 ECU_ADDRESS 0x3FC026 /begin FUNCTION_LIST Wandfilm /end FUNCTION_LIST /end MEASUREMENT
/begin MEASUREMENT wf_ist_vsp_zyl11 "Wandfilrueckstand vor VSP" UWORD FORMULA_0086 0 0 0.0 2000.0000 ECU_ADDRESS 0x3FC028 /begin FUNCTION_LIST Wandfilm /end FUNCTION_LIST /end MEASUREMENT
/begin MEASUREMENT wf_ist_vsp_zyl12 "Wandfilrueckstand vor VSP" UWORD FORMULA_0086 0 0 0.0 2000.0000 ECU_ADDRESS 0x3FC02A /begin FUNCTION_LIST Wandfilm /end FUNCTION_LIST /end MEASUREMENT
/begin MEASUREMENT wf_mks_vsp_zyl1 "Kraftstoffmasse im VSP" UWORD FORMULA_0086 0 0 0.0 2000.0000 ECU_ADDRESS 0x3FC02C /begin FUNCTION_LIST Wandfilm /end FUNCTION_LIST /end MEASUREMENT
/begin MEASUREMENT wf_mks_vsp_zyl2 "Kraftstoffmasse im VSP" UWORD FORMULA_0086 0 0 0.0 2000.0000 ECU_ADDRESS 0x3FC02E /begin FUNCTION_LIST Wandfilm /end FUNCTION_LIST /end MEASUREMENT
/begin MEASUREMENT wf_mks_vsp_zyl3 "Kraftstoffmasse im VSP" UWORD FORMULA_0086 0 0 0.0 2000.0000 ECU_ADDRESS 0x3FC030 /begin FUNCTION_LIST Wandfilm /end FUNCTION_LIST /end MEASUREMENT
/begin MEASUREMENT wf_mks_vsp_zyl4 "Kraftstoffmasse im VSP" UWORD FORMULA_0086 0 0 0.0 2000.0000 ECU_ADDRESS 0x3FC032 /begin FUNCTION_LIST Wandfilm /end FUNCTION_LIST /end MEASUREMENT
/begin MEASUREMENT wf_mks_vsp_zyl5 "Kraftstoffmasse im VSP" UWORD FORMULA_0086 0 0 0.0 2000.0000 ECU_ADDRESS 0x3FC034 /begin FUNCTION_LIST Wandfilm /end FUNCTION_LIST /end MEASUREMENT
/begin MEASUREMENT wf_mks_vsp_zyl6 "Kraftstoffmasse im VSP" UWORD FORMULA_0086 0 0 0.0 2000.0000 ECU_ADDRESS 0x3FC036 /begin FUNCTION_LIST Wandfilm /end FUNCTION_LIST /end MEASUREMENT
/begin MEASUREMENT wf_mks_vsp_zyl7 "Kraftstoffmasse im VSP" UWORD FORMULA_0086 0 0 0.0 2000.0000 ECU_ADDRESS 0x3FC038 /begin FUNCTION_LIST Wandfilm /end FUNCTION_LIST /end MEASUREMENT
/begin MEASUREMENT wf_mks_vsp_zyl8 "Kraftstoffmasse im VSP" UWORD FORMULA_0086 0 0 0.0 2000.0000 ECU_ADDRESS 0x3FC03A /begin FUNCTION_LIST Wandfilm /end FUNCTION_LIST /end MEASUREMENT
/begin MEASUREMENT wf_mks_vsp_zyl9 "Kraftstoffmasse im VSP" UWORD FORMULA_0086 0 0 0.0 2000.0000 ECU_ADDRESS 0x3FC03C /begin FUNCTION_LIST Wandfilm /end FUNCTION_LIST /end MEASUREMENT
/begin MEASUREMENT wf_mks_vsp_zyl10 "Kraftstoffmasse im VSP" UWORD FORMULA_0086 0 0 0.0 2000.0000 ECU_ADDRESS 0x3FC03E /begin FUNCTION_LIST Wandfilm /end FUNCTION_LIST /end MEASUREMENT
/begin MEASUREMENT wf_mks_vsp_zyl11 "Kraftstoffmasse im VSP" UWORD FORMULA_0086 0 0 0.0 2000.0000 ECU_ADDRESS 0x3FC040 /begin FUNCTION_LIST Wandfilm /end FUNCTION_LIST /end MEASUREMENT
/begin MEASUREMENT wf_mks_vsp_zyl12 "Kraftstoffmasse im VSP" UWORD FORMULA_0086 0 0 0.0 2000.0000 ECU_ADDRESS 0x3FC042 /begin FUNCTION_LIST Wandfilm /end FUNCTION_LIST /end MEASUREMENT
/begin MEASUREMENT wf_mks_dif_zyl1 "Dif. aus SOLL-IST-WF" SWORD FORMULA_0086 0 0 -1024.0000 1023.0000 ECU_ADDRESS 0x3FC044 /begin FUNCTION_LIST Wandfilm /end FUNCTION_LIST /end MEASUREMENT
/begin MEASUREMENT wf_mks_dif_zyl2 "Dif. aus SOLL-IST-WF" SWORD FORMULA_0086 0 0 -1024.0000 1023.0000 ECU_ADDRESS 0x3FC046 /begin FUNCTION_LIST Wandfilm /end FUNCTION_LIST /end MEASUREMENT
/begin MEASUREMENT wf_mks_dif_zyl3 "Dif. aus SOLL-IST-WF" SWORD FORMULA_0086 0 0 -1024.0000 1023.0000 ECU_ADDRESS 0x3FC048 /begin FUNCTION_LIST Wandfilm /end FUNCTION_LIST /end MEASUREMENT
/begin MEASUREMENT wf_mks_dif_zyl4 "Dif. aus SOLL-IST-WF" SWORD FORMULA_0086 0 0 -1024.0000 1023.0000 ECU_ADDRESS 0x3FC04A /begin FUNCTION_LIST Wandfilm /end FUNCTION_LIST /end MEASUREMENT
/begin MEASUREMENT wf_mks_dif_zyl5 "Dif. aus SOLL-IST-WF" SWORD FORMULA_0086 0 0 -1024.0000 1023.0000 ECU_ADDRESS 0x3FC04C /begin FUNCTION_LIST Wandfilm /end FUNCTION_LIST /end MEASUREMENT
/begin MEASUREMENT wf_mks_dif_zyl6 "Dif. aus SOLL-IST-WF" SWORD FORMULA_0086 0 0 -1024.0000 1023.0000 ECU_ADDRESS 0x3FC04E /begin FUNCTION_LIST Wandfilm /end FUNCTION_LIST /end MEASUREMENT
/begin MEASUREMENT wf_mks_dif_zyl7 "Dif. aus SOLL-IST-WF" SWORD FORMULA_0086 0 0 -1024.0000 1023.0000 ECU_ADDRESS 0x3FC050 /begin FUNCTION_LIST Wandfilm /end FUNCTION_LIST /end MEASUREMENT
/begin MEASUREMENT wf_mks_dif_zyl8 "Dif. aus SOLL-IST-WF" SWORD FORMULA_0086 0 0 -1024.0000 1023.0000 ECU_ADDRESS 0x3FC052 /begin FUNCTION_LIST Wandfilm /end FUNCTION_LIST /end MEASUREMENT
/begin MEASUREMENT wf_mks_dif_zyl9 "Dif. aus SOLL-IST-WF" SWORD FORMULA_0086 0 0 -1024.0000 1023.0000 ECU_ADDRESS 0x3FC054 /begin FUNCTION_LIST Wandfilm /end FUNCTION_LIST /end MEASUREMENT
/begin MEASUREMENT wf_mks_dif_zyl10 "Dif. aus SOLL-IST-WF" SWORD FORMULA_0086 0 0 -1024.0000 1023.0000 ECU_ADDRESS 0x3FC056 /begin FUNCTION_LIST Wandfilm /end FUNCTION_LIST /end MEASUREMENT
/begin MEASUREMENT wf_mks_dif_zyl11 "Dif. aus SOLL-IST-WF" SWORD FORMULA_0086 0 0 -1024.0000 1023.0000 ECU_ADDRESS 0x3FC058 /begin FUNCTION_LIST Wandfilm /end FUNCTION_LIST /end MEASUREMENT
/begin MEASUREMENT wf_mks_dif_zyl12 "Dif. aus SOLL-IST-WF" SWORD FORMULA_0086 0 0 -1024.0000 1023.0000 ECU_ADDRESS 0x3FC05A /begin FUNCTION_LIST Wandfilm /end FUNCTION_LIST /end MEASUREMENT
/begin MEASUREMENT wf_mks_roh_zyl1 "benoetigte MKS aus WF" SWORD FORMULA_0086 0 0 -1024.0000 1023.0000 ECU_ADDRESS 0x3FC05C /begin FUNCTION_LIST Wandfilm /end FUNCTION_LIST /end MEASUREMENT
/begin MEASUREMENT wf_mks_roh_zyl2 "benoetigte MKS aus WF" SWORD FORMULA_0086 0 0 -1024.0000 1023.0000 ECU_ADDRESS 0x3FC05E /begin FUNCTION_LIST Wandfilm /end FUNCTION_LIST /end MEASUREMENT
/begin MEASUREMENT wf_mks_roh_zyl3 "benoetigte MKS aus WF" SWORD FORMULA_0086 0 0 -1024.0000 1023.0000 ECU_ADDRESS 0x3FC060 /begin FUNCTION_LIST Wandfilm /end FUNCTION_LIST /end MEASUREMENT
/begin MEASUREMENT wf_mks_roh_zyl4 "benoetigte MKS aus WF" SWORD FORMULA_0086 0 0 -1024.0000 1023.0000 ECU_ADDRESS 0x3FC062 /begin FUNCTION_LIST Wandfilm /end FUNCTION_LIST /end MEASUREMENT
/begin MEASUREMENT wf_mks_roh_zyl5 "benoetigte MKS aus WF" SWORD FORMULA_0086 0 0 -1024.0000 1023.0000 ECU_ADDRESS 0x3FC064 /begin FUNCTION_LIST Wandfilm /end FUNCTION_LIST /end MEASUREMENT
/begin MEASUREMENT wf_mks_roh_zyl6 "benoetigte MKS aus WF" SWORD FORMULA_0086 0 0 -1024.0000 1023.0000 ECU_ADDRESS 0x3FC066 /begin FUNCTION_LIST Wandfilm /end FUNCTION_LIST /end MEASUREMENT
/begin MEASUREMENT wf_mks_roh_zyl7 "benoetigte MKS aus WF" SWORD FORMULA_0086 0 0 -1024.0000 1023.0000 ECU_ADDRESS 0x3FC068 /begin FUNCTION_LIST Wandfilm /end FUNCTION_LIST /end MEASUREMENT
/begin MEASUREMENT wf_mks_roh_zyl8 "benoetigte MKS aus WF" SWORD FORMULA_0086 0 0 -1024.0000 1023.0000 ECU_ADDRESS 0x3FC06A /begin FUNCTION_LIST Wandfilm /end FUNCTION_LIST /end MEASUREMENT
/begin MEASUREMENT wf_mks_roh_zyl9 "benoetigte MKS aus WF" SWORD FORMULA_0086 0 0 -1024.0000 1023.0000 ECU_ADDRESS 0x3FC06C /begin FUNCTION_LIST Wandfilm /end FUNCTION_LIST /end MEASUREMENT
/begin MEASUREMENT wf_mks_roh_zyl10 "benoetigte MKS aus WF" SWORD FORMULA_0086 0 0 -1024.0000 1023.0000 ECU_ADDRESS 0x3FC06E /begin FUNCTION_LIST Wandfilm /end FUNCTION_LIST /end MEASUREMENT
/begin MEASUREMENT wf_mks_roh_zyl11 "benoetigte MKS aus WF" SWORD FORMULA_0086 0 0 -1024.0000 1023.0000 ECU_ADDRESS 0x3FC070 /begin FUNCTION_LIST Wandfilm /end FUNCTION_LIST /end MEASUREMENT
/begin MEASUREMENT wf_mks_roh_zyl12 "benoetigte MKS aus WF" SWORD FORMULA_0086 0 0 -1024.0000 1023.0000 ECU_ADDRESS 0x3FC072 /begin FUNCTION_LIST Wandfilm /end FUNCTION_LIST /end MEASUREMENT
/begin MEASUREMENT wf_mks_begr_zyl1 "begr. wf_mks_roh" SWORD FORMULA_0086 0 0 -1024.0000 1023.0000 ECU_ADDRESS 0x3FC074 /begin FUNCTION_LIST Wandfilm /end FUNCTION_LIST /end MEASUREMENT
/begin MEASUREMENT wf_mks_begr_zyl2 "begr. wf_mks_roh" SWORD FORMULA_0086 0 0 -1024.0000 1023.0000 ECU_ADDRESS 0x3FC076 /begin FUNCTION_LIST Wandfilm /end FUNCTION_LIST /end MEASUREMENT
/begin MEASUREMENT wf_mks_begr_zyl3 "begr. wf_mks_roh" SWORD FORMULA_0086 0 0 -1024.0000 1023.0000 ECU_ADDRESS 0x3FC078 /begin FUNCTION_LIST Wandfilm /end FUNCTION_LIST /end MEASUREMENT
/begin MEASUREMENT wf_mks_begr_zyl4 "begr. wf_mks_roh" SWORD FORMULA_0086 0 0 -1024.0000 1023.0000 ECU_ADDRESS 0x3FC07A /begin FUNCTION_LIST Wandfilm /end FUNCTION_LIST /end MEASUREMENT
/begin MEASUREMENT wf_mks_begr_zyl5 "begr. wf_mks_roh" SWORD FORMULA_0086 0 0 -1024.0000 1023.0000 ECU_ADDRESS 0x3FC07C /begin FUNCTION_LIST Wandfilm /end FUNCTION_LIST /end MEASUREMENT
/begin MEASUREMENT wf_mks_begr_zyl6 "begr. wf_mks_roh" SWORD FORMULA_0086 0 0 -1024.0000 1023.0000 ECU_ADDRESS 0x3FC07E /begin FUNCTION_LIST Wandfilm /end FUNCTION_LIST /end MEASUREMENT
/begin MEASUREMENT wf_mks_begr_zyl7 "begr. wf_mks_roh" SWORD FORMULA_0086 0 0 -1024.0000 1023.0000 ECU_ADDRESS 0x3FC080 /begin FUNCTION_LIST Wandfilm /end FUNCTION_LIST /end MEASUREMENT
/begin MEASUREMENT wf_mks_begr_zyl8 "begr. wf_mks_roh" SWORD FORMULA_0086 0 0 -1024.0000 1023.0000 ECU_ADDRESS 0x3FC082 /begin FUNCTION_LIST Wandfilm /end FUNCTION_LIST /end MEASUREMENT
/begin MEASUREMENT wf_mks_begr_zyl9 "begr. wf_mks_roh" SWORD FORMULA_0086 0 0 -1024.0000 1023.0000 ECU_ADDRESS 0x3FC084 /begin FUNCTION_LIST Wandfilm /end FUNCTION_LIST /end MEASUREMENT
/begin MEASUREMENT wf_mks_begr_zyl10 "begr. wf_mks_roh" SWORD FORMULA_0086 0 0 -1024.0000 1023.0000 ECU_ADDRESS 0x3FC086 /begin FUNCTION_LIST Wandfilm /end FUNCTION_LIST /end MEASUREMENT
/begin MEASUREMENT wf_mks_begr_zyl11 "begr. wf_mks_roh" SWORD FORMULA_0086 0 0 -1024.0000 1023.0000 ECU_ADDRESS 0x3FC088 /begin FUNCTION_LIST Wandfilm /end FUNCTION_LIST /end MEASUREMENT
/begin MEASUREMENT wf_mks_begr_zyl12 "begr. wf_mks_roh" SWORD FORMULA_0086 0 0 -1024.0000 1023.0000 ECU_ADDRESS 0x3FC08A /begin FUNCTION_LIST Wandfilm /end FUNCTION_LIST /end MEASUREMENT
/begin MEASUREMENT wf_mks_zyl1 "MKS aus Wandfilmmodell" SWORD FORMULA_0125 0 0 -512.0000 511.0000 ECU_ADDRESS 0x3FC08C /begin FUNCTION_LIST Wandfilm /end FUNCTION_LIST /end MEASUREMENT
/begin MEASUREMENT wf_mks_zyl2 "MKS aus Wandfilmmodell" SWORD FORMULA_0125 0 0 -512.0000 511.0000 ECU_ADDRESS 0x3FC08E /begin FUNCTION_LIST Wandfilm /end FUNCTION_LIST /end MEASUREMENT
/begin MEASUREMENT wf_mks_zyl3 "MKS aus Wandfilmmodell" SWORD FORMULA_0125 0 0 -512.0000 511.0000 ECU_ADDRESS 0x3FC090 /begin FUNCTION_LIST Wandfilm /end FUNCTION_LIST /end MEASUREMENT
/begin MEASUREMENT wf_mks_zyl4 "MKS aus Wandfilmmodell" SWORD FORMULA_0125 0 0 -512.0000 511.0000 ECU_ADDRESS 0x3FC092 /begin FUNCTION_LIST Wandfilm /end FUNCTION_LIST /end MEASUREMENT
/begin MEASUREMENT wf_mks_zyl5 "MKS aus Wandfilmmodell" SWORD FORMULA_0125 0 0 -512.0000 511.0000 ECU_ADDRESS 0x3FC094 /begin FUNCTION_LIST Wandfilm /end FUNCTION_LIST /end MEASUREMENT
/begin MEASUREMENT wf_mks_zyl6 "MKS aus Wandfilmmodell" SWORD FORMULA_0125 0 0 -512.0000 511.0000 ECU_ADDRESS 0x3FC096 /begin FUNCTION_LIST Wandfilm /end FUNCTION_LIST /end MEASUREMENT
/begin MEASUREMENT wf_mks_zyl7 "MKS aus Wandfilmmodell" SWORD FORMULA_0125 0 0 -512.0000 511.0000 ECU_ADDRESS 0x3FC098 /begin FUNCTION_LIST Wandfilm /end FUNCTION_LIST /end MEASUREMENT
/begin MEASUREMENT wf_mks_zyl8 "MKS aus Wandfilmmodell" SWORD FORMULA_0125 0 0 -512.0000 511.0000 ECU_ADDRESS 0x3FC09A /begin FUNCTION_LIST Wandfilm /end FUNCTION_LIST /end MEASUREMENT
/begin MEASUREMENT wf_mks_zyl9 "MKS aus Wandfilmmodell" SWORD FORMULA_0125 0 0 -512.0000 511.0000 ECU_ADDRESS 0x3FC09C /begin FUNCTION_LIST Wandfilm /end FUNCTION_LIST /end MEASUREMENT
/begin MEASUREMENT wf_mks_zyl10 "MKS aus Wandfilmmodell" SWORD FORMULA_0125 0 0 -512.0000 511.0000 ECU_ADDRESS 0x3FC09E /begin FUNCTION_LIST Wandfilm /end FUNCTION_LIST /end MEASUREMENT
/begin MEASUREMENT wf_mks_zyl11 "MKS aus Wandfilmmodell" SWORD FORMULA_0125 0 0 -512.0000 511.0000 ECU_ADDRESS 0x3FC0A0 /begin FUNCTION_LIST Wandfilm /end FUNCTION_LIST /end MEASUREMENT
/begin MEASUREMENT wf_mks_zyl12 "MKS aus Wandfilmmodell" SWORD FORMULA_0125 0 0 -512.0000 511.0000 ECU_ADDRESS 0x3FC0A2 /begin FUNCTION_LIST Wandfilm /end FUNCTION_LIST /end MEASUREMENT
/begin MEASUREMENT wf_vsp_seq_cnt "Segmentcounter f. sequentiellen WF-VSP" UWORD FORMULA_0242 0 0 0.0 12.0000 ECU_ADDRESS 0x3FC0A4 /begin FUNCTION_LIST Wandfilm /end FUNCTION_LIST /end MEASUREMENT
/begin MEASUREMENT wf_asp_cnt "ASP-Counter f. WF-Auf-/Abbau" UWORD FORMULA_0243 0 0 0.0 1279.0000 ECU_ADDRESS 0x3FC0A6 /begin FUNCTION_LIST Wandfilm /end FUNCTION_LIST /end MEASUREMENT
/* ------------------ Abschnitt erzeugt aus zust_inj.dat ------------------ */
/begin CHARACTERISTIC K_ZUST_N_PS_LL "Drehzahlschwelle f. Uebergang PRESYNC --> LL" VALUE 0x61B68 TKW_VV_VV_SW 100.0 FORMULA_0011 0.0 3000.0000 /begin FUNCTION_LIST Zustand /end FUNCTION_LIST /end CHARACTERISTIC
/begin CHARACTERISTIC K_ZUST_MD_LL_TL "Momentenschwelle f. Uebergang LL --> TL" VALUE 0x61B6A TKW_VV_VV_SW 100.0 FORMULA_0022 0.0 100.0000 /begin FUNCTION_LIST Zustand /end FUNCTION_LIST FORMAT "%4.1" /end CHARACTERISTIC
/begin CHARACTERISTIC K_ZUST_MD_ST_LL "Momentenschwelle f. Uebergang ST --> LL" VALUE 0x61B6C TKW_VV_VV_SW 100.0 FORMULA_0022 0.0 100.0000 /begin FUNCTION_LIST Zustand /end FUNCTION_LIST FORMAT "%4.1" /end CHARACTERISTIC
/begin CHARACTERISTIC K_ZUST_MD_HYST_LL_TL "MD Hysterese f. Uebergang TL --> LL" VALUE 0x61B6E TKW_VV_VV_SW 100.0 FORMULA_0022 0.0 100.0000 /begin FUNCTION_LIST Zustand /end FUNCTION_LIST FORMAT "%4.1" /end CHARACTERISTIC
/begin CHARACTERISTIC K_ZUST_MD_HYST_TL_VL "MD Hysterese f. Uebergang TL --> VL" VALUE 0x61B70 TKW_VV_VV_SW 100.0 FORMULA_0022 0.0 100.0000 /begin FUNCTION_LIST Zustand /end FUNCTION_LIST FORMAT "%4.1" /end CHARACTERISTIC
/begin CHARACTERISTIC K_ZUST_T_NL "Nachlaufzeit" VALUE 0x61B72 TKW_VV_VV_UW 100.0 FORMULA_0103 0.0 655.3500 /begin FUNCTION_LIST Zustand /end FUNCTION_LIST FORMAT "%5.2" /end CHARACTERISTIC
/begin CHARACTERISTIC K_ZUST_NL_TIMOUT_INJ "Timeoutueberwachung fuer INJ" VALUE 0x61B74 TKW_VV_VV_UW 100.0 FORMULA_0245 0.0 5000.0000 /begin FUNCTION_LIST Zustand /end FUNCTION_LIST FORMAT "%5.2" /end CHARACTERISTIC
/begin CHARACTERISTIC K_ZUST_MD_SA_TL "Momentenschwelle f. Uebergang SA --> TL" VALUE 0x61B76 TKW_VV_VV_SW 100.0 FORMULA_0022 0.0 100.0000 /begin FUNCTION_LIST Zustand /end FUNCTION_LIST FORMAT "%4.1" /end CHARACTERISTIC
/begin CHARACTERISTIC KL_ZUST_N_ST_LL "Drehzahlschwelle fuer Start Exit" CURVE 0x61B78 TKL_SW_VV_SW 100.0 FORMULA_0011 0.0 10000.0000 /begin FUNCTION_LIST Zustand /end FUNCTION_LIST
 /begin AXIS_DESCR STD_AXIS tmot FORMULA_0019 3 -50.0000 150.0000 FORMAT "%4.1" /end AXIS_DESCR
/end CHARACTERISTIC
/begin CHARACTERISTIC KL_ZUST_MD_TL_VL "md_rel fuer Uebergang TL -> VL" CURVE 0x61B86 TKL_SW_VV_SW 100.0 FORMULA_0022 0.0 100.0000 /begin FUNCTION_LIST Zustand /end FUNCTION_LIST /begin AXIS_DESCR STD_AXIS n FORMULA_0011 6 0.0 10000.0000 /end AXIS_DESCR FORMAT "%4.1" /end CHARACTERISTIC
/begin MEASUREMENT time_kl15_on "Zeit seit Kl15 an" ULONG FORMULA_0244 0 0 0.0 21474836.4700 ECU_ADDRESS 0x3FC0C4 /begin FUNCTION_LIST Zustand /end FUNCTION_LIST /end MEASUREMENT
/begin MEASUREMENT zust_nl_ed "IGN Proz. quitiert NL nicht" UWORD FORMULA_0017 0 0 0.0 111.0 ECU_ADDRESS 0x3FC0C8 /begin FUNCTION_LIST Zustand /end FUNCTION_LIST BIT_MASK 0x6F /end MEASUREMENT
/begin MEASUREMENT zust_tmot_start "tmot im Zustand START" SWORD FORMULA_0019 0 0 -50.0000 150.0000 ECU_ADDRESS 0x3FC0CA /begin FUNCTION_LIST Zustand /end FUNCTION_LIST /end MEASUREMENT
/begin FUNCTION TPU_Interface "TPU_Interface" /end FUNCTION
/begin FUNCTION Taskmonitor "Taskmonitor" /end FUNCTION
/begin FUNCTION Umgebungsdruck "Umgebungsdruck" /end FUNCTION
/begin FUNCTION Vanos "Vanos" /end FUNCTION
/begin FUNCTION Version "Version" /end FUNCTION
/begin FUNCTION Wandfilm "Wandfilm" /end FUNCTION
/begin FUNCTION Zustand "Zustand" /end FUNCTION
/begin FUNCTION aq "aq" /end FUNCTION
/begin FUNCTION cantel "cantel" /end FUNCTION
/begin FUNCTION debug "debug" /end FUNCTION
/begin FUNCTION os "os" /end FUNCTION
/begin FUNCTION pabg "pabg" /end FUNCTION
/begin FUNCTION rps "rps" /end FUNCTION
/begin FUNCTION sa_we "sa_we" /end FUNCTION
/begin FUNCTION spi "spi" /end FUNCTION
/begin FUNCTION sys_zust "sys_zust" /end FUNCTION
/begin FUNCTION testfunktion "testfunktion" /end FUNCTION
/begin RECORD_LAYOUT TKW_VV_VV_UB FNC_VALUES 1 UBYTE COLUMN_DIR DIRECT /end RECORD_LAYOUT
/begin RECORD_LAYOUT TKW_VV_VV_SB FNC_VALUES 1 SBYTE COLUMN_DIR DIRECT /end RECORD_LAYOUT
/begin RECORD_LAYOUT TKW_VV_VV_UW FNC_VALUES 1 UWORD COLUMN_DIR DIRECT /end RECORD_LAYOUT
/begin RECORD_LAYOUT TKW_VV_VV_SW FNC_VALUES 1 SWORD COLUMN_DIR DIRECT /end RECORD_LAYOUT
/begin RECORD_LAYOUT TKL_UW_VV_UW NO_AXIS_PTS_X 1 UBYTE RESERVED 2 BYTE AXIS_PTS_X 3 UWORD INDEX_INCR DIRECT FNC_VALUES 4 UWORD COLUMN_DIR DIRECT /end RECORD_LAYOUT
/begin RECORD_LAYOUT TKL_SW_VV_UW NO_AXIS_PTS_X 1 UBYTE RESERVED 2 BYTE AXIS_PTS_X 3 SWORD INDEX_INCR DIRECT FNC_VALUES 4 UWORD COLUMN_DIR DIRECT /end RECORD_LAYOUT
/begin RECORD_LAYOUT TKL_SW_VV_SW NO_AXIS_PTS_X 1 UBYTE RESERVED 2 BYTE AXIS_PTS_X 3 SWORD INDEX_INCR DIRECT FNC_VALUES 4 SWORD COLUMN_DIR DIRECT /end RECORD_LAYOUT
/begin RECORD_LAYOUT TKF_UW_UW_UW NO_AXIS_PTS_X 1 UBYTE NO_AXIS_PTS_Y 2 UBYTE AXIS_PTS_X 3 UWORD INDEX_INCR DIRECT AXIS_PTS_Y 4 UWORD INDEX_INCR DIRECT FNC_VALUES 5 UWORD COLUMN_DIR DIRECT /end RECORD_LAYOUT
/begin RECORD_LAYOUT TKF_SW_SW_UW NO_AXIS_PTS_X 1 UBYTE NO_AXIS_PTS_Y 2 UBYTE AXIS_PTS_X 3 SWORD INDEX_INCR DIRECT AXIS_PTS_Y 4 SWORD INDEX_INCR DIRECT FNC_VALUES 5 UWORD COLUMN_DIR DIRECT /end RECORD_LAYOUT
/begin RECORD_LAYOUT TKF_SW_SW_SW NO_AXIS_PTS_X 1 UBYTE NO_AXIS_PTS_Y 2 UBYTE AXIS_PTS_X 3 SWORD INDEX_INCR DIRECT AXIS_PTS_Y 4 SWORD INDEX_INCR DIRECT FNC_VALUES 5 SWORD COLUMN_DIR DIRECT /end RECORD_LAYOUT
/end MODULE
/end PROJECT
