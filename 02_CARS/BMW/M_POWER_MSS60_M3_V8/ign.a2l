ASAP2_VERSION 1 30
/begin PROJECT MSS65-ign "Generiert am 14.10.05 um 09:57:47"
/begin HEADER "" VERSION "R341" /end HEADER
/begin MODULE _MSS65-ign "Generiert am 14.10.05 um 09:57:47"
/begin MOD_COMMON "" BYTE_ORDER MSB_FIRST ALIGNMENT_BYTE 1 ALIGNMENT_WORD 2 ALIGNMENT_LONG 4 ALIGNMENT_FLOAT32_IEEE 4 ALIGNMENT_FLOAT64_IEEE 8 /end MOD_COMMON
/begin CHARACTERISTIC K_ED_AFZ_HS.DEC_NACH_EINTRAG "Filterverringerung nach Fehlerspeichereintrag" VALUE 0x716EF TKW_VV_VV_UB 100.0 FORMULA_0003 0.0 255.0 /end CHARACTERISTIC
/begin CHARACTERISTIC K_ED_AFZ_HS.DEC_VOR_EINTRAG "Filterverringerung vorm Fehlerspeichereintrag" VALUE 0x716ED TKW_VV_VV_UB 100.0 FORMULA_0003 0.0 255.0 /end CHARACTERISTIC
/begin CHARACTERISTIC K_ED_AFZ_HS.FEHLERSCHWELLE "Filterschwelle fuer Fehlereintrag" VALUE 0x716EA TKW_VV_VV_UB 100.0 FORMULA_0003 0.0 255.0 /end CHARACTERISTIC
/begin CHARACTERISTIC K_ED_AFZ_HS.INC_NACH_EINTRAG "Filtererhoehung nach Fehlerspeichereintrag" VALUE 0x716EE TKW_VV_VV_UB 100.0 FORMULA_0003 0.0 255.0 /end CHARACTERISTIC
/begin CHARACTERISTIC K_ED_AFZ_HS.INC_VOR_EINTRAG "Filtererhoehung vorm Fehlerspeichereintrag" VALUE 0x716EC TKW_VV_VV_UB 100.0 FORMULA_0003 0.0 255.0 /end CHARACTERISTIC
/begin CHARACTERISTIC K_ED_AFZ_HS.KLASSENINDEX "Auswahl der Fehlerklasse" VALUE 0x716F0 TKW_VV_VV_UB 100.0 FORMULA_0003 0.0 8.0 /end CHARACTERISTIC
/begin CHARACTERISTIC K_ED_AFZ_HS.OK_SCHWELLE "Filterschwelle fuer Fehleraustrag" VALUE 0x716EB TKW_VV_VV_UB 100.0 FORMULA_0003 0.0 255.0 /end CHARACTERISTIC
/begin CHARACTERISTIC K_ED_AFZ_HS.P_CODE_OPENLOAD "P-Code fuer die Art OPENLOAD" VALUE 0x716E6 TKW_VV_VV_UW 100.0 FORMULA_0010 0.0 65535.0 /end CHARACTERISTIC
/begin CHARACTERISTIC K_ED_AFZ_HS.P_CODE_SH_TO_GND "P-Code fuer die Art SH_TO_GND" VALUE 0x716E4 TKW_VV_VV_UW 100.0 FORMULA_0010 0.0 65535.0 /end CHARACTERISTIC
/begin CHARACTERISTIC K_ED_AFZ_HS.P_CODE_SH_TO_UB "P-Code fuer die Art SH_TO_UB" VALUE 0x716E2 TKW_VV_VV_UW 100.0 FORMULA_0010 0.0 65535.0 /end CHARACTERISTIC
/begin CHARACTERISTIC K_ED_AFZ_HS.P_CODE_UNPLAUSIBEL "P-Code fuer die Art UNPLAUSIBEL" VALUE 0x716E8 TKW_VV_VV_UW 100.0 FORMULA_0010 0.0 65535.0 /end CHARACTERISTIC
/begin CHARACTERISTIC K_ED_APPL_DATA_IGN.DEC_NACH_EINTRAG "Filterverringerung nach Fehlerspeichereintrag" VALUE 0x70D7D TKW_VV_VV_UB 100.0 FORMULA_0003 0.0 255.0 /end CHARACTERISTIC
/begin CHARACTERISTIC K_ED_APPL_DATA_IGN.DEC_VOR_EINTRAG "Filterverringerung vorm Fehlerspeichereintrag" VALUE 0x70D7B TKW_VV_VV_UB 100.0 FORMULA_0003 0.0 255.0 /end CHARACTERISTIC
/begin CHARACTERISTIC K_ED_APPL_DATA_IGN.FEHLERSCHWELLE "Filterschwelle fuer Fehlereintrag" VALUE 0x70D78 TKW_VV_VV_UB 100.0 FORMULA_0003 0.0 255.0 /end CHARACTERISTIC
/begin CHARACTERISTIC K_ED_APPL_DATA_IGN.INC_NACH_EINTRAG "Filtererhoehung nach Fehlerspeichereintrag" VALUE 0x70D7C TKW_VV_VV_UB 100.0 FORMULA_0003 0.0 255.0 /end CHARACTERISTIC
/begin CHARACTERISTIC K_ED_APPL_DATA_IGN.INC_VOR_EINTRAG "Filtererhoehung vorm Fehlerspeichereintrag" VALUE 0x70D7A TKW_VV_VV_UB 100.0 FORMULA_0003 0.0 255.0 /end CHARACTERISTIC
/begin CHARACTERISTIC K_ED_APPL_DATA_IGN.KLASSENINDEX "Auswahl der Fehlerklasse" VALUE 0x70D7E TKW_VV_VV_UB 100.0 FORMULA_0003 0.0 8.0 /end CHARACTERISTIC
/begin CHARACTERISTIC K_ED_APPL_DATA_IGN.OK_SCHWELLE "Filterschwelle fuer Fehleraustrag" VALUE 0x70D79 TKW_VV_VV_UB 100.0 FORMULA_0003 0.0 255.0 /end CHARACTERISTIC
/begin CHARACTERISTIC K_ED_APPL_DATA_IGN.P_CODE_OPENLOAD "P-Code fuer die Art OPENLOAD" VALUE 0x70D74 TKW_VV_VV_UW 100.0 FORMULA_0010 0.0 65535.0 /end CHARACTERISTIC
/begin CHARACTERISTIC K_ED_APPL_DATA_IGN.P_CODE_SH_TO_GND "P-Code fuer die Art SH_TO_GND" VALUE 0x70D72 TKW_VV_VV_UW 100.0 FORMULA_0010 0.0 65535.0 /end CHARACTERISTIC
/begin CHARACTERISTIC K_ED_APPL_DATA_IGN.P_CODE_SH_TO_UB "P-Code fuer die Art SH_TO_UB" VALUE 0x70D70 TKW_VV_VV_UW 100.0 FORMULA_0010 0.0 65535.0 /end CHARACTERISTIC
/begin CHARACTERISTIC K_ED_APPL_DATA_IGN.P_CODE_UNPLAUSIBEL "P-Code fuer die Art UNPLAUSIBEL" VALUE 0x70D76 TKW_VV_VV_UW 100.0 FORMULA_0010 0.0 65535.0 /end CHARACTERISTIC
/begin CHARACTERISTIC K_ED_AUSS_ABG_MULT.DEC_NACH_EINTRAG "Filterverringerung nach Fehlerspeichereintrag" VALUE 0x7151B TKW_VV_VV_UB 100.0 FORMULA_0003 0.0 255.0 /end CHARACTERISTIC
/begin CHARACTERISTIC K_ED_AUSS_ABG_MULT.DEC_VOR_EINTRAG "Filterverringerung vorm Fehlerspeichereintrag" VALUE 0x71519 TKW_VV_VV_UB 100.0 FORMULA_0003 0.0 255.0 /end CHARACTERISTIC
/begin CHARACTERISTIC K_ED_AUSS_ABG_MULT.FEHLERSCHWELLE "Filterschwelle fuer Fehlereintrag" VALUE 0x71516 TKW_VV_VV_UB 100.0 FORMULA_0003 0.0 255.0 /end CHARACTERISTIC
/begin CHARACTERISTIC K_ED_AUSS_ABG_MULT.INC_NACH_EINTRAG "Filtererhoehung nach Fehlerspeichereintrag" VALUE 0x7151A TKW_VV_VV_UB 100.0 FORMULA_0003 0.0 255.0 /end CHARACTERISTIC
/begin CHARACTERISTIC K_ED_AUSS_ABG_MULT.INC_VOR_EINTRAG "Filtererhoehung vorm Fehlerspeichereintrag" VALUE 0x71518 TKW_VV_VV_UB 100.0 FORMULA_0003 0.0 255.0 /end CHARACTERISTIC
/begin CHARACTERISTIC K_ED_AUSS_ABG_MULT.KLASSENINDEX "Auswahl der Fehlerklasse" VALUE 0x7151C TKW_VV_VV_UB 100.0 FORMULA_0003 0.0 8.0 /end CHARACTERISTIC
/begin MEASUREMENT ed_fsp_17of20_.ed_fil_index_nv "Verweis auf Fehlerfilter" UWORD FORMULA_0010 0 0.0 0.0 65535.0 READ_WRITE ECU_ADDRESS 0x3F9C4E /end MEASUREMENT
/begin MEASUREMENT ed_fsp_17of20_.fehlerart_nv "Fehlerart und Statusbits" UWORD FORMULA_0010 0 0.0 0.0 65535.0 READ_WRITE ECU_ADDRESS 0x3F9C2A /end MEASUREMENT
/begin MEASUREMENT ed_fsp_17of20_.fehlercode_nv "Externer Fehlerort" UWORD FORMULA_0053 0 0.0 0.0 65535.0 READ_WRITE ECU_ADDRESS 0x3F9C28 /end MEASUREMENT
/begin MEASUREMENT ed_fsp_17of20_.ff_egas_ist_dk_b1_nv "Drosselklappenposition des Freeze Frame" UBYTE FORMULA_0059 0 0.0 0.0 100.0 READ_WRITE ECU_ADDRESS 0x3F9C68 /end MEASUREMENT
/begin MEASUREMENT ed_fsp_17of20_.ff_laa_f_ber_b1_nv "Lambdaadaptionsfaktor ohne TE des Freeze Frame" UBYTE FORMULA_0058 0 0.0 0.0 1.99210000038147 READ_WRITE ECU_ADDRESS 0x3F9C60 /end MEASUREMENT
/begin MEASUREMENT ed_fsp_17of20_.ff_laa_f_ber_b2_nv "Lambdaadaptionsfaktor ohne TE des Freeze Frame" UBYTE FORMULA_0058 0 0.0 0.0 1.99210000038147 READ_WRITE ECU_ADDRESS 0x3F9C61 /end MEASUREMENT
/begin MEASUREMENT ed_fsp_17of20_.ff_lam_reg_b1_nv "Einspritzsystem des Freeze Frame" UBYTE FORMULA_0057 0 0.0 0.0 255.0 READ_WRITE ECU_ADDRESS 0x3F9C5C /end MEASUREMENT
/begin MEASUREMENT ed_fsp_17of20_.ff_lam_reg_b2_nv "Einspritzsystem des Freeze Frame" UBYTE FORMULA_0057 0 0.0 0.0 255.0 READ_WRITE ECU_ADDRESS 0x3F9C5D /end MEASUREMENT
/begin MEASUREMENT ed_fsp_17of20_.ff_lam_reg_f_b1_nv "Lambdaregelfaktor des Freeze Frame" UBYTE FORMULA_0058 0 0.0 0.0 1.99210000038147 READ_WRITE ECU_ADDRESS 0x3F9C5E /end MEASUREMENT
/begin MEASUREMENT ed_fsp_17of20_.ff_lam_reg_f_b2_nv "Lambdaregelfaktor des Freeze Frame" UBYTE FORMULA_0058 0 0.0 0.0 1.99210000038147 READ_WRITE ECU_ADDRESS 0x3F9C5F /end MEASUREMENT
/begin MEASUREMENT ed_fsp_17of20_.ff_ml_ges_nv "Luftmasse des Freeze Frame" UWORD FORMULA_0056 0 0.0 0.0 655.3499755859375 READ_WRITE ECU_ADDRESS 0x3F9C5A /end MEASUREMENT
/begin MEASUREMENT ed_fsp_17of20_.ff_n_nv "Drehzahl des Freeze Frame" UWORD FORMULA_0055 0 0.0 0.0 16383.75 READ_WRITE ECU_ADDRESS 0x3F9C58 /end MEASUREMENT
/begin MEASUREMENT ed_fsp_17of20_.ff_p_code_nv "P-Code des Freeze Frame" UWORD FORMULA_0010 0 0.0 0.0 65535.0 READ_WRITE ECU_ADDRESS 0x3F9C56 /end MEASUREMENT
/begin MEASUREMENT ed_fsp_17of20_.ff_pks_ist_nv "Kraftstoffdruck des Freeze Frame" UBYTE FORMULA_0061 0 0.0 0.0 765.0 READ_WRITE ECU_ADDRESS 0x3F9C64 /end MEASUREMENT
/begin MEASUREMENT ed_fsp_17of20_.ff_rf_m_nv "Last des Freeze Frame" UBYTE FORMULA_0059 0 0.0 0.0 100.0 READ_WRITE ECU_ADDRESS 0x3F9C62 /end MEASUREMENT
/begin MEASUREMENT ed_fsp_17of20_.ff_sl_st_nv "Sekundaerluftstatus des Freeze Frame" UBYTE FORMULA_0064 0 0.0 0.0 255.0 READ_WRITE ECU_ADDRESS 0x3F9C69 /end MEASUREMENT
/begin MEASUREMENT ed_fsp_17of20_.ff_tan_m_nv "Ansauglufttemperatur des Freeze Frame" UBYTE FORMULA_0060 0 0.0 -40.0 215.0 READ_WRITE ECU_ADDRESS 0x3F9C67 /end MEASUREMENT
/begin MEASUREMENT ed_fsp_17of20_.ff_tmot_nv "Kuehlwassertemperatur des Freeze Frame" UBYTE FORMULA_0060 0 0.0 -40.0 215.0 READ_WRITE ECU_ADDRESS 0x3F9C63 /end MEASUREMENT
/begin MEASUREMENT ed_fsp_17of20_.ff_tz1_nv "Zuendwinkel 1 des Freeze Frame" UBYTE FORMULA_0063 0 0.0 -64.0 63.5 READ_WRITE ECU_ADDRESS 0x3F9C66 /end MEASUREMENT
/begin MEASUREMENT ed_fsp_17of20_.ff_v_vorne_nv "Geschwindigkeit des Freeze Frame" UBYTE FORMULA_0062 0 0.0 0.0 255.0 READ_WRITE ECU_ADDRESS 0x3F9C65 /end MEASUREMENT
/begin MEASUREMENT ed_fsp_17of20_.haeufigkeitszaehler_nv "Uebergangszaehler von i.O. -> n.i.O" UBYTE FORMULA_0003 0 0.0 0.0 255.0 READ_WRITE ECU_ADDRESS 0x3F9C2C /end MEASUREMENT
/begin MEASUREMENT ed_fsp_17of20_.inj_fehlerzaehler_nv "INJ-Fehlerzaehler" UWORD FORMULA_0010 0 0.0 0.0 65535.0 READ_WRITE ECU_ADDRESS 0x3F9C4C /end MEASUREMENT
/begin MEASUREMENT ed_fsp_17of20_.logistikzaehler_nv "Warm-Up-Cycling-Zaehler" UBYTE FORMULA_0003 0 0.0 0.0 255.0 READ_WRITE ECU_ADDRESS 0x3F9C2D /end MEASUREMENT
/begin MEASUREMENT ed_fsp_17of20_.mil_filter_nv "Filterwert der Milansteuerung" UBYTE FORMULA_0003 0 0.0 0.0 255.0 READ_WRITE ECU_ADDRESS 0x3F9C50 /end MEASUREMENT
/begin MEASUREMENT ed_fsp_17of20_.mil_filter_scdn_nv "Similar Conditions Eintragsfilterwert der Milansteuerung" UBYTE FORMULA_0003 0 0.0 0.0 255.0 READ_WRITE ECU_ADDRESS 0x3F9C51 /end MEASUREMENT
/begin MEASUREMENT ed_fsp_17of20_.scdn_nenner_nv "Gesamte Anzahl" UWORD FORMULA_0010 0 0.0 0.0 65535.0 READ_WRITE ECU_ADDRESS 0x3F9C54 /end MEASUREMENT
/begin MEASUREMENT ed_fsp_17of20_.scdn_zaehler_nv "Im similar Fenster" UWORD FORMULA_0010 0 0.0 0.0 65535.0 READ_WRITE ECU_ADDRESS 0x3F9C52 /end MEASUREMENT
/begin MEASUREMENT ed_fsp_17of20_.uw_satz_1of3_.uw_km_stand_nv "Kilometerstand beim Fehlereintrag" UWORD FORMULA_0054 0 0.0 0.0 524280.0 READ_WRITE ECU_ADDRESS 0x3F9C2E /end MEASUREMENT
/begin MEASUREMENT ed_fsp_17of20_.uw_satz_1of3_.uw_wert_nv_1of4_ "Umweltbedingung beim Fehlereintrag" UWORD FORMULA_0010 0 0.0 0.0 65535.0 READ_WRITE ECU_ADDRESS 0x3F9C30 /end MEASUREMENT
/begin MEASUREMENT ed_fsp_17of20_.uw_satz_1of3_.uw_wert_nv_2of4_ "Umweltbedingung beim Fehlereintrag" UWORD FORMULA_0010 0 0.0 0.0 65535.0 READ_WRITE ECU_ADDRESS 0x3F9C32 /end MEASUREMENT
/begin MEASUREMENT ed_fsp_17of20_.uw_satz_1of3_.uw_wert_nv_3of4_ "Umweltbedingung beim Fehlereintrag" UWORD FORMULA_0010 0 0.0 0.0 65535.0 READ_WRITE ECU_ADDRESS 0x3F9C34 /end MEASUREMENT
/begin MEASUREMENT ed_fsp_17of20_.uw_satz_1of3_.uw_wert_nv_4of4_ "Umweltbedingung beim Fehlereintrag" UWORD FORMULA_0010 0 0.0 0.0 65535.0 READ_WRITE ECU_ADDRESS 0x3F9C36 /end MEASUREMENT
/begin MEASUREMENT ed_fsp_17of20_.uw_satz_2of3_.uw_km_stand_nv "Kilometerstand beim Fehlereintrag" UWORD FORMULA_0054 0 0.0 0.0 524280.0 READ_WRITE ECU_ADDRESS 0x3F9C38 /end MEASUREMENT
/begin MEASUREMENT ed_fsp_17of20_.uw_satz_2of3_.uw_wert_nv_1of4_ "Umweltbedingung beim Fehlereintrag" UWORD FORMULA_0010 0 0.0 0.0 65535.0 READ_WRITE ECU_ADDRESS 0x3F9C3A /end MEASUREMENT
/begin MEASUREMENT ed_fsp_17of20_.uw_satz_2of3_.uw_wert_nv_2of4_ "Umweltbedingung beim Fehlereintrag" UWORD FORMULA_0010 0 0.0 0.0 65535.0 READ_WRITE ECU_ADDRESS 0x3F9C3C /end MEASUREMENT
/begin MEASUREMENT ed_fsp_17of20_.uw_satz_2of3_.uw_wert_nv_3of4_ "Umweltbedingung beim Fehlereintrag" UWORD FORMULA_0010 0 0.0 0.0 65535.0 READ_WRITE ECU_ADDRESS 0x3F9C3E /end MEASUREMENT
/begin MEASUREMENT ed_fsp_17of20_.uw_satz_2of3_.uw_wert_nv_4of4_ "Umweltbedingung beim Fehlereintrag" UWORD FORMULA_0010 0 0.0 0.0 65535.0 READ_WRITE ECU_ADDRESS 0x3F9C40 /end MEASUREMENT
/begin MEASUREMENT ed_fsp_17of20_.uw_satz_3of3_.uw_km_stand_nv "Kilometerstand beim Fehlereintrag" UWORD FORMULA_0054 0 0.0 0.0 524280.0 READ_WRITE ECU_ADDRESS 0x3F9C42 /end MEASUREMENT
/begin MEASUREMENT ed_fsp_17of20_.uw_satz_3of3_.uw_wert_nv_1of4_ "Umweltbedingung beim Fehlereintrag" UWORD FORMULA_0010 0 0.0 0.0 65535.0 READ_WRITE ECU_ADDRESS 0x3F9C44 /end MEASUREMENT
/begin MEASUREMENT ed_fsp_17of20_.uw_satz_3of3_.uw_wert_nv_2of4_ "Umweltbedingung beim Fehlereintrag" UWORD FORMULA_0010 0 0.0 0.0 65535.0 READ_WRITE ECU_ADDRESS 0x3F9C46 /end MEASUREMENT
/begin MEASUREMENT ed_fsp_17of20_.uw_satz_3of3_.uw_wert_nv_3of4_ "Umweltbedingung beim Fehlereintrag" UWORD FORMULA_0010 0 0.0 0.0 65535.0 READ_WRITE ECU_ADDRESS 0x3F9C48 /end MEASUREMENT
/begin MEASUREMENT ed_fsp_17of20_.uw_satz_3of3_.uw_wert_nv_4of4_ "Umweltbedingung beim Fehlereintrag" UWORD FORMULA_0010 0 0.0 0.0 65535.0 READ_WRITE ECU_ADDRESS 0x3F9C4A /end MEASUREMENT
/begin MEASUREMENT ed_fsp_18of20_.ed_fil_index_nv "Verweis auf Fehlerfilter" UWORD FORMULA_0010 0 0.0 0.0 65535.0 READ_WRITE ECU_ADDRESS 0x3F9C90 /end MEASUREMENT
/begin MEASUREMENT ed_fsp_18of20_.fehlerart_nv "Fehlerart und Statusbits" UWORD FORMULA_0010 0 0.0 0.0 65535.0 READ_WRITE ECU_ADDRESS 0x3F9C6C /end MEASUREMENT
/begin MEASUREMENT ed_fsp_18of20_.fehlercode_nv "Externer Fehlerort" UWORD FORMULA_0053 0 0.0 0.0 65535.0 READ_WRITE ECU_ADDRESS 0x3F9C6A /end MEASUREMENT
/begin MEASUREMENT ed_fsp_18of20_.ff_egas_ist_dk_b1_nv "Drosselklappenposition des Freeze Frame" UBYTE FORMULA_0059 0 0.0 0.0 100.0 READ_WRITE ECU_ADDRESS 0x3F9CAA /end MEASUREMENT
/begin MEASUREMENT ed_fsp_18of20_.ff_laa_f_ber_b1_nv "Lambdaadaptionsfaktor ohne TE des Freeze Frame" UBYTE FORMULA_0058 0 0.0 0.0 1.99210000038147 READ_WRITE ECU_ADDRESS 0x3F9CA2 /end MEASUREMENT
/begin MEASUREMENT ed_fsp_18of20_.ff_laa_f_ber_b2_nv "Lambdaadaptionsfaktor ohne TE des Freeze Frame" UBYTE FORMULA_0058 0 0.0 0.0 1.99210000038147 READ_WRITE ECU_ADDRESS 0x3F9CA3 /end MEASUREMENT
/begin MEASUREMENT ed_fsp_18of20_.ff_lam_reg_b1_nv "Einspritzsystem des Freeze Frame" UBYTE FORMULA_0057 0 0.0 0.0 255.0 READ_WRITE ECU_ADDRESS 0x3F9C9E /end MEASUREMENT
/begin MEASUREMENT ed_fsp_18of20_.ff_lam_reg_b2_nv "Einspritzsystem des Freeze Frame" UBYTE FORMULA_0057 0 0.0 0.0 255.0 READ_WRITE ECU_ADDRESS 0x3F9C9F /end MEASUREMENT
/begin MEASUREMENT ed_fsp_18of20_.ff_lam_reg_f_b1_nv "Lambdaregelfaktor des Freeze Frame" UBYTE FORMULA_0058 0 0.0 0.0 1.99210000038147 READ_WRITE ECU_ADDRESS 0x3F9CA0 /end MEASUREMENT
/begin MEASUREMENT ed_fsp_18of20_.ff_lam_reg_f_b2_nv "Lambdaregelfaktor des Freeze Frame" UBYTE FORMULA_0058 0 0.0 0.0 1.99210000038147 READ_WRITE ECU_ADDRESS 0x3F9CA1 /end MEASUREMENT
/begin MEASUREMENT ed_fsp_18of20_.ff_ml_ges_nv "Luftmasse des Freeze Frame" UWORD FORMULA_0056 0 0.0 0.0 655.3499755859375 READ_WRITE ECU_ADDRESS 0x3F9C9C /end MEASUREMENT
/begin MEASUREMENT ed_fsp_18of20_.ff_n_nv "Drehzahl des Freeze Frame" UWORD FORMULA_0055 0 0.0 0.0 16383.75 READ_WRITE ECU_ADDRESS 0x3F9C9A /end MEASUREMENT
/begin MEASUREMENT ed_fsp_18of20_.ff_p_code_nv "P-Code des Freeze Frame" UWORD FORMULA_0010 0 0.0 0.0 65535.0 READ_WRITE ECU_ADDRESS 0x3F9C98 /end MEASUREMENT
/begin MEASUREMENT ed_fsp_18of20_.ff_pks_ist_nv "Kraftstoffdruck des Freeze Frame" UBYTE FORMULA_0061 0 0.0 0.0 765.0 READ_WRITE ECU_ADDRESS 0x3F9CA6 /end MEASUREMENT
/begin MEASUREMENT ed_fsp_18of20_.ff_rf_m_nv "Last des Freeze Frame" UBYTE FORMULA_0059 0 0.0 0.0 100.0 READ_WRITE ECU_ADDRESS 0x3F9CA4 /end MEASUREMENT
/begin MEASUREMENT ed_fsp_18of20_.ff_sl_st_nv "Sekundaerluftstatus des Freeze Frame" UBYTE FORMULA_0064 0 0.0 0.0 255.0 READ_WRITE ECU_ADDRESS 0x3F9CAB /end MEASUREMENT
/begin MEASUREMENT ed_fsp_18of20_.ff_tan_m_nv "Ansauglufttemperatur des Freeze Frame" UBYTE FORMULA_0060 0 0.0 -40.0 215.0 READ_WRITE ECU_ADDRESS 0x3F9CA9 /end MEASUREMENT
/begin MEASUREMENT ed_fsp_18of20_.ff_tmot_nv "Kuehlwassertemperatur des Freeze Frame" UBYTE FORMULA_0060 0 0.0 -40.0 215.0 READ_WRITE ECU_ADDRESS 0x3F9CA5 /end MEASUREMENT
/begin MEASUREMENT ed_fsp_18of20_.ff_tz1_nv "Zuendwinkel 1 des Freeze Frame" UBYTE FORMULA_0063 0 0.0 -64.0 63.5 READ_WRITE ECU_ADDRESS 0x3F9CA8 /end MEASUREMENT
/begin MEASUREMENT ed_fsp_18of20_.ff_v_vorne_nv "Geschwindigkeit des Freeze Frame" UBYTE FORMULA_0062 0 0.0 0.0 255.0 READ_WRITE ECU_ADDRESS 0x3F9CA7 /end MEASUREMENT
/begin MEASUREMENT ed_fsp_18of20_.haeufigkeitszaehler_nv "Uebergangszaehler von i.O. -> n.i.O" UBYTE FORMULA_0003 0 0.0 0.0 255.0 READ_WRITE ECU_ADDRESS 0x3F9C6E /end MEASUREMENT
/begin MEASUREMENT ed_fsp_18of20_.inj_fehlerzaehler_nv "INJ-Fehlerzaehler" UWORD FORMULA_0010 0 0.0 0.0 65535.0 READ_WRITE ECU_ADDRESS 0x3F9C8E /end MEASUREMENT
/begin MEASUREMENT ed_fsp_18of20_.logistikzaehler_nv "Warm-Up-Cycling-Zaehler" UBYTE FORMULA_0003 0 0.0 0.0 255.0 READ_WRITE ECU_ADDRESS 0x3F9C6F /end MEASUREMENT
/begin MEASUREMENT ed_fsp_18of20_.mil_filter_nv "Filterwert der Milansteuerung" UBYTE FORMULA_0003 0 0.0 0.0 255.0 READ_WRITE ECU_ADDRESS 0x3F9C92 /end MEASUREMENT
/begin MEASUREMENT ed_fsp_18of20_.mil_filter_scdn_nv "Similar Conditions Eintragsfilterwert der Milansteuerung" UBYTE FORMULA_0003 0 0.0 0.0 255.0 READ_WRITE ECU_ADDRESS 0x3F9C93 /end MEASUREMENT
/begin MEASUREMENT ed_fsp_18of20_.scdn_nenner_nv "Gesamte Anzahl" UWORD FORMULA_0010 0 0.0 0.0 65535.0 READ_WRITE ECU_ADDRESS 0x3F9C96 /end MEASUREMENT
/begin MEASUREMENT ed_fsp_18of20_.scdn_zaehler_nv "Im similar Fenster" UWORD FORMULA_0010 0 0.0 0.0 65535.0 READ_WRITE ECU_ADDRESS 0x3F9C94 /end MEASUREMENT
/begin MEASUREMENT ed_fsp_18of20_.uw_satz_1of3_.uw_km_stand_nv "Kilometerstand beim Fehlereintrag" UWORD FORMULA_0054 0 0.0 0.0 524280.0 READ_WRITE ECU_ADDRESS 0x3F9C70 /end MEASUREMENT
/begin MEASUREMENT ed_fsp_18of20_.uw_satz_1of3_.uw_wert_nv_1of4_ "Umweltbedingung beim Fehlereintrag" UWORD FORMULA_0010 0 0.0 0.0 65535.0 READ_WRITE ECU_ADDRESS 0x3F9C72 /end MEASUREMENT
/begin MEASUREMENT ed_fsp_18of20_.uw_satz_1of3_.uw_wert_nv_2of4_ "Umweltbedingung beim Fehlereintrag" UWORD FORMULA_0010 0 0.0 0.0 65535.0 READ_WRITE ECU_ADDRESS 0x3F9C74 /end MEASUREMENT
/begin MEASUREMENT ed_fsp_18of20_.uw_satz_1of3_.uw_wert_nv_3of4_ "Umweltbedingung beim Fehlereintrag" UWORD FORMULA_0010 0 0.0 0.0 65535.0 READ_WRITE ECU_ADDRESS 0x3F9C76 /end MEASUREMENT
/begin MEASUREMENT ed_fsp_18of20_.uw_satz_1of3_.uw_wert_nv_4of4_ "Umweltbedingung beim Fehlereintrag" UWORD FORMULA_0010 0 0.0 0.0 65535.0 READ_WRITE ECU_ADDRESS 0x3F9C78 /end MEASUREMENT
/begin MEASUREMENT ed_fsp_18of20_.uw_satz_2of3_.uw_km_stand_nv "Kilometerstand beim Fehlereintrag" UWORD FORMULA_0054 0 0.0 0.0 524280.0 READ_WRITE ECU_ADDRESS 0x3F9C7A /end MEASUREMENT
/begin MEASUREMENT ed_fsp_18of20_.uw_satz_2of3_.uw_wert_nv_1of4_ "Umweltbedingung beim Fehlereintrag" UWORD FORMULA_0010 0 0.0 0.0 65535.0 READ_WRITE ECU_ADDRESS 0x3F9C7C /end MEASUREMENT
/begin MEASUREMENT ed_fsp_18of20_.uw_satz_2of3_.uw_wert_nv_2of4_ "Umweltbedingung beim Fehlereintrag" UWORD FORMULA_0010 0 0.0 0.0 65535.0 READ_WRITE ECU_ADDRESS 0x3F9C7E /end MEASUREMENT
/begin MEASUREMENT ed_fsp_18of20_.uw_satz_2of3_.uw_wert_nv_3of4_ "Umweltbedingung beim Fehlereintrag" UWORD FORMULA_0010 0 0.0 0.0 65535.0 READ_WRITE ECU_ADDRESS 0x3F9C80 /end MEASUREMENT
/begin MEASUREMENT ed_fsp_18of20_.uw_satz_2of3_.uw_wert_nv_4of4_ "Umweltbedingung beim Fehlereintrag" UWORD FORMULA_0010 0 0.0 0.0 65535.0 READ_WRITE ECU_ADDRESS 0x3F9C82 /end MEASUREMENT
/begin MEASUREMENT ed_fsp_18of20_.uw_satz_3of3_.uw_km_stand_nv "Kilometerstand beim Fehlereintrag" UWORD FORMULA_0054 0 0.0 0.0 524280.0 READ_WRITE ECU_ADDRESS 0x3F9C84 /end MEASUREMENT
/begin MEASUREMENT ed_fsp_18of20_.uw_satz_3of3_.uw_wert_nv_1of4_ "Umweltbedingung beim Fehlereintrag" UWORD FORMULA_0010 0 0.0 0.0 65535.0 READ_WRITE ECU_ADDRESS 0x3F9C86 /end MEASUREMENT
/begin MEASUREMENT ed_fsp_18of20_.uw_satz_3of3_.uw_wert_nv_2of4_ "Umweltbedingung beim Fehlereintrag" UWORD FORMULA_0010 0 0.0 0.0 65535.0 READ_WRITE ECU_ADDRESS 0x3F9C88 /end MEASUREMENT
/begin MEASUREMENT ed_fsp_18of20_.uw_satz_3of3_.uw_wert_nv_3of4_ "Umweltbedingung beim Fehlereintrag" UWORD FORMULA_0010 0 0.0 0.0 65535.0 READ_WRITE ECU_ADDRESS 0x3F9C8A /end MEASUREMENT
/begin MEASUREMENT ed_fsp_18of20_.uw_satz_3of3_.uw_wert_nv_4of4_ "Umweltbedingung beim Fehlereintrag" UWORD FORMULA_0010 0 0.0 0.0 65535.0 READ_WRITE ECU_ADDRESS 0x3F9C8C /end MEASUREMENT
/begin MEASUREMENT ed_fsp_19of20_.ed_fil_index_nv "Verweis auf Fehlerfilter" UWORD FORMULA_0010 0 0.0 0.0 65535.0 READ_WRITE ECU_ADDRESS 0x3F9CD2 /end MEASUREMENT
/begin MEASUREMENT ed_fsp_19of20_.fehlerart_nv "Fehlerart und Statusbits" UWORD FORMULA_0010 0 0.0 0.0 65535.0 READ_WRITE ECU_ADDRESS 0x3F9CAE /end MEASUREMENT
/begin MEASUREMENT ed_fsp_19of20_.fehlercode_nv "Externer Fehlerort" UWORD FORMULA_0053 0 0.0 0.0 65535.0 READ_WRITE ECU_ADDRESS 0x3F9CAC /end MEASUREMENT
/begin MEASUREMENT ed_fsp_19of20_.ff_egas_ist_dk_b1_nv "Drosselklappenposition des Freeze Frame" UBYTE FORMULA_0059 0 0.0 0.0 100.0 READ_WRITE ECU_ADDRESS 0x3F9CEC /end MEASUREMENT
/begin MEASUREMENT ed_fsp_19of20_.ff_laa_f_ber_b1_nv "Lambdaadaptionsfaktor ohne TE des Freeze Frame" UBYTE FORMULA_0058 0 0.0 0.0 1.99210000038147 READ_WRITE ECU_ADDRESS 0x3F9CE4 /end MEASUREMENT
/begin MEASUREMENT ed_fsp_19of20_.ff_laa_f_ber_b2_nv "Lambdaadaptionsfaktor ohne TE des Freeze Frame" UBYTE FORMULA_0058 0 0.0 0.0 1.99210000038147 READ_WRITE ECU_ADDRESS 0x3F9CE5 /end MEASUREMENT
/begin MEASUREMENT ed_fsp_19of20_.ff_lam_reg_b1_nv "Einspritzsystem des Freeze Frame" UBYTE FORMULA_0057 0 0.0 0.0 255.0 READ_WRITE ECU_ADDRESS 0x3F9CE0 /end MEASUREMENT
/begin MEASUREMENT ed_fsp_19of20_.ff_lam_reg_b2_nv "Einspritzsystem des Freeze Frame" UBYTE FORMULA_0057 0 0.0 0.0 255.0 READ_WRITE ECU_ADDRESS 0x3F9CE1 /end MEASUREMENT
/begin MEASUREMENT ed_fsp_19of20_.ff_lam_reg_f_b1_nv "Lambdaregelfaktor des Freeze Frame" UBYTE FORMULA_0058 0 0.0 0.0 1.99210000038147 READ_WRITE ECU_ADDRESS 0x3F9CE2 /end MEASUREMENT
/begin MEASUREMENT ed_fsp_19of20_.ff_lam_reg_f_b2_nv "Lambdaregelfaktor des Freeze Frame" UBYTE FORMULA_0058 0 0.0 0.0 1.99210000038147 READ_WRITE ECU_ADDRESS 0x3F9CE3 /end MEASUREMENT
/begin MEASUREMENT ed_fsp_19of20_.ff_ml_ges_nv "Luftmasse des Freeze Frame" UWORD FORMULA_0056 0 0.0 0.0 655.3499755859375 READ_WRITE ECU_ADDRESS 0x3F9CDE /end MEASUREMENT
/begin MEASUREMENT ed_fsp_19of20_.ff_n_nv "Drehzahl des Freeze Frame" UWORD FORMULA_0055 0 0.0 0.0 16383.75 READ_WRITE ECU_ADDRESS 0x3F9CDC /end MEASUREMENT
/begin MEASUREMENT ed_fsp_19of20_.ff_p_code_nv "P-Code des Freeze Frame" UWORD FORMULA_0010 0 0.0 0.0 65535.0 READ_WRITE ECU_ADDRESS 0x3F9CDA /end MEASUREMENT
/begin MEASUREMENT ed_fsp_19of20_.ff_pks_ist_nv "Kraftstoffdruck des Freeze Frame" UBYTE FORMULA_0061 0 0.0 0.0 765.0 READ_WRITE ECU_ADDRESS 0x3F9CE8 /end MEASUREMENT
/begin MEASUREMENT ed_fsp_19of20_.ff_rf_m_nv "Last des Freeze Frame" UBYTE FORMULA_0059 0 0.0 0.0 100.0 READ_WRITE ECU_ADDRESS 0x3F9CE6 /end MEASUREMENT
/begin MEASUREMENT ed_fsp_19of20_.ff_sl_st_nv "Sekundaerluftstatus des Freeze Frame" UBYTE FORMULA_0064 0 0.0 0.0 255.0 READ_WRITE ECU_ADDRESS 0x3F9CED /end MEASUREMENT
/begin MEASUREMENT ed_fsp_19of20_.ff_tan_m_nv "Ansauglufttemperatur des Freeze Frame" UBYTE FORMULA_0060 0 0.0 -40.0 215.0 READ_WRITE ECU_ADDRESS 0x3F9CEB /end MEASUREMENT
/begin MEASUREMENT ed_fsp_19of20_.ff_tmot_nv "Kuehlwassertemperatur des Freeze Frame" UBYTE FORMULA_0060 0 0.0 -40.0 215.0 READ_WRITE ECU_ADDRESS 0x3F9CE7 /end MEASUREMENT
/begin MEASUREMENT ed_fsp_19of20_.ff_tz1_nv "Zuendwinkel 1 des Freeze Frame" UBYTE FORMULA_0063 0 0.0 -64.0 63.5 READ_WRITE ECU_ADDRESS 0x3F9CEA /end MEASUREMENT
/begin MEASUREMENT ed_fsp_19of20_.ff_v_vorne_nv "Geschwindigkeit des Freeze Frame" UBYTE FORMULA_0062 0 0.0 0.0 255.0 READ_WRITE ECU_ADDRESS 0x3F9CE9 /end MEASUREMENT
/begin MEASUREMENT ed_fsp_19of20_.haeufigkeitszaehler_nv "Uebergangszaehler von i.O. -> n.i.O" UBYTE FORMULA_0003 0 0.0 0.0 255.0 READ_WRITE ECU_ADDRESS 0x3F9CB0 /end MEASUREMENT
/begin MEASUREMENT ed_fsp_19of20_.inj_fehlerzaehler_nv "INJ-Fehlerzaehler" UWORD FORMULA_0010 0 0.0 0.0 65535.0 READ_WRITE ECU_ADDRESS 0x3F9CD0 /end MEASUREMENT
/begin MEASUREMENT ed_fsp_19of20_.logistikzaehler_nv "Warm-Up-Cycling-Zaehler" UBYTE FORMULA_0003 0 0.0 0.0 255.0 READ_WRITE ECU_ADDRESS 0x3F9CB1 /end MEASUREMENT
/begin MEASUREMENT ed_fsp_19of20_.mil_filter_nv "Filterwert der Milansteuerung" UBYTE FORMULA_0003 0 0.0 0.0 255.0 READ_WRITE ECU_ADDRESS 0x3F9CD4 /end MEASUREMENT
/begin MEASUREMENT ed_fsp_19of20_.mil_filter_scdn_nv "Similar Conditions Eintragsfilterwert der Milansteuerung" UBYTE FORMULA_0003 0 0.0 0.0 255.0 READ_WRITE ECU_ADDRESS 0x3F9CD5 /end MEASUREMENT
/begin MEASUREMENT ed_fsp_19of20_.scdn_nenner_nv "Gesamte Anzahl" UWORD FORMULA_0010 0 0.0 0.0 65535.0 READ_WRITE ECU_ADDRESS 0x3F9CD8 /end MEASUREMENT
/begin MEASUREMENT ed_fsp_19of20_.scdn_zaehler_nv "Im similar Fenster" UWORD FORMULA_0010 0 0.0 0.0 65535.0 READ_WRITE ECU_ADDRESS 0x3F9CD6 /end MEASUREMENT
/begin MEASUREMENT ed_fsp_19of20_.uw_satz_1of3_.uw_km_stand_nv "Kilometerstand beim Fehlereintrag" UWORD FORMULA_0054 0 0.0 0.0 524280.0 READ_WRITE ECU_ADDRESS 0x3F9CB2 /end MEASUREMENT
/begin MEASUREMENT ed_fsp_19of20_.uw_satz_1of3_.uw_wert_nv_1of4_ "Umweltbedingung beim Fehlereintrag" UWORD FORMULA_0010 0 0.0 0.0 65535.0 READ_WRITE ECU_ADDRESS 0x3F9CB4 /end MEASUREMENT
/begin MEASUREMENT ed_fsp_19of20_.uw_satz_1of3_.uw_wert_nv_2of4_ "Umweltbedingung beim Fehlereintrag" UWORD FORMULA_0010 0 0.0 0.0 65535.0 READ_WRITE ECU_ADDRESS 0x3F9CB6 /end MEASUREMENT
/begin MEASUREMENT ed_fsp_19of20_.uw_satz_1of3_.uw_wert_nv_3of4_ "Umweltbedingung beim Fehlereintrag" UWORD FORMULA_0010 0 0.0 0.0 65535.0 READ_WRITE ECU_ADDRESS 0x3F9CB8 /end MEASUREMENT
/begin MEASUREMENT ed_fsp_19of20_.uw_satz_1of3_.uw_wert_nv_4of4_ "Umweltbedingung beim Fehlereintrag" UWORD FORMULA_0010 0 0.0 0.0 65535.0 READ_WRITE ECU_ADDRESS 0x3F9CBA /end MEASUREMENT
/begin MEASUREMENT ed_fsp_19of20_.uw_satz_2of3_.uw_km_stand_nv "Kilometerstand beim Fehlereintrag" UWORD FORMULA_0054 0 0.0 0.0 524280.0 READ_WRITE ECU_ADDRESS 0x3F9CBC /end MEASUREMENT
/begin MEASUREMENT ed_fsp_19of20_.uw_satz_2of3_.uw_wert_nv_1of4_ "Umweltbedingung beim Fehlereintrag" UWORD FORMULA_0010 0 0.0 0.0 65535.0 READ_WRITE ECU_ADDRESS 0x3F9CBE /end MEASUREMENT
/begin MEASUREMENT ed_fsp_19of20_.uw_satz_2of3_.uw_wert_nv_2of4_ "Umweltbedingung beim Fehlereintrag" UWORD FORMULA_0010 0 0.0 0.0 65535.0 READ_WRITE ECU_ADDRESS 0x3F9CC0 /end MEASUREMENT
/begin MEASUREMENT ed_fsp_19of20_.uw_satz_2of3_.uw_wert_nv_3of4_ "Umweltbedingung beim Fehlereintrag" UWORD FORMULA_0010 0 0.0 0.0 65535.0 READ_WRITE ECU_ADDRESS 0x3F9CC2 /end MEASUREMENT
/begin MEASUREMENT ed_fsp_19of20_.uw_satz_2of3_.uw_wert_nv_4of4_ "Umweltbedingung beim Fehlereintrag" UWORD FORMULA_0010 0 0.0 0.0 65535.0 READ_WRITE ECU_ADDRESS 0x3F9CC4 /end MEASUREMENT
/begin MEASUREMENT ed_fsp_19of20_.uw_satz_3of3_.uw_km_stand_nv "Kilometerstand beim Fehlereintrag" UWORD FORMULA_0054 0 0.0 0.0 524280.0 READ_WRITE ECU_ADDRESS 0x3F9CC6 /end MEASUREMENT
/begin MEASUREMENT ed_fsp_19of20_.uw_satz_3of3_.uw_wert_nv_1of4_ "Umweltbedingung beim Fehlereintrag" UWORD FORMULA_0010 0 0.0 0.0 65535.0 READ_WRITE ECU_ADDRESS 0x3F9CC8 /end MEASUREMENT
/begin MEASUREMENT ed_fsp_19of20_.uw_satz_3of3_.uw_wert_nv_2of4_ "Umweltbedingung beim Fehlereintrag" UWORD FORMULA_0010 0 0.0 0.0 65535.0 READ_WRITE ECU_ADDRESS 0x3F9CCA /end MEASUREMENT
/begin MEASUREMENT ed_fsp_19of20_.uw_satz_3of3_.uw_wert_nv_3of4_ "Umweltbedingung beim Fehlereintrag" UWORD FORMULA_0010 0 0.0 0.0 65535.0 READ_WRITE ECU_ADDRESS 0x3F9CCC /end MEASUREMENT
/begin MEASUREMENT ed_fsp_19of20_.uw_satz_3of3_.uw_wert_nv_4of4_ "Umweltbedingung beim Fehlereintrag" UWORD FORMULA_0010 0 0.0 0.0 65535.0 READ_WRITE ECU_ADDRESS 0x3F9CCE /end MEASUREMENT
/begin MEASUREMENT ed_fsp_1of20_.ed_fil_index_nv "Verweis auf Fehlerfilter" UWORD FORMULA_0010 0 0.0 0.0 65535.0 READ_WRITE ECU_ADDRESS 0x3F982E /end MEASUREMENT
/begin MEASUREMENT ed_fsp_1of20_.fehlerart_nv "Fehlerart und Statusbits" UWORD FORMULA_0010 0 0.0 0.0 65535.0 READ_WRITE ECU_ADDRESS 0x3F980A /end MEASUREMENT
/begin MEASUREMENT ed_fsp_1of20_.fehlercode_nv "Externer Fehlerort" UWORD FORMULA_0053 0 0.0 0.0 65535.0 READ_WRITE ECU_ADDRESS 0x3F9808 /end MEASUREMENT
/begin MEASUREMENT ed_fsp_1of20_.ff_egas_ist_dk_b1_nv "Drosselklappenposition des Freeze Frame" UBYTE FORMULA_0059 0 0.0 0.0 100.0 READ_WRITE ECU_ADDRESS 0x3F9848 /end MEASUREMENT
/begin MEASUREMENT ed_fsp_1of20_.ff_laa_f_ber_b1_nv "Lambdaadaptionsfaktor ohne TE des Freeze Frame" UBYTE FORMULA_0058 0 0.0 0.0 1.99210000038147 READ_WRITE ECU_ADDRESS 0x3F9840 /end MEASUREMENT
/begin MEASUREMENT ed_fsp_1of20_.ff_laa_f_ber_b2_nv "Lambdaadaptionsfaktor ohne TE des Freeze Frame" UBYTE FORMULA_0058 0 0.0 0.0 1.99210000038147 READ_WRITE ECU_ADDRESS 0x3F9841 /end MEASUREMENT
/begin MEASUREMENT ed_fsp_1of20_.ff_lam_reg_b1_nv "Einspritzsystem des Freeze Frame" UBYTE FORMULA_0057 0 0.0 0.0 255.0 READ_WRITE ECU_ADDRESS 0x3F983C /end MEASUREMENT
/begin MEASUREMENT ed_fsp_1of20_.ff_lam_reg_b2_nv "Einspritzsystem des Freeze Frame" UBYTE FORMULA_0057 0 0.0 0.0 255.0 READ_WRITE ECU_ADDRESS 0x3F983D /end MEASUREMENT
/begin MEASUREMENT ed_fsp_1of20_.ff_lam_reg_f_b1_nv "Lambdaregelfaktor des Freeze Frame" UBYTE FORMULA_0058 0 0.0 0.0 1.99210000038147 READ_WRITE ECU_ADDRESS 0x3F983E /end MEASUREMENT
/begin MEASUREMENT ed_fsp_1of20_.ff_lam_reg_f_b2_nv "Lambdaregelfaktor des Freeze Frame" UBYTE FORMULA_0058 0 0.0 0.0 1.99210000038147 READ_WRITE ECU_ADDRESS 0x3F983F /end MEASUREMENT
/begin MEASUREMENT ed_fsp_1of20_.ff_ml_ges_nv "Luftmasse des Freeze Frame" UWORD FORMULA_0056 0 0.0 0.0 655.3499755859375 READ_WRITE ECU_ADDRESS 0x3F983A /end MEASUREMENT
/begin MEASUREMENT ed_fsp_1of20_.ff_n_nv "Drehzahl des Freeze Frame" UWORD FORMULA_0055 0 0.0 0.0 16383.75 READ_WRITE ECU_ADDRESS 0x3F9838 /end MEASUREMENT
/begin MEASUREMENT ed_fsp_1of20_.ff_p_code_nv "P-Code des Freeze Frame" UWORD FORMULA_0010 0 0.0 0.0 65535.0 READ_WRITE ECU_ADDRESS 0x3F9836 /end MEASUREMENT
/begin MEASUREMENT ed_fsp_1of20_.ff_pks_ist_nv "Kraftstoffdruck des Freeze Frame" UBYTE FORMULA_0061 0 0.0 0.0 765.0 READ_WRITE ECU_ADDRESS 0x3F9844 /end MEASUREMENT
/begin MEASUREMENT ed_fsp_1of20_.ff_rf_m_nv "Last des Freeze Frame" UBYTE FORMULA_0059 0 0.0 0.0 100.0 READ_WRITE ECU_ADDRESS 0x3F9842 /end MEASUREMENT
/begin MEASUREMENT ed_fsp_1of20_.ff_sl_st_nv "Sekundaerluftstatus des Freeze Frame" UBYTE FORMULA_0064 0 0.0 0.0 255.0 READ_WRITE ECU_ADDRESS 0x3F9849 /end MEASUREMENT
/begin MEASUREMENT ed_fsp_1of20_.ff_tan_m_nv "Ansauglufttemperatur des Freeze Frame" UBYTE FORMULA_0060 0 0.0 -40.0 215.0 READ_WRITE ECU_ADDRESS 0x3F9847 /end MEASUREMENT
/begin MEASUREMENT ed_fsp_1of20_.ff_tmot_nv "Kuehlwassertemperatur des Freeze Frame" UBYTE FORMULA_0060 0 0.0 -40.0 215.0 READ_WRITE ECU_ADDRESS 0x3F9843 /end MEASUREMENT
/begin MEASUREMENT ed_fsp_1of20_.ff_tz1_nv "Zuendwinkel 1 des Freeze Frame" UBYTE FORMULA_0063 0 0.0 -64.0 63.5 READ_WRITE ECU_ADDRESS 0x3F9846 /end MEASUREMENT
/begin MEASUREMENT ed_fsp_1of20_.ff_v_vorne_nv "Geschwindigkeit des Freeze Frame" UBYTE FORMULA_0062 0 0.0 0.0 255.0 READ_WRITE ECU_ADDRESS 0x3F9845 /end MEASUREMENT
/begin MEASUREMENT ed_fsp_1of20_.haeufigkeitszaehler_nv "Uebergangszaehler von i.O. -> n.i.O" UBYTE FORMULA_0003 0 0.0 0.0 255.0 READ_WRITE ECU_ADDRESS 0x3F980C /end MEASUREMENT
/begin MEASUREMENT ed_fsp_1of20_.inj_fehlerzaehler_nv "INJ-Fehlerzaehler" UWORD FORMULA_0010 0 0.0 0.0 65535.0 READ_WRITE ECU_ADDRESS 0x3F982C /end MEASUREMENT
/begin MEASUREMENT ed_fsp_1of20_.logistikzaehler_nv "Warm-Up-Cycling-Zaehler" UBYTE FORMULA_0003 0 0.0 0.0 255.0 READ_WRITE ECU_ADDRESS 0x3F980D /end MEASUREMENT
/begin MEASUREMENT ed_fsp_1of20_.mil_filter_nv "Filterwert der Milansteuerung" UBYTE FORMULA_0003 0 0.0 0.0 255.0 READ_WRITE ECU_ADDRESS 0x3F9830 /end MEASUREMENT
/begin MEASUREMENT ed_fsp_1of20_.mil_filter_scdn_nv "Similar Conditions Eintragsfilterwert der Milansteuerung" UBYTE FORMULA_0003 0 0.0 0.0 255.0 READ_WRITE ECU_ADDRESS 0x3F9831 /end MEASUREMENT
/begin MEASUREMENT ed_fsp_1of20_.scdn_nenner_nv "Gesamte Anzahl" UWORD FORMULA_0010 0 0.0 0.0 65535.0 READ_WRITE ECU_ADDRESS 0x3F9834 /end MEASUREMENT
/begin MEASUREMENT ed_fsp_1of20_.scdn_zaehler_nv "Im similar Fenster" UWORD FORMULA_0010 0 0.0 0.0 65535.0 READ_WRITE ECU_ADDRESS 0x3F9832 /end MEASUREMENT
/begin MEASUREMENT ed_fsp_1of20_.uw_satz_1of3_.uw_km_stand_nv "Kilometerstand beim Fehlereintrag" UWORD FORMULA_0054 0 0.0 0.0 524280.0 READ_WRITE ECU_ADDRESS 0x3F980E /end MEASUREMENT
/begin MEASUREMENT ed_fsp_1of20_.uw_satz_1of3_.uw_wert_nv_1of4_ "Umweltbedingung beim Fehlereintrag" UWORD FORMULA_0010 0 0.0 0.0 65535.0 READ_WRITE ECU_ADDRESS 0x3F9810 /end MEASUREMENT
/begin MEASUREMENT ed_fsp_1of20_.uw_satz_1of3_.uw_wert_nv_2of4_ "Umweltbedingung beim Fehlereintrag" UWORD FORMULA_0010 0 0.0 0.0 65535.0 READ_WRITE ECU_ADDRESS 0x3F9812 /end MEASUREMENT
/begin MEASUREMENT ed_fsp_1of20_.uw_satz_1of3_.uw_wert_nv_3of4_ "Umweltbedingung beim Fehlereintrag" UWORD FORMULA_0010 0 0.0 0.0 65535.0 READ_WRITE ECU_ADDRESS 0x3F9814 /end MEASUREMENT
/begin MEASUREMENT ed_fsp_1of20_.uw_satz_1of3_.uw_wert_nv_4of4_ "Umweltbedingung beim Fehlereintrag" UWORD FORMULA_0010 0 0.0 0.0 65535.0 READ_WRITE ECU_ADDRESS 0x3F9816 /end MEASUREMENT
/begin MEASUREMENT ed_fsp_1of20_.uw_satz_2of3_.uw_km_stand_nv "Kilometerstand beim Fehlereintrag" UWORD FORMULA_0054 0 0.0 0.0 524280.0 READ_WRITE ECU_ADDRESS 0x3F9818 /end MEASUREMENT
/begin MEASUREMENT ed_fsp_1of20_.uw_satz_2of3_.uw_wert_nv_1of4_ "Umweltbedingung beim Fehlereintrag" UWORD FORMULA_0010 0 0.0 0.0 65535.0 READ_WRITE ECU_ADDRESS 0x3F981A /end MEASUREMENT
/begin MEASUREMENT ed_fsp_1of20_.uw_satz_2of3_.uw_wert_nv_2of4_ "Umweltbedingung beim Fehlereintrag" UWORD FORMULA_0010 0 0.0 0.0 65535.0 READ_WRITE ECU_ADDRESS 0x3F981C /end MEASUREMENT
/begin MEASUREMENT ed_fsp_1of20_.uw_satz_2of3_.uw_wert_nv_3of4_ "Umweltbedingung beim Fehlereintrag" UWORD FORMULA_0010 0 0.0 0.0 65535.0 READ_WRITE ECU_ADDRESS 0x3F981E /end MEASUREMENT
/begin MEASUREMENT ed_fsp_1of20_.uw_satz_2of3_.uw_wert_nv_4of4_ "Umweltbedingung beim Fehlereintrag" UWORD FORMULA_0010 0 0.0 0.0 65535.0 READ_WRITE ECU_ADDRESS 0x3F9820 /end MEASUREMENT
/begin MEASUREMENT ed_fsp_1of20_.uw_satz_3of3_.uw_km_stand_nv "Kilometerstand beim Fehlereintrag" UWORD FORMULA_0054 0 0.0 0.0 524280.0 READ_WRITE ECU_ADDRESS 0x3F9822 /end MEASUREMENT
/begin MEASUREMENT ed_fsp_1of20_.uw_satz_3of3_.uw_wert_nv_1of4_ "Umweltbedingung beim Fehlereintrag" UWORD FORMULA_0010 0 0.0 0.0 65535.0 READ_WRITE ECU_ADDRESS 0x3F9824 /end MEASUREMENT
/begin MEASUREMENT ed_fsp_1of20_.uw_satz_3of3_.uw_wert_nv_2of4_ "Umweltbedingung beim Fehlereintrag" UWORD FORMULA_0010 0 0.0 0.0 65535.0 READ_WRITE ECU_ADDRESS 0x3F9826 /end MEASUREMENT
/begin MEASUREMENT ed_fsp_1of20_.uw_satz_3of3_.uw_wert_nv_3of4_ "Umweltbedingung beim Fehlereintrag" UWORD FORMULA_0010 0 0.0 0.0 65535.0 READ_WRITE ECU_ADDRESS 0x3F9828 /end MEASUREMENT
/begin MEASUREMENT ed_fsp_1of20_.uw_satz_3of3_.uw_wert_nv_4of4_ "Umweltbedingung beim Fehlereintrag" UWORD FORMULA_0010 0 0.0 0.0 65535.0 READ_WRITE ECU_ADDRESS 0x3F982A /end MEASUREMENT
/begin MEASUREMENT ed_fsp_20of20_.ed_fil_index_nv "Verweis auf Fehlerfilter" UWORD FORMULA_0010 0 0.0 0.0 65535.0 READ_WRITE ECU_ADDRESS 0x3F9D14 /end MEASUREMENT
/begin MEASUREMENT ed_fsp_20of20_.fehlerart_nv "Fehlerart und Statusbits" UWORD FORMULA_0010 0 0.0 0.0 65535.0 READ_WRITE ECU_ADDRESS 0x3F9CF0 /end MEASUREMENT
/begin MEASUREMENT ed_fsp_20of20_.fehlercode_nv "Externer Fehlerort" UWORD FORMULA_0053 0 0.0 0.0 65535.0 READ_WRITE ECU_ADDRESS 0x3F9CEE /end MEASUREMENT
/begin MEASUREMENT ed_fsp_20of20_.ff_egas_ist_dk_b1_nv "Drosselklappenposition des Freeze Frame" UBYTE FORMULA_0059 0 0.0 0.0 100.0 READ_WRITE ECU_ADDRESS 0x3F9D2E /end MEASUREMENT
/begin MEASUREMENT ed_fsp_20of20_.ff_laa_f_ber_b1_nv "Lambdaadaptionsfaktor ohne TE des Freeze Frame" UBYTE FORMULA_0058 0 0.0 0.0 1.99210000038147 READ_WRITE ECU_ADDRESS 0x3F9D26 /end MEASUREMENT
/begin MEASUREMENT ed_fsp_20of20_.ff_laa_f_ber_b2_nv "Lambdaadaptionsfaktor ohne TE des Freeze Frame" UBYTE FORMULA_0058 0 0.0 0.0 1.99210000038147 READ_WRITE ECU_ADDRESS 0x3F9D27 /end MEASUREMENT
/begin MEASUREMENT ed_fsp_20of20_.ff_lam_reg_b1_nv "Einspritzsystem des Freeze Frame" UBYTE FORMULA_0057 0 0.0 0.0 255.0 READ_WRITE ECU_ADDRESS 0x3F9D22 /end MEASUREMENT
/begin MEASUREMENT ed_fsp_20of20_.ff_lam_reg_b2_nv "Einspritzsystem des Freeze Frame" UBYTE FORMULA_0057 0 0.0 0.0 255.0 READ_WRITE ECU_ADDRESS 0x3F9D23 /end MEASUREMENT
/begin MEASUREMENT ed_fsp_20of20_.ff_lam_reg_f_b1_nv "Lambdaregelfaktor des Freeze Frame" UBYTE FORMULA_0058 0 0.0 0.0 1.99210000038147 READ_WRITE ECU_ADDRESS 0x3F9D24 /end MEASUREMENT
/begin MEASUREMENT ed_fsp_20of20_.ff_lam_reg_f_b2_nv "Lambdaregelfaktor des Freeze Frame" UBYTE FORMULA_0058 0 0.0 0.0 1.99210000038147 READ_WRITE ECU_ADDRESS 0x3F9D25 /end MEASUREMENT
/begin MEASUREMENT ed_fsp_20of20_.ff_ml_ges_nv "Luftmasse des Freeze Frame" UWORD FORMULA_0056 0 0.0 0.0 655.3499755859375 READ_WRITE ECU_ADDRESS 0x3F9D20 /end MEASUREMENT
/begin MEASUREMENT ed_fsp_20of20_.ff_n_nv "Drehzahl des Freeze Frame" UWORD FORMULA_0055 0 0.0 0.0 16383.75 READ_WRITE ECU_ADDRESS 0x3F9D1E /end MEASUREMENT
/begin MEASUREMENT ed_fsp_20of20_.ff_p_code_nv "P-Code des Freeze Frame" UWORD FORMULA_0010 0 0.0 0.0 65535.0 READ_WRITE ECU_ADDRESS 0x3F9D1C /end MEASUREMENT
/begin MEASUREMENT ed_fsp_20of20_.ff_pks_ist_nv "Kraftstoffdruck des Freeze Frame" UBYTE FORMULA_0061 0 0.0 0.0 765.0 READ_WRITE ECU_ADDRESS 0x3F9D2A /end MEASUREMENT
/begin MEASUREMENT ed_fsp_20of20_.ff_rf_m_nv "Last des Freeze Frame" UBYTE FORMULA_0059 0 0.0 0.0 100.0 READ_WRITE ECU_ADDRESS 0x3F9D28 /end MEASUREMENT
/begin MEASUREMENT ed_fsp_20of20_.ff_sl_st_nv "Sekundaerluftstatus des Freeze Frame" UBYTE FORMULA_0064 0 0.0 0.0 255.0 READ_WRITE ECU_ADDRESS 0x3F9D2F /end MEASUREMENT
/begin MEASUREMENT ed_fsp_20of20_.ff_tan_m_nv "Ansauglufttemperatur des Freeze Frame" UBYTE FORMULA_0060 0 0.0 -40.0 215.0 READ_WRITE ECU_ADDRESS 0x3F9D2D /end MEASUREMENT
/begin MEASUREMENT ed_fsp_20of20_.ff_tmot_nv "Kuehlwassertemperatur des Freeze Frame" UBYTE FORMULA_0060 0 0.0 -40.0 215.0 READ_WRITE ECU_ADDRESS 0x3F9D29 /end MEASUREMENT
/begin MEASUREMENT ed_fsp_20of20_.ff_tz1_nv "Zuendwinkel 1 des Freeze Frame" UBYTE FORMULA_0063 0 0.0 -64.0 63.5 READ_WRITE ECU_ADDRESS 0x3F9D2C /end MEASUREMENT
/begin MEASUREMENT ed_fsp_20of20_.ff_v_vorne_nv "Geschwindigkeit des Freeze Frame" UBYTE FORMULA_0062 0 0.0 0.0 255.0 READ_WRITE ECU_ADDRESS 0x3F9D2B /end MEASUREMENT
/begin MEASUREMENT ed_fsp_20of20_.haeufigkeitszaehler_nv "Uebergangszaehler von i.O. -> n.i.O" UBYTE FORMULA_0003 0 0.0 0.0 255.0 READ_WRITE ECU_ADDRESS 0x3F9CF2 /end MEASUREMENT
/begin MEASUREMENT ed_fsp_20of20_.inj_fehlerzaehler_nv "INJ-Fehlerzaehler" UWORD FORMULA_0010 0 0.0 0.0 65535.0 READ_WRITE ECU_ADDRESS 0x3F9D12 /end MEASUREMENT
/begin MEASUREMENT ed_fsp_20of20_.logistikzaehler_nv "Warm-Up-Cycling-Zaehler" UBYTE FORMULA_0003 0 0.0 0.0 255.0 READ_WRITE ECU_ADDRESS 0x3F9CF3 /end MEASUREMENT
/begin MEASUREMENT ed_fsp_20of20_.mil_filter_nv "Filterwert der Milansteuerung" UBYTE FORMULA_0003 0 0.0 0.0 255.0 READ_WRITE ECU_ADDRESS 0x3F9D16 /end MEASUREMENT
/begin MEASUREMENT ed_fsp_20of20_.mil_filter_scdn_nv "Similar Conditions Eintragsfilterwert der Milansteuerung" UBYTE FORMULA_0003 0 0.0 0.0 255.0 READ_WRITE ECU_ADDRESS 0x3F9D17 /end MEASUREMENT
/begin MEASUREMENT ed_fsp_20of20_.scdn_nenner_nv "Gesamte Anzahl" UWORD FORMULA_0010 0 0.0 0.0 65535.0 READ_WRITE ECU_ADDRESS 0x3F9D1A /end MEASUREMENT
/begin MEASUREMENT ed_fsp_20of20_.scdn_zaehler_nv "Im similar Fenster" UWORD FORMULA_0010 0 0.0 0.0 65535.0 READ_WRITE ECU_ADDRESS 0x3F9D18 /end MEASUREMENT
/begin MEASUREMENT ed_fsp_20of20_.uw_satz_1of3_.uw_km_stand_nv "Kilometerstand beim Fehlereintrag" UWORD FORMULA_0054 0 0.0 0.0 524280.0 READ_WRITE ECU_ADDRESS 0x3F9CF4 /end MEASUREMENT
/begin MEASUREMENT ed_fsp_20of20_.uw_satz_1of3_.uw_wert_nv_1of4_ "Umweltbedingung beim Fehlereintrag" UWORD FORMULA_0010 0 0.0 0.0 65535.0 READ_WRITE ECU_ADDRESS 0x3F9CF6 /end MEASUREMENT
/begin MEASUREMENT ed_fsp_20of20_.uw_satz_1of3_.uw_wert_nv_2of4_ "Umweltbedingung beim Fehlereintrag" UWORD FORMULA_0010 0 0.0 0.0 65535.0 READ_WRITE ECU_ADDRESS 0x3F9CF8 /end MEASUREMENT
/begin MEASUREMENT ed_fsp_20of20_.uw_satz_1of3_.uw_wert_nv_3of4_ "Umweltbedingung beim Fehlereintrag" UWORD FORMULA_0010 0 0.0 0.0 65535.0 READ_WRITE ECU_ADDRESS 0x3F9CFA /end MEASUREMENT
/begin MEASUREMENT ed_fsp_20of20_.uw_satz_1of3_.uw_wert_nv_4of4_ "Umweltbedingung beim Fehlereintrag" UWORD FORMULA_0010 0 0.0 0.0 65535.0 READ_WRITE ECU_ADDRESS 0x3F9CFC /end MEASUREMENT
/begin MEASUREMENT ed_fsp_20of20_.uw_satz_2of3_.uw_km_stand_nv "Kilometerstand beim Fehlereintrag" UWORD FORMULA_0054 0 0.0 0.0 524280.0 READ_WRITE ECU_ADDRESS 0x3F9CFE /end MEASUREMENT
/begin MEASUREMENT ed_fsp_20of20_.uw_satz_2of3_.uw_wert_nv_1of4_ "Umweltbedingung beim Fehlereintrag" UWORD FORMULA_0010 0 0.0 0.0 65535.0 READ_WRITE ECU_ADDRESS 0x3F9D00 /end MEASUREMENT
/begin MEASUREMENT ed_fsp_20of20_.uw_satz_2of3_.uw_wert_nv_2of4_ "Umweltbedingung beim Fehlereintrag" UWORD FORMULA_0010 0 0.0 0.0 65535.0 READ_WRITE ECU_ADDRESS 0x3F9D02 /end MEASUREMENT
/begin MEASUREMENT ed_fsp_20of20_.uw_satz_2of3_.uw_wert_nv_3of4_ "Umweltbedingung beim Fehlereintrag" UWORD FORMULA_0010 0 0.0 0.0 65535.0 READ_WRITE ECU_ADDRESS 0x3F9D04 /end MEASUREMENT
/begin MEASUREMENT ed_fsp_20of20_.uw_satz_2of3_.uw_wert_nv_4of4_ "Umweltbedingung beim Fehlereintrag" UWORD FORMULA_0010 0 0.0 0.0 65535.0 READ_WRITE ECU_ADDRESS 0x3F9D06 /end MEASUREMENT
/begin MEASUREMENT ed_fsp_20of20_.uw_satz_3of3_.uw_km_stand_nv "Kilometerstand beim Fehlereintrag" UWORD FORMULA_0054 0 0.0 0.0 524280.0 READ_WRITE ECU_ADDRESS 0x3F9D08 /end MEASUREMENT
/begin MEASUREMENT ed_fsp_20of20_.uw_satz_3of3_.uw_wert_nv_1of4_ "Umweltbedingung beim Fehlereintrag" UWORD FORMULA_0010 0 0.0 0.0 65535.0 READ_WRITE ECU_ADDRESS 0x3F9D0A /end MEASUREMENT
/begin MEASUREMENT ed_fsp_20of20_.uw_satz_3of3_.uw_wert_nv_2of4_ "Umweltbedingung beim Fehlereintrag" UWORD FORMULA_0010 0 0.0 0.0 65535.0 READ_WRITE ECU_ADDRESS 0x3F9D0C /end MEASUREMENT
/begin MEASUREMENT ed_fsp_20of20_.uw_satz_3of3_.uw_wert_nv_3of4_ "Umweltbedingung beim Fehlereintrag" UWORD FORMULA_0010 0 0.0 0.0 65535.0 READ_WRITE ECU_ADDRESS 0x3F9D0E /end MEASUREMENT
/begin MEASUREMENT ed_fsp_20of20_.uw_satz_3of3_.uw_wert_nv_4of4_ "Umweltbedingung beim Fehlereintrag" UWORD FORMULA_0010 0 0.0 0.0 65535.0 READ_WRITE ECU_ADDRESS 0x3F9D10 /end MEASUREMENT
/begin MEASUREMENT ed_fsp_2of20_.ed_fil_index_nv "Verweis auf Fehlerfilter" UWORD FORMULA_0010 0 0.0 0.0 65535.0 READ_WRITE ECU_ADDRESS 0x3F9870 /end MEASUREMENT
/begin MEASUREMENT ed_fsp_2of20_.fehlerart_nv "Fehlerart und Statusbits" UWORD FORMULA_0010 0 0.0 0.0 65535.0 READ_WRITE ECU_ADDRESS 0x3F984C /end MEASUREMENT
/begin MEASUREMENT ed_fsp_2of20_.fehlercode_nv "Externer Fehlerort" UWORD FORMULA_0053 0 0.0 0.0 65535.0 READ_WRITE ECU_ADDRESS 0x3F984A /end MEASUREMENT
/begin MEASUREMENT ed_fsp_2of20_.ff_egas_ist_dk_b1_nv "Drosselklappenposition des Freeze Frame" UBYTE FORMULA_0059 0 0.0 0.0 100.0 READ_WRITE ECU_ADDRESS 0x3F988A /end MEASUREMENT
/begin MEASUREMENT ed_fsp_2of20_.ff_laa_f_ber_b1_nv "Lambdaadaptionsfaktor ohne TE des Freeze Frame" UBYTE FORMULA_0058 0 0.0 0.0 1.99210000038147 READ_WRITE ECU_ADDRESS 0x3F9882 /end MEASUREMENT
/begin MEASUREMENT ed_fsp_2of20_.ff_laa_f_ber_b2_nv "Lambdaadaptionsfaktor ohne TE des Freeze Frame" UBYTE FORMULA_0058 0 0.0 0.0 1.99210000038147 READ_WRITE ECU_ADDRESS 0x3F9883 /end MEASUREMENT
/begin MEASUREMENT ed_fsp_2of20_.ff_lam_reg_b1_nv "Einspritzsystem des Freeze Frame" UBYTE FORMULA_0057 0 0.0 0.0 255.0 READ_WRITE ECU_ADDRESS 0x3F987E /end MEASUREMENT
/begin MEASUREMENT ed_fsp_2of20_.ff_lam_reg_b2_nv "Einspritzsystem des Freeze Frame" UBYTE FORMULA_0057 0 0.0 0.0 255.0 READ_WRITE ECU_ADDRESS 0x3F987F /end MEASUREMENT
/begin MEASUREMENT ed_fsp_2of20_.ff_lam_reg_f_b1_nv "Lambdaregelfaktor des Freeze Frame" UBYTE FORMULA_0058 0 0.0 0.0 1.99210000038147 READ_WRITE ECU_ADDRESS 0x3F9880 /end MEASUREMENT
/begin MEASUREMENT ed_fsp_2of20_.ff_lam_reg_f_b2_nv "Lambdaregelfaktor des Freeze Frame" UBYTE FORMULA_0058 0 0.0 0.0 1.99210000038147 READ_WRITE ECU_ADDRESS 0x3F9881 /end MEASUREMENT
/begin MEASUREMENT ed_fsp_2of20_.ff_ml_ges_nv "Luftmasse des Freeze Frame" UWORD FORMULA_0056 0 0.0 0.0 655.3499755859375 READ_WRITE ECU_ADDRESS 0x3F987C /end MEASUREMENT
/begin MEASUREMENT ed_fsp_2of20_.ff_n_nv "Drehzahl des Freeze Frame" UWORD FORMULA_0055 0 0.0 0.0 16383.75 READ_WRITE ECU_ADDRESS 0x3F987A /end MEASUREMENT
/begin MEASUREMENT ed_fsp_2of20_.ff_p_code_nv "P-Code des Freeze Frame" UWORD FORMULA_0010 0 0.0 0.0 65535.0 READ_WRITE ECU_ADDRESS 0x3F9878 /end MEASUREMENT
/begin MEASUREMENT ed_fsp_2of20_.ff_pks_ist_nv "Kraftstoffdruck des Freeze Frame" UBYTE FORMULA_0061 0 0.0 0.0 765.0 READ_WRITE ECU_ADDRESS 0x3F9886 /end MEASUREMENT
/begin MEASUREMENT ed_fsp_2of20_.ff_rf_m_nv "Last des Freeze Frame" UBYTE FORMULA_0059 0 0.0 0.0 100.0 READ_WRITE ECU_ADDRESS 0x3F9884 /end MEASUREMENT
/begin MEASUREMENT ed_fsp_2of20_.ff_sl_st_nv "Sekundaerluftstatus des Freeze Frame" UBYTE FORMULA_0064 0 0.0 0.0 255.0 READ_WRITE ECU_ADDRESS 0x3F988B /end MEASUREMENT
/begin MEASUREMENT ed_fsp_2of20_.ff_tan_m_nv "Ansauglufttemperatur des Freeze Frame" UBYTE FORMULA_0060 0 0.0 -40.0 215.0 READ_WRITE ECU_ADDRESS 0x3F9889 /end MEASUREMENT
/begin MEASUREMENT ed_fsp_2of20_.ff_tmot_nv "Kuehlwassertemperatur des Freeze Frame" UBYTE FORMULA_0060 0 0.0 -40.0 215.0 READ_WRITE ECU_ADDRESS 0x3F9885 /end MEASUREMENT
/begin MEASUREMENT ed_fsp_2of20_.ff_tz1_nv "Zuendwinkel 1 des Freeze Frame" UBYTE FORMULA_0063 0 0.0 -64.0 63.5 READ_WRITE ECU_ADDRESS 0x3F9888 /end MEASUREMENT
/begin MEASUREMENT ed_fsp_2of20_.ff_v_vorne_nv "Geschwindigkeit des Freeze Frame" UBYTE FORMULA_0062 0 0.0 0.0 255.0 READ_WRITE ECU_ADDRESS 0x3F9887 /end MEASUREMENT
/begin MEASUREMENT ed_fsp_2of20_.haeufigkeitszaehler_nv "Uebergangszaehler von i.O. -> n.i.O" UBYTE FORMULA_0003 0 0.0 0.0 255.0 READ_WRITE ECU_ADDRESS 0x3F984E /end MEASUREMENT
/begin MEASUREMENT ed_fsp_2of20_.inj_fehlerzaehler_nv "INJ-Fehlerzaehler" UWORD FORMULA_0010 0 0.0 0.0 65535.0 READ_WRITE ECU_ADDRESS 0x3F986E /end MEASUREMENT
/begin MEASUREMENT ed_fsp_2of20_.logistikzaehler_nv "Warm-Up-Cycling-Zaehler" UBYTE FORMULA_0003 0 0.0 0.0 255.0 READ_WRITE ECU_ADDRESS 0x3F984F /end MEASUREMENT
/begin MEASUREMENT ed_fsp_2of20_.mil_filter_nv "Filterwert der Milansteuerung" UBYTE FORMULA_0003 0 0.0 0.0 255.0 READ_WRITE ECU_ADDRESS 0x3F9872 /end MEASUREMENT
/begin MEASUREMENT ed_fsp_2of20_.mil_filter_scdn_nv "Similar Conditions Eintragsfilterwert der Milansteuerung" UBYTE FORMULA_0003 0 0.0 0.0 255.0 READ_WRITE ECU_ADDRESS 0x3F9873 /end MEASUREMENT
/begin MEASUREMENT ed_fsp_2of20_.scdn_nenner_nv "Gesamte Anzahl" UWORD FORMULA_0010 0 0.0 0.0 65535.0 READ_WRITE ECU_ADDRESS 0x3F9876 /end MEASUREMENT
/begin MEASUREMENT ed_fsp_2of20_.scdn_zaehler_nv "Im similar Fenster" UWORD FORMULA_0010 0 0.0 0.0 65535.0 READ_WRITE ECU_ADDRESS 0x3F9874 /end MEASUREMENT
/begin MEASUREMENT ed_fsp_2of20_.uw_satz_1of3_.uw_km_stand_nv "Kilometerstand beim Fehlereintrag" UWORD FORMULA_0054 0 0.0 0.0 524280.0 READ_WRITE ECU_ADDRESS 0x3F9850 /end MEASUREMENT
/begin MEASUREMENT ed_fsp_2of20_.uw_satz_1of3_.uw_wert_nv_1of4_ "Umweltbedingung beim Fehlereintrag" UWORD FORMULA_0010 0 0.0 0.0 65535.0 READ_WRITE ECU_ADDRESS 0x3F9852 /end MEASUREMENT
/begin MEASUREMENT ed_fsp_2of20_.uw_satz_1of3_.uw_wert_nv_2of4_ "Umweltbedingung beim Fehlereintrag" UWORD FORMULA_0010 0 0.0 0.0 65535.0 READ_WRITE ECU_ADDRESS 0x3F9854 /end MEASUREMENT
/begin MEASUREMENT ed_fsp_2of20_.uw_satz_1of3_.uw_wert_nv_3of4_ "Umweltbedingung beim Fehlereintrag" UWORD FORMULA_0010 0 0.0 0.0 65535.0 READ_WRITE ECU_ADDRESS 0x3F9856 /end MEASUREMENT
/begin MEASUREMENT ed_fsp_2of20_.uw_satz_1of3_.uw_wert_nv_4of4_ "Umweltbedingung beim Fehlereintrag" UWORD FORMULA_0010 0 0.0 0.0 65535.0 READ_WRITE ECU_ADDRESS 0x3F9858 /end MEASUREMENT
/begin MEASUREMENT ed_fsp_2of20_.uw_satz_2of3_.uw_km_stand_nv "Kilometerstand beim Fehlereintrag" UWORD FORMULA_0054 0 0.0 0.0 524280.0 READ_WRITE ECU_ADDRESS 0x3F985A /end MEASUREMENT
/begin MEASUREMENT ed_fsp_2of20_.uw_satz_2of3_.uw_wert_nv_1of4_ "Umweltbedingung beim Fehlereintrag" UWORD FORMULA_0010 0 0.0 0.0 65535.0 READ_WRITE ECU_ADDRESS 0x3F985C /end MEASUREMENT
/begin MEASUREMENT ed_fsp_2of20_.uw_satz_2of3_.uw_wert_nv_2of4_ "Umweltbedingung beim Fehlereintrag" UWORD FORMULA_0010 0 0.0 0.0 65535.0 READ_WRITE ECU_ADDRESS 0x3F985E /end MEASUREMENT
/begin MEASUREMENT ed_fsp_2of20_.uw_satz_2of3_.uw_wert_nv_3of4_ "Umweltbedingung beim Fehlereintrag" UWORD FORMULA_0010 0 0.0 0.0 65535.0 READ_WRITE ECU_ADDRESS 0x3F9860 /end MEASUREMENT
/begin MEASUREMENT ed_fsp_2of20_.uw_satz_2of3_.uw_wert_nv_4of4_ "Umweltbedingung beim Fehlereintrag" UWORD FORMULA_0010 0 0.0 0.0 65535.0 READ_WRITE ECU_ADDRESS 0x3F9862 /end MEASUREMENT
/begin MEASUREMENT ed_fsp_2of20_.uw_satz_3of3_.uw_km_stand_nv "Kilometerstand beim Fehlereintrag" UWORD FORMULA_0054 0 0.0 0.0 524280.0 READ_WRITE ECU_ADDRESS 0x3F9864 /end MEASUREMENT
/begin MEASUREMENT ed_fsp_2of20_.uw_satz_3of3_.uw_wert_nv_1of4_ "Umweltbedingung beim Fehlereintrag" UWORD FORMULA_0010 0 0.0 0.0 65535.0 READ_WRITE ECU_ADDRESS 0x3F9866 /end MEASUREMENT
/begin MEASUREMENT ed_fsp_2of20_.uw_satz_3of3_.uw_wert_nv_2of4_ "Umweltbedingung beim Fehlereintrag" UWORD FORMULA_0010 0 0.0 0.0 65535.0 READ_WRITE ECU_ADDRESS 0x3F9868 /end MEASUREMENT
/begin MEASUREMENT ed_fsp_2of20_.uw_satz_3of3_.uw_wert_nv_3of4_ "Umweltbedingung beim Fehlereintrag" UWORD FORMULA_0010 0 0.0 0.0 65535.0 READ_WRITE ECU_ADDRESS 0x3F986A /end MEASUREMENT
/begin MEASUREMENT ed_fsp_2of20_.uw_satz_3of3_.uw_wert_nv_4of4_ "Umweltbedingung beim Fehlereintrag" UWORD FORMULA_0010 0 0.0 0.0 65535.0 READ_WRITE ECU_ADDRESS 0x3F986C /end MEASUREMENT
/begin MEASUREMENT ed_fsp_3of20_.ed_fil_index_nv "Verweis auf Fehlerfilter" UWORD FORMULA_0010 0 0.0 0.0 65535.0 READ_WRITE ECU_ADDRESS 0x3F98B2 /end MEASUREMENT
/begin MEASUREMENT ed_fsp_3of20_.fehlerart_nv "Fehlerart und Statusbits" UWORD FORMULA_0010 0 0.0 0.0 65535.0 READ_WRITE ECU_ADDRESS 0x3F988E /end MEASUREMENT
/begin MEASUREMENT ed_fsp_3of20_.fehlercode_nv "Externer Fehlerort" UWORD FORMULA_0053 0 0.0 0.0 65535.0 READ_WRITE ECU_ADDRESS 0x3F988C /end MEASUREMENT
/begin MEASUREMENT ed_fsp_3of20_.ff_egas_ist_dk_b1_nv "Drosselklappenposition des Freeze Frame" UBYTE FORMULA_0059 0 0.0 0.0 100.0 READ_WRITE ECU_ADDRESS 0x3F98CC /end MEASUREMENT
/begin MEASUREMENT ed_fsp_3of20_.ff_laa_f_ber_b1_nv "Lambdaadaptionsfaktor ohne TE des Freeze Frame" UBYTE FORMULA_0058 0 0.0 0.0 1.99210000038147 READ_WRITE ECU_ADDRESS 0x3F98C4 /end MEASUREMENT
/begin MEASUREMENT ed_fsp_3of20_.ff_laa_f_ber_b2_nv "Lambdaadaptionsfaktor ohne TE des Freeze Frame" UBYTE FORMULA_0058 0 0.0 0.0 1.99210000038147 READ_WRITE ECU_ADDRESS 0x3F98C5 /end MEASUREMENT
/begin MEASUREMENT ed_fsp_3of20_.ff_lam_reg_b1_nv "Einspritzsystem des Freeze Frame" UBYTE FORMULA_0057 0 0.0 0.0 255.0 READ_WRITE ECU_ADDRESS 0x3F98C0 /end MEASUREMENT
/begin MEASUREMENT ed_fsp_3of20_.ff_lam_reg_b2_nv "Einspritzsystem des Freeze Frame" UBYTE FORMULA_0057 0 0.0 0.0 255.0 READ_WRITE ECU_ADDRESS 0x3F98C1 /end MEASUREMENT
/begin MEASUREMENT ed_fsp_3of20_.ff_lam_reg_f_b1_nv "Lambdaregelfaktor des Freeze Frame" UBYTE FORMULA_0058 0 0.0 0.0 1.99210000038147 READ_WRITE ECU_ADDRESS 0x3F98C2 /end MEASUREMENT
/begin MEASUREMENT ed_fsp_3of20_.ff_lam_reg_f_b2_nv "Lambdaregelfaktor des Freeze Frame" UBYTE FORMULA_0058 0 0.0 0.0 1.99210000038147 READ_WRITE ECU_ADDRESS 0x3F98C3 /end MEASUREMENT
/begin MEASUREMENT ed_fsp_3of20_.ff_ml_ges_nv "Luftmasse des Freeze Frame" UWORD FORMULA_0056 0 0.0 0.0 655.3499755859375 READ_WRITE ECU_ADDRESS 0x3F98BE /end MEASUREMENT
/begin MEASUREMENT ed_fsp_3of20_.ff_n_nv "Drehzahl des Freeze Frame" UWORD FORMULA_0055 0 0.0 0.0 16383.75 READ_WRITE ECU_ADDRESS 0x3F98BC /end MEASUREMENT
/begin MEASUREMENT ed_fsp_3of20_.ff_p_code_nv "P-Code des Freeze Frame" UWORD FORMULA_0010 0 0.0 0.0 65535.0 READ_WRITE ECU_ADDRESS 0x3F98BA /end MEASUREMENT
/begin MEASUREMENT ed_fsp_3of20_.ff_pks_ist_nv "Kraftstoffdruck des Freeze Frame" UBYTE FORMULA_0061 0 0.0 0.0 765.0 READ_WRITE ECU_ADDRESS 0x3F98C8 /end MEASUREMENT
/begin MEASUREMENT ed_fsp_3of20_.ff_rf_m_nv "Last des Freeze Frame" UBYTE FORMULA_0059 0 0.0 0.0 100.0 READ_WRITE ECU_ADDRESS 0x3F98C6 /end MEASUREMENT
/begin MEASUREMENT ed_fsp_3of20_.ff_sl_st_nv "Sekundaerluftstatus des Freeze Frame" UBYTE FORMULA_0064 0 0.0 0.0 255.0 READ_WRITE ECU_ADDRESS 0x3F98CD /end MEASUREMENT
/begin MEASUREMENT ed_fsp_3of20_.ff_tan_m_nv "Ansauglufttemperatur des Freeze Frame" UBYTE FORMULA_0060 0 0.0 -40.0 215.0 READ_WRITE ECU_ADDRESS 0x3F98CB /end MEASUREMENT
/begin MEASUREMENT ed_fsp_3of20_.ff_tmot_nv "Kuehlwassertemperatur des Freeze Frame" UBYTE FORMULA_0060 0 0.0 -40.0 215.0 READ_WRITE ECU_ADDRESS 0x3F98C7 /end MEASUREMENT
/begin MEASUREMENT ed_fsp_3of20_.ff_tz1_nv "Zuendwinkel 1 des Freeze Frame" UBYTE FORMULA_0063 0 0.0 -64.0 63.5 READ_WRITE ECU_ADDRESS 0x3F98CA /end MEASUREMENT
/begin MEASUREMENT ed_fsp_3of20_.ff_v_vorne_nv "Geschwindigkeit des Freeze Frame" UBYTE FORMULA_0062 0 0.0 0.0 255.0 READ_WRITE ECU_ADDRESS 0x3F98C9 /end MEASUREMENT
/begin MEASUREMENT ed_fsp_3of20_.haeufigkeitszaehler_nv "Uebergangszaehler von i.O. -> n.i.O" UBYTE FORMULA_0003 0 0.0 0.0 255.0 READ_WRITE ECU_ADDRESS 0x3F9890 /end MEASUREMENT
/begin MEASUREMENT ed_fsp_3of20_.inj_fehlerzaehler_nv "INJ-Fehlerzaehler" UWORD FORMULA_0010 0 0.0 0.0 65535.0 READ_WRITE ECU_ADDRESS 0x3F98B0 /end MEASUREMENT
/begin MEASUREMENT ed_fsp_3of20_.logistikzaehler_nv "Warm-Up-Cycling-Zaehler" UBYTE FORMULA_0003 0 0.0 0.0 255.0 READ_WRITE ECU_ADDRESS 0x3F9891 /end MEASUREMENT
/begin MEASUREMENT ed_fsp_3of20_.mil_filter_nv "Filterwert der Milansteuerung" UBYTE FORMULA_0003 0 0.0 0.0 255.0 READ_WRITE ECU_ADDRESS 0x3F98B4 /end MEASUREMENT
/begin MEASUREMENT ed_fsp_3of20_.mil_filter_scdn_nv "Similar Conditions Eintragsfilterwert der Milansteuerung" UBYTE FORMULA_0003 0 0.0 0.0 255.0 READ_WRITE ECU_ADDRESS 0x3F98B5 /end MEASUREMENT
/begin MEASUREMENT ed_fsp_3of20_.scdn_nenner_nv "Gesamte Anzahl" UWORD FORMULA_0010 0 0.0 0.0 65535.0 READ_WRITE ECU_ADDRESS 0x3F98B8 /end MEASUREMENT
/begin MEASUREMENT ed_fsp_3of20_.scdn_zaehler_nv "Im similar Fenster" UWORD FORMULA_0010 0 0.0 0.0 65535.0 READ_WRITE ECU_ADDRESS 0x3F98B6 /end MEASUREMENT
/begin MEASUREMENT ed_fsp_3of20_.uw_satz_1of3_.uw_km_stand_nv "Kilometerstand beim Fehlereintrag" UWORD FORMULA_0054 0 0.0 0.0 524280.0 READ_WRITE ECU_ADDRESS 0x3F9892 /end MEASUREMENT
/begin MEASUREMENT ed_fsp_3of20_.uw_satz_1of3_.uw_wert_nv_1of4_ "Umweltbedingung beim Fehlereintrag" UWORD FORMULA_0010 0 0.0 0.0 65535.0 READ_WRITE ECU_ADDRESS 0x3F9894 /end MEASUREMENT
/begin MEASUREMENT ed_fsp_3of20_.uw_satz_1of3_.uw_wert_nv_2of4_ "Umweltbedingung beim Fehlereintrag" UWORD FORMULA_0010 0 0.0 0.0 65535.0 READ_WRITE ECU_ADDRESS 0x3F9896 /end MEASUREMENT
/begin MEASUREMENT ed_fsp_3of20_.uw_satz_1of3_.uw_wert_nv_3of4_ "Umweltbedingung beim Fehlereintrag" UWORD FORMULA_0010 0 0.0 0.0 65535.0 READ_WRITE ECU_ADDRESS 0x3F9898 /end MEASUREMENT
/begin MEASUREMENT ed_fsp_3of20_.uw_satz_1of3_.uw_wert_nv_4of4_ "Umweltbedingung beim Fehlereintrag" UWORD FORMULA_0010 0 0.0 0.0 65535.0 READ_WRITE ECU_ADDRESS 0x3F989A /end MEASUREMENT
/begin MEASUREMENT ed_fsp_3of20_.uw_satz_2of3_.uw_km_stand_nv "Kilometerstand beim Fehlereintrag" UWORD FORMULA_0054 0 0.0 0.0 524280.0 READ_WRITE ECU_ADDRESS 0x3F989C /end MEASUREMENT
/begin MEASUREMENT ed_fsp_3of20_.uw_satz_2of3_.uw_wert_nv_1of4_ "Umweltbedingung beim Fehlereintrag" UWORD FORMULA_0010 0 0.0 0.0 65535.0 READ_WRITE ECU_ADDRESS 0x3F989E /end MEASUREMENT
/begin MEASUREMENT ed_fsp_3of20_.uw_satz_2of3_.uw_wert_nv_2of4_ "Umweltbedingung beim Fehlereintrag" UWORD FORMULA_0010 0 0.0 0.0 65535.0 READ_WRITE ECU_ADDRESS 0x3F98A0 /end MEASUREMENT
/begin MEASUREMENT ed_fsp_3of20_.uw_satz_2of3_.uw_wert_nv_3of4_ "Umweltbedingung beim Fehlereintrag" UWORD FORMULA_0010 0 0.0 0.0 65535.0 READ_WRITE ECU_ADDRESS 0x3F98A2 /end MEASUREMENT
/begin MEASUREMENT ed_fsp_3of20_.uw_satz_2of3_.uw_wert_nv_4of4_ "Umweltbedingung beim Fehlereintrag" UWORD FORMULA_0010 0 0.0 0.0 65535.0 READ_WRITE ECU_ADDRESS 0x3F98A4 /end MEASUREMENT
/begin MEASUREMENT ed_fsp_3of20_.uw_satz_3of3_.uw_km_stand_nv "Kilometerstand beim Fehlereintrag" UWORD FORMULA_0054 0 0.0 0.0 524280.0 READ_WRITE ECU_ADDRESS 0x3F98A6 /end MEASUREMENT
/begin MEASUREMENT ed_fsp_3of20_.uw_satz_3of3_.uw_wert_nv_1of4_ "Umweltbedingung beim Fehlereintrag" UWORD FORMULA_0010 0 0.0 0.0 65535.0 READ_WRITE ECU_ADDRESS 0x3F98A8 /end MEASUREMENT
/begin MEASUREMENT ed_fsp_3of20_.uw_satz_3of3_.uw_wert_nv_2of4_ "Umweltbedingung beim Fehlereintrag" UWORD FORMULA_0010 0 0.0 0.0 65535.0 READ_WRITE ECU_ADDRESS 0x3F98AA /end MEASUREMENT
/begin MEASUREMENT ed_fsp_3of20_.uw_satz_3of3_.uw_wert_nv_3of4_ "Umweltbedingung beim Fehlereintrag" UWORD FORMULA_0010 0 0.0 0.0 65535.0 READ_WRITE ECU_ADDRESS 0x3F98AC /end MEASUREMENT
/begin MEASUREMENT ed_fsp_3of20_.uw_satz_3of3_.uw_wert_nv_4of4_ "Umweltbedingung beim Fehlereintrag" UWORD FORMULA_0010 0 0.0 0.0 65535.0 READ_WRITE ECU_ADDRESS 0x3F98AE /end MEASUREMENT
/begin MEASUREMENT ed_fsp_4of20_.ed_fil_index_nv "Verweis auf Fehlerfilter" UWORD FORMULA_0010 0 0.0 0.0 65535.0 READ_WRITE ECU_ADDRESS 0x3F98F4 /end MEASUREMENT
/begin MEASUREMENT ed_fsp_4of20_.fehlerart_nv "Fehlerart und Statusbits" UWORD FORMULA_0010 0 0.0 0.0 65535.0 READ_WRITE ECU_ADDRESS 0x3F98D0 /end MEASUREMENT
/begin MEASUREMENT ed_fsp_4of20_.fehlercode_nv "Externer Fehlerort" UWORD FORMULA_0053 0 0.0 0.0 65535.0 READ_WRITE ECU_ADDRESS 0x3F98CE /end MEASUREMENT
/begin MEASUREMENT ed_fsp_4of20_.ff_egas_ist_dk_b1_nv "Drosselklappenposition des Freeze Frame" UBYTE FORMULA_0059 0 0.0 0.0 100.0 READ_WRITE ECU_ADDRESS 0x3F990E /end MEASUREMENT
/begin MEASUREMENT ed_fsp_4of20_.ff_laa_f_ber_b1_nv "Lambdaadaptionsfaktor ohne TE des Freeze Frame" UBYTE FORMULA_0058 0 0.0 0.0 1.99210000038147 READ_WRITE ECU_ADDRESS 0x3F9906 /end MEASUREMENT
/begin MEASUREMENT ed_fsp_4of20_.ff_laa_f_ber_b2_nv "Lambdaadaptionsfaktor ohne TE des Freeze Frame" UBYTE FORMULA_0058 0 0.0 0.0 1.99210000038147 READ_WRITE ECU_ADDRESS 0x3F9907 /end MEASUREMENT
/begin MEASUREMENT ed_fsp_4of20_.ff_lam_reg_b1_nv "Einspritzsystem des Freeze Frame" UBYTE FORMULA_0057 0 0.0 0.0 255.0 READ_WRITE ECU_ADDRESS 0x3F9902 /end MEASUREMENT
/begin MEASUREMENT ed_fsp_4of20_.ff_lam_reg_b2_nv "Einspritzsystem des Freeze Frame" UBYTE FORMULA_0057 0 0.0 0.0 255.0 READ_WRITE ECU_ADDRESS 0x3F9903 /end MEASUREMENT
/begin MEASUREMENT ed_fsp_4of20_.ff_lam_reg_f_b1_nv "Lambdaregelfaktor des Freeze Frame" UBYTE FORMULA_0058 0 0.0 0.0 1.99210000038147 READ_WRITE ECU_ADDRESS 0x3F9904 /end MEASUREMENT
/begin MEASUREMENT ed_fsp_4of20_.ff_lam_reg_f_b2_nv "Lambdaregelfaktor des Freeze Frame" UBYTE FORMULA_0058 0 0.0 0.0 1.99210000038147 READ_WRITE ECU_ADDRESS 0x3F9905 /end MEASUREMENT
/begin MEASUREMENT ed_fsp_4of20_.ff_ml_ges_nv "Luftmasse des Freeze Frame" UWORD FORMULA_0056 0 0.0 0.0 655.3499755859375 READ_WRITE ECU_ADDRESS 0x3F9900 /end MEASUREMENT
/begin MEASUREMENT ed_fsp_4of20_.ff_n_nv "Drehzahl des Freeze Frame" UWORD FORMULA_0055 0 0.0 0.0 16383.75 READ_WRITE ECU_ADDRESS 0x3F98FE /end MEASUREMENT
/begin MEASUREMENT ed_fsp_4of20_.ff_p_code_nv "P-Code des Freeze Frame" UWORD FORMULA_0010 0 0.0 0.0 65535.0 READ_WRITE ECU_ADDRESS 0x3F98FC /end MEASUREMENT
/begin MEASUREMENT ed_fsp_4of20_.ff_pks_ist_nv "Kraftstoffdruck des Freeze Frame" UBYTE FORMULA_0061 0 0.0 0.0 765.0 READ_WRITE ECU_ADDRESS 0x3F990A /end MEASUREMENT
/begin MEASUREMENT ed_fsp_4of20_.ff_rf_m_nv "Last des Freeze Frame" UBYTE FORMULA_0059 0 0.0 0.0 100.0 READ_WRITE ECU_ADDRESS 0x3F9908 /end MEASUREMENT
/begin MEASUREMENT ed_fsp_4of20_.ff_sl_st_nv "Sekundaerluftstatus des Freeze Frame" UBYTE FORMULA_0064 0 0.0 0.0 255.0 READ_WRITE ECU_ADDRESS 0x3F990F /end MEASUREMENT
/begin MEASUREMENT ed_fsp_4of20_.ff_tan_m_nv "Ansauglufttemperatur des Freeze Frame" UBYTE FORMULA_0060 0 0.0 -40.0 215.0 READ_WRITE ECU_ADDRESS 0x3F990D /end MEASUREMENT
/begin MEASUREMENT ed_fsp_4of20_.ff_tmot_nv "Kuehlwassertemperatur des Freeze Frame" UBYTE FORMULA_0060 0 0.0 -40.0 215.0 READ_WRITE ECU_ADDRESS 0x3F9909 /end MEASUREMENT
/begin MEASUREMENT ed_fsp_4of20_.ff_tz1_nv "Zuendwinkel 1 des Freeze Frame" UBYTE FORMULA_0063 0 0.0 -64.0 63.5 READ_WRITE ECU_ADDRESS 0x3F990C /end MEASUREMENT
/begin MEASUREMENT ed_fsp_4of20_.ff_v_vorne_nv "Geschwindigkeit des Freeze Frame" UBYTE FORMULA_0062 0 0.0 0.0 255.0 READ_WRITE ECU_ADDRESS 0x3F990B /end MEASUREMENT
/begin MEASUREMENT ed_fsp_4of20_.haeufigkeitszaehler_nv "Uebergangszaehler von i.O. -> n.i.O" UBYTE FORMULA_0003 0 0.0 0.0 255.0 READ_WRITE ECU_ADDRESS 0x3F98D2 /end MEASUREMENT
/begin MEASUREMENT ed_fsp_4of20_.inj_fehlerzaehler_nv "INJ-Fehlerzaehler" UWORD FORMULA_0010 0 0.0 0.0 65535.0 READ_WRITE ECU_ADDRESS 0x3F98F2 /end MEASUREMENT
/begin MEASUREMENT ed_fsp_4of20_.logistikzaehler_nv "Warm-Up-Cycling-Zaehler" UBYTE FORMULA_0003 0 0.0 0.0 255.0 READ_WRITE ECU_ADDRESS 0x3F98D3 /end MEASUREMENT
/begin MEASUREMENT ed_fsp_4of20_.mil_filter_nv "Filterwert der Milansteuerung" UBYTE FORMULA_0003 0 0.0 0.0 255.0 READ_WRITE ECU_ADDRESS 0x3F98F6 /end MEASUREMENT
/begin MEASUREMENT ed_fsp_4of20_.mil_filter_scdn_nv "Similar Conditions Eintragsfilterwert der Milansteuerung" UBYTE FORMULA_0003 0 0.0 0.0 255.0 READ_WRITE ECU_ADDRESS 0x3F98F7 /end MEASUREMENT
/begin MEASUREMENT ed_fsp_4of20_.scdn_nenner_nv "Gesamte Anzahl" UWORD FORMULA_0010 0 0.0 0.0 65535.0 READ_WRITE ECU_ADDRESS 0x3F98FA /end MEASUREMENT
/begin MEASUREMENT ed_fsp_4of20_.scdn_zaehler_nv "Im similar Fenster" UWORD FORMULA_0010 0 0.0 0.0 65535.0 READ_WRITE ECU_ADDRESS 0x3F98F8 /end MEASUREMENT
/begin MEASUREMENT ed_fsp_4of20_.uw_satz_1of3_.uw_km_stand_nv "Kilometerstand beim Fehlereintrag" UWORD FORMULA_0054 0 0.0 0.0 524280.0 READ_WRITE ECU_ADDRESS 0x3F98D4 /end MEASUREMENT
/begin MEASUREMENT ed_fsp_4of20_.uw_satz_1of3_.uw_wert_nv_1of4_ "Umweltbedingung beim Fehlereintrag" UWORD FORMULA_0010 0 0.0 0.0 65535.0 READ_WRITE ECU_ADDRESS 0x3F98D6 /end MEASUREMENT
/begin MEASUREMENT ed_fsp_4of20_.uw_satz_1of3_.uw_wert_nv_2of4_ "Umweltbedingung beim Fehlereintrag" UWORD FORMULA_0010 0 0.0 0.0 65535.0 READ_WRITE ECU_ADDRESS 0x3F98D8 /end MEASUREMENT
/begin MEASUREMENT ed_fsp_4of20_.uw_satz_1of3_.uw_wert_nv_3of4_ "Umweltbedingung beim Fehlereintrag" UWORD FORMULA_0010 0 0.0 0.0 65535.0 READ_WRITE ECU_ADDRESS 0x3F98DA /end MEASUREMENT
/begin MEASUREMENT ed_fsp_4of20_.uw_satz_1of3_.uw_wert_nv_4of4_ "Umweltbedingung beim Fehlereintrag" UWORD FORMULA_0010 0 0.0 0.0 65535.0 READ_WRITE ECU_ADDRESS 0x3F98DC /end MEASUREMENT
/begin MEASUREMENT ed_fsp_4of20_.uw_satz_2of3_.uw_km_stand_nv "Kilometerstand beim Fehlereintrag" UWORD FORMULA_0054 0 0.0 0.0 524280.0 READ_WRITE ECU_ADDRESS 0x3F98DE /end MEASUREMENT
/begin MEASUREMENT ed_fsp_4of20_.uw_satz_2of3_.uw_wert_nv_1of4_ "Umweltbedingung beim Fehlereintrag" UWORD FORMULA_0010 0 0.0 0.0 65535.0 READ_WRITE ECU_ADDRESS 0x3F98E0 /end MEASUREMENT
/begin MEASUREMENT ed_fsp_4of20_.uw_satz_2of3_.uw_wert_nv_2of4_ "Umweltbedingung beim Fehlereintrag" UWORD FORMULA_0010 0 0.0 0.0 65535.0 READ_WRITE ECU_ADDRESS 0x3F98E2 /end MEASUREMENT
/begin MEASUREMENT ed_fsp_4of20_.uw_satz_2of3_.uw_wert_nv_3of4_ "Umweltbedingung beim Fehlereintrag" UWORD FORMULA_0010 0 0.0 0.0 65535.0 READ_WRITE ECU_ADDRESS 0x3F98E4 /end MEASUREMENT
/begin MEASUREMENT ed_fsp_4of20_.uw_satz_2of3_.uw_wert_nv_4of4_ "Umweltbedingung beim Fehlereintrag" UWORD FORMULA_0010 0 0.0 0.0 65535.0 READ_WRITE ECU_ADDRESS 0x3F98E6 /end MEASUREMENT
/begin MEASUREMENT ed_fsp_4of20_.uw_satz_3of3_.uw_km_stand_nv "Kilometerstand beim Fehlereintrag" UWORD FORMULA_0054 0 0.0 0.0 524280.0 READ_WRITE ECU_ADDRESS 0x3F98E8 /end MEASUREMENT
/begin MEASUREMENT ed_fsp_4of20_.uw_satz_3of3_.uw_wert_nv_1of4_ "Umweltbedingung beim Fehlereintrag" UWORD FORMULA_0010 0 0.0 0.0 65535.0 READ_WRITE ECU_ADDRESS 0x3F98EA /end MEASUREMENT
/begin MEASUREMENT ed_fsp_4of20_.uw_satz_3of3_.uw_wert_nv_2of4_ "Umweltbedingung beim Fehlereintrag" UWORD FORMULA_0010 0 0.0 0.0 65535.0 READ_WRITE ECU_ADDRESS 0x3F98EC /end MEASUREMENT
/begin MEASUREMENT ed_fsp_4of20_.uw_satz_3of3_.uw_wert_nv_3of4_ "Umweltbedingung beim Fehlereintrag" UWORD FORMULA_0010 0 0.0 0.0 65535.0 READ_WRITE ECU_ADDRESS 0x3F98EE /end MEASUREMENT
/begin MEASUREMENT ed_fsp_4of20_.uw_satz_3of3_.uw_wert_nv_4of4_ "Umweltbedingung beim Fehlereintrag" UWORD FORMULA_0010 0 0.0 0.0 65535.0 READ_WRITE ECU_ADDRESS 0x3F98F0 /end MEASUREMENT
/begin MEASUREMENT ed_fsp_5of20_.ed_fil_index_nv "Verweis auf Fehlerfilter" UWORD FORMULA_0010 0 0.0 0.0 65535.0 READ_WRITE ECU_ADDRESS 0x3F9936 /end MEASUREMENT
/begin MEASUREMENT ed_fsp_5of20_.fehlerart_nv "Fehlerart und Statusbits" UWORD FORMULA_0010 0 0.0 0.0 65535.0 READ_WRITE ECU_ADDRESS 0x3F9912 /end MEASUREMENT
/begin MEASUREMENT ed_fsp_5of20_.fehlercode_nv "Externer Fehlerort" UWORD FORMULA_0053 0 0.0 0.0 65535.0 READ_WRITE ECU_ADDRESS 0x3F9910 /end MEASUREMENT
/begin MEASUREMENT ed_fsp_5of20_.ff_egas_ist_dk_b1_nv "Drosselklappenposition des Freeze Frame" UBYTE FORMULA_0059 0 0.0 0.0 100.0 READ_WRITE ECU_ADDRESS 0x3F9950 /end MEASUREMENT
/begin MEASUREMENT ed_fsp_5of20_.ff_laa_f_ber_b1_nv "Lambdaadaptionsfaktor ohne TE des Freeze Frame" UBYTE FORMULA_0058 0 0.0 0.0 1.99210000038147 READ_WRITE ECU_ADDRESS 0x3F9948 /end MEASUREMENT
/begin MEASUREMENT ed_fsp_5of20_.ff_laa_f_ber_b2_nv "Lambdaadaptionsfaktor ohne TE des Freeze Frame" UBYTE FORMULA_0058 0 0.0 0.0 1.99210000038147 READ_WRITE ECU_ADDRESS 0x3F9949 /end MEASUREMENT
/begin MEASUREMENT ed_fsp_5of20_.ff_lam_reg_b1_nv "Einspritzsystem des Freeze Frame" UBYTE FORMULA_0057 0 0.0 0.0 255.0 READ_WRITE ECU_ADDRESS 0x3F9944 /end MEASUREMENT
/begin MEASUREMENT ed_fsp_5of20_.ff_lam_reg_b2_nv "Einspritzsystem des Freeze Frame" UBYTE FORMULA_0057 0 0.0 0.0 255.0 READ_WRITE ECU_ADDRESS 0x3F9945 /end MEASUREMENT
/begin MEASUREMENT ed_fsp_5of20_.ff_lam_reg_f_b1_nv "Lambdaregelfaktor des Freeze Frame" UBYTE FORMULA_0058 0 0.0 0.0 1.99210000038147 READ_WRITE ECU_ADDRESS 0x3F9946 /end MEASUREMENT
/begin MEASUREMENT ed_fsp_5of20_.ff_lam_reg_f_b2_nv "Lambdaregelfaktor des Freeze Frame" UBYTE FORMULA_0058 0 0.0 0.0 1.99210000038147 READ_WRITE ECU_ADDRESS 0x3F9947 /end MEASUREMENT
/begin MEASUREMENT ed_fsp_5of20_.ff_ml_ges_nv "Luftmasse des Freeze Frame" UWORD FORMULA_0056 0 0.0 0.0 655.3499755859375 READ_WRITE ECU_ADDRESS 0x3F9942 /end MEASUREMENT
/begin MEASUREMENT ed_fsp_5of20_.ff_n_nv "Drehzahl des Freeze Frame" UWORD FORMULA_0055 0 0.0 0.0 16383.75 READ_WRITE ECU_ADDRESS 0x3F9940 /end MEASUREMENT
/begin MEASUREMENT ed_fsp_5of20_.ff_p_code_nv "P-Code des Freeze Frame" UWORD FORMULA_0010 0 0.0 0.0 65535.0 READ_WRITE ECU_ADDRESS 0x3F993E /end MEASUREMENT
/begin MEASUREMENT ed_fsp_5of20_.ff_pks_ist_nv "Kraftstoffdruck des Freeze Frame" UBYTE FORMULA_0061 0 0.0 0.0 765.0 READ_WRITE ECU_ADDRESS 0x3F994C /end MEASUREMENT
/begin MEASUREMENT ed_fsp_5of20_.ff_rf_m_nv "Last des Freeze Frame" UBYTE FORMULA_0059 0 0.0 0.0 100.0 READ_WRITE ECU_ADDRESS 0x3F994A /end MEASUREMENT
/begin MEASUREMENT ed_fsp_5of20_.ff_sl_st_nv "Sekundaerluftstatus des Freeze Frame" UBYTE FORMULA_0064 0 0.0 0.0 255.0 READ_WRITE ECU_ADDRESS 0x3F9951 /end MEASUREMENT
/begin MEASUREMENT ed_fsp_5of20_.ff_tan_m_nv "Ansauglufttemperatur des Freeze Frame" UBYTE FORMULA_0060 0 0.0 -40.0 215.0 READ_WRITE ECU_ADDRESS 0x3F994F /end MEASUREMENT
/begin MEASUREMENT ed_fsp_5of20_.ff_tmot_nv "Kuehlwassertemperatur des Freeze Frame" UBYTE FORMULA_0060 0 0.0 -40.0 215.0 READ_WRITE ECU_ADDRESS 0x3F994B /end MEASUREMENT
/begin MEASUREMENT ed_fsp_5of20_.ff_tz1_nv "Zuendwinkel 1 des Freeze Frame" UBYTE FORMULA_0063 0 0.0 -64.0 63.5 READ_WRITE ECU_ADDRESS 0x3F994E /end MEASUREMENT
/begin MEASUREMENT ed_fsp_5of20_.ff_v_vorne_nv "Geschwindigkeit des Freeze Frame" UBYTE FORMULA_0062 0 0.0 0.0 255.0 READ_WRITE ECU_ADDRESS 0x3F994D /end MEASUREMENT
/begin MEASUREMENT ed_fsp_5of20_.haeufigkeitszaehler_nv "Uebergangszaehler von i.O. -> n.i.O" UBYTE FORMULA_0003 0 0.0 0.0 255.0 READ_WRITE ECU_ADDRESS 0x3F9914 /end MEASUREMENT
/begin MEASUREMENT ed_fsp_5of20_.inj_fehlerzaehler_nv "INJ-Fehlerzaehler" UWORD FORMULA_0010 0 0.0 0.0 65535.0 READ_WRITE ECU_ADDRESS 0x3F9934 /end MEASUREMENT
/begin MEASUREMENT ed_fsp_5of20_.logistikzaehler_nv "Warm-Up-Cycling-Zaehler" UBYTE FORMULA_0003 0 0.0 0.0 255.0 READ_WRITE ECU_ADDRESS 0x3F9915 /end MEASUREMENT
/begin MEASUREMENT ed_fsp_5of20_.mil_filter_nv "Filterwert der Milansteuerung" UBYTE FORMULA_0003 0 0.0 0.0 255.0 READ_WRITE ECU_ADDRESS 0x3F9938 /end MEASUREMENT
/begin MEASUREMENT ed_fsp_5of20_.mil_filter_scdn_nv "Similar Conditions Eintragsfilterwert der Milansteuerung" UBYTE FORMULA_0003 0 0.0 0.0 255.0 READ_WRITE ECU_ADDRESS 0x3F9939 /end MEASUREMENT
/begin MEASUREMENT ed_fsp_5of20_.scdn_nenner_nv "Gesamte Anzahl" UWORD FORMULA_0010 0 0.0 0.0 65535.0 READ_WRITE ECU_ADDRESS 0x3F993C /end MEASUREMENT
/begin MEASUREMENT ed_fsp_5of20_.scdn_zaehler_nv "Im similar Fenster" UWORD FORMULA_0010 0 0.0 0.0 65535.0 READ_WRITE ECU_ADDRESS 0x3F993A /end MEASUREMENT
/begin MEASUREMENT ed_fsp_5of20_.uw_satz_1of3_.uw_km_stand_nv "Kilometerstand beim Fehlereintrag" UWORD FORMULA_0054 0 0.0 0.0 524280.0 READ_WRITE ECU_ADDRESS 0x3F9916 /end MEASUREMENT
/begin MEASUREMENT ed_fsp_5of20_.uw_satz_1of3_.uw_wert_nv_1of4_ "Umweltbedingung beim Fehlereintrag" UWORD FORMULA_0010 0 0.0 0.0 65535.0 READ_WRITE ECU_ADDRESS 0x3F9918 /end MEASUREMENT
/begin MEASUREMENT ed_fsp_5of20_.uw_satz_1of3_.uw_wert_nv_2of4_ "Umweltbedingung beim Fehlereintrag" UWORD FORMULA_0010 0 0.0 0.0 65535.0 READ_WRITE ECU_ADDRESS 0x3F991A /end MEASUREMENT
/begin MEASUREMENT ed_fsp_5of20_.uw_satz_1of3_.uw_wert_nv_3of4_ "Umweltbedingung beim Fehlereintrag" UWORD FORMULA_0010 0 0.0 0.0 65535.0 READ_WRITE ECU_ADDRESS 0x3F991C /end MEASUREMENT
/begin MEASUREMENT ed_fsp_5of20_.uw_satz_1of3_.uw_wert_nv_4of4_ "Umweltbedingung beim Fehlereintrag" UWORD FORMULA_0010 0 0.0 0.0 65535.0 READ_WRITE ECU_ADDRESS 0x3F991E /end MEASUREMENT
/begin MEASUREMENT ed_fsp_5of20_.uw_satz_2of3_.uw_km_stand_nv "Kilometerstand beim Fehlereintrag" UWORD FORMULA_0054 0 0.0 0.0 524280.0 READ_WRITE ECU_ADDRESS 0x3F9920 /end MEASUREMENT
/begin MEASUREMENT ed_fsp_5of20_.uw_satz_2of3_.uw_wert_nv_1of4_ "Umweltbedingung beim Fehlereintrag" UWORD FORMULA_0010 0 0.0 0.0 65535.0 READ_WRITE ECU_ADDRESS 0x3F9922 /end MEASUREMENT
/begin MEASUREMENT ed_fsp_5of20_.uw_satz_2of3_.uw_wert_nv_2of4_ "Umweltbedingung beim Fehlereintrag" UWORD FORMULA_0010 0 0.0 0.0 65535.0 READ_WRITE ECU_ADDRESS 0x3F9924 /end MEASUREMENT
/begin MEASUREMENT ed_fsp_5of20_.uw_satz_2of3_.uw_wert_nv_3of4_ "Umweltbedingung beim Fehlereintrag" UWORD FORMULA_0010 0 0.0 0.0 65535.0 READ_WRITE ECU_ADDRESS 0x3F9926 /end MEASUREMENT
/begin MEASUREMENT ed_fsp_5of20_.uw_satz_2of3_.uw_wert_nv_4of4_ "Umweltbedingung beim Fehlereintrag" UWORD FORMULA_0010 0 0.0 0.0 65535.0 READ_WRITE ECU_ADDRESS 0x3F9928 /end MEASUREMENT
/begin MEASUREMENT ed_fsp_5of20_.uw_satz_3of3_.uw_km_stand_nv "Kilometerstand beim Fehlereintrag" UWORD FORMULA_0054 0 0.0 0.0 524280.0 READ_WRITE ECU_ADDRESS 0x3F992A /end MEASUREMENT
/begin MEASUREMENT ed_fsp_5of20_.uw_satz_3of3_.uw_wert_nv_1of4_ "Umweltbedingung beim Fehlereintrag" UWORD FORMULA_0010 0 0.0 0.0 65535.0 READ_WRITE ECU_ADDRESS 0x3F992C /end MEASUREMENT
/begin MEASUREMENT ed_fsp_5of20_.uw_satz_3of3_.uw_wert_nv_2of4_ "Umweltbedingung beim Fehlereintrag" UWORD FORMULA_0010 0 0.0 0.0 65535.0 READ_WRITE ECU_ADDRESS 0x3F992E /end MEASUREMENT
/begin MEASUREMENT ed_fsp_5of20_.uw_satz_3of3_.uw_wert_nv_3of4_ "Umweltbedingung beim Fehlereintrag" UWORD FORMULA_0010 0 0.0 0.0 65535.0 READ_WRITE ECU_ADDRESS 0x3F9930 /end MEASUREMENT
/begin MEASUREMENT ed_fsp_5of20_.uw_satz_3of3_.uw_wert_nv_4of4_ "Umweltbedingung beim Fehlereintrag" UWORD FORMULA_0010 0 0.0 0.0 65535.0 READ_WRITE ECU_ADDRESS 0x3F9932 /end MEASUREMENT
/begin MEASUREMENT ed_fsp_6of20_.ed_fil_index_nv "Verweis auf Fehlerfilter" UWORD FORMULA_0010 0 0.0 0.0 65535.0 READ_WRITE ECU_ADDRESS 0x3F9978 /end MEASUREMENT
/begin MEASUREMENT ed_fsp_6of20_.fehlerart_nv "Fehlerart und Statusbits" UWORD FORMULA_0010 0 0.0 0.0 65535.0 READ_WRITE ECU_ADDRESS 0x3F9954 /end MEASUREMENT
/begin MEASUREMENT ed_fsp_6of20_.fehlercode_nv "Externer Fehlerort" UWORD FORMULA_0053 0 0.0 0.0 65535.0 READ_WRITE ECU_ADDRESS 0x3F9952 /end MEASUREMENT
/begin MEASUREMENT ed_fsp_6of20_.ff_egas_ist_dk_b1_nv "Drosselklappenposition des Freeze Frame" UBYTE FORMULA_0059 0 0.0 0.0 100.0 READ_WRITE ECU_ADDRESS 0x3F9992 /end MEASUREMENT
/begin MEASUREMENT ed_fsp_6of20_.ff_laa_f_ber_b1_nv "Lambdaadaptionsfaktor ohne TE des Freeze Frame" UBYTE FORMULA_0058 0 0.0 0.0 1.99210000038147 READ_WRITE ECU_ADDRESS 0x3F998A /end MEASUREMENT
/begin MEASUREMENT ed_fsp_6of20_.ff_laa_f_ber_b2_nv "Lambdaadaptionsfaktor ohne TE des Freeze Frame" UBYTE FORMULA_0058 0 0.0 0.0 1.99210000038147 READ_WRITE ECU_ADDRESS 0x3F998B /end MEASUREMENT
/begin MEASUREMENT ed_fsp_6of20_.ff_lam_reg_b1_nv "Einspritzsystem des Freeze Frame" UBYTE FORMULA_0057 0 0.0 0.0 255.0 READ_WRITE ECU_ADDRESS 0x3F9986 /end MEASUREMENT
/begin MEASUREMENT ed_fsp_6of20_.ff_lam_reg_b2_nv "Einspritzsystem des Freeze Frame" UBYTE FORMULA_0057 0 0.0 0.0 255.0 READ_WRITE ECU_ADDRESS 0x3F9987 /end MEASUREMENT
/begin MEASUREMENT ed_fsp_6of20_.ff_lam_reg_f_b1_nv "Lambdaregelfaktor des Freeze Frame" UBYTE FORMULA_0058 0 0.0 0.0 1.99210000038147 READ_WRITE ECU_ADDRESS 0x3F9988 /end MEASUREMENT
/begin MEASUREMENT ed_fsp_6of20_.ff_lam_reg_f_b2_nv "Lambdaregelfaktor des Freeze Frame" UBYTE FORMULA_0058 0 0.0 0.0 1.99210000038147 READ_WRITE ECU_ADDRESS 0x3F9989 /end MEASUREMENT
/begin MEASUREMENT ed_fsp_6of20_.ff_ml_ges_nv "Luftmasse des Freeze Frame" UWORD FORMULA_0056 0 0.0 0.0 655.3499755859375 READ_WRITE ECU_ADDRESS 0x3F9984 /end MEASUREMENT
/begin MEASUREMENT ed_fsp_6of20_.ff_n_nv "Drehzahl des Freeze Frame" UWORD FORMULA_0055 0 0.0 0.0 16383.75 READ_WRITE ECU_ADDRESS 0x3F9982 /end MEASUREMENT
/begin MEASUREMENT ed_fsp_6of20_.ff_p_code_nv "P-Code des Freeze Frame" UWORD FORMULA_0010 0 0.0 0.0 65535.0 READ_WRITE ECU_ADDRESS 0x3F9980 /end MEASUREMENT
/begin MEASUREMENT ed_fsp_6of20_.ff_pks_ist_nv "Kraftstoffdruck des Freeze Frame" UBYTE FORMULA_0061 0 0.0 0.0 765.0 READ_WRITE ECU_ADDRESS 0x3F998E /end MEASUREMENT
/begin MEASUREMENT ed_fsp_6of20_.ff_rf_m_nv "Last des Freeze Frame" UBYTE FORMULA_0059 0 0.0 0.0 100.0 READ_WRITE ECU_ADDRESS 0x3F998C /end MEASUREMENT
/begin MEASUREMENT ed_fsp_6of20_.ff_sl_st_nv "Sekundaerluftstatus des Freeze Frame" UBYTE FORMULA_0064 0 0.0 0.0 255.0 READ_WRITE ECU_ADDRESS 0x3F9993 /end MEASUREMENT
/begin MEASUREMENT ed_fsp_6of20_.ff_tan_m_nv "Ansauglufttemperatur des Freeze Frame" UBYTE FORMULA_0060 0 0.0 -40.0 215.0 READ_WRITE ECU_ADDRESS 0x3F9991 /end MEASUREMENT
/begin MEASUREMENT ed_fsp_6of20_.ff_tmot_nv "Kuehlwassertemperatur des Freeze Frame" UBYTE FORMULA_0060 0 0.0 -40.0 215.0 READ_WRITE ECU_ADDRESS 0x3F998D /end MEASUREMENT
/begin MEASUREMENT ed_fsp_6of20_.ff_tz1_nv "Zuendwinkel 1 des Freeze Frame" UBYTE FORMULA_0063 0 0.0 -64.0 63.5 READ_WRITE ECU_ADDRESS 0x3F9990 /end MEASUREMENT
/begin MEASUREMENT ed_fsp_6of20_.ff_v_vorne_nv "Geschwindigkeit des Freeze Frame" UBYTE FORMULA_0062 0 0.0 0.0 255.0 READ_WRITE ECU_ADDRESS 0x3F998F /end MEASUREMENT
/begin MEASUREMENT ed_fsp_6of20_.haeufigkeitszaehler_nv "Uebergangszaehler von i.O. -> n.i.O" UBYTE FORMULA_0003 0 0.0 0.0 255.0 READ_WRITE ECU_ADDRESS 0x3F9956 /end MEASUREMENT
/begin MEASUREMENT ed_fsp_6of20_.inj_fehlerzaehler_nv "INJ-Fehlerzaehler" UWORD FORMULA_0010 0 0.0 0.0 65535.0 READ_WRITE ECU_ADDRESS 0x3F9976 /end MEASUREMENT
/begin MEASUREMENT ed_fsp_6of20_.logistikzaehler_nv "Warm-Up-Cycling-Zaehler" UBYTE FORMULA_0003 0 0.0 0.0 255.0 READ_WRITE ECU_ADDRESS 0x3F9957 /end MEASUREMENT
/begin MEASUREMENT ed_fsp_6of20_.mil_filter_nv "Filterwert der Milansteuerung" UBYTE FORMULA_0003 0 0.0 0.0 255.0 READ_WRITE ECU_ADDRESS 0x3F997A /end MEASUREMENT
/begin MEASUREMENT ed_fsp_6of20_.mil_filter_scdn_nv "Similar Conditions Eintragsfilterwert der Milansteuerung" UBYTE FORMULA_0003 0 0.0 0.0 255.0 READ_WRITE ECU_ADDRESS 0x3F997B /end MEASUREMENT
/begin MEASUREMENT ed_fsp_6of20_.scdn_nenner_nv "Gesamte Anzahl" UWORD FORMULA_0010 0 0.0 0.0 65535.0 READ_WRITE ECU_ADDRESS 0x3F997E /end MEASUREMENT
/begin MEASUREMENT ed_fsp_6of20_.scdn_zaehler_nv "Im similar Fenster" UWORD FORMULA_0010 0 0.0 0.0 65535.0 READ_WRITE ECU_ADDRESS 0x3F997C /end MEASUREMENT
/begin MEASUREMENT ed_fsp_6of20_.uw_satz_1of3_.uw_km_stand_nv "Kilometerstand beim Fehlereintrag" UWORD FORMULA_0054 0 0.0 0.0 524280.0 READ_WRITE ECU_ADDRESS 0x3F9958 /end MEASUREMENT
/begin MEASUREMENT ed_fsp_6of20_.uw_satz_1of3_.uw_wert_nv_1of4_ "Umweltbedingung beim Fehlereintrag" UWORD FORMULA_0010 0 0.0 0.0 65535.0 READ_WRITE ECU_ADDRESS 0x3F995A /end MEASUREMENT
/begin MEASUREMENT ed_fsp_6of20_.uw_satz_1of3_.uw_wert_nv_2of4_ "Umweltbedingung beim Fehlereintrag" UWORD FORMULA_0010 0 0.0 0.0 65535.0 READ_WRITE ECU_ADDRESS 0x3F995C /end MEASUREMENT
/begin MEASUREMENT ed_fsp_6of20_.uw_satz_1of3_.uw_wert_nv_3of4_ "Umweltbedingung beim Fehlereintrag" UWORD FORMULA_0010 0 0.0 0.0 65535.0 READ_WRITE ECU_ADDRESS 0x3F995E /end MEASUREMENT
/begin MEASUREMENT ed_fsp_6of20_.uw_satz_1of3_.uw_wert_nv_4of4_ "Umweltbedingung beim Fehlereintrag" UWORD FORMULA_0010 0 0.0 0.0 65535.0 READ_WRITE ECU_ADDRESS 0x3F9960 /end MEASUREMENT
/begin MEASUREMENT ed_fsp_6of20_.uw_satz_2of3_.uw_km_stand_nv "Kilometerstand beim Fehlereintrag" UWORD FORMULA_0054 0 0.0 0.0 524280.0 READ_WRITE ECU_ADDRESS 0x3F9962 /end MEASUREMENT
/begin MEASUREMENT ed_fsp_6of20_.uw_satz_2of3_.uw_wert_nv_1of4_ "Umweltbedingung beim Fehlereintrag" UWORD FORMULA_0010 0 0.0 0.0 65535.0 READ_WRITE ECU_ADDRESS 0x3F9964 /end MEASUREMENT
/begin MEASUREMENT ed_fsp_6of20_.uw_satz_2of3_.uw_wert_nv_2of4_ "Umweltbedingung beim Fehlereintrag" UWORD FORMULA_0010 0 0.0 0.0 65535.0 READ_WRITE ECU_ADDRESS 0x3F9966 /end MEASUREMENT
/begin MEASUREMENT ed_fsp_6of20_.uw_satz_2of3_.uw_wert_nv_3of4_ "Umweltbedingung beim Fehlereintrag" UWORD FORMULA_0010 0 0.0 0.0 65535.0 READ_WRITE ECU_ADDRESS 0x3F9968 /end MEASUREMENT
/begin MEASUREMENT ed_fsp_6of20_.uw_satz_2of3_.uw_wert_nv_4of4_ "Umweltbedingung beim Fehlereintrag" UWORD FORMULA_0010 0 0.0 0.0 65535.0 READ_WRITE ECU_ADDRESS 0x3F996A /end MEASUREMENT
/begin MEASUREMENT ed_fsp_6of20_.uw_satz_3of3_.uw_km_stand_nv "Kilometerstand beim Fehlereintrag" UWORD FORMULA_0054 0 0.0 0.0 524280.0 READ_WRITE ECU_ADDRESS 0x3F996C /end MEASUREMENT
/begin MEASUREMENT ed_fsp_6of20_.uw_satz_3of3_.uw_wert_nv_1of4_ "Umweltbedingung beim Fehlereintrag" UWORD FORMULA_0010 0 0.0 0.0 65535.0 READ_WRITE ECU_ADDRESS 0x3F996E /end MEASUREMENT
/begin MEASUREMENT ed_fsp_6of20_.uw_satz_3of3_.uw_wert_nv_2of4_ "Umweltbedingung beim Fehlereintrag" UWORD FORMULA_0010 0 0.0 0.0 65535.0 READ_WRITE ECU_ADDRESS 0x3F9970 /end MEASUREMENT
/begin MEASUREMENT ed_fsp_6of20_.uw_satz_3of3_.uw_wert_nv_3of4_ "Umweltbedingung beim Fehlereintrag" UWORD FORMULA_0010 0 0.0 0.0 65535.0 READ_WRITE ECU_ADDRESS 0x3F9972 /end MEASUREMENT
/begin MEASUREMENT ed_fsp_6of20_.uw_satz_3of3_.uw_wert_nv_4of4_ "Umweltbedingung beim Fehlereintrag" UWORD FORMULA_0010 0 0.0 0.0 65535.0 READ_WRITE ECU_ADDRESS 0x3F9974 /end MEASUREMENT
/begin MEASUREMENT ed_fsp_7of20_.ed_fil_index_nv "Verweis auf Fehlerfilter" UWORD FORMULA_0010 0 0.0 0.0 65535.0 READ_WRITE ECU_ADDRESS 0x3F99BA /end MEASUREMENT
/begin MEASUREMENT ed_fsp_7of20_.fehlerart_nv "Fehlerart und Statusbits" UWORD FORMULA_0010 0 0.0 0.0 65535.0 READ_WRITE ECU_ADDRESS 0x3F9996 /end MEASUREMENT
/begin MEASUREMENT ed_fsp_7of20_.fehlercode_nv "Externer Fehlerort" UWORD FORMULA_0053 0 0.0 0.0 65535.0 READ_WRITE ECU_ADDRESS 0x3F9994 /end MEASUREMENT
/begin MEASUREMENT ed_fsp_7of20_.ff_egas_ist_dk_b1_nv "Drosselklappenposition des Freeze Frame" UBYTE FORMULA_0059 0 0.0 0.0 100.0 READ_WRITE ECU_ADDRESS 0x3F99D4 /end MEASUREMENT
/begin MEASUREMENT ed_fsp_7of20_.ff_laa_f_ber_b1_nv "Lambdaadaptionsfaktor ohne TE des Freeze Frame" UBYTE FORMULA_0058 0 0.0 0.0 1.99210000038147 READ_WRITE ECU_ADDRESS 0x3F99CC /end MEASUREMENT
/begin MEASUREMENT ed_fsp_7of20_.ff_laa_f_ber_b2_nv "Lambdaadaptionsfaktor ohne TE des Freeze Frame" UBYTE FORMULA_0058 0 0.0 0.0 1.99210000038147 READ_WRITE ECU_ADDRESS 0x3F99CD /end MEASUREMENT
/begin MEASUREMENT ed_fsp_7of20_.ff_lam_reg_b1_nv "Einspritzsystem des Freeze Frame" UBYTE FORMULA_0057 0 0.0 0.0 255.0 READ_WRITE ECU_ADDRESS 0x3F99C8 /end MEASUREMENT
/begin MEASUREMENT ed_fsp_7of20_.ff_lam_reg_b2_nv "Einspritzsystem des Freeze Frame" UBYTE FORMULA_0057 0 0.0 0.0 255.0 READ_WRITE ECU_ADDRESS 0x3F99C9 /end MEASUREMENT
/begin MEASUREMENT ed_fsp_7of20_.ff_lam_reg_f_b1_nv "Lambdaregelfaktor des Freeze Frame" UBYTE FORMULA_0058 0 0.0 0.0 1.99210000038147 READ_WRITE ECU_ADDRESS 0x3F99CA /end MEASUREMENT
/begin MEASUREMENT ed_fsp_7of20_.ff_lam_reg_f_b2_nv "Lambdaregelfaktor des Freeze Frame" UBYTE FORMULA_0058 0 0.0 0.0 1.99210000038147 READ_WRITE ECU_ADDRESS 0x3F99CB /end MEASUREMENT
/begin MEASUREMENT ed_fsp_7of20_.ff_ml_ges_nv "Luftmasse des Freeze Frame" UWORD FORMULA_0056 0 0.0 0.0 655.3499755859375 READ_WRITE ECU_ADDRESS 0x3F99C6 /end MEASUREMENT
/begin MEASUREMENT ed_fsp_7of20_.ff_n_nv "Drehzahl des Freeze Frame" UWORD FORMULA_0055 0 0.0 0.0 16383.75 READ_WRITE ECU_ADDRESS 0x3F99C4 /end MEASUREMENT
/begin MEASUREMENT ed_fsp_7of20_.ff_p_code_nv "P-Code des Freeze Frame" UWORD FORMULA_0010 0 0.0 0.0 65535.0 READ_WRITE ECU_ADDRESS 0x3F99C2 /end MEASUREMENT
/begin MEASUREMENT ed_fsp_7of20_.ff_pks_ist_nv "Kraftstoffdruck des Freeze Frame" UBYTE FORMULA_0061 0 0.0 0.0 765.0 READ_WRITE ECU_ADDRESS 0x3F99D0 /end MEASUREMENT
/begin MEASUREMENT ed_fsp_7of20_.ff_rf_m_nv "Last des Freeze Frame" UBYTE FORMULA_0059 0 0.0 0.0 100.0 READ_WRITE ECU_ADDRESS 0x3F99CE /end MEASUREMENT
/begin MEASUREMENT ed_fsp_7of20_.ff_sl_st_nv "Sekundaerluftstatus des Freeze Frame" UBYTE FORMULA_0064 0 0.0 0.0 255.0 READ_WRITE ECU_ADDRESS 0x3F99D5 /end MEASUREMENT
/begin MEASUREMENT ed_fsp_7of20_.ff_tan_m_nv "Ansauglufttemperatur des Freeze Frame" UBYTE FORMULA_0060 0 0.0 -40.0 215.0 READ_WRITE ECU_ADDRESS 0x3F99D3 /end MEASUREMENT
/begin MEASUREMENT ed_fsp_7of20_.ff_tmot_nv "Kuehlwassertemperatur des Freeze Frame" UBYTE FORMULA_0060 0 0.0 -40.0 215.0 READ_WRITE ECU_ADDRESS 0x3F99CF /end MEASUREMENT
/begin MEASUREMENT ed_fsp_7of20_.ff_tz1_nv "Zuendwinkel 1 des Freeze Frame" UBYTE FORMULA_0063 0 0.0 -64.0 63.5 READ_WRITE ECU_ADDRESS 0x3F99D2 /end MEASUREMENT
/begin MEASUREMENT ed_fsp_7of20_.ff_v_vorne_nv "Geschwindigkeit des Freeze Frame" UBYTE FORMULA_0062 0 0.0 0.0 255.0 READ_WRITE ECU_ADDRESS 0x3F99D1 /end MEASUREMENT
/begin MEASUREMENT ed_fsp_7of20_.haeufigkeitszaehler_nv "Uebergangszaehler von i.O. -> n.i.O" UBYTE FORMULA_0003 0 0.0 0.0 255.0 READ_WRITE ECU_ADDRESS 0x3F9998 /end MEASUREMENT
/begin MEASUREMENT ed_fsp_7of20_.inj_fehlerzaehler_nv "INJ-Fehlerzaehler" UWORD FORMULA_0010 0 0.0 0.0 65535.0 READ_WRITE ECU_ADDRESS 0x3F99B8 /end MEASUREMENT
/begin MEASUREMENT ed_fsp_7of20_.logistikzaehler_nv "Warm-Up-Cycling-Zaehler" UBYTE FORMULA_0003 0 0.0 0.0 255.0 READ_WRITE ECU_ADDRESS 0x3F9999 /end MEASUREMENT
/begin MEASUREMENT ed_fsp_7of20_.mil_filter_nv "Filterwert der Milansteuerung" UBYTE FORMULA_0003 0 0.0 0.0 255.0 READ_WRITE ECU_ADDRESS 0x3F99BC /end MEASUREMENT
/begin MEASUREMENT ed_fsp_7of20_.mil_filter_scdn_nv "Similar Conditions Eintragsfilterwert der Milansteuerung" UBYTE FORMULA_0003 0 0.0 0.0 255.0 READ_WRITE ECU_ADDRESS 0x3F99BD /end MEASUREMENT
/begin MEASUREMENT ed_fsp_7of20_.scdn_nenner_nv "Gesamte Anzahl" UWORD FORMULA_0010 0 0.0 0.0 65535.0 READ_WRITE ECU_ADDRESS 0x3F99C0 /end MEASUREMENT
/begin MEASUREMENT ed_fsp_7of20_.scdn_zaehler_nv "Im similar Fenster" UWORD FORMULA_0010 0 0.0 0.0 65535.0 READ_WRITE ECU_ADDRESS 0x3F99BE /end MEASUREMENT
/begin MEASUREMENT ed_fsp_7of20_.uw_satz_1of3_.uw_km_stand_nv "Kilometerstand beim Fehlereintrag" UWORD FORMULA_0054 0 0.0 0.0 524280.0 READ_WRITE ECU_ADDRESS 0x3F999A /end MEASUREMENT
/begin MEASUREMENT ed_fsp_7of20_.uw_satz_1of3_.uw_wert_nv_1of4_ "Umweltbedingung beim Fehlereintrag" UWORD FORMULA_0010 0 0.0 0.0 65535.0 READ_WRITE ECU_ADDRESS 0x3F999C /end MEASUREMENT
/begin MEASUREMENT ed_fsp_7of20_.uw_satz_1of3_.uw_wert_nv_2of4_ "Umweltbedingung beim Fehlereintrag" UWORD FORMULA_0010 0 0.0 0.0 65535.0 READ_WRITE ECU_ADDRESS 0x3F999E /end MEASUREMENT
/begin MEASUREMENT ed_fsp_7of20_.uw_satz_1of3_.uw_wert_nv_3of4_ "Umweltbedingung beim Fehlereintrag" UWORD FORMULA_0010 0 0.0 0.0 65535.0 READ_WRITE ECU_ADDRESS 0x3F99A0 /end MEASUREMENT
/begin MEASUREMENT ed_fsp_7of20_.uw_satz_1of3_.uw_wert_nv_4of4_ "Umweltbedingung beim Fehlereintrag" UWORD FORMULA_0010 0 0.0 0.0 65535.0 READ_WRITE ECU_ADDRESS 0x3F99A2 /end MEASUREMENT
/begin MEASUREMENT ed_fsp_7of20_.uw_satz_2of3_.uw_km_stand_nv "Kilometerstand beim Fehlereintrag" UWORD FORMULA_0054 0 0.0 0.0 524280.0 READ_WRITE ECU_ADDRESS 0x3F99A4 /end MEASUREMENT
/begin MEASUREMENT ed_fsp_7of20_.uw_satz_2of3_.uw_wert_nv_1of4_ "Umweltbedingung beim Fehlereintrag" UWORD FORMULA_0010 0 0.0 0.0 65535.0 READ_WRITE ECU_ADDRESS 0x3F99A6 /end MEASUREMENT
/begin MEASUREMENT ed_fsp_7of20_.uw_satz_2of3_.uw_wert_nv_2of4_ "Umweltbedingung beim Fehlereintrag" UWORD FORMULA_0010 0 0.0 0.0 65535.0 READ_WRITE ECU_ADDRESS 0x3F99A8 /end MEASUREMENT
/begin MEASUREMENT ed_fsp_7of20_.uw_satz_2of3_.uw_wert_nv_3of4_ "Umweltbedingung beim Fehlereintrag" UWORD FORMULA_0010 0 0.0 0.0 65535.0 READ_WRITE ECU_ADDRESS 0x3F99AA /end MEASUREMENT
/begin MEASUREMENT ed_fsp_7of20_.uw_satz_2of3_.uw_wert_nv_4of4_ "Umweltbedingung beim Fehlereintrag" UWORD FORMULA_0010 0 0.0 0.0 65535.0 READ_WRITE ECU_ADDRESS 0x3F99AC /end MEASUREMENT
/begin MEASUREMENT ed_fsp_7of20_.uw_satz_3of3_.uw_km_stand_nv "Kilometerstand beim Fehlereintrag" UWORD FORMULA_0054 0 0.0 0.0 524280.0 READ_WRITE ECU_ADDRESS 0x3F99AE /end MEASUREMENT
/begin MEASUREMENT ed_fsp_7of20_.uw_satz_3of3_.uw_wert_nv_1of4_ "Umweltbedingung beim Fehlereintrag" UWORD FORMULA_0010 0 0.0 0.0 65535.0 READ_WRITE ECU_ADDRESS 0x3F99B0 /end MEASUREMENT
/begin MEASUREMENT ed_fsp_7of20_.uw_satz_3of3_.uw_wert_nv_2of4_ "Umweltbedingung beim Fehlereintrag" UWORD FORMULA_0010 0 0.0 0.0 65535.0 READ_WRITE ECU_ADDRESS 0x3F99B2 /end MEASUREMENT
/begin MEASUREMENT ed_fsp_7of20_.uw_satz_3of3_.uw_wert_nv_3of4_ "Umweltbedingung beim Fehlereintrag" UWORD FORMULA_0010 0 0.0 0.0 65535.0 READ_WRITE ECU_ADDRESS 0x3F99B4 /end MEASUREMENT
/begin MEASUREMENT ed_fsp_7of20_.uw_satz_3of3_.uw_wert_nv_4of4_ "Umweltbedingung beim Fehlereintrag" UWORD FORMULA_0010 0 0.0 0.0 65535.0 READ_WRITE ECU_ADDRESS 0x3F99B6 /end MEASUREMENT
/begin MEASUREMENT ed_fsp_8of20_.ed_fil_index_nv "Verweis auf Fehlerfilter" UWORD FORMULA_0010 0 0.0 0.0 65535.0 READ_WRITE ECU_ADDRESS 0x3F99FC /end MEASUREMENT
/begin MEASUREMENT ed_fsp_8of20_.fehlerart_nv "Fehlerart und Statusbits" UWORD FORMULA_0010 0 0.0 0.0 65535.0 READ_WRITE ECU_ADDRESS 0x3F99D8 /end MEASUREMENT
/begin MEASUREMENT ed_fsp_8of20_.fehlercode_nv "Externer Fehlerort" UWORD FORMULA_0053 0 0.0 0.0 65535.0 READ_WRITE ECU_ADDRESS 0x3F99D6 /end MEASUREMENT
/begin MEASUREMENT ed_fsp_8of20_.ff_egas_ist_dk_b1_nv "Drosselklappenposition des Freeze Frame" UBYTE FORMULA_0059 0 0.0 0.0 100.0 READ_WRITE ECU_ADDRESS 0x3F9A16 /end MEASUREMENT
/begin MEASUREMENT ed_fsp_8of20_.ff_laa_f_ber_b1_nv "Lambdaadaptionsfaktor ohne TE des Freeze Frame" UBYTE FORMULA_0058 0 0.0 0.0 1.99210000038147 READ_WRITE ECU_ADDRESS 0x3F9A0E /end MEASUREMENT
/begin MEASUREMENT ed_fsp_8of20_.ff_laa_f_ber_b2_nv "Lambdaadaptionsfaktor ohne TE des Freeze Frame" UBYTE FORMULA_0058 0 0.0 0.0 1.99210000038147 READ_WRITE ECU_ADDRESS 0x3F9A0F /end MEASUREMENT
/begin MEASUREMENT ed_fsp_8of20_.ff_lam_reg_b1_nv "Einspritzsystem des Freeze Frame" UBYTE FORMULA_0057 0 0.0 0.0 255.0 READ_WRITE ECU_ADDRESS 0x3F9A0A /end MEASUREMENT
/begin MEASUREMENT ed_fsp_8of20_.ff_lam_reg_b2_nv "Einspritzsystem des Freeze Frame" UBYTE FORMULA_0057 0 0.0 0.0 255.0 READ_WRITE ECU_ADDRESS 0x3F9A0B /end MEASUREMENT
/begin MEASUREMENT ed_fsp_8of20_.ff_lam_reg_f_b1_nv "Lambdaregelfaktor des Freeze Frame" UBYTE FORMULA_0058 0 0.0 0.0 1.99210000038147 READ_WRITE ECU_ADDRESS 0x3F9A0C /end MEASUREMENT
/begin MEASUREMENT ed_fsp_8of20_.ff_lam_reg_f_b2_nv "Lambdaregelfaktor des Freeze Frame" UBYTE FORMULA_0058 0 0.0 0.0 1.99210000038147 READ_WRITE ECU_ADDRESS 0x3F9A0D /end MEASUREMENT
/begin MEASUREMENT ed_fsp_8of20_.ff_ml_ges_nv "Luftmasse des Freeze Frame" UWORD FORMULA_0056 0 0.0 0.0 655.3499755859375 READ_WRITE ECU_ADDRESS 0x3F9A08 /end MEASUREMENT
/begin MEASUREMENT ed_fsp_8of20_.ff_n_nv "Drehzahl des Freeze Frame" UWORD FORMULA_0055 0 0.0 0.0 16383.75 READ_WRITE ECU_ADDRESS 0x3F9A06 /end MEASUREMENT
/begin MEASUREMENT ed_fsp_8of20_.ff_p_code_nv "P-Code des Freeze Frame" UWORD FORMULA_0010 0 0.0 0.0 65535.0 READ_WRITE ECU_ADDRESS 0x3F9A04 /end MEASUREMENT
/begin MEASUREMENT ed_fsp_8of20_.ff_pks_ist_nv "Kraftstoffdruck des Freeze Frame" UBYTE FORMULA_0061 0 0.0 0.0 765.0 READ_WRITE ECU_ADDRESS 0x3F9A12 /end MEASUREMENT
/begin MEASUREMENT ed_fsp_8of20_.ff_rf_m_nv "Last des Freeze Frame" UBYTE FORMULA_0059 0 0.0 0.0 100.0 READ_WRITE ECU_ADDRESS 0x3F9A10 /end MEASUREMENT
/begin MEASUREMENT ed_fsp_8of20_.ff_sl_st_nv "Sekundaerluftstatus des Freeze Frame" UBYTE FORMULA_0064 0 0.0 0.0 255.0 READ_WRITE ECU_ADDRESS 0x3F9A17 /end MEASUREMENT
/begin MEASUREMENT ed_fsp_8of20_.ff_tan_m_nv "Ansauglufttemperatur des Freeze Frame" UBYTE FORMULA_0060 0 0.0 -40.0 215.0 READ_WRITE ECU_ADDRESS 0x3F9A15 /end MEASUREMENT
/begin MEASUREMENT ed_fsp_8of20_.ff_tmot_nv "Kuehlwassertemperatur des Freeze Frame" UBYTE FORMULA_0060 0 0.0 -40.0 215.0 READ_WRITE ECU_ADDRESS 0x3F9A11 /end MEASUREMENT
/begin MEASUREMENT ed_fsp_8of20_.ff_tz1_nv "Zuendwinkel 1 des Freeze Frame" UBYTE FORMULA_0063 0 0.0 -64.0 63.5 READ_WRITE ECU_ADDRESS 0x3F9A14 /end MEASUREMENT
/begin MEASUREMENT ed_fsp_8of20_.ff_v_vorne_nv "Geschwindigkeit des Freeze Frame" UBYTE FORMULA_0062 0 0.0 0.0 255.0 READ_WRITE ECU_ADDRESS 0x3F9A13 /end MEASUREMENT
/begin MEASUREMENT ed_fsp_8of20_.haeufigkeitszaehler_nv "Uebergangszaehler von i.O. -> n.i.O" UBYTE FORMULA_0003 0 0.0 0.0 255.0 READ_WRITE ECU_ADDRESS 0x3F99DA /end MEASUREMENT
/begin MEASUREMENT ed_fsp_8of20_.inj_fehlerzaehler_nv "INJ-Fehlerzaehler" UWORD FORMULA_0010 0 0.0 0.0 65535.0 READ_WRITE ECU_ADDRESS 0x3F99FA /end MEASUREMENT
/begin MEASUREMENT ed_fsp_8of20_.logistikzaehler_nv "Warm-Up-Cycling-Zaehler" UBYTE FORMULA_0003 0 0.0 0.0 255.0 READ_WRITE ECU_ADDRESS 0x3F99DB /end MEASUREMENT
/begin MEASUREMENT ed_fsp_8of20_.mil_filter_nv "Filterwert der Milansteuerung" UBYTE FORMULA_0003 0 0.0 0.0 255.0 READ_WRITE ECU_ADDRESS 0x3F99FE /end MEASUREMENT
/begin MEASUREMENT ed_fsp_8of20_.mil_filter_scdn_nv "Similar Conditions Eintragsfilterwert der Milansteuerung" UBYTE FORMULA_0003 0 0.0 0.0 255.0 READ_WRITE ECU_ADDRESS 0x3F99FF /end MEASUREMENT
/begin MEASUREMENT ed_fsp_8of20_.scdn_nenner_nv "Gesamte Anzahl" UWORD FORMULA_0010 0 0.0 0.0 65535.0 READ_WRITE ECU_ADDRESS 0x3F9A02 /end MEASUREMENT
/begin MEASUREMENT ed_fsp_8of20_.scdn_zaehler_nv "Im similar Fenster" UWORD FORMULA_0010 0 0.0 0.0 65535.0 READ_WRITE ECU_ADDRESS 0x3F9A00 /end MEASUREMENT
/begin MEASUREMENT ed_fsp_8of20_.uw_satz_1of3_.uw_km_stand_nv "Kilometerstand beim Fehlereintrag" UWORD FORMULA_0054 0 0.0 0.0 524280.0 READ_WRITE ECU_ADDRESS 0x3F99DC /end MEASUREMENT
/begin MEASUREMENT ed_fsp_8of20_.uw_satz_1of3_.uw_wert_nv_1of4_ "Umweltbedingung beim Fehlereintrag" UWORD FORMULA_0010 0 0.0 0.0 65535.0 READ_WRITE ECU_ADDRESS 0x3F99DE /end MEASUREMENT
/begin MEASUREMENT ed_fsp_8of20_.uw_satz_1of3_.uw_wert_nv_2of4_ "Umweltbedingung beim Fehlereintrag" UWORD FORMULA_0010 0 0.0 0.0 65535.0 READ_WRITE ECU_ADDRESS 0x3F99E0 /end MEASUREMENT
/begin MEASUREMENT ed_fsp_8of20_.uw_satz_1of3_.uw_wert_nv_3of4_ "Umweltbedingung beim Fehlereintrag" UWORD FORMULA_0010 0 0.0 0.0 65535.0 READ_WRITE ECU_ADDRESS 0x3F99E2 /end MEASUREMENT
/begin MEASUREMENT ed_fsp_8of20_.uw_satz_1of3_.uw_wert_nv_4of4_ "Umweltbedingung beim Fehlereintrag" UWORD FORMULA_0010 0 0.0 0.0 65535.0 READ_WRITE ECU_ADDRESS 0x3F99E4 /end MEASUREMENT
/begin MEASUREMENT ed_fsp_8of20_.uw_satz_2of3_.uw_km_stand_nv "Kilometerstand beim Fehlereintrag" UWORD FORMULA_0054 0 0.0 0.0 524280.0 READ_WRITE ECU_ADDRESS 0x3F99E6 /end MEASUREMENT
/begin MEASUREMENT ed_fsp_8of20_.uw_satz_2of3_.uw_wert_nv_1of4_ "Umweltbedingung beim Fehlereintrag" UWORD FORMULA_0010 0 0.0 0.0 65535.0 READ_WRITE ECU_ADDRESS 0x3F99E8 /end MEASUREMENT
/begin MEASUREMENT ed_fsp_8of20_.uw_satz_2of3_.uw_wert_nv_2of4_ "Umweltbedingung beim Fehlereintrag" UWORD FORMULA_0010 0 0.0 0.0 65535.0 READ_WRITE ECU_ADDRESS 0x3F99EA /end MEASUREMENT
/begin MEASUREMENT ed_fsp_8of20_.uw_satz_2of3_.uw_wert_nv_3of4_ "Umweltbedingung beim Fehlereintrag" UWORD FORMULA_0010 0 0.0 0.0 65535.0 READ_WRITE ECU_ADDRESS 0x3F99EC /end MEASUREMENT
/begin MEASUREMENT ed_fsp_8of20_.uw_satz_2of3_.uw_wert_nv_4of4_ "Umweltbedingung beim Fehlereintrag" UWORD FORMULA_0010 0 0.0 0.0 65535.0 READ_WRITE ECU_ADDRESS 0x3F99EE /end MEASUREMENT
/begin MEASUREMENT ed_fsp_8of20_.uw_satz_3of3_.uw_km_stand_nv "Kilometerstand beim Fehlereintrag" UWORD FORMULA_0054 0 0.0 0.0 524280.0 READ_WRITE ECU_ADDRESS 0x3F99F0 /end MEASUREMENT
/begin MEASUREMENT ed_fsp_8of20_.uw_satz_3of3_.uw_wert_nv_1of4_ "Umweltbedingung beim Fehlereintrag" UWORD FORMULA_0010 0 0.0 0.0 65535.0 READ_WRITE ECU_ADDRESS 0x3F99F2 /end MEASUREMENT
/begin MEASUREMENT ed_fsp_8of20_.uw_satz_3of3_.uw_wert_nv_2of4_ "Umweltbedingung beim Fehlereintrag" UWORD FORMULA_0010 0 0.0 0.0 65535.0 READ_WRITE ECU_ADDRESS 0x3F99F4 /end MEASUREMENT
/begin MEASUREMENT ed_fsp_8of20_.uw_satz_3of3_.uw_wert_nv_3of4_ "Umweltbedingung beim Fehlereintrag" UWORD FORMULA_0010 0 0.0 0.0 65535.0 READ_WRITE ECU_ADDRESS 0x3F99F6 /end MEASUREMENT
/begin MEASUREMENT ed_fsp_8of20_.uw_satz_3of3_.uw_wert_nv_4of4_ "Umweltbedingung beim Fehlereintrag" UWORD FORMULA_0010 0 0.0 0.0 65535.0 READ_WRITE ECU_ADDRESS 0x3F99F8 /end MEASUREMENT
/begin MEASUREMENT ed_fsp_9of20_.ed_fil_index_nv "Verweis auf Fehlerfilter" UWORD FORMULA_0010 0 0.0 0.0 65535.0 READ_WRITE ECU_ADDRESS 0x3F9A3E /end MEASUREMENT
/begin MEASUREMENT ed_fsp_9of20_.fehlerart_nv "Fehlerart und Statusbits" UWORD FORMULA_0010 0 0.0 0.0 65535.0 READ_WRITE ECU_ADDRESS 0x3F9A1A /end MEASUREMENT
/begin MEASUREMENT ed_fsp_9of20_.fehlercode_nv "Externer Fehlerort" UWORD FORMULA_0053 0 0.0 0.0 65535.0 READ_WRITE ECU_ADDRESS 0x3F9A18 /end MEASUREMENT
/begin MEASUREMENT ed_fsp_9of20_.ff_egas_ist_dk_b1_nv "Drosselklappenposition des Freeze Frame" UBYTE FORMULA_0059 0 0.0 0.0 100.0 READ_WRITE ECU_ADDRESS 0x3F9A58 /end MEASUREMENT
/begin MEASUREMENT ed_fsp_9of20_.ff_laa_f_ber_b1_nv "Lambdaadaptionsfaktor ohne TE des Freeze Frame" UBYTE FORMULA_0058 0 0.0 0.0 1.99210000038147 READ_WRITE ECU_ADDRESS 0x3F9A50 /end MEASUREMENT
/begin MEASUREMENT ed_fsp_9of20_.ff_laa_f_ber_b2_nv "Lambdaadaptionsfaktor ohne TE des Freeze Frame" UBYTE FORMULA_0058 0 0.0 0.0 1.99210000038147 READ_WRITE ECU_ADDRESS 0x3F9A51 /end MEASUREMENT
/begin MEASUREMENT ed_fsp_9of20_.ff_lam_reg_b1_nv "Einspritzsystem des Freeze Frame" UBYTE FORMULA_0057 0 0.0 0.0 255.0 READ_WRITE ECU_ADDRESS 0x3F9A4C /end MEASUREMENT
/begin MEASUREMENT ed_fsp_9of20_.ff_lam_reg_b2_nv "Einspritzsystem des Freeze Frame" UBYTE FORMULA_0057 0 0.0 0.0 255.0 READ_WRITE ECU_ADDRESS 0x3F9A4D /end MEASUREMENT
/begin MEASUREMENT ed_fsp_9of20_.ff_lam_reg_f_b1_nv "Lambdaregelfaktor des Freeze Frame" UBYTE FORMULA_0058 0 0.0 0.0 1.99210000038147 READ_WRITE ECU_ADDRESS 0x3F9A4E /end MEASUREMENT
/begin MEASUREMENT ed_fsp_9of20_.ff_lam_reg_f_b2_nv "Lambdaregelfaktor des Freeze Frame" UBYTE FORMULA_0058 0 0.0 0.0 1.99210000038147 READ_WRITE ECU_ADDRESS 0x3F9A4F /end MEASUREMENT
/begin MEASUREMENT ed_fsp_9of20_.ff_ml_ges_nv "Luftmasse des Freeze Frame" UWORD FORMULA_0056 0 0.0 0.0 655.3499755859375 READ_WRITE ECU_ADDRESS 0x3F9A4A /end MEASUREMENT
/begin MEASUREMENT ed_fsp_9of20_.ff_n_nv "Drehzahl des Freeze Frame" UWORD FORMULA_0055 0 0.0 0.0 16383.75 READ_WRITE ECU_ADDRESS 0x3F9A48 /end MEASUREMENT
/begin MEASUREMENT ed_fsp_9of20_.ff_p_code_nv "P-Code des Freeze Frame" UWORD FORMULA_0010 0 0.0 0.0 65535.0 READ_WRITE ECU_ADDRESS 0x3F9A46 /end MEASUREMENT
/begin MEASUREMENT ed_fsp_9of20_.ff_pks_ist_nv "Kraftstoffdruck des Freeze Frame" UBYTE FORMULA_0061 0 0.0 0.0 765.0 READ_WRITE ECU_ADDRESS 0x3F9A54 /end MEASUREMENT
/begin MEASUREMENT ed_fsp_9of20_.ff_rf_m_nv "Last des Freeze Frame" UBYTE FORMULA_0059 0 0.0 0.0 100.0 READ_WRITE ECU_ADDRESS 0x3F9A52 /end MEASUREMENT
/begin MEASUREMENT ed_fsp_9of20_.ff_sl_st_nv "Sekundaerluftstatus des Freeze Frame" UBYTE FORMULA_0064 0 0.0 0.0 255.0 READ_WRITE ECU_ADDRESS 0x3F9A59 /end MEASUREMENT
/begin MEASUREMENT ed_fsp_9of20_.ff_tan_m_nv "Ansauglufttemperatur des Freeze Frame" UBYTE FORMULA_0060 0 0.0 -40.0 215.0 READ_WRITE ECU_ADDRESS 0x3F9A57 /end MEASUREMENT
/begin MEASUREMENT ed_fsp_9of20_.ff_tmot_nv "Kuehlwassertemperatur des Freeze Frame" UBYTE FORMULA_0060 0 0.0 -40.0 215.0 READ_WRITE ECU_ADDRESS 0x3F9A53 /end MEASUREMENT
/begin MEASUREMENT ed_fsp_9of20_.ff_tz1_nv "Zuendwinkel 1 des Freeze Frame" UBYTE FORMULA_0063 0 0.0 -64.0 63.5 READ_WRITE ECU_ADDRESS 0x3F9A56 /end MEASUREMENT
/begin MEASUREMENT ed_fsp_9of20_.ff_v_vorne_nv "Geschwindigkeit des Freeze Frame" UBYTE FORMULA_0062 0 0.0 0.0 255.0 READ_WRITE ECU_ADDRESS 0x3F9A55 /end MEASUREMENT
/begin MEASUREMENT ed_fsp_9of20_.haeufigkeitszaehler_nv "Uebergangszaehler von i.O. -> n.i.O" UBYTE FORMULA_0003 0 0.0 0.0 255.0 READ_WRITE ECU_ADDRESS 0x3F9A1C /end MEASUREMENT
/begin MEASUREMENT ed_fsp_9of20_.inj_fehlerzaehler_nv "INJ-Fehlerzaehler" UWORD FORMULA_0010 0 0.0 0.0 65535.0 READ_WRITE ECU_ADDRESS 0x3F9A3C /end MEASUREMENT
/begin MEASUREMENT ed_fsp_9of20_.logistikzaehler_nv "Warm-Up-Cycling-Zaehler" UBYTE FORMULA_0003 0 0.0 0.0 255.0 READ_WRITE ECU_ADDRESS 0x3F9A1D /end MEASUREMENT
/begin MEASUREMENT ed_fsp_9of20_.mil_filter_nv "Filterwert der Milansteuerung" UBYTE FORMULA_0003 0 0.0 0.0 255.0 READ_WRITE ECU_ADDRESS 0x3F9A40 /end MEASUREMENT
/begin MEASUREMENT ed_fsp_9of20_.mil_filter_scdn_nv "Similar Conditions Eintragsfilterwert der Milansteuerung" UBYTE FORMULA_0003 0 0.0 0.0 255.0 READ_WRITE ECU_ADDRESS 0x3F9A41 /end MEASUREMENT
/begin MEASUREMENT ed_fsp_9of20_.scdn_nenner_nv "Gesamte Anzahl" UWORD FORMULA_0010 0 0.0 0.0 65535.0 READ_WRITE ECU_ADDRESS 0x3F9A44 /end MEASUREMENT
/begin MEASUREMENT ed_fsp_9of20_.scdn_zaehler_nv "Im similar Fenster" UWORD FORMULA_0010 0 0.0 0.0 65535.0 READ_WRITE ECU_ADDRESS 0x3F9A42 /end MEASUREMENT
/begin MEASUREMENT ed_fsp_9of20_.uw_satz_1of3_.uw_km_stand_nv "Kilometerstand beim Fehlereintrag" UWORD FORMULA_0054 0 0.0 0.0 524280.0 READ_WRITE ECU_ADDRESS 0x3F9A1E /end MEASUREMENT
/begin MEASUREMENT ed_fsp_9of20_.uw_satz_1of3_.uw_wert_nv_1of4_ "Umweltbedingung beim Fehlereintrag" UWORD FORMULA_0010 0 0.0 0.0 65535.0 READ_WRITE ECU_ADDRESS 0x3F9A20 /end MEASUREMENT
/begin MEASUREMENT ed_fsp_9of20_.uw_satz_1of3_.uw_wert_nv_2of4_ "Umweltbedingung beim Fehlereintrag" UWORD FORMULA_0010 0 0.0 0.0 65535.0 READ_WRITE ECU_ADDRESS 0x3F9A22 /end MEASUREMENT
/begin MEASUREMENT ed_fsp_9of20_.uw_satz_1of3_.uw_wert_nv_3of4_ "Umweltbedingung beim Fehlereintrag" UWORD FORMULA_0010 0 0.0 0.0 65535.0 READ_WRITE ECU_ADDRESS 0x3F9A24 /end MEASUREMENT
/begin MEASUREMENT ed_fsp_9of20_.uw_satz_1of3_.uw_wert_nv_4of4_ "Umweltbedingung beim Fehlereintrag" UWORD FORMULA_0010 0 0.0 0.0 65535.0 READ_WRITE ECU_ADDRESS 0x3F9A26 /end MEASUREMENT
/begin MEASUREMENT ed_fsp_9of20_.uw_satz_2of3_.uw_km_stand_nv "Kilometerstand beim Fehlereintrag" UWORD FORMULA_0054 0 0.0 0.0 524280.0 READ_WRITE ECU_ADDRESS 0x3F9A28 /end MEASUREMENT
/begin MEASUREMENT ed_fsp_9of20_.uw_satz_2of3_.uw_wert_nv_1of4_ "Umweltbedingung beim Fehlereintrag" UWORD FORMULA_0010 0 0.0 0.0 65535.0 READ_WRITE ECU_ADDRESS 0x3F9A2A /end MEASUREMENT
/begin MEASUREMENT ed_fsp_9of20_.uw_satz_2of3_.uw_wert_nv_2of4_ "Umweltbedingung beim Fehlereintrag" UWORD FORMULA_0010 0 0.0 0.0 65535.0 READ_WRITE ECU_ADDRESS 0x3F9A2C /end MEASUREMENT
/begin MEASUREMENT ed_fsp_9of20_.uw_satz_2of3_.uw_wert_nv_3of4_ "Umweltbedingung beim Fehlereintrag" UWORD FORMULA_0010 0 0.0 0.0 65535.0 READ_WRITE ECU_ADDRESS 0x3F9A2E /end MEASUREMENT
/begin MEASUREMENT ed_fsp_9of20_.uw_satz_2of3_.uw_wert_nv_4of4_ "Umweltbedingung beim Fehlereintrag" UWORD FORMULA_0010 0 0.0 0.0 65535.0 READ_WRITE ECU_ADDRESS 0x3F9A30 /end MEASUREMENT
/begin MEASUREMENT ed_fsp_9of20_.uw_satz_3of3_.uw_km_stand_nv "Kilometerstand beim Fehlereintrag" UWORD FORMULA_0054 0 0.0 0.0 524280.0 READ_WRITE ECU_ADDRESS 0x3F9A32 /end MEASUREMENT
/begin MEASUREMENT ed_fsp_9of20_.uw_satz_3of3_.uw_wert_nv_1of4_ "Umweltbedingung beim Fehlereintrag" UWORD FORMULA_0010 0 0.0 0.0 65535.0 READ_WRITE ECU_ADDRESS 0x3F9A34 /end MEASUREMENT
/begin MEASUREMENT ed_fsp_9of20_.uw_satz_3of3_.uw_wert_nv_2of4_ "Umweltbedingung beim Fehlereintrag" UWORD FORMULA_0010 0 0.0 0.0 65535.0 READ_WRITE ECU_ADDRESS 0x3F9A36 /end MEASUREMENT
/begin MEASUREMENT ed_fsp_9of20_.uw_satz_3of3_.uw_wert_nv_3of4_ "Umweltbedingung beim Fehlereintrag" UWORD FORMULA_0010 0 0.0 0.0 65535.0 READ_WRITE ECU_ADDRESS 0x3F9A38 /end MEASUREMENT
/begin MEASUREMENT ed_fsp_9of20_.uw_satz_3of3_.uw_wert_nv_4of4_ "Umweltbedingung beim Fehlereintrag" UWORD FORMULA_0010 0 0.0 0.0 65535.0 READ_WRITE ECU_ADDRESS 0x3F9A3A /end MEASUREMENT
/begin MEASUREMENT ed_loeschen "Uebergangsloesung zum Loeschen" UBYTE FORMULA_0070 0 0.0 0.0 255.0 READ_WRITE ECU_ADDRESS 0x3FB648 /end MEASUREMENT
/begin MEASUREMENT ed_mil_bmw_ign "Mil-Status IGN" UBYTE FORMULA_0065 0 0 0.0 255.0 READ_WRITE BIT_MASK 0x1 ECU_ADDRESS 0x3F8238 /end MEASUREMENT
/begin MEASUREMENT ed_mil_bmw_inj "Mil-Status INJ" UBYTE FORMULA_0065 0 0 0.0 255.0 READ_WRITE BIT_MASK 0x1 ECU_ADDRESS 0x3F8530 /end MEASUREMENT
/begin MEASUREMENT ed_mil_dme_ign "Mil-Status IGN" UBYTE FORMULA_0067 0 0 0.0 255.0 READ_WRITE BIT_MASK 0x80 ECU_ADDRESS 0x3F8238 /end MEASUREMENT
/begin MEASUREMENT ed_mil_dme_inj "Mil-Status INJ" UBYTE FORMULA_0067 0 0 0.0 255.0 READ_WRITE BIT_MASK 0x80 ECU_ADDRESS 0x3F8530 /end MEASUREMENT
/begin MEASUREMENT ed_mil_on_km_stand_nv "Kilometerstand MIL on" ULONG FORMULA_0027 0 0.0 0.0 16777214.0 READ_WRITE ECU_ADDRESS 0x3F9300 /end MEASUREMENT
/begin MEASUREMENT ed_mil_predrive_ign "Mil-Status IGN" UBYTE FORMULA_0066 0 0 0.0 255.0 READ_WRITE BIT_MASK 0x2 ECU_ADDRESS 0x3F8238 /end MEASUREMENT
/begin MEASUREMENT ed_mil_predrive_inj "Mil-Status INJ" UBYTE FORMULA_0066 0 0 0.0 255.0 READ_WRITE BIT_MASK 0x2 ECU_ADDRESS 0x3F8530 /end MEASUREMENT
/begin MEASUREMENT ed_mil_smg_ign "Mil-Status IGN" UBYTE FORMULA_0069 0 0 0.0 255.0 READ_WRITE BIT_MASK 0x8 ECU_ADDRESS 0x3F8238 /end MEASUREMENT
/begin MEASUREMENT ed_mil_st_ign "Mil-Status IGN" UBYTE FORMULA_0037 0 0.0 0.0 255.0 READ_WRITE ECU_ADDRESS 0x3F8238 /end MEASUREMENT
/begin MEASUREMENT ed_mil_st_inj "Mil-Status INJ" UBYTE FORMULA_0037 0 0.0 0.0 255.0 READ_WRITE ECU_ADDRESS 0x3F8530 /end MEASUREMENT
/begin MEASUREMENT ed_mil_zyl_off_ign "Mil-Status IGN" UBYTE FORMULA_0068 0 0 0.0 255.0 READ_WRITE BIT_MASK 0x4 ECU_ADDRESS 0x3F8238 /end MEASUREMENT
/begin MEASUREMENT ed_rbm_afz_hs.denominator_nv "Fahrzyklen" UWORD FORMULA_0010 0 0.0 0.0 65535.0 READ_WRITE ECU_ADDRESS 0x3F97AA /end MEASUREMENT
/begin MEASUREMENT ed_rbm_afz_hs.numerator_nv "Diagnosezyklen" UWORD FORMULA_0010 0 0.0 0.0 65535.0 READ_WRITE ECU_ADDRESS 0x3F97A8 /end MEASUREMENT
/begin MEASUREMENT ed_rbm_appl_data_ign.denominator_nv "Fahrzyklen" UWORD FORMULA_0010 0 0.0 0.0 65535.0 READ_WRITE ECU_ADDRESS 0x3F9636 /end MEASUREMENT
/begin MEASUREMENT ed_rbm_appl_data_ign.numerator_nv "Diagnosezyklen" UWORD FORMULA_0010 0 0.0 0.0 65535.0 READ_WRITE ECU_ADDRESS 0x3F9634 /end MEASUREMENT
/begin MEASUREMENT ed_rbm_auss_abg_mult.denominator_nv "Fahrzyklen" UWORD FORMULA_0010 0 0.0 0.0 65535.0 READ_WRITE ECU_ADDRESS 0x3F9762 /end MEASUREMENT
/begin MEASUREMENT ed_rbm_auss_abg_mult.numerator_nv "Diagnosezyklen" UWORD FORMULA_0010 0 0.0 0.0 65535.0 READ_WRITE ECU_ADDRESS 0x3F9760 /end MEASUREMENT
/begin MEASUREMENT ed_rbm_auss_abg_z1.denominator_nv "Fahrzyklen" UWORD FORMULA_0010 0 0.0 0.0 65535.0 READ_WRITE ECU_ADDRESS 0x3F9732 /end MEASUREMENT
/begin MEASUREMENT ed_rbm_auss_abg_z1.numerator_nv "Diagnosezyklen" UWORD FORMULA_0010 0 0.0 0.0 65535.0 READ_WRITE ECU_ADDRESS 0x3F9730 /end MEASUREMENT
/begin MEASUREMENT ed_rbm_auss_abg_z10.denominator_nv "Fahrzyklen" UWORD FORMULA_0010 0 0.0 0.0 65535.0 READ_WRITE ECU_ADDRESS 0x3F9756 /end MEASUREMENT
/begin MEASUREMENT ed_rbm_auss_abg_z10.numerator_nv "Diagnosezyklen" UWORD FORMULA_0010 0 0.0 0.0 65535.0 READ_WRITE ECU_ADDRESS 0x3F9754 /end MEASUREMENT
/begin MEASUREMENT ed_rbm_auss_abg_z2.denominator_nv "Fahrzyklen" UWORD FORMULA_0010 0 0.0 0.0 65535.0 READ_WRITE ECU_ADDRESS 0x3F9736 /end MEASUREMENT
/begin MEASUREMENT ed_rbm_auss_abg_z2.numerator_nv "Diagnosezyklen" UWORD FORMULA_0010 0 0.0 0.0 65535.0 READ_WRITE ECU_ADDRESS 0x3F9734 /end MEASUREMENT
/begin MEASUREMENT ed_rbm_auss_abg_z3.denominator_nv "Fahrzyklen" UWORD FORMULA_0010 0 0.0 0.0 65535.0 READ_WRITE ECU_ADDRESS 0x3F973A /end MEASUREMENT
/begin MEASUREMENT ed_rbm_auss_abg_z3.numerator_nv "Diagnosezyklen" UWORD FORMULA_0010 0 0.0 0.0 65535.0 READ_WRITE ECU_ADDRESS 0x3F9738 /end MEASUREMENT
/begin MEASUREMENT ed_rbm_auss_abg_z4.denominator_nv "Fahrzyklen" UWORD FORMULA_0010 0 0.0 0.0 65535.0 READ_WRITE ECU_ADDRESS 0x3F973E /end MEASUREMENT
/begin MEASUREMENT ed_rbm_auss_abg_z4.numerator_nv "Diagnosezyklen" UWORD FORMULA_0010 0 0.0 0.0 65535.0 READ_WRITE ECU_ADDRESS 0x3F973C /end MEASUREMENT
/begin MEASUREMENT ed_rbm_auss_abg_z5.denominator_nv "Fahrzyklen" UWORD FORMULA_0010 0 0.0 0.0 65535.0 READ_WRITE ECU_ADDRESS 0x3F9742 /end MEASUREMENT
/begin MEASUREMENT ed_rbm_auss_abg_z5.numerator_nv "Diagnosezyklen" UWORD FORMULA_0010 0 0.0 0.0 65535.0 READ_WRITE ECU_ADDRESS 0x3F9740 /end MEASUREMENT
/begin MEASUREMENT ed_rbm_auss_abg_z6.denominator_nv "Fahrzyklen" UWORD FORMULA_0010 0 0.0 0.0 65535.0 READ_WRITE ECU_ADDRESS 0x3F9746 /end MEASUREMENT
/begin MEASUREMENT ed_rbm_auss_abg_z6.numerator_nv "Diagnosezyklen" UWORD FORMULA_0010 0 0.0 0.0 65535.0 READ_WRITE ECU_ADDRESS 0x3F9744 /end MEASUREMENT
/begin MEASUREMENT ed_rbm_auss_abg_z7.denominator_nv "Fahrzyklen" UWORD FORMULA_0010 0 0.0 0.0 65535.0 READ_WRITE ECU_ADDRESS 0x3F974A /end MEASUREMENT
/begin MEASUREMENT ed_rbm_auss_abg_z7.numerator_nv "Diagnosezyklen" UWORD FORMULA_0010 0 0.0 0.0 65535.0 READ_WRITE ECU_ADDRESS 0x3F9748 /end MEASUREMENT
/begin MEASUREMENT ed_rbm_auss_abg_z8.denominator_nv "Fahrzyklen" UWORD FORMULA_0010 0 0.0 0.0 65535.0 READ_WRITE ECU_ADDRESS 0x3F974E /end MEASUREMENT
/begin MEASUREMENT ed_rbm_auss_abg_z8.numerator_nv "Diagnosezyklen" UWORD FORMULA_0010 0 0.0 0.0 65535.0 READ_WRITE ECU_ADDRESS 0x3F974C /end MEASUREMENT
/begin MEASUREMENT ed_rbm_auss_abg_z9.denominator_nv "Fahrzyklen" UWORD FORMULA_0010 0 0.0 0.0 65535.0 READ_WRITE ECU_ADDRESS 0x3F9752 /end MEASUREMENT
/begin MEASUREMENT ed_rbm_auss_abg_z9.numerator_nv "Diagnosezyklen" UWORD FORMULA_0010 0 0.0 0.0 65535.0 READ_WRITE ECU_ADDRESS 0x3F9750 /end MEASUREMENT
/begin MEASUREMENT ed_rbm_auss_kat_mult.denominator_nv "Fahrzyklen" UWORD FORMULA_0010 0 0.0 0.0 65535.0 READ_WRITE ECU_ADDRESS 0x3F972E /end MEASUREMENT
/begin MEASUREMENT ed_rbm_auss_kat_mult.numerator_nv "Diagnosezyklen" UWORD FORMULA_0010 0 0.0 0.0 65535.0 READ_WRITE ECU_ADDRESS 0x3F972C /end MEASUREMENT
/begin MEASUREMENT ed_rbm_auss_kat_z1.denominator_nv "Fahrzyklen" UWORD FORMULA_0010 0 0.0 0.0 65535.0 READ_WRITE ECU_ADDRESS 0x3F96FE /end MEASUREMENT
/begin MEASUREMENT ed_rbm_auss_kat_z1.numerator_nv "Diagnosezyklen" UWORD FORMULA_0010 0 0.0 0.0 65535.0 READ_WRITE ECU_ADDRESS 0x3F96FC /end MEASUREMENT
/begin MEASUREMENT ed_rbm_auss_kat_z10.denominator_nv "Fahrzyklen" UWORD FORMULA_0010 0 0.0 0.0 65535.0 READ_WRITE ECU_ADDRESS 0x3F9722 /end MEASUREMENT
/begin MEASUREMENT ed_rbm_auss_kat_z10.numerator_nv "Diagnosezyklen" UWORD FORMULA_0010 0 0.0 0.0 65535.0 READ_WRITE ECU_ADDRESS 0x3F9720 /end MEASUREMENT
/begin MEASUREMENT ed_rbm_auss_kat_z2.denominator_nv "Fahrzyklen" UWORD FORMULA_0010 0 0.0 0.0 65535.0 READ_WRITE ECU_ADDRESS 0x3F9702 /end MEASUREMENT
/begin MEASUREMENT ed_rbm_auss_kat_z2.numerator_nv "Diagnosezyklen" UWORD FORMULA_0010 0 0.0 0.0 65535.0 READ_WRITE ECU_ADDRESS 0x3F9700 /end MEASUREMENT
/begin MEASUREMENT ed_rbm_auss_kat_z3.denominator_nv "Fahrzyklen" UWORD FORMULA_0010 0 0.0 0.0 65535.0 READ_WRITE ECU_ADDRESS 0x3F9706 /end MEASUREMENT
/begin MEASUREMENT ed_rbm_auss_kat_z3.numerator_nv "Diagnosezyklen" UWORD FORMULA_0010 0 0.0 0.0 65535.0 READ_WRITE ECU_ADDRESS 0x3F9704 /end MEASUREMENT
/begin MEASUREMENT ed_rbm_auss_kat_z4.denominator_nv "Fahrzyklen" UWORD FORMULA_0010 0 0.0 0.0 65535.0 READ_WRITE ECU_ADDRESS 0x3F970A /end MEASUREMENT
/begin MEASUREMENT ed_rbm_auss_kat_z4.numerator_nv "Diagnosezyklen" UWORD FORMULA_0010 0 0.0 0.0 65535.0 READ_WRITE ECU_ADDRESS 0x3F9708 /end MEASUREMENT
/begin MEASUREMENT ed_rbm_auss_kat_z5.denominator_nv "Fahrzyklen" UWORD FORMULA_0010 0 0.0 0.0 65535.0 READ_WRITE ECU_ADDRESS 0x3F970E /end MEASUREMENT
/begin MEASUREMENT ed_rbm_auss_kat_z5.numerator_nv "Diagnosezyklen" UWORD FORMULA_0010 0 0.0 0.0 65535.0 READ_WRITE ECU_ADDRESS 0x3F970C /end MEASUREMENT
/begin MEASUREMENT ed_rbm_auss_kat_z6.denominator_nv "Fahrzyklen" UWORD FORMULA_0010 0 0.0 0.0 65535.0 READ_WRITE ECU_ADDRESS 0x3F9712 /end MEASUREMENT
/begin MEASUREMENT ed_rbm_auss_kat_z6.numerator_nv "Diagnosezyklen" UWORD FORMULA_0010 0 0.0 0.0 65535.0 READ_WRITE ECU_ADDRESS 0x3F9710 /end MEASUREMENT
/begin MEASUREMENT ed_rbm_auss_kat_z7.denominator_nv "Fahrzyklen" UWORD FORMULA_0010 0 0.0 0.0 65535.0 READ_WRITE ECU_ADDRESS 0x3F9716 /end MEASUREMENT
/begin MEASUREMENT ed_rbm_auss_kat_z7.numerator_nv "Diagnosezyklen" UWORD FORMULA_0010 0 0.0 0.0 65535.0 READ_WRITE ECU_ADDRESS 0x3F9714 /end MEASUREMENT
/begin MEASUREMENT ed_rbm_auss_kat_z8.denominator_nv "Fahrzyklen" UWORD FORMULA_0010 0 0.0 0.0 65535.0 READ_WRITE ECU_ADDRESS 0x3F971A /end MEASUREMENT
/begin MEASUREMENT ed_rbm_auss_kat_z8.numerator_nv "Diagnosezyklen" UWORD FORMULA_0010 0 0.0 0.0 65535.0 READ_WRITE ECU_ADDRESS 0x3F9718 /end MEASUREMENT
/begin MEASUREMENT ed_rbm_auss_kat_z9.denominator_nv "Fahrzyklen" UWORD FORMULA_0010 0 0.0 0.0 65535.0 READ_WRITE ECU_ADDRESS 0x3F971E /end MEASUREMENT
/begin MEASUREMENT ed_rbm_auss_kat_z9.numerator_nv "Diagnosezyklen" UWORD FORMULA_0010 0 0.0 0.0 65535.0 READ_WRITE ECU_ADDRESS 0x3F971C /end MEASUREMENT
/begin MEASUREMENT ed_rbm_bls_plau.denominator_nv "Fahrzyklen" UWORD FORMULA_0010 0 0.0 0.0 65535.0 READ_WRITE ECU_ADDRESS 0x3F9782 /end MEASUREMENT
/begin MEASUREMENT ed_rbm_bls_plau.numerator_nv "Diagnosezyklen" UWORD FORMULA_0010 0 0.0 0.0 65535.0 READ_WRITE ECU_ADDRESS 0x3F9780 /end MEASUREMENT
/begin MEASUREMENT ed_rbm_denominator_nv "Status der Denominatorerhoehung" UBYTE FORMULA_0003 0 0.0 0.0 255.0 READ_WRITE ECU_ADDRESS 0x3F92FD /end MEASUREMENT
/begin MEASUREMENT ed_rbm_dk_init.denominator_nv "Fahrzyklen" UWORD FORMULA_0010 0 0.0 0.0 65535.0 READ_WRITE ECU_ADDRESS 0x3F967A /end MEASUREMENT
/begin MEASUREMENT ed_rbm_dk_init.numerator_nv "Diagnosezyklen" UWORD FORMULA_0010 0 0.0 0.0 65535.0 READ_WRITE ECU_ADDRESS 0x3F9678 /end MEASUREMENT
/begin MEASUREMENT ed_rbm_dk1_adapt.denominator_nv "Fahrzyklen" UWORD FORMULA_0010 0 0.0 0.0 65535.0 READ_WRITE ECU_ADDRESS 0x3F9686 /end MEASUREMENT
/begin MEASUREMENT ed_rbm_dk1_adapt.numerator_nv "Diagnosezyklen" UWORD FORMULA_0010 0 0.0 0.0 65535.0 READ_WRITE ECU_ADDRESS 0x3F9684 /end MEASUREMENT
/begin MEASUREMENT ed_rbm_dk1_can.denominator_nv "Fahrzyklen" UWORD FORMULA_0010 0 0.0 0.0 65535.0 READ_WRITE ECU_ADDRESS 0x3F9656 /end MEASUREMENT
/begin MEASUREMENT ed_rbm_dk1_can.numerator_nv "Diagnosezyklen" UWORD FORMULA_0010 0 0.0 0.0 65535.0 READ_WRITE ECU_ADDRESS 0x3F9654 /end MEASUREMENT
/begin MEASUREMENT ed_rbm_dk1_cmd.denominator_nv "Fahrzyklen" UWORD FORMULA_0010 0 0.0 0.0 65535.0 READ_WRITE ECU_ADDRESS 0x3F96DA /end MEASUREMENT
/begin MEASUREMENT ed_rbm_dk1_cmd.numerator_nv "Diagnosezyklen" UWORD FORMULA_0010 0 0.0 0.0 65535.0 READ_WRITE ECU_ADDRESS 0x3F96D8 /end MEASUREMENT
/begin MEASUREMENT ed_rbm_dk1_federn.denominator_nv "Fahrzyklen" UWORD FORMULA_0010 0 0.0 0.0 65535.0 READ_WRITE ECU_ADDRESS 0x3F96C6 /end MEASUREMENT
/begin MEASUREMENT ed_rbm_dk1_federn.numerator_nv "Diagnosezyklen" UWORD FORMULA_0010 0 0.0 0.0 65535.0 READ_WRITE ECU_ADDRESS 0x3F96C4 /end MEASUREMENT
/begin MEASUREMENT ed_rbm_dk1_pdr.denominator_nv "Fahrzyklen" UWORD FORMULA_0010 0 0.0 0.0 65535.0 READ_WRITE ECU_ADDRESS 0x3F96AE /end MEASUREMENT
/begin MEASUREMENT ed_rbm_dk1_pdr.numerator_nv "Diagnosezyklen" UWORD FORMULA_0010 0 0.0 0.0 65535.0 READ_WRITE ECU_ADDRESS 0x3F96AC /end MEASUREMENT
/begin MEASUREMENT ed_rbm_dk1_regler.denominator_nv "Fahrzyklen" UWORD FORMULA_0010 0 0.0 0.0 65535.0 READ_WRITE ECU_ADDRESS 0x3F967E /end MEASUREMENT
/begin MEASUREMENT ed_rbm_dk1_regler.numerator_nv "Diagnosezyklen" UWORD FORMULA_0010 0 0.0 0.0 65535.0 READ_WRITE ECU_ADDRESS 0x3F967C /end MEASUREMENT
/begin MEASUREMENT ed_rbm_dk1_sk_err.denominator_nv "Fahrzyklen" UWORD FORMULA_0010 0 0.0 0.0 65535.0 READ_WRITE ECU_ADDRESS 0x3F96BE /end MEASUREMENT
/begin MEASUREMENT ed_rbm_dk1_sk_err.numerator_nv "Diagnosezyklen" UWORD FORMULA_0010 0 0.0 0.0 65535.0 READ_WRITE ECU_ADDRESS 0x3F96BC /end MEASUREMENT
/begin MEASUREMENT ed_rbm_dk1_wdk.denominator_nv "Fahrzyklen" UWORD FORMULA_0010 0 0.0 0.0 65535.0 READ_WRITE ECU_ADDRESS 0x3F96A6 /end MEASUREMENT
/begin MEASUREMENT ed_rbm_dk1_wdk.numerator_nv "Diagnosezyklen" UWORD FORMULA_0010 0 0.0 0.0 65535.0 READ_WRITE ECU_ADDRESS 0x3F96A4 /end MEASUREMENT
/begin MEASUREMENT ed_rbm_dk1_zust.denominator_nv "Fahrzyklen" UWORD FORMULA_0010 0 0.0 0.0 65535.0 READ_WRITE ECU_ADDRESS 0x3F9796 /end MEASUREMENT
/begin MEASUREMENT ed_rbm_dk1_zust.numerator_nv "Diagnosezyklen" UWORD FORMULA_0010 0 0.0 0.0 65535.0 READ_WRITE ECU_ADDRESS 0x3F9794 /end MEASUREMENT
/begin MEASUREMENT ed_rbm_dk2_adapt.denominator_nv "Fahrzyklen" UWORD FORMULA_0010 0 0.0 0.0 65535.0 READ_WRITE ECU_ADDRESS 0x3F968A /end MEASUREMENT
/begin MEASUREMENT ed_rbm_dk2_adapt.numerator_nv "Diagnosezyklen" UWORD FORMULA_0010 0 0.0 0.0 65535.0 READ_WRITE ECU_ADDRESS 0x3F9688 /end MEASUREMENT
/begin MEASUREMENT ed_rbm_dk2_can.denominator_nv "Fahrzyklen" UWORD FORMULA_0010 0 0.0 0.0 65535.0 READ_WRITE ECU_ADDRESS 0x3F965A /end MEASUREMENT
/begin MEASUREMENT ed_rbm_dk2_can.numerator_nv "Diagnosezyklen" UWORD FORMULA_0010 0 0.0 0.0 65535.0 READ_WRITE ECU_ADDRESS 0x3F9658 /end MEASUREMENT
/begin MEASUREMENT ed_rbm_dk2_cmd.denominator_nv "Fahrzyklen" UWORD FORMULA_0010 0 0.0 0.0 65535.0 READ_WRITE ECU_ADDRESS 0x3F96DE /end MEASUREMENT
/begin MEASUREMENT ed_rbm_dk2_cmd.numerator_nv "Diagnosezyklen" UWORD FORMULA_0010 0 0.0 0.0 65535.0 READ_WRITE ECU_ADDRESS 0x3F96DC /end MEASUREMENT
/begin MEASUREMENT ed_rbm_dk2_federn.denominator_nv "Fahrzyklen" UWORD FORMULA_0010 0 0.0 0.0 65535.0 READ_WRITE ECU_ADDRESS 0x3F96CA /end MEASUREMENT
/begin MEASUREMENT ed_rbm_dk2_federn.numerator_nv "Diagnosezyklen" UWORD FORMULA_0010 0 0.0 0.0 65535.0 READ_WRITE ECU_ADDRESS 0x3F96C8 /end MEASUREMENT
/begin MEASUREMENT ed_rbm_dk2_pdr.denominator_nv "Fahrzyklen" UWORD FORMULA_0010 0 0.0 0.0 65535.0 READ_WRITE ECU_ADDRESS 0x3F96B2 /end MEASUREMENT
/begin MEASUREMENT ed_rbm_dk2_pdr.numerator_nv "Diagnosezyklen" UWORD FORMULA_0010 0 0.0 0.0 65535.0 READ_WRITE ECU_ADDRESS 0x3F96B0 /end MEASUREMENT
/begin MEASUREMENT ed_rbm_dk2_regler.denominator_nv "Fahrzyklen" UWORD FORMULA_0010 0 0.0 0.0 65535.0 READ_WRITE ECU_ADDRESS 0x3F9682 /end MEASUREMENT
/begin MEASUREMENT ed_rbm_dk2_regler.numerator_nv "Diagnosezyklen" UWORD FORMULA_0010 0 0.0 0.0 65535.0 READ_WRITE ECU_ADDRESS 0x3F9680 /end MEASUREMENT
/begin MEASUREMENT ed_rbm_dk2_sk_err.denominator_nv "Fahrzyklen" UWORD FORMULA_0010 0 0.0 0.0 65535.0 READ_WRITE ECU_ADDRESS 0x3F96C2 /end MEASUREMENT
/begin MEASUREMENT ed_rbm_dk2_sk_err.numerator_nv "Diagnosezyklen" UWORD FORMULA_0010 0 0.0 0.0 65535.0 READ_WRITE ECU_ADDRESS 0x3F96C0 /end MEASUREMENT
/begin MEASUREMENT ed_rbm_dk2_wdk.denominator_nv "Fahrzyklen" UWORD FORMULA_0010 0 0.0 0.0 65535.0 READ_WRITE ECU_ADDRESS 0x3F96AA /end MEASUREMENT
/begin MEASUREMENT ed_rbm_dk2_wdk.numerator_nv "Diagnosezyklen" UWORD FORMULA_0010 0 0.0 0.0 65535.0 READ_WRITE ECU_ADDRESS 0x3F96A8 /end MEASUREMENT
/begin MEASUREMENT ed_rbm_dk2_zust.denominator_nv "Fahrzyklen" UWORD FORMULA_0010 0 0.0 0.0 65535.0 READ_WRITE ECU_ADDRESS 0x3F979A /end MEASUREMENT
/begin MEASUREMENT ed_rbm_dk2_zust.numerator_nv "Diagnosezyklen" UWORD FORMULA_0010 0 0.0 0.0 65535.0 READ_WRITE ECU_ADDRESS 0x3F9798 /end MEASUREMENT
/begin MEASUREMENT ed_rbm_dkg_eingr.denominator_nv "Fahrzyklen" UWORD FORMULA_0010 0 0.0 0.0 65535.0 READ_WRITE ECU_ADDRESS 0x3F976A /end MEASUREMENT
/begin MEASUREMENT ed_rbm_dkg_eingr.numerator_nv "Diagnosezyklen" UWORD FORMULA_0010 0 0.0 0.0 65535.0 READ_WRITE ECU_ADDRESS 0x3F9768 /end MEASUREMENT
/begin MEASUREMENT ed_rbm_dsc_eingr.denominator_nv "Fahrzyklen" UWORD FORMULA_0010 0 0.0 0.0 65535.0 READ_WRITE ECU_ADDRESS 0x3F96D6 /end MEASUREMENT
/begin MEASUREMENT ed_rbm_dsc_eingr.numerator_nv "Diagnosezyklen" UWORD FORMULA_0010 0 0.0 0.0 65535.0 READ_WRITE ECU_ADDRESS 0x3F96D4 /end MEASUREMENT
/begin MEASUREMENT ed_rbm_e2_ign.denominator_nv "Fahrzyklen" UWORD FORMULA_0010 0 0.0 0.0 65535.0 READ_WRITE ECU_ADDRESS 0x3F977E /end MEASUREMENT
/begin MEASUREMENT ed_rbm_e2_ign.numerator_nv "Diagnosezyklen" UWORD FORMULA_0010 0 0.0 0.0 65535.0 READ_WRITE ECU_ADDRESS 0x3F977C /end MEASUREMENT
/begin MEASUREMENT ed_rbm_ec_busoff.denominator_nv "Fahrzyklen" UWORD FORMULA_0010 0 0.0 0.0 65535.0 READ_WRITE ECU_ADDRESS 0x3F96FA /end MEASUREMENT
/begin MEASUREMENT ed_rbm_ec_busoff.numerator_nv "Diagnosezyklen" UWORD FORMULA_0010 0 0.0 0.0 65535.0 READ_WRITE ECU_ADDRESS 0x3F96F8 /end MEASUREMENT
/begin MEASUREMENT ed_rbm_fgr_abwurf.denominator_nv "Fahrzyklen" UWORD FORMULA_0010 0 0.0 0.0 65535.0 READ_WRITE ECU_ADDRESS 0x3F979E /end MEASUREMENT
/begin MEASUREMENT ed_rbm_fgr_abwurf.numerator_nv "Diagnosezyklen" UWORD FORMULA_0010 0 0.0 0.0 65535.0 READ_WRITE ECU_ADDRESS 0x3F979C /end MEASUREMENT
/begin MEASUREMENT ed_rbm_index_121_ign.denominator_nv "Fahrzyklen" UWORD FORMULA_0010 0 0.0 0.0 65535.0 READ_WRITE ECU_ADDRESS 0x3F97EE /end MEASUREMENT
/begin MEASUREMENT ed_rbm_index_121_ign.numerator_nv "Diagnosezyklen" UWORD FORMULA_0010 0 0.0 0.0 65535.0 READ_WRITE ECU_ADDRESS 0x3F97EC /end MEASUREMENT
/begin MEASUREMENT ed_rbm_index_122_ign.denominator_nv "Fahrzyklen" UWORD FORMULA_0010 0 0.0 0.0 65535.0 READ_WRITE ECU_ADDRESS 0x3F97F2 /end MEASUREMENT
/begin MEASUREMENT ed_rbm_index_122_ign.numerator_nv "Diagnosezyklen" UWORD FORMULA_0010 0 0.0 0.0 65535.0 READ_WRITE ECU_ADDRESS 0x3F97F0 /end MEASUREMENT
/begin MEASUREMENT ed_rbm_index_123_ign.denominator_nv "Fahrzyklen" UWORD FORMULA_0010 0 0.0 0.0 65535.0 READ_WRITE ECU_ADDRESS 0x3F97F6 /end MEASUREMENT
/begin MEASUREMENT ed_rbm_index_123_ign.numerator_nv "Diagnosezyklen" UWORD FORMULA_0010 0 0.0 0.0 65535.0 READ_WRITE ECU_ADDRESS 0x3F97F4 /end MEASUREMENT
/begin MEASUREMENT ed_rbm_index_124_ign.denominator_nv "Fahrzyklen" UWORD FORMULA_0010 0 0.0 0.0 65535.0 READ_WRITE ECU_ADDRESS 0x3F97FA /end MEASUREMENT
/begin MEASUREMENT ed_rbm_index_124_ign.numerator_nv "Diagnosezyklen" UWORD FORMULA_0010 0 0.0 0.0 65535.0 READ_WRITE ECU_ADDRESS 0x3F97F8 /end MEASUREMENT
/begin MEASUREMENT ed_rbm_index_125_ign.denominator_nv "Fahrzyklen" UWORD FORMULA_0010 0 0.0 0.0 65535.0 READ_WRITE ECU_ADDRESS 0x3F97FE /end MEASUREMENT
/begin MEASUREMENT ed_rbm_index_125_ign.numerator_nv "Diagnosezyklen" UWORD FORMULA_0010 0 0.0 0.0 65535.0 READ_WRITE ECU_ADDRESS 0x3F97FC /end MEASUREMENT
/begin MEASUREMENT ed_rbm_index_126_ign.denominator_nv "Fahrzyklen" UWORD FORMULA_0010 0 0.0 0.0 65535.0 READ_WRITE ECU_ADDRESS 0x3F9802 /end MEASUREMENT
/begin MEASUREMENT ed_rbm_index_126_ign.numerator_nv "Diagnosezyklen" UWORD FORMULA_0010 0 0.0 0.0 65535.0 READ_WRITE ECU_ADDRESS 0x3F9800 /end MEASUREMENT
/begin MEASUREMENT ed_rbm_index_127_ign.denominator_nv "Fahrzyklen" UWORD FORMULA_0010 0 0.0 0.0 65535.0 READ_WRITE ECU_ADDRESS 0x3F9806 /end MEASUREMENT
/begin MEASUREMENT ed_rbm_index_127_ign.numerator_nv "Diagnosezyklen" UWORD FORMULA_0010 0 0.0 0.0 65535.0 READ_WRITE ECU_ADDRESS 0x3F9804 /end MEASUREMENT
/begin MEASUREMENT ed_rbm_index_33_ign.denominator_nv "Fahrzyklen" UWORD FORMULA_0010 0 0.0 0.0 65535.0 READ_WRITE ECU_ADDRESS 0x3F968E /end MEASUREMENT
/begin MEASUREMENT ed_rbm_index_33_ign.numerator_nv "Diagnosezyklen" UWORD FORMULA_0010 0 0.0 0.0 65535.0 READ_WRITE ECU_ADDRESS 0x3F968C /end MEASUREMENT
/begin MEASUREMENT ed_rbm_index_34_ign.denominator_nv "Fahrzyklen" UWORD FORMULA_0010 0 0.0 0.0 65535.0 READ_WRITE ECU_ADDRESS 0x3F9692 /end MEASUREMENT
/begin MEASUREMENT ed_rbm_index_34_ign.numerator_nv "Diagnosezyklen" UWORD FORMULA_0010 0 0.0 0.0 65535.0 READ_WRITE ECU_ADDRESS 0x3F9690 /end MEASUREMENT
/begin MEASUREMENT ed_rbm_index_35_ign.denominator_nv "Fahrzyklen" UWORD FORMULA_0010 0 0.0 0.0 65535.0 READ_WRITE ECU_ADDRESS 0x3F9696 /end MEASUREMENT
/begin MEASUREMENT ed_rbm_index_35_ign.numerator_nv "Diagnosezyklen" UWORD FORMULA_0010 0 0.0 0.0 65535.0 READ_WRITE ECU_ADDRESS 0x3F9694 /end MEASUREMENT
/begin MEASUREMENT ed_rbm_index_36_ign.denominator_nv "Fahrzyklen" UWORD FORMULA_0010 0 0.0 0.0 65535.0 READ_WRITE ECU_ADDRESS 0x3F969A /end MEASUREMENT
/begin MEASUREMENT ed_rbm_index_36_ign.numerator_nv "Diagnosezyklen" UWORD FORMULA_0010 0 0.0 0.0 65535.0 READ_WRITE ECU_ADDRESS 0x3F9698 /end MEASUREMENT
/begin MEASUREMENT ed_rbm_index_71_ign.denominator_nv "Fahrzyklen" UWORD FORMULA_0010 0 0.0 0.0 65535.0 READ_WRITE ECU_ADDRESS 0x3F9726 /end MEASUREMENT
/begin MEASUREMENT ed_rbm_index_71_ign.numerator_nv "Diagnosezyklen" UWORD FORMULA_0010 0 0.0 0.0 65535.0 READ_WRITE ECU_ADDRESS 0x3F9724 /end MEASUREMENT
/begin MEASUREMENT ed_rbm_index_72_ign.denominator_nv "Fahrzyklen" UWORD FORMULA_0010 0 0.0 0.0 65535.0 READ_WRITE ECU_ADDRESS 0x3F972A /end MEASUREMENT
/begin MEASUREMENT ed_rbm_index_72_ign.numerator_nv "Diagnosezyklen" UWORD FORMULA_0010 0 0.0 0.0 65535.0 READ_WRITE ECU_ADDRESS 0x3F9728 /end MEASUREMENT
/begin MEASUREMENT ed_rbm_index_84_ign.denominator_nv "Fahrzyklen" UWORD FORMULA_0010 0 0.0 0.0 65535.0 READ_WRITE ECU_ADDRESS 0x3F975A /end MEASUREMENT
/begin MEASUREMENT ed_rbm_index_84_ign.numerator_nv "Diagnosezyklen" UWORD FORMULA_0010 0 0.0 0.0 65535.0 READ_WRITE ECU_ADDRESS 0x3F9758 /end MEASUREMENT
/begin MEASUREMENT ed_rbm_index_85_ign.denominator_nv "Fahrzyklen" UWORD FORMULA_0010 0 0.0 0.0 65535.0 READ_WRITE ECU_ADDRESS 0x3F975E /end MEASUREMENT
/begin MEASUREMENT ed_rbm_index_85_ign.numerator_nv "Diagnosezyklen" UWORD FORMULA_0010 0 0.0 0.0 65535.0 READ_WRITE ECU_ADDRESS 0x3F975C /end MEASUREMENT
/begin MEASUREMENT ed_rbm_llr_diag.denominator_nv "Fahrzyklen" UWORD FORMULA_0010 0 0.0 0.0 65535.0 READ_WRITE ECU_ADDRESS 0x3F978A /end MEASUREMENT
/begin MEASUREMENT ed_rbm_llr_diag.numerator_nv "Diagnosezyklen" UWORD FORMULA_0010 0 0.0 0.0 65535.0 READ_WRITE ECU_ADDRESS 0x3F9788 /end MEASUREMENT
/begin MEASUREMENT ed_rbm_llr_diag_css.denominator_nv "Fahrzyklen" UWORD FORMULA_0010 0 0.0 0.0 65535.0 READ_WRITE ECU_ADDRESS 0x3F97BE /end MEASUREMENT
/begin MEASUREMENT ed_rbm_llr_diag_css.numerator_nv "Diagnosezyklen" UWORD FORMULA_0010 0 0.0 0.0 65535.0 READ_WRITE ECU_ADDRESS 0x3F97BC /end MEASUREMENT
/begin MEASUREMENT ed_rbm_lls_init.denominator_nv "Fahrzyklen" UWORD FORMULA_0010 0 0.0 0.0 65535.0 READ_WRITE ECU_ADDRESS 0x3F96D2 /end MEASUREMENT
/begin MEASUREMENT ed_rbm_lls_init.numerator_nv "Diagnosezyklen" UWORD FORMULA_0010 0 0.0 0.0 65535.0 READ_WRITE ECU_ADDRESS 0x3F96D0 /end MEASUREMENT
/begin MEASUREMENT ed_rbm_lls1_can.denominator_nv "Fahrzyklen" UWORD FORMULA_0010 0 0.0 0.0 65535.0 READ_WRITE ECU_ADDRESS 0x3F964E /end MEASUREMENT
/begin MEASUREMENT ed_rbm_lls1_can.numerator_nv "Diagnosezyklen" UWORD FORMULA_0010 0 0.0 0.0 65535.0 READ_WRITE ECU_ADDRESS 0x3F964C /end MEASUREMENT
/begin MEASUREMENT ed_rbm_lls1_cmd.denominator_nv "Fahrzyklen" UWORD FORMULA_0010 0 0.0 0.0 65535.0 READ_WRITE ECU_ADDRESS 0x3F96E2 /end MEASUREMENT
/begin MEASUREMENT ed_rbm_lls1_cmd.numerator_nv "Diagnosezyklen" UWORD FORMULA_0010 0 0.0 0.0 65535.0 READ_WRITE ECU_ADDRESS 0x3F96E0 /end MEASUREMENT
/begin MEASUREMENT ed_rbm_lls1_regler.denominator_nv "Fahrzyklen" UWORD FORMULA_0010 0 0.0 0.0 65535.0 READ_WRITE ECU_ADDRESS 0x3F96B6 /end MEASUREMENT
/begin MEASUREMENT ed_rbm_lls1_regler.numerator_nv "Diagnosezyklen" UWORD FORMULA_0010 0 0.0 0.0 65535.0 READ_WRITE ECU_ADDRESS 0x3F96B4 /end MEASUREMENT
/begin MEASUREMENT ed_rbm_lls1_sk.denominator_nv "Fahrzyklen" UWORD FORMULA_0010 0 0.0 0.0 65535.0 READ_WRITE ECU_ADDRESS 0x3F965E /end MEASUREMENT
/begin MEASUREMENT ed_rbm_lls1_sk.numerator_nv "Diagnosezyklen" UWORD FORMULA_0010 0 0.0 0.0 65535.0 READ_WRITE ECU_ADDRESS 0x3F965C /end MEASUREMENT
/begin MEASUREMENT ed_rbm_lls2_can.denominator_nv "Fahrzyklen" UWORD FORMULA_0010 0 0.0 0.0 65535.0 READ_WRITE ECU_ADDRESS 0x3F9652 /end MEASUREMENT
/begin MEASUREMENT ed_rbm_lls2_can.numerator_nv "Diagnosezyklen" UWORD FORMULA_0010 0 0.0 0.0 65535.0 READ_WRITE ECU_ADDRESS 0x3F9650 /end MEASUREMENT
/begin MEASUREMENT ed_rbm_lls2_cmd.denominator_nv "Fahrzyklen" UWORD FORMULA_0010 0 0.0 0.0 65535.0 READ_WRITE ECU_ADDRESS 0x3F96E6 /end MEASUREMENT
/begin MEASUREMENT ed_rbm_lls2_cmd.numerator_nv "Diagnosezyklen" UWORD FORMULA_0010 0 0.0 0.0 65535.0 READ_WRITE ECU_ADDRESS 0x3F96E4 /end MEASUREMENT
/begin MEASUREMENT ed_rbm_lls2_regler.denominator_nv "Fahrzyklen" UWORD FORMULA_0010 0 0.0 0.0 65535.0 READ_WRITE ECU_ADDRESS 0x3F96BA /end MEASUREMENT
/begin MEASUREMENT ed_rbm_lls2_regler.numerator_nv "Diagnosezyklen" UWORD FORMULA_0010 0 0.0 0.0 65535.0 READ_WRITE ECU_ADDRESS 0x3F96B8 /end MEASUREMENT
/begin MEASUREMENT ed_rbm_lls2_sk.denominator_nv "Fahrzyklen" UWORD FORMULA_0010 0 0.0 0.0 65535.0 READ_WRITE ECU_ADDRESS 0x3F9662 /end MEASUREMENT
/begin MEASUREMENT ed_rbm_lls2_sk.numerator_nv "Diagnosezyklen" UWORD FORMULA_0010 0 0.0 0.0 65535.0 READ_WRITE ECU_ADDRESS 0x3F9660 /end MEASUREMENT
/begin MEASUREMENT ed_rbm_m_spule_z1.denominator_nv "Fahrzyklen" UWORD FORMULA_0010 0 0.0 0.0 65535.0 READ_WRITE ECU_ADDRESS 0x3F97C6 /end MEASUREMENT
/begin MEASUREMENT ed_rbm_m_spule_z1.numerator_nv "Diagnosezyklen" UWORD FORMULA_0010 0 0.0 0.0 65535.0 READ_WRITE ECU_ADDRESS 0x3F97C4 /end MEASUREMENT
/begin MEASUREMENT ed_rbm_m_spule_z10.denominator_nv "Fahrzyklen" UWORD FORMULA_0010 0 0.0 0.0 65535.0 READ_WRITE ECU_ADDRESS 0x3F97EA /end MEASUREMENT
/begin MEASUREMENT ed_rbm_m_spule_z10.numerator_nv "Diagnosezyklen" UWORD FORMULA_0010 0 0.0 0.0 65535.0 READ_WRITE ECU_ADDRESS 0x3F97E8 /end MEASUREMENT
/begin MEASUREMENT ed_rbm_m_spule_z2.denominator_nv "Fahrzyklen" UWORD FORMULA_0010 0 0.0 0.0 65535.0 READ_WRITE ECU_ADDRESS 0x3F97CA /end MEASUREMENT
/begin MEASUREMENT ed_rbm_m_spule_z2.numerator_nv "Diagnosezyklen" UWORD FORMULA_0010 0 0.0 0.0 65535.0 READ_WRITE ECU_ADDRESS 0x3F97C8 /end MEASUREMENT
/begin MEASUREMENT ed_rbm_m_spule_z3.denominator_nv "Fahrzyklen" UWORD FORMULA_0010 0 0.0 0.0 65535.0 READ_WRITE ECU_ADDRESS 0x3F97CE /end MEASUREMENT
/begin MEASUREMENT ed_rbm_m_spule_z3.numerator_nv "Diagnosezyklen" UWORD FORMULA_0010 0 0.0 0.0 65535.0 READ_WRITE ECU_ADDRESS 0x3F97CC /end MEASUREMENT
/begin MEASUREMENT ed_rbm_m_spule_z4.denominator_nv "Fahrzyklen" UWORD FORMULA_0010 0 0.0 0.0 65535.0 READ_WRITE ECU_ADDRESS 0x3F97D2 /end MEASUREMENT
/begin MEASUREMENT ed_rbm_m_spule_z4.numerator_nv "Diagnosezyklen" UWORD FORMULA_0010 0 0.0 0.0 65535.0 READ_WRITE ECU_ADDRESS 0x3F97D0 /end MEASUREMENT
/begin MEASUREMENT ed_rbm_m_spule_z5.denominator_nv "Fahrzyklen" UWORD FORMULA_0010 0 0.0 0.0 65535.0 READ_WRITE ECU_ADDRESS 0x3F97D6 /end MEASUREMENT
/begin MEASUREMENT ed_rbm_m_spule_z5.numerator_nv "Diagnosezyklen" UWORD FORMULA_0010 0 0.0 0.0 65535.0 READ_WRITE ECU_ADDRESS 0x3F97D4 /end MEASUREMENT
/begin MEASUREMENT ed_rbm_m_spule_z6.denominator_nv "Fahrzyklen" UWORD FORMULA_0010 0 0.0 0.0 65535.0 READ_WRITE ECU_ADDRESS 0x3F97DA /end MEASUREMENT
/begin MEASUREMENT ed_rbm_m_spule_z6.numerator_nv "Diagnosezyklen" UWORD FORMULA_0010 0 0.0 0.0 65535.0 READ_WRITE ECU_ADDRESS 0x3F97D8 /end MEASUREMENT
/begin MEASUREMENT ed_rbm_m_spule_z7.denominator_nv "Fahrzyklen" UWORD FORMULA_0010 0 0.0 0.0 65535.0 READ_WRITE ECU_ADDRESS 0x3F97DE /end MEASUREMENT
/begin MEASUREMENT ed_rbm_m_spule_z7.numerator_nv "Diagnosezyklen" UWORD FORMULA_0010 0 0.0 0.0 65535.0 READ_WRITE ECU_ADDRESS 0x3F97DC /end MEASUREMENT
/begin MEASUREMENT ed_rbm_m_spule_z8.denominator_nv "Fahrzyklen" UWORD FORMULA_0010 0 0.0 0.0 65535.0 READ_WRITE ECU_ADDRESS 0x3F97E2 /end MEASUREMENT
/begin MEASUREMENT ed_rbm_m_spule_z8.numerator_nv "Diagnosezyklen" UWORD FORMULA_0010 0 0.0 0.0 65535.0 READ_WRITE ECU_ADDRESS 0x3F97E0 /end MEASUREMENT
/begin MEASUREMENT ed_rbm_m_spule_z9.denominator_nv "Fahrzyklen" UWORD FORMULA_0010 0 0.0 0.0 65535.0 READ_WRITE ECU_ADDRESS 0x3F97E6 /end MEASUREMENT
/begin MEASUREMENT ed_rbm_m_spule_z9.numerator_nv "Diagnosezyklen" UWORD FORMULA_0010 0 0.0 0.0 65535.0 READ_WRITE ECU_ADDRESS 0x3F97E4 /end MEASUREMENT
/begin MEASUREMENT ed_rbm_md_sk_err.denominator_nv "Fahrzyklen" UWORD FORMULA_0010 0 0.0 0.0 65535.0 READ_WRITE ECU_ADDRESS 0x3F96CE /end MEASUREMENT
/begin MEASUREMENT ed_rbm_md_sk_err.numerator_nv "Diagnosezyklen" UWORD FORMULA_0010 0 0.0 0.0 65535.0 READ_WRITE ECU_ADDRESS 0x3F96CC /end MEASUREMENT
/begin MEASUREMENT ed_rbm_n_getr_ein_hs.denominator_nv "Fahrzyklen" UWORD FORMULA_0010 0 0.0 0.0 65535.0 READ_WRITE ECU_ADDRESS 0x3F97AE /end MEASUREMENT
/begin MEASUREMENT ed_rbm_n_getr_ein_hs.numerator_nv "Diagnosezyklen" UWORD FORMULA_0010 0 0.0 0.0 65535.0 READ_WRITE ECU_ADDRESS 0x3F97AC /end MEASUREMENT
/begin MEASUREMENT ed_rbm_pctrl_ign.denominator_nv "Fahrzyklen" UWORD FORMULA_0010 0 0.0 0.0 65535.0 READ_WRITE ECU_ADDRESS 0x3F964A /end MEASUREMENT
/begin MEASUREMENT ed_rbm_pctrl_ign.numerator_nv "Diagnosezyklen" UWORD FORMULA_0010 0 0.0 0.0 65535.0 READ_WRITE ECU_ADDRESS 0x3F9648 /end MEASUREMENT
/begin MEASUREMENT ed_rbm_pwg_bls.denominator_nv "Fahrzyklen" UWORD FORMULA_0010 0 0.0 0.0 65535.0 READ_WRITE ECU_ADDRESS 0x3F97A2 /end MEASUREMENT
/begin MEASUREMENT ed_rbm_pwg_bls.numerator_nv "Diagnosezyklen" UWORD FORMULA_0010 0 0.0 0.0 65535.0 READ_WRITE ECU_ADDRESS 0x3F97A0 /end MEASUREMENT
/begin MEASUREMENT ed_rbm_pwg_vgl.denominator_nv "Fahrzyklen" UWORD FORMULA_0010 0 0.0 0.0 65535.0 READ_WRITE ECU_ADDRESS 0x3F9646 /end MEASUREMENT
/begin MEASUREMENT ed_rbm_pwg_vgl.numerator_nv "Diagnosezyklen" UWORD FORMULA_0010 0 0.0 0.0 65535.0 READ_WRITE ECU_ADDRESS 0x3F9644 /end MEASUREMENT
/begin MEASUREMENT ed_rbm_pwg1.denominator_nv "Fahrzyklen" UWORD FORMULA_0010 0 0.0 0.0 65535.0 READ_WRITE ECU_ADDRESS 0x3F963E /end MEASUREMENT
/begin MEASUREMENT ed_rbm_pwg1.numerator_nv "Diagnosezyklen" UWORD FORMULA_0010 0 0.0 0.0 65535.0 READ_WRITE ECU_ADDRESS 0x3F963C /end MEASUREMENT
/begin MEASUREMENT ed_rbm_pwg2.denominator_nv "Fahrzyklen" UWORD FORMULA_0010 0 0.0 0.0 65535.0 READ_WRITE ECU_ADDRESS 0x3F9642 /end MEASUREMENT
/begin MEASUREMENT ed_rbm_pwg2.numerator_nv "Diagnosezyklen" UWORD FORMULA_0010 0 0.0 0.0 65535.0 READ_WRITE ECU_ADDRESS 0x3F9640 /end MEASUREMENT
/begin MEASUREMENT ed_rbm_sc_busoff.denominator_nv "Fahrzyklen" UWORD FORMULA_0010 0 0.0 0.0 65535.0 READ_WRITE ECU_ADDRESS 0x3F96F6 /end MEASUREMENT
/begin MEASUREMENT ed_rbm_sc_busoff.numerator_nv "Diagnosezyklen" UWORD FORMULA_0010 0 0.0 0.0 65535.0 READ_WRITE ECU_ADDRESS 0x3F96F4 /end MEASUREMENT
/begin MEASUREMENT ed_rbm_sc_pks.denominator_nv "Fahrzyklen" UWORD FORMULA_0010 0 0.0 0.0 65535.0 READ_WRITE ECU_ADDRESS 0x3F976E /end MEASUREMENT
/begin MEASUREMENT ed_rbm_sc_pks.numerator_nv "Diagnosezyklen" UWORD FORMULA_0010 0 0.0 0.0 65535.0 READ_WRITE ECU_ADDRESS 0x3F976C /end MEASUREMENT
/begin MEASUREMENT ed_rbm_sc_smg1.denominator_nv "Fahrzyklen" UWORD FORMULA_0010 0 0.0 0.0 65535.0 READ_WRITE ECU_ADDRESS 0x3F96EA /end MEASUREMENT
/begin MEASUREMENT ed_rbm_sc_smg1.numerator_nv "Diagnosezyklen" UWORD FORMULA_0010 0 0.0 0.0 65535.0 READ_WRITE ECU_ADDRESS 0x3F96E8 /end MEASUREMENT
/begin MEASUREMENT ed_rbm_sc_smg2.denominator_nv "Fahrzyklen" UWORD FORMULA_0010 0 0.0 0.0 65535.0 READ_WRITE ECU_ADDRESS 0x3F96EE /end MEASUREMENT
/begin MEASUREMENT ed_rbm_sc_smg2.numerator_nv "Diagnosezyklen" UWORD FORMULA_0010 0 0.0 0.0 65535.0 READ_WRITE ECU_ADDRESS 0x3F96EC /end MEASUREMENT
/begin MEASUREMENT ed_rbm_sc_smg3.denominator_nv "Fahrzyklen" UWORD FORMULA_0010 0 0.0 0.0 65535.0 READ_WRITE ECU_ADDRESS 0x3F96F2 /end MEASUREMENT
/begin MEASUREMENT ed_rbm_sc_smg3.numerator_nv "Diagnosezyklen" UWORD FORMULA_0010 0 0.0 0.0 65535.0 READ_WRITE ECU_ADDRESS 0x3F96F0 /end MEASUREMENT
/begin MEASUREMENT ed_rbm_servo_i.denominator_nv "Fahrzyklen" UWORD FORMULA_0010 0 0.0 0.0 65535.0 READ_WRITE ECU_ADDRESS 0x3F97B2 /end MEASUREMENT
/begin MEASUREMENT ed_rbm_servo_i.numerator_nv "Diagnosezyklen" UWORD FORMULA_0010 0 0.0 0.0 65535.0 READ_WRITE ECU_ADDRESS 0x3F97B0 /end MEASUREMENT
/begin MEASUREMENT ed_rbm_servo_v.denominator_nv "Fahrzyklen" UWORD FORMULA_0010 0 0.0 0.0 65535.0 READ_WRITE ECU_ADDRESS 0x3F97B6 /end MEASUREMENT
/begin MEASUREMENT ed_rbm_servo_v.numerator_nv "Diagnosezyklen" UWORD FORMULA_0010 0 0.0 0.0 65535.0 READ_WRITE ECU_ADDRESS 0x3F97B4 /end MEASUREMENT
/begin MEASUREMENT ed_rbm_sg_ign.denominator_nv "Fahrzyklen" UWORD FORMULA_0010 0 0.0 0.0 65535.0 READ_WRITE ECU_ADDRESS 0x3F977A /end MEASUREMENT
/begin MEASUREMENT ed_rbm_sg_ign.numerator_nv "Diagnosezyklen" UWORD FORMULA_0010 0 0.0 0.0 65535.0 READ_WRITE ECU_ADDRESS 0x3F9778 /end MEASUREMENT
/begin MEASUREMENT ed_rbm_sk_manager_ign.denominator_nv "Fahrzyklen" UWORD FORMULA_0010 0 0.0 0.0 65535.0 READ_WRITE ECU_ADDRESS 0x3F9786 /end MEASUREMENT
/begin MEASUREMENT ed_rbm_sk_manager_ign.numerator_nv "Diagnosezyklen" UWORD FORMULA_0010 0 0.0 0.0 65535.0 READ_WRITE ECU_ADDRESS 0x3F9784 /end MEASUREMENT
/begin MEASUREMENT ed_rbm_sk_tr_ign.denominator_nv "Fahrzyklen" UWORD FORMULA_0010 0 0.0 0.0 65535.0 READ_WRITE ECU_ADDRESS 0x3F960A /end MEASUREMENT
/begin MEASUREMENT ed_rbm_sk_tr_ign.numerator_nv "Diagnosezyklen" UWORD FORMULA_0010 0 0.0 0.0 65535.0 READ_WRITE ECU_ADDRESS 0x3F9608 /end MEASUREMENT
/begin MEASUREMENT ed_rbm_smg_schaltab.denominator_nv "Fahrzyklen" UWORD FORMULA_0010 0 0.0 0.0 65535.0 READ_WRITE ECU_ADDRESS 0x3F9666 /end MEASUREMENT
/begin MEASUREMENT ed_rbm_smg_schaltab.numerator_nv "Diagnosezyklen" UWORD FORMULA_0010 0 0.0 0.0 65535.0 READ_WRITE ECU_ADDRESS 0x3F9664 /end MEASUREMENT
/begin MEASUREMENT ed_rbm_smg_sk.denominator_nv "Fahrzyklen" UWORD FORMULA_0010 0 0.0 0.0 65535.0 READ_WRITE ECU_ADDRESS 0x3F966A /end MEASUREMENT
/begin MEASUREMENT ed_rbm_smg_sk.numerator_nv "Diagnosezyklen" UWORD FORMULA_0010 0 0.0 0.0 65535.0 READ_WRITE ECU_ADDRESS 0x3F9668 /end MEASUREMENT
/begin MEASUREMENT ed_rbm_smg_sk_n.denominator_nv "Fahrzyklen" UWORD FORMULA_0010 0 0.0 0.0 65535.0 READ_WRITE ECU_ADDRESS 0x3F966E /end MEASUREMENT
/begin MEASUREMENT ed_rbm_smg_sk_n.numerator_nv "Diagnosezyklen" UWORD FORMULA_0010 0 0.0 0.0 65535.0 READ_WRITE ECU_ADDRESS 0x3F966C /end MEASUREMENT
/begin MEASUREMENT ed_rbm_start_rl.denominator_nv "Fahrzyklen" UWORD FORMULA_0010 0 0.0 0.0 65535.0 READ_WRITE ECU_ADDRESS 0x3F97A6 /end MEASUREMENT
/begin MEASUREMENT ed_rbm_start_rl.numerator_nv "Diagnosezyklen" UWORD FORMULA_0010 0 0.0 0.0 65535.0 READ_WRITE ECU_ADDRESS 0x3F97A4 /end MEASUREMENT
/begin MEASUREMENT ed_rbm_tabg1.denominator_nv "Fahrzyklen" UWORD FORMULA_0010 0 0.0 0.0 65535.0 READ_WRITE ECU_ADDRESS 0x3F969E /end MEASUREMENT
/begin MEASUREMENT ed_rbm_tabg1.numerator_nv "Diagnosezyklen" UWORD FORMULA_0010 0 0.0 0.0 65535.0 READ_WRITE ECU_ADDRESS 0x3F969C /end MEASUREMENT
/begin MEASUREMENT ed_rbm_tabg2.denominator_nv "Fahrzyklen" UWORD FORMULA_0010 0 0.0 0.0 65535.0 READ_WRITE ECU_ADDRESS 0x3F96A2 /end MEASUREMENT
/begin MEASUREMENT ed_rbm_tabg2.numerator_nv "Diagnosezyklen" UWORD FORMULA_0010 0 0.0 0.0 65535.0 READ_WRITE ECU_ADDRESS 0x3F96A0 /end MEASUREMENT
/begin MEASUREMENT ed_rbm_tan_obd_b1.denominator_nv "Fahrzyklen" UWORD FORMULA_0010 0 0.0 0.0 65535.0 READ_WRITE ECU_ADDRESS 0x3F9766 /end MEASUREMENT
/begin MEASUREMENT ed_rbm_tan_obd_b1.numerator_nv "Diagnosezyklen" UWORD FORMULA_0010 0 0.0 0.0 65535.0 READ_WRITE ECU_ADDRESS 0x3F9764 /end MEASUREMENT
/begin MEASUREMENT ed_rbm_tan_obd_b2.denominator_nv "Fahrzyklen" UWORD FORMULA_0010 0 0.0 0.0 65535.0 READ_WRITE ECU_ADDRESS 0x3F9792 /end MEASUREMENT
/begin MEASUREMENT ed_rbm_tan_obd_b2.numerator_nv "Diagnosezyklen" UWORD FORMULA_0010 0 0.0 0.0 65535.0 READ_WRITE ECU_ADDRESS 0x3F9790 /end MEASUREMENT
/begin MEASUREMENT ed_rbm_tan1.denominator_nv "Fahrzyklen" UWORD FORMULA_0010 0 0.0 0.0 65535.0 READ_WRITE ECU_ADDRESS 0x3F9616 /end MEASUREMENT
/begin MEASUREMENT ed_rbm_tan1.numerator_nv "Diagnosezyklen" UWORD FORMULA_0010 0 0.0 0.0 65535.0 READ_WRITE ECU_ADDRESS 0x3F9614 /end MEASUREMENT
/begin MEASUREMENT ed_rbm_tan2.denominator_nv "Fahrzyklen" UWORD FORMULA_0010 0 0.0 0.0 65535.0 READ_WRITE ECU_ADDRESS 0x3F961A /end MEASUREMENT
/begin MEASUREMENT ed_rbm_tan2.numerator_nv "Diagnosezyklen" UWORD FORMULA_0010 0 0.0 0.0 65535.0 READ_WRITE ECU_ADDRESS 0x3F9618 /end MEASUREMENT
/begin MEASUREMENT ed_rbm_tdme.denominator_nv "Fahrzyklen" UWORD FORMULA_0010 0 0.0 0.0 65535.0 READ_WRITE ECU_ADDRESS 0x3F962A /end MEASUREMENT
/begin MEASUREMENT ed_rbm_tdme.numerator_nv "Diagnosezyklen" UWORD FORMULA_0010 0 0.0 0.0 65535.0 READ_WRITE ECU_ADDRESS 0x3F9628 /end MEASUREMENT
/begin MEASUREMENT ed_rbm_thermostat.denominator_nv "Fahrzyklen" UWORD FORMULA_0010 0 0.0 0.0 65535.0 READ_WRITE ECU_ADDRESS 0x3F978E /end MEASUREMENT
/begin MEASUREMENT ed_rbm_thermostat.numerator_nv "Diagnosezyklen" UWORD FORMULA_0010 0 0.0 0.0 65535.0 READ_WRITE ECU_ADDRESS 0x3F978C /end MEASUREMENT
/begin MEASUREMENT ed_rbm_time "Motor laeuft fuer Rate Based" UWORD FORMULA_0071 0 0.0 0.0 6553.5 READ_WRITE ECU_ADDRESS 0x3FB64A /end MEASUREMENT
/begin MEASUREMENT ed_rbm_time_ll "Zeit im Leerlauf" UWORD FORMULA_0071 0 0.0 0.0 6553.5 READ_WRITE ECU_ADDRESS 0x3FB64C /end MEASUREMENT
/begin MEASUREMENT ed_rbm_time_rel_obd.denominator_nv "Fahrzyklen" UWORD FORMULA_0010 0 0.0 0.0 65535.0 READ_WRITE ECU_ADDRESS 0x3F961E /end MEASUREMENT
/begin MEASUREMENT ed_rbm_time_rel_obd.numerator_nv "Diagnosezyklen" UWORD FORMULA_0010 0 0.0 0.0 65535.0 READ_WRITE ECU_ADDRESS 0x3F961C /end MEASUREMENT
/begin MEASUREMENT ed_rbm_time_v "Zeit mit Mindestgeschwindigkeit" UWORD FORMULA_0071 0 0.0 0.0 6553.5 READ_WRITE ECU_ADDRESS 0x3FB64E /end MEASUREMENT
/begin MEASUREMENT ed_rbm_tka.denominator_nv "Fahrzyklen" UWORD FORMULA_0010 0 0.0 0.0 65535.0 READ_WRITE ECU_ADDRESS 0x3F9626 /end MEASUREMENT
/begin MEASUREMENT ed_rbm_tka.numerator_nv "Diagnosezyklen" UWORD FORMULA_0010 0 0.0 0.0 65535.0 READ_WRITE ECU_ADDRESS 0x3F9624 /end MEASUREMENT
/begin MEASUREMENT ed_rbm_tka_obd.denominator_nv "Fahrzyklen" UWORD FORMULA_0010 0 0.0 0.0 65535.0 READ_WRITE ECU_ADDRESS 0x3F963A /end MEASUREMENT
/begin MEASUREMENT ed_rbm_tka_obd.numerator_nv "Diagnosezyklen" UWORD FORMULA_0010 0 0.0 0.0 65535.0 READ_WRITE ECU_ADDRESS 0x3F9638 /end MEASUREMENT
/begin MEASUREMENT ed_rbm_tmot.denominator_nv "Fahrzyklen" UWORD FORMULA_0010 0 0.0 0.0 65535.0 READ_WRITE ECU_ADDRESS 0x3F960E /end MEASUREMENT
/begin MEASUREMENT ed_rbm_tmot.numerator_nv "Diagnosezyklen" UWORD FORMULA_0010 0 0.0 0.0 65535.0 READ_WRITE ECU_ADDRESS 0x3F960C /end MEASUREMENT
/begin MEASUREMENT ed_rbm_tmot_obd.denominator_nv "Fahrzyklen" UWORD FORMULA_0010 0 0.0 0.0 65535.0 READ_WRITE ECU_ADDRESS 0x3F9612 /end MEASUREMENT
/begin MEASUREMENT ed_rbm_tmot_obd.numerator_nv "Diagnosezyklen" UWORD FORMULA_0010 0 0.0 0.0 65535.0 READ_WRITE ECU_ADDRESS 0x3F9610 /end MEASUREMENT
/begin MEASUREMENT ed_rbm_tmot_obd_high.denominator_nv "Fahrzyklen" UWORD FORMULA_0010 0 0.0 0.0 65535.0 READ_WRITE ECU_ADDRESS 0x3F97C2 /end MEASUREMENT
/begin MEASUREMENT ed_rbm_tmot_obd_high.numerator_nv "Diagnosezyklen" UWORD FORMULA_0010 0 0.0 0.0 65535.0 READ_WRITE ECU_ADDRESS 0x3F97C0 /end MEASUREMENT
/begin MEASUREMENT ed_rbm_tumg.denominator_nv "Fahrzyklen" UWORD FORMULA_0010 0 0.0 0.0 65535.0 READ_WRITE ECU_ADDRESS 0x3F97BA /end MEASUREMENT
/begin MEASUREMENT ed_rbm_tumg.numerator_nv "Diagnosezyklen" UWORD FORMULA_0010 0 0.0 0.0 65535.0 READ_WRITE ECU_ADDRESS 0x3F97B8 /end MEASUREMENT
/begin MEASUREMENT ed_rbm_tumg_obd.denominator_nv "Fahrzyklen" UWORD FORMULA_0010 0 0.0 0.0 65535.0 READ_WRITE ECU_ADDRESS 0x3F9672 /end MEASUREMENT
/begin MEASUREMENT ed_rbm_tumg_obd.numerator_nv "Diagnosezyklen" UWORD FORMULA_0010 0 0.0 0.0 65535.0 READ_WRITE ECU_ADDRESS 0x3F9670 /end MEASUREMENT
/begin MEASUREMENT ed_rbm_ub.denominator_nv "Fahrzyklen" UWORD FORMULA_0010 0 0.0 0.0 65535.0 READ_WRITE ECU_ADDRESS 0x3F9622 /end MEASUREMENT
/begin MEASUREMENT ed_rbm_ub.numerator_nv "Diagnosezyklen" UWORD FORMULA_0010 0 0.0 0.0 65535.0 READ_WRITE ECU_ADDRESS 0x3F9620 /end MEASUREMENT
/begin MEASUREMENT ed_rbm_uext_111219514.denominator_nv "Fahrzyklen" UWORD FORMULA_0010 0 0.0 0.0 65535.0 READ_WRITE ECU_ADDRESS 0x3F962E /end MEASUREMENT
/begin MEASUREMENT ed_rbm_uext_111219514.numerator_nv "Diagnosezyklen" UWORD FORMULA_0010 0 0.0 0.0 65535.0 READ_WRITE ECU_ADDRESS 0x3F962C /end MEASUREMENT
/begin MEASUREMENT ed_rbm_uext_124_512.denominator_nv "Fahrzyklen" UWORD FORMULA_0010 0 0.0 0.0 65535.0 READ_WRITE ECU_ADDRESS 0x3F9632 /end MEASUREMENT
/begin MEASUREMENT ed_rbm_uext_124_512.numerator_nv "Diagnosezyklen" UWORD FORMULA_0010 0 0.0 0.0 65535.0 READ_WRITE ECU_ADDRESS 0x3F9630 /end MEASUREMENT
/begin MEASUREMENT ed_rbm_v_direkt.denominator_nv "Fahrzyklen" UWORD FORMULA_0010 0 0.0 0.0 65535.0 READ_WRITE ECU_ADDRESS 0x3F9676 /end MEASUREMENT
/begin MEASUREMENT ed_rbm_v_direkt.numerator_nv "Diagnosezyklen" UWORD FORMULA_0010 0 0.0 0.0 65535.0 READ_WRITE ECU_ADDRESS 0x3F9674 /end MEASUREMENT
/begin MEASUREMENT ed_rbm_zoelp1.denominator_nv "Fahrzyklen" UWORD FORMULA_0010 0 0.0 0.0 65535.0 READ_WRITE ECU_ADDRESS 0x3F9772 /end MEASUREMENT
/begin MEASUREMENT ed_rbm_zoelp1.numerator_nv "Diagnosezyklen" UWORD FORMULA_0010 0 0.0 0.0 65535.0 READ_WRITE ECU_ADDRESS 0x3F9770 /end MEASUREMENT
/begin MEASUREMENT ed_rbm_zoelp2.denominator_nv "Fahrzyklen" UWORD FORMULA_0010 0 0.0 0.0 65535.0 READ_WRITE ECU_ADDRESS 0x3F9776 /end MEASUREMENT
/begin MEASUREMENT ed_rbm_zoelp2.numerator_nv "Diagnosezyklen" UWORD FORMULA_0010 0 0.0 0.0 65535.0 READ_WRITE ECU_ADDRESS 0x3F9774 /end MEASUREMENT
/begin MEASUREMENT ed_scdn_st_nv "Welche Fehler muessen mit similar Conditions behandelt werden" ULONG FORMULA_0000 0 0.0 0.0 4294967295.0 READ_WRITE ECU_ADDRESS 0x3F9304 /end MEASUREMENT
/begin MEASUREMENT ed_st_fehler_ign "ED-Gesamtstatus IGN-Fehler" ULONG FORMULA_0000 0 0.0 0.0 4294967295.0 READ_WRITE ARRAY_SIZE 4 ECU_ADDRESS 0x3F8218 MATRIX_DIM 4 1 1 /end MEASUREMENT
/begin MEASUREMENT ed_st_fehler_inj "ED-Gesamtstatus INJ-Fehler" ULONG FORMULA_0000 0 0.0 0.0 4294967295.0 READ_WRITE ARRAY_SIZE 7 ECU_ADDRESS 0x3F84F8 MATRIX_DIM 7 1 1 /end MEASUREMENT
/begin MEASUREMENT ed_st_filter_ign "ED-Gesamtstatus IGN-Filter" ULONG FORMULA_0000 0 0.0 0.0 4294967295.0 READ_WRITE ARRAY_SIZE 4 ECU_ADDRESS 0x3F8228 MATRIX_DIM 4 1 1 /end MEASUREMENT
/begin MEASUREMENT ed_st_filter_inj "ED-Gesamtstatus INJ-Filter" ULONG FORMULA_0000 0 0.0 0.0 4294967295.0 READ_WRITE ARRAY_SIZE 7 ECU_ADDRESS 0x3F8514 MATRIX_DIM 7 1 1 /end MEASUREMENT
/begin MEASUREMENT ed_st_nv "Status-Eigendiagnose" UBYTE FORMULA_0037 0 0.0 0.0 255.0 READ_WRITE ECU_ADDRESS 0x3F92FC /end MEASUREMENT
/begin MEASUREMENT ed_st_nv_css_den "CSS-Denominator" UBYTE FORMULA_0050 0 0 0.0 255.0 READ_WRITE BIT_MASK 0x20 ECU_ADDRESS 0x3F92FC /end MEASUREMENT
/begin MEASUREMENT ed_st_nv_css_num "CSS-Numerator" UBYTE FORMULA_0051 0 0 0.0 255.0 READ_WRITE BIT_MASK 0x40 ECU_ADDRESS 0x3F92FC /end MEASUREMENT
/begin MEASUREMENT ed_st_nv_rbm_abbruch "Abbruch des RBM" UBYTE FORMULA_0049 0 0 0.0 255.0 READ_WRITE BIT_MASK 0x10 ECU_ADDRESS 0x3F92FC /end MEASUREMENT
/begin MEASUREMENT ed_st_nv_rbm_dcy "Rate-Based-DCY" UBYTE FORMULA_0046 0 0 0.0 255.0 READ_WRITE BIT_MASK 0x2 ECU_ADDRESS 0x3F92FC /end MEASUREMENT
/begin MEASUREMENT ed_st_nv_rbm_evap "RBM-EVAP-Bedingung" UBYTE FORMULA_0047 0 0 0.0 255.0 READ_WRITE BIT_MASK 0x4 ECU_ADDRESS 0x3F92FC /end MEASUREMENT
/begin MEASUREMENT ed_st_nv_rbm_slp "RBM-SLP-Bedingung" UBYTE FORMULA_0048 0 0 0.0 255.0 READ_WRITE BIT_MASK 0x8 ECU_ADDRESS 0x3F92FC /end MEASUREMENT
/begin MEASUREMENT ed_st_nv_wuc "Warmupcycleerkennung" UBYTE FORMULA_0045 0 0 0.0 255.0 READ_WRITE BIT_MASK 0x1 ECU_ADDRESS 0x3F92FC /end MEASUREMENT
/begin COMPU_METHOD FORMULA_0000 "FORMULA_0000" RAT_FUNC "%7.0" "-" COEFFS 0 1 0 0 0 1 /end COMPU_METHOD
/begin COMPU_METHOD FORMULA_0003 "FORMULA_0003" RAT_FUNC "%3.0" "-" COEFFS 0 1 0 0 0 1 /end COMPU_METHOD
/begin COMPU_METHOD FORMULA_0010 "FORMULA_0010" RAT_FUNC "%5.0" "-" COEFFS 0 1 0 0 0 1 /end COMPU_METHOD
/begin COMPU_METHOD FORMULA_0027 "FORMULA_0027" RAT_FUNC "%7.0" "km" COEFFS 0 1 0 0 0 1 /end COMPU_METHOD
/begin COMPU_METHOD FORMULA_0037 "FORMULA_0037" RAT_FUNC "%5.2" "-" COEFFS 0 1 0 0 0 1 /end COMPU_METHOD
/begin COMPU_METHOD FORMULA_0045 "FORMULA_0045" TAB_VERB "%5.2" "-" COMPU_TAB_REF FORMULA_0045_VTAB /end COMPU_METHOD
/begin COMPU_METHOD FORMULA_0046 "FORMULA_0046" TAB_VERB "%5.2" "-" COMPU_TAB_REF FORMULA_0046_VTAB /end COMPU_METHOD
/begin COMPU_METHOD FORMULA_0047 "FORMULA_0047" TAB_VERB "%5.2" "-" COMPU_TAB_REF FORMULA_0047_VTAB /end COMPU_METHOD
/begin COMPU_METHOD FORMULA_0048 "FORMULA_0048" TAB_VERB "%5.2" "-" COMPU_TAB_REF FORMULA_0048_VTAB /end COMPU_METHOD
/begin COMPU_METHOD FORMULA_0049 "FORMULA_0049" TAB_VERB "%5.2" "-" COMPU_TAB_REF FORMULA_0049_VTAB /end COMPU_METHOD
/begin COMPU_METHOD FORMULA_0050 "FORMULA_0050" TAB_VERB "%5.2" "-" COMPU_TAB_REF FORMULA_0050_VTAB /end COMPU_METHOD
/begin COMPU_METHOD FORMULA_0051 "FORMULA_0051" TAB_VERB "%5.2" "-" COMPU_TAB_REF FORMULA_0051_VTAB /end COMPU_METHOD
/begin COMPU_METHOD FORMULA_0053 "FORMULA_0053" TAB_VERB "%5.0" "-" COMPU_TAB_REF FORMULA_0053_VTAB /end COMPU_METHOD
/begin COMPU_METHOD FORMULA_0054 "FORMULA_0054" RAT_FUNC "%5.0" "km" COEFFS 0 0.125 0.0 0 0.0 1.0 /end COMPU_METHOD
/begin COMPU_METHOD FORMULA_0055 "FORMULA_0055" RAT_FUNC "%5.0" "-" COEFFS 0 4.0 0.0 0 0.0 1.0 /end COMPU_METHOD
/begin COMPU_METHOD FORMULA_0056 "FORMULA_0056" RAT_FUNC "%7.2" "g/s" COEFFS 0 100.0 0.0 0 0.0 1.0 /end COMPU_METHOD
/begin COMPU_METHOD FORMULA_0057 "FORMULA_0057" TAB_VERB "%3.0" "-" COMPU_TAB_REF FORMULA_0057_VTAB /end COMPU_METHOD
/begin COMPU_METHOD FORMULA_0058 "FORMULA_0058" RAT_FUNC "%7.4" "-" COEFFS 0 128.0 0.0 0 0.0 1.0 /end COMPU_METHOD
/begin COMPU_METHOD FORMULA_0059 "FORMULA_0059" RAT_FUNC "%7.4" "%" COEFFS 0 2.55 0.0 0 0.0 1.0 /end COMPU_METHOD
/begin COMPU_METHOD FORMULA_0060 "FORMULA_0060" RAT_FUNC "%3.0" "°C" COEFFS 0 1.0 40.0 0 0.0 1.0 /end COMPU_METHOD
/begin COMPU_METHOD FORMULA_0061 "FORMULA_0061" RAT_FUNC "%3.0" "kPa" COEFFS 0 0.3333333333333333 0.0 0 0.0 1.0 /end COMPU_METHOD
/begin COMPU_METHOD FORMULA_0062 "FORMULA_0062" RAT_FUNC "%3.0" "km/h" COEFFS 0 1 0 0 0 1 /end COMPU_METHOD
/begin COMPU_METHOD FORMULA_0063 "FORMULA_0063" RAT_FUNC "%4.1" "°KW" COEFFS 0 2.0 128.0 0 0.0 1.0 /end COMPU_METHOD
/begin COMPU_METHOD FORMULA_0064 "FORMULA_0064" TAB_VERB "%3.0" "-" COMPU_TAB_REF FORMULA_0064_VTAB /end COMPU_METHOD
/begin COMPU_METHOD FORMULA_0065 "FORMULA_0065" TAB_VERB "%5.2" "-" COMPU_TAB_REF FORMULA_0065_VTAB /end COMPU_METHOD
/begin COMPU_METHOD FORMULA_0066 "FORMULA_0066" TAB_VERB "%5.2" "-" COMPU_TAB_REF FORMULA_0066_VTAB /end COMPU_METHOD
/begin COMPU_METHOD FORMULA_0067 "FORMULA_0067" TAB_VERB "%5.2" "-" COMPU_TAB_REF FORMULA_0067_VTAB /end COMPU_METHOD
/begin COMPU_METHOD FORMULA_0068 "FORMULA_0068" TAB_VERB "%5.2" "-" COMPU_TAB_REF FORMULA_0068_VTAB /end COMPU_METHOD
/begin COMPU_METHOD FORMULA_0069 "FORMULA_0069" TAB_VERB "%5.2" "-" COMPU_TAB_REF FORMULA_0069_VTAB /end COMPU_METHOD
/begin COMPU_METHOD FORMULA_0070 "FORMULA_0070" TAB_VERB "%3.0" "-" COMPU_TAB_REF FORMULA_0070_VTAB /end COMPU_METHOD
/begin COMPU_METHOD FORMULA_0071 "FORMULA_0071" RAT_FUNC "%6.1" "s" COEFFS 0 10.0 0.0 0 0.0 1.0 /end COMPU_METHOD
/begin COMPU_VTAB FORMULA_0045_VTAB "FORMULA_0045_VTAB" TAB_VERB 1 0 "kein WUC" DEFAULT_VALUE "Warmcycle" /end COMPU_VTAB
/begin COMPU_VTAB FORMULA_0046_VTAB "FORMULA_0046_VTAB" TAB_VERB 1 0 "Kein Cycle" DEFAULT_VALUE "Rate-Based-DCY" /end COMPU_VTAB
/begin COMPU_VTAB FORMULA_0047_VTAB "FORMULA_0047_VTAB" TAB_VERB 1 0 "Kein RBM-EVAP" DEFAULT_VALUE "RBM-EVAP" /end COMPU_VTAB
/begin COMPU_VTAB FORMULA_0048_VTAB "FORMULA_0048_VTAB" TAB_VERB 1 0 "Kein RBM-SLP" DEFAULT_VALUE "RBM-SLP" /end COMPU_VTAB
/begin COMPU_VTAB FORMULA_0049_VTAB "FORMULA_0049_VTAB" TAB_VERB 1 0 "Kein Abbruch" DEFAULT_VALUE "Abbruch" /end COMPU_VTAB
/begin COMPU_VTAB FORMULA_0050_VTAB "FORMULA_0050_VTAB" TAB_VERB 1 0 "Kein CSS-DEN" DEFAULT_VALUE "CSS-DEN" /end COMPU_VTAB
/begin COMPU_VTAB FORMULA_0051_VTAB "FORMULA_0051_VTAB" TAB_VERB 1 0 "Kein CSS-NUM" DEFAULT_VALUE "CSS-NUM" /end COMPU_VTAB
/begin COMPU_VTAB FORMULA_0053_VTAB "FORMULA_0053_VTAB" TAB_VERB 352 10000 "SK_TESTFEHLER" 10001 "PUMG_FEHLER" 10002 "HFM1_FEHLER" 10003 "HFM2_FEHLER" 10004 "PSAU1_FEHLER" 10005 "PSAU2_FEHLER" 10006 "VAN_HALL_E1_FEHLER" 10007 "VAN_HALL_A1_FEHLER" 10008 "VAN_HALL_E2_FEHLER" 10009 "VAN_HALL_A2_FEHLER" 10010 "VAN_REGL_E1_FEHLER" 10011 "VAN_REGL_A1_FEHLER" 10012 "VAN_REGL_E2_FEHLER" 10013 "VAN_REGL_A2_FEHLER" 10014 "NW_SYNC_FEHLER" 10015 "INDEX_15_INJ" 10016 "PCTRL_IGN_FEHLER" 10017 "PT_TORQDKG_FEHLER" 10018 "PKS_FEHLER" 10019 "PT_STATUSR_FEHLER" 10020 "LAVK1_FEHLER" 10021 "LAVK2_FEHLER" 10022 "LAVK1_OBD_PLAU_FEHLER" 10023 "LAVK2_OBD_PLAU_FEHLER" 10024 "LAVK1_OBD_SA_FEHLER" 10025 "LAVK2_OBD_SA_FEHLER" 10026 "LANK1_FEHLER" 10027 "LANK2_FEHLER" 10028 "LSHNK1_FEHLER" 10029 "LSHNK2_FEHLER" 52615 "PT_BUSOFF" 52632 "PT_TORQDSC_FEHLER" 52645 "PT_STDSC_FEHLER" 52667 "PT_VRAD_FEHLER" 52636 "PT_VFZG_FEHLER" 52628 "PT_ATEMP_FEHLER" 52640 "PT_KLST_FEHLER" 52649 "PT_KKOS_FEHLER" 52641 "PT_LRW_FEHLER" 10039 "FPLAU1_FEHLER" 10040 "FPLAU2_FEHLER" 10041 "SL_ML_HFM_FEHLER" 10042 "LANK1_OBD_S_FEHLER" 10043 "LANK2_OBD_S_FEHLER" 10044 "LAVK1_OBD_TL_FEHLER" 10045 "LAVK2_OBD_TL_FEHLER" 10046 "LSHVK1_FEHLER" 10047 "LSHVK2_FEHLER" 10048 "LSRVK1_OBD_REG_FEHLER" 10049 "LSRVK2_OBD_REG_FEHLER" 10050 "LSHVK1_R_FEHLER" 10051 "LSHVK2_R_FEHLER" 10052 "LSRVK1_OBD_START_FEHLER" 10053 "LSRVK2_OBD_START_FEHLER" 10054 "LSRVK1_OBD_REF_FEHLER" 10055 "LSRVK2_OBD_REF_FEHLER" 10056 "LAVK1_DIAG_FEHLER" 10057 "LAVK2_DIAG_FEHLER" 10058 "LAVK1_IA_OPENLOAD_FEHLER" 10059 "LAVK2_IA_OPENLOAD_FEHLER" 10060 "PT_GRB_FEHLER" 10061 "PT_GRB2_FEHLER" 10062 "LAVK1_UN_OPENLOAD_FEHLER" 10063 "LAVK2_UN_OPENLOAD_FEHLER" 10064 "LAVK1_IP_OPENLOAD_FEHLER" 10065 "LAVK2_IP_OPENLOAD_FEHLER" 10066 "APPL_DATA_INJ" 10067 "TZ1_FEHLER" 10068 "TZ2_FEHLER" 10069 "TZ3_FEHLER" 10070 "TZ4_FEHLER" 10071 "TZ5_FEHLER" 10072 "TZ6_FEHLER" 10073 "TZ7_FEHLER" 10074 "TZ8_FEHLER" 10075 "TZ9_FEHLER" 10076 "TZ10_FEHLER" 10077 "LAM1_REG_FEHLER" 10078 "LAM2_REG_FEHLER" 10079 "VAN_ANSCHL_E1_FEHLER" 10080 "VAN_ANSCHL_A1_FEHLER" 10081 "VAN_ANSCHL_E2_FEHLER" 10082 "VAN_ANSCHL_A2_FEHLER" 10083 "VAN_VENT_E1_FEHLER" 10084 "VAN_VENT_A1_FEHLER" 10085 "VAN_VENT_E2_FEHLER" 10086 "VAN_VENT_A2_FEHLER" 10087 "EV1_FEHLER" 10088 "EV2_FEHLER" 10089 "EV3_FEHLER" 10090 "EV4_FEHLER" 10091 "EV5_FEHLER" 10092 "EV6_FEHLER" 10093 "EV7_FEHLER" 10094 "EV8_FEHLER" 10095 "EV9_FEHLER" 10096 "EV10_FEHLER" 10097 "LAVK1_OBD_DYN_FEHLER" 10098 "LAVK2_OBD_DYN_FEHLER" 52650 "PT_CRASH_FEHLER" 52635 "PT_VEHMOD_FEHLER" 52629 "PT_BEDFGR_FEHLER" 10102 "DMTL_P_FEHLER" 10103 "DMTL_V_FEHLER" 10104 "DMTL_H_FEHLER" 10105 "DMTL_GROBLECK_FEHLER" 10106 "DMTL_FEUCHT_FEHLER" 10107 "DMTL_DECKEL_MELDUNG" 10108 "LA1_TRIM_FEHLER" 10109 "LA2_TRIM_FEHLER" 10110 "RLU87_FEHLER" 10111 "EKP_PWM_FEHLER" 10112 "CODIER_FEHLER" 10113 "TD_FEHLER" 10114 "RLSLP_FEHLER" 10115 "SLV_FEHLER" 52639 "PT_KMST_FEHLER" 52648 "PT_STATKOM_FEHLER" 10118 "PKS_LL_FEHLER" 10119 "PKS_TL_FEHLER" 10120 "PKS_Q_FEHLER" 10121 "KAT_OBD1_FEHLER" 10122 "KAT_OBD2_FEHLER" 10123 "VAN_DSV_FEHLER" 10124 "FI_GEN" 10125 "FI_BSD" 10126 "FI_QLT" 10127 "FI_IBS1" 10128 "FI_IBS2" 10129 "FI_IBS3" 10130 "FI_PMBN" 10131 "FI_PMBATT" 10132 "MVAC_DRUCKSENSOR" 52668 "PT_BEDAT_FEHLER" 10134 "SK_MANAGER_INJ" 10135 "INDEX_135_INJ" 10136 "EWS_SCI_FEHLER" 10137 "EWS_MAN_FEHLER" 10138 "FI_BSD_0" 10139 "FI_BSD_6" 10140 "FI_BSDGLOB" 10141 "FI_PMRUHVERL" 10142 "FI_TOENS" 10143 "EBOX_ELU_FEHLER" 10144 "SG_INJ_FEHLER" 10145 "EGAS_ENLTG1_DIAG" 10146 "EGAS_ENLTG2_DIAG" 10147 "S_POEL_FEHLER" 10148 "TEV1_OBD_FEHLER" 10149 "TEV2_OBD_FEHLER" 10150 "TEV1_FEHLER" 10151 "TEV2_FEHLER" 10152 "EBENE2_INJ_FEHLER" 10153 "KW_FEHLER" 10154 "LA1_ADAPT_FEHLER" 10155 "LA2_ADAPT_FEHLER" 10156 "KGE1_FEHLER" 10157 "KGE2_FEHLER" 10158 "FST_FEHLER" 10159 "SLP_FEHLER" 10160 "SL_DURCHS_B1" 10161 "SL_DURCHS_B2" 10162 "SL_DURCHS_HSTRANG" 10163 "FETRAWE_FEHLER" 10164 "S_GETR_HS_FEHLER" 10165 "S_KUPP_HS_FEHLER" 10166 "VAN_DRUCK_FEHLER" 10167 "ELUP_FEHLER" 10168 "ELU_FEHLER" 52655 "PT_STATANH_FEHLER" 10170 "KSD1_FEHLER" 10171 "KSD2_FEHLER" 10172 "KATS1_FEHLER" 10173 "KATS2_FEHLER" 10174 "PT_GRB3_FEHLER" 10175 "PT_ANFRADMOM_FEHLER" 10176 "FST_GEBER_FEHLER" 10177 "TANK_LEER_INFO" 10178 "PT_TOMA_FEHLER" 10179 "DMTL_FEINLECK_FEHLER" 10180 "PUMG_OBD_FEHLER" 10181 "SL_ML_HFM_OBD_FEHLER" 10182 "LA1_TRIM_AD_FEHLER" 10183 "LA2_TRIM_AD_FEHLER" 10184 "LANK1_OPENLOAD_FEHLER" 10185 "LANK2_OPENLOAD_FEHLER" 10186 "LANK1_OBD_WE_FEHLER" 10187 "LANK2_OBD_WE_FEHLER" 10188 "LSHNK1_R_FEHLER" 10189 "LSHNK2_R_FEHLER" 10190 "PKS_MODELL_FEHLER" 10191 "PKS_PAUFBAU_FEHLER" 10192 "PKSR_ADAPT_ANSCHL_FEHLER" 10193 "TGETR_FEHLER" 10194 "LAVK_ATIC42_FEHLER" 10195 "PT_ALAENGS_FEHLER" 10196 "INDEX_196_INJ" 10197 "INDEX_197_INJ" 10198 "INDEX_198_INJ" 10199 "INDEX_199_INJ" 10200 "INDEX_200_INJ" 10201 "INDEX_201_INJ" 10202 "INDEX_202_INJ" 10203 "INDEX_203_INJ" 10204 "INDEX_204_INJ" 10205 "INDEX_205_INJ" 10206 "INDEX_206_INJ" 10207 "INDEX_207_INJ" 10208 "INDEX_208_INJ" 10209 "INDEX_209_INJ" 10210 "INDEX_210_INJ" 10211 "INDEX_211_INJ" 10212 "INDEX_212_INJ" 10213 "INDEX_213_INJ" 10214 "INDEX_214_INJ" 10215 "INDEX_215_INJ" 10216 "INDEX_216_INJ" 10217 "INDEX_217_INJ" 10218 "INDEX_218_INJ" 10219 "INDEX_219_INJ" 10220 "INDEX_220_INJ" 10221 "INDEX_221_INJ" 10222 "INDEX_222_INJ" 10223 "INDEX_223_INJ" 11000 "SK_TESTFEHLER" 11001 "TMOT_FEHLER" 11002 "TMOT_OBD_FEHLER" 11003 "TAN1_FEHLER" 11004 "TAN2_FEHLER" 11005 "TIME_REL_OBD_FEHLER" 11006 "UB_FEHLER" 11007 "TKA_FEHLER" 11008 "TDME_FEHLER" 11009 "UEXT_111_219_514_FEHLER" 11010 "UEXT_124_512_FEHLER" 11011 "APPL_DATA_IGN" 11012 "TKA_OBD_FEHLER" 11013 "PWG1_FEHLER" 11014 "PWG2_FEHLER" 11015 "PWG_VGL_FEHLER" 11016 "PCTRL_INJ_FEHLER" 52669 "EC_LLS1_FEHLER" 52670 "EC_LLS2_FEHLER" 52671 "EC_DK1_FEHLER" 52672 "EC_DK2_FEHLER" 11021 "LLS1_SK_FEHLER" 11022 "LLS2_SK_FEHLER" 11023 "SMG_SCHALTABLAUF" 11024 "SMG_SK_FEHLER" 11025 "SMG_SK_N_UEBERWACHUNG" 11026 "TUMG_OBD_FEHLER" 11027 "V_FEHLER" 11028 "DK_INIT_FEHLER" 11029 "DK1_REG_FEHLER" 11030 "DK2_REG_FEHLER" 11031 "DK1_ADAPT_FEHLER" 11032 "DK2_ADAPT_FEHLER" 11033 "INDEX_33_IGN" 11034 "INDEX_34_IGN" 11035 "INDEX_35_IGN" 11036 "INDEX_36_IGN" 11037 "TABG1_FEHLER" 11038 "TABG2_FEHLER" 11039 "DK1_WDK_FEHLER" 11040 "DK2_WDK_FEHLER" 11041 "DK1_PDR_FEHLER" 11042 "DK2_PDR_FEHLER" 11043 "LLS1_REG_FEHLER" 11044 "LLS2_REG_FEHLER" 11045 "DK1_SK_FEHLER" 11046 "DK2_SK_FEHLER" 11047 "DK1_FT_FEHLER" 11048 "DK2_FT_FEHLER" 11049 "MD_SK_ERR" 11050 "LLS_INIT_FEHLER" 11051 "DSC_EINGR_FEHLER" 11052 "DK1_CMD_FEHLER" 11053 "DK2_CMD_FEHLER" 11054 "LLS1_CMD_FEHLER" 11055 "LLS2_CMD_FEHLER" 52673 "SC_SMG1_FEHLER" 52674 "SC_SMG2_FEHLER" 52675 "SC_SMG3_FEHLER" 52619 "SC_BUSOFF_FEHLER" 52627 "EC_BUSOFF_FEHLER" 11061 "AUSS_KAT_Z1_FEHLER" 11062 "AUSS_KAT_Z2_FEHLER" 11063 "AUSS_KAT_Z3_FEHLER" 11064 "AUSS_KAT_Z4_FEHLER" 11065 "AUSS_KAT_Z5_FEHLER" 11066 "AUSS_KAT_Z6_FEHLER" 11067 "AUSS_KAT_Z7_FEHLER" 11068 "AUSS_KAT_Z8_FEHLER" 11069 "AUSS_KAT_Z9_FEHLER" 11070 "AUSS_KAT_Z10_FEHLER" 11071 "INDEX_71_IGN" 11072 "INDEX_72_IGN" 11073 "AUSS_KAT_MULT_FEHLER" 11074 "AUSS_ABG_Z1_FEHLER" 11075 "AUSS_ABG_Z2_FEHLER" 11076 "AUSS_ABG_Z3_FEHLER" 11077 "AUSS_ABG_Z4_FEHLER" 11078 "AUSS_ABG_Z5_FEHLER" 11079 "AUSS_ABG_Z6_FEHLER" 11080 "AUSS_ABG_Z7_FEHLER" 11081 "AUSS_ABG_Z8_FEHLER" 11082 "AUSS_ABG_Z9_FEHLER" 11083 "AUSS_ABG_Z10_FEHLER" 11084 "INDEX_84_IGN" 11085 "INDEX_85_IGN" 11086 "AUSS_ABG_MULT_FEHLER" 11087 "TAN_OBD_B1_FEHLER" 11088 "DKG_EINGR_FEHLER" 11089 "SC_PKS_FEHLER" 11090 "ZOELP1_FEHLER" 11091 "ZOELP2_FEHLER" 11092 "SG_IGN_FEHLER" 11093 "EBENE2_IGN_FEHLER" 11094 "BLS_PLAU_FEHLER" 11095 "SK_MANAGER_IGN" 11096 "LLR_DIAGNOSE" 11097 "THERMOSTAT_FEHLER" 11098 "TAN_OBD_B2_FEHLER" 11099 "DK1_ZUSTAND" 11100 "DK2_ZUSTAND" 11101 "FGR_ABWURF" 11102 "PWG_BLS_FEHLER" 11103 "START_RL_FEHLER" 11104 "AFZ_FEHLER" 11105 "N_GETR_EIN_HS_FEHLER" 11106 "SERVO_I_FEHLER" 11107 "SERVO_V_FEHLER" 11108 "TUMG_FEHLER" 11109 "LLR_DIAGNOSE_CSS" 11110 "TMOT_HIGH_FEHLER" 11111 "M_SPULE_ZYL_1" 11112 "M_SPULE_ZYL_2" 11113 "M_SPULE_ZYL_3" 11114 "M_SPULE_ZYL_4" 11115 "M_SPULE_ZYL_5" 11116 "M_SPULE_ZYL_6" 11117 "M_SPULE_ZYL_7" 11118 "M_SPULE_ZYL_8" 11119 "M_SPULE_ZYL_9" 11120 "M_SPULE_ZYL_10" 11121 "INDEX_121_IGN" 11122 "INDEX_122_IGN" 11123 "INDEX_123_IGN" 11124 "INDEX_124_IGN" 11125 "INDEX_125_IGN" 11126 "INDEX_126_IGN" 11127 "INDEX_127_IGN" /end COMPU_VTAB
/begin COMPU_VTAB FORMULA_0057_VTAB "FORMULA_0057_VTAB" TAB_VERB 4 1 "Regler noch aus" 2 "Regler aktiv" 4 "Schubabschalten" 8 "Sonde defekt" /end COMPU_VTAB
/begin COMPU_VTAB FORMULA_0064_VTAB "FORMULA_0064_VTAB" TAB_VERB 2 1 "Einblasung" 4 "Keine Einblasung" /end COMPU_VTAB
/begin COMPU_VTAB FORMULA_0065_VTAB "FORMULA_0065_VTAB" TAB_VERB 1 0 "BMW-MIL aus" DEFAULT_VALUE "BMW-MIL an" /end COMPU_VTAB
/begin COMPU_VTAB FORMULA_0066_VTAB "FORMULA_0066_VTAB" TAB_VERB 1 0 "PRE-MIL aus" DEFAULT_VALUE "PRE-MIL an" /end COMPU_VTAB
/begin COMPU_VTAB FORMULA_0067_VTAB "FORMULA_0067_VTAB" TAB_VERB 1 0 "DME-MIL aus" DEFAULT_VALUE "DME-MIL an" /end COMPU_VTAB
/begin COMPU_VTAB FORMULA_0068_VTAB "FORMULA_0068_VTAB" TAB_VERB 1 0 "ZYL_OFF-MIL aus" DEFAULT_VALUE "ZYL_OFF-MIL an" /end COMPU_VTAB
/begin COMPU_VTAB FORMULA_0069_VTAB "FORMULA_0069_VTAB" TAB_VERB 1 0 "SMG-MIL aus" DEFAULT_VALUE "SMG-MIL an" /end COMPU_VTAB
/begin COMPU_VTAB FORMULA_0070_VTAB "FORMULA_0070_VTAB" TAB_VERB 1 165 "fsp_loeschen" DEFAULT_VALUE "fsp_sichern" /end COMPU_VTAB
/begin FUNCTION Eigendiagnose ""
 /begin DEF_CHARACTERISTIC K_ED_AFZ_HS.DEC_NACH_EINTRAG K_ED_AFZ_HS.DEC_VOR_EINTRAG K_ED_AFZ_HS.FEHLERSCHWELLE K_ED_AFZ_HS.INC_NACH_EINTRAG K_ED_AFZ_HS.INC_VOR_EINTRAG K_ED_AFZ_HS.KLASSENINDEX K_ED_AFZ_HS.OK_SCHWELLE K_ED_AFZ_HS.P_CODE_OPENLOAD K_ED_AFZ_HS.P_CODE_SH_TO_GND K_ED_AFZ_HS.P_CODE_SH_TO_UB K_ED_AFZ_HS.P_CODE_UNPLAUSIBEL K_ED_APPL_DATA_IGN.DEC_NACH_EINTRAG K_ED_APPL_DATA_IGN.DEC_VOR_EINTRAG K_ED_APPL_DATA_IGN.FEHLERSCHWELLE K_ED_APPL_DATA_IGN.INC_NACH_EINTRAG K_ED_APPL_DATA_IGN.INC_VOR_EINTRAG K_ED_APPL_DATA_IGN.KLASSENINDEX K_ED_APPL_DATA_IGN.OK_SCHWELLE K_ED_APPL_DATA_IGN.P_CODE_OPENLOAD K_ED_APPL_DATA_IGN.P_CODE_SH_TO_GND K_ED_APPL_DATA_IGN.P_CODE_SH_TO_UB K_ED_APPL_DATA_IGN.P_CODE_UNPLAUSIBEL K_ED_AUSS_ABG_MULT.DEC_NACH_EINTRAG K_ED_AUSS_ABG_MULT.DEC_VOR_EINTRAG K_ED_AUSS_ABG_MULT.FEHLERSCHWELLE K_ED_AUSS_ABG_MULT.INC_NACH_EINTRAG K_ED_AUSS_ABG_MULT.INC_VOR_EINTRAG K_ED_AUSS_ABG_MULT.KLASSENINDEX /end DEF_CHARACTERISTIC
 /begin OUT_MEASUREMENT ed_fsp_17of20_.ed_fil_index_nv ed_fsp_17of20_.fehlerart_nv ed_fsp_17of20_.fehlercode_nv ed_fsp_17of20_.ff_egas_ist_dk_b1_nv ed_fsp_17of20_.ff_laa_f_ber_b1_nv ed_fsp_17of20_.ff_laa_f_ber_b2_nv ed_fsp_17of20_.ff_lam_reg_b1_nv ed_fsp_17of20_.ff_lam_reg_b2_nv ed_fsp_17of20_.ff_lam_reg_f_b1_nv ed_fsp_17of20_.ff_lam_reg_f_b2_nv ed_fsp_17of20_.ff_ml_ges_nv ed_fsp_17of20_.ff_n_nv ed_fsp_17of20_.ff_p_code_nv ed_fsp_17of20_.ff_pks_ist_nv ed_fsp_17of20_.ff_rf_m_nv ed_fsp_17of20_.ff_sl_st_nv ed_fsp_17of20_.ff_tan_m_nv ed_fsp_17of20_.ff_tmot_nv ed_fsp_17of20_.ff_tz1_nv ed_fsp_17of20_.ff_v_vorne_nv ed_fsp_17of20_.haeufigkeitszaehler_nv ed_fsp_17of20_.inj_fehlerzaehler_nv ed_fsp_17of20_.logistikzaehler_nv ed_fsp_17of20_.mil_filter_nv ed_fsp_17of20_.mil_filter_scdn_nv ed_fsp_17of20_.scdn_nenner_nv ed_fsp_17of20_.scdn_zaehler_nv ed_fsp_17of20_.uw_satz_1of3_.uw_km_stand_nv ed_fsp_17of20_.uw_satz_1of3_.uw_wert_nv_1of4_ ed_fsp_17of20_.uw_satz_1of3_.uw_wert_nv_2of4_ ed_fsp_17of20_.uw_satz_1of3_.uw_wert_nv_3of4_ ed_fsp_17of20_.uw_satz_1of3_.uw_wert_nv_4of4_ ed_fsp_17of20_.uw_satz_2of3_.uw_km_stand_nv ed_fsp_17of20_.uw_satz_2of3_.uw_wert_nv_1of4_ ed_fsp_17of20_.uw_satz_2of3_.uw_wert_nv_2of4_ ed_fsp_17of20_.uw_satz_2of3_.uw_wert_nv_3of4_ ed_fsp_17of20_.uw_satz_2of3_.uw_wert_nv_4of4_ ed_fsp_17of20_.uw_satz_3of3_.uw_km_stand_nv ed_fsp_17of20_.uw_satz_3of3_.uw_wert_nv_1of4_ ed_fsp_17of20_.uw_satz_3of3_.uw_wert_nv_2of4_ ed_fsp_17of20_.uw_satz_3of3_.uw_wert_nv_3of4_ ed_fsp_17of20_.uw_satz_3of3_.uw_wert_nv_4of4_ ed_fsp_18of20_.ed_fil_index_nv ed_fsp_18of20_.fehlerart_nv ed_fsp_18of20_.fehlercode_nv ed_fsp_18of20_.ff_egas_ist_dk_b1_nv ed_fsp_18of20_.ff_laa_f_ber_b1_nv ed_fsp_18of20_.ff_laa_f_ber_b2_nv ed_fsp_18of20_.ff_lam_reg_b1_nv ed_fsp_18of20_.ff_lam_reg_b2_nv ed_fsp_18of20_.ff_lam_reg_f_b1_nv ed_fsp_18of20_.ff_lam_reg_f_b2_nv ed_fsp_18of20_.ff_ml_ges_nv ed_fsp_18of20_.ff_n_nv ed_fsp_18of20_.ff_p_code_nv ed_fsp_18of20_.ff_pks_ist_nv ed_fsp_18of20_.ff_rf_m_nv ed_fsp_18of20_.ff_sl_st_nv ed_fsp_18of20_.ff_tan_m_nv ed_fsp_18of20_.ff_tmot_nv ed_fsp_18of20_.ff_tz1_nv ed_fsp_18of20_.ff_v_vorne_nv ed_fsp_18of20_.haeufigkeitszaehler_nv ed_fsp_18of20_.inj_fehlerzaehler_nv ed_fsp_18of20_.logistikzaehler_nv ed_fsp_18of20_.mil_filter_nv ed_fsp_18of20_.mil_filter_scdn_nv ed_fsp_18of20_.scdn_nenner_nv ed_fsp_18of20_.scdn_zaehler_nv ed_fsp_18of20_.uw_satz_1of3_.uw_km_stand_nv ed_fsp_18of20_.uw_satz_1of3_.uw_wert_nv_1of4_ ed_fsp_18of20_.uw_satz_1of3_.uw_wert_nv_2of4_ ed_fsp_18of20_.uw_satz_1of3_.uw_wert_nv_3of4_ ed_fsp_18of20_.uw_satz_1of3_.uw_wert_nv_4of4_ ed_fsp_18of20_.uw_satz_2of3_.uw_km_stand_nv ed_fsp_18of20_.uw_satz_2of3_.uw_wert_nv_1of4_ ed_fsp_18of20_.uw_satz_2of3_.uw_wert_nv_2of4_ ed_fsp_18of20_.uw_satz_2of3_.uw_wert_nv_3of4_ ed_fsp_18of20_.uw_satz_2of3_.uw_wert_nv_4of4_ ed_fsp_18of20_.uw_satz_3of3_.uw_km_stand_nv ed_fsp_18of20_.uw_satz_3of3_.uw_wert_nv_1of4_ ed_fsp_18of20_.uw_satz_3of3_.uw_wert_nv_2of4_ ed_fsp_18of20_.uw_satz_3of3_.uw_wert_nv_3of4_ ed_fsp_18of20_.uw_satz_3of3_.uw_wert_nv_4of4_ ed_fsp_19of20_.ed_fil_index_nv ed_fsp_19of20_.fehlerart_nv ed_fsp_19of20_.fehlercode_nv ed_fsp_19of20_.ff_egas_ist_dk_b1_nv ed_fsp_19of20_.ff_laa_f_ber_b1_nv ed_fsp_19of20_.ff_laa_f_ber_b2_nv ed_fsp_19of20_.ff_lam_reg_b1_nv ed_fsp_19of20_.ff_lam_reg_b2_nv ed_fsp_19of20_.ff_lam_reg_f_b1_nv ed_fsp_19of20_.ff_lam_reg_f_b2_nv ed_fsp_19of20_.ff_ml_ges_nv ed_fsp_19of20_.ff_n_nv ed_fsp_19of20_.ff_p_code_nv ed_fsp_19of20_.ff_pks_ist_nv ed_fsp_19of20_.ff_rf_m_nv ed_fsp_19of20_.ff_sl_st_nv ed_fsp_19of20_.ff_tan_m_nv ed_fsp_19of20_.ff_tmot_nv ed_fsp_19of20_.ff_tz1_nv ed_fsp_19of20_.ff_v_vorne_nv ed_fsp_19of20_.haeufigkeitszaehler_nv ed_fsp_19of20_.inj_fehlerzaehler_nv ed_fsp_19of20_.logistikzaehler_nv ed_fsp_19of20_.mil_filter_nv ed_fsp_19of20_.mil_filter_scdn_nv ed_fsp_19of20_.scdn_nenner_nv ed_fsp_19of20_.scdn_zaehler_nv ed_fsp_19of20_.uw_satz_1of3_.uw_km_stand_nv ed_fsp_19of20_.uw_satz_1of3_.uw_wert_nv_1of4_ ed_fsp_19of20_.uw_satz_1of3_.uw_wert_nv_2of4_ ed_fsp_19of20_.uw_satz_1of3_.uw_wert_nv_3of4_ ed_fsp_19of20_.uw_satz_1of3_.uw_wert_nv_4of4_ ed_fsp_19of20_.uw_satz_2of3_.uw_km_stand_nv ed_fsp_19of20_.uw_satz_2of3_.uw_wert_nv_1of4_ ed_fsp_19of20_.uw_satz_2of3_.uw_wert_nv_2of4_ ed_fsp_19of20_.uw_satz_2of3_.uw_wert_nv_3of4_ ed_fsp_19of20_.uw_satz_2of3_.uw_wert_nv_4of4_ ed_fsp_19of20_.uw_satz_3of3_.uw_km_stand_nv ed_fsp_19of20_.uw_satz_3of3_.uw_wert_nv_1of4_ ed_fsp_19of20_.uw_satz_3of3_.uw_wert_nv_2of4_ ed_fsp_19of20_.uw_satz_3of3_.uw_wert_nv_3of4_ ed_fsp_19of20_.uw_satz_3of3_.uw_wert_nv_4of4_ ed_fsp_1of20_.ed_fil_index_nv ed_fsp_1of20_.fehlerart_nv ed_fsp_1of20_.fehlercode_nv ed_fsp_1of20_.ff_egas_ist_dk_b1_nv ed_fsp_1of20_.ff_laa_f_ber_b1_nv ed_fsp_1of20_.ff_laa_f_ber_b2_nv ed_fsp_1of20_.ff_lam_reg_b1_nv ed_fsp_1of20_.ff_lam_reg_b2_nv ed_fsp_1of20_.ff_lam_reg_f_b1_nv ed_fsp_1of20_.ff_lam_reg_f_b2_nv ed_fsp_1of20_.ff_ml_ges_nv ed_fsp_1of20_.ff_n_nv ed_fsp_1of20_.ff_p_code_nv ed_fsp_1of20_.ff_pks_ist_nv ed_fsp_1of20_.ff_rf_m_nv ed_fsp_1of20_.ff_sl_st_nv ed_fsp_1of20_.ff_tan_m_nv ed_fsp_1of20_.ff_tmot_nv ed_fsp_1of20_.ff_tz1_nv ed_fsp_1of20_.ff_v_vorne_nv ed_fsp_1of20_.haeufigkeitszaehler_nv ed_fsp_1of20_.inj_fehlerzaehler_nv ed_fsp_1of20_.logistikzaehler_nv ed_fsp_1of20_.mil_filter_nv ed_fsp_1of20_.mil_filter_scdn_nv ed_fsp_1of20_.scdn_nenner_nv ed_fsp_1of20_.scdn_zaehler_nv ed_fsp_1of20_.uw_satz_1of3_.uw_km_stand_nv ed_fsp_1of20_.uw_satz_1of3_.uw_wert_nv_1of4_ ed_fsp_1of20_.uw_satz_1of3_.uw_wert_nv_2of4_ ed_fsp_1of20_.uw_satz_1of3_.uw_wert_nv_3of4_ ed_fsp_1of20_.uw_satz_1of3_.uw_wert_nv_4of4_ ed_fsp_1of20_.uw_satz_2of3_.uw_km_stand_nv ed_fsp_1of20_.uw_satz_2of3_.uw_wert_nv_1of4_ ed_fsp_1of20_.uw_satz_2of3_.uw_wert_nv_2of4_ ed_fsp_1of20_.uw_satz_2of3_.uw_wert_nv_3of4_ ed_fsp_1of20_.uw_satz_2of3_.uw_wert_nv_4of4_ ed_fsp_1of20_.uw_satz_3of3_.uw_km_stand_nv ed_fsp_1of20_.uw_satz_3of3_.uw_wert_nv_1of4_ ed_fsp_1of20_.uw_satz_3of3_.uw_wert_nv_2of4_ ed_fsp_1of20_.uw_satz_3of3_.uw_wert_nv_3of4_ ed_fsp_1of20_.uw_satz_3of3_.uw_wert_nv_4of4_ ed_fsp_20of20_.ed_fil_index_nv ed_fsp_20of20_.fehlerart_nv ed_fsp_20of20_.fehlercode_nv ed_fsp_20of20_.ff_egas_ist_dk_b1_nv ed_fsp_20of20_.ff_laa_f_ber_b1_nv ed_fsp_20of20_.ff_laa_f_ber_b2_nv ed_fsp_20of20_.ff_lam_reg_b1_nv ed_fsp_20of20_.ff_lam_reg_b2_nv ed_fsp_20of20_.ff_lam_reg_f_b1_nv ed_fsp_20of20_.ff_lam_reg_f_b2_nv ed_fsp_20of20_.ff_ml_ges_nv ed_fsp_20of20_.ff_n_nv ed_fsp_20of20_.ff_p_code_nv ed_fsp_20of20_.ff_pks_ist_nv ed_fsp_20of20_.ff_rf_m_nv ed_fsp_20of20_.ff_sl_st_nv ed_fsp_20of20_.ff_tan_m_nv ed_fsp_20of20_.ff_tmot_nv ed_fsp_20of20_.ff_tz1_nv ed_fsp_20of20_.ff_v_vorne_nv ed_fsp_20of20_.haeufigkeitszaehler_nv ed_fsp_20of20_.inj_fehlerzaehler_nv ed_fsp_20of20_.logistikzaehler_nv ed_fsp_20of20_.mil_filter_nv ed_fsp_20of20_.mil_filter_scdn_nv ed_fsp_20of20_.scdn_nenner_nv ed_fsp_20of20_.scdn_zaehler_nv ed_fsp_20of20_.uw_satz_1of3_.uw_km_stand_nv ed_fsp_20of20_.uw_satz_1of3_.uw_wert_nv_1of4_ ed_fsp_20of20_.uw_satz_1of3_.uw_wert_nv_2of4_ ed_fsp_20of20_.uw_satz_1of3_.uw_wert_nv_3of4_ ed_fsp_20of20_.uw_satz_1of3_.uw_wert_nv_4of4_ ed_fsp_20of20_.uw_satz_2of3_.uw_km_stand_nv ed_fsp_20of20_.uw_satz_2of3_.uw_wert_nv_1of4_ ed_fsp_20of20_.uw_satz_2of3_.uw_wert_nv_2of4_ ed_fsp_20of20_.uw_satz_2of3_.uw_wert_nv_3of4_ ed_fsp_20of20_.uw_satz_2of3_.uw_wert_nv_4of4_ ed_fsp_20of20_.uw_satz_3of3_.uw_km_stand_nv ed_fsp_20of20_.uw_satz_3of3_.uw_wert_nv_1of4_ ed_fsp_20of20_.uw_satz_3of3_.uw_wert_nv_2of4_ ed_fsp_20of20_.uw_satz_3of3_.uw_wert_nv_3of4_ ed_fsp_20of20_.uw_satz_3of3_.uw_wert_nv_4of4_ ed_fsp_2of20_.ed_fil_index_nv ed_fsp_2of20_.fehlerart_nv ed_fsp_2of20_.fehlercode_nv ed_fsp_2of20_.ff_egas_ist_dk_b1_nv ed_fsp_2of20_.ff_laa_f_ber_b1_nv ed_fsp_2of20_.ff_laa_f_ber_b2_nv ed_fsp_2of20_.ff_lam_reg_b1_nv ed_fsp_2of20_.ff_lam_reg_b2_nv ed_fsp_2of20_.ff_lam_reg_f_b1_nv ed_fsp_2of20_.ff_lam_reg_f_b2_nv ed_fsp_2of20_.ff_ml_ges_nv ed_fsp_2of20_.ff_n_nv ed_fsp_2of20_.ff_p_code_nv ed_fsp_2of20_.ff_pks_ist_nv ed_fsp_2of20_.ff_rf_m_nv ed_fsp_2of20_.ff_sl_st_nv ed_fsp_2of20_.ff_tan_m_nv ed_fsp_2of20_.ff_tmot_nv ed_fsp_2of20_.ff_tz1_nv ed_fsp_2of20_.ff_v_vorne_nv ed_fsp_2of20_.haeufigkeitszaehler_nv ed_fsp_2of20_.inj_fehlerzaehler_nv ed_fsp_2of20_.logistikzaehler_nv ed_fsp_2of20_.mil_filter_nv ed_fsp_2of20_.mil_filter_scdn_nv ed_fsp_2of20_.scdn_nenner_nv ed_fsp_2of20_.scdn_zaehler_nv ed_fsp_2of20_.uw_satz_1of3_.uw_km_stand_nv ed_fsp_2of20_.uw_satz_1of3_.uw_wert_nv_1of4_ ed_fsp_2of20_.uw_satz_1of3_.uw_wert_nv_2of4_ ed_fsp_2of20_.uw_satz_1of3_.uw_wert_nv_3of4_ ed_fsp_2of20_.uw_satz_1of3_.uw_wert_nv_4of4_ ed_fsp_2of20_.uw_satz_2of3_.uw_km_stand_nv ed_fsp_2of20_.uw_satz_2of3_.uw_wert_nv_1of4_ ed_fsp_2of20_.uw_satz_2of3_.uw_wert_nv_2of4_ ed_fsp_2of20_.uw_satz_2of3_.uw_wert_nv_3of4_ ed_fsp_2of20_.uw_satz_2of3_.uw_wert_nv_4of4_ ed_fsp_2of20_.uw_satz_3of3_.uw_km_stand_nv ed_fsp_2of20_.uw_satz_3of3_.uw_wert_nv_1of4_ ed_fsp_2of20_.uw_satz_3of3_.uw_wert_nv_2of4_ ed_fsp_2of20_.uw_satz_3of3_.uw_wert_nv_3of4_ ed_fsp_2of20_.uw_satz_3of3_.uw_wert_nv_4of4_ ed_fsp_3of20_.ed_fil_index_nv ed_fsp_3of20_.fehlerart_nv ed_fsp_3of20_.fehlercode_nv ed_fsp_3of20_.ff_egas_ist_dk_b1_nv ed_fsp_3of20_.ff_laa_f_ber_b1_nv ed_fsp_3of20_.ff_laa_f_ber_b2_nv ed_fsp_3of20_.ff_lam_reg_b1_nv ed_fsp_3of20_.ff_lam_reg_b2_nv ed_fsp_3of20_.ff_lam_reg_f_b1_nv ed_fsp_3of20_.ff_lam_reg_f_b2_nv ed_fsp_3of20_.ff_ml_ges_nv ed_fsp_3of20_.ff_n_nv ed_fsp_3of20_.ff_p_code_nv ed_fsp_3of20_.ff_pks_ist_nv ed_fsp_3of20_.ff_rf_m_nv ed_fsp_3of20_.ff_sl_st_nv ed_fsp_3of20_.ff_tan_m_nv ed_fsp_3of20_.ff_tmot_nv ed_fsp_3of20_.ff_tz1_nv ed_fsp_3of20_.ff_v_vorne_nv ed_fsp_3of20_.haeufigkeitszaehler_nv ed_fsp_3of20_.inj_fehlerzaehler_nv ed_fsp_3of20_.logistikzaehler_nv ed_fsp_3of20_.mil_filter_nv ed_fsp_3of20_.mil_filter_scdn_nv ed_fsp_3of20_.scdn_nenner_nv ed_fsp_3of20_.scdn_zaehler_nv ed_fsp_3of20_.uw_satz_1of3_.uw_km_stand_nv ed_fsp_3of20_.uw_satz_1of3_.uw_wert_nv_1of4_ ed_fsp_3of20_.uw_satz_1of3_.uw_wert_nv_2of4_ ed_fsp_3of20_.uw_satz_1of3_.uw_wert_nv_3of4_ ed_fsp_3of20_.uw_satz_1of3_.uw_wert_nv_4of4_ ed_fsp_3of20_.uw_satz_2of3_.uw_km_stand_nv ed_fsp_3of20_.uw_satz_2of3_.uw_wert_nv_1of4_ ed_fsp_3of20_.uw_satz_2of3_.uw_wert_nv_2of4_ ed_fsp_3of20_.uw_satz_2of3_.uw_wert_nv_3of4_ ed_fsp_3of20_.uw_satz_2of3_.uw_wert_nv_4of4_ ed_fsp_3of20_.uw_satz_3of3_.uw_km_stand_nv ed_fsp_3of20_.uw_satz_3of3_.uw_wert_nv_1of4_ ed_fsp_3of20_.uw_satz_3of3_.uw_wert_nv_2of4_ ed_fsp_3of20_.uw_satz_3of3_.uw_wert_nv_3of4_ ed_fsp_3of20_.uw_satz_3of3_.uw_wert_nv_4of4_ ed_fsp_4of20_.ed_fil_index_nv ed_fsp_4of20_.fehlerart_nv ed_fsp_4of20_.fehlercode_nv ed_fsp_4of20_.ff_egas_ist_dk_b1_nv ed_fsp_4of20_.ff_laa_f_ber_b1_nv ed_fsp_4of20_.ff_laa_f_ber_b2_nv ed_fsp_4of20_.ff_lam_reg_b1_nv ed_fsp_4of20_.ff_lam_reg_b2_nv ed_fsp_4of20_.ff_lam_reg_f_b1_nv ed_fsp_4of20_.ff_lam_reg_f_b2_nv ed_fsp_4of20_.ff_ml_ges_nv ed_fsp_4of20_.ff_n_nv ed_fsp_4of20_.ff_p_code_nv ed_fsp_4of20_.ff_pks_ist_nv ed_fsp_4of20_.ff_rf_m_nv ed_fsp_4of20_.ff_sl_st_nv ed_fsp_4of20_.ff_tan_m_nv ed_fsp_4of20_.ff_tmot_nv ed_fsp_4of20_.ff_tz1_nv ed_fsp_4of20_.ff_v_vorne_nv ed_fsp_4of20_.haeufigkeitszaehler_nv ed_fsp_4of20_.inj_fehlerzaehler_nv ed_fsp_4of20_.logistikzaehler_nv ed_fsp_4of20_.mil_filter_nv ed_fsp_4of20_.mil_filter_scdn_nv ed_fsp_4of20_.scdn_nenner_nv ed_fsp_4of20_.scdn_zaehler_nv ed_fsp_4of20_.uw_satz_1of3_.uw_km_stand_nv ed_fsp_4of20_.uw_satz_1of3_.uw_wert_nv_1of4_ ed_fsp_4of20_.uw_satz_1of3_.uw_wert_nv_2of4_ ed_fsp_4of20_.uw_satz_1of3_.uw_wert_nv_3of4_ ed_fsp_4of20_.uw_satz_1of3_.uw_wert_nv_4of4_ ed_fsp_4of20_.uw_satz_2of3_.uw_km_stand_nv ed_fsp_4of20_.uw_satz_2of3_.uw_wert_nv_1of4_ ed_fsp_4of20_.uw_satz_2of3_.uw_wert_nv_2of4_ ed_fsp_4of20_.uw_satz_2of3_.uw_wert_nv_3of4_ ed_fsp_4of20_.uw_satz_2of3_.uw_wert_nv_4of4_ ed_fsp_4of20_.uw_satz_3of3_.uw_km_stand_nv ed_fsp_4of20_.uw_satz_3of3_.uw_wert_nv_1of4_ ed_fsp_4of20_.uw_satz_3of3_.uw_wert_nv_2of4_ ed_fsp_4of20_.uw_satz_3of3_.uw_wert_nv_3of4_ ed_fsp_4of20_.uw_satz_3of3_.uw_wert_nv_4of4_ ed_fsp_5of20_.ed_fil_index_nv ed_fsp_5of20_.fehlerart_nv ed_fsp_5of20_.fehlercode_nv ed_fsp_5of20_.ff_egas_ist_dk_b1_nv ed_fsp_5of20_.ff_laa_f_ber_b1_nv ed_fsp_5of20_.ff_laa_f_ber_b2_nv ed_fsp_5of20_.ff_lam_reg_b1_nv ed_fsp_5of20_.ff_lam_reg_b2_nv ed_fsp_5of20_.ff_lam_reg_f_b1_nv ed_fsp_5of20_.ff_lam_reg_f_b2_nv ed_fsp_5of20_.ff_ml_ges_nv ed_fsp_5of20_.ff_n_nv ed_fsp_5of20_.ff_p_code_nv ed_fsp_5of20_.ff_pks_ist_nv ed_fsp_5of20_.ff_rf_m_nv ed_fsp_5of20_.ff_sl_st_nv ed_fsp_5of20_.ff_tan_m_nv ed_fsp_5of20_.ff_tmot_nv ed_fsp_5of20_.ff_tz1_nv ed_fsp_5of20_.ff_v_vorne_nv ed_fsp_5of20_.haeufigkeitszaehler_nv ed_fsp_5of20_.inj_fehlerzaehler_nv ed_fsp_5of20_.logistikzaehler_nv ed_fsp_5of20_.mil_filter_nv ed_fsp_5of20_.mil_filter_scdn_nv ed_fsp_5of20_.scdn_nenner_nv ed_fsp_5of20_.scdn_zaehler_nv ed_fsp_5of20_.uw_satz_1of3_.uw_km_stand_nv ed_fsp_5of20_.uw_satz_1of3_.uw_wert_nv_1of4_ ed_fsp_5of20_.uw_satz_1of3_.uw_wert_nv_2of4_ ed_fsp_5of20_.uw_satz_1of3_.uw_wert_nv_3of4_ ed_fsp_5of20_.uw_satz_1of3_.uw_wert_nv_4of4_ ed_fsp_5of20_.uw_satz_2of3_.uw_km_stand_nv ed_fsp_5of20_.uw_satz_2of3_.uw_wert_nv_1of4_ ed_fsp_5of20_.uw_satz_2of3_.uw_wert_nv_2of4_ ed_fsp_5of20_.uw_satz_2of3_.uw_wert_nv_3of4_ ed_fsp_5of20_.uw_satz_2of3_.uw_wert_nv_4of4_ ed_fsp_5of20_.uw_satz_3of3_.uw_km_stand_nv ed_fsp_5of20_.uw_satz_3of3_.uw_wert_nv_1of4_ ed_fsp_5of20_.uw_satz_3of3_.uw_wert_nv_2of4_ ed_fsp_5of20_.uw_satz_3of3_.uw_wert_nv_3of4_ ed_fsp_5of20_.uw_satz_3of3_.uw_wert_nv_4of4_ ed_fsp_6of20_.ed_fil_index_nv ed_fsp_6of20_.fehlerart_nv ed_fsp_6of20_.fehlercode_nv ed_fsp_6of20_.ff_egas_ist_dk_b1_nv ed_fsp_6of20_.ff_laa_f_ber_b1_nv ed_fsp_6of20_.ff_laa_f_ber_b2_nv ed_fsp_6of20_.ff_lam_reg_b1_nv ed_fsp_6of20_.ff_lam_reg_b2_nv ed_fsp_6of20_.ff_lam_reg_f_b1_nv ed_fsp_6of20_.ff_lam_reg_f_b2_nv ed_fsp_6of20_.ff_ml_ges_nv ed_fsp_6of20_.ff_n_nv ed_fsp_6of20_.ff_p_code_nv ed_fsp_6of20_.ff_pks_ist_nv ed_fsp_6of20_.ff_rf_m_nv ed_fsp_6of20_.ff_sl_st_nv ed_fsp_6of20_.ff_tan_m_nv ed_fsp_6of20_.ff_tmot_nv ed_fsp_6of20_.ff_tz1_nv ed_fsp_6of20_.ff_v_vorne_nv ed_fsp_6of20_.haeufigkeitszaehler_nv ed_fsp_6of20_.inj_fehlerzaehler_nv ed_fsp_6of20_.logistikzaehler_nv ed_fsp_6of20_.mil_filter_nv ed_fsp_6of20_.mil_filter_scdn_nv ed_fsp_6of20_.scdn_nenner_nv ed_fsp_6of20_.scdn_zaehler_nv ed_fsp_6of20_.uw_satz_1of3_.uw_km_stand_nv ed_fsp_6of20_.uw_satz_1of3_.uw_wert_nv_1of4_ ed_fsp_6of20_.uw_satz_1of3_.uw_wert_nv_2of4_ ed_fsp_6of20_.uw_satz_1of3_.uw_wert_nv_3of4_ ed_fsp_6of20_.uw_satz_1of3_.uw_wert_nv_4of4_ ed_fsp_6of20_.uw_satz_2of3_.uw_km_stand_nv ed_fsp_6of20_.uw_satz_2of3_.uw_wert_nv_1of4_ ed_fsp_6of20_.uw_satz_2of3_.uw_wert_nv_2of4_ ed_fsp_6of20_.uw_satz_2of3_.uw_wert_nv_3of4_ ed_fsp_6of20_.uw_satz_2of3_.uw_wert_nv_4of4_ ed_fsp_6of20_.uw_satz_3of3_.uw_km_stand_nv ed_fsp_6of20_.uw_satz_3of3_.uw_wert_nv_1of4_ ed_fsp_6of20_.uw_satz_3of3_.uw_wert_nv_2of4_ ed_fsp_6of20_.uw_satz_3of3_.uw_wert_nv_3of4_ ed_fsp_6of20_.uw_satz_3of3_.uw_wert_nv_4of4_ ed_fsp_7of20_.ed_fil_index_nv ed_fsp_7of20_.fehlerart_nv ed_fsp_7of20_.fehlercode_nv ed_fsp_7of20_.ff_egas_ist_dk_b1_nv ed_fsp_7of20_.ff_laa_f_ber_b1_nv ed_fsp_7of20_.ff_laa_f_ber_b2_nv ed_fsp_7of20_.ff_lam_reg_b1_nv ed_fsp_7of20_.ff_lam_reg_b2_nv ed_fsp_7of20_.ff_lam_reg_f_b1_nv ed_fsp_7of20_.ff_lam_reg_f_b2_nv ed_fsp_7of20_.ff_ml_ges_nv ed_fsp_7of20_.ff_n_nv ed_fsp_7of20_.ff_p_code_nv ed_fsp_7of20_.ff_pks_ist_nv ed_fsp_7of20_.ff_rf_m_nv ed_fsp_7of20_.ff_sl_st_nv ed_fsp_7of20_.ff_tan_m_nv ed_fsp_7of20_.ff_tmot_nv ed_fsp_7of20_.ff_tz1_nv ed_fsp_7of20_.ff_v_vorne_nv ed_fsp_7of20_.haeufigkeitszaehler_nv ed_fsp_7of20_.inj_fehlerzaehler_nv ed_fsp_7of20_.logistikzaehler_nv ed_fsp_7of20_.mil_filter_nv ed_fsp_7of20_.mil_filter_scdn_nv ed_fsp_7of20_.scdn_nenner_nv ed_fsp_7of20_.scdn_zaehler_nv ed_fsp_7of20_.uw_satz_1of3_.uw_km_stand_nv ed_fsp_7of20_.uw_satz_1of3_.uw_wert_nv_1of4_ ed_fsp_7of20_.uw_satz_1of3_.uw_wert_nv_2of4_ ed_fsp_7of20_.uw_satz_1of3_.uw_wert_nv_3of4_ ed_fsp_7of20_.uw_satz_1of3_.uw_wert_nv_4of4_ ed_fsp_7of20_.uw_satz_2of3_.uw_km_stand_nv ed_fsp_7of20_.uw_satz_2of3_.uw_wert_nv_1of4_ ed_fsp_7of20_.uw_satz_2of3_.uw_wert_nv_2of4_ ed_fsp_7of20_.uw_satz_2of3_.uw_wert_nv_3of4_ ed_fsp_7of20_.uw_satz_2of3_.uw_wert_nv_4of4_ ed_fsp_7of20_.uw_satz_3of3_.uw_km_stand_nv ed_fsp_7of20_.uw_satz_3of3_.uw_wert_nv_1of4_ ed_fsp_7of20_.uw_satz_3of3_.uw_wert_nv_2of4_ ed_fsp_7of20_.uw_satz_3of3_.uw_wert_nv_3of4_ ed_fsp_7of20_.uw_satz_3of3_.uw_wert_nv_4of4_ ed_fsp_8of20_.ed_fil_index_nv ed_fsp_8of20_.fehlerart_nv ed_fsp_8of20_.fehlercode_nv ed_fsp_8of20_.ff_egas_ist_dk_b1_nv ed_fsp_8of20_.ff_laa_f_ber_b1_nv ed_fsp_8of20_.ff_laa_f_ber_b2_nv ed_fsp_8of20_.ff_lam_reg_b1_nv ed_fsp_8of20_.ff_lam_reg_b2_nv ed_fsp_8of20_.ff_lam_reg_f_b1_nv ed_fsp_8of20_.ff_lam_reg_f_b2_nv ed_fsp_8of20_.ff_ml_ges_nv ed_fsp_8of20_.ff_n_nv ed_fsp_8of20_.ff_p_code_nv ed_fsp_8of20_.ff_pks_ist_nv ed_fsp_8of20_.ff_rf_m_nv ed_fsp_8of20_.ff_sl_st_nv ed_fsp_8of20_.ff_tan_m_nv ed_fsp_8of20_.ff_tmot_nv ed_fsp_8of20_.ff_tz1_nv ed_fsp_8of20_.ff_v_vorne_nv ed_fsp_8of20_.haeufigkeitszaehler_nv ed_fsp_8of20_.inj_fehlerzaehler_nv ed_fsp_8of20_.logistikzaehler_nv ed_fsp_8of20_.mil_filter_nv ed_fsp_8of20_.mil_filter_scdn_nv ed_fsp_8of20_.scdn_nenner_nv ed_fsp_8of20_.scdn_zaehler_nv ed_fsp_8of20_.uw_satz_1of3_.uw_km_stand_nv ed_fsp_8of20_.uw_satz_1of3_.uw_wert_nv_1of4_ ed_fsp_8of20_.uw_satz_1of3_.uw_wert_nv_2of4_ ed_fsp_8of20_.uw_satz_1of3_.uw_wert_nv_3of4_ ed_fsp_8of20_.uw_satz_1of3_.uw_wert_nv_4of4_ ed_fsp_8of20_.uw_satz_2of3_.uw_km_stand_nv ed_fsp_8of20_.uw_satz_2of3_.uw_wert_nv_1of4_ ed_fsp_8of20_.uw_satz_2of3_.uw_wert_nv_2of4_ ed_fsp_8of20_.uw_satz_2of3_.uw_wert_nv_3of4_ ed_fsp_8of20_.uw_satz_2of3_.uw_wert_nv_4of4_ ed_fsp_8of20_.uw_satz_3of3_.uw_km_stand_nv ed_fsp_8of20_.uw_satz_3of3_.uw_wert_nv_1of4_ ed_fsp_8of20_.uw_satz_3of3_.uw_wert_nv_2of4_ ed_fsp_8of20_.uw_satz_3of3_.uw_wert_nv_3of4_ ed_fsp_8of20_.uw_satz_3of3_.uw_wert_nv_4of4_ ed_fsp_9of20_.ed_fil_index_nv ed_fsp_9of20_.fehlerart_nv ed_fsp_9of20_.fehlercode_nv ed_fsp_9of20_.ff_egas_ist_dk_b1_nv ed_fsp_9of20_.ff_laa_f_ber_b1_nv ed_fsp_9of20_.ff_laa_f_ber_b2_nv ed_fsp_9of20_.ff_lam_reg_b1_nv ed_fsp_9of20_.ff_lam_reg_b2_nv ed_fsp_9of20_.ff_lam_reg_f_b1_nv ed_fsp_9of20_.ff_lam_reg_f_b2_nv ed_fsp_9of20_.ff_ml_ges_nv ed_fsp_9of20_.ff_n_nv ed_fsp_9of20_.ff_p_code_nv ed_fsp_9of20_.ff_pks_ist_nv ed_fsp_9of20_.ff_rf_m_nv ed_fsp_9of20_.ff_sl_st_nv ed_fsp_9of20_.ff_tan_m_nv ed_fsp_9of20_.ff_tmot_nv ed_fsp_9of20_.ff_tz1_nv ed_fsp_9of20_.ff_v_vorne_nv ed_fsp_9of20_.haeufigkeitszaehler_nv ed_fsp_9of20_.inj_fehlerzaehler_nv ed_fsp_9of20_.logistikzaehler_nv ed_fsp_9of20_.mil_filter_nv ed_fsp_9of20_.mil_filter_scdn_nv ed_fsp_9of20_.scdn_nenner_nv ed_fsp_9of20_.scdn_zaehler_nv ed_fsp_9of20_.uw_satz_1of3_.uw_km_stand_nv ed_fsp_9of20_.uw_satz_1of3_.uw_wert_nv_1of4_ ed_fsp_9of20_.uw_satz_1of3_.uw_wert_nv_2of4_ ed_fsp_9of20_.uw_satz_1of3_.uw_wert_nv_3of4_ ed_fsp_9of20_.uw_satz_1of3_.uw_wert_nv_4of4_ ed_fsp_9of20_.uw_satz_2of3_.uw_km_stand_nv ed_fsp_9of20_.uw_satz_2of3_.uw_wert_nv_1of4_ ed_fsp_9of20_.uw_satz_2of3_.uw_wert_nv_2of4_ ed_fsp_9of20_.uw_satz_2of3_.uw_wert_nv_3of4_ ed_fsp_9of20_.uw_satz_2of3_.uw_wert_nv_4of4_ ed_fsp_9of20_.uw_satz_3of3_.uw_km_stand_nv ed_fsp_9of20_.uw_satz_3of3_.uw_wert_nv_1of4_ ed_fsp_9of20_.uw_satz_3of3_.uw_wert_nv_2of4_ ed_fsp_9of20_.uw_satz_3of3_.uw_wert_nv_3of4_ ed_fsp_9of20_.uw_satz_3of3_.uw_wert_nv_4of4_ ed_loeschen ed_mil_bmw_ign ed_mil_bmw_inj ed_mil_dme_ign ed_mil_dme_inj ed_mil_on_km_stand_nv ed_mil_predrive_ign ed_mil_predrive_inj ed_mil_smg_ign ed_mil_st_ign ed_mil_st_inj ed_mil_zyl_off_ign ed_rbm_afz_hs.denominator_nv ed_rbm_afz_hs.numerator_nv ed_rbm_appl_data_ign.denominator_nv ed_rbm_appl_data_ign.numerator_nv ed_rbm_auss_abg_mult.denominator_nv ed_rbm_auss_abg_mult.numerator_nv ed_rbm_auss_abg_z1.denominator_nv ed_rbm_auss_abg_z1.numerator_nv ed_rbm_auss_abg_z10.denominator_nv ed_rbm_auss_abg_z10.numerator_nv ed_rbm_auss_abg_z2.denominator_nv ed_rbm_auss_abg_z2.numerator_nv ed_rbm_auss_abg_z3.denominator_nv ed_rbm_auss_abg_z3.numerator_nv ed_rbm_auss_abg_z4.denominator_nv ed_rbm_auss_abg_z4.numerator_nv ed_rbm_auss_abg_z5.denominator_nv ed_rbm_auss_abg_z5.numerator_nv ed_rbm_auss_abg_z6.denominator_nv ed_rbm_auss_abg_z6.numerator_nv ed_rbm_auss_abg_z7.denominator_nv ed_rbm_auss_abg_z7.numerator_nv ed_rbm_auss_abg_z8.denominator_nv ed_rbm_auss_abg_z8.numerator_nv ed_rbm_auss_abg_z9.denominator_nv ed_rbm_auss_abg_z9.numerator_nv ed_rbm_auss_kat_mult.denominator_nv ed_rbm_auss_kat_mult.numerator_nv ed_rbm_auss_kat_z1.denominator_nv ed_rbm_auss_kat_z1.numerator_nv ed_rbm_auss_kat_z10.denominator_nv ed_rbm_auss_kat_z10.numerator_nv ed_rbm_auss_kat_z2.denominator_nv ed_rbm_auss_kat_z2.numerator_nv ed_rbm_auss_kat_z3.denominator_nv ed_rbm_auss_kat_z3.numerator_nv ed_rbm_auss_kat_z4.denominator_nv ed_rbm_auss_kat_z4.numerator_nv ed_rbm_auss_kat_z5.denominator_nv ed_rbm_auss_kat_z5.numerator_nv ed_rbm_auss_kat_z6.denominator_nv ed_rbm_auss_kat_z6.numerator_nv ed_rbm_auss_kat_z7.denominator_nv ed_rbm_auss_kat_z7.numerator_nv ed_rbm_auss_kat_z8.denominator_nv ed_rbm_auss_kat_z8.numerator_nv ed_rbm_auss_kat_z9.denominator_nv ed_rbm_auss_kat_z9.numerator_nv ed_rbm_bls_plau.denominator_nv ed_rbm_bls_plau.numerator_nv ed_rbm_denominator_nv ed_rbm_dk_init.denominator_nv ed_rbm_dk_init.numerator_nv ed_rbm_dk1_adapt.denominator_nv ed_rbm_dk1_adapt.numerator_nv ed_rbm_dk1_can.denominator_nv ed_rbm_dk1_can.numerator_nv ed_rbm_dk1_cmd.denominator_nv ed_rbm_dk1_cmd.numerator_nv ed_rbm_dk1_federn.denominator_nv ed_rbm_dk1_federn.numerator_nv ed_rbm_dk1_pdr.denominator_nv ed_rbm_dk1_pdr.numerator_nv ed_rbm_dk1_regler.denominator_nv ed_rbm_dk1_regler.numerator_nv ed_rbm_dk1_sk_err.denominator_nv ed_rbm_dk1_sk_err.numerator_nv ed_rbm_dk1_wdk.denominator_nv ed_rbm_dk1_wdk.numerator_nv ed_rbm_dk1_zust.denominator_nv ed_rbm_dk1_zust.numerator_nv ed_rbm_dk2_adapt.denominator_nv ed_rbm_dk2_adapt.numerator_nv ed_rbm_dk2_can.denominator_nv ed_rbm_dk2_can.numerator_nv ed_rbm_dk2_cmd.denominator_nv ed_rbm_dk2_cmd.numerator_nv ed_rbm_dk2_federn.denominator_nv ed_rbm_dk2_federn.numerator_nv ed_rbm_dk2_pdr.denominator_nv ed_rbm_dk2_pdr.numerator_nv ed_rbm_dk2_regler.denominator_nv ed_rbm_dk2_regler.numerator_nv ed_rbm_dk2_sk_err.denominator_nv ed_rbm_dk2_sk_err.numerator_nv ed_rbm_dk2_wdk.denominator_nv ed_rbm_dk2_wdk.numerator_nv ed_rbm_dk2_zust.denominator_nv ed_rbm_dk2_zust.numerator_nv ed_rbm_dkg_eingr.denominator_nv ed_rbm_dkg_eingr.numerator_nv ed_rbm_dsc_eingr.denominator_nv ed_rbm_dsc_eingr.numerator_nv ed_rbm_e2_ign.denominator_nv ed_rbm_e2_ign.numerator_nv ed_rbm_ec_busoff.denominator_nv ed_rbm_ec_busoff.numerator_nv ed_rbm_fgr_abwurf.denominator_nv ed_rbm_fgr_abwurf.numerator_nv ed_rbm_index_121_ign.denominator_nv ed_rbm_index_121_ign.numerator_nv ed_rbm_index_122_ign.denominator_nv ed_rbm_index_122_ign.numerator_nv ed_rbm_index_123_ign.denominator_nv ed_rbm_index_123_ign.numerator_nv ed_rbm_index_124_ign.denominator_nv ed_rbm_index_124_ign.numerator_nv ed_rbm_index_125_ign.denominator_nv ed_rbm_index_125_ign.numerator_nv ed_rbm_index_126_ign.denominator_nv ed_rbm_index_126_ign.numerator_nv ed_rbm_index_127_ign.denominator_nv ed_rbm_index_127_ign.numerator_nv ed_rbm_index_33_ign.denominator_nv ed_rbm_index_33_ign.numerator_nv ed_rbm_index_34_ign.denominator_nv ed_rbm_index_34_ign.numerator_nv ed_rbm_index_35_ign.denominator_nv ed_rbm_index_35_ign.numerator_nv ed_rbm_index_36_ign.denominator_nv ed_rbm_index_36_ign.numerator_nv ed_rbm_index_71_ign.denominator_nv ed_rbm_index_71_ign.numerator_nv ed_rbm_index_72_ign.denominator_nv ed_rbm_index_72_ign.numerator_nv ed_rbm_index_84_ign.denominator_nv ed_rbm_index_84_ign.numerator_nv ed_rbm_index_85_ign.denominator_nv ed_rbm_index_85_ign.numerator_nv ed_rbm_llr_diag.denominator_nv ed_rbm_llr_diag.numerator_nv ed_rbm_llr_diag_css.denominator_nv ed_rbm_llr_diag_css.numerator_nv ed_rbm_lls_init.denominator_nv ed_rbm_lls_init.numerator_nv ed_rbm_lls1_can.denominator_nv ed_rbm_lls1_can.numerator_nv ed_rbm_lls1_cmd.denominator_nv ed_rbm_lls1_cmd.numerator_nv ed_rbm_lls1_regler.denominator_nv ed_rbm_lls1_regler.numerator_nv ed_rbm_lls1_sk.denominator_nv ed_rbm_lls1_sk.numerator_nv ed_rbm_lls2_can.denominator_nv ed_rbm_lls2_can.numerator_nv ed_rbm_lls2_cmd.denominator_nv ed_rbm_lls2_cmd.numerator_nv ed_rbm_lls2_regler.denominator_nv ed_rbm_lls2_regler.numerator_nv ed_rbm_lls2_sk.denominator_nv ed_rbm_lls2_sk.numerator_nv ed_rbm_m_spule_z1.denominator_nv ed_rbm_m_spule_z1.numerator_nv ed_rbm_m_spule_z10.denominator_nv ed_rbm_m_spule_z10.numerator_nv ed_rbm_m_spule_z2.denominator_nv ed_rbm_m_spule_z2.numerator_nv ed_rbm_m_spule_z3.denominator_nv ed_rbm_m_spule_z3.numerator_nv ed_rbm_m_spule_z4.denominator_nv ed_rbm_m_spule_z4.numerator_nv ed_rbm_m_spule_z5.denominator_nv ed_rbm_m_spule_z5.numerator_nv ed_rbm_m_spule_z6.denominator_nv ed_rbm_m_spule_z6.numerator_nv ed_rbm_m_spule_z7.denominator_nv ed_rbm_m_spule_z7.numerator_nv ed_rbm_m_spule_z8.denominator_nv ed_rbm_m_spule_z8.numerator_nv ed_rbm_m_spule_z9.denominator_nv ed_rbm_m_spule_z9.numerator_nv ed_rbm_md_sk_err.denominator_nv ed_rbm_md_sk_err.numerator_nv ed_rbm_n_getr_ein_hs.denominator_nv ed_rbm_n_getr_ein_hs.numerator_nv ed_rbm_pctrl_ign.denominator_nv ed_rbm_pctrl_ign.numerator_nv ed_rbm_pwg_bls.denominator_nv ed_rbm_pwg_bls.numerator_nv ed_rbm_pwg_vgl.denominator_nv ed_rbm_pwg_vgl.numerator_nv ed_rbm_pwg1.denominator_nv ed_rbm_pwg1.numerator_nv ed_rbm_pwg2.denominator_nv ed_rbm_pwg2.numerator_nv ed_rbm_sc_busoff.denominator_nv ed_rbm_sc_busoff.numerator_nv ed_rbm_sc_pks.denominator_nv ed_rbm_sc_pks.numerator_nv ed_rbm_sc_smg1.denominator_nv ed_rbm_sc_smg1.numerator_nv ed_rbm_sc_smg2.denominator_nv ed_rbm_sc_smg2.numerator_nv ed_rbm_sc_smg3.denominator_nv ed_rbm_sc_smg3.numerator_nv ed_rbm_servo_i.denominator_nv ed_rbm_servo_i.numerator_nv ed_rbm_servo_v.denominator_nv ed_rbm_servo_v.numerator_nv ed_rbm_sg_ign.denominator_nv ed_rbm_sg_ign.numerator_nv ed_rbm_sk_manager_ign.denominator_nv ed_rbm_sk_manager_ign.numerator_nv ed_rbm_sk_tr_ign.denominator_nv ed_rbm_sk_tr_ign.numerator_nv ed_rbm_smg_schaltab.denominator_nv ed_rbm_smg_schaltab.numerator_nv ed_rbm_smg_sk.denominator_nv ed_rbm_smg_sk.numerator_nv ed_rbm_smg_sk_n.denominator_nv ed_rbm_smg_sk_n.numerator_nv ed_rbm_start_rl.denominator_nv ed_rbm_start_rl.numerator_nv ed_rbm_tabg1.denominator_nv ed_rbm_tabg1.numerator_nv ed_rbm_tabg2.denominator_nv ed_rbm_tabg2.numerator_nv ed_rbm_tan_obd_b1.denominator_nv ed_rbm_tan_obd_b1.numerator_nv ed_rbm_tan_obd_b2.denominator_nv ed_rbm_tan_obd_b2.numerator_nv ed_rbm_tan1.denominator_nv ed_rbm_tan1.numerator_nv ed_rbm_tan2.denominator_nv ed_rbm_tan2.numerator_nv ed_rbm_tdme.denominator_nv ed_rbm_tdme.numerator_nv ed_rbm_thermostat.denominator_nv ed_rbm_thermostat.numerator_nv ed_rbm_time ed_rbm_time_ll ed_rbm_time_rel_obd.denominator_nv ed_rbm_time_rel_obd.numerator_nv ed_rbm_time_v ed_rbm_tka.denominator_nv ed_rbm_tka.numerator_nv ed_rbm_tka_obd.denominator_nv ed_rbm_tka_obd.numerator_nv ed_rbm_tmot.denominator_nv ed_rbm_tmot.numerator_nv ed_rbm_tmot_obd.denominator_nv ed_rbm_tmot_obd.numerator_nv ed_rbm_tmot_obd_high.denominator_nv ed_rbm_tmot_obd_high.numerator_nv ed_rbm_tumg.denominator_nv ed_rbm_tumg.numerator_nv ed_rbm_tumg_obd.denominator_nv ed_rbm_tumg_obd.numerator_nv ed_rbm_ub.denominator_nv ed_rbm_ub.numerator_nv ed_rbm_uext_111219514.denominator_nv ed_rbm_uext_111219514.numerator_nv ed_rbm_uext_124_512.denominator_nv ed_rbm_uext_124_512.numerator_nv ed_rbm_v_direkt.denominator_nv ed_rbm_v_direkt.numerator_nv ed_rbm_zoelp1.denominator_nv ed_rbm_zoelp1.numerator_nv ed_rbm_zoelp2.denominator_nv ed_rbm_zoelp2.numerator_nv ed_scdn_st_nv ed_st_fehler_ign ed_st_fehler_inj ed_st_filter_ign ed_st_filter_inj ed_st_nv ed_st_nv_css_den ed_st_nv_css_num ed_st_nv_rbm_abbruch ed_st_nv_rbm_dcy ed_st_nv_rbm_evap ed_st_nv_rbm_slp ed_st_nv_wuc /end OUT_MEASUREMENT
/end FUNCTION
/begin RECORD_LAYOUT TKW_VV_VV_UB FNC_VALUES 1 UBYTE COLUMN_DIR DIRECT /end RECORD_LAYOUT
/begin RECORD_LAYOUT TKW_VV_VV_UW FNC_VALUES 1 UWORD COLUMN_DIR DIRECT /end RECORD_LAYOUT
/end MODULE
/end PROJECT
