ASAP2_VERSION 1 3
/begin PROJECT P390 "BMW DDE6.2 6-Zylinder VR0.1 15.03.2004 CAN11/12H"
/begin HEADER "" VERSION "VR0.1_6Z_CAN11/12H" PROJECT_NO P390 /end HEADER
/begin MODULE DIM ""
/begin MOD_COMMON "" BYTE_ORDER MSB_FIRST ALIGNMENT_BYTE 1 ALIGNMENT_WORD 2 ALIGNMENT_LONG 4 ALIGNMENT_FLOAT32_IEEE 4 /end MOD_COMMON
/begin MEASUREMENT St_sleep.B_sleepwait "Signal Verzoegerung Sleep Indication" UBYTE Def_bit_ub_0 0 0 0.0 255.0 ECU_ADDRESS 0x007FBBE0 /begin FUNCTION_LIST KT_IBS /end FUNCTION_LIST BIT_MASK 0x1 /end MEASUREMENT
/begin MEASUREMENT St_sleep "Statuswort Einschlafverhalten" UBYTE Def_st_ub_q1 0 0 0.0 255.0000 ECU_ADDRESS 0x007FBBE0 /begin FUNCTION_LIST KT_IBS /end FUNCTION_LIST /end MEASUREMENT
/begin MEASUREMENT St_ibsreg4.B_startfgk "Bedingung Startfähigkeit gefährdet" UBYTE Def_bit_ub_0 0 0 0.0 255.0 ECU_ADDRESS 0x0080042C /begin FUNCTION_LIST KT_IBS /end FUNCTION_LIST BIT_MASK 0x1 /end MEASUREMENT
/begin MEASUREMENT St_ibsreg4.B_strtaw "Bedingung Startauswertung gerechnet" UBYTE Def_bit_ub_1 0 0 0.0 255.0 ECU_ADDRESS 0x0080042C /begin FUNCTION_LIST KT_IBS /end FUNCTION_LIST BIT_MASK 0x2 /end MEASUREMENT
/begin MEASUREMENT St_ibsreg4.B_ibspwf "Bedingung IBS powerfail erkannt" UBYTE Def_bit_ub_4 0 0 0.0 255.0 ECU_ADDRESS 0x0080042C /begin FUNCTION_LIST KT_IBS /end FUNCTION_LIST BIT_MASK 0x10 /end MEASUREMENT
/begin MEASUREMENT St_ibsreg4.B_tiefset "Bedingung Tiefentladung" UBYTE Def_bit_ub_5 0 0 0.0 255.0 ECU_ADDRESS 0x0080042C /begin FUNCTION_LIST KT_IBS /end FUNCTION_LIST BIT_MASK 0x20 /end MEASUREMENT
/begin MEASUREMENT St_ibsreg4 "Statuswort ibsreg4" UBYTE Def_st_ub_q1 0 0 0.0 255.0000 ECU_ADDRESS 0x0080042C /begin FUNCTION_LIST KT_IBS /end FUNCTION_LIST /end MEASUREMENT
/begin MEASUREMENT St_ibsreg5.B_fsclr "Bedingung IBS interne Fehler loeschen" UBYTE Def_bit_ub_3 0 0 0.0 255.0 ECU_ADDRESS 0x0080042D /begin FUNCTION_LIST KT_IBS /end FUNCTION_LIST BIT_MASK 0x8 /end MEASUREMENT
/begin MEASUREMENT St_ibsreg5 "Statuswort ibsreg5" UBYTE Def_st_ub_q1 0 0 0.0 255.0000 ECU_ADDRESS 0x0080042D /begin FUNCTION_LIST KT_IBS /end FUNCTION_LIST /end MEASUREMENT
/begin MEASUREMENT Ibs_reg5 "IBS Register 5 Var.not used: now St_ibsreg5" UBYTE Def_dez_ub_q1 0 0 0.0 255.0000 ECU_ADDRESS 0x0080042E /begin FUNCTION_LIST KT_IBS /end FUNCTION_LIST /end MEASUREMENT
/begin MEASUREMENT Ibs_errors "Fehler Reg. aus IBS gelesen" UBYTE Def_dez_ub_q1 0 0 0.0 255.0000 ECU_ADDRESS 0x0080042F /begin FUNCTION_LIST KT_IBS /end FUNCTION_LIST /end MEASUREMENT
/begin MEASUREMENT Ibs_msgind "Index auf EBSD Botschaft" UBYTE Def_dez_ub_q1 0 0 0.0 255.0000 ECU_ADDRESS 0x00800430 /begin FUNCTION_LIST KT_IBS /end FUNCTION_LIST /end MEASUREMENT
/begin MEASUREMENT Ibs_msgsta "EBSD Fehler Status" UBYTE Def_dez_ub_q1 0 0 0.0 255.0000 ECU_ADDRESS 0x00800431 /begin FUNCTION_LIST KT_IBS /end FUNCTION_LIST /end MEASUREMENT
/begin MEASUREMENT Kt_ibsstatus "Status BSD Statemachine" UBYTE Def_dez_ub_q1 0 0 0.0 255.0000 ECU_ADDRESS 0x00800432 /begin FUNCTION_LIST KT_IBS /end FUNCTION_LIST /end MEASUREMENT
/begin MEASUREMENT Ibs_start "Status Statemachine Startup Kommunikation" UBYTE Def_dez_ub_q1 0 0 0.0 255.0000 ECU_ADDRESS 0x00800433 /begin FUNCTION_LIST KT_IBS /end FUNCTION_LIST /end MEASUREMENT
/begin MEASUREMENT Comcontrol "Kontrolle Diagnose Modul DIBS" UBYTE Def_dez_ub_q1 0 0 0.0 255.0000 ECU_ADDRESS 0x00800434 /begin FUNCTION_LIST KT_IBS /end FUNCTION_LIST /end MEASUREMENT
/begin MEASUREMENT St_ibebsd1.B_ibs_msgrdy "Bedingung EBSD Botschaft von IBS empfangen" UBYTE Def_bit_ub_0 0 0 0.0 255.0 ECU_ADDRESS 0x00800435 /begin FUNCTION_LIST KT_IBS /end FUNCTION_LIST BIT_MASK 0x1 /end MEASUREMENT
/begin MEASUREMENT St_ibebsd1.B_ibs_msgwri "Bedingung EBSD Übertragungsrichtung schreiben" UBYTE Def_bit_ub_1 0 0 0.0 255.0 ECU_ADDRESS 0x00800435 /begin FUNCTION_LIST KT_IBS /end FUNCTION_LIST BIT_MASK 0x2 /end MEASUREMENT
/begin MEASUREMENT St_ibebsd1.B_eb_txok "Bedingung EBSD Übertragungsrichtung schreiben" UBYTE Def_bit_ub_2 0 0 0.0 255.0 ECU_ADDRESS 0x00800435 /begin FUNCTION_LIST KT_IBS /end FUNCTION_LIST BIT_MASK 0x4 /end MEASUREMENT
/begin MEASUREMENT St_ibebsd1.B_eb_busy "Bedingung EBSD Übertragungsrichtung schreiben" UBYTE Def_bit_ub_3 0 0 0.0 255.0 ECU_ADDRESS 0x00800435 /begin FUNCTION_LIST KT_IBS /end FUNCTION_LIST BIT_MASK 0x8 /end MEASUREMENT
/begin MEASUREMENT St_ibebsd1 "Statuswort ibebsd1" UBYTE Def_st_ub_q1 0 0 0.0 255.0000 ECU_ADDRESS 0x00800435 /begin FUNCTION_LIST KT_IBS /end FUNCTION_LIST /end MEASUREMENT
/begin MEASUREMENT St_ibserr.B_ibfbsd "Bedingung BSD Fehler" UBYTE Def_bit_ub_0 0 0 0.0 255.0 ECU_ADDRESS 0x00800436 /begin FUNCTION_LIST KT_IBS /end FUNCTION_LIST BIT_MASK 0x1 /end MEASUREMENT
/begin MEASUREMENT St_ibserr.B_ibfebsd "Bedingung EBSD Fehler" UBYTE Def_bit_ub_1 0 0 0.0 255.0 ECU_ADDRESS 0x00800436 /begin FUNCTION_LIST KT_IBS /end FUNCTION_LIST BIT_MASK 0x2 /end MEASUREMENT
/begin MEASUREMENT St_ibserr.B_ibunplau "Bedingung IBS Version unplausibel" UBYTE Def_bit_ub_2 0 0 0.0 255.0 ECU_ADDRESS 0x00800436 /begin FUNCTION_LIST KT_IBS /end FUNCTION_LIST BIT_MASK 0x4 /end MEASUREMENT
/begin MEASUREMENT St_ibserr "Statuswort ibserr" UBYTE Def_st_ub_q1 0 0 0.0 255.0000 ECU_ADDRESS 0x00800436 /begin FUNCTION_LIST KT_IBS /end FUNCTION_LIST /end MEASUREMENT
/begin MEASUREMENT St_ibmix.B_ibrhilo "toggle Bit Register0/ 1 hi- od. lo byte" UBYTE Def_bit_ub_0 0 0 0.0 255.0 ECU_ADDRESS 0x00800437 /begin FUNCTION_LIST KT_IBS /end FUNCTION_LIST BIT_MASK 0x1 /end MEASUREMENT
/begin MEASUREMENT St_ibmix.B_ibttog "global toggle bit" UBYTE Def_bit_ub_1 0 0 0.0 255.0 ECU_ADDRESS 0x00800437 /begin FUNCTION_LIST KT_IBS /end FUNCTION_LIST BIT_MASK 0x2 /end MEASUREMENT
/begin MEASUREMENT St_ibmix "Statuswort ibmix" UBYTE Def_st_ub_q1 0 0 0.0 255.0000 ECU_ADDRESS 0x00800437 /begin FUNCTION_LIST KT_IBS /end FUNCTION_LIST /end MEASUREMENT
/begin MEASUREMENT Ibswbase "IBS Software Baseline" UBYTE Def_dez_ub_q1 0 0 0.0 255.0000 ECU_ADDRESS 0x00800438 /begin FUNCTION_LIST KT_IBS /end FUNCTION_LIST /end MEASUREMENT
/begin MEASUREMENT Ibswchang "IBS Software Änderungs Status" UBYTE Def_dez_ub_q1 0 0 0.0 255.0000 ECU_ADDRESS 0x00800439 /begin FUNCTION_LIST KT_IBS /end FUNCTION_LIST /end MEASUREMENT
/begin MEASUREMENT Ibhwversi "IBS Hardware Version" UBYTE Def_dez_ub_q1 0 0 0.0 255.0000 ECU_ADDRESS 0x0080043A /begin FUNCTION_LIST KT_IBS /end FUNCTION_LIST /end MEASUREMENT
/begin MEASUREMENT Ib_parlen "Länge IBS Parameterliste" UBYTE Def_dez_ub_q1 0 0 0.0 255.0000 ECU_ADDRESS 0x0080043B /begin FUNCTION_LIST KT_IBS /end FUNCTION_LIST /end MEASUREMENT
/begin MEASUREMENT Ibsiicctri "IBS Fehlerzähler" UBYTE Def_dez_ub_q1 0 0 0.0 255.0000 ECU_ADDRESS 0x0080043C /begin FUNCTION_LIST KT_IBS /end FUNCTION_LIST /end MEASUREMENT
/begin MEASUREMENT Ibsbclctri "IBS Fehlerzähler" UBYTE Def_dez_ub_q1 0 0 0.0 255.0000 ECU_ADDRESS 0x0080043D /begin FUNCTION_LIST KT_IBS /end FUNCTION_LIST /end MEASUREMENT
/begin MEASUREMENT Ibseromctr "IBS Fehlerzähler" UBYTE Def_dez_ub_q1 0 0 0.0 255.0000 ECU_ADDRESS 0x0080043E /begin FUNCTION_LIST KT_IBS /end FUNCTION_LIST /end MEASUREMENT
/begin MEASUREMENT Ibsramctr "IBS Fehlerzähler" UBYTE Def_dez_ub_q1 0 0 0.0 255.0000 ECU_ADDRESS 0x0080043F /begin FUNCTION_LIST KT_IBS /end FUNCTION_LIST /end MEASUREMENT
/begin MEASUREMENT Ibspromctr "IBS Fehlerzähler" UBYTE Def_dez_ub_q1 0 0 0.0 255.0000 ECU_ADDRESS 0x00800440 /begin FUNCTION_LIST KT_IBS /end FUNCTION_LIST /end MEASUREMENT
/begin MEASUREMENT Ibsdncsctr "IBS Fehlerzähler download checksum" UBYTE Def_dez_ub_q1 0 0 0.0 255.0000 ECU_ADDRESS 0x00800441 /begin FUNCTION_LIST KT_IBS /end FUNCTION_LIST /end MEASUREMENT
/begin MEASUREMENT T_battsoci "T_battsoc0, Rohwert aus IBS" UBYTE Def_dez_ub_q1 0 0 0.0 255.0000 ECU_ADDRESS 0x00800442 /begin FUNCTION_LIST KT_IBS /end FUNCTION_LIST /end MEASUREMENT
/begin MEASUREMENT Tbatt_maxi "T_batt_max, Rohwert aus IBS" UBYTE Def_dez_ub_q1 0 0 0.0 255.0000 ECU_ADDRESS 0x00800443 /begin FUNCTION_LIST KT_IBS /end FUNCTION_LIST /end MEASUREMENT
/begin MEASUREMENT Tbatt_mini "T_batt_min, Rohwert aus IBS" UBYTE Def_dez_ub_q1 0 0 0.0 255.0000 ECU_ADDRESS 0x00800444 /begin FUNCTION_LIST KT_IBS /end FUNCTION_LIST /end MEASUREMENT
/begin MEASUREMENT Ibslvdctr "IBS Fehlerzähler" UWORD Def_dez_uw_q1 0 0 0.0 65535.0000 ECU_ADDRESS 0x008003E4 /begin FUNCTION_LIST KT_IBS /end FUNCTION_LIST /end MEASUREMENT
/begin MEASUREMENT I_batt "Batteriestrom von IBS gemessen" UWORD Def_i_uw_q0p08_o200 0 0 -200.0000 5042.8000 ECU_ADDRESS 0x008003E6 /begin FUNCTION_LIST KT_IBS /end FUNCTION_LIST /end MEASUREMENT
/begin MEASUREMENT U_batt "Batteriespannung von IBS gemessen" UWORD Def_u_uw_q0p25em3_o6 0 0 6.0000 22.3837 ECU_ADDRESS 0x008003E8 /begin FUNCTION_LIST KT_IBS /end FUNCTION_LIST /end MEASUREMENT
/begin MEASUREMENT Ibsborctr "IBS Fehlerzähler" UWORD Def_dez_uw_q1 0 0 0.0 65535.0000 ECU_ADDRESS 0x008003EA /begin FUNCTION_LIST KT_IBS /end FUNCTION_LIST /end MEASUREMENT
/begin MEASUREMENT Ibswdtctr "IBS Fehlerzähler watchdog" UWORD Def_dez_uw_q1 0 0 0.0 65535.0000 ECU_ADDRESS 0x008003EC /begin FUNCTION_LIST KT_IBS /end FUNCTION_LIST /end MEASUREMENT
/begin MEASUREMENT Ibsporctr "IBS Fehlerzähler power on" UWORD Def_dez_uw_q1 0 0 0.0 65535.0000 ECU_ADDRESS 0x008003EE /begin FUNCTION_LIST KT_IBS /end FUNCTION_LIST /end MEASUREMENT
/begin MEASUREMENT Ibsptyctr "IBS Fehlerzähler BSD parity" UWORD Def_dez_uw_q1 0 0 0.0 65535.0000 ECU_ADDRESS 0x008003F0 /begin FUNCTION_LIST KT_IBS /end FUNCTION_LIST /end MEASUREMENT
/begin MEASUREMENT Qlad "Delta Batterieladung" UWORD Def_ql_uw_q0p0182 0 0 0.0 1192.7502 ECU_ADDRESS 0x008003F2 /begin FUNCTION_LIST KT_IBS /end FUNCTION_LIST /end MEASUREMENT
/begin MEASUREMENT Qelad "Delta Batterieentladung" UWORD Def_ql_uw_q0p0182 0 0 0.0 1192.7502 ECU_ADDRESS 0x008003F4 /begin FUNCTION_LIST KT_IBS /end FUNCTION_LIST /end MEASUREMENT
/begin MEASUREMENT I_soc0 "Strom bei Ruhespannungsmessung" SWORD Def_i_sw_q0p02 0 0 -655.3600 655.3400 ECU_ADDRESS 0x008003F6 /begin FUNCTION_LIST KT_IBS /end FUNCTION_LIST /end MEASUREMENT
/begin MEASUREMENT T_battsoc0 "Batterietemperatur bei Ruhespannungsmessung" SWORD Def_t_sw_q0p1 0 0 -3276.8000 3276.7000 ECU_ADDRESS 0x008003F8 /begin FUNCTION_LIST KT_IBS /end FUNCTION_LIST /end MEASUREMENT
/begin MEASUREMENT U1soc0 "Ruhespannung 1" UWORD Def_u_uw_q0p25em3_o6 0 0 6.0000 22.3837 ECU_ADDRESS 0x008003FA /begin FUNCTION_LIST KT_IBS /end FUNCTION_LIST /end MEASUREMENT
/begin MEASUREMENT U2soc0 "Ruhespannung 1" UWORD Def_u_uw_q0p25em3_o6 0 0 6.0000 22.3837 ECU_ADDRESS 0x008003FC /begin FUNCTION_LIST KT_IBS /end FUNCTION_LIST /end MEASUREMENT
/begin MEASUREMENT U3soc0 "Ruhespannung 1" UWORD Def_u_uw_q0p25em3_o6 0 0 6.0000 22.3837 ECU_ADDRESS 0x008003FE /begin FUNCTION_LIST KT_IBS /end FUNCTION_LIST /end MEASUREMENT
/begin MEASUREMENT Qladsoc0 "Ladung bei Ruhespannungsmessung" UWORD Def_ql_uw_q0p0182 0 0 0.0 1192.7502 ECU_ADDRESS 0x00800400 /begin FUNCTION_LIST KT_IBS /end FUNCTION_LIST /end MEASUREMENT
/begin MEASUREMENT Qeladsoc0 "Entladung bei Ruhespannungsmessung" UWORD Def_ql_uw_q0p0182 0 0 0.0 1192.7502 ECU_ADDRESS 0x00800402 /begin FUNCTION_LIST KT_IBS /end FUNCTION_LIST /end MEASUREMENT
/begin MEASUREMENT U_vorstart "Spannung vor Start" UWORD Def_u_uw_q0p25em3_o6 0 0 6.0000 22.3837 ECU_ADDRESS 0x00800404 /begin FUNCTION_LIST KT_IBS /end FUNCTION_LIST /end MEASUREMENT
/begin MEASUREMENT U_tnstart "Spannung im Start" UWORD Def_u_uw_q0p25em3_o6 0 0 6.0000 22.3837 ECU_ADDRESS 0x00800406 /begin FUNCTION_LIST KT_IBS /end FUNCTION_LIST /end MEASUREMENT
/begin MEASUREMENT I_vorstart "Batteriestrom vor Start" UWORD Def_i_uw_q0p02_o200 0 0 -200.0000 1110.7000 ECU_ADDRESS 0x00800408 /begin FUNCTION_LIST KT_IBS /end FUNCTION_LIST /end MEASUREMENT
/begin MEASUREMENT I_tnstart "Batteriestrom im Start" UWORD Def_i_uw_q0p02 0 0 0.0 1310.7000 ECU_ADDRESS 0x0080040A /begin FUNCTION_LIST KT_IBS /end FUNCTION_LIST /end MEASUREMENT
/begin MEASUREMENT T1histiruh "Ruhestromhistogramm Klasse 1" UWORD Def_dez_uw_q1 0 0 0.0 65535.0000 ECU_ADDRESS 0x0080040C /begin FUNCTION_LIST KT_IBS /end FUNCTION_LIST /end MEASUREMENT
/begin MEASUREMENT T2histiruh "Ruhestromhistogramm Klasse 2" UWORD Def_dez_uw_q1 0 0 0.0 65535.0000 ECU_ADDRESS 0x0080040E /begin FUNCTION_LIST KT_IBS /end FUNCTION_LIST /end MEASUREMENT
/begin MEASUREMENT T3histiruh "Ruhestromhistogramm Klasse 3" UWORD Def_dez_uw_q1 0 0 0.0 65535.0000 ECU_ADDRESS 0x00800410 /begin FUNCTION_LIST KT_IBS /end FUNCTION_LIST /end MEASUREMENT
/begin MEASUREMENT T4histiruh "Ruhestromhistogramm Klasse 4" UWORD Def_dez_uw_q1 0 0 0.0 65535.0000 ECU_ADDRESS 0x00800412 /begin FUNCTION_LIST KT_IBS /end FUNCTION_LIST /end MEASUREMENT
/begin MEASUREMENT T_batt_ibs "Batterietemperatur" SWORD Def_t_sw_q0p1 0 0 -3276.8000 3276.7000 ECU_ADDRESS 0x00800414 /begin FUNCTION_LIST KT_IBS /end FUNCTION_LIST /end MEASUREMENT
/begin MEASUREMENT T_batt_max "Maximale Batt. Temperatur bei Stillstand" SWORD Def_t_sw_q0p1 0 0 -3276.8000 3276.7000 ECU_ADDRESS 0x00800416 /begin FUNCTION_LIST KT_IBS /end FUNCTION_LIST /end MEASUREMENT
/begin MEASUREMENT T_batt_min "Minimale Batt. Temperatur bei Stillstand" SWORD Def_t_sw_q0p1 0 0 -3276.8000 3276.7000 ECU_ADDRESS 0x00800418 /begin FUNCTION_LIST KT_IBS /end FUNCTION_LIST /end MEASUREMENT
/begin MEASUREMENT Ktupcsctr "kt_ibs Fehlerzähler EBSD Checksumme" UWORD Def_dez_uw_q1 0 0 0.0 65535.0000 ECU_ADDRESS 0x0080041A /begin FUNCTION_LIST KT_IBS /end FUNCTION_LIST /end MEASUREMENT
/begin MEASUREMENT Zbibs "Zusbaunummer" ULONG Def_dez_ul_q1 0 0 0.0 2147483647.0000 ECU_ADDRESS 0x008003D8 /begin FUNCTION_LIST KT_IBS /end FUNCTION_LIST /end MEASUREMENT
/begin MEASUREMENT Snibs "Seriennummer" ULONG Def_dez_ul_q1 0 0 0.0 2147483647.0000 ECU_ADDRESS 0x008003DC /begin FUNCTION_LIST KT_IBS /end FUNCTION_LIST /end MEASUREMENT
/begin MEASUREMENT Ebsd_varin "Index EBSD Variable" UBYTE Def_dez_ub_q1 0 0 0.0 255.0000 ECU_ADDRESS 0x00800445 /begin FUNCTION_LIST KT_IBS /end FUNCTION_LIST /end MEASUREMENT
/begin MEASUREMENT Ebsd_nbyt "Länge EBSD Variable" UBYTE Def_dez_ub_q1 0 0 0.0 255.0000 ECU_ADDRESS 0x00800446 /begin FUNCTION_LIST KT_IBS /end FUNCTION_LIST /end MEASUREMENT
/begin MEASUREMENT Unind "EBSD Puffer Index" UBYTE Def_dez_ub_q1 0 0 0.0 255.0000 ECU_ADDRESS 0x00800447 /begin FUNCTION_LIST KT_IBS /end FUNCTION_LIST /end MEASUREMENT
/begin MEASUREMENT Ebsd_adr "EBSD Adresse im IBS" UBYTE Def_dez_ub_q1 0 0 0.0 255.0000 ECU_ADDRESS 0x00800448 /begin FUNCTION_LIST KT_IBS /end FUNCTION_LIST /end MEASUREMENT
/begin MEASUREMENT Ebsd_errdir "EBSD Übertragungsrichtung bei Fehler" UBYTE Def_dez_ub_q1 0 0 0.0 255.0000 ECU_ADDRESS 0x00800449 /begin FUNCTION_LIST KT_IBS /end FUNCTION_LIST /end MEASUREMENT
/begin MEASUREMENT Ebsd_errin "EBSD Index bei Fehler" UBYTE Def_dez_ub_q1 0 0 0.0 255.0000 ECU_ADDRESS 0x0080044A /begin FUNCTION_LIST KT_IBS /end FUNCTION_LIST /end MEASUREMENT
/begin MEASUREMENT Ebsd_errep "EBSD Fehler repeat timer" UBYTE Def_dez_ub_q1 0 0 0.0 255.0000 ECU_ADDRESS 0x0080044B /begin FUNCTION_LIST KT_IBS /end FUNCTION_LIST /end MEASUREMENT
/begin MEASUREMENT Ebsd_timo "EBSD Fehler timeout counter" UBYTE Def_dez_ub_q1 0 0 0.0 255.0000 ECU_ADDRESS 0x0080044C /begin FUNCTION_LIST KT_IBS /end FUNCTION_LIST /end MEASUREMENT
/begin MEASUREMENT R5cyctim "Timer f. zyklisches Senden IBS Reg. 5" UBYTE Def_dez_ub_q1 0 0 0.0 255.0000 ECU_ADDRESS 0x0080044D /begin FUNCTION_LIST KT_IBS /end FUNCTION_LIST /end MEASUREMENT
/begin MEASUREMENT Fsclctr "Hilfszaehler IBS Fehler loeschen" UBYTE Def_dez_ub_q1 0 0 0.0 255.0000 ECU_ADDRESS 0x0080044E /begin FUNCTION_LIST KT_IBS /end FUNCTION_LIST /end MEASUREMENT
/begin MEASUREMENT Ktib_chk16 "Checksumme EBSD Übertragung intern" UWORD Def_dez_uw_q1 0 0 0.0 65535.0000 ECU_ADDRESS 0x0080041C /begin FUNCTION_LIST KT_IBS /end FUNCTION_LIST /end MEASUREMENT
/begin MEASUREMENT Ib_chk16 "Checksumme EBSD Übertragung aus IBS" UWORD Def_dez_uw_q1 0 0 0.0 65535.0000 ECU_ADDRESS 0x0080041E /begin FUNCTION_LIST KT_IBS /end FUNCTION_LIST /end MEASUREMENT
/begin MEASUREMENT Chk16_ibs "Checksumme Parameter aus IBS" UWORD Def_dez_uw_q1 0 0 0.0 65535.0000 ECU_ADDRESS 0x00800420 /begin FUNCTION_LIST KT_IBS /end FUNCTION_LIST /end MEASUREMENT
/begin MEASUREMENT Chkpara "Checksumme Parameter intern" UWORD Def_dez_uw_q1 0 0 0.0 65535.0000 ECU_ADDRESS 0x00800422 /begin FUNCTION_LIST KT_IBS /end FUNCTION_LIST /end MEASUREMENT
/begin MEASUREMENT Acfzgl "Fahrzeuglängsbeschleunigung" SBYTE Def_ac_sb_q0p25 0 0 -32.0000 31.7500 ECU_ADDRESS 0x007FBC26 /begin FUNCTION_LIST LAYER /end FUNCTION_LIST /end MEASUREMENT
/begin MEASUREMENT Acfzgq "Fahrzeugquerbeschleunigung" SBYTE Def_ac_sb_q0p25 0 0 -32.0000 31.7500 ECU_ADDRESS 0x007FBC27 /begin FUNCTION_LIST LAYER /end FUNCTION_LIST /end MEASUREMENT
/begin MEASUREMENT Batt_coort "codierter Batterieeinbauort" UBYTE Def_dez_ub_q1 0 0 0.0 255.0000 ECU_ADDRESS 0x007FBC28 /begin FUNCTION_LIST LAYER /end FUNCTION_LIST /end MEASUREMENT
/begin MEASUREMENT Bordnetz "ausgewähltes Bordnetz(0x01 => CAN11H, 0x02 => CAN12H(BN2000))" UBYTE Def_st_ub_q1 0 0 0.0 255.0000 ECU_ADDRESS 0x007FBC29 /begin FUNCTION_LIST LAYER /end FUNCTION_LIST /end MEASUREMENT
/begin MEASUREMENT Bosbtvfbkt "Verfügbarkeit vom Tester" UBYTE Def_dez_ub_q1 0 0 0.0 255.0000 ECU_ADDRESS 0x007FBC2A /begin FUNCTION_LIST LAYER /end FUNCTION_LIST /end MEASUREMENT
/begin MEASUREMENT Bosjzielt "Zieltermin_Jahr vom Tester" UBYTE Def_dez_ub_q1 0 0 0.0 255.0000 ECU_ADDRESS 0x007FBC2B /begin FUNCTION_LIST LAYER /end FUNCTION_LIST /end MEASUREMENT
/begin MEASUREMENT Bosmzielt "Zieltermin_Monat vom Tester" UBYTE Def_dez_ub_q1 0 0 0.0 255.0000 ECU_ADDRESS 0x007FBC2C /begin FUNCTION_LIST LAYER /end FUNCTION_LIST /end MEASUREMENT
/begin MEASUREMENT Bosprog2t "Prognose_Intervall_Zeit vom Tester" UBYTE Def_dez_ub_q1 0 0 0.0 255.0000 ECU_ADDRESS 0x007FBC2D /begin FUNCTION_LIST LAYER /end FUNCTION_LIST /end MEASUREMENT
/begin MEASUREMENT Bosrlsmr "Restlaufstrecke Motoröl vom Kombi" SWORD Def_km_sw_q10 0 0 -327680.0000 327670.0000 ECU_ADDRESS 0x007FBC2E /begin FUNCTION_LIST LAYER /end FUNCTION_LIST /end MEASUREMENT
/begin MEASUREMENT Bosrlsmt "Restlaufstrecke Motoröl vom Tester" SWORD Def_km_sw_q10 0 0 -327680.0000 327670.0000 ECU_ADDRESS 0x007FBC30 /begin FUNCTION_LIST LAYER /end FUNCTION_LIST /end MEASUREMENT
/begin MEASUREMENT Bosrw2t "Prognose_Intervall_Weg vom Tester" UBYTE Def_km_ub_q1000 0 0 0.0 255000.0000 ECU_ADDRESS 0x007FBC32 /begin FUNCTION_LIST LAYER /end FUNCTION_LIST /end MEASUREMENT
/begin MEASUREMENT Bosv "Verfügbarkeit vom Kombi" UBYTE Def_dez_ub_q1 0 0 0.0 255.0000 ECU_ADDRESS 0x007FBC33 /begin FUNCTION_LIST LAYER /end FUNCTION_LIST /end MEASUREMENT
/begin MEASUREMENT Bsdcontrol "3 Byte Schnittstelle für kt_ibs" UBYTE Def_dez_ub_q1 0 0 0.0 255.0000 ECU_ADDRESS 0x007FBC34 /begin FUNCTION_LIST LAYER /end FUNCTION_LIST /end MEASUREMENT
/begin MEASUREMENT Bsddata "3 Byte Schnittstelle kt_ibs" UBYTE Def_dez_ub_q1 0 0 0.0 255.0000 ECU_ADDRESS 0x007FBC35 /begin FUNCTION_LIST LAYER /end FUNCTION_LIST /end MEASUREMENT
/begin MEASUREMENT Bsdgencv "Chipversion Generator 1" UBYTE Def_st_ub_q1 0 0 0.0 255.0000 ECU_ADDRESS 0x007FBC36 /begin FUNCTION_LIST LAYER /end FUNCTION_LIST /end MEASUREMENT
/begin MEASUREMENT Bsdgenregv "Reglerversion Generator 1" UBYTE Def_st_ub_q1 0 0 0.0 255.0000 ECU_ADDRESS 0x007FBC37 /begin FUNCTION_LIST LAYER /end FUNCTION_LIST /end MEASUREMENT
/begin MEASUREMENT Bsdregadr "3 Byte Schnittstelle für kt_ibs" UBYTE Def_dez_ub_q1 0 0 0.0 255.0000 ECU_ADDRESS 0x007FBC38 /begin FUNCTION_LIST LAYER /end FUNCTION_LIST /end MEASUREMENT
/begin MEASUREMENT Dfgrob "Grobwert Auslastungsgrad Generator 1" UBYTE Def_st_ub_q1 0 0 0.0 255.0000 ECU_ADDRESS 0x007FBC39 /begin FUNCTION_LIST LAYER /end FUNCTION_LIST /end MEASUREMENT
/begin MEASUREMENT Dfsiggen "Auslastungsgrad Generator 1" UBYTE Def_f_ub_b100 0 0 0.0 99.6093 ECU_ADDRESS 0x007FBC3A /begin FUNCTION_LIST LAYER /end FUNCTION_LIST /end MEASUREMENT
/begin MEASUREMENT Dmd_gen "max. Momentenanstieg Motor für Generator" SWORD Def_dm_sw_q0p1 0 0 -3276.8000 3276.7000 ECU_ADDRESS 0x007FBC3C /begin FUNCTION_LIST LAYER /end FUNCTION_LIST /end MEASUREMENT
/begin MEASUREMENT Fahrzeug "Fahrzeugtypbezeichnung (E60 = 60, E65 = 65, E46 = 46)" UBYTE Def_dez_ub_q1 0 0 0.0 255.0000 ECU_ADDRESS 0x007FBC3E /begin FUNCTION_LIST LAYER /end FUNCTION_LIST /end MEASUREMENT
/begin MEASUREMENT Fho "Korrekturfaktor Höhe" UWORD Def_f_uw_b2 0 0 0.0 1.9999 ECU_ADDRESS 0x007FBC40 /begin FUNCTION_LIST LAYER /end FUNCTION_LIST /end MEASUREMENT
/begin MEASUREMENT Fid_manhydr "Funktionsidentifier Mandetek Hydraulikpfad" UBYTE Def_dez_ub_q1 0 0 0.0 255.0000 ECU_ADDRESS 0x007FBC42 /begin FUNCTION_LIST LAYER /end FUNCTION_LIST /end MEASUREMENT
/begin MEASUREMENT Fid_manluft "Funktionsidentifier Mandetek Luftpfad" UBYTE Def_dez_ub_q1 0 0 0.0 255.0000 ECU_ADDRESS 0x007FBC43 /begin FUNCTION_LIST LAYER /end FUNCTION_LIST /end MEASUREMENT
/begin MEASUREMENT Gangi "Aktueller Gang intern" UBYTE Def_dez_ub_q1 0 0 0.0 255.0000 ECU_ADDRESS 0x007FBC44 /begin FUNCTION_LIST LAYER /end FUNCTION_LIST /end MEASUREMENT
/begin MEASUREMENT Gen_manufak "Herstellercode Generator 1" UBYTE Def_st_ub_q1 0 0 0.0 255.0000 ECU_ADDRESS 0x007FBC45 /begin FUNCTION_LIST LAYER /end FUNCTION_LIST /end MEASUREMENT
/begin MEASUREMENT Gen_typkenn "Kennung Generatortyp Generator 1" UBYTE Def_st_ub_q1 0 0 0.0 255.0000 ECU_ADDRESS 0x007FBC46 /begin FUNCTION_LIST LAYER /end FUNCTION_LIST /end MEASUREMENT
/begin MEASUREMENT I_pregelv "Strom Raildruckregelventil" SWORD Def_i_sw_q0039 0 0 -128.0000 127.9960 ECU_ADDRESS 0x007FBC48 /begin FUNCTION_LIST LAYER /end FUNCTION_LIST /end MEASUREMENT
/begin MEASUREMENT I_zme "Strom Zumesseinheit" SWORD Def_i_sw_q0039 0 0 -128.0000 127.9960 ECU_ADDRESS 0x007FBC4A /begin FUNCTION_LIST LAYER /end FUNCTION_LIST /end MEASUREMENT
/begin MEASUREMENT Id_bosrst "Kennung vom Tester für Ölservice" UBYTE Def_dez_ub_q1 0 0 0.0 255.0000 ECU_ADDRESS 0x007FBC4C /begin FUNCTION_LIST LAYER /end FUNCTION_LIST /end MEASUREMENT
/begin MEASUREMENT Id_bosrtt "ID f. BOS-Reset v. Tester" UBYTE Def_dez_ub_q1 0 0 0.0 255.0000 ECU_ADDRESS 0x007FBC4D /begin FUNCTION_LIST LAYER /end FUNCTION_LIST /end MEASUREMENT
/begin MEASUREMENT Id_bosrtw "ID f. Motoröl v. Kombi" UWORD Def_dez_uw_q1 0 0 0.0 65535.0000 ECU_ADDRESS 0x007FBC4E /begin FUNCTION_LIST LAYER /end FUNCTION_LIST /end MEASUREMENT
/begin MEASUREMENT Ierr "Erregerstrom Generator 1" UBYTE Def_i_ub_q0p125 0 0 0.0 31.8750 ECU_ADDRESS 0x007FBC50 /begin FUNCTION_LIST LAYER /end FUNCTION_LIST /end MEASUREMENT
/begin MEASUREMENT Ierr_grenz_ext "Grenzerregerstrom vom Tester" UBYTE Def_i_ub_q0p125 0 0 0.0 31.8750 ECU_ADDRESS 0x007FBC51 /begin FUNCTION_LIST LAYER /end FUNCTION_LIST /end MEASUREMENT
/begin MEASUREMENT Ierrfgrenz "Kopie begrenzter Erregerstrom Generator 1" UBYTE Def_i_ub_q0p125 0 0 0.0 31.8750 ECU_ADDRESS 0x007FBC52 /begin FUNCTION_LIST LAYER /end FUNCTION_LIST /end MEASUREMENT
/begin MEASUREMENT Km_st "Kilometerstand" UWORD Def_km_uw_q10 0 0 0.0 655350.0000 ECU_ADDRESS 0x007FBC54 /begin FUNCTION_LIST LAYER /end FUNCTION_LIST /end MEASUREMENT
/begin MEASUREMENT Kvaverbr "Kraftstoffverbrauch" UWORD Def_dez_uw_q1 0 0 0.0 65535.0000 ECU_ADDRESS 0x007FBC56 /begin FUNCTION_LIST LAYER /end FUNCTION_LIST /end MEASUREMENT
/begin MEASUREMENT L_pwmout "Tastverhältnis E-Lüfter" UBYTE Def_tv_ub_q0p390625 0 0 0.0 99.6093 ECU_ADDRESS 0x007FBC58 /begin FUNCTION_LIST LAYER /end FUNCTION_LIST /end MEASUREMENT
/begin MEASUREMENT La_ist1 "Lambdaistwert" UWORD Def_f_uw_b16 0 0 0.0 15.9997 ECU_ADDRESS 0x007FBC5A /begin FUNCTION_LIST LAYER /end FUNCTION_LIST /end MEASUREMENT
/begin MEASUREMENT Md_mgmax "maximalmoment Generator" SWORD Def_m_sw_q0p1 0 0 -3276.8000 3276.7000 ECU_ADDRESS 0x007FBC5C /begin FUNCTION_LIST LAYER /end FUNCTION_LIST /end MEASUREMENT
/begin MEASUREMENT Me_ist "Einspritzmasse aktuell" SWORD Def_me_sw_q0p01 0 0 -327.6800 327.6700 ECU_ADDRESS 0x007FBC5E /begin FUNCTION_LIST LAYER /end FUNCTION_LIST /end MEASUREMENT
/begin MEASUREMENT Ml "Luftmasse pro Zylinder" SWORD Def_ml_sw_q0p1 0 0 -3276.8000 3276.7000 ECU_ADDRESS 0x007FBC60 /begin FUNCTION_LIST LAYER /end FUNCTION_LIST /end MEASUREMENT
/begin MEASUREMENT Mslui "integrierte Luftmasse" UWORD Def_lm_uw_q0p000444 0 0 0.0 29.1266 ECU_ADDRESS 0x007FBC62 /begin FUNCTION_LIST LAYER /end FUNCTION_LIST /end MEASUREMENT
/begin MEASUREMENT N_idlms "Leerlaufdrehzahlanhebung von Powermodul" UBYTE Def_st_ub_q1 0 0 0.0 255.0000 ECU_ADDRESS 0x007FBC64 /begin FUNCTION_LIST LAYER /end FUNCTION_LIST /end MEASUREMENT
/begin MEASUREMENT Na_bnanteil "Bordnetzanteil Nebebaggregate" UBYTE Def_f_ub_b2 0 0 0.0 1.9921 ECU_ADDRESS 0x007FBC65 /begin FUNCTION_LIST LAYER /end FUNCTION_LIST /end MEASUREMENT
/begin MEASUREMENT Nkw "Motordrehzahl an der Kurbelwelle" SWORD Def_n_sw_q1p0 0 0 -32768.0000 32767.0000 ECU_ADDRESS 0x007FBC66 /begin FUNCTION_LIST LAYER /end FUNCTION_LIST /end MEASUREMENT
/begin MEASUREMENT Nsllm "Solldrehzahl im Leerlauf ohne Fahrstufe" SWORD Def_n_sw_q1p0 0 0 -32768.0000 32767.0000 ECU_ADDRESS 0x007FBC68 /begin FUNCTION_LIST LAYER /end FUNCTION_LIST /end MEASUREMENT
/begin MEASUREMENT Oz_datstat "Status Anzeige Uhrzeit Datum" UBYTE Def_dez_ub_q1 0 0 0.0 255.0000 ECU_ADDRESS 0x007FBC6A /begin FUNCTION_LIST LAYER /end FUNCTION_LIST /end MEASUREMENT
/begin MEASUREMENT Oz_nivr "Rohwert Ölniveau vom Sensor" UBYTE Def_dez_ub_q1 0 0 0.0 255.0000 ECU_ADDRESS 0x007FBC6B /begin FUNCTION_LIST LAYER /end FUNCTION_LIST /end MEASUREMENT
/begin MEASUREMENT Oz_permr "Rohwert Permittivität v. Sensor" UWORD Def_dez_uw_q1 0 0 0.0 65535.0000 ECU_ADDRESS 0x007FBC6C /begin FUNCTION_LIST LAYER /end FUNCTION_LIST /end MEASUREMENT
/begin MEASUREMENT Oz_resetr "Status der Resetart vom Kombi" UBYTE Def_dez_ub_q1 0 0 0.0 255.0000 ECU_ADDRESS 0x007FBC6E /begin FUNCTION_LIST LAYER /end FUNCTION_LIST /end MEASUREMENT
/begin MEASUREMENT Oz_status "Statusinfo vom Sensor" UBYTE Def_dez_ub_q1 0 0 0.0 255.0000 ECU_ADDRESS 0x007FBC6F /begin FUNCTION_LIST LAYER /end FUNCTION_LIST /end MEASUREMENT
/begin MEASUREMENT Oz_tempr "Rohwert Öltemperatur v. Sensor" UBYTE Def_dez_ub_q1 0 0 0.0 255.0000 ECU_ADDRESS 0x007FBC70 /begin FUNCTION_LIST LAYER /end FUNCTION_LIST /end MEASUREMENT
/begin MEASUREMENT P_gle "Glühleistung" UWORD Def_p_uw_q0p039 0 0 0.0 2559.9609 ECU_ADDRESS 0x007FBC72 /begin FUNCTION_LIST LAYER /end FUNCTION_LIST /end MEASUREMENT
/begin MEASUREMENT Pld "Ladedruck" SWORD Def_p_sw_q1 0 0 -32768.0000 32767.0000 ECU_ADDRESS 0x007FBC74 /begin FUNCTION_LIST LAYER /end FUNCTION_LIST /end MEASUREMENT
/begin MEASUREMENT Pu "Umgebungsluftdruck" UWORD Def_p_uw_q0p039 0 0 0.0 2559.9609 ECU_ADDRESS 0x007FBC76 /begin FUNCTION_LIST LAYER /end FUNCTION_LIST /end MEASUREMENT
/begin MEASUREMENT Rf "relative Füllung" SWORD Def_rf_sw_q0p01 0 0 -327.6800 327.6700 ECU_ADDRESS 0x007FBC78 /begin FUNCTION_LIST LAYER /end FUNCTION_LIST /end MEASUREMENT
/begin MEASUREMENT St_instr3_1 "Statusbyte CAN Botschaft Instr3" UBYTE Def_st_ub_q1 0 0 0.0 255.0000 ECU_ADDRESS 0x007FBC7A /begin FUNCTION_LIST LAYER /end FUNCTION_LIST /end MEASUREMENT
/begin MEASUREMENT St_nwf "-" UBYTE Def_st_ub_q1 0 0 0.0 255.0000 ECU_ADDRESS 0x007FBC7B /begin FUNCTION_LIST LAYER /end FUNCTION_LIST /end MEASUREMENT
/begin MEASUREMENT St_ptc_pwr "Statusrückmeldung für individuelle Ansteuerung für einen Sonderverbraucher (PTC)" UBYTE Def_f_ub_b127p5 0 0 0.0 127.5000 ECU_ADDRESS 0x007FBC7C /begin FUNCTION_LIST LAYER /end FUNCTION_LIST /end MEASUREMENT
/begin MEASUREMENT T_jahr "Borddatum" UWORD Def_dez_uw_q1 0 0 0.0 65535.0000 ECU_ADDRESS 0x007FBC7E /begin FUNCTION_LIST LAYER /end FUNCTION_LIST /end MEASUREMENT
/begin MEASUREMENT T_monate "Borddatum" UBYTE Def_dez_ub_q1 0 0 0.0 255.0000 ECU_ADDRESS 0x007FBC80 /begin FUNCTION_LIST LAYER /end FUNCTION_LIST /end MEASUREMENT
/begin MEASUREMENT T_tag "Borddatum" UBYTE Def_dez_ub_q1 0 0 0.0 255.0000 ECU_ADDRESS 0x007FBC81 /begin FUNCTION_LIST LAYER /end FUNCTION_LIST /end MEASUREMENT
/begin MEASUREMENT Tans "Ansauglufttemperatur" SWORD Def_t_sw_q0p1 0 0 -3276.8000 3276.7000 ECU_ADDRESS 0x007FBC82 /begin FUNCTION_LIST LAYER /end FUNCTION_LIST /end MEASUREMENT
/begin MEASUREMENT Tchip "Chiptemperatur Generator 1" SWORD Def_t_sw_q0p1 0 0 -3276.8000 3276.7000 ECU_ADDRESS 0x007FBC84 /begin FUNCTION_LIST LAYER /end FUNCTION_LIST /end MEASUREMENT
/begin MEASUREMENT Td_og_cnt "Zähler für fallende Flanken im TÖNS_Signal" UBYTE Def_dez_ub_q1 0 0 0.0 255.0000 ECU_ADDRESS 0x007FBC86 /begin FUNCTION_LIST LAYER /end FUNCTION_LIST /end MEASUREMENT
/begin MEASUREMENT Td_og_icnt "Zeit zwischen 2 Fallenden Flanken" UWORD Def_td_uw_q0p01 0 0 0.0 655.3500 ECU_ADDRESS 0x007FBC88 /begin FUNCTION_LIST LAYER /end FUNCTION_LIST /end MEASUREMENT
/begin MEASUREMENT Td_og_tk "Abkühlzeit von TÖNS" UWORD Def_td_uw_q0p1 0 0 0.0 6553.5000 ECU_ADDRESS 0x007FBC8A /begin FUNCTION_LIST LAYER /end FUNCTION_LIST /end MEASUREMENT
/begin MEASUREMENT Td_og_tr "Referntzeit" UWORD Def_td_uw_q0p1 0 0 0.0 6553.5000 ECU_ADDRESS 0x007FBC8C /begin FUNCTION_LIST LAYER /end FUNCTION_LIST /end MEASUREMENT
/begin MEASUREMENT Td_og_tv "Temperaturzeit von TÖNS" UWORD Def_td_uw_q0p1 0 0 0.0 6553.5000 ECU_ADDRESS 0x007FBC8E /begin FUNCTION_LIST LAYER /end FUNCTION_LIST /end MEASUREMENT
/begin MEASUREMENT Td_og_uplcnt "Zähler für unplausible signale" UBYTE Def_dez_ub_q1 0 0 0.0 255.0000 ECU_ADDRESS 0x007FBC90 /begin FUNCTION_LIST LAYER /end FUNCTION_LIST /end MEASUREMENT
/begin MEASUREMENT Td_rdgenreg2 "Auslesezeit für DF-Signal und Diagnose" UBYTE Def_td_ub_q0p1 0 0 0.0 25.5000 ECU_ADDRESS 0x007FBC91 /begin FUNCTION_LIST LAYER /end FUNCTION_LIST /end MEASUREMENT
/begin MEASUREMENT Tkat_mod "modellierte Katalysatortemperatur" SWORD Def_t_sw_q0p1 0 0 -3276.8000 3276.7000 ECU_ADDRESS 0x007FBC92 /begin FUNCTION_LIST LAYER /end FUNCTION_LIST /end MEASUREMENT
/begin MEASUREMENT Tlrfgen "Kopie Generator1 LR Vorgabe auf Bus gelegt" UBYTE Def_td_ub_q0p1 0 0 0.0 25.5000 ECU_ADDRESS 0x007FBC94 /begin FUNCTION_LIST LAYER /end FUNCTION_LIST /end MEASUREMENT
/begin MEASUREMENT Tlrgen_ext "Loadresponse vom Tester" UBYTE Def_td_ub_q0p1 0 0 0.0 25.5000 ECU_ADDRESS 0x007FBC95 /begin FUNCTION_LIST LAYER /end FUNCTION_LIST /end MEASUREMENT
/begin MEASUREMENT Tluft "Lufttemperatur" SWORD Def_t_sw_q0p01 0 0 -327.6800 327.6700 ECU_ADDRESS 0x007FBC96 /begin FUNCTION_LIST LAYER /end FUNCTION_LIST /end MEASUREMENT
/begin MEASUREMENT Tmot "Kühlwassertemperatur" SWORD Def_t_sw_q0p01 0 0 -327.6800 327.6700 ECU_ADDRESS 0x007FBC98 /begin FUNCTION_LIST LAYER /end FUNCTION_LIST /end MEASUREMENT
/begin MEASUREMENT Tmot_start "Motorstarttemperatur" SWORD Def_t_sw_q0p01 0 0 -327.6800 327.6700 ECU_ADDRESS 0x007FBC9A /begin FUNCTION_LIST LAYER /end FUNCTION_LIST /end MEASUREMENT
/begin MEASUREMENT Tn_abstell "Abstellzeit" UWORD Def_dez_uw_q1 0 0 0.0 65535.0000 ECU_ADDRESS 0x007FBC9C /begin FUNCTION_LIST LAYER /end FUNCTION_LIST /end MEASUREMENT
/begin MEASUREMENT Toel_mdl "Modelltemperatur Motoröl" SWORD Def_t_sw_q0p1 0 0 -3276.8000 3276.7000 ECU_ADDRESS 0x007FBC9E /begin FUNCTION_LIST LAYER /end FUNCTION_LIST /end MEASUREMENT
/begin MEASUREMENT Tumg "Umgebungstemperatur" SWORD Def_t_sw_q0p1 0 0 -3276.8000 3276.7000 ECU_ADDRESS 0x007FBCA0 /begin FUNCTION_LIST LAYER /end FUNCTION_LIST /end MEASUREMENT
/begin MEASUREMENT Tumg_can "Umgebungstemperatur" SWORD Def_t_sw_q0p1 0 0 -3276.8000 3276.7000 ECU_ADDRESS 0x007FBCA2 /begin FUNCTION_LIST LAYER /end FUNCTION_LIST /end MEASUREMENT
/begin MEASUREMENT Tv_agr "Tastverhältnis AGR-Steller" SWORD Def_tv_sw_q0p01 0 0 -327.6800 327.6700 ECU_ADDRESS 0x007FBCA4 /begin FUNCTION_LIST LAYER /end FUNCTION_LIST /end MEASUREMENT
/begin MEASUREMENT Tv_pld "Tastverhältnis Ladedrucksteller" SWORD Def_tv_sw_q0p01 0 0 -327.6800 327.6700 ECU_ADDRESS 0x007FBCA6 /begin FUNCTION_LIST LAYER /end FUNCTION_LIST /end MEASUREMENT
/begin MEASUREMENT Twasser "Wassertemperatur" SWORD Def_t_sw_q0p01 0 0 -327.6800 327.6700 ECU_ADDRESS 0x007FBCA8 /begin FUNCTION_LIST LAYER /end FUNCTION_LIST /end MEASUREMENT
/begin MEASUREMENT U_fgen "kopierter Wert von zum Generator gesendeter Sollspannung Generator 1" UWORD Def_u_uw_q0p1 0 0 0.0 6553.5000 ECU_ADDRESS 0x007FBCAA /begin FUNCTION_LIST LAYER /end FUNCTION_LIST /end MEASUREMENT
/begin MEASUREMENT U_gen_ext "physikalischer Wert Generatorsollspannung für Generator 1 vom Tester" UWORD Def_u_uw_q0p1 0 0 0.0 6553.5000 ECU_ADDRESS 0x007FBCAC /begin FUNCTION_LIST LAYER /end FUNCTION_LIST /end MEASUREMENT
/begin MEASUREMENT U_gen_slp "Spannungsanforderung Sekundärluftpumpe" UWORD Def_u_uw_q0p1 0 0 0.0 6553.5000 ECU_ADDRESS 0x007FBCAE /begin FUNCTION_LIST LAYER /end FUNCTION_LIST /end MEASUREMENT
/begin MEASUREMENT U_gensollpm "Sollwert Spannung vom Powermodul" SWORD Def_u_sw_b128 0 0 -128.0000 127.9960 ECU_ADDRESS 0x007FBCB0 /begin FUNCTION_LIST LAYER /end FUNCTION_LIST /end MEASUREMENT
/begin MEASUREMENT Ub "Bordnetzspannung" UWORD Def_u_uw_q0p0942 0 0 0.0 6173.3970 ECU_ADDRESS 0x007FBCB2 /begin FUNCTION_LIST LAYER /end FUNCTION_LIST /end MEASUREMENT
/begin MEASUREMENT Uregnom "Nominalspannung Regler Generator 1" UWORD Def_u_uw_q0p1 0 0 0.0 6553.5000 ECU_ADDRESS 0x007FBCB4 /begin FUNCTION_LIST LAYER /end FUNCTION_LIST /end MEASUREMENT
/begin MEASUREMENT V "Fahrzeuggeschwindigkeit" UWORD Def_v_uw_q1p0 0 0 0.0 360.0000 ECU_ADDRESS 0x007FBCB6 /begin FUNCTION_LIST LAYER /end FUNCTION_LIST /end MEASUREMENT
/begin MEASUREMENT W_ub "ungefilterte Bordnetzspannung [0 .. 24,021 V]" UBYTE Def_u_ub_q0p0942 0 0 0.0 24.0210 ECU_ADDRESS 0x007FBCB8 /begin FUNCTION_LIST LAYER /end FUNCTION_LIST /end MEASUREMENT
/begin MEASUREMENT Wped "Pedalwertgeberposition" SWORD Def_tv_sw_q0p0244 0 0 -800.0000 799.9755 ECU_ADDRESS 0x007FBCBA /begin FUNCTION_LIST LAYER /end FUNCTION_LIST /end MEASUREMENT
/begin MEASUREMENT Zrbosr "Servicezähler vom Kombi" UBYTE Def_dez_ub_q1 0 0 0.0 255.0000 ECU_ADDRESS 0x007FBCBC /begin FUNCTION_LIST LAYER /end FUNCTION_LIST /end MEASUREMENT
/begin MEASUREMENT Zrbosrt "Servicezählerstand v. Tester" UBYTE Def_dez_ub_q1 0 0 0.0 255.0000 ECU_ADDRESS 0x007FBCBD /begin FUNCTION_LIST LAYER /end FUNCTION_LIST /end MEASUREMENT
/begin MEASUREMENT Ztageabs "Tagezähler vom Kombi" UWORD Def_dez_uw_q1 0 0 0.0 65535.0000 ECU_ADDRESS 0x007FBCBE /begin FUNCTION_LIST LAYER /end FUNCTION_LIST /end MEASUREMENT
/begin MEASUREMENT St_agr.B_agrok "Bedingung Abgasrückführung ok" UBYTE Def_bit_ub_1 0 0 0.0 255.0 ECU_ADDRESS 0x007FBCC0 /begin FUNCTION_LIST LAYER /end FUNCTION_LIST BIT_MASK 0x2 /end MEASUREMENT
/begin MEASUREMENT St_agr "Statusbyte agr" UBYTE Def_st_ub_q1 0 0 0.0 255.0000 ECU_ADDRESS 0x007FBCC0 /begin FUNCTION_LIST LAYER /end FUNCTION_LIST /end MEASUREMENT
/begin MEASUREMENT St_ckl15.B_ckl30 "Bedingung Klemme R (über CAN)" UBYTE Def_bit_ub_1 0 0 0.0 255.0 ECU_ADDRESS 0x007FBCC1 /begin FUNCTION_LIST LAYER /end FUNCTION_LIST BIT_MASK 0x2 /end MEASUREMENT
/begin MEASUREMENT St_ckl15.B_ckl50 "Bedingung Klemme 50 (über CAN)" UBYTE Def_bit_ub_0 0 0 0.0 255.0 ECU_ADDRESS 0x007FBCC1 /begin FUNCTION_LIST LAYER /end FUNCTION_LIST BIT_MASK 0x1 /end MEASUREMENT
/begin MEASUREMENT St_ckl15 "Statusbyte Klemmensignale vom CAN" UBYTE Def_st_ub_q1 0 0 0.0 255.0000 ECU_ADDRESS 0x007FBCC1 /begin FUNCTION_LIST LAYER /end FUNCTION_LIST /end MEASUREMENT
/begin MEASUREMENT St_egs.B_fs "Bedingung Fahrstufe" UBYTE Def_bit_ub_0 0 0 0.0 255.0 ECU_ADDRESS 0x007FBCC2 /begin FUNCTION_LIST LAYER /end FUNCTION_LIST BIT_MASK 0x1 /end MEASUREMENT
/begin MEASUREMENT St_egs "Statusbyte Automatikgetriebe" UBYTE Def_st_ub_q1 0 0 0.0 255.0000 ECU_ADDRESS 0x007FBCC2 /begin FUNCTION_LIST LAYER /end FUNCTION_LIST /end MEASUREMENT
/begin MEASUREMENT St_gen_ext.B_gen_ext "Bedingung Testeransteuerung Generator" UBYTE Def_bit_ub_0 0 0 0.0 255.0 ECU_ADDRESS 0x007FBCC3 /begin FUNCTION_LIST LAYER /end FUNCTION_LIST BIT_MASK 0x1 /end MEASUREMENT
/begin MEASUREMENT St_gen_ext.B_ierr_ext "Bedingung Anforderung Grenzerregerstrom vom Tester" UBYTE Def_bit_ub_2 0 0 0.0 255.0 ECU_ADDRESS 0x007FBCC3 /begin FUNCTION_LIST LAYER /end FUNCTION_LIST BIT_MASK 0x4 /end MEASUREMENT
/begin MEASUREMENT St_gen_ext.B_loadre_ext "Bedingung Anforderung Loadresponse vom Tester" UBYTE Def_bit_ub_1 0 0 0.0 255.0 ECU_ADDRESS 0x007FBCC3 /begin FUNCTION_LIST LAYER /end FUNCTION_LIST BIT_MASK 0x2 /end MEASUREMENT
/begin MEASUREMENT St_gen_ext "Statusbyte Generator extern" UBYTE Def_st_ub_q1 0 0 0.0 255.0000 ECU_ADDRESS 0x007FBCC3 /begin FUNCTION_LIST LAYER /end FUNCTION_LIST /end MEASUREMENT
/begin MEASUREMENT St_genallg.B_abliactiv "Bedingung Abblendlicht aktiv" UBYTE Def_bit_ub_1 0 0 0.0 255.0 ECU_ADDRESS 0x007FBCC4 /begin FUNCTION_LIST LAYER /end FUNCTION_LIST BIT_MASK 0x2 /end MEASUREMENT
/begin MEASUREMENT St_genallg.B_bsdprot1 "Bedingung BSD Protokollinhalt für BSD 1 Regler" UBYTE Def_bit_ub_3 0 0 0.0 255.0 ECU_ADDRESS 0x007FBCC4 /begin FUNCTION_LIST LAYER /end FUNCTION_LIST BIT_MASK 0x8 /end MEASUREMENT
/begin MEASUREMENT St_genallg.B_bsdprot2 "Bedingung BSD Protokollinhalt für BSD 2 Regler" UBYTE Def_bit_ub_4 0 0 0.0 255.0 ECU_ADDRESS 0x007FBCC4 /begin FUNCTION_LIST LAYER /end FUNCTION_LIST BIT_MASK 0x10 /end MEASUREMENT
/begin MEASUREMENT St_genallg.B_iliactiv "Bedingung Innenlicht aktiv" UBYTE Def_bit_ub_0 0 0 0.0 255.0 ECU_ADDRESS 0x007FBCC4 /begin FUNCTION_LIST LAYER /end FUNCTION_LIST BIT_MASK 0x1 /end MEASUREMENT
/begin MEASUREMENT St_genallg.B_rd_gentyp "Bedingung Schalter APK zum Auslesen Hersteller und Generatortyp" UBYTE Def_bit_ub_5 0 0 0.0 255.0 ECU_ADDRESS 0x007FBCC4 /begin FUNCTION_LIST LAYER /end FUNCTION_LIST BIT_MASK 0x20 /end MEASUREMENT
/begin MEASUREMENT St_genallg "Statusbyte Generator allgemein" UBYTE Def_st_ub_q1 0 0 0.0 255.0000 ECU_ADDRESS 0x007FBCC4 /begin FUNCTION_LIST LAYER /end FUNCTION_LIST /end MEASUREMENT
/begin MEASUREMENT St_generator.B_crashgen "Bedingung Generator abschalten bei Crash" UBYTE Def_bit_ub_6 0 0 0.0 255.0 ECU_ADDRESS 0x007FBCC5 /begin FUNCTION_LIST LAYER /end FUNCTION_LIST BIT_MASK 0x40 /end MEASUREMENT
/begin MEASUREMENT St_generator.B_genactiv "Bedingung Generatorinterface 1 aktiv" UBYTE Def_bit_ub_0 0 0 0.0 255.0 ECU_ADDRESS 0x007FBCC5 /begin FUNCTION_LIST LAYER /end FUNCTION_LIST BIT_MASK 0x1 /end MEASUREMENT
/begin MEASUREMENT St_generator.B_genfbsd "Bedingung Kommunikationsverlust BSD Generator 1" UBYTE Def_bit_ub_2 0 0 0.0 255.0 ECU_ADDRESS 0x007FBCC5 /begin FUNCTION_LIST LAYER /end FUNCTION_LIST BIT_MASK 0x4 /end MEASUREMENT
/begin MEASUREMENT St_generator.B_genfel "Bedingung Generatorfehler elektrisch Generator 1" UBYTE Def_bit_ub_3 0 0 0.0 255.0 ECU_ADDRESS 0x007FBCC5 /begin FUNCTION_LIST LAYER /end FUNCTION_LIST BIT_MASK 0x8 /end MEASUREMENT
/begin MEASUREMENT St_generator.B_genfht "Bedingung Generatorzustand hohe Temparatur Generator 1" UBYTE Def_bit_ub_4 0 0 0.0 255.0 ECU_ADDRESS 0x007FBCC5 /begin FUNCTION_LIST LAYER /end FUNCTION_LIST BIT_MASK 0x10 /end MEASUREMENT
/begin MEASUREMENT St_generator.B_genfme "Bedingung Generatorfehler mechanisch Generator 1" UBYTE Def_bit_ub_5 0 0 0.0 255.0 ECU_ADDRESS 0x007FBCC5 /begin FUNCTION_LIST LAYER /end FUNCTION_LIST BIT_MASK 0x20 /end MEASUREMENT
/begin MEASUREMENT St_generator "Statusbyte Generator" UBYTE Def_st_ub_q1 0 0 0.0 255.0000 ECU_ADDRESS 0x007FBCC5 /begin FUNCTION_LIST LAYER /end FUNCTION_LIST /end MEASUREMENT
/begin MEASUREMENT St_gengrenz.B_bnnio "Bedingung Bordnetzt n.i.o." UBYTE Def_bit_ub_2 0 0 0.0 255.0 ECU_ADDRESS 0x007FBCC6 /begin FUNCTION_LIST LAYER /end FUNCTION_LIST BIT_MASK 0x4 /end MEASUREMENT
/begin MEASUREMENT St_gengrenz "Statusbyte Gengrenz" UBYTE Def_st_ub_q1 0 0 0.0 255.0000 ECU_ADDRESS 0x007FBCC6 /begin FUNCTION_LIST LAYER /end FUNCTION_LIST /end MEASUREMENT
/begin MEASUREMENT St_genll.B_lrfoff "Bedingung Kopie Drehzahlschwelle für LR-Funktion Generator 1 aktiv" UBYTE Def_bit_ub_0 0 0 0.0 255.0 ECU_ADDRESS 0x007FBCC7 /begin FUNCTION_LIST LAYER /end FUNCTION_LIST BIT_MASK 0x1 /end MEASUREMENT
/begin MEASUREMENT St_genll.B_lrreg1ak "Bedingung LR-Register 1 aktiv Generator 1" UBYTE Def_bit_ub_2 0 0 0.0 255.0 ECU_ADDRESS 0x007FBCC7 /begin FUNCTION_LIST LAYER /end FUNCTION_LIST BIT_MASK 0x4 /end MEASUREMENT
/begin MEASUREMENT St_genll "Statusbyte LR-Eingänge Generator" UBYTE Def_st_ub_q1 0 0 0.0 255.0000 ECU_ADDRESS 0x007FBCC7 /begin FUNCTION_LIST LAYER /end FUNCTION_LIST /end MEASUREMENT
/begin MEASUREMENT St_getriebe.B_autget "Bedingung Automatikgetriebe verbaut" UBYTE Def_bit_ub_0 0 0 0.0 255.0 ECU_ADDRESS 0x007FBCC8 /begin FUNCTION_LIST LAYER /end FUNCTION_LIST BIT_MASK 0x1 /end MEASUREMENT
/begin MEASUREMENT St_getriebe "Statuswort Getriebe" UBYTE Def_st_ub_q1 0 0 0.0 255.0000 ECU_ADDRESS 0x007FBCC8 /begin FUNCTION_LIST LAYER /end FUNCTION_LIST /end MEASUREMENT
/begin MEASUREMENT St_imdgen_1s.B_genhtkrit "Diodentemperatur im kritischen Bereich" UBYTE Def_bit_ub_1 0 0 0.0 255.0 ECU_ADDRESS 0x007FBCC9 /begin FUNCTION_LIST LAYER /end FUNCTION_LIST BIT_MASK 0x2 /end MEASUREMENT
/begin MEASUREMENT St_imdgen_1s.B_tdiodekrit "Generatormoment enable/disable" UBYTE Def_bit_ub_3 0 0 0.0 255.0 ECU_ADDRESS 0x007FBCC9 /begin FUNCTION_LIST LAYER /end FUNCTION_LIST BIT_MASK 0x8 /end MEASUREMENT
/begin MEASUREMENT St_imdgen_1s "Statusbyte imdgen_1s" UBYTE Def_st_ub_q1 0 0 0.0 255.0000 ECU_ADDRESS 0x007FBCC9 /begin FUNCTION_LIST LAYER /end FUNCTION_LIST /end MEASUREMENT
/begin MEASUREMENT St_kl15.B_kl15_ep "Bedingung Kl. 15 gesetzt" UBYTE Def_bit_ub_0 0 0 0.0 255.0 ECU_ADDRESS 0x007FBCCA /begin FUNCTION_LIST LAYER /end FUNCTION_LIST BIT_MASK 0x1 /end MEASUREMENT
/begin MEASUREMENT St_kl15 "Statusbyte Klemme 15" UBYTE Def_st_ub_q1 0 0 0.0 255.0000 ECU_ADDRESS 0x007FBCCA /begin FUNCTION_LIST LAYER /end FUNCTION_LIST /end MEASUREMENT
/begin MEASUREMENT St_llr.B_llrein "Bedingung Leerlaufregler ist aktiv" UWORD Def_bit_uw_0 0 0 0.0 65535.0 ECU_ADDRESS 0x007FBCCC /begin FUNCTION_LIST LAYER /end FUNCTION_LIST BIT_MASK 0x1 /end MEASUREMENT
/begin MEASUREMENT St_llr "Statusword Leerlaufregler" UWORD Def_st_uw_q1 0 0 0.0 65535.0000 ECU_ADDRESS 0x007FBCCC /begin FUNCTION_LIST LAYER /end FUNCTION_LIST /end MEASUREMENT
/begin MEASUREMENT St_loadresp.B_lroff "Bedingung Drehzahlschwelle für LR-Funktion Generator 1 aktiv" UBYTE Def_bit_ub_0 0 0 0.0 255.0 ECU_ADDRESS 0x007FBCCE /begin FUNCTION_LIST LAYER /end FUNCTION_LIST BIT_MASK 0x1 /end MEASUREMENT
/begin MEASUREMENT St_loadresp "Statusbyte Loadresp" UBYTE Def_st_ub_q1 0 0 0.0 255.0000 ECU_ADDRESS 0x007FBCCE /begin FUNCTION_LIST LAYER /end FUNCTION_LIST /end MEASUREMENT
/begin MEASUREMENT St_lsu.B_lsuakt "Bedingung Lambdasonde betriebsbereit" UBYTE Def_bit_ub_1 0 0 0.0 255.0 ECU_ADDRESS 0x007FBCCF /begin FUNCTION_LIST LAYER /end FUNCTION_LIST BIT_MASK 0x2 /end MEASUREMENT
/begin MEASUREMENT St_lsu "Statusbyte lsu" UBYTE Def_st_ub_q1 0 0 0.0 255.0000 ECU_ADDRESS 0x007FBCCF /begin FUNCTION_LIST LAYER /end FUNCTION_LIST /end MEASUREMENT
/begin MEASUREMENT St_master.B_masterhw "Bedingung Master-SG" UBYTE Def_bit_ub_0 0 0 0.0 255.0 ECU_ADDRESS 0x007FBCD0 /begin FUNCTION_LIST LAYER /end FUNCTION_LIST BIT_MASK 0x1 /end MEASUREMENT
/begin MEASUREMENT St_master "Statusbyte Master" UBYTE Def_st_ub_q1 0 0 0.0 255.0000 ECU_ADDRESS 0x007FBCD0 /begin FUNCTION_LIST LAYER /end FUNCTION_LIST /end MEASUREMENT
/begin MEASUREMENT St_mdna.B_lastab "Bedingung Lastabwurf" UBYTE Def_bit_ub_0 0 0 0.0 255.0 ECU_ADDRESS 0x007FBCD1 /begin FUNCTION_LIST LAYER /end FUNCTION_LIST BIT_MASK 0x1 /end MEASUREMENT
/begin MEASUREMENT St_mdna "Statusbyte Momentenaufnahme der Nebenaggregate" UBYTE Def_st_ub_q1 0 0 0.0 255.0000 ECU_ADDRESS 0x007FBCD1 /begin FUNCTION_LIST LAYER /end FUNCTION_LIST /end MEASUREMENT
/begin MEASUREMENT St_mkwchn.B_kwdreht "Bedingung drehende Kurbelwelle erkannt" UBYTE Def_bit_ub_5 0 0 0.0 255.0 ECU_ADDRESS 0x007FBCD2 /begin FUNCTION_LIST LAYER /end FUNCTION_LIST BIT_MASK 0x20 /end MEASUREMENT
/begin MEASUREMENT St_mkwchn "Statusbyte Masterkurbelwelle" UBYTE Def_st_ub_q1 0 0 0.0 255.0000 ECU_ADDRESS 0x007FBCD2 /begin FUNCTION_LIST LAYER /end FUNCTION_LIST /end MEASUREMENT
/begin MEASUREMENT St_motzustd.B_ll "Bedingung Leerlauf" UWORD Def_bit_uw_3 0 0 0.0 65535.0 ECU_ADDRESS 0x007FBCD4 /begin FUNCTION_LIST LAYER /end FUNCTION_LIST BIT_MASK 0x8 /end MEASUREMENT
/begin MEASUREMENT St_motzustd.B_vl "Bedingung Volllast" UWORD Def_bit_uw_5 0 0 0.0 65535.0 ECU_ADDRESS 0x007FBCD4 /begin FUNCTION_LIST LAYER /end FUNCTION_LIST BIT_MASK 0x20 /end MEASUREMENT
/begin MEASUREMENT St_motzustd "Statuswort Motorzustand" UWORD Def_st_uw_q1 0 0 0.0 65535.0000 ECU_ADDRESS 0x007FBCD4 /begin FUNCTION_LIST LAYER /end FUNCTION_LIST /end MEASUREMENT
/begin MEASUREMENT St_oz.B_anhang "Bedingung Anhänger erkannt" UBYTE Def_bit_ub_0 0 0 0.0 255.0 ECU_ADDRESS 0x007FBCD6 /begin FUNCTION_LIST LAYER /end FUNCTION_LIST BIT_MASK 0x1 /end MEASUREMENT
/begin MEASUREMENT St_oz.B_ozfbsd "Bedingung Fehler BSD-Kommunikation" UBYTE Def_bit_ub_1 0 0 0.0 255.0 ECU_ADDRESS 0x007FBCD6 /begin FUNCTION_LIST LAYER /end FUNCTION_LIST BIT_MASK 0x2 /end MEASUREMENT
/begin MEASUREMENT St_oz "Statuswort Eingangsgröáen Ölzustandssensor" UBYTE Def_dez_ub_q1 0 0 0.0 255.0000 ECU_ADDRESS 0x007FBCD6 /begin FUNCTION_LIST LAYER /end FUNCTION_LIST /end MEASUREMENT
/begin MEASUREMENT St_oz_i.B_td_og "Bedingung Abkühlzeit gültig" UBYTE Def_bit_ub_0 0 0 0.0 255.0 ECU_ADDRESS 0x007FBCD7 /begin FUNCTION_LIST LAYER /end FUNCTION_LIST BIT_MASK 0x1 /end MEASUREMENT
/begin MEASUREMENT St_oz_i.B_td_ogok "Bedingung State-Machine 1x gültig gerechnet" UBYTE Def_bit_ub_4 0 0 0.0 255.0 ECU_ADDRESS 0x007FBCD7 /begin FUNCTION_LIST LAYER /end FUNCTION_LIST BIT_MASK 0x10 /end MEASUREMENT
/begin MEASUREMENT St_oz_i.B_toel "Bedingung tr und tv gültig" UBYTE Def_bit_ub_1 0 0 0.0 255.0 ECU_ADDRESS 0x007FBCD7 /begin FUNCTION_LIST LAYER /end FUNCTION_LIST BIT_MASK 0x2 /end MEASUREMENT
/begin MEASUREMENT St_oz_i "Statusbyte für Eingang OZ" UBYTE Def_dez_ub_q1 0 0 0.0 255.0000 ECU_ADDRESS 0x007FBCD7 /begin FUNCTION_LIST LAYER /end FUNCTION_LIST /end MEASUREMENT
/begin MEASUREMENT St_pld.B_pldok "Bedingung Ladedruckregelung ok" UBYTE Def_bit_ub_1 0 0 0.0 255.0 ECU_ADDRESS 0x007FBCD8 /begin FUNCTION_LIST LAYER /end FUNCTION_LIST BIT_MASK 0x2 /end MEASUREMENT
/begin MEASUREMENT St_pld "Statusbyte pld" UBYTE Def_st_ub_q1 0 0 0.0 255.0000 ECU_ADDRESS 0x007FBCD8 /begin FUNCTION_LIST LAYER /end FUNCTION_LIST /end MEASUREMENT
/begin MEASUREMENT St_pmi.B_fabttreg "Bedingung Batterietausch registrieren" UBYTE Def_bit_ub_1 0 0 0.0 255.0 ECU_ADDRESS 0x007FBCD9 /begin FUNCTION_LIST LAYER /end FUNCTION_LIST BIT_MASK 0x2 /end MEASUREMENT
/begin MEASUREMENT St_pmi.B_fahisrst "Bedingung Histogrammreset" UBYTE Def_bit_ub_2 0 0 0.0 255.0 ECU_ADDRESS 0x007FBCD9 /begin FUNCTION_LIST LAYER /end FUNCTION_LIST BIT_MASK 0x4 /end MEASUREMENT
/begin MEASUREMENT St_pmi "Statusbyte LCP-Eingänge" UBYTE Def_st_ub_q1 0 0 0.0 255.0000 ECU_ADDRESS 0x007FBCD9 /begin FUNCTION_LIST LAYER /end FUNCTION_LIST /end MEASUREMENT
/begin MEASUREMENT St_pwf.B_pwf "Bedingung Powerfail" UBYTE Def_bit_ub_0 0 0 0.0 255.0 ECU_ADDRESS 0x007FBCDA /begin FUNCTION_LIST LAYER /end FUNCTION_LIST BIT_MASK 0x1 /end MEASUREMENT
/begin MEASUREMENT St_pwf "Statusbyte Powerfail" UBYTE Def_st_ub_q1 0 0 0.0 255.0000 ECU_ADDRESS 0x007FBCDA /begin FUNCTION_LIST LAYER /end FUNCTION_LIST /end MEASUREMENT
/begin MEASUREMENT St_sawe.B_sa "Bedingung Schubabschaltung" UBYTE Def_bit_ub_3 0 0 0.0 255.0 ECU_ADDRESS 0x007FBCDB /begin FUNCTION_LIST LAYER /end FUNCTION_LIST BIT_MASK 0x8 /end MEASUREMENT
/begin MEASUREMENT St_sawe "Statusbyte Schubabschaltung(Wiedereinsetzen" UBYTE Def_st_ub_q1 0 0 0.0 255.0000 ECU_ADDRESS 0x007FBCDB /begin FUNCTION_LIST LAYER /end FUNCTION_LIST /end MEASUREMENT
/begin MEASUREMENT St_slp.B_genslp "Bedingung Spannungsanforderung Sekundärluftpumpe" UBYTE Def_bit_ub_2 0 0 0.0 255.0 ECU_ADDRESS 0x007FBCDC /begin FUNCTION_LIST LAYER /end FUNCTION_LIST BIT_MASK 0x4 /end MEASUREMENT
/begin MEASUREMENT St_slp "Statusbyte Sekundärluftpumpe" UBYTE Def_st_ub_q1 0 0 0.0 255.0000 ECU_ADDRESS 0x007FBCDC /begin FUNCTION_LIST LAYER /end FUNCTION_LIST /end MEASUREMENT
/begin MEASUREMENT St_sls.B_sls "Bedingung Sekundärluftsystem aktiv" UBYTE Def_bit_ub_0 0 0 0.0 255.0 ECU_ADDRESS 0x007FBCDD /begin FUNCTION_LIST LAYER /end FUNCTION_LIST BIT_MASK 0x1 /end MEASUREMENT
/begin MEASUREMENT St_sls "Statuswort Sekundärluftsystem" UBYTE Def_st_ub_q1 0 0 0.0 255.0000 ECU_ADDRESS 0x007FBCDD /begin FUNCTION_LIST LAYER /end FUNCTION_LIST /end MEASUREMENT
/begin MEASUREMENT St_tan.B_taners "Bedingung Ansaugluft auf Ersatzwert" UBYTE Def_bit_ub_0 0 0 0.0 255.0 ECU_ADDRESS 0x007FBCDE /begin FUNCTION_LIST LAYER /end FUNCTION_LIST BIT_MASK 0x1 /end MEASUREMENT
/begin MEASUREMENT St_tan "Statusbyte Bedingung für Startwertberechnung" UBYTE Def_st_ub_q1 0 0 0.0 255.0000 ECU_ADDRESS 0x007FBCDE /begin FUNCTION_LIST LAYER /end FUNCTION_LIST /end MEASUREMENT
/begin MEASUREMENT St_tum.B_tumers "Bedingung Umgebungstemperaturersatzwert" UBYTE Def_bit_ub_0 0 0 0.0 255.0 ECU_ADDRESS 0x007FBCDF /begin FUNCTION_LIST LAYER /end FUNCTION_LIST BIT_MASK 0x1 /end MEASUREMENT
/begin MEASUREMENT St_tum "Statusbyte Umgebungstemperatur" UBYTE Def_st_ub_q1 0 0 0.0 255.0000 ECU_ADDRESS 0x007FBCDF /begin FUNCTION_LIST LAYER /end FUNCTION_LIST /end MEASUREMENT
/begin MEASUREMENT St_zwktibs.B_ibsactiv "Bedingung Kommunikation IBS vorhanden" UBYTE Def_bit_ub_0 0 0 0.0 255.0 ECU_ADDRESS 0x007FBCE0 /begin FUNCTION_LIST LAYER /end FUNCTION_LIST BIT_MASK 0x1 /end MEASUREMENT
/begin MEASUREMENT St_zwktibs "Statusbyte Zwktibs" UBYTE Def_st_ub_q1 0 0 0.0 255.0000 ECU_ADDRESS 0x007FBCE0 /begin FUNCTION_LIST LAYER /end FUNCTION_LIST /end MEASUREMENT
/begin MEASUREMENT Batt_class "Klassifizierung der in diesem Fzg. eingebauten Batterie" UBYTE Def_dez_ub_q1 0 0 0.0 255.0000 ECU_ADDRESS 0x00800470 /begin FUNCTION_LIST LAYER /end FUNCTION_LIST /end MEASUREMENT
/begin MEASUREMENT Bosfxid2r "ID_Funktion_BOS_Rückstellung_2" UWORD Def_dez_uw_q1 0 0 0.0 65535.0000 ECU_ADDRESS 0x00800472 /begin FUNCTION_LIST LAYER /end FUNCTION_LIST /end MEASUREMENT
/begin MEASUREMENT Bosid2r "ID_2_BOS_Rückstellung_2" UBYTE Def_dez_ub_q1 0 0 0.0 255.0000 ECU_ADDRESS 0x00800474 /begin FUNCTION_LIST LAYER /end FUNCTION_LIST /end MEASUREMENT
/begin MEASUREMENT Bosjzielr "Zieltermin_Jahr_BOS_Rückstellung_2" UBYTE Def_dez_ub_q1 0 0 0.0 255.0000 ECU_ADDRESS 0x00800475 /begin FUNCTION_LIST LAYER /end FUNCTION_LIST /end MEASUREMENT
/begin MEASUREMENT Bosmzielr "Zieltermin_Monat_BOS_Rückstellung_2" UBYTE Def_dez_ub_q1 0 0 0.0 255.0000 ECU_ADDRESS 0x00800476 /begin FUNCTION_LIST LAYER /end FUNCTION_LIST /end MEASUREMENT
/begin MEASUREMENT Bosprog2r "Prognose_Intervall_Zeit_BOS_Rückstellung_2" UBYTE Def_dez_ub_q1 0 0 0.0 255.0000 ECU_ADDRESS 0x00800477 /begin FUNCTION_LIST LAYER /end FUNCTION_LIST /end MEASUREMENT
/begin MEASUREMENT Bosrw2r "Prognose_Intervall_Weg_BOS_Rückstellung_2" UBYTE Def_km_ub_q1000 0 0 0.0 255000.0000 ECU_ADDRESS 0x00800478 /begin FUNCTION_LIST LAYER /end FUNCTION_LIST /end MEASUREMENT
/begin MEASUREMENT Ikurz_ogr "obere Grenze Kurzschlussstrom vom CAS" UBYTE Def_i_ub_q10 0 0 0.0 2550.0000 ECU_ADDRESS 0x00800479 /begin FUNCTION_LIST LAYER /end FUNCTION_LIST /end MEASUREMENT
/begin MEASUREMENT Ikurz_ugr "untere Grenze Kurzschlussstrom vom CAS" UBYTE Def_i_ub_q10 0 0 0.0 2550.0000 ECU_ADDRESS 0x0080047A /begin FUNCTION_LIST LAYER /end FUNCTION_LIST /end MEASUREMENT
/begin MEASUREMENT Iwakeupgr "Fahrzeugspezifischer Ruhestrom" UBYTE Def_i_ub_q0p001 0 0 0.0 0.2550 ECU_ADDRESS 0x0080047B /begin FUNCTION_LIST LAYER /end FUNCTION_LIST /end MEASUREMENT
/begin MEASUREMENT Km_st_1 "Wegstrecke_km auf 1km genau" ULONG Def_dez_ul_q1 0 0 0.0 2147483647.0000 ECU_ADDRESS 0x0080047C /begin FUNCTION_LIST LAYER /end FUNCTION_LIST /end MEASUREMENT
/begin MEASUREMENT Oz_lf1c "Länderfaktor 1 codiert" UBYTE Def_lf_ub_q0p01 0 0 0.0 2.5500 ECU_ADDRESS 0x00800480 /begin FUNCTION_LIST LAYER /end FUNCTION_LIST /end MEASUREMENT
/begin MEASUREMENT Oz_lf2c "Länderfaktor 2 codiert" UBYTE Def_lf_ub_q0p01 0 0 0.0 2.5500 ECU_ADDRESS 0x00800481 /begin FUNCTION_LIST LAYER /end FUNCTION_LIST /end MEASUREMENT
/begin MEASUREMENT Pmsv "angemeldete Powermanagment Standverbraucher" UBYTE Def_dez_ub_q1 0 0 0.0 255.0000 ECU_ADDRESS 0x00800484 ARRAY_SIZE 15 /begin FUNCTION_LIST LAYER /end FUNCTION_LIST /end MEASUREMENT
/begin MEASUREMENT Tmot_abstell "Motorabstelltemperatur" SWORD Def_t_sw_q0p01 0 0 -327.6800 327.6700 ECU_ADDRESS 0x00800494 /begin FUNCTION_LIST LAYER /end FUNCTION_LIST /end MEASUREMENT
/begin MEASUREMENT Tn_abstellm "Abstellzeit in Minuten" UWORD Def_tn_uw_q1 0 0 0.0 65535.0000 ECU_ADDRESS 0x00800496 /begin FUNCTION_LIST LAYER /end FUNCTION_LIST /end MEASUREMENT
/begin MEASUREMENT St_devxdetec.B_dev0detec "BSD Dev. 0 gelernt" UBYTE Def_bit_ub_0 0 0 0.0 255.0 ECU_ADDRESS 0x00800498 /begin FUNCTION_LIST LAYER /end FUNCTION_LIST BIT_MASK 0x1 /end MEASUREMENT
/begin MEASUREMENT St_devxdetec.B_dev1detec "BSD Dev. 1 gelernt" UBYTE Def_bit_ub_1 0 0 0.0 255.0 ECU_ADDRESS 0x00800498 /begin FUNCTION_LIST LAYER /end FUNCTION_LIST BIT_MASK 0x2 /end MEASUREMENT
/begin MEASUREMENT St_devxdetec.B_dev2detec "BSD Dev. 2 gelernt" UBYTE Def_bit_ub_2 0 0 0.0 255.0 ECU_ADDRESS 0x00800498 /begin FUNCTION_LIST LAYER /end FUNCTION_LIST BIT_MASK 0x4 /end MEASUREMENT
/begin MEASUREMENT St_devxdetec.B_dev3detec "BSD Dev. 3 gelernt" UBYTE Def_bit_ub_3 0 0 0.0 255.0 ECU_ADDRESS 0x00800498 /begin FUNCTION_LIST LAYER /end FUNCTION_LIST BIT_MASK 0x8 /end MEASUREMENT
/begin MEASUREMENT St_devxdetec.B_dev4detec "BSD Dev. 4 gelernt" UBYTE Def_bit_ub_4 0 0 0.0 255.0 ECU_ADDRESS 0x00800498 /begin FUNCTION_LIST LAYER /end FUNCTION_LIST BIT_MASK 0x10 /end MEASUREMENT
/begin MEASUREMENT St_devxdetec.B_dev5detec "BSD Dev. 5 gelernt" UBYTE Def_bit_ub_5 0 0 0.0 255.0 ECU_ADDRESS 0x00800498 /begin FUNCTION_LIST LAYER /end FUNCTION_LIST BIT_MASK 0x20 /end MEASUREMENT
/begin MEASUREMENT St_devxdetec.B_dev6detec "BSD Dev. 6 gelernt" UBYTE Def_bit_ub_6 0 0 0.0 255.0 ECU_ADDRESS 0x00800498 /begin FUNCTION_LIST LAYER /end FUNCTION_LIST BIT_MASK 0x40 /end MEASUREMENT
/begin MEASUREMENT St_devxdetec.B_dev7detec "BSD Dev. 7 gelernt" UBYTE Def_bit_ub_7 0 0 0.0 255.0 ECU_ADDRESS 0x00800498 /begin FUNCTION_LIST LAYER /end FUNCTION_LIST BIT_MASK 0x80 /end MEASUREMENT
/begin MEASUREMENT St_devxdetec "Ergebnis BSD-Lernfunktion" UBYTE Def_dez_ub_q1 0 0 0.0 255.0000 ECU_ADDRESS 0x00800498 /begin FUNCTION_LIST LAYER /end FUNCTION_LIST /end MEASUREMENT
/begin MEASUREMENT St_elu.B_elu600 "Bedingung Elüftertyp" UBYTE Def_bit_ub_0 0 0 0.0 255.0 ECU_ADDRESS 0x00800499 /begin FUNCTION_LIST LAYER /end FUNCTION_LIST BIT_MASK 0x1 /end MEASUREMENT
/begin MEASUREMENT St_elu "Statusbyte Elüfter" UBYTE Def_st_ub_q1 0 0 0.0 255.0000 ECU_ADDRESS 0x00800499 /begin FUNCTION_LIST LAYER /end FUNCTION_LIST /end MEASUREMENT
/begin MEASUREMENT St_ibs.B_ibsdetec "Bedingung IBS erkannt" UBYTE Def_bit_ub_0 0 0 0.0 255.0 ECU_ADDRESS 0x0080049A /begin FUNCTION_LIST LAYER /end FUNCTION_LIST BIT_MASK 0x1 /end MEASUREMENT
/begin MEASUREMENT St_ibs "Statusbyte IBS" UBYTE Def_st_ub_q1 0 0 0.0 255.0000 ECU_ADDRESS 0x0080049A /begin FUNCTION_LIST LAYER /end FUNCTION_LIST /end MEASUREMENT
/begin MEASUREMENT St_pmbnstab.B_nachlend "Bedingung Nachlauf beendet" UBYTE Def_bit_ub_0 0 0 0.0 255.0 ECU_ADDRESS 0x0080049B /begin FUNCTION_LIST LAYER /end FUNCTION_LIST BIT_MASK 0x1 /end MEASUREMENT
/begin MEASUREMENT St_pmbnstab "Statusbyte Bordnetzstabilität" UBYTE Def_st_ub_q1 0 0 0.0 255.0000 ECU_ADDRESS 0x0080049B /begin FUNCTION_LIST LAYER /end FUNCTION_LIST /end MEASUREMENT
/begin MEASUREMENT St_pmi_nv.B_fapmmess "Bedingung Messmethode PM" UBYTE Def_bit_ub_0 0 0 0.0 255.0 ECU_ADDRESS 0x0080049C /begin FUNCTION_LIST LAYER /end FUNCTION_LIST BIT_MASK 0x1 /end MEASUREMENT
/begin MEASUREMENT St_pmi_nv.B_ulcp "Bedingung ULCP aktiv" UBYTE Def_bit_ub_1 0 0 0.0 255.0 ECU_ADDRESS 0x0080049C /begin FUNCTION_LIST LAYER /end FUNCTION_LIST BIT_MASK 0x2 /end MEASUREMENT
/begin MEASUREMENT St_pmi_nv "Statusbyte LCP-Eingänge nv" UBYTE Def_st_ub_q1 0 0 0.0 255.0000 ECU_ADDRESS 0x0080049C /begin FUNCTION_LIST LAYER /end FUNCTION_LIST /end MEASUREMENT
/begin MEASUREMENT St_start.B_sta "Bedingung Automatikstart" UBYTE Def_bit_ub_7 0 0 0.0 255.0 ECU_ADDRESS 0x0080049D /begin FUNCTION_LIST LAYER /end FUNCTION_LIST BIT_MASK 0x80 /end MEASUREMENT
/begin MEASUREMENT St_start.B_startende "Bedingung Startende" UBYTE Def_bit_ub_3 0 0 0.0 255.0 ECU_ADDRESS 0x0080049D /begin FUNCTION_LIST LAYER /end FUNCTION_LIST BIT_MASK 0x8 /end MEASUREMENT
/begin MEASUREMENT St_start "Statusbyte Start" UBYTE Def_st_ub_q1 0 0 0.0 255.0000 ECU_ADDRESS 0x0080049D /begin FUNCTION_LIST LAYER /end FUNCTION_LIST /end MEASUREMENT
/begin MEASUREMENT St_lbattcal0.B_lbatteinih "Ende Initialisierungsphase Lbattcal Batterie hinten" UBYTE Def_bit_ub_0 0 0 0.0 255.0 ECU_ADDRESS 0x007FC762 /begin FUNCTION_LIST LBATTCAL /end FUNCTION_LIST BIT_MASK 0x1 /end MEASUREMENT
/begin MEASUREMENT St_lbattcal0.B_lbatteiniv "Ende Initialisierungsphase Lbattcal Batterie vorne" UBYTE Def_bit_ub_1 0 0 0.0 255.0 ECU_ADDRESS 0x007FC762 /begin FUNCTION_LIST LBATTCAL /end FUNCTION_LIST BIT_MASK 0x2 /end MEASUREMENT
/begin MEASUREMENT St_lbattcal0.B_lbattenh "Enable Batterie hinten" UBYTE Def_bit_ub_2 0 0 0.0 255.0 ECU_ADDRESS 0x007FC762 /begin FUNCTION_LIST LBATTCAL /end FUNCTION_LIST BIT_MASK 0x4 /end MEASUREMENT
/begin MEASUREMENT St_lbattcal0.B_lbattenv "Enable Batterie vorne" UBYTE Def_bit_ub_3 0 0 0.0 255.0 ECU_ADDRESS 0x007FC762 /begin FUNCTION_LIST LBATTCAL /end FUNCTION_LIST BIT_MASK 0x8 /end MEASUREMENT
/begin MEASUREMENT St_lbattcal0.B_lbattinit "Initialisierung LBATTCAL beendet" UBYTE Def_bit_ub_4 0 0 0.0 255.0 ECU_ADDRESS 0x007FC762 /begin FUNCTION_LIST LBATTCAL /end FUNCTION_LIST BIT_MASK 0x10 /end MEASUREMENT
/begin MEASUREMENT St_lbattcal0.B_dly_tbi "Bedingung für Startwertberechnung" UBYTE Def_bit_ub_5 0 0 0.0 255.0 ECU_ADDRESS 0x007FC762 /begin FUNCTION_LIST LBATTCAL /end FUNCTION_LIST BIT_MASK 0x20 /end MEASUREMENT
/begin MEASUREMENT St_lbattcal0 "Statuswort" UBYTE Def_st_ub_q1 0 0 0.0 255.0000 ECU_ADDRESS 0x007FC762 /begin FUNCTION_LIST LBATTCAL /end FUNCTION_LIST /end MEASUREMENT
/begin MEASUREMENT U_kompk "Zwischengröße" SWORD Def_u_sw_b128 0 0 0.0 127.9960 ECU_ADDRESS 0x0080049E /begin FUNCTION_LIST LBATTCAL /end FUNCTION_LIST /end MEASUREMENT
/begin MEASUREMENT U_kompm "Zwischengröße" SWORD Def_u_sw_b128 0 0 0.0 127.9960 ECU_ADDRESS 0x008004A0 /begin FUNCTION_LIST LBATTCAL /end FUNCTION_LIST /end MEASUREMENT
/begin MEASUREMENT U_lade "Zwischengröße" SWORD Def_u_sw_b128 0 0 0.0 127.9960 ECU_ADDRESS 0x008004A2 /begin FUNCTION_LIST LBATTCAL /end FUNCTION_LIST /end MEASUREMENT
/begin MEASUREMENT T_batt_lb "Batterietemperatur" SWORD Def_t_sw_q0p1 0 0 -3276.8000 3276.7000 ECU_ADDRESS 0x007FC74C /begin FUNCTION_LIST LBATTCAL /end FUNCTION_LIST /end MEASUREMENT
/begin MEASUREMENT Tumg_ers "Aussentemperatur oder Ersatzwert" SWORD Def_t_sw_q0p1 0 0 -3276.8000 3276.7000 ECU_ADDRESS 0x007FC74E /begin FUNCTION_LIST LBATTCAL /end FUNCTION_LIST /end MEASUREMENT
/begin MEASUREMENT U_gensollm "Generatorsollspannung" SWORD Def_u_sw_b128 0 0 -128.0000 127.9960 ECU_ADDRESS 0x007FC750 /begin FUNCTION_LIST LBATTCAL /end FUNCTION_LIST /end MEASUREMENT
/begin MEASUREMENT T_battabst "Batterieabstelltemperatur" SWORD Def_t_sw_q0p1 0 0 -3276.8000 3276.7000 ECU_ADDRESS 0x008004A8 /begin FUNCTION_LIST LBATTCAL /end FUNCTION_LIST /end MEASUREMENT
/begin MEASUREMENT Tumg_abst "Abstell-Aussentemperatur" SWORD Def_t_sw_q0p1 0 0 -3276.8000 3276.7000 ECU_ADDRESS 0x008004AA /begin FUNCTION_LIST LBATTCAL /end FUNCTION_LIST /end MEASUREMENT
/begin MEASUREMENT Tumg_battab "Abstell-Umgebungstemperatur Batterie" SWORD Def_t_sw_q0p1 0 0 -3276.8000 3276.7000 ECU_ADDRESS 0x008004AC /begin FUNCTION_LIST LBATTCAL /end FUNCTION_LIST /end MEASUREMENT
/begin MEASUREMENT T_batstiniv "Starttemperatur Batterie vorne" SWORD Def_t_sw_q0p1 0 0 -3276.8000 3276.7000 ECU_ADDRESS 0x007FC752 /begin FUNCTION_LIST LBATTCAL /end FUNCTION_LIST /end MEASUREMENT
/begin MEASUREMENT T_batt_ini "Startwert Batterietemperatur" SWORD Def_t_sw_q0p1 0 0 -3276.8000 3276.7000 ECU_ADDRESS 0x007FC754 /begin FUNCTION_LIST LBATTCAL /end FUNCTION_LIST /end MEASUREMENT
/begin MEASUREMENT T_batt_zw "Temporäre Batterietemperatur" SWORD Def_t_sw_q0p1 0 0 -3276.8000 3276.7000 ECU_ADDRESS 0x007FC756 /begin FUNCTION_LIST LBATTCAL /end FUNCTION_LIST /end MEASUREMENT
/begin MEASUREMENT T_batt_zw2 "Temporäre Zwischengroesse" SWORD Def_t_sw_q0p1 0 0 -3276.8000 3276.7000 ECU_ADDRESS 0x007FC758 /begin FUNCTION_LIST LBATTCAL /end FUNCTION_LIST /end MEASUREMENT
/begin MEASUREMENT T_batt_zw3 "" SWORD Def_t_sw_q0p1 0 0 -3276.8000 3276.7000 ECU_ADDRESS 0x007FC75A /begin FUNCTION_LIST LBATTCAL /end FUNCTION_LIST /end MEASUREMENT
/begin MEASUREMENT Tumg_dt "Temporäre zwischengroesse" SWORD Def_t_sw_q0p1 0 0 -3276.8000 3276.7000 ECU_ADDRESS 0x007FC75C /begin FUNCTION_LIST LBATTCAL /end FUNCTION_LIST /end MEASUREMENT
/begin MEASUREMENT Tumg_tp "" SWORD Def_t_sw_q0p1 0 0 -3276.8000 3276.7000 ECU_ADDRESS 0x007FC75E /begin FUNCTION_LIST LBATTCAL /end FUNCTION_LIST /end MEASUREMENT
/begin MEASUREMENT Batt_tfil "Zeitkonstante Batterie" UWORD Def_f_uw_b1 0 0 0.0 9.99984741210938e-1 ECU_ADDRESS 0x007FC760 /begin FUNCTION_LIST LBATTCAL /end FUNCTION_LIST /end MEASUREMENT
/begin MEASUREMENT Batt_ort "Batterieeinbauort" UBYTE Def_st_ub_q1 0 0 0.0 255.0000 ECU_ADDRESS 0x007FC763 /begin FUNCTION_LIST LBATTCAL /end FUNCTION_LIST /end MEASUREMENT
/begin MEASUREMENT N_nstart "Motordrehzahl nach Motorstart" SWORD Def_n_sw_q1p0 0 0 -32768.0000 32767.0000 ECU_ADDRESS 0x007FC77C /begin FUNCTION_LIST LDSTGEN /end FUNCTION_LIST /end MEASUREMENT
/begin MEASUREMENT Dfpropval "" UWORD Def_f_uw_b32 0 0 0.0 31.9995 ECU_ADDRESS 0x007FC77E /begin FUNCTION_LIST LDSTGEN /end FUNCTION_LIST /end MEASUREMENT
/begin MEASUREMENT Dffgen "ss_msv.dat" UBYTE Def_f_ub_b100 0 0 0.0 99.6093 ECU_ADDRESS 0x007FC780 /begin FUNCTION_LIST LDSTGEN /end FUNCTION_LIST /end MEASUREMENT
/begin MEASUREMENT St_ldstgen "Lastzustand Generator elektrisch/thermisch" UBYTE Def_st_ub_q1 0 0 0.0 255.0000 ECU_ADDRESS 0x007FC781 /begin FUNCTION_LIST LDSTGEN /end FUNCTION_LIST /end MEASUREMENT
/begin MEASUREMENT Dfsumme "DFMonitor Summe FASTA" FLOAT32_IEEE Def_f_r32 0 0 1.0000 340282346638528860000000000000000000000.0 ECU_ADDRESS 0x008004B0 /begin FUNCTION_LIST LDSTGEN /end FUNCTION_LIST /end MEASUREMENT
/begin MEASUREMENT Dfwanzahl "DF-Wertezähler" FLOAT32_IEEE Def_f_r32 0 0 1.0000 340282346638528860000000000000000000000.0 ECU_ADDRESS 0x008004B4 /begin FUNCTION_LIST LDSTGEN /end FUNCTION_LIST /end MEASUREMENT
/begin MEASUREMENT Dfmonitor "DF-Monitor für FASTA" UBYTE Def_f_ub_b100 0 0 0.0 99.6093 ECU_ADDRESS 0x008004B8 /begin FUNCTION_LIST LDSTGEN /end FUNCTION_LIST /end MEASUREMENT
/begin MEASUREMENT Ierr_fil "Gefilterter Erregerstrom" UBYTE Def_i_ub_q0p125 0 0 0.0 31.8750 ECU_ADDRESS 0x008004AE /begin FUNCTION_LIST LDSTGEN /end FUNCTION_LIST /end MEASUREMENT
/begin MEASUREMENT N_idlibs "Leerlaufdrehzahlvorgabe von LC-Powermanagement" UBYTE Def_st_ub_q1 0 0 0.0 255.0000 ECU_ADDRESS 0x008004B9 /begin FUNCTION_LIST LLPMCTRL /end FUNCTION_LIST /end MEASUREMENT
/begin MEASUREMENT St_llranh0.B_idlgspec "" UBYTE Def_bit_ub_0 0 0 0.0 255.0 ECU_ADDRESS 0x007FC7F6 /begin FUNCTION_LIST LLRANH /end FUNCTION_LIST BIT_MASK 0x1 /end MEASUREMENT
/begin MEASUREMENT St_llranh0.B_nsub "Bedingung für Solldrehzahlanhebung bei niedriger Batteriespannung" UBYTE Def_bit_ub_1 0 0 0.0 255.0 ECU_ADDRESS 0x007FC7F6 /begin FUNCTION_LIST LLRANH /end FUNCTION_LIST BIT_MASK 0x2 /end MEASUREMENT
/begin MEASUREMENT St_llranh0.B_idl_tp "Temporäres Berechnungsbit" UBYTE Def_bit_ub_2 0 0 0.0 255.0 ECU_ADDRESS 0x007FC7F6 /begin FUNCTION_LIST LLRANH /end FUNCTION_LIST BIT_MASK 0x4 /end MEASUREMENT
/begin MEASUREMENT St_llranh0 "Statuswort" UBYTE Def_st_ub_q1 0 0 0.0 255.0000 ECU_ADDRESS 0x007FC7F6 /begin FUNCTION_LIST LLRANH /end FUNCTION_LIST /end MEASUREMENT
/begin MEASUREMENT Nslb "N_soll Korrektur von Ladebilanz Batterie" SWORD Def_n_sw_q1p0 0 0 0.0 32767.0000 ECU_ADDRESS 0x007FC7F4 /begin FUNCTION_LIST LLRANH /end FUNCTION_LIST /end MEASUREMENT
/begin MEASUREMENT St_dmdblock.B_timmin "" UBYTE Def_bit_ub_0 0 0 0.0 255.0 ECU_ADDRESS 0x007FC7FE /begin FUNCTION_LIST LOADRESP /end FUNCTION_LIST BIT_MASK 0x1 /end MEASUREMENT
/begin MEASUREMENT St_dmdblock.B_timmax "" UBYTE Def_bit_ub_1 0 0 0.0 255.0 ECU_ADDRESS 0x007FC7FE /begin FUNCTION_LIST LOADRESP /end FUNCTION_LIST BIT_MASK 0x2 /end MEASUREMENT
/begin MEASUREMENT St_dmdblock.B_dmd_frei "" UBYTE Def_bit_ub_2 0 0 0.0 255.0 ECU_ADDRESS 0x007FC7FE /begin FUNCTION_LIST LOADRESP /end FUNCTION_LIST BIT_MASK 0x4 /end MEASUREMENT
/begin MEASUREMENT St_dmdblock "Statuswort" UBYTE Def_st_ub_q1 0 0 0.0 255.0000 ECU_ADDRESS 0x007FC7FE /begin FUNCTION_LIST LOADRESP /end FUNCTION_LIST /end MEASUREMENT
/begin MEASUREMENT St_loadresp.B_lroff2 "" UBYTE Def_bit_ub_1 0 0 0.0 255.0 ECU_ADDRESS 0x007FBCCE /begin FUNCTION_LIST LOADRESP /end FUNCTION_LIST BIT_MASK 0x2 /end MEASUREMENT
/begin MEASUREMENT St_loadresp0.B_genoffst "Bedingung Generatorabschaltung im Start" UBYTE Def_bit_ub_0 0 0 0.0 255.0 ECU_ADDRESS 0x007FC7FF /begin FUNCTION_LIST LOADRESP /end FUNCTION_LIST BIT_MASK 0x1 /end MEASUREMENT
/begin MEASUREMENT St_loadresp0.B_genoffmd "Abschaltung Generator angefordert" UBYTE Def_bit_ub_1 0 0 0.0 255.0 ECU_ADDRESS 0x007FC7FF /begin FUNCTION_LIST LOADRESP /end FUNCTION_LIST BIT_MASK 0x2 /end MEASUREMENT
/begin MEASUREMENT St_loadresp0.B_fub "Bedingung: Fehler Batteriespannungssensor" UBYTE Def_bit_ub_2 0 0 0.0 255.0 ECU_ADDRESS 0x007FC7FF /begin FUNCTION_LIST LOADRESP /end FUNCTION_LIST BIT_MASK 0x4 /end MEASUREMENT
/begin MEASUREMENT St_loadresp0 "Statuswort" UBYTE Def_st_ub_q1 0 0 0.0 255.0000 ECU_ADDRESS 0x007FC7FF /begin FUNCTION_LIST LOADRESP /end FUNCTION_LIST /end MEASUREMENT
/begin MEASUREMENT St_loadresp10ms.B_mdgrenz "Bedingung Generator im Modus Momentenbegrenzung" UBYTE Def_bit_ub_0 0 0 0.0 255.0 ECU_ADDRESS 0x007FC800 /begin FUNCTION_LIST LOADRESP /end FUNCTION_LIST BIT_MASK 0x1 /end MEASUREMENT
/begin MEASUREMENT St_loadresp10ms "Statuswort" UBYTE Def_st_ub_q1 0 0 0.0 255.0000 ECU_ADDRESS 0x007FC800 /begin FUNCTION_LIST LOADRESP /end FUNCTION_LIST /end MEASUREMENT
/begin MEASUREMENT St_loadresp_nv0.B_genoffvl "Bedingung Generatorabschaltung bei Vollast" UBYTE Def_bit_ub_0 0 0 0.0 255.0 ECU_ADDRESS 0x008004BA /begin FUNCTION_LIST LOADRESP /end FUNCTION_LIST BIT_MASK 0x1 /end MEASUREMENT
/begin MEASUREMENT St_loadresp_nv0 "Statuswort" UBYTE Def_st_ub_q1 0 0 0.0 255.0000 ECU_ADDRESS 0x008004BA /begin FUNCTION_LIST LOADRESP /end FUNCTION_LIST /end MEASUREMENT
/begin MEASUREMENT Md_grenz "Maximalmoment Generator an BSDII" SWORD Def_m_sw_q0p1 0 0 -3276.8000 3276.7000 ECU_ADDRESS 0x007FC7FC /begin FUNCTION_LIST LOADRESP /end FUNCTION_LIST /end MEASUREMENT
/begin MEASUREMENT Tlrgen "Sollwert Load- Response- Zeit Generator" UBYTE Def_td_ub_q0p1 0 0 0.0 25.5000 ECU_ADDRESS 0x007FC801 /begin FUNCTION_LIST LOADRESP /end FUNCTION_LIST /end MEASUREMENT
/begin MEASUREMENT Tlrgen2 "Sollwert Load- Response- Zeit Generator2" UBYTE Def_td_ub_q0p1 0 0 0.0 25.5000 ECU_ADDRESS 0x007FC802 /begin FUNCTION_LIST LOADRESP /end FUNCTION_LIST /end MEASUREMENT
/begin MEASUREMENT Z_dmdblock "" UBYTE Def_dez_ub_q1 0 0 0.0 255.0000 ECU_ADDRESS 0x008004BB /begin FUNCTION_LIST LOADRESP /end FUNCTION_LIST /end MEASUREMENT
/begin MEASUREMENT Loadresp "Loadresponse Zeit aus Kennfeldrechnung (alte Version)" UBYTE Def_td_ub_q0p1 0 0 0.0 25.5000 ECU_ADDRESS 0x007FC803 /begin FUNCTION_LIST LOADRESP /end FUNCTION_LIST /end MEASUREMENT
/begin MEASUREMENT St_mandetek.B_mandetekml "Bedingung Freigabe Manipulationserkennung " UWORD Def_bit_uw_0 0 0 0.0 65535.0 ECU_ADDRESS 0x007FC944 /begin FUNCTION_LIST MANDETEK /end FUNCTION_LIST BIT_MASK 0x1 /end MEASUREMENT
/begin MEASUREMENT St_mandetek.B_mandetekh "Bedingung Manipulationserkenung Hydraulikpfad aktiv" UWORD Def_bit_uw_1 0 0 0.0 65535.0 ECU_ADDRESS 0x007FC944 /begin FUNCTION_LIST MANDETEK /end FUNCTION_LIST BIT_MASK 0x2 /end MEASUREMENT
/begin MEASUREMENT St_mandetek.B_mandetekl "Bedingung Manipulationserkenung Luftpfad aktiv" UWORD Def_bit_uw_2 0 0 0.0 65535.0 ECU_ADDRESS 0x007FC944 /begin FUNCTION_LIST MANDETEK /end FUNCTION_LIST BIT_MASK 0x4 /end MEASUREMENT
/begin MEASUREMENT St_mandetek.B_mandetek1 "Bedingung für Hydraulikpfadaktivierung temp 1" UWORD Def_bit_uw_3 0 0 0.0 65535.0 ECU_ADDRESS 0x007FC944 /begin FUNCTION_LIST MANDETEK /end FUNCTION_LIST BIT_MASK 0x8 /end MEASUREMENT
/begin MEASUREMENT St_mandetek.B_mandetek2 "Bedingung für Hydraulikpfadaktivierung temp. 2" UWORD Def_bit_uw_4 0 0 0.0 65535.0 ECU_ADDRESS 0x007FC944 /begin FUNCTION_LIST MANDETEK /end FUNCTION_LIST BIT_MASK 0x10 /end MEASUREMENT
/begin MEASUREMENT St_mandetek.B_mandetek3 "Bedingung für Hydraulikpfadaktivierung temp. 3" UWORD Def_bit_uw_5 0 0 0.0 65535.0 ECU_ADDRESS 0x007FC944 /begin FUNCTION_LIST MANDETEK /end FUNCTION_LIST BIT_MASK 0x20 /end MEASUREMENT
/begin MEASUREMENT St_mandetek.B_mandetek4 "Bedingung für Luftpfadaktivierung temp 4" UWORD Def_bit_uw_6 0 0 0.0 65535.0 ECU_ADDRESS 0x007FC944 /begin FUNCTION_LIST MANDETEK /end FUNCTION_LIST BIT_MASK 0x40 /end MEASUREMENT
/begin MEASUREMENT St_mandetek.B_mandetek5 "Bedingung für Luftpfadaktivierung temp 5" UWORD Def_bit_uw_7 0 0 0.0 65535.0 ECU_ADDRESS 0x007FC944 /begin FUNCTION_LIST MANDETEK /end FUNCTION_LIST BIT_MASK 0x80 /end MEASUREMENT
/begin MEASUREMENT St_mandetek "Statuswort" UWORD Def_st_uw_q1 0 0 0.0 65535.0000 ECU_ADDRESS 0x007FC944 /begin FUNCTION_LIST MANDETEK /end FUNCTION_LIST /end MEASUREMENT
/begin MEASUREMENT Twhydrcntg "Zähler Tuningwahrscheinlichk Hydraulikpfad gesamt" ULONG Def_dez_ul_q1 0 0 1.0000 4294967295.0000 ECU_ADDRESS 0x00800978 /begin FUNCTION_LIST MANDETEK /end FUNCTION_LIST /end MEASUREMENT
/begin MEASUREMENT Twluftcntg "Zähler Tuningwahrscheinlichkeit Luftpfad gesamt" ULONG Def_dez_ul_q1 0 0 1.0000 4294967264.0000 ECU_ADDRESS 0x0080097C /begin FUNCTION_LIST MANDETEK /end FUNCTION_LIST /end MEASUREMENT
/begin MEASUREMENT Spkm_st "Historienspeicher Kilometerstand" UWORD Def_km_uw_q10 0 0 0.0 655350.0000 ECU_ADDRESS 0x00800980 ARRAY_SIZE 120 /begin FUNCTION_LIST MANDETEK /end FUNCTION_LIST /end MEASUREMENT
/begin MEASUREMENT Spman_f_hydr "Historienspeicher rel. Fehler Hydraulikpfad begrenzt" UWORD Def_f_uw_b4 0 0 0.0 3.9999 ECU_ADDRESS 0x00800A70 ARRAY_SIZE 120 /begin FUNCTION_LIST MANDETEK /end FUNCTION_LIST /end MEASUREMENT
/begin MEASUREMENT Spman_f_luft "Historienspeicher rel. Fehler Luftpfad begrenzt" UWORD Def_f_uw_b4 0 0 0.0 3.9999 ECU_ADDRESS 0x00800B60 ARRAY_SIZE 120 /begin FUNCTION_LIST MANDETEK /end FUNCTION_LIST /end MEASUREMENT
/begin MEASUREMENT Tw "Tuningwahrscheinlichkeit" UWORD Def_f_uw_b100 0 0 0.0 99.9984 ECU_ADDRESS 0x00800C50 /begin FUNCTION_LIST MANDETEK /end FUNCTION_LIST /end MEASUREMENT
/begin MEASUREMENT Twhydr "Tuningwahrscheinlichkeit Hydraulikpfad" UWORD Def_f_uw_b100 0 0 0.0 99.9984 ECU_ADDRESS 0x00800C52 /begin FUNCTION_LIST MANDETEK /end FUNCTION_LIST /end MEASUREMENT
/begin MEASUREMENT Twhydrcnt "Tuningwahrscheinlichkeitszähler Hydraulokpfad" UWORD Def_dez_uw_q1 0 0 0.0 65535.0000 ECU_ADDRESS 0x00800C54 /begin FUNCTION_LIST MANDETEK /end FUNCTION_LIST /end MEASUREMENT
/begin MEASUREMENT Twhydrmax "max. Tuningwahrscheinlichkeit Hydraulikpfad" UWORD Def_f_uw_b100 0 0 0.0 99.9984 ECU_ADDRESS 0x00800C56 /begin FUNCTION_LIST MANDETEK /end FUNCTION_LIST /end MEASUREMENT
/begin MEASUREMENT Twluft "Tuningwahrscheinlichkeit Luftpfad" UWORD Def_f_uw_b100 0 0 0.0 99.9984 ECU_ADDRESS 0x00800C58 /begin FUNCTION_LIST MANDETEK /end FUNCTION_LIST /end MEASUREMENT
/begin MEASUREMENT Twluftcnt "Tuningwahrscheinlichkeitszähler Luftpfad" UWORD Def_dez_uw_q1 0 0 0.0 65535.0000 ECU_ADDRESS 0x00800C5A /begin FUNCTION_LIST MANDETEK /end FUNCTION_LIST /end MEASUREMENT
/begin MEASUREMENT Twluftmax "max. Tuningwahrscheinlichkeit Luftpfad" UWORD Def_f_uw_b100 0 0 0.0 99.9984 ECU_ADDRESS 0x00800C5C /begin FUNCTION_LIST MANDETEK /end FUNCTION_LIST /end MEASUREMENT
/begin MEASUREMENT Spla_n "Historienspeicher Lambdawert normiert" UBYTE Def_f_ub_b2 0 0 0.0 1.9921 ECU_ADDRESS 0x00800C60 ARRAY_SIZE 120 /begin FUNCTION_LIST MANDETEK /end FUNCTION_LIST /end MEASUREMENT
/begin MEASUREMENT Spme_n "Historienspeicher Einspritzmasse normiert" UBYTE Def_f_ub_b2 0 0 0.0 1.9921 ECU_ADDRESS 0x00800CD8 ARRAY_SIZE 120 /begin FUNCTION_LIST MANDETEK /end FUNCTION_LIST /end MEASUREMENT
/begin MEASUREMENT Spml_n "Historienspeicher Luftmasse pro Zylinder normiert" UBYTE Def_f_ub_b2 0 0 0.0 1.9921 ECU_ADDRESS 0x00800D50 ARRAY_SIZE 120 /begin FUNCTION_LIST MANDETEK /end FUNCTION_LIST /end MEASUREMENT
/begin MEASUREMENT Spnkw_n "Historienspeicher Motordrehzahl an der Kurbelwelle normiert" UBYTE Def_f_ub_b2 0 0 0.0 1.9921 ECU_ADDRESS 0x00800DC8 ARRAY_SIZE 120 /begin FUNCTION_LIST MANDETEK /end FUNCTION_LIST /end MEASUREMENT
/begin MEASUREMENT Sppld_n "Historienspeicher Ladedruck normiert" UBYTE Def_f_ub_b2 0 0 0.0 1.9921 ECU_ADDRESS 0x00800E40 ARRAY_SIZE 120 /begin FUNCTION_LIST MANDETEK /end FUNCTION_LIST /end MEASUREMENT
/begin MEASUREMENT Sptv_agr_n "Historienspeicher Tastverhältnis AGR-Steller normiert" UBYTE Def_f_ub_b2 0 0 0.0 1.9921 ECU_ADDRESS 0x00800EB8 ARRAY_SIZE 120 /begin FUNCTION_LIST MANDETEK /end FUNCTION_LIST /end MEASUREMENT
/begin MEASUREMENT Sptv_pld_n "Historienspeicher Tastverhältnis Ladedrucksteller normiert" UBYTE Def_f_ub_b2 0 0 0.0 1.9921 ECU_ADDRESS 0x00800F30 ARRAY_SIZE 120 /begin FUNCTION_LIST MANDETEK /end FUNCTION_LIST /end MEASUREMENT
/begin MEASUREMENT Spwped_n "Historienspeicher Pedalwertgeberposition normiert" UBYTE Def_f_ub_b2 0 0 0.0 1.9921 ECU_ADDRESS 0x00800FA8 ARRAY_SIZE 120 /begin FUNCTION_LIST MANDETEK /end FUNCTION_LIST /end MEASUREMENT
/begin MEASUREMENT Abst_hydr "Abstand Hydraulikpfadpfad" ULONG Def_f_ul_b262144 0 0 0.0 11.9998 ECU_ADDRESS 0x008004BC /begin FUNCTION_LIST MANDETEK /end FUNCTION_LIST /end MEASUREMENT
/begin MEASUREMENT Abst_luft "Abstand Luftpfad" ULONG Def_f_ul_b262144 0 0 0.0 15.9997 ECU_ADDRESS 0x008004C0 /begin FUNCTION_LIST MANDETEK /end FUNCTION_LIST /end MEASUREMENT
/begin MEASUREMENT F_hydr "rel. Fehler Hydraulikpfadpfad" ULONG Def_f_ul_b262144 0 0 0.0 196596.0001 ECU_ADDRESS 0x008004C4 /begin FUNCTION_LIST MANDETEK /end FUNCTION_LIST /end MEASUREMENT
/begin MEASUREMENT F_hydra "abs. Fehler Hydraulikpfadpfad" ULONG Def_f_ul_b262144 0 0 0.0 11.9998 ECU_ADDRESS 0x008004C8 /begin FUNCTION_LIST MANDETEK /end FUNCTION_LIST /end MEASUREMENT
/begin MEASUREMENT F_luft "rel. Fehler Luftpfadpfad" ULONG Def_f_ul_b262144 0 0 0.0 262128.0002 ECU_ADDRESS 0x008004CC /begin FUNCTION_LIST MANDETEK /end FUNCTION_LIST /end MEASUREMENT
/begin MEASUREMENT F_lufta "abs. Fehler Luftpfad" ULONG Def_f_ul_b262144 0 0 0.0 15.9997 ECU_ADDRESS 0x008004D0 /begin FUNCTION_LIST MANDETEK /end FUNCTION_LIST /end MEASUREMENT
/begin MEASUREMENT Fhydr_temp1 "rel. Fehler Hydraulikpfad temporär 1" ULONG Def_f_ul_b262144 0 0 0.0 65532.0000 ECU_ADDRESS 0x008004D4 /begin FUNCTION_LIST MANDETEK /end FUNCTION_LIST /end MEASUREMENT
/begin MEASUREMENT Fhydr_temp2 "rel. Fehler Hydraulikpfad temporär 2" ULONG Def_f_ul_b262144 0 0 0.0 65532.0000 ECU_ADDRESS 0x008004D8 /begin FUNCTION_LIST MANDETEK /end FUNCTION_LIST /end MEASUREMENT
/begin MEASUREMENT Fhydr_temp3 "rel. Fehler Hydraulikpfad temporär 3" ULONG Def_f_ul_b262144 0 0 0.0 65532.0000 ECU_ADDRESS 0x008004DC /begin FUNCTION_LIST MANDETEK /end FUNCTION_LIST /end MEASUREMENT
/begin MEASUREMENT Fluft_temp1 "rel. Fehler Luftpfad temporär 1" ULONG Def_f_ul_b262144 0 0 0.0 65532.0000 ECU_ADDRESS 0x008004E0 /begin FUNCTION_LIST MANDETEK /end FUNCTION_LIST /end MEASUREMENT
/begin MEASUREMENT Fluft_temp2 "rel. Fehler Luftpfad temporär 2" ULONG Def_f_ul_b262144 0 0 0.0 65532.0000 ECU_ADDRESS 0x008004E4 /begin FUNCTION_LIST MANDETEK /end FUNCTION_LIST /end MEASUREMENT
/begin MEASUREMENT Fluft_temp3 "rel. Fehler Luftpfad temporär 3" ULONG Def_f_ul_b262144 0 0 0.0 65532.0000 ECU_ADDRESS 0x008004E8 /begin FUNCTION_LIST MANDETEK /end FUNCTION_LIST /end MEASUREMENT
/begin MEASUREMENT Fluft_temp4 "rel. Fehler Luftpfad temporär 4" ULONG Def_f_ul_b262144 0 0 0.0 65532.0000 ECU_ADDRESS 0x008004EC /begin FUNCTION_LIST MANDETEK /end FUNCTION_LIST /end MEASUREMENT
/begin MEASUREMENT Sigmanme "Ringpuffer Einspritzmasse aktuell" SWORD Def_me_sw_q0p01 0 0 -327.6800 327.6700 ECU_ADDRESS 0x008004F0 ARRAY_SIZE 20 /begin FUNCTION_LIST MANDETEK /end FUNCTION_LIST /end MEASUREMENT
/begin MEASUREMENT Sigmanmlh "Ringpuffer Luftmasse pro Zylinder (Hydraulikpfad)" SWORD Def_ml_sw_q0p1 0 0 -3276.8000 3276.7000 ECU_ADDRESS 0x00800518 ARRAY_SIZE 20 /begin FUNCTION_LIST MANDETEK /end FUNCTION_LIST /end MEASUREMENT
/begin MEASUREMENT Sigmanmll "Ringpuffer Luftmasse pro Zylinder (Luftpfad)" SWORD Def_ml_sw_q0p1 0 0 -3276.8000 3276.7000 ECU_ADDRESS 0x00800540 ARRAY_SIZE 20 /begin FUNCTION_LIST MANDETEK /end FUNCTION_LIST /end MEASUREMENT
/begin MEASUREMENT Sigmanpld "Ringpuffer Ladedruck" SWORD Def_p_sw_q1 0 0 -32768.0000 32767.0000 ECU_ADDRESS 0x00800568 ARRAY_SIZE 20 /begin FUNCTION_LIST MANDETEK /end FUNCTION_LIST /end MEASUREMENT
/begin MEASUREMENT Sigmantvagr "Ringpuffer Tastverhältnis AGR-Steller" SWORD Def_tv_sw_q0p01 0 0 -327.6800 327.6700 ECU_ADDRESS 0x00800590 ARRAY_SIZE 20 /begin FUNCTION_LIST MANDETEK /end FUNCTION_LIST /end MEASUREMENT
/begin MEASUREMENT Sigmantvpld "Ringpuffer Tastverhältnis Ladedrucksteller" SWORD Def_tv_sw_q0p01 0 0 -327.6800 327.6700 ECU_ADDRESS 0x008005B8 ARRAY_SIZE 20 /begin FUNCTION_LIST MANDETEK /end FUNCTION_LIST /end MEASUREMENT
/begin MEASUREMENT Abst_temp1 "Abstand Hydraulikpfad temporär 1" UWORD Def_f_uw_b4 0 0 0.0 3.9999 ECU_ADDRESS 0x008005E0 /begin FUNCTION_LIST MANDETEK /end FUNCTION_LIST /end MEASUREMENT
/begin MEASUREMENT Abst_temp2 "Abstand Hydraulikpfad temporär 2" UWORD Def_f_uw_b4 0 0 0.0 3.9999 ECU_ADDRESS 0x008005E2 /begin FUNCTION_LIST MANDETEK /end FUNCTION_LIST /end MEASUREMENT
/begin MEASUREMENT Abst_temp3 "Abstand Hydraulikpfad temporär 3" UWORD Def_f_uw_b4 0 0 0.0 3.9999 ECU_ADDRESS 0x008005E4 /begin FUNCTION_LIST MANDETEK /end FUNCTION_LIST /end MEASUREMENT
/begin MEASUREMENT Abst_temp4 "Abstand Luftpfad temporär 5" UWORD Def_f_uw_b4 0 0 0.0 3.9999 ECU_ADDRESS 0x008005E6 /begin FUNCTION_LIST MANDETEK /end FUNCTION_LIST /end MEASUREMENT
/begin MEASUREMENT Abst_temp5 "Abstand Luftpfad temporär 6" UWORD Def_f_uw_b4 0 0 0.0 3.9999 ECU_ADDRESS 0x008005E8 /begin FUNCTION_LIST MANDETEK /end FUNCTION_LIST /end MEASUREMENT
/begin MEASUREMENT Abst_temp6 "Abstand Luftpfad temporär 7" UWORD Def_f_uw_b4 0 0 0.0 3.9999 ECU_ADDRESS 0x008005EA /begin FUNCTION_LIST MANDETEK /end FUNCTION_LIST /end MEASUREMENT
/begin MEASUREMENT Abst_temp7 "Abstand Luftpfad temporär 8" UWORD Def_f_uw_b4 0 0 0.0 3.9999 ECU_ADDRESS 0x008005EC /begin FUNCTION_LIST MANDETEK /end FUNCTION_LIST /end MEASUREMENT
/begin MEASUREMENT Km_sth "Kilometerstand Hydraulikpfad" UWORD Def_km_uw_q10 0 0 0.0 655350.0000 ECU_ADDRESS 0x008005EE /begin FUNCTION_LIST MANDETEK /end FUNCTION_LIST /end MEASUREMENT
/begin MEASUREMENT Km_stl "Kilometerstand Luftpfad" UWORD Def_km_uw_q10 0 0 0.0 655350.0000 ECU_ADDRESS 0x008005F0 /begin FUNCTION_LIST MANDETEK /end FUNCTION_LIST /end MEASUREMENT
/begin MEASUREMENT Sigmanla "Ringpuffer La_ist1" UWORD Def_f_uw_b16 0 0 0.0 15.9997 ECU_ADDRESS 0x008005F2 ARRAY_SIZE 20 /begin FUNCTION_LIST MANDETEK /end FUNCTION_LIST /end MEASUREMENT
/begin MEASUREMENT Gewh "Gewicht Hydraulikpfad" UBYTE Def_dez_ub_q1 0 0 0.0 255.0000 ECU_ADDRESS 0x0080061C /begin FUNCTION_LIST MANDETEK /end FUNCTION_LIST /end MEASUREMENT
/begin MEASUREMENT Gewl "Gewicht Luftpfad" UBYTE Def_dez_ub_q1 0 0 0.0 255.0000 ECU_ADDRESS 0x0080061D /begin FUNCTION_LIST MANDETEK /end FUNCTION_LIST /end MEASUREMENT
/begin MEASUREMENT Ghydrla "Gewicht Hydraulikpfad La_ist1" UBYTE Def_f_ub_b2 0 0 0.0079 1.9921 ECU_ADDRESS 0x00800620 ARRAY_SIZE 120 /begin FUNCTION_LIST MANDETEK /end FUNCTION_LIST /end MEASUREMENT
/begin MEASUREMENT Ghydrme "Gewicht Hydraulikpfad Me_ist" UBYTE Def_f_ub_b2 0 0 0.0079 1.9921 ECU_ADDRESS 0x00800698 ARRAY_SIZE 120 /begin FUNCTION_LIST MANDETEK /end FUNCTION_LIST /end MEASUREMENT
/begin MEASUREMENT Ghydrml "Gewicht Hydraulikpfad Ml" UBYTE Def_f_ub_b2 0 0 0.0079 1.9921 ECU_ADDRESS 0x00800710 ARRAY_SIZE 120 /begin FUNCTION_LIST MANDETEK /end FUNCTION_LIST /end MEASUREMENT
/begin MEASUREMENT Gluftml "Gewicht Luftpfad Ml" UBYTE Def_f_ub_b2 0 0 0.0079 1.9921 ECU_ADDRESS 0x00800788 ARRAY_SIZE 120 /begin FUNCTION_LIST MANDETEK /end FUNCTION_LIST /end MEASUREMENT
/begin MEASUREMENT Gluftpld "Gewicht Luftpfad Pld" UBYTE Def_f_ub_b2 0 0 0.0079 1.9921 ECU_ADDRESS 0x00800800 ARRAY_SIZE 120 /begin FUNCTION_LIST MANDETEK /end FUNCTION_LIST /end MEASUREMENT
/begin MEASUREMENT Glufttvagr "Gewicht Luftpfad Tastverhältnis Agr" UBYTE Def_f_ub_b2 0 0 0.0079 1.9921 ECU_ADDRESS 0x00800878 ARRAY_SIZE 120 /begin FUNCTION_LIST MANDETEK /end FUNCTION_LIST /end MEASUREMENT
/begin MEASUREMENT Glufttvpld "Gewicht Luftpfad Tastverhältnis Pld" UBYTE Def_f_ub_b2 0 0 0.0079 1.9921 ECU_ADDRESS 0x008008F0 ARRAY_SIZE 120 /begin FUNCTION_LIST MANDETEK /end FUNCTION_LIST /end MEASUREMENT
/begin MEASUREMENT Hydrstat "Zähler für quasistationären Zustand Hydraulikpfad" UBYTE Def_dez_ub_q1 0 0 0.0 255.0000 ECU_ADDRESS 0x00800968 /begin FUNCTION_LIST MANDETEK /end FUNCTION_LIST /end MEASUREMENT
/begin MEASUREMENT La_n "Lambdawert normiert" UBYTE Def_f_ub_b2 0 0 0.0 1.9921 ECU_ADDRESS 0x00800969 /begin FUNCTION_LIST MANDETEK /end FUNCTION_LIST /end MEASUREMENT
/begin MEASUREMENT Luftstat "Zähler für quasistationären Zustand Luftpfad" UBYTE Def_dez_ub_q1 0 0 0.0 255.0000 ECU_ADDRESS 0x0080096A /begin FUNCTION_LIST MANDETEK /end FUNCTION_LIST /end MEASUREMENT
/begin MEASUREMENT Me_n "Einspritzmasse normiert" UBYTE Def_f_ub_b2 0 0 0.0 1.9921 ECU_ADDRESS 0x0080096B /begin FUNCTION_LIST MANDETEK /end FUNCTION_LIST /end MEASUREMENT
/begin MEASUREMENT Mlh_n "Luftmasse pro Zylinder normiert Hydraulikpfad" UBYTE Def_f_ub_b2 0 0 0.0 1.9921 ECU_ADDRESS 0x0080096C /begin FUNCTION_LIST MANDETEK /end FUNCTION_LIST /end MEASUREMENT
/begin MEASUREMENT Mll_n "Luftmasse pro Zylinder normiert Luftpfad" UBYTE Def_f_ub_b2 0 0 0.0 1.9921 ECU_ADDRESS 0x0080096D /begin FUNCTION_LIST MANDETEK /end FUNCTION_LIST /end MEASUREMENT
/begin MEASUREMENT Nkwh_n "Motordrehzahl an der Kurbelwelle fuer Hydraulikpfad normiert" UBYTE Def_f_ub_b2 0 0 0.0 1.9921 ECU_ADDRESS 0x0080096E /begin FUNCTION_LIST MANDETEK /end FUNCTION_LIST /end MEASUREMENT
/begin MEASUREMENT Nkwl_n "Motordrehzahl an der Kurbelwelle fuer Luftpfad normiert" UBYTE Def_f_ub_b2 0 0 0.0 1.9921 ECU_ADDRESS 0x0080096F /begin FUNCTION_LIST MANDETEK /end FUNCTION_LIST /end MEASUREMENT
/begin MEASUREMENT Pld_n "Ladedruck normiert" UBYTE Def_f_ub_b2 0 0 0.0 1.9921 ECU_ADDRESS 0x00800970 /begin FUNCTION_LIST MANDETEK /end FUNCTION_LIST /end MEASUREMENT
/begin MEASUREMENT Tv_agr_n "Tastverhältnis AGR-Steller normiert" UBYTE Def_f_ub_b2 0 0 0.0 1.9921 ECU_ADDRESS 0x00800971 /begin FUNCTION_LIST MANDETEK /end FUNCTION_LIST /end MEASUREMENT
/begin MEASUREMENT Tv_pld_n "Tastverhältnis Ladedrucksteller normiert" UBYTE Def_f_ub_b2 0 0 0.0 1.9921 ECU_ADDRESS 0x00800972 /begin FUNCTION_LIST MANDETEK /end FUNCTION_LIST /end MEASUREMENT
/begin MEASUREMENT Wpedh_n "Pedalwertgeberposition Hydraulikpfad normiert" UBYTE Def_f_ub_b2 0 0 0.0 1.9921 ECU_ADDRESS 0x00800973 /begin FUNCTION_LIST MANDETEK /end FUNCTION_LIST /end MEASUREMENT
/begin MEASUREMENT Wpedl_n "Pedalwertgeberposition Luftpfad normiert" UBYTE Def_f_ub_b2 0 0 0.0 1.9921 ECU_ADDRESS 0x00800974 /begin FUNCTION_LIST MANDETEK /end FUNCTION_LIST /end MEASUREMENT
/begin MEASUREMENT Z_mandetek1 "Zähler Mandetek1" UBYTE Def_dez_ub_q1 0 0 0.0 255.0000 ECU_ADDRESS 0x00800975 /begin FUNCTION_LIST MANDETEK /end FUNCTION_LIST /end MEASUREMENT
/begin MEASUREMENT Z_mandetek2 "Zähler Mandetek2" UBYTE Def_dez_ub_q1 0 0 0.0 255.0000 ECU_ADDRESS 0x00800976 /begin FUNCTION_LIST MANDETEK /end FUNCTION_LIST /end MEASUREMENT
/begin MEASUREMENT St_ozbg0.B_bosmsgc "Bedingung für Absetzen einer BOS-Meldung" UBYTE Def_bit_ub_0 0 0 0.0 255.0 ECU_ADDRESS 0x007FCC89 /begin FUNCTION_LIST OZBG /end FUNCTION_LIST BIT_MASK 0x1 /end MEASUREMENT
/begin MEASUREMENT St_ozbg0.B_mol_vb "Bedingung Ölverbrauchswarnung" UBYTE Def_bit_ub_1 0 0 0.0 255.0 ECU_ADDRESS 0x007FCC89 /begin FUNCTION_LIST OZBG /end FUNCTION_LIST BIT_MASK 0x2 /end MEASUREMENT
/begin MEASUREMENT St_ozbg0.B_mol_vl "Bedingung Ölverlustwarnung" UBYTE Def_bit_ub_2 0 0 0.0 255.0 ECU_ADDRESS 0x007FCC89 /begin FUNCTION_LIST OZBG /end FUNCTION_LIST BIT_MASK 0x4 /end MEASUREMENT
/begin MEASUREMENT St_ozbg0.B_oeltemp "Bedingung für CAN-Ausgabe der Öltemperatur" UBYTE Def_bit_ub_3 0 0 0.0 255.0 ECU_ADDRESS 0x007FCC89 /begin FUNCTION_LIST OZBG /end FUNCTION_LIST BIT_MASK 0x8 /end MEASUREMENT
/begin MEASUREMENT St_ozbg0.B_oelverb "" UBYTE Def_bit_ub_4 0 0 0.0 255.0 ECU_ADDRESS 0x007FCC89 /begin FUNCTION_LIST OZBG /end FUNCTION_LIST BIT_MASK 0x10 /end MEASUREMENT
/begin MEASUREMENT St_ozbg0.B_oelverl "" UBYTE Def_bit_ub_5 0 0 0.0 255.0 ECU_ADDRESS 0x007FCC89 /begin FUNCTION_LIST OZBG /end FUNCTION_LIST BIT_MASK 0x20 /end MEASUREMENT
/begin MEASUREMENT St_ozbg0 "Statuswort" UBYTE Def_st_ub_q1 0 0 0.0 255.0000 ECU_ADDRESS 0x007FCC89 /begin FUNCTION_LIST OZBG /end FUNCTION_LIST /end MEASUREMENT
/begin MEASUREMENT St_ozbg_nv0.B_ozkl15 "Merker für Einschalten Kl. 15" UBYTE Def_bit_ub_0 0 0 0.0 255.0 ECU_ADDRESS 0x0080102C /begin FUNCTION_LIST OZBG /end FUNCTION_LIST BIT_MASK 0x1 /end MEASUREMENT
/begin MEASUREMENT St_ozbg_nv0 "Statuswort" UBYTE Def_st_ub_q1 0 0 0.0 255.0000 ECU_ADDRESS 0x0080102C /begin FUNCTION_LIST OZBG /end FUNCTION_LIST /end MEASUREMENT
/begin MEASUREMENT Oz_tempakt "Ausgabe Öltemperatur für den Tester" SWORD Def_t_sw_q0p1 0 0 -3276.8000 3276.7000 ECU_ADDRESS 0x00801020 /begin FUNCTION_LIST OZBG /end FUNCTION_LIST /end MEASUREMENT
/begin MEASUREMENT Toel "Ausgabewert Motoröltemperatur für LoCAN" SWORD Def_t_sw_q0p1 0 0 -3276.8000 3276.7000 ECU_ADDRESS 0x00801022 /begin FUNCTION_LIST OZBG /end FUNCTION_LIST /end MEASUREMENT
/begin MEASUREMENT Toel_oz "Ausgabe Öltemperatur" SWORD Def_t_sw_q0p1 0 0 -3276.8000 3276.7000 ECU_ADDRESS 0x00801024 /begin FUNCTION_LIST OZBG /end FUNCTION_LIST /end MEASUREMENT
/begin MEASUREMENT Id_bosmg "Kennung für BOS-Meldung = Ölservice-Info" UWORD Def_dez_uw_q1 0 0 0.0 65535.0000 ECU_ADDRESS 0x00801026 /begin FUNCTION_LIST OZBG /end FUNCTION_LIST /end MEASUREMENT
/begin MEASUREMENT Bosstate "Einheit der BOS-Info (km)" UBYTE Def_dez_ub_q1 0 0 0.0 255.0000 ECU_ADDRESS 0x00801028 /begin FUNCTION_LIST OZBG /end FUNCTION_LIST /end MEASUREMENT
/begin MEASUREMENT Id_bosmgt "Kennung für BOS-Meldung vom Tester" UBYTE Def_dez_ub_q1 0 0 0.0 255.0000 ECU_ADDRESS 0x00801029 /begin FUNCTION_LIST OZBG /end FUNCTION_LIST /end MEASUREMENT
/begin MEASUREMENT Id_bosmsg "Kennung für BOS-Meldung vom Kombi" UBYTE Def_dez_ub_q1 0 0 0.0 255.0000 ECU_ADDRESS 0x0080102A /begin FUNCTION_LIST OZBG /end FUNCTION_LIST /end MEASUREMENT
/begin MEASUREMENT Oz_reset "Zieltermin_Monat_BOS_Rückstellung_2" UBYTE Def_dez_ub_q1 0 0 0.0 255.0000 ECU_ADDRESS 0x0080102B /begin FUNCTION_LIST OZBG /end FUNCTION_LIST /end MEASUREMENT
/begin MEASUREMENT Bosfxid2 "Zieltermin_Monat_BOS_Rückstellung_2" SWORD Def_dez_sw_q1 0 0 -32768.0000 32767.0000 ECU_ADDRESS 0x0080102E /begin FUNCTION_LIST OZBG /end FUNCTION_LIST /end MEASUREMENT
/begin MEASUREMENT Bosrlsm "Ausgabewert Restlaufstrecke Motoröl" SWORD Def_km_sw_q10 0 0 -327680.0000 327670.0000 ECU_ADDRESS 0x00801030 /begin FUNCTION_LIST OZBG /end FUNCTION_LIST /end MEASUREMENT
/begin MEASUREMENT Bosbtvfbk "Rest-Verfügbarkeit Motoröl in Prozent" UBYTE Def_dez_ub_q1 0 0 0.0 255.0000 ECU_ADDRESS 0x00801032 /begin FUNCTION_LIST OZBG /end FUNCTION_LIST /end MEASUREMENT
/begin MEASUREMENT Bosid2 "Zieltermin_Monat_BOS_Rückstellung_2" UBYTE Def_dez_ub_q1 0 0 0.0 255.0000 ECU_ADDRESS 0x00801033 /begin FUNCTION_LIST OZBG /end FUNCTION_LIST /end MEASUREMENT
/begin MEASUREMENT Bosjziel "Zieltermin_Monat_BOS_Rückstellung_2" UBYTE Def_dez_ub_q1 0 0 0.0 255.0000 ECU_ADDRESS 0x00801034 /begin FUNCTION_LIST OZBG /end FUNCTION_LIST /end MEASUREMENT
/begin MEASUREMENT Bosmziel "Zieltermin_Monat_BOS_Meldung_2" UBYTE Def_dez_ub_q1 0 0 0.0 255.0000 ECU_ADDRESS 0x00801035 /begin FUNCTION_LIST OZBG /end FUNCTION_LIST /end MEASUREMENT
/begin MEASUREMENT Bosprog2 "Prognose_Intervall_Zeit_BOS_Meldung_2" UBYTE Def_dez_ub_q1 0 0 0.0 255.0000 ECU_ADDRESS 0x00801036 /begin FUNCTION_LIST OZBG /end FUNCTION_LIST /end MEASUREMENT
/begin MEASUREMENT Bosres "Zieltermin_Monat_BOS_Rückstellung_2" UBYTE Def_dez_ub_q1 0 0 0.0 255.0000 ECU_ADDRESS 0x00801037 /begin FUNCTION_LIST OZBG /end FUNCTION_LIST /end MEASUREMENT
/begin MEASUREMENT Bosrw2 "Prognose_Intervall_Weg_BOS_Meldung_2" UBYTE Def_km_ub_q1000 0 0 0.0 255000.0000 ECU_ADDRESS 0x00801038 /begin FUNCTION_LIST OZBG /end FUNCTION_LIST /end MEASUREMENT
/begin MEASUREMENT Zrbosmld "anzuzeigender Zähler für durchgeführten Ölservice" UBYTE Def_dez_ub_q1 0 0 0.0 255.0000 ECU_ADDRESS 0x00801039 /begin FUNCTION_LIST OZBG /end FUNCTION_LIST /end MEASUREMENT
/begin MEASUREMENT St_ozgg0.B_oelwech "Bedingung Ölwechsel erfolgt" UBYTE Def_bit_ub_0 0 0 0.0 255.0 ECU_ADDRESS 0x007FCC8E /begin FUNCTION_LIST OZGG /end FUNCTION_LIST BIT_MASK 0x1 /end MEASUREMENT
/begin MEASUREMENT St_ozgg0.B_ozniv "Bedingung Niveausignal in Ordnung" UBYTE Def_bit_ub_1 0 0 0.0 255.0 ECU_ADDRESS 0x007FCC8E /begin FUNCTION_LIST OZGG /end FUNCTION_LIST BIT_MASK 0x2 /end MEASUREMENT
/begin MEASUREMENT St_ozgg0.B_ozperm "Bedingung Permittivitätssignal in Ordnung" UBYTE Def_bit_ub_2 0 0 0.0 255.0 ECU_ADDRESS 0x007FCC8E /begin FUNCTION_LIST OZGG /end FUNCTION_LIST BIT_MASK 0x4 /end MEASUREMENT
/begin MEASUREMENT St_ozgg0.B_oztemp "Bedingung Temperatursignal in Ordnung" UBYTE Def_bit_ub_3 0 0 0.0 255.0 ECU_ADDRESS 0x007FCC8E /begin FUNCTION_LIST OZGG /end FUNCTION_LIST BIT_MASK 0x8 /end MEASUREMENT
/begin MEASUREMENT St_ozgg0.B_ozvfchg "Bedingung für geänderte Verfügbarkeit" UBYTE Def_bit_ub_4 0 0 0.0 255.0 ECU_ADDRESS 0x007FCC8E /begin FUNCTION_LIST OZGG /end FUNCTION_LIST BIT_MASK 0x10 /end MEASUREMENT
/begin MEASUREMENT St_ozgg0.B_svcntchg "Bedingung für über Tester geänderten Servicezähler" UBYTE Def_bit_ub_5 0 0 0.0 255.0 ECU_ADDRESS 0x007FCC8E /begin FUNCTION_LIST OZGG /end FUNCTION_LIST BIT_MASK 0x20 /end MEASUREMENT
/begin MEASUREMENT St_ozgg0.B_ozvfchgt "" UBYTE Def_bit_ub_6 0 0 0.0 255.0 ECU_ADDRESS 0x007FCC8E /begin FUNCTION_LIST OZGG /end FUNCTION_LIST BIT_MASK 0x40 /end MEASUREMENT
/begin MEASUREMENT St_ozgg0.B_ozzeitdmew "" UBYTE Def_bit_ub_7 0 0 0.0 255.0 ECU_ADDRESS 0x007FCC8E /begin FUNCTION_LIST OZGG /end FUNCTION_LIST BIT_MASK 0x80 /end MEASUREMENT
/begin MEASUREMENT St_ozgg0 "Statuswort" UBYTE Def_st_ub_q1 0 0 0.0 255.0000 ECU_ADDRESS 0x007FCC8E /begin FUNCTION_LIST OZGG /end FUNCTION_LIST /end MEASUREMENT
/begin MEASUREMENT St_ozgg1.B_ozvfchgc "Bedingung für geänderte Verfügbarkeit vom Kombi über Restweg" UBYTE Def_bit_ub_0 0 0 0.0 255.0 ECU_ADDRESS 0x007FCC8F /begin FUNCTION_LIST OZGG /end FUNCTION_LIST BIT_MASK 0x1 /end MEASUREMENT
/begin MEASUREMENT St_ozgg1.B_ozvfchgcc "Bedingung für geänderte Verfügbarkeit vom Kombi" UBYTE Def_bit_ub_1 0 0 0.0 255.0 ECU_ADDRESS 0x007FCC8F /begin FUNCTION_LIST OZGG /end FUNCTION_LIST BIT_MASK 0x2 /end MEASUREMENT
/begin MEASUREMENT St_ozgg1.B_ozmanip "" UBYTE Def_bit_ub_2 0 0 0.0 255.0 ECU_ADDRESS 0x007FCC8F /begin FUNCTION_LIST OZGG /end FUNCTION_LIST BIT_MASK 0x4 /end MEASUREMENT
/begin MEASUREMENT St_ozgg1.B_ozresett "Reset vom Tester" UBYTE Def_bit_ub_3 0 0 0.0 255.0 ECU_ADDRESS 0x007FCC8F /begin FUNCTION_LIST OZGG /end FUNCTION_LIST BIT_MASK 0x8 /end MEASUREMENT
/begin MEASUREMENT St_ozgg1.B_ozresetcan "Reset BOS vom Kombi (CAN)" UBYTE Def_bit_ub_4 0 0 0.0 255.0 ECU_ADDRESS 0x007FCC8F /begin FUNCTION_LIST OZGG /end FUNCTION_LIST BIT_MASK 0x10 /end MEASUREMENT
/begin MEASUREMENT St_ozgg1.B_ozreset "BOS Reset (Ölwechsel)" UBYTE Def_bit_ub_5 0 0 0.0 255.0 ECU_ADDRESS 0x007FCC8F /begin FUNCTION_LIST OZGG /end FUNCTION_LIST BIT_MASK 0x20 /end MEASUREMENT
/begin MEASUREMENT St_ozgg1 "Statuswort" UBYTE Def_st_ub_q1 0 0 0.0 255.0000 ECU_ADDRESS 0x007FCC8F /begin FUNCTION_LIST OZGG /end FUNCTION_LIST /end MEASUREMENT
/begin MEASUREMENT St_ozgg_nv0.B_dmeini "Bedingung für neue noch nicht initialisierte DME" UBYTE Def_bit_ub_0 0 0 0.0 255.0 ECU_ADDRESS 0x0080104E /begin FUNCTION_LIST OZGG /end FUNCTION_LIST BIT_MASK 0x1 /end MEASUREMENT
/begin MEASUREMENT St_ozgg_nv0.B_dmewech "Bedingung für getauschte DME zur Aktualisierung der BOS-Werte" UBYTE Def_bit_ub_1 0 0 0.0 255.0 ECU_ADDRESS 0x0080104E /begin FUNCTION_LIST OZGG /end FUNCTION_LIST BIT_MASK 0x2 /end MEASUREMENT
/begin MEASUREMENT St_ozgg_nv0.B_factoryres "" UBYTE Def_bit_ub_2 0 0 0.0 255.0 ECU_ADDRESS 0x0080104E /begin FUNCTION_LIST OZGG /end FUNCTION_LIST BIT_MASK 0x4 /end MEASUREMENT
/begin MEASUREMENT St_ozgg_nv0 "Statuswort" UBYTE Def_st_ub_q1 0 0 0.0 255.0000 ECU_ADDRESS 0x0080104E /begin FUNCTION_LIST OZGG /end FUNCTION_LIST /end MEASUREMENT
/begin MEASUREMENT Oz_rwrueck "" SWORD Def_km_sw_q10 0 0 -327680.0000 327670.0000 ECU_ADDRESS 0x0080103A /begin FUNCTION_LIST OZGG /end FUNCTION_LIST /end MEASUREMENT
/begin MEASUREMENT Oz_temp "Öltemperatur ungefiltert" SWORD Def_t_sw_q0p1 0 0 -3276.8000 3276.7000 ECU_ADDRESS 0x0080103C /begin FUNCTION_LIST OZGG /end FUNCTION_LIST /end MEASUREMENT
/begin MEASUREMENT Oz_perm "Permittivität ungefiltert" UWORD Def_perm_uw_b6 0 0 0.0 5.9999 ECU_ADDRESS 0x0080103E /begin FUNCTION_LIST OZGG /end FUNCTION_LIST /end MEASUREMENT
/begin MEASUREMENT Oz_permakt "Permittivität für den Tester" UWORD Def_perm_uw_b6 0 0 0.0 5.9999 ECU_ADDRESS 0x00801040 /begin FUNCTION_LIST OZGG /end FUNCTION_LIST /end MEASUREMENT
/begin MEASUREMENT Oz_manip "geänderter Servicezähler" UBYTE Def_dez_ub_q1 0 0 0.0 255.0000 ECU_ADDRESS 0x00801046 /begin FUNCTION_LIST OZGG /end FUNCTION_LIST /end MEASUREMENT
/begin MEASUREMENT Oz_niv "Ölniveau ungefiltert" UBYTE Def_niv_ub_b75 0 0 0.0 74.7070 ECU_ADDRESS 0x00801047 /begin FUNCTION_LIST OZGG /end FUNCTION_LIST /end MEASUREMENT
/begin MEASUREMENT Oz_svcntchg "geänderter Servicezähler" UBYTE Def_dez_ub_q1 0 0 0.0 255.0000 ECU_ADDRESS 0x00801048 /begin FUNCTION_LIST OZGG /end FUNCTION_LIST /end MEASUREMENT
/begin MEASUREMENT Oz_zjbdmew "" UBYTE Def_dez_ub_q1 0 0 0.0 255.0000 ECU_ADDRESS 0x00801049 /begin FUNCTION_LIST OZGG /end FUNCTION_LIST /end MEASUREMENT
/begin MEASUREMENT Oz_zmbdmew "" UBYTE Def_dez_ub_q1 0 0 0.0 255.0000 ECU_ADDRESS 0x0080104A /begin FUNCTION_LIST OZGG /end FUNCTION_LIST /end MEASUREMENT
/begin MEASUREMENT Oz_kmlow "Kilometerstand letzter Ölwechsel" SWORD Def_km_sw_q10 0 0 -327680.0000 327670.0000 ECU_ADDRESS 0x00801050 /begin FUNCTION_LIST OZGG /end FUNCTION_LIST /end MEASUREMENT
/begin MEASUREMENT Oz_lowrwanz "Register für Restweganzeige beim Ölwechsel" SWORD Def_km_sw_q10 0 0 -327680.0000 327670.0000 ECU_ADDRESS 0x00801052 ARRAY_SIZE 6 /begin FUNCTION_LIST OZGG /end FUNCTION_LIST /end MEASUREMENT
/begin MEASUREMENT Oz_lowkm "Register für KM-Stand beim Ölwechsel" UWORD Def_km_uw_q10 0 0 0.0 655350.0000 ECU_ADDRESS 0x0080105E ARRAY_SIZE 6 /begin FUNCTION_LIST OZGG /end FUNCTION_LIST /end MEASUREMENT
/begin MEASUREMENT Oz_lowperex "Register für extrapoliertes Er beim Ölwechsel" UWORD Def_perm_uw_b6 0 0 0.0 5.9999 ECU_ADDRESS 0x0080106A ARRAY_SIZE 6 /begin FUNCTION_LIST OZGG /end FUNCTION_LIST /end MEASUREMENT
/begin MEASUREMENT Oz_lowperm0 "Register für Er nach Ölwechsel" UWORD Def_perm_uw_b6 0 0 0.0 5.9999 ECU_ADDRESS 0x00801076 ARRAY_SIZE 6 /begin FUNCTION_LIST OZGG /end FUNCTION_LIST /end MEASUREMENT
/begin MEASUREMENT Oz_oelkm "Ölkilometer" UWORD Def_km_uw_q10 0 0 0.0 655350.0000 ECU_ADDRESS 0x00801082 /begin FUNCTION_LIST OZGG /end FUNCTION_LIST /end MEASUREMENT
/begin MEASUREMENT Oz_perref "Ersatzpermittivität" UWORD Def_dez_uw_q1 0 0 0.0 1024.0000 ECU_ADDRESS 0x00801084 /begin FUNCTION_LIST OZGG /end FUNCTION_LIST /end MEASUREMENT
/begin MEASUREMENT Oz_vfbdmew "Verfügbarkeit aus Kombi bei DME-Wechsel" SBYTE Def_dez_sb_q1 0 0 -128.0000 127.0000 ECU_ADDRESS 0x00801086 /begin FUNCTION_LIST OZGG /end FUNCTION_LIST /end MEASUREMENT
/begin MEASUREMENT Oz_lowcnt "Zähler zur Sicherung der Ölwechselinformationen" UBYTE Def_dez_ub_q1 0 0 0.0 255.0000 ECU_ADDRESS 0x00801087 /begin FUNCTION_LIST OZGG /end FUNCTION_LIST /end MEASUREMENT
/begin MEASUREMENT Oz_manipt "Manipulation" UBYTE Def_dez_ub_q1 0 0 0.0 255.0000 ECU_ADDRESS 0x00801088 /begin FUNCTION_LIST OZGG /end FUNCTION_LIST /end MEASUREMENT
/begin MEASUREMENT Oz_rwprueck "" UBYTE Def_km_ub_q1000 0 0 0.0 255000.0000 ECU_ADDRESS 0x00801089 /begin FUNCTION_LIST OZGG /end FUNCTION_LIST /end MEASUREMENT
/begin MEASUREMENT Oz_permt "begrenzter Permittivitäts-Rohwert" UWORD Def_dez_uw_q1 0 0 0.0 1024.0000 ECU_ADDRESS 0x00801042 /begin FUNCTION_LIST OZGG /end FUNCTION_LIST /end MEASUREMENT
/begin MEASUREMENT Oz_tempt "begrenzter Temperatur-Rohwert" UWORD Def_dez_uw_q1 0 0 0.0 65535.0000 ECU_ADDRESS 0x00801044 /begin FUNCTION_LIST OZGG /end FUNCTION_LIST /end MEASUREMENT
/begin MEASUREMENT Oz_nivrers "Ersatzniveau-Rohwert" UBYTE Def_dez_ub_q1 0 0 0.0 255.0000 ECU_ADDRESS 0x0080104B /begin FUNCTION_LIST OZGG /end FUNCTION_LIST /end MEASUREMENT
/begin MEASUREMENT Oz_nivt "begrenzter Niveau-Rohwert" UBYTE Def_dez_ub_q1 0 0 0.0 255.0000 ECU_ADDRESS 0x0080104C /begin FUNCTION_LIST OZGG /end FUNCTION_LIST /end MEASUREMENT
/begin MEASUREMENT Oz_leit_dum "" UBYTE Def_dez_ub_q1 0 0 0.0 255.0000 ECU_ADDRESS 0x007FCC90 /begin FUNCTION_LIST OZLEIT /end FUNCTION_LIST /end MEASUREMENT
/begin MEASUREMENT St_oznivdl0.B_oznivb "" UBYTE Def_bit_ub_0 0 0 0.0 255.0 ECU_ADDRESS 0x007FCC92 /begin FUNCTION_LIST OZNIVDL /end FUNCTION_LIST BIT_MASK 0x1 /end MEASUREMENT
/begin MEASUREMENT St_oznivdl0.B_ozkrzkor "Bedingung drehzahlkorrigierter Kurzzeit Niveaumittelwert berechnet" UBYTE Def_bit_ub_1 0 0 0.0 255.0 ECU_ADDRESS 0x007FCC92 /begin FUNCTION_LIST OZNIVDL /end FUNCTION_LIST BIT_MASK 0x2 /end MEASUREMENT
/begin MEASUREMENT St_oznivdl0.B_ozlangmw "Bedingung Langzeit-Mittelwert berechnet" UBYTE Def_bit_ub_2 0 0 0.0 255.0 ECU_ADDRESS 0x007FCC92 /begin FUNCTION_LIST OZNIVDL /end FUNCTION_LIST BIT_MASK 0x4 /end MEASUREMENT
/begin MEASUREMENT St_oznivdl0.B_ozor "Bedingung Orientierungsmessung erfolgt" UBYTE Def_bit_ub_3 0 0 0.0 255.0 ECU_ADDRESS 0x007FCC92 /begin FUNCTION_LIST OZNIVDL /end FUNCTION_LIST BIT_MASK 0x8 /end MEASUREMENT
/begin MEASUREMENT St_oznivdl0.B_ozvormw "Bedingung vorgezogener Mittelwert berechnet" UBYTE Def_bit_ub_4 0 0 0.0 255.0 ECU_ADDRESS 0x007FCC92 /begin FUNCTION_LIST OZNIVDL /end FUNCTION_LIST BIT_MASK 0x10 /end MEASUREMENT
/begin MEASUREMENT St_oznivdl0.B_ozkrzlkor "" UBYTE Def_bit_ub_5 0 0 0.0 255.0 ECU_ADDRESS 0x007FCC92 /begin FUNCTION_LIST OZNIVDL /end FUNCTION_LIST BIT_MASK 0x20 /end MEASUREMENT
/begin MEASUREMENT St_oznivdl0.B_oelnivnorm "" UBYTE Def_bit_ub_6 0 0 0.0 255.0 ECU_ADDRESS 0x007FCC92 /begin FUNCTION_LIST OZNIVDL /end FUNCTION_LIST BIT_MASK 0x40 /end MEASUREMENT
/begin MEASUREMENT St_oznivdl0.B_ozkrzl "" UBYTE Def_bit_ub_7 0 0 0.0 255.0 ECU_ADDRESS 0x007FCC92 /begin FUNCTION_LIST OZNIVDL /end FUNCTION_LIST BIT_MASK 0x80 /end MEASUREMENT
/begin MEASUREMENT St_oznivdl0 "Statuswort" UBYTE Def_st_ub_q1 0 0 0.0 255.0000 ECU_ADDRESS 0x007FCC92 /begin FUNCTION_LIST OZNIVDL /end FUNCTION_LIST /end MEASUREMENT
/begin MEASUREMENT St_oznivdl1.B_ozkrzkor2 "Ein Mittelwert von zwei KurzMw ist da" UBYTE Def_bit_ub_0 0 0 0.0 255.0 ECU_ADDRESS 0x007FCC91 /begin FUNCTION_LIST OZNIVDL /end FUNCTION_LIST BIT_MASK 0x1 /end MEASUREMENT
/begin MEASUREMENT St_oznivdl1.B_ozkrzkornb "Bedingung drehzahlkorrigierter Kurzzeit Niveaumittelwert und nicht drehzahlbegrenzt berechnet" UBYTE Def_bit_ub_1 0 0 0.0 255.0 ECU_ADDRESS 0x007FCC91 /begin FUNCTION_LIST OZNIVDL /end FUNCTION_LIST BIT_MASK 0x2 /end MEASUREMENT
/begin MEASUREMENT St_oznivdl1 "Statuswort" UBYTE Def_st_ub_q1 0 0 0.0 255.0000 ECU_ADDRESS 0x007FCC91 /begin FUNCTION_LIST OZNIVDL /end FUNCTION_LIST /end MEASUREMENT
/begin MEASUREMENT St_oznivdl_nv0.B_ozlw1 "Bedingung mindestens 1 gültiger Langzeitmittelwert war vorhanden" UBYTE Def_bit_ub_0 0 0 0.0 255.0 ECU_ADDRESS 0x008010BA /begin FUNCTION_LIST OZNIVDL /end FUNCTION_LIST BIT_MASK 0x1 /end MEASUREMENT
/begin MEASUREMENT St_oznivdl_nv0.B_ozpeilerr "" UBYTE Def_bit_ub_1 0 0 0.0 255.0 ECU_ADDRESS 0x008010BA /begin FUNCTION_LIST OZNIVDL /end FUNCTION_LIST BIT_MASK 0x2 /end MEASUREMENT
/begin MEASUREMENT St_oznivdl_nv0 "Statuswort" UBYTE Def_st_ub_q1 0 0 0.0 255.0000 ECU_ADDRESS 0x008010BA /begin FUNCTION_LIST OZNIVDL /end FUNCTION_LIST /end MEASUREMENT
/begin MEASUREMENT Oz_testtoel2 "" SWORD Def_t_sw_q0p1 0 0 -3276.8000 3276.7000 ECU_ADDRESS 0x0080108A /begin FUNCTION_LIST OZNIVDL /end FUNCTION_LIST /end MEASUREMENT
/begin MEASUREMENT Oz_krzor "kurzzeitiger Mittelwert Orientierungsmessung Niveau" UBYTE Def_niv_ub_b75 0 0 0.0 74.7070 ECU_ADDRESS 0x0080109E /begin FUNCTION_LIST OZNIVDL /end FUNCTION_LIST /end MEASUREMENT
/begin MEASUREMENT Oz_lp "oz level picture" UBYTE Def_dez_ub_q1 0 0 0.0 255.0000 ECU_ADDRESS 0x0080109F /begin FUNCTION_LIST OZNIVDL /end FUNCTION_LIST /end MEASUREMENT
/begin MEASUREMENT Oz_lv "oz level value" UBYTE Def_dez_ub_q1 0 0 0.0 255.0000 ECU_ADDRESS 0x008010A0 /begin FUNCTION_LIST OZNIVDL /end FUNCTION_LIST /end MEASUREMENT
/begin MEASUREMENT Oz_nivakt "Aktuelles Niveau für den Tester" UBYTE Def_niv_ub_b75 0 0 0.0 74.7070 ECU_ADDRESS 0x008010A1 /begin FUNCTION_LIST OZNIVDL /end FUNCTION_LIST /end MEASUREMENT
/begin MEASUREMENT Oz_nivkrzt "Kurzmittelwert-Niveau für den Tester" UBYTE Def_niv_ub_b75 0 0 0.0 74.7070 ECU_ADDRESS 0x008010A2 /begin FUNCTION_LIST OZNIVDL /end FUNCTION_LIST /end MEASUREMENT
/begin MEASUREMENT Oz_nivnfm "Nachfüllmenge" UBYTE Def_niv_ub_b8 0 0 0.0 7.9687 ECU_ADDRESS 0x008010A3 /begin FUNCTION_LIST OZNIVDL /end FUNCTION_LIST /end MEASUREMENT
/begin MEASUREMENT Oz_orikor "OriMw korrigiert" UBYTE Def_niv_ub_b75 0 0 0.0 74.7070 ECU_ADDRESS 0x008010A4 /begin FUNCTION_LIST OZNIVDL /end FUNCTION_LIST /end MEASUREMENT
/begin MEASUREMENT Oz_vormw "vorgezogener Mittelwert Niveau" UBYTE Def_niv_ub_b75 0 0 0.0 74.7070 ECU_ADDRESS 0x008010A5 /begin FUNCTION_LIST OZNIVDL /end FUNCTION_LIST /end MEASUREMENT
/begin MEASUREMENT Oz_rwpeil "Restweg laut Peilstab" SWORD Def_km_sw_q10 0 0 -327680.0000 327670.0000 ECU_ADDRESS 0x008010BC /begin FUNCTION_LIST OZNIVDL /end FUNCTION_LIST /end MEASUREMENT
/begin MEASUREMENT Oz_oelverbr "Berechneter Ölverbrauch" UWORD Def_dez_uw_q1 0 0 0.0 65535.0000 ECU_ADDRESS 0x008010BE /begin FUNCTION_LIST OZNIVDL /end FUNCTION_LIST /end MEASUREMENT
/begin MEASUREMENT Oz_peilkmalt "Km Stand beim 1. Sensorfehler" UWORD Def_km_uw_q10 0 0 0.0 655350.0000 ECU_ADDRESS 0x008010C0 /begin FUNCTION_LIST OZNIVDL /end FUNCTION_LIST /end MEASUREMENT
/begin MEASUREMENT Oz_verbkmalt "Km-Stand letzter Ölverbrauch-Berechnung" UWORD Def_km_uw_q10 0 0 0.0 655350.0000 ECU_ADDRESS 0x008010C2 /begin FUNCTION_LIST OZNIVDL /end FUNCTION_LIST /end MEASUREMENT
/begin MEASUREMENT Oz_langmw "Langzeitmittelwert berechnet" UBYTE Def_niv_ub_b75 0 0 0.0 74.7070 ECU_ADDRESS 0x008010C4 /begin FUNCTION_LIST OZNIVDL /end FUNCTION_LIST /end MEASUREMENT
/begin MEASUREMENT Oz_nivlangt "Langmittelwert für den Tester" UBYTE Def_niv_ub_b75 0 0 0.0 74.7070 ECU_ADDRESS 0x008010C5 /begin FUNCTION_LIST OZNIVDL /end FUNCTION_LIST /end MEASUREMENT
/begin MEASUREMENT Oz_peilaltanz "" UBYTE Def_niv_ub_b75 0 0 0.0 74.7070 ECU_ADDRESS 0x008010C6 /begin FUNCTION_LIST OZNIVDL /end FUNCTION_LIST /end MEASUREMENT
/begin MEASUREMENT Oz_verbnivalt "Ölniveau letzter Ölverbrauch-Berechnung" UBYTE Def_niv_ub_b75 0 0 0.0 74.7070 ECU_ADDRESS 0x008010C7 /begin FUNCTION_LIST OZNIVDL /end FUNCTION_LIST /end MEASUREMENT
/begin MEASUREMENT N_ozmw "kurzzeitiger Mittelwert Drehzahl" SWORD Def_n_sw_q1p0 0 0 -32767.0000 32767.0000 ECU_ADDRESS 0x0080108C /begin FUNCTION_LIST OZNIVDL /end FUNCTION_LIST /end MEASUREMENT
/begin MEASUREMENT Oz_hoehe "" SWORD Def_f_sw_b8 0 0 -8.0000 7.9997 ECU_ADDRESS 0x0080108E /begin FUNCTION_LIST OZNIVDL /end FUNCTION_LIST /end MEASUREMENT
/begin MEASUREMENT Oz_nmotf "" SWORD Def_n_sw_q1p0 0 0 -32768.0000 32767.0000 ECU_ADDRESS 0x00801090 /begin FUNCTION_LIST OZNIVDL /end FUNCTION_LIST /end MEASUREMENT
/begin MEASUREMENT Oz_nmotfm "Drehzehlmittelwert Töns" SWORD Def_n_sw_q1p0 0 0 -32768.0000 32767.0000 ECU_ADDRESS 0x00801092 /begin FUNCTION_LIST OZNIVDL /end FUNCTION_LIST /end MEASUREMENT
/begin MEASUREMENT Oz_steigung "" SWORD Def_f_sw_b64 0 0 -64.0000 63.9980 ECU_ADDRESS 0x00801094 /begin FUNCTION_LIST OZNIVDL /end FUNCTION_LIST /end MEASUREMENT
/begin MEASUREMENT Oz_dkm "" UWORD Def_f_uw_b10 0 0 0.0 9.9998 ECU_ADDRESS 0x00801096 /begin FUNCTION_LIST OZNIVDL /end FUNCTION_LIST /end MEASUREMENT
/begin MEASUREMENT Oz_nivlit "Ölniveau in Liter" UWORD Def_niv_uw_q0p1 0 0 0.0 25.5000 ECU_ADDRESS 0x00801098 /begin FUNCTION_LIST OZNIVDL /end FUNCTION_LIST /end MEASUREMENT
/begin MEASUREMENT Oz_peilkm "Max Ziel km im Fehlerfall" UWORD Def_km_uw_q10 0 0 0.0 655350.0000 ECU_ADDRESS 0x0080109A /begin FUNCTION_LIST OZNIVDL /end FUNCTION_LIST /end MEASUREMENT
/begin MEASUREMENT Oz_pzdivp "Verhältnis oz_luftalt/oz_luftneu" UWORD Def_f_uw_b2 0 0 0.0 1.9999 ECU_ADDRESS 0x0080109C /begin FUNCTION_LIST OZNIVDL /end FUNCTION_LIST /end MEASUREMENT
/begin MEASUREMENT Oz_krzcnt "" UBYTE Def_dez_ub_q1 0 0 0.0 255.0000 ECU_ADDRESS 0x008010A6 /begin FUNCTION_LIST OZNIVDL /end FUNCTION_LIST /end MEASUREMENT
/begin MEASUREMENT Oz_krzkor2 "Mittelwert von zwei KurzMw" UBYTE Def_niv_ub_b75 0 0 0.0 74.7070 ECU_ADDRESS 0x008010A7 /begin FUNCTION_LIST OZNIVDL /end FUNCTION_LIST /end MEASUREMENT
/begin MEASUREMENT Oz_krzmw "" UBYTE Def_niv_ub_b75 0 0 0.0 74.7070 ECU_ADDRESS 0x008010A8 /begin FUNCTION_LIST OZNIVDL /end FUNCTION_LIST /end MEASUREMENT
/begin MEASUREMENT Oz_krzmwkor "" UBYTE Def_niv_ub_b75 0 0 0.0 74.7070 ECU_ADDRESS 0x008010A9 /begin FUNCTION_LIST OZNIVDL /end FUNCTION_LIST /end MEASUREMENT
/begin MEASUREMENT Oz_lgmwcnt "" UBYTE Def_dez_ub_q1 0 0 0.0 255.0000 ECU_ADDRESS 0x008010AA /begin FUNCTION_LIST OZNIVDL /end FUNCTION_LIST /end MEASUREMENT
/begin MEASUREMENT Oz_oelnivak "" UBYTE Def_td_ub_q0p5 0 0 0.0 127.5000 ECU_ADDRESS 0x008010AB /begin FUNCTION_LIST OZNIVDL /end FUNCTION_LIST /end MEASUREMENT
/begin MEASUREMENT Oz_oelnivaknk "" UBYTE Def_td_ub_q0p5 0 0 0.0 127.5000 ECU_ADDRESS 0x008010AC /begin FUNCTION_LIST OZNIVDL /end FUNCTION_LIST /end MEASUREMENT
/begin MEASUREMENT Oz_oelnivkurz "" UBYTE Def_td_ub_q0p5 0 0 0.0 127.5000 ECU_ADDRESS 0x008010AD /begin FUNCTION_LIST OZNIVDL /end FUNCTION_LIST /end MEASUREMENT
/begin MEASUREMENT Oz_oelnivm "10er Mittelwert Töns nicht korrigiet" UBYTE Def_td_ub_q0p5 0 0 0.0 127.5000 ECU_ADDRESS 0x008010AE /begin FUNCTION_LIST OZNIVDL /end FUNCTION_LIST /end MEASUREMENT
/begin MEASUREMENT Oz_oelnivnorm "" UBYTE Def_td_ub_q0p5 0 0 0.0 127.5000 ECU_ADDRESS 0x008010AF /begin FUNCTION_LIST OZNIVDL /end FUNCTION_LIST /end MEASUREMENT
/begin MEASUREMENT Oz_oelnivori "" UBYTE Def_td_ub_q0p5 0 0 0.0 127.5000 ECU_ADDRESS 0x008010B0 /begin FUNCTION_LIST OZNIVDL /end FUNCTION_LIST /end MEASUREMENT
/begin MEASUREMENT Oz_peil "" UBYTE Def_niv_ub_b75 0 0 0.0 74.7070 ECU_ADDRESS 0x008010B1 /begin FUNCTION_LIST OZNIVDL /end FUNCTION_LIST /end MEASUREMENT
/begin MEASUREMENT Oz_peilalt "" UBYTE Def_niv_ub_b75 0 0 0.0 74.7070 ECU_ADDRESS 0x008010B2 /begin FUNCTION_LIST OZNIVDL /end FUNCTION_LIST /end MEASUREMENT
/begin MEASUREMENT Oz_peilalt1 "" UBYTE Def_niv_ub_b75 0 0 0.0 74.7070 ECU_ADDRESS 0x008010B3 /begin FUNCTION_LIST OZNIVDL /end FUNCTION_LIST /end MEASUREMENT
/begin MEASUREMENT Oz_peilalt2 "" UBYTE Def_niv_ub_b75 0 0 0.0 74.7070 ECU_ADDRESS 0x008010B4 /begin FUNCTION_LIST OZNIVDL /end FUNCTION_LIST /end MEASUREMENT
/begin MEASUREMENT Oz_tog_i "" UBYTE Def_dez_ub_q1 0 0 0.0 255.0000 ECU_ADDRESS 0x008010B5 /begin FUNCTION_LIST OZNIVDL /end FUNCTION_LIST /end MEASUREMENT
/begin MEASUREMENT Oz_togbwi "" UBYTE Def_dez_ub_q1 0 0 0.0 255.0000 ECU_ADDRESS 0x008010B6 /begin FUNCTION_LIST OZNIVDL /end FUNCTION_LIST /end MEASUREMENT
/begin MEASUREMENT Oz_togki "" UBYTE Def_dez_ub_q1 0 0 0.0 255.0000 ECU_ADDRESS 0x008010B7 /begin FUNCTION_LIST OZNIVDL /end FUNCTION_LIST /end MEASUREMENT
/begin MEASUREMENT Oz_vormwcnt "" UBYTE Def_dez_ub_q1 0 0 0.0 255.0000 ECU_ADDRESS 0x008010B8 /begin FUNCTION_LIST OZNIVDL /end FUNCTION_LIST /end MEASUREMENT
/begin MEASUREMENT St_ozperm0.B_calcdper "" UBYTE Def_bit_ub_0 0 0 0.0 255.0 ECU_ADDRESS 0x007FCC93 /begin FUNCTION_LIST OZPERM /end FUNCTION_LIST BIT_MASK 0x1 /end MEASUREMENT
/begin MEASUREMENT St_ozperm0.B_ozpermgl "" UBYTE Def_bit_ub_1 0 0 0.0 255.0 ECU_ADDRESS 0x007FCC93 /begin FUNCTION_LIST OZPERM /end FUNCTION_LIST BIT_MASK 0x2 /end MEASUREMENT
/begin MEASUREMENT St_ozperm0.B_ozpermpl "" UBYTE Def_bit_ub_2 0 0 0.0 255.0 ECU_ADDRESS 0x007FCC93 /begin FUNCTION_LIST OZPERM /end FUNCTION_LIST BIT_MASK 0x4 /end MEASUREMENT
/begin MEASUREMENT St_ozperm0.B_ozpermpld "Bedingung für Berechnung Restweg aus Er" UBYTE Def_bit_ub_3 0 0 0.0 255.0 ECU_ADDRESS 0x007FCC93 /begin FUNCTION_LIST OZPERM /end FUNCTION_LIST BIT_MASK 0x8 /end MEASUREMENT
/begin MEASUREMENT St_ozperm0 "Statuswort" UBYTE Def_st_ub_q1 0 0 0.0 255.0000 ECU_ADDRESS 0x007FCC93 /begin FUNCTION_LIST OZPERM /end FUNCTION_LIST /end MEASUREMENT
/begin MEASUREMENT St_ozperm_nv0.B_ozper0ok "Bedingung, dass gültiger Start-Permittivitätswert vorliegt" UBYTE Def_bit_ub_0 0 0 0.0 255.0 ECU_ADDRESS 0x008010CC /begin FUNCTION_LIST OZPERM /end FUNCTION_LIST BIT_MASK 0x1 /end MEASUREMENT
/begin MEASUREMENT St_ozperm_nv0.B_ozeranz "Bedingung für Anzeige Restweg aus Er" UBYTE Def_bit_ub_1 0 0 0.0 255.0 ECU_ADDRESS 0x008010CC /begin FUNCTION_LIST OZPERM /end FUNCTION_LIST BIT_MASK 0x2 /end MEASUREMENT
/begin MEASUREMENT St_ozperm_nv0.B_ozregstg "Bedingung Schieberegistersteuerung" UBYTE Def_bit_ub_2 0 0 0.0 255.0 ECU_ADDRESS 0x008010CC /begin FUNCTION_LIST OZPERM /end FUNCTION_LIST BIT_MASK 0x4 /end MEASUREMENT
/begin MEASUREMENT St_ozperm_nv0.B_ozer0ok "Bedingung Permittivität beim letztem Ölwechsel endgültig berechnet" UBYTE Def_bit_ub_3 0 0 0.0 255.0 ECU_ADDRESS 0x008010CC /begin FUNCTION_LIST OZPERM /end FUNCTION_LIST BIT_MASK 0x8 /end MEASUREMENT
/begin MEASUREMENT St_ozperm_nv0.B_ozdperm "Bedingung Delta Er-Ermittlung aktiv" UBYTE Def_bit_ub_4 0 0 0.0 255.0 ECU_ADDRESS 0x008010CC /begin FUNCTION_LIST OZPERM /end FUNCTION_LIST BIT_MASK 0x10 /end MEASUREMENT
/begin MEASUREMENT St_ozperm_nv0.B_ozerplt "Bedingung Ausheizzeit erfüllt" UBYTE Def_bit_ub_5 0 0 0.0 255.0 ECU_ADDRESS 0x008010CC /begin FUNCTION_LIST OZPERM /end FUNCTION_LIST BIT_MASK 0x20 /end MEASUREMENT
/begin MEASUREMENT St_ozperm_nv0 "Statuswort" UBYTE Def_st_ub_q1 0 0 0.0 255.0000 ECU_ADDRESS 0x008010CC /begin FUNCTION_LIST OZPERM /end FUNCTION_LIST /end MEASUREMENT
/begin MEASUREMENT Oz_permoff "Offset für Permittivitätskorrektur" UWORD Def_perm_uw_b6 0 0 0.0 5.9999 ECU_ADDRESS 0x008010C8 /begin FUNCTION_LIST OZPERM /end FUNCTION_LIST /end MEASUREMENT
/begin MEASUREMENT Oz_permoff_oz "Offset für Permittivitätskorrektur" SWORD Def_perm_sw_b6 0 0 -6.0000 5.9998 ECU_ADDRESS 0x008010CE /begin FUNCTION_LIST OZPERM /end FUNCTION_LIST /end MEASUREMENT
/begin MEASUREMENT Oz_kmreg "Schieberegister Kilometerstand" UWORD Def_km_uw_q10 0 0 0.0 655350.0000 ECU_ADDRESS 0x008010D0 ARRAY_SIZE 15 /begin FUNCTION_LIST OZPERM /end FUNCTION_LIST /end MEASUREMENT
/begin MEASUREMENT Oz_nivkm "letzter Kilometerstand bei dem ein neuer Langzeitmittelwert Niveau vorlag und kein Öl nachgefüllt wurde" UWORD Def_km_uw_q10 0 0 0.0 655350.0000 ECU_ADDRESS 0x008010EE /begin FUNCTION_LIST OZPERM /end FUNCTION_LIST /end MEASUREMENT
/begin MEASUREMENT Oz_permex "Permittivität für Bewertung aufbereitet (extrapoliert)" UWORD Def_perm_uw_b6 0 0 0.0 5.9999 ECU_ADDRESS 0x008010F0 /begin FUNCTION_LIST OZPERM /end FUNCTION_LIST /end MEASUREMENT
/begin MEASUREMENT Oz_permlow "aufbereitete Permittivität bei letztem Ölwechsel" UWORD Def_perm_uw_b6 0 0 0.0 5.9999 ECU_ADDRESS 0x008010F2 /begin FUNCTION_LIST OZPERM /end FUNCTION_LIST /end MEASUREMENT
/begin MEASUREMENT Oz_permreg "Schieberegister Permittivität" UWORD Def_perm_uw_b6 0 0 0.0 5.9999 ECU_ADDRESS 0x008010F4 ARRAY_SIZE 15 /begin FUNCTION_LIST OZPERM /end FUNCTION_LIST /end MEASUREMENT
/begin MEASUREMENT Oz_prfstrg "Zähler für Delta Er-Ermittlung" UWORD Def_dez_uw_q1 0 0 0.0 65535.0000 ECU_ADDRESS 0x00801112 /begin FUNCTION_LIST OZPERM /end FUNCTION_LIST /end MEASUREMENT
/begin MEASUREMENT Oz_todeltime "Zähler Ausheizzeit (nichtflüchtig)" UWORD Def_td_uw_q1 0 0 0.0 65535.0000 ECU_ADDRESS 0x00801114 /begin FUNCTION_LIST OZPERM /end FUNCTION_LIST /end MEASUREMENT
/begin MEASUREMENT Oz_permanz "Anzahl der Messwerte im Schieberegister" SBYTE Def_dez_sb_q1 0 0 -128.0000 127.0000 ECU_ADDRESS 0x00801116 /begin FUNCTION_LIST OZPERM /end FUNCTION_LIST /end MEASUREMENT
/begin MEASUREMENT Oz_dpermsi "" SBYTE Def_dez_sb_q1 0 0 -128.0000 127.0000 ECU_ADDRESS 0x008010CA /begin FUNCTION_LIST OZPERM /end FUNCTION_LIST /end MEASUREMENT
/begin MEASUREMENT St_ozrestkm_0.B_oznoperm "Keine Berechnung von Permittivität für die Restlaufstrecke" UBYTE Def_bit_ub_0 0 0 0.0 255.0 ECU_ADDRESS 0x007FCCC4 /begin FUNCTION_LIST OZRESTKM /end FUNCTION_LIST BIT_MASK 0x1 /end MEASUREMENT
/begin MEASUREMENT St_ozrestkm_0 "Statuswort" UBYTE Def_st_ub_q1 0 0 0.0 255.0000 ECU_ADDRESS 0x007FCCC4 /begin FUNCTION_LIST OZRESTKM /end FUNCTION_LIST /end MEASUREMENT
/begin MEASUREMENT St_ozrestkm_nv0.B_rwanz0 "Bedingung für Restweganzeige = Null" UBYTE Def_bit_ub_0 0 0 0.0 255.0 ECU_ADDRESS 0x00801140 /begin FUNCTION_LIST OZRESTKM /end FUNCTION_LIST BIT_MASK 0x1 /end MEASUREMENT
/begin MEASUREMENT St_ozrestkm_nv0.B_ozvfk "Prognose und KVB aus der Kombi-Verfügbarkeit berechnet " UBYTE Def_bit_ub_1 0 0 0.0 255.0 ECU_ADDRESS 0x00801140 /begin FUNCTION_LIST OZRESTKM /end FUNCTION_LIST BIT_MASK 0x2 /end MEASUREMENT
/begin MEASUREMENT St_ozrestkm_nv0.B_ozini "" UBYTE Def_bit_ub_2 0 0 0.0 255.0 ECU_ADDRESS 0x00801140 /begin FUNCTION_LIST OZRESTKM /end FUNCTION_LIST BIT_MASK 0x4 /end MEASUREMENT
/begin MEASUREMENT St_ozrestkm_nv0.B_ozcntini "Tageberechnung initialisiert" UBYTE Def_bit_ub_3 0 0 0.0 255.0 ECU_ADDRESS 0x00801140 /begin FUNCTION_LIST OZRESTKM /end FUNCTION_LIST BIT_MASK 0x8 /end MEASUREMENT
/begin MEASUREMENT St_ozrestkm_nv0 "Statuswort" UBYTE Def_st_ub_q1 0 0 0.0 255.0000 ECU_ADDRESS 0x00801140 /begin FUNCTION_LIST OZRESTKM /end FUNCTION_LIST /end MEASUREMENT
/begin MEASUREMENT Oz_rwkvb "" SWORD Def_km_sw_q10 0 0 -327680.0000 327670.0000 ECU_ADDRESS 0x00801120 /begin FUNCTION_LIST OZRESTKM /end FUNCTION_LIST /end MEASUREMENT
/begin MEASUREMENT Oz_rwperm "Restweg aus Permittivität abgeleitet" SWORD Def_km_sw_q10 0 0 -327680.0000 327670.0000 ECU_ADDRESS 0x00801122 /begin FUNCTION_LIST OZRESTKM /end FUNCTION_LIST /end MEASUREMENT
/begin MEASUREMENT Oz_rwzeit "Restweg laut Zeitverlauf" SWORD Def_km_sw_q10 0 0 -327680.0000 327670.0000 ECU_ADDRESS 0x00801124 /begin FUNCTION_LIST OZRESTKM /end FUNCTION_LIST /end MEASUREMENT
/begin MEASUREMENT Oz_oelzeit "Öl-Alter in Monate" UWORD Def_dez_uw_q1 0 0 0.0 65535.0000 ECU_ADDRESS 0x00801126 /begin FUNCTION_LIST OZRESTKM /end FUNCTION_LIST /end MEASUREMENT
/begin MEASUREMENT Oz_oelzeitt "Öl-Alter in Tage" UWORD Def_dez_uw_q1 0 0 0.0 65535.0000 ECU_ADDRESS 0x00801128 /begin FUNCTION_LIST OZRESTKM /end FUNCTION_LIST /end MEASUREMENT
/begin MEASUREMENT Oz_rwprog "Prognose_Intervall_Weg_BOS_Meldung_2" UWORD Def_km_uw_q10 0 0 0.0 655350.0000 ECU_ADDRESS 0x0080112A /begin FUNCTION_LIST OZRESTKM /end FUNCTION_LIST /end MEASUREMENT
/begin MEASUREMENT Oz_intprog "Prognose_Intervall_Zeit_BOS_Meldung_2" UBYTE Def_dez_ub_q1 0 0 0.0 255.0000 ECU_ADDRESS 0x00801138 /begin FUNCTION_LIST OZRESTKM /end FUNCTION_LIST /end MEASUREMENT
/begin MEASUREMENT Oz_vfanz "anzuzeigende Verfügbarkeit" UBYTE Def_lf_ub_q0p01 0 0 0.0 2.5500 ECU_ADDRESS 0x00801139 /begin FUNCTION_LIST OZRESTKM /end FUNCTION_LIST /end MEASUREMENT
/begin MEASUREMENT Oz_kvbmw "" ULONG Def_fuel_ul_q0p000122 0 0 0.0 100.0000 ECU_ADDRESS 0x00801144 /begin FUNCTION_LIST OZRESTKM /end FUNCTION_LIST /end MEASUREMENT
/begin MEASUREMENT Oz_kvbsm_ul "" ULONG Def_fuel_ul_q0p000122 0 0 0.0 524287.9998 ECU_ADDRESS 0x00801148 /begin FUNCTION_LIST OZRESTKM /end FUNCTION_LIST /end MEASUREMENT
/begin MEASUREMENT Oz_cttagini "Tag beim Ölwechsel" SWORD Def_dez_sw_q1 0 0 -32768.0000 32767.0000 ECU_ADDRESS 0x0080114C /begin FUNCTION_LIST OZRESTKM /end FUNCTION_LIST /end MEASUREMENT
/begin MEASUREMENT Oz_rwanz "anzuzeigender Restweg" SWORD Def_km_sw_q10 0 0 -327680.0000 327670.0000 ECU_ADDRESS 0x0080114E /begin FUNCTION_LIST OZRESTKM /end FUNCTION_LIST /end MEASUREMENT
/begin MEASUREMENT Oz_kmstrw0 "Kilometerstand bei Restweg = Null" UWORD Def_km_uw_q10 0 0 0.0 655350.0000 ECU_ADDRESS 0x00801150 /begin FUNCTION_LIST OZRESTKM /end FUNCTION_LIST /end MEASUREMENT
/begin MEASUREMENT Oz_kvbog "zugeteilte Bonuskraftstoffmenge" UWORD Def_dez_uw_q1 0 0 0.0 65535.0000 ECU_ADDRESS 0x00801152 /begin FUNCTION_LIST OZRESTKM /end FUNCTION_LIST /end MEASUREMENT
/begin MEASUREMENT Oz_permbog "zugeteilter Permittivitätsbonus" UWORD Def_perm_uw_b6 0 0 0.0 5.9999 ECU_ADDRESS 0x00801154 /begin FUNCTION_LIST OZRESTKM /end FUNCTION_LIST /end MEASUREMENT
/begin MEASUREMENT Oz_utzeit "Zeit Öl in Übertemperatur" UWORD Def_dez_uw_q1 0 0 0.0 65535.0000 ECU_ADDRESS 0x00801156 /begin FUNCTION_LIST OZRESTKM /end FUNCTION_LIST /end MEASUREMENT
/begin MEASUREMENT Oz_lf1t "Länderfaktor 1" UBYTE Def_lf_ub_q0p01 0 0 0.0 2.5500 ECU_ADDRESS 0x00801158 /begin FUNCTION_LIST OZRESTKM /end FUNCTION_LIST /end MEASUREMENT
/begin MEASUREMENT Oz_lf2t "Länderfaktor 2" UBYTE Def_lf_ub_q0p01 0 0 0.0 2.5500 ECU_ADDRESS 0x00801159 /begin FUNCTION_LIST OZRESTKM /end FUNCTION_LIST /end MEASUREMENT
/begin MEASUREMENT Oz_zieljahr "" UBYTE Def_dez_ub_q1 0 0 0.0 255.0000 ECU_ADDRESS 0x0080115A /begin FUNCTION_LIST OZRESTKM /end FUNCTION_LIST /end MEASUREMENT
/begin MEASUREMENT Oz_zielmon "" UBYTE Def_dez_ub_q1 0 0 0.0 255.0000 ECU_ADDRESS 0x0080115B /begin FUNCTION_LIST OZRESTKM /end FUNCTION_LIST /end MEASUREMENT
/begin MEASUREMENT Oz_kvbdiff "" ULONG Def_fuel_ul_q0p000122 0 0 0.0 100.0000 ECU_ADDRESS 0x00801118 /begin FUNCTION_LIST OZRESTKM /end FUNCTION_LIST /end MEASUREMENT
/begin MEASUREMENT Oz_kvbsm "" ULONG Def_fuel_ul_q0p000122 0 0 0.0 10000.0000 ECU_ADDRESS 0x0080111C /begin FUNCTION_LIST OZRESTKM /end FUNCTION_LIST /end MEASUREMENT
/begin MEASUREMENT Oz_rwp "Zwischengröße Restwegberechnung" SWORD Def_km_sw_q10 0 0 -327680.0000 327670.0000 ECU_ADDRESS 0x0080112C /begin FUNCTION_LIST OZRESTKM /end FUNCTION_LIST /end MEASUREMENT
/begin MEASUREMENT Oz_kvbmwtmp "" UWORD Def_f_uw_b64 0 0 0.0 63.9990 ECU_ADDRESS 0x0080112E /begin FUNCTION_LIST OZRESTKM /end FUNCTION_LIST /end MEASUREMENT
/begin MEASUREMENT Oz_kvbmx "" UWORD Def_dez_uw_q1 0 0 0.0 65535.0000 ECU_ADDRESS 0x00801130 /begin FUNCTION_LIST OZRESTKM /end FUNCTION_LIST /end MEASUREMENT
/begin MEASUREMENT Oz_kvbtmp2 "" UWORD Def_km_uw_q10 0 0 0.0 655350.0000 ECU_ADDRESS 0x00801132 /begin FUNCTION_LIST OZRESTKM /end FUNCTION_LIST /end MEASUREMENT
/begin MEASUREMENT Oz_litges "Gesamtverbrauch für Ölwechsel" UWORD Def_dez_uw_q1 0 0 0.0 65535.0000 ECU_ADDRESS 0x00801134 /begin FUNCTION_LIST OZRESTKM /end FUNCTION_LIST /end MEASUREMENT
/begin MEASUREMENT Oz_litgesk "Gesamtverbrauch für Ölwechsel" UWORD Def_dez_uw_q1 0 0 0.0 65535.0000 ECU_ADDRESS 0x00801136 /begin FUNCTION_LIST OZRESTKM /end FUNCTION_LIST /end MEASUREMENT
/begin MEASUREMENT Oz_vfkvb "Verfügbarkeit aus Kraftstoffverbrauch" UBYTE Def_lf_ub_q0p01 0 0 0.0 2.5500 ECU_ADDRESS 0x0080113A /begin FUNCTION_LIST OZRESTKM /end FUNCTION_LIST /end MEASUREMENT
/begin MEASUREMENT Oz_vfperm "Verfügbarkeit aus der Permittivität" UBYTE Def_lf_ub_q0p01 0 0 0.0 2.5500 ECU_ADDRESS 0x0080113B /begin FUNCTION_LIST OZRESTKM /end FUNCTION_LIST /end MEASUREMENT
/begin MEASUREMENT Oz_vfzeit "Verfügbarkeit aus Zeit" UBYTE Def_lf_ub_q0p01 0 0 0.0 2.5500 ECU_ADDRESS 0x0080113C /begin FUNCTION_LIST OZRESTKM /end FUNCTION_LIST /end MEASUREMENT
/begin MEASUREMENT Oz_tempf "" SWORD Def_t_sw_q0p1 0 0 -3276.8000 3276.7000 ECU_ADDRESS 0x007FCD04 /begin FUNCTION_LIST OZTEMP /end FUNCTION_LIST /end MEASUREMENT
/begin MEASUREMENT St_bns2.B_nachlnd7 "Bordnetzstabilitätsmaßnahmen aktiv" UBYTE Def_bit_ub_0 0 0 0.0 255.0 ECU_ADDRESS 0x007FCEDA /begin FUNCTION_LIST PMBNSTAB /end FUNCTION_LIST BIT_MASK 0x1 /end MEASUREMENT
/begin MEASUREMENT St_bns2 "Statuswort" UBYTE Def_st_ub_q1 0 0 0.0 255.0000 ECU_ADDRESS 0x007FCEDA /begin FUNCTION_LIST PMBNSTAB /end FUNCTION_LIST /end MEASUREMENT
/begin MEASUREMENT St_bns.B_bns "lokales B_nachlaufende" UBYTE Def_bit_ub_0 0 0 0.0 255.0 ECU_ADDRESS 0x00801160 /begin FUNCTION_LIST PMBNSTAB /end FUNCTION_LIST BIT_MASK 0x1 /end MEASUREMENT
/begin MEASUREMENT St_bns "Statuswort" UBYTE Def_st_ub_q1 0 0 0.0 255.0000 ECU_ADDRESS 0x00801160 /begin FUNCTION_LIST PMBNSTAB /end FUNCTION_LIST /end MEASUREMENT
/begin MEASUREMENT Bnctrmx1s "" UBYTE Def_dez_ub_q1 0 0 0.0 255.0000 ECU_ADDRESS 0x0080115C /begin FUNCTION_LIST PMBNSTAB /end FUNCTION_LIST /end MEASUREMENT
/begin MEASUREMENT Bnsctrant0 "Counter 1 sec-Anteile ohne Grenzwertüberschreitung" ULONG Def_dez_ul_q1 0 0 0.0 4294967295.0000 ECU_ADDRESS 0x00801164 /begin FUNCTION_LIST PMBNSTAB /end FUNCTION_LIST /end MEASUREMENT
/begin MEASUREMENT Bnsctrant1 "Counter 1 sec-Anteile 1. Bereich" UWORD Def_dez_uw_q1 0 0 0.0 65535.0000 ECU_ADDRESS 0x00801168 /begin FUNCTION_LIST PMBNSTAB /end FUNCTION_LIST /end MEASUREMENT
/begin MEASUREMENT Bnsctrant2 "Counter 1 sec-Anteile 2. Bereich" UWORD Def_dez_uw_q1 0 0 0.0 65535.0000 ECU_ADDRESS 0x0080116A /begin FUNCTION_LIST PMBNSTAB /end FUNCTION_LIST /end MEASUREMENT
/begin MEASUREMENT Bnsctrant3 "Counter 1 sec-Anteile 3. Bereich" UWORD Def_dez_uw_q1 0 0 0.0 65535.0000 ECU_ADDRESS 0x0080116C /begin FUNCTION_LIST PMBNSTAB /end FUNCTION_LIST /end MEASUREMENT
/begin MEASUREMENT Bnsctr "Counter Bordnetzspannungsplausibilisierung" UBYTE Def_dez_ub_q1 0 0 0.0 255.0000 ECU_ADDRESS 0x0080116E /begin FUNCTION_LIST PMBNSTAB /end FUNCTION_LIST /end MEASUREMENT
/begin MEASUREMENT St_pmdiag0.B_codierpm "Q_elad 1. Takt vorbei " UBYTE Def_bit_ub_0 0 0 0.0 255.0 ECU_ADDRESS 0x007FCF34 /begin FUNCTION_LIST PMDIAG /end FUNCTION_LIST BIT_MASK 0x1 /end MEASUREMENT
/begin MEASUREMENT St_pmdiag0.B_ccprio "Anfrage an CAS die Codierdaten erneut fuer PM zu senden." UBYTE Def_bit_ub_1 0 0 0.0 255.0 ECU_ADDRESS 0x007FCF34 /begin FUNCTION_LIST PMDIAG /end FUNCTION_LIST BIT_MASK 0x2 /end MEASUREMENT
/begin MEASUREMENT St_pmdiag0.B_ccbttdfk "CC Meldung : Komfortverbraucher eingeschraenkt" UBYTE Def_bit_ub_2 0 0 0.0 255.0 ECU_ADDRESS 0x007FCF34 /begin FUNCTION_LIST PMDIAG /end FUNCTION_LIST BIT_MASK 0x4 /end MEASUREMENT
/begin MEASUREMENT St_pmdiag0.B_ccpmerr "CC Meldung : Batterie Nachladen" UBYTE Def_bit_ub_3 0 0 0.0 255.0 ECU_ADDRESS 0x007FCF34 /begin FUNCTION_LIST PMDIAG /end FUNCTION_LIST BIT_MASK 0x8 /end MEASUREMENT
/begin MEASUREMENT St_pmdiag0.B_ccbttknt "Ruhestromverletzung derzeit vorhanden." UBYTE Def_bit_ub_4 0 0 0.0 255.0 ECU_ADDRESS 0x007FCF34 /begin FUNCTION_LIST PMDIAG /end FUNCTION_LIST BIT_MASK 0x10 /end MEASUREMENT
/begin MEASUREMENT St_pmdiag0.B_pcoschg "IBS Histrogramm darf gelöscht werden." UBYTE Def_bit_ub_5 0 0 0.0 255.0 ECU_ADDRESS 0x007FCF34 /begin FUNCTION_LIST PMDIAG /end FUNCTION_LIST BIT_MASK 0x20 /end MEASUREMENT
/begin MEASUREMENT St_pmdiag0.B_ccbtnach "IHKA Standverbraucher aktiv" UBYTE Def_bit_ub_6 0 0 0.0 255.0 ECU_ADDRESS 0x007FCF34 /begin FUNCTION_LIST PMDIAG /end FUNCTION_LIST BIT_MASK 0x40 /end MEASUREMENT
/begin MEASUREMENT St_pmdiag0.B_tiefrset "CC Meldung : Batterie verschlissen" UBYTE Def_bit_ub_7 0 0 0.0 255.0 ECU_ADDRESS 0x007FCF34 /begin FUNCTION_LIST PMDIAG /end FUNCTION_LIST BIT_MASK 0x80 /end MEASUREMENT
/begin MEASUREMENT St_pmdiag0 "Statuswort" UBYTE Def_st_ub_q1 0 0 0.0 255.0000 ECU_ADDRESS 0x007FCF34 /begin FUNCTION_LIST PMDIAG /end FUNCTION_LIST /end MEASUREMENT
/begin MEASUREMENT St_pmdiag1.B_ccruhver "CC Meldung : Powermgm ausser Betrieb" UBYTE Def_bit_ub_0 0 0 0.0 255.0 ECU_ADDRESS 0x007FCF35 /begin FUNCTION_LIST PMDIAG /end FUNCTION_LIST BIT_MASK 0x1 /end MEASUREMENT
/begin MEASUREMENT St_pmdiag1.B_histrset "CC Meldung : Batteriekontakt pruefen" UBYTE Def_bit_ub_1 0 0 0.0 255.0 ECU_ADDRESS 0x007FCF35 /begin FUNCTION_LIST PMDIAG /end FUNCTION_LIST BIT_MASK 0x2 /end MEASUREMENT
/begin MEASUREMENT St_pmdiag1.B_timer_rst "Bed. SVstatus darf geändert werden." UBYTE Def_bit_ub_2 0 0 0.0 255.0 ECU_ADDRESS 0x007FCF35 /begin FUNCTION_LIST PMDIAG /end FUNCTION_LIST BIT_MASK 0x4 /end MEASUREMENT
/begin MEASUREMENT St_pmdiag1.B_sv_ihka "Dient zum Aufziehen des internen Delay Timers" UBYTE Def_bit_ub_3 0 0 0.0 255.0 ECU_ADDRESS 0x007FCF35 /begin FUNCTION_LIST PMDIAG /end FUNCTION_LIST BIT_MASK 0x8 /end MEASUREMENT
/begin MEASUREMENT St_pmdiag1.B_ruhverl7 "Tiefentladungsbit, B_tiefset, im IBS löschen." UBYTE Def_bit_ub_4 0 0 0.0 255.0 ECU_ADDRESS 0x007FCF35 /begin FUNCTION_LIST PMDIAG /end FUNCTION_LIST BIT_MASK 0x10 /end MEASUREMENT
/begin MEASUREMENT St_pmdiag1.B_qelad1step "CC Meldung : erhoehter Ruhestrom" UBYTE Def_bit_ub_5 0 0 0.0 255.0 ECU_ADDRESS 0x007FCF35 /begin FUNCTION_LIST PMDIAG /end FUNCTION_LIST BIT_MASK 0x20 /end MEASUREMENT
/begin MEASUREMENT St_pmdiag1 "Statuswort" UBYTE Def_st_ub_q1 0 0 0.0 255.0000 ECU_ADDRESS 0x007FCF35 /begin FUNCTION_LIST PMDIAG /end FUNCTION_LIST /end MEASUREMENT
/begin MEASUREMENT St_pmdiagnv.B_ruhverl "ruhestromverletzung vorhanden" UBYTE Def_bit_ub_0 0 0 0.0 255.0 ECU_ADDRESS 0x008011A0 /begin FUNCTION_LIST PMDIAG /end FUNCTION_LIST BIT_MASK 0x1 /end MEASUREMENT
/begin MEASUREMENT St_pmdiagnv "Statuswort" UBYTE Def_st_ub_q1 0 0 0.0 255.0000 ECU_ADDRESS 0x008011A0 /begin FUNCTION_LIST PMDIAG /end FUNCTION_LIST /end MEASUREMENT
/begin MEASUREMENT Dqelad7 "diff = qelad-qeladold7" UWORD Def_ql_uw_q0p29127 0 0 0.0 19088.4522 ECU_ADDRESS 0x00801170 /begin FUNCTION_LIST PMDIAG /end FUNCTION_LIST /end MEASUREMENT
/begin MEASUREMENT Dqlad7 "diff = qlad-qladold7" UWORD Def_ql_uw_q0p29127 0 0 0.0 19088.4522 ECU_ADDRESS 0x00801172 /begin FUNCTION_LIST PMDIAG /end FUNCTION_LIST /end MEASUREMENT
/begin MEASUREMENT Qladzwsp7 "qlad uebertragspeicher" UWORD Def_dez_uw_q1 0 0 0.0 65535.0000 ECU_ADDRESS 0x00801174 /begin FUNCTION_LIST PMDIAG /end FUNCTION_LIST /end MEASUREMENT
/begin MEASUREMENT Stat_sv_reg "Status Standverbraucher registriert" UWORD Def_dez_uw_q1 0 0 0.0 65535.0000 ECU_ADDRESS 0x00801176 /begin FUNCTION_LIST PMDIAG /end FUNCTION_LIST /end MEASUREMENT
/begin MEASUREMENT T2pmcntr "T2PMINFO countdowncounter" UWORD Def_td_uw_q0p1 0 0 0.0 6553.5000 ECU_ADDRESS 0x00801178 /begin FUNCTION_LIST PMDIAG /end FUNCTION_LIST /end MEASUREMENT
/begin MEASUREMENT T3pmcntr "T3PMINFO countdowncounter" UWORD Def_td_uw_q0p1 0 0 0.0 6553.5000 ECU_ADDRESS 0x0080117A /begin FUNCTION_LIST PMDIAG /end FUNCTION_LIST /end MEASUREMENT
/begin MEASUREMENT T_histsum "Txhistiruh Summe" UWORD Def_td_uw_q56 0 0 0.0 3669960.0000 ECU_ADDRESS 0x0080117C /begin FUNCTION_LIST PMDIAG /end FUNCTION_LIST /end MEASUREMENT
/begin MEASUREMENT T_histsummin "Summe der Txhistiruh in Minuten" UWORD Def_td_uw_q0p933 0 0 0.0 61166.0000 ECU_ADDRESS 0x0080117E /begin FUNCTION_LIST PMDIAG /end FUNCTION_LIST /end MEASUREMENT
/begin MEASUREMENT T2hist "T2histitruh in sek." UWORD Def_td_uw_q14 0 0 0.0 917490.0000 ECU_ADDRESS 0x00801180 /begin FUNCTION_LIST PMDIAG /end FUNCTION_LIST /end MEASUREMENT
/begin MEASUREMENT T3hist "T3histiruh in Sek" UWORD Def_td_uw_q14 0 0 0.0 917490.0000 ECU_ADDRESS 0x00801182 /begin FUNCTION_LIST PMDIAG /end FUNCTION_LIST /end MEASUREMENT
/begin MEASUREMENT T4hist "T4histiruh in Sek" UWORD Def_td_uw_q14 0 0 0.0 917490.0000 ECU_ADDRESS 0x00801184 /begin FUNCTION_LIST PMDIAG /end FUNCTION_LIST /end MEASUREMENT
/begin MEASUREMENT Batt_index "Batterie Index" UBYTE Def_dez_ub_q1 0 0 0.0 255.0000 ECU_ADDRESS 0x00801186 /begin FUNCTION_LIST PMDIAG /end FUNCTION_LIST /end MEASUREMENT
/begin MEASUREMENT C_battnenn "Batteriekapazitaet" UBYTE Def_ql_ub_q1 0 0 0.0 255.0000 ECU_ADDRESS 0x00801187 /begin FUNCTION_LIST PMDIAG /end FUNCTION_LIST /end MEASUREMENT
/begin MEASUREMENT Codiercnt "Internet Zaehler fuer Anfrage Codierung" UBYTE Def_td_ub_q0p1 0 0 0.0 25.5000 ECU_ADDRESS 0x00801188 /begin FUNCTION_LIST PMDIAG /end FUNCTION_LIST /end MEASUREMENT
/begin MEASUREMENT Ibsbor_hb "highbyte ibsborctr" UBYTE Def_dez_ub_q1 0 0 0.0 255.0000 ECU_ADDRESS 0x00801189 /begin FUNCTION_LIST PMDIAG /end FUNCTION_LIST /end MEASUREMENT
/begin MEASUREMENT Ikurz_ogrz "Obere Grenze Kurzschlußstrom" UBYTE Def_i_ub_q10 0 0 0.0 2550.0000 ECU_ADDRESS 0x0080118A /begin FUNCTION_LIST PMDIAG /end FUNCTION_LIST /end MEASUREMENT
/begin MEASUREMENT Ikurz_ugrz "Untere Grenze Kurzschlußstrom" UBYTE Def_i_ub_q10 0 0 0.0 2550.0000 ECU_ADDRESS 0x0080118B /begin FUNCTION_LIST PMDIAG /end FUNCTION_LIST /end MEASUREMENT
/begin MEASUREMENT Iwakeupgrz "Ruhestromverletzungsgrenze, ab hier weckt u.U. das IBS." UBYTE Def_i_ub_q0p00125 0 0 0.0 0.2550 ECU_ADDRESS 0x0080118C /begin FUNCTION_LIST PMDIAG /end FUNCTION_LIST /end MEASUREMENT
/begin MEASUREMENT Ospgcnt "fs_Oberspannungscounter" UBYTE Def_td_ub_q0p1 0 0 0.0 25.5000 ECU_ADDRESS 0x0080118D /begin FUNCTION_LIST PMDIAG /end FUNCTION_LIST /end MEASUREMENT
/begin MEASUREMENT Ospgprell "Anzahl der entprellten FS_Oberspannungserkennung" UBYTE Def_dez_ub_q1 0 0 0.0 255.0000 ECU_ADDRESS 0x0080118E /begin FUNCTION_LIST PMDIAG /end FUNCTION_LIST /end MEASUREMENT
/begin MEASUREMENT Ospgstat "Status Oberspannungserkennung" UBYTE Def_dez_ub_q1 0 0 0.0 255.0000 ECU_ADDRESS 0x0080118F /begin FUNCTION_LIST PMDIAG /end FUNCTION_LIST /end MEASUREMENT
/begin MEASUREMENT Pm_klemmstat "Umweltbed. Klemmenstatus" UBYTE Def_dez_ub_q1 0 0 0.0 255.0000 ECU_ADDRESS 0x00801190 /begin FUNCTION_LIST PMDIAG /end FUNCTION_LIST /end MEASUREMENT
/begin MEASUREMENT Stat_sv_reg1 "LoByte Stat_sv_reg für Umweltbedingungen" UBYTE Def_dez_ub_q1 0 0 0.0 255.0000 ECU_ADDRESS 0x00801191 /begin FUNCTION_LIST PMDIAG /end FUNCTION_LIST /end MEASUREMENT
/begin MEASUREMENT Stat_sv_reg2 "HiByte Stat_sv_reg für Umweltbedinung" UBYTE Def_dez_ub_q1 0 0 0.0 255.0000 ECU_ADDRESS 0x00801192 /begin FUNCTION_LIST PMDIAG /end FUNCTION_LIST /end MEASUREMENT
/begin MEASUREMENT Svaus "Status Standverbraucher sind aus " UBYTE Identity 0 0 0.0 1.0000 ECU_ADDRESS 0x00801193 /begin FUNCTION_LIST PMDIAG /end FUNCTION_LIST /end MEASUREMENT
/begin MEASUREMENT T1histshort "T1 Histogramm in 14.9333 MIn. Quantisiert" UBYTE Def_td_ub_q14p9333 0 0 0.0 3808.0000 ECU_ADDRESS 0x00801194 /begin FUNCTION_LIST PMDIAG /end FUNCTION_LIST /end MEASUREMENT
/begin MEASUREMENT T1pmcntr "T1PMINFO countdowncounter" UBYTE Def_td_ub_q0p1 0 0 0.0 25.5000 ECU_ADDRESS 0x00801195 /begin FUNCTION_LIST PMDIAG /end FUNCTION_LIST /end MEASUREMENT
/begin MEASUREMENT T2histshort "T2 Histogramm als Umweltbed. bei Ruhestromverletzung" UBYTE Def_td_ub_q14p9333 0 0 0.0 3808.0000 ECU_ADDRESS 0x00801196 /begin FUNCTION_LIST PMDIAG /end FUNCTION_LIST /end MEASUREMENT
/begin MEASUREMENT T3histshort "T3 Histogramm als Umweltbed. bei Ruhestromverletzung" UBYTE Def_td_ub_q14p9333 0 0 0.0 3808.0000 ECU_ADDRESS 0x00801197 /begin FUNCTION_LIST PMDIAG /end FUNCTION_LIST /end MEASUREMENT
/begin MEASUREMENT T4histshort "T4 Histogramm als Umweltbed. bei Ruhestromverletzung" UBYTE Def_td_ub_q14p9333 0 0 0.0 3808.0000 ECU_ADDRESS 0x00801198 /begin FUNCTION_LIST PMDIAG /end FUNCTION_LIST /end MEASUREMENT
/begin MEASUREMENT T_saismem "T Saison zw. speicher" UBYTE Def_dez_ub_q1 0 0 0.0 255.0000 ECU_ADDRESS 0x00801199 /begin FUNCTION_LIST PMDIAG /end FUNCTION_LIST /end MEASUREMENT
/begin MEASUREMENT Uspgcnt "FS_Unterspannungscounter" UBYTE Def_td_ub_q0p1 0 0 0.0 25.5000 ECU_ADDRESS 0x0080119A /begin FUNCTION_LIST PMDIAG /end FUNCTION_LIST /end MEASUREMENT
/begin MEASUREMENT Uspgprell "Anzahl der entprellten FS_Unterspannungserkennung." UBYTE Def_dez_ub_q1 0 0 0.0 255.0000 ECU_ADDRESS 0x0080119B /begin FUNCTION_LIST PMDIAG /end FUNCTION_LIST /end MEASUREMENT
/begin MEASUREMENT Uspgstat "FS_Unterspannungsstatus" UBYTE Def_dez_ub_q1 0 0 0.0 255.0000 ECU_ADDRESS 0x0080119C /begin FUNCTION_LIST PMDIAG /end FUNCTION_LIST /end MEASUREMENT
/begin MEASUREMENT Ztagedelta "verstrichene Tage" UBYTE Def_dez_ub_q1 0 0 0.0 10.0000 ECU_ADDRESS 0x0080119D /begin FUNCTION_LIST PMDIAG /end FUNCTION_LIST /end MEASUREMENT
/begin MEASUREMENT Ztagestate "Tageswechsel Statemachine Ctr" UBYTE Def_dez_ub_q1 0 0 0.0 255.0000 ECU_ADDRESS 0x0080119E /begin FUNCTION_LIST PMDIAG /end FUNCTION_LIST /end MEASUREMENT
/begin MEASUREMENT Pminfo1 "Infospeicher 1 vom Powermanagement" UWORD Def_dez_uw_q1 0 0 0.0 65535.0000 ECU_ADDRESS 0x008011A2 ARRAY_SIZE 37 /begin FUNCTION_LIST PMDIAG /end FUNCTION_LIST /end MEASUREMENT
/begin MEASUREMENT Qeladold7 "zuletzt gesp. qelad" UWORD Def_ql_uw_q0p0182 0 0 0.0 1193.0282 ECU_ADDRESS 0x008011EC /begin FUNCTION_LIST PMDIAG /end FUNCTION_LIST /end MEASUREMENT
/begin MEASUREMENT Qladold7 "zuletzt gesp. qlad" UWORD Def_ql_uw_q0p0182 0 0 0.0 1193.0282 ECU_ADDRESS 0x008011EE /begin FUNCTION_LIST PMDIAG /end FUNCTION_LIST /end MEASUREMENT
/begin MEASUREMENT Ztageold "letzter Wert von ztageabs_w" UWORD Def_dez_uw_q1 0 0 0.0 65535.0000 ECU_ADDRESS 0x008011F0 /begin FUNCTION_LIST PMDIAG /end FUNCTION_LIST /end MEASUREMENT
/begin MEASUREMENT Fs_pm "Fehlerspeicher Powermanagement, Bitcodiert" UBYTE Def_dez_ub_q1 0 0 0.0 255.0000 ECU_ADDRESS 0x008011F2 /begin FUNCTION_LIST PMDIAG /end FUNCTION_LIST /end MEASUREMENT
/begin MEASUREMENT Pminfo2 "Fehlerinfo2 vom Powermanagement" UBYTE Def_dez_ub_q1 0 0 0.0 255.0000 ECU_ADDRESS 0x008011F4 ARRAY_SIZE 29 /begin FUNCTION_LIST PMDIAG /end FUNCTION_LIST /end MEASUREMENT
/begin MEASUREMENT St_pmprsvcalc.B_ubtlow "Bedingung Batterie in Unterspannungszustand" UBYTE Def_bit_ub_0 0 0 0.0 255.0 ECU_ADDRESS 0x007FCF3A /begin FUNCTION_LIST PMPRSVCALC /end FUNCTION_LIST BIT_MASK 0x1 /end MEASUREMENT
/begin MEASUREMENT St_pmprsvcalc.B_uloreset "Bedingung Batterie nicht mehr in Unterspannungszustand" UBYTE Def_bit_ub_1 0 0 0.0 255.0 ECU_ADDRESS 0x007FCF3A /begin FUNCTION_LIST PMPRSVCALC /end FUNCTION_LIST BIT_MASK 0x2 /end MEASUREMENT
/begin MEASUREMENT St_pmprsvcalc.B_ipmtimer "IPM Timer für Prios aktiv" UBYTE Def_bit_ub_2 0 0 0.0 255.0 ECU_ADDRESS 0x007FCF3A /begin FUNCTION_LIST PMPRSVCALC /end FUNCTION_LIST BIT_MASK 0x4 /end MEASUREMENT
/begin MEASUREMENT St_pmprsvcalc.B_ipmaktiv "IPM Massnahmen bzgl. Prios aktiviert" UBYTE Def_bit_ub_3 0 0 0.0 255.0 ECU_ADDRESS 0x007FCF3A /begin FUNCTION_LIST PMPRSVCALC /end FUNCTION_LIST BIT_MASK 0x8 /end MEASUREMENT
/begin MEASUREMENT St_pmprsvcalc.B_kwdr_old "Dient zur Erkennung einer steigender Flanke B_kl15" UBYTE Def_bit_ub_4 0 0 0.0 255.0 ECU_ADDRESS 0x007FCF3A /begin FUNCTION_LIST PMPRSVCALC /end FUNCTION_LIST BIT_MASK 0x10 /end MEASUREMENT
/begin MEASUREMENT St_pmprsvcalc.B_gendef "Bedingung Generator defekt während Motorbetrieb" UBYTE Def_bit_ub_5 0 0 0.0 255.0 ECU_ADDRESS 0x007FCF3A /begin FUNCTION_LIST PMPRSVCALC /end FUNCTION_LIST BIT_MASK 0x20 /end MEASUREMENT
/begin MEASUREMENT St_pmprsvcalc.B_nkwptcio "NKW status für PTC i.o." UBYTE Def_bit_ub_6 0 0 0.0 255.0 ECU_ADDRESS 0x007FCF3A /begin FUNCTION_LIST PMPRSVCALC /end FUNCTION_LIST BIT_MASK 0x40 /end MEASUREMENT
/begin MEASUREMENT St_pmprsvcalc.B_ptckoor "PTC Koordinator Maßnahmen Aktiv" UBYTE Def_bit_ub_7 0 0 0.0 255.0 ECU_ADDRESS 0x007FCF3A /begin FUNCTION_LIST PMPRSVCALC /end FUNCTION_LIST BIT_MASK 0x80 /end MEASUREMENT
/begin MEASUREMENT St_pmprsvcalc "Statuswort" UBYTE Def_st_ub_q1 0 0 0.0 255.0000 ECU_ADDRESS 0x007FCF3A /begin FUNCTION_LIST PMPRSVCALC /end FUNCTION_LIST /end MEASUREMENT
/begin MEASUREMENT St_pmprsvcalc1.B_enwakeup "Bit, ob IBS Bus wecken darf oder nicht." UBYTE Def_bit_ub_0 0 0 0.0 255.0 ECU_ADDRESS 0x007FCF3C /begin FUNCTION_LIST PMPRSVCALC /end FUNCTION_LIST BIT_MASK 0x1 /end MEASUREMENT
/begin MEASUREMENT St_pmprsvcalc1.B_dubt "Bedg., ob dubt > 100mV" UBYTE Def_bit_ub_1 0 0 0.0 255.0 ECU_ADDRESS 0x007FCF3C /begin FUNCTION_LIST PMPRSVCALC /end FUNCTION_LIST BIT_MASK 0x2 /end MEASUREMENT
/begin MEASUREMENT St_pmprsvcalc1.B_pmvsdanf "Bedg., ob 3b3 versendet wird" UBYTE Def_bit_ub_2 0 0 0.0 255.0 ECU_ADDRESS 0x007FCF3C /begin FUNCTION_LIST PMPRSVCALC /end FUNCTION_LIST BIT_MASK 0x4 /end MEASUREMENT
/begin MEASUREMENT St_pmprsvcalc1.B_pmbsdanf "Bedg. ob 3b4 versendet wird" UBYTE Def_bit_ub_4 0 0 0.0 255.0 ECU_ADDRESS 0x007FCF3C /begin FUNCTION_LIST PMPRSVCALC /end FUNCTION_LIST BIT_MASK 0x10 /end MEASUREMENT
/begin MEASUREMENT St_pmprsvcalc1.B_limcalc "Bedg. begrenzte Berechnung" UBYTE Def_bit_ub_5 0 0 0.0 255.0 ECU_ADDRESS 0x007FCF3C /begin FUNCTION_LIST PMPRSVCALC /end FUNCTION_LIST BIT_MASK 0x20 /end MEASUREMENT
/begin MEASUREMENT St_pmprsvcalc1.B_notprsv "Bed.Notlauf aufg.Batt-Unterspg, Generatorstat und B_kl15 in PMPRSVCALC" UBYTE Def_bit_ub_6 0 0 0.0 255.0 ECU_ADDRESS 0x007FCF3C /begin FUNCTION_LIST PMPRSVCALC /end FUNCTION_LIST BIT_MASK 0x40 /end MEASUREMENT
/begin MEASUREMENT St_pmprsvcalc1.B_pireset "Bedingung für PI-Reset" UBYTE Def_bit_ub_7 0 0 0.0 255.0 ECU_ADDRESS 0x007FCF3C /begin FUNCTION_LIST PMPRSVCALC /end FUNCTION_LIST BIT_MASK 0x80 /end MEASUREMENT
/begin MEASUREMENT St_pmprsvcalc1 "Statuswort" UBYTE Def_st_ub_q1 0 0 0.0 255.0000 ECU_ADDRESS 0x007FCF3C /begin FUNCTION_LIST PMPRSVCALC /end FUNCTION_LIST /end MEASUREMENT
/begin MEASUREMENT St_pmprsvcalc2.B_kwdrise "Motorstart Rising" UBYTE Def_bit_ub_0 0 0 0.0 255.0 ECU_ADDRESS 0x007FCF3B /begin FUNCTION_LIST PMPRSVCALC /end FUNCTION_LIST BIT_MASK 0x1 /end MEASUREMENT
/begin MEASUREMENT St_pmprsvcalc2.B_pmsulevon "PM Sulev Maßnahmen aktiv" UBYTE Def_bit_ub_1 0 0 0.0 255.0 ECU_ADDRESS 0x007FCF3B /begin FUNCTION_LIST PMPRSVCALC /end FUNCTION_LIST BIT_MASK 0x2 /end MEASUREMENT
/begin MEASUREMENT St_pmprsvcalc2.B_genkommerr "Nur Gen. Komm. Fehler vorhanden" UBYTE Def_bit_ub_2 0 0 0.0 255.0 ECU_ADDRESS 0x007FCF3B /begin FUNCTION_LIST PMPRSVCALC /end FUNCTION_LIST BIT_MASK 0x4 /end MEASUREMENT
/begin MEASUREMENT St_pmprsvcalc2 "Statuswort" UBYTE Def_st_ub_q1 0 0 0.0 255.0000 ECU_ADDRESS 0x007FCF3B /begin FUNCTION_LIST PMPRSVCALC /end FUNCTION_LIST /end MEASUREMENT
/begin MEASUREMENT St_pmprsv_nv.B_enwake7 "lokales B_enwake" UBYTE Def_bit_ub_0 0 0 0.0 255.0 ECU_ADDRESS 0x0080129E /begin FUNCTION_LIST PMPRSVCALC /end FUNCTION_LIST BIT_MASK 0x1 /end MEASUREMENT
/begin MEASUREMENT St_pmprsv_nv "Statuswort" UBYTE Def_st_ub_q1 0 0 0.0 255.0000 ECU_ADDRESS 0x0080129E /begin FUNCTION_LIST PMPRSVCALC /end FUNCTION_LIST /end MEASUREMENT
/begin MEASUREMENT Priopizw1 "Pi-Regler zw1" SLONG Def_f_sl_q0p007 0 0 -512.0000 512.0000 ECU_ADDRESS 0x00801214 /begin FUNCTION_LIST PMPRSVCALC /end FUNCTION_LIST /end MEASUREMENT
/begin MEASUREMENT Priopizw2 "Pi-Regler zw2" SLONG Def_f_sl_q0p007 0 0 -512.0000 512.0000 ECU_ADDRESS 0x00801218 /begin FUNCTION_LIST PMPRSVCALC /end FUNCTION_LIST /end MEASUREMENT
/begin MEASUREMENT Ptcpizw1 "PTC PI Regler zw1" SLONG Def_f_sl_q0p007 0 0 -512.0000 512.0000 ECU_ADDRESS 0x0080121C /begin FUNCTION_LIST PMPRSVCALC /end FUNCTION_LIST /end MEASUREMENT
/begin MEASUREMENT Ptcpizw2 "PTC PI zw2" SLONG Def_f_sl_q0p007 0 0 -512.0000 512.0000 ECU_ADDRESS 0x00801220 /begin FUNCTION_LIST PMPRSVCALC /end FUNCTION_LIST /end MEASUREMENT
/begin MEASUREMENT All2ptc "Gesamtgewichtung für PTC-Ansteuerung" SWORD Def_f_sw_p0q25 0 0 -500.0000 550.0000 ECU_ADDRESS 0x00801224 /begin FUNCTION_LIST PMPRSVCALC /end FUNCTION_LIST /end MEASUREMENT
/begin MEASUREMENT Df2pi "DF-Gewichtung auf Prios" SWORD Def_f_sw_p0q25 0 0 -100.0000 100.0000 ECU_ADDRESS 0x00801226 /begin FUNCTION_LIST PMPRSVCALC /end FUNCTION_LIST /end MEASUREMENT
/begin MEASUREMENT Dfall2pi "Gesamtgewichtung auf Prios" SWORD Def_f_sw_p0q25 0 0 -500.0000 500.0000 ECU_ADDRESS 0x00801228 /begin FUNCTION_LIST PMPRSVCALC /end FUNCTION_LIST /end MEASUREMENT
/begin MEASUREMENT Dfpi2ptc "Gewichtung der Prios -> Gewichtung für PTC Ansteuerung" SWORD Def_f_sw_p0q25 0 0 -100.0000 100.0000 ECU_ADDRESS 0x0080122A /begin FUNCTION_LIST PMPRSVCALC /end FUNCTION_LIST /end MEASUREMENT
/begin MEASUREMENT Dfpt1_2ptc "gefiltertes dffgen Gewichtung auf PTC-Ansteuerung" SWORD Def_f_sw_p0q25 0 0 -100.0000 100.0000 ECU_ADDRESS 0x0080122C /begin FUNCTION_LIST PMPRSVCALC /end FUNCTION_LIST /end MEASUREMENT
/begin MEASUREMENT Dsoc2pi "Batterieladezustand-Gewichtung auf Prios" SWORD Def_f_sw_p0q25 0 0 -150.0000 150.0000 ECU_ADDRESS 0x0080122E /begin FUNCTION_LIST PMPRSVCALC /end FUNCTION_LIST /end MEASUREMENT
/begin MEASUREMENT Dsoc2ptc "dsoc Gewichtung auf PTC-Ansteuerung" SWORD Def_f_sw_p0q25 0 0 -150.0000 150.0000 ECU_ADDRESS 0x00801230 /begin FUNCTION_LIST PMPRSVCALC /end FUNCTION_LIST /end MEASUREMENT
/begin MEASUREMENT Dudtmul "PTC dudt : gewichtetes Dudt" SWORD Def_f_sw_q0p000147 0 0 -48.2304 48.2289 ECU_ADDRESS 0x00801232 /begin FUNCTION_LIST PMPRSVCALC /end FUNCTION_LIST /end MEASUREMENT
/begin MEASUREMENT Ibtdiff2pi "Batterie-soll-strom Gewichtung auf Prios" SWORD Def_f_sw_p0q25 0 0 -100.0000 100.0000 ECU_ADDRESS 0x00801234 /begin FUNCTION_LIST PMPRSVCALC /end FUNCTION_LIST /end MEASUREMENT
/begin MEASUREMENT Idiff2ptc "idiff Gewichtung auf die PTC-Ansteuerung" SWORD Def_f_sw_p0q25 0 0 -100.0000 100.0000 ECU_ADDRESS 0x00801236 /begin FUNCTION_LIST PMPRSVCALC /end FUNCTION_LIST /end MEASUREMENT
/begin MEASUREMENT Pgen2ptc "Gewichtung der Generatorrestleistung für PTC-Ansteuerung" SWORD Def_f_sw_p0q25 0 0 -100.0000 100.0000 ECU_ADDRESS 0x00801238 /begin FUNCTION_LIST PMPRSVCALC /end FUNCTION_LIST /end MEASUREMENT
/begin MEASUREMENT Ubdiff "ubattsoll - ubatt_w" SWORD Def_f_sw_b32 0 0 -32.0000 31.9990 ECU_ADDRESS 0x0080123A /begin FUNCTION_LIST PMPRSVCALC /end FUNCTION_LIST /end MEASUREMENT
/begin MEASUREMENT Ubdiff2pi "Ubatt-Differenz-Gewichtung auf Prios" SWORD Def_f_sw_p0q25 0 0 -100.0000 100.0000 ECU_ADDRESS 0x0080123C /begin FUNCTION_LIST PMPRSVCALC /end FUNCTION_LIST /end MEASUREMENT
/begin MEASUREMENT Ubt7mem "resultierendes ubt" SWORD Def_u_sw_b128 0 0 -128.0000 127.9960 ECU_ADDRESS 0x0080123E /begin FUNCTION_LIST PMPRSVCALC /end FUNCTION_LIST /end MEASUREMENT
/begin MEASUREMENT Ubtpt12ptc "Ubatt Gewichtung für PTC Ansteuerung" SWORD Def_f_sw_p0q25 0 0 -100.0000 100.0000 ECU_ADDRESS 0x00801240 /begin FUNCTION_LIST PMPRSVCALC /end FUNCTION_LIST /end MEASUREMENT
/begin MEASUREMENT Udeltac "inkrementierte Differenz zwischen altem und neuem ubt" SWORD Def_u_sw_b128 0 0 -128.0000 127.9960 ECU_ADDRESS 0x00801242 /begin FUNCTION_LIST PMPRSVCALC /end FUNCTION_LIST /end MEASUREMENT
/begin MEASUREMENT Ubdiffilt "Wert nach Ubdiff-Tiefpass Prio" SWORD Def_f_sw_b32 0 0 -32.0000 31.9990 ECU_ADDRESS 0x00801274 /begin FUNCTION_LIST PMPRSVCALC /end FUNCTION_LIST /end MEASUREMENT
/begin MEASUREMENT Ubdiffptc "Delta Usoll-Ubatt PTC" SWORD Def_f_sw_b32 0 0 -32.0000 31.9990 ECU_ADDRESS 0x00801276 /begin FUNCTION_LIST PMPRSVCALC /end FUNCTION_LIST /end MEASUREMENT
/begin MEASUREMENT Ubtpt1ptc "Ubdiffptc gefiltert" SWORD Def_f_sw_b32 0 0 -32.0000 31.9990 ECU_ADDRESS 0x00801278 /begin FUNCTION_LIST PMPRSVCALC /end FUNCTION_LIST /end MEASUREMENT
/begin MEASUREMENT Allptcfilt "pi-geregelte Gewichtung für PTC-Ansteuerung" UWORD Def_f_uw_q0p25 0 0 0.0 550.0000 ECU_ADDRESS 0x00801244 /begin FUNCTION_LIST PMPRSVCALC /end FUNCTION_LIST /end MEASUREMENT
/begin MEASUREMENT Ctrpwrcf "Komfort-Teil von ctrpwrcos" UWORD Def_dez_uw_q1 0 0 0.0 65535.0000 ECU_ADDRESS 0x00801246 /begin FUNCTION_LIST PMPRSVCALC /end FUNCTION_LIST /end MEASUREMENT
/begin MEASUREMENT Ctrpwrcos "Steuerung_Leistung_Verbraucher" UWORD Def_dez_uw_q1 0 0 0.0 65535.0000 ECU_ADDRESS 0x00801248 /begin FUNCTION_LIST PMPRSVCALC /end FUNCTION_LIST /end MEASUREMENT
/begin MEASUREMENT Ctrpwrcos7 "lokales ctrpwrcos" UWORD Def_dez_uw_q1 0 0 0.0 65535.0000 ECU_ADDRESS 0x0080124A /begin FUNCTION_LIST PMPRSVCALC /end FUNCTION_LIST /end MEASUREMENT
/begin MEASUREMENT Ctrpwrdf "df-Teil von ctrpwrcos" UWORD Def_dez_uw_q1 0 0 0.0 65535.0000 ECU_ADDRESS 0x0080124C /begin FUNCTION_LIST PMPRSVCALC /end FUNCTION_LIST /end MEASUREMENT
/begin MEASUREMENT Ctrpwrmem "altes ctrpwrcos" UWORD Def_dez_uw_q1 0 0 0.0 65535.0000 ECU_ADDRESS 0x0080124E /begin FUNCTION_LIST PMPRSVCALC /end FUNCTION_LIST /end MEASUREMENT
/begin MEASUREMENT Dfallpi "PI-Geregelte Gesamtgewichtung auf Prios" UWORD Def_f_uw_q0p25 0 0 0.0 450.0000 ECU_ADDRESS 0x00801250 /begin FUNCTION_LIST PMPRSVCALC /end FUNCTION_LIST /end MEASUREMENT
/begin MEASUREMENT Dfprio "" UWORD Def_f_uw_q0p25 0 0 0.0 450.0000 ECU_ADDRESS 0x00801252 /begin FUNCTION_LIST PMPRSVCALC /end FUNCTION_LIST /end MEASUREMENT
/begin MEASUREMENT F_dudtptc "Inkrement auf Ptc_pwr aufgrund du/dt" UWORD Def_f_uw_q0p25 0 0 0.0 550.0000 ECU_ADDRESS 0x00801254 /begin FUNCTION_LIST PMPRSVCALC /end FUNCTION_LIST /end MEASUREMENT
/begin MEASUREMENT Ibtdiff "Delta Ibtsoll-Ibatt" UWORD Def_i_uw_q0p08_o200 0 0 -200.0000 5042.8000 ECU_ADDRESS 0x00801256 /begin FUNCTION_LIST PMPRSVCALC /end FUNCTION_LIST /end MEASUREMENT
/begin MEASUREMENT Ibtsoll "Sollstrom aufgrund von tbatt und dsoc" UWORD Def_i_uw_q0p08_o200 0 0 -200.0000 5042.8000 ECU_ADDRESS 0x00801258 /begin FUNCTION_LIST PMPRSVCALC /end FUNCTION_LIST /end MEASUREMENT
/begin MEASUREMENT Ipmdfprio "lokale Prioberechnungsvariable bei IPM aktiv" UWORD Def_f_uw_q0p25 0 0 0.0 450.0000 ECU_ADDRESS 0x0080125A /begin FUNCTION_LIST PMPRSVCALC /end FUNCTION_LIST /end MEASUREMENT
/begin MEASUREMENT Isolldiff "Differenz isoll - ibatt_w für PTC Ansteuerung" UWORD Def_i_uw_q0p08_o200 0 0 -200.0000 5042.8000 ECU_ADDRESS 0x0080125C /begin FUNCTION_LIST PMPRSVCALC /end FUNCTION_LIST /end MEASUREMENT
/begin MEASUREMENT Memprio1 "memory 1 PI-Regler dfall2pi E60Prio" UWORD Def_f_uw_b512 0 0 0.0 511.9921 ECU_ADDRESS 0x0080125E /begin FUNCTION_LIST PMPRSVCALC /end FUNCTION_LIST /end MEASUREMENT
/begin MEASUREMENT Memprio2 "memory 2 PI-Regler dfall2pi E60Prio" UWORD Def_f_uw_b512 0 0 0.0 511.9921 ECU_ADDRESS 0x00801260 /begin FUNCTION_LIST PMPRSVCALC /end FUNCTION_LIST /end MEASUREMENT
/begin MEASUREMENT Memptc1 "memory 1 PI-Regler all2ptc PTC" UWORD Def_f_uw_b512 0 0 0.0 511.9921 ECU_ADDRESS 0x00801262 /begin FUNCTION_LIST PMPRSVCALC /end FUNCTION_LIST /end MEASUREMENT
/begin MEASUREMENT Memptc2 "memory 2 PI-Regler all2ptc PTC" UWORD Def_f_uw_b512 0 0 0.0 511.9921 ECU_ADDRESS 0x00801264 /begin FUNCTION_LIST PMPRSVCALC /end FUNCTION_LIST /end MEASUREMENT
/begin MEASUREMENT Pgenrest "Generatorrestleistung (igenrest*ubatt_w)" UWORD Def_f_uw_q0p25 0 0 0.0 6400.0000 ECU_ADDRESS 0x00801266 /begin FUNCTION_LIST PMPRSVCALC /end FUNCTION_LIST /end MEASUREMENT
/begin MEASUREMENT Ptcadd "Wg. Spgeinbruch zu addierender PTC Faktor" UWORD Def_f_uw_q0p25 0 0 0.0 550.0000 ECU_ADDRESS 0x00801268 /begin FUNCTION_LIST PMPRSVCALC /end FUNCTION_LIST /end MEASUREMENT
/begin MEASUREMENT Ubold7 "PTC dudt : alter Ub Wert zur Differenzbildung" UWORD Def_u_uw_q0p0942 0 0 0.0 6173.3970 ECU_ADDRESS 0x0080126A /begin FUNCTION_LIST PMPRSVCALC /end FUNCTION_LIST /end MEASUREMENT
/begin MEASUREMENT Ubt "Batteriespannung" UWORD Def_u_uw_q0p015 0 0 0.0 983.0250 ECU_ADDRESS 0x0080126C /begin FUNCTION_LIST PMPRSVCALC /end FUNCTION_LIST /end MEASUREMENT
/begin MEASUREMENT Ubt7 "Lokale Batteriespannung" UWORD Def_u_uw_q0p015 0 0 0.0 61.4250 ECU_ADDRESS 0x0080126E /begin FUNCTION_LIST PMPRSVCALC /end FUNCTION_LIST /end MEASUREMENT
/begin MEASUREMENT Ubt7old "altes ubt" UWORD Def_u_uw_q0p015 0 0 0.0 61.4250 ECU_ADDRESS 0x00801270 /begin FUNCTION_LIST PMPRSVCALC /end FUNCTION_LIST /end MEASUREMENT
/begin MEASUREMENT Udeltaabsc "absoluter Wert von udelta" UWORD Def_u_uw_q0p015 0 0 0.0 61.4250 ECU_ADDRESS 0x00801272 /begin FUNCTION_LIST PMPRSVCALC /end FUNCTION_LIST /end MEASUREMENT
/begin MEASUREMENT D_udtptc "Spannungsdifferenz in 10ms" SBYTE Def_u_sb_q0p0942 0 0 -12.0576 11.9634 ECU_ADDRESS 0x0080127A /begin FUNCTION_LIST PMPRSVCALC /end FUNCTION_LIST /end MEASUREMENT
/begin MEASUREMENT Ctrcbr "Steuerung_Stromzweige" UBYTE Def_dez_ub_q1 0 0 0.0 255.0000 ECU_ADDRESS 0x0080127B /begin FUNCTION_LIST PMPRSVCALC /end FUNCTION_LIST /end MEASUREMENT
/begin MEASUREMENT Ctrcbr7 "lokales ctrcbr" UBYTE Def_dez_ub_q1 0 0 0.0 255.0000 ECU_ADDRESS 0x0080127C /begin FUNCTION_LIST PMPRSVCALC /end FUNCTION_LIST /end MEASUREMENT
/begin MEASUREMENT Ctrcbrmem "altes ctrbr" UBYTE Def_dez_ub_q1 0 0 0.0 255.0000 ECU_ADDRESS 0x0080127D /begin FUNCTION_LIST PMPRSVCALC /end FUNCTION_LIST /end MEASUREMENT
/begin MEASUREMENT Ctrpcos "Steuerung_Standverbraucher" UBYTE Def_dez_ub_q1 0 0 0.0 3.0000 ECU_ADDRESS 0x0080127E /begin FUNCTION_LIST PMPRSVCALC /end FUNCTION_LIST /end MEASUREMENT
/begin MEASUREMENT Ctrpcosmem "altes ctrpcos" UBYTE Def_dez_ub_q1 0 0 0.0 3.0000 ECU_ADDRESS 0x0080127F /begin FUNCTION_LIST PMPRSVCALC /end FUNCTION_LIST /end MEASUREMENT
/begin MEASUREMENT Ctrprio "Steuerung_Spitzenreduzierung_Priorität" UBYTE Def_dez_ub_q1 0 0 0.0 7.0000 ECU_ADDRESS 0x00801280 /begin FUNCTION_LIST PMPRSVCALC /end FUNCTION_LIST /end MEASUREMENT
/begin MEASUREMENT Ctrprio7 "lokales ctrprio" UBYTE Def_dez_ub_q1 0 0 0.0 7.0000 ECU_ADDRESS 0x00801281 /begin FUNCTION_LIST PMPRSVCALC /end FUNCTION_LIST /end MEASUREMENT
/begin MEASUREMENT Ctrpriocf "Steuerung_Spitzenreduzierung_Priorität_Komfort" UBYTE Def_dez_ub_q1 0 0 0.0 7.0000 ECU_ADDRESS 0x00801282 /begin FUNCTION_LIST PMPRSVCALC /end FUNCTION_LIST /end MEASUREMENT
/begin MEASUREMENT Ctrpriocf7 "lokales ctrpriocf" UBYTE Def_dez_ub_q1 0 0 0.0 7.0000 ECU_ADDRESS 0x00801283 /begin FUNCTION_LIST PMPRSVCALC /end FUNCTION_LIST /end MEASUREMENT
/begin MEASUREMENT Ctrpriocfm "altes ctrpriocf" UBYTE Def_dez_ub_q1 0 0 0.0 7.0000 ECU_ADDRESS 0x00801284 /begin FUNCTION_LIST PMPRSVCALC /end FUNCTION_LIST /end MEASUREMENT
/begin MEASUREMENT Ctrpriomem "altes ctrprio" UBYTE Def_dez_ub_q1 0 0 0.0 7.0000 ECU_ADDRESS 0x00801285 /begin FUNCTION_LIST PMPRSVCALC /end FUNCTION_LIST /end MEASUREMENT
/begin MEASUREMENT Ctrpwspcos "Steuerung_Leistung_Sonderverbraucher" UBYTE Def_f_ub_b127p5 0 0 0.0 127.5000 ECU_ADDRESS 0x00801286 /begin FUNCTION_LIST PMPRSVCALC /end FUNCTION_LIST /end MEASUREMENT
/begin MEASUREMENT Dff_filt7 "lokales dffgenflit" UBYTE Def_f_ub_b100 0 0 0.0 99.6093 ECU_ADDRESS 0x00801287 /begin FUNCTION_LIST PMPRSVCALC /end FUNCTION_LIST /end MEASUREMENT
/begin MEASUREMENT Dfgenfilt "Über PT-1 gefiltertes dffgen-Signal" UBYTE Def_f_ub_b100 0 0 0.0 99.6093 ECU_ADDRESS 0x00801288 /begin FUNCTION_LIST PMPRSVCALC /end FUNCTION_LIST /end MEASUREMENT
/begin MEASUREMENT Picntr "Counter fuer PI-Reset" UBYTE Def_td_ub_q0p1 0 0 0.0 25.5000 ECU_ADDRESS 0x00801289 /begin FUNCTION_LIST PMPRSVCALC /end FUNCTION_LIST /end MEASUREMENT
/begin MEASUREMENT Pmbscount "zyklisches Senden entspricht 5 sek" UBYTE Def_dez_ub_q1 0 0 0.0 255.0000 ECU_ADDRESS 0x0080128A /begin FUNCTION_LIST PMPRSVCALC /end FUNCTION_LIST /end MEASUREMENT
/begin MEASUREMENT Pmvscount "Zähler bis zum nächsten zyklischen Senden von 3b3" UBYTE Def_dez_ub_q1 0 0 0.0 255.0000 ECU_ADDRESS 0x0080128B /begin FUNCTION_LIST PMPRSVCALC /end FUNCTION_LIST /end MEASUREMENT
/begin MEASUREMENT Ptc_pwr "Maximale Leistung, die der PTC einstellen darf." UBYTE Def_f_ub_b127p5 0 0 0.0 127.5000 ECU_ADDRESS 0x0080128C /begin FUNCTION_LIST PMPRSVCALC /end FUNCTION_LIST /end MEASUREMENT
/begin MEASUREMENT Ptc_pwr7 "lokales ptc_pwr" UBYTE Def_f_ub_b127p5 0 0 0.0 127.5000 ECU_ADDRESS 0x0080128D /begin FUNCTION_LIST PMPRSVCALC /end FUNCTION_LIST /end MEASUREMENT
/begin MEASUREMENT Pwrspmem "altes ctrpwspcos" UBYTE Def_f_ub_b127p5 0 0 0.0 127.5000 ECU_ADDRESS 0x0080128E /begin FUNCTION_LIST PMPRSVCALC /end FUNCTION_LIST /end MEASUREMENT
/begin MEASUREMENT Rqpcos "Anforderung_Standverbraucher" UBYTE Def_dez_ub_q1 0 0 0.0 3.0000 ECU_ADDRESS 0x0080128F /begin FUNCTION_LIST PMPRSVCALC /end FUNCTION_LIST /end MEASUREMENT
/begin MEASUREMENT Rqpcos7 "lokales rqpcos" UBYTE Def_dez_ub_q1 0 0 0.0 3.0000 ECU_ADDRESS 0x00801290 /begin FUNCTION_LIST PMPRSVCALC /end FUNCTION_LIST /end MEASUREMENT
/begin MEASUREMENT Rqpcosmem "altes rqpcos" UBYTE Def_dez_ub_q1 0 0 0.0 3.0000 ECU_ADDRESS 0x00801291 /begin FUNCTION_LIST PMPRSVCALC /end FUNCTION_LIST /end MEASUREMENT
/begin MEASUREMENT Selspcos "Auswahl_Sonderverbraucher" UBYTE Def_dez_ub_q1 0 0 0.0 15.0000 ECU_ADDRESS 0x00801292 /begin FUNCTION_LIST PMPRSVCALC /end FUNCTION_LIST /end MEASUREMENT
/begin MEASUREMENT Selspcosme "altes selspcos" UBYTE Def_dez_ub_q1 0 0 0.0 15.0000 ECU_ADDRESS 0x00801293 /begin FUNCTION_LIST PMPRSVCALC /end FUNCTION_LIST /end MEASUREMENT
/begin MEASUREMENT Stpcos "Status_Standverbraucher" UBYTE Def_dez_ub_q1 0 0 0.0 3.0000 ECU_ADDRESS 0x00801294 /begin FUNCTION_LIST PMPRSVCALC /end FUNCTION_LIST /end MEASUREMENT
/begin MEASUREMENT Stpcosmem "altes stpcos" UBYTE Def_dez_ub_q1 0 0 0.0 3.0000 ECU_ADDRESS 0x00801295 /begin FUNCTION_LIST PMPRSVCALC /end FUNCTION_LIST /end MEASUREMENT
/begin MEASUREMENT Ulev "Spannungsebene" UBYTE Def_dez_ub_q1 0 0 0.0 15.0000 ECU_ADDRESS 0x00801296 /begin FUNCTION_LIST PMPRSVCALC /end FUNCTION_LIST /end MEASUREMENT
/begin MEASUREMENT Ulevmem "altes ulev" UBYTE Def_dez_ub_q1 0 0 0.0 15.0000 ECU_ADDRESS 0x00801297 /begin FUNCTION_LIST PMPRSVCALC /end FUNCTION_LIST /end MEASUREMENT
/begin MEASUREMENT Ulow "Unterspannungsstatus : 0=i.O, 1=in between, 2=unterspannung" UBYTE Def_dez_ub_q1 0 0 0.0 255.0000 ECU_ADDRESS 0x00801298 /begin FUNCTION_LIST PMPRSVCALC /end FUNCTION_LIST /end MEASUREMENT
/begin MEASUREMENT Ulowtimer "Zeit zur Unterspannungserkennung * Taskzeit (50*100ms = 5sec)" UBYTE Def_td_ub_q0p1 0 0 0.0 25.5000 ECU_ADDRESS 0x00801299 /begin FUNCTION_LIST PMPRSVCALC /end FUNCTION_LIST /end MEASUREMENT
/begin MEASUREMENT kbmcount "Counter, gesetzt von KBMCNT_APP" UBYTE Def_td_ub_q0p1 0 0 0.0 25.5000 ECU_ADDRESS 0x0080129A /begin FUNCTION_LIST PMPRSVCALC /end FUNCTION_LIST /end MEASUREMENT
/begin MEASUREMENT Dfpt1filt "Wert nach DF-Tiefpass Prio" UBYTE Def_f_ub_b100 0 0 0.0 99.6093 ECU_ADDRESS 0x0080129B /begin FUNCTION_LIST PMPRSVCALC /end FUNCTION_LIST /end MEASUREMENT
/begin MEASUREMENT Dfpt1ptc "Wert nach DFFGEN-Filter PTC" UBYTE Def_f_ub_b100 0 0 0.0 99.6093 ECU_ADDRESS 0x0080129C /begin FUNCTION_LIST PMPRSVCALC /end FUNCTION_LIST /end MEASUREMENT
/begin MEASUREMENT Igenrest "Generatorreststrom modelliert" UBYTE Def_i_ub_q1 0 0 0.0 255.0000 ECU_ADDRESS 0x0080129D /begin FUNCTION_LIST PMPRSVCALC /end FUNCTION_LIST /end MEASUREMENT
/begin MEASUREMENT Ctrpcos7 "lokales ctrpcos" UBYTE Def_dez_ub_q1 0 0 0.0 3.0000 ECU_ADDRESS 0x0080129F /begin FUNCTION_LIST PMPRSVCALC /end FUNCTION_LIST /end MEASUREMENT
/begin MEASUREMENT Stpcos7 "lokales stpcos" UBYTE Def_dez_ub_q1 0 0 0.0 3.0000 ECU_ADDRESS 0x008012A0 /begin FUNCTION_LIST PMPRSVCALC /end FUNCTION_LIST /end MEASUREMENT
/begin MEASUREMENT St_pmsoccalc.B_soc_pwf "Uo Kalibrierung durchgeführt" UBYTE Def_bit_ub_1 0 0 0.0 255.0 ECU_ADDRESS 0x007FCF6C /begin FUNCTION_LIST PMSOCCALC /end FUNCTION_LIST BIT_MASK 0x2 /end MEASUREMENT
/begin MEASUREMENT St_pmsoccalc.B_soccalc "Uo Kalibrierung durchgeführt" UBYTE Def_bit_ub_2 0 0 0.0 255.0 ECU_ADDRESS 0x007FCF6C /begin FUNCTION_LIST PMSOCCALC /end FUNCTION_LIST BIT_MASK 0x4 /end MEASUREMENT
/begin MEASUREMENT St_pmsoccalc "Statuswort" UBYTE Def_st_ub_q1 0 0 0.0 255.0000 ECU_ADDRESS 0x007FCF6C /begin FUNCTION_LIST PMSOCCALC /end FUNCTION_LIST /end MEASUREMENT
/begin MEASUREMENT St_pmsocalc1.B_ibspwf_e "Bedingung Powerfail IBS erkannt" UBYTE Def_bit_ub_0 0 0 0.0 255.0 ECU_ADDRESS 0x008012B0 /begin FUNCTION_LIST PMSOCCALC /end FUNCTION_LIST BIT_MASK 0x1 /end MEASUREMENT
/begin MEASUREMENT St_pmsocalc1 "Statuswort" UBYTE Def_st_ub_q1 0 0 0.0 255.0000 ECU_ADDRESS 0x008012B0 /begin FUNCTION_LIST PMSOCCALC /end FUNCTION_LIST /end MEASUREMENT
/begin MEASUREMENT D_qelad "Delta Kapazität entladen" UWORD Def_ql_uw_q0p0182 0 0 0.0 1193.0282 ECU_ADDRESS 0x008012A2 /begin FUNCTION_LIST PMSOCCALC /end FUNCTION_LIST /end MEASUREMENT
/begin MEASUREMENT D_qlad "Delta Kapazität geladen" UWORD Def_ql_uw_q0p0182 0 0 0.0 1193.0282 ECU_ADDRESS 0x008012A4 /begin FUNCTION_LIST PMSOCCALC /end FUNCTION_LIST /end MEASUREMENT
/begin MEASUREMENT Soc_bila "Ladezustand durch Bilanzierung und Ruhespannungsmessung ermittelt" UWORD Def_f_uw_b100 0 0 0.0 99.9984 ECU_ADDRESS 0x008012A6 /begin FUNCTION_LIST PMSOCCALC /end FUNCTION_LIST /end MEASUREMENT
/begin MEASUREMENT Soc_quali "Zähler Genauigkeit Ladeztustandsbestimmung" UWORD Def_ql_uw_q0p0182 0 0 0.0 1193.0282 ECU_ADDRESS 0x008012A8 /begin FUNCTION_LIST PMSOCCALC /end FUNCTION_LIST /end MEASUREMENT
/begin MEASUREMENT Ubatt0 "Aus Wertetripel ausgewählter Ruhespannungswert" UWORD Def_u_uw_q0p25em3_o6 0 0 6.0000 22.3837 ECU_ADDRESS 0x008012AA /begin FUNCTION_LIST PMSOCCALC /end FUNCTION_LIST /end MEASUREMENT
/begin MEASUREMENT Cbatt_lo "Nennkapazität Batterie, lokal" UBYTE Def_ql_ub_q1 0 0 1.0000 255.0000 ECU_ADDRESS 0x008012AC /begin FUNCTION_LIST PMSOCCALC /end FUNCTION_LIST /end MEASUREMENT
/begin MEASUREMENT Ib_commcnt "Zähler Taskaufrufe zwischen periodischer Abfrage qlad und qelad" UBYTE Def_dez_ub_q1 0 0 0.0 255.0000 ECU_ADDRESS 0x008012AD /begin FUNCTION_LIST PMSOCCALC /end FUNCTION_LIST /end MEASUREMENT
/begin MEASUREMENT Ib_commsta "Statemaschine zeiger zur Abfrage qlad und qelad" UBYTE Def_dez_ub_q1 0 0 0.0 255.0000 ECU_ADDRESS 0x008012AE /begin FUNCTION_LIST PMSOCCALC /end FUNCTION_LIST /end MEASUREMENT
/begin MEASUREMENT Kalevcnt "Anzahl der Ruhespannungsmessungen" UBYTE Def_dez_ub_q1 0 0 0.0 255.0000 ECU_ADDRESS 0x008012AF /begin FUNCTION_LIST PMSOCCALC /end FUNCTION_LIST /end MEASUREMENT
/begin MEASUREMENT Q_bila "Kapazität Batterie (long)" ULONG Def_ql_ul_q2p7Em7 0 0 0.0 1193.0464 ECU_ADDRESS 0x008012B4 /begin FUNCTION_LIST PMSOCCALC /end FUNCTION_LIST /end MEASUREMENT
/begin MEASUREMENT Qeladold "Kapazität Entladen vor Abstellen" UWORD Def_ql_uw_q0p0182 0 0 0.0 1193.0282 ECU_ADDRESS 0x008012B8 /begin FUNCTION_LIST PMSOCCALC /end FUNCTION_LIST /end MEASUREMENT
/begin MEASUREMENT Qladold "Kapazität Getladen vor Abstellen" UWORD Def_ql_uw_q0p0182 0 0 0.0 1193.0282 ECU_ADDRESS 0x008012BA /begin FUNCTION_LIST PMSOCCALC /end FUNCTION_LIST /end MEASUREMENT
/begin MEASUREMENT Soc_b_loc "lokal soc_bila f. KFSOCLF" UWORD Def_f_uw_b100 0 0 0.0 99.9984 ECU_ADDRESS 0x008012BC /begin FUNCTION_LIST PMSOCCALC /end FUNCTION_LIST /end MEASUREMENT
/begin MEASUREMENT Soc_q_loc "lokaler Zähler Genauigkeit Ladeztustandsbestimmung" UWORD Def_ql_uw_q0p0182 0 0 0.0 1193.0282 ECU_ADDRESS 0x008012BE /begin FUNCTION_LIST PMSOCCALC /end FUNCTION_LIST /end MEASUREMENT
/begin MEASUREMENT Isoc0loc "Batteriestrom zum Zeitpunkt der Ruhespannungsmessung (lokal)" SWORD Def_i_sw_q0p02 0 0 -655.3600 655.3400 ECU_ADDRESS 0x007FCF68 /begin FUNCTION_LIST PMSOCCALC /end FUNCTION_LIST /end MEASUREMENT
/begin MEASUREMENT Tsocloc "Batterietemperatur zum Zeitpunkt der Ruhespannungsmessung (lokal)" SWORD Def_t_sw_q0p1 0 0 -3276.8000 3276.7000 ECU_ADDRESS 0x007FCF6A /begin FUNCTION_LIST PMSOCCALC /end FUNCTION_LIST /end MEASUREMENT
/begin MEASUREMENT Soc_fit_temp "" UWORD Def_f_uw_b100 0 0 0.0 99.9984 ECU_ADDRESS 0x008012C0 /begin FUNCTION_LIST PMSOCFIT /end FUNCTION_LIST /end MEASUREMENT
/begin MEASUREMENT Ubatts2 "Hilfswert2 Spannung aus Fitberechnung" UWORD Def_u_uw_q0p25em3_o6 0 0 6.0000 16.0000 ECU_ADDRESS 0x008012C2 /begin FUNCTION_LIST PMSOCFIT /end FUNCTION_LIST /end MEASUREMENT
/begin MEASUREMENT Soc_fit "SoC aus der Fitformel" UWORD Def_f_uw_b100 0 0 0.0 99.9984 ECU_ADDRESS 0x008012C4 /begin FUNCTION_LIST PMSOCFIT /end FUNCTION_LIST /end MEASUREMENT
/begin MEASUREMENT St_pmsockor0.B_soc_npl "Bedingung Hilfsvariable Fit 3" UBYTE Def_bit_ub_0 0 0 0.0 255.0 ECU_ADDRESS 0x007FCF74 /begin FUNCTION_LIST PMSOCKOR /end FUNCTION_LIST BIT_MASK 0x1 /end MEASUREMENT
/begin MEASUREMENT St_pmsockor0.B_pm_fit2 "Bedingung SoC-Wert nicht plausibel" UBYTE Def_bit_ub_1 0 0 0.0 255.0 ECU_ADDRESS 0x007FCF74 /begin FUNCTION_LIST PMSOCKOR /end FUNCTION_LIST BIT_MASK 0x2 /end MEASUREMENT
/begin MEASUREMENT St_pmsockor0.B_pm_fit3 "Bedingung Hilfsvariable Fit 2" UBYTE Def_bit_ub_2 0 0 0.0 255.0 ECU_ADDRESS 0x007FCF74 /begin FUNCTION_LIST PMSOCKOR /end FUNCTION_LIST BIT_MASK 0x4 /end MEASUREMENT
/begin MEASUREMENT St_pmsockor0.B_pmsocini "Bedingung Startqualität vollständig berechnet" UBYTE Def_bit_ub_3 0 0 0.0 255.0 ECU_ADDRESS 0x007FCF74 /begin FUNCTION_LIST PMSOCKOR /end FUNCTION_LIST BIT_MASK 0x8 /end MEASUREMENT
/begin MEASUREMENT St_pmsockor0.B_q_start "wird beim INIT wahr um den Timer zurückzusetzen" UBYTE Def_bit_ub_4 0 0 0.0 255.0 ECU_ADDRESS 0x007FCF74 /begin FUNCTION_LIST PMSOCKOR /end FUNCTION_LIST BIT_MASK 0x10 /end MEASUREMENT
/begin MEASUREMENT St_pmsockor0.B_abschfit "Bedingung Korrektur Startfähigkeitsgrenze durchgeführt" UBYTE Def_bit_ub_5 0 0 0.0 255.0 ECU_ADDRESS 0x007FCF74 /begin FUNCTION_LIST PMSOCKOR /end FUNCTION_LIST BIT_MASK 0x20 /end MEASUREMENT
/begin MEASUREMENT St_pmsockor0 "Statuswort" UBYTE Def_st_ub_q1 0 0 0.0 255.0000 ECU_ADDRESS 0x007FCF74 /begin FUNCTION_LIST PMSOCKOR /end FUNCTION_LIST /end MEASUREMENT
/begin MEASUREMENT D_socw "Delta SoC" SWORD Def_f_sw_b100 0 0 -100.0000 99.9969 ECU_ADDRESS 0x008012C6 /begin FUNCTION_LIST PMSOCKOR /end FUNCTION_LIST /end MEASUREMENT
/begin MEASUREMENT T_saisonalt "letzter Wert Saisontemperatur" SWORD Def_t_sw_q0p1 0 0 -3276.8000 3276.7000 ECU_ADDRESS 0x008012C8 /begin FUNCTION_LIST PMSOCKOR /end FUNCTION_LIST /end MEASUREMENT
/begin MEASUREMENT Soc_stfgkw "SoC Startfähigkeit" UWORD Def_f_uw_b100 0 0 0.0 99.9984 ECU_ADDRESS 0x008012CA /begin FUNCTION_LIST PMSOCKOR /end FUNCTION_LIST /end MEASUREMENT
/begin MEASUREMENT Absch_korr "Korrekturwert Abschaltung" SWORD Def_f_sw_q0p00153 0 0 -40.0000 40.0000 ECU_ADDRESS 0x008012D2 /begin FUNCTION_LIST PMSOCKOR /end FUNCTION_LIST /end MEASUREMENT
/begin MEASUREMENT D_soc "Abstand zur Startfähigkeitsgrenze" SWORD Def_f_sw_b100 0 0 -100.0000 99.9969 ECU_ADDRESS 0x008012D4 /begin FUNCTION_LIST PMSOCKOR /end FUNCTION_LIST /end MEASUREMENT
/begin MEASUREMENT Soc_korr "Korrekturwert soc_bila" SWORD Def_f_sw_b100 0 0 -100.0000 99.9969 ECU_ADDRESS 0x008012D6 /begin FUNCTION_LIST PMSOCKOR /end FUNCTION_LIST /end MEASUREMENT
/begin MEASUREMENT T_saison "Saison -Temperatur" SWORD Def_t_sw_q0p1 0 0 -3276.8000 3276.7000 ECU_ADDRESS 0x008012D8 /begin FUNCTION_LIST PMSOCKOR /end FUNCTION_LIST /end MEASUREMENT
/begin MEASUREMENT Q_startfgk "Abstand zur Startfähigkeitsgrenze" UWORD Def_ql_uw_q0p0182 0 0 0.0 1193.0282 ECU_ADDRESS 0x008012DA /begin FUNCTION_LIST PMSOCKOR /end FUNCTION_LIST /end MEASUREMENT
/begin MEASUREMENT Soc_q_kor "Korrekturwert Genauigkeit Ladezustandsbestimmung" UWORD Def_ql_uw_q0p0182 0 0 0.0 1193.0282 ECU_ADDRESS 0x008012DC /begin FUNCTION_LIST PMSOCKOR /end FUNCTION_LIST /end MEASUREMENT
/begin MEASUREMENT Soc_rel "Relativzähler für Ladezustand SoC" UWORD Def_f_uw_b100 0 0 0.0 99.9984 ECU_ADDRESS 0x008012DE /begin FUNCTION_LIST PMSOCKOR /end FUNCTION_LIST /end MEASUREMENT
/begin MEASUREMENT Soc_stfgk "Startfähigkeitsgrenze" UWORD Def_f_uw_b100 0 0 0.0 99.9984 ECU_ADDRESS 0x008012E0 /begin FUNCTION_LIST PMSOCKOR /end FUNCTION_LIST /end MEASUREMENT
/begin MEASUREMENT Pm_tsrdy "Status Berechnung Tsaison" UBYTE Identity 0 0 0.0 1.0000 ECU_ADDRESS 0x008012E2 /begin FUNCTION_LIST PMSOCKOR /end FUNCTION_LIST /end MEASUREMENT
/begin MEASUREMENT St_pmsocstart0.B_pmstart7 "Bed. Motorstart für Startauswertung PM" UBYTE Def_bit_ub_0 0 0 0.0 255.0 ECU_ADDRESS 0x007FCF7A /begin FUNCTION_LIST PMSOCSTART /end FUNCTION_LIST BIT_MASK 0x1 /end MEASUREMENT
/begin MEASUREMENT St_pmsocstart0.B_resetsta "Bedingung Reset Startauswertung" UBYTE Def_bit_ub_1 0 0 0.0 255.0 ECU_ADDRESS 0x007FCF7A /begin FUNCTION_LIST PMSOCSTART /end FUNCTION_LIST BIT_MASK 0x2 /end MEASUREMENT
/begin MEASUREMENT St_pmsocstart0.B_rstdatardy "Motor aus erkannt, Startwerte im IBS bereit zum löschen." UBYTE Def_bit_ub_2 0 0 0.0 255.0 ECU_ADDRESS 0x007FCF7A /begin FUNCTION_LIST PMSOCSTART /end FUNCTION_LIST BIT_MASK 0x4 /end MEASUREMENT
/begin MEASUREMENT St_pmsocstart0 "Statuswort" UBYTE Def_st_ub_q1 0 0 0.0 255.0000 ECU_ADDRESS 0x007FCF7A /begin FUNCTION_LIST PMSOCSTART /end FUNCTION_LIST /end MEASUREMENT
/begin MEASUREMENT St_pmsocstart_nv0.B_pmstartq "Bedingung Startqualität" UBYTE Def_bit_ub_0 0 0 0.0 255.0 ECU_ADDRESS 0x008012F1 /begin FUNCTION_LIST PMSOCSTART /end FUNCTION_LIST BIT_MASK 0x1 /end MEASUREMENT
/begin MEASUREMENT St_pmsocstart_nv0.B_pmsqrdy "kt_ibs.dat" UBYTE Def_bit_ub_1 0 0 0.0 255.0 ECU_ADDRESS 0x008012F1 /begin FUNCTION_LIST PMSOCSTART /end FUNCTION_LIST BIT_MASK 0x2 /end MEASUREMENT
/begin MEASUREMENT St_pmsocstart_nv0 "Statuswort" UBYTE Def_st_ub_q1 0 0 0.0 255.0000 ECU_ADDRESS 0x008012F1 /begin FUNCTION_LIST PMSOCSTART /end FUNCTION_LIST /end MEASUREMENT
/begin MEASUREMENT Nnmstart "Motordrehzahl nach Motorstart" SWORD Def_n_sw_q1p0 0 0 -32768.0000 32767.0000 ECU_ADDRESS 0x008012E4 /begin FUNCTION_LIST PMSOCSTART /end FUNCTION_LIST /end MEASUREMENT
/begin MEASUREMENT U_startausw "U_tnstart - ugrenz" SWORD Def_u_sw_q0p00025 0 0 -8.1920 8.1917 ECU_ADDRESS 0x008012E6 /begin FUNCTION_LIST PMSOCSTART /end FUNCTION_LIST /end MEASUREMENT
/begin MEASUREMENT Ideltaabs "Differenz der Startströme" UWORD Def_i_uw_q0p02 0 0 0.0200 1310.7000 ECU_ADDRESS 0x008012E8 /begin FUNCTION_LIST PMSOCSTART /end FUNCTION_LIST /end MEASUREMENT
/begin MEASUREMENT U_grenz "Grenzwert Spannung" UWORD Def_u_uw_q0p25em3_o6 0 0 6.0000 22.3837 ECU_ADDRESS 0x008012EA /begin FUNCTION_LIST PMSOCSTART /end FUNCTION_LIST /end MEASUREMENT
/begin MEASUREMENT Ub_old "letzter Wert Batteriespannung" UWORD Def_u_uw_q0p0942 0 0 0.0 6173.3970 ECU_ADDRESS 0x008012EC /begin FUNCTION_LIST PMSOCSTART /end FUNCTION_LIST /end MEASUREMENT
/begin MEASUREMENT Pmstartsta "Schalter für Ablaufsteuerung" UBYTE Def_dez_ub_q1 0 0 0.0 255.0000 ECU_ADDRESS 0x008012EE /begin FUNCTION_LIST PMSOCSTART /end FUNCTION_LIST /end MEASUREMENT
/begin MEASUREMENT Rin_grenzh "Batt.Innenwiderstand Grenze" UBYTE Def_f_ub_b32 0 0 0.0 31.8750 ECU_ADDRESS 0x008012EF /begin FUNCTION_LIST PMSOCSTART /end FUNCTION_LIST /end MEASUREMENT
/begin MEASUREMENT Rin_start "Innenwiderstand Batterie beim Start" UBYTE Def_f_ub_b32 0 0 0.0 31.8750 ECU_ADDRESS 0x008012F0 /begin FUNCTION_LIST PMSOCSTART /end FUNCTION_LIST /end MEASUREMENT
/begin MEASUREMENT St_pmugencalc.B_genclcon "Wird auf true gesetzt wenn Motor und Generator bereits T_B_NMOT-Sekunden laufen." UBYTE Def_bit_ub_0 0 0 0.0 255.0 ECU_ADDRESS 0x007FCF88 /begin FUNCTION_LIST PMUGENCALC /end FUNCTION_LIST BIT_MASK 0x1 /end MEASUREMENT
/begin MEASUREMENT St_pmugencalc "Statuswort" UBYTE Def_st_ub_q1 0 0 0.0 255.0000 ECU_ADDRESS 0x007FCF88 /begin FUNCTION_LIST PMUGENCALC /end FUNCTION_LIST /end MEASUREMENT
/begin MEASUREMENT U_ibs "Generatorspannungsvorgabe von IBS" SWORD Def_u_sw_b128 0 0 -128.0000 127.9960 ECU_ADDRESS 0x008012F2 /begin FUNCTION_LIST PMUGENCALC /end FUNCTION_LIST /end MEASUREMENT
/begin MEASUREMENT U_igrdetec "U_gsoll - U_ibs für IGRLOW Detektierung" SWORD Def_u_sw_b128 0 0 -128.0000 127.9960 ECU_ADDRESS 0x008012F4 /begin FUNCTION_LIST PMUGENCALC /end FUNCTION_LIST /end MEASUREMENT
/begin MEASUREMENT Udelta "Delta zw. Battsollspg und Battspg" SWORD Def_u_sw_q0p00025 0 0 -8.1920 8.1917 ECU_ADDRESS 0x008012F6 /begin FUNCTION_LIST PMUGENCALC /end FUNCTION_LIST /end MEASUREMENT
/begin MEASUREMENT Udeltaabs "Absolutwert von udelta" SWORD Def_u_sw_q0p00025 0 0 0.0 8.1917 ECU_ADDRESS 0x008012F8 /begin FUNCTION_LIST PMUGENCALC /end FUNCTION_LIST /end MEASUREMENT
/begin MEASUREMENT Ubattsoll "Batteriesollspannung aufgrund Batterietemperatur und Batt.-ladezustand. Weitere Nutzung in PMPRSVCALC." UWORD Def_u_uw_q0p25em3_o6 0 0 6.0000 22.3837 ECU_ADDRESS 0x008012FA /begin FUNCTION_LIST PMUGENCALC /end FUNCTION_LIST /end MEASUREMENT
/begin MEASUREMENT Ubattsoll7 "lokales ubattsoll" UWORD Def_u_uw_q0p25em3_o6 0 0 6.0000 22.3837 ECU_ADDRESS 0x008012FC /begin FUNCTION_LIST PMUGENCALC /end FUNCTION_LIST /end MEASUREMENT
/begin MEASUREMENT T_bnmotakt "Zeit nachdem der Motor laeuft, hoert nach T_B_NMOT Sekunden auf." UBYTE Def_td_ub_q1 0 0 0.0 255.0000 ECU_ADDRESS 0x00801300 /begin FUNCTION_LIST PMUGENCALC /end FUNCTION_LIST /end MEASUREMENT
/begin MEASUREMENT T_delta "Zeit, die seit letzem Prozessaufruf verstrichen ist. Dient zur Taskkompatibilitaet." UBYTE Def_td_ub_q1 0 0 0.0 255.0000 ECU_ADDRESS 0x00801301 /begin FUNCTION_LIST PMUGENCALC /end FUNCTION_LIST /end MEASUREMENT
/begin MEASUREMENT Uibs7 "lokales uibs" SWORD Def_u_sw_b128 0 0 -128.0000 127.9960 ECU_ADDRESS 0x008012FE /begin FUNCTION_LIST PMUGENCALC /end FUNCTION_LIST /end MEASUREMENT
/begin MEASUREMENT St_ugenkor0.B_1stugen "Modulspezifische Bedingung für Schubabschalten" UBYTE Def_bit_ub_0 0 0 0.0 255.0 ECU_ADDRESS 0x007FD67C /begin FUNCTION_LIST UGENKOR /end FUNCTION_LIST BIT_MASK 0x1 /end MEASUREMENT
/begin MEASUREMENT St_ugenkor0.B_genoffout "Freigabe für modulspezifisches Schubabschalten" UBYTE Def_bit_ub_1 0 0 0.0 255.0 ECU_ADDRESS 0x007FD67C /begin FUNCTION_LIST UGENKOR /end FUNCTION_LIST BIT_MASK 0x2 /end MEASUREMENT
/begin MEASUREMENT St_ugenkor0.B_ugenini "Bedingung ctrgenutar noch nicht gueltig" UBYTE Def_bit_ub_2 0 0 0.0 255.0 ECU_ADDRESS 0x007FD67C /begin FUNCTION_LIST UGENKOR /end FUNCTION_LIST BIT_MASK 0x4 /end MEASUREMENT
/begin MEASUREMENT St_ugenkor0.B_genoff "Bedingung Abschaltung Generator" UBYTE Def_bit_ub_3 0 0 0.0 255.0 ECU_ADDRESS 0x007FD67C /begin FUNCTION_LIST UGENKOR /end FUNCTION_LIST BIT_MASK 0x8 /end MEASUREMENT
/begin MEASUREMENT St_ugenkor0.B_genoff2 "Initialisierung Generatorspannung" UBYTE Def_bit_ub_4 0 0 0.0 255.0 ECU_ADDRESS 0x007FD67C /begin FUNCTION_LIST UGENKOR /end FUNCTION_LIST BIT_MASK 0x10 /end MEASUREMENT
/begin MEASUREMENT St_ugenkor0.B_genoffok "Bedingung Generator ausgeschaltet" UBYTE Def_bit_ub_5 0 0 0.0 255.0 ECU_ADDRESS 0x007FD67C /begin FUNCTION_LIST UGENKOR /end FUNCTION_LIST BIT_MASK 0x20 /end MEASUREMENT
/begin MEASUREMENT St_ugenkor0.B_noctrgen "Bedingung Generator2 ausgeschaltet" UBYTE Def_bit_ub_6 0 0 0.0 255.0 ECU_ADDRESS 0x007FD67C /begin FUNCTION_LIST UGENKOR /end FUNCTION_LIST BIT_MASK 0x40 /end MEASUREMENT
/begin MEASUREMENT St_ugenkor0.B_verb_off "Bedingung Generatorabschaltfreigabe Sicherheitstimer" UBYTE Def_bit_ub_7 0 0 0.0 255.0 ECU_ADDRESS 0x007FD67C /begin FUNCTION_LIST UGENKOR /end FUNCTION_LIST BIT_MASK 0x80 /end MEASUREMENT
/begin MEASUREMENT St_ugenkor0 "Statuswort" UBYTE Def_st_ub_q1 0 0 0.0 255.0000 ECU_ADDRESS 0x007FD67C /begin FUNCTION_LIST UGENKOR /end FUNCTION_LIST /end MEASUREMENT
/begin MEASUREMENT St_ugenkor2.B_saaktiv "Bedingung elektr. Verbraucher AUS" UBYTE Def_bit_ub_0 0 0 0.0 255.0 ECU_ADDRESS 0x0080131C /begin FUNCTION_LIST UGENKOR /end FUNCTION_LIST BIT_MASK 0x1 /end MEASUREMENT
/begin MEASUREMENT St_ugenkor2.B_saset "Bedindung Toggel Generatorauswahl" UBYTE Def_bit_ub_1 0 0 0.0 255.0 ECU_ADDRESS 0x0080131C /begin FUNCTION_LIST UGENKOR /end FUNCTION_LIST BIT_MASK 0x2 /end MEASUREMENT
/begin MEASUREMENT St_ugenkor2 "Statuswort" UBYTE Def_st_ub_q1 0 0 0.0 255.0000 ECU_ADDRESS 0x0080131C /begin FUNCTION_LIST UGENKOR /end FUNCTION_LIST /end MEASUREMENT
/begin MEASUREMENT St_ugenkor1.B_gentoggl "Bedingung Ladespannungvorgabe ignoriert" UBYTE Def_bit_ub_0 0 0 0.0 255.0 ECU_ADDRESS 0x0080131D /begin FUNCTION_LIST UGENKOR /end FUNCTION_LIST BIT_MASK 0x1 /end MEASUREMENT
/begin MEASUREMENT St_ugenkor1 "Statuswort" UBYTE Def_st_ub_q1 0 0 0.0 255.0000 ECU_ADDRESS 0x0080131D /begin FUNCTION_LIST UGENKOR /end FUNCTION_LIST /end MEASUREMENT
/begin MEASUREMENT T_batt "Batterietemperatur" SWORD Def_t_sw_q0p1 0 0 -3276.8000 3276.7000 ECU_ADDRESS 0x007FD678 /begin FUNCTION_LIST UGENKOR /end FUNCTION_LIST /end MEASUREMENT
/begin MEASUREMENT U_gen "Sollwert Generatorspannung" UWORD Def_u_uw_q0p1 0 0 0.0 6553.5000 ECU_ADDRESS 0x00801308 /begin FUNCTION_LIST UGENKOR /end FUNCTION_LIST /end MEASUREMENT
/begin MEASUREMENT U_gen2 "Generatosspannungssollwert für Generator2" UWORD Def_u_uw_q0p1 0 0 0.0 16.0000 ECU_ADDRESS 0x0080130A /begin FUNCTION_LIST UGENKOR /end FUNCTION_LIST /end MEASUREMENT
/begin MEASUREMENT U_gsoll "Generatorsollspannung Basis" UWORD Def_u_uw_q0p1 0 0 0.0 6553.5000 ECU_ADDRESS 0x0080130C /begin FUNCTION_LIST UGENKOR /end FUNCTION_LIST /end MEASUREMENT
/begin MEASUREMENT U_gsoll_off "Generatorsollspannung Basis" UWORD Def_u_uw_q0p1 0 0 0.0 6553.5000 ECU_ADDRESS 0x0080130E /begin FUNCTION_LIST UGENKOR /end FUNCTION_LIST /end MEASUREMENT
/begin MEASUREMENT U_gsoll_tp "Generatorsollspannung Basis" UWORD Def_u_uw_q0p1 0 0 0.0 6553.5000 ECU_ADDRESS 0x00801310 /begin FUNCTION_LIST UGENKOR /end FUNCTION_LIST /end MEASUREMENT
/begin MEASUREMENT Pmigrlowctr "" UWORD Def_dez_uw_q1 0 0 0.0 65535.0000 ECU_ADDRESS 0x00801312 /begin FUNCTION_LIST UGENKOR /end FUNCTION_LIST /end MEASUREMENT
/begin MEASUREMENT U_gen_igr "" UWORD Def_u_uw_q0p1 0 0 0.0 6553.5000 ECU_ADDRESS 0x00801314 /begin FUNCTION_LIST UGENKOR /end FUNCTION_LIST /end MEASUREMENT
/begin MEASUREMENT U_gsoll_tp2 "Generatorsollspannung Basis" UWORD Def_u_uw_q0p1 0 0 0.0 6553.5000 ECU_ADDRESS 0x00801316 /begin FUNCTION_LIST UGENKOR /end FUNCTION_LIST /end MEASUREMENT
/begin MEASUREMENT U_gsollred "reduzierte Generatorsollspannung" UWORD Def_u_uw_q0p1 0 0 0.0 6553.5000 ECU_ADDRESS 0x00801318 /begin FUNCTION_LIST UGENKOR /end FUNCTION_LIST /end MEASUREMENT
/begin MEASUREMENT U_gsolltmp "reduzierte Zwischengeneratorsollspannung" UWORD Def_u_uw_q0p1 0 0 0.0 6553.5000 ECU_ADDRESS 0x007FD67A /begin FUNCTION_LIST UGENKOR /end FUNCTION_LIST /end MEASUREMENT
/begin FUNCTION KT_IBS "KT_IBS" /end FUNCTION
/begin FUNCTION LAYER "LAYER" /end FUNCTION
/begin FUNCTION LBATTCAL "LBATTCAL" /end FUNCTION
/begin FUNCTION LDSTGEN "LDSTGEN" /end FUNCTION
/begin FUNCTION LLPMCTRL "LLPMCTRL" /end FUNCTION
/begin FUNCTION LLRANH "LLRANH" /end FUNCTION
/begin FUNCTION LOADRESP "LOADRESP" /end FUNCTION
/begin FUNCTION MANDETEK "MANDETEK" /end FUNCTION
/begin FUNCTION OZBG "OZBG" /end FUNCTION
/begin FUNCTION OZGG "OZGG" /end FUNCTION
/begin FUNCTION OZLEIT "OZLEIT" /end FUNCTION
/begin FUNCTION OZNIVDL "OZNIVDL" /end FUNCTION
/begin FUNCTION OZPERM "OZPERM" /end FUNCTION
/begin FUNCTION OZRESTKM "OZRESTKM" /end FUNCTION
/begin FUNCTION OZTEMP "OZTEMP" /end FUNCTION
/begin FUNCTION PMBNSTAB "PMBNSTAB" /end FUNCTION
/begin FUNCTION PMDIAG "PMDIAG" /end FUNCTION
/begin FUNCTION PMPRSVCALC "PMPRSVCALC" /end FUNCTION
/begin FUNCTION PMSOCCALC "PMSOCCALC" /end FUNCTION
/begin FUNCTION PMSOCFIT "PMSOCFIT" /end FUNCTION
/begin FUNCTION PMSOCKOR "PMSOCKOR" /end FUNCTION
/begin FUNCTION PMSOCSTART "PMSOCSTART" /end FUNCTION
/begin FUNCTION PMUGENCALC "PMUGENCALC" /end FUNCTION
/begin FUNCTION UGENKOR "UGENKOR" /end FUNCTION
/begin COMPU_METHOD Def_f_uw_b512 "Def_f_uw_b512" RAT_FUNC "%8.3" "-" COEFFS 0 65536 0 0 0 512 /end COMPU_METHOD
/begin COMPU_METHOD Def_t_sw_q0p1 "Def_t_sw_q0p1" RAT_FUNC "%6.1" "°C" COEFFS 0 10 0 0 0 1 /end COMPU_METHOD
/begin COMPU_METHOD Def_u_uw_q0p0942 "Def_u_uw_q0p0942" RAT_FUNC "%6.1" "V" COEFFS 0 1 0 0 0 0.0942 /end COMPU_METHOD
/begin COMPU_METHOD Def_v_uw_q1p0 "Def_v_uw_q1p0" RAT_FUNC "%5.0" "km/h" COEFFS 0 1 0 0 0 1 /end COMPU_METHOD
/begin COMPU_METHOD Def_tv_ub_q0p390625 "Def_tv_ub_q0p390625" RAT_FUNC "%5.2" "%" COEFFS 0 256 0 0 0 100 /end COMPU_METHOD
/begin COMPU_METHOD Def_bit_ub_0 "Def_bit_ub_0" TAB_VERB "%5.2" "-" COMPU_TAB_REF Def_bit_ub_0_VTAB /end COMPU_METHOD
/begin COMPU_METHOD Def_st_ub_q1 "Def_st_ub_q1" RAT_FUNC "%3.0" "-" COEFFS 0 1 0 0 0 1 /end COMPU_METHOD
/begin COMPU_METHOD Def_n_sw_q1p0 "Def_n_sw_q1p0" RAT_FUNC "%5.0" "Upm" COEFFS 0 1 0 0 0 1 /end COMPU_METHOD
/begin COMPU_METHOD Def_f_ub_b100 "Def_f_ub_b100" RAT_FUNC "%5.2" "%" COEFFS 0 256 0 0 0 100 /end COMPU_METHOD
/begin COMPU_METHOD Def_i_ub_q1 "Def_i_ub_q1" RAT_FUNC "%6.3" "" COEFFS 0 1 0 0 0 1 /end COMPU_METHOD
/begin COMPU_METHOD Def_td_ub_q0p1 "Def_td_ub_q0p1" RAT_FUNC "%4.1" "s" COEFFS 0 10 0 0 0 1 /end COMPU_METHOD
/begin COMPU_METHOD Def_bit_ub_1 "Def_bit_ub_1" TAB_VERB "%5.2" "-" COMPU_TAB_REF Def_bit_ub_1_VTAB /end COMPU_METHOD
/begin COMPU_METHOD Def_bit_ub_2 "Def_bit_ub_2" TAB_VERB "%5.2" "-" COMPU_TAB_REF Def_bit_ub_2_VTAB /end COMPU_METHOD
/begin COMPU_METHOD Def_bit_ub_3 "Def_bit_ub_3" TAB_VERB "%5.2" "-" COMPU_TAB_REF Def_bit_ub_3_VTAB /end COMPU_METHOD
/begin COMPU_METHOD Def_bit_ub_4 "Def_bit_ub_4" TAB_VERB "%5.2" "-" COMPU_TAB_REF Def_bit_ub_4_VTAB /end COMPU_METHOD
/begin COMPU_METHOD Def_bit_ub_5 "Def_bit_ub_5" TAB_VERB "%5.2" "-" COMPU_TAB_REF Def_bit_ub_5_VTAB /end COMPU_METHOD
/begin COMPU_METHOD Def_bit_ub_6 "Def_bit_ub_6" TAB_VERB "%5.2" "-" COMPU_TAB_REF Def_bit_ub_6_VTAB /end COMPU_METHOD
/begin COMPU_METHOD Def_bit_ub_7 "Def_bit_ub_7" TAB_VERB "%5.2" "-" COMPU_TAB_REF Def_bit_ub_7_VTAB /end COMPU_METHOD
/begin COMPU_METHOD Def_st_uw_q1 "Def_st_uw_q1" RAT_FUNC "%5.0" "-" COEFFS 0 1 0 0 0 1 /end COMPU_METHOD
/begin COMPU_METHOD Def_dez_uw_q1 "Def_dez_uw_q1" RAT_FUNC "%5.0" "-" COEFFS 0 1 0 0 0 1 /end COMPU_METHOD
/begin COMPU_METHOD Def_dez_ub_q1 "Def_dez_ub_q1" RAT_FUNC "%3.0" "-" COEFFS 0 1 0 0 0 1 /end COMPU_METHOD
/begin COMPU_METHOD Identity "Identity" RAT_FUNC "%4.1" "-" COEFFS 0 1 0 0 0 1 /end COMPU_METHOD
/begin COMPU_METHOD Def_dez_ul_q1 "Def_dez_ul_q1" RAT_FUNC "%7.0" "-" COEFFS 0 1 0 0 0 1 /end COMPU_METHOD
/begin COMPU_METHOD Def_m_sw_q0p1 "Def_m_sw_q0p1" RAT_FUNC "%7.2" "Nm" COEFFS 0 10 0 0 0 1 /end COMPU_METHOD
/begin COMPU_METHOD Def_f_uw_b100 "Def_f_uw_b100" RAT_FUNC "%8.3" "%" COEFFS 0 65536 0 0 0 100 /end COMPU_METHOD
/begin COMPU_METHOD Def_i_ub_q0p125 "Def_i_ub_q0p125" RAT_FUNC "%6.3" "A" COEFFS 0 8 0 0 0 1 /end COMPU_METHOD
/begin COMPU_METHOD Def_u_uw_q0p1 "Def_u_uw_q0p1" RAT_FUNC "%8.3" "V" COEFFS 0 10 0 0 0 1 /end COMPU_METHOD
/begin COMPU_METHOD Def_f_uw_b1 "Def_f_uw_b1" RAT_FUNC "%14.5" "-" COEFFS 0 65536 0 0 0 1 /end COMPU_METHOD
/begin COMPU_METHOD Def_f_uw_b32 "Def_f_uw_b32" RAT_FUNC "%9.4" "-" COEFFS 0 65536 0 0 0 32 /end COMPU_METHOD
/begin COMPU_METHOD Def_td_ub_q1 "Def_td_ub_q1" RAT_FUNC "%5.2" "s" COEFFS 0 1 0 0 0 1 /end COMPU_METHOD
/begin COMPU_METHOD Def_f_ub_b2 "Def_f_ub_b2" RAT_FUNC "%6.3" "-" COEFFS 0 256 0 0 0 2 /end COMPU_METHOD
/begin COMPU_METHOD Def_f_uw_b2 "Def_f_uw_b2" RAT_FUNC "%14.5" "-" COEFFS 0 65536 0 0 0 2 /end COMPU_METHOD
/begin COMPU_METHOD Def_f_uw_b64 "Def_f_uw_b64" RAT_FUNC "%9.4" "-" COEFFS 0 65536 0 0 0 64 /end COMPU_METHOD
/begin COMPU_METHOD Def_i_uw_q0p08_o200 "Def_i_uw_q0p08_o200" RAT_FUNC "%8.3" "" COEFFS 0 25 5000 0 0 2 /end COMPU_METHOD
/begin COMPU_METHOD Def_u_uw_q0p25em3_o6 "Def_u_uw_q0p25em3_o6" RAT_FUNC "%9.4" "" COEFFS 0 -4000 24000 0 0 -1 /end COMPU_METHOD
/begin COMPU_METHOD Def_ql_uw_q0p0182 "Def_ql_uw_q0p0182" RAT_FUNC "%8.3" "Ah" COEFFS 0 989 0 0 0 18 /end COMPU_METHOD
/begin COMPU_METHOD Def_i_sw_q0p02 "Def_i_sw_q0p02" RAT_FUNC "%8.3" "A" COEFFS 0 50 0 0 0 1 /end COMPU_METHOD
/begin COMPU_METHOD Def_i_uw_q0p02_o200 "Def_i_uw_q0p02_o200" RAT_FUNC "%7.2" "A" COEFFS 0 50 10000 0 0 1 /end COMPU_METHOD
/begin COMPU_METHOD Def_i_uw_q0p02 "Def_i_uw_q0p02" RAT_FUNC "%8.3" "A" COEFFS 0 1 0 0 0 0.02 /end COMPU_METHOD
/begin COMPU_METHOD Def_ac_sb_q0p25 "Def_ac_sb_q0p25" RAT_FUNC "%4.1" "-" COEFFS 0 4 0 0 0 1 /end COMPU_METHOD
/begin COMPU_METHOD Def_km_sw_q10 "Def_km_sw_q10" RAT_FUNC "%6.1" "km" COEFFS 0 1 0 0 0 10 /end COMPU_METHOD
/begin COMPU_METHOD Def_km_ub_q1000 "Def_km_ub_q1000" RAT_FUNC "%3.0" "km" COEFFS 0 1 0 0 0 1000 /end COMPU_METHOD
/begin COMPU_METHOD Def_dm_sw_q0p1 "Def_dm_sw_q0p1" RAT_FUNC "%7.2" "Nm/s" COEFFS 0 10 0 0 0 1 /end COMPU_METHOD
/begin COMPU_METHOD Def_i_sw_q0039 "Def_i_sw_q0039" RAT_FUNC "%8.3" "mA" COEFFS 0 256 0 0 0 1 /end COMPU_METHOD
/begin COMPU_METHOD Def_km_uw_q10 "Def_km_uw_q10" RAT_FUNC "%5.0" "km" COEFFS 0 1 0 0 0 10 /end COMPU_METHOD
/begin COMPU_METHOD Def_f_uw_b16 "Def_f_uw_b16" RAT_FUNC "%9.4" "-" COEFFS 0 65536 0 0 0 16 /end COMPU_METHOD
/begin COMPU_METHOD Def_me_sw_q0p01 "Def_me_sw_q0p01" RAT_FUNC "%8.3" "mg/cyc" COEFFS 0 100 0 0 0 1 /end COMPU_METHOD
/begin COMPU_METHOD Def_ml_sw_q0p1 "Def_ml_sw_q0p1" RAT_FUNC "%7.2" "mg/Hub" COEFFS 0 10 0 0 0 1 /end COMPU_METHOD
/begin COMPU_METHOD Def_lm_uw_q0p000444 "Def_lm_uw_q0p000444" RAT_FUNC "%9.4" "kg" COEFFS 0 2250 0 0 0 1 /end COMPU_METHOD
/begin COMPU_METHOD Def_p_uw_q0p039 "Def_p_uw_q0p039" RAT_FUNC "%7.2" "hPa" COEFFS 0 256 0 0 0 10 /end COMPU_METHOD
/begin COMPU_METHOD Def_p_sw_q1 "Def_p_sw_q1" RAT_FUNC "%6.1" "hPa" COEFFS 0 1 0 0 0 1 /end COMPU_METHOD
/begin COMPU_METHOD Def_rf_sw_q0p01 "Def_rf_sw_q0p01" RAT_FUNC "%9.4" "%" COEFFS 0 100 0 0 0 1 /end COMPU_METHOD
/begin COMPU_METHOD Def_f_ub_b127p5 "Def_f_ub_b127p5" RAT_FUNC "%5.2" "%" COEFFS 0 2 0 0 0 1 /end COMPU_METHOD
/begin COMPU_METHOD Def_td_uw_q0p01 "Def_td_uw_q0p01" RAT_FUNC "%7.2" "s" COEFFS 0 100 0 0 0 1 /end COMPU_METHOD
/begin COMPU_METHOD Def_td_uw_q0p1 "Def_td_uw_q0p1" RAT_FUNC "%6.1" "s" COEFFS 0 10 0 0 0 1 /end COMPU_METHOD
/begin COMPU_METHOD Def_t_sw_q0p01 "Def_t_sw_q0p01" RAT_FUNC "%7.2" "°C" COEFFS 0 100 0 0 0 1 /end COMPU_METHOD
/begin COMPU_METHOD Def_tv_sw_q0p01 "Def_tv_sw_q0p01" RAT_FUNC "%8.3" "%" COEFFS 0 100 0 0 0 1 /end COMPU_METHOD
/begin COMPU_METHOD Def_u_sw_b128 "Def_u_sw_b128" RAT_FUNC "%8.3" "V" COEFFS 0 256 0 0 0 1 /end COMPU_METHOD
/begin COMPU_METHOD Def_u_ub_q0p0942 "Def_u_ub_q0p0942" RAT_FUNC "%7.4" "V" COEFFS 0 1 0 0 0 0.0942 /end COMPU_METHOD
/begin COMPU_METHOD Def_tv_sw_q0p0244 "Def_tv_sw_q0p0244" RAT_FUNC "%7.2" "%" COEFFS 0 4096 0 0 0 100 /end COMPU_METHOD
/begin COMPU_METHOD Def_bit_uw_0 "Def_bit_uw_0" TAB_VERB "%7.2" "-" COMPU_TAB_REF Def_bit_uw_0_VTAB /end COMPU_METHOD
/begin COMPU_METHOD Def_bit_uw_3 "Def_bit_uw_3" TAB_VERB "%7.2" "-" COMPU_TAB_REF Def_bit_uw_3_VTAB /end COMPU_METHOD
/begin COMPU_METHOD Def_bit_uw_5 "Def_bit_uw_5" TAB_VERB "%7.2" "-" COMPU_TAB_REF Def_bit_uw_5_VTAB /end COMPU_METHOD
/begin COMPU_METHOD Def_i_ub_q10 "Def_i_ub_q10" RAT_FUNC "%5.2" "A" COEFFS 0 1 0 0 0 10 /end COMPU_METHOD
/begin COMPU_METHOD Def_i_ub_q0p001 "Def_i_ub_q0p001" RAT_FUNC "%6.3" "A" COEFFS 0 1000 0 0 0 1 /end COMPU_METHOD
/begin COMPU_METHOD Def_lf_ub_q0p01 "Def_lf_ub_q0p01" RAT_FUNC "%5.2" "-" COEFFS 0 100 0 0 0 1 /end COMPU_METHOD
/begin COMPU_METHOD Def_tn_uw_q1 "Def_tn_uw_q1" RAT_FUNC "%7.2" "min" COEFFS 0 1 0 0 0 1 /end COMPU_METHOD
/begin COMPU_METHOD Def_f_ub_b32 "Def_f_ub_b32" RAT_FUNC "%5.2" "-" COEFFS 0 256 0 0 0 32 /end COMPU_METHOD
/begin COMPU_METHOD Def_f_r32 "Def_f_r32" RAT_FUNC "%14.7" "-" COEFFS 0 1 0 0 0 1 /end COMPU_METHOD
/begin COMPU_METHOD Def_f_sw_b100 "Def_f_sw_b100" RAT_FUNC "%8.3" "-" COEFFS 0 32768 0 0 0 100 /end COMPU_METHOD
/begin COMPU_METHOD Def_bit_uw_1 "Def_bit_uw_1" TAB_VERB "%7.2" "-" COMPU_TAB_REF Def_bit_uw_1_VTAB /end COMPU_METHOD
/begin COMPU_METHOD Def_bit_uw_2 "Def_bit_uw_2" TAB_VERB "%7.2" "-" COMPU_TAB_REF Def_bit_uw_2_VTAB /end COMPU_METHOD
/begin COMPU_METHOD Def_bit_uw_4 "Def_bit_uw_4" TAB_VERB "%7.2" "-" COMPU_TAB_REF Def_bit_uw_4_VTAB /end COMPU_METHOD
/begin COMPU_METHOD Def_bit_uw_6 "Def_bit_uw_6" TAB_VERB "%7.2" "-" COMPU_TAB_REF Def_bit_uw_6_VTAB /end COMPU_METHOD
/begin COMPU_METHOD Def_bit_uw_7 "Def_bit_uw_7" TAB_VERB "%7.2" "-" COMPU_TAB_REF Def_bit_uw_7_VTAB /end COMPU_METHOD
/begin COMPU_METHOD Def_f_uw_b4 "Def_f_uw_b4" RAT_FUNC "%14.5" "-" COEFFS 0 65536 0 0 0 4 /end COMPU_METHOD
/begin COMPU_METHOD Def_f_ul_b262144 "Def_f_ul_b262144" RAT_FUNC "%14.5" "" COEFFS 0 16384 0 0 0 1 /end COMPU_METHOD
/begin COMPU_METHOD Def_dez_sw_q1 "Def_dez_sw_q1" RAT_FUNC "%5.0" "-" COEFFS 0 1 0 0 0 1 /end COMPU_METHOD
/begin COMPU_METHOD Def_niv_ub_b75 "Def_niv_ub_b75" RAT_FUNC "%5.2" "" COEFFS 0 256 0 0 0 75 /end COMPU_METHOD
/begin COMPU_METHOD Def_perm_uw_b6 "Def_perm_uw_b6" RAT_FUNC "%14.5" "-" COEFFS 0 65536 0 0 0 6 /end COMPU_METHOD
/begin COMPU_METHOD Def_dez_sb_q1 "Def_dez_sb_q1" RAT_FUNC "%3.0" "-" COEFFS 0 1 0 0 0 1 /end COMPU_METHOD
/begin COMPU_METHOD Def_niv_ub_b8 "Def_niv_ub_b8" RAT_FUNC "%5.2" "" COEFFS 0 256 0 0 0 8 /end COMPU_METHOD
/begin COMPU_METHOD Def_f_sw_b8 "Def_f_sw_b8" RAT_FUNC "%9.4" "-" COEFFS 0 32768 0 0 0 8 /end COMPU_METHOD
/begin COMPU_METHOD Def_f_sw_b64 "Def_f_sw_b64" RAT_FUNC "%8.3" "-" COEFFS 0 65536 0 0 0 128 /end COMPU_METHOD
/begin COMPU_METHOD Def_f_uw_b10 "Def_f_uw_b10" RAT_FUNC "%9.4" "%" COEFFS 0 65536 0 0 0 10 /end COMPU_METHOD
/begin COMPU_METHOD Def_niv_uw_q0p1 "Def_niv_uw_q0p1" RAT_FUNC "%6.1" "l" COEFFS 0 10 0 0 0 1 /end COMPU_METHOD
/begin COMPU_METHOD Def_td_ub_q0p5 "Def_td_ub_q0p5" RAT_FUNC "%6.3" "s" COEFFS 0 2 0 0 0 1 /end COMPU_METHOD
/begin COMPU_METHOD Def_f_sw_b32 "Def_f_sw_b32" RAT_FUNC "%9.4" "-" COEFFS 0 32768 0 0 0 32 /end COMPU_METHOD
/begin COMPU_METHOD Def_perm_sw_b6 "Def_perm_sw_b6" RAT_FUNC "%9.4" "-" COEFFS 0 65536 0 0 0 12 /end COMPU_METHOD
/begin COMPU_METHOD Def_td_uw_q1 "Def_td_uw_q1" RAT_FUNC "%5.0" "s" COEFFS 0 1 0 0 0 1 /end COMPU_METHOD
/begin COMPU_METHOD Def_fuel_ul_q0p000122 "Def_fuel_ul_q0p000122" RAT_FUNC "%11.4" "" COEFFS 0 8192 0 0 0 1 /end COMPU_METHOD
/begin COMPU_METHOD Def_ql_uw_q0p29127 "Def_ql_uw_q0p29127" RAT_FUNC "%7.2" "" COEFFS 0 103 0 0 0 30 /end COMPU_METHOD
/begin COMPU_METHOD Def_td_uw_q56 "Def_td_uw_q56" RAT_FUNC "%7.2" "s" COEFFS 0 1 0 0 0 56 /end COMPU_METHOD
/begin COMPU_METHOD Def_td_uw_q0p933 "Def_td_uw_q0p933" RAT_FUNC "%7.2" "min" COEFFS 0 15 0 0 0 14 /end COMPU_METHOD
/begin COMPU_METHOD Def_td_uw_q14 "Def_td_uw_q14" RAT_FUNC "%7.2" "s" COEFFS 0 1 0 0 0 14 /end COMPU_METHOD
/begin COMPU_METHOD Def_ql_ub_q1 "Def_ql_ub_q1" RAT_FUNC "%4.1" "" COEFFS 0 1 0 0 0 1 /end COMPU_METHOD
/begin COMPU_METHOD Def_i_ub_q0p00125 "Def_i_ub_q0p00125" RAT_FUNC "%6.3" "" COEFFS 0 800 0 0 0 1 /end COMPU_METHOD
/begin COMPU_METHOD Def_td_ub_q14p9333 "Def_td_ub_q14p9333" RAT_FUNC "%5.2" "min" COEFFS 0 15 0 0 0 224 /end COMPU_METHOD
/begin COMPU_METHOD Def_f_sw_q0p00153 "Def_f_sw_q0p00153" RAT_FUNC "%8.3" "-" COEFFS 0 32768 0 0 0 50 /end COMPU_METHOD
/begin COMPU_METHOD Def_u_sw_q0p00025 "Def_u_sw_q0p00025" RAT_FUNC "%9.4" "" COEFFS 0 4000 0 0 0 1 /end COMPU_METHOD
/begin COMPU_METHOD Def_f_sl_q0p007 "Def_f_sl_q0p007" RAT_FUNC "%10.3" "" COEFFS 0 65536 0 0 0 512 /end COMPU_METHOD
/begin COMPU_METHOD Def_f_sw_p0q25 "Def_f_sw_p0q25" RAT_FUNC "%7.2" "" COEFFS 0 4 0 0 0 1 /end COMPU_METHOD
/begin COMPU_METHOD Def_f_sw_q0p000147 "Def_f_sw_q0p000147" RAT_FUNC "%9.4" "-" COEFFS 0 64 0 0 0 0.0942 /end COMPU_METHOD
/begin COMPU_METHOD Def_f_uw_q0p25 "Def_f_uw_q0p25" RAT_FUNC "%8.3" "" COEFFS 0 4 0 0 0 1 /end COMPU_METHOD
/begin COMPU_METHOD Def_u_uw_q0p015 "Def_u_uw_q0p015" RAT_FUNC "%8.3" "V" COEFFS 0 200 0 0 0 3 /end COMPU_METHOD
/begin COMPU_METHOD Def_u_sb_q0p0942 "Def_u_sb_q0p0942" RAT_FUNC "%7.4" "V" COEFFS 0 1 0 0 0 0.0942 /end COMPU_METHOD
/begin COMPU_METHOD Def_ql_ul_q2p7Em7 "Def_ql_ul_q2p7Em7" RAT_FUNC "%11.4" "Ah" COEFFS 0 3600000 0 0 0 1 /end COMPU_METHOD
/begin COMPU_VTAB Def_bit_ub_0_VTAB "Def_bit_ub_0_VTAB" TAB_VERB 2 0 "FALSE" 1 "TRUE" /end COMPU_VTAB
/begin COMPU_VTAB Def_bit_ub_1_VTAB "Def_bit_ub_1_VTAB" TAB_VERB 2 0 "FALSE" 1 "TRUE" /end COMPU_VTAB
/begin COMPU_VTAB Def_bit_ub_2_VTAB "Def_bit_ub_2_VTAB" TAB_VERB 2 0 "FALSE" 1 "TRUE" /end COMPU_VTAB
/begin COMPU_VTAB Def_bit_ub_3_VTAB "Def_bit_ub_3_VTAB" TAB_VERB 2 0 "FALSE" 1 "TRUE" /end COMPU_VTAB
/begin COMPU_VTAB Def_bit_ub_4_VTAB "Def_bit_ub_4_VTAB" TAB_VERB 2 0 "FALSE" 1 "TRUE" /end COMPU_VTAB
/begin COMPU_VTAB Def_bit_ub_5_VTAB "Def_bit_ub_5_VTAB" TAB_VERB 2 0 "FALSE" 1 "TRUE" /end COMPU_VTAB
/begin COMPU_VTAB Def_bit_ub_6_VTAB "Def_bit_ub_6_VTAB" TAB_VERB 2 0 "FALSE" 1 "TRUE" /end COMPU_VTAB
/begin COMPU_VTAB Def_bit_ub_7_VTAB "Def_bit_ub_7_VTAB" TAB_VERB 2 0 "FALSE" 1 "TRUE" /end COMPU_VTAB
/begin COMPU_VTAB Def_bit_uw_0_VTAB "Def_bit_uw_0_VTAB" TAB_VERB 2 0 "FALSE" 1 "TRUE" /end COMPU_VTAB
/begin COMPU_VTAB Def_bit_uw_3_VTAB "Def_bit_uw_3_VTAB" TAB_VERB 2 0 "FALSE" 1 "TRUE" /end COMPU_VTAB
/begin COMPU_VTAB Def_bit_uw_5_VTAB "Def_bit_uw_5_VTAB" TAB_VERB 2 0 "FALSE" 1 "TRUE" /end COMPU_VTAB
/begin COMPU_VTAB Def_bit_uw_1_VTAB "Def_bit_uw_1_VTAB" TAB_VERB 2 0 "FALSE" 1 "TRUE" /end COMPU_VTAB
/begin COMPU_VTAB Def_bit_uw_2_VTAB "Def_bit_uw_2_VTAB" TAB_VERB 2 0 "FALSE" 1 "TRUE" /end COMPU_VTAB
/begin COMPU_VTAB Def_bit_uw_4_VTAB "Def_bit_uw_4_VTAB" TAB_VERB 2 0 "FALSE" 1 "TRUE" /end COMPU_VTAB
/begin COMPU_VTAB Def_bit_uw_6_VTAB "Def_bit_uw_6_VTAB" TAB_VERB 2 0 "FALSE" 1 "TRUE" /end COMPU_VTAB
/begin COMPU_VTAB Def_bit_uw_7_VTAB "Def_bit_uw_7_VTAB" TAB_VERB 2 0 "FALSE" 1 "TRUE" /end COMPU_VTAB
/begin RECORD_LAYOUT TKL_UB_VV_SW NO_AXIS_PTS_X 1 UBYTE RESERVED 2 BYTE AXIS_PTS_X 3 UBYTE INDEX_INCR DIRECT FNC_VALUES 4 SWORD COLUMN_DIR DIRECT /end RECORD_LAYOUT
/begin RECORD_LAYOUT TKF_SW_UW_UW NO_AXIS_PTS_X 1 UBYTE NO_AXIS_PTS_Y 2 UBYTE AXIS_PTS_X 3 UWORD INDEX_INCR DIRECT AXIS_PTS_Y 4 SWORD INDEX_INCR DIRECT FNC_VALUES 5 UWORD COLUMN_DIR DIRECT /end RECORD_LAYOUT
/begin RECORD_LAYOUT TKL_UB_VV_UW NO_AXIS_PTS_X 1 UBYTE RESERVED 2 BYTE AXIS_PTS_X 3 UBYTE INDEX_INCR DIRECT FNC_VALUES 4 UWORD COLUMN_DIR DIRECT /end RECORD_LAYOUT
/begin RECORD_LAYOUT TKF_UW_SW_UW NO_AXIS_PTS_X 1 UBYTE NO_AXIS_PTS_Y 2 UBYTE AXIS_PTS_X 3 SWORD INDEX_INCR DIRECT AXIS_PTS_Y 4 UWORD INDEX_INCR DIRECT FNC_VALUES 5 UWORD COLUMN_DIR DIRECT /end RECORD_LAYOUT
/end MODULE
/end PROJECT
