ASAP2_VERSION 1 41
/begin PROJECT MSD70 "Spray Guided DI-System with Piezo Injectors for 6-Cylinder"
/begin HEADER "_default_HeaderComment" PROJECT_NO _0B /end HEADER
/begin MODULE _default_ModuleName "_default_ModuleLongIdentifier"
/begin MOD_COMMON "_default_ModCommonComment" DEPOSIT ABSOLUTE BYTE_ORDER MSB_LAST ALIGNMENT_BYTE 1 ALIGNMENT_WORD 2 ALIGNMENT_LONG 2 ALIGNMENT_FLOAT32_IEEE 2 ALIGNMENT_FLOAT64_IEEE 4 /end MOD_COMMON
/begin CHARACTERISTIC c_tnt_mdl_nt_agi_delta "max. deviation between higher and lower NT temp. for enabling an aging adaptation" VALUE 0xa1029a6e _REC_VAL_20_u1 1020. _CNV_A_R_LINEAR_____490_CM 0. 1020. DISPLAY_IDENTIFIER C_TNT_MDL_NT_AGI_DELTA FORMAT "%4.0" /end CHARACTERISTIC
/begin CHARACTERISTIC c_tnt_mdl_nt_agi_dyw "temperature threshold for dynamic window limitation" VALUE 0xa1029a6f _REC_VAL_20_u1 1020. _CNV_A_R_LINEAR_____490_CM 0. 1020. DISPLAY_IDENTIFIER C_TNT_MDL_NT_AGI_DYW FORMAT "%4.0" /end CHARACTERISTIC
/begin CHARACTERISTIC c_crlc_tnt_mdl_nt_agi_dyw "correlation factor for calculation of TNT of dynamic window limitation" VALUE 0xa1029236 _REC_VAL_20_u2 0.9999847412109381 _CNV_A_R_LINEAR_____68_CM 0. 0.9999847412109381 DISPLAY_IDENTIFIER C_CRLC_TNT_MDL_NT_AGI_DYW FORMAT "%7.5" /end CHARACTERISTIC
/begin CHARACTERISTIC lc_inh_nt_agi_man "Deactivation flag ( for the manual setting of the inhibiting bit NOx trap aging adaptation )" VALUE 0xa1029d5b _REC_VAL_20_u1 1. _CNV_A_R_LINEAR_____0_CM 0. 1. DISPLAY_IDENTIFIER LC_INH_NT_AGI_MAN FORMAT "%1.0" /end CHARACTERISTIC
/begin CHARACTERISTIC lc_inh_nt_agi_off "Deactivation flag for the deactivation of inhibiting the NOx trap aging adaptation " VALUE 0xa1029d5c _REC_VAL_20_u1 1. _CNV_A_R_LINEAR_____0_CM 0. 1. DISPLAY_IDENTIFIER LC_INH_NT_AGI_OFF FORMAT "%1.0" /end CHARACTERISTIC
/begin CHARACTERISTIC c_tnt_mdl_nt_agi_min "temperature threshold for enabling / disabling an aging adaptation" VALUE 0xa1029a71 _REC_VAL_20_u1 1020. _CNV_A_R_LINEAR_____490_CM 0. 1020. DISPLAY_IDENTIFIER C_TNT_MDL_NT_AGI_MIN FORMAT "%4.0" /end CHARACTERISTIC
/begin CHARACTERISTIC c_tnt_mdl_nt_agi_max "temperature threshold for enabling / disabling an aging adaptation" VALUE 0xa1029a70 _REC_VAL_20_u1 1020. _CNV_A_R_LINEAR_____490_CM 0. 1020. DISPLAY_IDENTIFIER C_TNT_MDL_NT_AGI_MAX FORMAT "%4.0" /end CHARACTERISTIC
/begin CHARACTERISTIC c_n_32_nt_agi_max "engine speed threshold for enabling / disabling an aging adaptation" VALUE 0xa10295cf _REC_VAL_20_u1 8160. _CNV_A_R_LINEAR_____9_CM 0. 8160. DISPLAY_IDENTIFIER C_N_32_NT_AGI_MAX FORMAT "%4.0" /end CHARACTERISTIC
/begin CHARACTERISTIC c_n_32_nt_agi_min "engine speed threshold for enabling / disabling an aging adaptation" VALUE 0xa10295d0 _REC_VAL_20_u1 8160. _CNV_A_R_LINEAR_____9_CM 0. 8160. DISPLAY_IDENTIFIER C_N_32_NT_AGI_MIN FORMAT "%4.0" /end CHARACTERISTIC
/begin CHARACTERISTIC c_mff_sp_s_nt_agi_max "fuel mass flow threshold for enabling / disabling an aging adaptation" VALUE 0xa10295a0 _REC_VAL_20_u2 1389. _CNV_A_R_LINEAR_____108_CM 0. 1389. DISPLAY_IDENTIFIER C_MFF_SP_S_NT_AGI_MAX FORMAT "%7.2" /end CHARACTERISTIC
/begin CHARACTERISTIC c_mff_sp_s_nt_agi_min "fuel mass flow threshold for enabling / disabling an aging adaptation" VALUE 0xa10295a2 _REC_VAL_20_u2 1389. _CNV_A_R_LINEAR_____108_CM 0. 1389. DISPLAY_IDENTIFIER C_MFF_SP_S_NT_AGI_MIN FORMAT "%7.2" /end CHARACTERISTIC
/begin CHARACTERISTIC c_lamb_nt_agi_min "lambda threshold for enabling / disabling an aging adaptation" VALUE 0xa10294ea _REC_VAL_20_u2 31.9990234375 _CNV_A_R_LINEAR_____122_CM 0. 31.9990234375 DISPLAY_IDENTIFIER C_LAMB_NT_AGI_MIN FORMAT "%7.4" /end CHARACTERISTIC
/begin CHARACTERISTIC c_tia_nt_agi_min "min. intake air temperature threshold for enabling / disabling an aging adaptation" VALUE 0xa1029a53 _REC_VAL_20_u1 190.5 _CNV_A_R_LINEAR_____16_CM -48. 142.5 DISPLAY_IDENTIFIER C_TIA_NT_AGI_MIN FORMAT "%5.1" /end CHARACTERISTIC
/begin CHARACTERISTIC c_toil_nt_agi_max "max. oil temperature threshold for enabling / disabling an aging adaptation" VALUE 0xa1029a85 _REC_VAL_20_u1 200. _CNV_A_R_LINEAR_____25_CM -40. 160. DISPLAY_IDENTIFIER C_TOIL_NT_AGI_MAX FORMAT "%3.0" /end CHARACTERISTIC
/begin CHARACTERISTIC c_toil_nt_agi_min "min. oil temperature threshold for enabling / disabling an aging adaptation" VALUE 0xa1029a86 _REC_VAL_20_u1 200. _CNV_A_R_LINEAR_____25_CM -40. 160. DISPLAY_IDENTIFIER C_TOIL_NT_AGI_MIN FORMAT "%3.0" /end CHARACTERISTIC
/begin CHARACTERISTIC c_amp_nt_agi_min "min. ambient pressure threshold for enabling / disabling an aging adaptation" VALUE 0xa1029196 _REC_VAL_20_u2 5434. _CNV_A_R_LINEAR_____26_CM 0. 5434. DISPLAY_IDENTIFIER C_AMP_NT_AGI_MIN FORMAT "%7.2" /end CHARACTERISTIC
/begin CHARACTERISTIC c_tnt_mdl_mv_agi_min "Temperature threshold for enabling / disabling an aging adaptation" VALUE 0xa1029a67 _REC_VAL_20_u1 1020. _CNV_A_R_LINEAR_____490_CM 0. 1020. DISPLAY_IDENTIFIER C_TNT_MDL_MV_AGI_MIN FORMAT "%4.0" /end CHARACTERISTIC
/begin CHARACTERISTIC c_tnt_mdl_mv_agi_max "Temperature threshold for enabling / disabling an aging adaptation" VALUE 0xa1029a66 _REC_VAL_20_u1 1020. _CNV_A_R_LINEAR_____490_CM 0. 1020. DISPLAY_IDENTIFIER C_TNT_MDL_MV_AGI_MAX FORMAT "%4.0" /end CHARACTERISTIC
/begin CHARACTERISTIC lc_nox_sens_max_agi_adj_ena "Switch to enable adjustment of NOx Sensor threshold for regeneration by aging adaptation" VALUE 0xa1029d95 _REC_VAL_20_u1 1. _CNV_A_R_LINEAR_____0_CM 0. 1. DISPLAY_IDENTIFIER LC_NOX_SENS_MAX_AGI_ADJ_ENA FORMAT "%1.0" /end CHARACTERISTIC
/begin CHARACTERISTIC c_err_egr_3_req_ctr_min "threshold for enabling aging factor observation considering EGR problems" VALUE 0xa102936a _REC_VAL_20_u1 255. _CNV_A_R_LINEAR_____0_CM 0. 255. DISPLAY_IDENTIFIER C_ERR_EGR_3_REQ_CTR_MIN FORMAT "%3.0" /end CHARACTERISTIC
/begin MEASUREMENT lv_ch_so2p_stb "Flag for catalyst heating in standby mode" UBYTE _CNV_S_2_RANGE__0___1_CM 1 100. 0. 1. DISPLAY_IDENTIFIER LV_CH_SO2P_STB ECU_ADDRESS 0xd0003a74 BIT_MASK 0x1 /end MEASUREMENT
/begin CHARACTERISTIC c_vs_ch_so2p_hys " Vehicle speed hysteresis for switching off catalyst heating" VALUE 0xa1029c62 _REC_VAL_20_u1 255. _CNV_A_R_LINEAR_____6_CM 0. 255. DISPLAY_IDENTIFIER C_VS_CH_SO2P_HYS FORMAT "%3.0" /end CHARACTERISTIC
/begin CHARACTERISTIC c_tnt_mdl_ch_hys "Hysteresis for activation of catalyst heating" VALUE 0xa1029a5a _REC_VAL_20_u1 1020. _CNV_A_R_LINEAR_____490_CM 0. 1020. DISPLAY_IDENTIFIER C_TNT_MDL_CH_HYS FORMAT "%4.0" /end CHARACTERISTIC
/begin CHARACTERISTIC ip_tnt_delta "Permissible temperature difference to be bridged" CURVE 0xa1028144 _REC_CUR_20_u1_u2 1020. _CNV_A_R_LINEAR_____490_CM 0. 1020. DISPLAY_IDENTIFIER IP_TNT_DELTA FORMAT "%4.0"
 /begin AXIS_DESCR COM_AXIS nt_agi _CNV_A_R_LINEAR_____68_CM 8 0. 0.9999847412109381 FORMAT "%7.5" AXIS_PTS_REF ldp_nt_agi_sul__ip_tnt_delta /end AXIS_DESCR
/end CHARACTERISTIC
/begin AXIS_PTS ldp_nt_agi_sul__ip_tnt_delta "" 0xa1021094 nt_agi _REC_AXS_20_u2 0.9999847412109381 _CNV_A_R_LINEAR_____68_CM 8 0. 0.9999847412109381 FORMAT "%7.5" /end AXIS_PTS
/begin MEASUREMENT lv_vs_ch_so2p_min_1 "Flag for catalyst heating activation by vehicle speed threshold 1" UBYTE _CNV_S_2_RANGE__0___1_CM 1 100. 0. 1. DISPLAY_IDENTIFIER LV_VS_CH_SO2P_MIN_1 ECU_ADDRESS 0xc0000a82 BIT_MASK 0x1 /end MEASUREMENT
/begin MEASUREMENT lv_vs_ch_so2p_min_2 "Flag for catalyst heating activation by vehicle speed threshold 2" UBYTE _CNV_S_2_RANGE__0___1_CM 1 100. 0. 1. DISPLAY_IDENTIFIER LV_VS_CH_SO2P_MIN_2 ECU_ADDRESS 0xc0000a83 BIT_MASK 0x1 /end MEASUREMENT
/begin MEASUREMENT tnt_mdl_ch_so2p_sp "NT-temperature setpoint (to be reached by heating)" UBYTE _CNV_A_R_LINEAR_____490_CM 1 100. 0. 1020. DISPLAY_IDENTIFIER TNT_MDL_CH_SO2P_SP ECU_ADDRESS 0xd0003a70 FORMAT "%4.0" /end MEASUREMENT
/begin MEASUREMENT t_vs_ch_so2p_min_1 "Time of vehicle speed conditions 1 for catalyst heating activation present" UWORD _CNV_A_R_LINEAR_____4_CM 1 100. 0. 6553.5 DISPLAY_IDENTIFIER T_VS_CH_SO2P_MIN_1 ECU_ADDRESS 0xc0000a74 FORMAT "%6.1" /end MEASUREMENT
/begin MEASUREMENT t_vs_ch_so2p_min_2 "Time of vehicle speed conditions 2 for catalyst heating activation present" UWORD _CNV_A_R_LINEAR_____4_CM 1 100. 0. 6553.5 DISPLAY_IDENTIFIER T_VS_CH_SO2P_MIN_2 ECU_ADDRESS 0xc0000a76 FORMAT "%6.1" /end MEASUREMENT
/begin MEASUREMENT state_ch_so2p_req "Active State in SO2P - Heating Management" UBYTE _CNV_S_7_STATE_CH_S_491_CM 1 100. 0. 6. DISPLAY_IDENTIFIER STATE_CH_SO2P_REQ ECU_ADDRESS 0xd0003a71 /end MEASUREMENT
/begin MEASUREMENT ctr_ch_so2p "Counter of heating activation within one driving cycle" UBYTE _CNV_A_R_LINEAR_____0_CM 1 100. 0. 255. DISPLAY_IDENTIFIER CTR_CH_SO2P ECU_ADDRESS 0xc0000a80 FORMAT "%3.0" /end MEASUREMENT
/begin MEASUREMENT t_ch_so2p_act "Time of catalyst heating active" UWORD _CNV_A_R_LINEAR_____4_CM 1 100. 0. 6553.5 DISPLAY_IDENTIFIER T_CH_SO2P_ACT ECU_ADDRESS 0xd0004e1c FORMAT "%6.1" /end MEASUREMENT
/begin MEASUREMENT tnt_mdl_max_avl_mmv "Moving Meanvalue of maximum attainable monolith temp. for active NOx cat desulfation" UWORD _CNV_A_R_LINEAR_____197_CM 1 100. 0. 1023.984375 DISPLAY_IDENTIFIER TNT_MDL_MAX_AVL_MMV ECU_ADDRESS 0xc0000a78 FORMAT "%7.2" /end MEASUREMENT
/begin MEASUREMENT vs_ch_so2p_mmv "Moving Meanvalue of vehicle speed" UBYTE _CNV_A_R_LINEAR_____6_CM 1 100. 0. 255. DISPLAY_IDENTIFIER VS_CH_SO2P_MMV ECU_ADDRESS 0xd0003a72 FORMAT "%3.0" /end MEASUREMENT
/begin MEASUREMENT lv_ch_so2p "Flag for activation / deactivation of the catalyst heating" UBYTE _CNV_S_2_RANGE__0___1_CM 1 100. 0. 1. DISPLAY_IDENTIFIER LV_CH_SO2P ECU_ADDRESS 0xd0003a73 BIT_MASK 0x1 /end MEASUREMENT
/begin MEASUREMENT lv_lamb_so2p_ctl "Flag to be passed to lambda stimulation coordination" UBYTE _CNV_S_2_RANGE__0___1_CM 1 100. 0. 1. DISPLAY_IDENTIFIER LV_LAMB_SO2P_CTL ECU_ADDRESS 0xd0003a75 BIT_MASK 0x1 /end MEASUREMENT
/begin CHARACTERISTIC c_vs_ch_so2p_min " Vehicle speed threshold for switching on / off catalyst heating stand by" VALUE 0xa1029c63 _REC_VAL_20_u1 255. _CNV_A_R_LINEAR_____6_CM 0. 255. DISPLAY_IDENTIFIER C_VS_CH_SO2P_MIN FORMAT "%3.0" /end CHARACTERISTIC
/begin CHARACTERISTIC c_vs_ch_so2p_min_1 " Vehicle speed threshold for switching on catalyst heating - condition 1" VALUE 0xa1029c64 _REC_VAL_20_u1 255. _CNV_A_R_LINEAR_____6_CM 0. 255. DISPLAY_IDENTIFIER C_VS_CH_SO2P_MIN_1 FORMAT "%3.0" /end CHARACTERISTIC
/begin CHARACTERISTIC c_vs_ch_so2p_min_2 " Vehicle speed threshold for switching on catalyst heating- condition 2" VALUE 0xa1029c65 _REC_VAL_20_u1 255. _CNV_A_R_LINEAR_____6_CM 0. 255. DISPLAY_IDENTIFIER C_VS_CH_SO2P_MIN_2 FORMAT "%3.0" /end CHARACTERISTIC
/begin CHARACTERISTIC c_vs_ch_so2p_mmv_min "Vehicle speed (PT1-filtered) threshold for switching on catalyst heating" VALUE 0xa1029c66 _REC_VAL_20_u1 255. _CNV_A_R_LINEAR_____6_CM 0. 255. DISPLAY_IDENTIFIER C_VS_CH_SO2P_MMV_MIN FORMAT "%3.0" /end CHARACTERISTIC
/begin CHARACTERISTIC c_t_vs_ch_so2p_min_1 " Minimum time of vehicle speed conditions 1 for switching on catalyst heating" VALUE 0xa10299a2 _REC_VAL_20_u2 6553.5 _CNV_A_R_LINEAR_____4_CM 0. 6553.5 DISPLAY_IDENTIFIER C_T_VS_CH_SO2P_MIN_1 FORMAT "%6.1" /end CHARACTERISTIC
/begin CHARACTERISTIC c_t_ch_so2p_act_max " Maximium of total time of catalyst heating active" VALUE 0xa102981a _REC_VAL_20_u2 6553.5 _CNV_A_R_LINEAR_____4_CM 0. 6553.5 DISPLAY_IDENTIFIER C_T_CH_SO2P_ACT_MAX FORMAT "%6.1" /end CHARACTERISTIC
/begin CHARACTERISTIC c_t_ast_ch_so2p_max "Time after start threshold up to catalyst heating is allowed" VALUE 0xa10297fa _REC_VAL_20_u2 6553.5 _CNV_A_R_LINEAR_____4_CM 0. 6553.5 DISPLAY_IDENTIFIER C_T_AST_CH_SO2P_MAX FORMAT "%6.1" /end CHARACTERISTIC
/begin CHARACTERISTIC c_t_vs_ch_so2p_min_2 " Minimum time of vehicle speed conditions 2 for switching on catalyst heating" VALUE 0xa10299a4 _REC_VAL_20_u2 6553.5 _CNV_A_R_LINEAR_____4_CM 0. 6553.5 DISPLAY_IDENTIFIER C_T_VS_CH_SO2P_MIN_2 FORMAT "%6.1" /end CHARACTERISTIC
/begin CHARACTERISTIC c_crlc_tnt_mdl_max_avl "Correlation constant of pt1-filter for maximum attainable monolith temp for active NOx cat desulfation" VALUE 0xa1029234 _REC_VAL_20_u2 0.9999847412109381 _CNV_A_R_LINEAR_____68_CM 0. 0.9999847412109381 DISPLAY_IDENTIFIER C_CRLC_TNT_MDL_MAX_AVL FORMAT "%7.5" /end CHARACTERISTIC
/begin CHARACTERISTIC c_crlc_vs_ch_so2p "Correlation constant of pt1-filter for vehicle speed" VALUE 0xa1029246 _REC_VAL_20_u2 0.9999847412109381 _CNV_A_R_LINEAR_____68_CM 0. 0.9999847412109381 DISPLAY_IDENTIFIER C_CRLC_VS_CH_SO2P FORMAT "%7.5" /end CHARACTERISTIC
/begin CHARACTERISTIC c_ctr_ch_so2p_max "Time after start threshold up to catalyst heating is allowed" VALUE 0xa102924d _REC_VAL_20_u1 255. _CNV_A_R_LINEAR_____0_CM 0. 255. DISPLAY_IDENTIFIER C_CTR_CH_SO2P_MAX FORMAT "%3.0" /end CHARACTERISTIC
/begin CHARACTERISTIC c_dist_ch_so2p_min "Mileage counter Threshold since last desulfation to enable cat heating" VALUE 0xa1029304 _REC_VAL_20_u2 524280. _CNV_A_R_LINEAR_____259_CM 0. 524280. DISPLAY_IDENTIFIER C_DIST_CH_SO2P_MIN FORMAT "%6.0" /end CHARACTERISTIC
/begin CHARACTERISTIC c_dist_t_ch_so2p_rst "Mileage Threshold without desulfation after which cat heating is allowed " VALUE 0xa102930c _REC_VAL_20_u2 524280. _CNV_A_R_LINEAR_____259_CM 0. 524280. DISPLAY_IDENTIFIER C_DIST_T_CH_SO2P_RST FORMAT "%6.0" /end CHARACTERISTIC
/begin CHARACTERISTIC lc_tq_add_lamb_ch "Switch for Cat heating w/o lambda stimulation" VALUE 0xa1029df5 _REC_VAL_20_u1 1. _CNV_A_R_LINEAR_____0_CM 0. 1. DISPLAY_IDENTIFIER LC_TQ_ADD_LAMB_CH FORMAT "%1.0" /end CHARACTERISTIC
/begin CHARACTERISTIC lc_ena_t_ast_ch "Switch to enable cat heating during T_AST " VALUE 0xa1029d32 _REC_VAL_20_u1 1. _CNV_A_R_LINEAR_____0_CM 0. 1. DISPLAY_IDENTIFIER LC_ENA_T_AST_CH FORMAT "%1.0" /end CHARACTERISTIC
/begin AXIS_PTS ldp_nt_agi_thermo_ip_tnt_ch_sp "" 0xa10210d4 nt_agi_thermo _REC_AXS_20_u1 0.99609375 _CNV_A_R_LINEAR_____27_CM 8 0. 0.99609375 FORMAT "%5.3" /end AXIS_PTS
/begin AXIS_PTS ldp_flow_nt_mmv_tnt_mdl_dif_ch_lamb "" 0xa1020a1c flow_nt_mmv _REC_AXS_20_u2 2047.96875 _CNV_A_R_LINEAR_____207_CM 4 0. 2047.96875 FORMAT "%7.2" /end AXIS_PTS
/begin CHARACTERISTIC ip_tnt_mdl_ch_so2p_sp "NT-temperature setpoint (to be reached by heating)" CURVE 0xa102814c _REC_CUR_20_u1_u1 1020. _CNV_A_R_LINEAR_____490_CM 0. 1020. DISPLAY_IDENTIFIER IP_TNT_MDL_CH_SO2P_SP FORMAT "%4.0"
 /begin AXIS_DESCR COM_AXIS nt_agi_thermo _CNV_A_R_LINEAR_____27_CM 8 0. 0.99609375 FORMAT "%5.3" AXIS_PTS_REF ldp_nt_agi_thermo_ip_tnt_ch_sp /end AXIS_DESCR
/end CHARACTERISTIC
/begin CHARACTERISTIC ip_tnt_mdl_dif_ch_lamb "Achievable raising of  temperature by lambda stimulation" CURVE 0xa1028154 _REC_CUR_20_u1_u2 1020. _CNV_A_R_LINEAR_____490_CM 0. 1020. DISPLAY_IDENTIFIER IP_TNT_MDL_DIF_CH_LAMB FORMAT "%4.0"
 /begin AXIS_DESCR COM_AXIS flow_nt_mmv _CNV_A_R_LINEAR_____207_CM 4 0. 2047.96875 FORMAT "%7.2" AXIS_PTS_REF ldp_flow_nt_mmv_tnt_mdl_dif_ch_lamb /end AXIS_DESCR
/end CHARACTERISTIC
/begin MEASUREMENT dist_ch_so2p "Mileage counter since last desulfation" UWORD _CNV_A_R_LINEAR_____259_CM 1 100. 0. 524280. DISPLAY_IDENTIFIER DIST_CH_SO2P ECU_ADDRESS 0xc0000a7a FORMAT "%6.0" /end MEASUREMENT
/begin MEASUREMENT dist_ch_so2p_old "Mileage at last active desulfation" UWORD _CNV_A_R_LINEAR_____259_CM 1 100. 0. 524280. DISPLAY_IDENTIFIER DIST_CH_SO2P_OLD ECU_ADDRESS 0xd0004e1e FORMAT "%6.0" /end MEASUREMENT
/begin MEASUREMENT nox_cor_hom "Corrected engine out NOx emission in homogeneous operation mode" UWORD _CNV_A_R_LINEAR_____492_CM 1 100. 0. 1023.984375 DISPLAY_IDENTIFIER NOX_COR_HOM ECU_ADDRESS 0xd0004e20 FORMAT "%7.2" /end MEASUREMENT
/begin MEASUREMENT nox_add_iga "Engine out NOx emission correction due to spark retardation" SWORD _CNV_A_R_LINEAR_____492_CM 1 100. -512. 511.984375 DISPLAY_IDENTIFIER NOX_ADD_IGA ECU_ADDRESS 0xc0000a84 FORMAT "%7.2" /end MEASUREMENT
/begin MEASUREMENT lamb_dif_nox "Deviation of lambda at homogeneous lean operation" UWORD _CNV_A_R_LINEAR_____493_CM 1 100. -32. 31.9990234375 DISPLAY_IDENTIFIER LAMB_DIF_NOX ECU_ADDRESS 0xc0000a86 FORMAT "%8.4" /end MEASUREMENT
/begin AXIS_PTS ldp_n_32__nox_hom "" 0xa1020d90 n_32 _REC_AXS_20_u1 8160. _CNV_A_R_LINEAR_____9_CM 8 0. 8160. FORMAT "%4.0" /end AXIS_PTS
/begin AXIS_PTS ldpm_maf_10 "" 0xa1021b70 maf _REC_AXS_20_u1 1389. _CNV_A_R_LINEAR_____14_CM 8 0. 1389. FORMAT "%4.0" /end AXIS_PTS
/begin CHARACTERISTIC ip_nox_hom "NOx engine out base emission" MAP 0xa1026630 _REC_MAP_20_u2_u1_u1 1023.984375 _CNV_A_R_LINEAR_____492_CM 0. 1023.984375 DISPLAY_IDENTIFIER IP_NOX_HOM FORMAT "%7.2"
 /begin AXIS_DESCR COM_AXIS n_32 _CNV_A_R_LINEAR_____9_CM 8 0. 8160. FORMAT "%4.0" AXIS_PTS_REF ldp_n_32__nox_hom /end AXIS_DESCR
 /begin AXIS_DESCR COM_AXIS maf _CNV_A_R_LINEAR_____14_CM 8 0. 1389. FORMAT "%4.0" AXIS_PTS_REF ldpm_maf_10 /end AXIS_DESCR
/end CHARACTERISTIC
/begin AXIS_PTS ldp_n_32__nox_iga "" 0xa1020d9a n_32 _REC_AXS_20_u1 8160. _CNV_A_R_LINEAR_____9_CM 4 0. 8160. FORMAT "%4.0" /end AXIS_PTS
/begin CHARACTERISTIC ip_nox_iga "Ignition correction applied to the NOx engine out base emission" MAP 0xa10266b0 _REC_MAP_20_u1_u1_u1 7.96875 _CNV_A_R_LINEAR_____494_CM 0. 7.96875 DISPLAY_IDENTIFIER IP_NOX_IGA FORMAT "%4.2"
 /begin AXIS_DESCR COM_AXIS n_32 _CNV_A_R_LINEAR_____9_CM 4 0. 8160. FORMAT "%4.0" AXIS_PTS_REF ldp_n_32__nox_iga /end AXIS_DESCR
 /begin AXIS_DESCR COM_AXIS maf _CNV_A_R_LINEAR_____14_CM 8 0. 1389. FORMAT "%4.0" AXIS_PTS_REF ldpm_maf_10 /end AXIS_DESCR
/end CHARACTERISTIC
/begin AXIS_PTS ldpm_maf_12 "" 0xa1021b7a maf _REC_AXS_20_u1 1389. _CNV_A_R_LINEAR_____14_CM 4 0. 1389. FORMAT "%4.0" /end AXIS_PTS
/begin AXIS_PTS ldp_lamb_dif_nox__nox_lamb_mv "" 0xa1020c00 online_dummy _REC_AXS_20_u2 63.9990234375 _CNV_A_R_LINEAR_____493_CM 8 -32. 31.9990234375 FORMAT "%8.4" /end AXIS_PTS
/begin CHARACTERISTIC ip_nox_lamb_mv "Lambda correction applied to the NOx engine out base emission" MAP 0xa10266d0 _REC_MAP_20_u2_u1_u2 15.999755859375 _CNV_A_R_LINEAR_____115_CM 0. 15.999755859375 DISPLAY_IDENTIFIER IP_NOX_LAMB_MV FORMAT "%7.4"
 /begin AXIS_DESCR COM_AXIS maf _CNV_A_R_LINEAR_____14_CM 4 0. 1389. FORMAT "%4.0" AXIS_PTS_REF ldpm_maf_12 /end AXIS_DESCR
 /begin AXIS_DESCR COM_AXIS online_dummy _CNV_A_R_LINEAR_____493_CM 8 -32. 31.9990234375 FORMAT "%8.4" AXIS_PTS_REF ldp_lamb_dif_nox__nox_lamb_mv /end AXIS_DESCR
/end CHARACTERISTIC
/begin AXIS_PTS ldp_tia__nox_tia_hom "" 0xa1021358 tia _REC_AXS_20_u1 190.5 _CNV_A_R_LINEAR_____16_CM 8 -48. 142.5 FORMAT "%5.1" /end AXIS_PTS
/begin CHARACTERISTIC ip_nox_tia_hom "Air temperature in intake manifold correction applied to the NOx engine out base emission" CURVE 0xa1026a54 _REC_CUR_20_u1_u1 3.984375 _CNV_A_R_LINEAR_____255_CM 0. 3.984375 DISPLAY_IDENTIFIER IP_NOX_TIA_HOM FORMAT "%4.2"
 /begin AXIS_DESCR COM_AXIS tia _CNV_A_R_LINEAR_____16_CM 8 -48. 142.5 FORMAT "%5.1" AXIS_PTS_REF ldp_tia__nox_tia_hom /end AXIS_DESCR
/end CHARACTERISTIC
/begin AXIS_PTS ldp_egr_ratio__nox_egr_hom "" 0xa1020910 egr_ratio _REC_AXS_20_u2 99.99847412109381 _CNV_A_R_LINEAR_____489_CM 4 0. 99.99847412109381 /end AXIS_PTS
/begin CHARACTERISTIC ip_nox_egr_hom "EGR correction applied to the NOx engine out base emission" MAP 0xa10265a0 _REC_MAP_20_u1_u1_u2 7.96875 _CNV_A_R_LINEAR_____184_CM 0. 7.96875 DISPLAY_IDENTIFIER IP_NOX_EGR_HOM FORMAT "%4.2"
 /begin AXIS_DESCR COM_AXIS maf _CNV_A_R_LINEAR_____14_CM 4 0. 1389. FORMAT "%4.0" AXIS_PTS_REF ldpm_maf_12 /end AXIS_DESCR
 /begin AXIS_DESCR COM_AXIS egr_ratio _CNV_A_R_LINEAR_____489_CM 4 0. 99.99847412109381 AXIS_PTS_REF ldp_egr_ratio__nox_egr_hom /end AXIS_DESCR
/end CHARACTERISTIC
/begin MEASUREMENT lv_inh_lamb_puls_so2p "flag inhibiting the NOx catalyst desulfation lambda stimulation" UBYTE _CNV_S_2_RANGE__0___1_CM 1 100. 0. 1. DISPLAY_IDENTIFIER LV_INH_LAMB_PULS_SO2P ECU_ADDRESS 0xd0003a78 BIT_MASK 0x1 /end MEASUREMENT
/begin CHARACTERISTIC lc_inh_lamb_puls_so2p_man "code word for the manual setting of the inhibiting bit NOx trap desulfation by lambda stimulation" VALUE 0xa1029d55 _REC_VAL_20_u1 1. _CNV_A_R_LINEAR_____0_CM 0. 1. DISPLAY_IDENTIFIER LC_INH_LAMB_PULS_SO2P_MAN FORMAT "%1.0" /end CHARACTERISTIC
/begin CHARACTERISTIC lc_inh_lamb_puls_so2p_off "code word for the deactivation of inhibiting the NOx trap desulfation by lambda stimulation" VALUE 0xa1029d56 _REC_VAL_20_u1 1. _CNV_A_R_LINEAR_____0_CM 0. 1. DISPLAY_IDENTIFIER LC_INH_LAMB_PULS_SO2P_OFF FORMAT "%1.0" /end CHARACTERISTIC
/begin MEASUREMENT lv_nt_o2_stc_req "bit for requesting an OSC adaptation cycle" UBYTE _CNV_S_2_RANGE__0___1_CM 1 100. 0. 1. DISPLAY_IDENTIFIER LV_NT_O2_STC_REQ ECU_ADDRESS 0xd0003a7d BIT_MASK 0x1 /end MEASUREMENT
/begin MEASUREMENT lv_nt_o2_stc_lim "bit for limitation an OSC adaptation cycle" UBYTE _CNV_S_2_RANGE__0___1_CM 1 100. 0. 1. DISPLAY_IDENTIFIER LV_NT_O2_STC_LIM ECU_ADDRESS 0xd0003a7e BIT_MASK 0x1 /end MEASUREMENT
/begin MEASUREMENT lv_nt_o2_stc_vld "Flag for valid status of OSC adaptation measurement" UBYTE _CNV_S_2_RANGE__0___1_CM 1 100. 0. 1. DISPLAY_IDENTIFIER LV_NT_O2_STC_VLD ECU_ADDRESS 0xd0003a7f BIT_MASK 0x1 /end MEASUREMENT
/begin MEASUREMENT nt_o2_stc_ad "adaptation factor for NOx catalyst oxygen storage capacity" UBYTE _CNV_A_R_LINEAR_____100_CM 1 100. 0. 1.9921875 DISPLAY_IDENTIFIER NT_O2_STC_AD ECU_ADDRESS 0xd0003a7c FORMAT "%5.3" /end MEASUREMENT
/begin MEASUREMENT nt_o2_stc_ofs "adaptation offset for NOx catalyst oxygen storage capacity" SWORD _CNV_A_R_LINEAR_____497_CM 1 100. -10485.6 10485.6 DISPLAY_IDENTIFIER NT_O2_STC_OFS ECU_ADDRESS 0xd0004e26 FORMAT "%7.1" /end MEASUREMENT
/begin MEASUREMENT dist_o2_stc_old "mileage of last O2_STC adaptation" UWORD _CNV_A_R_LINEAR_____259_CM 1 100. 0. 524280. DISPLAY_IDENTIFIER DIST_O2_STC_OLD ECU_ADDRESS 0xd0004e24 FORMAT "%6.0" /end MEASUREMENT
/begin CHARACTERISTIC c_dist_o2_stc "mileage distance to be passed before next O2_STC measurement" VALUE 0xa1029306 _REC_VAL_20_u2 524280. _CNV_A_R_LINEAR_____259_CM 0. 524280. DISPLAY_IDENTIFIER C_DIST_O2_STC FORMAT "%6.0" /end CHARACTERISTIC
/begin CHARACTERISTIC c_dist_o2_stc_vld "mileage distance to be passed before next O2_STC measurement is not valid anymore" VALUE 0xa1029308 _REC_VAL_20_u2 524280. _CNV_A_R_LINEAR_____259_CM 0. 524280. DISPLAY_IDENTIFIER C_DIST_O2_STC_VLD FORMAT "%6.0" /end CHARACTERISTIC
/begin CHARACTERISTIC c_nt_o2_stc_delta "permissible deviation between old and new osc value" VALUE 0xa10296e0 _REC_VAL_20_u2 10485.6 _CNV_A_R_LINEAR_____498_CM 0. 10485.6 DISPLAY_IDENTIFIER C_NT_O2_STC_DELTA FORMAT "%7.1" /end CHARACTERISTIC
/begin CHARACTERISTIC lc_nt_o2_stc_req "Logical constant for manually requesting an O2_STC adaptation cycle" VALUE 0xa1029dad _REC_VAL_20_u1 1. _CNV_A_R_LINEAR_____0_CM 0. 1. DISPLAY_IDENTIFIER LC_NT_O2_STC_REQ FORMAT "%1.0" /end CHARACTERISTIC
/begin CHARACTERISTIC lc_nt_o2_stc_vld "Logical constant for manually setting of valid bit O2_STC value" VALUE 0xa1029dae _REC_VAL_20_u1 1. _CNV_A_R_LINEAR_____0_CM 0. 1. DISPLAY_IDENTIFIER LC_NT_O2_STC_VLD FORMAT "%1.0" /end CHARACTERISTIC
/begin CHARACTERISTIC c_nt_o2_stc_ad_man "manual initialisation value for oxygen storage capacity adaptation value" VALUE 0xa10296df _REC_VAL_20_u1 1.9921875 _CNV_A_R_LINEAR_____100_CM 0. 1.9921875 DISPLAY_IDENTIFIER C_NT_O2_STC_AD_MAN FORMAT "%5.3" /end CHARACTERISTIC
/begin CHARACTERISTIC lc_nt_o2_stc_ad_man "Logical constant for manual initialisation of NT_O2_STC_AD" VALUE 0xa1029dab _REC_VAL_20_u1 1. _CNV_A_R_LINEAR_____0_CM 0. 1. DISPLAY_IDENTIFIER LC_NT_O2_STC_AD_MAN FORMAT "%1.0" /end CHARACTERISTIC
/begin CHARACTERISTIC lc_nt_o2_stc_rep_off "Logical constant for disabling a repetition of osc-measurement in case of gradient limitation" VALUE 0xa1029dac _REC_VAL_20_u1 1. _CNV_A_R_LINEAR_____0_CM 0. 1. DISPLAY_IDENTIFIER LC_NT_O2_STC_REP_OFF FORMAT "%1.0" /end CHARACTERISTIC
/begin MEASUREMENT dist_nt "mileage counter for NOx trap purposes" UWORD _CNV_A_R_LINEAR_____259_CM 1 100. 0. 524280. DISPLAY_IDENTIFIER DIST_NT ECU_ADDRESS 0xd0004ebc FORMAT "%8.3" /end MEASUREMENT
/begin MEASUREMENT ntl_dec_int_ad "mileage counter for NOx trap purposes" UWORD _CNV_A_R_LINEAR_____495_CM 1 100. 0. 10485.6 DISPLAY_IDENTIFIER NTL_DEC_INT_AD ECU_ADDRESS 0xd0004ebe FORMAT "%7.1" /end MEASUREMENT
/begin MEASUREMENT nox_ppm_1 "NOx concentration in the exhaust gas downstream NOx catalyst" UWORD _CNV_A_R_LINEAR_____499_CM 1 100. 0. 1500. DISPLAY_IDENTIFIER NOX_PPM_1 ECU_ADDRESS 0xd0004e28 FORMAT "%4.0" /end MEASUREMENT
/begin MEASUREMENT nox_ppm_2 "NOx concentration in the exhaust gas downstream NOx catalyst" UWORD _CNV_A_R_LINEAR_____499_CM 1 100. 0. 1500. DISPLAY_IDENTIFIER NOX_PPM_2 ECU_ADDRESS 0xd0004e2e FORMAT "%4.0" /end MEASUREMENT
/begin MEASUREMENT nox_ppm_ad_add_1 "offset adaptation value for the NOx signal" SWORD _CNV_A_R_LINEAR_____499_CM 1 100. -100. 1500. DISPLAY_IDENTIFIER NOX_PPM_AD_ADD_1 ECU_ADDRESS 0xd0004e2a FORMAT "%4.0" /end MEASUREMENT
/begin MEASUREMENT nox_ppm_ad_add_2 "offset adaptation value for the NOx signal" SWORD _CNV_A_R_LINEAR_____499_CM 1 100. -100. 1500. DISPLAY_IDENTIFIER NOX_PPM_AD_ADD_2 ECU_ADDRESS 0xd0004e30 FORMAT "%4.0" /end MEASUREMENT
/begin MEASUREMENT nox_ofs_puc_1 "NOx signal offset value, measured at PUC" SWORD _CNV_A_R_LINEAR_____499_CM 1 100. -100. 1500. DISPLAY_IDENTIFIER NOX_OFS_PUC_1 ECU_ADDRESS 0xd000556c FORMAT "%4.0" /end MEASUREMENT
/begin MEASUREMENT nox_ofs_puc_2 "NOx signal offset value, measured at PUC" SWORD _CNV_A_R_LINEAR_____499_CM 1 100. -100. 1500. DISPLAY_IDENTIFIER NOX_OFS_PUC_2 ECU_ADDRESS 0xd0005578 FORMAT "%4.0" /end MEASUREMENT
/begin MEASUREMENT nox_ofs_afs_2 "NOx signal offset value, measured at lambda=1.0 operation" SWORD _CNV_A_R_LINEAR_____499_CM 1 100. -100. 1500. DISPLAY_IDENTIFIER NOX_OFS_AFS_2 ECU_ADDRESS 0xd000557c FORMAT "%4.0" /end MEASUREMENT
/begin MEASUREMENT nox_ofs_load_2 "NOx signal offset value, measured after start of a \"LOAD\" phase" SWORD _CNV_A_R_LINEAR_____499_CM 1 100. -100. 1500. DISPLAY_IDENTIFIER NOX_OFS_LOAD_2 ECU_ADDRESS 0xd0005580 FORMAT "%4.0" /end MEASUREMENT
/begin MEASUREMENT nox_ofs_load_1 "NOx signal offset value, measured after start of a \"LOAD\" phase" SWORD _CNV_A_R_LINEAR_____499_CM 1 100. -100. 1500. DISPLAY_IDENTIFIER NOX_OFS_LOAD_1 ECU_ADDRESS 0xd0005574 FORMAT "%4.0" /end MEASUREMENT
/begin MEASUREMENT nox_nox_sens_diag_min_1 "last NOx signal offset value, measured after start of a \"LOAD\" phase" SWORD _CNV_A_R_LINEAR_____499_CM 1 100. -100. 1500. DISPLAY_IDENTIFIER NOX_NOX_SENS_DIAG_MIN_1 ECU_ADDRESS 0xd0004e2c FORMAT "%4.0" /end MEASUREMENT
/begin MEASUREMENT nox_nox_sens_diag_min_2 "last NOx signal offset value, measured after start of a \"LOAD\" phase" SWORD _CNV_A_R_LINEAR_____499_CM 1 100. -100. 1500. DISPLAY_IDENTIFIER NOX_NOX_SENS_DIAG_MIN_2 ECU_ADDRESS 0xd0004e32 FORMAT "%4.0" /end MEASUREMENT
/begin MEASUREMENT nox_ofs_afs_1 "NOx signal offset value, measured at lambda=1.0 operation" SWORD _CNV_A_R_LINEAR_____499_CM 1 100. -100. 1500. DISPLAY_IDENTIFIER NOX_OFS_AFS_1 ECU_ADDRESS 0xd0005570 FORMAT "%4.0" /end MEASUREMENT
/begin MEASUREMENT maf_int_afs_1 "sucking air mass after leaving adaptation conditions" UWORD _CNV_A_R_LINEAR_____198_CM 1 100. 0. 1820.398 DISPLAY_IDENTIFIER MAF_INT_AFS_1 ECU_ADDRESS 0xc0000a8c FORMAT "%7.2" /end MEASUREMENT
/begin MEASUREMENT maf_int_afs_2 "sucking air mass after leaving adaptation conditions" UWORD _CNV_A_R_LINEAR_____198_CM 1 100. 0. 1820.398 DISPLAY_IDENTIFIER MAF_INT_AFS_2 ECU_ADDRESS 0xc0000a92 FORMAT "%7.2" /end MEASUREMENT
/begin MEASUREMENT lv_nox_ofs_load_1 "variable for NOx signal offset adaptation control flow" UBYTE _CNV_S_2_RANGE__0___1_CM 1 100. 0. 1. DISPLAY_IDENTIFIER LV_NOX_OFS_LOAD_1 ECU_ADDRESS 0xd0003a80 BIT_MASK 0x1 /end MEASUREMENT
/begin MEASUREMENT lv_nox_ofs_load_2 "variable for NOx signal offset adaptation control flow" UBYTE _CNV_S_2_RANGE__0___1_CM 1 100. 0. 1. DISPLAY_IDENTIFIER LV_NOX_OFS_LOAD_2 ECU_ADDRESS 0xd0003a83 BIT_MASK 0x1 /end MEASUREMENT
/begin MEASUREMENT lv_t_nox_sens_vld_2 "flag: NOx sensor signal valid after regeneration (bank selective)" UBYTE _CNV_S_2_RANGE__0___1_CM 1 100. 0. 1. DISPLAY_IDENTIFIER LV_T_NOX_SENS_VLD_2 ECU_ADDRESS 0xd0003a84 BIT_MASK 0x1 /end MEASUREMENT
/begin MEASUREMENT lv_t_nox_sens_vld "flag: NOx sensor signal valid after regeneration" UBYTE _CNV_S_2_RANGE__0___1_CM 1 100. 0. 1. DISPLAY_IDENTIFIER LV_T_NOX_SENS_VLD ECU_ADDRESS 0xd0003a82 BIT_MASK 0x1 /end MEASUREMENT
/begin MEASUREMENT lv_t_nox_sens_vld_1 "flag: NOx sensor signal valid after regeneration (bank selective)" UBYTE _CNV_S_2_RANGE__0___1_CM 1 100. 0. 1. DISPLAY_IDENTIFIER LV_T_NOX_SENS_VLD_1 ECU_ADDRESS 0xd0003a81 BIT_MASK 0x1 /end MEASUREMENT
/begin MEASUREMENT t_nox_ppm_delta_vld_1 "timer for determination \"NOx sensor signal inside of a limited gap\"" UBYTE _CNV_A_R_LINEAR_____4_CM 1 100. 0. 25.5 DISPLAY_IDENTIFIER T_NOX_PPM_DELTA_VLD_1 ECU_ADDRESS 0xc0000aa0 FORMAT "%4.1" /end MEASUREMENT
/begin MEASUREMENT t_nox_ppm_delta_vld_2 "timer for determination \"NOx sensor signal inside of a limited gap\"" UBYTE _CNV_A_R_LINEAR_____4_CM 1 100. 0. 25.5 DISPLAY_IDENTIFIER T_NOX_PPM_DELTA_VLD_2 ECU_ADDRESS 0xc0000aa2 FORMAT "%4.1" /end MEASUREMENT
/begin MEASUREMENT nox_ppm_delta_1 "NOx sensor signal gradient (bank selective)" SWORD _CNV_A_R_LINEAR_____499_CM 1 100. -1500. 1500. DISPLAY_IDENTIFIER NOX_PPM_DELTA_1 ECU_ADDRESS 0xc0000a90 FORMAT "%5.0" /end MEASUREMENT
/begin MEASUREMENT nox_ppm_delta_2 "NOx sensor signal gradient (bank selective)" SWORD _CNV_A_R_LINEAR_____499_CM 1 100. -1500. 1500. DISPLAY_IDENTIFIER NOX_PPM_DELTA_2 ECU_ADDRESS 0xc0000a96 FORMAT "%5.0" /end MEASUREMENT
/begin MEASUREMENT nox_ppm_delta_mmv_1 "NOx sensor signal gradient moving mean value (bank selective)" SWORD _CNV_A_R_LINEAR_____499_CM 1 100. -1500. 1500. DISPLAY_IDENTIFIER NOX_PPM_DELTA_MMV_1 ECU_ADDRESS 0xc0000a98 FORMAT "%5.0" /end MEASUREMENT
/begin MEASUREMENT nox_ppm_delta_mmv_2 "NOx sensor signal gradient moving mean value (bank selective)" SWORD _CNV_A_R_LINEAR_____499_CM 1 100. -1500. 1500. DISPLAY_IDENTIFIER NOX_PPM_DELTA_MMV_2 ECU_ADDRESS 0xc0000a9c FORMAT "%5.0" /end MEASUREMENT
/begin CHARACTERISTIC c_maf_int_puc_min_nox "MAF threshold for starting the NOx signal offset adaptation at PUC" VALUE 0xa1029544 _REC_VAL_20_u2 1820.398 _CNV_A_R_LINEAR_____198_CM 0. 1820.398 DISPLAY_IDENTIFIER C_MAF_INT_PUC_MIN_NOX FORMAT "%7.2" /end CHARACTERISTIC
/begin CHARACTERISTIC c_maf_int_afs_min_nox "MAF threshold for starting the NOx signal offset adaptation at lambda = 1" VALUE 0xa102953e _REC_VAL_20_u2 1820.398 _CNV_A_R_LINEAR_____198_CM 0. 1820.398 DISPLAY_IDENTIFIER C_MAF_INT_AFS_MIN_NOX FORMAT "%7.2" /end CHARACTERISTIC
/begin CHARACTERISTIC c_nt_agi_nox_ofs_min "NOx catalyst aging threshold for calculation of a new NOx signal offset value" VALUE 0xa10296ca _REC_VAL_20_u2 0.9999847412109381 _CNV_A_R_LINEAR_____68_CM 0. 0.9999847412109381 DISPLAY_IDENTIFIER C_NT_AGI_NOX_OFS_MIN FORMAT "%7.5" /end CHARACTERISTIC
/begin CHARACTERISTIC c_crlc_nox_ofs_afs "correlation constant for calculation of lambda=1.0 offset value" VALUE 0xa1029222 _REC_VAL_20_u2 0.9999847412109381 _CNV_A_R_LINEAR_____68_CM 0. 0.9999847412109381 DISPLAY_IDENTIFIER C_CRLC_NOX_OFS_AFS FORMAT "%7.5" /end CHARACTERISTIC
/begin CHARACTERISTIC c_nox_ofs_puc_max "maximum NOx signal offset value at PUC" VALUE 0xa102969a _REC_VAL_20_s2 1600. _CNV_A_R_LINEAR_____499_CM -100. 1500. DISPLAY_IDENTIFIER C_NOX_OFS_PUC_MAX FORMAT "%4.0" /end CHARACTERISTIC
/begin CHARACTERISTIC c_nox_ofs_man_1 "NOx signal offset at manual setting" VALUE 0xa1029696 _REC_VAL_20_s2 1600. _CNV_A_R_LINEAR_____499_CM -100. 1500. DISPLAY_IDENTIFIER C_NOX_OFS_MAN_1 FORMAT "%4.0" /end CHARACTERISTIC
/begin CHARACTERISTIC c_nox_ofs_man_2 "NOx signal offset at manual setting" VALUE 0xa1029698 _REC_VAL_20_s2 1600. _CNV_A_R_LINEAR_____499_CM -100. 1500. DISPLAY_IDENTIFIER C_NOX_OFS_MAN_2 FORMAT "%4.0" /end CHARACTERISTIC
/begin CHARACTERISTIC c_vls_dif_nox_ofs_max "maximum allowed control deviation of trim control to start the NOx signal offset calculation" VALUE 0xa1029c2a _REC_VAL_20_u2 4.9951171875 _CNV_A_R_LINEAR_____2_CM 0. 4.9951171875 DISPLAY_IDENTIFIER C_VLS_DIF_NOX_OFS_MAX FORMAT "%5.3" /end CHARACTERISTIC
/begin CHARACTERISTIC c_nox_ppm_ad_add_max "maximum limit of NOx signal offset adaptation value" VALUE 0xa10296a4 _REC_VAL_20_s2 1600. _CNV_A_R_LINEAR_____499_CM -100. 1500. DISPLAY_IDENTIFIER C_NOX_PPM_AD_ADD_MAX FORMAT "%4.0" /end CHARACTERISTIC
/begin CHARACTERISTIC lc_nox_sens_ad_rst "reset of NOx signal adaptation values" VALUE 0xa1029d8e _REC_VAL_20_u1 1. _CNV_A_R_LINEAR_____0_CM 0. 1. DISPLAY_IDENTIFIER LC_NOX_SENS_AD_RST FORMAT "%1.0" /end CHARACTERISTIC
/begin CHARACTERISTIC lc_nox_sens_nox_ofs_vld_on "a valid NOx signal is necessary for this offset adaptation (on/off)" VALUE 0xa1029d98 _REC_VAL_20_u1 1. _CNV_A_R_LINEAR_____0_CM 0. 1. DISPLAY_IDENTIFIER LC_NOX_SENS_NOX_OFS_VLD_ON FORMAT "%1.0" /end CHARACTERISTIC
/begin CHARACTERISTIC c_nt_hom_ini_use "offset adaptation runs only after a complete NOx catalyst regeneration" VALUE 0xa10296de _REC_VAL_20_u1 3. _CNV_A_R_LINEAR_____0_CM 0. 3. DISPLAY_IDENTIFIER C_NT_HOM_INI_USE FORMAT "%1.0" /end CHARACTERISTIC
/begin CHARACTERISTIC c_nox_ofs_sel "selection of a NOx signal adaptation method" VALUE 0xa102969c _REC_VAL_20_u1 4. _CNV_S_5_NOX_OFS_SE_500_CM 0. 4. DISPLAY_IDENTIFIER C_NOX_OFS_SEL /end CHARACTERISTIC
/begin CHARACTERISTIC c_t_nox_sens_nox_ofs "min. NOx signal \"valid\" time for enable of NOx signal offset adaptation" VALUE 0xa1029922 _REC_VAL_20_u2 327.67 _CNV_A_R_LINEAR_____3_CM 0. 327.67 DISPLAY_IDENTIFIER C_T_NOX_SENS_NOX_OFS FORMAT "%6.2" /end CHARACTERISTIC
/begin CHARACTERISTIC c_tnt_mdl_nox_ofs_min "min. temperature of NOx catalyst at which the NOx signal offset adaptation at \"LOAD\" is activated" VALUE 0xa1029a6c _REC_VAL_20_u2 1023.984375 _CNV_A_R_LINEAR_____197_CM 0. 1023.984375 DISPLAY_IDENTIFIER C_TNT_MDL_NOX_OFS_MIN FORMAT "%7.2" /end CHARACTERISTIC
/begin CHARACTERISTIC c_tnt_mdl_nox_ofs_max "max. temperature of NOx catalyst at which the NOx signal offset adaptation at \"LOAD\" is activated" VALUE 0xa1029a6a _REC_VAL_20_u2 1023.984375 _CNV_A_R_LINEAR_____197_CM 0. 1023.984375 DISPLAY_IDENTIFIER C_TNT_MDL_NOX_OFS_MAX FORMAT "%7.2" /end CHARACTERISTIC
/begin CHARACTERISTIC c_t_afl_nox_ofs_min "min. lean time for calculation of NOx signal offset adaptation value" VALUE 0xa10297f0 _REC_VAL_20_u2 1310.7 _CNV_A_R_LINEAR_____107_CM 0. 1310.7 DISPLAY_IDENTIFIER C_T_AFL_NOX_OFS_MIN FORMAT "%7.2" /end CHARACTERISTIC
/begin CHARACTERISTIC c_t_nox_ppm_delta_min "blocking time of NOx sensor based regeneration request for gradient observation" VALUE 0xa1029917 _REC_VAL_20_u1 25.5 _CNV_A_R_LINEAR_____4_CM 0. 25.5 DISPLAY_IDENTIFIER C_T_NOX_PPM_DELTA_MIN FORMAT "%4.1" /end CHARACTERISTIC
/begin CHARACTERISTIC c_t_nox_sens_vld "blocking time of NOx sensor based regeneration request after a regeneration" VALUE 0xa1029926 _REC_VAL_20_u2 1310.7 _CNV_A_R_LINEAR_____107_CM 0. 1310.7 DISPLAY_IDENTIFIER C_T_NOX_SENS_VLD FORMAT "%7.2" /end CHARACTERISTIC
/begin CHARACTERISTIC c_t_nox_sens_vld_puc "blocking time of NOx sensor based regeneration request after PUC" VALUE 0xa1029928 _REC_VAL_20_u2 1310.7 _CNV_A_R_LINEAR_____107_CM 0. 1310.7 DISPLAY_IDENTIFIER C_T_NOX_SENS_VLD_PUC FORMAT "%7.2" /end CHARACTERISTIC
/begin CHARACTERISTIC c_crlc_nox_ofs_puc "correlation constant for calculation of PUC offset value" VALUE 0xa1029224 _REC_VAL_20_u2 0.9999847412109381 _CNV_A_R_LINEAR_____68_CM 0. 0.9999847412109381 DISPLAY_IDENTIFIER C_CRLC_NOX_OFS_PUC FORMAT "%7.5" /end CHARACTERISTIC
/begin CHARACTERISTIC c_crlc_nox_ppm_delta "correlation factor to calculate moving mean value of the NOx sensor signal gradient" VALUE 0xa1029228 _REC_VAL_20_u2 0.9999847412109381 _CNV_A_R_LINEAR_____68_CM 0. 0.9999847412109381 DISPLAY_IDENTIFIER C_CRLC_NOX_PPM_DELTA FORMAT "%7.5" /end CHARACTERISTIC
/begin CHARACTERISTIC c_nox_ppm_max_sens_vld "maximum NOx sensor signal to enable gradient observation" VALUE 0xa10296b0 _REC_VAL_20_u2 1500. _CNV_A_R_LINEAR_____499_CM 0. 1500. DISPLAY_IDENTIFIER C_NOX_PPM_MAX_SENS_VLD FORMAT "%4.0" /end CHARACTERISTIC
/begin CHARACTERISTIC c_nox_ppm_delta_mmv_min "minimum allowed NOx sensor signal gradient" VALUE 0xa10296ac _REC_VAL_20_s2 3000. _CNV_A_R_LINEAR_____499_CM -1500. 1500. DISPLAY_IDENTIFIER C_NOX_PPM_DELTA_MMV_MIN FORMAT "%5.0" /end CHARACTERISTIC
/begin CHARACTERISTIC c_nox_ppm_delta_mmv_max "maximum allowed NOx sensor signal gradient" VALUE 0xa10296aa _REC_VAL_20_s2 3000. _CNV_A_R_LINEAR_____499_CM -1500. 1500. DISPLAY_IDENTIFIER C_NOX_PPM_DELTA_MMV_MAX FORMAT "%5.0" /end CHARACTERISTIC
/begin CHARACTERISTIC c_nox_ppm_ad_add_min "minimum limit of NOx signal offset adaptation value" VALUE 0xa10296a6 _REC_VAL_20_s2 1600. _CNV_A_R_LINEAR_____499_CM -100. 1500. DISPLAY_IDENTIFIER C_NOX_PPM_AD_ADD_MIN FORMAT "%4.0" /end CHARACTERISTIC
/begin CHARACTERISTIC c_nox_ofs_afs_dft "default NOx signal offset value for offset adaptation at lambda=1.0 operation" VALUE 0xa1029694 _REC_VAL_20_s2 1600. _CNV_A_R_LINEAR_____499_CM -100. 1500. DISPLAY_IDENTIFIER C_NOX_OFS_AFS_DFT FORMAT "%4.0" /end CHARACTERISTIC
/begin AXIS_PTS ldp_nox_nox_sens_diag_min "" 0xa1021070 nox_nox_sens_diag_min_1 _REC_AXS_20_u2 1600.000000000001 _CNV_A_R_LINEAR_____501_CM 4 -100.000000000001 1500. FORMAT "%4.0" /end AXIS_PTS
/begin CHARACTERISTIC ip_crlc_nox_ofs_load "correlation constant for calculation of \"LOAD\" offset value" CURVE 0xa10231b0 _REC_CUR_20_u2_u2 0.9999847412109381 _CNV_A_R_LINEAR_____68_CM 0. 0.9999847412109381 DISPLAY_IDENTIFIER IP_CRLC_NOX_OFS_LOAD FORMAT "%7.5"
 /begin AXIS_DESCR COM_AXIS nox_nox_sens_diag_min_1 _CNV_A_R_LINEAR_____501_CM 4 -100.000000000001 1500. FORMAT "%4.0" AXIS_PTS_REF ldp_nox_nox_sens_diag_min /end AXIS_DESCR
/end CHARACTERISTIC
/begin MEASUREMENT map_dif_nox_s "pressure difference to basis ambient pressure of the model" UWORD _CNV_A_R_LINEAR_____26_CM 1 100. 0. 5434. DISPLAY_IDENTIFIER MAP_DIF_NOX_S ECU_ADDRESS 0xc0000aa4 FORMAT "%7.2" /end MEASUREMENT
/begin MEASUREMENT nox_cor_s "Corrected engine out NOx emission in stratified operation mode" UWORD _CNV_A_R_LINEAR_____492_CM 1 100. 0. 1023.984375 DISPLAY_IDENTIFIER NOX_COR_S ECU_ADDRESS 0xd0004e34 FORMAT "%7.2" /end MEASUREMENT
/begin CHARACTERISTIC c_open_min_act_egr_nox_cor_s "minimum opening to consider the EGR valve acting for NOx emission in statified operation" VALUE 0xa1029718 _REC_VAL_20_u1 99.609375 _CNV_A_R_LINEAR_____5_CM 0. 99.609375 DISPLAY_IDENTIFIER C_OPEN_MIN_ACT_EGR_NOX_COR_S FORMAT "%4.1" /end CHARACTERISTIC
/begin CHARACTERISTIC c_amp_bas_nox_s "basis ambient pressure for NOx engine out emission model" VALUE 0xa1029188 _REC_VAL_20_u2 5434. _CNV_A_R_LINEAR_____26_CM 0. 5434. DISPLAY_IDENTIFIER C_AMP_BAS_NOX_S FORMAT "%7.2" /end CHARACTERISTIC
/begin AXIS_PTS ldpm_n_32_1_nox_s "" 0xa1021d98 n_32 _REC_AXS_20_u1 8160. _CNV_A_R_LINEAR_____9_CM 8 0. 8160. FORMAT "%4.0" /end AXIS_PTS
/begin CHARACTERISTIC ip_egr_ratio_bas_nox_cor_mdl "NOx engine out basis of EGR ratio in stratified operation" MAP 0xa1023370 _REC_MAP_20_u2_u1_u2 99.99847412109381 _CNV_A_R_LINEAR_____7_CM 0. 99.99847412109381 DISPLAY_IDENTIFIER IP_EGR_RATIO_BAS_NOX_COR_MDL
 /begin AXIS_DESCR COM_AXIS n_32 _CNV_A_R_LINEAR_____9_CM 8 0. 8160. FORMAT "%4.0" AXIS_PTS_REF ldpm_n_32_1_nox_s /end AXIS_DESCR
 /begin AXIS_DESCR COM_AXIS mff_sp_s _CNV_A_R_LINEAR_____108_CM 8 0. 1389. FORMAT "%7.2" AXIS_PTS_REF ldpm_mff_sp_s_2_nox_s /end AXIS_DESCR
/end CHARACTERISTIC
/begin CHARACTERISTIC ip_nox_s "NOx engine out base emission in stratified operation" MAP 0xa1026814 _REC_MAP_20_u2_u2_u1 1023.984375 _CNV_A_R_LINEAR_____492_CM 0. 1023.984375 DISPLAY_IDENTIFIER IP_NOX_S FORMAT "%7.2"
 /begin AXIS_DESCR COM_AXIS mff_sp_s _CNV_A_R_LINEAR_____108_CM 8 0. 1389. FORMAT "%7.2" AXIS_PTS_REF ldpm_mff_sp_s_2_nox_s /end AXIS_DESCR
 /begin AXIS_DESCR COM_AXIS n_32 _CNV_A_R_LINEAR_____9_CM 8 0. 8160. FORMAT "%4.0" AXIS_PTS_REF ldpm_n_32_1_nox_s /end AXIS_DESCR
/end CHARACTERISTIC
/begin CHARACTERISTIC ip_nox_egr_ratio_dif_s "engine out NOx emission correction due to EGR ratio deviation" MAP 0xa10265b0 _REC_MAP_20_u2_u2_u2 1.99996948242188 _CNV_A_R_LINEAR_____8_CM 0. 1.99996948242188 DISPLAY_IDENTIFIER IP_NOX_EGR_RATIO_DIF_S FORMAT "%7.5"
 /begin AXIS_DESCR COM_AXIS pq_egr _CNV_A_R_LINEAR_____68_CM 8 0. 0.9999847412109381 FORMAT "%7.5" AXIS_PTS_REF ldpm_pq_egr_nox_s /end AXIS_DESCR
 /begin AXIS_DESCR COM_AXIS egr_ratio _CNV_A_R_LINEAR_____7_CM 8 0. 99.99847412109381 AXIS_PTS_REF ldp_egr_ratio_nox_s /end AXIS_DESCR
/end CHARACTERISTIC
/begin CHARACTERISTIC ip_nox_tco_s_egr_close "engine out NOx emission correction due to cooling water temperature" MAP 0xa1026a14 _REC_MAP_20_u2_u1_u2 1.99996948242188 _CNV_A_R_LINEAR_____8_CM 0. 1.99996948242188 DISPLAY_IDENTIFIER IP_NOX_TCO_S_EGR_CLOSE FORMAT "%7.5"
 /begin AXIS_DESCR COM_AXIS tco _CNV_A_R_LINEAR_____16_CM 4 -48. 142.5 FORMAT "%5.1" AXIS_PTS_REF ldpm_tco_dif_nox_s_nox_s /end AXIS_DESCR
 /begin AXIS_DESCR COM_AXIS map_dif_nox_s _CNV_A_R_LINEAR_____26_CM 8 0. 5434. FORMAT "%7.2" AXIS_PTS_REF ldpm_map_dif_nox_s_nox_s /end AXIS_DESCR
/end CHARACTERISTIC
/begin AXIS_PTS ldpm_mff_sp_s_2_nox_s "" 0xa1021cc8 mff_sp_s _REC_AXS_20_u2 1389. _CNV_A_R_LINEAR_____108_CM 8 0. 1389. FORMAT "%7.2" /end AXIS_PTS
/begin AXIS_PTS ldp_tco_nox_tco_s_egr_close "" 0xa10212b8 tco _REC_AXS_20_u1 190.5 _CNV_A_R_LINEAR_____16_CM 4 -48. 142.5 FORMAT "%5.1" /end AXIS_PTS
/begin AXIS_PTS ldpm_tia_2_nox_tia_s "" 0xa102230e tia _REC_AXS_20_u1 190.5 _CNV_A_R_LINEAR_____16_CM 4 -48. 142.5 FORMAT "%5.1" /end AXIS_PTS
/begin CHARACTERISTIC ip_nox_tia_s "Engine out NOx emission correction due to intake air temperature" MAP 0xa1026a5c _REC_MAP_20_u2_u1_u1 1.99996948242188 _CNV_A_R_LINEAR_____8_CM 0. 1.99996948242188 DISPLAY_IDENTIFIER IP_NOX_TIA_S FORMAT "%7.5"
 /begin AXIS_DESCR COM_AXIS tia _CNV_A_R_LINEAR_____16_CM 4 -48. 142.5 FORMAT "%5.1" AXIS_PTS_REF ldpm_tia_nox_s /end AXIS_DESCR
 /begin AXIS_DESCR COM_AXIS n_32 _CNV_A_R_LINEAR_____9_CM 8 0. 8160. FORMAT "%4.0" AXIS_PTS_REF ldpm_n_32_1_nox_s /end AXIS_DESCR
/end CHARACTERISTIC
/begin CHARACTERISTIC ip_nox_tia_s_egr_close "Engine out NOx emission correction due to intake air temperature at closed EGR valve" MAP 0xa1026a9c _REC_MAP_20_u2_u1_u1 4. _CNV_A_R_LINEAR_____256_CM 0. 4. DISPLAY_IDENTIFIER IP_NOX_TIA_S_EGR_CLOSE FORMAT "%6.4"
 /begin AXIS_DESCR COM_AXIS tia _CNV_A_R_LINEAR_____16_CM 4 -48. 142.5 FORMAT "%5.1" AXIS_PTS_REF ldpm_tia_nox_s /end AXIS_DESCR
 /begin AXIS_DESCR COM_AXIS n_32 _CNV_A_R_LINEAR_____9_CM 8 0. 8160. FORMAT "%4.0" AXIS_PTS_REF ldpm_n_32_1_nox_s /end AXIS_DESCR
/end CHARACTERISTIC
/begin AXIS_PTS ldp_fac_maf_max "" 0xa1020990 fac_maf_max _REC_AXS_20_u2 1.99996948242188 _CNV_A_R_LINEAR_____8_CM 4 0. 1.99996948242188 FORMAT "%7.5" /end AXIS_PTS
/begin CHARACTERISTIC ip_fac_maf_max "Engine out NOx emission correction due to the throttle factor" CURVE 0xa1023b18 _REC_CUR_20_u2_u2 1.99996948242188 _CNV_A_R_LINEAR_____8_CM 0. 1.99996948242188 DISPLAY_IDENTIFIER IP_FAC_MAF_MAX FORMAT "%7.5"
 /begin AXIS_DESCR COM_AXIS fac_maf_max _CNV_A_R_LINEAR_____8_CM 4 0. 1.99996948242188 FORMAT "%7.5" AXIS_PTS_REF ldp_fac_maf_max /end AXIS_DESCR
/end CHARACTERISTIC
/begin CHARACTERISTIC ip_nox_s_egr_close "NOx engine out base emission in stratified operation with closed EGR" MAP 0xa1026894 _REC_MAP_20_u2_u2_u1 1023.984375 _CNV_A_R_LINEAR_____492_CM 0. 1023.984375 DISPLAY_IDENTIFIER IP_NOX_S_EGR_CLOSE FORMAT "%7.2"
 /begin AXIS_DESCR COM_AXIS mff_sp_s _CNV_A_R_LINEAR_____108_CM 8 0. 1389. FORMAT "%7.2" AXIS_PTS_REF ldpm_mff_sp_s_2_nox_s /end AXIS_DESCR
 /begin AXIS_DESCR COM_AXIS n_32 _CNV_A_R_LINEAR_____9_CM 8 0. 8160. FORMAT "%4.0" AXIS_PTS_REF ldpm_n_32_1_nox_s /end AXIS_DESCR
/end CHARACTERISTIC
/begin CHARACTERISTIC ip_nox_map_dif_s "engine out NOx emission correction due to ambient pressure deviation" MAP 0xa1026710 _REC_MAP_20_u2_u2_u2 1.99996948242188 _CNV_A_R_LINEAR_____8_CM 0. 1.99996948242188 DISPLAY_IDENTIFIER IP_NOX_MAP_DIF_S FORMAT "%7.5"
 /begin AXIS_DESCR COM_AXIS pq_egr _CNV_A_R_LINEAR_____68_CM 8 0. 0.9999847412109381 FORMAT "%7.5" AXIS_PTS_REF ldpm_pq_egr_nox_s /end AXIS_DESCR
 /begin AXIS_DESCR COM_AXIS map_dif_nox_s _CNV_A_R_LINEAR_____26_CM 8 0. 5434. FORMAT "%7.2" AXIS_PTS_REF ldpm_map_dif_nox_s_nox_s /end AXIS_DESCR
/end CHARACTERISTIC
/begin CHARACTERISTIC lc_rpu_nox_cor_s "Switch to use RPU value of NOX_COR_S" VALUE 0xa1029dca _REC_VAL_20_u1 1. _CNV_A_R_LINEAR_____0_CM 0. 1. DISPLAY_IDENTIFIER LC_RPU_NOX_COR_S FORMAT "%1.0" /end CHARACTERISTIC
/begin MEASUREMENT tco_dif_nox_s "Cooling water temperature difference to basis cooling temperature of the model" UBYTE _CNV_A_R_LINEAR_____16_CM 1 100. -48. 142.5 DISPLAY_IDENTIFIER TCO_DIF_NOX_S ECU_ADDRESS 0xc0000ab0 FORMAT "%6.2" /end MEASUREMENT
/begin CHARACTERISTIC c_tco_bas_nox_s "Basis cooling water temperature for NOx engine out emission model" VALUE 0xa10299ca _REC_VAL_20_u1 190.5 _CNV_A_R_LINEAR_____16_CM -48. 142.5 DISPLAY_IDENTIFIER C_TCO_BAS_NOX_S FORMAT "%6.2" /end CHARACTERISTIC
/begin AXIS_PTS ldpm_pq_egr_nox_s "" 0xa10221a4 pq_egr _REC_AXS_20_u2 0.9999847412109381 _CNV_A_R_LINEAR_____68_CM 8 0. 0.9999847412109381 FORMAT "%7.5" /end AXIS_PTS
/begin AXIS_PTS ldpm_tco_dif_nox_s_nox_s "" 0xa1022280 tco _REC_AXS_20_u1 190.5 _CNV_A_R_LINEAR_____16_CM 4 -48. 142.5 FORMAT "%5.1" /end AXIS_PTS
/begin AXIS_PTS ldpm_tia_nox_s "" 0xa1022320 tia _REC_AXS_20_u1 190.5 _CNV_A_R_LINEAR_____16_CM 4 -48. 142.5 FORMAT "%5.1" /end AXIS_PTS
/begin AXIS_PTS ldpm_map_dif_nox_s_nox_s "" 0xa1021c88 map_dif_nox_s _REC_AXS_20_u2 5434. _CNV_A_R_LINEAR_____26_CM 8 0. 5434. FORMAT "%7.2" /end AXIS_PTS
/begin AXIS_PTS ldp_egr_ratio_nox_s "" 0xa102092c egr_ratio _REC_AXS_20_u2 99.99847412109381 _CNV_A_R_LINEAR_____7_CM 8 0. 99.99847412109381 /end AXIS_PTS
/begin MEASUREMENT nox_cor_s_tmp_1 "Corrected engine out NOx emission in stratified operation mode (intermediate)" ULONG _CNV_A_R_LINEAR_____492_CM 1 100. 0. 16383.984375 DISPLAY_IDENTIFIER NOX_COR_S_TMP_1 ECU_ADDRESS 0xc0000aa8 FORMAT "%8.2" /end MEASUREMENT
/begin MEASUREMENT nox_cor_s_tmp_2 "Corrected engine out NOx emission in stratified operation mode (intermediate)" ULONG _CNV_A_R_LINEAR_____492_CM 1 100. 0. 32767.984375 DISPLAY_IDENTIFIER NOX_COR_S_TMP_2 ECU_ADDRESS 0xc0000aac FORMAT "%8.2" /end MEASUREMENT
/begin CHARACTERISTIC ip_nox_map_dif_s_egr_close "engine out NOx emission correction due to ambient pressure deviation with closed EGR" MAP 0xa1026790 _REC_MAP_20_u2_u2_u2 1.99996948242188 _CNV_A_R_LINEAR_____8_CM 0. 1.99996948242188 DISPLAY_IDENTIFIER IP_NOX_MAP_DIF_S_EGR_CLOSE FORMAT "%7.5"
 /begin AXIS_DESCR COM_AXIS pq_egr _CNV_A_R_LINEAR_____68_CM 8 0. 0.9999847412109381 FORMAT "%7.5" AXIS_PTS_REF ldpm_pq_egr_nox_s /end AXIS_DESCR
 /begin AXIS_DESCR COM_AXIS map_dif_nox_s _CNV_A_R_LINEAR_____26_CM 8 0. 5434. FORMAT "%7.2" AXIS_PTS_REF ldpm_map_dif_nox_s_nox_s /end AXIS_DESCR
/end CHARACTERISTIC
/begin CHARACTERISTIC ip_nox_tco_s "engine out NOx emission correction due to cooling water temperature" MAP 0xa10269d4 _REC_MAP_20_u2_u1_u2 1.99996948242188 _CNV_A_R_LINEAR_____8_CM 0. 1.99996948242188 DISPLAY_IDENTIFIER IP_NOX_TCO_S FORMAT "%7.5"
 /begin AXIS_DESCR COM_AXIS tco _CNV_A_R_LINEAR_____16_CM 4 -48. 142.5 FORMAT "%5.1" AXIS_PTS_REF ldpm_tco_dif_nox_s_nox_s /end AXIS_DESCR
 /begin AXIS_DESCR COM_AXIS map_dif_nox_s _CNV_A_R_LINEAR_____26_CM 8 0. 5434. FORMAT "%7.2" AXIS_PTS_REF ldpm_map_dif_nox_s_nox_s /end AXIS_DESCR
/end CHARACTERISTIC
/begin CHARACTERISTIC lc_inh_ch_so2p_man "switch for manual inhibition of catalyst heating for desulfation" VALUE 0xa1029d47 _REC_VAL_20_u1 1. _CNV_A_R_LINEAR_____0_CM 0. 1. DISPLAY_IDENTIFIER LC_INH_CH_SO2P_MAN FORMAT "%2.0" /end CHARACTERISTIC
/begin CHARACTERISTIC lc_inh_ch_so2p_off "switch for forcing the inhibition of desulfation catalyst heating to be deactivated" VALUE 0xa1029d48 _REC_VAL_20_u1 1. _CNV_A_R_LINEAR_____0_CM 0. 1. DISPLAY_IDENTIFIER LC_INH_CH_SO2P_OFF FORMAT "%2.0" /end CHARACTERISTIC
/begin MEASUREMENT lv_inh_ch_so2p "flag inhibiting the catalyst heating for desulfation" UBYTE _CNV_S_2_RANGE__0___1_CM 1 100. 0. 1. DISPLAY_IDENTIFIER LV_INH_CH_SO2P ECU_ADDRESS 0xd0003af0 BIT_MASK 0x1 /end MEASUREMENT
/begin MEASUREMENT lv_so2p_req "request for the activation of a desulfation (to comb. manager and to desulf. lamb. coord.)" UBYTE _CNV_S_2_RANGE__0___1_CM 1 100. 0. 1. DISPLAY_IDENTIFIER LV_SO2P_REQ ECU_ADDRESS 0xd0003aa0 BIT_MASK 0x1 /end MEASUREMENT
/begin MEASUREMENT lv_so2p_fast_req "request of a fast desulfation (instead of an alternating desulfation)" UBYTE _CNV_S_2_RANGE__0___1_CM 1 100. 0. 1. DISPLAY_IDENTIFIER LV_SO2P_FAST_REQ ECU_ADDRESS 0xd0003aa1 BIT_MASK 0x1 /end MEASUREMENT
/begin MEASUREMENT lv_so2p_lamb_puls "flag to be passed to the lambda stimulation coordination" UBYTE _CNV_S_2_RANGE__0___1_CM 1 100. 0. 1. DISPLAY_IDENTIFIER LV_SO2P_LAMB_PULS ECU_ADDRESS 0xd0003aa2 BIT_MASK 0x1 /end MEASUREMENT
/begin MEASUREMENT lv_so2p_act "NOx trap desulfation active" UBYTE _CNV_S_2_RANGE__0___1_CM 1 100. 0. 1. DISPLAY_IDENTIFIER LV_SO2P_ACT ECU_ADDRESS 0xd0003aa3 BIT_MASK 0x1 /end MEASUREMENT
/begin MEASUREMENT lv_so2p_afr_cord "flag to be passed to catalyst heating manager: rich operation requested" UBYTE _CNV_S_2_RANGE__0___1_CM 1 100. 0. 1. DISPLAY_IDENTIFIER LV_SO2P_AFR_CORD ECU_ADDRESS 0xd0003aa4 BIT_MASK 0x1 /end MEASUREMENT
/begin MEASUREMENT t_so2p_not "time counter for non-desulfation athmosphere" UWORD _CNV_A_R_LINEAR_____4_CM 1 100. 0. 6553.5 DISPLAY_IDENTIFIER T_SO2P_NOT ECU_ADDRESS 0xd0004e5c FORMAT "%6.1" /end MEASUREMENT
/begin MEASUREMENT t_so2p_dly "delay time counter before sulfur release" UWORD _CNV_A_R_LINEAR_____4_CM 1 100. 0. 6553.5 DISPLAY_IDENTIFIER T_SO2P_DLY ECU_ADDRESS 0xd0004e5e FORMAT "%6.1" /end MEASUREMENT
/begin MEASUREMENT lamb_so2p "lambda setpoint for desulfation" UWORD _CNV_A_R_LINEAR_____122_CM 1 100. 0. 31.9990234375 DISPLAY_IDENTIFIER LAMB_SO2P ECU_ADDRESS 0xd0004e60 FORMAT "%7.4" /end MEASUREMENT
/begin CHARACTERISTIC c_tnt_mdl_so2p_min "NOx trap monolith temperature threshold for SO2 purge possible" VALUE 0xa1029a7c _REC_VAL_20_u1 1020. _CNV_A_R_LINEAR_____490_CM 0. 1020. DISPLAY_IDENTIFIER C_TNT_MDL_SO2P_MIN FORMAT "%4.0" /end CHARACTERISTIC
/begin CHARACTERISTIC c_tnt_mdl_so2p_hys "NOx trap monolith temperature hysteresis for SO2 purge deactivation" VALUE 0xa1029a7b _REC_VAL_20_u1 1020. _CNV_A_R_LINEAR_____490_CM 0. 1020. DISPLAY_IDENTIFIER C_TNT_MDL_SO2P_HYS FORMAT "%4.0" /end CHARACTERISTIC
/begin CHARACTERISTIC c_tnt_mdl_so2p_fast "NOx trap temperature threshold for switching to fast desulfation" VALUE 0xa1029a79 _REC_VAL_20_u1 1020. _CNV_A_R_LINEAR_____490_CM 0. 1020. DISPLAY_IDENTIFIER C_TNT_MDL_SO2P_FAST FORMAT "%4.0" /end CHARACTERISTIC
/begin CHARACTERISTIC c_tnt_mdl_so2p_fast_hys "NOx trap temperature hysteresis for switching back to alternating desulfation" VALUE 0xa1029a7a _REC_VAL_20_u1 1020. _CNV_A_R_LINEAR_____490_CM 0. 1020. DISPLAY_IDENTIFIER C_TNT_MDL_SO2P_FAST_HYS FORMAT "%4.0" /end CHARACTERISTIC
/begin CHARACTERISTIC c_lamb_so2p "lambda threshold for SO2 purge active" VALUE 0xa10294fe _REC_VAL_20_u2 31.9990234375 _CNV_A_R_LINEAR_____122_CM 0. 31.9990234375 DISPLAY_IDENTIFIER C_LAMB_SO2P FORMAT "%7.4" /end CHARACTERISTIC
/begin CHARACTERISTIC c_lamb_so2p_hys "lambda hysteresis for SO2 purge active detection" VALUE 0xa1029500 _REC_VAL_20_u2 31.9990234375 _CNV_A_R_LINEAR_____122_CM 0. 31.9990234375 DISPLAY_IDENTIFIER C_LAMB_SO2P_HYS FORMAT "%7.4" /end CHARACTERISTIC
/begin CHARACTERISTIC c_t_so2p_not_max "maximum time for desulfation interruption before desulfation timer reset" VALUE 0xa102995e _REC_VAL_20_u2 6553.5 _CNV_A_R_LINEAR_____4_CM 0. 6553.5 DISPLAY_IDENTIFIER C_T_SO2P_NOT_MAX FORMAT "%6.1" /end CHARACTERISTIC
/begin CHARACTERISTIC c_nt_agi_so2p_max "max. NOx trap aging factor (incremented by desulfation)" VALUE 0xa10296d8 _REC_VAL_20_u2 0.9999847412109381 _CNV_A_R_LINEAR_____68_CM 0. 0.9999847412109381 DISPLAY_IDENTIFIER C_NT_AGI_SO2P_MAX FORMAT "%7.5" /end CHARACTERISTIC
/begin CHARACTERISTIC c_vs_so2p_fast_thd "vehicle speed threshold for switching to fast desulfation" VALUE 0xa1029ccf _REC_VAL_20_u1 255. _CNV_A_R_LINEAR_____6_CM 0. 255. DISPLAY_IDENTIFIER C_VS_SO2P_FAST_THD FORMAT "%3.0" /end CHARACTERISTIC
/begin CHARACTERISTIC c_vs_so2p_fast_hys "vehicle speed hysteresis for switching back to alternating desulfation" VALUE 0xa1029cce _REC_VAL_20_u1 255. _CNV_A_R_LINEAR_____6_CM 0. 255. DISPLAY_IDENTIFIER C_VS_SO2P_FAST_HYS FORMAT "%3.0" /end CHARACTERISTIC
/begin CHARACTERISTIC lc_so2p_fast_man "logical constant for manual switch to fast desulfation mode " VALUE 0xa1029dd6 _REC_VAL_20_u1 1. _CNV_A_R_LINEAR_____0_CM 0. 1. DISPLAY_IDENTIFIER LC_SO2P_FAST_MAN FORMAT "%1.0" /end CHARACTERISTIC
/begin CHARACTERISTIC c_lamb_so2p_pas "passive lambda request value" VALUE 0xa1029502 _REC_VAL_20_u2 31.9990234375 _CNV_A_R_LINEAR_____122_CM 0. 31.9990234375 DISPLAY_IDENTIFIER C_LAMB_SO2P_PAS FORMAT "%7.4" /end CHARACTERISTIC
/begin AXIS_PTS ldp_tnt_mdl_mv__lamb_so2p "" 0xa10213a0 tnt_mdl_mv _REC_AXS_20_u2 1023.984375 _CNV_A_R_LINEAR_____197_CM 8 0. 1023.984375 FORMAT "%7.2" /end AXIS_PTS
/begin CHARACTERISTIC ip_lamb_so2p "required lambda during desulfation" CURVE 0xa10260b0 _REC_CUR_20_u2_u2 31.9990234375 _CNV_A_R_LINEAR_____122_CM 0. 31.9990234375 DISPLAY_IDENTIFIER IP_LAMB_SO2P FORMAT "%7.4"
 /begin AXIS_DESCR COM_AXIS tnt_mdl_mv _CNV_A_R_LINEAR_____197_CM 8 0. 1023.984375 FORMAT "%7.2" AXIS_PTS_REF ldp_tnt_mdl_mv__lamb_so2p /end AXIS_DESCR
/end CHARACTERISTIC
/begin CHARACTERISTIC c_nt_sul_so2p_max "max. NOx trap sulphur load out of sulphur model" VALUE 0xa10296f4 _REC_VAL_20_u2 10485.6 _CNV_A_R_LINEAR_____495_CM 0. 10485.6 DISPLAY_IDENTIFIER C_NT_SUL_SO2P_MAX FORMAT "%7.1" /end CHARACTERISTIC
/begin AXIS_PTS ldp_tnt_mdl_mv_ip_vs_so2p_fast "" 0xa10213ea tnt_mdl_mv _REC_AXS_20_u1 1020. _CNV_A_R_LINEAR_____490_CM 4 0. 1020. FORMAT "%4.0" /end AXIS_PTS
/begin CHARACTERISTIC ip_vs_so2p_fast_thd "vehicle speed threshold for switching to fast desulation according to TNT_MDL_MV" CURVE 0xa1029028 _REC_CUR_20_u1_u1 255. _CNV_A_R_LINEAR_____6_CM 0. 255. DISPLAY_IDENTIFIER IP_VS_SO2P_FAST_THD FORMAT "%3.0"
 /begin AXIS_DESCR COM_AXIS tnt_mdl_mv _CNV_A_R_LINEAR_____490_CM 4 0. 1020. FORMAT "%4.0" AXIS_PTS_REF ldp_tnt_mdl_mv_ip_vs_so2p_fast /end AXIS_DESCR
/end CHARACTERISTIC
/begin CHARACTERISTIC c_tnt_mdl_so2p_min_delta "NOx trap monolith temperature delta to threshold" VALUE 0xa1029a7d _REC_VAL_20_u1 1020. _CNV_A_R_LINEAR_____490_CM 0. 1020. DISPLAY_IDENTIFIER C_TNT_MDL_SO2P_MIN_DELTA FORMAT "%4.0" /end CHARACTERISTIC
/begin MEASUREMENT lv_so2p_act_lamb_1 "NOx trap desulfation lambda condition fulfilled" UBYTE _CNV_S_2_RANGE__0___1_CM 1 100. 0. 1. DISPLAY_IDENTIFIER LV_SO2P_ACT_LAMB_1 ECU_ADDRESS 0xd0003aa6 BIT_MASK 0x1 /end MEASUREMENT
/begin MEASUREMENT lv_so2p_act_lamb_2 "NOx trap desulfation lambda condition fulfilled" UBYTE _CNV_S_2_RANGE__0___1_CM 1 100. 0. 1. DISPLAY_IDENTIFIER LV_SO2P_ACT_LAMB_2 ECU_ADDRESS 0xd0003aa7 BIT_MASK 0x1 /end MEASUREMENT
/begin MEASUREMENT lv_so2p_act_tnt "NOx trap desulfation temperature condition fulfilled" UBYTE _CNV_S_2_RANGE__0___1_CM 1 100. 0. 1. DISPLAY_IDENTIFIER LV_SO2P_ACT_TNT ECU_ADDRESS 0xd0003aa5 BIT_MASK 0x1 /end MEASUREMENT
/begin AXIS_PTS ldp_lamb_vls_down_ref "" 0xa1020c3c NO_INPUT_QUANTITY _REC_AXS_20_u2 31.9990234375 _CNV_A_R_LINEAR_____122_CM 8 0. 31.9990234375 FORMAT "%7.4" /end AXIS_PTS
/begin CHARACTERISTIC c_vls_down_ref_so2p "LS reference signal at downstream position set manually" VALUE 0xa1029c40 _REC_VAL_20_u2 4.995 _CNV_A_R_LINEAR_____218_CM 0. 4.995 DISPLAY_IDENTIFIER C_VLS_DOWN_REF_SO2P FORMAT "%5.3" /end CHARACTERISTIC
/begin CHARACTERISTIC c_vls_down_so2p_min "VLS threshold for SO2 purge active" VALUE 0xa1029c44 _REC_VAL_20_u2 4.995 _CNV_A_R_LINEAR_____218_CM 0. 4.995 DISPLAY_IDENTIFIER C_VLS_DOWN_SO2P_MIN FORMAT "%5.3" /end CHARACTERISTIC
/begin CHARACTERISTIC c_vls_down_so2p_hys "VLS hysteresis for SO2 purge active detection" VALUE 0xa1029c42 _REC_VAL_20_u2 4.995 _CNV_A_R_LINEAR_____218_CM 0. 4.995 DISPLAY_IDENTIFIER C_VLS_DOWN_SO2P_HYS FORMAT "%5.3" /end CHARACTERISTIC
/begin CHARACTERISTIC c_state_sens_vls_down_so2p_act_1 "Mode to determine the sensor used for detection of a desulfating atmosphere" VALUE 0xa10297c7 _REC_VAL_20_u1 5. _CNV_A_R_LINEAR_____0_CM 0. 5. DISPLAY_IDENTIFIER C_STATE_SENS_VLS_DOWN_SO2P_ACT_1 FORMAT "%2.0" /end CHARACTERISTIC
/begin CHARACTERISTIC c_state_sens_vls_down_so2p_act_2 "Mode to determine the sensor used for detection of a desulfating atmosphere" VALUE 0xa10297c8 _REC_VAL_20_u1 5. _CNV_A_R_LINEAR_____0_CM 0. 5. DISPLAY_IDENTIFIER C_STATE_SENS_VLS_DOWN_SO2P_ACT_2 FORMAT "%2.0" /end CHARACTERISTIC
/begin CHARACTERISTIC ip_lamb_vls_down_ref "Scaling map for Lambdasensor to VLS_DOWN" CURVE 0xa10260c0 _REC_CUR_20_u2_u2 4.995 _CNV_A_R_LINEAR_____218_CM 0. 4.995 DISPLAY_IDENTIFIER IP_LAMB_VLS_DOWN_REF FORMAT "%5.3"
 /begin AXIS_DESCR COM_AXIS NO_INPUT_QUANTITY _CNV_A_R_LINEAR_____122_CM 8 0. 31.9990234375 FORMAT "%7.4" AXIS_PTS_REF ldp_lamb_vls_down_ref /end AXIS_DESCR
/end CHARACTERISTIC
/begin MEASUREMENT lv_trig_afr_afl "Logical value for triggering a transition of rich to lean operation" UBYTE _CNV_S_2_RANGE__0___1_CM 1 100. 0. 1. DISPLAY_IDENTIFIER LV_TRIG_AFR_AFL ECU_ADDRESS 0xd0003ab0 BIT_MASK 0x1 /end MEASUREMENT
/begin MEASUREMENT lv_rgn_nt_req "logical value for regeneration phase request" UBYTE _CNV_S_2_RANGE__0___1_CM 1 100. 0. 1. DISPLAY_IDENTIFIER LV_RGN_NT_REQ ECU_ADDRESS 0xd0003aac BIT_MASK 0x1 /end MEASUREMENT
/begin MEASUREMENT lv_nt_afs_req "request of lambda = 1 operation mode" UBYTE _CNV_S_2_RANGE__0___1_CM 1 100. 0. 1. DISPLAY_IDENTIFIER LV_NT_AFS_REQ ECU_ADDRESS 0xd0003aad BIT_MASK 0x1 /end MEASUREMENT
/begin MEASUREMENT lv_rgn_agi_1 "flag used for communication with aging function" UBYTE _CNV_S_2_RANGE__0___1_CM 1 100. 0. 1. DISPLAY_IDENTIFIER LV_RGN_AGI_1 ECU_ADDRESS 0xd0003ac4 BIT_MASK 0x1 /end MEASUREMENT
/begin MEASUREMENT lv_rgn_agi_2 "flag used for communication with aging function" UBYTE _CNV_S_2_RANGE__0___1_CM 1 100. 0. 1. DISPLAY_IDENTIFIER LV_RGN_AGI_2 ECU_ADDRESS 0xd0003ac5 BIT_MASK 0x1 /end MEASUREMENT
/begin MEASUREMENT lv_rgn_agi_vld_1 "flag used for communication with aging function" UBYTE _CNV_S_2_RANGE__0___1_CM 1 100. 0. 1. DISPLAY_IDENTIFIER LV_RGN_AGI_VLD_1 ECU_ADDRESS 0xd0003ac6 BIT_MASK 0x1 /end MEASUREMENT
/begin MEASUREMENT lv_rgn_agi_vld_2 "flag used for communication with aging function" UBYTE _CNV_S_2_RANGE__0___1_CM 1 100. 0. 1. DISPLAY_IDENTIFIER LV_RGN_AGI_VLD_2 ECU_ADDRESS 0xd0003ac7 BIT_MASK 0x1 /end MEASUREMENT
/begin MEASUREMENT lv_nox_sens_rgn "regeneration request only due to NOx sensor (loading model blocked)" UBYTE _CNV_S_2_RANGE__0___1_CM 1 100. 0. 1. DISPLAY_IDENTIFIER LV_NOX_SENS_RGN ECU_ADDRESS 0xd0003aaf BIT_MASK 0x1 /end MEASUREMENT
/begin MEASUREMENT lv_nox_sens "logical value for the existence of a NOx sensor" UBYTE _CNV_S_2_RANGE__0___1_CM 1 100. 0. 1. DISPLAY_IDENTIFIER LV_NOX_SENS ECU_ADDRESS 0xd0003aae BIT_MASK 0x1 /end MEASUREMENT
/begin MEASUREMENT lv_afl_not "logical value: lambda=1 or richer operation is requested or active" UBYTE _CNV_S_2_RANGE__0___1_CM 1 100. 0. 1. DISPLAY_IDENTIFIER LV_AFL_NOT ECU_ADDRESS 0xd0003ab1 BIT_MASK 0x1 /end MEASUREMENT
/begin MEASUREMENT lv_rgn_stop_sens "flag indicating: Stop of Rgn by sensor enabled" UBYTE _CNV_S_2_RANGE__0___1_CM 1 100. 0. 1. DISPLAY_IDENTIFIER LV_RGN_STOP_SENS ECU_ADDRESS 0xd0003ab2 BIT_MASK 0x1 /end MEASUREMENT
/begin MEASUREMENT lv_rgn_stop_tout "flag indicating: Stop of Rgn by time counter enabled" UBYTE _CNV_S_2_RANGE__0___1_CM 1 100. 0. 1. DISPLAY_IDENTIFIER LV_RGN_STOP_TOUT ECU_ADDRESS 0xd0003ab4 BIT_MASK 0x1 /end MEASUREMENT
/begin MEASUREMENT lv_rgn_stop_mdl "flag indicating: Stop of Rgn out of model enabled" UBYTE _CNV_S_2_RANGE__0___1_CM 1 100. 0. 1. DISPLAY_IDENTIFIER LV_RGN_STOP_MDL ECU_ADDRESS 0xd0003ab3 BIT_MASK 0x1 /end MEASUREMENT
/begin MEASUREMENT lv_rgn_req_ntld "logical value for regeneration phase request because of the NOx trap loading degree" UBYTE _CNV_S_2_RANGE__0___1_CM 1 100. 0. 1. DISPLAY_IDENTIFIER LV_RGN_REQ_NTLD ECU_ADDRESS 0xd0003ab5 BIT_MASK 0x1 /end MEASUREMENT
/begin MEASUREMENT lv_rgn_req_nox_sens "regeneration request caused by the NOx sensor signal" UBYTE _CNV_S_2_RANGE__0___1_CM 1 100. 0. 1. DISPLAY_IDENTIFIER LV_RGN_REQ_NOX_SENS ECU_ADDRESS 0xd0003ab7 BIT_MASK 0x1 /end MEASUREMENT
/begin MEASUREMENT lv_rgn_req_ntld_afs "logical value for regeneration phase request before switching to stoichiometric operation or rich operation" UBYTE _CNV_S_2_RANGE__0___1_CM 1 100. 0. 1. DISPLAY_IDENTIFIER LV_RGN_REQ_NTLD_AFS ECU_ADDRESS 0xd0003ab6 BIT_MASK 0x1 /end MEASUREMENT
/begin MEASUREMENT lv_act_int_puc_afl_1 "request for catalyst purge activation when leaving lean burn condition" UBYTE _CNV_S_2_RANGE__0___1_CM 1 100. 0. 1. DISPLAY_IDENTIFIER LV_ACT_INT_PUC_AFL_1 ECU_ADDRESS 0xd0003aca BIT_MASK 0x1 /end MEASUREMENT
/begin MEASUREMENT lv_act_int_puc_afl_2 "request for catalyst purge activation when leaving lean burn condition" UBYTE _CNV_S_2_RANGE__0___1_CM 1 100. 0. 1. DISPLAY_IDENTIFIER LV_ACT_INT_PUC_AFL_2 ECU_ADDRESS 0xd0003acb BIT_MASK 0x1 /end MEASUREMENT
/begin MEASUREMENT lv_sens_afr_1 "downstream sensor sees rich exhaust gas (stop of regeneration)" UBYTE _CNV_S_2_RANGE__0___1_CM 1 100. 0. 1. DISPLAY_IDENTIFIER LV_SENS_AFR_1 ECU_ADDRESS 0xd0003acc BIT_MASK 0x1 /end MEASUREMENT
/begin MEASUREMENT lv_sens_afr_2 "downstream sensor sees rich exhaust gas (stop of regeneration)" UBYTE _CNV_S_2_RANGE__0___1_CM 1 100. 0. 1. DISPLAY_IDENTIFIER LV_SENS_AFR_2 ECU_ADDRESS 0xd0003acd BIT_MASK 0x1 /end MEASUREMENT
/begin MEASUREMENT lv_sens_afr_trim "downstream sensor sees rich exhaust gas (homogeneous detection threshold)" UBYTE _CNV_S_2_RANGE__0___1_CM 1 100. 0. 1. DISPLAY_IDENTIFIER LV_SENS_AFR_TRIM ECU_ADDRESS 0xd0003ab8 BIT_MASK 0x1 /end MEASUREMENT
/begin MEASUREMENT lv_nt_hom_ini "flag: NOx trap initialised due to sufficient hom. stoic. operation (accumulation effects eliminated)" UBYTE _CNV_S_2_RANGE__0___1_CM 1 100. 0. 1. DISPLAY_IDENTIFIER LV_NT_HOM_INI ECU_ADDRESS 0xd0003ab9 BIT_MASK 0x1 /end MEASUREMENT
/begin MEASUREMENT lv_nox_sens_nox_vld_rgn_st_2 "flag: NOx sensor NOx signal validity at the moment the NOx sensor rgn request is set" UBYTE _CNV_S_2_RANGE__0___1_CM 1 100. 0. 1. DISPLAY_IDENTIFIER LV_NOX_SENS_NOX_VLD_RGN_ST_2 ECU_ADDRESS 0xd0003ad1 BIT_MASK 0x1 /end MEASUREMENT
/begin MEASUREMENT lv_t_afl_min "flag: minimum lean time for setting a request elapsed" UBYTE _CNV_S_2_RANGE__0___1_CM 1 100. 0. 1. DISPLAY_IDENTIFIER LV_T_AFL_MIN ECU_ADDRESS 0xd0003abf BIT_MASK 0x1 /end MEASUREMENT
/begin MEASUREMENT lv_mdl_afr "model rich exhaust gas (stop of regeneration)" UBYTE _CNV_S_2_RANGE__0___1_CM 1 100. 0. 1. DISPLAY_IDENTIFIER LV_MDL_AFR ECU_ADDRESS 0xd0003aba BIT_MASK 0x1 /end MEASUREMENT
/begin MEASUREMENT lv_tout_afr "rich exhaust gas after time out (stop of regeneration)" UBYTE _CNV_S_2_RANGE__0___1_CM 1 100. 0. 1. DISPLAY_IDENTIFIER LV_TOUT_AFR ECU_ADDRESS 0xd0003abb BIT_MASK 0x1 /end MEASUREMENT
/begin MEASUREMENT nox_conc_raw "NOx concentration engine out" UWORD _CNV_A_R_LINEAR_____499_CM 1 100. 0. 65535. DISPLAY_IDENTIFIER NOX_CONC_RAW ECU_ADDRESS 0xd0004e64 FORMAT "%5.0" /end MEASUREMENT
/begin MEASUREMENT nox_conc_red "corrected NOx concentration in catalyst (incl. SSR)" UWORD _CNV_A_R_LINEAR_____499_CM 1 100. 0. 65535. DISPLAY_IDENTIFIER NOX_CONC_RED ECU_ADDRESS 0xd0004e68 FORMAT "%5.0" /end MEASUREMENT
/begin MEASUREMENT nox_conc "NOx concentration engine out (after raw emission adaptation correction)" UWORD _CNV_A_R_LINEAR_____499_CM 1 100. 0. 65535. DISPLAY_IDENTIFIER NOX_CONC ECU_ADDRESS 0xd0004e66 FORMAT "%5.0" /end MEASUREMENT
/begin MEASUREMENT nox_conc_red_mmv_rgn_st "filtered corrected NOx concentration in catalyst (incl. SSR) at Rgn start" UWORD _CNV_A_R_LINEAR_____499_CM 1 100. 0. 65535. DISPLAY_IDENTIFIER NOX_CONC_RED_MMV_RGN_ST ECU_ADDRESS 0xd0004e6c FORMAT "%5.0" /end MEASUREMENT
/begin MEASUREMENT nox_conc_red_mmv "filtered corrected NOx concentration in catalyst (incl. SSR)" UWORD _CNV_A_R_LINEAR_____499_CM 1 100. 0. 65535. DISPLAY_IDENTIFIER NOX_CONC_RED_MMV ECU_ADDRESS 0xd0004e6a FORMAT "%5.0" /end MEASUREMENT
/begin MEASUREMENT nox_ppm_tmp_1 "temporary internal NOx sensor NOx value for regeneration request calculation" UWORD _CNV_A_R_LINEAR_____499_CM 1 100. 0. 1500. DISPLAY_IDENTIFIER NOX_PPM_TMP_1 ECU_ADDRESS 0xc0000af8 FORMAT "%4.0" /end MEASUREMENT
/begin MEASUREMENT nox_ppm_tmp_2 "temporary internal NOx sensor NOx value for regeneration request calculation" UWORD _CNV_A_R_LINEAR_____499_CM 1 100. 0. 1500. DISPLAY_IDENTIFIER NOX_PPM_TMP_2 ECU_ADDRESS 0xc0000afa FORMAT "%4.0" /end MEASUREMENT
/begin MEASUREMENT nox_sens_max "NOx sensor signal threshold for requesting a regeneration" UWORD _CNV_A_R_LINEAR_____499_CM 1 100. 0. 1500. DISPLAY_IDENTIFIER NOX_SENS_MAX ECU_ADDRESS 0xd0004e94 FORMAT "%4.0" /end MEASUREMENT
/begin MEASUREMENT nox_conc_mmv "filtered NOx concentration engine out concentration" UWORD _CNV_A_R_LINEAR_____499_CM 1 100. 0. 65535. DISPLAY_IDENTIFIER NOX_CONC_MMV ECU_ADDRESS 0xc0000ac4 FORMAT "%5.0" /end MEASUREMENT
/begin MEASUREMENT nox_conc_out_mdl "corrected NOx concentration after catalyst" UWORD _CNV_A_R_LINEAR_____499_CM 1 100. 0. 65535. DISPLAY_IDENTIFIER NOX_CONC_OUT_MDL ECU_ADDRESS 0xd0004e92 FORMAT "%5.0" /end MEASUREMENT
/begin MEASUREMENT nox_conc_out_mdl_mmv "filtered corrected NOx concentration after catalyst" UWORD _CNV_A_R_LINEAR_____499_CM 1 100. 0. 65535. DISPLAY_IDENTIFIER NOX_CONC_OUT_MDL_MMV ECU_ADDRESS 0xc0000ad2 FORMAT "%5.0" /end MEASUREMENT
/begin MEASUREMENT nox_ppm_rgn_st_2 "downstream NOx concentration by NOx sensor at start of regeneration" UWORD _CNV_A_R_LINEAR_____499_CM 1 100. 0. 1500. DISPLAY_IDENTIFIER NOX_PPM_RGN_ST_2 ECU_ADDRESS 0xd0004ea8 FORMAT "%4.0" /end MEASUREMENT
/begin MEASUREMENT nox_ppm_rgn_st_1 "downstream NOx concentration by NOx sensor at start of regeneration" UWORD _CNV_A_R_LINEAR_____499_CM 1 100. 0. 1500. DISPLAY_IDENTIFIER NOX_PPM_RGN_ST_1 ECU_ADDRESS 0xd0004ea6 FORMAT "%4.0" /end MEASUREMENT
/begin MEASUREMENT nox_cor "raw engine out NOx emission" UWORD _CNV_A_R_LINEAR_____492_CM 1 100. 0. 1023.984375 DISPLAY_IDENTIFIER NOX_COR ECU_ADDRESS 0xc0000ac6 FORMAT "%7.2" /end MEASUREMENT
/begin MEASUREMENT nox_cor_red "corrected engine out NOx emission (incl. SSR)" UWORD _CNV_A_R_LINEAR_____492_CM 1 100. 0. 1023.984375 DISPLAY_IDENTIFIER NOX_COR_RED ECU_ADDRESS 0xd0004e6e FORMAT "%7.2" /end MEASUREMENT
/begin MEASUREMENT nox_flow "NOx emission flow which is stored in the catalyst" UWORD _CNV_A_R_LINEAR_____492_CM 1 100. 0. 1023.984375 DISPLAY_IDENTIFIER NOX_FLOW ECU_ADDRESS 0xc0000ac8 FORMAT "%7.2" /end MEASUREMENT
/begin MEASUREMENT nox_out_mdl "modelled downstream NOx emission" UWORD _CNV_A_R_LINEAR_____492_CM 1 100. 0. 1023.984375 DISPLAY_IDENTIFIER NOX_OUT_MDL ECU_ADDRESS 0xd0004e70 FORMAT "%7.2" /end MEASUREMENT
/begin MEASUREMENT nox_out_mdl_int "integral of modelled downstream NOx emission for one lean / rich cycle" UWORD _CNV_A_R_LINEAR_____495_CM 1 100. 0. 10485.6 DISPLAY_IDENTIFIER NOX_OUT_MDL_INT ECU_ADDRESS 0xd0004e72 FORMAT "%7.1" /end MEASUREMENT
/begin MEASUREMENT nox_out_int_tmp_2 "temporary internal NOx out integral value for NOx sensor regeneration request calculation" UWORD _CNV_A_R_LINEAR_____495_CM 1 100. 0. 10485.6 DISPLAY_IDENTIFIER NOX_OUT_INT_TMP_2 ECU_ADDRESS 0xc0000afe FORMAT "%7.1" /end MEASUREMENT
/begin MEASUREMENT nt_eff "NOx trap efficiency" UWORD _CNV_A_R_LINEAR_____275_CM 1 100. 0. 1. DISPLAY_IDENTIFIER NT_EFF ECU_ADDRESS 0xd0004e74 FORMAT "%7.5" /end MEASUREMENT
/begin MEASUREMENT nt_eff_cor "NOx trap efficiency correction factor" UBYTE _CNV_A_R_LINEAR_____255_CM 1 100. 0. 3.984375 DISPLAY_IDENTIFIER NT_EFF_COR ECU_ADDRESS 0xc0000b20 FORMAT "%4.2" /end MEASUREMENT
/begin MEASUREMENT nt_eff_cor_rgn_st "NOx trap efficiency correction factor at regeneration start" UBYTE _CNV_A_R_LINEAR_____255_CM 1 100. 0. 3.984375 DISPLAY_IDENTIFIER NT_EFF_COR_RGN_ST ECU_ADDRESS 0xd0003aa9 FORMAT "%4.2" /end MEASUREMENT
/begin MEASUREMENT ntl "NOx trap absolute loading" UWORD _CNV_A_R_LINEAR_____495_CM 1 100. 0. 10485.6 DISPLAY_IDENTIFIER NTL ECU_ADDRESS 0xd0004e78 FORMAT "%7.1" /end MEASUREMENT
/begin MEASUREMENT ntl_rgn_st_nox "NOx trap absolute loading (only NOx) when regeneration starts" UWORD _CNV_A_R_LINEAR_____495_CM 1 100. 0. 10485.6 DISPLAY_IDENTIFIER NTL_RGN_ST_NOX ECU_ADDRESS 0xd0004e7c FORMAT "%7.1" /end MEASUREMENT
/begin MEASUREMENT ntl_rgn_st "NOx trap absolute loading (O2+NOx) when regeneration starts" UWORD _CNV_A_R_LINEAR_____495_CM 1 100. 0. 10485.6 DISPLAY_IDENTIFIER NTL_RGN_ST ECU_ADDRESS 0xd0004e7a FORMAT "%7.1" /end MEASUREMENT
/begin MEASUREMENT ntl_dec_int_1 "integral of the lack of oxygen during regeneration phase" UWORD _CNV_A_R_LINEAR_____495_CM 1 100. 0. 10485.6 DISPLAY_IDENTIFIER NTL_DEC_INT_1 ECU_ADDRESS 0xd0004e9e FORMAT "%7.1" /end MEASUREMENT
/begin MEASUREMENT ntl_dec_2 "decrement of NOx trap absolute NOx loading during regeneration (lack of oxygen)" ULONG _CNV_A_R_LINEAR_____502_CM 1 100. 0. 10485.7599975586 DISPLAY_IDENTIFIER NTL_DEC_2 ECU_ADDRESS 0xc0000b1c FORMAT "%12.6" /end MEASUREMENT
/begin MEASUREMENT ntl_dec_1 "decrement of NOx trap absolute NOx loading during regeneration (lack of oxygen)" ULONG _CNV_A_R_LINEAR_____502_CM 1 100. 0. 10485.7599975586 DISPLAY_IDENTIFIER NTL_DEC_1 ECU_ADDRESS 0xc0000b18 FORMAT "%12.6" /end MEASUREMENT
/begin MEASUREMENT ntl_dec_int_swi_2 "NTL_DEC INT until the downstream sensor switches to rich exhaust gas" UWORD _CNV_A_R_LINEAR_____495_CM 1 100. 0. 10485.6 DISPLAY_IDENTIFIER NTL_DEC_INT_SWI_2 ECU_ADDRESS 0xd0004ea4 FORMAT "%7.1" /end MEASUREMENT
/begin MEASUREMENT ntl_dec_int_swi_1 "NTL_DEC INT until the downstream sensor switches to rich exhaust gas" UWORD _CNV_A_R_LINEAR_____495_CM 1 100. 0. 10485.6 DISPLAY_IDENTIFIER NTL_DEC_INT_SWI_1 ECU_ADDRESS 0xd0004ea2 FORMAT "%7.1" /end MEASUREMENT
/begin MEASUREMENT ntl_dec_int_2 "integral of the lack of oxygen during regeneration phase" UWORD _CNV_A_R_LINEAR_____495_CM 1 100. 0. 10485.6 DISPLAY_IDENTIFIER NTL_DEC_INT_2 ECU_ADDRESS 0xd0004ea0 FORMAT "%7.1" /end MEASUREMENT
/begin MEASUREMENT o2l "O2 absolut loading of the NOx trap" UWORD _CNV_A_R_LINEAR_____495_CM 1 100. 0. 10485.6 DISPLAY_IDENTIFIER O2L ECU_ADDRESS 0xd0004e84 FORMAT "%7.1" /end MEASUREMENT
/begin MEASUREMENT nt_o2_stc "NOx trap oxygen storage capacity" UWORD _CNV_A_R_LINEAR_____495_CM 1 100. 0. 10485.6 DISPLAY_IDENTIFIER NT_O2_STC ECU_ADDRESS 0xd0004e80 FORMAT "%7.1" /end MEASUREMENT
/begin MEASUREMENT nt_o2_stc_bas "NOx trap base oxygen storage capacity" UWORD _CNV_A_R_LINEAR_____495_CM 1 100. 0. 10485.6 DISPLAY_IDENTIFIER NT_O2_STC_BAS ECU_ADDRESS 0xd0004e82 FORMAT "%7.1" /end MEASUREMENT
/begin MEASUREMENT o2_flow "corrected engine out O2 flow" UWORD _CNV_A_R_LINEAR_____503_CM 1 100. 0. 16383.75 DISPLAY_IDENTIFIER O2_FLOW ECU_ADDRESS 0xc0000ace FORMAT "%7.1" /end MEASUREMENT
/begin MEASUREMENT fac_rgn_dec_shar "share factor for the reducing agent for the decrementation of NTL and O2L" UBYTE _CNV_A_R_LINEAR_____100_CM 1 100. 0. 1. DISPLAY_IDENTIFIER FAC_RGN_DEC_SHAR ECU_ADDRESS 0xc0000b21 FORMAT "%5.3" /end MEASUREMENT
/begin MEASUREMENT ntld "NOx trap loading degree" UWORD _CNV_A_R_LINEAR_____68_CM 1 100. 0. 0.9999847412109381 DISPLAY_IDENTIFIER NTLD ECU_ADDRESS 0xd0004e86 FORMAT "%7.5" /end MEASUREMENT
/begin MEASUREMENT ntld_mdl "NOx trap loading degree out of model" UWORD _CNV_A_R_LINEAR_____68_CM 1 100. 0. 0.9999847412109381 DISPLAY_IDENTIFIER NTLD_MDL ECU_ADDRESS 0xd0004e98 FORMAT "%7.5" /end MEASUREMENT
/begin MEASUREMENT ntld_rgn_st "NOx trap loading degree at start of regeneration" UWORD _CNV_A_R_LINEAR_____68_CM 1 100. 0. 0.9999847412109381 DISPLAY_IDENTIFIER NTLD_RGN_ST ECU_ADDRESS 0xd0004e88 FORMAT "%7.5" /end MEASUREMENT
/begin MEASUREMENT ntld_max "loading degree threshold for starting a regeneration" UWORD _CNV_A_R_LINEAR_____68_CM 1 100. 0. 0.9999847412109381 DISPLAY_IDENTIFIER NTLD_MAX ECU_ADDRESS 0xd0004e8a FORMAT "%7.5" /end MEASUREMENT
/begin MEASUREMENT t_afl "elapsed time since lean phase was started" UWORD _CNV_A_R_LINEAR_____107_CM 1 100. 0. 1310.7 DISPLAY_IDENTIFIER T_AFL ECU_ADDRESS 0xd0004e8c FORMAT "%7.2" /end MEASUREMENT
/begin MEASUREMENT t_afl_puc "elapsed time since last PUC phase" UWORD _CNV_A_R_LINEAR_____107_CM 1 100. 0. 1310.7 DISPLAY_IDENTIFIER T_AFL_PUC ECU_ADDRESS 0xd0004e8e FORMAT "%7.2" /end MEASUREMENT
/begin MEASUREMENT t_nt_hom "counting back the minimum homogeneous time for detecting initialised catalyst state" UWORD _CNV_A_R_LINEAR_____3_CM 1 100. 0. 655.35 DISPLAY_IDENTIFIER T_NT_HOM ECU_ADDRESS 0xc0000ad0 FORMAT "%6.2" /end MEASUREMENT
/begin MEASUREMENT t_nt_hom_delta "decrement for T_NT_HOM counter" SBYTE _CNV_A_R_LINEAR_____3_CM 1 100. -1.28 1.27 DISPLAY_IDENTIFIER T_NT_HOM_DELTA ECU_ADDRESS 0xc0000b26 FORMAT "%5.2" /end MEASUREMENT
/begin MEASUREMENT sum_ntl_cyc "amount of regeneration cycles carried out" UWORD _CNV_A_R_LINEAR_____0_CM 1 100. 0. 65535. DISPLAY_IDENTIFIER SUM_NTL_CYC ECU_ADDRESS 0xd0004e9a FORMAT "%5.0" /end MEASUREMENT
/begin MEASUREMENT flow_nt_mmv "filtered exhaust gas flow through NOx trap" UWORD _CNV_A_R_LINEAR_____207_CM 1 100. 0. 2047.96875 DISPLAY_IDENTIFIER FLOW_NT_MMV ECU_ADDRESS 0xd0004e90 FORMAT "%7.2" /end MEASUREMENT
/begin MEASUREMENT nt_agi_av "actual aging factor (ratio of actual storage capacity vs. base storage capacity)" UBYTE _CNV_A_R_LINEAR_____27_CM 1 100. 0. 0.99609375 DISPLAY_IDENTIFIER NT_AGI_AV ECU_ADDRESS 0xd0003aaa FORMAT "%5.3" /end MEASUREMENT
/begin MEASUREMENT nox_cor_red_mmv "moving mean value of corrected engine out NOx emission (incl. SSR)" UWORD _CNV_A_R_LINEAR_____492_CM 1 100. 0. 1023.984375 DISPLAY_IDENTIFIER NOX_COR_RED_MMV ECU_ADDRESS 0xd0004e96 FORMAT "%7.2" /end MEASUREMENT
/begin CHARACTERISTIC c_lamb_o2_stc "lambda threshold for O2 storage in lean operation" VALUE 0xa10294ec _REC_VAL_20_u2 31.9990234375 _CNV_A_R_LINEAR_____122_CM 0. 31.9990234375 DISPLAY_IDENTIFIER C_LAMB_O2_STC FORMAT "%7.4" /end CHARACTERISTIC
/begin CHARACTERISTIC c_o2_flow_cor_fac "correction factor for the O2 engine out flow" VALUE 0xa1029714 _REC_VAL_20_u2 128. _CNV_A_R_LINEAR_____504_CM 0. 128. DISPLAY_IDENTIFIER C_O2_FLOW_COR_FAC FORMAT "%7.3" /end CHARACTERISTIC
/begin CHARACTERISTIC c_fac_o2_equ "factor for the balance of stored NO O2" VALUE 0xa1029397 _REC_VAL_20_u1 1.9921875 _CNV_A_R_LINEAR_____100_CM 0. 1.9921875 DISPLAY_IDENTIFIER C_FAC_O2_EQU FORMAT "%5.3" /end CHARACTERISTIC
/begin CHARACTERISTIC c_fac_cor_o2l "correction factor for the O2L decrementation" VALUE 0xa102937a _REC_VAL_20_u1 1.9921875 _CNV_A_R_LINEAR_____100_CM 0. 1.9921875 DISPLAY_IDENTIFIER C_FAC_COR_O2L FORMAT "%5.3" /end CHARACTERISTIC
/begin CHARACTERISTIC c_lamb_stc "lambda threshold for lean operation" VALUE 0xa102950e _REC_VAL_20_u2 31.9990234375 _CNV_A_R_LINEAR_____122_CM 0. 31.9990234375 DISPLAY_IDENTIFIER C_LAMB_STC FORMAT "%7.4" /end CHARACTERISTIC
/begin CHARACTERISTIC c_lamb_rgn "lambda threshold for rich operation" VALUE 0xa10294f6 _REC_VAL_20_u2 31.9990234375 _CNV_A_R_LINEAR_____122_CM 0. 31.9990234375 DISPLAY_IDENTIFIER C_LAMB_RGN FORMAT "%7.4" /end CHARACTERISTIC
/begin CHARACTERISTIC c_ntl_ini_st "initialisation value of the NOx trap absolute loading after engine start" VALUE 0xa10296f6 _REC_VAL_20_u2 10485.6 _CNV_A_R_LINEAR_____495_CM 0. 10485.6 DISPLAY_IDENTIFIER C_NTL_INI_ST FORMAT "%7.1" /end CHARACTERISTIC
/begin CHARACTERISTIC c_ntld_rgn_st_ini "initialisation value for NOx trap loading degree at start of regeneration" VALUE 0xa102970e _REC_VAL_20_u2 0.9999847412109381 _CNV_A_R_LINEAR_____68_CM 0. 0.9999847412109381 DISPLAY_IDENTIFIER C_NTLD_RGN_ST_INI FORMAT "%7.5" /end CHARACTERISTIC
/begin CHARACTERISTIC c_ntld_lgrd "limitating gradient of loading degree" VALUE 0xa1029702 _REC_VAL_20_u2 0.9999847412109381 _CNV_A_R_LINEAR_____68_CM 0. 0.9999847412109381 DISPLAY_IDENTIFIER C_NTLD_LGRD FORMAT "%7.5" /end CHARACTERISTIC
/begin CHARACTERISTIC c_nox_conc_cor "correction factor of the NOx concentration regarding the mol mass" VALUE 0xa1029688 _REC_VAL_20_u2 8192. _CNV_A_R_LINEAR_____505_CM 0. 8192. DISPLAY_IDENTIFIER C_NOX_CONC_COR FORMAT "%6.1" /end CHARACTERISTIC
/begin CHARACTERISTIC c_crlc_nox_conc_red "correction factor for filtering of NOX_CONC_RED" VALUE 0xa102921a _REC_VAL_20_u2 0.9999847412109381 _CNV_A_R_LINEAR_____68_CM 0. 0.9999847412109381 DISPLAY_IDENTIFIER C_CRLC_NOX_CONC_RED FORMAT "%7.5" /end CHARACTERISTIC
/begin CHARACTERISTIC c_crlc_nox_cor_red "correction factor for filtering of NOX_COR_RED" VALUE 0xa102921c _REC_VAL_20_u2 0.9999847412109381 _CNV_A_R_LINEAR_____68_CM 0. 0.9999847412109381 DISPLAY_IDENTIFIER C_CRLC_NOX_COR_RED FORMAT "%7.5" /end CHARACTERISTIC
/begin CHARACTERISTIC c_crlc_nox_conc_out_mdl "correction factor for filtering of NOX_CONC_OUT_MDL" VALUE 0xa1029218 _REC_VAL_20_u2 0.9999847412109381 _CNV_A_R_LINEAR_____68_CM 0. 0.9999847412109381 DISPLAY_IDENTIFIER C_CRLC_NOX_CONC_OUT_MDL FORMAT "%7.5" /end CHARACTERISTIC
/begin CHARACTERISTIC c_ntld_nt_hom_rst "loading degree threshold for resetting the homogeneous time counter T_NT_HOM" VALUE 0xa102970c _REC_VAL_20_u2 0.9999847412109381 _CNV_A_R_LINEAR_____68_CM 0. 0.9999847412109381 DISPLAY_IDENTIFIER C_NTLD_NT_HOM_RST FORMAT "%7.5" /end CHARACTERISTIC
/begin CHARACTERISTIC c_t_afl_nt_hom_rst "lean time after which the homogeneous time counter is reinitialised" VALUE 0xa10297f2 _REC_VAL_20_u2 1310.7 _CNV_A_R_LINEAR_____107_CM 0. 1310.7 DISPLAY_IDENTIFIER C_T_AFL_NT_HOM_RST FORMAT "%7.2" /end CHARACTERISTIC
/begin CHARACTERISTIC lc_nt_afs_req "switch to force hom. mode in passive or enable lean operation" VALUE 0xa1029da1 _REC_VAL_20_u1 1. _CNV_A_R_LINEAR_____0_CM 0. 1. DISPLAY_IDENTIFIER LC_NT_AFS_REQ FORMAT "%1.0" /end CHARACTERISTIC
/begin CHARACTERISTIC c_state_rgn_ctl "regeneration stop mode" VALUE 0xa10297ba _REC_VAL_20_u1 3. _CNV_S_4_STATE_RGN__506_CM 0. 3. DISPLAY_IDENTIFIER C_STATE_RGN_CTL /end CHARACTERISTIC
/begin CHARACTERISTIC c_state_sens_afr_1 "bench selective mode to determine rich exhaust gas downstream NOx trap" VALUE 0xa10297c0 _REC_VAL_20_u1 4. _CNV_S_5_STATE_SENS_507_CM 0. 4. DISPLAY_IDENTIFIER C_STATE_SENS_AFR_1 /end CHARACTERISTIC
/begin CHARACTERISTIC c_state_sens_afr_2 "bench selective mode to determine rich exhaust gas downstream NOx trap" VALUE 0xa10297c1 _REC_VAL_20_u1 4. _CNV_S_5_STATE_SENS_507_CM 0. 4. DISPLAY_IDENTIFIER C_STATE_SENS_AFR_2 /end CHARACTERISTIC
/begin CHARACTERISTIC c_state_sens_afr_trim_1 "bench selective mode to determine trim threshold reached by downstream sensor" VALUE 0xa10297c4 _REC_VAL_20_u1 4. _CNV_S_5_STATE_SENS_507_CM 0. 4. DISPLAY_IDENTIFIER C_STATE_SENS_AFR_TRIM_1 /end CHARACTERISTIC
/begin CHARACTERISTIC c_state_sens_afr_trim_2 "bench selective mode to determine trim threshold reached by downstream sensor" VALUE 0xa10297c5 _REC_VAL_20_u1 4. _CNV_S_5_STATE_SENS_507_CM 0. 4. DISPLAY_IDENTIFIER C_STATE_SENS_AFR_TRIM_2 /end CHARACTERISTIC
/begin CHARACTERISTIC c_t_afl_rgn_req_ntld "minimum duration of lean operation before permitting a regeneration request from the model" VALUE 0xa10297f4 _REC_VAL_20_u2 1310.7 _CNV_A_R_LINEAR_____107_CM 0. 1310.7 DISPLAY_IDENTIFIER C_T_AFL_RGN_REQ_NTLD FORMAT "%7.2" /end CHARACTERISTIC
/begin CHARACTERISTIC c_t_afl_min "minimum duration of lean operation before permitting a regeneration" VALUE 0xa10297ee _REC_VAL_20_u2 1310.7 _CNV_A_R_LINEAR_____107_CM 0. 1310.7 DISPLAY_IDENTIFIER C_T_AFL_MIN FORMAT "%7.2" /end CHARACTERISTIC
/begin CHARACTERISTIC c_vls_nox_sens_rgn_stop "binary NOx sensor signal threshold for determining rich exhaust gas" VALUE 0xa1029c5a _REC_VAL_20_u2 1400. _CNV_A_R_LINEAR_____211_CM -200. 1200. DISPLAY_IDENTIFIER C_VLS_NOX_SENS_RGN_STOP FORMAT "%4.0" /end CHARACTERISTIC
/begin CHARACTERISTIC c_lamb_nox_sens_rgn_stop "linear NOx sensor signal threshold for determining rich exhaust gas" VALUE 0xa10294e8 _REC_VAL_20_u2 31.9990234375 _CNV_A_R_LINEAR_____122_CM 0. 31.9990234375 DISPLAY_IDENTIFIER C_LAMB_NOX_SENS_RGN_STOP FORMAT "%7.4" /end CHARACTERISTIC
/begin CHARACTERISTIC c_lamb_nox_sens_afr_trim "linear NOx sensor signal threshold for determining rich trim conditions" VALUE 0xa10294e6 _REC_VAL_20_u2 31.9990234375 _CNV_A_R_LINEAR_____122_CM 0. 31.9990234375 DISPLAY_IDENTIFIER C_LAMB_NOX_SENS_AFR_TRIM FORMAT "%7.4" /end CHARACTERISTIC
/begin CHARACTERISTIC c_nox_ppm_rgn_stop "linear NOx sensor signal threshold for determining rich trim conditions" VALUE 0xa10296b4 _REC_VAL_20_u2 1500. _CNV_A_R_LINEAR_____499_CM 0. 1500. DISPLAY_IDENTIFIER C_NOX_PPM_RGN_STOP FORMAT "%4.0" /end CHARACTERISTIC
/begin CHARACTERISTIC c_o2l_min "minimum NOx trap oxygen loading for stopping a regeneration" VALUE 0xa1029716 _REC_VAL_20_u2 10485.6 _CNV_A_R_LINEAR_____495_CM 0. 10485.6 DISPLAY_IDENTIFIER C_O2L_MIN FORMAT "%7.1" /end CHARACTERISTIC
/begin CHARACTERISTIC c_sum_o2l_ntl_max "threshold of oxygen and NOx loading for requesting a NOx catalyst purge" VALUE 0xa10297dc _REC_VAL_20_u2 10485.6 _CNV_A_R_LINEAR_____495_CM 0. 10485.6 DISPLAY_IDENTIFIER C_SUM_O2L_NTL_MAX FORMAT "%7.1" /end CHARACTERISTIC
/begin CHARACTERISTIC c_ntl_trig_afr_afl "minimum NOx trap NOx loading for triggering the transition from rich to lean operation" VALUE 0xa10296fa _REC_VAL_20_u2 10485.6 _CNV_A_R_LINEAR_____495_CM 0. 10485.6 DISPLAY_IDENTIFIER C_NTL_TRIG_AFR_AFL FORMAT "%7.1" /end CHARACTERISTIC
/begin CHARACTERISTIC c_sum_ntl_cyc_sp "NOx trap regeneration cycle counter initialisation value" VALUE 0xa10297da _REC_VAL_20_u2 65535. _CNV_A_R_LINEAR_____0_CM 0. 65535. DISPLAY_IDENTIFIER C_SUM_NTL_CYC_SP FORMAT "%5.0" /end CHARACTERISTIC
/begin CHARACTERISTIC c_tnt_mdl_inh_purge "NOx trap temperature threshold for inhibiting a catalyst purge" VALUE 0xa1029a62 _REC_VAL_20_u1 1020. _CNV_A_R_LINEAR_____490_CM 0. 1020. DISPLAY_IDENTIFIER C_TNT_MDL_INH_PURGE FORMAT "%4.0" /end CHARACTERISTIC
/begin CHARACTERISTIC lc_nox_sens "logical constant for the existence of a NOx sensor" VALUE 0xa1029d8c _REC_VAL_20_u1 1. _CNV_A_R_LINEAR_____0_CM 0. 1. DISPLAY_IDENTIFIER LC_NOX_SENS FORMAT "%1.0" /end CHARACTERISTIC
/begin CHARACTERISTIC lc_nox_sens_rgn "switch to exclusivly use the NOx sensor for requesting a regeneration" VALUE 0xa1029d9b _REC_VAL_20_u1 1. _CNV_A_R_LINEAR_____0_CM 0. 1. DISPLAY_IDENTIFIER LC_NOX_SENS_RGN FORMAT "%1.0" /end CHARACTERISTIC
/begin CHARACTERISTIC lc_sum_ntl_cyc_new "initialisation of regeneration cycle counter" VALUE 0xa1029de2 _REC_VAL_20_u1 1. _CNV_A_R_LINEAR_____0_CM 0. 1. DISPLAY_IDENTIFIER LC_SUM_NTL_CYC_NEW FORMAT "%1.0" /end CHARACTERISTIC
/begin CHARACTERISTIC lc_ntld_max_afs "switch between NTLD and NTLD_MDL for LV_RGN_REQ_NTLD_AFS" VALUE 0xa1029db2 _REC_VAL_20_u1 1. _CNV_A_R_LINEAR_____0_CM 0. 1. DISPLAY_IDENTIFIER LC_NTLD_MAX_AFS FORMAT "%1.0" /end CHARACTERISTIC
/begin CHARACTERISTIC lc_inh_rgn_pu "switch to forbid regeneration during PU" VALUE 0xa1029d68 _REC_VAL_20_u1 1. _CNV_A_R_LINEAR_____0_CM 0. 1. DISPLAY_IDENTIFIER LC_INH_RGN_PU FORMAT "%1.0" /end CHARACTERISTIC
/begin CHARACTERISTIC c_tnt_mdl_min_hys "temperature hysteresis for lambda=1 mode deactivation due to low temperature" VALUE 0xa1029a65 _REC_VAL_20_u1 1020. _CNV_A_R_LINEAR_____490_CM 0. 1020. DISPLAY_IDENTIFIER C_TNT_MDL_MIN_HYS FORMAT "%4.0" /end CHARACTERISTIC
/begin CHARACTERISTIC c_tnt_mdl_max_hys "temperature hysteresis for lambda=1 mode deactivation due to high temperature" VALUE 0xa1029a63 _REC_VAL_20_u1 1020. _CNV_A_R_LINEAR_____490_CM 0. 1020. DISPLAY_IDENTIFIER C_TNT_MDL_MAX_HYS FORMAT "%4.0" /end CHARACTERISTIC
/begin CHARACTERISTIC c_t_nt_hom "lean time threshold for resetting the homogeneous time T_NT_HOM" VALUE 0xa1029932 _REC_VAL_20_u2 655.35 _CNV_A_R_LINEAR_____3_CM 0. 655.35 DISPLAY_IDENTIFIER C_T_NT_HOM FORMAT "%6.2" /end CHARACTERISTIC
/begin AXIS_PTS ldp_tnt_mdl_mv_ip_nox_red_fac "" 0xa10213ce tnt_mdl_mv _REC_AXS_20_u1 1020. _CNV_A_R_LINEAR_____490_CM 4 0. 1020. FORMAT "%4.0" /end AXIS_PTS
/begin AXIS_PTS ldp_nox_conc_mmv_ip_nt_stc_bas "" 0xa1021048 nox_conc_mmv _REC_AXS_20_u2 65535. _CNV_A_R_LINEAR_____499_CM 8 0. 65535. FORMAT "%5.0" /end AXIS_PTS
/begin AXIS_PTS ldpm_tnt_mdl_nox "" 0xa1022338 tnt_mdl_mv _REC_AXS_20_u1 1020. _CNV_A_R_LINEAR_____490_CM 8 0. 1020. FORMAT "%4.0" /end AXIS_PTS
/begin AXIS_PTS ldp_lamb_mv_ip_o2_stc_max "" 0xa1020c14 lamb_mv _REC_AXS_20_u2 31.9990234375 _CNV_A_R_LINEAR_____122_CM 8 0. 31.9990234375 FORMAT "%7.4" /end AXIS_PTS
/begin AXIS_PTS ldp_nt_agi_ntld_ip_nt_agi_rgn "" 0xa1021088 nt_agi_ntld _REC_AXS_20_u1 0.99609375 _CNV_A_R_LINEAR_____27_CM 8 0. 0.99609375 FORMAT "%5.3" /end AXIS_PTS
/begin AXIS_PTS ldp_tnt_mdl_mv_ip_nt_agi_rgn "" 0xa10213d4 tnt_mdl_mv _REC_AXS_20_u1 1020. _CNV_A_R_LINEAR_____490_CM 8 0. 1020. FORMAT "%4.0" /end AXIS_PTS
/begin AXIS_PTS ldpm_n_32_1 "" 0xa1021d72 n_32 _REC_AXS_20_u1 8160. _CNV_A_R_LINEAR_____9_CM 4 0. 8160. FORMAT "%4.0" /end AXIS_PTS
/begin AXIS_PTS ldp_ntld_rgn_st_id_vls_down "" 0xa1021134 ntld_rgn_st _REC_AXS_20_u2 0.9999847412109381 _CNV_A_R_LINEAR_____68_CM 4 0. 0.9999847412109381 FORMAT "%7.5" /end AXIS_PTS
/begin AXIS_PTS ldp_flow_nt_mmv_ip_t_rgn_max "" 0xa1020a10 flow_nt_mmv _REC_AXS_20_u2 2047.96875 _CNV_A_R_LINEAR_____207_CM 4 0. 2047.96875 FORMAT "%7.2" /end AXIS_PTS
/begin AXIS_PTS ldpm_maf_kgh_ip_t_nt_hom "" 0xa1021c7a maf_kgh _REC_AXS_20_u1 2040. _CNV_A_R_LINEAR_____508_CM 4 0. 2040. FORMAT "%4.0" /end AXIS_PTS
/begin AXIS_PTS ldpm_lamb_av_cor_ip_t_nt_hom "" 0xa1021b3c online_dummy _REC_AXS_20_u2 31.9990234375 _CNV_A_R_LINEAR_____122_CM 4 0. 31.9990234375 FORMAT "%7.4" /end AXIS_PTS
/begin AXIS_PTS ldp_tqi_req_fast_ip_ntld_max "" 0xa1021610 tqi_req_fast _REC_AXS_20_u2 2047.96875 _CNV_A_R_LINEAR_____65_CM 12 -1024. 1023.96875 FORMAT "%8.2" /end AXIS_PTS
/begin CHARACTERISTIC ip_nox_red_fac "reduction factor taking into account the chemical  NOx conversion" CURVE 0xa1026810 _REC_CUR_20_u1_u1 0.99609375 _CNV_A_R_LINEAR_____27_CM 0. 0.99609375 DISPLAY_IDENTIFIER IP_NOX_RED_FAC FORMAT "%5.3"
 /begin AXIS_DESCR COM_AXIS tnt_mdl_mv _CNV_A_R_LINEAR_____490_CM 4 0. 1020. FORMAT "%4.0" AXIS_PTS_REF ldp_tnt_mdl_mv_ip_nox_red_fac /end AXIS_DESCR
/end CHARACTERISTIC
/begin CHARACTERISTIC ip_nt_eff_bas "basic NOx trap efficiency" MAP 0xa1026b28 _REC_MAP_20_u2_u2_u1 0.9999847412109381 _CNV_A_R_LINEAR_____68_CM 0. 0.9999847412109381 DISPLAY_IDENTIFIER IP_NT_EFF_BAS FORMAT "%7.5"
 /begin AXIS_DESCR COM_AXIS ntld _CNV_A_R_LINEAR_____68_CM 8 0. 0.9999847412109381 FORMAT "%7.5" AXIS_PTS_REF ldpm_ntld /end AXIS_DESCR
 /begin AXIS_DESCR COM_AXIS tnt_mdl_mv _CNV_A_R_LINEAR_____490_CM 8 0. 1020. FORMAT "%4.0" AXIS_PTS_REF ldpm_tnt_mdl_nox /end AXIS_DESCR
/end CHARACTERISTIC
/begin CHARACTERISTIC ip_nt_eff_cor "NOx trap efficiency correction" MAP 0xa1026c28 _REC_MAP_20_u1_u2_u1 3.984375 _CNV_A_R_LINEAR_____255_CM 0. 3.984375 DISPLAY_IDENTIFIER IP_NT_EFF_COR FORMAT "%4.2"
 /begin AXIS_DESCR COM_AXIS nox_cor _CNV_A_R_LINEAR_____492_CM 8 0. 1023.984375 FORMAT "%7.2" AXIS_PTS_REF ldp_nox_cor_ip_nt_eff_cor /end AXIS_DESCR
 /begin AXIS_DESCR COM_AXIS tnt_mdl_mv _CNV_A_R_LINEAR_____490_CM 8 0. 1020. FORMAT "%4.0" AXIS_PTS_REF ldpm_tnt_mdl_nox /end AXIS_DESCR
/end CHARACTERISTIC
/begin CHARACTERISTIC ip_o2_stc_max "max. storage capacity of O2 in the NOx trap" MAP 0xa10270c8 _REC_MAP_20_u2_u2_u1 10485.6 _CNV_A_R_LINEAR_____495_CM 0. 10485.6 DISPLAY_IDENTIFIER IP_O2_STC_MAX FORMAT "%7.1"
 /begin AXIS_DESCR COM_AXIS lamb_mv _CNV_A_R_LINEAR_____122_CM 8 0. 31.9990234375 FORMAT "%7.4" AXIS_PTS_REF ldp_lamb_mv_ip_o2_stc_max /end AXIS_DESCR
 /begin AXIS_DESCR COM_AXIS tnt_mdl_mv _CNV_A_R_LINEAR_____490_CM 8 0. 1020. FORMAT "%4.0" AXIS_PTS_REF ldpm_tnt_mdl_nox /end AXIS_DESCR
/end CHARACTERISTIC
/begin CHARACTERISTIC ip_nt_agi_rgn_frq "modification of the actual storage capacity due to aging factor NT_AGI_NTLD" MAP 0xa1026ae8 _REC_MAP_20_u1_u1_u1 0.99609375 _CNV_A_R_LINEAR_____27_CM 0. 0.99609375 DISPLAY_IDENTIFIER IP_NT_AGI_RGN_FRQ FORMAT "%5.3"
 /begin AXIS_DESCR COM_AXIS nt_agi_ntld _CNV_A_R_LINEAR_____27_CM 8 0. 0.99609375 FORMAT "%5.3" AXIS_PTS_REF ldp_nt_agi_ntld_ip_nt_agi_rgn /end AXIS_DESCR
 /begin AXIS_DESCR COM_AXIS tnt_mdl_mv _CNV_A_R_LINEAR_____490_CM 8 0. 1020. FORMAT "%4.0" AXIS_PTS_REF ldp_tnt_mdl_mv_ip_nt_agi_rgn /end AXIS_DESCR
/end CHARACTERISTIC
/begin CHARACTERISTIC ip_ntl_min "minimum NOx trap NOx loading for stopping a regeneration" CURVE 0xa1026e08 _REC_CUR_20_u2_u1 10485.6 _CNV_A_R_LINEAR_____495_CM 0. 10485.6 DISPLAY_IDENTIFIER IP_NTL_MIN FORMAT "%7.1"
 /begin AXIS_DESCR COM_AXIS tnt_mdl_mv _CNV_A_R_LINEAR_____490_CM 8 0. 1020. FORMAT "%4.0" AXIS_PTS_REF ldpm_tnt_mdl_nox /end AXIS_DESCR
/end CHARACTERISTIC
/begin CHARACTERISTIC ip_ntld_max "maximum NOx trap loading degree for requesting a regeneration" MAP 0xa1026f18 _REC_MAP_20_u2_u2_u1 0.9999847412109381 _CNV_A_R_LINEAR_____68_CM 0. 0.9999847412109381 DISPLAY_IDENTIFIER IP_NTLD_MAX FORMAT "%7.5"
 /begin AXIS_DESCR COM_AXIS tqi_req_fast _CNV_A_R_LINEAR_____65_CM 12 -1024. 1023.96875 FORMAT "%8.2" AXIS_PTS_REF ldp_tqi_req_fast_ip_ntld_max /end AXIS_DESCR
 /begin AXIS_DESCR COM_AXIS n_32 _CNV_A_R_LINEAR_____9_CM 4 0. 8160. FORMAT "%4.0" AXIS_PTS_REF ldpm_n_32_1 /end AXIS_DESCR
/end CHARACTERISTIC
/begin CHARACTERISTIC ip_ntld_max_adj "maximum NOx trap loading degree for requesting a regeneration (adjusted for special purposes)" MAP 0xa1026f78 _REC_MAP_20_u2_u2_u1 0.9999847412109381 _CNV_A_R_LINEAR_____68_CM 0. 0.9999847412109381 DISPLAY_IDENTIFIER IP_NTLD_MAX_ADJ FORMAT "%7.5"
 /begin AXIS_DESCR COM_AXIS tqi_req_fast _CNV_A_R_LINEAR_____65_CM 8 -1024. 1023.96875 FORMAT "%8.2" AXIS_PTS_REF ldpm_tqi_req_fast_1_egtr /end AXIS_DESCR
 /begin AXIS_DESCR COM_AXIS n_32 _CNV_A_R_LINEAR_____9_CM 4 0. 8160. FORMAT "%4.0" AXIS_PTS_REF ldpm_n_32_1 /end AXIS_DESCR
/end CHARACTERISTIC
/begin CHARACTERISTIC id_vls_down_rgn_stop "downstream binary lambda sensor signal threshold for determining rich exhaust gas" CURVE 0xa1023020 _REC_CUR_20_u2_u2 4.9951171875 _CNV_A_R_LINEAR_____2_CM 0. 4.9951171875 DISPLAY_IDENTIFIER ID_VLS_DOWN_RGN_STOP FORMAT "%5.3"
 /begin AXIS_DESCR COM_AXIS ntld_rgn_st _CNV_A_R_LINEAR_____68_CM 4 0. 0.9999847412109381 FORMAT "%7.5" AXIS_PTS_REF ldp_ntld_rgn_st_id_vls_down /end AXIS_DESCR
/end CHARACTERISTIC
/begin CHARACTERISTIC ip_t_nt_hom_dec "weighted decrement for the homogeneous time counter" MAP 0xa1027d98 _REC_MAP_20_u1_u1_u2 1.27 _CNV_A_R_LINEAR_____509_CM 0. 1.27 DISPLAY_IDENTIFIER IP_T_NT_HOM_DEC FORMAT "%4.2"
 /begin AXIS_DESCR COM_AXIS maf_kgh _CNV_A_R_LINEAR_____508_CM 4 0. 2040. FORMAT "%4.0" AXIS_PTS_REF ldpm_maf_kgh_ip_t_nt_hom /end AXIS_DESCR
 /begin AXIS_DESCR COM_AXIS online_dummy _CNV_A_R_LINEAR_____122_CM 4 0. 31.9990234375 FORMAT "%7.4" AXIS_PTS_REF ldpm_lamb_av_cor_ip_t_nt_hom /end AXIS_DESCR
/end CHARACTERISTIC
/begin CHARACTERISTIC ip_t_nt_hom_inc "weighted increment for the homogeneous time counter" MAP 0xa1027da8 _REC_MAP_20_u1_u1_u2 1.27 _CNV_A_R_LINEAR_____509_CM 0. 1.27 DISPLAY_IDENTIFIER IP_T_NT_HOM_INC FORMAT "%4.2"
 /begin AXIS_DESCR COM_AXIS maf_kgh _CNV_A_R_LINEAR_____508_CM 4 0. 2040. FORMAT "%4.0" AXIS_PTS_REF ldpm_maf_kgh_ip_t_nt_hom /end AXIS_DESCR
 /begin AXIS_DESCR COM_AXIS online_dummy _CNV_A_R_LINEAR_____122_CM 4 0. 31.9990234375 FORMAT "%7.4" AXIS_PTS_REF ldpm_lamb_av_cor_ip_t_nt_hom /end AXIS_DESCR
/end CHARACTERISTIC
/begin CHARACTERISTIC ip_t_rgn_max "regeneration time for manual regeneration duration selection" MAP 0xa1027dc8 _REC_MAP_20_u2_u2_u2 655.35 _CNV_A_R_LINEAR_____3_CM 0. 655.35 DISPLAY_IDENTIFIER IP_T_RGN_MAX FORMAT "%6.2"
 /begin AXIS_DESCR COM_AXIS flow_nt_mmv _CNV_A_R_LINEAR_____207_CM 4 0. 2047.96875 FORMAT "%7.2" AXIS_PTS_REF ldp_flow_nt_mmv_ip_t_rgn_max /end AXIS_DESCR
 /begin AXIS_DESCR COM_AXIS nt_agi _CNV_A_R_LINEAR_____68_CM 4 0. 0.9999847412109381 FORMAT "%7.5" AXIS_PTS_REF ldpm_nt_agi /end AXIS_DESCR
/end CHARACTERISTIC
/begin MEASUREMENT tnt_mdl_max "maximum NOx trap temperature for lean operation" UBYTE _CNV_A_R_LINEAR_____490_CM 1 100. 0. 1020. DISPLAY_IDENTIFIER TNT_MDL_MAX ECU_ADDRESS 0xc0000b24 FORMAT "%4.0" /end MEASUREMENT
/begin MEASUREMENT tnt_mdl_min "minimum NOx trap temperature for lean operation" UBYTE _CNV_A_R_LINEAR_____490_CM 1 100. 0. 1020. DISPLAY_IDENTIFIER TNT_MDL_MIN ECU_ADDRESS 0xc0000b25 FORMAT "%4.0" /end MEASUREMENT
/begin CHARACTERISTIC lc_rpu_state_nox "Switch to use RPU value of STATE_NOX" VALUE 0xa1029dd2 _REC_VAL_20_u1 1. _CNV_A_R_LINEAR_____0_CM 0. 1. DISPLAY_IDENTIFIER LC_RPU_STATE_NOX FORMAT "%1.0" /end CHARACTERISTIC
/begin CHARACTERISTIC lc_rpu_nt_eff_cor "Switch to use RPU value of NT_EFF_COR" VALUE 0xa1029dcc _REC_VAL_20_u1 1. _CNV_A_R_LINEAR_____0_CM 0. 1. DISPLAY_IDENTIFIER LC_RPU_NT_EFF_COR FORMAT "%1.0" /end CHARACTERISTIC
/begin CHARACTERISTIC lc_rpu_nt_stc_bas "Switch to use RPU value of NT_STC_BAS" VALUE 0xa1029dcd _REC_VAL_20_u1 1. _CNV_A_R_LINEAR_____0_CM 0. 1. DISPLAY_IDENTIFIER LC_RPU_NT_STC_BAS FORMAT "%1.0" /end CHARACTERISTIC
/begin CHARACTERISTIC lc_rpu_ntl "Switch to use RPU value of NTL" VALUE 0xa1029dce _REC_VAL_20_u1 1. _CNV_A_R_LINEAR_____0_CM 0. 1. DISPLAY_IDENTIFIER LC_RPU_NTL FORMAT "%1.0" /end CHARACTERISTIC
/begin CHARACTERISTIC lc_rpu_rgn_nt_req "switch to use RPU value of LV_RGN_NT_REQ" VALUE 0xa1029dd0 _REC_VAL_20_u1 1. _CNV_A_R_LINEAR_____0_CM 0. 1. DISPLAY_IDENTIFIER LC_RPU_RGN_NT_REQ FORMAT "%1.0" /end CHARACTERISTIC
/begin CHARACTERISTIC lc_rpu_nt_afs_req "Switch to use RPU value of LV_NT_AFS_REQ" VALUE 0xa1029dcb _REC_VAL_20_u1 1. _CNV_A_R_LINEAR_____0_CM 0. 1. DISPLAY_IDENTIFIER LC_RPU_NT_AFS_REQ FORMAT "%1.0" /end CHARACTERISTIC
/begin CHARACTERISTIC lc_rpu_rgn_agi "Switch to use RPU value of LV_RGN_AGI_i" VALUE 0xa1029dcf _REC_VAL_20_u1 1. _CNV_A_R_LINEAR_____0_CM 0. 1. DISPLAY_IDENTIFIER LC_RPU_RGN_AGI FORMAT "%1.0" /end CHARACTERISTIC
/begin CHARACTERISTIC lc_rpu_act_int_puc_afl "Switch to use RPU value of LV_ACT_INT_PUC_AFL_i" VALUE 0xa1029dc7 _REC_VAL_20_u1 1. _CNV_A_R_LINEAR_____0_CM 0. 1. DISPLAY_IDENTIFIER LC_RPU_ACT_INT_PUC_AFL FORMAT "%1.0" /end CHARACTERISTIC
/begin CHARACTERISTIC lc_rpu_sens_afr "Switch to use RPU value of LV_SENS_AFR_i" VALUE 0xa1029dd1 _REC_VAL_20_u1 1. _CNV_A_R_LINEAR_____0_CM 0. 1. DISPLAY_IDENTIFIER LC_RPU_SENS_AFR FORMAT "%1.0" /end CHARACTERISTIC
/begin CHARACTERISTIC lc_rpu_state_tran_calc "Switch to enable transition calc. by ECU / DME if STATE_NOX is calc. by RPU" VALUE 0xa1029dd3 _REC_VAL_20_u1 1. _CNV_A_R_LINEAR_____0_CM 0. 1. DISPLAY_IDENTIFIER LC_RPU_STATE_TRAN_CALC FORMAT "%1.0" /end CHARACTERISTIC
/begin CHARACTERISTIC c_nox_out_mes_int_max "threshold for integrated downstream emission (meas. by NOx sensor) for requesting a regeneration" VALUE 0xa10296a0 _REC_VAL_20_u2 10485.6 _CNV_A_R_LINEAR_____495_CM 0. 10485.6 DISPLAY_IDENTIFIER C_NOX_OUT_MES_INT_MAX FORMAT "%7.1" /end CHARACTERISTIC
/begin MEASUREMENT lv_rgn_req_nox_sens_tmp_1 "bench selective regeneration request caused by the NOx sensor signal" UBYTE _CNV_S_2_RANGE__0___1_CM 1 100. 0. 1. DISPLAY_IDENTIFIER LV_RGN_REQ_NOX_SENS_TMP_1 ECU_ADDRESS 0xd0003ac8 BIT_MASK 0x1 /end MEASUREMENT
/begin MEASUREMENT lv_rgn_req_nox_sens_tmp_2 "bench selective regeneration request caused by the NOx sensor signal" UBYTE _CNV_S_2_RANGE__0___1_CM 1 100. 0. 1. DISPLAY_IDENTIFIER LV_RGN_REQ_NOX_SENS_TMP_2 ECU_ADDRESS 0xd0003ac9 BIT_MASK 0x1 /end MEASUREMENT
/begin MEASUREMENT lv_sens_afr_trim_tmp_1 "downstream sensor sees rich exhaust gas (homogeneous detection threshold) (bench selective)" UBYTE _CNV_S_2_RANGE__0___1_CM 1 100. 0. 1. DISPLAY_IDENTIFIER LV_SENS_AFR_TRIM_TMP_1 ECU_ADDRESS 0xd0003ace BIT_MASK 0x1 /end MEASUREMENT
/begin MEASUREMENT lv_sens_afr_trim_tmp_2 "downstream sensor sees rich exhaust gas (homogeneous detection threshold) (bench selective)" UBYTE _CNV_S_2_RANGE__0___1_CM 1 100. 0. 1. DISPLAY_IDENTIFIER LV_SENS_AFR_TRIM_TMP_2 ECU_ADDRESS 0xd0003acf BIT_MASK 0x1 /end MEASUREMENT
/begin MEASUREMENT nt_eff_bas "Basis NOx trap efficiency" UWORD _CNV_A_R_LINEAR_____68_CM 1 100. 0. 0.9999847412109381 DISPLAY_IDENTIFIER NT_EFF_BAS ECU_ADDRESS 0xc0000ad4 FORMAT "%7.5" /end MEASUREMENT
/begin MEASUREMENT ntld_max_afs "maximum NOx trap loading degree for requesting a regeneration before lambda1 operation" UWORD _CNV_A_R_LINEAR_____68_CM 1 100. 0. 0.9999847412109381 DISPLAY_IDENTIFIER NTLD_MAX_AFS ECU_ADDRESS 0xd0004e9c FORMAT "%7.5" /end MEASUREMENT
/begin MEASUREMENT ntld_max_afs_bas "Basis maximum NOx trap loading degree for requesting a regeneration before lambda1 operation" UWORD _CNV_A_R_LINEAR_____68_CM 1 100. 0. 0.9999847412109381 DISPLAY_IDENTIFIER NTLD_MAX_AFS_BAS ECU_ADDRESS 0xc0000ad6 FORMAT "%7.5" /end MEASUREMENT
/begin MEASUREMENT nox_sens_max_bas "Not corrected NOx sensor signal threshold for requesting a regeneration" UWORD _CNV_A_R_LINEAR_____499_CM 1 100. 0. 1500. DISPLAY_IDENTIFIER NOX_SENS_MAX_BAS ECU_ADDRESS 0xc0000ad8 FORMAT "%4.0" /end MEASUREMENT
/begin AXIS_PTS ldpm_ntld "" 0xa1022178 ntld _REC_AXS_20_u2 0.9999847412109381 _CNV_A_R_LINEAR_____68_CM 8 0. 0.9999847412109381 FORMAT "%7.5" /end AXIS_PTS
/begin CHARACTERISTIC ip_nt_eff_bas_ef_close "basic NOx trap efficiency for closed exhaust flap" MAP 0xa1026ba8 _REC_MAP_20_u2_u2_u1 0.9999847412109381 _CNV_A_R_LINEAR_____68_CM 0. 0.9999847412109381 DISPLAY_IDENTIFIER IP_NT_EFF_BAS_EF_CLOSE FORMAT "%7.5"
 /begin AXIS_DESCR COM_AXIS ntld _CNV_A_R_LINEAR_____68_CM 8 0. 0.9999847412109381 FORMAT "%7.5" AXIS_PTS_REF ldpm_ntld /end AXIS_DESCR
 /begin AXIS_DESCR COM_AXIS tnt_mdl_mv _CNV_A_R_LINEAR_____490_CM 8 0. 1020. FORMAT "%4.0" AXIS_PTS_REF ldpm_tnt_mdl_nox /end AXIS_DESCR
/end CHARACTERISTIC
/begin AXIS_PTS ldpm_nt_agi "" 0xa102212c nt_agi _REC_AXS_20_u2 0.9999847412109381 _CNV_A_R_LINEAR_____68_CM 4 0. 0.9999847412109381 FORMAT "%7.5" /end AXIS_PTS
/begin AXIS_PTS ldp_tqi_req_fast_ip_ntld_afs_at "" 0xa10215e8 tqi_req_fast _REC_AXS_20_u2 2047.96875 _CNV_A_R_LINEAR_____65_CM 8 -1024. 1023.96875 FORMAT "%8.2" /end AXIS_PTS
/begin AXIS_PTS ldp_tqi_req_fast_ip_ntld_afs_mt "" 0xa10215fc tqi_req_fast _REC_AXS_20_u2 2047.96875 _CNV_A_R_LINEAR_____65_CM 8 -1024. 1023.96875 FORMAT "%8.2" /end AXIS_PTS
/begin AXIS_PTS ldp_n_32_ntld_max_afs_mt "" 0xa1020e78 n_32 _REC_AXS_20_u1 8160. _CNV_A_R_LINEAR_____9_CM 4 0. 8160. FORMAT "%4.0" /end AXIS_PTS
/begin AXIS_PTS ldp_n_32_ntld_max_afs_at "" 0xa1020e72 n_32 _REC_AXS_20_u1 8160. _CNV_A_R_LINEAR_____9_CM 4 0. 8160. FORMAT "%4.0" /end AXIS_PTS
/begin CHARACTERISTIC ip_fac_nox_sens_max "factor to correct threshold of the NOx sensor signal for requesting a regeneration" MAP 0xa1023ba8 _REC_MAP_20_u1_u2_u2 1.9921875 _CNV_A_R_LINEAR_____100_CM 0. 1.9921875 DISPLAY_IDENTIFIER IP_FAC_NOX_SENS_MAX FORMAT "%5.3"
 /begin AXIS_DESCR COM_AXIS nt_agi _CNV_A_R_LINEAR_____68_CM 4 0. 0.9999847412109381 FORMAT "%7.5" AXIS_PTS_REF ldpm_nt_agi /end AXIS_DESCR
 /begin AXIS_DESCR COM_AXIS tnt_mdl_mv _CNV_A_R_LINEAR_____197_CM 6 0. 1023.984375 FORMAT "%11.6" AXIS_PTS_REF ldp_tnt_mdl_mv_ip_fac_nox_sens /end AXIS_DESCR
/end CHARACTERISTIC
/begin CHARACTERISTIC c_fac_ntld_max_afs_err_egr "factor to correct homogen request in case of EGR_ERR" VALUE 0xa1029396 _REC_VAL_20_u1 1.9921875 _CNV_A_R_LINEAR_____100_CM 0. 1.9921875 DISPLAY_IDENTIFIER C_FAC_NTLD_MAX_AFS_ERR_EGR FORMAT "%5.3" /end CHARACTERISTIC
/begin AXIS_PTS ldp_flow_nt_mmv_ip_nox_sens_mt "" 0xa1020a00 flow_nt_mmv _REC_AXS_20_u2 2047.96875 _CNV_A_R_LINEAR_____207_CM 6 0. 2047.96875 FORMAT "%7.2" /end AXIS_PTS
/begin AXIS_PTS ldp_flow_nt_mmv_ip_nox_sens_at "" 0xa10209f0 flow_nt_mmv _REC_AXS_20_u2 2047.96875 _CNV_A_R_LINEAR_____207_CM 6 0. 2047.96875 FORMAT "%7.2" /end AXIS_PTS
/begin AXIS_PTS ldp_n_32_ip_nox_sens_max_mt "" 0xa1020e34 n_32 _REC_AXS_20_u1 8160. _CNV_A_R_LINEAR_____9_CM 8 0. 8160. FORMAT "%4.0" /end AXIS_PTS
/begin AXIS_PTS ldp_n_32_ip_nox_sens_max_at "" 0xa1020e28 n_32 _REC_AXS_20_u1 8160. _CNV_A_R_LINEAR_____9_CM 8 0. 8160. FORMAT "%4.0" /end AXIS_PTS
/begin CHARACTERISTIC c_nox_ppm_dif_mon "Max. deviation between model and NOx sensor" VALUE 0xa10296ae _REC_VAL_20_u2 1500. _CNV_A_R_LINEAR_____499_CM 0. 1500. DISPLAY_IDENTIFIER C_NOX_PPM_DIF_MON FORMAT "%4.0" /end CHARACTERISTIC
/begin CHARACTERISTIC c_nox_sens_max_ofs "Threshold offset of the NOx sensor signal for requesting a regeneration" VALUE 0xa10296b8 _REC_VAL_20_u2 1500. _CNV_A_R_LINEAR_____499_CM 0. 1500. DISPLAY_IDENTIFIER C_NOX_SENS_MAX_OFS FORMAT "%4.0" /end CHARACTERISTIC
/begin AXIS_PTS ldp_nt_agi_thermo__tnt_mdl_max "" 0xa10210b6 nt_agi _REC_AXS_20_u1 0.99609375 _CNV_A_R_LINEAR_____27_CM 4 0. 0.99609375 FORMAT "%5.3" /end AXIS_PTS
/begin CHARACTERISTIC ip_ntld_max_afs_at "maximum NOx trap loading degree for requesting a regeneration before lambda1 operation ( for automatic transmission )" MAP 0xa1026fb8 _REC_MAP_20_u2_u2_u1 0.9999847412109381 _CNV_A_R_LINEAR_____68_CM 0. 0.9999847412109381 DISPLAY_IDENTIFIER IP_NTLD_MAX_AFS_AT FORMAT "%7.5"
 /begin AXIS_DESCR COM_AXIS tqi_req_fast _CNV_A_R_LINEAR_____65_CM 8 -1024. 1023.96875 FORMAT "%8.2" AXIS_PTS_REF ldp_tqi_req_fast_ip_ntld_afs_at /end AXIS_DESCR
 /begin AXIS_DESCR COM_AXIS n_32 _CNV_A_R_LINEAR_____9_CM 4 0. 8160. FORMAT "%4.0" AXIS_PTS_REF ldp_n_32_ntld_max_afs_at /end AXIS_DESCR
/end CHARACTERISTIC
/begin CHARACTERISTIC ip_ntld_max_afs_mt "maximum NOx trap loading degree for requesting a regeneration before lambda1 operation ( for manual transmission )" MAP 0xa1026ff8 _REC_MAP_20_u2_u2_u1 0.9999847412109381 _CNV_A_R_LINEAR_____68_CM 0. 0.9999847412109381 DISPLAY_IDENTIFIER IP_NTLD_MAX_AFS_MT FORMAT "%7.5"
 /begin AXIS_DESCR COM_AXIS tqi_req_fast _CNV_A_R_LINEAR_____65_CM 8 -1024. 1023.96875 FORMAT "%8.2" AXIS_PTS_REF ldp_tqi_req_fast_ip_ntld_afs_mt /end AXIS_DESCR
 /begin AXIS_DESCR COM_AXIS n_32 _CNV_A_R_LINEAR_____9_CM 4 0. 8160. FORMAT "%4.0" AXIS_PTS_REF ldp_n_32_ntld_max_afs_mt /end AXIS_DESCR
/end CHARACTERISTIC
/begin CHARACTERISTIC ip_nox_sens_max_mt "threshold of the NOx sensor signal for requesting a regeneration for MT" MAP 0xa1026974 _REC_MAP_20_u2_u2_u1 1500. _CNV_A_R_LINEAR_____499_CM 0. 1500. DISPLAY_IDENTIFIER IP_NOX_SENS_MAX_MT FORMAT "%4.0"
 /begin AXIS_DESCR COM_AXIS flow_nt_mmv _CNV_A_R_LINEAR_____207_CM 6 0. 2047.96875 FORMAT "%7.2" AXIS_PTS_REF ldp_flow_nt_mmv_ip_nox_sens_mt /end AXIS_DESCR
 /begin AXIS_DESCR COM_AXIS n_32 _CNV_A_R_LINEAR_____9_CM 8 0. 8160. FORMAT "%4.0" AXIS_PTS_REF ldp_n_32_ip_nox_sens_max_mt /end AXIS_DESCR
/end CHARACTERISTIC
/begin CHARACTERISTIC ip_nox_sens_max_at "threshold of the NOx sensor signal for requesting a regeneration for AT" MAP 0xa1026914 _REC_MAP_20_u2_u2_u1 1500. _CNV_A_R_LINEAR_____499_CM 0. 1500. DISPLAY_IDENTIFIER IP_NOX_SENS_MAX_AT FORMAT "%4.0"
 /begin AXIS_DESCR COM_AXIS flow_nt_mmv _CNV_A_R_LINEAR_____207_CM 6 0. 2047.96875 FORMAT "%7.2" AXIS_PTS_REF ldp_flow_nt_mmv_ip_nox_sens_at /end AXIS_DESCR
 /begin AXIS_DESCR COM_AXIS n_32 _CNV_A_R_LINEAR_____9_CM 8 0. 8160. FORMAT "%4.0" AXIS_PTS_REF ldp_n_32_ip_nox_sens_max_at /end AXIS_DESCR
/end CHARACTERISTIC
/begin CHARACTERISTIC c_nt_stc_bas_max_rng_h "maximum value of base NOx trap storage capacity map" VALUE 0xa10296e2 _REC_VAL_20_u2 20971.2 _CNV_A_R_LINEAR_____510_CM 0. 20971.2 DISPLAY_IDENTIFIER C_NT_STC_BAS_MAX_RNG_H FORMAT "%7.1" /end CHARACTERISTIC
/begin MEASUREMENT nt_stc_rng_h "NOx trap storage capacity" UWORD _CNV_A_R_LINEAR_____510_CM 1 100. 0. 20971.2 DISPLAY_IDENTIFIER NT_STC_RNG_H ECU_ADDRESS 0xc0000acc FORMAT "%7.1" /end MEASUREMENT
/begin MEASUREMENT nt_stc_bas_rng_h "NOx trap base storage capacity" UWORD _CNV_A_R_LINEAR_____510_CM 1 100. 0. 20971.2 DISPLAY_IDENTIFIER NT_STC_BAS_RNG_H ECU_ADDRESS 0xd0004e76 FORMAT "%7.1" /end MEASUREMENT
/begin MEASUREMENT t_afl_sum "sum_of_lean_time" ULONG _CNV_A_R_LINEAR_____511_CM 1 100. 0. 85900000. DISPLAY_IDENTIFIER T_AFL_SUM ECU_ADDRESS 0xd000558c FORMAT "%11.0" /end MEASUREMENT
/begin CHARACTERISTIC ip_nt_stc_bas_rng_h "NOx trap storage capacity" MAP 0xa1026c68 _REC_MAP_20_u2_u2_u1 20971.2 _CNV_A_R_LINEAR_____510_CM 0. 20971.2 DISPLAY_IDENTIFIER IP_NT_STC_BAS_RNG_H FORMAT "%7.1"
 /begin AXIS_DESCR COM_AXIS nox_conc_mmv _CNV_A_R_LINEAR_____499_CM 8 0. 65535. FORMAT "%5.0" AXIS_PTS_REF ldp_nox_conc_mmv_ip_nt_stc_bas /end AXIS_DESCR
 /begin AXIS_DESCR COM_AXIS tnt_mdl_mv _CNV_A_R_LINEAR_____490_CM 8 0. 1020. FORMAT "%4.0" AXIS_PTS_REF ldpm_tnt_mdl_nox /end AXIS_DESCR
/end CHARACTERISTIC
/begin CHARACTERISTIC c_nt_stc_ini_rng_h "initialisation value of actual and base NOx trap storage capacity" VALUE 0xa10296e4 _REC_VAL_20_u2 20971.2 _CNV_A_R_LINEAR_____510_CM 0. 20971.2 DISPLAY_IDENTIFIER C_NT_STC_INI_RNG_H FORMAT "%7.1" /end CHARACTERISTIC
/begin MEASUREMENT lv_nt_act "flag for NOx catalyst function activation" UBYTE _CNV_S_2_RANGE__0___1_CM 1 100. 0. 1. DISPLAY_IDENTIFIER LV_NT_ACT ECU_ADDRESS 0xd0003aab BIT_MASK 0x1 /end MEASUREMENT
/begin MEASUREMENT lv_sens_rgn_1_ready "end of first regeneration" UBYTE _CNV_S_2_RANGE__0___1_CM 1 100. 0. 1. DISPLAY_IDENTIFIER LV_SENS_RGN_1_READY ECU_ADDRESS 0xd0003abc BIT_MASK 0x1 /end MEASUREMENT
/begin MEASUREMENT lv_rgn_cdn "flag for testing whether or not regeneration conditions are given" UBYTE _CNV_S_2_RANGE__0___1_CM 1 100. 0. 1. DISPLAY_IDENTIFIER LV_RGN_CDN ECU_ADDRESS 0xd0003abe BIT_MASK 0x1 /end MEASUREMENT
/begin MEASUREMENT lv_vls_grd_neg "negative gradient of vls_nox_sens_1 between first and second regeneration" UBYTE _CNV_S_2_RANGE__0___1_CM 1 100. 0. 1. DISPLAY_IDENTIFIER LV_VLS_GRD_NEG ECU_ADDRESS 0xd0003ac0 BIT_MASK 0x1 /end MEASUREMENT
/begin MEASUREMENT ntl_min "minimum NOx trap loading" UWORD _CNV_A_R_LINEAR_____495_CM 1 100. 0. 10485.6 DISPLAY_IDENTIFIER NTL_MIN ECU_ADDRESS 0xd0004e7e FORMAT "%7.1" /end MEASUREMENT
/begin MEASUREMENT vls_min_tmp "temporary local minimum of vls_nox_sens_1" UWORD _CNV_A_R_LINEAR_____211_CM 1 100. -200. 1200. DISPLAY_IDENTIFIER VLS_MIN_TMP ECU_ADDRESS 0xc0000ada FORMAT "%5.0" /end MEASUREMENT
/begin MEASUREMENT vls_max_tmp "temporary local maximum of vls_nox_sens_1" UWORD _CNV_A_R_LINEAR_____211_CM 1 100. -200. 1200. DISPLAY_IDENTIFIER VLS_MAX_TMP ECU_ADDRESS 0xc0000adc FORMAT "%5.0" /end MEASUREMENT
/begin CHARACTERISTIC lc_nt_act "logical constant for NOx catalyst function activation" VALUE 0xa1029da0 _REC_VAL_20_u1 1. _CNV_A_R_LINEAR_____0_CM 0. 1. DISPLAY_IDENTIFIER LC_NT_ACT FORMAT "%1.0" /end CHARACTERISTIC
/begin CHARACTERISTIC lc_sens_afr_mod "selection of calculation method for LV_SENS_AFR_i" VALUE 0xa1029dd4 _REC_VAL_20_u1 1. _CNV_A_R_LINEAR_____0_CM 0. 1. DISPLAY_IDENTIFIER LC_SENS_AFR_MOD FORMAT "%1.0" /end CHARACTERISTIC
/begin CHARACTERISTIC c_t_nt_hom_max_vld "lean time threshold for resetting the homogeneous time T_NT_HOM" VALUE 0xa1029934 _REC_VAL_20_u2 655.35 _CNV_A_R_LINEAR_____3_CM 0. 655.35 DISPLAY_IDENTIFIER C_T_NT_HOM_MAX_VLD FORMAT "%6.2" /end CHARACTERISTIC
/begin CHARACTERISTIC c_vls_nox_sens_afr_trim "binary NOx sensor signal threshold for determining rich trim conditions" VALUE 0xa1029c58 _REC_VAL_20_u2 1400. _CNV_A_R_LINEAR_____211_CM -200. 1200. DISPLAY_IDENTIFIER C_VLS_NOX_SENS_AFR_TRIM FORMAT "%4.0" /end CHARACTERISTIC
/begin CHARACTERISTIC c_vls_dist_grd_neg "Difference between local maximum and current value for calculation of negative gradient" VALUE 0xa1029c2c _REC_VAL_20_u2 1400. _CNV_A_R_LINEAR_____211_CM -200. 1200. DISPLAY_IDENTIFIER C_VLS_DIST_GRD_NEG FORMAT "%5.0" /end CHARACTERISTIC
/begin CHARACTERISTIC c_vls_dist_grd_pos "Difference between local minimum and current value for calculation of positive gradient" VALUE 0xa1029c2e _REC_VAL_20_u2 1400. _CNV_A_R_LINEAR_____211_CM -200. 1200. DISPLAY_IDENTIFIER C_VLS_DIST_GRD_POS FORMAT "%5.0" /end CHARACTERISTIC
/begin CHARACTERISTIC c_vls_max_rgn_2_stop "Threshold value for end of second regeneration" VALUE 0xa1029c4a _REC_VAL_20_u2 1400. _CNV_A_R_LINEAR_____211_CM -200. 1200. DISPLAY_IDENTIFIER C_VLS_MAX_RGN_2_STOP FORMAT "%5.0" /end CHARACTERISTIC
/begin CHARACTERISTIC ip_tnt_mdl_min "minimum NOx trap temperature for lean operation" CURVE 0xa102815c _REC_CUR_20_u1_u1 1020. _CNV_A_R_LINEAR_____490_CM 0. 1020. DISPLAY_IDENTIFIER IP_TNT_MDL_MIN FORMAT "%4.0"
 /begin AXIS_DESCR COM_AXIS nt_agi _CNV_A_R_LINEAR_____27_CM 4 0. 0.99609375 FORMAT "%5.3" AXIS_PTS_REF ldp_nt_agi_thermo__tnt_mdl_min /end AXIS_DESCR
/end CHARACTERISTIC
/begin CHARACTERISTIC ip_tnt_mdl_min_is "minimum NOx trap temperature for lean operation at idle speed" CURVE 0xa1028160 _REC_CUR_20_u1_u1 1020. _CNV_A_R_LINEAR_____490_CM 0. 1020. DISPLAY_IDENTIFIER IP_TNT_MDL_MIN_IS FORMAT "%4.0"
 /begin AXIS_DESCR COM_AXIS nt_agi _CNV_A_R_LINEAR_____27_CM 4 0. 0.99609375 FORMAT "%5.3" AXIS_PTS_REF ldp_nt_agi_thermo_ip_tnt_min_is /end AXIS_DESCR
/end CHARACTERISTIC
/begin AXIS_PTS ldp_nt_agi_thermo__tnt_mdl_min "" 0xa10210bc nt_agi _REC_AXS_20_u1 0.99609375 _CNV_A_R_LINEAR_____27_CM 4 0. 0.99609375 FORMAT "%5.3" /end AXIS_PTS
/begin AXIS_PTS ldp_nt_agi_thermo_ip_tnt_min_is "" 0xa10210de nt_agi _REC_AXS_20_u1 0.99609375 _CNV_A_R_LINEAR_____27_CM 4 0. 0.99609375 FORMAT "%5.3" /end AXIS_PTS
/begin CHARACTERISTIC c_vls_max_rgn_1_stop "Threshold value for end of first regeneration" VALUE 0xa1029c48 _REC_VAL_20_u2 1400. _CNV_A_R_LINEAR_____211_CM -200. 1200. DISPLAY_IDENTIFIER C_VLS_MAX_RGN_1_STOP FORMAT "%5.0" /end CHARACTERISTIC
/begin CHARACTERISTIC c_vls_grd_neg_vls_set "Negative gradient for set of LV_SENS_AFR_2 with VLS signal" VALUE 0xa1029c46 _REC_VAL_20_u2 1400. _CNV_A_R_LINEAR_____211_CM -200. 1200. DISPLAY_IDENTIFIER C_VLS_GRD_NEG_VLS_SET FORMAT "%5.0" /end CHARACTERISTIC
/begin MEASUREMENT vls_nox_sens_old "old binary O2 signal voltage, raw value, measured by NOx sensor" UWORD _CNV_A_R_LINEAR_____211_CM 1 100. -200. 1200. DISPLAY_IDENTIFIER VLS_NOX_SENS_OLD ECU_ADDRESS 0xc000087a FORMAT "%5.0" /end MEASUREMENT
/begin MEASUREMENT nox_out_int_tmp_1 "temporary internal NOx out integral value for NOx sensor regeneration request calculation" UWORD _CNV_A_R_LINEAR_____495_CM 1 100. 0. 10485.6 DISPLAY_IDENTIFIER NOX_OUT_INT_TMP_1 ECU_ADDRESS 0xc0000afc FORMAT "%7.1" /end MEASUREMENT
/begin MEASUREMENT nox_cor_int "Integral of modelled NOx raw emissions (pre NOx catalyst) at current lean operation phase" UWORD _CNV_A_R_LINEAR_____495_CM 1 100. 0. 10485.6 DISPLAY_IDENTIFIER NOX_COR_INT ECU_ADDRESS 0xc0000aca FORMAT "%7.1" /end MEASUREMENT
/begin MEASUREMENT dist_afl_st "Mileage counter value at start of lean operation phase (STATE_NOX = LOAD)" ULONG _CNV_A_R_LINEAR_____446_CM 1 100. 0. 429496729500. DISPLAY_IDENTIFIER DIST_AFL_ST ECU_ADDRESS 0xc0000b0c FORMAT "%12.0" /end MEASUREMENT
/begin MEASUREMENT lv_nox_sens_nox_vld_rgn_st_1 "flag: NOx sensor NOx signal validity at the moment the NOx sensor rgn request is set" UBYTE _CNV_S_2_RANGE__0___1_CM 1 100. 0. 1. DISPLAY_IDENTIFIER LV_NOX_SENS_NOX_VLD_RGN_ST_1 ECU_ADDRESS 0xd0003ad0 BIT_MASK 0x1 /end MEASUREMENT
/begin MEASUREMENT dist_afl "Mileage during current lean operation phase (STATE_NOX = LOAD)" UWORD _CNV_A_R_LINEAR_____512_CM 1 100. 0. 6553.5 DISPLAY_IDENTIFIER DIST_AFL ECU_ADDRESS 0xc0000ae4 FORMAT "%6.1" /end MEASUREMENT
/begin MEASUREMENT t_stop "Time counter since start of STATE_NOX = STOP is active" UWORD _CNV_A_R_LINEAR_____3_CM 1 100. 0. 655.35 DISPLAY_IDENTIFIER T_STOP ECU_ADDRESS 0xc0000ae6 FORMAT "%6.2" /end MEASUREMENT
/begin MEASUREMENT maf_int_stop "Air mass integral since start of STATE_NOX = STOP is active" UWORD _CNV_A_R_ANOX_LINEA_513_CM 1 100. 0. 1456.333333 DISPLAY_IDENTIFIER MAF_INT_STOP ECU_ADDRESS 0xc0000ae8 FORMAT "%7.2" /end MEASUREMENT
/begin MEASUREMENT state_nox "NOx catalyst state" UBYTE _CNV_S_6_STATE_NOX__514_CM 1 100. 0. 5. DISPLAY_IDENTIFIER STATE_NOX ECU_ADDRESS 0xd0003aa8 /end MEASUREMENT
/begin CHARACTERISTIC c_vls_down_afr_trim "binary lambda sensor signal threshold for determining rich trim conditions" VALUE 0xa1029c3c _REC_VAL_20_u2 4.9951171875 _CNV_A_R_LINEAR_____2_CM 0. 4.9951171875 DISPLAY_IDENTIFIER C_VLS_DOWN_AFR_TRIM FORMAT "%5.3" /end CHARACTERISTIC
/begin CHARACTERISTIC c_t_stop_afl_purge_max "Time limit for activation of catalyst purge after lean operation at STATE_NOX = STOP" VALUE 0xa1029962 _REC_VAL_20_u2 655.35 _CNV_A_R_LINEAR_____3_CM 0. 655.35 DISPLAY_IDENTIFIER C_T_STOP_AFL_PURGE_MAX FORMAT "%6.2" /end CHARACTERISTIC
/begin CHARACTERISTIC c_maf_int_stop_afl_purge_max "Air mass integral limit for activation of catalyst purge after lean operation at STATE_NOX = STOP" VALUE 0xa1029548 _REC_VAL_20_u2 1456.333333 _CNV_A_R_ANOX_LINEA_513_CM 0. 1456.333333 DISPLAY_IDENTIFIER C_MAF_INT_STOP_AFL_PURGE_MAX FORMAT "%7.2" /end CHARACTERISTIC
/begin CHARACTERISTIC c_ctr_afl_purge_max "Maximum number of activation cycles for catalyst purge after lean operation at STATE_NOX = STOP" VALUE 0xa102924a _REC_VAL_20_u1 255. _CNV_A_R_LINEAR_____0_CM 0. 255. DISPLAY_IDENTIFIER C_CTR_AFL_PURGE_MAX FORMAT "%3.0" /end CHARACTERISTIC
/begin CHARACTERISTIC c_vls_down_afl_purge_on "VLS_DOWN activation threshold for catalyst purge after lean operation at STATE_NOX = STOP" VALUE 0xa1029c34 _REC_VAL_20_u2 4.9951171875 _CNV_A_R_LINEAR_____2_CM 0. 4.9951171875 DISPLAY_IDENTIFIER C_VLS_DOWN_AFL_PURGE_ON FORMAT "%5.3" /end CHARACTERISTIC
/begin CHARACTERISTIC c_vls_down_afl_purge_off "VLS_DOWN deactivation threshold for catalyst purge after lean operation at STATE_NOX = STOP" VALUE 0xa1029c32 _REC_VAL_20_u2 4.9951171875 _CNV_A_R_LINEAR_____2_CM 0. 4.9951171875 DISPLAY_IDENTIFIER C_VLS_DOWN_AFL_PURGE_OFF FORMAT "%5.3" /end CHARACTERISTIC
/begin CHARACTERISTIC c_vls_nox_sens_afl_purge_on "VLS_NOX_SENS activation threshold for catalyst purge after lean operation at STATE_NOX = STOP" VALUE 0xa1029c52 _REC_VAL_20_u2 1400. _CNV_A_R_LINEAR_____211_CM -200. 1200. DISPLAY_IDENTIFIER C_VLS_NOX_SENS_AFL_PURGE_ON FORMAT "%4.0" /end CHARACTERISTIC
/begin CHARACTERISTIC c_vls_nox_sens_afl_purge_off "VLS_NOX_SENS deactivation threshold for catalyst purge after lean operation at STATE_NOX = STOP" VALUE 0xa1029c50 _REC_VAL_20_u2 1400. _CNV_A_R_LINEAR_____211_CM -200. 1200. DISPLAY_IDENTIFIER C_VLS_NOX_SENS_AFL_PURGE_OFF FORMAT "%4.0" /end CHARACTERISTIC
/begin CHARACTERISTIC c_lamb_nox_sens_afl_purge_on "LAMB_NOX_SENS activation threshold for catalyst purge after lean operation at STATE_NOX = STOP" VALUE 0xa10294e0 _REC_VAL_20_u2 31.9990234375 _CNV_A_R_LINEAR_____122_CM 0. 31.9990234375 DISPLAY_IDENTIFIER C_LAMB_NOX_SENS_AFL_PURGE_ON FORMAT "%7.4" /end CHARACTERISTIC
/begin CHARACTERISTIC c_lamb_nox_sens_afl_purge_off "LAMB_NOX_SENS deactivation threshold for catalyst purge after lean operation at STATE_NOX = STOP" VALUE 0xa10294de _REC_VAL_20_u2 31.9990234375 _CNV_A_R_LINEAR_____122_CM 0. 31.9990234375 DISPLAY_IDENTIFIER C_LAMB_NOX_SENS_AFL_PURGE_OFF FORMAT "%7.4" /end CHARACTERISTIC
/begin CHARACTERISTIC c_vs_inh_purge "vehicle speed threshold for inhibiting a catalyst purge" VALUE 0xa1029c9d _REC_VAL_20_u1 255. _CNV_A_R_LINEAR_____6_CM 0. 255. DISPLAY_IDENTIFIER C_VS_INH_PURGE FORMAT "%3.0" /end CHARACTERISTIC
/begin CHARACTERISTIC lc_nox_rpu "General switch to enable switch to RPU values" VALUE 0xa1029d8b _REC_VAL_20_u1 1. _CNV_A_R_LINEAR_____0_CM 0. 1. DISPLAY_IDENTIFIER LC_NOX_RPU FORMAT "%1.0" /end CHARACTERISTIC
/begin CHARACTERISTIC lc_inh_afl_purge_tout "Inhibition of catalyst purge break if a time out condition fulfilled" VALUE 0xa1029d46 _REC_VAL_20_u1 1. _CNV_A_R_LINEAR_____0_CM 0. 1. DISPLAY_IDENTIFIER LC_INH_AFL_PURGE_TOUT FORMAT "%1.0" /end CHARACTERISTIC
/begin AXIS_PTS ldpm_tqi_req_fast_1_egtr "" 0xa102237c tqi_req_fast _REC_AXS_20_u2 2047.96875 _CNV_A_R_LINEAR_____65_CM 8 -1024. 1023.96875 FORMAT "%8.2" /end AXIS_PTS
/begin AXIS_PTS ldp_tnt_mdl_mv_ip_fac_nox_sens "" 0xa10213c0 tnt_mdl_mv _REC_AXS_20_u2 1023.984375 _CNV_A_R_LINEAR_____197_CM 6 0. 1023.984375 FORMAT "%11.6" /end AXIS_PTS
/begin AXIS_PTS ldp_nox_cor_ip_nt_eff_cor "" 0xa102105c nox_cor _REC_AXS_20_u2 1023.984375 _CNV_A_R_LINEAR_____492_CM 8 0. 1023.984375 FORMAT "%7.2" /end AXIS_PTS
/begin CHARACTERISTIC ip_tnt_mdl_max "maximum NOx trap temperature for lean operation" CURVE 0xa1028158 _REC_CUR_20_u1_u1 1020. _CNV_A_R_LINEAR_____490_CM 0. 1020. DISPLAY_IDENTIFIER IP_TNT_MDL_MAX FORMAT "%4.0"
 /begin AXIS_DESCR COM_AXIS nt_agi _CNV_A_R_LINEAR_____27_CM 4 0. 0.99609375 FORMAT "%5.3" AXIS_PTS_REF ldp_nt_agi_thermo__tnt_mdl_max /end AXIS_DESCR
/end CHARACTERISTIC
/begin AXIS_PTS ldp_ntl_dec_int_ip_t_max_rgn "" 0xa1021104 ntl_dec_int_1 _REC_AXS_20_u2 10485.6 _CNV_A_R_LINEAR_____495_CM 6 0. 10485.6 FORMAT "%8.2" /end AXIS_PTS
/begin AXIS_PTS ldp_ntl_rgn_st_ip_t_max_rgn "" 0xa1021124 ntl_rgn_st _REC_AXS_20_u2 10485.6 _CNV_A_R_LINEAR_____495_CM 6 0. 10485.6 FORMAT "%8.2" /end AXIS_PTS
/begin AXIS_PTS ldp_ntl_rgn_st_ip_ntl_dec_int "" 0xa1021114 ntl_rgn_st _REC_AXS_20_u2 10485.6 _CNV_A_R_LINEAR_____495_CM 6 0. 10485.6 FORMAT "%8.2" /end AXIS_PTS
/begin CHARACTERISTIC ip_t_max_rgn_2_stop "Maximum time duration of second regeneration" MAP 0xa1027c68 _REC_MAP_20_u2_u2_u2 655.35 _CNV_A_R_LINEAR_____3_CM 0. 655.35 DISPLAY_IDENTIFIER IP_T_MAX_RGN_2_STOP FORMAT "%6.2"
 /begin AXIS_DESCR COM_AXIS ntl_rgn_st _CNV_A_R_LINEAR_____495_CM 6 0. 10485.6 FORMAT "%8.2" AXIS_PTS_REF ldp_ntl_rgn_st_ip_t_max_rgn /end AXIS_DESCR
 /begin AXIS_DESCR COM_AXIS ntl_dec_int_1 _CNV_A_R_LINEAR_____495_CM 6 0. 10485.6 FORMAT "%8.2" AXIS_PTS_REF ldp_ntl_dec_int_ip_t_max_rgn /end AXIS_DESCR
/end CHARACTERISTIC
/begin CHARACTERISTIC ip_ntl_dec_int_max "Maximum amount of regeneration agent" CURVE 0xa1026dec _REC_CUR_20_u2_u2 10485.6 _CNV_A_R_LINEAR_____495_CM 0. 10485.6 DISPLAY_IDENTIFIER IP_NTL_DEC_INT_MAX FORMAT "%8.2"
 /begin AXIS_DESCR COM_AXIS ntl_rgn_st _CNV_A_R_LINEAR_____495_CM 6 0. 10485.6 FORMAT "%8.2" AXIS_PTS_REF ldp_ntl_rgn_st_ip_ntl_dec_int /end AXIS_DESCR
/end CHARACTERISTIC
/begin CHARACTERISTIC c_dist_afl_min "Minimum mileage for calculation of RATIO_NOX_OUT_INT_DIST" VALUE 0xa1029302 _REC_VAL_20_u2 6553.5 _CNV_A_R_LINEAR_____512_CM 0. 6553.5 DISPLAY_IDENTIFIER C_DIST_AFL_MIN FORMAT "%6.1" /end CHARACTERISTIC
/begin CHARACTERISTIC c_ratio_nox_out_int_dist_max "Maximum ratio of NOx out integral to mileage at current lean phase; threshold for start of a NOx regeneration" VALUE 0xa1029782 _REC_VAL_20_u2 6.5535 _CNV_A_R_ANOX_LINEA_515_CM 0. 6.5535 DISPLAY_IDENTIFIER C_RATIO_NOX_OUT_INT_DIST_MAX FORMAT "%6.4" /end CHARACTERISTIC
/begin CHARACTERISTIC c_nox_cor_int_min "Minimum NOx raw emission integral value for calculation of RATIO_NOX" VALUE 0xa102968a _REC_VAL_20_u2 10485.6 _CNV_A_R_LINEAR_____495_CM 0. 10485.6 DISPLAY_IDENTIFIER C_NOX_COR_INT_MIN FORMAT "%8.2" /end CHARACTERISTIC
/begin CHARACTERISTIC c_crlc_flow_nt "correlation constant for calculation of filtered exhaust gas flow" VALUE 0xa10291fc _REC_VAL_20_u2 0.9999847412109381 _CNV_A_R_LINEAR_____68_CM 0. 0.9999847412109381 DISPLAY_IDENTIFIER C_CRLC_FLOW_NT FORMAT "%7.5" /end CHARACTERISTIC
/begin CHARACTERISTIC c_ratio_nox_max "Maximum ratio of NOx out integral to NOx raw emission integral; threshold for start of a NOx regenration" VALUE 0xa1029780 _REC_VAL_20_u2 99.99847412109381 _CNV_A_R_LINEAR_____7_CM 0. 99.99847412109381 DISPLAY_IDENTIFIER C_RATIO_NOX_MAX /end CHARACTERISTIC
/begin MEASUREMENT lv_cat_purge_req_post_afl[0] "Request for catalyst purge activation when leaving lean burn operation" UBYTE _CNV_S_2_RANGE__0___1_CM 1 100. 0. 1. DISPLAY_IDENTIFIER lv_cat_purge_req_post_afl_1 ECU_ADDRESS 0xd0003ac2 BIT_MASK 0x1 /end MEASUREMENT
/begin MEASUREMENT lv_cat_purge_req_post_afl[1] "Request for catalyst purge activation when leaving lean burn operation" UBYTE _CNV_S_2_RANGE__0___1_CM 1 100. 0. 1. DISPLAY_IDENTIFIER lv_cat_purge_req_post_afl_2 ECU_ADDRESS 0xd0003ac3 BIT_MASK 0x1 /end MEASUREMENT
/begin MEASUREMENT state_afl_purge[0] "State of catalyst purge after lean operation" UBYTE _CNV_S_3_STATE_AFL__516_CM 1 100. 0. 2. DISPLAY_IDENTIFIER state_afl_purge_1 ECU_ADDRESS 0xc0000b32 /end MEASUREMENT
/begin MEASUREMENT state_afl_purge[1] "State of catalyst purge after lean operation" UBYTE _CNV_S_3_STATE_AFL__516_CM 1 100. 0. 2. DISPLAY_IDENTIFIER state_afl_purge_2 ECU_ADDRESS 0xc0000b33 /end MEASUREMENT
/begin MEASUREMENT ctr_afl_purge[0] "Activation counter for catalyst purge after lean operation" UBYTE _CNV_A_R_LINEAR_____0_CM 1 100. 0. 255. DISPLAY_IDENTIFIER ctr_afl_purge_1 ECU_ADDRESS 0xc0000b34 FORMAT "%3.0" /end MEASUREMENT
/begin MEASUREMENT ctr_afl_purge[1] "Activation counter for catalyst purge after lean operation" UBYTE _CNV_A_R_LINEAR_____0_CM 1 100. 0. 255. DISPLAY_IDENTIFIER ctr_afl_purge_2 ECU_ADDRESS 0xc0000b35 FORMAT "%3.0" /end MEASUREMENT
/begin CHARACTERISTIC c_state_sens_afl_purge[0] "Determination of signal for catalyst purge function after lean operation" VALUE 0xa10297be _REC_VAL_20_u1 4. _CNV_S_5_C_STATE_SE_517_CM 0. 4. DISPLAY_IDENTIFIER c_state_sens_afl_purge_1 /end CHARACTERISTIC
/begin CHARACTERISTIC c_state_sens_afl_purge[1] "Determination of signal for catalyst purge function after lean operation" VALUE 0xa10297bf _REC_VAL_20_u1 4. _CNV_S_5_C_STATE_SE_517_CM 0. 4. DISPLAY_IDENTIFIER c_state_sens_afl_purge_2 /end CHARACTERISTIC
/begin MEASUREMENT ratio_nox[0] "Ratio of NOx out integral to NOx raw emission integral" UWORD _CNV_A_R_LINEAR_____7_CM 1 100. 0. 99.99847412109381 DISPLAY_IDENTIFIER ratio_nox_1 ECU_ADDRESS 0xc0000af4 /end MEASUREMENT
/begin MEASUREMENT ratio_nox[1] "Ratio of NOx out integral to NOx raw emission integral" UWORD _CNV_A_R_LINEAR_____7_CM 1 100. 0. 99.99847412109381 DISPLAY_IDENTIFIER ratio_nox_2 ECU_ADDRESS 0xc0000af6 /end MEASUREMENT
/begin MEASUREMENT ratio_nox_out_int_dist[0] "Ratio of NOx out emissions related to mileage of current lean operation phase" UWORD _CNV_A_R_ANOX_LINEA_515_CM 1 100. 0. 6.5535 DISPLAY_IDENTIFIER ratio_nox_out_int_dist_1 ECU_ADDRESS 0xc0000af0 FORMAT "%6.4" /end MEASUREMENT
/begin MEASUREMENT ratio_nox_out_int_dist[1] "Ratio of NOx out emissions related to mileage of current lean operation phase" UWORD _CNV_A_R_ANOX_LINEA_515_CM 1 100. 0. 6.5535 DISPLAY_IDENTIFIER ratio_nox_out_int_dist_2 ECU_ADDRESS 0xc0000af2 FORMAT "%6.4" /end MEASUREMENT
/begin MEASUREMENT nox_ad_fac "NOx emission adaptation factor" UBYTE _CNV_A_R_LINEAR_____100_CM 1 100. 0. 1.9921875 DISPLAY_IDENTIFIER NOX_AD_FAC ECU_ADDRESS 0xd0003a40 FORMAT "%5.3" /end MEASUREMENT
/begin MEASUREMENT lv_nox_ad_cmpl "logical value for active NOx emission adaptation" UBYTE _CNV_S_2_RANGE__0___1_CM 1 100. 0. 1. DISPLAY_IDENTIFIER LV_NOX_AD_CMPL ECU_ADDRESS 0xd0003a43 BIT_MASK 0x1 /end MEASUREMENT
/begin MEASUREMENT ntl_rgn_st_nox_mes_1 "measured NOx reducing agent mass" UWORD _CNV_A_R_LINEAR_____495_CM 1 100. 0. 10485.6 DISPLAY_IDENTIFIER NTL_RGN_ST_NOX_MES_1 ECU_ADDRESS 0xc00009c8 FORMAT "%7.1" /end MEASUREMENT
/begin MEASUREMENT ntl_rgn_st_nox_mes_2 "measured NOx reducing agent mass" UWORD _CNV_A_R_LINEAR_____495_CM 1 100. 0. 10485.6 DISPLAY_IDENTIFIER NTL_RGN_ST_NOX_MES_2 ECU_ADDRESS 0xc00009ce FORMAT "%7.1" /end MEASUREMENT
/begin MEASUREMENT nox_ad_fac_1 "NOx emission adaptation factor" UBYTE _CNV_A_R_LINEAR_____100_CM 1 100. 0. 1.9921875 DISPLAY_IDENTIFIER NOX_AD_FAC_1 ECU_ADDRESS 0xd0003a41 FORMAT "%5.3" /end MEASUREMENT
/begin MEASUREMENT nox_ad_fac_2 "NOx emission adaptation factor" UBYTE _CNV_A_R_LINEAR_____100_CM 1 100. 0. 1.9921875 DISPLAY_IDENTIFIER NOX_AD_FAC_2 ECU_ADDRESS 0xd0003a42 FORMAT "%5.3" /end MEASUREMENT
/begin MEASUREMENT lv_dyw_nox_ad "logical value for active limited dynamics" UBYTE _CNV_S_2_RANGE__0___1_CM 1 100. 0. 1. DISPLAY_IDENTIFIER LV_DYW_NOX_AD ECU_ADDRESS 0xd0003a44 BIT_MASK 0x1 /end MEASUREMENT
/begin MEASUREMENT nox_cor_s_mmv "moving mean value of NOx emission" UWORD _CNV_A_R_LINEAR_____492_CM 1 100. 0. 1023.984375 DISPLAY_IDENTIFIER NOX_COR_S_MMV ECU_ADDRESS 0xc00009ca FORMAT "%7.2" /end MEASUREMENT
/begin MEASUREMENT maf_fg_cyl_mmv "moving mean value of mass air flow" UWORD _CNV_A_R_LINEAR_____207_CM 1 100. 0. 2047.96875 DISPLAY_IDENTIFIER MAF_FG_CYL_MMV ECU_ADDRESS 0xc00009cc FORMAT "%7.2" /end MEASUREMENT
/begin MEASUREMENT nox_ad_fac_raw_2 "raw value of NOx emission adaptation factor" UBYTE _CNV_A_R_LINEAR_____100_CM 1 100. 0. 1.9921875 DISPLAY_IDENTIFIER NOX_AD_FAC_RAW_2 ECU_ADDRESS 0xc00009d6 FORMAT "%5.3" /end MEASUREMENT
/begin MEASUREMENT nox_ad_fac_raw_1 "raw value of NOx emission adaptation factor" UBYTE _CNV_A_R_LINEAR_____100_CM 1 100. 0. 1.9921875 DISPLAY_IDENTIFIER NOX_AD_FAC_RAW_1 ECU_ADDRESS 0xc00009d0 FORMAT "%5.3" /end MEASUREMENT
/begin MEASUREMENT ctr_nox_ad_fac "adaptations counter" UBYTE _CNV_A_R_LINEAR_____0_CM 1 100. 0. 255. DISPLAY_IDENTIFIER CTR_NOX_AD_FAC ECU_ADDRESS 0xc00009d1 FORMAT "%3.0" /end MEASUREMENT
/begin CHARACTERISTIC c_crlc_nox_ad_fac "correlation constant of NOx emission factor" VALUE 0xa1029216 _REC_VAL_20_u1 0.99609375 _CNV_A_R_LINEAR_____27_CM 0. 0.99609375 DISPLAY_IDENTIFIER C_CRLC_NOX_AD_FAC FORMAT "%5.3" /end CHARACTERISTIC
/begin CHARACTERISTIC lc_nox_ad_act "switch to activate NOx emission adaptation" VALUE 0xa1029d84 _REC_VAL_20_u1 1. _CNV_A_R_LINEAR_____0_CM 0. 1. DISPLAY_IDENTIFIER LC_NOX_AD_ACT FORMAT "%1.0" /end CHARACTERISTIC
/begin CHARACTERISTIC c_crlc_nox_ad "correlation constant of NOx emission" VALUE 0xa1029214 _REC_VAL_20_u2 0.9999847412109381 _CNV_A_R_LINEAR_____68_CM 0. 0.9999847412109381 DISPLAY_IDENTIFIER C_CRLC_NOX_AD FORMAT "%7.5" /end CHARACTERISTIC
/begin CHARACTERISTIC c_nox_ad_dyw "NOx emission limit for limited dynamics" VALUE 0xa1029684 _REC_VAL_20_u2 1023.984375 _CNV_A_R_LINEAR_____492_CM 0. 1023.984375 DISPLAY_IDENTIFIER C_NOX_AD_DYW FORMAT "%7.2" /end CHARACTERISTIC
/begin CHARACTERISTIC c_crlc_maf_fg_cyl "correlation constant of air mass flow" VALUE 0xa1029206 _REC_VAL_20_u2 0.9999847412109381 _CNV_A_R_LINEAR_____68_CM 0. 0.9999847412109381 DISPLAY_IDENTIFIER C_CRLC_MAF_FG_CYL FORMAT "%7.5" /end CHARACTERISTIC
/begin CHARACTERISTIC c_maf_fg_cyl_dyw "air mass flow limit for limited dynamics" VALUE 0xa102953a _REC_VAL_20_u2 2047.96875 _CNV_A_R_LINEAR_____207_CM 0. 2047.96875 DISPLAY_IDENTIFIER C_MAF_FG_CYL_DYW FORMAT "%7.2" /end CHARACTERISTIC
/begin CHARACTERISTIC lc_nox_ad_on "switch to enable permanent NOx emission adaptation" VALUE 0xa1029d87 _REC_VAL_20_u1 1. _CNV_A_R_LINEAR_____0_CM 0. 1. DISPLAY_IDENTIFIER LC_NOX_AD_ON FORMAT "%1.0" /end CHARACTERISTIC
/begin CHARACTERISTIC c_ntld_min_nox_ad "min. NOx trap loading degree for starting adaptation" VALUE 0xa102970a _REC_VAL_20_u2 0.9999847412109381 _CNV_A_R_LINEAR_____68_CM 0. 0.9999847412109381 DISPLAY_IDENTIFIER C_NTLD_MIN_NOX_AD FORMAT "%7.5" /end CHARACTERISTIC
/begin CHARACTERISTIC c_nox_ad_fac_dif "max. difference of NOx emission adaptation factor for finishing adaptation" VALUE 0xa1029686 _REC_VAL_20_u1 1.9921875 _CNV_A_R_LINEAR_____100_CM 0. 1.9921875 DISPLAY_IDENTIFIER C_NOX_AD_FAC_DIF FORMAT "%5.3" /end CHARACTERISTIC
/begin CHARACTERISTIC c_ctr_nox_ad_fac_min "min. value of adaptations counter to finish adaptation" VALUE 0xa10292b1 _REC_VAL_20_u1 255. _CNV_A_R_LINEAR_____0_CM 0. 255. DISPLAY_IDENTIFIER C_CTR_NOX_AD_FAC_MIN FORMAT "%3.0" /end CHARACTERISTIC
/begin CHARACTERISTIC c_tnt_mdl_nox_ad_min "temperature threshold for enabling / disabling emission adaptation" VALUE 0xa1029a69 _REC_VAL_20_u1 1020. _CNV_A_R_LINEAR_____490_CM 0. 1020. DISPLAY_IDENTIFIER C_TNT_MDL_NOX_AD_MIN FORMAT "%4.0" /end CHARACTERISTIC
/begin CHARACTERISTIC c_tnt_mdl_nox_ad_max "temperature threshold for enabling / disabling emission adaptation" VALUE 0xa1029a68 _REC_VAL_20_u1 1020. _CNV_A_R_LINEAR_____490_CM 0. 1020. DISPLAY_IDENTIFIER C_TNT_MDL_NOX_AD_MAX FORMAT "%4.0" /end CHARACTERISTIC
/begin CHARACTERISTIC c_ntld_max_nox_ad "max. NOx trap loading degree for starting adaptation" VALUE 0xa1029704 _REC_VAL_20_u2 0.9999847412109381 _CNV_A_R_LINEAR_____68_CM 0. 0.9999847412109381 DISPLAY_IDENTIFIER C_NTLD_MAX_NOX_AD FORMAT "%7.5" /end CHARACTERISTIC
/begin CHARACTERISTIC lc_nox_ad_fac_ini "switch for manual initialisation of NOx emission adaptation factor" VALUE 0xa1029d86 _REC_VAL_20_u1 1. _CNV_A_R_LINEAR_____0_CM 0. 1. DISPLAY_IDENTIFIER LC_NOX_AD_FAC_INI FORMAT "%1.0" /end CHARACTERISTIC
/begin CHARACTERISTIC c_nox_ad_fac_ini "NOx emission adaptation factor initialisation value" VALUE 0xa1029687 _REC_VAL_20_u1 1.9921875 _CNV_A_R_LINEAR_____100_CM 0. 1.9921875 DISPLAY_IDENTIFIER C_NOX_AD_FAC_INI FORMAT "%5.3" /end CHARACTERISTIC
/begin CHARACTERISTIC c_lamb_nox_ad_dyw "lambda threshold for limited dynamics" VALUE 0xa10294d8 _REC_VAL_20_u2 31.9990234375 _CNV_A_R_LINEAR_____122_CM 0. 31.9990234375 DISPLAY_IDENTIFIER C_LAMB_NOX_AD_DYW FORMAT "%7.4" /end CHARACTERISTIC
/begin CHARACTERISTIC c_n_32_min_rgn_nox_ad "minimum engine speed for used adaptation value" VALUE 0xa10295cc _REC_VAL_20_u1 8160. _CNV_A_R_LINEAR_____9_CM 0. 8160. DISPLAY_IDENTIFIER C_N_32_MIN_RGN_NOX_AD FORMAT "%4.0" /end CHARACTERISTIC
/begin CHARACTERISTIC c_vs_min_rgn_nox_ad "minimum vehicle speed for used adaptation value" VALUE 0xa1029cc5 _REC_VAL_20_u1 255. _CNV_A_R_LINEAR_____6_CM 0. 255. DISPLAY_IDENTIFIER C_VS_MIN_RGN_NOX_AD FORMAT "%3.0" /end CHARACTERISTIC
/begin CHARACTERISTIC c_maf_min_rgn_nox_ad "minimum mass air flow for used adaptation value" VALUE 0xa1029562 _REC_VAL_20_u2 2047.96875 _CNV_A_R_LINEAR_____207_CM 0. 2047.96875 DISPLAY_IDENTIFIER C_MAF_MIN_RGN_NOX_AD FORMAT "%7.2" /end CHARACTERISTIC
/begin MEASUREMENT lv_so2p_afr_1 "logical value: alternation is currently in rich phase" UBYTE _CNV_S_2_RANGE__0___1_CM 1 100. 0. 1. DISPLAY_IDENTIFIER LV_SO2P_AFR_1 ECU_ADDRESS 0xd0003a65 BIT_MASK 0x1 /end MEASUREMENT
/begin MEASUREMENT lv_so2p_afr_2 "logical value: alternation is currently in rich phase" UBYTE _CNV_S_2_RANGE__0___1_CM 1 100. 0. 1. DISPLAY_IDENTIFIER LV_SO2P_AFR_2 ECU_ADDRESS 0xd0003a69 BIT_MASK 0x1 /end MEASUREMENT
/begin MEASUREMENT lamb_puls_so2p_1 "delta lambda to pass the lambda stimulation coordination routine" SBYTE _CNV_A_R_LINEAR_____122_CM 1 100. -0.125 0.1240234375 DISPLAY_IDENTIFIER LAMB_PULS_SO2P_1 ECU_ADDRESS 0xd0003a64 FORMAT "%7.4" /end MEASUREMENT
/begin MEASUREMENT t_lam_dly_so2p_2 "total LAM P-jump delay time for transition due to desufation lambda alternation" UWORD _CNV_A_R_LINEAR_____107_CM 1 100. 0. 1310.7 DISPLAY_IDENTIFIER T_LAM_DLY_SO2P_2 ECU_ADDRESS 0xc0000a10 FORMAT "%7.2" /end MEASUREMENT
/begin MEASUREMENT t_lam_dly_so2p_1 "total LAM P-jump delay time for transition due to desufation lambda alternation" UWORD _CNV_A_R_LINEAR_____107_CM 1 100. 0. 1310.7 DISPLAY_IDENTIFIER T_LAM_DLY_SO2P_1 ECU_ADDRESS 0xc0000a02 FORMAT "%7.2" /end MEASUREMENT
/begin CHARACTERISTIC c_delta_lamb_afr_so2p "delta lambda value for rich phase of desufation" VALUE 0xa10292f9 _REC_VAL_20_s1 0.2490234375 _CNV_A_R_LINEAR_____122_CM -0.125 0.1240234375 DISPLAY_IDENTIFIER C_DELTA_LAMB_AFR_SO2P FORMAT "%7.4" /end CHARACTERISTIC
/begin CHARACTERISTIC c_delta_lamb_afl_so2p "delta lambda value for lean phase of desufation" VALUE 0xa10292f8 _REC_VAL_20_s1 0.2490234375 _CNV_A_R_LINEAR_____122_CM -0.125 0.1240234375 DISPLAY_IDENTIFIER C_DELTA_LAMB_AFL_SO2P FORMAT "%7.4" /end CHARACTERISTIC
/begin CHARACTERISTIC c_t_lam_dly_so2p_pos "basic LAM P-jump delay time from lean to rich transition" VALUE 0xa10298b2 _REC_VAL_20_u2 1310.68 _CNV_A_R_LINEAR_____107_CM 0. 1310.68 DISPLAY_IDENTIFIER C_T_LAM_DLY_SO2P_POS FORMAT "%7.2" /end CHARACTERISTIC
/begin CHARACTERISTIC c_t_lam_dly_so2p_neg "basic LAM P-jump delay time from rich to lean transition" VALUE 0xa10298b0 _REC_VAL_20_u2 1310.68 _CNV_A_R_LINEAR_____107_CM 0. 1310.68 DISPLAY_IDENTIFIER C_T_LAM_DLY_SO2P_NEG FORMAT "%7.2" /end CHARACTERISTIC
/begin CHARACTERISTIC c_so2p_lamb_ramp "ramp gradient of the lambda alternation" VALUE 0xa1029792 _REC_VAL_20_u2 0.124996 _CNV_A_R_LINEAR_____524_CM 0. 0.124996 DISPLAY_IDENTIFIER C_SO2P_LAMB_RAMP FORMAT "%8.6" /end CHARACTERISTIC
/begin CHARACTERISTIC c_delta_lamb_sp_so2p "permissible deviation of the lambda controller setpoint for desulfation with lambda alternation" VALUE 0xa10292fe _REC_VAL_20_u2 2. _CNV_A_R_LINEAR_____122_CM 0. 2. DISPLAY_IDENTIFIER C_DELTA_LAMB_SP_SO2P FORMAT "%6.4" /end CHARACTERISTIC
/begin MEASUREMENT lv_afl_down_1 "boolean flag indicating detection of lean air fuel mixture when set by downstream sensor" UBYTE _CNV_S_2_RANGE__0___1_CM 1 100. 0. 1. DISPLAY_IDENTIFIER LV_AFL_DOWN_1 ECU_ADDRESS 0xd0003a66 BIT_MASK 0x1 /end MEASUREMENT
/begin MEASUREMENT lv_afl_down_2 "boolean flag indicating detection of lean air fuel mixture when set by downstream sensor" UBYTE _CNV_S_2_RANGE__0___1_CM 1 100. 0. 1. DISPLAY_IDENTIFIER LV_AFL_DOWN_2 ECU_ADDRESS 0xd0003a6a BIT_MASK 0x1 /end MEASUREMENT
/begin MEASUREMENT lv_vls_down_tra_2 "boolean flag indicating transition of air fuel mixture when set by downstream sensor" UBYTE _CNV_S_2_RANGE__0___1_CM 1 100. 0. 1. DISPLAY_IDENTIFIER LV_VLS_DOWN_TRA_2 ECU_ADDRESS 0xd0003a6b BIT_MASK 0x1 /end MEASUREMENT
/begin MEASUREMENT lv_vls_down_tra_1 "boolean flag indicating transition of air fuel mixture when set by downstream sensor" UBYTE _CNV_S_2_RANGE__0___1_CM 1 100. 0. 1. DISPLAY_IDENTIFIER LV_VLS_DOWN_TRA_1 ECU_ADDRESS 0xd0003a67 BIT_MASK 0x1 /end MEASUREMENT
/begin MEASUREMENT vls_down_ref_1 "downstream signal voltage observed for downstream AF cycle evaluation" UWORD _CNV_A_R_LINEAR_____2_CM 1 100. 0. 4.9951171875 DISPLAY_IDENTIFIER VLS_DOWN_REF_1 ECU_ADDRESS 0xc0000a04 FORMAT "%5.3" /end MEASUREMENT
/begin MEASUREMENT vls_down_ref_2 "downstream signal voltage observed for downstream AF cycle evaluation" UWORD _CNV_A_R_LINEAR_____2_CM 1 100. 0. 4.9951171875 DISPLAY_IDENTIFIER VLS_DOWN_REF_2 ECU_ADDRESS 0xc0000a12 FORMAT "%5.3" /end MEASUREMENT
/begin MEASUREMENT t_vls_down_cyc_afl_1 "lean mixture cycle time at LS downstream position" UWORD _CNV_A_R_LINEAR_____107_CM 1 100. 0. 1310.7 DISPLAY_IDENTIFIER T_VLS_DOWN_CYC_AFL_1 ECU_ADDRESS 0xc0000a06 FORMAT "%7.2" /end MEASUREMENT
/begin MEASUREMENT t_vls_down_cyc_afr_2 "rich mixture cycle time at LS downstream position" UWORD _CNV_A_R_LINEAR_____107_CM 1 100. 0. 1310.7 DISPLAY_IDENTIFIER T_VLS_DOWN_CYC_AFR_2 ECU_ADDRESS 0xc0000a16 FORMAT "%7.2" /end MEASUREMENT
/begin MEASUREMENT t_vls_down_cyc_afr_1 "rich mixture cycle time at LS downstream position" UWORD _CNV_A_R_LINEAR_____107_CM 1 100. 0. 1310.7 DISPLAY_IDENTIFIER T_VLS_DOWN_CYC_AFR_1 ECU_ADDRESS 0xc0000a08 FORMAT "%7.2" /end MEASUREMENT
/begin MEASUREMENT t_afl_down_lock_2 "timer indicating duration of LV_AFL lock at LS downstream position" UWORD _CNV_A_R_LINEAR_____107_CM 1 100. 0. 1310.7 DISPLAY_IDENTIFIER T_AFL_DOWN_LOCK_2 ECU_ADDRESS 0xc0000a18 FORMAT "%7.2" /end MEASUREMENT
/begin MEASUREMENT t_afl_down_lock_1 "timer indicating duration of LV_AFL lock at LS downstream position" UWORD _CNV_A_R_LINEAR_____107_CM 1 100. 0. 1310.7 DISPLAY_IDENTIFIER T_AFL_DOWN_LOCK_1 ECU_ADDRESS 0xc0000a0a FORMAT "%7.2" /end MEASUREMENT
/begin MEASUREMENT ctr_vls_down_afl_cyc_2 "denotes number of AF cycles since lambda contoller last activated at LS downstream position" UWORD _CNV_A_R_LINEAR_____0_CM 1 100. 0. 65535. DISPLAY_IDENTIFIER CTR_VLS_DOWN_AFL_CYC_2 ECU_ADDRESS 0xc0000a1a FORMAT "%5.0" /end MEASUREMENT
/begin MEASUREMENT ctr_vls_down_afl_cyc_1 "denotes number of AF cycles since lambda contoller last activated at LS downstream position" UWORD _CNV_A_R_LINEAR_____0_CM 1 100. 0. 65535. DISPLAY_IDENTIFIER CTR_VLS_DOWN_AFL_CYC_1 ECU_ADDRESS 0xc0000a0c FORMAT "%5.0" /end MEASUREMENT
/begin CHARACTERISTIC ip_delta_lamb_ch_so2p "basic value of LAMP_PULS_SO2P integral component when lambda < 1" MAP 0xa1023220 _REC_MAP_20_u1_u1_u2 0.5 _CNV_A_R_EGCP_LINEA_363_CM 0. 0.5 DISPLAY_IDENTIFIER IP_DELTA_LAMB_CH_SO2P FORMAT "%6.4"
 /begin AXIS_DESCR COM_AXIS n_32 _CNV_A_R_LINEAR_____9_CM 8 0. 8160. FORMAT "%4.0" AXIS_PTS_REF ldpm_n_32_1_lamb_puls_so2p /end AXIS_DESCR
 /begin AXIS_DESCR COM_AXIS maf _CNV_A_R_LINEAR_____108_CM 8 0. 1389. FORMAT "%7.2" AXIS_PTS_REF ldpm_maf_1_lamb_puls_so2p /end AXIS_DESCR
/end CHARACTERISTIC
/begin AXIS_PTS ldpm_n_32_1_lamb_puls_so2p "" 0xa1021d8c n_32 _REC_AXS_20_u1 8160. _CNV_A_R_LINEAR_____9_CM 8 0. 8160. FORMAT "%4.0" /end AXIS_PTS
/begin AXIS_PTS ldpm_maf_1_lamb_puls_so2p "" 0xa1021b9c maf _REC_AXS_20_u2 1389. _CNV_A_R_LINEAR_____108_CM 8 0. 1389. FORMAT "%7.2" /end AXIS_PTS
/begin CHARACTERISTIC ip_lam_so2p_pos_p "basic value of LAMB_PULS_SO2P integral component during transition from lambda < 1 to lambda > 1" MAP 0xa1025f30 _REC_MAP_20_u1_u1_u2 0.124023 _CNV_A_R_EGCP_LINEA_363_CM 0. 0.124023 DISPLAY_IDENTIFIER IP_LAM_SO2P_POS_P FORMAT "%6.4"
 /begin AXIS_DESCR COM_AXIS n_32 _CNV_A_R_LINEAR_____9_CM 8 0. 8160. FORMAT "%4.0" AXIS_PTS_REF ldpm_n_32_1_lamb_puls_so2p /end AXIS_DESCR
 /begin AXIS_DESCR COM_AXIS maf _CNV_A_R_LINEAR_____108_CM 8 0. 1389. FORMAT "%7.2" AXIS_PTS_REF ldpm_maf_1_lamb_puls_so2p /end AXIS_DESCR
/end CHARACTERISTIC
/begin CHARACTERISTIC ip_lam_so2p_pos_i "basic value of LAMB_PULS_SO2P integral component when lambda lambda > 1" MAP 0xa1025eb0 _REC_MAP_20_u2_u1_u2 0.124996 _CNV_A_R_LINEAR_____524_CM 0. 0.124996 DISPLAY_IDENTIFIER IP_LAM_SO2P_POS_I FORMAT "%8.6"
 /begin AXIS_DESCR COM_AXIS n_32 _CNV_A_R_LINEAR_____9_CM 8 0. 8160. FORMAT "%4.0" AXIS_PTS_REF ldpm_n_32_1_lamb_puls_so2p /end AXIS_DESCR
 /begin AXIS_DESCR COM_AXIS maf _CNV_A_R_LINEAR_____108_CM 8 0. 1389. FORMAT "%7.2" AXIS_PTS_REF ldpm_maf_1_lamb_puls_so2p /end AXIS_DESCR
/end CHARACTERISTIC
/begin CHARACTERISTIC ip_lam_so2p_neg_p "basic value of LAMB_PULS_SO2P proportional component during transition from lambda > 1 to lambda < 1" MAP 0xa1025e70 _REC_MAP_20_u1_u1_u2 0.124023 _CNV_A_R_EGCP_LINEA_363_CM 0. 0.124023 DISPLAY_IDENTIFIER IP_LAM_SO2P_NEG_P FORMAT "%6.4"
 /begin AXIS_DESCR COM_AXIS n_32 _CNV_A_R_LINEAR_____9_CM 8 0. 8160. FORMAT "%4.0" AXIS_PTS_REF ldpm_n_32_1_lamb_puls_so2p /end AXIS_DESCR
 /begin AXIS_DESCR COM_AXIS maf _CNV_A_R_LINEAR_____108_CM 8 0. 1389. FORMAT "%7.2" AXIS_PTS_REF ldpm_maf_1_lamb_puls_so2p /end AXIS_DESCR
/end CHARACTERISTIC
/begin CHARACTERISTIC ip_lam_so2p_neg_i "basic value of LAMB_PULS_SO2P integral component when lambda lambda < 1" MAP 0xa1025df0 _REC_MAP_20_u2_u1_u2 0.124996 _CNV_A_R_LINEAR_____524_CM 0. 0.124996 DISPLAY_IDENTIFIER IP_LAM_SO2P_NEG_I FORMAT "%8.6"
 /begin AXIS_DESCR COM_AXIS n_32 _CNV_A_R_LINEAR_____9_CM 8 0. 8160. FORMAT "%4.0" AXIS_PTS_REF ldpm_n_32_1_lamb_puls_so2p /end AXIS_DESCR
 /begin AXIS_DESCR COM_AXIS maf _CNV_A_R_LINEAR_____108_CM 8 0. 1389. FORMAT "%7.2" AXIS_PTS_REF ldpm_maf_1_lamb_puls_so2p /end AXIS_DESCR
/end CHARACTERISTIC
/begin AXIS_PTS ldp_lamb_nox_sens_ip_lamb_nox "" 0xa1020c28 lamb_nox_sens_1 _REC_AXS_20_u2 31.9990234375 _CNV_A_R_LINEAR_____122_CM 8 0. 31.9990234375 FORMAT "%7.4" /end AXIS_PTS
/begin CHARACTERISTIC ip_lamb_nox_sens_ref "scaling map for downstream sensor signal LAMB_NOX_SENS to VLS_DOWN_REF" CURVE 0xa1026090 _REC_CUR_20_u2_u2 4.9951171875 _CNV_A_R_LINEAR_____2_CM 0. 4.9951171875 DISPLAY_IDENTIFIER IP_LAMB_NOX_SENS_REF FORMAT "%5.3"
 /begin AXIS_DESCR COM_AXIS lamb_nox_sens_1 _CNV_A_R_LINEAR_____122_CM 8 0. 31.9990234375 FORMAT "%7.4" AXIS_PTS_REF ldp_lamb_nox_sens_ip_lamb_nox /end AXIS_DESCR
/end CHARACTERISTIC
/begin AXIS_PTS ldp_vls_nox_sens_ip_vls_nox "" 0xa1021834 vls_nox_sens_1 _REC_AXS_20_u2 1400. _CNV_A_R_LINEAR_____211_CM 8 -200. 1200. FORMAT "%4.0" /end AXIS_PTS
/begin CHARACTERISTIC ip_vls_nox_sens_ref "scaling map for downstream sensor signal VLS_NOX_SENS to VLS_DOWN_REF" CURVE 0xa1029018 _REC_CUR_20_u2_u2 4.9951171875 _CNV_A_R_LINEAR_____2_CM 0. 4.9951171875 DISPLAY_IDENTIFIER IP_VLS_NOX_SENS_REF FORMAT "%5.3"
 /begin AXIS_DESCR COM_AXIS vls_nox_sens_1 _CNV_A_R_LINEAR_____211_CM 8 -200. 1200. FORMAT "%4.0" AXIS_PTS_REF ldp_vls_nox_sens_ip_vls_nox /end AXIS_DESCR
/end CHARACTERISTIC
/begin MEASUREMENT t_vls_down_cyc_afl_2 "lean mixture cycle time at LS downstream position" UWORD _CNV_A_R_LINEAR_____107_CM 1 100. 0. 1310.7 DISPLAY_IDENTIFIER T_VLS_DOWN_CYC_AFL_2 ECU_ADDRESS 0xc0000a14 FORMAT "%7.2" /end MEASUREMENT
/begin MEASUREMENT lamb_puls_so2p_2 "delta lambda to pass the lambda stimulation coordination routine" SBYTE _CNV_A_R_LINEAR_____122_CM 1 100. -0.125 0.1240234375 DISPLAY_IDENTIFIER LAMB_PULS_SO2P_2 ECU_ADDRESS 0xd0003a68 FORMAT "%7.4" /end MEASUREMENT
/begin MEASUREMENT lamb_puls_so2p_h_res_1 "delta lambda with high resolution" SWORD _CNV_A_R_LACO_LINEA_388_CM 1 100. -0.125 0.124996185302734 DISPLAY_IDENTIFIER LAMB_PULS_SO2P_H_RES_1 ECU_ADDRESS 0xc0000a00 FORMAT "%8.6" /end MEASUREMENT
/begin MEASUREMENT lamb_puls_so2p_h_res_2 "delta lambda with high resolution" SWORD _CNV_A_R_LACO_LINEA_388_CM 1 100. -0.125 0.124996185302734 DISPLAY_IDENTIFIER LAMB_PULS_SO2P_H_RES_2 ECU_ADDRESS 0xc0000a0e FORMAT "%8.6" /end MEASUREMENT
/begin CHARACTERISTIC c_state_sens_vls_down_ref "mode to determine the sensor used for downstream signal aquisition" VALUE 0xa10297c6 _REC_VAL_20_u1 4. _CNV_S_5_STATE_SENS_525_CM 0. 4. DISPLAY_IDENTIFIER C_STATE_SENS_VLS_DOWN_REF /end CHARACTERISTIC
/begin CHARACTERISTIC c_vls_down_ref_man "LS reference signal at downstream position set manually " VALUE 0xa1029c3e _REC_VAL_20_u2 4.9951171875 _CNV_A_R_LINEAR_____2_CM 0. 4.9951171875 DISPLAY_IDENTIFIER C_VLS_DOWN_REF_MAN FORMAT "%5.3" /end CHARACTERISTIC
/begin CHARACTERISTIC c_vls_down_afl "threshold for detection of lean mixture at downstream position" VALUE 0xa1029c30 _REC_VAL_20_u2 4.9951171875 _CNV_A_R_LINEAR_____2_CM 0. 4.9951171875 DISPLAY_IDENTIFIER C_VLS_DOWN_AFL FORMAT "%5.3" /end CHARACTERISTIC
/begin CHARACTERISTIC c_vls_down_afr "threshold for detection of rich mixture at downstream position" VALUE 0xa1029c36 _REC_VAL_20_u2 4.9951171875 _CNV_A_R_LINEAR_____2_CM 0. 4.9951171875 DISPLAY_IDENTIFIER C_VLS_DOWN_AFR FORMAT "%5.3" /end CHARACTERISTIC
/begin CHARACTERISTIC c_t_vls_down_cyc_afl_max "maximum lean mixture cycle time at LS downstream position" VALUE 0xa102999c _REC_VAL_20_u2 1310.7 _CNV_A_R_LINEAR_____107_CM 0. 1310.7 DISPLAY_IDENTIFIER C_T_VLS_DOWN_CYC_AFL_MAX FORMAT "%7.2" /end CHARACTERISTIC
/begin CHARACTERISTIC c_t_vls_down_cyc_afr_max "maximum rich mixture cycle time at LS downstream position" VALUE 0xa102999e _REC_VAL_20_u2 1310.7 _CNV_A_R_LINEAR_____107_CM 0. 1310.7 DISPLAY_IDENTIFIER C_T_VLS_DOWN_CYC_AFR_MAX FORMAT "%7.2" /end CHARACTERISTIC
/begin CHARACTERISTIC lc_t_afl_down_ctl "logical flag to consider time thresholds for switching lean to rich or rich to lean" VALUE 0xa1029de4 _REC_VAL_20_u1 1. _CNV_A_R_LINEAR_____0_CM 0. 1. DISPLAY_IDENTIFIER LC_T_AFL_DOWN_CTL FORMAT "%1.0" /end CHARACTERISTIC
/begin AXIS_PTS ldpm_n_32_1_lamb_puls_ref "" 0xa1021d80 n_32 _REC_AXS_20_u1 8160. _CNV_A_R_LINEAR_____9_CM 8 0. 8160. FORMAT "%4.0" /end AXIS_PTS
/begin AXIS_PTS ldpm_maf_2_lamb_puls_ref "" 0xa1021bb0 n_32 _REC_AXS_20_u2 1389. _CNV_A_R_LINEAR_____108_CM 8 0. 1389. FORMAT "%7.2" /end AXIS_PTS
/begin CHARACTERISTIC ip_t_afl_down_lock_afl "LV_AFL transition lock-out time after transition of AF mixture to lean at LS downstream position" MAP 0xa102790c _REC_MAP_20_u2_u1_u2 1310.7 _CNV_A_R_LINEAR_____107_CM 0. 1310.7 DISPLAY_IDENTIFIER IP_T_AFL_DOWN_LOCK_AFL FORMAT "%7.2"
 /begin AXIS_DESCR COM_AXIS n_32 _CNV_A_R_LINEAR_____9_CM 8 0. 8160. FORMAT "%4.0" AXIS_PTS_REF ldpm_n_32_1_lamb_puls_ref /end AXIS_DESCR
 /begin AXIS_DESCR COM_AXIS n_32 _CNV_A_R_LINEAR_____108_CM 8 0. 1389. FORMAT "%7.2" AXIS_PTS_REF ldpm_maf_2_lamb_puls_ref /end AXIS_DESCR
/end CHARACTERISTIC
/begin CHARACTERISTIC ip_t_afl_down_lock_afr "LV_AFL transition lock-out time after transition of AF mixture to rich at LS downstream position" MAP 0xa102798c _REC_MAP_20_u2_u1_u2 1310.7 _CNV_A_R_LINEAR_____107_CM 0. 1310.7 DISPLAY_IDENTIFIER IP_T_AFL_DOWN_LOCK_AFR FORMAT "%7.2"
 /begin AXIS_DESCR COM_AXIS n_32 _CNV_A_R_LINEAR_____9_CM 8 0. 8160. FORMAT "%4.0" AXIS_PTS_REF ldpm_n_32_1_lamb_puls_ref /end AXIS_DESCR
 /begin AXIS_DESCR COM_AXIS n_32 _CNV_A_R_LINEAR_____108_CM 8 0. 1389. FORMAT "%7.2" AXIS_PTS_REF ldpm_maf_2_lamb_puls_ref /end AXIS_DESCR
/end CHARACTERISTIC
/begin MEASUREMENT nox_out_mdl_sens "modelled NOx emission flow downstream the NOx catalyst" UWORD _CNV_A_R_LINEAR_____492_CM 1 100. 0. 1023.984375 DISPLAY_IDENTIFIER NOX_OUT_MDL_SENS ECU_ADDRESS 0xc0000a1c FORMAT "%7.2" /end MEASUREMENT
/begin MEASUREMENT nox_out_mdl_dif_2 "deviation between measured and calculated NOx flow after NOx catalyst (bench selective)" SWORD _CNV_A_R_LINEAR_____492_CM 1 100. -512. 511.984375 DISPLAY_IDENTIFIER NOX_OUT_MDL_DIF_2 ECU_ADDRESS 0xc0000a3a FORMAT "%7.2" /end MEASUREMENT
/begin MEASUREMENT ntld_mdl_dif "correction of the closed loop control NOx catalyst model" SWORD _CNV_A_R_LINEAR_____526_CM 1 100. -0.5 0.499984741210938 DISPLAY_IDENTIFIER NTLD_MDL_DIF ECU_ADDRESS 0xd0004e10 FORMAT "%8.5" /end MEASUREMENT
/begin MEASUREMENT nox_out_mdl_dif_1 "deviation between measured and calculated NOx flow after NOx catalyst (bench selective)" SWORD _CNV_A_R_LINEAR_____492_CM 1 100. -512. 511.984375 DISPLAY_IDENTIFIER NOX_OUT_MDL_DIF_1 ECU_ADDRESS 0xc0000a26 FORMAT "%7.2" /end MEASUREMENT
/begin MEASUREMENT nox_out_mes_mmv_2 "moving mean value of measured NOx flow after NOx catalyst (bench selective)" UWORD _CNV_A_R_LINEAR_____492_CM 1 100. 0. 1023.984375 DISPLAY_IDENTIFIER NOX_OUT_MES_MMV_2 ECU_ADDRESS 0xc0000a30 FORMAT "%7.2" /end MEASUREMENT
/begin MEASUREMENT nox_out_mes_mmv_1 "moving mean value of measured NOx flow after NOx catalyst (bench selective)" UWORD _CNV_A_R_LINEAR_____492_CM 1 100. 0. 1023.984375 DISPLAY_IDENTIFIER NOX_OUT_MES_MMV_1 ECU_ADDRESS 0xc0000a1e FORMAT "%7.2" /end MEASUREMENT
/begin MEASUREMENT t_nox_mdl_ctrl_act_2 "time controller is active (bench selective)" UWORD _CNV_A_R_LINEAR_____107_CM 1 100. 0. 1310.7 DISPLAY_IDENTIFIER T_NOX_MDL_CTRL_ACT_2 ECU_ADDRESS 0xc0000a32 FORMAT "%7.2" /end MEASUREMENT
/begin MEASUREMENT t_nox_mdl_ctrl_act_1 "time controller is active (bench selective)" UWORD _CNV_A_R_LINEAR_____107_CM 1 100. 0. 1310.7 DISPLAY_IDENTIFIER T_NOX_MDL_CTRL_ACT_1 ECU_ADDRESS 0xc0000a20 FORMAT "%7.2" /end MEASUREMENT
/begin MEASUREMENT t_nox_mdl_ctrl_ena_1 "time controller is enabled (bench selective)" UWORD _CNV_A_R_LINEAR_____107_CM 1 100. 0. 1310.7 DISPLAY_IDENTIFIER T_NOX_MDL_CTRL_ENA_1 ECU_ADDRESS 0xc0000a22 FORMAT "%7.2" /end MEASUREMENT
/begin MEASUREMENT t_nox_mdl_ctrl_ena_2 "time controller is enabled (bench selective)" UWORD _CNV_A_R_LINEAR_____107_CM 1 100. 0. 1310.7 DISPLAY_IDENTIFIER T_NOX_MDL_CTRL_ENA_2 ECU_ADDRESS 0xc0000a34 FORMAT "%7.2" /end MEASUREMENT
/begin MEASUREMENT ntld_mdl_dif_i "I-value of the closed loop control NOx catalyst model" SWORD _CNV_A_R_LINEAR_____526_CM 1 100. -0.5 0.499984741210938 DISPLAY_IDENTIFIER NTLD_MDL_DIF_I ECU_ADDRESS 0xc0000a28 FORMAT "%8.5" /end MEASUREMENT
/begin MEASUREMENT ntld_mdl_dif_i_1 "I-value of the closed loop control NOx catalyst model (bench selective)" SWORD _CNV_A_R_LINEAR_____526_CM 1 100. -0.5 0.499984741210938 DISPLAY_IDENTIFIER NTLD_MDL_DIF_I_1 ECU_ADDRESS 0xc0000a2c FORMAT "%8.5" /end MEASUREMENT
/begin MEASUREMENT ntld_mdl_dif_i_2 "I-value of the closed loop control NOx catalyst model (bench selective)" SWORD _CNV_A_R_LINEAR_____526_CM 1 100. -0.5 0.499984741210938 DISPLAY_IDENTIFIER NTLD_MDL_DIF_I_2 ECU_ADDRESS 0xc0000a38 FORMAT "%8.5" /end MEASUREMENT
/begin MEASUREMENT ntld_mdl_dif_p "P-value of the closed loop control NOx catalyst model" SWORD _CNV_A_R_LINEAR_____526_CM 1 100. -0.5 0.499984741210938 DISPLAY_IDENTIFIER NTLD_MDL_DIF_P ECU_ADDRESS 0xc0000a2a FORMAT "%8.5" /end MEASUREMENT
/begin MEASUREMENT ntld_mdl_dif_p_1 "P-value of the closed loop control NOx catalyst model (bench selective)" SWORD _CNV_A_R_LINEAR_____526_CM 1 100. -0.5 0.499984741210938 DISPLAY_IDENTIFIER NTLD_MDL_DIF_P_1 ECU_ADDRESS 0xc0000a2e FORMAT "%8.5" /end MEASUREMENT
/begin MEASUREMENT ntld_mdl_dif_p_2 "P-value of the closed loop control NOx catalyst model (bench selective)" SWORD _CNV_A_R_LINEAR_____526_CM 1 100. -0.5 0.499984741210938 DISPLAY_IDENTIFIER NTLD_MDL_DIF_P_2 ECU_ADDRESS 0xc0000a3c FORMAT "%8.5" /end MEASUREMENT
/begin MEASUREMENT lv_nox_rgn_cmpl "boolean whether regenerations are \"complete\" or not" UBYTE _CNV_S_2_RANGE__0___1_CM 1 100. 0. 1. DISPLAY_IDENTIFIER LV_NOX_RGN_CMPL ECU_ADDRESS 0xd0003a6c BIT_MASK 0x1 /end MEASUREMENT
/begin MEASUREMENT lv_inh_nox_mdl_ctrl_rgn "prohibition of regeneration by controller controlled NOx signal" UBYTE _CNV_S_2_RANGE__0___1_CM 1 100. 0. 1. DISPLAY_IDENTIFIER LV_INH_NOX_MDL_CTRL_RGN ECU_ADDRESS 0xd0003a6d BIT_MASK 0x1 /end MEASUREMENT
/begin MEASUREMENT lv_inh_nox_mdl_ctrl_rgn_1 "prohibition of regeneration by controller controlled NOx signal (bench selective)" UBYTE _CNV_S_2_RANGE__0___1_CM 1 100. 0. 1. DISPLAY_IDENTIFIER LV_INH_NOX_MDL_CTRL_RGN_1 ECU_ADDRESS 0xc0000a40 BIT_MASK 0x1 /end MEASUREMENT
/begin MEASUREMENT lv_inh_nox_mdl_ctrl_rgn_2 "prohibition of regeneration by controller controlled NOx signal (bench selective)" UBYTE _CNV_S_2_RANGE__0___1_CM 1 100. 0. 1. DISPLAY_IDENTIFIER LV_INH_NOX_MDL_CTRL_RGN_2 ECU_ADDRESS 0xc0000a42 BIT_MASK 0x1 /end MEASUREMENT
/begin CHARACTERISTIC c_ntld_mdl_dif_i_min "minimum value of the I-part of the closed loop control NOx catalyst model" VALUE 0xa1029708 _REC_VAL_20_s2 0.9999847412109379 _CNV_A_R_LINEAR_____526_CM -0.5 0.499984741210938 DISPLAY_IDENTIFIER C_NTLD_MDL_DIF_I_MIN FORMAT "%8.5" /end CHARACTERISTIC
/begin CHARACTERISTIC c_ntld_mdl_dif_i_max "maximum value of the I-part of the closed loop control NOx catalyst model" VALUE 0xa1029706 _REC_VAL_20_s2 0.9999847412109379 _CNV_A_R_LINEAR_____526_CM -0.5 0.499984741210938 DISPLAY_IDENTIFIER C_NTLD_MDL_DIF_I_MAX FORMAT "%8.5" /end CHARACTERISTIC
/begin CHARACTERISTIC c_ntld_dec_stop "ramp gradient for a gradual deactivation of I-share during STATE_NOX = STOP" VALUE 0xa1029700 _REC_VAL_20_u2 0.9999847412109381 _CNV_A_R_LINEAR_____68_CM 0. 0.9999847412109381 DISPLAY_IDENTIFIER C_NTLD_DEC_STOP FORMAT "%7.5" /end CHARACTERISTIC
/begin CHARACTERISTIC c_ntld_dec_rgn "ramp gradient for a gradual deactivation of I-share during STATE_NOX = REGENERATION" VALUE 0xa10296fe _REC_VAL_20_u2 0.9999847412109381 _CNV_A_R_LINEAR_____68_CM 0. 0.9999847412109381 DISPLAY_IDENTIFIER C_NTLD_DEC_RGN FORMAT "%7.5" /end CHARACTERISTIC
/begin CHARACTERISTIC c_nox_out_mes_grd_max "maximum gradient of measured NOx flow downstream NOx cat" VALUE 0xa102969e _REC_VAL_20_u2 1023.984375 _CNV_A_R_LINEAR_____492_CM 0. 1023.984375 DISPLAY_IDENTIFIER C_NOX_OUT_MES_GRD_MAX FORMAT "%7.2" /end CHARACTERISTIC
/begin CHARACTERISTIC lc_nox_rgn_cmpl "switch whether regenerations are \"complete\" or not" VALUE 0xa1029d8a _REC_VAL_20_u1 1. _CNV_A_R_LINEAR_____0_CM 0. 1. DISPLAY_IDENTIFIER LC_NOX_RGN_CMPL FORMAT "%1.0" /end CHARACTERISTIC
/begin CHARACTERISTIC c_nox_ppm_ctrl_min "minimum threshold for measured NOx flow downstream NOx cat" VALUE 0xa10296a8 _REC_VAL_20_u2 1500. _CNV_A_R_LINEAR_____499_CM 0. 1500. DISPLAY_IDENTIFIER C_NOX_PPM_CTRL_MIN FORMAT "%4.0" /end CHARACTERISTIC
/begin CHARACTERISTIC c_ntld_ctrl_min "min NOx trap loading degree to start NOx catalyst model controller" VALUE 0xa10296fc _REC_VAL_20_u2 0.9999847412109381 _CNV_A_R_LINEAR_____68_CM 0. 0.9999847412109381 DISPLAY_IDENTIFIER C_NTLD_CTRL_MIN FORMAT "%7.5" /end CHARACTERISTIC
/begin CHARACTERISTIC c_crlc_nox_out_mes_mmv "correlation constant for moving mean value of measured NOx flow after NOx catalyst" VALUE 0xa1029226 _REC_VAL_20_u2 0.9999847412109381 _CNV_A_R_LINEAR_____68_CM 0. 0.9999847412109381 DISPLAY_IDENTIFIER C_CRLC_NOX_OUT_MES_MMV FORMAT "%7.5" /end CHARACTERISTIC
/begin CHARACTERISTIC lc_nox_mdl_ctrl_act "switch to activate closed loop control for the NOx catalyst model" VALUE 0xa1029d88 _REC_VAL_20_u1 1. _CNV_A_R_LINEAR_____0_CM 0. 1. DISPLAY_IDENTIFIER LC_NOX_MDL_CTRL_ACT FORMAT "%1.0" /end CHARACTERISTIC
/begin CHARACTERISTIC c_nox_out_mes_mmv_max "maximum value for \"limited dynamic\" for measured NOx flow downstream NOx cat" VALUE 0xa10296a2 _REC_VAL_20_u2 1023.984375 _CNV_A_R_LINEAR_____492_CM 0. 1023.984375 DISPLAY_IDENTIFIER C_NOX_OUT_MES_MMV_MAX FORMAT "%7.2" /end CHARACTERISTIC
/begin CHARACTERISTIC c_nox_dif_mon "max deviation between model and NOx sensor" VALUE 0xa102968c _REC_VAL_20_u2 1023.984375 _CNV_A_R_LINEAR_____492_CM 0. 1023.984375 DISPLAY_IDENTIFIER C_NOX_DIF_MON FORMAT "%7.2" /end CHARACTERISTIC
/begin CHARACTERISTIC c_nox_dif_mon_min "threshold for monitoring deviation between model and NOx sensor" VALUE 0xa102968e _REC_VAL_20_u2 1500. _CNV_A_R_LINEAR_____499_CM 0. 1500. DISPLAY_IDENTIFIER C_NOX_DIF_MON_MIN FORMAT "%4.0" /end CHARACTERISTIC
/begin CHARACTERISTIC c_t_nox_mdl_inh_ctrl_min "threshold for time controller must be active to allow regeneration request" VALUE 0xa1029916 _REC_VAL_20_u1 0.99609375 _CNV_A_R_LINEAR_____27_CM 0. 0.99609375 DISPLAY_IDENTIFIER C_T_NOX_MDL_INH_CTRL_MIN FORMAT "%5.3" /end CHARACTERISTIC
/begin CHARACTERISTIC c_t_nox_mdl_ctrl_ena_min "time controller is enabled" VALUE 0xa1029914 _REC_VAL_20_u2 1310.7 _CNV_A_R_LINEAR_____107_CM 0. 1310.7 DISPLAY_IDENTIFIER C_T_NOX_MDL_CTRL_ENA_MIN FORMAT "%7.2" /end CHARACTERISTIC
/begin CHARACTERISTIC lc_inh_p_hld "switch to inhibit holding of P-share" VALUE 0xa1029d63 _REC_VAL_20_u1 1. _CNV_A_R_LINEAR_____0_CM 0. 1. DISPLAY_IDENTIFIER LC_INH_P_HLD FORMAT "%1.0" /end CHARACTERISTIC
/begin CHARACTERISTIC lc_inh_nox_mdl_ctrl_ini "initialisation value for LV_INH_NOX_MDL_CTRL_RGN_i" VALUE 0xa1029d57 _REC_VAL_20_u1 1. _CNV_A_R_LINEAR_____0_CM 0. 1. DISPLAY_IDENTIFIER LC_INH_NOX_MDL_CTRL_INI FORMAT "%1.0" /end CHARACTERISTIC
/begin AXIS_PTS ldpm_nox_cor_red_mmv "" 0xa1022108 nox_cor_red_mmv _REC_AXS_20_u2 1023.984375 _CNV_A_R_LINEAR_____492_CM 6 0. 1023.984375 FORMAT "%7.2" /end AXIS_PTS
/begin AXIS_PTS ldp_maf_kgh_ip_crlc_nox_sens "" 0xa1020ca0 maf_kgh _REC_AXS_20_u2 2047.96875 _CNV_A_R_LINEAR_____207_CM 4 0. 2047.96875 FORMAT "%7.2" /end AXIS_PTS
/begin CHARACTERISTIC ip_ntld_mdl_dif_i "correlation constant for the I-share of the NTLD controller" MAP 0xa1027038 _REC_MAP_20_u2_u2_u2 0.499992370605469 _CNV_A_R_LINEAR_____527_CM 0. 0.499992370605469 DISPLAY_IDENTIFIER IP_NTLD_MDL_DIF_I FORMAT "%8.6"
 /begin AXIS_DESCR COM_AXIS nox_cor_red_mmv _CNV_A_R_LINEAR_____492_CM 6 0. 1023.984375 FORMAT "%7.2" AXIS_PTS_REF ldpm_nox_cor_red_mmv /end AXIS_DESCR
 /begin AXIS_DESCR COM_AXIS tnt_mdl_mv _CNV_A_R_LINEAR_____197_CM 6 0. 1023.984375 FORMAT "%7.2" AXIS_PTS_REF ldpm_tnt_mdl_mv /end AXIS_DESCR
/end CHARACTERISTIC
/begin CHARACTERISTIC ip_ntld_mdl_dif_p "correlation constant for the P-share of the NTLD controller" MAP 0xa1027080 _REC_MAP_20_u2_u2_u2 0.499992370605469 _CNV_A_R_LINEAR_____527_CM 0. 0.499992370605469 DISPLAY_IDENTIFIER IP_NTLD_MDL_DIF_P FORMAT "%8.6"
 /begin AXIS_DESCR COM_AXIS nox_cor_red_mmv _CNV_A_R_LINEAR_____492_CM 6 0. 1023.984375 FORMAT "%7.2" AXIS_PTS_REF ldpm_nox_cor_red_mmv /end AXIS_DESCR
 /begin AXIS_DESCR COM_AXIS tnt_mdl_mv _CNV_A_R_LINEAR_____197_CM 6 0. 1023.984375 FORMAT "%7.2" AXIS_PTS_REF ldpm_tnt_mdl_mv /end AXIS_DESCR
/end CHARACTERISTIC
/begin CHARACTERISTIC ip_crlc_nox_sens "correlation constant for the first order time delay of the calculated NOx flow after NOx catalyst" CURVE 0xa10231b8 _REC_CUR_20_u2_u2 0.9999847412109381 _CNV_A_R_LINEAR_____68_CM 0. 0.9999847412109381 DISPLAY_IDENTIFIER IP_CRLC_NOX_SENS FORMAT "%7.5"
 /begin AXIS_DESCR COM_AXIS maf_kgh _CNV_A_R_LINEAR_____207_CM 4 0. 2047.96875 FORMAT "%7.2" AXIS_PTS_REF ldp_maf_kgh_ip_crlc_nox_sens /end AXIS_DESCR
/end CHARACTERISTIC
/begin AXIS_PTS ldpm_tnt_mdl_mv "" 0xa1022328 tnt_mdl_mv _REC_AXS_20_u2 1023.984375 _CNV_A_R_LINEAR_____197_CM 6 0. 1023.984375 FORMAT "%7.2" /end AXIS_PTS
/begin CHARACTERISTIC c_su_conc_fuel "fuel sulphur concentration" VALUE 0xa10297cd _REC_VAL_20_u1 510. _CNV_A_R_LINEAR_____528_CM 0. 510. DISPLAY_IDENTIFIER C_SU_CONC_FUEL FORMAT "%3.0" /end CHARACTERISTIC
/begin CHARACTERISTIC c_su_conc_fuel_h "fuel sulphur concentration for high sulphured fuel" VALUE 0xa10297ce _REC_VAL_20_u1 510. _CNV_A_R_LINEAR_____528_CM 0. 510. DISPLAY_IDENTIFIER C_SU_CONC_FUEL_H FORMAT "%3.0" /end CHARACTERISTIC
/begin CHARACTERISTIC c_crlc_su_nox "correlation constant" VALUE 0xa1029232 _REC_VAL_20_u2 2.812146e-008 _CNV_A_R_ANOX_LINEA_529_CM 0. 2.812146e-008 DISPLAY_IDENTIFIER C_CRLC_SU_NOX FORMAT "%15.13" /end CHARACTERISTIC
/begin CHARACTERISTIC c_nt_sul_ini "manual initialisation value for NOx trap sulphur model" VALUE 0xa10296e8 _REC_VAL_20_u2 10485.6 _CNV_A_R_LINEAR_____495_CM 0. 10485.6 DISPLAY_IDENTIFIER C_NT_SUL_INI FORMAT "%7.1" /end CHARACTERISTIC
/begin CHARACTERISTIC c_lamb_sp_min_sul "lambda threshold for sulphur poisonning in homogeneous lambda 1" VALUE 0xa1029506 _REC_VAL_20_u2 31.9990234375 _CNV_A_R_LINEAR_____122_CM 0. 31.9990234375 DISPLAY_IDENTIFIER C_LAMB_SP_MIN_SUL FORMAT "%7.4" /end CHARACTERISTIC
/begin CHARACTERISTIC lc_nt_sul_ini_man "logical constant for manual initialisation of NOx trap sulphur model" VALUE 0xa1029db0 _REC_VAL_20_u1 1. _CNV_A_R_LINEAR_____0_CM 0. 1. DISPLAY_IDENTIFIER LC_NT_SUL_INI_MAN FORMAT "%1.0" /end CHARACTERISTIC
/begin CHARACTERISTIC lc_nt_sul_lim_not "logical constant for continue incrementation above NT_SUL_MAX" VALUE 0xa1029db1 _REC_VAL_20_u1 1. _CNV_A_R_LINEAR_____0_CM 0. 1. DISPLAY_IDENTIFIER LC_NT_SUL_LIM_NOT FORMAT "%1.0" /end CHARACTERISTIC
/begin CHARACTERISTIC ip_nt_sul_max "maximum sulphur loading respecting NT_AGI_THERMO" CURVE 0xa1026db0 _REC_CUR_20_u2_u2 10485.6 _CNV_A_R_LINEAR_____495_CM 0. 10485.6 DISPLAY_IDENTIFIER IP_NT_SUL_MAX FORMAT "%7.1"
 /begin AXIS_DESCR COM_AXIS nt_agi_thermo _CNV_A_R_LINEAR_____68_CM 6 0. 0.9999847412109381 FORMAT "%7.5" AXIS_PTS_REF ldpm_nt_agi_thermo_ip_nt_sul_max /end AXIS_DESCR
/end CHARACTERISTIC
/begin CHARACTERISTIC ip_t_so2p_dly "delay time before sulphur release" CURVE 0xa1027de8 _REC_CUR_20_u2_u2 6553.5 _CNV_A_R_LINEAR_____4_CM 0. 6553.5 DISPLAY_IDENTIFIER IP_T_SO2P_DLY FORMAT "%6.1"
 /begin AXIS_DESCR COM_AXIS lamb_mv _CNV_A_R_LINEAR_____122_CM 4 0. 31.9990234375 FORMAT "%7.4" AXIS_PTS_REF ldpm_lamb_mv_ip_t_so2p_dly /end AXIS_DESCR
/end CHARACTERISTIC
/begin CHARACTERISTIC ip_nt_sul_dec_bas "basic sulphur loading decrement per time step" MAP 0xa1026ce8 _REC_MAP_20_u2_u2_u2 5242.8 _CNV_A_R_LINEAR_____530_CM 0. 5242.8 DISPLAY_IDENTIFIER IP_NT_SUL_DEC_BAS FORMAT "%7.2"
 /begin AXIS_DESCR COM_AXIS lamb_mv _CNV_A_R_LINEAR_____122_CM 4 0. 31.9990234375 FORMAT "%7.4" AXIS_PTS_REF ldpm_lamb_mv_ip_nt_sul_dec_bas /end AXIS_DESCR
 /begin AXIS_DESCR COM_AXIS tnt_mdl_mv _CNV_A_R_LINEAR_____197_CM 4 0. 1023.984375 FORMAT "%7.2" AXIS_PTS_REF ldp_tnt_mdl_mv_ip_nt_sul_dec /end AXIS_DESCR
/end CHARACTERISTIC
/begin CHARACTERISTIC ip_nt_sul_dec_fac_1 "correction factor for sulphur release" MAP 0xa1026d08 _REC_MAP_20_u2_u2_u2 0.9999847412109381 _CNV_A_R_LINEAR_____68_CM 0. 0.9999847412109381 DISPLAY_IDENTIFIER IP_NT_SUL_DEC_FAC_1 FORMAT "%7.5"
 /begin AXIS_DESCR COM_AXIS nt_sul _CNV_A_R_LINEAR_____495_CM 6 0. 10485.6 FORMAT "%7.1" AXIS_PTS_REF ldpm_nt_sul_ip_nt_sul_dec_fac_1 /end AXIS_DESCR
 /begin AXIS_DESCR COM_AXIS nt_sul_so2p_beg_1 _CNV_A_R_LINEAR_____495_CM 6 0. 10485.6 FORMAT "%7.1" AXIS_PTS_REF ldp_nt_sul_so2p_beg_ip_nt_sul_1 /end AXIS_DESCR
/end CHARACTERISTIC
/begin AXIS_PTS ldp_tnt_mdl_mv_ip_nt_sul_dec "" 0xa10213e0 tnt_mdl_mv _REC_AXS_20_u2 1023.984375 _CNV_A_R_LINEAR_____197_CM 4 0. 1023.984375 FORMAT "%7.2" /end AXIS_PTS
/begin CHARACTERISTIC ip_nt_sul_h_dec_fac_1 "correction factor for sulphur release for high sulphured fuel" MAP 0xa1026d5c _REC_MAP_20_u2_u2_u2 0.9999847412109381 _CNV_A_R_LINEAR_____68_CM 0. 0.9999847412109381 DISPLAY_IDENTIFIER IP_NT_SUL_H_DEC_FAC_1 FORMAT "%7.5"
 /begin AXIS_DESCR COM_AXIS nt_sul _CNV_A_R_LINEAR_____495_CM 6 0. 10485.6 FORMAT "%7.1" AXIS_PTS_REF ldpm_nt_sul_ip_nt_sul_dec_fac_1 /end AXIS_DESCR
 /begin AXIS_DESCR COM_AXIS nt_sul_so2p_beg_1 _CNV_A_R_LINEAR_____495_CM 6 0. 10485.6 FORMAT "%7.1" AXIS_PTS_REF ldp_nt_sul_so2p_beg_ip_nt_sul_1 /end AXIS_DESCR
/end CHARACTERISTIC
/begin AXIS_PTS ldp_nt_agi_thermo_ip_nt_sul_2 "" 0xa10210c4 nt_agi_thermo _REC_AXS_20_u2 0.9999847412109381 _CNV_A_R_LINEAR_____68_CM 6 0. 0.9999847412109381 FORMAT "%7.5" /end AXIS_PTS
/begin CHARACTERISTIC ip_nt_sul_dec_fac_2 "correction factor for sulphur release on thermal aging factor" CURVE 0xa1026d50 _REC_CUR_20_u2_u2 0.9999847412109381 _CNV_A_R_LINEAR_____68_CM 0. 0.9999847412109381 DISPLAY_IDENTIFIER IP_NT_SUL_DEC_FAC_2 FORMAT "%7.5"
 /begin AXIS_DESCR COM_AXIS nt_agi_thermo _CNV_A_R_LINEAR_____68_CM 6 0. 0.9999847412109381 FORMAT "%7.5" AXIS_PTS_REF ldp_nt_agi_thermo_ip_nt_sul_2 /end AXIS_DESCR
/end CHARACTERISTIC
/begin MEASUREMENT nt_agi_inc_so2p_1 "NOx trap aging factor increment per time step" ULONG _CNV_A_R_LINEAR_____518_CM 1 100. 0. 1. DISPLAY_IDENTIFIER NT_AGI_INC_SO2P_1 ECU_ADDRESS 0xd0005598 FORMAT "%12.10" /end MEASUREMENT
/begin MEASUREMENT nt_agi_inc_so2p_2 "NOx trap aging factor increment per time step" ULONG _CNV_A_R_LINEAR_____518_CM 1 100. 0. 1. DISPLAY_IDENTIFIER NT_AGI_INC_SO2P_2 ECU_ADDRESS 0xd00055b4 FORMAT "%12.10" /end MEASUREMENT
/begin MEASUREMENT nt_sul_agi_delta_1 "NT_SUL_AGI delta due to desulfation" SLONG _CNV_A_R_LINEAR_____531_CM 1 100. -5242.88 5242.87999755859 DISPLAY_IDENTIFIER NT_SUL_AGI_DELTA_1 ECU_ADDRESS 0xc0000a54 FORMAT "%11.6" /end MEASUREMENT
/begin MEASUREMENT nt_sul_agi_delta_2 "NT_SUL_AGI delta due to desulfation" SLONG _CNV_A_R_LINEAR_____531_CM 1 100. -5242.88 5242.87999755859 DISPLAY_IDENTIFIER NT_SUL_AGI_DELTA_2 ECU_ADDRESS 0xc0000a60 FORMAT "%11.6" /end MEASUREMENT
/begin AXIS_PTS ldpm_nt_agi_thermo_ip_nt_sul_max "" 0xa1022148 nt_agi_thermo _REC_AXS_20_u2 0.9999847412109381 _CNV_A_R_LINEAR_____68_CM 6 0. 0.9999847412109381 FORMAT "%7.5" /end AXIS_PTS
/begin AXIS_PTS ldpm_lamb_mv_ip_t_so2p_dly "" 0xa1021b54 lamb_mv _REC_AXS_20_u2 31.9990234375 _CNV_A_R_LINEAR_____122_CM 4 0. 31.9990234375 FORMAT "%7.4" /end AXIS_PTS
/begin AXIS_PTS ldpm_lamb_mv_ip_nt_sul_dec_bas "" 0xa1021b48 lamb_mv _REC_AXS_20_u2 31.9990234375 _CNV_A_R_LINEAR_____122_CM 4 0. 31.9990234375 FORMAT "%7.4" /end AXIS_PTS
/begin AXIS_PTS ldp_nt_sul_so2p_beg_ip_nt_sul_1 "" 0xa10210f4 nt_sul_so2p_beg_1 _REC_AXS_20_u2 10485.6 _CNV_A_R_LINEAR_____495_CM 6 0. 10485.6 FORMAT "%7.1" /end AXIS_PTS
/begin AXIS_PTS ldpm_nt_sul_ip_nt_sul_h_dec_1 "" 0xa1022168 nt_sul _REC_AXS_20_u2 10485.6 _CNV_A_R_LINEAR_____495_CM 6 0. 10485.6 FORMAT "%7.1" /end AXIS_PTS
/begin AXIS_PTS ldp_tnt_mdl_mv_ip_crlc_sul_afs "" 0xa10213b4 tnt_mdl_mv _REC_AXS_20_u2 1023.984375 _CNV_A_R_LINEAR_____197_CM 4 0. 1023.984375 FORMAT "%7.2" /end AXIS_PTS
/begin CHARACTERISTIC ip_crlc_sul_afs "conversion factor for sulphur poisonning in homogenous lambda 1 according to tnt_mdl_mv" CURVE 0xa10231c0 _REC_CUR_20_u2_u2 0.9999847412109381 _CNV_A_R_LINEAR_____68_CM 0. 0.9999847412109381 DISPLAY_IDENTIFIER IP_CRLC_SUL_AFS FORMAT "%7.5"
 /begin AXIS_DESCR COM_AXIS tnt_mdl_mv _CNV_A_R_LINEAR_____197_CM 4 0. 1023.984375 FORMAT "%7.2" AXIS_PTS_REF ldp_tnt_mdl_mv_ip_crlc_sul_afs /end AXIS_DESCR
/end CHARACTERISTIC
/begin AXIS_PTS ldpm_nt_sul_ip_nt_sul_dec_fac_1 "" 0xa1022158 nt_sul _REC_AXS_20_u2 10485.6 _CNV_A_R_LINEAR_____495_CM 6 0. 10485.6 FORMAT "%7.1" /end AXIS_PTS
/begin MEASUREMENT nt_sul_h "NOx trap sulphur loading for high sulphured fuel" UWORD _CNV_A_R_LINEAR_____495_CM 1 100. 0. 10485.6 DISPLAY_IDENTIFIER NT_SUL_H ECU_ADDRESS 0xd0004eb2 FORMAT "%7.1" /end MEASUREMENT
/begin MEASUREMENT nt_sul "NOx trap sulphur loading" UWORD _CNV_A_R_LINEAR_____495_CM 1 100. 0. 10485.6 DISPLAY_IDENTIFIER NT_SUL ECU_ADDRESS 0xd0004eb0 FORMAT "%7.1" /end MEASUREMENT
/begin CHARACTERISTIC c_state_egr_cbk "Configuration of asymmetrical EGR branch for sulfur model ( 0: no unsymmetry, 1 or 2: EGR branch on this bank )" VALUE 0xa10297ae _REC_VAL_20_u1 2. _CNV_A_R_LINEAR_____0_CM 0. 2. DISPLAY_IDENTIFIER C_STATE_EGR_CBK FORMAT "%2.0" /end CHARACTERISTIC
/begin MEASUREMENT nt_sul_32_1 "NOx trap sulphur loading with high resolution" ULONG _CNV_A_R_LINEAR_____532_CM 1 100. 0. 10485.6 DISPLAY_IDENTIFIER NT_SUL_32_1 ECU_ADDRESS 0xd0005590 FORMAT "%12.6" /end MEASUREMENT
/begin MEASUREMENT nt_sul_32_2 "NOx trap sulphur loading with high resolution" ULONG _CNV_A_R_LINEAR_____532_CM 1 100. 0. 10485.6 DISPLAY_IDENTIFIER NT_SUL_32_2 ECU_ADDRESS 0xd00055ac FORMAT "%12.6" /end MEASUREMENT
/begin MEASUREMENT nt_sul_h_32_1 "NOx trap sulphur loading for high sulphured fuel with high resolution" ULONG _CNV_A_R_LINEAR_____532_CM 1 100. 0. 10485.6 DISPLAY_IDENTIFIER NT_SUL_H_32_1 ECU_ADDRESS 0xd0005594 FORMAT "%12.6" /end MEASUREMENT
/begin MEASUREMENT nt_sul_h_32_2 "NOx trap sulphur loading for high sulphured fuel with high resolution" ULONG _CNV_A_R_LINEAR_____532_CM 1 100. 0. 10485.6 DISPLAY_IDENTIFIER NT_SUL_H_32_2 ECU_ADDRESS 0xd00055b0 FORMAT "%12.6" /end MEASUREMENT
/begin MEASUREMENT nt_sul_max_1 "maximum NOx trap sulphur loading" UWORD _CNV_A_R_LINEAR_____495_CM 1 100. 0. 10485.6 DISPLAY_IDENTIFIER NT_SUL_MAX_1 ECU_ADDRESS 0xd0004eb4 FORMAT "%7.1" /end MEASUREMENT
/begin MEASUREMENT nt_sul_max_2 "maximum NOx trap sulphur loading" UWORD _CNV_A_R_LINEAR_____495_CM 1 100. 0. 10485.6 DISPLAY_IDENTIFIER NT_SUL_MAX_2 ECU_ADDRESS 0xd0004eb8 FORMAT "%7.1" /end MEASUREMENT
/begin MEASUREMENT nt_sul_so2p_beg_2 "NOx trap sulphur loading at desulfation begin" UWORD _CNV_A_R_LINEAR_____495_CM 1 100. 0. 10485.6 DISPLAY_IDENTIFIER NT_SUL_SO2P_BEG_2 ECU_ADDRESS 0xc0000a4c FORMAT "%7.1" /end MEASUREMENT
/begin MEASUREMENT nt_sul_so2p_beg_1 "NOx trap sulphur loading at desulfation begin" UWORD _CNV_A_R_LINEAR_____495_CM 1 100. 0. 10485.6 DISPLAY_IDENTIFIER NT_SUL_SO2P_BEG_1 ECU_ADDRESS 0xc0000a48 FORMAT "%7.1" /end MEASUREMENT
/begin MEASUREMENT nt_sul_delta_1 "NT_SUL delta due to desulfation or loading" SLONG _CNV_A_R_LINEAR_____531_CM 1 100. -5242.88 5242.87999755859 DISPLAY_IDENTIFIER NT_SUL_DELTA_1 ECU_ADDRESS 0xc0000a58 FORMAT "%11.6" /end MEASUREMENT
/begin MEASUREMENT nt_sul_delta_2 "NT_SUL delta due to desulfation or loading" SLONG _CNV_A_R_LINEAR_____531_CM 1 100. -5242.88 5242.87999755859 DISPLAY_IDENTIFIER NT_SUL_DELTA_2 ECU_ADDRESS 0xc0000a64 FORMAT "%11.6" /end MEASUREMENT
/begin MEASUREMENT nt_sul_h_delta_1 "NT_SUL_H delta due to desulfation or loading" SLONG _CNV_A_R_LINEAR_____531_CM 1 100. -5242.88 5242.87999755859 DISPLAY_IDENTIFIER NT_SUL_H_DELTA_1 ECU_ADDRESS 0xc0000a50 FORMAT "%11.6" /end MEASUREMENT
/begin MEASUREMENT nt_sul_h_delta_2 "NT_SUL_H delta due to desulfation or loading" SLONG _CNV_A_R_LINEAR_____531_CM 1 100. -5242.88 5242.87999755859 DISPLAY_IDENTIFIER NT_SUL_H_DELTA_2 ECU_ADDRESS 0xc0000a5c FORMAT "%11.6" /end MEASUREMENT
/begin MEASUREMENT nt_sul_h_so2p_beg_1 "NOx trap sulphur loading for high sulphured fuel at desulfation begin" UWORD _CNV_A_R_LINEAR_____495_CM 1 100. 0. 10485.6 DISPLAY_IDENTIFIER NT_SUL_H_SO2P_BEG_1 ECU_ADDRESS 0xc0000a46 FORMAT "%7.1" /end MEASUREMENT
/begin MEASUREMENT nt_sul_h_so2p_beg_2 "NOx trap sulphur loading for high sulphured fuel at desulfation begin" UWORD _CNV_A_R_LINEAR_____495_CM 1 100. 0. 10485.6 DISPLAY_IDENTIFIER NT_SUL_H_SO2P_BEG_2 ECU_ADDRESS 0xc0000a4a FORMAT "%7.1" /end MEASUREMENT
/begin COMPU_METHOD _CNV_A_R_LINEAR_____0_CM "" RAT_FUNC "%6.3" "-" COEFFS 0 1. 0. 0 0 1 /end COMPU_METHOD
/begin COMPU_METHOD _CNV_S_2_RANGE__0___1_CM "" TAB_VERB "%6.3" "-" COMPU_TAB_REF _CNV_S_2_RANGE__0___1 /end COMPU_METHOD
/begin COMPU_VTAB _CNV_S_2_RANGE__0___1 "" TAB_VERB 2 0 "0" 1 "1" /end COMPU_VTAB
/begin COMPU_METHOD _CNV_A_R_LINEAR_____2_CM "" RAT_FUNC "%6.3" "V" COEFFS 0 204.8 0. 0 0 1 /end COMPU_METHOD
/begin COMPU_METHOD _CNV_A_R_LINEAR_____3_CM "" RAT_FUNC "%6.3" "s" COEFFS 0 100. 0. 0 0 1 /end COMPU_METHOD
/begin COMPU_METHOD _CNV_A_R_LINEAR_____4_CM "" RAT_FUNC "%6.3" "s" COEFFS 0 10. 0. 0 0 1 /end COMPU_METHOD
/begin COMPU_METHOD _CNV_A_R_LINEAR_____5_CM "" RAT_FUNC "%6.3" "%" COEFFS 0 2.56 0. 0 0 1 /end COMPU_METHOD
/begin COMPU_METHOD _CNV_A_R_LINEAR_____6_CM "" RAT_FUNC "%6.3" "km/h" COEFFS 0 1. 0. 0 0 1 /end COMPU_METHOD
/begin COMPU_METHOD _CNV_A_R_LINEAR_____7_CM "" RAT_FUNC "%6.3" "%" COEFFS 0 655.3599999999997 0. 0 0 1 /end COMPU_METHOD
/begin COMPU_METHOD _CNV_A_R_LINEAR_____8_CM "" RAT_FUNC "%6.3" "-" COEFFS 0 32767.99999999992 0. 0 0 1 /end COMPU_METHOD
/begin COMPU_METHOD _CNV_A_R_LINEAR_____9_CM "" RAT_FUNC "%6.3" "rpm" COEFFS 0 3.125e-002 0. 0 0 1 /end COMPU_METHOD
/begin COMPU_METHOD _CNV_A_R_LINEAR_____14_CM "" RAT_FUNC "%6.3" "mg/stk" COEFFS 0 0.183585313174946 0. 0 0 1 /end COMPU_METHOD
/begin COMPU_METHOD _CNV_A_R_LINEAR_____16_CM "" RAT_FUNC "%6.3" "°C" COEFFS 0 1.333333333333333 64. 0 0 1 /end COMPU_METHOD
/begin COMPU_METHOD _CNV_A_R_LINEAR_____25_CM "" RAT_FUNC "%6.3" "°C" COEFFS 0 1. 40. 0 0 1 /end COMPU_METHOD
/begin COMPU_METHOD _CNV_A_R_LINEAR_____26_CM "" RAT_FUNC "%6.3" "hPa" COEFFS 0 12.06017666543982 0. 0 0 1 /end COMPU_METHOD
/begin COMPU_METHOD _CNV_A_R_LINEAR_____27_CM "" RAT_FUNC "%6.3" "-" COEFFS 0 256. 0. 0 0 1 /end COMPU_METHOD
/begin COMPU_METHOD _CNV_A_R_LINEAR_____65_CM "" RAT_FUNC "%6.3" "Nm" COEFFS 0 32. 32768. 0 0 1 /end COMPU_METHOD
/begin COMPU_METHOD _CNV_A_R_LINEAR_____68_CM "" RAT_FUNC "%6.3" "-" COEFFS 0 65535.99999999996 0. 0 0 1 /end COMPU_METHOD
/begin COMPU_METHOD _CNV_A_R_LINEAR_____100_CM "" RAT_FUNC "%6.3" "-" COEFFS 0 128. 0. 0 0 1 /end COMPU_METHOD
/begin COMPU_METHOD _CNV_A_R_LINEAR_____107_CM "" RAT_FUNC "%6.3" "s" COEFFS 0 50. 0. 0 0 1 /end COMPU_METHOD
/begin COMPU_METHOD _CNV_A_R_LINEAR_____108_CM "" RAT_FUNC "%6.3" "mg/stk" COEFFS 0 47.18142548596112 0. 0 0 1 /end COMPU_METHOD
/begin COMPU_METHOD _CNV_A_R_LINEAR_____115_CM "" RAT_FUNC "%6.3" "-" COEFFS 0 4096. 0. 0 0 1 /end COMPU_METHOD
/begin COMPU_METHOD _CNV_A_R_LINEAR_____122_CM "" RAT_FUNC "%6.3" "-" COEFFS 0 1024. 0. 0 0 1 /end COMPU_METHOD
/begin COMPU_METHOD _CNV_A_R_LINEAR_____184_CM "" RAT_FUNC "%6.3" "-" COEFFS 0 32. 0. 0 0 1 /end COMPU_METHOD
/begin COMPU_METHOD _CNV_A_R_LINEAR_____197_CM "" RAT_FUNC "%6.3" "°C" COEFFS 0 64. 0. 0 0 1 /end COMPU_METHOD
/begin COMPU_METHOD _CNV_A_R_LINEAR_____198_CM "" RAT_FUNC "%6.3" "g" COEFFS 0 36.00036915004301 0. 0 0 1 /end COMPU_METHOD
/begin COMPU_METHOD _CNV_A_R_LINEAR_____207_CM "" RAT_FUNC "%6.3" "kg/h" COEFFS 0 32. 0. 0 0 1 /end COMPU_METHOD
/begin COMPU_METHOD _CNV_A_R_LINEAR_____211_CM "" RAT_FUNC "%6.3" "mV" COEFFS 0 1. 200. 0 0 1 /end COMPU_METHOD
/begin COMPU_METHOD _CNV_A_R_LINEAR_____218_CM "" RAT_FUNC "%6.3" "V" COEFFS 0 204.8048048048048 0. 0 0 1 /end COMPU_METHOD
/begin COMPU_METHOD _CNV_A_R_LINEAR_____255_CM "" RAT_FUNC "%6.3" "" COEFFS 0 64. 0. 0 0 1 /end COMPU_METHOD
/begin COMPU_METHOD _CNV_A_R_LINEAR_____256_CM "" RAT_FUNC "%6.3" "-" COEFFS 0 16383.75 0. 0 0 1 /end COMPU_METHOD
/begin COMPU_METHOD _CNV_A_R_LINEAR_____259_CM "" RAT_FUNC "%6.3" "km" COEFFS 0 0.125 0. 0 0 1 /end COMPU_METHOD
/begin COMPU_METHOD _CNV_A_R_LINEAR_____275_CM "" RAT_FUNC "%6.3" "-" COEFFS 0 32768. 0. 0 0 1 /end COMPU_METHOD
/begin COMPU_METHOD _CNV_A_R_EGCP_LINEA_363_CM "" RAT_FUNC "%6.3" "-" COEFFS 0 1024.003612233215 0. 0 0 1 /end COMPU_METHOD
/begin COMPU_METHOD _CNV_A_R_LACO_LINEA_388_CM "" RAT_FUNC "%6.3" "-" COEFFS 0 262144.0000000004 5.093170329928398e-011 0 0 1 /end COMPU_METHOD
/begin COMPU_METHOD _CNV_A_R_LINEAR_____446_CM "" RAT_FUNC "%6.3" "m" COEFFS 0 1.e-002 0. 0 0 1 /end COMPU_METHOD
/begin COMPU_METHOD _CNV_A_R_LINEAR_____489_CM "" RAT_FUNC "%6.3" "-" COEFFS 0 655.3599999999997 0. 0 0 1 /end COMPU_METHOD
/begin COMPU_METHOD _CNV_A_R_LINEAR_____490_CM "" RAT_FUNC "%6.3" "°C" COEFFS 0 0.25 0. 0 0 1 /end COMPU_METHOD
/begin COMPU_METHOD _CNV_S_7_STATE_CH_S_491_CM "" TAB_VERB "%6.3" "-" COMPU_TAB_REF _CNV_S_7_STATE_CH_S_491 /end COMPU_METHOD
/begin COMPU_VTAB _CNV_S_7_STATE_CH_S_491 "" TAB_VERB 7 0 "OFF" 1 "LAMB_CH" 2 "TQ_ADD_CH" 3 "TQ_ADD_LAMB_CH" 4 "TQ_ADD_FAST" 5 "TQ_ADD_LAMB" 6 "STB" /end COMPU_VTAB
/begin COMPU_METHOD _CNV_A_R_LINEAR_____492_CM "" RAT_FUNC "%6.3" "mg/s" COEFFS 0 64. 0. 0 0 1 /end COMPU_METHOD
/begin COMPU_METHOD _CNV_A_R_LINEAR_____493_CM "" RAT_FUNC "%6.3" "" COEFFS 0 1024. 32768. 0 0 1 /end COMPU_METHOD
/begin COMPU_METHOD _CNV_A_R_LINEAR_____494_CM "" RAT_FUNC "%6.3" "mg/(s*°CRK)" COEFFS 0 32. 0. 0 0 1 /end COMPU_METHOD
/begin COMPU_METHOD _CNV_A_R_LINEAR_____495_CM "" RAT_FUNC "%6.3" "mg" COEFFS 0 6.25 0. 0 0 1 /end COMPU_METHOD
/begin COMPU_METHOD _CNV_A_R_LINEAR_____497_CM "" RAT_FUNC "%6.3" "mg" COEFFS 0 3.125 -0.5 0 0 1 /end COMPU_METHOD
/begin COMPU_METHOD _CNV_A_R_LINEAR_____498_CM "" RAT_FUNC "%6.3" "mg" COEFFS 0 3.124952315556573 0. 0 0 1 /end COMPU_METHOD
/begin COMPU_METHOD _CNV_A_R_LINEAR_____499_CM "" RAT_FUNC "%6.3" "ppm" COEFFS 0 1. 0. 0 0 1 /end COMPU_METHOD
/begin COMPU_METHOD _CNV_S_5_NOX_OFS_SE_500_CM "" TAB_VERB "%6.3" "" COMPU_TAB_REF _CNV_S_5_NOX_OFS_SE_500 /end COMPU_METHOD
/begin COMPU_VTAB _CNV_S_5_NOX_OFS_SE_500 "" TAB_VERB 5 0 "PUC_OFFSET" 1 "AFS_OFFSET" 2 "LOAD_OFFSET" 3 "MIN_OFFSET" 4 "MAN_OFFSET" /end COMPU_VTAB
/begin COMPU_METHOD _CNV_A_R_LINEAR_____501_CM "" RAT_FUNC "%6.3" "ppm" COEFFS 0 0.9999999999999994 100.0000000000009 0 0 1 /end COMPU_METHOD
/begin COMPU_METHOD _CNV_A_R_LINEAR_____502_CM "" RAT_FUNC "%6.3" "mg" COEFFS 0 409599.9999999998 0. 0 0 1 /end COMPU_METHOD
/begin COMPU_METHOD _CNV_A_R_LINEAR_____503_CM "" RAT_FUNC "%6.3" "mg/s" COEFFS 0 4. 0. 0 0 1 /end COMPU_METHOD
/begin COMPU_METHOD _CNV_A_R_LINEAR_____504_CM "" RAT_FUNC "%6.3" "-" COEFFS 0 511.9921875 0. 0 0 1 /end COMPU_METHOD
/begin COMPU_METHOD _CNV_A_R_LINEAR_____505_CM "" RAT_FUNC "%6.3" "-" COEFFS 0 7.9998779296875 0. 0 0 1 /end COMPU_METHOD
/begin COMPU_METHOD _CNV_S_4_STATE_RGN__506_CM "" TAB_VERB "%6.3" "-" COMPU_TAB_REF _CNV_S_4_STATE_RGN__506 /end COMPU_METHOD
/begin COMPU_VTAB _CNV_S_4_STATE_RGN__506 "" TAB_VERB 4 0 "SENSOR" 1 "MODEL" 2 "SENSOR_MODEL" 3 "TIME" /end COMPU_VTAB
/begin COMPU_METHOD _CNV_S_5_STATE_SENS_507_CM "" TAB_VERB "%6.3" "-" COMPU_TAB_REF _CNV_S_5_STATE_SENS_507 /end COMPU_METHOD
/begin COMPU_VTAB _CNV_S_5_STATE_SENS_507 "" TAB_VERB 5 0 "VLS_DOWN" 1 "VLS_NOX_SENS" 2 "LAMB_NOX_SENS" 3 "VLS_NT_DOWN" 4 "NONE" /end COMPU_VTAB
/begin COMPU_METHOD _CNV_A_R_LINEAR_____508_CM "" RAT_FUNC "%6.3" "kg/h" COEFFS 0 0.125 0. 0 0 1 /end COMPU_METHOD
/begin COMPU_METHOD _CNV_A_R_LINEAR_____509_CM "" RAT_FUNC "%6.3" "ms" COEFFS 0 100. 0. 0 0 1 /end COMPU_METHOD
/begin COMPU_METHOD _CNV_A_R_LINEAR_____510_CM "" RAT_FUNC "%6.3" "mg" COEFFS 0 3.125 0. 0 0 1 /end COMPU_METHOD
/begin COMPU_METHOD _CNV_A_R_LINEAR_____511_CM "" RAT_FUNC "%6.3" "s" COEFFS 0 49.99961926658906 0. 0 0 1 /end COMPU_METHOD
/begin COMPU_METHOD _CNV_A_R_LINEAR_____512_CM "" RAT_FUNC "%6.3" "km" COEFFS 0 10. 0. 0 0 1 /end COMPU_METHOD
/begin COMPU_METHOD _CNV_A_R_ANOX_LINEA_513_CM "" RAT_FUNC "%6.3" "g" COEFFS 0 45.00000001029984 0. 0 0 1 /end COMPU_METHOD
/begin COMPU_METHOD _CNV_S_6_STATE_NOX__514_CM "" TAB_VERB "%6.3" "-" COMPU_TAB_REF _CNV_S_6_STATE_NOX__514 /end COMPU_METHOD
/begin COMPU_VTAB _CNV_S_6_STATE_NOX__514 "" TAB_VERB 6 0 "PASSIV" 1 "LOAD" 2 "REGENERATION" 3 "WAIT" 4 "STOP" 5 "WARMUP" /end COMPU_VTAB
/begin COMPU_METHOD _CNV_A_R_ANOX_LINEA_515_CM "" RAT_FUNC "%6.3" "g/km" COEFFS 0 10000. 0. 0 0 1 /end COMPU_METHOD
/begin COMPU_METHOD _CNV_S_3_STATE_AFL__516_CM "" TAB_VERB "%6.3" "-" COMPU_TAB_REF _CNV_S_3_STATE_AFL__516 /end COMPU_METHOD
/begin COMPU_VTAB _CNV_S_3_STATE_AFL__516 "" TAB_VERB 3 0 "DISABLED" 1 "OFF" 2 "ON" /end COMPU_VTAB
/begin COMPU_METHOD _CNV_S_5_C_STATE_SE_517_CM "" TAB_VERB "%6.3" "" COMPU_TAB_REF _CNV_S_5_C_STATE_SE_517 /end COMPU_METHOD
/begin COMPU_VTAB _CNV_S_5_C_STATE_SE_517 "" TAB_VERB 5 0 "VLS_DOWN" 1 "VLS_NOX_SENS" 2 "LAMB_NOX_SENS" 3 "VLS_NT_DOWN" 4 "NONE" /end COMPU_VTAB
/begin COMPU_METHOD _CNV_A_R_LINEAR_____518_CM "" RAT_FUNC "%6.3" "-" COEFFS 0 4294967295. 0. 0 0 1 /end COMPU_METHOD
/begin COMPU_METHOD _CNV_A_R_LINEAR_____524_CM "" RAT_FUNC "%6.3" "-" COEFFS 0 262144.3886204358 0. 0 0 1 /end COMPU_METHOD
/begin COMPU_METHOD _CNV_S_5_STATE_SENS_525_CM "" TAB_VERB "%6.3" "-" COMPU_TAB_REF _CNV_S_5_STATE_SENS_525 /end COMPU_METHOD
/begin COMPU_VTAB _CNV_S_5_STATE_SENS_525 "" TAB_VERB 5 0 "VLS_DOWN" 1 "VLS_NOX_SENS" 2 "LAMB_NOX_SENS" 3 "VLS_NT_DOWN" 4 "TIMER" /end COMPU_VTAB
/begin COMPU_METHOD _CNV_A_R_LINEAR_____526_CM "" RAT_FUNC "%6.3" "" COEFFS 0 65535.99999999997 -1.455191522836685e-011 0 0 1 /end COMPU_METHOD
/begin COMPU_METHOD _CNV_A_R_LINEAR_____527_CM "" RAT_FUNC "%6.3" "s/mg" COEFFS 0 131071.9999999999 0. 0 0 1 /end COMPU_METHOD
/begin COMPU_METHOD _CNV_A_R_LINEAR_____528_CM "" RAT_FUNC "%6.3" "ppm" COEFFS 0 0.5 0. 0 0 1 /end COMPU_METHOD
/begin COMPU_METHOD _CNV_A_R_ANOX_LINEA_529_CM "" RAT_FUNC "%6.3" "-" COEFFS 0 2330426656368.482 0. 0 0 1 /end COMPU_METHOD
/begin COMPU_METHOD _CNV_A_R_LINEAR_____530_CM "" RAT_FUNC "%6.3" "mg" COEFFS 0 6.249904631113146 0. 0 0 1 /end COMPU_METHOD
/begin COMPU_METHOD _CNV_A_R_LINEAR_____531_CM "" RAT_FUNC "%6.3" "mg" COEFFS 0 409600.0000000001 4.76837158203125e-007 0 0 1 /end COMPU_METHOD
/begin COMPU_METHOD _CNV_A_R_LINEAR_____532_CM "" RAT_FUNC "%6.3" "mg" COEFFS 0 409606.25 0. 0 0 1 /end COMPU_METHOD
/begin RECORD_LAYOUT _REC_VAL_20_u1 FNC_VALUES 1 UBYTE COLUMN_DIR DIRECT /end RECORD_LAYOUT
/begin RECORD_LAYOUT _REC_VAL_20_u2 FNC_VALUES 1 UWORD COLUMN_DIR DIRECT /end RECORD_LAYOUT
/begin RECORD_LAYOUT _REC_AXS_20_u1 NO_AXIS_PTS_X 1 UBYTE AXIS_PTS_X 2 UBYTE INDEX_INCR DIRECT /end RECORD_LAYOUT
/begin RECORD_LAYOUT _REC_MAP_20_u2_u1_u1 FNC_VALUES 1 UWORD COLUMN_DIR DIRECT /end RECORD_LAYOUT
/begin RECORD_LAYOUT _REC_CUR_20_u1_u1 FNC_VALUES 1 UBYTE COLUMN_DIR DIRECT /end RECORD_LAYOUT
/begin RECORD_LAYOUT _REC_VAL_20_s2 FNC_VALUES 1 SWORD COLUMN_DIR DIRECT /end RECORD_LAYOUT
/begin RECORD_LAYOUT _REC_MAP_20_u2_u2_u1 FNC_VALUES 1 UWORD COLUMN_DIR DIRECT /end RECORD_LAYOUT
/begin RECORD_LAYOUT _REC_AXS_20_u2 NO_AXIS_PTS_X 1 UWORD AXIS_PTS_X 2 UWORD INDEX_INCR DIRECT /end RECORD_LAYOUT
/begin RECORD_LAYOUT _REC_CUR_20_u2_u1 FNC_VALUES 1 UWORD COLUMN_DIR DIRECT /end RECORD_LAYOUT
/begin RECORD_LAYOUT _REC_CUR_20_u2_u2 FNC_VALUES 1 UWORD COLUMN_DIR DIRECT /end RECORD_LAYOUT
/begin RECORD_LAYOUT _REC_VAL_20_s1 FNC_VALUES 1 SBYTE COLUMN_DIR DIRECT /end RECORD_LAYOUT
/begin RECORD_LAYOUT _REC_MAP_20_u2_u1_u2 FNC_VALUES 1 UWORD COLUMN_DIR DIRECT /end RECORD_LAYOUT
/begin RECORD_LAYOUT _REC_CUR_20_u1_u2 FNC_VALUES 1 UBYTE COLUMN_DIR DIRECT /end RECORD_LAYOUT
/begin RECORD_LAYOUT _REC_MAP_20_u2_u2_u2 FNC_VALUES 1 UWORD COLUMN_DIR DIRECT /end RECORD_LAYOUT
/begin RECORD_LAYOUT _REC_MAP_20_u1_u2_u2 FNC_VALUES 1 UBYTE COLUMN_DIR DIRECT /end RECORD_LAYOUT
/begin RECORD_LAYOUT _REC_MAP_20_u1_u1_u1 FNC_VALUES 1 UBYTE COLUMN_DIR DIRECT /end RECORD_LAYOUT
/begin RECORD_LAYOUT _REC_MAP_20_u1_u2_u1 FNC_VALUES 1 UBYTE COLUMN_DIR DIRECT /end RECORD_LAYOUT
/begin RECORD_LAYOUT _REC_MAP_20_u1_u1_u2 FNC_VALUES 1 UBYTE COLUMN_DIR DIRECT /end RECORD_LAYOUT
/begin FUNCTION INJ_NOx_Cat_Sulphur_Model "_NOx Cat Sulphur Model"
 /begin DEF_CHARACTERISTIC c_su_conc_fuel c_su_conc_fuel_h c_crlc_su_nox c_nt_sul_ini c_lamb_sp_min_sul lc_nt_sul_ini_man lc_nt_sul_lim_not ip_nt_sul_max ip_t_so2p_dly ip_nt_sul_dec_bas ip_nt_sul_dec_fac_1 ldp_tnt_mdl_mv_ip_nt_sul_dec ip_nt_sul_h_dec_fac_1 ldp_nt_agi_thermo_ip_nt_sul_2 ip_nt_sul_dec_fac_2 ldpm_nt_agi_thermo_ip_nt_sul_max ldpm_lamb_mv_ip_t_so2p_dly ldpm_lamb_mv_ip_nt_sul_dec_bas ldp_nt_sul_so2p_beg_ip_nt_sul_1 ldpm_nt_sul_ip_nt_sul_h_dec_1 ldp_tnt_mdl_mv_ip_crlc_sul_afs ip_crlc_sul_afs ldpm_nt_sul_ip_nt_sul_dec_fac_1 c_state_egr_cbk /end DEF_CHARACTERISTIC
 /begin OUT_MEASUREMENT nt_agi_inc_so2p_1 nt_agi_inc_so2p_2 nt_sul_agi_delta_1 nt_sul_agi_delta_2 nt_sul_h nt_sul nt_sul_32_1 nt_sul_32_2 nt_sul_h_32_1 nt_sul_h_32_2 nt_sul_max_1 nt_sul_max_2 nt_sul_so2p_beg_2 nt_sul_so2p_beg_1 nt_sul_delta_1 nt_sul_delta_2 nt_sul_h_delta_1 nt_sul_h_delta_2 nt_sul_h_so2p_beg_1 nt_sul_h_so2p_beg_2 /end OUT_MEASUREMENT
/end FUNCTION
/begin FUNCTION INJ_NOx_Cat_Model_Control "_NOx Cat Model Control"
 /begin DEF_CHARACTERISTIC c_ntld_mdl_dif_i_min c_ntld_mdl_dif_i_max c_ntld_dec_stop c_ntld_dec_rgn c_nox_out_mes_grd_max lc_nox_rgn_cmpl c_nox_ppm_ctrl_min c_ntld_ctrl_min c_crlc_nox_out_mes_mmv lc_nox_mdl_ctrl_act c_nox_out_mes_mmv_max c_nox_dif_mon c_nox_dif_mon_min c_t_nox_mdl_inh_ctrl_min c_t_nox_mdl_ctrl_ena_min lc_inh_p_hld lc_inh_nox_mdl_ctrl_ini ldpm_nox_cor_red_mmv ldp_maf_kgh_ip_crlc_nox_sens ip_ntld_mdl_dif_i ip_ntld_mdl_dif_p ip_crlc_nox_sens ldpm_tnt_mdl_mv /end DEF_CHARACTERISTIC
 /begin OUT_MEASUREMENT nox_out_mdl_sens nox_out_mdl_dif_2 ntld_mdl_dif nox_out_mdl_dif_1 nox_out_mes_mmv_2 nox_out_mes_mmv_1 t_nox_mdl_ctrl_act_2 t_nox_mdl_ctrl_act_1 t_nox_mdl_ctrl_ena_1 t_nox_mdl_ctrl_ena_2 ntld_mdl_dif_i ntld_mdl_dif_i_1 ntld_mdl_dif_i_2 ntld_mdl_dif_p ntld_mdl_dif_p_1 ntld_mdl_dif_p_2 lv_nox_rgn_cmpl lv_inh_nox_mdl_ctrl_rgn lv_inh_nox_mdl_ctrl_rgn_1 lv_inh_nox_mdl_ctrl_rgn_2 /end OUT_MEASUREMENT
/end FUNCTION
/begin FUNCTION INJ_NOx_Cat_Desulfation_Lambda_Stimulation "_NOx Cat Desulfation Lambda Stimulation"
 /begin DEF_CHARACTERISTIC c_delta_lamb_afr_so2p c_delta_lamb_afl_so2p c_t_lam_dly_so2p_pos c_t_lam_dly_so2p_neg c_so2p_lamb_ramp c_delta_lamb_sp_so2p ip_delta_lamb_ch_so2p ldpm_n_32_1_lamb_puls_so2p ldpm_maf_1_lamb_puls_so2p ip_lam_so2p_pos_p ip_lam_so2p_pos_i ip_lam_so2p_neg_p ip_lam_so2p_neg_i ldp_lamb_nox_sens_ip_lamb_nox ip_lamb_nox_sens_ref ldp_vls_nox_sens_ip_vls_nox ip_vls_nox_sens_ref c_state_sens_vls_down_ref c_vls_down_ref_man c_vls_down_afl c_vls_down_afr c_t_vls_down_cyc_afl_max c_t_vls_down_cyc_afr_max lc_t_afl_down_ctl ldpm_n_32_1_lamb_puls_ref ldpm_maf_2_lamb_puls_ref ip_t_afl_down_lock_afl ip_t_afl_down_lock_afr /end DEF_CHARACTERISTIC
 /begin OUT_MEASUREMENT lv_so2p_afr_1 lamb_puls_so2p_1 t_lam_dly_so2p_2 t_lam_dly_so2p_1 lv_afl_down_1 lv_afl_down_2 lv_vls_down_tra_2 lv_vls_down_tra_1 vls_down_ref_1 vls_down_ref_2 t_vls_down_cyc_afl_1 ctr_vls_down_afl_cyc_2 ctr_vls_down_afl_cyc_1 t_vls_down_cyc_afl_2 lamb_puls_so2p_2 lamb_puls_so2p_h_res_1 lamb_puls_so2p_h_res_2 /end OUT_MEASUREMENT
/end FUNCTION
/begin FUNCTION INJ_NOx_Engine_out_Emission_Adaptation "_NOx Engine out Emission Adaptation"
 /begin DEF_CHARACTERISTIC c_crlc_nox_ad_fac lc_nox_ad_act c_crlc_nox_ad c_nox_ad_dyw c_crlc_maf_fg_cyl c_maf_fg_cyl_dyw lc_nox_ad_on c_ntld_min_nox_ad c_nox_ad_fac_dif c_ctr_nox_ad_fac_min c_tnt_mdl_nox_ad_min c_tnt_mdl_nox_ad_max c_ntld_max_nox_ad lc_nox_ad_fac_ini c_nox_ad_fac_ini c_lamb_nox_ad_dyw c_n_32_min_rgn_nox_ad c_vs_min_rgn_nox_ad c_maf_min_rgn_nox_ad /end DEF_CHARACTERISTIC
 /begin OUT_MEASUREMENT nox_ad_fac lv_nox_ad_cmpl ntl_rgn_st_nox_mes_1 ntl_rgn_st_nox_mes_2 nox_ad_fac_1 nox_ad_fac_2 lv_dyw_nox_ad nox_cor_s_mmv maf_fg_cyl_mmv nox_ad_fac_raw_2 nox_ad_fac_raw_1 ctr_nox_ad_fac /end OUT_MEASUREMENT
/end FUNCTION
/begin FUNCTION INJ_NOx_catalyst_management_catalyst_states "_NOx catalyst management-catalyst states"
 /begin DEF_CHARACTERISTIC c_lamb_o2_stc c_o2_flow_cor_fac c_fac_o2_equ c_fac_cor_o2l c_lamb_stc c_lamb_rgn c_ntl_ini_st c_ntld_rgn_st_ini c_ntld_lgrd c_nox_conc_cor c_crlc_nox_conc_red c_crlc_nox_cor_red c_crlc_nox_conc_out_mdl c_ntld_nt_hom_rst c_t_afl_nt_hom_rst lc_nt_afs_req c_state_rgn_ctl c_state_sens_afr_1 c_state_sens_afr_2 c_state_sens_afr_trim_1 c_state_sens_afr_trim_2 c_t_afl_rgn_req_ntld c_t_afl_min c_vls_nox_sens_rgn_stop c_lamb_nox_sens_rgn_stop c_lamb_nox_sens_afr_trim c_nox_ppm_rgn_stop c_o2l_min c_sum_o2l_ntl_max c_ntl_trig_afr_afl c_sum_ntl_cyc_sp c_tnt_mdl_inh_purge lc_nox_sens lc_nox_sens_rgn lc_sum_ntl_cyc_new lc_ntld_max_afs lc_inh_rgn_pu c_tnt_mdl_min_hys c_tnt_mdl_max_hys c_t_nt_hom ldp_tnt_mdl_mv_ip_nox_red_fac ldp_nox_conc_mmv_ip_nt_stc_bas ldpm_tnt_mdl_nox ldp_lamb_mv_ip_o2_stc_max ldp_nt_agi_ntld_ip_nt_agi_rgn ldp_tnt_mdl_mv_ip_nt_agi_rgn ldpm_n_32_1 ldp_ntld_rgn_st_id_vls_down ldp_flow_nt_mmv_ip_t_rgn_max ldpm_maf_kgh_ip_t_nt_hom ldpm_lamb_av_cor_ip_t_nt_hom ldp_tqi_req_fast_ip_ntld_max ip_nox_red_fac ip_nt_eff_bas ip_nt_eff_cor ip_o2_stc_max ip_nt_agi_rgn_frq ip_ntl_min ip_ntld_max ip_ntld_max_adj id_vls_down_rgn_stop ip_t_nt_hom_dec ip_t_nt_hom_inc ip_t_rgn_max lc_rpu_state_nox lc_rpu_nt_eff_cor lc_rpu_nt_stc_bas lc_rpu_ntl lc_rpu_rgn_nt_req lc_rpu_nt_afs_req lc_rpu_rgn_agi lc_rpu_act_int_puc_afl lc_rpu_sens_afr lc_rpu_state_tran_calc c_nox_out_mes_int_max ldpm_ntld ip_nt_eff_bas_ef_close ldpm_nt_agi ldp_tqi_req_fast_ip_ntld_afs_at ldp_tqi_req_fast_ip_ntld_afs_mt ldp_n_32_ntld_max_afs_mt ldp_n_32_ntld_max_afs_at ip_fac_nox_sens_max c_fac_ntld_max_afs_err_egr ldp_flow_nt_mmv_ip_nox_sens_mt ldp_flow_nt_mmv_ip_nox_sens_at ldp_n_32_ip_nox_sens_max_mt ldp_n_32_ip_nox_sens_max_at c_nox_ppm_dif_mon c_nox_sens_max_ofs ldp_nt_agi_thermo__tnt_mdl_max ip_ntld_max_afs_at ip_ntld_max_afs_mt ip_nox_sens_max_mt ip_nox_sens_max_at c_nt_stc_bas_max_rng_h ip_nt_stc_bas_rng_h c_nt_stc_ini_rng_h lc_nt_act lc_sens_afr_mod c_t_nt_hom_max_vld c_vls_nox_sens_afr_trim c_vls_dist_grd_neg c_vls_dist_grd_pos c_vls_max_rgn_2_stop ip_tnt_mdl_min ip_tnt_mdl_min_is ldp_nt_agi_thermo__tnt_mdl_min ldp_nt_agi_thermo_ip_tnt_min_is c_vls_max_rgn_1_stop c_vls_grd_neg_vls_set c_vls_down_afr_trim c_t_stop_afl_purge_max c_maf_int_stop_afl_purge_max c_ctr_afl_purge_max c_vls_down_afl_purge_on c_vls_down_afl_purge_off c_vls_nox_sens_afl_purge_on c_vls_nox_sens_afl_purge_off c_lamb_nox_sens_afl_purge_on c_lamb_nox_sens_afl_purge_off c_vs_inh_purge lc_nox_rpu lc_inh_afl_purge_tout ldpm_tqi_req_fast_1_egtr ldp_tnt_mdl_mv_ip_fac_nox_sens ldp_nox_cor_ip_nt_eff_cor ip_tnt_mdl_max ldp_ntl_dec_int_ip_t_max_rgn ldp_ntl_rgn_st_ip_t_max_rgn ldp_ntl_rgn_st_ip_ntl_dec_int ip_t_max_rgn_2_stop ip_ntl_dec_int_max c_dist_afl_min c_ratio_nox_out_int_dist_max c_nox_cor_int_min c_crlc_flow_nt c_ratio_nox_max c_state_sens_afl_purge[0] c_state_sens_afl_purge[1] /end DEF_CHARACTERISTIC
 /begin OUT_MEASUREMENT lv_trig_afr_afl lv_rgn_nt_req lv_nt_afs_req lv_rgn_agi_1 lv_rgn_agi_2 lv_rgn_agi_vld_1 lv_rgn_agi_vld_2 lv_nox_sens_rgn lv_nox_sens lv_afl_not lv_rgn_stop_sens lv_rgn_stop_tout lv_rgn_stop_mdl lv_rgn_req_ntld lv_rgn_req_nox_sens lv_rgn_req_ntld_afs lv_act_int_puc_afl_1 lv_act_int_puc_afl_2 lv_sens_afr_1 lv_sens_afr_2 lv_sens_afr_trim lv_nt_hom_ini lv_nox_sens_nox_vld_rgn_st_2 lv_t_afl_min lv_mdl_afr lv_tout_afr nox_conc_raw nox_conc_red nox_conc nox_conc_red_mmv_rgn_st nox_conc_red_mmv nox_ppm_tmp_1 nox_ppm_tmp_2 nox_sens_max nox_conc_mmv nox_conc_out_mdl nox_conc_out_mdl_mmv nox_ppm_rgn_st_2 nox_ppm_rgn_st_1 nox_cor nox_cor_red nox_flow nox_out_mdl nox_out_mdl_int nox_out_int_tmp_2 nt_eff nt_eff_cor nt_eff_cor_rgn_st ntl ntl_rgn_st_nox ntl_rgn_st ntl_dec_int_1 ntl_dec_2 ntl_dec_1 ntl_dec_int_swi_2 ntl_dec_int_swi_1 ntl_dec_int_2 o2l nt_o2_stc nt_o2_stc_bas o2_flow fac_rgn_dec_shar ntld ntld_mdl ntld_rgn_st ntld_max t_afl t_afl_puc t_nt_hom t_nt_hom_delta sum_ntl_cyc flow_nt_mmv nt_agi_av nox_cor_red_mmv tnt_mdl_max tnt_mdl_min lv_rgn_req_nox_sens_tmp_1 lv_rgn_req_nox_sens_tmp_2 lv_sens_afr_trim_tmp_1 lv_sens_afr_trim_tmp_2 nt_eff_bas ntld_max_afs ntld_max_afs_bas nox_sens_max_bas nt_stc_rng_h nt_stc_bas_rng_h t_afl_sum lv_nt_act lv_sens_rgn_1_ready lv_rgn_cdn lv_vls_grd_neg ntl_min vls_min_tmp vls_max_tmp vls_nox_sens_old nox_out_int_tmp_1 nox_cor_int dist_afl_st lv_nox_sens_nox_vld_rgn_st_1 dist_afl t_stop maf_int_stop state_nox lv_cat_purge_req_post_afl[0] lv_cat_purge_req_post_afl[1] state_afl_purge[0] state_afl_purge[1] ctr_afl_purge[0] ctr_afl_purge[1] ratio_nox[0] ratio_nox[1] ratio_nox_out_int_dist[0] ratio_nox_out_int_dist[1] /end OUT_MEASUREMENT
/end FUNCTION
/begin FUNCTION INJ_NOx_catalyst_desulfation "_NOx catalyst desulfation"
 /begin DEF_CHARACTERISTIC lc_inh_ch_so2p_man lc_inh_ch_so2p_off c_tnt_mdl_so2p_min c_tnt_mdl_so2p_hys c_tnt_mdl_so2p_fast c_tnt_mdl_so2p_fast_hys c_lamb_so2p c_lamb_so2p_hys c_t_so2p_not_max c_nt_agi_so2p_max c_vs_so2p_fast_thd c_vs_so2p_fast_hys lc_so2p_fast_man c_lamb_so2p_pas ldp_tnt_mdl_mv__lamb_so2p ip_lamb_so2p c_nt_sul_so2p_max ldp_tnt_mdl_mv_ip_vs_so2p_fast ip_vs_so2p_fast_thd c_tnt_mdl_so2p_min_delta ldp_lamb_vls_down_ref c_vls_down_ref_so2p c_vls_down_so2p_min c_vls_down_so2p_hys c_state_sens_vls_down_so2p_act_1 c_state_sens_vls_down_so2p_act_2 ip_lamb_vls_down_ref /end DEF_CHARACTERISTIC
 /begin OUT_MEASUREMENT lv_inh_ch_so2p lv_so2p_req lv_so2p_fast_req lv_so2p_lamb_puls lv_so2p_act lv_so2p_afr_cord t_so2p_not t_so2p_dly lamb_so2p lv_so2p_act_lamb_1 lv_so2p_act_lamb_2 lv_so2p_act_tnt /end OUT_MEASUREMENT
/end FUNCTION
/begin FUNCTION INJ_NOx_engine_out_emission_stratified_mode "_NOx engine out emission stratified mode"
 /begin DEF_CHARACTERISTIC c_open_min_act_egr_nox_cor_s c_amp_bas_nox_s ldpm_n_32_1_nox_s ip_egr_ratio_bas_nox_cor_mdl ip_nox_s ip_nox_egr_ratio_dif_s ip_nox_tco_s_egr_close ldpm_mff_sp_s_2_nox_s ldp_tco_nox_tco_s_egr_close ldpm_tia_2_nox_tia_s ip_nox_tia_s ip_nox_tia_s_egr_close ldp_fac_maf_max ip_fac_maf_max ip_nox_s_egr_close ip_nox_map_dif_s lc_rpu_nox_cor_s c_tco_bas_nox_s ldpm_pq_egr_nox_s ldpm_tco_dif_nox_s_nox_s ldpm_tia_nox_s ldpm_map_dif_nox_s_nox_s ldp_egr_ratio_nox_s ip_nox_map_dif_s_egr_close ip_nox_tco_s /end DEF_CHARACTERISTIC
 /begin OUT_MEASUREMENT map_dif_nox_s nox_cor_s tco_dif_nox_s nox_cor_s_tmp_1 nox_cor_s_tmp_2 /end OUT_MEASUREMENT
/end FUNCTION
/begin FUNCTION INJ_NOx___Sensor_function "_NOx - Sensor function"
 /begin DEF_CHARACTERISTIC c_maf_int_puc_min_nox c_maf_int_afs_min_nox c_nt_agi_nox_ofs_min c_crlc_nox_ofs_afs c_nox_ofs_puc_max c_nox_ofs_man_1 c_nox_ofs_man_2 c_vls_dif_nox_ofs_max c_nox_ppm_ad_add_max lc_nox_sens_ad_rst lc_nox_sens_nox_ofs_vld_on c_nt_hom_ini_use c_nox_ofs_sel c_t_nox_sens_nox_ofs c_tnt_mdl_nox_ofs_min c_tnt_mdl_nox_ofs_max c_t_afl_nox_ofs_min c_t_nox_ppm_delta_min c_t_nox_sens_vld c_t_nox_sens_vld_puc c_crlc_nox_ofs_puc c_crlc_nox_ppm_delta c_nox_ppm_max_sens_vld c_nox_ppm_delta_mmv_min c_nox_ppm_delta_mmv_max c_nox_ppm_ad_add_min c_nox_ofs_afs_dft ldp_nox_nox_sens_diag_min ip_crlc_nox_ofs_load /end DEF_CHARACTERISTIC
 /begin OUT_MEASUREMENT nox_ppm_1 nox_ppm_2 nox_ppm_ad_add_1 nox_ppm_ad_add_2 nox_ofs_puc_1 nox_ofs_puc_2 nox_ofs_afs_2 nox_ofs_load_2 nox_ofs_load_1 nox_nox_sens_diag_min_1 nox_nox_sens_diag_min_2 nox_ofs_afs_1 maf_int_afs_1 maf_int_afs_2 lv_nox_ofs_load_1 lv_nox_ofs_load_2 lv_t_nox_sens_vld_2 lv_t_nox_sens_vld lv_t_nox_sens_vld_1 t_nox_ppm_delta_vld_1 t_nox_ppm_delta_vld_2 nox_ppm_delta_1 nox_ppm_delta_2 nox_ppm_delta_mmv_1 nox_ppm_delta_mmv_2 /end OUT_MEASUREMENT
/end FUNCTION
/begin FUNCTION INJ_NOx_catalyst_Oxygen_storage_capacity_adaptation "_NOx catalyst Oxygen storage capacity adaptation"
 /begin DEF_CHARACTERISTIC c_dist_o2_stc c_dist_o2_stc_vld c_nt_o2_stc_delta lc_nt_o2_stc_req lc_nt_o2_stc_vld c_nt_o2_stc_ad_man lc_nt_o2_stc_ad_man lc_nt_o2_stc_rep_off /end DEF_CHARACTERISTIC
 /begin OUT_MEASUREMENT lv_nt_o2_stc_req lv_nt_o2_stc_lim lv_nt_o2_stc_vld nt_o2_stc_ad nt_o2_stc_ofs dist_o2_stc_old dist_nt ntl_dec_int_ad /end OUT_MEASUREMENT
/end FUNCTION
/begin FUNCTION INJ_Application_Incidence_for_NOx_Cat_Desulfation_Lambda_Stimulation "_Application Incidence for NOx Cat Desulfation Lambda Stimulation" /begin DEF_CHARACTERISTIC lc_inh_lamb_puls_so2p_man lc_inh_lamb_puls_so2p_off /end DEF_CHARACTERISTIC
 /begin OUT_MEASUREMENT lv_inh_lamb_puls_so2p lv_so2p_afr_2 t_vls_down_cyc_afr_2 t_vls_down_cyc_afr_1 t_afl_down_lock_2 t_afl_down_lock_1 /end OUT_MEASUREMENT
/end FUNCTION
/begin FUNCTION INJ_NOx_engine_out_emission_homogeneous_mode "_NOx engine out emission homogeneous mode"
 /begin DEF_CHARACTERISTIC ldp_n_32__nox_hom ldpm_maf_10 ip_nox_hom ldp_n_32__nox_iga ip_nox_iga ldpm_maf_12 ldp_lamb_dif_nox__nox_lamb_mv ip_nox_lamb_mv ldp_tia__nox_tia_hom ip_nox_tia_hom ldp_egr_ratio__nox_egr_hom ip_nox_egr_hom /end DEF_CHARACTERISTIC
 /begin OUT_MEASUREMENT nox_cor_hom nox_add_iga lamb_dif_nox /end OUT_MEASUREMENT
/end FUNCTION
/begin FUNCTION INJ_NOx_catalyst_desulfation___heating_activation "_NOx catalyst desulfation - heating activation"
 /begin DEF_CHARACTERISTIC c_vs_ch_so2p_hys c_tnt_mdl_ch_hys ip_tnt_delta ldp_nt_agi_sul__ip_tnt_delta c_vs_ch_so2p_min c_vs_ch_so2p_min_1 c_vs_ch_so2p_min_2 c_vs_ch_so2p_mmv_min c_t_vs_ch_so2p_min_1 c_t_ch_so2p_act_max c_t_ast_ch_so2p_max c_t_vs_ch_so2p_min_2 c_crlc_tnt_mdl_max_avl c_crlc_vs_ch_so2p c_ctr_ch_so2p_max c_dist_ch_so2p_min c_dist_t_ch_so2p_rst lc_tq_add_lamb_ch lc_ena_t_ast_ch ldp_nt_agi_thermo_ip_tnt_ch_sp ldp_flow_nt_mmv_tnt_mdl_dif_ch_lamb ip_tnt_mdl_ch_so2p_sp ip_tnt_mdl_dif_ch_lamb /end DEF_CHARACTERISTIC
 /begin OUT_MEASUREMENT lv_ch_so2p_stb lv_vs_ch_so2p_min_1 lv_vs_ch_so2p_min_2 tnt_mdl_ch_so2p_sp t_vs_ch_so2p_min_1 t_vs_ch_so2p_min_2 state_ch_so2p_req ctr_ch_so2p t_ch_so2p_act tnt_mdl_max_avl_mmv vs_ch_so2p_mmv lv_ch_so2p lv_lamb_so2p_ctl dist_ch_so2p dist_ch_so2p_old /end OUT_MEASUREMENT
/end FUNCTION
/begin FUNCTION INJ_Application_incidence_for_NOx_cat_aging "_Application incidence for NOx cat aging"
 /begin DEF_CHARACTERISTIC c_tnt_mdl_nt_agi_delta c_tnt_mdl_nt_agi_dyw c_crlc_tnt_mdl_nt_agi_dyw lc_inh_nt_agi_man lc_inh_nt_agi_off c_tnt_mdl_nt_agi_min c_tnt_mdl_nt_agi_max c_n_32_nt_agi_max c_n_32_nt_agi_min c_mff_sp_s_nt_agi_max c_mff_sp_s_nt_agi_min c_lamb_nt_agi_min c_tia_nt_agi_min c_toil_nt_agi_max c_toil_nt_agi_min c_amp_nt_agi_min c_tnt_mdl_mv_agi_min c_tnt_mdl_mv_agi_max lc_nox_sens_max_agi_adj_ena c_err_egr_3_req_ctr_min /end DEF_CHARACTERISTIC
/end FUNCTION
/end MODULE
/end PROJECT
