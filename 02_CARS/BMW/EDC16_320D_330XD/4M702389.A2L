ASAP2_VERSION 1 3
/begin PROJECT P389 "BMW DDE6.0 4-Zylinder V70.2 30.03.2004"
/begin HEADER "" VERSION "V70.2_4Z" PROJECT_NO P389 /end HEADER
/begin MODULE DIM ""
/begin MOD_COMMON "" BYTE_ORDER MSB_FIRST ALIGNMENT_BYTE 1 ALIGNMENT_WORD 2 ALIGNMENT_LONG 4 ALIGNMENT_FLOAT32_IEEE 4 /end MOD_COMMON
/begin CHARACTERISTIC PCR_I1AdPCVKi_C "Grundwert der I-Verstaerkung des I-Reglers bei Kleinsignalen" VALUE 0xE7CC8 Kw_Wu32 999999.999767 Ki 0.00 999999.999767 FORMAT "%13.6" /end CHARACTERISTIC
/begin CHARACTERISTIC PCR_I1AdPCVKiPos_C "Grundwert der I-Verstaerkung des I-Reglers bei positiven Grossesignalen" VALUE 0xE7CCC Kw_Wu32 999999.999767 Ki 0.00 999999.999767 FORMAT "%13.6" /end CHARACTERISTIC
/begin CHARACTERISTIC PCR_I1AdPCVKiNeg_C "Grundwert der I-Verstaerkung des I-Reglers bei negativen Grossesignalen" VALUE 0xE7CD0 Kw_Wu32 999999.999767 Ki 0.00 999999.999767 FORMAT "%13.6" /end CHARACTERISTIC
/begin CHARACTERISTIC PCR_rI1AdPCVWinPos_C "obere Kleinsignalgrenze des I-Reglers" VALUE 0xE7CD4 Kw_Ws16 799.9878 Prc -400.0000 399.9878 FORMAT "%8.4" /end CHARACTERISTIC
/begin CHARACTERISTIC PCR_rI1AdPCVWinNeg_C "untere Kleinsignalgrenze des I-Reglers" VALUE 0xE7CD6 Kw_Ws16 799.9878 Prc -400.0000 399.9878 FORMAT "%8.4" /end CHARACTERISTIC
/begin CHARACTERISTIC PCR_I2AdPCVKi_C "Grundwert der I-Verstaerkung des I-Reglers bei Kleinsignalen" VALUE 0xE7CD8 Kw_Wu32 999999.999767 Ki 0.00 999999.999767 FORMAT "%13.6" /end CHARACTERISTIC
/begin CHARACTERISTIC PCR_I2AdPCVKiPos_C "Grundwert der I-Verstaerkung des I-Reglers bei positiven Grossesignalen" VALUE 0xE7CDC Kw_Wu32 999999.999767 Ki 0.00 999999.999767 FORMAT "%13.6" /end CHARACTERISTIC
/begin CHARACTERISTIC PCR_I2AdPCVKiNeg_C "Grundwert der I-Verstaerkung des I-Reglers bei negativen Grossesignalen" VALUE 0xE7CE0 Kw_Wu32 999999.999767 Ki 0.00 999999.999767 FORMAT "%13.6" /end CHARACTERISTIC
/begin CHARACTERISTIC PCR_rI2AdPCVWinPos_C "obere Kleinsignalgrenze des I-Reglers" VALUE 0xE7CE4 Kw_Ws16 799.9878 Prc -400.0000 399.9878 FORMAT "%8.4" /end CHARACTERISTIC
/begin CHARACTERISTIC PCR_rI2AdPCVWinNeg_C "untere Kleinsignalgrenze des I-Reglers" VALUE 0xE7CE6 Kw_Ws16 799.9878 Prc -400.0000 399.9878 FORMAT "%8.4" /end CHARACTERISTIC
/begin CHARACTERISTIC PCR_I3AdPCVKi_C "Grundwert der I-Verstaerkung des I-Reglers bei Kleinsignalen" VALUE 0xE7CE8 Kw_Wu32 999999.999767 Ki 0.00 999999.999767 FORMAT "%13.6" /end CHARACTERISTIC
/begin CHARACTERISTIC PCR_I3AdPCVKiPos_C "Grundwert der I-Verstaerkung des I-Reglers bei positiven Grossesignalen" VALUE 0xE7CEC Kw_Wu32 999999.999767 Ki 0.00 999999.999767 FORMAT "%13.6" /end CHARACTERISTIC
/begin CHARACTERISTIC PCR_I3AdPCVKiNeg_C "Grundwert der I-Verstaerkung des I-Reglers bei negativen Grossesignalen" VALUE 0xE7CF0 Kw_Wu32 999999.999767 Ki 0.00 999999.999767 FORMAT "%13.6" /end CHARACTERISTIC
/begin CHARACTERISTIC PCR_rI3AdPCVWinPos_C "obere Kleinsignalgrenze des I-Reglers" VALUE 0xE7CF4 Kw_Ws16 799.9878 Prc -400.0000 399.9878 FORMAT "%8.4" /end CHARACTERISTIC
/begin CHARACTERISTIC PCR_rI3AdPCVWinNeg_C "untere Kleinsignalgrenze des I-Reglers" VALUE 0xE7CF6 Kw_Ws16 799.9878 Prc -400.0000 399.9878 FORMAT "%8.4" /end CHARACTERISTIC
/begin CHARACTERISTIC PCR_I4AdPCVKi_C "Grundwert der I-Verstaerkung des I-Reglers bei Kleinsignalen" VALUE 0xE7CF8 Kw_Wu32 999999.999767 Ki 0.00 999999.999767 FORMAT "%13.6" /end CHARACTERISTIC
/begin CHARACTERISTIC PCR_I4AdPCVKiPos_C "Grundwert der I-Verstaerkung des I-Reglers bei positiven Grossesignalen" VALUE 0xE7CFC Kw_Wu32 999999.999767 Ki 0.00 999999.999767 FORMAT "%13.6" /end CHARACTERISTIC
/begin CHARACTERISTIC PCR_I4AdPCVKiNeg_C "Grundwert der I-Verstaerkung des I-Reglers bei negativen Grossesignalen" VALUE 0xE7D00 Kw_Wu32 999999.999767 Ki 0.00 999999.999767 FORMAT "%13.6" /end CHARACTERISTIC
/begin CHARACTERISTIC PCR_rI4AdPCVWinPos_C "obere Kleinsignalgrenze des I-Reglers" VALUE 0xE7D04 Kw_Ws16 799.9878 Prc -400.0000 399.9878 FORMAT "%8.4" /end CHARACTERISTIC
/begin CHARACTERISTIC PCR_rI4AdPCVWinNeg_C "untere Kleinsignalgrenze des I-Reglers" VALUE 0xE7D06 Kw_Ws16 799.9878 Prc -400.0000 399.9878 FORMAT "%8.4" /end CHARACTERISTIC
/begin CHARACTERISTIC PCR_tiDT1DesCld_C "Verzögerungszeitkonstante der dynamischen Sollwertbildung bei kaltem Motor" VALUE 0xE6FC0 Kw_Wu32 4294.9663 TimeDelay_s 0.0010000001 4294.9673 FORMAT "%9.4" EXTENDED_LIMITS 0.0000010000000 4294.9673 /end CHARACTERISTIC
/begin CHARACTERISTIC PCR_DKdDesCld_C "Kleinsignalverstärkung der dynamischen Sollwertbildung bei kaltem Motor" VALUE 0xE6FC4 Kw_Ws32 65535.9999847 Kd -32768.0000000 32767.9999847 FORMAT "%13.7" /end CHARACTERISTIC
/begin CHARACTERISTIC PCR_DKdPosDesCld_C "Positive Großsignalverstärkung der dynamischen Sollwertbildung bei kaltem Motor" VALUE 0xE6FC8 Kw_Ws32 65535.9999847 Kd -32768.0000000 32767.9999847 FORMAT "%13.7" /end CHARACTERISTIC
/begin CHARACTERISTIC PCR_DKdNegDesCld_C "Negative Großsignalverstärkung der dynamischen Sollwertbildung bei kaltem Motor" VALUE 0xE6FCC Kw_Ws32 65535.9999847 Kd -32768.0000000 32767.9999847 FORMAT "%13.7" /end CHARACTERISTIC
/begin CHARACTERISTIC PCR_dpDWinPosDesCld_C "Positive Kleinsignalgrenze bei kaltem Motor" VALUE 0xE6FD0 Kw_Ws16 65535.00 Pres_hPa -32768.00 32767.00 FORMAT "%8.2" /end CHARACTERISTIC
/begin CHARACTERISTIC PCR_dpDWinNegDesCld_C "Negative Kleinsignalgrenze bei kaltem Motor" VALUE 0xE6FD2 Kw_Ws16 65535.00 Pres_hPa -32768.00 32767.00 FORMAT "%8.2" /end CHARACTERISTIC
/begin CHARACTERISTIC PCR_ctAirPerTimeFrq_C "Anzahl der Abtastungen der erfassten Frischluftmasse für die diskrete Fouriertransformation" VALUE 0xEA1E0 Kw_Wu8 9.000 OneToOne 1.000 10.00 FORMAT "%5.2" EXTENDED_LIMITS 0.00 255.0 /end CHARACTERISTIC
/begin CHARACTERISTIC PCR_DebLPDvtNegDef_C "Vorentprellzeit für Erkennung negativer bleibender Regelabw." VALUE 0xE9C5C Kw_Wu16 655350.0 Time_ms 0.00 655350.0 FORMAT "%8.1" /end CHARACTERISTIC
/begin CHARACTERISTIC PCR_DebLPDvtNegOk_C "Vorentprellzeit für Heilung bei negativer bleibender Regelabw." VALUE 0xE9C5E Kw_Wu16 655350.0 Time_ms 0.00 655350.0 FORMAT "%8.1" /end CHARACTERISTIC
/begin CHARACTERISTIC PCR_DebLPDvtPosDef_C "Vorentprellzeit für Erkennung positiver bleibender Regelabw." VALUE 0xE9C60 Kw_Wu16 655350.0 Time_ms 0.00 655350.0 FORMAT "%8.1" /end CHARACTERISTIC
/begin CHARACTERISTIC PCR_DebLPDvtPosOk_C "Vorentprellzeit für Heilung bei positiver bleibender Regelabw." VALUE 0xE9C62 Kw_Wu16 655350.0 Time_ms 0.00 655350.0 FORMAT "%8.1" /end CHARACTERISTIC
/begin CHARACTERISTIC PCR_DebSRCHighDef_C "Defektzeit SRC-high" VALUE 0xE9D84 Kw_Wu16 655350.0 Time_ms 0.00 655350.0 FORMAT "%8.1" /end CHARACTERISTIC
/begin CHARACTERISTIC PCR_DebSRCHighOk_C "Heilungszeit SRC-high" VALUE 0xE9D86 Kw_Wu16 655350.0 Time_ms 0.00 655350.0 FORMAT "%8.1" /end CHARACTERISTIC
/begin CHARACTERISTIC PCR_DebSRCLowDef_C "Defektzeit SRC-low" VALUE 0xE9D88 Kw_Wu16 655350.0 Time_ms 0.00 655350.0 FORMAT "%8.1" /end CHARACTERISTIC
/begin CHARACTERISTIC PCR_DebSRCLowOk_C "Heilungszeit SRC-low" VALUE 0xE9D8A Kw_Wu16 655350.0 Time_ms 0.00 655350.0 FORMAT "%8.1" /end CHARACTERISTIC
/begin CHARACTERISTIC PCR_dlyPT1_C "Zeitkonstante der Sollwertverzögerung für I-Anteil" VALUE 0xE7D08 Kw_Wu32 4294.9663 TimeDelay_s 0.0010000001 4294.9673 FORMAT "%9.4" EXTENDED_LIMITS 0.0000010000000 4294.9673 /end CHARACTERISTIC
/begin CHARACTERISTIC PCR_dnAvrgAdPCVLim_C "Maximale Grenze fuer Motordrehzahl Beschleunigung" VALUE 0xE7D0C Kw_Ws16 655350.0 dn_dZ20 -327680.0 327670.0 FORMAT "%8.1" /end CHARACTERISTIC
/begin CHARACTERISTIC PCR_tiDnCorrDT1_C "Time delay for DT1 (engine-speed gradient calculation)" VALUE 0xE7D10 Kw_Wu32 4294.9673 TimeDelay_s 0.0000010000000 4294.9673 FORMAT "%9.4" /end CHARACTERISTIC
/begin CHARACTERISTIC PCR_DnCorrDKd_C "Gain for DT1 (engine-speed gradient calculation)" VALUE 0xE7D14 Kw_Ws32 32767.9999924 Kd_rpm2dndt -16384.0000000 16383.9999924 FORMAT "%13.7" /end CHARACTERISTIC
/begin CHARACTERISTIC PCR_dnSurgeCtlRel_C "Max. Limit für Drehzahlbeschl. bei Erkennung gleicher Status" VALUE 0xE9FA0 Kw_Ws16 655350.0 dn_dZ20 -327680.0 327670.0 FORMAT "%8.1" /end CHARACTERISTIC
/begin CHARACTERISTIC PCR_dpBDes_C "Derivative of desired boost pressure" VALUE 0xE6FD4 Kw_Ws16 8000.000 dp_dZ20 -4000.000 4000.000 FORMAT "%8.3" EXTENDED_LIMITS -327680.0 327670.0 /end CHARACTERISTIC
/begin CHARACTERISTIC PCR_tiDpCorrDT1_C "Zeitverzögerung für die D-Parameterkorrektur aus dem Ladedruckgradienten" VALUE 0xE7D18 Kw_Wu32 4294.9673 TimeDelay_s 0.0000010000000 4294.9673 FORMAT "%9.4" /end CHARACTERISTIC
/begin CHARACTERISTIC PCR_dpCorrDKd_C "Faktor für D-Parameter Korrektur generiert aus dem Ladedruckgradient" VALUE 0xE7D1C Kw_Ws32 32767.9999924 Kd_Pres2dpdt -16384.0000000 16383.9999924 FORMAT "%13.7" /end CHARACTERISTIC
/begin CHARACTERISTIC PCR_dpSlpLimDwn_C "Down slope" VALUE 0xE6FD8 Kw_Wu32 65535949.9817 RmpPres_hPa 50.0030517578 65535999.9847 FORMAT "%13.4" EXTENDED_LIMITS 0.00 65535999.9847 /end CHARACTERISTIC
/begin CHARACTERISTIC PCR_dpSlpLimUp_C "Up slope" VALUE 0xE6FDC Kw_Wu32 65535949.9817 RmpPres_hPa 50.0030517578 65535999.9847 FORMAT "%13.4" EXTENDED_LIMITS 0.00 65535999.9847 /end CHARACTERISTIC
/begin CHARACTERISTIC PCR_dpSurgeCtlRmpUp_C "Anti Surge Rampensteigung AUF" VALUE 0xE9FA4 Kw_Wu32 65535999.9847 RmpPres_hPa 0.00 65535999.9847 FORMAT "%13.4" /end CHARACTERISTIC
/begin CHARACTERISTIC PCR_dpSurgeCtlRmpDwn_C "Anti Surge Rampensteigung AB" VALUE 0xE9FA8 Kw_Wu32 65535999.9847 RmpPres_hPa 0.00 65535999.9847 FORMAT "%13.4" /end CHARACTERISTIC
/begin CHARACTERISTIC PCR_dqCtlAdPCVLim_C "Maximale Grenze fuer Einspritzmenge" VALUE 0xE7D20 Kw_Ws16 32767.50 InjMassPerSec_20ms -16384.00 16383.50 FORMAT "%8.2" /end CHARACTERISTIC
/begin CHARACTERISTIC PCR_tiAdPCVqCtlDT1_C "Zeitkonstante T1 des PT1-Filters im DT1-Filter" VALUE 0xE7D24 Kw_Wu32 4294.9663 TimeDelay_s 0.0010000001 4294.9673 FORMAT "%9.4" EXTENDED_LIMITS 0.0000010000000 4294.9673 /end CHARACTERISTIC
/begin CHARACTERISTIC PCR_DKdAdPCVqCtlDT1_C "Differentiationsfaktor Kd (fuer Kd=0.02 gilt y(k)=exp(-Ts/T1)*y(k-1)+(x(k)-x(k-1)))" VALUE 0xE7D28 Kw_Ws32 10.0000000000 Kd 0.00 10.0000000000 FORMAT "%13.10" EXTENDED_LIMITS -32768.0000000 32767.9999847 /end CHARACTERISTIC
/begin CHARACTERISTIC PCR_dqDes_C "Application constant for derivative of desired fuel quantity" VALUE 0xE6FE0 Kw_Ws16 200.0000 InjMassPerSec_20ms 0.00 200.0000 FORMAT "%8.4" EXTENDED_LIMITS -16384.00 16383.50 /end CHARACTERISTIC
/begin CHARACTERISTIC PCR_dqSurgeCtlRel_C "Max. Limit für Einspritzmengengradienten bei Erkennung gleicher Status" VALUE 0xE9FAC Kw_Ws16 32767.50 InjMassPerSec_20ms -16384.00 16383.50 FORMAT "%8.2" /end CHARACTERISTIC
/begin CHARACTERISTIC PCR_drAdPCVCtlRmpUp_C "Rampensteigung (steigend) für Ausgabewert der adaptiven Vorsteuerung" VALUE 0xE7D2C Kw_Wu32 799998.699874 RmpPrc 1.29994004965 799999.999814 FORMAT "%13.6" EXTENDED_LIMITS 0.00 799999.999814 /end CHARACTERISTIC
/begin CHARACTERISTIC PCR_drAdPCVCtlRmpDwn_C "Rampensteigung (fallend) für Ausgabewert der adaptiven Vorsteuerung" VALUE 0xE7D30 Kw_Wu32 799998.699874 RmpPrc 1.29994004965 799999.999814 FORMAT "%13.6" EXTENDED_LIMITS 0.00 799999.999814 /end CHARACTERISTIC
/begin CHARACTERISTIC PCR_drAPP1UnFlt_C "Application constant for ratio of Accelerator pedal 1 position unfiltered value" VALUE 0xE6FE2 Kw_Ws16 100.0977 PrcPerSec 0.00 100.0977 FORMAT "%8.4" EXTENDED_LIMITS -20000.00 19999.39 /end CHARACTERISTIC
/begin CHARACTERISTIC PCR_drBPALPRmpUp_C "Positive Rampensteigung" VALUE 0xE86A8 Kw_Wu32 799999.999814 RmpPrc 0.00 799999.999814 FORMAT "%13.6" /end CHARACTERISTIC
/begin CHARACTERISTIC PCR_drBPALPRmpDwn_C "Negative Rampensteigung" VALUE 0xE86AC Kw_Wu32 799999.999814 RmpPrc 0.00 799999.999814 FORMAT "%13.6" /end CHARACTERISTIC
/begin CHARACTERISTIC PCR_drBPGovMaxDynUp_C "Rate of increase of dynamic correction for maximum allowable PCR governor output" VALUE 0xE7D34 Kw_Wu32 100.000016391 RmpPrc 0.00 100.000016391 FORMAT "%13.9" EXTENDED_LIMITS 0.00 799999.999814 /end CHARACTERISTIC
/begin CHARACTERISTIC PCR_drBPGovMaxDynDn_C "Rate of decrease of dynamic correction for maximum allowable PCR governor output" VALUE 0xE7D38 Kw_Wu32 100.000016391 RmpPrc 0.00 100.000016391 FORMAT "%13.9" EXTENDED_LIMITS 0.00 799999.999814 /end CHARACTERISTIC
/begin CHARACTERISTIC PCR_drSurgeCtlRmpUp_C "Anti Surge Rampensteigung AUF" VALUE 0xE9FB0 Kw_Wu32 799999.999814 RmpPrc 0.00 799999.999814 FORMAT "%13.6" /end CHARACTERISTIC
/begin CHARACTERISTIC PCR_drSurgeCtlRmpDwn_C "Anti Surge Rampensteigung AB" VALUE 0xE9FB4 Kw_Wu32 799999.999814 RmpPrc 0.00 799999.999814 FORMAT "%13.6" /end CHARACTERISTIC
/begin CHARACTERISTIC PCR_tiBDesRaw_C "Reciprocal of time delay" VALUE 0xE6FE4 Kw_Wu32 4294.9663 TimeDelay_s 0.0010000001 4294.9673 FORMAT "%9.4" EXTENDED_LIMITS 0.0000010000000 4294.9673 /end CHARACTERISTIC
/begin CHARACTERISTIC PCR_dpBDesRaw_C "Differential factor" VALUE 0xE6FE8 Kw_Ws32 8000.00000000 Kd_Pres2dpdt -4000.00000000 4000.00000000 FORMAT "%13.8" EXTENDED_LIMITS -16384.0000000 16383.9999924 /end CHARACTERISTIC
/begin CHARACTERISTIC PCR_tiDT1qDes_C "Time delay factor for the DT1 filter for desired fuel quantity" VALUE 0xE6FEC Kw_Wu32 4294.9663 TimeDelay_s 0.0010000001 4294.9673 FORMAT "%9.4" EXTENDED_LIMITS 0.0000010000000 4294.9673 /end CHARACTERISTIC
/begin CHARACTERISTIC PCR_DKdqDes_C "Differential factor for DT1 filter for desired fuel quantity" VALUE 0xE6FF0 Kw_Ws32 10.0000000000 Kd 0.00 10.0000000000 FORMAT "%13.10" EXTENDED_LIMITS -32768.0000000 32767.9999847 /end CHARACTERISTIC
/begin CHARACTERISTIC PCR_tiDT1rAPP1_C "time delay for DT1 filter for Accelerator pedal 1 position" VALUE 0xE6FF4 Kw_Wu32 4294.9663 TimeDelay_s 0.0010000001 4294.9673 FORMAT "%9.4" EXTENDED_LIMITS 0.0000010000000 4294.9673 /end CHARACTERISTIC
/begin CHARACTERISTIC PCR_DKdrAPP1_C "Derivative factor for DT1 Filter for Accelerator pedal 1 position" VALUE 0xE6FF8 Kw_Ws32 10.0000000000 Kd 0.00 10.0000000000 FORMAT "%13.10" EXTENDED_LIMITS -32768.0000000 32767.9999847 /end CHARACTERISTIC
/begin CHARACTERISTIC PCR_tiDT1LP_C "Verzoegerungszeitkonstante fuer das DT1-Glied des PIDT1-Reglers" VALUE 0xE86B0 Kw_Wu32 4294.9663 TimeDelay_s 0.0010000001 4294.9673 FORMAT "%9.4" EXTENDED_LIMITS 0.0000010000000 4294.9673 /end CHARACTERISTIC
/begin CHARACTERISTIC PCR_DKdLP_C "Grundwert der D-Verstaerkung des PIDT1-Reglers bei Kleinsignalen" VALUE 0xE86B4 Kw_Ws32 9.99999996275 Kd_Pres_hPa2Prc 0.00 9.99999996275 FORMAT "%13.10" EXTENDED_LIMITS -400.000000000 399.999999814 /end CHARACTERISTIC
/begin CHARACTERISTIC PCR_DKdPosLP_C "Grundwert der D-Verstaerkung des PIDT1-Reglers bei positiven Groszsignalen" VALUE 0xE86B8 Kw_Ws32 9.99999996275 Kd_Pres_hPa2Prc 0.00 9.99999996275 FORMAT "%13.10" EXTENDED_LIMITS -400.000000000 399.999999814 /end CHARACTERISTIC
/begin CHARACTERISTIC PCR_DKdNegLP_C "Grundwert der  D-Verstaerkung des PIDT1-Reglers bei negativen Groszsignalen" VALUE 0xE86BC Kw_Ws32 9.99999996275 Kd_Pres_hPa2Prc 0.00 9.99999996275 FORMAT "%13.10" EXTENDED_LIMITS -400.000000000 399.999999814 /end CHARACTERISTIC
/begin CHARACTERISTIC PCR_pDWinPosLP_C "obere Kleinsignalgrenze fuer das I-Glied des PIDT1-Reglers" VALUE 0xE86C0 Kw_Ws16 10000.00 Pres_hPa -5000.000 5000.000 FORMAT "%8.3" EXTENDED_LIMITS -32768.00 32767.00 /end CHARACTERISTIC
/begin CHARACTERISTIC PCR_pDWinNegLP_C "untere Kleinsignalgrenze fuer das DT1-Glied des PIDT1-Reglers" VALUE 0xE86C2 Kw_Ws16 10000.00 Pres_hPa -5000.000 5000.000 FORMAT "%8.3" EXTENDED_LIMITS -32768.00 32767.00 /end CHARACTERISTIC
/begin CHARACTERISTIC PCR_DT1_C "Verzögerungszeitkonstante für das DT1-Glied des PIDT1-Reglers" VALUE 0xE7D3C Kw_Wu32 4294.9663 TimeDelay_s 0.0010000001 4294.9673 FORMAT "%9.4" EXTENDED_LIMITS 0.0000010000000 4294.9673 /end CHARACTERISTIC
/begin CHARACTERISTIC PCR_DKd_C "Grundwert der D-Verstärkung des PIDT1-Reglers bei Kleinsignalen" VALUE 0xE7D40 Kw_Ws32 9.99999996275 Kd_Pres_hPa2Prc 0.00 9.99999996275 FORMAT "%13.10" EXTENDED_LIMITS -400.000000000 399.999999814 /end CHARACTERISTIC
/begin CHARACTERISTIC PCR_DKdPos_C "Grundwert der D-Verstärkung des PIDT1-Reglers bei positiven Großssignalen" VALUE 0xE7D44 Kw_Ws32 9.99999996275 Kd_Pres_hPa2Prc 0.00 9.99999996275 FORMAT "%13.10" EXTENDED_LIMITS -400.000000000 399.999999814 /end CHARACTERISTIC
/begin CHARACTERISTIC PCR_DKdNeg_C "Grundwert der D-Verstärkung des PIDT1-Reglers bei negativen Großsignalen" VALUE 0xE7D48 Kw_Ws32 9.99999996275 Kd_Pres_hPa2Prc 0.00 9.99999996275 FORMAT "%13.10" EXTENDED_LIMITS -400.000000000 399.999999814 /end CHARACTERISTIC
/begin CHARACTERISTIC PCR_pDWinPos_C "Obere Kleinsignalgrenze für das DT1-Glied des PIDT1-Reglers" VALUE 0xE7D4C Kw_Ws16 10000.00 Pres_hPa -5000.000 5000.000 FORMAT "%8.3" EXTENDED_LIMITS -32768.00 32767.00 /end CHARACTERISTIC
/begin CHARACTERISTIC PCR_pDWinNeg_C "Untere Kleinsignalgrenze für das DT1-Glied des PIDT1-Reglers" VALUE 0xE7D4E Kw_Ws16 10000.00 Pres_hPa -5000.000 5000.000 FORMAT "%8.3" EXTENDED_LIMITS -32768.00 32767.00 /end CHARACTERISTIC
/begin CHARACTERISTIC PCR_facAirPerTimeAmplMax_C "Obere Grenzwert für die Turboladerpumpgrenzerkennung" VALUE 0xEA1E2 Kw_Ws16 2047.938 FactM 0.00 2047.938 FORMAT "%8.3" EXTENDED_LIMITS -2048.000 2047.938 /end CHARACTERISTIC
/begin CHARACTERISTIC PCR_facAirPerTimeAmplMin_C "Untere Grenzwert für die Turboladerpumpgrenzerkennung" VALUE 0xEA1E4 Kw_Ws16 2047.938 FactM 0.00 2047.938 FORMAT "%8.3" EXTENDED_LIMITS -2048.000 2047.938 /end CHARACTERISTIC
/begin CHARACTERISTIC PCR_facATRgn_CUR "Kennlinie für lufttemperaturabhängigen Korrekturwert bei Regenerationsbetrieb" CURVE 0xE6FFC Kl_Xs16_Ws16 3.000000 Fact 0.00 3.000000 FORMAT "%8.6" EXTENDED_LIMITS -4.000000 3.999878
 /begin AXIS_DESCR STD_AXIS IATSCD_tAir Temp_Cels 6 -50.14000 199.8600 FORMAT "%8.4" EXTENDED_LIMITS -3549.940 3003.560 DEPOSIT ABSOLUTE /end AXIS_DESCR
/end CHARACTERISTIC
/begin CHARACTERISTIC PCR_facBPGovMaxCorr_CUR "Correction factor(MAX)of D-parameter according to engine speed and particle filter soot mass" CURVE 0xE7D50 Kl_Xs16_Ws16 5.000000 Fact1 0.00 5.000000 FORMAT "%8.6" EXTENDED_LIMITS -256.0000 255.9922
 /begin AXIS_DESCR STD_AXIS PFlt_mSot mSoot_g 8 0.00 300.0000 FORMAT "%8.4" EXTENDED_LIMITS -327.6800 327.6700 DEPOSIT ABSOLUTE /end AXIS_DESCR
/end CHARACTERISTIC
/begin CHARACTERISTIC PCR_facCnv_CUR "Kennlinie zur Amplitudenhöhe der oszillierenden Frischluftmasse beim Laderpumpen" CURVE 0xEA1E6 Kl_Xs16_Ws16 1.000000 FactM 0.00 1.000000 FORMAT "%8.6" EXTENDED_LIMITS -2048.000 2047.938
 /begin AXIS_DESCR STD_AXIS PCR_facAirPerTimeAmplFlt_mp FactM 10 -2048.000 2047.938 FORMAT "%8.3" DEPOSIT ABSOLUTE /end AXIS_DESCR
/end CHARACTERISTIC
/begin CHARACTERISTIC PCR_facCtQ_MAP "Kennfeld für Kühlwassertemperaturkorrekturfaktor de Sollwertberechnung" MAP 0xE7016 Kf_Xs16_Ys16_Ws16 7.999878 Fact -4.000000 3.999878 FORMAT "%8.6"
 /begin AXIS_DESCR STD_AXIS CTSCD_tClnt Temp_Cels 2 -50.1400 199.8600 FORMAT "%8.4" EXTENDED_LIMITS -3549.940 3003.560 DEPOSIT ABSOLUTE /end AXIS_DESCR
 /begin AXIS_DESCR STD_AXIS PCR_qDes InjMass 2 0.00 200.0000 FORMAT "%8.4" EXTENDED_LIMITS -327.6800 327.6700 DEPOSIT ABSOLUTE /end AXIS_DESCR
/end CHARACTERISTIC
/begin CHARACTERISTIC PCR_facDnCorr_CUR "Curve for Correction factor based on the engine-speed gradient" CURVE 0xE7D72 Kl_Xs16_Ws16 511.9922 Fact1 -256.0000 255.9922 FORMAT "%8.4"
 /begin AXIS_DESCR STD_AXIS PCR_dn_mp dn_dZ20 6 -6000.000 6000.000 FORMAT "%8.3" EXTENDED_LIMITS -327680.0 327670.0 DEPOSIT ABSOLUTE /end AXIS_DESCR
/end CHARACTERISTIC
/begin CHARACTERISTIC PCR_facDpCorr_CUR "Korrekturfaktor für D-Parameter Korrektur aus dem Ladedruckgradienten" CURVE 0xE7D8C Kl_Xs16_Ws16 511.9922 Fact1 -256.0000 255.9922 FORMAT "%8.4"
 /begin AXIS_DESCR STD_AXIS PCR_dpBGDev_mp dp_dZ20 10 -350000.0 350000.0 FORMAT "%8.1" EXTENDED_LIMITS -327680.0 327670.0 DEPOSIT ABSOLUTE /end AXIS_DESCR
/end CHARACTERISTIC
/begin CHARACTERISTIC PCR_facD_MAP "Kennfeld für Adaptionsfaktor der D-Verstärkung" MAP 0xE7DB6 Kf_Xs16_Ys16_Ws16 50.00000 Fact1 0.00 50.00000 FORMAT "%8.5" EXTENDED_LIMITS -256.0000 255.9922
 /begin AXIS_DESCR STD_AXIS Eng_nAvrg EngN 10 0.00 8000.000 FORMAT "%8.3" EXTENDED_LIMITS -32768.00 32767.00 DEPOSIT ABSOLUTE /end AXIS_DESCR
 /begin AXIS_DESCR STD_AXIS InjCtl_qCurr InjMassCyc 4 0.00 200.0000 FORMAT "%8.4" EXTENDED_LIMITS -327.6800 327.6700 DEPOSIT ABSOLUTE /end AXIS_DESCR
/end CHARACTERISTIC
/begin CHARACTERISTIC PCR_facIAT_CUR "Lufttemperaturabhängiger Faktor für Sollwertbildung" CURVE 0xE702A Kl_Xs16_Ws16 3.000000 Fact 0.00 3.000000 FORMAT "%8.6" EXTENDED_LIMITS -4.000000 3.999878
 /begin AXIS_DESCR STD_AXIS CTSCD_tClnt Temp_Cels 6 -50.14000 199.8600 FORMAT "%8.4" EXTENDED_LIMITS -3549.940 3003.560 DEPOSIT ABSOLUTE /end AXIS_DESCR
/end CHARACTERISTIC
/begin CHARACTERISTIC PCR_facI_MAP "Kennfeld für Adaptionsfaktor der I-Verstärkung" MAP 0xE7E26 Kf_Xs16_Ys16_Ws16 50.00000 Fact1 0.00 50.00000 FORMAT "%8.5" EXTENDED_LIMITS -256.0000 255.9922
 /begin AXIS_DESCR STD_AXIS Eng_nAvrg EngN 10 0.00 8000.000 FORMAT "%8.3" EXTENDED_LIMITS -32768.00 32767.00 DEPOSIT ABSOLUTE /end AXIS_DESCR
 /begin AXIS_DESCR STD_AXIS InjCtl_qCurr InjMassCyc 4 0.00 200.0000 FORMAT "%8.4" EXTENDED_LIMITS -327.6800 327.6700 DEPOSIT ABSOLUTE /end AXIS_DESCR
/end CHARACTERISTIC
/begin CHARACTERISTIC PCR_facmSotCorr_MAP "Correction factor of D-parameter  according to engine speed and particle filter soot mass" MAP 0xE7E96 Kf_Xs16_Ys16_Ws16 5.000000 Fact1 0.00 5.000000 FORMAT "%8.6" EXTENDED_LIMITS -256.0000 255.9922
 /begin AXIS_DESCR STD_AXIS Eng_nAvrg EngN 10 0.00 8000.000 FORMAT "%8.3" EXTENDED_LIMITS -32768.00 32767.00 DEPOSIT ABSOLUTE /end AXIS_DESCR
 /begin AXIS_DESCR STD_AXIS PFlt_mSot mSoot_g 8 0.00 300.0000 FORMAT "%8.4" EXTENDED_LIMITS -327.6800 327.6700 DEPOSIT ABSOLUTE /end AXIS_DESCR
/end CHARACTERISTIC
/begin CHARACTERISTIC PCR_facN_CUR "Gewichtungsfaktor über Drehzahl für Athmosphärendruckkorrektur" CURVE 0xE7044 Kl_Xs16_Ws16 1.000000 Fact 0.00 1.000000 FORMAT "%8.6" EXTENDED_LIMITS -4.000000 3.999878
 /begin AXIS_DESCR STD_AXIS Eng_nAvrg EngN 6 0.00 6000.000 FORMAT "%8.3" EXTENDED_LIMITS -32768.00 32767.00 DEPOSIT ABSOLUTE /end AXIS_DESCR
/end CHARACTERISTIC
/begin CHARACTERISTIC PCR_facPresPFltMax_CUR "Korrekturfaktor für maximal zulässige Stellgröße in Abhängigkeit des Staudrucks vor Partikelfilter" CURVE 0xE7F5E Kl_Xs16_Ws16 5.000000 Fact1 0.00 5.000000 FORMAT "%8.6" EXTENDED_LIMITS -256.0000 255.9922
 /begin AXIS_DESCR STD_AXIS PFlt_pPre Pres_hPa 8 0.00 3500.0000 FORMAT "%8.4" EXTENDED_LIMITS -32768.00 32767.00 DEPOSIT ABSOLUTE /end AXIS_DESCR
/end CHARACTERISTIC
/begin CHARACTERISTIC PCR_facPresPFltMin_CUR "Korrekturfaktor für minimal zulässige Stellgröße in Abhängigkeit des Staudrucks vor Partikelfilter" CURVE 0xE7F80 Kl_Xs16_Ws16 5.000000 Fact1 0.00 5.000000 FORMAT "%8.6" EXTENDED_LIMITS -256.0000 255.9922
 /begin AXIS_DESCR STD_AXIS PFlt_pPre Pres_hPa 8 0.00 3500.0000 FORMAT "%8.4" EXTENDED_LIMITS -32768.00 32767.00 DEPOSIT ABSOLUTE /end AXIS_DESCR
/end CHARACTERISTIC
/begin CHARACTERISTIC PCR_facP_MAP "Kennfeld für Adaptionsfaktor der P-Verstärkung" MAP 0xE7FA2 Kf_Xs16_Ys16_Ws16 50.00000 Fact1 0.00 50.00000 FORMAT "%8.5" EXTENDED_LIMITS -256.0000 255.9922
 /begin AXIS_DESCR STD_AXIS Eng_nAvrg EngN 10 0.00 8000.000 FORMAT "%8.3" EXTENDED_LIMITS -32768.00 32767.00 DEPOSIT ABSOLUTE /end AXIS_DESCR
 /begin AXIS_DESCR STD_AXIS InjCtl_qCurr InjMassCyc 4 0.00 200.0000 FORMAT "%8.4" EXTENDED_LIMITS -327.6800 327.6700 DEPOSIT ABSOLUTE /end AXIS_DESCR
/end CHARACTERISTIC
/begin CHARACTERISTIC PCR_facSin_CUR "Sinusfunktion als Kennlinie" CURVE 0xEA210 Kl_Xs16_Ws16 1.000000 Fact 0.00 1.000000 FORMAT "%8.6" EXTENDED_LIMITS -4.000000 3.999878 READ_ONLY
 /begin AXIS_DESCR STD_AXIS PCR_facSinIn_mp Fact1 11 -256.0000 255.9922 FORMAT "%8.4" DEPOSIT ABSOLUTE /end AXIS_DESCR
/end CHARACTERISTIC
/begin CHARACTERISTIC PCR_facSqr_CUR "Quadratwurzelfunktion als Kennlinie" CURVE 0xEA23E Kl_Xs16_Ws16 2047.938 FactM 0.00 2047.938 FORMAT "%8.3" EXTENDED_LIMITS -2048.000 2047.938 READ_ONLY
 /begin AXIS_DESCR STD_AXIS PCR_facSqrIn_mp FactM 19 0.00 2047.938 FORMAT "%8.3" EXTENDED_LIMITS -2048.000 2047.938 DEPOSIT ABSOLUTE /end AXIS_DESCR
/end CHARACTERISTIC
/begin CHARACTERISTIC PCR_facSurgeDes_CUR "Kennlinie für Sollwert Luftmassenschwingung" CURVE 0xE9FB8 Kl_Xs16_Ws16 4095.938 FactM -2048.000 2047.938 FORMAT "%8.3"
 /begin AXIS_DESCR STD_AXIS Eng_nAvrg EngN 6 0.00 6000.000 FORMAT "%8.3" EXTENDED_LIMITS -32768.00 32767.00 DEPOSIT ABSOLUTE /end AXIS_DESCR
/end CHARACTERISTIC
/begin CHARACTERISTIC PCR_facSurgeI_MAP "Kennfeld für Adaptionsfaktor der I-Verstärkung" MAP 0xE9FD2 Kf_Xs16_Ys16_Ws16 50.00000 Fact1 0.00 50.00000 FORMAT "%8.5" EXTENDED_LIMITS -256.0000 255.9922
 /begin AXIS_DESCR STD_AXIS Eng_nAvrg EngN 6 0.00 6000.000 FORMAT "%8.3" EXTENDED_LIMITS -32768.00 32767.00 DEPOSIT ABSOLUTE /end AXIS_DESCR
 /begin AXIS_DESCR STD_AXIS InjCtl_qCurr InjMassCyc 4 0.00 327.6700 FORMAT "%8.4" EXTENDED_LIMITS -327.6800 327.6700 DEPOSIT ABSOLUTE /end AXIS_DESCR
/end CHARACTERISTIC
/begin CHARACTERISTIC PCR_facSurgeP_MAP "Kennfeld für Adaptionsfaktor der P-Verstärkung" MAP 0xEA01A Kf_Xs16_Ys16_Ws16 50.00000 Fact1 0.00 50.00000 FORMAT "%8.5" EXTENDED_LIMITS -256.0000 255.9922
 /begin AXIS_DESCR STD_AXIS Eng_nAvrg EngN 6 0.00 6000.000 FORMAT "%8.3" EXTENDED_LIMITS -32768.00 32767.00 DEPOSIT ABSOLUTE /end AXIS_DESCR
 /begin AXIS_DESCR STD_AXIS InjCtl_qCurr InjMassCyc 4 0.00 327.6700 FORMAT "%8.4" EXTENDED_LIMITS -327.6800 327.6700 DEPOSIT ABSOLUTE /end AXIS_DESCR
/end CHARACTERISTIC
/begin CHARACTERISTIC PCR_IKiLP_C "Grundwert der I-Verstaerkung des PIDT1-Reglers bei Kleinsignalen" VALUE 0xE86C4 Kw_Wu32 12207.0312472 Ki_Pres_hPa2Prc 0.00 12207.0312472 FORMAT "%13.7" /end CHARACTERISTIC
/begin CHARACTERISTIC PCR_IKiPosLP_C "Grundwert der I-Verstaerkung des PIDT1-Reglers bei positiven Groszsignalen" VALUE 0xE86C8 Kw_Wu32 12207.0312472 Ki_Pres_hPa2Prc 0.00 12207.0312472 FORMAT "%13.7" /end CHARACTERISTIC
/begin CHARACTERISTIC PCR_IKiNegLP_C "Grundwert der I-Verstaerkung des PIDT1-Reglers bei negativen Groszsignalen" VALUE 0xE86CC Kw_Wu32 12207.0312472 Ki_Pres_hPa2Prc 0.00 12207.0312472 FORMAT "%13.7" /end CHARACTERISTIC
/begin CHARACTERISTIC PCR_pIWinPosLP_C "obere Kleinsignalgrenze fuer das I-Glied des PIDT1-Reglers" VALUE 0xE86D0 Kw_Ws16 65535.00 Pres_hPa -32768.00 32767.00 FORMAT "%8.2" /end CHARACTERISTIC
/begin CHARACTERISTIC PCR_pIWinNegLP_C "untere Kleinsignalgrenze fuer das I-Glied des PIDT1-Reglers" VALUE 0xE86D2 Kw_Ws16 65535.00 Pres_hPa -32768.00 32767.00 FORMAT "%8.2" /end CHARACTERISTIC
/begin CHARACTERISTIC PCR_ISurgeKi_C "Grundwert der I-Verstärkung des PI-Reglers bei Kleinsignalen" VALUE 0xEA064 Kw_Wu32 15999999.9963 Ki_Pres_fac2hPa 0.00 15999999.9963 FORMAT "%13.4" /end CHARACTERISTIC
/begin CHARACTERISTIC PCR_ISurgeKiPos_C "Grundwert der I-Verstärkung des PI-Reglers bei pos.Großsignalen" VALUE 0xEA068 Kw_Wu32 15999999.9963 Ki_Pres_fac2hPa 0.00 15999999.9963 FORMAT "%13.4" /end CHARACTERISTIC
/begin CHARACTERISTIC PCR_ISurgeKiNeg_C "Grundwert der I-Verstärkung des PI-Reglers bei neg.Großsignalen" VALUE 0xEA06C Kw_Wu32 15999999.9963 Ki_Pres_fac2hPa 0.00 15999999.9963 FORMAT "%13.4" /end CHARACTERISTIC
/begin CHARACTERISTIC PCR_facSurgeIWinPos_C "Obere Kleinsignalgrenze für das P-Glied des AntiSurge-Reglers" VALUE 0xEA070 Kw_Ws16 4095.938 FactM -2048.000 2047.938 FORMAT "%8.3" /end CHARACTERISTIC
/begin CHARACTERISTIC PCR_facSurgeIWinNeg_C "Untere Kleinsignalgrenze für das P-Glied des AntiSurge-Reglers" VALUE 0xEA072 Kw_Ws16 4095.938 FactM -2048.000 2047.938 FORMAT "%8.3" /end CHARACTERISTIC
/begin CHARACTERISTIC PCR_IKi_C "Grundwert der I-Verstärkung des PIDT1-Reglers bei Kleinsignalen" VALUE 0xE8014 Kw_Wu32 12207.0312472 Ki_Pres_hPa2Prc 0.00 12207.0312472 FORMAT "%13.7" /end CHARACTERISTIC
/begin CHARACTERISTIC PCR_IKiPos_C "Grundwert der I-Verstärkung des PIDT1-Reglers bei positiven Großsignalen" VALUE 0xE8018 Kw_Wu32 12207.0312472 Ki_Pres_hPa2Prc 0.00 12207.0312472 FORMAT "%13.7" /end CHARACTERISTIC
/begin CHARACTERISTIC PCR_IKiNeg_C "Grundwert der I-Verstärkung des PIDT1-Reglers bei negativen Großsignalen" VALUE 0xE801C Kw_Wu32 12207.0312472 Ki_Pres_hPa2Prc 0.00 12207.0312472 FORMAT "%13.7" /end CHARACTERISTIC
/begin CHARACTERISTIC PCR_pIWinPos_C "Obere Kleinsignalgrenze für das I-Glied des PIDT1-Reglers" VALUE 0xE8020 Kw_Ws16 65535.00 Pres_hPa -32768.00 32767.00 FORMAT "%8.2" /end CHARACTERISTIC
/begin CHARACTERISTIC PCR_pIWinNeg_C "Untere Kleinsignalgrenze für das I-Glied des PIDT1-Reglers" VALUE 0xE8022 Kw_Ws16 65535.00 Pres_hPa -32768.00 32767.00 FORMAT "%8.2" /end CHARACTERISTIC
/begin CHARACTERISTIC PCR_mskNoAdPCVVal_C "Maske zur Auswahl der Bedingungen, die zu einem Ignorieren der Lernwerte fuehren" VALUE 0xE8024 Kw_Wu16 65535.00 OneToOne 0.00 65535.00 FORMAT "%8.2" /end CHARACTERISTIC
/begin CHARACTERISTIC PCR_mskResetVal_C "Maske zur Auswahl der Bedingungen, die zu einem Reset der Lernwerte fuehren" VALUE 0xE8026 Kw_Wu16 65535.00 OneToOne 0.00 65535.00 FORMAT "%8.2" /end CHARACTERISTIC
/begin CHARACTERISTIC PCR_mskStopLearning_C "Maske zur Auswahl der Bedingungen, die zu einem Stop des Lernalgorithmus fuehren" VALUE 0xE8028 Kw_Wu16 65535.00 OneToOne 0.00 65535.00 FORMAT "%8.2" /end CHARACTERISTIC
/begin CHARACTERISTIC PCR_nAvrgAdPCV1_C "Wert der Drehzahl des ersten Referenz-Betriebspunktes" VALUE 0xE802A Kw_Ws16 6000.000 EngN 0.00 6000.000 FORMAT "%8.3" EXTENDED_LIMITS -32768.00 32767.00 /end CHARACTERISTIC
/begin CHARACTERISTIC PCR_nAvrgAdPCV2_C "Wert der Drehzahl des zweiten Referenz-Betriebspunktes" VALUE 0xE802C Kw_Ws16 6000.000 EngN 0.00 6000.000 FORMAT "%8.3" EXTENDED_LIMITS -32768.00 32767.00 /end CHARACTERISTIC
/begin CHARACTERISTIC PCR_nCoStart_C "#SSD untere Drehzahlgrenze für Kaltstarterkennung-Vorgabewert" VALUE 0xE9D8C Kw_Ws16 65535.00 EngN -32768.00 32767.00 FORMAT "%8.2" /end CHARACTERISTIC
/begin CHARACTERISTIC PCR_nCoStrtHigh_C "#SSD obere Drehzahlgrenze für Kaltstarterkennung-Vorgabewert" VALUE 0xE9D8E Kw_Ws16 5960.000 EngN 40.00000 6000.000 FORMAT "%8.3" EXTENDED_LIMITS -32768.00 32767.00 /end CHARACTERISTIC
/begin CHARACTERISTIC PCR_nLimMax_C "Upper threshold for engine speed." VALUE 0xE705E Kw_Ws16 6000.000 EngN 0.00 6000.000 FORMAT "%8.3" EXTENDED_LIMITS -32768.00 32767.00 /end CHARACTERISTIC
/begin CHARACTERISTIC PCR_nLimMin_C "Lower threshold for engine speed." VALUE 0xE7060 Kw_Ws16 6000.000 EngN 0.00 6000.000 FORMAT "%8.3" EXTENDED_LIMITS -32768.00 32767.00 /end CHARACTERISTIC
/begin CHARACTERISTIC PCR_nLPWrkSph2_C "obere Drehzahlgrenze des Arbeitsbereichs 2" VALUE 0xE9C64 Kw_Ws16 5960.000 EngN 40.00000 6000.000 FORMAT "%8.3" EXTENDED_LIMITS -32768.00 32767.00 /end CHARACTERISTIC
/begin CHARACTERISTIC PCR_nLPWrkSph3_C "obere Drehzahlgrenze des Arbeitsbereichs 3" VALUE 0xE9C66 Kw_Ws16 5960.000 EngN 40.00000 6000.000 FORMAT "%8.3" EXTENDED_LIMITS -32768.00 32767.00 /end CHARACTERISTIC
/begin CHARACTERISTIC PCR_nPCVMax_C "Maximale Drehzahl bei Verwendung des PCVs" VALUE 0xE802E Kw_Ws16 6000.000 EngN 0.00 6000.000 FORMAT "%8.3" EXTENDED_LIMITS -32768.00 32767.00 /end CHARACTERISTIC
/begin CHARACTERISTIC PCR_nPCVMin_C "Minimale Drehzahl bei Verwendung des PCVs" VALUE 0xE8030 Kw_Ws16 6000.000 EngN 0.00 6000.000 FORMAT "%8.3" EXTENDED_LIMITS -32768.00 32767.00 /end CHARACTERISTIC
/begin CHARACTERISTIC PCR_nWrkSph1_C "obere Drehzahlgrenze des Arbeitsbereiches 1" VALUE 0xE9D90 Kw_Ws16 8000.000 EngN 0.00 8000.000 FORMAT "%8.3" EXTENDED_LIMITS -32768.00 32767.00 /end CHARACTERISTIC
/begin CHARACTERISTIC PCR_nWrkSph2_C "Drehzahlgrenze zwischen den Arbeitsbereichen 2 und 3" VALUE 0xE9D92 Kw_Ws16 8000.000 EngN 0.00 8000.000 FORMAT "%8.3" EXTENDED_LIMITS -32768.00 32767.00 /end CHARACTERISTIC
/begin CHARACTERISTIC PCR_nWrkSph3_C "Drehzahlgrenze zwischen den Arbeitsbereichen 3 und 4" VALUE 0xE9D94 Kw_Ws16 8000.000 EngN 0.00 8000.000 FORMAT "%8.3" EXTENDED_LIMITS -32768.00 32767.00 /end CHARACTERISTIC
/begin CHARACTERISTIC PCR_pAPQCmpnRgn_MAP "Kennfeld für atmosphärendruckabhängigen Korrekturwert bei Regenerationsbetrieb" MAP 0xE7062 Kf_Xs16_Ys16_Ws16 4400.000 Pres_hPa -400.0000 4000.000 FORMAT "%8.3" EXTENDED_LIMITS -32768.00 32767.00
 /begin AXIS_DESCR STD_AXIS APSCD_pVal Pres_hPa 6 0.00 4000.000 FORMAT "%8.3" EXTENDED_LIMITS -32768.00 32767.00 DEPOSIT ABSOLUTE /end AXIS_DESCR
 /begin AXIS_DESCR STD_AXIS PCR_qDes InjMass 6 0.00 200.0000 FORMAT "%8.4" EXTENDED_LIMITS -327.6800 327.6700 DEPOSIT ABSOLUTE /end AXIS_DESCR
/end CHARACTERISTIC
/begin CHARACTERISTIC PCR_pAPQCmpn_MAP "Kennfeld für atmosphärendruckabhängige Kompensation für Sollwertberechnung" MAP 0xE70C6 Kf_Xs16_Ys16_Ws16 8000.000 Pres_hPa -4000.000 4000.000 FORMAT "%8.3" EXTENDED_LIMITS -32768.00 32767.00
 /begin AXIS_DESCR STD_AXIS APSCD_pVal Pres_hPa 6 0.00 4000.000 FORMAT "%8.3" EXTENDED_LIMITS -32768.00 32767.00 DEPOSIT ABSOLUTE /end AXIS_DESCR
 /begin AXIS_DESCR STD_AXIS PCR_qDes InjMass 6 0.00 200.0000 FORMAT "%8.4" EXTENDED_LIMITS -327.6800 327.6700 DEPOSIT ABSOLUTE /end AXIS_DESCR
/end CHARACTERISTIC
/begin CHARACTERISTIC PCR_pBDesBasFDC_MAP "base desired boost pressure map for sport mode" MAP 0xE712A Kf_Xs16_Ys16_Ws16 4000.000 Pres_hPa 0.00 4000.000 FORMAT "%8.3" EXTENDED_LIMITS -32768.00 32767.00
 /begin AXIS_DESCR STD_AXIS Eng_nAvrg EngN 16 0.00 8000.000 FORMAT "%8.3" EXTENDED_LIMITS -32768.00 32767.00 DEPOSIT ABSOLUTE /end AXIS_DESCR
 /begin AXIS_DESCR STD_AXIS PCR_qDes InjMass 16 0.00 200.0000 FORMAT "%8.4" EXTENDED_LIMITS -327.6800 327.6700 DEPOSIT ABSOLUTE /end AXIS_DESCR
/end CHARACTERISTIC
/begin CHARACTERISTIC PCR_pBDesBasRgn1_MAP "Erstes Regenerationskennfeld zur Ermittlung des Ladedruckbasissollwerts" MAP 0xE736E Kf_Xs16_Ys16_Ws16 4000.000 Pres_hPa 0.00 4000.000 FORMAT "%8.3" EXTENDED_LIMITS -32768.00 32767.00
 /begin AXIS_DESCR STD_AXIS Eng_nAvrg EngN 16 0.00 8000.000 FORMAT "%8.3" EXTENDED_LIMITS -32768.00 32767.00 DEPOSIT ABSOLUTE /end AXIS_DESCR
 /begin AXIS_DESCR STD_AXIS PCR_qDes InjMass 16 0.00 200.0000 FORMAT "%8.4" EXTENDED_LIMITS -327.6800 327.6700 DEPOSIT ABSOLUTE /end AXIS_DESCR
/end CHARACTERISTIC
/begin CHARACTERISTIC PCR_pBDesBasRgn2_MAP "Zweites Regenerationskennfeld zur Ermittlung des Ladedruckbasissollwerts" MAP 0xE75B2 Kf_Xs16_Ys16_Ws16 4000.000 Pres_hPa 0.00 4000.000 FORMAT "%8.3" EXTENDED_LIMITS -32768.00 32767.00
 /begin AXIS_DESCR STD_AXIS Eng_nAvrg EngN 16 0.00 8000.000 FORMAT "%8.3" EXTENDED_LIMITS -32768.00 32767.00 DEPOSIT ABSOLUTE /end AXIS_DESCR
 /begin AXIS_DESCR STD_AXIS PCR_qDes InjMass 16 0.00 200.0000 FORMAT "%8.4" EXTENDED_LIMITS -327.6800 327.6700 DEPOSIT ABSOLUTE /end AXIS_DESCR
/end CHARACTERISTIC
/begin CHARACTERISTIC PCR_pBDesLPRgn1_MAP "Kennfeld zum Ladedrucksollwert bei niedrigem Druck in regenaration1" MAP 0xE86D4 Kf_Xs16_Ys16_Ws16 4000.000 Pres_hPa 0.00 4000.000 FORMAT "%8.3" EXTENDED_LIMITS -32768.00 32767.00
 /begin AXIS_DESCR STD_AXIS Eng_nAvrg EngN 16 0.00 8000.000 FORMAT "%8.3" EXTENDED_LIMITS -32768.00 32767.00 DEPOSIT ABSOLUTE /end AXIS_DESCR
 /begin AXIS_DESCR STD_AXIS PCR_qDes InjMass 16 0.00 200.0000 FORMAT "%8.4" EXTENDED_LIMITS -327.6800 327.6700 DEPOSIT ABSOLUTE /end AXIS_DESCR
/end CHARACTERISTIC
/begin CHARACTERISTIC PCR_pBDesLPRgn2_MAP "Kennfeld zum Ladedrucksollwert bei niedrigem Druck in Regeneration 2" MAP 0xE8918 Kf_Xs16_Ys16_Ws16 4000.000 Pres_hPa 0.00 4000.000 FORMAT "%8.3" EXTENDED_LIMITS -32768.00 32767.00
 /begin AXIS_DESCR STD_AXIS Eng_nAvrg EngN 16 0.00 8000.000 FORMAT "%8.3" EXTENDED_LIMITS -32768.00 32767.00 DEPOSIT ABSOLUTE /end AXIS_DESCR
 /begin AXIS_DESCR STD_AXIS PCR_qDes InjMass 16 0.00 200.0000 FORMAT "%8.4" EXTENDED_LIMITS -327.6800 327.6700 DEPOSIT ABSOLUTE /end AXIS_DESCR
/end CHARACTERISTIC
/begin CHARACTERISTIC PCR_pBDesLP_MAP " KF Ladedruck-Sollwert bei Kompressorbypass offen" MAP 0xE8B5C Kf_Xs16_Ys16_Ws16 4000.000 Pres_hPa 0.00 4000.000 FORMAT "%8.3" EXTENDED_LIMITS -32768.00 32767.00
 /begin AXIS_DESCR STD_AXIS Eng_nAvrg EngN 16 0.00 8000.000 FORMAT "%8.3" EXTENDED_LIMITS -32768.00 32767.00 DEPOSIT ABSOLUTE /end AXIS_DESCR
 /begin AXIS_DESCR STD_AXIS PCR_qDes InjMass 16 0.00 200.0000 FORMAT "%8.4" EXTENDED_LIMITS -327.6800 327.6700 DEPOSIT ABSOLUTE /end AXIS_DESCR
/end CHARACTERISTIC
/begin CHARACTERISTIC PCR_pBDesMaxAPLP_MAP "KF max Ladedruck bei Kompressorbypass offen" MAP 0xE8DA0 Kf_Xs16_Ys16_Ws16 4000.000 Pres_hPa 0.00 4000.000 FORMAT "%8.3" EXTENDED_LIMITS -32768.00 32767.00
 /begin AXIS_DESCR STD_AXIS Eng_nAvrg EngN 10 0.00 8000.000 FORMAT "%8.3" EXTENDED_LIMITS -32768.00 32767.00 DEPOSIT ABSOLUTE /end AXIS_DESCR
 /begin AXIS_DESCR STD_AXIS APSCD_pVal Pres_hPa 10 0.00 4000.000 FORMAT "%8.3" EXTENDED_LIMITS -32768.00 32767.00 DEPOSIT ABSOLUTE /end AXIS_DESCR
/end CHARACTERISTIC
/begin CHARACTERISTIC PCR_pBGDevAdPCVLim_C "Maximale Grenze fuer die Regler-Abweichung" VALUE 0xE8032 Kw_Ws16 65535.00 Pres_hPa -32768.00 32767.00 FORMAT "%8.2" /end CHARACTERISTIC
/begin CHARACTERISTIC PCR_pBGDevMaxOffset_C "#SSD Max. Regelabweichung PCR - Offset während DSC-Eingriff (eingefrorener Leadpfad)" VALUE 0xE9D96 Kw_Ws16 65535.00 Pres_hPa -32768.00 32767.00 FORMAT "%8.2" /end CHARACTERISTIC
/begin CHARACTERISTIC PCR_pBGDevMax_MAP "Kennfeld der Obergrenze für Erkennung einer bleibenden Regelabweichung" MAP 0xE9D98 Kf_Xs16_Ys16_Ws16 4000.000 Pres_hPa 0.00 4000.000 FORMAT "%8.3" EXTENDED_LIMITS -32768.00 32767.00
 /begin AXIS_DESCR STD_AXIS Eng_nAvrg EngN 4 0.00 6000.000 FORMAT "%8.3" EXTENDED_LIMITS -32768.00 32767.00 DEPOSIT ABSOLUTE /end AXIS_DESCR
 /begin AXIS_DESCR STD_AXIS InjCtl_qCurr InjMassCyc 4 0.00 327.6700 FORMAT "%8.4" EXTENDED_LIMITS -327.6800 327.6700 DEPOSIT ABSOLUTE /end AXIS_DESCR
/end CHARACTERISTIC
/begin CHARACTERISTIC PCR_pBGDevMinOffset_C "#SSD neg. Regelabweichung PCR - Offset während DSC-Eingriff (eingefrorener Leadpfad)" VALUE 0xE9DCC Kw_Ws16 65535.00 Pres_hPa -32768.00 32767.00 FORMAT "%8.2" /end CHARACTERISTIC
/begin CHARACTERISTIC PCR_pBGDevMin_MAP "Untergrenze für Erkennung einer bleibenden Regelabweichung" MAP 0xE9DCE Kf_Xs16_Ys16_Ws16 4300.000 Pres_hPa -300.0000 4000.000 FORMAT "%8.3" EXTENDED_LIMITS -32768.00 32767.00
 /begin AXIS_DESCR STD_AXIS Eng_nAvrg EngN 4 0.00 6000.000 FORMAT "%8.3" EXTENDED_LIMITS -32768.00 32767.00 DEPOSIT ABSOLUTE /end AXIS_DESCR
 /begin AXIS_DESCR STD_AXIS InjCtl_qCurr InjMassCyc 4 0.00 327.6700 FORMAT "%8.4" EXTENDED_LIMITS -327.6800 327.6700 DEPOSIT ABSOLUTE /end AXIS_DESCR
/end CHARACTERISTIC
/begin CHARACTERISTIC PCR_pBSurgeDesMax_MAP "Kennfeld zur Bestimmung der max. zulässigen Stellgröße" MAP 0xEA074 Kf_Xs16_Ys16_Ws16 65535.00 Pres_hPa -32768.00 32767.00 FORMAT "%8.2"
 /begin AXIS_DESCR STD_AXIS Eng_nAvrg EngN 5 0.00 6000.000 FORMAT "%8.3" EXTENDED_LIMITS -32768.00 32767.00 DEPOSIT ABSOLUTE /end AXIS_DESCR
 /begin AXIS_DESCR STD_AXIS InjCtl_qCurr InjMassCyc 5 0.00 327.6700 FORMAT "%8.4" EXTENDED_LIMITS -327.6800 327.6700 DEPOSIT ABSOLUTE /end AXIS_DESCR
/end CHARACTERISTIC
/begin CHARACTERISTIC PCR_pBSurgeDesMin_MAP "Kennfeld zur Bestimmung der min. zulässigen Stellgröße" MAP 0xEA0BE Kf_Xs16_Ys16_Ws16 65535.00 Pres_hPa -32768.00 32767.00 FORMAT "%8.2"
 /begin AXIS_DESCR STD_AXIS Eng_nAvrg EngN 5 0.00 6000.000 FORMAT "%8.3" EXTENDED_LIMITS -32768.00 32767.00 DEPOSIT ABSOLUTE /end AXIS_DESCR
 /begin AXIS_DESCR STD_AXIS InjCtl_qCurr InjMassCyc 5 0.00 327.6700 FORMAT "%8.4" EXTENDED_LIMITS -327.6800 327.6700 DEPOSIT ABSOLUTE /end AXIS_DESCR
/end CHARACTERISTIC
/begin CHARACTERISTIC PCR_pBSurgeDes_CUR "Kennlinie für Sollwert Ladedruck zur Reduktion Laderpumpen" CURVE 0xEA108 Kl_Xs16_Ws16 65535.00 Pres_hPa -32768.00 32767.00 FORMAT "%8.2"
 /begin AXIS_DESCR STD_AXIS PCR_pBSurgePICtlLim_mp Pres_hPa 2 -32768.00 32767.00 FORMAT "%8.2" DEPOSIT ABSOLUTE /end AXIS_DESCR
/end CHARACTERISTIC
/begin CHARACTERISTIC PCR_pDesAdd_Vector "#SSD Bypass-Label für additiven Bypass von PCR_pBDes (Nicht verstellen!)" VALUE 0xC318C Kw_Wu8 255.0 OneToOne 0.00 255.0 FORMAT "%5.1" /end CHARACTERISTIC
/begin CHARACTERISTIC PCR_pDesAdd_Channel "#SSD Bypass-Label für additiven Bypass von PCR_pBDes (Nicht verstellen!)" VALUE 0xC318D Kw_Wu8 255.0 OneToOne 0.00 255.0 FORMAT "%5.1" /end CHARACTERISTIC
/begin CHARACTERISTIC PCR_pDesBas_MAP "Kennfeld für die Grundwertbestimmung des Ladedruckbasissollwerts" MAP 0xE77F6 Kf_Xs16_Ys16_Ws16 4000.000 Pres_hPa 0.00 4000.000 FORMAT "%8.3" EXTENDED_LIMITS -32768.00 32767.00
 /begin AXIS_DESCR STD_AXIS Eng_nAvrg EngN 16 0.00 8000.000 FORMAT "%8.3" EXTENDED_LIMITS -32768.00 32767.00 DEPOSIT ABSOLUTE /end AXIS_DESCR
 /begin AXIS_DESCR STD_AXIS PCR_qDes InjMass 16 0.00 200.0000 FORMAT "%8.4" EXTENDED_LIMITS -327.6800 327.6700 DEPOSIT ABSOLUTE /end AXIS_DESCR
/end CHARACTERISTIC
/begin CHARACTERISTIC PCR_pDesMaxAP_MAP "Größter erlaubter Ladedrucksollwert in Abhängigkeit vom Luftdruck" MAP 0xE7A3A Kf_Xs16_Ys16_Ws16 4000.000 Pres_hPa 0.00 4000.000 FORMAT "%8.3" EXTENDED_LIMITS -32768.00 32767.00
 /begin AXIS_DESCR STD_AXIS Eng_nAvrg EngN 16 0.00 8000.000 FORMAT "%8.3" EXTENDED_LIMITS -32768.00 32767.00 DEPOSIT ABSOLUTE /end AXIS_DESCR
 /begin AXIS_DESCR STD_AXIS APSCD_pVal Pres_hPa 16 0.00 4000.000 FORMAT "%8.3" EXTENDED_LIMITS -32768.00 32767.00 DEPOSIT ABSOLUTE /end AXIS_DESCR
/end CHARACTERISTIC
/begin CHARACTERISTIC PCR_pDesMax_C "Größter erlaubter Ladedrucksollwert" VALUE 0xE7C7E Kw_Ws16 4000.000 Pres_hPa 0.00 4000.000 FORMAT "%8.3" EXTENDED_LIMITS -32768.00 32767.00 /end CHARACTERISTIC
/begin CHARACTERISTIC PCR_pDesMin_C "Kleinster erlaubter Ladedrucksollwert" VALUE 0xE7C80 Kw_Ws16 4000.000 Pres_hPa 0.00 4000.000 FORMAT "%8.3" EXTENDED_LIMITS -32768.00 32767.00 /end CHARACTERISTIC
/begin CHARACTERISTIC PCR_pDes_Vector "#SSD Bypass-Label für PCR_pBDes (Nicht verstellen!)" VALUE 0xC318E Kw_Wu8 255.0 OneToOne 0.00 255.0 FORMAT "%5.1" /end CHARACTERISTIC
/begin CHARACTERISTIC PCR_pDes_Channel "#SSD Bypass-Label für PCR_pBDes (Nicht verstellen!)" VALUE 0xC318F Kw_Wu8 255.0 OneToOne 0.00 255.0 FORMAT "%5.1" /end CHARACTERISTIC
/begin CHARACTERISTIC PCR_pDvtSurgeCtlRel_C "Max. Limit für Stellerabweichung bei Erkennung gleicher Status" VALUE 0xEA112 Kw_Ws16 65535.00 Pres_hPa -32768.00 32767.00 FORMAT "%8.2" /end CHARACTERISTIC
/begin CHARACTERISTIC PCR_pFltValLim_C "Maximale Grenze fuer Ladedruck" VALUE 0xE8034 Kw_Ws16 65535.00 Pres_hPa -32768.00 32767.00 FORMAT "%8.2" /end CHARACTERISTIC
/begin CHARACTERISTIC PCR_pLPDvtMaxOffset_C "Offset für Obergrenze für Erkennung einer bleibenden Regelabweichung" VALUE 0xE9C68 Kw_Ws16 65535.00 Pres_hPa -32768.00 32767.00 FORMAT "%8.2" /end CHARACTERISTIC
/begin CHARACTERISTIC PCR_pLPDvtMax_MAP "Obergrenze für Erkennung einer bleibenden Regelabweichung" MAP 0xE9C6A Kf_Xs16_Ys16_Ws16 4000.000 Pres_hPa 0.00 4000.000 FORMAT "%8.3" EXTENDED_LIMITS -32768.00 32767.00
 /begin AXIS_DESCR STD_AXIS Eng_nAvrg EngN 4 0.00 6000.000 FORMAT "%8.3" EXTENDED_LIMITS -32768.00 32767.00 DEPOSIT ABSOLUTE /end AXIS_DESCR
 /begin AXIS_DESCR STD_AXIS InjCtl_qCurr InjMassCyc 4 0.00 327.6700 FORMAT "%8.4" EXTENDED_LIMITS -327.6800 327.6700 DEPOSIT ABSOLUTE /end AXIS_DESCR
/end CHARACTERISTIC
/begin CHARACTERISTIC PCR_pLPDvtMinOffset_C "Offset für Untergrenze für Erkennung einer bleibenden Regelabweichung" VALUE 0xE9C9E Kw_Ws16 65535.00 Pres_hPa -32768.00 32767.00 FORMAT "%8.2" /end CHARACTERISTIC
/begin CHARACTERISTIC PCR_pLPDvtMin_MAP "Untergrenze für Erkennung einer bleibenden Regelabweichung Niederdruckstufe" MAP 0xE9CA0 Kf_Xs16_Ys16_Ws16 4300.000 Pres_hPa -300.0000 4000.000 FORMAT "%8.3" EXTENDED_LIMITS -32768.00 32767.00
 /begin AXIS_DESCR STD_AXIS Eng_nAvrg EngN 4 0.00 6000.000 FORMAT "%8.3" EXTENDED_LIMITS -32768.00 32767.00 DEPOSIT ABSOLUTE /end AXIS_DESCR
 /begin AXIS_DESCR STD_AXIS InjCtl_qCurr InjMassCyc 4 0.00 327.6700 FORMAT "%8.4" EXTENDED_LIMITS -327.6800 327.6700 DEPOSIT ABSOLUTE /end AXIS_DESCR
/end CHARACTERISTIC
/begin CHARACTERISTIC PCR_PKpLP_C "Grundwert der P-Verstaerkung des PIDT1-Reglers bei Kleinsignalen" VALUE 0xE8E94 Kw_Wu32 799.999999814 Kp_Pres_hPa2Prc 0.00 799.999999814 FORMAT "%13.9" /end CHARACTERISTIC
/begin CHARACTERISTIC PCR_PKpPosLP_C "Grundwert der P-Verstaerkung des PIDT1-Reglers bei positiven Groszsignalen" VALUE 0xE8E98 Kw_Wu32 799.999999814 Kp_Pres_hPa2Prc 0.00 799.999999814 FORMAT "%13.9" /end CHARACTERISTIC
/begin CHARACTERISTIC PCR_PKpNegLP_C "Grundwert der P-Verstaerkung des PIDT1-Reglers bei negativen Groszsignalen" VALUE 0xE8E9C Kw_Wu32 799.999999814 Kp_Pres_hPa2Prc 0.00 799.999999814 FORMAT "%13.9" /end CHARACTERISTIC
/begin CHARACTERISTIC PCR_pPWinPosLP_C "obere Kleinsignalgrenze fuer das P-Glied des PIDT1-Reglers" VALUE 0xE8EA0 Kw_Ws16 65535.00 Pres_hPa -32768.00 32767.00 FORMAT "%8.2" /end CHARACTERISTIC
/begin CHARACTERISTIC PCR_pPWinNegLP_C "untere Kleinsignalgrenze fuer das P-Glied des PIDT1-Reglers" VALUE 0xE8EA2 Kw_Ws16 65535.00 Pres_hPa -32768.00 32767.00 FORMAT "%8.2" /end CHARACTERISTIC
/begin CHARACTERISTIC PCR_pNQCtCmpn_MAP "Kennfeld für Kühlwassertemperaturkorrekturwert für Sollwertberechnung" MAP 0xE7C82 Kf_Xs16_Ys16_Ws16 4000.000 Pres_hPa 0.00 4000.000 FORMAT "%8.3" EXTENDED_LIMITS -32768.00 32767.00
 /begin AXIS_DESCR STD_AXIS Eng_nAvrg EngN 2 0.00 8000.000 FORMAT "%8.3" EXTENDED_LIMITS -32768.00 32767.00 DEPOSIT ABSOLUTE /end AXIS_DESCR
 /begin AXIS_DESCR STD_AXIS PCR_qDes InjMass 2 0.00 200.0000 FORMAT "%8.4" EXTENDED_LIMITS -327.6800 327.6700 DEPOSIT ABSOLUTE /end AXIS_DESCR
/end CHARACTERISTIC
/begin CHARACTERISTIC PCR_pSurgeARWIMin_C "minimal zulässige ARW ant-surge regler" VALUE 0xEA114 Kw_Ws16 7000.000 Pres_hPa -3500.000 3500.000 FORMAT "%8.3" EXTENDED_LIMITS -32768.00 32767.00 /end CHARACTERISTIC
/begin CHARACTERISTIC PCR_PSurgeKp_C "Grundwert der P-Verstärkung des PI-Reglers bei Kleinsigna-len" VALUE 0xEA118 Kw_Wu32 1048575.99976 Kp_Pres_fac2hPa 0.00 1048575.99976 FORMAT "%13.5" /end CHARACTERISTIC
/begin CHARACTERISTIC PCR_PSurgeKpPos_C "Grundwert der P-Verstärkung des PI-Reglers bei pos.Großsignalen" VALUE 0xEA11C Kw_Wu32 1048575.99976 Kp_Pres_fac2hPa 0.00 1048575.99976 FORMAT "%13.5" /end CHARACTERISTIC
/begin CHARACTERISTIC PCR_PSurgeKpNeg_C "Grundwert der P-Verstärkung des PI-Reglers bei neg.Großsignalen" VALUE 0xEA120 Kw_Wu32 1048575.99976 Kp_Pres_fac2hPa 0.00 1048575.99976 FORMAT "%13.5" /end CHARACTERISTIC
/begin CHARACTERISTIC PCR_facSurgePWinPos_C "Obere Kleinsignalgrenze für das P-Glied des AntiSurge-Reglers" VALUE 0xEA124 Kw_Ws16 4095.938 FactM -2048.000 2047.938 FORMAT "%8.3" /end CHARACTERISTIC
/begin CHARACTERISTIC PCR_facSurgePWinNeg_C "Untere Kleinsignalgrenze für das P-Glied des AntiSurge-Reglers" VALUE 0xEA126 Kw_Ws16 4095.938 FactM -2048.000 2047.938 FORMAT "%8.3" /end CHARACTERISTIC
/begin CHARACTERISTIC PCR_pValAdPCVMax_C "Maximale Grenze für Luftdruck" VALUE 0xE8036 Kw_Ws16 65535.00 Pres_hPa -32768.00 32767.00 FORMAT "%8.2" /end CHARACTERISTIC
/begin CHARACTERISTIC PCR_pValAdPCVMin_C "Minimale Grenze fuer Luftdruck" VALUE 0xE8038 Kw_Ws16 65535.00 Pres_hPa -32768.00 32767.00 FORMAT "%8.2" /end CHARACTERISTIC
/begin CHARACTERISTIC PCR_PKp_C "Grundwert der P-Verstärkung des PIDT1-Reglers bei Kleinsignalen" VALUE 0xE803C Kw_Wu32 799.999999814 Kp_Pres_hPa2Prc 0.00 799.999999814 FORMAT "%13.9" /end CHARACTERISTIC
/begin CHARACTERISTIC PCR_PKpPos_C "Grundwert der P-Verstärkung des PIDT1-Reglers bei positiven Großsignalen" VALUE 0xE8040 Kw_Wu32 799.999999814 Kp_Pres_hPa2Prc 0.00 799.999999814 FORMAT "%13.9" /end CHARACTERISTIC
/begin CHARACTERISTIC PCR_PKpNeg_C "Grundwert der P-Verstärkung des PIDT1-Reglers bei negativen Großsignalen" VALUE 0xE8044 Kw_Wu32 799.999999814 Kp_Pres_hPa2Prc 0.00 799.999999814 FORMAT "%13.9" /end CHARACTERISTIC
/begin CHARACTERISTIC PCR_pPWinPos_C "Obere Kleinsignalgrenze für das P-Glied des PIDT1-Reglers" VALUE 0xE8048 Kw_Ws16 65535.00 Pres_hPa -32768.00 32767.00 FORMAT "%8.2" /end CHARACTERISTIC
/begin CHARACTERISTIC PCR_pPWinNeg_C "Untere Kleinsignalgrenze für das P-Glied des PIDT1-Reglers" VALUE 0xE804A Kw_Ws16 65535.00 Pres_hPa -32768.00 32767.00 FORMAT "%8.2" /end CHARACTERISTIC
/begin CHARACTERISTIC PCR_qClutchThres_C "Mengenschwellwert für Kupplungserkennung" VALUE 0xE9E02 Kw_Ws16 200.0000 InjMass 0.00 200.0000 FORMAT "%8.4" EXTENDED_LIMITS -327.6800 327.6700 /end CHARACTERISTIC
/begin CHARACTERISTIC PCR_qClutchThres_CUR "Drehzahlabhängige Mengenschwelle zur Kupplungserkennung" CURVE 0xE9E04 Kl_Xs16_Ws16 327.6700 InjMassCyc 0.00 327.6700 FORMAT "%8.4" EXTENDED_LIMITS -327.6800 327.6700
 /begin AXIS_DESCR STD_AXIS Eng_nAvrg EngN 4 40.00000 6000.000 FORMAT "%8.3" EXTENDED_LIMITS -32768.00 32767.00 DEPOSIT ABSOLUTE /end AXIS_DESCR
/end CHARACTERISTIC
/begin CHARACTERISTIC PCR_qCtlAdPCV1_C "Wert der Einspritzmenge des ersten Referenz-Betriebspunktes" VALUE 0xE804C Kw_Ws16 327.6700 InjMassCyc 0.00 327.6700 FORMAT "%8.4" EXTENDED_LIMITS -327.6800 327.6700 /end CHARACTERISTIC
/begin CHARACTERISTIC PCR_qCtlAdPCV2_C "Wert der Einspritzmenge des zweiten Referenz-Betriebspunktes" VALUE 0xE804E Kw_Ws16 327.6700 InjMassCyc 0.00 327.6700 FORMAT "%8.4" EXTENDED_LIMITS -327.6800 327.6700 /end CHARACTERISTIC
/begin CHARACTERISTIC PCR_qLPClutchThres_CUR "Drehzahlabhängige Mengenschwelle zur Kupplungserkennung(Niederdruckstufe)" CURVE 0xE9CD4 Kl_Xs16_Ws16 327.6700 InjMassCyc 0.00 327.6700 FORMAT "%8.4" EXTENDED_LIMITS -327.6800 327.6700
 /begin AXIS_DESCR STD_AXIS Eng_nAvrg EngN 4 40.00000 6000.000 FORMAT "%8.3" EXTENDED_LIMITS -32768.00 32767.00 DEPOSIT ABSOLUTE /end AXIS_DESCR
/end CHARACTERISTIC
/begin CHARACTERISTIC PCR_qLPGvnrOffRgn_CUR "Mengenkennlinie für Reglerabschaltschwelle in Abhängigkeit von der Drehzahl bei Regenerationsbetrieb(Niederdruckstufe)" CURVE 0xE9CE6 Kl_Xs16_Ws16 200.0000 InjMass 0.00 200.0000 FORMAT "%8.4" EXTENDED_LIMITS -327.6800 327.6700
 /begin AXIS_DESCR STD_AXIS Eng_nAvrg EngN 8 0.00 8000.000 FORMAT "%8.3" EXTENDED_LIMITS -32768.00 32767.00 DEPOSIT ABSOLUTE /end AXIS_DESCR
/end CHARACTERISTIC
/begin CHARACTERISTIC PCR_qLPGvnrOff_CUR "Einspritzmengenkennlinie für Abschaltschwelle im Normalmodus(Niederdruckstufe)" CURVE 0xE9D08 Kl_Xs16_Ws16 200.0000 InjMass 0.00 200.0000 FORMAT "%8.4" EXTENDED_LIMITS -327.6800 327.6700
 /begin AXIS_DESCR STD_AXIS Eng_nAvrg EngN 8 0.00 8000.000 FORMAT "%8.3" EXTENDED_LIMITS -32768.00 32767.00 DEPOSIT ABSOLUTE /end AXIS_DESCR
/end CHARACTERISTIC
/begin CHARACTERISTIC PCR_qLPGvnrOnRgn_CUR "Mengenkennlinie für Reglereinschaltschwelle in Abhängigkeit von der Drehzahl bei Regenerationsbetrieb(Niederdruckstufe)" CURVE 0xE9D2A Kl_Xs16_Ws16 200.0000 InjMass 0.00 200.0000 FORMAT "%8.4" EXTENDED_LIMITS -327.6800 327.6700
 /begin AXIS_DESCR STD_AXIS Eng_nAvrg EngN 8 0.00 8000.000 FORMAT "%8.3" EXTENDED_LIMITS -32768.00 32767.00 DEPOSIT ABSOLUTE /end AXIS_DESCR
/end CHARACTERISTIC
/begin CHARACTERISTIC PCR_qLPGvnrOn_CUR "Einspritzmengenkennlinie für Einschaltschwelle im Normalmodus(Niederdruckstufe)" CURVE 0xE9D4C Kl_Xs16_Ws16 200.0000 InjMass 0.00 200.0000 FORMAT "%8.4" EXTENDED_LIMITS -327.6800 327.6700
 /begin AXIS_DESCR STD_AXIS Eng_nAvrg EngN 8 0.00 8000.000 FORMAT "%8.3" EXTENDED_LIMITS -32768.00 32767.00 DEPOSIT ABSOLUTE /end AXIS_DESCR
/end CHARACTERISTIC
/begin CHARACTERISTIC PCR_qLPWrkSph2_C "obere Mengengrenze des Arbeitsbereichs 2" VALUE 0xE9D6E Kw_Ws16 200.0000 InjMass 0.00 200.0000 FORMAT "%8.4" EXTENDED_LIMITS -327.6800 327.6700 /end CHARACTERISTIC
/begin CHARACTERISTIC PCR_qLPWrkSph3_C "obere Mengengrenze des Arbeitsbereichs 3" VALUE 0xE9D70 Kw_Ws16 200.0000 InjMass 0.00 200.0000 FORMAT "%8.4" EXTENDED_LIMITS -327.6800 327.6700 /end CHARACTERISTIC
/begin CHARACTERISTIC PCR_qPCVMax_C "Maximale Einspritzmenge bei Verwendung des PCVs" VALUE 0xE8050 Kw_Ws16 327.6700 InjMassCyc 0.00 327.6700 FORMAT "%8.4" EXTENDED_LIMITS -327.6800 327.6700 /end CHARACTERISTIC
/begin CHARACTERISTIC PCR_qPCVMin_C "Minimale Einspritzmenge bei Verwendung des PCVs" VALUE 0xE8052 Kw_Ws16 327.6700 InjMassCyc 0.00 327.6700 FORMAT "%8.4" EXTENDED_LIMITS -327.6800 327.6700 /end CHARACTERISTIC
/begin CHARACTERISTIC PCR_qRgtOffRgn_CUR "Mengenkennlinie für Reglerabschaltschwelle in Abhängigkeit von der Drehzahl für Partikelfilter Regeneration" CURVE 0xE9E16 Kl_Xs16_Ws16 200.0000 InjMass 0.00 200.0000 FORMAT "%8.4" EXTENDED_LIMITS -327.6800 327.6700
 /begin AXIS_DESCR STD_AXIS Eng_nAvrg EngN 8 0.00 8000.000 FORMAT "%8.3" EXTENDED_LIMITS -32768.00 32767.00 DEPOSIT ABSOLUTE /end AXIS_DESCR
/end CHARACTERISTIC
/begin CHARACTERISTIC PCR_qRgtOff_CUR "Mengenkennlinie für Reglerabschaltschwelle in Abhängigkeit von der Drehzahl" CURVE 0xE9E38 Kl_Xs16_Ws16 200.0000 InjMass 0.00 200.0000 FORMAT "%8.4" EXTENDED_LIMITS -327.6800 327.6700
 /begin AXIS_DESCR STD_AXIS Eng_nAvrg EngN 9 0.00 8000.000 FORMAT "%8.3" EXTENDED_LIMITS -32768.00 32767.00 DEPOSIT ABSOLUTE /end AXIS_DESCR
/end CHARACTERISTIC
/begin CHARACTERISTIC PCR_qRgtOnRgn_CUR "Mengenkennlinie für Reglereinschaltschwelle in Abhängigkeit von der Drehzahl für Partikelfilter Regeneration" CURVE 0xE9E5E Kl_Xs16_Ws16 200.0000 InjMass 0.00 200.0000 FORMAT "%8.4" EXTENDED_LIMITS -327.6800 327.6700
 /begin AXIS_DESCR STD_AXIS Eng_nAvrg EngN 8 0.00 8000.000 FORMAT "%8.3" EXTENDED_LIMITS -32768.00 32767.00 DEPOSIT ABSOLUTE /end AXIS_DESCR
/end CHARACTERISTIC
/begin CHARACTERISTIC PCR_qRgtOn_CUR "Mengenkennlinie für Reglereinschaltschwelle in Abhängigkeit von der Drehzahl" CURVE 0xE9E80 Kl_Xs16_Ws16 200.0000 InjMass 0.00 200.0000 FORMAT "%8.4" EXTENDED_LIMITS -327.6800 327.6700
 /begin AXIS_DESCR STD_AXIS Eng_nAvrg EngN 9 0.00 8000.000 FORMAT "%8.3" EXTENDED_LIMITS -32768.00 32767.00 DEPOSIT ABSOLUTE /end AXIS_DESCR
/end CHARACTERISTIC
/begin CHARACTERISTIC PCR_qWrkSph2_C "obere Mengengrenze des Arbeitsbereichs 2" VALUE 0xE9EA6 Kw_Ws16 200.0000 InjMass 0.00 200.0000 FORMAT "%8.4" EXTENDED_LIMITS -327.6800 327.6700 /end CHARACTERISTIC
/begin CHARACTERISTIC PCR_qWrkSph3_C "Einspritzmengengrenze zwischen den Arbeitsbereichen 2 und 3" VALUE 0xE9EA8 Kw_Ws16 200.0000 InjMass 0.00 200.0000 FORMAT "%8.4" EXTENDED_LIMITS -327.6800 327.6700 /end CHARACTERISTIC
/begin CHARACTERISTIC PCR_rAdPCVCtlValMax_C "Maximale Grenze fuer Adaptives Vorsteuerkennfeld" VALUE 0xE8054 Kw_Ws16 100.0000 Prc 0.00 100.0000 FORMAT "%8.4" EXTENDED_LIMITS -400.0000 399.9878 /end CHARACTERISTIC
/begin CHARACTERISTIC PCR_rAdPCVCtlValMin_C "Minimale Grenze fuer Adaptives Vorsteuerkennfeld" VALUE 0xE8056 Kw_Ws16 100.0000 Prc 0.00 100.0000 FORMAT "%8.4" EXTENDED_LIMITS -400.0000 399.9878 /end CHARACTERISTIC
/begin CHARACTERISTIC PCR_rARWIMin_C "Minimum value in case of ""Anti-Reset-Windup""" VALUE 0xE86A4 Kw_Ws16 100.0000 Prc 0.00 100.0000 FORMAT "%8.4" EXTENDED_LIMITS -400.0000 399.9878 /end CHARACTERISTIC
/begin CHARACTERISTIC PCR_rBPACDAdd_Vector "#SSD Bypass-Label für additiven Bypass von PCR_rBPACD (Nicht verstellen!)" VALUE 0xC3190 Kw_Wu8 255.0 OneToOne 0.00 255.0 FORMAT "%5.1" /end CHARACTERISTIC
/begin CHARACTERISTIC PCR_rBPACDAdd_Channel "#SSD Bypass-Label für additiven Bypass von PCR_rBPACD (Nicht verstellen!)" VALUE 0xC3191 Kw_Wu8 255.0 OneToOne 0.00 255.0 FORMAT "%5.1" /end CHARACTERISTIC
/begin CHARACTERISTIC PCR_rBPACD_Vector "#SSD Bypass-Label für PCR_rBPACD (Nicht verstellen!)" VALUE 0xC3192 Kw_Wu8 255.0 OneToOne 0.00 255.0 FORMAT "%5.1" /end CHARACTERISTIC
/begin CHARACTERISTIC PCR_rBPACD_Channel "#SSD Bypass-Label für PCR_rBPACD (Nicht verstellen!)" VALUE 0xC3193 Kw_Wu8 255.0 OneToOne 0.00 255.0 FORMAT "%5.1" /end CHARACTERISTIC
/begin CHARACTERISTIC PCR_rBPBasLPRgn1_MAP "1. RGN Map für LPA" MAP 0xE8EA4 Kf_Xs16_Ys16_Ws16 100.0000 Prc 0.00 100.0000 FORMAT "%8.4" EXTENDED_LIMITS -400.0000 399.9878
 /begin AXIS_DESCR STD_AXIS Eng_nAvrg EngN 16 0.00 8000.000 FORMAT "%8.3" EXTENDED_LIMITS -32768.00 32767.00 DEPOSIT ABSOLUTE /end AXIS_DESCR
 /begin AXIS_DESCR STD_AXIS PCR_qDes InjMass 16 0.00 200.0000 FORMAT "%8.4" EXTENDED_LIMITS -327.6800 327.6700 DEPOSIT ABSOLUTE /end AXIS_DESCR
/end CHARACTERISTIC
/begin CHARACTERISTIC PCR_rBPBasLPRgn2_MAP "2. RGN Map für LPA" MAP 0xE90E8 Kf_Xs16_Ys16_Ws16 100.0000 Prc 0.00 100.0000 FORMAT "%8.4" EXTENDED_LIMITS -400.0000 399.9878
 /begin AXIS_DESCR STD_AXIS Eng_nAvrg EngN 16 0.00 8000.000 FORMAT "%8.3" EXTENDED_LIMITS -32768.00 32767.00 DEPOSIT ABSOLUTE /end AXIS_DESCR
 /begin AXIS_DESCR STD_AXIS PCR_qDes InjMass 16 0.00 200.0000 FORMAT "%8.4" EXTENDED_LIMITS -327.6800 327.6700 DEPOSIT ABSOLUTE /end AXIS_DESCR
/end CHARACTERISTIC
/begin CHARACTERISTIC PCR_rBPBasLP_MAP "KF TV an steller(LPA) bei Kompressorbypass geschlossen" MAP 0xE932C Kf_Xs16_Ys16_Ws16 100.0000 Prc 0.00 100.0000 FORMAT "%8.4" EXTENDED_LIMITS -400.0000 399.9878
 /begin AXIS_DESCR STD_AXIS Eng_nAvrg EngN 16 0.00 8000.000 FORMAT "%8.3" EXTENDED_LIMITS -32768.00 32767.00 DEPOSIT ABSOLUTE /end AXIS_DESCR
 /begin AXIS_DESCR STD_AXIS PCR_qDes InjMass 16 0.00 200.0000 FORMAT "%8.4" EXTENDED_LIMITS -327.6800 327.6700 DEPOSIT ABSOLUTE /end AXIS_DESCR
/end CHARACTERISTIC
/begin CHARACTERISTIC PCR_rBPGovMaxCorr_MAP "Correction factor(MAX) of D-parameter according to engine speed and particle filter soot mass" MAP 0xE8058 Kf_Xs16_Ys16_Ws16 100.0000 Prc 0.00 100.0000 FORMAT "%8.4" EXTENDED_LIMITS -400.0000 399.9878
 /begin AXIS_DESCR STD_AXIS Eng_nAvrg EngN 16 0.00 8000.000 FORMAT "%8.3" EXTENDED_LIMITS -32768.00 32767.00 DEPOSIT ABSOLUTE /end AXIS_DESCR
 /begin AXIS_DESCR STD_AXIS PCR_qReal InjMassCyc 10 0.00 100.0000 FORMAT "%8.4" EXTENDED_LIMITS -327.6800 327.6700 DEPOSIT ABSOLUTE /end AXIS_DESCR
/end CHARACTERISTIC
/begin CHARACTERISTIC PCR_rBPGovMaxDynCorr_MAP "MAP für dynamische Korrektur des BP-Regler-Maximums" MAP 0xE81D0 Kf_Xs16_Ys16_Ws16 100.0000 Prc 0.00 100.0000 FORMAT "%8.4" EXTENDED_LIMITS -400.0000 399.9878
 /begin AXIS_DESCR STD_AXIS APSCD_pVal Pres_hPa 8 0.00 4000.000 FORMAT "%8.3" EXTENDED_LIMITS -32768.00 32767.00 DEPOSIT ABSOLUTE /end AXIS_DESCR
 /begin AXIS_DESCR STD_AXIS Eng_nAvrg EngN 8 40.00000 6000.000 FORMAT "%8.3" EXTENDED_LIMITS -32768.00 32767.00 DEPOSIT ABSOLUTE /end AXIS_DESCR
/end CHARACTERISTIC
/begin CHARACTERISTIC PCR_rBPGovMaxDynEnd_C "Ramp correction end value for maximum allowable PCR governor output" VALUE 0xE8274 Kw_Ws16 100.0000 Prc 0.00 100.0000 FORMAT "%8.4" EXTENDED_LIMITS -400.0000 399.9878 /end CHARACTERISTIC
/begin CHARACTERISTIC PCR_rBPGovMaxDynStrt_C "Ramp correction start value for maximum allowable PCR governor output" VALUE 0xE8276 Kw_Ws16 100.0000 Prc 0.00 100.0000 FORMAT "%8.4" EXTENDED_LIMITS -400.0000 399.9878 /end CHARACTERISTIC
/begin CHARACTERISTIC PCR_rBPGovMaxDyn_MAP "Map for Maximum allowable PCR output for actuator" MAP 0xE8278 Kf_Xs16_Ys16_Ws16 100.0000 Prc 0.00 100.0000 FORMAT "%8.4" EXTENDED_LIMITS -400.0000 399.9878
 /begin AXIS_DESCR STD_AXIS Eng_nAvrg EngN 8 40.00000 6000.000 FORMAT "%8.3" EXTENDED_LIMITS -32768.00 32767.00 DEPOSIT ABSOLUTE /end AXIS_DESCR
 /begin AXIS_DESCR STD_AXIS PCR_qReal InjMassCyc 8 0.00 100.0000 FORMAT "%8.4" EXTENDED_LIMITS -327.6800 327.6700 DEPOSIT ABSOLUTE /end AXIS_DESCR
/end CHARACTERISTIC
/begin CHARACTERISTIC PCR_rBPRglBasLPRgn1_MAP "KF fuer Vorsteuertastverhaeltnis" MAP 0xE9570 Kf_Xs16_Ys16_Ws16 100.0000 Prc 0.00 100.0000 FORMAT "%8.4" EXTENDED_LIMITS -400.0000 399.9878
 /begin AXIS_DESCR STD_AXIS Eng_nAvrg EngN 16 0.00 8000.000 FORMAT "%8.3" EXTENDED_LIMITS -32768.00 32767.00 DEPOSIT ABSOLUTE /end AXIS_DESCR
 /begin AXIS_DESCR STD_AXIS PCR_qDes InjMass 16 0.00 200.0000 FORMAT "%8.4" EXTENDED_LIMITS -327.6800 327.6700 DEPOSIT ABSOLUTE /end AXIS_DESCR
/end CHARACTERISTIC
/begin CHARACTERISTIC PCR_rBPRglBasLPRgn2_MAP "KF fuer Vorsteuertastverhaeltnis" MAP 0xE97B4 Kf_Xs16_Ys16_Ws16 100.0000 Prc 0.00 100.0000 FORMAT "%8.4" EXTENDED_LIMITS -400.0000 399.9878
 /begin AXIS_DESCR STD_AXIS Eng_nAvrg EngN 16 0.00 8000.000 FORMAT "%8.3" EXTENDED_LIMITS -32768.00 32767.00 DEPOSIT ABSOLUTE /end AXIS_DESCR
 /begin AXIS_DESCR STD_AXIS PCR_qDes InjMass 16 0.00 200.0000 FORMAT "%8.4" EXTENDED_LIMITS -327.6800 327.6700 DEPOSIT ABSOLUTE /end AXIS_DESCR
/end CHARACTERISTIC
/begin CHARACTERISTIC PCR_rBPRglBasLP_MAP "KF fuer Vorsteuertastverhaeltnis" MAP 0xE99F8 Kf_Xs16_Ys16_Ws16 100.0000 Prc 0.00 100.0000 FORMAT "%8.4" EXTENDED_LIMITS -400.0000 399.9878
 /begin AXIS_DESCR STD_AXIS Eng_nAvrg EngN 16 0.00 8000.000 FORMAT "%8.3" EXTENDED_LIMITS -32768.00 32767.00 DEPOSIT ABSOLUTE /end AXIS_DESCR
 /begin AXIS_DESCR STD_AXIS PCR_qDes InjMass 16 0.00 200.0000 FORMAT "%8.4" EXTENDED_LIMITS -327.6800 327.6700 DEPOSIT ABSOLUTE /end AXIS_DESCR
/end CHARACTERISTIC
/begin CHARACTERISTIC PCR_rCBOpn_C "Stellgroesze fuer den Ladedrucksteller bei geoeffnetem Verdichterbypass" VALUE 0xE9EAA Kw_Ws16 799.9878 Prc -400.0000 399.9878 FORMAT "%8.4" /end CHARACTERISTIC
/begin CHARACTERISTIC PCR_rDflVal04_C "Default Verhältnis für 'Default Schalter' prio 4" VALUE 0xE9EAC Kw_Ws16 799.9878 Prc -400.0000 399.9878 FORMAT "%8.4" /end CHARACTERISTIC
/begin CHARACTERISTIC PCR_rDflVal05_C "Default Verhältnis für 'Default Schalter' prio 5" VALUE 0xE9EAE Kw_Ws16 799.9878 Prc -400.0000 399.9878 FORMAT "%8.4" /end CHARACTERISTIC
/begin CHARACTERISTIC PCR_rDflVal06_C "Defaultwert 6 für relative Stellung des Ladedruckstellers" VALUE 0xE9EB0 Kw_Ws16 799.9878 Prc -400.0000 399.9878 FORMAT "%8.4" /end CHARACTERISTIC
/begin CHARACTERISTIC PCR_rDflVal12_C "Defaultwert 12 für relative Stellung des Ladedruckstellers" VALUE 0xE9EB2 Kw_Ws16 799.9878 Prc -400.0000 399.9878 FORMAT "%8.4" /end CHARACTERISTIC
/begin CHARACTERISTIC PCR_rDflVal15_MAP "Default value map for the output of the two actuators" MAP 0xE9EB4 Kf_Xs16_Ys16_Ws16 300.0000 Prc -100.0000 200.0000 FORMAT "%8.4" EXTENDED_LIMITS -400.0000 399.9878
 /begin AXIS_DESCR STD_AXIS Eng_nAvrg EngN 8 0.00 6000.000 FORMAT "%8.3" EXTENDED_LIMITS -32768.00 32767.00 DEPOSIT ABSOLUTE /end AXIS_DESCR
 /begin AXIS_DESCR STD_AXIS PCR_qReal InjMassCyc 8 0.00 327.6700 FORMAT "%8.4" EXTENDED_LIMITS -327.6800 327.6700 DEPOSIT ABSOLUTE /end AXIS_DESCR
/end CHARACTERISTIC
/begin CHARACTERISTIC PCR_rDflVal18_C "Defaultwert 18 für relative Stellung des Ladedruckstellers" VALUE 0xE9F58 Kw_Ws16 799.9878 Prc -400.0000 399.9878 FORMAT "%8.4" /end CHARACTERISTIC
/begin CHARACTERISTIC PCR_rDflVal24_C "Defaultwert 24 für relative Stellung des Ladedruckstellers" VALUE 0xE9F5A Kw_Ws16 799.9878 Prc -400.0000 399.9878 FORMAT "%8.4" /end CHARACTERISTIC
/begin CHARACTERISTIC PCR_rDistAdPCV1_C "Verzerrung eingang des I1-Reglers" VALUE 0xE831C Kw_Ws16 100.0000 Prc 0.00 100.0000 FORMAT "%8.4" EXTENDED_LIMITS -400.0000 399.9878 /end CHARACTERISTIC
/begin CHARACTERISTIC PCR_rDistAdPCV2_C "Verzerrung eingang des I2-Reglers" VALUE 0xE831E Kw_Ws16 100.0000 Prc 0.00 100.0000 FORMAT "%8.4" EXTENDED_LIMITS -400.0000 399.9878 /end CHARACTERISTIC
/begin CHARACTERISTIC PCR_rDistAdPCV3_C "Verzerrung eingang des I3-Reglers" VALUE 0xE8320 Kw_Ws16 100.0000 Prc 0.00 100.0000 FORMAT "%8.4" EXTENDED_LIMITS -400.0000 399.9878 /end CHARACTERISTIC
/begin CHARACTERISTIC PCR_rDistAdPCV4_C "Verzerrung eingang des I4-Reglers" VALUE 0xE8322 Kw_Ws16 100.0000 Prc 0.00 100.0000 FORMAT "%8.4" EXTENDED_LIMITS -400.0000 399.9878 /end CHARACTERISTIC
/begin CHARACTERISTIC PCR_rDt1InitLP_C "Initialisierungs-Wert fuer DT1-Regler" VALUE 0xE9C3C Kw_Ws16 200.0000 Prc -100.0000 100.0000 FORMAT "%8.4" EXTENDED_LIMITS -400.0000 399.9878 /end CHARACTERISTIC
/begin CHARACTERISTIC PCR_rGovMaxLP_C "Maximale Grenze fuer Regler Ausgang" VALUE 0xE9C3E Kw_Ws16 200.0000 Prc -100.0000 100.0000 FORMAT "%8.4" EXTENDED_LIMITS -400.0000 399.9878 /end CHARACTERISTIC
/begin CHARACTERISTIC PCR_rGovMinLP_C "Minimale Grenze fuer Regler Ausgang" VALUE 0xE9C40 Kw_Ws16 200.0000 Prc -100.0000 100.0000 FORMAT "%8.4" EXTENDED_LIMITS -400.0000 399.9878 /end CHARACTERISTIC
/begin CHARACTERISTIC PCR_rGvnrMax_CUR "Kennlinie zur Bestimmung der maximal zulässigen Stellgroesse aus dem Verbrauch" CURVE 0xE8324 Kl_Xs16_Ws16 300.0000 Prc -100.0000 200.0000 FORMAT "%8.4" EXTENDED_LIMITS -400.0000 399.9878
 /begin AXIS_DESCR STD_AXIS CoEng_dvolFlConsum FlConsum_l_h 16 0.00 327.6700 FORMAT "%8.4" EXTENDED_LIMITS -327.6800 327.6700 DEPOSIT ABSOLUTE /end AXIS_DESCR
/end CHARACTERISTIC
/begin CHARACTERISTIC PCR_rGvnrMax_MAP "Kennfeld/Kennlinie zur Bestimmung der maximal zulässigen Stellgröße aus Drehzahl und Einspritzmenge" MAP 0xE8366 Kf_Xs16_Ys16_Ws16 300.0000 Prc -100.0000 200.0000 FORMAT "%8.4" EXTENDED_LIMITS -400.0000 399.9878
 /begin AXIS_DESCR STD_AXIS Eng_nAvrg EngN 16 0.00 8000.000 FORMAT "%8.3" EXTENDED_LIMITS -32768.00 32767.00 DEPOSIT ABSOLUTE /end AXIS_DESCR
 /begin AXIS_DESCR STD_AXIS PCR_qReal InjMassCyc 16 0.00 200.0000 FORMAT "%8.4" EXTENDED_LIMITS -327.6800 327.6700 DEPOSIT ABSOLUTE /end AXIS_DESCR
/end CHARACTERISTIC
/begin CHARACTERISTIC PCR_rGvnrMin_CUR "Kennlinie zur Bestimmung der minimal zulässigen Stellgoesse aus dem Verbrauch" CURVE 0xE85AA Kl_Xs16_Ws16 300.0000 Prc -100.0000 200.0000 FORMAT "%8.4" EXTENDED_LIMITS -400.0000 399.9878
 /begin AXIS_DESCR STD_AXIS CoEng_dvolFlConsum FlConsum_l_h 2 0.00 327.6700 FORMAT "%8.4" EXTENDED_LIMITS -327.6800 327.6700 DEPOSIT ABSOLUTE /end AXIS_DESCR
/end CHARACTERISTIC
/begin CHARACTERISTIC PCR_rGvnrMin_MAP "Kennfeld/Kennlinie zur Bestimmung der minimal zulässigen Stellgröße aus Drehzahl und Einspritzmenge" MAP 0xE85B4 Kf_Xs16_Ys16_Ws16 300.0000 Prc -100.0000 200.0000 FORMAT "%8.4" EXTENDED_LIMITS -400.0000 399.9878
 /begin AXIS_DESCR STD_AXIS Eng_nAvrg EngN 4 0.00 8000.000 FORMAT "%8.3" EXTENDED_LIMITS -32768.00 32767.00 DEPOSIT ABSOLUTE /end AXIS_DESCR
 /begin AXIS_DESCR STD_AXIS PCR_qReal InjMassCyc 4 0.00 200.0000 FORMAT "%8.4" EXTENDED_LIMITS -327.6800 327.6700 DEPOSIT ABSOLUTE /end AXIS_DESCR
/end CHARACTERISTIC
/begin CHARACTERISTIC PCR_rIInitLP_C "Initialisierungs-Wert fuer PI-Regler" VALUE 0xE9C42 Kw_Ws16 200.0000 Prc -100.0000 100.0000 FORMAT "%8.4" EXTENDED_LIMITS -400.0000 399.9878 /end CHARACTERISTIC
/begin CHARACTERISTIC PCR_rLPDflVal09_C "Vorgabewert 9 für Regelungsausgang" VALUE 0xE9D72 Kw_Ws16 799.9878 Prc -400.0000 399.9878 FORMAT "%8.4" /end CHARACTERISTIC
/begin CHARACTERISTIC PCR_rLPDflVal12_C "Vorgabewert 12 für Regelungsausgang" VALUE 0xE9D74 Kw_Ws16 799.9878 Prc -400.0000 399.9878 FORMAT "%8.4" /end CHARACTERISTIC
/begin CHARACTERISTIC PCR_rLPDflVal18_C "Vorgabewert 18 für Regelungsausgang" VALUE 0xE9D76 Kw_Ws16 799.9878 Prc -400.0000 399.9878 FORMAT "%8.4" /end CHARACTERISTIC
/begin CHARACTERISTIC PCR_rMaxLP_C "Maximale Grenze fuer PID + Vorsteuertastverhaeltnis Ausgang" VALUE 0xE9C44 Kw_Ws16 200.0000 Prc -100.0000 100.0000 FORMAT "%8.4" EXTENDED_LIMITS -400.0000 399.9878 /end CHARACTERISTIC
/begin CHARACTERISTIC PCR_rMinLP_C "Minimale Grenze fuer PID + Vorsteuertastverhaeltnis Ausgang" VALUE 0xE9C46 Kw_Ws16 200.0000 Prc -100.0000 100.0000 FORMAT "%8.4" EXTENDED_LIMITS -400.0000 399.9878 /end CHARACTERISTIC
/begin CHARACTERISTIC PCR_rOutIMax_MAP "Kennfeld zur Limitierung des I-Reglers über Drehzahl und differentzierten gefilterteren Werts des Ladedrucks" MAP 0xE85E8 Kf_Xs16_Ys16_Ws16 5.004883 Prc 0.00 5.004883 FORMAT "%8.6" EXTENDED_LIMITS -400.0000 399.9878
 /begin AXIS_DESCR STD_AXIS BPSCD_dFltValDT1 dp_dZ10 8 -350000.0 350000.0 FORMAT "%8.1" EXTENDED_LIMITS -327680.0 327670.0 DEPOSIT ABSOLUTE /end AXIS_DESCR
 /begin AXIS_DESCR STD_AXIS Eng_nAvrg EngN 8 40.00000 6000.000 FORMAT "%8.3" EXTENDED_LIMITS -32768.00 32767.00 DEPOSIT ABSOLUTE /end AXIS_DESCR
/end CHARACTERISTIC
/begin CHARACTERISTIC PCR_rSurgeGvnrOff_CUR "Wert" CURVE 0xEA128 Kl_Xs16_Ws16 799.9878 Prc -400.0000 399.9878 FORMAT "%8.4"
 /begin AXIS_DESCR STD_AXIS Eng_nAvrg EngN 5 0.00 6000.000 FORMAT "%8.3" EXTENDED_LIMITS -32768.00 32767.00 DEPOSIT ABSOLUTE /end AXIS_DESCR
/end CHARACTERISTIC
/begin CHARACTERISTIC PCR_rSurgeGvnrOn_MAP "Kennfeld" MAP 0xEA13E Kf_Xs16_Ys16_Ws16 100.0000 Prc 0.00 100.0000 FORMAT "%8.4" EXTENDED_LIMITS -400.0000 399.9878
 /begin AXIS_DESCR STD_AXIS Eng_nAvrg EngN 6 0.00 6000.000 FORMAT "%8.3" EXTENDED_LIMITS -32768.00 32767.00 DEPOSIT ABSOLUTE /end AXIS_DESCR
 /begin AXIS_DESCR STD_AXIS APSCD_pLinVal Pres_hPa 4 -32768.00 32767.00 FORMAT "%8.2" DEPOSIT ABSOLUTE /end AXIS_DESCR
/end CHARACTERISTIC
/begin CHARACTERISTIC PCR_rSurgeGvnr_MAP "kennlinie für Ladedrucksteuersignal aus AntiSurge-Regler Eingangsgrößen" MAP 0xEA186 Kf_Xs16_Ys16_Ws16 100.0000 Prc 0.00 100.0000 FORMAT "%8.4" EXTENDED_LIMITS -400.0000 399.9878
 /begin AXIS_DESCR STD_AXIS PCR_pBSurgePICtlLim_mp Pres_hPa 5 -32768.00 32767.00 FORMAT "%8.2" DEPOSIT ABSOLUTE /end AXIS_DESCR
 /begin AXIS_DESCR STD_AXIS Eng_nAvrg EngN 5 0.00 6000.000 FORMAT "%8.3" EXTENDED_LIMITS -32768.00 32767.00 DEPOSIT ABSOLUTE /end AXIS_DESCR
/end CHARACTERISTIC
/begin CHARACTERISTIC PCR_stAdPCVReset_C "Status fuer die eeprom Spiegel-Werte neu zu fassen" VALUE 0xE868C Kw_Wu8 255.0 OneToOne 0.00 255.0 FORMAT "%5.1" /end CHARACTERISTIC
/begin CHARACTERISTIC PCR_stLPMonCur_C "Schalter für EGT" VALUE 0xE9D78 Kw_Wu32 4294967295.00 OneToOne 0.00 4294967295.00 FORMAT "%13.2" /end CHARACTERISTIC
/begin CHARACTERISTIC PCR_stMonCur_C "Bit Mask for EGT_st" VALUE 0xE9F5C Kw_Wu32 4294967295.00 OneToOne 0.00 4294967295.00 FORMAT "%13.2" /end CHARACTERISTIC
/begin CHARACTERISTIC PCR_stRgnMsk1_C "applizierbare Bitmaske für erstes Regenerationskennfeld" VALUE 0xE7C98 Kw_Wu32 4294967295.00 OneToOne 0.00 4294967295.00 FORMAT "%13.2" /end CHARACTERISTIC
/begin CHARACTERISTIC PCR_stRgnMsk2_C "applizierbare Bitmaske für zweites Regenerationskennfeld" VALUE 0xE7C9C Kw_Wu32 4294967295.00 OneToOne 0.00 4294967295.00 FORMAT "%13.2" /end CHARACTERISTIC
/begin CHARACTERISTIC PCR_stRgnMskLP1_C "Erste Maske für Auswahl LPGov Regeneration Mode" VALUE 0xE9C48 Kw_Wu32 4294967295.00 OneToOne 0.00 4294967295.00 FORMAT "%13.2" /end CHARACTERISTIC
/begin CHARACTERISTIC PCR_stRgnMskLP2_C "Zweite Maske für Auswahl LPGov Regeneration Mode" VALUE 0xE9C4C Kw_Wu32 4294967295.00 OneToOne 0.00 4294967295.00 FORMAT "%13.2" /end CHARACTERISTIC
/begin CHARACTERISTIC PCR_tiDebSurge1_C "Parameter 1 für die Entprellung der Erkennung oszillierende Luftmasse mit großer Amplitude" VALUE 0xEA28C Kw_Wu16 655140.0 TimeDeb 0.00 655140.0 FORMAT "%8.1" EXTENDED_LIMITS 0.00 655350.0 /end CHARACTERISTIC
/begin CHARACTERISTIC PCR_tiDebSurge2_C "Parameter 2 für die Entprellung der Erkennung oszillierende Luftmasse mit großer Amplitude" VALUE 0xEA28E Kw_Wu16 655140.0 TimeDeb 0.00 655140.0 FORMAT "%8.1" EXTENDED_LIMITS 0.00 655350.0 /end CHARACTERISTIC
/begin CHARACTERISTIC PCR_tiSurgeGvnrPT1_C "Parameter für PT1-Glied für Tiefpassfilterung der Regelabwei-chung für I Anteil" VALUE 0xEA1D0 Kw_Wu32 4294.9663 TimeDelay_s 0.0010000001 4294.9673 FORMAT "%9.4" EXTENDED_LIMITS 0.0000010000000 4294.9673 /end CHARACTERISTIC
/begin CHARACTERISTIC PCR_swtActSlpLim_C "Schalter Status Sollwert AbfallBegrenzung (1: PWG/Menge, 0: Ladedrucksollwert)" VALUE 0xE7CA0 Kw_Wu8 255.0 OneToOne 0.00 255.0 FORMAT "%5.1" /end CHARACTERISTIC
/begin CHARACTERISTIC PCR_swtAdPCVrLim_C "Schalter Status Stop Lernen - Anhebung / Absenkung adaptiver Vorsteuerwertes (0: >0, 1: <0)" VALUE 0xE868D Kw_Wu8 255.0 OneToOne 0.00 255.0 FORMAT "%5.1" /end CHARACTERISTIC
/begin CHARACTERISTIC PCR_swtAirPerTimeDet_C "Schalter zur Auswahl der Erfassung der Luftmassenschwingung mittels DFT oder PT1" VALUE 0xEA290 Kw_Wu8 1.000 OneToOne 0.00 1.000 FORMAT "%5.3" EXTENDED_LIMITS 0.00 255.0 /end CHARACTERISTIC
/begin CHARACTERISTIC PCR_swtARWMode_C "Schalter für ""Anti-Reset-Windup""- Massnahme (0: einfrieren, 1: rückrechnen)" VALUE 0xE86A6 Kw_Wu8 1.000 OneToOne 0.00 1.000 FORMAT "%5.3" EXTENDED_LIMITS 0.00 255.0 /end CHARACTERISTIC
/begin CHARACTERISTIC PCR_swtFacCnv_C "Schalter zur Umschaltung des Faktors mit Konversion" VALUE 0xEA291 Kw_Wu8 1.000 OneToOne 0.00 1.000 FORMAT "%5.3" EXTENDED_LIMITS 0.00 255.0 /end CHARACTERISTIC
/begin CHARACTERISTIC PCR_swtIDevType_C "Deviation I/P  Integrator selection switch (0: Zusatzfunktion aktiviert, 1: deaktiviert)" VALUE 0xE868E Kw_Wu8 255.0 OneToOne 0.00 255.0 FORMAT "%5.1" /end CHARACTERISTIC
/begin CHARACTERISTIC PCR_swtLimMpCrVal_C "Schalter zur Auswahl der Größen, aus denen der Stellgrößenbereich bestimmt wird (1: Verbrauch, 0: Drehzahl und Einspritzmenge)" VALUE 0xE868F Kw_Wu8 0.00 OneToOne 1.000 1.000 FORMAT "%5.3" EXTENDED_LIMITS 0.00 255.0 /end CHARACTERISTIC
/begin CHARACTERISTIC PCR_swtLimMpCrType_C "Schaltertyp zur Auswahl der Größen, aus denen der zulässige Stellgrößenbereich bestimmt wird" VALUE 0xE8690 Kw_Wu8 0.00 OneToOne 0.00 0.00 FORMAT "%5.2" EXTENDED_LIMITS 0.00 255.0 /end CHARACTERISTIC
/begin CHARACTERISTIC PCR_swtLimSelVal_C "Auswahl Größen f. Bestimmung des zuläss. Stellgrößenbereichs (P263:bei Init. gelesen)(0:PCR_swtLimSel_CSTR; 1:Eng_nAvrg,qInjCtl)" VALUE 0xE8691 Kw_Wu8 0.00 OneToOne 1.000 1.000 FORMAT "%5.3" EXTENDED_LIMITS 0.00 255.0 /end CHARACTERISTIC
/begin CHARACTERISTIC PCR_swtLimSelType_C "Schaltertyp zur Auswahl der Größen, aus denen der zulässige Stellgrößenbereich bestimmt wird" VALUE 0xE8692 Kw_Wu8 0.00 OneToOne 0.00 0.00 FORMAT "%5.2" EXTENDED_LIMITS 0.00 255.0 /end CHARACTERISTIC
/begin CHARACTERISTIC PCR_swtLPV8_C "Schalter zur Erkennung des Defaultwertes aufgrund der Prioritätsbasis" VALUE 0xE9D7C Kw_Wu8 255.0 OneToOne 0.00 255.0 FORMAT "%5.1" /end CHARACTERISTIC
/begin CHARACTERISTIC PCR_swtQntDesVal_C "Mengeneingangswunsch bei der Sollwertberechnung (1: akt Einspritzmenge, 2: Rohwert, 3: Berechnet, 4: CurrCor, d: RawCor)" VALUE 0xE7CA1 Kw_Wu8 4.000 OneToOne 1.000 5.000 FORMAT "%5.3" EXTENDED_LIMITS 0.00 255.0 /end CHARACTERISTIC
/begin CHARACTERISTIC PCR_swtQntDesType_C "Schaltertyp für Mengeneingangswunsch bei der Sollwertberechnung" VALUE 0xE7CA2 Kw_Wu8 1.000 OneToOne 1.000 2.000 FORMAT "%5.3" EXTENDED_LIMITS 0.00 255.0 /end CHARACTERISTIC
/begin CHARACTERISTIC PCR_swtRawCur_C "Auswahl der Einspritzmenge - 0: Rohwert oder 1: aktueller Wert" VALUE 0xE8693 Kw_Wu8 255.0 OneToOne 0.00 255.0 FORMAT "%5.1" /end CHARACTERISTIC
/begin CHARACTERISTIC PCR_swtRelAbsVal_C "#SSD Schalterwert zur  Auswahl zwischen Absolut- und Relativdruckregelung  (0: absolut, 1: relativ)" VALUE 0xE8694 Kw_Wu8 1.000 OneToOne 0.00 1.000 FORMAT "%5.3" EXTENDED_LIMITS 0.00 255.0 /end CHARACTERISTIC
/begin CHARACTERISTIC PCR_swtRelAbsType_C "#SSD Softwareschalter Typ zur  Auswahl zwischen Absolut- und Relativdruckregelung" VALUE 0xE8695 Kw_Wu8 1.000 OneToOne 1.000 2.000 FORMAT "%5.3" EXTENDED_LIMITS 0.00 255.0 /end CHARACTERISTIC
/begin CHARACTERISTIC PCR_swtSlpLimInputType_C "Switch for selection of Slope limitation type" VALUE 0xE7CA3 Kw_Wu8 255.0 OneToOne 0.00 255.0 FORMAT "%5.1" /end CHARACTERISTIC
/begin CHARACTERISTIC PCR_swtSurgeARWMode_C "Schalter für ""Anti-Reset-Windup""- Massnahme (0: einfrieren, 1: rückrechnen)" VALUE 0xEA1D4 Kw_Wu8 1.000 OneToOne 0.00 1.000 FORMAT "%5.3" EXTENDED_LIMITS 0.00 255.0 /end CHARACTERISTIC
/begin CHARACTERISTIC PCR_swtSurgeGvnrSel_C "Shalter zum AntiSurge-Regler (Bit0 - PCR_stPreSurge: 1: on, 0: off Bit1: PCR_stSurge: 1: on, 0: off)" VALUE 0xEA1D5 Kw_Wu8 255.0 OneToOne 0.00 255.0 FORMAT "%5.1" /end CHARACTERISTIC
/begin CHARACTERISTIC PCR_swtV8_C "Schalter für Vorgabewert DflVal24 bei 8 Zyl. (1: verwende Vorgabewert, 0: verwende Standardwert)" VALUE 0xE9F60 Kw_Wu8 255.0 OneToOne 0.00 255.0 FORMAT "%5.1" /end CHARACTERISTIC
/begin CHARACTERISTIC PCR_tAirAdPCVMax_C "Maximale Grenze fuer Kuehlmitteltemperatur" VALUE 0xE8696 Kw_Ws16 950.000 Temp_Cels -50.140 899.860 FORMAT "%8.3" EXTENDED_LIMITS -3549.940 3003.560 /end CHARACTERISTIC
/begin CHARACTERISTIC PCR_tAirAdPCVMin_C "Minimale Grenze fuer  Lufttemperatur" VALUE 0xE8698 Kw_Ws16 950.000 Temp_Cels -50.140 899.860 FORMAT "%8.3" EXTENDED_LIMITS -3549.940 3003.560 /end CHARACTERISTIC
/begin CHARACTERISTIC PCR_tClntAdPCVLim_C "Minimale Grenze fuer Kuehlmittel temperatur" VALUE 0xE869A Kw_Ws16 950.000 Temp_Cels -50.140 899.860 FORMAT "%8.3" EXTENDED_LIMITS -3549.940 3003.560 /end CHARACTERISTIC
/begin CHARACTERISTIC PCR_tClntThres_C "Kühlwassertemperaturschwelle zur Parametersatzumschaltung bei der Berechnung des dyn. Anteils" VALUE 0xE7CA4 Kw_Ws16 950.000 Temp_Cels -50.140 899.860 FORMAT "%8.3" EXTENDED_LIMITS -3549.940 3003.560 /end CHARACTERISTIC
/begin CHARACTERISTIC PCR_tiHiLoAdPCVRelCond0_C "Entprellzeit der Aktivierung Releasecondition 0 (RegelabweiRegelabweichung) der adaptiven Vorsteuerung" VALUE 0xE869C Kw_Wu16 655350.0 TimeDeb 0.00 655350.0 FORMAT "%8.1" /end CHARACTERISTIC
/begin CHARACTERISTIC PCR_tiLoHiAdPCVRelCond0_C "Entprellzeit der Deaktivierung Releasecondition 0 (RegelabweiRegelabweichung)der adaptiven Vorsteuerung" VALUE 0xE869E Kw_Wu16 655350.0 TimeDeb 0.00 655350.0 FORMAT "%8.1" /end CHARACTERISTIC
/begin CHARACTERISTIC PCR_tiHiLoAdPCVRelCond3_C "Entprellzeit der Deaktivierung Releasecondition 3 RegelabweiRegelabweichung) der adaptiven Vorsteuerung" VALUE 0xE86A0 Kw_Wu16 655350.0 TimeDeb 0.00 655350.0 FORMAT "%8.1" /end CHARACTERISTIC
/begin CHARACTERISTIC PCR_tiLoHiAdPCVRelCond3_C "Entprellzeit der Aktivierung Releasecondition 3 RegelabweiRegelabweichung)der adaptiven Vorsteuerung" VALUE 0xE86A2 Kw_Wu16 655350.0 TimeDeb 0.00 655350.0 FORMAT "%8.1" /end CHARACTERISTIC
/begin CHARACTERISTIC PCR_tiAirPerTimeAmplFlt_C "Parameter für PT1-Glied für Tiefpassfilterung der Amplitude der oszillierenden Frischluftmasse nach der DFT" VALUE 0xEA294 Kw_Wu32 4294967.3 TimeDelay_ms 0.0010000000 4294967.3 FORMAT "%9.1" /end CHARACTERISTIC
/begin CHARACTERISTIC PCR_tiAirPTCtlFlt1_C "Parameter für PT1-Glied für Tiefpassfilterung der Amplitude der oszillierenden FrischluftmasseCtl-Flt1" VALUE 0xEA298 Kw_Wu32 4294967.3 TimeDelay_ms 0.0010000000 4294967.3 FORMAT "%9.1" /end CHARACTERISTIC
/begin CHARACTERISTIC PCR_tiAirPTCtlFlt2_C "Parameter für PT1-Glied für Tiefpassfilterung der Amplitude der oszillierenden FrischluftmasseCtl-Flt2" VALUE 0xEA29C Kw_Wu32 4294967.3 TimeDelay_ms 0.0010000000 4294967.3 FORMAT "%9.1" /end CHARACTERISTIC
/begin CHARACTERISTIC PCR_tiBDesSlpLim_C "Time duration for which desired boost pressure value is through the ramp." VALUE 0xE7CA6 Kw_Wu16 655.3500 Time_s 0.00 655.3500 FORMAT "%8.4" /end CHARACTERISTIC
/begin CHARACTERISTIC PCR_tiClutchDebHighLow_C "Entprellzeit für Kupplungssignalüberwachung von High/Low-Wechsel" VALUE 0xE9F62 Kw_Wu16 655350.0 TimeDeb 0.00 655350.0 FORMAT "%8.1" /end CHARACTERISTIC
/begin CHARACTERISTIC PCR_tiClutchDebLowHigh_C "Entprellzeit für Kupplungssignalüberwachung von Low/High-Wechsel" VALUE 0xE9F64 Kw_Wu16 655350.0 TimeDeb 0.00 655350.0 FORMAT "%8.1" /end CHARACTERISTIC
/begin CHARACTERISTIC PCR_tiCoStrt_CUR "#SSD Kennlinie für die Zeit, die die Regelung nach Startabwurf abgeschaltet bleibt" CURVE 0xE9F66 Kl_Xs16_Ws16 33000.00 Time_ms 0.00 33000.00 FORMAT "%8.2" EXTENDED_LIMITS -327680.0 327670.0
 /begin AXIS_DESCR STD_AXIS CTSCD_tClnt Temp_Cels 6 -50.1400 199.8600 FORMAT "%8.4" EXTENDED_LIMITS -3549.940 3003.560 DEPOSIT ABSOLUTE /end AXIS_DESCR
/end CHARACTERISTIC
/begin CHARACTERISTIC PCR_tiDelPreSurgeDet_C "Verzögerungszeit für die Erkennung oszillierende Luftmasse mit kleiner Amplitude" VALUE 0xEA2A0 Kw_Wu16 655350.0 Time_ms 0.00 655350.0 FORMAT "%8.1" /end CHARACTERISTIC
/begin CHARACTERISTIC PCR_tiGvnrOffDel_CUR "Abschaltungsverzögerungszeit im Normalmodus" CURVE 0xE9F80 Kl_Xs16_Ws16 20.00000 Time_s 0.00 20.00000 FORMAT "%8.5" EXTENDED_LIMITS -327.6800 327.6700
 /begin AXIS_DESCR STD_AXIS Eng_nAvrg EngN 6 0.00 8000.000 FORMAT "%8.3" EXTENDED_LIMITS -32768.00 32767.00 DEPOSIT ABSOLUTE /end AXIS_DESCR
/end CHARACTERISTIC
/begin CHARACTERISTIC PCR_tiLPClutchDebHighLow_C "Deaktivierungszeit für Kupplungserkennung" VALUE 0xE9D7E Kw_Wu16 655350.0 TimeDeb 0.00 655350.0 FORMAT "%8.1" /end CHARACTERISTIC
/begin CHARACTERISTIC PCR_tiLPClutchDebLowHigh_C "Aktivierungs-(Verzögerungss-)zeit für Kupplungserkennung" VALUE 0xE9D80 Kw_Wu16 655350.0 TimeDeb 0.00 655350.0 FORMAT "%8.1" /end CHARACTERISTIC
/begin CHARACTERISTIC PCR_tiRmpMswt_C "Rampenlaufzeit für Mehrfachumschalter" VAL_BLK 0xE7CA8 Kwb_Wu32 65.535999984741210 EGTRmp 0.000000015258789066052715 65.536000000000001 FORMAT "%19.16" NUMBER 3 /end CHARACTERISTIC
/begin CHARACTERISTIC PCR_tiRmpSlp_C "Rampensteigungen für EGT_RgnSwt" VAL_BLK 0xE9C50 Kwb_Wu32 65.535999984741210 EGTRmp 0.000000015258789066052715 65.536000000000001 FORMAT "%19.16" NUMBER 3 /end CHARACTERISTIC
/begin CHARACTERISTIC PCR_tiStrtDelayInit_C "#SSD Inititalisierungswert der Zeit, die der PCR nach dem Startabfall abgeschaltet bleibt" VALUE 0xE9F9A Kw_Wu16 655350.0 Time_ms 0.00 655350.0 FORMAT "%8.1" /end CHARACTERISTIC
/begin CHARACTERISTIC PCR_tiSurgeCtlHiLoRel3_C "Zeit für Statuswechsel niedrig" VALUE 0xEA1D6 Kw_Wu16 655350.0 TimeDeb 0.00 655350.0 FORMAT "%8.1" /end CHARACTERISTIC
/begin CHARACTERISTIC PCR_tiSurgeCtlLoHiRel3_C "Zeit für Statuswechsel hoch" VALUE 0xEA1D8 Kw_Wu16 655350.0 TimeDeb 0.00 655350.0 FORMAT "%8.1" /end CHARACTERISTIC
/begin CHARACTERISTIC PCR_tiSurgeCtlHiLoRelAll_C "Zeit für Statuswechsel niedrig" VALUE 0xEA1DA Kw_Wu16 655350.0 TimeDeb 0.00 655350.0 FORMAT "%8.1" /end CHARACTERISTIC
/begin CHARACTERISTIC PCR_tiSurgeCtlLoHiRelAll_C "Zeit für Statuswechsel hoch" VALUE 0xEA1DC Kw_Wu16 655350.0 TimeDeb 0.00 655350.0 FORMAT "%8.1" /end CHARACTERISTIC
/begin CHARACTERISTIC PCR_vClutch_C "Geschwindigkeitsgrenze für Kuplungsüberwachung" VALUE 0xE9F9C Kw_Ws16 300.0000 Vel 0.00 300.0000 FORMAT "%8.4" EXTENDED_LIMITS -327.6800 327.6700 /end CHARACTERISTIC
/begin CHARACTERISTIC PCR_vLPClutch_C "Geschwindigkeitsschwelle für Kupplungssignal überwachung" VALUE 0xE9D82 Kw_Ws16 300.0000 Vel 0.00 300.0000 FORMAT "%8.4" EXTENDED_LIMITS -327.6800 327.6700 /end CHARACTERISTIC
/begin CHARACTERISTIC PCR_tiDT1DesWrm_C "Verzögerungszeitkonstante der dynamischen Sollwertbildung bei warmem Motor" VALUE 0xE7CB4 Kw_Wu32 4294.9663 TimeDelay_s 0.0010000001 4294.9673 FORMAT "%9.4" EXTENDED_LIMITS 0.0000010000000 4294.9673 /end CHARACTERISTIC
/begin CHARACTERISTIC PCR_DKdDesWrm_C "Kleinsignalverstärkung der dynamischen Sollwertbildung bei warmem Motor" VALUE 0xE7CB8 Kw_Ws32 65535.9999847 Kd -32768.0000000 32767.9999847 FORMAT "%13.7" /end CHARACTERISTIC
/begin CHARACTERISTIC PCR_DKdPosDesWrm_C "Positive Großsignalverstärkung der dynamischen Sollwertbildung bei warmem Motor" VALUE 0xE7CBC Kw_Ws32 65535.9999847 Kd -32768.0000000 32767.9999847 FORMAT "%13.7" /end CHARACTERISTIC
/begin CHARACTERISTIC PCR_DKdNegDesWrm_C "Negative Großsignalverstärkung der dynamischen Sollwertbildung bei warmem Motor" VALUE 0xE7CC0 Kw_Ws32 65535.9999847 Kd -32768.0000000 32767.9999847 FORMAT "%13.7" /end CHARACTERISTIC
/begin CHARACTERISTIC PCR_dpDWinPosDesWrm_C "Positive Kleinsignalgrenze bei warmem Motor" VALUE 0xE7CC4 Kw_Ws16 65535.00 Pres_hPa -32768.00 32767.00 FORMAT "%8.2" /end CHARACTERISTIC
/begin CHARACTERISTIC PCR_dpDWinNegDesWrm_C "Negative Kleinsignalgrenze bei warmem Motor" VALUE 0xE7CC6 Kw_Ws16 65535.00 Pres_hPa -32768.00 32767.00 FORMAT "%8.2" /end CHARACTERISTIC
/begin CHARACTERISTIC PCVCD_uSRCMin_C "#SSD Signal Range Check Min-Wert" VALUE 0xEA2EC Kw_Ws16 5200.391 Volt 0.00 5200.391 FORMAT "%8.3" EXTENDED_LIMITS -160156.4 160151.5 /end CHARACTERISTIC
/begin CHARACTERISTIC PCVCD_uSRCMax_C "#SSD Signal Range Check Max-Wert" VALUE 0xEA2EE Kw_Ws16 5200.391 Volt 0.00 5200.391 FORMAT "%8.3" EXTENDED_LIMITS -160156.4 160151.5 /end CHARACTERISTIC
/begin CHARACTERISTIC PCVCD_iLin_CUR "#SSD Analogeingang, Linearisierungskennlinie" CURVE 0xEA2F0 Kl_Xs16_Ws16 5000.000 Curr 0.00 5000.000 FORMAT "%8.3" EXTENDED_LIMITS -32768.00 32767.00
 /begin AXIS_DESCR STD_AXIS PCVCD_uRawVal_mp Volt 2 0.00 5200.391 FORMAT "%8.3" EXTENDED_LIMITS -160156.4 160151.5 DEPOSIT ABSOLUTE /end AXIS_DESCR
/end CHARACTERISTIC
/begin CHARACTERISTIC PCVCD_ctPwrStgOnMax_C "maximale Anzahl von Endstufen-Einschaltungen pro Fahrzyklus bei SCB oder Übertemperatur" VALUE 0xEA2FA Kw_Wu16 65535.00 OneToOne 0.00 65535.00 FORMAT "%8.2" /end CHARACTERISTIC
/begin CHARACTERISTIC PCVCD_dcycMax_C "#SSD Max-Wert, Ausgangstastverhältnis" VALUE 0xEA2FC Kw_Ws16 100.0000 DtyCyc 0.00 100.0000 FORMAT "%8.4" EXTENDED_LIMITS -327.6800 327.6700 /end CHARACTERISTIC
/begin CHARACTERISTIC PCVCD_dcycMin_C "#SSD Min-Wert, Ausgangstastverhältnis" VALUE 0xEA2FE Kw_Ws16 100.0000 DtyCyc 0.00 100.0000 FORMAT "%8.4" EXTENDED_LIMITS -327.6800 327.6700 /end CHARACTERISTIC
/begin CHARACTERISTIC PCVCD_DebExcTempDef_C "#SSD Fehlerentprellzeit Uebertemperatur" VALUE 0xEA300 Kw_Wu16 655350.0 Time_ms 0.00 655350.0 FORMAT "%8.1" /end CHARACTERISTIC
/begin CHARACTERISTIC PCVCD_DebExcTempOk_C "#SSD Heilungsentprellzeit Uebertemperatur" VALUE 0xEA302 Kw_Wu16 655350.0 Time_ms 0.00 655350.0 FORMAT "%8.1" /end CHARACTERISTIC
/begin CHARACTERISTIC PCVCD_DebNoLoadDef_C "#SSD Fehlerentprellzeit Leerlauf" VALUE 0xEA304 Kw_Wu16 655350.0 Time_ms 0.00 655350.0 FORMAT "%8.1" /end CHARACTERISTIC
/begin CHARACTERISTIC PCVCD_DebNoLoadOk_C "#SSD Heilungszeit Leerlauf" VALUE 0xEA306 Kw_Wu16 655350.0 Time_ms 0.00 655350.0 FORMAT "%8.1" /end CHARACTERISTIC
/begin CHARACTERISTIC PCVCD_DebShortCircBatDef_C "#SSD Fehlerentprellzeit Kurzschluss Batterie" VALUE 0xEA308 Kw_Wu16 655350.0 Time_ms 0.00 655350.0 FORMAT "%8.1" /end CHARACTERISTIC
/begin CHARACTERISTIC PCVCD_DebShortCircBatOk_C "#SSD Heilungsentprellzeit Kurzschluss Batterie" VALUE 0xEA30A Kw_Wu16 655350.0 Time_ms 0.00 655350.0 FORMAT "%8.1" /end CHARACTERISTIC
/begin CHARACTERISTIC PCVCD_DebShortCircGndDef_C "#SSD Fehlerentprellzeit Kurzschluss Masse" VALUE 0xEA30C Kw_Wu16 655350.0 Time_ms 0.00 655350.0 FORMAT "%8.1" /end CHARACTERISTIC
/begin CHARACTERISTIC PCVCD_DebShortCircGndOk_C "#SSD Heilungsentprellzeit Kurzschluss Masse" VALUE 0xEA30E Kw_Wu16 655350.0 Time_ms 0.00 655350.0 FORMAT "%8.1" /end CHARACTERISTIC
/begin CHARACTERISTIC PCVCD_DebSRCHighDef_C "#SSD Fehlerentprellzeit für Analogeingang SRC-High Fehler" VALUE 0xEA310 Kw_Wu16 655350.0 Time_ms 0.00 655350.0 FORMAT "%8.1" /end CHARACTERISTIC
/begin CHARACTERISTIC PCVCD_DebSRCHighOk_C "#SSD Heilungsentprellzeit für Analogeingang SRC-High Fehler" VALUE 0xEA312 Kw_Wu16 655350.0 Time_ms 0.00 655350.0 FORMAT "%8.1" /end CHARACTERISTIC
/begin CHARACTERISTIC PCVCD_DebSRCLowDef_C "#SSD Fehlerentprellzeit Analogeingang SRC-Low Fehler" VALUE 0xEA314 Kw_Wu16 655350.0 Time_ms 0.00 655350.0 FORMAT "%8.1" /end CHARACTERISTIC
/begin CHARACTERISTIC PCVCD_DebSRCLowOk_C "#SSD Heilungsentprellzeit für Analogeingang SRC-Low Fehler" VALUE 0xEA316 Kw_Wu16 655350.0 Time_ms 0.00 655350.0 FORMAT "%8.1" /end CHARACTERISTIC
/begin CHARACTERISTIC PCVCD_facIGovInit_CUR "#SSD Initialisierungsfaktor für I-Anteil des Stromreglers als Funktion der Systemtemperatur" CURVE 0xEA318 Kl_Xs16_Ws16 2.000000 Fact 0.00 2.000000 FORMAT "%8.6" EXTENDED_LIMITS -4.000000 3.999878
 /begin AXIS_DESCR STD_AXIS FlSys_t Temp_Cels 4 -50.14000 199.8600 FORMAT "%8.4" EXTENDED_LIMITS -3549.940 3003.560 DEPOSIT ABSOLUTE /end AXIS_DESCR
/end CHARACTERISTIC
/begin CHARACTERISTIC PCVCD_facIGovMax_C "#SSD maximaler I-Anteil" VALUE 0xEA32A Kw_Ws16 1.000000 Fact 1.000000 2.000000 FORMAT "%8.6" EXTENDED_LIMITS -4.000000 3.999878 /end CHARACTERISTIC
/begin CHARACTERISTIC PCVCD_facIGovMin_C "#SSD minimaler I-Anteil" VALUE 0xEA32C Kw_Ws16 0.5000000 Fact 0.5000000 1.000000 FORMAT "%8.6" EXTENDED_LIMITS -4.000000 3.999878 /end CHARACTERISTIC
/begin CHARACTERISTIC PCVCD_tiFlt1PT1_C "#SSD PT1 Filterzeitkonstante für Strom-Istwert" VALUE 0xEA330 Kw_Wu32 4294.9673 TimeDelay_s 0.0000010000000 4294.9673 FORMAT "%9.4" /end CHARACTERISTIC
/begin CHARACTERISTIC PCVCD_tiFlt2PT1_C "#SSD PT1 Filterzeitkonstante für Strom-Sollwert" VALUE 0xEA334 Kw_Wu32 4294.9673 TimeDelay_s 0.0000010000000 4294.9673 FORMAT "%9.4" /end CHARACTERISTIC
/begin CHARACTERISTIC PCVCD_tiIGovDT1_C "#SSD DT1 Zeitkonstante" VALUE 0xEA338 Kw_Wu32 4294.9673 TimeDelay_s 0.0000010000000 4294.9673 FORMAT "%9.4" /end CHARACTERISTIC
/begin CHARACTERISTIC PCVCD_IGovDKd_C "#SSD DT1 Differenziationsfaktor" VALUE 0xEA33C Kw_Ws32 65535.9999847 Kd -32768.0000000 32767.9999847 FORMAT "%13.7" /end CHARACTERISTIC
/begin CHARACTERISTIC PCVCD_IGovIKi_C "#SSD I-Glied, Kleinsignalverstärkung" VALUE 0xEA340 Kw_Wu32 122.070312472 Ki_curr2fact 0.00 122.070312472 FORMAT "%13.9" /end CHARACTERISTIC
/begin CHARACTERISTIC PCVCD_IGovIKiPos_C "#SSD I-Glied, Verstärkung für positive Großsignale" VALUE 0xEA344 Kw_Wu32 122.070312472 Ki_curr2fact 0.00 122.070312472 FORMAT "%13.9" /end CHARACTERISTIC
/begin CHARACTERISTIC PCVCD_IGovIKiNeg_C "#SSD I_Glied, Verstärkung für negative Großsignale" VALUE 0xEA348 Kw_Wu32 122.070312472 Ki_curr2fact 0.00 122.070312472 FORMAT "%13.9" /end CHARACTERISTIC
/begin CHARACTERISTIC PCVCD_iIGovIWinPos_C "#SSD I-Glied, Kleinsignalfenster positiv" VALUE 0xEA34C Kw_Ws16 65535.00 Curr -32768.00 32767.00 FORMAT "%8.2" /end CHARACTERISTIC
/begin CHARACTERISTIC PCVCD_iIGovIWinNeg_C "#SSD I_Glied, Kleinsignalfenster negativ" VALUE 0xEA34E Kw_Ws16 65535.00 Curr -32768.00 32767.00 FORMAT "%8.2" /end CHARACTERISTIC
/begin CHARACTERISTIC PCVCD_tiFltPT1Init_C "#SSD PT1 Filterzeitkonstante während Initialisierungsphase des Stromreglers" VALUE 0xEA350 Kw_Wu32 4294.9673 TimeDelay_s 0.0000010000000 4294.9673 FORMAT "%9.4" /end CHARACTERISTIC
/begin CHARACTERISTIC PCVCD_numAdc_C "#SSD Parameter für die Auswahl des Analogkanals für das Druckregelventil" VALUE 0xEA354 Kw_Wu8 26.0000000000 NumPinAdc 0.00 26.0000000000 FORMAT "%13.10" /end CHARACTERISTIC
/begin CHARACTERISTIC PCVCD_numDia1_C "#SSD Parameter für Zuordnung der Diagnose zur 1. Endstufe des Druckregelventils" VALUE 0xEA355 Kw_Wu8 27.0000000000 NumPinDia 0.00 27.0000000000 FORMAT "%13.10" /end CHARACTERISTIC
/begin CHARACTERISTIC PCVCD_numDia2_C "#SSD Parameter für Zuordnung der Diagnose zur 2. Endstufe des Druckregelventils" VALUE 0xEA356 Kw_Wu8 27.0000000000 NumPinDia 0.00 27.0000000000 FORMAT "%13.10" /end CHARACTERISTIC
/begin CHARACTERISTIC PCVCD_numPwmOut_C "#SSD Parameter für die Auswahl des Hardware-Pins für das Druckregelventil" VALUE 0xEA357 Kw_Wu8 13.0000000000 NumPinPwmOut 0.00 13.0000000000 FORMAT "%13.10" /end CHARACTERISTIC
/begin CHARACTERISTIC PCVCD_stInvOut_C "#SSD Invertierungsparameter der PWM Endstufe" VALUE 0xEA358 Kw_Wu8 1.000 OneToOne 0.00 1.000 FORMAT "%5.3" EXTENDED_LIMITS 0.00 255.0 /end CHARACTERISTIC
/begin CHARACTERISTIC PCVCD_tiPer_C "#SSD Periodendauer der PWM-Endstufe" VALUE 0xEA35A Kw_Ws16 9.900000 Period 0.1000000 10.00000 FORMAT "%8.5" EXTENDED_LIMITS -3276.800 3276.700 /end CHARACTERISTIC
/begin CHARACTERISTIC PCVCD_resCoil_C "#SSD Widerstandswert der DRV-Spule" VALUE 0xEA35C Kw_Ws16 5000.000 Resist_1 0.00 5000.000 FORMAT "%8.3" EXTENDED_LIMITS -32768.00 32767.00 /end CHARACTERISTIC
/begin CHARACTERISTIC PCVCD_stPwrStgDia_C "#SSD Statuswort zur Spezifikation des Abschaltverhaltens der Endstufenfehlerdiagnose Druckregelventil" VALUE 0xEA35E Kw_Wu8 255.0 OneToOne 0.00 255.0 FORMAT "%5.1" /end CHARACTERISTIC
/begin CHARACTERISTIC PCVCD_stSPICtl_C "Parameter zur Anzeige der verwendeten Endstufenart ( 1 =SPI fähige Endstufe, 0 = nicht SPI fähige Endstufe )" VALUE 0xEA35F Kw_Wu8 1.000 OneToOne 0.00 1.000 FORMAT "%5.3" EXTENDED_LIMITS 0.00 255.0 /end CHARACTERISTIC
/begin CHARACTERISTIC PCVCD_swtCtlStateVal_C "#SSD CP1: 0: konstant Stromregelung, 1: nur wenn Raildruckregler im gesteuerten Betrieb ist" VALUE 0xEA360 Kw_Wu8 0.00 OneToOne 0.00 0.00 FORMAT "%5.2" EXTENDED_LIMITS 0.00 255.0 /end CHARACTERISTIC
/begin CHARACTERISTIC PCVCD_swtCtlStateType_C "#SSD CP1: Auswahl, Schalterwert aus Datensatz oder EEPROM" VALUE 0xEA361 Kw_Wu8 1.000 OneToOne 1.000 2.000 FORMAT "%5.3" EXTENDED_LIMITS 0.00 255.0 /end CHARACTERISTIC
/begin CHARACTERISTIC PCVCD_swt_C "#SSD allgemeine Schalterfunktionen der Endstufe Druckregelventil (bit0: 0...Batteriespannungskorrektur aus, 1...ein; bit1-7: Reserve)" VALUE 0xEA362 Kw_Wu8 255.0 OneToOne 0.00 255.0 FORMAT "%5.1" /end CHARACTERISTIC
/begin CHARACTERISTIC PCVCD_tiBtwTst_C "#SSD Zeitabstand, in dem im Fehlerfall die Endstufe getestet wird" VALUE 0xEA364 Kw_Wu16 29990.00 Time_ms 10.00000 30000.00 FORMAT "%8.2" EXTENDED_LIMITS 0.00 655350.0 /end CHARACTERISTIC
/begin CHARACTERISTIC PCVCD_tiIGovInit_C "#SSD maximale Zeitdauer der Initialisierungsphase für den Stromregler" VALUE 0xEA366 Kw_Wu16 655350.0 Time_ms 0.00 655350.0 FORMAT "%8.1" /end CHARACTERISTIC
/begin CHARACTERISTIC PCVCD_tiPwrStgOn_C "Zeit, für welche die Endstufe beim Fall der nicht SPI fähige Endstufe eingeschaltet wird." VALUE 0xEA368 Kw_Wu16 655140.0 Time_ms 0.00 655140.0 FORMAT "%8.1" EXTENDED_LIMITS 0.00 655350.0 /end CHARACTERISTIC
/begin CHARACTERISTIC PCVCD_tiDebSigDefSigTst_C "Fehlerentprellzeit fuer Fehlerpfad Dfp_PCVCD_SigTst" VALUE 0xEA36A Kw_Wu16 655350.0 Time_ms 0.00 655350.0 FORMAT "%8.1" /end CHARACTERISTIC
/begin CHARACTERISTIC PCVCD_tiDebSigOkSigTst_C "Heliungsentprellzeit fuer Fehlerpfad Dfp_PCVCD_SigTst" VALUE 0xEA36C Kw_Wu16 655350.0 Time_ms 0.00 655350.0 FORMAT "%8.1" /end CHARACTERISTIC
/begin CHARACTERISTIC PCV_dvolLeak_CUR "#SSD Leckage des Druckregelventils" CURVE 0xEA2A4 Kl_Xs16_Ws16 150000.0 Qp_mm3_sec 0.00 150000.0 FORMAT "%8.1" EXTENDED_LIMITS -327680.0 327670.0
 /begin AXIS_DESCR STD_AXIS Rail_pSetPoint Pres_Rail 6 0.00 2000.000 FORMAT "%5.3" EXTENDED_LIMITS -3276.800 3276.700 DEPOSIT ABSOLUTE /end AXIS_DESCR
/end CHARACTERISTIC
/begin CHARACTERISTIC PCV_iCnvPress_CUR "#SSD Kennlinie zur Umrechnung von Raildruck in elektrischen Strom" CURVE 0xEA2BE Kl_Xs16_Ws16 5000.000 Curr 0.00 5000.000 FORMAT "%8.3" EXTENDED_LIMITS -32768.00 32767.00
 /begin AXIS_DESCR STD_AXIS Rail_pPCVSet Pres_Rail 10 0.00 2000.000 FORMAT "%5.3" EXTENDED_LIMITS -3276.800 3276.700 DEPOSIT ABSOLUTE /end AXIS_DESCR
/end CHARACTERISTIC
/begin CHARACTERISTIC PCV_iSetMin_C "#SSD Sollstrom bei elektrischer Abschaltung des Druckregelventils" VALUE 0xEA2E8 Kw_Ws16 65535.00 Curr -32768.00 32767.00 FORMAT "%8.2" /end CHARACTERISTIC
/begin CHARACTERISTIC PCV_iSet_Vector "#SSD Bypass-Label für PCV_iSet (Nicht verstellen!)" VALUE 0xC3194 Kw_Wu8 255.0 OneToOne 0.00 255.0 FORMAT "%5.1" /end CHARACTERISTIC
/begin CHARACTERISTIC PCV_iSet_Channel "#SSD Bypass-Label für PCV_iSet, nicht editieren!" VALUE 0xC3195 Kw_Wu8 255.0 OneToOne 0.00 255.0 FORMAT "%5.1" /end CHARACTERISTIC
/begin CHARACTERISTIC PFltCD_uSRCMinPPre_C "Spannungsrohwert SRC-Min des Abgasdrucks vor dem Partikelfilter" VALUE 0xEBE78 Kw_Ws16 5200.391 Volt 0.00 5200.391 FORMAT "%8.3" EXTENDED_LIMITS -160156.4 160151.5 /end CHARACTERISTIC
/begin CHARACTERISTIC PFltCD_uSRCMaxPPre_C "Spannungsrohwert SRC-Max des Abgasdrucks vor dem Partikelfilter" VALUE 0xEBE7A Kw_Ws16 5200.391 Volt 0.00 5200.391 FORMAT "%8.3" EXTENDED_LIMITS -160156.4 160151.5 /end CHARACTERISTIC
/begin CHARACTERISTIC PFltCD_pLinPre_CUR "Linearisierungskennlinie des Abgasdrucks vor dem Partikelfilter" CURVE 0xEBE7C Kl_Xs16_Ws16 50000.00 Pres 0.00 50000.00 FORMAT "%9.2" EXTENDED_LIMITS -32768.00 32767.00
 /begin AXIS_DESCR STD_AXIS PFltCD_uRawPresPre_mp Volt 8 0.00 5200.391 FORMAT "%8.3" EXTENDED_LIMITS -160156.4 160151.5 DEPOSIT ABSOLUTE /end AXIS_DESCR
/end CHARACTERISTIC
/begin CHARACTERISTIC PFltCD_uSRCMinTempPre_C "Spannungsrohwert SRC-Min der Abgastemperatur vor dem Partikelfilter" VALUE 0xEBEFC Kw_Ws16 5200.391 Volt 0.00 5200.391 FORMAT "%8.3" EXTENDED_LIMITS -160156.4 160151.5 /end CHARACTERISTIC
/begin CHARACTERISTIC PFltCD_uSRCMaxTempPre_C "Spannungsrohwert SRC-Max der Abgastemperatur vor dem Partikelfilter" VALUE 0xEBEFE Kw_Ws16 5200.391 Volt 0.00 5200.391 FORMAT "%8.3" EXTENDED_LIMITS -160156.4 160151.5 /end CHARACTERISTIC
/begin CHARACTERISTIC PFltCD_tLinPre_CUR "Linearisierungskennlinie der Abgastemperatur vor dem Partikelfilter" CURVE 0xEBF00 Kl_Xs16_Ws16 950.000 Temp_Cels -50.14000 899.860 FORMAT "%8.3" EXTENDED_LIMITS -3549.940 3003.560
 /begin AXIS_DESCR STD_AXIS PFltCD_uRawTempPre Volt 16 0.00 5200.391 FORMAT "%8.3" EXTENDED_LIMITS -160156.4 160151.5 DEPOSIT ABSOLUTE /end AXIS_DESCR
/end CHARACTERISTIC
/begin CHARACTERISTIC PFltCD_DebSRCHighDefTPre_C "Fehlerentprellzeit SRC-High-Fehler für die Abgastemperatur vor dem Partikelfilter" VALUE 0xEBF42 Kw_Wu16 655350.0 Time_ms 0.00 655350.0 FORMAT "%8.1" /end CHARACTERISTIC
/begin CHARACTERISTIC PFltCD_DebSRCHighOkTPre_C "Heilungsentprellzeit SRC-High für die Abgastemperatur vor dem Partikelfilter" VALUE 0xEBF44 Kw_Wu16 655350.0 Time_ms 0.00 655350.0 FORMAT "%8.1" /end CHARACTERISTIC
/begin CHARACTERISTIC PFltCD_DebSRCHiDefPPre_C "Entprellzeit: obere SRC Grenze überschritten" VALUE 0xEBE9E Kw_Wu16 655350.0 Time_ms 0.00 655350.0 FORMAT "%8.1" /end CHARACTERISTIC
/begin CHARACTERISTIC PFltCD_DebSRCHiOkPPre_C "Entprellzeit: obere Grenzwertverletzung geheilt" VALUE 0xEBEA0 Kw_Wu16 655350.0 Time_ms 0.00 655350.0 FORMAT "%8.1" /end CHARACTERISTIC
/begin CHARACTERISTIC PFltCD_DebSRCLoDefPPre_C "Entprellzeit: untere SRC Grenze überschritten" VALUE 0xEBEA2 Kw_Wu16 655350.0 Time_ms 0.00 655350.0 FORMAT "%8.1" /end CHARACTERISTIC
/begin CHARACTERISTIC PFltCD_DebSRCLoOkPPre_C "Entprellzeit: untere Grenzwertverletzung geheilt" VALUE 0xEBEA4 Kw_Wu16 655350.0 Time_ms 0.00 655350.0 FORMAT "%8.1" /end CHARACTERISTIC
/begin CHARACTERISTIC PFltCD_DebSRCLowDefTPre_C "Fehlerentprellzeit SRC-Low-Fehler für die Abgastemperatur vor dem Partikelfilter" VALUE 0xEBF46 Kw_Wu16 655350.0 Time_ms 0.00 655350.0 FORMAT "%8.1" /end CHARACTERISTIC
/begin CHARACTERISTIC PFltCD_DebSRCLowOkTPre_C "Heilungsentprellzeit SRC-Low für die Abgastemperatur vor dem Partikelfilter" VALUE 0xEBF48 Kw_Wu16 655350.0 Time_ms 0.00 655350.0 FORMAT "%8.1" /end CHARACTERISTIC
/begin CHARACTERISTIC PFltCD_dtRmpSlpUpPPre_C "Rampensteigung bei Heilung/Vorgabewert für Absolutdrucksensor vor dem Partikelfilter" VALUE 0xEBEA8 Kw_Wu32 65535999.9847 RmpPres 0.00 65535999.9847 FORMAT "%14.4" /end CHARACTERISTIC
/begin CHARACTERISTIC PFltCD_dtRmpSlpDwnPPre_C "Rampensteigung bei Heilung/Vorgabewert für Abolutdrucksensor vor dem Partikelfilter" VALUE 0xEBEAC Kw_Wu32 65535999.9847 RmpPres 0.00 65535999.9847 FORMAT "%14.4" /end CHARACTERISTIC
/begin CHARACTERISTIC PFltCD_dtRmpSlpUpPre_C "Aufw.-Schritt für Rampe der Abgastemperatur vor dem Partikelfilter" VALUE 0xEBF4C Kw_Wu32 6553599.99847 RmpTemp 0.00 6553599.99847 FORMAT "%13.5" /end CHARACTERISTIC
/begin CHARACTERISTIC PFltCD_dtRmpSlpDwnPre_C "Abw.-Schritt für Rampe der Abgastemperatur vor dem Partikelfilter" VALUE 0xEBF50 Kw_Wu32 6553599.99847 RmpTemp 0.00 6553599.99847 FORMAT "%13.5" /end CHARACTERISTIC
/begin CHARACTERISTIC PFLTCD_numAdc2_C "#SSD application parameter for Exhaust Temperature sensor 1" VALUE 0xEBEB0 Kw_Wu8 26.0000000000 NumPinAdc 0.00 26.0000000000 FORMAT "%13.10" /end CHARACTERISTIC
/begin CHARACTERISTIC PFLTCD_numAdc_C "#SSD application parameter for Exhaust Temperature Sensor 1" VALUE 0xEBF54 Kw_Wu8 26.0000000000 NumPinAdc 0.00 26.0000000000 FORMAT "%13.10" /end CHARACTERISTIC
/begin CHARACTERISTIC PFltCD_pPreCor_CUR "" CURVE 0xEBEB2 Kl_Xs16_Ws16 50000.00 Pres 0.00 50000.00 FORMAT "%9.2" EXTENDED_LIMITS -32768.00 32767.00
 /begin AXIS_DESCR STD_AXIS PFlt_dvol CubMtrPerHr 16 -3276.800 3276.700 FORMAT "%8.3" DEPOSIT ABSOLUTE /end AXIS_DESCR
/end CHARACTERISTIC
/begin CHARACTERISTIC PFltCD_tiPPrePT1_C "Zeitkonstante des PT1 Filters" VALUE 0xEBEF4 Kw_Wu32 4294.9673 TimeDelay_s 0.0000010000000 4294.9673 FORMAT "%9.4" /end CHARACTERISTIC
/begin CHARACTERISTIC PFltCD_tPreCor_CUR "" CURVE 0xEBF56 Kl_Xs16_Ws16 400.2000 TempDiff_Cels -200.1000 200.1000 FORMAT "%8.4" EXTENDED_LIMITS -3276.800 3276.700
 /begin AXIS_DESCR STD_AXIS PFlt_dmEG AirMassPerTime 16 -3276.800 3276.700 FORMAT "%8.3" DEPOSIT ABSOLUTE /end AXIS_DESCR
/end CHARACTERISTIC
/begin CHARACTERISTIC PFltCD_stSensIDWordPPre_C "Geberkennwort für Abgasdruck vor dem Partikelfilter" VALUE 0xEBEF8 Kw_Wu16 65535.00 OneToOne 0.00 65535.00 FORMAT "%8.2" /end CHARACTERISTIC
/begin CHARACTERISTIC PFltCD_pDflPre_C "Vorgabewert für Absolutdruck vor dem Partikelfilter" VALUE 0xEBEFA Kw_Ws16 50000.00 Pres 0.00 50000.00 FORMAT "%9.2" EXTENDED_LIMITS -32768.00 32767.00 /end CHARACTERISTIC
/begin CHARACTERISTIC PFltCD_stSensIDWordTPre_C "Geberkennwort für Abgastemperatur vor dem Partikelfilter" VALUE 0xEBF98 Kw_Wu16 65535.00 OneToOne 0.00 65535.00 FORMAT "%8.2" /end CHARACTERISTIC
/begin CHARACTERISTIC PFltCD_tDflPre_C "Vorgabewert für die Abgastemperatur vor dem Partikelfilter" VALUE 0xEBF9A Kw_Ws16 950.000 Temp_Cels -50.14000 899.860 FORMAT "%8.3" EXTENDED_LIMITS -3549.940 3003.560 /end CHARACTERISTIC
/begin CHARACTERISTIC PFlt_aVehFltAshCorMax_C "maximal zulässiger Wert Fahrzeugbeschleunigung" VALUE 0xEA370 Kw_Ws16 10.00000 Acc 0.00 10.00000 FORMAT "%8.5" EXTENDED_LIMITS -32.76800 32.76700 /end CHARACTERISTIC
/begin CHARACTERISTIC PFlt_aVehFltAshCorMin_C "minimal zulässiger Wert Fahrzeugbeschleunigung" VALUE 0xEA372 Kw_Ws16 20.00000 Acc -10.00000 10.00000 FORMAT "%8.5" EXTENDED_LIMITS -32.76800 32.76700 /end CHARACTERISTIC
/begin CHARACTERISTIC PFlt_ctAshCorRgnMax_C "Counteranzahl für Maximumzähler der AshCor Regeneration" VALUE 0xEA374 Kw_Wu16 65535.00 OneToOne 0.00 65535.00 FORMAT "%8.2" /end CHARACTERISTIC
/begin CHARACTERISTIC PFlt_ctAshCorRgn_C "Counterzahl für gültige AshCor Regeneration" VALUE 0xEA376 Kw_Wu16 65535.00 OneToOne 0.00 65535.00 FORMAT "%8.2" /end CHARACTERISTIC
/begin CHARACTERISTIC PFlt_facAshCorOld_C "Faktor für den alten Aschekorrekturwert" VALUE 0xEA378 Kw_Ws16 65535.00 OneToOne -32768.00 32767.00 FORMAT "%8.2" /end CHARACTERISTIC
/begin CHARACTERISTIC PFlt_facAshOil_C "Faktor für Aschenöl" VALUE 0xEA37A Kw_Ws16 65535.00 OneToOne -32768.00 32767.00 FORMAT "%8.2" /end CHARACTERISTIC
/begin CHARACTERISTIC PFlt_facFlTotCor_C "Gesamtmenge Kraftstoffkorrekturfaktor" VALUE 0xEA37C Kw_Ws16 1.000000 Fact 0.00 1.000000 FORMAT "%8.6" EXTENDED_LIMITS -4.000000 3.999878 /end CHARACTERISTIC
/begin CHARACTERISTIC PFlt_faclAshCor_C "Aschenkorrekturfaktor." VALUE 0xEA37E Kw_Wu16 65535.00 OneToOne 0.00 65535.00 FORMAT "%8.2" /end CHARACTERISTIC
/begin CHARACTERISTIC PFlt_lAshCorMax_C "Maximaler Kilometerstand" VALUE 0xEA380 Kw_Ws16 32767.00 LengthKm 0.00 32767.00 FORMAT "%8.2" EXTENDED_LIMITS -32768.00 32767.00 /end CHARACTERISTIC
/begin CHARACTERISTIC PFlt_lAshCorNextDef_C "Lesen des Wertes aus dem Eeprom nicht erfolgreich; diesen Wert verwenden" VALUE 0xEA384 Kw_Wu32 4294967295.00 LengthKm 0.00 4294967295.00 FORMAT "%13.2" /end CHARACTERISTIC
/begin CHARACTERISTIC PFlt_lAshCorNplAbsRel_C "Kilometerzahl, welche bei erkanntem relativen und absoluten Fehler addiert wird" VALUE 0xEA388 Kw_Ws16 32767.00 LengthKm 0.00 32767.00 FORMAT "%8.2" EXTENDED_LIMITS -32768.00 32767.00 /end CHARACTERISTIC
/begin CHARACTERISTIC PFlt_lAshCorNplAbs_C "plausibler Wert für den absoluten Kilometerstand" VALUE 0xEA38A Kw_Ws16 32767.00 LengthKm 0.00 32767.00 FORMAT "%8.2" EXTENDED_LIMITS -32768.00 32767.00 /end CHARACTERISTIC
/begin CHARACTERISTIC PFlt_lAshCorNplRel_C "plausibler Wert für den relativen Kilometerstand" VALUE 0xEA38C Kw_Ws16 32767.00 LengthKm 0.00 32767.00 FORMAT "%8.2" EXTENDED_LIMITS -32768.00 32767.00 /end CHARACTERISTIC
/begin CHARACTERISTIC PFlt_lAshCorRegIntr_C "Regenerationsunterbrechung Kilometerstand" VALUE 0xEA38E Kw_Ws16 32767.00 LengthKm 0.00 32767.00 FORMAT "%8.2" EXTENDED_LIMITS -32768.00 32767.00 /end CHARACTERISTIC
/begin CHARACTERISTIC PFlt_lMinSnceRgn_C "Minimaler Abstand seit letzter Regeneration." VALUE 0xEA390 Kw_Wu32 2147483647.00 Length 0.00 2147483647.00 FORMAT "%13.2" EXTENDED_LIMITS 0.00 4294967295.00 /end CHARACTERISTIC
/begin CHARACTERISTIC PFlt_mAshCor_MAP "Map für Ascheabweichung vom Sollwert" MAP 0xEA394 Kf_Xs16_Ys16_Ws16 400.0000 mSoot_g -100.0000 300.0000 FORMAT "%8.4" EXTENDED_LIMITS -327.6800 327.6700
 /begin AXIS_DESCR STD_AXIS PFlt_dVolFltAshCor_mp CubMtrPerHr 8 0.00 3000.000 FORMAT "%8.3" EXTENDED_LIMITS -3276.800 3276.700 DEPOSIT ABSOLUTE /end AXIS_DESCR
 /begin AXIS_DESCR STD_AXIS PFlt_resFlowFltAshCor_mp Res_hPaHrPerCM 8 0.00 25.00000 FORMAT "%8.5" EXTENDED_LIMITS -32.76800 32.76700 DEPOSIT ABSOLUTE /end AXIS_DESCR
/end CHARACTERISTIC
/begin CHARACTERISTIC PFlt_mAshTolcAbs_C "" VALUE 0xEA438 Kw_Ws16 300.0000 mSoot_g 0.00 300.0000 FORMAT "%8.4" EXTENDED_LIMITS -327.6800 327.6700 /end CHARACTERISTIC
/begin CHARACTERISTIC PFlt_mAshTolcMaxAbs_C "maximal erlaubte absolute Abweichung des neu berechneten Aschewertes" VALUE 0xEA43A Kw_Ws16 300.0000 mSoot_g 0.00 300.0000 FORMAT "%8.4" EXTENDED_LIMITS -327.6800 327.6700 /end CHARACTERISTIC
/begin CHARACTERISTIC PFlt_mAshTolcMaxRel_C "maximal erlaubte relative Abweichung der neu berechneten Aschemenge" VALUE 0xEA43C Kw_Ws16 300.0000 mSoot_g 0.00 300.0000 FORMAT "%8.4" EXTENDED_LIMITS -327.6800 327.6700 /end CHARACTERISTIC
/begin CHARACTERISTIC PFlt_nAvrgFltAshCorMax_C "maximal zulässiger Wert Drehzahl" VALUE 0xEA43E Kw_Ws16 6000.000 EngN 0.00 6000.000 FORMAT "%8.3" EXTENDED_LIMITS -32768.00 32767.00 /end CHARACTERISTIC
/begin CHARACTERISTIC PFlt_nAvrgFltAshCorMin_C "minimal zulässiger Wert Drehzahl" VALUE 0xEA440 Kw_Ws16 6000.000 EngN 0.00 6000.000 FORMAT "%8.3" EXTENDED_LIMITS -32768.00 32767.00 /end CHARACTERISTIC
/begin CHARACTERISTIC PFlt_numAshCorMsk_C "Maske für gültige AshCor Regeneration, Eingang ist der Status PFlt_stEngPOp" VALUE 0xEA442 Kw_Wu16 65535.00 OneToOne 0.00 65535.00 FORMAT "%8.2" /end CHARACTERISTIC
/begin CHARACTERISTIC PFlt_numAshCor_C "AshCor-Schalterwert" VALUE 0xEA444 Kw_Wu8 11.00 OneToOne 0.00 11.00 FORMAT "%5.2" EXTENDED_LIMITS 0.00 255.0 /end CHARACTERISTIC
/begin CHARACTERISTIC PFlt_numPFltErrRgnIntr_C "" VALUE 0xEA445 Kw_Wu8 8.000 OneToOne 0.00 8.000 FORMAT "%5.3" EXTENDED_LIMITS 0.00 255.0 /end CHARACTERISTIC
/begin CHARACTERISTIC PFlt_numPFltErr_C "Constant for CSF Limp - Home" VALUE 0xEA446 Kw_Wu8 8.000 OneToOne 0.00 8.000 FORMAT "%5.3" EXTENDED_LIMITS 0.00 255.0 /end CHARACTERISTIC
/begin CHARACTERISTIC PFlt_qFlTotMin_C "Unterere Grenze für Gesamtmenge Kraftstoffquantität" VALUE 0xEA448 Kw_Ws16 320.0000 Fl_2 0.00 320.0000 FORMAT "%8.4" EXTENDED_LIMITS -327680.0 327670.0 /end CHARACTERISTIC
/begin CHARACTERISTIC PFlt_qSetUnBalFltAshCorMax_C "maximal zulässiger Wert aktuelle Einspritzmenge" VALUE 0xEA44A Kw_Ws16 327.6700 InjMassCyc 0.00 327.6700 FORMAT "%8.4" EXTENDED_LIMITS -327.6800 327.6700 /end CHARACTERISTIC
/begin CHARACTERISTIC PFlt_qSetUnBalFltAshCorMin_C "minimal zulässiger Wert aktuelle Einspritzmenge" VALUE 0xEA44C Kw_Ws16 327.6700 InjMassCyc 0.00 327.6700 FORMAT "%8.4" EXTENDED_LIMITS -327.6800 327.6700 /end CHARACTERISTIC
/begin CHARACTERISTIC PFlt_swtAshCorActive_C "generelle Aktivierung der Ascheabgleich-Funktion (1=Funktion aktiv, 0=Inaktiev)" VALUE 0xEA44E Kw_Wu8 1.000 OneToOne 0.00 1.000 FORMAT "%5.3" EXTENDED_LIMITS 0.00 255.0 /end CHARACTERISTIC
/begin CHARACTERISTIC PFlt_swtAshCorOn_C "Statusschwelle Aschekorrektur (1: Regneration erkannt, Ascheabgleichtimer gestrted; 0: keine Regeneration erkannt)" VALUE 0xEA44F Kw_Wu8 4.000 OneToOne 0.00 4.000 FORMAT "%5.3" EXTENDED_LIMITS 0.00 255.0 /end CHARACTERISTIC
/begin CHARACTERISTIC PFlt_tAirFltAshCorMax_C "maximal zulässiger Wert Lufttemperatur" VALUE 0xEA450 Kw_Ws16 250.0000 Temp_Cels -50.14000 199.8600 FORMAT "%8.4" EXTENDED_LIMITS -3549.940 3003.560 /end CHARACTERISTIC
/begin CHARACTERISTIC PFlt_tAirFltAshCorMin_C "minimal zulässiger Wert Lufttemperatur" VALUE 0xEA452 Kw_Ws16 250.0000 Temp_Cels -50.14000 199.8600 FORMAT "%8.4" EXTENDED_LIMITS -3549.940 3003.560 /end CHARACTERISTIC
/begin CHARACTERISTIC PFlt_tCIntAshCorMax_C "maximal zulässiger Wert Kühlmitteltemperatur" VALUE 0xEA454 Kw_Ws16 250.0000 Temp_Cels -50.14000 199.8600 FORMAT "%8.4" EXTENDED_LIMITS -3549.940 3003.560 /end CHARACTERISTIC
/begin CHARACTERISTIC PFlt_tCIntAshCorMin_C "minimal zulässiger Wert Kühlmitteltemperatur" VALUE 0xEA456 Kw_Ws16 250.0000 Temp_Cels -50.14000 199.8600 FORMAT "%8.4" EXTENDED_LIMITS -3549.940 3003.560 /end CHARACTERISTIC
/begin CHARACTERISTIC PFlt_tiAshCorAirTempPT1_C "Zeitkonstante Lufttemperatur" VALUE 0xEA458 Kw_Wu32 4294.8273 TimeDelay_s 0.14000154 4294.9673 FORMAT "%9.4" EXTENDED_LIMITS 0.0000010000000 4294.9673 /end CHARACTERISTIC
/begin CHARACTERISTIC PFlt_tiAshCorCIntTempPT1_C "Zeitkonstante Kühlmitteltemperatur" VALUE 0xEA45C Kw_Wu32 4294.8273 TimeDelay_s 0.14000154 4294.9673 FORMAT "%9.4" EXTENDED_LIMITS 0.0000010000000 4294.9673 /end CHARACTERISTIC
/begin CHARACTERISTIC PFlt_tiAshCorDVolPT1_C "Zeitkonstante Abgasvolumenstrom vor PFlt" VALUE 0xEA460 Kw_Wu32 4294.8273 TimeDelay_s 0.14000154 4294.9673 FORMAT "%9.4" EXTENDED_LIMITS 0.0000010000000 4294.9673 /end CHARACTERISTIC
/begin CHARACTERISTIC PFlt_tiAshCorEngSpdPT1_C "Zeitkonstante Drehzahl" VALUE 0xEA464 Kw_Wu32 4294.8273 TimeDelay_s 0.14000154 4294.9673 FORMAT "%9.4" EXTENDED_LIMITS 0.0000010000000 4294.9673 /end CHARACTERISTIC
/begin CHARACTERISTIC PFlt_tiAshCorInjMsPT1_C "Zeitkonstante aktuelle Einspritzmasse" VALUE 0xEA468 Kw_Wu32 4294.8273 TimeDelay_s 0.14000154 4294.9673 FORMAT "%9.4" EXTENDED_LIMITS 0.0000010000000 4294.9673 /end CHARACTERISTIC
/begin CHARACTERISTIC PFlt_tiAshCorOxiTempPT1_C "Zeitkonstante OxiKat-Temperatur" VALUE 0xEA46C Kw_Wu32 4294.8273 TimeDelay_s 0.14000154 4294.9673 FORMAT "%9.4" EXTENDED_LIMITS 0.0000010000000 4294.9673 /end CHARACTERISTIC
/begin CHARACTERISTIC PFlt_tiAshCorPreTempPT1_C "Zeitkonstante Vortemperatur Partikelfilter" VALUE 0xEA470 Kw_Wu32 4294.8273 TimeDelay_s 0.14000154 4294.9673 FORMAT "%9.4" EXTENDED_LIMITS 0.0000010000000 4294.9673 /end CHARACTERISTIC
/begin CHARACTERISTIC PFlt_tiAshCorResFlowPT1_C "Zeitkonstante gefilterter Stromwiderstand" VALUE 0xEA474 Kw_Wu32 4294.8273 TimeDelay_s 0.14000154 4294.9673 FORMAT "%9.4" EXTENDED_LIMITS 0.0000010000000 4294.9673 /end CHARACTERISTIC
/begin CHARACTERISTIC PFlt_tiAshCorRlsOn_C "Entprellzeit Simulation EIN" VALUE 0xEA478 Kw_Wu16 655140.0 Time_ms 0.00 655140.0 FORMAT "%8.1" EXTENDED_LIMITS 0.00 655350.0 /end CHARACTERISTIC
/begin CHARACTERISTIC PFlt_tiAshCorVehAccPT1_C "Zeitkonstante Fahrzeugbeschleunigung" VALUE 0xEA47C Kw_Wu32 4294.8273 TimeDelay_s 0.14000154 4294.9673 FORMAT "%9.4" EXTENDED_LIMITS 0.0000010000000 4294.9673 /end CHARACTERISTIC
/begin CHARACTERISTIC PFlt_tiAshCorVehSpdPT1_C "Zeitkonstante Fahrzeuggeschwindigkeit" VALUE 0xEA480 Kw_Wu32 4294.8273 TimeDelay_s 0.14000154 4294.9673 FORMAT "%9.4" EXTENDED_LIMITS 0.0000010000000 4294.9673 /end CHARACTERISTIC
/begin CHARACTERISTIC PFlt_tiAshCorWaitMax_C "Regenerationsdauer" VALUE 0xEA484 Kw_Wu32 655140.000000 Time_s 0.00 655140.000000 FORMAT "%13.6" EXTENDED_LIMITS 0.00 42949672.9500 /end CHARACTERISTIC
/begin CHARACTERISTIC PFlt_tiPFltErrPer_C "" VALUE 0xEA488 Kw_Wu16 655350.0 TimePFltLimpHome 0.00 655350.0 FORMAT "%8.1" /end CHARACTERISTIC
/begin CHARACTERISTIC PFlt_tiPFltErrRgn_C "" VALUE 0xEA48A Kw_Wu16 655350.0 TimePFltLimpHome 0.00 655350.0 FORMAT "%8.1" /end CHARACTERISTIC
/begin CHARACTERISTIC PFlt_tOxiPreFltAshCorMax_C "maximal zulässiger Wert Temperatur vor dem OxiKat" VALUE 0xEA48C Kw_Ws16 950.000 Temp_Cels -50.140 899.860 FORMAT "%8.3" EXTENDED_LIMITS -3549.940 3003.560 /end CHARACTERISTIC
/begin CHARACTERISTIC PFlt_tOxiPreFltAshCorMin_C "minimal zulässiger Wert Temperatur vor dem OxiKat" VALUE 0xEA48E Kw_Ws16 950.000 Temp_Cels -50.140 899.860 FORMAT "%8.3" EXTENDED_LIMITS -3549.940 3003.560 /end CHARACTERISTIC
/begin CHARACTERISTIC PFlt_tPreFltAshCorMax_C "maximal zulässiger Wert Vortemperatur Partikelfilter" VALUE 0xEA490 Kw_Ws16 950.000 Temp_Cels -50.140 899.860 FORMAT "%8.3" EXTENDED_LIMITS -3549.940 3003.560 /end CHARACTERISTIC
/begin CHARACTERISTIC PFlt_tPreFltAshCorMin_C "minimal zulässiger Wert Vortemperatur Partikelfilter" VALUE 0xEA492 Kw_Ws16 950.000 Temp_Cels -50.140 899.860 FORMAT "%8.3" EXTENDED_LIMITS -3549.940 3003.560 /end CHARACTERISTIC
/begin CHARACTERISTIC PFlt_vVehFltAshCorMax_C "maximal zulässiger Wert Fahrzeuggeschwindigkeit" VALUE 0xEA494 Kw_Ws16 300.0000 Vel 0.00 300.0000 FORMAT "%8.4" EXTENDED_LIMITS -327.6800 327.6700 /end CHARACTERISTIC
/begin CHARACTERISTIC PFlt_vVehFltAshCorMin_C "minimal zulässiger Wert Fahrzeuggeschwindigkeit" VALUE 0xEA496 Kw_Ws16 300.0000 Vel 0.00 300.0000 FORMAT "%8.4" EXTENDED_LIMITS -327.6800 327.6700 /end CHARACTERISTIC
/begin MEASUREMENT PCR_bpMap_mp "Calculation of the correction factor based on atmospheric factor" UBYTE OneToOne 1 100 0.00 255.0 FORMAT "%5.1" ECU_ADDRESS 0x8FF7C7 /end MEASUREMENT
/begin MEASUREMENT PCR_DKd_mp "Kleinsignalverstärkung des Regler-DT1-Anteils" SLONG Kd_Pres2Prc 1 100 -400.000000000 399.999999814 FORMAT "%12.9" ECU_ADDRESS 0x8FF808 /end MEASUREMENT
/begin MEASUREMENT PCR_dn_mp "value of engine speed gradient" SWORD dn_dZ20 1 100 -327680.0 327670.0 FORMAT "%8.1" ECU_ADDRESS 0x8FF80C /end MEASUREMENT
/begin MEASUREMENT PCR_dpBDesRaw_mp "Derivative of unlimited desired boost pressure with preconttrol" SWORD dp_dZ20 1 100 -327680.0 327670.0 FORMAT "%8.1" ECU_ADDRESS 0x8FF7C8 /end MEASUREMENT
/begin MEASUREMENT PCR_dpBGDev_mp "Ladedruckgradient" SWORD dp_dZ20 1 100 -327680.0 327670.0 FORMAT "%8.1" ECU_ADDRESS 0x8FF80E /end MEASUREMENT
/begin MEASUREMENT PCR_dqCtlA "Ableitung der Kraftstoffmasse" SWORD InjMassPerSec_20ms 1 100 -16384.00 16383.50 FORMAT "%8.2" ECU_ADDRESS 0x7F8FAC /end MEASUREMENT
/begin MEASUREMENT PCR_dqDes_mp "Einspritzmengen-Änderung" SWORD InjMassPerSec_20ms 1 100 -16384.00 16383.50 FORMAT "%8.2" ECU_ADDRESS 0x8FF7CA /end MEASUREMENT
/begin MEASUREMENT PCR_drAPP1UnFlt_mp "Measuring point for ratio of Accelerator pedal 1 position - Unfiltered value" SWORD PrcPerSec 1 100 -20000.00 19999.39 FORMAT "%8.2" ECU_ADDRESS 0x8FF7CC /end MEASUREMENT
/begin MEASUREMENT PCR_facAdPCVc1_mp "Faktor c1 zur Bestimmung des VorSteuerkennfeldes der Ladedruckregelung" SWORD Fact 1 100 -4.000000 3.999878 FORMAT "%8.6" ECU_ADDRESS 0x8FF810 /end MEASUREMENT
/begin MEASUREMENT PCR_facAdPCVc2_mp "Faktor c2 zur Bestimmung des VorSteuerkennfeldes der Ladedruckregelung" SWORD Fact 1 100 -4.000000 3.999878 FORMAT "%8.6" ECU_ADDRESS 0x8FF812 /end MEASUREMENT
/begin MEASUREMENT PCR_facAdPCVc3_mp "Faktor c3 zur Bestimmung des VorSteuerkennfeldes der Ladedruckregelung" SWORD Fact 1 100 -4.000000 3.999878 FORMAT "%8.6" ECU_ADDRESS 0x8FF814 /end MEASUREMENT
/begin MEASUREMENT PCR_facAdPCVc4_mp "Faktor c4 zur Bestimmung des VorSteuerkennfeldes der Ladedruckregelung" SWORD Fact 1 100 -4.000000 3.999878 FORMAT "%8.6" ECU_ADDRESS 0x8FF816 /end MEASUREMENT
/begin MEASUREMENT PCR_facAdPCVrx_mp "Faktor rx zur Bestimmung des VorSteuerkennfeldes der Ladedruckregelung" SWORD Fact 1 100 -4.000000 3.999878 FORMAT "%8.6" ECU_ADDRESS 0x8FF818 /end MEASUREMENT
/begin MEASUREMENT PCR_facAdPCVry_mp "Faktor ry zur Bestimmung des VorSteuerkennfeldes der Ladedruckregelung" SWORD Fact 1 100 -4.000000 3.999878 FORMAT "%8.6" ECU_ADDRESS 0x8FF81A /end MEASUREMENT
/begin MEASUREMENT PCR_facAirAmplFlt_mp "Amplitudenhöhe der oszillierenden Frischluftmasse beim Laderpumpen" SWORD FactM 1 100 -2048.000 2047.938 FORMAT "%8.3" ECU_ADDRESS 0x8FF8BC /end MEASUREMENT
/begin MEASUREMENT PCR_facAirPerTimeAmplFlt "Amplitudenhöhe der oszillierenden Frischluftmasse beim La-derpumpen tiefpassgefiltert" SWORD FactM 1 100 -2048.000 2047.938 FORMAT "%8.3" ECU_ADDRESS 0x7F8FAE /end MEASUREMENT
/begin MEASUREMENT PCR_facAirPerTimeAmplFlt_mp "Amplitudenhöhe der oszillierenden Frischluftmasse beim Laderpumpen nach DFT tiefpassgefilter (PT1)" SWORD FactM 1 100 -2048.000 2047.938 FORMAT "%8.3" ECU_ADDRESS 0x8FF8BE /end MEASUREMENT
/begin MEASUREMENT PCR_facAirPerTimeAmpl_mp "Amplitudenhöhe der oszillierenden Frischluftmasse beim Laderpumpen nach DFT" SWORD FactM 1 100 -2048.000 2047.938 FORMAT "%8.3" ECU_ADDRESS 0x8FF8C0 /end MEASUREMENT
/begin MEASUREMENT PCR_facAirPTAmpl1_mp "Amplitudenhöhe der oszillierenden Frischluftmasse beim Laderpumpen (nach PT1-Ctl1)" SWORD FactM 1 100 -2048.000 2047.938 FORMAT "%8.3" ECU_ADDRESS 0x8FF8C2 /end MEASUREMENT
/begin MEASUREMENT PCR_facAirPTAmpl2Flt_mp "Amplitudenhöhe der oszillierenden Frischluftmasse beim Laderpumpen (nach PT1-Ctl2)" SWORD FactM 1 100 -2048.000 2047.938 FORMAT "%8.3" ECU_ADDRESS 0x8FF8C4 /end MEASUREMENT
/begin MEASUREMENT PCR_facAirPTAmpl2_mp "Amplitudenhöhe der oszillierenden Frischluftmasse beim Laderpumpen (früher PT1-Ctl2)" SWORD FactM 1 100 -2048.000 2047.938 FORMAT "%8.3" ECU_ADDRESS 0x8FF8C6 /end MEASUREMENT
/begin MEASUREMENT PCR_facATRgn_mp "lufttemperaturabhängigerKorrekturfactor bei Regenerationsbetrieb" SWORD Fact 1 100 -4.000000 3.999878 FORMAT "%8.6" ECU_ADDRESS 0x8FF7CE /end MEASUREMENT
/begin MEASUREMENT PCR_facAT_mp "Lufttemperaturabhängiger Faktor für Sollwertberechnung" SWORD Fact 1 100 -4.000000 3.999878 FORMAT "%8.6" ECU_ADDRESS 0x8FF7D0 /end MEASUREMENT
/begin MEASUREMENT PCR_facCosCoeffDFT_mp "Kosinuskoeffizient der Fouriertransformation" SLONG FactM 1 100 -134217728.000 134217727.938 FORMAT "%13.3" ECU_ADDRESS 0x8FF8C8 /end MEASUREMENT
/begin MEASUREMENT PCR_facCtQ_mp "Kühltemperaturabhängiger Faktor für Sollwertberechnung" SWORD Fact 1 100 -4.000000 3.999878 FORMAT "%8.6" ECU_ADDRESS 0x8FF7D2 /end MEASUREMENT
/begin MEASUREMENT PCR_facD1_mp "Adaptionsfaktor für Regler-D-Verstärkung" SWORD Fact1 1 100 -256.0000 255.9922 FORMAT "%8.4" ECU_ADDRESS 0x8FF81C /end MEASUREMENT
/begin MEASUREMENT PCR_facDnCorr_mp "corrective factor based on engine speed gradient" SWORD Fact1 1 100 -256.0000 255.9922 FORMAT "%8.4" ECU_ADDRESS 0x8FF81E /end MEASUREMENT
/begin MEASUREMENT PCR_facDpCorr_mp "Korrekturfaktor für D-Parameter Korrektur aus dem Ladedruckgradienten" SWORD Fact1 1 100 -256.0000 255.9922 FORMAT "%8.4" ECU_ADDRESS 0x8FF820 /end MEASUREMENT
/begin MEASUREMENT PCR_facD_mp "Adaptionsfaktor für Regler-D-Verstärkung" SWORD Fact1 1 100 -256.0000 255.9922 FORMAT "%8.4" ECU_ADDRESS 0x8FF822 /end MEASUREMENT
/begin MEASUREMENT PCR_facI_mp "Adaptionsfaktor für Regler-I-Verstärkung" SWORD Fact1 1 100 -256.0000 255.9922 FORMAT "%8.4" ECU_ADDRESS 0x8FF824 /end MEASUREMENT
/begin MEASUREMENT PCR_facmSotCorr_mp "Adaption factor for D-Govrnr. Parameter" SWORD Fact1 1 100 -256.0000 255.9922 FORMAT "%8.4" ECU_ADDRESS 0x8FF826 /end MEASUREMENT
/begin MEASUREMENT PCR_facN_mp "Faktor für Berücksichtigung der Drehzahl DesValCalc" SWORD Fact 1 100 -4.000000 3.999878 FORMAT "%8.6" ECU_ADDRESS 0x8FF7D4 /end MEASUREMENT
/begin MEASUREMENT PCR_facP_mp "Adaptionsfaktor für Regler-P-Verstärkung" SWORD Fact1 1 100 -256.0000 255.9922 FORMAT "%8.4" ECU_ADDRESS 0x8FF828 /end MEASUREMENT
/begin MEASUREMENT PCR_facSGDevI_mp "I Regelabweichung AntiSurge-Regler" SWORD FactM 1 100 -2048.000 2047.938 FORMAT "%8.3" ECU_ADDRESS 0x8FF8A0 /end MEASUREMENT
/begin MEASUREMENT PCR_facSinCoeffDFT_mp "Sinuskoeffizient der Fouriertransformation" SLONG FactM 1 100 -134217728.000 134217727.938 FORMAT "%13.3" ECU_ADDRESS 0x8FF8CC /end MEASUREMENT
/begin MEASUREMENT PCR_facSinIn_mp "Kennlinieeingangsgröße für den Ersatz der Sinusfunktion durch die Kennlinie" SWORD Fact1 1 100 -256.0000 255.9922 FORMAT "%8.4" ECU_ADDRESS 0x8FF8D0 /end MEASUREMENT
/begin MEASUREMENT PCR_facSinOut_mp "Kennlinieausgangsgröße für den Ersatz der Sinusfunktion durch Kennlinie" SWORD Fact 1 100 -4.000000 3.999878 FORMAT "%8.6" ECU_ADDRESS 0x8FF8D2 /end MEASUREMENT
/begin MEASUREMENT PCR_facSqrIn_mp "Kennlinieeingangsgröße für den Ersatz der Quadratwurzelfunktion durch die Kennlinie" SWORD FactM 1 100 -2048.000 2047.938 FORMAT "%8.3" ECU_ADDRESS 0x8FF8D4 /end MEASUREMENT
/begin MEASUREMENT PCR_facSurgeDes_mp "Sollwert Luftmassenschwingung(AntiSurge-Regler)" SWORD FactM 1 100 -2048.000 2047.938 FORMAT "%8.3" ECU_ADDRESS 0x8FF8A2 /end MEASUREMENT
/begin MEASUREMENT PCR_facSurgeGvnrDev_mp "Regelabweichung AntiSurge-Regler" SWORD FactM 1 100 -2048.000 2047.938 FORMAT "%8.3" ECU_ADDRESS 0x8FF8A4 /end MEASUREMENT
/begin MEASUREMENT PCR_facSurgeI_mp "Adaptionsfaktor für I-Reglerverstärkung" SWORD Fact1 1 100 -256.0000 255.9922 FORMAT "%8.4" ECU_ADDRESS 0x8FF8A6 /end MEASUREMENT
/begin MEASUREMENT PCR_facSurgeP_mp "Adaptionsfaktor für P-Reglerverstärkung" SWORD Fact1 1 100 -256.0000 255.9922 FORMAT "%8.4" ECU_ADDRESS 0x8FF8A8 /end MEASUREMENT
/begin MEASUREMENT PCR_pAPQCmpnRgn_mp "atmosphärendruckabhängigen Korrekturwert bei Regenerationsbetrieb" SWORD Pres 1 100 -32768.00 32767.00 FORMAT "%9.2" ECU_ADDRESS 0x8FF7D6 /end MEASUREMENT
/begin MEASUREMENT PCR_pAPQCmpn_mp "luftdruckabhängige Kompensation für Sollwertbildung" SWORD Pres 1 100 -32768.00 32767.00 FORMAT "%9.2" ECU_ADDRESS 0x8FF7D8 /end MEASUREMENT
/begin MEASUREMENT PCR_pBasMAP_mp "stationärer Ladedrucksollwert aus Basiskennfeld" SWORD Pres 1 100 -32768.00 32767.00 FORMAT "%9.2" ECU_ADDRESS 0x8FF7DA /end MEASUREMENT
/begin MEASUREMENT PCR_pBDesAPCorrRgn1_mp "in Abhängigkeit des atmosphärendruck korrigierter Sollwert aus erstem Regenerationskennfeld" SWORD Pres 1 100 -32768.00 32767.00 FORMAT "%9.2" ECU_ADDRESS 0x8FF7DC /end MEASUREMENT
/begin MEASUREMENT PCR_pBDesAPCorrRgn2_mp "in Abhängigkeit des atmosphärendrucks korrigierter Sollwert aus zweitem Regenerationskennfeld" SWORD Pres 1 100 -32768.00 32767.00 FORMAT "%9.2" ECU_ADDRESS 0x8FF7DE /end MEASUREMENT
/begin MEASUREMENT PCR_pBDesAPCorr_mp "Luftdruckabhängige Korrektur des Ladedrucksollwerts" SWORD Pres 1 100 -32768.00 32767.00 FORMAT "%9.2" ECU_ADDRESS 0x8FF7E0 /end MEASUREMENT
/begin MEASUREMENT PCR_pBDesATCorrRgn1_mp "korrigierter Ladedrucksollwert aus Regenerationskennfeld 1" SWORD Pres 1 100 -32768.00 32767.00 FORMAT "%9.2" ECU_ADDRESS 0x8FF7E2 /end MEASUREMENT
/begin MEASUREMENT PCR_pBDesATCorrRgn2_mp "korriegerter Ladedrucksollwert aus zweitem Regenerationskennfeld 2" SWORD Pres 1 100 -32768.00 32767.00 FORMAT "%9.2" ECU_ADDRESS 0x8FF7E4 /end MEASUREMENT
/begin MEASUREMENT PCR_pBDesATCorr_mp "Bezüglich Lufttemperatur korrigierter Ladedrucksollwert" SWORD Pres 1 100 -32768.00 32767.00 FORMAT "%9.2" ECU_ADDRESS 0x8FF7E6 /end MEASUREMENT
/begin MEASUREMENT PCR_pBDesCtCorr_mp "Kühltemperaturkorrigierter Wert des Ladedrucksollwerts" SWORD Pres 1 100 -32768.00 32767.00 FORMAT "%9.2" ECU_ADDRESS 0x8FF7E8 /end MEASUREMENT
/begin MEASUREMENT PCR_pBDesDyn_mp "Dynamischer Teil des Ladedrucksollwerts" SWORD Pres_hPa 1 100 -32768.00 32767.00 FORMAT "%8.2" ECU_ADDRESS 0x8FF7EA /end MEASUREMENT
/begin MEASUREMENT PCR_pBDesFlt_mp "Output value from PT1 Filter" SWORD Pres_hPa 1 100 -32768.00 32767.00 FORMAT "%8.2" ECU_ADDRESS 0x8FF82A /end MEASUREMENT
/begin MEASUREMENT PCR_pBDesLPUnLim_mp "" SWORD Pres_hPa 1 100 -32768.00 32767.00 FORMAT "%8.2" ECU_ADDRESS 0x8FF86A /end MEASUREMENT
/begin MEASUREMENT PCR_pBDesLP_mp "Gewuenschter Ladedrucksollwert" SWORD Pres_hPa 1 100 -32768.00 32767.00 FORMAT "%8.2" ECU_ADDRESS 0x8FF86C /end MEASUREMENT
/begin MEASUREMENT PCR_pBDesMaxAP_mp "Größter erlaubter Ladedrucksollwert in Abhängigkeit vom Luftdruck" SWORD Pres 1 100 -32768.00 32767.00 FORMAT "%9.2" ECU_ADDRESS 0x8FF7EC /end MEASUREMENT
/begin MEASUREMENT PCR_pBDesNCorr_mp "Boost press. value corr. by eng. spd. fac." SWORD Pres 1 100 -32768.00 32767.00 FORMAT "%9.2" ECU_ADDRESS 0x8FF7EE /end MEASUREMENT
/begin MEASUREMENT PCR_pBDesRaw2_mp "Unlimited desired boost pressure with rampcontrol." SWORD Pres_hPa 1 100 -32768.00 32767.00 FORMAT "%8.2" ECU_ADDRESS 0x8FF7F0 /end MEASUREMENT
/begin MEASUREMENT PCR_pBDesRaw3_mp "Unbegrentzer Laderdrucksollwert mit Vorsterung und Anti Surge Regler" SWORD Pres_hPa 1 100 -32768.00 32767.00 FORMAT "%8.2" ECU_ADDRESS 0x8FF7F2 /end MEASUREMENT
/begin MEASUREMENT PCR_pBDesRaw_mp "Unbegrenzter Ladedrucksollwert mit Vorsteuerung" SWORD Pres_hPa 1 100 -32768.00 32767.00 FORMAT "%8.2" ECU_ADDRESS 0x8FF7F4 /end MEASUREMENT
/begin MEASUREMENT PCR_pBDesStat_mp "Stationärer Teil des Ladedrucksollwerts" SWORD Pres 1 100 -32768.00 32767.00 FORMAT "%9.2" ECU_ADDRESS 0x8FF7F6 /end MEASUREMENT
/begin MEASUREMENT PCR_pBDes_mp "gewälter unbegrenzerter Ladedrucksollwert" SWORD Pres 1 100 -32768.00 32767.00 FORMAT "%9.2" ECU_ADDRESS 0x8FF7F8 /end MEASUREMENT
/begin MEASUREMENT PCR_pBGDev "Regelabweichung" SWORD Pres_hPa 1 100 -32768.00 32767.00 FORMAT "%8.2" ECU_ADDRESS 0x7F8FB2 /end MEASUREMENT
/begin MEASUREMENT PCR_pBGDev2_mp "Deviation I/P for Integrator" SWORD Pres_hPa 1 100 -32768.00 32767.00 FORMAT "%8.2" ECU_ADDRESS 0x8FF82C /end MEASUREMENT
/begin MEASUREMENT PCR_pBGDevI_mp "Regelabweichung für I-Anteil" SWORD Pres_hPa 1 100 -32768.00 32767.00 FORMAT "%8.2" ECU_ADDRESS 0x8FF82E /end MEASUREMENT
/begin MEASUREMENT PCR_pBGDevMaxRaw_mp "messpunkt für Erkennung einer bleibenden Regelabweichung" SWORD Pres_hPa 1 100 -32768.00 32767.00 FORMAT "%8.2" ECU_ADDRESS 0x8FF890 /end MEASUREMENT
/begin MEASUREMENT PCR_pBGDevMax_mp "Maximale Reglerabweichung" SWORD Pres_hPa 1 100 -32768.00 32767.00 FORMAT "%8.2" ECU_ADDRESS 0x8FF892 /end MEASUREMENT
/begin MEASUREMENT PCR_pBGDevMinRaw_mp "messpunkt für Erkennung einer bleibenden Regelabweichung" SWORD Pres_hPa 1 100 -32768.00 32767.00 FORMAT "%8.2" ECU_ADDRESS 0x8FF894 /end MEASUREMENT
/begin MEASUREMENT PCR_pBGDevMin_mp "negative deviation threshold with offset" SWORD Pres_hPa 1 100 -32768.00 32767.00 FORMAT "%8.2" ECU_ADDRESS 0x8FF896 /end MEASUREMENT
/begin MEASUREMENT PCR_pBGDvtLP "Regelabweichung" SWORD Pres_hPa 1 100 -32768.00 32767.00 FORMAT "%8.2" ECU_ADDRESS 0x7F8FB4 /end MEASUREMENT
/begin MEASUREMENT PCR_pBSurgeDes "Sollwert Ladedruck zur Reduktion Laderpumpen" SWORD Pres_hPa 1 100 -32768.00 32767.00 FORMAT "%8.2" ECU_ADDRESS 0x7F8FB6 /end MEASUREMENT
/begin MEASUREMENT PCR_pBSurgeDesMax_mp "maximal zulässige Reglerstellgröße AntiSurge-Regler" SWORD Pres_hPa 1 100 -32768.00 32767.00 FORMAT "%8.2" ECU_ADDRESS 0x8FF8AA /end MEASUREMENT
/begin MEASUREMENT PCR_pBSurgeDesMin_mp "minimal zulässige Reglerstellgröße AntiSurge-Regler" SWORD Pres_hPa 1 100 -32768.00 32767.00 FORMAT "%8.2" ECU_ADDRESS 0x8FF8AC /end MEASUREMENT
/begin MEASUREMENT PCR_pBSurgeDesRaw_mp "" SWORD Pres_hPa 1 100 -32768.00 32767.00 FORMAT "%8.2" ECU_ADDRESS 0x8FF8AE /end MEASUREMENT
/begin MEASUREMENT PCR_pBSurgePICtlLim_mp "PI-Anteil des PI-Regler" SWORD Pres_hPa 1 100 -32768.00 32767.00 FORMAT "%8.2" ECU_ADDRESS 0x8FF8B0 /end MEASUREMENT
/begin MEASUREMENT PCR_pBSurgePICtl_mp "PI-Anteil des PI-Regler" SWORD Pres_hPa 1 100 -32768.00 32767.00 FORMAT "%8.2" ECU_ADDRESS 0x8FF8B2 /end MEASUREMENT
/begin MEASUREMENT PCR_pDesByp_mp "Bypass-Label, Kopie von PCR_pBDes" SWORD Pres_hPa 1 100 -32768.00 32767.00 FORMAT "%8.2" ECU_ADDRESS 0x8FF7FA /end MEASUREMENT
/begin MEASUREMENT PCR_pDesVal "Ladedrucksollwert" SWORD Pres_hPa 1 100 -32768.00 32767.00 FORMAT "%8.2" ECU_ADDRESS 0x7F8FB8 /end MEASUREMENT
/begin MEASUREMENT PCR_pLPDvtMaxRaw_mp "Max. Schwelle für Regelabweichung Niederdruckstufe (vor Offset)" SWORD Pres_hPa 1 100 -32768.00 32767.00 FORMAT "%8.2" ECU_ADDRESS 0x8FF880 /end MEASUREMENT
/begin MEASUREMENT PCR_pLPDvtMax_mp "Maximale Schwelle für Regelabweichung Niederdruckstufe" SWORD Pres_hPa 1 100 -32768.00 32767.00 FORMAT "%8.2" ECU_ADDRESS 0x8FF882 /end MEASUREMENT
/begin MEASUREMENT PCR_pLPDvtMinRaw_mp " Min. Schwelle für Regelabweichung Niederdruckstufe(vor Offset)" SWORD Pres_hPa 1 100 -32768.00 32767.00 FORMAT "%8.2" ECU_ADDRESS 0x8FF884 /end MEASUREMENT
/begin MEASUREMENT PCR_pLPDvtMin_mp "Minimale Schwelle für Regelabweichung Niederdruckstufe" SWORD Pres_hPa 1 100 -32768.00 32767.00 FORMAT "%8.2" ECU_ADDRESS 0x8FF886 /end MEASUREMENT
/begin MEASUREMENT PCR_pNQCtCmpn_mp "Korrekturwert für Kühlwassertemperaturkorrektur für Sollwertberechnung" SWORD Pres 1 100 -32768.00 32767.00 FORMAT "%9.2" ECU_ADDRESS 0x8FF7FC /end MEASUREMENT
/begin MEASUREMENT PCR_pRgnMAP1_mp "stationärer Ladedrucksollwert aus erstem Regenerationskennfeld" SWORD Pres 1 100 -32768.00 32767.00 FORMAT "%9.2" ECU_ADDRESS 0x8FF7FE /end MEASUREMENT
/begin MEASUREMENT PCR_pRgnMAP2_mp "stationärer Ladedrucksollwert aus zweitem Regenerationskennfeld" SWORD Pres 1 100 -32768.00 32767.00 FORMAT "%9.2" ECU_ADDRESS 0x8FF800 /end MEASUREMENT
/begin MEASUREMENT PCR_pSOutI_mp "I-Anteil des PI-Regler" SWORD Pres_hPa 1 100 -32768.00 32767.00 FORMAT "%8.2" ECU_ADDRESS 0x8FF8B4 /end MEASUREMENT
/begin MEASUREMENT PCR_pSOutP_mp "P-Anteil des PI-Regler" SWORD Pres_hPa 1 100 -32768.00 32767.00 FORMAT "%8.2" ECU_ADDRESS 0x8FF8B6 /end MEASUREMENT
/begin MEASUREMENT PCR_pSurgestI_mp "I-Anteil des PI-Regler" SWORD Pres_hPa 1 100 -32768.00 32767.00 FORMAT "%8.2" ECU_ADDRESS 0x8FF8B8 /end MEASUREMENT
/begin MEASUREMENT PCR_qDes "Einspritzmenge für Sollwertbildung" SWORD InjMass 1 100 -327.6800 327.6700 FORMAT "%8.4" ECU_ADDRESS 0x7F8FBA /end MEASUREMENT
/begin MEASUREMENT PCR_qDesFrmMngTrqInr_mp "Desired quantity based on FrmMng_trqInr and FMTC_etaCurr" SWORD InjMassCyc 1 100 -327.6800 327.6700 FORMAT "%8.4" ECU_ADDRESS 0x8FF802 /end MEASUREMENT
/begin MEASUREMENT PCR_qLPGvnrOff_mp "Einspritzmenge für Reglerabschaltschwelle(Niederdruckstufe)" SWORD InjMass 1 100 -327.6800 327.6700 FORMAT "%8.4" ECU_ADDRESS 0x8FF888 /end MEASUREMENT
/begin MEASUREMENT PCR_qLPGvnrOn_mp "Einspritzmenge für Reglereinschaltschwelle(Niederdruckstufe)" SWORD InjMass 1 100 -327.6800 327.6700 FORMAT "%8.4" ECU_ADDRESS 0x8FF88A /end MEASUREMENT
/begin MEASUREMENT PCR_qReal "Injection quantity after switching" SWORD InjMassCyc 1 100 -327.6800 327.6700 FORMAT "%8.4" ECU_ADDRESS 0x7F8FBC /end MEASUREMENT
/begin MEASUREMENT PCR_rAdPCVCtlValLim_mp "Beschraenkter Adaption des VorSteuerkennfeldes der Ladedruckregelung" SWORD Prc 1 100 -400.0000 399.9878 FORMAT "%8.4" ECU_ADDRESS 0x8FF830 /end MEASUREMENT
/begin MEASUREMENT PCR_rAdPCVCtlVal_mp "Adaption des VorSteuerkennfeldes der Ladedruckregelung" SWORD Prc 1 100 -400.0000 399.9878 FORMAT "%8.4" ECU_ADDRESS 0x8FF832 /end MEASUREMENT
/begin MEASUREMENT PCR_rAdPCVI1_mp "Eingang in den I1-Regler nach Multiplizieren mit C1" SWORD Prc 1 100 -400.0000 399.9878 FORMAT "%8.4" ECU_ADDRESS 0x8FF834 /end MEASUREMENT
/begin MEASUREMENT PCR_rAdPCVI2_mp "Eingang in den I2-Regler nach Multiplizieren mit C2" SWORD Prc 1 100 -400.0000 399.9878 FORMAT "%8.4" ECU_ADDRESS 0x8FF836 /end MEASUREMENT
/begin MEASUREMENT PCR_rAdPCVI3_mp "Eingang in den I3-Regler nach Multiplizieren mit C3" SWORD Prc 1 100 -400.0000 399.9878 FORMAT "%8.4" ECU_ADDRESS 0x8FF838 /end MEASUREMENT
/begin MEASUREMENT PCR_rAdPCVI4_mp "Eingang in den I4-Regler nach Multiplizieren mit C4" SWORD Prc 1 100 -400.0000 399.9878 FORMAT "%8.4" ECU_ADDRESS 0x8FF83A /end MEASUREMENT
/begin MEASUREMENT PCR_rBPA "Stellgröße für den Ladedrucksteller" SWORD Prc 1 100 -400.0000 399.9878 FORMAT "%8.4" ECU_ADDRESS 0x7F8FBE /end MEASUREMENT
/begin MEASUREMENT PCR_rBPA2 "Ratio2 of valve lift for boost pressure actuator" SWORD Prc 1 100 -400.0000 399.9878 FORMAT "%8.4" ECU_ADDRESS 0x7F8FC0 /end MEASUREMENT
/begin MEASUREMENT PCR_rBPACDByp_mp "Bypass-Label, Kopie von PCR_rBPACD" SWORD Prc 1 100 -400.0000 399.9878 FORMAT "%8.4" ECU_ADDRESS 0x8FF898 /end MEASUREMENT
/begin MEASUREMENT PCR_rBPALP "TV Rohwert an Niederdruckstufensteller" SWORD Prc 1 100 -400.0000 399.9878 FORMAT "%8.4" ECU_ADDRESS 0x7F8FC2 /end MEASUREMENT
/begin MEASUREMENT PCR_rBPALP2 "Stellgröße für den 2. Ladedrucksteller" SWORD Prc 1 100 -400.0000 399.9878 FORMAT "%8.4" ECU_ADDRESS 0x7F8FC4 /end MEASUREMENT
/begin MEASUREMENT PCR_rBPBasLP_mp "" SWORD Prc 1 100 -400.0000 399.9878 FORMAT "%8.4" ECU_ADDRESS 0x8FF86E /end MEASUREMENT
/begin MEASUREMENT PCR_rBPGovMax "Maximal zulässige Reglerstellgröße" SWORD Prc 1 100 -400.0000 399.9878 FORMAT "%8.4" ECU_ADDRESS 0x7F8FC6 /end MEASUREMENT
/begin MEASUREMENT PCR_rBPGovMaxDynRamp_mp "Ramp correction to Maximum allowable PCR governer output" SWORD Prc 1 100 -400.0000 399.9878 FORMAT "%8.4" ECU_ADDRESS 0x6F81BA /end MEASUREMENT
/begin MEASUREMENT PCR_rBPGovMaxDyn_mp "Maximum allowable PCR governer output before ramp correction" SWORD Prc 1 100 -400.0000 399.9878 FORMAT "%8.4" ECU_ADDRESS 0x6F81BC /end MEASUREMENT
/begin MEASUREMENT PCR_rBPGovMaxVal1_mp "Maximum allowable PCR governer output without dynamic correction" SWORD Prc 1 100 -400.0000 399.9878 FORMAT "%8.4" ECU_ADDRESS 0x6F81BE /end MEASUREMENT
/begin MEASUREMENT PCR_rBPGovMaxVal2_mp "Maximum allowable PCR governer output with dynamic correction" SWORD Prc 1 100 -400.0000 399.9878 FORMAT "%8.4" ECU_ADDRESS 0x6F81C0 /end MEASUREMENT
/begin MEASUREMENT PCR_rBPGovMax_mp "Maximal zulässige Reglerstellgröße" SWORD Prc 1 100 -400.0000 399.9878 FORMAT "%8.4" ECU_ADDRESS 0x6F81C2 /end MEASUREMENT
/begin MEASUREMENT PCR_rBPGovMin "Minimal zulässige Reglerstellgröße" SWORD Prc 1 100 -400.0000 399.9878 FORMAT "%8.4" ECU_ADDRESS 0x7F8FC8 /end MEASUREMENT
/begin MEASUREMENT PCR_rBPGovMin_mp "Minimal zulässige Reglerstellgröße" SWORD Prc 1 100 -400.0000 399.9878 FORMAT "%8.4" ECU_ADDRESS 0x6F81C4 /end MEASUREMENT
/begin MEASUREMENT PCR_rBPGvnrUnLim1_mp "Ladedrucksteller- Tastverhältnis 1 (unbegrenzt)" SWORD Prc 1 100 -400.0000 399.9878 FORMAT "%8.4" ECU_ADDRESS 0x8FF83C /end MEASUREMENT
/begin MEASUREMENT PCR_rBPGvnrUnLim2_mp "Ladedrucksteller- Tastverhältnis 2 (unbegrenzt)" SWORD Prc 1 100 -400.0000 399.9878 FORMAT "%8.4" ECU_ADDRESS 0x8FF83E /end MEASUREMENT
/begin MEASUREMENT PCR_rBPLim "limited boost pressure actuator value" SWORD Prc 1 100 -400.0000 399.9878 FORMAT "%8.4" ECU_ADDRESS 0x7F8FCA /end MEASUREMENT
/begin MEASUREMENT PCR_rBPLim_mp "limited value of PID output" SWORD Prc 1 100 -400.0000 399.9878 FORMAT "%8.4" ECU_ADDRESS 0x8FF840 /end MEASUREMENT
/begin MEASUREMENT PCR_rBPRglBasLP_mp "" SWORD Prc 1 100 -400.0000 399.9878 FORMAT "%8.4" ECU_ADDRESS 0x8FF870 /end MEASUREMENT
/begin MEASUREMENT PCR_rGvnr "Reglerstellgröße für den Ladedruck" SWORD Prc 1 100 -400.0000 399.9878 FORMAT "%8.4" ECU_ADDRESS 0x7F8FD0 /end MEASUREMENT
/begin MEASUREMENT PCR_rGvnr2 "Ratio 2 of valve lift from governor with PCR Balancing governor" SWORD Prc 1 100 -400.0000 399.9878 FORMAT "%8.4" ECU_ADDRESS 0x7F8FD2 /end MEASUREMENT
/begin MEASUREMENT PCR_rGvnrLP "Stellgröße des Ladedruckreglers LP - Steller 1" SWORD Prc 1 100 -400.0000 399.9878 FORMAT "%8.4" ECU_ADDRESS 0x7F8FD4 /end MEASUREMENT
/begin MEASUREMENT PCR_rGvnrSurge "for Anti-Surge LIGov Boost Pressure" SWORD Prc 1 100 -400.0000 399.9878 FORMAT "%8.4" ECU_ADDRESS 0x7F8FD8 /end MEASUREMENT
/begin MEASUREMENT PCR_rGvnrSurgeRaw_mp "" SWORD Prc 1 100 -400.0000 399.9878 FORMAT "%8.4" ECU_ADDRESS 0x6F81C8 /end MEASUREMENT
/begin MEASUREMENT PCR_rInitI1AdPCV_mp "Initialisationswerte fuer I1-Regler" SWORD Prc 1 100 -400.0000 399.9878 FORMAT "%8.4" ECU_ADDRESS 0x8FF842 /end MEASUREMENT
/begin MEASUREMENT PCR_rInitI2AdPCV_mp "Initialisationswerte fuer I2-Regler" SWORD Prc 1 100 -400.0000 399.9878 FORMAT "%8.4" ECU_ADDRESS 0x8FF844 /end MEASUREMENT
/begin MEASUREMENT PCR_rInitI3AdPCV_mp "Initialisationswerte fuer I3-Regler" SWORD Prc 1 100 -400.0000 399.9878 FORMAT "%8.4" ECU_ADDRESS 0x8FF846 /end MEASUREMENT
/begin MEASUREMENT PCR_rInitI4AdPCV_mp "Initialisationswerte fuer I4-Regler" SWORD Prc 1 100 -400.0000 399.9878 FORMAT "%8.4" ECU_ADDRESS 0x8FF848 /end MEASUREMENT
/begin MEASUREMENT PCR_rOutAdPCVI1_mp "Ausgang Des I1-Regler" SWORD Prc 1 100 -400.0000 399.9878 FORMAT "%8.4" ECU_ADDRESS 0x8FF84A /end MEASUREMENT
/begin MEASUREMENT PCR_rOutAdPCVI2_mp "Ausgang Des I2-Regler" SWORD Prc 1 100 -400.0000 399.9878 FORMAT "%8.4" ECU_ADDRESS 0x8FF84C /end MEASUREMENT
/begin MEASUREMENT PCR_rOutAdPCVI3_mp "Ausgang Des I3-Regler" SWORD Prc 1 100 -400.0000 399.9878 FORMAT "%8.4" ECU_ADDRESS 0x8FF84E /end MEASUREMENT
/begin MEASUREMENT PCR_rOutAdPCVI4_mp "Ausgang Des I4-Regler" SWORD Prc 1 100 -400.0000 399.9878 FORMAT "%8.4" ECU_ADDRESS 0x8FF850 /end MEASUREMENT
/begin MEASUREMENT PCR_rOutDLP_mp "DTWin1-Regler Ausgang" SWORD Prc 1 100 -400.0000 399.9878 FORMAT "%8.4" ECU_ADDRESS 0x8FF872 /end MEASUREMENT
/begin MEASUREMENT PCR_rOutDT1_mp "DT1-Anteil des PIDT1 Reglers" SWORD Prc 1 100 -400.0000 399.9878 FORMAT "%8.4" ECU_ADDRESS 0x8FF852 /end MEASUREMENT
/begin MEASUREMENT PCR_rOutILim_mp "limited value of output" SWORD Prc 1 100 -400.0000 399.9878 FORMAT "%8.4" ECU_ADDRESS 0x8FF854 /end MEASUREMENT
/begin MEASUREMENT PCR_rOutILP_mp "I-Regler Ausgang" SWORD Prc 1 100 -400.0000 399.9878 FORMAT "%8.4" ECU_ADDRESS 0x8FF874 /end MEASUREMENT
/begin MEASUREMENT PCR_rOutIMax_mp "Ausgangsgröße des Kennfeldes PCR_rOutIMax_MAP" SWORD Prc 1 100 -400.0000 399.9878 FORMAT "%8.4" ECU_ADDRESS 0x8FF856 /end MEASUREMENT
/begin MEASUREMENT PCR_rOutI_mp "I-Anteil des PIDT1 Reglers" SWORD Prc 1 100 -400.0000 399.9878 FORMAT "%8.4" ECU_ADDRESS 0x8FF858 /end MEASUREMENT
/begin MEASUREMENT PCR_rOutLimLP_mp "Beschraenkter PID + Vorsteuertastverhaeltnis Ausgang" SWORD Prc 1 100 -400.0000 399.9878 FORMAT "%8.4" ECU_ADDRESS 0x8FF876 /end MEASUREMENT
/begin MEASUREMENT PCR_rOutLP_mp "PID + Vorsteuertastverhaeltnis Ausgang" SWORD Prc 1 100 -400.0000 399.9878 FORMAT "%8.4" ECU_ADDRESS 0x8FF878 /end MEASUREMENT
/begin MEASUREMENT PCR_rOutPIDLP_mp "" SWORD Prc 1 100 -400.0000 399.9878 FORMAT "%8.4" ECU_ADDRESS 0x8FF87A /end MEASUREMENT
/begin MEASUREMENT PCR_rOutPILP_mp "PI-Regler Ausgang" SWORD Prc 1 100 -400.0000 399.9878 FORMAT "%8.4" ECU_ADDRESS 0x8FF87C /end MEASUREMENT
/begin MEASUREMENT PCR_rOutPLP_mp "P-Regler Ausgang" SWORD Prc 1 100 -400.0000 399.9878 FORMAT "%8.4" ECU_ADDRESS 0x8FF87E /end MEASUREMENT
/begin MEASUREMENT PCR_rOutP_mp "P-Anteil des PIDT1 Reglers" SWORD Prc 1 100 -400.0000 399.9878 FORMAT "%8.4" ECU_ADDRESS 0x8FF85A /end MEASUREMENT
/begin MEASUREMENT PCR_rPICtl_mp "P+I+Steueranteil der Stellgröße (vor ARW)" SWORD Prc 1 100 -400.0000 399.9878 FORMAT "%8.4" ECU_ADDRESS 0x8FF85C /end MEASUREMENT
/begin MEASUREMENT PCR_rPIDCtl_mp "Regel- und Steueranteil der Stellgrösse des Ladedruckreglers" SWORD Prc 1 100 -400.0000 399.9878 FORMAT "%8.4" ECU_ADDRESS 0x8FF866 /end MEASUREMENT
/begin MEASUREMENT PCR_rstI_mp "Integratorzustand in Basisvariante" SWORD Prc 1 100 -400.0000 399.9878 FORMAT "%8.4" ECU_ADDRESS 0x8FF868 /end MEASUREMENT
/begin MEASUREMENT PCR_rSurgeGvnrHysOff_mp "" SWORD Prc 1 100 -400.0000 399.9878 FORMAT "%8.4" ECU_ADDRESS 0x6F81CA /end MEASUREMENT
/begin MEASUREMENT PCR_rSurgeGvnrOff_mp "" SWORD Prc 1 100 -400.0000 399.9878 FORMAT "%8.4" ECU_ADDRESS 0x6F81CC /end MEASUREMENT
/begin MEASUREMENT PCR_rSurgeGvnrOn_mp "" SWORD Prc 1 100 -400.0000 399.9878 FORMAT "%8.4" ECU_ADDRESS 0x6F81CE /end MEASUREMENT
/begin MEASUREMENT PCR_stAdPCVLogic_mp "Status zur Freigabe verschiedener Funktionsmodi des Lernalgorithmus (aktiv, nicht aktiv, ruecksetzen, ignorieren)" UBYTE OneToOne 1 100 0.00 255.0 FORMAT "%5.1" ECU_ADDRESS 0x8FF85E /end MEASUREMENT
/begin MEASUREMENT PCR_stAdPCVRelCond_mp "Status der Bedingungen zur Freigabe des Lernprozesses" UBYTE OneToOne 1 100 0.00 255.0 FORMAT "%5.1" ECU_ADDRESS 0x8FF85F /end MEASUREMENT
/begin MEASUREMENT PCR_stAdPCV_mp "Bedingungen fuer verschiedene Funktionsmodi des Lernalgorithmus (aktiv, nicht aktiv ruecksetzen, ignorieren)" UWORD OneToOne 1 100 0.00 65535.00 FORMAT "%8.2" ECU_ADDRESS 0x8FF860 /end MEASUREMENT
/begin MEASUREMENT PCR_stBDesLogic_mp "Status bits based on which raw or ramped unlimited desired boost pressure selection is made." UBYTE OneToOne 1 100 0.00 255.0 FORMAT "%5.1" ECU_ADDRESS 0x8FF804 /end MEASUREMENT
/begin MEASUREMENT PCR_stClutch_mp "" UBYTE OneToOne 1 100 0.00 255.0 FORMAT "%5.1" ECU_ADDRESS 0x8FF89A /end MEASUREMENT
/begin MEASUREMENT PCR_stCmpEnd_mp "Calculation of the correction factor based on atmospheric factor" UBYTE OneToOne 1 100 0.00 255.0 FORMAT "%5.1" ECU_ADDRESS 0x8FF805 /end MEASUREMENT
/begin MEASUREMENT PCR_stCpBVlv_mp "Status des Vorgabewertes bei offener Verdichterbypassklappe" UBYTE OneToOne 1 100 0.00 255.0 FORMAT "%5.1" ECU_ADDRESS 0x8FF89B /end MEASUREMENT
/begin MEASUREMENT PCR_stEepAdPCV_mp "Status von eeprom schreibt" UBYTE OneToOne 1 100 0.00 255.0 FORMAT "%5.1" ECU_ADDRESS 0x8FF862 /end MEASUREMENT
/begin MEASUREMENT PCR_stEepBlock_mp "Status des Eeprom-Blockes" SWORD OneToOne 1 100 -32768.00 32767.00 FORMAT "%8.2" ECU_ADDRESS 0x8FF864 /end MEASUREMENT
/begin MEASUREMENT PCR_stLPClutch_mp "Geschwindigkeitsschwelle für Kupplungssignal überwachung" UBYTE OneToOne 1 100 0.00 255.0 FORMAT "%5.1" ECU_ADDRESS 0x8FF88C /end MEASUREMENT
/begin MEASUREMENT PCR_stLPMonitor "Schalter: Regler Niederdruckstufe (PCR_LP) ein/aus" UBYTE OneToOne 1 100 0.00 255.0 FORMAT "%5.1" ECU_ADDRESS 0x7F896D /end MEASUREMENT
/begin MEASUREMENT PCR_stLPPCR "Status der Ladedruckregelung Niederdruckstufe" UWORD OneToOne 1 100 0.00 65535.00 FORMAT "%8.2" ECU_ADDRESS 0x7F8FDC /end MEASUREMENT
/begin MEASUREMENT PCR_stLPRgn_mp "Statuswert für die Bestimmung der Quantität am Regler Ein-Aus" UBYTE OneToOne 1 100 0.00 255.0 FORMAT "%5.1" ECU_ADDRESS 0x8FF88D /end MEASUREMENT
/begin MEASUREMENT PCR_stLPWorkSph "aktueller Arbeitsbereich" UBYTE OneToOne 1 100 0.00 255.0 FORMAT "%5.1" ECU_ADDRESS 0x7F896E /end MEASUREMENT
/begin MEASUREMENT PCR_stMonitor "Statusangabe bei Abschaltung der Regelung" UBYTE OneToOne 1 100 0.00 255.0 FORMAT "%5.1" ECU_ADDRESS 0x7F896F /end MEASUREMENT
/begin MEASUREMENT PCR_stPCR "Status der Ladedruckregelung" UWORD OneToOne 1 100 0.00 65535.00 FORMAT "%8.2" ECU_ADDRESS 0x7F8FDE /end MEASUREMENT
/begin MEASUREMENT PCR_stPCR_mp "Status der Ladedruckregelung" UWORD OneToOne 1 100 0.00 65535.00 FORMAT "%8.2" ECU_ADDRESS 0x8FF89C /end MEASUREMENT
/begin MEASUREMENT PCR_stPreSurge "Status der Erkennung für Laderpumpen Zustand 1 (oszillierende Frischluftmasse mit kleiner Amplitude)" UBYTE OneToOne 1 100 0.00 255.0 FORMAT "%5.1" ECU_ADDRESS 0x7F8970 /end MEASUREMENT
/begin MEASUREMENT PCR_stSurge "Status der Erkennung für Laderpumpen Zustand 2 (oszillierende Frischluftmasse mit großer Amplitude)" UBYTE OneToOne 1 100 0.00 255.0 FORMAT "%5.1" ECU_ADDRESS 0x7F8971 /end MEASUREMENT
/begin MEASUREMENT PCR_stSwtBPGovMaxDyn_mp "Ramp switch position, for dynamic adjustment of maximum allowable PCR governor output" UBYTE OneToOne 1 100 0.00 255.0 FORMAT "%5.1" ECU_ADDRESS 0x6F81C6 /end MEASUREMENT
/begin MEASUREMENT PCR_stWorkSph "present working sphere" UBYTE OneToOne 1 100 0.00 255.0 FORMAT "%5.1" ECU_ADDRESS 0x7F8974 /end MEASUREMENT
/begin MEASUREMENT PCR_swtGvnr "Schalter: Regler ein/aus" UBYTE OneToOne 1 100 0.00 255.0 FORMAT "%5.1" ECU_ADDRESS 0x7F8975 /end MEASUREMENT
/begin MEASUREMENT PCR_swtLimSel "Schalter zur Auswahl der Größen, aus denen der zulässige Stellgrößenbereich bestimmt wird" UBYTE OneToOne 1 100 0.00 255.0 FORMAT "%5.1" ECU_ADDRESS 0x7F8977 /end MEASUREMENT
/begin MEASUREMENT PCR_swtLPGvnr "Schalter: Regler Niederdruckstufe (PCR_LP) ein/aus" UBYTE OneToOne 1 100 0.00 255.0 FORMAT "%5.1" ECU_ADDRESS 0x7F8976 /end MEASUREMENT
/begin MEASUREMENT PCR_swtLPGvnrV1_mp "" UBYTE OneToOne 1 100 0.00 255.0 FORMAT "%5.1" ECU_ADDRESS 0x8FF88E /end MEASUREMENT
/begin MEASUREMENT PCR_swtQntDes "Schalter für Mengeneingangswunsch bei der Sollwertberechnung" UBYTE OneToOne 1 100 0.00 255.0 FORMAT "%5.1" ECU_ADDRESS 0x7F8979 /end MEASUREMENT
/begin MEASUREMENT PCR_swtRelAbs "Schalter zur Auswahl zwischen Absolut- und Relativdruckregelung" UBYTE OneToOne 1 100 0.00 255.0 FORMAT "%5.1" ECU_ADDRESS 0x7F897A /end MEASUREMENT
/begin MEASUREMENT PCR_swtSurgeGvnr "Zustand einzelnen Statis für AntiSurge-Regler" UBYTE OneToOne 1 100 0.00 255.0 FORMAT "%5.1" ECU_ADDRESS 0x7F897B /end MEASUREMENT
/begin MEASUREMENT PCR_swtSurgeGvnrRel_mp "" UBYTE OneToOne 1 100 0.00 255.0 FORMAT "%5.1" ECU_ADDRESS 0x8FF8BA /end MEASUREMENT
/begin MEASUREMENT PCR_swtSurgeGvnrSel_mp "Zustand einzelnen Statis für AntiSurge-Regler" UBYTE OneToOne 1 100 0.00 255.0 FORMAT "%5.1" ECU_ADDRESS 0x8FF8BB /end MEASUREMENT
/begin MEASUREMENT PCR_tiStrtDelay_mp "Zeit, in der die Regelung nach Startabwurf abgeschaltet bleibt" UWORD Time_ms 1 100 0.00 655350.0 FORMAT "%8.1" ECU_ADDRESS 0x8FF89E /end MEASUREMENT
/begin MEASUREMENT PCVCD_dcycDT1_mp "Sollwert Tastverhältnis mit DT1-Anteil" SWORD DtyCyc 1 100 -327.6800 327.6700 FORMAT "%8.4" ECU_ADDRESS 0x8FF8DC /end MEASUREMENT
/begin MEASUREMENT PCVCD_dcycOut_mp "Ausgangstastverhältnis" SWORD DtyCyc 1 100 -327.6800 327.6700 FORMAT "%8.4" ECU_ADDRESS 0x6F81D0 /end MEASUREMENT
/begin MEASUREMENT PCVCD_dcycSetVal_mp "Sollwert Tastverhältnis für Druckregelventil" SWORD DtyCyc 1 100 -327.6800 327.6700 FORMAT "%8.4" ECU_ADDRESS 0x8FF8DE /end MEASUREMENT
/begin MEASUREMENT PCVCD_facIGov_mp "Stromregler I-Anteil" SWORD Fact 1 100 -4.000000 3.999878 FORMAT "%8.6" ECU_ADDRESS 0x8FF8E0 /end MEASUREMENT
/begin MEASUREMENT PCVCD_iActFlt_mp "PT1 gefilterter Strom Istwert" SWORD Curr 1 100 -32768.00 32767.00 FORMAT "%8.2" ECU_ADDRESS 0x8FF8E2 /end MEASUREMENT
/begin MEASUREMENT PCVCD_iActVal "Analogeingang Strom-Istwert" SWORD Curr 1 100 -32768.00 32767.00 FORMAT "%8.2" ECU_ADDRESS 0x7F8FE0 /end MEASUREMENT
/begin MEASUREMENT PCVCD_iDvt_mp "Stromregler Regelabweichung" SWORD Curr 1 100 -32768.00 32767.00 FORMAT "%8.2" ECU_ADDRESS 0x8FF8E4 /end MEASUREMENT
/begin MEASUREMENT PCVCD_iGovActVal_mp "Isttrom nach Eingriff des Raildruckreglers" SWORD Curr 1 100 -32768.00 32767.00 FORMAT "%8.2" ECU_ADDRESS 0x8FF8E6 /end MEASUREMENT
/begin MEASUREMENT PCVCD_iSetFlt_mp "PT1 gefilterter Stromistwert" SWORD Curr 1 100 -32768.00 32767.00 FORMAT "%8.2" ECU_ADDRESS 0x8FF8E8 /end MEASUREMENT
/begin MEASUREMENT PCVCD_swtCtlState "geschlossener Regelkreis für Stromregler konstant oder in Abhängigkeit vom Raildruckregler" UBYTE OneToOne 1 100 0.00 255.0 FORMAT "%5.1" ECU_ADDRESS 0x7F897C /end MEASUREMENT
/begin MEASUREMENT PCVCD_uRawVal_mp "Analogeingang Spannungsrohwert" SWORD Volt 1 100 -160156.4 160151.5 FORMAT "%8.1" ECU_ADDRESS 0x8FF8EA /end MEASUREMENT
/begin MEASUREMENT PCV_dvolLeak_mp "Leckage des Druckregelventils" SWORD Qp_mm3_sec 1 100 -327680.0 327670.0 FORMAT "%8.1" ECU_ADDRESS 0x8FF8D6 /end MEASUREMENT
/begin MEASUREMENT PCV_iSet_mp "Sollstrom fuer das Druckregelventil" SWORD Curr 1 100 -32768.00 32767.00 FORMAT "%8.2" ECU_ADDRESS 0x8FF8D8 /end MEASUREMENT
/begin MEASUREMENT PCV_stActrCtl_mp "Zustand der Stellwertsteuerung fuer das Druckregelventil" UBYTE OneToOne 1 100 0.00 255.0 FORMAT "%5.1" ECU_ADDRESS 0x8FF8DA /end MEASUREMENT
/begin MEASUREMENT PFltCD_pLinPre "linearisierter Analogwert, Absolutdrucksensor vor dem Partikelfilter" SWORD Pres 1 100 -32768.00 32767.00 FORMAT "%9.2" ECU_ADDRESS 0x7F8FE4 /end MEASUREMENT
/begin MEASUREMENT PFltCD_pPre "Abgastemp. vor Partikelfilter" SWORD Pres 1 100 -32768.00 32767.00 FORMAT "%9.2" ECU_ADDRESS 0x7F8FE6 /end MEASUREMENT
/begin MEASUREMENT PFltCD_tLinPre "Linearisierter Wert der Abgastemperatur vor dem Partikelfilter" SWORD Temp_Cels 1 100 -50.140 899.860 FORMAT "%8.3" ECU_ADDRESS 0x7F8FE8 /end MEASUREMENT
/begin MEASUREMENT PFltCD_tPre "Abgastemp. vor Partikelfilter erster Sensor" SWORD Temp_Cels 1 100 -50.140 899.860 FORMAT "%8.3" ECU_ADDRESS 0x7F8FEA /end MEASUREMENT
/begin MEASUREMENT PFltCD_uRawPresPre_mp "Spannungsrohwert vom Absolutdrucksensor vor dem Partikelfilter" SWORD Volt 1 100 -160156.4 160151.5 FORMAT "%8.1" ECU_ADDRESS 0x6F820E /end MEASUREMENT
/begin MEASUREMENT PFltCD_uRawTempPre "Spannungsrohwert der Abgastemperatur vor dem Partikelfilter" SWORD Volt 1 100 -160156.4 160151.5 FORMAT "%8.1" ECU_ADDRESS 0x7F8FEE /end MEASUREMENT
/begin MEASUREMENT PFlt_aVehFltAshCor_mp "gefilterter Wert Fahrzeugbeschleunigung" SWORD Acc 1 100 -32.76800 32.76700 FORMAT "%8.5" ECU_ADDRESS 0x8FF8EC /end MEASUREMENT
/begin MEASUREMENT PFlt_ctNumAshCorMax_mp "aktueller Zählerwert des Maximumzählers für AshCor Regeneration" UWORD OneToOne 1 100 0.00 65535.00 FORMAT "%8.2" ECU_ADDRESS 0x6F81D2 /end MEASUREMENT
/begin MEASUREMENT PFlt_ctNumAshCor_mp "aktueller Zählerwert für erfolgreiche Regeneration" UWORD OneToOne 1 100 0.00 65535.00 FORMAT "%8.2" ECU_ADDRESS 0x6F81D4 /end MEASUREMENT
/begin MEASUREMENT PFlt_dqFlTotAct_mp "" SWORD Fl_2 1 100 -327680.0 327670.0 FORMAT "%8.1" ECU_ADDRESS 0x8FF8EE /end MEASUREMENT
/begin MEASUREMENT PFlt_dqFlTotEnd_mp "" SWORD Fl_2 1 100 -327680.0 327670.0 FORMAT "%8.1" ECU_ADDRESS 0x8FF8F0 /end MEASUREMENT
/begin MEASUREMENT PFlt_dVolFltAshCorRaw_mp "dVol-Rohwert" SWORD CubMtrPerHr 1 100 -3276.800 3276.700 FORMAT "%8.3" ECU_ADDRESS 0x8FF8F2 /end MEASUREMENT
/begin MEASUREMENT PFlt_dVolFltAshCor_mp "PT1-gefilterter Wert für PFlt_dvol" SWORD CubMtrPerHr 1 100 -3276.800 3276.700 FORMAT "%8.3" ECU_ADDRESS 0x8FF8F4 /end MEASUREMENT
/begin MEASUREMENT PFlt_facAshCorDiff_mp "" SWORD Fact 1 100 -4.000000 3.999878 FORMAT "%8.6" ECU_ADDRESS 0x8FF8F6 /end MEASUREMENT
/begin MEASUREMENT PFlt_lAshCorAct_mp "Zwischenwert Kilometerstand" UWORD LengthKm 1 100 0.00 65535.00 FORMAT "%8.2" ECU_ADDRESS 0x8FF8F8 /end MEASUREMENT
/begin MEASUREMENT PFlt_lAshCorNext "Kilometer für die nächste(folgende) Abgleichung" ULONG LengthKm 1 100 0.00 4294967295.00 FORMAT "%13.2" ECU_ADDRESS 0x7F921C /end MEASUREMENT
/begin MEASUREMENT PFlt_lAshCorNextEEProm_mp "nächster Kilometerstand für Ascheabgelichregeneration, gelesen vom EEPROM bei Motorstart" ULONG LengthKm 1 100 0.00 4294967295.00 FORMAT "%13.2" ECU_ADDRESS 0x8FF8FC /end MEASUREMENT
/begin MEASUREMENT PFlt_lAshCorNextMax_mp "Messender Punkt für folgende maximale Aschenkorrektur" ULONG LengthKm 1 100 0.00 4294967295.00 FORMAT "%13.2" ECU_ADDRESS 0x8FF900 /end MEASUREMENT
/begin MEASUREMENT PFlt_lAshCorNextOilCor_mp "Messender Punkt für folgendes maximales Aschen ölen Korrektur." ULONG LengthKm 1 100 0.00 4294967295.00 FORMAT "%13.2" ECU_ADDRESS 0x8FF904 /end MEASUREMENT
/begin MEASUREMENT PFlt_lAshCorOldCalc_mp "Messender Punkt für alten Aschenkorrekturwert." ULONG LengthKm 1 100 0.00 4294967295.00 FORMAT "%13.2" ECU_ADDRESS 0x8FF908 /end MEASUREMENT
/begin MEASUREMENT PFlt_lAshCorStep_mp "Schrittgröße für Aschenkorrektur." UWORD LengthKm 1 100 0.00 65535.00 FORMAT "%8.2" ECU_ADDRESS 0x8FF90C /end MEASUREMENT
/begin MEASUREMENT PFlt_mAshCorAct "tatsächliche Aschenmenge" SWORD mSoot_g 1 100 -327.6800 327.6700 FORMAT "%8.4" ECU_ADDRESS 0x7F8FF6 /end MEASUREMENT
/begin MEASUREMENT PFlt_mAshCorActRel_mp "aktuell relative Abweichung der neu berechneten Aschemenge" SWORD mSoot_g 1 100 -327.6800 327.6700 FORMAT "%8.4" ECU_ADDRESS 0x8FF90E /end MEASUREMENT
/begin MEASUREMENT PFlt_mAshCorDiff1_mp "Absolutbetrag von PFlt_mAshCorDiff_mp, relative Aschemengeabweichung" SWORD mSoot_g 1 100 -327.6800 327.6700 FORMAT "%8.4" ECU_ADDRESS 0x8FF910 /end MEASUREMENT
/begin MEASUREMENT PFlt_mAshCorDiff2_mp "" SWORD mSoot_g 1 100 -327.6800 327.6700 FORMAT "%8.4" ECU_ADDRESS 0x8FF912 /end MEASUREMENT
/begin MEASUREMENT PFlt_mAshCorDiff_mp "output of PFlt_mAshCor_MAP, Abweichung vom Aschemengesollwert" SWORD mSoot_g 1 100 -327.6800 327.6700 FORMAT "%8.4" ECU_ADDRESS 0x6F81D6 /end MEASUREMENT
/begin MEASUREMENT PFlt_mAshCorNew "Wird nur berechnet, wenn PFlt_mAshCorAct einen plausiblen Wert besitzt" SWORD mSoot_g 1 100 -327.6800 327.6700 FORMAT "%8.4" ECU_ADDRESS 0x7F8FF8 /end MEASUREMENT
/begin MEASUREMENT PFlt_mAshCorOld "Aschekorrekturwert vom vorherigen Zyklus" SWORD mSoot_g 1 100 -327.6800 327.6700 FORMAT "%8.4" ECU_ADDRESS 0x7F8FFA /end MEASUREMENT
/begin MEASUREMENT PFlt_nAvrgFltAshCor_mp "gefilterter Wert Drehzahl" SWORD EngN 1 100 -32768.00 32767.00 FORMAT "%8.2" ECU_ADDRESS 0x8FF914 /end MEASUREMENT
/begin MEASUREMENT PFlt_numPrj "Regeneration demand number" UBYTE OneToOne 1 100 0.00 255.0 FORMAT "%5.1" ECU_ADDRESS 0x7F897E /end MEASUREMENT
/begin MEASUREMENT PFlt_qFlTotCor "Gesamtmenge Kraftstoffquantitätskorrektur" SWORD Fl_2 1 100 -327680.0 327670.0 FORMAT "%8.1" ECU_ADDRESS 0x7F9018 /end MEASUREMENT
/begin MEASUREMENT PFlt_qSetUnBalFltAshCor_mp "gefilterter Wert Einspritzmasse" SWORD InjMassCyc 1 100 -327.6800 327.6700 FORMAT "%8.4" ECU_ADDRESS 0x8FF916 /end MEASUREMENT
/begin MEASUREMENT PFlt_resFlowFltAshCorRaw_mp "Resflow-Rohwert" SWORD Res_hPaHrPerCM 1 100 -32.76800 32.76700 FORMAT "%8.5" ECU_ADDRESS 0x8FF918 /end MEASUREMENT
/begin MEASUREMENT PFlt_resFlowFltAshCor_mp "PT1-gefilterter Wert für for PFlt_resFlow" SWORD Res_hPaHrPerCM 1 100 -32.76800 32.76700 FORMAT "%8.5" ECU_ADDRESS 0x8FF91A /end MEASUREMENT
/begin MEASUREMENT PFlt_stAshCorCalc_mp "Berechnungsstatus Aschekorrektur" UBYTE OneToOne 1 100 0.00 255.0 FORMAT "%5.1" ECU_ADDRESS 0x8FF91C /end MEASUREMENT
/begin MEASUREMENT PFlt_stAshCorDist_mp "Status Ashekorrekturdistanz" UBYTE OneToOne 1 100 0.00 255.0 FORMAT "%5.1" ECU_ADDRESS 0x8FF91D /end MEASUREMENT
/begin MEASUREMENT PFlt_stAshCorRgnMax "Maximumzähler für AshCor Regeneration abgelaufen, keine gültige Regeneration stattgefunden" UBYTE OneToOne 1 100 0.00 255.0 FORMAT "%5.1" ECU_ADDRESS 0x7F8982 /end MEASUREMENT
/begin MEASUREMENT PFlt_stAshCorRgn_mp "bitweise Aufschlüsselung der aktuellen Regenerationsanforderung" UBYTE OneToOne 1 100 0.00 255.0 FORMAT "%5.1" ECU_ADDRESS 0x8FF91E /end MEASUREMENT
/begin MEASUREMENT PFlt_stAshCorRlsOn_mp "Status Aschekorrektur-Freigabe am" UBYTE OneToOne 1 100 0.00 255.0 FORMAT "%5.1" ECU_ADDRESS 0x8FF91F /end MEASUREMENT
/begin MEASUREMENT PFlt_stAshCorRls_mp "Status Aschekorrektur-Freigabe" UBYTE OneToOne 1 100 0.00 255.0 FORMAT "%5.1" ECU_ADDRESS 0x8FF920 /end MEASUREMENT
/begin MEASUREMENT PFlt_stAshCor_mp "Status Aschekorrektur" UBYTE OneToOne 1 100 0.00 255.0 FORMAT "%5.1" ECU_ADDRESS 0x8FF921 /end MEASUREMENT
/begin MEASUREMENT PFlt_stFlTotCorOn_mp "Status für Gesamtmenge Kraftstoffkorrektur ON." UBYTE OneToOne 1 100 0.00 255.0 FORMAT "%5.1" ECU_ADDRESS 0x8FF922 /end MEASUREMENT
/begin MEASUREMENT PFlt_stFlTotCor_mp "Status für Gesamtmenge Kraftstoffkorrektur" UBYTE OneToOne 1 100 0.00 255.0 FORMAT "%5.1" ECU_ADDRESS 0x8FF923 /end MEASUREMENT
/begin MEASUREMENT PFlt_stPFltErr_mp "" UBYTE OneToOne 1 100 0.00 255.0 FORMAT "%5.1" ECU_ADDRESS 0x8FF924 /end MEASUREMENT
/begin MEASUREMENT PFlt_tAirFltAshCor_mp "gefilterter Wert Ansauglufttemperatur" SWORD Temp_Cels 1 100 -50.140 899.860 FORMAT "%8.3" ECU_ADDRESS 0x8FF926 /end MEASUREMENT
/begin MEASUREMENT PFlt_tCIntFltAshCor_mp "gefilterter Wert Kühlmitteltemperatur" SWORD Temp_Cels 1 100 -50.140 899.860 FORMAT "%8.3" ECU_ADDRESS 0x8FF928 /end MEASUREMENT
/begin MEASUREMENT PFlt_tiPFltErr_mp "" UWORD TimePFltLimpHome 1 100 0.00 655350.0 FORMAT "%8.1" ECU_ADDRESS 0x6F81D8 /end MEASUREMENT
/begin MEASUREMENT PFlt_tOxiPreFltAshCor_mp "gefilterter Wert OxiKat-Temperatur" SWORD Temp_Cels 1 100 -50.140 899.860 FORMAT "%8.3" ECU_ADDRESS 0x8FF92A /end MEASUREMENT
/begin MEASUREMENT PFlt_tPreFltAshCor_mp "gefilterter Wert Aufwärtstemperatur Partikelfilter" SWORD Temp_Cels 1 100 -50.140 899.860 FORMAT "%8.3" ECU_ADDRESS 0x8FF92C /end MEASUREMENT
/begin MEASUREMENT PFlt_vVehFltAshCor_mp "gefilterter Wert Fahrzeuggeschwindigkeit" SWORD Vel 1 100 -327.6800 327.6700 FORMAT "%8.4" ECU_ADDRESS 0x8FF92E /end MEASUREMENT
/begin FUNCTION pcr_desvalcalc "Ladedruck Sollwertbildung"
 /begin DEF_CHARACTERISTIC PCR_tiDT1DesCld_C PCR_DKdDesCld_C PCR_DKdPosDesCld_C PCR_DKdNegDesCld_C PCR_dpDWinPosDesCld_C PCR_dpDWinNegDesCld_C PCR_dpBDes_C PCR_dpSlpLimDwn_C PCR_dpSlpLimUp_C PCR_dqDes_C PCR_drAPP1UnFlt_C PCR_tiBDesRaw_C PCR_dpBDesRaw_C PCR_tiDT1qDes_C PCR_DKdqDes_C PCR_tiDT1rAPP1_C PCR_DKdrAPP1_C PCR_facATRgn_CUR PCR_facCtQ_MAP PCR_facIAT_CUR PCR_facN_CUR PCR_nLimMax_C PCR_nLimMin_C PCR_pAPQCmpnRgn_MAP PCR_pAPQCmpn_MAP PCR_pBDesBasFDC_MAP PCR_pBDesBasRgn1_MAP PCR_pBDesBasRgn2_MAP PCR_pDesBas_MAP PCR_pDesMaxAP_MAP PCR_pDesMax_C PCR_pDesMin_C PCR_pNQCtCmpn_MAP PCR_stRgnMsk1_C PCR_stRgnMsk2_C PCR_swtActSlpLim_C PCR_swtQntDesVal_C PCR_swtQntDesType_C PCR_swtSlpLimInputType_C PCR_tClntThres_C PCR_tiBDesSlpLim_C PCR_tiRmpMswt_C PCR_tiDT1DesWrm_C PCR_DKdDesWrm_C PCR_DKdPosDesWrm_C PCR_DKdNegDesWrm_C PCR_dpDWinPosDesWrm_C PCR_dpDWinNegDesWrm_C /end DEF_CHARACTERISTIC
 /begin IN_MEASUREMENT APSCD_pVal CTSCD_tClnt Eng_nAvrg IATSCD_tAir PCR_qDes /end IN_MEASUREMENT
/end FUNCTION
/begin FUNCTION pcr_desvalcalc_msg "" /begin OUT_MEASUREMENT PCR_pDesVal PCR_qDes PCR_swtQntDes /end OUT_MEASUREMENT /end FUNCTION
/begin FUNCTION pcr_desvalcalc_uic ""
 /begin DEF_CHARACTERISTIC PCR_pDesAdd_Vector PCR_pDesAdd_Channel PCR_pDes_Vector PCR_pDes_Channel /end DEF_CHARACTERISTIC
 /begin OUT_MEASUREMENT PCR_bpMap_mp PCR_dpBDesRaw_mp PCR_dqDes_mp PCR_drAPP1UnFlt_mp PCR_facATRgn_mp PCR_facAT_mp PCR_facCtQ_mp PCR_facN_mp PCR_pAPQCmpnRgn_mp PCR_pAPQCmpn_mp PCR_pBasMAP_mp PCR_pBDesAPCorrRgn1_mp PCR_pBDesAPCorrRgn2_mp PCR_pBDesAPCorr_mp PCR_pBDesATCorrRgn1_mp PCR_pBDesATCorrRgn2_mp PCR_pBDesATCorr_mp PCR_pBDesCtCorr_mp PCR_pBDesDyn_mp PCR_pBDesMaxAP_mp PCR_pBDesNCorr_mp PCR_pBDesRaw2_mp PCR_pBDesRaw3_mp PCR_pBDesRaw_mp PCR_pBDesStat_mp PCR_pBDes_mp PCR_pDesByp_mp PCR_pNQCtCmpn_mp PCR_pRgnMAP1_mp PCR_pRgnMAP2_mp PCR_qDesFrmMngTrqInr_mp PCR_stBDesLogic_mp PCR_stCmpEnd_mp /end OUT_MEASUREMENT
/end FUNCTION
/begin FUNCTION pcr_governor "Adaptiver Ladedruckregler"
 /begin DEF_CHARACTERISTIC PCR_I1AdPCVKi_C PCR_I1AdPCVKiPos_C PCR_I1AdPCVKiNeg_C PCR_rI1AdPCVWinPos_C PCR_rI1AdPCVWinNeg_C PCR_I2AdPCVKi_C PCR_I2AdPCVKiPos_C PCR_I2AdPCVKiNeg_C PCR_rI2AdPCVWinPos_C PCR_rI2AdPCVWinNeg_C PCR_I3AdPCVKi_C PCR_I3AdPCVKiPos_C PCR_I3AdPCVKiNeg_C PCR_rI3AdPCVWinPos_C PCR_rI3AdPCVWinNeg_C PCR_I4AdPCVKi_C PCR_I4AdPCVKiPos_C PCR_I4AdPCVKiNeg_C PCR_rI4AdPCVWinPos_C PCR_rI4AdPCVWinNeg_C PCR_dlyPT1_C PCR_dnAvrgAdPCVLim_C PCR_tiDnCorrDT1_C PCR_DnCorrDKd_C PCR_tiDpCorrDT1_C PCR_dpCorrDKd_C PCR_dqCtlAdPCVLim_C PCR_tiAdPCVqCtlDT1_C PCR_DKdAdPCVqCtlDT1_C PCR_drAdPCVCtlRmpUp_C PCR_drAdPCVCtlRmpDwn_C PCR_drBPGovMaxDynUp_C PCR_drBPGovMaxDynDn_C PCR_DT1_C PCR_DKd_C PCR_DKdPos_C PCR_DKdNeg_C PCR_pDWinPos_C PCR_pDWinNeg_C PCR_facBPGovMaxCorr_CUR PCR_facDnCorr_CUR PCR_facDpCorr_CUR PCR_facD_MAP PCR_facI_MAP PCR_facmSotCorr_MAP PCR_facPresPFltMax_CUR PCR_facPresPFltMin_CUR PCR_facP_MAP PCR_IKi_C PCR_IKiPos_C PCR_IKiNeg_C PCR_pIWinPos_C PCR_pIWinNeg_C PCR_mskNoAdPCVVal_C PCR_mskResetVal_C PCR_mskStopLearning_C PCR_nAvrgAdPCV1_C PCR_nAvrgAdPCV2_C PCR_nPCVMax_C PCR_nPCVMin_C PCR_pBGDevAdPCVLim_C PCR_pFltValLim_C PCR_pValAdPCVMax_C PCR_pValAdPCVMin_C PCR_PKp_C PCR_PKpPos_C PCR_PKpNeg_C PCR_pPWinPos_C PCR_pPWinNeg_C PCR_qCtlAdPCV1_C PCR_qCtlAdPCV2_C PCR_qPCVMax_C PCR_qPCVMin_C PCR_rAdPCVCtlValMax_C PCR_rAdPCVCtlValMin_C PCR_rBPGovMaxCorr_MAP PCR_rBPGovMaxDynCorr_MAP PCR_rBPGovMaxDynEnd_C PCR_rBPGovMaxDynStrt_C PCR_rBPGovMaxDyn_MAP PCR_rDistAdPCV1_C PCR_rDistAdPCV2_C PCR_rDistAdPCV3_C PCR_rDistAdPCV4_C PCR_rGvnrMax_CUR PCR_rGvnrMax_MAP PCR_rGvnrMin_CUR PCR_rGvnrMin_MAP PCR_rOutIMax_MAP PCR_stAdPCVReset_C PCR_swtAdPCVrLim_C PCR_swtIDevType_C PCR_swtLimMpCrVal_C PCR_swtLimMpCrType_C PCR_swtLimSelVal_C PCR_swtLimSelType_C PCR_swtRawCur_C PCR_swtRelAbsVal_C PCR_swtRelAbsType_C PCR_tAirAdPCVMax_C PCR_tAirAdPCVMin_C PCR_tClntAdPCVLim_C PCR_tiHiLoAdPCVRelCond0_C PCR_tiLoHiAdPCVRelCond0_C PCR_tiHiLoAdPCVRelCond3_C PCR_tiLoHiAdPCVRelCond3_C /end DEF_CHARACTERISTIC
 /begin IN_MEASUREMENT APSCD_pVal BPSCD_dFltValDT1 CoEng_dvolFlConsum Eng_nAvrg InjCtl_qCurr PCR_dn_mp PCR_dpBGDev_mp PCR_qReal PFlt_mSot PFlt_pPre /end IN_MEASUREMENT
/end FUNCTION
/begin FUNCTION pcr_governor_msg ""
 /begin OUT_MEASUREMENT PCR_dqCtlA PCR_pBGDev PCR_qReal PCR_rBPGovMax PCR_rBPGovMin PCR_rBPLim PCR_rGvnr PCR_rGvnr2 PCR_swtLimSel PCR_swtRelAbs /end OUT_MEASUREMENT
/end FUNCTION
/begin FUNCTION pcr_governor_uic ""
 /begin OUT_MEASUREMENT PCR_DKd_mp PCR_dn_mp PCR_dpBGDev_mp PCR_facAdPCVc1_mp PCR_facAdPCVc2_mp PCR_facAdPCVc3_mp PCR_facAdPCVc4_mp PCR_facAdPCVrx_mp PCR_facAdPCVry_mp PCR_facD1_mp PCR_facDnCorr_mp PCR_facDpCorr_mp PCR_facD_mp PCR_facI_mp PCR_facmSotCorr_mp PCR_facP_mp PCR_pBDesFlt_mp PCR_pBGDev2_mp PCR_pBGDevI_mp PCR_rAdPCVCtlValLim_mp PCR_rAdPCVCtlVal_mp PCR_rAdPCVI1_mp PCR_rAdPCVI2_mp PCR_rAdPCVI3_mp PCR_rAdPCVI4_mp PCR_rBPGovMaxDynRamp_mp PCR_rBPGovMaxDyn_mp PCR_rBPGovMaxVal1_mp PCR_rBPGovMaxVal2_mp PCR_rBPGovMax_mp PCR_rBPGovMin_mp PCR_rBPGvnrUnLim1_mp PCR_rBPGvnrUnLim2_mp PCR_rBPLim_mp PCR_rInitI1AdPCV_mp PCR_rInitI2AdPCV_mp PCR_rInitI3AdPCV_mp PCR_rInitI4AdPCV_mp PCR_rOutAdPCVI1_mp PCR_rOutAdPCVI2_mp PCR_rOutAdPCVI3_mp PCR_rOutAdPCVI4_mp PCR_rOutDT1_mp PCR_rOutILim_mp PCR_rOutIMax_mp PCR_rOutI_mp PCR_rOutP_mp PCR_rPICtl_mp PCR_stAdPCVLogic_mp PCR_stAdPCVRelCond_mp PCR_stAdPCV_mp PCR_stEepAdPCV_mp PCR_stEepBlock_mp PCR_stSwtBPGovMaxDyn_mp /end OUT_MEASUREMENT
/end FUNCTION
/begin FUNCTION pcr_governor_var "" /begin DEF_CHARACTERISTIC PCR_rARWIMin_C PCR_swtARWMode_C /end DEF_CHARACTERISTIC /end FUNCTION
/begin FUNCTION pcr_governor_var_msg "" /end FUNCTION
/begin FUNCTION pcr_governor_var_uic "" /begin OUT_MEASUREMENT PCR_rPIDCtl_mp PCR_rstI_mp /end OUT_MEASUREMENT /end FUNCTION
/begin FUNCTION pcr_lpgovernor ""
 /begin DEF_CHARACTERISTIC PCR_drBPALPRmpUp_C PCR_drBPALPRmpDwn_C PCR_tiDT1LP_C PCR_DKdLP_C PCR_DKdPosLP_C PCR_DKdNegLP_C PCR_pDWinPosLP_C PCR_pDWinNegLP_C PCR_IKiLP_C PCR_IKiPosLP_C PCR_IKiNegLP_C PCR_pIWinPosLP_C PCR_pIWinNegLP_C PCR_pBDesLPRgn1_MAP PCR_pBDesLPRgn2_MAP PCR_pBDesLP_MAP PCR_pBDesMaxAPLP_MAP PCR_PKpLP_C PCR_PKpPosLP_C PCR_PKpNegLP_C PCR_pPWinPosLP_C PCR_pPWinNegLP_C PCR_rBPBasLPRgn1_MAP PCR_rBPBasLPRgn2_MAP PCR_rBPBasLP_MAP PCR_rBPRglBasLPRgn1_MAP PCR_rBPRglBasLPRgn2_MAP PCR_rBPRglBasLP_MAP PCR_rDt1InitLP_C PCR_rGovMaxLP_C PCR_rGovMinLP_C PCR_rIInitLP_C PCR_rMaxLP_C PCR_rMinLP_C PCR_stRgnMskLP1_C PCR_stRgnMskLP2_C PCR_tiRmpSlp_C /end DEF_CHARACTERISTIC
 /begin IN_MEASUREMENT APSCD_pVal Eng_nAvrg PCR_qDes /end IN_MEASUREMENT
/end FUNCTION
/begin FUNCTION pcr_lpgovernor_msg "" /begin OUT_MEASUREMENT PCR_pBGDvtLP PCR_rGvnrLP /end OUT_MEASUREMENT /end FUNCTION
/begin FUNCTION pcr_lpgovernor_uic ""
 /begin OUT_MEASUREMENT PCR_pBDesLPUnLim_mp PCR_pBDesLP_mp PCR_rBPBasLP_mp PCR_rBPRglBasLP_mp PCR_rOutDLP_mp PCR_rOutILP_mp PCR_rOutLimLP_mp PCR_rOutLP_mp PCR_rOutPIDLP_mp PCR_rOutPILP_mp PCR_rOutPLP_mp /end OUT_MEASUREMENT
/end FUNCTION
/begin FUNCTION pcr_lpmonitor "PCR Monitoring  at Low Pressure"
 /begin DEF_CHARACTERISTIC PCR_DebLPDvtNegDef_C PCR_DebLPDvtNegOk_C PCR_DebLPDvtPosDef_C PCR_DebLPDvtPosOk_C PCR_nLPWrkSph2_C PCR_nLPWrkSph3_C PCR_pLPDvtMaxOffset_C PCR_pLPDvtMax_MAP PCR_pLPDvtMinOffset_C PCR_pLPDvtMin_MAP PCR_qLPClutchThres_CUR PCR_qLPGvnrOffRgn_CUR PCR_qLPGvnrOff_CUR PCR_qLPGvnrOnRgn_CUR PCR_qLPGvnrOn_CUR PCR_qLPWrkSph2_C PCR_qLPWrkSph3_C PCR_rLPDflVal09_C PCR_rLPDflVal12_C PCR_rLPDflVal18_C PCR_stLPMonCur_C PCR_swtLPV8_C PCR_tiLPClutchDebHighLow_C PCR_tiLPClutchDebLowHigh_C PCR_vLPClutch_C /end DEF_CHARACTERISTIC
 /begin IN_MEASUREMENT Eng_nAvrg InjCtl_qCurr /end IN_MEASUREMENT
/end FUNCTION
/begin FUNCTION pcr_lpmonitor_msg ""
 /begin OUT_MEASUREMENT PCR_rBPALP PCR_rBPALP2 PCR_stLPMonitor PCR_stLPPCR PCR_stLPWorkSph PCR_swtLPGvnr /end OUT_MEASUREMENT
/end FUNCTION
/begin FUNCTION pcr_lpmonitor_uic ""
 /begin OUT_MEASUREMENT PCR_pLPDvtMaxRaw_mp PCR_pLPDvtMax_mp PCR_pLPDvtMinRaw_mp PCR_pLPDvtMin_mp PCR_qLPGvnrOff_mp PCR_qLPGvnrOn_mp PCR_stLPClutch_mp PCR_stLPRgn_mp PCR_swtLPGvnrV1_mp /end OUT_MEASUREMENT
/end FUNCTION
/begin FUNCTION pcr_monitor "Ladedruckregelung - Überwachung und Abschaltung"
 /begin DEF_CHARACTERISTIC PCR_DebSRCHighDef_C PCR_DebSRCHighOk_C PCR_DebSRCLowDef_C PCR_DebSRCLowOk_C PCR_nCoStart_C PCR_nCoStrtHigh_C PCR_nWrkSph1_C PCR_nWrkSph2_C PCR_nWrkSph3_C PCR_pBGDevMaxOffset_C PCR_pBGDevMax_MAP PCR_pBGDevMinOffset_C PCR_pBGDevMin_MAP PCR_qClutchThres_C PCR_qClutchThres_CUR PCR_qRgtOffRgn_CUR PCR_qRgtOff_CUR PCR_qRgtOnRgn_CUR PCR_qRgtOn_CUR PCR_qWrkSph2_C PCR_qWrkSph3_C PCR_rCBOpn_C PCR_rDflVal04_C PCR_rDflVal05_C PCR_rDflVal06_C PCR_rDflVal12_C PCR_rDflVal15_MAP PCR_rDflVal18_C PCR_rDflVal24_C PCR_stMonCur_C PCR_swtV8_C PCR_tiClutchDebHighLow_C PCR_tiClutchDebLowHigh_C PCR_tiCoStrt_CUR PCR_tiGvnrOffDel_CUR PCR_tiStrtDelayInit_C PCR_vClutch_C /end DEF_CHARACTERISTIC
 /begin IN_MEASUREMENT CTSCD_tClnt Eng_nAvrg InjCtl_qCurr PCR_qReal /end IN_MEASUREMENT
/end FUNCTION
/begin FUNCTION pcr_monitor_msg ""
 /begin OUT_MEASUREMENT PCR_rBPA PCR_rBPA2 PCR_stMonitor PCR_stPCR PCR_stWorkSph PCR_swtGvnr /end OUT_MEASUREMENT
/end FUNCTION
/begin FUNCTION pcr_monitor_uic ""
 /begin DEF_CHARACTERISTIC PCR_rBPACDAdd_Vector PCR_rBPACDAdd_Channel PCR_rBPACD_Vector PCR_rBPACD_Channel /end DEF_CHARACTERISTIC
 /begin OUT_MEASUREMENT PCR_pBGDevMaxRaw_mp PCR_pBGDevMax_mp PCR_pBGDevMinRaw_mp PCR_pBGDevMin_mp PCR_rBPACDByp_mp PCR_stClutch_mp PCR_stCpBVlv_mp PCR_stPCR_mp PCR_tiStrtDelay_mp /end OUT_MEASUREMENT
/end FUNCTION
/begin FUNCTION pcr_monitor_var "" /end FUNCTION
/begin FUNCTION pcr_monitor_var_msg "" /end FUNCTION
/begin FUNCTION pcr_monitor_var_uic "" /end FUNCTION
/begin FUNCTION pcr_surgectl "LDR-AntiSurge Regler"
 /begin DEF_CHARACTERISTIC PCR_dnSurgeCtlRel_C PCR_dpSurgeCtlRmpUp_C PCR_dpSurgeCtlRmpDwn_C PCR_dqSurgeCtlRel_C PCR_drSurgeCtlRmpUp_C PCR_drSurgeCtlRmpDwn_C PCR_facSurgeDes_CUR PCR_facSurgeI_MAP PCR_facSurgeP_MAP PCR_ISurgeKi_C PCR_ISurgeKiPos_C PCR_ISurgeKiNeg_C PCR_facSurgeIWinPos_C PCR_facSurgeIWinNeg_C PCR_pBSurgeDesMax_MAP PCR_pBSurgeDesMin_MAP PCR_pBSurgeDes_CUR PCR_pDvtSurgeCtlRel_C PCR_pSurgeARWIMin_C PCR_PSurgeKp_C PCR_PSurgeKpPos_C PCR_PSurgeKpNeg_C PCR_facSurgePWinPos_C PCR_facSurgePWinNeg_C PCR_rSurgeGvnrOff_CUR PCR_rSurgeGvnrOn_MAP PCR_rSurgeGvnr_MAP PCR_tiSurgeGvnrPT1_C PCR_swtSurgeARWMode_C PCR_swtSurgeGvnrSel_C PCR_tiSurgeCtlHiLoRel3_C PCR_tiSurgeCtlLoHiRel3_C PCR_tiSurgeCtlHiLoRelAll_C PCR_tiSurgeCtlLoHiRelAll_C /end DEF_CHARACTERISTIC
 /begin IN_MEASUREMENT APSCD_pLinVal Eng_nAvrg InjCtl_qCurr PCR_pBSurgePICtlLim_mp /end IN_MEASUREMENT
/end FUNCTION
/begin FUNCTION pcr_surgectl_msg "" /begin OUT_MEASUREMENT PCR_pBSurgeDes PCR_rGvnrSurge PCR_swtSurgeGvnr /end OUT_MEASUREMENT /end FUNCTION
/begin FUNCTION pcr_surgectl_uic ""
 /begin OUT_MEASUREMENT PCR_facSGDevI_mp PCR_facSurgeDes_mp PCR_facSurgeGvnrDev_mp PCR_facSurgeI_mp PCR_facSurgeP_mp PCR_pBSurgeDesMax_mp PCR_pBSurgeDesMin_mp PCR_pBSurgeDesRaw_mp PCR_pBSurgePICtlLim_mp PCR_pBSurgePICtl_mp PCR_pSOutI_mp PCR_pSOutP_mp PCR_pSurgestI_mp PCR_rGvnrSurgeRaw_mp PCR_rSurgeGvnrHysOff_mp PCR_rSurgeGvnrOff_mp PCR_rSurgeGvnrOn_mp PCR_swtSurgeGvnrRel_mp PCR_swtSurgeGvnrSel_mp /end OUT_MEASUREMENT
/end FUNCTION
/begin FUNCTION pcr_surgedet "Turboladerpumpgrenzerkennung"
 /begin DEF_CHARACTERISTIC PCR_ctAirPerTimeFrq_C PCR_facAirPerTimeAmplMax_C PCR_facAirPerTimeAmplMin_C PCR_facCnv_CUR PCR_facSin_CUR PCR_facSqr_CUR PCR_tiDebSurge1_C PCR_tiDebSurge2_C PCR_swtAirPerTimeDet_C PCR_swtFacCnv_C PCR_tiAirPerTimeAmplFlt_C PCR_tiAirPTCtlFlt1_C PCR_tiAirPTCtlFlt2_C PCR_tiDelPreSurgeDet_C /end DEF_CHARACTERISTIC
 /begin IN_MEASUREMENT PCR_facAirPerTimeAmplFlt_mp PCR_facSinIn_mp PCR_facSqrIn_mp /end IN_MEASUREMENT
/end FUNCTION
/begin FUNCTION pcr_surgedet_msg "" /begin OUT_MEASUREMENT PCR_facAirPerTimeAmplFlt PCR_stPreSurge PCR_stSurge /end OUT_MEASUREMENT /end FUNCTION
/begin FUNCTION pcr_surgedet_uic ""
 /begin OUT_MEASUREMENT PCR_facAirAmplFlt_mp PCR_facAirPerTimeAmplFlt_mp PCR_facAirPerTimeAmpl_mp PCR_facAirPTAmpl1_mp PCR_facAirPTAmpl2Flt_mp PCR_facAirPTAmpl2_mp PCR_facCosCoeffDFT_mp PCR_facSinCoeffDFT_mp PCR_facSinIn_mp PCR_facSinOut_mp PCR_facSqrIn_mp /end OUT_MEASUREMENT
/end FUNCTION
/begin FUNCTION pcvcd_co "Druckregelventil Komponententreiber"
 /begin DEF_CHARACTERISTIC PCVCD_uSRCMin_C PCVCD_uSRCMax_C PCVCD_iLin_CUR PCVCD_ctPwrStgOnMax_C PCVCD_dcycMax_C PCVCD_dcycMin_C PCVCD_DebExcTempDef_C PCVCD_DebExcTempOk_C PCVCD_DebNoLoadDef_C PCVCD_DebNoLoadOk_C PCVCD_DebShortCircBatDef_C PCVCD_DebShortCircBatOk_C PCVCD_DebShortCircGndDef_C PCVCD_DebShortCircGndOk_C PCVCD_DebSRCHighDef_C PCVCD_DebSRCHighOk_C PCVCD_DebSRCLowDef_C PCVCD_DebSRCLowOk_C PCVCD_facIGovInit_CUR PCVCD_facIGovMax_C PCVCD_facIGovMin_C PCVCD_tiFlt1PT1_C PCVCD_tiFlt2PT1_C PCVCD_tiIGovDT1_C PCVCD_IGovDKd_C PCVCD_IGovIKi_C PCVCD_IGovIKiPos_C PCVCD_IGovIKiNeg_C PCVCD_iIGovIWinPos_C PCVCD_iIGovIWinNeg_C PCVCD_tiFltPT1Init_C PCVCD_numAdc_C PCVCD_numDia1_C PCVCD_numDia2_C PCVCD_numPwmOut_C PCVCD_stInvOut_C PCVCD_tiPer_C PCVCD_resCoil_C PCVCD_stPwrStgDia_C PCVCD_stSPICtl_C PCVCD_swtCtlStateVal_C PCVCD_swtCtlStateType_C PCVCD_swt_C PCVCD_tiBtwTst_C PCVCD_tiIGovInit_C PCVCD_tiPwrStgOn_C PCVCD_tiDebSigDefSigTst_C PCVCD_tiDebSigOkSigTst_C /end DEF_CHARACTERISTIC
 /begin IN_MEASUREMENT FlSys_t PCVCD_uRawVal_mp /end IN_MEASUREMENT
/end FUNCTION
/begin FUNCTION pcvcd_co_msg "" /begin OUT_MEASUREMENT PCVCD_iActVal PCVCD_swtCtlState /end OUT_MEASUREMENT /end FUNCTION
/begin FUNCTION pcvcd_co_uic ""
 /begin OUT_MEASUREMENT PCVCD_dcycDT1_mp PCVCD_dcycOut_mp PCVCD_dcycSetVal_mp PCVCD_facIGov_mp PCVCD_iActFlt_mp PCVCD_iDvt_mp PCVCD_iGovActVal_mp PCVCD_iSetFlt_mp PCVCD_uRawVal_mp /end OUT_MEASUREMENT
/end FUNCTION
/begin FUNCTION pcv_leak "Leckage des Druckregelventils" /begin DEF_CHARACTERISTIC PCV_dvolLeak_CUR /end DEF_CHARACTERISTIC /begin IN_MEASUREMENT Rail_pSetPoint /end IN_MEASUREMENT /end FUNCTION
/begin FUNCTION pcv_leak_uic "" /begin OUT_MEASUREMENT PCV_dvolLeak_mp /end OUT_MEASUREMENT /end FUNCTION
/begin FUNCTION pcv_msg "" /end FUNCTION
/begin FUNCTION pcv_setcurr "Berechnung elektrischer Sollstrom für das Druckregelventil" /begin DEF_CHARACTERISTIC PCV_iCnvPress_CUR PCV_iSetMin_C /end DEF_CHARACTERISTIC /begin IN_MEASUREMENT Rail_pPCVSet /end IN_MEASUREMENT /end FUNCTION
/begin FUNCTION pcv_setcurr_uic "" /begin DEF_CHARACTERISTIC PCV_iSet_Vector PCV_iSet_Channel /end DEF_CHARACTERISTIC /begin OUT_MEASUREMENT PCV_iSet_mp PCV_stActrCtl_mp /end OUT_MEASUREMENT /end FUNCTION
/begin FUNCTION pfltcd_getppre "Absolutdruck vor dem Partikelfilter"
 /begin DEF_CHARACTERISTIC PFltCD_uSRCMinPPre_C PFltCD_uSRCMaxPPre_C PFltCD_pLinPre_CUR PFltCD_DebSRCHiDefPPre_C PFltCD_DebSRCHiOkPPre_C PFltCD_DebSRCLoDefPPre_C PFltCD_DebSRCLoOkPPre_C PFltCD_dtRmpSlpUpPPre_C PFltCD_dtRmpSlpDwnPPre_C PFLTCD_numAdc2_C PFltCD_pPreCor_CUR PFltCD_tiPPrePT1_C PFltCD_stSensIDWordPPre_C PFltCD_pDflPre_C /end DEF_CHARACTERISTIC
 /begin IN_MEASUREMENT PFltCD_uRawPresPre_mp PFlt_dvol /end IN_MEASUREMENT
/end FUNCTION
/begin FUNCTION pfltcd_getppre_msg "" /begin OUT_MEASUREMENT PFltCD_pLinPre PFltCD_pPre /end OUT_MEASUREMENT /end FUNCTION
/begin FUNCTION pfltcd_getppre_uic "" /begin OUT_MEASUREMENT PFltCD_uRawPresPre_mp /end OUT_MEASUREMENT /end FUNCTION
/begin FUNCTION pfltcd_gettpre "Abgastemperatur vor dem Partikelfilter"
 /begin DEF_CHARACTERISTIC PFltCD_uSRCMinTempPre_C PFltCD_uSRCMaxTempPre_C PFltCD_tLinPre_CUR PFltCD_DebSRCHighDefTPre_C PFltCD_DebSRCHighOkTPre_C PFltCD_DebSRCLowDefTPre_C PFltCD_DebSRCLowOkTPre_C PFltCD_dtRmpSlpUpPre_C PFltCD_dtRmpSlpDwnPre_C PFLTCD_numAdc_C PFltCD_tPreCor_CUR PFltCD_stSensIDWordTPre_C PFltCD_tDflPre_C /end DEF_CHARACTERISTIC
 /begin IN_MEASUREMENT PFltCD_uRawTempPre PFlt_dmEG /end IN_MEASUREMENT
/end FUNCTION
/begin FUNCTION pfltcd_gettpre_msg "" /begin OUT_MEASUREMENT PFltCD_tLinPre PFltCD_tPre PFltCD_uRawTempPre /end OUT_MEASUREMENT /end FUNCTION
/begin FUNCTION pflt_ashcor ""
 /begin DEF_CHARACTERISTIC PFlt_aVehFltAshCorMax_C PFlt_aVehFltAshCorMin_C PFlt_ctAshCorRgnMax_C PFlt_ctAshCorRgn_C PFlt_facAshCorOld_C PFlt_facAshOil_C PFlt_facFlTotCor_C PFlt_faclAshCor_C PFlt_lAshCorMax_C PFlt_lAshCorNextDef_C PFlt_lAshCorNplAbsRel_C PFlt_lAshCorNplAbs_C PFlt_lAshCorNplRel_C PFlt_lAshCorRegIntr_C PFlt_lMinSnceRgn_C PFlt_mAshCor_MAP PFlt_mAshTolcAbs_C PFlt_mAshTolcMaxAbs_C PFlt_mAshTolcMaxRel_C PFlt_nAvrgFltAshCorMax_C PFlt_nAvrgFltAshCorMin_C PFlt_numAshCorMsk_C PFlt_numAshCor_C PFlt_numPFltErrRgnIntr_C PFlt_numPFltErr_C PFlt_qFlTotMin_C PFlt_qSetUnBalFltAshCorMax_C PFlt_qSetUnBalFltAshCorMin_C PFlt_swtAshCorActive_C PFlt_swtAshCorOn_C PFlt_tAirFltAshCorMax_C PFlt_tAirFltAshCorMin_C PFlt_tCIntAshCorMax_C PFlt_tCIntAshCorMin_C PFlt_tiAshCorAirTempPT1_C PFlt_tiAshCorCIntTempPT1_C PFlt_tiAshCorDVolPT1_C PFlt_tiAshCorEngSpdPT1_C PFlt_tiAshCorInjMsPT1_C PFlt_tiAshCorOxiTempPT1_C PFlt_tiAshCorPreTempPT1_C PFlt_tiAshCorResFlowPT1_C PFlt_tiAshCorRlsOn_C PFlt_tiAshCorVehAccPT1_C PFlt_tiAshCorVehSpdPT1_C PFlt_tiAshCorWaitMax_C PFlt_tiPFltErrPer_C PFlt_tiPFltErrRgn_C PFlt_tOxiPreFltAshCorMax_C PFlt_tOxiPreFltAshCorMin_C PFlt_tPreFltAshCorMax_C PFlt_tPreFltAshCorMin_C PFlt_vVehFltAshCorMax_C PFlt_vVehFltAshCorMin_C /end DEF_CHARACTERISTIC
 /begin IN_MEASUREMENT PFlt_dVolFltAshCor_mp PFlt_resFlowFltAshCor_mp /end IN_MEASUREMENT
/end FUNCTION
/begin FUNCTION pflt_ashcor_msg ""
 /begin OUT_MEASUREMENT PFlt_lAshCorNext PFlt_mAshCorAct PFlt_mAshCorNew PFlt_mAshCorOld PFlt_numPrj PFlt_qFlTotCor PFlt_stAshCorRgnMax /end OUT_MEASUREMENT
/end FUNCTION
/begin FUNCTION pflt_ashcor_uic ""
 /begin OUT_MEASUREMENT PFlt_aVehFltAshCor_mp PFlt_ctNumAshCorMax_mp PFlt_ctNumAshCor_mp PFlt_dqFlTotAct_mp PFlt_dqFlTotEnd_mp PFlt_dVolFltAshCorRaw_mp PFlt_dVolFltAshCor_mp PFlt_facAshCorDiff_mp PFlt_lAshCorAct_mp PFlt_lAshCorNextEEProm_mp PFlt_lAshCorNextMax_mp PFlt_lAshCorNextOilCor_mp PFlt_lAshCorOldCalc_mp PFlt_lAshCorStep_mp PFlt_mAshCorActRel_mp PFlt_mAshCorDiff1_mp PFlt_mAshCorDiff2_mp PFlt_mAshCorDiff_mp PFlt_nAvrgFltAshCor_mp PFlt_qSetUnBalFltAshCor_mp PFlt_resFlowFltAshCorRaw_mp PFlt_resFlowFltAshCor_mp PFlt_stAshCorCalc_mp PFlt_stAshCorDist_mp PFlt_stAshCorRgn_mp PFlt_stAshCorRlsOn_mp PFlt_stAshCorRls_mp PFlt_stAshCor_mp PFlt_stFlTotCorOn_mp PFlt_stFlTotCor_mp PFlt_stPFltErr_mp PFlt_tAirFltAshCor_mp PFlt_tCIntFltAshCor_mp PFlt_tiPFltErr_mp PFlt_tOxiPreFltAshCor_mp PFlt_tPreFltAshCor_mp PFlt_vVehFltAshCor_mp /end OUT_MEASUREMENT
/end FUNCTION
/begin COMPU_METHOD Acc "Fahrzeugbeschleunigung" RAT_FUNC "%6.5" "m/s^2" COEFFS 0 1000 0 0 0 1 /end COMPU_METHOD
/begin COMPU_METHOD AirMassPerTime "Luftmasse pro Zeit" RAT_FUNC "%6.3" "Kg/h" COEFFS 0 10 0 0 0 1 /end COMPU_METHOD
/begin COMPU_METHOD CubMtrPerHr "Volumsstrom in m^3/h" RAT_FUNC "%6.3" "m^3/h" COEFFS 0 10 0 0 0 1 /end COMPU_METHOD
/begin COMPU_METHOD Curr "Strom" RAT_FUNC "%6.2" "mA" COEFFS 0 1 0 0 0 1 /end COMPU_METHOD
/begin COMPU_METHOD dn_dZ20 "Motorbeschleunigung pro Zeit (dn/dt) (im 20 ms Raster)" RAT_FUNC "%6.1" "rmp/s" COEFFS 0 0.1 0 0 0 1 /end COMPU_METHOD
/begin COMPU_METHOD dp_dZ10 "boost pressure per time (dp/dt) every 10ms" RAT_FUNC "%6.1" "hPa/s" COEFFS 0 0.1 0 0 0 1 /end COMPU_METHOD
/begin COMPU_METHOD dp_dZ20 " boost pressure per time (dp/dt) every 20ms" RAT_FUNC "%6.1" "hPa/s" COEFFS 0 0.1 0 0 0 1 /end COMPU_METHOD
/begin COMPU_METHOD DtyCyc "Tastverhaeltnis" RAT_FUNC "%6.4" "%" COEFFS 0 100 0 0 0 1 /end COMPU_METHOD
/begin COMPU_METHOD EGTRmp "Zeitrampe verwendet von EGT Lib Funktionen" RAT_FUNC "%6.3" "s" COEFFS 0 0 1 0 0.0152587890625 0 /end COMPU_METHOD
/begin COMPU_METHOD EngN "Motordrehzahl" RAT_FUNC "%6.2" "rpm" COEFFS 0 1 0 0 0 1 /end COMPU_METHOD
/begin COMPU_METHOD Fact "Faktor mit Auflösung 1 / 8192, hauptsächlich für einen Faktorenbereich 0...1 verwendet" RAT_FUNC "%6.5" "-" COEFFS 0 8192 0 0 0 1 /end COMPU_METHOD
/begin COMPU_METHOD Fact1 "Faktor mit Auflösung 0,01 (100 mal höherer Bereich als Fact)" RAT_FUNC "%6.4" "-" COEFFS 0 128 0 0 0 1 /end COMPU_METHOD
/begin COMPU_METHOD FactM "Low resolution factor for airmass" RAT_FUNC "%6.4" "-" COEFFS 0 16 0 0 0 1 /end COMPU_METHOD
/begin COMPU_METHOD FlConsum_l_h "Kraftstoffverbrauch" RAT_FUNC "%6.4" "l/h" COEFFS 0 100 0 0 0 1 /end COMPU_METHOD
/begin COMPU_METHOD Fl_2 "Umrechnung for getting 16 bit  total fuel consumption" RAT_FUNC "%6.1" "l" COEFFS 0 0.1 0 0 0 1 /end COMPU_METHOD
/begin COMPU_METHOD InjMass "Einspritzmenge" RAT_FUNC "%6.4" "mg/hub" COEFFS 0 100 0 0 0 1 /end COMPU_METHOD
/begin COMPU_METHOD InjMassCyc "Einspritzmenge pro Zyklus (mg/Zyklus)" RAT_FUNC "%6.4" "mg/cyc" COEFFS 0 100 0 0 0 1 /end COMPU_METHOD
/begin COMPU_METHOD InjMassPerSec_20ms "Einspritzmengenänderung pro Sekunde für 20ms-Tasks" RAT_FUNC "%6.3" "mg/hub/s" COEFFS 0 2 0 0 0 1 /end COMPU_METHOD
/begin COMPU_METHOD Kd "Differentialverstärkung Kd (gleiche Einheit/Umrechnungsformel an Ein- und Ausgang)" RAT_FUNC "%7.6" "1/1" COEFFS 0 65536 0 0 0 1 /end COMPU_METHOD
/begin COMPU_METHOD Kd_Pres2dpdt "differential gain(boost pressure to rate of change of boost pressure)" RAT_FUNC "%8.7" "hPa/sec/hPa" COEFFS 0 131072 0 0 0 1 /end COMPU_METHOD
/begin COMPU_METHOD Kd_Pres2Prc "Differentialverstärkung Kd (Druck Pres zu Prozent Prc)" RAT_FUNC "%9.8" "%/hPa" COEFFS 0 5368709.120000 0 0 0 1 /end COMPU_METHOD
/begin COMPU_METHOD Kd_Pres_hPa2Prc "Differentialverstärkung Kd (Druck Pres_hPa zu Prozent Prc)" RAT_FUNC "%9.8" "%/hPa" COEFFS 0 5368709.12 0 0 0 1 /end COMPU_METHOD
/begin COMPU_METHOD Kd_rpm2dndt "differential gain(engine speed to rate of change of engine speed)" RAT_FUNC "%8.7" "rmp/sec/rpm" COEFFS 0 131072 0 0 0 1 /end COMPU_METHOD
/begin COMPU_METHOD Ki "Integrale Verstärkung Ki (gleiche Einheit/Umrechnungsregel an Ein- und Ausgang)" RAT_FUNC "%6.5" "1/s" COEFFS 0 4294.967296 0 0 0 1 /end COMPU_METHOD
/begin COMPU_METHOD Ki_curr2fact "Integralverstärkung (Strom Curr zu Faktor Fact)" RAT_FUNC "%10.9" "1/mA*s" COEFFS 0 35184372.088832 0 0 0 1 /end COMPU_METHOD
/begin COMPU_METHOD Ki_Pres_fac2hPa "Gain Conversion from Factor to Hpa" RAT_FUNC "%6.4" "hPa/s" COEFFS 0 268.435456 0 0 0 1 /end COMPU_METHOD
/begin COMPU_METHOD Ki_Pres_hPa2Prc "Integralverstärkung (Druck Pres_hPa zu Prozent Prc)" RAT_FUNC "%8.7" "%/(hPa*s)" COEFFS 0 351843.72088832 0 0 0 1 /end COMPU_METHOD
/begin COMPU_METHOD Kp_Pres_fac2hPa "Gain Conversion from Factor to Hpa" RAT_FUNC "%6.5" "hPa" COEFFS 0 4096 0 0 0 1 /end COMPU_METHOD
/begin COMPU_METHOD Kp_Pres_hPa2Prc "Proportionale Verstärkung (Druck Pres_hPa zu Prozent Prc)" RAT_FUNC "%9.8" "%/hPa" COEFFS 0 5368709.12 0 0 0 1 /end COMPU_METHOD
/begin COMPU_METHOD Length "Länge in Meter" RAT_FUNC "%6.2" "m" COEFFS 0 1 0 0 0 1 /end COMPU_METHOD
/begin COMPU_METHOD LengthKm "Länge in Kilometer" RAT_FUNC "%6.2" "km" COEFFS 0 1 0 0 0 1 /end COMPU_METHOD
/begin COMPU_METHOD mSoot_g "Rußmasse [g]" RAT_FUNC "%6.4" "g" COEFFS 0 100 0 0 0 1 /end COMPU_METHOD
/begin COMPU_METHOD NumPinAdc "verbale Umrechnung für ADC Signale" TAB_VERB "%6.3" "-" COMPU_TAB_REF NumPinAdc /end COMPU_METHOD
/begin COMPU_VTAB NumPinAdc "verbale Umrechnung für ADC Signale" TAB_VERB 27 0 "Water_Temperature_Sensor_182" 1 "Intake_Air_Temperature_Sensor_157" 2 "Charge_Air_Temperature_Sensor_183" 3 "Exhaust_Temperature_Sensor_2_134" 4 "Exhaust_Temperature_Sensor_1_158" 5 "1st_APP_Sensor_252" 6 "2nd_APP_Sensor_239" 7 "ADC_REF" 8 "Boost_Pressure_Sensor_154" 9 "Atmospheric_Pressure_Sensor" 10 "Battery_Voltage_Sensor" 11 "Rail_Pressure_Sensor_156" 12 "Rail_Pressure_Peak_Value_156" 13 "Booster_Voltage_Sensor" 14 "Current_MeUn_Sensor" 15 "Current_PCV_Sensor" 16 "Voltage_Bank_1" 17 "Voltage_Bank_2" 18 "Pressure_Upstream_Particle_Filter_159" 19 "Engine_Oil_Pressure_110" 20 "Temperature_ECU_PCB" 21 "Voltage_Lambda_Ua" 22 "Voltage_Lambda_Ri" 23 "EMCCD_Current_Governor1_124" 24 "EMCCD_Current_Governor2_121" 25 "ADC_DUMMY_NOT_USED" 26 "ADC_DUMMY_A_NOT_USED" /end COMPU_VTAB
/begin COMPU_METHOD NumPinDia "Verbale Umrechnung für Diagnose Signale" TAB_VERB "%6.3" "-" COMPU_TAB_REF NumPinDia /end COMPU_METHOD
/begin COMPU_VTAB NumPinDia "Verbale Umrechnung für Diagnose Signale" TAB_VERB 28 0 "CJ945_Diagnostic_Signal" 1 "AC_Compressor_DiaSig" 2 "Fuel_Pump_Diagnostic_Signal_232" 3 "Starter_234" 4 "Oil_Pressure_Lamp_Switch_245" 5 "Engine_Bay_Air_Flaps_123" 6 "Ebox_Fan_Actuator_Diagnostic_Signal_219" 7 "Shuttr_Actuator_Diagnostic_Signal_231" 8 "Twostage_TurboLoading_SW_DiaSig" 9 "DIO_OUT_DIAGNOSTIC_DUMMY_NOT_USED" 10 "Alternator" 11 "Boost_Pressure_Actuator_Diagnostic_Signal_193" 12 "EGR_Actuator_Diagnostic_Signal_194" 13 "1st_Pressure_Control_Valve_Diagnostic_Signal_172" 14 "2nd_Pressure_Control_Valve_Diagnostic_Signal_172" 15 "1st_Metering_Unit_Diagnostic_Signal_171" 16 "2nd_Metering_Unit_Diagnostic_Signal_171" 17 "Variable_Swirl_Actuator_Diagnostic_Signal_195" 18 "FAN_240" 19 "Add_On_Heater_244" 20 "EngM_Bearing_Actuator_Diagnostic_Signal_124" 21 "EngM_Bearing_Actuator_Diagnostic_Signal_121" 22 "Throttle_Valve_Diagnostic_Signal_196" 23 "Low pressure stage BPA_Diagnostic_Signal_117" 24 "PWM_DIAGNOSTIC_DUMMY_NOT_USED" 25 "1st_Sensor_Supply_Voltage_DiaSig" 26 "2nd_Sensor_Supply_Voltage_DiaSig" 27 "3rd_Sensor_Supply_Voltage_DiaSig" /end COMPU_VTAB
/begin COMPU_METHOD NumPinPwmOut "Verbale Umrechnung für PWM-Ausgang Signale" TAB_VERB "%6.3" "-" COMPU_TAB_REF NumPinPwmOut /end COMPU_METHOD
/begin COMPU_VTAB NumPinPwmOut "Verbale Umrechnung für PWM-Ausgang Signale" TAB_VERB 14 0 "Boost_Pressure_Actuator_193" 1 "EGR_Actuator_194" 2 "PCV_Actuator_172" 3 "MeUn_Actuator_171" 4 "Variable_Swirl_Actuator_195" 5 "Fan_Actuator_240" 6 "Add_On_Heater_244" 7 "EngM_Bearing_Actuator_124" 8 "EngM_Bearing_Actuator_121" 9 "Throttle_Valve_196" 10 "LSU_Heater_PWMOutput" 11 "Low pressure stage BPA_117" 12 "Shuttr_Actuator_PWM_231" 13 "PWM_DUMMY_NOT_USED" /end COMPU_VTAB
/begin COMPU_METHOD OneToOne "eins zu eins (physikalischer Wert ist gleich dem internen Wert)" RAT_FUNC "%6.2" "-" COEFFS 0 1 0 0 0 1 /end COMPU_METHOD
/begin COMPU_METHOD Period "Periodendauer" RAT_FUNC "%6.3" "ms" COEFFS 0 10 0 0 0 1 /end COMPU_METHOD
/begin COMPU_METHOD Prc "Prozent, gleiche interne Auflösung wie Fact, aber Darstellung in Prozent (0...100%)" RAT_FUNC "%6.4" "%" COEFFS 0 81.92 0 0 0 1 /end COMPU_METHOD
/begin COMPU_METHOD PrcPerSec "Prozentänderung pro Sekunde für 20ms-Tasks" RAT_FUNC "%6.3" "%/s" COEFFS 0 1.6384 0 0 0 1 /end COMPU_METHOD
/begin COMPU_METHOD Pres "Druck (angezeigt in [kPa])" RAT_FUNC "%7.2" "hPa" COEFFS 0 1.000000 0 0 0 1 /end COMPU_METHOD
/begin COMPU_METHOD Pres_hPa "Druck (angezeigt in [hPa])" RAT_FUNC "%6.2" "hPa" COEFFS 0 1 0 0 0 1 /end COMPU_METHOD
/begin COMPU_METHOD Pres_Rail "Raildruck in hPa" RAT_FUNC "%4.3" "bar" COEFFS 0 10.000000 0 0 0 1 /end COMPU_METHOD
/begin COMPU_METHOD Qp_mm3_sec "Umrechnung für Volumenstrom" RAT_FUNC "%6.1" "mm3/s" COEFFS 0 0.1 0 0 0 1 /end COMPU_METHOD
/begin COMPU_METHOD Resist_1 "1. Widerstandsvariante" RAT_FUNC "%6.2" "mOhm" COEFFS 0 1 0 0 0 1 /end COMPU_METHOD
/begin COMPU_METHOD Res_hPaHrPerCM "Strömungswiderstand [hPa h/m3]" RAT_FUNC "%6.5" "hPa/(m^3/h)" COEFFS 0 1000 0 0 0 1 /end COMPU_METHOD
/begin COMPU_METHOD RmpPrc "Prozent Rampengradient" RAT_FUNC "%6.5" "%/s" COEFFS 0 5368.70912 0 0 0 1 /end COMPU_METHOD
/begin COMPU_METHOD RmpPres "Rampengradient für Druck" RAT_FUNC "%7.3" "hPa/s" COEFFS 0 65.536000 0 0 0 1 /end COMPU_METHOD
/begin COMPU_METHOD RmpPres_hPa "Rampengradient für Druck angezeigt in [hPa/s]" RAT_FUNC "%6.4" "hPa/s" COEFFS 0 65.536 0 0 0 1 /end COMPU_METHOD
/begin COMPU_METHOD RmpTemp "Rampengradient für Temperatur" RAT_FUNC "%6.4" "deg C/s" COEFFS 0 655.36 0 0 0 1 /end COMPU_METHOD
/begin COMPU_METHOD TempDiff_Cels "difference/offset temperature displayed in degree celcius" RAT_FUNC "%6.3" "deg C" COEFFS 0 10 0 0 0 1 /end COMPU_METHOD
/begin COMPU_METHOD Temp_Cels "Temperatur dargestellt in °C (gleiche interne Darstellung wie Temp_Kelv)" RAT_FUNC "%6.1" "deg C" COEFFS 0 10 2731.4 0 0 1 /end COMPU_METHOD
/begin COMPU_METHOD Temp_Kelv "Temperatur dargestellt in Kelvin" RAT_FUNC "%6.3" "deg C" COEFFS 0 10 0 0 0 1 /end COMPU_METHOD
/begin COMPU_METHOD TimeDeb "Entprellzeit in Millisekunden für Libraryfunktion Debounce" RAT_FUNC "%6.1" "ms" COEFFS 0 0.1 0 0 0 1 /end COMPU_METHOD
/begin COMPU_METHOD TimeDelay_ms "Zeitkonstante T1 fuer die Bibliotheksfunktionen PT1, DT1, etc.,  in ms angegeben" RAT_FUNC "%9.0" "ms" COEFFS 0 0 1 0 2.3283064365387e-07 0 /end COMPU_METHOD
/begin COMPU_METHOD TimeDelay_s "Zeitkonstante T1 (in s) für PT1, DT1, etc." RAT_FUNC "%9.3" "s" COEFFS 0 0 1 0 0.00023283064365387 0 /end COMPU_METHOD
/begin COMPU_METHOD TimePFltLimpHome "" RAT_FUNC "%6.1" "s" COEFFS 0 0.1 0 0 0 1 /end COMPU_METHOD
/begin COMPU_METHOD Time_ms "Zeit in ms für Fehlerentprellung (DSM) und SW-Timer" RAT_FUNC "%6.1" "ms" COEFFS 0 0.1 0 0 0 1 /end COMPU_METHOD
/begin COMPU_METHOD Time_s "Zeit in s für Fehlerentprellung (DSM) und SW-Timer" RAT_FUNC "%6.4" "s" COEFFS 0 100 0 0 0 1 /end COMPU_METHOD
/begin COMPU_METHOD Vel "Fahrzeuggeschwindigkeit, gleiche interne Auflösung wie Vel_SI" RAT_FUNC "%6.4" "km/h" COEFFS 0 100 0 0 0 1 /end COMPU_METHOD
/begin COMPU_METHOD Volt "Spannung in V (von ADC)" RAT_FUNC "%6.2" "mV" COEFFS 0 0.2046 0 0 0 1 /end COMPU_METHOD
/begin RECORD_LAYOUT Kf_Xs16_Ys16_Ws16 NO_AXIS_PTS_X 1 SWORD NO_AXIS_PTS_Y 2 SWORD AXIS_PTS_X 3 SWORD INDEX_INCR DIRECT AXIS_PTS_Y 4 SWORD INDEX_INCR DIRECT FNC_VALUES 5 SWORD COLUMN_DIR DIRECT /end RECORD_LAYOUT
/begin RECORD_LAYOUT Kl_Xs16_Ws16 NO_AXIS_PTS_X 1 SWORD AXIS_PTS_X 2 SWORD INDEX_INCR DIRECT FNC_VALUES 3 SWORD COLUMN_DIR DIRECT /end RECORD_LAYOUT
/begin RECORD_LAYOUT Kwb_Wu32 FNC_VALUES 1 ULONG COLUMN_DIR DIRECT /end RECORD_LAYOUT
/begin RECORD_LAYOUT Kw_Ws16 FNC_VALUES 1 SWORD COLUMN_DIR DIRECT /end RECORD_LAYOUT
/begin RECORD_LAYOUT Kw_Ws32 FNC_VALUES 1 SLONG COLUMN_DIR DIRECT /end RECORD_LAYOUT
/begin RECORD_LAYOUT Kw_Wu16 FNC_VALUES 1 UWORD COLUMN_DIR DIRECT /end RECORD_LAYOUT
/begin RECORD_LAYOUT Kw_Wu32 FNC_VALUES 1 ULONG COLUMN_DIR DIRECT /end RECORD_LAYOUT
/begin RECORD_LAYOUT Kw_Wu8 FNC_VALUES 1 UBYTE COLUMN_DIR DIRECT /end RECORD_LAYOUT
/end MODULE
/end PROJECT
