ASAP2_VERSION 1 30
/begin PROJECT MSS65-inj "Generiert am 14.10.05 um 11:34:36"
/begin HEADER "" VERSION "R341" /end HEADER
/begin MODULE _MSS65-inj "Generiert am 14.10.05 um 11:34:36"
/begin MOD_COMMON "" BYTE_ORDER MSB_FIRST ALIGNMENT_BYTE 1 ALIGNMENT_WORD 2 ALIGNMENT_LONG 4 ALIGNMENT_FLOAT32_IEEE 4 ALIGNMENT_FLOAT64_IEEE 8 /end MOD_COMMON
/begin CHARACTERISTIC K_ED_LANK1_OPENLOAD.P_CODE_UNPLAUSIBEL "P-Code fuer die Art UNPLAUSIBEL" VALUE 0x71B88 TKW_VV_VV_UW 100.0 FORMULA_0010 0.0 65535.0 /end CHARACTERISTIC
/begin CHARACTERISTIC K_ED_LANK2.DEC_NACH_EINTRAG "Filterverringerung nach Fehlerspeichereintrag" VALUE 0x70B9D TKW_VV_VV_UB 100.0 FORMULA_0003 0.0 255.0 /end CHARACTERISTIC
/begin CHARACTERISTIC K_ED_LANK2.DEC_VOR_EINTRAG "Filterverringerung vorm Fehlerspeichereintrag" VALUE 0x70B9B TKW_VV_VV_UB 100.0 FORMULA_0003 0.0 255.0 /end CHARACTERISTIC
/begin CHARACTERISTIC K_ED_LANK2.FEHLERSCHWELLE "Filterschwelle fuer Fehlereintrag" VALUE 0x70B98 TKW_VV_VV_UB 100.0 FORMULA_0003 0.0 255.0 /end CHARACTERISTIC
/begin CHARACTERISTIC K_ED_LANK2.INC_NACH_EINTRAG "Filtererhoehung nach Fehlerspeichereintrag" VALUE 0x70B9C TKW_VV_VV_UB 100.0 FORMULA_0003 0.0 255.0 /end CHARACTERISTIC
/begin CHARACTERISTIC K_ED_LANK2.INC_VOR_EINTRAG "Filtererhoehung vorm Fehlerspeichereintrag" VALUE 0x70B9A TKW_VV_VV_UB 100.0 FORMULA_0003 0.0 255.0 /end CHARACTERISTIC
/begin CHARACTERISTIC K_ED_LANK2.KLASSENINDEX "Auswahl der Fehlerklasse" VALUE 0x70B9E TKW_VV_VV_UB 100.0 FORMULA_0003 0.0 8.0 /end CHARACTERISTIC
/begin CHARACTERISTIC K_ED_LANK2.OK_SCHWELLE "Filterschwelle fuer Fehleraustrag" VALUE 0x70B99 TKW_VV_VV_UB 100.0 FORMULA_0003 0.0 255.0 /end CHARACTERISTIC
/begin CHARACTERISTIC K_ED_LANK2.P_CODE_OPENLOAD "P-Code fuer die Art OPENLOAD" VALUE 0x70B94 TKW_VV_VV_UW 100.0 FORMULA_0010 0.0 65535.0 /end CHARACTERISTIC
/begin CHARACTERISTIC K_ED_LANK2.P_CODE_SH_TO_GND "P-Code fuer die Art SH_TO_GND" VALUE 0x70B92 TKW_VV_VV_UW 100.0 FORMULA_0010 0.0 65535.0 /end CHARACTERISTIC
/begin CHARACTERISTIC K_ED_LANK2.P_CODE_SH_TO_UB "P-Code fuer die Art SH_TO_UB" VALUE 0x70B90 TKW_VV_VV_UW 100.0 FORMULA_0010 0.0 65535.0 /end CHARACTERISTIC
/begin CHARACTERISTIC K_ED_LANK2.P_CODE_UNPLAUSIBEL "P-Code fuer die Art UNPLAUSIBEL" VALUE 0x70B96 TKW_VV_VV_UW 100.0 FORMULA_0010 0.0 65535.0 /end CHARACTERISTIC
/begin CHARACTERISTIC K_ED_LANK2_OBD_S.DEC_NACH_EINTRAG "Filterverringerung nach Fehlerspeichereintrag" VALUE 0x70D3D TKW_VV_VV_UB 100.0 FORMULA_0003 0.0 255.0 /end CHARACTERISTIC
/begin CHARACTERISTIC K_ED_LANK2_OBD_S.DEC_VOR_EINTRAG "Filterverringerung vorm Fehlerspeichereintrag" VALUE 0x70D3B TKW_VV_VV_UB 100.0 FORMULA_0003 0.0 255.0 /end CHARACTERISTIC
/begin CHARACTERISTIC K_ED_LANK2_OBD_S.FEHLERSCHWELLE "Filterschwelle fuer Fehlereintrag" VALUE 0x70D38 TKW_VV_VV_UB 100.0 FORMULA_0003 0.0 255.0 /end CHARACTERISTIC
/begin CHARACTERISTIC K_ED_LANK2_OBD_S.INC_NACH_EINTRAG "Filtererhoehung nach Fehlerspeichereintrag" VALUE 0x70D3C TKW_VV_VV_UB 100.0 FORMULA_0003 0.0 255.0 /end CHARACTERISTIC
/begin CHARACTERISTIC K_ED_LANK2_OBD_S.INC_VOR_EINTRAG "Filtererhoehung vorm Fehlerspeichereintrag" VALUE 0x70D3A TKW_VV_VV_UB 100.0 FORMULA_0003 0.0 255.0 /end CHARACTERISTIC
/begin CHARACTERISTIC K_ED_LANK2_OBD_S.KLASSENINDEX "Auswahl der Fehlerklasse" VALUE 0x70D3E TKW_VV_VV_UB 100.0 FORMULA_0003 0.0 8.0 /end CHARACTERISTIC
/begin CHARACTERISTIC K_ED_LANK2_OBD_S.OK_SCHWELLE "Filterschwelle fuer Fehleraustrag" VALUE 0x70D39 TKW_VV_VV_UB 100.0 FORMULA_0003 0.0 255.0 /end CHARACTERISTIC
/begin CHARACTERISTIC K_ED_LANK2_OBD_S.P_CODE_OPENLOAD "P-Code fuer die Art OPENLOAD" VALUE 0x70D34 TKW_VV_VV_UW 100.0 FORMULA_0010 0.0 65535.0 /end CHARACTERISTIC
/begin CHARACTERISTIC K_ED_LANK2_OBD_S.P_CODE_SH_TO_GND "P-Code fuer die Art SH_TO_GND" VALUE 0x70D32 TKW_VV_VV_UW 100.0 FORMULA_0010 0.0 65535.0 /end CHARACTERISTIC
/begin CHARACTERISTIC K_ED_LANK2_OBD_S.P_CODE_SH_TO_UB "P-Code fuer die Art SH_TO_UB" VALUE 0x70D30 TKW_VV_VV_UW 100.0 FORMULA_0010 0.0 65535.0 /end CHARACTERISTIC
/begin CHARACTERISTIC K_ED_LANK2_OBD_S.P_CODE_UNPLAUSIBEL "P-Code fuer die Art UNPLAUSIBEL" VALUE 0x70D36 TKW_VV_VV_UW 100.0 FORMULA_0010 0.0 65535.0 /end CHARACTERISTIC
/begin CHARACTERISTIC K_ED_LANK2_OBD_WE.DEC_NACH_EINTRAG "Filterverringerung nach Fehlerspeichereintrag" VALUE 0x71BDD TKW_VV_VV_UB 100.0 FORMULA_0003 0.0 255.0 /end CHARACTERISTIC
/begin CHARACTERISTIC K_ED_LANK2_OBD_WE.DEC_VOR_EINTRAG "Filterverringerung vorm Fehlerspeichereintrag" VALUE 0x71BDB TKW_VV_VV_UB 100.0 FORMULA_0003 0.0 255.0 /end CHARACTERISTIC
/begin CHARACTERISTIC K_ED_LANK2_OBD_WE.FEHLERSCHWELLE "Filterschwelle fuer Fehlereintrag" VALUE 0x71BD8 TKW_VV_VV_UB 100.0 FORMULA_0003 0.0 255.0 /end CHARACTERISTIC
/begin CHARACTERISTIC K_ED_LANK2_OBD_WE.INC_NACH_EINTRAG "Filtererhoehung nach Fehlerspeichereintrag" VALUE 0x71BDC TKW_VV_VV_UB 100.0 FORMULA_0003 0.0 255.0 /end CHARACTERISTIC
/begin CHARACTERISTIC K_ED_LANK2_OBD_WE.INC_VOR_EINTRAG "Filtererhoehung vorm Fehlerspeichereintrag" VALUE 0x71BDA TKW_VV_VV_UB 100.0 FORMULA_0003 0.0 255.0 /end CHARACTERISTIC
/begin CHARACTERISTIC K_ED_LANK2_OBD_WE.KLASSENINDEX "Auswahl der Fehlerklasse" VALUE 0x71BDE TKW_VV_VV_UB 100.0 FORMULA_0003 0.0 8.0 /end CHARACTERISTIC
/begin CHARACTERISTIC K_ED_LANK2_OBD_WE.OK_SCHWELLE "Filterschwelle fuer Fehleraustrag" VALUE 0x71BD9 TKW_VV_VV_UB 100.0 FORMULA_0003 0.0 255.0 /end CHARACTERISTIC
/begin CHARACTERISTIC K_ED_LANK2_OBD_WE.P_CODE_OPENLOAD "P-Code fuer die Art OPENLOAD" VALUE 0x71BD4 TKW_VV_VV_UW 100.0 FORMULA_0010 0.0 65535.0 /end CHARACTERISTIC
/begin CHARACTERISTIC K_ED_LANK2_OBD_WE.P_CODE_SH_TO_GND "P-Code fuer die Art SH_TO_GND" VALUE 0x71BD2 TKW_VV_VV_UW 100.0 FORMULA_0010 0.0 65535.0 /end CHARACTERISTIC
/begin CHARACTERISTIC K_ED_LANK2_OBD_WE.P_CODE_SH_TO_UB "P-Code fuer die Art SH_TO_UB" VALUE 0x71BD0 TKW_VV_VV_UW 100.0 FORMULA_0010 0.0 65535.0 /end CHARACTERISTIC
/begin CHARACTERISTIC K_ED_LANK2_OBD_WE.P_CODE_UNPLAUSIBEL "P-Code fuer die Art UNPLAUSIBEL" VALUE 0x71BD6 TKW_VV_VV_UW 100.0 FORMULA_0010 0.0 65535.0 /end CHARACTERISTIC
/begin CHARACTERISTIC K_ED_LANK2_OPENLOAD.DEC_NACH_EINTRAG "Filterverringerung nach Fehlerspeichereintrag" VALUE 0x71BA9 TKW_VV_VV_UB 100.0 FORMULA_0003 0.0 255.0 /end CHARACTERISTIC
/begin CHARACTERISTIC K_ED_LANK2_OPENLOAD.DEC_VOR_EINTRAG "Filterverringerung vorm Fehlerspeichereintrag" VALUE 0x71BA7 TKW_VV_VV_UB 100.0 FORMULA_0003 0.0 255.0 /end CHARACTERISTIC
/begin CHARACTERISTIC K_ED_LANK2_OPENLOAD.FEHLERSCHWELLE "Filterschwelle fuer Fehlereintrag" VALUE 0x71BA4 TKW_VV_VV_UB 100.0 FORMULA_0003 0.0 255.0 /end CHARACTERISTIC
/begin CHARACTERISTIC K_ED_LANK2_OPENLOAD.INC_NACH_EINTRAG "Filtererhoehung nach Fehlerspeichereintrag" VALUE 0x71BA8 TKW_VV_VV_UB 100.0 FORMULA_0003 0.0 255.0 /end CHARACTERISTIC
/begin CHARACTERISTIC K_ED_LANK2_OPENLOAD.INC_VOR_EINTRAG "Filtererhoehung vorm Fehlerspeichereintrag" VALUE 0x71BA6 TKW_VV_VV_UB 100.0 FORMULA_0003 0.0 255.0 /end CHARACTERISTIC
/begin CHARACTERISTIC K_ED_LANK2_OPENLOAD.KLASSENINDEX "Auswahl der Fehlerklasse" VALUE 0x71BAA TKW_VV_VV_UB 100.0 FORMULA_0003 0.0 8.0 /end CHARACTERISTIC
/begin CHARACTERISTIC K_ED_LANK2_OPENLOAD.OK_SCHWELLE "Filterschwelle fuer Fehleraustrag" VALUE 0x71BA5 TKW_VV_VV_UB 100.0 FORMULA_0003 0.0 255.0 /end CHARACTERISTIC
/begin CHARACTERISTIC K_ED_LANK2_OPENLOAD.P_CODE_OPENLOAD "P-Code fuer die Art OPENLOAD" VALUE 0x71BA0 TKW_VV_VV_UW 100.0 FORMULA_0010 0.0 65535.0 /end CHARACTERISTIC
/begin CHARACTERISTIC K_ED_LANK2_OPENLOAD.P_CODE_SH_TO_GND "P-Code fuer die Art SH_TO_GND" VALUE 0x71B9E TKW_VV_VV_UW 100.0 FORMULA_0010 0.0 65535.0 /end CHARACTERISTIC
/begin CHARACTERISTIC K_ED_LANK2_OPENLOAD.P_CODE_SH_TO_UB "P-Code fuer die Art SH_TO_UB" VALUE 0x71B9C TKW_VV_VV_UW 100.0 FORMULA_0010 0.0 65535.0 /end CHARACTERISTIC
/begin CHARACTERISTIC K_ED_LANK2_OPENLOAD.P_CODE_UNPLAUSIBEL "P-Code fuer die Art UNPLAUSIBEL" VALUE 0x71BA2 TKW_VV_VV_UW 100.0 FORMULA_0010 0.0 65535.0 /end CHARACTERISTIC
/begin CHARACTERISTIC K_ED_LAVK_ATIC42.DEC_NACH_EINTRAG "Filterverringerung nach Fehlerspeichereintrag" VALUE 0x71C93 TKW_VV_VV_UB 100.0 FORMULA_0003 0.0 255.0 /end CHARACTERISTIC
/begin CHARACTERISTIC K_ED_LAVK_ATIC42.DEC_VOR_EINTRAG "Filterverringerung vorm Fehlerspeichereintrag" VALUE 0x71C91 TKW_VV_VV_UB 100.0 FORMULA_0003 0.0 255.0 /end CHARACTERISTIC
/begin CHARACTERISTIC K_ED_LAVK_ATIC42.FEHLERSCHWELLE "Filterschwelle fuer Fehlereintrag" VALUE 0x71C8E TKW_VV_VV_UB 100.0 FORMULA_0003 0.0 255.0 /end CHARACTERISTIC
/begin CHARACTERISTIC K_ED_LAVK_ATIC42.INC_NACH_EINTRAG "Filtererhoehung nach Fehlerspeichereintrag" VALUE 0x71C92 TKW_VV_VV_UB 100.0 FORMULA_0003 0.0 255.0 /end CHARACTERISTIC
/begin CHARACTERISTIC K_ED_LAVK_ATIC42.INC_VOR_EINTRAG "Filtererhoehung vorm Fehlerspeichereintrag" VALUE 0x71C90 TKW_VV_VV_UB 100.0 FORMULA_0003 0.0 255.0 /end CHARACTERISTIC
/begin CHARACTERISTIC K_ED_LAVK_ATIC42.KLASSENINDEX "Auswahl der Fehlerklasse" VALUE 0x71C94 TKW_VV_VV_UB 100.0 FORMULA_0003 0.0 8.0 /end CHARACTERISTIC
/begin CHARACTERISTIC K_ED_LAVK_ATIC42.OK_SCHWELLE "Filterschwelle fuer Fehleraustrag" VALUE 0x71C8F TKW_VV_VV_UB 100.0 FORMULA_0003 0.0 255.0 /end CHARACTERISTIC
/begin CHARACTERISTIC K_ED_LAVK_ATIC42.P_CODE_OPENLOAD "P-Code fuer die Art OPENLOAD" VALUE 0x71C8A TKW_VV_VV_UW 100.0 FORMULA_0010 0.0 65535.0 /end CHARACTERISTIC
/begin CHARACTERISTIC K_ED_LAVK_ATIC42.P_CODE_SH_TO_GND "P-Code fuer die Art SH_TO_GND" VALUE 0x71C88 TKW_VV_VV_UW 100.0 FORMULA_0010 0.0 65535.0 /end CHARACTERISTIC
/begin CHARACTERISTIC K_ED_LAVK_ATIC42.P_CODE_SH_TO_UB "P-Code fuer die Art SH_TO_UB" VALUE 0x71C86 TKW_VV_VV_UW 100.0 FORMULA_0010 0.0 65535.0 /end CHARACTERISTIC
/begin CHARACTERISTIC K_ED_LAVK_ATIC42.P_CODE_UNPLAUSIBEL "P-Code fuer die Art UNPLAUSIBEL" VALUE 0x71C8C TKW_VV_VV_UW 100.0 FORMULA_0010 0.0 65535.0 /end CHARACTERISTIC
/begin CHARACTERISTIC K_ED_LAVK1.DEC_NACH_EINTRAG "Filterverringerung nach Fehlerspeichereintrag" VALUE 0x70AE7 TKW_VV_VV_UB 100.0 FORMULA_0003 0.0 255.0 /end CHARACTERISTIC
/begin CHARACTERISTIC K_ED_LAVK1.DEC_VOR_EINTRAG "Filterverringerung vorm Fehlerspeichereintrag" VALUE 0x70AE5 TKW_VV_VV_UB 100.0 FORMULA_0003 0.0 255.0 /end CHARACTERISTIC
/begin CHARACTERISTIC K_ED_LAVK1.FEHLERSCHWELLE "Filterschwelle fuer Fehlereintrag" VALUE 0x70AE2 TKW_VV_VV_UB 100.0 FORMULA_0003 0.0 255.0 /end CHARACTERISTIC
/begin CHARACTERISTIC K_ED_LAVK1.INC_NACH_EINTRAG "Filtererhoehung nach Fehlerspeichereintrag" VALUE 0x70AE6 TKW_VV_VV_UB 100.0 FORMULA_0003 0.0 255.0 /end CHARACTERISTIC
/begin CHARACTERISTIC K_ED_LAVK1.INC_VOR_EINTRAG "Filtererhoehung vorm Fehlerspeichereintrag" VALUE 0x70AE4 TKW_VV_VV_UB 100.0 FORMULA_0003 0.0 255.0 /end CHARACTERISTIC
/begin CHARACTERISTIC K_ED_LAVK1.KLASSENINDEX "Auswahl der Fehlerklasse" VALUE 0x70AE8 TKW_VV_VV_UB 100.0 FORMULA_0003 0.0 8.0 /end CHARACTERISTIC
/begin CHARACTERISTIC K_ED_LAVK1.OK_SCHWELLE "Filterschwelle fuer Fehleraustrag" VALUE 0x70AE3 TKW_VV_VV_UB 100.0 FORMULA_0003 0.0 255.0 /end CHARACTERISTIC
/begin CHARACTERISTIC K_ED_LAVK1.P_CODE_OPENLOAD "P-Code fuer die Art OPENLOAD" VALUE 0x70ADE TKW_VV_VV_UW 100.0 FORMULA_0010 0.0 65535.0 /end CHARACTERISTIC
/begin CHARACTERISTIC K_ED_LAVK1.P_CODE_SH_TO_GND "P-Code fuer die Art SH_TO_GND" VALUE 0x70ADC TKW_VV_VV_UW 100.0 FORMULA_0010 0.0 65535.0 /end CHARACTERISTIC
/begin CHARACTERISTIC K_ED_LAVK1.P_CODE_SH_TO_UB "P-Code fuer die Art SH_TO_UB" VALUE 0x70ADA TKW_VV_VV_UW 100.0 FORMULA_0010 0.0 65535.0 /end CHARACTERISTIC
/begin CHARACTERISTIC K_ED_LAVK1.P_CODE_UNPLAUSIBEL "P-Code fuer die Art UNPLAUSIBEL" VALUE 0x70AE0 TKW_VV_VV_UW 100.0 FORMULA_0010 0.0 65535.0 /end CHARACTERISTIC
/begin CHARACTERISTIC K_ED_LAVK1_DIAG.DEC_NACH_EINTRAG "Filterverringerung nach Fehlerspeichereintrag" VALUE 0x70E8F TKW_VV_VV_UB 100.0 FORMULA_0003 0.0 255.0 /end CHARACTERISTIC
/begin CHARACTERISTIC K_ED_LAVK1_DIAG.DEC_VOR_EINTRAG "Filterverringerung vorm Fehlerspeichereintrag" VALUE 0x70E8D TKW_VV_VV_UB 100.0 FORMULA_0003 0.0 255.0 /end CHARACTERISTIC
/begin CHARACTERISTIC K_ED_LAVK1_DIAG.FEHLERSCHWELLE "Filterschwelle fuer Fehlereintrag" VALUE 0x70E8A TKW_VV_VV_UB 100.0 FORMULA_0003 0.0 255.0 /end CHARACTERISTIC
/begin CHARACTERISTIC K_ED_LAVK1_DIAG.INC_NACH_EINTRAG "Filtererhoehung nach Fehlerspeichereintrag" VALUE 0x70E8E TKW_VV_VV_UB 100.0 FORMULA_0003 0.0 255.0 /end CHARACTERISTIC
/begin CHARACTERISTIC K_ED_LAVK1_DIAG.INC_VOR_EINTRAG "Filtererhoehung vorm Fehlerspeichereintrag" VALUE 0x70E8C TKW_VV_VV_UB 100.0 FORMULA_0003 0.0 255.0 /end CHARACTERISTIC
/begin CHARACTERISTIC K_ED_LAVK1_DIAG.KLASSENINDEX "Auswahl der Fehlerklasse" VALUE 0x70E90 TKW_VV_VV_UB 100.0 FORMULA_0003 0.0 8.0 /end CHARACTERISTIC
/begin CHARACTERISTIC K_ED_LAVK1_DIAG.OK_SCHWELLE "Filterschwelle fuer Fehleraustrag" VALUE 0x70E8B TKW_VV_VV_UB 100.0 FORMULA_0003 0.0 255.0 /end CHARACTERISTIC
/begin CHARACTERISTIC K_ED_LAVK1_DIAG.P_CODE_OPENLOAD "P-Code fuer die Art OPENLOAD" VALUE 0x70E86 TKW_VV_VV_UW 100.0 FORMULA_0010 0.0 65535.0 /end CHARACTERISTIC
/begin CHARACTERISTIC K_ED_LAVK1_DIAG.P_CODE_SH_TO_GND "P-Code fuer die Art SH_TO_GND" VALUE 0x70E84 TKW_VV_VV_UW 100.0 FORMULA_0010 0.0 65535.0 /end CHARACTERISTIC
/begin CHARACTERISTIC K_ED_LAVK1_DIAG.P_CODE_SH_TO_UB "P-Code fuer die Art SH_TO_UB" VALUE 0x70E82 TKW_VV_VV_UW 100.0 FORMULA_0010 0.0 65535.0 /end CHARACTERISTIC
/begin CHARACTERISTIC K_ED_LAVK1_DIAG.P_CODE_UNPLAUSIBEL "P-Code fuer die Art UNPLAUSIBEL" VALUE 0x70E88 TKW_VV_VV_UW 100.0 FORMULA_0010 0.0 65535.0 /end CHARACTERISTIC
/begin CHARACTERISTIC K_ED_LAVK1_IA_OPENLOAD.DEC_NACH_EINTRAG "Filterverringerung nach Fehlerspeichereintrag" VALUE 0x70EC3 TKW_VV_VV_UB 100.0 FORMULA_0003 0.0 255.0 /end CHARACTERISTIC
/begin CHARACTERISTIC K_ED_LAVK1_IA_OPENLOAD.DEC_VOR_EINTRAG "Filterverringerung vorm Fehlerspeichereintrag" VALUE 0x70EC1 TKW_VV_VV_UB 100.0 FORMULA_0003 0.0 255.0 /end CHARACTERISTIC
/begin CHARACTERISTIC K_ED_LAVK1_IA_OPENLOAD.FEHLERSCHWELLE "Filterschwelle fuer Fehlereintrag" VALUE 0x70EBE TKW_VV_VV_UB 100.0 FORMULA_0003 0.0 255.0 /end CHARACTERISTIC
/begin CHARACTERISTIC K_ED_LAVK1_IA_OPENLOAD.INC_NACH_EINTRAG "Filtererhoehung nach Fehlerspeichereintrag" VALUE 0x70EC2 TKW_VV_VV_UB 100.0 FORMULA_0003 0.0 255.0 /end CHARACTERISTIC
/begin CHARACTERISTIC K_ED_LAVK1_IA_OPENLOAD.INC_VOR_EINTRAG "Filtererhoehung vorm Fehlerspeichereintrag" VALUE 0x70EC0 TKW_VV_VV_UB 100.0 FORMULA_0003 0.0 255.0 /end CHARACTERISTIC
/begin CHARACTERISTIC K_ED_LAVK1_IA_OPENLOAD.KLASSENINDEX "Auswahl der Fehlerklasse" VALUE 0x70EC4 TKW_VV_VV_UB 100.0 FORMULA_0003 0.0 8.0 /end CHARACTERISTIC
/begin CHARACTERISTIC K_ED_LAVK1_IA_OPENLOAD.OK_SCHWELLE "Filterschwelle fuer Fehleraustrag" VALUE 0x70EBF TKW_VV_VV_UB 100.0 FORMULA_0003 0.0 255.0 /end CHARACTERISTIC
/begin CHARACTERISTIC K_ED_LAVK1_IA_OPENLOAD.P_CODE_OPENLOAD "P-Code fuer die Art OPENLOAD" VALUE 0x70EBA TKW_VV_VV_UW 100.0 FORMULA_0010 0.0 65535.0 /end CHARACTERISTIC
/begin CHARACTERISTIC K_ED_LAVK1_IA_OPENLOAD.P_CODE_SH_TO_GND "P-Code fuer die Art SH_TO_GND" VALUE 0x70EB8 TKW_VV_VV_UW 100.0 FORMULA_0010 0.0 65535.0 /end CHARACTERISTIC
/begin CHARACTERISTIC K_ED_LAVK1_IA_OPENLOAD.P_CODE_SH_TO_UB "P-Code fuer die Art SH_TO_UB" VALUE 0x70EB6 TKW_VV_VV_UW 100.0 FORMULA_0010 0.0 65535.0 /end CHARACTERISTIC
/begin CHARACTERISTIC K_ED_LAVK1_IA_OPENLOAD.P_CODE_UNPLAUSIBEL "P-Code fuer die Art UNPLAUSIBEL" VALUE 0x70EBC TKW_VV_VV_UW 100.0 FORMULA_0010 0.0 65535.0 /end CHARACTERISTIC
/begin CHARACTERISTIC K_ED_LAVK1_IP_OPENLOAD.DEC_NACH_EINTRAG "Filterverringerung nach Fehlerspeichereintrag" VALUE 0x70F5F TKW_VV_VV_UB 100.0 FORMULA_0003 0.0 255.0 /end CHARACTERISTIC
/begin CHARACTERISTIC K_ED_LAVK1_IP_OPENLOAD.DEC_VOR_EINTRAG "Filterverringerung vorm Fehlerspeichereintrag" VALUE 0x70F5D TKW_VV_VV_UB 100.0 FORMULA_0003 0.0 255.0 /end CHARACTERISTIC
/begin CHARACTERISTIC K_ED_LAVK1_IP_OPENLOAD.FEHLERSCHWELLE "Filterschwelle fuer Fehlereintrag" VALUE 0x70F5A TKW_VV_VV_UB 100.0 FORMULA_0003 0.0 255.0 /end CHARACTERISTIC
/begin CHARACTERISTIC K_ED_LAVK1_IP_OPENLOAD.INC_NACH_EINTRAG "Filtererhoehung nach Fehlerspeichereintrag" VALUE 0x70F5E TKW_VV_VV_UB 100.0 FORMULA_0003 0.0 255.0 /end CHARACTERISTIC
/begin CHARACTERISTIC K_ED_LAVK1_IP_OPENLOAD.INC_VOR_EINTRAG "Filtererhoehung vorm Fehlerspeichereintrag" VALUE 0x70F5C TKW_VV_VV_UB 100.0 FORMULA_0003 0.0 255.0 /end CHARACTERISTIC
/begin CHARACTERISTIC K_ED_LAVK1_IP_OPENLOAD.KLASSENINDEX "Auswahl der Fehlerklasse" VALUE 0x70F60 TKW_VV_VV_UB 100.0 FORMULA_0003 0.0 8.0 /end CHARACTERISTIC
/begin CHARACTERISTIC K_ED_LAVK1_IP_OPENLOAD.OK_SCHWELLE "Filterschwelle fuer Fehleraustrag" VALUE 0x70F5B TKW_VV_VV_UB 100.0 FORMULA_0003 0.0 255.0 /end CHARACTERISTIC
/begin CHARACTERISTIC K_ED_LAVK1_IP_OPENLOAD.P_CODE_OPENLOAD "P-Code fuer die Art OPENLOAD" VALUE 0x70F56 TKW_VV_VV_UW 100.0 FORMULA_0010 0.0 65535.0 /end CHARACTERISTIC
/begin CHARACTERISTIC K_ED_LAVK1_IP_OPENLOAD.P_CODE_SH_TO_GND "P-Code fuer die Art SH_TO_GND" VALUE 0x70F54 TKW_VV_VV_UW 100.0 FORMULA_0010 0.0 65535.0 /end CHARACTERISTIC
/begin CHARACTERISTIC K_ED_LAVK1_IP_OPENLOAD.P_CODE_SH_TO_UB "P-Code fuer die Art SH_TO_UB" VALUE 0x70F52 TKW_VV_VV_UW 100.0 FORMULA_0010 0.0 65535.0 /end CHARACTERISTIC
/begin CHARACTERISTIC K_ED_LAVK1_IP_OPENLOAD.P_CODE_UNPLAUSIBEL "P-Code fuer die Art UNPLAUSIBEL" VALUE 0x70F58 TKW_VV_VV_UW 100.0 FORMULA_0010 0.0 65535.0 /end CHARACTERISTIC
/begin CHARACTERISTIC K_ED_LAVK1_OBD_DYN.DEC_NACH_EINTRAG "Filterverringerung nach Fehlerspeichereintrag" VALUE 0x712B9 TKW_VV_VV_UB 100.0 FORMULA_0003 0.0 255.0 /end CHARACTERISTIC
/begin CHARACTERISTIC K_ED_LAVK1_OBD_DYN.DEC_VOR_EINTRAG "Filterverringerung vorm Fehlerspeichereintrag" VALUE 0x712B7 TKW_VV_VV_UB 100.0 FORMULA_0003 0.0 255.0 /end CHARACTERISTIC
/begin CHARACTERISTIC K_ED_LAVK1_OBD_DYN.FEHLERSCHWELLE "Filterschwelle fuer Fehlereintrag" VALUE 0x712B4 TKW_VV_VV_UB 100.0 FORMULA_0003 0.0 255.0 /end CHARACTERISTIC
/begin CHARACTERISTIC K_ED_LAVK1_OBD_DYN.INC_NACH_EINTRAG "Filtererhoehung nach Fehlerspeichereintrag" VALUE 0x712B8 TKW_VV_VV_UB 100.0 FORMULA_0003 0.0 255.0 /end CHARACTERISTIC
/begin CHARACTERISTIC K_ED_LAVK1_OBD_DYN.INC_VOR_EINTRAG "Filtererhoehung vorm Fehlerspeichereintrag" VALUE 0x712B6 TKW_VV_VV_UB 100.0 FORMULA_0003 0.0 255.0 /end CHARACTERISTIC
/begin CHARACTERISTIC K_ED_LAVK1_OBD_DYN.KLASSENINDEX "Auswahl der Fehlerklasse" VALUE 0x712BA TKW_VV_VV_UB 100.0 FORMULA_0003 0.0 8.0 /end CHARACTERISTIC
/begin CHARACTERISTIC K_ED_LAVK1_OBD_DYN.OK_SCHWELLE "Filterschwelle fuer Fehleraustrag" VALUE 0x712B5 TKW_VV_VV_UB 100.0 FORMULA_0003 0.0 255.0 /end CHARACTERISTIC
/begin CHARACTERISTIC K_ED_LAVK1_OBD_DYN.P_CODE_OPENLOAD "P-Code fuer die Art OPENLOAD" VALUE 0x712B0 TKW_VV_VV_UW 100.0 FORMULA_0010 0.0 65535.0 /end CHARACTERISTIC
/begin CHARACTERISTIC K_ED_LAVK1_OBD_DYN.P_CODE_SH_TO_GND "P-Code fuer die Art SH_TO_GND" VALUE 0x712AE TKW_VV_VV_UW 100.0 FORMULA_0010 0.0 65535.0 /end CHARACTERISTIC
/begin CHARACTERISTIC K_ED_LAVK1_OBD_DYN.P_CODE_SH_TO_UB "P-Code fuer die Art SH_TO_UB" VALUE 0x712AC TKW_VV_VV_UW 100.0 FORMULA_0010 0.0 65535.0 /end CHARACTERISTIC
/begin CHARACTERISTIC K_ED_LAVK1_OBD_DYN.P_CODE_UNPLAUSIBEL "P-Code fuer die Art UNPLAUSIBEL" VALUE 0x712B2 TKW_VV_VV_UW 100.0 FORMULA_0010 0.0 65535.0 /end CHARACTERISTIC
/begin CHARACTERISTIC K_ED_LAVK1_OBD_PLAU.DEC_NACH_EINTRAG "Filterverringerung nach Fehlerspeichereintrag" VALUE 0x70B1B TKW_VV_VV_UB 100.0 FORMULA_0003 0.0 255.0 /end CHARACTERISTIC
/begin CHARACTERISTIC K_ED_LAVK1_OBD_PLAU.DEC_VOR_EINTRAG "Filterverringerung vorm Fehlerspeichereintrag" VALUE 0x70B19 TKW_VV_VV_UB 100.0 FORMULA_0003 0.0 255.0 /end CHARACTERISTIC
/begin CHARACTERISTIC K_ED_LAVK1_OBD_PLAU.FEHLERSCHWELLE "Filterschwelle fuer Fehlereintrag" VALUE 0x70B16 TKW_VV_VV_UB 100.0 FORMULA_0003 0.0 255.0 /end CHARACTERISTIC
/begin CHARACTERISTIC K_ED_LAVK1_OBD_PLAU.INC_NACH_EINTRAG "Filtererhoehung nach Fehlerspeichereintrag" VALUE 0x70B1A TKW_VV_VV_UB 100.0 FORMULA_0003 0.0 255.0 /end CHARACTERISTIC
/begin CHARACTERISTIC K_ED_LAVK1_OBD_PLAU.INC_VOR_EINTRAG "Filtererhoehung vorm Fehlerspeichereintrag" VALUE 0x70B18 TKW_VV_VV_UB 100.0 FORMULA_0003 0.0 255.0 /end CHARACTERISTIC
/begin CHARACTERISTIC K_ED_LAVK1_OBD_PLAU.KLASSENINDEX "Auswahl der Fehlerklasse" VALUE 0x70B1C TKW_VV_VV_UB 100.0 FORMULA_0003 0.0 8.0 /end CHARACTERISTIC
/begin CHARACTERISTIC K_ED_LAVK1_OBD_PLAU.OK_SCHWELLE "Filterschwelle fuer Fehleraustrag" VALUE 0x70B17 TKW_VV_VV_UB 100.0 FORMULA_0003 0.0 255.0 /end CHARACTERISTIC
/begin CHARACTERISTIC K_ED_LAVK1_OBD_PLAU.P_CODE_OPENLOAD "P-Code fuer die Art OPENLOAD" VALUE 0x70B12 TKW_VV_VV_UW 100.0 FORMULA_0010 0.0 65535.0 /end CHARACTERISTIC
/begin CHARACTERISTIC K_ED_LAVK1_OBD_PLAU.P_CODE_SH_TO_GND "P-Code fuer die Art SH_TO_GND" VALUE 0x70B10 TKW_VV_VV_UW 100.0 FORMULA_0010 0.0 65535.0 /end CHARACTERISTIC
/begin CHARACTERISTIC K_ED_LAVK1_OBD_PLAU.P_CODE_SH_TO_UB "P-Code fuer die Art SH_TO_UB" VALUE 0x70B0E TKW_VV_VV_UW 100.0 FORMULA_0010 0.0 65535.0 /end CHARACTERISTIC
/begin CHARACTERISTIC K_ED_LAVK1_OBD_PLAU.P_CODE_UNPLAUSIBEL "P-Code fuer die Art UNPLAUSIBEL" VALUE 0x70B14 TKW_VV_VV_UW 100.0 FORMULA_0010 0.0 65535.0 /end CHARACTERISTIC
/begin CHARACTERISTIC K_ED_LAVK1_OBD_SA.DEC_NACH_EINTRAG "Filterverringerung nach Fehlerspeichereintrag" VALUE 0x70B4F TKW_VV_VV_UB 100.0 FORMULA_0003 0.0 255.0 /end CHARACTERISTIC
/begin CHARACTERISTIC K_ED_LAVK1_OBD_SA.DEC_VOR_EINTRAG "Filterverringerung vorm Fehlerspeichereintrag" VALUE 0x70B4D TKW_VV_VV_UB 100.0 FORMULA_0003 0.0 255.0 /end CHARACTERISTIC
/begin CHARACTERISTIC K_ED_LAVK1_OBD_SA.FEHLERSCHWELLE "Filterschwelle fuer Fehlereintrag" VALUE 0x70B4A TKW_VV_VV_UB 100.0 FORMULA_0003 0.0 255.0 /end CHARACTERISTIC
/begin CHARACTERISTIC K_ED_LAVK1_OBD_SA.INC_NACH_EINTRAG "Filtererhoehung nach Fehlerspeichereintrag" VALUE 0x70B4E TKW_VV_VV_UB 100.0 FORMULA_0003 0.0 255.0 /end CHARACTERISTIC
/begin CHARACTERISTIC K_ED_LAVK1_OBD_SA.INC_VOR_EINTRAG "Filtererhoehung vorm Fehlerspeichereintrag" VALUE 0x70B4C TKW_VV_VV_UB 100.0 FORMULA_0003 0.0 255.0 /end CHARACTERISTIC
/begin CHARACTERISTIC K_ED_LAVK1_OBD_SA.KLASSENINDEX "Auswahl der Fehlerklasse" VALUE 0x70B50 TKW_VV_VV_UB 100.0 FORMULA_0003 0.0 8.0 /end CHARACTERISTIC
/begin CHARACTERISTIC K_ED_LAVK1_OBD_SA.OK_SCHWELLE "Filterschwelle fuer Fehleraustrag" VALUE 0x70B4B TKW_VV_VV_UB 100.0 FORMULA_0003 0.0 255.0 /end CHARACTERISTIC
/begin CHARACTERISTIC K_ED_LAVK1_OBD_SA.P_CODE_OPENLOAD "P-Code fuer die Art OPENLOAD" VALUE 0x70B46 TKW_VV_VV_UW 100.0 FORMULA_0010 0.0 65535.0 /end CHARACTERISTIC
/begin CHARACTERISTIC K_ED_LAVK1_OBD_SA.P_CODE_SH_TO_GND "P-Code fuer die Art SH_TO_GND" VALUE 0x70B44 TKW_VV_VV_UW 100.0 FORMULA_0010 0.0 65535.0 /end CHARACTERISTIC
/begin CHARACTERISTIC K_ED_LAVK1_OBD_SA.P_CODE_SH_TO_UB "P-Code fuer die Art SH_TO_UB" VALUE 0x70B42 TKW_VV_VV_UW 100.0 FORMULA_0010 0.0 65535.0 /end CHARACTERISTIC
/begin CHARACTERISTIC K_ED_LAVK1_OBD_SA.P_CODE_UNPLAUSIBEL "P-Code fuer die Art UNPLAUSIBEL" VALUE 0x70B48 TKW_VV_VV_UW 100.0 FORMULA_0010 0.0 65535.0 /end CHARACTERISTIC
/begin CHARACTERISTIC K_ED_LAVK1_OBD_TL.DEC_NACH_EINTRAG "Filterverringerung nach Fehlerspeichereintrag" VALUE 0x70D57 TKW_VV_VV_UB 100.0 FORMULA_0003 0.0 255.0 /end CHARACTERISTIC
/begin CHARACTERISTIC K_ED_LAVK1_OBD_TL.DEC_VOR_EINTRAG "Filterverringerung vorm Fehlerspeichereintrag" VALUE 0x70D55 TKW_VV_VV_UB 100.0 FORMULA_0003 0.0 255.0 /end CHARACTERISTIC
/begin CHARACTERISTIC K_ED_LAVK1_OBD_TL.FEHLERSCHWELLE "Filterschwelle fuer Fehlereintrag" VALUE 0x70D52 TKW_VV_VV_UB 100.0 FORMULA_0003 0.0 255.0 /end CHARACTERISTIC
/begin CHARACTERISTIC K_ED_LAVK1_OBD_TL.INC_NACH_EINTRAG "Filtererhoehung nach Fehlerspeichereintrag" VALUE 0x70D56 TKW_VV_VV_UB 100.0 FORMULA_0003 0.0 255.0 /end CHARACTERISTIC
/begin CHARACTERISTIC K_ED_LAVK1_OBD_TL.INC_VOR_EINTRAG "Filtererhoehung vorm Fehlerspeichereintrag" VALUE 0x70D54 TKW_VV_VV_UB 100.0 FORMULA_0003 0.0 255.0 /end CHARACTERISTIC
/begin CHARACTERISTIC K_ED_LAVK1_OBD_TL.KLASSENINDEX "Auswahl der Fehlerklasse" VALUE 0x70D58 TKW_VV_VV_UB 100.0 FORMULA_0003 0.0 8.0 /end CHARACTERISTIC
/begin CHARACTERISTIC K_ED_LAVK1_OBD_TL.OK_SCHWELLE "Filterschwelle fuer Fehleraustrag" VALUE 0x70D53 TKW_VV_VV_UB 100.0 FORMULA_0003 0.0 255.0 /end CHARACTERISTIC
/begin CHARACTERISTIC K_ED_LAVK1_OBD_TL.P_CODE_OPENLOAD "P-Code fuer die Art OPENLOAD" VALUE 0x70D4E TKW_VV_VV_UW 100.0 FORMULA_0010 0.0 65535.0 /end CHARACTERISTIC
/begin CHARACTERISTIC K_ED_LAVK1_OBD_TL.P_CODE_SH_TO_GND "P-Code fuer die Art SH_TO_GND" VALUE 0x70D4C TKW_VV_VV_UW 100.0 FORMULA_0010 0.0 65535.0 /end CHARACTERISTIC
/begin CHARACTERISTIC K_ED_LAVK1_OBD_TL.P_CODE_SH_TO_UB "P-Code fuer die Art SH_TO_UB" VALUE 0x70D4A TKW_VV_VV_UW 100.0 FORMULA_0010 0.0 65535.0 /end CHARACTERISTIC
/begin CHARACTERISTIC K_ED_LAVK1_OBD_TL.P_CODE_UNPLAUSIBEL "P-Code fuer die Art UNPLAUSIBEL" VALUE 0x70D50 TKW_VV_VV_UW 100.0 FORMULA_0010 0.0 65535.0 /end CHARACTERISTIC
/begin CHARACTERISTIC K_ED_LAVK1_TRIM.DEC_NACH_EINTRAG "Filterverringerung nach Fehlerspeichereintrag" VALUE 0x713D7 TKW_VV_VV_UB 100.0 FORMULA_0003 0.0 255.0 /end CHARACTERISTIC
/begin CHARACTERISTIC K_ED_LAVK1_TRIM.DEC_VOR_EINTRAG "Filterverringerung vorm Fehlerspeichereintrag" VALUE 0x713D5 TKW_VV_VV_UB 100.0 FORMULA_0003 0.0 255.0 /end CHARACTERISTIC
/begin CHARACTERISTIC K_ED_LAVK1_TRIM.FEHLERSCHWELLE "Filterschwelle fuer Fehlereintrag" VALUE 0x713D2 TKW_VV_VV_UB 100.0 FORMULA_0003 0.0 255.0 /end CHARACTERISTIC
/begin CHARACTERISTIC K_ED_LAVK1_TRIM.INC_NACH_EINTRAG "Filtererhoehung nach Fehlerspeichereintrag" VALUE 0x713D6 TKW_VV_VV_UB 100.0 FORMULA_0003 0.0 255.0 /end CHARACTERISTIC
/begin CHARACTERISTIC K_ED_LAVK1_TRIM.INC_VOR_EINTRAG "Filtererhoehung vorm Fehlerspeichereintrag" VALUE 0x713D4 TKW_VV_VV_UB 100.0 FORMULA_0003 0.0 255.0 /end CHARACTERISTIC
/begin CHARACTERISTIC K_ED_LAVK1_TRIM.KLASSENINDEX "Auswahl der Fehlerklasse" VALUE 0x713D8 TKW_VV_VV_UB 100.0 FORMULA_0003 0.0 8.0 /end CHARACTERISTIC
/begin CHARACTERISTIC K_ED_LAVK1_TRIM.OK_SCHWELLE "Filterschwelle fuer Fehleraustrag" VALUE 0x713D3 TKW_VV_VV_UB 100.0 FORMULA_0003 0.0 255.0 /end CHARACTERISTIC
/begin CHARACTERISTIC K_ED_LAVK1_TRIM.P_CODE_OPENLOAD "P-Code fuer die Art OPENLOAD" VALUE 0x713CE TKW_VV_VV_UW 100.0 FORMULA_0010 0.0 65535.0 /end CHARACTERISTIC
/begin CHARACTERISTIC K_ED_LAVK1_TRIM.P_CODE_SH_TO_GND "P-Code fuer die Art SH_TO_GND" VALUE 0x713CC TKW_VV_VV_UW 100.0 FORMULA_0010 0.0 65535.0 /end CHARACTERISTIC
/begin CHARACTERISTIC K_ED_LAVK1_TRIM.P_CODE_SH_TO_UB "P-Code fuer die Art SH_TO_UB" VALUE 0x713CA TKW_VV_VV_UW 100.0 FORMULA_0010 0.0 65535.0 /end CHARACTERISTIC
/begin CHARACTERISTIC K_ED_LAVK1_TRIM.P_CODE_UNPLAUSIBEL "P-Code fuer die Art UNPLAUSIBEL" VALUE 0x713D0 TKW_VV_VV_UW 100.0 FORMULA_0010 0.0 65535.0 /end CHARACTERISTIC
/begin CHARACTERISTIC K_ED_LAVK1_UN_OPENLOAD.DEC_NACH_EINTRAG "Filterverringerung nach Fehlerspeichereintrag" VALUE 0x70F2B TKW_VV_VV_UB 100.0 FORMULA_0003 0.0 255.0 /end CHARACTERISTIC
/begin CHARACTERISTIC K_ED_LAVK1_UN_OPENLOAD.DEC_VOR_EINTRAG "Filterverringerung vorm Fehlerspeichereintrag" VALUE 0x70F29 TKW_VV_VV_UB 100.0 FORMULA_0003 0.0 255.0 /end CHARACTERISTIC
/begin CHARACTERISTIC K_ED_LAVK1_UN_OPENLOAD.FEHLERSCHWELLE "Filterschwelle fuer Fehlereintrag" VALUE 0x70F26 TKW_VV_VV_UB 100.0 FORMULA_0003 0.0 255.0 /end CHARACTERISTIC
/begin CHARACTERISTIC K_ED_LAVK1_UN_OPENLOAD.INC_NACH_EINTRAG "Filtererhoehung nach Fehlerspeichereintrag" VALUE 0x70F2A TKW_VV_VV_UB 100.0 FORMULA_0003 0.0 255.0 /end CHARACTERISTIC
/begin CHARACTERISTIC K_ED_LAVK1_UN_OPENLOAD.INC_VOR_EINTRAG "Filtererhoehung vorm Fehlerspeichereintrag" VALUE 0x70F28 TKW_VV_VV_UB 100.0 FORMULA_0003 0.0 255.0 /end CHARACTERISTIC
/begin CHARACTERISTIC K_ED_LAVK1_UN_OPENLOAD.KLASSENINDEX "Auswahl der Fehlerklasse" VALUE 0x70F2C TKW_VV_VV_UB 100.0 FORMULA_0003 0.0 8.0 /end CHARACTERISTIC
/begin CHARACTERISTIC K_ED_LAVK1_UN_OPENLOAD.OK_SCHWELLE "Filterschwelle fuer Fehleraustrag" VALUE 0x70F27 TKW_VV_VV_UB 100.0 FORMULA_0003 0.0 255.0 /end CHARACTERISTIC
/begin CHARACTERISTIC K_ED_LAVK1_UN_OPENLOAD.P_CODE_OPENLOAD "P-Code fuer die Art OPENLOAD" VALUE 0x70F22 TKW_VV_VV_UW 100.0 FORMULA_0010 0.0 65535.0 /end CHARACTERISTIC
/begin CHARACTERISTIC K_ED_LAVK1_UN_OPENLOAD.P_CODE_SH_TO_GND "P-Code fuer die Art SH_TO_GND" VALUE 0x70F20 TKW_VV_VV_UW 100.0 FORMULA_0010 0.0 65535.0 /end CHARACTERISTIC
/begin CHARACTERISTIC K_ED_LAVK1_UN_OPENLOAD.P_CODE_SH_TO_UB "P-Code fuer die Art SH_TO_UB" VALUE 0x70F1E TKW_VV_VV_UW 100.0 FORMULA_0010 0.0 65535.0 /end CHARACTERISTIC
/begin CHARACTERISTIC K_ED_LAVK1_UN_OPENLOAD.P_CODE_UNPLAUSIBEL "P-Code fuer die Art UNPLAUSIBEL" VALUE 0x70F24 TKW_VV_VV_UW 100.0 FORMULA_0010 0.0 65535.0 /end CHARACTERISTIC
/begin CHARACTERISTIC K_ED_LAVK2.DEC_NACH_EINTRAG "Filterverringerung nach Fehlerspeichereintrag" VALUE 0x70B01 TKW_VV_VV_UB 100.0 FORMULA_0003 0.0 255.0 /end CHARACTERISTIC
/begin CHARACTERISTIC K_ED_LAVK2.DEC_VOR_EINTRAG "Filterverringerung vorm Fehlerspeichereintrag" VALUE 0x70AFF TKW_VV_VV_UB 100.0 FORMULA_0003 0.0 255.0 /end CHARACTERISTIC
/begin CHARACTERISTIC K_ED_LAVK2.FEHLERSCHWELLE "Filterschwelle fuer Fehlereintrag" VALUE 0x70AFC TKW_VV_VV_UB 100.0 FORMULA_0003 0.0 255.0 /end CHARACTERISTIC
/begin CHARACTERISTIC K_ED_LAVK2.INC_NACH_EINTRAG "Filtererhoehung nach Fehlerspeichereintrag" VALUE 0x70B00 TKW_VV_VV_UB 100.0 FORMULA_0003 0.0 255.0 /end CHARACTERISTIC
/begin CHARACTERISTIC K_ED_LAVK2.INC_VOR_EINTRAG "Filtererhoehung vorm Fehlerspeichereintrag" VALUE 0x70AFE TKW_VV_VV_UB 100.0 FORMULA_0003 0.0 255.0 /end CHARACTERISTIC
/begin CHARACTERISTIC K_ED_LAVK2.KLASSENINDEX "Auswahl der Fehlerklasse" VALUE 0x70B02 TKW_VV_VV_UB 100.0 FORMULA_0003 0.0 8.0 /end CHARACTERISTIC
/begin CHARACTERISTIC K_ED_LAVK2.OK_SCHWELLE "Filterschwelle fuer Fehleraustrag" VALUE 0x70AFD TKW_VV_VV_UB 100.0 FORMULA_0003 0.0 255.0 /end CHARACTERISTIC
/begin CHARACTERISTIC K_ED_LAVK2.P_CODE_OPENLOAD "P-Code fuer die Art OPENLOAD" VALUE 0x70AF8 TKW_VV_VV_UW 100.0 FORMULA_0010 0.0 65535.0 /end CHARACTERISTIC
/begin CHARACTERISTIC K_ED_LAVK2.P_CODE_SH_TO_GND "P-Code fuer die Art SH_TO_GND" VALUE 0x70AF6 TKW_VV_VV_UW 100.0 FORMULA_0010 0.0 65535.0 /end CHARACTERISTIC
/begin CHARACTERISTIC K_ED_LAVK2.P_CODE_SH_TO_UB "P-Code fuer die Art SH_TO_UB" VALUE 0x70AF4 TKW_VV_VV_UW 100.0 FORMULA_0010 0.0 65535.0 /end CHARACTERISTIC
/begin CHARACTERISTIC K_ED_LAVK2.P_CODE_UNPLAUSIBEL "P-Code fuer die Art UNPLAUSIBEL" VALUE 0x70AFA TKW_VV_VV_UW 100.0 FORMULA_0010 0.0 65535.0 /end CHARACTERISTIC
/begin CHARACTERISTIC K_ED_LAVK2_DIAG.DEC_NACH_EINTRAG "Filterverringerung nach Fehlerspeichereintrag" VALUE 0x70EA9 TKW_VV_VV_UB 100.0 FORMULA_0003 0.0 255.0 /end CHARACTERISTIC
/begin CHARACTERISTIC K_ED_LAVK2_DIAG.DEC_VOR_EINTRAG "Filterverringerung vorm Fehlerspeichereintrag" VALUE 0x70EA7 TKW_VV_VV_UB 100.0 FORMULA_0003 0.0 255.0 /end CHARACTERISTIC
/begin CHARACTERISTIC K_ED_LAVK2_DIAG.FEHLERSCHWELLE "Filterschwelle fuer Fehlereintrag" VALUE 0x70EA4 TKW_VV_VV_UB 100.0 FORMULA_0003 0.0 255.0 /end CHARACTERISTIC
/begin CHARACTERISTIC K_ED_LAVK2_DIAG.INC_NACH_EINTRAG "Filtererhoehung nach Fehlerspeichereintrag" VALUE 0x70EA8 TKW_VV_VV_UB 100.0 FORMULA_0003 0.0 255.0 /end CHARACTERISTIC
/begin CHARACTERISTIC K_ED_LAVK2_DIAG.INC_VOR_EINTRAG "Filtererhoehung vorm Fehlerspeichereintrag" VALUE 0x70EA6 TKW_VV_VV_UB 100.0 FORMULA_0003 0.0 255.0 /end CHARACTERISTIC
/begin CHARACTERISTIC K_ED_LAVK2_DIAG.KLASSENINDEX "Auswahl der Fehlerklasse" VALUE 0x70EAA TKW_VV_VV_UB 100.0 FORMULA_0003 0.0 8.0 /end CHARACTERISTIC
/begin CHARACTERISTIC K_ED_LAVK2_DIAG.OK_SCHWELLE "Filterschwelle fuer Fehleraustrag" VALUE 0x70EA5 TKW_VV_VV_UB 100.0 FORMULA_0003 0.0 255.0 /end CHARACTERISTIC
/begin CHARACTERISTIC K_ED_LAVK2_DIAG.P_CODE_OPENLOAD "P-Code fuer die Art OPENLOAD" VALUE 0x70EA0 TKW_VV_VV_UW 100.0 FORMULA_0010 0.0 65535.0 /end CHARACTERISTIC
/begin CHARACTERISTIC K_ED_LAVK2_DIAG.P_CODE_SH_TO_GND "P-Code fuer die Art SH_TO_GND" VALUE 0x70E9E TKW_VV_VV_UW 100.0 FORMULA_0010 0.0 65535.0 /end CHARACTERISTIC
/begin CHARACTERISTIC K_ED_LAVK2_DIAG.P_CODE_SH_TO_UB "P-Code fuer die Art SH_TO_UB" VALUE 0x70E9C TKW_VV_VV_UW 100.0 FORMULA_0010 0.0 65535.0 /end CHARACTERISTIC
/begin CHARACTERISTIC K_ED_LAVK2_DIAG.P_CODE_UNPLAUSIBEL "P-Code fuer die Art UNPLAUSIBEL" VALUE 0x70EA2 TKW_VV_VV_UW 100.0 FORMULA_0010 0.0 65535.0 /end CHARACTERISTIC
/begin CHARACTERISTIC K_ED_LAVK2_IA_OPENLOAD.DEC_NACH_EINTRAG "Filterverringerung nach Fehlerspeichereintrag" VALUE 0x70EDD TKW_VV_VV_UB 100.0 FORMULA_0003 0.0 255.0 /end CHARACTERISTIC
/begin CHARACTERISTIC K_ED_LAVK2_IA_OPENLOAD.DEC_VOR_EINTRAG "Filterverringerung vorm Fehlerspeichereintrag" VALUE 0x70EDB TKW_VV_VV_UB 100.0 FORMULA_0003 0.0 255.0 /end CHARACTERISTIC
/begin CHARACTERISTIC K_ED_LAVK2_IA_OPENLOAD.FEHLERSCHWELLE "Filterschwelle fuer Fehlereintrag" VALUE 0x70ED8 TKW_VV_VV_UB 100.0 FORMULA_0003 0.0 255.0 /end CHARACTERISTIC
/begin CHARACTERISTIC K_ED_LAVK2_IA_OPENLOAD.INC_NACH_EINTRAG "Filtererhoehung nach Fehlerspeichereintrag" VALUE 0x70EDC TKW_VV_VV_UB 100.0 FORMULA_0003 0.0 255.0 /end CHARACTERISTIC
/begin CHARACTERISTIC K_ED_LAVK2_IA_OPENLOAD.INC_VOR_EINTRAG "Filtererhoehung vorm Fehlerspeichereintrag" VALUE 0x70EDA TKW_VV_VV_UB 100.0 FORMULA_0003 0.0 255.0 /end CHARACTERISTIC
/begin CHARACTERISTIC K_ED_LAVK2_IA_OPENLOAD.KLASSENINDEX "Auswahl der Fehlerklasse" VALUE 0x70EDE TKW_VV_VV_UB 100.0 FORMULA_0003 0.0 8.0 /end CHARACTERISTIC
/begin CHARACTERISTIC K_ED_LAVK2_IA_OPENLOAD.OK_SCHWELLE "Filterschwelle fuer Fehleraustrag" VALUE 0x70ED9 TKW_VV_VV_UB 100.0 FORMULA_0003 0.0 255.0 /end CHARACTERISTIC
/begin CHARACTERISTIC K_ED_LAVK2_IA_OPENLOAD.P_CODE_OPENLOAD "P-Code fuer die Art OPENLOAD" VALUE 0x70ED4 TKW_VV_VV_UW 100.0 FORMULA_0010 0.0 65535.0 /end CHARACTERISTIC
/begin CHARACTERISTIC K_ED_LAVK2_IA_OPENLOAD.P_CODE_SH_TO_GND "P-Code fuer die Art SH_TO_GND" VALUE 0x70ED2 TKW_VV_VV_UW 100.0 FORMULA_0010 0.0 65535.0 /end CHARACTERISTIC
/begin CHARACTERISTIC K_ED_LAVK2_IA_OPENLOAD.P_CODE_SH_TO_UB "P-Code fuer die Art SH_TO_UB" VALUE 0x70ED0 TKW_VV_VV_UW 100.0 FORMULA_0010 0.0 65535.0 /end CHARACTERISTIC
/begin CHARACTERISTIC K_ED_LAVK2_IA_OPENLOAD.P_CODE_UNPLAUSIBEL "P-Code fuer die Art UNPLAUSIBEL" VALUE 0x70ED6 TKW_VV_VV_UW 100.0 FORMULA_0010 0.0 65535.0 /end CHARACTERISTIC
/begin CHARACTERISTIC K_ED_LAVK2_IP_OPENLOAD.DEC_NACH_EINTRAG "Filterverringerung nach Fehlerspeichereintrag" VALUE 0x70F79 TKW_VV_VV_UB 100.0 FORMULA_0003 0.0 255.0 /end CHARACTERISTIC
/begin CHARACTERISTIC K_ED_LAVK2_IP_OPENLOAD.DEC_VOR_EINTRAG "Filterverringerung vorm Fehlerspeichereintrag" VALUE 0x70F77 TKW_VV_VV_UB 100.0 FORMULA_0003 0.0 255.0 /end CHARACTERISTIC
/begin CHARACTERISTIC K_ED_LAVK2_IP_OPENLOAD.FEHLERSCHWELLE "Filterschwelle fuer Fehlereintrag" VALUE 0x70F74 TKW_VV_VV_UB 100.0 FORMULA_0003 0.0 255.0 /end CHARACTERISTIC
/begin CHARACTERISTIC K_ED_LAVK2_IP_OPENLOAD.INC_NACH_EINTRAG "Filtererhoehung nach Fehlerspeichereintrag" VALUE 0x70F78 TKW_VV_VV_UB 100.0 FORMULA_0003 0.0 255.0 /end CHARACTERISTIC
/begin CHARACTERISTIC K_ED_LAVK2_IP_OPENLOAD.INC_VOR_EINTRAG "Filtererhoehung vorm Fehlerspeichereintrag" VALUE 0x70F76 TKW_VV_VV_UB 100.0 FORMULA_0003 0.0 255.0 /end CHARACTERISTIC
/begin CHARACTERISTIC K_ED_LAVK2_IP_OPENLOAD.KLASSENINDEX "Auswahl der Fehlerklasse" VALUE 0x70F7A TKW_VV_VV_UB 100.0 FORMULA_0003 0.0 8.0 /end CHARACTERISTIC
/begin CHARACTERISTIC K_ED_LAVK2_IP_OPENLOAD.OK_SCHWELLE "Filterschwelle fuer Fehleraustrag" VALUE 0x70F75 TKW_VV_VV_UB 100.0 FORMULA_0003 0.0 255.0 /end CHARACTERISTIC
/begin CHARACTERISTIC K_ED_LAVK2_IP_OPENLOAD.P_CODE_OPENLOAD "P-Code fuer die Art OPENLOAD" VALUE 0x70F70 TKW_VV_VV_UW 100.0 FORMULA_0010 0.0 65535.0 /end CHARACTERISTIC
/begin CHARACTERISTIC K_ED_LAVK2_IP_OPENLOAD.P_CODE_SH_TO_GND "P-Code fuer die Art SH_TO_GND" VALUE 0x70F6E TKW_VV_VV_UW 100.0 FORMULA_0010 0.0 65535.0 /end CHARACTERISTIC
/begin CHARACTERISTIC K_ED_LAVK2_IP_OPENLOAD.P_CODE_SH_TO_UB "P-Code fuer die Art SH_TO_UB" VALUE 0x70F6C TKW_VV_VV_UW 100.0 FORMULA_0010 0.0 65535.0 /end CHARACTERISTIC
/begin CHARACTERISTIC K_ED_LAVK2_IP_OPENLOAD.P_CODE_UNPLAUSIBEL "P-Code fuer die Art UNPLAUSIBEL" VALUE 0x70F72 TKW_VV_VV_UW 100.0 FORMULA_0010 0.0 65535.0 /end CHARACTERISTIC
/begin CHARACTERISTIC K_ED_LAVK2_OBD_DYN.DEC_NACH_EINTRAG "Filterverringerung nach Fehlerspeichereintrag" VALUE 0x712D3 TKW_VV_VV_UB 100.0 FORMULA_0003 0.0 255.0 /end CHARACTERISTIC
/begin CHARACTERISTIC K_ED_LAVK2_OBD_DYN.DEC_VOR_EINTRAG "Filterverringerung vorm Fehlerspeichereintrag" VALUE 0x712D1 TKW_VV_VV_UB 100.0 FORMULA_0003 0.0 255.0 /end CHARACTERISTIC
/begin CHARACTERISTIC K_ED_LAVK2_OBD_DYN.FEHLERSCHWELLE "Filterschwelle fuer Fehlereintrag" VALUE 0x712CE TKW_VV_VV_UB 100.0 FORMULA_0003 0.0 255.0 /end CHARACTERISTIC
/begin CHARACTERISTIC K_ED_LAVK2_OBD_DYN.INC_NACH_EINTRAG "Filtererhoehung nach Fehlerspeichereintrag" VALUE 0x712D2 TKW_VV_VV_UB 100.0 FORMULA_0003 0.0 255.0 /end CHARACTERISTIC
/begin CHARACTERISTIC K_ED_LAVK2_OBD_DYN.INC_VOR_EINTRAG "Filtererhoehung vorm Fehlerspeichereintrag" VALUE 0x712D0 TKW_VV_VV_UB 100.0 FORMULA_0003 0.0 255.0 /end CHARACTERISTIC
/begin CHARACTERISTIC K_ED_LAVK2_OBD_DYN.KLASSENINDEX "Auswahl der Fehlerklasse" VALUE 0x712D4 TKW_VV_VV_UB 100.0 FORMULA_0003 0.0 8.0 /end CHARACTERISTIC
/begin CHARACTERISTIC K_ED_LAVK2_OBD_DYN.OK_SCHWELLE "Filterschwelle fuer Fehleraustrag" VALUE 0x712CF TKW_VV_VV_UB 100.0 FORMULA_0003 0.0 255.0 /end CHARACTERISTIC
/begin CHARACTERISTIC K_ED_LAVK2_OBD_DYN.P_CODE_OPENLOAD "P-Code fuer die Art OPENLOAD" VALUE 0x712CA TKW_VV_VV_UW 100.0 FORMULA_0010 0.0 65535.0 /end CHARACTERISTIC
/begin CHARACTERISTIC K_ED_LAVK2_OBD_DYN.P_CODE_SH_TO_GND "P-Code fuer die Art SH_TO_GND" VALUE 0x712C8 TKW_VV_VV_UW 100.0 FORMULA_0010 0.0 65535.0 /end CHARACTERISTIC
/begin CHARACTERISTIC K_ED_LAVK2_OBD_DYN.P_CODE_SH_TO_UB "P-Code fuer die Art SH_TO_UB" VALUE 0x712C6 TKW_VV_VV_UW 100.0 FORMULA_0010 0.0 65535.0 /end CHARACTERISTIC
/begin CHARACTERISTIC K_ED_LAVK2_OBD_DYN.P_CODE_UNPLAUSIBEL "P-Code fuer die Art UNPLAUSIBEL" VALUE 0x712CC TKW_VV_VV_UW 100.0 FORMULA_0010 0.0 65535.0 /end CHARACTERISTIC
/begin CHARACTERISTIC K_ED_LAVK2_OBD_PLAU.DEC_NACH_EINTRAG "Filterverringerung nach Fehlerspeichereintrag" VALUE 0x70B35 TKW_VV_VV_UB 100.0 FORMULA_0003 0.0 255.0 /end CHARACTERISTIC
/begin CHARACTERISTIC K_ED_LAVK2_OBD_PLAU.DEC_VOR_EINTRAG "Filterverringerung vorm Fehlerspeichereintrag" VALUE 0x70B33 TKW_VV_VV_UB 100.0 FORMULA_0003 0.0 255.0 /end CHARACTERISTIC
/begin CHARACTERISTIC K_ED_LAVK2_OBD_PLAU.FEHLERSCHWELLE "Filterschwelle fuer Fehlereintrag" VALUE 0x70B30 TKW_VV_VV_UB 100.0 FORMULA_0003 0.0 255.0 /end CHARACTERISTIC
/begin CHARACTERISTIC K_ED_LAVK2_OBD_PLAU.INC_NACH_EINTRAG "Filtererhoehung nach Fehlerspeichereintrag" VALUE 0x70B34 TKW_VV_VV_UB 100.0 FORMULA_0003 0.0 255.0 /end CHARACTERISTIC
/begin CHARACTERISTIC K_ED_LAVK2_OBD_PLAU.INC_VOR_EINTRAG "Filtererhoehung vorm Fehlerspeichereintrag" VALUE 0x70B32 TKW_VV_VV_UB 100.0 FORMULA_0003 0.0 255.0 /end CHARACTERISTIC
/begin CHARACTERISTIC K_ED_LAVK2_OBD_PLAU.KLASSENINDEX "Auswahl der Fehlerklasse" VALUE 0x70B36 TKW_VV_VV_UB 100.0 FORMULA_0003 0.0 8.0 /end CHARACTERISTIC
/begin CHARACTERISTIC K_ED_LAVK2_OBD_PLAU.OK_SCHWELLE "Filterschwelle fuer Fehleraustrag" VALUE 0x70B31 TKW_VV_VV_UB 100.0 FORMULA_0003 0.0 255.0 /end CHARACTERISTIC
/begin CHARACTERISTIC K_ED_LAVK2_OBD_PLAU.P_CODE_OPENLOAD "P-Code fuer die Art OPENLOAD" VALUE 0x70B2C TKW_VV_VV_UW 100.0 FORMULA_0010 0.0 65535.0 /end CHARACTERISTIC
/begin CHARACTERISTIC K_ED_LAVK2_OBD_PLAU.P_CODE_SH_TO_GND "P-Code fuer die Art SH_TO_GND" VALUE 0x70B2A TKW_VV_VV_UW 100.0 FORMULA_0010 0.0 65535.0 /end CHARACTERISTIC
/begin CHARACTERISTIC K_ED_LAVK2_OBD_PLAU.P_CODE_SH_TO_UB "P-Code fuer die Art SH_TO_UB" VALUE 0x70B28 TKW_VV_VV_UW 100.0 FORMULA_0010 0.0 65535.0 /end CHARACTERISTIC
/begin CHARACTERISTIC K_ED_LAVK2_OBD_PLAU.P_CODE_UNPLAUSIBEL "P-Code fuer die Art UNPLAUSIBEL" VALUE 0x70B2E TKW_VV_VV_UW 100.0 FORMULA_0010 0.0 65535.0 /end CHARACTERISTIC
/begin CHARACTERISTIC K_ED_LAVK2_OBD_SA.DEC_NACH_EINTRAG "Filterverringerung nach Fehlerspeichereintrag" VALUE 0x70B69 TKW_VV_VV_UB 100.0 FORMULA_0003 0.0 255.0 /end CHARACTERISTIC
/begin CHARACTERISTIC K_ED_LAVK2_OBD_SA.DEC_VOR_EINTRAG "Filterverringerung vorm Fehlerspeichereintrag" VALUE 0x70B67 TKW_VV_VV_UB 100.0 FORMULA_0003 0.0 255.0 /end CHARACTERISTIC
/begin CHARACTERISTIC K_ED_LAVK2_OBD_SA.FEHLERSCHWELLE "Filterschwelle fuer Fehlereintrag" VALUE 0x70B64 TKW_VV_VV_UB 100.0 FORMULA_0003 0.0 255.0 /end CHARACTERISTIC
/begin CHARACTERISTIC K_ED_LAVK2_OBD_SA.INC_NACH_EINTRAG "Filtererhoehung nach Fehlerspeichereintrag" VALUE 0x70B68 TKW_VV_VV_UB 100.0 FORMULA_0003 0.0 255.0 /end CHARACTERISTIC
/begin CHARACTERISTIC K_ED_LAVK2_OBD_SA.INC_VOR_EINTRAG "Filtererhoehung vorm Fehlerspeichereintrag" VALUE 0x70B66 TKW_VV_VV_UB 100.0 FORMULA_0003 0.0 255.0 /end CHARACTERISTIC
/begin CHARACTERISTIC K_ED_LAVK2_OBD_SA.KLASSENINDEX "Auswahl der Fehlerklasse" VALUE 0x70B6A TKW_VV_VV_UB 100.0 FORMULA_0003 0.0 8.0 /end CHARACTERISTIC
/begin CHARACTERISTIC K_ED_LAVK2_OBD_SA.OK_SCHWELLE "Filterschwelle fuer Fehleraustrag" VALUE 0x70B65 TKW_VV_VV_UB 100.0 FORMULA_0003 0.0 255.0 /end CHARACTERISTIC
/begin CHARACTERISTIC K_ED_LAVK2_OBD_SA.P_CODE_OPENLOAD "P-Code fuer die Art OPENLOAD" VALUE 0x70B60 TKW_VV_VV_UW 100.0 FORMULA_0010 0.0 65535.0 /end CHARACTERISTIC
/begin CHARACTERISTIC K_ED_LAVK2_OBD_SA.P_CODE_SH_TO_GND "P-Code fuer die Art SH_TO_GND" VALUE 0x70B5E TKW_VV_VV_UW 100.0 FORMULA_0010 0.0 65535.0 /end CHARACTERISTIC
/begin CHARACTERISTIC K_ED_LAVK2_OBD_SA.P_CODE_SH_TO_UB "P-Code fuer die Art SH_TO_UB" VALUE 0x70B5C TKW_VV_VV_UW 100.0 FORMULA_0010 0.0 65535.0 /end CHARACTERISTIC
/begin CHARACTERISTIC K_ED_LAVK2_OBD_SA.P_CODE_UNPLAUSIBEL "P-Code fuer die Art UNPLAUSIBEL" VALUE 0x70B62 TKW_VV_VV_UW 100.0 FORMULA_0010 0.0 65535.0 /end CHARACTERISTIC
/begin CHARACTERISTIC K_ED_LAVK2_OBD_TL.DEC_NACH_EINTRAG "Filterverringerung nach Fehlerspeichereintrag" VALUE 0x70D71 TKW_VV_VV_UB 100.0 FORMULA_0003 0.0 255.0 /end CHARACTERISTIC
/begin CHARACTERISTIC K_ED_LAVK2_OBD_TL.DEC_VOR_EINTRAG "Filterverringerung vorm Fehlerspeichereintrag" VALUE 0x70D6F TKW_VV_VV_UB 100.0 FORMULA_0003 0.0 255.0 /end CHARACTERISTIC
/begin CHARACTERISTIC K_ED_LAVK2_OBD_TL.FEHLERSCHWELLE "Filterschwelle fuer Fehlereintrag" VALUE 0x70D6C TKW_VV_VV_UB 100.0 FORMULA_0003 0.0 255.0 /end CHARACTERISTIC
/begin CHARACTERISTIC K_ED_LAVK2_OBD_TL.INC_NACH_EINTRAG "Filtererhoehung nach Fehlerspeichereintrag" VALUE 0x70D70 TKW_VV_VV_UB 100.0 FORMULA_0003 0.0 255.0 /end CHARACTERISTIC
/begin CHARACTERISTIC K_ED_LAVK2_OBD_TL.INC_VOR_EINTRAG "Filtererhoehung vorm Fehlerspeichereintrag" VALUE 0x70D6E TKW_VV_VV_UB 100.0 FORMULA_0003 0.0 255.0 /end CHARACTERISTIC
/begin CHARACTERISTIC K_ED_LAVK2_OBD_TL.KLASSENINDEX "Auswahl der Fehlerklasse" VALUE 0x70D72 TKW_VV_VV_UB 100.0 FORMULA_0003 0.0 8.0 /end CHARACTERISTIC
/begin CHARACTERISTIC K_ED_LAVK2_OBD_TL.OK_SCHWELLE "Filterschwelle fuer Fehleraustrag" VALUE 0x70D6D TKW_VV_VV_UB 100.0 FORMULA_0003 0.0 255.0 /end CHARACTERISTIC
/begin CHARACTERISTIC K_ED_LAVK2_OBD_TL.P_CODE_OPENLOAD "P-Code fuer die Art OPENLOAD" VALUE 0x70D68 TKW_VV_VV_UW 100.0 FORMULA_0010 0.0 65535.0 /end CHARACTERISTIC
/begin CHARACTERISTIC K_ED_LAVK2_OBD_TL.P_CODE_SH_TO_GND "P-Code fuer die Art SH_TO_GND" VALUE 0x70D66 TKW_VV_VV_UW 100.0 FORMULA_0010 0.0 65535.0 /end CHARACTERISTIC
/begin CHARACTERISTIC K_ED_LAVK2_OBD_TL.P_CODE_SH_TO_UB "P-Code fuer die Art SH_TO_UB" VALUE 0x70D64 TKW_VV_VV_UW 100.0 FORMULA_0010 0.0 65535.0 /end CHARACTERISTIC
/begin CHARACTERISTIC K_ED_LAVK2_OBD_TL.P_CODE_UNPLAUSIBEL "P-Code fuer die Art UNPLAUSIBEL" VALUE 0x70D6A TKW_VV_VV_UW 100.0 FORMULA_0010 0.0 65535.0 /end CHARACTERISTIC
/begin CHARACTERISTIC K_ED_LAVK2_TRIM.DEC_NACH_EINTRAG "Filterverringerung nach Fehlerspeichereintrag" VALUE 0x713F1 TKW_VV_VV_UB 100.0 FORMULA_0003 0.0 255.0 /end CHARACTERISTIC
/begin CHARACTERISTIC K_ED_LAVK2_TRIM.DEC_VOR_EINTRAG "Filterverringerung vorm Fehlerspeichereintrag" VALUE 0x713EF TKW_VV_VV_UB 100.0 FORMULA_0003 0.0 255.0 /end CHARACTERISTIC
/begin CHARACTERISTIC K_ED_LAVK2_TRIM.FEHLERSCHWELLE "Filterschwelle fuer Fehlereintrag" VALUE 0x713EC TKW_VV_VV_UB 100.0 FORMULA_0003 0.0 255.0 /end CHARACTERISTIC
/begin CHARACTERISTIC K_ED_LAVK2_TRIM.INC_NACH_EINTRAG "Filtererhoehung nach Fehlerspeichereintrag" VALUE 0x713F0 TKW_VV_VV_UB 100.0 FORMULA_0003 0.0 255.0 /end CHARACTERISTIC
/begin CHARACTERISTIC K_ED_LAVK2_TRIM.INC_VOR_EINTRAG "Filtererhoehung vorm Fehlerspeichereintrag" VALUE 0x713EE TKW_VV_VV_UB 100.0 FORMULA_0003 0.0 255.0 /end CHARACTERISTIC
/begin CHARACTERISTIC K_ED_LAVK2_TRIM.KLASSENINDEX "Auswahl der Fehlerklasse" VALUE 0x713F2 TKW_VV_VV_UB 100.0 FORMULA_0003 0.0 8.0 /end CHARACTERISTIC
/begin CHARACTERISTIC K_ED_LAVK2_TRIM.OK_SCHWELLE "Filterschwelle fuer Fehleraustrag" VALUE 0x713ED TKW_VV_VV_UB 100.0 FORMULA_0003 0.0 255.0 /end CHARACTERISTIC
/begin CHARACTERISTIC K_ED_LAVK2_TRIM.P_CODE_OPENLOAD "P-Code fuer die Art OPENLOAD" VALUE 0x713E8 TKW_VV_VV_UW 100.0 FORMULA_0010 0.0 65535.0 /end CHARACTERISTIC
/begin CHARACTERISTIC K_ED_LAVK2_TRIM.P_CODE_SH_TO_GND "P-Code fuer die Art SH_TO_GND" VALUE 0x713E6 TKW_VV_VV_UW 100.0 FORMULA_0010 0.0 65535.0 /end CHARACTERISTIC
/begin CHARACTERISTIC K_ED_LAVK2_TRIM.P_CODE_SH_TO_UB "P-Code fuer die Art SH_TO_UB" VALUE 0x713E4 TKW_VV_VV_UW 100.0 FORMULA_0010 0.0 65535.0 /end CHARACTERISTIC
/begin CHARACTERISTIC K_ED_LAVK2_TRIM.P_CODE_UNPLAUSIBEL "P-Code fuer die Art UNPLAUSIBEL" VALUE 0x713EA TKW_VV_VV_UW 100.0 FORMULA_0010 0.0 65535.0 /end CHARACTERISTIC
/begin CHARACTERISTIC K_ED_LAVK2_UN_OPENLOAD.DEC_NACH_EINTRAG "Filterverringerung nach Fehlerspeichereintrag" VALUE 0x70F45 TKW_VV_VV_UB 100.0 FORMULA_0003 0.0 255.0 /end CHARACTERISTIC
/begin CHARACTERISTIC K_ED_LAVK2_UN_OPENLOAD.DEC_VOR_EINTRAG "Filterverringerung vorm Fehlerspeichereintrag" VALUE 0x70F43 TKW_VV_VV_UB 100.0 FORMULA_0003 0.0 255.0 /end CHARACTERISTIC
/begin CHARACTERISTIC K_ED_LAVK2_UN_OPENLOAD.FEHLERSCHWELLE "Filterschwelle fuer Fehlereintrag" VALUE 0x70F40 TKW_VV_VV_UB 100.0 FORMULA_0003 0.0 255.0 /end CHARACTERISTIC
/begin CHARACTERISTIC K_ED_LAVK2_UN_OPENLOAD.INC_NACH_EINTRAG "Filtererhoehung nach Fehlerspeichereintrag" VALUE 0x70F44 TKW_VV_VV_UB 100.0 FORMULA_0003 0.0 255.0 /end CHARACTERISTIC
/begin CHARACTERISTIC K_ED_LAVK2_UN_OPENLOAD.INC_VOR_EINTRAG "Filtererhoehung vorm Fehlerspeichereintrag" VALUE 0x70F42 TKW_VV_VV_UB 100.0 FORMULA_0003 0.0 255.0 /end CHARACTERISTIC
/begin CHARACTERISTIC K_ED_LAVK2_UN_OPENLOAD.KLASSENINDEX "Auswahl der Fehlerklasse" VALUE 0x70F46 TKW_VV_VV_UB 100.0 FORMULA_0003 0.0 8.0 /end CHARACTERISTIC
/begin CHARACTERISTIC K_ED_LAVK2_UN_OPENLOAD.OK_SCHWELLE "Filterschwelle fuer Fehleraustrag" VALUE 0x70F41 TKW_VV_VV_UB 100.0 FORMULA_0003 0.0 255.0 /end CHARACTERISTIC
/begin CHARACTERISTIC K_ED_LAVK2_UN_OPENLOAD.P_CODE_OPENLOAD "P-Code fuer die Art OPENLOAD" VALUE 0x70F3C TKW_VV_VV_UW 100.0 FORMULA_0010 0.0 65535.0 /end CHARACTERISTIC
/begin CHARACTERISTIC K_ED_LAVK2_UN_OPENLOAD.P_CODE_SH_TO_GND "P-Code fuer die Art SH_TO_GND" VALUE 0x70F3A TKW_VV_VV_UW 100.0 FORMULA_0010 0.0 65535.0 /end CHARACTERISTIC
/begin CHARACTERISTIC K_ED_LAVK2_UN_OPENLOAD.P_CODE_SH_TO_UB "P-Code fuer die Art SH_TO_UB" VALUE 0x70F38 TKW_VV_VV_UW 100.0 FORMULA_0010 0.0 65535.0 /end CHARACTERISTIC
/begin CHARACTERISTIC K_ED_LAVK2_UN_OPENLOAD.P_CODE_UNPLAUSIBEL "P-Code fuer die Art UNPLAUSIBEL" VALUE 0x70F3E TKW_VV_VV_UW 100.0 FORMULA_0010 0.0 65535.0 /end CHARACTERISTIC
/begin CHARACTERISTIC K_ED_LSHNK1.DEC_NACH_EINTRAG "Filterverringerung nach Fehlerspeichereintrag" VALUE 0x70BB7 TKW_VV_VV_UB 100.0 FORMULA_0003 0.0 255.0 /end CHARACTERISTIC
/begin CHARACTERISTIC K_ED_LSHNK1.DEC_VOR_EINTRAG "Filterverringerung vorm Fehlerspeichereintrag" VALUE 0x70BB5 TKW_VV_VV_UB 100.0 FORMULA_0003 0.0 255.0 /end CHARACTERISTIC
/begin CHARACTERISTIC K_ED_LSHNK1.FEHLERSCHWELLE "Filterschwelle fuer Fehlereintrag" VALUE 0x70BB2 TKW_VV_VV_UB 100.0 FORMULA_0003 0.0 255.0 /end CHARACTERISTIC
/begin CHARACTERISTIC K_ED_LSHNK1.INC_NACH_EINTRAG "Filtererhoehung nach Fehlerspeichereintrag" VALUE 0x70BB6 TKW_VV_VV_UB 100.0 FORMULA_0003 0.0 255.0 /end CHARACTERISTIC
/begin CHARACTERISTIC K_ED_LSHNK1.INC_VOR_EINTRAG "Filtererhoehung vorm Fehlerspeichereintrag" VALUE 0x70BB4 TKW_VV_VV_UB 100.0 FORMULA_0003 0.0 255.0 /end CHARACTERISTIC
/begin CHARACTERISTIC K_ED_LSHNK1.KLASSENINDEX "Auswahl der Fehlerklasse" VALUE 0x70BB8 TKW_VV_VV_UB 100.0 FORMULA_0003 0.0 8.0 /end CHARACTERISTIC
/begin CHARACTERISTIC K_ED_LSHNK1.OK_SCHWELLE "Filterschwelle fuer Fehleraustrag" VALUE 0x70BB3 TKW_VV_VV_UB 100.0 FORMULA_0003 0.0 255.0 /end CHARACTERISTIC
/begin CHARACTERISTIC K_ED_LSHNK1.P_CODE_OPENLOAD "P-Code fuer die Art OPENLOAD" VALUE 0x70BAE TKW_VV_VV_UW 100.0 FORMULA_0010 0.0 65535.0 /end CHARACTERISTIC
/begin CHARACTERISTIC K_ED_LSHNK1.P_CODE_SH_TO_GND "P-Code fuer die Art SH_TO_GND" VALUE 0x70BAC TKW_VV_VV_UW 100.0 FORMULA_0010 0.0 65535.0 /end CHARACTERISTIC
/begin CHARACTERISTIC K_ED_LSHNK1.P_CODE_SH_TO_UB "P-Code fuer die Art SH_TO_UB" VALUE 0x70BAA TKW_VV_VV_UW 100.0 FORMULA_0010 0.0 65535.0 /end CHARACTERISTIC
/begin CHARACTERISTIC K_ED_LSHNK1.P_CODE_UNPLAUSIBEL "P-Code fuer die Art UNPLAUSIBEL" VALUE 0x70BB0 TKW_VV_VV_UW 100.0 FORMULA_0010 0.0 65535.0 /end CHARACTERISTIC
/begin CHARACTERISTIC K_ED_LSHNK1_R.DEC_NACH_EINTRAG "Filterverringerung nach Fehlerspeichereintrag" VALUE 0x71BF7 TKW_VV_VV_UB 100.0 FORMULA_0003 0.0 255.0 /end CHARACTERISTIC
/begin CHARACTERISTIC K_ED_LSHNK1_R.DEC_VOR_EINTRAG "Filterverringerung vorm Fehlerspeichereintrag" VALUE 0x71BF5 TKW_VV_VV_UB 100.0 FORMULA_0003 0.0 255.0 /end CHARACTERISTIC
/begin CHARACTERISTIC K_ED_LSHNK1_R.FEHLERSCHWELLE "Filterschwelle fuer Fehlereintrag" VALUE 0x71BF2 TKW_VV_VV_UB 100.0 FORMULA_0003 0.0 255.0 /end CHARACTERISTIC
/begin CHARACTERISTIC K_ED_LSHNK1_R.INC_NACH_EINTRAG "Filtererhoehung nach Fehlerspeichereintrag" VALUE 0x71BF6 TKW_VV_VV_UB 100.0 FORMULA_0003 0.0 255.0 /end CHARACTERISTIC
/begin CHARACTERISTIC K_ED_LSHNK1_R.INC_VOR_EINTRAG "Filtererhoehung vorm Fehlerspeichereintrag" VALUE 0x71BF4 TKW_VV_VV_UB 100.0 FORMULA_0003 0.0 255.0 /end CHARACTERISTIC
/begin CHARACTERISTIC K_ED_LSHNK1_R.KLASSENINDEX "Auswahl der Fehlerklasse" VALUE 0x71BF8 TKW_VV_VV_UB 100.0 FORMULA_0003 0.0 8.0 /end CHARACTERISTIC
/begin CHARACTERISTIC K_ED_LSHNK1_R.OK_SCHWELLE "Filterschwelle fuer Fehleraustrag" VALUE 0x71BF3 TKW_VV_VV_UB 100.0 FORMULA_0003 0.0 255.0 /end CHARACTERISTIC
/begin CHARACTERISTIC K_ED_LSHNK1_R.P_CODE_OPENLOAD "P-Code fuer die Art OPENLOAD" VALUE 0x71BEE TKW_VV_VV_UW 100.0 FORMULA_0010 0.0 65535.0 /end CHARACTERISTIC
/begin CHARACTERISTIC K_ED_LSHNK1_R.P_CODE_SH_TO_GND "P-Code fuer die Art SH_TO_GND" VALUE 0x71BEC TKW_VV_VV_UW 100.0 FORMULA_0010 0.0 65535.0 /end CHARACTERISTIC
/begin CHARACTERISTIC K_ED_LSHNK1_R.P_CODE_SH_TO_UB "P-Code fuer die Art SH_TO_UB" VALUE 0x71BEA TKW_VV_VV_UW 100.0 FORMULA_0010 0.0 65535.0 /end CHARACTERISTIC
/begin CHARACTERISTIC K_ED_LSHNK1_R.P_CODE_UNPLAUSIBEL "P-Code fuer die Art UNPLAUSIBEL" VALUE 0x71BF0 TKW_VV_VV_UW 100.0 FORMULA_0010 0.0 65535.0 /end CHARACTERISTIC
/begin CHARACTERISTIC K_ED_LSHNK2.DEC_NACH_EINTRAG "Filterverringerung nach Fehlerspeichereintrag" VALUE 0x70BD1 TKW_VV_VV_UB 100.0 FORMULA_0003 0.0 255.0 /end CHARACTERISTIC
/begin CHARACTERISTIC K_ED_LSHNK2.DEC_VOR_EINTRAG "Filterverringerung vorm Fehlerspeichereintrag" VALUE 0x70BCF TKW_VV_VV_UB 100.0 FORMULA_0003 0.0 255.0 /end CHARACTERISTIC
/begin CHARACTERISTIC K_ED_LSHNK2.FEHLERSCHWELLE "Filterschwelle fuer Fehlereintrag" VALUE 0x70BCC TKW_VV_VV_UB 100.0 FORMULA_0003 0.0 255.0 /end CHARACTERISTIC
/begin CHARACTERISTIC K_ED_LSHNK2.INC_NACH_EINTRAG "Filtererhoehung nach Fehlerspeichereintrag" VALUE 0x70BD0 TKW_VV_VV_UB 100.0 FORMULA_0003 0.0 255.0 /end CHARACTERISTIC
/begin CHARACTERISTIC K_ED_LSHNK2.INC_VOR_EINTRAG "Filtererhoehung vorm Fehlerspeichereintrag" VALUE 0x70BCE TKW_VV_VV_UB 100.0 FORMULA_0003 0.0 255.0 /end CHARACTERISTIC
/begin CHARACTERISTIC K_ED_LSHNK2.KLASSENINDEX "Auswahl der Fehlerklasse" VALUE 0x70BD2 TKW_VV_VV_UB 100.0 FORMULA_0003 0.0 8.0 /end CHARACTERISTIC
/begin CHARACTERISTIC K_ED_LSHNK2.OK_SCHWELLE "Filterschwelle fuer Fehleraustrag" VALUE 0x70BCD TKW_VV_VV_UB 100.0 FORMULA_0003 0.0 255.0 /end CHARACTERISTIC
/begin CHARACTERISTIC K_ED_LSHNK2.P_CODE_OPENLOAD "P-Code fuer die Art OPENLOAD" VALUE 0x70BC8 TKW_VV_VV_UW 100.0 FORMULA_0010 0.0 65535.0 /end CHARACTERISTIC
/begin CHARACTERISTIC K_ED_LSHNK2.P_CODE_SH_TO_GND "P-Code fuer die Art SH_TO_GND" VALUE 0x70BC6 TKW_VV_VV_UW 100.0 FORMULA_0010 0.0 65535.0 /end CHARACTERISTIC
/begin CHARACTERISTIC K_ED_LSHNK2.P_CODE_SH_TO_UB "P-Code fuer die Art SH_TO_UB" VALUE 0x70BC4 TKW_VV_VV_UW 100.0 FORMULA_0010 0.0 65535.0 /end CHARACTERISTIC
/begin CHARACTERISTIC K_ED_LSHNK2.P_CODE_UNPLAUSIBEL "P-Code fuer die Art UNPLAUSIBEL" VALUE 0x70BCA TKW_VV_VV_UW 100.0 FORMULA_0010 0.0 65535.0 /end CHARACTERISTIC
/begin CHARACTERISTIC K_ED_LSHNK2_R.DEC_NACH_EINTRAG "Filterverringerung nach Fehlerspeichereintrag" VALUE 0x71C11 TKW_VV_VV_UB 100.0 FORMULA_0003 0.0 255.0 /end CHARACTERISTIC
/begin CHARACTERISTIC K_ED_LSHNK2_R.DEC_VOR_EINTRAG "Filterverringerung vorm Fehlerspeichereintrag" VALUE 0x71C0F TKW_VV_VV_UB 100.0 FORMULA_0003 0.0 255.0 /end CHARACTERISTIC
/begin CHARACTERISTIC K_ED_LSHNK2_R.FEHLERSCHWELLE "Filterschwelle fuer Fehlereintrag" VALUE 0x71C0C TKW_VV_VV_UB 100.0 FORMULA_0003 0.0 255.0 /end CHARACTERISTIC
/begin CHARACTERISTIC K_ED_LSHNK2_R.INC_NACH_EINTRAG "Filtererhoehung nach Fehlerspeichereintrag" VALUE 0x71C10 TKW_VV_VV_UB 100.0 FORMULA_0003 0.0 255.0 /end CHARACTERISTIC
/begin CHARACTERISTIC K_ED_LSHNK2_R.INC_VOR_EINTRAG "Filtererhoehung vorm Fehlerspeichereintrag" VALUE 0x71C0E TKW_VV_VV_UB 100.0 FORMULA_0003 0.0 255.0 /end CHARACTERISTIC
/begin CHARACTERISTIC K_ED_LSHNK2_R.KLASSENINDEX "Auswahl der Fehlerklasse" VALUE 0x71C12 TKW_VV_VV_UB 100.0 FORMULA_0003 0.0 8.0 /end CHARACTERISTIC
/begin CHARACTERISTIC K_ED_LSHNK2_R.OK_SCHWELLE "Filterschwelle fuer Fehleraustrag" VALUE 0x71C0D TKW_VV_VV_UB 100.0 FORMULA_0003 0.0 255.0 /end CHARACTERISTIC
/begin CHARACTERISTIC K_ED_LSHNK2_R.P_CODE_OPENLOAD "P-Code fuer die Art OPENLOAD" VALUE 0x71C08 TKW_VV_VV_UW 100.0 FORMULA_0010 0.0 65535.0 /end CHARACTERISTIC
/begin CHARACTERISTIC K_ED_LSHNK2_R.P_CODE_SH_TO_GND "P-Code fuer die Art SH_TO_GND" VALUE 0x71C06 TKW_VV_VV_UW 100.0 FORMULA_0010 0.0 65535.0 /end CHARACTERISTIC
/begin CHARACTERISTIC K_ED_LSHNK2_R.P_CODE_SH_TO_UB "P-Code fuer die Art SH_TO_UB" VALUE 0x71C04 TKW_VV_VV_UW 100.0 FORMULA_0010 0.0 65535.0 /end CHARACTERISTIC
/begin CHARACTERISTIC K_ED_LSHNK2_R.P_CODE_UNPLAUSIBEL "P-Code fuer die Art UNPLAUSIBEL" VALUE 0x71C0A TKW_VV_VV_UW 100.0 FORMULA_0010 0.0 65535.0 /end CHARACTERISTIC
/begin CHARACTERISTIC K_ED_LSHVK1.DEC_NACH_EINTRAG "Filterverringerung nach Fehlerspeichereintrag" VALUE 0x70D8B TKW_VV_VV_UB 100.0 FORMULA_0003 0.0 255.0 /end CHARACTERISTIC
/begin CHARACTERISTIC K_ED_LSHVK1.DEC_VOR_EINTRAG "Filterverringerung vorm Fehlerspeichereintrag" VALUE 0x70D89 TKW_VV_VV_UB 100.0 FORMULA_0003 0.0 255.0 /end CHARACTERISTIC
/begin CHARACTERISTIC K_ED_LSHVK1.FEHLERSCHWELLE "Filterschwelle fuer Fehlereintrag" VALUE 0x70D86 TKW_VV_VV_UB 100.0 FORMULA_0003 0.0 255.0 /end CHARACTERISTIC
/begin CHARACTERISTIC K_ED_LSHVK1.INC_NACH_EINTRAG "Filtererhoehung nach Fehlerspeichereintrag" VALUE 0x70D8A TKW_VV_VV_UB 100.0 FORMULA_0003 0.0 255.0 /end CHARACTERISTIC
/begin CHARACTERISTIC K_ED_LSHVK1.INC_VOR_EINTRAG "Filtererhoehung vorm Fehlerspeichereintrag" VALUE 0x70D88 TKW_VV_VV_UB 100.0 FORMULA_0003 0.0 255.0 /end CHARACTERISTIC
/begin CHARACTERISTIC K_ED_LSHVK1.KLASSENINDEX "Auswahl der Fehlerklasse" VALUE 0x70D8C TKW_VV_VV_UB 100.0 FORMULA_0003 0.0 8.0 /end CHARACTERISTIC
/begin CHARACTERISTIC K_ED_LSHVK1.OK_SCHWELLE "Filterschwelle fuer Fehleraustrag" VALUE 0x70D87 TKW_VV_VV_UB 100.0 FORMULA_0003 0.0 255.0 /end CHARACTERISTIC
/begin CHARACTERISTIC K_ED_LSHVK1.P_CODE_OPENLOAD "P-Code fuer die Art OPENLOAD" VALUE 0x70D82 TKW_VV_VV_UW 100.0 FORMULA_0010 0.0 65535.0 /end CHARACTERISTIC
/begin CHARACTERISTIC K_ED_LSHVK1.P_CODE_SH_TO_GND "P-Code fuer die Art SH_TO_GND" VALUE 0x70D80 TKW_VV_VV_UW 100.0 FORMULA_0010 0.0 65535.0 /end CHARACTERISTIC
/begin CHARACTERISTIC K_ED_LSHVK1.P_CODE_SH_TO_UB "P-Code fuer die Art SH_TO_UB" VALUE 0x70D7E TKW_VV_VV_UW 100.0 FORMULA_0010 0.0 65535.0 /end CHARACTERISTIC
/begin CHARACTERISTIC K_ED_LSHVK1.P_CODE_UNPLAUSIBEL "P-Code fuer die Art UNPLAUSIBEL" VALUE 0x70D84 TKW_VV_VV_UW 100.0 FORMULA_0010 0.0 65535.0 /end CHARACTERISTIC
/begin CHARACTERISTIC K_ED_LSHVK1_R.DEC_NACH_EINTRAG "Filterverringerung nach Fehlerspeichereintrag" VALUE 0x70DF3 TKW_VV_VV_UB 100.0 FORMULA_0003 0.0 255.0 /end CHARACTERISTIC
/begin CHARACTERISTIC K_ED_LSHVK1_R.DEC_VOR_EINTRAG "Filterverringerung vorm Fehlerspeichereintrag" VALUE 0x70DF1 TKW_VV_VV_UB 100.0 FORMULA_0003 0.0 255.0 /end CHARACTERISTIC
/begin CHARACTERISTIC K_ED_LSHVK1_R.FEHLERSCHWELLE "Filterschwelle fuer Fehlereintrag" VALUE 0x70DEE TKW_VV_VV_UB 100.0 FORMULA_0003 0.0 255.0 /end CHARACTERISTIC
/begin CHARACTERISTIC K_ED_LSHVK1_R.INC_NACH_EINTRAG "Filtererhoehung nach Fehlerspeichereintrag" VALUE 0x70DF2 TKW_VV_VV_UB 100.0 FORMULA_0003 0.0 255.0 /end CHARACTERISTIC
/begin CHARACTERISTIC K_ED_LSHVK1_R.INC_VOR_EINTRAG "Filtererhoehung vorm Fehlerspeichereintrag" VALUE 0x70DF0 TKW_VV_VV_UB 100.0 FORMULA_0003 0.0 255.0 /end CHARACTERISTIC
/begin CHARACTERISTIC K_ED_LSHVK1_R.KLASSENINDEX "Auswahl der Fehlerklasse" VALUE 0x70DF4 TKW_VV_VV_UB 100.0 FORMULA_0003 0.0 8.0 /end CHARACTERISTIC
/begin CHARACTERISTIC K_ED_LSHVK1_R.OK_SCHWELLE "Filterschwelle fuer Fehleraustrag" VALUE 0x70DEF TKW_VV_VV_UB 100.0 FORMULA_0003 0.0 255.0 /end CHARACTERISTIC
/begin CHARACTERISTIC K_ED_LSHVK1_R.P_CODE_OPENLOAD "P-Code fuer die Art OPENLOAD" VALUE 0x70DEA TKW_VV_VV_UW 100.0 FORMULA_0010 0.0 65535.0 /end CHARACTERISTIC
/begin CHARACTERISTIC K_ED_LSHVK1_R.P_CODE_SH_TO_GND "P-Code fuer die Art SH_TO_GND" VALUE 0x70DE8 TKW_VV_VV_UW 100.0 FORMULA_0010 0.0 65535.0 /end CHARACTERISTIC
/begin CHARACTERISTIC K_ED_LSHVK1_R.P_CODE_SH_TO_UB "P-Code fuer die Art SH_TO_UB" VALUE 0x70DE6 TKW_VV_VV_UW 100.0 FORMULA_0010 0.0 65535.0 /end CHARACTERISTIC
/begin CHARACTERISTIC K_ED_LSHVK1_R.P_CODE_UNPLAUSIBEL "P-Code fuer die Art UNPLAUSIBEL" VALUE 0x70DEC TKW_VV_VV_UW 100.0 FORMULA_0010 0.0 65535.0 /end CHARACTERISTIC
/begin CHARACTERISTIC K_ED_LSHVK2.DEC_NACH_EINTRAG "Filterverringerung nach Fehlerspeichereintrag" VALUE 0x70DA5 TKW_VV_VV_UB 100.0 FORMULA_0003 0.0 255.0 /end CHARACTERISTIC
/begin CHARACTERISTIC K_ED_LSHVK2.DEC_VOR_EINTRAG "Filterverringerung vorm Fehlerspeichereintrag" VALUE 0x70DA3 TKW_VV_VV_UB 100.0 FORMULA_0003 0.0 255.0 /end CHARACTERISTIC
/begin CHARACTERISTIC K_ED_LSHVK2.FEHLERSCHWELLE "Filterschwelle fuer Fehlereintrag" VALUE 0x70DA0 TKW_VV_VV_UB 100.0 FORMULA_0003 0.0 255.0 /end CHARACTERISTIC
/begin CHARACTERISTIC K_ED_LSHVK2.INC_NACH_EINTRAG "Filtererhoehung nach Fehlerspeichereintrag" VALUE 0x70DA4 TKW_VV_VV_UB 100.0 FORMULA_0003 0.0 255.0 /end CHARACTERISTIC
/begin CHARACTERISTIC K_ED_LSHVK2.INC_VOR_EINTRAG "Filtererhoehung vorm Fehlerspeichereintrag" VALUE 0x70DA2 TKW_VV_VV_UB 100.0 FORMULA_0003 0.0 255.0 /end CHARACTERISTIC
/begin CHARACTERISTIC K_ED_LSHVK2.KLASSENINDEX "Auswahl der Fehlerklasse" VALUE 0x70DA6 TKW_VV_VV_UB 100.0 FORMULA_0003 0.0 8.0 /end CHARACTERISTIC
/begin CHARACTERISTIC K_ED_LSHVK2.OK_SCHWELLE "Filterschwelle fuer Fehleraustrag" VALUE 0x70DA1 TKW_VV_VV_UB 100.0 FORMULA_0003 0.0 255.0 /end CHARACTERISTIC
/begin CHARACTERISTIC K_ED_LSHVK2.P_CODE_OPENLOAD "P-Code fuer die Art OPENLOAD" VALUE 0x70D9C TKW_VV_VV_UW 100.0 FORMULA_0010 0.0 65535.0 /end CHARACTERISTIC
/begin CHARACTERISTIC K_ED_LSHVK2.P_CODE_SH_TO_GND "P-Code fuer die Art SH_TO_GND" VALUE 0x70D9A TKW_VV_VV_UW 100.0 FORMULA_0010 0.0 65535.0 /end CHARACTERISTIC
/begin CHARACTERISTIC K_ED_LSHVK2.P_CODE_SH_TO_UB "P-Code fuer die Art SH_TO_UB" VALUE 0x70D98 TKW_VV_VV_UW 100.0 FORMULA_0010 0.0 65535.0 /end CHARACTERISTIC
/begin CHARACTERISTIC K_ED_LSHVK2.P_CODE_UNPLAUSIBEL "P-Code fuer die Art UNPLAUSIBEL" VALUE 0x70D9E TKW_VV_VV_UW 100.0 FORMULA_0010 0.0 65535.0 /end CHARACTERISTIC
/begin CHARACTERISTIC K_ED_LSHVK2_R.DEC_NACH_EINTRAG "Filterverringerung nach Fehlerspeichereintrag" VALUE 0x70E0D TKW_VV_VV_UB 100.0 FORMULA_0003 0.0 255.0 /end CHARACTERISTIC
/begin CHARACTERISTIC K_ED_LSHVK2_R.DEC_VOR_EINTRAG "Filterverringerung vorm Fehlerspeichereintrag" VALUE 0x70E0B TKW_VV_VV_UB 100.0 FORMULA_0003 0.0 255.0 /end CHARACTERISTIC
/begin CHARACTERISTIC K_ED_LSHVK2_R.FEHLERSCHWELLE "Filterschwelle fuer Fehlereintrag" VALUE 0x70E08 TKW_VV_VV_UB 100.0 FORMULA_0003 0.0 255.0 /end CHARACTERISTIC
/begin CHARACTERISTIC K_ED_LSHVK2_R.INC_NACH_EINTRAG "Filtererhoehung nach Fehlerspeichereintrag" VALUE 0x70E0C TKW_VV_VV_UB 100.0 FORMULA_0003 0.0 255.0 /end CHARACTERISTIC
/begin CHARACTERISTIC K_ED_LSHVK2_R.INC_VOR_EINTRAG "Filtererhoehung vorm Fehlerspeichereintrag" VALUE 0x70E0A TKW_VV_VV_UB 100.0 FORMULA_0003 0.0 255.0 /end CHARACTERISTIC
/begin CHARACTERISTIC K_ED_LSHVK2_R.KLASSENINDEX "Auswahl der Fehlerklasse" VALUE 0x70E0E TKW_VV_VV_UB 100.0 FORMULA_0003 0.0 8.0 /end CHARACTERISTIC
/begin CHARACTERISTIC K_ED_LSHVK2_R.OK_SCHWELLE "Filterschwelle fuer Fehleraustrag" VALUE 0x70E09 TKW_VV_VV_UB 100.0 FORMULA_0003 0.0 255.0 /end CHARACTERISTIC
/begin CHARACTERISTIC K_ED_LSHVK2_R.P_CODE_OPENLOAD "P-Code fuer die Art OPENLOAD" VALUE 0x70E04 TKW_VV_VV_UW 100.0 FORMULA_0010 0.0 65535.0 /end CHARACTERISTIC
/begin CHARACTERISTIC K_ED_LSHVK2_R.P_CODE_SH_TO_GND "P-Code fuer die Art SH_TO_GND" VALUE 0x70E02 TKW_VV_VV_UW 100.0 FORMULA_0010 0.0 65535.0 /end CHARACTERISTIC
/begin CHARACTERISTIC K_ED_LSHVK2_R.P_CODE_SH_TO_UB "P-Code fuer die Art SH_TO_UB" VALUE 0x70E00 TKW_VV_VV_UW 100.0 FORMULA_0010 0.0 65535.0 /end CHARACTERISTIC
/begin CHARACTERISTIC K_ED_LSHVK2_R.P_CODE_UNPLAUSIBEL "P-Code fuer die Art UNPLAUSIBEL" VALUE 0x70E06 TKW_VV_VV_UW 100.0 FORMULA_0010 0.0 65535.0 /end CHARACTERISTIC
/begin CHARACTERISTIC K_ED_LSRVK1_OBD_REF.DEC_NACH_EINTRAG "Filterverringerung nach Fehlerspeichereintrag" VALUE 0x70E5B TKW_VV_VV_UB 100.0 FORMULA_0003 0.0 255.0 /end CHARACTERISTIC
/begin CHARACTERISTIC K_ED_LSRVK1_OBD_REF.DEC_VOR_EINTRAG "Filterverringerung vorm Fehlerspeichereintrag" VALUE 0x70E59 TKW_VV_VV_UB 100.0 FORMULA_0003 0.0 255.0 /end CHARACTERISTIC
/begin CHARACTERISTIC K_ED_LSRVK1_OBD_REF.FEHLERSCHWELLE "Filterschwelle fuer Fehlereintrag" VALUE 0x70E56 TKW_VV_VV_UB 100.0 FORMULA_0003 0.0 255.0 /end CHARACTERISTIC
/begin CHARACTERISTIC K_ED_LSRVK1_OBD_REF.INC_NACH_EINTRAG "Filtererhoehung nach Fehlerspeichereintrag" VALUE 0x70E5A TKW_VV_VV_UB 100.0 FORMULA_0003 0.0 255.0 /end CHARACTERISTIC
/begin CHARACTERISTIC K_ED_LSRVK1_OBD_REF.INC_VOR_EINTRAG "Filtererhoehung vorm Fehlerspeichereintrag" VALUE 0x70E58 TKW_VV_VV_UB 100.0 FORMULA_0003 0.0 255.0 /end CHARACTERISTIC
/begin CHARACTERISTIC K_ED_LSRVK1_OBD_REF.KLASSENINDEX "Auswahl der Fehlerklasse" VALUE 0x70E5C TKW_VV_VV_UB 100.0 FORMULA_0003 0.0 8.0 /end CHARACTERISTIC
/begin CHARACTERISTIC K_ED_LSRVK1_OBD_REF.OK_SCHWELLE "Filterschwelle fuer Fehleraustrag" VALUE 0x70E57 TKW_VV_VV_UB 100.0 FORMULA_0003 0.0 255.0 /end CHARACTERISTIC
/begin CHARACTERISTIC K_ED_LSRVK1_OBD_REF.P_CODE_OPENLOAD "P-Code fuer die Art OPENLOAD" VALUE 0x70E52 TKW_VV_VV_UW 100.0 FORMULA_0010 0.0 65535.0 /end CHARACTERISTIC
/begin CHARACTERISTIC K_ED_LSRVK1_OBD_REF.P_CODE_SH_TO_GND "P-Code fuer die Art SH_TO_GND" VALUE 0x70E50 TKW_VV_VV_UW 100.0 FORMULA_0010 0.0 65535.0 /end CHARACTERISTIC
/begin CHARACTERISTIC K_ED_LSRVK1_OBD_REF.P_CODE_SH_TO_UB "P-Code fuer die Art SH_TO_UB" VALUE 0x70E4E TKW_VV_VV_UW 100.0 FORMULA_0010 0.0 65535.0 /end CHARACTERISTIC
/begin CHARACTERISTIC K_ED_LSRVK1_OBD_REF.P_CODE_UNPLAUSIBEL "P-Code fuer die Art UNPLAUSIBEL" VALUE 0x70E54 TKW_VV_VV_UW 100.0 FORMULA_0010 0.0 65535.0 /end CHARACTERISTIC
/begin CHARACTERISTIC K_ED_LSRVK1_OBD_REG.DEC_NACH_EINTRAG "Filterverringerung nach Fehlerspeichereintrag" VALUE 0x70DBF TKW_VV_VV_UB 100.0 FORMULA_0003 0.0 255.0 /end CHARACTERISTIC
/begin CHARACTERISTIC K_ED_LSRVK1_OBD_REG.DEC_VOR_EINTRAG "Filterverringerung vorm Fehlerspeichereintrag" VALUE 0x70DBD TKW_VV_VV_UB 100.0 FORMULA_0003 0.0 255.0 /end CHARACTERISTIC
/begin CHARACTERISTIC K_ED_LSRVK1_OBD_REG.FEHLERSCHWELLE "Filterschwelle fuer Fehlereintrag" VALUE 0x70DBA TKW_VV_VV_UB 100.0 FORMULA_0003 0.0 255.0 /end CHARACTERISTIC
/begin CHARACTERISTIC K_ED_LSRVK1_OBD_REG.INC_NACH_EINTRAG "Filtererhoehung nach Fehlerspeichereintrag" VALUE 0x70DBE TKW_VV_VV_UB 100.0 FORMULA_0003 0.0 255.0 /end CHARACTERISTIC
/begin CHARACTERISTIC K_ED_LSRVK1_OBD_REG.INC_VOR_EINTRAG "Filtererhoehung vorm Fehlerspeichereintrag" VALUE 0x70DBC TKW_VV_VV_UB 100.0 FORMULA_0003 0.0 255.0 /end CHARACTERISTIC
/begin CHARACTERISTIC K_ED_LSRVK1_OBD_REG.KLASSENINDEX "Auswahl der Fehlerklasse" VALUE 0x70DC0 TKW_VV_VV_UB 100.0 FORMULA_0003 0.0 8.0 /end CHARACTERISTIC
/begin CHARACTERISTIC K_ED_LSRVK1_OBD_REG.OK_SCHWELLE "Filterschwelle fuer Fehleraustrag" VALUE 0x70DBB TKW_VV_VV_UB 100.0 FORMULA_0003 0.0 255.0 /end CHARACTERISTIC
/begin CHARACTERISTIC K_ED_LSRVK1_OBD_REG.P_CODE_OPENLOAD "P-Code fuer die Art OPENLOAD" VALUE 0x70DB6 TKW_VV_VV_UW 100.0 FORMULA_0010 0.0 65535.0 /end CHARACTERISTIC
/begin CHARACTERISTIC K_ED_LSRVK1_OBD_REG.P_CODE_SH_TO_GND "P-Code fuer die Art SH_TO_GND" VALUE 0x70DB4 TKW_VV_VV_UW 100.0 FORMULA_0010 0.0 65535.0 /end CHARACTERISTIC
/begin CHARACTERISTIC K_ED_LSRVK1_OBD_REG.P_CODE_SH_TO_UB "P-Code fuer die Art SH_TO_UB" VALUE 0x70DB2 TKW_VV_VV_UW 100.0 FORMULA_0010 0.0 65535.0 /end CHARACTERISTIC
/begin CHARACTERISTIC K_ED_LSRVK1_OBD_REG.P_CODE_UNPLAUSIBEL "P-Code fuer die Art UNPLAUSIBEL" VALUE 0x70DB8 TKW_VV_VV_UW 100.0 FORMULA_0010 0.0 65535.0 /end CHARACTERISTIC
/begin CHARACTERISTIC K_ED_LSRVK1_OBD_START.DEC_NACH_EINTRAG "Filterverringerung nach Fehlerspeichereintrag" VALUE 0x70E27 TKW_VV_VV_UB 100.0 FORMULA_0003 0.0 255.0 /end CHARACTERISTIC
/begin CHARACTERISTIC K_ED_LSRVK1_OBD_START.DEC_VOR_EINTRAG "Filterverringerung vorm Fehlerspeichereintrag" VALUE 0x70E25 TKW_VV_VV_UB 100.0 FORMULA_0003 0.0 255.0 /end CHARACTERISTIC
/begin CHARACTERISTIC K_ED_LSRVK1_OBD_START.FEHLERSCHWELLE "Filterschwelle fuer Fehlereintrag" VALUE 0x70E22 TKW_VV_VV_UB 100.0 FORMULA_0003 0.0 255.0 /end CHARACTERISTIC
/begin CHARACTERISTIC K_ED_LSRVK1_OBD_START.INC_NACH_EINTRAG "Filtererhoehung nach Fehlerspeichereintrag" VALUE 0x70E26 TKW_VV_VV_UB 100.0 FORMULA_0003 0.0 255.0 /end CHARACTERISTIC
/begin CHARACTERISTIC K_ED_LSRVK1_OBD_START.INC_VOR_EINTRAG "Filtererhoehung vorm Fehlerspeichereintrag" VALUE 0x70E24 TKW_VV_VV_UB 100.0 FORMULA_0003 0.0 255.0 /end CHARACTERISTIC
/begin CHARACTERISTIC K_ED_LSRVK1_OBD_START.KLASSENINDEX "Auswahl der Fehlerklasse" VALUE 0x70E28 TKW_VV_VV_UB 100.0 FORMULA_0003 0.0 8.0 /end CHARACTERISTIC
/begin CHARACTERISTIC K_ED_LSRVK1_OBD_START.OK_SCHWELLE "Filterschwelle fuer Fehleraustrag" VALUE 0x70E23 TKW_VV_VV_UB 100.0 FORMULA_0003 0.0 255.0 /end CHARACTERISTIC
/begin CHARACTERISTIC K_ED_LSRVK1_OBD_START.P_CODE_OPENLOAD "P-Code fuer die Art OPENLOAD" VALUE 0x70E1E TKW_VV_VV_UW 100.0 FORMULA_0010 0.0 65535.0 /end CHARACTERISTIC
/begin CHARACTERISTIC K_ED_LSRVK1_OBD_START.P_CODE_SH_TO_GND "P-Code fuer die Art SH_TO_GND" VALUE 0x70E1C TKW_VV_VV_UW 100.0 FORMULA_0010 0.0 65535.0 /end CHARACTERISTIC
/begin CHARACTERISTIC K_ED_LSRVK1_OBD_START.P_CODE_SH_TO_UB "P-Code fuer die Art SH_TO_UB" VALUE 0x70E1A TKW_VV_VV_UW 100.0 FORMULA_0010 0.0 65535.0 /end CHARACTERISTIC
/begin CHARACTERISTIC K_ED_LSRVK1_OBD_START.P_CODE_UNPLAUSIBEL "P-Code fuer die Art UNPLAUSIBEL" VALUE 0x70E20 TKW_VV_VV_UW 100.0 FORMULA_0010 0.0 65535.0 /end CHARACTERISTIC
/begin CHARACTERISTIC K_ED_LSRVK2_OBD_REF.DEC_NACH_EINTRAG "Filterverringerung nach Fehlerspeichereintrag" VALUE 0x70E75 TKW_VV_VV_UB 100.0 FORMULA_0003 0.0 255.0 /end CHARACTERISTIC
/begin CHARACTERISTIC K_ED_LSRVK2_OBD_REF.DEC_VOR_EINTRAG "Filterverringerung vorm Fehlerspeichereintrag" VALUE 0x70E73 TKW_VV_VV_UB 100.0 FORMULA_0003 0.0 255.0 /end CHARACTERISTIC
/begin CHARACTERISTIC K_ED_LSRVK2_OBD_REF.FEHLERSCHWELLE "Filterschwelle fuer Fehlereintrag" VALUE 0x70E70 TKW_VV_VV_UB 100.0 FORMULA_0003 0.0 255.0 /end CHARACTERISTIC
/begin CHARACTERISTIC K_ED_LSRVK2_OBD_REF.INC_NACH_EINTRAG "Filtererhoehung nach Fehlerspeichereintrag" VALUE 0x70E74 TKW_VV_VV_UB 100.0 FORMULA_0003 0.0 255.0 /end CHARACTERISTIC
/begin CHARACTERISTIC K_ED_LSRVK2_OBD_REF.INC_VOR_EINTRAG "Filtererhoehung vorm Fehlerspeichereintrag" VALUE 0x70E72 TKW_VV_VV_UB 100.0 FORMULA_0003 0.0 255.0 /end CHARACTERISTIC
/begin CHARACTERISTIC K_ED_LSRVK2_OBD_REF.KLASSENINDEX "Auswahl der Fehlerklasse" VALUE 0x70E76 TKW_VV_VV_UB 100.0 FORMULA_0003 0.0 8.0 /end CHARACTERISTIC
/begin CHARACTERISTIC K_ED_LSRVK2_OBD_REF.OK_SCHWELLE "Filterschwelle fuer Fehleraustrag" VALUE 0x70E71 TKW_VV_VV_UB 100.0 FORMULA_0003 0.0 255.0 /end CHARACTERISTIC
/begin CHARACTERISTIC K_ED_LSRVK2_OBD_REF.P_CODE_OPENLOAD "P-Code fuer die Art OPENLOAD" VALUE 0x70E6C TKW_VV_VV_UW 100.0 FORMULA_0010 0.0 65535.0 /end CHARACTERISTIC
/begin CHARACTERISTIC K_ED_LSRVK2_OBD_REF.P_CODE_SH_TO_GND "P-Code fuer die Art SH_TO_GND" VALUE 0x70E6A TKW_VV_VV_UW 100.0 FORMULA_0010 0.0 65535.0 /end CHARACTERISTIC
/begin CHARACTERISTIC K_ED_LSRVK2_OBD_REF.P_CODE_SH_TO_UB "P-Code fuer die Art SH_TO_UB" VALUE 0x70E68 TKW_VV_VV_UW 100.0 FORMULA_0010 0.0 65535.0 /end CHARACTERISTIC
/begin CHARACTERISTIC K_ED_LSRVK2_OBD_REF.P_CODE_UNPLAUSIBEL "P-Code fuer die Art UNPLAUSIBEL" VALUE 0x70E6E TKW_VV_VV_UW 100.0 FORMULA_0010 0.0 65535.0 /end CHARACTERISTIC
/begin CHARACTERISTIC K_ED_LSRVK2_OBD_REG.DEC_NACH_EINTRAG "Filterverringerung nach Fehlerspeichereintrag" VALUE 0x70DD9 TKW_VV_VV_UB 100.0 FORMULA_0003 0.0 255.0 /end CHARACTERISTIC
/begin CHARACTERISTIC K_ED_LSRVK2_OBD_REG.DEC_VOR_EINTRAG "Filterverringerung vorm Fehlerspeichereintrag" VALUE 0x70DD7 TKW_VV_VV_UB 100.0 FORMULA_0003 0.0 255.0 /end CHARACTERISTIC
/begin CHARACTERISTIC K_ED_LSRVK2_OBD_REG.FEHLERSCHWELLE "Filterschwelle fuer Fehlereintrag" VALUE 0x70DD4 TKW_VV_VV_UB 100.0 FORMULA_0003 0.0 255.0 /end CHARACTERISTIC
/begin CHARACTERISTIC K_ED_LSRVK2_OBD_REG.INC_NACH_EINTRAG "Filtererhoehung nach Fehlerspeichereintrag" VALUE 0x70DD8 TKW_VV_VV_UB 100.0 FORMULA_0003 0.0 255.0 /end CHARACTERISTIC
/begin CHARACTERISTIC K_ED_LSRVK2_OBD_REG.INC_VOR_EINTRAG "Filtererhoehung vorm Fehlerspeichereintrag" VALUE 0x70DD6 TKW_VV_VV_UB 100.0 FORMULA_0003 0.0 255.0 /end CHARACTERISTIC
/begin CHARACTERISTIC K_ED_LSRVK2_OBD_REG.KLASSENINDEX "Auswahl der Fehlerklasse" VALUE 0x70DDA TKW_VV_VV_UB 100.0 FORMULA_0003 0.0 8.0 /end CHARACTERISTIC
/begin CHARACTERISTIC K_ED_LSRVK2_OBD_REG.OK_SCHWELLE "Filterschwelle fuer Fehleraustrag" VALUE 0x70DD5 TKW_VV_VV_UB 100.0 FORMULA_0003 0.0 255.0 /end CHARACTERISTIC
/begin CHARACTERISTIC K_ED_LSRVK2_OBD_REG.P_CODE_OPENLOAD "P-Code fuer die Art OPENLOAD" VALUE 0x70DD0 TKW_VV_VV_UW 100.0 FORMULA_0010 0.0 65535.0 /end CHARACTERISTIC
/begin CHARACTERISTIC K_ED_LSRVK2_OBD_REG.P_CODE_SH_TO_GND "P-Code fuer die Art SH_TO_GND" VALUE 0x70DCE TKW_VV_VV_UW 100.0 FORMULA_0010 0.0 65535.0 /end CHARACTERISTIC
/begin CHARACTERISTIC K_ED_LSRVK2_OBD_REG.P_CODE_SH_TO_UB "P-Code fuer die Art SH_TO_UB" VALUE 0x70DCC TKW_VV_VV_UW 100.0 FORMULA_0010 0.0 65535.0 /end CHARACTERISTIC
/begin CHARACTERISTIC K_ED_LSRVK2_OBD_REG.P_CODE_UNPLAUSIBEL "P-Code fuer die Art UNPLAUSIBEL" VALUE 0x70DD2 TKW_VV_VV_UW 100.0 FORMULA_0010 0.0 65535.0 /end CHARACTERISTIC
/begin CHARACTERISTIC K_ED_LSRVK2_OBD_START.DEC_NACH_EINTRAG "Filterverringerung nach Fehlerspeichereintrag" VALUE 0x70E41 TKW_VV_VV_UB 100.0 FORMULA_0003 0.0 255.0 /end CHARACTERISTIC
/begin CHARACTERISTIC K_ED_LSRVK2_OBD_START.DEC_VOR_EINTRAG "Filterverringerung vorm Fehlerspeichereintrag" VALUE 0x70E3F TKW_VV_VV_UB 100.0 FORMULA_0003 0.0 255.0 /end CHARACTERISTIC
/begin CHARACTERISTIC K_ED_LSRVK2_OBD_START.FEHLERSCHWELLE "Filterschwelle fuer Fehlereintrag" VALUE 0x70E3C TKW_VV_VV_UB 100.0 FORMULA_0003 0.0 255.0 /end CHARACTERISTIC
/begin CHARACTERISTIC K_ED_LSRVK2_OBD_START.INC_NACH_EINTRAG "Filtererhoehung nach Fehlerspeichereintrag" VALUE 0x70E40 TKW_VV_VV_UB 100.0 FORMULA_0003 0.0 255.0 /end CHARACTERISTIC
/begin CHARACTERISTIC K_ED_LSRVK2_OBD_START.INC_VOR_EINTRAG "Filtererhoehung vorm Fehlerspeichereintrag" VALUE 0x70E3E TKW_VV_VV_UB 100.0 FORMULA_0003 0.0 255.0 /end CHARACTERISTIC
/begin CHARACTERISTIC K_ED_LSRVK2_OBD_START.KLASSENINDEX "Auswahl der Fehlerklasse" VALUE 0x70E42 TKW_VV_VV_UB 100.0 FORMULA_0003 0.0 8.0 /end CHARACTERISTIC
/begin CHARACTERISTIC K_ED_LSRVK2_OBD_START.OK_SCHWELLE "Filterschwelle fuer Fehleraustrag" VALUE 0x70E3D TKW_VV_VV_UB 100.0 FORMULA_0003 0.0 255.0 /end CHARACTERISTIC
/begin CHARACTERISTIC K_ED_LSRVK2_OBD_START.P_CODE_OPENLOAD "P-Code fuer die Art OPENLOAD" VALUE 0x70E38 TKW_VV_VV_UW 100.0 FORMULA_0010 0.0 65535.0 /end CHARACTERISTIC
/begin CHARACTERISTIC K_ED_LSRVK2_OBD_START.P_CODE_SH_TO_GND "P-Code fuer die Art SH_TO_GND" VALUE 0x70E36 TKW_VV_VV_UW 100.0 FORMULA_0010 0.0 65535.0 /end CHARACTERISTIC
/begin CHARACTERISTIC K_ED_LSRVK2_OBD_START.P_CODE_SH_TO_UB "P-Code fuer die Art SH_TO_UB" VALUE 0x70E34 TKW_VV_VV_UW 100.0 FORMULA_0010 0.0 65535.0 /end CHARACTERISTIC
/begin CHARACTERISTIC K_ED_LSRVK2_OBD_START.P_CODE_UNPLAUSIBEL "P-Code fuer die Art UNPLAUSIBEL" VALUE 0x70E3A TKW_VV_VV_UW 100.0 FORMULA_0010 0.0 65535.0 /end CHARACTERISTIC
/begin CHARACTERISTIC K_ED_MIL_MASKE "Auswahl wer Mil ansteuert" VALUE 0x71F90 TKW_VV_VV_UB 100.0 FORMULA_0662 0.0 255.0 /end CHARACTERISTIC
/begin CHARACTERISTIC K_ED_MVAC_DRUCKSENSOR.DEC_NACH_EINTRAG "Filterverringerung nach Fehlerspeichereintrag" VALUE 0x71647 TKW_VV_VV_UB 100.0 FORMULA_0003 0.0 255.0 /end CHARACTERISTIC
/begin CHARACTERISTIC K_ED_MVAC_DRUCKSENSOR.DEC_VOR_EINTRAG "Filterverringerung vorm Fehlerspeichereintrag" VALUE 0x71645 TKW_VV_VV_UB 100.0 FORMULA_0003 0.0 255.0 /end CHARACTERISTIC
/begin CHARACTERISTIC K_ED_MVAC_DRUCKSENSOR.FEHLERSCHWELLE "Filterschwelle fuer Fehlereintrag" VALUE 0x71642 TKW_VV_VV_UB 100.0 FORMULA_0003 0.0 255.0 /end CHARACTERISTIC
/begin CHARACTERISTIC K_ED_MVAC_DRUCKSENSOR.INC_NACH_EINTRAG "Filtererhoehung nach Fehlerspeichereintrag" VALUE 0x71646 TKW_VV_VV_UB 100.0 FORMULA_0003 0.0 255.0 /end CHARACTERISTIC
/begin CHARACTERISTIC K_ED_MVAC_DRUCKSENSOR.INC_VOR_EINTRAG "Filtererhoehung vorm Fehlerspeichereintrag" VALUE 0x71644 TKW_VV_VV_UB 100.0 FORMULA_0003 0.0 255.0 /end CHARACTERISTIC
/begin CHARACTERISTIC K_ED_MVAC_DRUCKSENSOR.KLASSENINDEX "Auswahl der Fehlerklasse" VALUE 0x71648 TKW_VV_VV_UB 100.0 FORMULA_0003 0.0 8.0 /end CHARACTERISTIC
/begin CHARACTERISTIC K_ED_MVAC_DRUCKSENSOR.OK_SCHWELLE "Filterschwelle fuer Fehleraustrag" VALUE 0x71643 TKW_VV_VV_UB 100.0 FORMULA_0003 0.0 255.0 /end CHARACTERISTIC
/begin CHARACTERISTIC K_ED_MVAC_DRUCKSENSOR.P_CODE_OPENLOAD "P-Code fuer die Art OPENLOAD" VALUE 0x7163E TKW_VV_VV_UW 100.0 FORMULA_0010 0.0 65535.0 /end CHARACTERISTIC
/begin CHARACTERISTIC K_ED_MVAC_DRUCKSENSOR.P_CODE_SH_TO_GND "P-Code fuer die Art SH_TO_GND" VALUE 0x7163C TKW_VV_VV_UW 100.0 FORMULA_0010 0.0 65535.0 /end CHARACTERISTIC
/begin CHARACTERISTIC K_ED_MVAC_DRUCKSENSOR.P_CODE_SH_TO_UB "P-Code fuer die Art SH_TO_UB" VALUE 0x7163A TKW_VV_VV_UW 100.0 FORMULA_0010 0.0 65535.0 /end CHARACTERISTIC
/begin CHARACTERISTIC K_ED_MVAC_DRUCKSENSOR.P_CODE_UNPLAUSIBEL "P-Code fuer die Art UNPLAUSIBEL" VALUE 0x71640 TKW_VV_VV_UW 100.0 FORMULA_0010 0.0 65535.0 /end CHARACTERISTIC
/begin CHARACTERISTIC K_ED_NW_SYNC.DEC_NACH_EINTRAG "Filterverringerung nach Fehlerspeichereintrag" VALUE 0x70A4B TKW_VV_VV_UB 100.0 FORMULA_0003 0.0 255.0 /end CHARACTERISTIC
/begin CHARACTERISTIC K_ED_NW_SYNC.DEC_VOR_EINTRAG "Filterverringerung vorm Fehlerspeichereintrag" VALUE 0x70A49 TKW_VV_VV_UB 100.0 FORMULA_0003 0.0 255.0 /end CHARACTERISTIC
/begin CHARACTERISTIC K_ED_NW_SYNC.FEHLERSCHWELLE "Filterschwelle fuer Fehlereintrag" VALUE 0x70A46 TKW_VV_VV_UB 100.0 FORMULA_0003 0.0 255.0 /end CHARACTERISTIC
/begin CHARACTERISTIC K_ED_NW_SYNC.INC_NACH_EINTRAG "Filtererhoehung nach Fehlerspeichereintrag" VALUE 0x70A4A TKW_VV_VV_UB 100.0 FORMULA_0003 0.0 255.0 /end CHARACTERISTIC
/begin CHARACTERISTIC K_ED_NW_SYNC.INC_VOR_EINTRAG "Filtererhoehung vorm Fehlerspeichereintrag" VALUE 0x70A48 TKW_VV_VV_UB 100.0 FORMULA_0003 0.0 255.0 /end CHARACTERISTIC
/begin CHARACTERISTIC K_ED_NW_SYNC.KLASSENINDEX "Auswahl der Fehlerklasse" VALUE 0x70A4C TKW_VV_VV_UB 100.0 FORMULA_0003 0.0 8.0 /end CHARACTERISTIC
/begin CHARACTERISTIC K_ED_NW_SYNC.OK_SCHWELLE "Filterschwelle fuer Fehleraustrag" VALUE 0x70A47 TKW_VV_VV_UB 100.0 FORMULA_0003 0.0 255.0 /end CHARACTERISTIC
/begin CHARACTERISTIC K_ED_NW_SYNC.P_CODE_OPENLOAD "P-Code fuer die Art OPENLOAD" VALUE 0x70A42 TKW_VV_VV_UW 100.0 FORMULA_0010 0.0 65535.0 /end CHARACTERISTIC
/begin CHARACTERISTIC K_ED_NW_SYNC.P_CODE_SH_TO_GND "P-Code fuer die Art SH_TO_GND" VALUE 0x70A40 TKW_VV_VV_UW 100.0 FORMULA_0010 0.0 65535.0 /end CHARACTERISTIC
/begin CHARACTERISTIC K_ED_NW_SYNC.P_CODE_SH_TO_UB "P-Code fuer die Art SH_TO_UB" VALUE 0x70A3E TKW_VV_VV_UW 100.0 FORMULA_0010 0.0 65535.0 /end CHARACTERISTIC
/begin CHARACTERISTIC K_ED_NW_SYNC.P_CODE_UNPLAUSIBEL "P-Code fuer die Art UNPLAUSIBEL" VALUE 0x70A44 TKW_VV_VV_UW 100.0 FORMULA_0010 0.0 65535.0 /end CHARACTERISTIC
/begin CHARACTERISTIC K_ED_PCTRL_INJ.DEC_NACH_EINTRAG "Filterverringerung nach Fehlerspeichereintrag" VALUE 0x70A7F TKW_VV_VV_UB 100.0 FORMULA_0003 0.0 255.0 /end CHARACTERISTIC
/begin CHARACTERISTIC K_ED_PCTRL_INJ.DEC_VOR_EINTRAG "Filterverringerung vorm Fehlerspeichereintrag" VALUE 0x70A7D TKW_VV_VV_UB 100.0 FORMULA_0003 0.0 255.0 /end CHARACTERISTIC
/begin CHARACTERISTIC K_ED_PCTRL_INJ.FEHLERSCHWELLE "Filterschwelle fuer Fehlereintrag" VALUE 0x70A7A TKW_VV_VV_UB 100.0 FORMULA_0003 0.0 255.0 /end CHARACTERISTIC
/begin CHARACTERISTIC K_ED_PCTRL_INJ.INC_NACH_EINTRAG "Filtererhoehung nach Fehlerspeichereintrag" VALUE 0x70A7E TKW_VV_VV_UB 100.0 FORMULA_0003 0.0 255.0 /end CHARACTERISTIC
/begin CHARACTERISTIC K_ED_PCTRL_INJ.INC_VOR_EINTRAG "Filtererhoehung vorm Fehlerspeichereintrag" VALUE 0x70A7C TKW_VV_VV_UB 100.0 FORMULA_0003 0.0 255.0 /end CHARACTERISTIC
/begin CHARACTERISTIC K_ED_PCTRL_INJ.KLASSENINDEX "Auswahl der Fehlerklasse" VALUE 0x70A80 TKW_VV_VV_UB 100.0 FORMULA_0003 0.0 8.0 /end CHARACTERISTIC
/begin CHARACTERISTIC K_ED_PCTRL_INJ.OK_SCHWELLE "Filterschwelle fuer Fehleraustrag" VALUE 0x70A7B TKW_VV_VV_UB 100.0 FORMULA_0003 0.0 255.0 /end CHARACTERISTIC
/begin CHARACTERISTIC K_ED_PCTRL_INJ.P_CODE_OPENLOAD "P-Code fuer die Art OPENLOAD" VALUE 0x70A76 TKW_VV_VV_UW 100.0 FORMULA_0010 0.0 65535.0 /end CHARACTERISTIC
/begin CHARACTERISTIC K_ED_PCTRL_INJ.P_CODE_SH_TO_GND "P-Code fuer die Art SH_TO_GND" VALUE 0x70A74 TKW_VV_VV_UW 100.0 FORMULA_0010 0.0 65535.0 /end CHARACTERISTIC
/begin CHARACTERISTIC K_ED_PCTRL_INJ.P_CODE_SH_TO_UB "P-Code fuer die Art SH_TO_UB" VALUE 0x70A72 TKW_VV_VV_UW 100.0 FORMULA_0010 0.0 65535.0 /end CHARACTERISTIC
/begin CHARACTERISTIC K_ED_PCTRL_INJ.P_CODE_UNPLAUSIBEL "P-Code fuer die Art UNPLAUSIBEL" VALUE 0x70A78 TKW_VV_VV_UW 100.0 FORMULA_0010 0.0 65535.0 /end CHARACTERISTIC
/begin CHARACTERISTIC K_ED_PKS.DEC_NACH_EINTRAG "Filterverringerung nach Fehlerspeichereintrag" VALUE 0x70AB3 TKW_VV_VV_UB 100.0 FORMULA_0003 0.0 255.0 /end CHARACTERISTIC
/begin CHARACTERISTIC K_ED_PKS.DEC_VOR_EINTRAG "Filterverringerung vorm Fehlerspeichereintrag" VALUE 0x70AB1 TKW_VV_VV_UB 100.0 FORMULA_0003 0.0 255.0 /end CHARACTERISTIC
/begin CHARACTERISTIC K_ED_PKS.FEHLERSCHWELLE "Filterschwelle fuer Fehlereintrag" VALUE 0x70AAE TKW_VV_VV_UB 100.0 FORMULA_0003 0.0 255.0 /end CHARACTERISTIC
/begin CHARACTERISTIC K_ED_PKS.INC_NACH_EINTRAG "Filtererhoehung nach Fehlerspeichereintrag" VALUE 0x70AB2 TKW_VV_VV_UB 100.0 FORMULA_0003 0.0 255.0 /end CHARACTERISTIC
/begin CHARACTERISTIC K_ED_PKS.INC_VOR_EINTRAG "Filtererhoehung vorm Fehlerspeichereintrag" VALUE 0x70AB0 TKW_VV_VV_UB 100.0 FORMULA_0003 0.0 255.0 /end CHARACTERISTIC
/begin CHARACTERISTIC K_ED_PKS.KLASSENINDEX "Auswahl der Fehlerklasse" VALUE 0x70AB4 TKW_VV_VV_UB 100.0 FORMULA_0003 0.0 8.0 /end CHARACTERISTIC
/begin CHARACTERISTIC K_ED_PKS.OK_SCHWELLE "Filterschwelle fuer Fehleraustrag" VALUE 0x70AAF TKW_VV_VV_UB 100.0 FORMULA_0003 0.0 255.0 /end CHARACTERISTIC
/begin CHARACTERISTIC K_ED_PKS.P_CODE_OPENLOAD "P-Code fuer die Art OPENLOAD" VALUE 0x70AAA TKW_VV_VV_UW 100.0 FORMULA_0010 0.0 65535.0 /end CHARACTERISTIC
/begin CHARACTERISTIC K_ED_PKS.P_CODE_SH_TO_GND "P-Code fuer die Art SH_TO_GND" VALUE 0x70AA8 TKW_VV_VV_UW 100.0 FORMULA_0010 0.0 65535.0 /end CHARACTERISTIC
/begin CHARACTERISTIC K_ED_PKS.P_CODE_SH_TO_UB "P-Code fuer die Art SH_TO_UB" VALUE 0x70AA6 TKW_VV_VV_UW 100.0 FORMULA_0010 0.0 65535.0 /end CHARACTERISTIC
/begin CHARACTERISTIC K_ED_PKS.P_CODE_UNPLAUSIBEL "P-Code fuer die Art UNPLAUSIBEL" VALUE 0x70AAC TKW_VV_VV_UW 100.0 FORMULA_0010 0.0 65535.0 /end CHARACTERISTIC
/begin CHARACTERISTIC K_ED_PKS_ADAPT_ANSCHL.DEC_NACH_EINTRAG "Filterverringerung nach Fehlerspeichereintrag" VALUE 0x71C5F TKW_VV_VV_UB 100.0 FORMULA_0003 0.0 255.0 /end CHARACTERISTIC
/begin CHARACTERISTIC K_ED_PKS_ADAPT_ANSCHL.DEC_VOR_EINTRAG "Filterverringerung vorm Fehlerspeichereintrag" VALUE 0x71C5D TKW_VV_VV_UB 100.0 FORMULA_0003 0.0 255.0 /end CHARACTERISTIC
/begin CHARACTERISTIC K_ED_PKS_ADAPT_ANSCHL.FEHLERSCHWELLE "Filterschwelle fuer Fehlereintrag" VALUE 0x71C5A TKW_VV_VV_UB 100.0 FORMULA_0003 0.0 255.0 /end CHARACTERISTIC
/begin CHARACTERISTIC K_ED_PKS_ADAPT_ANSCHL.INC_NACH_EINTRAG "Filtererhoehung nach Fehlerspeichereintrag" VALUE 0x71C5E TKW_VV_VV_UB 100.0 FORMULA_0003 0.0 255.0 /end CHARACTERISTIC
/begin CHARACTERISTIC K_ED_PKS_ADAPT_ANSCHL.INC_VOR_EINTRAG "Filtererhoehung vorm Fehlerspeichereintrag" VALUE 0x71C5C TKW_VV_VV_UB 100.0 FORMULA_0003 0.0 255.0 /end CHARACTERISTIC
/begin CHARACTERISTIC K_ED_PKS_ADAPT_ANSCHL.KLASSENINDEX "Auswahl der Fehlerklasse" VALUE 0x71C60 TKW_VV_VV_UB 100.0 FORMULA_0003 0.0 8.0 /end CHARACTERISTIC
/begin CHARACTERISTIC K_ED_PKS_ADAPT_ANSCHL.OK_SCHWELLE "Filterschwelle fuer Fehleraustrag" VALUE 0x71C5B TKW_VV_VV_UB 100.0 FORMULA_0003 0.0 255.0 /end CHARACTERISTIC
/begin CHARACTERISTIC K_ED_PKS_ADAPT_ANSCHL.P_CODE_OPENLOAD "P-Code fuer die Art OPENLOAD" VALUE 0x71C56 TKW_VV_VV_UW 100.0 FORMULA_0010 0.0 65535.0 /end CHARACTERISTIC
/begin CHARACTERISTIC K_ED_PKS_ADAPT_ANSCHL.P_CODE_SH_TO_GND "P-Code fuer die Art SH_TO_GND" VALUE 0x71C54 TKW_VV_VV_UW 100.0 FORMULA_0010 0.0 65535.0 /end CHARACTERISTIC
/begin CHARACTERISTIC K_ED_PKS_ADAPT_ANSCHL.P_CODE_SH_TO_UB "P-Code fuer die Art SH_TO_UB" VALUE 0x71C52 TKW_VV_VV_UW 100.0 FORMULA_0010 0.0 65535.0 /end CHARACTERISTIC
/begin CHARACTERISTIC K_ED_PKS_ADAPT_ANSCHL.P_CODE_UNPLAUSIBEL "P-Code fuer die Art UNPLAUSIBEL" VALUE 0x71C58 TKW_VV_VV_UW 100.0 FORMULA_0010 0.0 65535.0 /end CHARACTERISTIC
/begin CHARACTERISTIC K_ED_PKS_LL.DEC_NACH_EINTRAG "Filterverringerung nach Fehlerspeichereintrag" VALUE 0x714DB TKW_VV_VV_UB 100.0 FORMULA_0003 0.0 255.0 /end CHARACTERISTIC
/begin CHARACTERISTIC K_ED_PKS_LL.DEC_VOR_EINTRAG "Filterverringerung vorm Fehlerspeichereintrag" VALUE 0x714D9 TKW_VV_VV_UB 100.0 FORMULA_0003 0.0 255.0 /end CHARACTERISTIC
/begin CHARACTERISTIC K_ED_PKS_LL.FEHLERSCHWELLE "Filterschwelle fuer Fehlereintrag" VALUE 0x714D6 TKW_VV_VV_UB 100.0 FORMULA_0003 0.0 255.0 /end CHARACTERISTIC
/begin CHARACTERISTIC K_ED_PKS_LL.INC_NACH_EINTRAG "Filtererhoehung nach Fehlerspeichereintrag" VALUE 0x714DA TKW_VV_VV_UB 100.0 FORMULA_0003 0.0 255.0 /end CHARACTERISTIC
/begin CHARACTERISTIC K_ED_PKS_LL.INC_VOR_EINTRAG "Filtererhoehung vorm Fehlerspeichereintrag" VALUE 0x714D8 TKW_VV_VV_UB 100.0 FORMULA_0003 0.0 255.0 /end CHARACTERISTIC
/begin CHARACTERISTIC K_ED_PKS_LL.KLASSENINDEX "Auswahl der Fehlerklasse" VALUE 0x714DC TKW_VV_VV_UB 100.0 FORMULA_0003 0.0 8.0 /end CHARACTERISTIC
/begin CHARACTERISTIC K_ED_PKS_LL.OK_SCHWELLE "Filterschwelle fuer Fehleraustrag" VALUE 0x714D7 TKW_VV_VV_UB 100.0 FORMULA_0003 0.0 255.0 /end CHARACTERISTIC
/begin CHARACTERISTIC K_ED_PKS_LL.P_CODE_OPENLOAD "P-Code fuer die Art OPENLOAD" VALUE 0x714D2 TKW_VV_VV_UW 100.0 FORMULA_0010 0.0 65535.0 /end CHARACTERISTIC
/begin CHARACTERISTIC K_ED_PKS_LL.P_CODE_SH_TO_GND "P-Code fuer die Art SH_TO_GND" VALUE 0x714D0 TKW_VV_VV_UW 100.0 FORMULA_0010 0.0 65535.0 /end CHARACTERISTIC
/begin CHARACTERISTIC K_ED_PKS_LL.P_CODE_SH_TO_UB "P-Code fuer die Art SH_TO_UB" VALUE 0x714CE TKW_VV_VV_UW 100.0 FORMULA_0010 0.0 65535.0 /end CHARACTERISTIC
/begin CHARACTERISTIC K_ED_PKS_LL.P_CODE_UNPLAUSIBEL "P-Code fuer die Art UNPLAUSIBEL" VALUE 0x714D4 TKW_VV_VV_UW 100.0 FORMULA_0010 0.0 65535.0 /end CHARACTERISTIC
/begin CHARACTERISTIC K_ED_PKS_MODELL.DEC_NACH_EINTRAG "Filterverringerung nach Fehlerspeichereintrag" VALUE 0x71C2B TKW_VV_VV_UB 100.0 FORMULA_0003 0.0 255.0 /end CHARACTERISTIC
/begin CHARACTERISTIC K_ED_PKS_MODELL.DEC_VOR_EINTRAG "Filterverringerung vorm Fehlerspeichereintrag" VALUE 0x71C29 TKW_VV_VV_UB 100.0 FORMULA_0003 0.0 255.0 /end CHARACTERISTIC
/begin CHARACTERISTIC K_ED_PKS_MODELL.FEHLERSCHWELLE "Filterschwelle fuer Fehlereintrag" VALUE 0x71C26 TKW_VV_VV_UB 100.0 FORMULA_0003 0.0 255.0 /end CHARACTERISTIC
/begin CHARACTERISTIC K_ED_PKS_MODELL.INC_NACH_EINTRAG "Filtererhoehung nach Fehlerspeichereintrag" VALUE 0x71C2A TKW_VV_VV_UB 100.0 FORMULA_0003 0.0 255.0 /end CHARACTERISTIC
/begin CHARACTERISTIC K_ED_PKS_MODELL.INC_VOR_EINTRAG "Filtererhoehung vorm Fehlerspeichereintrag" VALUE 0x71C28 TKW_VV_VV_UB 100.0 FORMULA_0003 0.0 255.0 /end CHARACTERISTIC
/begin CHARACTERISTIC K_ED_PKS_MODELL.KLASSENINDEX "Auswahl der Fehlerklasse" VALUE 0x71C2C TKW_VV_VV_UB 100.0 FORMULA_0003 0.0 8.0 /end CHARACTERISTIC
/begin CHARACTERISTIC K_ED_PKS_MODELL.OK_SCHWELLE "Filterschwelle fuer Fehleraustrag" VALUE 0x71C27 TKW_VV_VV_UB 100.0 FORMULA_0003 0.0 255.0 /end CHARACTERISTIC
/begin CHARACTERISTIC K_ED_PKS_MODELL.P_CODE_OPENLOAD "P-Code fuer die Art OPENLOAD" VALUE 0x71C22 TKW_VV_VV_UW 100.0 FORMULA_0010 0.0 65535.0 /end CHARACTERISTIC
/begin CHARACTERISTIC K_ED_PKS_MODELL.P_CODE_SH_TO_GND "P-Code fuer die Art SH_TO_GND" VALUE 0x71C20 TKW_VV_VV_UW 100.0 FORMULA_0010 0.0 65535.0 /end CHARACTERISTIC
/begin CHARACTERISTIC K_ED_PKS_MODELL.P_CODE_SH_TO_UB "P-Code fuer die Art SH_TO_UB" VALUE 0x71C1E TKW_VV_VV_UW 100.0 FORMULA_0010 0.0 65535.0 /end CHARACTERISTIC
/begin CHARACTERISTIC K_ED_PKS_MODELL.P_CODE_UNPLAUSIBEL "P-Code fuer die Art UNPLAUSIBEL" VALUE 0x71C24 TKW_VV_VV_UW 100.0 FORMULA_0010 0.0 65535.0 /end CHARACTERISTIC
/begin CHARACTERISTIC K_ED_PKS_PAUFBAU.DEC_NACH_EINTRAG "Filterverringerung nach Fehlerspeichereintrag" VALUE 0x71C45 TKW_VV_VV_UB 100.0 FORMULA_0003 0.0 255.0 /end CHARACTERISTIC
/begin CHARACTERISTIC K_ED_PKS_PAUFBAU.DEC_VOR_EINTRAG "Filterverringerung vorm Fehlerspeichereintrag" VALUE 0x71C43 TKW_VV_VV_UB 100.0 FORMULA_0003 0.0 255.0 /end CHARACTERISTIC
/begin CHARACTERISTIC K_ED_PKS_PAUFBAU.FEHLERSCHWELLE "Filterschwelle fuer Fehlereintrag" VALUE 0x71C40 TKW_VV_VV_UB 100.0 FORMULA_0003 0.0 255.0 /end CHARACTERISTIC
/begin CHARACTERISTIC K_ED_PKS_PAUFBAU.INC_NACH_EINTRAG "Filtererhoehung nach Fehlerspeichereintrag" VALUE 0x71C44 TKW_VV_VV_UB 100.0 FORMULA_0003 0.0 255.0 /end CHARACTERISTIC
/begin CHARACTERISTIC K_ED_PKS_PAUFBAU.INC_VOR_EINTRAG "Filtererhoehung vorm Fehlerspeichereintrag" VALUE 0x71C42 TKW_VV_VV_UB 100.0 FORMULA_0003 0.0 255.0 /end CHARACTERISTIC
/begin CHARACTERISTIC K_ED_PKS_PAUFBAU.KLASSENINDEX "Auswahl der Fehlerklasse" VALUE 0x71C46 TKW_VV_VV_UB 100.0 FORMULA_0003 0.0 8.0 /end CHARACTERISTIC
/begin CHARACTERISTIC K_ED_PKS_PAUFBAU.OK_SCHWELLE "Filterschwelle fuer Fehleraustrag" VALUE 0x71C41 TKW_VV_VV_UB 100.0 FORMULA_0003 0.0 255.0 /end CHARACTERISTIC
/begin CHARACTERISTIC K_ED_PKS_PAUFBAU.P_CODE_OPENLOAD "P-Code fuer die Art OPENLOAD" VALUE 0x71C3C TKW_VV_VV_UW 100.0 FORMULA_0010 0.0 65535.0 /end CHARACTERISTIC
/begin CHARACTERISTIC K_ED_PKS_PAUFBAU.P_CODE_SH_TO_GND "P-Code fuer die Art SH_TO_GND" VALUE 0x71C3A TKW_VV_VV_UW 100.0 FORMULA_0010 0.0 65535.0 /end CHARACTERISTIC
/begin CHARACTERISTIC K_ED_PKS_PAUFBAU.P_CODE_SH_TO_UB "P-Code fuer die Art SH_TO_UB" VALUE 0x71C38 TKW_VV_VV_UW 100.0 FORMULA_0010 0.0 65535.0 /end CHARACTERISTIC
/begin CHARACTERISTIC K_ED_PKS_PAUFBAU.P_CODE_UNPLAUSIBEL "P-Code fuer die Art UNPLAUSIBEL" VALUE 0x71C3E TKW_VV_VV_UW 100.0 FORMULA_0010 0.0 65535.0 /end CHARACTERISTIC
/begin CHARACTERISTIC K_ED_PKS_Q.DEC_NACH_EINTRAG "Filterverringerung nach Fehlerspeichereintrag" VALUE 0x7150F TKW_VV_VV_UB 100.0 FORMULA_0003 0.0 255.0 /end CHARACTERISTIC
/begin CHARACTERISTIC K_ED_PKS_Q.DEC_VOR_EINTRAG "Filterverringerung vorm Fehlerspeichereintrag" VALUE 0x7150D TKW_VV_VV_UB 100.0 FORMULA_0003 0.0 255.0 /end CHARACTERISTIC
/begin CHARACTERISTIC K_ED_PKS_Q.FEHLERSCHWELLE "Filterschwelle fuer Fehlereintrag" VALUE 0x7150A TKW_VV_VV_UB 100.0 FORMULA_0003 0.0 255.0 /end CHARACTERISTIC
/begin CHARACTERISTIC K_ED_PKS_Q.INC_NACH_EINTRAG "Filtererhoehung nach Fehlerspeichereintrag" VALUE 0x7150E TKW_VV_VV_UB 100.0 FORMULA_0003 0.0 255.0 /end CHARACTERISTIC
/begin CHARACTERISTIC K_ED_PKS_Q.INC_VOR_EINTRAG "Filtererhoehung vorm Fehlerspeichereintrag" VALUE 0x7150C TKW_VV_VV_UB 100.0 FORMULA_0003 0.0 255.0 /end CHARACTERISTIC
/begin CHARACTERISTIC K_ED_PKS_Q.KLASSENINDEX "Auswahl der Fehlerklasse" VALUE 0x71510 TKW_VV_VV_UB 100.0 FORMULA_0003 0.0 8.0 /end CHARACTERISTIC
/begin CHARACTERISTIC K_ED_PKS_Q.OK_SCHWELLE "Filterschwelle fuer Fehleraustrag" VALUE 0x7150B TKW_VV_VV_UB 100.0 FORMULA_0003 0.0 255.0 /end CHARACTERISTIC
/begin CHARACTERISTIC K_ED_PKS_Q.P_CODE_OPENLOAD "P-Code fuer die Art OPENLOAD" VALUE 0x71506 TKW_VV_VV_UW 100.0 FORMULA_0010 0.0 65535.0 /end CHARACTERISTIC
/begin CHARACTERISTIC K_ED_PKS_Q.P_CODE_SH_TO_GND "P-Code fuer die Art SH_TO_GND" VALUE 0x71504 TKW_VV_VV_UW 100.0 FORMULA_0010 0.0 65535.0 /end CHARACTERISTIC
/begin CHARACTERISTIC K_ED_PKS_Q.P_CODE_SH_TO_UB "P-Code fuer die Art SH_TO_UB" VALUE 0x71502 TKW_VV_VV_UW 100.0 FORMULA_0010 0.0 65535.0 /end CHARACTERISTIC
/begin CHARACTERISTIC K_ED_PKS_Q.P_CODE_UNPLAUSIBEL "P-Code fuer die Art UNPLAUSIBEL" VALUE 0x71508 TKW_VV_VV_UW 100.0 FORMULA_0010 0.0 65535.0 /end CHARACTERISTIC
/begin CHARACTERISTIC K_ED_PKS_TL.DEC_NACH_EINTRAG "Filterverringerung nach Fehlerspeichereintrag" VALUE 0x714F5 TKW_VV_VV_UB 100.0 FORMULA_0003 0.0 255.0 /end CHARACTERISTIC
/begin CHARACTERISTIC K_ED_PKS_TL.DEC_VOR_EINTRAG "Filterverringerung vorm Fehlerspeichereintrag" VALUE 0x714F3 TKW_VV_VV_UB 100.0 FORMULA_0003 0.0 255.0 /end CHARACTERISTIC
/begin CHARACTERISTIC K_ED_PKS_TL.FEHLERSCHWELLE "Filterschwelle fuer Fehlereintrag" VALUE 0x714F0 TKW_VV_VV_UB 100.0 FORMULA_0003 0.0 255.0 /end CHARACTERISTIC
/begin CHARACTERISTIC K_ED_PKS_TL.INC_NACH_EINTRAG "Filtererhoehung nach Fehlerspeichereintrag" VALUE 0x714F4 TKW_VV_VV_UB 100.0 FORMULA_0003 0.0 255.0 /end CHARACTERISTIC
/begin CHARACTERISTIC K_ED_PKS_TL.INC_VOR_EINTRAG "Filtererhoehung vorm Fehlerspeichereintrag" VALUE 0x714F2 TKW_VV_VV_UB 100.0 FORMULA_0003 0.0 255.0 /end CHARACTERISTIC
/begin CHARACTERISTIC K_ED_PKS_TL.KLASSENINDEX "Auswahl der Fehlerklasse" VALUE 0x714F6 TKW_VV_VV_UB 100.0 FORMULA_0003 0.0 8.0 /end CHARACTERISTIC
/begin CHARACTERISTIC K_ED_PKS_TL.OK_SCHWELLE "Filterschwelle fuer Fehleraustrag" VALUE 0x714F1 TKW_VV_VV_UB 100.0 FORMULA_0003 0.0 255.0 /end CHARACTERISTIC
/begin CHARACTERISTIC K_ED_PKS_TL.P_CODE_OPENLOAD "P-Code fuer die Art OPENLOAD" VALUE 0x714EC TKW_VV_VV_UW 100.0 FORMULA_0010 0.0 65535.0 /end CHARACTERISTIC
/begin CHARACTERISTIC K_ED_PKS_TL.P_CODE_SH_TO_GND "P-Code fuer die Art SH_TO_GND" VALUE 0x714EA TKW_VV_VV_UW 100.0 FORMULA_0010 0.0 65535.0 /end CHARACTERISTIC
/begin CHARACTERISTIC K_ED_PKS_TL.P_CODE_SH_TO_UB "P-Code fuer die Art SH_TO_UB" VALUE 0x714E8 TKW_VV_VV_UW 100.0 FORMULA_0010 0.0 65535.0 /end CHARACTERISTIC
/begin CHARACTERISTIC K_ED_PKS_TL.P_CODE_UNPLAUSIBEL "P-Code fuer die Art UNPLAUSIBEL" VALUE 0x714EE TKW_VV_VV_UW 100.0 FORMULA_0010 0.0 65535.0 /end CHARACTERISTIC
/begin CHARACTERISTIC K_ED_PSAU1.DEC_NACH_EINTRAG "Filterverringerung nach Fehlerspeichereintrag" VALUE 0x70947 TKW_VV_VV_UB 100.0 FORMULA_0003 0.0 255.0 /end CHARACTERISTIC
/begin CHARACTERISTIC K_ED_PSAU1.DEC_VOR_EINTRAG "Filterverringerung vorm Fehlerspeichereintrag" VALUE 0x70945 TKW_VV_VV_UB 100.0 FORMULA_0003 0.0 255.0 /end CHARACTERISTIC
/begin CHARACTERISTIC K_ED_PSAU1.FEHLERSCHWELLE "Filterschwelle fuer Fehlereintrag" VALUE 0x70942 TKW_VV_VV_UB 100.0 FORMULA_0003 0.0 255.0 /end CHARACTERISTIC
/begin CHARACTERISTIC K_ED_PSAU1.INC_NACH_EINTRAG "Filtererhoehung nach Fehlerspeichereintrag" VALUE 0x70946 TKW_VV_VV_UB 100.0 FORMULA_0003 0.0 255.0 /end CHARACTERISTIC
/begin CHARACTERISTIC K_ED_PSAU1.INC_VOR_EINTRAG "Filtererhoehung vorm Fehlerspeichereintrag" VALUE 0x70944 TKW_VV_VV_UB 100.0 FORMULA_0003 0.0 255.0 /end CHARACTERISTIC
/begin CHARACTERISTIC K_ED_PSAU1.KLASSENINDEX "Auswahl der Fehlerklasse" VALUE 0x70948 TKW_VV_VV_UB 100.0 FORMULA_0003 0.0 8.0 /end CHARACTERISTIC
/begin CHARACTERISTIC K_ED_PSAU1.OK_SCHWELLE "Filterschwelle fuer Fehleraustrag" VALUE 0x70943 TKW_VV_VV_UB 100.0 FORMULA_0003 0.0 255.0 /end CHARACTERISTIC
/begin CHARACTERISTIC K_ED_PSAU1.P_CODE_OPENLOAD "P-Code fuer die Art OPENLOAD" VALUE 0x7093E TKW_VV_VV_UW 100.0 FORMULA_0010 0.0 65535.0 /end CHARACTERISTIC
/begin CHARACTERISTIC K_ED_PSAU1.P_CODE_SH_TO_GND "P-Code fuer die Art SH_TO_GND" VALUE 0x7093C TKW_VV_VV_UW 100.0 FORMULA_0010 0.0 65535.0 /end CHARACTERISTIC
/begin CHARACTERISTIC K_ED_PSAU1.P_CODE_SH_TO_UB "P-Code fuer die Art SH_TO_UB" VALUE 0x7093A TKW_VV_VV_UW 100.0 FORMULA_0010 0.0 65535.0 /end CHARACTERISTIC
/begin CHARACTERISTIC K_ED_PSAU1.P_CODE_UNPLAUSIBEL "P-Code fuer die Art UNPLAUSIBEL" VALUE 0x70940 TKW_VV_VV_UW 100.0 FORMULA_0010 0.0 65535.0 /end CHARACTERISTIC
/begin CHARACTERISTIC K_ED_PSAU2.DEC_NACH_EINTRAG "Filterverringerung nach Fehlerspeichereintrag" VALUE 0x70961 TKW_VV_VV_UB 100.0 FORMULA_0003 0.0 255.0 /end CHARACTERISTIC
/begin CHARACTERISTIC K_ED_PSAU2.DEC_VOR_EINTRAG "Filterverringerung vorm Fehlerspeichereintrag" VALUE 0x7095F TKW_VV_VV_UB 100.0 FORMULA_0003 0.0 255.0 /end CHARACTERISTIC
/begin CHARACTERISTIC K_ED_PSAU2.FEHLERSCHWELLE "Filterschwelle fuer Fehlereintrag" VALUE 0x7095C TKW_VV_VV_UB 100.0 FORMULA_0003 0.0 255.0 /end CHARACTERISTIC
/begin CHARACTERISTIC K_ED_PSAU2.INC_NACH_EINTRAG "Filtererhoehung nach Fehlerspeichereintrag" VALUE 0x70960 TKW_VV_VV_UB 100.0 FORMULA_0003 0.0 255.0 /end CHARACTERISTIC
/begin CHARACTERISTIC K_ED_PSAU2.INC_VOR_EINTRAG "Filtererhoehung vorm Fehlerspeichereintrag" VALUE 0x7095E TKW_VV_VV_UB 100.0 FORMULA_0003 0.0 255.0 /end CHARACTERISTIC
/begin CHARACTERISTIC K_ED_PSAU2.KLASSENINDEX "Auswahl der Fehlerklasse" VALUE 0x70962 TKW_VV_VV_UB 100.0 FORMULA_0003 0.0 8.0 /end CHARACTERISTIC
/begin CHARACTERISTIC K_ED_PSAU2.OK_SCHWELLE "Filterschwelle fuer Fehleraustrag" VALUE 0x7095D TKW_VV_VV_UB 100.0 FORMULA_0003 0.0 255.0 /end CHARACTERISTIC
/begin CHARACTERISTIC K_ED_PSAU2.P_CODE_OPENLOAD "P-Code fuer die Art OPENLOAD" VALUE 0x70958 TKW_VV_VV_UW 100.0 FORMULA_0010 0.0 65535.0 /end CHARACTERISTIC
/begin CHARACTERISTIC K_ED_PSAU2.P_CODE_SH_TO_GND "P-Code fuer die Art SH_TO_GND" VALUE 0x70956 TKW_VV_VV_UW 100.0 FORMULA_0010 0.0 65535.0 /end CHARACTERISTIC
/begin CHARACTERISTIC K_ED_PSAU2.P_CODE_SH_TO_UB "P-Code fuer die Art SH_TO_UB" VALUE 0x70954 TKW_VV_VV_UW 100.0 FORMULA_0010 0.0 65535.0 /end CHARACTERISTIC
/begin CHARACTERISTIC K_ED_PSAU2.P_CODE_UNPLAUSIBEL "P-Code fuer die Art UNPLAUSIBEL" VALUE 0x7095A TKW_VV_VV_UW 100.0 FORMULA_0010 0.0 65535.0 /end CHARACTERISTIC
/begin CHARACTERISTIC K_ED_PT_ANFRADMOM.DEC_NACH_EINTRAG "Filterverringerung nach Fehlerspeichereintrag" VALUE 0x71AA5 TKW_VV_VV_UB 100.0 FORMULA_0003 0.0 255.0 /end CHARACTERISTIC
/begin CHARACTERISTIC K_ED_PT_ANFRADMOM.DEC_VOR_EINTRAG "Filterverringerung vorm Fehlerspeichereintrag" VALUE 0x71AA3 TKW_VV_VV_UB 100.0 FORMULA_0003 0.0 255.0 /end CHARACTERISTIC
/begin CHARACTERISTIC K_ED_PT_ANFRADMOM.FEHLERSCHWELLE "Filterschwelle fuer Fehlereintrag" VALUE 0x71AA0 TKW_VV_VV_UB 100.0 FORMULA_0003 0.0 255.0 /end CHARACTERISTIC
/begin CHARACTERISTIC K_ED_PT_ANFRADMOM.INC_NACH_EINTRAG "Filtererhoehung nach Fehlerspeichereintrag" VALUE 0x71AA4 TKW_VV_VV_UB 100.0 FORMULA_0003 0.0 255.0 /end CHARACTERISTIC
/begin CHARACTERISTIC K_ED_PT_ANFRADMOM.INC_VOR_EINTRAG "Filtererhoehung vorm Fehlerspeichereintrag" VALUE 0x71AA2 TKW_VV_VV_UB 100.0 FORMULA_0003 0.0 255.0 /end CHARACTERISTIC
/begin CHARACTERISTIC K_ED_PT_ANFRADMOM.KLASSENINDEX "Auswahl der Fehlerklasse" VALUE 0x71AA6 TKW_VV_VV_UB 100.0 FORMULA_0003 0.0 8.0 /end CHARACTERISTIC
/begin CHARACTERISTIC K_ED_PT_ANFRADMOM.OK_SCHWELLE "Filterschwelle fuer Fehleraustrag" VALUE 0x71AA1 TKW_VV_VV_UB 100.0 FORMULA_0003 0.0 255.0 /end CHARACTERISTIC
/begin CHARACTERISTIC K_ED_PT_ANFRADMOM.P_CODE_OPENLOAD "P-Code fuer die Art OPENLOAD" VALUE 0x71A9C TKW_VV_VV_UW 100.0 FORMULA_0010 0.0 65535.0 /end CHARACTERISTIC
/begin CHARACTERISTIC K_ED_PT_ANFRADMOM.P_CODE_SH_TO_GND "P-Code fuer die Art SH_TO_GND" VALUE 0x71A9A TKW_VV_VV_UW 100.0 FORMULA_0010 0.0 65535.0 /end CHARACTERISTIC
/begin CHARACTERISTIC K_ED_PT_ANFRADMOM.P_CODE_SH_TO_UB "P-Code fuer die Art SH_TO_UB" VALUE 0x71A98 TKW_VV_VV_UW 100.0 FORMULA_0010 0.0 65535.0 /end CHARACTERISTIC
/begin CHARACTERISTIC K_ED_PT_ANFRADMOM.P_CODE_UNPLAUSIBEL "P-Code fuer die Art UNPLAUSIBEL" VALUE 0x71A9E TKW_VV_VV_UW 100.0 FORMULA_0010 0.0 65535.0 /end CHARACTERISTIC
/begin CHARACTERISTIC K_ED_PT_ATEMP.DEC_NACH_EINTRAG "Filterverringerung nach Fehlerspeichereintrag" VALUE 0x70C6D TKW_VV_VV_UB 100.0 FORMULA_0003 0.0 255.0 /end CHARACTERISTIC
/begin CHARACTERISTIC K_ED_PT_ATEMP.DEC_VOR_EINTRAG "Filterverringerung vorm Fehlerspeichereintrag" VALUE 0x70C6B TKW_VV_VV_UB 100.0 FORMULA_0003 0.0 255.0 /end CHARACTERISTIC
/begin CHARACTERISTIC K_ED_PT_ATEMP.FEHLERSCHWELLE "Filterschwelle fuer Fehlereintrag" VALUE 0x70C68 TKW_VV_VV_UB 100.0 FORMULA_0003 0.0 255.0 /end CHARACTERISTIC
/begin CHARACTERISTIC K_ED_PT_ATEMP.INC_NACH_EINTRAG "Filtererhoehung nach Fehlerspeichereintrag" VALUE 0x70C6C TKW_VV_VV_UB 100.0 FORMULA_0003 0.0 255.0 /end CHARACTERISTIC
/begin CHARACTERISTIC K_ED_PT_ATEMP.INC_VOR_EINTRAG "Filtererhoehung vorm Fehlerspeichereintrag" VALUE 0x70C6A TKW_VV_VV_UB 100.0 FORMULA_0003 0.0 255.0 /end CHARACTERISTIC
/begin CHARACTERISTIC K_ED_PT_ATEMP.KLASSENINDEX "Auswahl der Fehlerklasse" VALUE 0x70C6E TKW_VV_VV_UB 100.0 FORMULA_0003 0.0 8.0 /end CHARACTERISTIC
/begin CHARACTERISTIC K_ED_PT_ATEMP.OK_SCHWELLE "Filterschwelle fuer Fehleraustrag" VALUE 0x70C69 TKW_VV_VV_UB 100.0 FORMULA_0003 0.0 255.0 /end CHARACTERISTIC
/begin CHARACTERISTIC K_ED_PT_ATEMP.P_CODE_OPENLOAD "P-Code fuer die Art OPENLOAD" VALUE 0x70C64 TKW_VV_VV_UW 100.0 FORMULA_0010 0.0 65535.0 /end CHARACTERISTIC
/begin CHARACTERISTIC K_ED_PT_ATEMP.P_CODE_SH_TO_GND "P-Code fuer die Art SH_TO_GND" VALUE 0x70C62 TKW_VV_VV_UW 100.0 FORMULA_0010 0.0 65535.0 /end CHARACTERISTIC
/begin CHARACTERISTIC K_ED_PT_ATEMP.P_CODE_SH_TO_UB "P-Code fuer die Art SH_TO_UB" VALUE 0x70C60 TKW_VV_VV_UW 100.0 FORMULA_0010 0.0 65535.0 /end CHARACTERISTIC
/begin CHARACTERISTIC K_ED_PT_ATEMP.P_CODE_UNPLAUSIBEL "P-Code fuer die Art UNPLAUSIBEL" VALUE 0x70C66 TKW_VV_VV_UW 100.0 FORMULA_0010 0.0 65535.0 /end CHARACTERISTIC
/begin CHARACTERISTIC K_ED_PT_AX.DEC_NACH_EINTRAG "Filterverringerung nach Fehlerspeichereintrag" VALUE 0x71CAD TKW_VV_VV_UB 100.0 FORMULA_0003 0.0 255.0 /end CHARACTERISTIC
/begin CHARACTERISTIC K_ED_PT_AX.DEC_VOR_EINTRAG "Filterverringerung vorm Fehlerspeichereintrag" VALUE 0x71CAB TKW_VV_VV_UB 100.0 FORMULA_0003 0.0 255.0 /end CHARACTERISTIC
/begin CHARACTERISTIC K_ED_PT_AX.FEHLERSCHWELLE "Filterschwelle fuer Fehlereintrag" VALUE 0x71CA8 TKW_VV_VV_UB 100.0 FORMULA_0003 0.0 255.0 /end CHARACTERISTIC
/begin CHARACTERISTIC K_ED_PT_AX.INC_NACH_EINTRAG "Filtererhoehung nach Fehlerspeichereintrag" VALUE 0x71CAC TKW_VV_VV_UB 100.0 FORMULA_0003 0.0 255.0 /end CHARACTERISTIC
/begin CHARACTERISTIC K_ED_PT_AX.INC_VOR_EINTRAG "Filtererhoehung vorm Fehlerspeichereintrag" VALUE 0x71CAA TKW_VV_VV_UB 100.0 FORMULA_0003 0.0 255.0 /end CHARACTERISTIC
/begin CHARACTERISTIC K_ED_PT_AX.KLASSENINDEX "Auswahl der Fehlerklasse" VALUE 0x71CAE TKW_VV_VV_UB 100.0 FORMULA_0003 0.0 8.0 /end CHARACTERISTIC
/begin CHARACTERISTIC K_ED_PT_AX.OK_SCHWELLE "Filterschwelle fuer Fehleraustrag" VALUE 0x71CA9 TKW_VV_VV_UB 100.0 FORMULA_0003 0.0 255.0 /end CHARACTERISTIC
/begin CHARACTERISTIC K_ED_PT_AX.P_CODE_OPENLOAD "P-Code fuer die Art OPENLOAD" VALUE 0x71CA4 TKW_VV_VV_UW 100.0 FORMULA_0010 0.0 65535.0 /end CHARACTERISTIC
/begin CHARACTERISTIC K_ED_PT_AX.P_CODE_SH_TO_GND "P-Code fuer die Art SH_TO_GND" VALUE 0x71CA2 TKW_VV_VV_UW 100.0 FORMULA_0010 0.0 65535.0 /end CHARACTERISTIC
/begin CHARACTERISTIC K_ED_PT_AX.P_CODE_SH_TO_UB "P-Code fuer die Art SH_TO_UB" VALUE 0x71CA0 TKW_VV_VV_UW 100.0 FORMULA_0010 0.0 65535.0 /end CHARACTERISTIC
/begin CHARACTERISTIC K_ED_PT_AX.P_CODE_UNPLAUSIBEL "P-Code fuer die Art UNPLAUSIBEL" VALUE 0x71CA6 TKW_VV_VV_UW 100.0 FORMULA_0010 0.0 65535.0 /end CHARACTERISTIC
/begin CHARACTERISTIC K_ED_PT_BEDAT.DEC_NACH_EINTRAG "Filterverringerung nach Fehlerspeichereintrag" VALUE 0x71661 TKW_VV_VV_UB 100.0 FORMULA_0003 0.0 255.0 /end CHARACTERISTIC
/begin CHARACTERISTIC K_ED_PT_BEDAT.DEC_VOR_EINTRAG "Filterverringerung vorm Fehlerspeichereintrag" VALUE 0x7165F TKW_VV_VV_UB 100.0 FORMULA_0003 0.0 255.0 /end CHARACTERISTIC
/begin CHARACTERISTIC K_ED_PT_BEDAT.FEHLERSCHWELLE "Filterschwelle fuer Fehlereintrag" VALUE 0x7165C TKW_VV_VV_UB 100.0 FORMULA_0003 0.0 255.0 /end CHARACTERISTIC
/begin CHARACTERISTIC K_ED_PT_BEDAT.INC_NACH_EINTRAG "Filtererhoehung nach Fehlerspeichereintrag" VALUE 0x71660 TKW_VV_VV_UB 100.0 FORMULA_0003 0.0 255.0 /end CHARACTERISTIC
/begin CHARACTERISTIC K_ED_PT_BEDAT.INC_VOR_EINTRAG "Filtererhoehung vorm Fehlerspeichereintrag" VALUE 0x7165E TKW_VV_VV_UB 100.0 FORMULA_0003 0.0 255.0 /end CHARACTERISTIC
/begin CHARACTERISTIC K_ED_PT_BEDAT.KLASSENINDEX "Auswahl der Fehlerklasse" VALUE 0x71662 TKW_VV_VV_UB 100.0 FORMULA_0003 0.0 8.0 /end CHARACTERISTIC
/begin CHARACTERISTIC K_ED_PT_BEDAT.OK_SCHWELLE "Filterschwelle fuer Fehleraustrag" VALUE 0x7165D TKW_VV_VV_UB 100.0 FORMULA_0003 0.0 255.0 /end CHARACTERISTIC
/begin CHARACTERISTIC K_ED_PT_BEDAT.P_CODE_OPENLOAD "P-Code fuer die Art OPENLOAD" VALUE 0x71658 TKW_VV_VV_UW 100.0 FORMULA_0010 0.0 65535.0 /end CHARACTERISTIC
/begin CHARACTERISTIC K_ED_PT_BEDAT.P_CODE_SH_TO_GND "P-Code fuer die Art SH_TO_GND" VALUE 0x71656 TKW_VV_VV_UW 100.0 FORMULA_0010 0.0 65535.0 /end CHARACTERISTIC
/begin CHARACTERISTIC K_ED_PT_BEDAT.P_CODE_SH_TO_UB "P-Code fuer die Art SH_TO_UB" VALUE 0x71654 TKW_VV_VV_UW 100.0 FORMULA_0010 0.0 65535.0 /end CHARACTERISTIC
/begin CHARACTERISTIC K_ED_PT_BEDAT.P_CODE_UNPLAUSIBEL "P-Code fuer die Art UNPLAUSIBEL" VALUE 0x7165A TKW_VV_VV_UW 100.0 FORMULA_0010 0.0 65535.0 /end CHARACTERISTIC
/begin CHARACTERISTIC K_ED_PT_BEDFGR.DEC_NACH_EINTRAG "Filterverringerung nach Fehlerspeichereintrag" VALUE 0x71321 TKW_VV_VV_UB 100.0 FORMULA_0003 0.0 255.0 /end CHARACTERISTIC
/begin CHARACTERISTIC K_ED_PT_BEDFGR.DEC_VOR_EINTRAG "Filterverringerung vorm Fehlerspeichereintrag" VALUE 0x7131F TKW_VV_VV_UB 100.0 FORMULA_0003 0.0 255.0 /end CHARACTERISTIC
/begin CHARACTERISTIC K_ED_PT_BEDFGR.FEHLERSCHWELLE "Filterschwelle fuer Fehlereintrag" VALUE 0x7131C TKW_VV_VV_UB 100.0 FORMULA_0003 0.0 255.0 /end CHARACTERISTIC
/begin CHARACTERISTIC K_ED_PT_BEDFGR.INC_NACH_EINTRAG "Filtererhoehung nach Fehlerspeichereintrag" VALUE 0x71320 TKW_VV_VV_UB 100.0 FORMULA_0003 0.0 255.0 /end CHARACTERISTIC
/begin CHARACTERISTIC K_ED_PT_BEDFGR.INC_VOR_EINTRAG "Filtererhoehung vorm Fehlerspeichereintrag" VALUE 0x7131E TKW_VV_VV_UB 100.0 FORMULA_0003 0.0 255.0 /end CHARACTERISTIC
/begin CHARACTERISTIC K_ED_PT_BEDFGR.KLASSENINDEX "Auswahl der Fehlerklasse" VALUE 0x71322 TKW_VV_VV_UB 100.0 FORMULA_0003 0.0 8.0 /end CHARACTERISTIC
/begin CHARACTERISTIC K_ED_PT_BEDFGR.OK_SCHWELLE "Filterschwelle fuer Fehleraustrag" VALUE 0x7131D TKW_VV_VV_UB 100.0 FORMULA_0003 0.0 255.0 /end CHARACTERISTIC
/begin CHARACTERISTIC K_ED_PT_BEDFGR.P_CODE_OPENLOAD "P-Code fuer die Art OPENLOAD" VALUE 0x71318 TKW_VV_VV_UW 100.0 FORMULA_0010 0.0 65535.0 /end CHARACTERISTIC
/begin CHARACTERISTIC K_ED_PT_BEDFGR.P_CODE_SH_TO_GND "P-Code fuer die Art SH_TO_GND" VALUE 0x71316 TKW_VV_VV_UW 100.0 FORMULA_0010 0.0 65535.0 /end CHARACTERISTIC
/begin CHARACTERISTIC K_ED_PT_BEDFGR.P_CODE_SH_TO_UB "P-Code fuer die Art SH_TO_UB" VALUE 0x71314 TKW_VV_VV_UW 100.0 FORMULA_0010 0.0 65535.0 /end CHARACTERISTIC
/begin CHARACTERISTIC K_ED_PT_BEDFGR.P_CODE_UNPLAUSIBEL "P-Code fuer die Art UNPLAUSIBEL" VALUE 0x7131A TKW_VV_VV_UW 100.0 FORMULA_0010 0.0 65535.0 /end CHARACTERISTIC
/begin CHARACTERISTIC K_ED_PT_BUSOFF.DEC_NACH_EINTRAG "Filterverringerung nach Fehlerspeichereintrag" VALUE 0x70BEB TKW_VV_VV_UB 100.0 FORMULA_0003 0.0 255.0 /end CHARACTERISTIC
/begin CHARACTERISTIC K_ED_PT_BUSOFF.DEC_VOR_EINTRAG "Filterverringerung vorm Fehlerspeichereintrag" VALUE 0x70BE9 TKW_VV_VV_UB 100.0 FORMULA_0003 0.0 255.0 /end CHARACTERISTIC
/begin CHARACTERISTIC K_ED_PT_BUSOFF.FEHLERSCHWELLE "Filterschwelle fuer Fehlereintrag" VALUE 0x70BE6 TKW_VV_VV_UB 100.0 FORMULA_0003 0.0 255.0 /end CHARACTERISTIC
/begin CHARACTERISTIC K_ED_PT_BUSOFF.INC_NACH_EINTRAG "Filtererhoehung nach Fehlerspeichereintrag" VALUE 0x70BEA TKW_VV_VV_UB 100.0 FORMULA_0003 0.0 255.0 /end CHARACTERISTIC
/begin CHARACTERISTIC K_ED_PT_BUSOFF.INC_VOR_EINTRAG "Filtererhoehung vorm Fehlerspeichereintrag" VALUE 0x70BE8 TKW_VV_VV_UB 100.0 FORMULA_0003 0.0 255.0 /end CHARACTERISTIC
/begin CHARACTERISTIC K_ED_PT_BUSOFF.KLASSENINDEX "Auswahl der Fehlerklasse" VALUE 0x70BEC TKW_VV_VV_UB 100.0 FORMULA_0003 0.0 8.0 /end CHARACTERISTIC
/begin CHARACTERISTIC K_ED_PT_BUSOFF.OK_SCHWELLE "Filterschwelle fuer Fehleraustrag" VALUE 0x70BE7 TKW_VV_VV_UB 100.0 FORMULA_0003 0.0 255.0 /end CHARACTERISTIC
/begin CHARACTERISTIC K_ED_PT_BUSOFF.P_CODE_OPENLOAD "P-Code fuer die Art OPENLOAD" VALUE 0x70BE2 TKW_VV_VV_UW 100.0 FORMULA_0010 0.0 65535.0 /end CHARACTERISTIC
/begin CHARACTERISTIC K_ED_PT_BUSOFF.P_CODE_SH_TO_GND "P-Code fuer die Art SH_TO_GND" VALUE 0x70BE0 TKW_VV_VV_UW 100.0 FORMULA_0010 0.0 65535.0 /end CHARACTERISTIC
/begin CHARACTERISTIC K_ED_PT_BUSOFF.P_CODE_SH_TO_UB "P-Code fuer die Art SH_TO_UB" VALUE 0x70BDE TKW_VV_VV_UW 100.0 FORMULA_0010 0.0 65535.0 /end CHARACTERISTIC
/begin CHARACTERISTIC K_ED_PT_BUSOFF.P_CODE_UNPLAUSIBEL "P-Code fuer die Art UNPLAUSIBEL" VALUE 0x70BE4 TKW_VV_VV_UW 100.0 FORMULA_0010 0.0 65535.0 /end CHARACTERISTIC
/begin CHARACTERISTIC K_ED_PT_CRASH.DEC_NACH_EINTRAG "Filterverringerung nach Fehlerspeichereintrag" VALUE 0x712ED TKW_VV_VV_UB 100.0 FORMULA_0003 0.0 255.0 /end CHARACTERISTIC
/begin CHARACTERISTIC K_ED_PT_CRASH.DEC_VOR_EINTRAG "Filterverringerung vorm Fehlerspeichereintrag" VALUE 0x712EB TKW_VV_VV_UB 100.0 FORMULA_0003 0.0 255.0 /end CHARACTERISTIC
/begin CHARACTERISTIC K_ED_PT_CRASH.FEHLERSCHWELLE "Filterschwelle fuer Fehlereintrag" VALUE 0x712E8 TKW_VV_VV_UB 100.0 FORMULA_0003 0.0 255.0 /end CHARACTERISTIC
/begin CHARACTERISTIC K_ED_PT_CRASH.INC_NACH_EINTRAG "Filtererhoehung nach Fehlerspeichereintrag" VALUE 0x712EC TKW_VV_VV_UB 100.0 FORMULA_0003 0.0 255.0 /end CHARACTERISTIC
/begin CHARACTERISTIC K_ED_PT_CRASH.INC_VOR_EINTRAG "Filtererhoehung vorm Fehlerspeichereintrag" VALUE 0x712EA TKW_VV_VV_UB 100.0 FORMULA_0003 0.0 255.0 /end CHARACTERISTIC
/begin CHARACTERISTIC K_ED_PT_CRASH.KLASSENINDEX "Auswahl der Fehlerklasse" VALUE 0x712EE TKW_VV_VV_UB 100.0 FORMULA_0003 0.0 8.0 /end CHARACTERISTIC
/begin CHARACTERISTIC K_ED_PT_CRASH.OK_SCHWELLE "Filterschwelle fuer Fehleraustrag" VALUE 0x712E9 TKW_VV_VV_UB 100.0 FORMULA_0003 0.0 255.0 /end CHARACTERISTIC
/begin CHARACTERISTIC K_ED_PT_CRASH.P_CODE_OPENLOAD "P-Code fuer die Art OPENLOAD" VALUE 0x712E4 TKW_VV_VV_UW 100.0 FORMULA_0010 0.0 65535.0 /end CHARACTERISTIC
/begin CHARACTERISTIC K_ED_PT_CRASH.P_CODE_SH_TO_GND "P-Code fuer die Art SH_TO_GND" VALUE 0x712E2 TKW_VV_VV_UW 100.0 FORMULA_0010 0.0 65535.0 /end CHARACTERISTIC
/begin CHARACTERISTIC K_ED_PT_CRASH.P_CODE_SH_TO_UB "P-Code fuer die Art SH_TO_UB" VALUE 0x712E0 TKW_VV_VV_UW 100.0 FORMULA_0010 0.0 65535.0 /end CHARACTERISTIC
/begin CHARACTERISTIC K_ED_PT_CRASH.P_CODE_UNPLAUSIBEL "P-Code fuer die Art UNPLAUSIBEL" VALUE 0x712E6 TKW_VV_VV_UW 100.0 FORMULA_0010 0.0 65535.0 /end CHARACTERISTIC
/begin CHARACTERISTIC K_ED_PT_GRB.DEC_NACH_EINTRAG "Filterverringerung nach Fehlerspeichereintrag" VALUE 0x70EF7 TKW_VV_VV_UB 100.0 FORMULA_0003 0.0 255.0 /end CHARACTERISTIC
/begin CHARACTERISTIC K_ED_PT_GRB.DEC_VOR_EINTRAG "Filterverringerung vorm Fehlerspeichereintrag" VALUE 0x70EF5 TKW_VV_VV_UB 100.0 FORMULA_0003 0.0 255.0 /end CHARACTERISTIC
/begin CHARACTERISTIC K_ED_PT_GRB.FEHLERSCHWELLE "Filterschwelle fuer Fehlereintrag" VALUE 0x70EF2 TKW_VV_VV_UB 100.0 FORMULA_0003 0.0 255.0 /end CHARACTERISTIC
/begin CHARACTERISTIC K_ED_PT_GRB.INC_NACH_EINTRAG "Filtererhoehung nach Fehlerspeichereintrag" VALUE 0x70EF6 TKW_VV_VV_UB 100.0 FORMULA_0003 0.0 255.0 /end CHARACTERISTIC
/begin CHARACTERISTIC K_ED_PT_GRB.INC_VOR_EINTRAG "Filtererhoehung vorm Fehlerspeichereintrag" VALUE 0x70EF4 TKW_VV_VV_UB 100.0 FORMULA_0003 0.0 255.0 /end CHARACTERISTIC
/begin CHARACTERISTIC K_ED_PT_GRB.KLASSENINDEX "Auswahl der Fehlerklasse" VALUE 0x70EF8 TKW_VV_VV_UB 100.0 FORMULA_0003 0.0 8.0 /end CHARACTERISTIC
/begin CHARACTERISTIC K_ED_PT_GRB.OK_SCHWELLE "Filterschwelle fuer Fehleraustrag" VALUE 0x70EF3 TKW_VV_VV_UB 100.0 FORMULA_0003 0.0 255.0 /end CHARACTERISTIC
/begin CHARACTERISTIC K_ED_PT_GRB.P_CODE_OPENLOAD "P-Code fuer die Art OPENLOAD" VALUE 0x70EEE TKW_VV_VV_UW 100.0 FORMULA_0010 0.0 65535.0 /end CHARACTERISTIC
/begin CHARACTERISTIC K_ED_PT_GRB.P_CODE_SH_TO_GND "P-Code fuer die Art SH_TO_GND" VALUE 0x70EEC TKW_VV_VV_UW 100.0 FORMULA_0010 0.0 65535.0 /end CHARACTERISTIC
/begin CHARACTERISTIC K_ED_PT_GRB.P_CODE_SH_TO_UB "P-Code fuer die Art SH_TO_UB" VALUE 0x70EEA TKW_VV_VV_UW 100.0 FORMULA_0010 0.0 65535.0 /end CHARACTERISTIC
/begin CHARACTERISTIC K_ED_PT_GRB.P_CODE_UNPLAUSIBEL "P-Code fuer die Art UNPLAUSIBEL" VALUE 0x70EF0 TKW_VV_VV_UW 100.0 FORMULA_0010 0.0 65535.0 /end CHARACTERISTIC
/begin CHARACTERISTIC K_ED_PT_GRB2.DEC_NACH_EINTRAG "Filterverringerung nach Fehlerspeichereintrag" VALUE 0x70F11 TKW_VV_VV_UB 100.0 FORMULA_0003 0.0 255.0 /end CHARACTERISTIC
/begin CHARACTERISTIC K_ED_PT_GRB2.DEC_VOR_EINTRAG "Filterverringerung vorm Fehlerspeichereintrag" VALUE 0x70F0F TKW_VV_VV_UB 100.0 FORMULA_0003 0.0 255.0 /end CHARACTERISTIC
/begin CHARACTERISTIC K_ED_PT_GRB2.FEHLERSCHWELLE "Filterschwelle fuer Fehlereintrag" VALUE 0x70F0C TKW_VV_VV_UB 100.0 FORMULA_0003 0.0 255.0 /end CHARACTERISTIC
/begin CHARACTERISTIC K_ED_PT_GRB2.INC_NACH_EINTRAG "Filtererhoehung nach Fehlerspeichereintrag" VALUE 0x70F10 TKW_VV_VV_UB 100.0 FORMULA_0003 0.0 255.0 /end CHARACTERISTIC
/begin CHARACTERISTIC K_ED_PT_GRB2.INC_VOR_EINTRAG "Filtererhoehung vorm Fehlerspeichereintrag" VALUE 0x70F0E TKW_VV_VV_UB 100.0 FORMULA_0003 0.0 255.0 /end CHARACTERISTIC
/begin CHARACTERISTIC K_ED_PT_GRB2.KLASSENINDEX "Auswahl der Fehlerklasse" VALUE 0x70F12 TKW_VV_VV_UB 100.0 FORMULA_0003 0.0 8.0 /end CHARACTERISTIC
/begin CHARACTERISTIC K_ED_PT_GRB2.OK_SCHWELLE "Filterschwelle fuer Fehleraustrag" VALUE 0x70F0D TKW_VV_VV_UB 100.0 FORMULA_0003 0.0 255.0 /end CHARACTERISTIC
/begin CHARACTERISTIC K_ED_PT_GRB2.P_CODE_OPENLOAD "P-Code fuer die Art OPENLOAD" VALUE 0x70F08 TKW_VV_VV_UW 100.0 FORMULA_0010 0.0 65535.0 /end CHARACTERISTIC
/begin CHARACTERISTIC K_ED_PT_GRB2.P_CODE_SH_TO_GND "P-Code fuer die Art SH_TO_GND" VALUE 0x70F06 TKW_VV_VV_UW 100.0 FORMULA_0010 0.0 65535.0 /end CHARACTERISTIC
/begin CHARACTERISTIC K_ED_PT_GRB2.P_CODE_SH_TO_UB "P-Code fuer die Art SH_TO_UB" VALUE 0x70F04 TKW_VV_VV_UW 100.0 FORMULA_0010 0.0 65535.0 /end CHARACTERISTIC
/begin CHARACTERISTIC K_ED_PT_GRB2.P_CODE_UNPLAUSIBEL "P-Code fuer die Art UNPLAUSIBEL" VALUE 0x70F0A TKW_VV_VV_UW 100.0 FORMULA_0010 0.0 65535.0 /end CHARACTERISTIC
/begin CHARACTERISTIC K_ED_PT_GRB3.DEC_NACH_EINTRAG "Filterverringerung nach Fehlerspeichereintrag" VALUE 0x71A8B TKW_VV_VV_UB 100.0 FORMULA_0003 0.0 255.0 /end CHARACTERISTIC
/begin CHARACTERISTIC K_ED_PT_GRB3.DEC_VOR_EINTRAG "Filterverringerung vorm Fehlerspeichereintrag" VALUE 0x71A89 TKW_VV_VV_UB 100.0 FORMULA_0003 0.0 255.0 /end CHARACTERISTIC
/begin CHARACTERISTIC K_ED_PT_GRB3.FEHLERSCHWELLE "Filterschwelle fuer Fehlereintrag" VALUE 0x71A86 TKW_VV_VV_UB 100.0 FORMULA_0003 0.0 255.0 /end CHARACTERISTIC
/begin CHARACTERISTIC K_ED_PT_GRB3.INC_NACH_EINTRAG "Filtererhoehung nach Fehlerspeichereintrag" VALUE 0x71A8A TKW_VV_VV_UB 100.0 FORMULA_0003 0.0 255.0 /end CHARACTERISTIC
/begin CHARACTERISTIC K_ED_PT_GRB3.INC_VOR_EINTRAG "Filtererhoehung vorm Fehlerspeichereintrag" VALUE 0x71A88 TKW_VV_VV_UB 100.0 FORMULA_0003 0.0 255.0 /end CHARACTERISTIC
/begin CHARACTERISTIC K_ED_PT_GRB3.KLASSENINDEX "Auswahl der Fehlerklasse" VALUE 0x71A8C TKW_VV_VV_UB 100.0 FORMULA_0003 0.0 8.0 /end CHARACTERISTIC
/begin CHARACTERISTIC K_ED_PT_GRB3.OK_SCHWELLE "Filterschwelle fuer Fehleraustrag" VALUE 0x71A87 TKW_VV_VV_UB 100.0 FORMULA_0003 0.0 255.0 /end CHARACTERISTIC
/begin CHARACTERISTIC K_ED_PT_GRB3.P_CODE_OPENLOAD "P-Code fuer die Art OPENLOAD" VALUE 0x71A82 TKW_VV_VV_UW 100.0 FORMULA_0010 0.0 65535.0 /end CHARACTERISTIC
/begin CHARACTERISTIC K_ED_PT_GRB3.P_CODE_SH_TO_GND "P-Code fuer die Art SH_TO_GND" VALUE 0x71A80 TKW_VV_VV_UW 100.0 FORMULA_0010 0.0 65535.0 /end CHARACTERISTIC
/begin CHARACTERISTIC K_ED_PT_GRB3.P_CODE_SH_TO_UB "P-Code fuer die Art SH_TO_UB" VALUE 0x71A7E TKW_VV_VV_UW 100.0 FORMULA_0010 0.0 65535.0 /end CHARACTERISTIC
/begin CHARACTERISTIC K_ED_PT_GRB3.P_CODE_UNPLAUSIBEL "P-Code fuer die Art UNPLAUSIBEL" VALUE 0x71A84 TKW_VV_VV_UW 100.0 FORMULA_0010 0.0 65535.0 /end CHARACTERISTIC
/begin CHARACTERISTIC K_ED_PT_KKOS.DEC_NACH_EINTRAG "Filterverringerung nach Fehlerspeichereintrag" VALUE 0x70CA1 TKW_VV_VV_UB 100.0 FORMULA_0003 0.0 255.0 /end CHARACTERISTIC
/begin CHARACTERISTIC K_ED_PT_KKOS.DEC_VOR_EINTRAG "Filterverringerung vorm Fehlerspeichereintrag" VALUE 0x70C9F TKW_VV_VV_UB 100.0 FORMULA_0003 0.0 255.0 /end CHARACTERISTIC
/begin CHARACTERISTIC K_ED_PT_KKOS.FEHLERSCHWELLE "Filterschwelle fuer Fehlereintrag" VALUE 0x70C9C TKW_VV_VV_UB 100.0 FORMULA_0003 0.0 255.0 /end CHARACTERISTIC
/begin CHARACTERISTIC K_ED_PT_KKOS.INC_NACH_EINTRAG "Filtererhoehung nach Fehlerspeichereintrag" VALUE 0x70CA0 TKW_VV_VV_UB 100.0 FORMULA_0003 0.0 255.0 /end CHARACTERISTIC
/begin CHARACTERISTIC K_ED_PT_KKOS.INC_VOR_EINTRAG "Filtererhoehung vorm Fehlerspeichereintrag" VALUE 0x70C9E TKW_VV_VV_UB 100.0 FORMULA_0003 0.0 255.0 /end CHARACTERISTIC
/begin CHARACTERISTIC K_ED_PT_KKOS.KLASSENINDEX "Auswahl der Fehlerklasse" VALUE 0x70CA2 TKW_VV_VV_UB 100.0 FORMULA_0003 0.0 8.0 /end CHARACTERISTIC
/begin CHARACTERISTIC K_ED_PT_KKOS.OK_SCHWELLE "Filterschwelle fuer Fehleraustrag" VALUE 0x70C9D TKW_VV_VV_UB 100.0 FORMULA_0003 0.0 255.0 /end CHARACTERISTIC
/begin CHARACTERISTIC K_ED_PT_KKOS.P_CODE_OPENLOAD "P-Code fuer die Art OPENLOAD" VALUE 0x70C98 TKW_VV_VV_UW 100.0 FORMULA_0010 0.0 65535.0 /end CHARACTERISTIC
/begin CHARACTERISTIC K_ED_PT_KKOS.P_CODE_SH_TO_GND "P-Code fuer die Art SH_TO_GND" VALUE 0x70C96 TKW_VV_VV_UW 100.0 FORMULA_0010 0.0 65535.0 /end CHARACTERISTIC
/begin CHARACTERISTIC K_ED_PT_KKOS.P_CODE_SH_TO_UB "P-Code fuer die Art SH_TO_UB" VALUE 0x70C94 TKW_VV_VV_UW 100.0 FORMULA_0010 0.0 65535.0 /end CHARACTERISTIC
/begin CHARACTERISTIC K_ED_PT_KKOS.P_CODE_UNPLAUSIBEL "P-Code fuer die Art UNPLAUSIBEL" VALUE 0x70C9A TKW_VV_VV_UW 100.0 FORMULA_0010 0.0 65535.0 /end CHARACTERISTIC
/begin CHARACTERISTIC K_ED_PT_KLST.DEC_NACH_EINTRAG "Filterverringerung nach Fehlerspeichereintrag" VALUE 0x70C87 TKW_VV_VV_UB 100.0 FORMULA_0003 0.0 255.0 /end CHARACTERISTIC
/begin CHARACTERISTIC K_ED_PT_KLST.DEC_VOR_EINTRAG "Filterverringerung vorm Fehlerspeichereintrag" VALUE 0x70C85 TKW_VV_VV_UB 100.0 FORMULA_0003 0.0 255.0 /end CHARACTERISTIC
/begin CHARACTERISTIC K_ED_PT_KLST.FEHLERSCHWELLE "Filterschwelle fuer Fehlereintrag" VALUE 0x70C82 TKW_VV_VV_UB 100.0 FORMULA_0003 0.0 255.0 /end CHARACTERISTIC
/begin CHARACTERISTIC K_ED_PT_KLST.INC_NACH_EINTRAG "Filtererhoehung nach Fehlerspeichereintrag" VALUE 0x70C86 TKW_VV_VV_UB 100.0 FORMULA_0003 0.0 255.0 /end CHARACTERISTIC
/begin CHARACTERISTIC K_ED_PT_KLST.INC_VOR_EINTRAG "Filtererhoehung vorm Fehlerspeichereintrag" VALUE 0x70C84 TKW_VV_VV_UB 100.0 FORMULA_0003 0.0 255.0 /end CHARACTERISTIC
/begin CHARACTERISTIC K_ED_PT_KLST.KLASSENINDEX "Auswahl der Fehlerklasse" VALUE 0x70C88 TKW_VV_VV_UB 100.0 FORMULA_0003 0.0 8.0 /end CHARACTERISTIC
/begin CHARACTERISTIC K_ED_PT_KLST.OK_SCHWELLE "Filterschwelle fuer Fehleraustrag" VALUE 0x70C83 TKW_VV_VV_UB 100.0 FORMULA_0003 0.0 255.0 /end CHARACTERISTIC
/begin CHARACTERISTIC K_ED_PT_KLST.P_CODE_OPENLOAD "P-Code fuer die Art OPENLOAD" VALUE 0x70C7E TKW_VV_VV_UW 100.0 FORMULA_0010 0.0 65535.0 /end CHARACTERISTIC
/begin CHARACTERISTIC K_ED_PT_KLST.P_CODE_SH_TO_GND "P-Code fuer die Art SH_TO_GND" VALUE 0x70C7C TKW_VV_VV_UW 100.0 FORMULA_0010 0.0 65535.0 /end CHARACTERISTIC
/begin CHARACTERISTIC K_ED_PT_KLST.P_CODE_SH_TO_UB "P-Code fuer die Art SH_TO_UB" VALUE 0x70C7A TKW_VV_VV_UW 100.0 FORMULA_0010 0.0 65535.0 /end CHARACTERISTIC
/begin CHARACTERISTIC K_ED_PT_KLST.P_CODE_UNPLAUSIBEL "P-Code fuer die Art UNPLAUSIBEL" VALUE 0x70C80 TKW_VV_VV_UW 100.0 FORMULA_0010 0.0 65535.0 /end CHARACTERISTIC
/begin CHARACTERISTIC K_ED_PT_KM.DEC_NACH_EINTRAG "Filterverringerung nach Fehlerspeichereintrag" VALUE 0x714A7 TKW_VV_VV_UB 100.0 FORMULA_0003 0.0 255.0 /end CHARACTERISTIC
/begin CHARACTERISTIC K_ED_PT_KM.DEC_VOR_EINTRAG "Filterverringerung vorm Fehlerspeichereintrag" VALUE 0x714A5 TKW_VV_VV_UB 100.0 FORMULA_0003 0.0 255.0 /end CHARACTERISTIC
/begin CHARACTERISTIC K_ED_PT_KM.FEHLERSCHWELLE "Filterschwelle fuer Fehlereintrag" VALUE 0x714A2 TKW_VV_VV_UB 100.0 FORMULA_0003 0.0 255.0 /end CHARACTERISTIC
/begin CHARACTERISTIC K_ED_PT_KM.INC_NACH_EINTRAG "Filtererhoehung nach Fehlerspeichereintrag" VALUE 0x714A6 TKW_VV_VV_UB 100.0 FORMULA_0003 0.0 255.0 /end CHARACTERISTIC
/begin CHARACTERISTIC K_ED_PT_KM.INC_VOR_EINTRAG "Filtererhoehung vorm Fehlerspeichereintrag" VALUE 0x714A4 TKW_VV_VV_UB 100.0 FORMULA_0003 0.0 255.0 /end CHARACTERISTIC
/begin CHARACTERISTIC K_ED_PT_KM.KLASSENINDEX "Auswahl der Fehlerklasse" VALUE 0x714A8 TKW_VV_VV_UB 100.0 FORMULA_0003 0.0 8.0 /end CHARACTERISTIC
/begin CHARACTERISTIC K_ED_PT_KM.OK_SCHWELLE "Filterschwelle fuer Fehleraustrag" VALUE 0x714A3 TKW_VV_VV_UB 100.0 FORMULA_0003 0.0 255.0 /end CHARACTERISTIC
/begin CHARACTERISTIC K_ED_PT_KM.P_CODE_OPENLOAD "P-Code fuer die Art OPENLOAD" VALUE 0x7149E TKW_VV_VV_UW 100.0 FORMULA_0010 0.0 65535.0 /end CHARACTERISTIC
/begin CHARACTERISTIC K_ED_PT_KM.P_CODE_SH_TO_GND "P-Code fuer die Art SH_TO_GND" VALUE 0x7149C TKW_VV_VV_UW 100.0 FORMULA_0010 0.0 65535.0 /end CHARACTERISTIC
/begin CHARACTERISTIC K_ED_PT_KM.P_CODE_SH_TO_UB "P-Code fuer die Art SH_TO_UB" VALUE 0x7149A TKW_VV_VV_UW 100.0 FORMULA_0010 0.0 65535.0 /end CHARACTERISTIC
/begin CHARACTERISTIC K_ED_PT_KM.P_CODE_UNPLAUSIBEL "P-Code fuer die Art UNPLAUSIBEL" VALUE 0x714A0 TKW_VV_VV_UW 100.0 FORMULA_0010 0.0 65535.0 /end CHARACTERISTIC
/begin CHARACTERISTIC K_ED_PT_KOMBI.DEC_NACH_EINTRAG "Filterverringerung nach Fehlerspeichereintrag" VALUE 0x714C1 TKW_VV_VV_UB 100.0 FORMULA_0003 0.0 255.0 /end CHARACTERISTIC
/begin CHARACTERISTIC K_ED_PT_KOMBI.DEC_VOR_EINTRAG "Filterverringerung vorm Fehlerspeichereintrag" VALUE 0x714BF TKW_VV_VV_UB 100.0 FORMULA_0003 0.0 255.0 /end CHARACTERISTIC
/begin CHARACTERISTIC K_ED_PT_KOMBI.FEHLERSCHWELLE "Filterschwelle fuer Fehlereintrag" VALUE 0x714BC TKW_VV_VV_UB 100.0 FORMULA_0003 0.0 255.0 /end CHARACTERISTIC
/begin CHARACTERISTIC K_ED_PT_KOMBI.INC_NACH_EINTRAG "Filtererhoehung nach Fehlerspeichereintrag" VALUE 0x714C0 TKW_VV_VV_UB 100.0 FORMULA_0003 0.0 255.0 /end CHARACTERISTIC
/begin CHARACTERISTIC K_ED_PT_KOMBI.INC_VOR_EINTRAG "Filtererhoehung vorm Fehlerspeichereintrag" VALUE 0x714BE TKW_VV_VV_UB 100.0 FORMULA_0003 0.0 255.0 /end CHARACTERISTIC
/begin CHARACTERISTIC K_ED_PT_KOMBI.KLASSENINDEX "Auswahl der Fehlerklasse" VALUE 0x714C2 TKW_VV_VV_UB 100.0 FORMULA_0003 0.0 8.0 /end CHARACTERISTIC
/begin CHARACTERISTIC K_ED_PT_KOMBI.OK_SCHWELLE "Filterschwelle fuer Fehleraustrag" VALUE 0x714BD TKW_VV_VV_UB 100.0 FORMULA_0003 0.0 255.0 /end CHARACTERISTIC
/begin CHARACTERISTIC K_ED_PT_KOMBI.P_CODE_OPENLOAD "P-Code fuer die Art OPENLOAD" VALUE 0x714B8 TKW_VV_VV_UW 100.0 FORMULA_0010 0.0 65535.0 /end CHARACTERISTIC
/begin CHARACTERISTIC K_ED_PT_KOMBI.P_CODE_SH_TO_GND "P-Code fuer die Art SH_TO_GND" VALUE 0x714B6 TKW_VV_VV_UW 100.0 FORMULA_0010 0.0 65535.0 /end CHARACTERISTIC
/begin CHARACTERISTIC K_ED_PT_KOMBI.P_CODE_SH_TO_UB "P-Code fuer die Art SH_TO_UB" VALUE 0x714B4 TKW_VV_VV_UW 100.0 FORMULA_0010 0.0 65535.0 /end CHARACTERISTIC
/begin CHARACTERISTIC K_ED_PT_KOMBI.P_CODE_UNPLAUSIBEL "P-Code fuer die Art UNPLAUSIBEL" VALUE 0x714BA TKW_VV_VV_UW 100.0 FORMULA_0010 0.0 65535.0 /end CHARACTERISTIC
/begin CHARACTERISTIC K_ED_PT_LRW.DEC_NACH_EINTRAG "Filterverringerung nach Fehlerspeichereintrag" VALUE 0x70CBB TKW_VV_VV_UB 100.0 FORMULA_0003 0.0 255.0 /end CHARACTERISTIC
/begin CHARACTERISTIC K_ED_PT_LRW.DEC_VOR_EINTRAG "Filterverringerung vorm Fehlerspeichereintrag" VALUE 0x70CB9 TKW_VV_VV_UB 100.0 FORMULA_0003 0.0 255.0 /end CHARACTERISTIC
/begin CHARACTERISTIC K_ED_PT_LRW.FEHLERSCHWELLE "Filterschwelle fuer Fehlereintrag" VALUE 0x70CB6 TKW_VV_VV_UB 100.0 FORMULA_0003 0.0 255.0 /end CHARACTERISTIC
/begin CHARACTERISTIC K_ED_PT_LRW.INC_NACH_EINTRAG "Filtererhoehung nach Fehlerspeichereintrag" VALUE 0x70CBA TKW_VV_VV_UB 100.0 FORMULA_0003 0.0 255.0 /end CHARACTERISTIC
/begin CHARACTERISTIC K_ED_PT_LRW.INC_VOR_EINTRAG "Filtererhoehung vorm Fehlerspeichereintrag" VALUE 0x70CB8 TKW_VV_VV_UB 100.0 FORMULA_0003 0.0 255.0 /end CHARACTERISTIC
/begin CHARACTERISTIC K_ED_PT_LRW.KLASSENINDEX "Auswahl der Fehlerklasse" VALUE 0x70CBC TKW_VV_VV_UB 100.0 FORMULA_0003 0.0 8.0 /end CHARACTERISTIC
/begin CHARACTERISTIC K_ED_PT_LRW.OK_SCHWELLE "Filterschwelle fuer Fehleraustrag" VALUE 0x70CB7 TKW_VV_VV_UB 100.0 FORMULA_0003 0.0 255.0 /end CHARACTERISTIC
/begin CHARACTERISTIC K_ED_PT_LRW.P_CODE_OPENLOAD "P-Code fuer die Art OPENLOAD" VALUE 0x70CB2 TKW_VV_VV_UW 100.0 FORMULA_0010 0.0 65535.0 /end CHARACTERISTIC
/begin CHARACTERISTIC K_ED_PT_LRW.P_CODE_SH_TO_GND "P-Code fuer die Art SH_TO_GND" VALUE 0x70CB0 TKW_VV_VV_UW 100.0 FORMULA_0010 0.0 65535.0 /end CHARACTERISTIC
/begin CHARACTERISTIC K_ED_PT_LRW.P_CODE_SH_TO_UB "P-Code fuer die Art SH_TO_UB" VALUE 0x70CAE TKW_VV_VV_UW 100.0 FORMULA_0010 0.0 65535.0 /end CHARACTERISTIC
/begin CHARACTERISTIC K_ED_PT_LRW.P_CODE_UNPLAUSIBEL "P-Code fuer die Art UNPLAUSIBEL" VALUE 0x70CB4 TKW_VV_VV_UW 100.0 FORMULA_0010 0.0 65535.0 /end CHARACTERISTIC
/begin CHARACTERISTIC K_ED_PT_STATANH.DEC_NACH_EINTRAG "Filterverringerung nach Fehlerspeichereintrag" VALUE 0x71A09 TKW_VV_VV_UB 100.0 FORMULA_0003 0.0 255.0 /end CHARACTERISTIC
/begin CHARACTERISTIC K_ED_PT_STATANH.DEC_VOR_EINTRAG "Filterverringerung vorm Fehlerspeichereintrag" VALUE 0x71A07 TKW_VV_VV_UB 100.0 FORMULA_0003 0.0 255.0 /end CHARACTERISTIC
/begin CHARACTERISTIC K_ED_PT_STATANH.FEHLERSCHWELLE "Filterschwelle fuer Fehlereintrag" VALUE 0x71A04 TKW_VV_VV_UB 100.0 FORMULA_0003 0.0 255.0 /end CHARACTERISTIC
/begin CHARACTERISTIC K_ED_PT_STATANH.INC_NACH_EINTRAG "Filtererhoehung nach Fehlerspeichereintrag" VALUE 0x71A08 TKW_VV_VV_UB 100.0 FORMULA_0003 0.0 255.0 /end CHARACTERISTIC
/begin CHARACTERISTIC K_ED_PT_STATANH.INC_VOR_EINTRAG "Filtererhoehung vorm Fehlerspeichereintrag" VALUE 0x71A06 TKW_VV_VV_UB 100.0 FORMULA_0003 0.0 255.0 /end CHARACTERISTIC
/begin CHARACTERISTIC K_ED_PT_STATANH.KLASSENINDEX "Auswahl der Fehlerklasse" VALUE 0x71A0A TKW_VV_VV_UB 100.0 FORMULA_0003 0.0 8.0 /end CHARACTERISTIC
/begin CHARACTERISTIC K_ED_PT_STATANH.OK_SCHWELLE "Filterschwelle fuer Fehleraustrag" VALUE 0x71A05 TKW_VV_VV_UB 100.0 FORMULA_0003 0.0 255.0 /end CHARACTERISTIC
/begin CHARACTERISTIC K_ED_PT_STATANH.P_CODE_OPENLOAD "P-Code fuer die Art OPENLOAD" VALUE 0x71A00 TKW_VV_VV_UW 100.0 FORMULA_0010 0.0 65535.0 /end CHARACTERISTIC
/begin CHARACTERISTIC K_ED_PT_STATANH.P_CODE_SH_TO_GND "P-Code fuer die Art SH_TO_GND" VALUE 0x719FE TKW_VV_VV_UW 100.0 FORMULA_0010 0.0 65535.0 /end CHARACTERISTIC
/begin CHARACTERISTIC K_ED_PT_STATANH.P_CODE_SH_TO_UB "P-Code fuer die Art SH_TO_UB" VALUE 0x719FC TKW_VV_VV_UW 100.0 FORMULA_0010 0.0 65535.0 /end CHARACTERISTIC
/begin CHARACTERISTIC K_ED_PT_STATANH.P_CODE_UNPLAUSIBEL "P-Code fuer die Art UNPLAUSIBEL" VALUE 0x71A02 TKW_VV_VV_UW 100.0 FORMULA_0010 0.0 65535.0 /end CHARACTERISTIC
/begin CHARACTERISTIC K_ED_PT_STATDKG.DEC_NACH_EINTRAG "Filterverringerung nach Fehlerspeichereintrag" VALUE 0x70A99 TKW_VV_VV_UB 100.0 FORMULA_0003 0.0 255.0 /end CHARACTERISTIC
/begin CHARACTERISTIC K_ED_PT_STATDKG.DEC_VOR_EINTRAG "Filterverringerung vorm Fehlerspeichereintrag" VALUE 0x70A97 TKW_VV_VV_UB 100.0 FORMULA_0003 0.0 255.0 /end CHARACTERISTIC
/begin CHARACTERISTIC K_ED_PT_STATDKG.FEHLERSCHWELLE "Filterschwelle fuer Fehlereintrag" VALUE 0x70A94 TKW_VV_VV_UB 100.0 FORMULA_0003 0.0 255.0 /end CHARACTERISTIC
/begin CHARACTERISTIC K_ED_PT_STATDKG.INC_NACH_EINTRAG "Filtererhoehung nach Fehlerspeichereintrag" VALUE 0x70A98 TKW_VV_VV_UB 100.0 FORMULA_0003 0.0 255.0 /end CHARACTERISTIC
/begin CHARACTERISTIC K_ED_PT_STATDKG.INC_VOR_EINTRAG "Filtererhoehung vorm Fehlerspeichereintrag" VALUE 0x70A96 TKW_VV_VV_UB 100.0 FORMULA_0003 0.0 255.0 /end CHARACTERISTIC
/begin CHARACTERISTIC K_ED_PT_STATDKG.KLASSENINDEX "Auswahl der Fehlerklasse" VALUE 0x70A9A TKW_VV_VV_UB 100.0 FORMULA_0003 0.0 8.0 /end CHARACTERISTIC
/begin CHARACTERISTIC K_ED_PT_STATDKG.OK_SCHWELLE "Filterschwelle fuer Fehleraustrag" VALUE 0x70A95 TKW_VV_VV_UB 100.0 FORMULA_0003 0.0 255.0 /end CHARACTERISTIC
/begin CHARACTERISTIC K_ED_PT_STATDKG.P_CODE_OPENLOAD "P-Code fuer die Art OPENLOAD" VALUE 0x70A90 TKW_VV_VV_UW 100.0 FORMULA_0010 0.0 65535.0 /end CHARACTERISTIC
/begin CHARACTERISTIC K_ED_PT_STATDKG.P_CODE_SH_TO_GND "P-Code fuer die Art SH_TO_GND" VALUE 0x70A8E TKW_VV_VV_UW 100.0 FORMULA_0010 0.0 65535.0 /end CHARACTERISTIC
/begin CHARACTERISTIC K_ED_PT_STATDKG.P_CODE_SH_TO_UB "P-Code fuer die Art SH_TO_UB" VALUE 0x70A8C TKW_VV_VV_UW 100.0 FORMULA_0010 0.0 65535.0 /end CHARACTERISTIC
/begin CHARACTERISTIC K_ED_PT_STATDKG.P_CODE_UNPLAUSIBEL "P-Code fuer die Art UNPLAUSIBEL" VALUE 0x70A92 TKW_VV_VV_UW 100.0 FORMULA_0010 0.0 65535.0 /end CHARACTERISTIC
/begin CHARACTERISTIC K_ED_PT_STATR.DEC_NACH_EINTRAG "Filterverringerung nach Fehlerspeichereintrag" VALUE 0x70ACD TKW_VV_VV_UB 100.0 FORMULA_0003 0.0 255.0 /end CHARACTERISTIC
/begin CHARACTERISTIC K_ED_PT_STATR.DEC_VOR_EINTRAG "Filterverringerung vorm Fehlerspeichereintrag" VALUE 0x70ACB TKW_VV_VV_UB 100.0 FORMULA_0003 0.0 255.0 /end CHARACTERISTIC
/begin CHARACTERISTIC K_ED_PT_STATR.FEHLERSCHWELLE "Filterschwelle fuer Fehlereintrag" VALUE 0x70AC8 TKW_VV_VV_UB 100.0 FORMULA_0003 0.0 255.0 /end CHARACTERISTIC
/begin CHARACTERISTIC K_ED_PT_STATR.INC_NACH_EINTRAG "Filtererhoehung nach Fehlerspeichereintrag" VALUE 0x70ACC TKW_VV_VV_UB 100.0 FORMULA_0003 0.0 255.0 /end CHARACTERISTIC
/begin CHARACTERISTIC K_ED_PT_STATR.INC_VOR_EINTRAG "Filtererhoehung vorm Fehlerspeichereintrag" VALUE 0x70ACA TKW_VV_VV_UB 100.0 FORMULA_0003 0.0 255.0 /end CHARACTERISTIC
/begin CHARACTERISTIC K_ED_PT_STATR.KLASSENINDEX "Auswahl der Fehlerklasse" VALUE 0x70ACE TKW_VV_VV_UB 100.0 FORMULA_0003 0.0 8.0 /end CHARACTERISTIC
/begin CHARACTERISTIC K_ED_PT_STATR.OK_SCHWELLE "Filterschwelle fuer Fehleraustrag" VALUE 0x70AC9 TKW_VV_VV_UB 100.0 FORMULA_0003 0.0 255.0 /end CHARACTERISTIC
/begin CHARACTERISTIC K_ED_PT_STATR.P_CODE_OPENLOAD "P-Code fuer die Art OPENLOAD" VALUE 0x70AC4 TKW_VV_VV_UW 100.0 FORMULA_0010 0.0 65535.0 /end CHARACTERISTIC
/begin CHARACTERISTIC K_ED_PT_STATR.P_CODE_SH_TO_GND "P-Code fuer die Art SH_TO_GND" VALUE 0x70AC2 TKW_VV_VV_UW 100.0 FORMULA_0010 0.0 65535.0 /end CHARACTERISTIC
/begin CHARACTERISTIC K_ED_PT_STATR.P_CODE_SH_TO_UB "P-Code fuer die Art SH_TO_UB" VALUE 0x70AC0 TKW_VV_VV_UW 100.0 FORMULA_0010 0.0 65535.0 /end CHARACTERISTIC
/begin CHARACTERISTIC K_ED_PT_STATR.P_CODE_UNPLAUSIBEL "P-Code fuer die Art UNPLAUSIBEL" VALUE 0x70AC6 TKW_VV_VV_UW 100.0 FORMULA_0010 0.0 65535.0 /end CHARACTERISTIC
/begin CHARACTERISTIC K_ED_PT_STDSC.DEC_NACH_EINTRAG "Filterverringerung nach Fehlerspeichereintrag" VALUE 0x70C1F TKW_VV_VV_UB 100.0 FORMULA_0003 0.0 255.0 /end CHARACTERISTIC
/begin CHARACTERISTIC K_ED_PT_STDSC.DEC_VOR_EINTRAG "Filterverringerung vorm Fehlerspeichereintrag" VALUE 0x70C1D TKW_VV_VV_UB 100.0 FORMULA_0003 0.0 255.0 /end CHARACTERISTIC
/begin CHARACTERISTIC K_ED_PT_STDSC.FEHLERSCHWELLE "Filterschwelle fuer Fehlereintrag" VALUE 0x70C1A TKW_VV_VV_UB 100.0 FORMULA_0003 0.0 255.0 /end CHARACTERISTIC
/begin CHARACTERISTIC K_ED_PT_STDSC.INC_NACH_EINTRAG "Filtererhoehung nach Fehlerspeichereintrag" VALUE 0x70C1E TKW_VV_VV_UB 100.0 FORMULA_0003 0.0 255.0 /end CHARACTERISTIC
/begin CHARACTERISTIC K_ED_PT_STDSC.INC_VOR_EINTRAG "Filtererhoehung vorm Fehlerspeichereintrag" VALUE 0x70C1C TKW_VV_VV_UB 100.0 FORMULA_0003 0.0 255.0 /end CHARACTERISTIC
/begin CHARACTERISTIC K_ED_PT_STDSC.KLASSENINDEX "Auswahl der Fehlerklasse" VALUE 0x70C20 TKW_VV_VV_UB 100.0 FORMULA_0003 0.0 8.0 /end CHARACTERISTIC
/begin CHARACTERISTIC K_ED_PT_STDSC.OK_SCHWELLE "Filterschwelle fuer Fehleraustrag" VALUE 0x70C1B TKW_VV_VV_UB 100.0 FORMULA_0003 0.0 255.0 /end CHARACTERISTIC
/begin CHARACTERISTIC K_ED_PT_STDSC.P_CODE_OPENLOAD "P-Code fuer die Art OPENLOAD" VALUE 0x70C16 TKW_VV_VV_UW 100.0 FORMULA_0010 0.0 65535.0 /end CHARACTERISTIC
/begin CHARACTERISTIC K_ED_PT_STDSC.P_CODE_SH_TO_GND "P-Code fuer die Art SH_TO_GND" VALUE 0x70C14 TKW_VV_VV_UW 100.0 FORMULA_0010 0.0 65535.0 /end CHARACTERISTIC
/begin CHARACTERISTIC K_ED_PT_STDSC.P_CODE_SH_TO_UB "P-Code fuer die Art SH_TO_UB" VALUE 0x70C12 TKW_VV_VV_UW 100.0 FORMULA_0010 0.0 65535.0 /end CHARACTERISTIC
/begin CHARACTERISTIC K_ED_PT_STDSC.P_CODE_UNPLAUSIBEL "P-Code fuer die Art UNPLAUSIBEL" VALUE 0x70C18 TKW_VV_VV_UW 100.0 FORMULA_0010 0.0 65535.0 /end CHARACTERISTIC
/begin CHARACTERISTIC K_ED_PT_TOMA.DEC_NACH_EINTRAG "Filterverringerung nach Fehlerspeichereintrag" VALUE 0x71AF3 TKW_VV_VV_UB 100.0 FORMULA_0003 0.0 255.0 /end CHARACTERISTIC
/begin CHARACTERISTIC K_ED_PT_TOMA.DEC_VOR_EINTRAG "Filterverringerung vorm Fehlerspeichereintrag" VALUE 0x71AF1 TKW_VV_VV_UB 100.0 FORMULA_0003 0.0 255.0 /end CHARACTERISTIC
/begin CHARACTERISTIC K_ED_PT_TOMA.FEHLERSCHWELLE "Filterschwelle fuer Fehlereintrag" VALUE 0x71AEE TKW_VV_VV_UB 100.0 FORMULA_0003 0.0 255.0 /end CHARACTERISTIC
/begin CHARACTERISTIC K_ED_PT_TOMA.INC_NACH_EINTRAG "Filtererhoehung nach Fehlerspeichereintrag" VALUE 0x71AF2 TKW_VV_VV_UB 100.0 FORMULA_0003 0.0 255.0 /end CHARACTERISTIC
/begin CHARACTERISTIC K_ED_PT_TOMA.INC_VOR_EINTRAG "Filtererhoehung vorm Fehlerspeichereintrag" VALUE 0x71AF0 TKW_VV_VV_UB 100.0 FORMULA_0003 0.0 255.0 /end CHARACTERISTIC
/begin CHARACTERISTIC K_ED_PT_TOMA.KLASSENINDEX "Auswahl der Fehlerklasse" VALUE 0x71AF4 TKW_VV_VV_UB 100.0 FORMULA_0003 0.0 8.0 /end CHARACTERISTIC
/begin CHARACTERISTIC K_ED_PT_TOMA.OK_SCHWELLE "Filterschwelle fuer Fehleraustrag" VALUE 0x71AEF TKW_VV_VV_UB 100.0 FORMULA_0003 0.0 255.0 /end CHARACTERISTIC
/begin CHARACTERISTIC K_ED_PT_TOMA.P_CODE_OPENLOAD "P-Code fuer die Art OPENLOAD" VALUE 0x71AEA TKW_VV_VV_UW 100.0 FORMULA_0010 0.0 65535.0 /end CHARACTERISTIC
/begin CHARACTERISTIC K_ED_PT_TOMA.P_CODE_SH_TO_GND "P-Code fuer die Art SH_TO_GND" VALUE 0x71AE8 TKW_VV_VV_UW 100.0 FORMULA_0010 0.0 65535.0 /end CHARACTERISTIC
/begin CHARACTERISTIC K_ED_PT_TOMA.P_CODE_SH_TO_UB "P-Code fuer die Art SH_TO_UB" VALUE 0x71AE6 TKW_VV_VV_UW 100.0 FORMULA_0010 0.0 65535.0 /end CHARACTERISTIC
/begin CHARACTERISTIC K_ED_PT_TOMA.P_CODE_UNPLAUSIBEL "P-Code fuer die Art UNPLAUSIBEL" VALUE 0x71AEC TKW_VV_VV_UW 100.0 FORMULA_0010 0.0 65535.0 /end CHARACTERISTIC
/begin CHARACTERISTIC K_ED_PT_TORQDSC.DEC_NACH_EINTRAG "Filterverringerung nach Fehlerspeichereintrag" VALUE 0x70C05 TKW_VV_VV_UB 100.0 FORMULA_0003 0.0 255.0 /end CHARACTERISTIC
/begin CHARACTERISTIC K_ED_PT_TORQDSC.DEC_VOR_EINTRAG "Filterverringerung vorm Fehlerspeichereintrag" VALUE 0x70C03 TKW_VV_VV_UB 100.0 FORMULA_0003 0.0 255.0 /end CHARACTERISTIC
/begin CHARACTERISTIC K_ED_PT_TORQDSC.FEHLERSCHWELLE "Filterschwelle fuer Fehlereintrag" VALUE 0x70C00 TKW_VV_VV_UB 100.0 FORMULA_0003 0.0 255.0 /end CHARACTERISTIC
/begin CHARACTERISTIC K_ED_PT_TORQDSC.INC_NACH_EINTRAG "Filtererhoehung nach Fehlerspeichereintrag" VALUE 0x70C04 TKW_VV_VV_UB 100.0 FORMULA_0003 0.0 255.0 /end CHARACTERISTIC
/begin CHARACTERISTIC K_ED_PT_TORQDSC.INC_VOR_EINTRAG "Filtererhoehung vorm Fehlerspeichereintrag" VALUE 0x70C02 TKW_VV_VV_UB 100.0 FORMULA_0003 0.0 255.0 /end CHARACTERISTIC
/begin CHARACTERISTIC K_ED_PT_TORQDSC.KLASSENINDEX "Auswahl der Fehlerklasse" VALUE 0x70C06 TKW_VV_VV_UB 100.0 FORMULA_0003 0.0 8.0 /end CHARACTERISTIC
/begin CHARACTERISTIC K_ED_PT_TORQDSC.OK_SCHWELLE "Filterschwelle fuer Fehleraustrag" VALUE 0x70C01 TKW_VV_VV_UB 100.0 FORMULA_0003 0.0 255.0 /end CHARACTERISTIC
/begin CHARACTERISTIC K_ED_PT_TORQDSC.P_CODE_OPENLOAD "P-Code fuer die Art OPENLOAD" VALUE 0x70BFC TKW_VV_VV_UW 100.0 FORMULA_0010 0.0 65535.0 /end CHARACTERISTIC
/begin CHARACTERISTIC K_ED_PT_TORQDSC.P_CODE_SH_TO_GND "P-Code fuer die Art SH_TO_GND" VALUE 0x70BFA TKW_VV_VV_UW 100.0 FORMULA_0010 0.0 65535.0 /end CHARACTERISTIC
/begin CHARACTERISTIC K_ED_PT_TORQDSC.P_CODE_SH_TO_UB "P-Code fuer die Art SH_TO_UB" VALUE 0x70BF8 TKW_VV_VV_UW 100.0 FORMULA_0010 0.0 65535.0 /end CHARACTERISTIC
/begin CHARACTERISTIC K_ED_PT_TORQDSC.P_CODE_UNPLAUSIBEL "P-Code fuer die Art UNPLAUSIBEL" VALUE 0x70BFE TKW_VV_VV_UW 100.0 FORMULA_0010 0.0 65535.0 /end CHARACTERISTIC
/begin CHARACTERISTIC K_ED_PT_VEHMOD.DEC_NACH_EINTRAG "Filterverringerung nach Fehlerspeichereintrag" VALUE 0x71307 TKW_VV_VV_UB 100.0 FORMULA_0003 0.0 255.0 /end CHARACTERISTIC
/begin CHARACTERISTIC K_ED_PT_VEHMOD.DEC_VOR_EINTRAG "Filterverringerung vorm Fehlerspeichereintrag" VALUE 0x71305 TKW_VV_VV_UB 100.0 FORMULA_0003 0.0 255.0 /end CHARACTERISTIC
/begin CHARACTERISTIC K_ED_PT_VEHMOD.FEHLERSCHWELLE "Filterschwelle fuer Fehlereintrag" VALUE 0x71302 TKW_VV_VV_UB 100.0 FORMULA_0003 0.0 255.0 /end CHARACTERISTIC
/begin CHARACTERISTIC K_ED_PT_VEHMOD.INC_NACH_EINTRAG "Filtererhoehung nach Fehlerspeichereintrag" VALUE 0x71306 TKW_VV_VV_UB 100.0 FORMULA_0003 0.0 255.0 /end CHARACTERISTIC
/begin CHARACTERISTIC K_ED_PT_VEHMOD.INC_VOR_EINTRAG "Filtererhoehung vorm Fehlerspeichereintrag" VALUE 0x71304 TKW_VV_VV_UB 100.0 FORMULA_0003 0.0 255.0 /end CHARACTERISTIC
/begin CHARACTERISTIC K_ED_PT_VEHMOD.KLASSENINDEX "Auswahl der Fehlerklasse" VALUE 0x71308 TKW_VV_VV_UB 100.0 FORMULA_0003 0.0 8.0 /end CHARACTERISTIC
/begin CHARACTERISTIC K_ED_PT_VEHMOD.OK_SCHWELLE "Filterschwelle fuer Fehleraustrag" VALUE 0x71303 TKW_VV_VV_UB 100.0 FORMULA_0003 0.0 255.0 /end CHARACTERISTIC
/begin CHARACTERISTIC K_ED_PT_VEHMOD.P_CODE_OPENLOAD "P-Code fuer die Art OPENLOAD" VALUE 0x712FE TKW_VV_VV_UW 100.0 FORMULA_0010 0.0 65535.0 /end CHARACTERISTIC
/begin CHARACTERISTIC K_ED_PT_VEHMOD.P_CODE_SH_TO_GND "P-Code fuer die Art SH_TO_GND" VALUE 0x712FC TKW_VV_VV_UW 100.0 FORMULA_0010 0.0 65535.0 /end CHARACTERISTIC
/begin CHARACTERISTIC K_ED_PT_VEHMOD.P_CODE_SH_TO_UB "P-Code fuer die Art SH_TO_UB" VALUE 0x712FA TKW_VV_VV_UW 100.0 FORMULA_0010 0.0 65535.0 /end CHARACTERISTIC
/begin CHARACTERISTIC K_ED_PT_VEHMOD.P_CODE_UNPLAUSIBEL "P-Code fuer die Art UNPLAUSIBEL" VALUE 0x71300 TKW_VV_VV_UW 100.0 FORMULA_0010 0.0 65535.0 /end CHARACTERISTIC
/begin CHARACTERISTIC K_ED_PT_VFZG.DEC_NACH_EINTRAG "Filterverringerung nach Fehlerspeichereintrag" VALUE 0x70C53 TKW_VV_VV_UB 100.0 FORMULA_0003 0.0 255.0 /end CHARACTERISTIC
/begin CHARACTERISTIC K_ED_PT_VFZG.DEC_VOR_EINTRAG "Filterverringerung vorm Fehlerspeichereintrag" VALUE 0x70C51 TKW_VV_VV_UB 100.0 FORMULA_0003 0.0 255.0 /end CHARACTERISTIC
/begin CHARACTERISTIC K_ED_PT_VFZG.FEHLERSCHWELLE "Filterschwelle fuer Fehlereintrag" VALUE 0x70C4E TKW_VV_VV_UB 100.0 FORMULA_0003 0.0 255.0 /end CHARACTERISTIC
/begin CHARACTERISTIC K_ED_PT_VFZG.INC_NACH_EINTRAG "Filtererhoehung nach Fehlerspeichereintrag" VALUE 0x70C52 TKW_VV_VV_UB 100.0 FORMULA_0003 0.0 255.0 /end CHARACTERISTIC
/begin CHARACTERISTIC K_ED_PT_VFZG.INC_VOR_EINTRAG "Filtererhoehung vorm Fehlerspeichereintrag" VALUE 0x70C50 TKW_VV_VV_UB 100.0 FORMULA_0003 0.0 255.0 /end CHARACTERISTIC
/begin CHARACTERISTIC K_ED_PT_VFZG.KLASSENINDEX "Auswahl der Fehlerklasse" VALUE 0x70C54 TKW_VV_VV_UB 100.0 FORMULA_0003 0.0 8.0 /end CHARACTERISTIC
/begin CHARACTERISTIC K_ED_PT_VFZG.OK_SCHWELLE "Filterschwelle fuer Fehleraustrag" VALUE 0x70C4F TKW_VV_VV_UB 100.0 FORMULA_0003 0.0 255.0 /end CHARACTERISTIC
/begin CHARACTERISTIC K_ED_PT_VFZG.P_CODE_OPENLOAD "P-Code fuer die Art OPENLOAD" VALUE 0x70C4A TKW_VV_VV_UW 100.0 FORMULA_0010 0.0 65535.0 /end CHARACTERISTIC
/begin CHARACTERISTIC K_ED_PT_VFZG.P_CODE_SH_TO_GND "P-Code fuer die Art SH_TO_GND" VALUE 0x70C48 TKW_VV_VV_UW 100.0 FORMULA_0010 0.0 65535.0 /end CHARACTERISTIC
/begin CHARACTERISTIC K_ED_PT_VFZG.P_CODE_SH_TO_UB "P-Code fuer die Art SH_TO_UB" VALUE 0x70C46 TKW_VV_VV_UW 100.0 FORMULA_0010 0.0 65535.0 /end CHARACTERISTIC
/begin CHARACTERISTIC K_ED_PT_VFZG.P_CODE_UNPLAUSIBEL "P-Code fuer die Art UNPLAUSIBEL" VALUE 0x70C4C TKW_VV_VV_UW 100.0 FORMULA_0010 0.0 65535.0 /end CHARACTERISTIC
/begin CHARACTERISTIC K_ED_PT_VRAD.DEC_NACH_EINTRAG "Filterverringerung nach Fehlerspeichereintrag" VALUE 0x70C39 TKW_VV_VV_UB 100.0 FORMULA_0003 0.0 255.0 /end CHARACTERISTIC
/begin CHARACTERISTIC K_ED_PT_VRAD.DEC_VOR_EINTRAG "Filterverringerung vorm Fehlerspeichereintrag" VALUE 0x70C37 TKW_VV_VV_UB 100.0 FORMULA_0003 0.0 255.0 /end CHARACTERISTIC
/begin CHARACTERISTIC K_ED_PT_VRAD.FEHLERSCHWELLE "Filterschwelle fuer Fehlereintrag" VALUE 0x70C34 TKW_VV_VV_UB 100.0 FORMULA_0003 0.0 255.0 /end CHARACTERISTIC
/begin CHARACTERISTIC K_ED_PT_VRAD.INC_NACH_EINTRAG "Filtererhoehung nach Fehlerspeichereintrag" VALUE 0x70C38 TKW_VV_VV_UB 100.0 FORMULA_0003 0.0 255.0 /end CHARACTERISTIC
/begin CHARACTERISTIC K_ED_PT_VRAD.INC_VOR_EINTRAG "Filtererhoehung vorm Fehlerspeichereintrag" VALUE 0x70C36 TKW_VV_VV_UB 100.0 FORMULA_0003 0.0 255.0 /end CHARACTERISTIC
/begin CHARACTERISTIC K_ED_PT_VRAD.KLASSENINDEX "Auswahl der Fehlerklasse" VALUE 0x70C3A TKW_VV_VV_UB 100.0 FORMULA_0003 0.0 8.0 /end CHARACTERISTIC
/begin CHARACTERISTIC K_ED_PT_VRAD.OK_SCHWELLE "Filterschwelle fuer Fehleraustrag" VALUE 0x70C35 TKW_VV_VV_UB 100.0 FORMULA_0003 0.0 255.0 /end CHARACTERISTIC
/begin CHARACTERISTIC K_ED_PT_VRAD.P_CODE_OPENLOAD "P-Code fuer die Art OPENLOAD" VALUE 0x70C30 TKW_VV_VV_UW 100.0 FORMULA_0010 0.0 65535.0 /end CHARACTERISTIC
/begin CHARACTERISTIC K_ED_PT_VRAD.P_CODE_SH_TO_GND "P-Code fuer die Art SH_TO_GND" VALUE 0x70C2E TKW_VV_VV_UW 100.0 FORMULA_0010 0.0 65535.0 /end CHARACTERISTIC
/begin CHARACTERISTIC K_ED_PT_VRAD.P_CODE_SH_TO_UB "P-Code fuer die Art SH_TO_UB" VALUE 0x70C2C TKW_VV_VV_UW 100.0 FORMULA_0010 0.0 65535.0 /end CHARACTERISTIC
/begin CHARACTERISTIC K_ED_PT_VRAD.P_CODE_UNPLAUSIBEL "P-Code fuer die Art UNPLAUSIBEL" VALUE 0x70C32 TKW_VV_VV_UW 100.0 FORMULA_0010 0.0 65535.0 /end CHARACTERISTIC
/begin CHARACTERISTIC K_ED_PUMG.DEC_NACH_EINTRAG "Filterverringerung nach Fehlerspeichereintrag" VALUE 0x708F9 TKW_VV_VV_UB 100.0 FORMULA_0003 0.0 255.0 /end CHARACTERISTIC
/begin CHARACTERISTIC K_ED_PUMG.DEC_VOR_EINTRAG "Filterverringerung vorm Fehlerspeichereintrag" VALUE 0x708F7 TKW_VV_VV_UB 100.0 FORMULA_0003 0.0 255.0 /end CHARACTERISTIC
/begin CHARACTERISTIC K_ED_PUMG.FEHLERSCHWELLE "Filterschwelle fuer Fehlereintrag" VALUE 0x708F4 TKW_VV_VV_UB 100.0 FORMULA_0003 0.0 255.0 /end CHARACTERISTIC
/begin CHARACTERISTIC K_ED_PUMG.INC_NACH_EINTRAG "Filtererhoehung nach Fehlerspeichereintrag" VALUE 0x708F8 TKW_VV_VV_UB 100.0 FORMULA_0003 0.0 255.0 /end CHARACTERISTIC
/begin CHARACTERISTIC K_ED_PUMG.INC_VOR_EINTRAG "Filtererhoehung vorm Fehlerspeichereintrag" VALUE 0x708F6 TKW_VV_VV_UB 100.0 FORMULA_0003 0.0 255.0 /end CHARACTERISTIC
/begin CHARACTERISTIC K_ED_PUMG.KLASSENINDEX "Auswahl der Fehlerklasse" VALUE 0x708FA TKW_VV_VV_UB 100.0 FORMULA_0003 0.0 8.0 /end CHARACTERISTIC
/begin CHARACTERISTIC K_ED_PUMG.OK_SCHWELLE "Filterschwelle fuer Fehleraustrag" VALUE 0x708F5 TKW_VV_VV_UB 100.0 FORMULA_0003 0.0 255.0 /end CHARACTERISTIC
/begin CHARACTERISTIC K_ED_PUMG.P_CODE_OPENLOAD "P-Code fuer die Art OPENLOAD" VALUE 0x708F0 TKW_VV_VV_UW 100.0 FORMULA_0010 0.0 65535.0 /end CHARACTERISTIC
/begin CHARACTERISTIC K_ED_PUMG.P_CODE_SH_TO_GND "P-Code fuer die Art SH_TO_GND" VALUE 0x708EE TKW_VV_VV_UW 100.0 FORMULA_0010 0.0 65535.0 /end CHARACTERISTIC
/begin CHARACTERISTIC K_ED_PUMG.P_CODE_SH_TO_UB "P-Code fuer die Art SH_TO_UB" VALUE 0x708EC TKW_VV_VV_UW 100.0 FORMULA_0010 0.0 65535.0 /end CHARACTERISTIC
/begin CHARACTERISTIC K_ED_PUMG.P_CODE_UNPLAUSIBEL "P-Code fuer die Art UNPLAUSIBEL" VALUE 0x708F2 TKW_VV_VV_UW 100.0 FORMULA_0010 0.0 65535.0 /end CHARACTERISTIC
/begin CHARACTERISTIC K_ED_PUMG_OBD.DEC_NACH_EINTRAG "Filterverringerung nach Fehlerspeichereintrag" VALUE 0x71B27 TKW_VV_VV_UB 100.0 FORMULA_0003 0.0 255.0 /end CHARACTERISTIC
/begin CHARACTERISTIC K_ED_PUMG_OBD.DEC_VOR_EINTRAG "Filterverringerung vorm Fehlerspeichereintrag" VALUE 0x71B25 TKW_VV_VV_UB 100.0 FORMULA_0003 0.0 255.0 /end CHARACTERISTIC
/begin CHARACTERISTIC K_ED_PUMG_OBD.FEHLERSCHWELLE "Filterschwelle fuer Fehlereintrag" VALUE 0x71B22 TKW_VV_VV_UB 100.0 FORMULA_0003 0.0 255.0 /end CHARACTERISTIC
/begin CHARACTERISTIC K_ED_PUMG_OBD.INC_NACH_EINTRAG "Filtererhoehung nach Fehlerspeichereintrag" VALUE 0x71B26 TKW_VV_VV_UB 100.0 FORMULA_0003 0.0 255.0 /end CHARACTERISTIC
/begin CHARACTERISTIC K_ED_PUMG_OBD.INC_VOR_EINTRAG "Filtererhoehung vorm Fehlerspeichereintrag" VALUE 0x71B24 TKW_VV_VV_UB 100.0 FORMULA_0003 0.0 255.0 /end CHARACTERISTIC
/begin CHARACTERISTIC K_ED_PUMG_OBD.KLASSENINDEX "Auswahl der Fehlerklasse" VALUE 0x71B28 TKW_VV_VV_UB 100.0 FORMULA_0003 0.0 8.0 /end CHARACTERISTIC
/begin CHARACTERISTIC K_ED_PUMG_OBD.OK_SCHWELLE "Filterschwelle fuer Fehleraustrag" VALUE 0x71B23 TKW_VV_VV_UB 100.0 FORMULA_0003 0.0 255.0 /end CHARACTERISTIC
/begin CHARACTERISTIC K_ED_PUMG_OBD.P_CODE_OPENLOAD "P-Code fuer die Art OPENLOAD" VALUE 0x71B1E TKW_VV_VV_UW 100.0 FORMULA_0010 0.0 65535.0 /end CHARACTERISTIC
/begin CHARACTERISTIC K_ED_PUMG_OBD.P_CODE_SH_TO_GND "P-Code fuer die Art SH_TO_GND" VALUE 0x71B1C TKW_VV_VV_UW 100.0 FORMULA_0010 0.0 65535.0 /end CHARACTERISTIC
/begin CHARACTERISTIC K_ED_PUMG_OBD.P_CODE_SH_TO_UB "P-Code fuer die Art SH_TO_UB" VALUE 0x71B1A TKW_VV_VV_UW 100.0 FORMULA_0010 0.0 65535.0 /end CHARACTERISTIC
/begin CHARACTERISTIC K_ED_PUMG_OBD.P_CODE_UNPLAUSIBEL "P-Code fuer die Art UNPLAUSIBEL" VALUE 0x71B20 TKW_VV_VV_UW 100.0 FORMULA_0010 0.0 65535.0 /end CHARACTERISTIC
/begin CHARACTERISTIC K_ED_RBM_EVAP_MAX "Maximaltemperatur EVAP" VALUE 0x71FAC TKW_VV_VV_SW 100.0 FORMULA_0023 -50.0 170.0 FORMAT "%4.1" /end CHARACTERISTIC
/begin CHARACTERISTIC K_ED_RBM_EVAP_MIN "Mindesttemperatur EVAP" VALUE 0x71FAA TKW_VV_VV_SW 100.0 FORMULA_0023 -50.0 170.0 FORMAT "%4.1" /end CHARACTERISTIC
/begin CHARACTERISTIC K_ED_RBM_EVAP_TEMP_DELTA "Max. Differenz zwischen tmot und tumg fuer EVAP" VALUE 0x71FAE TKW_VV_VV_SW 100.0 FORMULA_0074 -1000.0 1000.0 FORMAT "%4.1" /end CHARACTERISTIC
/begin CHARACTERISTIC K_ED_RBM_PUMG_MIN "Mindestluftdruck fuer Rate-Based" VALUE 0x71F9E TKW_VV_VV_SW 100.0 FORMULA_0075 400.0 1200.0 FORMAT "%4.1" /end CHARACTERISTIC
/begin CHARACTERISTIC K_ED_RBM_TIME "Gesamtzeit fuer Fahrzyklus" VALUE 0x71FA2 TKW_VV_VV_UW 100.0 FORMULA_0071 0.0 6553.5 FORMAT "%4.1" /end CHARACTERISTIC
/begin CHARACTERISTIC K_ED_RBM_TIME_LL "Mindestleerlauf Fahrzyklus" VALUE 0x71FA6 TKW_VV_VV_UW 100.0 FORMULA_0071 0.0 6553.5 FORMAT "%4.1" /end CHARACTERISTIC
/begin CHARACTERISTIC K_ED_RBM_TIME_SLP "SLP-Mindestzeit fuer Fahrzyklus" VALUE 0x71F92 TKW_VV_VV_UW 100.0 FORMULA_0071 0.0 6553.5 FORMAT "%4.1" /end CHARACTERISTIC
/begin CHARACTERISTIC K_ED_RBM_TIME_V "Geschwindigkeitszeit Fahrzyklus" VALUE 0x71FA4 TKW_VV_VV_UW 100.0 FORMULA_0071 0.0 6553.5 FORMAT "%4.1" /end CHARACTERISTIC
/begin CHARACTERISTIC K_ED_RBM_TUMG_MIN "Mindesttemperatur" VALUE 0x71FA0 TKW_VV_VV_SW 100.0 FORMULA_0023 -50.0 170.0 FORMAT "%4.1" /end CHARACTERISTIC
/begin CHARACTERISTIC K_ED_RBM_V_MIN "Mindestgeschwindigkeit Fahrzyklus" VALUE 0x71FA8 TKW_VV_VV_SW 100.0 FORMULA_0076 -80.0 360.0 FORMAT "%4.1" /end CHARACTERISTIC
/begin CHARACTERISTIC K_ED_RLSLP.DEC_NACH_EINTRAG "Filterverringerung nach Fehlerspeichereintrag" VALUE 0x71473 TKW_VV_VV_UB 100.0 FORMULA_0003 0.0 255.0 /end CHARACTERISTIC
/begin CHARACTERISTIC K_ED_RLSLP.DEC_VOR_EINTRAG "Filterverringerung vorm Fehlerspeichereintrag" VALUE 0x71471 TKW_VV_VV_UB 100.0 FORMULA_0003 0.0 255.0 /end CHARACTERISTIC
/begin CHARACTERISTIC K_ED_RLSLP.FEHLERSCHWELLE "Filterschwelle fuer Fehlereintrag" VALUE 0x7146E TKW_VV_VV_UB 100.0 FORMULA_0003 0.0 255.0 /end CHARACTERISTIC
/begin CHARACTERISTIC K_ED_RLSLP.INC_NACH_EINTRAG "Filtererhoehung nach Fehlerspeichereintrag" VALUE 0x71472 TKW_VV_VV_UB 100.0 FORMULA_0003 0.0 255.0 /end CHARACTERISTIC
/begin CHARACTERISTIC K_ED_RLSLP.INC_VOR_EINTRAG "Filtererhoehung vorm Fehlerspeichereintrag" VALUE 0x71470 TKW_VV_VV_UB 100.0 FORMULA_0003 0.0 255.0 /end CHARACTERISTIC
/begin CHARACTERISTIC K_ED_RLSLP.KLASSENINDEX "Auswahl der Fehlerklasse" VALUE 0x71474 TKW_VV_VV_UB 100.0 FORMULA_0003 0.0 8.0 /end CHARACTERISTIC
/begin CHARACTERISTIC K_ED_RLSLP.OK_SCHWELLE "Filterschwelle fuer Fehleraustrag" VALUE 0x7146F TKW_VV_VV_UB 100.0 FORMULA_0003 0.0 255.0 /end CHARACTERISTIC
/begin CHARACTERISTIC K_ED_RLSLP.P_CODE_OPENLOAD "P-Code fuer die Art OPENLOAD" VALUE 0x7146A TKW_VV_VV_UW 100.0 FORMULA_0010 0.0 65535.0 /end CHARACTERISTIC
/begin CHARACTERISTIC K_ED_RLSLP.P_CODE_SH_TO_GND "P-Code fuer die Art SH_TO_GND" VALUE 0x71468 TKW_VV_VV_UW 100.0 FORMULA_0010 0.0 65535.0 /end CHARACTERISTIC
/begin CHARACTERISTIC K_ED_RLSLP.P_CODE_SH_TO_UB "P-Code fuer die Art SH_TO_UB" VALUE 0x71466 TKW_VV_VV_UW 100.0 FORMULA_0010 0.0 65535.0 /end CHARACTERISTIC
/begin CHARACTERISTIC K_ED_RLSLP.P_CODE_UNPLAUSIBEL "P-Code fuer die Art UNPLAUSIBEL" VALUE 0x7146C TKW_VV_VV_UW 100.0 FORMULA_0010 0.0 65535.0 /end CHARACTERISTIC
/begin CHARACTERISTIC K_ED_RLU87.DEC_NACH_EINTRAG "Filterverringerung nach Fehlerspeichereintrag" VALUE 0x7140B TKW_VV_VV_UB 100.0 FORMULA_0003 0.0 255.0 /end CHARACTERISTIC
/begin CHARACTERISTIC K_ED_RLU87.DEC_VOR_EINTRAG "Filterverringerung vorm Fehlerspeichereintrag" VALUE 0x71409 TKW_VV_VV_UB 100.0 FORMULA_0003 0.0 255.0 /end CHARACTERISTIC
/begin CHARACTERISTIC K_ED_RLU87.FEHLERSCHWELLE "Filterschwelle fuer Fehlereintrag" VALUE 0x71406 TKW_VV_VV_UB 100.0 FORMULA_0003 0.0 255.0 /end CHARACTERISTIC
/begin CHARACTERISTIC K_ED_RLU87.INC_NACH_EINTRAG "Filtererhoehung nach Fehlerspeichereintrag" VALUE 0x7140A TKW_VV_VV_UB 100.0 FORMULA_0003 0.0 255.0 /end CHARACTERISTIC
/begin CHARACTERISTIC K_ED_RLU87.INC_VOR_EINTRAG "Filtererhoehung vorm Fehlerspeichereintrag" VALUE 0x71408 TKW_VV_VV_UB 100.0 FORMULA_0003 0.0 255.0 /end CHARACTERISTIC
/begin CHARACTERISTIC K_ED_RLU87.KLASSENINDEX "Auswahl der Fehlerklasse" VALUE 0x7140C TKW_VV_VV_UB 100.0 FORMULA_0003 0.0 8.0 /end CHARACTERISTIC
/begin CHARACTERISTIC K_ED_RLU87.OK_SCHWELLE "Filterschwelle fuer Fehleraustrag" VALUE 0x71407 TKW_VV_VV_UB 100.0 FORMULA_0003 0.0 255.0 /end CHARACTERISTIC
/begin CHARACTERISTIC K_ED_RLU87.P_CODE_OPENLOAD "P-Code fuer die Art OPENLOAD" VALUE 0x71402 TKW_VV_VV_UW 100.0 FORMULA_0010 0.0 65535.0 /end CHARACTERISTIC
/begin CHARACTERISTIC K_ED_RLU87.P_CODE_SH_TO_GND "P-Code fuer die Art SH_TO_GND" VALUE 0x71400 TKW_VV_VV_UW 100.0 FORMULA_0010 0.0 65535.0 /end CHARACTERISTIC
/begin CHARACTERISTIC K_ED_RLU87.P_CODE_SH_TO_UB "P-Code fuer die Art SH_TO_UB" VALUE 0x713FE TKW_VV_VV_UW 100.0 FORMULA_0010 0.0 65535.0 /end CHARACTERISTIC
/begin CHARACTERISTIC K_ED_RLU87.P_CODE_UNPLAUSIBEL "P-Code fuer die Art UNPLAUSIBEL" VALUE 0x71404 TKW_VV_VV_UW 100.0 FORMULA_0010 0.0 65535.0 /end CHARACTERISTIC
/begin CHARACTERISTIC K_ED_S_GETR_HS.DEC_NACH_EINTRAG "Filterverringerung nach Fehlerspeichereintrag" VALUE 0x71987 TKW_VV_VV_UB 100.0 FORMULA_0003 0.0 255.0 /end CHARACTERISTIC
/begin CHARACTERISTIC K_ED_S_GETR_HS.DEC_VOR_EINTRAG "Filterverringerung vorm Fehlerspeichereintrag" VALUE 0x71985 TKW_VV_VV_UB 100.0 FORMULA_0003 0.0 255.0 /end CHARACTERISTIC
/begin CHARACTERISTIC K_ED_S_GETR_HS.FEHLERSCHWELLE "Filterschwelle fuer Fehlereintrag" VALUE 0x71982 TKW_VV_VV_UB 100.0 FORMULA_0003 0.0 255.0 /end CHARACTERISTIC
/begin CHARACTERISTIC K_ED_S_GETR_HS.INC_NACH_EINTRAG "Filtererhoehung nach Fehlerspeichereintrag" VALUE 0x71986 TKW_VV_VV_UB 100.0 FORMULA_0003 0.0 255.0 /end CHARACTERISTIC
/begin CHARACTERISTIC K_ED_S_GETR_HS.INC_VOR_EINTRAG "Filtererhoehung vorm Fehlerspeichereintrag" VALUE 0x71984 TKW_VV_VV_UB 100.0 FORMULA_0003 0.0 255.0 /end CHARACTERISTIC
/begin CHARACTERISTIC K_ED_S_GETR_HS.KLASSENINDEX "Auswahl der Fehlerklasse" VALUE 0x71988 TKW_VV_VV_UB 100.0 FORMULA_0003 0.0 8.0 /end CHARACTERISTIC
/begin CHARACTERISTIC K_ED_S_GETR_HS.OK_SCHWELLE "Filterschwelle fuer Fehleraustrag" VALUE 0x71983 TKW_VV_VV_UB 100.0 FORMULA_0003 0.0 255.0 /end CHARACTERISTIC
/begin CHARACTERISTIC K_ED_S_GETR_HS.P_CODE_OPENLOAD "P-Code fuer die Art OPENLOAD" VALUE 0x7197E TKW_VV_VV_UW 100.0 FORMULA_0010 0.0 65535.0 /end CHARACTERISTIC
/begin CHARACTERISTIC K_ED_S_GETR_HS.P_CODE_SH_TO_GND "P-Code fuer die Art SH_TO_GND" VALUE 0x7197C TKW_VV_VV_UW 100.0 FORMULA_0010 0.0 65535.0 /end CHARACTERISTIC
/begin CHARACTERISTIC K_ED_S_GETR_HS.P_CODE_SH_TO_UB "P-Code fuer die Art SH_TO_UB" VALUE 0x7197A TKW_VV_VV_UW 100.0 FORMULA_0010 0.0 65535.0 /end CHARACTERISTIC
/begin CHARACTERISTIC K_ED_S_GETR_HS.P_CODE_UNPLAUSIBEL "P-Code fuer die Art UNPLAUSIBEL" VALUE 0x71980 TKW_VV_VV_UW 100.0 FORMULA_0010 0.0 65535.0 /end CHARACTERISTIC
/begin CHARACTERISTIC K_ED_S_KUPP_HS.DEC_NACH_EINTRAG "Filterverringerung nach Fehlerspeichereintrag" VALUE 0x719A1 TKW_VV_VV_UB 100.0 FORMULA_0003 0.0 255.0 /end CHARACTERISTIC
/begin CHARACTERISTIC K_ED_S_KUPP_HS.DEC_VOR_EINTRAG "Filterverringerung vorm Fehlerspeichereintrag" VALUE 0x7199F TKW_VV_VV_UB 100.0 FORMULA_0003 0.0 255.0 /end CHARACTERISTIC
/begin CHARACTERISTIC K_ED_S_KUPP_HS.FEHLERSCHWELLE "Filterschwelle fuer Fehlereintrag" VALUE 0x7199C TKW_VV_VV_UB 100.0 FORMULA_0003 0.0 255.0 /end CHARACTERISTIC
/begin CHARACTERISTIC K_ED_S_KUPP_HS.INC_NACH_EINTRAG "Filtererhoehung nach Fehlerspeichereintrag" VALUE 0x719A0 TKW_VV_VV_UB 100.0 FORMULA_0003 0.0 255.0 /end CHARACTERISTIC
/begin CHARACTERISTIC K_ED_S_KUPP_HS.INC_VOR_EINTRAG "Filtererhoehung vorm Fehlerspeichereintrag" VALUE 0x7199E TKW_VV_VV_UB 100.0 FORMULA_0003 0.0 255.0 /end CHARACTERISTIC
/begin CHARACTERISTIC K_ED_S_KUPP_HS.KLASSENINDEX "Auswahl der Fehlerklasse" VALUE 0x719A2 TKW_VV_VV_UB 100.0 FORMULA_0003 0.0 8.0 /end CHARACTERISTIC
/begin CHARACTERISTIC K_ED_S_KUPP_HS.OK_SCHWELLE "Filterschwelle fuer Fehleraustrag" VALUE 0x7199D TKW_VV_VV_UB 100.0 FORMULA_0003 0.0 255.0 /end CHARACTERISTIC
/begin CHARACTERISTIC K_ED_S_KUPP_HS.P_CODE_OPENLOAD "P-Code fuer die Art OPENLOAD" VALUE 0x71998 TKW_VV_VV_UW 100.0 FORMULA_0010 0.0 65535.0 /end CHARACTERISTIC
/begin CHARACTERISTIC K_ED_S_KUPP_HS.P_CODE_SH_TO_GND "P-Code fuer die Art SH_TO_GND" VALUE 0x71996 TKW_VV_VV_UW 100.0 FORMULA_0010 0.0 65535.0 /end CHARACTERISTIC
/begin CHARACTERISTIC K_ED_S_KUPP_HS.P_CODE_SH_TO_UB "P-Code fuer die Art SH_TO_UB" VALUE 0x71994 TKW_VV_VV_UW 100.0 FORMULA_0010 0.0 65535.0 /end CHARACTERISTIC
/begin CHARACTERISTIC K_ED_S_KUPP_HS.P_CODE_UNPLAUSIBEL "P-Code fuer die Art UNPLAUSIBEL" VALUE 0x7199A TKW_VV_VV_UW 100.0 FORMULA_0010 0.0 65535.0 /end CHARACTERISTIC
/begin CHARACTERISTIC K_ED_S_POEL_DIAG.DEC_NACH_EINTRAG "Filterverringerung nach Fehlerspeichereintrag" VALUE 0x717CD TKW_VV_VV_UB 100.0 FORMULA_0003 0.0 255.0 /end CHARACTERISTIC
/begin CHARACTERISTIC K_ED_S_POEL_DIAG.DEC_VOR_EINTRAG "Filterverringerung vorm Fehlerspeichereintrag" VALUE 0x717CB TKW_VV_VV_UB 100.0 FORMULA_0003 0.0 255.0 /end CHARACTERISTIC
/begin CHARACTERISTIC K_ED_S_POEL_DIAG.FEHLERSCHWELLE "Filterschwelle fuer Fehlereintrag" VALUE 0x717C8 TKW_VV_VV_UB 100.0 FORMULA_0003 0.0 255.0 /end CHARACTERISTIC
/begin CHARACTERISTIC K_ED_S_POEL_DIAG.INC_NACH_EINTRAG "Filtererhoehung nach Fehlerspeichereintrag" VALUE 0x717CC TKW_VV_VV_UB 100.0 FORMULA_0003 0.0 255.0 /end CHARACTERISTIC
/begin CHARACTERISTIC K_ED_S_POEL_DIAG.INC_VOR_EINTRAG "Filtererhoehung vorm Fehlerspeichereintrag" VALUE 0x717CA TKW_VV_VV_UB 100.0 FORMULA_0003 0.0 255.0 /end CHARACTERISTIC
/begin CHARACTERISTIC K_ED_S_POEL_DIAG.KLASSENINDEX "Auswahl der Fehlerklasse" VALUE 0x717CE TKW_VV_VV_UB 100.0 FORMULA_0003 0.0 8.0 /end CHARACTERISTIC
/begin CHARACTERISTIC K_ED_S_POEL_DIAG.OK_SCHWELLE "Filterschwelle fuer Fehleraustrag" VALUE 0x717C9 TKW_VV_VV_UB 100.0 FORMULA_0003 0.0 255.0 /end CHARACTERISTIC
/begin CHARACTERISTIC K_ED_S_POEL_DIAG.P_CODE_OPENLOAD "P-Code fuer die Art OPENLOAD" VALUE 0x717C4 TKW_VV_VV_UW 100.0 FORMULA_0010 0.0 65535.0 /end CHARACTERISTIC
/begin CHARACTERISTIC K_ED_S_POEL_DIAG.P_CODE_SH_TO_GND "P-Code fuer die Art SH_TO_GND" VALUE 0x717C2 TKW_VV_VV_UW 100.0 FORMULA_0010 0.0 65535.0 /end CHARACTERISTIC
/begin CHARACTERISTIC K_ED_S_POEL_DIAG.P_CODE_SH_TO_UB "P-Code fuer die Art SH_TO_UB" VALUE 0x717C0 TKW_VV_VV_UW 100.0 FORMULA_0010 0.0 65535.0 /end CHARACTERISTIC
/begin CHARACTERISTIC K_ED_S_POEL_DIAG.P_CODE_UNPLAUSIBEL "P-Code fuer die Art UNPLAUSIBEL" VALUE 0x717C6 TKW_VV_VV_UW 100.0 FORMULA_0010 0.0 65535.0 /end CHARACTERISTIC
/begin CHARACTERISTIC K_ED_SCDN_ABDECKUNG_AUSTRAG "Similar Abdeckung fuer Fehlerspeicheraustrag " VALUE 0x71F98 TKW_VV_VV_UW 100.0 FORMULA_0073 0.0 4.0 FORMAT "%6.3" /end CHARACTERISTIC
/begin CHARACTERISTIC K_ED_SCDN_ABDECKUNG_EINTRAG "Similar Abdeckung fuer Fehlerspeichereintrag " VALUE 0x71F96 TKW_VV_VV_UW 100.0 FORMULA_0073 0.0 4.0 FORMAT "%6.3" /end CHARACTERISTIC
/begin CHARACTERISTIC K_ED_SG_INJ.DEC_NACH_EINTRAG "Filterverringerung nach Fehlerspeichereintrag" VALUE 0x7177F TKW_VV_VV_UB 100.0 FORMULA_0003 0.0 255.0 /end CHARACTERISTIC
/begin CHARACTERISTIC K_ED_SG_INJ.DEC_VOR_EINTRAG "Filterverringerung vorm Fehlerspeichereintrag" VALUE 0x7177D TKW_VV_VV_UB 100.0 FORMULA_0003 0.0 255.0 /end CHARACTERISTIC
/begin CHARACTERISTIC K_ED_SG_INJ.FEHLERSCHWELLE "Filterschwelle fuer Fehlereintrag" VALUE 0x7177A TKW_VV_VV_UB 100.0 FORMULA_0003 0.0 255.0 /end CHARACTERISTIC
/begin CHARACTERISTIC K_ED_SG_INJ.INC_NACH_EINTRAG "Filtererhoehung nach Fehlerspeichereintrag" VALUE 0x7177E TKW_VV_VV_UB 100.0 FORMULA_0003 0.0 255.0 /end CHARACTERISTIC
/begin CHARACTERISTIC K_ED_SG_INJ.INC_VOR_EINTRAG "Filtererhoehung vorm Fehlerspeichereintrag" VALUE 0x7177C TKW_VV_VV_UB 100.0 FORMULA_0003 0.0 255.0 /end CHARACTERISTIC
/begin CHARACTERISTIC K_ED_SG_INJ.KLASSENINDEX "Auswahl der Fehlerklasse" VALUE 0x71780 TKW_VV_VV_UB 100.0 FORMULA_0003 0.0 8.0 /end CHARACTERISTIC
/begin CHARACTERISTIC K_ED_SG_INJ.OK_SCHWELLE "Filterschwelle fuer Fehleraustrag" VALUE 0x7177B TKW_VV_VV_UB 100.0 FORMULA_0003 0.0 255.0 /end CHARACTERISTIC
/begin CHARACTERISTIC K_ED_SG_INJ.P_CODE_OPENLOAD "P-Code fuer die Art OPENLOAD" VALUE 0x71776 TKW_VV_VV_UW 100.0 FORMULA_0010 0.0 65535.0 /end CHARACTERISTIC
/begin CHARACTERISTIC K_ED_SG_INJ.P_CODE_SH_TO_GND "P-Code fuer die Art SH_TO_GND" VALUE 0x71774 TKW_VV_VV_UW 100.0 FORMULA_0010 0.0 65535.0 /end CHARACTERISTIC
/begin CHARACTERISTIC K_ED_SG_INJ.P_CODE_SH_TO_UB "P-Code fuer die Art SH_TO_UB" VALUE 0x71772 TKW_VV_VV_UW 100.0 FORMULA_0010 0.0 65535.0 /end CHARACTERISTIC
/begin CHARACTERISTIC K_ED_SG_INJ.P_CODE_UNPLAUSIBEL "P-Code fuer die Art UNPLAUSIBEL" VALUE 0x71778 TKW_VV_VV_UW 100.0 FORMULA_0010 0.0 65535.0 /end CHARACTERISTIC
/begin CHARACTERISTIC K_ED_SK_MANAGER_INJ.DEC_NACH_EINTRAG "Filterverringerung nach Fehlerspeichereintrag" VALUE 0x7167B TKW_VV_VV_UB 100.0 FORMULA_0003 0.0 255.0 /end CHARACTERISTIC
/begin CHARACTERISTIC K_ED_SK_MANAGER_INJ.DEC_VOR_EINTRAG "Filterverringerung vorm Fehlerspeichereintrag" VALUE 0x71679 TKW_VV_VV_UB 100.0 FORMULA_0003 0.0 255.0 /end CHARACTERISTIC
/begin CHARACTERISTIC K_ED_SK_MANAGER_INJ.FEHLERSCHWELLE "Filterschwelle fuer Fehlereintrag" VALUE 0x71676 TKW_VV_VV_UB 100.0 FORMULA_0003 0.0 255.0 /end CHARACTERISTIC
/begin CHARACTERISTIC K_ED_SK_MANAGER_INJ.INC_NACH_EINTRAG "Filtererhoehung nach Fehlerspeichereintrag" VALUE 0x7167A TKW_VV_VV_UB 100.0 FORMULA_0003 0.0 255.0 /end CHARACTERISTIC
/begin CHARACTERISTIC K_ED_SK_MANAGER_INJ.INC_VOR_EINTRAG "Filtererhoehung vorm Fehlerspeichereintrag" VALUE 0x71678 TKW_VV_VV_UB 100.0 FORMULA_0003 0.0 255.0 /end CHARACTERISTIC
/begin CHARACTERISTIC K_ED_SK_MANAGER_INJ.KLASSENINDEX "Auswahl der Fehlerklasse" VALUE 0x7167C TKW_VV_VV_UB 100.0 FORMULA_0003 0.0 8.0 /end CHARACTERISTIC
/begin CHARACTERISTIC K_ED_SK_MANAGER_INJ.OK_SCHWELLE "Filterschwelle fuer Fehleraustrag" VALUE 0x71677 TKW_VV_VV_UB 100.0 FORMULA_0003 0.0 255.0 /end CHARACTERISTIC
/begin CHARACTERISTIC K_ED_SK_MANAGER_INJ.P_CODE_OPENLOAD "P-Code fuer die Art OPENLOAD" VALUE 0x71672 TKW_VV_VV_UW 100.0 FORMULA_0010 0.0 65535.0 /end CHARACTERISTIC
/begin CHARACTERISTIC K_ED_SK_MANAGER_INJ.P_CODE_SH_TO_GND "P-Code fuer die Art SH_TO_GND" VALUE 0x71670 TKW_VV_VV_UW 100.0 FORMULA_0010 0.0 65535.0 /end CHARACTERISTIC
/begin CHARACTERISTIC K_ED_SK_MANAGER_INJ.P_CODE_SH_TO_UB "P-Code fuer die Art SH_TO_UB" VALUE 0x7166E TKW_VV_VV_UW 100.0 FORMULA_0010 0.0 65535.0 /end CHARACTERISTIC
/begin CHARACTERISTIC K_ED_SK_MANAGER_INJ.P_CODE_UNPLAUSIBEL "P-Code fuer die Art UNPLAUSIBEL" VALUE 0x71674 TKW_VV_VV_UW 100.0 FORMULA_0010 0.0 65535.0 /end CHARACTERISTIC
/begin CHARACTERISTIC K_ED_SK_TR_INJ.DEC_NACH_EINTRAG "Filterverringerung nach Fehlerspeichereintrag" VALUE 0x708DF TKW_VV_VV_UB 100.0 FORMULA_0003 0.0 255.0 /end CHARACTERISTIC
/begin CHARACTERISTIC K_ED_SK_TR_INJ.DEC_VOR_EINTRAG "Filterverringerung vorm Fehlerspeichereintrag" VALUE 0x708DD TKW_VV_VV_UB 100.0 FORMULA_0003 0.0 255.0 /end CHARACTERISTIC
/begin CHARACTERISTIC K_ED_SK_TR_INJ.FEHLERSCHWELLE "Filterschwelle fuer Fehlereintrag" VALUE 0x708DA TKW_VV_VV_UB 100.0 FORMULA_0003 0.0 255.0 /end CHARACTERISTIC
/begin CHARACTERISTIC K_ED_SK_TR_INJ.INC_NACH_EINTRAG "Filtererhoehung nach Fehlerspeichereintrag" VALUE 0x708DE TKW_VV_VV_UB 100.0 FORMULA_0003 0.0 255.0 /end CHARACTERISTIC
/begin CHARACTERISTIC K_ED_SK_TR_INJ.INC_VOR_EINTRAG "Filtererhoehung vorm Fehlerspeichereintrag" VALUE 0x708DC TKW_VV_VV_UB 100.0 FORMULA_0003 0.0 255.0 /end CHARACTERISTIC
/begin CHARACTERISTIC K_ED_SK_TR_INJ.KLASSENINDEX "Auswahl der Fehlerklasse" VALUE 0x708E0 TKW_VV_VV_UB 100.0 FORMULA_0003 0.0 8.0 /end CHARACTERISTIC
/begin CHARACTERISTIC K_ED_SK_TR_INJ.OK_SCHWELLE "Filterschwelle fuer Fehleraustrag" VALUE 0x708DB TKW_VV_VV_UB 100.0 FORMULA_0003 0.0 255.0 /end CHARACTERISTIC
/begin CHARACTERISTIC K_ED_SK_TR_INJ.P_CODE_OPENLOAD "P-Code fuer die Art OPENLOAD" VALUE 0x708D6 TKW_VV_VV_UW 100.0 FORMULA_0010 0.0 65535.0 /end CHARACTERISTIC
/begin CHARACTERISTIC K_ED_SK_TR_INJ.P_CODE_SH_TO_GND "P-Code fuer die Art SH_TO_GND" VALUE 0x708D4 TKW_VV_VV_UW 100.0 FORMULA_0010 0.0 65535.0 /end CHARACTERISTIC
/begin CHARACTERISTIC K_ED_SK_TR_INJ.P_CODE_SH_TO_UB "P-Code fuer die Art SH_TO_UB" VALUE 0x708D2 TKW_VV_VV_UW 100.0 FORMULA_0010 0.0 65535.0 /end CHARACTERISTIC
/begin CHARACTERISTIC K_ED_SK_TR_INJ.P_CODE_UNPLAUSIBEL "P-Code fuer die Art UNPLAUSIBEL" VALUE 0x708D8 TKW_VV_VV_UW 100.0 FORMULA_0010 0.0 65535.0 /end CHARACTERISTIC
/begin CHARACTERISTIC K_ED_SL_DURCHS_B1.DEC_NACH_EINTRAG "Filterverringerung nach Fehlerspeichereintrag" VALUE 0x7191F TKW_VV_VV_UB 100.0 FORMULA_0003 0.0 255.0 /end CHARACTERISTIC
/begin CHARACTERISTIC K_ED_SL_DURCHS_B1.DEC_VOR_EINTRAG "Filterverringerung vorm Fehlerspeichereintrag" VALUE 0x7191D TKW_VV_VV_UB 100.0 FORMULA_0003 0.0 255.0 /end CHARACTERISTIC
/begin CHARACTERISTIC K_ED_SL_DURCHS_B1.FEHLERSCHWELLE "Filterschwelle fuer Fehlereintrag" VALUE 0x7191A TKW_VV_VV_UB 100.0 FORMULA_0003 0.0 255.0 /end CHARACTERISTIC
/begin CHARACTERISTIC K_ED_SL_DURCHS_B1.INC_NACH_EINTRAG "Filtererhoehung nach Fehlerspeichereintrag" VALUE 0x7191E TKW_VV_VV_UB 100.0 FORMULA_0003 0.0 255.0 /end CHARACTERISTIC
/begin CHARACTERISTIC K_ED_SL_DURCHS_B1.INC_VOR_EINTRAG "Filtererhoehung vorm Fehlerspeichereintrag" VALUE 0x7191C TKW_VV_VV_UB 100.0 FORMULA_0003 0.0 255.0 /end CHARACTERISTIC
/begin CHARACTERISTIC K_ED_SL_DURCHS_B1.KLASSENINDEX "Auswahl der Fehlerklasse" VALUE 0x71920 TKW_VV_VV_UB 100.0 FORMULA_0003 0.0 8.0 /end CHARACTERISTIC
/begin CHARACTERISTIC K_ED_SL_DURCHS_B1.OK_SCHWELLE "Filterschwelle fuer Fehleraustrag" VALUE 0x7191B TKW_VV_VV_UB 100.0 FORMULA_0003 0.0 255.0 /end CHARACTERISTIC
/begin CHARACTERISTIC K_ED_SL_DURCHS_B1.P_CODE_OPENLOAD "P-Code fuer die Art OPENLOAD" VALUE 0x71916 TKW_VV_VV_UW 100.0 FORMULA_0010 0.0 65535.0 /end CHARACTERISTIC
/begin CHARACTERISTIC K_ED_SL_DURCHS_B1.P_CODE_SH_TO_GND "P-Code fuer die Art SH_TO_GND" VALUE 0x71914 TKW_VV_VV_UW 100.0 FORMULA_0010 0.0 65535.0 /end CHARACTERISTIC
/begin CHARACTERISTIC K_ED_SL_DURCHS_B1.P_CODE_SH_TO_UB "P-Code fuer die Art SH_TO_UB" VALUE 0x71912 TKW_VV_VV_UW 100.0 FORMULA_0010 0.0 65535.0 /end CHARACTERISTIC
/begin CHARACTERISTIC K_ED_SL_DURCHS_B1.P_CODE_UNPLAUSIBEL "P-Code fuer die Art UNPLAUSIBEL" VALUE 0x71918 TKW_VV_VV_UW 100.0 FORMULA_0010 0.0 65535.0 /end CHARACTERISTIC
/begin CHARACTERISTIC K_ED_SL_DURCHS_B2.DEC_NACH_EINTRAG "Filterverringerung nach Fehlerspeichereintrag" VALUE 0x71939 TKW_VV_VV_UB 100.0 FORMULA_0003 0.0 255.0 /end CHARACTERISTIC
/begin CHARACTERISTIC K_ED_SL_DURCHS_B2.DEC_VOR_EINTRAG "Filterverringerung vorm Fehlerspeichereintrag" VALUE 0x71937 TKW_VV_VV_UB 100.0 FORMULA_0003 0.0 255.0 /end CHARACTERISTIC
/begin CHARACTERISTIC K_ED_SL_DURCHS_B2.FEHLERSCHWELLE "Filterschwelle fuer Fehlereintrag" VALUE 0x71934 TKW_VV_VV_UB 100.0 FORMULA_0003 0.0 255.0 /end CHARACTERISTIC
/begin CHARACTERISTIC K_ED_SL_DURCHS_B2.INC_NACH_EINTRAG "Filtererhoehung nach Fehlerspeichereintrag" VALUE 0x71938 TKW_VV_VV_UB 100.0 FORMULA_0003 0.0 255.0 /end CHARACTERISTIC
/begin CHARACTERISTIC K_ED_SL_DURCHS_B2.INC_VOR_EINTRAG "Filtererhoehung vorm Fehlerspeichereintrag" VALUE 0x71936 TKW_VV_VV_UB 100.0 FORMULA_0003 0.0 255.0 /end CHARACTERISTIC
/begin CHARACTERISTIC K_ED_SL_DURCHS_B2.KLASSENINDEX "Auswahl der Fehlerklasse" VALUE 0x7193A TKW_VV_VV_UB 100.0 FORMULA_0003 0.0 8.0 /end CHARACTERISTIC
/begin CHARACTERISTIC K_ED_SL_DURCHS_B2.OK_SCHWELLE "Filterschwelle fuer Fehleraustrag" VALUE 0x71935 TKW_VV_VV_UB 100.0 FORMULA_0003 0.0 255.0 /end CHARACTERISTIC
/begin CHARACTERISTIC K_ED_SL_DURCHS_B2.P_CODE_OPENLOAD "P-Code fuer die Art OPENLOAD" VALUE 0x71930 TKW_VV_VV_UW 100.0 FORMULA_0010 0.0 65535.0 /end CHARACTERISTIC
/begin CHARACTERISTIC K_ED_SL_DURCHS_B2.P_CODE_SH_TO_GND "P-Code fuer die Art SH_TO_GND" VALUE 0x7192E TKW_VV_VV_UW 100.0 FORMULA_0010 0.0 65535.0 /end CHARACTERISTIC
/begin CHARACTERISTIC K_ED_SL_DURCHS_B2.P_CODE_SH_TO_UB "P-Code fuer die Art SH_TO_UB" VALUE 0x7192C TKW_VV_VV_UW 100.0 FORMULA_0010 0.0 65535.0 /end CHARACTERISTIC
/begin CHARACTERISTIC K_ED_SL_DURCHS_B2.P_CODE_UNPLAUSIBEL "P-Code fuer die Art UNPLAUSIBEL" VALUE 0x71932 TKW_VV_VV_UW 100.0 FORMULA_0010 0.0 65535.0 /end CHARACTERISTIC
/begin COMPU_METHOD FORMULA_0003 "FORMULA_0003" RAT_FUNC "%3.0" "-" COEFFS 0 1 0 0 0 1 /end COMPU_METHOD
/begin COMPU_METHOD FORMULA_0010 "FORMULA_0010" RAT_FUNC "%5.0" "-" COEFFS 0 1 0 0 0 1 /end COMPU_METHOD
/begin COMPU_METHOD FORMULA_0023 "FORMULA_0023" RAT_FUNC "%6.1" "°C" COEFFS 0 10.0 2732.0 0 0.0 1.0 /end COMPU_METHOD
/begin COMPU_METHOD FORMULA_0071 "FORMULA_0071" RAT_FUNC "%6.1" "s" COEFFS 0 10.0 0.0 0 0.0 1.0 /end COMPU_METHOD
/begin COMPU_METHOD FORMULA_0073 "FORMULA_0073" RAT_FUNC "%8.3" "-" COEFFS 0 1024.0 0.0 0 0.0 1.0 /end COMPU_METHOD
/begin COMPU_METHOD FORMULA_0074 "FORMULA_0074" RAT_FUNC "%6.1" "Kelvin" COEFFS 0 10.0 0.0 0 0.0 1.0 /end COMPU_METHOD
/begin COMPU_METHOD FORMULA_0075 "FORMULA_0075" RAT_FUNC "%6.1" "mbar" COEFFS 0 16.0 0.0 0 0.0 1.0 /end COMPU_METHOD
/begin COMPU_METHOD FORMULA_0076 "FORMULA_0076" RAT_FUNC "%6.1" "km/h" COEFFS 0 16.0 0.0 0 0.0 1.0 /end COMPU_METHOD
/begin COMPU_METHOD FORMULA_0662 "FORMULA_0662" TAB_VERB "%3.0" "-" COMPU_TAB_REF FORMULA_0662_VTAB /end COMPU_METHOD
/begin COMPU_VTAB FORMULA_0662_VTAB "FORMULA_0662_VTAB" TAB_VERB 5 0 "MIL immer aus" 1 "BMW ohne Predrive" 2 "nur Predrive" 134 "OBD" 142 "OBD+SMG" /end COMPU_VTAB
/begin FUNCTION Eigendiagnose ""
 /begin DEF_CHARACTERISTIC K_ED_LANK1_OPENLOAD.P_CODE_UNPLAUSIBEL K_ED_LANK2.DEC_NACH_EINTRAG K_ED_LANK2.DEC_VOR_EINTRAG K_ED_LANK2.FEHLERSCHWELLE K_ED_LANK2.INC_NACH_EINTRAG K_ED_LANK2.INC_VOR_EINTRAG K_ED_LANK2.KLASSENINDEX K_ED_LANK2.OK_SCHWELLE K_ED_LANK2.P_CODE_OPENLOAD K_ED_LANK2.P_CODE_SH_TO_GND K_ED_LANK2.P_CODE_SH_TO_UB K_ED_LANK2.P_CODE_UNPLAUSIBEL K_ED_LANK2_OBD_S.DEC_NACH_EINTRAG K_ED_LANK2_OBD_S.DEC_VOR_EINTRAG K_ED_LANK2_OBD_S.FEHLERSCHWELLE K_ED_LANK2_OBD_S.INC_NACH_EINTRAG K_ED_LANK2_OBD_S.INC_VOR_EINTRAG K_ED_LANK2_OBD_S.KLASSENINDEX K_ED_LANK2_OBD_S.OK_SCHWELLE K_ED_LANK2_OBD_S.P_CODE_OPENLOAD K_ED_LANK2_OBD_S.P_CODE_SH_TO_GND K_ED_LANK2_OBD_S.P_CODE_SH_TO_UB K_ED_LANK2_OBD_S.P_CODE_UNPLAUSIBEL K_ED_LANK2_OBD_WE.DEC_NACH_EINTRAG K_ED_LANK2_OBD_WE.DEC_VOR_EINTRAG K_ED_LANK2_OBD_WE.FEHLERSCHWELLE K_ED_LANK2_OBD_WE.INC_NACH_EINTRAG K_ED_LANK2_OBD_WE.INC_VOR_EINTRAG K_ED_LANK2_OBD_WE.KLASSENINDEX K_ED_LANK2_OBD_WE.OK_SCHWELLE K_ED_LANK2_OBD_WE.P_CODE_OPENLOAD K_ED_LANK2_OBD_WE.P_CODE_SH_TO_GND K_ED_LANK2_OBD_WE.P_CODE_SH_TO_UB K_ED_LANK2_OBD_WE.P_CODE_UNPLAUSIBEL K_ED_LANK2_OPENLOAD.DEC_NACH_EINTRAG K_ED_LANK2_OPENLOAD.DEC_VOR_EINTRAG K_ED_LANK2_OPENLOAD.FEHLERSCHWELLE K_ED_LANK2_OPENLOAD.INC_NACH_EINTRAG K_ED_LANK2_OPENLOAD.INC_VOR_EINTRAG K_ED_LANK2_OPENLOAD.KLASSENINDEX K_ED_LANK2_OPENLOAD.OK_SCHWELLE K_ED_LANK2_OPENLOAD.P_CODE_OPENLOAD K_ED_LANK2_OPENLOAD.P_CODE_SH_TO_GND K_ED_LANK2_OPENLOAD.P_CODE_SH_TO_UB K_ED_LANK2_OPENLOAD.P_CODE_UNPLAUSIBEL K_ED_LAVK_ATIC42.DEC_NACH_EINTRAG K_ED_LAVK_ATIC42.DEC_VOR_EINTRAG K_ED_LAVK_ATIC42.FEHLERSCHWELLE K_ED_LAVK_ATIC42.INC_NACH_EINTRAG K_ED_LAVK_ATIC42.INC_VOR_EINTRAG K_ED_LAVK_ATIC42.KLASSENINDEX K_ED_LAVK_ATIC42.OK_SCHWELLE K_ED_LAVK_ATIC42.P_CODE_OPENLOAD K_ED_LAVK_ATIC42.P_CODE_SH_TO_GND K_ED_LAVK_ATIC42.P_CODE_SH_TO_UB K_ED_LAVK_ATIC42.P_CODE_UNPLAUSIBEL K_ED_LAVK1.DEC_NACH_EINTRAG K_ED_LAVK1.DEC_VOR_EINTRAG K_ED_LAVK1.FEHLERSCHWELLE K_ED_LAVK1.INC_NACH_EINTRAG K_ED_LAVK1.INC_VOR_EINTRAG K_ED_LAVK1.KLASSENINDEX K_ED_LAVK1.OK_SCHWELLE K_ED_LAVK1.P_CODE_OPENLOAD K_ED_LAVK1.P_CODE_SH_TO_GND K_ED_LAVK1.P_CODE_SH_TO_UB K_ED_LAVK1.P_CODE_UNPLAUSIBEL K_ED_LAVK1_DIAG.DEC_NACH_EINTRAG K_ED_LAVK1_DIAG.DEC_VOR_EINTRAG K_ED_LAVK1_DIAG.FEHLERSCHWELLE K_ED_LAVK1_DIAG.INC_NACH_EINTRAG K_ED_LAVK1_DIAG.INC_VOR_EINTRAG K_ED_LAVK1_DIAG.KLASSENINDEX K_ED_LAVK1_DIAG.OK_SCHWELLE K_ED_LAVK1_DIAG.P_CODE_OPENLOAD K_ED_LAVK1_DIAG.P_CODE_SH_TO_GND K_ED_LAVK1_DIAG.P_CODE_SH_TO_UB K_ED_LAVK1_DIAG.P_CODE_UNPLAUSIBEL K_ED_LAVK1_IA_OPENLOAD.DEC_NACH_EINTRAG K_ED_LAVK1_IA_OPENLOAD.DEC_VOR_EINTRAG K_ED_LAVK1_IA_OPENLOAD.FEHLERSCHWELLE K_ED_LAVK1_IA_OPENLOAD.INC_NACH_EINTRAG K_ED_LAVK1_IA_OPENLOAD.INC_VOR_EINTRAG K_ED_LAVK1_IA_OPENLOAD.KLASSENINDEX K_ED_LAVK1_IA_OPENLOAD.OK_SCHWELLE K_ED_LAVK1_IA_OPENLOAD.P_CODE_OPENLOAD K_ED_LAVK1_IA_OPENLOAD.P_CODE_SH_TO_GND K_ED_LAVK1_IA_OPENLOAD.P_CODE_SH_TO_UB K_ED_LAVK1_IA_OPENLOAD.P_CODE_UNPLAUSIBEL K_ED_LAVK1_IP_OPENLOAD.DEC_NACH_EINTRAG K_ED_LAVK1_IP_OPENLOAD.DEC_VOR_EINTRAG K_ED_LAVK1_IP_OPENLOAD.FEHLERSCHWELLE K_ED_LAVK1_IP_OPENLOAD.INC_NACH_EINTRAG K_ED_LAVK1_IP_OPENLOAD.INC_VOR_EINTRAG K_ED_LAVK1_IP_OPENLOAD.KLASSENINDEX K_ED_LAVK1_IP_OPENLOAD.OK_SCHWELLE K_ED_LAVK1_IP_OPENLOAD.P_CODE_OPENLOAD K_ED_LAVK1_IP_OPENLOAD.P_CODE_SH_TO_GND K_ED_LAVK1_IP_OPENLOAD.P_CODE_SH_TO_UB K_ED_LAVK1_IP_OPENLOAD.P_CODE_UNPLAUSIBEL K_ED_LAVK1_OBD_DYN.DEC_NACH_EINTRAG K_ED_LAVK1_OBD_DYN.DEC_VOR_EINTRAG K_ED_LAVK1_OBD_DYN.FEHLERSCHWELLE K_ED_LAVK1_OBD_DYN.INC_NACH_EINTRAG K_ED_LAVK1_OBD_DYN.INC_VOR_EINTRAG K_ED_LAVK1_OBD_DYN.KLASSENINDEX K_ED_LAVK1_OBD_DYN.OK_SCHWELLE K_ED_LAVK1_OBD_DYN.P_CODE_OPENLOAD K_ED_LAVK1_OBD_DYN.P_CODE_SH_TO_GND K_ED_LAVK1_OBD_DYN.P_CODE_SH_TO_UB K_ED_LAVK1_OBD_DYN.P_CODE_UNPLAUSIBEL K_ED_LAVK1_OBD_PLAU.DEC_NACH_EINTRAG K_ED_LAVK1_OBD_PLAU.DEC_VOR_EINTRAG K_ED_LAVK1_OBD_PLAU.FEHLERSCHWELLE K_ED_LAVK1_OBD_PLAU.INC_NACH_EINTRAG K_ED_LAVK1_OBD_PLAU.INC_VOR_EINTRAG K_ED_LAVK1_OBD_PLAU.KLASSENINDEX K_ED_LAVK1_OBD_PLAU.OK_SCHWELLE K_ED_LAVK1_OBD_PLAU.P_CODE_OPENLOAD K_ED_LAVK1_OBD_PLAU.P_CODE_SH_TO_GND K_ED_LAVK1_OBD_PLAU.P_CODE_SH_TO_UB K_ED_LAVK1_OBD_PLAU.P_CODE_UNPLAUSIBEL K_ED_LAVK1_OBD_SA.DEC_NACH_EINTRAG K_ED_LAVK1_OBD_SA.DEC_VOR_EINTRAG K_ED_LAVK1_OBD_SA.FEHLERSCHWELLE K_ED_LAVK1_OBD_SA.INC_NACH_EINTRAG K_ED_LAVK1_OBD_SA.INC_VOR_EINTRAG K_ED_LAVK1_OBD_SA.KLASSENINDEX K_ED_LAVK1_OBD_SA.OK_SCHWELLE K_ED_LAVK1_OBD_SA.P_CODE_OPENLOAD K_ED_LAVK1_OBD_SA.P_CODE_SH_TO_GND K_ED_LAVK1_OBD_SA.P_CODE_SH_TO_UB K_ED_LAVK1_OBD_SA.P_CODE_UNPLAUSIBEL K_ED_LAVK1_OBD_TL.DEC_NACH_EINTRAG K_ED_LAVK1_OBD_TL.DEC_VOR_EINTRAG K_ED_LAVK1_OBD_TL.FEHLERSCHWELLE K_ED_LAVK1_OBD_TL.INC_NACH_EINTRAG K_ED_LAVK1_OBD_TL.INC_VOR_EINTRAG K_ED_LAVK1_OBD_TL.KLASSENINDEX K_ED_LAVK1_OBD_TL.OK_SCHWELLE K_ED_LAVK1_OBD_TL.P_CODE_OPENLOAD K_ED_LAVK1_OBD_TL.P_CODE_SH_TO_GND K_ED_LAVK1_OBD_TL.P_CODE_SH_TO_UB K_ED_LAVK1_OBD_TL.P_CODE_UNPLAUSIBEL K_ED_LAVK1_TRIM.DEC_NACH_EINTRAG K_ED_LAVK1_TRIM.DEC_VOR_EINTRAG K_ED_LAVK1_TRIM.FEHLERSCHWELLE K_ED_LAVK1_TRIM.INC_NACH_EINTRAG K_ED_LAVK1_TRIM.INC_VOR_EINTRAG K_ED_LAVK1_TRIM.KLASSENINDEX K_ED_LAVK1_TRIM.OK_SCHWELLE K_ED_LAVK1_TRIM.P_CODE_OPENLOAD K_ED_LAVK1_TRIM.P_CODE_SH_TO_GND K_ED_LAVK1_TRIM.P_CODE_SH_TO_UB K_ED_LAVK1_TRIM.P_CODE_UNPLAUSIBEL K_ED_LAVK1_UN_OPENLOAD.DEC_NACH_EINTRAG K_ED_LAVK1_UN_OPENLOAD.DEC_VOR_EINTRAG K_ED_LAVK1_UN_OPENLOAD.FEHLERSCHWELLE K_ED_LAVK1_UN_OPENLOAD.INC_NACH_EINTRAG K_ED_LAVK1_UN_OPENLOAD.INC_VOR_EINTRAG K_ED_LAVK1_UN_OPENLOAD.KLASSENINDEX K_ED_LAVK1_UN_OPENLOAD.OK_SCHWELLE K_ED_LAVK1_UN_OPENLOAD.P_CODE_OPENLOAD K_ED_LAVK1_UN_OPENLOAD.P_CODE_SH_TO_GND K_ED_LAVK1_UN_OPENLOAD.P_CODE_SH_TO_UB K_ED_LAVK1_UN_OPENLOAD.P_CODE_UNPLAUSIBEL K_ED_LAVK2.DEC_NACH_EINTRAG K_ED_LAVK2.DEC_VOR_EINTRAG K_ED_LAVK2.FEHLERSCHWELLE K_ED_LAVK2.INC_NACH_EINTRAG K_ED_LAVK2.INC_VOR_EINTRAG K_ED_LAVK2.KLASSENINDEX K_ED_LAVK2.OK_SCHWELLE K_ED_LAVK2.P_CODE_OPENLOAD K_ED_LAVK2.P_CODE_SH_TO_GND K_ED_LAVK2.P_CODE_SH_TO_UB K_ED_LAVK2.P_CODE_UNPLAUSIBEL K_ED_LAVK2_DIAG.DEC_NACH_EINTRAG K_ED_LAVK2_DIAG.DEC_VOR_EINTRAG K_ED_LAVK2_DIAG.FEHLERSCHWELLE K_ED_LAVK2_DIAG.INC_NACH_EINTRAG K_ED_LAVK2_DIAG.INC_VOR_EINTRAG K_ED_LAVK2_DIAG.KLASSENINDEX K_ED_LAVK2_DIAG.OK_SCHWELLE K_ED_LAVK2_DIAG.P_CODE_OPENLOAD K_ED_LAVK2_DIAG.P_CODE_SH_TO_GND K_ED_LAVK2_DIAG.P_CODE_SH_TO_UB K_ED_LAVK2_DIAG.P_CODE_UNPLAUSIBEL K_ED_LAVK2_IA_OPENLOAD.DEC_NACH_EINTRAG K_ED_LAVK2_IA_OPENLOAD.DEC_VOR_EINTRAG K_ED_LAVK2_IA_OPENLOAD.FEHLERSCHWELLE K_ED_LAVK2_IA_OPENLOAD.INC_NACH_EINTRAG K_ED_LAVK2_IA_OPENLOAD.INC_VOR_EINTRAG K_ED_LAVK2_IA_OPENLOAD.KLASSENINDEX K_ED_LAVK2_IA_OPENLOAD.OK_SCHWELLE K_ED_LAVK2_IA_OPENLOAD.P_CODE_OPENLOAD K_ED_LAVK2_IA_OPENLOAD.P_CODE_SH_TO_GND K_ED_LAVK2_IA_OPENLOAD.P_CODE_SH_TO_UB K_ED_LAVK2_IA_OPENLOAD.P_CODE_UNPLAUSIBEL K_ED_LAVK2_IP_OPENLOAD.DEC_NACH_EINTRAG K_ED_LAVK2_IP_OPENLOAD.DEC_VOR_EINTRAG K_ED_LAVK2_IP_OPENLOAD.FEHLERSCHWELLE K_ED_LAVK2_IP_OPENLOAD.INC_NACH_EINTRAG K_ED_LAVK2_IP_OPENLOAD.INC_VOR_EINTRAG K_ED_LAVK2_IP_OPENLOAD.KLASSENINDEX K_ED_LAVK2_IP_OPENLOAD.OK_SCHWELLE K_ED_LAVK2_IP_OPENLOAD.P_CODE_OPENLOAD K_ED_LAVK2_IP_OPENLOAD.P_CODE_SH_TO_GND K_ED_LAVK2_IP_OPENLOAD.P_CODE_SH_TO_UB K_ED_LAVK2_IP_OPENLOAD.P_CODE_UNPLAUSIBEL K_ED_LAVK2_OBD_DYN.DEC_NACH_EINTRAG K_ED_LAVK2_OBD_DYN.DEC_VOR_EINTRAG K_ED_LAVK2_OBD_DYN.FEHLERSCHWELLE K_ED_LAVK2_OBD_DYN.INC_NACH_EINTRAG K_ED_LAVK2_OBD_DYN.INC_VOR_EINTRAG K_ED_LAVK2_OBD_DYN.KLASSENINDEX K_ED_LAVK2_OBD_DYN.OK_SCHWELLE K_ED_LAVK2_OBD_DYN.P_CODE_OPENLOAD K_ED_LAVK2_OBD_DYN.P_CODE_SH_TO_GND K_ED_LAVK2_OBD_DYN.P_CODE_SH_TO_UB K_ED_LAVK2_OBD_DYN.P_CODE_UNPLAUSIBEL K_ED_LAVK2_OBD_PLAU.DEC_NACH_EINTRAG K_ED_LAVK2_OBD_PLAU.DEC_VOR_EINTRAG K_ED_LAVK2_OBD_PLAU.FEHLERSCHWELLE K_ED_LAVK2_OBD_PLAU.INC_NACH_EINTRAG K_ED_LAVK2_OBD_PLAU.INC_VOR_EINTRAG K_ED_LAVK2_OBD_PLAU.KLASSENINDEX K_ED_LAVK2_OBD_PLAU.OK_SCHWELLE K_ED_LAVK2_OBD_PLAU.P_CODE_OPENLOAD K_ED_LAVK2_OBD_PLAU.P_CODE_SH_TO_GND K_ED_LAVK2_OBD_PLAU.P_CODE_SH_TO_UB K_ED_LAVK2_OBD_PLAU.P_CODE_UNPLAUSIBEL K_ED_LAVK2_OBD_SA.DEC_NACH_EINTRAG K_ED_LAVK2_OBD_SA.DEC_VOR_EINTRAG K_ED_LAVK2_OBD_SA.FEHLERSCHWELLE K_ED_LAVK2_OBD_SA.INC_NACH_EINTRAG K_ED_LAVK2_OBD_SA.INC_VOR_EINTRAG K_ED_LAVK2_OBD_SA.KLASSENINDEX K_ED_LAVK2_OBD_SA.OK_SCHWELLE K_ED_LAVK2_OBD_SA.P_CODE_OPENLOAD K_ED_LAVK2_OBD_SA.P_CODE_SH_TO_GND K_ED_LAVK2_OBD_SA.P_CODE_SH_TO_UB K_ED_LAVK2_OBD_SA.P_CODE_UNPLAUSIBEL K_ED_LAVK2_OBD_TL.DEC_NACH_EINTRAG K_ED_LAVK2_OBD_TL.DEC_VOR_EINTRAG K_ED_LAVK2_OBD_TL.FEHLERSCHWELLE K_ED_LAVK2_OBD_TL.INC_NACH_EINTRAG K_ED_LAVK2_OBD_TL.INC_VOR_EINTRAG K_ED_LAVK2_OBD_TL.KLASSENINDEX K_ED_LAVK2_OBD_TL.OK_SCHWELLE K_ED_LAVK2_OBD_TL.P_CODE_OPENLOAD K_ED_LAVK2_OBD_TL.P_CODE_SH_TO_GND K_ED_LAVK2_OBD_TL.P_CODE_SH_TO_UB K_ED_LAVK2_OBD_TL.P_CODE_UNPLAUSIBEL K_ED_LAVK2_TRIM.DEC_NACH_EINTRAG K_ED_LAVK2_TRIM.DEC_VOR_EINTRAG K_ED_LAVK2_TRIM.FEHLERSCHWELLE K_ED_LAVK2_TRIM.INC_NACH_EINTRAG K_ED_LAVK2_TRIM.INC_VOR_EINTRAG K_ED_LAVK2_TRIM.KLASSENINDEX K_ED_LAVK2_TRIM.OK_SCHWELLE K_ED_LAVK2_TRIM.P_CODE_OPENLOAD K_ED_LAVK2_TRIM.P_CODE_SH_TO_GND K_ED_LAVK2_TRIM.P_CODE_SH_TO_UB K_ED_LAVK2_TRIM.P_CODE_UNPLAUSIBEL K_ED_LAVK2_UN_OPENLOAD.DEC_NACH_EINTRAG K_ED_LAVK2_UN_OPENLOAD.DEC_VOR_EINTRAG K_ED_LAVK2_UN_OPENLOAD.FEHLERSCHWELLE K_ED_LAVK2_UN_OPENLOAD.INC_NACH_EINTRAG K_ED_LAVK2_UN_OPENLOAD.INC_VOR_EINTRAG K_ED_LAVK2_UN_OPENLOAD.KLASSENINDEX K_ED_LAVK2_UN_OPENLOAD.OK_SCHWELLE K_ED_LAVK2_UN_OPENLOAD.P_CODE_OPENLOAD K_ED_LAVK2_UN_OPENLOAD.P_CODE_SH_TO_GND K_ED_LAVK2_UN_OPENLOAD.P_CODE_SH_TO_UB K_ED_LAVK2_UN_OPENLOAD.P_CODE_UNPLAUSIBEL K_ED_LSHNK1.DEC_NACH_EINTRAG K_ED_LSHNK1.DEC_VOR_EINTRAG K_ED_LSHNK1.FEHLERSCHWELLE K_ED_LSHNK1.INC_NACH_EINTRAG K_ED_LSHNK1.INC_VOR_EINTRAG K_ED_LSHNK1.KLASSENINDEX K_ED_LSHNK1.OK_SCHWELLE K_ED_LSHNK1.P_CODE_OPENLOAD K_ED_LSHNK1.P_CODE_SH_TO_GND K_ED_LSHNK1.P_CODE_SH_TO_UB K_ED_LSHNK1.P_CODE_UNPLAUSIBEL K_ED_LSHNK1_R.DEC_NACH_EINTRAG K_ED_LSHNK1_R.DEC_VOR_EINTRAG K_ED_LSHNK1_R.FEHLERSCHWELLE K_ED_LSHNK1_R.INC_NACH_EINTRAG K_ED_LSHNK1_R.INC_VOR_EINTRAG K_ED_LSHNK1_R.KLASSENINDEX K_ED_LSHNK1_R.OK_SCHWELLE K_ED_LSHNK1_R.P_CODE_OPENLOAD K_ED_LSHNK1_R.P_CODE_SH_TO_GND K_ED_LSHNK1_R.P_CODE_SH_TO_UB K_ED_LSHNK1_R.P_CODE_UNPLAUSIBEL K_ED_LSHNK2.DEC_NACH_EINTRAG K_ED_LSHNK2.DEC_VOR_EINTRAG K_ED_LSHNK2.FEHLERSCHWELLE K_ED_LSHNK2.INC_NACH_EINTRAG K_ED_LSHNK2.INC_VOR_EINTRAG K_ED_LSHNK2.KLASSENINDEX K_ED_LSHNK2.OK_SCHWELLE K_ED_LSHNK2.P_CODE_OPENLOAD K_ED_LSHNK2.P_CODE_SH_TO_GND K_ED_LSHNK2.P_CODE_SH_TO_UB K_ED_LSHNK2.P_CODE_UNPLAUSIBEL K_ED_LSHNK2_R.DEC_NACH_EINTRAG K_ED_LSHNK2_R.DEC_VOR_EINTRAG K_ED_LSHNK2_R.FEHLERSCHWELLE K_ED_LSHNK2_R.INC_NACH_EINTRAG K_ED_LSHNK2_R.INC_VOR_EINTRAG K_ED_LSHNK2_R.KLASSENINDEX K_ED_LSHNK2_R.OK_SCHWELLE K_ED_LSHNK2_R.P_CODE_OPENLOAD K_ED_LSHNK2_R.P_CODE_SH_TO_GND K_ED_LSHNK2_R.P_CODE_SH_TO_UB K_ED_LSHNK2_R.P_CODE_UNPLAUSIBEL K_ED_LSHVK1.DEC_NACH_EINTRAG K_ED_LSHVK1.DEC_VOR_EINTRAG K_ED_LSHVK1.FEHLERSCHWELLE K_ED_LSHVK1.INC_NACH_EINTRAG K_ED_LSHVK1.INC_VOR_EINTRAG K_ED_LSHVK1.KLASSENINDEX K_ED_LSHVK1.OK_SCHWELLE K_ED_LSHVK1.P_CODE_OPENLOAD K_ED_LSHVK1.P_CODE_SH_TO_GND K_ED_LSHVK1.P_CODE_SH_TO_UB K_ED_LSHVK1.P_CODE_UNPLAUSIBEL K_ED_LSHVK1_R.DEC_NACH_EINTRAG K_ED_LSHVK1_R.DEC_VOR_EINTRAG K_ED_LSHVK1_R.FEHLERSCHWELLE K_ED_LSHVK1_R.INC_NACH_EINTRAG K_ED_LSHVK1_R.INC_VOR_EINTRAG K_ED_LSHVK1_R.KLASSENINDEX K_ED_LSHVK1_R.OK_SCHWELLE K_ED_LSHVK1_R.P_CODE_OPENLOAD K_ED_LSHVK1_R.P_CODE_SH_TO_GND K_ED_LSHVK1_R.P_CODE_SH_TO_UB K_ED_LSHVK1_R.P_CODE_UNPLAUSIBEL K_ED_LSHVK2.DEC_NACH_EINTRAG K_ED_LSHVK2.DEC_VOR_EINTRAG K_ED_LSHVK2.FEHLERSCHWELLE K_ED_LSHVK2.INC_NACH_EINTRAG K_ED_LSHVK2.INC_VOR_EINTRAG K_ED_LSHVK2.KLASSENINDEX K_ED_LSHVK2.OK_SCHWELLE K_ED_LSHVK2.P_CODE_OPENLOAD K_ED_LSHVK2.P_CODE_SH_TO_GND K_ED_LSHVK2.P_CODE_SH_TO_UB K_ED_LSHVK2.P_CODE_UNPLAUSIBEL K_ED_LSHVK2_R.DEC_NACH_EINTRAG K_ED_LSHVK2_R.DEC_VOR_EINTRAG K_ED_LSHVK2_R.FEHLERSCHWELLE K_ED_LSHVK2_R.INC_NACH_EINTRAG K_ED_LSHVK2_R.INC_VOR_EINTRAG K_ED_LSHVK2_R.KLASSENINDEX K_ED_LSHVK2_R.OK_SCHWELLE K_ED_LSHVK2_R.P_CODE_OPENLOAD K_ED_LSHVK2_R.P_CODE_SH_TO_GND K_ED_LSHVK2_R.P_CODE_SH_TO_UB K_ED_LSHVK2_R.P_CODE_UNPLAUSIBEL K_ED_LSRVK1_OBD_REF.DEC_NACH_EINTRAG K_ED_LSRVK1_OBD_REF.DEC_VOR_EINTRAG K_ED_LSRVK1_OBD_REF.FEHLERSCHWELLE K_ED_LSRVK1_OBD_REF.INC_NACH_EINTRAG K_ED_LSRVK1_OBD_REF.INC_VOR_EINTRAG K_ED_LSRVK1_OBD_REF.KLASSENINDEX K_ED_LSRVK1_OBD_REF.OK_SCHWELLE K_ED_LSRVK1_OBD_REF.P_CODE_OPENLOAD K_ED_LSRVK1_OBD_REF.P_CODE_SH_TO_GND K_ED_LSRVK1_OBD_REF.P_CODE_SH_TO_UB K_ED_LSRVK1_OBD_REF.P_CODE_UNPLAUSIBEL K_ED_LSRVK1_OBD_REG.DEC_NACH_EINTRAG K_ED_LSRVK1_OBD_REG.DEC_VOR_EINTRAG K_ED_LSRVK1_OBD_REG.FEHLERSCHWELLE K_ED_LSRVK1_OBD_REG.INC_NACH_EINTRAG K_ED_LSRVK1_OBD_REG.INC_VOR_EINTRAG K_ED_LSRVK1_OBD_REG.KLASSENINDEX K_ED_LSRVK1_OBD_REG.OK_SCHWELLE K_ED_LSRVK1_OBD_REG.P_CODE_OPENLOAD K_ED_LSRVK1_OBD_REG.P_CODE_SH_TO_GND K_ED_LSRVK1_OBD_REG.P_CODE_SH_TO_UB K_ED_LSRVK1_OBD_REG.P_CODE_UNPLAUSIBEL K_ED_LSRVK1_OBD_START.DEC_NACH_EINTRAG K_ED_LSRVK1_OBD_START.DEC_VOR_EINTRAG K_ED_LSRVK1_OBD_START.FEHLERSCHWELLE K_ED_LSRVK1_OBD_START.INC_NACH_EINTRAG K_ED_LSRVK1_OBD_START.INC_VOR_EINTRAG K_ED_LSRVK1_OBD_START.KLASSENINDEX K_ED_LSRVK1_OBD_START.OK_SCHWELLE K_ED_LSRVK1_OBD_START.P_CODE_OPENLOAD K_ED_LSRVK1_OBD_START.P_CODE_SH_TO_GND K_ED_LSRVK1_OBD_START.P_CODE_SH_TO_UB K_ED_LSRVK1_OBD_START.P_CODE_UNPLAUSIBEL K_ED_LSRVK2_OBD_REF.DEC_NACH_EINTRAG K_ED_LSRVK2_OBD_REF.DEC_VOR_EINTRAG K_ED_LSRVK2_OBD_REF.FEHLERSCHWELLE K_ED_LSRVK2_OBD_REF.INC_NACH_EINTRAG K_ED_LSRVK2_OBD_REF.INC_VOR_EINTRAG K_ED_LSRVK2_OBD_REF.KLASSENINDEX K_ED_LSRVK2_OBD_REF.OK_SCHWELLE K_ED_LSRVK2_OBD_REF.P_CODE_OPENLOAD K_ED_LSRVK2_OBD_REF.P_CODE_SH_TO_GND K_ED_LSRVK2_OBD_REF.P_CODE_SH_TO_UB K_ED_LSRVK2_OBD_REF.P_CODE_UNPLAUSIBEL K_ED_LSRVK2_OBD_REG.DEC_NACH_EINTRAG K_ED_LSRVK2_OBD_REG.DEC_VOR_EINTRAG K_ED_LSRVK2_OBD_REG.FEHLERSCHWELLE K_ED_LSRVK2_OBD_REG.INC_NACH_EINTRAG K_ED_LSRVK2_OBD_REG.INC_VOR_EINTRAG K_ED_LSRVK2_OBD_REG.KLASSENINDEX K_ED_LSRVK2_OBD_REG.OK_SCHWELLE K_ED_LSRVK2_OBD_REG.P_CODE_OPENLOAD K_ED_LSRVK2_OBD_REG.P_CODE_SH_TO_GND K_ED_LSRVK2_OBD_REG.P_CODE_SH_TO_UB K_ED_LSRVK2_OBD_REG.P_CODE_UNPLAUSIBEL K_ED_LSRVK2_OBD_START.DEC_NACH_EINTRAG K_ED_LSRVK2_OBD_START.DEC_VOR_EINTRAG K_ED_LSRVK2_OBD_START.FEHLERSCHWELLE K_ED_LSRVK2_OBD_START.INC_NACH_EINTRAG K_ED_LSRVK2_OBD_START.INC_VOR_EINTRAG K_ED_LSRVK2_OBD_START.KLASSENINDEX K_ED_LSRVK2_OBD_START.OK_SCHWELLE K_ED_LSRVK2_OBD_START.P_CODE_OPENLOAD K_ED_LSRVK2_OBD_START.P_CODE_SH_TO_GND K_ED_LSRVK2_OBD_START.P_CODE_SH_TO_UB K_ED_LSRVK2_OBD_START.P_CODE_UNPLAUSIBEL K_ED_MIL_MASKE K_ED_MVAC_DRUCKSENSOR.DEC_NACH_EINTRAG K_ED_MVAC_DRUCKSENSOR.DEC_VOR_EINTRAG K_ED_MVAC_DRUCKSENSOR.FEHLERSCHWELLE K_ED_MVAC_DRUCKSENSOR.INC_NACH_EINTRAG K_ED_MVAC_DRUCKSENSOR.INC_VOR_EINTRAG K_ED_MVAC_DRUCKSENSOR.KLASSENINDEX K_ED_MVAC_DRUCKSENSOR.OK_SCHWELLE K_ED_MVAC_DRUCKSENSOR.P_CODE_OPENLOAD K_ED_MVAC_DRUCKSENSOR.P_CODE_SH_TO_GND K_ED_MVAC_DRUCKSENSOR.P_CODE_SH_TO_UB K_ED_MVAC_DRUCKSENSOR.P_CODE_UNPLAUSIBEL K_ED_NW_SYNC.DEC_NACH_EINTRAG K_ED_NW_SYNC.DEC_VOR_EINTRAG K_ED_NW_SYNC.FEHLERSCHWELLE K_ED_NW_SYNC.INC_NACH_EINTRAG K_ED_NW_SYNC.INC_VOR_EINTRAG K_ED_NW_SYNC.KLASSENINDEX K_ED_NW_SYNC.OK_SCHWELLE K_ED_NW_SYNC.P_CODE_OPENLOAD K_ED_NW_SYNC.P_CODE_SH_TO_GND K_ED_NW_SYNC.P_CODE_SH_TO_UB K_ED_NW_SYNC.P_CODE_UNPLAUSIBEL K_ED_PCTRL_INJ.DEC_NACH_EINTRAG K_ED_PCTRL_INJ.DEC_VOR_EINTRAG K_ED_PCTRL_INJ.FEHLERSCHWELLE K_ED_PCTRL_INJ.INC_NACH_EINTRAG K_ED_PCTRL_INJ.INC_VOR_EINTRAG K_ED_PCTRL_INJ.KLASSENINDEX K_ED_PCTRL_INJ.OK_SCHWELLE K_ED_PCTRL_INJ.P_CODE_OPENLOAD K_ED_PCTRL_INJ.P_CODE_SH_TO_GND K_ED_PCTRL_INJ.P_CODE_SH_TO_UB K_ED_PCTRL_INJ.P_CODE_UNPLAUSIBEL K_ED_PKS.DEC_NACH_EINTRAG K_ED_PKS.DEC_VOR_EINTRAG K_ED_PKS.FEHLERSCHWELLE K_ED_PKS.INC_NACH_EINTRAG K_ED_PKS.INC_VOR_EINTRAG K_ED_PKS.KLASSENINDEX K_ED_PKS.OK_SCHWELLE K_ED_PKS.P_CODE_OPENLOAD K_ED_PKS.P_CODE_SH_TO_GND K_ED_PKS.P_CODE_SH_TO_UB K_ED_PKS.P_CODE_UNPLAUSIBEL K_ED_PKS_ADAPT_ANSCHL.DEC_NACH_EINTRAG K_ED_PKS_ADAPT_ANSCHL.DEC_VOR_EINTRAG K_ED_PKS_ADAPT_ANSCHL.FEHLERSCHWELLE K_ED_PKS_ADAPT_ANSCHL.INC_NACH_EINTRAG K_ED_PKS_ADAPT_ANSCHL.INC_VOR_EINTRAG K_ED_PKS_ADAPT_ANSCHL.KLASSENINDEX K_ED_PKS_ADAPT_ANSCHL.OK_SCHWELLE K_ED_PKS_ADAPT_ANSCHL.P_CODE_OPENLOAD K_ED_PKS_ADAPT_ANSCHL.P_CODE_SH_TO_GND K_ED_PKS_ADAPT_ANSCHL.P_CODE_SH_TO_UB K_ED_PKS_ADAPT_ANSCHL.P_CODE_UNPLAUSIBEL K_ED_PKS_LL.DEC_NACH_EINTRAG K_ED_PKS_LL.DEC_VOR_EINTRAG K_ED_PKS_LL.FEHLERSCHWELLE K_ED_PKS_LL.INC_NACH_EINTRAG K_ED_PKS_LL.INC_VOR_EINTRAG K_ED_PKS_LL.KLASSENINDEX K_ED_PKS_LL.OK_SCHWELLE K_ED_PKS_LL.P_CODE_OPENLOAD K_ED_PKS_LL.P_CODE_SH_TO_GND K_ED_PKS_LL.P_CODE_SH_TO_UB K_ED_PKS_LL.P_CODE_UNPLAUSIBEL K_ED_PKS_MODELL.DEC_NACH_EINTRAG K_ED_PKS_MODELL.DEC_VOR_EINTRAG K_ED_PKS_MODELL.FEHLERSCHWELLE K_ED_PKS_MODELL.INC_NACH_EINTRAG K_ED_PKS_MODELL.INC_VOR_EINTRAG K_ED_PKS_MODELL.KLASSENINDEX K_ED_PKS_MODELL.OK_SCHWELLE K_ED_PKS_MODELL.P_CODE_OPENLOAD K_ED_PKS_MODELL.P_CODE_SH_TO_GND K_ED_PKS_MODELL.P_CODE_SH_TO_UB K_ED_PKS_MODELL.P_CODE_UNPLAUSIBEL K_ED_PKS_PAUFBAU.DEC_NACH_EINTRAG K_ED_PKS_PAUFBAU.DEC_VOR_EINTRAG K_ED_PKS_PAUFBAU.FEHLERSCHWELLE K_ED_PKS_PAUFBAU.INC_NACH_EINTRAG K_ED_PKS_PAUFBAU.INC_VOR_EINTRAG K_ED_PKS_PAUFBAU.KLASSENINDEX K_ED_PKS_PAUFBAU.OK_SCHWELLE K_ED_PKS_PAUFBAU.P_CODE_OPENLOAD K_ED_PKS_PAUFBAU.P_CODE_SH_TO_GND K_ED_PKS_PAUFBAU.P_CODE_SH_TO_UB K_ED_PKS_PAUFBAU.P_CODE_UNPLAUSIBEL K_ED_PKS_Q.DEC_NACH_EINTRAG K_ED_PKS_Q.DEC_VOR_EINTRAG K_ED_PKS_Q.FEHLERSCHWELLE K_ED_PKS_Q.INC_NACH_EINTRAG K_ED_PKS_Q.INC_VOR_EINTRAG K_ED_PKS_Q.KLASSENINDEX K_ED_PKS_Q.OK_SCHWELLE K_ED_PKS_Q.P_CODE_OPENLOAD K_ED_PKS_Q.P_CODE_SH_TO_GND K_ED_PKS_Q.P_CODE_SH_TO_UB K_ED_PKS_Q.P_CODE_UNPLAUSIBEL K_ED_PKS_TL.DEC_NACH_EINTRAG K_ED_PKS_TL.DEC_VOR_EINTRAG K_ED_PKS_TL.FEHLERSCHWELLE K_ED_PKS_TL.INC_NACH_EINTRAG K_ED_PKS_TL.INC_VOR_EINTRAG K_ED_PKS_TL.KLASSENINDEX K_ED_PKS_TL.OK_SCHWELLE K_ED_PKS_TL.P_CODE_OPENLOAD K_ED_PKS_TL.P_CODE_SH_TO_GND K_ED_PKS_TL.P_CODE_SH_TO_UB K_ED_PKS_TL.P_CODE_UNPLAUSIBEL K_ED_PSAU1.DEC_NACH_EINTRAG K_ED_PSAU1.DEC_VOR_EINTRAG K_ED_PSAU1.FEHLERSCHWELLE K_ED_PSAU1.INC_NACH_EINTRAG K_ED_PSAU1.INC_VOR_EINTRAG K_ED_PSAU1.KLASSENINDEX K_ED_PSAU1.OK_SCHWELLE K_ED_PSAU1.P_CODE_OPENLOAD K_ED_PSAU1.P_CODE_SH_TO_GND K_ED_PSAU1.P_CODE_SH_TO_UB K_ED_PSAU1.P_CODE_UNPLAUSIBEL K_ED_PSAU2.DEC_NACH_EINTRAG K_ED_PSAU2.DEC_VOR_EINTRAG K_ED_PSAU2.FEHLERSCHWELLE K_ED_PSAU2.INC_NACH_EINTRAG K_ED_PSAU2.INC_VOR_EINTRAG K_ED_PSAU2.KLASSENINDEX K_ED_PSAU2.OK_SCHWELLE K_ED_PSAU2.P_CODE_OPENLOAD K_ED_PSAU2.P_CODE_SH_TO_GND K_ED_PSAU2.P_CODE_SH_TO_UB K_ED_PSAU2.P_CODE_UNPLAUSIBEL K_ED_PT_ANFRADMOM.DEC_NACH_EINTRAG K_ED_PT_ANFRADMOM.DEC_VOR_EINTRAG K_ED_PT_ANFRADMOM.FEHLERSCHWELLE K_ED_PT_ANFRADMOM.INC_NACH_EINTRAG K_ED_PT_ANFRADMOM.INC_VOR_EINTRAG K_ED_PT_ANFRADMOM.KLASSENINDEX K_ED_PT_ANFRADMOM.OK_SCHWELLE K_ED_PT_ANFRADMOM.P_CODE_OPENLOAD K_ED_PT_ANFRADMOM.P_CODE_SH_TO_GND K_ED_PT_ANFRADMOM.P_CODE_SH_TO_UB K_ED_PT_ANFRADMOM.P_CODE_UNPLAUSIBEL K_ED_PT_ATEMP.DEC_NACH_EINTRAG K_ED_PT_ATEMP.DEC_VOR_EINTRAG K_ED_PT_ATEMP.FEHLERSCHWELLE K_ED_PT_ATEMP.INC_NACH_EINTRAG K_ED_PT_ATEMP.INC_VOR_EINTRAG K_ED_PT_ATEMP.KLASSENINDEX K_ED_PT_ATEMP.OK_SCHWELLE K_ED_PT_ATEMP.P_CODE_OPENLOAD K_ED_PT_ATEMP.P_CODE_SH_TO_GND K_ED_PT_ATEMP.P_CODE_SH_TO_UB K_ED_PT_ATEMP.P_CODE_UNPLAUSIBEL K_ED_PT_AX.DEC_NACH_EINTRAG K_ED_PT_AX.DEC_VOR_EINTRAG K_ED_PT_AX.FEHLERSCHWELLE K_ED_PT_AX.INC_NACH_EINTRAG K_ED_PT_AX.INC_VOR_EINTRAG K_ED_PT_AX.KLASSENINDEX K_ED_PT_AX.OK_SCHWELLE K_ED_PT_AX.P_CODE_OPENLOAD K_ED_PT_AX.P_CODE_SH_TO_GND K_ED_PT_AX.P_CODE_SH_TO_UB K_ED_PT_AX.P_CODE_UNPLAUSIBEL K_ED_PT_BEDAT.DEC_NACH_EINTRAG K_ED_PT_BEDAT.DEC_VOR_EINTRAG K_ED_PT_BEDAT.FEHLERSCHWELLE K_ED_PT_BEDAT.INC_NACH_EINTRAG K_ED_PT_BEDAT.INC_VOR_EINTRAG K_ED_PT_BEDAT.KLASSENINDEX K_ED_PT_BEDAT.OK_SCHWELLE K_ED_PT_BEDAT.P_CODE_OPENLOAD K_ED_PT_BEDAT.P_CODE_SH_TO_GND K_ED_PT_BEDAT.P_CODE_SH_TO_UB K_ED_PT_BEDAT.P_CODE_UNPLAUSIBEL K_ED_PT_BEDFGR.DEC_NACH_EINTRAG K_ED_PT_BEDFGR.DEC_VOR_EINTRAG K_ED_PT_BEDFGR.FEHLERSCHWELLE K_ED_PT_BEDFGR.INC_NACH_EINTRAG K_ED_PT_BEDFGR.INC_VOR_EINTRAG K_ED_PT_BEDFGR.KLASSENINDEX K_ED_PT_BEDFGR.OK_SCHWELLE K_ED_PT_BEDFGR.P_CODE_OPENLOAD K_ED_PT_BEDFGR.P_CODE_SH_TO_GND K_ED_PT_BEDFGR.P_CODE_SH_TO_UB K_ED_PT_BEDFGR.P_CODE_UNPLAUSIBEL K_ED_PT_BUSOFF.DEC_NACH_EINTRAG K_ED_PT_BUSOFF.DEC_VOR_EINTRAG K_ED_PT_BUSOFF.FEHLERSCHWELLE K_ED_PT_BUSOFF.INC_NACH_EINTRAG K_ED_PT_BUSOFF.INC_VOR_EINTRAG K_ED_PT_BUSOFF.KLASSENINDEX K_ED_PT_BUSOFF.OK_SCHWELLE K_ED_PT_BUSOFF.P_CODE_OPENLOAD K_ED_PT_BUSOFF.P_CODE_SH_TO_GND K_ED_PT_BUSOFF.P_CODE_SH_TO_UB K_ED_PT_BUSOFF.P_CODE_UNPLAUSIBEL K_ED_PT_CRASH.DEC_NACH_EINTRAG K_ED_PT_CRASH.DEC_VOR_EINTRAG K_ED_PT_CRASH.FEHLERSCHWELLE K_ED_PT_CRASH.INC_NACH_EINTRAG K_ED_PT_CRASH.INC_VOR_EINTRAG K_ED_PT_CRASH.KLASSENINDEX K_ED_PT_CRASH.OK_SCHWELLE K_ED_PT_CRASH.P_CODE_OPENLOAD K_ED_PT_CRASH.P_CODE_SH_TO_GND K_ED_PT_CRASH.P_CODE_SH_TO_UB K_ED_PT_CRASH.P_CODE_UNPLAUSIBEL K_ED_PT_GRB.DEC_NACH_EINTRAG K_ED_PT_GRB.DEC_VOR_EINTRAG K_ED_PT_GRB.FEHLERSCHWELLE K_ED_PT_GRB.INC_NACH_EINTRAG K_ED_PT_GRB.INC_VOR_EINTRAG K_ED_PT_GRB.KLASSENINDEX K_ED_PT_GRB.OK_SCHWELLE K_ED_PT_GRB.P_CODE_OPENLOAD K_ED_PT_GRB.P_CODE_SH_TO_GND K_ED_PT_GRB.P_CODE_SH_TO_UB K_ED_PT_GRB.P_CODE_UNPLAUSIBEL K_ED_PT_GRB2.DEC_NACH_EINTRAG K_ED_PT_GRB2.DEC_VOR_EINTRAG K_ED_PT_GRB2.FEHLERSCHWELLE K_ED_PT_GRB2.INC_NACH_EINTRAG K_ED_PT_GRB2.INC_VOR_EINTRAG K_ED_PT_GRB2.KLASSENINDEX K_ED_PT_GRB2.OK_SCHWELLE K_ED_PT_GRB2.P_CODE_OPENLOAD K_ED_PT_GRB2.P_CODE_SH_TO_GND K_ED_PT_GRB2.P_CODE_SH_TO_UB K_ED_PT_GRB2.P_CODE_UNPLAUSIBEL K_ED_PT_GRB3.DEC_NACH_EINTRAG K_ED_PT_GRB3.DEC_VOR_EINTRAG K_ED_PT_GRB3.FEHLERSCHWELLE K_ED_PT_GRB3.INC_NACH_EINTRAG K_ED_PT_GRB3.INC_VOR_EINTRAG K_ED_PT_GRB3.KLASSENINDEX K_ED_PT_GRB3.OK_SCHWELLE K_ED_PT_GRB3.P_CODE_OPENLOAD K_ED_PT_GRB3.P_CODE_SH_TO_GND K_ED_PT_GRB3.P_CODE_SH_TO_UB K_ED_PT_GRB3.P_CODE_UNPLAUSIBEL K_ED_PT_KKOS.DEC_NACH_EINTRAG K_ED_PT_KKOS.DEC_VOR_EINTRAG K_ED_PT_KKOS.FEHLERSCHWELLE K_ED_PT_KKOS.INC_NACH_EINTRAG K_ED_PT_KKOS.INC_VOR_EINTRAG K_ED_PT_KKOS.KLASSENINDEX K_ED_PT_KKOS.OK_SCHWELLE K_ED_PT_KKOS.P_CODE_OPENLOAD K_ED_PT_KKOS.P_CODE_SH_TO_GND K_ED_PT_KKOS.P_CODE_SH_TO_UB K_ED_PT_KKOS.P_CODE_UNPLAUSIBEL K_ED_PT_KLST.DEC_NACH_EINTRAG K_ED_PT_KLST.DEC_VOR_EINTRAG K_ED_PT_KLST.FEHLERSCHWELLE K_ED_PT_KLST.INC_NACH_EINTRAG K_ED_PT_KLST.INC_VOR_EINTRAG K_ED_PT_KLST.KLASSENINDEX K_ED_PT_KLST.OK_SCHWELLE K_ED_PT_KLST.P_CODE_OPENLOAD K_ED_PT_KLST.P_CODE_SH_TO_GND K_ED_PT_KLST.P_CODE_SH_TO_UB K_ED_PT_KLST.P_CODE_UNPLAUSIBEL K_ED_PT_KM.DEC_NACH_EINTRAG K_ED_PT_KM.DEC_VOR_EINTRAG K_ED_PT_KM.FEHLERSCHWELLE K_ED_PT_KM.INC_NACH_EINTRAG K_ED_PT_KM.INC_VOR_EINTRAG K_ED_PT_KM.KLASSENINDEX K_ED_PT_KM.OK_SCHWELLE K_ED_PT_KM.P_CODE_OPENLOAD K_ED_PT_KM.P_CODE_SH_TO_GND K_ED_PT_KM.P_CODE_SH_TO_UB K_ED_PT_KM.P_CODE_UNPLAUSIBEL K_ED_PT_KOMBI.DEC_NACH_EINTRAG K_ED_PT_KOMBI.DEC_VOR_EINTRAG K_ED_PT_KOMBI.FEHLERSCHWELLE K_ED_PT_KOMBI.INC_NACH_EINTRAG K_ED_PT_KOMBI.INC_VOR_EINTRAG K_ED_PT_KOMBI.KLASSENINDEX K_ED_PT_KOMBI.OK_SCHWELLE K_ED_PT_KOMBI.P_CODE_OPENLOAD K_ED_PT_KOMBI.P_CODE_SH_TO_GND K_ED_PT_KOMBI.P_CODE_SH_TO_UB K_ED_PT_KOMBI.P_CODE_UNPLAUSIBEL K_ED_PT_LRW.DEC_NACH_EINTRAG K_ED_PT_LRW.DEC_VOR_EINTRAG K_ED_PT_LRW.FEHLERSCHWELLE K_ED_PT_LRW.INC_NACH_EINTRAG K_ED_PT_LRW.INC_VOR_EINTRAG K_ED_PT_LRW.KLASSENINDEX K_ED_PT_LRW.OK_SCHWELLE K_ED_PT_LRW.P_CODE_OPENLOAD K_ED_PT_LRW.P_CODE_SH_TO_GND K_ED_PT_LRW.P_CODE_SH_TO_UB K_ED_PT_LRW.P_CODE_UNPLAUSIBEL K_ED_PT_STATANH.DEC_NACH_EINTRAG K_ED_PT_STATANH.DEC_VOR_EINTRAG K_ED_PT_STATANH.FEHLERSCHWELLE K_ED_PT_STATANH.INC_NACH_EINTRAG K_ED_PT_STATANH.INC_VOR_EINTRAG K_ED_PT_STATANH.KLASSENINDEX K_ED_PT_STATANH.OK_SCHWELLE K_ED_PT_STATANH.P_CODE_OPENLOAD K_ED_PT_STATANH.P_CODE_SH_TO_GND K_ED_PT_STATANH.P_CODE_SH_TO_UB K_ED_PT_STATANH.P_CODE_UNPLAUSIBEL K_ED_PT_STATDKG.DEC_NACH_EINTRAG K_ED_PT_STATDKG.DEC_VOR_EINTRAG K_ED_PT_STATDKG.FEHLERSCHWELLE K_ED_PT_STATDKG.INC_NACH_EINTRAG K_ED_PT_STATDKG.INC_VOR_EINTRAG K_ED_PT_STATDKG.KLASSENINDEX K_ED_PT_STATDKG.OK_SCHWELLE K_ED_PT_STATDKG.P_CODE_OPENLOAD K_ED_PT_STATDKG.P_CODE_SH_TO_GND K_ED_PT_STATDKG.P_CODE_SH_TO_UB K_ED_PT_STATDKG.P_CODE_UNPLAUSIBEL K_ED_PT_STATR.DEC_NACH_EINTRAG K_ED_PT_STATR.DEC_VOR_EINTRAG K_ED_PT_STATR.FEHLERSCHWELLE K_ED_PT_STATR.INC_NACH_EINTRAG K_ED_PT_STATR.INC_VOR_EINTRAG K_ED_PT_STATR.KLASSENINDEX K_ED_PT_STATR.OK_SCHWELLE K_ED_PT_STATR.P_CODE_OPENLOAD K_ED_PT_STATR.P_CODE_SH_TO_GND K_ED_PT_STATR.P_CODE_SH_TO_UB K_ED_PT_STATR.P_CODE_UNPLAUSIBEL K_ED_PT_STDSC.DEC_NACH_EINTRAG K_ED_PT_STDSC.DEC_VOR_EINTRAG K_ED_PT_STDSC.FEHLERSCHWELLE K_ED_PT_STDSC.INC_NACH_EINTRAG K_ED_PT_STDSC.INC_VOR_EINTRAG K_ED_PT_STDSC.KLASSENINDEX K_ED_PT_STDSC.OK_SCHWELLE K_ED_PT_STDSC.P_CODE_OPENLOAD K_ED_PT_STDSC.P_CODE_SH_TO_GND K_ED_PT_STDSC.P_CODE_SH_TO_UB K_ED_PT_STDSC.P_CODE_UNPLAUSIBEL K_ED_PT_TOMA.DEC_NACH_EINTRAG K_ED_PT_TOMA.DEC_VOR_EINTRAG K_ED_PT_TOMA.FEHLERSCHWELLE K_ED_PT_TOMA.INC_NACH_EINTRAG K_ED_PT_TOMA.INC_VOR_EINTRAG K_ED_PT_TOMA.KLASSENINDEX K_ED_PT_TOMA.OK_SCHWELLE K_ED_PT_TOMA.P_CODE_OPENLOAD K_ED_PT_TOMA.P_CODE_SH_TO_GND K_ED_PT_TOMA.P_CODE_SH_TO_UB K_ED_PT_TOMA.P_CODE_UNPLAUSIBEL K_ED_PT_TORQDSC.DEC_NACH_EINTRAG K_ED_PT_TORQDSC.DEC_VOR_EINTRAG K_ED_PT_TORQDSC.FEHLERSCHWELLE K_ED_PT_TORQDSC.INC_NACH_EINTRAG K_ED_PT_TORQDSC.INC_VOR_EINTRAG K_ED_PT_TORQDSC.KLASSENINDEX K_ED_PT_TORQDSC.OK_SCHWELLE K_ED_PT_TORQDSC.P_CODE_OPENLOAD K_ED_PT_TORQDSC.P_CODE_SH_TO_GND K_ED_PT_TORQDSC.P_CODE_SH_TO_UB K_ED_PT_TORQDSC.P_CODE_UNPLAUSIBEL K_ED_PT_VEHMOD.DEC_NACH_EINTRAG K_ED_PT_VEHMOD.DEC_VOR_EINTRAG K_ED_PT_VEHMOD.FEHLERSCHWELLE K_ED_PT_VEHMOD.INC_NACH_EINTRAG K_ED_PT_VEHMOD.INC_VOR_EINTRAG K_ED_PT_VEHMOD.KLASSENINDEX K_ED_PT_VEHMOD.OK_SCHWELLE K_ED_PT_VEHMOD.P_CODE_OPENLOAD K_ED_PT_VEHMOD.P_CODE_SH_TO_GND K_ED_PT_VEHMOD.P_CODE_SH_TO_UB K_ED_PT_VEHMOD.P_CODE_UNPLAUSIBEL K_ED_PT_VFZG.DEC_NACH_EINTRAG K_ED_PT_VFZG.DEC_VOR_EINTRAG K_ED_PT_VFZG.FEHLERSCHWELLE K_ED_PT_VFZG.INC_NACH_EINTRAG K_ED_PT_VFZG.INC_VOR_EINTRAG K_ED_PT_VFZG.KLASSENINDEX K_ED_PT_VFZG.OK_SCHWELLE K_ED_PT_VFZG.P_CODE_OPENLOAD K_ED_PT_VFZG.P_CODE_SH_TO_GND K_ED_PT_VFZG.P_CODE_SH_TO_UB K_ED_PT_VFZG.P_CODE_UNPLAUSIBEL K_ED_PT_VRAD.DEC_NACH_EINTRAG K_ED_PT_VRAD.DEC_VOR_EINTRAG K_ED_PT_VRAD.FEHLERSCHWELLE K_ED_PT_VRAD.INC_NACH_EINTRAG K_ED_PT_VRAD.INC_VOR_EINTRAG K_ED_PT_VRAD.KLASSENINDEX K_ED_PT_VRAD.OK_SCHWELLE K_ED_PT_VRAD.P_CODE_OPENLOAD K_ED_PT_VRAD.P_CODE_SH_TO_GND K_ED_PT_VRAD.P_CODE_SH_TO_UB K_ED_PT_VRAD.P_CODE_UNPLAUSIBEL K_ED_PUMG.DEC_NACH_EINTRAG K_ED_PUMG.DEC_VOR_EINTRAG K_ED_PUMG.FEHLERSCHWELLE K_ED_PUMG.INC_NACH_EINTRAG K_ED_PUMG.INC_VOR_EINTRAG K_ED_PUMG.KLASSENINDEX K_ED_PUMG.OK_SCHWELLE K_ED_PUMG.P_CODE_OPENLOAD K_ED_PUMG.P_CODE_SH_TO_GND K_ED_PUMG.P_CODE_SH_TO_UB K_ED_PUMG.P_CODE_UNPLAUSIBEL K_ED_PUMG_OBD.DEC_NACH_EINTRAG K_ED_PUMG_OBD.DEC_VOR_EINTRAG K_ED_PUMG_OBD.FEHLERSCHWELLE K_ED_PUMG_OBD.INC_NACH_EINTRAG K_ED_PUMG_OBD.INC_VOR_EINTRAG K_ED_PUMG_OBD.KLASSENINDEX K_ED_PUMG_OBD.OK_SCHWELLE K_ED_PUMG_OBD.P_CODE_OPENLOAD K_ED_PUMG_OBD.P_CODE_SH_TO_GND K_ED_PUMG_OBD.P_CODE_SH_TO_UB K_ED_PUMG_OBD.P_CODE_UNPLAUSIBEL K_ED_RBM_EVAP_MAX K_ED_RBM_EVAP_MIN K_ED_RBM_EVAP_TEMP_DELTA K_ED_RBM_PUMG_MIN K_ED_RBM_TIME K_ED_RBM_TIME_LL K_ED_RBM_TIME_SLP K_ED_RBM_TIME_V K_ED_RBM_TUMG_MIN K_ED_RBM_V_MIN K_ED_RLSLP.DEC_NACH_EINTRAG K_ED_RLSLP.DEC_VOR_EINTRAG K_ED_RLSLP.FEHLERSCHWELLE K_ED_RLSLP.INC_NACH_EINTRAG K_ED_RLSLP.INC_VOR_EINTRAG K_ED_RLSLP.KLASSENINDEX K_ED_RLSLP.OK_SCHWELLE K_ED_RLSLP.P_CODE_OPENLOAD K_ED_RLSLP.P_CODE_SH_TO_GND K_ED_RLSLP.P_CODE_SH_TO_UB K_ED_RLSLP.P_CODE_UNPLAUSIBEL K_ED_RLU87.DEC_NACH_EINTRAG K_ED_RLU87.DEC_VOR_EINTRAG K_ED_RLU87.FEHLERSCHWELLE K_ED_RLU87.INC_NACH_EINTRAG K_ED_RLU87.INC_VOR_EINTRAG K_ED_RLU87.KLASSENINDEX K_ED_RLU87.OK_SCHWELLE K_ED_RLU87.P_CODE_OPENLOAD K_ED_RLU87.P_CODE_SH_TO_GND K_ED_RLU87.P_CODE_SH_TO_UB K_ED_RLU87.P_CODE_UNPLAUSIBEL K_ED_S_GETR_HS.DEC_NACH_EINTRAG K_ED_S_GETR_HS.DEC_VOR_EINTRAG K_ED_S_GETR_HS.FEHLERSCHWELLE K_ED_S_GETR_HS.INC_NACH_EINTRAG K_ED_S_GETR_HS.INC_VOR_EINTRAG K_ED_S_GETR_HS.KLASSENINDEX K_ED_S_GETR_HS.OK_SCHWELLE K_ED_S_GETR_HS.P_CODE_OPENLOAD K_ED_S_GETR_HS.P_CODE_SH_TO_GND K_ED_S_GETR_HS.P_CODE_SH_TO_UB K_ED_S_GETR_HS.P_CODE_UNPLAUSIBEL K_ED_S_KUPP_HS.DEC_NACH_EINTRAG K_ED_S_KUPP_HS.DEC_VOR_EINTRAG K_ED_S_KUPP_HS.FEHLERSCHWELLE K_ED_S_KUPP_HS.INC_NACH_EINTRAG K_ED_S_KUPP_HS.INC_VOR_EINTRAG K_ED_S_KUPP_HS.KLASSENINDEX K_ED_S_KUPP_HS.OK_SCHWELLE K_ED_S_KUPP_HS.P_CODE_OPENLOAD K_ED_S_KUPP_HS.P_CODE_SH_TO_GND K_ED_S_KUPP_HS.P_CODE_SH_TO_UB K_ED_S_KUPP_HS.P_CODE_UNPLAUSIBEL K_ED_S_POEL_DIAG.DEC_NACH_EINTRAG K_ED_S_POEL_DIAG.DEC_VOR_EINTRAG K_ED_S_POEL_DIAG.FEHLERSCHWELLE K_ED_S_POEL_DIAG.INC_NACH_EINTRAG K_ED_S_POEL_DIAG.INC_VOR_EINTRAG K_ED_S_POEL_DIAG.KLASSENINDEX K_ED_S_POEL_DIAG.OK_SCHWELLE K_ED_S_POEL_DIAG.P_CODE_OPENLOAD K_ED_S_POEL_DIAG.P_CODE_SH_TO_GND K_ED_S_POEL_DIAG.P_CODE_SH_TO_UB K_ED_S_POEL_DIAG.P_CODE_UNPLAUSIBEL K_ED_SCDN_ABDECKUNG_AUSTRAG K_ED_SCDN_ABDECKUNG_EINTRAG K_ED_SG_INJ.DEC_NACH_EINTRAG K_ED_SG_INJ.DEC_VOR_EINTRAG K_ED_SG_INJ.FEHLERSCHWELLE K_ED_SG_INJ.INC_NACH_EINTRAG K_ED_SG_INJ.INC_VOR_EINTRAG K_ED_SG_INJ.KLASSENINDEX K_ED_SG_INJ.OK_SCHWELLE K_ED_SG_INJ.P_CODE_OPENLOAD K_ED_SG_INJ.P_CODE_SH_TO_GND K_ED_SG_INJ.P_CODE_SH_TO_UB K_ED_SG_INJ.P_CODE_UNPLAUSIBEL K_ED_SK_MANAGER_INJ.DEC_NACH_EINTRAG K_ED_SK_MANAGER_INJ.DEC_VOR_EINTRAG K_ED_SK_MANAGER_INJ.FEHLERSCHWELLE K_ED_SK_MANAGER_INJ.INC_NACH_EINTRAG K_ED_SK_MANAGER_INJ.INC_VOR_EINTRAG K_ED_SK_MANAGER_INJ.KLASSENINDEX K_ED_SK_MANAGER_INJ.OK_SCHWELLE K_ED_SK_MANAGER_INJ.P_CODE_OPENLOAD K_ED_SK_MANAGER_INJ.P_CODE_SH_TO_GND K_ED_SK_MANAGER_INJ.P_CODE_SH_TO_UB K_ED_SK_MANAGER_INJ.P_CODE_UNPLAUSIBEL K_ED_SK_TR_INJ.DEC_NACH_EINTRAG K_ED_SK_TR_INJ.DEC_VOR_EINTRAG K_ED_SK_TR_INJ.FEHLERSCHWELLE K_ED_SK_TR_INJ.INC_NACH_EINTRAG K_ED_SK_TR_INJ.INC_VOR_EINTRAG K_ED_SK_TR_INJ.KLASSENINDEX K_ED_SK_TR_INJ.OK_SCHWELLE K_ED_SK_TR_INJ.P_CODE_OPENLOAD K_ED_SK_TR_INJ.P_CODE_SH_TO_GND K_ED_SK_TR_INJ.P_CODE_SH_TO_UB K_ED_SK_TR_INJ.P_CODE_UNPLAUSIBEL K_ED_SL_DURCHS_B1.DEC_NACH_EINTRAG K_ED_SL_DURCHS_B1.DEC_VOR_EINTRAG K_ED_SL_DURCHS_B1.FEHLERSCHWELLE K_ED_SL_DURCHS_B1.INC_NACH_EINTRAG K_ED_SL_DURCHS_B1.INC_VOR_EINTRAG K_ED_SL_DURCHS_B1.KLASSENINDEX K_ED_SL_DURCHS_B1.OK_SCHWELLE K_ED_SL_DURCHS_B1.P_CODE_OPENLOAD K_ED_SL_DURCHS_B1.P_CODE_SH_TO_GND K_ED_SL_DURCHS_B1.P_CODE_SH_TO_UB K_ED_SL_DURCHS_B1.P_CODE_UNPLAUSIBEL K_ED_SL_DURCHS_B2.DEC_NACH_EINTRAG K_ED_SL_DURCHS_B2.DEC_VOR_EINTRAG K_ED_SL_DURCHS_B2.FEHLERSCHWELLE K_ED_SL_DURCHS_B2.INC_NACH_EINTRAG K_ED_SL_DURCHS_B2.INC_VOR_EINTRAG K_ED_SL_DURCHS_B2.KLASSENINDEX K_ED_SL_DURCHS_B2.OK_SCHWELLE K_ED_SL_DURCHS_B2.P_CODE_OPENLOAD K_ED_SL_DURCHS_B2.P_CODE_SH_TO_GND K_ED_SL_DURCHS_B2.P_CODE_SH_TO_UB K_ED_SL_DURCHS_B2.P_CODE_UNPLAUSIBEL /end DEF_CHARACTERISTIC
/end FUNCTION
/begin RECORD_LAYOUT TKW_VV_VV_SW FNC_VALUES 1 SWORD COLUMN_DIR DIRECT /end RECORD_LAYOUT
/begin RECORD_LAYOUT TKW_VV_VV_UB FNC_VALUES 1 UBYTE COLUMN_DIR DIRECT /end RECORD_LAYOUT
/begin RECORD_LAYOUT TKW_VV_VV_UW FNC_VALUES 1 UWORD COLUMN_DIR DIRECT /end RECORD_LAYOUT
/end MODULE
/end PROJECT
