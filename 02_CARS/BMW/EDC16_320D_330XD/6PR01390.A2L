ASAP2_VERSION 1 3
/begin PROJECT P390 "BMW DDE6.2 6-Zylinder VR0.1 15.03.2004 CAN11/12H"
/begin HEADER "" VERSION "VR0.1_6Z_CAN11/12H" PROJECT_NO P390 /end HEADER
/begin MODULE DIM ""
/begin MOD_COMMON "" BYTE_ORDER MSB_FIRST ALIGNMENT_BYTE 1 ALIGNMENT_WORD 2 ALIGNMENT_LONG 4 ALIGNMENT_FLOAT32_IEEE 4 /end MOD_COMMON
/begin CHARACTERISTIC DSM_SdwDfp_Layer_TANS_C "Enprellzeit Shadow Zustand für Fehlerpfad Dfp_Layer_TANS" VALUE 0xCD6B4 Kw_Wu16 655350.0 Time_ms 0.00 655350.0 FORMAT "%8.1" /end CHARACTERISTIC
/begin CHARACTERISTIC DSM_SdwDfp_ACCDCmpr_C "Enprellzeit Shadow Zustand für Fehlerpfad Dfp_ACCDCmpr" VALUE 0xCD6B6 Kw_Wu16 655350.0 Time_ms 0.00 655350.0 FORMAT "%8.1" /end CHARACTERISTIC
/begin CHARACTERISTIC DSM_SdwDfp_ACCDPres_C "Enprellzeit Shadow Zustand für Fehlerpfad Dfp_ACCDPres" VALUE 0xCD6B8 Kw_Wu16 655350.0 Time_ms 0.00 655350.0 FORMAT "%8.1" /end CHARACTERISTIC
/begin CHARACTERISTIC DSM_SdwDfp_ACCDPres1_C "Enprellzeit Shadow Zustand für Fehlerpfad Dfp_ACCDPres1" VALUE 0xCD6BA Kw_Wu16 655350.0 Time_ms 0.00 655350.0 FORMAT "%8.1" /end CHARACTERISTIC
/begin CHARACTERISTIC DSM_SdwDfp_ACCDPresAna_C "Enprellzeit Shadow Zustand für Fehlerpfad Dfp_ACCDPresAna" VALUE 0xCD6BC Kw_Wu16 655350.0 Time_ms 0.00 655350.0 FORMAT "%8.1" /end CHARACTERISTIC
/begin CHARACTERISTIC DSM_SdwDfp_ACCDSwtin_C "Enprellzeit Shadow Zustand für Fehlerpfad Dfp_ACCDSwtin" VALUE 0xCD6BE Kw_Wu16 655350.0 Time_ms 0.00 655350.0 FORMAT "%8.1" /end CHARACTERISTIC
/begin CHARACTERISTIC DSM_SdwDfp_ACC_PlausTrqDes_C "Enprellzeit Shadow Zustand für Fehlerpfad Dfp_ACC_PlausTrqDes" VALUE 0xCD6C0 Kw_Wu16 655350.0 Time_ms 0.00 655350.0 FORMAT "%8.1" /end CHARACTERISTIC
/begin CHARACTERISTIC DSM_SdwDfp_ACC_trqInr_C "Enprellzeit Shadow Zustand für Fehlerpfad Dfp_ACC_trqInr" VALUE 0xCD6C2 Kw_Wu16 655350.0 Time_ms 0.00 655350.0 FORMAT "%8.1" /end CHARACTERISTIC
/begin CHARACTERISTIC DSM_SdwDfp_ACTrq_C "Enprellzeit Shadow Zustand für Fehlerpfad Dfp_ACTrq" VALUE 0xCD6C4 Kw_Wu16 655350.0 Time_ms 0.00 655350.0 FORMAT "%8.1" /end CHARACTERISTIC
/begin CHARACTERISTIC DSM_SdwDfp_ADCMon_C "Enprellzeit Shadow Zustand für Fehlerpfad Dfp_ADCMon" VALUE 0xCD6C6 Kw_Wu16 655350.0 Time_ms 0.00 655350.0 FORMAT "%8.1" /end CHARACTERISTIC
/begin CHARACTERISTIC DSM_SdwDfp_AFSCDIdlAdjVal_C "Enprellzeit Shadow Zustand für Fehlerpfad Dfp_AFSCDIdlAdjVal" VALUE 0xCD6C8 Kw_Wu16 655350.0 Time_ms 0.00 655350.0 FORMAT "%8.1" /end CHARACTERISTIC
/begin CHARACTERISTIC DSM_SdwDfp_AFSCDLdAdjVal_C "Enprellzeit Shadow Zustand für Fehlerpfad Dfp_AFSCDLdAdjVal" VALUE 0xCD6CA Kw_Wu16 655350.0 Time_ms 0.00 655350.0 FORMAT "%8.1" /end CHARACTERISTIC
/begin CHARACTERISTIC DSM_SdwDfp_AFSCD_AirTempDcyc_C "Enprellzeit Shadow Zustand für Fehlerpfad Dfp_AFSCD_AirTempDcyc" VALUE 0xCD6CC Kw_Wu16 655350.0 Time_ms 0.00 655350.0 FORMAT "%8.1" /end CHARACTERISTIC
/begin CHARACTERISTIC DSM_SdwDfp_AFSCD_PlOffsDrft_C "Enprellzeit Shadow Zustand für Fehlerpfad Dfp_AFSCD_PlOffsDrft" VALUE 0xCD6CE Kw_Wu16 655350.0 Time_ms 0.00 655350.0 FORMAT "%8.1" /end CHARACTERISTIC
/begin CHARACTERISTIC DSM_SdwDfp_AFSCD_PlSetyDrft_C "Enprellzeit Shadow Zustand für Fehlerpfad Dfp_AFSCD_PlSetyDrft" VALUE 0xCD6D0 Kw_Wu16 655350.0 Time_ms 0.00 655350.0 FORMAT "%8.1" /end CHARACTERISTIC
/begin CHARACTERISTIC DSM_SdwDfp_AFSCD_SRCAirTemp_C "Enprellzeit Shadow Zustand für Fehlerpfad Dfp_AFSCD_SRCAirTemp" VALUE 0xCD6D2 Kw_Wu16 655350.0 Time_ms 0.00 655350.0 FORMAT "%8.1" /end CHARACTERISTIC
/begin CHARACTERISTIC DSM_SdwDfp_AFSCD_SRCBatt_C "Enprellzeit Shadow Zustand für Fehlerpfad Dfp_AFSCD_SRCBatt" VALUE 0xCD6D4 Kw_Wu16 655350.0 Time_ms 0.00 655350.0 FORMAT "%8.1" /end CHARACTERISTIC
/begin CHARACTERISTIC DSM_SdwDfp_AFSCD_SRCCorrAirm_C "Enprellzeit Shadow Zustand für Fehlerpfad Dfp_AFSCD_SRCCorrAirm" VALUE 0xCD6D6 Kw_Wu16 655350.0 Time_ms 0.00 655350.0 FORMAT "%8.1" /end CHARACTERISTIC
/begin CHARACTERISTIC DSM_SdwDfp_AFSCD_SRCRawAirm_C "Enprellzeit Shadow Zustand für Fehlerpfad Dfp_AFSCD_SRCRawAirm" VALUE 0xCD6D8 Kw_Wu16 655350.0 Time_ms 0.00 655350.0 FORMAT "%8.1" /end CHARACTERISTIC
/begin CHARACTERISTIC DSM_SdwDfp_Layer_TUMG_C "Enprellzeit Shadow Zustand für Fehlerpfad Dfp_Layer_TUMG" VALUE 0xCD6DA Kw_Wu16 655350.0 Time_ms 0.00 655350.0 FORMAT "%8.1" /end CHARACTERISTIC
/begin CHARACTERISTIC DSM_SdwDfp_AFSCD_SRCRefSigPer_C "Enprellzeit Shadow Zustand für Fehlerpfad Dfp_AFSCD_SRCRefSigPer" VALUE 0xCD6DC Kw_Wu16 655350.0 Time_ms 0.00 655350.0 FORMAT "%8.1" /end CHARACTERISTIC
/begin CHARACTERISTIC DSM_SdwDfp_AOHtCD_C "Enprellzeit Shadow Zustand für Fehlerpfad Dfp_AOHtCD" VALUE 0xCD6DE Kw_Wu16 655350.0 Time_ms 0.00 655350.0 FORMAT "%8.1" /end CHARACTERISTIC
/begin CHARACTERISTIC DSM_SdwDfp_Layer_GEN_C "Enprellzeit Shadow Zustand für Fehlerpfad Dfp_Layer_GEN" VALUE 0xCD6E0 Kw_Wu16 655350.0 Time_ms 0.00 655350.0 FORMAT "%8.1" /end CHARACTERISTIC
/begin CHARACTERISTIC DSM_SdwDfp_Layer_BSD_C "Enprellzeit Shadow Zustand für Fehlerpfad Dfp_Layer_BSD" VALUE 0xCD6E2 Kw_Wu16 655350.0 Time_ms 0.00 655350.0 FORMAT "%8.1" /end CHARACTERISTIC
/begin CHARACTERISTIC DSM_SdwDfp_AOHtCD_AOHtDia1_C "Enprellzeit Shadow Zustand für Fehlerpfad Dfp_AOHtCD_AOHtDia1" VALUE 0xCD6E4 Kw_Wu16 655350.0 Time_ms 0.00 655350.0 FORMAT "%8.1" /end CHARACTERISTIC
/begin CHARACTERISTIC DSM_SdwDfp_AOHtCD_AOHtDia2_C "Enprellzeit Shadow Zustand für Fehlerpfad Dfp_AOHtCD_AOHtDia2" VALUE 0xCD6E6 Kw_Wu16 655350.0 Time_ms 0.00 655350.0 FORMAT "%8.1" /end CHARACTERISTIC
/begin CHARACTERISTIC DSM_SdwDfp_AOHtCD_AOHtDia3_C "Enprellzeit Shadow Zustand für Fehlerpfad Dfp_AOHtCD_AOHtDia3" VALUE 0xCD6E8 Kw_Wu16 655350.0 Time_ms 0.00 655350.0 FORMAT "%8.1" /end CHARACTERISTIC
/begin CHARACTERISTIC DSM_SdwDfp_APP1_C "Enprellzeit Shadow Zustand für Fehlerpfad Dfp_APP1" VALUE 0xCD6EA Kw_Wu16 655350.0 Time_ms 0.00 655350.0 FORMAT "%8.1" /end CHARACTERISTIC
/begin CHARACTERISTIC DSM_SdwDfp_APP2_C "#SSD Enprellzeit Shadow Zustand für Fehlerpfad Dfp_APP2" VALUE 0xCD6EC Kw_Wu16 655350.0 Time_ms 0.00 655350.0 FORMAT "%8.1" /end CHARACTERISTIC
/begin CHARACTERISTIC DSM_SdwDfp_APPSync_C "Enprellzeit Shadow Zustand für Fehlerpfad Dfp_APPSync" VALUE 0xCD6EE Kw_Wu16 655350.0 Time_ms 0.00 655350.0 FORMAT "%8.1" /end CHARACTERISTIC
/begin CHARACTERISTIC DSM_SdwDfp_APSCD_C "Enprellzeit Shadow Zustand für Fehlerpfad Dfp_APSCD" VALUE 0xCD6F0 Kw_Wu16 655350.0 Time_ms 0.00 655350.0 FORMAT "%8.1" /end CHARACTERISTIC
/begin CHARACTERISTIC DSM_SdwDfp_ARS_C "Enprellzeit Shadow Zustand für Fehlerpfad Dfp_ARS" VALUE 0xCD6F2 Kw_Wu16 655350.0 Time_ms 0.00 655350.0 FORMAT "%8.1" /end CHARACTERISTIC
/begin CHARACTERISTIC DSM_SdwDfp_AccPedPlausBrk_C "Enprellzeit Shadow Zustand für Fehlerpfad Dfp_AccPedPlausBrk" VALUE 0xCD6F4 Kw_Wu16 655350.0 Time_ms 0.00 655350.0 FORMAT "%8.1" /end CHARACTERISTIC
/begin CHARACTERISTIC DSM_SdwDfp_AirCtlGvnrDvtRgnMax_C "Enprellzeit Shadow Zustand für Fehlerpfad Dfp_AirCtlGvnrDvtRgnMax" VALUE 0xCD6F6 Kw_Wu16 655350.0 Time_ms 0.00 655350.0 FORMAT "%8.1" /end CHARACTERISTIC
/begin CHARACTERISTIC DSM_SdwDfp_Layer_QLT_C "Enprellzeit Shadow Zustand für Fehlerpfad Dfp_Layer_QLT" VALUE 0xCD6F8 Kw_Wu16 655350.0 Time_ms 0.00 655350.0 FORMAT "%8.1" /end CHARACTERISTIC
/begin CHARACTERISTIC DSM_SdwDfp_AirCtlGvnrDvtRgnMax2_C "" VALUE 0xCD6FA Kw_Wu16 655350.0 Time_ms 0.00 655350.0 FORMAT "%8.1" /end CHARACTERISTIC
/begin CHARACTERISTIC DSM_SdwDfp_Layer_IBS1_C "Enprellzeit Shadow Zustand für Fehlerpfad Dfp_Layer_IBS1" VALUE 0xCD6FC Kw_Wu16 655350.0 Time_ms 0.00 655350.0 FORMAT "%8.1" /end CHARACTERISTIC
/begin CHARACTERISTIC DSM_SdwDfp_Layer_IBS2_C "Enprellzeit Shadow Zustand für Fehlerpfad Dfp_Layer_IBS2" VALUE 0xCD6FE Kw_Wu16 655350.0 Time_ms 0.00 655350.0 FORMAT "%8.1" /end CHARACTERISTIC
/begin CHARACTERISTIC DSM_SdwDfp_Layer_IBS3_C "Enprellzeit Shadow Zustand für Fehlerpfad Dfp_Layer_IBS3" VALUE 0xCD700 Kw_Wu16 655350.0 Time_ms 0.00 655350.0 FORMAT "%8.1" /end CHARACTERISTIC
/begin CHARACTERISTIC DSM_SdwDfp_Layer_PMBN_C "Enprellzeit Shadow Zustand für Fehlerpfad Dfp_Layer_PMBN" VALUE 0xCD702 Kw_Wu16 655350.0 Time_ms 0.00 655350.0 FORMAT "%8.1" /end CHARACTERISTIC
/begin CHARACTERISTIC DSM_SdwDfp_Layer_PMBATT_C "Enprellzeit Shadow Zustand für Fehlerpfad Dfp_Layer_PMBATT" VALUE 0xCD704 Kw_Wu16 655350.0 Time_ms 0.00 655350.0 FORMAT "%8.1" /end CHARACTERISTIC
/begin CHARACTERISTIC DSM_SdwDfp_AirCtlGvnrDvtRgnMin_C "Enprellzeit Shadow Zustand für Fehlerpfad Dfp_AirCtlGvnrDvtRgnMin" VALUE 0xCD706 Kw_Wu16 655350.0 Time_ms 0.00 655350.0 FORMAT "%8.1" /end CHARACTERISTIC
/begin CHARACTERISTIC DSM_SdwDfp_AirCtlGvnrDvtRgnMin2_C "" VALUE 0xCD708 Kw_Wu16 655350.0 Time_ms 0.00 655350.0 FORMAT "%8.1" /end CHARACTERISTIC
/begin CHARACTERISTIC DSM_SdwDfp_AirCtlPlateBreak_C "DSM variable for Dfp_AirCtlPlateBreak_mp" VALUE 0xCD70A Kw_Wu16 655350.0 Time_ms 0.00 655350.0 FORMAT "%8.1" /end CHARACTERISTIC
/begin CHARACTERISTIC DSM_SdwDfp_AirCtlRmpTO_C "Enprellzeit Shadow Zustand für Fehlerpfad Dfp_AirCtlRmpTO" VALUE 0xCD70C Kw_Wu16 655350.0 Time_ms 0.00 655350.0 FORMAT "%8.1" /end CHARACTERISTIC
/begin CHARACTERISTIC DSM_SdwDfp_AirCtl_GovNegDev_C "Enprellzeit Shadow Zustand für Fehlerpfad Dfp_AirCtl_GovNegDev" VALUE 0xCD70E Kw_Wu16 655350.0 Time_ms 0.00 655350.0 FORMAT "%8.1" /end CHARACTERISTIC
/begin CHARACTERISTIC DSM_SdwDfp_AirCtl_GovNegDev2_C "Enprellzeit Shadow Zustand für Fehlerpfad Dfp_AirCtl_GovNegDev2" VALUE 0xCD710 Kw_Wu16 655350.0 Time_ms 0.00 655350.0 FORMAT "%8.1" /end CHARACTERISTIC
/begin CHARACTERISTIC DSM_SdwDfp_AirCtl_GovPosDev_C "Enprellzeit Shadow Zustand für Fehlerpfad Dfp_AirCtl_GovPosDev" VALUE 0xCD712 Kw_Wu16 655350.0 Time_ms 0.00 655350.0 FORMAT "%8.1" /end CHARACTERISTIC
/begin CHARACTERISTIC DSM_SdwDfp_AirCtl_GovPosDev2_C "Enprellzeit Shadow Zustand für Fehlerpfad Dfp_AirCtl_GovPosDev2" VALUE 0xCD714 Kw_Wu16 655350.0 Time_ms 0.00 655350.0 FORMAT "%8.1" /end CHARACTERISTIC
/begin CHARACTERISTIC DSM_SdwDfp_AltCD_C "Enprellzeit Shadow Zustand für Fehlerpfad Dfp_AltCD" VALUE 0xCD716 Kw_Wu16 655350.0 Time_ms 0.00 655350.0 FORMAT "%8.1" /end CHARACTERISTIC
/begin CHARACTERISTIC DSM_SdwDfp_AltCD_Load_C "Enprellzeit Shadow Zustand für Fehlerpfad Dfp_AltCD_Load" VALUE 0xCD718 Kw_Wu16 655350.0 Time_ms 0.00 655350.0 FORMAT "%8.1" /end CHARACTERISTIC
/begin CHARACTERISTIC DSM_SdwDfp_BPACD_BPADia1_C "Enprellzeit Shadow Zustand für Fehlerpfad Dfp_BPACD_BPADia1" VALUE 0xCD71A Kw_Wu16 655350.0 Time_ms 0.00 655350.0 FORMAT "%8.1" /end CHARACTERISTIC
/begin CHARACTERISTIC DSM_SdwDfp_BPACD_BPADia2_C "Enprellzeit Shadow Zustand für Fehlerpfad Dfp_BPACD_BPADia2" VALUE 0xCD71C Kw_Wu16 655350.0 Time_ms 0.00 655350.0 FORMAT "%8.1" /end CHARACTERISTIC
/begin CHARACTERISTIC DSM_SdwDfp_BPACD_BPADia3_C "Enprellzeit Shadow Zustand für Fehlerpfad Dfp_BPACD_BPADia3" VALUE 0xCD71E Kw_Wu16 655350.0 Time_ms 0.00 655350.0 FORMAT "%8.1" /end CHARACTERISTIC
/begin CHARACTERISTIC DSM_SdwDfp_BPACD_Max_C "Enprellzeit Shadow Zustand für Fehlerpfad Dfp_BPACD_Max" VALUE 0xCD720 Kw_Wu16 655350.0 Time_ms 0.00 655350.0 FORMAT "%8.1" /end CHARACTERISTIC
/begin CHARACTERISTIC DSM_SdwDfp_BPACD_Min_C "Enprellzeit Shadow Zustand für Fehlerpfad Dfp_BPACD_Min" VALUE 0xCD722 Kw_Wu16 655350.0 Time_ms 0.00 655350.0 FORMAT "%8.1" /end CHARACTERISTIC
/begin CHARACTERISTIC DSM_SdwDfp_BPACD_SigNpl_C "Enprellzeit Shadow Zustand für Fehlerpfad Dfp_BPACD_SigNpl" VALUE 0xCD724 Kw_Wu16 655350.0 Time_ms 0.00 655350.0 FORMAT "%8.1" /end CHARACTERISTIC
/begin CHARACTERISTIC DSM_SdwDfp_BPSCD_C "Enprellzeit Shadow Zustand für Fehlerpfad Dfp_BPSCD" VALUE 0xCD726 Kw_Wu16 655350.0 Time_ms 0.00 655350.0 FORMAT "%8.1" /end CHARACTERISTIC
/begin CHARACTERISTIC DSM_SdwDfp_BattCD_C "Enprellzeit Shadow Zustand für Fehlerpfad Dfp_BattCD" VALUE 0xCD728 Kw_Wu16 655350.0 Time_ms 0.00 655350.0 FORMAT "%8.1" /end CHARACTERISTIC
/begin CHARACTERISTIC DSM_SdwDfp_BrkCD_C "Enprellzeit Shadow Zustand für Fehlerpfad Dfp_BrkCD" VALUE 0xCD72A Kw_Wu16 655350.0 Time_ms 0.00 655350.0 FORMAT "%8.1" /end CHARACTERISTIC
/begin CHARACTERISTIC DSM_SdwDfp_Bss_C "Enprellzeit Shadow Zustand für Fehlerpfad Dfp_Bss" VALUE 0xCD72C Kw_Wu16 655350.0 Time_ms 0.00 655350.0 FORMAT "%8.1" /end CHARACTERISTIC
/begin CHARACTERISTIC DSM_SdwDfp_CBACD_C "Enprellzeit Shadow Zustand für Fehlerpfad Dfp_CBACD" VALUE 0xCD72E Kw_Wu16 655350.0 Time_ms 0.00 655350.0 FORMAT "%8.1" /end CHARACTERISTIC
/begin CHARACTERISTIC DSM_SdwDfp_CTSCD_C "Enprellzeit Shadow Zustand für Fehlerpfad Dfp_CTSCD" VALUE 0xCD730 Kw_Wu16 655350.0 Time_ms 0.00 655350.0 FORMAT "%8.1" /end CHARACTERISTIC
/begin CHARACTERISTIC DSM_SdwDfp_Clg_DynTst_C "Enprellzeit Shadow Zustand für Fehlerpfad Dfp_Clg_DynTst" VALUE 0xCD732 Kw_Wu16 655350.0 Time_ms 0.00 655350.0 FORMAT "%8.1" /end CHARACTERISTIC
/begin CHARACTERISTIC DSM_SdwDfp_CmbChbMisfire1_C "Enprellzeit Shadow Zustand für Fehlerpfad Dfp_CmbChbMisfire1" VALUE 0xCD734 Kw_Wu16 655350.0 Time_ms 0.00 655350.0 FORMAT "%8.1" /end CHARACTERISTIC
/begin CHARACTERISTIC DSM_SdwDfp_CmbChbMisfire2_C "Enprellzeit Shadow Zustand für Fehlerpfad Dfp_CmbChbMisfire2" VALUE 0xCD736 Kw_Wu16 655350.0 Time_ms 0.00 655350.0 FORMAT "%8.1" /end CHARACTERISTIC
/begin CHARACTERISTIC DSM_SdwDfp_CmbChbMisfire3_C "Enprellzeit Shadow Zustand für Fehlerpfad Dfp_CmbChbMisfire3" VALUE 0xCD738 Kw_Wu16 655350.0 Time_ms 0.00 655350.0 FORMAT "%8.1" /end CHARACTERISTIC
/begin CHARACTERISTIC DSM_SdwDfp_CmbChbMisfire4_C "Enprellzeit Shadow Zustand für Fehlerpfad Dfp_CmbChbMisfire4" VALUE 0xCD73A Kw_Wu16 655350.0 Time_ms 0.00 655350.0 FORMAT "%8.1" /end CHARACTERISTIC
/begin CHARACTERISTIC DSM_SdwDfp_CmbChbMisfire5_C "Enprellzeit Shadow Zustand für Fehlerpfad Dfp_CmbChbMisfire5" VALUE 0xCD73C Kw_Wu16 655350.0 Time_ms 0.00 655350.0 FORMAT "%8.1" /end CHARACTERISTIC
/begin CHARACTERISTIC DSM_SdwDfp_CmbChbMisfire6_C "Enprellzeit Shadow Zustand für Fehlerpfad Dfp_CmbChbMisfire6" VALUE 0xCD73E Kw_Wu16 655350.0 Time_ms 0.00 655350.0 FORMAT "%8.1" /end CHARACTERISTIC
/begin CHARACTERISTIC DSM_SdwDfp_CmbChbMisfireMul_C "Enprellzeit Shadow Zustand für Fehlerpfad Dfp_CmbChbMisfireMul" VALUE 0xCD740 Kw_Wu16 655350.0 Time_ms 0.00 655350.0 FORMAT "%8.1" /end CHARACTERISTIC
/begin CHARACTERISTIC DSM_SdwDfp_CoVMDCSh_C "Enprellzeit Shadow Zustand für Fehlerpfad Dfp_CoVMDCSh" VALUE 0xCD742 Kw_Wu16 655350.0 Time_ms 0.00 655350.0 FORMAT "%8.1" /end CHARACTERISTIC
/begin CHARACTERISTIC DSM_SdwDfp_ConvCD_C "Enprellzeit Shadow Zustand für Fehlerpfad Dfp_ConvCD" VALUE 0xCD744 Kw_Wu16 655350.0 Time_ms 0.00 655350.0 FORMAT "%8.1" /end CHARACTERISTIC
/begin CHARACTERISTIC DSM_SdwDfp_Layer_PMRUHVERL_C "Enprellzeit Shadow Zustand für Fehlerpfad Dfp_Layer_PMRUHVERL" VALUE 0xCD746 Kw_Wu16 655350.0 Time_ms 0.00 655350.0 FORMAT "%8.1" /end CHARACTERISTIC
/begin CHARACTERISTIC DSM_SdwDfp_CrCCDMFL_C "Enprellzeit Shadow Zustand für Fehlerpfad Dfp_CrCCDMFL" VALUE 0xCD748 Kw_Wu16 655350.0 Time_ms 0.00 655350.0 FORMAT "%8.1" /end CHARACTERISTIC
/begin CHARACTERISTIC DSM_SdwDfp_CrCtl_vCrCtl_C "Enprellzeit Shadow Zustand für Fehlerpfad Dfp_CrCtl_vCrCtl" VALUE 0xCD74A Kw_Wu16 655350.0 Time_ms 0.00 655350.0 FORMAT "%8.1" /end CHARACTERISTIC
/begin CHARACTERISTIC DSM_SdwDfp_DCC_PlausTrqDes_C "Enprellzeit Shadow Zustand für Fehlerpfad Dfp_DCC_PlausTrqDes" VALUE 0xCD74C Kw_Wu16 655350.0 Time_ms 0.00 655350.0 FORMAT "%8.1" /end CHARACTERISTIC
/begin CHARACTERISTIC DSM_SdwDfp_Dummy1_C "Enprellzeit Shadow Zustand für Fehlerpfad Dfp_Dummy1" VALUE 0xCD74E Kw_Wu16 655350.0 Time_ms 0.00 655350.0 FORMAT "%8.1" /end CHARACTERISTIC
/begin CHARACTERISTIC DSM_SdwDfp_Layer_TOENS_C "Enprellzeit Shadow Zustand für Fehlerpfad Dfp_Layer_TOENS" VALUE 0xCD750 Kw_Wu16 655350.0 Time_ms 0.00 655350.0 FORMAT "%8.1" /end CHARACTERISTIC
/begin CHARACTERISTIC DSM_SdwDfp_Layer_MANHYDR_C "Enprellzeit Shadow Zustand für Fehlerpfad Dfp_Layer_MANHYDR" VALUE 0xCD752 Kw_Wu16 655350.0 Time_ms 0.00 655350.0 FORMAT "%8.1" /end CHARACTERISTIC
/begin CHARACTERISTIC DSM_SdwDfp_Layer_MANLUFT_C "Enprellzeit Shadow Zustand für Fehlerpfad Dfp_Layer_MANLUFT" VALUE 0xCD754 Kw_Wu16 655350.0 Time_ms 0.00 655350.0 FORMAT "%8.1" /end CHARACTERISTIC
/begin CHARACTERISTIC DSM_SdwDfp_EATSCD_C "Enprellzeit Shadow Zustand für Fehlerpfad Dfp_EATSCD" VALUE 0xCD756 Kw_Wu16 655350.0 Time_ms 0.00 655350.0 FORMAT "%8.1" /end CHARACTERISTIC
/begin CHARACTERISTIC DSM_SdwDfp_EBAFCD_C "Enprellzeit Shadow Zustand für Fehlerpfad Dfp_EBAFCD" VALUE 0xCD758 Kw_Wu16 655350.0 Time_ms 0.00 655350.0 FORMAT "%8.1" /end CHARACTERISTIC
/begin CHARACTERISTIC DSM_SdwDfp_EBFCD_C "Enprellzeit Shadow Zustand für Fehlerpfad Dfp_EBFCD" VALUE 0xCD75A Kw_Wu16 655350.0 Time_ms 0.00 655350.0 FORMAT "%8.1" /end CHARACTERISTIC
/begin CHARACTERISTIC DSM_SdwDfp_EBTSCD_C "Enprellzeit Shadow Zustand für Fehlerpfad Dfp_EBTSCD" VALUE 0xCD75C Kw_Wu16 655350.0 Time_ms 0.00 655350.0 FORMAT "%8.1" /end CHARACTERISTIC
/begin CHARACTERISTIC DSM_SdwDfp_EBTSCD_OvrTemp_C "Enprellzeit Shadow Zustand für Fehlerpfad Dfp_EBTSCD_OvrTemp" VALUE 0xCD75E Kw_Wu16 655350.0 Time_ms 0.00 655350.0 FORMAT "%8.1" /end CHARACTERISTIC
/begin CHARACTERISTIC DSM_SdwDfp_EEPCDVarMng_C "Enprellzeit Shadow Zustand für Fehlerpfad Dfp_EEPCDVarMng" VALUE 0xCD760 Kw_Wu16 655350.0 Time_ms 0.00 655350.0 FORMAT "%8.1" /end CHARACTERISTIC
/begin CHARACTERISTIC DSM_SdwDfp_EGPpCD_C "Enprellzeit Shadow Zustand für Fehlerpfad Dfp_EGPpCD" VALUE 0xCD762 Kw_Wu16 655350.0 Time_ms 0.00 655350.0 FORMAT "%8.1" /end CHARACTERISTIC
/begin CHARACTERISTIC DSM_SdwDfp_EGPpCDTPreTrbn_C "Enprellzeit Shadow Zustand für Fehlerpfad Dfp_EgPpCDTPreTrbn" VALUE 0xCD764 Kw_Wu16 655350.0 Time_ms 0.00 655350.0 FORMAT "%8.1" /end CHARACTERISTIC
/begin CHARACTERISTIC DSM_SdwDfp_EGRCD_Max_C "Enprellzeit Shadow Zustand für Fehlerpfad Dfp_EGRCD_Max" VALUE 0xCD766 Kw_Wu16 655350.0 Time_ms 0.00 655350.0 FORMAT "%8.1" /end CHARACTERISTIC
/begin CHARACTERISTIC DSM_SdwDfp_EGRCD_Min_C "Enprellzeit Shadow Zustand für Fehlerpfad Dfp_EGRCD_Min" VALUE 0xCD768 Kw_Wu16 655350.0 Time_ms 0.00 655350.0 FORMAT "%8.1" /end CHARACTERISTIC
/begin CHARACTERISTIC DSM_SdwDfp_EGRCD_SigNpl_C "Enprellzeit Shadow Zustand für Fehlerpfad Dfp_EGRCD_SigNpl" VALUE 0xCD76A Kw_Wu16 655350.0 Time_ms 0.00 655350.0 FORMAT "%8.1" /end CHARACTERISTIC
/begin CHARACTERISTIC DSM_SdwDfp_EGTRgnOilDil_C "Enprellzeit Shadow Zustand für Fehlerpfad Dfp_EGTRgnOilDil" VALUE 0xCD76C Kw_Wu16 655350.0 Time_ms 0.00 655350.0 FORMAT "%8.1" /end CHARACTERISTIC
/begin CHARACTERISTIC DSM_SdwDfp_EMCCDNoLoad1_C "Enprellzeit Shadow Zustand für Fehlerpfad Dfp_EMCCDNoLoad1" VALUE 0xCD76E Kw_Wu16 655350.0 Time_ms 0.00 655350.0 FORMAT "%8.1" /end CHARACTERISTIC
/begin CHARACTERISTIC DSM_SdwDfp_EMCCDNoLoad2_C "Enprellzeit Shadow Zustand für Fehlerpfad Dfp_EMCCDNoLoad2" VALUE 0xCD770 Kw_Wu16 655350.0 Time_ms 0.00 655350.0 FORMAT "%8.1" /end CHARACTERISTIC
/begin CHARACTERISTIC DSM_SdwDfp_EMCCDSCBat1_C "Enprellzeit Shadow Zustand für Fehlerpfad Dfp_EMCCDSCBat1" VALUE 0xCD772 Kw_Wu16 655350.0 Time_ms 0.00 655350.0 FORMAT "%8.1" /end CHARACTERISTIC
/begin CHARACTERISTIC DSM_SdwDfp_EMCCDSCBat2_C "Enprellzeit Shadow Zustand für Fehlerpfad Dfp_EMCCDSCBat2" VALUE 0xCD774 Kw_Wu16 655350.0 Time_ms 0.00 655350.0 FORMAT "%8.1" /end CHARACTERISTIC
/begin CHARACTERISTIC DSM_SdwDfp_EMCCDSCGnd1_C "Enprellzeit Shadow Zustand für Fehlerpfad Dfp_EMCCDSCGnd1" VALUE 0xCD776 Kw_Wu16 655350.0 Time_ms 0.00 655350.0 FORMAT "%8.1" /end CHARACTERISTIC
/begin CHARACTERISTIC DSM_SdwDfp_EMCCDSCGnd2_C "Enprellzeit Shadow Zustand für Fehlerpfad Dfp_EMCCDSCGnd2" VALUE 0xCD778 Kw_Wu16 655350.0 Time_ms 0.00 655350.0 FORMAT "%8.1" /end CHARACTERISTIC
/begin CHARACTERISTIC DSM_SdwDfp_EMCCD_ADC1_C "Enprellzeit Shadow Zustand für Fehlerpfad Dfp_EMCCD_ADC1" VALUE 0xCD77A Kw_Wu16 655350.0 Time_ms 0.00 655350.0 FORMAT "%8.1" /end CHARACTERISTIC
/begin CHARACTERISTIC DSM_SdwDfp_EMCCD_ADC2_C "Enprellzeit Shadow Zustand für Fehlerpfad Dfp_EMCCD_ADC2" VALUE 0xCD77C Kw_Wu16 655350.0 Time_ms 0.00 655350.0 FORMAT "%8.1" /end CHARACTERISTIC
/begin CHARACTERISTIC DSM_SdwDfp_ETClbETFltInj1_C "Enprellzeit Shadow Zustand für Fehlerpfad Dfp_ETClbETFltInj1" VALUE 0xCD77E Kw_Wu16 655350.0 Time_ms 0.00 655350.0 FORMAT "%8.1" /end CHARACTERISTIC
/begin CHARACTERISTIC DSM_SdwDfp_ETClbETFltInj2_C "Enprellzeit Shadow Zustand für Fehlerpfad Dfp_ETClbETFltInj2" VALUE 0xCD780 Kw_Wu16 655350.0 Time_ms 0.00 655350.0 FORMAT "%8.1" /end CHARACTERISTIC
/begin CHARACTERISTIC DSM_SdwDfp_ETClbETFltInj3_C "Enprellzeit Shadow Zustand für Fehlerpfad Dfp_ETClbETFltInj3" VALUE 0xCD782 Kw_Wu16 655350.0 Time_ms 0.00 655350.0 FORMAT "%8.1" /end CHARACTERISTIC
/begin CHARACTERISTIC DSM_SdwDfp_ETClbETFltInj4_C "Enprellzeit Shadow Zustand für Fehlerpfad Dfp_ETClbETFltInj4" VALUE 0xCD784 Kw_Wu16 655350.0 Time_ms 0.00 655350.0 FORMAT "%8.1" /end CHARACTERISTIC
/begin CHARACTERISTIC DSM_SdwDfp_ETClbETFltInj5_C "Enprellzeit Shadow Zustand für Fehlerpfad Dfp_ETClbETFltInj5" VALUE 0xCD786 Kw_Wu16 655350.0 Time_ms 0.00 655350.0 FORMAT "%8.1" /end CHARACTERISTIC
/begin CHARACTERISTIC DSM_SdwDfp_ETClbETFltInj6_C "Enprellzeit Shadow Zustand für Fehlerpfad Dfp_ETClbETFltInj6" VALUE 0xCD788 Kw_Wu16 655350.0 Time_ms 0.00 655350.0 FORMAT "%8.1" /end CHARACTERISTIC
/begin CHARACTERISTIC DSM_SdwDfp_ETClbInj1_C "Enprellzeit Shadow Zustand für Fehlerpfad Dfp_ETClbInj1" VALUE 0xCD78A Kw_Wu16 655350.0 Time_ms 0.00 655350.0 FORMAT "%8.1" /end CHARACTERISTIC
/begin CHARACTERISTIC DSM_SdwDfp_ETClbInj2_C "Enprellzeit Shadow Zustand für Fehlerpfad Dfp_ETClbInj2" VALUE 0xCD78C Kw_Wu16 655350.0 Time_ms 0.00 655350.0 FORMAT "%8.1" /end CHARACTERISTIC
/begin CHARACTERISTIC DSM_SdwDfp_ETClbInj3_C "Enprellzeit Shadow Zustand für Fehlerpfad Dfp_ETClbInj3" VALUE 0xCD78E Kw_Wu16 655350.0 Time_ms 0.00 655350.0 FORMAT "%8.1" /end CHARACTERISTIC
/begin CHARACTERISTIC DSM_SdwDfp_ETClbInj4_C "Enprellzeit Shadow Zustand für Fehlerpfad Dfp_ETClbInj4" VALUE 0xCD790 Kw_Wu16 655350.0 Time_ms 0.00 655350.0 FORMAT "%8.1" /end CHARACTERISTIC
/begin CHARACTERISTIC DSM_SdwDfp_ETClbInj5_C "Enprellzeit Shadow Zustand für Fehlerpfad Dfp_ETClbInj5" VALUE 0xCD792 Kw_Wu16 655350.0 Time_ms 0.00 655350.0 FORMAT "%8.1" /end CHARACTERISTIC
/begin CHARACTERISTIC DSM_SdwDfp_ETClbInj6_C "Enprellzeit Shadow Zustand für Fehlerpfad Dfp_ETClbInj6" VALUE 0xCD794 Kw_Wu16 655350.0 Time_ms 0.00 655350.0 FORMAT "%8.1" /end CHARACTERISTIC
/begin CHARACTERISTIC DSM_SdwDfp_EngMCaS1_C "Enprellzeit Shadow Zustand für Fehlerpfad Dfp_EngMCaS1" VALUE 0xCD796 Kw_Wu16 655350.0 Time_ms 0.00 655350.0 FORMAT "%8.1" /end CHARACTERISTIC
/begin CHARACTERISTIC DSM_SdwDfp_EngMCrS1_C "Enprellzeit Shadow Zustand für Fehlerpfad Dfp_EngMCrS1" VALUE 0xCD798 Kw_Wu16 655350.0 Time_ms 0.00 655350.0 FORMAT "%8.1" /end CHARACTERISTIC
/begin CHARACTERISTIC DSM_SdwDfp_EngMOfsCaSCrS_C "Enprellzeit Shadow Zustand für Fehlerpfad Dfp_EngMOfsCaSCrS" VALUE 0xCD79A Kw_Wu16 655350.0 Time_ms 0.00 655350.0 FORMAT "%8.1" /end CHARACTERISTIC
/begin CHARACTERISTIC DSM_SdwDfp_EngPrtFWODet_C "Enprellzeit Shadow Zustand für Fehlerpfad Dfp_EngPrtFWODet" VALUE 0xCD79C Kw_Wu16 655350.0 Time_ms 0.00 655350.0 FORMAT "%8.1" /end CHARACTERISTIC
/begin CHARACTERISTIC DSM_SdwDfp_FBCqDvt_C "Enprellzeit Shadow Zustand für Fehlerpfad Dfp_FBCqDvt" VALUE 0xCD79E Kw_Wu16 655350.0 Time_ms 0.00 655350.0 FORMAT "%8.1" /end CHARACTERISTIC
/begin CHARACTERISTIC DSM_SdwDfp_FMTC_NonMonotonMap_C "Enprellzeit Shadow Zustand für Fehlerpfad Dfp_FMTC_NonMonotonMap" VALUE 0xCD7A0 Kw_Wu16 655350.0 Time_ms 0.00 655350.0 FORMAT "%8.1" /end CHARACTERISTIC
/begin CHARACTERISTIC DSM_SdwDfp_FTSCD_C "Enprellzeit Shadow Zustand für Fehlerpfad Dfp_FTSCD" VALUE 0xCD7A2 Kw_Wu16 655350.0 Time_ms 0.00 655350.0 FORMAT "%8.1" /end CHARACTERISTIC
/begin CHARACTERISTIC DSM_SdwDfp_FanCD_C "Enprellzeit Shadow Zustand für Fehlerpfad Dfp_FanCD" VALUE 0xCD7A4 Kw_Wu16 655350.0 Time_ms 0.00 655350.0 FORMAT "%8.1" /end CHARACTERISTIC
/begin CHARACTERISTIC DSM_SdwDfp_FanCD_FanCtlr1_C "Enprellzeit Shadow Zustand für Fehlerpfad Dfp_FanCD_FanCtlr1" VALUE 0xCD7A6 Kw_Wu16 655350.0 Time_ms 0.00 655350.0 FORMAT "%8.1" /end CHARACTERISTIC
/begin CHARACTERISTIC DSM_SdwDfp_FanCD_FanCtlr2_C "Enprellzeit Shadow Zustand für Fehlerpfad Dfp_FanCD_FanCtlr2" VALUE 0xCD7A8 Kw_Wu16 655350.0 Time_ms 0.00 655350.0 FORMAT "%8.1" /end CHARACTERISTIC
/begin CHARACTERISTIC DSM_SdwDfp_FanCD_FanCtlr3_C "Enprellzeit Shadow Zustand für Fehlerpfad Dfp_FanCD_FanCtlr3" VALUE 0xCD7AA Kw_Wu16 655350.0 Time_ms 0.00 655350.0 FORMAT "%8.1" /end CHARACTERISTIC
/begin CHARACTERISTIC DSM_SdwDfp_FlFCD_C "Enprellzeit Shadow Zustand für Fehlerpfad Dfp_FlFCD" VALUE 0xCD7AC Kw_Wu16 655350.0 Time_ms 0.00 655350.0 FORMAT "%8.1" /end CHARACTERISTIC
/begin CHARACTERISTIC DSM_SdwDfp_FlMngSmkDefect_C "Enprellzeit Shadow Zustand für Fehlerpfad Dfp_FlMngSmkDefect" VALUE 0xCD7AE Kw_Wu16 655350.0 Time_ms 0.00 655350.0 FORMAT "%8.1" /end CHARACTERISTIC
/begin CHARACTERISTIC DSM_SdwDfp_FrmMngANFRADMOMPT_C "Enprellzeit Shadow Zustand für Fehlerpfad Dfp_FrmMngANFRADMOMPT" VALUE 0xCD7B0 Kw_Wu16 655350.0 Time_ms 0.00 655350.0 FORMAT "%8.1" /end CHARACTERISTIC
/begin CHARACTERISTIC DSM_SdwDfp_FrmMngASC1_C "Enprellzeit Shadow Zustand für Fehlerpfad Dfp_FrmMngASC1" VALUE 0xCD7B2 Kw_Wu16 655350.0 Time_ms 0.00 655350.0 FORMAT "%8.1" /end CHARACTERISTIC
/begin CHARACTERISTIC DSM_SdwDfp_FrmMngASC2_C "Enprellzeit Shadow Zustand für Fehlerpfad Dfp_FrmMngASC2" VALUE 0xCD7B4 Kw_Wu16 655350.0 Time_ms 0.00 655350.0 FORMAT "%8.1" /end CHARACTERISTIC
/begin CHARACTERISTIC DSM_SdwDfp_FrmMngASC3_C "Enprellzeit Shadow Zustand für Fehlerpfad Dfp_FrmMngASC3" VALUE 0xCD7B6 Kw_Wu16 655350.0 Time_ms 0.00 655350.0 FORMAT "%8.1" /end CHARACTERISTIC
/begin CHARACTERISTIC DSM_SdwDfp_FrmMngASC4_C "Enprellzeit Shadow Zustand für Fehlerpfad Dfp_FrmMngASC4" VALUE 0xCD7B8 Kw_Wu16 655350.0 Time_ms 0.00 655350.0 FORMAT "%8.1" /end CHARACTERISTIC
/begin CHARACTERISTIC DSM_SdwDfp_FrmMngBOS_RESET_C "Enprellzeit Shadow Zustand für Fehlerpfad Dfp_FrmMngBOS_RESET" VALUE 0xCD7BA Kw_Wu16 655350.0 Time_ms 0.00 655350.0 FORMAT "%8.1" /end CHARACTERISTIC
/begin CHARACTERISTIC DSM_SdwDfp_FrmMngBOS_RESET_2_C "" VALUE 0xCD7BC Kw_Wu16 655350.0 Time_ms 0.00 655350.0 FORMAT "%8.1" /end CHARACTERISTIC
/begin CHARACTERISTIC DSM_SdwDfp_FrmMngDMANFAFS_C "Enprellzeit Shadow Zustand für Fehlerpfad Dfp_FrmMngDMANFAFS" VALUE 0xCD7BE Kw_Wu16 655350.0 Time_ms 0.00 655350.0 FORMAT "%8.1" /end CHARACTERISTIC
/begin CHARACTERISTIC DSM_SdwDfp_FrmMngDRMANFSSG_C "#SSD Enprellzeit Shadow Zustand für Fehlerpfad Dfp_FrmMngDRMANFSSG" VALUE 0xCD7C0 Kw_Wu16 655350.0 Time_ms 0.00 655350.0 FORMAT "%8.1" /end CHARACTERISTIC
/begin CHARACTERISTIC DSM_SdwDfp_FrmMngEGS1_C "Enprellzeit Shadow Zustand für Fehlerpfad Dfp_FrmMngEGS1" VALUE 0xCD7C2 Kw_Wu16 655350.0 Time_ms 0.00 655350.0 FORMAT "%8.1" /end CHARACTERISTIC
/begin CHARACTERISTIC DSM_SdwDfp_FrmMngEGS2_C "Enprellzeit Shadow Zustand für Fehlerpfad Dfp_FrmMngEGS2" VALUE 0xCD7C4 Kw_Wu16 655350.0 Time_ms 0.00 655350.0 FORMAT "%8.1" /end CHARACTERISTIC
/begin CHARACTERISTIC DSM_SdwDfp_FrmMngGEARBX_DATA_C "Enprellzeit Shadow Zustand für Fehlerpfad Dfp_FrmMngGEARBX_DATA" VALUE 0xCD7C6 Kw_Wu16 655350.0 Time_ms 0.00 655350.0 FORMAT "%8.1" /end CHARACTERISTIC
/begin CHARACTERISTIC DSM_SdwDfp_FrmMngGEARBX_DATA2_C "Enprellzeit Shadow Zustand für Fehlerpfad Dfp_FrmMngGEARBX_DATA2" VALUE 0xCD7C8 Kw_Wu16 655350.0 Time_ms 0.00 655350.0 FORMAT "%8.1" /end CHARACTERISTIC
/begin CHARACTERISTIC DSM_SdwDfp_FrmMngHEAT_AC_C "Enprellzeit Shadow Zustand für Fehlerpfad Dfp_FrmMngHEAT_AC" VALUE 0xCD7CA Kw_Wu16 655350.0 Time_ms 0.00 655350.0 FORMAT "%8.1" /end CHARACTERISTIC
/begin CHARACTERISTIC DSM_SdwDfp_FrmMngINSTR2_C "Enprellzeit Shadow Zustand für Fehlerpfad Dfp_FrmMngINSTR2" VALUE 0xCD7CC Kw_Wu16 655350.0 Time_ms 0.00 655350.0 FORMAT "%8.1" /end CHARACTERISTIC
/begin CHARACTERISTIC DSM_SdwDfp_FrmMngINSTR3_C "Enprellzeit Shadow Zustand für Fehlerpfad Dfp_FrmMngINSTR3" VALUE 0xCD7CE Kw_Wu16 655350.0 Time_ms 0.00 655350.0 FORMAT "%8.1" /end CHARACTERISTIC
/begin CHARACTERISTIC DSM_SdwDfp_FrmMngLENKRADWINKEL_C "Enprellzeit Shadow Zustand für Fehlerpfad Dfp_FrmMngLENKRADWINKEL" VALUE 0xCD7D0 Kw_Wu16 655350.0 Time_ms 0.00 655350.0 FORMAT "%8.1" /end CHARACTERISTIC
/begin CHARACTERISTIC DSM_SdwDfp_FrmMngMILEAGE_RANGE_C "Enprellzeit Shadow Zustand für Fehlerpfad Dfp_FrmMngMILEAGE_RANGE" VALUE 0xCD7D2 Kw_Wu16 655350.0 Time_ms 0.00 655350.0 FORMAT "%8.1" /end CHARACTERISTIC
/begin CHARACTERISTIC DSM_SdwDfp_FrmMngOPCRCTLACC_C "#SSD Enprellzeit Shadow Zustand für Fehlerpfad Dfp_FrmMngOPCRCTLACC" VALUE 0xCD7D4 Kw_Wu16 655350.0 Time_ms 0.00 655350.0 FORMAT "%8.1" /end CHARACTERISTIC
/begin CHARACTERISTIC DSM_SdwDfp_FrmMngPRGG_CCTR_C "Enprellzeit Shadow Zustand für Fehlerpfad Dfp_FrmMngPRGG_CCTR" VALUE 0xCD7D6 Kw_Wu16 655350.0 Time_ms 0.00 655350.0 FORMAT "%8.1" /end CHARACTERISTIC
/begin CHARACTERISTIC DSM_SdwDfp_FrmMngPWRMNG_LOADV_C "Enprellzeit Shadow Zustand für Fehlerpfad Dfp_FrmMngPWRMNG_LOADV" VALUE 0xCD7D8 Kw_Wu16 655350.0 Time_ms 0.00 655350.0 FORMAT "%8.1" /end CHARACTERISTIC
/begin CHARACTERISTIC DSM_SdwDfp_FrmMngParkConsumer_C "Entprellzeit Shadow Zusand für Fehlerpfad Dfp_FrmMngParkConsumer" VALUE 0xCD7DA Kw_Wu16 655350.0 Time_ms 0.00 655350.0 FORMAT "%8.1" /end CHARACTERISTIC
/begin CHARACTERISTIC DSM_SdwDfp_FrmMngRQSTGEFAN_C "RQ_STG_EFAN - CAN-message related errors" VALUE 0xCD7DC Kw_Wu16 655350.0 Time_ms 0.00 655350.0 FORMAT "%8.1" /end CHARACTERISTIC
/begin CHARACTERISTIC DSM_SdwDfp_FrmMngSSGErr_C "Enprellzeit Shadow Zustand für Fehlerpfad Dfp_FrmMngSSGErr" VALUE 0xCD7DE Kw_Wu16 655350.0 Time_ms 0.00 655350.0 FORMAT "%8.1" /end CHARACTERISTIC
/begin CHARACTERISTIC DSM_SdwDfp_FrmMngSSGShOff_C "Enprellzeit Shadow Zustand für Fehlerpfad Dfp_FrmMngSSGShOff" VALUE 0xCD7E0 Kw_Wu16 655350.0 Time_ms 0.00 655350.0 FORMAT "%8.1" /end CHARACTERISTIC
/begin CHARACTERISTIC DSM_SdwDfp_FrmMngSTAT_ANH_C "Enprellzeit Shadow Zustand für Fehlerpfad Dfp_FrmMngSTAT_ANH" VALUE 0xCD7E2 Kw_Wu16 655350.0 Time_ms 0.00 655350.0 FORMAT "%8.1" /end CHARACTERISTIC
/begin CHARACTERISTIC DSM_SdwDfp_FrmMngSTAT_ARS_C "Enprellzeit Shadow Zustand für Fehlerpfad Dfp_FrmMngSTAT_ARS" VALUE 0xCD7E4 Kw_Wu16 655350.0 Time_ms 0.00 655350.0 FORMAT "%8.1" /end CHARACTERISTIC
/begin CHARACTERISTIC DSM_SdwDfp_FrmMngSTAT_DSC_C "Enprellzeit Shadow Zustand für Fehlerpfad Dfp_FrmMngSTAT_DSC" VALUE 0xCD7E6 Kw_Wu16 655350.0 Time_ms 0.00 655350.0 FORMAT "%8.1" /end CHARACTERISTIC
/begin CHARACTERISTIC DSM_SdwDfp_FrmMngSTAT_EKP_C "Enprellzeit Shadow Zustand für Fehlerpfad Dfp_FrmMngSTAT_EKP" VALUE 0xCD7E8 Kw_Wu16 655350.0 Time_ms 0.00 655350.0 FORMAT "%8.1" /end CHARACTERISTIC
/begin CHARACTERISTIC DSM_SdwDfp_FrmMngSTAT_KOMBI_C "Enprellzeit Shadow Zustand für Fehlerpfad Dfp_FrmMngSTAT_KOMBI" VALUE 0xCD7EA Kw_Wu16 655350.0 Time_ms 0.00 655350.0 FORMAT "%8.1" /end CHARACTERISTIC
/begin CHARACTERISTIC DSM_SdwDfp_FrmMngSTAT_SITZ_C "Enprellzeit Shadow Zustand für Fehlerpfad Dfp_FrmMngSTAT_SITZ" VALUE 0xCD7EC Kw_Wu16 655350.0 Time_ms 0.00 655350.0 FORMAT "%8.1" /end CHARACTERISTIC
/begin CHARACTERISTIC DSM_SdwDfp_FrmMngStOBDGbxMilOf_C "Enprellzeit Shadow Zustand für Fehlerpfad Dfp_FrmMngStOBDGbxMilOf" VALUE 0xCD7EE Kw_Wu16 655350.0 Time_ms 0.00 655350.0 FORMAT "%8.1" /end CHARACTERISTIC
/begin CHARACTERISTIC DSM_SdwDfp_FrmMngStOBDGbxMilOn_C "Enprellzeit Shadow Zustand für Fehlerpfad Dfp_FrmMngStOBDGbxMilOn" VALUE 0xCD7F0 Kw_Wu16 655350.0 Time_ms 0.00 655350.0 FORMAT "%8.1" /end CHARACTERISTIC
/begin CHARACTERISTIC DSM_SdwDfp_FrmMngTEMPRELTIME_C "Enprellzeit Shadow Zustand für Fehlerpfad Dfp_FrmMngTEMPRELTIME" VALUE 0xCD7F2 Kw_Wu16 655350.0 Time_ms 0.00 655350.0 FORMAT "%8.1" /end CHARACTERISTIC
/begin CHARACTERISTIC DSM_SdwDfp_FrmMngTERMINAL_C "Enprellzeit Shadow Zustand für Fehlerpfad Dfp_FrmMngTERMINAL" VALUE 0xCD7F4 Kw_Wu16 655350.0 Time_ms 0.00 655350.0 FORMAT "%8.1" /end CHARACTERISTIC
/begin CHARACTERISTIC DSM_SdwDfp_FrmMngTIME_DATE_C "Enprellzeit Shadow Zustand für Fehlerpfad Dfp_FrmMngTIME_DATE" VALUE 0xCD7F6 Kw_Wu16 655350.0 Time_ms 0.00 655350.0 FORMAT "%8.1" /end CHARACTERISTIC
/begin CHARACTERISTIC DSM_SdwDfp_FrmMngTORQUE_DSC_C "#SSD Enprellzeit Shadow Zustand für Fehlerpfad Dfp_FrmMngTORQUE_DSC" VALUE 0xCD7F8 Kw_Wu16 655350.0 Time_ms 0.00 655350.0 FORMAT "%8.1" /end CHARACTERISTIC
/begin CHARACTERISTIC DSM_SdwDfp_FrmMngTORQUE_GEARBX_C "#SSD Enprellzeit Shadow Zustand für Fehlerpfad Dfp_FrmMngTORQUE_GEARBX" VALUE 0xCD7FA Kw_Wu16 655350.0 Time_ms 0.00 655350.0 FORMAT "%8.1" /end CHARACTERISTIC
/begin CHARACTERISTIC DSM_SdwDfp_FrmMngTrq_ReqACC_C "#SSD Enprellzeit Shadow Zustand für Fehlerpfad Dfp_FrmMngTrq_ReqACC" VALUE 0xCD7FC Kw_Wu16 655350.0 Time_ms 0.00 655350.0 FORMAT "%8.1" /end CHARACTERISTIC
/begin CHARACTERISTIC DSM_SdwDfp_FrmMngVEH_MOD_C "VEH_MOD - CAN-message related errors" VALUE 0xCD7FE Kw_Wu16 655350.0 Time_ms 0.00 655350.0 FORMAT "%8.1" /end CHARACTERISTIC
/begin CHARACTERISTIC DSM_SdwDfp_FrmMngVELOCITY_C "Enprellzeit Shadow Zustand für Fehlerpfad Dfp_FrmMngVELOCITY" VALUE 0xCD800 Kw_Wu16 655350.0 Time_ms 0.00 655350.0 FORMAT "%8.1" /end CHARACTERISTIC
/begin CHARACTERISTIC DSM_SdwDfp_FrmMngWHEEL_SPEED_C "Enprellzeit Shadow Zustand für Fehlerpfad Dfp_FrmMngWHEEL_SPEED" VALUE 0xCD802 Kw_Wu16 655350.0 Time_ms 0.00 655350.0 FORMAT "%8.1" /end CHARACTERISTIC
/begin CHARACTERISTIC DSM_SdwDfp_FrmMngstCurr_C "Entprellzeit für Dfp_FrmMngstCurr" VALUE 0xCD804 Kw_Wu16 655350.0 Time_ms 0.00 655350.0 FORMAT "%8.1" /end CHARACTERISTIC
/begin CHARACTERISTIC DSM_SdwDfp_FrmMngswtPSPOff_C "Entprellzeit für Dfp_FrmMngswtPSPOff" VALUE 0xCD806 Kw_Wu16 655350.0 Time_ms 0.00 655350.0 FORMAT "%8.1" /end CHARACTERISTIC
/begin CHARACTERISTIC DSM_SdwDfp_GearbxIncMax_C "Enprellzeit Shadow Zustand für Fehlerpfad Dfp_GearbxIncMax" VALUE 0xCD808 Kw_Wu16 655350.0 Time_ms 0.00 655350.0 FORMAT "%8.1" /end CHARACTERISTIC
/begin CHARACTERISTIC DSM_SdwDfp_GlwCD_C "Enprellzeit Shadow Zustand für Fehlerpfad Dfp_GlwCD" VALUE 0xCD80A Kw_Wu16 655350.0 Time_ms 0.00 655350.0 FORMAT "%8.1" /end CHARACTERISTIC
/begin CHARACTERISTIC DSM_SdwDfp_GlwCDGlwCirc1_C "Enprellzeit Shadow Zustand für Fehlerpfad Dfp_GlwCDGlwCirc1" VALUE 0xCD80C Kw_Wu16 655350.0 Time_ms 0.00 655350.0 FORMAT "%8.1" /end CHARACTERISTIC
/begin CHARACTERISTIC DSM_SdwDfp_GlwCDGlwCirc2_C "Enprellzeit Shadow Zustand für Fehlerpfad Dfp_GlwCDGlwCirc2" VALUE 0xCD80E Kw_Wu16 655350.0 Time_ms 0.00 655350.0 FORMAT "%8.1" /end CHARACTERISTIC
/begin CHARACTERISTIC DSM_SdwDfp_GlwCDGlwCirc3_C "Enprellzeit Shadow Zustand für Fehlerpfad Dfp_GlwCDGlwCirc3" VALUE 0xCD810 Kw_Wu16 655350.0 Time_ms 0.00 655350.0 FORMAT "%8.1" /end CHARACTERISTIC
/begin CHARACTERISTIC DSM_SdwDfp_GlwCDGlwCirc4_C "Enprellzeit Shadow Zustand für Fehlerpfad Dfp_GlwCDGlwCirc4" VALUE 0xCD812 Kw_Wu16 655350.0 Time_ms 0.00 655350.0 FORMAT "%8.1" /end CHARACTERISTIC
/begin CHARACTERISTIC DSM_SdwDfp_GlwCDGlwCirc5_C "Enprellzeit Shadow Zustand für Fehlerpfad Dfp_GlwCDGlwCirc5" VALUE 0xCD814 Kw_Wu16 655350.0 Time_ms 0.00 655350.0 FORMAT "%8.1" /end CHARACTERISTIC
/begin CHARACTERISTIC DSM_SdwDfp_GlwCDGlwCirc6_C "Enprellzeit Shadow Zustand für Fehlerpfad Dfp_GlwCDGlwCirc6" VALUE 0xCD816 Kw_Wu16 655350.0 Time_ms 0.00 655350.0 FORMAT "%8.1" /end CHARACTERISTIC
/begin CHARACTERISTIC DSM_SdwDfp_GlwCDGlwCirc7_C "Enprellzeit Shadow Zustand für Fehlerpfad Dfp_GlwCDGlwCirc7" VALUE 0xCD818 Kw_Wu16 655350.0 Time_ms 0.00 655350.0 FORMAT "%8.1" /end CHARACTERISTIC
/begin CHARACTERISTIC DSM_SdwDfp_GlwCDGlwCirc8_C "Enprellzeit Shadow Zustand für Fehlerpfad Dfp_GlwCDGlwCirc8" VALUE 0xCD81A Kw_Wu16 655350.0 Time_ms 0.00 655350.0 FORMAT "%8.1" /end CHARACTERISTIC
/begin CHARACTERISTIC DSM_SdwDfp_GlwCtl_C "Enprellzeit Shadow Zustand für Fehlerpfad Dfp_GlwCtl" VALUE 0xCD81C Kw_Wu16 655350.0 Time_ms 0.00 655350.0 FORMAT "%8.1" /end CHARACTERISTIC
/begin CHARACTERISTIC DSM_SdwDfp_HWEMonCom_C "Enprellzeit Shadow Zustand für Fehlerpfad Dfp_HWEMonCom" VALUE 0xCD81E Kw_Wu16 655350.0 Time_ms 0.00 655350.0 FORMAT "%8.1" /end CHARACTERISTIC
/begin CHARACTERISTIC DSM_SdwDfp_HWEMonEEPROM_C "Enprellzeit Shadow Zustand für Fehlerpfad Dfp_HWEMonEEPROM" VALUE 0xCD820 Kw_Wu16 655350.0 Time_ms 0.00 655350.0 FORMAT "%8.1" /end CHARACTERISTIC
/begin CHARACTERISTIC DSM_SdwDfp_HWEMonRcyLocked_C "Enprellzeit Shadow Zustand für Fehlerpfad Dfp_HWEMonRcyLocked" VALUE 0xCD822 Kw_Wu16 655350.0 Time_ms 0.00 655350.0 FORMAT "%8.1" /end CHARACTERISTIC
/begin CHARACTERISTIC DSM_SdwDfp_HWEMonRcySuppressed_C "Enprellzeit Shadow Zustand für Fehlerpfad Dfp_HWEMonRcySuppressed" VALUE 0xCD824 Kw_Wu16 655350.0 Time_ms 0.00 655350.0 FORMAT "%8.1" /end CHARACTERISTIC
/begin CHARACTERISTIC DSM_SdwDfp_HWEMonRcyVisible_C "Enprellzeit Shadow Zustand für Fehlerpfad Dfp_HWEMonRcyVisible" VALUE 0xCD826 Kw_Wu16 655350.0 Time_ms 0.00 655350.0 FORMAT "%8.1" /end CHARACTERISTIC
/begin CHARACTERISTIC DSM_SdwDfp_HWEMonUMaxSupply_C "Enprellzeit Shadow Zustand für Fehlerpfad Dfp_HWEMonUMaxSupply" VALUE 0xCD828 Kw_Wu16 655350.0 Time_ms 0.00 655350.0 FORMAT "%8.1" /end CHARACTERISTIC
/begin CHARACTERISTIC DSM_SdwDfp_HWEMonUMinSupply_C "Enprellzeit Shadow Zustand für Fehlerpfad Dfp_HWEMonUMinSupply" VALUE 0xCD82A Kw_Wu16 655350.0 Time_ms 0.00 655350.0 FORMAT "%8.1" /end CHARACTERISTIC
/begin CHARACTERISTIC DSM_SdwDfp_IATSCD_C "Enprellzeit Shadow Zustand für Fehlerpfad Dfp_IATSCD" VALUE 0xCD82C Kw_Wu16 655350.0 Time_ms 0.00 655350.0 FORMAT "%8.1" /end CHARACTERISTIC
/begin CHARACTERISTIC DSM_SdwDfp_IATSCD_CATS_C "Enprellzeit Shadow Zustand für Fehlerpfad Dfp_IATSCD_CATS" VALUE 0xCD82E Kw_Wu16 655350.0 Time_ms 0.00 655350.0 FORMAT "%8.1" /end CHARACTERISTIC
/begin CHARACTERISTIC DSM_SdwDfp_ImmCtlImmCD_C "Enprellzeit Shadow Zustand für Fehlerpfad Dfp_ImmCtlImmCD" VALUE 0xCD830 Kw_Wu16 655350.0 Time_ms 0.00 655350.0 FORMAT "%8.1" /end CHARACTERISTIC
/begin CHARACTERISTIC DSM_SdwDfp_ImmCtlImmEep_C "Enprellzeit Shadow Zustand für Fehlerpfad Dfp_ImmCtlImmEep" VALUE 0xCD832 Kw_Wu16 655350.0 Time_ms 0.00 655350.0 FORMAT "%8.1" /end CHARACTERISTIC
/begin CHARACTERISTIC DSM_SdwDfp_ImmCtlMpl_C "Enprellzeit Shadow Zustand für Fehlerpfad Dfp_ImmCtlMpl" VALUE 0xCD834 Kw_Wu16 655350.0 Time_ms 0.00 655350.0 FORMAT "%8.1" /end CHARACTERISTIC
/begin CHARACTERISTIC DSM_SdwDfp_IndSys1_C "Enprellzeit Shadow Zustand für Fehlerpfad Dfp_IndSys1" VALUE 0xCD836 Kw_Wu16 655350.0 Time_ms 0.00 655350.0 FORMAT "%8.1" /end CHARACTERISTIC
/begin CHARACTERISTIC DSM_SdwDfp_IndSys2_C "Enprellzeit Shadow Zustand für Fehlerpfad Dfp_IndSys2" VALUE 0xCD838 Kw_Wu16 655350.0 Time_ms 0.00 655350.0 FORMAT "%8.1" /end CHARACTERISTIC
/begin CHARACTERISTIC DSM_SdwDfp_InjCrv_InjLim_C "Enprellzeit Shadow Zustand für Fehlerpfad Dfp_InjCrv_InjLim" VALUE 0xCD83A Kw_Wu16 655350.0 Time_ms 0.00 655350.0 FORMAT "%8.1" /end CHARACTERISTIC
/begin CHARACTERISTIC DSM_SdwDfp_InjCtlAdjQnt_C "Enprellzeit Shadow Zustand für Fehlerpfad Dfp_InjCtlAdjQnt" VALUE 0xCD83C Kw_Wu16 655350.0 Time_ms 0.00 655350.0 FORMAT "%8.1" /end CHARACTERISTIC
/begin CHARACTERISTIC DSM_SdwDfp_InjCtlDrift_C "Enprellzeit Shadow Zustand für Fehlerpfad Dfp_InjCtlDrift" VALUE 0xCD83E Kw_Wu16 655350.0 Time_ms 0.00 655350.0 FORMAT "%8.1" /end CHARACTERISTIC
/begin CHARACTERISTIC DSM_SdwDfp_InjVCDActrChrg_C "Enprellzeit Shadow Zustand für Fehlerpfad Dfp_InjVCDActrChrg" VALUE 0xCD840 Kw_Wu16 655350.0 Time_ms 0.00 655350.0 FORMAT "%8.1" /end CHARACTERISTIC
/begin CHARACTERISTIC DSM_SdwDfp_InjVCDActrEnrg1_C "Enprellzeit Shadow Zustand für Fehlerpfad Dfp_InjVCDActrEnrg1" VALUE 0xCD842 Kw_Wu16 655350.0 Time_ms 0.00 655350.0 FORMAT "%8.1" /end CHARACTERISTIC
/begin CHARACTERISTIC DSM_SdwDfp_InjVCDActrEnrg2_C "Enprellzeit Shadow Zustand für Fehlerpfad Dfp_InjVCDActrEnrg2" VALUE 0xCD844 Kw_Wu16 655350.0 Time_ms 0.00 655350.0 FORMAT "%8.1" /end CHARACTERISTIC
/begin CHARACTERISTIC DSM_SdwDfp_InjVCDActrEnrg3_C "Enprellzeit Shadow Zustand für Fehlerpfad Dfp_InjVCDActrEnrg3" VALUE 0xCD846 Kw_Wu16 655350.0 Time_ms 0.00 655350.0 FORMAT "%8.1" /end CHARACTERISTIC
/begin CHARACTERISTIC DSM_SdwDfp_InjVCDActrEnrg4_C "Enprellzeit Shadow Zustand für Fehlerpfad Dfp_InjVCDActrEnrg4" VALUE 0xCD848 Kw_Wu16 655350.0 Time_ms 0.00 655350.0 FORMAT "%8.1" /end CHARACTERISTIC
/begin CHARACTERISTIC DSM_SdwDfp_InjVCDActrEnrg5_C "Enprellzeit Shadow Zustand für Fehlerpfad Dfp_InjVCDActrEnrg5" VALUE 0xCD84A Kw_Wu16 655350.0 Time_ms 0.00 655350.0 FORMAT "%8.1" /end CHARACTERISTIC
/begin CHARACTERISTIC DSM_SdwDfp_InjVCDActrEnrg6_C "Enprellzeit Shadow Zustand für Fehlerpfad Dfp_InjVCDActrEnrg6" VALUE 0xCD84C Kw_Wu16 655350.0 Time_ms 0.00 655350.0 FORMAT "%8.1" /end CHARACTERISTIC
/begin CHARACTERISTIC DSM_SdwDfp_InjVCDActrEnrg7_C "Enprellzeit Shadow Zustand für Fehlerpfad Dfp_InjVCDActrEnrg7" VALUE 0xCD84E Kw_Wu16 655350.0 Time_ms 0.00 655350.0 FORMAT "%8.1" /end CHARACTERISTIC
/begin CHARACTERISTIC DSM_SdwDfp_InjVCDActrEnrg8_C "Enprellzeit Shadow Zustand für Fehlerpfad Dfp_InjVCDActrEnrg8" VALUE 0xCD850 Kw_Wu16 655350.0 Time_ms 0.00 655350.0 FORMAT "%8.1" /end CHARACTERISTIC
/begin CHARACTERISTIC DSM_SdwDfp_InjVCDActrVolt_C "Enprellzeit Shadow Zustand für Fehlerpfad Dfp_InjVCDActrVolt" VALUE 0xCD852 Kw_Wu16 655350.0 Time_ms 0.00 655350.0 FORMAT "%8.1" /end CHARACTERISTIC
/begin CHARACTERISTIC DSM_SdwDfp_InjVCDClsBank1_C "Enprellzeit Shadow Zustand für Fehlerpfad Dfp_InjVCDClsBank1" VALUE 0xCD854 Kw_Wu16 655350.0 Time_ms 0.00 655350.0 FORMAT "%8.1" /end CHARACTERISTIC
/begin CHARACTERISTIC DSM_SdwDfp_InjVCDClsBank2_C "Enprellzeit Shadow Zustand für Fehlerpfad Dfp_InjVCDClsBank2" VALUE 0xCD856 Kw_Wu16 655350.0 Time_ms 0.00 655350.0 FORMAT "%8.1" /end CHARACTERISTIC
/begin CHARACTERISTIC DSM_SdwDfp_InjVCDMonCab_C "Enprellzeit Shadow Zustand für Fehlerpfad Dfp_InjVCDMonCab" VALUE 0xCD858 Kw_Wu16 655350.0 Time_ms 0.00 655350.0 FORMAT "%8.1" /end CHARACTERISTIC
/begin CHARACTERISTIC DSM_SdwDfp_InjVCDMonSwt_C "Enprellzeit Shadow Zustand für Fehlerpfad Dfp_InjVCDMonSwt" VALUE 0xCD85A Kw_Wu16 655350.0 Time_ms 0.00 655350.0 FORMAT "%8.1" /end CHARACTERISTIC
/begin CHARACTERISTIC DSM_SdwDfp_InjVCDShOffDCDC_C "Enprellzeit Shadow Zustand für Fehlerpfad Dfp_InjVCDShOffDCDC" VALUE 0xCD85C Kw_Wu16 655350.0 Time_ms 0.00 655350.0 FORMAT "%8.1" /end CHARACTERISTIC
/begin CHARACTERISTIC DSM_SdwDfp_InjVCDUBuf_C "Enprellzeit Shadow Zustand für Fehlerpfad Dfp_InjVCDUBuf" VALUE 0xCD85E Kw_Wu16 655350.0 Time_ms 0.00 655350.0 FORMAT "%8.1" /end CHARACTERISTIC
/begin CHARACTERISTIC DSM_SdwDfp_InjVCD_CY370Ampl_C "Enprellzeit Shadow Zustand für Fehlerpfad Dfp_InjVCD_CY370Ampl" VALUE 0xCD860 Kw_Wu16 655350.0 Time_ms 0.00 655350.0 FORMAT "%8.1" /end CHARACTERISTIC
/begin CHARACTERISTIC DSM_SdwDfp_InjVlvBnk1A_C "Enprellzeit Shadow Zustand für Fehlerpfad Dfp_InjVlvBnk1A" VALUE 0xCD862 Kw_Wu16 655350.0 Time_ms 0.00 655350.0 FORMAT "%8.1" /end CHARACTERISTIC
/begin CHARACTERISTIC DSM_SdwDfp_InjVlvBnk1B_C "Enprellzeit Shadow Zustand für Fehlerpfad Dfp_InjVlvBnk1B" VALUE 0xCD864 Kw_Wu16 655350.0 Time_ms 0.00 655350.0 FORMAT "%8.1" /end CHARACTERISTIC
/begin CHARACTERISTIC DSM_SdwDfp_InjVlvBnk2A_C "Enprellzeit Shadow Zustand für Fehlerpfad Dfp_InjVlvBnk2A" VALUE 0xCD866 Kw_Wu16 655350.0 Time_ms 0.00 655350.0 FORMAT "%8.1" /end CHARACTERISTIC
/begin CHARACTERISTIC DSM_SdwDfp_InjVlvBnk2B_C "Enprellzeit Shadow Zustand für Fehlerpfad Dfp_InjVlvBnk2B" VALUE 0xCD868 Kw_Wu16 655350.0 Time_ms 0.00 655350.0 FORMAT "%8.1" /end CHARACTERISTIC
/begin CHARACTERISTIC DSM_SdwDfp_InjVlvChipA_C "Enprellzeit Shadow Zustand für Fehlerpfad Dfp_InjVlvChipA" VALUE 0xCD86A Kw_Wu16 655350.0 Time_ms 0.00 655350.0 FORMAT "%8.1" /end CHARACTERISTIC
/begin CHARACTERISTIC DSM_SdwDfp_InjVlvChipB_C "Enprellzeit Shadow Zustand für Fehlerpfad Dfp_InjVlvChipB" VALUE 0xCD86C Kw_Wu16 655350.0 Time_ms 0.00 655350.0 FORMAT "%8.1" /end CHARACTERISTIC
/begin CHARACTERISTIC DSM_SdwDfp_InjVlvCyl1A_C "Enprellzeit Shadow Zustand für Fehlerpfad Dfp_InjVlvCyl1A" VALUE 0xCD86E Kw_Wu16 655350.0 Time_ms 0.00 655350.0 FORMAT "%8.1" /end CHARACTERISTIC
/begin CHARACTERISTIC DSM_SdwDfp_InjVlvCyl1B_C "Enprellzeit Shadow Zustand für Fehlerpfad Dfp_InjVlvCyl1B" VALUE 0xCD870 Kw_Wu16 655350.0 Time_ms 0.00 655350.0 FORMAT "%8.1" /end CHARACTERISTIC
/begin CHARACTERISTIC DSM_SdwDfp_InjVlvCyl1C_C "Enprellzeit Shadow Zustand für Fehlerpfad Dfp_InjVlvCyl1C" VALUE 0xCD872 Kw_Wu16 655350.0 Time_ms 0.00 655350.0 FORMAT "%8.1" /end CHARACTERISTIC
/begin CHARACTERISTIC DSM_SdwDfp_InjVlvCyl2A_C "Enprellzeit Shadow Zustand für Fehlerpfad Dfp_InjVlvCyl2A" VALUE 0xCD874 Kw_Wu16 655350.0 Time_ms 0.00 655350.0 FORMAT "%8.1" /end CHARACTERISTIC
/begin CHARACTERISTIC DSM_SdwDfp_InjVlvCyl2B_C "Enprellzeit Shadow Zustand für Fehlerpfad Dfp_InjVlvCyl2B" VALUE 0xCD876 Kw_Wu16 655350.0 Time_ms 0.00 655350.0 FORMAT "%8.1" /end CHARACTERISTIC
/begin CHARACTERISTIC DSM_SdwDfp_InjVlvCyl2C_C "Enprellzeit Shadow Zustand für Fehlerpfad Dfp_InjVlvCyl2C" VALUE 0xCD878 Kw_Wu16 655350.0 Time_ms 0.00 655350.0 FORMAT "%8.1" /end CHARACTERISTIC
/begin CHARACTERISTIC DSM_SdwDfp_InjVlvCyl3A_C "Enprellzeit Shadow Zustand für Fehlerpfad Dfp_InjVlvCyl3A" VALUE 0xCD87A Kw_Wu16 655350.0 Time_ms 0.00 655350.0 FORMAT "%8.1" /end CHARACTERISTIC
/begin CHARACTERISTIC DSM_SdwDfp_InjVlvCyl3B_C "Enprellzeit Shadow Zustand für Fehlerpfad Dfp_InjVlvCyl3B" VALUE 0xCD87C Kw_Wu16 655350.0 Time_ms 0.00 655350.0 FORMAT "%8.1" /end CHARACTERISTIC
/begin CHARACTERISTIC DSM_SdwDfp_InjVlvCyl3C_C "Enprellzeit Shadow Zustand für Fehlerpfad Dfp_InjVlvCyl3C" VALUE 0xCD87E Kw_Wu16 655350.0 Time_ms 0.00 655350.0 FORMAT "%8.1" /end CHARACTERISTIC
/begin CHARACTERISTIC DSM_SdwDfp_InjVlvCyl4A_C "Enprellzeit Shadow Zustand für Fehlerpfad Dfp_InjVlvCyl4A" VALUE 0xCD880 Kw_Wu16 655350.0 Time_ms 0.00 655350.0 FORMAT "%8.1" /end CHARACTERISTIC
/begin CHARACTERISTIC DSM_SdwDfp_InjVlvCyl4B_C "Enprellzeit Shadow Zustand für Fehlerpfad Dfp_InjVlvCyl4B" VALUE 0xCD882 Kw_Wu16 655350.0 Time_ms 0.00 655350.0 FORMAT "%8.1" /end CHARACTERISTIC
/begin CHARACTERISTIC DSM_SdwDfp_InjVlvCyl4C_C "Enprellzeit Shadow Zustand für Fehlerpfad Dfp_InjVlvCyl4C" VALUE 0xCD884 Kw_Wu16 655350.0 Time_ms 0.00 655350.0 FORMAT "%8.1" /end CHARACTERISTIC
/begin CHARACTERISTIC DSM_SdwDfp_InjVlvCyl5A_C "Enprellzeit Shadow Zustand für Fehlerpfad Dfp_InjVlvCyl5A" VALUE 0xCD886 Kw_Wu16 655350.0 Time_ms 0.00 655350.0 FORMAT "%8.1" /end CHARACTERISTIC
/begin CHARACTERISTIC DSM_SdwDfp_InjVlvCyl5B_C "Enprellzeit Shadow Zustand für Fehlerpfad Dfp_InjVlvCyl5B" VALUE 0xCD888 Kw_Wu16 655350.0 Time_ms 0.00 655350.0 FORMAT "%8.1" /end CHARACTERISTIC
/begin CHARACTERISTIC DSM_SdwDfp_InjVlvCyl5C_C "Enprellzeit Shadow Zustand für Fehlerpfad Dfp_InjVlvCyl5C" VALUE 0xCD88A Kw_Wu16 655350.0 Time_ms 0.00 655350.0 FORMAT "%8.1" /end CHARACTERISTIC
/begin CHARACTERISTIC DSM_SdwDfp_InjVlvCyl6A_C "Enprellzeit Shadow Zustand für Fehlerpfad Dfp_InjVlvCyl6A" VALUE 0xCD88C Kw_Wu16 655350.0 Time_ms 0.00 655350.0 FORMAT "%8.1" /end CHARACTERISTIC
/begin CHARACTERISTIC DSM_SdwDfp_InjVlvCyl6B_C "Enprellzeit Shadow Zustand für Fehlerpfad Dfp_InjVlvCyl6B" VALUE 0xCD88E Kw_Wu16 655350.0 Time_ms 0.00 655350.0 FORMAT "%8.1" /end CHARACTERISTIC
/begin CHARACTERISTIC DSM_SdwDfp_InjVlvCyl6C_C "Enprellzeit Shadow Zustand für Fehlerpfad Dfp_InjVlvCyl6C" VALUE 0xCD890 Kw_Wu16 655350.0 Time_ms 0.00 655350.0 FORMAT "%8.1" /end CHARACTERISTIC
/begin CHARACTERISTIC DSM_SdwDfp_InjVlvCyl7A_C "Enprellzeit Shadow Zustand für Fehlerpfad Dfp_InjVlvCyl7A" VALUE 0xCD892 Kw_Wu16 655350.0 Time_ms 0.00 655350.0 FORMAT "%8.1" /end CHARACTERISTIC
/begin CHARACTERISTIC DSM_SdwDfp_InjVlvCyl7B_C "Enprellzeit Shadow Zustand für Fehlerpfad Dfp_InjVlvCyl7B" VALUE 0xCD894 Kw_Wu16 655350.0 Time_ms 0.00 655350.0 FORMAT "%8.1" /end CHARACTERISTIC
/begin CHARACTERISTIC DSM_SdwDfp_InjVlvCyl7C_C "Enprellzeit Shadow Zustand für Fehlerpfad Dfp_InjVlvCyl7C" VALUE 0xCD896 Kw_Wu16 655350.0 Time_ms 0.00 655350.0 FORMAT "%8.1" /end CHARACTERISTIC
/begin CHARACTERISTIC DSM_SdwDfp_InjVlvCyl8A_C "Enprellzeit Shadow Zustand für Fehlerpfad Dfp_InjVlvCyl8A" VALUE 0xCD898 Kw_Wu16 655350.0 Time_ms 0.00 655350.0 FORMAT "%8.1" /end CHARACTERISTIC
/begin CHARACTERISTIC DSM_SdwDfp_InjVlvCyl8B_C "Enprellzeit Shadow Zustand für Fehlerpfad Dfp_InjVlvCyl8B" VALUE 0xCD89A Kw_Wu16 655350.0 Time_ms 0.00 655350.0 FORMAT "%8.1" /end CHARACTERISTIC
/begin CHARACTERISTIC DSM_SdwDfp_InjVlvCyl8C_C "Enprellzeit Shadow Zustand für Fehlerpfad Dfp_InjVlvCyl8C" VALUE 0xCD89C Kw_Wu16 655350.0 Time_ms 0.00 655350.0 FORMAT "%8.1" /end CHARACTERISTIC
/begin CHARACTERISTIC DSM_SdwDfp_InjVlvNVC1_C "Enprellzeit Shadow Zustand für Fehlerpfad Dfp_InjVlvNVC1" VALUE 0xCD89E Kw_Wu16 655350.0 Time_ms 0.00 655350.0 FORMAT "%8.1" /end CHARACTERISTIC
/begin CHARACTERISTIC DSM_SdwDfp_InjVlvNVC2_C "Enprellzeit Shadow Zustand für Fehlerpfad Dfp_InjVlvNVC2" VALUE 0xCD8A0 Kw_Wu16 655350.0 Time_ms 0.00 655350.0 FORMAT "%8.1" /end CHARACTERISTIC
/begin CHARACTERISTIC DSM_SdwDfp_InjVlvNVC3_C "Enprellzeit Shadow Zustand für Fehlerpfad Dfp_InjVlvNVC3" VALUE 0xCD8A2 Kw_Wu16 655350.0 Time_ms 0.00 655350.0 FORMAT "%8.1" /end CHARACTERISTIC
/begin CHARACTERISTIC DSM_SdwDfp_InjVlvNVC4_C "Enprellzeit Shadow Zustand für Fehlerpfad Dfp_InjVlvNVC4" VALUE 0xCD8A4 Kw_Wu16 655350.0 Time_ms 0.00 655350.0 FORMAT "%8.1" /end CHARACTERISTIC
/begin CHARACTERISTIC DSM_SdwDfp_InjVlvNVC5_C "Enprellzeit Shadow Zustand für Fehlerpfad Dfp_InjVlvNVC5" VALUE 0xCD8A6 Kw_Wu16 655350.0 Time_ms 0.00 655350.0 FORMAT "%8.1" /end CHARACTERISTIC
/begin CHARACTERISTIC DSM_SdwDfp_InjVlvNVC6_C "Enprellzeit Shadow Zustand für Fehlerpfad Dfp_InjVlvNVC6" VALUE 0xCD8A8 Kw_Wu16 655350.0 Time_ms 0.00 655350.0 FORMAT "%8.1" /end CHARACTERISTIC
/begin CHARACTERISTIC DSM_SdwDfp_InjVlvNVC7_C "Enprellzeit Shadow Zustand für Fehlerpfad Dfp_InjVlvNVC7" VALUE 0xCD8AA Kw_Wu16 655350.0 Time_ms 0.00 655350.0 FORMAT "%8.1" /end CHARACTERISTIC
/begin CHARACTERISTIC DSM_SdwDfp_InjVlvNVC8_C "Enprellzeit Shadow Zustand für Fehlerpfad Dfp_InjVlvNVC8" VALUE 0xCD8AC Kw_Wu16 655350.0 Time_ms 0.00 655350.0 FORMAT "%8.1" /end CHARACTERISTIC
/begin CHARACTERISTIC DSM_SdwDfp_LPACD_Max_C "Enprellzeit Shadow Zustand für Fehlerpfad Dfp_LPACD_Max" VALUE 0xCD8AE Kw_Wu16 655350.0 Time_ms 0.00 655350.0 FORMAT "%8.1" /end CHARACTERISTIC
/begin CHARACTERISTIC DSM_SdwDfp_LPACD_Min_C "Enprellzeit Shadow Zustand für Fehlerpfad Dfp_LPACD_Min" VALUE 0xCD8B0 Kw_Wu16 655350.0 Time_ms 0.00 655350.0 FORMAT "%8.1" /end CHARACTERISTIC
/begin CHARACTERISTIC DSM_SdwDfp_LPACD_SigNpl_C "Enprellzeit Shadow Zustand für Fehlerpfad Dfp_LPACD_SigNpl" VALUE 0xCD8B2 Kw_Wu16 655350.0 Time_ms 0.00 655350.0 FORMAT "%8.1" /end CHARACTERISTIC
/begin CHARACTERISTIC DSM_SdwDfp_LSUCDCircNernst0_C "Enprellzeit Shadow Zustand für Fehlerpfad Dfp_LSUCDCircNernst0" VALUE 0xCD8B4 Kw_Wu16 655350.0 Time_ms 0.00 655350.0 FORMAT "%8.1" /end CHARACTERISTIC
/begin CHARACTERISTIC DSM_SdwDfp_LSUCDCircPumpCur0_C "Enprellzeit Shadow Zustand für Fehlerpfad Dfp_LSUCDCircPumpCur0" VALUE 0xCD8B6 Kw_Wu16 655350.0 Time_ms 0.00 655350.0 FORMAT "%8.1" /end CHARACTERISTIC
/begin CHARACTERISTIC DSM_SdwDfp_LSUCDCircVirtGnd0_C "Enprellzeit Shadow Zustand für Fehlerpfad Dfp_LSUCDCircVirtGnd0" VALUE 0xCD8B8 Kw_Wu16 655350.0 Time_ms 0.00 655350.0 FORMAT "%8.1" /end CHARACTERISTIC
/begin CHARACTERISTIC DSM_SdwDfp_LSUCDHeater0_C "Enprellzeit Shadow Zustand für Fehlerpfad Dfp_LSUCDHeater0" VALUE 0xCD8BA Kw_Wu16 655350.0 Time_ms 0.00 655350.0 FORMAT "%8.1" /end CHARACTERISTIC
/begin CHARACTERISTIC DSM_SdwDfp_LSUCDHtCoup0_C "Enprellzeit Shadow Zustand für Fehlerpfad Dfp_LSUCDHtCoup0" VALUE 0xCD8BC Kw_Wu16 655350.0 Time_ms 0.00 655350.0 FORMAT "%8.1" /end CHARACTERISTIC
/begin CHARACTERISTIC DSM_SdwDfp_LSUCDO20_C "Enprellzeit Shadow Zustand für Fehlerpfad Dfp_LSUCDO20" VALUE 0xCD8BE Kw_Wu16 655350.0 Time_ms 0.00 655350.0 FORMAT "%8.1" /end CHARACTERISTIC
/begin CHARACTERISTIC DSM_SdwDfp_LSUCDO2Clb0_C "Enprellzeit Shadow Zustand für Fehlerpfad Dfp_LSUCDO2Clb0" VALUE 0xCD8C0 Kw_Wu16 655350.0 Time_ms 0.00 655350.0 FORMAT "%8.1" /end CHARACTERISTIC
/begin CHARACTERISTIC DSM_SdwDfp_LSUCDRiClb0_C "Enprellzeit Shadow Zustand für Fehlerpfad Dfp_LSUCDRiClb0" VALUE 0xCD8C2 Kw_Wu16 655350.0 Time_ms 0.00 655350.0 FORMAT "%8.1" /end CHARACTERISTIC
/begin CHARACTERISTIC DSM_SdwDfp_LSUCDSPI0_C "Enprellzeit Shadow Zustand für Fehlerpfad Dfp_LSUCDSPI0" VALUE 0xCD8C4 Kw_Wu16 655350.0 Time_ms 0.00 655350.0 FORMAT "%8.1" /end CHARACTERISTIC
/begin CHARACTERISTIC DSM_SdwDfp_LSUCDSPIBattLow0_C "Enprellzeit Shadow Zustand für Fehlerpfad Dfp_LSUCDSPIBattLow0" VALUE 0xCD8C6 Kw_Wu16 655350.0 Time_ms 0.00 655350.0 FORMAT "%8.1" /end CHARACTERISTIC
/begin CHARACTERISTIC DSM_SdwDfp_LSUCDWireIP0_C "Enprellzeit Shadow Zustand für Fehlerpfad Dfp_LSUCDWireIP0" VALUE 0xCD8C8 Kw_Wu16 655350.0 Time_ms 0.00 655350.0 FORMAT "%8.1" /end CHARACTERISTIC
/begin CHARACTERISTIC DSM_SdwDfp_LSUCtlRiExc0_C "Enprellzeit Shadow Zustand für Fehlerpfad Dfp_LSUCtlRiExc0" VALUE 0xCD8CA Kw_Wu16 655350.0 Time_ms 0.00 655350.0 FORMAT "%8.1" /end CHARACTERISTIC
/begin CHARACTERISTIC DSM_SdwDfp_LSUMon1Sens_C "Enprellzeit Shadow Zustand für Fehlerpfad Dfp_LSUMon1Sens" VALUE 0xCD8CC Kw_Wu16 655350.0 Time_ms 0.00 655350.0 FORMAT "%8.1" /end CHARACTERISTIC
/begin CHARACTERISTIC DSM_SdwDfp_LSUMon2Sens_C "Enprellzeit Shadow Zustand für Fehlerpfad Dfp_LSUMon2Sens" VALUE 0xCD8CE Kw_Wu16 655350.0 Time_ms 0.00 655350.0 FORMAT "%8.1" /end CHARACTERISTIC
/begin CHARACTERISTIC DSM_SdwDfp_MIL_C "Enprellzeit Shadow Zustand für Fehlerpfad Dfp_MIL" VALUE 0xCD8D0 Kw_Wu16 655350.0 Time_ms 0.00 655350.0 FORMAT "%8.1" /end CHARACTERISTIC
/begin CHARACTERISTIC DSM_SdwDfp_MRlyCD_C "Enprellzeit Shadow Zustand für Fehlerpfad Dfp_MRlyCD" VALUE 0xCD8D2 Kw_Wu16 655350.0 Time_ms 0.00 655350.0 FORMAT "%8.1" /end CHARACTERISTIC
/begin CHARACTERISTIC DSM_SdwDfp_MSidCD_Comm_C "Enprellzeit Shadow Zustand für Fehlerpfad Dfp_MSidCD_Comm" VALUE 0xCD8D4 Kw_Wu16 655350.0 Time_ms 0.00 655350.0 FORMAT "%8.1" /end CHARACTERISTIC
/begin CHARACTERISTIC DSM_SdwDfp_MSidCD_Pin_C "Enprellzeit Shadow Zustand für Fehlerpfad Dfp_MSidCD_Pin" VALUE 0xCD8D6 Kw_Wu16 655350.0 Time_ms 0.00 655350.0 FORMAT "%8.1" /end CHARACTERISTIC
/begin CHARACTERISTIC DSM_SdwDfp_MSidCD_Sel_INI_C "Enprellzeit Shadow Zustand für Fehlerpfad Dfp_MSidCD_Sel_INI" VALUE 0xCD8D8 Kw_Wu16 655350.0 Time_ms 0.00 655350.0 FORMAT "%8.1" /end CHARACTERISTIC
/begin CHARACTERISTIC DSM_SdwDfp_MSidCD_Select_C "Enprellzeit Shadow Zustand für Fehlerpfad Dfp_MSidCD_Select" VALUE 0xCD8DA Kw_Wu16 655350.0 Time_ms 0.00 655350.0 FORMAT "%8.1" /end CHARACTERISTIC
/begin CHARACTERISTIC DSM_SdwDfp_MeUnCDNoLoad_C "Enprellzeit Shadow Zustand für Fehlerpfad Dfp_MeUnCDNoLoad" VALUE 0xCD8DC Kw_Wu16 655350.0 Time_ms 0.00 655350.0 FORMAT "%8.1" /end CHARACTERISTIC
/begin CHARACTERISTIC DSM_SdwDfp_MeUnCDSCBat_C "Enprellzeit Shadow Zustand für Fehlerpfad Dfp_MeUnCDSCBat" VALUE 0xCD8DE Kw_Wu16 655350.0 Time_ms 0.00 655350.0 FORMAT "%8.1" /end CHARACTERISTIC
/begin CHARACTERISTIC DSM_SdwDfp_MeUnCDSCGnd_C "Enprellzeit Shadow Zustand für Fehlerpfad Dfp_MeUnCDSCGnd" VALUE 0xCD8E0 Kw_Wu16 655350.0 Time_ms 0.00 655350.0 FORMAT "%8.1" /end CHARACTERISTIC
/begin CHARACTERISTIC DSM_SdwDfp_MeUnCD_ADC_C "Enprellzeit Shadow Zustand für Fehlerpfad Dfp_MeUnCD_ADC" VALUE 0xCD8E2 Kw_Wu16 655350.0 Time_ms 0.00 655350.0 FORMAT "%8.1" /end CHARACTERISTIC
/begin CHARACTERISTIC DSM_SdwDfp_MeUnCD_SigTst_C "Enprellzeit Shadow Zustand für Fehlerpfad Dfp_MeUnCD_SigTst" VALUE 0xCD8E4 Kw_Wu16 655350.0 Time_ms 0.00 655350.0 FORMAT "%8.1" /end CHARACTERISTIC
/begin CHARACTERISTIC DSM_SdwDfp_Montr_C "Enprellzeit Shadow Zustand für Fehlerpfad Dfp_Montr" VALUE 0xCD8E6 Kw_Wu16 655350.0 Time_ms 0.00 655350.0 FORMAT "%8.1" /end CHARACTERISTIC
/begin CHARACTERISTIC DSM_SdwDfp_NetMngDeviceA_C "Enprellzeit Shadow Zustand für Fehlerpfad Dfp_NetMngDeviceA" VALUE 0xCD8E8 Kw_Wu16 655350.0 Time_ms 0.00 655350.0 FORMAT "%8.1" /end CHARACTERISTIC
/begin CHARACTERISTIC DSM_SdwDfp_NetMngDeviceB_C "Enprellzeit Shadow Zustand für Fehlerpfad Dfp_NetMngDeviceB" VALUE 0xCD8EA Kw_Wu16 655350.0 Time_ms 0.00 655350.0 FORMAT "%8.1" /end CHARACTERISTIC
/begin CHARACTERISTIC DSM_SdwDfp_NetMngDeviceC_C "Enprellzeit Shadow Zustand für Fehlerpfad Dfp_NetMngDeviceC" VALUE 0xCD8EC Kw_Wu16 655350.0 Time_ms 0.00 655350.0 FORMAT "%8.1" /end CHARACTERISTIC
/begin CHARACTERISTIC DSM_SdwDfp_OPSCD_Lamp_C "Enprellzeit Shadow Zustand für Fehlerpfad Dfp_OPSCD_Lamp" VALUE 0xCD8EE Kw_Wu16 655350.0 Time_ms 0.00 655350.0 FORMAT "%8.1" /end CHARACTERISTIC
/begin CHARACTERISTIC DSM_SdwDfp_OPSCD_anain_C "Enprellzeit Shadow Zustand für Fehlerpfad Dfp_OPSCD_anain" VALUE 0xCD8F0 Kw_Wu16 655350.0 Time_ms 0.00 655350.0 FORMAT "%8.1" /end CHARACTERISTIC
/begin CHARACTERISTIC DSM_SdwDfp_OTSCD_C "Enprellzeit Shadow Zustand für Fehlerpfad Dfp_OTSCD" VALUE 0xCD8F2 Kw_Wu16 655350.0 Time_ms 0.00 655350.0 FORMAT "%8.1" /end CHARACTERISTIC
/begin CHARACTERISTIC DSM_SdwDfp_OvRMon_C "Enprellzeit Shadow Zustand für Fehlerpfad Dfp_OvRMon" VALUE 0xCD8F4 Kw_Wu16 655350.0 Time_ms 0.00 655350.0 FORMAT "%8.1" /end CHARACTERISTIC
/begin CHARACTERISTIC DSM_SdwDfp_OvRMonBrk_C "Enprellzeit Shadow Zustand für Fehlerpfad Dfp_OvRMonBrk" VALUE 0xCD8F6 Kw_Wu16 655350.0 Time_ms 0.00 655350.0 FORMAT "%8.1" /end CHARACTERISTIC
/begin CHARACTERISTIC DSM_SdwDfp_OvRMonSigA_C "Enprellzeit Shadow Zustand für Fehlerpfad Dfp_OvRMonSigA" VALUE 0xCD8F8 Kw_Wu16 655350.0 Time_ms 0.00 655350.0 FORMAT "%8.1" /end CHARACTERISTIC
/begin CHARACTERISTIC DSM_SdwDfp_OxiCCDTPre_C "Enprellzeit Shadow Zustand für Fehlerpfad Dfp_OxiCCDTPre" VALUE 0xCD8FA Kw_Wu16 655350.0 Time_ms 0.00 655350.0 FORMAT "%8.1" /end CHARACTERISTIC
/begin CHARACTERISTIC DSM_SdwDfp_PCR_GovDevNeg_C "Enprellzeit Shadow Zustand für Fehlerpfad Dfp_PCR_GovDevNeg" VALUE 0xCD8FC Kw_Wu16 655350.0 Time_ms 0.00 655350.0 FORMAT "%8.1" /end CHARACTERISTIC
/begin CHARACTERISTIC DSM_SdwDfp_PCR_GovDevPos_C "Enprellzeit Shadow Zustand für Fehlerpfad Dfp_PCR_GovDevPos" VALUE 0xCD8FE Kw_Wu16 655350.0 Time_ms 0.00 655350.0 FORMAT "%8.1" /end CHARACTERISTIC
/begin CHARACTERISTIC DSM_SdwDfp_PCR_LPGvnrDvtNeg_C "Enprellzeit Shadow Zustand für Fehlerpfad Dfp_PCR_LPGvnrDvtNeg" VALUE 0xCD900 Kw_Wu16 655350.0 Time_ms 0.00 655350.0 FORMAT "%8.1" /end CHARACTERISTIC
/begin CHARACTERISTIC DSM_SdwDfp_PCR_LPGvnrDvtPos_C "Enprellzeit Shadow Zustand für Fehlerpfad Dfp_PCR_LPGvnrDvtPos" VALUE 0xCD902 Kw_Wu16 655350.0 Time_ms 0.00 655350.0 FORMAT "%8.1" /end CHARACTERISTIC
/begin CHARACTERISTIC DSM_SdwDfp_PCVCDNoLoad_C "Enprellzeit Shadow Zustand für Fehlerpfad Dfp_PCVCDNoLoad" VALUE 0xCD904 Kw_Wu16 655350.0 Time_ms 0.00 655350.0 FORMAT "%8.1" /end CHARACTERISTIC
/begin CHARACTERISTIC DSM_SdwDfp_PCVCDSCBat_C "Enprellzeit Shadow Zustand für Fehlerpfad Dfp_PCVCDSCBat" VALUE 0xCD906 Kw_Wu16 655350.0 Time_ms 0.00 655350.0 FORMAT "%8.1" /end CHARACTERISTIC
/begin CHARACTERISTIC DSM_SdwDfp_PCVCDSCGnd_C "Enprellzeit Shadow Zustand für Fehlerpfad Dfp_PCVCDSCGnd" VALUE 0xCD908 Kw_Wu16 655350.0 Time_ms 0.00 655350.0 FORMAT "%8.1" /end CHARACTERISTIC
/begin CHARACTERISTIC DSM_SdwDfp_PCVCD_ADC_C "Enprellzeit Shadow Zustand für Fehlerpfad Dfp_PCVCD_ADC" VALUE 0xCD90A Kw_Wu16 655350.0 Time_ms 0.00 655350.0 FORMAT "%8.1" /end CHARACTERISTIC
/begin CHARACTERISTIC DSM_SdwDfp_PCVCD_SigTst_C "Enprellzeit Shadow Zustand für Fehlerpfad Dfp_PCVCD_SigTst" VALUE 0xCD90C Kw_Wu16 655350.0 Time_ms 0.00 655350.0 FORMAT "%8.1" /end CHARACTERISTIC
/begin CHARACTERISTIC DSM_SdwDfp_PFltAPSPlaus_C "Enprellzeit Shadow Zustand für Fehlerpfad Dfp_PFltAPSPlaus" VALUE 0xCD90E Kw_Wu16 655350.0 Time_ms 0.00 655350.0 FORMAT "%8.1" /end CHARACTERISTIC
/begin CHARACTERISTIC DSM_SdwDfp_PFltAPSens_C "Enprellzeit Shadow Zustand für Fehlerpfad Dfp_PFltAPSens" VALUE 0xCD910 Kw_Wu16 655350.0 Time_ms 0.00 655350.0 FORMAT "%8.1" /end CHARACTERISTIC
/begin CHARACTERISTIC DSM_SdwDfp_PFltBPSPlaus_C "Enprellzeit Shadow Zustand für Fehlerpfad Dfp_PFltBPSPlaus" VALUE 0xCD912 Kw_Wu16 655350.0 Time_ms 0.00 655350.0 FORMAT "%8.1" /end CHARACTERISTIC
/begin CHARACTERISTIC DSM_SdwDfp_PFltCDPPre_C "Enprellzeit Shadow Zustand für Fehlerpfad Dfp_PFltCDPPre" VALUE 0xCD914 Kw_Wu16 655350.0 Time_ms 0.00 655350.0 FORMAT "%8.1" /end CHARACTERISTIC
/begin CHARACTERISTIC DSM_SdwDfp_PFltCDTempPre_C "Enprellzeit Shadow Zustand für Fehlerpfad Dfp_PFltCDTempPre" VALUE 0xCD916 Kw_Wu16 655350.0 Time_ms 0.00 655350.0 FORMAT "%8.1" /end CHARACTERISTIC
/begin CHARACTERISTIC DSM_SdwDfp_PFltChar_C "Enprellzeit Shadow Zustand für Fehlerpfad Dfp_PFltChar" VALUE 0xCD918 Kw_Wu16 655350.0 Time_ms 0.00 655350.0 FORMAT "%8.1" /end CHARACTERISTIC
/begin CHARACTERISTIC DSM_SdwDfp_PFltEngPrt_C "Enprellzeit Shadow Zustand für Fehlerpfad Dfp_PFltEngPrt" VALUE 0xCD91A Kw_Wu16 655350.0 Time_ms 0.00 655350.0 FORMAT "%8.1" /end CHARACTERISTIC
/begin CHARACTERISTIC DSM_SdwDfp_PFltPresDynPlaus_C "Enprellzeit Shadow Zustand für Fehlerpfad Dfp_PFltPresDynPlaus" VALUE 0xCD91C Kw_Wu16 655350.0 Time_ms 0.00 655350.0 FORMAT "%8.1" /end CHARACTERISTIC
/begin CHARACTERISTIC DSM_SdwDfp_PFltPresPlaus_C "Enprellzeit Shadow Zustand für Fehlerpfad Dfp_PFltPresPlaus" VALUE 0xCD91E Kw_Wu16 655350.0 Time_ms 0.00 655350.0 FORMAT "%8.1" /end CHARACTERISTIC
/begin CHARACTERISTIC DSM_SdwDfp_PFltPresSens_C "Enprellzeit Shadow Zustand für Fehlerpfad Dfp_PFltPresSens" VALUE 0xCD920 Kw_Wu16 655350.0 Time_ms 0.00 655350.0 FORMAT "%8.1" /end CHARACTERISTIC
/begin CHARACTERISTIC DSM_SdwDfp_PFltPresSensFrz_C "Enprellzeit Shadow Zustand für Fehlerpfad Dfp_PFltPresSensFrz" VALUE 0xCD922 Kw_Wu16 655350.0 Time_ms 0.00 655350.0 FORMAT "%8.1" /end CHARACTERISTIC
/begin CHARACTERISTIC DSM_SdwDfp_PFltPresSensHsLn_C "Enprellzeit Shadow Zustand für Fehlerpfad Dfp_PFltPresSensHsLn" VALUE 0xCD924 Kw_Wu16 655350.0 Time_ms 0.00 655350.0 FORMAT "%8.1" /end CHARACTERISTIC
/begin CHARACTERISTIC DSM_SdwDfp_PFltPresSensSot_C "Enprellzeit Shadow Zustand für Fehlerpfad Dfp_PFltPresSensSot" VALUE 0xCD926 Kw_Wu16 655350.0 Time_ms 0.00 655350.0 FORMAT "%8.1" /end CHARACTERISTIC
/begin CHARACTERISTIC DSM_SdwDfp_PFltRgnPerm_C "Enprellzeit Shadow Zustand für Fehlerpfad Dfp_PFltRgnPerm" VALUE 0xCD928 Kw_Wu16 655350.0 Time_ms 0.00 655350.0 FORMAT "%8.1" /end CHARACTERISTIC
/begin CHARACTERISTIC DSM_SdwDfp_PFltTempDwnStrm_C "Enprellzeit Shadow Zustand für Fehlerpfad Dfp_PFltTempDwnStrm" VALUE 0xCD92A Kw_Wu16 655350.0 Time_ms 0.00 655350.0 FORMAT "%8.1" /end CHARACTERISTIC
/begin CHARACTERISTIC DSM_SdwDfp_PFltTempSens_C "Enprellzeit Shadow Zustand für Fehlerpfad Dfp_PFltTempSens" VALUE 0xCD92C Kw_Wu16 655350.0 Time_ms 0.00 655350.0 FORMAT "%8.1" /end CHARACTERISTIC
/begin CHARACTERISTIC DSM_SdwDfp_PFltTempUpStrm_C "Enprellzeit Shadow Zustand für Fehlerpfad Dfp_PFltTempUpStrm" VALUE 0xCD92E Kw_Wu16 655350.0 Time_ms 0.00 655350.0 FORMAT "%8.1" /end CHARACTERISTIC
/begin CHARACTERISTIC DSM_SdwDfp_PFltmSotDiffMax_C "Enprellzeit Shadow Zustand für Fehlerpfad Dfp_PFltmSotDiffMax" VALUE 0xCD930 Kw_Wu16 655350.0 Time_ms 0.00 655350.0 FORMAT "%8.1" /end CHARACTERISTIC
/begin CHARACTERISTIC DSM_SdwDfp_PSPCD_Actr_C "Enprellzeit Shadow Zustand für Fehlerpfad Dfp_PSPCD_Actr" VALUE 0xCD932 Kw_Wu16 655350.0 Time_ms 0.00 655350.0 FORMAT "%8.1" /end CHARACTERISTIC
/begin CHARACTERISTIC DSM_SdwDfp_PresPlausDblDef_C "Enprellzeit Shadow Zustand für Fehlerpfad Dfp_PresPlausDblDef" VALUE 0xCD934 Kw_Wu16 655350.0 Time_ms 0.00 655350.0 FORMAT "%8.1" /end CHARACTERISTIC
/begin CHARACTERISTIC DSM_SdwDfp_QLTCD_C "Enprellzeit Shadow Zustand für Fehlerpfad Dfp_QLTCD" VALUE 0xCD936 Kw_Wu16 655350.0 Time_ms 0.00 655350.0 FORMAT "%8.1" /end CHARACTERISTIC
/begin CHARACTERISTIC DSM_SdwDfp_RailCD_C "Enprellzeit Shadow Zustand für Fehlerpfad Dfp_RailCD" VALUE 0xCD938 Kw_Wu16 655350.0 Time_ms 0.00 655350.0 FORMAT "%8.1" /end CHARACTERISTIC
/begin CHARACTERISTIC DSM_SdwDfp_RailCDOfsTst_C "Enprellzeit Shadow Zustand für Fehlerpfad Dfp_RailCDOfsTst" VALUE 0xCD93A Kw_Wu16 655350.0 Time_ms 0.00 655350.0 FORMAT "%8.1" /end CHARACTERISTIC
/begin CHARACTERISTIC DSM_SdwDfp_RailCD_PMonStrt_C "Enprellzeit Shadow Zustand für Fehlerpfad Dfp_RailCD_PMonStrt" VALUE 0xCD93C Kw_Wu16 655350.0 Time_ms 0.00 655350.0 FORMAT "%8.1" /end CHARACTERISTIC
/begin CHARACTERISTIC DSM_SdwDfp_RailCtlModeMeUnDiag_C "Enprellzeit Shadow Zustand für Fehlerpfad Dfp_RailCtlModeMeUnDiag" VALUE 0xCD93E Kw_Wu16 655350.0 Time_ms 0.00 655350.0 FORMAT "%8.1" /end CHARACTERISTIC
/begin CHARACTERISTIC DSM_SdwDfp_RailCtlModePCVDiag_C "Enprellzeit Shadow Zustand für Fehlerpfad Dfp_RailCtlModePCVDiag" VALUE 0xCD940 Kw_Wu16 655350.0 Time_ms 0.00 655350.0 FORMAT "%8.1" /end CHARACTERISTIC
/begin CHARACTERISTIC DSM_SdwDfp_RailMeUn0_C "Enprellzeit Shadow Zustand für Fehlerpfad Dfp_RailMeUn0" VALUE 0xCD942 Kw_Wu16 655350.0 Time_ms 0.00 655350.0 FORMAT "%8.1" /end CHARACTERISTIC
/begin CHARACTERISTIC DSM_SdwDfp_RailMeUn1_C "Enprellzeit Shadow Zustand für Fehlerpfad Dfp_RailMeUn1" VALUE 0xCD944 Kw_Wu16 655350.0 Time_ms 0.00 655350.0 FORMAT "%8.1" /end CHARACTERISTIC
/begin CHARACTERISTIC DSM_SdwDfp_RailMeUn2_C "Enprellzeit Shadow Zustand für Fehlerpfad Dfp_RailMeUn2" VALUE 0xCD946 Kw_Wu16 655350.0 Time_ms 0.00 655350.0 FORMAT "%8.1" /end CHARACTERISTIC
/begin CHARACTERISTIC DSM_SdwDfp_RailMeUn3_C "Enprellzeit Shadow Zustand für Fehlerpfad Dfp_RailMeUn3" VALUE 0xCD948 Kw_Wu16 655350.0 Time_ms 0.00 655350.0 FORMAT "%8.1" /end CHARACTERISTIC
/begin CHARACTERISTIC DSM_SdwDfp_RailMeUn4_C "Enprellzeit Shadow Zustand für Fehlerpfad Dfp_RailMeUn4" VALUE 0xCD94A Kw_Wu16 655350.0 Time_ms 0.00 655350.0 FORMAT "%8.1" /end CHARACTERISTIC
/begin CHARACTERISTIC DSM_SdwDfp_RailPCV0_C "Enprellzeit Shadow Zustand für Fehlerpfad Dfp_RailPCV0" VALUE 0xCD94C Kw_Wu16 655350.0 Time_ms 0.00 655350.0 FORMAT "%8.1" /end CHARACTERISTIC
/begin CHARACTERISTIC DSM_SdwDfp_RailPCV1_C "Enprellzeit Shadow Zustand für Fehlerpfad Dfp_RailPCV1" VALUE 0xCD94E Kw_Wu16 655350.0 Time_ms 0.00 655350.0 FORMAT "%8.1" /end CHARACTERISTIC
/begin CHARACTERISTIC DSM_SdwDfp_RailPCV2_C "Enprellzeit Shadow Zustand für Fehlerpfad Dfp_RailPCV2" VALUE 0xCD950 Kw_Wu16 655350.0 Time_ms 0.00 655350.0 FORMAT "%8.1" /end CHARACTERISTIC
/begin CHARACTERISTIC DSM_SdwDfp_RailPCV3_C "Enprellzeit Shadow Zustand für Fehlerpfad Dfp_RailPCV3" VALUE 0xCD952 Kw_Wu16 655350.0 Time_ms 0.00 655350.0 FORMAT "%8.1" /end CHARACTERISTIC
/begin CHARACTERISTIC DSM_SdwDfp_RailPCV4_C "Enprellzeit Shadow Zustand für Fehlerpfad Dfp_RailPCV4" VALUE 0xCD954 Kw_Wu16 655350.0 Time_ms 0.00 655350.0 FORMAT "%8.1" /end CHARACTERISTIC
/begin CHARACTERISTIC DSM_SdwDfp_RailPCV5_C "Enprellzeit Shadow Zustand für Fehlerpfad Dfp_RailPCV5" VALUE 0xCD956 Kw_Wu16 655350.0 Time_ms 0.00 655350.0 FORMAT "%8.1" /end CHARACTERISTIC
/begin CHARACTERISTIC DSM_SdwDfp_SOPTst_C "Enprellzeit Shadow Zustand für Fehlerpfad Dfp_SOPTst" VALUE 0xCD958 Kw_Wu16 655350.0 Time_ms 0.00 655350.0 FORMAT "%8.1" /end CHARACTERISTIC
/begin CHARACTERISTIC DSM_SdwDfp_SSpMon1_C "Enprellzeit Shadow Zustand für Fehlerpfad Dfp_SSpMon1" VALUE 0xCD95A Kw_Wu16 655350.0 Time_ms 0.00 655350.0 FORMAT "%8.1" /end CHARACTERISTIC
/begin CHARACTERISTIC DSM_SdwDfp_SSpMon2_C "Enprellzeit Shadow Zustand für Fehlerpfad Dfp_SSpMon2" VALUE 0xCD95C Kw_Wu16 655350.0 Time_ms 0.00 655350.0 FORMAT "%8.1" /end CHARACTERISTIC
/begin CHARACTERISTIC DSM_SdwDfp_SSpMon3_C "Enprellzeit Shadow Zustand für Fehlerpfad Dfp_SSpMon3" VALUE 0xCD95E Kw_Wu16 655350.0 Time_ms 0.00 655350.0 FORMAT "%8.1" /end CHARACTERISTIC
/begin CHARACTERISTIC DSM_SdwDfp_SWChk_CycSigChkDat_C "Enprellzeit Shadow Zustand für Fehlerpfad Dfp_SWChk_CycSigChkDat" VALUE 0xCD960 Kw_Wu16 655350.0 Time_ms 0.00 655350.0 FORMAT "%8.1" /end CHARACTERISTIC
/begin CHARACTERISTIC DSM_SdwDfp_SWChk_CycSigChkPrg_C "Enprellzeit Shadow Zustand für Fehlerpfad Dfp_SWChk_CycSigChkPrg" VALUE 0xCD962 Kw_Wu16 655350.0 Time_ms 0.00 655350.0 FORMAT "%8.1" /end CHARACTERISTIC
/begin CHARACTERISTIC DSM_SdwDfp_ShutCD_C "Enprellzeit Shadow Zustand für Fehlerpfad Dfp_ShutCD" VALUE 0xCD964 Kw_Wu16 655350.0 Time_ms 0.00 655350.0 FORMAT "%8.1" /end CHARACTERISTIC
/begin CHARACTERISTIC DSM_SdwDfp_StSysTrqShutOff_C "Enprellzeit Shadow Zustand für Fehlerpfad Dfp_StSysTrqShutOff" VALUE 0xCD966 Kw_Wu16 655350.0 Time_ms 0.00 655350.0 FORMAT "%8.1" /end CHARACTERISTIC
/begin CHARACTERISTIC DSM_SdwDfp_StrtCD_Actr_C "Enprellzeit Shadow Zustand für Fehlerpfad Dfp_StrtCD_Actr" VALUE 0xCD968 Kw_Wu16 655350.0 Time_ms 0.00 655350.0 FORMAT "%8.1" /end CHARACTERISTIC
/begin CHARACTERISTIC DSM_SdwDfp_SysLamp_C "Enprellzeit Shadow Zustand für Fehlerpfad Dfp_SysLamp" VALUE 0xCD96A Kw_Wu16 655350.0 Time_ms 0.00 655350.0 FORMAT "%8.1" /end CHARACTERISTIC
/begin CHARACTERISTIC DSM_SdwDfp_T15CD_C "Enprellzeit Shadow Zustand für Fehlerpfad Dfp_T15CD" VALUE 0xCD96C Kw_Wu16 655350.0 Time_ms 0.00 655350.0 FORMAT "%8.1" /end CHARACTERISTIC
/begin CHARACTERISTIC DSM_SdwDfp_TGearbx_C "Enprellzeit Shadow Zustand für Fehlerpfad Dfp_TGearbx" VALUE 0xCD96E Kw_Wu16 655350.0 Time_ms 0.00 655350.0 FORMAT "%8.1" /end CHARACTERISTIC
/begin CHARACTERISTIC DSM_SdwDfp_TPUMon_C "Enprellzeit Shadow Zustand für Fehlerpfad Dfp_TPUMon" VALUE 0xCD970 Kw_Wu16 655350.0 Time_ms 0.00 655350.0 FORMAT "%8.1" /end CHARACTERISTIC
/begin CHARACTERISTIC DSM_SdwDfp_TVACD_Max_C "Enprellzeit Shadow Zustand für Fehlerpfad Dfp_TVACD_Max" VALUE 0xCD972 Kw_Wu16 655350.0 Time_ms 0.00 655350.0 FORMAT "%8.1" /end CHARACTERISTIC
/begin CHARACTERISTIC DSM_SdwDfp_TVACD_Min_C "Enprellzeit Shadow Zustand für Fehlerpfad Dfp_TVACD_Min" VALUE 0xCD974 Kw_Wu16 655350.0 Time_ms 0.00 655350.0 FORMAT "%8.1" /end CHARACTERISTIC
/begin CHARACTERISTIC DSM_SdwDfp_TVACD_SigNpl_C "Enprellzeit Shadow Zustand für Fehlerpfad Dfp_TVACD_SigNpl" VALUE 0xCD976 Kw_Wu16 655350.0 Time_ms 0.00 655350.0 FORMAT "%8.1" /end CHARACTERISTIC
/begin CHARACTERISTIC DSM_SdwDfp_TVACD_TVADia1_C "Enprellzeit Shadow Zustand für Fehlerpfad Dfp_TVACD_TVADia1" VALUE 0xCD978 Kw_Wu16 655350.0 Time_ms 0.00 655350.0 FORMAT "%8.1" /end CHARACTERISTIC
/begin CHARACTERISTIC DSM_SdwDfp_TVACD_TVADia2_C "Enprellzeit Shadow Zustand für Fehlerpfad Dfp_TVACD_TVADia2" VALUE 0xCD97A Kw_Wu16 655350.0 Time_ms 0.00 655350.0 FORMAT "%8.1" /end CHARACTERISTIC
/begin CHARACTERISTIC DSM_SdwDfp_TVACD_TVADia3_C "Enprellzeit Shadow Zustand für Fehlerpfad Dfp_TVACD_TVADia3" VALUE 0xCD97C Kw_Wu16 655350.0 Time_ms 0.00 655350.0 FORMAT "%8.1" /end CHARACTERISTIC
/begin CHARACTERISTIC DSM_SdwDfp_TVACD_TVADia4_C "Enprellzeit Shadow Zustand für Fehlerpfad Dfp_TVACD_TVADia4" VALUE 0xCD97E Kw_Wu16 655350.0 Time_ms 0.00 655350.0 FORMAT "%8.1" /end CHARACTERISTIC
/begin CHARACTERISTIC DSM_SdwDfp_VSACD_DioInDia1_C "Enprellzeit Shadow Zustand für Fehlerpfad Dfp_VSACD_DioInDia1" VALUE 0xCD980 Kw_Wu16 655350.0 Time_ms 0.00 655350.0 FORMAT "%8.1" /end CHARACTERISTIC
/begin CHARACTERISTIC DSM_SdwDfp_VSACD_DioInDia2_C "Enprellzeit Shadow Zustand für Fehlerpfad Dfp_VSACD_DioInDia2" VALUE 0xCD982 Kw_Wu16 655350.0 Time_ms 0.00 655350.0 FORMAT "%8.1" /end CHARACTERISTIC
/begin CHARACTERISTIC DSM_SdwDfp_VSACD_DioInDia3_C "Enprellzeit Shadow Zustand für Fehlerpfad Dfp_VSACD_DioInDia3" VALUE 0xCD984 Kw_Wu16 655350.0 Time_ms 0.00 655350.0 FORMAT "%8.1" /end CHARACTERISTIC
/begin CHARACTERISTIC DSM_SdwDfp_VSACD_DioInDia4_C "Enprellzeit Shadow Zustand für Fehlerpfad Dfp_VSACD_DioInDia4" VALUE 0xCD986 Kw_Wu16 655350.0 Time_ms 0.00 655350.0 FORMAT "%8.1" /end CHARACTERISTIC
/begin CHARACTERISTIC DSM_SdwDfp_VSACD_DioInMin_C "Enprellzeit Shadow Zustand für Fehlerpfad Dfp_VSACD_DioInMin" VALUE 0xCD988 Kw_Wu16 655350.0 Time_ms 0.00 655350.0 FORMAT "%8.1" /end CHARACTERISTIC
/begin CHARACTERISTIC DSM_SdwDfp_VSACD_Max_C "Enprellzeit Shadow Zustand für Fehlerpfad Dfp_VSACD_Max" VALUE 0xCD98A Kw_Wu16 655350.0 Time_ms 0.00 655350.0 FORMAT "%8.1" /end CHARACTERISTIC
/begin CHARACTERISTIC DSM_SdwDfp_VSACD_Min_C "Enprellzeit Shadow Zustand für Fehlerpfad Dfp_VSACD_Min" VALUE 0xCD98C Kw_Wu16 655350.0 Time_ms 0.00 655350.0 FORMAT "%8.1" /end CHARACTERISTIC
/begin CHARACTERISTIC DSM_SdwDfp_VSACD_SigNpl_C "Enprellzeit Shadow Zustand für Fehlerpfad Dfp_VSACD_SigNpl" VALUE 0xCD98E Kw_Wu16 655350.0 Time_ms 0.00 655350.0 FORMAT "%8.1" /end CHARACTERISTIC
/begin CHARACTERISTIC DSM_SdwDfp_VSACD_VSADia1_C "Enprellzeit Shadow Zustand für Fehlerpfad Dfp_VSACD_VSADia1" VALUE 0xCD990 Kw_Wu16 655350.0 Time_ms 0.00 655350.0 FORMAT "%8.1" /end CHARACTERISTIC
/begin CHARACTERISTIC DSM_SdwDfp_VSACD_VSADia2_C "Enprellzeit Shadow Zustand für Fehlerpfad Dfp_VSACD_VSADia2" VALUE 0xCD992 Kw_Wu16 655350.0 Time_ms 0.00 655350.0 FORMAT "%8.1" /end CHARACTERISTIC
/begin CHARACTERISTIC DSM_SdwDfp_VSACD_VSADia3_C "Enprellzeit Shadow Zustand für Fehlerpfad Dfp_VSACD_VSADia3" VALUE 0xCD994 Kw_Wu16 655350.0 Time_ms 0.00 655350.0 FORMAT "%8.1" /end CHARACTERISTIC
/begin CHARACTERISTIC DSM_SdwDfp_VSACD_VSADia4_C "Enprellzeit Shadow Zustand für Fehlerpfad Dfp_VSACD_VSADia4" VALUE 0xCD996 Kw_Wu16 655350.0 Time_ms 0.00 655350.0 FORMAT "%8.1" /end CHARACTERISTIC
/begin CHARACTERISTIC DSM_SdwDfp_VSSCD1_C "Enprellzeit Shadow Zustand für Fehlerpfad Dfp_VSSCD1" VALUE 0xCD998 Kw_Wu16 655350.0 Time_ms 0.00 655350.0 FORMAT "%8.1" /end CHARACTERISTIC
/begin CHARACTERISTIC DSM_SdwDfp_VSSCD2_C "Enprellzeit Shadow Zustand für Fehlerpfad Dfp_VSSCD2" VALUE 0xCD99A Kw_Wu16 655350.0 Time_ms 0.00 655350.0 FORMAT "%8.1" /end CHARACTERISTIC
/begin CHARACTERISTIC DSM_SdwDfp_WdCom_C "Enprellzeit Shadow Zustand für Fehlerpfad Dfp_WdCom" VALUE 0xCD99C Kw_Wu16 655350.0 Time_ms 0.00 655350.0 FORMAT "%8.1" /end CHARACTERISTIC
/begin CHARACTERISTIC DSM_TypDfp_Layer_TANS_C "Konvertierung der Fehlertypen auf der Diagnoseschnittstelle fuer Fehlerpfad Dfp_Layer_TANS" VAL_BLK 0xCD99E Kwb_Wu8 255.0 OneToOne 0.00 255.0 FORMAT "%5.1" NUMBER 4 /end CHARACTERISTIC
/begin CHARACTERISTIC DSM_TypDfp_ACCDCmpr_C "Konvertierung der Fehlertypen auf der Diagnoseschnittstelle fuer Fehlerpfad Dfp_ACCDCmpr" VAL_BLK 0xCD9A2 Kwb_Wu8 255.0 OneToOne 0.00 255.0 FORMAT "%5.1" NUMBER 4 /end CHARACTERISTIC
/begin CHARACTERISTIC DSM_TypDfp_ACCDPres_C "Konvertierung der Fehlertypen auf der Diagnoseschnittstelle fuer Fehlerpfad Dfp_ACCDPres" VAL_BLK 0xCD9A6 Kwb_Wu8 255.0 OneToOne 0.00 255.0 FORMAT "%5.1" NUMBER 4 /end CHARACTERISTIC
/begin CHARACTERISTIC DSM_TypDfp_ACCDPres1_C "Konvertierung der Fehlertypen auf der Diagnoseschnittstelle fuer Fehlerpfad Dfp_ACCDPres1" VAL_BLK 0xCD9AA Kwb_Wu8 255.0 OneToOne 0.00 255.0 FORMAT "%5.1" NUMBER 4 /end CHARACTERISTIC
/begin CHARACTERISTIC DSM_TypDfp_ACCDPresAna_C "Konvertierung der Fehlertypen auf der Diagnoseschnittstelle fuer Fehlerpfad Dfp_ACCDPresAna" VAL_BLK 0xCD9AE Kwb_Wu8 255.0 OneToOne 0.00 255.0 FORMAT "%5.1" NUMBER 4 /end CHARACTERISTIC
/begin CHARACTERISTIC DSM_TypDfp_ACCDSwtin_C "Konvertierung der Fehlertypen auf der Diagnoseschnittstelle fuer Fehlerpfad Dfp_ACCDSwtin" VAL_BLK 0xCD9B2 Kwb_Wu8 255.0 OneToOne 0.00 255.0 FORMAT "%5.1" NUMBER 4 /end CHARACTERISTIC
/begin CHARACTERISTIC DSM_TypDfp_ACC_PlausTrqDes_C "Konvertierung der Fehlertypen auf der Diagnoseschnittstelle fuer Fehlerpfad Dfp_ACC_PlausTrqDes" VAL_BLK 0xCD9B6 Kwb_Wu8 255.0 OneToOne 0.00 255.0 FORMAT "%5.1" NUMBER 4 /end CHARACTERISTIC
/begin CHARACTERISTIC DSM_TypDfp_ACC_trqInr_C "Konvertierung der Fehlertypen auf der Diagnoseschnittstelle fuer Fehlerpfad Dfp_ACC_trqInr" VAL_BLK 0xCD9BA Kwb_Wu8 255.0 OneToOne 0.00 255.0 FORMAT "%5.1" NUMBER 4 /end CHARACTERISTIC
/begin CHARACTERISTIC DSM_TypDfp_ACTrq_C "Konvertierung der Fehlertypen auf der Diagnoseschnittstelle fuer Fehlerpfad Dfp_ACTrq" VAL_BLK 0xCD9BE Kwb_Wu8 255.0 OneToOne 0.00 255.0 FORMAT "%5.1" NUMBER 4 /end CHARACTERISTIC
/begin CHARACTERISTIC DSM_TypDfp_ADCMon_C "Konvertierung der Fehlertypen auf der Diagnoseschnittstelle fuer Fehlerpfad Dfp_ADCMon" VAL_BLK 0xCD9C2 Kwb_Wu8 255.0 OneToOne 0.00 255.0 FORMAT "%5.1" NUMBER 4 /end CHARACTERISTIC
/begin CHARACTERISTIC DSM_TypDfp_AFSCDIdlAdjVal_C "Konvertierung der Fehlertypen auf der Diagnoseschnittstelle fuer Fehlerpfad Dfp_AFSCDIdlAdjVal" VAL_BLK 0xCD9C6 Kwb_Wu8 255.0 OneToOne 0.00 255.0 FORMAT "%5.1" NUMBER 4 /end CHARACTERISTIC
/begin CHARACTERISTIC DSM_TypDfp_AFSCDLdAdjVal_C "Konvertierung der Fehlertypen auf der Diagnoseschnittstelle fuer Fehlerpfad Dfp_AFSCDLdAdjVal" VAL_BLK 0xCD9CA Kwb_Wu8 255.0 OneToOne 0.00 255.0 FORMAT "%5.1" NUMBER 4 /end CHARACTERISTIC
/begin CHARACTERISTIC DSM_TypDfp_AFSCD_AirTempDcyc_C "Konvertierung der Fehlertypen auf der Diagnoseschnittstelle fuer Fehlerpfad Dfp_AFSCD_AirTempDcyc" VAL_BLK 0xCD9CE Kwb_Wu8 255.0 OneToOne 0.00 255.0 FORMAT "%5.1" NUMBER 4 /end CHARACTERISTIC
/begin CHARACTERISTIC DSM_TypDfp_AFSCD_PlOffsDrft_C "Konvertierung der Fehlertypen auf der Diagnoseschnittstelle fuer Fehlerpfad Dfp_AFSCD_PlOffsDrft" VAL_BLK 0xCD9D2 Kwb_Wu8 255.0 OneToOne 0.00 255.0 FORMAT "%5.1" NUMBER 4 /end CHARACTERISTIC
/begin CHARACTERISTIC DSM_TypDfp_AFSCD_PlSetyDrft_C "Konvertierung der Fehlertypen auf der Diagnoseschnittstelle fuer Fehlerpfad Dfp_AFSCD_PlSetyDrft" VAL_BLK 0xCD9D6 Kwb_Wu8 255.0 OneToOne 0.00 255.0 FORMAT "%5.1" NUMBER 4 /end CHARACTERISTIC
/begin CHARACTERISTIC DSM_TypDfp_AFSCD_SRCAirTemp_C "Konvertierung der Fehlertypen auf der Diagnoseschnittstelle fuer Fehlerpfad Dfp_AFSCD_SRCAirTemp" VAL_BLK 0xCD9DA Kwb_Wu8 255.0 OneToOne 0.00 255.0 FORMAT "%5.1" NUMBER 4 /end CHARACTERISTIC
/begin CHARACTERISTIC DSM_TypDfp_AFSCD_SRCBatt_C "Konvertierung der Fehlertypen auf der Diagnoseschnittstelle fuer Fehlerpfad Dfp_AFSCD_SRCBatt" VAL_BLK 0xCD9DE Kwb_Wu8 255.0 OneToOne 0.00 255.0 FORMAT "%5.1" NUMBER 4 /end CHARACTERISTIC
/begin CHARACTERISTIC DSM_TypDfp_AFSCD_SRCCorrAirm_C "Konvertierung der Fehlertypen auf der Diagnoseschnittstelle fuer Fehlerpfad Dfp_AFSCD_SRCCorrAirm" VAL_BLK 0xCD9E2 Kwb_Wu8 255.0 OneToOne 0.00 255.0 FORMAT "%5.1" NUMBER 4 /end CHARACTERISTIC
/begin CHARACTERISTIC DSM_TypDfp_AFSCD_SRCRawAirm_C "Konvertierung der Fehlertypen auf der Diagnoseschnittstelle fuer Fehlerpfad Dfp_AFSCD_SRCRawAirm" VAL_BLK 0xCD9E6 Kwb_Wu8 255.0 OneToOne 0.00 255.0 FORMAT "%5.1" NUMBER 4 /end CHARACTERISTIC
/begin CHARACTERISTIC DSM_TypDfp_Layer_TUMG_C "Konvertierung der Fehlertypen auf der Diagnoseschnittstelle fuer Fehlerpfad Dfp_Layer_TUMG" VAL_BLK 0xCD9EA Kwb_Wu8 255.0 OneToOne 0.00 255.0 FORMAT "%5.1" NUMBER 4 /end CHARACTERISTIC
/begin CHARACTERISTIC DSM_TypDfp_AFSCD_SRCRefSigPer_C "Konvertierung der Fehlertypen auf der Diagnoseschnittstelle fuer Fehlerpfad Dfp_AFSCD_SRCRefSigPer" VAL_BLK 0xCD9EE Kwb_Wu8 255.0 OneToOne 0.00 255.0 FORMAT "%5.1" NUMBER 4 /end CHARACTERISTIC
/begin CHARACTERISTIC DSM_TypDfp_AOHtCD_C "Konvertierung der Fehlertypen auf der Diagnoseschnittstelle fuer Fehlerpfad Dfp_AOHtCD" VAL_BLK 0xCD9F2 Kwb_Wu8 255.0 OneToOne 0.00 255.0 FORMAT "%5.1" NUMBER 4 /end CHARACTERISTIC
/begin CHARACTERISTIC DSM_TypDfp_Layer_GEN_C "Konvertierung der Fehlertypen auf der Diagnoseschnittstelle fuer Fehlerpfad Dfp_Layer_GEN" VAL_BLK 0xCD9F6 Kwb_Wu8 255.0 OneToOne 0.00 255.0 FORMAT "%5.1" NUMBER 4 /end CHARACTERISTIC
/begin CHARACTERISTIC DSM_TypDfp_Layer_BSD_C "Konvertierung der Fehlertypen auf der Diagnoseschnittstelle fuer Fehlerpfad Dfp_Layer_BSD" VAL_BLK 0xCD9FA Kwb_Wu8 255.0 OneToOne 0.00 255.0 FORMAT "%5.1" NUMBER 4 /end CHARACTERISTIC
/begin CHARACTERISTIC DSM_TypDfp_AOHtCD_AOHtDia1_C "Konvertierung der Fehlertypen auf der Diagnoseschnittstelle fuer Fehlerpfad Dfp_AOHtCD_AOHtDia1" VAL_BLK 0xCD9FE Kwb_Wu8 255.0 OneToOne 0.00 255.0 FORMAT "%5.1" NUMBER 4 /end CHARACTERISTIC
/begin CHARACTERISTIC DSM_TypDfp_AOHtCD_AOHtDia2_C "Konvertierung der Fehlertypen auf der Diagnoseschnittstelle fuer Fehlerpfad Dfp_AOHtCD_AOHtDia2" VAL_BLK 0xCDA02 Kwb_Wu8 255.0 OneToOne 0.00 255.0 FORMAT "%5.1" NUMBER 4 /end CHARACTERISTIC
/begin CHARACTERISTIC DSM_TypDfp_AOHtCD_AOHtDia3_C "Konvertierung der Fehlertypen auf der Diagnoseschnittstelle fuer Fehlerpfad Dfp_AOHtCD_AOHtDia3" VAL_BLK 0xCDA06 Kwb_Wu8 255.0 OneToOne 0.00 255.0 FORMAT "%5.1" NUMBER 4 /end CHARACTERISTIC
/begin CHARACTERISTIC DSM_TypDfp_APP1_C "Konvertierung der Fehlertypen auf der Diagnoseschnittstelle fuer Fehlerpfad Dfp_APP1" VAL_BLK 0xCDA0A Kwb_Wu8 255.0 OneToOne 0.00 255.0 FORMAT "%5.1" NUMBER 4 /end CHARACTERISTIC
/begin CHARACTERISTIC DSM_TypDfp_APP2_C "Konvertierung der Fehlertypen auf der Diagnoseschnittstelle fuer Fehlerpfad Dfp_APP2" VAL_BLK 0xCDA0E Kwb_Wu8 255.0 OneToOne 0.00 255.0 FORMAT "%5.1" NUMBER 4 /end CHARACTERISTIC
/begin CHARACTERISTIC DSM_TypDfp_APPSync_C "Konvertierung der Fehlertypen auf der Diagnoseschnittstelle fuer Fehlerpfad Dfp_APPSync" VAL_BLK 0xCDA12 Kwb_Wu8 255.0 OneToOne 0.00 255.0 FORMAT "%5.1" NUMBER 4 /end CHARACTERISTIC
/begin CHARACTERISTIC DSM_TypDfp_APSCD_C "Konvertierung der Fehlertypen auf der Diagnoseschnittstelle fuer Fehlerpfad Dfp_APSCD" VAL_BLK 0xCDA16 Kwb_Wu8 255.0 OneToOne 0.00 255.0 FORMAT "%5.1" NUMBER 4 /end CHARACTERISTIC
/begin CHARACTERISTIC DSM_TypDfp_ARS_C "Konvertierung der Fehlertypen auf der Diagnoseschnittstelle fuer Fehlerpfad Dfp_ARS" VAL_BLK 0xCDA1A Kwb_Wu8 255.0 OneToOne 0.00 255.0 FORMAT "%5.1" NUMBER 4 /end CHARACTERISTIC
/begin CHARACTERISTIC DSM_TypDfp_AccPedPlausBrk_C "Konvertierung der Fehlertypen auf der Diagnoseschnittstelle fuer Fehlerpfad Dfp_AccPedPlausBrk" VAL_BLK 0xCDA1E Kwb_Wu8 255.0 OneToOne 0.00 255.0 FORMAT "%5.1" NUMBER 4 /end CHARACTERISTIC
/begin CHARACTERISTIC DSM_TypDfp_AirCtlGvnrDvtRgnMax_C "Konvertierung der Fehlertypen auf der Diagnoseschnittstelle fuer Fehlerpfad Dfp_AirCtlGvnrDvtRgnMax" VAL_BLK 0xCDA22 Kwb_Wu8 255.0 OneToOne 0.00 255.0 FORMAT "%5.1" NUMBER 4 /end CHARACTERISTIC
/begin CHARACTERISTIC DSM_TypDfp_Layer_QLT_C "Konvertierung der Fehlertypen auf der Diagnoseschnittstelle fuer Fehlerpfad Dfp_Layer_QLT" VAL_BLK 0xCDA26 Kwb_Wu8 255.0 OneToOne 0.00 255.0 FORMAT "%5.1" NUMBER 4 /end CHARACTERISTIC
/begin CHARACTERISTIC DSM_TypDfp_AirCtlGvnrDvtRgnMax2_C "" VAL_BLK 0xCDA2A Kwb_Wu8 255.0 OneToOne 0.00 255.0 FORMAT "%5.1" NUMBER 4 /end CHARACTERISTIC
/begin CHARACTERISTIC DSM_TypDfp_Layer_IBS1_C "Konvertierung der Fehlertypen auf der Diagnoseschnittstelle fuer Fehlerpfad Dfp_Layer_IBS1" VAL_BLK 0xCDA2E Kwb_Wu8 255.0 OneToOne 0.00 255.0 FORMAT "%5.1" NUMBER 4 /end CHARACTERISTIC
/begin CHARACTERISTIC DSM_TypDfp_Layer_IBS2_C "Konvertierung der Fehlertypen auf der Diagnoseschnittstelle fuer Fehlerpfad Dfp_Layer_IBS2" VAL_BLK 0xCDA32 Kwb_Wu8 255.0 OneToOne 0.00 255.0 FORMAT "%5.1" NUMBER 4 /end CHARACTERISTIC
/begin CHARACTERISTIC DSM_TypDfp_Layer_IBS3_C "Konvertierung der Fehlertypen auf der Diagnoseschnittstelle fuer Fehlerpfad Dfp_Layer_IBS3" VAL_BLK 0xCDA36 Kwb_Wu8 255.0 OneToOne 0.00 255.0 FORMAT "%5.1" NUMBER 4 /end CHARACTERISTIC
/begin CHARACTERISTIC DSM_TypDfp_Layer_PMBN_C "Konvertierung der Fehlertypen auf der Diagnoseschnittstelle fuer Fehlerpfad Dfp_Layer_PMBN" VAL_BLK 0xCDA3A Kwb_Wu8 255.0 OneToOne 0.00 255.0 FORMAT "%5.1" NUMBER 4 /end CHARACTERISTIC
/begin CHARACTERISTIC DSM_TypDfp_Layer_PMBATT_C "Konvertierung der Fehlertypen auf der Diagnoseschnittstelle fuer Fehlerpfad Dfp_Layer_PMBATT" VAL_BLK 0xCDA3E Kwb_Wu8 255.0 OneToOne 0.00 255.0 FORMAT "%5.1" NUMBER 4 /end CHARACTERISTIC
/begin CHARACTERISTIC DSM_TypDfp_AirCtlGvnrDvtRgnMin_C "Konvertierung der Fehlertypen auf der Diagnoseschnittstelle fuer Fehlerpfad Dfp_AirCtlGvnrDvtRgnMin" VAL_BLK 0xCDA42 Kwb_Wu8 255.0 OneToOne 0.00 255.0 FORMAT "%5.1" NUMBER 4 /end CHARACTERISTIC
/begin CHARACTERISTIC DSM_TypDfp_AirCtlGvnrDvtRgnMin2_C "" VAL_BLK 0xCDA46 Kwb_Wu8 255.0 OneToOne 0.00 255.0 FORMAT "%5.1" NUMBER 4 /end CHARACTERISTIC
/begin CHARACTERISTIC DSM_TypDfp_AirCtlPlateBreak_C "DSM variable for Dfp_AirCtlPlateBreak_mp" VAL_BLK 0xCDA4A Kwb_Wu8 255.0 OneToOne 0.00 255.0 FORMAT "%5.1" NUMBER 4 /end CHARACTERISTIC
/begin CHARACTERISTIC DSM_TypDfp_AirCtlRmpTO_C "Konvertierung der Fehlertypen auf der Diagnoseschnittstelle fuer Fehlerpfad Dfp_AirCtlRmpTO" VAL_BLK 0xCDA4E Kwb_Wu8 255.0 OneToOne 0.00 255.0 FORMAT "%5.1" NUMBER 4 /end CHARACTERISTIC
/begin CHARACTERISTIC DSM_TypDfp_AirCtl_GovNegDev_C "Konvertierung der Fehlertypen auf der Diagnoseschnittstelle fuer Fehlerpfad Dfp_AirCtl_GovNegDev" VAL_BLK 0xCDA52 Kwb_Wu8 255.0 OneToOne 0.00 255.0 FORMAT "%5.1" NUMBER 4 /end CHARACTERISTIC
/begin CHARACTERISTIC DSM_TypDfp_AirCtl_GovNegDev2_C "Konvertierung der Fehlertypen auf der Diagnoseschnittstelle fuer Fehlerpfad Dfp_AirCtl_GovNegDev2" VAL_BLK 0xCDA56 Kwb_Wu8 255.0 OneToOne 0.00 255.0 FORMAT "%5.1" NUMBER 4 /end CHARACTERISTIC
/begin CHARACTERISTIC DSM_TypDfp_AirCtl_GovPosDev_C "Konvertierung der Fehlertypen auf der Diagnoseschnittstelle fuer Fehlerpfad Dfp_AirCtl_GovPosDev" VAL_BLK 0xCDA5A Kwb_Wu8 255.0 OneToOne 0.00 255.0 FORMAT "%5.1" NUMBER 4 /end CHARACTERISTIC
/begin CHARACTERISTIC DSM_TypDfp_AirCtl_GovPosDev2_C "Konvertierung der Fehlertypen auf der Diagnoseschnittstelle fuer Fehlerpfad Dfp_AirCtl_GovPosDev2" VAL_BLK 0xCDA5E Kwb_Wu8 255.0 OneToOne 0.00 255.0 FORMAT "%5.1" NUMBER 4 /end CHARACTERISTIC
/begin CHARACTERISTIC DSM_TypDfp_AltCD_C "Konvertierung der Fehlertypen auf der Diagnoseschnittstelle fuer Fehlerpfad Dfp_AltCD" VAL_BLK 0xCDA62 Kwb_Wu8 255.0 OneToOne 0.00 255.0 FORMAT "%5.1" NUMBER 4 /end CHARACTERISTIC
/begin CHARACTERISTIC DSM_TypDfp_AltCD_Load_C "Konvertierung der Fehlertypen auf der Diagnoseschnittstelle fuer Fehlerpfad Dfp_AltCD_Load" VAL_BLK 0xCDA66 Kwb_Wu8 255.0 OneToOne 0.00 255.0 FORMAT "%5.1" NUMBER 4 /end CHARACTERISTIC
/begin CHARACTERISTIC DSM_TypDfp_BPACD_BPADia1_C "Konvertierung der Fehlertypen auf der Diagnoseschnittstelle fuer Fehlerpfad Dfp_BPACD_BPADia1" VAL_BLK 0xCDA6A Kwb_Wu8 255.0 OneToOne 0.00 255.0 FORMAT "%5.1" NUMBER 4 /end CHARACTERISTIC
/begin CHARACTERISTIC DSM_TypDfp_BPACD_BPADia2_C "Konvertierung der Fehlertypen auf der Diagnoseschnittstelle fuer Fehlerpfad Dfp_BPACD_BPADia2" VAL_BLK 0xCDA6E Kwb_Wu8 255.0 OneToOne 0.00 255.0 FORMAT "%5.1" NUMBER 4 /end CHARACTERISTIC
/begin CHARACTERISTIC DSM_TypDfp_BPACD_BPADia3_C "Konvertierung der Fehlertypen auf der Diagnoseschnittstelle fuer Fehlerpfad Dfp_BPACD_BPADia3" VAL_BLK 0xCDA72 Kwb_Wu8 255.0 OneToOne 0.00 255.0 FORMAT "%5.1" NUMBER 4 /end CHARACTERISTIC
/begin CHARACTERISTIC DSM_TypDfp_BPACD_Max_C "Konvertierung der Fehlertypen auf der Diagnoseschnittstelle fuer Fehlerpfad Dfp_BPACD_Max" VAL_BLK 0xCDA76 Kwb_Wu8 255.0 OneToOne 0.00 255.0 FORMAT "%5.1" NUMBER 4 /end CHARACTERISTIC
/begin CHARACTERISTIC DSM_TypDfp_BPACD_Min_C "Konvertierung der Fehlertypen auf der Diagnoseschnittstelle fuer Fehlerpfad Dfp_BPACD_Min" VAL_BLK 0xCDA7A Kwb_Wu8 255.0 OneToOne 0.00 255.0 FORMAT "%5.1" NUMBER 4 /end CHARACTERISTIC
/begin CHARACTERISTIC DSM_TypDfp_BPACD_SigNpl_C "Konvertierung der Fehlertypen auf der Diagnoseschnittstelle fuer Fehlerpfad Dfp_BPACD_SigNpl" VAL_BLK 0xCDA7E Kwb_Wu8 255.0 OneToOne 0.00 255.0 FORMAT "%5.1" NUMBER 4 /end CHARACTERISTIC
/begin CHARACTERISTIC DSM_TypDfp_BPSCD_C "Konvertierung der Fehlertypen auf der Diagnoseschnittstelle fuer Fehlerpfad Dfp_BPSCD" VAL_BLK 0xCDA82 Kwb_Wu8 255.0 OneToOne 0.00 255.0 FORMAT "%5.1" NUMBER 4 /end CHARACTERISTIC
/begin CHARACTERISTIC DSM_TypDfp_BattCD_C "Konvertierung der Fehlertypen auf der Diagnoseschnittstelle fuer Fehlerpfad Dfp_BattCD" VAL_BLK 0xCDA86 Kwb_Wu8 255.0 OneToOne 0.00 255.0 FORMAT "%5.1" NUMBER 4 /end CHARACTERISTIC
/begin CHARACTERISTIC DSM_TypDfp_BrkCD_C "Konvertierung der Fehlertypen auf der Diagnoseschnittstelle fuer Fehlerpfad Dfp_BrkCD" VAL_BLK 0xCDA8A Kwb_Wu8 255.0 OneToOne 0.00 255.0 FORMAT "%5.1" NUMBER 4 /end CHARACTERISTIC
/begin CHARACTERISTIC DSM_TypDfp_Bss_C "Konvertierung der Fehlertypen auf der Diagnoseschnittstelle fuer Fehlerpfad Dfp_Bss" VAL_BLK 0xCDA8E Kwb_Wu8 255.0 OneToOne 0.00 255.0 FORMAT "%5.1" NUMBER 4 /end CHARACTERISTIC
/begin CHARACTERISTIC DSM_TypDfp_CBACD_C "Konvertierung der Fehlertypen auf der Diagnoseschnittstelle fuer Fehlerpfad Dfp_CBACD" VAL_BLK 0xCDA92 Kwb_Wu8 255.0 OneToOne 0.00 255.0 FORMAT "%5.1" NUMBER 4 /end CHARACTERISTIC
/begin CHARACTERISTIC DSM_TypDfp_CTSCD_C "Konvertierung der Fehlertypen auf der Diagnoseschnittstelle fuer Fehlerpfad Dfp_CTSCD" VAL_BLK 0xCDA96 Kwb_Wu8 255.0 OneToOne 0.00 255.0 FORMAT "%5.1" NUMBER 4 /end CHARACTERISTIC
/begin CHARACTERISTIC DSM_TypDfp_Clg_DynTst_C "Konvertierung der Fehlertypen auf der Diagnoseschnittstelle fuer Fehlerpfad Dfp_Clg_DynTst" VAL_BLK 0xCDA9A Kwb_Wu8 255.0 OneToOne 0.00 255.0 FORMAT "%5.1" NUMBER 4 /end CHARACTERISTIC
/begin CHARACTERISTIC DSM_TypDfp_CmbChbMisfire1_C "Konvertierung der Fehlertypen auf der Diagnoseschnittstelle fuer Fehlerpfad Dfp_CmbChbMisfire1" VAL_BLK 0xCDA9E Kwb_Wu8 255.0 OneToOne 0.00 255.0 FORMAT "%5.1" NUMBER 4 /end CHARACTERISTIC
/begin CHARACTERISTIC DSM_TypDfp_CmbChbMisfire2_C "Konvertierung der Fehlertypen auf der Diagnoseschnittstelle fuer Fehlerpfad Dfp_CmbChbMisfire2" VAL_BLK 0xCDAA2 Kwb_Wu8 255.0 OneToOne 0.00 255.0 FORMAT "%5.1" NUMBER 4 /end CHARACTERISTIC
/begin CHARACTERISTIC DSM_TypDfp_CmbChbMisfire3_C "Konvertierung der Fehlertypen auf der Diagnoseschnittstelle fuer Fehlerpfad Dfp_CmbChbMisfire3" VAL_BLK 0xCDAA6 Kwb_Wu8 255.0 OneToOne 0.00 255.0 FORMAT "%5.1" NUMBER 4 /end CHARACTERISTIC
/begin CHARACTERISTIC DSM_TypDfp_CmbChbMisfire4_C "Konvertierung der Fehlertypen auf der Diagnoseschnittstelle fuer Fehlerpfad Dfp_CmbChbMisfire4" VAL_BLK 0xCDAAA Kwb_Wu8 255.0 OneToOne 0.00 255.0 FORMAT "%5.1" NUMBER 4 /end CHARACTERISTIC
/begin CHARACTERISTIC DSM_TypDfp_CmbChbMisfire5_C "Konvertierung der Fehlertypen auf der Diagnoseschnittstelle fuer Fehlerpfad Dfp_CmbChbMisfire5" VAL_BLK 0xCDAAE Kwb_Wu8 255.0 OneToOne 0.00 255.0 FORMAT "%5.1" NUMBER 4 /end CHARACTERISTIC
/begin CHARACTERISTIC DSM_TypDfp_CmbChbMisfire6_C "Konvertierung der Fehlertypen auf der Diagnoseschnittstelle fuer Fehlerpfad Dfp_CmbChbMisfire6" VAL_BLK 0xCDAB2 Kwb_Wu8 255.0 OneToOne 0.00 255.0 FORMAT "%5.1" NUMBER 4 /end CHARACTERISTIC
/begin CHARACTERISTIC DSM_TypDfp_CmbChbMisfireMul_C "Konvertierung der Fehlertypen auf der Diagnoseschnittstelle fuer Fehlerpfad Dfp_CmbChbMisfireMul" VAL_BLK 0xCDAB6 Kwb_Wu8 255.0 OneToOne 0.00 255.0 FORMAT "%5.1" NUMBER 4 /end CHARACTERISTIC
/begin CHARACTERISTIC DSM_TypDfp_CoVMDCSh_C "Konvertierung der Fehlertypen auf der Diagnoseschnittstelle fuer Fehlerpfad Dfp_CoVMDCSh" VAL_BLK 0xCDABA Kwb_Wu8 255.0 OneToOne 0.00 255.0 FORMAT "%5.1" NUMBER 4 /end CHARACTERISTIC
/begin CHARACTERISTIC DSM_TypDfp_ConvCD_C "Konvertierung der Fehlertypen auf der Diagnoseschnittstelle fuer Fehlerpfad Dfp_ConvCD" VAL_BLK 0xCDABE Kwb_Wu8 255.0 OneToOne 0.00 255.0 FORMAT "%5.1" NUMBER 4 /end CHARACTERISTIC
/begin CHARACTERISTIC DSM_TypDfp_Layer_PMRUHVERL_C "Konvertierung der Fehlertypen auf der Diagnoseschnittstelle fuer Fehlerpfad Dfp_Layer_PMRUHVERL" VAL_BLK 0xCDAC2 Kwb_Wu8 255.0 OneToOne 0.00 255.0 FORMAT "%5.1" NUMBER 4 /end CHARACTERISTIC
/begin CHARACTERISTIC DSM_TypDfp_CrCCDMFL_C "Konvertierung der Fehlertypen auf der Diagnoseschnittstelle fuer Fehlerpfad Dfp_CrCCDMFL" VAL_BLK 0xCDAC6 Kwb_Wu8 255.0 OneToOne 0.00 255.0 FORMAT "%5.1" NUMBER 4 /end CHARACTERISTIC
/begin CHARACTERISTIC DSM_TypDfp_CrCtl_vCrCtl_C "Konvertierung der Fehlertypen auf der Diagnoseschnittstelle fuer Fehlerpfad Dfp_CrCtl_vCrCtl" VAL_BLK 0xCDACA Kwb_Wu8 255.0 OneToOne 0.00 255.0 FORMAT "%5.1" NUMBER 4 /end CHARACTERISTIC
/begin CHARACTERISTIC DSM_TypDfp_DCC_PlausTrqDes_C "Konvertierung der Fehlertypen auf der Diagnoseschnittstelle fuer Fehlerpfad Dfp_DCC_PlausTrqDes" VAL_BLK 0xCDACE Kwb_Wu8 255.0 OneToOne 0.00 255.0 FORMAT "%5.1" NUMBER 4 /end CHARACTERISTIC
/begin CHARACTERISTIC DSM_TypDfp_Dummy1_C "Konvertierung der Fehlertypen auf der Diagnoseschnittstelle fuer Fehlerpfad Dfp_Dummy1" VAL_BLK 0xCDAD2 Kwb_Wu8 255.0 OneToOne 0.00 255.0 FORMAT "%5.1" NUMBER 4 /end CHARACTERISTIC
/begin CHARACTERISTIC DSM_TypDfp_Layer_TOENS_C "Konvertierung der Fehlertypen auf der Diagnoseschnittstelle fuer Fehlerpfad Dfp_Layer_TOENS" VAL_BLK 0xCDAD6 Kwb_Wu8 255.0 OneToOne 0.00 255.0 FORMAT "%5.1" NUMBER 4 /end CHARACTERISTIC
/begin CHARACTERISTIC DSM_TypDfp_Layer_MANHYDR_C "Konvertierung der Fehlertypen auf der Diagnoseschnittstelle fuer Fehlerpfad Dfp_Layer_MANHYDR" VAL_BLK 0xCDADA Kwb_Wu8 255.0 OneToOne 0.00 255.0 FORMAT "%5.1" NUMBER 4 /end CHARACTERISTIC
/begin CHARACTERISTIC DSM_TypDfp_Layer_MANLUFT_C "Konvertierung der Fehlertypen auf der Diagnoseschnittstelle fuer Fehlerpfad Dfp_Layer_MANLUFT" VAL_BLK 0xCDADE Kwb_Wu8 255.0 OneToOne 0.00 255.0 FORMAT "%5.1" NUMBER 4 /end CHARACTERISTIC
/begin CHARACTERISTIC DSM_TypDfp_EATSCD_C "Konvertierung der Fehlertypen auf der Diagnoseschnittstelle fuer Fehlerpfad Dfp_EATSCD" VAL_BLK 0xCDAE2 Kwb_Wu8 255.0 OneToOne 0.00 255.0 FORMAT "%5.1" NUMBER 4 /end CHARACTERISTIC
/begin CHARACTERISTIC DSM_TypDfp_EBAFCD_C "Konvertierung der Fehlertypen auf der Diagnoseschnittstelle fuer Fehlerpfad Dfp_EBAFCD" VAL_BLK 0xCDAE6 Kwb_Wu8 255.0 OneToOne 0.00 255.0 FORMAT "%5.1" NUMBER 4 /end CHARACTERISTIC
/begin CHARACTERISTIC DSM_TypDfp_EBFCD_C "Konvertierung der Fehlertypen auf der Diagnoseschnittstelle fuer Fehlerpfad Dfp_EBFCD" VAL_BLK 0xCDAEA Kwb_Wu8 255.0 OneToOne 0.00 255.0 FORMAT "%5.1" NUMBER 4 /end CHARACTERISTIC
/begin CHARACTERISTIC DSM_TypDfp_EBTSCD_C "Konvertierung der Fehlertypen auf der Diagnoseschnittstelle fuer Fehlerpfad Dfp_EBTSCD" VAL_BLK 0xCDAEE Kwb_Wu8 255.0 OneToOne 0.00 255.0 FORMAT "%5.1" NUMBER 4 /end CHARACTERISTIC
/begin CHARACTERISTIC DSM_TypDfp_EBTSCD_OvrTemp_C "Konvertierung der Fehlertypen auf der Diagnoseschnittstelle fuer Fehlerpfad Dfp_EBTSCD_OvrTemp" VAL_BLK 0xCDAF2 Kwb_Wu8 255.0 OneToOne 0.00 255.0 FORMAT "%5.1" NUMBER 4 /end CHARACTERISTIC
/begin CHARACTERISTIC DSM_TypDfp_EEPCDVarMng_C "Konvertierung der Fehlertypen auf der Diagnoseschnittstelle fuer Fehlerpfad Dfp_EEPCDVarMng" VAL_BLK 0xCDAF6 Kwb_Wu8 255.0 OneToOne 0.00 255.0 FORMAT "%5.1" NUMBER 4 /end CHARACTERISTIC
/begin CHARACTERISTIC DSM_TypDfp_EGPpCD_C "Konvertierung der Fehlertypen auf der Diagnoseschnittstelle fuer Fehlerpfad Dfp_EGPpCD" VAL_BLK 0xCDAFA Kwb_Wu8 255.0 OneToOne 0.00 255.0 FORMAT "%5.1" NUMBER 4 /end CHARACTERISTIC
/begin CHARACTERISTIC DSM_TypDfp_EGPpCDTPreTrbn_C "Konvertierung der Fehlertypen auf der Diagnoseschnittstelle fuer Fehlerpfad Dfp_EgPpCDTPreTrbn" VAL_BLK 0xCDAFE Kwb_Wu8 255.0 OneToOne 0.00 255.0 FORMAT "%5.1" NUMBER 4 /end CHARACTERISTIC
/begin CHARACTERISTIC DSM_TypDfp_EGRCD_Max_C "Konvertierung der Fehlertypen auf der Diagnoseschnittstelle fuer Fehlerpfad Dfp_EGRCD_Max" VAL_BLK 0xCDB02 Kwb_Wu8 255.0 OneToOne 0.00 255.0 FORMAT "%5.1" NUMBER 4 /end CHARACTERISTIC
/begin CHARACTERISTIC DSM_TypDfp_EGRCD_Min_C "Konvertierung der Fehlertypen auf der Diagnoseschnittstelle fuer Fehlerpfad Dfp_EGRCD_Min" VAL_BLK 0xCDB06 Kwb_Wu8 255.0 OneToOne 0.00 255.0 FORMAT "%5.1" NUMBER 4 /end CHARACTERISTIC
/begin CHARACTERISTIC DSM_TypDfp_EGRCD_SigNpl_C "Konvertierung der Fehlertypen auf der Diagnoseschnittstelle fuer Fehlerpfad Dfp_EGRCD_SigNpl" VAL_BLK 0xCDB0A Kwb_Wu8 255.0 OneToOne 0.00 255.0 FORMAT "%5.1" NUMBER 4 /end CHARACTERISTIC
/begin CHARACTERISTIC DSM_TypDfp_EGTRgnOilDil_C "Konvertierung der Fehlertypen auf der Diagnoseschnittstelle fuer Fehlerpfad Dfp_EGTRgnOilDil" VAL_BLK 0xCDB0E Kwb_Wu8 255.0 OneToOne 0.00 255.0 FORMAT "%5.1" NUMBER 4 /end CHARACTERISTIC
/begin CHARACTERISTIC DSM_TypDfp_EMCCDNoLoad1_C "Konvertierung der Fehlertypen auf der Diagnoseschnittstelle fuer Fehlerpfad Dfp_EMCCDNoLoad1" VAL_BLK 0xCDB12 Kwb_Wu8 255.0 OneToOne 0.00 255.0 FORMAT "%5.1" NUMBER 4 /end CHARACTERISTIC
/begin CHARACTERISTIC DSM_TypDfp_EMCCDNoLoad2_C "Konvertierung der Fehlertypen auf der Diagnoseschnittstelle fuer Fehlerpfad Dfp_EMCCDNoLoad2" VAL_BLK 0xCDB16 Kwb_Wu8 255.0 OneToOne 0.00 255.0 FORMAT "%5.1" NUMBER 4 /end CHARACTERISTIC
/begin CHARACTERISTIC DSM_TypDfp_EMCCDSCBat1_C "Konvertierung der Fehlertypen auf der Diagnoseschnittstelle fuer Fehlerpfad Dfp_EMCCDSCBat1" VAL_BLK 0xCDB1A Kwb_Wu8 255.0 OneToOne 0.00 255.0 FORMAT "%5.1" NUMBER 4 /end CHARACTERISTIC
/begin CHARACTERISTIC DSM_TypDfp_EMCCDSCBat2_C "Konvertierung der Fehlertypen auf der Diagnoseschnittstelle fuer Fehlerpfad Dfp_EMCCDSCBat2" VAL_BLK 0xCDB1E Kwb_Wu8 255.0 OneToOne 0.00 255.0 FORMAT "%5.1" NUMBER 4 /end CHARACTERISTIC
/begin CHARACTERISTIC DSM_TypDfp_EMCCDSCGnd1_C "Konvertierung der Fehlertypen auf der Diagnoseschnittstelle fuer Fehlerpfad Dfp_EMCCDSCGnd1" VAL_BLK 0xCDB22 Kwb_Wu8 255.0 OneToOne 0.00 255.0 FORMAT "%5.1" NUMBER 4 /end CHARACTERISTIC
/begin CHARACTERISTIC DSM_TypDfp_EMCCDSCGnd2_C "Konvertierung der Fehlertypen auf der Diagnoseschnittstelle fuer Fehlerpfad Dfp_EMCCDSCGnd2" VAL_BLK 0xCDB26 Kwb_Wu8 255.0 OneToOne 0.00 255.0 FORMAT "%5.1" NUMBER 4 /end CHARACTERISTIC
/begin CHARACTERISTIC DSM_TypDfp_EMCCD_ADC1_C "Konvertierung der Fehlertypen auf der Diagnoseschnittstelle fuer Fehlerpfad Dfp_EMCCD_ADC1" VAL_BLK 0xCDB2A Kwb_Wu8 255.0 OneToOne 0.00 255.0 FORMAT "%5.1" NUMBER 4 /end CHARACTERISTIC
/begin CHARACTERISTIC DSM_TypDfp_EMCCD_ADC2_C "Konvertierung der Fehlertypen auf der Diagnoseschnittstelle fuer Fehlerpfad Dfp_EMCCD_ADC2" VAL_BLK 0xCDB2E Kwb_Wu8 255.0 OneToOne 0.00 255.0 FORMAT "%5.1" NUMBER 4 /end CHARACTERISTIC
/begin CHARACTERISTIC DSM_TypDfp_ETClbETFltInj1_C "Konvertierung der Fehlertypen auf der Diagnoseschnittstelle fuer Fehlerpfad Dfp_ETClbETFltInj1" VAL_BLK 0xCDB32 Kwb_Wu8 255.0 OneToOne 0.00 255.0 FORMAT "%5.1" NUMBER 4 /end CHARACTERISTIC
/begin CHARACTERISTIC DSM_TypDfp_ETClbETFltInj2_C "Konvertierung der Fehlertypen auf der Diagnoseschnittstelle fuer Fehlerpfad Dfp_ETClbETFltInj2" VAL_BLK 0xCDB36 Kwb_Wu8 255.0 OneToOne 0.00 255.0 FORMAT "%5.1" NUMBER 4 /end CHARACTERISTIC
/begin CHARACTERISTIC DSM_TypDfp_ETClbETFltInj3_C "Konvertierung der Fehlertypen auf der Diagnoseschnittstelle fuer Fehlerpfad Dfp_ETClbETFltInj3" VAL_BLK 0xCDB3A Kwb_Wu8 255.0 OneToOne 0.00 255.0 FORMAT "%5.1" NUMBER 4 /end CHARACTERISTIC
/begin CHARACTERISTIC DSM_TypDfp_ETClbETFltInj4_C "Konvertierung der Fehlertypen auf der Diagnoseschnittstelle fuer Fehlerpfad Dfp_ETClbETFltInj4" VAL_BLK 0xCDB3E Kwb_Wu8 255.0 OneToOne 0.00 255.0 FORMAT "%5.1" NUMBER 4 /end CHARACTERISTIC
/begin CHARACTERISTIC DSM_TypDfp_ETClbETFltInj5_C "Konvertierung der Fehlertypen auf der Diagnoseschnittstelle fuer Fehlerpfad Dfp_ETClbETFltInj5" VAL_BLK 0xCDB42 Kwb_Wu8 255.0 OneToOne 0.00 255.0 FORMAT "%5.1" NUMBER 4 /end CHARACTERISTIC
/begin CHARACTERISTIC DSM_TypDfp_ETClbETFltInj6_C "Konvertierung der Fehlertypen auf der Diagnoseschnittstelle fuer Fehlerpfad Dfp_ETClbETFltInj6" VAL_BLK 0xCDB46 Kwb_Wu8 255.0 OneToOne 0.00 255.0 FORMAT "%5.1" NUMBER 4 /end CHARACTERISTIC
/begin CHARACTERISTIC DSM_TypDfp_ETClbInj1_C "Konvertierung der Fehlertypen auf der Diagnoseschnittstelle fuer Fehlerpfad Dfp_ETClbInj1" VAL_BLK 0xCDB4A Kwb_Wu8 255.0 OneToOne 0.00 255.0 FORMAT "%5.1" NUMBER 4 /end CHARACTERISTIC
/begin CHARACTERISTIC DSM_TypDfp_ETClbInj2_C "Konvertierung der Fehlertypen auf der Diagnoseschnittstelle fuer Fehlerpfad Dfp_ETClbInj2" VAL_BLK 0xCDB4E Kwb_Wu8 255.0 OneToOne 0.00 255.0 FORMAT "%5.1" NUMBER 4 /end CHARACTERISTIC
/begin CHARACTERISTIC DSM_TypDfp_ETClbInj3_C "Konvertierung der Fehlertypen auf der Diagnoseschnittstelle fuer Fehlerpfad Dfp_ETClbInj3" VAL_BLK 0xCDB52 Kwb_Wu8 255.0 OneToOne 0.00 255.0 FORMAT "%5.1" NUMBER 4 /end CHARACTERISTIC
/begin CHARACTERISTIC DSM_TypDfp_ETClbInj4_C "Konvertierung der Fehlertypen auf der Diagnoseschnittstelle fuer Fehlerpfad Dfp_ETClbInj4" VAL_BLK 0xCDB56 Kwb_Wu8 255.0 OneToOne 0.00 255.0 FORMAT "%5.1" NUMBER 4 /end CHARACTERISTIC
/begin CHARACTERISTIC DSM_TypDfp_ETClbInj5_C "Konvertierung der Fehlertypen auf der Diagnoseschnittstelle fuer Fehlerpfad Dfp_ETClbInj5" VAL_BLK 0xCDB5A Kwb_Wu8 255.0 OneToOne 0.00 255.0 FORMAT "%5.1" NUMBER 4 /end CHARACTERISTIC
/begin CHARACTERISTIC DSM_TypDfp_ETClbInj6_C "Konvertierung der Fehlertypen auf der Diagnoseschnittstelle fuer Fehlerpfad Dfp_ETClbInj6" VAL_BLK 0xCDB5E Kwb_Wu8 255.0 OneToOne 0.00 255.0 FORMAT "%5.1" NUMBER 4 /end CHARACTERISTIC
/begin CHARACTERISTIC DSM_TypDfp_EngMCaS1_C "Konvertierung der Fehlertypen auf der Diagnoseschnittstelle fuer Fehlerpfad Dfp_EngMCaS1" VAL_BLK 0xCDB62 Kwb_Wu8 255.0 OneToOne 0.00 255.0 FORMAT "%5.1" NUMBER 4 /end CHARACTERISTIC
/begin CHARACTERISTIC DSM_TypDfp_EngMCrS1_C "Konvertierung der Fehlertypen auf der Diagnoseschnittstelle fuer Fehlerpfad Dfp_EngMCrS1" VAL_BLK 0xCDB66 Kwb_Wu8 255.0 OneToOne 0.00 255.0 FORMAT "%5.1" NUMBER 4 /end CHARACTERISTIC
/begin CHARACTERISTIC DSM_TypDfp_EngMOfsCaSCrS_C "Konvertierung der Fehlertypen auf der Diagnoseschnittstelle fuer Fehlerpfad Dfp_EngMOfsCaSCrS" VAL_BLK 0xCDB6A Kwb_Wu8 255.0 OneToOne 0.00 255.0 FORMAT "%5.1" NUMBER 4 /end CHARACTERISTIC
/begin CHARACTERISTIC DSM_TypDfp_EngPrtFWODet_C "Konvertierung der Fehlertypen auf der Diagnoseschnittstelle fuer Fehlerpfad Dfp_EngPrtFWODet" VAL_BLK 0xCDB6E Kwb_Wu8 255.0 OneToOne 0.00 255.0 FORMAT "%5.1" NUMBER 4 /end CHARACTERISTIC
/begin CHARACTERISTIC DSM_TypDfp_FBCqDvt_C "Konvertierung der Fehlertypen auf der Diagnoseschnittstelle fuer Fehlerpfad Dfp_FBCqDvt" VAL_BLK 0xCDB72 Kwb_Wu8 255.0 OneToOne 0.00 255.0 FORMAT "%5.1" NUMBER 4 /end CHARACTERISTIC
/begin CHARACTERISTIC DSM_TypDfp_FMTC_NonMonotonMap_C "Konvertierung der Fehlertypen auf der Diagnoseschnittstelle fuer Fehlerpfad Dfp_FMTC_NonMonotonMap" VAL_BLK 0xCDB76 Kwb_Wu8 255.0 OneToOne 0.00 255.0 FORMAT "%5.1" NUMBER 4 /end CHARACTERISTIC
/begin CHARACTERISTIC DSM_TypDfp_FTSCD_C "Konvertierung der Fehlertypen auf der Diagnoseschnittstelle fuer Fehlerpfad Dfp_FTSCD" VAL_BLK 0xCDB7A Kwb_Wu8 255.0 OneToOne 0.00 255.0 FORMAT "%5.1" NUMBER 4 /end CHARACTERISTIC
/begin CHARACTERISTIC DSM_TypDfp_FanCD_C "Konvertierung der Fehlertypen auf der Diagnoseschnittstelle fuer Fehlerpfad Dfp_FanCD" VAL_BLK 0xCDB7E Kwb_Wu8 255.0 OneToOne 0.00 255.0 FORMAT "%5.1" NUMBER 4 /end CHARACTERISTIC
/begin CHARACTERISTIC DSM_TypDfp_FanCD_FanCtlr1_C "Konvertierung der Fehlertypen auf der Diagnoseschnittstelle fuer Fehlerpfad Dfp_FanCD_FanCtlr1" VAL_BLK 0xCDB82 Kwb_Wu8 255.0 OneToOne 0.00 255.0 FORMAT "%5.1" NUMBER 4 /end CHARACTERISTIC
/begin CHARACTERISTIC DSM_TypDfp_FanCD_FanCtlr2_C "Konvertierung der Fehlertypen auf der Diagnoseschnittstelle fuer Fehlerpfad Dfp_FanCD_FanCtlr2" VAL_BLK 0xCDB86 Kwb_Wu8 255.0 OneToOne 0.00 255.0 FORMAT "%5.1" NUMBER 4 /end CHARACTERISTIC
/begin CHARACTERISTIC DSM_TypDfp_FanCD_FanCtlr3_C "Konvertierung der Fehlertypen auf der Diagnoseschnittstelle fuer Fehlerpfad Dfp_FanCD_FanCtlr3" VAL_BLK 0xCDB8A Kwb_Wu8 255.0 OneToOne 0.00 255.0 FORMAT "%5.1" NUMBER 4 /end CHARACTERISTIC
/begin CHARACTERISTIC DSM_TypDfp_FlFCD_C "Konvertierung der Fehlertypen auf der Diagnoseschnittstelle fuer Fehlerpfad Dfp_FlFCD" VAL_BLK 0xCDB8E Kwb_Wu8 255.0 OneToOne 0.00 255.0 FORMAT "%5.1" NUMBER 4 /end CHARACTERISTIC
/begin CHARACTERISTIC DSM_TypDfp_FlMngSmkDefect_C "Konvertierung der Fehlertypen auf der Diagnoseschnittstelle fuer Fehlerpfad Dfp_FlMngSmkDefect" VAL_BLK 0xCDB92 Kwb_Wu8 255.0 OneToOne 0.00 255.0 FORMAT "%5.1" NUMBER 4 /end CHARACTERISTIC
/begin CHARACTERISTIC DSM_TypDfp_FrmMngANFRADMOMPT_C "Konvertierung der Fehlertypen auf der Diagnoseschnittstelle fuer Fehlerpfad Dfp_FrmMngANFRADMOMPT" VAL_BLK 0xCDB96 Kwb_Wu8 255.0 OneToOne 0.00 255.0 FORMAT "%5.1" NUMBER 4 /end CHARACTERISTIC
/begin CHARACTERISTIC DSM_TypDfp_FrmMngASC1_C "Konvertierung der Fehlertypen auf der Diagnoseschnittstelle fuer Fehlerpfad Dfp_FrmMngASC1" VAL_BLK 0xCDB9A Kwb_Wu8 255.0 OneToOne 0.00 255.0 FORMAT "%5.1" NUMBER 4 /end CHARACTERISTIC
/begin CHARACTERISTIC DSM_TypDfp_FrmMngASC2_C "Konvertierung der Fehlertypen auf der Diagnoseschnittstelle fuer Fehlerpfad Dfp_FrmMngASC2" VAL_BLK 0xCDB9E Kwb_Wu8 255.0 OneToOne 0.00 255.0 FORMAT "%5.1" NUMBER 4 /end CHARACTERISTIC
/begin CHARACTERISTIC DSM_TypDfp_FrmMngASC3_C "Konvertierung der Fehlertypen auf der Diagnoseschnittstelle fuer Fehlerpfad Dfp_FrmMngASC3" VAL_BLK 0xCDBA2 Kwb_Wu8 255.0 OneToOne 0.00 255.0 FORMAT "%5.1" NUMBER 4 /end CHARACTERISTIC
/begin CHARACTERISTIC DSM_TypDfp_FrmMngASC4_C "Konvertierung der Fehlertypen auf der Diagnoseschnittstelle fuer Fehlerpfad Dfp_FrmMngASC4" VAL_BLK 0xCDBA6 Kwb_Wu8 255.0 OneToOne 0.00 255.0 FORMAT "%5.1" NUMBER 4 /end CHARACTERISTIC
/begin CHARACTERISTIC DSM_TypDfp_FrmMngBOS_RESET_C "Konvertierung der Fehlertypen auf der Diagnoseschnittstelle fuer Fehlerpfad Dfp_FrmMngBOS_RESET" VAL_BLK 0xCDBAA Kwb_Wu8 255.0 OneToOne 0.00 255.0 FORMAT "%5.1" NUMBER 4 /end CHARACTERISTIC
/begin CHARACTERISTIC DSM_TypDfp_FrmMngBOS_RESET_2_C "" VAL_BLK 0xCDBAE Kwb_Wu8 255.0 OneToOne 0.00 255.0 FORMAT "%5.1" NUMBER 4 /end CHARACTERISTIC
/begin CHARACTERISTIC DSM_TypDfp_FrmMngDMANFAFS_C "Konvertierung der Fehlertypen auf der Diagnoseschnittstelle fuer Fehlerpfad Dfp_FrmMngDMANFAFS" VAL_BLK 0xCDBB2 Kwb_Wu8 255.0 OneToOne 0.00 255.0 FORMAT "%5.1" NUMBER 4 /end CHARACTERISTIC
/begin CHARACTERISTIC DSM_TypDfp_FrmMngDRMANFSSG_C "Konvertierung der Fehlertypen auf der Diagnoseschnittstelle fuer Fehlerpfad Dfp_FrmMngDRMANFSSG" VAL_BLK 0xCDBB6 Kwb_Wu8 255.0 OneToOne 0.00 255.0 FORMAT "%5.1" NUMBER 4 /end CHARACTERISTIC
/begin CHARACTERISTIC DSM_TypDfp_FrmMngEGS1_C "Konvertierung der Fehlertypen auf der Diagnoseschnittstelle fuer Fehlerpfad Dfp_FrmMngEGS1" VAL_BLK 0xCDBBA Kwb_Wu8 255.0 OneToOne 0.00 255.0 FORMAT "%5.1" NUMBER 4 /end CHARACTERISTIC
/begin CHARACTERISTIC DSM_TypDfp_FrmMngEGS2_C "Konvertierung der Fehlertypen auf der Diagnoseschnittstelle fuer Fehlerpfad Dfp_FrmMngEGS2" VAL_BLK 0xCDBBE Kwb_Wu8 255.0 OneToOne 0.00 255.0 FORMAT "%5.1" NUMBER 4 /end CHARACTERISTIC
/begin CHARACTERISTIC DSM_TypDfp_FrmMngGEARBX_DATA_C "type for faults in path" VAL_BLK 0xCDBC2 Kwb_Wu8 255.0 OneToOne 0.00 255.0 FORMAT "%5.1" NUMBER 4 /end CHARACTERISTIC
/begin CHARACTERISTIC DSM_TypDfp_FrmMngGEARBX_DATA2_C "Konvertierung der Fehlertypen auf der Diagnoseschnittstelle fuer Fehlerpfad Dfp_FrmMngGEARBX_DATA2" VAL_BLK 0xCDBC6 Kwb_Wu8 255.0 OneToOne 0.00 255.0 FORMAT "%5.1" NUMBER 4 /end CHARACTERISTIC
/begin CHARACTERISTIC DSM_TypDfp_FrmMngHEAT_AC_C "type for faults in path" VAL_BLK 0xCDBCA Kwb_Wu8 255.0 OneToOne 0.00 255.0 FORMAT "%5.1" NUMBER 4 /end CHARACTERISTIC
/begin CHARACTERISTIC DSM_TypDfp_FrmMngINSTR2_C "Konvertierung der Fehlertypen auf der Diagnoseschnittstelle fuer Fehlerpfad Dfp_FrmMngINSTR2" VAL_BLK 0xCDBCE Kwb_Wu8 255.0 OneToOne 0.00 255.0 FORMAT "%5.1" NUMBER 4 /end CHARACTERISTIC
/begin CHARACTERISTIC DSM_TypDfp_FrmMngINSTR3_C "Konvertierung der Fehlertypen auf der Diagnoseschnittstelle fuer Fehlerpfad Dfp_FrmMngINSTR3" VAL_BLK 0xCDBD2 Kwb_Wu8 255.0 OneToOne 0.00 255.0 FORMAT "%5.1" NUMBER 4 /end CHARACTERISTIC
/begin CHARACTERISTIC DSM_TypDfp_FrmMngLENKRADWINKEL_C "Konvertierung der Fehlertypen auf der Diagnoseschnittstelle fuer Fehlerpfad Dfp_FrmMngLENKRADWINKEL" VAL_BLK 0xCDBD6 Kwb_Wu8 255.0 OneToOne 0.00 255.0 FORMAT "%5.1" NUMBER 4 /end CHARACTERISTIC
/begin CHARACTERISTIC DSM_TypDfp_FrmMngMILEAGE_RANGE_C "Konvertierung der Fehlertypen auf der Diagnoseschnittstelle fuer Fehlerpfad Dfp_FrmMngMILEAGE_RANGE" VAL_BLK 0xCDBDA Kwb_Wu8 255.0 OneToOne 0.00 255.0 FORMAT "%5.1" NUMBER 4 /end CHARACTERISTIC
/begin CHARACTERISTIC DSM_TypDfp_FrmMngOPCRCTLACC_C "Konvertierung der Fehlertypen auf der Diagnoseschnittstelle fuer Fehlerpfad Dfp_FrmMngOPCRCTLACC" VAL_BLK 0xCDBDE Kwb_Wu8 255.0 OneToOne 0.00 255.0 FORMAT "%5.1" NUMBER 4 /end CHARACTERISTIC
/begin CHARACTERISTIC DSM_TypDfp_FrmMngPRGG_CCTR_C "Konvertierung der Fehlertypen auf der Diagnoseschnittstelle fuer Fehlerpfad Dfp_FrmMngPRGG_CCTR" VAL_BLK 0xCDBE2 Kwb_Wu8 255.0 OneToOne 0.00 255.0 FORMAT "%5.1" NUMBER 4 /end CHARACTERISTIC
/begin CHARACTERISTIC DSM_TypDfp_FrmMngPWRMNG_LOADV_C "Konvertierung der Fehlertypen auf der Diagnoseschnittstelle fuer Fehlerpfad Dfp_FrmMngPWRMNG_LOADV" VAL_BLK 0xCDBE6 Kwb_Wu8 255.0 OneToOne 0.00 255.0 FORMAT "%5.1" NUMBER 4 /end CHARACTERISTIC
/begin CHARACTERISTIC DSM_TypDfp_FrmMngParkConsumer_C "Konvertierung der Fehlertypen auf der Diagnoseschnittstelle fuer Fehlerpfad Dfp_FrmMngParkConsumer" VAL_BLK 0xCDBEA Kwb_Wu8 255.0 OneToOne 0.00 255.0 FORMAT "%5.1" NUMBER 4 /end CHARACTERISTIC
/begin CHARACTERISTIC DSM_TypDfp_FrmMngRQSTGEFAN_C "RQ_STG_EFAN - CAN-message related errors" VAL_BLK 0xCDBEE Kwb_Wu8 255.0 OneToOne 0.00 255.0 FORMAT "%5.1" NUMBER 4 /end CHARACTERISTIC
/begin CHARACTERISTIC DSM_TypDfp_FrmMngSSGErr_C "Konvertierung der Fehlertypen auf der Diagnoseschnittstelle fuer Fehlerpfad Dfp_FrmMngSSGErr" VAL_BLK 0xCDBF2 Kwb_Wu8 255.0 OneToOne 0.00 255.0 FORMAT "%5.1" NUMBER 4 /end CHARACTERISTIC
/begin CHARACTERISTIC DSM_TypDfp_FrmMngSSGShOff_C "Konvertierung der Fehlertypen auf der Diagnoseschnittstelle fuer Fehlerpfad Dfp_FrmMngSSGShOff" VAL_BLK 0xCDBF6 Kwb_Wu8 255.0 OneToOne 0.00 255.0 FORMAT "%5.1" NUMBER 4 /end CHARACTERISTIC
/begin CHARACTERISTIC DSM_TypDfp_FrmMngSTAT_ANH_C "Konvertierung der Fehlertypen auf der Diagnoseschnittstelle fuer Fehlerpfad Dfp_FrmMngSTAT_ANH" VAL_BLK 0xCDBFA Kwb_Wu8 255.0 OneToOne 0.00 255.0 FORMAT "%5.1" NUMBER 4 /end CHARACTERISTIC
/begin CHARACTERISTIC DSM_TypDfp_FrmMngSTAT_ARS_C "type for faults in path" VAL_BLK 0xCDBFE Kwb_Wu8 255.0 OneToOne 0.00 255.0 FORMAT "%5.1" NUMBER 4 /end CHARACTERISTIC
/begin CHARACTERISTIC DSM_TypDfp_FrmMngSTAT_DSC_C "type for faults in path" VAL_BLK 0xCDC02 Kwb_Wu8 255.0 OneToOne 0.00 255.0 FORMAT "%5.1" NUMBER 4 /end CHARACTERISTIC
/begin CHARACTERISTIC DSM_TypDfp_FrmMngSTAT_EKP_C "Konvertierung der Fehlertypen auf der Diagnoseschnittstelle fuer Fehlerpfad Dfp_FrmMngSTAT_EKP" VAL_BLK 0xCDC06 Kwb_Wu8 255.0 OneToOne 0.00 255.0 FORMAT "%5.1" NUMBER 4 /end CHARACTERISTIC
/begin CHARACTERISTIC DSM_TypDfp_FrmMngSTAT_KOMBI_C "Konvertierung der Fehlertypen auf der Diagnoseschnittstelle fuer Fehlerpfad Dfp_FrmMngSTAT_KOMBI" VAL_BLK 0xCDC0A Kwb_Wu8 255.0 OneToOne 0.00 255.0 FORMAT "%5.1" NUMBER 4 /end CHARACTERISTIC
/begin CHARACTERISTIC DSM_TypDfp_FrmMngSTAT_SITZ_C "Konvertierung der Fehlertypen auf der Diagnoseschnittstelle fuer Fehlerpfad Dfp_FrmMngSTAT_SITZ" VAL_BLK 0xCDC0E Kwb_Wu8 255.0 OneToOne 0.00 255.0 FORMAT "%5.1" NUMBER 4 /end CHARACTERISTIC
/begin CHARACTERISTIC DSM_TypDfp_FrmMngStOBDGbxMilOf_C "Konvertierung der Fehlertypen auf der Diagnoseschnittstelle fuer Fehlerpfad Dfp_FrmMngStOBDGbxMilOf" VAL_BLK 0xCDC12 Kwb_Wu8 255.0 OneToOne 0.00 255.0 FORMAT "%5.1" NUMBER 4 /end CHARACTERISTIC
/begin CHARACTERISTIC DSM_TypDfp_FrmMngStOBDGbxMilOn_C "Konvertierung der Fehlertypen auf der Diagnoseschnittstelle fuer Fehlerpfad Dfp_FrmMngStOBDGbxMilOn" VAL_BLK 0xCDC16 Kwb_Wu8 255.0 OneToOne 0.00 255.0 FORMAT "%5.1" NUMBER 4 /end CHARACTERISTIC
/begin CHARACTERISTIC DSM_TypDfp_FrmMngTEMPRELTIME_C "Konvertierung der Fehlertypen auf der Diagnoseschnittstelle fuer Fehlerpfad Dfp_FrmMngTEMPRELTIME" VAL_BLK 0xCDC1A Kwb_Wu8 255.0 OneToOne 0.00 255.0 FORMAT "%5.1" NUMBER 4 /end CHARACTERISTIC
/begin CHARACTERISTIC DSM_TypDfp_FrmMngTERMINAL_C "type for faults in path" VAL_BLK 0xCDC1E Kwb_Wu8 255.0 OneToOne 0.00 255.0 FORMAT "%5.1" NUMBER 4 /end CHARACTERISTIC
/begin CHARACTERISTIC DSM_TypDfp_FrmMngTIME_DATE_C "Konvertierung der Fehlertypen auf der Diagnoseschnittstelle fuer Fehlerpfad Dfp_FrmMngTIME_DATE" VAL_BLK 0xCDC22 Kwb_Wu8 255.0 OneToOne 0.00 255.0 FORMAT "%5.1" NUMBER 4 /end CHARACTERISTIC
/begin CHARACTERISTIC DSM_TypDfp_FrmMngTORQUE_DSC_C "type for faults in path" VAL_BLK 0xCDC26 Kwb_Wu8 255.0 OneToOne 0.00 255.0 FORMAT "%5.1" NUMBER 4 /end CHARACTERISTIC
/begin CHARACTERISTIC DSM_TypDfp_FrmMngTORQUE_GEARBX_C "type for faults in path" VAL_BLK 0xCDC2A Kwb_Wu8 255.0 OneToOne 0.00 255.0 FORMAT "%5.1" NUMBER 4 /end CHARACTERISTIC
/begin CHARACTERISTIC DSM_TypDfp_FrmMngTrq_ReqACC_C "Konvertierung der Fehlertypen auf der Diagnoseschnittstelle fuer Fehlerpfad Dfp_FrmMngTrq_ReqACC" VAL_BLK 0xCDC2E Kwb_Wu8 255.0 OneToOne 0.00 255.0 FORMAT "%5.1" NUMBER 4 /end CHARACTERISTIC
/begin CHARACTERISTIC DSM_TypDfp_FrmMngVEH_MOD_C "VEH_MOD - CAN-message related errors" VAL_BLK 0xCDC32 Kwb_Wu8 255.0 OneToOne 0.00 255.0 FORMAT "%5.1" NUMBER 4 /end CHARACTERISTIC
/begin CHARACTERISTIC DSM_TypDfp_FrmMngVELOCITY_C "type for faults in path" VAL_BLK 0xCDC36 Kwb_Wu8 255.0 OneToOne 0.00 255.0 FORMAT "%5.1" NUMBER 4 /end CHARACTERISTIC
/begin CHARACTERISTIC DSM_TypDfp_FrmMngWHEEL_SPEED_C "Konvertierung der Fehlertypen auf der Diagnoseschnittstelle fuer Fehlerpfad Dfp_FrmMngWHEEL_SPEED" VAL_BLK 0xCDC3A Kwb_Wu8 255.0 OneToOne 0.00 255.0 FORMAT "%5.1" NUMBER 4 /end CHARACTERISTIC
/begin CHARACTERISTIC DSM_TypDfp_FrmMngstCurr_C "Fehlertyp Feld für Dfp_FrmMngstCurr" VAL_BLK 0xCDC3E Kwb_Wu8 255.0 OneToOne 0.00 255.0 FORMAT "%5.1" NUMBER 4 /end CHARACTERISTIC
/begin CHARACTERISTIC DSM_TypDfp_FrmMngswtPSPOff_C "Fehlertyp Feld für Dfp_FrmMngswtPSPOff" VAL_BLK 0xCDC42 Kwb_Wu8 255.0 OneToOne 0.00 255.0 FORMAT "%5.1" NUMBER 4 /end CHARACTERISTIC
/begin CHARACTERISTIC DSM_TypDfp_GearbxIncMax_C "Konvertierung der Fehlertypen auf der Diagnoseschnittstelle fuer Fehlerpfad Dfp_GearbxIncMax" VAL_BLK 0xCDC46 Kwb_Wu8 255.0 OneToOne 0.00 255.0 FORMAT "%5.1" NUMBER 4 /end CHARACTERISTIC
/begin CHARACTERISTIC DSM_TypDfp_GlwCD_C "Konvertierung der Fehlertypen auf der Diagnoseschnittstelle fuer Fehlerpfad Dfp_GlwCD" VAL_BLK 0xCDC4A Kwb_Wu8 255.0 OneToOne 0.00 255.0 FORMAT "%5.1" NUMBER 4 /end CHARACTERISTIC
/begin CHARACTERISTIC DSM_TypDfp_GlwCDGlwCirc1_C "Konvertierung der Fehlertypen auf der Diagnoseschnittstelle fuer Fehlerpfad Dfp_GlwCDGlwCirc1" VAL_BLK 0xCDC4E Kwb_Wu8 255.0 OneToOne 0.00 255.0 FORMAT "%5.1" NUMBER 4 /end CHARACTERISTIC
/begin CHARACTERISTIC DSM_TypDfp_GlwCDGlwCirc2_C "Konvertierung der Fehlertypen auf der Diagnoseschnittstelle fuer Fehlerpfad Dfp_GlwCDGlwCirc2" VAL_BLK 0xCDC52 Kwb_Wu8 255.0 OneToOne 0.00 255.0 FORMAT "%5.1" NUMBER 4 /end CHARACTERISTIC
/begin CHARACTERISTIC DSM_TypDfp_GlwCDGlwCirc3_C "Konvertierung der Fehlertypen auf der Diagnoseschnittstelle fuer Fehlerpfad Dfp_GlwCDGlwCirc3" VAL_BLK 0xCDC56 Kwb_Wu8 255.0 OneToOne 0.00 255.0 FORMAT "%5.1" NUMBER 4 /end CHARACTERISTIC
/begin CHARACTERISTIC DSM_TypDfp_GlwCDGlwCirc4_C "Konvertierung der Fehlertypen auf der Diagnoseschnittstelle fuer Fehlerpfad Dfp_GlwCDGlwCirc4" VAL_BLK 0xCDC5A Kwb_Wu8 255.0 OneToOne 0.00 255.0 FORMAT "%5.1" NUMBER 4 /end CHARACTERISTIC
/begin CHARACTERISTIC DSM_TypDfp_GlwCDGlwCirc5_C "Konvertierung der Fehlertypen auf der Diagnoseschnittstelle fuer Fehlerpfad Dfp_GlwCDGlwCirc5" VAL_BLK 0xCDC5E Kwb_Wu8 255.0 OneToOne 0.00 255.0 FORMAT "%5.1" NUMBER 4 /end CHARACTERISTIC
/begin CHARACTERISTIC DSM_TypDfp_GlwCDGlwCirc6_C "Konvertierung der Fehlertypen auf der Diagnoseschnittstelle fuer Fehlerpfad Dfp_GlwCDGlwCirc6" VAL_BLK 0xCDC62 Kwb_Wu8 255.0 OneToOne 0.00 255.0 FORMAT "%5.1" NUMBER 4 /end CHARACTERISTIC
/begin CHARACTERISTIC DSM_TypDfp_GlwCDGlwCirc7_C "Konvertierung der Fehlertypen auf der Diagnoseschnittstelle fuer Fehlerpfad Dfp_GlwCDGlwCirc7" VAL_BLK 0xCDC66 Kwb_Wu8 255.0 OneToOne 0.00 255.0 FORMAT "%5.1" NUMBER 4 /end CHARACTERISTIC
/begin CHARACTERISTIC DSM_TypDfp_GlwCDGlwCirc8_C "Konvertierung der Fehlertypen auf der Diagnoseschnittstelle fuer Fehlerpfad Dfp_GlwCDGlwCirc8" VAL_BLK 0xCDC6A Kwb_Wu8 255.0 OneToOne 0.00 255.0 FORMAT "%5.1" NUMBER 4 /end CHARACTERISTIC
/begin CHARACTERISTIC DSM_TypDfp_GlwCtl_C "Konvertierung der Fehlertypen auf der Diagnoseschnittstelle fuer Fehlerpfad Dfp_GlwCtl" VAL_BLK 0xCDC6E Kwb_Wu8 255.0 OneToOne 0.00 255.0 FORMAT "%5.1" NUMBER 4 /end CHARACTERISTIC
/begin CHARACTERISTIC DSM_TypDfp_HWEMonCom_C "Konvertierung der Fehlertypen auf der Diagnoseschnittstelle fuer Fehlerpfad Dfp_HWEMonCom" VAL_BLK 0xCDC72 Kwb_Wu8 255.0 OneToOne 0.00 255.0 FORMAT "%5.1" NUMBER 4 /end CHARACTERISTIC
/begin CHARACTERISTIC DSM_TypDfp_HWEMonEEPROM_C "Konvertierung der Fehlertypen auf der Diagnoseschnittstelle fuer Fehlerpfad Dfp_HWEMonEEPROM" VAL_BLK 0xCDC76 Kwb_Wu8 255.0 OneToOne 0.00 255.0 FORMAT "%5.1" NUMBER 4 /end CHARACTERISTIC
/begin CHARACTERISTIC DSM_TypDfp_HWEMonRcyLocked_C "Konvertierung der Fehlertypen auf der Diagnoseschnittstelle fuer Fehlerpfad Dfp_HWEMonRcyLocked" VAL_BLK 0xCDC7A Kwb_Wu8 255.0 OneToOne 0.00 255.0 FORMAT "%5.1" NUMBER 4 /end CHARACTERISTIC
/begin CHARACTERISTIC DSM_TypDfp_HWEMonRcySuppressed_C "Konvertierung der Fehlertypen auf der Diagnoseschnittstelle fuer Fehlerpfad Dfp_HWEMonRcySuppressed" VAL_BLK 0xCDC7E Kwb_Wu8 255.0 OneToOne 0.00 255.0 FORMAT "%5.1" NUMBER 4 /end CHARACTERISTIC
/begin CHARACTERISTIC DSM_TypDfp_HWEMonRcyVisible_C "Konvertierung der Fehlertypen auf der Diagnoseschnittstelle fuer Fehlerpfad Dfp_HWEMonRcyVisible" VAL_BLK 0xCDC82 Kwb_Wu8 255.0 OneToOne 0.00 255.0 FORMAT "%5.1" NUMBER 4 /end CHARACTERISTIC
/begin CHARACTERISTIC DSM_TypDfp_HWEMonUMaxSupply_C "Konvertierung der Fehlertypen auf der Diagnoseschnittstelle fuer Fehlerpfad Dfp_HWEMonUMaxSupply" VAL_BLK 0xCDC86 Kwb_Wu8 255.0 OneToOne 0.00 255.0 FORMAT "%5.1" NUMBER 4 /end CHARACTERISTIC
/begin CHARACTERISTIC DSM_TypDfp_HWEMonUMinSupply_C "Konvertierung der Fehlertypen auf der Diagnoseschnittstelle fuer Fehlerpfad Dfp_HWEMonUMinSupply" VAL_BLK 0xCDC8A Kwb_Wu8 255.0 OneToOne 0.00 255.0 FORMAT "%5.1" NUMBER 4 /end CHARACTERISTIC
/begin CHARACTERISTIC DSM_TypDfp_IATSCD_C "Konvertierung der Fehlertypen auf der Diagnoseschnittstelle fuer Fehlerpfad Dfp_IATSCD" VAL_BLK 0xCDC8E Kwb_Wu8 255.0 OneToOne 0.00 255.0 FORMAT "%5.1" NUMBER 4 /end CHARACTERISTIC
/begin CHARACTERISTIC DSM_TypDfp_IATSCD_CATS_C "Konvertierung der Fehlertypen auf der Diagnoseschnittstelle fuer Fehlerpfad Dfp_IATSCD_CATS" VAL_BLK 0xCDC92 Kwb_Wu8 255.0 OneToOne 0.00 255.0 FORMAT "%5.1" NUMBER 4 /end CHARACTERISTIC
/begin CHARACTERISTIC DSM_TypDfp_ImmCtlImmCD_C "Konvertierung der Fehlertypen auf der Diagnoseschnittstelle fuer Fehlerpfad Dfp_ImmCtlImmCD" VAL_BLK 0xCDC96 Kwb_Wu8 255.0 OneToOne 0.00 255.0 FORMAT "%5.1" NUMBER 4 /end CHARACTERISTIC
/begin CHARACTERISTIC DSM_TypDfp_ImmCtlImmEep_C "Konvertierung der Fehlertypen auf der Diagnoseschnittstelle fuer Fehlerpfad Dfp_ImmCtlImmEep" VAL_BLK 0xCDC9A Kwb_Wu8 255.0 OneToOne 0.00 255.0 FORMAT "%5.1" NUMBER 4 /end CHARACTERISTIC
/begin CHARACTERISTIC DSM_TypDfp_ImmCtlMpl_C "Konvertierung der Fehlertypen auf der Diagnoseschnittstelle fuer Fehlerpfad Dfp_ImmCtlMpl" VAL_BLK 0xCDC9E Kwb_Wu8 255.0 OneToOne 0.00 255.0 FORMAT "%5.1" NUMBER 4 /end CHARACTERISTIC
/begin CHARACTERISTIC DSM_TypDfp_IndSys1_C "Konvertierung der Fehlertypen auf der Diagnoseschnittstelle fuer Fehlerpfad Dfp_IndSys1" VAL_BLK 0xCDCA2 Kwb_Wu8 255.0 OneToOne 0.00 255.0 FORMAT "%5.1" NUMBER 4 /end CHARACTERISTIC
/begin CHARACTERISTIC DSM_TypDfp_IndSys2_C "Konvertierung der Fehlertypen auf der Diagnoseschnittstelle fuer Fehlerpfad Dfp_IndSys2" VAL_BLK 0xCDCA6 Kwb_Wu8 255.0 OneToOne 0.00 255.0 FORMAT "%5.1" NUMBER 4 /end CHARACTERISTIC
/begin CHARACTERISTIC DSM_TypDfp_InjCrv_InjLim_C "Konvertierung der Fehlertypen auf der Diagnoseschnittstelle fuer Fehlerpfad Dfp_InjCrv_InjLim" VAL_BLK 0xCDCAA Kwb_Wu8 255.0 OneToOne 0.00 255.0 FORMAT "%5.1" NUMBER 4 /end CHARACTERISTIC
/begin CHARACTERISTIC DSM_TypDfp_InjCtlAdjQnt_C "Konvertierung der Fehlertypen auf der Diagnoseschnittstelle fuer Fehlerpfad Dfp_InjCtlAdjQnt" VAL_BLK 0xCDCAE Kwb_Wu8 255.0 OneToOne 0.00 255.0 FORMAT "%5.1" NUMBER 4 /end CHARACTERISTIC
/begin CHARACTERISTIC DSM_TypDfp_InjCtlDrift_C "Konvertierung der Fehlertypen auf der Diagnoseschnittstelle fuer Fehlerpfad Dfp_InjCtlDrift" VAL_BLK 0xCDCB2 Kwb_Wu8 255.0 OneToOne 0.00 255.0 FORMAT "%5.1" NUMBER 4 /end CHARACTERISTIC
/begin CHARACTERISTIC DSM_TypDfp_InjVCDActrChrg_C "Konvertierung der Fehlertypen auf der Diagnoseschnittstelle fuer Fehlerpfad Dfp_InjVCDActrChrg" VAL_BLK 0xCDCB6 Kwb_Wu8 255.0 OneToOne 0.00 255.0 FORMAT "%5.1" NUMBER 4 /end CHARACTERISTIC
/begin CHARACTERISTIC DSM_TypDfp_InjVCDActrEnrg1_C "Konvertierung der Fehlertypen auf der Diagnoseschnittstelle fuer Fehlerpfad Dfp_InjVCDActrEnrg1" VAL_BLK 0xCDCBA Kwb_Wu8 255.0 OneToOne 0.00 255.0 FORMAT "%5.1" NUMBER 4 /end CHARACTERISTIC
/begin CHARACTERISTIC DSM_TypDfp_InjVCDActrEnrg2_C "Konvertierung der Fehlertypen auf der Diagnoseschnittstelle fuer Fehlerpfad Dfp_InjVCDActrEnrg2" VAL_BLK 0xCDCBE Kwb_Wu8 255.0 OneToOne 0.00 255.0 FORMAT "%5.1" NUMBER 4 /end CHARACTERISTIC
/begin CHARACTERISTIC DSM_TypDfp_InjVCDActrEnrg3_C "Konvertierung der Fehlertypen auf der Diagnoseschnittstelle fuer Fehlerpfad Dfp_InjVCDActrEnrg3" VAL_BLK 0xCDCC2 Kwb_Wu8 255.0 OneToOne 0.00 255.0 FORMAT "%5.1" NUMBER 4 /end CHARACTERISTIC
/begin CHARACTERISTIC DSM_TypDfp_InjVCDActrEnrg4_C "Konvertierung der Fehlertypen auf der Diagnoseschnittstelle fuer Fehlerpfad Dfp_InjVCDActrEnrg4" VAL_BLK 0xCDCC6 Kwb_Wu8 255.0 OneToOne 0.00 255.0 FORMAT "%5.1" NUMBER 4 /end CHARACTERISTIC
/begin CHARACTERISTIC DSM_TypDfp_InjVCDActrEnrg5_C "Konvertierung der Fehlertypen auf der Diagnoseschnittstelle fuer Fehlerpfad Dfp_InjVCDActrEnrg5" VAL_BLK 0xCDCCA Kwb_Wu8 255.0 OneToOne 0.00 255.0 FORMAT "%5.1" NUMBER 4 /end CHARACTERISTIC
/begin CHARACTERISTIC DSM_TypDfp_InjVCDActrEnrg6_C "Konvertierung der Fehlertypen auf der Diagnoseschnittstelle fuer Fehlerpfad Dfp_InjVCDActrEnrg6" VAL_BLK 0xCDCCE Kwb_Wu8 255.0 OneToOne 0.00 255.0 FORMAT "%5.1" NUMBER 4 /end CHARACTERISTIC
/begin CHARACTERISTIC DSM_TypDfp_InjVCDActrEnrg7_C "Konvertierung der Fehlertypen auf der Diagnoseschnittstelle fuer Fehlerpfad Dfp_InjVCDActrEnrg7" VAL_BLK 0xCDCD2 Kwb_Wu8 255.0 OneToOne 0.00 255.0 FORMAT "%5.1" NUMBER 4 /end CHARACTERISTIC
/begin CHARACTERISTIC DSM_TypDfp_InjVCDActrEnrg8_C "Konvertierung der Fehlertypen auf der Diagnoseschnittstelle fuer Fehlerpfad Dfp_InjVCDActrEnrg8" VAL_BLK 0xCDCD6 Kwb_Wu8 255.0 OneToOne 0.00 255.0 FORMAT "%5.1" NUMBER 4 /end CHARACTERISTIC
/begin CHARACTERISTIC DSM_TypDfp_InjVCDActrVolt_C "Konvertierung der Fehlertypen auf der Diagnoseschnittstelle fuer Fehlerpfad Dfp_InjVCDActrVolt" VAL_BLK 0xCDCDA Kwb_Wu8 255.0 OneToOne 0.00 255.0 FORMAT "%5.1" NUMBER 4 /end CHARACTERISTIC
/begin CHARACTERISTIC DSM_TypDfp_InjVCDClsBank1_C "Konvertierung der Fehlertypen auf der Diagnoseschnittstelle fuer Fehlerpfad Dfp_InjVCDClsBank1" VAL_BLK 0xCDCDE Kwb_Wu8 255.0 OneToOne 0.00 255.0 FORMAT "%5.1" NUMBER 4 /end CHARACTERISTIC
/begin CHARACTERISTIC DSM_TypDfp_InjVCDClsBank2_C "Konvertierung der Fehlertypen auf der Diagnoseschnittstelle fuer Fehlerpfad Dfp_InjVCDClsBank2" VAL_BLK 0xCDCE2 Kwb_Wu8 255.0 OneToOne 0.00 255.0 FORMAT "%5.1" NUMBER 4 /end CHARACTERISTIC
/begin CHARACTERISTIC DSM_TypDfp_InjVCDMonCab_C "Konvertierung der Fehlertypen auf der Diagnoseschnittstelle fuer Fehlerpfad Dfp_InjVCDMonCab" VAL_BLK 0xCDCE6 Kwb_Wu8 255.0 OneToOne 0.00 255.0 FORMAT "%5.1" NUMBER 4 /end CHARACTERISTIC
/begin CHARACTERISTIC DSM_TypDfp_InjVCDMonSwt_C "Konvertierung der Fehlertypen auf der Diagnoseschnittstelle fuer Fehlerpfad Dfp_InjVCDMonSwt" VAL_BLK 0xCDCEA Kwb_Wu8 255.0 OneToOne 0.00 255.0 FORMAT "%5.1" NUMBER 4 /end CHARACTERISTIC
/begin CHARACTERISTIC DSM_TypDfp_InjVCDShOffDCDC_C "Konvertierung der Fehlertypen auf der Diagnoseschnittstelle fuer Fehlerpfad Dfp_InjVCDShOffDCDC" VAL_BLK 0xCDCEE Kwb_Wu8 255.0 OneToOne 0.00 255.0 FORMAT "%5.1" NUMBER 4 /end CHARACTERISTIC
/begin CHARACTERISTIC DSM_TypDfp_InjVCDUBuf_C "Konvertierung der Fehlertypen auf der Diagnoseschnittstelle fuer Fehlerpfad Dfp_InjVCDUBuf" VAL_BLK 0xCDCF2 Kwb_Wu8 255.0 OneToOne 0.00 255.0 FORMAT "%5.1" NUMBER 4 /end CHARACTERISTIC
/begin CHARACTERISTIC DSM_TypDfp_InjVCD_CY370Ampl_C "Konvertierung der Fehlertypen auf der Diagnoseschnittstelle fuer Fehlerpfad Dfp_InjVCD_CY370Ampl" VAL_BLK 0xCDCF6 Kwb_Wu8 255.0 OneToOne 0.00 255.0 FORMAT "%5.1" NUMBER 4 /end CHARACTERISTIC
/begin CHARACTERISTIC DSM_TypDfp_InjVlvBnk1A_C "Konvertierung der Fehlertypen auf der Diagnoseschnittstelle fuer Fehlerpfad Dfp_InjVlvBnk1A" VAL_BLK 0xCDCFA Kwb_Wu8 255.0 OneToOne 0.00 255.0 FORMAT "%5.1" NUMBER 4 /end CHARACTERISTIC
/begin CHARACTERISTIC DSM_TypDfp_InjVlvBnk1B_C "Konvertierung der Fehlertypen auf der Diagnoseschnittstelle fuer Fehlerpfad Dfp_InjVlvBnk1B" VAL_BLK 0xCDCFE Kwb_Wu8 255.0 OneToOne 0.00 255.0 FORMAT "%5.1" NUMBER 4 /end CHARACTERISTIC
/begin CHARACTERISTIC DSM_TypDfp_InjVlvBnk2A_C "Konvertierung der Fehlertypen auf der Diagnoseschnittstelle fuer Fehlerpfad Dfp_InjVlvBnk2A" VAL_BLK 0xCDD02 Kwb_Wu8 255.0 OneToOne 0.00 255.0 FORMAT "%5.1" NUMBER 4 /end CHARACTERISTIC
/begin CHARACTERISTIC DSM_TypDfp_InjVlvBnk2B_C "Konvertierung der Fehlertypen auf der Diagnoseschnittstelle fuer Fehlerpfad Dfp_InjVlvBnk2B" VAL_BLK 0xCDD06 Kwb_Wu8 255.0 OneToOne 0.00 255.0 FORMAT "%5.1" NUMBER 4 /end CHARACTERISTIC
/begin CHARACTERISTIC DSM_TypDfp_InjVlvChipA_C "Konvertierung der Fehlertypen auf der Diagnoseschnittstelle fuer Fehlerpfad Dfp_InjVlvChipA" VAL_BLK 0xCDD0A Kwb_Wu8 255.0 OneToOne 0.00 255.0 FORMAT "%5.1" NUMBER 4 /end CHARACTERISTIC
/begin CHARACTERISTIC DSM_TypDfp_InjVlvChipB_C "Konvertierung der Fehlertypen auf der Diagnoseschnittstelle fuer Fehlerpfad Dfp_InjVlvChipB" VAL_BLK 0xCDD0E Kwb_Wu8 255.0 OneToOne 0.00 255.0 FORMAT "%5.1" NUMBER 4 /end CHARACTERISTIC
/begin CHARACTERISTIC DSM_TypDfp_InjVlvCyl1A_C "Konvertierung der Fehlertypen auf der Diagnoseschnittstelle fuer Fehlerpfad Dfp_InjVlvCyl1A" VAL_BLK 0xCDD12 Kwb_Wu8 255.0 OneToOne 0.00 255.0 FORMAT "%5.1" NUMBER 4 /end CHARACTERISTIC
/begin CHARACTERISTIC DSM_TypDfp_InjVlvCyl1B_C "Konvertierung der Fehlertypen auf der Diagnoseschnittstelle fuer Fehlerpfad Dfp_InjVlvCyl1B" VAL_BLK 0xCDD16 Kwb_Wu8 255.0 OneToOne 0.00 255.0 FORMAT "%5.1" NUMBER 4 /end CHARACTERISTIC
/begin CHARACTERISTIC DSM_TypDfp_InjVlvCyl1C_C "Konvertierung der Fehlertypen auf der Diagnoseschnittstelle fuer Fehlerpfad Dfp_InjVlvCyl1C" VAL_BLK 0xCDD1A Kwb_Wu8 255.0 OneToOne 0.00 255.0 FORMAT "%5.1" NUMBER 4 /end CHARACTERISTIC
/begin CHARACTERISTIC DSM_TypDfp_InjVlvCyl2A_C "Konvertierung der Fehlertypen auf der Diagnoseschnittstelle fuer Fehlerpfad Dfp_InjVlvCyl2A" VAL_BLK 0xCDD1E Kwb_Wu8 255.0 OneToOne 0.00 255.0 FORMAT "%5.1" NUMBER 4 /end CHARACTERISTIC
/begin CHARACTERISTIC DSM_TypDfp_InjVlvCyl2B_C "Konvertierung der Fehlertypen auf der Diagnoseschnittstelle fuer Fehlerpfad Dfp_InjVlvCyl2B" VAL_BLK 0xCDD22 Kwb_Wu8 255.0 OneToOne 0.00 255.0 FORMAT "%5.1" NUMBER 4 /end CHARACTERISTIC
/begin CHARACTERISTIC DSM_TypDfp_InjVlvCyl2C_C "Konvertierung der Fehlertypen auf der Diagnoseschnittstelle fuer Fehlerpfad Dfp_InjVlvCyl2C" VAL_BLK 0xCDD26 Kwb_Wu8 255.0 OneToOne 0.00 255.0 FORMAT "%5.1" NUMBER 4 /end CHARACTERISTIC
/begin CHARACTERISTIC DSM_TypDfp_InjVlvCyl3A_C "Konvertierung der Fehlertypen auf der Diagnoseschnittstelle fuer Fehlerpfad Dfp_InjVlvCyl3A" VAL_BLK 0xCDD2A Kwb_Wu8 255.0 OneToOne 0.00 255.0 FORMAT "%5.1" NUMBER 4 /end CHARACTERISTIC
/begin CHARACTERISTIC DSM_TypDfp_InjVlvCyl3B_C "Konvertierung der Fehlertypen auf der Diagnoseschnittstelle fuer Fehlerpfad Dfp_InjVlvCyl3B" VAL_BLK 0xCDD2E Kwb_Wu8 255.0 OneToOne 0.00 255.0 FORMAT "%5.1" NUMBER 4 /end CHARACTERISTIC
/begin CHARACTERISTIC DSM_TypDfp_InjVlvCyl3C_C "Konvertierung der Fehlertypen auf der Diagnoseschnittstelle fuer Fehlerpfad Dfp_InjVlvCyl3C" VAL_BLK 0xCDD32 Kwb_Wu8 255.0 OneToOne 0.00 255.0 FORMAT "%5.1" NUMBER 4 /end CHARACTERISTIC
/begin CHARACTERISTIC DSM_TypDfp_InjVlvCyl4A_C "Konvertierung der Fehlertypen auf der Diagnoseschnittstelle fuer Fehlerpfad Dfp_InjVlvCyl4A" VAL_BLK 0xCDD36 Kwb_Wu8 255.0 OneToOne 0.00 255.0 FORMAT "%5.1" NUMBER 4 /end CHARACTERISTIC
/begin CHARACTERISTIC DSM_TypDfp_InjVlvCyl4B_C "Konvertierung der Fehlertypen auf der Diagnoseschnittstelle fuer Fehlerpfad Dfp_InjVlvCyl4B" VAL_BLK 0xCDD3A Kwb_Wu8 255.0 OneToOne 0.00 255.0 FORMAT "%5.1" NUMBER 4 /end CHARACTERISTIC
/begin CHARACTERISTIC DSM_TypDfp_InjVlvCyl4C_C "Konvertierung der Fehlertypen auf der Diagnoseschnittstelle fuer Fehlerpfad Dfp_InjVlvCyl4C" VAL_BLK 0xCDD3E Kwb_Wu8 255.0 OneToOne 0.00 255.0 FORMAT "%5.1" NUMBER 4 /end CHARACTERISTIC
/begin CHARACTERISTIC DSM_TypDfp_InjVlvCyl5A_C "Konvertierung der Fehlertypen auf der Diagnoseschnittstelle fuer Fehlerpfad Dfp_InjVlvCyl5A" VAL_BLK 0xCDD42 Kwb_Wu8 255.0 OneToOne 0.00 255.0 FORMAT "%5.1" NUMBER 4 /end CHARACTERISTIC
/begin CHARACTERISTIC DSM_TypDfp_InjVlvCyl5B_C "Konvertierung der Fehlertypen auf der Diagnoseschnittstelle fuer Fehlerpfad Dfp_InjVlvCyl5B" VAL_BLK 0xCDD46 Kwb_Wu8 255.0 OneToOne 0.00 255.0 FORMAT "%5.1" NUMBER 4 /end CHARACTERISTIC
/begin CHARACTERISTIC DSM_TypDfp_InjVlvCyl5C_C "Konvertierung der Fehlertypen auf der Diagnoseschnittstelle fuer Fehlerpfad Dfp_InjVlvCyl5C" VAL_BLK 0xCDD4A Kwb_Wu8 255.0 OneToOne 0.00 255.0 FORMAT "%5.1" NUMBER 4 /end CHARACTERISTIC
/begin CHARACTERISTIC DSM_TypDfp_InjVlvCyl6A_C "Konvertierung der Fehlertypen auf der Diagnoseschnittstelle fuer Fehlerpfad Dfp_InjVlvCyl6A" VAL_BLK 0xCDD4E Kwb_Wu8 255.0 OneToOne 0.00 255.0 FORMAT "%5.1" NUMBER 4 /end CHARACTERISTIC
/begin CHARACTERISTIC DSM_TypDfp_InjVlvCyl6B_C "Konvertierung der Fehlertypen auf der Diagnoseschnittstelle fuer Fehlerpfad Dfp_InjVlvCyl6B" VAL_BLK 0xCDD52 Kwb_Wu8 255.0 OneToOne 0.00 255.0 FORMAT "%5.1" NUMBER 4 /end CHARACTERISTIC
/begin CHARACTERISTIC DSM_TypDfp_InjVlvCyl6C_C "Konvertierung der Fehlertypen auf der Diagnoseschnittstelle fuer Fehlerpfad Dfp_InjVlvCyl6C" VAL_BLK 0xCDD56 Kwb_Wu8 255.0 OneToOne 0.00 255.0 FORMAT "%5.1" NUMBER 4 /end CHARACTERISTIC
/begin CHARACTERISTIC DSM_TypDfp_InjVlvCyl7A_C "Konvertierung der Fehlertypen auf der Diagnoseschnittstelle fuer Fehlerpfad Dfp_InjVlvCyl7A" VAL_BLK 0xCDD5A Kwb_Wu8 255.0 OneToOne 0.00 255.0 FORMAT "%5.1" NUMBER 4 /end CHARACTERISTIC
/begin CHARACTERISTIC DSM_TypDfp_InjVlvCyl7B_C "Konvertierung der Fehlertypen auf der Diagnoseschnittstelle fuer Fehlerpfad Dfp_InjVlvCyl7B" VAL_BLK 0xCDD5E Kwb_Wu8 255.0 OneToOne 0.00 255.0 FORMAT "%5.1" NUMBER 4 /end CHARACTERISTIC
/begin CHARACTERISTIC DSM_TypDfp_InjVlvCyl7C_C "Konvertierung der Fehlertypen auf der Diagnoseschnittstelle fuer Fehlerpfad Dfp_InjVlvCyl7C" VAL_BLK 0xCDD62 Kwb_Wu8 255.0 OneToOne 0.00 255.0 FORMAT "%5.1" NUMBER 4 /end CHARACTERISTIC
/begin CHARACTERISTIC DSM_TypDfp_InjVlvCyl8A_C "Konvertierung der Fehlertypen auf der Diagnoseschnittstelle fuer Fehlerpfad Dfp_InjVlvCyl8A" VAL_BLK 0xCDD66 Kwb_Wu8 255.0 OneToOne 0.00 255.0 FORMAT "%5.1" NUMBER 4 /end CHARACTERISTIC
/begin CHARACTERISTIC DSM_TypDfp_InjVlvCyl8B_C "Konvertierung der Fehlertypen auf der Diagnoseschnittstelle fuer Fehlerpfad Dfp_InjVlvCyl8B" VAL_BLK 0xCDD6A Kwb_Wu8 255.0 OneToOne 0.00 255.0 FORMAT "%5.1" NUMBER 4 /end CHARACTERISTIC
/begin CHARACTERISTIC DSM_TypDfp_InjVlvCyl8C_C "Konvertierung der Fehlertypen auf der Diagnoseschnittstelle fuer Fehlerpfad Dfp_InjVlvCyl8C" VAL_BLK 0xCDD6E Kwb_Wu8 255.0 OneToOne 0.00 255.0 FORMAT "%5.1" NUMBER 4 /end CHARACTERISTIC
/begin CHARACTERISTIC DSM_TypDfp_InjVlvNVC1_C "Konvertierung der Fehlertypen auf der Diagnoseschnittstelle fuer Fehlerpfad Dfp_InjVlvNVC1" VAL_BLK 0xCDD72 Kwb_Wu8 255.0 OneToOne 0.00 255.0 FORMAT "%5.1" NUMBER 4 /end CHARACTERISTIC
/begin CHARACTERISTIC DSM_TypDfp_InjVlvNVC2_C "Konvertierung der Fehlertypen auf der Diagnoseschnittstelle fuer Fehlerpfad Dfp_InjVlvNVC2" VAL_BLK 0xCDD76 Kwb_Wu8 255.0 OneToOne 0.00 255.0 FORMAT "%5.1" NUMBER 4 /end CHARACTERISTIC
/begin CHARACTERISTIC DSM_TypDfp_InjVlvNVC3_C "Konvertierung der Fehlertypen auf der Diagnoseschnittstelle fuer Fehlerpfad Dfp_InjVlvNVC3" VAL_BLK 0xCDD7A Kwb_Wu8 255.0 OneToOne 0.00 255.0 FORMAT "%5.1" NUMBER 4 /end CHARACTERISTIC
/begin CHARACTERISTIC DSM_TypDfp_InjVlvNVC4_C "Konvertierung der Fehlertypen auf der Diagnoseschnittstelle fuer Fehlerpfad Dfp_InjVlvNVC4" VAL_BLK 0xCDD7E Kwb_Wu8 255.0 OneToOne 0.00 255.0 FORMAT "%5.1" NUMBER 4 /end CHARACTERISTIC
/begin CHARACTERISTIC DSM_TypDfp_InjVlvNVC5_C "Konvertierung der Fehlertypen auf der Diagnoseschnittstelle fuer Fehlerpfad Dfp_InjVlvNVC5" VAL_BLK 0xCDD82 Kwb_Wu8 255.0 OneToOne 0.00 255.0 FORMAT "%5.1" NUMBER 4 /end CHARACTERISTIC
/begin CHARACTERISTIC DSM_TypDfp_InjVlvNVC6_C "Konvertierung der Fehlertypen auf der Diagnoseschnittstelle fuer Fehlerpfad Dfp_InjVlvNVC6" VAL_BLK 0xCDD86 Kwb_Wu8 255.0 OneToOne 0.00 255.0 FORMAT "%5.1" NUMBER 4 /end CHARACTERISTIC
/begin CHARACTERISTIC DSM_TypDfp_InjVlvNVC7_C "Konvertierung der Fehlertypen auf der Diagnoseschnittstelle fuer Fehlerpfad Dfp_InjVlvNVC7" VAL_BLK 0xCDD8A Kwb_Wu8 255.0 OneToOne 0.00 255.0 FORMAT "%5.1" NUMBER 4 /end CHARACTERISTIC
/begin CHARACTERISTIC DSM_TypDfp_InjVlvNVC8_C "Konvertierung der Fehlertypen auf der Diagnoseschnittstelle fuer Fehlerpfad Dfp_InjVlvNVC8" VAL_BLK 0xCDD8E Kwb_Wu8 255.0 OneToOne 0.00 255.0 FORMAT "%5.1" NUMBER 4 /end CHARACTERISTIC
/begin CHARACTERISTIC DSM_TypDfp_LPACD_Max_C "Konvertierung der Fehlertypen auf der Diagnoseschnittstelle fuer Fehlerpfad Dfp_LPACD_Max" VAL_BLK 0xCDD92 Kwb_Wu8 255.0 OneToOne 0.00 255.0 FORMAT "%5.1" NUMBER 4 /end CHARACTERISTIC
/begin CHARACTERISTIC DSM_TypDfp_LPACD_Min_C "Konvertierung der Fehlertypen auf der Diagnoseschnittstelle fuer Fehlerpfad Dfp_LPACD_Min" VAL_BLK 0xCDD96 Kwb_Wu8 255.0 OneToOne 0.00 255.0 FORMAT "%5.1" NUMBER 4 /end CHARACTERISTIC
/begin CHARACTERISTIC DSM_TypDfp_LPACD_SigNpl_C "Konvertierung der Fehlertypen auf der Diagnoseschnittstelle fuer Fehlerpfad Dfp_LPACD_SigNpl" VAL_BLK 0xCDD9A Kwb_Wu8 255.0 OneToOne 0.00 255.0 FORMAT "%5.1" NUMBER 4 /end CHARACTERISTIC
/begin CHARACTERISTIC DSM_TypDfp_LSUCDCircNernst0_C "Konvertierung der Fehlertypen auf der Diagnoseschnittstelle fuer Fehlerpfad Dfp_LSUCDCircNernst0" VAL_BLK 0xCDD9E Kwb_Wu8 255.0 OneToOne 0.00 255.0 FORMAT "%5.1" NUMBER 4 /end CHARACTERISTIC
/begin CHARACTERISTIC DSM_TypDfp_LSUCDCircPumpCur0_C "Konvertierung der Fehlertypen auf der Diagnoseschnittstelle fuer Fehlerpfad Dfp_LSUCDCircPumpCur0" VAL_BLK 0xCDDA2 Kwb_Wu8 255.0 OneToOne 0.00 255.0 FORMAT "%5.1" NUMBER 4 /end CHARACTERISTIC
/begin CHARACTERISTIC DSM_TypDfp_LSUCDCircVirtGnd0_C "Konvertierung der Fehlertypen auf der Diagnoseschnittstelle fuer Fehlerpfad Dfp_LSUCDCircVirtGnd0" VAL_BLK 0xCDDA6 Kwb_Wu8 255.0 OneToOne 0.00 255.0 FORMAT "%5.1" NUMBER 4 /end CHARACTERISTIC
/begin CHARACTERISTIC DSM_TypDfp_LSUCDHeater0_C "Konvertierung der Fehlertypen auf der Diagnoseschnittstelle fuer Fehlerpfad Dfp_LSUCDHeater0" VAL_BLK 0xCDDAA Kwb_Wu8 255.0 OneToOne 0.00 255.0 FORMAT "%5.1" NUMBER 4 /end CHARACTERISTIC
/begin CHARACTERISTIC DSM_TypDfp_LSUCDHtCoup0_C "Konvertierung der Fehlertypen auf der Diagnoseschnittstelle fuer Fehlerpfad Dfp_LSUCDHtCoup0" VAL_BLK 0xCDDAE Kwb_Wu8 255.0 OneToOne 0.00 255.0 FORMAT "%5.1" NUMBER 4 /end CHARACTERISTIC
/begin CHARACTERISTIC DSM_TypDfp_LSUCDO20_C "Konvertierung der Fehlertypen auf der Diagnoseschnittstelle fuer Fehlerpfad Dfp_LSUCDO20" VAL_BLK 0xCDDB2 Kwb_Wu8 255.0 OneToOne 0.00 255.0 FORMAT "%5.1" NUMBER 4 /end CHARACTERISTIC
/begin CHARACTERISTIC DSM_TypDfp_LSUCDO2Clb0_C "Konvertierung der Fehlertypen auf der Diagnoseschnittstelle fuer Fehlerpfad Dfp_LSUCDO2Clb0" VAL_BLK 0xCDDB6 Kwb_Wu8 255.0 OneToOne 0.00 255.0 FORMAT "%5.1" NUMBER 4 /end CHARACTERISTIC
/begin CHARACTERISTIC DSM_TypDfp_LSUCDRiClb0_C "Konvertierung der Fehlertypen auf der Diagnoseschnittstelle fuer Fehlerpfad Dfp_LSUCDRiClb0" VAL_BLK 0xCDDBA Kwb_Wu8 255.0 OneToOne 0.00 255.0 FORMAT "%5.1" NUMBER 4 /end CHARACTERISTIC
/begin CHARACTERISTIC DSM_TypDfp_LSUCDSPI0_C "Konvertierung der Fehlertypen auf der Diagnoseschnittstelle fuer Fehlerpfad Dfp_LSUCDSPI0" VAL_BLK 0xCDDBE Kwb_Wu8 255.0 OneToOne 0.00 255.0 FORMAT "%5.1" NUMBER 4 /end CHARACTERISTIC
/begin CHARACTERISTIC DSM_TypDfp_LSUCDSPIBattLow0_C "Konvertierung der Fehlertypen auf der Diagnoseschnittstelle fuer Fehlerpfad Dfp_LSUCDSPIBattLow0" VAL_BLK 0xCDDC2 Kwb_Wu8 255.0 OneToOne 0.00 255.0 FORMAT "%5.1" NUMBER 4 /end CHARACTERISTIC
/begin CHARACTERISTIC DSM_TypDfp_LSUCDWireIP0_C "Konvertierung der Fehlertypen auf der Diagnoseschnittstelle fuer Fehlerpfad Dfp_LSUCDWireIP0" VAL_BLK 0xCDDC6 Kwb_Wu8 255.0 OneToOne 0.00 255.0 FORMAT "%5.1" NUMBER 4 /end CHARACTERISTIC
/begin CHARACTERISTIC DSM_TypDfp_LSUCtlRiExc0_C "Konvertierung der Fehlertypen auf der Diagnoseschnittstelle fuer Fehlerpfad Dfp_LSUCtlRiExc0" VAL_BLK 0xCDDCA Kwb_Wu8 255.0 OneToOne 0.00 255.0 FORMAT "%5.1" NUMBER 4 /end CHARACTERISTIC
/begin CHARACTERISTIC DSM_TypDfp_LSUMon1Sens_C "Konvertierung der Fehlertypen auf der Diagnoseschnittstelle fuer Fehlerpfad Dfp_LSUMon1Sens" VAL_BLK 0xCDDCE Kwb_Wu8 255.0 OneToOne 0.00 255.0 FORMAT "%5.1" NUMBER 4 /end CHARACTERISTIC
/begin CHARACTERISTIC DSM_TypDfp_LSUMon2Sens_C "Konvertierung der Fehlertypen auf der Diagnoseschnittstelle fuer Fehlerpfad Dfp_LSUMon2Sens" VAL_BLK 0xCDDD2 Kwb_Wu8 255.0 OneToOne 0.00 255.0 FORMAT "%5.1" NUMBER 4 /end CHARACTERISTIC
/begin CHARACTERISTIC DSM_TypDfp_MIL_C "Konvertierung der Fehlertypen auf der Diagnoseschnittstelle fuer Fehlerpfad Dfp_MIL" VAL_BLK 0xCDDD6 Kwb_Wu8 255.0 OneToOne 0.00 255.0 FORMAT "%5.1" NUMBER 4 /end CHARACTERISTIC
/begin CHARACTERISTIC DSM_TypDfp_MRlyCD_C "Konvertierung der Fehlertypen auf der Diagnoseschnittstelle fuer Fehlerpfad Dfp_MRlyCD" VAL_BLK 0xCDDDA Kwb_Wu8 255.0 OneToOne 0.00 255.0 FORMAT "%5.1" NUMBER 4 /end CHARACTERISTIC
/begin CHARACTERISTIC DSM_TypDfp_MSidCD_Comm_C "Konvertierung der Fehlertypen auf der Diagnoseschnittstelle fuer Fehlerpfad Dfp_MSidCD_Comm" VAL_BLK 0xCDDDE Kwb_Wu8 255.0 OneToOne 0.00 255.0 FORMAT "%5.1" NUMBER 4 /end CHARACTERISTIC
/begin CHARACTERISTIC DSM_TypDfp_MSidCD_Pin_C "Konvertierung der Fehlertypen auf der Diagnoseschnittstelle fuer Fehlerpfad Dfp_MSidCD_Pin" VAL_BLK 0xCDDE2 Kwb_Wu8 255.0 OneToOne 0.00 255.0 FORMAT "%5.1" NUMBER 4 /end CHARACTERISTIC
/begin CHARACTERISTIC DSM_TypDfp_MSidCD_Sel_INI_C "Konvertierung der Fehlertypen auf der Diagnoseschnittstelle fuer Fehlerpfad Dfp_MSidCD_Sel_INI" VAL_BLK 0xCDDE6 Kwb_Wu8 255.0 OneToOne 0.00 255.0 FORMAT "%5.1" NUMBER 4 /end CHARACTERISTIC
/begin CHARACTERISTIC DSM_TypDfp_MSidCD_Select_C "Konvertierung der Fehlertypen auf der Diagnoseschnittstelle fuer Fehlerpfad Dfp_MSidCD_Select" VAL_BLK 0xCDDEA Kwb_Wu8 255.0 OneToOne 0.00 255.0 FORMAT "%5.1" NUMBER 4 /end CHARACTERISTIC
/begin CHARACTERISTIC DSM_TypDfp_MeUnCDNoLoad_C "Konvertierung der Fehlertypen auf der Diagnoseschnittstelle fuer Fehlerpfad Dfp_MeUnCDNoLoad" VAL_BLK 0xCDDEE Kwb_Wu8 255.0 OneToOne 0.00 255.0 FORMAT "%5.1" NUMBER 4 /end CHARACTERISTIC
/begin CHARACTERISTIC DSM_TypDfp_MeUnCDSCBat_C "Konvertierung der Fehlertypen auf der Diagnoseschnittstelle fuer Fehlerpfad Dfp_MeUnCDSCBat" VAL_BLK 0xCDDF2 Kwb_Wu8 255.0 OneToOne 0.00 255.0 FORMAT "%5.1" NUMBER 4 /end CHARACTERISTIC
/begin CHARACTERISTIC DSM_TypDfp_MeUnCDSCGnd_C "Konvertierung der Fehlertypen auf der Diagnoseschnittstelle fuer Fehlerpfad Dfp_MeUnCDSCGnd" VAL_BLK 0xCDDF6 Kwb_Wu8 255.0 OneToOne 0.00 255.0 FORMAT "%5.1" NUMBER 4 /end CHARACTERISTIC
/begin CHARACTERISTIC DSM_TypDfp_MeUnCD_ADC_C "Konvertierung der Fehlertypen auf der Diagnoseschnittstelle fuer Fehlerpfad Dfp_MeUnCD_ADC" VAL_BLK 0xCDDFA Kwb_Wu8 255.0 OneToOne 0.00 255.0 FORMAT "%5.1" NUMBER 4 /end CHARACTERISTIC
/begin CHARACTERISTIC DSM_TypDfp_MeUnCD_SigTst_C "Konvertierung der Fehlertypen auf der Diagnoseschnittstelle fuer Fehlerpfad Dfp_MeUnCD_SigTst" VAL_BLK 0xCDDFE Kwb_Wu8 255.0 OneToOne 0.00 255.0 FORMAT "%5.1" NUMBER 4 /end CHARACTERISTIC
/begin CHARACTERISTIC DSM_TypDfp_Montr_C "Konvertierung der Fehlertypen auf der Diagnoseschnittstelle fuer Fehlerpfad Dfp_Montr" VAL_BLK 0xCDE02 Kwb_Wu8 255.0 OneToOne 0.00 255.0 FORMAT "%5.1" NUMBER 4 /end CHARACTERISTIC
/begin CHARACTERISTIC DSM_TypDfp_NetMngDeviceA_C "Konvertierung der Fehlertypen auf der Diagnoseschnittstelle fuer Fehlerpfad Dfp_NetMngDeviceA" VAL_BLK 0xCDE06 Kwb_Wu8 255.0 OneToOne 0.00 255.0 FORMAT "%5.1" NUMBER 4 /end CHARACTERISTIC
/begin CHARACTERISTIC DSM_TypDfp_NetMngDeviceB_C "Konvertierung der Fehlertypen auf der Diagnoseschnittstelle fuer Fehlerpfad Dfp_NetMngDeviceB" VAL_BLK 0xCDE0A Kwb_Wu8 255.0 OneToOne 0.00 255.0 FORMAT "%5.1" NUMBER 4 /end CHARACTERISTIC
/begin CHARACTERISTIC DSM_TypDfp_NetMngDeviceC_C "Konvertierung der Fehlertypen auf der Diagnoseschnittstelle fuer Fehlerpfad Dfp_NetMngDeviceC" VAL_BLK 0xCDE0E Kwb_Wu8 255.0 OneToOne 0.00 255.0 FORMAT "%5.1" NUMBER 4 /end CHARACTERISTIC
/begin CHARACTERISTIC DSM_TypDfp_OPSCD_Lamp_C "Konvertierung der Fehlertypen auf der Diagnoseschnittstelle fuer Fehlerpfad Dfp_OPSCD_Lamp" VAL_BLK 0xCDE12 Kwb_Wu8 255.0 OneToOne 0.00 255.0 FORMAT "%5.1" NUMBER 4 /end CHARACTERISTIC
/begin CHARACTERISTIC DSM_TypDfp_OPSCD_anain_C "Konvertierung der Fehlertypen auf der Diagnoseschnittstelle fuer Fehlerpfad Dfp_OPSCD_anain" VAL_BLK 0xCDE16 Kwb_Wu8 255.0 OneToOne 0.00 255.0 FORMAT "%5.1" NUMBER 4 /end CHARACTERISTIC
/begin CHARACTERISTIC DSM_TypDfp_OTSCD_C "Konvertierung der Fehlertypen auf der Diagnoseschnittstelle fuer Fehlerpfad Dfp_OTSCD" VAL_BLK 0xCDE1A Kwb_Wu8 255.0 OneToOne 0.00 255.0 FORMAT "%5.1" NUMBER 4 /end CHARACTERISTIC
/begin CHARACTERISTIC DSM_TypDfp_OvRMon_C "Konvertierung der Fehlertypen auf der Diagnoseschnittstelle fuer Fehlerpfad Dfp_OvRMon" VAL_BLK 0xCDE1E Kwb_Wu8 255.0 OneToOne 0.00 255.0 FORMAT "%5.1" NUMBER 4 /end CHARACTERISTIC
/begin CHARACTERISTIC DSM_TypDfp_OvRMonBrk_C "conversion of fault types for diagnostic interface for fault path Dfp_OvRMonBrk" VAL_BLK 0xCDE22 Kwb_Wu8 255.0 OneToOne 0.00 255.0 FORMAT "%5.1" NUMBER 4 /end CHARACTERISTIC
/begin CHARACTERISTIC DSM_TypDfp_OvRMonSigA_C "Konvertierung der Fehlertypen auf der Diagnoseschnittstelle fuer Fehlerpfad Dfp_OvRMonSigA" VAL_BLK 0xCDE26 Kwb_Wu8 255.0 OneToOne 0.00 255.0 FORMAT "%5.1" NUMBER 4 /end CHARACTERISTIC
/begin CHARACTERISTIC DSM_TypDfp_OxiCCDTPre_C "Konvertierung der Fehlertypen auf der Diagnoseschnittstelle fuer Fehlerpfad Dfp_OxiCCDTPre" VAL_BLK 0xCDE2A Kwb_Wu8 255.0 OneToOne 0.00 255.0 FORMAT "%5.1" NUMBER 4 /end CHARACTERISTIC
/begin CHARACTERISTIC DSM_TypDfp_PCR_GovDevNeg_C "Konvertierung der Fehlertypen auf der Diagnoseschnittstelle fuer Fehlerpfad Dfp_PCR_GovDevNeg" VAL_BLK 0xCDE2E Kwb_Wu8 255.0 OneToOne 0.00 255.0 FORMAT "%5.1" NUMBER 4 /end CHARACTERISTIC
/begin CHARACTERISTIC DSM_TypDfp_PCR_GovDevPos_C "Konvertierung der Fehlertypen auf der Diagnoseschnittstelle fuer Fehlerpfad Dfp_PCR_GovDevPos" VAL_BLK 0xCDE32 Kwb_Wu8 255.0 OneToOne 0.00 255.0 FORMAT "%5.1" NUMBER 4 /end CHARACTERISTIC
/begin CHARACTERISTIC DSM_TypDfp_PCR_LPGvnrDvtNeg_C "Konvertierung der Fehlertypen auf der Diagnoseschnittstelle fuer Fehlerpfad Dfp_PCR_LPGvnrDvtNeg" VAL_BLK 0xCDE36 Kwb_Wu8 255.0 OneToOne 0.00 255.0 FORMAT "%5.1" NUMBER 4 /end CHARACTERISTIC
/begin CHARACTERISTIC DSM_TypDfp_PCR_LPGvnrDvtPos_C "Konvertierung der Fehlertypen auf der Diagnoseschnittstelle fuer Fehlerpfad Dfp_PCR_LPGvnrDvtPos" VAL_BLK 0xCDE3A Kwb_Wu8 255.0 OneToOne 0.00 255.0 FORMAT "%5.1" NUMBER 4 /end CHARACTERISTIC
/begin CHARACTERISTIC DSM_TypDfp_PCVCDNoLoad_C "Konvertierung der Fehlertypen auf der Diagnoseschnittstelle fuer Fehlerpfad Dfp_PCVCDNoLoad" VAL_BLK 0xCDE3E Kwb_Wu8 255.0 OneToOne 0.00 255.0 FORMAT "%5.1" NUMBER 4 /end CHARACTERISTIC
/begin CHARACTERISTIC DSM_TypDfp_PCVCDSCBat_C "Konvertierung der Fehlertypen auf der Diagnoseschnittstelle fuer Fehlerpfad Dfp_PCVCDSCBat" VAL_BLK 0xCDE42 Kwb_Wu8 255.0 OneToOne 0.00 255.0 FORMAT "%5.1" NUMBER 4 /end CHARACTERISTIC
/begin CHARACTERISTIC DSM_TypDfp_PCVCDSCGnd_C "Konvertierung der Fehlertypen auf der Diagnoseschnittstelle fuer Fehlerpfad Dfp_PCVCDSCGnd" VAL_BLK 0xCDE46 Kwb_Wu8 255.0 OneToOne 0.00 255.0 FORMAT "%5.1" NUMBER 4 /end CHARACTERISTIC
/begin CHARACTERISTIC DSM_TypDfp_PCVCD_ADC_C "Konvertierung der Fehlertypen auf der Diagnoseschnittstelle fuer Fehlerpfad Dfp_PCVCD_ADC" VAL_BLK 0xCDE4A Kwb_Wu8 255.0 OneToOne 0.00 255.0 FORMAT "%5.1" NUMBER 4 /end CHARACTERISTIC
/begin CHARACTERISTIC DSM_TypDfp_PCVCD_SigTst_C "Konvertierung der Fehlertypen auf der Diagnoseschnittstelle fuer Fehlerpfad Dfp_PCVCD_SigTst" VAL_BLK 0xCDE4E Kwb_Wu8 255.0 OneToOne 0.00 255.0 FORMAT "%5.1" NUMBER 4 /end CHARACTERISTIC
/begin CHARACTERISTIC DSM_TypDfp_PFltAPSPlaus_C "Konvertierung der Fehlertypen auf der Diagnoseschnittstelle fuer Fehlerpfad Dfp_PFltAPSPlaus" VAL_BLK 0xCDE52 Kwb_Wu8 255.0 OneToOne 0.00 255.0 FORMAT "%5.1" NUMBER 4 /end CHARACTERISTIC
/begin CHARACTERISTIC DSM_TypDfp_PFltAPSens_C "Konvertierung der Fehlertypen auf der Diagnoseschnittstelle fuer Fehlerpfad Dfp_PFltAPSens" VAL_BLK 0xCDE56 Kwb_Wu8 255.0 OneToOne 0.00 255.0 FORMAT "%5.1" NUMBER 4 /end CHARACTERISTIC
/begin CHARACTERISTIC DSM_TypDfp_PFltBPSPlaus_C "Konvertierung der Fehlertypen auf der Diagnoseschnittstelle fuer Fehlerpfad Dfp_PFltBPSPlaus" VAL_BLK 0xCDE5A Kwb_Wu8 255.0 OneToOne 0.00 255.0 FORMAT "%5.1" NUMBER 4 /end CHARACTERISTIC
/begin CHARACTERISTIC DSM_TypDfp_PFltCDPPre_C "Konvertierung der Fehlertypen auf der Diagnoseschnittstelle fuer Fehlerpfad Dfp_PFltCDPPre" VAL_BLK 0xCDE5E Kwb_Wu8 255.0 OneToOne 0.00 255.0 FORMAT "%5.1" NUMBER 4 /end CHARACTERISTIC
/begin CHARACTERISTIC DSM_TypDfp_PFltCDTempPre_C "Konvertierung der Fehlertypen auf der Diagnoseschnittstelle fuer Fehlerpfad Dfp_PFltCDTempPre" VAL_BLK 0xCDE62 Kwb_Wu8 255.0 OneToOne 0.00 255.0 FORMAT "%5.1" NUMBER 4 /end CHARACTERISTIC
/begin CHARACTERISTIC DSM_TypDfp_PFltChar_C "Konvertierung der Fehlertypen auf der Diagnoseschnittstelle fuer Fehlerpfad Dfp_PFltChar" VAL_BLK 0xCDE66 Kwb_Wu8 255.0 OneToOne 0.00 255.0 FORMAT "%5.1" NUMBER 4 /end CHARACTERISTIC
/begin CHARACTERISTIC DSM_TypDfp_PFltEngPrt_C "Konvertierung der Fehlertypen auf der Diagnoseschnittstelle fuer Fehlerpfad Dfp_PFltEngPrt" VAL_BLK 0xCDE6A Kwb_Wu8 255.0 OneToOne 0.00 255.0 FORMAT "%5.1" NUMBER 4 /end CHARACTERISTIC
/begin CHARACTERISTIC DSM_TypDfp_PFltPresDynPlaus_C "Konvertierung der Fehlertypen auf der Diagnoseschnittstelle fuer Fehlerpfad Dfp_PFltPresDynPlaus" VAL_BLK 0xCDE6E Kwb_Wu8 255.0 OneToOne 0.00 255.0 FORMAT "%5.1" NUMBER 4 /end CHARACTERISTIC
/begin CHARACTERISTIC DSM_TypDfp_PFltPresPlaus_C "Konvertierung der Fehlertypen auf der Diagnoseschnittstelle fuer Fehlerpfad Dfp_PFltPresPlaus" VAL_BLK 0xCDE72 Kwb_Wu8 255.0 OneToOne 0.00 255.0 FORMAT "%5.1" NUMBER 4 /end CHARACTERISTIC
/begin CHARACTERISTIC DSM_TypDfp_PFltPresSens_C "Konvertierung der Fehlertypen auf der Diagnoseschnittstelle fuer Fehlerpfad Dfp_PFltPresSens" VAL_BLK 0xCDE76 Kwb_Wu8 255.0 OneToOne 0.00 255.0 FORMAT "%5.1" NUMBER 4 /end CHARACTERISTIC
/begin CHARACTERISTIC DSM_TypDfp_PFltPresSensFrz_C "Konvertierung der Fehlertypen auf der Diagnoseschnittstelle fuer Fehlerpfad Dfp_PFltPresSensFrz" VAL_BLK 0xCDE7A Kwb_Wu8 255.0 OneToOne 0.00 255.0 FORMAT "%5.1" NUMBER 4 /end CHARACTERISTIC
/begin CHARACTERISTIC DSM_TypDfp_PFltPresSensHsLn_C "Konvertierung der Fehlertypen auf der Diagnoseschnittstelle fuer Fehlerpfad Dfp_PFltPresSensHsLn" VAL_BLK 0xCDE7E Kwb_Wu8 255.0 OneToOne 0.00 255.0 FORMAT "%5.1" NUMBER 4 /end CHARACTERISTIC
/begin CHARACTERISTIC DSM_TypDfp_PFltPresSensSot_C "Konvertierung der Fehlertypen auf der Diagnoseschnittstelle fuer Fehlerpfad Dfp_PFltPresSensSot" VAL_BLK 0xCDE82 Kwb_Wu8 255.0 OneToOne 0.00 255.0 FORMAT "%5.1" NUMBER 4 /end CHARACTERISTIC
/begin CHARACTERISTIC DSM_TypDfp_PFltRgnPerm_C "Konvertierung der Fehlertypen auf der Diagnoseschnittstelle fuer Fehlerpfad Dfp_PFltRgnPerm" VAL_BLK 0xCDE86 Kwb_Wu8 255.0 OneToOne 0.00 255.0 FORMAT "%5.1" NUMBER 4 /end CHARACTERISTIC
/begin CHARACTERISTIC DSM_TypDfp_PFltTempDwnStrm_C "Konvertierung der Fehlertypen auf der Diagnoseschnittstelle fuer Fehlerpfad Dfp_PFltTempDwnStrm" VAL_BLK 0xCDE8A Kwb_Wu8 255.0 OneToOne 0.00 255.0 FORMAT "%5.1" NUMBER 4 /end CHARACTERISTIC
/begin CHARACTERISTIC DSM_TypDfp_PFltTempSens_C "Konvertierung der Fehlertypen auf der Diagnoseschnittstelle fuer Fehlerpfad Dfp_PFltTempSens" VAL_BLK 0xCDE8E Kwb_Wu8 255.0 OneToOne 0.00 255.0 FORMAT "%5.1" NUMBER 4 /end CHARACTERISTIC
/begin CHARACTERISTIC DSM_TypDfp_PFltTempUpStrm_C "Konvertierung der Fehlertypen auf der Diagnoseschnittstelle fuer Fehlerpfad Dfp_PFltTempUpStrm" VAL_BLK 0xCDE92 Kwb_Wu8 255.0 OneToOne 0.00 255.0 FORMAT "%5.1" NUMBER 4 /end CHARACTERISTIC
/begin CHARACTERISTIC DSM_TypDfp_PFltmSotDiffMax_C "Konvertierung der Fehlertypen auf der Diagnoseschnittstelle fuer Fehlerpfad Dfp_PFltmSotDiffMax" VAL_BLK 0xCDE96 Kwb_Wu8 255.0 OneToOne 0.00 255.0 FORMAT "%5.1" NUMBER 4 /end CHARACTERISTIC
/begin CHARACTERISTIC DSM_TypDfp_PSPCD_Actr_C "Konvertierung der Fehlertypen auf der Diagnoseschnittstelle fuer Fehlerpfad Dfp_PSPCD_Actr" VAL_BLK 0xCDE9A Kwb_Wu8 255.0 OneToOne 0.00 255.0 FORMAT "%5.1" NUMBER 4 /end CHARACTERISTIC
/begin CHARACTERISTIC DSM_TypDfp_PresPlausDblDef_C "Konvertierung der Fehlertypen auf der Diagnoseschnittstelle fuer Fehlerpfad Dfp_PresPlausDblDef" VAL_BLK 0xCDE9E Kwb_Wu8 255.0 OneToOne 0.00 255.0 FORMAT "%5.1" NUMBER 4 /end CHARACTERISTIC
/begin CHARACTERISTIC DSM_TypDfp_QLTCD_C "Konvertierung der Fehlertypen auf der Diagnoseschnittstelle fuer Fehlerpfad Dfp_QLTCD" VAL_BLK 0xCDEA2 Kwb_Wu8 255.0 OneToOne 0.00 255.0 FORMAT "%5.1" NUMBER 4 /end CHARACTERISTIC
/begin CHARACTERISTIC DSM_TypDfp_RailCD_C "Konvertierung der Fehlertypen auf der Diagnoseschnittstelle fuer Fehlerpfad Dfp_RailCD" VAL_BLK 0xCDEA6 Kwb_Wu8 255.0 OneToOne 0.00 255.0 FORMAT "%5.1" NUMBER 4 /end CHARACTERISTIC
/begin CHARACTERISTIC DSM_TypDfp_RailCDOfsTst_C "Konvertierung der Fehlertypen auf der Diagnoseschnittstelle fuer Fehlerpfad Dfp_RailCDOfsTst" VAL_BLK 0xCDEAA Kwb_Wu8 255.0 OneToOne 0.00 255.0 FORMAT "%5.1" NUMBER 4 /end CHARACTERISTIC
/begin CHARACTERISTIC DSM_TypDfp_RailCD_PMonStrt_C "Konvertierung der Fehlertypen auf der Diagnoseschnittstelle fuer Fehlerpfad Dfp_RailCD_PMonStrt" VAL_BLK 0xCDEAE Kwb_Wu8 255.0 OneToOne 0.00 255.0 FORMAT "%5.1" NUMBER 4 /end CHARACTERISTIC
/begin CHARACTERISTIC DSM_TypDfp_RailCtlModeMeUnDiag_C "Konvertierung der Fehlertypen auf der Diagnoseschnittstelle fuer Fehlerpfad Dfp_RailCtlModeMeUnDiag" VAL_BLK 0xCDEB2 Kwb_Wu8 255.0 OneToOne 0.00 255.0 FORMAT "%5.1" NUMBER 4 /end CHARACTERISTIC
/begin CHARACTERISTIC DSM_TypDfp_RailCtlModePCVDiag_C "Konvertierung der Fehlertypen auf der Diagnoseschnittstelle fuer Fehlerpfad Dfp_RailCtlModePCVDiag" VAL_BLK 0xCDEB6 Kwb_Wu8 255.0 OneToOne 0.00 255.0 FORMAT "%5.1" NUMBER 4 /end CHARACTERISTIC
/begin CHARACTERISTIC DSM_TypDfp_RailMeUn0_C "Konvertierung der Fehlertypen auf der Diagnoseschnittstelle fuer Fehlerpfad Dfp_RailMeUn0" VAL_BLK 0xCDEBA Kwb_Wu8 255.0 OneToOne 0.00 255.0 FORMAT "%5.1" NUMBER 4 /end CHARACTERISTIC
/begin CHARACTERISTIC DSM_TypDfp_RailMeUn1_C "Konvertierung der Fehlertypen auf der Diagnoseschnittstelle fuer Fehlerpfad Dfp_RailMeUn1" VAL_BLK 0xCDEBE Kwb_Wu8 255.0 OneToOne 0.00 255.0 FORMAT "%5.1" NUMBER 4 /end CHARACTERISTIC
/begin CHARACTERISTIC DSM_TypDfp_RailMeUn2_C "Konvertierung der Fehlertypen auf der Diagnoseschnittstelle fuer Fehlerpfad Dfp_RailMeUn2" VAL_BLK 0xCDEC2 Kwb_Wu8 255.0 OneToOne 0.00 255.0 FORMAT "%5.1" NUMBER 4 /end CHARACTERISTIC
/begin CHARACTERISTIC DSM_TypDfp_RailMeUn3_C "Konvertierung der Fehlertypen auf der Diagnoseschnittstelle fuer Fehlerpfad Dfp_RailMeUn3" VAL_BLK 0xCDEC6 Kwb_Wu8 255.0 OneToOne 0.00 255.0 FORMAT "%5.1" NUMBER 4 /end CHARACTERISTIC
/begin CHARACTERISTIC DSM_TypDfp_RailMeUn4_C "Konvertierung der Fehlertypen auf der Diagnoseschnittstelle fuer Fehlerpfad Dfp_RailMeUn4" VAL_BLK 0xCDECA Kwb_Wu8 255.0 OneToOne 0.00 255.0 FORMAT "%5.1" NUMBER 4 /end CHARACTERISTIC
/begin CHARACTERISTIC DSM_TypDfp_RailPCV0_C "Konvertierung der Fehlertypen auf der Diagnoseschnittstelle fuer Fehlerpfad Dfp_RailPCV0" VAL_BLK 0xCDECE Kwb_Wu8 255.0 OneToOne 0.00 255.0 FORMAT "%5.1" NUMBER 4 /end CHARACTERISTIC
/begin CHARACTERISTIC DSM_TypDfp_RailPCV1_C "Konvertierung der Fehlertypen auf der Diagnoseschnittstelle fuer Fehlerpfad Dfp_RailPCV1" VAL_BLK 0xCDED2 Kwb_Wu8 255.0 OneToOne 0.00 255.0 FORMAT "%5.1" NUMBER 4 /end CHARACTERISTIC
/begin CHARACTERISTIC DSM_TypDfp_RailPCV2_C "Konvertierung der Fehlertypen auf der Diagnoseschnittstelle fuer Fehlerpfad Dfp_RailPCV2" VAL_BLK 0xCDED6 Kwb_Wu8 255.0 OneToOne 0.00 255.0 FORMAT "%5.1" NUMBER 4 /end CHARACTERISTIC
/begin CHARACTERISTIC DSM_TypDfp_RailPCV3_C "Konvertierung der Fehlertypen auf der Diagnoseschnittstelle fuer Fehlerpfad Dfp_RailPCV3" VAL_BLK 0xCDEDA Kwb_Wu8 255.0 OneToOne 0.00 255.0 FORMAT "%5.1" NUMBER 4 /end CHARACTERISTIC
/begin CHARACTERISTIC DSM_TypDfp_RailPCV4_C "Konvertierung der Fehlertypen auf der Diagnoseschnittstelle fuer Fehlerpfad Dfp_RailPCV4" VAL_BLK 0xCDEDE Kwb_Wu8 255.0 OneToOne 0.00 255.0 FORMAT "%5.1" NUMBER 4 /end CHARACTERISTIC
/begin CHARACTERISTIC DSM_TypDfp_RailPCV5_C "Konvertierung der Fehlertypen auf der Diagnoseschnittstelle fuer Fehlerpfad Dfp_RailPCV5" VAL_BLK 0xCDEE2 Kwb_Wu8 255.0 OneToOne 0.00 255.0 FORMAT "%5.1" NUMBER 4 /end CHARACTERISTIC
/begin CHARACTERISTIC DSM_TypDfp_SOPTst_C "Konvertierung der Fehlertypen auf der Diagnoseschnittstelle fuer Fehlerpfad Dfp_SOPTst" VAL_BLK 0xCDEE6 Kwb_Wu8 255.0 OneToOne 0.00 255.0 FORMAT "%5.1" NUMBER 4 /end CHARACTERISTIC
/begin CHARACTERISTIC DSM_TypDfp_SSpMon1_C "Konvertierung der Fehlertypen auf der Diagnoseschnittstelle fuer Fehlerpfad Dfp_SSpMon1" VAL_BLK 0xCDEEA Kwb_Wu8 255.0 OneToOne 0.00 255.0 FORMAT "%5.1" NUMBER 4 /end CHARACTERISTIC
/begin CHARACTERISTIC DSM_TypDfp_SSpMon2_C "Konvertierung der Fehlertypen auf der Diagnoseschnittstelle fuer Fehlerpfad Dfp_SSpMon2" VAL_BLK 0xCDEEE Kwb_Wu8 255.0 OneToOne 0.00 255.0 FORMAT "%5.1" NUMBER 4 /end CHARACTERISTIC
/begin CHARACTERISTIC DSM_TypDfp_SSpMon3_C "Konvertierung der Fehlertypen auf der Diagnoseschnittstelle fuer Fehlerpfad Dfp_SSpMon3" VAL_BLK 0xCDEF2 Kwb_Wu8 255.0 OneToOne 0.00 255.0 FORMAT "%5.1" NUMBER 4 /end CHARACTERISTIC
/begin CHARACTERISTIC DSM_TypDfp_SWChk_CycSigChkDat_C "Konvertierung der Fehlertypen auf der Diagnoseschnittstelle fuer Fehlerpfad Dfp_SWChk_CycSigChkDat" VAL_BLK 0xCDEF6 Kwb_Wu8 255.0 OneToOne 0.00 255.0 FORMAT "%5.1" NUMBER 4 /end CHARACTERISTIC
/begin CHARACTERISTIC DSM_TypDfp_SWChk_CycSigChkPrg_C "Konvertierung der Fehlertypen auf der Diagnoseschnittstelle fuer Fehlerpfad Dfp_SWChk_CycSigChkPrg" VAL_BLK 0xCDEFA Kwb_Wu8 255.0 OneToOne 0.00 255.0 FORMAT "%5.1" NUMBER 4 /end CHARACTERISTIC
/begin CHARACTERISTIC DSM_TypDfp_ShutCD_C "Konvertierung der Fehlertypen auf der Diagnoseschnittstelle fuer Fehlerpfad Dfp_ShutCD" VAL_BLK 0xCDEFE Kwb_Wu8 255.0 OneToOne 0.00 255.0 FORMAT "%5.1" NUMBER 4 /end CHARACTERISTIC
/begin CHARACTERISTIC DSM_TypDfp_StSysTrqShutOff_C "Konvertierung der Fehlertypen auf der Diagnoseschnittstelle fuer Fehlerpfad Dfp_StSysTrqShutOff" VAL_BLK 0xCDF02 Kwb_Wu8 255.0 OneToOne 0.00 255.0 FORMAT "%5.1" NUMBER 4 /end CHARACTERISTIC
/begin CHARACTERISTIC DSM_TypDfp_StrtCD_Actr_C "Konvertierung der Fehlertypen auf der Diagnoseschnittstelle fuer Fehlerpfad Dfp_StrtCD_Actr" VAL_BLK 0xCDF06 Kwb_Wu8 255.0 OneToOne 0.00 255.0 FORMAT "%5.1" NUMBER 4 /end CHARACTERISTIC
/begin CHARACTERISTIC DSM_TypDfp_SysLamp_C "Konvertierung der Fehlertypen auf der Diagnoseschnittstelle fuer Fehlerpfad Dfp_SysLamp" VAL_BLK 0xCDF0A Kwb_Wu8 255.0 OneToOne 0.00 255.0 FORMAT "%5.1" NUMBER 4 /end CHARACTERISTIC
/begin CHARACTERISTIC DSM_TypDfp_T15CD_C "Konvertierung der Fehlertypen auf der Diagnoseschnittstelle fuer Fehlerpfad Dfp_T15CD" VAL_BLK 0xCDF0E Kwb_Wu8 255.0 OneToOne 0.00 255.0 FORMAT "%5.1" NUMBER 4 /end CHARACTERISTIC
/begin CHARACTERISTIC DSM_TypDfp_TGearbx_C "Konvertierung der Fehlertypen auf der Diagnoseschnittstelle fuer Fehlerpfad Dfp_TGearbx" VAL_BLK 0xCDF12 Kwb_Wu8 255.0 OneToOne 0.00 255.0 FORMAT "%5.1" NUMBER 4 /end CHARACTERISTIC
/begin CHARACTERISTIC DSM_TypDfp_TPUMon_C "Konvertierung der Fehlertypen auf der Diagnoseschnittstelle fuer Fehlerpfad Dfp_TPUMon" VAL_BLK 0xCDF16 Kwb_Wu8 255.0 OneToOne 0.00 255.0 FORMAT "%5.1" NUMBER 4 /end CHARACTERISTIC
/begin CHARACTERISTIC DSM_TypDfp_TVACD_Max_C "Konvertierung der Fehlertypen auf der Diagnoseschnittstelle fuer Fehlerpfad Dfp_TVACD_Max" VAL_BLK 0xCDF1A Kwb_Wu8 255.0 OneToOne 0.00 255.0 FORMAT "%5.1" NUMBER 4 /end CHARACTERISTIC
/begin CHARACTERISTIC DSM_TypDfp_TVACD_Min_C "Konvertierung der Fehlertypen auf der Diagnoseschnittstelle fuer Fehlerpfad Dfp_TVACD_Min" VAL_BLK 0xCDF1E Kwb_Wu8 255.0 OneToOne 0.00 255.0 FORMAT "%5.1" NUMBER 4 /end CHARACTERISTIC
/begin CHARACTERISTIC DSM_TypDfp_TVACD_SigNpl_C "Konvertierung der Fehlertypen auf der Diagnoseschnittstelle fuer Fehlerpfad Dfp_TVACD_SigNpl" VAL_BLK 0xCDF22 Kwb_Wu8 255.0 OneToOne 0.00 255.0 FORMAT "%5.1" NUMBER 4 /end CHARACTERISTIC
/begin CHARACTERISTIC DSM_TypDfp_TVACD_TVADia1_C "Konvertierung der Fehlertypen auf der Diagnoseschnittstelle fuer Fehlerpfad Dfp_TVACD_TVADia1" VAL_BLK 0xCDF26 Kwb_Wu8 255.0 OneToOne 0.00 255.0 FORMAT "%5.1" NUMBER 4 /end CHARACTERISTIC
/begin CHARACTERISTIC DSM_TypDfp_TVACD_TVADia2_C "Konvertierung der Fehlertypen auf der Diagnoseschnittstelle fuer Fehlerpfad Dfp_TVACD_TVADia2" VAL_BLK 0xCDF2A Kwb_Wu8 255.0 OneToOne 0.00 255.0 FORMAT "%5.1" NUMBER 4 /end CHARACTERISTIC
/begin CHARACTERISTIC DSM_TypDfp_TVACD_TVADia3_C "Konvertierung der Fehlertypen auf der Diagnoseschnittstelle fuer Fehlerpfad Dfp_TVACD_TVADia3" VAL_BLK 0xCDF2E Kwb_Wu8 255.0 OneToOne 0.00 255.0 FORMAT "%5.1" NUMBER 4 /end CHARACTERISTIC
/begin CHARACTERISTIC DSM_TypDfp_TVACD_TVADia4_C "Konvertierung der Fehlertypen auf der Diagnoseschnittstelle fuer Fehlerpfad Dfp_TVACD_TVADia4" VAL_BLK 0xCDF32 Kwb_Wu8 255.0 OneToOne 0.00 255.0 FORMAT "%5.1" NUMBER 4 /end CHARACTERISTIC
/begin CHARACTERISTIC DSM_TypDfp_VSACD_DioInDia1_C "Konvertierung der Fehlertypen auf der Diagnoseschnittstelle fuer Fehlerpfad Dfp_VSACD_DioInDia1" VAL_BLK 0xCDF36 Kwb_Wu8 255.0 OneToOne 0.00 255.0 FORMAT "%5.1" NUMBER 4 /end CHARACTERISTIC
/begin CHARACTERISTIC DSM_TypDfp_VSACD_DioInDia2_C "Konvertierung der Fehlertypen auf der Diagnoseschnittstelle fuer Fehlerpfad Dfp_VSACD_DioInDia2" VAL_BLK 0xCDF3A Kwb_Wu8 255.0 OneToOne 0.00 255.0 FORMAT "%5.1" NUMBER 4 /end CHARACTERISTIC
/begin CHARACTERISTIC DSM_TypDfp_VSACD_DioInDia3_C "Konvertierung der Fehlertypen auf der Diagnoseschnittstelle fuer Fehlerpfad Dfp_VSACD_DioInDia3" VAL_BLK 0xCDF3E Kwb_Wu8 255.0 OneToOne 0.00 255.0 FORMAT "%5.1" NUMBER 4 /end CHARACTERISTIC
/begin CHARACTERISTIC DSM_TypDfp_VSACD_DioInDia4_C "Konvertierung der Fehlertypen auf der Diagnoseschnittstelle fuer Fehlerpfad Dfp_VSACD_DioInDia4" VAL_BLK 0xCDF42 Kwb_Wu8 255.0 OneToOne 0.00 255.0 FORMAT "%5.1" NUMBER 4 /end CHARACTERISTIC
/begin CHARACTERISTIC DSM_TypDfp_VSACD_DioInMin_C "Konvertierung der Fehlertypen auf der Diagnoseschnittstelle fuer Fehlerpfad Dfp_VSACD_DioInMin" VAL_BLK 0xCDF46 Kwb_Wu8 255.0 OneToOne 0.00 255.0 FORMAT "%5.1" NUMBER 4 /end CHARACTERISTIC
/begin CHARACTERISTIC DSM_TypDfp_VSACD_Max_C "Konvertierung der Fehlertypen auf der Diagnoseschnittstelle fuer Fehlerpfad Dfp_VSACD_Max" VAL_BLK 0xCDF4A Kwb_Wu8 255.0 OneToOne 0.00 255.0 FORMAT "%5.1" NUMBER 4 /end CHARACTERISTIC
/begin CHARACTERISTIC DSM_TypDfp_VSACD_Min_C "Konvertierung der Fehlertypen auf der Diagnoseschnittstelle fuer Fehlerpfad Dfp_VSACD_Min" VAL_BLK 0xCDF4E Kwb_Wu8 255.0 OneToOne 0.00 255.0 FORMAT "%5.1" NUMBER 4 /end CHARACTERISTIC
/begin CHARACTERISTIC DSM_TypDfp_VSACD_SigNpl_C "Konvertierung der Fehlertypen auf der Diagnoseschnittstelle fuer Fehlerpfad Dfp_VSACD_SigNpl" VAL_BLK 0xCDF52 Kwb_Wu8 255.0 OneToOne 0.00 255.0 FORMAT "%5.1" NUMBER 4 /end CHARACTERISTIC
/begin CHARACTERISTIC DSM_TypDfp_VSACD_VSADia1_C "Konvertierung der Fehlertypen auf der Diagnoseschnittstelle fuer Fehlerpfad Dfp_VSACD_VSADia1" VAL_BLK 0xCDF56 Kwb_Wu8 255.0 OneToOne 0.00 255.0 FORMAT "%5.1" NUMBER 4 /end CHARACTERISTIC
/begin CHARACTERISTIC DSM_TypDfp_VSACD_VSADia2_C "Konvertierung der Fehlertypen auf der Diagnoseschnittstelle fuer Fehlerpfad Dfp_VSACD_VSADia2" VAL_BLK 0xCDF5A Kwb_Wu8 255.0 OneToOne 0.00 255.0 FORMAT "%5.1" NUMBER 4 /end CHARACTERISTIC
/begin CHARACTERISTIC DSM_TypDfp_VSACD_VSADia3_C "Konvertierung der Fehlertypen auf der Diagnoseschnittstelle fuer Fehlerpfad Dfp_VSACD_VSADia3" VAL_BLK 0xCDF5E Kwb_Wu8 255.0 OneToOne 0.00 255.0 FORMAT "%5.1" NUMBER 4 /end CHARACTERISTIC
/begin CHARACTERISTIC DSM_TypDfp_VSACD_VSADia4_C "Konvertierung der Fehlertypen auf der Diagnoseschnittstelle fuer Fehlerpfad Dfp_VSACD_VSADia4" VAL_BLK 0xCDF62 Kwb_Wu8 255.0 OneToOne 0.00 255.0 FORMAT "%5.1" NUMBER 4 /end CHARACTERISTIC
/begin CHARACTERISTIC DSM_TypDfp_VSSCD1_C "Konvertierung der Fehlertypen auf der Diagnoseschnittstelle fuer Fehlerpfad Dfp_VSSCD1" VAL_BLK 0xCDF66 Kwb_Wu8 255.0 OneToOne 0.00 255.0 FORMAT "%5.1" NUMBER 4 /end CHARACTERISTIC
/begin CHARACTERISTIC DSM_TypDfp_VSSCD2_C "Konvertierung der Fehlertypen auf der Diagnoseschnittstelle fuer Fehlerpfad Dfp_VSSCD2" VAL_BLK 0xCDF6A Kwb_Wu8 255.0 OneToOne 0.00 255.0 FORMAT "%5.1" NUMBER 4 /end CHARACTERISTIC
/begin CHARACTERISTIC DSM_TypDfp_WdCom_C "Konvertierung der Fehlertypen auf der Diagnoseschnittstelle fuer Fehlerpfad Dfp_WdCom" VAL_BLK 0xCDF6E Kwb_Wu8 255.0 OneToOne 0.00 255.0 FORMAT "%5.1" NUMBER 4 /end CHARACTERISTIC
/begin FUNCTION dsm_auto_sdw ""
 /begin DEF_CHARACTERISTIC DSM_SdwDfp_Layer_TANS_C DSM_SdwDfp_ACCDCmpr_C DSM_SdwDfp_ACCDPres_C DSM_SdwDfp_ACCDPres1_C DSM_SdwDfp_ACCDPresAna_C DSM_SdwDfp_ACCDSwtin_C DSM_SdwDfp_ACC_PlausTrqDes_C DSM_SdwDfp_ACC_trqInr_C DSM_SdwDfp_ACTrq_C DSM_SdwDfp_ADCMon_C DSM_SdwDfp_AFSCDIdlAdjVal_C DSM_SdwDfp_AFSCDLdAdjVal_C DSM_SdwDfp_AFSCD_AirTempDcyc_C DSM_SdwDfp_AFSCD_PlOffsDrft_C DSM_SdwDfp_AFSCD_PlSetyDrft_C DSM_SdwDfp_AFSCD_SRCAirTemp_C DSM_SdwDfp_AFSCD_SRCBatt_C DSM_SdwDfp_AFSCD_SRCCorrAirm_C DSM_SdwDfp_AFSCD_SRCRawAirm_C DSM_SdwDfp_Layer_TUMG_C DSM_SdwDfp_AFSCD_SRCRefSigPer_C DSM_SdwDfp_AOHtCD_C DSM_SdwDfp_Layer_GEN_C DSM_SdwDfp_Layer_BSD_C DSM_SdwDfp_AOHtCD_AOHtDia1_C DSM_SdwDfp_AOHtCD_AOHtDia2_C DSM_SdwDfp_AOHtCD_AOHtDia3_C DSM_SdwDfp_APP1_C DSM_SdwDfp_APP2_C DSM_SdwDfp_APPSync_C DSM_SdwDfp_APSCD_C DSM_SdwDfp_ARS_C DSM_SdwDfp_AccPedPlausBrk_C DSM_SdwDfp_AirCtlGvnrDvtRgnMax_C DSM_SdwDfp_Layer_QLT_C DSM_SdwDfp_AirCtlGvnrDvtRgnMax2_C DSM_SdwDfp_Layer_IBS1_C DSM_SdwDfp_Layer_IBS2_C DSM_SdwDfp_Layer_IBS3_C DSM_SdwDfp_Layer_PMBN_C DSM_SdwDfp_Layer_PMBATT_C DSM_SdwDfp_AirCtlGvnrDvtRgnMin_C DSM_SdwDfp_AirCtlGvnrDvtRgnMin2_C DSM_SdwDfp_AirCtlPlateBreak_C DSM_SdwDfp_AirCtlRmpTO_C DSM_SdwDfp_AirCtl_GovNegDev_C DSM_SdwDfp_AirCtl_GovNegDev2_C DSM_SdwDfp_AirCtl_GovPosDev_C DSM_SdwDfp_AirCtl_GovPosDev2_C DSM_SdwDfp_AltCD_C DSM_SdwDfp_AltCD_Load_C DSM_SdwDfp_BPACD_BPADia1_C DSM_SdwDfp_BPACD_BPADia2_C DSM_SdwDfp_BPACD_BPADia3_C DSM_SdwDfp_BPACD_Max_C DSM_SdwDfp_BPACD_Min_C DSM_SdwDfp_BPACD_SigNpl_C DSM_SdwDfp_BPSCD_C DSM_SdwDfp_BattCD_C DSM_SdwDfp_BrkCD_C DSM_SdwDfp_Bss_C DSM_SdwDfp_CBACD_C DSM_SdwDfp_CTSCD_C DSM_SdwDfp_Clg_DynTst_C DSM_SdwDfp_CmbChbMisfire1_C DSM_SdwDfp_CmbChbMisfire2_C DSM_SdwDfp_CmbChbMisfire3_C DSM_SdwDfp_CmbChbMisfire4_C DSM_SdwDfp_CmbChbMisfire5_C DSM_SdwDfp_CmbChbMisfire6_C DSM_SdwDfp_CmbChbMisfireMul_C DSM_SdwDfp_CoVMDCSh_C DSM_SdwDfp_ConvCD_C DSM_SdwDfp_Layer_PMRUHVERL_C DSM_SdwDfp_CrCCDMFL_C DSM_SdwDfp_CrCtl_vCrCtl_C DSM_SdwDfp_DCC_PlausTrqDes_C DSM_SdwDfp_Dummy1_C DSM_SdwDfp_Layer_TOENS_C DSM_SdwDfp_Layer_MANHYDR_C DSM_SdwDfp_Layer_MANLUFT_C DSM_SdwDfp_EATSCD_C DSM_SdwDfp_EBAFCD_C DSM_SdwDfp_EBFCD_C DSM_SdwDfp_EBTSCD_C DSM_SdwDfp_EBTSCD_OvrTemp_C DSM_SdwDfp_EEPCDVarMng_C DSM_SdwDfp_EGPpCD_C DSM_SdwDfp_EGPpCDTPreTrbn_C DSM_SdwDfp_EGRCD_Max_C DSM_SdwDfp_EGRCD_Min_C DSM_SdwDfp_EGRCD_SigNpl_C DSM_SdwDfp_EGTRgnOilDil_C DSM_SdwDfp_EMCCDNoLoad1_C DSM_SdwDfp_EMCCDNoLoad2_C DSM_SdwDfp_EMCCDSCBat1_C DSM_SdwDfp_EMCCDSCBat2_C DSM_SdwDfp_EMCCDSCGnd1_C DSM_SdwDfp_EMCCDSCGnd2_C DSM_SdwDfp_EMCCD_ADC1_C DSM_SdwDfp_EMCCD_ADC2_C DSM_SdwDfp_ETClbETFltInj1_C DSM_SdwDfp_ETClbETFltInj2_C DSM_SdwDfp_ETClbETFltInj3_C DSM_SdwDfp_ETClbETFltInj4_C DSM_SdwDfp_ETClbETFltInj5_C DSM_SdwDfp_ETClbETFltInj6_C DSM_SdwDfp_ETClbInj1_C DSM_SdwDfp_ETClbInj2_C DSM_SdwDfp_ETClbInj3_C DSM_SdwDfp_ETClbInj4_C DSM_SdwDfp_ETClbInj5_C DSM_SdwDfp_ETClbInj6_C DSM_SdwDfp_EngMCaS1_C DSM_SdwDfp_EngMCrS1_C DSM_SdwDfp_EngMOfsCaSCrS_C DSM_SdwDfp_EngPrtFWODet_C DSM_SdwDfp_FBCqDvt_C DSM_SdwDfp_FMTC_NonMonotonMap_C DSM_SdwDfp_FTSCD_C DSM_SdwDfp_FanCD_C DSM_SdwDfp_FanCD_FanCtlr1_C DSM_SdwDfp_FanCD_FanCtlr2_C DSM_SdwDfp_FanCD_FanCtlr3_C DSM_SdwDfp_FlFCD_C DSM_SdwDfp_FlMngSmkDefect_C DSM_SdwDfp_FrmMngANFRADMOMPT_C DSM_SdwDfp_FrmMngASC1_C DSM_SdwDfp_FrmMngASC2_C DSM_SdwDfp_FrmMngASC3_C DSM_SdwDfp_FrmMngASC4_C DSM_SdwDfp_FrmMngBOS_RESET_C DSM_SdwDfp_FrmMngBOS_RESET_2_C DSM_SdwDfp_FrmMngDMANFAFS_C DSM_SdwDfp_FrmMngDRMANFSSG_C DSM_SdwDfp_FrmMngEGS1_C DSM_SdwDfp_FrmMngEGS2_C DSM_SdwDfp_FrmMngGEARBX_DATA_C DSM_SdwDfp_FrmMngGEARBX_DATA2_C DSM_SdwDfp_FrmMngHEAT_AC_C DSM_SdwDfp_FrmMngINSTR2_C DSM_SdwDfp_FrmMngINSTR3_C DSM_SdwDfp_FrmMngLENKRADWINKEL_C DSM_SdwDfp_FrmMngMILEAGE_RANGE_C DSM_SdwDfp_FrmMngOPCRCTLACC_C DSM_SdwDfp_FrmMngPRGG_CCTR_C DSM_SdwDfp_FrmMngPWRMNG_LOADV_C DSM_SdwDfp_FrmMngParkConsumer_C DSM_SdwDfp_FrmMngRQSTGEFAN_C DSM_SdwDfp_FrmMngSSGErr_C DSM_SdwDfp_FrmMngSSGShOff_C DSM_SdwDfp_FrmMngSTAT_ANH_C DSM_SdwDfp_FrmMngSTAT_ARS_C DSM_SdwDfp_FrmMngSTAT_DSC_C DSM_SdwDfp_FrmMngSTAT_EKP_C DSM_SdwDfp_FrmMngSTAT_KOMBI_C DSM_SdwDfp_FrmMngSTAT_SITZ_C DSM_SdwDfp_FrmMngStOBDGbxMilOf_C DSM_SdwDfp_FrmMngStOBDGbxMilOn_C DSM_SdwDfp_FrmMngTEMPRELTIME_C DSM_SdwDfp_FrmMngTERMINAL_C DSM_SdwDfp_FrmMngTIME_DATE_C DSM_SdwDfp_FrmMngTORQUE_DSC_C DSM_SdwDfp_FrmMngTORQUE_GEARBX_C DSM_SdwDfp_FrmMngTrq_ReqACC_C DSM_SdwDfp_FrmMngVEH_MOD_C DSM_SdwDfp_FrmMngVELOCITY_C DSM_SdwDfp_FrmMngWHEEL_SPEED_C DSM_SdwDfp_FrmMngstCurr_C DSM_SdwDfp_FrmMngswtPSPOff_C DSM_SdwDfp_GearbxIncMax_C DSM_SdwDfp_GlwCD_C DSM_SdwDfp_GlwCDGlwCirc1_C DSM_SdwDfp_GlwCDGlwCirc2_C DSM_SdwDfp_GlwCDGlwCirc3_C DSM_SdwDfp_GlwCDGlwCirc4_C DSM_SdwDfp_GlwCDGlwCirc5_C DSM_SdwDfp_GlwCDGlwCirc6_C DSM_SdwDfp_GlwCDGlwCirc7_C DSM_SdwDfp_GlwCDGlwCirc8_C DSM_SdwDfp_GlwCtl_C DSM_SdwDfp_HWEMonCom_C DSM_SdwDfp_HWEMonEEPROM_C DSM_SdwDfp_HWEMonRcyLocked_C DSM_SdwDfp_HWEMonRcySuppressed_C DSM_SdwDfp_HWEMonRcyVisible_C DSM_SdwDfp_HWEMonUMaxSupply_C DSM_SdwDfp_HWEMonUMinSupply_C DSM_SdwDfp_IATSCD_C DSM_SdwDfp_IATSCD_CATS_C DSM_SdwDfp_ImmCtlImmCD_C DSM_SdwDfp_ImmCtlImmEep_C DSM_SdwDfp_ImmCtlMpl_C DSM_SdwDfp_IndSys1_C DSM_SdwDfp_IndSys2_C DSM_SdwDfp_InjCrv_InjLim_C DSM_SdwDfp_InjCtlAdjQnt_C DSM_SdwDfp_InjCtlDrift_C DSM_SdwDfp_InjVCDActrChrg_C DSM_SdwDfp_InjVCDActrEnrg1_C DSM_SdwDfp_InjVCDActrEnrg2_C DSM_SdwDfp_InjVCDActrEnrg3_C DSM_SdwDfp_InjVCDActrEnrg4_C DSM_SdwDfp_InjVCDActrEnrg5_C DSM_SdwDfp_InjVCDActrEnrg6_C DSM_SdwDfp_InjVCDActrEnrg7_C DSM_SdwDfp_InjVCDActrEnrg8_C DSM_SdwDfp_InjVCDActrVolt_C DSM_SdwDfp_InjVCDClsBank1_C DSM_SdwDfp_InjVCDClsBank2_C DSM_SdwDfp_InjVCDMonCab_C DSM_SdwDfp_InjVCDMonSwt_C DSM_SdwDfp_InjVCDShOffDCDC_C DSM_SdwDfp_InjVCDUBuf_C DSM_SdwDfp_InjVCD_CY370Ampl_C DSM_SdwDfp_InjVlvBnk1A_C DSM_SdwDfp_InjVlvBnk1B_C DSM_SdwDfp_InjVlvBnk2A_C DSM_SdwDfp_InjVlvBnk2B_C DSM_SdwDfp_InjVlvChipA_C DSM_SdwDfp_InjVlvChipB_C DSM_SdwDfp_InjVlvCyl1A_C DSM_SdwDfp_InjVlvCyl1B_C DSM_SdwDfp_InjVlvCyl1C_C DSM_SdwDfp_InjVlvCyl2A_C DSM_SdwDfp_InjVlvCyl2B_C DSM_SdwDfp_InjVlvCyl2C_C DSM_SdwDfp_InjVlvCyl3A_C DSM_SdwDfp_InjVlvCyl3B_C DSM_SdwDfp_InjVlvCyl3C_C DSM_SdwDfp_InjVlvCyl4A_C DSM_SdwDfp_InjVlvCyl4B_C DSM_SdwDfp_InjVlvCyl4C_C DSM_SdwDfp_InjVlvCyl5A_C DSM_SdwDfp_InjVlvCyl5B_C DSM_SdwDfp_InjVlvCyl5C_C DSM_SdwDfp_InjVlvCyl6A_C DSM_SdwDfp_InjVlvCyl6B_C DSM_SdwDfp_InjVlvCyl6C_C DSM_SdwDfp_InjVlvCyl7A_C DSM_SdwDfp_InjVlvCyl7B_C DSM_SdwDfp_InjVlvCyl7C_C DSM_SdwDfp_InjVlvCyl8A_C DSM_SdwDfp_InjVlvCyl8B_C DSM_SdwDfp_InjVlvCyl8C_C DSM_SdwDfp_InjVlvNVC1_C DSM_SdwDfp_InjVlvNVC2_C DSM_SdwDfp_InjVlvNVC3_C DSM_SdwDfp_InjVlvNVC4_C DSM_SdwDfp_InjVlvNVC5_C DSM_SdwDfp_InjVlvNVC6_C DSM_SdwDfp_InjVlvNVC7_C DSM_SdwDfp_InjVlvNVC8_C DSM_SdwDfp_LPACD_Max_C DSM_SdwDfp_LPACD_Min_C DSM_SdwDfp_LPACD_SigNpl_C DSM_SdwDfp_LSUCDCircNernst0_C DSM_SdwDfp_LSUCDCircPumpCur0_C DSM_SdwDfp_LSUCDCircVirtGnd0_C DSM_SdwDfp_LSUCDHeater0_C DSM_SdwDfp_LSUCDHtCoup0_C DSM_SdwDfp_LSUCDO20_C DSM_SdwDfp_LSUCDO2Clb0_C DSM_SdwDfp_LSUCDRiClb0_C DSM_SdwDfp_LSUCDSPI0_C DSM_SdwDfp_LSUCDSPIBattLow0_C DSM_SdwDfp_LSUCDWireIP0_C DSM_SdwDfp_LSUCtlRiExc0_C DSM_SdwDfp_LSUMon1Sens_C DSM_SdwDfp_LSUMon2Sens_C DSM_SdwDfp_MIL_C DSM_SdwDfp_MRlyCD_C DSM_SdwDfp_MSidCD_Comm_C DSM_SdwDfp_MSidCD_Pin_C DSM_SdwDfp_MSidCD_Sel_INI_C DSM_SdwDfp_MSidCD_Select_C DSM_SdwDfp_MeUnCDNoLoad_C DSM_SdwDfp_MeUnCDSCBat_C DSM_SdwDfp_MeUnCDSCGnd_C DSM_SdwDfp_MeUnCD_ADC_C DSM_SdwDfp_MeUnCD_SigTst_C DSM_SdwDfp_Montr_C DSM_SdwDfp_NetMngDeviceA_C DSM_SdwDfp_NetMngDeviceB_C DSM_SdwDfp_NetMngDeviceC_C DSM_SdwDfp_OPSCD_Lamp_C DSM_SdwDfp_OPSCD_anain_C DSM_SdwDfp_OTSCD_C DSM_SdwDfp_OvRMon_C DSM_SdwDfp_OvRMonBrk_C DSM_SdwDfp_OvRMonSigA_C DSM_SdwDfp_OxiCCDTPre_C DSM_SdwDfp_PCR_GovDevNeg_C DSM_SdwDfp_PCR_GovDevPos_C DSM_SdwDfp_PCR_LPGvnrDvtNeg_C DSM_SdwDfp_PCR_LPGvnrDvtPos_C DSM_SdwDfp_PCVCDNoLoad_C DSM_SdwDfp_PCVCDSCBat_C DSM_SdwDfp_PCVCDSCGnd_C DSM_SdwDfp_PCVCD_ADC_C DSM_SdwDfp_PCVCD_SigTst_C DSM_SdwDfp_PFltAPSPlaus_C DSM_SdwDfp_PFltAPSens_C DSM_SdwDfp_PFltBPSPlaus_C DSM_SdwDfp_PFltCDPPre_C DSM_SdwDfp_PFltCDTempPre_C DSM_SdwDfp_PFltChar_C DSM_SdwDfp_PFltEngPrt_C DSM_SdwDfp_PFltPresDynPlaus_C DSM_SdwDfp_PFltPresPlaus_C DSM_SdwDfp_PFltPresSens_C DSM_SdwDfp_PFltPresSensFrz_C DSM_SdwDfp_PFltPresSensHsLn_C DSM_SdwDfp_PFltPresSensSot_C DSM_SdwDfp_PFltRgnPerm_C DSM_SdwDfp_PFltTempDwnStrm_C DSM_SdwDfp_PFltTempSens_C DSM_SdwDfp_PFltTempUpStrm_C DSM_SdwDfp_PFltmSotDiffMax_C DSM_SdwDfp_PSPCD_Actr_C DSM_SdwDfp_PresPlausDblDef_C DSM_SdwDfp_QLTCD_C DSM_SdwDfp_RailCD_C DSM_SdwDfp_RailCDOfsTst_C DSM_SdwDfp_RailCD_PMonStrt_C DSM_SdwDfp_RailCtlModeMeUnDiag_C DSM_SdwDfp_RailCtlModePCVDiag_C DSM_SdwDfp_RailMeUn0_C DSM_SdwDfp_RailMeUn1_C DSM_SdwDfp_RailMeUn2_C DSM_SdwDfp_RailMeUn3_C DSM_SdwDfp_RailMeUn4_C DSM_SdwDfp_RailPCV0_C DSM_SdwDfp_RailPCV1_C DSM_SdwDfp_RailPCV2_C DSM_SdwDfp_RailPCV3_C DSM_SdwDfp_RailPCV4_C DSM_SdwDfp_RailPCV5_C DSM_SdwDfp_SOPTst_C DSM_SdwDfp_SSpMon1_C DSM_SdwDfp_SSpMon2_C DSM_SdwDfp_SSpMon3_C DSM_SdwDfp_SWChk_CycSigChkDat_C DSM_SdwDfp_SWChk_CycSigChkPrg_C DSM_SdwDfp_ShutCD_C DSM_SdwDfp_StSysTrqShutOff_C DSM_SdwDfp_StrtCD_Actr_C DSM_SdwDfp_SysLamp_C DSM_SdwDfp_T15CD_C DSM_SdwDfp_TGearbx_C DSM_SdwDfp_TPUMon_C DSM_SdwDfp_TVACD_Max_C DSM_SdwDfp_TVACD_Min_C DSM_SdwDfp_TVACD_SigNpl_C DSM_SdwDfp_TVACD_TVADia1_C DSM_SdwDfp_TVACD_TVADia2_C DSM_SdwDfp_TVACD_TVADia3_C DSM_SdwDfp_TVACD_TVADia4_C DSM_SdwDfp_VSACD_DioInDia1_C DSM_SdwDfp_VSACD_DioInDia2_C DSM_SdwDfp_VSACD_DioInDia3_C DSM_SdwDfp_VSACD_DioInDia4_C DSM_SdwDfp_VSACD_DioInMin_C DSM_SdwDfp_VSACD_Max_C DSM_SdwDfp_VSACD_Min_C DSM_SdwDfp_VSACD_SigNpl_C DSM_SdwDfp_VSACD_VSADia1_C DSM_SdwDfp_VSACD_VSADia2_C DSM_SdwDfp_VSACD_VSADia3_C DSM_SdwDfp_VSACD_VSADia4_C DSM_SdwDfp_VSSCD1_C DSM_SdwDfp_VSSCD2_C DSM_SdwDfp_WdCom_C /end DEF_CHARACTERISTIC
/end FUNCTION
/begin FUNCTION dsm_auto_trans ""
 /begin DEF_CHARACTERISTIC DSM_TypDfp_Layer_TANS_C DSM_TypDfp_ACCDCmpr_C DSM_TypDfp_ACCDPres_C DSM_TypDfp_ACCDPres1_C DSM_TypDfp_ACCDPresAna_C DSM_TypDfp_ACCDSwtin_C DSM_TypDfp_ACC_PlausTrqDes_C DSM_TypDfp_ACC_trqInr_C DSM_TypDfp_ACTrq_C DSM_TypDfp_ADCMon_C DSM_TypDfp_AFSCDIdlAdjVal_C DSM_TypDfp_AFSCDLdAdjVal_C DSM_TypDfp_AFSCD_AirTempDcyc_C DSM_TypDfp_AFSCD_PlOffsDrft_C DSM_TypDfp_AFSCD_PlSetyDrft_C DSM_TypDfp_AFSCD_SRCAirTemp_C DSM_TypDfp_AFSCD_SRCBatt_C DSM_TypDfp_AFSCD_SRCCorrAirm_C DSM_TypDfp_AFSCD_SRCRawAirm_C DSM_TypDfp_Layer_TUMG_C DSM_TypDfp_AFSCD_SRCRefSigPer_C DSM_TypDfp_AOHtCD_C DSM_TypDfp_Layer_GEN_C DSM_TypDfp_Layer_BSD_C DSM_TypDfp_AOHtCD_AOHtDia1_C DSM_TypDfp_AOHtCD_AOHtDia2_C DSM_TypDfp_AOHtCD_AOHtDia3_C DSM_TypDfp_APP1_C DSM_TypDfp_APP2_C DSM_TypDfp_APPSync_C DSM_TypDfp_APSCD_C DSM_TypDfp_ARS_C DSM_TypDfp_AccPedPlausBrk_C DSM_TypDfp_AirCtlGvnrDvtRgnMax_C DSM_TypDfp_Layer_QLT_C DSM_TypDfp_AirCtlGvnrDvtRgnMax2_C DSM_TypDfp_Layer_IBS1_C DSM_TypDfp_Layer_IBS2_C DSM_TypDfp_Layer_IBS3_C DSM_TypDfp_Layer_PMBN_C DSM_TypDfp_Layer_PMBATT_C DSM_TypDfp_AirCtlGvnrDvtRgnMin_C DSM_TypDfp_AirCtlGvnrDvtRgnMin2_C DSM_TypDfp_AirCtlPlateBreak_C DSM_TypDfp_AirCtlRmpTO_C DSM_TypDfp_AirCtl_GovNegDev_C DSM_TypDfp_AirCtl_GovNegDev2_C DSM_TypDfp_AirCtl_GovPosDev_C DSM_TypDfp_AirCtl_GovPosDev2_C DSM_TypDfp_AltCD_C DSM_TypDfp_AltCD_Load_C DSM_TypDfp_BPACD_BPADia1_C DSM_TypDfp_BPACD_BPADia2_C DSM_TypDfp_BPACD_BPADia3_C DSM_TypDfp_BPACD_Max_C DSM_TypDfp_BPACD_Min_C DSM_TypDfp_BPACD_SigNpl_C DSM_TypDfp_BPSCD_C DSM_TypDfp_BattCD_C DSM_TypDfp_BrkCD_C DSM_TypDfp_Bss_C DSM_TypDfp_CBACD_C DSM_TypDfp_CTSCD_C DSM_TypDfp_Clg_DynTst_C DSM_TypDfp_CmbChbMisfire1_C DSM_TypDfp_CmbChbMisfire2_C DSM_TypDfp_CmbChbMisfire3_C DSM_TypDfp_CmbChbMisfire4_C DSM_TypDfp_CmbChbMisfire5_C DSM_TypDfp_CmbChbMisfire6_C DSM_TypDfp_CmbChbMisfireMul_C DSM_TypDfp_CoVMDCSh_C DSM_TypDfp_ConvCD_C DSM_TypDfp_Layer_PMRUHVERL_C DSM_TypDfp_CrCCDMFL_C DSM_TypDfp_CrCtl_vCrCtl_C DSM_TypDfp_DCC_PlausTrqDes_C DSM_TypDfp_Dummy1_C DSM_TypDfp_Layer_TOENS_C DSM_TypDfp_Layer_MANHYDR_C DSM_TypDfp_Layer_MANLUFT_C DSM_TypDfp_EATSCD_C DSM_TypDfp_EBAFCD_C DSM_TypDfp_EBFCD_C DSM_TypDfp_EBTSCD_C DSM_TypDfp_EBTSCD_OvrTemp_C DSM_TypDfp_EEPCDVarMng_C DSM_TypDfp_EGPpCD_C DSM_TypDfp_EGPpCDTPreTrbn_C DSM_TypDfp_EGRCD_Max_C DSM_TypDfp_EGRCD_Min_C DSM_TypDfp_EGRCD_SigNpl_C DSM_TypDfp_EGTRgnOilDil_C DSM_TypDfp_EMCCDNoLoad1_C DSM_TypDfp_EMCCDNoLoad2_C DSM_TypDfp_EMCCDSCBat1_C DSM_TypDfp_EMCCDSCBat2_C DSM_TypDfp_EMCCDSCGnd1_C DSM_TypDfp_EMCCDSCGnd2_C DSM_TypDfp_EMCCD_ADC1_C DSM_TypDfp_EMCCD_ADC2_C DSM_TypDfp_ETClbETFltInj1_C DSM_TypDfp_ETClbETFltInj2_C DSM_TypDfp_ETClbETFltInj3_C DSM_TypDfp_ETClbETFltInj4_C DSM_TypDfp_ETClbETFltInj5_C DSM_TypDfp_ETClbETFltInj6_C DSM_TypDfp_ETClbInj1_C DSM_TypDfp_ETClbInj2_C DSM_TypDfp_ETClbInj3_C DSM_TypDfp_ETClbInj4_C DSM_TypDfp_ETClbInj5_C DSM_TypDfp_ETClbInj6_C DSM_TypDfp_EngMCaS1_C DSM_TypDfp_EngMCrS1_C DSM_TypDfp_EngMOfsCaSCrS_C DSM_TypDfp_EngPrtFWODet_C DSM_TypDfp_FBCqDvt_C DSM_TypDfp_FMTC_NonMonotonMap_C DSM_TypDfp_FTSCD_C DSM_TypDfp_FanCD_C DSM_TypDfp_FanCD_FanCtlr1_C DSM_TypDfp_FanCD_FanCtlr2_C DSM_TypDfp_FanCD_FanCtlr3_C DSM_TypDfp_FlFCD_C DSM_TypDfp_FlMngSmkDefect_C DSM_TypDfp_FrmMngANFRADMOMPT_C DSM_TypDfp_FrmMngASC1_C DSM_TypDfp_FrmMngASC2_C DSM_TypDfp_FrmMngASC3_C DSM_TypDfp_FrmMngASC4_C DSM_TypDfp_FrmMngBOS_RESET_C DSM_TypDfp_FrmMngBOS_RESET_2_C DSM_TypDfp_FrmMngDMANFAFS_C DSM_TypDfp_FrmMngDRMANFSSG_C DSM_TypDfp_FrmMngEGS1_C DSM_TypDfp_FrmMngEGS2_C DSM_TypDfp_FrmMngGEARBX_DATA_C DSM_TypDfp_FrmMngGEARBX_DATA2_C DSM_TypDfp_FrmMngHEAT_AC_C DSM_TypDfp_FrmMngINSTR2_C DSM_TypDfp_FrmMngINSTR3_C DSM_TypDfp_FrmMngLENKRADWINKEL_C DSM_TypDfp_FrmMngMILEAGE_RANGE_C DSM_TypDfp_FrmMngOPCRCTLACC_C DSM_TypDfp_FrmMngPRGG_CCTR_C DSM_TypDfp_FrmMngPWRMNG_LOADV_C DSM_TypDfp_FrmMngParkConsumer_C DSM_TypDfp_FrmMngRQSTGEFAN_C DSM_TypDfp_FrmMngSSGErr_C DSM_TypDfp_FrmMngSSGShOff_C DSM_TypDfp_FrmMngSTAT_ANH_C DSM_TypDfp_FrmMngSTAT_ARS_C DSM_TypDfp_FrmMngSTAT_DSC_C DSM_TypDfp_FrmMngSTAT_EKP_C DSM_TypDfp_FrmMngSTAT_KOMBI_C DSM_TypDfp_FrmMngSTAT_SITZ_C DSM_TypDfp_FrmMngStOBDGbxMilOf_C DSM_TypDfp_FrmMngStOBDGbxMilOn_C DSM_TypDfp_FrmMngTEMPRELTIME_C DSM_TypDfp_FrmMngTERMINAL_C DSM_TypDfp_FrmMngTIME_DATE_C DSM_TypDfp_FrmMngTORQUE_DSC_C DSM_TypDfp_FrmMngTORQUE_GEARBX_C DSM_TypDfp_FrmMngTrq_ReqACC_C DSM_TypDfp_FrmMngVEH_MOD_C DSM_TypDfp_FrmMngVELOCITY_C DSM_TypDfp_FrmMngWHEEL_SPEED_C DSM_TypDfp_FrmMngstCurr_C DSM_TypDfp_FrmMngswtPSPOff_C DSM_TypDfp_GearbxIncMax_C DSM_TypDfp_GlwCD_C DSM_TypDfp_GlwCDGlwCirc1_C DSM_TypDfp_GlwCDGlwCirc2_C DSM_TypDfp_GlwCDGlwCirc3_C DSM_TypDfp_GlwCDGlwCirc4_C DSM_TypDfp_GlwCDGlwCirc5_C DSM_TypDfp_GlwCDGlwCirc6_C DSM_TypDfp_GlwCDGlwCirc7_C DSM_TypDfp_GlwCDGlwCirc8_C DSM_TypDfp_GlwCtl_C DSM_TypDfp_HWEMonCom_C DSM_TypDfp_HWEMonEEPROM_C DSM_TypDfp_HWEMonRcyLocked_C DSM_TypDfp_HWEMonRcySuppressed_C DSM_TypDfp_HWEMonRcyVisible_C DSM_TypDfp_HWEMonUMaxSupply_C DSM_TypDfp_HWEMonUMinSupply_C DSM_TypDfp_IATSCD_C DSM_TypDfp_IATSCD_CATS_C DSM_TypDfp_ImmCtlImmCD_C DSM_TypDfp_ImmCtlImmEep_C DSM_TypDfp_ImmCtlMpl_C DSM_TypDfp_IndSys1_C DSM_TypDfp_IndSys2_C DSM_TypDfp_InjCrv_InjLim_C DSM_TypDfp_InjCtlAdjQnt_C DSM_TypDfp_InjCtlDrift_C DSM_TypDfp_InjVCDActrChrg_C DSM_TypDfp_InjVCDActrEnrg1_C DSM_TypDfp_InjVCDActrEnrg2_C DSM_TypDfp_InjVCDActrEnrg3_C DSM_TypDfp_InjVCDActrEnrg4_C DSM_TypDfp_InjVCDActrEnrg5_C DSM_TypDfp_InjVCDActrEnrg6_C DSM_TypDfp_InjVCDActrEnrg7_C DSM_TypDfp_InjVCDActrEnrg8_C DSM_TypDfp_InjVCDActrVolt_C DSM_TypDfp_InjVCDClsBank1_C DSM_TypDfp_InjVCDClsBank2_C DSM_TypDfp_InjVCDMonCab_C DSM_TypDfp_InjVCDMonSwt_C DSM_TypDfp_InjVCDShOffDCDC_C DSM_TypDfp_InjVCDUBuf_C DSM_TypDfp_InjVCD_CY370Ampl_C DSM_TypDfp_InjVlvBnk1A_C DSM_TypDfp_InjVlvBnk1B_C DSM_TypDfp_InjVlvBnk2A_C DSM_TypDfp_InjVlvBnk2B_C DSM_TypDfp_InjVlvChipA_C DSM_TypDfp_InjVlvChipB_C DSM_TypDfp_InjVlvCyl1A_C DSM_TypDfp_InjVlvCyl1B_C DSM_TypDfp_InjVlvCyl1C_C DSM_TypDfp_InjVlvCyl2A_C DSM_TypDfp_InjVlvCyl2B_C DSM_TypDfp_InjVlvCyl2C_C DSM_TypDfp_InjVlvCyl3A_C DSM_TypDfp_InjVlvCyl3B_C DSM_TypDfp_InjVlvCyl3C_C DSM_TypDfp_InjVlvCyl4A_C DSM_TypDfp_InjVlvCyl4B_C DSM_TypDfp_InjVlvCyl4C_C DSM_TypDfp_InjVlvCyl5A_C DSM_TypDfp_InjVlvCyl5B_C DSM_TypDfp_InjVlvCyl5C_C DSM_TypDfp_InjVlvCyl6A_C DSM_TypDfp_InjVlvCyl6B_C DSM_TypDfp_InjVlvCyl6C_C DSM_TypDfp_InjVlvCyl7A_C DSM_TypDfp_InjVlvCyl7B_C DSM_TypDfp_InjVlvCyl7C_C DSM_TypDfp_InjVlvCyl8A_C DSM_TypDfp_InjVlvCyl8B_C DSM_TypDfp_InjVlvCyl8C_C DSM_TypDfp_InjVlvNVC1_C DSM_TypDfp_InjVlvNVC2_C DSM_TypDfp_InjVlvNVC3_C DSM_TypDfp_InjVlvNVC4_C DSM_TypDfp_InjVlvNVC5_C DSM_TypDfp_InjVlvNVC6_C DSM_TypDfp_InjVlvNVC7_C DSM_TypDfp_InjVlvNVC8_C DSM_TypDfp_LPACD_Max_C DSM_TypDfp_LPACD_Min_C DSM_TypDfp_LPACD_SigNpl_C DSM_TypDfp_LSUCDCircNernst0_C DSM_TypDfp_LSUCDCircPumpCur0_C DSM_TypDfp_LSUCDCircVirtGnd0_C DSM_TypDfp_LSUCDHeater0_C DSM_TypDfp_LSUCDHtCoup0_C DSM_TypDfp_LSUCDO20_C DSM_TypDfp_LSUCDO2Clb0_C DSM_TypDfp_LSUCDRiClb0_C DSM_TypDfp_LSUCDSPI0_C DSM_TypDfp_LSUCDSPIBattLow0_C DSM_TypDfp_LSUCDWireIP0_C DSM_TypDfp_LSUCtlRiExc0_C DSM_TypDfp_LSUMon1Sens_C DSM_TypDfp_LSUMon2Sens_C DSM_TypDfp_MIL_C DSM_TypDfp_MRlyCD_C DSM_TypDfp_MSidCD_Comm_C DSM_TypDfp_MSidCD_Pin_C DSM_TypDfp_MSidCD_Sel_INI_C DSM_TypDfp_MSidCD_Select_C DSM_TypDfp_MeUnCDNoLoad_C DSM_TypDfp_MeUnCDSCBat_C DSM_TypDfp_MeUnCDSCGnd_C DSM_TypDfp_MeUnCD_ADC_C DSM_TypDfp_MeUnCD_SigTst_C DSM_TypDfp_Montr_C DSM_TypDfp_NetMngDeviceA_C DSM_TypDfp_NetMngDeviceB_C DSM_TypDfp_NetMngDeviceC_C DSM_TypDfp_OPSCD_Lamp_C DSM_TypDfp_OPSCD_anain_C DSM_TypDfp_OTSCD_C DSM_TypDfp_OvRMon_C DSM_TypDfp_OvRMonBrk_C DSM_TypDfp_OvRMonSigA_C DSM_TypDfp_OxiCCDTPre_C DSM_TypDfp_PCR_GovDevNeg_C DSM_TypDfp_PCR_GovDevPos_C DSM_TypDfp_PCR_LPGvnrDvtNeg_C DSM_TypDfp_PCR_LPGvnrDvtPos_C DSM_TypDfp_PCVCDNoLoad_C DSM_TypDfp_PCVCDSCBat_C DSM_TypDfp_PCVCDSCGnd_C DSM_TypDfp_PCVCD_ADC_C DSM_TypDfp_PCVCD_SigTst_C DSM_TypDfp_PFltAPSPlaus_C DSM_TypDfp_PFltAPSens_C DSM_TypDfp_PFltBPSPlaus_C DSM_TypDfp_PFltCDPPre_C DSM_TypDfp_PFltCDTempPre_C DSM_TypDfp_PFltChar_C DSM_TypDfp_PFltEngPrt_C DSM_TypDfp_PFltPresDynPlaus_C DSM_TypDfp_PFltPresPlaus_C DSM_TypDfp_PFltPresSens_C DSM_TypDfp_PFltPresSensFrz_C DSM_TypDfp_PFltPresSensHsLn_C DSM_TypDfp_PFltPresSensSot_C DSM_TypDfp_PFltRgnPerm_C DSM_TypDfp_PFltTempDwnStrm_C DSM_TypDfp_PFltTempSens_C DSM_TypDfp_PFltTempUpStrm_C DSM_TypDfp_PFltmSotDiffMax_C DSM_TypDfp_PSPCD_Actr_C DSM_TypDfp_PresPlausDblDef_C DSM_TypDfp_QLTCD_C DSM_TypDfp_RailCD_C DSM_TypDfp_RailCDOfsTst_C DSM_TypDfp_RailCD_PMonStrt_C DSM_TypDfp_RailCtlModeMeUnDiag_C DSM_TypDfp_RailCtlModePCVDiag_C DSM_TypDfp_RailMeUn0_C DSM_TypDfp_RailMeUn1_C DSM_TypDfp_RailMeUn2_C DSM_TypDfp_RailMeUn3_C DSM_TypDfp_RailMeUn4_C DSM_TypDfp_RailPCV0_C DSM_TypDfp_RailPCV1_C DSM_TypDfp_RailPCV2_C DSM_TypDfp_RailPCV3_C DSM_TypDfp_RailPCV4_C DSM_TypDfp_RailPCV5_C DSM_TypDfp_SOPTst_C DSM_TypDfp_SSpMon1_C DSM_TypDfp_SSpMon2_C DSM_TypDfp_SSpMon3_C DSM_TypDfp_SWChk_CycSigChkDat_C DSM_TypDfp_SWChk_CycSigChkPrg_C DSM_TypDfp_ShutCD_C DSM_TypDfp_StSysTrqShutOff_C DSM_TypDfp_StrtCD_Actr_C DSM_TypDfp_SysLamp_C DSM_TypDfp_T15CD_C DSM_TypDfp_TGearbx_C DSM_TypDfp_TPUMon_C DSM_TypDfp_TVACD_Max_C DSM_TypDfp_TVACD_Min_C DSM_TypDfp_TVACD_SigNpl_C DSM_TypDfp_TVACD_TVADia1_C DSM_TypDfp_TVACD_TVADia2_C DSM_TypDfp_TVACD_TVADia3_C DSM_TypDfp_TVACD_TVADia4_C DSM_TypDfp_VSACD_DioInDia1_C DSM_TypDfp_VSACD_DioInDia2_C DSM_TypDfp_VSACD_DioInDia3_C DSM_TypDfp_VSACD_DioInDia4_C DSM_TypDfp_VSACD_DioInMin_C DSM_TypDfp_VSACD_Max_C DSM_TypDfp_VSACD_Min_C DSM_TypDfp_VSACD_SigNpl_C DSM_TypDfp_VSACD_VSADia1_C DSM_TypDfp_VSACD_VSADia2_C DSM_TypDfp_VSACD_VSADia3_C DSM_TypDfp_VSACD_VSADia4_C DSM_TypDfp_VSSCD1_C DSM_TypDfp_VSSCD2_C DSM_TypDfp_WdCom_C /end DEF_CHARACTERISTIC
/end FUNCTION
/begin COMPU_METHOD OneToOne "eins zu eins (physikalischer Wert ist gleich dem internen Wert)" RAT_FUNC "%6.2" "-" COEFFS 0 1 0 0 0 1 /end COMPU_METHOD
/begin COMPU_METHOD Time_ms "Zeit in ms für Fehlerentprellung (DSM) und SW-Timer" RAT_FUNC "%6.1" "ms" COEFFS 0 0.1 0 0 0 1 /end COMPU_METHOD
/begin RECORD_LAYOUT Kwb_Wu8 FNC_VALUES 1 UBYTE COLUMN_DIR DIRECT /end RECORD_LAYOUT
/begin RECORD_LAYOUT Kw_Wu16 FNC_VALUES 1 UWORD COLUMN_DIR DIRECT /end RECORD_LAYOUT
/end MODULE
/end PROJECT
