ASAP2_VERSION 1 3
/begin PROJECT P383 "BMW DDE6.3 8-Zylinder V9E.3 11.10.2004 CAN12H"
/begin HEADER "" VERSION "V9E.3_8Z_CAN12H" PROJECT_NO P383 /end HEADER
/begin MODULE DIM ""
/begin MOD_COMMON "" BYTE_ORDER MSB_FIRST ALIGNMENT_BYTE 1 ALIGNMENT_WORD 2 ALIGNMENT_LONG 4 ALIGNMENT_FLOAT32_IEEE 4 /end MOD_COMMON
/begin CHARACTERISTIC DSM_InhDfp_Layer_TANS_C "Durch Fehlerpfad Dfp_Layer_TANS verriegelte Funktionsidentifier" VAL_BLK 0xCEB48 Kwb_Wu16 61811.0000000 FidName 0.00 61811.0000000 FORMAT "%13.7" NUMBER 5 /end CHARACTERISTIC
/begin CHARACTERISTIC DSM_InhDfp_ACCDSwtin_C "Durch Fehlerpfad Dfp_ACCDSwtin verriegelte Funktionsidentifier" VAL_BLK 0xCEB52 Kwb_Wu16 61811.0000000 FidName 0.00 61811.0000000 FORMAT "%13.7" NUMBER 5 /end CHARACTERISTIC
/begin CHARACTERISTIC DSM_InhDfp_ACC_PlausTrqDes_C "Durch Fehlerpfad Dfp_ACC_PlausTrqDes verriegelte Funktionsidentifier" VAL_BLK 0xCEB5C Kwb_Wu16 61811.0000000 FidName 0.00 61811.0000000 FORMAT "%13.7" NUMBER 6 /end CHARACTERISTIC
/begin CHARACTERISTIC DSM_InhDfp_ACC_trqInr_C "Durch Fehlerpfad Dfp_ACC_trqInr verriegelte Funktionsidentifier" VAL_BLK 0xCEB68 Kwb_Wu16 61811.0000000 FidName 0.00 61811.0000000 FORMAT "%13.7" NUMBER 6 /end CHARACTERISTIC
/begin CHARACTERISTIC DSM_InhDfp_ACTrq_C "Durch Fehlerpfad Dfp_ACTrq verriegelte Funktionsidentifier" VAL_BLK 0xCEB74 Kwb_Wu16 61811.0000000 FidName 0.00 61811.0000000 FORMAT "%13.7" NUMBER 6 /end CHARACTERISTIC
/begin CHARACTERISTIC DSM_InhDfp_ADCMon_C "Durch Fehlerpfad Dfp_ADCMon verriegelte Funktionsidentifier" VAL_BLK 0xCEB80 Kwb_Wu16 61811.0000000 FidName 0.00 61811.0000000 FORMAT "%13.7" NUMBER 10 /end CHARACTERISTIC
/begin CHARACTERISTIC DSM_InhDfp_AFSCDIdlAdjVal_C "Durch Fehlerpfad Dfp_AFSCDIdlAdjVal verriegelte Funktionsidentifier" VAL_BLK 0xCEB94 Kwb_Wu16 61811.0000000 FidName 0.00 61811.0000000 FORMAT "%13.7" NUMBER 15 /end CHARACTERISTIC
/begin CHARACTERISTIC DSM_InhDfp_AFSCDLdAdjVal_C "Durch Fehlerpfad Dfp_AFSCDLdAdjVal verriegelte Funktionsidentifier" VAL_BLK 0xCEBB2 Kwb_Wu16 61811.0000000 FidName 0.00 61811.0000000 FORMAT "%13.7" NUMBER 15 /end CHARACTERISTIC
/begin CHARACTERISTIC DSM_InhDfp_AFSCDPlAirPerCylDif_C "Durch Fehlerpfad Dfp_AFSCDPlAirPerCylDif verriegelte Funktionsidentifier" VAL_BLK 0xCEBD0 Kwb_Wu16 61811.0000000 FidName 0.00 61811.0000000 FORMAT "%13.7" NUMBER 14 /end CHARACTERISTIC
/begin CHARACTERISTIC DSM_InhDfp_AFSCD_AirTempDcyc_C "Durch Fehlerpfad Dfp_AFSCD_AirTempDcyc verriegelte Funktionsidentifier" VAL_BLK 0xCEBEC Kwb_Wu16 61811.0000000 FidName 0.00 61811.0000000 FORMAT "%13.7" NUMBER 16 /end CHARACTERISTIC
/begin CHARACTERISTIC DSM_InhDfp_AFSCD_AirTempDcyc2_C "Durch Fehlerpfad Dfp_AFSCD_AirTempDcyc2 verriegelte Funktionsidentifier" VAL_BLK 0xCEC0C Kwb_Wu16 61811.0000000 FidName 0.00 61811.0000000 FORMAT "%13.7" NUMBER 13 /end CHARACTERISTIC
/begin CHARACTERISTIC DSM_InhDfp_AFSCD_PlOffsDrft_C "Durch Fehlerpfad Dfp_AFSCD_PlOffsDrft verriegelte Funktionsidentifier" VAL_BLK 0xCEC26 Kwb_Wu16 61811.0000000 FidName 0.00 61811.0000000 FORMAT "%13.7" NUMBER 31 /end CHARACTERISTIC
/begin CHARACTERISTIC DSM_InhDfp_AFSCD_PlOffsDrft2_C "Durch Fehlerpfad Dfp_AFSCD_PlOffsDrft2 verriegelte Funktionsidentifier" VAL_BLK 0xCEC64 Kwb_Wu16 61811.0000000 FidName 0.00 61811.0000000 FORMAT "%13.7" NUMBER 13 /end CHARACTERISTIC
/begin CHARACTERISTIC DSM_InhDfp_AFSCD_PlSetyDrft_C "Durch Fehlerpfad Dfp_AFSCD_PlSetyDrft verriegelte Funktionsidentifier" VAL_BLK 0xCEC7E Kwb_Wu16 61811.0000000 FidName 0.00 61811.0000000 FORMAT "%13.7" NUMBER 38 /end CHARACTERISTIC
/begin CHARACTERISTIC DSM_InhDfp_AFSCD_SRCAirTemp_C "Durch Fehlerpfad Dfp_AFSCD_SRCAirTemp verriegelte Funktionsidentifier" VAL_BLK 0xCECCA Kwb_Wu16 61811.0000000 FidName 0.00 61811.0000000 FORMAT "%13.7" NUMBER 21 /end CHARACTERISTIC
/begin CHARACTERISTIC DSM_InhDfp_AFSCD_SRCAirTemp2_C "Durch Fehlerpfad Dfp_AFSCD_SRCAirTemp2 verriegelte Funktionsidentifier" VAL_BLK 0xCECF4 Kwb_Wu16 61811.0000000 FidName 0.00 61811.0000000 FORMAT "%13.7" NUMBER 17 /end CHARACTERISTIC
/begin CHARACTERISTIC DSM_InhDfp_AFSCD_SRCBatt_C "Durch Fehlerpfad Dfp_AFSCD_SRCBatt verriegelte Funktionsidentifier" VAL_BLK 0xCED16 Kwb_Wu16 61811.0000000 FidName 0.00 61811.0000000 FORMAT "%13.7" NUMBER 20 /end CHARACTERISTIC
/begin CHARACTERISTIC DSM_InhDfp_AFSCD_SRCBatt2_C "Durch Fehlerpfad Dfp_AFSCD_SRCBatt2 verriegelte Funktionsidentifier" VAL_BLK 0xCED3E Kwb_Wu16 61811.0000000 FidName 0.00 61811.0000000 FORMAT "%13.7" NUMBER 18 /end CHARACTERISTIC
/begin CHARACTERISTIC DSM_InhDfp_AFSCD_SRCCorrAirm_C "Durch Fehlerpfad Dfp_AFSCD_SRCCorrAirm verriegelte Funktionsidentifier" VAL_BLK 0xCED62 Kwb_Wu16 61811.0000000 FidName 0.00 61811.0000000 FORMAT "%13.7" NUMBER 21 /end CHARACTERISTIC
/begin CHARACTERISTIC DSM_InhDfp_Layer_TUMG_C "Durch Fehlerpfad Dfp_Layer_TUMG verriegelte Funktionsidentifier" VAL_BLK 0xCED8C Kwb_Wu16 61811.0000000 FidName 0.00 61811.0000000 FORMAT "%13.7" NUMBER 5 /end CHARACTERISTIC
/begin CHARACTERISTIC DSM_InhDfp_AFSCD_SRCCorrAirm2_C "Durch Fehlerpfad Dfp_AFSCD_SRCCorrAirm2 verriegelte Funktionsidentifier" VAL_BLK 0xCED96 Kwb_Wu16 61811.0000000 FidName 0.00 61811.0000000 FORMAT "%13.7" NUMBER 18 /end CHARACTERISTIC
/begin CHARACTERISTIC DSM_InhDfp_AFSCD_SRCRawAirm_C "Durch Fehlerpfad Dfp_AFSCD_SRCRawAirm verriegelte Funktionsidentifier" VAL_BLK 0xCEDBA Kwb_Wu16 61811.0000000 FidName 0.00 61811.0000000 FORMAT "%13.7" NUMBER 23 /end CHARACTERISTIC
/begin CHARACTERISTIC DSM_InhDfp_Layer_GEN_C "Durch Fehlerpfad Dfp_Layer_GEN verriegelte Funktionsidentifier" VAL_BLK 0xCEDE8 Kwb_Wu16 61811.0000000 FidName 0.00 61811.0000000 FORMAT "%13.7" NUMBER 5 /end CHARACTERISTIC
/begin CHARACTERISTIC DSM_InhDfp_Layer_BSD_C "Durch Fehlerpfad Dfp_Layer_BSD verriegelte Funktionsidentifier" VAL_BLK 0xCEDF2 Kwb_Wu16 61811.0000000 FidName 0.00 61811.0000000 FORMAT "%13.7" NUMBER 5 /end CHARACTERISTIC
/begin CHARACTERISTIC DSM_InhDfp_AFSCD_SRCRawAirm2_C "Durch Fehlerpfad Dfp_AFSCD_SRCRawAirm2 verriegelte Funktionsidentifier" VAL_BLK 0xCEDFC Kwb_Wu16 61811.0000000 FidName 0.00 61811.0000000 FORMAT "%13.7" NUMBER 17 /end CHARACTERISTIC
/begin CHARACTERISTIC DSM_InhDfp_AFSCD_SRCRefSigPer_C "Durch Fehlerpfad Dfp_AFSCD_SRCRefSigPer verriegelte Funktionsidentifier" VAL_BLK 0xCEE1E Kwb_Wu16 61811.0000000 FidName 0.00 61811.0000000 FORMAT "%13.7" NUMBER 19 /end CHARACTERISTIC
/begin CHARACTERISTIC DSM_InhDfp_AFSCD_SRCRefSigPer2_C "Durch Fehlerpfad Dfp_AFSCD_SRCRefSigPer2 verriegelte Funktionsidentifier" VAL_BLK 0xCEE44 Kwb_Wu16 61811.0000000 FidName 0.00 61811.0000000 FORMAT "%13.7" NUMBER 18 /end CHARACTERISTIC
/begin CHARACTERISTIC DSM_InhDfp_AOHtCD_C "Durch Fehlerpfad Dfp_AOHtCD verriegelte Funktionsidentifier" VAL_BLK 0xCEE68 Kwb_Wu16 61811.0000000 FidName 0.00 61811.0000000 FORMAT "%13.7" NUMBER 7 /end CHARACTERISTIC
/begin CHARACTERISTIC DSM_InhDfp_AOHtCD_AOHtDia1_C "Durch Fehlerpfad Dfp_AOHtCD_AOHtDia1 verriegelte Funktionsidentifier" VAL_BLK 0xCEE76 Kwb_Wu16 61811.0000000 FidName 0.00 61811.0000000 FORMAT "%13.7" NUMBER 6 /end CHARACTERISTIC
/begin CHARACTERISTIC DSM_InhDfp_AOHtCD_AOHtDia2_C "Durch Fehlerpfad Dfp_AOHtCD_AOHtDia2 verriegelte Funktionsidentifier" VAL_BLK 0xCEE82 Kwb_Wu16 61811.0000000 FidName 0.00 61811.0000000 FORMAT "%13.7" NUMBER 5 /end CHARACTERISTIC
/begin CHARACTERISTIC DSM_InhDfp_AOHtCD_AOHtDia3_C "Durch Fehlerpfad Dfp_AOHtCD_AOHtDia3 verriegelte Funktionsidentifier" VAL_BLK 0xCEE8C Kwb_Wu16 61811.0000000 FidName 0.00 61811.0000000 FORMAT "%13.7" NUMBER 5 /end CHARACTERISTIC
/begin CHARACTERISTIC DSM_InhDfp_APP1_C "Durch Fehlerpfad Dfp_APP1 verriegelte Funktionsidentifier" VAL_BLK 0xCEE96 Kwb_Wu16 61811.0000000 FidName 0.00 61811.0000000 FORMAT "%13.7" NUMBER 10 /end CHARACTERISTIC
/begin CHARACTERISTIC DSM_InhDfp_APP2_C "Durch Fehlerpfad Dfp_APP2 verriegelte Funktionsidentifier" VAL_BLK 0xCEEAA Kwb_Wu16 61811.0000000 FidName 0.00 61811.0000000 FORMAT "%13.7" NUMBER 10 /end CHARACTERISTIC
/begin CHARACTERISTIC DSM_InhDfp_APPCDCmpd_C "Durch Fehlerpfad Dfp_APPCDCmpd verriegelte Funktionsidentifier" VAL_BLK 0xCEEBE Kwb_Wu16 61811.0000000 FidName 0.00 61811.0000000 FORMAT "%13.7" NUMBER 8 /end CHARACTERISTIC
/begin CHARACTERISTIC DSM_InhDfp_Layer_QLT_C "Durch Fehlerpfad Dfp_Layer_QLT verriegelte Funktionsidentifier" VAL_BLK 0xCEECE Kwb_Wu16 61811.0000000 FidName 0.00 61811.0000000 FORMAT "%13.7" NUMBER 5 /end CHARACTERISTIC
/begin CHARACTERISTIC DSM_InhDfp_APPSync_C "Durch Fehlerpfad Dfp_APPSync verriegelte Funktionsidentifier" VAL_BLK 0xCEED8 Kwb_Wu16 61811.0000000 FidName 0.00 61811.0000000 FORMAT "%13.7" NUMBER 11 /end CHARACTERISTIC
/begin CHARACTERISTIC DSM_InhDfp_Layer_IBS1_C "Durch Fehlerpfad Dfp_Layer_IBS1 verriegelte Funktionsidentifier" VAL_BLK 0xCEEEE Kwb_Wu16 61811.0000000 FidName 0.00 61811.0000000 FORMAT "%13.7" NUMBER 5 /end CHARACTERISTIC
/begin CHARACTERISTIC DSM_InhDfp_Layer_IBS2_C "Durch Fehlerpfad Dfp_Layer_IBS2 verriegelte Funktionsidentifier" VAL_BLK 0xCEEF8 Kwb_Wu16 61811.0000000 FidName 0.00 61811.0000000 FORMAT "%13.7" NUMBER 5 /end CHARACTERISTIC
/begin CHARACTERISTIC DSM_InhDfp_Layer_IBS3_C "Durch Fehlerpfad Dfp_Layer_IBS3 verriegelte Funktionsidentifier" VAL_BLK 0xCEF02 Kwb_Wu16 61811.0000000 FidName 0.00 61811.0000000 FORMAT "%13.7" NUMBER 5 /end CHARACTERISTIC
/begin CHARACTERISTIC DSM_InhDfp_Layer_PMBN_C "Durch Fehlerpfad Dfp_Layer_PMBN verriegelte Funktionsidentifier" VAL_BLK 0xCEF0C Kwb_Wu16 61811.0000000 FidName 0.00 61811.0000000 FORMAT "%13.7" NUMBER 5 /end CHARACTERISTIC
/begin CHARACTERISTIC DSM_InhDfp_Layer_PMBATT_C "Durch Fehlerpfad Dfp_Layer_PMBATT verriegelte Funktionsidentifier" VAL_BLK 0xCEF16 Kwb_Wu16 61811.0000000 FidName 0.00 61811.0000000 FORMAT "%13.7" NUMBER 5 /end CHARACTERISTIC
/begin CHARACTERISTIC DSM_InhDfp_APSCD_C "Durch Fehlerpfad Dfp_APSCD verriegelte Funktionsidentifier" VAL_BLK 0xCEF20 Kwb_Wu16 61811.0000000 FidName 0.00 61811.0000000 FORMAT "%13.7" NUMBER 25 /end CHARACTERISTIC
/begin CHARACTERISTIC DSM_InhDfp_ARS_C "Durch Fehlerpfad Dfp_ARS verriegelte Funktionsidentifier" VAL_BLK 0xCEF52 Kwb_Wu16 61811.0000000 FidName 0.00 61811.0000000 FORMAT "%13.7" NUMBER 7 /end CHARACTERISTIC
/begin CHARACTERISTIC DSM_InhDfp_AccPedPlausBrk_C "Durch Fehlerpfad Dfp_AccPedPlausBrk verriegelte Funktionsidentifier" VAL_BLK 0xCEF60 Kwb_Wu16 61811.0000000 FidName 0.00 61811.0000000 FORMAT "%13.7" NUMBER 5 /end CHARACTERISTIC
/begin CHARACTERISTIC DSM_InhDfp_AddPCDTnkLvl_C "Durch Fehlerpfad Dfp_AddPCDTnkLvl verriegelte Funktionsidentifier" VAL_BLK 0xCEF6A Kwb_Wu16 61811.0000000 FidName 0.00 61811.0000000 FORMAT "%13.7" NUMBER 6 /end CHARACTERISTIC
/begin CHARACTERISTIC DSM_InhDfp_AirCtlGvnrDvtRgnMax_C "Durch Fehlerpfad Dfp_AirCtlGvnrDvtRgnMax verriegelte Funktionsidentifier" VAL_BLK 0xCEF76 Kwb_Wu16 61811.0000000 FidName 0.00 61811.0000000 FORMAT "%13.7" NUMBER 10 /end CHARACTERISTIC
/begin CHARACTERISTIC DSM_InhDfp_AirCtlGvnrDvtRgnMin_C "Durch Fehlerpfad Dfp_AirCtlGvnrDvtRgnMin verriegelte Funktionsidentifier" VAL_BLK 0xCEF8A Kwb_Wu16 61811.0000000 FidName 0.00 61811.0000000 FORMAT "%13.7" NUMBER 10 /end CHARACTERISTIC
/begin CHARACTERISTIC DSM_InhDfp_AirCtlGvnrDvtRgnMn2_C "Durch Fehlerpfad Dfp_AirCtlGvnrDvtRgnMn2 verriegelte Funktionsidentifier" VAL_BLK 0xCEF9E Kwb_Wu16 61811.0000000 FidName 0.00 61811.0000000 FORMAT "%13.7" NUMBER 10 /end CHARACTERISTIC
/begin CHARACTERISTIC DSM_InhDfp_AirCtlGvnrDvtRgnMx2_C "Durch Fehlerpfad Dfp_AirCtlGvnrDvtRgnMx2 verriegelte Funktionsidentifier" VAL_BLK 0xCEFB2 Kwb_Wu16 61811.0000000 FidName 0.00 61811.0000000 FORMAT "%13.7" NUMBER 10 /end CHARACTERISTIC
/begin CHARACTERISTIC DSM_InhDfp_AirCtlPlateBreak_C "DSM variable for Dfp_AirCtlPlateBreak_mp" VAL_BLK 0xCEFC6 Kwb_Wu16 61811.0000000 FidName 0.00 61811.0000000 FORMAT "%13.7" NUMBER 10 /end CHARACTERISTIC
/begin CHARACTERISTIC DSM_InhDfp_AirCtlRmpTO_C "Durch Fehlerpfad Dfp_AirCtlRmpTO verriegelte Funktionsidentifier" VAL_BLK 0xCEFDA Kwb_Wu16 61811.0000000 FidName 0.00 61811.0000000 FORMAT "%13.7" NUMBER 10 /end CHARACTERISTIC
/begin CHARACTERISTIC DSM_InhDfp_AirCtl_GovNegDev_C "Durch Fehlerpfad Dfp_AirCtl_GovNegDev verriegelte Funktionsidentifier" VAL_BLK 0xCEFEE Kwb_Wu16 61811.0000000 FidName 0.00 61811.0000000 FORMAT "%13.7" NUMBER 17 /end CHARACTERISTIC
/begin CHARACTERISTIC DSM_InhDfp_AirCtl_GovNegDev2_C "Durch Fehlerpfad Dfp_AirCtl_GovNegDev2 verriegelte Funktionsidentifier" VAL_BLK 0xCF010 Kwb_Wu16 61811.0000000 FidName 0.00 61811.0000000 FORMAT "%13.7" NUMBER 16 /end CHARACTERISTIC
/begin CHARACTERISTIC DSM_InhDfp_AirCtl_GovPosDev_C "Durch Fehlerpfad Dfp_AirCtl_GovPosDev verriegelte Funktionsidentifier" VAL_BLK 0xCF030 Kwb_Wu16 61811.0000000 FidName 0.00 61811.0000000 FORMAT "%13.7" NUMBER 19 /end CHARACTERISTIC
/begin CHARACTERISTIC DSM_InhDfp_AirCtl_GovPosDev2_C "Durch Fehlerpfad Dfp_AirCtl_GovPosDev2 verriegelte Funktionsidentifier" VAL_BLK 0xCF056 Kwb_Wu16 61811.0000000 FidName 0.00 61811.0000000 FORMAT "%13.7" NUMBER 18 /end CHARACTERISTIC
/begin CHARACTERISTIC DSM_InhDfp_AltCD_C "Durch Fehlerpfad Dfp_AltCD verriegelte Funktionsidentifier" VAL_BLK 0xCF07A Kwb_Wu16 61811.0000000 FidName 0.00 61811.0000000 FORMAT "%13.7" NUMBER 6 /end CHARACTERISTIC
/begin CHARACTERISTIC DSM_InhDfp_BPACD_BPADia1_C "Durch Fehlerpfad Dfp_BPACD_BPADia1 verriegelte Funktionsidentifier" VAL_BLK 0xCF086 Kwb_Wu16 61811.0000000 FidName 0.00 61811.0000000 FORMAT "%13.7" NUMBER 5 /end CHARACTERISTIC
/begin CHARACTERISTIC DSM_InhDfp_BPACD_BPADia1v2_C "Durch Fehlerpfad Dfp_BPACD_BPADia1v2 verriegelte Funktionsidentifier" VAL_BLK 0xCF090 Kwb_Wu16 61811.0000000 FidName 0.00 61811.0000000 FORMAT "%13.7" NUMBER 5 /end CHARACTERISTIC
/begin CHARACTERISTIC DSM_InhDfp_BPACD_BPADia2_C "Durch Fehlerpfad Dfp_BPACD_BPADia2 verriegelte Funktionsidentifier" VAL_BLK 0xCF09A Kwb_Wu16 61811.0000000 FidName 0.00 61811.0000000 FORMAT "%13.7" NUMBER 5 /end CHARACTERISTIC
/begin CHARACTERISTIC DSM_InhDfp_BPACD_BPADia2v2_C "Durch Fehlerpfad Dfp_BPACD_BPADia2v2 verriegelte Funktionsidentifier" VAL_BLK 0xCF0A4 Kwb_Wu16 61811.0000000 FidName 0.00 61811.0000000 FORMAT "%13.7" NUMBER 5 /end CHARACTERISTIC
/begin CHARACTERISTIC DSM_InhDfp_BPACD_BPADia3_C "Durch Fehlerpfad Dfp_BPACD_BPADia3 verriegelte Funktionsidentifier" VAL_BLK 0xCF0AE Kwb_Wu16 61811.0000000 FidName 0.00 61811.0000000 FORMAT "%13.7" NUMBER 5 /end CHARACTERISTIC
/begin CHARACTERISTIC DSM_InhDfp_BPACD_BPADia3v2_C "Durch Fehlerpfad Dfp_BPACD_BPADia3v2 verriegelte Funktionsidentifier" VAL_BLK 0xCF0B8 Kwb_Wu16 61811.0000000 FidName 0.00 61811.0000000 FORMAT "%13.7" NUMBER 5 /end CHARACTERISTIC
/begin CHARACTERISTIC DSM_InhDfp_BPACD_BPADia4_C "Durch Fehlerpfad Dfp_BPACD_BPADia4 verriegelte Funktionsidentifier" VAL_BLK 0xCF0C2 Kwb_Wu16 61811.0000000 FidName 0.00 61811.0000000 FORMAT "%13.7" NUMBER 5 /end CHARACTERISTIC
/begin CHARACTERISTIC DSM_InhDfp_BPACD_BPADia4v2_C "Durch Fehlerpfad Dfp_BPACD_BPADia4v2 verriegelte Funktionsidentifier" VAL_BLK 0xCF0CC Kwb_Wu16 61811.0000000 FidName 0.00 61811.0000000 FORMAT "%13.7" NUMBER 5 /end CHARACTERISTIC
/begin CHARACTERISTIC DSM_InhDfp_BPACD_Max_C "Durch Fehlerpfad Dfp_BPACD_Max verriegelte Funktionsidentifier" VAL_BLK 0xCF0D6 Kwb_Wu16 61811.0000000 FidName 0.00 61811.0000000 FORMAT "%13.7" NUMBER 10 /end CHARACTERISTIC
/begin CHARACTERISTIC DSM_InhDfp_BPACD_Max2_C "Durch Fehlerpfad Dfp_BPACD_Max2 verriegelte Funktionsidentifier" VAL_BLK 0xCF0EA Kwb_Wu16 61811.0000000 FidName 0.00 61811.0000000 FORMAT "%13.7" NUMBER 10 /end CHARACTERISTIC
/begin CHARACTERISTIC DSM_InhDfp_BPACD_Min_C "Durch Fehlerpfad Dfp_BPACD_Min verriegelte Funktionsidentifier" VAL_BLK 0xCF0FE Kwb_Wu16 61811.0000000 FidName 0.00 61811.0000000 FORMAT "%13.7" NUMBER 9 /end CHARACTERISTIC
/begin CHARACTERISTIC DSM_InhDfp_BPACD_Min2_C "Durch Fehlerpfad Dfp_BPACD_Min2 verriegelte Funktionsidentifier" VAL_BLK 0xCF110 Kwb_Wu16 61811.0000000 FidName 0.00 61811.0000000 FORMAT "%13.7" NUMBER 9 /end CHARACTERISTIC
/begin CHARACTERISTIC DSM_InhDfp_BPACD_SigNpl_C "Durch Fehlerpfad Dfp_BPACD_SigNpl verriegelte Funktionsidentifier" VAL_BLK 0xCF122 Kwb_Wu16 61811.0000000 FidName 0.00 61811.0000000 FORMAT "%13.7" NUMBER 11 /end CHARACTERISTIC
/begin CHARACTERISTIC DSM_InhDfp_BPACD_SigNpl2_C "Durch Fehlerpfad Dfp_BPACD_SigNpl2 verriegelte Funktionsidentifier" VAL_BLK 0xCF138 Kwb_Wu16 61811.0000000 FidName 0.00 61811.0000000 FORMAT "%13.7" NUMBER 10 /end CHARACTERISTIC
/begin CHARACTERISTIC DSM_InhDfp_BPSCD_C "Durch Fehlerpfad Dfp_BPSCD verriegelte Funktionsidentifier" VAL_BLK 0xCF14C Kwb_Wu16 61811.0000000 FidName 0.00 61811.0000000 FORMAT "%13.7" NUMBER 29 /end CHARACTERISTIC
/begin CHARACTERISTIC DSM_InhDfp_BattCD_C "Durch Fehlerpfad Dfp_BattCD verriegelte Funktionsidentifier" VAL_BLK 0xCF186 Kwb_Wu16 61811.0000000 FidName 0.00 61811.0000000 FORMAT "%13.7" NUMBER 8 /end CHARACTERISTIC
/begin CHARACTERISTIC DSM_InhDfp_BrkCD_C "Durch Fehlerpfad Dfp_BrkCD verriegelte Funktionsidentifier" VAL_BLK 0xCF196 Kwb_Wu16 61811.0000000 FidName 0.00 61811.0000000 FORMAT "%13.7" NUMBER 12 /end CHARACTERISTIC
/begin CHARACTERISTIC DSM_InhDfp_Layer_PMRUHVERL_C "Durch Fehlerpfad Dfp_Layer_PMRUHVERL verriegelte Funktionsidentifier" VAL_BLK 0xCF1AE Kwb_Wu16 61811.0000000 FidName 0.00 61811.0000000 FORMAT "%13.7" NUMBER 5 /end CHARACTERISTIC
/begin CHARACTERISTIC DSM_InhDfp_Bss_C "Durch Fehlerpfad Dfp_Bss verriegelte Funktionsidentifier" VAL_BLK 0xCF1B8 Kwb_Wu16 61811.0000000 FidName 0.00 61811.0000000 FORMAT "%13.7" NUMBER 5 /end CHARACTERISTIC
/begin CHARACTERISTIC DSM_InhDfp_CBACD_C "Durch Fehlerpfad Dfp_CBACD verriegelte Funktionsidentifier" VAL_BLK 0xCF1C2 Kwb_Wu16 61811.0000000 FidName 0.00 61811.0000000 FORMAT "%13.7" NUMBER 6 /end CHARACTERISTIC
/begin CHARACTERISTIC DSM_InhDfp_CTSCD_C "Durch Fehlerpfad Dfp_CTSCD verriegelte Funktionsidentifier" VAL_BLK 0xCF1CE Kwb_Wu16 61811.0000000 FidName 0.00 61811.0000000 FORMAT "%13.7" NUMBER 37 /end CHARACTERISTIC
/begin CHARACTERISTIC DSM_InhDfp_Clg_DynTst_C "Durch Fehlerpfad Dfp_Clg_DynTst verriegelte Funktionsidentifier" VAL_BLK 0xCF218 Kwb_Wu16 61811.0000000 FidName 0.00 61811.0000000 FORMAT "%13.7" NUMBER 5 /end CHARACTERISTIC
/begin CHARACTERISTIC DSM_InhDfp_Layer_TOENS_C "Durch Fehlerpfad Dfp_Layer_TOENS verriegelte Funktionsidentifier" VAL_BLK 0xCF222 Kwb_Wu16 61811.0000000 FidName 0.00 61811.0000000 FORMAT "%13.7" NUMBER 5 /end CHARACTERISTIC
/begin CHARACTERISTIC DSM_InhDfp_Layer_MANHYDR_C "Durch Fehlerpfad Dfp_Layer_MANHYDR verriegelte Funktionsidentifier" VAL_BLK 0xCF22C Kwb_Wu16 61811.0000000 FidName 0.00 61811.0000000 FORMAT "%13.7" NUMBER 5 /end CHARACTERISTIC
/begin CHARACTERISTIC DSM_InhDfp_Layer_MANLUFT_C "Durch Fehlerpfad Dfp_Layer_MANLUFT verriegelte Funktionsidentifier" VAL_BLK 0xCF236 Kwb_Wu16 61811.0000000 FidName 0.00 61811.0000000 FORMAT "%13.7" NUMBER 5 /end CHARACTERISTIC
/begin CHARACTERISTIC DSM_InhDfp_CmbChbMisfire1_C "Durch Fehlerpfad Dfp_CmbChbMisfire1 verriegelte Funktionsidentifier" VAL_BLK 0xCF240 Kwb_Wu16 61811.0000000 FidName 0.00 61811.0000000 FORMAT "%13.7" NUMBER 6 /end CHARACTERISTIC
/begin CHARACTERISTIC DSM_InhDfp_CmbChbMisfire2_C "Durch Fehlerpfad Dfp_CmbChbMisfire2 verriegelte Funktionsidentifier" VAL_BLK 0xCF24C Kwb_Wu16 61811.0000000 FidName 0.00 61811.0000000 FORMAT "%13.7" NUMBER 6 /end CHARACTERISTIC
/begin CHARACTERISTIC DSM_InhDfp_CmbChbMisfire3_C "Durch Fehlerpfad Dfp_CmbChbMisfire3 verriegelte Funktionsidentifier" VAL_BLK 0xCF258 Kwb_Wu16 61811.0000000 FidName 0.00 61811.0000000 FORMAT "%13.7" NUMBER 6 /end CHARACTERISTIC
/begin CHARACTERISTIC DSM_InhDfp_CmbChbMisfire4_C "Durch Fehlerpfad Dfp_CmbChbMisfire4 verriegelte Funktionsidentifier" VAL_BLK 0xCF264 Kwb_Wu16 61811.0000000 FidName 0.00 61811.0000000 FORMAT "%13.7" NUMBER 6 /end CHARACTERISTIC
/begin CHARACTERISTIC DSM_InhDfp_CmbChbMisfire5_C "Durch Fehlerpfad Dfp_CmbChbMisfire5 verriegelte Funktionsidentifier" VAL_BLK 0xCF270 Kwb_Wu16 61811.0000000 FidName 0.00 61811.0000000 FORMAT "%13.7" NUMBER 6 /end CHARACTERISTIC
/begin CHARACTERISTIC DSM_InhDfp_CmbChbMisfire6_C "Durch Fehlerpfad Dfp_CmbChbMisfire6 verriegelte Funktionsidentifier" VAL_BLK 0xCF27C Kwb_Wu16 61811.0000000 FidName 0.00 61811.0000000 FORMAT "%13.7" NUMBER 6 /end CHARACTERISTIC
/begin CHARACTERISTIC DSM_InhDfp_CmbChbMisfire7_C "Durch Fehlerpfad Dfp_CmbChbMisfire7 verriegelte Funktionsidentifier" VAL_BLK 0xCF288 Kwb_Wu16 61811.0000000 FidName 0.00 61811.0000000 FORMAT "%13.7" NUMBER 6 /end CHARACTERISTIC
/begin CHARACTERISTIC DSM_InhDfp_CmbChbMisfire8_C "Durch Fehlerpfad Dfp_CmbChbMisfire8 verriegelte Funktionsidentifier" VAL_BLK 0xCF294 Kwb_Wu16 61811.0000000 FidName 0.00 61811.0000000 FORMAT "%13.7" NUMBER 6 /end CHARACTERISTIC
/begin CHARACTERISTIC DSM_InhDfp_CmbChbMisfireMul_C "Durch Fehlerpfad Dfp_CmbChbMisfireMul verriegelte Funktionsidentifier" VAL_BLK 0xCF2A0 Kwb_Wu16 61811.0000000 FidName 0.00 61811.0000000 FORMAT "%13.7" NUMBER 6 /end CHARACTERISTIC
/begin CHARACTERISTIC DSM_InhDfp_CoDT_TRQ_Des_C "Durch Fehlerpfad Dfp_CoDT_TRQ_Des verriegelte Funktionsidentifier" VAL_BLK 0xCF2AC Kwb_Wu16 61811.0000000 FidName 0.00 61811.0000000 FORMAT "%13.7" NUMBER 6 /end CHARACTERISTIC
/begin CHARACTERISTIC DSM_InhDfp_CoDT_TRQ_Lead_C "Durch Fehlerpfad Dfp_CoDT_TRQ_Lead verriegelte Funktionsidentifier" VAL_BLK 0xCF2B8 Kwb_Wu16 61811.0000000 FidName 0.00 61811.0000000 FORMAT "%13.7" NUMBER 6 /end CHARACTERISTIC
/begin CHARACTERISTIC DSM_InhDfp_CoEng_GbxRpmRduc_C "Durch Fehlerpfad Dfp_CoEng_GbxRpmRduc verriegelte Funktionsidentifier" VAL_BLK 0xCF2C4 Kwb_Wu16 61811.0000000 FidName 0.00 61811.0000000 FORMAT "%13.7" NUMBER 6 /end CHARACTERISTIC
/begin CHARACTERISTIC DSM_InhDfp_CoVMDCSh_C "Durch Fehlerpfad Dfp_CoVMDCSh verriegelte Funktionsidentifier" VAL_BLK 0xCF2D0 Kwb_Wu16 61811.0000000 FidName 0.00 61811.0000000 FORMAT "%13.7" NUMBER 5 /end CHARACTERISTIC
/begin CHARACTERISTIC DSM_InhDfp_ConvCD_C "Durch Fehlerpfad Dfp_ConvCD verriegelte Funktionsidentifier" VAL_BLK 0xCF2DA Kwb_Wu16 61811.0000000 FidName 0.00 61811.0000000 FORMAT "%13.7" NUMBER 13 /end CHARACTERISTIC
/begin CHARACTERISTIC DSM_InhDfp_CrCCDMFL_C "Durch Fehlerpfad Dfp_CrCCDMFL verriegelte Funktionsidentifier" VAL_BLK 0xCF2F4 Kwb_Wu16 61811.0000000 FidName 0.00 61811.0000000 FORMAT "%13.7" NUMBER 6 /end CHARACTERISTIC
/begin CHARACTERISTIC DSM_InhDfp_CrCtl_vCrCtl_C "Durch Fehlerpfad Dfp_CrCtl_vCrCtl verriegelte Funktionsidentifier" VAL_BLK 0xCF300 Kwb_Wu16 61811.0000000 FidName 0.00 61811.0000000 FORMAT "%13.7" NUMBER 6 /end CHARACTERISTIC
/begin CHARACTERISTIC DSM_InhDfp_EATSCD_C "Durch Fehlerpfad Dfp_EATSCD verriegelte Funktionsidentifier" VAL_BLK 0xCF30C Kwb_Wu16 61811.0000000 FidName 0.00 61811.0000000 FORMAT "%13.7" NUMBER 12 /end CHARACTERISTIC
/begin CHARACTERISTIC DSM_InhDfp_EBAFCD_C "Durch Fehlerpfad Dfp_EBAFCD verriegelte Funktionsidentifier" VAL_BLK 0xCF324 Kwb_Wu16 61811.0000000 FidName 0.00 61811.0000000 FORMAT "%13.7" NUMBER 5 /end CHARACTERISTIC
/begin CHARACTERISTIC DSM_InhDfp_EBFCD_C "Durch Fehlerpfad Dfp_EBFCD verriegelte Funktionsidentifier" VAL_BLK 0xCF32E Kwb_Wu16 61811.0000000 FidName 0.00 61811.0000000 FORMAT "%13.7" NUMBER 5 /end CHARACTERISTIC
/begin CHARACTERISTIC DSM_InhDfp_EBTSCD_C "Durch Fehlerpfad Dfp_EBTSCD verriegelte Funktionsidentifier" VAL_BLK 0xCF338 Kwb_Wu16 61811.0000000 FidName 0.00 61811.0000000 FORMAT "%13.7" NUMBER 6 /end CHARACTERISTIC
/begin CHARACTERISTIC DSM_InhDfp_EBTSCD_OvrTemp_C "Durch Fehlerpfad Dfp_EBTSCD_OvrTemp verriegelte Funktionsidentifier" VAL_BLK 0xCF344 Kwb_Wu16 61811.0000000 FidName 0.00 61811.0000000 FORMAT "%13.7" NUMBER 5 /end CHARACTERISTIC
/begin CHARACTERISTIC DSM_InhDfp_EEPCDVarMng_C "Durch Fehlerpfad Dfp_EEPCDVarMng verriegelte Funktionsidentifier" VAL_BLK 0xCF34E Kwb_Wu16 61811.0000000 FidName 0.00 61811.0000000 FORMAT "%13.7" NUMBER 5 /end CHARACTERISTIC
/begin CHARACTERISTIC DSM_InhDfp_EGPpCD_C "Durch Fehlerpfad Dfp_EGPpCD verriegelte Funktionsidentifier" VAL_BLK 0xCF358 Kwb_Wu16 61811.0000000 FidName 0.00 61811.0000000 FORMAT "%13.7" NUMBER 5 /end CHARACTERISTIC
/begin CHARACTERISTIC DSM_InhDfp_EGRCD_Max_C "Durch Fehlerpfad Dfp_EGRCD_Max verriegelte Funktionsidentifier" VAL_BLK 0xCF362 Kwb_Wu16 61811.0000000 FidName 0.00 61811.0000000 FORMAT "%13.7" NUMBER 9 /end CHARACTERISTIC
/begin CHARACTERISTIC DSM_InhDfp_EGRCD_Max2_C "Durch Fehlerpfad Dfp_EGRCD_Max2 verriegelte Funktionsidentifier" VAL_BLK 0xCF374 Kwb_Wu16 61811.0000000 FidName 0.00 61811.0000000 FORMAT "%13.7" NUMBER 8 /end CHARACTERISTIC
/begin CHARACTERISTIC DSM_InhDfp_EGRCD_Min_C "Durch Fehlerpfad Dfp_EGRCD_Min verriegelte Funktionsidentifier" VAL_BLK 0xCF384 Kwb_Wu16 61811.0000000 FidName 0.00 61811.0000000 FORMAT "%13.7" NUMBER 10 /end CHARACTERISTIC
/begin CHARACTERISTIC DSM_InhDfp_EGRCD_Min2_C "Durch Fehlerpfad Dfp_EGRCD_Min2 verriegelte Funktionsidentifier" VAL_BLK 0xCF398 Kwb_Wu16 61811.0000000 FidName 0.00 61811.0000000 FORMAT "%13.7" NUMBER 9 /end CHARACTERISTIC
/begin CHARACTERISTIC DSM_InhDfp_EGRCD_PWMInDia1_C "Durch Fehlerpfad Dfp_EGRCD_PWMInDia1 verriegelte Funktionsidentifier" VAL_BLK 0xCF3AA Kwb_Wu16 61811.0000000 FidName 0.00 61811.0000000 FORMAT "%13.7" NUMBER 8 /end CHARACTERISTIC
/begin CHARACTERISTIC DSM_InhDfp_EGRCD_PWMInDia2_C "Durch Fehlerpfad Dfp_EGRCD_PWMInDia2 verriegelte Funktionsidentifier" VAL_BLK 0xCF3BA Kwb_Wu16 61811.0000000 FidName 0.00 61811.0000000 FORMAT "%13.7" NUMBER 8 /end CHARACTERISTIC
/begin CHARACTERISTIC DSM_InhDfp_EGRCD_PWMInDia21_C "Durch Fehlerpfad Dfp_EGRCD_PWMInDia21 verriegelte Funktionsidentifier" VAL_BLK 0xCF3CA Kwb_Wu16 61811.0000000 FidName 0.00 61811.0000000 FORMAT "%13.7" NUMBER 8 /end CHARACTERISTIC
/begin CHARACTERISTIC DSM_InhDfp_EGRCD_PWMInDia22_C "Durch Fehlerpfad Dfp_EGRCD_PWMInDia22 verriegelte Funktionsidentifier" VAL_BLK 0xCF3DA Kwb_Wu16 61811.0000000 FidName 0.00 61811.0000000 FORMAT "%13.7" NUMBER 8 /end CHARACTERISTIC
/begin CHARACTERISTIC DSM_InhDfp_EGRCD_PWMInDia23_C "Durch Fehlerpfad Dfp_EGRCD_PWMInDia23 verriegelte Funktionsidentifier" VAL_BLK 0xCF3EA Kwb_Wu16 61811.0000000 FidName 0.00 61811.0000000 FORMAT "%13.7" NUMBER 8 /end CHARACTERISTIC
/begin CHARACTERISTIC DSM_InhDfp_EGRCD_PWMInDia24_C "Durch Fehlerpfad Dfp_EGRCD_PWMInDia24 verriegelte Funktionsidentifier" VAL_BLK 0xCF3FA Kwb_Wu16 61811.0000000 FidName 0.00 61811.0000000 FORMAT "%13.7" NUMBER 8 /end CHARACTERISTIC
/begin CHARACTERISTIC DSM_InhDfp_EGRCD_PWMInDia3_C "Durch Fehlerpfad Dfp_EGRCD_PWMInDia3 verriegelte Funktionsidentifier" VAL_BLK 0xCF40A Kwb_Wu16 61811.0000000 FidName 0.00 61811.0000000 FORMAT "%13.7" NUMBER 8 /end CHARACTERISTIC
/begin CHARACTERISTIC DSM_InhDfp_EGRCD_PWMInDia4_C "Durch Fehlerpfad Dfp_EGRCD_PWMInDia4 verriegelte Funktionsidentifier" VAL_BLK 0xCF41A Kwb_Wu16 61811.0000000 FidName 0.00 61811.0000000 FORMAT "%13.7" NUMBER 8 /end CHARACTERISTIC
/begin CHARACTERISTIC DSM_InhDfp_EGRCD_SigDia_C "Durch Fehlerpfad Dfp_EGRCD_SigDia verriegelte Funktionsidentifier" VAL_BLK 0xCF42A Kwb_Wu16 61811.0000000 FidName 0.00 61811.0000000 FORMAT "%13.7" NUMBER 5 /end CHARACTERISTIC
/begin CHARACTERISTIC DSM_InhDfp_EGRCD_SigDia2_C "Durch Fehlerpfad Dfp_EGRCD_SigDia2 verriegelte Funktionsidentifier" VAL_BLK 0xCF434 Kwb_Wu16 61811.0000000 FidName 0.00 61811.0000000 FORMAT "%13.7" NUMBER 5 /end CHARACTERISTIC
/begin CHARACTERISTIC DSM_InhDfp_EGRCD_SigNpl_C "Durch Fehlerpfad Dfp_EGRCD_SigNpl verriegelte Funktionsidentifier" VAL_BLK 0xCF43E Kwb_Wu16 61811.0000000 FidName 0.00 61811.0000000 FORMAT "%13.7" NUMBER 10 /end CHARACTERISTIC
/begin CHARACTERISTIC DSM_InhDfp_EGRCD_SigNpl2_C "Durch Fehlerpfad Dfp_EGRCD_SigNpl2 verriegelte Funktionsidentifier" VAL_BLK 0xCF452 Kwb_Wu16 61811.0000000 FidName 0.00 61811.0000000 FORMAT "%13.7" NUMBER 8 /end CHARACTERISTIC
/begin CHARACTERISTIC DSM_InhDfp_EGTOilLvlCrit_C "Durch Fehlerpfad Dfp_EGTOilLvlCrit verriegelte Funktionsidentifier" VAL_BLK 0xCF462 Kwb_Wu16 61811.0000000 FidName 0.00 61811.0000000 FORMAT "%13.7" NUMBER 5 /end CHARACTERISTIC
/begin CHARACTERISTIC DSM_InhDfp_EGTOilVscCrit_C "Durch Fehlerpfad Dfp_EGTOilVscCrit verriegelte Funktionsidentifier" VAL_BLK 0xCF46C Kwb_Wu16 61811.0000000 FidName 0.00 61811.0000000 FORMAT "%13.7" NUMBER 5 /end CHARACTERISTIC
/begin CHARACTERISTIC DSM_InhDfp_EGTRgnOilDil_C "Durch Fehlerpfad Dfp_EGTRgnOilDil verriegelte Funktionsidentifier" VAL_BLK 0xCF476 Kwb_Wu16 61811.0000000 FidName 0.00 61811.0000000 FORMAT "%13.7" NUMBER 16 /end CHARACTERISTIC
/begin CHARACTERISTIC DSM_InhDfp_EGTTempGvnrInrB1_C "Durch Fehlerpfad Dfp_EGTTempGvnrInrB1 verriegelte Funktionsidentifier" VAL_BLK 0xCF496 Kwb_Wu16 61811.0000000 FidName 0.00 61811.0000000 FORMAT "%13.7" NUMBER 15 /end CHARACTERISTIC
/begin CHARACTERISTIC DSM_InhDfp_EGTTempGvnrInrB2_C "Durch Fehlerpfad Dfp_EGTTempGvnrInrB2 verriegelte Funktionsidentifier" VAL_BLK 0xCF4B4 Kwb_Wu16 61811.0000000 FidName 0.00 61811.0000000 FORMAT "%13.7" NUMBER 15 /end CHARACTERISTIC
/begin CHARACTERISTIC DSM_InhDfp_EGTTempGvnrOutrB1_C "Durch Fehlerpfad Dfp_EGTTempGvnrOutrB1 verriegelte Funktionsidentifier" VAL_BLK 0xCF4D2 Kwb_Wu16 61811.0000000 FidName 0.00 61811.0000000 FORMAT "%13.7" NUMBER 15 /end CHARACTERISTIC
/begin CHARACTERISTIC DSM_InhDfp_EGTTempGvnrOutrB2_C "Durch Fehlerpfad Dfp_EGTTempGvnrOutrB2 verriegelte Funktionsidentifier" VAL_BLK 0xCF4F0 Kwb_Wu16 61811.0000000 FidName 0.00 61811.0000000 FORMAT "%13.7" NUMBER 15 /end CHARACTERISTIC
/begin CHARACTERISTIC DSM_InhDfp_ETClbETFltInj1_C "Durch Fehlerpfad Dfp_ETClbETFltInj1 verriegelte Funktionsidentifier" VAL_BLK 0xCF50E Kwb_Wu16 61811.0000000 FidName 0.00 61811.0000000 FORMAT "%13.7" NUMBER 5 /end CHARACTERISTIC
/begin CHARACTERISTIC DSM_InhDfp_ETClbETFltInj2_C "Durch Fehlerpfad Dfp_ETClbETFltInj2 verriegelte Funktionsidentifier" VAL_BLK 0xCF518 Kwb_Wu16 61811.0000000 FidName 0.00 61811.0000000 FORMAT "%13.7" NUMBER 5 /end CHARACTERISTIC
/begin CHARACTERISTIC DSM_InhDfp_ETClbETFltInj3_C "Durch Fehlerpfad Dfp_ETClbETFltInj3 verriegelte Funktionsidentifier" VAL_BLK 0xCF522 Kwb_Wu16 61811.0000000 FidName 0.00 61811.0000000 FORMAT "%13.7" NUMBER 5 /end CHARACTERISTIC
/begin CHARACTERISTIC DSM_InhDfp_ETClbETFltInj4_C "Durch Fehlerpfad Dfp_ETClbETFltInj4 verriegelte Funktionsidentifier" VAL_BLK 0xCF52C Kwb_Wu16 61811.0000000 FidName 0.00 61811.0000000 FORMAT "%13.7" NUMBER 5 /end CHARACTERISTIC
/begin CHARACTERISTIC DSM_InhDfp_ETClbETFltInj5_C "Durch Fehlerpfad Dfp_ETClbETFltInj5 verriegelte Funktionsidentifier" VAL_BLK 0xCF536 Kwb_Wu16 61811.0000000 FidName 0.00 61811.0000000 FORMAT "%13.7" NUMBER 5 /end CHARACTERISTIC
/begin CHARACTERISTIC DSM_InhDfp_ETClbETFltInj6_C "Durch Fehlerpfad Dfp_ETClbETFltInj6 verriegelte Funktionsidentifier" VAL_BLK 0xCF540 Kwb_Wu16 61811.0000000 FidName 0.00 61811.0000000 FORMAT "%13.7" NUMBER 5 /end CHARACTERISTIC
/begin CHARACTERISTIC DSM_InhDfp_ETClbETFltInj7_C "Durch Fehlerpfad Dfp_ETClbETFltInj7 verriegelte Funktionsidentifier" VAL_BLK 0xCF54A Kwb_Wu16 61811.0000000 FidName 0.00 61811.0000000 FORMAT "%13.7" NUMBER 5 /end CHARACTERISTIC
/begin CHARACTERISTIC DSM_InhDfp_ETClbETFltInj8_C "Durch Fehlerpfad Dfp_ETClbETFltInj8 verriegelte Funktionsidentifier" VAL_BLK 0xCF554 Kwb_Wu16 61811.0000000 FidName 0.00 61811.0000000 FORMAT "%13.7" NUMBER 5 /end CHARACTERISTIC
/begin CHARACTERISTIC DSM_InhDfp_ETClbInj1_C "Durch Fehlerpfad Dfp_ETClbInj1 verriegelte Funktionsidentifier" VAL_BLK 0xCF55E Kwb_Wu16 61811.0000000 FidName 0.00 61811.0000000 FORMAT "%13.7" NUMBER 5 /end CHARACTERISTIC
/begin CHARACTERISTIC DSM_InhDfp_ETClbInj2_C "Durch Fehlerpfad Dfp_ETClbInj2 verriegelte Funktionsidentifier" VAL_BLK 0xCF568 Kwb_Wu16 61811.0000000 FidName 0.00 61811.0000000 FORMAT "%13.7" NUMBER 5 /end CHARACTERISTIC
/begin CHARACTERISTIC DSM_InhDfp_ETClbInj3_C "Durch Fehlerpfad Dfp_ETClbInj3 verriegelte Funktionsidentifier" VAL_BLK 0xCF572 Kwb_Wu16 61811.0000000 FidName 0.00 61811.0000000 FORMAT "%13.7" NUMBER 5 /end CHARACTERISTIC
/begin CHARACTERISTIC DSM_InhDfp_ETClbInj4_C "Durch Fehlerpfad Dfp_ETClbInj4 verriegelte Funktionsidentifier" VAL_BLK 0xCF57C Kwb_Wu16 61811.0000000 FidName 0.00 61811.0000000 FORMAT "%13.7" NUMBER 5 /end CHARACTERISTIC
/begin CHARACTERISTIC DSM_InhDfp_ETClbInj5_C "Durch Fehlerpfad Dfp_ETClbInj5 verriegelte Funktionsidentifier" VAL_BLK 0xCF586 Kwb_Wu16 61811.0000000 FidName 0.00 61811.0000000 FORMAT "%13.7" NUMBER 5 /end CHARACTERISTIC
/begin CHARACTERISTIC DSM_InhDfp_ETClbInj6_C "Durch Fehlerpfad Dfp_ETClbInj6 verriegelte Funktionsidentifier" VAL_BLK 0xCF590 Kwb_Wu16 61811.0000000 FidName 0.00 61811.0000000 FORMAT "%13.7" NUMBER 5 /end CHARACTERISTIC
/begin CHARACTERISTIC DSM_InhDfp_ETClbInj7_C "Durch Fehlerpfad Dfp_ETClbInj7 verriegelte Funktionsidentifier" VAL_BLK 0xCF59A Kwb_Wu16 61811.0000000 FidName 0.00 61811.0000000 FORMAT "%13.7" NUMBER 5 /end CHARACTERISTIC
/begin CHARACTERISTIC DSM_InhDfp_ETClbInj8_C "Durch Fehlerpfad Dfp_ETClbInj8 verriegelte Funktionsidentifier" VAL_BLK 0xCF5A4 Kwb_Wu16 61811.0000000 FidName 0.00 61811.0000000 FORMAT "%13.7" NUMBER 5 /end CHARACTERISTIC
/begin CHARACTERISTIC DSM_InhDfp_EngMCaS1_C "Durch Fehlerpfad Dfp_EngMCaS1 verriegelte Funktionsidentifier" VAL_BLK 0xCF5AE Kwb_Wu16 61811.0000000 FidName 0.00 61811.0000000 FORMAT "%13.7" NUMBER 12 /end CHARACTERISTIC
/begin CHARACTERISTIC DSM_InhDfp_EngMCrS1_C "Durch Fehlerpfad Dfp_EngMCrS1 verriegelte Funktionsidentifier" VAL_BLK 0xCF5C6 Kwb_Wu16 61811.0000000 FidName 0.00 61811.0000000 FORMAT "%13.7" NUMBER 18 /end CHARACTERISTIC
/begin CHARACTERISTIC DSM_InhDfp_EngMOfsCaSCrS_C "Durch Fehlerpfad Dfp_EngMOfsCaSCrS verriegelte Funktionsidentifier" VAL_BLK 0xCF5EA Kwb_Wu16 61811.0000000 FidName 0.00 61811.0000000 FORMAT "%13.7" NUMBER 7 /end CHARACTERISTIC
/begin CHARACTERISTIC DSM_InhDfp_EngMntCtlCD_C "Durch Fehlerpfad Dfp_EngMntCtlCD verriegelte Funktionsidentifier" VAL_BLK 0xCF5F8 Kwb_Wu16 61811.0000000 FidName 0.00 61811.0000000 FORMAT "%13.7" NUMBER 5 /end CHARACTERISTIC
/begin CHARACTERISTIC DSM_InhDfp_FBCqDvt_C "Durch Fehlerpfad Dfp_FBCqDvt verriegelte Funktionsidentifier" VAL_BLK 0xCF602 Kwb_Wu16 61811.0000000 FidName 0.00 61811.0000000 FORMAT "%13.7" NUMBER 5 /end CHARACTERISTIC
/begin CHARACTERISTIC DSM_InhDfp_FMAErrMod_C "Durch Fehlerpfad Dfp_FMAErrMod verriegelte Funktionsidentifier" VAL_BLK 0xCF60C Kwb_Wu16 61811.0000000 FidName 0.00 61811.0000000 FORMAT "%13.7" NUMBER 5 /end CHARACTERISTIC
/begin CHARACTERISTIC DSM_InhDfp_FMTC_NonMonotonMap_C "Durch Fehlerpfad Dfp_FMTC_NonMonotonMap verriegelte Funktionsidentifier" VAL_BLK 0xCF616 Kwb_Wu16 61811.0000000 FidName 0.00 61811.0000000 FORMAT "%13.7" NUMBER 5 /end CHARACTERISTIC
/begin CHARACTERISTIC DSM_InhDfp_FTSCD_C "Durch Fehlerpfad Dfp_FTSCD verriegelte Funktionsidentifier" VAL_BLK 0xCF620 Kwb_Wu16 61811.0000000 FidName 0.00 61811.0000000 FORMAT "%13.7" NUMBER 12 /end CHARACTERISTIC
/begin CHARACTERISTIC DSM_InhDfp_FanCD_C "Durch Fehlerpfad Dfp_FanCD verriegelte Funktionsidentifier" VAL_BLK 0xCF638 Kwb_Wu16 61811.0000000 FidName 0.00 61811.0000000 FORMAT "%13.7" NUMBER 7 /end CHARACTERISTIC
/begin CHARACTERISTIC DSM_InhDfp_FanCD_FanCtlr1_C "Durch Fehlerpfad Dfp_FanCD_FanCtlr1 verriegelte Funktionsidentifier" VAL_BLK 0xCF646 Kwb_Wu16 61811.0000000 FidName 0.00 61811.0000000 FORMAT "%13.7" NUMBER 7 /end CHARACTERISTIC
/begin CHARACTERISTIC DSM_InhDfp_FanCD_FanCtlr2_C "Durch Fehlerpfad Dfp_FanCD_FanCtlr2 verriegelte Funktionsidentifier" VAL_BLK 0xCF654 Kwb_Wu16 61811.0000000 FidName 0.00 61811.0000000 FORMAT "%13.7" NUMBER 6 /end CHARACTERISTIC
/begin CHARACTERISTIC DSM_InhDfp_FanCD_FanCtlr3_C "Durch Fehlerpfad Dfp_FanCD_FanCtlr3 verriegelte Funktionsidentifier" VAL_BLK 0xCF660 Kwb_Wu16 61811.0000000 FidName 0.00 61811.0000000 FORMAT "%13.7" NUMBER 6 /end CHARACTERISTIC
/begin CHARACTERISTIC DSM_InhDfp_FlFCD_C "Durch Fehlerpfad Dfp_FlFCD verriegelte Funktionsidentifier" VAL_BLK 0xCF66C Kwb_Wu16 61811.0000000 FidName 0.00 61811.0000000 FORMAT "%13.7" NUMBER 5 /end CHARACTERISTIC
/begin CHARACTERISTIC DSM_InhDfp_FlMngSmkDefect_C "Durch Fehlerpfad Dfp_FlMngSmkDefect verriegelte Funktionsidentifier" VAL_BLK 0xCF676 Kwb_Wu16 61811.0000000 FidName 0.00 61811.0000000 FORMAT "%13.7" NUMBER 5 /end CHARACTERISTIC
/begin CHARACTERISTIC DSM_InhDfp_FlSCDT1_C "Durch Fehlerpfad Dfp_FlSCDT1 verriegelte Funktionsidentifier" VAL_BLK 0xCF680 Kwb_Wu16 61811.0000000 FidName 0.00 61811.0000000 FORMAT "%13.7" NUMBER 5 /end CHARACTERISTIC
/begin CHARACTERISTIC DSM_InhDfp_FrmMngANFRADMOMPT_C "Durch Fehlerpfad Dfp_FrmMngANFRADMOMPT verriegelte Funktionsidentifier" VAL_BLK 0xCF68A Kwb_Wu16 61811.0000000 FidName 0.00 61811.0000000 FORMAT "%13.7" NUMBER 5 /end CHARACTERISTIC
/begin CHARACTERISTIC DSM_InhDfp_FrmMngASC1_C "Durch Fehlerpfad Dfp_FrmMngASC1 verriegelte Funktionsidentifier" VAL_BLK 0xCF694 Kwb_Wu16 61811.0000000 FidName 0.00 61811.0000000 FORMAT "%13.7" NUMBER 7 /end CHARACTERISTIC
/begin CHARACTERISTIC DSM_InhDfp_FrmMngASC2_C "Durch Fehlerpfad Dfp_FrmMngASC2 verriegelte Funktionsidentifier" VAL_BLK 0xCF6A2 Kwb_Wu16 61811.0000000 FidName 0.00 61811.0000000 FORMAT "%13.7" NUMBER 6 /end CHARACTERISTIC
/begin CHARACTERISTIC DSM_InhDfp_FrmMngASC3_C "Durch Fehlerpfad Dfp_FrmMngASC3 verriegelte Funktionsidentifier" VAL_BLK 0xCF6AE Kwb_Wu16 61811.0000000 FidName 0.00 61811.0000000 FORMAT "%13.7" NUMBER 6 /end CHARACTERISTIC
/begin CHARACTERISTIC DSM_InhDfp_FrmMngASC4_C "Durch Fehlerpfad Dfp_FrmMngASC4 verriegelte Funktionsidentifier" VAL_BLK 0xCF6BA Kwb_Wu16 61811.0000000 FidName 0.00 61811.0000000 FORMAT "%13.7" NUMBER 5 /end CHARACTERISTIC
/begin CHARACTERISTIC DSM_InhDfp_FrmMngBOS_RESET_C "Durch Fehlerpfad Dfp_FrmMngBOS_RESET verriegelte Funktionsidentifier" VAL_BLK 0xCF6C4 Kwb_Wu16 61811.0000000 FidName 0.00 61811.0000000 FORMAT "%13.7" NUMBER 5 /end CHARACTERISTIC
/begin CHARACTERISTIC DSM_InhDfp_FrmMngBOS_RESET2_C "Durch Fehlerpfad Dfp_FrmMngBOS_RESET2 verriegelte Funktionsidentifier" VAL_BLK 0xCF6CE Kwb_Wu16 61811.0000000 FidName 0.00 61811.0000000 FORMAT "%13.7" NUMBER 5 /end CHARACTERISTIC
/begin CHARACTERISTIC DSM_InhDfp_FrmMngDMANFAFS_C "Durch Fehlerpfad Dfp_FrmMngDMANFAFS verriegelte Funktionsidentifier" VAL_BLK 0xCF6D8 Kwb_Wu16 61811.0000000 FidName 0.00 61811.0000000 FORMAT "%13.7" NUMBER 5 /end CHARACTERISTIC
/begin CHARACTERISTIC DSM_InhDfp_FrmMngDRMANFSSG_C "Durch Fehlerpfad Dfp_FrmMngDRMANFSSG verriegelte Funktionsidentifier" VAL_BLK 0xCF6E2 Kwb_Wu16 61811.0000000 FidName 0.00 61811.0000000 FORMAT "%13.7" NUMBER 7 /end CHARACTERISTIC
/begin CHARACTERISTIC DSM_InhDfp_FrmMngEGS1_C "Durch Fehlerpfad Dfp_FrmMngEGS1 verriegelte Funktionsidentifier" VAL_BLK 0xCF6F0 Kwb_Wu16 61811.0000000 FidName 0.00 61811.0000000 FORMAT "%13.7" NUMBER 7 /end CHARACTERISTIC
/begin CHARACTERISTIC DSM_InhDfp_FrmMngEGS2_C "Durch Fehlerpfad Dfp_FrmMngEGS2 verriegelte Funktionsidentifier" VAL_BLK 0xCF6FE Kwb_Wu16 61811.0000000 FidName 0.00 61811.0000000 FORMAT "%13.7" NUMBER 5 /end CHARACTERISTIC
/begin CHARACTERISTIC DSM_InhDfp_FrmMngGEARBX_DATA_C "FIDs to be inhibited by path" VAL_BLK 0xCF708 Kwb_Wu16 61811.0000000 FidName 0.00 61811.0000000 FORMAT "%13.7" NUMBER 9 /end CHARACTERISTIC
/begin CHARACTERISTIC DSM_InhDfp_FrmMngGEARBX_DATA2_C "Durch Fehlerpfad Dfp_FrmMngGEARBX_DATA2 verriegelte Funktionsidentifier" VAL_BLK 0xCF71A Kwb_Wu16 61811.0000000 FidName 0.00 61811.0000000 FORMAT "%13.7" NUMBER 6 /end CHARACTERISTIC
/begin CHARACTERISTIC DSM_InhDfp_FrmMngHEAT_AC_C "FIDs to be inhibited by path" VAL_BLK 0xCF726 Kwb_Wu16 61811.0000000 FidName 0.00 61811.0000000 FORMAT "%13.7" NUMBER 6 /end CHARACTERISTIC
/begin CHARACTERISTIC DSM_InhDfp_FrmMngINSTR2_C "Durch Fehlerpfad Dfp_FrmMngINSTR2 verriegelte Funktionsidentifier" VAL_BLK 0xCF732 Kwb_Wu16 61811.0000000 FidName 0.00 61811.0000000 FORMAT "%13.7" NUMBER 5 /end CHARACTERISTIC
/begin CHARACTERISTIC DSM_InhDfp_FrmMngINSTR3_C "Durch Fehlerpfad Dfp_FrmMngINSTR3 verriegelte Funktionsidentifier" VAL_BLK 0xCF73C Kwb_Wu16 61811.0000000 FidName 0.00 61811.0000000 FORMAT "%13.7" NUMBER 5 /end CHARACTERISTIC
/begin CHARACTERISTIC DSM_InhDfp_FrmMngLENKRADWINKEL_C "Durch Fehlerpfad Dfp_FrmMngLENKRADWINKEL verriegelte Funktionsidentifier" VAL_BLK 0xCF746 Kwb_Wu16 61811.0000000 FidName 0.00 61811.0000000 FORMAT "%13.7" NUMBER 6 /end CHARACTERISTIC
/begin CHARACTERISTIC DSM_InhDfp_FrmMngMILEAGE_RANGE_C "Durch Fehlerpfad Dfp_FrmMngMILEAGE_RANGE verriegelte Funktionsidentifier" VAL_BLK 0xCF752 Kwb_Wu16 61811.0000000 FidName 0.00 61811.0000000 FORMAT "%13.7" NUMBER 5 /end CHARACTERISTIC
/begin CHARACTERISTIC DSM_InhDfp_FrmMngMSPHISYNC_C "Durch Fehlerpfad Dfp_FrmMngMSPHISYNC verriegelte Funktionsidentifier" VAL_BLK 0xCF75C Kwb_Wu16 61811.0000000 FidName 0.00 61811.0000000 FORMAT "%13.7" NUMBER 5 /end CHARACTERISTIC
/begin CHARACTERISTIC DSM_InhDfp_FrmMngMST4_C "Durch Fehlerpfad Dfp_FrmMngMST4 verriegelte Funktionsidentifier" VAL_BLK 0xCF766 Kwb_Wu16 61811.0000000 FidName 0.00 61811.0000000 FORMAT "%13.7" NUMBER 5 /end CHARACTERISTIC
/begin CHARACTERISTIC DSM_InhDfp_FrmMngMST5_C "Durch Fehlerpfad Dfp_FrmMngMST5 verriegelte Funktionsidentifier" VAL_BLK 0xCF770 Kwb_Wu16 61811.0000000 FidName 0.00 61811.0000000 FORMAT "%13.7" NUMBER 6 /end CHARACTERISTIC
/begin CHARACTERISTIC DSM_InhDfp_FrmMngOPCRCTLACC_C "Durch Fehlerpfad Dfp_FrmMngOPCRCTLACC verriegelte Funktionsidentifier" VAL_BLK 0xCF77C Kwb_Wu16 61811.0000000 FidName 0.00 61811.0000000 FORMAT "%13.7" NUMBER 7 /end CHARACTERISTIC
/begin CHARACTERISTIC DSM_InhDfp_FrmMngPRGG_CCTR_C "Durch Fehlerpfad Dfp_FrmMngPRGG_CCTR verriegelte Funktionsidentifier" VAL_BLK 0xCF78A Kwb_Wu16 61811.0000000 FidName 0.00 61811.0000000 FORMAT "%13.7" NUMBER 5 /end CHARACTERISTIC
/begin CHARACTERISTIC DSM_InhDfp_FrmMngPWRMNG_LOADV_C "Durch Fehlerpfad Dfp_FrmMngPWRMNG_LOADV verriegelte Funktionsidentifier" VAL_BLK 0xCF794 Kwb_Wu16 61811.0000000 FidName 0.00 61811.0000000 FORMAT "%13.7" NUMBER 5 /end CHARACTERISTIC
/begin CHARACTERISTIC DSM_InhDfp_FrmMngParkConsumer_C "Durch Fehlerpfad Dfp_FrmMngParkConsumer verriegelte Funktionsidentifier" VAL_BLK 0xCF79E Kwb_Wu16 61811.0000000 FidName 0.00 61811.0000000 FORMAT "%13.7" NUMBER 6 /end CHARACTERISTIC
/begin CHARACTERISTIC DSM_InhDfp_FrmMngRQSTGEFAN_C "Durch Fehlerpfad Dfp_FrmMngRQSTGEFAN_C verriegelte Funktionsidentifier" VAL_BLK 0xCF7AA Kwb_Wu16 61811.0000000 FidName 0.00 61811.0000000 FORMAT "%13.7" NUMBER 5 /end CHARACTERISTIC
/begin CHARACTERISTIC DSM_InhDfp_FrmMngSLV4_C "Durch Fehlerpfad Dfp_FrmMngSLV4 verriegelte Funktionsidentifier" VAL_BLK 0xCF7B4 Kwb_Wu16 61811.0000000 FidName 0.00 61811.0000000 FORMAT "%13.7" NUMBER 5 /end CHARACTERISTIC
/begin CHARACTERISTIC DSM_InhDfp_FrmMngSLV5_C "Durch Fehlerpfad Dfp_FrmMngSLV5 verriegelte Funktionsidentifier" VAL_BLK 0xCF7BE Kwb_Wu16 61811.0000000 FidName 0.00 61811.0000000 FORMAT "%13.7" NUMBER 6 /end CHARACTERISTIC
/begin CHARACTERISTIC DSM_InhDfp_FrmMngSSGErr_C "Durch Fehlerpfad Dfp_FrmMngSSGErr verriegelte Funktionsidentifier" VAL_BLK 0xCF7CA Kwb_Wu16 61811.0000000 FidName 0.00 61811.0000000 FORMAT "%13.7" NUMBER 9 /end CHARACTERISTIC
/begin CHARACTERISTIC DSM_InhDfp_FrmMngSSGShOff_C "Durch Fehlerpfad Dfp_FrmMngSSGShOff verriegelte Funktionsidentifier" VAL_BLK 0xCF7DC Kwb_Wu16 61811.0000000 FidName 0.00 61811.0000000 FORMAT "%13.7" NUMBER 5 /end CHARACTERISTIC
/begin CHARACTERISTIC DSM_InhDfp_FrmMngSTAT_ANH_C "Durch Fehlerpfad Dfp_FrmMngSTAT_ANH verriegelte Funktionsidentifier" VAL_BLK 0xCF7E6 Kwb_Wu16 61811.0000000 FidName 0.00 61811.0000000 FORMAT "%13.7" NUMBER 5 /end CHARACTERISTIC
/begin CHARACTERISTIC DSM_InhDfp_FrmMngSTAT_ARS_C "FIDs to be inhibited by path" VAL_BLK 0xCF7F0 Kwb_Wu16 61811.0000000 FidName 0.00 61811.0000000 FORMAT "%13.7" NUMBER 8 /end CHARACTERISTIC
/begin CHARACTERISTIC DSM_InhDfp_FrmMngSTAT_DSC_C "FIDs to be inhibited by path" VAL_BLK 0xCF800 Kwb_Wu16 61811.0000000 FidName 0.00 61811.0000000 FORMAT "%13.7" NUMBER 8 /end CHARACTERISTIC
/begin CHARACTERISTIC DSM_InhDfp_FrmMngSTAT_EKP_C "Durch Fehlerpfad Dfp_FrmMngSTAT_EKP verriegelte Funktionsidentifier" VAL_BLK 0xCF810 Kwb_Wu16 61811.0000000 FidName 0.00 61811.0000000 FORMAT "%13.7" NUMBER 5 /end CHARACTERISTIC
/begin CHARACTERISTIC DSM_InhDfp_FrmMngSTAT_KOMBI_C "Durch Fehlerpfad Dfp_FrmMngSTAT_KOMBI verriegelte Funktionsidentifier" VAL_BLK 0xCF81A Kwb_Wu16 61811.0000000 FidName 0.00 61811.0000000 FORMAT "%13.7" NUMBER 6 /end CHARACTERISTIC
/begin CHARACTERISTIC DSM_InhDfp_FrmMngSTAT_SITZ_C "Durch Fehlerpfad Dfp_FrmMngSTAT_SITZ verriegelte Funktionsidentifier" VAL_BLK 0xCF826 Kwb_Wu16 61811.0000000 FidName 0.00 61811.0000000 FORMAT "%13.7" NUMBER 5 /end CHARACTERISTIC
/begin CHARACTERISTIC DSM_InhDfp_FrmMngStOBDGbxMilOf_C "Durch Fehlerpfad Dfp_FrmMngStOBDGbxMilOf verriegelte Funktionsidentifier" VAL_BLK 0xCF830 Kwb_Wu16 61811.0000000 FidName 0.00 61811.0000000 FORMAT "%13.7" NUMBER 5 /end CHARACTERISTIC
/begin CHARACTERISTIC DSM_InhDfp_FrmMngStOBDGbxMilOn_C "Durch Fehlerpfad Dfp_FrmMngStOBDGbxMilOn verriegelte Funktionsidentifier" VAL_BLK 0xCF83A Kwb_Wu16 61811.0000000 FidName 0.00 61811.0000000 FORMAT "%13.7" NUMBER 5 /end CHARACTERISTIC
/begin CHARACTERISTIC DSM_InhDfp_FrmMngTEMPRELTIME_C "Durch Fehlerpfad Dfp_FrmMngTEMPRELTIME verriegelte Funktionsidentifier" VAL_BLK 0xCF844 Kwb_Wu16 61811.0000000 FidName 0.00 61811.0000000 FORMAT "%13.7" NUMBER 6 /end CHARACTERISTIC
/begin CHARACTERISTIC DSM_InhDfp_FrmMngTERMINAL_C "FIDs to be inhibited by path" VAL_BLK 0xCF850 Kwb_Wu16 61811.0000000 FidName 0.00 61811.0000000 FORMAT "%13.7" NUMBER 6 /end CHARACTERISTIC
/begin CHARACTERISTIC DSM_InhDfp_FrmMngTIME_DATE_C "Durch Fehlerpfad Dfp_FrmMngTIME_DATE verriegelte Funktionsidentifier" VAL_BLK 0xCF85C Kwb_Wu16 61811.0000000 FidName 0.00 61811.0000000 FORMAT "%13.7" NUMBER 5 /end CHARACTERISTIC
/begin CHARACTERISTIC DSM_InhDfp_FrmMngTORQUE_DSC_C "FIDs to be inhibited by path" VAL_BLK 0xCF866 Kwb_Wu16 61811.0000000 FidName 0.00 61811.0000000 FORMAT "%13.7" NUMBER 11 /end CHARACTERISTIC
/begin CHARACTERISTIC DSM_InhDfp_FrmMngTORQUE_GEARBX_C "FIDs to be inhibited by path" VAL_BLK 0xCF87C Kwb_Wu16 61811.0000000 FidName 0.00 61811.0000000 FORMAT "%13.7" NUMBER 12 /end CHARACTERISTIC
/begin CHARACTERISTIC DSM_InhDfp_FrmMngTrq_ReqACC_C "Durch Fehlerpfad Dfp_FrmMngTrq_ReqACC verriegelte Funktionsidentifier" VAL_BLK 0xCF894 Kwb_Wu16 61811.0000000 FidName 0.00 61811.0000000 FORMAT "%13.7" NUMBER 10 /end CHARACTERISTIC
/begin CHARACTERISTIC DSM_InhDfp_FrmMngVEH_MOD_C "Durch Fehlerpfad Dfp_FrmMngVEH_MOD_C verriegelte Funktionsidentifier" VAL_BLK 0xCF8A8 Kwb_Wu16 61811.0000000 FidName 0.00 61811.0000000 FORMAT "%13.7" NUMBER 5 /end CHARACTERISTIC
/begin CHARACTERISTIC DSM_InhDfp_FrmMngVELOCITY_C "FIDs to be inhibited by path" VAL_BLK 0xCF8B2 Kwb_Wu16 61811.0000000 FidName 0.00 61811.0000000 FORMAT "%13.7" NUMBER 5 /end CHARACTERISTIC
/begin CHARACTERISTIC DSM_InhDfp_FrmMngWHEEL_SPEED_C "Durch Fehlerpfad Dfp_FrmMngWHEEL_SPEED verriegelte Funktionsidentifier" VAL_BLK 0xCF8BC Kwb_Wu16 61811.0000000 FidName 0.00 61811.0000000 FORMAT "%13.7" NUMBER 7 /end CHARACTERISTIC
/begin CHARACTERISTIC DSM_InhDfp_FrmMngstCurr_C "Fid Nummern für Dfp_FrmMngstCurr" VAL_BLK 0xCF8CA Kwb_Wu16 61811.0000000 FidName 0.00 61811.0000000 FORMAT "%13.7" NUMBER 5 /end CHARACTERISTIC
/begin CHARACTERISTIC DSM_InhDfp_FrmMngswtPSPOff_C "Fid Nummern für Dfp_FrmMngswtPSPOff" VAL_BLK 0xCF8D4 Kwb_Wu16 61811.0000000 FidName 0.00 61811.0000000 FORMAT "%13.7" NUMBER 5 /end CHARACTERISTIC
/begin CHARACTERISTIC DSM_InhDfp_GearbxIncMax_C "Durch Fehlerpfad Dfp_GearbxIncMax verriegelte Funktionsidentifier" VAL_BLK 0xCF8DE Kwb_Wu16 61811.0000000 FidName 0.00 61811.0000000 FORMAT "%13.7" NUMBER 5 /end CHARACTERISTIC
/begin CHARACTERISTIC DSM_InhDfp_GlwCD_C "Durch Fehlerpfad Dfp_GlwCD verriegelte Funktionsidentifier" VAL_BLK 0xCF8E8 Kwb_Wu16 61811.0000000 FidName 0.00 61811.0000000 FORMAT "%13.7" NUMBER 5 /end CHARACTERISTIC
/begin CHARACTERISTIC DSM_InhDfp_GlwCDGlwCirc1_C "Durch Fehlerpfad Dfp_GlwCDGlwCirc1 verriegelte Funktionsidentifier" VAL_BLK 0xCF8F2 Kwb_Wu16 61811.0000000 FidName 0.00 61811.0000000 FORMAT "%13.7" NUMBER 5 /end CHARACTERISTIC
/begin CHARACTERISTIC DSM_InhDfp_GlwCDGlwCirc2_C "Durch Fehlerpfad Dfp_GlwCDGlwCirc2 verriegelte Funktionsidentifier" VAL_BLK 0xCF8FC Kwb_Wu16 61811.0000000 FidName 0.00 61811.0000000 FORMAT "%13.7" NUMBER 5 /end CHARACTERISTIC
/begin CHARACTERISTIC DSM_InhDfp_GlwCDGlwCirc3_C "Durch Fehlerpfad Dfp_GlwCDGlwCirc3 verriegelte Funktionsidentifier" VAL_BLK 0xCF906 Kwb_Wu16 61811.0000000 FidName 0.00 61811.0000000 FORMAT "%13.7" NUMBER 5 /end CHARACTERISTIC
/begin CHARACTERISTIC DSM_InhDfp_GlwCDGlwCirc4_C "Durch Fehlerpfad Dfp_GlwCDGlwCirc4 verriegelte Funktionsidentifier" VAL_BLK 0xCF910 Kwb_Wu16 61811.0000000 FidName 0.00 61811.0000000 FORMAT "%13.7" NUMBER 5 /end CHARACTERISTIC
/begin CHARACTERISTIC DSM_InhDfp_GlwCDGlwCirc5_C "Durch Fehlerpfad Dfp_GlwCDGlwCirc5 verriegelte Funktionsidentifier" VAL_BLK 0xCF91A Kwb_Wu16 61811.0000000 FidName 0.00 61811.0000000 FORMAT "%13.7" NUMBER 5 /end CHARACTERISTIC
/begin CHARACTERISTIC DSM_InhDfp_GlwCDGlwCirc6_C "Durch Fehlerpfad Dfp_GlwCDGlwCirc6 verriegelte Funktionsidentifier" VAL_BLK 0xCF924 Kwb_Wu16 61811.0000000 FidName 0.00 61811.0000000 FORMAT "%13.7" NUMBER 5 /end CHARACTERISTIC
/begin CHARACTERISTIC DSM_InhDfp_GlwCDGlwCirc7_C "Durch Fehlerpfad Dfp_GlwCDGlwCirc7 verriegelte Funktionsidentifier" VAL_BLK 0xCF92E Kwb_Wu16 61811.0000000 FidName 0.00 61811.0000000 FORMAT "%13.7" NUMBER 5 /end CHARACTERISTIC
/begin CHARACTERISTIC DSM_InhDfp_GlwCDGlwCirc8_C "Durch Fehlerpfad Dfp_GlwCDGlwCirc8 verriegelte Funktionsidentifier" VAL_BLK 0xCF938 Kwb_Wu16 61811.0000000 FidName 0.00 61811.0000000 FORMAT "%13.7" NUMBER 5 /end CHARACTERISTIC
/begin CHARACTERISTIC DSM_InhDfp_GlwCtl_C "Durch Fehlerpfad Dfp_GlwCtl verriegelte Funktionsidentifier" VAL_BLK 0xCF942 Kwb_Wu16 61811.0000000 FidName 0.00 61811.0000000 FORMAT "%13.7" NUMBER 5 /end CHARACTERISTIC
/begin CHARACTERISTIC DSM_InhDfp_HWEMonCom_C "Durch Fehlerpfad Dfp_HWEMonCom verriegelte Funktionsidentifier" VAL_BLK 0xCF94C Kwb_Wu16 61811.0000000 FidName 0.00 61811.0000000 FORMAT "%13.7" NUMBER 5 /end CHARACTERISTIC
/begin CHARACTERISTIC DSM_InhDfp_HWEMonEEPROM_C "Durch Fehlerpfad Dfp_HWEMonEEPROM verriegelte Funktionsidentifier" VAL_BLK 0xCF956 Kwb_Wu16 61811.0000000 FidName 0.00 61811.0000000 FORMAT "%13.7" NUMBER 7 /end CHARACTERISTIC
/begin CHARACTERISTIC DSM_InhDfp_HWEMonRcyLocked_C "Durch Fehlerpfad Dfp_HWEMonRcyLocked verriegelte Funktionsidentifier" VAL_BLK 0xCF964 Kwb_Wu16 61811.0000000 FidName 0.00 61811.0000000 FORMAT "%13.7" NUMBER 5 /end CHARACTERISTIC
/begin CHARACTERISTIC DSM_InhDfp_HWEMonRcySuppressed_C "Durch Fehlerpfad Dfp_HWEMonRcySuppressed verriegelte Funktionsidentifier" VAL_BLK 0xCF96E Kwb_Wu16 61811.0000000 FidName 0.00 61811.0000000 FORMAT "%13.7" NUMBER 5 /end CHARACTERISTIC
/begin CHARACTERISTIC DSM_InhDfp_HWEMonRcyVisible_C "Durch Fehlerpfad Dfp_HWEMonRcyVisible verriegelte Funktionsidentifier" VAL_BLK 0xCF978 Kwb_Wu16 61811.0000000 FidName 0.00 61811.0000000 FORMAT "%13.7" NUMBER 5 /end CHARACTERISTIC
/begin CHARACTERISTIC DSM_InhDfp_HWEMonUMaxSupply_C "Durch Fehlerpfad Dfp_HWEMonUMaxSupply verriegelte Funktionsidentifier" VAL_BLK 0xCF982 Kwb_Wu16 61811.0000000 FidName 0.00 61811.0000000 FORMAT "%13.7" NUMBER 6 /end CHARACTERISTIC
/begin CHARACTERISTIC DSM_InhDfp_HWEMonUMinSupply_C "Durch Fehlerpfad Dfp_HWEMonUMinSupply verriegelte Funktionsidentifier" VAL_BLK 0xCF98E Kwb_Wu16 61811.0000000 FidName 0.00 61811.0000000 FORMAT "%13.7" NUMBER 6 /end CHARACTERISTIC
/begin CHARACTERISTIC DSM_InhDfp_IATSCD_C "Durch Fehlerpfad Dfp_IATSCD verriegelte Funktionsidentifier" VAL_BLK 0xCF99A Kwb_Wu16 61811.0000000 FidName 0.00 61811.0000000 FORMAT "%13.7" NUMBER 24 /end CHARACTERISTIC
/begin CHARACTERISTIC DSM_InhDfp_IATSCD_CATS_C "Durch Fehlerpfad Dfp_IATSCD_CATS verriegelte Funktionsidentifier" VAL_BLK 0xCF9CA Kwb_Wu16 61811.0000000 FidName 0.00 61811.0000000 FORMAT "%13.7" NUMBER 9 /end CHARACTERISTIC
/begin CHARACTERISTIC DSM_InhDfp_IATSCD_CATSSec_C "Durch Fehlerpfad Dfp_IATSCD_CATSSec verriegelte Funktionsidentifier" VAL_BLK 0xCF9DC Kwb_Wu16 61811.0000000 FidName 0.00 61811.0000000 FORMAT "%13.7" NUMBER 8 /end CHARACTERISTIC
/begin CHARACTERISTIC DSM_InhDfp_ImmCtlImmCD_C "Durch Fehlerpfad Dfp_ImmCtlImmCD verriegelte Funktionsidentifier" VAL_BLK 0xCF9EC Kwb_Wu16 61811.0000000 FidName 0.00 61811.0000000 FORMAT "%13.7" NUMBER 6 /end CHARACTERISTIC
/begin CHARACTERISTIC DSM_InhDfp_ImmCtlImmEep_C "Durch Fehlerpfad Dfp_ImmCtlImmEep verriegelte Funktionsidentifier" VAL_BLK 0xCF9F8 Kwb_Wu16 61811.0000000 FidName 0.00 61811.0000000 FORMAT "%13.7" NUMBER 6 /end CHARACTERISTIC
/begin CHARACTERISTIC DSM_InhDfp_ImmCtlMpl_C "Durch Fehlerpfad Dfp_ImmCtlMpl verriegelte Funktionsidentifier" VAL_BLK 0xCFA04 Kwb_Wu16 61811.0000000 FidName 0.00 61811.0000000 FORMAT "%13.7" NUMBER 6 /end CHARACTERISTIC
/begin CHARACTERISTIC DSM_InhDfp_IndSys1_C "Durch Fehlerpfad Dfp_IndSys1 verriegelte Funktionsidentifier" VAL_BLK 0xCFA10 Kwb_Wu16 61811.0000000 FidName 0.00 61811.0000000 FORMAT "%13.7" NUMBER 13 /end CHARACTERISTIC
/begin CHARACTERISTIC DSM_InhDfp_IndSys2_C "Durch Fehlerpfad Dfp_IndSys2 verriegelte Funktionsidentifier" VAL_BLK 0xCFA2A Kwb_Wu16 61811.0000000 FidName 0.00 61811.0000000 FORMAT "%13.7" NUMBER 13 /end CHARACTERISTIC
/begin CHARACTERISTIC DSM_InhDfp_InjCrv_InjLim_C "Durch Fehlerpfad Dfp_InjCrv_InjLim verriegelte Funktionsidentifier" VAL_BLK 0xCFA44 Kwb_Wu16 61811.0000000 FidName 0.00 61811.0000000 FORMAT "%13.7" NUMBER 5 /end CHARACTERISTIC
/begin CHARACTERISTIC DSM_InhDfp_InjCtlAdjQnt_C "Durch Fehlerpfad Dfp_InjCtlAdjQnt verriegelte Funktionsidentifier" VAL_BLK 0xCFA4E Kwb_Wu16 61811.0000000 FidName 0.00 61811.0000000 FORMAT "%13.7" NUMBER 5 /end CHARACTERISTIC
/begin CHARACTERISTIC DSM_InhDfp_InjCtlDrift_C "Durch Fehlerpfad Dfp_InjCtlDrift verriegelte Funktionsidentifier" VAL_BLK 0xCFA58 Kwb_Wu16 61811.0000000 FidName 0.00 61811.0000000 FORMAT "%13.7" NUMBER 5 /end CHARACTERISTIC
/begin CHARACTERISTIC DSM_InhDfp_InjVCDActrChrg_C "Durch Fehlerpfad Dfp_InjVCDActrChrg verriegelte Funktionsidentifier" VAL_BLK 0xCFA62 Kwb_Wu16 61811.0000000 FidName 0.00 61811.0000000 FORMAT "%13.7" NUMBER 5 /end CHARACTERISTIC
/begin CHARACTERISTIC DSM_InhDfp_InjVCDActrEnrg1_C "Durch Fehlerpfad Dfp_InjVCDActrEnrg1 verriegelte Funktionsidentifier" VAL_BLK 0xCFA6C Kwb_Wu16 61811.0000000 FidName 0.00 61811.0000000 FORMAT "%13.7" NUMBER 5 /end CHARACTERISTIC
/begin CHARACTERISTIC DSM_InhDfp_InjVCDActrEnrg2_C "Durch Fehlerpfad Dfp_InjVCDActrEnrg2 verriegelte Funktionsidentifier" VAL_BLK 0xCFA76 Kwb_Wu16 61811.0000000 FidName 0.00 61811.0000000 FORMAT "%13.7" NUMBER 5 /end CHARACTERISTIC
/begin CHARACTERISTIC DSM_InhDfp_InjVCDActrEnrg3_C "Durch Fehlerpfad Dfp_InjVCDActrEnrg3 verriegelte Funktionsidentifier" VAL_BLK 0xCFA80 Kwb_Wu16 61811.0000000 FidName 0.00 61811.0000000 FORMAT "%13.7" NUMBER 5 /end CHARACTERISTIC
/begin CHARACTERISTIC DSM_InhDfp_InjVCDActrEnrg4_C "Durch Fehlerpfad Dfp_InjVCDActrEnrg4 verriegelte Funktionsidentifier" VAL_BLK 0xCFA8A Kwb_Wu16 61811.0000000 FidName 0.00 61811.0000000 FORMAT "%13.7" NUMBER 5 /end CHARACTERISTIC
/begin CHARACTERISTIC DSM_InhDfp_InjVCDActrEnrg5_C "Durch Fehlerpfad Dfp_InjVCDActrEnrg5 verriegelte Funktionsidentifier" VAL_BLK 0xCFA94 Kwb_Wu16 61811.0000000 FidName 0.00 61811.0000000 FORMAT "%13.7" NUMBER 5 /end CHARACTERISTIC
/begin CHARACTERISTIC DSM_InhDfp_InjVCDActrEnrg6_C "Durch Fehlerpfad Dfp_InjVCDActrEnrg6 verriegelte Funktionsidentifier" VAL_BLK 0xCFA9E Kwb_Wu16 61811.0000000 FidName 0.00 61811.0000000 FORMAT "%13.7" NUMBER 5 /end CHARACTERISTIC
/begin CHARACTERISTIC DSM_InhDfp_InjVCDActrEnrg7_C "Durch Fehlerpfad Dfp_InjVCDActrEnrg7 verriegelte Funktionsidentifier" VAL_BLK 0xCFAA8 Kwb_Wu16 61811.0000000 FidName 0.00 61811.0000000 FORMAT "%13.7" NUMBER 5 /end CHARACTERISTIC
/begin CHARACTERISTIC DSM_InhDfp_InjVCDActrEnrg8_C "Durch Fehlerpfad Dfp_InjVCDActrEnrg8 verriegelte Funktionsidentifier" VAL_BLK 0xCFAB2 Kwb_Wu16 61811.0000000 FidName 0.00 61811.0000000 FORMAT "%13.7" NUMBER 5 /end CHARACTERISTIC
/begin CHARACTERISTIC DSM_InhDfp_InjVCDActrVolt_C "Durch Fehlerpfad Dfp_InjVCDActrVolt verriegelte Funktionsidentifier" VAL_BLK 0xCFABC Kwb_Wu16 61811.0000000 FidName 0.00 61811.0000000 FORMAT "%13.7" NUMBER 5 /end CHARACTERISTIC
/begin CHARACTERISTIC DSM_InhDfp_InjVCDClsBank1_C "Durch Fehlerpfad Dfp_InjVCDClsBank1 verriegelte Funktionsidentifier" VAL_BLK 0xCFAC6 Kwb_Wu16 61811.0000000 FidName 0.00 61811.0000000 FORMAT "%13.7" NUMBER 5 /end CHARACTERISTIC
/begin CHARACTERISTIC DSM_InhDfp_InjVCDClsBank2_C "Durch Fehlerpfad Dfp_InjVCDClsBank2 verriegelte Funktionsidentifier" VAL_BLK 0xCFAD0 Kwb_Wu16 61811.0000000 FidName 0.00 61811.0000000 FORMAT "%13.7" NUMBER 5 /end CHARACTERISTIC
/begin CHARACTERISTIC DSM_InhDfp_InjVCDMonCab_C "Durch Fehlerpfad Dfp_InjVCDMonCab verriegelte Funktionsidentifier" VAL_BLK 0xCFADA Kwb_Wu16 61811.0000000 FidName 0.00 61811.0000000 FORMAT "%13.7" NUMBER 6 /end CHARACTERISTIC
/begin CHARACTERISTIC DSM_InhDfp_InjVCDMonSwt_C "Durch Fehlerpfad Dfp_InjVCDMonSwt verriegelte Funktionsidentifier" VAL_BLK 0xCFAE6 Kwb_Wu16 61811.0000000 FidName 0.00 61811.0000000 FORMAT "%13.7" NUMBER 6 /end CHARACTERISTIC
/begin CHARACTERISTIC DSM_InhDfp_InjVCDShOffDCDC_C "Durch Fehlerpfad Dfp_InjVCDShOffDCDC verriegelte Funktionsidentifier" VAL_BLK 0xCFAF2 Kwb_Wu16 61811.0000000 FidName 0.00 61811.0000000 FORMAT "%13.7" NUMBER 6 /end CHARACTERISTIC
/begin CHARACTERISTIC DSM_InhDfp_InjVCDUBuf1_C "Durch Fehlerpfad Dfp_InjVCDUBuf1 verriegelte Funktionsidentifier" VAL_BLK 0xCFAFE Kwb_Wu16 61811.0000000 FidName 0.00 61811.0000000 FORMAT "%13.7" NUMBER 5 /end CHARACTERISTIC
/begin CHARACTERISTIC DSM_InhDfp_InjVCDUBuf2_C "Durch Fehlerpfad Dfp_InjVCDUBuf2 verriegelte Funktionsidentifier" VAL_BLK 0xCFB08 Kwb_Wu16 61811.0000000 FidName 0.00 61811.0000000 FORMAT "%13.7" NUMBER 5 /end CHARACTERISTIC
/begin CHARACTERISTIC DSM_InhDfp_InjVCD_CY370Ampl_C "Durch Fehlerpfad Dfp_InjVCD_CY370Ampl verriegelte Funktionsidentifier" VAL_BLK 0xCFB12 Kwb_Wu16 61811.0000000 FidName 0.00 61811.0000000 FORMAT "%13.7" NUMBER 5 /end CHARACTERISTIC
/begin CHARACTERISTIC DSM_InhDfp_InjVCD_DrvTime_C "Durch Fehlerpfad Dfp_InjVCD_DrvTime verriegelte Funktionsidentifier" VAL_BLK 0xCFB1C Kwb_Wu16 61811.0000000 FidName 0.00 61811.0000000 FORMAT "%13.7" NUMBER 5 /end CHARACTERISTIC
/begin CHARACTERISTIC DSM_InhDfp_InjVCD_DrvTimeRcy_C "Durch Fehlerpfad Dfp_InjVCD_DrvTimeRcy verriegelte Funktionsidentifier" VAL_BLK 0xCFB26 Kwb_Wu16 61811.0000000 FidName 0.00 61811.0000000 FORMAT "%13.7" NUMBER 5 /end CHARACTERISTIC
/begin CHARACTERISTIC DSM_InhDfp_InjVCD_TPUErr_C "Durch Fehlerpfad Dfp_InjVCDTpuErr verriegelte Funktionsidentifier" VAL_BLK 0xCFB30 Kwb_Wu16 61811.0000000 FidName 0.00 61811.0000000 FORMAT "%13.7" NUMBER 5 /end CHARACTERISTIC
/begin CHARACTERISTIC DSM_InhDfp_InjVlvBnk1A_C "Durch Fehlerpfad Dfp_InjVlvBnk1A verriegelte Funktionsidentifier" VAL_BLK 0xCFB3A Kwb_Wu16 61811.0000000 FidName 0.00 61811.0000000 FORMAT "%13.7" NUMBER 10 /end CHARACTERISTIC
/begin CHARACTERISTIC DSM_InhDfp_InjVlvBnk1B_C "Durch Fehlerpfad Dfp_InjVlvBnk1B verriegelte Funktionsidentifier" VAL_BLK 0xCFB4E Kwb_Wu16 61811.0000000 FidName 0.00 61811.0000000 FORMAT "%13.7" NUMBER 10 /end CHARACTERISTIC
/begin CHARACTERISTIC DSM_InhDfp_InjVlvBnk2A_C "Durch Fehlerpfad Dfp_InjVlvBnk2A verriegelte Funktionsidentifier" VAL_BLK 0xCFB62 Kwb_Wu16 61811.0000000 FidName 0.00 61811.0000000 FORMAT "%13.7" NUMBER 10 /end CHARACTERISTIC
/begin CHARACTERISTIC DSM_InhDfp_InjVlvBnk2B_C "Durch Fehlerpfad Dfp_InjVlvBnk2B verriegelte Funktionsidentifier" VAL_BLK 0xCFB76 Kwb_Wu16 61811.0000000 FidName 0.00 61811.0000000 FORMAT "%13.7" NUMBER 10 /end CHARACTERISTIC
/begin CHARACTERISTIC DSM_InhDfp_InjVlvChipA_C "Durch Fehlerpfad Dfp_InjVlvChipA verriegelte Funktionsidentifier" VAL_BLK 0xCFB8A Kwb_Wu16 61811.0000000 FidName 0.00 61811.0000000 FORMAT "%13.7" NUMBER 9 /end CHARACTERISTIC
/begin CHARACTERISTIC DSM_InhDfp_InjVlvChipB_C "Durch Fehlerpfad Dfp_InjVlvChipB verriegelte Funktionsidentifier" VAL_BLK 0xCFB9C Kwb_Wu16 61811.0000000 FidName 0.00 61811.0000000 FORMAT "%13.7" NUMBER 9 /end CHARACTERISTIC
/begin CHARACTERISTIC DSM_InhDfp_InjVlvCyl1A_C "Durch Fehlerpfad Dfp_InjVlvCyl1A verriegelte Funktionsidentifier" VAL_BLK 0xCFBAE Kwb_Wu16 61811.0000000 FidName 0.00 61811.0000000 FORMAT "%13.7" NUMBER 10 /end CHARACTERISTIC
/begin CHARACTERISTIC DSM_InhDfp_InjVlvCyl1B_C "Durch Fehlerpfad Dfp_InjVlvCyl1B verriegelte Funktionsidentifier" VAL_BLK 0xCFBC2 Kwb_Wu16 61811.0000000 FidName 0.00 61811.0000000 FORMAT "%13.7" NUMBER 14 /end CHARACTERISTIC
/begin CHARACTERISTIC DSM_InhDfp_InjVlvCyl1C_C "Durch Fehlerpfad Dfp_InjVlvCyl1C verriegelte Funktionsidentifier" VAL_BLK 0xCFBDE Kwb_Wu16 61811.0000000 FidName 0.00 61811.0000000 FORMAT "%13.7" NUMBER 7 /end CHARACTERISTIC
/begin CHARACTERISTIC DSM_InhDfp_InjVlvCyl2A_C "Durch Fehlerpfad Dfp_InjVlvCyl2A verriegelte Funktionsidentifier" VAL_BLK 0xCFBEC Kwb_Wu16 61811.0000000 FidName 0.00 61811.0000000 FORMAT "%13.7" NUMBER 10 /end CHARACTERISTIC
/begin CHARACTERISTIC DSM_InhDfp_InjVlvCyl2B_C "Durch Fehlerpfad Dfp_InjVlvCyl2B verriegelte Funktionsidentifier" VAL_BLK 0xCFC00 Kwb_Wu16 61811.0000000 FidName 0.00 61811.0000000 FORMAT "%13.7" NUMBER 15 /end CHARACTERISTIC
/begin CHARACTERISTIC DSM_InhDfp_InjVlvCyl2C_C "Durch Fehlerpfad Dfp_InjVlvCyl2C verriegelte Funktionsidentifier" VAL_BLK 0xCFC1E Kwb_Wu16 61811.0000000 FidName 0.00 61811.0000000 FORMAT "%13.7" NUMBER 7 /end CHARACTERISTIC
/begin CHARACTERISTIC DSM_InhDfp_InjVlvCyl3A_C "Durch Fehlerpfad Dfp_InjVlvCyl3A verriegelte Funktionsidentifier" VAL_BLK 0xCFC2C Kwb_Wu16 61811.0000000 FidName 0.00 61811.0000000 FORMAT "%13.7" NUMBER 10 /end CHARACTERISTIC
/begin CHARACTERISTIC DSM_InhDfp_InjVlvCyl3B_C "Durch Fehlerpfad Dfp_InjVlvCyl3B verriegelte Funktionsidentifier" VAL_BLK 0xCFC40 Kwb_Wu16 61811.0000000 FidName 0.00 61811.0000000 FORMAT "%13.7" NUMBER 15 /end CHARACTERISTIC
/begin CHARACTERISTIC DSM_InhDfp_InjVlvCyl3C_C "Durch Fehlerpfad Dfp_InjVlvCyl3C verriegelte Funktionsidentifier" VAL_BLK 0xCFC5E Kwb_Wu16 61811.0000000 FidName 0.00 61811.0000000 FORMAT "%13.7" NUMBER 7 /end CHARACTERISTIC
/begin CHARACTERISTIC DSM_InhDfp_InjVlvCyl4A_C "Durch Fehlerpfad Dfp_InjVlvCyl4A verriegelte Funktionsidentifier" VAL_BLK 0xCFC6C Kwb_Wu16 61811.0000000 FidName 0.00 61811.0000000 FORMAT "%13.7" NUMBER 10 /end CHARACTERISTIC
/begin CHARACTERISTIC DSM_InhDfp_InjVlvCyl4B_C "Durch Fehlerpfad Dfp_InjVlvCyl4B verriegelte Funktionsidentifier" VAL_BLK 0xCFC80 Kwb_Wu16 61811.0000000 FidName 0.00 61811.0000000 FORMAT "%13.7" NUMBER 15 /end CHARACTERISTIC
/begin CHARACTERISTIC DSM_InhDfp_InjVlvCyl4C_C "Durch Fehlerpfad Dfp_InjVlvCyl4C verriegelte Funktionsidentifier" VAL_BLK 0xCFC9E Kwb_Wu16 61811.0000000 FidName 0.00 61811.0000000 FORMAT "%13.7" NUMBER 7 /end CHARACTERISTIC
/begin CHARACTERISTIC DSM_InhDfp_InjVlvCyl5A_C "Durch Fehlerpfad Dfp_InjVlvCyl5A verriegelte Funktionsidentifier" VAL_BLK 0xCFCAC Kwb_Wu16 61811.0000000 FidName 0.00 61811.0000000 FORMAT "%13.7" NUMBER 10 /end CHARACTERISTIC
/begin CHARACTERISTIC DSM_InhDfp_InjVlvCyl5B_C "Durch Fehlerpfad Dfp_InjVlvCyl5B verriegelte Funktionsidentifier" VAL_BLK 0xCFCC0 Kwb_Wu16 61811.0000000 FidName 0.00 61811.0000000 FORMAT "%13.7" NUMBER 15 /end CHARACTERISTIC
/begin CHARACTERISTIC DSM_InhDfp_InjVlvCyl5C_C "Durch Fehlerpfad Dfp_InjVlvCyl5C verriegelte Funktionsidentifier" VAL_BLK 0xCFCDE Kwb_Wu16 61811.0000000 FidName 0.00 61811.0000000 FORMAT "%13.7" NUMBER 7 /end CHARACTERISTIC
/begin CHARACTERISTIC DSM_InhDfp_InjVlvCyl6A_C "Durch Fehlerpfad Dfp_InjVlvCyl6A verriegelte Funktionsidentifier" VAL_BLK 0xCFCEC Kwb_Wu16 61811.0000000 FidName 0.00 61811.0000000 FORMAT "%13.7" NUMBER 10 /end CHARACTERISTIC
/begin CHARACTERISTIC DSM_InhDfp_InjVlvCyl6B_C "Durch Fehlerpfad Dfp_InjVlvCyl6B verriegelte Funktionsidentifier" VAL_BLK 0xCFD00 Kwb_Wu16 61811.0000000 FidName 0.00 61811.0000000 FORMAT "%13.7" NUMBER 15 /end CHARACTERISTIC
/begin CHARACTERISTIC DSM_InhDfp_InjVlvCyl6C_C "Durch Fehlerpfad Dfp_InjVlvCyl6C verriegelte Funktionsidentifier" VAL_BLK 0xCFD1E Kwb_Wu16 61811.0000000 FidName 0.00 61811.0000000 FORMAT "%13.7" NUMBER 7 /end CHARACTERISTIC
/begin CHARACTERISTIC DSM_InhDfp_InjVlvCyl7A_C "Durch Fehlerpfad Dfp_InjVlvCyl7A verriegelte Funktionsidentifier" VAL_BLK 0xCFD2C Kwb_Wu16 61811.0000000 FidName 0.00 61811.0000000 FORMAT "%13.7" NUMBER 10 /end CHARACTERISTIC
/begin CHARACTERISTIC DSM_InhDfp_InjVlvCyl7B_C "Durch Fehlerpfad Dfp_InjVlvCyl7B verriegelte Funktionsidentifier" VAL_BLK 0xCFD40 Kwb_Wu16 61811.0000000 FidName 0.00 61811.0000000 FORMAT "%13.7" NUMBER 15 /end CHARACTERISTIC
/begin CHARACTERISTIC DSM_InhDfp_InjVlvCyl7C_C "Durch Fehlerpfad Dfp_InjVlvCyl7C verriegelte Funktionsidentifier" VAL_BLK 0xCFD5E Kwb_Wu16 61811.0000000 FidName 0.00 61811.0000000 FORMAT "%13.7" NUMBER 7 /end CHARACTERISTIC
/begin CHARACTERISTIC DSM_InhDfp_InjVlvCyl8A_C "Durch Fehlerpfad Dfp_InjVlvCyl8A verriegelte Funktionsidentifier" VAL_BLK 0xCFD6C Kwb_Wu16 61811.0000000 FidName 0.00 61811.0000000 FORMAT "%13.7" NUMBER 10 /end CHARACTERISTIC
/begin CHARACTERISTIC DSM_InhDfp_InjVlvCyl8B_C "Durch Fehlerpfad Dfp_InjVlvCyl8B verriegelte Funktionsidentifier" VAL_BLK 0xCFD80 Kwb_Wu16 61811.0000000 FidName 0.00 61811.0000000 FORMAT "%13.7" NUMBER 15 /end CHARACTERISTIC
/begin CHARACTERISTIC DSM_InhDfp_InjVlvCyl8C_C "Durch Fehlerpfad Dfp_InjVlvCyl8C verriegelte Funktionsidentifier" VAL_BLK 0xCFD9E Kwb_Wu16 61811.0000000 FidName 0.00 61811.0000000 FORMAT "%13.7" NUMBER 7 /end CHARACTERISTIC
/begin CHARACTERISTIC DSM_InhDfp_InjVlvNVC1_C "Durch Fehlerpfad Dfp_InjVlvNVC1 verriegelte Funktionsidentifier" VAL_BLK 0xCFDAC Kwb_Wu16 61811.0000000 FidName 0.00 61811.0000000 FORMAT "%13.7" NUMBER 5 /end CHARACTERISTIC
/begin CHARACTERISTIC DSM_InhDfp_InjVlvNVC2_C "Durch Fehlerpfad Dfp_InjVlvNVC2 verriegelte Funktionsidentifier" VAL_BLK 0xCFDB6 Kwb_Wu16 61811.0000000 FidName 0.00 61811.0000000 FORMAT "%13.7" NUMBER 5 /end CHARACTERISTIC
/begin CHARACTERISTIC DSM_InhDfp_InjVlvNVC3_C "Durch Fehlerpfad Dfp_InjVlvNVC3 verriegelte Funktionsidentifier" VAL_BLK 0xCFDC0 Kwb_Wu16 61811.0000000 FidName 0.00 61811.0000000 FORMAT "%13.7" NUMBER 5 /end CHARACTERISTIC
/begin CHARACTERISTIC DSM_InhDfp_InjVlvNVC4_C "Durch Fehlerpfad Dfp_InjVlvNVC4 verriegelte Funktionsidentifier" VAL_BLK 0xCFDCA Kwb_Wu16 61811.0000000 FidName 0.00 61811.0000000 FORMAT "%13.7" NUMBER 5 /end CHARACTERISTIC
/begin CHARACTERISTIC DSM_InhDfp_InjVlvNVC5_C "Durch Fehlerpfad Dfp_InjVlvNVC5 verriegelte Funktionsidentifier" VAL_BLK 0xCFDD4 Kwb_Wu16 61811.0000000 FidName 0.00 61811.0000000 FORMAT "%13.7" NUMBER 5 /end CHARACTERISTIC
/begin CHARACTERISTIC DSM_InhDfp_InjVlvNVC6_C "Durch Fehlerpfad Dfp_InjVlvNVC6 verriegelte Funktionsidentifier" VAL_BLK 0xCFDDE Kwb_Wu16 61811.0000000 FidName 0.00 61811.0000000 FORMAT "%13.7" NUMBER 5 /end CHARACTERISTIC
/begin CHARACTERISTIC DSM_InhDfp_InjVlvNVC7_C "Durch Fehlerpfad Dfp_InjVlvNVC7 verriegelte Funktionsidentifier" VAL_BLK 0xCFDE8 Kwb_Wu16 61811.0000000 FidName 0.00 61811.0000000 FORMAT "%13.7" NUMBER 5 /end CHARACTERISTIC
/begin CHARACTERISTIC DSM_InhDfp_InjVlvNVC8_C "Durch Fehlerpfad Dfp_InjVlvNVC8 verriegelte Funktionsidentifier" VAL_BLK 0xCFDF2 Kwb_Wu16 61811.0000000 FidName 0.00 61811.0000000 FORMAT "%13.7" NUMBER 5 /end CHARACTERISTIC
/begin CHARACTERISTIC DSM_InhDfp_KeyCheck_C "Durch Fehlerpfad Dfp_KeyCheck verriegelte Funktionsidentifier" VAL_BLK 0xCFDFC Kwb_Wu16 61811.0000000 FidName 0.00 61811.0000000 FORMAT "%13.7" NUMBER 5 /end CHARACTERISTIC
/begin CHARACTERISTIC DSM_InhDfp_LIGovECUTransMode_C "Durch Fehlerpfad Dfp_LIGovECUTransMode verriegelte Funktionsidentifier" VAL_BLK 0xCFE06 Kwb_Wu16 61811.0000000 FidName 0.00 61811.0000000 FORMAT "%13.7" NUMBER 5 /end CHARACTERISTIC
/begin CHARACTERISTIC DSM_InhDfp_LPACD_Max_C "Durch Fehlerpfad Dfp_LPACD_Max verriegelte Funktionsidentifier" VAL_BLK 0xCFE10 Kwb_Wu16 61811.0000000 FidName 0.00 61811.0000000 FORMAT "%13.7" NUMBER 6 /end CHARACTERISTIC
/begin CHARACTERISTIC DSM_InhDfp_LPACD_Min_C "Durch Fehlerpfad Dfp_LPACD_Min verriegelte Funktionsidentifier" VAL_BLK 0xCFE1C Kwb_Wu16 61811.0000000 FidName 0.00 61811.0000000 FORMAT "%13.7" NUMBER 7 /end CHARACTERISTIC
/begin CHARACTERISTIC DSM_InhDfp_LPACD_SigNpl_C "Durch Fehlerpfad Dfp_LPACD_SigNpl verriegelte Funktionsidentifier" VAL_BLK 0xCFE2A Kwb_Wu16 61811.0000000 FidName 0.00 61811.0000000 FORMAT "%13.7" NUMBER 6 /end CHARACTERISTIC
/begin CHARACTERISTIC DSM_InhDfp_LSUCDCircNernst0B1_C "Durch Fehlerpfad Dfp_LSUCDCircNernst0B1 verriegelte Funktionsidentifier" VAL_BLK 0xCFE36 Kwb_Wu16 61811.0000000 FidName 0.00 61811.0000000 FORMAT "%13.7" NUMBER 5 /end CHARACTERISTIC
/begin CHARACTERISTIC DSM_InhDfp_LSUCDCircNernst0B2_C "Durch Fehlerpfad Dfp_LSUCDCircNernst0B2 verriegelte Funktionsidentifier" VAL_BLK 0xCFE40 Kwb_Wu16 61811.0000000 FidName 0.00 61811.0000000 FORMAT "%13.7" NUMBER 5 /end CHARACTERISTIC
/begin CHARACTERISTIC DSM_InhDfp_LSUCDCircPumpCur0B1_C "Durch Fehlerpfad Dfp_LSUCDCircPumpCur0B1 verriegelte Funktionsidentifier" VAL_BLK 0xCFE4A Kwb_Wu16 61811.0000000 FidName 0.00 61811.0000000 FORMAT "%13.7" NUMBER 5 /end CHARACTERISTIC
/begin CHARACTERISTIC DSM_InhDfp_LSUCDCircPumpCur0B2_C "Durch Fehlerpfad Dfp_LSUCDCircPumpCur0B2 verriegelte Funktionsidentifier" VAL_BLK 0xCFE54 Kwb_Wu16 61811.0000000 FidName 0.00 61811.0000000 FORMAT "%13.7" NUMBER 5 /end CHARACTERISTIC
/begin CHARACTERISTIC DSM_InhDfp_LSUCDCircVirtGnd0B1_C "Durch Fehlerpfad Dfp_LSUCDCircVirtGnd0B1 verriegelte Funktionsidentifier" VAL_BLK 0xCFE5E Kwb_Wu16 61811.0000000 FidName 0.00 61811.0000000 FORMAT "%13.7" NUMBER 5 /end CHARACTERISTIC
/begin CHARACTERISTIC DSM_InhDfp_LSUCDCircVirtGnd0B2_C "Durch Fehlerpfad Dfp_LSUCDCircVirtGnd0B2 verriegelte Funktionsidentifier" VAL_BLK 0xCFE68 Kwb_Wu16 61811.0000000 FidName 0.00 61811.0000000 FORMAT "%13.7" NUMBER 5 /end CHARACTERISTIC
/begin CHARACTERISTIC DSM_InhDfp_LSUCDHeater0B1_C "Durch Fehlerpfad Dfp_LSUCDHeater0B1 verriegelte Funktionsidentifier" VAL_BLK 0xCFE72 Kwb_Wu16 61811.0000000 FidName 0.00 61811.0000000 FORMAT "%13.7" NUMBER 5 /end CHARACTERISTIC
/begin CHARACTERISTIC DSM_InhDfp_LSUCDHeater0B2_C "Durch Fehlerpfad Dfp_LSUCDHeater0B2 verriegelte Funktionsidentifier" VAL_BLK 0xCFE7C Kwb_Wu16 61811.0000000 FidName 0.00 61811.0000000 FORMAT "%13.7" NUMBER 5 /end CHARACTERISTIC
/begin CHARACTERISTIC DSM_InhDfp_LSUCDHtCoup0B1_C "Durch Fehlerpfad Dfp_LSUCDHtCoup0B1 verriegelte Funktionsidentifier" VAL_BLK 0xCFE86 Kwb_Wu16 61811.0000000 FidName 0.00 61811.0000000 FORMAT "%13.7" NUMBER 5 /end CHARACTERISTIC
/begin CHARACTERISTIC DSM_InhDfp_LSUCDHtCoup0B2_C "Durch Fehlerpfad Dfp_LSUCDHtCoup0B2 verriegelte Funktionsidentifier" VAL_BLK 0xCFE90 Kwb_Wu16 61811.0000000 FidName 0.00 61811.0000000 FORMAT "%13.7" NUMBER 5 /end CHARACTERISTIC
/begin CHARACTERISTIC DSM_InhDfp_LSUCDO20B1_C "Durch Fehlerpfad Dfp_LSUCDO20B1 verriegelte Funktionsidentifier" VAL_BLK 0xCFE9A Kwb_Wu16 61811.0000000 FidName 0.00 61811.0000000 FORMAT "%13.7" NUMBER 5 /end CHARACTERISTIC
/begin CHARACTERISTIC DSM_InhDfp_LSUCDO20B2_C "Durch Fehlerpfad Dfp_LSUCDO20B2 verriegelte Funktionsidentifier" VAL_BLK 0xCFEA4 Kwb_Wu16 61811.0000000 FidName 0.00 61811.0000000 FORMAT "%13.7" NUMBER 5 /end CHARACTERISTIC
/begin CHARACTERISTIC DSM_InhDfp_LSUCDO2Clb0B1_C "Durch Fehlerpfad Dfp_LSUCDO2Clb0B1 verriegelte Funktionsidentifier" VAL_BLK 0xCFEAE Kwb_Wu16 61811.0000000 FidName 0.00 61811.0000000 FORMAT "%13.7" NUMBER 5 /end CHARACTERISTIC
/begin CHARACTERISTIC DSM_InhDfp_LSUCDO2Clb0B2_C "Durch Fehlerpfad Dfp_LSUCDO2Clb0B2 verriegelte Funktionsidentifier" VAL_BLK 0xCFEB8 Kwb_Wu16 61811.0000000 FidName 0.00 61811.0000000 FORMAT "%13.7" NUMBER 5 /end CHARACTERISTIC
/begin CHARACTERISTIC DSM_InhDfp_LSUCDRiClb0B1_C "Durch Fehlerpfad Dfp_LSUCDRiClb0B1 verriegelte Funktionsidentifier" VAL_BLK 0xCFEC2 Kwb_Wu16 61811.0000000 FidName 0.00 61811.0000000 FORMAT "%13.7" NUMBER 5 /end CHARACTERISTIC
/begin CHARACTERISTIC DSM_InhDfp_LSUCDRiClb0B2_C "Durch Fehlerpfad Dfp_LSUCDRiClb0B2 verriegelte Funktionsidentifier" VAL_BLK 0xCFECC Kwb_Wu16 61811.0000000 FidName 0.00 61811.0000000 FORMAT "%13.7" NUMBER 5 /end CHARACTERISTIC
/begin CHARACTERISTIC DSM_InhDfp_LSUCDSPI0B1_C "Durch Fehlerpfad Dfp_LSUCDSPI0B1 verriegelte Funktionsidentifier" VAL_BLK 0xCFED6 Kwb_Wu16 61811.0000000 FidName 0.00 61811.0000000 FORMAT "%13.7" NUMBER 5 /end CHARACTERISTIC
/begin CHARACTERISTIC DSM_InhDfp_LSUCDSPI0B2_C "Durch Fehlerpfad Dfp_LSUCDSPI0B2 verriegelte Funktionsidentifier" VAL_BLK 0xCFEE0 Kwb_Wu16 61811.0000000 FidName 0.00 61811.0000000 FORMAT "%13.7" NUMBER 5 /end CHARACTERISTIC
/begin CHARACTERISTIC DSM_InhDfp_LSUCDSPIBattLow0B1_C "Durch Fehlerpfad Dfp_LSUCDSPIBattLow0B1 verriegelte Funktionsidentifier" VAL_BLK 0xCFEEA Kwb_Wu16 61811.0000000 FidName 0.00 61811.0000000 FORMAT "%13.7" NUMBER 5 /end CHARACTERISTIC
/begin CHARACTERISTIC DSM_InhDfp_LSUCDSPIBattLow0B2_C "Durch Fehlerpfad Dfp_LSUCDSPIBattLow0B2 verriegelte Funktionsidentifier" VAL_BLK 0xCFEF4 Kwb_Wu16 61811.0000000 FidName 0.00 61811.0000000 FORMAT "%13.7" NUMBER 5 /end CHARACTERISTIC
/begin CHARACTERISTIC DSM_InhDfp_LSUCDWireIP0B1_C "Durch Fehlerpfad Dfp_LSUCDWireIP0B1 verriegelte Funktionsidentifier" VAL_BLK 0xCFEFE Kwb_Wu16 61811.0000000 FidName 0.00 61811.0000000 FORMAT "%13.7" NUMBER 5 /end CHARACTERISTIC
/begin CHARACTERISTIC DSM_InhDfp_LSUCDWireIP0B2_C "Durch Fehlerpfad Dfp_LSUCDWireIP0B2 verriegelte Funktionsidentifier" VAL_BLK 0xCFF08 Kwb_Wu16 61811.0000000 FidName 0.00 61811.0000000 FORMAT "%13.7" NUMBER 5 /end CHARACTERISTIC
/begin CHARACTERISTIC DSM_InhDfp_LSUCtlRiExc0B1_C "Durch Fehlerpfad Dfp_LSUCtlRiExc0B1 verriegelte Funktionsidentifier" VAL_BLK 0xCFF12 Kwb_Wu16 61811.0000000 FidName 0.00 61811.0000000 FORMAT "%13.7" NUMBER 5 /end CHARACTERISTIC
/begin CHARACTERISTIC DSM_InhDfp_LSUCtlRiExc0B2_C "Durch Fehlerpfad Dfp_LSUCtlRiExc0B2 verriegelte Funktionsidentifier" VAL_BLK 0xCFF1C Kwb_Wu16 61811.0000000 FidName 0.00 61811.0000000 FORMAT "%13.7" NUMBER 5 /end CHARACTERISTIC
/begin CHARACTERISTIC DSM_InhDfp_LSUMon1SensB1_C "Durch Fehlerpfad Dfp_LSUMon1SensB1 verriegelte Funktionsidentifier" VAL_BLK 0xCFF26 Kwb_Wu16 61811.0000000 FidName 0.00 61811.0000000 FORMAT "%13.7" NUMBER 5 /end CHARACTERISTIC
/begin CHARACTERISTIC DSM_InhDfp_LSUMon1SensB2_C "Durch Fehlerpfad Dfp_LSUMon1SensB2 verriegelte Funktionsidentifier" VAL_BLK 0xCFF30 Kwb_Wu16 61811.0000000 FidName 0.00 61811.0000000 FORMAT "%13.7" NUMBER 5 /end CHARACTERISTIC
/begin CHARACTERISTIC DSM_InhDfp_LSUMon2SensB1_C "Durch Fehlerpfad Dfp_LSUMon2SensB1 verriegelte Funktionsidentifier" VAL_BLK 0xCFF3A Kwb_Wu16 61811.0000000 FidName 0.00 61811.0000000 FORMAT "%13.7" NUMBER 5 /end CHARACTERISTIC
/begin CHARACTERISTIC DSM_InhDfp_LSUMon2SensB2_C "Durch Fehlerpfad Dfp_LSUMon2SensB2 verriegelte Funktionsidentifier" VAL_BLK 0xCFF44 Kwb_Wu16 61811.0000000 FidName 0.00 61811.0000000 FORMAT "%13.7" NUMBER 5 /end CHARACTERISTIC
/begin CHARACTERISTIC DSM_InhDfp_MIL_C "Durch Fehlerpfad Dfp_MIL verriegelte Funktionsidentifier" VAL_BLK 0xCFF4E Kwb_Wu16 61811.0000000 FidName 0.00 61811.0000000 FORMAT "%13.7" NUMBER 6 /end CHARACTERISTIC
/begin CHARACTERISTIC DSM_InhDfp_MRlyCD_C "Durch Fehlerpfad Dfp_MRlyCD verriegelte Funktionsidentifier" VAL_BLK 0xCFF5A Kwb_Wu16 61811.0000000 FidName 0.00 61811.0000000 FORMAT "%13.7" NUMBER 5 /end CHARACTERISTIC
/begin CHARACTERISTIC DSM_InhDfp_MSMon_C "Durch Fehlerpfad Dfp_MSMon verriegelte Funktionsidentifier" VAL_BLK 0xCFF64 Kwb_Wu16 61811.0000000 FidName 0.00 61811.0000000 FORMAT "%13.7" NUMBER 18 /end CHARACTERISTIC
/begin CHARACTERISTIC DSM_InhDfp_MSMonConsist_C "Durch Fehlerpfad Dfp_MSMonConsist verriegelte Funktionsidentifier" VAL_BLK 0xCFF88 Kwb_Wu16 61811.0000000 FidName 0.00 61811.0000000 FORMAT "%13.7" NUMBER 13 /end CHARACTERISTIC
/begin CHARACTERISTIC DSM_InhDfp_MSMonPFlt1_C "Durch Fehlerpfad Dfp_MSMonPFlt1 verriegelte Funktionsidentifier" VAL_BLK 0xCFFA2 Kwb_Wu16 61811.0000000 FidName 0.00 61811.0000000 FORMAT "%13.7" NUMBER 5 /end CHARACTERISTIC
/begin CHARACTERISTIC DSM_InhDfp_MSMonPFlt2_C "Durch Fehlerpfad Dfp_MSMonPFlt2 verriegelte Funktionsidentifier" VAL_BLK 0xCFFAC Kwb_Wu16 61811.0000000 FidName 0.00 61811.0000000 FORMAT "%13.7" NUMBER 5 /end CHARACTERISTIC
/begin CHARACTERISTIC DSM_InhDfp_MSMonPFlt3_C "Durch Fehlerpfad Dfp_MSMonPFlt3 verriegelte Funktionsidentifier" VAL_BLK 0xCFFB6 Kwb_Wu16 61811.0000000 FidName 0.00 61811.0000000 FORMAT "%13.7" NUMBER 5 /end CHARACTERISTIC
/begin CHARACTERISTIC DSM_InhDfp_MSMonPFlt4_C "Durch Fehlerpfad Dfp_MSMonPFlt4 verriegelte Funktionsidentifier" VAL_BLK 0xCFFC0 Kwb_Wu16 61811.0000000 FidName 0.00 61811.0000000 FORMAT "%13.7" NUMBER 5 /end CHARACTERISTIC
/begin CHARACTERISTIC DSM_InhDfp_MSMon_ARS_TO_C "Durch Fehlerpfad Dfp_MSMon_ARS_TO verriegelte Funktionsidentifier" VAL_BLK 0xCFFCA Kwb_Wu16 61811.0000000 FidName 0.00 61811.0000000 FORMAT "%13.7" NUMBER 7 /end CHARACTERISTIC
/begin CHARACTERISTIC DSM_InhDfp_MSMon_AirCtl_C "InhDfp zum Abgleich der Luftsystemfehler zwischen Master und Slave" VAL_BLK 0xCFFD8 Kwb_Wu16 61811.0000000 FidName 0.00 61811.0000000 FORMAT "%13.7" NUMBER 6 /end CHARACTERISTIC
/begin CHARACTERISTIC DSM_InhDfp_MSMon_AirSys0_C "InhDfp zum Abgleich der Luftsystemfehler zwischen Master und Slave" VAL_BLK 0xCFFE4 Kwb_Wu16 61811.0000000 FidName 0.00 61811.0000000 FORMAT "%13.7" NUMBER 7 /end CHARACTERISTIC
/begin CHARACTERISTIC DSM_InhDfp_MSMon_AirSys1_C "InhDfp zum Abgleich der Luftsystemfehler zwischen Master und Slave" VAL_BLK 0xCFFF2 Kwb_Wu16 61811.0000000 FidName 0.00 61811.0000000 FORMAT "%13.7" NUMBER 7 /end CHARACTERISTIC
/begin CHARACTERISTIC DSM_InhDfp_MSMon_AirSys2_C "InhDfp zum Abgleich der Luftsystemfehler zwischen Master und Slave" VAL_BLK 0xD0000 Kwb_Wu16 61811.0000000 FidName 0.00 61811.0000000 FORMAT "%13.7" NUMBER 7 /end CHARACTERISTIC
/begin CHARACTERISTIC DSM_InhDfp_MSMon_AirSys3_C "InhDfp zum Abgleich der Luftsystemfehler zwischen Master und Slave" VAL_BLK 0xD000E Kwb_Wu16 61811.0000000 FidName 0.00 61811.0000000 FORMAT "%13.7" NUMBER 7 /end CHARACTERISTIC
/begin CHARACTERISTIC DSM_InhDfp_MSMon_AirSys4_C "InhDfp zum Abgleich der Luftsystemfehler zwischen Master und Slave" VAL_BLK 0xD001C Kwb_Wu16 61811.0000000 FidName 0.00 61811.0000000 FORMAT "%13.7" NUMBER 7 /end CHARACTERISTIC
/begin CHARACTERISTIC DSM_InhDfp_MSMon_AirSys7_C "InhDfp zum Abgleich der Luftsystemfehler zwischen Master und Slave" VAL_BLK 0xD002A Kwb_Wu16 61811.0000000 FidName 0.00 61811.0000000 FORMAT "%13.7" NUMBER 7 /end CHARACTERISTIC
/begin CHARACTERISTIC DSM_InhDfp_MSMon_CanDef_C "Durch Fehlerpfad Dfp_MSMon_CanDef verriegelte Funktionsidentifier" VAL_BLK 0xD0038 Kwb_Wu16 61811.0000000 FidName 0.00 61811.0000000 FORMAT "%13.7" NUMBER 8 /end CHARACTERISTIC
/begin CHARACTERISTIC DSM_InhDfp_MSMon_CoEng_OffVeh_C "Durch Fehlerpfad Dfp_MSMon_CoEng_OffVeh_C  verriegelte Funktionsidentifier" VAL_BLK 0xD0048 Kwb_Wu16 61811.0000000 FidName 0.00 61811.0000000 FORMAT "%13.7" NUMBER 5 /end CHARACTERISTIC
/begin CHARACTERISTIC DSM_InhDfp_MSMon_CoEng_Rev1_C "Durch Fehlerpfad Dfp_MSMon_CoEng_Rev1_C  verriegelte Funktionsidentifier" VAL_BLK 0xD0052 Kwb_Wu16 61811.0000000 FidName 0.00 61811.0000000 FORMAT "%13.7" NUMBER 7 /end CHARACTERISTIC
/begin CHARACTERISTIC DSM_InhDfp_MSMon_CoEng_Rev2_C "Durch Fehlerpfad Dfp_MSMon_CoEng_Rev2_C verriegelte Funktionsidentifier" VAL_BLK 0xD0060 Kwb_Wu16 61811.0000000 FidName 0.00 61811.0000000 FORMAT "%13.7" NUMBER 7 /end CHARACTERISTIC
/begin CHARACTERISTIC DSM_InhDfp_MSMon_CoEng_RevMS_C "Durch Fehlerpfad Dfp_MSMon_CoEng_RevMS_C  verriegelte Funktionsidentifier" VAL_BLK 0xD006E Kwb_Wu16 61811.0000000 FidName 0.00 61811.0000000 FORMAT "%13.7" NUMBER 7 /end CHARACTERISTIC
/begin CHARACTERISTIC DSM_InhDfp_MSMon_DSC_TO_C "Durch Fehlerpfad Dfp_MSMon_DSC_TO verriegelte Funktionsidentifier" VAL_BLK 0xD007C Kwb_Wu16 61811.0000000 FidName 0.00 61811.0000000 FORMAT "%13.7" NUMBER 6 /end CHARACTERISTIC
/begin CHARACTERISTIC DSM_InhDfp_MSMon_EGS_TO_C "Durch Fehlerpfad Dfp_MSMon_EGS_TO verriegelte Funktionsidentifier" VAL_BLK 0xD0088 Kwb_Wu16 61811.0000000 FidName 0.00 61811.0000000 FORMAT "%13.7" NUMBER 8 /end CHARACTERISTIC
/begin CHARACTERISTIC DSM_InhDfp_MSMon_FrmMngCoEng_C "Durch Fehlerpfad Dfp_MSMon_FrmMngCoEng verriegelte Funktionsidentifier" VAL_BLK 0xD0098 Kwb_Wu16 61811.0000000 FidName 0.00 61811.0000000 FORMAT "%13.7" NUMBER 6 /end CHARACTERISTIC
/begin CHARACTERISTIC DSM_InhDfp_MSMon_FrmMngPT_C "Durch Fehlerpfad Dfp_MSMon_FrmMngPT_C  verriegelte Funktionsidentifier" VAL_BLK 0xD00A4 Kwb_Wu16 61811.0000000 FidName 0.00 61811.0000000 FORMAT "%13.7" NUMBER 9 /end CHARACTERISTIC
/begin CHARACTERISTIC DSM_InhDfp_MSMon_FrmMngPT2_C "Durch Fehlerpfad Dfp_MSMon_FrmMngPT2 verriegelte Funktionsidentifier" VAL_BLK 0xD00B6 Kwb_Wu16 61811.0000000 FidName 0.00 61811.0000000 FORMAT "%13.7" NUMBER 5 /end CHARACTERISTIC
/begin CHARACTERISTIC DSM_InhDfp_MSMon_Mil_C "Durch Fehlerpfad Dfp_MSMon_Mil_C  verriegelte Funktionsidentifier" VAL_BLK 0xD00C0 Kwb_Wu16 61811.0000000 FidName 0.00 61811.0000000 FORMAT "%13.7" NUMBER 5 /end CHARACTERISTIC
/begin CHARACTERISTIC DSM_InhDfp_MSMon_NetMngPtCan_C "Durch Fehlerpfad Dfp_MSMon_NetMngPtCan verriegelte Funktionsidentifier" VAL_BLK 0xD00CA Kwb_Wu16 61811.0000000 FidName 0.00 61811.0000000 FORMAT "%13.7" NUMBER 6 /end CHARACTERISTIC
/begin CHARACTERISTIC DSM_InhDfp_MSMon_RailCDPMon_C "Durch Fehlerpfad Dfp_MSMon_RailCDPMon verriegelte Funktionsidentifier" VAL_BLK 0xD00D6 Kwb_Wu16 61811.0000000 FidName 0.00 61811.0000000 FORMAT "%13.7" NUMBER 5 /end CHARACTERISTIC
/begin CHARACTERISTIC DSM_InhDfp_MSMon_StEGS_C "Durch Fehlerpfad Dfp_MSMon_StEGS verriegelte Funktionsidentifier" VAL_BLK 0xD00E0 Kwb_Wu16 61811.0000000 FidName 0.00 61811.0000000 FORMAT "%13.7" NUMBER 6 /end CHARACTERISTIC
/begin CHARACTERISTIC DSM_InhDfp_MSMon_SysLamp_C "Durch Fehlerpfad Dfp_MSMon_SysLamp_C  verriegelte Funktionsidentifier" VAL_BLK 0xD00EC Kwb_Wu16 61811.0000000 FidName 0.00 61811.0000000 FORMAT "%13.7" NUMBER 5 /end CHARACTERISTIC
/begin CHARACTERISTIC DSM_InhDfp_MSMon_ZFCClbActv_C "Durch Fehlerpfad Dfp_MSMon_ZFCClbActv verriegelte Funktionsidentifier" VAL_BLK 0xD00F6 Kwb_Wu16 61811.0000000 FidName 0.00 61811.0000000 FORMAT "%13.7" NUMBER 5 /end CHARACTERISTIC
/begin CHARACTERISTIC DSM_InhDfp_MSMon_qLimErr_C "Durch Fehlerpfad Dfp_MSMon_qLimErr_C  verriegelte Funktionsidentifier" VAL_BLK 0xD0100 Kwb_Wu16 61811.0000000 FidName 0.00 61811.0000000 FORMAT "%13.7" NUMBER 6 /end CHARACTERISTIC
/begin CHARACTERISTIC DSM_InhDfp_MSMon_trqCoDT_C "Durch Fehlerpfad Dfp_MSMon_trqCoDT_C  verriegelte Funktionsidentifier" VAL_BLK 0xD010C Kwb_Wu16 61811.0000000 FidName 0.00 61811.0000000 FORMAT "%13.7" NUMBER 6 /end CHARACTERISTIC
/begin CHARACTERISTIC DSM_InhDfp_MSMon_trqCoVeh_C "Durch Fehlerpfad Dfp_MSMon_trqCoVeh_C  verriegelte Funktionsidentifier" VAL_BLK 0xD0118 Kwb_Wu16 61811.0000000 FidName 0.00 61811.0000000 FORMAT "%13.7" NUMBER 6 /end CHARACTERISTIC
/begin CHARACTERISTIC DSM_InhDfp_MSMon_trqCoVehLim_C "Durch Fehlerpfad Dfp_MSMon_trqCoVehLim_C  verriegelte Funktionsidentifier" VAL_BLK 0xD0124 Kwb_Wu16 61811.0000000 FidName 0.00 61811.0000000 FORMAT "%13.7" NUMBER 6 /end CHARACTERISTIC
/begin CHARACTERISTIC DSM_InhDfp_MSMon_trqDesExt_C "Durch Fehlerpfad Dfp_MSMon_trqDesExt_C  verriegelte Funktionsidentifier" VAL_BLK 0xD0130 Kwb_Wu16 61811.0000000 FidName 0.00 61811.0000000 FORMAT "%13.7" NUMBER 7 /end CHARACTERISTIC
/begin CHARACTERISTIC DSM_InhDfp_MSMon_trqDesExtRev_C "Durch Fehlerpfad Dfp_MSMon_trqDesExtRev_C  verriegelte Funktionsidentifier" VAL_BLK 0xD013E Kwb_Wu16 61811.0000000 FidName 0.00 61811.0000000 FORMAT "%13.7" NUMBER 7 /end CHARACTERISTIC
/begin CHARACTERISTIC DSM_InhDfp_MSMon_trqLimErr_C "Durch Fehlerpfad Dfp_MSMon_trqLimErr_C  verriegelte Funktionsidentifier" VAL_BLK 0xD014C Kwb_Wu16 61811.0000000 FidName 0.00 61811.0000000 FORMAT "%13.7" NUMBER 6 /end CHARACTERISTIC
/begin CHARACTERISTIC DSM_InhDfp_MSMon_trqLimErr1_C "Durch Fehlerpfad Dfp_MSMon_trqLimErr1_C  verriegelte Funktionsidentifier" VAL_BLK 0xD0158 Kwb_Wu16 61811.0000000 FidName 0.00 61811.0000000 FORMAT "%13.7" NUMBER 6 /end CHARACTERISTIC
/begin CHARACTERISTIC DSM_InhDfp_MSMon_trqLimErr2_C "Durch Fehlerpfad Dfp_MSMon_trqLimErr2_C  verriegelte Funktionsidentifier" VAL_BLK 0xD0164 Kwb_Wu16 61811.0000000 FidName 0.00 61811.0000000 FORMAT "%13.7" NUMBER 6 /end CHARACTERISTIC
/begin CHARACTERISTIC DSM_InhDfp_MSMon_trqLimErr3_C "Durch Fehlerpfad Dfp_MSMon_trqLimErr3 verriegelte Funktionsidentifier" VAL_BLK 0xD0170 Kwb_Wu16 61811.0000000 FidName 0.00 61811.0000000 FORMAT "%13.7" NUMBER 6 /end CHARACTERISTIC
/begin CHARACTERISTIC DSM_InhDfp_MSMon_trqLimErr4_C "Durch Fehlerpfad Dfp_MSMon_trqLimErr4 verriegelte Funktionsidentifier" VAL_BLK 0xD017C Kwb_Wu16 61811.0000000 FidName 0.00 61811.0000000 FORMAT "%13.7" NUMBER 6 /end CHARACTERISTIC
/begin CHARACTERISTIC DSM_InhDfp_MSidCD_Comm_C "Durch Fehlerpfad Dfp_MSidCD_Comm verriegelte Funktionsidentifier" VAL_BLK 0xD0188 Kwb_Wu16 61811.0000000 FidName 0.00 61811.0000000 FORMAT "%13.7" NUMBER 5 /end CHARACTERISTIC
/begin CHARACTERISTIC DSM_InhDfp_MSidCD_EcuMixed_C "Durch Fehlerpfad Dfp_MSidCD_EcuMixed verriegelte Funktionsidentifier" VAL_BLK 0xD0192 Kwb_Wu16 61811.0000000 FidName 0.00 61811.0000000 FORMAT "%13.7" NUMBER 7 /end CHARACTERISTIC
/begin CHARACTERISTIC DSM_InhDfp_MSidCD_Pin_C "Durch Fehlerpfad Dfp_MSidCD_Pin verriegelte Funktionsidentifier" VAL_BLK 0xD01A0 Kwb_Wu16 61811.0000000 FidName 0.00 61811.0000000 FORMAT "%13.7" NUMBER 6 /end CHARACTERISTIC
/begin CHARACTERISTIC DSM_InhDfp_MSidCD_Sel_INI_C "Durch Fehlerpfad Dfp_MSidCD_Sel_INI verriegelte Funktionsidentifier" VAL_BLK 0xD01AC Kwb_Wu16 61811.0000000 FidName 0.00 61811.0000000 FORMAT "%13.7" NUMBER 7 /end CHARACTERISTIC
/begin CHARACTERISTIC DSM_InhDfp_MSidCD_Select_C "Durch Fehlerpfad Dfp_MSidCD_Select verriegelte Funktionsidentifier" VAL_BLK 0xD01BA Kwb_Wu16 61811.0000000 FidName 0.00 61811.0000000 FORMAT "%13.7" NUMBER 7 /end CHARACTERISTIC
/begin CHARACTERISTIC DSM_InhDfp_MSid_SwCmp_C "Durch Fehlerpfad Dfp_MSid_SwCmp verriegelte Funktionsidentifier" VAL_BLK 0xD01C8 Kwb_Wu16 61811.0000000 FidName 0.00 61811.0000000 FORMAT "%13.7" NUMBER 7 /end CHARACTERISTIC
/begin CHARACTERISTIC DSM_InhDfp_MSid_regEEPDiff_C "Durch Fehlerpfad Dfp_MSid_regEEPDiff verriegelte Funktionsidentifier" VAL_BLK 0xD01D6 Kwb_Wu16 61811.0000000 FidName 0.00 61811.0000000 FORMAT "%13.7" NUMBER 5 /end CHARACTERISTIC
/begin CHARACTERISTIC DSM_InhDfp_MeUnCDNoLoad_C "Durch Fehlerpfad Dfp_MeUnCDNoLoad verriegelte Funktionsidentifier" VAL_BLK 0xD01E0 Kwb_Wu16 61811.0000000 FidName 0.00 61811.0000000 FORMAT "%13.7" NUMBER 13 /end CHARACTERISTIC
/begin CHARACTERISTIC DSM_InhDfp_MeUnCDSCBat_C "Durch Fehlerpfad Dfp_MeUnCDSCBat verriegelte Funktionsidentifier" VAL_BLK 0xD01FA Kwb_Wu16 61811.0000000 FidName 0.00 61811.0000000 FORMAT "%13.7" NUMBER 13 /end CHARACTERISTIC
/begin CHARACTERISTIC DSM_InhDfp_MeUnCDSCGnd_C "Durch Fehlerpfad Dfp_MeUnCDSCGnd verriegelte Funktionsidentifier" VAL_BLK 0xD0214 Kwb_Wu16 61811.0000000 FidName 0.00 61811.0000000 FORMAT "%13.7" NUMBER 8 /end CHARACTERISTIC
/begin CHARACTERISTIC DSM_InhDfp_MeUnCD_ADC_C "Durch Fehlerpfad Dfp_MeUnCD_ADC verriegelte Funktionsidentifier" VAL_BLK 0xD0224 Kwb_Wu16 61811.0000000 FidName 0.00 61811.0000000 FORMAT "%13.7" NUMBER 7 /end CHARACTERISTIC
/begin CHARACTERISTIC DSM_InhDfp_MeUnCD_SigTst_C "Durch Fehlerpfad Dfp_MeUnCD_SigTst verriegelte Funktionsidentifier" VAL_BLK 0xD0232 Kwb_Wu16 61811.0000000 FidName 0.00 61811.0000000 FORMAT "%13.7" NUMBER 15 /end CHARACTERISTIC
/begin CHARACTERISTIC DSM_InhDfp_Montr_C "Durch Fehlerpfad Dfp_Montr verriegelte Funktionsidentifier" VAL_BLK 0xD0250 Kwb_Wu16 61811.0000000 FidName 0.00 61811.0000000 FORMAT "%13.7" NUMBER 8 /end CHARACTERISTIC
/begin CHARACTERISTIC DSM_InhDfp_NetMngDeviceA_C "Durch Fehlerpfad Dfp_NetMngDeviceA verriegelte Funktionsidentifier" VAL_BLK 0xD0260 Kwb_Wu16 61811.0000000 FidName 0.00 61811.0000000 FORMAT "%13.7" NUMBER 17 /end CHARACTERISTIC
/begin CHARACTERISTIC DSM_InhDfp_NetMngDeviceB_C "Durch Fehlerpfad Dfp_NetMngDeviceB verriegelte Funktionsidentifier" VAL_BLK 0xD0282 Kwb_Wu16 61811.0000000 FidName 0.00 61811.0000000 FORMAT "%13.7" NUMBER 5 /end CHARACTERISTIC
/begin CHARACTERISTIC DSM_InhDfp_NetMngDeviceC_C "Durch Fehlerpfad Dfp_NetMngDeviceC verriegelte Funktionsidentifier" VAL_BLK 0xD028C Kwb_Wu16 61811.0000000 FidName 0.00 61811.0000000 FORMAT "%13.7" NUMBER 14 /end CHARACTERISTIC
/begin CHARACTERISTIC DSM_InhDfp_NetMngPrvCan_C "Durch Fehlerpfad Dfp_NetMngPrvCan verriegelte Funktionsidentifier" VAL_BLK 0xD02A8 Kwb_Wu16 61811.0000000 FidName 0.00 61811.0000000 FORMAT "%13.7" NUMBER 7 /end CHARACTERISTIC
/begin CHARACTERISTIC DSM_InhDfp_NetMngPrvCanSlave_C "Durch Fehlerpfad Dfp_NetMngPrvCanSlave verriegelte Funktionsidentifier" VAL_BLK 0xD02B6 Kwb_Wu16 61811.0000000 FidName 0.00 61811.0000000 FORMAT "%13.7" NUMBER 7 /end CHARACTERISTIC
/begin CHARACTERISTIC DSM_InhDfp_NetMngPtCan_C "Durch Fehlerpfad Dfp_NetMngPtCan verriegelte Funktionsidentifier" VAL_BLK 0xD02C4 Kwb_Wu16 61811.0000000 FidName 0.00 61811.0000000 FORMAT "%13.7" NUMBER 20 /end CHARACTERISTIC
/begin CHARACTERISTIC DSM_InhDfp_NetMngPtCanSlave_C "Durch Fehlerpfad Dfp_NetMngPtCanSlave verriegelte Funktionsidentifier" VAL_BLK 0xD02EC Kwb_Wu16 61811.0000000 FidName 0.00 61811.0000000 FORMAT "%13.7" NUMBER 18 /end CHARACTERISTIC
/begin CHARACTERISTIC DSM_InhDfp_OPSCD_Lamp_C "Durch Fehlerpfad Dfp_OPSCD_Lamp verriegelte Funktionsidentifier" VAL_BLK 0xD0310 Kwb_Wu16 61811.0000000 FidName 0.00 61811.0000000 FORMAT "%13.7" NUMBER 5 /end CHARACTERISTIC
/begin CHARACTERISTIC DSM_InhDfp_OPSCD_anain_C "Durch Fehlerpfad Dfp_OPSCD_anain verriegelte Funktionsidentifier" VAL_BLK 0xD031A Kwb_Wu16 61811.0000000 FidName 0.00 61811.0000000 FORMAT "%13.7" NUMBER 5 /end CHARACTERISTIC
/begin CHARACTERISTIC DSM_InhDfp_OTSCD_C "Durch Fehlerpfad Dfp_OTSCD verriegelte Funktionsidentifier" VAL_BLK 0xD0324 Kwb_Wu16 61811.0000000 FidName 0.00 61811.0000000 FORMAT "%13.7" NUMBER 10 /end CHARACTERISTIC
/begin CHARACTERISTIC DSM_InhDfp_OvRMon_C "Durch Fehlerpfad Dfp_OvRMon verriegelte Funktionsidentifier" VAL_BLK 0xD0338 Kwb_Wu16 61811.0000000 FidName 0.00 61811.0000000 FORMAT "%13.7" NUMBER 5 /end CHARACTERISTIC
/begin CHARACTERISTIC DSM_InhDfp_OvRMonSigA_C "Durch Fehlerpfad Dfp_OvRMonSigA verriegelte Funktionsidentifier" VAL_BLK 0xD0342 Kwb_Wu16 61811.0000000 FidName 0.00 61811.0000000 FORMAT "%13.7" NUMBER 5 /end CHARACTERISTIC
/begin CHARACTERISTIC DSM_InhDfp_OxiCCDTPreB1_C "Durch Fehlerpfad Dfp_OxiCCDTPreB1 verriegelte Funktionsidentifier" VAL_BLK 0xD034C Kwb_Wu16 61811.0000000 FidName 0.00 61811.0000000 FORMAT "%13.7" NUMBER 37 /end CHARACTERISTIC
/begin CHARACTERISTIC DSM_InhDfp_OxiCCDTPreB2_C "Durch Fehlerpfad Dfp_OxiCCDTPreB2 verriegelte Funktionsidentifier" VAL_BLK 0xD0396 Kwb_Wu16 61811.0000000 FidName 0.00 61811.0000000 FORMAT "%13.7" NUMBER 37 /end CHARACTERISTIC
/begin CHARACTERISTIC DSM_InhDfp_PCBS_C "Durch Fehlerpfad Dfp_PCBS verriegelte Funktionsidentifier" VAL_BLK 0xD03E0 Kwb_Wu16 61811.0000000 FidName 0.00 61811.0000000 FORMAT "%13.7" NUMBER 5 /end CHARACTERISTIC
/begin CHARACTERISTIC DSM_InhDfp_PCR_BalGvnr_C "Durch Fehlerpfad Dfp_PCR_BalGvnr verriegelte Funktionsidentifier" VAL_BLK 0xD03EA Kwb_Wu16 61811.0000000 FidName 0.00 61811.0000000 FORMAT "%13.7" NUMBER 7 /end CHARACTERISTIC
/begin CHARACTERISTIC DSM_InhDfp_PCR_GovDevNeg_C "Durch Fehlerpfad Dfp_PCR_GovDevNeg verriegelte Funktionsidentifier" VAL_BLK 0xD03F8 Kwb_Wu16 61811.0000000 FidName 0.00 61811.0000000 FORMAT "%13.7" NUMBER 11 /end CHARACTERISTIC
/begin CHARACTERISTIC DSM_InhDfp_PCR_GovDevPos_C "Durch Fehlerpfad Dfp_PCR_GovDevPos verriegelte Funktionsidentifier" VAL_BLK 0xD040E Kwb_Wu16 61811.0000000 FidName 0.00 61811.0000000 FORMAT "%13.7" NUMBER 9 /end CHARACTERISTIC
/begin CHARACTERISTIC DSM_InhDfp_PCR_LPGvnrDvtNeg_C "Durch Fehlerpfad Dfp_PCR_LPGvnrDvtNeg verriegelte Funktionsidentifier" VAL_BLK 0xD0420 Kwb_Wu16 61811.0000000 FidName 0.00 61811.0000000 FORMAT "%13.7" NUMBER 7 /end CHARACTERISTIC
/begin CHARACTERISTIC DSM_InhDfp_PCR_LPGvnrDvtPos_C "Durch Fehlerpfad Dfp_PCR_LPGvnrDvtPos verriegelte Funktionsidentifier" VAL_BLK 0xD042E Kwb_Wu16 61811.0000000 FidName 0.00 61811.0000000 FORMAT "%13.7" NUMBER 6 /end CHARACTERISTIC
/begin CHARACTERISTIC DSM_InhDfp_PCVCDNoLoad_C "Durch Fehlerpfad Dfp_PCVCDNoLoad verriegelte Funktionsidentifier" VAL_BLK 0xD043A Kwb_Wu16 61811.0000000 FidName 0.00 61811.0000000 FORMAT "%13.7" NUMBER 8 /end CHARACTERISTIC
/begin CHARACTERISTIC DSM_InhDfp_PCVCDSCBat_C "Durch Fehlerpfad Dfp_PCVCDSCBat verriegelte Funktionsidentifier" VAL_BLK 0xD044A Kwb_Wu16 61811.0000000 FidName 0.00 61811.0000000 FORMAT "%13.7" NUMBER 8 /end CHARACTERISTIC
/begin CHARACTERISTIC DSM_InhDfp_PCVCDSCGnd_C "Durch Fehlerpfad Dfp_PCVCDSCGnd verriegelte Funktionsidentifier" VAL_BLK 0xD045A Kwb_Wu16 61811.0000000 FidName 0.00 61811.0000000 FORMAT "%13.7" NUMBER 13 /end CHARACTERISTIC
/begin CHARACTERISTIC DSM_InhDfp_PCVCD_ADC_C "Durch Fehlerpfad Dfp_PCVCD_ADC verriegelte Funktionsidentifier" VAL_BLK 0xD0474 Kwb_Wu16 61811.0000000 FidName 0.00 61811.0000000 FORMAT "%13.7" NUMBER 8 /end CHARACTERISTIC
/begin CHARACTERISTIC DSM_InhDfp_PCVCD_SigTst_C "Durch Fehlerpfad Dfp_PCVCD_SigTst verriegelte Funktionsidentifier" VAL_BLK 0xD0484 Kwb_Wu16 61811.0000000 FidName 0.00 61811.0000000 FORMAT "%13.7" NUMBER 15 /end CHARACTERISTIC
/begin CHARACTERISTIC DSM_InhDfp_PFltAPSPlaus_C "Durch Fehlerpfad Dfp_PFltAPSPlaus verriegelte Funktionsidentifier" VAL_BLK 0xD04A2 Kwb_Wu16 61811.0000000 FidName 0.00 61811.0000000 FORMAT "%13.7" NUMBER 31 /end CHARACTERISTIC
/begin CHARACTERISTIC DSM_InhDfp_PFltAPSensB1_C "Durch Fehlerpfad Dfp_PFltAPSensB1 verriegelte Funktionsidentifier" VAL_BLK 0xD04E0 Kwb_Wu16 61811.0000000 FidName 0.00 61811.0000000 FORMAT "%13.7" NUMBER 32 /end CHARACTERISTIC
/begin CHARACTERISTIC DSM_InhDfp_PFltAPSensB2_C "Durch Fehlerpfad Dfp_PFltAPSensB2 verriegelte Funktionsidentifier" VAL_BLK 0xD0520 Kwb_Wu16 61811.0000000 FidName 0.00 61811.0000000 FORMAT "%13.7" NUMBER 32 /end CHARACTERISTIC
/begin CHARACTERISTIC DSM_InhDfp_PFltBPSPlaus_C "Durch Fehlerpfad Dfp_PFltBPSPlaus verriegelte Funktionsidentifier" VAL_BLK 0xD0560 Kwb_Wu16 61811.0000000 FidName 0.00 61811.0000000 FORMAT "%13.7" NUMBER 31 /end CHARACTERISTIC
/begin CHARACTERISTIC DSM_InhDfp_PFltCDPPreB1_C "Durch Fehlerpfad Dfp_PFltCDPPreB1 verriegelte Funktionsidentifier" VAL_BLK 0xD059E Kwb_Wu16 61811.0000000 FidName 0.00 61811.0000000 FORMAT "%13.7" NUMBER 32 /end CHARACTERISTIC
/begin CHARACTERISTIC DSM_InhDfp_PFltCDPPreB2_C "Durch Fehlerpfad Dfp_PFltCDPPreB2 verriegelte Funktionsidentifier" VAL_BLK 0xD05DE Kwb_Wu16 61811.0000000 FidName 0.00 61811.0000000 FORMAT "%13.7" NUMBER 33 /end CHARACTERISTIC
/begin CHARACTERISTIC DSM_InhDfp_PFltCDTPreB1_C "Durch Fehlerpfad Dfp_PFltCDTPreB1 verriegelte Funktionsidentifier" VAL_BLK 0xD0620 Kwb_Wu16 61811.0000000 FidName 0.00 61811.0000000 FORMAT "%13.7" NUMBER 30 /end CHARACTERISTIC
/begin CHARACTERISTIC DSM_InhDfp_PFltCDTPreB2_C "Durch Fehlerpfad Dfp_PFltCDTPreB2 verriegelte Funktionsidentifier" VAL_BLK 0xD065C Kwb_Wu16 61811.0000000 FidName 0.00 61811.0000000 FORMAT "%13.7" NUMBER 30 /end CHARACTERISTIC
/begin CHARACTERISTIC DSM_InhDfp_PFltCharB1_C "Durch Fehlerpfad Dfp_PFltCharB1 verriegelte Funktionsidentifier" VAL_BLK 0xD0698 Kwb_Wu16 61811.0000000 FidName 0.00 61811.0000000 FORMAT "%13.7" NUMBER 35 /end CHARACTERISTIC
/begin CHARACTERISTIC DSM_InhDfp_PFltCharB2_C "Durch Fehlerpfad Dfp_PFltCharB2 verriegelte Funktionsidentifier" VAL_BLK 0xD06DE Kwb_Wu16 61811.0000000 FidName 0.00 61811.0000000 FORMAT "%13.7" NUMBER 35 /end CHARACTERISTIC
/begin CHARACTERISTIC DSM_InhDfp_PFltDltOxiPreTwFlw_C "Temperaturabweichungsfehlerpfad vor Oxi Cat Behandlung" VAL_BLK 0xD0724 Kwb_Wu16 61811.0000000 FidName 0.00 61811.0000000 FORMAT "%13.7" NUMBER 31 /end CHARACTERISTIC
/begin CHARACTERISTIC DSM_InhDfp_PFltDltPreTwFlw_C "Temperaturabweichungsfehlerpfad vor DPF - Behandlung" VAL_BLK 0xD0762 Kwb_Wu16 61811.0000000 FidName 0.00 61811.0000000 FORMAT "%13.7" NUMBER 31 /end CHARACTERISTIC
/begin CHARACTERISTIC DSM_InhDfp_PFltEngPrtB1_C "Durch Fehlerpfad Dfp_PFltEngPrtB1 verriegelte Funktionsidentifier" VAL_BLK 0xD07A0 Kwb_Wu16 61811.0000000 FidName 0.00 61811.0000000 FORMAT "%13.7" NUMBER 31 /end CHARACTERISTIC
/begin CHARACTERISTIC DSM_InhDfp_PFltEngPrtB2_C "Durch Fehlerpfad Dfp_PFltEngPrtB2 verriegelte Funktionsidentifier" VAL_BLK 0xD07DE Kwb_Wu16 61811.0000000 FidName 0.00 61811.0000000 FORMAT "%13.7" NUMBER 31 /end CHARACTERISTIC
/begin CHARACTERISTIC DSM_InhDfp_PFltOvldInhRgnB1_C "Durch Fehlerpfad Dfp_PFltOvldInhRgnB1 verriegelte Funktionsidentifier" VAL_BLK 0xD081C Kwb_Wu16 61811.0000000 FidName 0.00 61811.0000000 FORMAT "%13.7" NUMBER 30 /end CHARACTERISTIC
/begin CHARACTERISTIC DSM_InhDfp_PFltOvldInhRgnB2_C "Durch Fehlerpfad Dfp_PFltOvldInhRgnB2 verriegelte Funktionsidentifier" VAL_BLK 0xD0858 Kwb_Wu16 61811.0000000 FidName 0.00 61811.0000000 FORMAT "%13.7" NUMBER 30 /end CHARACTERISTIC
/begin CHARACTERISTIC DSM_InhDfp_PFltOvldTrqLimB1_C "Durch Fehlerpfad Dfp_PFltOvldTrqLimB1 verriegelte Funktionsidentifier" VAL_BLK 0xD0894 Kwb_Wu16 61811.0000000 FidName 0.00 61811.0000000 FORMAT "%13.7" NUMBER 30 /end CHARACTERISTIC
/begin CHARACTERISTIC DSM_InhDfp_PFltOvldTrqLimB2_C "Durch Fehlerpfad Dfp_PFltOvldTrqLimB2 verriegelte Funktionsidentifier" VAL_BLK 0xD08D0 Kwb_Wu16 61811.0000000 FidName 0.00 61811.0000000 FORMAT "%13.7" NUMBER 30 /end CHARACTERISTIC
/begin CHARACTERISTIC DSM_InhDfp_PFltPresDynPlausB1_C "Durch Fehlerpfad Dfp_PFltPresDynPlausB1 verriegelte Funktionsidentifier" VAL_BLK 0xD090C Kwb_Wu16 61811.0000000 FidName 0.00 61811.0000000 FORMAT "%13.7" NUMBER 34 /end CHARACTERISTIC
/begin CHARACTERISTIC DSM_InhDfp_PFltPresDynPlausB2_C "Durch Fehlerpfad Dfp_PFltPresDynPlausB2 verriegelte Funktionsidentifier" VAL_BLK 0xD0950 Kwb_Wu16 61811.0000000 FidName 0.00 61811.0000000 FORMAT "%13.7" NUMBER 34 /end CHARACTERISTIC
/begin CHARACTERISTIC DSM_InhDfp_PFltPresPlausB1_C "Durch Fehlerpfad Dfp_PFltPresPlausB1 verriegelte Funktionsidentifier" VAL_BLK 0xD0994 Kwb_Wu16 61811.0000000 FidName 0.00 61811.0000000 FORMAT "%13.7" NUMBER 30 /end CHARACTERISTIC
/begin CHARACTERISTIC DSM_InhDfp_PFltPresPlausB2_C "Durch Fehlerpfad Dfp_PFltPresPlausB2 verriegelte Funktionsidentifier" VAL_BLK 0xD09D0 Kwb_Wu16 61811.0000000 FidName 0.00 61811.0000000 FORMAT "%13.7" NUMBER 30 /end CHARACTERISTIC
/begin CHARACTERISTIC DSM_InhDfp_PFltPresSensB1_C "Durch Fehlerpfad Dfp_PFltPresSensB1 verriegelte Funktionsidentifier" VAL_BLK 0xD0A0C Kwb_Wu16 61811.0000000 FidName 0.00 61811.0000000 FORMAT "%13.7" NUMBER 36 /end CHARACTERISTIC
/begin CHARACTERISTIC DSM_InhDfp_PFltPresSensB2_C "Durch Fehlerpfad Dfp_PFltPresSensB2 verriegelte Funktionsidentifier" VAL_BLK 0xD0A54 Kwb_Wu16 61811.0000000 FidName 0.00 61811.0000000 FORMAT "%13.7" NUMBER 36 /end CHARACTERISTIC
/begin CHARACTERISTIC DSM_InhDfp_PFltPresSensFrz_C "Durch Fehlerpfad Dfp_PFltPresSensFrz verriegelte Funktionsidentifier" VAL_BLK 0xD0A9C Kwb_Wu16 61811.0000000 FidName 0.00 61811.0000000 FORMAT "%13.7" NUMBER 30 /end CHARACTERISTIC
/begin CHARACTERISTIC DSM_InhDfp_PFltPresSensHsLnB1_C "Durch Fehlerpfad Dfp_PFltPresSensHsLnB1 verriegelte Funktionsidentifier" VAL_BLK 0xD0AD8 Kwb_Wu16 61811.0000000 FidName 0.00 61811.0000000 FORMAT "%13.7" NUMBER 35 /end CHARACTERISTIC
/begin CHARACTERISTIC DSM_InhDfp_PFltPresSensHsLnB2_C "Durch Fehlerpfad Dfp_PFltPresSensHsLnB2 verriegelte Funktionsidentifier" VAL_BLK 0xD0B1E Kwb_Wu16 61811.0000000 FidName 0.00 61811.0000000 FORMAT "%13.7" NUMBER 35 /end CHARACTERISTIC
/begin CHARACTERISTIC DSM_InhDfp_PFltPresSensSotB1_C "Durch Fehlerpfad Dfp_PFltPresSensSotB1 verriegelte Funktionsidentifier" VAL_BLK 0xD0B64 Kwb_Wu16 61811.0000000 FidName 0.00 61811.0000000 FORMAT "%13.7" NUMBER 34 /end CHARACTERISTIC
/begin CHARACTERISTIC DSM_InhDfp_PFltPresSensSotB2_C "Durch Fehlerpfad Dfp_PFltPresSensSotB2 verriegelte Funktionsidentifier" VAL_BLK 0xD0BA8 Kwb_Wu16 61811.0000000 FidName 0.00 61811.0000000 FORMAT "%13.7" NUMBER 34 /end CHARACTERISTIC
/begin CHARACTERISTIC DSM_InhDfp_PFltRgnPerm_C "Durch Fehlerpfad Dfp_PFltRgnPerm verriegelte Funktionsidentifier" VAL_BLK 0xD0BEC Kwb_Wu16 61811.0000000 FidName 0.00 61811.0000000 FORMAT "%13.7" NUMBER 30 /end CHARACTERISTIC
/begin CHARACTERISTIC DSM_InhDfp_PFltTempDwnStrmB1_C "Durch Fehlerpfad Dfp_PFltTempDwnStrmB1 verriegelte Funktionsidentifier" VAL_BLK 0xD0C28 Kwb_Wu16 61811.0000000 FidName 0.00 61811.0000000 FORMAT "%13.7" NUMBER 37 /end CHARACTERISTIC
/begin CHARACTERISTIC DSM_InhDfp_PFltTempDwnStrmB2_C "Durch Fehlerpfad Dfp_PFltTempDwnStrmB2 verriegelte Funktionsidentifier" VAL_BLK 0xD0C72 Kwb_Wu16 61811.0000000 FidName 0.00 61811.0000000 FORMAT "%13.7" NUMBER 37 /end CHARACTERISTIC
/begin CHARACTERISTIC DSM_InhDfp_PFltTempSensB1_C "Durch Fehlerpfad Dfp_PFltTempSensB1 verriegelte Funktionsidentifier" VAL_BLK 0xD0CBC Kwb_Wu16 61811.0000000 FidName 0.00 61811.0000000 FORMAT "%13.7" NUMBER 37 /end CHARACTERISTIC
/begin CHARACTERISTIC DSM_InhDfp_PFltTempSensB2_C "Durch Fehlerpfad Dfp_PFltTempSensB2 verriegelte Funktionsidentifier" VAL_BLK 0xD0D06 Kwb_Wu16 61811.0000000 FidName 0.00 61811.0000000 FORMAT "%13.7" NUMBER 37 /end CHARACTERISTIC
/begin CHARACTERISTIC DSM_InhDfp_PFltTempUpStrmB1_C "Durch Fehlerpfad Dfp_PFltTempUpStrmB1 verriegelte Funktionsidentifier" VAL_BLK 0xD0D50 Kwb_Wu16 61811.0000000 FidName 0.00 61811.0000000 FORMAT "%13.7" NUMBER 34 /end CHARACTERISTIC
/begin CHARACTERISTIC DSM_InhDfp_PFltTempUpStrmB2_C "Durch Fehlerpfad Dfp_PFltTempUpStrmB2 verriegelte Funktionsidentifier" VAL_BLK 0xD0D94 Kwb_Wu16 61811.0000000 FidName 0.00 61811.0000000 FORMAT "%13.7" NUMBER 34 /end CHARACTERISTIC
/begin CHARACTERISTIC DSM_InhDfp_PFlt_tOxiPreMaxB1_C "Durch Fehlerpfad Dfp_PFlt_tOxiPreMaxB1 verriegelte Funktionsidentifier" VAL_BLK 0xD0DD8 Kwb_Wu16 61811.0000000 FidName 0.00 61811.0000000 FORMAT "%13.7" NUMBER 30 /end CHARACTERISTIC
/begin CHARACTERISTIC DSM_InhDfp_PFlt_tOxiPreMaxB2_C "Durch Fehlerpfad Dfp_PFlt_tOxiPreMaxB2 verriegelte Funktionsidentifier" VAL_BLK 0xD0E14 Kwb_Wu16 61811.0000000 FidName 0.00 61811.0000000 FORMAT "%13.7" NUMBER 30 /end CHARACTERISTIC
/begin CHARACTERISTIC DSM_InhDfp_PFlt_tOxiPreMxRgnB1_C "Durch Fehlerpfad Dfp_PFlt_tOxiPreMxRgnB1 verriegelte Funktionsidentifier" VAL_BLK 0xD0E50 Kwb_Wu16 61811.0000000 FidName 0.00 61811.0000000 FORMAT "%13.7" NUMBER 30 /end CHARACTERISTIC
/begin CHARACTERISTIC DSM_InhDfp_PFlt_tOxiPreMxRgnB2_C "Durch Fehlerpfad Dfp_PFlt_tOxiPreMxRgnB2 verriegelte Funktionsidentifier" VAL_BLK 0xD0E8C Kwb_Wu16 61811.0000000 FidName 0.00 61811.0000000 FORMAT "%13.7" NUMBER 30 /end CHARACTERISTIC
/begin CHARACTERISTIC DSM_InhDfp_PFlt_tPreMaxB1_C "Durch Fehlerpfad Dfp_PFlt_tPreMaxB1 verriegelte Funktionsidentifier" VAL_BLK 0xD0EC8 Kwb_Wu16 61811.0000000 FidName 0.00 61811.0000000 FORMAT "%13.7" NUMBER 30 /end CHARACTERISTIC
/begin CHARACTERISTIC DSM_InhDfp_PFlt_tPreMaxB2_C "Durch Fehlerpfad Dfp_PFlt_tPreMaxB2 verriegelte Funktionsidentifier" VAL_BLK 0xD0F04 Kwb_Wu16 61811.0000000 FidName 0.00 61811.0000000 FORMAT "%13.7" NUMBER 30 /end CHARACTERISTIC
/begin CHARACTERISTIC DSM_InhDfp_PFlt_tPreMaxRgnB1_C "Durch Fehlerpfad Dfp_PFlt_tPreMaxRgnB1 verriegelte Funktionsidentifier" VAL_BLK 0xD0F40 Kwb_Wu16 61811.0000000 FidName 0.00 61811.0000000 FORMAT "%13.7" NUMBER 30 /end CHARACTERISTIC
/begin CHARACTERISTIC DSM_InhDfp_PFlt_tPreMaxRgnB2_C "Durch Fehlerpfad Dfp_PFlt_tPreMaxRgnB2 verriegelte Funktionsidentifier" VAL_BLK 0xD0F7C Kwb_Wu16 61811.0000000 FidName 0.00 61811.0000000 FORMAT "%13.7" NUMBER 30 /end CHARACTERISTIC
/begin CHARACTERISTIC DSM_InhDfp_PFltmSotDiffMaxB1_C "Durch Fehlerpfad Dfp_PFltmSotDiffMaxB1 verriegelte Funktionsidentifier" VAL_BLK 0xD0FB8 Kwb_Wu16 61811.0000000 FidName 0.00 61811.0000000 FORMAT "%13.7" NUMBER 31 /end CHARACTERISTIC
/begin CHARACTERISTIC DSM_InhDfp_PFltmSotDiffMaxB2_C "Durch Fehlerpfad Dfp_PFltmSotDiffMaxB2 verriegelte Funktionsidentifier" VAL_BLK 0xD0FF6 Kwb_Wu16 61811.0000000 FidName 0.00 61811.0000000 FORMAT "%13.7" NUMBER 31 /end CHARACTERISTIC
/begin CHARACTERISTIC DSM_InhDfp_PresPlausDblDef_C "Durch Fehlerpfad Dfp_PresPlausDblDef verriegelte Funktionsidentifier" VAL_BLK 0xD1034 Kwb_Wu16 61811.0000000 FidName 0.00 61811.0000000 FORMAT "%13.7" NUMBER 15 /end CHARACTERISTIC
/begin CHARACTERISTIC DSM_InhDfp_QLTCD_C "Durch Fehlerpfad Dfp_QLTCD verriegelte Funktionsidentifier" VAL_BLK 0xD1052 Kwb_Wu16 61811.0000000 FidName 0.00 61811.0000000 FORMAT "%13.7" NUMBER 5 /end CHARACTERISTIC
/begin CHARACTERISTIC DSM_InhDfp_RailCD_C "Durch Fehlerpfad Dfp_RailCD verriegelte Funktionsidentifier" VAL_BLK 0xD105C Kwb_Wu16 61811.0000000 FidName 0.00 61811.0000000 FORMAT "%13.7" NUMBER 25 /end CHARACTERISTIC
/begin CHARACTERISTIC DSM_InhDfp_RailCDOfsTst_C "Durch Fehlerpfad Dfp_RailCDOfsTst verriegelte Funktionsidentifier" VAL_BLK 0xD108E Kwb_Wu16 61811.0000000 FidName 0.00 61811.0000000 FORMAT "%13.7" NUMBER 21 /end CHARACTERISTIC
/begin CHARACTERISTIC DSM_InhDfp_RailCD_PMonStrt_C "Durch Fehlerpfad Dfp_RailCD_PMonStrt verriegelte Funktionsidentifier" VAL_BLK 0xD10B8 Kwb_Wu16 61811.0000000 FidName 0.00 61811.0000000 FORMAT "%13.7" NUMBER 11 /end CHARACTERISTIC
/begin CHARACTERISTIC DSM_InhDfp_RailCPC1_C "Durch Fehlerpfad Dfp_RailCPC1 verriegelte Funktionsidentifier" VAL_BLK 0xD10CE Kwb_Wu16 61811.0000000 FidName 0.00 61811.0000000 FORMAT "%13.7" NUMBER 6 /end CHARACTERISTIC
/begin CHARACTERISTIC DSM_InhDfp_RailCPC3_C "Durch Fehlerpfad Dfp_RailCPC3 verriegelte Funktionsidentifier" VAL_BLK 0xD10DA Kwb_Wu16 61811.0000000 FidName 0.00 61811.0000000 FORMAT "%13.7" NUMBER 6 /end CHARACTERISTIC
/begin CHARACTERISTIC DSM_InhDfp_RailCPC4_C "Durch Fehlerpfad Dfp_RailCPC4 verriegelte Funktionsidentifier" VAL_BLK 0xD10E6 Kwb_Wu16 61811.0000000 FidName 0.00 61811.0000000 FORMAT "%13.7" NUMBER 6 /end CHARACTERISTIC
/begin CHARACTERISTIC DSM_InhDfp_RailCtlModeMeUnDiag_C "Durch Fehlerpfad Dfp_RailCtlModeMeUnDiag verriegelte Funktionsidentifier" VAL_BLK 0xD10F2 Kwb_Wu16 61811.0000000 FidName 0.00 61811.0000000 FORMAT "%13.7" NUMBER 7 /end CHARACTERISTIC
/begin CHARACTERISTIC DSM_InhDfp_RailCtlModePCVDiag_C "Durch Fehlerpfad Dfp_RailCtlModePCVDiag verriegelte Funktionsidentifier" VAL_BLK 0xD1100 Kwb_Wu16 61811.0000000 FidName 0.00 61811.0000000 FORMAT "%13.7" NUMBER 7 /end CHARACTERISTIC
/begin CHARACTERISTIC DSM_InhDfp_RailMeUn0_C "Durch Fehlerpfad Dfp_RailMeUn0 verriegelte Funktionsidentifier" VAL_BLK 0xD110E Kwb_Wu16 61811.0000000 FidName 0.00 61811.0000000 FORMAT "%13.7" NUMBER 13 /end CHARACTERISTIC
/begin CHARACTERISTIC DSM_InhDfp_RailMeUn1_C "Durch Fehlerpfad Dfp_RailMeUn1 verriegelte Funktionsidentifier" VAL_BLK 0xD1128 Kwb_Wu16 61811.0000000 FidName 0.00 61811.0000000 FORMAT "%13.7" NUMBER 11 /end CHARACTERISTIC
/begin CHARACTERISTIC DSM_InhDfp_RailMeUn2_C "Durch Fehlerpfad Dfp_RailMeUn2 verriegelte Funktionsidentifier" VAL_BLK 0xD113E Kwb_Wu16 61811.0000000 FidName 0.00 61811.0000000 FORMAT "%13.7" NUMBER 13 /end CHARACTERISTIC
/begin CHARACTERISTIC DSM_InhDfp_RailMeUn3_C "Durch Fehlerpfad Dfp_RailMeUn3 verriegelte Funktionsidentifier" VAL_BLK 0xD1158 Kwb_Wu16 61811.0000000 FidName 0.00 61811.0000000 FORMAT "%13.7" NUMBER 8 /end CHARACTERISTIC
/begin CHARACTERISTIC DSM_InhDfp_RailMeUn4_C "Durch Fehlerpfad Dfp_RailMeUn4 verriegelte Funktionsidentifier" VAL_BLK 0xD1168 Kwb_Wu16 61811.0000000 FidName 0.00 61811.0000000 FORMAT "%13.7" NUMBER 13 /end CHARACTERISTIC
/begin CHARACTERISTIC DSM_InhDfp_RailPCV0_C "Durch Fehlerpfad Dfp_RailPCV0 verriegelte Funktionsidentifier" VAL_BLK 0xD1182 Kwb_Wu16 61811.0000000 FidName 0.00 61811.0000000 FORMAT "%13.7" NUMBER 13 /end CHARACTERISTIC
/begin CHARACTERISTIC DSM_InhDfp_RailPCV1_C "Durch Fehlerpfad Dfp_RailPCV1 verriegelte Funktionsidentifier" VAL_BLK 0xD119C Kwb_Wu16 61811.0000000 FidName 0.00 61811.0000000 FORMAT "%13.7" NUMBER 8 /end CHARACTERISTIC
/begin CHARACTERISTIC DSM_InhDfp_RailPCV2_C "Durch Fehlerpfad Dfp_RailPCV2 verriegelte Funktionsidentifier" VAL_BLK 0xD11AC Kwb_Wu16 61811.0000000 FidName 0.00 61811.0000000 FORMAT "%13.7" NUMBER 10 /end CHARACTERISTIC
/begin CHARACTERISTIC DSM_InhDfp_RailPCV3_C "Durch Fehlerpfad Dfp_RailPCV3 verriegelte Funktionsidentifier" VAL_BLK 0xD11C0 Kwb_Wu16 61811.0000000 FidName 0.00 61811.0000000 FORMAT "%13.7" NUMBER 9 /end CHARACTERISTIC
/begin CHARACTERISTIC DSM_InhDfp_RailPCV4_C "Durch Fehlerpfad Dfp_RailPCV4 verriegelte Funktionsidentifier" VAL_BLK 0xD11D2 Kwb_Wu16 61811.0000000 FidName 0.00 61811.0000000 FORMAT "%13.7" NUMBER 13 /end CHARACTERISTIC
/begin CHARACTERISTIC DSM_InhDfp_RailPCV5_C "Durch Fehlerpfad Dfp_RailPCV5 verriegelte Funktionsidentifier" VAL_BLK 0xD11EC Kwb_Wu16 61811.0000000 FidName 0.00 61811.0000000 FORMAT "%13.7" NUMBER 8 /end CHARACTERISTIC
/begin CHARACTERISTIC DSM_InhDfp_SOPTst_C "Durch Fehlerpfad Dfp_SOPTst verriegelte Funktionsidentifier" VAL_BLK 0xD11FC Kwb_Wu16 61811.0000000 FidName 0.00 61811.0000000 FORMAT "%13.7" NUMBER 6 /end CHARACTERISTIC
/begin CHARACTERISTIC DSM_InhDfp_SSpMon1_C "Durch Fehlerpfad Dfp_SSpMon1 verriegelte Funktionsidentifier" VAL_BLK 0xD1208 Kwb_Wu16 61811.0000000 FidName 0.00 61811.0000000 FORMAT "%13.7" NUMBER 37 /end CHARACTERISTIC
/begin CHARACTERISTIC DSM_InhDfp_SSpMon2_C "Durch Fehlerpfad Dfp_SSpMon2 verriegelte Funktionsidentifier" VAL_BLK 0xD1252 Kwb_Wu16 61811.0000000 FidName 0.00 61811.0000000 FORMAT "%13.7" NUMBER 30 /end CHARACTERISTIC
/begin CHARACTERISTIC DSM_InhDfp_SSpMon3_C "Durch Fehlerpfad Dfp_SSpMon3 verriegelte Funktionsidentifier" VAL_BLK 0xD128E Kwb_Wu16 61811.0000000 FidName 0.00 61811.0000000 FORMAT "%13.7" NUMBER 25 /end CHARACTERISTIC
/begin CHARACTERISTIC DSM_InhDfp_SSpMon4_C "Durch Fehlerpfad Dfp_SSpMon4 verriegelte Funktionsidentifier" VAL_BLK 0xD12C0 Kwb_Wu16 61811.0000000 FidName 0.00 61811.0000000 FORMAT "%13.7" NUMBER 5 /end CHARACTERISTIC
/begin CHARACTERISTIC DSM_InhDfp_SSpMon5_C "Durch Fehlerpfad Dfp_SSpMon5 verriegelte Funktionsidentifier" VAL_BLK 0xD12CA Kwb_Wu16 61811.0000000 FidName 0.00 61811.0000000 FORMAT "%13.7" NUMBER 5 /end CHARACTERISTIC
/begin CHARACTERISTIC DSM_InhDfp_SSpMon6_C "Durch Fehlerpfad Dfp_SSpMon6 verriegelte Funktionsidentifier" VAL_BLK 0xD12D4 Kwb_Wu16 61811.0000000 FidName 0.00 61811.0000000 FORMAT "%13.7" NUMBER 5 /end CHARACTERISTIC
/begin CHARACTERISTIC DSM_InhDfp_SWChk_CycSigChkDat_C "Durch Fehlerpfad Dfp_SWChk_CycSigChkDat verriegelte Funktionsidentifier" VAL_BLK 0xD12DE Kwb_Wu16 61811.0000000 FidName 0.00 61811.0000000 FORMAT "%13.7" NUMBER 5 /end CHARACTERISTIC
/begin CHARACTERISTIC DSM_InhDfp_SWChk_CycSigChkPrg_C "Durch Fehlerpfad Dfp_SWChk_CycSigChkPrg verriegelte Funktionsidentifier" VAL_BLK 0xD12E8 Kwb_Wu16 61811.0000000 FidName 0.00 61811.0000000 FORMAT "%13.7" NUMBER 5 /end CHARACTERISTIC
/begin CHARACTERISTIC DSM_InhDfp_StSysTrqShutOff_C "Durch Fehlerpfad Dfp_StSysTrqShutOff verriegelte Funktionsidentifier" VAL_BLK 0xD12F2 Kwb_Wu16 61811.0000000 FidName 0.00 61811.0000000 FORMAT "%13.7" NUMBER 5 /end CHARACTERISTIC
/begin CHARACTERISTIC DSM_InhDfp_StrtCD_Actr_C "Durch Fehlerpfad Dfp_StrtCD_Actr verriegelte Funktionsidentifier" VAL_BLK 0xD12FC Kwb_Wu16 61811.0000000 FidName 0.00 61811.0000000 FORMAT "%13.7" NUMBER 5 /end CHARACTERISTIC
/begin CHARACTERISTIC DSM_InhDfp_SysLamp_C "Durch Fehlerpfad Dfp_SysLamp verriegelte Funktionsidentifier" VAL_BLK 0xD1306 Kwb_Wu16 61811.0000000 FidName 0.00 61811.0000000 FORMAT "%13.7" NUMBER 6 /end CHARACTERISTIC
/begin CHARACTERISTIC DSM_InhDfp_T15CD_C "Durch Fehlerpfad Dfp_T15CD verriegelte Funktionsidentifier" VAL_BLK 0xD1312 Kwb_Wu16 61811.0000000 FidName 0.00 61811.0000000 FORMAT "%13.7" NUMBER 8 /end CHARACTERISTIC
/begin CHARACTERISTIC DSM_InhDfp_TGearbx_C "Durch Fehlerpfad Dfp_TGearbx verriegelte Funktionsidentifier" VAL_BLK 0xD1322 Kwb_Wu16 61811.0000000 FidName 0.00 61811.0000000 FORMAT "%13.7" NUMBER 6 /end CHARACTERISTIC
/begin CHARACTERISTIC DSM_InhDfp_TPUMon_C "Durch Fehlerpfad Dfp_TPUMon verriegelte Funktionsidentifier" VAL_BLK 0xD132E Kwb_Wu16 61811.0000000 FidName 0.00 61811.0000000 FORMAT "%13.7" NUMBER 5 /end CHARACTERISTIC
/begin CHARACTERISTIC DSM_InhDfp_TVACD_AirMon1_C "Durch Fehlerpfad Dfp_TVACD_AirMon1 verriegelte Funktionsidentifier" VAL_BLK 0xD1338 Kwb_Wu16 61811.0000000 FidName 0.00 61811.0000000 FORMAT "%13.7" NUMBER 10 /end CHARACTERISTIC
/begin CHARACTERISTIC DSM_InhDfp_TVACD_AirMon2_C "Durch Fehlerpfad Dfp_TVACD_AirMon2 verriegelte Funktionsidentifier" VAL_BLK 0xD134C Kwb_Wu16 61811.0000000 FidName 0.00 61811.0000000 FORMAT "%13.7" NUMBER 10 /end CHARACTERISTIC
/begin CHARACTERISTIC DSM_InhDfp_TVACD_Max_C "Durch Fehlerpfad Dfp_TVACD_Max verriegelte Funktionsidentifier" VAL_BLK 0xD1360 Kwb_Wu16 61811.0000000 FidName 0.00 61811.0000000 FORMAT "%13.7" NUMBER 16 /end CHARACTERISTIC
/begin CHARACTERISTIC DSM_InhDfp_TVACD_Max2_C "Durch Fehlerpfad Dfp_TVACD_Max2 verriegelte Funktionsidentifier" VAL_BLK 0xD1380 Kwb_Wu16 61811.0000000 FidName 0.00 61811.0000000 FORMAT "%13.7" NUMBER 13 /end CHARACTERISTIC
/begin CHARACTERISTIC DSM_InhDfp_TVACD_Min_C "Durch Fehlerpfad Dfp_TVACD_Min verriegelte Funktionsidentifier" VAL_BLK 0xD139A Kwb_Wu16 61811.0000000 FidName 0.00 61811.0000000 FORMAT "%13.7" NUMBER 15 /end CHARACTERISTIC
/begin CHARACTERISTIC DSM_InhDfp_TVACD_Min2_C "Durch Fehlerpfad Dfp_TVACD_Min2 verriegelte Funktionsidentifier" VAL_BLK 0xD13B8 Kwb_Wu16 61811.0000000 FidName 0.00 61811.0000000 FORMAT "%13.7" NUMBER 13 /end CHARACTERISTIC
/begin CHARACTERISTIC DSM_InhDfp_TVACD_SigNpl_C "Durch Fehlerpfad Dfp_TVACD_SigNpl verriegelte Funktionsidentifier" VAL_BLK 0xD13D2 Kwb_Wu16 61811.0000000 FidName 0.00 61811.0000000 FORMAT "%13.7" NUMBER 18 /end CHARACTERISTIC
/begin CHARACTERISTIC DSM_InhDfp_TVACD_SigNpl2_C "Durch Fehlerpfad Dfp_TVACD_SigNpl2 verriegelte Funktionsidentifier" VAL_BLK 0xD13F6 Kwb_Wu16 61811.0000000 FidName 0.00 61811.0000000 FORMAT "%13.7" NUMBER 13 /end CHARACTERISTIC
/begin CHARACTERISTIC DSM_InhDfp_TVACD_TVADia1_C "Durch Fehlerpfad Dfp_TVACD_TVADia1 verriegelte Funktionsidentifier" VAL_BLK 0xD1410 Kwb_Wu16 61811.0000000 FidName 0.00 61811.0000000 FORMAT "%13.7" NUMBER 11 /end CHARACTERISTIC
/begin CHARACTERISTIC DSM_InhDfp_TVACD_TVADia2_C "Durch Fehlerpfad Dfp_TVACD_TVADia2 verriegelte Funktionsidentifier" VAL_BLK 0xD1426 Kwb_Wu16 61811.0000000 FidName 0.00 61811.0000000 FORMAT "%13.7" NUMBER 11 /end CHARACTERISTIC
/begin CHARACTERISTIC DSM_InhDfp_TVACD_TVADia21_C "Durch Fehlerpfad Dfp_TVACD_TVADia21 verriegelte Funktionsidentifier" VAL_BLK 0xD143C Kwb_Wu16 61811.0000000 FidName 0.00 61811.0000000 FORMAT "%13.7" NUMBER 10 /end CHARACTERISTIC
/begin CHARACTERISTIC DSM_InhDfp_TVACD_TVADia22_C "Durch Fehlerpfad Dfp_TVACD_TVADia22 verriegelte Funktionsidentifier" VAL_BLK 0xD1450 Kwb_Wu16 61811.0000000 FidName 0.00 61811.0000000 FORMAT "%13.7" NUMBER 10 /end CHARACTERISTIC
/begin CHARACTERISTIC DSM_InhDfp_TVACD_TVADia23_C "Durch Fehlerpfad Dfp_TVACD_TVADia23 verriegelte Funktionsidentifier" VAL_BLK 0xD1464 Kwb_Wu16 61811.0000000 FidName 0.00 61811.0000000 FORMAT "%13.7" NUMBER 10 /end CHARACTERISTIC
/begin CHARACTERISTIC DSM_InhDfp_TVACD_TVADia24_C "Durch Fehlerpfad Dfp_TVACD_TVADia24 verriegelte Funktionsidentifier" VAL_BLK 0xD1478 Kwb_Wu16 61811.0000000 FidName 0.00 61811.0000000 FORMAT "%13.7" NUMBER 10 /end CHARACTERISTIC
/begin CHARACTERISTIC DSM_InhDfp_TVACD_TVADia3_C "Durch Fehlerpfad Dfp_TVACD_TVADia3 verriegelte Funktionsidentifier" VAL_BLK 0xD148C Kwb_Wu16 61811.0000000 FidName 0.00 61811.0000000 FORMAT "%13.7" NUMBER 11 /end CHARACTERISTIC
/begin CHARACTERISTIC DSM_InhDfp_TVACD_TVADia4_C "Durch Fehlerpfad Dfp_TVACD_TVADia4 verriegelte Funktionsidentifier" VAL_BLK 0xD14A2 Kwb_Wu16 61811.0000000 FidName 0.00 61811.0000000 FORMAT "%13.7" NUMBER 10 /end CHARACTERISTIC
/begin CHARACTERISTIC DSM_InhDfp_ThrVlvMon_C "Durch Fehlerpfad Dfp_ThrVlvMon verriegelte Funktionsidentifier" VAL_BLK 0xD14B6 Kwb_Wu16 61811.0000000 FidName 0.00 61811.0000000 FORMAT "%13.7" NUMBER 5 /end CHARACTERISTIC
/begin CHARACTERISTIC DSM_InhDfp_VSACD_DiaDet_C "Durch Fehlerpfad Dfp_VSACD_DiaDet verriegelte Funktionsidentifier" VAL_BLK 0xD14C0 Kwb_Wu16 61811.0000000 FidName 0.00 61811.0000000 FORMAT "%13.7" NUMBER 6 /end CHARACTERISTIC
/begin CHARACTERISTIC DSM_InhDfp_VSACD_DioInDia1_C "Durch Fehlerpfad Dfp_VSACD_DioInDia1 verriegelte Funktionsidentifier" VAL_BLK 0xD14CC Kwb_Wu16 61811.0000000 FidName 0.00 61811.0000000 FORMAT "%13.7" NUMBER 5 /end CHARACTERISTIC
/begin CHARACTERISTIC DSM_InhDfp_VSACD_DioInDia2_C "Durch Fehlerpfad Dfp_VSACD_DioInDia2 verriegelte Funktionsidentifier" VAL_BLK 0xD14D6 Kwb_Wu16 61811.0000000 FidName 0.00 61811.0000000 FORMAT "%13.7" NUMBER 5 /end CHARACTERISTIC
/begin CHARACTERISTIC DSM_InhDfp_VSACD_DioInDia3_C "Durch Fehlerpfad Dfp_VSACD_DioInDia3 verriegelte Funktionsidentifier" VAL_BLK 0xD14E0 Kwb_Wu16 61811.0000000 FidName 0.00 61811.0000000 FORMAT "%13.7" NUMBER 5 /end CHARACTERISTIC
/begin CHARACTERISTIC DSM_InhDfp_VSACD_DioInDia4_C "Durch Fehlerpfad Dfp_VSACD_DioInDia4 verriegelte Funktionsidentifier" VAL_BLK 0xD14EA Kwb_Wu16 61811.0000000 FidName 0.00 61811.0000000 FORMAT "%13.7" NUMBER 5 /end CHARACTERISTIC
/begin CHARACTERISTIC DSM_InhDfp_VSACD_DioInMin_C "Durch Fehlerpfad Dfp_VSACD_DioInMin verriegelte Funktionsidentifier" VAL_BLK 0xD14F4 Kwb_Wu16 61811.0000000 FidName 0.00 61811.0000000 FORMAT "%13.7" NUMBER 5 /end CHARACTERISTIC
/begin CHARACTERISTIC DSM_InhDfp_VSACD_Max_C "Durch Fehlerpfad Dfp_VSACD_Max verriegelte Funktionsidentifier" VAL_BLK 0xD14FE Kwb_Wu16 61811.0000000 FidName 0.00 61811.0000000 FORMAT "%13.7" NUMBER 7 /end CHARACTERISTIC
/begin CHARACTERISTIC DSM_InhDfp_VSACD_Min_C "Durch Fehlerpfad Dfp_VSACD_Min verriegelte Funktionsidentifier" VAL_BLK 0xD150C Kwb_Wu16 61811.0000000 FidName 0.00 61811.0000000 FORMAT "%13.7" NUMBER 7 /end CHARACTERISTIC
/begin CHARACTERISTIC DSM_InhDfp_VSACD_SigNpl_C "Durch Fehlerpfad Dfp_VSACD_SigNpl verriegelte Funktionsidentifier" VAL_BLK 0xD151A Kwb_Wu16 61811.0000000 FidName 0.00 61811.0000000 FORMAT "%13.7" NUMBER 7 /end CHARACTERISTIC
/begin CHARACTERISTIC DSM_InhDfp_VSACD_VSADia1_C "Durch Fehlerpfad Dfp_VSACD_VSADia1 verriegelte Funktionsidentifier" VAL_BLK 0xD1528 Kwb_Wu16 61811.0000000 FidName 0.00 61811.0000000 FORMAT "%13.7" NUMBER 5 /end CHARACTERISTIC
/begin CHARACTERISTIC DSM_InhDfp_VSACD_VSADia2_C "Durch Fehlerpfad Dfp_VSACD_VSADia2 verriegelte Funktionsidentifier" VAL_BLK 0xD1532 Kwb_Wu16 61811.0000000 FidName 0.00 61811.0000000 FORMAT "%13.7" NUMBER 5 /end CHARACTERISTIC
/begin CHARACTERISTIC DSM_InhDfp_VSACD_VSADia3_C "Durch Fehlerpfad Dfp_VSACD_VSADia3 verriegelte Funktionsidentifier" VAL_BLK 0xD153C Kwb_Wu16 61811.0000000 FidName 0.00 61811.0000000 FORMAT "%13.7" NUMBER 5 /end CHARACTERISTIC
/begin CHARACTERISTIC DSM_InhDfp_VSACD_VSADia4_C "Durch Fehlerpfad Dfp_VSACD_VSADia4 verriegelte Funktionsidentifier" VAL_BLK 0xD1546 Kwb_Wu16 61811.0000000 FidName 0.00 61811.0000000 FORMAT "%13.7" NUMBER 5 /end CHARACTERISTIC
/begin CHARACTERISTIC DSM_InhDfp_VSSCD1_C "Durch Fehlerpfad Dfp_VSSCD1 verriegelte Funktionsidentifier" VAL_BLK 0xD1550 Kwb_Wu16 61811.0000000 FidName 0.00 61811.0000000 FORMAT "%13.7" NUMBER 24 /end CHARACTERISTIC
/begin CHARACTERISTIC DSM_InhDfp_VSSCD2_C "Durch Fehlerpfad Dfp_VSSCD2 verriegelte Funktionsidentifier" VAL_BLK 0xD1580 Kwb_Wu16 61811.0000000 FidName 0.00 61811.0000000 FORMAT "%13.7" NUMBER 25 /end CHARACTERISTIC
/begin CHARACTERISTIC DSM_InhDfp_WdCom_C "Durch Fehlerpfad Dfp_WdCom verriegelte Funktionsidentifier" VAL_BLK 0xD15B2 Kwb_Wu16 61811.0000000 FidName 0.00 61811.0000000 FORMAT "%13.7" NUMBER 6 /end CHARACTERISTIC
/begin FUNCTION dsm_auto_inh ""
 /begin DEF_CHARACTERISTIC DSM_InhDfp_Layer_TANS_C DSM_InhDfp_ACCDSwtin_C DSM_InhDfp_ACC_PlausTrqDes_C DSM_InhDfp_ACC_trqInr_C DSM_InhDfp_ACTrq_C DSM_InhDfp_ADCMon_C DSM_InhDfp_AFSCDIdlAdjVal_C DSM_InhDfp_AFSCDLdAdjVal_C DSM_InhDfp_AFSCDPlAirPerCylDif_C DSM_InhDfp_AFSCD_AirTempDcyc_C DSM_InhDfp_AFSCD_AirTempDcyc2_C DSM_InhDfp_AFSCD_PlOffsDrft_C DSM_InhDfp_AFSCD_PlOffsDrft2_C DSM_InhDfp_AFSCD_PlSetyDrft_C DSM_InhDfp_AFSCD_SRCAirTemp_C DSM_InhDfp_AFSCD_SRCAirTemp2_C DSM_InhDfp_AFSCD_SRCBatt_C DSM_InhDfp_AFSCD_SRCBatt2_C DSM_InhDfp_AFSCD_SRCCorrAirm_C DSM_InhDfp_Layer_TUMG_C DSM_InhDfp_AFSCD_SRCCorrAirm2_C DSM_InhDfp_AFSCD_SRCRawAirm_C DSM_InhDfp_Layer_GEN_C DSM_InhDfp_Layer_BSD_C DSM_InhDfp_AFSCD_SRCRawAirm2_C DSM_InhDfp_AFSCD_SRCRefSigPer_C DSM_InhDfp_AFSCD_SRCRefSigPer2_C DSM_InhDfp_AOHtCD_C DSM_InhDfp_AOHtCD_AOHtDia1_C DSM_InhDfp_AOHtCD_AOHtDia2_C DSM_InhDfp_AOHtCD_AOHtDia3_C DSM_InhDfp_APP1_C DSM_InhDfp_APP2_C DSM_InhDfp_APPCDCmpd_C DSM_InhDfp_Layer_QLT_C DSM_InhDfp_APPSync_C DSM_InhDfp_Layer_IBS1_C DSM_InhDfp_Layer_IBS2_C DSM_InhDfp_Layer_IBS3_C DSM_InhDfp_Layer_PMBN_C DSM_InhDfp_Layer_PMBATT_C DSM_InhDfp_APSCD_C DSM_InhDfp_ARS_C DSM_InhDfp_AccPedPlausBrk_C DSM_InhDfp_AddPCDTnkLvl_C DSM_InhDfp_AirCtlGvnrDvtRgnMax_C DSM_InhDfp_AirCtlGvnrDvtRgnMin_C DSM_InhDfp_AirCtlGvnrDvtRgnMn2_C DSM_InhDfp_AirCtlGvnrDvtRgnMx2_C DSM_InhDfp_AirCtlPlateBreak_C DSM_InhDfp_AirCtlRmpTO_C DSM_InhDfp_AirCtl_GovNegDev_C DSM_InhDfp_AirCtl_GovNegDev2_C DSM_InhDfp_AirCtl_GovPosDev_C DSM_InhDfp_AirCtl_GovPosDev2_C DSM_InhDfp_AltCD_C DSM_InhDfp_BPACD_BPADia1_C DSM_InhDfp_BPACD_BPADia1v2_C DSM_InhDfp_BPACD_BPADia2_C DSM_InhDfp_BPACD_BPADia2v2_C DSM_InhDfp_BPACD_BPADia3_C DSM_InhDfp_BPACD_BPADia3v2_C DSM_InhDfp_BPACD_BPADia4_C DSM_InhDfp_BPACD_BPADia4v2_C DSM_InhDfp_BPACD_Max_C DSM_InhDfp_BPACD_Max2_C DSM_InhDfp_BPACD_Min_C DSM_InhDfp_BPACD_Min2_C DSM_InhDfp_BPACD_SigNpl_C DSM_InhDfp_BPACD_SigNpl2_C DSM_InhDfp_BPSCD_C DSM_InhDfp_BattCD_C DSM_InhDfp_BrkCD_C DSM_InhDfp_Layer_PMRUHVERL_C DSM_InhDfp_Bss_C DSM_InhDfp_CBACD_C DSM_InhDfp_CTSCD_C DSM_InhDfp_Clg_DynTst_C DSM_InhDfp_Layer_TOENS_C DSM_InhDfp_Layer_MANHYDR_C DSM_InhDfp_Layer_MANLUFT_C DSM_InhDfp_CmbChbMisfire1_C DSM_InhDfp_CmbChbMisfire2_C DSM_InhDfp_CmbChbMisfire3_C DSM_InhDfp_CmbChbMisfire4_C DSM_InhDfp_CmbChbMisfire5_C DSM_InhDfp_CmbChbMisfire6_C DSM_InhDfp_CmbChbMisfire7_C DSM_InhDfp_CmbChbMisfire8_C DSM_InhDfp_CmbChbMisfireMul_C DSM_InhDfp_CoDT_TRQ_Des_C DSM_InhDfp_CoDT_TRQ_Lead_C DSM_InhDfp_CoEng_GbxRpmRduc_C DSM_InhDfp_CoVMDCSh_C DSM_InhDfp_ConvCD_C DSM_InhDfp_CrCCDMFL_C DSM_InhDfp_CrCtl_vCrCtl_C DSM_InhDfp_EATSCD_C DSM_InhDfp_EBAFCD_C DSM_InhDfp_EBFCD_C DSM_InhDfp_EBTSCD_C DSM_InhDfp_EBTSCD_OvrTemp_C DSM_InhDfp_EEPCDVarMng_C DSM_InhDfp_EGPpCD_C DSM_InhDfp_EGRCD_Max_C DSM_InhDfp_EGRCD_Max2_C DSM_InhDfp_EGRCD_Min_C DSM_InhDfp_EGRCD_Min2_C DSM_InhDfp_EGRCD_PWMInDia1_C DSM_InhDfp_EGRCD_PWMInDia2_C DSM_InhDfp_EGRCD_PWMInDia21_C DSM_InhDfp_EGRCD_PWMInDia22_C DSM_InhDfp_EGRCD_PWMInDia23_C DSM_InhDfp_EGRCD_PWMInDia24_C DSM_InhDfp_EGRCD_PWMInDia3_C DSM_InhDfp_EGRCD_PWMInDia4_C DSM_InhDfp_EGRCD_SigDia_C DSM_InhDfp_EGRCD_SigDia2_C DSM_InhDfp_EGRCD_SigNpl_C DSM_InhDfp_EGRCD_SigNpl2_C DSM_InhDfp_EGTOilLvlCrit_C DSM_InhDfp_EGTOilVscCrit_C DSM_InhDfp_EGTRgnOilDil_C DSM_InhDfp_EGTTempGvnrInrB1_C DSM_InhDfp_EGTTempGvnrInrB2_C DSM_InhDfp_EGTTempGvnrOutrB1_C DSM_InhDfp_EGTTempGvnrOutrB2_C DSM_InhDfp_ETClbETFltInj1_C DSM_InhDfp_ETClbETFltInj2_C DSM_InhDfp_ETClbETFltInj3_C DSM_InhDfp_ETClbETFltInj4_C DSM_InhDfp_ETClbETFltInj5_C DSM_InhDfp_ETClbETFltInj6_C DSM_InhDfp_ETClbETFltInj7_C DSM_InhDfp_ETClbETFltInj8_C DSM_InhDfp_ETClbInj1_C DSM_InhDfp_ETClbInj2_C DSM_InhDfp_ETClbInj3_C DSM_InhDfp_ETClbInj4_C DSM_InhDfp_ETClbInj5_C DSM_InhDfp_ETClbInj6_C DSM_InhDfp_ETClbInj7_C DSM_InhDfp_ETClbInj8_C DSM_InhDfp_EngMCaS1_C DSM_InhDfp_EngMCrS1_C DSM_InhDfp_EngMOfsCaSCrS_C DSM_InhDfp_EngMntCtlCD_C DSM_InhDfp_FBCqDvt_C DSM_InhDfp_FMAErrMod_C DSM_InhDfp_FMTC_NonMonotonMap_C DSM_InhDfp_FTSCD_C DSM_InhDfp_FanCD_C DSM_InhDfp_FanCD_FanCtlr1_C DSM_InhDfp_FanCD_FanCtlr2_C DSM_InhDfp_FanCD_FanCtlr3_C DSM_InhDfp_FlFCD_C DSM_InhDfp_FlMngSmkDefect_C DSM_InhDfp_FlSCDT1_C DSM_InhDfp_FrmMngANFRADMOMPT_C DSM_InhDfp_FrmMngASC1_C DSM_InhDfp_FrmMngASC2_C DSM_InhDfp_FrmMngASC3_C DSM_InhDfp_FrmMngASC4_C DSM_InhDfp_FrmMngBOS_RESET_C DSM_InhDfp_FrmMngBOS_RESET2_C DSM_InhDfp_FrmMngDMANFAFS_C DSM_InhDfp_FrmMngDRMANFSSG_C DSM_InhDfp_FrmMngEGS1_C DSM_InhDfp_FrmMngEGS2_C DSM_InhDfp_FrmMngGEARBX_DATA_C DSM_InhDfp_FrmMngGEARBX_DATA2_C DSM_InhDfp_FrmMngHEAT_AC_C DSM_InhDfp_FrmMngINSTR2_C DSM_InhDfp_FrmMngINSTR3_C DSM_InhDfp_FrmMngLENKRADWINKEL_C DSM_InhDfp_FrmMngMILEAGE_RANGE_C DSM_InhDfp_FrmMngMSPHISYNC_C DSM_InhDfp_FrmMngMST4_C DSM_InhDfp_FrmMngMST5_C DSM_InhDfp_FrmMngOPCRCTLACC_C DSM_InhDfp_FrmMngPRGG_CCTR_C DSM_InhDfp_FrmMngPWRMNG_LOADV_C DSM_InhDfp_FrmMngParkConsumer_C DSM_InhDfp_FrmMngRQSTGEFAN_C DSM_InhDfp_FrmMngSLV4_C DSM_InhDfp_FrmMngSLV5_C DSM_InhDfp_FrmMngSSGErr_C DSM_InhDfp_FrmMngSSGShOff_C DSM_InhDfp_FrmMngSTAT_ANH_C DSM_InhDfp_FrmMngSTAT_ARS_C DSM_InhDfp_FrmMngSTAT_DSC_C DSM_InhDfp_FrmMngSTAT_EKP_C DSM_InhDfp_FrmMngSTAT_KOMBI_C DSM_InhDfp_FrmMngSTAT_SITZ_C DSM_InhDfp_FrmMngStOBDGbxMilOf_C DSM_InhDfp_FrmMngStOBDGbxMilOn_C DSM_InhDfp_FrmMngTEMPRELTIME_C DSM_InhDfp_FrmMngTERMINAL_C DSM_InhDfp_FrmMngTIME_DATE_C DSM_InhDfp_FrmMngTORQUE_DSC_C DSM_InhDfp_FrmMngTORQUE_GEARBX_C DSM_InhDfp_FrmMngTrq_ReqACC_C DSM_InhDfp_FrmMngVEH_MOD_C DSM_InhDfp_FrmMngVELOCITY_C DSM_InhDfp_FrmMngWHEEL_SPEED_C DSM_InhDfp_FrmMngstCurr_C DSM_InhDfp_FrmMngswtPSPOff_C DSM_InhDfp_GearbxIncMax_C DSM_InhDfp_GlwCD_C DSM_InhDfp_GlwCDGlwCirc1_C DSM_InhDfp_GlwCDGlwCirc2_C DSM_InhDfp_GlwCDGlwCirc3_C DSM_InhDfp_GlwCDGlwCirc4_C DSM_InhDfp_GlwCDGlwCirc5_C DSM_InhDfp_GlwCDGlwCirc6_C DSM_InhDfp_GlwCDGlwCirc7_C DSM_InhDfp_GlwCDGlwCirc8_C DSM_InhDfp_GlwCtl_C DSM_InhDfp_HWEMonCom_C DSM_InhDfp_HWEMonEEPROM_C DSM_InhDfp_HWEMonRcyLocked_C DSM_InhDfp_HWEMonRcySuppressed_C DSM_InhDfp_HWEMonRcyVisible_C DSM_InhDfp_HWEMonUMaxSupply_C DSM_InhDfp_HWEMonUMinSupply_C DSM_InhDfp_IATSCD_C DSM_InhDfp_IATSCD_CATS_C DSM_InhDfp_IATSCD_CATSSec_C DSM_InhDfp_ImmCtlImmCD_C DSM_InhDfp_ImmCtlImmEep_C DSM_InhDfp_ImmCtlMpl_C DSM_InhDfp_IndSys1_C DSM_InhDfp_IndSys2_C DSM_InhDfp_InjCrv_InjLim_C DSM_InhDfp_InjCtlAdjQnt_C DSM_InhDfp_InjCtlDrift_C DSM_InhDfp_InjVCDActrChrg_C DSM_InhDfp_InjVCDActrEnrg1_C DSM_InhDfp_InjVCDActrEnrg2_C DSM_InhDfp_InjVCDActrEnrg3_C DSM_InhDfp_InjVCDActrEnrg4_C DSM_InhDfp_InjVCDActrEnrg5_C DSM_InhDfp_InjVCDActrEnrg6_C DSM_InhDfp_InjVCDActrEnrg7_C DSM_InhDfp_InjVCDActrEnrg8_C DSM_InhDfp_InjVCDActrVolt_C DSM_InhDfp_InjVCDClsBank1_C DSM_InhDfp_InjVCDClsBank2_C DSM_InhDfp_InjVCDMonCab_C DSM_InhDfp_InjVCDMonSwt_C DSM_InhDfp_InjVCDShOffDCDC_C DSM_InhDfp_InjVCDUBuf1_C DSM_InhDfp_InjVCDUBuf2_C DSM_InhDfp_InjVCD_CY370Ampl_C DSM_InhDfp_InjVCD_DrvTime_C DSM_InhDfp_InjVCD_DrvTimeRcy_C DSM_InhDfp_InjVCD_TPUErr_C DSM_InhDfp_InjVlvBnk1A_C DSM_InhDfp_InjVlvBnk1B_C DSM_InhDfp_InjVlvBnk2A_C DSM_InhDfp_InjVlvBnk2B_C DSM_InhDfp_InjVlvChipA_C DSM_InhDfp_InjVlvChipB_C DSM_InhDfp_InjVlvCyl1A_C DSM_InhDfp_InjVlvCyl1B_C DSM_InhDfp_InjVlvCyl1C_C DSM_InhDfp_InjVlvCyl2A_C DSM_InhDfp_InjVlvCyl2B_C DSM_InhDfp_InjVlvCyl2C_C DSM_InhDfp_InjVlvCyl3A_C DSM_InhDfp_InjVlvCyl3B_C DSM_InhDfp_InjVlvCyl3C_C DSM_InhDfp_InjVlvCyl4A_C DSM_InhDfp_InjVlvCyl4B_C DSM_InhDfp_InjVlvCyl4C_C DSM_InhDfp_InjVlvCyl5A_C DSM_InhDfp_InjVlvCyl5B_C DSM_InhDfp_InjVlvCyl5C_C DSM_InhDfp_InjVlvCyl6A_C DSM_InhDfp_InjVlvCyl6B_C DSM_InhDfp_InjVlvCyl6C_C DSM_InhDfp_InjVlvCyl7A_C DSM_InhDfp_InjVlvCyl7B_C DSM_InhDfp_InjVlvCyl7C_C DSM_InhDfp_InjVlvCyl8A_C DSM_InhDfp_InjVlvCyl8B_C DSM_InhDfp_InjVlvCyl8C_C DSM_InhDfp_InjVlvNVC1_C DSM_InhDfp_InjVlvNVC2_C DSM_InhDfp_InjVlvNVC3_C DSM_InhDfp_InjVlvNVC4_C DSM_InhDfp_InjVlvNVC5_C DSM_InhDfp_InjVlvNVC6_C DSM_InhDfp_InjVlvNVC7_C DSM_InhDfp_InjVlvNVC8_C DSM_InhDfp_KeyCheck_C DSM_InhDfp_LIGovECUTransMode_C DSM_InhDfp_LPACD_Max_C DSM_InhDfp_LPACD_Min_C DSM_InhDfp_LPACD_SigNpl_C DSM_InhDfp_LSUCDCircNernst0B1_C DSM_InhDfp_LSUCDCircNernst0B2_C DSM_InhDfp_LSUCDCircPumpCur0B1_C DSM_InhDfp_LSUCDCircPumpCur0B2_C DSM_InhDfp_LSUCDCircVirtGnd0B1_C DSM_InhDfp_LSUCDCircVirtGnd0B2_C DSM_InhDfp_LSUCDHeater0B1_C DSM_InhDfp_LSUCDHeater0B2_C DSM_InhDfp_LSUCDHtCoup0B1_C DSM_InhDfp_LSUCDHtCoup0B2_C DSM_InhDfp_LSUCDO20B1_C DSM_InhDfp_LSUCDO20B2_C DSM_InhDfp_LSUCDO2Clb0B1_C DSM_InhDfp_LSUCDO2Clb0B2_C DSM_InhDfp_LSUCDRiClb0B1_C DSM_InhDfp_LSUCDRiClb0B2_C DSM_InhDfp_LSUCDSPI0B1_C DSM_InhDfp_LSUCDSPI0B2_C DSM_InhDfp_LSUCDSPIBattLow0B1_C DSM_InhDfp_LSUCDSPIBattLow0B2_C DSM_InhDfp_LSUCDWireIP0B1_C DSM_InhDfp_LSUCDWireIP0B2_C DSM_InhDfp_LSUCtlRiExc0B1_C DSM_InhDfp_LSUCtlRiExc0B2_C DSM_InhDfp_LSUMon1SensB1_C DSM_InhDfp_LSUMon1SensB2_C DSM_InhDfp_LSUMon2SensB1_C DSM_InhDfp_LSUMon2SensB2_C DSM_InhDfp_MIL_C DSM_InhDfp_MRlyCD_C DSM_InhDfp_MSMon_C DSM_InhDfp_MSMonConsist_C DSM_InhDfp_MSMonPFlt1_C DSM_InhDfp_MSMonPFlt2_C DSM_InhDfp_MSMonPFlt3_C DSM_InhDfp_MSMonPFlt4_C DSM_InhDfp_MSMon_ARS_TO_C DSM_InhDfp_MSMon_AirCtl_C DSM_InhDfp_MSMon_AirSys0_C DSM_InhDfp_MSMon_AirSys1_C DSM_InhDfp_MSMon_AirSys2_C DSM_InhDfp_MSMon_AirSys3_C DSM_InhDfp_MSMon_AirSys4_C DSM_InhDfp_MSMon_AirSys7_C DSM_InhDfp_MSMon_CanDef_C DSM_InhDfp_MSMon_CoEng_OffVeh_C DSM_InhDfp_MSMon_CoEng_Rev1_C DSM_InhDfp_MSMon_CoEng_Rev2_C DSM_InhDfp_MSMon_CoEng_RevMS_C DSM_InhDfp_MSMon_DSC_TO_C DSM_InhDfp_MSMon_EGS_TO_C DSM_InhDfp_MSMon_FrmMngCoEng_C DSM_InhDfp_MSMon_FrmMngPT_C DSM_InhDfp_MSMon_FrmMngPT2_C DSM_InhDfp_MSMon_Mil_C DSM_InhDfp_MSMon_NetMngPtCan_C DSM_InhDfp_MSMon_RailCDPMon_C DSM_InhDfp_MSMon_StEGS_C DSM_InhDfp_MSMon_SysLamp_C DSM_InhDfp_MSMon_ZFCClbActv_C DSM_InhDfp_MSMon_qLimErr_C DSM_InhDfp_MSMon_trqCoDT_C DSM_InhDfp_MSMon_trqCoVeh_C DSM_InhDfp_MSMon_trqCoVehLim_C DSM_InhDfp_MSMon_trqDesExt_C DSM_InhDfp_MSMon_trqDesExtRev_C DSM_InhDfp_MSMon_trqLimErr_C DSM_InhDfp_MSMon_trqLimErr1_C DSM_InhDfp_MSMon_trqLimErr2_C DSM_InhDfp_MSMon_trqLimErr3_C DSM_InhDfp_MSMon_trqLimErr4_C DSM_InhDfp_MSidCD_Comm_C DSM_InhDfp_MSidCD_EcuMixed_C DSM_InhDfp_MSidCD_Pin_C DSM_InhDfp_MSidCD_Sel_INI_C DSM_InhDfp_MSidCD_Select_C DSM_InhDfp_MSid_SwCmp_C DSM_InhDfp_MSid_regEEPDiff_C DSM_InhDfp_MeUnCDNoLoad_C DSM_InhDfp_MeUnCDSCBat_C DSM_InhDfp_MeUnCDSCGnd_C DSM_InhDfp_MeUnCD_ADC_C DSM_InhDfp_MeUnCD_SigTst_C DSM_InhDfp_Montr_C DSM_InhDfp_NetMngDeviceA_C DSM_InhDfp_NetMngDeviceB_C DSM_InhDfp_NetMngDeviceC_C DSM_InhDfp_NetMngPrvCan_C DSM_InhDfp_NetMngPrvCanSlave_C DSM_InhDfp_NetMngPtCan_C DSM_InhDfp_NetMngPtCanSlave_C DSM_InhDfp_OPSCD_Lamp_C DSM_InhDfp_OPSCD_anain_C DSM_InhDfp_OTSCD_C DSM_InhDfp_OvRMon_C DSM_InhDfp_OvRMonSigA_C DSM_InhDfp_OxiCCDTPreB1_C DSM_InhDfp_OxiCCDTPreB2_C DSM_InhDfp_PCBS_C DSM_InhDfp_PCR_BalGvnr_C DSM_InhDfp_PCR_GovDevNeg_C DSM_InhDfp_PCR_GovDevPos_C DSM_InhDfp_PCR_LPGvnrDvtNeg_C DSM_InhDfp_PCR_LPGvnrDvtPos_C DSM_InhDfp_PCVCDNoLoad_C DSM_InhDfp_PCVCDSCBat_C DSM_InhDfp_PCVCDSCGnd_C DSM_InhDfp_PCVCD_ADC_C DSM_InhDfp_PCVCD_SigTst_C DSM_InhDfp_PFltAPSPlaus_C DSM_InhDfp_PFltAPSensB1_C DSM_InhDfp_PFltAPSensB2_C DSM_InhDfp_PFltBPSPlaus_C DSM_InhDfp_PFltCDPPreB1_C DSM_InhDfp_PFltCDPPreB2_C DSM_InhDfp_PFltCDTPreB1_C DSM_InhDfp_PFltCDTPreB2_C DSM_InhDfp_PFltCharB1_C DSM_InhDfp_PFltCharB2_C DSM_InhDfp_PFltDltOxiPreTwFlw_C DSM_InhDfp_PFltDltPreTwFlw_C DSM_InhDfp_PFltEngPrtB1_C DSM_InhDfp_PFltEngPrtB2_C DSM_InhDfp_PFltOvldInhRgnB1_C DSM_InhDfp_PFltOvldInhRgnB2_C DSM_InhDfp_PFltOvldTrqLimB1_C DSM_InhDfp_PFltOvldTrqLimB2_C DSM_InhDfp_PFltPresDynPlausB1_C DSM_InhDfp_PFltPresDynPlausB2_C DSM_InhDfp_PFltPresPlausB1_C DSM_InhDfp_PFltPresPlausB2_C DSM_InhDfp_PFltPresSensB1_C DSM_InhDfp_PFltPresSensB2_C DSM_InhDfp_PFltPresSensFrz_C DSM_InhDfp_PFltPresSensHsLnB1_C DSM_InhDfp_PFltPresSensHsLnB2_C DSM_InhDfp_PFltPresSensSotB1_C DSM_InhDfp_PFltPresSensSotB2_C DSM_InhDfp_PFltRgnPerm_C DSM_InhDfp_PFltTempDwnStrmB1_C DSM_InhDfp_PFltTempDwnStrmB2_C DSM_InhDfp_PFltTempSensB1_C DSM_InhDfp_PFltTempSensB2_C DSM_InhDfp_PFltTempUpStrmB1_C DSM_InhDfp_PFltTempUpStrmB2_C DSM_InhDfp_PFlt_tOxiPreMaxB1_C DSM_InhDfp_PFlt_tOxiPreMaxB2_C DSM_InhDfp_PFlt_tOxiPreMxRgnB1_C DSM_InhDfp_PFlt_tOxiPreMxRgnB2_C DSM_InhDfp_PFlt_tPreMaxB1_C DSM_InhDfp_PFlt_tPreMaxB2_C DSM_InhDfp_PFlt_tPreMaxRgnB1_C DSM_InhDfp_PFlt_tPreMaxRgnB2_C DSM_InhDfp_PFltmSotDiffMaxB1_C DSM_InhDfp_PFltmSotDiffMaxB2_C DSM_InhDfp_PresPlausDblDef_C DSM_InhDfp_QLTCD_C DSM_InhDfp_RailCD_C DSM_InhDfp_RailCDOfsTst_C DSM_InhDfp_RailCD_PMonStrt_C DSM_InhDfp_RailCPC1_C DSM_InhDfp_RailCPC3_C DSM_InhDfp_RailCPC4_C DSM_InhDfp_RailCtlModeMeUnDiag_C DSM_InhDfp_RailCtlModePCVDiag_C DSM_InhDfp_RailMeUn0_C DSM_InhDfp_RailMeUn1_C DSM_InhDfp_RailMeUn2_C DSM_InhDfp_RailMeUn3_C DSM_InhDfp_RailMeUn4_C DSM_InhDfp_RailPCV0_C DSM_InhDfp_RailPCV1_C DSM_InhDfp_RailPCV2_C DSM_InhDfp_RailPCV3_C DSM_InhDfp_RailPCV4_C DSM_InhDfp_RailPCV5_C DSM_InhDfp_SOPTst_C DSM_InhDfp_SSpMon1_C DSM_InhDfp_SSpMon2_C DSM_InhDfp_SSpMon3_C DSM_InhDfp_SSpMon4_C DSM_InhDfp_SSpMon5_C DSM_InhDfp_SSpMon6_C DSM_InhDfp_SWChk_CycSigChkDat_C DSM_InhDfp_SWChk_CycSigChkPrg_C DSM_InhDfp_StSysTrqShutOff_C DSM_InhDfp_StrtCD_Actr_C DSM_InhDfp_SysLamp_C DSM_InhDfp_T15CD_C DSM_InhDfp_TGearbx_C DSM_InhDfp_TPUMon_C DSM_InhDfp_TVACD_AirMon1_C DSM_InhDfp_TVACD_AirMon2_C DSM_InhDfp_TVACD_Max_C DSM_InhDfp_TVACD_Max2_C DSM_InhDfp_TVACD_Min_C DSM_InhDfp_TVACD_Min2_C DSM_InhDfp_TVACD_SigNpl_C DSM_InhDfp_TVACD_SigNpl2_C DSM_InhDfp_TVACD_TVADia1_C DSM_InhDfp_TVACD_TVADia2_C DSM_InhDfp_TVACD_TVADia21_C DSM_InhDfp_TVACD_TVADia22_C DSM_InhDfp_TVACD_TVADia23_C DSM_InhDfp_TVACD_TVADia24_C DSM_InhDfp_TVACD_TVADia3_C DSM_InhDfp_TVACD_TVADia4_C DSM_InhDfp_ThrVlvMon_C DSM_InhDfp_VSACD_DiaDet_C DSM_InhDfp_VSACD_DioInDia1_C DSM_InhDfp_VSACD_DioInDia2_C DSM_InhDfp_VSACD_DioInDia3_C DSM_InhDfp_VSACD_DioInDia4_C DSM_InhDfp_VSACD_DioInMin_C DSM_InhDfp_VSACD_Max_C DSM_InhDfp_VSACD_Min_C DSM_InhDfp_VSACD_SigNpl_C DSM_InhDfp_VSACD_VSADia1_C DSM_InhDfp_VSACD_VSADia2_C DSM_InhDfp_VSACD_VSADia3_C DSM_InhDfp_VSACD_VSADia4_C DSM_InhDfp_VSSCD1_C DSM_InhDfp_VSSCD2_C DSM_InhDfp_WdCom_C /end DEF_CHARACTERISTIC
/end FUNCTION
/begin COMPU_METHOD FidName "Verbale Umrechnung für Fid-Namen" TAB_VERB "%6.3" "-" COMPU_TAB_REF FidName /end COMPU_METHOD
/begin COMPU_VTAB FidName "Verbale Umrechnung für Fid-Namen" TAB_VERB 1856 0 "Fid_unused" 4097 "Fid_ACCIRevErr_MAX" 4098 "Fid_ACCRevErr_MAX" 4099 "Fid_ACC_AliveErr_MAX" 4100 "Fid_ACC_CanDef_MAX" 4101 "Fid_ACC_CsErr_MAX" 4102 "Fid_ACC_TiOutErr_MAX" 4103 "Fid_ACCtl_ACTrqErr_MAX" 4104 "Fid_ACCtl_CTSErr_MAX" 4105 "Fid_ACCtl_FanErr_MAX" 4106 "Fid_ACCtl_TGearbxErr_MAX" 4107 "Fid_ACCtl_VSSErr_MAX" 4108 "Fid_AFSCD_MAX" 4109 "Fid_AFSCD2_MAX" 4110 "Fid_AFSCD_AirPerCyl_MAX" 4111 "Fid_AFSCD_AirPerCyl2_MAX" 4112 "Fid_AFSCD_AirPerTime_MAX" 4113 "Fid_AFSCD_AirPerTime2_MAX" 4114 "Fid_AFSCD_BPSCDErr_MAX" 4115 "Fid_AFSCD_PlAirPerCylDifOff_MAX" 4116 "Fid_AFSCD_PlOffsDrft_MAX" 4117 "Fid_AFSCD_PlOffsDrft2_MAX" 4118 "Fid_AFSCD_PlSetyDrft_MAX" 4119 "Fid_AFSCD_PlSetyDrft2_MAX" 4120 "Fid_AFSCD_SRCCorrAirm_MAX" 4121 "Fid_AFSCD_SRCCorrAirm2_MAX" 4122 "Fid_AFSCD_SRCDcyc_MAX" 4123 "Fid_AFSCD_SRCDcyc2_MAX" 4124 "Fid_AFSCD_SRCRawAirm_MAX" 4125 "Fid_AFSCD_SRCRawAirm2_MAX" 4126 "Fid_AFSCD_SRCRefSig_MAX" 4127 "Fid_AFSCD_SRCRefSig2_MAX" 4128 "Fid_AFSCD_tAir1_MAX" 4129 "Fid_AFSCD_tAir2_MAX" 4130 "Fid_AOHt_AltErr_MAX" 4131 "Fid_AOHt_ShutOffErr_MAX" 4132 "Fid_APP1_MAX" 4133 "Fid_APP2_MAX" 4134 "Fid_APPKickdown_MAX" 4135 "Fid_APSCD_MAX" 4136 "Fid_ARSOff_MAX" 4137 "Fid_ASDdc_MAX" 4138 "Fid_ASModSwtOffEng_MAX" 4139 "Fid_ASModSwtOffIndVol_MAX" 4140 "Fid_AccPed_MAX" 4141 "Fid_AccPedBrkPres_MAX" 4142 "Fid_AccPedVel_MAX" 4143 "Fid_AccPed_Brk_MAX" 4144 "Fid_AirCtl_MAX" 4145 "Fid_AirCtlCorrAlt_MAX" 4146 "Fid_AirCtlDyn_MAX" 4147 "Fid_AirCtlNeg_MAX" 4148 "Fid_AirCtlNeg2_MAX" 4149 "Fid_AirCtlPFltEGRRed_MAX" 4150 "Fid_AirCtlPlateBreak_MAX" 4151 "Fid_AirCtlPlateBreakAct_MAX" 4152 "Fid_AirCtlPos_MAX" 4153 "Fid_AirCtlPos2_MAX" 4154 "Fid_AirCtl_Brk_MAX" 4155 "Fid_AirCtl_Gear_MAX" 4156 "Fid_BPSCDMon_MAX" 4157 "Fid_CTSCDFlTemp_MAX" 4158 "Fid_CTSCD_Plaus_MAX" 4159 "Fid_ClgDynTst_MAX" 4160 "Fid_CmbChb_MAX" 4161 "Fid_CoDT_GripDeb_MAX" 4162 "Fid_CoDT_Mon_MAX" 4163 "Fid_CoDT_TRQ_MAX" 4164 "Fid_CoEngIRevSys1_MAX" 4165 "Fid_CoEngIRevSys2_MAX" 4166 "Fid_CoEngIRevVeh_MAX" 4167 "Fid_CoEngPFltErr_MAX" 4168 "Fid_CoEngPFltOvldErr_MAX" 4169 "Fid_CoEngRevSys1_MAX" 4170 "Fid_CoEngRevSys2_MAX" 4171 "Fid_CoEngRevVeh_MAX" 4172 "Fid_CoEngShOffTst_MAX" 4173 "Fid_CoEngSoftShOffTV_MAX" 4174 "Fid_CoEng_ActrPrt_MAX" 4175 "Fid_CoEng_Nrml2Strt_MAX" 4176 "Fid_CoEng_PwrStgEnable_MAX" 4177 "Fid_CoEng_trqLimErr_MAX" 4178 "Fid_CoEng_trqLimErr1_MAX" 4179 "Fid_CoEng_trqLimErr2_MAX" 4180 "Fid_CoEng_trqLimErr3_MAX" 4181 "Fid_CoEng_trqLimErr4_MAX" 4182 "Fid_CoVM_StabDem_Err_MAX" 4183 "Fid_CoVehtrqLimErr_MAX" 4184 "Fid_CpBVlvOff_MAX" 4185 "Fid_CrCtlShutOffIr_MAX" 4186 "Fid_CrCtl_ASCTimeout_MAX" 4187 "Fid_CrCtl_CanDef_MAX" 4188 "Fid_CrCtl_KombiTimeout_MAX" 4189 "Fid_CrCtl_vCrCtl_MAX" 4190 "Fid_DSM_Wuc_MAX" 4191 "Fid_EATSCDTSubs_MAX" 4192 "Fid_EBAFCD_MAX" 4193 "Fid_EBFCD_MAX" 4194 "Fid_ECU_MAX" 4195 "Fid_EGSysCoLSU0_MAX" 4196 "Fid_EGSysCoNSC_MAX" 4197 "Fid_EGSysCoOxi_MAX" 4198 "Fid_EGSysCoTrbn_MAX" 4199 "Fid_EGSysCoTube0_MAX" 4200 "Fid_EGSysCoTube1_MAX" 4201 "Fid_EGSysHtgDel_MAX" 4202 "Fid_EGSysMaxTOxiPreB1_MAX" 4203 "Fid_EGSysMaxTOxiPreB2_MAX" 4204 "Fid_EGSysMaxTPreB1_MAX" 4205 "Fid_EGSysMaxTPreB2_MAX" 4206 "Fid_EGSysMaxTPreRgnB1_MAX" 4207 "Fid_EGSysMaxTPreRgnB2_MAX" 4208 "Fid_EGSysMxTOxiPreRgnB1_MAX" 4209 "Fid_EGSysMxTOxiPreRgnB2_MAX" 4210 "Fid_EGSysNSC_MAX" 4211 "Fid_EGSysOxiCat_MAX" 4212 "Fid_EGSysPresEnv_MAX" 4213 "Fid_EGSysStrt_MAX" 4214 "Fid_EGSysTemp_MAX" 4215 "Fid_EGSysTrbn_MAX" 4216 "Fid_EGSysTube_MAX" 4217 "Fid_EGSys_AP_MAX" 4218 "Fid_EGTRgnLck_MAX" 4219 "Fid_EGTTempGvnrAirCtl_MAX" 4220 "Fid_EGTTempGvnrInrB1_MAX" 4221 "Fid_EGTTempGvnrInrB2_MAX" 4222 "Fid_EGTTempGvnrOutrB1_MAX" 4223 "Fid_EGTTempGvnrOutrB2_MAX" 4224 "Fid_ETClbCorActv_MAX" 4225 "Fid_EngCTSCD_MAX" 4226 "Fid_EngMCaS1_MAX" 4227 "Fid_EngMCaSBackUp_MAX" 4228 "Fid_EngMCrS1_MAX" 4229 "Fid_EngMCrSBackUp_MAX" 4230 "Fid_EngMTEng_MAX" 4231 "Fid_EngMTrqFrcPDiff_MAX" 4232 "Fid_EngMVVeh_MAX" 4233 "Fid_EngM_ChkStrtSpd_MAX" 4234 "Fid_EngPrt_nLimErr_MAX" 4235 "Fid_FBC_MAX" 4236 "Fid_FBCMonI_MAX" 4237 "Fid_FMASwtOff1_MAX" 4238 "Fid_FMASwtOff2_MAX" 4239 "Fid_FMASwtOff3_MAX" 4240 "Fid_FMTC_AirCorr_MAX" 4241 "Fid_FMTC_PCRCorr_MAX" 4242 "Fid_FMTC_SOECorr_MAX" 4243 "Fid_FTSCDErr_MAX" 4244 "Fid_FanCtl_MAX" 4245 "Fid_FanGbxOil_MAX" 4246 "Fid_FlMngFullLdRglOff_MAX" 4247 "Fid_FlMngSmkDefect_MAX" 4248 "Fid_FlMngTPFltErr_MAX" 4249 "Fid_FlSysCTSSens_MAX" 4250 "Fid_FlSysDens_MAX" 4251 "Fid_FlSysFTSSens_MAX" 4252 "Fid_FrmMngAOHt_MAX" 4253 "Fid_FrmMngAPP_MAX" 4254 "Fid_FrmMngARS_MAX" 4255 "Fid_FrmMngAddLevl_MAX" 4256 "Fid_FrmMngBrk_MAX" 4257 "Fid_FrmMngBrkDef_MAX" 4258 "Fid_FrmMngCoEng_MAX" 4259 "Fid_FrmMngCoEng_St2_MAX" 4260 "Fid_FrmMngConvDef_MAX" 4261 "Fid_FrmMngEngOvrSpd_MAX" 4262 "Fid_FrmMngEngRpmTemp_MAX" 4263 "Fid_FrmMngEngSpd_MAX" 4264 "Fid_FrmMngInjDU1_MAX" 4265 "Fid_FrmMngInjDU2_MAX" 4266 "Fid_FrmMngInjVlv_MAX" 4267 "Fid_FrmMngOBDCtl_MAX" 4268 "Fid_FrmMngPFltDef_MAX" 4269 "Fid_FrmMngParkConsumer_MAX" 4270 "Fid_FrmMngPla_DSC_MAX" 4271 "Fid_FrmMngPla_EGS_MAX" 4272 "Fid_FrmMngPowerTrainCAN_MAX" 4273 "Fid_FrmMngPrvCan_MAX" 4274 "Fid_FrmMngPwrMngLIGovSt_MAX" 4275 "Fid_FrmMngRpmRduc_MAX" 4276 "Fid_FrmMngSIG_ARS_MAX" 4277 "Fid_FrmMngSIG_DSC_MAX" 4278 "Fid_FrmMngSig_EGS_MAX" 4279 "Fid_FrmMngTO_ARS_MAX" 4280 "Fid_FrmMngTO_DSC_MAX" 4281 "Fid_FrmMngTo_EGS_MAX" 4282 "Fid_FrmMngTrqGearbx_MAX" 4283 "Fid_FrmMngWaterVlv_MAX" 4284 "Fid_FrmMng_ST_TORQ_MAX" 4285 "Fid_FrmMng_stTrq_MAX" 4286 "Fid_FrmMngnSetpoint_MAX" 4287 "Fid_FrmMngpVal_MAX" 4288 "Fid_FrmMngtEng_MAX" 4289 "Fid_GearbxDrvAway_MAX" 4290 "Fid_GearbxDrvAwayInactv_MAX" 4291 "Fid_GearbxNmin_MAX" 4292 "Fid_GearbxPtCANErr_MAX" 4293 "Fid_GearbxSlip_MAX" 4294 "Fid_GearbxTrqLimErr_MAX" 4295 "Fid_Gearbx_GearDet_MAX" 4296 "Fid_Gearbx_TrqIntv_Err_MAX" 4297 "Fid_GlwCtl1_MAX" 4298 "Fid_GlwCtl2_MAX" 4299 "Fid_GlwCtl3_MAX" 4300 "Fid_HDC_MAX" 4301 "Fid_IATSCD_MAX" 4302 "Fid_IATSCD_tAir1_MAX" 4303 "Fid_IATSCD_tAir2_MAX" 4304 "Fid_IndSys1_MAX" 4305 "Fid_IndSys2_MAX" 4306 "Fid_InjCrvCoErr_MAX" 4307 "Fid_InjCrvCylOffs_MAX" 4308 "Fid_InjCtl_qLimErr_MAX" 4309 "Fid_InjVCDActrEnrgTemp_MAX" 4310 "Fid_InjVCDCls_MAX" 4311 "Fid_InjVCDTPUErr_MAX" 4312 "Fid_InjVlvActrTemp_MAX" 4313 "Fid_InjVlvInjLim_MAX" 4314 "Fid_InjVlvMon_MAX" 4315 "Fid_InjVlvNVC_MAX" 4316 "Fid_InjVlvSetUpVolt_MAX" 4317 "Fid_InjVlvWvCorOff_MAX" 4318 "Fid_LIGovSetpointDrvAwy_MAX" 4319 "Fid_LIGovUbr_MAX" 4320 "Fid_LSUCDMon0_MAX" 4321 "Fid_LSUCDO20_MAX" 4322 "Fid_LSUCDRi0_MAX" 4323 "Fid_LSUCDactiv0_MAX" 4324 "Fid_LSUCDlsu0_MAX" 4325 "Fid_LSUClbSched_MAX" 4326 "Fid_LSUCtl0_MAX" 4327 "Fid_LSUMonAllChecks_MAX" 4328 "Fid_LSUMonPlausChk_MAX" 4329 "Fid_Layer_FI_TANS_MAX" 4330 "Fid_Layer_FI_TUMG_MAX" 4331 "Fid_Layer_MANHYDR_MAX" 4332 "Fid_Layer_MANLUFT_MAX" 4333 "Fid_MSCDPrivCan_MAX" 4334 "Fid_MSMonNetMngPtCan_MAX" 4335 "Fid_MSMonPFlt1_MAX" 4336 "Fid_MSMonPFlt2_MAX" 4337 "Fid_MSMonPFlt3_MAX" 4338 "Fid_MSMonPFlt4_MAX" 4339 "Fid_MSMonStEGS_MAX" 4340 "Fid_MSMon_ARS_TO_MAX" 4341 "Fid_MSMon_CanDef_MAX" 4342 "Fid_MSMon_DSC_TO_MAX" 4343 "Fid_MSMon_EGS_TO_MAX" 4344 "Fid_MSMon_FrmMngPT_MAX" 4345 "Fid_MSMon_FrmMngPT2_MAX" 4346 "Fid_MSMon_trqOff_MAX" 4347 "Fid_MSidCD_ECU_MAX" 4348 "Fid_MSidCD_Pin_MAX" 4349 "Fid_MeUnCDCalcI_MAX" 4350 "Fid_Mil_MAX" 4351 "Fid_OTSCD_MAX" 4352 "Fid_OxiCat_pPreCat_MAX" 4353 "Fid_PCBSPFltDef_MAX" 4354 "Fid_PCR_MAX" 4355 "Fid_PCRBalGvnr_MAX" 4356 "Fid_PCRBalGvnrP40Corr_MAX" 4357 "Fid_PCRExtnLimActr_MAX" 4358 "Fid_PCRGvnrDvtNeg_MAX" 4359 "Fid_PCRGvnrDvtPos_MAX" 4360 "Fid_PCRLPGvnrDvtNeg_MAX" 4361 "Fid_PCRLPGvnrDvtPos_MAX" 4362 "Fid_PCRSurgeGvnr_MAX" 4363 "Fid_PCRSurgeLIGov_MAX" 4364 "Fid_PCR_LP_MAX" 4365 "Fid_PCR_LPMS_MAX" 4366 "Fid_PCR_MS_MAX" 4367 "Fid_PCR_SurgeDet_MAX" 4368 "Fid_PCVCDCalcI_MAX" 4369 "Fid_PFltAshCor_MAX" 4370 "Fid_PFltAshCorRgn_MAX" 4371 "Fid_PFltBrk_MAX" 4372 "Fid_PFltCharB1_MAX" 4373 "Fid_PFltCharB2_MAX" 4374 "Fid_PFltChngParB1_MAX" 4375 "Fid_PFltChngParB2_MAX" 4376 "Fid_PFltClth_MAX" 4377 "Fid_PFltDynChkB1_MAX" 4378 "Fid_PFltDynChkB2_MAX" 4379 "Fid_PFltEngPrtRgnMon_MAX" 4380 "Fid_PFltGearDet_MAX" 4381 "Fid_PFltHsLnChkB1_MAX" 4382 "Fid_PFltHsLnChkB2_MAX" 4383 "Fid_PFltLckRgnErr_MAX" 4384 "Fid_PFltLckRgnFuel_MAX" 4385 "Fid_PFltNumPFltErr_MAX" 4386 "Fid_PFltNumPFltErrLck_MAX" 4387 "Fid_PFltPlausPresB1_MAX" 4388 "Fid_PFltPlausPresB2_MAX" 4389 "Fid_PFltPlausTempB1_MAX" 4390 "Fid_PFltPlausTempB2_MAX" 4391 "Fid_PFltPresPlausProj_MAX" 4392 "Fid_PFltPresSensFrz_MAX" 4393 "Fid_PFltPresSensHsLnB1_MAX" 4394 "Fid_PFltPresSensHsLnB2_MAX" 4395 "Fid_PFltPresSensPreB1_MAX" 4396 "Fid_PFltPresSensPreB2_MAX" 4397 "Fid_PFltSRCPresB1_MAX" 4398 "Fid_PFltSRCPresB2_MAX" 4399 "Fid_PFltSRCTempB1_MAX" 4400 "Fid_PFltSRCTempB2_MAX" 4401 "Fid_PFltSimOnB1_MAX" 4402 "Fid_PFltSimOnB2_MAX" 4403 "Fid_PFltSpdVeh_MAX" 4404 "Fid_PFltSucB1_MAX" 4405 "Fid_PFltSucB2_MAX" 4406 "Fid_PFltTOxiPreDiffB1_MAX" 4407 "Fid_PFltTOxiPreDiffB2_MAX" 4408 "Fid_PFltTPreDiffB1_MAX" 4409 "Fid_PFltTPreDiffB2_MAX" 4410 "Fid_PFltTempAir_MAX" 4411 "Fid_PFltTempClnt_MAX" 4412 "Fid_PFltTempOxiPreB1_MAX" 4413 "Fid_PFltTempOxiPreB2_MAX" 4414 "Fid_PFltTempOxiPstB1_MAX" 4415 "Fid_PFltTempOxiPstB2_MAX" 4416 "Fid_PFltTempPreB1_MAX" 4417 "Fid_PFltTempPreB2_MAX" 4418 "Fid_PFltTempSensB1_MAX" 4419 "Fid_PFltTempSensB2_MAX" 4420 "Fid_PFltTempSensFrz_MAX" 4421 "Fid_PFltTwFlwTempDev_MAX" 4422 "Fid_PFltVltgBatt_MAX" 4423 "Fid_RailCDRPSErrChk_MAX" 4424 "Fid_RailCDSubstVal_MAX" 4425 "Fid_RailCD_PMonStrt_MAX" 4426 "Fid_RailCPCtlMeUnMode_MAX" 4427 "Fid_RailCPCtlPCVMode_MAX" 4428 "Fid_RailCtlMode_MAX" 4429 "Fid_RailMeUn0Blk_MAX" 4430 "Fid_RailMeUn0Rls_MAX" 4431 "Fid_RailMeUn1Blk_MAX" 4432 "Fid_RailMeUn1Rls_MAX" 4433 "Fid_RailMeUn2Blk_MAX" 4434 "Fid_RailMeUn2Rls_MAX" 4435 "Fid_RailMeUn3Blk_MAX" 4436 "Fid_RailMeUn3Rls_MAX" 4437 "Fid_RailMeUn4Blk_MAX" 4438 "Fid_RailMeUn4Rls_MAX" 4439 "Fid_RailMeUnCtlMode_MAX" 4440 "Fid_RailPCV0Blk_MAX" 4441 "Fid_RailPCV0Rls_MAX" 4442 "Fid_RailPCV1Blk_MAX" 4443 "Fid_RailPCV1Rls_MAX" 4444 "Fid_RailPCV2Blk_MAX" 4445 "Fid_RailPCV2Rls_MAX" 4446 "Fid_RailPCV3Blk_MAX" 4447 "Fid_RailPCV3Rls_MAX" 4448 "Fid_RailPCV4Blk_MAX" 4449 "Fid_RailPCV4Rls_MAX" 4450 "Fid_RailPCV5Blk_MAX" 4451 "Fid_RailPCV5Rls_MAX" 4452 "Fid_RailPCVCtlMode_MAX" 4453 "Fid_RailSetPointLim_MAX" 4454 "Fid_RailSetPointRed_MAX" 4455 "Fid_SignalsTstNLim_MAX" 4456 "Fid_StSysImmo_MAX" 4457 "Fid_StSysStrtTipGbxDat_MAX" 4458 "Fid_SysLamp_MAX" 4459 "Fid_T15CDCanError_MAX" 4460 "Fid_T50CDSig_MAX" 4461 "Fid_TVACD_AirMonOff_MAX" 4462 "Fid_ThrVlvMon_MAX" 4463 "Fid_VSACDDioInDia_MAX" 4464 "Fid_VSSCD_Tx_MAX" 4465 "Fid_VehDaDist_MAX" 4466 "Fid_ZFCClbActv_MAX" 4467 "Fid_ZFCCldCmbCham_MAX" 8193 "Fid_ACCIRevErr_MIN" 8194 "Fid_ACCRevErr_MIN" 8195 "Fid_ACC_AliveErr_MIN" 8196 "Fid_ACC_CanDef_MIN" 8197 "Fid_ACC_CsErr_MIN" 8198 "Fid_ACC_TiOutErr_MIN" 8199 "Fid_ACCtl_ACTrqErr_MIN" 8200 "Fid_ACCtl_CTSErr_MIN" 8201 "Fid_ACCtl_FanErr_MIN" 8202 "Fid_ACCtl_TGearbxErr_MIN" 8203 "Fid_ACCtl_VSSErr_MIN" 8204 "Fid_AFSCD_MIN" 8205 "Fid_AFSCD2_MIN" 8206 "Fid_AFSCD_AirPerCyl_MIN" 8207 "Fid_AFSCD_AirPerCyl2_MIN" 8208 "Fid_AFSCD_AirPerTime_MIN" 8209 "Fid_AFSCD_AirPerTime2_MIN" 8210 "Fid_AFSCD_BPSCDErr_MIN" 8211 "Fid_AFSCD_PlAirPerCylDifOff_MIN" 8212 "Fid_AFSCD_PlOffsDrft_MIN" 8213 "Fid_AFSCD_PlOffsDrft2_MIN" 8214 "Fid_AFSCD_PlSetyDrft_MIN" 8215 "Fid_AFSCD_PlSetyDrft2_MIN" 8216 "Fid_AFSCD_SRCCorrAirm_MIN" 8217 "Fid_AFSCD_SRCCorrAirm2_MIN" 8218 "Fid_AFSCD_SRCDcyc_MIN" 8219 "Fid_AFSCD_SRCDcyc2_MIN" 8220 "Fid_AFSCD_SRCRawAirm_MIN" 8221 "Fid_AFSCD_SRCRawAirm2_MIN" 8222 "Fid_AFSCD_SRCRefSig_MIN" 8223 "Fid_AFSCD_SRCRefSig2_MIN" 8224 "Fid_AFSCD_tAir1_MIN" 8225 "Fid_AFSCD_tAir2_MIN" 8226 "Fid_AOHt_AltErr_MIN" 8227 "Fid_AOHt_ShutOffErr_MIN" 8228 "Fid_APP1_MIN" 8229 "Fid_APP2_MIN" 8230 "Fid_APPKickdown_MIN" 8231 "Fid_APSCD_MIN" 8232 "Fid_ARSOff_MIN" 8233 "Fid_ASDdc_MIN" 8234 "Fid_ASModSwtOffEng_MIN" 8235 "Fid_ASModSwtOffIndVol_MIN" 8236 "Fid_AccPed_MIN" 8237 "Fid_AccPedBrkPres_MIN" 8238 "Fid_AccPedVel_MIN" 8239 "Fid_AccPed_Brk_MIN" 8240 "Fid_AirCtl_MIN" 8241 "Fid_AirCtlCorrAlt_MIN" 8242 "Fid_AirCtlDyn_MIN" 8243 "Fid_AirCtlNeg_MIN" 8244 "Fid_AirCtlNeg2_MIN" 8245 "Fid_AirCtlPFltEGRRed_MIN" 8246 "Fid_AirCtlPlateBreak_MIN" 8247 "Fid_AirCtlPlateBreakAct_MIN" 8248 "Fid_AirCtlPos_MIN" 8249 "Fid_AirCtlPos2_MIN" 8250 "Fid_AirCtl_Brk_MIN" 8251 "Fid_AirCtl_Gear_MIN" 8252 "Fid_BPSCDMon_MIN" 8253 "Fid_CTSCDFlTemp_MIN" 8254 "Fid_CTSCD_Plaus_MIN" 8255 "Fid_ClgDynTst_MIN" 8256 "Fid_CmbChb_MIN" 8257 "Fid_CoDT_GripDeb_MIN" 8258 "Fid_CoDT_Mon_MIN" 8259 "Fid_CoDT_TRQ_MIN" 8260 "Fid_CoEngIRevSys1_MIN" 8261 "Fid_CoEngIRevSys2_MIN" 8262 "Fid_CoEngIRevVeh_MIN" 8263 "Fid_CoEngPFltErr_MIN" 8264 "Fid_CoEngPFltOvldErr_MIN" 8265 "Fid_CoEngRevSys1_MIN" 8266 "Fid_CoEngRevSys2_MIN" 8267 "Fid_CoEngRevVeh_MIN" 8268 "Fid_CoEngShOffTst_MIN" 8269 "Fid_CoEngSoftShOffTV_MIN" 8270 "Fid_CoEng_ActrPrt_MIN" 8271 "Fid_CoEng_Nrml2Strt_MIN" 8272 "Fid_CoEng_PwrStgEnable_MIN" 8273 "Fid_CoEng_trqLimErr_MIN" 8274 "Fid_CoEng_trqLimErr1_MIN" 8275 "Fid_CoEng_trqLimErr2_MIN" 8276 "Fid_CoEng_trqLimErr3_MIN" 8277 "Fid_CoEng_trqLimErr4_MIN" 8278 "Fid_CoVM_StabDem_Err_MIN" 8279 "Fid_CoVehtrqLimErr_MIN" 8280 "Fid_CpBVlvOff_MIN" 8281 "Fid_CrCtlShutOffIr_MIN" 8282 "Fid_CrCtl_ASCTimeout_MIN" 8283 "Fid_CrCtl_CanDef_MIN" 8284 "Fid_CrCtl_KombiTimeout_MIN" 8285 "Fid_CrCtl_vCrCtl_MIN" 8286 "Fid_DSM_Wuc_MIN" 8287 "Fid_EATSCDTSubs_MIN" 8288 "Fid_EBAFCD_MIN" 8289 "Fid_EBFCD_MIN" 8290 "Fid_ECU_MIN" 8291 "Fid_EGSysCoLSU0_MIN" 8292 "Fid_EGSysCoNSC_MIN" 8293 "Fid_EGSysCoOxi_MIN" 8294 "Fid_EGSysCoTrbn_MIN" 8295 "Fid_EGSysCoTube0_MIN" 8296 "Fid_EGSysCoTube1_MIN" 8297 "Fid_EGSysHtgDel_MIN" 8298 "Fid_EGSysMaxTOxiPreB1_MIN" 8299 "Fid_EGSysMaxTOxiPreB2_MIN" 8300 "Fid_EGSysMaxTPreB1_MIN" 8301 "Fid_EGSysMaxTPreB2_MIN" 8302 "Fid_EGSysMaxTPreRgnB1_MIN" 8303 "Fid_EGSysMaxTPreRgnB2_MIN" 8304 "Fid_EGSysMxTOxiPreRgnB1_MIN" 8305 "Fid_EGSysMxTOxiPreRgnB2_MIN" 8306 "Fid_EGSysNSC_MIN" 8307 "Fid_EGSysOxiCat_MIN" 8308 "Fid_EGSysPresEnv_MIN" 8309 "Fid_EGSysStrt_MIN" 8310 "Fid_EGSysTemp_MIN" 8311 "Fid_EGSysTrbn_MIN" 8312 "Fid_EGSysTube_MIN" 8313 "Fid_EGSys_AP_MIN" 8314 "Fid_EGTRgnLck_MIN" 8315 "Fid_EGTTempGvnrAirCtl_MIN" 8316 "Fid_EGTTempGvnrInrB1_MIN" 8317 "Fid_EGTTempGvnrInrB2_MIN" 8318 "Fid_EGTTempGvnrOutrB1_MIN" 8319 "Fid_EGTTempGvnrOutrB2_MIN" 8320 "Fid_ETClbCorActv_MIN" 8321 "Fid_EngCTSCD_MIN" 8322 "Fid_EngMCaS1_MIN" 8323 "Fid_EngMCaSBackUp_MIN" 8324 "Fid_EngMCrS1_MIN" 8325 "Fid_EngMCrSBackUp_MIN" 8326 "Fid_EngMTEng_MIN" 8327 "Fid_EngMTrqFrcPDiff_MIN" 8328 "Fid_EngMVVeh_MIN" 8329 "Fid_EngM_ChkStrtSpd_MIN" 8330 "Fid_EngPrt_nLimErr_MIN" 8331 "Fid_FBC_MIN" 8332 "Fid_FBCMonI_MIN" 8333 "Fid_FMASwtOff1_MIN" 8334 "Fid_FMASwtOff2_MIN" 8335 "Fid_FMASwtOff3_MIN" 8336 "Fid_FMTC_AirCorr_MIN" 8337 "Fid_FMTC_PCRCorr_MIN" 8338 "Fid_FMTC_SOECorr_MIN" 8339 "Fid_FTSCDErr_MIN" 8340 "Fid_FanCtl_MIN" 8341 "Fid_FanGbxOil_MIN" 8342 "Fid_FlMngFullLdRglOff_MIN" 8343 "Fid_FlMngSmkDefect_MIN" 8344 "Fid_FlMngTPFltErr_MIN" 8345 "Fid_FlSysCTSSens_MIN" 8346 "Fid_FlSysDens_MIN" 8347 "Fid_FlSysFTSSens_MIN" 8348 "Fid_FrmMngAOHt_MIN" 8349 "Fid_FrmMngAPP_MIN" 8350 "Fid_FrmMngARS_MIN" 8351 "Fid_FrmMngAddLevl_MIN" 8352 "Fid_FrmMngBrk_MIN" 8353 "Fid_FrmMngBrkDef_MIN" 8354 "Fid_FrmMngCoEng_MIN" 8355 "Fid_FrmMngCoEng_St2_MIN" 8356 "Fid_FrmMngConvDef_MIN" 8357 "Fid_FrmMngEngOvrSpd_MIN" 8358 "Fid_FrmMngEngRpmTemp_MIN" 8359 "Fid_FrmMngEngSpd_MIN" 8360 "Fid_FrmMngInjDU1_MIN" 8361 "Fid_FrmMngInjDU2_MIN" 8362 "Fid_FrmMngInjVlv_MIN" 8363 "Fid_FrmMngOBDCtl_MIN" 8364 "Fid_FrmMngPFltDef_MIN" 8365 "Fid_FrmMngParkConsumer_MIN" 8366 "Fid_FrmMngPla_DSC_MIN" 8367 "Fid_FrmMngPla_EGS_MIN" 8368 "Fid_FrmMngPowerTrainCAN_MIN" 8369 "Fid_FrmMngPrvCan_MIN" 8370 "Fid_FrmMngPwrMngLIGovSt_MIN" 8371 "Fid_FrmMngRpmRduc_MIN" 8372 "Fid_FrmMngSIG_ARS_MIN" 8373 "Fid_FrmMngSIG_DSC_MIN" 8374 "Fid_FrmMngSig_EGS_MIN" 8375 "Fid_FrmMngTO_ARS_MIN" 8376 "Fid_FrmMngTO_DSC_MIN" 8377 "Fid_FrmMngTo_EGS_MIN" 8378 "Fid_FrmMngTrqGearbx_MIN" 8379 "Fid_FrmMngWaterVlv_MIN" 8380 "Fid_FrmMng_ST_TORQ_MIN" 8381 "Fid_FrmMng_stTrq_MIN" 8382 "Fid_FrmMngnSetpoint_MIN" 8383 "Fid_FrmMngpVal_MIN" 8384 "Fid_FrmMngtEng_MIN" 8385 "Fid_GearbxDrvAway_MIN" 8386 "Fid_GearbxDrvAwayInactv_MIN" 8387 "Fid_GearbxNmin_MIN" 8388 "Fid_GearbxPtCANErr_MIN" 8389 "Fid_GearbxSlip_MIN" 8390 "Fid_GearbxTrqLimErr_MIN" 8391 "Fid_Gearbx_GearDet_MIN" 8392 "Fid_Gearbx_TrqIntv_Err_MIN" 8393 "Fid_GlwCtl1_MIN" 8394 "Fid_GlwCtl2_MIN" 8395 "Fid_GlwCtl3_MIN" 8396 "Fid_HDC_MIN" 8397 "Fid_IATSCD_MIN" 8398 "Fid_IATSCD_tAir1_MIN" 8399 "Fid_IATSCD_tAir2_MIN" 8400 "Fid_IndSys1_MIN" 8401 "Fid_IndSys2_MIN" 8402 "Fid_InjCrvCoErr_MIN" 8403 "Fid_InjCrvCylOffs_MIN" 8404 "Fid_InjCtl_qLimErr_MIN" 8405 "Fid_InjVCDActrEnrgTemp_MIN" 8406 "Fid_InjVCDCls_MIN" 8407 "Fid_InjVCDTPUErr_MIN" 8408 "Fid_InjVlvActrTemp_MIN" 8409 "Fid_InjVlvInjLim_MIN" 8410 "Fid_InjVlvMon_MIN" 8411 "Fid_InjVlvNVC_MIN" 8412 "Fid_InjVlvSetUpVolt_MIN" 8413 "Fid_InjVlvWvCorOff_MIN" 8414 "Fid_LIGovSetpointDrvAwy_MIN" 8415 "Fid_LIGovUbr_MIN" 8416 "Fid_LSUCDMon0_MIN" 8417 "Fid_LSUCDO20_MIN" 8418 "Fid_LSUCDRi0_MIN" 8419 "Fid_LSUCDactiv0_MIN" 8420 "Fid_LSUCDlsu0_MIN" 8421 "Fid_LSUClbSched_MIN" 8422 "Fid_LSUCtl0_MIN" 8423 "Fid_LSUMonAllChecks_MIN" 8424 "Fid_LSUMonPlausChk_MIN" 8425 "Fid_Layer_FI_TANS_MIN" 8426 "Fid_Layer_FI_TUMG_MIN" 8427 "Fid_Layer_MANHYDR_MIN" 8428 "Fid_Layer_MANLUFT_MIN" 8429 "Fid_MSCDPrivCan_MIN" 8430 "Fid_MSMonNetMngPtCan_MIN" 8431 "Fid_MSMonPFlt1_MIN" 8432 "Fid_MSMonPFlt2_MIN" 8433 "Fid_MSMonPFlt3_MIN" 8434 "Fid_MSMonPFlt4_MIN" 8435 "Fid_MSMonStEGS_MIN" 8436 "Fid_MSMon_ARS_TO_MIN" 8437 "Fid_MSMon_CanDef_MIN" 8438 "Fid_MSMon_DSC_TO_MIN" 8439 "Fid_MSMon_EGS_TO_MIN" 8440 "Fid_MSMon_FrmMngPT_MIN" 8441 "Fid_MSMon_FrmMngPT2_MIN" 8442 "Fid_MSMon_trqOff_MIN" 8443 "Fid_MSidCD_ECU_MIN" 8444 "Fid_MSidCD_Pin_MIN" 8445 "Fid_MeUnCDCalcI_MIN" 8446 "Fid_Mil_MIN" 8447 "Fid_OTSCD_MIN" 8448 "Fid_OxiCat_pPreCat_MIN" 8449 "Fid_PCBSPFltDef_MIN" 8450 "Fid_PCR_MIN" 8451 "Fid_PCRBalGvnr_MIN" 8452 "Fid_PCRBalGvnrP40Corr_MIN" 8453 "Fid_PCRExtnLimActr_MIN" 8454 "Fid_PCRGvnrDvtNeg_MIN" 8455 "Fid_PCRGvnrDvtPos_MIN" 8456 "Fid_PCRLPGvnrDvtNeg_MIN" 8457 "Fid_PCRLPGvnrDvtPos_MIN" 8458 "Fid_PCRSurgeGvnr_MIN" 8459 "Fid_PCRSurgeLIGov_MIN" 8460 "Fid_PCR_LP_MIN" 8461 "Fid_PCR_LPMS_MIN" 8462 "Fid_PCR_MS_MIN" 8463 "Fid_PCR_SurgeDet_MIN" 8464 "Fid_PCVCDCalcI_MIN" 8465 "Fid_PFltAshCor_MIN" 8466 "Fid_PFltAshCorRgn_MIN" 8467 "Fid_PFltBrk_MIN" 8468 "Fid_PFltCharB1_MIN" 8469 "Fid_PFltCharB2_MIN" 8470 "Fid_PFltChngParB1_MIN" 8471 "Fid_PFltChngParB2_MIN" 8472 "Fid_PFltClth_MIN" 8473 "Fid_PFltDynChkB1_MIN" 8474 "Fid_PFltDynChkB2_MIN" 8475 "Fid_PFltEngPrtRgnMon_MIN" 8476 "Fid_PFltGearDet_MIN" 8477 "Fid_PFltHsLnChkB1_MIN" 8478 "Fid_PFltHsLnChkB2_MIN" 8479 "Fid_PFltLckRgnErr_MIN" 8480 "Fid_PFltLckRgnFuel_MIN" 8481 "Fid_PFltNumPFltErr_MIN" 8482 "Fid_PFltNumPFltErrLck_MIN" 8483 "Fid_PFltPlausPresB1_MIN" 8484 "Fid_PFltPlausPresB2_MIN" 8485 "Fid_PFltPlausTempB1_MIN" 8486 "Fid_PFltPlausTempB2_MIN" 8487 "Fid_PFltPresPlausProj_MIN" 8488 "Fid_PFltPresSensFrz_MIN" 8489 "Fid_PFltPresSensHsLnB1_MIN" 8490 "Fid_PFltPresSensHsLnB2_MIN" 8491 "Fid_PFltPresSensPreB1_MIN" 8492 "Fid_PFltPresSensPreB2_MIN" 8493 "Fid_PFltSRCPresB1_MIN" 8494 "Fid_PFltSRCPresB2_MIN" 8495 "Fid_PFltSRCTempB1_MIN" 8496 "Fid_PFltSRCTempB2_MIN" 8497 "Fid_PFltSimOnB1_MIN" 8498 "Fid_PFltSimOnB2_MIN" 8499 "Fid_PFltSpdVeh_MIN" 8500 "Fid_PFltSucB1_MIN" 8501 "Fid_PFltSucB2_MIN" 8502 "Fid_PFltTOxiPreDiffB1_MIN" 8503 "Fid_PFltTOxiPreDiffB2_MIN" 8504 "Fid_PFltTPreDiffB1_MIN" 8505 "Fid_PFltTPreDiffB2_MIN" 8506 "Fid_PFltTempAir_MIN" 8507 "Fid_PFltTempClnt_MIN" 8508 "Fid_PFltTempOxiPreB1_MIN" 8509 "Fid_PFltTempOxiPreB2_MIN" 8510 "Fid_PFltTempOxiPstB1_MIN" 8511 "Fid_PFltTempOxiPstB2_MIN" 8512 "Fid_PFltTempPreB1_MIN" 8513 "Fid_PFltTempPreB2_MIN" 8514 "Fid_PFltTempSensB1_MIN" 8515 "Fid_PFltTempSensB2_MIN" 8516 "Fid_PFltTempSensFrz_MIN" 8517 "Fid_PFltTwFlwTempDev_MIN" 8518 "Fid_PFltVltgBatt_MIN" 8519 "Fid_RailCDRPSErrChk_MIN" 8520 "Fid_RailCDSubstVal_MIN" 8521 "Fid_RailCD_PMonStrt_MIN" 8522 "Fid_RailCPCtlMeUnMode_MIN" 8523 "Fid_RailCPCtlPCVMode_MIN" 8524 "Fid_RailCtlMode_MIN" 8525 "Fid_RailMeUn0Blk_MIN" 8526 "Fid_RailMeUn0Rls_MIN" 8527 "Fid_RailMeUn1Blk_MIN" 8528 "Fid_RailMeUn1Rls_MIN" 8529 "Fid_RailMeUn2Blk_MIN" 8530 "Fid_RailMeUn2Rls_MIN" 8531 "Fid_RailMeUn3Blk_MIN" 8532 "Fid_RailMeUn3Rls_MIN" 8533 "Fid_RailMeUn4Blk_MIN" 8534 "Fid_RailMeUn4Rls_MIN" 8535 "Fid_RailMeUnCtlMode_MIN" 8536 "Fid_RailPCV0Blk_MIN" 8537 "Fid_RailPCV0Rls_MIN" 8538 "Fid_RailPCV1Blk_MIN" 8539 "Fid_RailPCV1Rls_MIN" 8540 "Fid_RailPCV2Blk_MIN" 8541 "Fid_RailPCV2Rls_MIN" 8542 "Fid_RailPCV3Blk_MIN" 8543 "Fid_RailPCV3Rls_MIN" 8544 "Fid_RailPCV4Blk_MIN" 8545 "Fid_RailPCV4Rls_MIN" 8546 "Fid_RailPCV5Blk_MIN" 8547 "Fid_RailPCV5Rls_MIN" 8548 "Fid_RailPCVCtlMode_MIN" 8549 "Fid_RailSetPointLim_MIN" 8550 "Fid_RailSetPointRed_MIN" 8551 "Fid_SignalsTstNLim_MIN" 8552 "Fid_StSysImmo_MIN" 8553 "Fid_StSysStrtTipGbxDat_MIN" 8554 "Fid_SysLamp_MIN" 8555 "Fid_T15CDCanError_MIN" 8556 "Fid_T50CDSig_MIN" 8557 "Fid_TVACD_AirMonOff_MIN" 8558 "Fid_ThrVlvMon_MIN" 8559 "Fid_VSACDDioInDia_MIN" 8560 "Fid_VSSCD_Tx_MIN" 8561 "Fid_VehDaDist_MIN" 8562 "Fid_ZFCClbActv_MIN" 8563 "Fid_ZFCCldCmbCham_MIN" 16385 "Fid_ACCIRevErr_SIG" 16386 "Fid_ACCRevErr_SIG" 16387 "Fid_ACC_AliveErr_SIG" 16388 "Fid_ACC_CanDef_SIG" 16389 "Fid_ACC_CsErr_SIG" 16390 "Fid_ACC_TiOutErr_SIG" 16391 "Fid_ACCtl_ACTrqErr_SIG" 16392 "Fid_ACCtl_CTSErr_SIG" 16393 "Fid_ACCtl_FanErr_SIG" 16394 "Fid_ACCtl_TGearbxErr_SIG" 16395 "Fid_ACCtl_VSSErr_SIG" 16396 "Fid_AFSCD_SIG" 16397 "Fid_AFSCD2_SIG" 16398 "Fid_AFSCD_AirPerCyl_SIG" 16399 "Fid_AFSCD_AirPerCyl2_SIG" 16400 "Fid_AFSCD_AirPerTime_SIG" 16401 "Fid_AFSCD_AirPerTime2_SIG" 16402 "Fid_AFSCD_BPSCDErr_SIG" 16403 "Fid_AFSCD_PlAirPerCylDifOff_SIG" 16404 "Fid_AFSCD_PlOffsDrft_SIG" 16405 "Fid_AFSCD_PlOffsDrft2_SIG" 16406 "Fid_AFSCD_PlSetyDrft_SIG" 16407 "Fid_AFSCD_PlSetyDrft2_SIG" 16408 "Fid_AFSCD_SRCCorrAirm_SIG" 16409 "Fid_AFSCD_SRCCorrAirm2_SIG" 16410 "Fid_AFSCD_SRCDcyc_SIG" 16411 "Fid_AFSCD_SRCDcyc2_SIG" 16412 "Fid_AFSCD_SRCRawAirm_SIG" 16413 "Fid_AFSCD_SRCRawAirm2_SIG" 16414 "Fid_AFSCD_SRCRefSig_SIG" 16415 "Fid_AFSCD_SRCRefSig2_SIG" 16416 "Fid_AFSCD_tAir1_SIG" 16417 "Fid_AFSCD_tAir2_SIG" 16418 "Fid_AOHt_AltErr_SIG" 16419 "Fid_AOHt_ShutOffErr_SIG" 16420 "Fid_APP1_SIG" 16421 "Fid_APP2_SIG" 16422 "Fid_APPKickdown_SIG" 16423 "Fid_APSCD_SIG" 16424 "Fid_ARSOff_SIG" 16425 "Fid_ASDdc_SIG" 16426 "Fid_ASModSwtOffEng_SIG" 16427 "Fid_ASModSwtOffIndVol_SIG" 16428 "Fid_AccPed_SIG" 16429 "Fid_AccPedBrkPres_SIG" 16430 "Fid_AccPedVel_SIG" 16431 "Fid_AccPed_Brk_SIG" 16432 "Fid_AirCtl_SIG" 16433 "Fid_AirCtlCorrAlt_SIG" 16434 "Fid_AirCtlDyn_SIG" 16435 "Fid_AirCtlNeg_SIG" 16436 "Fid_AirCtlNeg2_SIG" 16437 "Fid_AirCtlPFltEGRRed_SIG" 16438 "Fid_AirCtlPlateBreak_SIG" 16439 "Fid_AirCtlPlateBreakAct_SIG" 16440 "Fid_AirCtlPos_SIG" 16441 "Fid_AirCtlPos2_SIG" 16442 "Fid_AirCtl_Brk_SIG" 16443 "Fid_AirCtl_Gear_SIG" 16444 "Fid_BPSCDMon_SIG" 16445 "Fid_CTSCDFlTemp_SIG" 16446 "Fid_CTSCD_Plaus_SIG" 16447 "Fid_ClgDynTst_SIG" 16448 "Fid_CmbChb_SIG" 16449 "Fid_CoDT_GripDeb_SIG" 16450 "Fid_CoDT_Mon_SIG" 16451 "Fid_CoDT_TRQ_SIG" 16452 "Fid_CoEngIRevSys1_SIG" 16453 "Fid_CoEngIRevSys2_SIG" 16454 "Fid_CoEngIRevVeh_SIG" 16455 "Fid_CoEngPFltErr_SIG" 16456 "Fid_CoEngPFltOvldErr_SIG" 16457 "Fid_CoEngRevSys1_SIG" 16458 "Fid_CoEngRevSys2_SIG" 16459 "Fid_CoEngRevVeh_SIG" 16460 "Fid_CoEngShOffTst_SIG" 16461 "Fid_CoEngSoftShOffTV_SIG" 16462 "Fid_CoEng_ActrPrt_SIG" 16463 "Fid_CoEng_Nrml2Strt_SIG" 16464 "Fid_CoEng_PwrStgEnable_SIG" 16465 "Fid_CoEng_trqLimErr_SIG" 16466 "Fid_CoEng_trqLimErr1_SIG" 16467 "Fid_CoEng_trqLimErr2_SIG" 16468 "Fid_CoEng_trqLimErr3_SIG" 16469 "Fid_CoEng_trqLimErr4_SIG" 16470 "Fid_CoVM_StabDem_Err_SIG" 16471 "Fid_CoVehtrqLimErr_SIG" 16472 "Fid_CpBVlvOff_SIG" 16473 "Fid_CrCtlShutOffIr_SIG" 16474 "Fid_CrCtl_ASCTimeout_SIG" 16475 "Fid_CrCtl_CanDef_SIG" 16476 "Fid_CrCtl_KombiTimeout_SIG" 16477 "Fid_CrCtl_vCrCtl_SIG" 16478 "Fid_DSM_Wuc_SIG" 16479 "Fid_EATSCDTSubs_SIG" 16480 "Fid_EBAFCD_SIG" 16481 "Fid_EBFCD_SIG" 16482 "Fid_ECU_SIG" 16483 "Fid_EGSysCoLSU0_SIG" 16484 "Fid_EGSysCoNSC_SIG" 16485 "Fid_EGSysCoOxi_SIG" 16486 "Fid_EGSysCoTrbn_SIG" 16487 "Fid_EGSysCoTube0_SIG" 16488 "Fid_EGSysCoTube1_SIG" 16489 "Fid_EGSysHtgDel_SIG" 16490 "Fid_EGSysMaxTOxiPreB1_SIG" 16491 "Fid_EGSysMaxTOxiPreB2_SIG" 16492 "Fid_EGSysMaxTPreB1_SIG" 16493 "Fid_EGSysMaxTPreB2_SIG" 16494 "Fid_EGSysMaxTPreRgnB1_SIG" 16495 "Fid_EGSysMaxTPreRgnB2_SIG" 16496 "Fid_EGSysMxTOxiPreRgnB1_SIG" 16497 "Fid_EGSysMxTOxiPreRgnB2_SIG" 16498 "Fid_EGSysNSC_SIG" 16499 "Fid_EGSysOxiCat_SIG" 16500 "Fid_EGSysPresEnv_SIG" 16501 "Fid_EGSysStrt_SIG" 16502 "Fid_EGSysTemp_SIG" 16503 "Fid_EGSysTrbn_SIG" 16504 "Fid_EGSysTube_SIG" 16505 "Fid_EGSys_AP_SIG" 16506 "Fid_EGTRgnLck_SIG" 16507 "Fid_EGTTempGvnrAirCtl_SIG" 16508 "Fid_EGTTempGvnrInrB1_SIG" 16509 "Fid_EGTTempGvnrInrB2_SIG" 16510 "Fid_EGTTempGvnrOutrB1_SIG" 16511 "Fid_EGTTempGvnrOutrB2_SIG" 16512 "Fid_ETClbCorActv_SIG" 16513 "Fid_EngCTSCD_SIG" 16514 "Fid_EngMCaS1_SIG" 16515 "Fid_EngMCaSBackUp_SIG" 16516 "Fid_EngMCrS1_SIG" 16517 "Fid_EngMCrSBackUp_SIG" 16518 "Fid_EngMTEng_SIG" 16519 "Fid_EngMTrqFrcPDiff_SIG" 16520 "Fid_EngMVVeh_SIG" 16521 "Fid_EngM_ChkStrtSpd_SIG" 16522 "Fid_EngPrt_nLimErr_SIG" 16523 "Fid_FBC_SIG" 16524 "Fid_FBCMonI_SIG" 16525 "Fid_FMASwtOff1_SIG" 16526 "Fid_FMASwtOff2_SIG" 16527 "Fid_FMASwtOff3_SIG" 16528 "Fid_FMTC_AirCorr_SIG" 16529 "Fid_FMTC_PCRCorr_SIG" 16530 "Fid_FMTC_SOECorr_SIG" 16531 "Fid_FTSCDErr_SIG" 16532 "Fid_FanCtl_SIG" 16533 "Fid_FanGbxOil_SIG" 16534 "Fid_FlMngFullLdRglOff_SIG" 16535 "Fid_FlMngSmkDefect_SIG" 16536 "Fid_FlMngTPFltErr_SIG" 16537 "Fid_FlSysCTSSens_SIG" 16538 "Fid_FlSysDens_SIG" 16539 "Fid_FlSysFTSSens_SIG" 16540 "Fid_FrmMngAOHt_SIG" 16541 "Fid_FrmMngAPP_SIG" 16542 "Fid_FrmMngARS_SIG" 16543 "Fid_FrmMngAddLevl_SIG" 16544 "Fid_FrmMngBrk_SIG" 16545 "Fid_FrmMngBrkDef_SIG" 16546 "Fid_FrmMngCoEng_SIG" 16547 "Fid_FrmMngCoEng_St2_SIG" 16548 "Fid_FrmMngConvDef_SIG" 16549 "Fid_FrmMngEngOvrSpd_SIG" 16550 "Fid_FrmMngEngRpmTemp_SIG" 16551 "Fid_FrmMngEngSpd_SIG" 16552 "Fid_FrmMngInjDU1_SIG" 16553 "Fid_FrmMngInjDU2_SIG" 16554 "Fid_FrmMngInjVlv_SIG" 16555 "Fid_FrmMngOBDCtl_SIG" 16556 "Fid_FrmMngPFltDef_SIG" 16557 "Fid_FrmMngParkConsumer_SIG" 16558 "Fid_FrmMngPla_DSC_SIG" 16559 "Fid_FrmMngPla_EGS_SIG" 16560 "Fid_FrmMngPowerTrainCAN_SIG" 16561 "Fid_FrmMngPrvCan_SIG" 16562 "Fid_FrmMngPwrMngLIGovSt_SIG" 16563 "Fid_FrmMngRpmRduc_SIG" 16564 "Fid_FrmMngSIG_ARS_SIG" 16565 "Fid_FrmMngSIG_DSC_SIG" 16566 "Fid_FrmMngSig_EGS_SIG" 16567 "Fid_FrmMngTO_ARS_SIG" 16568 "Fid_FrmMngTO_DSC_SIG" 16569 "Fid_FrmMngTo_EGS_SIG" 16570 "Fid_FrmMngTrqGearbx_SIG" 16571 "Fid_FrmMngWaterVlv_SIG" 16572 "Fid_FrmMng_ST_TORQ_SIG" 16573 "Fid_FrmMng_stTrq_SIG" 16574 "Fid_FrmMngnSetpoint_SIG" 16575 "Fid_FrmMngpVal_SIG" 16576 "Fid_FrmMngtEng_SIG" 16577 "Fid_GearbxDrvAway_SIG" 16578 "Fid_GearbxDrvAwayInactv_SIG" 16579 "Fid_GearbxNmin_SIG" 16580 "Fid_GearbxPtCANErr_SIG" 16581 "Fid_GearbxSlip_SIG" 16582 "Fid_GearbxTrqLimErr_SIG" 16583 "Fid_Gearbx_GearDet_SIG" 16584 "Fid_Gearbx_TrqIntv_Err_SIG" 16585 "Fid_GlwCtl1_SIG" 16586 "Fid_GlwCtl2_SIG" 16587 "Fid_GlwCtl3_SIG" 16588 "Fid_HDC_SIG" 16589 "Fid_IATSCD_SIG" 16590 "Fid_IATSCD_tAir1_SIG" 16591 "Fid_IATSCD_tAir2_SIG" 16592 "Fid_IndSys1_SIG" 16593 "Fid_IndSys2_SIG" 16594 "Fid_InjCrvCoErr_SIG" 16595 "Fid_InjCrvCylOffs_SIG" 16596 "Fid_InjCtl_qLimErr_SIG" 16597 "Fid_InjVCDActrEnrgTemp_SIG" 16598 "Fid_InjVCDCls_SIG" 16599 "Fid_InjVCDTPUErr_SIG" 16600 "Fid_InjVlvActrTemp_SIG" 16601 "Fid_InjVlvInjLim_SIG" 16602 "Fid_InjVlvMon_SIG" 16603 "Fid_InjVlvNVC_SIG" 16604 "Fid_InjVlvSetUpVolt_SIG" 16605 "Fid_InjVlvWvCorOff_SIG" 16606 "Fid_LIGovSetpointDrvAwy_SIG" 16607 "Fid_LIGovUbr_SIG" 16608 "Fid_LSUCDMon0_SIG" 16609 "Fid_LSUCDO20_SIG" 16610 "Fid_LSUCDRi0_SIG" 16611 "Fid_LSUCDactiv0_SIG" 16612 "Fid_LSUCDlsu0_SIG" 16613 "Fid_LSUClbSched_SIG" 16614 "Fid_LSUCtl0_SIG" 16615 "Fid_LSUMonAllChecks_SIG" 16616 "Fid_LSUMonPlausChk_SIG" 16617 "Fid_Layer_FI_TANS_SIG" 16618 "Fid_Layer_FI_TUMG_SIG" 16619 "Fid_Layer_MANHYDR_SIG" 16620 "Fid_Layer_MANLUFT_SIG" 16621 "Fid_MSCDPrivCan_SIG" 16622 "Fid_MSMonNetMngPtCan_SIG" 16623 "Fid_MSMonPFlt1_SIG" 16624 "Fid_MSMonPFlt2_SIG" 16625 "Fid_MSMonPFlt3_SIG" 16626 "Fid_MSMonPFlt4_SIG" 16627 "Fid_MSMonStEGS_SIG" 16628 "Fid_MSMon_ARS_TO_SIG" 16629 "Fid_MSMon_CanDef_SIG" 16630 "Fid_MSMon_DSC_TO_SIG" 16631 "Fid_MSMon_EGS_TO_SIG" 16632 "Fid_MSMon_FrmMngPT_SIG" 16633 "Fid_MSMon_FrmMngPT2_SIG" 16634 "Fid_MSMon_trqOff_SIG" 16635 "Fid_MSidCD_ECU_SIG" 16636 "Fid_MSidCD_Pin_SIG" 16637 "Fid_MeUnCDCalcI_SIG" 16638 "Fid_Mil_SIG" 16639 "Fid_OTSCD_SIG" 16640 "Fid_OxiCat_pPreCat_SIG" 16641 "Fid_PCBSPFltDef_SIG" 16642 "Fid_PCR_SIG" 16643 "Fid_PCRBalGvnr_SIG" 16644 "Fid_PCRBalGvnrP40Corr_SIG" 16645 "Fid_PCRExtnLimActr_SIG" 16646 "Fid_PCRGvnrDvtNeg_SIG" 16647 "Fid_PCRGvnrDvtPos_SIG" 16648 "Fid_PCRLPGvnrDvtNeg_SIG" 16649 "Fid_PCRLPGvnrDvtPos_SIG" 16650 "Fid_PCRSurgeGvnr_SIG" 16651 "Fid_PCRSurgeLIGov_SIG" 16652 "Fid_PCR_LP_SIG" 16653 "Fid_PCR_LPMS_SIG" 16654 "Fid_PCR_MS_SIG" 16655 "Fid_PCR_SurgeDet_SIG" 16656 "Fid_PCVCDCalcI_SIG" 16657 "Fid_PFltAshCor_SIG" 16658 "Fid_PFltAshCorRgn_SIG" 16659 "Fid_PFltBrk_SIG" 16660 "Fid_PFltCharB1_SIG" 16661 "Fid_PFltCharB2_SIG" 16662 "Fid_PFltChngParB1_SIG" 16663 "Fid_PFltChngParB2_SIG" 16664 "Fid_PFltClth_SIG" 16665 "Fid_PFltDynChkB1_SIG" 16666 "Fid_PFltDynChkB2_SIG" 16667 "Fid_PFltEngPrtRgnMon_SIG" 16668 "Fid_PFltGearDet_SIG" 16669 "Fid_PFltHsLnChkB1_SIG" 16670 "Fid_PFltHsLnChkB2_SIG" 16671 "Fid_PFltLckRgnErr_SIG" 16672 "Fid_PFltLckRgnFuel_SIG" 16673 "Fid_PFltNumPFltErr_SIG" 16674 "Fid_PFltNumPFltErrLck_SIG" 16675 "Fid_PFltPlausPresB1_SIG" 16676 "Fid_PFltPlausPresB2_SIG" 16677 "Fid_PFltPlausTempB1_SIG" 16678 "Fid_PFltPlausTempB2_SIG" 16679 "Fid_PFltPresPlausProj_SIG" 16680 "Fid_PFltPresSensFrz_SIG" 16681 "Fid_PFltPresSensHsLnB1_SIG" 16682 "Fid_PFltPresSensHsLnB2_SIG" 16683 "Fid_PFltPresSensPreB1_SIG" 16684 "Fid_PFltPresSensPreB2_SIG" 16685 "Fid_PFltSRCPresB1_SIG" 16686 "Fid_PFltSRCPresB2_SIG" 16687 "Fid_PFltSRCTempB1_SIG" 16688 "Fid_PFltSRCTempB2_SIG" 16689 "Fid_PFltSimOnB1_SIG" 16690 "Fid_PFltSimOnB2_SIG" 16691 "Fid_PFltSpdVeh_SIG" 16692 "Fid_PFltSucB1_SIG" 16693 "Fid_PFltSucB2_SIG" 16694 "Fid_PFltTOxiPreDiffB1_SIG" 16695 "Fid_PFltTOxiPreDiffB2_SIG" 16696 "Fid_PFltTPreDiffB1_SIG" 16697 "Fid_PFltTPreDiffB2_SIG" 16698 "Fid_PFltTempAir_SIG" 16699 "Fid_PFltTempClnt_SIG" 16700 "Fid_PFltTempOxiPreB1_SIG" 16701 "Fid_PFltTempOxiPreB2_SIG" 16702 "Fid_PFltTempOxiPstB1_SIG" 16703 "Fid_PFltTempOxiPstB2_SIG" 16704 "Fid_PFltTempPreB1_SIG" 16705 "Fid_PFltTempPreB2_SIG" 16706 "Fid_PFltTempSensB1_SIG" 16707 "Fid_PFltTempSensB2_SIG" 16708 "Fid_PFltTempSensFrz_SIG" 16709 "Fid_PFltTwFlwTempDev_SIG" 16710 "Fid_PFltVltgBatt_SIG" 16711 "Fid_RailCDRPSErrChk_SIG" 16712 "Fid_RailCDSubstVal_SIG" 16713 "Fid_RailCD_PMonStrt_SIG" 16714 "Fid_RailCPCtlMeUnMode_SIG" 16715 "Fid_RailCPCtlPCVMode_SIG" 16716 "Fid_RailCtlMode_SIG" 16717 "Fid_RailMeUn0Blk_SIG" 16718 "Fid_RailMeUn0Rls_SIG" 16719 "Fid_RailMeUn1Blk_SIG" 16720 "Fid_RailMeUn1Rls_SIG" 16721 "Fid_RailMeUn2Blk_SIG" 16722 "Fid_RailMeUn2Rls_SIG" 16723 "Fid_RailMeUn3Blk_SIG" 16724 "Fid_RailMeUn3Rls_SIG" 16725 "Fid_RailMeUn4Blk_SIG" 16726 "Fid_RailMeUn4Rls_SIG" 16727 "Fid_RailMeUnCtlMode_SIG" 16728 "Fid_RailPCV0Blk_SIG" 16729 "Fid_RailPCV0Rls_SIG" 16730 "Fid_RailPCV1Blk_SIG" 16731 "Fid_RailPCV1Rls_SIG" 16732 "Fid_RailPCV2Blk_SIG" 16733 "Fid_RailPCV2Rls_SIG" 16734 "Fid_RailPCV3Blk_SIG" 16735 "Fid_RailPCV3Rls_SIG" 16736 "Fid_RailPCV4Blk_SIG" 16737 "Fid_RailPCV4Rls_SIG" 16738 "Fid_RailPCV5Blk_SIG" 16739 "Fid_RailPCV5Rls_SIG" 16740 "Fid_RailPCVCtlMode_SIG" 16741 "Fid_RailSetPointLim_SIG" 16742 "Fid_RailSetPointRed_SIG" 16743 "Fid_SignalsTstNLim_SIG" 16744 "Fid_StSysImmo_SIG" 16745 "Fid_StSysStrtTipGbxDat_SIG" 16746 "Fid_SysLamp_SIG" 16747 "Fid_T15CDCanError_SIG" 16748 "Fid_T50CDSig_SIG" 16749 "Fid_TVACD_AirMonOff_SIG" 16750 "Fid_ThrVlvMon_SIG" 16751 "Fid_VSACDDioInDia_SIG" 16752 "Fid_VSSCD_Tx_SIG" 16753 "Fid_VehDaDist_SIG" 16754 "Fid_ZFCClbActv_SIG" 16755 "Fid_ZFCCldCmbCham_SIG" 32769 "Fid_ACCIRevErr_NPL" 32770 "Fid_ACCRevErr_NPL" 32771 "Fid_ACC_AliveErr_NPL" 32772 "Fid_ACC_CanDef_NPL" 32773 "Fid_ACC_CsErr_NPL" 32774 "Fid_ACC_TiOutErr_NPL" 32775 "Fid_ACCtl_ACTrqErr_NPL" 32776 "Fid_ACCtl_CTSErr_NPL" 32777 "Fid_ACCtl_FanErr_NPL" 32778 "Fid_ACCtl_TGearbxErr_NPL" 32779 "Fid_ACCtl_VSSErr_NPL" 32780 "Fid_AFSCD_NPL" 32781 "Fid_AFSCD2_NPL" 32782 "Fid_AFSCD_AirPerCyl_NPL" 32783 "Fid_AFSCD_AirPerCyl2_NPL" 32784 "Fid_AFSCD_AirPerTime_NPL" 32785 "Fid_AFSCD_AirPerTime2_NPL" 32786 "Fid_AFSCD_BPSCDErr_NPL" 32787 "Fid_AFSCD_PlAirPerCylDifOff_NPL" 32788 "Fid_AFSCD_PlOffsDrft_NPL" 32789 "Fid_AFSCD_PlOffsDrft2_NPL" 32790 "Fid_AFSCD_PlSetyDrft_NPL" 32791 "Fid_AFSCD_PlSetyDrft2_NPL" 32792 "Fid_AFSCD_SRCCorrAirm_NPL" 32793 "Fid_AFSCD_SRCCorrAirm2_NPL" 32794 "Fid_AFSCD_SRCDcyc_NPL" 32795 "Fid_AFSCD_SRCDcyc2_NPL" 32796 "Fid_AFSCD_SRCRawAirm_NPL" 32797 "Fid_AFSCD_SRCRawAirm2_NPL" 32798 "Fid_AFSCD_SRCRefSig_NPL" 32799 "Fid_AFSCD_SRCRefSig2_NPL" 32800 "Fid_AFSCD_tAir1_NPL" 32801 "Fid_AFSCD_tAir2_NPL" 32802 "Fid_AOHt_AltErr_NPL" 32803 "Fid_AOHt_ShutOffErr_NPL" 32804 "Fid_APP1_NPL" 32805 "Fid_APP2_NPL" 32806 "Fid_APPKickdown_NPL" 32807 "Fid_APSCD_NPL" 32808 "Fid_ARSOff_NPL" 32809 "Fid_ASDdc_NPL" 32810 "Fid_ASModSwtOffEng_NPL" 32811 "Fid_ASModSwtOffIndVol_NPL" 32812 "Fid_AccPed_NPL" 32813 "Fid_AccPedBrkPres_NPL" 32814 "Fid_AccPedVel_NPL" 32815 "Fid_AccPed_Brk_NPL" 32816 "Fid_AirCtl_NPL" 32817 "Fid_AirCtlCorrAlt_NPL" 32818 "Fid_AirCtlDyn_NPL" 32819 "Fid_AirCtlNeg_NPL" 32820 "Fid_AirCtlNeg2_NPL" 32821 "Fid_AirCtlPFltEGRRed_NPL" 32822 "Fid_AirCtlPlateBreak_NPL" 32823 "Fid_AirCtlPlateBreakAct_NPL" 32824 "Fid_AirCtlPos_NPL" 32825 "Fid_AirCtlPos2_NPL" 32826 "Fid_AirCtl_Brk_NPL" 32827 "Fid_AirCtl_Gear_NPL" 32828 "Fid_BPSCDMon_NPL" 32829 "Fid_CTSCDFlTemp_NPL" 32830 "Fid_CTSCD_Plaus_NPL" 32831 "Fid_ClgDynTst_NPL" 32832 "Fid_CmbChb_NPL" 32833 "Fid_CoDT_GripDeb_NPL" 32834 "Fid_CoDT_Mon_NPL" 32835 "Fid_CoDT_TRQ_NPL" 32836 "Fid_CoEngIRevSys1_NPL" 32837 "Fid_CoEngIRevSys2_NPL" 32838 "Fid_CoEngIRevVeh_NPL" 32839 "Fid_CoEngPFltErr_NPL" 32840 "Fid_CoEngPFltOvldErr_NPL" 32841 "Fid_CoEngRevSys1_NPL" 32842 "Fid_CoEngRevSys2_NPL" 32843 "Fid_CoEngRevVeh_NPL" 32844 "Fid_CoEngShOffTst_NPL" 32845 "Fid_CoEngSoftShOffTV_NPL" 32846 "Fid_CoEng_ActrPrt_NPL" 32847 "Fid_CoEng_Nrml2Strt_NPL" 32848 "Fid_CoEng_PwrStgEnable_NPL" 32849 "Fid_CoEng_trqLimErr_NPL" 32850 "Fid_CoEng_trqLimErr1_NPL" 32851 "Fid_CoEng_trqLimErr2_NPL" 32852 "Fid_CoEng_trqLimErr3_NPL" 32853 "Fid_CoEng_trqLimErr4_NPL" 32854 "Fid_CoVM_StabDem_Err_NPL" 32855 "Fid_CoVehtrqLimErr_NPL" 32856 "Fid_CpBVlvOff_NPL" 32857 "Fid_CrCtlShutOffIr_NPL" 32858 "Fid_CrCtl_ASCTimeout_NPL" 32859 "Fid_CrCtl_CanDef_NPL" 32860 "Fid_CrCtl_KombiTimeout_NPL" 32861 "Fid_CrCtl_vCrCtl_NPL" 32862 "Fid_DSM_Wuc_NPL" 32863 "Fid_EATSCDTSubs_NPL" 32864 "Fid_EBAFCD_NPL" 32865 "Fid_EBFCD_NPL" 32866 "Fid_ECU_NPL" 32867 "Fid_EGSysCoLSU0_NPL" 32868 "Fid_EGSysCoNSC_NPL" 32869 "Fid_EGSysCoOxi_NPL" 32870 "Fid_EGSysCoTrbn_NPL" 32871 "Fid_EGSysCoTube0_NPL" 32872 "Fid_EGSysCoTube1_NPL" 32873 "Fid_EGSysHtgDel_NPL" 32874 "Fid_EGSysMaxTOxiPreB1_NPL" 32875 "Fid_EGSysMaxTOxiPreB2_NPL" 32876 "Fid_EGSysMaxTPreB1_NPL" 32877 "Fid_EGSysMaxTPreB2_NPL" 32878 "Fid_EGSysMaxTPreRgnB1_NPL" 32879 "Fid_EGSysMaxTPreRgnB2_NPL" 32880 "Fid_EGSysMxTOxiPreRgnB1_NPL" 32881 "Fid_EGSysMxTOxiPreRgnB2_NPL" 32882 "Fid_EGSysNSC_NPL" 32883 "Fid_EGSysOxiCat_NPL" 32884 "Fid_EGSysPresEnv_NPL" 32885 "Fid_EGSysStrt_NPL" 32886 "Fid_EGSysTemp_NPL" 32887 "Fid_EGSysTrbn_NPL" 32888 "Fid_EGSysTube_NPL" 32889 "Fid_EGSys_AP_NPL" 32890 "Fid_EGTRgnLck_NPL" 32891 "Fid_EGTTempGvnrAirCtl_NPL" 32892 "Fid_EGTTempGvnrInrB1_NPL" 32893 "Fid_EGTTempGvnrInrB2_NPL" 32894 "Fid_EGTTempGvnrOutrB1_NPL" 32895 "Fid_EGTTempGvnrOutrB2_NPL" 32896 "Fid_ETClbCorActv_NPL" 32897 "Fid_EngCTSCD_NPL" 32898 "Fid_EngMCaS1_NPL" 32899 "Fid_EngMCaSBackUp_NPL" 32900 "Fid_EngMCrS1_NPL" 32901 "Fid_EngMCrSBackUp_NPL" 32902 "Fid_EngMTEng_NPL" 32903 "Fid_EngMTrqFrcPDiff_NPL" 32904 "Fid_EngMVVeh_NPL" 32905 "Fid_EngM_ChkStrtSpd_NPL" 32906 "Fid_EngPrt_nLimErr_NPL" 32907 "Fid_FBC_NPL" 32908 "Fid_FBCMonI_NPL" 32909 "Fid_FMASwtOff1_NPL" 32910 "Fid_FMASwtOff2_NPL" 32911 "Fid_FMASwtOff3_NPL" 32912 "Fid_FMTC_AirCorr_NPL" 32913 "Fid_FMTC_PCRCorr_NPL" 32914 "Fid_FMTC_SOECorr_NPL" 32915 "Fid_FTSCDErr_NPL" 32916 "Fid_FanCtl_NPL" 32917 "Fid_FanGbxOil_NPL" 32918 "Fid_FlMngFullLdRglOff_NPL" 32919 "Fid_FlMngSmkDefect_NPL" 32920 "Fid_FlMngTPFltErr_NPL" 32921 "Fid_FlSysCTSSens_NPL" 32922 "Fid_FlSysDens_NPL" 32923 "Fid_FlSysFTSSens_NPL" 32924 "Fid_FrmMngAOHt_NPL" 32925 "Fid_FrmMngAPP_NPL" 32926 "Fid_FrmMngARS_NPL" 32927 "Fid_FrmMngAddLevl_NPL" 32928 "Fid_FrmMngBrk_NPL" 32929 "Fid_FrmMngBrkDef_NPL" 32930 "Fid_FrmMngCoEng_NPL" 32931 "Fid_FrmMngCoEng_St2_NPL" 32932 "Fid_FrmMngConvDef_NPL" 32933 "Fid_FrmMngEngOvrSpd_NPL" 32934 "Fid_FrmMngEngRpmTemp_NPL" 32935 "Fid_FrmMngEngSpd_NPL" 32936 "Fid_FrmMngInjDU1_NPL" 32937 "Fid_FrmMngInjDU2_NPL" 32938 "Fid_FrmMngInjVlv_NPL" 32939 "Fid_FrmMngOBDCtl_NPL" 32940 "Fid_FrmMngPFltDef_NPL" 32941 "Fid_FrmMngParkConsumer_NPL" 32942 "Fid_FrmMngPla_DSC_NPL" 32943 "Fid_FrmMngPla_EGS_NPL" 32944 "Fid_FrmMngPowerTrainCAN_NPL" 32945 "Fid_FrmMngPrvCan_NPL" 32946 "Fid_FrmMngPwrMngLIGovSt_NPL" 32947 "Fid_FrmMngRpmRduc_NPL" 32948 "Fid_FrmMngSIG_ARS_NPL" 32949 "Fid_FrmMngSIG_DSC_NPL" 32950 "Fid_FrmMngSig_EGS_NPL" 32951 "Fid_FrmMngTO_ARS_NPL" 32952 "Fid_FrmMngTO_DSC_NPL" 32953 "Fid_FrmMngTo_EGS_NPL" 32954 "Fid_FrmMngTrqGearbx_NPL" 32955 "Fid_FrmMngWaterVlv_NPL" 32956 "Fid_FrmMng_ST_TORQ_NPL" 32957 "Fid_FrmMng_stTrq_NPL" 32958 "Fid_FrmMngnSetpoint_NPL" 32959 "Fid_FrmMngpVal_NPL" 32960 "Fid_FrmMngtEng_NPL" 32961 "Fid_GearbxDrvAway_NPL" 32962 "Fid_GearbxDrvAwayInactv_NPL" 32963 "Fid_GearbxNmin_NPL" 32964 "Fid_GearbxPtCANErr_NPL" 32965 "Fid_GearbxSlip_NPL" 32966 "Fid_GearbxTrqLimErr_NPL" 32967 "Fid_Gearbx_GearDet_NPL" 32968 "Fid_Gearbx_TrqIntv_Err_NPL" 32969 "Fid_GlwCtl1_NPL" 32970 "Fid_GlwCtl2_NPL" 32971 "Fid_GlwCtl3_NPL" 32972 "Fid_HDC_NPL" 32973 "Fid_IATSCD_NPL" 32974 "Fid_IATSCD_tAir1_NPL" 32975 "Fid_IATSCD_tAir2_NPL" 32976 "Fid_IndSys1_NPL" 32977 "Fid_IndSys2_NPL" 32978 "Fid_InjCrvCoErr_NPL" 32979 "Fid_InjCrvCylOffs_NPL" 32980 "Fid_InjCtl_qLimErr_NPL" 32981 "Fid_InjVCDActrEnrgTemp_NPL" 32982 "Fid_InjVCDCls_NPL" 32983 "Fid_InjVCDTPUErr_NPL" 32984 "Fid_InjVlvActrTemp_NPL" 32985 "Fid_InjVlvInjLim_NPL" 32986 "Fid_InjVlvMon_NPL" 32987 "Fid_InjVlvNVC_NPL" 32988 "Fid_InjVlvSetUpVolt_NPL" 32989 "Fid_InjVlvWvCorOff_NPL" 32990 "Fid_LIGovSetpointDrvAwy_NPL" 32991 "Fid_LIGovUbr_NPL" 32992 "Fid_LSUCDMon0_NPL" 32993 "Fid_LSUCDO20_NPL" 32994 "Fid_LSUCDRi0_NPL" 32995 "Fid_LSUCDactiv0_NPL" 32996 "Fid_LSUCDlsu0_NPL" 32997 "Fid_LSUClbSched_NPL" 32998 "Fid_LSUCtl0_NPL" 32999 "Fid_LSUMonAllChecks_NPL" 33000 "Fid_LSUMonPlausChk_NPL" 33001 "Fid_Layer_FI_TANS_NPL" 33002 "Fid_Layer_FI_TUMG_NPL" 33003 "Fid_Layer_MANHYDR_NPL" 33004 "Fid_Layer_MANLUFT_NPL" 33005 "Fid_MSCDPrivCan_NPL" 33006 "Fid_MSMonNetMngPtCan_NPL" 33007 "Fid_MSMonPFlt1_NPL" 33008 "Fid_MSMonPFlt2_NPL" 33009 "Fid_MSMonPFlt3_NPL" 33010 "Fid_MSMonPFlt4_NPL" 33011 "Fid_MSMonStEGS_NPL" 33012 "Fid_MSMon_ARS_TO_NPL" 33013 "Fid_MSMon_CanDef_NPL" 33014 "Fid_MSMon_DSC_TO_NPL" 33015 "Fid_MSMon_EGS_TO_NPL" 33016 "Fid_MSMon_FrmMngPT_NPL" 33017 "Fid_MSMon_FrmMngPT2_NPL" 33018 "Fid_MSMon_trqOff_NPL" 33019 "Fid_MSidCD_ECU_NPL" 33020 "Fid_MSidCD_Pin_NPL" 33021 "Fid_MeUnCDCalcI_NPL" 33022 "Fid_Mil_NPL" 33023 "Fid_OTSCD_NPL" 33024 "Fid_OxiCat_pPreCat_NPL" 33025 "Fid_PCBSPFltDef_NPL" 33026 "Fid_PCR_NPL" 33027 "Fid_PCRBalGvnr_NPL" 33028 "Fid_PCRBalGvnrP40Corr_NPL" 33029 "Fid_PCRExtnLimActr_NPL" 33030 "Fid_PCRGvnrDvtNeg_NPL" 33031 "Fid_PCRGvnrDvtPos_NPL" 33032 "Fid_PCRLPGvnrDvtNeg_NPL" 33033 "Fid_PCRLPGvnrDvtPos_NPL" 33034 "Fid_PCRSurgeGvnr_NPL" 33035 "Fid_PCRSurgeLIGov_NPL" 33036 "Fid_PCR_LP_NPL" 33037 "Fid_PCR_LPMS_NPL" 33038 "Fid_PCR_MS_NPL" 33039 "Fid_PCR_SurgeDet_NPL" 33040 "Fid_PCVCDCalcI_NPL" 33041 "Fid_PFltAshCor_NPL" 33042 "Fid_PFltAshCorRgn_NPL" 33043 "Fid_PFltBrk_NPL" 33044 "Fid_PFltCharB1_NPL" 33045 "Fid_PFltCharB2_NPL" 33046 "Fid_PFltChngParB1_NPL" 33047 "Fid_PFltChngParB2_NPL" 33048 "Fid_PFltClth_NPL" 33049 "Fid_PFltDynChkB1_NPL" 33050 "Fid_PFltDynChkB2_NPL" 33051 "Fid_PFltEngPrtRgnMon_NPL" 33052 "Fid_PFltGearDet_NPL" 33053 "Fid_PFltHsLnChkB1_NPL" 33054 "Fid_PFltHsLnChkB2_NPL" 33055 "Fid_PFltLckRgnErr_NPL" 33056 "Fid_PFltLckRgnFuel_NPL" 33057 "Fid_PFltNumPFltErr_NPL" 33058 "Fid_PFltNumPFltErrLck_NPL" 33059 "Fid_PFltPlausPresB1_NPL" 33060 "Fid_PFltPlausPresB2_NPL" 33061 "Fid_PFltPlausTempB1_NPL" 33062 "Fid_PFltPlausTempB2_NPL" 33063 "Fid_PFltPresPlausProj_NPL" 33064 "Fid_PFltPresSensFrz_NPL" 33065 "Fid_PFltPresSensHsLnB1_NPL" 33066 "Fid_PFltPresSensHsLnB2_NPL" 33067 "Fid_PFltPresSensPreB1_NPL" 33068 "Fid_PFltPresSensPreB2_NPL" 33069 "Fid_PFltSRCPresB1_NPL" 33070 "Fid_PFltSRCPresB2_NPL" 33071 "Fid_PFltSRCTempB1_NPL" 33072 "Fid_PFltSRCTempB2_NPL" 33073 "Fid_PFltSimOnB1_NPL" 33074 "Fid_PFltSimOnB2_NPL" 33075 "Fid_PFltSpdVeh_NPL" 33076 "Fid_PFltSucB1_NPL" 33077 "Fid_PFltSucB2_NPL" 33078 "Fid_PFltTOxiPreDiffB1_NPL" 33079 "Fid_PFltTOxiPreDiffB2_NPL" 33080 "Fid_PFltTPreDiffB1_NPL" 33081 "Fid_PFltTPreDiffB2_NPL" 33082 "Fid_PFltTempAir_NPL" 33083 "Fid_PFltTempClnt_NPL" 33084 "Fid_PFltTempOxiPreB1_NPL" 33085 "Fid_PFltTempOxiPreB2_NPL" 33086 "Fid_PFltTempOxiPstB1_NPL" 33087 "Fid_PFltTempOxiPstB2_NPL" 33088 "Fid_PFltTempPreB1_NPL" 33089 "Fid_PFltTempPreB2_NPL" 33090 "Fid_PFltTempSensB1_NPL" 33091 "Fid_PFltTempSensB2_NPL" 33092 "Fid_PFltTempSensFrz_NPL" 33093 "Fid_PFltTwFlwTempDev_NPL" 33094 "Fid_PFltVltgBatt_NPL" 33095 "Fid_RailCDRPSErrChk_NPL" 33096 "Fid_RailCDSubstVal_NPL" 33097 "Fid_RailCD_PMonStrt_NPL" 33098 "Fid_RailCPCtlMeUnMode_NPL" 33099 "Fid_RailCPCtlPCVMode_NPL" 33100 "Fid_RailCtlMode_NPL" 33101 "Fid_RailMeUn0Blk_NPL" 33102 "Fid_RailMeUn0Rls_NPL" 33103 "Fid_RailMeUn1Blk_NPL" 33104 "Fid_RailMeUn1Rls_NPL" 33105 "Fid_RailMeUn2Blk_NPL" 33106 "Fid_RailMeUn2Rls_NPL" 33107 "Fid_RailMeUn3Blk_NPL" 33108 "Fid_RailMeUn3Rls_NPL" 33109 "Fid_RailMeUn4Blk_NPL" 33110 "Fid_RailMeUn4Rls_NPL" 33111 "Fid_RailMeUnCtlMode_NPL" 33112 "Fid_RailPCV0Blk_NPL" 33113 "Fid_RailPCV0Rls_NPL" 33114 "Fid_RailPCV1Blk_NPL" 33115 "Fid_RailPCV1Rls_NPL" 33116 "Fid_RailPCV2Blk_NPL" 33117 "Fid_RailPCV2Rls_NPL" 33118 "Fid_RailPCV3Blk_NPL" 33119 "Fid_RailPCV3Rls_NPL" 33120 "Fid_RailPCV4Blk_NPL" 33121 "Fid_RailPCV4Rls_NPL" 33122 "Fid_RailPCV5Blk_NPL" 33123 "Fid_RailPCV5Rls_NPL" 33124 "Fid_RailPCVCtlMode_NPL" 33125 "Fid_RailSetPointLim_NPL" 33126 "Fid_RailSetPointRed_NPL" 33127 "Fid_SignalsTstNLim_NPL" 33128 "Fid_StSysImmo_NPL" 33129 "Fid_StSysStrtTipGbxDat_NPL" 33130 "Fid_SysLamp_NPL" 33131 "Fid_T15CDCanError_NPL" 33132 "Fid_T50CDSig_NPL" 33133 "Fid_TVACD_AirMonOff_NPL" 33134 "Fid_ThrVlvMon_NPL" 33135 "Fid_VSACDDioInDia_NPL" 33136 "Fid_VSSCD_Tx_NPL" 33137 "Fid_VehDaDist_NPL" 33138 "Fid_ZFCClbActv_NPL" 33139 "Fid_ZFCCldCmbCham_NPL" 61441 "Fid_ACCIRevErr" 61442 "Fid_ACCRevErr" 61443 "Fid_ACC_AliveErr" 61444 "Fid_ACC_CanDef" 61445 "Fid_ACC_CsErr" 61446 "Fid_ACC_TiOutErr" 61447 "Fid_ACCtl_ACTrqErr" 61448 "Fid_ACCtl_CTSErr" 61449 "Fid_ACCtl_FanErr" 61450 "Fid_ACCtl_TGearbxErr" 61451 "Fid_ACCtl_VSSErr" 61452 "Fid_AFSCD" 61453 "Fid_AFSCD2" 61454 "Fid_AFSCD_AirPerCyl" 61455 "Fid_AFSCD_AirPerCyl2" 61456 "Fid_AFSCD_AirPerTime" 61457 "Fid_AFSCD_AirPerTime2" 61458 "Fid_AFSCD_BPSCDErr" 61459 "Fid_AFSCD_PlAirPerCylDifOff" 61460 "Fid_AFSCD_PlOffsDrft" 61461 "Fid_AFSCD_PlOffsDrft2" 61462 "Fid_AFSCD_PlSetyDrft" 61463 "Fid_AFSCD_PlSetyDrft2" 61464 "Fid_AFSCD_SRCCorrAirm" 61465 "Fid_AFSCD_SRCCorrAirm2" 61466 "Fid_AFSCD_SRCDcyc" 61467 "Fid_AFSCD_SRCDcyc2" 61468 "Fid_AFSCD_SRCRawAirm" 61469 "Fid_AFSCD_SRCRawAirm2" 61470 "Fid_AFSCD_SRCRefSig" 61471 "Fid_AFSCD_SRCRefSig2" 61472 "Fid_AFSCD_tAir1" 61473 "Fid_AFSCD_tAir2" 61474 "Fid_AOHt_AltErr" 61475 "Fid_AOHt_ShutOffErr" 61476 "Fid_APP1" 61477 "Fid_APP2" 61478 "Fid_APPKickdown" 61479 "Fid_APSCD" 61480 "Fid_ARSOff" 61481 "Fid_ASDdc" 61482 "Fid_ASModSwtOffEng" 61483 "Fid_ASModSwtOffIndVol" 61484 "Fid_AccPed" 61485 "Fid_AccPedBrkPres" 61486 "Fid_AccPedVel" 61487 "Fid_AccPed_Brk" 61488 "Fid_AirCtl" 61489 "Fid_AirCtlCorrAlt" 61490 "Fid_AirCtlDyn" 61491 "Fid_AirCtlNeg" 61492 "Fid_AirCtlNeg2" 61493 "Fid_AirCtlPFltEGRRed" 61494 "Fid_AirCtlPlateBreak" 61495 "Fid_AirCtlPlateBreakAct" 61496 "Fid_AirCtlPos" 61497 "Fid_AirCtlPos2" 61498 "Fid_AirCtl_Brk" 61499 "Fid_AirCtl_Gear" 61500 "Fid_BPSCDMon" 61501 "Fid_CTSCDFlTemp" 61502 "Fid_CTSCD_Plaus" 61503 "Fid_ClgDynTst" 61504 "Fid_CmbChb" 61505 "Fid_CoDT_GripDeb" 61506 "Fid_CoDT_Mon" 61507 "Fid_CoDT_TRQ" 61508 "Fid_CoEngIRevSys1" 61509 "Fid_CoEngIRevSys2" 61510 "Fid_CoEngIRevVeh" 61511 "Fid_CoEngPFltErr" 61512 "Fid_CoEngPFltOvldErr" 61513 "Fid_CoEngRevSys1" 61514 "Fid_CoEngRevSys2" 61515 "Fid_CoEngRevVeh" 61516 "Fid_CoEngShOffTst" 61517 "Fid_CoEngSoftShOffTV" 61518 "Fid_CoEng_ActrPrt" 61519 "Fid_CoEng_Nrml2Strt" 61520 "Fid_CoEng_PwrStgEnable" 61521 "Fid_CoEng_trqLimErr" 61522 "Fid_CoEng_trqLimErr1" 61523 "Fid_CoEng_trqLimErr2" 61524 "Fid_CoEng_trqLimErr3" 61525 "Fid_CoEng_trqLimErr4" 61526 "Fid_CoVM_StabDem_Err" 61527 "Fid_CoVehtrqLimErr" 61528 "Fid_CpBVlvOff" 61529 "Fid_CrCtlShutOffIr" 61530 "Fid_CrCtl_ASCTimeout" 61531 "Fid_CrCtl_CanDef" 61532 "Fid_CrCtl_KombiTimeout" 61533 "Fid_CrCtl_vCrCtl" 61534 "Fid_DSM_Wuc" 61535 "Fid_EATSCDTSubs" 61536 "Fid_EBAFCD" 61537 "Fid_EBFCD" 61538 "Fid_ECU" 61539 "Fid_EGSysCoLSU0" 61540 "Fid_EGSysCoNSC" 61541 "Fid_EGSysCoOxi" 61542 "Fid_EGSysCoTrbn" 61543 "Fid_EGSysCoTube0" 61544 "Fid_EGSysCoTube1" 61545 "Fid_EGSysHtgDel" 61546 "Fid_EGSysMaxTOxiPreB1" 61547 "Fid_EGSysMaxTOxiPreB2" 61548 "Fid_EGSysMaxTPreB1" 61549 "Fid_EGSysMaxTPreB2" 61550 "Fid_EGSysMaxTPreRgnB1" 61551 "Fid_EGSysMaxTPreRgnB2" 61552 "Fid_EGSysMxTOxiPreRgnB1" 61553 "Fid_EGSysMxTOxiPreRgnB2" 61554 "Fid_EGSysNSC" 61555 "Fid_EGSysOxiCat" 61556 "Fid_EGSysPresEnv" 61557 "Fid_EGSysStrt" 61558 "Fid_EGSysTemp" 61559 "Fid_EGSysTrbn" 61560 "Fid_EGSysTube" 61561 "Fid_EGSys_AP" 61562 "Fid_EGTRgnLck" 61563 "Fid_EGTTempGvnrAirCtl" 61564 "Fid_EGTTempGvnrInrB1" 61565 "Fid_EGTTempGvnrInrB2" 61566 "Fid_EGTTempGvnrOutrB1" 61567 "Fid_EGTTempGvnrOutrB2" 61568 "Fid_ETClbCorActv" 61569 "Fid_EngCTSCD" 61570 "Fid_EngMCaS1" 61571 "Fid_EngMCaSBackUp" 61572 "Fid_EngMCrS1" 61573 "Fid_EngMCrSBackUp" 61574 "Fid_EngMTEng" 61575 "Fid_EngMTrqFrcPDiff" 61576 "Fid_EngMVVeh" 61577 "Fid_EngM_ChkStrtSpd" 61578 "Fid_EngPrt_nLimErr" 61579 "Fid_FBC" 61580 "Fid_FBCMonI" 61581 "Fid_FMASwtOff1" 61582 "Fid_FMASwtOff2" 61583 "Fid_FMASwtOff3" 61584 "Fid_FMTC_AirCorr" 61585 "Fid_FMTC_PCRCorr" 61586 "Fid_FMTC_SOECorr" 61587 "Fid_FTSCDErr" 61588 "Fid_FanCtl" 61589 "Fid_FanGbxOil" 61590 "Fid_FlMngFullLdRglOff" 61591 "Fid_FlMngSmkDefect" 61592 "Fid_FlMngTPFltErr" 61593 "Fid_FlSysCTSSens" 61594 "Fid_FlSysDens" 61595 "Fid_FlSysFTSSens" 61596 "Fid_FrmMngAOHt" 61597 "Fid_FrmMngAPP" 61598 "Fid_FrmMngARS" 61599 "Fid_FrmMngAddLevl" 61600 "Fid_FrmMngBrk" 61601 "Fid_FrmMngBrkDef" 61602 "Fid_FrmMngCoEng" 61603 "Fid_FrmMngCoEng_St2" 61604 "Fid_FrmMngConvDef" 61605 "Fid_FrmMngEngOvrSpd" 61606 "Fid_FrmMngEngRpmTemp" 61607 "Fid_FrmMngEngSpd" 61608 "Fid_FrmMngInjDU1" 61609 "Fid_FrmMngInjDU2" 61610 "Fid_FrmMngInjVlv" 61611 "Fid_FrmMngOBDCtl" 61612 "Fid_FrmMngPFltDef" 61613 "Fid_FrmMngParkConsumer" 61614 "Fid_FrmMngPla_DSC" 61615 "Fid_FrmMngPla_EGS" 61616 "Fid_FrmMngPowerTrainCAN" 61617 "Fid_FrmMngPrvCan" 61618 "Fid_FrmMngPwrMngLIGovSt" 61619 "Fid_FrmMngRpmRduc" 61620 "Fid_FrmMngSIG_ARS" 61621 "Fid_FrmMngSIG_DSC" 61622 "Fid_FrmMngSig_EGS" 61623 "Fid_FrmMngTO_ARS" 61624 "Fid_FrmMngTO_DSC" 61625 "Fid_FrmMngTo_EGS" 61626 "Fid_FrmMngTrqGearbx" 61627 "Fid_FrmMngWaterVlv" 61628 "Fid_FrmMng_ST_TORQ" 61629 "Fid_FrmMng_stTrq" 61630 "Fid_FrmMngnSetpoint" 61631 "Fid_FrmMngpVal" 61632 "Fid_FrmMngtEng" 61633 "Fid_GearbxDrvAway" 61634 "Fid_GearbxDrvAwayInactv" 61635 "Fid_GearbxNmin" 61636 "Fid_GearbxPtCANErr" 61637 "Fid_GearbxSlip" 61638 "Fid_GearbxTrqLimErr" 61639 "Fid_Gearbx_GearDet" 61640 "Fid_Gearbx_TrqIntv_Err" 61641 "Fid_GlwCtl1" 61642 "Fid_GlwCtl2" 61643 "Fid_GlwCtl3" 61644 "Fid_HDC" 61645 "Fid_IATSCD" 61646 "Fid_IATSCD_tAir1" 61647 "Fid_IATSCD_tAir2" 61648 "Fid_IndSys1" 61649 "Fid_IndSys2" 61650 "Fid_InjCrvCoErr" 61651 "Fid_InjCrvCylOffs" 61652 "Fid_InjCtl_qLimErr" 61653 "Fid_InjVCDActrEnrgTemp" 61654 "Fid_InjVCDCls" 61655 "Fid_InjVCDTPUErr" 61656 "Fid_InjVlvActrTemp" 61657 "Fid_InjVlvInjLim" 61658 "Fid_InjVlvMon" 61659 "Fid_InjVlvNVC" 61660 "Fid_InjVlvSetUpVolt" 61661 "Fid_InjVlvWvCorOff" 61662 "Fid_LIGovSetpointDrvAwy" 61663 "Fid_LIGovUbr" 61664 "Fid_LSUCDMon0" 61665 "Fid_LSUCDO20" 61666 "Fid_LSUCDRi0" 61667 "Fid_LSUCDactiv0" 61668 "Fid_LSUCDlsu0" 61669 "Fid_LSUClbSched" 61670 "Fid_LSUCtl0" 61671 "Fid_LSUMonAllChecks" 61672 "Fid_LSUMonPlausChk" 61673 "Fid_Layer_FI_TANS" 61674 "Fid_Layer_FI_TUMG" 61675 "Fid_Layer_MANHYDR" 61676 "Fid_Layer_MANLUFT" 61677 "Fid_MSCDPrivCan" 61678 "Fid_MSMonNetMngPtCan" 61679 "Fid_MSMonPFlt1" 61680 "Fid_MSMonPFlt2" 61681 "Fid_MSMonPFlt3" 61682 "Fid_MSMonPFlt4" 61683 "Fid_MSMonStEGS" 61684 "Fid_MSMon_ARS_TO" 61685 "Fid_MSMon_CanDef" 61686 "Fid_MSMon_DSC_TO" 61687 "Fid_MSMon_EGS_TO" 61688 "Fid_MSMon_FrmMngPT" 61689 "Fid_MSMon_FrmMngPT2" 61690 "Fid_MSMon_trqOff" 61691 "Fid_MSidCD_ECU" 61692 "Fid_MSidCD_Pin" 61693 "Fid_MeUnCDCalcI" 61694 "Fid_Mil" 61695 "Fid_OTSCD" 61696 "Fid_OxiCat_pPreCat" 61697 "Fid_PCBSPFltDef" 61698 "Fid_PCR" 61699 "Fid_PCRBalGvnr" 61700 "Fid_PCRBalGvnrP40Corr" 61701 "Fid_PCRExtnLimActr" 61702 "Fid_PCRGvnrDvtNeg" 61703 "Fid_PCRGvnrDvtPos" 61704 "Fid_PCRLPGvnrDvtNeg" 61705 "Fid_PCRLPGvnrDvtPos" 61706 "Fid_PCRSurgeGvnr" 61707 "Fid_PCRSurgeLIGov" 61708 "Fid_PCR_LP" 61709 "Fid_PCR_LPMS" 61710 "Fid_PCR_MS" 61711 "Fid_PCR_SurgeDet" 61712 "Fid_PCVCDCalcI" 61713 "Fid_PFltAshCor" 61714 "Fid_PFltAshCorRgn" 61715 "Fid_PFltBrk" 61716 "Fid_PFltCharB1" 61717 "Fid_PFltCharB2" 61718 "Fid_PFltChngParB1" 61719 "Fid_PFltChngParB2" 61720 "Fid_PFltClth" 61721 "Fid_PFltDynChkB1" 61722 "Fid_PFltDynChkB2" 61723 "Fid_PFltEngPrtRgnMon" 61724 "Fid_PFltGearDet" 61725 "Fid_PFltHsLnChkB1" 61726 "Fid_PFltHsLnChkB2" 61727 "Fid_PFltLckRgnErr" 61728 "Fid_PFltLckRgnFuel" 61729 "Fid_PFltNumPFltErr" 61730 "Fid_PFltNumPFltErrLck" 61731 "Fid_PFltPlausPresB1" 61732 "Fid_PFltPlausPresB2" 61733 "Fid_PFltPlausTempB1" 61734 "Fid_PFltPlausTempB2" 61735 "Fid_PFltPresPlausProj" 61736 "Fid_PFltPresSensFrz" 61737 "Fid_PFltPresSensHsLnB1" 61738 "Fid_PFltPresSensHsLnB2" 61739 "Fid_PFltPresSensPreB1" 61740 "Fid_PFltPresSensPreB2" 61741 "Fid_PFltSRCPresB1" 61742 "Fid_PFltSRCPresB2" 61743 "Fid_PFltSRCTempB1" 61744 "Fid_PFltSRCTempB2" 61745 "Fid_PFltSimOnB1" 61746 "Fid_PFltSimOnB2" 61747 "Fid_PFltSpdVeh" 61748 "Fid_PFltSucB1" 61749 "Fid_PFltSucB2" 61750 "Fid_PFltTOxiPreDiffB1" 61751 "Fid_PFltTOxiPreDiffB2" 61752 "Fid_PFltTPreDiffB1" 61753 "Fid_PFltTPreDiffB2" 61754 "Fid_PFltTempAir" 61755 "Fid_PFltTempClnt" 61756 "Fid_PFltTempOxiPreB1" 61757 "Fid_PFltTempOxiPreB2" 61758 "Fid_PFltTempOxiPstB1" 61759 "Fid_PFltTempOxiPstB2" 61760 "Fid_PFltTempPreB1" 61761 "Fid_PFltTempPreB2" 61762 "Fid_PFltTempSensB1" 61763 "Fid_PFltTempSensB2" 61764 "Fid_PFltTempSensFrz" 61765 "Fid_PFltTwFlwTempDev" 61766 "Fid_PFltVltgBatt" 61767 "Fid_RailCDRPSErrChk" 61768 "Fid_RailCDSubstVal" 61769 "Fid_RailCD_PMonStrt" 61770 "Fid_RailCPCtlMeUnMode" 61771 "Fid_RailCPCtlPCVMode" 61772 "Fid_RailCtlMode" 61773 "Fid_RailMeUn0Blk" 61774 "Fid_RailMeUn0Rls" 61775 "Fid_RailMeUn1Blk" 61776 "Fid_RailMeUn1Rls" 61777 "Fid_RailMeUn2Blk" 61778 "Fid_RailMeUn2Rls" 61779 "Fid_RailMeUn3Blk" 61780 "Fid_RailMeUn3Rls" 61781 "Fid_RailMeUn4Blk" 61782 "Fid_RailMeUn4Rls" 61783 "Fid_RailMeUnCtlMode" 61784 "Fid_RailPCV0Blk" 61785 "Fid_RailPCV0Rls" 61786 "Fid_RailPCV1Blk" 61787 "Fid_RailPCV1Rls" 61788 "Fid_RailPCV2Blk" 61789 "Fid_RailPCV2Rls" 61790 "Fid_RailPCV3Blk" 61791 "Fid_RailPCV3Rls" 61792 "Fid_RailPCV4Blk" 61793 "Fid_RailPCV4Rls" 61794 "Fid_RailPCV5Blk" 61795 "Fid_RailPCV5Rls" 61796 "Fid_RailPCVCtlMode" 61797 "Fid_RailSetPointLim" 61798 "Fid_RailSetPointRed" 61799 "Fid_SignalsTstNLim" 61800 "Fid_StSysImmo" 61801 "Fid_StSysStrtTipGbxDat" 61802 "Fid_SysLamp" 61803 "Fid_T15CDCanError" 61804 "Fid_T50CDSig" 61805 "Fid_TVACD_AirMonOff" 61806 "Fid_ThrVlvMon" 61807 "Fid_VSACDDioInDia" 61808 "Fid_VSSCD_Tx" 61809 "Fid_VehDaDist" 61810 "Fid_ZFCClbActv" 61811 "Fid_ZFCCldCmbCham" /end COMPU_VTAB
/begin COMPU_METHOD Frequency_PA "Frequenz" RAT_FUNC "%6.2" "Hz" COEFFS 0 1 0 0 0 1 /end COMPU_METHOD
/begin RECORD_LAYOUT Kwb_Wu16 FNC_VALUES 1 UWORD COLUMN_DIR DIRECT /end RECORD_LAYOUT
/end MODULE
/end PROJECT
