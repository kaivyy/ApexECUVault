ASAP2_VERSION 1 41
/begin PROJECT MSD85 "Spray Guided DI-System with Piezo Injectors for 8-Cylinder"
/begin HEADER "_default_HeaderComment" PROJECT_NO _91 /end HEADER
/begin MODULE _default_ModuleName "_default_ModuleLongIdentifier"
/begin MOD_COMMON "_default_ModCommonComment" DEPOSIT ABSOLUTE BYTE_ORDER MSB_LAST ALIGNMENT_BYTE 1 ALIGNMENT_WORD 2 ALIGNMENT_LONG 2 ALIGNMENT_FLOAT32_IEEE 2 ALIGNMENT_FLOAT64_IEEE 4 /end MOD_COMMON
/begin MEASUREMENT Dla_soll_puls "Differenzlambda für Pulsation" SWORD _CNV_R_R_Def_f_sw_b_592_CM 1 100. -8. 7.9997 DISPLAY_IDENTIFIER DLA_SOLL_PULS ECU_ADDRESS 0xd000dd8a FORMAT "%9.4" ARRAY_SIZE 2 MATRIX_DIM 2 1 1 /end MEASUREMENT
/begin MEASUREMENT Dla_uesp "Differenzlambda Überspülen" SWORD _CNV_R_R_Def_f_sw_b_592_CM 1 100. -8. 7.9997 DISPLAY_IDENTIFIER DLA_UESP ECU_ADDRESS 0xd000ddb2 FORMAT "%9.4" /end MEASUREMENT
/begin MEASUREMENT Dla_wup "Differenzlambda Warmlauf" SWORD _CNV_R_R_Def_f_sw_b_592_CM 1 100. -8. 7.9997 DISPLAY_IDENTIFIER DLA_WUP ECU_ADDRESS 0xd000ddb4 FORMAT "%9.4" /end MEASUREMENT
/begin MEASUREMENT Dmd_gen "Maximaler Momentenanstieg Motor für Generator" SWORD _CNV_R_R_Def_m_sw_q_554_CM 1 100. -3276.8 3276.7 DISPLAY_IDENTIFIER DMD_GEN ECU_ADDRESS 0xd000e0ce FORMAT "%7.2" /end MEASUREMENT
/begin MEASUREMENT Dmd_gen_kor "Bedingung: Erhöhung der Zielreserve wenn Ierrdiff zu klein" SWORD _CNV_R_R_Def_m_sw_q_554_CM 1 100. -3276.8 3276.7 DISPLAY_IDENTIFIER DMD_GEN_KOR ECU_ADDRESS 0xd000e0d0 FORMAT "%7.2" /end MEASUREMENT
/begin MEASUREMENT Dmdi_ml_soll "Mdi_ml_soll-Gradient" SWORD _CNV_R_R_Def_m_sw_q_554_CM 1 100. -3276.8 3276.7 DISPLAY_IDENTIFIER DMDI_ML_SOLL ECU_ADDRESS 0xd000ddb6 FORMAT "%7.2" /end MEASUREMENT
/begin MEASUREMENT Dtes12_s "(schicht)" SWORD _CNV_R_R_Def_td_sw__601_CM 1 100. -131.072 131.068 DISPLAY_IDENTIFIER DTES12_S ECU_ADDRESS 0xd000d7a4 FORMAT "%8.3" /end MEASUREMENT
/begin MEASUREMENT Dwese2_h "" SWORD _CNV_R_R_Def_kw_sw__603_CM 1 100. -768. 767.9765 DISPLAY_IDENTIFIER DWESE2_H ECU_ADDRESS 0xd000d740 FORMAT "%8.3" ARRAY_SIZE 8 MATRIX_DIM 8 1 1 /end MEASUREMENT
/begin MEASUREMENT Dwese_hs "Deltawinkel auf Zündwinkel geschichtet aus Kennfeld (homogen-schicht)" SWORD _CNV_R_R_Def_kw_sw__603_CM 1 100. -768. 767.9765 DISPLAY_IDENTIFIER DWESE_HS ECU_ADDRESS 0xd000d79e FORMAT "%8.3" /end MEASUREMENT
/begin MEASUREMENT Dwese_s "Deltawinkel auf Zündwinkel geschichtet aus Kennfeld (schicht)" SWORD _CNV_R_R_Def_kw_sw__603_CM 1 100. -768. 767.9765 DISPLAY_IDENTIFIER DWESE_S ECU_ADDRESS 0xd000d79c FORMAT "%8.3" /end MEASUREMENT
/begin MEASUREMENT Dwesest_h "" SWORD _CNV_R_R_Def_kw_sw__603_CM 1 100. -768. 767.9765 DISPLAY_IDENTIFIER DWESEST_H ECU_ADDRESS 0xd000d79a FORMAT "%8.3" /end MEASUREMENT
/begin MEASUREMENT Eta_ges_f "Gesamtwirkungsgrad" SWORD _CNV_R_R_Def_eta_sw_599_CM 1 100. -200. 199.9938 DISPLAY_IDENTIFIER ETA_GES_F ECU_ADDRESS 0xd000ddb0 FORMAT "%8.3" /end MEASUREMENT
/begin MEASUREMENT Eta_lako "Lambda Wirkungsgrad koordiniert Rf basiert" SWORD _CNV_R_R_Def_eta_sw_599_CM 1 100. -200. 199.9938 DISPLAY_IDENTIFIER ETA_LAKO ECU_ADDRESS 0xd000dd8e FORMAT "%8.3" /end MEASUREMENT
/begin MEASUREMENT Eta_lamb_bas "Wirkungsgrad" SWORD _CNV_R_R_Def_eta_sw_599_CM 1 100. -200. 199.9938 DISPLAY_IDENTIFIER ETA_LAMB_BAS ECU_ADDRESS 0xd000dd90 FORMAT "%8.3" /end MEASUREMENT
/begin MEASUREMENT Eta_lamb_bas1 "Wirkungsgrad" SWORD _CNV_R_R_Def_eta_sw_599_CM 1 100. -200. 199.9938 DISPLAY_IDENTIFIER ETA_LAMB_BAS1 ECU_ADDRESS 0xd000ddb8 FORMAT "%8.3" /end MEASUREMENT
/begin MEASUREMENT Eta_lamb_bas2 "Wirkungsgrad" SWORD _CNV_R_R_Def_eta_sw_599_CM 1 100. -200. 199.9938 DISPLAY_IDENTIFIER ETA_LAMB_BAS2 ECU_ADDRESS 0xd000ddba FORMAT "%8.3" /end MEASUREMENT
/begin MEASUREMENT F_klann_eps1 "Differenz zwischen gelerntem Wert und aktuellen Eingangswert, Bank 1" FLOAT32_IEEE _CNV_R_R_Def_dez_sl_551_CM 1 100. -1000000000000. 10000000000000. DISPLAY_IDENTIFIER F_KLANN_EPS1 ECU_ADDRESS 0xc0000e3c FORMAT "%14.7" /end MEASUREMENT
/begin MEASUREMENT F_klann_eps2 "Differenz zwischen gelerntem Wert und aktuellen Eingangswert, Bank 2" FLOAT32_IEEE _CNV_R_R_Def_dez_sl_551_CM 1 100. -1000000000000. 10000000000000. DISPLAY_IDENTIFIER F_KLANN_EPS2 ECU_ADDRESS 0xc0000e40 FORMAT "%14.7" /end MEASUREMENT
/begin MEASUREMENT F_lradap1 "Faktor aus Lambdaregelungsadaption für Bank 1" SWORD _CNV_R_R_Def_f_sw_q_550_CM 1 100. -50. 49.9984 DISPLAY_IDENTIFIER F_LRADAP1 ECU_ADDRESS 0xc0000e28 FORMAT "%9.4" /end MEASUREMENT
/begin MEASUREMENT F_lradap2 "Faktor aus Lambdaregelungsadaption für Bank 2" SWORD _CNV_R_R_Def_f_sw_q_550_CM 1 100. -50. 49.9984 DISPLAY_IDENTIFIER F_LRADAP2 ECU_ADDRESS 0xc0000e2a FORMAT "%9.4" /end MEASUREMENT
/begin MEASUREMENT F_lradap_vb1 "Faktor aus Lambdaregelungsadaption für Bank 1, unbegrenzt" SWORD _CNV_R_R_Def_f_sw_q_550_CM 1 100. -50. 49.9984 DISPLAY_IDENTIFIER F_LRADAP_VB1 ECU_ADDRESS 0xc0000e2c FORMAT "%9.4" /end MEASUREMENT
/begin MEASUREMENT F_lradap_vb2 "Faktor aus Lambdaregelungsadaption für Bank 2, unbegrenzt" SWORD _CNV_R_R_Def_f_sw_q_550_CM 1 100. -50. 49.9984 DISPLAY_IDENTIFIER F_LRADAP_VB2 ECU_ADDRESS 0xc0000e2e FORMAT "%9.4" /end MEASUREMENT
/begin MEASUREMENT F_lradaps1 "Erlernter Faktor aus Lambdaregelungsadaption für Bank 1" SWORD _CNV_R_R_Def_f_sw_q_550_CM 1 100. -50. 49.9984 DISPLAY_IDENTIFIER F_LRADAPS1 ECU_ADDRESS 0xc0000e34 FORMAT "%9.4" /end MEASUREMENT
/begin MEASUREMENT F_lradaps2 "Erlernter Faktor aus Lambdaregelungsadaption für Bank 2" SWORD _CNV_R_R_Def_f_sw_q_550_CM 1 100. -50. 49.9984 DISPLAY_IDENTIFIER F_LRADAPS2 ECU_ADDRESS 0xc0000e36 FORMAT "%9.4" /end MEASUREMENT
/begin MEASUREMENT F_wes_h "Ueberblendfaktor Einspritzbeginn 1te und 2te Einspritzung kalt(F=1) warm(F=0)" UBYTE _CNV_R_R_Def_f_ub_b_619_CM 1 100. 0. 1. DISPLAY_IDENTIFIER F_WES_H ECU_ADDRESS 0xd000d7a8 /end MEASUREMENT
/begin MEASUREMENT I_genipol1 "Invers interpolierte Generatorstrom 1. Kennfeld" SWORD _CNV_R_R_Def_i_uw_q_630_CM 1 100. -4096. 4095.875 DISPLAY_IDENTIFIER I_GENIPOL1 ECU_ADDRESS 0xd000e0fe FORMAT "%8.3" /end MEASUREMENT
/begin MEASUREMENT I_genipol2 "Invers interpolierte Generatorstrom 2. Kennfeld" SWORD _CNV_R_R_Def_i_uw_q_630_CM 1 100. -4096. 4095.875 DISPLAY_IDENTIFIER I_GENIPOL2 ECU_ADDRESS 0xd000e100 FORMAT "%8.3" /end MEASUREMENT
/begin MEASUREMENT I_genipol3 "Invers interpolierte Generatorstrom 3. Kennfeld" SWORD _CNV_R_R_Def_i_uw_q_630_CM 1 100. -4096. 4095.875 DISPLAY_IDENTIFIER I_GENIPOL3 ECU_ADDRESS 0xd000e102 FORMAT "%8.3" /end MEASUREMENT
/begin MEASUREMENT Ierrdiff "Differenz zwischen Ierr und Ierrgrenz" SWORD _CNV_R_R_Def_i_uw_q_630_CM 1 100. -4096. 4095.875 DISPLAY_IDENTIFIER IERRDIFF ECU_ADDRESS 0xd000e0d2 FORMAT "%8.3" /end MEASUREMENT
/begin MEASUREMENT Ierrgrenz "Grenzerregerstrom" UBYTE _CNV_R_R_Def_i_uw_q_630_CM 1 100. 0. 31.875 DISPLAY_IDENTIFIER IERRGRENZ ECU_ADDRESS 0xd000e0e4 /end MEASUREMENT
/begin MEASUREMENT Ierrgrenz_ext "Grenzerregerstrom vom Tester" UBYTE _CNV_R_R_Def_i_uw_q_630_CM 1 100. 0. 31.875 DISPLAY_IDENTIFIER IERRGRENZ_EXT ECU_ADDRESS 0xd000e0e8 /end MEASUREMENT
/begin MEASUREMENT Ierrgrenz_md "Grenzerregerstrom Momentenbasiert" UBYTE _CNV_R_R_Def_i_uw_q_630_CM 1 100. 0. 31.875 DISPLAY_IDENTIFIER IERRGRENZ_MD ECU_ADDRESS 0xd000e0fc /end MEASUREMENT
/begin MEASUREMENT Klann_test1 "Faktor aus Lambdaregelungsadaption für Bank 1, Testerabfrage" SWORD _CNV_R_R_Def_f_sw_q_550_CM 1 100. -50. 49.9984 DISPLAY_IDENTIFIER KLANN_TEST1 ECU_ADDRESS 0xc0000e30 FORMAT "%9.4" /end MEASUREMENT
/begin MEASUREMENT Klann_test2 "Faktor aus Lambdaregelungsadaption für Bank 2, Testerabfrage" SWORD _CNV_R_R_Def_f_sw_q_550_CM 1 100. -50. 49.9984 DISPLAY_IDENTIFIER KLANN_TEST2 ECU_ADDRESS 0xc0000e32 FORMAT "%9.4" /end MEASUREMENT
/begin MEASUREMENT La_abgas1 "Berechnetes Lambda im Abgas inklusive Durchspülung in sch, hos und hom Bank 1" UWORD _CNV_R_R_Def_f_uw_b_559_CM 1 100. 0. 15.9997 DISPLAY_IDENTIFIER LA_ABGAS1 ECU_ADDRESS 0xd000dd92 FORMAT "%9.4" /end MEASUREMENT
/begin MEASUREMENT La_abgas2 "Berechnetes Lambda im Abgas inklusive Durchspülung in sch, hos und hom Bank 2" UWORD _CNV_R_R_Def_f_uw_b_559_CM 1 100. 0. 15.9997 DISPLAY_IDENTIFIER LA_ABGAS2 ECU_ADDRESS 0xd000dd94 FORMAT "%9.4" /end MEASUREMENT
/begin MEASUREMENT La_bas1 "Basis Lambda-Sollwert, Bank 1 (Zulieferer)" UWORD _CNV_R_R_Def_f_uw_b_559_CM 1 100. 0. 15.9997 DISPLAY_IDENTIFIER LA_BAS1 ECU_ADDRESS 0xd000dd96 FORMAT "%9.4" /end MEASUREMENT
/begin MEASUREMENT La_bas2 "Basis Lambda-Sollwert, Bank 2 (Zulieferer)" UWORD _CNV_R_R_Def_f_uw_b_559_CM 1 100. 0. 15.9997 DISPLAY_IDENTIFIER LA_BAS2 ECU_ADDRESS 0xd000dd98 FORMAT "%9.4" /end MEASUREMENT
/begin MEASUREMENT La_hom1 "Lambda-Basiswert bei Homogen Bank 1" UWORD _CNV_R_R_Def_f_uw_b_559_CM 1 100. 0. 15.9997 DISPLAY_IDENTIFIER LA_HOM1 ECU_ADDRESS 0xd000ddbc FORMAT "%9.4" /end MEASUREMENT
/begin MEASUREMENT La_hom2 "Lambda-Basiswert bei Homogen Bank 2" UWORD _CNV_R_R_Def_f_uw_b_559_CM 1 100. 0. 15.9997 DISPLAY_IDENTIFIER LA_HOM2 ECU_ADDRESS 0xd000ddbe FORMAT "%9.4" /end MEASUREMENT
/begin MEASUREMENT La_inst "Lambdasollwert instationär" UWORD _CNV_R_R_Def_f_uw_b_559_CM 1 100. 0. 15.9997 DISPLAY_IDENTIFIER LA_INST ECU_ADDRESS 0xd000ddc0 FORMAT "%9.4" /end MEASUREMENT
/begin MEASUREMENT La_inst_bas "Lambdasollwert instationär vor Gradientenlimitierung" UWORD _CNV_R_R_Def_f_uw_b_559_CM 1 100. 0. 15.9997 DISPLAY_IDENTIFIER LA_INST_BAS ECU_ADDRESS 0xd000ddc2 FORMAT "%9.4" /end MEASUREMENT
/begin MEASUREMENT La_ref_homm "Lambda-Basiswert bei Homogen mager" UWORD _CNV_R_R_Def_f_uw_b_559_CM 1 100. 0. 15.9997 DISPLAY_IDENTIFIER LA_REF_HOMM ECU_ADDRESS 0xd000dd9a FORMAT "%9.4" /end MEASUREMENT
/begin MEASUREMENT La_soll1 "Lambda-Sollwert Bank 1" UWORD _CNV_R_R_Def_f_uw_b_559_CM 1 100. 0. 15.9997 DISPLAY_IDENTIFIER LA_SOLL1 ECU_ADDRESS 0xd000dd9c FORMAT "%9.4" /end MEASUREMENT
/begin MEASUREMENT La_soll2 "Lambda-Sollwert Bank 2" UWORD _CNV_R_R_Def_f_uw_b_559_CM 1 100. 0. 15.9997 DISPLAY_IDENTIFIER LA_SOLL2 ECU_ADDRESS 0xd000dd9e FORMAT "%9.4" /end MEASUREMENT
/begin MEASUREMENT La_soll_h1 "Lambda-Sollwert Bank 1" UWORD _CNV_R_R_Def_f_uw_b_559_CM 1 100. 0. 15.9997 DISPLAY_IDENTIFIER LA_SOLL_H1 ECU_ADDRESS 0xd000dda0 FORMAT "%9.4" /end MEASUREMENT
/begin MEASUREMENT La_soll_h2 "Lambda-Sollwert Bank 2" UWORD _CNV_R_R_Def_f_uw_b_559_CM 1 100. 0. 15.9997 DISPLAY_IDENTIFIER LA_SOLL_H2 ECU_ADDRESS 0xd000dda2 FORMAT "%9.4" /end MEASUREMENT
/begin MEASUREMENT La_soll_ko1 "LambdaWert aus Lambda Koordinator Bank 1" UWORD _CNV_R_R_Def_f_uw_b_559_CM 1 100. 0. 15.9997 DISPLAY_IDENTIFIER LA_SOLL_KO1 ECU_ADDRESS 0xd000dda4 FORMAT "%9.4" /end MEASUREMENT
/begin MEASUREMENT La_soll_ko2 "LambdaWert aus Lambda Koordinator Bank 2" UWORD _CNV_R_R_Def_f_uw_b_559_CM 1 100. 0. 15.9997 DISPLAY_IDENTIFIER LA_SOLL_KO2 ECU_ADDRESS 0xd000dda6 FORMAT "%9.4" /end MEASUREMENT
/begin MEASUREMENT La_soll_stat1 "Solllambda im Brennraum ohne Pulsation Bank 1 (homogen)" UWORD _CNV_R_R_Def_f_uw_b_559_CM 1 100. 0. 15.9997 DISPLAY_IDENTIFIER LA_SOLL_STAT1 ECU_ADDRESS 0xd000dda8 FORMAT "%9.4" /end MEASUREMENT
/begin MEASUREMENT La_soll_stat2 "Solllambda im Brennraum ohne Pulsation Bank 2 (homogen)" UWORD _CNV_R_R_Def_f_uw_b_559_CM 1 100. 0. 15.9997 DISPLAY_IDENTIFIER LA_SOLL_STAT2 ECU_ADDRESS 0xd000ddaa FORMAT "%9.4" /end MEASUREMENT
/begin MEASUREMENT La_soll_vl1 "Lambdasoll Volllast Bank 1" UWORD _CNV_R_R_Def_f_uw_b_559_CM 1 100. 0. 15.9997 DISPLAY_IDENTIFIER LA_SOLL_VL1 ECU_ADDRESS 0xd000ddc4 FORMAT "%9.4" /end MEASUREMENT
/begin MEASUREMENT La_soll_vl2 "Lambdasoll Volllast Bank 2" UWORD _CNV_R_R_Def_f_uw_b_559_CM 1 100. 0. 15.9997 DISPLAY_IDENTIFIER LA_SOLL_VL2 ECU_ADDRESS 0xd000ddc6 FORMAT "%9.4" /end MEASUREMENT
/begin MEASUREMENT La_vl1 "Lambdasoll Volllast Bank 1" UWORD _CNV_R_R_Def_f_uw_b_559_CM 1 100. 0. 15.9997 DISPLAY_IDENTIFIER LA_VL1 ECU_ADDRESS 0xd000ddc8 FORMAT "%9.4" /end MEASUREMENT
/begin MEASUREMENT La_vl2 "Lambdasoll Volllast Bank 2" UWORD _CNV_R_R_Def_f_uw_b_559_CM 1 100. 0. 15.9997 DISPLAY_IDENTIFIER LA_VL2 ECU_ADDRESS 0xd000ddca FORMAT "%9.4" /end MEASUREMENT
/begin MEASUREMENT La_wahl1_b1 "Lambda Ebene 1 Bank 1" UWORD _CNV_R_R_Def_f_uw_b_559_CM 1 100. 0. 15.9997 DISPLAY_IDENTIFIER LA_WAHL1_B1 ECU_ADDRESS 0xd000ddcc FORMAT "%9.4" /end MEASUREMENT
/begin MEASUREMENT La_wahl1_b2 "Lambda in Ebene 1 Bank 2" UWORD _CNV_R_R_Def_f_uw_b_559_CM 1 100. 0. 15.9997 DISPLAY_IDENTIFIER LA_WAHL1_B2 ECU_ADDRESS 0xd000ddce FORMAT "%9.4" /end MEASUREMENT
/begin MEASUREMENT La_wahl2_b1 "Lambda in Ebene 2 Bank 1" UWORD _CNV_R_R_Def_f_uw_b_559_CM 1 100. 0. 15.9997 DISPLAY_IDENTIFIER LA_WAHL2_B1 ECU_ADDRESS 0xd000ddd0 FORMAT "%9.4" /end MEASUREMENT
/begin MEASUREMENT La_wahl2_b2 "Lambda Ebene 2 BAnk 2" UWORD _CNV_R_R_Def_f_uw_b_559_CM 1 100. 0. 15.9997 DISPLAY_IDENTIFIER LA_WAHL2_B2 ECU_ADDRESS 0xd000ddd2 FORMAT "%9.4" /end MEASUREMENT
/begin MEASUREMENT Lam_auswahl1 "Variable zur Auswahl der Lambdas in Ebene 1 (Schalterstellung)" UBYTE _CNV_R_R_Def_dez_sl_551_CM 1 100. 0. 255. DISPLAY_IDENTIFIER LAM_AUSWAHL1 ECU_ADDRESS 0xd000ddac FORMAT "%3.0" /end MEASUREMENT
/begin MEASUREMENT Lam_auswahl2 "Variable zur Auswahl der Lambdas in Ebene 2 (Schalterstellung)" UBYTE _CNV_R_R_Def_dez_sl_551_CM 1 100. 0. 255. DISPLAY_IDENTIFIER LAM_AUSWAHL2 ECU_ADDRESS 0xd000ddad FORMAT "%3.0" /end MEASUREMENT
/begin MEASUREMENT Lam_auswahl3 "Variable zur Auswahl der Lambdas in Ebene 3 (Schalterstellung)" UBYTE _CNV_R_R_Def_dez_sl_551_CM 1 100. 0. 255. DISPLAY_IDENTIFIER LAM_AUSWAHL3 ECU_ADDRESS 0xd000ddae FORMAT "%3.0" /end MEASUREMENT
/begin MEASUREMENT Lam_auswahl_dla "Variable zur Schalterauswahl des Differenzlambdas" UBYTE _CNV_R_R_Def_dez_sl_551_CM 1 100. 0. 255. DISPLAY_IDENTIFIER LAM_AUSWAHL_DLA ECU_ADDRESS 0xd000ddaf FORMAT "%3.0" /end MEASUREMENT
/begin MEASUREMENT Loadresp "Loadresponse Zeit aus Kennfeldrechnung (alte Version)" UBYTE _CNV_R_R_Def_td_ub__574_CM 1 100. 0. 25.5 DISPLAY_IDENTIFIER LOADRESP ECU_ADDRESS 0xd000e0f8 FORMAT "%4.1" /end MEASUREMENT
/begin MEASUREMENT Md_dmm "Delta Moment pro Rechenraster für Generatorgrenzmoment" SWORD _CNV_R_R_Def_m_sw_q_649_CM 1 100. -327.68 327.67 DISPLAY_IDENTIFIER MD_DMM ECU_ADDRESS 0xd000e0d4 FORMAT "%7.2" /end MEASUREMENT
/begin MEASUREMENT Md_entlsoll "Sollentlastungsmoment Generator" SWORD _CNV_R_R_Def_m_sw_q_554_CM 1 100. -3276.8 3276.7 DISPLAY_IDENTIFIER MD_ENTLSOLL ECU_ADDRESS 0xd000e136 FORMAT "%7.2" /end MEASUREMENT
/begin MEASUREMENT Md_entlsoll1 "Sollentlastungsmoment bei NA Überlast" SWORD _CNV_R_R_Def_m_sw_q_554_CM 1 100. -3276.8 3276.7 DISPLAY_IDENTIFIER MD_ENTLSOLL1 ECU_ADDRESS 0xd000e14a FORMAT "%7.2" /end MEASUREMENT
/begin MEASUREMENT Md_entlsoll2 "Sollentlastungsmoment Generator im Start" SWORD _CNV_R_R_Def_m_sw_q_554_CM 1 100. -3276.8 3276.7 DISPLAY_IDENTIFIER MD_ENTLSOLL2 ECU_ADDRESS 0xd000e0ee FORMAT "%7.2" /end MEASUREMENT
/begin MEASUREMENT Md_entlsoll4 "Sollentlastungsmoment bei Rennstart" SWORD _CNV_R_R_Def_m_sw_q_554_CM 1 100. -3276.8 3276.7 DISPLAY_IDENTIFIER MD_ENTLSOLL4 ECU_ADDRESS 0xd000e16e FORMAT "%7.2" /end MEASUREMENT
/begin MEASUREMENT Md_entlsollkk "Sollentlastungsmoment für Klimakompressor" SWORD _CNV_R_R_Def_m_sw_q_554_CM 1 100. -3276.8 3276.7 DISPLAY_IDENTIFIER MD_ENTLSOLLKK ECU_ADDRESS 0xd000e14c FORMAT "%7.2" /end MEASUREMENT
/begin MEASUREMENT Md_gennmgg "Generatormoment gefiltert für GEN_GRENZ" SWORD _CNV_R_R_Def_m_sw_q_554_CM 1 100. -3276.8 3276.7 DISPLAY_IDENTIFIER MD_GENNMGG ECU_ADDRESS 0xd000e0d6 FORMAT "%7.2" /end MEASUREMENT
/begin MEASUREMENT Md_gennmnofil "Generatormoment ungefiltert" SWORD _CNV_R_R_Def_m_sw_q_554_CM 1 100. -3276.8 3276.7 DISPLAY_IDENTIFIER MD_GENNMNOFIL ECU_ADDRESS 0xd000e0c6 FORMAT "%7.2" /end MEASUREMENT
/begin MEASUREMENT Md_get_ipm "Getriebeverlustmoment" SWORD _CNV_R_R_Def_m_sw_q_554_CM 1 100. -3276.8 3276.7 DISPLAY_IDENTIFIER MD_GET_IPM ECU_ADDRESS 0xd000e148 FORMAT "%7.2" /end MEASUREMENT
/begin MEASUREMENT Md_grenz_int "Generatorgrenzmoment aus Integration" SWORD _CNV_R_R_Def_m_sw_q_649_CM 1 100. -327.68 327.67 DISPLAY_IDENTIFIER MD_GRENZ_INT ECU_ADDRESS 0xd000e0d8 FORMAT "%7.2" /end MEASUREMENT
/begin MEASUREMENT Md_grenz_kor "Korrigiertes Grenzmoment" SWORD _CNV_R_R_Def_m_sw_q_554_CM 1 100. -3276.8 3276.7 DISPLAY_IDENTIFIER MD_GRENZ_KOR ECU_ADDRESS 0xd000e104 FORMAT "%7.2" /end MEASUREMENT
/begin MEASUREMENT Md_grenz_res "Generatorgrenzmoment aus Addition der Zielreserve" SWORD _CNV_R_R_Def_m_sw_q_649_CM 1 100. -327.68 327.67 DISPLAY_IDENTIFIER MD_GRENZ_RES ECU_ADDRESS 0xd000e0da FORMAT "%7.2" /end MEASUREMENT
/begin MEASUREMENT Md_gresziel "Zielreserve für Generator BN i.O." SWORD _CNV_R_R_Def_m_sw_q_649_CM 1 100. -327.68 327.67 DISPLAY_IDENTIFIER MD_GRESZIEL ECU_ADDRESS 0xd000e0dc FORMAT "%7.2" /end MEASUREMENT
/begin MEASUREMENT Md_greszielkorr "Korrigierte Zielreserve für Generator" SWORD _CNV_R_R_Def_m_sw_q_649_CM 1 100. -327.68 327.67 DISPLAY_IDENTIFIER MD_GRESZIELKORR ECU_ADDRESS 0xd000e0de FORMAT "%7.2" /end MEASUREMENT
/begin MEASUREMENT Md_max_acnaue "Begrenzungsmomente Klimakompressor bei NA Überlast" SWORD _CNV_R_R_Def_m_sw_q_554_CM 1 100. -3276.8 3276.7 DISPLAY_IDENTIFIER MD_MAX_ACNAUE ECU_ADDRESS 0xd000e132 FORMAT "%7.2" /end MEASUREMENT
/begin MEASUREMENT Md_max_klima "Begrenzungsmoment Klimakompressor" SWORD _CNV_R_R_Def_m_sw_q_554_CM 1 100. -3276.8 3276.7 DISPLAY_IDENTIFIER MD_MAX_KLIMA ECU_ADDRESS 0xd000e12e FORMAT "%7.2" /end MEASUREMENT
/begin MEASUREMENT Md_na_bc "Im best case freigebbares Moment der NA" SWORD _CNV_R_R_Def_m_sw_q_554_CM 1 100. -3276.8 3276.7 DISPLAY_IDENTIFIER MD_NA_BC ECU_ADDRESS 0xd000e140 FORMAT "%7.2" /end MEASUREMENT
/begin MEASUREMENT Md_na_bilanzgen "mögliches Entlastungsmoment durch GEN" SWORD _CNV_R_R_Def_m_sw_q_554_CM 1 100. -3276.8 3276.7 DISPLAY_IDENTIFIER MD_NA_BILANZGEN ECU_ADDRESS 0xd000e112 FORMAT "%7.2" /end MEASUREMENT
/begin MEASUREMENT Md_na_bilanzkk "mögliches Entlastungsmoment durch KK" SWORD _CNV_R_R_Def_m_sw_q_554_CM 1 100. -3276.8 3276.7 DISPLAY_IDENTIFIER MD_NA_BILANZKK ECU_ADDRESS 0xd000e110 FORMAT "%7.2" /end MEASUREMENT
/begin MEASUREMENT Md_na_bilanzl "Md_na_bc + Md_na_wcl" SWORD _CNV_R_R_Def_m_sw_q_554_CM 1 100. -3276.8 3276.7 DISPLAY_IDENTIFIER MD_NA_BILANZL ECU_ADDRESS 0xd000e10e FORMAT "%7.2" /end MEASUREMENT
/begin MEASUREMENT Md_na_bilanzs "Md_na_bc + Md_na_wcs" SWORD _CNV_R_R_Def_m_sw_q_554_CM 1 100. -3276.8 3276.7 DISPLAY_IDENTIFIER MD_NA_BILANZS ECU_ADDRESS 0xd000e10c FORMAT "%7.2" /end MEASUREMENT
/begin MEASUREMENT Md_na_wcl "Moment, daß die Nebenaggregate maximal noch aufnehmen können; bei langsamer Entlastung" SWORD _CNV_R_R_Def_m_sw_q_554_CM 1 100. -3276.8 3276.7 DISPLAY_IDENTIFIER MD_NA_WCL ECU_ADDRESS 0xd000e146 FORMAT "%7.2" /end MEASUREMENT
/begin MEASUREMENT Md_na_wcs "Moment, daß die Nebenaggregate maximal noch aufnehmen können; bei schneller Entlastung" SWORD _CNV_R_R_Def_m_sw_q_554_CM 1 100. -3276.8 3276.7 DISPLAY_IDENTIFIER MD_NA_WCS ECU_ADDRESS 0xd000e144 FORMAT "%7.2" /end MEASUREMENT
/begin MEASUREMENT Md_naars_wcl "Moment, daß das ARS maximal noch aufnehmen kann; bei langsamer Entlastung" SWORD _CNV_R_R_Def_m_sw_q_554_CM 1 100. -3276.8 3276.7 DISPLAY_IDENTIFIER MD_NAARS_WCL ECU_ADDRESS 0xd000e162 FORMAT "%7.2" /end MEASUREMENT
/begin MEASUREMENT Md_naars_wcs "Moment, daß das ARS maximal noch aufnehmen kann; bei schneller Entlastung" SWORD _CNV_R_R_Def_m_sw_q_554_CM 1 100. -3276.8 3276.7 DISPLAY_IDENTIFIER MD_NAARS_WCS ECU_ADDRESS 0xd000e164 FORMAT "%7.2" /end MEASUREMENT
/begin MEASUREMENT Md_naef_wcl "Moment, daß die EF-Nebenaggregate maximal noch aufnehmen können; bei langsamer Entlastung" SWORD _CNV_R_R_Def_m_sw_q_554_CM 1 100. -3276.8 3276.7 DISPLAY_IDENTIFIER MD_NAEF_WCL ECU_ADDRESS 0xd000e154 FORMAT "%7.2" /end MEASUREMENT
/begin MEASUREMENT Md_naef_wcs "Moment, daß die EF-Nebenaggregate maximal noch aufnehmen können; bei schneller Entlastung" SWORD _CNV_R_R_Def_m_sw_q_554_CM 1 100. -3276.8 3276.7 DISPLAY_IDENTIFIER MD_NAEF_WCS ECU_ADDRESS 0xd000e152 FORMAT "%7.2" /end MEASUREMENT
/begin MEASUREMENT Md_nagen_wcl "Moment, daß der Generator maximal noch aufnehmen kann; bei langsamer Entlastung" SWORD _CNV_R_R_Def_m_sw_q_554_CM 1 100. -3276.8 3276.7 DISPLAY_IDENTIFIER MD_NAGEN_WCL ECU_ADDRESS 0xd000e15a FORMAT "%7.2" /end MEASUREMENT
/begin MEASUREMENT Md_nagen_wcs "Moment, daß der Generator maximal noch aufnehmen kann; bei schneller Entlastung" SWORD _CNV_R_R_Def_m_sw_q_554_CM 1 100. -3276.8 3276.7 DISPLAY_IDENTIFIER MD_NAGEN_WCS ECU_ADDRESS 0xd000e15c FORMAT "%7.2" /end MEASUREMENT
/begin MEASUREMENT Md_nagesverlust "Gesamtverlustmoment der NA inkl. Wandler" SWORD _CNV_R_R_Def_m_sw_q_554_CM 1 100. -3276.8 3276.7 DISPLAY_IDENTIFIER MD_NAGESVERLUST ECU_ADDRESS 0xd000e142 FORMAT "%7.2" /end MEASUREMENT
/begin MEASUREMENT Md_nagetr_wcl "Moment, daß das Getriebe maximal noch aufnehmen kann; bei langsamer Entlastung" SWORD _CNV_R_R_Def_m_sw_q_554_CM 1 100. -3276.8 3276.7 DISPLAY_IDENTIFIER MD_NAGETR_WCL ECU_ADDRESS 0xd000e158 FORMAT "%7.2" /end MEASUREMENT
/begin MEASUREMENT Md_nagetr_wcs "Moment, daß das Getriebe maximal noch aufnehmen kann; bei schneller Entlastung" SWORD _CNV_R_R_Def_m_sw_q_554_CM 1 100. -3276.8 3276.7 DISPLAY_IDENTIFIER MD_NAGETR_WCS ECU_ADDRESS 0xd000e156 FORMAT "%7.2" /end MEASUREMENT
/begin MEASUREMENT Md_nakk_wcl "Moment, daß der Klimakompressor maximal noch aufnehmen kann; bei langsamer Entlastung" SWORD _CNV_R_R_Def_m_sw_q_554_CM 1 100. -3276.8 3276.7 DISPLAY_IDENTIFIER MD_NAKK_WCL ECU_ADDRESS 0xd000e15e FORMAT "%7.2" /end MEASUREMENT
/begin MEASUREMENT Md_nakk_wcs "Moment, daß der Klimakompressor maximal noch aufnehmen kannn; bei schneller Entlastung" SWORD _CNV_R_R_Def_m_sw_q_554_CM 1 100. -3276.8 3276.7 DISPLAY_IDENTIFIER MD_NAKK_WCS ECU_ADDRESS 0xd000e160 FORMAT "%7.2" /end MEASUREMENT
/begin MEASUREMENT Md_nasl_wcl "Moment, daß die Servolenkung maximal noch aufnehmen kann; bei langsamer Entlastung" SWORD _CNV_R_R_Def_m_sw_q_554_CM 1 100. -3276.8 3276.7 DISPLAY_IDENTIFIER MD_NASL_WCL ECU_ADDRESS 0xd000e166 FORMAT "%7.2" /end MEASUREMENT
/begin MEASUREMENT Md_nasl_wcs "Moment, daß die Servolenkung maximal noch aufnehmen kann; bei schneller Entlastung" SWORD _CNV_R_R_Def_m_sw_q_554_CM 1 100. -3276.8 3276.7 DISPLAY_IDENTIFIER MD_NASL_WCS ECU_ADDRESS 0xd000e168 FORMAT "%7.2" /end MEASUREMENT
/begin MEASUREMENT Md_res_bn "Momentenreserve bei instabilem Bordnetz" SWORD _CNV_R_R_Def_m_sw_q_554_CM 1 100. -3276.8 3276.7 DISPLAY_IDENTIFIER MD_RES_BN ECU_ADDRESS 0xd000e0f6 FORMAT "%7.2" /end MEASUREMENT
/begin MEASUREMENT Md_res_real "Aktuelle Momentenreserve des Motors" SWORD _CNV_R_R_Def_m_sw_q_554_CM 1 100. -3276.8 3276.7 DISPLAY_IDENTIFIER MD_RES_REAL ECU_ADDRESS 0xd000e0c8 FORMAT "%7.2" /end MEASUREMENT
/begin MEASUREMENT Mdkw_grenz "Begrenzungsmoment für Generator" SWORD _CNV_R_R_Def_m_sw_q_554_CM 1 100. -3276.8 3276.7 DISPLAY_IDENTIFIER MDKW_GRENZ ECU_ADDRESS 0xd000e0e6 FORMAT "%7.2" /end MEASUREMENT
/begin MEASUREMENT Mdkw_grenz_dyn "Maximalmoment Generator" SWORD _CNV_R_R_Def_m_sw_q_554_CM 1 100. -3276.8 3276.7 DISPLAY_IDENTIFIER MDKW_GRENZ_DYN ECU_ADDRESS 0xd000e0ca FORMAT "%7.2" /end MEASUREMENT
/begin MEASUREMENT Mdkw_grenz_stat "Stationäres Generatorbegrenzungsmoment" SWORD _CNV_R_R_Def_m_sw_q_554_CM 1 100. -3276.8 3276.7 DISPLAY_IDENTIFIER MDKW_GRENZ_STAT ECU_ADDRESS 0xd000e130 FORMAT "%7.2" /end MEASUREMENT
/begin MEASUREMENT Mdkw_rest "Restmoment an der Kurbelwelle" SWORD _CNV_R_R_Def_m_sw_q_554_CM 1 100. -3276.8 3276.7 DISPLAY_IDENTIFIER MDKW_REST ECU_ADDRESS 0xd000e13e FORMAT "%7.2" /end MEASUREMENT
/begin MEASUREMENT N_ozmw "kurzzeitiger Mittelwert Drehzahl" SWORD _CNV_R_R_Def_n_sw_q_595_CM 1 100. -32767. 32767. DISPLAY_IDENTIFIER N_OZMW ECU_ADDRESS 0xc00078ce FORMAT "%5.0" /end MEASUREMENT
/begin MEASUREMENT Napr_i_appl "priorisierter Ierrgrenz" UWORD _CNV_R_R_Def_dez_sl_551_CM 1 100. 0. 65535. DISPLAY_IDENTIFIER NAPR_I_APPL ECU_ADDRESS 0xc0000e08 FORMAT "%5.0" /end MEASUREMENT
/begin MEASUREMENT Napr_i_ext "priorisierter Ierrgrenz" UWORD _CNV_R_R_Def_dez_sl_551_CM 1 100. 0. 65535. DISPLAY_IDENTIFIER NAPR_I_EXT ECU_ADDRESS 0xc0000e06 FORMAT "%5.0" /end MEASUREMENT
/begin MEASUREMENT Napr_i_ht "priorisierter Ierrgrenz" UWORD _CNV_R_R_Def_dez_sl_551_CM 1 100. 0. 65535. DISPLAY_IDENTIFIER NAPR_I_HT ECU_ADDRESS 0xc0000e02 FORMAT "%5.0" /end MEASUREMENT
/begin MEASUREMENT Napr_i_ll "priorisierter Ierrgrenz" UWORD _CNV_R_R_Def_dez_sl_551_CM 1 100. 0. 65535. DISPLAY_IDENTIFIER NAPR_I_LL ECU_ADDRESS 0xc0000e04 FORMAT "%5.0" /end MEASUREMENT
/begin MEASUREMENT Napr_i_md "priorisierter Ierrgrenz" UWORD _CNV_R_R_Def_dez_sl_551_CM 1 100. 0. 65535. DISPLAY_IDENTIFIER NAPR_I_MD ECU_ADDRESS 0xc0000e00 FORMAT "%5.0" /end MEASUREMENT
/begin MEASUREMENT Napr_md_dyn "priorisiertes Generatormoment" ULONG _CNV_R_R_Def_dez_sl_551_CM 1 100. 0. 4294967295. DISPLAY_IDENTIFIER NAPR_MD_DYN ECU_ADDRESS 0xc0000e12 FORMAT "%7.0" /end MEASUREMENT
/begin MEASUREMENT Napr_md_stat "priorisiertes Generatormoment" ULONG _CNV_R_R_Def_dez_sl_551_CM 1 100. 0. 4294967295. DISPLAY_IDENTIFIER NAPR_MD_STAT ECU_ADDRESS 0xc0000e0e FORMAT "%7.0" /end MEASUREMENT
/begin MEASUREMENT Napr_sollmn "Priorisierter Erregerstrom aus Sollspannung vom PM" UWORD _CNV_R_R_Def_dez_sl_551_CM 1 100. 0. 65535. DISPLAY_IDENTIFIER NAPR_SOLLMN ECU_ADDRESS 0xc0000e0a FORMAT "%5.0" /end MEASUREMENT
/begin MEASUREMENT Napr_spgw "Priorisierter Erregerstrom aus Spannungswächter vom PM" UWORD _CNV_R_R_Def_dez_sl_551_CM 1 100. 0. 65535. DISPLAY_IDENTIFIER NAPR_SPGW ECU_ADDRESS 0xc0000e0c FORMAT "%5.0" /end MEASUREMENT
/begin MEASUREMENT Oz_abstellm "Abstellzeit für OZ" UWORD _CNV_R_R_Def_tn_uw__664_CM 1 100. 0. 65535. DISPLAY_IDENTIFIER OZ_ABSTELLM ECU_ADDRESS 0xc00040ba FORMAT "%7.2" /end MEASUREMENT
/begin MEASUREMENT Oz_beschcnt "Zähler Beschleunigungsausblendung" UBYTE _CNV_R_R_Def_dez_sl_551_CM 1 100. 0. 255. DISPLAY_IDENTIFIER OZ_BESCHCNT ECU_ADDRESS 0xc00078df FORMAT "%3.0" /end MEASUREMENT
/begin MEASUREMENT Oz_dkm "Gefahrene Strecke für die Steigungsberechnung" UWORD _CNV_R_R_Def_f_uw_b_618_CM 1 100. 0. 9.999800000000001 DISPLAY_IDENTIFIER OZ_DKM ECU_ADDRESS 0xc00078d4 FORMAT "%9.4" /end MEASUREMENT
/begin MEASUREMENT Oz_hoehe "Gefahrene Höhe für die Steigungserkennung" SWORD _CNV_R_R_Def_f_sw_b_592_CM 1 100. -8. 7.9997 DISPLAY_IDENTIFIER OZ_HOEHE ECU_ADDRESS 0xc00078d0 FORMAT "%9.4" /end MEASUREMENT
/begin MEASUREMENT Oz_koroelp "Niveaukorrektur in Ölpumpe-Notlauf " SWORD _CNV_R_R_Def_niv_sw_666_CM 1 100. -37.5 37.5 DISPLAY_IDENTIFIER OZ_KOROELP ECU_ADDRESS 0xc00078bc FORMAT "%7.2" /end MEASUREMENT
/begin MEASUREMENT Oz_krz2cnt "KurzMw 2 Zähler" UBYTE _CNV_R_R_Def_dez_sl_551_CM 1 100. 0. 255. DISPLAY_IDENTIFIER OZ_KRZ2CNT ECU_ADDRESS 0xc00078be FORMAT "%3.0" /end MEASUREMENT
/begin MEASUREMENT Oz_krzcnt "10er Packet Zähler" UBYTE _CNV_R_R_Def_dez_sl_551_CM 1 100. 0. 255. DISPLAY_IDENTIFIER OZ_KRZCNT ECU_ADDRESS 0xc00078bf FORMAT "%3.0" /end MEASUREMENT
/begin MEASUREMENT Oz_krzkor2 "Mittelwert von zwei KurzMw" UBYTE _CNV_R_R_Def_niv_ub_667_CM 1 100. 0. 74.70699999999999 DISPLAY_IDENTIFIER OZ_KRZKOR2 ECU_ADDRESS 0xc00078e0 FORMAT "%5.2" /end MEASUREMENT
/begin MEASUREMENT Oz_krzkor2k "Mittelwert von zwei KurzMw Steigungs korrigiert" UBYTE _CNV_R_R_Def_niv_ub_667_CM 1 100. 0. 74.70699999999999 DISPLAY_IDENTIFIER OZ_KRZKOR2K ECU_ADDRESS 0xc00078c0 FORMAT "%5.2" /end MEASUREMENT
/begin MEASUREMENT Oz_krzmw "10er Packet" UBYTE _CNV_R_R_Def_niv_ub_667_CM 1 100. 0. 74.70699999999999 DISPLAY_IDENTIFIER OZ_KRZMW ECU_ADDRESS 0xc00078e1 FORMAT "%5.2" /end MEASUREMENT
/begin MEASUREMENT Oz_krzmwkor "10er Packet drehzahl korrigiert" UBYTE _CNV_R_R_Def_niv_ub_667_CM 1 100. 0. 74.70699999999999 DISPLAY_IDENTIFIER OZ_KRZMWKOR ECU_ADDRESS 0xc00078e2 FORMAT "%5.2" /end MEASUREMENT
/begin MEASUREMENT Oz_krzor "kurzzeitiger Mittelwert Orientierungsmessung Niveau" UBYTE _CNV_R_R_Def_niv_ub_667_CM 1 100. 0. 74.70699999999999 DISPLAY_IDENTIFIER OZ_KRZOR ECU_ADDRESS 0xc00078c1 FORMAT "%5.2" /end MEASUREMENT
/begin MEASUREMENT Oz_langmw "Langzeitmittelwert berechnet" UBYTE _CNV_R_R_Def_niv_ub_667_CM 1 100. 0. 74.70699999999999 DISPLAY_IDENTIFIER OZ_LANGMW ECU_ADDRESS 0xc00040be FORMAT "%5.2" /end MEASUREMENT
/begin MEASUREMENT Oz_lbmw "Längsbeschleunigungs Mittelwert für die Niveau-Korrektur" SBYTE _CNV_R_R_Def_f_sb_b_669_CM 1 100. -2. 1.9843 DISPLAY_IDENTIFIER OZ_LBMW ECU_ADDRESS 0xc00078dc FORMAT "%5.2" /end MEASUREMENT
/begin MEASUREMENT Oz_lgmwcnt "LangzeitMw Zähler" UBYTE _CNV_R_R_Def_dez_sl_551_CM 1 100. 0. 255. DISPLAY_IDENTIFIER OZ_LGMWCNT ECU_ADDRESS 0xc00078c2 FORMAT "%3.0" /end MEASUREMENT
/begin MEASUREMENT Oz_lp "oz level picture" UBYTE _CNV_R_R_Def_dez_sl_551_CM 1 100. 0. 255. DISPLAY_IDENTIFIER OZ_LP ECU_ADDRESS 0xc00078c3 FORMAT "%3.0" /end MEASUREMENT
/begin MEASUREMENT Oz_lv "oz level value" UBYTE _CNV_R_R_Def_dez_sl_551_CM 1 100. 0. 255. DISPLAY_IDENTIFIER OZ_LV ECU_ADDRESS 0xc00078c4 FORMAT "%3.0" /end MEASUREMENT
/begin MEASUREMENT Oz_nivakt "Aktuelles Niveau für den Tester" UBYTE _CNV_R_R_Def_niv_ub_667_CM 1 100. 0. 74.70699999999999 DISPLAY_IDENTIFIER OZ_NIVAKT ECU_ADDRESS 0xc00078c5 FORMAT "%5.2" /end MEASUREMENT
/begin MEASUREMENT Oz_nivkomp "Temperatur- und Zeitkompensation" UBYTE _CNV_R_R_Def_niv_ub_667_CM 1 100. 0. 74.70699999999999 DISPLAY_IDENTIFIER OZ_NIVKOMP ECU_ADDRESS 0xc00078c6 FORMAT "%5.2" /end MEASUREMENT
/begin MEASUREMENT Oz_nivkor "Aktuelles Niveau Temperatur korrigiert" UBYTE _CNV_R_R_Def_niv_ub_667_CM 1 100. 0. 74.70699999999999 DISPLAY_IDENTIFIER OZ_NIVKOR ECU_ADDRESS 0xc00078c7 FORMAT "%5.2" /end MEASUREMENT
/begin MEASUREMENT Oz_nivkrzt "Kurzmittelwert-Niveau für den Tester" UBYTE _CNV_R_R_Def_niv_ub_667_CM 1 100. 0. 74.70699999999999 DISPLAY_IDENTIFIER OZ_NIVKRZT ECU_ADDRESS 0xc00078c8 FORMAT "%5.2" /end MEASUREMENT
/begin MEASUREMENT Oz_nivlit "Ölniveau in Liter" UBYTE _CNV_R_R_Def_niv_ub_671_CM 1 100. 0. 25.5 DISPLAY_IDENTIFIER OZ_NIVLIT ECU_ADDRESS 0xc00078c9 FORMAT "%5.2" /end MEASUREMENT
/begin MEASUREMENT Oz_nivzeit "Zeit nach dem KF_OZZEIT" UWORD _CNV_R_R_Def_td_uw__673_CM 1 100. 0. 655.35 DISPLAY_IDENTIFIER OZ_NIVZEIT ECU_ADDRESS 0xc00078d6 FORMAT "%7.2" /end MEASUREMENT
/begin MEASUREMENT Oz_oricnt "Orientierungszähler" UBYTE _CNV_R_R_Def_dez_sl_551_CM 1 100. 0. 255. DISPLAY_IDENTIFIER OZ_ORICNT ECU_ADDRESS 0xc00078ca FORMAT "%3.0" /end MEASUREMENT
/begin MEASUREMENT Oz_orikor "OriMw korrigiert" UBYTE _CNV_R_R_Def_niv_ub_667_CM 1 100. 0. 74.70699999999999 DISPLAY_IDENTIFIER OZ_ORIKOR ECU_ADDRESS 0xc00078cb FORMAT "%5.2" /end MEASUREMENT
/begin MEASUREMENT Oz_peil "Ölniveau für die Peilstabanzeige" UBYTE _CNV_R_R_Def_niv_ub_667_CM 1 100. 0. 74.70699999999999 DISPLAY_IDENTIFIER OZ_PEIL ECU_ADDRESS 0xc00078e3 FORMAT "%5.2" /end MEASUREMENT
/begin MEASUREMENT Oz_peilaltanz "Letzter Wert, der die Anzeige geändert hat" UBYTE _CNV_R_R_Def_niv_ub_667_CM 1 100. 0. 74.70699999999999 DISPLAY_IDENTIFIER OZ_PEILALTANZ ECU_ADDRESS 0xc00040bf FORMAT "%5.2" /end MEASUREMENT
/begin MEASUREMENT Oz_peilkm "Max Ziel km im Fehlerfall" UWORD _CNV_R_R_Def_km_sw__68_CM 1 100. 0. 655350. DISPLAY_IDENTIFIER OZ_PEILKM ECU_ADDRESS 0xc00078d8 FORMAT "%5.0" /end MEASUREMENT
/begin MEASUREMENT Oz_peilkmalt "Km Stand beim 1. Sensorfehler" UWORD _CNV_R_R_Def_km_sw__68_CM 1 100. 0. 655350. DISPLAY_IDENTIFIER OZ_PEILKMALT ECU_ADDRESS 0xc00040bc FORMAT "%5.0" /end MEASUREMENT
/begin MEASUREMENT Oz_peillang "Letzter angeforderter Wert für die Peilstabanzeige" UBYTE _CNV_R_R_Def_niv_ub_667_CM 1 100. 0. 74.70699999999999 DISPLAY_IDENTIFIER OZ_PEILLANG ECU_ADDRESS 0xc00040c0 FORMAT "%5.2" /end MEASUREMENT
/begin MEASUREMENT Oz_peiloben "Obere Grenze aktuelles Balkens" UBYTE _CNV_R_R_Def_niv_ub_667_CM 1 100. 0. 74.70699999999999 DISPLAY_IDENTIFIER OZ_PEILOBEN ECU_ADDRESS 0xc00078e4 FORMAT "%5.2" /end MEASUREMENT
/begin MEASUREMENT Oz_peilunten "Obere Grenze aktuelles Balkens" UBYTE _CNV_R_R_Def_niv_ub_667_CM 1 100. 0. 74.70699999999999 DISPLAY_IDENTIFIER OZ_PEILUNTEN ECU_ADDRESS 0xc00078e5 FORMAT "%5.2" /end MEASUREMENT
/begin MEASUREMENT Oz_pzdivp "Verhältnis oz_luftalt/oz_luftneu" UWORD _CNV_R_R_Def_f_uw_b_590_CM 1 100. 0. 1.9999 DISPLAY_IDENTIFIER OZ_PZDIVP ECU_ADDRESS 0xc00078da FORMAT "%14.5" /end MEASUREMENT
/begin MEASUREMENT Oz_qbmw "Querbeschleunigungs Mittelwert für die Niveau-Korrektur" SBYTE _CNV_R_R_Def_f_sb_b_669_CM 1 100. -2. 1.9843 DISPLAY_IDENTIFIER OZ_QBMW ECU_ADDRESS 0xc00078dd FORMAT "%5.2" /end MEASUREMENT
/begin MEASUREMENT Oz_steigung "Berechnete Steigung" SWORD _CNV_R_R_Def_f_sw_b_623_CM 1 100. -64. 63.998 DISPLAY_IDENTIFIER OZ_STEIGUNG ECU_ADDRESS 0xc00078d2 FORMAT "%8.3" /end MEASUREMENT
/begin MEASUREMENT Oz_tempf "Gefilterte Öltemperatur" SWORD _CNV_R_R_Def_t_sw_q_578_CM 1 100. -3276.8 3276.7 DISPLAY_IDENTIFIER OZ_TEMPF ECU_ADDRESS 0xc00078e8 FORMAT "%6.1" /end MEASUREMENT
/begin MEASUREMENT Oz_tempmdl "Interne Modelltemperatur (NG6)" SWORD _CNV_R_R_Def_t_sw_q_578_CM 1 100. -3276.8 3276.7 DISPLAY_IDENTIFIER OZ_TEMPMDL ECU_ADDRESS 0xc00078ea FORMAT "%6.1" /end MEASUREMENT
/begin MEASUREMENT Oz_uefcnt "Zähler Überfüllung" UBYTE _CNV_R_R_Def_dez_sl_551_CM 1 100. 0. 255. DISPLAY_IDENTIFIER OZ_UEFCNT ECU_ADDRESS 0xc00078e6 FORMAT "%3.0" /end MEASUREMENT
/begin MEASUREMENT Oz_uefzcnt "Zwischenzähler Überfüllung" SBYTE _CNV_R_R_Def_dez_sl_551_CM 1 100. -128. 127. DISPLAY_IDENTIFIER OZ_UEFZCNT ECU_ADDRESS 0xc00078de FORMAT "%3.0" /end MEASUREMENT
/begin MEASUREMENT Oz_vormw "vorgezogener Mittelwert Niveau" UBYTE _CNV_R_R_Def_niv_ub_667_CM 1 100. 0. 74.70699999999999 DISPLAY_IDENTIFIER OZ_VORMW ECU_ADDRESS 0xc00078cc FORMAT "%5.2" /end MEASUREMENT
/begin MEASUREMENT Oz_vormwcnt "VorMw Zähler" UBYTE _CNV_R_R_Def_dez_sl_551_CM 1 100. 0. 255. DISPLAY_IDENTIFIER OZ_VORMWCNT ECU_ADDRESS 0xc00078cd FORMAT "%3.0" /end MEASUREMENT
/begin MEASUREMENT Pr_entl_soll "Priorität der Spannungsanforderung für Generatorentlastung" UBYTE _CNV_R_R_Def_dez_sl_551_CM 1 100. 0. 255. DISPLAY_IDENTIFIER PR_ENTL_SOLL ECU_ADDRESS 0xd000e129 FORMAT "%3.0" /end MEASUREMENT
/begin MEASUREMENT Pr_grenz_ist "Aktuelle Priorität Erregerstrombegrenzung" UBYTE _CNV_R_R_Def_dez_sl_551_CM 1 100. 0. 255. DISPLAY_IDENTIFIER PR_GRENZ_IST ECU_ADDRESS 0xd000e0e3 FORMAT "%3.0" /end MEASUREMENT
/begin MEASUREMENT Pr_grenz_md "Priorität Momentenbegrenzung des Generators" UBYTE _CNV_R_R_Def_dez_sl_551_CM 1 100. 0. 255. DISPLAY_IDENTIFIER PR_GRENZ_MD ECU_ADDRESS 0xd000e0e2 FORMAT "%3.0" /end MEASUREMENT
/begin MEASUREMENT Pr_ipmna "Aktuelle Priorität Erregerstrombegrenzung iPM NA" UBYTE _CNV_R_R_Def_dez_sl_551_CM 1 100. 0. 255. DISPLAY_IDENTIFIER PR_IPMNA ECU_ADDRESS 0xd000e0e0 FORMAT "%3.0" /end MEASUREMENT
/begin MEASUREMENT Pr_md_entlkk "Priorität der Begrenzung des Klimakompressors" UBYTE _CNV_R_R_Def_dez_sl_551_CM 1 100. 0. 255. DISPLAY_IDENTIFIER PR_MD_ENTLKK ECU_ADDRESS 0xd000e10a FORMAT "%3.0" /end MEASUREMENT
/begin MEASUREMENT Pr_md_entlsoll "Priorität der Momentenbegrenzung für Generatorentlastung" UBYTE _CNV_R_R_Def_dez_sl_551_CM 1 100. 0. 255. DISPLAY_IDENTIFIER PR_MD_ENTLSOLL ECU_ADDRESS 0xd000e12a FORMAT "%3.0" /end MEASUREMENT
/begin MEASUREMENT Pr_md_entlsoll1 "Priorität der Generatorentlastung bei NA Überlast " UBYTE _CNV_R_R_Def_dez_sl_551_CM 1 100. 0. 255. DISPLAY_IDENTIFIER PR_MD_ENTLSOLL1 ECU_ADDRESS 0xd000e109 FORMAT "%3.0" /end MEASUREMENT
/begin MEASUREMENT Pr_md_entlsoll1alt "Priorität der NA Begrenzung im Start (alter Wert)" UBYTE _CNV_R_R_Def_dez_sl_551_CM 1 100. 0. 255. DISPLAY_IDENTIFIER PR_MD_ENTLSOLL1ALT ECU_ADDRESS 0xd000e13a FORMAT "%3.0" /end MEASUREMENT
/begin MEASUREMENT Pr_md_entlsoll2 "Priorität der Generatorentlastung im Start" UBYTE _CNV_R_R_Def_dez_sl_551_CM 1 100. 0. 255. DISPLAY_IDENTIFIER PR_MD_ENTLSOLL2 ECU_ADDRESS 0xd000e0f0 FORMAT "%3.0" /end MEASUREMENT
/begin MEASUREMENT Pr_md_entlsoll2alt "Priorität der NA Begrenzung im Start (alter Wert)" UBYTE _CNV_R_R_Def_dez_sl_551_CM 1 100. 0. 255. DISPLAY_IDENTIFIER PR_MD_ENTLSOLL2ALT ECU_ADDRESS 0xd000e139 FORMAT "%3.0" /end MEASUREMENT
/begin MEASUREMENT Pr_md_entlsoll3alt "Priorität der NA Begrenzung von ELMOTENTL (alter Wert)" UBYTE _CNV_R_R_Def_dez_sl_551_CM 1 100. 0. 255. DISPLAY_IDENTIFIER PR_MD_ENTLSOLL3ALT ECU_ADDRESS 0xd000e138 FORMAT "%3.0" /end MEASUREMENT
/begin MEASUREMENT Pr_md_entlsoll4 "Prio zur Begrenzung Generatormoment bei Rennstart" UBYTE _CNV_R_R_Def_dez_sl_551_CM 1 100. 0. 255. DISPLAY_IDENTIFIER PR_MD_ENTLSOLL4 ECU_ADDRESS 0xd000e16d FORMAT "%3.0" /end MEASUREMENT
/begin MEASUREMENT Pr_mddyn "Priorität der Generatordynamikbegrenzung für iGR" UBYTE _CNV_R_R_Def_dez_sl_551_CM 1 100. 0. 255. DISPLAY_IDENTIFIER PR_MDDYN ECU_ADDRESS 0xd000e0cc FORMAT "%3.0" /end MEASUREMENT
/begin MEASUREMENT Pr_mdfunk "Prio Entlastung wegen Funktion" UBYTE _CNV_R_R_Def_dez_sl_551_CM 1 100. 0. 255. DISPLAY_IDENTIFIER PR_MDFUNK ECU_ADDRESS 0xd000e117 FORMAT "%3.0" /end MEASUREMENT
/begin MEASUREMENT Pr_mdkomf "Prio Entlastung wegen Komfort" UBYTE _CNV_R_R_Def_dez_sl_551_CM 1 100. 0. 255. DISPLAY_IDENTIFIER PR_MDKOMF ECU_ADDRESS 0xd000e114 FORMAT "%3.0" /end MEASUREMENT
/begin MEASUREMENT Pr_mdsich "Prio Entlastung wegen Sicherheit" UBYTE _CNV_R_R_Def_dez_sl_551_CM 1 100. 0. 255. DISPLAY_IDENTIFIER PR_MDSICH ECU_ADDRESS 0xd000e115 FORMAT "%3.0" /end MEASUREMENT
/begin MEASUREMENT Pr_mdsichkk "Prio Entlastung wegen Sicherheit" UBYTE _CNV_R_R_Def_dez_sl_551_CM 1 100. 0. 255. DISPLAY_IDENTIFIER PR_MDSICHKK ECU_ADDRESS 0xd000e116 FORMAT "%3.0" /end MEASUREMENT
/begin MEASUREMENT Rk_olad_1 "Rel. Kraftstoffmasse Bank 1 ohne Lambda Adaption" UWORD _CNV_R_R_Def_f_uw_b_588_CM 1 100. 0. 31.9995 DISPLAY_IDENTIFIER RK_OLAD_1 ECU_ADDRESS 0xc0000e38 FORMAT "%9.4" /end MEASUREMENT
/begin MEASUREMENT Rk_olad_2 "Rel. Kraftstoffmasse Bank 2 ohne Lambda Adaption" UWORD _CNV_R_R_Def_f_uw_b_588_CM 1 100. 0. 31.9995 DISPLAY_IDENTIFIER RK_OLAD_2 ECU_ADDRESS 0xc0000e3a FORMAT "%9.4" /end MEASUREMENT
/begin MEASUREMENT St_gengrenz "Statuswort" UBYTE _CNV_R_R_Def_dez_sl_551_CM 1 100. 0. 255. DISPLAY_IDENTIFIER ST_GENGRENZ ECU_ADDRESS 0xd000e0c4 FORMAT "%3.0" /end MEASUREMENT
/begin MEASUREMENT St_gengrenz.B_gengcalc "Bedingung: Ringpuffer weiter takten" UBYTE _CNV_S_2_Def_bit_ub_563_CM 1 100. 0. 1. DISPLAY_IDENTIFIER B_GENGCALC ECU_ADDRESS 0xd000e0c4 BIT_MASK 0x2 /end MEASUREMENT
/begin MEASUREMENT St_gengrenz.B_ierrhys "Bedingung: Erhöhung der Zielreserve wenn Ierrdiff zu klein" UBYTE _CNV_S_2_Def_bit_ub_563_CM 1 100. 0. 1. DISPLAY_IDENTIFIER B_IERRHYS ECU_ADDRESS 0xd000e0c4 BIT_MASK 0x1 /end MEASUREMENT
/begin MEASUREMENT St_genkor "Status Genkor" UBYTE _CNV_R_R_Def_dez_sl_551_CM 1 100. 0. 255. DISPLAY_IDENTIFIER ST_GENKOR ECU_ADDRESS 0xd000e0e1 FORMAT "%3.0" /end MEASUREMENT
/begin MEASUREMENT St_genkor.B_ierrgrenz_akt "Begrenzung Ierr akt" UBYTE _CNV_S_2_Def_bit_ub_563_CM 1 100. 0. 1. DISPLAY_IDENTIFIER B_IERRGRENZ_AKT ECU_ADDRESS 0xd000e0e1 BIT_MASK 0x1 /end MEASUREMENT
/begin MEASUREMENT St_ipmnaprae "Status IPMNA_PRAE" UBYTE _CNV_R_R_Def_dez_sl_551_CM 1 100. 0. 255. DISPLAY_IDENTIFIER ST_IPMNAPRAE ECU_ADDRESS 0xd000e108 FORMAT "%3.0" /end MEASUREMENT
/begin MEASUREMENT St_ipmnaprae.B_entlnkw "Bedingung" UBYTE _CNV_S_2_Def_bit_ub_563_CM 1 100. 0. 1. DISPLAY_IDENTIFIER B_ENTLNKW ECU_ADDRESS 0xd000e108 BIT_MASK 0x4 /end MEASUREMENT
/begin MEASUREMENT St_ipmnaprae.B_fl_kk "Bedingung" UBYTE _CNV_S_2_Def_bit_ub_563_CM 1 100. 0. 1. DISPLAY_IDENTIFIER B_FL_KK ECU_ADDRESS 0xd000e108 BIT_MASK 0x2 /end MEASUREMENT
/begin MEASUREMENT St_ipmnaprae.B_mdkwvoff "Bedingung" UBYTE _CNV_S_2_Def_bit_ub_563_CM 1 100. 0. 1. DISPLAY_IDENTIFIER B_MDKWVOFF ECU_ADDRESS 0xd000e108 BIT_MASK 0x1 /end MEASUREMENT
/begin MEASUREMENT St_ipmnaprae.B_notafu1 "Bedingung Not-Anfahrunterstützung" UBYTE _CNV_S_2_Def_bit_ub_563_CM 1 100. 0. 1. DISPLAY_IDENTIFIER B_NOTAFU1 ECU_ADDRESS 0xd000e108 BIT_MASK 0x8 /end MEASUREMENT
/begin MEASUREMENT St_klann_ad1 "Statuswort KLANN Lambda-Adaption an Anschlag Bank 1" UBYTE _CNV_R_R_Def_dez_sl_551_CM 1 100. 0. 255. DISPLAY_IDENTIFIER ST_KLANN_AD1 ECU_ADDRESS 0xd000e33c FORMAT "%3.0" /end MEASUREMENT
/begin MEASUREMENT St_klann_ad1.B_lradap1_mn "Bedingung Min unterschritten" UBYTE _CNV_S_2_Def_bit_ub_563_CM 1 100. 0. 1. DISPLAY_IDENTIFIER B_LRADAP1_MN ECU_ADDRESS 0xd000e33c BIT_MASK 0x1 /end MEASUREMENT
/begin MEASUREMENT St_klann_ad1.B_lradap1_mx "Bedingung Max überschritten" UBYTE _CNV_S_2_Def_bit_ub_563_CM 1 100. 0. 1. DISPLAY_IDENTIFIER B_LRADAP1_MX ECU_ADDRESS 0xd000e33c BIT_MASK 0x2 /end MEASUREMENT
/begin MEASUREMENT St_klann_ad2 "Statuswort KLANN Lambda-Adaption an Anschlag Bank 2" UBYTE _CNV_R_R_Def_dez_sl_551_CM 1 100. 0. 255. DISPLAY_IDENTIFIER ST_KLANN_AD2 ECU_ADDRESS 0xd000e33d FORMAT "%3.0" /end MEASUREMENT
/begin MEASUREMENT St_klann_ad2.B_lradap2_mn "Bedingung Min unterschritten" UBYTE _CNV_S_2_Def_bit_ub_563_CM 1 100. 0. 1. DISPLAY_IDENTIFIER B_LRADAP2_MN ECU_ADDRESS 0xd000e33d BIT_MASK 0x1 /end MEASUREMENT
/begin MEASUREMENT St_klann_ad2.B_lradap2_mx "Bedingung Max überschritten" UBYTE _CNV_S_2_Def_bit_ub_563_CM 1 100. 0. 1. DISPLAY_IDENTIFIER B_LRADAP2_MX ECU_ADDRESS 0xd000e33d BIT_MASK 0x2 /end MEASUREMENT
/begin MEASUREMENT St_lamko "Statuswort" UBYTE _CNV_R_R_Def_dez_sl_551_CM 1 100. 0. 255. DISPLAY_IDENTIFIER ST_LAMKO ECU_ADDRESS 0xd000dd88 FORMAT "%3.0" /end MEASUREMENT
/begin MEASUREMENT St_lamko.B_bswl "Signal für BTS, dass Lambdakorrektur für WL aktiv ist" UBYTE _CNV_S_2_Def_bit_ub_563_CM 1 100. 0. 1. DISPLAY_IDENTIFIER B_BSWL ECU_ADDRESS 0xd000dd88 BIT_MASK 0x1 /end MEASUREMENT
/begin MEASUREMENT St_lamko.B_lainst_neg "negativer Lambda-Eingriff instationär aktiv" UBYTE _CNV_S_2_Def_bit_ub_563_CM 1 100. 0. 1. DISPLAY_IDENTIFIER B_LAINST_NEG ECU_ADDRESS 0xd000dd88 BIT_MASK 0x2 /end MEASUREMENT
/begin MEASUREMENT St_lamko.B_lainst_pos "positiver Lambda-Eingriff instationär aktiv" UBYTE _CNV_S_2_Def_bit_ub_563_CM 1 100. 0. 1. DISPLAY_IDENTIFIER B_LAINST_POS ECU_ADDRESS 0xd000dd88 BIT_MASK 0x4 /end MEASUREMENT
/begin MEASUREMENT St_lamko.B_laprio_ko "Bedingung Lambda aus Koordinator muss unbedingt gestellet werden" UBYTE _CNV_S_2_Def_bit_ub_563_CM 1 100. 0. 1. DISPLAY_IDENTIFIER B_LAPRIO_KO ECU_ADDRESS 0xd000dd88 BIT_MASK 0x8 /end MEASUREMENT
/begin MEASUREMENT St_loadresp "Statuswort" UBYTE _CNV_R_R_Def_dez_sl_551_CM 1 100. 0. 255. DISPLAY_IDENTIFIER ST_LOADRESP ECU_ADDRESS 0xd000e0f4 FORMAT "%3.0" /end MEASUREMENT
/begin MEASUREMENT St_loadresp.B_lroff "Kein Langbezeichner vergeben" UBYTE _CNV_S_2_Def_bit_ub_563_CM 1 100. 0. 1. DISPLAY_IDENTIFIER B_LROFF ECU_ADDRESS 0xd000e0f4 BIT_MASK 0x1 /end MEASUREMENT
/begin MEASUREMENT St_loadresp0 "Statuswort" UBYTE _CNV_R_R_Def_dez_sl_551_CM 1 100. 0. 255. DISPLAY_IDENTIFIER ST_LOADRESP0 ECU_ADDRESS 0xd000e0ec FORMAT "%3.0" /end MEASUREMENT
/begin MEASUREMENT St_loadresp0.B_genoffmd "Abschaltung Generator angefordert" UBYTE _CNV_S_2_Def_bit_ub_563_CM 1 100. 0. 1. DISPLAY_IDENTIFIER B_GENOFFMD ECU_ADDRESS 0xd000e0ec BIT_MASK 0x2 /end MEASUREMENT
/begin MEASUREMENT St_loadresp0.B_genoffst "Bedingung Generatorabschaltung im Start" UBYTE _CNV_S_2_Def_bit_ub_563_CM 1 100. 0. 1. DISPLAY_IDENTIFIER B_GENOFFST ECU_ADDRESS 0xd000e0ec BIT_MASK 0x1 /end MEASUREMENT
/begin MEASUREMENT St_loadresp0.B_sulevvoff "Kein Langbezeichner vergeben" UBYTE _CNV_S_2_Def_bit_ub_563_CM 1 100. 0. 1. DISPLAY_IDENTIFIER B_SULEVVOFF ECU_ADDRESS 0xd000e0ec BIT_MASK 0x4 /end MEASUREMENT
/begin MEASUREMENT St_loadresp2 "Statuswort" UBYTE _CNV_R_R_Def_dez_sl_551_CM 1 100. 0. 255. DISPLAY_IDENTIFIER ST_LOADRESP2 ECU_ADDRESS 0xc0000e18 FORMAT "%3.0" /end MEASUREMENT
/begin MEASUREMENT St_loadresp2.B_lroff2 "Kein Langbezeichner vergeben" UBYTE _CNV_S_2_Def_bit_ub_563_CM 1 100. 0. 1. DISPLAY_IDENTIFIER B_LROFF2 ECU_ADDRESS 0xc0000e18 BIT_MASK 0x1 /end MEASUREMENT
/begin MEASUREMENT St_oznivdl0 "Statuswort" UBYTE _CNV_R_R_Def_dez_sl_551_CM 1 100. 0. 255. DISPLAY_IDENTIFIER ST_OZNIVDL0 ECU_ADDRESS 0xd000cf78 FORMAT "%3.0" /end MEASUREMENT
/begin MEASUREMENT St_oznivdl0.B_ozkrzkor "Bedingung drehzahlkorrigierter Kurzzeit Niveaumittelwert berechnet" UBYTE _CNV_S_2_Def_bit_ub_563_CM 1 100. 0. 1. DISPLAY_IDENTIFIER B_OZKRZKOR ECU_ADDRESS 0xd000cf78 BIT_MASK 0x2 /end MEASUREMENT
/begin MEASUREMENT St_oznivdl0.B_ozkrzlkor "B_ozkrzkor2 mit Steigungsausblendung" UBYTE _CNV_S_2_Def_bit_ub_563_CM 1 100. 0. 1. DISPLAY_IDENTIFIER B_OZKRZLKOR ECU_ADDRESS 0xd000cf78 BIT_MASK 0x20 /end MEASUREMENT
/begin MEASUREMENT St_oznivdl0.B_ozlangmw "Bedingung Langzeit-Mittelwert berechnet" UBYTE _CNV_S_2_Def_bit_ub_563_CM 1 100. 0. 1. DISPLAY_IDENTIFIER B_OZLANGMW ECU_ADDRESS 0xd000cf78 BIT_MASK 0x4 /end MEASUREMENT
/begin MEASUREMENT St_oznivdl0.B_ozluft "Umgebungsluftdruck plausibel / Steigungserkennung aktiv" UBYTE _CNV_S_2_Def_bit_ub_563_CM 1 100. 0. 1. DISPLAY_IDENTIFIER B_OZLUFT ECU_ADDRESS 0xd000cf78 BIT_MASK 0x40 /end MEASUREMENT
/begin MEASUREMENT St_oznivdl0.B_oznivb "Keine Beschleunigungsausblendung (bei false ausgeblendet)" UBYTE _CNV_S_2_Def_bit_ub_563_CM 1 100. 0. 1. DISPLAY_IDENTIFIER B_OZNIVB ECU_ADDRESS 0xd000cf78 BIT_MASK 0x1 /end MEASUREMENT
/begin MEASUREMENT St_oznivdl0.B_ozor "Bedingung Orientierungsmessung erfolgt" UBYTE _CNV_S_2_Def_bit_ub_563_CM 1 100. 0. 1. DISPLAY_IDENTIFIER B_OZOR ECU_ADDRESS 0xd000cf78 BIT_MASK 0x8 /end MEASUREMENT
/begin MEASUREMENT St_oznivdl0.B_ozpoelnl "Ölpumpe im Notlauf" UBYTE _CNV_S_2_Def_bit_ub_563_CM 1 100. 0. 1. DISPLAY_IDENTIFIER B_OZPOELNL ECU_ADDRESS 0xd000cf78 BIT_MASK 0x80 /end MEASUREMENT
/begin MEASUREMENT St_oznivdl0.B_ozvormw "Bedingung vorgezogener Mittelwert berechnet" UBYTE _CNV_S_2_Def_bit_ub_563_CM 1 100. 0. 1. DISPLAY_IDENTIFIER B_OZVORMW ECU_ADDRESS 0xd000cf78 BIT_MASK 0x10 /end MEASUREMENT
/begin MEASUREMENT St_oznivdl1 "Statuswort" UBYTE _CNV_R_R_Def_dez_sl_551_CM 1 100. 0. 255. DISPLAY_IDENTIFIER ST_OZNIVDL1 ECU_ADDRESS 0xd000cf79 FORMAT "%3.0" /end MEASUREMENT
/begin MEASUREMENT St_oznivdl1.B_ozfahrt "Das Fahrzeug hat sich bewegt" UBYTE _CNV_S_2_Def_bit_ub_563_CM 1 100. 0. 1. DISPLAY_IDENTIFIER B_OZFAHRT ECU_ADDRESS 0xd000cf79 BIT_MASK 0x10 /end MEASUREMENT
/begin MEASUREMENT St_oznivdl1.B_ozkrzkor2 "Ein Mittelwert von zwei KurzMw ist da" UBYTE _CNV_S_2_Def_bit_ub_563_CM 1 100. 0. 1. DISPLAY_IDENTIFIER B_OZKRZKOR2 ECU_ADDRESS 0xd000cf79 BIT_MASK 0x1 /end MEASUREMENT
/begin MEASUREMENT St_oznivdl1.B_ozkrzkornb "Bedingung drehzahlkorrigierter Kurzzeit Niveaumittelwert und nicht drehzahlbegrenzt berechnet" UBYTE _CNV_S_2_Def_bit_ub_563_CM 1 100. 0. 1. DISPLAY_IDENTIFIER B_OZKRZKORNB ECU_ADDRESS 0xd000cf79 BIT_MASK 0x2 /end MEASUREMENT
/begin MEASUREMENT St_oznivdl1.B_ozml "Anforderung Messung läuft" UBYTE _CNV_S_2_Def_bit_ub_563_CM 1 100. 0. 1. DISPLAY_IDENTIFIER B_OZML ECU_ADDRESS 0xd000cf79 BIT_MASK 0x40 /end MEASUREMENT
/begin MEASUREMENT St_oznivdl1.B_ozmreset "Reset der Messungen (beim INI2-Sprung)" UBYTE _CNV_S_2_Def_bit_ub_563_CM 1 100. 0. 1. DISPLAY_IDENTIFIER B_OZMRESET ECU_ADDRESS 0xd000cf79 BIT_MASK 0x80 /end MEASUREMENT
/begin MEASUREMENT St_oznivdl1.B_ozoelcheck "Ölcheck (Zündung an Motor aus) läuft gerade" UBYTE _CNV_S_2_Def_bit_ub_563_CM 1 100. 0. 1. DISPLAY_IDENTIFIER B_OZOELCHECK ECU_ADDRESS 0xd000cf79 BIT_MASK 0x4 /end MEASUREMENT
/begin MEASUREMENT St_oznivdl1.B_ozoelchok "Ölcheck OK" UBYTE _CNV_S_2_Def_bit_ub_563_CM 1 100. 0. 1. DISPLAY_IDENTIFIER B_OZOELCHOK ECU_ADDRESS 0xd000cf79 BIT_MASK 0x8 /end MEASUREMENT
/begin MEASUREMENT St_oznivdl1.B_ozueberf "Überfüllung entdeckt" UBYTE _CNV_S_2_Def_bit_ub_563_CM 1 100. 0. 1. DISPLAY_IDENTIFIER B_OZUEBERF ECU_ADDRESS 0xd000cf79 BIT_MASK 0x20 /end MEASUREMENT
/begin MEASUREMENT St_oznivdl_nv0 "Statuswort" UBYTE _CNV_R_R_Def_dez_sl_551_CM 1 100. 0. 255. DISPLAY_IDENTIFIER ST_OZNIVDL_NV0 ECU_ADDRESS 0xc00040b8 FORMAT "%3.0" /end MEASUREMENT
/begin MEASUREMENT St_oznivdl_nv0.B_ozabzlang "Abstellzeit zu lang für die Anzeige des letzten Wertes" UBYTE _CNV_S_2_Def_bit_ub_563_CM 1 100. 0. 1. DISPLAY_IDENTIFIER B_OZABZLANG ECU_ADDRESS 0xc00040b8 BIT_MASK 0x20 /end MEASUREMENT
/begin MEASUREMENT St_oznivdl_nv0.B_ozlmwneu "Langzeit-Mittelwert berechnet in der letzten Fahrt" UBYTE _CNV_S_2_Def_bit_ub_563_CM 1 100. 0. 1. DISPLAY_IDENTIFIER B_OZLMWNEU ECU_ADDRESS 0xc00040b8 BIT_MASK 0x4 /end MEASUREMENT
/begin MEASUREMENT St_oznivdl_nv0.B_ozlw1 "Aus Kompatibilitätsgründen" UBYTE _CNV_S_2_Def_bit_ub_563_CM 1 100. 0. 1. DISPLAY_IDENTIFIER B_OZLW1 ECU_ADDRESS 0xc00040b8 BIT_MASK 0x1 /end MEASUREMENT
/begin MEASUREMENT St_oznivdl_nv0.B_oznachf "Nachfüllung erkannt" UBYTE _CNV_S_2_Def_bit_ub_563_CM 1 100. 0. 1. DISPLAY_IDENTIFIER B_OZNACHF ECU_ADDRESS 0xc00040b8 BIT_MASK 0x8 /end MEASUREMENT
/begin MEASUREMENT St_oznivdl_nv0.B_ozoelwech "Ölwechsel für die Peilstabanzeige" UBYTE _CNV_S_2_Def_bit_ub_563_CM 1 100. 0. 1. DISPLAY_IDENTIFIER B_OZOELWECH ECU_ADDRESS 0xc00040b8 BIT_MASK 0x10 /end MEASUREMENT
/begin MEASUREMENT St_rennst "Status Rennstart" UBYTE _CNV_R_R_Def_dez_sl_551_CM 1 100. 0. 255. DISPLAY_IDENTIFIER ST_RENNST ECU_ADDRESS 0xd000e16c FORMAT "%3.0" /end MEASUREMENT
/begin MEASUREMENT St_rennst.B_genoffvl_lem "Bed Generatorausschaltung bei Volllast" UBYTE _CNV_S_2_Def_bit_ub_563_CM 1 100. 0. 1. DISPLAY_IDENTIFIER B_GENOFFVL_LEM ECU_ADDRESS 0xd000e16c BIT_MASK 0x20 /end MEASUREMENT
/begin MEASUREMENT St_rennst.B_genvloffla "Bed Flanke Generatorausschaltung" UBYTE _CNV_S_2_Def_bit_ub_563_CM 1 100. 0. 1. DISPLAY_IDENTIFIER B_GENVLOFFLA ECU_ADDRESS 0xd000e16c BIT_MASK 0x40 /end MEASUREMENT
/begin MEASUREMENT St_rennst.B_renn_ber "Status Rennstart" UBYTE _CNV_S_2_Def_bit_ub_563_CM 1 100. 0. 1. DISPLAY_IDENTIFIER B_RENN_BER ECU_ADDRESS 0xd000e16c BIT_MASK 0x1 /end MEASUREMENT
/begin MEASUREMENT St_rennst.B_renn_berold "Bedingung" UBYTE _CNV_S_2_Def_bit_ub_563_CM 1 100. 0. 1. DISPLAY_IDENTIFIER B_RENN_BEROLD ECU_ADDRESS 0xd000e16c BIT_MASK 0x8 /end MEASUREMENT
/begin MEASUREMENT St_rennst.B_rennstart "Bed Rennstart" UBYTE _CNV_S_2_Def_bit_ub_563_CM 1 100. 0. 1. DISPLAY_IDENTIFIER B_RENNSTART ECU_ADDRESS 0xd000e16c BIT_MASK 0x2 /end MEASUREMENT
/begin MEASUREMENT St_rennst.B_rennstartold "Bed Rennstart alt" UBYTE _CNV_S_2_Def_bit_ub_563_CM 1 100. 0. 1. DISPLAY_IDENTIFIER B_RENNSTARTOLD ECU_ADDRESS 0xd000e16c BIT_MASK 0x4 /end MEASUREMENT
/begin MEASUREMENT St_rennst.B_vl_verz "verzögertes B_vl" UBYTE _CNV_S_2_Def_bit_ub_563_CM 1 100. 0. 1. DISPLAY_IDENTIFIER B_VL_VERZ ECU_ADDRESS 0xd000e16c BIT_MASK 0x80 /end MEASUREMENT
/begin MEASUREMENT St_statmkor "Statuswort" UBYTE _CNV_R_R_Def_dez_sl_551_CM 1 100. 0. 255. DISPLAY_IDENTIFIER ST_STATMKOR ECU_ADDRESS 0xd000e134 FORMAT "%3.0" /end MEASUREMENT
/begin MEASUREMENT St_statmkor.B_grenz_stat "Bedingung" UBYTE _CNV_S_2_Def_bit_ub_563_CM 1 100. 0. 1. DISPLAY_IDENTIFIER B_GRENZ_STAT ECU_ADDRESS 0xd000e134 BIT_MASK 0x2 /end MEASUREMENT
/begin MEASUREMENT St_statmkor.B_kk_off "Bed KK aus" UBYTE _CNV_S_2_Def_bit_ub_563_CM 1 100. 0. 1. DISPLAY_IDENTIFIER B_KK_OFF ECU_ADDRESS 0xd000e134 BIT_MASK 0x1 /end MEASUREMENT
/begin MEASUREMENT St_statmkor.B_mdentlu "Bedingung" UBYTE _CNV_S_2_Def_bit_ub_563_CM 1 100. 0. 1. DISPLAY_IDENTIFIER B_MDENTLU ECU_ADDRESS 0xd000e134 BIT_MASK 0x4 /end MEASUREMENT
/begin MEASUREMENT St_statmkor1 "Statuswort" UBYTE _CNV_R_R_Def_dez_sl_551_CM 1 100. 0. 255. DISPLAY_IDENTIFIER ST_STATMKOR1 ECU_ADDRESS 0xd000e128 FORMAT "%3.0" /end MEASUREMENT
/begin MEASUREMENT St_statmkor1.B_notafu "Bed Notanfahrunterstützung" UBYTE _CNV_S_2_Def_bit_ub_563_CM 1 100. 0. 1. DISPLAY_IDENTIFIER B_NOTAFU ECU_ADDRESS 0xd000e128 BIT_MASK 0x1 /end MEASUREMENT
/begin MEASUREMENT St_wese "Statuswort WESE" UBYTE _CNV_R_R_Def_dez_sl_551_CM 1 100. 0. 255. DISPLAY_IDENTIFIER ST_WESE ECU_ADDRESS 0xd000d6fc FORMAT "%3.0" /end MEASUREMENT
/begin MEASUREMENT St_wese.B_tesmin12 "Begrenzung Abstand zwischen 1. und 2. Einspritzung aktiv" UBYTE _CNV_S_2_Def_bit_ub_563_CM 1 100. 0. 1. DISPLAY_IDENTIFIER B_TESMIN12 ECU_ADDRESS 0xd000d6fc BIT_MASK 0x2 /end MEASUREMENT
/begin MEASUREMENT St_wese.B_wese2h_abs "Statuswort WESE" UBYTE _CNV_S_2_Def_bit_ub_563_CM 1 100. 0. 1. DISPLAY_IDENTIFIER B_WESE2H_ABS ECU_ADDRESS 0xd000d6fc BIT_MASK 0x1 /end MEASUREMENT
/begin MEASUREMENT T_es12_hs "(homogen-schicht)" UWORD _CNV_R_R_Def_td_sw__601_CM 1 100. 0. 262.14 DISPLAY_IDENTIFIER T_ES12_HS ECU_ADDRESS 0xd000d7a6 FORMAT "%7.2" /end MEASUREMENT
/begin MEASUREMENT T_es12_s "(schicht)" UWORD _CNV_R_R_Def_td_sw__601_CM 1 100. 0. 262.14 DISPLAY_IDENTIFIER T_ES12_S ECU_ADDRESS 0xd000d7a2 FORMAT "%7.2" /end MEASUREMENT
/begin MEASUREMENT T_mdnal "Zeit bis Momentenentlastung greift" UBYTE _CNV_R_R_Def_t_ub_b_713_CM 1 100. 0. 1.9921 DISPLAY_IDENTIFIER T_MDNAL ECU_ADDRESS 0xd000e14f /end MEASUREMENT
/begin MEASUREMENT T_mdnas "Zeit bis Momentenentlastung greift" UBYTE _CNV_R_R_Def_t_ub_b_713_CM 1 100. 0. 1.9921 DISPLAY_IDENTIFIER T_MDNAS ECU_ADDRESS 0xd000e14e /end MEASUREMENT
/begin MEASUREMENT T_renn_akt "Zeit in der der Rennstart aktiv ist" UWORD _CNV_R_R_Def_td_ub__574_CM 1 100. 0. 6553.5 DISPLAY_IDENTIFIER T_RENN_AKT ECU_ADDRESS 0xd000e172 FORMAT "%6.1" /end MEASUREMENT
/begin MEASUREMENT T_v_renn "Zeit die von B_bls == true bis V != 0 vergehen darf" UBYTE _CNV_R_R_Def_td_ub__574_CM 1 100. 0. 25.5 DISPLAY_IDENTIFIER T_V_RENN ECU_ADDRESS 0xd000e170 FORMAT "%4.1" /end MEASUREMENT
/begin MEASUREMENT Td_afu "Ausschaltverzögerung B_notafu" UWORD _CNV_R_R_Def_td_uw__673_CM 1 100. 0. 655.35 DISPLAY_IDENTIFIER TD_AFU ECU_ADDRESS 0xd000e12c FORMAT "%7.2" /end MEASUREMENT
/begin MEASUREMENT Td_genbvl "Verzögerungszeit Volllast" UWORD _CNV_R_R_Def_td_ub__574_CM 1 100. 0. 6553.5 DISPLAY_IDENTIFIER TD_GENBVL ECU_ADDRESS 0xd000e178 FORMAT "%6.1" /end MEASUREMENT
/begin MEASUREMENT Td_genofvl "Verzögerungszeit Generatorvolllastabschaltung" UWORD _CNV_R_R_Def_td_ub__574_CM 1 100. 0. 6553.5 DISPLAY_IDENTIFIER TD_GENOFVL ECU_ADDRESS 0xd000e176 FORMAT "%6.1" /end MEASUREMENT
/begin MEASUREMENT Td_getriebe "Entprellzeit Gangwechsel aus N" UBYTE _CNV_R_R_Def_td_uw__673_CM 1 100. 0. 2.55 DISPLAY_IDENTIFIER TD_GETRIEBE ECU_ADDRESS 0xd000e150 FORMAT "%5.2" /end MEASUREMENT
/begin MEASUREMENT Td_kkoff "Erlaubte Dauer der KK-Abkopplung aus Pr_mdkomf und Pr_mdfunk" UWORD _CNV_R_R_Def_td_uw__673_CM 1 100. 0. 655.35 DISPLAY_IDENTIFIER TD_KKOFF ECU_ADDRESS 0xd000e11a FORMAT "%7.2" /end MEASUREMENT
/begin MEASUREMENT Td_kkoff_sich "Erlaubte Dauer der KK-Abkopplung" UWORD _CNV_R_R_Def_td_uw__673_CM 1 100. 0. 655.35 DISPLAY_IDENTIFIER TD_KKOFF_SICH ECU_ADDRESS 0xd000e118 FORMAT "%7.2" /end MEASUREMENT
/begin MEASUREMENT Td_mdent_funkres "Verzögerungszeit" UWORD _CNV_R_R_Def_td_uw__673_CM 1 100. 0. 655.35 DISPLAY_IDENTIFIER TD_MDENT_FUNKRES ECU_ADDRESS 0xd000e120 FORMAT "%7.2" /end MEASUREMENT
/begin MEASUREMENT Td_mdent_kkres "Verzögerungszeit" UWORD _CNV_R_R_Def_td_uw__673_CM 1 100. 0. 655.35 DISPLAY_IDENTIFIER TD_MDENT_KKRES ECU_ADDRESS 0xd000e11e FORMAT "%7.2" /end MEASUREMENT
/begin MEASUREMENT Td_mdent_komfres "Verzögerungszeit" UWORD _CNV_R_R_Def_td_uw__673_CM 1 100. 0. 655.35 DISPLAY_IDENTIFIER TD_MDENT_KOMFRES ECU_ADDRESS 0xd000e122 FORMAT "%7.2" /end MEASUREMENT
/begin MEASUREMENT Td_mdent_komfset "Verzögerungszeit" UWORD _CNV_R_R_Def_td_uw__673_CM 1 100. 0. 655.35 DISPLAY_IDENTIFIER TD_MDENT_KOMFSET ECU_ADDRESS 0xd000e124 FORMAT "%7.2" /end MEASUREMENT
/begin MEASUREMENT Td_mdent_sichres "Verzögerungszeit" UWORD _CNV_R_R_Def_td_uw__673_CM 1 100. 0. 655.35 DISPLAY_IDENTIFIER TD_MDENT_SICHRES ECU_ADDRESS 0xd000e11c FORMAT "%7.2" /end MEASUREMENT
/begin MEASUREMENT Td_renn "Verzögerungszeit Rennstartbereitschaft" UWORD _CNV_R_R_Def_td_ub__574_CM 1 100. 0. 6553.5 DISPLAY_IDENTIFIER TD_RENN ECU_ADDRESS 0xd000e174 FORMAT "%6.1" /end MEASUREMENT
/begin MEASUREMENT Td_wese "Zeitabstände zwischen Einspritzung schicht zylinderindividuell" UWORD _CNV_R_R_Def_td_sw__601_CM 1 100. 0. 262.14 DISPLAY_IDENTIFIER TD_WESE ECU_ADDRESS 0xd000d710 FORMAT "%7.2" ARRAY_SIZE 8 MATRIX_DIM 8 1 1 /end MEASUREMENT
/begin MEASUREMENT Tlrgen "Sollwert Load- Response- Zeit Generator" UBYTE _CNV_R_R_Def_td_ub__574_CM 1 100. 0. 25.5 DISPLAY_IDENTIFIER TLRGEN ECU_ADDRESS 0xc0000e19 FORMAT "%4.1" /end MEASUREMENT
/begin MEASUREMENT Tlrgen2 "Sollwert Load- Response- Zeit Generator2" UBYTE _CNV_R_R_Def_td_ub__574_CM 1 100. 0. 25.5 DISPLAY_IDENTIFIER TLRGEN2 ECU_ADDRESS 0xc0000e1a FORMAT "%4.1" /end MEASUREMENT
/begin MEASUREMENT U_entl_soll "Spannungsanforderung für Generatorentlastung" UBYTE _CNV_R_R_Def_u_ub_q_631_CM 1 100. 0. 25.5 DISPLAY_IDENTIFIER U_ENTL_SOLL ECU_ADDRESS 0xd000e12b FORMAT "%5.2" /end MEASUREMENT
/begin MEASUREMENT Var_afs "Variante AFS" UBYTE _CNV_R_R_Def_dez_sl_551_CM 1 100. 0. 255. DISPLAY_IDENTIFIER VAR_AFS ECU_ADDRESS 0xd000e13c FORMAT "%3.0" /end MEASUREMENT
/begin MEASUREMENT Var_ars "Variante ARS" UBYTE _CNV_R_R_Def_dez_sl_551_CM 1 100. 0. 255. DISPLAY_IDENTIFIER VAR_ARS ECU_ADDRESS 0xd000e13d FORMAT "%3.0" /end MEASUREMENT
/begin MEASUREMENT Wes "Winkel Einlaß schließt bezogen auf ZOT" SWORD _CNV_R_R_Def_kw_sw__603_CM 1 100. -768. 767.9765 DISPLAY_IDENTIFIER WES ECU_ADDRESS 0xc0000e54 FORMAT "%8.3" /end MEASUREMENT
/begin MEASUREMENT Wesb1_bas_h "Einspritzbeginnwinkel 1. Einspritzung für Basisbetrieb" SWORD _CNV_R_R_Def_kw_sw__603_CM 1 100. -768. 767.9765 DISPLAY_IDENTIFIER WESB1_BAS_H ECU_ADDRESS 0xd000d796 FORMAT "%8.3" /end MEASUREMENT
/begin MEASUREMENT Wesb1_h "Einspritzbeginnwinkel 1. Einspritzung Homogen" SWORD _CNV_R_R_Def_kw_sw__603_CM 1 100. -768. 767.9765 DISPLAY_IDENTIFIER WESB1_H ECU_ADDRESS 0xd000d720 FORMAT "%8.3" ARRAY_SIZE 8 MATRIX_DIM 8 1 1 /end MEASUREMENT
/begin MEASUREMENT Wesb1_hs "Einspritzbeginnwinkel 1. Einspritzung Homogenschicht" SWORD _CNV_R_R_Def_kw_sw__603_CM 1 100. -768. 767.9765 DISPLAY_IDENTIFIER WESB1_HS ECU_ADDRESS 0xd000d760 FORMAT "%8.3" ARRAY_SIZE 8 MATRIX_DIM 8 1 1 /end MEASUREMENT
/begin MEASUREMENT Wesb2min_h "frühest möglicher Einspritzwinkel f. 2te Einspritzung" SWORD _CNV_R_R_Def_kw_sw__603_CM 1 100. -768. 767.9765 DISPLAY_IDENTIFIER WESB2MIN_H ECU_ADDRESS 0xd000d790 FORMAT "%8.3" /end MEASUREMENT
/begin MEASUREMENT Wesb3_kh_s "Einspritzbeginn 3. Einspritzung für KH" SWORD _CNV_R_R_Def_kw_sw__603_CM 1 100. -768. 767.9765 DISPLAY_IDENTIFIER WESB3_KH_S ECU_ADDRESS 0xd000d794 FORMAT "%8.3" /end MEASUREMENT
/begin MEASUREMENT Wesb3_s "Einspritzbeginnwinkel 3. Einspritzung Schicht" SWORD _CNV_R_R_Def_kw_sw__603_CM 1 100. -768. 767.9765 DISPLAY_IDENTIFIER WESB3_S ECU_ADDRESS 0xd000d750 FORMAT "%8.3" ARRAY_SIZE 8 MATRIX_DIM 8 1 1 /end MEASUREMENT
/begin MEASUREMENT Wesbst_h "Einspritzbeginnwinkel 1. Einspritzung Start" SWORD _CNV_R_R_Def_kw_sw__603_CM 1 100. -768. 767.9765 DISPLAY_IDENTIFIER WESBST_H ECU_ADDRESS 0xd000d798 FORMAT "%8.3" /end MEASUREMENT
/begin MEASUREMENT Wese2_bas_h "Einspritzendewinkel 2. Einspritzung Homogen" SWORD _CNV_R_R_Def_kw_sw__603_CM 1 100. -768. 767.9765 DISPLAY_IDENTIFIER WESE2_BAS_H ECU_ADDRESS 0xd000d792 FORMAT "%8.3" /end MEASUREMENT
/begin MEASUREMENT Wese2_h "Einspritzendewinkel 2. Einspritzung Homogen" SWORD _CNV_R_R_Def_kw_sw__603_CM 1 100. -768. 767.9765 DISPLAY_IDENTIFIER WESE2_H ECU_ADDRESS 0xd000d730 FORMAT "%8.3" ARRAY_SIZE 8 MATRIX_DIM 8 1 1 /end MEASUREMENT
/begin MEASUREMENT Wese2_hs "(homogen-schicht)" SWORD _CNV_R_R_Def_kw_sw__603_CM 1 100. -768. 767.9765 DISPLAY_IDENTIFIER WESE2_HS ECU_ADDRESS 0xd000d770 FORMAT "%8.3" ARRAY_SIZE 8 MATRIX_DIM 8 1 1 /end MEASUREMENT
/begin MEASUREMENT Wese2_s "(schicht)" SWORD _CNV_R_R_Def_kw_sw__603_CM 1 100. -768. 767.9765 DISPLAY_IDENTIFIER WESE2_S ECU_ADDRESS 0xd000d7a0 FORMAT "%8.3" /end MEASUREMENT
/begin MEASUREMENT Wese3_h "Einspritzendewinkel 3te Einspritzung" SWORD _CNV_R_R_Def_kw_sw__603_CM 1 100. -768. 767.9765 DISPLAY_IDENTIFIER WESE3_H ECU_ADDRESS 0xd000d780 FORMAT "%8.3" ARRAY_SIZE 8 MATRIX_DIM 8 1 1 /end MEASUREMENT
/begin MEASUREMENT Wese_s "Einspritzende Haupteinspritzung zylinderindivduell" SWORD _CNV_R_R_Def_kw_sw__603_CM 1 100. -768. 767.9765 DISPLAY_IDENTIFIER WESE_S ECU_ADDRESS 0xd000d700 FORMAT "%8.3" ARRAY_SIZE 8 MATRIX_DIM 8 1 1 /end MEASUREMENT
/begin MEASUREMENT Wesnesprau "Winkel Einlaß schließt ahängig vom Hub" SWORD _CNV_R_R_Def_kw_sw__603_CM 1 100. -768. 767.9765 DISPLAY_IDENTIFIER WESNESPRAU ECU_ADDRESS 0xc0000e56 FORMAT "%8.3" /end MEASUREMENT
/begin MEASUREMENT Z_dmdblock "Kein Langbezeichner vergeben" UBYTE _CNV_R_R_Def_dez_sl_551_CM 1 100. 0. 255. DISPLAY_IDENTIFIER Z_DMDBLOCK ECU_ADDRESS 0xc00047b0 FORMAT "%3.0" /end MEASUREMENT
/begin MEASUREMENT Zk_eta "Zeitkonstante zur Filterung von Eta_ges" UWORD _CNV_R_R_Def_f_uw_b_555_CM 1 100. 0. 99.9984 DISPLAY_IDENTIFIER ZK_ETA ECU_ADDRESS 0xd000ddd4 FORMAT "%8.3" /end MEASUREMENT
/begin MEASUREMENT Zr_rennstart "Zähler Rennstart" UBYTE _CNV_R_R_Def_dez_sl_551_CM 1 100. 0. 255. DISPLAY_IDENTIFIER ZR_RENNSTART ECU_ADDRESS 0xc00047b4 FORMAT "%3.0" /end MEASUREMENT
/begin MEASUREMENT w_klbias1 "Gewichte KLANN, Biasterm" FLOAT32_IEEE _CNV_R_R_Def_dez_sl_551_CM 1 100. -1000000000000. 10000000000000. DISPLAY_IDENTIFIER W_KLBIAS1 ECU_ADDRESS 0xc00047b8 FORMAT "%14.7" ARRAY_SIZE 15 MATRIX_DIM 15 1 1 /end MEASUREMENT
/begin MEASUREMENT w_klbias2 "Gewichte KLANN, Biasterm" FLOAT32_IEEE _CNV_R_R_Def_dez_sl_551_CM 1 100. -1000000000000. 10000000000000. DISPLAY_IDENTIFIER W_KLBIAS2 ECU_ADDRESS 0xc00048a8 FORMAT "%14.7" ARRAY_SIZE 15 MATRIX_DIM 15 1 1 /end MEASUREMENT
/begin MEASUREMENT w_klnkw1 "Gewichte KLANN, Nkw-Eingang" FLOAT32_IEEE _CNV_R_R_Def_dez_sl_551_CM 1 100. -1000000000000. 10000000000000. DISPLAY_IDENTIFIER W_KLNKW1 ECU_ADDRESS 0xc00047f4 FORMAT "%14.7" ARRAY_SIZE 15 MATRIX_DIM 15 1 1 /end MEASUREMENT
/begin MEASUREMENT w_klnkw2 "Gewichte KLANN, Nkw-Eingang" FLOAT32_IEEE _CNV_R_R_Def_dez_sl_551_CM 1 100. -1000000000000. 10000000000000. DISPLAY_IDENTIFIER W_KLNKW2 ECU_ADDRESS 0xc00048e4 FORMAT "%14.7" ARRAY_SIZE 15 MATRIX_DIM 15 1 1 /end MEASUREMENT
/begin MEASUREMENT w_klrk1 "Gewichte KLANN, Rk-Eingang" FLOAT32_IEEE _CNV_R_R_Def_dez_sl_551_CM 1 100. -1000000000000. 10000000000000. DISPLAY_IDENTIFIER W_KLRK1 ECU_ADDRESS 0xc0004830 FORMAT "%14.7" ARRAY_SIZE 15 MATRIX_DIM 15 1 1 /end MEASUREMENT
/begin MEASUREMENT w_klrk2 "Gewichte KLANN, Rk-Eingang" FLOAT32_IEEE _CNV_R_R_Def_dez_sl_551_CM 1 100. -1000000000000. 10000000000000. DISPLAY_IDENTIFIER W_KLRK2 ECU_ADDRESS 0xc0004920 FORMAT "%14.7" ARRAY_SIZE 15 MATRIX_DIM 15 1 1 /end MEASUREMENT
/begin MEASUREMENT w_kltmot1 "Gewichte KLANN, Tmot-Eingang" FLOAT32_IEEE _CNV_R_R_Def_dez_sl_551_CM 1 100. -1000000000000. 10000000000000. DISPLAY_IDENTIFIER W_KLTMOT1 ECU_ADDRESS 0xc000486c FORMAT "%14.7" ARRAY_SIZE 15 MATRIX_DIM 15 1 1 /end MEASUREMENT
/begin MEASUREMENT w_kltmot2 "Gewichte KLANN, Tmot-Eingang" FLOAT32_IEEE _CNV_R_R_Def_dez_sl_551_CM 1 100. -1000000000000. 10000000000000. DISPLAY_IDENTIFIER W_KLTMOT2 ECU_ADDRESS 0xc000495c FORMAT "%14.7" ARRAY_SIZE 15 MATRIX_DIM 15 1 1 /end MEASUREMENT
/begin CHARACTERISTIC CW_BNS_LR "Codewort zur Einrechnung Bordnetzstabilität in Loadresponse" VALUE 0xa082bd12 _REC_VAL_20_u1 1. _CNV_R_R_Def_dez_sl_551_CM 0. 1. FORMAT "%3.0" /end CHARACTERISTIC
/begin CHARACTERISTIC CW_NA_KONF "Konfiguration schnelle/langsame Entlastung" VALUE 0xa082be75 _REC_VAL_20_u1 99.45 _CNV_R_R_Def_dez_sl_551_CM 0. 255. FORMAT "%3.0" /end CHARACTERISTIC
/begin CHARACTERISTIC KF_DLAWUP "Kennlinie Differenzlambda Warmlauf" MAP 0xa0827664 _REC_MAP_52_UBYTE_s2_u2_s2 15.9997 _CNV_R_R_Def_f_sw_b_592_CM -8. 7.9997 FORMAT "%7.4"
 /begin AXIS_DESCR STD_AXIS Zr_zyk_nstart _CNV_R_R_Def_dez_sl_551_CM 16 0. 65535. FORMAT "%5.0" /end AXIS_DESCR
 /begin AXIS_DESCR STD_AXIS Tmot _CNV_R_R_Def_t_sw_q_579_CM 10 -327.68 327.67 FORMAT "%5.2" /end AXIS_DESCR
/end CHARACTERISTIC
/begin CHARACTERISTIC KF_DLAWUP_ZSK "Kenlinie Differenzlambda Warmlauf Zylinderselektive Gleichstellung Kalt" MAP 0xa0827840 _REC_MAP_52_UBYTE_s2_u2_s2 15.9997 _CNV_R_R_Def_f_sw_b_592_CM -8. 7.9997 FORMAT "%7.4"
 /begin AXIS_DESCR STD_AXIS Zr_zyk_nstart _CNV_R_R_Def_dez_sl_551_CM 16 0. 65535. FORMAT "%5.0" /end AXIS_DESCR
 /begin AXIS_DESCR STD_AXIS Tmot _CNV_R_R_Def_t_sw_q_579_CM 10 -327.68 327.67 FORMAT "%5.2" /end AXIS_DESCR
/end CHARACTERISTIC
/begin CHARACTERISTIC KF_DLA_UESP "Grund-Kennfeld zur Berechnung Dla_uesp" MAP 0xa08277dc _REC_MAP_52_UBYTE_s2_s2_s2 15.9997 _CNV_R_R_Def_f_sw_b_592_CM -8. 7.9997 FORMAT "%7.4"
 /begin AXIS_DESCR STD_AXIS Nkw _CNV_R_R_Def_n_sw_q_595_CM 6 -32768. 32767. FORMAT "%5.0" /end AXIS_DESCR
 /begin AXIS_DESCR STD_AXIS Rf _CNV_R_R_Def_rf_sw__598_CM 6 -327.68 327.67 FORMAT "%7.4" /end AXIS_DESCR
/end CHARACTERISTIC
/begin CHARACTERISTIC KF_DTES12_S "Korrektur Einspritzabstand 1. 2. Einspritzung in S" MAP 0xa0821dd8 _REC_MAP_52_UBYTE_s2_s2_s2 99.61320000000001 _CNV_R_R_Def_td_sw__601_CM -131.072 131.068
 /begin AXIS_DESCR STD_AXIS Nkw _CNV_R_R_Def_n_sw_q_595_CM 6 -32768. 32767. FORMAT "%5.0" /end AXIS_DESCR
 /begin AXIS_DESCR STD_AXIS Drfopt_s _CNV_R_R_Def_eta_sw_599_CM 4 -200. 199.9938 /end AXIS_DESCR
/end CHARACTERISTIC
/begin CHARACTERISTIC KF_DWESEST_H "(homogen)" MAP 0xa0821cb8 _REC_MAP_52_UBYTE_s2_s2_s2 107.518355 _CNV_R_R_Def_kw_sw__603_CM -768. 767.9765
 /begin AXIS_DESCR STD_AXIS Nkw _CNV_R_R_Def_n_sw_q_595_CM 10 -32768. 32767. FORMAT "%5.0" /end AXIS_DESCR
 /begin AXIS_DESCR STD_AXIS Tmot _CNV_R_R_Def_t_sw_q_579_CM 12 -327.68 327.67 FORMAT "%5.2" /end AXIS_DESCR
/end CHARACTERISTIC
/begin CHARACTERISTIC KF_DWESE_HS "Deltawinkel auf Zündwinkel für Haupteinspritzung DI (homogen-schicht)" MAP 0xa0820a0c _REC_MAP_52_UBYTE_s2_s2_s2 107.518355 _CNV_R_R_Def_kw_sw__603_CM -768. 767.9765
 /begin AXIS_DESCR STD_AXIS Nkw _CNV_R_R_Def_n_sw_q_595_CM 16 -32768. 32767. FORMAT "%5.0" /end AXIS_DESCR
 /begin AXIS_DESCR STD_AXIS Rk_soll_s _CNV_R_R_Def_rk_sw__600_CM 16 -1600. 1599.9511 /end AXIS_DESCR
/end CHARACTERISTIC
/begin CHARACTERISTIC KF_DWESE_S "Deltawinkel auf Zündwinkel für Haupteinspritzung DI (schicht)" MAP 0xa08207c8 _REC_MAP_52_UBYTE_s2_s2_s2 107.518355 _CNV_R_R_Def_kw_sw__603_CM -768. 767.9765
 /begin AXIS_DESCR STD_AXIS Nkw _CNV_R_R_Def_n_sw_q_595_CM 16 -32768. 32767. FORMAT "%5.0" /end AXIS_DESCR
 /begin AXIS_DESCR STD_AXIS Rk_soll_s _CNV_R_R_Def_rk_sw__600_CM 16 -1600. 1599.9511 /end AXIS_DESCR
/end CHARACTERISTIC
/begin CHARACTERISTIC KF_FLRADAP_MN "Minimale Grenze zum Sperren der Adaption" MAP 0xa082ea78 _REC_MAP_52_UBYTE_s2_s2_u2 99.9984 _CNV_R_R_Def_f_sw_q_550_CM -50. 49.9984 FORMAT "%7.4"
 /begin AXIS_DESCR STD_AXIS Nkw _CNV_R_R_Def_n_sw_q_595_CM 8 -32768. 32767. FORMAT "%5.0" /end AXIS_DESCR
 /begin AXIS_DESCR STD_AXIS NO_INPUT_QUANTITY _CNV_R_R_Def_f_uw_b_588_CM 8 0. 31.9995 FORMAT "%7.4" /end AXIS_DESCR
/end CHARACTERISTIC
/begin CHARACTERISTIC KF_FLRADAP_MX "Maximale Grenze zum Sperren der Adaption" MAP 0xa082eb1c _REC_MAP_52_UBYTE_s2_s2_u2 99.9984 _CNV_R_R_Def_f_sw_q_550_CM -50. 49.9984 FORMAT "%7.4"
 /begin AXIS_DESCR STD_AXIS Nkw _CNV_R_R_Def_n_sw_q_595_CM 8 -32768. 32767. FORMAT "%5.0" /end AXIS_DESCR
 /begin AXIS_DESCR STD_AXIS NO_INPUT_QUANTITY _CNV_R_R_Def_f_uw_b_588_CM 8 0. 31.9995 FORMAT "%7.4" /end AXIS_DESCR
/end CHARACTERISTIC
/begin CHARACTERISTIC KF_FWES_H "Ueberblendfaktor Einspritzbeginn 1te und 2te Einspritzung kalt(F=1) warm(F=0)" MAP 0xa08207a4 _REC_MAP_52_u1_u2_s2 1. _CNV_R_R_Def_f_ub_b_619_CM 0. 1.
 /begin AXIS_DESCR STD_AXIS Zr_zyk_nstart _CNV_R_R_Def_dez_sl_551_CM 4 0. 65535. FORMAT "%5.0" /end AXIS_DESCR
 /begin AXIS_DESCR STD_AXIS Tmot _CNV_R_R_Def_t_sw_q_579_CM 4 -327.68 327.67 FORMAT "%5.2" /end AXIS_DESCR
/end CHARACTERISTIC
/begin CHARACTERISTIC KF_KLANN_EPS "Lernfaktor Wichtung KLANN" MAP 0xa082ebc0 _REC_MAP_52_u1_s2_s2 1. _CNV_R_R_Def_f_ub_b_619_CM 0. 1.
 /begin AXIS_DESCR STD_AXIS Nkw _CNV_R_R_Def_n_sw_q_595_CM 8 -32768. 32767. FORMAT "%5.0" /end AXIS_DESCR
 /begin AXIS_DESCR STD_AXIS Rf _CNV_R_R_Def_rf_sw__598_CM 8 -327.68 327.67 FORMAT "%7.4" /end AXIS_DESCR
/end CHARACTERISTIC
/begin CHARACTERISTIC KF_LABAS_1 "Basislambda im Homgenen Bank 1" MAP 0xa0827c18 _REC_MAP_52_UBYTE_u2_s2_s2 15.9997 _CNV_R_R_Def_f_uw_b_559_CM 0. 15.9997 FORMAT "%7.4"
 /begin AXIS_DESCR STD_AXIS Nkw _CNV_R_R_Def_n_sw_q_595_CM 16 -32768. 32767. FORMAT "%5.0" /end AXIS_DESCR
 /begin AXIS_DESCR STD_AXIS Rf _CNV_R_R_Def_rf_sw__598_CM 12 -327.68 327.67 FORMAT "%7.4" /end AXIS_DESCR
/end CHARACTERISTIC
/begin CHARACTERISTIC KF_LABAS_2 "Basislambda im Homgenen Bank 2" MAP 0xa0827a5c _REC_MAP_52_UBYTE_u2_s2_s2 15.9997 _CNV_R_R_Def_f_uw_b_559_CM 0. 15.9997 FORMAT "%7.4"
 /begin AXIS_DESCR STD_AXIS Nkw _CNV_R_R_Def_n_sw_q_595_CM 16 -32768. 32767. FORMAT "%5.0" /end AXIS_DESCR
 /begin AXIS_DESCR STD_AXIS Rf _CNV_R_R_Def_rf_sw__598_CM 12 -327.68 327.67 FORMAT "%7.4" /end AXIS_DESCR
/end CHARACTERISTIC
/begin CHARACTERISTIC KF_LAHOMBAS "Basislambda im Homgen Mager Betrieb" MAP 0xa0827e84 _REC_MAP_52_UBYTE_u2_s2_s2 15.9997 _CNV_R_R_Def_f_uw_b_559_CM 0. 15.9997 FORMAT "%7.4"
 /begin AXIS_DESCR STD_AXIS Nkw _CNV_R_R_Def_n_sw_q_595_CM 8 -32768. 32767. FORMAT "%5.0" /end AXIS_DESCR
 /begin AXIS_DESCR STD_AXIS Mdi_soll_l _CNV_R_R_Def_m_sw_q_554_CM 8 -3276.8 3276.7 FORMAT "%5.2" /end AXIS_DESCR
/end CHARACTERISTIC
/begin CHARACTERISTIC KF_LAINST_NEG "Lambdasollwert instationär negativer Lastsprung" MAP 0xa0827de0 _REC_MAP_52_UBYTE_u2_s2_s2 15.9997 _CNV_R_R_Def_f_uw_b_559_CM 0. 15.9997 FORMAT "%7.4"
 /begin AXIS_DESCR STD_AXIS Nkw _CNV_R_R_Def_n_sw_q_595_CM 8 -32768. 32767. FORMAT "%5.0" /end AXIS_DESCR
 /begin AXIS_DESCR STD_AXIS Mdi_ml_soll _CNV_R_R_Def_m_sw_q_554_CM 8 -3276.8 3276.7 FORMAT "%5.2" /end AXIS_DESCR
/end CHARACTERISTIC
/begin CHARACTERISTIC KF_LAINST_POS "Lambdasollwert instationär positiver Lastsprung" MAP 0xa08279b8 _REC_MAP_52_UBYTE_u2_s2_s2 15.9997 _CNV_R_R_Def_f_uw_b_559_CM 0. 15.9997 FORMAT "%7.4"
 /begin AXIS_DESCR STD_AXIS Nkw _CNV_R_R_Def_n_sw_q_595_CM 8 -32768. 32767. FORMAT "%5.0" /end AXIS_DESCR
 /begin AXIS_DESCR STD_AXIS Mdi_ml_soll _CNV_R_R_Def_m_sw_q_554_CM 8 -3276.8 3276.7 FORMAT "%5.2" /end AXIS_DESCR
/end CHARACTERISTIC
/begin CHARACTERISTIC KF_LORESP "Kennfeld Loadresponse ueber Motordrehzahl und rel. Luftmasse" MAP 0xa082bdd0 _REC_MAP_52_u1_s2_s2 25.5 _CNV_R_R_Def_td_ub__574_CM 0. 25.5 FORMAT "%4.1"
 /begin AXIS_DESCR STD_AXIS Nkw _CNV_R_R_Def_n_sw_q_595_CM 6 -32768. 32767. FORMAT "%5.0" /end AXIS_DESCR
 /begin AXIS_DESCR STD_AXIS Rf _CNV_R_R_Def_rf_sw__598_CM 6 -327.68 327.67 FORMAT "%7.4" /end AXIS_DESCR
/end CHARACTERISTIC
/begin CHARACTERISTIC KF_LORESPKH "Loadresponse bei Kat-Heizen" MAP 0xa082bd50 _REC_MAP_52_u1_s2_s2 25.5 _CNV_R_R_Def_td_ub__574_CM 0. 25.5 FORMAT "%4.1"
 /begin AXIS_DESCR STD_AXIS Nkw _CNV_R_R_Def_n_sw_q_595_CM 6 -32768. 32767. FORMAT "%5.0" /end AXIS_DESCR
 /begin AXIS_DESCR STD_AXIS Rf _CNV_R_R_Def_rf_sw__598_CM 6 -327.68 327.67 FORMAT "%7.4" /end AXIS_DESCR
/end CHARACTERISTIC
/begin CHARACTERISTIC KF_LRWAFS "Loadresponse bei Lenken mit EPS" MAP 0xa082bd90 _REC_MAP_52_u1_s2_s2 25.5 _CNV_R_R_Def_td_ub__574_CM 0. 25.5 FORMAT "%4.1"
 /begin AXIS_DESCR STD_AXIS W_afs _CNV_R_R_Def_f_sw_q_560_CM 6 -3276.8 3276.7 FORMAT "%5.2" /end AXIS_DESCR
 /begin AXIS_DESCR STD_AXIS W_dafs _CNV_R_R_Def_f_sw_q_560_CM 6 -3276.8 3276.7 FORMAT "%5.2" /end AXIS_DESCR
/end CHARACTERISTIC
/begin CHARACTERISTIC KF_MDMAX_ARS "max. Aufnahmemoment ARS" MAP 0xa082c018 _REC_MAP_52_UBYTE_s2_u2_s2 131.07 _CNV_R_R_Def_m_sw_q_554_CM -3276.8 3276.7 FORMAT "%5.2"
 /begin AXIS_DESCR STD_AXIS V _CNV_R_R_Def_v_uw_q_726_CM 4 0. 360. FORMAT "%5.0" /end AXIS_DESCR
 /begin AXIS_DESCR STD_AXIS Nkw _CNV_R_R_Def_n_sw_q_595_CM 4 -32768. 32767. FORMAT "%5.0" /end AXIS_DESCR
/end CHARACTERISTIC
/begin CHARACTERISTIC KF_MDMAX_GEN "max. Aufnahmemoment Generator" MAP 0xa082bfb0 _REC_MAP_52_UBYTE_s2_s2_s2 131.07 _CNV_R_R_Def_m_sw_q_554_CM -3276.8 3276.7 FORMAT "%5.2"
 /begin AXIS_DESCR STD_AXIS Tgen _CNV_R_R_Def_t_sw_q_578_CM 4 -3276.8 3276.7 FORMAT "%4.1" /end AXIS_DESCR
 /begin AXIS_DESCR STD_AXIS Nkw _CNV_R_R_Def_n_sw_q_595_CM 4 -32768. 32767. FORMAT "%5.0" /end AXIS_DESCR
/end CHARACTERISTIC
/begin CHARACTERISTIC KF_MDMAX_KK "max. Aufnahmemoment Klimakompressor" MAP 0xa082c04c _REC_MAP_52_UBYTE_s2_s2_s2 131.07 _CNV_R_R_Def_m_sw_q_554_CM -3276.8 3276.7 FORMAT "%5.2"
 /begin AXIS_DESCR STD_AXIS Tumg _CNV_R_R_Def_t_sw_q_578_CM 4 -3276.8 3276.7 FORMAT "%4.1" /end AXIS_DESCR
 /begin AXIS_DESCR STD_AXIS Nkw _CNV_R_R_Def_n_sw_q_595_CM 4 -32768. 32767. FORMAT "%5.0" /end AXIS_DESCR
/end CHARACTERISTIC
/begin CHARACTERISTIC KF_MDMAX_SL "max. Aufnahmemoment Servolenkung" MAP 0xa082bfe4 _REC_MAP_52_UBYTE_s2_s2_s2 131.07 _CNV_R_R_Def_m_sw_q_554_CM -3276.8 3276.7 FORMAT "%5.2"
 /begin AXIS_DESCR STD_AXIS W_afs _CNV_R_R_Def_f_sw_q_560_CM 4 -3276.8 3276.7 FORMAT "%5.2" /end AXIS_DESCR
 /begin AXIS_DESCR STD_AXIS W_dafs _CNV_R_R_Def_f_sw_q_560_CM 4 -3276.8 3276.7 FORMAT "%5.2" /end AXIS_DESCR
/end CHARACTERISTIC
/begin CHARACTERISTIC KF_MDRESWAFS "Momentenreserve bei Lenken mit EPS und instabilem Bordnetz" MAP 0xa082be10 _REC_MAP_52_UBYTE_s2_s2_s2 131.07 _CNV_R_R_Def_m_sw_q_554_CM -3276.8 3276.7 FORMAT "%5.2"
 /begin AXIS_DESCR STD_AXIS W_afs _CNV_R_R_Def_f_sw_q_560_CM 6 -3276.8 3276.7 FORMAT "%5.2" /end AXIS_DESCR
 /begin AXIS_DESCR STD_AXIS W_dafs _CNV_R_R_Def_f_sw_q_560_CM 6 -3276.8 3276.7 FORMAT "%5.2" /end AXIS_DESCR
/end CHARACTERISTIC
/begin CHARACTERISTIC KF_OZDREHKOR "Drehzahlkorrektur Niveau" MAP 0xa081aaa8 _REC_MAP_52_UBYTE_s2_s2_u2 75. _CNV_R_R_Def_niv_sw_666_CM -37.5 37.5 FORMAT "%5.2"
 /begin AXIS_DESCR STD_AXIS N_ozmw _CNV_R_R_Def_n_sw_q_595_CM 16 -32768. 32767. FORMAT "%5.0" /end AXIS_DESCR
 /begin AXIS_DESCR STD_AXIS NO_INPUT_QUANTITY _CNV_R_R_Def_niv_uw_744_CM 3 0. 19199.707 FORMAT "%5.2" /end AXIS_DESCR
/end CHARACTERISTIC
/begin CHARACTERISTIC KF_OZKFGPK "Niveaukorrektur im Notlauf Ölpumpe " MAP 0xa081ab30 _REC_MAP_52_UBYTE_s2_s2_u2 75. _CNV_R_R_Def_niv_sw_666_CM -37.5 37.5 FORMAT "%5.2"
 /begin AXIS_DESCR STD_AXIS Nkw _CNV_R_R_Def_n_sw_q_595_CM 16 -32768. 32767. FORMAT "%5.0" /end AXIS_DESCR
 /begin AXIS_DESCR STD_AXIS NO_INPUT_QUANTITY _CNV_R_R_Def_niv_uw_744_CM 3 0. 19199.707 FORMAT "%5.2" /end AXIS_DESCR
/end CHARACTERISTIC
/begin CHARACTERISTIC KF_OZKORRNIV "Niveaukorrektur nach Startzeit und Temperatur" MAP 0xa081abb8 _REC_MAP_52_UBYTE_s2_s2_u2 75. _CNV_R_R_Def_niv_uw_744_CM -37.5 37.5 FORMAT "%5.2"
 /begin AXIS_DESCR STD_AXIS Oz_tempf _CNV_R_R_Def_t_sw_q_578_CM 6 -3276.8 3276.7 FORMAT "%4.1" /end AXIS_DESCR
 /begin AXIS_DESCR STD_AXIS Oz_nivzeit _CNV_R_R_Def_td_uw__673_CM 6 0. 655.35 FORMAT "%5.2" /end AXIS_DESCR
/end CHARACTERISTIC
/begin CHARACTERISTIC KF_OZKORRORI "Kennfeld für die Korrektur des OriMw mit Abstellzeit und Öltemperatur" MAP 0xa081aa74 _REC_MAP_52_UBYTE_s2_s2_u2 75. _CNV_R_R_Def_niv_uw_744_CM -37.5 37.5 FORMAT "%5.2"
 /begin AXIS_DESCR STD_AXIS Toel _CNV_R_R_Def_t_sw_q_578_CM 4 -3276.8 3276.7 FORMAT "%4.1" /end AXIS_DESCR
 /begin AXIS_DESCR STD_AXIS Tn_abstellm _CNV_R_R_Def_tn_uw__664_CM 4 0. 65535. FORMAT "%5.2" /end AXIS_DESCR
/end CHARACTERISTIC
/begin CHARACTERISTIC KF_OZTEMPMDL "Öl-Modelltemperatur" MAP 0xa081ac68 _REC_MAP_52_UBYTE_s2_s2_s2 131.07 _CNV_R_R_Def_t_sw_q_578_CM -3276.8 3276.7 FORMAT "%4.1"
 /begin AXIS_DESCR STD_AXIS Tmot _CNV_R_R_Def_t_sw_q_579_CM 4 -327.68 327.67 FORMAT "%5.2" /end AXIS_DESCR
 /begin AXIS_DESCR STD_AXIS Nkw _CNV_R_R_Def_n_sw_q_595_CM 4 -32768. 32767. FORMAT "%5.0" /end AXIS_DESCR
/end CHARACTERISTIC
/begin CHARACTERISTIC KF_OZZEIT "Zusammenführüng Abstellzeit und Startzeit" MAP 0xa081ac1c _REC_MAP_52_UBYTE_u2_u2_u2 98.30250000000001 _CNV_R_R_Def_td_uw__673_CM 0. 655.35 FORMAT "%5.2"
 /begin AXIS_DESCR STD_AXIS Tn_start_10 _CNV_R_R_Def_td_uw__673_CM 6 0. 655.35 FORMAT "%5.2" /end AXIS_DESCR
 /begin AXIS_DESCR STD_AXIS Oz_abstellm _CNV_R_R_Def_tn_uw__664_CM 4 0. 65535. FORMAT "%5.2" /end AXIS_DESCR
/end CHARACTERISTIC
/begin CHARACTERISTIC KF_SUBPRIO_AUSW1 "Kennfeld zur Auswahl der Subprio für Ebene 1" MAP 0xa0827dd4 _REC_MAP_52_u1_u1_u1 99.45 _CNV_R_R_Def_dez_sl_551_CM 0. 255. FORMAT "%3.0"
 /begin AXIS_DESCR STD_AXIS Lam_auswahl2 _CNV_R_R_Def_dez_sl_551_CM 2 0. 255. FORMAT "%3.0" /end AXIS_DESCR
 /begin AXIS_DESCR STD_AXIS Lam_auswahl3 _CNV_R_R_Def_dez_sl_551_CM 2 0. 255. FORMAT "%3.0" /end AXIS_DESCR
/end CHARACTERISTIC
/begin CHARACTERISTIC KF_TES12MIN_S "Minimalabstand wegen Lambda zwischen 1. und 2. Einspritzung (schicht)" MAP 0xa0820e94 _REC_MAP_52_UBYTE_u2_s2_u2 99.61320000000001 _CNV_R_R_Def_td_sw__601_CM 0. 262.14 FORMAT "%5.2"
 /begin AXIS_DESCR STD_AXIS Nkw _CNV_R_R_Def_n_sw_q_595_CM 8 -32768. 32767. FORMAT "%5.0" /end AXIS_DESCR
 /begin AXIS_DESCR STD_AXIS La_ber _CNV_R_R_Def_f_uw_b_559_CM 8 0. 15.9997 FORMAT "%7.4" /end AXIS_DESCR
/end CHARACTERISTIC
/begin CHARACTERISTIC KF_TES12_S "Deltazeit zwischen 1. und 2. Einspritzung (schicht)" MAP 0xa0820c50 _REC_MAP_52_UBYTE_u2_s2_s2 99.61320000000001 _CNV_R_R_Def_td_sw__601_CM 0. 262.14 FORMAT "%5.2"
 /begin AXIS_DESCR STD_AXIS Nkw _CNV_R_R_Def_n_sw_q_595_CM 16 -32768. 32767. FORMAT "%5.0" /end AXIS_DESCR
 /begin AXIS_DESCR STD_AXIS Rk_soll_s _CNV_R_R_Def_rk_sw__600_CM 16 -1600. 1599.9511 /end AXIS_DESCR
/end CHARACTERISTIC
/begin CHARACTERISTIC KF_UESP_LA "Überspüllambda im Homgenen Bank 1" MAP 0xa08274a8 _REC_MAP_52_UBYTE_u2_s2_s2 15.9997 _CNV_R_R_Def_f_uw_b_559_CM 0. 15.9997 FORMAT "%7.4"
 /begin AXIS_DESCR STD_AXIS Nkw _CNV_R_R_Def_n_sw_q_595_CM 16 -32768. 32767. FORMAT "%5.0" /end AXIS_DESCR
 /begin AXIS_DESCR STD_AXIS Rf _CNV_R_R_Def_rf_sw__598_CM 12 -327.68 327.67 FORMAT "%7.4" /end AXIS_DESCR
/end CHARACTERISTIC
/begin CHARACTERISTIC KF_VERLWAN "max. Aufnahmemoment Servolenkung" MAP 0xa082c080 _REC_MAP_52_UBYTE_s2_s2_s2 131.07 _CNV_R_R_Def_m_sw_q_554_CM -3276.8 3276.7 FORMAT "%5.2"
 /begin AXIS_DESCR STD_AXIS Nturb _CNV_R_R_Def_n_sw_q_595_CM 6 -32768. 32767. FORMAT "%5.0" /end AXIS_DESCR
 /begin AXIS_DESCR STD_AXIS Nkw _CNV_R_R_Def_n_sw_q_595_CM 6 -32768. 32767. FORMAT "%5.0" /end AXIS_DESCR
/end CHARACTERISTIC
/begin CHARACTERISTIC KF_WESB1K_H "(homogen)" MAP 0xa0821058 _REC_MAP_52_UBYTE_s2_s2_s2 107.518355 _CNV_R_R_Def_kw_sw__603_CM -768. 767.9765
 /begin AXIS_DESCR STD_AXIS Nkw _CNV_R_R_Def_n_sw_q_595_CM 10 -32768. 32767. FORMAT "%5.0" /end AXIS_DESCR
 /begin AXIS_DESCR STD_AXIS Rk_sollm_h _CNV_R_R_Def_rk_sw__600_CM 12 -1600. 1599.9511 /end AXIS_DESCR
/end CHARACTERISTIC
/begin CHARACTERISTIC KF_WESB1NL_H "(homogen)" MAP 0xa0821178 _REC_MAP_52_UBYTE_s2_s2_s2 107.518355 _CNV_R_R_Def_kw_sw__603_CM -768. 767.9765
 /begin AXIS_DESCR STD_AXIS Nkw _CNV_R_R_Def_n_sw_q_595_CM 10 -32768. 32767. FORMAT "%5.0" /end AXIS_DESCR
 /begin AXIS_DESCR STD_AXIS Rk_sollm_h _CNV_R_R_Def_rk_sw__600_CM 12 -1600. 1599.9511 /end AXIS_DESCR
/end CHARACTERISTIC
/begin CHARACTERISTIC KF_WESB1_H "(homogen)" MAP 0xa0820f38 _REC_MAP_52_UBYTE_s2_s2_s2 107.518355 _CNV_R_R_Def_kw_sw__603_CM -768. 767.9765
 /begin AXIS_DESCR STD_AXIS Nkw _CNV_R_R_Def_n_sw_q_595_CM 10 -32768. 32767. FORMAT "%5.0" /end AXIS_DESCR
 /begin AXIS_DESCR STD_AXIS Rk_sollm_h _CNV_R_R_Def_rk_sw__600_CM 12 -1600. 1599.9511 /end AXIS_DESCR
/end CHARACTERISTIC
/begin CHARACTERISTIC KF_WESB1_HS "(homogen-schicht)" MAP 0xa0821a78 _REC_MAP_52_UBYTE_s2_s2_s2 107.518355 _CNV_R_R_Def_kw_sw__603_CM -768. 767.9765
 /begin AXIS_DESCR STD_AXIS Nkw _CNV_R_R_Def_n_sw_q_595_CM 10 -32768. 32767. FORMAT "%5.0" /end AXIS_DESCR
 /begin AXIS_DESCR STD_AXIS Rk_soll_h _CNV_R_R_Def_rk_sw__600_CM 12 -1600. 1599.9511 /end AXIS_DESCR
/end CHARACTERISTIC
/begin CHARACTERISTIC KF_WESB2MIN_3H "Minimaler Einspritzbeginnwinkel bei 3fach Einspritzung (homogen)" MAP 0xa0821958 _REC_MAP_52_UBYTE_s2_s2_s2 107.518355 _CNV_R_R_Def_kw_sw__603_CM -768. 767.9765
 /begin AXIS_DESCR STD_AXIS Nkw _CNV_R_R_Def_n_sw_q_595_CM 10 -32768. 32767. FORMAT "%5.0" /end AXIS_DESCR
 /begin AXIS_DESCR STD_AXIS Rk_sollm_h _CNV_R_R_Def_rk_sw__600_CM 12 -1600. 1599.9511 /end AXIS_DESCR
/end CHARACTERISTIC
/begin CHARACTERISTIC KF_WESBST_H "(homogen)" MAP 0xa0821b98 _REC_MAP_52_UBYTE_s2_s2_s2 107.518355 _CNV_R_R_Def_kw_sw__603_CM -768. 767.9765
 /begin AXIS_DESCR STD_AXIS Nkw _CNV_R_R_Def_n_sw_q_595_CM 10 -32768. 32767. FORMAT "%5.0" /end AXIS_DESCR
 /begin AXIS_DESCR STD_AXIS Tmot _CNV_R_R_Def_t_sw_q_579_CM 12 -327.68 327.67 FORMAT "%5.2" /end AXIS_DESCR
/end CHARACTERISTIC
/begin CHARACTERISTIC KF_WESE2K_3H "(homogen)" MAP 0xa0821838 _REC_MAP_52_UBYTE_s2_s2_s2 107.518355 _CNV_R_R_Def_kw_sw__603_CM -768. 767.9765
 /begin AXIS_DESCR STD_AXIS Nkw _CNV_R_R_Def_n_sw_q_595_CM 10 -32768. 32767. FORMAT "%5.0" /end AXIS_DESCR
 /begin AXIS_DESCR STD_AXIS Rk_sollm_h _CNV_R_R_Def_rk_sw__600_CM 12 -1600. 1599.9511 /end AXIS_DESCR
/end CHARACTERISTIC
/begin CHARACTERISTIC KF_WESE2K_H "kalt (homogen)" MAP 0xa08213b8 _REC_MAP_52_UBYTE_s2_s2_s2 107.518355 _CNV_R_R_Def_kw_sw__603_CM -768. 767.9765
 /begin AXIS_DESCR STD_AXIS Nkw _CNV_R_R_Def_n_sw_q_595_CM 10 -32768. 32767. FORMAT "%5.0" /end AXIS_DESCR
 /begin AXIS_DESCR STD_AXIS Rk_sollm_h _CNV_R_R_Def_rk_sw__600_CM 12 -1600. 1599.9511 /end AXIS_DESCR
/end CHARACTERISTIC
/begin CHARACTERISTIC KF_WESE2_3H "(homogen)" MAP 0xa0821718 _REC_MAP_52_UBYTE_s2_s2_s2 107.518355 _CNV_R_R_Def_kw_sw__603_CM -768. 767.9765
 /begin AXIS_DESCR STD_AXIS Nkw _CNV_R_R_Def_n_sw_q_595_CM 10 -32768. 32767. FORMAT "%5.0" /end AXIS_DESCR
 /begin AXIS_DESCR STD_AXIS Rk_sollm_h _CNV_R_R_Def_rk_sw__600_CM 12 -1600. 1599.9511 /end AXIS_DESCR
/end CHARACTERISTIC
/begin CHARACTERISTIC KF_WESE2_H "(homogen)" MAP 0xa0821298 _REC_MAP_52_UBYTE_s2_s2_s2 107.518355 _CNV_R_R_Def_kw_sw__603_CM -768. 767.9765
 /begin AXIS_DESCR STD_AXIS Nkw _CNV_R_R_Def_n_sw_q_595_CM 10 -32768. 32767. FORMAT "%5.0" /end AXIS_DESCR
 /begin AXIS_DESCR STD_AXIS Rk_sollm_h _CNV_R_R_Def_rk_sw__600_CM 12 -1600. 1599.9511 /end AXIS_DESCR
/end CHARACTERISTIC
/begin CHARACTERISTIC KF_WESE3K_H "(homogen)" MAP 0xa08215f8 _REC_MAP_52_UBYTE_s2_s2_s2 107.518355 _CNV_R_R_Def_kw_sw__603_CM -768. 767.9765
 /begin AXIS_DESCR STD_AXIS Nkw _CNV_R_R_Def_n_sw_q_595_CM 10 -32768. 32767. FORMAT "%5.0" /end AXIS_DESCR
 /begin AXIS_DESCR STD_AXIS Rk_sollm_h _CNV_R_R_Def_rk_sw__600_CM 12 -1600. 1599.9511 /end AXIS_DESCR
/end CHARACTERISTIC
/begin CHARACTERISTIC KF_WESE3_H "(homogen)" MAP 0xa08214d8 _REC_MAP_52_UBYTE_s2_s2_s2 107.518355 _CNV_R_R_Def_kw_sw__603_CM -768. 767.9765
 /begin AXIS_DESCR STD_AXIS Nkw _CNV_R_R_Def_n_sw_q_595_CM 10 -32768. 32767. FORMAT "%5.0" /end AXIS_DESCR
 /begin AXIS_DESCR STD_AXIS Rk_sollm_h _CNV_R_R_Def_rk_sw__600_CM 12 -1600. 1599.9511 /end AXIS_DESCR
/end CHARACTERISTIC
/begin CHARACTERISTIC KF_ZLRESOF "Kennfeld Generatorausschaltzeit bei Stillstand" MAP 0xa082bce8 _REC_MAP_52_u1_s2_u2 25.5 _CNV_R_R_Def_td_ub__574_CM 0. 25.5 FORMAT "%4.1"
 /begin AXIS_DESCR STD_AXIS Tmot_start _CNV_R_R_Def_t_sw_q_579_CM 4 -327.68 327.67 FORMAT "%5.2" /end AXIS_DESCR
 /begin AXIS_DESCR STD_AXIS Km_st _CNV_R_R_Def_km_sw__68_CM 4 0. 655350. FORMAT "%5.0" /end AXIS_DESCR
/end CHARACTERISTIC
/begin CHARACTERISTIC KF_ZLRRESOFV "Kennfeld Generatorausschaltzeit bei Fahrt" MAP 0xa082bcc4 _REC_MAP_52_u1_s2_u2 25.5 _CNV_R_R_Def_td_ub__574_CM 0. 25.5 FORMAT "%4.1"
 /begin AXIS_DESCR STD_AXIS Tmot_start _CNV_R_R_Def_t_sw_q_579_CM 4 -327.68 327.67 FORMAT "%5.2" /end AXIS_DESCR
 /begin AXIS_DESCR STD_AXIS Km_st _CNV_R_R_Def_km_sw__68_CM 4 0. 655350. FORMAT "%5.0" /end AXIS_DESCR
/end CHARACTERISTIC
/begin CHARACTERISTIC KL_AUSWAHL1 "Kennlinie zur Auswahl des Schalters für die Lambdas in Ebene 1" CURVE 0xa0827350 _REC_CUR_TKL_UW_VV__u1_u1 99.45 _CNV_R_R_Def_dez_sl_551_CM 0. 255. FORMAT "%3.0"
 /begin AXIS_DESCR STD_AXIS NO_INPUT_QUANTITY _CNV_S_22_Def_ba_gdi_567_CM 21 0. 21. /end AXIS_DESCR
/end CHARACTERISTIC
/begin CHARACTERISTIC KL_AUSWAHL2 "Kennlinie zur Auswahl des Schalters der Lambdas in Ebene 2" CURVE 0xa08273cc _REC_CUR_TKL_UW_VV__u1_u1 99.45 _CNV_R_R_Def_dez_sl_551_CM 0. 255. FORMAT "%3.0"
 /begin AXIS_DESCR STD_AXIS NO_INPUT_QUANTITY _CNV_S_22_Def_ba_gdi_567_CM 21 0. 21. /end AXIS_DESCR
/end CHARACTERISTIC
/begin CHARACTERISTIC KL_AUSWAHL3 "Kennlinie zur Auswahl des Schalters der Lambdas in Ebene 3" CURVE 0xa0827420 _REC_CUR_TKL_UW_VV__u1_u1 99.45 _CNV_R_R_Def_dez_sl_551_CM 0. 255. FORMAT "%3.0"
 /begin AXIS_DESCR STD_AXIS Subprio_gold _CNV_S_22_Def_ba_gdi_567_CM 21 0. 21. /end AXIS_DESCR
/end CHARACTERISTIC
/begin CHARACTERISTIC KL_AUSW_DLA "Kennlinie zur Auswahl des Differenzlambdas in Abhängigkeit von der Subba" CURVE 0xa0827320 _REC_CUR_TKL_UW_VV__u1_u1 99.45 _CNV_R_R_Def_dez_sl_551_CM 0. 255. FORMAT "%3.0"
 /begin AXIS_DESCR STD_AXIS NO_INPUT_QUANTITY _CNV_S_22_Def_ba_gdi_567_CM 21 0. 21. /end AXIS_DESCR
/end CHARACTERISTIC
/begin CHARACTERISTIC KL_AUSW_PULS "Kennlinie zur Auswahl der Pulsation in Abhängigkeit von der Subba" CURVE 0xa082739c _REC_CUR_TKL_UW_VV__u1_u1 99.45 _CNV_R_R_Def_dez_sl_551_CM 0. 255. FORMAT "%3.0"
 /begin AXIS_DESCR STD_AXIS Subprio_gold _CNV_S_22_Def_ba_gdi_567_CM 21 0. 21. /end AXIS_DESCR
/end CHARACTERISTIC
/begin CHARACTERISTIC KL_DLA_INST "Limitierender Gradient" CURVE 0xa08273fc _REC_CUR_TKL_UW_VV__u2_s2 15.9997 _CNV_R_R_Def_f_uw_b_559_CM 0. 15.9997 FORMAT "%7.4"
 /begin AXIS_DESCR STD_AXIS Nkw _CNV_R_R_Def_n_sw_q_595_CM 8 -32768. 32767. FORMAT "%5.0" /end AXIS_DESCR
/end CHARACTERISTIC
/begin CHARACTERISTIC KL_DMDILA_MAX "La_inst Auslöseschwelle negativ" CURVE 0xa08272a8 _REC_CUR_TKL_UW_VV__s2_s2 131.07 _CNV_R_R_Def_m_sw_q_554_CM -3276.8 3276.7 FORMAT "%5.2"
 /begin AXIS_DESCR STD_AXIS Nkw _CNV_R_R_Def_n_sw_q_595_CM 8 -32768. 32767. FORMAT "%5.0" /end AXIS_DESCR
/end CHARACTERISTIC
/begin CHARACTERISTIC KL_DMDILA_MIN "La_inst Auslöseschwelle positiv" CURVE 0xa0827484 _REC_CUR_TKL_UW_VV__s2_s2 131.07 _CNV_R_R_Def_m_sw_q_554_CM -3276.8 3276.7 FORMAT "%5.2"
 /begin AXIS_DESCR STD_AXIS Nkw _CNV_R_R_Def_n_sw_q_595_CM 8 -32768. 32767. FORMAT "%5.0" /end AXIS_DESCR
/end CHARACTERISTIC
/begin CHARACTERISTIC KL_DMD_MAX1 "Maximaler Momentengradient Generator" CURVE 0xa082bc88 _REC_CUR_TKL_UW_VV__s2_s2 131.07 _CNV_R_R_Def_m_sw_q_554_CM -3276.8 3276.7 FORMAT "%5.2"
 /begin AXIS_DESCR STD_AXIS Md_res_real _CNV_R_R_Def_m_sw_q_554_CM 6 -3276.8 3276.7 FORMAT "%5.2" /end AXIS_DESCR
/end CHARACTERISTIC
/begin CHARACTERISTIC KL_DMD_MAX2 "Offset maximaler Momentengradient Generator" CURVE 0xa082bc6c _REC_CUR_TKL_UW_VV__s2_s2 131.07 _CNV_R_R_Def_m_sw_q_554_CM -3276.8 3276.7 FORMAT "%5.2"
 /begin AXIS_DESCR STD_AXIS Nkw _CNV_R_R_Def_n_sw_q_595_CM 6 -32768. 32767. FORMAT "%5.0" /end AXIS_DESCR
/end CHARACTERISTIC
/begin CHARACTERISTIC KL_DWESB1P_H "(homogen)" CURVE 0xa08206f4 _REC_CUR_TKL_UW_VV__s2_u2 107.518355 _CNV_R_R_Def_kw_sw__603_CM -768. 767.9765
 /begin AXIS_DESCR STD_AXIS Prail_ist _CNV_R_R_Def_p_uw_q_676_CM 8 0. 39.9993 FORMAT "%7.4" /end AXIS_DESCR
/end CHARACTERISTIC
/begin CHARACTERISTIC KL_DWESE2P_H "(homogen)" CURVE 0xa0820718 _REC_CUR_TKL_UW_VV__s2_u2 107.518355 _CNV_R_R_Def_kw_sw__603_CM -768. 767.9765
 /begin AXIS_DESCR STD_AXIS Prail_ist _CNV_R_R_Def_p_uw_q_676_CM 8 0. 39.9993 FORMAT "%7.4" /end AXIS_DESCR
/end CHARACTERISTIC
/begin CHARACTERISTIC KL_ETA_LAMBDA "Kennlinie Wirkungsgrad Lambda" CURVE 0xa082726c _REC_CUR_TKL_UW_VV__s2_u2 99.99844999999999 _CNV_R_R_Def_eta_sw_599_CM -200. 199.9938
 /begin AXIS_DESCR STD_AXIS La_soll_ko2 _CNV_R_R_Def_f_uw_b_559_CM 8 0. 15.9997 FORMAT "%7.4" /end AXIS_DESCR
/end CHARACTERISTIC
/begin CHARACTERISTIC KL_FATLDYNTRIMM "Kennlinie Vertrimmung Faktor ATL dynamisch" CURVE 0xa0827450 _REC_CUR_TKL_UW_VV__u1_u1 0.996 _CNV_R_R_Def_f_ub_b_553_CM 0. 0.996 /begin AXIS_DESCR STD_AXIS F_atldyn _CNV_R_R_Def_f_ub_b_553_CM 6 0. 0.996 /end AXIS_DESCR /end CHARACTERISTIC
/begin CHARACTERISTIC KL_F_GENTYP "Faktor auf Maximalmoment Generator" CURVE 0xa082bf3c _REC_CUR_TKL_UW_VV__u1_u1 1.9921 _CNV_R_R_Def_f_ub_b_613_CM 0. 1.9921
 /begin AXIS_DESCR STD_AXIS Gen_awnumm _CNV_R_R_Def_dez_sl_551_CM 8 0. 255. FORMAT "%3.0" /end AXIS_DESCR
/end CHARACTERISTIC
/begin CHARACTERISTIC KL_F_MDSLT "Temperaturkorrektur auf Maximalmoment Lenkung" CURVE 0xa082bf1c _REC_CUR_TKL_UW_VV__u1_s2 1.9921 _CNV_R_R_Def_f_ub_b_613_CM 0. 1.9921
 /begin AXIS_DESCR STD_AXIS Tmot _CNV_R_R_Def_t_sw_q_579_CM 4 -327.68 327.67 FORMAT "%5.2" /end AXIS_DESCR
/end CHARACTERISTIC
/begin CHARACTERISTIC KL_KDLA_UESP "Kennlinie Integrationskonstante Berechnung Dla_uesp" CURVE 0xa0827380 _REC_CUR_TKL_UW_VV__u2_s2 0.9999847412109381 _CNV_R_R_Def_f_uw_b_571_CM 0. 0.9999847412109381 FORMAT "%14.5"
 /begin AXIS_DESCR STD_AXIS Nkw_dyn _CNV_R_R_Def_n_sw_q_595_CM 6 -32768. 32767. FORMAT "%5.0" /end AXIS_DESCR
/end CHARACTERISTIC
/begin CHARACTERISTIC KL_LAPRIO_KO "Auswahl lambdapriorer Pfad" CURVE 0xa08272cc _REC_CUR_TKL_UW_VV__u1_u1 1. _CNV_R_R_Def_dez_sl_551_CM 0. 1. FORMAT "%3.0"
 /begin AXIS_DESCR STD_AXIS Subprio_gold _CNV_S_22_Def_ba_gdi_567_CM 21 0. 21. /end AXIS_DESCR
/end CHARACTERISTIC
/begin CHARACTERISTIC KL_LA_VL1 "Kennlinie für Volllast Homogen Bank1" CURVE 0xa0827460 _REC_CUR_TKL_UW_VV__u2_s2 15.9997 _CNV_R_R_Def_f_uw_b_559_CM 0. 15.9997 FORMAT "%7.4"
 /begin AXIS_DESCR STD_AXIS Nkw _CNV_R_R_Def_n_sw_q_595_CM 8 -32768. 32767. FORMAT "%5.0" /end AXIS_DESCR
/end CHARACTERISTIC
/begin CHARACTERISTIC KL_LA_VL2 "Kennlinie für Volllast Homogen Bank2" CURVE 0xa08272fc _REC_CUR_TKL_UW_VV__u2_s2 15.9997 _CNV_R_R_Def_f_uw_b_559_CM 0. 15.9997 FORMAT "%7.4"
 /begin AXIS_DESCR STD_AXIS Nkw _CNV_R_R_Def_n_sw_q_595_CM 8 -32768. 32767. FORMAT "%5.0" /end AXIS_DESCR
/end CHARACTERISTIC
/begin CHARACTERISTIC KL_LORESPM "Motorabhängiger Loadresponse-Faktor" CURVE 0xa082bd20 _REC_CUR_TKL_UW_VV__u1_s2 3.9843 _CNV_R_R_Def_f_ub_b_632_CM 0. 3.9843 FORMAT "%5.2"
 /begin AXIS_DESCR STD_AXIS Tmot _CNV_R_R_Def_t_sw_q_579_CM 6 -327.68 327.67 FORMAT "%5.2" /end AXIS_DESCR
/end CHARACTERISTIC
/begin CHARACTERISTIC KL_LRIGR "Loadresponse bei IGR Betrieb" CURVE 0xa082bd34 _REC_CUR_TKL_UW_VV__u1_s2 25.5 _CNV_R_R_Def_td_ub__574_CM 0. 25.5 FORMAT "%4.1"
 /begin AXIS_DESCR STD_AXIS Nkw _CNV_R_R_Def_n_sw_q_595_CM 8 -32768. 32767. FORMAT "%5.0" /end AXIS_DESCR
/end CHARACTERISTIC
/begin CHARACTERISTIC KL_MDGRAD_AFS "Maximaler Momentengradient AFS" CURVE 0xa082bef8 _REC_CUR_TKL_UW_VV__s2_s2 131.07 _CNV_R_R_Def_m_sw_q_554_CM -3276.8 3276.7 FORMAT "%5.2"
 /begin AXIS_DESCR STD_AXIS W_afs _CNV_R_R_Def_f_sw_q_560_CM 4 -3276.8 3276.7 FORMAT "%5.2" /end AXIS_DESCR
/end CHARACTERISTIC
/begin CHARACTERISTIC KL_MDGRAD_GEN "Maximaler Momentengradient Generator" CURVE 0xa082bf78 _REC_CUR_TKL_UW_VV__s2_u1 131.07 _CNV_R_R_Def_m_sw_q_554_CM -3276.8 3276.7 FORMAT "%5.2"
 /begin AXIS_DESCR STD_AXIS Tlrgen _CNV_R_R_Def_td_ub__574_CM 8 0. 25.5 FORMAT "%4.1" /end AXIS_DESCR
/end CHARACTERISTIC
/begin CHARACTERISTIC KL_MDGRAD_SL "Maximaler Momentengradient Servolenkung" CURVE 0xa082bee4 _REC_CUR_TKL_UW_VV__s2_s2 131.07 _CNV_R_R_Def_m_sw_q_554_CM -3276.8 3276.7 FORMAT "%5.2"
 /begin AXIS_DESCR STD_AXIS W_afs _CNV_R_R_Def_f_sw_q_560_CM 4 -3276.8 3276.7 FORMAT "%5.2" /end AXIS_DESCR
/end CHARACTERISTIC
/begin CHARACTERISTIC KL_MDKMAXRED "Reduktion Maximalmoment Motor über Zündwinkeladaption" CURVE 0xa082bf64 _REC_CUR_TKL_UW_VV__s2_s2 131.07 _CNV_R_R_Def_m_sw_q_554_CM -3276.8 3276.7 FORMAT "%5.2"
 /begin AXIS_DESCR STD_AXIS Dzw_krann_vl _CNV_R_R_Def_zw_sw__604_CM 4 -50. 60. FORMAT "%4.1" /end AXIS_DESCR
/end CHARACTERISTIC
/begin CHARACTERISTIC KL_MDMAX_GETR "Maximalmoment Getriebe" CURVE 0xa082bf50 _REC_CUR_TKL_UW_VV__s2_s2 131.07 _CNV_R_R_Def_m_sw_q_554_CM -3276.8 3276.7 FORMAT "%5.2"
 /begin AXIS_DESCR STD_AXIS Tget _CNV_R_R_Def_t_sw_q_579_CM 4 -327.68 327.67 FORMAT "%5.2" /end AXIS_DESCR
/end CHARACTERISTIC
/begin CHARACTERISTIC KL_MDZIEL "Zielmomentenreserve für Generator bei BN i.O." CURVE 0xa082bc50 _REC_CUR_TKL_UW_VV__s2_s2 98.30250000000001 _CNV_R_R_Def_m_sw_q_649_CM -327.68 327.67 FORMAT "%5.2"
 /begin AXIS_DESCR STD_AXIS Nkw _CNV_R_R_Def_n_sw_q_595_CM 6 -32768. 32767. FORMAT "%5.0" /end AXIS_DESCR
/end CHARACTERISTIC
/begin CHARACTERISTIC KL_MDZIELIERR "Momentenoffset auf Zielreserve Generatorlimitierung" CURVE 0xa082bc3c _REC_CUR_TKL_UW_VV__s2_u1 98.30250000000001 _CNV_R_R_Def_m_sw_q_649_CM -327.68 327.67 FORMAT "%5.2" /begin AXIS_DESCR STD_AXIS Ierr _CNV_R_R_Def_i_uw_q_630_CM 6 0. 31.875 /end AXIS_DESCR /end CHARACTERISTIC
/begin CHARACTERISTIC KL_OZKRZMW2 "Anzahl 10er Pakete für Steigungsberechnung in Abhängigkeit von der gefahrenen Strecke" CURVE 0xa081a9f8 _REC_CUR_TKL_UW_VV__u1_u2 99.45 _CNV_R_R_Def_dez_sl_551_CM 0. 255. FORMAT "%3.0"
 /begin AXIS_DESCR STD_AXIS Oz_dkm _CNV_R_R_Def_f_uw_b_618_CM 4 0. 9.999800000000001 FORMAT "%7.4" /end AXIS_DESCR
/end CHARACTERISTIC
/begin CHARACTERISTIC KL_OZLBNIV "Korrektur der Längbeschleunigungseffekte beim 10er Paket QLT" CURVE 0xa081aa18 _REC_CUR_TKL_UW_VV__s1_s1 74.70699999999999 _CNV_R_R_Def_niv_ub_667_CM -37.5 37.207 FORMAT "%5.2"
 /begin AXIS_DESCR STD_AXIS Oz_lbmw _CNV_R_R_Def_f_sb_b_669_CM 8 -2. 1.9843 FORMAT "%5.2" /end AXIS_DESCR
/end CHARACTERISTIC
/begin CHARACTERISTIC KL_OZLN "y = ln x" CURVE 0xa081a9dc _REC_CUR_TKL_UW_VV__s2_u2 1.999969482421875 _CNV_R_R_Def_f_uw_b_590_CM -1. 0.999969482421875 FORMAT "%14.5"
 /begin AXIS_DESCR STD_AXIS Oz_pzdivp _CNV_R_R_Def_f_uw_b_590_CM 6 0. 1.9999 FORMAT "%14.5" /end AXIS_DESCR
/end CHARACTERISTIC
/begin CHARACTERISTIC KL_OZNFDELTA "Delta für die Nachfüllerkennung" CURVE 0xa081aa2c _REC_CUR_TKL_UW_VV__u1_u1 74.70699999999999 _CNV_R_R_Def_niv_ub_667_CM 0. 74.70699999999999 FORMAT "%5.2"
 /begin AXIS_DESCR STD_AXIS Oz_peillang _CNV_R_R_Def_niv_ub_667_CM 6 0. 74.70699999999999 FORMAT "%5.2" /end AXIS_DESCR
/end CHARACTERISTIC
/begin CHARACTERISTIC KL_OZORBERO "Toleranz für Orientierungsmessung nach oben in mm" CURVE 0xa081aa08 _REC_CUR_TKL_UW_VV__u1_u1 74.70699999999999 _CNV_R_R_Def_niv_ub_667_CM 0. 74.70699999999999 FORMAT "%5.2"
 /begin AXIS_DESCR STD_AXIS Oz_peillang _CNV_R_R_Def_niv_ub_667_CM 6 0. 74.70699999999999 FORMAT "%5.2" /end AXIS_DESCR
/end CHARACTERISTIC
/begin CHARACTERISTIC KL_OZQBNIV "Korrektur der Querbeschleunigungseffekte beim 10er Paket QLT" CURVE 0xa081aa3c _REC_CUR_TKL_UW_VV__s1_s1 74.70699999999999 _CNV_R_R_Def_niv_ub_667_CM -37.5 37.207 FORMAT "%5.2"
 /begin AXIS_DESCR STD_AXIS Oz_qbmw _CNV_R_R_Def_f_sb_b_669_CM 8 -2. 1.9843 FORMAT "%5.2" /end AXIS_DESCR
/end CHARACTERISTIC
/begin CHARACTERISTIC KL_OZSTNIV "Korrektur der Steigungseffekte beim 20er Paket QLT" CURVE 0xa081aa50 _REC_CUR_TKL_UW_VV__s2_s2 75. _CNV_R_R_Def_niv_uw_744_CM -37.5 37.5 FORMAT "%5.2"
 /begin AXIS_DESCR STD_AXIS Oz_steigung _CNV_R_R_Def_f_sw_b_623_CM 8 -64. 63.998 /end AXIS_DESCR
/end CHARACTERISTIC
/begin CHARACTERISTIC KL_U_ENTL "Umschaltung Entlastung über Strom oder Spannung" CURVE 0xa082beb8 _REC_CUR_TKL_UW_VV__u1_u1 99.45 _CNV_R_R_Def_dez_sl_551_CM 0. 255. FORMAT "%3.0"
 /begin AXIS_DESCR STD_AXIS Pr_md_entlsoll _CNV_R_R_Def_dez_sl_551_CM 8 0. 255. FORMAT "%3.0" /end AXIS_DESCR
/end CHARACTERISTIC
/begin CHARACTERISTIC KL_VERLPU "Getriebepumpenmoment" CURVE 0xa082bf94 _REC_CUR_TKL_UW_VV__s2_s2 131.07 _CNV_R_R_Def_m_sw_q_554_CM -3276.8 3276.7 FORMAT "%5.2"
 /begin AXIS_DESCR STD_AXIS Nkw _CNV_R_R_Def_n_sw_q_595_CM 6 -32768. 32767. FORMAT "%5.0" /end AXIS_DESCR
/end CHARACTERISTIC
/begin CHARACTERISTIC KL_VERLPU_TKOR "Temperaturkorrektur auf Getriebepumpenmoment" CURVE 0xa082bf2c _REC_CUR_TKL_UW_VV__u1_s2 1.9921 _CNV_R_R_Def_f_ub_b_613_CM 0. 1.9921
 /begin AXIS_DESCR STD_AXIS Tget _CNV_R_R_Def_t_sw_q_579_CM 4 -327.68 327.67 FORMAT "%5.2" /end AXIS_DESCR
/end CHARACTERISTIC
/begin CHARACTERISTIC KL_VERLWAN_TKOR "Temperaturkorrektur auf Wandlerverlustmoment" CURVE 0xa082bf0c _REC_CUR_TKL_UW_VV__u1_s2 1.9921 _CNV_R_R_Def_f_ub_b_613_CM 0. 1.9921
 /begin AXIS_DESCR STD_AXIS Tget _CNV_R_R_Def_t_sw_q_579_CM 4 -327.68 327.67 FORMAT "%5.2" /end AXIS_DESCR
/end CHARACTERISTIC
/begin CHARACTERISTIC KL_WESB1VL_H "(homogen)" CURVE 0xa082073c _REC_CUR_TKL_UW_VV__s2_s2 107.518355 _CNV_R_R_Def_kw_sw__603_CM -768. 767.9765
 /begin AXIS_DESCR STD_AXIS Nkw _CNV_R_R_Def_n_sw_q_595_CM 12 -32768. 32767. FORMAT "%5.0" /end AXIS_DESCR
/end CHARACTERISTIC
/begin CHARACTERISTIC KL_WESE2VL_H "(homogen)" CURVE 0xa0820770 _REC_CUR_TKL_UW_VV__s2_s2 107.518355 _CNV_R_R_Def_kw_sw__603_CM -768. 767.9765
 /begin AXIS_DESCR STD_AXIS Nkw _CNV_R_R_Def_n_sw_q_595_CM 12 -32768. 32767. FORMAT "%5.0" /end AXIS_DESCR
/end CHARACTERISTIC
/begin CHARACTERISTIC KL_WESNESPR "Kennlinie Winkel Einlaß schließt ahängig vom Hub" CURVE 0xa0833108 _REC_CUR_TKL_UW_VV__s2_u2 107.518355 _CNV_R_R_Def_kw_sw__603_CM -768. 767.9765 /begin AXIS_DESCR STD_AXIS Hubev_soll _CNV_R_R_Def_hub_uw_589_CM 8 0. 65.535 /end AXIS_DESCR /end CHARACTERISTIC
/begin CHARACTERISTIC KL_ZK_ETALAMZW "Zk zur Filterung von Eta_ges" CURVE 0xa0827f2c _REC_CUR_TKL_UW_VV__u2_s2 99.9984 _CNV_R_R_Def_f_uw_b_555_CM 0. 99.9984
 /begin AXIS_DESCR STD_AXIS Nkw _CNV_R_R_Def_n_sw_q_595_CM 8 -32768. 32767. FORMAT "%5.0" /end AXIS_DESCR
/end CHARACTERISTIC
/begin CHARACTERISTIC K_ANZ_RENN "Begrenzung Anzahl Entlastung Generator bei Rennstart" VALUE 0xa082c0eb _REC_VAL_20_u1 99.45 _CNV_R_R_Def_dez_sl_551_CM 0. 255. FORMAT "%3.0" /end CHARACTERISTIC
/begin CHARACTERISTIC K_APPLROFF "Generator-Loadresponse-Schwelle (in)aktiv" VALUE 0xa082bd13 _REC_VAL_20_u1 1. _CNV_R_R_Def_dez_sl_551_CM 0. 1. FORMAT "%3.0" /end CHARACTERISTIC
/begin CHARACTERISTIC K_CKLANN_NKW "Zentren KLANN für Nkw-Eingang" VAL_BLK 0xa082e9b0 _REC_VAL_2_s2 0. _CNV_R_R_Def_n_sw_q_595_CM -32768. 32767. FORMAT "%5.0" NUMBER 15 /end CHARACTERISTIC
/begin CHARACTERISTIC K_CKLANN_RK "Zentren KLANN für Rk-Eingang" VAL_BLK 0xa082e9d0 _REC_VAL_2_u2 31.99950000000001 _CNV_R_R_Def_f_uw_b_588_CM 0. 31.9995 FORMAT "%7.4" NUMBER 15 /end CHARACTERISTIC
/begin CHARACTERISTIC K_CKLANN_TMOT "Zentren KLANN für Tmot-Eingang" VAL_BLK 0xa082e9f0 _REC_VAL_2_s2 98.30250000000001 _CNV_R_R_Def_t_sw_q_579_CM -327.68 327.67 FORMAT "%5.2" NUMBER 15 /end CHARACTERISTIC
/begin CHARACTERISTIC K_CW_OZ "Codeword OZ 1" VALUE 0xa081a96c _REC_VAL_20_u2 0. _CNV_R_R_Def_dez_sl_551_CM 0. 65535. FORMAT "%5.0" /end CHARACTERISTIC
/begin CHARACTERISTIC K_DLA_BSWL "Schwelle für Lambdakorrektur im Warmlauf" VALUE 0xa082728e _REC_VAL_20_s2 15.9997 _CNV_R_R_Def_f_sw_b_592_CM -8. 7.9997 FORMAT "%7.4" /end CHARACTERISTIC
/begin CHARACTERISTIC K_DLA_HOMM "Offset Differenzlambda Homogen Manuell" VALUE 0xa0827290 _REC_VAL_20_s2 1.999969482421875 _CNV_R_R_Def_f_uw_b_590_CM -1. 0.999969482421875 FORMAT "%14.5" /end CHARACTERISTIC
/begin CHARACTERISTIC K_DLA_PULS "Faktor Differenzlambda Pulsationen" VALUE 0xa0827298 _REC_VAL_20_u2 1.9999 _CNV_R_R_Def_f_uw_b_590_CM 0. 1.9999 FORMAT "%14.5" /end CHARACTERISTIC
/begin CHARACTERISTIC K_DMDGEN_FAK "Korrekturfaktor zulässige Generatordynamik" VALUE 0xa082bc34 _REC_VAL_20_u2 1.9999 _CNV_R_R_Def_f_uw_b_590_CM 0. 1.9999 FORMAT "%14.5" /end CHARACTERISTIC
/begin CHARACTERISTIC K_DMDGEN_OFF "Korrekturoffset zulässige Generatordynamik" VALUE 0xa082bc2c _REC_VAL_20_s2 131.07 _CNV_R_R_Def_m_sw_q_554_CM -3276.8 3276.7 FORMAT "%5.2" /end CHARACTERISTIC
/begin CHARACTERISTIC K_DMDILA_MAX "La_inst Abschaltschwelle positiv" VALUE 0xa0827292 _REC_VAL_20_s2 131.07 _CNV_R_R_Def_m_sw_q_554_CM -3276.8 3276.7 FORMAT "%5.2" /end CHARACTERISTIC
/begin CHARACTERISTIC K_DMDILA_MIN "La_inst Abschaltschwelle negativ" VALUE 0xa0827294 _REC_VAL_20_s2 131.07 _CNV_R_R_Def_m_sw_q_554_CM -3276.8 3276.7 FORMAT "%5.2" /end CHARACTERISTIC
/begin CHARACTERISTIC K_DWESE2APP_H "Schalter Deltawinkel Einspritzende - Zündung  2 einspr. HOM manuell" VALUE 0xa08206ee _REC_VAL_20_s2 107.518355 _CNV_R_R_Def_kw_sw__603_CM -768. 767.9765 /end CHARACTERISTIC
/begin CHARACTERISTIC K_DWESEAPP_HS "Deltazündwinkel auf Zündwinkel Applikationswert (homogen-schicht)" VALUE 0xa08206e6 _REC_VAL_20_s2 107.518355 _CNV_R_R_Def_kw_sw__603_CM -768. 767.9765 /end CHARACTERISTIC
/begin CHARACTERISTIC K_DWESEAPP_S "Deltazündwinkel auf Zündwinkel Applikationswert (schicht)" VALUE 0xa08206e4 _REC_VAL_20_s2 107.518355 _CNV_R_R_Def_kw_sw__603_CM -768. 767.9765 /end CHARACTERISTIC
/begin CHARACTERISTIC K_ENAPPLGOFF "Enable Generatorauschaltsteuerung" VALUE 0xa082bcbe _REC_VAL_20_u1 99.45 _CNV_R_R_Def_dez_sl_551_CM 0. 255. FORMAT "%3.0" /end CHARACTERISTIC
/begin CHARACTERISTIC K_ENAPPLRESP "Enable Handsteuerung Loadresponse" VALUE 0xa082bd14 _REC_VAL_20_u1 99.45 _CNV_R_R_Def_dez_sl_551_CM 0. 255. FORMAT "%3.0" /end CHARACTERISTIC
/begin CHARACTERISTIC K_ETAGES_MN "untere Begrenzung Wirkungsgrad" VALUE 0xa0827f28 _REC_VAL_20_s2 99.99844999999999 _CNV_R_R_Def_eta_sw_599_CM -200. 199.9938 /end CHARACTERISTIC
/begin CHARACTERISTIC K_ETAGES_MX "obere Begrenzung Wirkungsgrad" VALUE 0xa0827f26 _REC_VAL_20_s2 99.99844999999999 _CNV_R_R_Def_eta_sw_599_CM -200. 199.9938 /end CHARACTERISTIC
/begin CHARACTERISTIC K_FHOGNMN "minimaler Wichtungsfaktor fuer minimale HFM-Luftmassen Schwelle in Abhaengigkeit von d.Hoehe fuer Generatorreduzierung" VALUE 0xa082bcbf _REC_VAL_20_u1 3.9843 _CNV_R_R_Def_f_ub_b_632_CM 0. 3.9843 FORMAT "%5.2" /end CHARACTERISTIC
/begin CHARACTERISTIC K_F_LLRI "Faktor auf I-Anteil LL Regler zur Bestimmung der NA Momentenbilanz" VALUE 0xa082bed0 _REC_VAL_20_s1 1.9921 _CNV_R_R_Def_f_sb_b_703_CM -1. 0.9921 /end CHARACTERISTIC
/begin CHARACTERISTIC K_F_MDMXREAL "Faktor auf maximales Motormoment zur Bestimmung der NA Momentenbilanz" VALUE 0xa082bed1 _REC_VAL_20_u1 1.9921 _CNV_R_R_Def_f_ub_b_613_CM 0. 1.9921 /end CHARACTERISTIC
/begin CHARACTERISTIC K_F_MDSLT "Faktor auf Maximalmoment bei normaler Lenkung" VALUE 0xa082bed7 _REC_VAL_20_u1 1.9921 _CNV_R_R_Def_f_ub_b_613_CM 0. 1.9921 /end CHARACTERISTIC
/begin CHARACTERISTIC K_F_NABC "Faktor auf im best case freigebbares Moment der NA" VALUE 0xa082becd _REC_VAL_20_u1 0.996 _CNV_R_R_Def_f_ub_b_553_CM 0. 0.996 /end CHARACTERISTIC
/begin CHARACTERISTIC K_GENGCALC "Zeitraster, in dem Md_gennm für GEN_GRENZ übernommen wird (Ringpuffer)" VALUE 0xa082bc36 _REC_VAL_20_u2 98.30250000000001 _CNV_R_R_Def_td_uw__673_CM 0. 655.35 FORMAT "%5.2" /end CHARACTERISTIC
/begin CHARACTERISTIC K_IERRGRENZ_APPL "Applikation Ierrgrenz" VALUE 0xa082bca7 _REC_VAL_20_u1 31.875 _CNV_R_R_Def_i_uw_q_630_CM 0. 31.875 /end CHARACTERISTIC
/begin CHARACTERISTIC K_IERRHYSMAX "Obere Schwelle für Hystereseerkennung (Aufweitung der Zielreserve)" VALUE 0xa082bc2e _REC_VAL_20_s2 81.91875 _CNV_R_R_Def_i_uw_q_630_CM -4096. 4095.875 /end CHARACTERISTIC
/begin CHARACTERISTIC K_IERRHYSMN "Untere Schwelle für Hystereseerkennung (Aufweitung der Zielreserve)" VALUE 0xa082bc30 _REC_VAL_20_s2 81.91875 _CNV_R_R_Def_i_uw_q_630_CM -4096. 4095.875 /end CHARACTERISTIC
/begin CHARACTERISTIC K_KDMDI_FIL "Filterkonstante Dmdi_ml_soll-Berechnung" VALUE 0xa082729a _REC_VAL_20_u2 0.9999694824218756 _CNV_R_R_Def_f_uw_b_571_CM 1.52587890625e-005 0.9999847412109381 FORMAT "%14.5" /end CHARACTERISTIC
/begin CHARACTERISTIC K_KLANN_ANZ "Anzahl Modelle für KLANN" VALUE 0xa082e9ad _REC_VAL_20_u1 15. _CNV_R_R_Def_dez_sl_551_CM 0. 15. FORMAT "%3.0" /end CHARACTERISTIC
/begin CHARACTERISTIC K_KLANN_EPS "Lernfaktor KLANN" VALUE 0xa082ea72 _REC_VAL_20_S4 0. _CNV_R_R_Def_dez_sl_551_CM -1000000000000. 10000000000000. FORMAT "%14.7" /end CHARACTERISTIC
/begin CHARACTERISTIC K_KLANN_MX "Maximalwert für Gewichte KLANN" VALUE 0xa082ea6e _REC_VAL_20_S4 0. _CNV_R_R_Def_dez_sl_551_CM -1000000000000. 10000000000000. FORMAT "%14.7" /end CHARACTERISTIC
/begin CHARACTERISTIC K_LAHOMMAN1 "Schalter Lambda-Sollwert Homogen über Applikation setzen Bank 1" VALUE 0xa082729c _REC_VAL_20_u2 15.9997 _CNV_R_R_Def_f_uw_b_559_CM 0. 15.9997 FORMAT "%7.4" /end CHARACTERISTIC
/begin CHARACTERISTIC K_LAHOMMAN2 "Schalter Lambda-Sollwert Homogen über Applikation setzen Bank 2" VALUE 0xa082729e _REC_VAL_20_u2 15.9997 _CNV_R_R_Def_f_uw_b_559_CM 0. 15.9997 FORMAT "%7.4" /end CHARACTERISTIC
/begin CHARACTERISTIC K_LAMIN_H "Lamdabrenngrenze fett" VALUE 0xa08272a0 _REC_VAL_20_u2 15.9997 _CNV_R_R_Def_f_uw_b_559_CM 0. 15.9997 FORMAT "%7.4" /end CHARACTERISTIC
/begin CHARACTERISTIC K_LASCHUB "Konstante Lambdavorgabe für Schub" VALUE 0xa08272a2 _REC_VAL_20_u2 15.9997 _CNV_R_R_Def_f_uw_b_559_CM 0. 15.9997 FORMAT "%7.4" /end CHARACTERISTIC
/begin CHARACTERISTIC K_LRBNS "Loadrespo´nse bei Warnung Bordnetzstabilität gefährdet" VALUE 0xa082bd15 _REC_VAL_20_u1 25.5 _CNV_R_R_Def_td_ub__574_CM 0. 25.5 FORMAT "%4.1" /end CHARACTERISTIC
/begin CHARACTERISTIC K_LRESPAPP "Load-Response Applikation" VALUE 0xa082bd16 _REC_VAL_20_u1 25.5 _CNV_R_R_Def_td_ub__574_CM 0. 25.5 FORMAT "%4.1" /end CHARACTERISTIC
/begin CHARACTERISTIC K_LRSPGW "Loadresponse bei Spannungswächtereingriff" VALUE 0xa082bd17 _REC_VAL_20_u1 25.5 _CNV_R_R_Def_td_ub__574_CM 0. 25.5 FORMAT "%4.1" /end CHARACTERISTIC
/begin CHARACTERISTIC K_LRTEST "Loadresponsevorgabe zu Testzwecken" VALUE 0xa082bd18 _REC_VAL_20_u1 25.5 _CNV_R_R_Def_td_ub__574_CM 0. 25.5 FORMAT "%4.1" /end CHARACTERISTIC
/begin CHARACTERISTIC K_MDACMIN "Minimales Restmoment Klimakompressor bei Entlastung" VALUE 0xa082beb6 _REC_VAL_20_s2 131.07 _CNV_R_R_Def_m_sw_q_554_CM -3276.8 3276.7 FORMAT "%5.2" /end CHARACTERISTIC
/begin CHARACTERISTIC K_MDENTLFUNK "Entlastungsmoment Nebenaggregate funktionale Gründe" VALUE 0xa082be96 _REC_VAL_20_s2 131.07 _CNV_R_R_Def_m_sw_q_554_CM -3276.8 3276.7 FORMAT "%5.2" /end CHARACTERISTIC
/begin CHARACTERISTIC K_MDENTLKOMF "Entlastungsmoment Nebenaggregate Komfortgründe" VALUE 0xa082be94 _REC_VAL_20_s2 131.07 _CNV_R_R_Def_m_sw_q_554_CM -3276.8 3276.7 FORMAT "%5.2" /end CHARACTERISTIC
/begin CHARACTERISTIC K_MDENTLSICH "Entlastungsmoment Nebenaggregate Sicherheitsgründe" VALUE 0xa082be92 _REC_VAL_20_s2 131.07 _CNV_R_R_Def_m_sw_q_554_CM -3276.8 3276.7 FORMAT "%5.2" /end CHARACTERISTIC
/begin CHARACTERISTIC K_MDENTLSOLL2 "Sollentlastungsmoment Generator im Start" VALUE 0xa082bca8 _REC_VAL_20_s2 131.07 _CNV_R_R_Def_m_sw_q_554_CM -3276.8 3276.7 FORMAT "%5.2" /end CHARACTERISTIC
/begin CHARACTERISTIC K_MDENTLTEST "Generatorentlastungsmoment zu Testzwecken" VALUE 0xa082be84 _REC_VAL_20_s2 131.07 _CNV_R_R_Def_m_sw_q_554_CM -3276.8 3276.7 FORMAT "%5.2" /end CHARACTERISTIC
/begin CHARACTERISTIC K_MDENTL_GENOFFVL "Momentenentlastung bei Volllast" VALUE 0xa082c0ec _REC_VAL_20_s2 131.07 _CNV_R_R_Def_m_sw_q_554_CM -3276.8 3276.7 FORMAT "%5.2" /end CHARACTERISTIC
/begin CHARACTERISTIC K_MDENTL_RENN "Momentenentlastung bei Rennstart" VALUE 0xa082c0ee _REC_VAL_20_s2 131.07 _CNV_R_R_Def_m_sw_q_554_CM -3276.8 3276.7 FORMAT "%5.2" /end CHARACTERISTIC
/begin CHARACTERISTIC K_MDGENGGFIL "Filterkonstante Filterung lokales Generatormoment" VALUE 0xa082bc38 _REC_VAL_20_u2 0.9999694824218756 _CNV_R_R_Def_f_uw_b_571_CM 1.52587890625e-005 0.9999847412109381 FORMAT "%14.5" /end CHARACTERISTIC
/begin CHARACTERISTIC K_MDGRAD_ARS "Max. Momentengradient des ARS bezogen auf 1s" VALUE 0xa082bed8 _REC_VAL_20_s2 131.07 _CNV_R_R_Def_m_sw_q_554_CM -3276.8 3276.7 FORMAT "%5.2" /end CHARACTERISTIC
/begin CHARACTERISTIC K_MDGRAD_GETR "Max. Momentengradient des Getriebes bezogen auf 1s" VALUE 0xa082bedc _REC_VAL_20_s2 131.07 _CNV_R_R_Def_m_sw_q_554_CM -3276.8 3276.7 FORMAT "%5.2" /end CHARACTERISTIC
/begin CHARACTERISTIC K_MDGRAD_GETRFS "Max. Momentengradient des Getriebes bei Fahrstufe bezogen auf 1s" VALUE 0xa082bede _REC_VAL_20_s2 131.07 _CNV_R_R_Def_m_sw_q_554_CM -3276.8 3276.7 FORMAT "%5.2" /end CHARACTERISTIC
/begin CHARACTERISTIC K_MDGRAD_KK "Max. Momentengradient des Klimakompressors bezogen auf 1s" VALUE 0xa082beda _REC_VAL_20_s2 131.07 _CNV_R_R_Def_m_sw_q_554_CM -3276.8 3276.7 FORMAT "%5.2" /end CHARACTERISTIC
/begin CHARACTERISTIC K_MDKWFUNK_HYS "Hysterese Momentenschwelle für Generatorentlastung funktionale Gründe" VALUE 0xa082be8c _REC_VAL_20_s2 131.07 _CNV_R_R_Def_m_sw_q_554_CM -3276.8 3276.7 FORMAT "%5.2" /end CHARACTERISTIC
/begin CHARACTERISTIC K_MDKWKOMF_HYS "Hysterese Momentenschwelle für Generatorentlastung Komfortgründe" VALUE 0xa082be90 _REC_VAL_20_s2 131.07 _CNV_R_R_Def_m_sw_q_554_CM -3276.8 3276.7 FORMAT "%5.2" /end CHARACTERISTIC
/begin CHARACTERISTIC K_MDKWRESTMXVOFF "Momentenschwelle für Verbraucherausschaltung" VALUE 0xa082be88 _REC_VAL_20_s2 131.07 _CNV_R_R_Def_m_sw_q_554_CM -3276.8 3276.7 FORMAT "%5.2" /end CHARACTERISTIC
/begin CHARACTERISTIC K_MDKWRESTMXVOFF_HYS "Hysterese Momentenschwelle für Verbraucherausschaltung" VALUE 0xa082be86 _REC_VAL_20_s2 131.07 _CNV_R_R_Def_m_sw_q_554_CM -3276.8 3276.7 FORMAT "%5.2" /end CHARACTERISTIC
/begin CHARACTERISTIC K_MDKWSICH_HYS "Hysterese Momentenschwelle für Generatorentlastung SIcherheitsgründe" VALUE 0xa082bea0 _REC_VAL_20_s2 131.07 _CNV_R_R_Def_m_sw_q_554_CM -3276.8 3276.7 FORMAT "%5.2" /end CHARACTERISTIC
/begin CHARACTERISTIC K_MDKW_FUNK "Momentenschwelle für Generatorentlastung funktionale Gründe" VALUE 0xa082be8a _REC_VAL_20_s2 131.07 _CNV_R_R_Def_m_sw_q_554_CM -3276.8 3276.7 FORMAT "%5.2" /end CHARACTERISTIC
/begin CHARACTERISTIC K_MDKW_KOMF "Momentenschwelle für Generatorentlastung Komfortgründe" VALUE 0xa082be8e _REC_VAL_20_s2 131.07 _CNV_R_R_Def_m_sw_q_554_CM -3276.8 3276.7 FORMAT "%5.2" /end CHARACTERISTIC
/begin CHARACTERISTIC K_MDKW_RESTAFU "Schwellwert Notanfahrunterstützung" VALUE 0xa082be7e _REC_VAL_20_s2 131.07 _CNV_R_R_Def_m_sw_q_554_CM -3276.8 3276.7 FORMAT "%5.2" /end CHARACTERISTIC
/begin CHARACTERISTIC K_MDKW_SICH "Momentenschwelle für Generatorentlastung Sicherheitsgründe" VALUE 0xa082be9e _REC_VAL_20_s2 131.07 _CNV_R_R_Def_m_sw_q_554_CM -3276.8 3276.7 FORMAT "%5.2" /end CHARACTERISTIC
/begin CHARACTERISTIC K_MDMAXMAN "Manuelle Vorgabe des maximalen Motormoments " VALUE 0xa082bee0 _REC_VAL_20_s2 131.07 _CNV_R_R_Def_m_sw_q_554_CM -3276.8 3276.7 FORMAT "%5.2" /end CHARACTERISTIC
/begin CHARACTERISTIC K_MDRESBN "Momentenreserve bei instabilem Bordnetz" VALUE 0xa082bd0c _REC_VAL_20_s2 131.07 _CNV_R_R_Def_m_sw_q_554_CM -3276.8 3276.7 FORMAT "%5.2" /end CHARACTERISTIC
/begin CHARACTERISTIC K_NACHFUELL12 "Nachfüll Erste Balken von Peistab" VALUE 0xa081a9ac _REC_VAL_20_u1 99.45 _CNV_R_R_Def_dez_sl_551_CM 0. 255. FORMAT "%3.0" /end CHARACTERISTIC
/begin CHARACTERISTIC K_NACHFUELL25 "Nachfüll Zweite Balken von Peistab" VALUE 0xa081a9ad _REC_VAL_20_u1 99.45 _CNV_R_R_Def_dez_sl_551_CM 0. 255. FORMAT "%3.0" /end CHARACTERISTIC
/begin CHARACTERISTIC K_NACHFUELL38 "Nachfüll Dritte Balken von Peistab" VALUE 0xa081a9ae _REC_VAL_20_u1 99.45 _CNV_R_R_Def_dez_sl_551_CM 0. 255. FORMAT "%3.0" /end CHARACTERISTIC
/begin CHARACTERISTIC K_NACHFUELL53 "Nachfüll Vierte Balken von Peistab" VALUE 0xa081a9af _REC_VAL_20_u1 99.45 _CNV_R_R_Def_dez_sl_551_CM 0. 255. FORMAT "%3.0" /end CHARACTERISTIC
/begin CHARACTERISTIC K_NACHFUELL69 "Nachfüll Fünfte Balken von Peistab" VALUE 0xa081a9b0 _REC_VAL_20_u1 99.45 _CNV_R_R_Def_dez_sl_551_CM 0. 255. FORMAT "%3.0" /end CHARACTERISTIC
/begin CHARACTERISTIC K_NACHFUELL85 "Nachfüll Sechte Balken von Peistab" VALUE 0xa081a9b1 _REC_VAL_20_u1 99.45 _CNV_R_R_Def_dez_sl_551_CM 0. 255. FORMAT "%3.0" /end CHARACTERISTIC
/begin CHARACTERISTIC K_NACHFUELL95 "Nachfüll Siebte Balken von Peistab" VALUE 0xa081a9b2 _REC_VAL_20_u1 99.45 _CNV_R_R_Def_dez_sl_551_CM 0. 255. FORMAT "%3.0" /end CHARACTERISTIC
/begin CHARACTERISTIC K_NGENOFMN "Nkw-Schwelle zur Aktivierung Generatorvolllastabschaltung" VALUE 0xa082c104 _REC_VAL_20_s2 0. _CNV_R_R_Def_n_sw_q_595_CM -32768. 32767. FORMAT "%5.0" /end CHARACTERISTIC
/begin CHARACTERISTIC K_NGENOFMX "Nkw-Schwelle zur Deaktivierung Generatorvolllastabschaltung" VALUE 0xa082c102 _REC_VAL_20_s2 0. _CNV_R_R_Def_n_sw_q_595_CM -32768. 32767. FORMAT "%5.0" /end CHARACTERISTIC
/begin CHARACTERISTIC K_NKWDYN_GRENZ "Grenzwert für negative Drehzahlgradienten zur Berechnung von Dla_uesp" VALUE 0xa0827296 _REC_VAL_20_s2 0. _CNV_R_R_Def_n_sw_q_595_CM -32768. 32767. FORMAT "%5.0" /end CHARACTERISTIC
/begin CHARACTERISTIC K_NKW_SCH "Drehzahlschwelle für Generator-Grenzmoment-Berechnung" VALUE 0xa082bc32 _REC_VAL_20_s2 0. _CNV_R_R_Def_n_sw_q_595_CM -32768. 32767. FORMAT "%5.0" /end CHARACTERISTIC
/begin CHARACTERISTIC K_NMXGENOF "Motordrehzahlschwelle für Generatorzuschaltung" VALUE 0xa082bcaa _REC_VAL_20_s2 0. _CNV_R_R_Def_n_sw_q_595_CM -32768. 32767. FORMAT "%5.0" /end CHARACTERISTIC
/begin CHARACTERISTIC K_OZABSTELL "Mindestwert für die Übernahme der Abstellzeit" VALUE 0xa081a98c _REC_VAL_20_u2 0. _CNV_R_R_Def_tn_uw__664_CM 0. 65535. FORMAT "%5.2" /end CHARACTERISTIC
/begin CHARACTERISTIC K_OZALTANZABZ "Abstellzeit für die Ausgabe der letzten Anzeige nach dem Ölcheck" VALUE 0xa081a98e _REC_VAL_20_u2 0. _CNV_R_R_Def_tn_uw__664_CM 0. 65535. FORMAT "%5.2" /end CHARACTERISTIC
/begin CHARACTERISTIC K_OZBESCHAUS "Zahl Ausgeblendet bei Lengsbescheunigung" VALUE 0xa081a9b3 _REC_VAL_20_u1 99.45 _CNV_R_R_Def_dez_sl_551_CM 0. 255. FORMAT "%3.0" /end CHARACTERISTIC
/begin CHARACTERISTIC K_OZDKNIVN "Ersatzwert für die Drehzahlkorrektur bei Oz_peilaltanz = 0" VALUE 0xa081a9b4 _REC_VAL_20_u1 74.70699999999999 _CNV_R_R_Def_niv_ub_667_CM 0. 74.70699999999999 FORMAT "%5.2" /end CHARACTERISTIC
/begin CHARACTERISTIC K_OZDKNIVPOEL "Ersatzwert für die Ölpumpe-Notlauf-Korrektur bei Oz_peilaltanz = 0" VALUE 0xa081a9b5 _REC_VAL_20_u1 74.70699999999999 _CNV_R_R_Def_niv_ub_667_CM 0. 74.70699999999999 FORMAT "%5.2" /end CHARACTERISTIC
/begin CHARACTERISTIC K_OZLBESCHN "Negative Längsbeschleunigung Ausblendung-Schwelle " VALUE 0xa081a9a0 _REC_VAL_20_s1 63.75 _CNV_R_R_Def_ac_sb__552_CM -32. 31.75 FORMAT "%4.1" /end CHARACTERISTIC
/begin CHARACTERISTIC K_OZLBESCHORI "Längsbeschleunigung Ausblendung-Schwelle beim OriMw" VALUE 0xa081a9a1 _REC_VAL_20_s1 63.75 _CNV_R_R_Def_ac_sb__552_CM -32. 31.75 FORMAT "%4.1" /end CHARACTERISTIC
/begin CHARACTERISTIC K_OZLBESCHP "Positive Längsbeschleunigung Ausblendung-Schwelle " VALUE 0xa081a9a2 _REC_VAL_20_s1 63.75 _CNV_R_R_Def_ac_sb__552_CM -32. 31.75 FORMAT "%4.1" /end CHARACTERISTIC
/begin CHARACTERISTIC K_OZLBESCHST "Längsbeschleunigung Ausblendung-Schwelle im Stand" VALUE 0xa081a9a3 _REC_VAL_20_s1 63.75 _CNV_R_R_Def_ac_sb__552_CM -32. 31.75 FORMAT "%4.1" /end CHARACTERISTIC
/begin CHARACTERISTIC K_OZLUFTMAX "Plausibel max luftsprung" VALUE 0xa081a990 _REC_VAL_20_u2 102.398436 _CNV_R_R_Def_p_sw_q_576_CM 0. 2559.9609 /end CHARACTERISTIC
/begin CHARACTERISTIC K_OZMAXSLOPE "Maximale erlaubte Steigung" VALUE 0xa081a970 _REC_VAL_20_s2 99.83843999999999 _CNV_R_R_Def_f_sw_b_623_CM -64. 63.998 /end CHARACTERISTIC
/begin CHARACTERISTIC K_OZMINSLOPE "Kleinste erlaubte Steigung (<0)" VALUE 0xa081a972 _REC_VAL_20_s2 99.83843999999999 _CNV_R_R_Def_f_sw_b_623_CM -64. 63.998 /end CHARACTERISTIC
/begin CHARACTERISTIC K_OZMWK "Anzahl der Messwerte für Kurzzeit-Mittelwert Niveau" VALUE 0xa081a9b6 _REC_VAL_20_u1 99.45 _CNV_R_R_Def_dez_sl_551_CM 0. 255. FORMAT "%3.0" /end CHARACTERISTIC
/begin CHARACTERISTIC K_OZMWL "Anzahl der Messwerte für Langzeit-Mittelwert Niveau" VALUE 0xa081a992 _REC_VAL_20_u2 0. _CNV_R_R_Def_dez_sl_551_CM 0. 65535. FORMAT "%5.0" /end CHARACTERISTIC
/begin CHARACTERISTIC K_OZMWOR "Anzahl der Messwerte für Orientierungsmessung" VALUE 0xa081a994 _REC_VAL_20_u2 0. _CNV_R_R_Def_dez_sl_551_CM 0. 65535. FORMAT "%5.0" /end CHARACTERISTIC
/begin CHARACTERISTIC K_OZMWV "Anzahl der Messwerte für vorgezogenen Mittelwert Niveau" VALUE 0xa081a996 _REC_VAL_20_u2 0. _CNV_R_R_Def_dez_sl_551_CM 0. 65535. FORMAT "%5.0" /end CHARACTERISTIC
/begin CHARACTERISTIC K_OZNFERR "Nachfüllmengenanzeige bei PreCheck OK" VALUE 0xa081a9b7 _REC_VAL_20_u1 99.45 _CNV_R_R_Def_dez_sl_551_CM 0. 255. FORMAT "%3.0" /end CHARACTERISTIC
/begin CHARACTERISTIC K_OZNFML "Nachfüllmengenanzeige bei Messung läuft" VALUE 0xa081a9b8 _REC_VAL_20_u1 99.45 _CNV_R_R_Def_dez_sl_551_CM 0. 255. FORMAT "%3.0" /end CHARACTERISTIC
/begin CHARACTERISTIC K_OZNFOELCKO "Nachfüllmengenanzeige bei PreCheck KO" VALUE 0xa081a9b9 _REC_VAL_20_u1 99.45 _CNV_R_R_Def_dez_sl_551_CM 0. 255. FORMAT "%3.0" /end CHARACTERISTIC
/begin CHARACTERISTIC K_OZNFOELCOK "Nachfüllmengenanzeige bei PreCheck OK" VALUE 0xa081a9ba _REC_VAL_20_u1 99.45 _CNV_R_R_Def_dez_sl_551_CM 0. 255. FORMAT "%3.0" /end CHARACTERISTIC
/begin CHARACTERISTIC K_OZNMOTMAX "obere Drehzahlgrenze für drehzahlkorrigierten Niveaumittelwert" VALUE 0xa081a974 _REC_VAL_20_s2 0. _CNV_R_R_Def_n_sw_q_595_CM -32768. 32767. FORMAT "%5.0" /end CHARACTERISTIC
/begin CHARACTERISTIC K_OZNMOTMIN "untere Drehzahlgrenze für drehzahlkorrigierten Niveaumittelwert" VALUE 0xa081a976 _REC_VAL_20_s2 0. _CNV_R_R_Def_n_sw_q_595_CM -32768. 32767. FORMAT "%5.0" /end CHARACTERISTIC
/begin CHARACTERISTIC K_OZOELCABZ "Minimale Abstellzeit für den ÖlCheck" VALUE 0xa081a998 _REC_VAL_20_u2 0. _CNV_R_R_Def_tn_uw__664_CM 0. 65535. FORMAT "%5.2" /end CHARACTERISTIC
/begin CHARACTERISTIC K_OZOELCOK "PreDriveCheck-Schwelle" VALUE 0xa081a9bb _REC_VAL_20_u1 74.70699999999999 _CNV_R_R_Def_niv_ub_667_CM 0. 74.70699999999999 FORMAT "%5.2" /end CHARACTERISTIC
/begin CHARACTERISTIC K_OZOELCVERZ "Verzögerung für den Ölcheck" VALUE 0xa081a9bc _REC_VAL_20_u1 99.45 _CNV_R_R_Def_td_ub__611_CM 0. 255. FORMAT "%5.2" /end CHARACTERISTIC
/begin CHARACTERISTIC K_OZOELVERB "Ölverbrauch" VALUE 0xa081a99a _REC_VAL_20_u2 0. _CNV_R_R_Def_dez_sl_551_CM 0. 65535. FORMAT "%5.0" /end CHARACTERISTIC
/begin CHARACTERISTIC K_OZORIPEILTZO "Ausgabeniveau für die tote Zone Orientierung-Check Peilstab mit alter Anzeige >= Mitte" VALUE 0xa081a9bd _REC_VAL_20_u1 74.70699999999999 _CNV_R_R_Def_niv_ub_667_CM 0. 74.70699999999999 FORMAT "%5.2" /end CHARACTERISTIC
/begin CHARACTERISTIC K_OZORIPEILTZU "Ausgabeniveau für die tote Zone Orientierung-Check Peilstab mit alter Anzeige < Mitte" VALUE 0xa081a9be _REC_VAL_20_u1 74.70699999999999 _CNV_R_R_Def_niv_ub_667_CM 0. 74.70699999999999 FORMAT "%5.2" /end CHARACTERISTIC
/begin CHARACTERISTIC K_OZPEIL12 "Erste Balken von Peistab" VALUE 0xa081a9bf _REC_VAL_20_u1 74.70699999999999 _CNV_R_R_Def_niv_ub_667_CM 0. 74.70699999999999 FORMAT "%5.2" /end CHARACTERISTIC
/begin CHARACTERISTIC K_OZPEIL25 "Zweite Balken von Peistab" VALUE 0xa081a9c0 _REC_VAL_20_u1 74.70699999999999 _CNV_R_R_Def_niv_ub_667_CM 0. 74.70699999999999 FORMAT "%5.2" /end CHARACTERISTIC
/begin CHARACTERISTIC K_OZPEIL38 "Dritte Balken von Peistab" VALUE 0xa081a9c1 _REC_VAL_20_u1 74.70699999999999 _CNV_R_R_Def_niv_ub_667_CM 0. 74.70699999999999 FORMAT "%5.2" /end CHARACTERISTIC
/begin CHARACTERISTIC K_OZPEIL53 "Vierte Balken von Peistab" VALUE 0xa081a9c2 _REC_VAL_20_u1 74.70699999999999 _CNV_R_R_Def_niv_ub_667_CM 0. 74.70699999999999 FORMAT "%5.2" /end CHARACTERISTIC
/begin CHARACTERISTIC K_OZPEIL69 "Fünfte Balken von Peistab" VALUE 0xa081a9c3 _REC_VAL_20_u1 74.70699999999999 _CNV_R_R_Def_niv_ub_667_CM 0. 74.70699999999999 FORMAT "%5.2" /end CHARACTERISTIC
/begin CHARACTERISTIC K_OZPEIL85 "Sechte Balken von Peistab" VALUE 0xa081a9c4 _REC_VAL_20_u1 74.70699999999999 _CNV_R_R_Def_niv_ub_667_CM 0. 74.70699999999999 FORMAT "%5.2" /end CHARACTERISTIC
/begin CHARACTERISTIC K_OZPEILDO "Delta + Hysterese Peilstab" VALUE 0xa081a9c5 _REC_VAL_20_u1 74.70699999999999 _CNV_R_R_Def_niv_ub_667_CM 0. 74.70699999999999 FORMAT "%5.2" /end CHARACTERISTIC
/begin CHARACTERISTIC K_OZPEILDOMIN "Delta + Hysterese Peilstab bei Min" VALUE 0xa081a9c6 _REC_VAL_20_u1 74.70699999999999 _CNV_R_R_Def_niv_ub_667_CM 0. 74.70699999999999 FORMAT "%5.2" /end CHARACTERISTIC
/begin CHARACTERISTIC K_OZPEILDU "Delta - Hysterese Peilstab" VALUE 0xa081a9c7 _REC_VAL_20_u1 74.70699999999999 _CNV_R_R_Def_niv_ub_667_CM 0. 74.70699999999999 FORMAT "%5.2" /end CHARACTERISTIC
/begin CHARACTERISTIC K_OZPEILDU38 "Delta - Hysterese Peilstab bei 1/4" VALUE 0xa081a9c8 _REC_VAL_20_u1 74.70699999999999 _CNV_R_R_Def_niv_ub_667_CM 0. 74.70699999999999 FORMAT "%5.2" /end CHARACTERISTIC
/begin CHARACTERISTIC K_OZPEILERR "Balkenanzeige im Fehlerfall" VALUE 0xa081a9c9 _REC_VAL_20_u1 99.45 _CNV_R_R_Def_dez_sl_551_CM 0. 255. FORMAT "%3.0" /end CHARACTERISTIC
/begin CHARACTERISTIC K_OZPEILKSPR "Max zulässiger Niveau-Unterschied zwischen alten Anzeige und VorMw" VALUE 0xa081a9ca _REC_VAL_20_u1 74.70699999999999 _CNV_R_R_Def_niv_ub_667_CM 0. 74.70699999999999 FORMAT "%5.2" /end CHARACTERISTIC
/begin CHARACTERISTIC K_OZPEILLP85 "Bankenanzeige für Niveau bei 85%" VALUE 0xa081a9cb _REC_VAL_20_u1 99.45 _CNV_R_R_Def_dez_sl_551_CM 0. 255. FORMAT "%3.0" /end CHARACTERISTIC
/begin CHARACTERISTIC K_OZPEILML "Balkenanzeige bei Messung läuft" VALUE 0xa081a9cc _REC_VAL_20_u1 99.45 _CNV_R_R_Def_dez_sl_551_CM 0. 255. FORMAT "%3.0" /end CHARACTERISTIC
/begin CHARACTERISTIC K_OZPEILOELCKO "Balkenanzeige bei ÖlCheck KO" VALUE 0xa081a9cd _REC_VAL_20_u1 99.45 _CNV_R_R_Def_dez_sl_551_CM 0. 255. FORMAT "%3.0" /end CHARACTERISTIC
/begin CHARACTERISTIC K_OZPEILOELCOK "Balkenanzeige bei ÖlCheck OK" VALUE 0xa081a9ce _REC_VAL_20_u1 99.45 _CNV_R_R_Def_dez_sl_551_CM 0. 255. FORMAT "%3.0" /end CHARACTERISTIC
/begin CHARACTERISTIC K_OZPEILSPRUNG "Max zulässiger Niveau-Unterschied zwischen LangMw" VALUE 0xa081a9cf _REC_VAL_20_u1 74.70699999999999 _CNV_R_R_Def_niv_ub_667_CM 0. 74.70699999999999 FORMAT "%5.2" /end CHARACTERISTIC
/begin CHARACTERISTIC K_OZQBESCHN "Negative Querbeschleunigung Ausblendung-Schwelle " VALUE 0xa081a9a4 _REC_VAL_20_s1 63.75 _CNV_R_R_Def_ac_sb__552_CM -32. 31.75 FORMAT "%4.1" /end CHARACTERISTIC
/begin CHARACTERISTIC K_OZQBESCHORI "Querbeschleunigung Ausblendung-Schwelle Beim OriMw" VALUE 0xa081a9a5 _REC_VAL_20_s1 63.75 _CNV_R_R_Def_ac_sb__552_CM -32. 31.75 FORMAT "%4.1" /end CHARACTERISTIC
/begin CHARACTERISTIC K_OZQBESCHP "Positive Querbeschleunigung Ausblendung-Schwelle " VALUE 0xa081a9a6 _REC_VAL_20_s1 63.75 _CNV_R_R_Def_ac_sb__552_CM -32. 31.75 FORMAT "%4.1" /end CHARACTERISTIC
/begin CHARACTERISTIC K_OZQBESCHST "Querbeschleunigung Ausblendung-Schwelle im Stand" VALUE 0xa081a9a7 _REC_VAL_20_s1 63.75 _CNV_R_R_Def_ac_sb__552_CM -32. 31.75 FORMAT "%4.1" /end CHARACTERISTIC
/begin CHARACTERISTIC K_OZSTANDVERZ "Verzögerung für Fahrzeug steht" VALUE 0xa081a9d0 _REC_VAL_20_u1 99.45 _CNV_R_R_Def_td_ub__611_CM 0. 255. FORMAT "%5.2" /end CHARACTERISTIC
/begin CHARACTERISTIC K_OZSTARTABZ "Mindestlaufzeit für die Übernahme der Abstellzeit" VALUE 0xa081a99c _REC_VAL_20_u2 98.30250000000001 _CNV_R_R_Def_td_uw__673_CM 0. 655.35 FORMAT "%5.2" /end CHARACTERISTIC
/begin CHARACTERISTIC K_OZSTARTVERZ "QLT Start Verzögerung nach Drehzal" VALUE 0xa081a9d1 _REC_VAL_20_u1 99.45 _CNV_R_R_Def_td_ub__611_CM 0. 255. FORMAT "%5.2" /end CHARACTERISTIC
/begin CHARACTERISTIC K_OZSTMINW "Minimale Strecke für die Steigungserkennung" VALUE 0xa081a99e _REC_VAL_20_u2 9.999800000000001 _CNV_R_R_Def_f_uw_b_618_CM 0. 9.999800000000001 FORMAT "%7.4" /end CHARACTERISTIC
/begin CHARACTERISTIC K_OZTEMPBW "Temperaturschwelle Öltemperatur Motor betriebswarm" VALUE 0xa081a978 _REC_VAL_20_s2 131.07 _CNV_R_R_Def_t_sw_q_578_CM -3276.8 3276.7 FORMAT "%4.1" /end CHARACTERISTIC
/begin CHARACTERISTIC K_OZTKOELP "Mindest Temperatur für Korrektur Notlauf Ölpumpe" VALUE 0xa081a97a _REC_VAL_20_s2 98.30250000000001 _CNV_R_R_Def_t_sw_q_579_CM -327.68 327.67 FORMAT "%5.2" /end CHARACTERISTIC
/begin CHARACTERISTIC K_OZTLPF "Faktor für den LowPass-Filter Öltemperatur" VALUE 0xa081ac64 _REC_VAL_20_u2 99.9984 _CNV_R_R_Def_f_uw_b_555_CM 0. 99.9984 /end CHARACTERISTIC
/begin CHARACTERISTIC K_OZTLPFMDL "Faktor für den LowPass-Filter Öltemperatur beim Modelltemperatur" VALUE 0xa081ac66 _REC_VAL_20_u2 99.9984 _CNV_R_R_Def_f_uw_b_555_CM 0. 99.9984 /end CHARACTERISTIC
/begin CHARACTERISTIC K_OZTORMIN "Mindest Temperatur für OrientierungMw QLT" VALUE 0xa081a97c _REC_VAL_20_s2 98.30250000000001 _CNV_R_R_Def_t_sw_q_579_CM -327.68 327.67 FORMAT "%5.2" /end CHARACTERISTIC
/begin CHARACTERISTIC K_OZTORMINF "Mindest Temperatur für OrientierungMw QLT während der Fahrt" VALUE 0xa081a97e _REC_VAL_20_s2 98.30250000000001 _CNV_R_R_Def_t_sw_q_579_CM -327.68 327.67 FORMAT "%5.2" /end CHARACTERISTIC
/begin CHARACTERISTIC K_OZTPOOFF "Verzögerung für Abschaltung Korrektur Notlauf Ölpumpe" VALUE 0xa081a9d2 _REC_VAL_20_u1 99.45 _CNV_R_R_Def_td_ub__611_CM 0. 255. FORMAT "%5.2" /end CHARACTERISTIC
/begin CHARACTERISTIC K_OZTPOON "Verzögerung für Eischaltung Korrektur Notlauf Ölpumpe" VALUE 0xa081a9d3 _REC_VAL_20_u1 99.45 _CNV_R_R_Def_td_ub__611_CM 0. 255. FORMAT "%5.2" /end CHARACTERISTIC
/begin CHARACTERISTIC K_OZUEBERF "Schwelle für die Überfüllung" VALUE 0xa081a9d4 _REC_VAL_20_u1 74.70699999999999 _CNV_R_R_Def_niv_ub_667_CM 0. 74.70699999999999 FORMAT "%5.2" /end CHARACTERISTIC
/begin CHARACTERISTIC K_OZUEFCNT "Anzahl Werte für Überfüllung" VALUE 0xa081a9d5 _REC_VAL_20_u1 99.45 _CNV_R_R_Def_dez_sl_551_CM 0. 255. FORMAT "%3.0" /end CHARACTERISTIC
/begin CHARACTERISTIC K_OZUEFNLB "Negative Längsbeschleunigungsgrenze für die Überfüllung" VALUE 0xa081a9a8 _REC_VAL_20_s1 63.75 _CNV_R_R_Def_ac_sb__552_CM -32. 31.75 FORMAT "%4.1" /end CHARACTERISTIC
/begin CHARACTERISTIC K_OZUEFNQB "Negative Querbeschleunigungsgrenze für die Überfüllung" VALUE 0xa081a9a9 _REC_VAL_20_s1 63.75 _CNV_R_R_Def_ac_sb__552_CM -32. 31.75 FORMAT "%4.1" /end CHARACTERISTIC
/begin CHARACTERISTIC K_OZUEFNST "Maximale negative Steigung für die Überfüllungserkenung" VALUE 0xa081a980 _REC_VAL_20_s2 99.83843999999999 _CNV_R_R_Def_f_sw_b_623_CM -64. 63.998 /end CHARACTERISTIC
/begin CHARACTERISTIC K_OZUEFODZ "Obere Drehzahlgrenze für die Überfüllungserkennung" VALUE 0xa081a982 _REC_VAL_20_s2 0. _CNV_R_R_Def_n_sw_q_595_CM -32768. 32767. FORMAT "%5.0" /end CHARACTERISTIC
/begin CHARACTERISTIC K_OZUEFPLB "Positive Längsbeschleunigungsgrenze für die Überfüllung" VALUE 0xa081a9aa _REC_VAL_20_s1 63.75 _CNV_R_R_Def_ac_sb__552_CM -32. 31.75 FORMAT "%4.1" /end CHARACTERISTIC
/begin CHARACTERISTIC K_OZUEFPQB "Positive Querbeschleunigungsgrenze für die Überfüllung" VALUE 0xa081a9ab _REC_VAL_20_s1 63.75 _CNV_R_R_Def_ac_sb__552_CM -32. 31.75 FORMAT "%4.1" /end CHARACTERISTIC
/begin CHARACTERISTIC K_OZUEFPST "Maximale positive Steigung für die Überfüllungserkenung" VALUE 0xa081a984 _REC_VAL_20_s2 99.83843999999999 _CNV_R_R_Def_f_sw_b_623_CM -64. 63.998 /end CHARACTERISTIC
/begin CHARACTERISTIC K_OZUEFTEM "Mindestöltemperatur für die Überfüllungserkennung" VALUE 0xa081a986 _REC_VAL_20_s2 131.07 _CNV_R_R_Def_t_sw_q_578_CM -3276.8 3276.7 FORMAT "%4.1" /end CHARACTERISTIC
/begin CHARACTERISTIC K_OZUEFUDZ "Untere Drehzahlgrenze für die Überfüllungserkennung" VALUE 0xa081a988 _REC_VAL_20_s2 0. _CNV_R_R_Def_n_sw_q_595_CM -32768. 32767. FORMAT "%5.0" /end CHARACTERISTIC
/begin CHARACTERISTIC K_OZUEFVERZ "Verzögerung für erkennung Überfüllung" VALUE 0xa081a9d6 _REC_VAL_20_u1 99.45 _CNV_R_R_Def_dez_sl_551_CM 0. 255. FORMAT "%3.0" /end CHARACTERISTIC
/begin CHARACTERISTIC K_OZVERBFAK "Faktor für die Anpassung des Ölverbrauches" VALUE 0xa081a9d7 _REC_VAL_20_u1 7.9687 _CNV_R_R_Def_f_ub_b_694_CM 0. 7.9687 FORMAT "%5.2" /end CHARACTERISTIC
/begin CHARACTERISTIC K_OZVERLORI "Schwelle für Orientierungswert Ölniveau (Verlustwarnung)" VALUE 0xa081a96e _REC_VAL_20_u1 74.70699999999999 _CNV_R_R_Def_niv_ub_667_CM 0. 74.70699999999999 FORMAT "%5.2" /end CHARACTERISTIC
/begin CHARACTERISTIC K_OZVERZERRBSD "Verzögerung für Peilstab-Fehlerfall beim BSD-Fehler" VALUE 0xa081a9d8 _REC_VAL_20_u1 99.45 _CNV_R_R_Def_td_ub__611_CM 0. 255. FORMAT "%5.2" /end CHARACTERISTIC
/begin CHARACTERISTIC K_OZVORMV "Korrektur von Vormw für Peilstab" VALUE 0xa081a98a _REC_VAL_20_s2 63.999 _CNV_R_R_Def_f_sw_b_556_CM -32. 31.999 FORMAT "%7.4" /end CHARACTERISTIC
/begin CHARACTERISTIC K_OZVORPEILMIN "Niveau Ausgabe (für die Peilstabanzeige) bei VorMw auf min und LangMw über 1/4" VALUE 0xa081a9d9 _REC_VAL_20_u1 74.70699999999999 _CNV_R_R_Def_niv_ub_667_CM 0. 74.70699999999999 FORMAT "%5.2" /end CHARACTERISTIC
/begin CHARACTERISTIC K_OZZINI "Zeit nach dem Abwürgen für den Aufruf des ini2-Prozess" VALUE 0xa081a9da _REC_VAL_20_u1 99.45 _CNV_R_R_Def_td_ub__611_CM 0. 255. FORMAT "%5.2" /end CHARACTERISTIC
/begin CHARACTERISTIC K_PR_GENOFFVL "Prio zur Begrenzung Generatormoment bei Volllast" VALUE 0xa082c0e5 _REC_VAL_20_u1 99.45 _CNV_R_R_Def_dez_sl_551_CM 0. 255. FORMAT "%3.0" /end CHARACTERISTIC
/begin CHARACTERISTIC K_PR_GENSTOFF "Priorität der Generatorentlastung im Start" VALUE 0xa082bcc0 _REC_VAL_20_u1 99.45 _CNV_R_R_Def_dez_sl_551_CM 0. 255. FORMAT "%3.0" /end CHARACTERISTIC
/begin CHARACTERISTIC K_PR_IERRAPPL "Prio zur Begrenzung Generatormoment" VALUE 0xa082bca5 _REC_VAL_20_u1 99.45 _CNV_R_R_Def_dez_sl_551_CM 0. 255. FORMAT "%3.0" /end CHARACTERISTIC
/begin CHARACTERISTIC K_PR_IERRTESTER "Prio zur Begrenzung Generatormoment" VALUE 0xa082bca6 _REC_VAL_20_u1 99.45 _CNV_R_R_Def_dez_sl_551_CM 0. 255. FORMAT "%3.0" /end CHARACTERISTIC
/begin CHARACTERISTIC K_PR_MDDYN "Priorität der Generatordynamikbegrenzung für iGR" VALUE 0xa082bc3a _REC_VAL_20_u1 99.45 _CNV_R_R_Def_dez_sl_551_CM 0. 255. FORMAT "%3.0" /end CHARACTERISTIC
/begin CHARACTERISTIC K_PR_MDFUNK "Prio zur Begrenzung Generatormoment" VALUE 0xa082be76 _REC_VAL_20_u1 99.45 _CNV_R_R_Def_dez_sl_551_CM 0. 255. FORMAT "%3.0" /end CHARACTERISTIC
/begin CHARACTERISTIC K_PR_MDKOMF "Prio zur Begrenzung Generatormoment" VALUE 0xa082be77 _REC_VAL_20_u1 99.45 _CNV_R_R_Def_dez_sl_551_CM 0. 255. FORMAT "%3.0" /end CHARACTERISTIC
/begin CHARACTERISTIC K_PR_MDSICH "Prio zur Begrenzung Generatormoment" VALUE 0xa082be79 _REC_VAL_20_u1 99.45 _CNV_R_R_Def_dez_sl_551_CM 0. 255. FORMAT "%3.0" /end CHARACTERISTIC
/begin CHARACTERISTIC K_PR_MDTEST "Priorität zum Testen der Generatorentlastung" VALUE 0xa082be78 _REC_VAL_20_u1 99.45 _CNV_R_R_Def_dez_sl_551_CM 0. 255. FORMAT "%3.0" /end CHARACTERISTIC
/begin CHARACTERISTIC K_PR_RENNST "Prio zur Begrenzung Generatormoment bei Rennstart" VALUE 0xa082c0e6 _REC_VAL_20_u1 99.45 _CNV_R_R_Def_dez_sl_551_CM 0. 255. FORMAT "%3.0" /end CHARACTERISTIC
/begin CHARACTERISTIC K_PR_RENNSTAGM "Prio zur Begrenzung Generatormoment bei Rennstart" VALUE 0xa082c0e7 _REC_VAL_20_u1 99.45 _CNV_R_R_Def_dez_sl_551_CM 0. 255. FORMAT "%3.0" /end CHARACTERISTIC
/begin CHARACTERISTIC K_RLMXGENOF "relative Luftfüllungschwelle für Generatorzuschaltung" VALUE 0xa082bcac _REC_VAL_20_s2 98.30250000000001 _CNV_R_R_Def_rf_sw__598_CM -327.68 327.67 FORMAT "%7.4" /end CHARACTERISTIC
/begin CHARACTERISTIC K_SCHNKWSPGW "Drehzahlschwelle für Rücknahme LR Verringerung nach Spannungswächter" VALUE 0xa082bd0e _REC_VAL_20_s2 0. _CNV_R_R_Def_n_sw_q_595_CM -32768. 32767. FORMAT "%5.0" /end CHARACTERISTIC
/begin CHARACTERISTIC K_SCHNKW_IPMNA "Drehzahlschwelle Berechnung iPM NA" VALUE 0xa082be7a _REC_VAL_20_s2 0. _CNV_R_R_Def_n_sw_q_595_CM -32768. 32767. FORMAT "%5.0" /end CHARACTERISTIC
/begin CHARACTERISTIC K_SCHPRLRTEST "Mindestpriorität zur Loadresponsevorgabe zu Testzwecken" VALUE 0xa082bd19 _REC_VAL_20_u1 99.45 _CNV_R_R_Def_dez_sl_551_CM 0. 255. FORMAT "%3.0" /end CHARACTERISTIC
/begin CHARACTERISTIC K_SCHPR_KKMN "Mindestpriorität zur Abschaltung Klimakompressor" VALUE 0xa082beb0 _REC_VAL_20_u1 99.45 _CNV_R_R_Def_dez_sl_551_CM 0. 255. FORMAT "%3.0" /end CHARACTERISTIC
/begin CHARACTERISTIC K_SCHPR_KKOFF "Mindestpriorität für Begrenzung Klimakompressor" VALUE 0xa082beb1 _REC_VAL_20_u1 99.45 _CNV_R_R_Def_dez_sl_551_CM 0. 255. FORMAT "%3.0" /end CHARACTERISTIC
/begin CHARACTERISTIC K_SCHWPRSPWGLR1 "Schwellwert für Spannungsreglereingriff auf Loadresponse" VALUE 0xa082bd1a _REC_VAL_20_u1 99.45 _CNV_R_R_Def_dez_sl_551_CM 0. 255. FORMAT "%3.0" /end CHARACTERISTIC
/begin CHARACTERISTIC K_SCHWPRSPWGLR2 "Schwellwert für Spannungsreglereingriff auf Loadresponse" VALUE 0xa082bd1b _REC_VAL_20_u1 99.45 _CNV_R_R_Def_dez_sl_551_CM 0. 255. FORMAT "%3.0" /end CHARACTERISTIC
/begin CHARACTERISTIC K_SCHWPRSPWGLR3 "Schwellwert für Spannungsreglereingriff auf Loadresponse" VALUE 0xa082bd1c _REC_VAL_20_u1 99.45 _CNV_R_R_Def_dez_sl_551_CM 0. 255. FORMAT "%3.0" /end CHARACTERISTIC
/begin CHARACTERISTIC K_SCHWPRSPWGLR4 "Schwellwert für Spannungsreglereingriff auf Loadresponse" VALUE 0xa082bd1d _REC_VAL_20_u1 99.45 _CNV_R_R_Def_dez_sl_551_CM 0. 255. FORMAT "%3.0" /end CHARACTERISTIC
/begin CHARACTERISTIC K_SCHWPRSPWGLR5 "Schwellwert für Spannungsreglereingriff auf Loadresponse" VALUE 0xa082bd1e _REC_VAL_20_u1 99.45 _CNV_R_R_Def_dez_sl_551_CM 0. 255. FORMAT "%3.0" /end CHARACTERISTIC
/begin CHARACTERISTIC K_SCH_ANFAHR "Pwg_ist-Anfahrschwelle" VALUE 0xa082be98 _REC_VAL_20_s2 95.99852999999999 _CNV_R_R_Def_wdk_sw_683_CM -800. 799.9755 FORMAT "%5.2" /end CHARACTERISTIC
/begin CHARACTERISTIC K_SCH_MDNAVERL "Momentenchwelle Entlastung wegen Sicherheit" VALUE 0xa082be9a _REC_VAL_20_s2 131.07 _CNV_R_R_Def_m_sw_q_554_CM -3276.8 3276.7 FORMAT "%5.2" /end CHARACTERISTIC
/begin CHARACTERISTIC K_SCH_NKWENTL "Drehzahlschwelle Entlastung wegen Sicherheit" VALUE 0xa082be9c _REC_VAL_20_s2 0. _CNV_R_R_Def_n_sw_q_595_CM -32768. 32767. FORMAT "%5.0" /end CHARACTERISTIC
/begin CHARACTERISTIC K_SCH_NKWGRAD "Schwelle Drehzahlgradient gefiltert" VALUE 0xa082be7d _REC_VAL_20_s1 81.60000000000001 _CNV_R_R_Def_ngrd_s_661_CM -4096. 4064. FORMAT "%5.2" /end CHARACTERISTIC
/begin CHARACTERISTIC K_SCH_PWGRENNST "Pwg_ist-Schwelle für Rennstart" VALUE 0xa082c0f0 _REC_VAL_20_s2 95.99852999999999 _CNV_R_R_Def_wdk_sw_683_CM -800. 799.9755 FORMAT "%5.2" /end CHARACTERISTIC
/begin CHARACTERISTIC K_SCH_VSICH "Schwelle Fahrzeug steht" VALUE 0xa082bea2 _REC_VAL_20_u2 100.8 _CNV_R_R_Def_v_uw_q_726_CM 0. 360. FORMAT "%5.0" /end CHARACTERISTIC
/begin CHARACTERISTIC K_SKLANN_NKW "Breiten KLANN für Nkw-Eingang" VAL_BLK 0xa082ea10 _REC_VAL_2_s2 0. _CNV_R_R_Def_n_sw_q_595_CM -32768. 32767. FORMAT "%5.0" NUMBER 15 /end CHARACTERISTIC
/begin CHARACTERISTIC K_SKLANN_RK "Breiten KLANN für Rk-Eingang" VAL_BLK 0xa082ea30 _REC_VAL_2_u2 31.99950000000001 _CNV_R_R_Def_f_uw_b_588_CM 0. 31.9995 FORMAT "%7.4" NUMBER 15 /end CHARACTERISTIC
/begin CHARACTERISTIC K_SKLANN_TMOT "Breiten KLANN für Tmot-Eingang" VAL_BLK 0xa082ea50 _REC_VAL_2_s2 98.30250000000001 _CNV_R_R_Def_t_sw_q_579_CM -327.68 327.67 FORMAT "%5.2" NUMBER 15 /end CHARACTERISTIC
/begin CHARACTERISTIC K_TABSTGNMN "minimale Abstellzeit für Generatorreduzierung" VALUE 0xa082bcb6 _REC_VAL_20_u2 0. _CNV_R_R_Def_dez_sl_551_CM 0. 65535. FORMAT "%5.0" /end CHARACTERISTIC
/begin CHARACTERISTIC K_TABSTGNMX "maximale Abstellzeit für Generatorreduzierung" VALUE 0xa082bcb8 _REC_VAL_20_u2 0. _CNV_R_R_Def_dez_sl_551_CM 0. 65535. FORMAT "%5.0" /end CHARACTERISTIC
/begin CHARACTERISTIC K_TATMGENOF "Motordrehzahlschwelle  Katalysatortemperatur" VALUE 0xa082bcae _REC_VAL_20_s2 131.07 _CNV_R_R_Def_t_sw_q_578_CM -3276.8 3276.7 FORMAT "%4.1" /end CHARACTERISTIC
/begin CHARACTERISTIC K_TDAFU "Ausschaltverzögerung B_notafu" VALUE 0xa082beb4 _REC_VAL_20_u2 98.30250000000001 _CNV_R_R_Def_td_uw__673_CM 0. 655.35 FORMAT "%5.2" /end CHARACTERISTIC
/begin CHARACTERISTIC K_TDGENOFFST "Zeitverzögerung B_start für Spannung im Start Generator" VALUE 0xa082bcba _REC_VAL_20_u2 131.07 _CNV_R_R_Def_td_ub__574_CM 0. 6553.5 FORMAT "%4.1" /end CHARACTERISTIC
/begin CHARACTERISTIC K_TDKLANN "Verzögerungszeit für Aktivierungssignal" VALUE 0xa082e9ae _REC_VAL_20_u1 25.5 _CNV_R_R_Def_td_ub__574_CM 0. 25.5 FORMAT "%4.1" /end CHARACTERISTIC
/begin CHARACTERISTIC K_TD_GENBVL "Verzögerungszeit Volllast" VALUE 0xa082c0f6 _REC_VAL_20_u2 131.07 _CNV_R_R_Def_td_ub__574_CM 0. 6553.5 FORMAT "%4.1" /end CHARACTERISTIC
/begin CHARACTERISTIC K_TD_GENOFVL "Verzögerungszeit Generatorvolllastabschaltung" VALUE 0xa082c0f8 _REC_VAL_20_u2 131.07 _CNV_R_R_Def_td_ub__574_CM 0. 6553.5 FORMAT "%4.1" /end CHARACTERISTIC
/begin CHARACTERISTIC K_TD_GETRIEBE "Entprellzeit Gangwechsel aus N" VALUE 0xa082bed3 _REC_VAL_20_u1 2.55 _CNV_R_R_Def_td_uw__673_CM 0. 2.55 FORMAT "%5.2" /end CHARACTERISTIC
/begin CHARACTERISTIC K_TD_KKOFF "Erlaubte Dauer der KK-Abkopplung" VALUE 0xa082be80 _REC_VAL_20_u2 98.30250000000001 _CNV_R_R_Def_td_uw__673_CM 0. 655.35 FORMAT "%5.2" /end CHARACTERISTIC
/begin CHARACTERISTIC K_TD_KKOFFSICH "Erlaubte Zeit der Klimakompressorabkopplung" VALUE 0xa082be82 _REC_VAL_20_u2 98.30250000000001 _CNV_R_R_Def_td_uw__673_CM 0. 655.35 FORMAT "%5.2" /end CHARACTERISTIC
/begin CHARACTERISTIC K_TD_MDENTFUNKRES "Verzögerungszeit" VALUE 0xa082bea8 _REC_VAL_20_u2 98.30250000000001 _CNV_R_R_Def_td_uw__673_CM 0. 655.35 FORMAT "%5.2" /end CHARACTERISTIC
/begin CHARACTERISTIC K_TD_MDENTKKRES "Verzögerungszeit" VALUE 0xa082beac _REC_VAL_20_u2 98.30250000000001 _CNV_R_R_Def_td_uw__673_CM 0. 655.35 FORMAT "%5.2" /end CHARACTERISTIC
/begin CHARACTERISTIC K_TD_MDENTKOMFRES "Verzögerungszeit" VALUE 0xa082bea4 _REC_VAL_20_u2 98.30250000000001 _CNV_R_R_Def_td_uw__673_CM 0. 655.35 FORMAT "%5.2" /end CHARACTERISTIC
/begin CHARACTERISTIC K_TD_MDENTKOMFSET "Verzögerungszeit" VALUE 0xa082bea6 _REC_VAL_20_u2 98.30250000000001 _CNV_R_R_Def_td_uw__673_CM 0. 655.35 FORMAT "%5.2" /end CHARACTERISTIC
/begin CHARACTERISTIC K_TD_MDENTSICHRES "Verzögerungszeit" VALUE 0xa082beaa _REC_VAL_20_u2 98.30250000000001 _CNV_R_R_Def_td_uw__673_CM 0. 655.35 FORMAT "%5.2" /end CHARACTERISTIC
/begin CHARACTERISTIC K_TD_RENN "Verzögerungszeit Rennstartbereitschaft" VALUE 0xa082c0f4 _REC_VAL_20_u2 131.07 _CNV_R_R_Def_td_ub__574_CM 0. 6553.5 FORMAT "%4.1" /end CHARACTERISTIC
/begin CHARACTERISTIC K_TES12APP_S "Einspritzabstand 1. 2. Einspritzung in S manuell" VALUE 0xa08206f2 _REC_VAL_20_u2 99.61320000000001 _CNV_R_R_Def_td_sw__601_CM 0. 262.14 FORMAT "%5.2" /end CHARACTERISTIC
/begin CHARACTERISTIC K_TESMIN "Minimalbegrenzung Deltazeit zwischen 2 Einspritzungen" VALUE 0xa08206f0 _REC_VAL_20_u2 99.61320000000001 _CNV_R_R_Def_td_sw__601_CM 0. 262.14 FORMAT "%5.2" /end CHARACTERISTIC
/begin CHARACTERISTIC K_TGENOFMN "Tmot-Schwelle zur Aktivierung Generatorvolllastabschaltung" VALUE 0xa082c100 _REC_VAL_20_s2 98.30250000000001 _CNV_R_R_Def_t_sw_q_579_CM -327.68 327.67 FORMAT "%5.2" /end CHARACTERISTIC
/begin CHARACTERISTIC K_TGENOFMX "Tmot-Schwelle zur Deaktivierung Generatorvolllastabschaltung" VALUE 0xa082c0fe _REC_VAL_20_s2 98.30250000000001 _CNV_R_R_Def_t_sw_q_579_CM -327.68 327.67 FORMAT "%5.2" /end CHARACTERISTIC
/begin CHARACTERISTIC K_TLORESPST "Startloadresponse" VALUE 0xa082bd10 _REC_VAL_20_u2 25.5 _CNV_R_R_Def_td_ub__753_CM 0. 25.5 FORMAT "%5.2" /end CHARACTERISTIC
/begin CHARACTERISTIC K_TMOTABGNMN "minimale Motorabstelltemperatur für Generatorreduzierung" VALUE 0xa082bcb0 _REC_VAL_20_s2 98.30250000000001 _CNV_R_R_Def_t_sw_q_579_CM -327.68 327.67 FORMAT "%5.2" /end CHARACTERISTIC
/begin CHARACTERISTIC K_TUMGGNMN "minimale Umgebungstemperatur für Generatorreduzierung" VALUE 0xa082bcb2 _REC_VAL_20_s2 131.07 _CNV_R_R_Def_t_sw_q_578_CM -3276.8 3276.7 FORMAT "%4.1" /end CHARACTERISTIC
/begin CHARACTERISTIC K_TUMGGNMX "maximale Umgebungstemperatur für Generatorreduzierung" VALUE 0xa082bcb4 _REC_VAL_20_s2 131.07 _CNV_R_R_Def_t_sw_q_578_CM -3276.8 3276.7 FORMAT "%4.1" /end CHARACTERISTIC
/begin CHARACTERISTIC K_T_MDNAGEN "Totzeit bei Abschaltung Generator" VALUE 0xa082bed6 _REC_VAL_20_u1 1.9921 _CNV_R_R_Def_t_ub_b_713_CM 0. 1.9921 /end CHARACTERISTIC
/begin CHARACTERISTIC K_T_MDNAKK "Totzeit bei Abschaltung Klimakompressor" VALUE 0xa082bed4 _REC_VAL_20_u1 1.9921 _CNV_R_R_Def_t_ub_b_713_CM 0. 1.9921 /end CHARACTERISTIC
/begin CHARACTERISTIC K_T_MDNAKKUP "Totzeit bei Abschaltung Klimakompressor mit Kupplung" VALUE 0xa082bed5 _REC_VAL_20_u1 1.9921 _CNV_R_R_Def_t_ub_b_713_CM 0. 1.9921 /end CHARACTERISTIC
/begin CHARACTERISTIC K_T_RENNAKT "Zeit in der der Rennstart aktiv ist" VALUE 0xa082c0f2 _REC_VAL_20_u2 131.07 _CNV_R_R_Def_td_ub__574_CM 0. 6553.5 FORMAT "%4.1" /end CHARACTERISTIC
/begin CHARACTERISTIC K_T_VRENN "Zeit die von B_bls == true bis V != 0 vergehen darf" VALUE 0xa082c0e8 _REC_VAL_20_u1 25.5 _CNV_R_R_Def_td_ub__574_CM 0. 25.5 FORMAT "%4.1" /end CHARACTERISTIC
/begin CHARACTERISTIC K_UENTL_SOLL "Spannungsanforderung für Generatorentlastung" VALUE 0xa082beb2 _REC_VAL_20_u1 25.5 _CNV_R_R_Def_u_ub_q_631_CM 0. 25.5 FORMAT "%5.2" /end CHARACTERISTIC
/begin CHARACTERISTIC K_UFAKRKTI "Umrechnungsfaktor Rk nach Ti" VALUE 0xa08206dc _REC_VAL_20_u2 0.9999 _CNV_R_R_Def_f_uw_b_571_CM 0. 0.9999 FORMAT "%14.5" /end CHARACTERISTIC
/begin CHARACTERISTIC K_VGENOFMN "V-Schwelle zur Aktivierung Generatorvolllastabschaltung" VALUE 0xa082c0fc _REC_VAL_20_u2 100.8 _CNV_R_R_Def_v_uw_q_726_CM 0. 360. FORMAT "%5.0" /end CHARACTERISTIC
/begin CHARACTERISTIC K_VGENOFMX "V-Schwelle zur Deaktivierung Generatorvolllastabschaltung" VALUE 0xa082c0fa _REC_VAL_20_u2 100.8 _CNV_R_R_Def_v_uw_q_726_CM 0. 360. FORMAT "%5.0" /end CHARACTERISTIC
/begin CHARACTERISTIC K_VZLORESOFV "Geschwindigkeitsschwelle für Generatorzuschaltung" VALUE 0xa082bcbc _REC_VAL_20_u2 0. _CNV_R_R_Def_v_uw_q_726_CM 0. 65535. FORMAT "%5.0" /end CHARACTERISTIC
/begin CHARACTERISTIC K_WESB1APP_H "Einspritzbeginnwinkel 1. Einspr. HOM manuell" VALUE 0xa08206e8 _REC_VAL_20_s2 107.518355 _CNV_R_R_Def_kw_sw__603_CM -768. 767.9765 /end CHARACTERISTIC
/begin CHARACTERISTIC K_WESB1APP_HS "Einspritzbeginnwinkel 1. Einspr. HS manuell" VALUE 0xa08206ea _REC_VAL_20_s2 107.518355 _CNV_R_R_Def_kw_sw__603_CM -768. 767.9765 /end CHARACTERISTIC
/begin CHARACTERISTIC K_WESB2MIN_H "Minimaler Einspritzbeginnwinkel bei 2fach Einspritzung" VALUE 0xa08206d8 _REC_VAL_20_s2 107.518355 _CNV_R_R_Def_kw_sw__603_CM -768. 767.9765 /end CHARACTERISTIC
/begin CHARACTERISTIC K_WESB3APP_S "Appl. Einspritzbeginn 3. Einspritzung für KH (schicht)" VALUE 0xa08206e2 _REC_VAL_20_s2 107.518355 _CNV_R_R_Def_kw_sw__603_CM -768. 767.9765 /end CHARACTERISTIC
/begin CHARACTERISTIC K_WESB3MAX_S "Maximaler Einspritzbeginn 3. Einspritzung für KH (schicht)" VALUE 0xa08206e0 _REC_VAL_20_s2 107.518355 _CNV_R_R_Def_kw_sw__603_CM -768. 767.9765 /end CHARACTERISTIC
/begin CHARACTERISTIC K_WESB3MIN_S "Minimaler Einspritzbeginn 3. Einspritzung für KH (schicht)" VALUE 0xa08206de _REC_VAL_20_s2 107.518355 _CNV_R_R_Def_kw_sw__603_CM -768. 767.9765 /end CHARACTERISTIC
/begin CHARACTERISTIC K_WESE2APP_H "Einspritzendewinkel 2. Einspr. HOM manuell" VALUE 0xa08206ec _REC_VAL_20_s2 107.518355 _CNV_R_R_Def_kw_sw__603_CM -768. 767.9765 /end CHARACTERISTIC
/begin CHARACTERISTIC K_WESE3APP_H "Einspritzendewinkel 3. Einspritzung" VALUE 0xa08206da _REC_VAL_20_s2 107.518355 _CNV_R_R_Def_kw_sw__603_CM -768. 767.9765 /end CHARACTERISTIC
/begin CHARACTERISTIC K_ZRRENN_INI "Initialisierungswert Rennstartzähler" VALUE 0xa082c0e9 _REC_VAL_20_u1 99.45 _CNV_R_R_Def_dez_sl_551_CM 0. 255. FORMAT "%3.0" /end CHARACTERISTIC
/begin CHARACTERISTIC S_APPL_DESU "Applikationsschalter zur Auswahl des Desulfatisierungslambdas" VALUE 0xa08272a4 _REC_VAL_20_u1 1. _CNV_R_R_Def_dez_sl_551_CM 0. 1. FORMAT "%3.0" /end CHARACTERISTIC
/begin CHARACTERISTIC S_DWESE2APP_H "Schalter Deltawinkel Einspritzende - Zündung  2 einspr. HOM manuell" VALUE 0xa08206d0 _REC_VAL_20_u1 99.45 _CNV_R_R_Def_dez_sl_551_CM 0. 255. FORMAT "%3.0" /end CHARACTERISTIC
/begin CHARACTERISTIC S_DWESEAPP_HS "(homogen-schicht)" VALUE 0xa08206d4 _REC_VAL_20_u1 99.45 _CNV_R_R_Def_dez_sl_551_CM 0. 255. FORMAT "%3.0" /end CHARACTERISTIC
/begin CHARACTERISTIC S_DWESEAPP_S "(schicht)" VALUE 0xa08206d5 _REC_VAL_20_u1 99.45 _CNV_R_R_Def_dez_sl_551_CM 0. 255. FORMAT "%3.0" /end CHARACTERISTIC
/begin CHARACTERISTIC S_GENOFFVL "Schalter Freigabe Generatorvolllastabschaltung" VALUE 0xa082c0e4 _REC_VAL_20_u1 99.45 _CNV_R_R_Def_dez_sl_551_CM 0. 255. FORMAT "%3.0" /end CHARACTERISTIC
/begin CHARACTERISTIC S_IPMNA_AN "Freigabe iPM NA Erregerstrombegrenzung " VALUE 0xa082bca4 _REC_VAL_20_u1 99.45 _CNV_R_R_Def_dez_sl_551_CM 0. 255. FORMAT "%3.0" /end CHARACTERISTIC
/begin CHARACTERISTIC S_KKOFF "1: KK darf abgeschaltet werden" VALUE 0xa082becf _REC_VAL_20_u1 99.45 _CNV_R_R_Def_dez_sl_551_CM 0. 255. FORMAT "%3.0" /end CHARACTERISTIC
/begin CHARACTERISTIC S_KLANN_ON "Einschalter KLANN" VALUE 0xa082e9ac _REC_VAL_20_u1 1. _CNV_R_R_Def_dez_sl_551_CM 0. 1. FORMAT "%3.0" /end CHARACTERISTIC
/begin CHARACTERISTIC S_LAHOMAN "Applikationsschalter zur manuellen Lambdavorgabe" VALUE 0xa08272a5 _REC_VAL_20_u1 1. _CNV_R_R_Def_dez_sl_551_CM 0. 1. FORMAT "%3.0" /end CHARACTERISTIC
/begin CHARACTERISTIC S_LORESLL "Schalter Kennlinienausschaltzeit " VALUE 0xa082bcc1 _REC_VAL_20_u1 1. _CNV_R_R_Def_dez_sl_551_CM 0. 1. FORMAT "%3.0" /end CHARACTERISTIC
/begin CHARACTERISTIC S_LRTEST "Umschaltung Loadresponse zu Testzwecken" VALUE 0xa082bd1f _REC_VAL_20_u1 1. _CNV_R_R_Def_dez_sl_551_CM 0. 1. FORMAT "%3.0" /end CHARACTERISTIC
/begin CHARACTERISTIC S_MDGETR_DME "1: Getriebeverlustmoment wird von DME berechnet" VALUE 0xa082bece _REC_VAL_20_u1 99.45 _CNV_R_R_Def_dez_sl_551_CM 0. 255. FORMAT "%3.0" /end CHARACTERISTIC
/begin CHARACTERISTIC S_MDMAXMAN "Schalter zur manuellen Vorgabe des maximalen Motormoments " VALUE 0xa082bed2 _REC_VAL_20_u1 99.45 _CNV_R_R_Def_dez_sl_551_CM 0. 255. FORMAT "%3.0" /end CHARACTERISTIC
/begin CHARACTERISTIC S_MDNAICM "1: Botschaft EF-Nebenaggregateverluste vorhanden" VALUE 0xa082becc _REC_VAL_20_u1 99.45 _CNV_R_R_Def_dez_sl_551_CM 0. 255. FORMAT "%3.0" /end CHARACTERISTIC
/begin CHARACTERISTIC S_MDWAHLGG "1: Lokal gefiltertes Generatormoment wird verwendet" VALUE 0xa082bc3b _REC_VAL_20_u1 1. _CNV_R_R_Def_dez_sl_551_CM 0. 1. FORMAT "%3.0" /end CHARACTERISTIC
/begin CHARACTERISTIC S_PULS1TO2 "Schalter für Umschaltung zwischen Pulsation für Bank 1 und Bank 2" VALUE 0xa08272a6 _REC_VAL_20_u1 1. _CNV_R_R_Def_dez_sl_551_CM 0. 1. FORMAT "%3.0" /end CHARACTERISTIC
/begin CHARACTERISTIC S_STATM_AN "Freigabe der NA Momentenbilanz" VALUE 0xa082be74 _REC_VAL_20_u1 99.45 _CNV_R_R_Def_dez_sl_551_CM 0. 255. FORMAT "%3.0" /end CHARACTERISTIC
/begin CHARACTERISTIC S_TES12APP_S "Einspritzabstand 1. 2. Einspritzung in S manuell" VALUE 0xa08206d1 _REC_VAL_20_u1 99.45 _CNV_R_R_Def_dez_sl_551_CM 0. 255. FORMAT "%3.0" /end CHARACTERISTIC
/begin CHARACTERISTIC S_TESTMBILANZ "Freigabe der Generatorentlastung zu Testzwecken" VALUE 0xa082be7c _REC_VAL_20_u1 99.45 _CNV_R_R_Def_dez_sl_551_CM 0. 255. FORMAT "%3.0" /end CHARACTERISTIC
/begin CHARACTERISTIC S_WESB1APP_H "Schalter Einspritzbeginnwinkel 1. Einspr. HOM manuell" VALUE 0xa08206d2 _REC_VAL_20_u1 99.45 _CNV_R_R_Def_dez_sl_551_CM 0. 255. FORMAT "%3.0" /end CHARACTERISTIC
/begin CHARACTERISTIC S_WESB1APP_HS "Schalter Einspritzbeginnwinkel 1. Einspr. HS manuell" VALUE 0xa08206d3 _REC_VAL_20_u1 99.45 _CNV_R_R_Def_dez_sl_551_CM 0. 255. FORMAT "%3.0" /end CHARACTERISTIC
/begin CHARACTERISTIC S_WESB3APP_S "(schicht)" VALUE 0xa08206d6 _REC_VAL_20_u1 99.45 _CNV_R_R_Def_dez_sl_551_CM 0. 255. FORMAT "%3.0" /end CHARACTERISTIC
/begin CHARACTERISTIC S_WESE2ABS_H "Schalter Einspritzendewinkel 2. Einspr. HOM absolut zum ZOT" VALUE 0xa08206cd _REC_VAL_20_u1 99.45 _CNV_R_R_Def_dez_sl_551_CM 0. 255. FORMAT "%3.0" /end CHARACTERISTIC
/begin CHARACTERISTIC S_WESE2APP_H "Schalter Einspritzendewinkel 2. Einspr. HOM manuell" VALUE 0xa08206ce _REC_VAL_20_u1 99.45 _CNV_R_R_Def_dez_sl_551_CM 0. 255. FORMAT "%3.0" /end CHARACTERISTIC
/begin CHARACTERISTIC S_WESE3APP_H "Einspritzendewinkel 3. Einspritzung aus K_WESE3APP_H aktiv" VALUE 0xa08206cf _REC_VAL_20_u1 99.45 _CNV_R_R_Def_dez_sl_551_CM 0. 255. FORMAT "%3.0" /end CHARACTERISTIC
/begin CHARACTERISTIC S_WESVL_ENA "Freigabe Einspritzwinkel bei B_vl über Vollast-Kennfeld" VALUE 0xa08206cc _REC_VAL_20_u1 99.45 _CNV_R_R_Def_dez_sl_551_CM 0. 255. FORMAT "%3.0" /end CHARACTERISTIC
/begin CHARACTERISTIC S_ZRRENN_INI "Initialisierung Rennstartzähler" VALUE 0xa082c0ea _REC_VAL_20_u1 99.45 _CNV_R_R_Def_dez_sl_551_CM 0. 255. FORMAT "%3.0" /end CHARACTERISTIC
/begin COMPU_METHOD _CNV_R_R_Def_km_sw__68_CM "Def_km_sw_q10" RAT_FUNC "%6.3" "km" COEFFS 0. 1. 0. 0. 0. 10. /end COMPU_METHOD
/begin COMPU_METHOD _CNV_R_R_Def_f_sw_q_550_CM "Def_f_sw_q0p00153" RAT_FUNC "%6.3" "-" COEFFS 0. 32768. 0. 0. 0. 50. /end COMPU_METHOD
/begin COMPU_METHOD _CNV_R_R_Def_dez_sl_551_CM "Def_dez_sl_q1" RAT_FUNC "%6.3" "-" COEFFS 0. 1. 0. 0. 0. 1. /end COMPU_METHOD
/begin COMPU_METHOD _CNV_R_R_Def_ac_sb__552_CM "Def_ac_sb_q0p25" RAT_FUNC "%6.3" "-" COEFFS 0. 4. 0. 0. 0. 1. /end COMPU_METHOD
/begin COMPU_METHOD _CNV_R_R_Def_f_ub_b_553_CM "Def_f_ub_b1" RAT_FUNC "%6.3" "-" COEFFS 0. 256. 0. 0. 0. 1. /end COMPU_METHOD
/begin COMPU_METHOD _CNV_R_R_Def_m_sw_q_554_CM "Def_m_sw_q0p1" RAT_FUNC "%6.3" "Nm" COEFFS 0. 10. 0. 0. 0. 1. /end COMPU_METHOD
/begin COMPU_METHOD _CNV_R_R_Def_f_uw_b_555_CM "Def_f_uw_b100" RAT_FUNC "%6.3" "%" COEFFS 0. 65536. 0. 0. 0. 100. /end COMPU_METHOD
/begin COMPU_METHOD _CNV_R_R_Def_f_sw_b_556_CM "Def_f_sw_b32" RAT_FUNC "%6.3" "-" COEFFS 0. 32768. 0. 0. 0. 32. /end COMPU_METHOD
/begin COMPU_METHOD _CNV_R_R_Def_f_uw_b_559_CM "Def_f_uw_b16" RAT_FUNC "%6.3" "-" COEFFS 0. 65536. 0. 0. 0. 16. /end COMPU_METHOD
/begin COMPU_METHOD _CNV_R_R_Def_f_sw_q_560_CM "Def_f_sw_q0p1" RAT_FUNC "%6.3" "-" COEFFS 0. 10. 0. 0. 0. 1. /end COMPU_METHOD
/begin COMPU_METHOD _CNV_S_2_Def_bit_ub_563_CM "Def_bit_ub_0" TAB_VERB "%6.3" "-" COMPU_TAB_REF _CNV_S_2_Def_bit_ub_563 /end COMPU_METHOD
/begin COMPU_VTAB _CNV_S_2_Def_bit_ub_563 "Def_bit_ub_0" TAB_VERB 2 0 "FALSE" 1 "TRUE" /end COMPU_VTAB
/begin COMPU_METHOD _CNV_S_22_Def_ba_gdi_567_CM "Def_ba_gdi_sub" TAB_VERB "%6.3" "-" COMPU_TAB_REF _CNV_S_22_Def_ba_gdi_567 /end COMPU_METHOD
/begin COMPU_VTAB _CNV_S_22_Def_ba_gdi_567 "Def_ba_gdi_sub" TAB_VERB 22 0 "KEINE" 1 "Optimal" 2 "Lambda_1" 3 "Test_O2" 4 "KHM_DOE_LR" 5 "KHM_DOE_EM" 6 "Bauteilschutz" 7 "KHM_ZW" 8 "Desu_puls" 9 "NOxKat_reg" 10 "KHM_LR" 11 "KHM_EM" 12 "KHM_ZW_DE" 13 "KHM_LR_DE" 14 "KHM_DOE_LR_DE" 15 "NOTLAUF" 16 "TESTLAM" 17 "GL_ZSK" 18 "DESU_FETT" 19 "ZWAD" 20 "UESP" 21 "VL" /end COMPU_VTAB
/begin COMPU_METHOD _CNV_R_R_Def_f_uw_b_571_CM "Def_f_uw_b1" RAT_FUNC "%6.3" "-" COEFFS 0. 65536. 0. 0. 0. 1. /end COMPU_METHOD
/begin COMPU_METHOD _CNV_R_R_Def_td_ub__574_CM "Def_td_ub_q0p1" RAT_FUNC "%6.3" "s" COEFFS 0. 10. 0. 0. 0. 1. /end COMPU_METHOD
/begin COMPU_METHOD _CNV_R_R_Def_p_sw_q_576_CM "Def_p_sw_q0p039" RAT_FUNC "%6.3" "hPa" COEFFS 0. 256. 0. 0. 0. 10. /end COMPU_METHOD
/begin COMPU_METHOD _CNV_R_R_Def_t_sw_q_578_CM "Def_t_sw_q0p1" RAT_FUNC "%6.3" "°C" COEFFS 0. 10. 0. 0. 0. 1. /end COMPU_METHOD
/begin COMPU_METHOD _CNV_R_R_Def_t_sw_q_579_CM "Def_t_sw_q0p01" RAT_FUNC "%6.3" "°C" COEFFS 0. 100. 0. 0. 0. 1. /end COMPU_METHOD
/begin COMPU_METHOD _CNV_R_R_Def_f_uw_b_588_CM "Def_f_uw_b32" RAT_FUNC "%6.3" "-" COEFFS 0. 65536. 0. 0. 0. 32. /end COMPU_METHOD
/begin COMPU_METHOD _CNV_R_R_Def_hub_uw_589_CM "Def_hub_uw_q0p001" RAT_FUNC "%6.3" "mm" COEFFS 0. 1000. 0. 0. 0. 1. /end COMPU_METHOD
/begin COMPU_METHOD _CNV_R_R_Def_f_uw_b_590_CM "Def_f_uw_b2" RAT_FUNC "%6.3" "-" COEFFS 0. 65536. 0. 0. 0. 2. /end COMPU_METHOD
/begin COMPU_METHOD _CNV_R_R_Def_f_sw_b_592_CM "Def_f_sw_b8" RAT_FUNC "%6.3" "-" COEFFS 0. 32768. 0. 0. 0. 8. /end COMPU_METHOD
/begin COMPU_METHOD _CNV_R_R_Def_n_sw_q_595_CM "Def_n_sw_q1p0" RAT_FUNC "%6.3" "Upm" COEFFS 0. 1. 0. 0. 0. 1. /end COMPU_METHOD
/begin COMPU_METHOD _CNV_R_R_Def_rf_sw__598_CM "Def_rf_sw_q0p01" RAT_FUNC "%6.3" "%" COEFFS 0. 100. 0. 0. 0. 1. /end COMPU_METHOD
/begin COMPU_METHOD _CNV_R_R_Def_eta_sw_599_CM "Def_eta_sw_b200" RAT_FUNC "%6.3" "%" COEFFS 0. 32768. 0. 0. 0. 200. /end COMPU_METHOD
/begin COMPU_METHOD _CNV_R_R_Def_rk_sw__600_CM "Def_rk_sw_b1600" RAT_FUNC "%6.3" "%" COEFFS 0. 2048. 0. 0. 0. 100. /end COMPU_METHOD
/begin COMPU_METHOD _CNV_R_R_Def_td_sw__601_CM "Def_td_sw_q0p004" RAT_FUNC "%6.3" "ms" COEFFS 0. 250. 0. 0. 0. 1. /end COMPU_METHOD
/begin COMPU_METHOD _CNV_R_R_Def_kw_sw__603_CM "Def_kw_sw_q0p0234" RAT_FUNC "%6.3" "°KW" COEFFS 0. 256. 0. 0. 0. 6. /end COMPU_METHOD
/begin COMPU_METHOD _CNV_R_R_Def_zw_sw__604_CM "Def_zw_sw_q0p1" RAT_FUNC "%6.3" "°" COEFFS 0. 10. 0. 0. 0. 1. /end COMPU_METHOD
/begin COMPU_METHOD _CNV_R_R_Def_td_ub__611_CM "Def_td_ub_q1" RAT_FUNC "%6.3" "s" COEFFS 0. 1. 0. 0. 0. 1. /end COMPU_METHOD
/begin COMPU_METHOD _CNV_R_R_Def_f_ub_b_613_CM "Def_f_ub_b2" RAT_FUNC "%6.3" "-" COEFFS 0. 256. 0. 0. 0. 2. /end COMPU_METHOD
/begin COMPU_METHOD _CNV_R_R_Def_f_uw_b_618_CM "Def_f_uw_b10" RAT_FUNC "%6.3" "%" COEFFS 0. 65536. 0. 0. 0. 10. /end COMPU_METHOD
/begin COMPU_METHOD _CNV_R_R_Def_f_ub_b_619_CM "Def_f_ub_b1p0" RAT_FUNC "%6.3" "-" COEFFS 0. 255. 0. 0. 0. 1. /end COMPU_METHOD
/begin COMPU_METHOD _CNV_R_R_Def_f_sw_b_623_CM "Def_f_sw_b64" RAT_FUNC "%6.3" "-" COEFFS 0. 32768. 0. 0. 0. 64. /end COMPU_METHOD
/begin COMPU_METHOD _CNV_R_R_Def_i_uw_q_630_CM "Def_i_uw_q0p125" RAT_FUNC "%6.3" "A" COEFFS 0. 8. 0. 0. 0. 1. /end COMPU_METHOD
/begin COMPU_METHOD _CNV_R_R_Def_u_ub_q_631_CM "Def_u_ub_q0p1" RAT_FUNC "%6.3" "V" COEFFS 0. 10. 0. 0. 0. 1. /end COMPU_METHOD
/begin COMPU_METHOD _CNV_R_R_Def_f_ub_b_632_CM "Def_f_ub_b4" RAT_FUNC "%6.3" "-" COEFFS 0. 256. 0. 0. 0. 4. /end COMPU_METHOD
/begin COMPU_METHOD _CNV_R_R_Def_m_sw_q_649_CM "Def_m_sw_q0p01" RAT_FUNC "%6.3" "Nm" COEFFS 0. 100. 0. 0. 0. 1. /end COMPU_METHOD
/begin COMPU_METHOD _CNV_R_R_Def_ngrd_s_661_CM "Def_ngrd_sb_q32p0" RAT_FUNC "%6.3" "Upm/s" COEFFS 0. 1. 0. 0. 0. 32. /end COMPU_METHOD
/begin COMPU_METHOD _CNV_R_R_Def_tn_uw__664_CM "Def_tn_uw_q1" RAT_FUNC "%6.3" "min" COEFFS 0. 1. 0. 0. 0. 1. /end COMPU_METHOD
/begin COMPU_METHOD _CNV_R_R_Def_niv_sw_666_CM "Def_niv_sw_q0p146" RAT_FUNC "%6.3" "mm" COEFFS 0. 512. 0. 0. 0. 75. /end COMPU_METHOD
/begin COMPU_METHOD _CNV_R_R_Def_niv_ub_667_CM "Def_niv_ub_b75" RAT_FUNC "%6.3" "" COEFFS 0. 256. 0. 0. 0. 75. /end COMPU_METHOD
/begin COMPU_METHOD _CNV_R_R_Def_f_sb_b_669_CM "Def_f_sb_b2" RAT_FUNC "%6.3" "-" COEFFS 0. 128. 0. 0. 0. 2. /end COMPU_METHOD
/begin COMPU_METHOD _CNV_R_R_Def_niv_ub_671_CM "Def_niv_ub_q0p1" RAT_FUNC "%6.3" "l" COEFFS 0. 10. 0. 0. 0. 1. /end COMPU_METHOD
/begin COMPU_METHOD _CNV_R_R_Def_td_uw__673_CM "Def_td_uw_q0p01" RAT_FUNC "%6.3" "s" COEFFS 0. 100. 0. 0. 0. 1. /end COMPU_METHOD
/begin COMPU_METHOD _CNV_R_R_Def_p_uw_q_676_CM "Def_p_uw_q0p0061" RAT_FUNC "%6.3" "MPa" COEFFS 0. 65536. 0. 0. 0. 40. /end COMPU_METHOD
/begin COMPU_METHOD _CNV_R_R_Def_wdk_sw_683_CM "Def_wdk_sw_q0p0244" RAT_FUNC "%6.3" "%" COEFFS 0. 4096. 0. 0. 0. 100. /end COMPU_METHOD
/begin COMPU_METHOD _CNV_R_R_Def_f_ub_b_694_CM "Def_f_ub_b8" RAT_FUNC "%6.3" "-" COEFFS 0. 256. 0. 0. 0. 8. /end COMPU_METHOD
/begin COMPU_METHOD _CNV_R_R_Def_f_sb_b_703_CM "Def_f_sb_b1" RAT_FUNC "%6.3" "-" COEFFS 0. 128. 0. 0. 0. 1. /end COMPU_METHOD
/begin COMPU_METHOD _CNV_R_R_Def_t_ub_b_713_CM "Def_t_ub_b2" RAT_FUNC "%6.3" "s" COEFFS 0. 128. 0. 0. 0. 1. /end COMPU_METHOD
/begin COMPU_METHOD _CNV_R_R_Def_v_uw_q_726_CM "Def_v_uw_q1p0" RAT_FUNC "%6.3" "km/h" COEFFS 0. 1. 0. 0. 0. 1. /end COMPU_METHOD
/begin COMPU_METHOD _CNV_R_R_Def_niv_uw_744_CM "Def_niv_uw_q0p293" RAT_FUNC "%6.3" "mm" COEFFS 0. 256. 0. 0. 0. 75. /end COMPU_METHOD
/begin COMPU_METHOD _CNV_R_R_Def_td_ub__753_CM "Def_td_ub_q0p02" RAT_FUNC "%6.3" "s" COEFFS 0. 50. 0. 0. 0. 1. /end COMPU_METHOD
/begin RECORD_LAYOUT _REC_VAL_20_u1 FNC_VALUES 1 UBYTE COLUMN_DIR DIRECT /end RECORD_LAYOUT
/begin RECORD_LAYOUT _REC_VAL_20_u2 FNC_VALUES 1 UWORD COLUMN_DIR DIRECT /end RECORD_LAYOUT
/begin RECORD_LAYOUT _REC_VAL_20_s2 FNC_VALUES 1 SWORD COLUMN_DIR DIRECT /end RECORD_LAYOUT
/begin RECORD_LAYOUT _REC_VAL_20_s1 FNC_VALUES 1 SBYTE COLUMN_DIR DIRECT /end RECORD_LAYOUT
/begin RECORD_LAYOUT _REC_MAP_52_UBYTE_s2_s2_u2 NO_AXIS_PTS_X 1 UBYTE NO_AXIS_PTS_Y 2 UBYTE AXIS_PTS_X 3 SWORD INDEX_INCR DIRECT AXIS_PTS_Y 4 UWORD INDEX_INCR DIRECT FNC_VALUES 5 SWORD COLUMN_DIR DIRECT /end RECORD_LAYOUT
/begin RECORD_LAYOUT _REC_MAP_52_u1_s2_s2 NO_AXIS_PTS_X 1 UBYTE NO_AXIS_PTS_Y 2 UBYTE AXIS_PTS_X 3 SWORD INDEX_INCR DIRECT AXIS_PTS_Y 4 SWORD INDEX_INCR DIRECT FNC_VALUES 5 UBYTE COLUMN_DIR DIRECT /end RECORD_LAYOUT
/begin RECORD_LAYOUT _REC_MAP_52_UBYTE_u2_s2_u2 NO_AXIS_PTS_X 1 UBYTE NO_AXIS_PTS_Y 2 UBYTE AXIS_PTS_X 3 SWORD INDEX_INCR DIRECT AXIS_PTS_Y 4 UWORD INDEX_INCR DIRECT FNC_VALUES 5 UWORD COLUMN_DIR DIRECT /end RECORD_LAYOUT
/begin RECORD_LAYOUT _REC_MAP_52_UBYTE_u2_s2_s2 NO_AXIS_PTS_X 1 UBYTE NO_AXIS_PTS_Y 2 UBYTE AXIS_PTS_X 3 SWORD INDEX_INCR DIRECT AXIS_PTS_Y 4 SWORD INDEX_INCR DIRECT FNC_VALUES 5 UWORD COLUMN_DIR DIRECT /end RECORD_LAYOUT
/begin RECORD_LAYOUT _REC_MAP_52_UBYTE_s2_s2_s2 NO_AXIS_PTS_X 1 UBYTE NO_AXIS_PTS_Y 2 UBYTE AXIS_PTS_X 3 SWORD INDEX_INCR DIRECT AXIS_PTS_Y 4 SWORD INDEX_INCR DIRECT FNC_VALUES 5 SWORD COLUMN_DIR DIRECT /end RECORD_LAYOUT
/begin RECORD_LAYOUT _REC_MAP_52_UBYTE_u2_u2_u2 NO_AXIS_PTS_X 1 UBYTE NO_AXIS_PTS_Y 2 UBYTE AXIS_PTS_X 3 UWORD INDEX_INCR DIRECT AXIS_PTS_Y 4 UWORD INDEX_INCR DIRECT FNC_VALUES 5 UWORD COLUMN_DIR DIRECT /end RECORD_LAYOUT
/begin RECORD_LAYOUT _REC_MAP_52_u1_u2_s2 NO_AXIS_PTS_X 1 UBYTE NO_AXIS_PTS_Y 2 UBYTE AXIS_PTS_X 3 UWORD INDEX_INCR DIRECT AXIS_PTS_Y 4 SWORD INDEX_INCR DIRECT FNC_VALUES 5 UBYTE COLUMN_DIR DIRECT /end RECORD_LAYOUT
/begin RECORD_LAYOUT _REC_MAP_52_UBYTE_s2_u2_s2 NO_AXIS_PTS_X 1 UBYTE NO_AXIS_PTS_Y 2 UBYTE AXIS_PTS_X 3 UWORD INDEX_INCR DIRECT AXIS_PTS_Y 4 SWORD INDEX_INCR DIRECT FNC_VALUES 5 SWORD COLUMN_DIR DIRECT /end RECORD_LAYOUT
/begin RECORD_LAYOUT _REC_MAP_52_u1_u1_u1 NO_AXIS_PTS_X 1 UBYTE NO_AXIS_PTS_Y 2 UBYTE AXIS_PTS_X 3 UBYTE INDEX_INCR DIRECT AXIS_PTS_Y 4 UBYTE INDEX_INCR DIRECT FNC_VALUES 5 UBYTE COLUMN_DIR DIRECT /end RECORD_LAYOUT
/begin RECORD_LAYOUT _REC_MAP_52_u1_s2_u2 NO_AXIS_PTS_X 1 UBYTE NO_AXIS_PTS_Y 2 UBYTE AXIS_PTS_X 3 SWORD INDEX_INCR DIRECT AXIS_PTS_Y 4 UWORD INDEX_INCR DIRECT FNC_VALUES 5 UBYTE COLUMN_DIR DIRECT /end RECORD_LAYOUT
/begin RECORD_LAYOUT _REC_CUR_TKL_UW_VV__u2_s2 NO_AXIS_PTS_X 1 UBYTE RESERVED 2 BYTE AXIS_PTS_X 3 SWORD INDEX_INCR DIRECT FNC_VALUES 4 UWORD COLUMN_DIR DIRECT /end RECORD_LAYOUT
/begin RECORD_LAYOUT _REC_CUR_TKL_UW_VV__u1_s2 NO_AXIS_PTS_X 1 UBYTE RESERVED 2 BYTE AXIS_PTS_X 3 SWORD INDEX_INCR DIRECT FNC_VALUES 4 UBYTE COLUMN_DIR DIRECT /end RECORD_LAYOUT
/begin RECORD_LAYOUT _REC_CUR_TKL_UW_VV__s2_s2 NO_AXIS_PTS_X 1 UBYTE RESERVED 2 BYTE AXIS_PTS_X 3 SWORD INDEX_INCR DIRECT FNC_VALUES 4 SWORD COLUMN_DIR DIRECT /end RECORD_LAYOUT
/begin RECORD_LAYOUT _REC_CUR_TKL_UW_VV__u1_u2 NO_AXIS_PTS_X 1 UBYTE RESERVED 2 BYTE AXIS_PTS_X 3 UWORD INDEX_INCR DIRECT FNC_VALUES 4 UBYTE COLUMN_DIR DIRECT /end RECORD_LAYOUT
/begin RECORD_LAYOUT _REC_CUR_TKL_UW_VV__s2_u2 NO_AXIS_PTS_X 1 UBYTE RESERVED 2 BYTE AXIS_PTS_X 3 UWORD INDEX_INCR DIRECT FNC_VALUES 4 SWORD COLUMN_DIR DIRECT /end RECORD_LAYOUT
/begin RECORD_LAYOUT _REC_CUR_TKL_UW_VV__u1_u1 NO_AXIS_PTS_X 1 UBYTE RESERVED 2 BYTE AXIS_PTS_X 3 UBYTE INDEX_INCR DIRECT FNC_VALUES 4 UBYTE COLUMN_DIR DIRECT /end RECORD_LAYOUT
/begin RECORD_LAYOUT _REC_CUR_TKL_UW_VV__s2_u1 NO_AXIS_PTS_X 1 UBYTE RESERVED 2 BYTE AXIS_PTS_X 3 UBYTE INDEX_INCR DIRECT FNC_VALUES 4 SWORD COLUMN_DIR DIRECT /end RECORD_LAYOUT
/begin RECORD_LAYOUT _REC_CUR_TKL_UW_VV__s1_s1 NO_AXIS_PTS_X 1 UBYTE RESERVED 2 BYTE AXIS_PTS_X 3 SBYTE INDEX_INCR DIRECT FNC_VALUES 4 SBYTE COLUMN_DIR DIRECT /end RECORD_LAYOUT
/begin RECORD_LAYOUT _REC_VAL_2_s2 FNC_VALUES 1 SWORD COLUMN_DIR DIRECT /end RECORD_LAYOUT
/begin RECORD_LAYOUT _REC_VAL_2_u2 FNC_VALUES 1 UWORD COLUMN_DIR DIRECT /end RECORD_LAYOUT
/begin RECORD_LAYOUT _REC_VAL_20_S4 FNC_VALUES 1 FLOAT32_IEEE COLUMN_DIR DIRECT /end RECORD_LAYOUT
/begin FUNCTION OZNIVDL ""
 /begin DEF_CHARACTERISTIC KF_OZDREHKOR KF_OZKFGPK KF_OZKORRNIV KF_OZKORRORI KF_OZZEIT KL_OZKRZMW2 KL_OZLBNIV KL_OZLN KL_OZNFDELTA KL_OZORBERO KL_OZQBNIV KL_OZSTNIV K_CW_OZ K_NACHFUELL12 K_NACHFUELL25 K_NACHFUELL38 K_NACHFUELL53 K_NACHFUELL69 K_NACHFUELL85 K_NACHFUELL95 K_OZABSTELL K_OZALTANZABZ K_OZBESCHAUS K_OZDKNIVN K_OZDKNIVPOEL K_OZLBESCHN K_OZLBESCHORI K_OZLBESCHP K_OZLBESCHST K_OZLUFTMAX K_OZMAXSLOPE K_OZMINSLOPE K_OZMWK K_OZMWL K_OZMWOR K_OZMWV K_OZNFERR K_OZNFML K_OZNFOELCKO K_OZNFOELCOK K_OZNMOTMAX K_OZNMOTMIN K_OZOELCABZ K_OZOELCOK K_OZOELCVERZ K_OZOELVERB K_OZORIPEILTZO K_OZORIPEILTZU K_OZPEIL12 K_OZPEIL25 K_OZPEIL38 K_OZPEIL53 K_OZPEIL69 K_OZPEIL85 K_OZPEILDO K_OZPEILDOMIN K_OZPEILDU K_OZPEILDU38 K_OZPEILERR K_OZPEILKSPR K_OZPEILLP85 K_OZPEILML K_OZPEILOELCKO K_OZPEILOELCOK K_OZPEILSPRUNG K_OZQBESCHN K_OZQBESCHORI K_OZQBESCHP K_OZQBESCHST K_OZSTANDVERZ K_OZSTARTABZ K_OZSTARTVERZ K_OZSTMINW K_OZTEMPBW K_OZTKOELP K_OZTORMIN K_OZTORMINF K_OZTPOOFF K_OZTPOON K_OZUEBERF K_OZUEFCNT K_OZUEFNLB K_OZUEFNQB K_OZUEFNST K_OZUEFODZ K_OZUEFPLB K_OZUEFPQB K_OZUEFPST K_OZUEFTEM K_OZUEFUDZ K_OZUEFVERZ K_OZVERBFAK K_OZVERLORI K_OZVERZERRBSD K_OZVORMV K_OZVORPEILMIN K_OZZINI /end DEF_CHARACTERISTIC
 /begin REF_CHARACTERISTIC K_OZKMUPL /end REF_CHARACTERISTIC
 /begin OUT_MEASUREMENT N_ozmw Oz_abstellm Oz_beschcnt Oz_dkm Oz_hoehe Oz_koroelp Oz_krz2cnt Oz_krzcnt Oz_krzkor2 Oz_krzkor2k Oz_krzmw Oz_krzmwkor Oz_krzor Oz_langmw Oz_lbmw Oz_lgmwcnt Oz_lp Oz_lv Oz_nivakt Oz_nivkomp Oz_nivkor Oz_nivkrzt Oz_nivlit Oz_nivzeit Oz_oricnt Oz_orikor Oz_peil Oz_peilaltanz Oz_peilkm Oz_peilkmalt Oz_peillang Oz_peiloben Oz_peilunten Oz_pzdivp Oz_qbmw Oz_steigung Oz_uefcnt Oz_uefzcnt Oz_vormw Oz_vormwcnt St_oznivdl0 St_oznivdl0.B_ozkrzkor St_oznivdl0.B_ozkrzlkor St_oznivdl0.B_ozlangmw St_oznivdl0.B_ozluft St_oznivdl0.B_oznivb St_oznivdl0.B_ozor St_oznivdl0.B_ozpoelnl St_oznivdl0.B_ozvormw St_oznivdl1 St_oznivdl1.B_ozfahrt St_oznivdl1.B_ozkrzkor2 St_oznivdl1.B_ozkrzkornb St_oznivdl1.B_ozml St_oznivdl1.B_ozmreset St_oznivdl1.B_ozoelcheck St_oznivdl1.B_ozoelchok St_oznivdl1.B_ozueberf St_oznivdl_nv0 St_oznivdl_nv0.B_ozabzlang St_oznivdl_nv0.B_ozlmwneu St_oznivdl_nv0.B_ozlw1 St_oznivdl_nv0.B_oznachf St_oznivdl_nv0.B_ozoelwech /end OUT_MEASUREMENT
 /begin IN_MEASUREMENT Acfzgl Acfzgq Km_st Nkw Oz_niv Oz_nivlangt Oz_nivnfm Oz_rwpeil Oz_tempf Pu St_cbsozin0 St_cbsozin0.B_oelwech St_cbsozin0.B_ozmanip St_cbsozin0.B_ozvfchg St_cbsozin0.B_ozvfchgc St_cbsozin0.B_ozvfchgcc St_cbsozin0.B_ozvfchgt St_cbsozin0.B_ozzeitdmew St_cbsozin0.B_svcntchg St_cbsozout_nv0 St_cbsozout_nv0.B_ozkl15 St_cbsozout_nv0.B_ozpeilerr St_dqlt0 St_dqlt0.B_ozdiagnmotok St_dqlt0.B_ozerrbsd St_dqlt0.B_ozkttoens St_dqlt0.B_ozlerr St_dqlt0.B_ozqerr St_dqlt0.B_ozterr St_dqlt0.B_td_ogerr St_dqlt0.B_td_ogupl St_dqlt1 St_dqlt1.B_ozerr St_dqlt1.B_ozfbsd2 St_dqlt1.B_oztemppl St_mkwchn St_mkwchn.B_kwdreht St_oz_o St_oz_o.B_mol_sf St_oz_o.B_oztemic St_ozbg0 St_ozbg0.B_mol_vb St_ozbg0.B_mol_vl St_ozbg0.B_oeltemp St_ozgg0 St_ozgg0.B_ozniv St_ozgg0.B_oznivqlt St_ozgg0.B_oznivtoe St_ozgg0.B_ozperm St_ozgg0.B_oztemp St_ozgg0.B_oztempqlt St_ozgg0.B_oztemptoe St_ozgg0.B_oztoeok Tn_abstellm Tn_start_10 Toel Tumg V /end IN_MEASUREMENT
/end FUNCTION
/begin FUNCTION OZTEMP "" /begin DEF_CHARACTERISTIC KF_OZTEMPMDL K_OZTLPF K_OZTLPFMDL /end DEF_CHARACTERISTIC /begin REF_CHARACTERISTIC K_CW_OZ_2 /end REF_CHARACTERISTIC /begin OUT_MEASUREMENT Oz_tempf Oz_tempmdl /end OUT_MEASUREMENT
 /begin IN_MEASUREMENT Nkw Oz_temp St_ozgg0 St_ozgg0.B_ozniv St_ozgg0.B_oznivqlt St_ozgg0.B_oznivtoe St_ozgg0.B_ozperm St_ozgg0.B_oztemp St_ozgg0.B_oztempqlt St_ozgg0.B_oztemptoe St_ozgg0.B_oztoeok Tmot Toel_mdl /end IN_MEASUREMENT
/end FUNCTION
/begin FUNCTION es_30_34_ "" /begin SUB_FUNCTION WES WESE /end SUB_FUNCTION /end FUNCTION
/begin FUNCTION WES "" /begin DEF_CHARACTERISTIC KL_WESNESPR /end DEF_CHARACTERISTIC /begin OUT_MEASUREMENT Wes Wesnesprau /end OUT_MEASUREMENT /begin IN_MEASUREMENT Hubev_soll Vse_spri /end IN_MEASUREMENT /end FUNCTION
/begin FUNCTION WESE ""
 /begin DEF_CHARACTERISTIC KF_DTES12_S KF_DWESEST_H KF_DWESE_HS KF_DWESE_S KF_FWES_H KF_TES12MIN_S KF_TES12_S KF_WESB1K_H KF_WESB1NL_H KF_WESB1_H KF_WESB1_HS KF_WESB2MIN_3H KF_WESBST_H KF_WESE2K_3H KF_WESE2K_H KF_WESE2_3H KF_WESE2_H KF_WESE3K_H KF_WESE3_H KL_DWESB1P_H KL_DWESE2P_H KL_WESB1VL_H KL_WESE2VL_H K_DWESE2APP_H K_DWESEAPP_HS K_DWESEAPP_S K_TES12APP_S K_TESMIN K_UFAKRKTI K_WESB1APP_H K_WESB1APP_HS K_WESB2MIN_H K_WESB3APP_S K_WESB3MAX_S K_WESB3MIN_S K_WESE2APP_H K_WESE3APP_H S_DWESE2APP_H S_DWESEAPP_HS S_DWESEAPP_S S_TES12APP_S S_WESB1APP_H S_WESB1APP_HS S_WESB3APP_S S_WESE2ABS_H S_WESE2APP_H S_WESE3APP_H S_WESVL_ENA /end DEF_CHARACTERISTIC
 /begin REF_CHARACTERISTIC S_SCH_CLC /end REF_CHARACTERISTIC
 /begin OUT_MEASUREMENT Dtes12_s Dwese2_h Dwese_hs Dwese_s Dwesest_h F_wes_h St_wese St_wese.B_tesmin12 St_wese.B_wese2h_abs T_es12_hs T_es12_s Td_wese Wesb1_bas_h Wesb1_h Wesb1_hs Wesb2min_h Wesb3_kh_s Wesb3_s Wesbst_h Wese2_bas_h Wese2_h Wese2_hs Wese2_s Wese3_h Wese_s /end OUT_MEASUREMENT
 /begin IN_MEASUREMENT Drfopt_s Dwesb3_kh_s Dwese2_kh_h La_ber Nkw Prail_ist Rk_soll_hs Rk_soll_s Rk_sollm_h St_clc St_clc.B_hmm_clc St_clc.B_sch_clc St_mdbanl St_mdbanl.B_agrzu_nl St_mdbanl.B_disa_nl St_mdbanl.B_evvt_vsa_nl St_mdbanl.B_evvt_vse_nl St_mdbanl.B_lastopp_nl St_mdbanl.B_tevzu_nl St_mdbanl.B_wesb1h_nl St_mdbanl.B_zw_nl St_mdrk St_mdrk.B_doe_h St_mdrk.B_doe_hs St_mdrk.B_doe_s St_mdrk.B_khmdoe_akt St_mdrk.B_la_prio St_mdrk.B_laprio_h St_mdrk.B_rfresmx_ba St_mdrk.B_rk_resmax St_mdrk3fach St_mdrk3fach.B_rk3h_akt St_motzustd St_motzustd.B_ll_roh St_motzustd.B_vl St_start St_start.B_jumpstart St_start.B_sta St_start.B_start St_start.B_startende St_start.B_wst St_wese.B_tesmin12 St_wese.B_wese2h_abs Tmot Wesb1kh_h Zr_zyk_nstart Zw_kor_s Zw_soll_hs /end IN_MEASUREMENT
/end FUNCTION
/begin FUNCTION ipmna_30_20_ ""
 /begin SUB_FUNCTION IPMNA_DYNKOR IPMNA_GENKOR IPMNA_GENSTOFF IPMNA_LOADRESP IPMNA_MD2IERR IPMNA_PRAE IPMNA_RENNST IPMNA_STATMBILANZ IPMNA_STATMKOR /end SUB_FUNCTION
/end FUNCTION
/begin FUNCTION IPMNA_DYNKOR ""
 /begin DEF_CHARACTERISTIC KL_DMD_MAX1 KL_DMD_MAX2 KL_MDZIEL KL_MDZIELIERR K_DMDGEN_FAK K_DMDGEN_OFF K_GENGCALC K_IERRHYSMAX K_IERRHYSMN K_MDGENGGFIL K_NKW_SCH K_PR_MDDYN S_MDWAHLGG /end DEF_CHARACTERISTIC
 /begin REF_CHARACTERISTIC K_GENMDNMOF K_PR_IGRLOW /end REF_CHARACTERISTIC
 /begin OUT_MEASUREMENT Dmd_gen Dmd_gen_kor Ierrdiff Md_dmm Md_gennmgg Md_gennmnofil Md_grenz_int Md_grenz_res Md_gresziel Md_greszielkorr Md_res_real Mdkw_grenz_dyn Pr_mddyn St_gengrenz St_gengrenz.B_gengcalc St_gengrenz.B_ierrhys /end OUT_MEASUREMENT
 /begin IN_MEASUREMENT Ierr Ierrgrenz Md_gennm Md_gennmtp Mdi_bas N_gen N_gen_tmp Nkw Pr_soll St_genallg St_genallg.B_abliactiv St_genallg.B_bsdprot1 St_genallg.B_bsdprot2 St_genallg.B_iliactiv St_genallg.B_rd_gentyp St_igrsbcalc St_igrsbcalc.B_igr_mot St_igrsbcalc.B_igrlow_en St_igrsbcalc.B_igrlow_on St_igrsbcalc.B_sa_igr St_imdgen0 St_imdgen0.B_gene St_imdgen0.B_generken St_imdgen0.B_im0 St_imdgen0.B_mod_calc /end IN_MEASUREMENT
/end FUNCTION
/begin FUNCTION IPMNA_GENKOR "" /begin DEF_CHARACTERISTIC K_IERRGRENZ_APPL K_PR_IERRAPPL K_PR_IERRTESTER S_IPMNA_AN /end DEF_CHARACTERISTIC
 /begin OUT_MEASUREMENT Ierrgrenz Ierrgrenz_ext Mdkw_grenz Napr_i_appl Napr_i_ext Napr_i_ht Napr_i_ll Napr_i_md Napr_md_dyn Napr_md_stat Napr_sollmn Napr_spgw Pr_grenz_ist Pr_grenz_md Pr_ipmna St_genkor St_genkor.B_ierrgrenz_akt /end OUT_MEASUREMENT
 /begin IN_MEASUREMENT Ierrgrenz_ht Ierrgrenz_ll Ierrgrenz_md Mdkw_grenz_dyn Mdkw_grenz_stat Pr_ierrllred Pr_ierrtred Pr_md_entlsoll Pr_mddyn Pr_sollmn Pr_spgw St_gen_ext St_gen_ext.B_gen_ext St_gen_ext.B_ierr_ext St_gen_ext.B_loadre_ext St_genallg St_genallg.B_abliactiv St_genallg.B_bsdprot1 St_genallg.B_bsdprot2 St_genallg.B_iliactiv St_genallg.B_rd_gentyp /end IN_MEASUREMENT
/end FUNCTION
/begin FUNCTION IPMNA_GENSTOFF ""
 /begin DEF_CHARACTERISTIC KF_ZLRESOF KF_ZLRRESOFV K_ENAPPLGOFF K_FHOGNMN K_MDENTLSOLL2 K_NMXGENOF K_PR_GENSTOFF K_RLMXGENOF K_TABSTGNMN K_TABSTGNMX K_TATMGENOF K_TDGENOFFST K_TMOTABGNMN K_TUMGGNMN K_TUMGGNMX K_VZLORESOFV S_LORESLL /end DEF_CHARACTERISTIC
 /begin OUT_MEASUREMENT Md_entlsoll2 Pr_md_entlsoll2 St_loadresp0 St_loadresp0.B_genoffmd St_loadresp0.B_genoffst St_loadresp0.B_sulevvoff /end OUT_MEASUREMENT
 /begin IN_MEASUREMENT Fho Km_st Nkw Rf St_bgkuppl1 St_bgkuppl1.B_ll St_start St_start.B_jumpstart St_start.B_sta St_start.B_start St_start.B_startende St_start.B_wst Tmot_start Tn_abstell Tumg V /end IN_MEASUREMENT
/end FUNCTION
/begin FUNCTION IPMNA_LOADRESP ""
 /begin DEF_CHARACTERISTIC CW_BNS_LR KF_LORESP KF_LORESPKH KF_LRWAFS KF_MDRESWAFS KL_LORESPM KL_LRIGR K_APPLROFF K_ENAPPLRESP K_LRBNS K_LRESPAPP K_LRSPGW K_LRTEST K_MDRESBN K_SCHNKWSPGW K_SCHPRLRTEST K_SCHWPRSPWGLR1 K_SCHWPRSPWGLR2 K_SCHWPRSPWGLR3 K_SCHWPRSPWGLR4 K_SCHWPRSPWGLR5 K_TLORESPST S_LRTEST /end DEF_CHARACTERISTIC
 /begin REF_CHARACTERISTIC K_PR_IGRLOW /end REF_CHARACTERISTIC
 /begin OUT_MEASUREMENT Loadresp Md_res_bn St_loadresp St_loadresp.B_lroff St_loadresp2 St_loadresp2.B_lroff2 Tlrgen Tlrgen2 Z_dmdblock /end OUT_MEASUREMENT
 /begin IN_MEASUREMENT Nkw Pr_entl_soll Pr_grenz_ist Pr_ipmna Pr_mddyn Pr_soll Pr_spgw Rf St_bgkuppl1 St_bgkuppl1.B_ll St_gen_ext St_gen_ext.B_gen_ext St_gen_ext.B_ierr_ext St_gen_ext.B_loadre_ext St_llr St_llr.B_llrein St_pmspgw St_pmspgw.B_bnqh St_pmspgw.B_eps_ak St_pmspgw.B_ldaeps_ak St_pmspgw.B_pmspgwbns St_pmspgw.B_ubw_aktiv St_pmspgw.B_ubw_ullow St_pmspgw.B_ubw_ulowak St_pmspgw.B_ubw_uslow St_pwf St_pwf.B_pwf Tmot W_afs W_dafs /end IN_MEASUREMENT
/end FUNCTION
/begin FUNCTION IPMNA_MD2IERR "" /begin REF_CHARACTERISTIC S_IPMNA_AN /end REF_CHARACTERISTIC /begin OUT_MEASUREMENT I_genipol1 I_genipol2 I_genipol3 Ierrgrenz_md Md_grenz_kor /end OUT_MEASUREMENT
 /begin IN_MEASUREMENT Gen_awnumm Gen_uebsetz Mdkw_grenz N_gen St_genallg St_genallg.B_abliactiv St_genallg.B_bsdprot1 St_genallg.B_bsdprot2 St_genallg.B_iliactiv St_genallg.B_rd_gentyp Tchip_diff1 Tchip_diff2 Ugen_calc /end IN_MEASUREMENT
/end FUNCTION
/begin FUNCTION IPMNA_PRAE ""
 /begin DEF_CHARACTERISTIC KF_MDMAX_ARS KF_MDMAX_GEN KF_MDMAX_KK KF_MDMAX_SL KF_VERLWAN KL_F_GENTYP KL_F_MDSLT KL_MDGRAD_AFS KL_MDGRAD_GEN KL_MDGRAD_SL KL_MDKMAXRED KL_MDMAX_GETR KL_VERLPU KL_VERLPU_TKOR KL_VERLWAN_TKOR K_F_LLRI K_F_MDMXREAL K_F_MDSLT K_F_NABC K_MDGRAD_ARS K_MDGRAD_GETR K_MDGRAD_GETRFS K_MDGRAD_KK K_MDMAXMAN K_TD_GETRIEBE K_T_MDNAGEN K_T_MDNAKK K_T_MDNAKKUP S_KKOFF S_MDGETR_DME S_MDMAXMAN S_MDNAICM /end DEF_CHARACTERISTIC
 /begin REF_CHARACTERISTIC CW_NA CW_NA_KONF K_PR_MDSICH K_SCHNKW_IPMNA S_STATM_AN /end REF_CHARACTERISTIC
 /begin OUT_MEASUREMENT Md_entlsoll1 Md_entlsollkk Md_get_ipm Md_na_bc Md_na_wcl Md_na_wcs Md_naars_wcl Md_naars_wcs Md_naef_wcl Md_naef_wcs Md_nagen_wcl Md_nagen_wcs Md_nagesverlust Md_nagetr_wcl Md_nagetr_wcs Md_nakk_wcl Md_nakk_wcs Md_nasl_wcl Md_nasl_wcs Mdkw_rest T_mdnal T_mdnas Td_getriebe Var_afs Var_ars /end OUT_MEASUREMENT
 /begin IN_MEASUREMENT Dzw_krann_vl Fho Gangi Gen_awnumm Md_gennm Mdk_max_real Nkw Pr_grenz_ist Tgen Tlrgen Tumg V Var_at W_afs W_dafs /end IN_MEASUREMENT
/end FUNCTION
/begin FUNCTION IPMNA_RENNST ""
 /begin DEF_CHARACTERISTIC K_ANZ_RENN K_MDENTL_GENOFFVL K_MDENTL_RENN K_NGENOFMN K_NGENOFMX K_PR_GENOFFVL K_PR_RENNST K_PR_RENNSTAGM K_SCH_PWGRENNST K_TD_GENBVL K_TD_GENOFVL K_TD_RENN K_TGENOFMN K_TGENOFMX K_T_RENNAKT K_T_VRENN K_VGENOFMN K_VGENOFMX K_ZRRENN_INI S_GENOFFVL S_ZRRENN_INI /end DEF_CHARACTERISTIC
 /begin OUT_MEASUREMENT Md_entlsoll4 Pr_md_entlsoll4 St_rennst St_rennst.B_genoffvl_lem St_rennst.B_genvloffla St_rennst.B_renn_ber St_rennst.B_renn_berold St_rennst.B_rennstart St_rennst.B_rennstartold St_rennst.B_vl_verz T_renn_akt T_v_renn Td_genbvl Td_genofvl Td_renn Zr_rennstart /end OUT_MEASUREMENT
 /begin IN_MEASUREMENT Nkw Pwg_ist St_bls St_bls.B_bls St_motzustd St_motzustd.B_ll_roh St_motzustd.B_vl St_pmbattmng2 St_pmbattmng2.B_agmverbaut St_pmbattmng2.B_entladung St_pmbattmng2.B_entlfrei St_pmbattmng2.B_taerr_1 St_pwf St_pwf.B_pwf Tmot V Var_at /end IN_MEASUREMENT
/end FUNCTION
/begin FUNCTION IPMNA_STATMBILANZ ""
 /begin DEF_CHARACTERISTIC CW_NA_KONF K_MDENTLFUNK K_MDENTLKOMF K_MDENTLSICH K_MDENTLTEST K_MDKWFUNK_HYS K_MDKWKOMF_HYS K_MDKWRESTMXVOFF K_MDKWRESTMXVOFF_HYS K_MDKWSICH_HYS K_MDKW_FUNK K_MDKW_KOMF K_MDKW_RESTAFU K_MDKW_SICH K_PR_MDFUNK K_PR_MDKOMF K_PR_MDSICH K_PR_MDTEST K_SCHNKW_IPMNA K_SCH_ANFAHR K_SCH_MDNAVERL K_SCH_NKWENTL K_SCH_NKWGRAD K_SCH_VSICH K_TD_KKOFF K_TD_KKOFFSICH K_TD_MDENTFUNKRES K_TD_MDENTKKRES K_TD_MDENTKOMFRES K_TD_MDENTKOMFSET K_TD_MDENTSICHRES S_STATM_AN S_TESTMBILANZ /end DEF_CHARACTERISTIC
 /begin OUT_MEASUREMENT Md_na_bilanzgen Md_na_bilanzkk Md_na_bilanzl Md_na_bilanzs Pr_md_entlkk Pr_md_entlsoll1 Pr_mdfunk Pr_mdkomf Pr_mdsich Pr_mdsichkk St_ipmnaprae St_ipmnaprae.B_entlnkw St_ipmnaprae.B_fl_kk St_ipmnaprae.B_mdkwvoff St_ipmnaprae.B_notafu1 Td_kkoff Td_kkoff_sich Td_mdent_funkres Td_mdent_kkres Td_mdent_komfres Td_mdent_komfset Td_mdent_sichres /end OUT_MEASUREMENT
 /begin IN_MEASUREMENT Gangi Md_na_bc Md_na_wcl Md_na_wcs Md_nagesverlust Mdkw_rest Nkw Nkw_grad_fpt1 Pwg_ist St_bls St_bls.B_bls St_kl15 St_kl15.B_kl15_ep St_kl15.B_kl15_vorab St_start St_start.B_jumpstart St_start.B_sta St_start.B_start St_start.B_startende St_start.B_wst V Var_at /end IN_MEASUREMENT
/end FUNCTION
/begin FUNCTION IPMNA_STATMKOR ""
 /begin DEF_CHARACTERISTIC KL_U_ENTL K_MDACMIN K_SCHPR_KKMN K_SCHPR_KKOFF K_TDAFU K_UENTL_SOLL /end DEF_CHARACTERISTIC
 /begin OUT_MEASUREMENT Md_entlsoll Md_max_acnaue Md_max_klima Mdkw_grenz_stat Pr_entl_soll Pr_md_entlsoll Pr_md_entlsoll1alt Pr_md_entlsoll2alt Pr_md_entlsoll3alt St_statmkor St_statmkor.B_grenz_stat St_statmkor.B_kk_off St_statmkor.B_mdentlu St_statmkor1 St_statmkor1.B_notafu Td_afu U_entl_soll /end OUT_MEASUREMENT
 /begin IN_MEASUREMENT Md_entlsoll1 Md_entlsoll2 Md_entlsoll3 Md_entlsoll4 Md_entlsollkk Md_gennm Md_max_acwm Md_na_ac Pr_ierrtred Pr_md_entlkk Pr_md_entlsoll1 Pr_md_entlsoll2 Pr_md_entlsoll3 Pr_md_entlsoll4 Pr_sollmn Pr_spgw St_elnotafu St_elnotafu.B_notafu2 St_ipmnaprae St_ipmnaprae.B_entlnkw St_ipmnaprae.B_fl_kk St_ipmnaprae.B_mdkwvoff St_ipmnaprae.B_notafu1 /end IN_MEASUREMENT
/end FUNCTION
/begin FUNCTION lr_30_43_ "" /begin SUB_FUNCTION KLANN LAMKO /end SUB_FUNCTION /end FUNCTION
/begin FUNCTION KLANN ""
 /begin DEF_CHARACTERISTIC KF_FLRADAP_MN KF_FLRADAP_MX KF_KLANN_EPS K_CKLANN_NKW K_CKLANN_RK K_CKLANN_TMOT K_KLANN_ANZ K_KLANN_EPS K_KLANN_MX K_SKLANN_NKW K_SKLANN_RK K_SKLANN_TMOT K_TDKLANN S_KLANN_ON /end DEF_CHARACTERISTIC
 /begin OUT_MEASUREMENT F_klann_eps1 F_klann_eps2 F_lradap1 F_lradap2 F_lradap_vb1 F_lradap_vb2 F_lradaps1 F_lradaps2 Klann_test1 Klann_test2 Rk_olad_1 Rk_olad_2 St_klann_ad1 St_klann_ad1.B_lradap1_mn St_klann_ad1.B_lradap1_mx St_klann_ad2 St_klann_ad2.B_lradap2_mn St_klann_ad2.B_lradap2_mx w_klbias1 w_klbias2 w_klnkw1 w_klnkw2 w_klrk1 w_klrk2 w_kltmot1 w_kltmot2 /end OUT_MEASUREMENT
 /begin IN_MEASUREMENT Nkw Rf St_atlout St_atlout.B_wg1_auf St_atlout.B_wg2_auf St_atlstat St_atlstat.B_atl_bereit St_atlstat.B_atldyn St_atlstat.B_atlr St_atlstat.B_tvld_mod St_atlstat.B_ulvdyn St_atlstat.B_vlschalt St_pwf St_pwf.B_pwf St_start St_start.B_jumpstart St_start.B_sta St_start.B_start St_start.B_startende St_start.B_wst St_tevein St_tevein.B_te St_tevein.B_te_la1 St_tevein.B_teblg St_tevein.B_tev_erf St_varkat St_varkat.B_varkat Tmot /end IN_MEASUREMENT
/end FUNCTION
/begin FUNCTION LAMKO ""
 /begin DEF_CHARACTERISTIC KF_DLAWUP KF_DLAWUP_ZSK KF_DLA_UESP KF_LABAS_1 KF_LABAS_2 KF_LAHOMBAS KF_LAINST_NEG KF_LAINST_POS KF_SUBPRIO_AUSW1 KF_UESP_LA KL_AUSWAHL1 KL_AUSWAHL2 KL_AUSWAHL3 KL_AUSW_DLA KL_AUSW_PULS KL_DLA_INST KL_DMDILA_MAX KL_DMDILA_MIN KL_ETA_LAMBDA KL_FATLDYNTRIMM KL_KDLA_UESP KL_LAPRIO_KO KL_LA_VL1 KL_LA_VL2 KL_ZK_ETALAMZW K_DLA_BSWL K_DLA_HOMM K_DLA_PULS K_DMDILA_MAX K_DMDILA_MIN K_ETAGES_MN K_ETAGES_MX K_KDMDI_FIL K_LAHOMMAN1 K_LAHOMMAN2 K_LAMIN_H K_LASCHUB K_NKWDYN_GRENZ S_APPL_DESU S_LAHOMAN S_PULS1TO2 /end DEF_CHARACTERISTIC
 /begin REF_CHARACTERISTIC S_ATM_N54 /end REF_CHARACTERISTIC
 /begin OUT_MEASUREMENT Dla_soll_puls Dla_uesp Dla_wup Dmdi_ml_soll Eta_ges_f Eta_lako Eta_lamb_bas Eta_lamb_bas1 Eta_lamb_bas2 La_abgas1 La_abgas2 La_bas1 La_bas2 La_hom1 La_hom2 La_inst La_inst_bas La_ref_homm La_soll1 La_soll2 La_soll_h1 La_soll_h2 La_soll_ko1 La_soll_ko2 La_soll_stat1 La_soll_stat2 La_soll_vl1 La_soll_vl2 La_vl1 La_vl2 La_wahl1_b1 La_wahl1_b2 La_wahl2_b1 La_wahl2_b2 Lam_auswahl1 Lam_auswahl2 Lam_auswahl3 Lam_auswahl_dla St_lamko St_lamko.B_bswl St_lamko.B_lainst_neg St_lamko.B_lainst_pos St_lamko.B_laprio_ko Zk_eta /end OUT_MEASUREMENT
 /begin IN_MEASUREMENT Ba_ist Ba_soll Ba_subist Dlam_bs_n54 Eta_zwve_m F_atldyn La_bs1 La_bs2 La_soll_notl1 La_soll_notl2 La_sollreg1 La_sollreg2 Mdi_ml_soll Mdi_soll_l Nkw Nkw_dyn Rf St_cybl St_cybl.B_gl_ad St_cybl.B_gl_adder St_cybl.B_gl_adz St_cybl.B_gl_faker St_cybl.B_gl_hz St_cybl.B_gl_wg1 St_cybl.B_gl_wg2 St_cybl.B_gl_zsk St_cybl.B_gl_zsw St_cybl.B_gl_zswz St_mdbafak St_mdbafak.B_hmm_akt St_mdbafak.B_hom_akt St_mdbafak.B_hschicht St_mdbafak.B_la_stopp St_mdbafak.B_la_stopp1 St_mdbafak.B_la_stopp2 St_mdbafak.B_sch_akt St_mdbafak.B_schicht St_subziel St_varkat St_varkat.B_varkat St_zwbts1 St_zwbts1.B_bs1 St_zwbts1.B_bs2 St_zwbts1.B_bsmager St_zwbts1.B_lklpsaga St_zwbts1.B_lklpsbs St_zwbts1.B_lklpsmager Subprio_bronze Subprio_gold Subprio_silber Tmot Zr_zyk_nstart /end IN_MEASUREMENT
/end FUNCTION
/begin FUNCTION kr_38_13_ "" /begin SUB_FUNCTION KRANN /end SUB_FUNCTION /end FUNCTION
/end MODULE
/end PROJECT
