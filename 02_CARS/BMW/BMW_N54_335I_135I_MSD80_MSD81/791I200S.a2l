ASAP2_VERSION 1 41
/begin PROJECT MSD85 "Spray Guided DI-System with Piezo Injectors for 8-Cylinder"
/begin HEADER "_default_HeaderComment" PROJECT_NO _91 /end HEADER
/begin MODULE _default_ModuleName "_default_ModuleLongIdentifier"
/begin MOD_COMMON "_default_ModCommonComment" DEPOSIT ABSOLUTE BYTE_ORDER MSB_LAST ALIGNMENT_BYTE 1 ALIGNMENT_WORD 2 ALIGNMENT_LONG 2 ALIGNMENT_FLOAT32_IEEE 2 ALIGNMENT_FLOAT64_IEEE 4 /end MOD_COMMON
/begin CHARACTERISTIC c_lamb_delta_p_lam_adj_max "" VALUE 0xa0801aa8 _REC_VAL_20_s2 0.25 _CNV_A_R_LINEAR_____24_CM -0.125 0.125 DISPLAY_IDENTIFIER C_LAMB_DELTA_P_LAM_ADJ_MAX FORMAT "%8.5" /end CHARACTERISTIC
/begin MEASUREMENT igc_diag_mis "Non filtered error information for misfire detection" UBYTE _CNV_A_R_LINEAR_____0_CM 1 100. 0. 255. DISPLAY_IDENTIFIER IGC_DIAG_MIS ECU_ADDRESS 0xd0007398 FORMAT "%3.0" /end MEASUREMENT
/begin CHARACTERISTIC c_abc_igc_scp "Value of anti-bounce counter after regeneration cycle Typical value for debug = 128" VALUE 0xa08008a1 _REC_VAL_20_u1 255. _CNV_A_R_LINEAR_____0_CM 0. 255. DISPLAY_IDENTIFIER C_ABC_IGC_SCP FORMAT "%3.0" /end CHARACTERISTIC
/begin CHARACTERISTIC c_iga_off_cycnr_hld "Duration for regeneration cycle recurrence number ; coil has been switched off - - typical value for debug = 16" VALUE 0xa08008ac _REC_VAL_20_u1 255. _CNV_A_R_LINEAR_____0_CM 0. 255. DISPLAY_IDENTIFIER C_IGA_OFF_CYCNR_HLD FORMAT "%3.0" /end CHARACTERISTIC
/begin CHARACTERISTIC c_sum_igc_scp "Number of cycles before switching off the coil until reset - - typical value for debug = 255" VALUE 0xa08008b8 _REC_VAL_20_u1 255. _CNV_A_R_LINEAR_____0_CM 0. 255. DISPLAY_IDENTIFIER C_SUM_IGC_SCP FORMAT "%3.0" /end CHARACTERISTIC
/begin CHARACTERISTIC c_esb_ign_cut_diag "C_ESB_IGN_CUT_DIAG = 0 will inhibit the function - - typical value for debug = 0" VALUE 0xa08008aa _REC_VAL_20_u1 1. _CNV_S_2_RANGE__0___1_CM 0. 1. DISPLAY_IDENTIFIER C_ESB_IGN_CUT_DIAG /end CHARACTERISTIC
/begin CHARACTERISTIC c_n_32_min_scp_igc_diag "Minimum engine speed for condition diagnosis SCP - Typical value for debug = 500 rpm" VALUE 0xa08008ae _REC_VAL_20_u1 8160. _CNV_A_R_LINEAR_____10_CM 0. 8160. DISPLAY_IDENTIFIER C_N_32_MIN_SCP_IGC_DIAG FORMAT "%4.0" /end CHARACTERISTIC
/begin CHARACTERISTIC c_n_32_min_ol_scg_igc_diag "Min engine speed for condition diagnosis OL/SCG  - Typical value for debug value = 500 rpm" VALUE 0xa08008ad _REC_VAL_20_u1 8160. _CNV_A_R_LINEAR_____10_CM 0. 8160. DISPLAY_IDENTIFIER C_N_32_MIN_OL_SCG_IGC_DIAG FORMAT "%4.0" /end CHARACTERISTIC
/begin CHARACTERISTIC c_tco_min_igc_diag "min temperature for condition diagnosis OL & SCG - - typical value for debug = 20°C  ( emission cycle starting )" VALUE 0xa08008c8 _REC_VAL_20_u1 190.5 _CNV_A_R_LINEAR_____17_CM -48. 142.5 DISPLAY_IDENTIFIER C_TCO_MIN_IGC_DIAG FORMAT "%6.2" /end CHARACTERISTIC
/begin MEASUREMENT lv_err_igc_scp_0 "ignition coil failure short circuit plus of cylinder 0" UBYTE _CNV_S_2_RANGE__0___1_CM 1 100. 0. 1. DISPLAY_IDENTIFIER LV_ERR_IGC_SCP_0 ECU_ADDRESS 0xd0007f20 BIT_MASK 0x1 /end MEASUREMENT
/begin MEASUREMENT lv_err_igc_scp_1 "ignition coil failure short circuit plus of cylinder 1" UBYTE _CNV_S_2_RANGE__0___1_CM 1 100. 0. 1. DISPLAY_IDENTIFIER LV_ERR_IGC_SCP_1 ECU_ADDRESS 0xd0007f21 BIT_MASK 0x1 /end MEASUREMENT
/begin MEASUREMENT lv_err_igc_scp_2 "ignition coil failure short circuit plus of cylinder 2" UBYTE _CNV_S_2_RANGE__0___1_CM 1 100. 0. 1. DISPLAY_IDENTIFIER LV_ERR_IGC_SCP_2 ECU_ADDRESS 0xd0007f22 BIT_MASK 0x1 /end MEASUREMENT
/begin MEASUREMENT lv_err_igc_scp_3 "ignition coil failure short circuit plus of cylinder 3" UBYTE _CNV_S_2_RANGE__0___1_CM 1 100. 0. 1. DISPLAY_IDENTIFIER LV_ERR_IGC_SCP_3 ECU_ADDRESS 0xd0007f23 BIT_MASK 0x1 /end MEASUREMENT
/begin MEASUREMENT lv_err_igc_scp_4 "ignition coil failure short circuit plus of cylinder 4" UBYTE _CNV_S_2_RANGE__0___1_CM 1 100. 0. 1. DISPLAY_IDENTIFIER LV_ERR_IGC_SCP_4 ECU_ADDRESS 0xd0007f24 BIT_MASK 0x1 /end MEASUREMENT
/begin MEASUREMENT lv_err_igc_scp_5 "ignition coil failure short circuit plus of cylinder 5" UBYTE _CNV_S_2_RANGE__0___1_CM 1 100. 0. 1. DISPLAY_IDENTIFIER LV_ERR_IGC_SCP_5 ECU_ADDRESS 0xd0007f25 BIT_MASK 0x1 /end MEASUREMENT
/begin MEASUREMENT lv_err_igc_scp_6 "ignition coil failure short circuit plus of cylinder 6" UBYTE _CNV_S_2_RANGE__0___1_CM 1 100. 0. 1. DISPLAY_IDENTIFIER LV_ERR_IGC_SCP_6 ECU_ADDRESS 0xd0007f26 BIT_MASK 0x1 /end MEASUREMENT
/begin MEASUREMENT lv_err_igc_scp_7 "ignition coil failure short circuit plus of cylinder 7" UBYTE _CNV_S_2_RANGE__0___1_CM 1 100. 0. 1. DISPLAY_IDENTIFIER LV_ERR_IGC_SCP_7 ECU_ADDRESS 0xd0007f27 BIT_MASK 0x1 /end MEASUREMENT
/begin MEASUREMENT lv_err_igc_scg_0 "ignition coil failure primary short circuit ground of cylinder 0" UBYTE _CNV_S_2_RANGE__0___1_CM 1 100. 0. 1. DISPLAY_IDENTIFIER LV_ERR_IGC_SCG_0 ECU_ADDRESS 0xd0007f28 BIT_MASK 0x1 /end MEASUREMENT
/begin MEASUREMENT lv_err_igc_scg_1 "ignition coil failure primary short circuit ground of cylinder 1" UBYTE _CNV_S_2_RANGE__0___1_CM 1 100. 0. 1. DISPLAY_IDENTIFIER LV_ERR_IGC_SCG_1 ECU_ADDRESS 0xd0007f29 BIT_MASK 0x1 /end MEASUREMENT
/begin MEASUREMENT lv_err_igc_scg_2 "ignition coil failure primary short circuit ground of cylinder 2" UBYTE _CNV_S_2_RANGE__0___1_CM 1 100. 0. 1. DISPLAY_IDENTIFIER LV_ERR_IGC_SCG_2 ECU_ADDRESS 0xd0007f2a BIT_MASK 0x1 /end MEASUREMENT
/begin MEASUREMENT lv_err_igc_scg_3 "ignition coil failure primary short circuit ground of cylinder 3" UBYTE _CNV_S_2_RANGE__0___1_CM 1 100. 0. 1. DISPLAY_IDENTIFIER LV_ERR_IGC_SCG_3 ECU_ADDRESS 0xd0007f2b BIT_MASK 0x1 /end MEASUREMENT
/begin MEASUREMENT lv_err_igc_scg_4 "ignition coil failure primary short circuit ground of cylinder 4" UBYTE _CNV_S_2_RANGE__0___1_CM 1 100. 0. 1. DISPLAY_IDENTIFIER LV_ERR_IGC_SCG_4 ECU_ADDRESS 0xd0007f2c BIT_MASK 0x1 /end MEASUREMENT
/begin MEASUREMENT lv_err_igc_scg_5 "ignition coil failure primary short circuit ground of cylinder 5" UBYTE _CNV_S_2_RANGE__0___1_CM 1 100. 0. 1. DISPLAY_IDENTIFIER LV_ERR_IGC_SCG_5 ECU_ADDRESS 0xd0007f2d BIT_MASK 0x1 /end MEASUREMENT
/begin MEASUREMENT lv_err_igc_scg_6 "ignition coil failure primary short circuit ground of cylinder 6" UBYTE _CNV_S_2_RANGE__0___1_CM 1 100. 0. 1. DISPLAY_IDENTIFIER LV_ERR_IGC_SCG_6 ECU_ADDRESS 0xd0007f2e BIT_MASK 0x1 /end MEASUREMENT
/begin MEASUREMENT lv_err_igc_scg_7 "ignition coil failure primary short circuit ground of cylinder 7" UBYTE _CNV_S_2_RANGE__0___1_CM 1 100. 0. 1. DISPLAY_IDENTIFIER LV_ERR_IGC_SCG_7 ECU_ADDRESS 0xd0007f2f BIT_MASK 0x1 /end MEASUREMENT
/begin MEASUREMENT lv_err_igc_ol_1 "ignition coil failure primary open load of cylinder 1" UBYTE _CNV_S_2_RANGE__0___1_CM 1 100. 0. 1. DISPLAY_IDENTIFIER LV_ERR_IGC_OL_1 ECU_ADDRESS 0xd0007f31 BIT_MASK 0x1 /end MEASUREMENT
/begin MEASUREMENT lv_err_igc_ol_2 "ignition coil failure primary open load of cylinder 2" UBYTE _CNV_S_2_RANGE__0___1_CM 1 100. 0. 1. DISPLAY_IDENTIFIER LV_ERR_IGC_OL_2 ECU_ADDRESS 0xd0007f32 BIT_MASK 0x1 /end MEASUREMENT
/begin MEASUREMENT lv_err_igc_ol_3 "ignition coil failure primary open load of cylinder 3" UBYTE _CNV_S_2_RANGE__0___1_CM 1 100. 0. 1. DISPLAY_IDENTIFIER LV_ERR_IGC_OL_3 ECU_ADDRESS 0xd0007f33 BIT_MASK 0x1 /end MEASUREMENT
/begin MEASUREMENT lv_err_igc_ol_4 "ignition coil failure primary open load of cylinder 4" UBYTE _CNV_S_2_RANGE__0___1_CM 1 100. 0. 1. DISPLAY_IDENTIFIER LV_ERR_IGC_OL_4 ECU_ADDRESS 0xd0007f34 BIT_MASK 0x1 /end MEASUREMENT
/begin MEASUREMENT lv_err_igc_ol_5 "ignition coil failure primary open load of cylinder 5" UBYTE _CNV_S_2_RANGE__0___1_CM 1 100. 0. 1. DISPLAY_IDENTIFIER LV_ERR_IGC_OL_5 ECU_ADDRESS 0xd0007f35 BIT_MASK 0x1 /end MEASUREMENT
/begin MEASUREMENT lv_err_igc_ol_6 "ignition coil failure primary open load of cylinder 6" UBYTE _CNV_S_2_RANGE__0___1_CM 1 100. 0. 1. DISPLAY_IDENTIFIER LV_ERR_IGC_OL_6 ECU_ADDRESS 0xd0007f36 BIT_MASK 0x1 /end MEASUREMENT
/begin MEASUREMENT lv_err_igc_ol_7 "ignition coil failure primary open load of cylinder 7" UBYTE _CNV_S_2_RANGE__0___1_CM 1 100. 0. 1. DISPLAY_IDENTIFIER LV_ERR_IGC_OL_7 ECU_ADDRESS 0xd0007f37 BIT_MASK 0x1 /end MEASUREMENT
/begin MEASUREMENT lv_inh_igc[0] "Inhibition for ignition system of cylinder x" UBYTE _CNV_S_2_RANGE__0___1_CM 1 100. 0. 1. DISPLAY_IDENTIFIER LV_INH_IGC_0 ECU_ADDRESS 0xd00073a8 BIT_MASK 0x1 /end MEASUREMENT
/begin MEASUREMENT lv_inh_igc[1] "Inhibition for ignition system of cylinder x" UBYTE _CNV_S_2_RANGE__0___1_CM 1 100. 0. 1. DISPLAY_IDENTIFIER LV_INH_IGC_1 ECU_ADDRESS 0xd00073a9 BIT_MASK 0x1 /end MEASUREMENT
/begin MEASUREMENT lv_inh_igc[2] "Inhibition for ignition system of cylinder x" UBYTE _CNV_S_2_RANGE__0___1_CM 1 100. 0. 1. DISPLAY_IDENTIFIER LV_INH_IGC_2 ECU_ADDRESS 0xd00073aa BIT_MASK 0x1 /end MEASUREMENT
/begin MEASUREMENT lv_inh_igc[3] "Inhibition for ignition system of cylinder x" UBYTE _CNV_S_2_RANGE__0___1_CM 1 100. 0. 1. DISPLAY_IDENTIFIER LV_INH_IGC_3 ECU_ADDRESS 0xd00073ab BIT_MASK 0x1 /end MEASUREMENT
/begin MEASUREMENT lv_inh_igc[4] "Inhibition for ignition system of cylinder x" UBYTE _CNV_S_2_RANGE__0___1_CM 1 100. 0. 1. DISPLAY_IDENTIFIER LV_INH_IGC_4 ECU_ADDRESS 0xd00073ac BIT_MASK 0x1 /end MEASUREMENT
/begin MEASUREMENT lv_inh_igc[5] "Inhibition for ignition system of cylinder x" UBYTE _CNV_S_2_RANGE__0___1_CM 1 100. 0. 1. DISPLAY_IDENTIFIER LV_INH_IGC_5 ECU_ADDRESS 0xd00073ad BIT_MASK 0x1 /end MEASUREMENT
/begin MEASUREMENT lv_inh_igc[6] "Inhibition for ignition system of cylinder x" UBYTE _CNV_S_2_RANGE__0___1_CM 1 100. 0. 1. DISPLAY_IDENTIFIER LV_INH_IGC_6 ECU_ADDRESS 0xd00073ae BIT_MASK 0x1 /end MEASUREMENT
/begin MEASUREMENT lv_inh_igc[7] "Inhibition for ignition system of cylinder x" UBYTE _CNV_S_2_RANGE__0___1_CM 1 100. 0. 1. DISPLAY_IDENTIFIER LV_INH_IGC_7 ECU_ADDRESS 0xd00073af BIT_MASK 0x1 /end MEASUREMENT
/begin MEASUREMENT lv_err_igc_ol_0 "ignition coil failure primary open load of cylinder 0" UBYTE _CNV_S_2_RANGE__0___1_CM 1 100. 0. 1. DISPLAY_IDENTIFIER LV_ERR_IGC_OL_0 ECU_ADDRESS 0xd0007f30 BIT_MASK 0x1 /end MEASUREMENT
/begin MEASUREMENT lv_inh_inj_diag_igc "Flag to inhibit injection on all cylinders due to lost ignition coil supply" UBYTE _CNV_S_2_RANGE__0___1_CM 1 100. 0. 1. DISPLAY_IDENTIFIER LV_INH_INJ_DIAG_IGC ECU_ADDRESS 0xd00073b0 BIT_MASK 0x1 /end MEASUREMENT
/begin MEASUREMENT lv_err_igc "OR of every failure" UBYTE _CNV_S_2_RANGE__0___1_CM 1 100. 0. 1. DISPLAY_IDENTIFIER LV_ERR_IGC ECU_ADDRESS 0xd00073a0 BIT_MASK 0x1 /end MEASUREMENT
/begin MEASUREMENT lv_err_dur_igc_mpl "ignition coil failure primary open load" UBYTE _CNV_S_2_RANGE__0___1_CM 1 100. 0. 1. DISPLAY_IDENTIFIER LV_ERR_DUR_IGC_MPL ECU_ADDRESS 0xd0007f38 BIT_MASK 0x1 /end MEASUREMENT
/begin MEASUREMENT inh_iv_igc "Injection cut off" UBYTE _CNV_A_R_LINEAR_____0_CM 1 100. 0. 255. DISPLAY_IDENTIFIER INH_IV_IGC ECU_ADDRESS 0xd000739b FORMAT "%3.0" /end MEASUREMENT
/begin CHARACTERISTIC c_abc_inc_igc_scp "Anti - bounce counter increment for ignition system diagnosis SCP -  typical value for debug = 5" VALUE 0xa08008a5 _REC_VAL_20_u1 255. _CNV_A_R_LINEAR_____0_CM 0. 255. DISPLAY_IDENTIFIER C_ABC_INC_IGC_SCP FORMAT "%3.0" /end CHARACTERISTIC
/begin CHARACTERISTIC c_abc_inc_igc_ol "Anti - bounce counter increment for ignition system diagnosis OL  - typical value for debug = 5" VALUE 0xa08008a3 _REC_VAL_20_u1 255. _CNV_A_R_LINEAR_____0_CM 0. 255. DISPLAY_IDENTIFIER C_ABC_INC_IGC_OL FORMAT "%3.0" /end CHARACTERISTIC
/begin CHARACTERISTIC c_abc_inc_igc_scg "Anti - bounce counter increment for ignition system diagnosis SCG -  typical value for debug = 5" VALUE 0xa08008a4 _REC_VAL_20_u1 255. _CNV_A_R_LINEAR_____0_CM 0. 255. DISPLAY_IDENTIFIER C_ABC_INC_IGC_SCG FORMAT "%3.0" /end CHARACTERISTIC
/begin CHARACTERISTIC c_abc_inc_dur_igc_mpl "Anti - bounce counter increment for the ignition system diagnosis multiple open load" VALUE 0xa08008a2 _REC_VAL_20_u1 255. _CNV_A_R_LINEAR_____0_CM 0. 255. DISPLAY_IDENTIFIER C_ABC_INC_DUR_IGC_MPL FORMAT "%3.0" /end CHARACTERISTIC
/begin CHARACTERISTIC c_abc_dec_dur_igc_mpl "Anti - bounce counter decrement for the ignition system diagnosis multiple open load" VALUE 0xa08008a0 _REC_VAL_20_u1 255. _CNV_A_R_LINEAR_____0_CM 0. 255. DISPLAY_IDENTIFIER C_ABC_DEC_DUR_IGC_MPL FORMAT "%3.0" /end CHARACTERISTIC
/begin CHARACTERISTIC c_abc_max_igc_scp "Maximum value of the anti-bounce counter for the ignition system diagnosis to switch off the coil  - typical value for debug = 255" VALUE 0xa08008a9 _REC_VAL_20_u1 254. _CNV_A_R_LINEAR_____0_CM 1. 255. DISPLAY_IDENTIFIER C_ABC_MAX_IGC_SCP FORMAT "%3.0" /end CHARACTERISTIC
/begin CHARACTERISTIC c_abc_max_igc_scg "Maximum value of the anti-bounce counter for the ignition diagnosis SCG - typical value for debug = 255" VALUE 0xa08008a8 _REC_VAL_20_u1 254. _CNV_A_R_LINEAR_____0_CM 1. 255. DISPLAY_IDENTIFIER C_ABC_MAX_IGC_SCG FORMAT "%3.0" /end CHARACTERISTIC
/begin CHARACTERISTIC c_abc_max_igc_ol "Maximum value of the anti-bounce counter for the ignition diagnosis OL - - typical value for debug = 255" VALUE 0xa08008a7 _REC_VAL_20_u1 254. _CNV_A_R_LINEAR_____0_CM 1. 255. DISPLAY_IDENTIFIER C_ABC_MAX_IGC_OL FORMAT "%3.0" /end CHARACTERISTIC
/begin CHARACTERISTIC c_abc_max_dur_igc_mpl "Maximum value of the anti - bounce counter for the ignition system diagnosis multiple open load" VALUE 0xa08008a6 _REC_VAL_20_u1 254. _CNV_A_R_LINEAR_____0_CM 1. 255. DISPLAY_IDENTIFIER C_ABC_MAX_DUR_IGC_MPL FORMAT "%3.0" /end CHARACTERISTIC
/begin MEASUREMENT lv_inh_diag_igc_scp "Inhibition condition for the short circuit plus for ignition diagnosis" UBYTE _CNV_S_2_RANGE__0___1_CM 1 100. 0. 1. DISPLAY_IDENTIFIER LV_INH_DIAG_IGC_SCP ECU_ADDRESS 0xd00073a4 BIT_MASK 0x1 /end MEASUREMENT
/begin MEASUREMENT lv_inh_diag_igc_scg "Inhibition condition for the short circuit to ground for ignition diagnosis" UBYTE _CNV_S_2_RANGE__0___1_CM 1 100. 0. 1. DISPLAY_IDENTIFIER LV_INH_DIAG_IGC_SCG ECU_ADDRESS 0xd00073a3 BIT_MASK 0x1 /end MEASUREMENT
/begin MEASUREMENT lv_inh_diag_igc_ol "Inhibition condition for open load for ignition diagnosis" UBYTE _CNV_S_2_RANGE__0___1_CM 1 100. 0. 1. DISPLAY_IDENTIFIER LV_INH_DIAG_IGC_OL ECU_ADDRESS 0xd00073a2 BIT_MASK 0x1 /end MEASUREMENT
/begin MEASUREMENT lv_inh_diag_dur_igc_mpl "Inhibition condition for diagnosis of open load on all cylinders" UBYTE _CNV_S_2_RANGE__0___1_CM 1 100. 0. 1. DISPLAY_IDENTIFIER LV_INH_DIAG_DUR_IGC_MPL ECU_ADDRESS 0xd00073a1 BIT_MASK 0x1 /end MEASUREMENT
/begin MEASUREMENT lv_td_ad_acq_vld "flag indicating validity of current measurement" UBYTE _CNV_S_2_RANGE__0___1_CM 1 100. 0. 1. DISPLAY_IDENTIFIER LV_TD_AD_ACQ_VLD ECU_ADDRESS 0xd0003250 BIT_MASK 0x1 /end MEASUREMENT
/begin MEASUREMENT lv_td_ad_swi "flag indicating validity of current measurement" UBYTE _CNV_S_2_RANGE__0___1_CM 1 100. 0. 1. DISPLAY_IDENTIFIER LV_TD_AD_SWI ECU_ADDRESS 0xd0003251 BIT_MASK 0x1 /end MEASUREMENT
/begin MEASUREMENT ctr_td_ad_swi "flag indicating validity of current measurement" UBYTE _CNV_A_R_LINEAR_____0_CM 1 100. 0. 255. DISPLAY_IDENTIFIER CTR_TD_AD_SWI ECU_ADDRESS 0xd0003238 FORMAT "%3.0" /end MEASUREMENT
/begin CHARACTERISTIC c_tco_td_ad_swi "TCO threshold to enable switch from channel NC_TD_AD_CHN_ST " VALUE 0xa08008c9 _REC_VAL_20_u1 190.5 _CNV_A_R_LINEAR_____17_CM -48. 142.5 DISPLAY_IDENTIFIER C_TCO_TD_AD_SWI FORMAT "%6.2" /end CHARACTERISTIC
/begin AXIS_PTS ldpm_maf_hb_1_egtr "" 0xa08018c4 maf_hb _REC_AXS_20_u1 1389. _CNV_A_R_LINEAR_____15_CM 8 0. 1389. FORMAT "%4.0" /end AXIS_PTS
/begin AXIS_PTS ldpm_eff_cat_diag_1_egtr "" 0xa08018ba online_dummy _REC_AXS_20_u1 1.9921875 _CNV_A_R_LINEAR_____103_CM 6 0. 1.9921875 FORMAT "%8.6" /end AXIS_PTS
/begin AXIS_PTS ldpm_n_32_1_egtr "" 0xa08018d0 n_32 _REC_AXS_20_u1 8160. _CNV_A_R_LINEAR_____10_CM 8 0. 8160. FORMAT "%4.0" /end AXIS_PTS
/begin AXIS_PTS ldpm_n_32_3_egtr "" 0xa08018da n_32 _REC_AXS_20_u1 8160. _CNV_A_R_LINEAR_____10_CM 6 0. 8160. FORMAT "%4.0" /end AXIS_PTS
/begin CHARACTERISTIC c_vls_down_thd_cat_purge "Downstream voltage signal threshold for end of pre cat purge detection" VALUE 0xa0801b28 _REC_VAL_20_u2 4.9951171875 _CNV_A_R_LINEAR_____2_CM 0. 4.9951171875 DISPLAY_IDENTIFIER C_VLS_DOWN_THD_CAT_PURGE FORMAT "%5.3" /end CHARACTERISTIC
/begin AXIS_PTS ldp_temp_main_cat_purge_ip_fac "" 0xa0801868 egtr[0].egtr_struct_defspcenri0.temp_main_cat_purge _REC_AXS_20_u2 2047.94 _CNV_A_R_EGTR_LINEA_811_CM 6 -273.15 1774.79 FORMAT "%9.4" /end AXIS_PTS
/begin AXIS_PTS ldp_maf_cyl_ip_lamb_sp "" 0xa0801778 maf_cyl _REC_AXS_20_u2 2047.96875 _CNV_A_R_LINEAR_____215_CM 6 0. 2047.96875 FORMAT "%10.5" /end AXIS_PTS
/begin AXIS_PTS ldp_ratio_o2l_rls_ip_lamb_sp "" 0xa0801808 egtr[0].egtr_struct_defspcenr0.ratio_o2l_rls_cat_purge _REC_AXS_20_u1 0.99609375 _CNV_A_R_LINEAR_____28_CM 8 0. 0.99609375 FORMAT "%5.3" /end AXIS_PTS
/begin CHARACTERISTIC ip_fac_main_cat_purge "Weighting factor considering volume ratio (pre / main cat) and cat temperature (for main cat purge)" MAP 0xa0801928 _REC_MAP_20_u1_u2_u1 1.9921875 _CNV_A_R_LINEAR_____103_CM 0. 1.9921875 DISPLAY_IDENTIFIER IP_FAC_MAIN_CAT_PURGE FORMAT "%8.6"
 /begin AXIS_DESCR COM_AXIS egtr[0].egtr_struct_defspcenri0.temp_main_cat_purge _CNV_A_R_EGTR_LINEA_811_CM 6 -273.15 1774.79 FORMAT "%9.4" AXIS_PTS_REF ldp_temp_main_cat_purge_ip_fac /end AXIS_DESCR
 /begin AXIS_DESCR COM_AXIS online_dummy _CNV_A_R_LINEAR_____103_CM 6 0. 1.9921875 FORMAT "%8.6" AXIS_PTS_REF ldpm_eff_cat_diag_1_egtr /end AXIS_DESCR
/end CHARACTERISTIC
/begin CHARACTERISTIC ip_lamb_sp_delta_cat_purge "Lambda set point shift of catalyst purge function" MAP 0xa080daf0 _REC_MAP_20_u2_u2_u1 0.24992 _CNV_A_R_LINEAR_____24_CM 0. 0.24992 DISPLAY_IDENTIFIER IP_LAMB_SP_DELTA_CAT_PURGE FORMAT "%7.5"
 /begin AXIS_DESCR COM_AXIS maf_cyl _CNV_A_R_LINEAR_____215_CM 6 0. 2047.96875 FORMAT "%10.5" AXIS_PTS_REF ldp_maf_cyl_ip_lamb_sp /end AXIS_DESCR
 /begin AXIS_DESCR COM_AXIS egtr[0].egtr_struct_defspcenr0.ratio_o2l_rls_cat_purge _CNV_A_R_LINEAR_____28_CM 8 0. 0.99609375 FORMAT "%5.3" AXIS_PTS_REF ldp_ratio_o2l_rls_ip_lamb_sp /end AXIS_DESCR
/end CHARACTERISTIC
/begin CHARACTERISTIC c_fac_add_main_cat_purge_hst "Additional weighting factor to define oxygen loading for main cat purge after hot start" VALUE 0xa0801a8f _REC_VAL_20_u1 1.9921875 _CNV_A_R_LINEAR_____103_CM 0. 1.9921875 DISPLAY_IDENTIFIER C_FAC_ADD_MAIN_CAT_PURGE_HST FORMAT "%8.6" /end CHARACTERISTIC
/begin CHARACTERISTIC c_fac_add_main_cat_purge_sa "Additional weighting factor to define oxygen loading for main cat purge after secondary air injection" VALUE 0xa0801a90 _REC_VAL_20_u1 1.9921875 _CNV_A_R_LINEAR_____103_CM 0. 1.9921875 DISPLAY_IDENTIFIER C_FAC_ADD_MAIN_CAT_PURGE_SA FORMAT "%8.6" /end CHARACTERISTIC
/begin CHARACTERISTIC c_maf_int_puc_act_min_cat_purge "Minimum air mass flow integral during PUC to activate cat purge function" VALUE 0xa0801adc _REC_VAL_20_u2 2912.666666666671 _CNV_A_R_LINEAR_____314_CM 0. 2912.66666666667 DISPLAY_IDENTIFIER C_MAF_INT_PUC_ACT_MIN_CAT_PURGE FORMAT "%7.2" /end CHARACTERISTIC
/begin CHARACTERISTIC c_o2l_rls_max_pcat_purge "Upper limit of oxygen loading set point for pre cat purge" VALUE 0xa0801aee _REC_VAL_20_u2 2.616848958333331 _CNV_A_R_LINEAR_____812_CM 0. 2.61684895833333 DISPLAY_IDENTIFIER C_O2L_RLS_MAX_PCAT_PURGE FORMAT "%7.5" /end CHARACTERISTIC
/begin CHARACTERISTIC c_o2l_rls_sp_pcat_purge_ch "Oxygen loading to be purged after catalyst heating lean phase" VALUE 0xa0801af0 _REC_VAL_20_u2 2.616848958333331 _CNV_A_R_LINEAR_____812_CM 0. 2.61684895833333 DISPLAY_IDENTIFIER C_O2L_RLS_SP_PCAT_PURGE_CH FORMAT "%7.5" /end CHARACTERISTIC
/begin CHARACTERISTIC c_o2l_rls_sp_pcat_purge_hst "Oxygen loading to be purged after hot start" VALUE 0xa0801af2 _REC_VAL_20_u2 2.616848958333331 _CNV_A_R_LINEAR_____812_CM 0. 2.61684895833333 DISPLAY_IDENTIFIER C_O2L_RLS_SP_PCAT_PURGE_HST FORMAT "%7.5" /end CHARACTERISTIC
/begin CHARACTERISTIC c_o2l_rls_sp_pcat_purge_sa "Oxygen loading to be purged after secondary air injection" VALUE 0xa0801af4 _REC_VAL_20_u2 2.616848958333331 _CNV_A_R_LINEAR_____812_CM 0. 2.61684895833333 DISPLAY_IDENTIFIER C_O2L_RLS_SP_PCAT_PURGE_SA FORMAT "%7.5" /end CHARACTERISTIC
/begin CHARACTERISTIC c_tco_thd_cat_purge_hst "Temperature threshold for hot start detection of cat purge function" VALUE 0xa0801b12 _REC_VAL_20_u1 190.5 _CNV_A_R_LINEAR_____17_CM -48. 142.5 DISPLAY_IDENTIFIER C_TCO_THD_CAT_PURGE_HST FORMAT "%6.2" /end CHARACTERISTIC
/begin AXIS_PTS ldp_maf_int_puc_act_ip_o2l_rls "" 0xa0801788 online_dummy _REC_AXS_20_u2 2912.666666666671 _CNV_A_R_LINEAR_____314_CM 6 0. 2912.66666666667 FORMAT "%7.2" /end AXIS_PTS
/begin AXIS_PTS ldp_temp_cat_ip_fac_pcat_purge "" 0xa0801844 online_dummy _REC_AXS_20_u2 2047.9375 _CNV_A_R_LINEAR_____214_CM 6 -273.15 1774.7875 FORMAT "%9.4" /end AXIS_PTS
/begin CHARACTERISTIC ip_o2l_rls_sp_pcat_purge_puc "Oxygen loading to be purged after pull cut off phase" CURVE 0xa0801a68 _REC_CUR_20_u2_u2 2.616848958333331 _CNV_A_R_LINEAR_____812_CM 0. 2.61684895833333 DISPLAY_IDENTIFIER IP_O2L_RLS_SP_PCAT_PURGE_PUC FORMAT "%7.5"
 /begin AXIS_DESCR COM_AXIS online_dummy _CNV_A_R_LINEAR_____314_CM 6 0. 2912.66666666667 FORMAT "%7.2" AXIS_PTS_REF ldp_maf_int_puc_act_ip_o2l_rls /end AXIS_DESCR
/end CHARACTERISTIC
/begin CHARACTERISTIC ip_fac_o2l_rls_sp_pcat_purge "Weighting factor for oxygen loading to be released during pre cat purge" MAP 0xa0801954 _REC_MAP_20_u1_u2_u1 0.99609375 _CNV_A_R_LINEAR_____28_CM 0. 0.99609375 DISPLAY_IDENTIFIER IP_FAC_O2L_RLS_SP_PCAT_PURGE FORMAT "%5.3"
 /begin AXIS_DESCR COM_AXIS online_dummy _CNV_A_R_LINEAR_____214_CM 6 -273.15 1774.7875 FORMAT "%9.4" AXIS_PTS_REF ldp_temp_cat_ip_fac_pcat_purge /end AXIS_DESCR
 /begin AXIS_DESCR COM_AXIS online_dummy _CNV_A_R_LINEAR_____103_CM 6 0. 1.9921875 FORMAT "%8.6" AXIS_PTS_REF ldpm_eff_cat_diag_1_egtr /end AXIS_DESCR
/end CHARACTERISTIC
/begin CHARACTERISTIC c_fac_add_main_cat_purge_gs_scc "Additional weighting factor for pre and main cat differences in case of gear shift with cylinder cut off" VALUE 0xa0801a8e _REC_VAL_20_u1 1.9921875 _CNV_A_R_LINEAR_____103_CM 0. 1.9921875 DISPLAY_IDENTIFIER C_FAC_ADD_MAIN_CAT_PURGE_GS_SCC FORMAT "%8.6" /end CHARACTERISTIC
/begin CHARACTERISTIC c_maf_int_gs_scc_min_cat_purge "Minimum air mass flow integral during cylinder cut-off at gear-shift to activate cat purge function" VALUE 0xa0801ad6 _REC_VAL_20_u2 2912.666666666671 _CNV_A_R_LINEAR_____314_CM 0. 2912.66666666667 DISPLAY_IDENTIFIER C_MAF_INT_GS_SCC_MIN_CAT_PURGE FORMAT "%7.2" /end CHARACTERISTIC
/begin CHARACTERISTIC c_fac_add_main_cat_purge_ch "Additional weighting factor to define oxygen loading for main cat purge after catalyst heating phase" VALUE 0xa0801a8d _REC_VAL_20_u1 1.9921875 _CNV_A_R_LINEAR_____103_CM 0. 1.9921875 DISPLAY_IDENTIFIER C_FAC_ADD_MAIN_CAT_PURGE_CH FORMAT "%8.6" /end CHARACTERISTIC
/begin CHARACTERISTIC c_lamb_sp_ch_thd_cat_purge "Threshold for lambda setpoint out of catalyst heating to activate catalyst purge" VALUE 0xa0801aac _REC_VAL_20_u2 31.9990234 _CNV_A_R_LINEAR_____813_CM 0. 31.9990234 DISPLAY_IDENTIFIER C_LAMB_SP_CH_THD_CAT_PURGE FORMAT "%10.7" /end CHARACTERISTIC
/begin CHARACTERISTIC c_maf_cyl_max_cat_purge "Maximum air mass flow threshold for cat purge activation" VALUE 0xa0801acc _REC_VAL_20_u2 2047.96875 _CNV_A_R_LINEAR_____215_CM 0. 2047.96875 DISPLAY_IDENTIFIER C_MAF_CYL_MAX_CAT_PURGE FORMAT "%10.5" /end CHARACTERISTIC
/begin CHARACTERISTIC c_n_max_cat_purge "Maximum engine speed for cat purge activation" VALUE 0xa0801ae8 _REC_VAL_20_u1 8160. _CNV_A_R_LINEAR_____10_CM 0. 8160. DISPLAY_IDENTIFIER C_N_MAX_CAT_PURGE FORMAT "%4.0" /end CHARACTERISTIC
/begin CHARACTERISTIC c_tco_min_cat_purge "Minimum TCO threshold for cat purge activation" VALUE 0xa0801b11 _REC_VAL_20_u1 190.5 _CNV_A_R_LINEAR_____17_CM -48. 142.5 DISPLAY_IDENTIFIER C_TCO_MIN_CAT_PURGE FORMAT "%6.2" /end CHARACTERISTIC
/begin CHARACTERISTIC c_temp_dif_pcat_main_cat_purge[0] "Temperature difference between pre and main cat" VALUE 0xa0801b18 _REC_VAL_20_u2 2047.9375 _CNV_A_R_LINEAR_____214_CM -273.15 1774.7875 DISPLAY_IDENTIFIER C_TEMP_DIF_PCAT_MAIN_CAT_PURGE[1] FORMAT "%9.4" /end CHARACTERISTIC
/begin CHARACTERISTIC c_temp_dif_pcat_main_cat_purge[1] "Temperature difference between pre and main cat" VALUE 0xa0801b1a _REC_VAL_20_u2 2047.9375 _CNV_A_R_LINEAR_____214_CM -273.15 1774.7875 DISPLAY_IDENTIFIER C_TEMP_DIF_PCAT_MAIN_CAT_PURGE[2] FORMAT "%9.4" /end CHARACTERISTIC
/begin CHARACTERISTIC lc_cat_purge_inh[0] "Calibration flag to force cat purge function to be inhibited" VALUE 0xa0801b34 _REC_VAL_20_u1 1. _CNV_A_R_LINEAR_____0_CM 0. 1. DISPLAY_IDENTIFIER LC_CAT_PURGE_INH[1] FORMAT "%1.0" /end CHARACTERISTIC
/begin CHARACTERISTIC lc_cat_purge_inh[1] "Calibration flag to force cat purge function to be inhibited" VALUE 0xa0801b35 _REC_VAL_20_u1 1. _CNV_A_R_LINEAR_____0_CM 0. 1. DISPLAY_IDENTIFIER LC_CAT_PURGE_INH[2] FORMAT "%1.0" /end CHARACTERISTIC
/begin MEASUREMENT lv_gs_scc "Cylinder cut of during gear shift" UBYTE _CNV_S_2_RANGE__0___1_CM 1 100. 0. 1. DISPLAY_IDENTIFIER LV_GS_SCC ECU_ADDRESS 0xd0007479 BIT_MASK 0x1 /end MEASUREMENT
/begin MEASUREMENT maf_int_puc_act "Air mass flow integral during pull cut off phase" UWORD _CNV_A_R_LINEAR_____314_CM 1 100. 0. 2912.66666666667 DISPLAY_IDENTIFIER MAF_INT_PUC_ACT ECU_ADDRESS 0xd0006608 FORMAT "%7.2" /end MEASUREMENT
/begin MEASUREMENT maf_int_puc_not_act "Air mass flow integral during not pull cut off phase" UWORD _CNV_A_R_LINEAR_____314_CM 1 100. 0. 2912.66666666667 DISPLAY_IDENTIFIER MAF_INT_PUC_NOT_ACT ECU_ADDRESS 0xd000660a FORMAT "%7.2" /end MEASUREMENT
/begin MEASUREMENT maf_int_gs_scc "Air mass flow integral at cylinder cut of during gear shift phase" UWORD _CNV_A_R_LINEAR_____314_CM 1 100. 0. 2912.66666666667 DISPLAY_IDENTIFIER MAF_INT_GS_SCC ECU_ADDRESS 0xd0006606 FORMAT "%7.2" /end MEASUREMENT
/begin CHARACTERISTIC lc_ns_2_deac "Force usage of first NOx sensor for cat purge of both banks" VALUE 0xa0801b43 _REC_VAL_20_u1 1. _CNV_A_R_LINEAR_____0_CM 0. 1. DISPLAY_IDENTIFIER LC_NS_2_DEAC FORMAT "%1.0" /end CHARACTERISTIC
/begin AXIS_PTS ldp_maf_cyl_ip_lamb_add_purge "" 0xa0801768 maf_cyl _REC_AXS_20_u2 2047.96875 _CNV_A_R_LINEAR_____215_CM 6 0. 2047.96875 FORMAT "%10.5" /end AXIS_PTS
/begin AXIS_PTS ldp_vls_nox_sens_ip_lamb_add "" 0xa080188c online_dummy _REC_AXS_20_u2 1400. _CNV_A_R_LINEAR_____219_CM 8 -200. 1200. FORMAT "%4.0" /end AXIS_PTS
/begin CHARACTERISTIC ip_lamb_add_purge "Delta lambda map for cat purge after lean mode" MAP 0xa080d890 _REC_MAP_20_u2_u2_u2 0.24993896484375 _CNV_A_R_LINEAR_____24_CM 0. 0.24993896484375 DISPLAY_IDENTIFIER IP_LAMB_ADD_PURGE FORMAT "%7.5"
 /begin AXIS_DESCR COM_AXIS maf_cyl _CNV_A_R_LINEAR_____215_CM 6 0. 2047.96875 FORMAT "%10.5" AXIS_PTS_REF ldp_maf_cyl_ip_lamb_add_purge /end AXIS_DESCR
 /begin AXIS_DESCR COM_AXIS online_dummy _CNV_A_R_LINEAR_____219_CM 8 -200. 1200. FORMAT "%4.0" AXIS_PTS_REF ldp_vls_nox_sens_ip_lamb_add /end AXIS_DESCR
/end CHARACTERISTIC
/begin MEASUREMENT lv_lamb_pls_syn_cbk "Flag used for exhaust gas bank synchonization" UBYTE _CNV_S_2_RANGE__0___1_CM 1 100. 0. 1. DISPLAY_IDENTIFIER LV_LAMB_PLS_SYN_CBK ECU_ADDRESS 0xd000747a BIT_MASK 0x1 /end MEASUREMENT
/begin CHARACTERISTIC lc_o2l_pls_cbk_syn "0: asynchronous forced stimulation, 1: synchronous forced stimulation" VALUE 0xa0801b46 _REC_VAL_20_u1 1. _CNV_A_R_LINEAR_____0_CM 0. 1. DISPLAY_IDENTIFIER LC_O2L_PLS_CBK_SYN FORMAT "%1.0" /end CHARACTERISTIC
/begin CHARACTERISTIC c_lamb_sp_de_thd_lamb_pls_off "Upper threshold of cat purge deviation for de-activating the forced stimulation" VALUE 0xa0801ab4 _REC_VAL_20_u2 0.24992 _CNV_A_R_LINEAR_____24_CM 0. 0.24992 DISPLAY_IDENTIFIER C_LAMB_SP_DE_THD_LAMB_PLS_OFF FORMAT "%7.5" /end CHARACTERISTIC
/begin CHARACTERISTIC c_lamb_sp_de_thd_lamb_pls_on "Lower threshold of cat purge deviation for activating the forced stimulation" VALUE 0xa0801ab6 _REC_VAL_20_u2 0.24992 _CNV_A_R_LINEAR_____24_CM 0. 0.24992 DISPLAY_IDENTIFIER C_LAMB_SP_DE_THD_LAMB_PLS_ON FORMAT "%7.5" /end CHARACTERISTIC
/begin CHARACTERISTIC c_lamb_sp_max_lamb_pls_act "Maximum lambda set point for forced lambda stimulation activation" VALUE 0xa0801ac0 _REC_VAL_20_u2 1.99993896484375 _CNV_A_R_LINEAR_____24_CM 0. 1.99993896484375 DISPLAY_IDENTIFIER C_LAMB_SP_MAX_LAMB_PLS_ACT FORMAT "%7.5" /end CHARACTERISTIC
/begin CHARACTERISTIC c_lamb_sp_min_lamb_pls_act "Minimum lambda set point for forced lambda stimulation activation" VALUE 0xa0801ac2 _REC_VAL_20_u2 1.99993896484375 _CNV_A_R_LINEAR_____24_CM 0. 1.99993896484375 DISPLAY_IDENTIFIER C_LAMB_SP_MIN_LAMB_PLS_ACT FORMAT "%7.5" /end CHARACTERISTIC
/begin CHARACTERISTIC c_maf_int_min_lamb_pls_act "Threshold for the air mass flow integral for the activation of the forced stimulation" VALUE 0xa0801ada _REC_VAL_20_u2 1456.33 _CNV_A_R_CYBL_LINEA_135_CM 0. 1456.33 DISPLAY_IDENTIFIER C_MAF_INT_MIN_LAMB_PLS_ACT FORMAT "%11.6" /end CHARACTERISTIC
/begin CHARACTERISTIC c_temp_cat_min_lamb_pls_act "Minimum value of the catalyst temperature for the activation of the forced stimulation" VALUE 0xa0801b16 _REC_VAL_20_u2 2047.94 _CNV_A_R_EGTR_LINEA_811_CM -273.15 1774.79 DISPLAY_IDENTIFIER C_TEMP_CAT_MIN_LAMB_PLS_ACT FORMAT "%9.4" /end CHARACTERISTIC
/begin CHARACTERISTIC c_fac_dif_thd_afl_pls_on "Lambda control difference threshold for re-activating lean stimulation half wave" VALUE 0xa0801a94 _REC_VAL_20_s2 1.999969482421875 _CNV_A_R_LINEAR_____259_CM -1. 0.999969482421875 DISPLAY_IDENTIFIER C_FAC_DIF_THD_AFL_PLS_ON FORMAT "%8.5" /end CHARACTERISTIC
/begin CHARACTERISTIC c_fac_dif_thd_afl_pls_off "Lambda control difference threshold for deactivating lean stimulation half wave" VALUE 0xa0801a92 _REC_VAL_20_s2 0.999969482421875 _CNV_A_R_LINEAR_____259_CM 0. 0.999969482421875 DISPLAY_IDENTIFIER C_FAC_DIF_THD_AFL_PLS_OFF FORMAT "%8.5" /end CHARACTERISTIC
/begin CHARACTERISTIC c_fac_dif_thd_afr_pls_off "Lambda control difference threshold for deactivating rich stimulation half wave" VALUE 0xa0801a96 _REC_VAL_20_s2 0.9999900000000002 _CNV_A_R_LINEAR_____259_CM -1. -1.e-005 DISPLAY_IDENTIFIER C_FAC_DIF_THD_AFR_PLS_OFF FORMAT "%8.5" /end CHARACTERISTIC
/begin CHARACTERISTIC c_fac_dif_thd_afr_pls_on "Lambda control difference threshold for re-activating rich stimulation half wave" VALUE 0xa0801a98 _REC_VAL_20_s2 1.999969482421875 _CNV_A_R_LINEAR_____259_CM -1. 0.999969482421875 DISPLAY_IDENTIFIER C_FAC_DIF_THD_AFR_PLS_ON FORMAT "%8.5" /end CHARACTERISTIC
/begin CHARACTERISTIC lc_lamb_pls_cor_act_is "Calibration flag indicating that corrective action for lambda stimulation is allowed in idle speed" VALUE 0xa0801b3c _REC_VAL_20_u1 1. _CNV_A_R_LINEAR_____0_CM 0. 1. DISPLAY_IDENTIFIER LC_LAMB_PLS_COR_ACT_IS FORMAT "%1.0" /end CHARACTERISTIC
/begin CHARACTERISTIC lc_lamb_pls_ext "flag indicating that external LAMP_PLS is used" VALUE 0xa0801b3d _REC_VAL_20_u1 1. _CNV_A_R_LINEAR_____0_CM 0. 1. DISPLAY_IDENTIFIER LC_LAMB_PLS_EXT FORMAT "%1.0" /end CHARACTERISTIC
/begin MEASUREMENT state_lamb_pls_det_value "State variable of forced lambda stimulation parameter determination" UBYTE _CNV_S_7_EGTR_RANGE_814_CM 1 100. 0. 6. DISPLAY_IDENTIFIER STATE_LAMB_PLS_DET_VALUE ECU_ADDRESS 0xd000747d /end MEASUREMENT
/begin MEASUREMENT lamb_sp_de_pls "Amplitude of the forced lambda stimulation" UWORD _CNV_A_R_LINEAR_____24_CM 1 100. 0. 0.1249389 DISPLAY_IDENTIFIER LAMB_SP_DE_PLS ECU_ADDRESS 0xd0006602 FORMAT "%7.5" /end MEASUREMENT
/begin MEASUREMENT lamb_delta_max_pls "Lambda set point deviation step height per sample step" UWORD _CNV_A_R_LINEAR_____24_CM 1 100. 0. 0.24992 DISPLAY_IDENTIFIER LAMB_DELTA_MAX_PLS ECU_ADDRESS 0xd0006600 FORMAT "%7.5" /end MEASUREMENT
/begin MEASUREMENT ctr_step_pls_nom_cat_diag "Step counter to switch between nominal and cat diagnosis forced stimulation" UBYTE _CNV_A_R_LINEAR_____0_CM 1 100. 0. 7. DISPLAY_IDENTIFIER CTR_STEP_PLS_NOM_CAT_DIAG ECU_ADDRESS 0xd000747c FORMAT "%3.0" /end MEASUREMENT
/begin CHARACTERISTIC c_lamb_delta_max_is_pls "Lambda set point deviation step height per sample step for forced stimulation in case of idle speed" VALUE 0xa0801aa4 _REC_VAL_20_u2 0.24992 _CNV_A_R_LINEAR_____24_CM 0. 0.24992 DISPLAY_IDENTIFIER C_LAMB_DELTA_MAX_IS_PLS FORMAT "%7.5" /end CHARACTERISTIC
/begin CHARACTERISTIC c_lamb_delta_max_lsh_diag_pls "Lambda set point deviation step height per sample step for forced stimulation requested by sensor heater " VALUE 0xa0801aa6 _REC_VAL_20_u2 0.24992 _CNV_A_R_LINEAR_____24_CM 0. 0.24992 DISPLAY_IDENTIFIER C_LAMB_DELTA_MAX_LSH_DIAG_PLS FORMAT "%7.5" /end CHARACTERISTIC
/begin CHARACTERISTIC c_lamb_sp_de_dyn_diag_pls "Amplitude of the forced lambda stimulation in case of active WRAF sensor dynamic diagnosis" VALUE 0xa0801aae _REC_VAL_20_u2 0.1249389 _CNV_A_R_LINEAR_____24_CM 0. 0.1249389 DISPLAY_IDENTIFIER C_LAMB_SP_DE_DYN_DIAG_PLS FORMAT "%7.5" /end CHARACTERISTIC
/begin CHARACTERISTIC c_lamb_sp_de_is_pls "Amplitude of forced stimulation in case of idle speed" VALUE 0xa0801ab0 _REC_VAL_20_u2 0.1249389 _CNV_A_R_LINEAR_____24_CM 0. 0.1249389 DISPLAY_IDENTIFIER C_LAMB_SP_DE_IS_PLS FORMAT "%7.5" /end CHARACTERISTIC
/begin CHARACTERISTIC c_lamb_sp_de_lsh_diag_pls "Amplitude of forced stimulation requested by sensor heater diagnosis" VALUE 0xa0801ab2 _REC_VAL_20_u2 0.1249389 _CNV_A_R_LINEAR_____24_CM 0. 0.1249389 DISPLAY_IDENTIFIER C_LAMB_SP_DE_LSH_DIAG_PLS FORMAT "%7.5" /end CHARACTERISTIC
/begin CHARACTERISTIC c_nr_step_pls_nom_cat_diag "Number of lean - rich steps to switch between nominal and cat diagnosis forced stimulation" VALUE 0xa0801ae9 _REC_VAL_20_u1 7. _CNV_A_R_LINEAR_____0_CM 0. 7. DISPLAY_IDENTIFIER C_NR_STEP_PLS_NOM_CAT_DIAG FORMAT "%3.0" /end CHARACTERISTIC
/begin MEASUREMENT o2l_sp_pls "Oxygen loading set point for forced lambda stimulation" UWORD _CNV_A_R_LINEAR_____812_CM 1 100. 0. 2.61684895833333 DISPLAY_IDENTIFIER O2L_SP_PLS ECU_ADDRESS 0xd000660c FORMAT "%7.5" /end MEASUREMENT
/begin CHARACTERISTIC c_o2l_sp_is_pls "Oxygen loading set point for forced lambda stimulation in case of idle speed" VALUE 0xa0801af6 _REC_VAL_20_u2 2.616848958333331 _CNV_A_R_LINEAR_____812_CM 0. 2.61684895833333 DISPLAY_IDENTIFIER C_O2L_SP_IS_PLS FORMAT "%7.5" /end CHARACTERISTIC
/begin CHARACTERISTIC c_o2l_sp_lsh_diag_pls "Oxygen loading set point for forced lambda stimulation requested by sensor heater diagnosis" VALUE 0xa0801af8 _REC_VAL_20_u2 2.616848958333331 _CNV_A_R_LINEAR_____812_CM 0. 2.61684895833333 DISPLAY_IDENTIFIER C_O2L_SP_LSH_DIAG_PLS FORMAT "%7.5" /end CHARACTERISTIC
/begin AXIS_PTS ldp_eff_cat_diag_ip_fac_1_pls "" 0xa0801738 online_dummy _REC_AXS_20_u1 1.9921875 _CNV_A_R_LINEAR_____103_CM 4 0. 1.9921875 FORMAT "%8.6" /end AXIS_PTS
/begin AXIS_PTS ldp_t_ast_ip_fac_2_pls "" 0xa0801814 t_ast _REC_AXS_20_u2 6553.5 _CNV_A_R_LINEAR_____4_CM 4 0. 6553.5 FORMAT "%6.1" /end AXIS_PTS
/begin CHARACTERISTIC ip_fac_2_lamb_sp_de_pls "Second factor for forced stimulation amplitude(depending on time after start and cat temperature)" MAP 0xa0801910 _REC_MAP_20_u1_u2_u2 1.9921875 _CNV_A_R_LINEAR_____103_CM 0. 1.9921875 DISPLAY_IDENTIFIER IP_FAC_2_LAMB_SP_DE_PLS FORMAT "%8.6"
 /begin AXIS_DESCR COM_AXIS t_ast _CNV_A_R_LINEAR_____4_CM 4 0. 6553.5 FORMAT "%6.1" AXIS_PTS_REF ldp_t_ast_ip_fac_2_pls /end AXIS_DESCR
 /begin AXIS_DESCR COM_AXIS online_dummy _CNV_A_R_EGTR_LINEA_811_CM 4 -273.15 1774.79 FORMAT "%9.4" AXIS_PTS_REF ldp_temp_cat_ip_fac_2_pls /end AXIS_DESCR
/end CHARACTERISTIC
/begin AXIS_PTS ldp_temp_cat_ip_fac_2_pls "" 0xa0801838 online_dummy _REC_AXS_20_u2 2047.94 _CNV_A_R_EGTR_LINEA_811_CM 4 -273.15 1774.79 FORMAT "%9.4" /end AXIS_PTS
/begin CHARACTERISTIC ip_fac_1_lamb_sp_de_pls "First factor for forced stimulation amplitude (depending on maximal value of EFF_CAT_DIAG[i])" CURVE 0xa080190c _REC_CUR_20_u1_u1 1.9921875 _CNV_A_R_LINEAR_____103_CM 0. 1.9921875 DISPLAY_IDENTIFIER IP_FAC_1_LAMB_SP_DE_PLS FORMAT "%8.6"
 /begin AXIS_DESCR COM_AXIS online_dummy _CNV_A_R_LINEAR_____103_CM 4 0. 1.9921875 FORMAT "%8.6" AXIS_PTS_REF ldp_eff_cat_diag_ip_fac_1_pls /end AXIS_DESCR
/end CHARACTERISTIC
/begin CHARACTERISTIC ip_lamb_delta_max_cat_diag_pls "Lambda set point deviation step height per sample step for forced stimulation in case of active catalyst diagnosis" MAP 0xa080d8f0 _REC_MAP_20_u2_u1_u1 0.24992 _CNV_A_R_LINEAR_____24_CM 0. 0.24992 DISPLAY_IDENTIFIER IP_LAMB_DELTA_MAX_CAT_DIAG_PLS FORMAT "%7.5"
 /begin AXIS_DESCR COM_AXIS n_32 _CNV_A_R_LINEAR_____10_CM 8 0. 8160. FORMAT "%4.0" AXIS_PTS_REF ldpm_n_32_1_egtr /end AXIS_DESCR
 /begin AXIS_DESCR COM_AXIS maf_hb _CNV_A_R_LINEAR_____15_CM 8 0. 1389. FORMAT "%4.0" AXIS_PTS_REF ldpm_maf_hb_1_egtr /end AXIS_DESCR
/end CHARACTERISTIC
/begin CHARACTERISTIC ip_lamb_delta_max_nom_pls "Lambda set point deviation step height per sample step for nominal forced stimulation" MAP 0xa080d970 _REC_MAP_20_u2_u1_u1 0.24992 _CNV_A_R_LINEAR_____24_CM 0. 0.24992 DISPLAY_IDENTIFIER IP_LAMB_DELTA_MAX_NOM_PLS FORMAT "%7.5"
 /begin AXIS_DESCR COM_AXIS n_32 _CNV_A_R_LINEAR_____10_CM 8 0. 8160. FORMAT "%4.0" AXIS_PTS_REF ldpm_n_32_1_egtr /end AXIS_DESCR
 /begin AXIS_DESCR COM_AXIS maf_hb _CNV_A_R_LINEAR_____15_CM 8 0. 1389. FORMAT "%4.0" AXIS_PTS_REF ldpm_maf_hb_1_egtr /end AXIS_DESCR
/end CHARACTERISTIC
/begin CHARACTERISTIC ip_lamb_sp_de_cat_diag_pls "Amplitude of forced stimulation in case of active catalyst diagnosis" MAP 0xa080d9f0 _REC_MAP_20_u2_u1_u1 0.1249389 _CNV_A_R_LINEAR_____24_CM 0. 0.1249389 DISPLAY_IDENTIFIER IP_LAMB_SP_DE_CAT_DIAG_PLS FORMAT "%7.5"
 /begin AXIS_DESCR COM_AXIS n_32 _CNV_A_R_LINEAR_____10_CM 8 0. 8160. FORMAT "%4.0" AXIS_PTS_REF ldpm_n_32_1_egtr /end AXIS_DESCR
 /begin AXIS_DESCR COM_AXIS maf_hb _CNV_A_R_LINEAR_____15_CM 8 0. 1389. FORMAT "%4.0" AXIS_PTS_REF ldpm_maf_hb_1_egtr /end AXIS_DESCR
/end CHARACTERISTIC
/begin CHARACTERISTIC ip_lamb_sp_de_nom_pls "Amplitude of nominal forced stimulation" MAP 0xa080da70 _REC_MAP_20_u2_u1_u1 0.1249389 _CNV_A_R_LINEAR_____24_CM 0. 0.1249389 DISPLAY_IDENTIFIER IP_LAMB_SP_DE_NOM_PLS FORMAT "%7.5"
 /begin AXIS_DESCR COM_AXIS n_32 _CNV_A_R_LINEAR_____10_CM 8 0. 8160. FORMAT "%4.0" AXIS_PTS_REF ldpm_n_32_1_egtr /end AXIS_DESCR
 /begin AXIS_DESCR COM_AXIS maf_hb _CNV_A_R_LINEAR_____15_CM 8 0. 1389. FORMAT "%4.0" AXIS_PTS_REF ldpm_maf_hb_1_egtr /end AXIS_DESCR
/end CHARACTERISTIC
/begin CHARACTERISTIC ip_o2l_sp_cat_diag_pls "Oxygen loading set point for forced lambda stimulation in case of active catalyst diagnosis" MAP 0xa080dbd0 _REC_MAP_20_u2_u1_u1 2.616848958333331 _CNV_A_R_LINEAR_____812_CM 0. 2.61684895833333 DISPLAY_IDENTIFIER IP_O2L_SP_CAT_DIAG_PLS FORMAT "%7.5"
 /begin AXIS_DESCR COM_AXIS n_32 _CNV_A_R_LINEAR_____10_CM 8 0. 8160. FORMAT "%4.0" AXIS_PTS_REF ldpm_n_32_1_egtr /end AXIS_DESCR
 /begin AXIS_DESCR COM_AXIS maf_hb _CNV_A_R_LINEAR_____15_CM 8 0. 1389. FORMAT "%4.0" AXIS_PTS_REF ldpm_maf_hb_1_egtr /end AXIS_DESCR
/end CHARACTERISTIC
/begin CHARACTERISTIC ip_o2l_sp_dyn_diag_pls "Oxygen loading set point for forced lambda stimulation in case of active dynamic WRAF sensor diagnosis" MAP 0xa080dc50 _REC_MAP_20_u2_u1_u1 2.616848958333331 _CNV_A_R_LINEAR_____812_CM 0. 2.61684895833333 DISPLAY_IDENTIFIER IP_O2L_SP_DYN_DIAG_PLS FORMAT "%7.5"
 /begin AXIS_DESCR COM_AXIS n_32 _CNV_A_R_LINEAR_____10_CM 8 0. 8160. FORMAT "%4.0" AXIS_PTS_REF ldpm_n_32_1_egtr /end AXIS_DESCR
 /begin AXIS_DESCR COM_AXIS maf_hb _CNV_A_R_LINEAR_____15_CM 8 0. 1389. FORMAT "%4.0" AXIS_PTS_REF ldpm_maf_hb_1_egtr /end AXIS_DESCR
/end CHARACTERISTIC
/begin CHARACTERISTIC ip_o2l_sp_nom_pls "Oxygen loading set point for nominal forced lambda stimulation" MAP 0xa080dcd0 _REC_MAP_20_u2_u1_u1 2.616848958333331 _CNV_A_R_LINEAR_____812_CM 0. 2.61684895833333 DISPLAY_IDENTIFIER IP_O2L_SP_NOM_PLS FORMAT "%7.5"
 /begin AXIS_DESCR COM_AXIS n_32 _CNV_A_R_LINEAR_____10_CM 8 0. 8160. FORMAT "%4.0" AXIS_PTS_REF ldpm_n_32_1_egtr /end AXIS_DESCR
 /begin AXIS_DESCR COM_AXIS maf_hb _CNV_A_R_LINEAR_____15_CM 8 0. 1389. FORMAT "%4.0" AXIS_PTS_REF ldpm_maf_hb_1_egtr /end AXIS_DESCR
/end CHARACTERISTIC
/begin CHARACTERISTIC lc_lamb_sti_off_lsl_ofs_adj "Calibration flag to allow inhibition of lambda stimulation during offset adjustment" VALUE 0xa0801b40 _REC_VAL_20_u1 1. _CNV_A_R_LINEAR_____0_CM 0. 1. DISPLAY_IDENTIFIER LC_LAMB_STI_OFF_LSL_OFS_ADJ FORMAT "%1.0" /end CHARACTERISTIC
/begin CHARACTERISTIC lc_lamb_pls_inh[0] "Calibration flag to force lambda stimulation to be inhibited" VALUE 0xa0801b3e _REC_VAL_20_u1 1. _CNV_A_R_LINEAR_____0_CM 0. 1. DISPLAY_IDENTIFIER LC_LAMB_PLS_INH[1] FORMAT "%1.0" /end CHARACTERISTIC
/begin CHARACTERISTIC lc_lamb_pls_inh[1] "Calibration flag to force lambda stimulation to be inhibited" VALUE 0xa0801b3f _REC_VAL_20_u1 1. _CNV_A_R_LINEAR_____0_CM 0. 1. DISPLAY_IDENTIFIER LC_LAMB_PLS_INH[2] FORMAT "%1.0" /end CHARACTERISTIC
/begin MEASUREMENT lv_diag_afl_req "" UBYTE _CNV_S_2_RANGE__0___1_CM 1 100. 0. 1. DISPLAY_IDENTIFIER LV_DIAG_AFL_REQ ECU_ADDRESS 0xd0007478 /end MEASUREMENT
/begin CHARACTERISTIC c_lamb_sp_diag_afl_diag "Lambda setpoint for lean part of the lean precatalyst diagnosis" VALUE 0xa0801ab8 _REC_VAL_20_u2 31.9990234375 _CNV_A_R_LINEAR_____129_CM 0. 31.9990234375 DISPLAY_IDENTIFIER C_LAMB_SP_DIAG_AFL_DIAG FORMAT "%7.4" /end CHARACTERISTIC
/begin CHARACTERISTIC c_lamb_sp_diag_afl_pas "Lambda setpoint for passive part of the lean precatalyst diagnosis" VALUE 0xa0801aba _REC_VAL_20_u2 31.9990234375 _CNV_A_R_LINEAR_____129_CM 0. 31.9990234375 DISPLAY_IDENTIFIER C_LAMB_SP_DIAG_AFL_PAS FORMAT "%7.4" /end CHARACTERISTIC
/begin CHARACTERISTIC c_lamb_sp_diag_park_shift "Lambda shift from basis lambda at park phase of the precatalyst lean diagnosis" VALUE 0xa0801abe _REC_VAL_20_u2 31.9990234375 _CNV_A_R_LINEAR_____129_CM 0. 31.9990234375 DISPLAY_IDENTIFIER C_LAMB_SP_DIAG_PARK_SHIFT FORMAT "%7.4" /end CHARACTERISTIC
/begin CHARACTERISTIC c_state_rgn_ini_diag_afl[0] "Initialization for the lambda setpoint for the precatalyst lean diagnosis at active state" VALUE 0xa0801b08 _REC_VAL_20_u1 3. _CNV_A_R_LINEAR_____0_CM 0. 3. DISPLAY_IDENTIFIER C_STATE_RGN_INI_DIAG_AFL[0] FORMAT "%3.0" /end CHARACTERISTIC
/begin CHARACTERISTIC c_state_rgn_ini_diag_afl[1] "Initialization for the lambda setpoint for the precatalyst lean diagnosis at active state" VALUE 0xa0801b09 _REC_VAL_20_u1 3. _CNV_A_R_LINEAR_____0_CM 0. 3. DISPLAY_IDENTIFIER C_STATE_RGN_INI_DIAG_AFL[1] FORMAT "%3.0" /end CHARACTERISTIC
/begin CHARACTERISTIC lc_state_rgn_diag_afl "Switch between regeneration states for calculation of O2L values" VALUE 0xa0801b47 _REC_VAL_20_u1 1. _CNV_A_R_LINEAR_____0_CM 0. 1. DISPLAY_IDENTIFIER LC_STATE_RGN_DIAG_AFL FORMAT "%1.0" /end CHARACTERISTIC
/begin AXIS_PTS ldp_n_32_ip_lamb_sp_diag_park_i "" 0xa08017b6 n_32 _REC_AXS_20_u1 8160. _CNV_A_R_LINEAR_____10_CM 4 0. 8160. FORMAT "%4.0" /end AXIS_PTS
/begin AXIS_PTS ldp_maf_ip_lamb_sp_diag_park_i "" 0xa0801798 maf _REC_AXS_20_u2 1389. _CNV_A_R_LINEAR_____111_CM 8 0. 1389. FORMAT "%7.2" /end AXIS_PTS
/begin CHARACTERISTIC ip_lamb_sp_diag_park_i "Integration step for lambda setpoint for lean precatalyst diagnosis at park state" MAP 0xa0801a10 _REC_MAP_20_u2_u1_u2 31.9990234375 _CNV_A_R_LINEAR_____129_CM 0. 31.9990234375 DISPLAY_IDENTIFIER IP_LAMB_SP_DIAG_PARK_I FORMAT "%7.4"
 /begin AXIS_DESCR COM_AXIS n_32 _CNV_A_R_LINEAR_____10_CM 4 0. 8160. FORMAT "%4.0" AXIS_PTS_REF ldp_n_32_ip_lamb_sp_diag_park_i /end AXIS_DESCR
 /begin AXIS_DESCR COM_AXIS maf _CNV_A_R_LINEAR_____111_CM 8 0. 1389. FORMAT "%7.2" AXIS_PTS_REF ldp_maf_ip_lamb_sp_diag_park_i /end AXIS_DESCR
/end CHARACTERISTIC
/begin CHARACTERISTIC c_state_rgn_ini_diag_afl_pas "Initialization for the lambda setpoint for the precatalyst lean diagnosis at passive state" VALUE 0xa0801b0a _REC_VAL_20_u1 3. _CNV_A_R_LINEAR_____0_CM 0. 3. DISPLAY_IDENTIFIER C_STATE_RGN_INI_DIAG_AFL_PAS FORMAT "%3.0" /end CHARACTERISTIC
/begin CHARACTERISTIC c_lamb_sp_diag_park_bas "Basis lambda setpoint of the lean precatalyst diagnosis at park phase" VALUE 0xa0801abc _REC_VAL_20_u2 31.9990234375 _CNV_A_R_LINEAR_____129_CM 0. 31.9990234375 DISPLAY_IDENTIFIER C_LAMB_SP_DIAG_PARK_BAS FORMAT "%7.4" /end CHARACTERISTIC
/begin CHARACTERISTIC c_ctr_min_cat_diag "min. number of required monitoring cycles for catalyst diagnosis" VALUE 0xa0801a84 _REC_VAL_20_u2 511. _CNV_A_R_LINEAR_____0_CM 0. 511. DISPLAY_IDENTIFIER C_CTR_MIN_CAT_DIAG FORMAT "%5.0" /end CHARACTERISTIC
/begin CHARACTERISTIC c_ctr_min_cat_diag_eol "min. threshold of required monitoring cycles for catalyst diagnosis at eol test" VALUE 0xa0801a86 _REC_VAL_20_u2 511. _CNV_A_R_LINEAR_____0_CM 0. 511. DISPLAY_IDENTIFIER C_CTR_MIN_CAT_DIAG_EOL FORMAT "%5.0" /end CHARACTERISTIC
/begin CHARACTERISTIC c_ctr_lamb_out_cat_diag "threshold to switch off cat diag due to to lamb_cat_down_mv is not in the right range" VALUE 0xa0801a82 _REC_VAL_20_u1 255. _CNV_A_R_LINEAR_____0_CM 0. 255. DISPLAY_IDENTIFIER C_CTR_LAMB_OUT_CAT_DIAG FORMAT "%3.0" /end CHARACTERISTIC
/begin CHARACTERISTIC c_lamb_cat_mv_dif_max "max. allowed lamb_cat_down_mv[i] fluctuation between 2 subsequent monitoring cycles" VALUE 0xa0801aa2 _REC_VAL_20_u2 1.99996948242188 _CNV_A_R_LINEAR_____9_CM 0. 1.99996948242188 DISPLAY_IDENTIFIER C_LAMB_CAT_MV_DIF_MAX FORMAT "%7.5" /end CHARACTERISTIC
/begin CHARACTERISTIC c_lamb_cat_mv_delta_max "max. allowed fluctuation between lamb_cat_down[i] and lamb_cat_down_mv[i] fin the same monitoring cycle" VALUE 0xa0801aa0 _REC_VAL_20_u2 1.99996948242188 _CNV_A_R_LINEAR_____9_CM 0. 1.99996948242188 DISPLAY_IDENTIFIER C_LAMB_CAT_MV_DELTA_MAX FORMAT "%7.5" /end CHARACTERISTIC
/begin CHARACTERISTIC c_n_32_cat_diag_deac "engine speed threshold to deactivate catalyst diagnosis to save ecu performance" VALUE 0xa0801ae2 _REC_VAL_20_u1 8160. _CNV_A_R_LINEAR_____10_CM 0. 8160. DISPLAY_IDENTIFIER C_N_32_CAT_DIAG_DEAC FORMAT "%4.0" /end CHARACTERISTIC
/begin CHARACTERISTIC ip_fac_mass_o2_cat_diag_at "weight factor of downstream sensor signal integral for automatic transmission" MAP 0xa080d710 _REC_MAP_20_u2_u1_u1 1.99996948242188 _CNV_A_R_LINEAR_____9_CM 0. 1.99996948242188 DISPLAY_IDENTIFIER IP_FAC_MASS_O2_CAT_DIAG_AT FORMAT "%7.5"
 /begin AXIS_DESCR COM_AXIS n_32 _CNV_A_R_LINEAR_____10_CM 8 0. 8160. FORMAT "%4.0" AXIS_PTS_REF ldpm_n_32_1_egtr /end AXIS_DESCR
 /begin AXIS_DESCR COM_AXIS maf_hb _CNV_A_R_LINEAR_____15_CM 8 0. 1389. FORMAT "%4.0" AXIS_PTS_REF ldpm_maf_hb_1_egtr /end AXIS_DESCR
/end CHARACTERISTIC
/begin CHARACTERISTIC ip_fac_mass_o2_cat_diag_mt "weight factor of downstream sensor signal integral for manual transmission" MAP 0xa080d790 _REC_MAP_20_u2_u1_u1 1.99996948242188 _CNV_A_R_LINEAR_____9_CM 0. 1.99996948242188 DISPLAY_IDENTIFIER IP_FAC_MASS_O2_CAT_DIAG_MT FORMAT "%7.5"
 /begin AXIS_DESCR COM_AXIS n_32 _CNV_A_R_LINEAR_____10_CM 8 0. 8160. FORMAT "%4.0" AXIS_PTS_REF ldpm_n_32_1_egtr /end AXIS_DESCR
 /begin AXIS_DESCR COM_AXIS maf_hb _CNV_A_R_LINEAR_____15_CM 8 0. 1389. FORMAT "%4.0" AXIS_PTS_REF ldpm_maf_hb_1_egtr /end AXIS_DESCR
/end CHARACTERISTIC
/begin AXIS_PTS ldp_temp_cat_dyn_mdl_ip_fac_cat "" 0xa080182c online_dummy _REC_AXS_20_u1 2040. _CNV_A_R_EGTR_LINEA_815_CM 8 -273.15 1766.85 FORMAT "%9.4" /end AXIS_PTS
/begin AXIS_PTS ldp_temp_cat_dif_ip_fac_cat "" 0xa0801820 egtr[0].egtr_struct_fctdgcef0.temp_cat_dif_dyn_stat _REC_AXS_20_u1 254. _CNV_A_R_LINEAR_____522_CM 8 0. 254. FORMAT "%3.0" /end AXIS_PTS
/begin CHARACTERISTIC ip_lamb_cat "lambda linearization from downstream ls signal" CURVE 0xa08019f8 _REC_CUR_20_u2_u2 1.99996948242188 _CNV_A_R_LINEAR_____9_CM 0. 1.99996948242188 DISPLAY_IDENTIFIER IP_LAMB_CAT FORMAT "%7.5"
 /begin AXIS_DESCR COM_AXIS online_dummy _CNV_A_R_LINEAR_____2_CM 12 0. 4.9951171875 FORMAT "%5.3" AXIS_PTS_REF ldp_vls_temp_ip_lamb_cat /end AXIS_DESCR
/end CHARACTERISTIC
/begin CHARACTERISTIC ip_fac_temp_cat_dif_stat "Factor to correct cat. diag value at catalyst temperature different to stationary temperature in this working point" MAP 0xa080d810 _REC_MAP_20_u2_u1_u1 4.9951171875 _CNV_A_R_LINEAR_____816_CM 0. 4.9951171875 DISPLAY_IDENTIFIER IP_FAC_TEMP_CAT_DIF_STAT FORMAT "%8.6"
 /begin AXIS_DESCR COM_AXIS online_dummy _CNV_A_R_EGTR_LINEA_815_CM 8 -273.15 1766.85 FORMAT "%9.4" AXIS_PTS_REF ldp_temp_cat_dyn_mdl_ip_fac_cat /end AXIS_DESCR
 /begin AXIS_DESCR COM_AXIS egtr[0].egtr_struct_fctdgcef0.temp_cat_dif_dyn_stat _CNV_A_R_LINEAR_____522_CM 8 0. 254. FORMAT "%3.0" AXIS_PTS_REF ldp_temp_cat_dif_ip_fac_cat /end AXIS_DESCR
/end CHARACTERISTIC
/begin CHARACTERISTIC c_o2l_cat_afl "Adjust parameter for ratio_mas_o2l_cat_dif calculation" VALUE 0xa0801aea _REC_VAL_20_u2 2.616848958333331 _CNV_A_R_LINEAR_____812_CM 0. 2.61684895833333 DISPLAY_IDENTIFIER C_O2L_CAT_AFL FORMAT "%7.5" /end CHARACTERISTIC
/begin CHARACTERISTIC c_lamb_cat_delta_max "max. deviation between LAMB_CAT_MV and setpoint for a valid monitoring cycle" VALUE 0xa0801a9c _REC_VAL_20_u2 1.99996948242188 _CNV_A_R_LINEAR_____9_CM 0. 1.99996948242188 DISPLAY_IDENTIFIER C_LAMB_CAT_DELTA_MAX FORMAT "%7.5" /end CHARACTERISTIC
/begin CHARACTERISTIC c_lamb_cat_delta_max_eol "max. deviation between LAMB_CAT_MV and setpoint for a valid monitoring cycle at end of line test" VALUE 0xa0801a9e _REC_VAL_20_u2 1.99996948242188 _CNV_A_R_LINEAR_____9_CM 0. 1.99996948242188 DISPLAY_IDENTIFIER C_LAMB_CAT_DELTA_MAX_EOL FORMAT "%7.5" /end CHARACTERISTIC
/begin CHARACTERISTIC c_temp_cat_dif_dyn_max "Max. Temperature difference for catalyst diagnosis cycle validity" VALUE 0xa0801b14 _REC_VAL_20_u1 254. _CNV_A_R_LINEAR_____522_CM 0. 254. DISPLAY_IDENTIFIER C_TEMP_CAT_DIF_DYN_MAX FORMAT "%3.0" /end CHARACTERISTIC
/begin CHARACTERISTIC c_temp_cat_dif_dyn_st "Max. Temperature difference for catalyst diagnosis begin" VALUE 0xa0801b15 _REC_VAL_20_u1 254. _CNV_A_R_LINEAR_____522_CM 0. 254. DISPLAY_IDENTIFIER C_TEMP_CAT_DIF_DYN_ST FORMAT "%3.0" /end CHARACTERISTIC
/begin AXIS_PTS ldp_vls_temp_ip_lamb_cat "" 0xa08018a0 online_dummy _REC_AXS_20_u2 4.9951171875 _CNV_A_R_LINEAR_____2_CM 12 0. 4.9951171875 FORMAT "%5.3" /end AXIS_PTS
/begin CHARACTERISTIC lc_eff_cat_diag_hom_ena "Use EFF_CAT_DIAG_HOM from linear cat diagnosis as result EFF_CAT_DIAG" VALUE 0xa0801b39 _REC_VAL_20_u1 1. _CNV_A_R_LINEAR_____0_CM 0. 1. DISPLAY_IDENTIFIER LC_EFF_CAT_DIAG_HOM_ENA FORMAT "%1.0" /end CHARACTERISTIC
/begin CHARACTERISTIC lc_o2l_cat_diag_afl_ena "Use O2L_CAT_DIAG_AFL from lean cat diagnosis as result EFF_CAT_DIAG" VALUE 0xa0801b44 _REC_VAL_20_u1 1. _CNV_A_R_LINEAR_____0_CM 0. 1. DISPLAY_IDENTIFIER LC_O2L_CAT_DIAG_AFL_ENA FORMAT "%1.0" /end CHARACTERISTIC
/begin AXIS_PTS ldp_o2l_cat_diag_afl_ip_eff_cat "" 0xa08017e4 online_dummy _REC_AXS_20_u2 2.616848958333331 _CNV_A_R_LINEAR_____812_CM 6 0. 2.61684895833333 FORMAT "%7.5" /end AXIS_PTS
/begin CHARACTERISTIC ip_eff_cat_diag_hom "Conversion of lean cat diag result O2L_CAT_DIAG_AFL to lambda=1 cat diag result EFF_CAT_DIAG" CURVE 0xa08018e2 _REC_CUR_20_u1_u2 1.9921875 _CNV_A_R_LINEAR_____103_CM 0. 1.9921875 DISPLAY_IDENTIFIER IP_EFF_CAT_DIAG_HOM FORMAT "%8.6"
 /begin AXIS_DESCR COM_AXIS online_dummy _CNV_A_R_LINEAR_____812_CM 6 0. 2.61684895833333 FORMAT "%7.5" AXIS_PTS_REF ldp_o2l_cat_diag_afl_ip_eff_cat /end AXIS_DESCR
/end CHARACTERISTIC
/begin CHARACTERISTIC c_amp_min_cat "min. ambient pressure threshold" VALUE 0xa0801a78 _REC_VAL_20_u2 5434. _CNV_A_R_LINEAR_____27_CM 0. 5434. DISPLAY_IDENTIFIER C_AMP_MIN_CAT FORMAT "%7.2" /end CHARACTERISTIC
/begin CHARACTERISTIC c_cl_max_cat "maximum canister load to allow catalyst and o2 sensor diagnosis" VALUE 0xa0801a7a _REC_VAL_20_u2 1.99996948242188 _CNV_A_R_LINEAR_____9_CM 0. 1.99996948242188 DISPLAY_IDENTIFIER C_CL_MAX_CAT FORMAT "%7.5" /end CHARACTERISTIC
/begin CHARACTERISTIC c_maf_hys_cat "hysterese after exceeding maf_lam_cat threshold" VALUE 0xa0801ad2 _REC_VAL_20_u2 1389. _CNV_A_R_LINEAR_____111_CM 0. 1389. DISPLAY_IDENTIFIER C_MAF_HYS_CAT FORMAT "%7.2" /end CHARACTERISTIC
/begin CHARACTERISTIC c_maf_int_dly_cat_diag "air mass flow threshold for cat diag activation after puc, cl max purge, forced stimulation on, downstream sensor ready" VALUE 0xa0801ad4 _REC_VAL_20_u2 1456.33 _CNV_A_R_CYBL_LINEA_135_CM 0. 1456.33 DISPLAY_IDENTIFIER C_MAF_INT_DLY_CAT_DIAG FORMAT "%11.6" /end CHARACTERISTIC
/begin CHARACTERISTIC c_maf_int_sw_cat_diag "air mass flow initial for cat diag activation after MAX to NO_PURGE and back" VALUE 0xa0801ade _REC_VAL_20_u2 1456.33 _CNV_A_R_CYBL_LINEA_135_CM 0. 1456.33 DISPLAY_IDENTIFIER C_MAF_INT_SW_CAT_DIAG FORMAT "%11.6" /end CHARACTERISTIC
/begin CHARACTERISTIC c_tco_min_cat "min. tco threshold for catalyst diagnosis activation" VALUE 0xa0801b10 _REC_VAL_20_u1 190.5 _CNV_A_R_LINEAR_____17_CM -48. 142.5 DISPLAY_IDENTIFIER C_TCO_MIN_CAT FORMAT "%6.2" /end CHARACTERISTIC
/begin CHARACTERISTIC c_temp_hys_cat "hysteresis after exeeding catayst temperature threshold for catalyst diagnosis activation" VALUE 0xa0801b1e _REC_VAL_20_u1 2040. _CNV_A_R_EGTR_LINEA_815_CM -273.15 1766.85 DISPLAY_IDENTIFIER C_TEMP_HYS_CAT FORMAT "%9.4" /end CHARACTERISTIC
/begin CHARACTERISTIC c_temp_max_cat "max. catalyst temperature threshold for catalyst diagnosis activation" VALUE 0xa0801b22 _REC_VAL_20_u1 2040. _CNV_A_R_EGTR_LINEA_815_CM -273.15 1766.85 DISPLAY_IDENTIFIER C_TEMP_MAX_CAT FORMAT "%9.4" /end CHARACTERISTIC
/begin CHARACTERISTIC c_temp_min_cat "min. catalyst temperature threshold for catalyst diagnosis activation" VALUE 0xa0801b23 _REC_VAL_20_u1 2040. _CNV_A_R_EGTR_LINEA_815_CM -273.15 1766.85 DISPLAY_IDENTIFIER C_TEMP_MIN_CAT FORMAT "%9.4" /end CHARACTERISTIC
/begin CHARACTERISTIC c_temp_min_cat_eol "min. catalyst temperature threshold for catalyst diagnosis activation in case of EOL test" VALUE 0xa0801b24 _REC_VAL_20_u1 2040. _CNV_A_R_EGTR_LINEA_815_CM -273.15 1766.85 DISPLAY_IDENTIFIER C_TEMP_MIN_CAT_EOL FORMAT "%9.4" /end CHARACTERISTIC
/begin CHARACTERISTIC c_vs_max_cat "max. vs threshold for catalyst diagnosis activation" VALUE 0xa0801b2e _REC_VAL_20_u1 255. _CNV_A_R_LINEAR_____6_CM 0. 255. DISPLAY_IDENTIFIER C_VS_MAX_CAT FORMAT "%3.0" /end CHARACTERISTIC
/begin CHARACTERISTIC c_vs_min_cat "min. vs threshold for catalyst diagnosis activation" VALUE 0xa0801b2f _REC_VAL_20_u1 255. _CNV_A_R_LINEAR_____6_CM 0. 255. DISPLAY_IDENTIFIER C_VS_MIN_CAT FORMAT "%3.0" /end CHARACTERISTIC
/begin CHARACTERISTIC lc_cat_diag_cdn_act_man "flag to set catalyst diagnosis condition manually" VALUE 0xa0801b30 _REC_VAL_20_u1 1. _CNV_A_R_LINEAR_____0_CM 0. 1. DISPLAY_IDENTIFIER LC_CAT_DIAG_CDN_ACT_MAN FORMAT "%1.0" /end CHARACTERISTIC
/begin CHARACTERISTIC ip_maf_max_cat "max. MAF threshold for catalyst diagnosis activation" CURVE 0xa0801a50 _REC_CUR_20_u2_u1 1389. _CNV_A_R_LINEAR_____111_CM 0. 1389. DISPLAY_IDENTIFIER IP_MAF_MAX_CAT FORMAT "%7.2"
 /begin AXIS_DESCR COM_AXIS n_32 _CNV_A_R_LINEAR_____10_CM 6 0. 8160. FORMAT "%4.0" AXIS_PTS_REF ldpm_n_32_3_egtr /end AXIS_DESCR
/end CHARACTERISTIC
/begin CHARACTERISTIC ip_maf_min_cat "min. MAF threshold for catalyst diagnosis activation" CURVE 0xa0801a5c _REC_CUR_20_u2_u1 1389. _CNV_A_R_LINEAR_____111_CM 0. 1389. DISPLAY_IDENTIFIER IP_MAF_MIN_CAT FORMAT "%7.2"
 /begin AXIS_DESCR COM_AXIS n_32 _CNV_A_R_LINEAR_____10_CM 6 0. 8160. FORMAT "%4.0" AXIS_PTS_REF ldpm_n_32_3_egtr /end AXIS_DESCR
/end CHARACTERISTIC
/begin MEASUREMENT load_cat_ldc "catalyst diagnosis specific load for limited dynamics calculation" UWORD _CNV_A_R_CPULOAD__0_448_CM 1 100. 0. 99.90234375 DISPLAY_IDENTIFIER LOAD_CAT_LDC ECU_ADDRESS 0xd0006604 FORMAT "%5.2" /end MEASUREMENT
/begin CHARACTERISTIC lc_inh_cat_diag_man_deac "Manual deactivation of CAT diagnosis inhibition conditions" VALUE 0xa0801b3b _REC_VAL_20_u1 1. _CNV_A_R_LINEAR_____0_CM 0. 1. DISPLAY_IDENTIFIER LC_INH_CAT_DIAG_MAN_DEAC FORMAT "%1.0" /end CHARACTERISTIC
/begin CHARACTERISTIC c_eff_cat_max_50_diag "max. threshold for eff_cat_diag to detect a separate catalyst with efficiency lower then 50%" VALUE 0xa0801a89 _REC_VAL_20_u1 1.9921875 _CNV_A_R_LINEAR_____103_CM 0. 1.9921875 DISPLAY_IDENTIFIER C_EFF_CAT_MAX_50_DIAG FORMAT "%8.6" /end CHARACTERISTIC
/begin CHARACTERISTIC c_eff_cat_max_diag "max. threshold for eff_cat_diag to detect a separate catalyst with obd limit emissions" VALUE 0xa0801a8a _REC_VAL_20_u1 1.9921875 _CNV_A_R_LINEAR_____103_CM 0. 1.9921875 DISPLAY_IDENTIFIER C_EFF_CAT_MAX_DIAG FORMAT "%8.6" /end CHARACTERISTIC
/begin CHARACTERISTIC c_eff_cat_max_diag_eol "max. threshold for eff_cat_diag[i] to detect a separate catalyst with obd limit emissions at eol test" VALUE 0xa0801a8b _REC_VAL_20_u1 1.9921875 _CNV_A_R_LINEAR_____103_CM 0. 1.9921875 DISPLAY_IDENTIFIER C_EFF_CAT_MAX_DIAG_EOL FORMAT "%8.6" /end CHARACTERISTIC
/begin CHARACTERISTIC c_eff_cat_max_sum_diag "max. threshold for eff_cat_diag to common detect of catalysts with vehicle obd limit emissions" VALUE 0xa0801a8c _REC_VAL_20_u1 1.9921875 _CNV_A_R_LINEAR_____103_CM 0. 1.9921875 DISPLAY_IDENTIFIER C_EFF_CAT_MAX_SUM_DIAG FORMAT "%8.6" /end CHARACTERISTIC
/begin CHARACTERISTIC lc_cat_diag_dis "for report value to scan tool: separate eff_cat_diag for each catalyst or common, if over obd emiss. limit" VALUE 0xa0801b31 _REC_VAL_20_u1 1. _CNV_A_R_LINEAR_____0_CM 0. 1. DISPLAY_IDENTIFIER LC_CAT_DIAG_DIS FORMAT "%1.0" /end CHARACTERISTIC
/begin CHARACTERISTIC lc_cat_diag_resu "switch over the failure memory setting: separate for each catalyst or common for obd emiss. limit" VALUE 0xa0801b32 _REC_VAL_20_u1 1. _CNV_A_R_LINEAR_____0_CM 0. 1. DISPLAY_IDENTIFIER LC_CAT_DIAG_RESU FORMAT "%1.0" /end CHARACTERISTIC
/begin AXIS_PTS ldp_eff_cat_diag_1_ip_eff_cat "" 0xa0801728 egtr[0].egtr_struct_fctdgcef0.eff_cat_diag_hom _REC_AXS_20_u1 1.9921875 _CNV_A_R_LINEAR_____103_CM 6 0. 1.9921875 FORMAT "%8.6" /end AXIS_PTS
/begin AXIS_PTS ldp_eff_cat_diag_2_ip_eff_cat "" 0xa0801730 egtr[1].egtr_struct_fctdgcef0.eff_cat_diag_hom _REC_AXS_20_u1 1.9921875 _CNV_A_R_LINEAR_____103_CM 6 0. 1.9921875 FORMAT "%8.6" /end AXIS_PTS
/begin CHARACTERISTIC ip_eff_cat_diag_sum "map of common eff_cat_diag_sum value depending from separate bank values for common obd emiss. limit" MAP 0xa08018e8 _REC_MAP_20_u1_u1_u1 1.9921875 _CNV_A_R_LINEAR_____103_CM 0. 1.9921875 DISPLAY_IDENTIFIER IP_EFF_CAT_DIAG_SUM FORMAT "%8.6"
 /begin AXIS_DESCR COM_AXIS egtr[0].egtr_struct_fctdgcef0.eff_cat_diag_hom _CNV_A_R_LINEAR_____103_CM 6 0. 1.9921875 FORMAT "%8.6" AXIS_PTS_REF ldp_eff_cat_diag_1_ip_eff_cat /end AXIS_DESCR
 /begin AXIS_DESCR COM_AXIS egtr[1].egtr_struct_fctdgcef0.eff_cat_diag_hom _CNV_A_R_LINEAR_____103_CM 6 0. 1.9921875 FORMAT "%8.6" AXIS_PTS_REF ldp_eff_cat_diag_2_ip_eff_cat /end AXIS_DESCR
/end CHARACTERISTIC
/begin MEASUREMENT eff_cat_diag_sum "common value for catalyst conversion capability of both cylinder banks (obd emission limit)" UBYTE _CNV_A_R_LINEAR_____103_CM 1 100. 0. 1.9921875 DISPLAY_IDENTIFIER EFF_CAT_DIAG_SUM ECU_ADDRESS 0xd00023ec FORMAT "%8.6" /end MEASUREMENT
/begin MEASUREMENT maf_mmv_cat_ldc "floating mean value for limited maf" UWORD _CNV_A_R_LINEAR_____111_CM 1 100. 0. 1389. DISPLAY_IDENTIFIER MAF_MMV_CAT_LDC ECU_ADDRESS 0xd00023f2 FORMAT "%7.2" /end MEASUREMENT
/begin MEASUREMENT n_mmv_cat_ldc "floating mean value for limited engine speed" UWORD _CNV_A_R_LINEAR_____14_CM 1 100. 0. 8160. DISPLAY_IDENTIFIER N_MMV_CAT_LDC ECU_ADDRESS 0xd00023f4 FORMAT "%4.0" /end MEASUREMENT
/begin MEASUREMENT load_grd_sum_cat_ldc "sum value of load gradient fro limited dynamics for catalyst diagnosis" UWORD _CNV_A_R_EGTR_LINEA_817_CM 1 100. 0. 159998. DISPLAY_IDENTIFIER LOAD_GRD_SUM_CAT_LDC ECU_ADDRESS 0xd00023f0 FORMAT "%12.5" /end MEASUREMENT
/begin MEASUREMENT load_grd_cat_ldc "load gradient for limted dynamics of catalyst diagnosis" SWORD _CNV_A_R_EGTR_LINEA_818_CM 1 100. -1250. 1247.56 DISPLAY_IDENTIFIER LOAD_GRD_CAT_LDC ECU_ADDRESS 0xd00023ee FORMAT "%10.5" /end MEASUREMENT
/begin MEASUREMENT lv_load_grd_cat_ldc "status limited dynamic load_grd_cat_ldc" UBYTE _CNV_S_2_RANGE__0___1_CM 1 100. 0. 1. DISPLAY_IDENTIFIER LV_LOAD_GRD_CAT_LDC ECU_ADDRESS 0xd0002400 BIT_MASK 0x1 /end MEASUREMENT
/begin MEASUREMENT lv_maf_cat_ldc "status limited dynamic maf" UBYTE _CNV_S_2_RANGE__0___1_CM 1 100. 0. 1. DISPLAY_IDENTIFIER LV_MAF_CAT_LDC ECU_ADDRESS 0xd0002401 BIT_MASK 0x1 /end MEASUREMENT
/begin MEASUREMENT lv_n_cat_ldc "status limited dynamic n" UBYTE _CNV_S_2_RANGE__0___1_CM 1 100. 0. 1. DISPLAY_IDENTIFIER LV_N_CAT_LDC ECU_ADDRESS 0xd0002402 BIT_MASK 0x1 /end MEASUREMENT
/begin CHARACTERISTIC c_crlc_maf_cat_ldc "correlation constant for floating mean value calculation of air mass flow" VALUE 0xa0801a7c _REC_VAL_20_u2 0.9999847412109381 _CNV_A_R_LINEAR_____89_CM 0. 0.9999847412109381 DISPLAY_IDENTIFIER C_CRLC_MAF_CAT_LDC FORMAT "%7.5" /end CHARACTERISTIC
/begin CHARACTERISTIC c_crlc_n_cat_ldc "correlation constant for floating mean value calculation of engine speed" VALUE 0xa0801a7e _REC_VAL_20_u2 0.9999847412109381 _CNV_A_R_LINEAR_____89_CM 0. 0.9999847412109381 DISPLAY_IDENTIFIER C_CRLC_N_CAT_LDC FORMAT "%7.5" /end CHARACTERISTIC
/begin CHARACTERISTIC c_fac_lam_mv_dyw_cat "threshold limited dynamic lambda" VALUE 0xa0801a9a _REC_VAL_20_u2 99.99847412109381 _CNV_A_R_LINEAR_____8_CM 0. 99.99847412109381 DISPLAY_IDENTIFIER C_FAC_LAM_MV_DYW_CAT /end CHARACTERISTIC
/begin CHARACTERISTIC c_load_grd_dec "decrement for calculation load_cat_ldc gradient" VALUE 0xa0801ac4 _REC_VAL_20_u2 2497.5653 _CNV_A_R_EGTR_LINEA_817_CM 0. 2497.5653 DISPLAY_IDENTIFIER C_LOAD_GRD_DEC FORMAT "%12.5" /end CHARACTERISTIC
/begin CHARACTERISTIC c_load_grd_min_sum_cat "min. threshold for load_grd cat_ldc summation" VALUE 0xa0801ac6 _REC_VAL_20_u2 1247.56 _CNV_A_R_EGTR_LINEA_817_CM 0. 1247.56 DISPLAY_IDENTIFIER C_LOAD_GRD_MIN_SUM_CAT FORMAT "%12.5" /end CHARACTERISTIC
/begin CHARACTERISTIC c_load_grd_sum_max "max threshold limited dynamic load_cat_ldc gradient" VALUE 0xa0801ac8 _REC_VAL_20_u2 159998. _CNV_A_R_EGTR_LINEA_817_CM 0. 159998. DISPLAY_IDENTIFIER C_LOAD_GRD_SUM_MAX FORMAT "%12.5" /end CHARACTERISTIC
/begin CHARACTERISTIC c_load_grd_sum_min "min threshold limited dynamic load_cat_ldc gradient" VALUE 0xa0801aca _REC_VAL_20_u2 159998. _CNV_A_R_EGTR_LINEA_817_CM 0. 159998. DISPLAY_IDENTIFIER C_LOAD_GRD_SUM_MIN FORMAT "%12.5" /end CHARACTERISTIC
/begin CHARACTERISTIC c_maf_dyw_cat_ldc "threshold limited dynamic engine maf" VALUE 0xa0801ad0 _REC_VAL_20_u2 1389. _CNV_A_R_LINEAR_____111_CM 0. 1389. DISPLAY_IDENTIFIER C_MAF_DYW_CAT_LDC FORMAT "%7.2" /end CHARACTERISTIC
/begin CHARACTERISTIC c_maf_int_min_cat_ldc "maf integral after setting limited dynamic conditions lv_cat_ldc[i] i before starting the monitoring cycle" VALUE 0xa0801ad8 _REC_VAL_20_u2 1456.33 _CNV_A_R_CYBL_LINEA_135_CM 0. 1456.33 DISPLAY_IDENTIFIER C_MAF_INT_MIN_CAT_LDC FORMAT "%11.6" /end CHARACTERISTIC
/begin CHARACTERISTIC c_n_dyw_cat_ldc "threshold limited dynamic engine speed" VALUE 0xa0801ae6 _REC_VAL_20_u2 8160. _CNV_A_R_LINEAR_____14_CM 0. 8160. DISPLAY_IDENTIFIER C_N_DYW_CAT_LDC FORMAT "%4.0" /end CHARACTERISTIC
/begin CHARACTERISTIC c_t_load_grd_dec_sum "time periods for calculation limited dynamic load_cat_ldc gradient" VALUE 0xa0801b0e _REC_VAL_20_u1 5.1 _CNV_A_R_LINEAR_____110_CM 0. 5.1 DISPLAY_IDENTIFIER C_T_LOAD_GRD_DEC_SUM FORMAT "%4.2" /end CHARACTERISTIC
/begin CHARACTERISTIC lc_fac_lam_rst_cat_ldc "switch for active reset of filtered fac_lam to not filtered after lim. dyn. over threshold" VALUE 0xa0801b3a _REC_VAL_20_u1 1. _CNV_A_R_LINEAR_____0_CM 0. 1. DISPLAY_IDENTIFIER LC_FAC_LAM_RST_CAT_LDC FORMAT "%1.0" /end CHARACTERISTIC
/begin CHARACTERISTIC lc_maf_rst_cat_ldc "switch for active reset of filtered maf to not filtered after lim. dyn. over threshold" VALUE 0xa0801b41 _REC_VAL_20_u1 1. _CNV_A_R_LINEAR_____0_CM 0. 1. DISPLAY_IDENTIFIER LC_MAF_RST_CAT_LDC FORMAT "%1.0" /end CHARACTERISTIC
/begin CHARACTERISTIC lc_n_rst_cat_ldc "switch for active reset of filtered n to not filtered after lim. dyn. over threshold" VALUE 0xa0801b42 _REC_VAL_20_u1 1. _CNV_A_R_LINEAR_____0_CM 0. 1. DISPLAY_IDENTIFIER LC_N_RST_CAT_LDC FORMAT "%1.0" /end CHARACTERISTIC
/begin MEASUREMENT egtr[0].egtr_struct_defspfstic0.lamb_pls "Lambda deviation for the lambda controller (only in case of NC_USE_EGTR = 0)" SWORD _CNV_A_R_LINEAR_____24_CM 1 100. -0.125 0.1249389 DISPLAY_IDENTIFIER LAMB_PLS[1] ECU_ADDRESS 0xd0005d18 FORMAT "%8.5" /end MEASUREMENT
/begin MEASUREMENT egtr[0].egtr_struct_defspfstic0.lv_lamb_pls_afl_cor_act "Flag indicating that corrective action for lean half wave of lambda stimulation is active" UBYTE _CNV_S_2_RANGE__0___1_CM 1 100. 0. 1. DISPLAY_IDENTIFIER LV_LAMB_PLS_AFL_COR_ACT[1] ECU_ADDRESS 0xd0005d1a BIT_MASK 0x1 /end MEASUREMENT
/begin MEASUREMENT egtr[0].egtr_struct_defspfstic0.lv_lamb_pls_afr_cor_act "Flag indicating that corrective action for rich half wave of lambda stimulation is active" UBYTE _CNV_S_2_RANGE__0___1_CM 1 100. 0. 1. DISPLAY_IDENTIFIER LV_LAMB_PLS_AFR_COR_ACT[1] ECU_ADDRESS 0xd0005d1b BIT_MASK 0x1 /end MEASUREMENT
/begin MEASUREMENT egtr[0].egtr_struct_defspfstia0.maf_int_lamb_pls_act "Air mass flow integral for forced lambda stimulation activation" UWORD _CNV_A_R_CYBL_LINEA_135_CM 1 100. 0. 1456.33 DISPLAY_IDENTIFIER MAF_INT_LAMB_PLS_ACT[1] ECU_ADDRESS 0xd0005d1c FORMAT "%11.6" /end MEASUREMENT
/begin MEASUREMENT egtr[0].egtr_struct_defspfstia0.lv_lamb_pls_act "Flag indicating that forced lambda stimulation is active" UBYTE _CNV_S_2_RANGE__0___1_CM 1 100. 0. 1. DISPLAY_IDENTIFIER LV_LAMB_PLS_ACT[1] ECU_ADDRESS 0xd0005d1e BIT_MASK 0x1 /end MEASUREMENT
/begin MEASUREMENT egtr[0].egtr_struct_defspfstia0.lv_lamb_pls_diag_lsh_up "Flag indicating that requested exaggerated forced lambda stimulation is active" UBYTE _CNV_S_2_RANGE__0___1_CM 1 100. 0. 1. DISPLAY_IDENTIFIER LV_LAMB_PLS_DIAG_LSH_UP[1] ECU_ADDRESS 0xd0005d1f BIT_MASK 0x1 /end MEASUREMENT
/begin MEASUREMENT egtr[0].egtr_struct_defspfstia0.lv_lamb_pls_act_cat_purge "Flag that indicates that the forced stimulation can be activated due to cat purge" UBYTE _CNV_S_2_RANGE__0___1_CM 1 100. 0. 1. DISPLAY_IDENTIFIER LV_LAMB_PLS_ACT_CAT_PURGE[1] ECU_ADDRESS 0xd0005d20 BIT_MASK 0x1 /end MEASUREMENT
/begin MEASUREMENT egtr[0].egtr_struct_defspfsti0.o2l_add_lamb_pls "O2 load to be added to the O2 load integral each sample step" SLONG _CNV_A_R_EGTR_LINEA_819_CM 1 100. -669.923556 669.923555 DISPLAY_IDENTIFIER O2L_ADD_LAMB_PLS[1] ECU_ADDRESS 0xd0005d24 FORMAT "%11.6" /end MEASUREMENT
/begin MEASUREMENT egtr[0].egtr_struct_defspfsti0.o2l_lamb_pls "Current O2 loading or release for forced lambda stimulation" SLONG _CNV_A_R_EGTR_LINEA_819_CM 1 100. -669.923556 669.923555 DISPLAY_IDENTIFIER O2L_LAMB_PLS[1] ECU_ADDRESS 0xd0005d28 FORMAT "%11.6" /end MEASUREMENT
/begin MEASUREMENT egtr[0].egtr_struct_defspfsti0.o2l_sp_new_lamb_pls "O2 loading set point that is realized by forced lambda stimulation" UWORD _CNV_A_R_LINEAR_____812_CM 1 100. 0. 2.61684895833333 DISPLAY_IDENTIFIER O2L_SP_NEW_LAMB_PLS[1] ECU_ADDRESS 0xd0005d2c FORMAT "%7.5" /end MEASUREMENT
/begin MEASUREMENT egtr[0].egtr_struct_defspfsti0.lamb_pls_o2l_osc "Lambda set point deviation based on forced stimulation O2 balancing" SWORD _CNV_A_R_LINEAR_____24_CM 1 100. -0.125 0.12493 DISPLAY_IDENTIFIER LAMB_PLS_O2L_OSC[1] ECU_ADDRESS 0xd0005d2e FORMAT "%8.5" /end MEASUREMENT
/begin MEASUREMENT egtr[0].egtr_struct_defspfsti0.fac_o2l_lamb_pls "Temporary factor for O2 loading calculation considering the lambda set point deviation" SWORD _CNV_A_R_EGTR_LINEA_820_CM 1 100. -0.25 0.249992 DISPLAY_IDENTIFIER FAC_O2L_LAMB_PLS[1] ECU_ADDRESS 0xd0005d30 FORMAT "%9.6" /end MEASUREMENT
/begin MEASUREMENT egtr[0].egtr_struct_defspfsti0.o2l_sp_half_lamb_pls "Auxiliary value; half O2 loading set point of forced lambda stimulation" UWORD _CNV_A_R_LINEAR_____812_CM 1 100. 0. 2.61684895833333 DISPLAY_IDENTIFIER O2L_SP_HALF_LAMB_PLS[1] ECU_ADDRESS 0xd0005d32 FORMAT "%7.5" /end MEASUREMENT
/begin MEASUREMENT egtr[0].egtr_struct_defspfsti0.state_lamb_pls "State of forced lambda stimulation" UBYTE _CNV_S_3_EGTR_RANGE_821_CM 1 100. 0. 2. DISPLAY_IDENTIFIER STATE_LAMB_PLS[1] ECU_ADDRESS 0xd0005d34 /end MEASUREMENT
/begin MEASUREMENT egtr[0].egtr_struct_defspfsti0.lv_lamb_pls_o2l_osc_pos "Auxiliary flag indicating positive lambda stimulation half wave" UBYTE _CNV_S_2_RANGE__0___1_CM 1 100. 0. 1. DISPLAY_IDENTIFIER LV_LAMB_PLS_O2L_OSC_POS[1] ECU_ADDRESS 0xd0005d35 BIT_MASK 0x1 /end MEASUREMENT
/begin MEASUREMENT egtr[0].egtr_struct_defspfsti0.lv_lamb_pls_mst_cbk "Auxiliary flag indicating that this bank is master bank for forced stimulation" UBYTE _CNV_S_2_RANGE__0___1_CM 1 100. 0. 1. DISPLAY_IDENTIFIER LV_LAMB_PLS_MST_CBK[1] ECU_ADDRESS 0xd0005d36 BIT_MASK 0x1 /end MEASUREMENT
/begin MEASUREMENT egtr[0].egtr_struct_defspcenrc0.lamb_sp_delta_cat_purge "Lambda set point shift of cat purge function" UWORD _CNV_A_R_LINEAR_____24_CM 1 100. 0. 0.24992 DISPLAY_IDENTIFIER LAMB_SP_DELTA_CAT_PURGE[1] ECU_ADDRESS 0xd0005d38 FORMAT "%7.5" /end MEASUREMENT
/begin MEASUREMENT egtr[0].egtr_struct_defspfstii0.lv_inh_lamb_pls "Inhibition flag for forced lambda stimulation" UBYTE _CNV_S_2_RANGE__0___1_CM 1 100. 0. 1. DISPLAY_IDENTIFIER LV_INH_LAMB_PLS[1] ECU_ADDRESS 0xd0005d3a BIT_MASK 0x1 /end MEASUREMENT
/begin MEASUREMENT egtr[0].egtr_struct_defspcenr0.o2l_rls_pcat_purge "Oxygen loading to be released for pre cat purge" SLONG _CNV_A_R_EGTR_LINEA_819_CM 1 100. -669.923556 669.923555 DISPLAY_IDENTIFIER O2L_RLS_PCAT_PURGE[1] ECU_ADDRESS 0xd0005d3c FORMAT "%11.6" /end MEASUREMENT
/begin MEASUREMENT egtr[0].egtr_struct_defspcenr0.o2l_rls_tot_cat_purge "Total oxygen loading to be released for pre and main cat purge" SLONG _CNV_A_R_EGTR_LINEA_819_CM 1 100. -669.923556 669.923555 DISPLAY_IDENTIFIER O2L_RLS_TOT_CAT_PURGE[1] ECU_ADDRESS 0xd0005d40 FORMAT "%11.6" /end MEASUREMENT
/begin MEASUREMENT egtr[0].egtr_struct_defspcenr0.o2l_rls_rest_cat_purge "Estimated rest oxygen loading to be released for pre and main cat purge" SLONG _CNV_A_R_EGTR_LINEA_819_CM 1 100. -669.923556 669.923555 DISPLAY_IDENTIFIER O2L_RLS_REST_CAT_PURGE[1] ECU_ADDRESS 0xd0005d44 FORMAT "%11.6" /end MEASUREMENT
/begin MEASUREMENT egtr[0].egtr_struct_defspcenr0.o2l_rls_add_cat_purge "Oxygen loading to be added each sample step for cat purge air mass flow integral" SLONG _CNV_A_R_EGTR_LINEA_819_CM 1 100. -669.923556 669.923555 DISPLAY_IDENTIFIER O2L_RLS_ADD_CAT_PURGE[1] ECU_ADDRESS 0xd0005d48 FORMAT "%11.6" /end MEASUREMENT
/begin MEASUREMENT egtr[0].egtr_struct_defspcenr0.o2l_rls_main_cat_purge "Oxygen loading to be released for main cat purge" SLONG _CNV_A_R_EGTR_LINEA_819_CM 1 100. -669.923556 669.923555 DISPLAY_IDENTIFIER O2L_RLS_MAIN_CAT_PURGE[1] ECU_ADDRESS 0xd0005d4c FORMAT "%11.6" /end MEASUREMENT
/begin MEASUREMENT egtr[0].egtr_struct_defspcenr0.lamb_sp_delta_it_cat_purge "Lambda set point shift of cat purge function (internal value)" UWORD _CNV_A_R_LINEAR_____24_CM 1 100. 0. 0.24992 DISPLAY_IDENTIFIER LAMB_SP_DELTA_IT_CAT_PURGE[1] ECU_ADDRESS 0xd0005d50 FORMAT "%7.5" /end MEASUREMENT
/begin MEASUREMENT egtr[0].egtr_struct_defspcenr0.fac_o2l_rls_cat_purge "Temporary factor for O2 loading release calculation considering the lambda set point deviation" SWORD _CNV_A_R_EGTR_LINEA_820_CM 1 100. -0.25 0.249992 DISPLAY_IDENTIFIER FAC_O2L_RLS_CAT_PURGE[1] ECU_ADDRESS 0xd0005d52 FORMAT "%9.6" /end MEASUREMENT
/begin MEASUREMENT egtr[0].egtr_struct_defspcenr0.ratio_o2l_rls_cat_purge "Quotient used by cat purge: current rest oxygen loading / total oxygen loading" UBYTE _CNV_A_R_LINEAR_____28_CM 1 100. 0. 0.99609375 DISPLAY_IDENTIFIER RATIO_O2L_RLS_CAT_PURGE[1] ECU_ADDRESS 0xd0005d54 FORMAT "%5.3" /end MEASUREMENT
/begin MEASUREMENT egtr[0].egtr_struct_defspcenr0.lv_cat_purge_act "Flag indicating that cat purge function is active" UBYTE _CNV_S_2_RANGE__0___1_CM 1 100. 0. 1. DISPLAY_IDENTIFIER LV_CAT_PURGE_ACT[1] ECU_ADDRESS 0xd0005d55 BIT_MASK 0x1 /end MEASUREMENT
/begin MEASUREMENT egtr[0].egtr_struct_defspcenr0.lv_vls_down_act_cat_purge "Flag indicating that downstream signal is/was below calibration threshold" UBYTE _CNV_S_2_RANGE__0___1_CM 1 100. 0. 1. DISPLAY_IDENTIFIER LV_VLS_DOWN_ACT_CAT_PURGE[1] ECU_ADDRESS 0xd0005d56 BIT_MASK 0x1 /end MEASUREMENT
/begin MEASUREMENT egtr[0].egtr_struct_defspcenr0.lv_cat_purge_main_cat "Flag indicating that cat purge for main cat is active" UBYTE _CNV_S_2_RANGE__0___1_CM 1 100. 0. 1. DISPLAY_IDENTIFIER LV_CAT_PURGE_MAIN_CAT[1] ECU_ADDRESS 0xd0005d57 BIT_MASK 0x1 /end MEASUREMENT
/begin MEASUREMENT egtr[0].egtr_struct_defspcenr0.lv_cat_purge_pcat "Flag indicating that cat purge for pre cat is active" UBYTE _CNV_S_2_RANGE__0___1_CM 1 100. 0. 1. DISPLAY_IDENTIFIER LV_CAT_PURGE_PCAT[1] ECU_ADDRESS 0xd0005d58 BIT_MASK 0x1 /end MEASUREMENT
/begin MEASUREMENT egtr[0].egtr_struct_defspcenrd0.o2l_rls_sp_pcat_purge "Oxygen loading to be purged (released) during pre cat purge" UWORD _CNV_A_R_LINEAR_____812_CM 1 100. 0. 2.61684895833333 DISPLAY_IDENTIFIER O2L_RLS_SP_PCAT_PURGE[1] ECU_ADDRESS 0xd0005d5c FORMAT "%7.5" /end MEASUREMENT
/begin MEASUREMENT egtr[0].egtr_struct_defspcenrd0.fac_add_main_cat_purge "Additional weighting factor for pre and main cat differences" UBYTE _CNV_A_R_LINEAR_____103_CM 1 100. 0. 1.9921875 DISPLAY_IDENTIFIER FAC_ADD_MAIN_CAT_PURGE[1] ECU_ADDRESS 0xd0005d5e FORMAT "%8.6" /end MEASUREMENT
/begin MEASUREMENT egtr[0].egtr_struct_defspcenrd0.state_cat_purge "State indicating the activation reason of cat purge" UBYTE _CNV_S_6_EGTR_RANGE_822_CM 1 100. 0. 5. DISPLAY_IDENTIFIER STATE_CAT_PURGE[1] ECU_ADDRESS 0xd0005d5f /end MEASUREMENT
/begin MEASUREMENT egtr[0].egtr_struct_defspcenrd0.lv_cat_purge_post_puc_trig "Auxiliary flag indicating that cat purge after PUC was triggered" UBYTE _CNV_S_2_RANGE__0___1_CM 1 100. 0. 1. DISPLAY_IDENTIFIER LV_CAT_PURGE_POST_PUC_TRIG[1] ECU_ADDRESS 0xd0005d60 BIT_MASK 0x1 /end MEASUREMENT
/begin MEASUREMENT egtr[0].egtr_struct_defspcenrd0.lv_cat_purge_st "Flag indicating that cat purge can be started (set for one sample step)" UBYTE _CNV_S_2_RANGE__0___1_CM 1 100. 0. 1. DISPLAY_IDENTIFIER LV_CAT_PURGE_ST[1] ECU_ADDRESS 0xd0005d61 BIT_MASK 0x1 /end MEASUREMENT
/begin MEASUREMENT egtr[0].egtr_struct_defspcenri0.temp_main_cat_purge "Catalyst temperature of main cat for cat purge function" UWORD _CNV_A_R_LINEAR_____214_CM 1 100. -273.15 1774.7875 DISPLAY_IDENTIFIER TEMP_MAIN_CAT_PURGE[1] ECU_ADDRESS 0xd0005d62 FORMAT "%9.4" /end MEASUREMENT
/begin MEASUREMENT egtr[0].egtr_struct_defspcenri0.lamb_sp_delta_add_cat_purge "Additional lambda set point shift for cat purge output" UWORD _CNV_A_R_LINEAR_____24_CM 1 100. 0. 0.24993896484375 DISPLAY_IDENTIFIER LAMB_SP_DELTA_ADD_CAT_PURGE[1] ECU_ADDRESS 0xd0005d64 FORMAT "%7.5" /end MEASUREMENT
/begin MEASUREMENT egtr[0].egtr_struct_defspcenri0.lv_inh_cat_purge "Inhibition flag for cat purge function" UBYTE _CNV_S_2_RANGE__0___1_CM 1 100. 0. 1. DISPLAY_IDENTIFIER LV_INH_CAT_PURGE[1] ECU_ADDRESS 0xd0005d66 BIT_MASK 0x1 /end MEASUREMENT
/begin MEASUREMENT egtr[0].egtr_struct_fctdgcefld0.fac_lam_mv_delta_cat_ldc "difference between filtered and not filtered fac_lam_mv[i] for lambda limited dynamic" SWORD _CNV_A_R_LINEAR_____113_CM 1 100. -50. 49.9984741210938 DISPLAY_IDENTIFIER FAC_LAM_MV_DELTA_CAT_LDC[1] ECU_ADDRESS 0xd0005d68 FORMAT "%7.3" /end MEASUREMENT
/begin MEASUREMENT egtr[0].egtr_struct_fctdgcefld0.maf_int_cat_ldc "integral of mass air flow since limited dynamic conditions fulfilled" UWORD _CNV_A_R_CYBL_LINEA_135_CM 1 100. 0. 1456.33 DISPLAY_IDENTIFIER MAF_INT_CAT_LDC[1] ECU_ADDRESS 0xd0005d6a FORMAT "%11.6" /end MEASUREMENT
/begin MEASUREMENT egtr[0].egtr_struct_fctdgcefld0.lv_cat_ldc "status of limited dynamics for catalyst efficiency diagnosis" UBYTE _CNV_S_2_RANGE__0___1_CM 1 100. 0. 1. DISPLAY_IDENTIFIER LV_CAT_LDC[1] ECU_ADDRESS 0xd0005d6c BIT_MASK 0x1 /end MEASUREMENT
/begin MEASUREMENT egtr[0].egtr_struct_fctdgcefld0.lv_fac_lam_cat_ldc "status limited dynamic fac_lam_mv[nc_cbk_ex_nr]" UBYTE _CNV_S_2_RANGE__0___1_CM 1 100. 0. 1. DISPLAY_IDENTIFIER LV_FAC_LAM_CAT_LDC[1] ECU_ADDRESS 0xd0005d6d BIT_MASK 0x1 /end MEASUREMENT
/begin MEASUREMENT egtr[0].egtr_struct_fctdgcefif0.eff_cat_diag_obd "cat. diag. value for obd scantool mod 6 output" UBYTE _CNV_A_R_LINEAR_____103_CM 1 100. 0. 1.9921875 DISPLAY_IDENTIFIER EFF_CAT_DIAG_OBD[1] ECU_ADDRESS 0xd0005d6e FORMAT "%8.6" /end MEASUREMENT
/begin MEASUREMENT egtr[0].egtr_struct_fctdgcefif0.eff_cat_max_diag_obd "actually threshold for scantool mod 6 output" UBYTE _CNV_A_R_LINEAR_____103_CM 1 100. 0. 1.9921875 DISPLAY_IDENTIFIER EFF_CAT_MAX_DIAG_OBD[1] ECU_ADDRESS 0xd0005d6f FORMAT "%8.6" /end MEASUREMENT
/begin MEASUREMENT egtr[0].egtr_struct_fctdgcefif0.lv_cdn_diag_cat_diag "Flag condition for catalyst diagnosis active" UBYTE _CNV_S_2_RANGE__0___1_CM 1 100. 0. 1. DISPLAY_IDENTIFIER LV_CDN_DIAG_CAT_DIAG[1] ECU_ADDRESS 0xd0005d70 BIT_MASK 0x1 /end MEASUREMENT
/begin MEASUREMENT egtr[0].egtr_struct_fctdgcefif0.lv_end_diag_cat_diag "flag catalyst diagnosis finished for that driving cycle" UBYTE _CNV_S_2_RANGE__0___1_CM 1 100. 0. 1. DISPLAY_IDENTIFIER LV_END_DIAG_CAT_DIAG[1] ECU_ADDRESS 0xd0005d71 BIT_MASK 0x1 /end MEASUREMENT
/begin MEASUREMENT egtr[0].egtr_struct_fctdgcefif0.lv_err_cat_diag "Present failure catalyst efficiency" UBYTE _CNV_S_2_RANGE__0___1_CM 1 100. 0. 1. DISPLAY_IDENTIFIER LV_ERR_CAT_DIAG[1] ECU_ADDRESS 0xd0005d72 BIT_MASK 0x1 /end MEASUREMENT
/begin MEASUREMENT egtr[0].egtr_struct_fctdgcefac0.maf_int_dly_cat_diag "Air mass flow integral after conditions are fulfilled for catalyst diagnosis activation" UWORD _CNV_A_R_CYBL_LINEA_135_CM 1 100. 0. 1456.33 DISPLAY_IDENTIFIER MAF_INT_DLY_CAT_DIAG[1] ECU_ADDRESS 0xd0005d74 FORMAT "%11.6" /end MEASUREMENT
/begin MEASUREMENT egtr[0].egtr_struct_fctdgcefac0.lv_cat_diag_cdn_act "Activation condition for O2 sensor and catalyst efficiency diagnosis (OSC-method)" UBYTE _CNV_S_2_RANGE__0___1_CM 1 100. 0. 1. DISPLAY_IDENTIFIER LV_CAT_DIAG_CDN_ACT[1] ECU_ADDRESS 0xd0005d76 BIT_MASK 0x1 /end MEASUREMENT
/begin MEASUREMENT egtr[0].egtr_struct_fctdgcef0.ratio_mass_o2_cat_dif_sum "summation of mass_o2_cat_dif_ratio[i] over all valid monitoring cycles" ULONG _CNV_A_R_EGTR_LINEA_823_CM 1 100. 0. 131072. DISPLAY_IDENTIFIER RATIO_MASS_O2_CAT_DIF_SUM[1] ECU_ADDRESS 0xd0005d78 FORMAT "%14.7" /end MEASUREMENT
/begin MEASUREMENT egtr[0].egtr_struct_fctdgcef0.lamb_cat_down_sum "integral of downstream lambda through 1 diagnosis period for calculation of mean value" ULONG _CNV_A_R_EGTR_LINEA_823_CM 1 100. 0. 131072. DISPLAY_IDENTIFIER LAMB_CAT_DOWN_SUM[1] ECU_ADDRESS 0xd0005d7c FORMAT "%14.7" /end MEASUREMENT
/begin MEASUREMENT egtr[0].egtr_struct_fctdgcef0.ratio_mass_o2_cat_dif "weighted mass_o2_cat_dif_cyc[i] value related to o2-load upstream catalyst from lambda controller" UWORD _CNV_A_R_LINEAR_____9_CM 1 100. 0. 1.99996948242188 DISPLAY_IDENTIFIER RATIO_MASS_O2_CAT_DIF[1] ECU_ADDRESS 0xd0005d80 FORMAT "%7.5" /end MEASUREMENT
/begin MEASUREMENT egtr[0].egtr_struct_fctdgcef0.mass_o2_cat_dif_cyc "mass o2 downsteam catalyst to mean value through 1 diagnosis period" UWORD _CNV_A_R_EGTR_LINEA_824_CM 1 100. 0. 8.17765e-002 DISPLAY_IDENTIFIER MASS_O2_CAT_DIF_CYC[1] ECU_ADDRESS 0xd0005d82 FORMAT "%10.8" /end MEASUREMENT
/begin MEASUREMENT egtr[0].egtr_struct_fctdgcef0.lamb_cat_down_mv "downstream lambda mean value for complete diagnosis period" UWORD _CNV_A_R_LINEAR_____9_CM 1 100. 0. 1.99996948242188 DISPLAY_IDENTIFIER LAMB_CAT_DOWN_MV[1] ECU_ADDRESS 0xd0005d84 FORMAT "%7.5" /end MEASUREMENT
/begin MEASUREMENT egtr[0].egtr_struct_fctdgcef0.lamb_cat_down_st_cyc "lamb_cat_down[i] value at start of monitoring cycle" UWORD _CNV_A_R_LINEAR_____9_CM 1 100. 0. 1.99996948242188 DISPLAY_IDENTIFIER LAMB_CAT_DOWN_ST_CYC[1] ECU_ADDRESS 0xd0005d86 FORMAT "%7.5" /end MEASUREMENT
/begin MEASUREMENT egtr[0].egtr_struct_fctdgcef0.lamb_cat_down "lambda downstream of catalyst; linearization of downstream ls signal" UWORD _CNV_A_R_LINEAR_____9_CM 1 100. 0. 1.99996948242188 DISPLAY_IDENTIFIER LAMB_CAT_DOWN[1] ECU_ADDRESS 0xd0005d88 FORMAT "%7.5" /end MEASUREMENT
/begin MEASUREMENT egtr[0].egtr_struct_fctdgcef0.flow_o2_cat_dif "downstream O2 flow difference to mean value" UWORD _CNV_A_R_EGTR_LINEA_825_CM 1 100. 0. 2.04441325e-003 DISPLAY_IDENTIFIER FLOW_O2_CAT_DIF[1] ECU_ADDRESS 0xd0005d8a FORMAT "%10.8" /end MEASUREMENT
/begin MEASUREMENT egtr[0].egtr_struct_fctdgcef0.ctr_cat_diag "monitoring cycle counter" UWORD _CNV_A_R_LINEAR_____0_CM 1 100. 0. 511. DISPLAY_IDENTIFIER CTR_CAT_DIAG[1] ECU_ADDRESS 0xd0005d8c FORMAT "%5.0" /end MEASUREMENT
/begin MEASUREMENT egtr[0].egtr_struct_fctdgcef0.ctr_lamb_cat_down_sum "Counter for the summation of LAMB_CAT_DOWN_SUM for each period" UWORD _CNV_A_R_LINEAR_____0_CM 1 100. 0. 65535. DISPLAY_IDENTIFIER CTR_LAMB_CAT_DOWN_SUM[1] ECU_ADDRESS 0xd0005d8e FORMAT "%5.0" /end MEASUREMENT
/begin MEASUREMENT egtr[0].egtr_struct_fctdgcef0.ctr_lamb_out_cat_diag "counter of non valid cycle due to lamb_cat_down_mv[i] is not in right range, for switch off cat diag" UBYTE _CNV_A_R_LINEAR_____0_CM 1 100. 0. 255. DISPLAY_IDENTIFIER CTR_LAMB_OUT_CAT_DIAG[1] ECU_ADDRESS 0xd0005d90 FORMAT "%3.0" /end MEASUREMENT
/begin MEASUREMENT egtr[0].egtr_struct_fctdgcef0.ctr_tot_cat_diag "total sum of all completed diagnosis cycles since ecu programming" UBYTE _CNV_A_R_LINEAR_____0_CM 1 100. 0. 255. DISPLAY_IDENTIFIER CTR_TOT_CAT_DIAG[1] ECU_ADDRESS 0xd0005d91 FORMAT "%3.0" /end MEASUREMENT
/begin MEASUREMENT egtr[0].egtr_struct_fctdgcef0.eff_cat_diag_hom "Catalyst diagnosis value in OSC range (from lambda=1 cat diag )" UBYTE _CNV_A_R_LINEAR_____103_CM 1 100. 0. 1.9921875 DISPLAY_IDENTIFIER EFF_CAT_DIAG_HOM[1] ECU_ADDRESS 0xd0005d92 FORMAT "%8.6" /end MEASUREMENT
/begin MEASUREMENT egtr[0].egtr_struct_fctdgcef0.temp_cat_dif_dyn_stat "temperature difference between dynamic and stationary catalyst temperature (from cat. temperature model)" UBYTE _CNV_A_R_EGTR_LINEA_826_CM 1 100. -256. 254. DISPLAY_IDENTIFIER TEMP_CAT_DIF_DYN_STAT[1] ECU_ADDRESS 0xd0005d93 FORMAT "%4.0" /end MEASUREMENT
/begin MEASUREMENT egtr[0].egtr_struct_fctdgcef0.state_cat_diag "state of diagnosis" UBYTE _CNV_S_6_EGTR_RANGE_827_CM 1 100. 0. 5. DISPLAY_IDENTIFIER STATE_CAT_DIAG[1] ECU_ADDRESS 0xd0005d94 /end MEASUREMENT
/begin MEASUREMENT egtr[0].egtr_struct_fctdgcef0.state_cat_diag_cyc_vld "Summary validity bits, current monitoring cycle valid and involved in calculation of diagnosis value; 1H = 1CROSS; 2H = MVDEL; 4H = 2CROSS; 8H = DIFMV; 10H = RANGE; 20H = TEMP" UBYTE _CNV_A_R_LINEAR_____0_CM 1 100. 0. 63. DISPLAY_IDENTIFIER STATE_CAT_DIAG_CYC_VLD[1] ECU_ADDRESS 0xd0005d95 FORMAT "%3.0" /end MEASUREMENT
/begin MEASUREMENT egtr[0].egtr_struct_fctdgcef0.lv_lamb_pls_req_cat_diag "flag to switch forced stimulation parameters for osc/nox cat. diagnosis" UBYTE _CNV_S_2_RANGE__0___1_CM 1 100. 0. 1. DISPLAY_IDENTIFIER LV_LAMB_PLS_REQ_CAT_DIAG[1] ECU_ADDRESS 0xd0005d96 BIT_MASK 0x1 /end MEASUREMENT
/begin MEASUREMENT egtr[0].egtr_struct_fctdgcef0.lv_lam_adj_cat_diag "Flag to switch trim control parameters for OSC/NOX Cat. Diagnosis (only in case of NC_USE_EGTR = 0)" UBYTE _CNV_S_2_RANGE__0___1_CM 1 100. 0. 1. DISPLAY_IDENTIFIER LV_LAM_ADJ_CAT_DIAG[1] ECU_ADDRESS 0xd0005d97 BIT_MASK 0x1 /end MEASUREMENT
/begin MEASUREMENT egtr[0].egtr_struct_fctdgcefi0.state_rbm_cat "interface of monitor cat_diag for the rate based monitoring statistics" UBYTE _CNV_A_R_LINEAR_____0_CM 1 100. 0. 15. DISPLAY_IDENTIFIER STATE_RBM_CAT[1] ECU_ADDRESS 0xd0005d98 FORMAT "%3.0" /end MEASUREMENT
/begin MEASUREMENT egtr[0].egtr_struct_fctdgcefi0.lv_inh_diag_cat_diag "flag to inhibit catalyst diagnosis function if there is a component failure" UBYTE _CNV_A_R_LINEAR_____0_CM 1 100. 0. 1. DISPLAY_IDENTIFIER LV_INH_DIAG_CAT_DIAG[1] ECU_ADDRESS 0xd0005d99 FORMAT "%1.0" BIT_MASK 0x1 /end MEASUREMENT
/begin MEASUREMENT egtr[0].egtr_struct_fctdgcefi0.lv_inh_diag_rbm_cat_diag "flag to inhibit rbm catalyst diagnosis dc incrementation if there is a component failure" UBYTE _CNV_A_R_LINEAR_____0_CM 1 100. 0. 1. DISPLAY_IDENTIFIER LV_INH_DIAG_RBM_CAT_DIAG[1] ECU_ADDRESS 0xd0005d9a FORMAT "%1.0" BIT_MASK 0x1 /end MEASUREMENT
/begin MEASUREMENT egtr[0].egtr_struct_fctdgtdlac0.temp_ldc_cat_diag_afl "Filtered modelled catalyst dynamic temperature" UWORD _CNV_A_R_LINEAR_____214_CM 1 100. -273.15 1774.7875 DISPLAY_IDENTIFIER TEMP_LDC_CAT_DIAG_AFL[1] ECU_ADDRESS 0xd0005d9c FORMAT "%9.4" /end MEASUREMENT
/begin MEASUREMENT egtr[0].egtr_struct_fctdgtdlac0.lv_o2l_clc_act_opp_tmp "Activation for diagnosis regarding operating point" UBYTE _CNV_A_R_LINEAR_____0_CM 1 100. 0. 1. DISPLAY_IDENTIFIER LV_O2L_CLC_ACT_OPP_TMP[1] ECU_ADDRESS 0xd0005d9e FORMAT "%1.0" BIT_MASK 0x1 /end MEASUREMENT
/begin MEASUREMENT egtr[0].egtr_struct_fctdgtdlac0.lv_o2l_clc_act_cdn "General activation flag for calculation of oxygen capacity" UBYTE _CNV_A_R_LINEAR_____0_CM 1 100. 0. 1. DISPLAY_IDENTIFIER LV_O2L_CLC_ACT_CDN[1] ECU_ADDRESS 0xd0005d9f FORMAT "%1.0" BIT_MASK 0x1 /end MEASUREMENT
/begin MEASUREMENT egtr[0].egtr_struct_fctdgtdlac0.lv_o2l_clc_act_tco_tmp "Activation for diagnosis regarding coolant temperature" UBYTE _CNV_A_R_LINEAR_____0_CM 1 100. 0. 1. DISPLAY_IDENTIFIER LV_O2L_CLC_ACT_TCO_TMP[1] ECU_ADDRESS 0xd0005da0 FORMAT "%1.0" BIT_MASK 0x1 /end MEASUREMENT
/begin MEASUREMENT egtr[0].egtr_struct_fctdgtdlac0.lv_o2l_clc_act_temp_tmp "Activation for diagnosis regarding TWC temperature" UBYTE _CNV_A_R_LINEAR_____0_CM 1 100. 0. 1. DISPLAY_IDENTIFIER LV_O2L_CLC_ACT_TEMP_TMP[1] ECU_ADDRESS 0xd0005da1 FORMAT "%1.0" BIT_MASK 0x1 /end MEASUREMENT
/begin MEASUREMENT egtr[0].egtr_struct_fctdgtdlac0.lv_o2l_clc_act_ldc_temp_tmp "Activation for diagnosis regarding TWC temperature limited dynamic" UBYTE _CNV_A_R_LINEAR_____0_CM 1 100. 0. 1. DISPLAY_IDENTIFIER LV_O2L_CLC_ACT_LDC_TEMP_TMP[1] ECU_ADDRESS 0xd0005da2 FORMAT "%1.0" BIT_MASK 0x1 /end MEASUREMENT
/begin MEASUREMENT egtr[0].egtr_struct_fctdgtdldd0.action_clcO2L_data_l_ampl.o2l_mv "Mean value of O2L values calculated in regenerations phase" UWORD _CNV_A_R_LINEAR_____812_CM 1 100. 0. 2.61684895833333 DISPLAY_IDENTIFIER O2L_L_AMPL_MV[1] ECU_ADDRESS 0xd0005da4 FORMAT "%7.5" /end MEASUREMENT
/begin MEASUREMENT egtr[0].egtr_struct_fctdgtdldd0.action_clcO2L_data_l_ampl.o2l_sum "Sum of O2L values calculated during regenerations phase" UWORD _CNV_A_R_EGTR_LINEA_828_CM 1 100. 0. 20.93479 DISPLAY_IDENTIFIER O2L_L_AMPL_SUM[1] ECU_ADDRESS 0xd0005da6 FORMAT "%7.4" /end MEASUREMENT
/begin MEASUREMENT egtr[0].egtr_struct_fctdgtdldd0.action_clcO2L_data_l_ampl.ctr_sum "Counter for calculation of mean value of O2L calculated in regeneration phases" UBYTE _CNV_A_R_LINEAR_____0_CM 1 100. 0. 255. DISPLAY_IDENTIFIER CTR_O2L_SUM_L_AMPL[1] ECU_ADDRESS 0xd0005da8 FORMAT "%3.0" /end MEASUREMENT
/begin MEASUREMENT egtr[0].egtr_struct_fctdgtdldd0.action_clcO2L_data_h_ampl.o2l_mv "Mean value of O2L values calculated in regenerations phase" UWORD _CNV_A_R_LINEAR_____812_CM 1 100. 0. 2.61684895833333 DISPLAY_IDENTIFIER O2L_H_AMPL_MV[1] ECU_ADDRESS 0xd0005daa FORMAT "%7.5" /end MEASUREMENT
/begin MEASUREMENT egtr[0].egtr_struct_fctdgtdldd0.action_clcO2L_data_h_ampl.o2l_sum "Sum of O2L values calculated during regenerations phase" UWORD _CNV_A_R_EGTR_LINEA_828_CM 1 100. 0. 20.93479 DISPLAY_IDENTIFIER O2L_H_AMPL_SUM[1] ECU_ADDRESS 0xd0005dac FORMAT "%7.4" /end MEASUREMENT
/begin MEASUREMENT egtr[0].egtr_struct_fctdgtdldd0.action_clcO2L_data_h_ampl.ctr_sum "Counter for calculation of mean value of O2L calculated in regeneration phases" UBYTE _CNV_A_R_LINEAR_____0_CM 1 100. 0. 255. DISPLAY_IDENTIFIER CTR_O2L_SUM_H_AMPL[1] ECU_ADDRESS 0xd0005dae FORMAT "%3.0" /end MEASUREMENT
/begin MEASUREMENT egtr[0].egtr_struct_fctdgtdldd0.action_clcO2L_data_park.o2l_mv "Mean value of O2L values calculated in regenerations phase" UWORD _CNV_A_R_LINEAR_____812_CM 1 100. 0. 2.61684895833333 DISPLAY_IDENTIFIER O2L_PARK_MV[1] ECU_ADDRESS 0xd0005db0 FORMAT "%7.5" /end MEASUREMENT
/begin MEASUREMENT egtr[0].egtr_struct_fctdgtdldd0.action_clcO2L_data_park.o2l_sum "Sum of O2L values calculated during regenerations phase" UWORD _CNV_A_R_EGTR_LINEA_828_CM 1 100. 0. 20.93479 DISPLAY_IDENTIFIER O2L_PARK_SUM[1] ECU_ADDRESS 0xd0005db2 FORMAT "%7.4" /end MEASUREMENT
/begin MEASUREMENT egtr[0].egtr_struct_fctdgtdldd0.action_clcO2L_data_park.ctr_sum "Counter for calculation of mean value of O2L calculated in regeneration phases" UBYTE _CNV_A_R_LINEAR_____0_CM 1 100. 0. 255. DISPLAY_IDENTIFIER CTR_O2L_SUM_PARK[1] ECU_ADDRESS 0xd0005db4 FORMAT "%3.0" /end MEASUREMENT
/begin MEASUREMENT egtr[0].egtr_struct_fctdgtdldd0.action_clcO2L_data_load.o2l_mv "Mean value of O2L values calculated in regenerations phase" UWORD _CNV_A_R_LINEAR_____812_CM 1 100. 0. 2.61684895833333 DISPLAY_IDENTIFIER O2L_LOAD_MV[1] ECU_ADDRESS 0xd0005db6 FORMAT "%7.5" /end MEASUREMENT
/begin MEASUREMENT egtr[0].egtr_struct_fctdgtdldd0.action_clcO2L_data_load.o2l_sum "Sum of O2L values calculated during regenerations phase" UWORD _CNV_A_R_EGTR_LINEA_828_CM 1 100. 0. 20.93479 DISPLAY_IDENTIFIER O2L_LOAD_SUM[1] ECU_ADDRESS 0xd0005db8 FORMAT "%7.4" /end MEASUREMENT
/begin MEASUREMENT egtr[0].egtr_struct_fctdgtdldd0.action_clcO2L_data_load.ctr_sum "Counter for calculation of mean value of O2L calculated in regeneration phases" UBYTE _CNV_A_R_LINEAR_____0_CM 1 100. 0. 255. DISPLAY_IDENTIFIER CTR_O2L_SUM_LOAD[1] ECU_ADDRESS 0xd0005dba FORMAT "%3.0" /end MEASUREMENT
/begin MEASUREMENT egtr[0].egtr_struct_fctdgtdldd0.o2l_cat_diag_afl "Finally O2L value for calculation of Error Symptom" UWORD _CNV_A_R_LINEAR_____812_CM 1 100. 0. 2.61684895833333 DISPLAY_IDENTIFIER O2L_CAT_DIAG_AFL[1] ECU_ADDRESS 0xd0005dbc FORMAT "%7.5" /end MEASUREMENT
/begin MEASUREMENT egtr[0].egtr_struct_fctdgtdldd0.o2l_delta_afr_cdn "Delta between O2L values calculated during H_AMPL and L_AMPL regeneration phase" UWORD _CNV_A_R_EGTR_LINEA_829_CM 1 100. -1.30844444444444 1.30840451388889 DISPLAY_IDENTIFIER O2L_DELTA_AFR_CDN[1] ECU_ADDRESS 0xd0005dbe FORMAT "%8.5" /end MEASUREMENT
/begin MEASUREMENT egtr[0].egtr_struct_fctdgtdldd0.o2l_afr_cdn_cor "Corrected O2L value with mathematic method" UWORD _CNV_A_R_LINEAR_____812_CM 1 100. 0. 2.61684895833333 DISPLAY_IDENTIFIER O2L_AFR_CDN_COR[1] ECU_ADDRESS 0xd0005dc0 FORMAT "%7.5" /end MEASUREMENT
/begin MEASUREMENT egtr[0].egtr_struct_fctdgtdldd0.o2l_afr_cdn_cor_mat "Corrected O2L value with empirical method" UWORD _CNV_A_R_LINEAR_____812_CM 1 100. 0. 2.61684895833333 DISPLAY_IDENTIFIER O2L_AFR_CDN_COR_MAT[1] ECU_ADDRESS 0xd0005dc2 FORMAT "%7.5" /end MEASUREMENT
/begin MEASUREMENT egtr[0].egtr_struct_fctdgtdldd0.o2l_afl_cdn_mat "Calculated O2L of PreCat in Lean Condition" UWORD _CNV_A_R_LINEAR_____812_CM 1 100. 0. 2.61684895833333 DISPLAY_IDENTIFIER O2L_AFL_CDN_MAT[1] ECU_ADDRESS 0xd0005dc4 FORMAT "%7.5" /end MEASUREMENT
/begin MEASUREMENT egtr[0].egtr_struct_fctdgtdldd0.o2l_sum_cat_diag_afl "Sum of O2L values of all phases for calculation of O2L_MMV_CAT_DIAG_AFL" UWORD _CNV_A_R_EGTR_LINEA_828_CM 1 100. 0. 20.93479 DISPLAY_IDENTIFIER O2L_SUM_CAT_DIAG_AFL[1] ECU_ADDRESS 0xd0005dc6 FORMAT "%7.4" /end MEASUREMENT
/begin MEASUREMENT egtr[0].egtr_struct_fctdgtdldd0.o2l_mmv_cat_diag_afl "Mean value of O2L values calculated in all phases" UWORD _CNV_A_R_LINEAR_____812_CM 1 100. 0. 2.61684895833333 DISPLAY_IDENTIFIER O2L_MMV_CAT_DIAG_AFL[1] ECU_ADDRESS 0xd0005dc8 FORMAT "%7.5" /end MEASUREMENT
/begin MEASUREMENT egtr[0].egtr_struct_fctdgtdldd0.fac_sum_o2l_mmv_tmp "Denominator for calculation of O2L_MMV_CAT_DIAG_AFL" UBYTE _CNV_A_R_LINEAR_____0_CM 1 100. 0. 255. DISPLAY_IDENTIFIER FAC_SUM_O2L_MMV_TMP[1] ECU_ADDRESS 0xd0005dca FORMAT "%3.0" /end MEASUREMENT
/begin MEASUREMENT egtr[0].egtr_struct_fctdgtdldd0.state_o2l_mv_clc_vld "Collected bits due to calculation of mean values at each phase" UBYTE _CNV_A_R_LINEAR_____0_CM 1 100. 0. 255. DISPLAY_IDENTIFIER STATE_O2L_MV_CLC_VLD[1] ECU_ADDRESS 0xd0005dcb FORMAT "%3.0" /end MEASUREMENT
/begin MEASUREMENT egtr[0].egtr_struct_fctdgtdldd0.lv_o2l_cat_diag_afl "Calculation of general O2L value was successful" UBYTE _CNV_A_R_LINEAR_____0_CM 1 100. 0. 1. DISPLAY_IDENTIFIER LV_O2L_CAT_DIAG_AFL[1] ECU_ADDRESS 0xd0005dcc FORMAT "%1.0" BIT_MASK 0x1 /end MEASUREMENT
/begin MEASUREMENT egtr[0].egtr_struct_fctdgtdldd0.lv_err_cat_diag_afl_tmp "Temporary present failure of diagnostic CAT_DIAG_AFL" UBYTE _CNV_A_R_LINEAR_____0_CM 1 100. 0. 1. DISPLAY_IDENTIFIER LV_ERR_CAT_DIAG_AFL_TMP[1] ECU_ADDRESS 0xd0005dcd FORMAT "%1.0" BIT_MASK 0x1 /end MEASUREMENT
/begin MEASUREMENT egtr[0].egtr_struct_fctdgtdldd0.lv_end_diag_afl_tmp "Temporary flag for end of the Diagnostic cycle without filtering" UBYTE _CNV_A_R_LINEAR_____0_CM 1 100. 0. 1. DISPLAY_IDENTIFIER LV_END_DIAG_AFL_TMP[1] ECU_ADDRESS 0xd0005dce FORMAT "%1.0" BIT_MASK 0x1 /end MEASUREMENT
/begin MEASUREMENT egtr[0].egtr_struct_fctdgtdldd0.lv_o2l_mv_clc_end "Calculation of mean values during diagnosis cycle has been done" UBYTE _CNV_A_R_LINEAR_____0_CM 1 100. 0. 1. DISPLAY_IDENTIFIER LV_O2L_MV_CLC_END[1] ECU_ADDRESS 0xd0005dcf FORMAT "%1.0" BIT_MASK 0x1 /end MEASUREMENT
/begin MEASUREMENT egtr[0].egtr_struct_fctdgtdlai0.lv_inh_diag_cat_diag_afl "Inhibition condition for the TWC lean diagnosis" UBYTE _CNV_A_R_LINEAR_____0_CM 1 100. 0. 1. DISPLAY_IDENTIFIER LV_INH_DIAG_CAT_DIAG_AFL[1] ECU_ADDRESS 0xd0005dd0 FORMAT "%1.0" BIT_MASK 0x1 /end MEASUREMENT
/begin MEASUREMENT egtr[0].egtr_struct_fctdgtdlai0.lv_diag_err_sum_diag_afl "Collected flag of errors of other relevant diagnosis" UBYTE _CNV_A_R_LINEAR_____0_CM 1 100. 0. 1. DISPLAY_IDENTIFIER LV_DIAG_ERR_SUM_DIAG_AFL[1] ECU_ADDRESS 0xd0005dd1 FORMAT "%1.0" BIT_MASK 0x1 /end MEASUREMENT
/begin MEASUREMENT egtr[0].egtr_struct_fctdgtdlai0.lv_diag_end_sum_diag_afl "Collected flag that other relevant diagnosis are finished" UBYTE _CNV_A_R_LINEAR_____0_CM 1 100. 0. 1. DISPLAY_IDENTIFIER LV_DIAG_END_SUM_DIAG_AFL[1] ECU_ADDRESS 0xd0005dd2 FORMAT "%1.0" BIT_MASK 0x1 /end MEASUREMENT
/begin MEASUREMENT egtr[0].egtr_struct_fctdgtdlai0.lv_err_qvm_1 "Inhibition condition for the TWC lean diagnosis" UBYTE _CNV_A_R_LINEAR_____0_CM 1 100. 0. 1. DISPLAY_IDENTIFIER LV_ERR_QVM_1 ECU_ADDRESS 0xd0005dd3 FORMAT "%1.0" BIT_MASK 0x1 /end MEASUREMENT
/begin MEASUREMENT egtr[0].egtr_struct_fctdgtdlai0.lv_err_qvm_2 "Inhibition condition for the TWC lean diagnosis" UBYTE _CNV_A_R_LINEAR_____0_CM 1 100. 0. 1. DISPLAY_IDENTIFIER LV_ERR_QVM_2 ECU_ADDRESS 0xd0005dd4 FORMAT "%1.0" BIT_MASK 0x1 /end MEASUREMENT
/begin MEASUREMENT egtr[0].egtr_struct_fctdgtdlai0.lv_err_qvm_3 "Inhibition condition for the TWC lean diagnosis" UBYTE _CNV_A_R_LINEAR_____0_CM 1 100. 0. 1. DISPLAY_IDENTIFIER LV_ERR_QVM_3 ECU_ADDRESS 0xd0005dd5 FORMAT "%1.0" BIT_MASK 0x1 /end MEASUREMENT
/begin MEASUREMENT egtr[0].egtr_struct_fctdgtdlai0.lv_err_qvm "QVM" UBYTE _CNV_A_R_LINEAR_____0_CM 1 100. 0. 1. DISPLAY_IDENTIFIER LV_ERR_QVM ECU_ADDRESS 0xd0005dd6 FORMAT "%1.0" BIT_MASK 0x1 /end MEASUREMENT
/begin MEASUREMENT egtr[0].egtr_struct_fctdgtdloc0.action_O2L_data_h_ampl.o2l_pha "Calculated O2L" UWORD _CNV_A_R_LINEAR_____812_CM 1 100. 0. 2.61684895833333 DISPLAY_IDENTIFIER O2L_RGN_H_AMPL_PHA[1] ECU_ADDRESS 0xd0005dd8 FORMAT "%7.5" /end MEASUREMENT
/begin MEASUREMENT egtr[0].egtr_struct_fctdgtdloc0.action_O2L_data_h_ampl.o2l_int_pha "Calculated O2L Integral" UWORD _CNV_A_R_LINEAR_____812_CM 1 100. 0. 2.61684895833333 DISPLAY_IDENTIFIER O2L_INT_RGN_H_AMPL_PHA[1] ECU_ADDRESS 0xd0005dda FORMAT "%7.5" /end MEASUREMENT
/begin MEASUREMENT egtr[0].egtr_struct_fctdgtdloc0.action_O2L_data_h_ampl.lv_o2l_clc "Flag for calculation of O2L" UBYTE _CNV_A_R_LINEAR_____0_CM 1 100. 0. 1. DISPLAY_IDENTIFIER LV_O2L_CLC_RGN_H_AMPL[1] ECU_ADDRESS 0xd0005ddd FORMAT "%1.0" BIT_MASK 0x1 /end MEASUREMENT
/begin MEASUREMENT egtr[0].egtr_struct_fctdgtdloc0.action_O2L_data_l_ampl.o2l_pha "Calculated O2L" UWORD _CNV_A_R_LINEAR_____812_CM 1 100. 0. 2.61684895833333 DISPLAY_IDENTIFIER O2L_RGN_L_AMPL_PHA[1] ECU_ADDRESS 0xd0005de0 FORMAT "%7.5" /end MEASUREMENT
/begin MEASUREMENT egtr[0].egtr_struct_fctdgtdloc0.action_O2L_data_l_ampl.o2l_int_pha "Calculated O2L Integral" UWORD _CNV_A_R_LINEAR_____812_CM 1 100. 0. 2.61684895833333 DISPLAY_IDENTIFIER O2L_INT_RGN_L_AMPL_PHA[1] ECU_ADDRESS 0xd0005de2 FORMAT "%7.5" /end MEASUREMENT
/begin MEASUREMENT egtr[0].egtr_struct_fctdgtdloc0.action_O2L_data_l_ampl.lv_o2l_clc "Flag for calculation of O2L" UBYTE _CNV_A_R_LINEAR_____0_CM 1 100. 0. 1. DISPLAY_IDENTIFIER LV_O2L_CLC_RGN_L_AMPL[1] ECU_ADDRESS 0xd0005de5 FORMAT "%1.0" BIT_MASK 0x1 /end MEASUREMENT
/begin MEASUREMENT egtr[0].egtr_struct_fctdgtdloc0.action_O2L_data_park.o2l_pha "Calculated O2L" UWORD _CNV_A_R_LINEAR_____812_CM 1 100. 0. 2.61684895833333 DISPLAY_IDENTIFIER O2L_PARK_PHA[1] ECU_ADDRESS 0xd0005de8 FORMAT "%7.5" /end MEASUREMENT
/begin MEASUREMENT egtr[0].egtr_struct_fctdgtdloc0.action_O2L_data_park.o2l_int_pha "Calculated O2L Integral" UWORD _CNV_A_R_LINEAR_____812_CM 1 100. 0. 2.61684895833333 DISPLAY_IDENTIFIER O2L_INT_PARK_PHA[1] ECU_ADDRESS 0xd0005dea FORMAT "%7.5" /end MEASUREMENT
/begin MEASUREMENT egtr[0].egtr_struct_fctdgtdloc0.action_O2L_data_park.lv_o2l_clc "Flag for calculation of O2L" UBYTE _CNV_A_R_LINEAR_____0_CM 1 100. 0. 1. DISPLAY_IDENTIFIER LV_O2L_CLC_PARK[1] ECU_ADDRESS 0xd0005ded FORMAT "%1.0" BIT_MASK 0x1 /end MEASUREMENT
/begin MEASUREMENT egtr[0].egtr_struct_fctdgtdloc0.action_O2L_data_load.o2l_pha "Calculated O2L" UWORD _CNV_A_R_LINEAR_____812_CM 1 100. 0. 2.61684895833333 DISPLAY_IDENTIFIER O2L_LOAD_PHA[1] ECU_ADDRESS 0xd0005df0 FORMAT "%7.5" /end MEASUREMENT
/begin MEASUREMENT egtr[0].egtr_struct_fctdgtdloc0.action_O2L_data_load.o2l_int_pha "Calculated O2L Integral" UWORD _CNV_A_R_LINEAR_____812_CM 1 100. 0. 2.61684895833333 DISPLAY_IDENTIFIER O2L_INT_LOAD_PHA[1] ECU_ADDRESS 0xd0005df2 FORMAT "%7.5" /end MEASUREMENT
/begin MEASUREMENT egtr[0].egtr_struct_fctdgtdloc0.action_O2L_data_load.lv_o2l_clc "Flag for calculation of O2L" UBYTE _CNV_A_R_LINEAR_____0_CM 1 100. 0. 1. DISPLAY_IDENTIFIER LV_O2L_CLC_LOAD[1] ECU_ADDRESS 0xd0005df5 FORMAT "%1.0" BIT_MASK 0x1 /end MEASUREMENT
/begin MEASUREMENT egtr[0].egtr_struct_fctdgtdloc0.state_o2l_clc_vld "Validation state for O2L integral calculation" UBYTE _CNV_A_R_LINEAR_____0_CM 1 100. 0. 255. DISPLAY_IDENTIFIER STATE_O2L_CLC_VLD[1] ECU_ADDRESS 0xd0005df8 FORMAT "%3.0" /end MEASUREMENT
/begin MEASUREMENT egtr[0].egtr_struct_fctdgtdloc0.t_afl_cdn_out "Timer for exit from state LEAN_CDN" UWORD _CNV_A_R_LINEAR_____3_CM 1 100. 0. 655.35 DISPLAY_IDENTIFIER T_AFL_CDN_OUT[1] ECU_ADDRESS 0xd0005dfa FORMAT "%6.2" /end MEASUREMENT
/begin MEASUREMENT egtr[0].egtr_struct_fctdgtdloc0.state_cat_diag_afl "OSC calculation state for TWC diagnosis at lean operation" UBYTE _CNV_S_4_RANGE_STAT_830_CM 1 100. 0. 3. DISPLAY_IDENTIFIER STATE_CAT_DIAG_AFL[1] ECU_ADDRESS 0xd0005dfc /end MEASUREMENT
/begin MEASUREMENT egtr[0].egtr_struct_fctdgtdloc0.state_o2l_clc_end "State for O2L calculation   calculation is finished" UBYTE _CNV_A_R_LINEAR_____0_CM 1 100. 0. 255. DISPLAY_IDENTIFIER STATE_O2L_CLC_END[1] ECU_ADDRESS 0xd0005dfd FORMAT "%3.0" /end MEASUREMENT
/begin MEASUREMENT egtr[0].egtr_struct_fctdgcefc0.eff_cat_diag "Catalyst diagnosis value in OSC range (only in case of NC_USE_EGTR = 0)" UBYTE _CNV_A_R_LINEAR_____103_CM 1 100. 0. 1.9921875 DISPLAY_IDENTIFIER EFF_CAT_DIAG[1] ECU_ADDRESS 0xd0005e00 FORMAT "%8.6" /end MEASUREMENT
/begin MEASUREMENT egtr[0].egtr_struct_defsptdlld0.lamb_sp_diag_afl "Lambda setpoint for precatalyst lean diagnosis" UWORD _CNV_A_R_LINEAR_____129_CM 1 100. 0. 31.9990234375 DISPLAY_IDENTIFIER LAMB_SP_DIAG_AFL[1] ECU_ADDRESS 0xd0005e02 FORMAT "%7.4" /end MEASUREMENT
/begin MEASUREMENT egtr[0].egtr_struct_defsptdlld0.state_rgn_cat_diag_afl "State for the calculation of lean TWC diagnosis due to state of system regeneration" UBYTE _CNV_A_R_LINEAR_____0_CM 1 100. 0. 3. DISPLAY_IDENTIFIER STATE_RGN_CAT_DIAG_AFL[1] ECU_ADDRESS 0xd0005e04 FORMAT "%3.0" /end MEASUREMENT
/begin MEASUREMENT egtr[0].egtr_struct_defsptdlld0.lv_lamb_sp_diag_afl_park "Indicator of lambda value position at park state " UBYTE _CNV_S_2_RANGE__0___1_CM 1 100. 0. 1. DISPLAY_IDENTIFIER LV_LAMB_SP_DIAG_AFL_PARK[1] ECU_ADDRESS 0xd0005e05 BIT_MASK 0x1 /end MEASUREMENT
/begin MEASUREMENT egtr[1].egtr_struct_defspfstic0.lamb_pls "Lambda deviation for the lambda controller (only in case of NC_USE_EGTR = 0)" SWORD _CNV_A_R_LINEAR_____24_CM 1 100. -0.125 0.1249389 DISPLAY_IDENTIFIER LAMB_PLS[2] ECU_ADDRESS 0xd0005e08 FORMAT "%8.5" /end MEASUREMENT
/begin MEASUREMENT egtr[1].egtr_struct_defspfstic0.lv_lamb_pls_afl_cor_act "Flag indicating that corrective action for lean half wave of lambda stimulation is active" UBYTE _CNV_S_2_RANGE__0___1_CM 1 100. 0. 1. DISPLAY_IDENTIFIER LV_LAMB_PLS_AFL_COR_ACT[2] ECU_ADDRESS 0xd0005e0a BIT_MASK 0x1 /end MEASUREMENT
/begin MEASUREMENT egtr[1].egtr_struct_defspfstic0.lv_lamb_pls_afr_cor_act "Flag indicating that corrective action for rich half wave of lambda stimulation is active" UBYTE _CNV_S_2_RANGE__0___1_CM 1 100. 0. 1. DISPLAY_IDENTIFIER LV_LAMB_PLS_AFR_COR_ACT[2] ECU_ADDRESS 0xd0005e0b BIT_MASK 0x1 /end MEASUREMENT
/begin MEASUREMENT egtr[1].egtr_struct_defspfstia0.maf_int_lamb_pls_act "Air mass flow integral for forced lambda stimulation activation" UWORD _CNV_A_R_CYBL_LINEA_135_CM 1 100. 0. 1456.33 DISPLAY_IDENTIFIER MAF_INT_LAMB_PLS_ACT[2] ECU_ADDRESS 0xd0005e0c FORMAT "%11.6" /end MEASUREMENT
/begin MEASUREMENT egtr[1].egtr_struct_defspfstia0.lv_lamb_pls_act "Flag indicating that forced lambda stimulation is active" UBYTE _CNV_S_2_RANGE__0___1_CM 1 100. 0. 1. DISPLAY_IDENTIFIER LV_LAMB_PLS_ACT[2] ECU_ADDRESS 0xd0005e0e BIT_MASK 0x1 /end MEASUREMENT
/begin MEASUREMENT egtr[1].egtr_struct_defspfstia0.lv_lamb_pls_diag_lsh_up "Flag indicating that requested exaggerated forced lambda stimulation is active" UBYTE _CNV_S_2_RANGE__0___1_CM 1 100. 0. 1. DISPLAY_IDENTIFIER LV_LAMB_PLS_DIAG_LSH_UP[2] ECU_ADDRESS 0xd0005e0f BIT_MASK 0x1 /end MEASUREMENT
/begin MEASUREMENT egtr[1].egtr_struct_defspfstia0.lv_lamb_pls_act_cat_purge "Flag that indicates that the forced stimulation can be activated due to cat purge" UBYTE _CNV_S_2_RANGE__0___1_CM 1 100. 0. 1. DISPLAY_IDENTIFIER LV_LAMB_PLS_ACT_CAT_PURGE[2] ECU_ADDRESS 0xd0005e10 BIT_MASK 0x1 /end MEASUREMENT
/begin MEASUREMENT egtr[1].egtr_struct_defspfsti0.o2l_add_lamb_pls "O2 load to be added to the O2 load integral each sample step" SLONG _CNV_A_R_EGTR_LINEA_819_CM 1 100. -669.923556 669.923555 DISPLAY_IDENTIFIER O2L_ADD_LAMB_PLS[2] ECU_ADDRESS 0xd0005e14 FORMAT "%11.6" /end MEASUREMENT
/begin MEASUREMENT egtr[1].egtr_struct_defspfsti0.o2l_lamb_pls "Current O2 loading or release for forced lambda stimulation" SLONG _CNV_A_R_EGTR_LINEA_819_CM 1 100. -669.923556 669.923555 DISPLAY_IDENTIFIER O2L_LAMB_PLS[2] ECU_ADDRESS 0xd0005e18 FORMAT "%11.6" /end MEASUREMENT
/begin MEASUREMENT egtr[1].egtr_struct_defspfsti0.o2l_sp_new_lamb_pls "O2 loading set point that is realized by forced lambda stimulation" UWORD _CNV_A_R_LINEAR_____812_CM 1 100. 0. 2.61684895833333 DISPLAY_IDENTIFIER O2L_SP_NEW_LAMB_PLS[2] ECU_ADDRESS 0xd0005e1c FORMAT "%7.5" /end MEASUREMENT
/begin MEASUREMENT egtr[1].egtr_struct_defspfsti0.lamb_pls_o2l_osc "Lambda set point deviation based on forced stimulation O2 balancing" SWORD _CNV_A_R_LINEAR_____24_CM 1 100. -0.125 0.12493 DISPLAY_IDENTIFIER LAMB_PLS_O2L_OSC[2] ECU_ADDRESS 0xd0005e1e FORMAT "%8.5" /end MEASUREMENT
/begin MEASUREMENT egtr[1].egtr_struct_defspfsti0.fac_o2l_lamb_pls "Temporary factor for O2 loading calculation considering the lambda set point deviation" SWORD _CNV_A_R_EGTR_LINEA_820_CM 1 100. -0.25 0.249992 DISPLAY_IDENTIFIER FAC_O2L_LAMB_PLS[2] ECU_ADDRESS 0xd0005e20 FORMAT "%9.6" /end MEASUREMENT
/begin MEASUREMENT egtr[1].egtr_struct_defspfsti0.o2l_sp_half_lamb_pls "Auxiliary value; half O2 loading set point of forced lambda stimulation" UWORD _CNV_A_R_LINEAR_____812_CM 1 100. 0. 2.61684895833333 DISPLAY_IDENTIFIER O2L_SP_HALF_LAMB_PLS[2] ECU_ADDRESS 0xd0005e22 FORMAT "%7.5" /end MEASUREMENT
/begin MEASUREMENT egtr[1].egtr_struct_defspfsti0.state_lamb_pls "State of forced lambda stimulation" UBYTE _CNV_S_3_EGTR_RANGE_821_CM 1 100. 0. 2. DISPLAY_IDENTIFIER STATE_LAMB_PLS[2] ECU_ADDRESS 0xd0005e24 /end MEASUREMENT
/begin MEASUREMENT egtr[1].egtr_struct_defspfsti0.lv_lamb_pls_o2l_osc_pos "Auxiliary flag indicating positive lambda stimulation half wave" UBYTE _CNV_S_2_RANGE__0___1_CM 1 100. 0. 1. DISPLAY_IDENTIFIER LV_LAMB_PLS_O2L_OSC_POS[2] ECU_ADDRESS 0xd0005e25 BIT_MASK 0x1 /end MEASUREMENT
/begin MEASUREMENT egtr[1].egtr_struct_defspfsti0.lv_lamb_pls_mst_cbk "Auxiliary flag indicating that this bank is master bank for forced stimulation" UBYTE _CNV_S_2_RANGE__0___1_CM 1 100. 0. 1. DISPLAY_IDENTIFIER LV_LAMB_PLS_MST_CBK[2] ECU_ADDRESS 0xd0005e26 BIT_MASK 0x1 /end MEASUREMENT
/begin MEASUREMENT egtr[1].egtr_struct_defspcenrc0.lamb_sp_delta_cat_purge "Lambda set point shift of cat purge function" UWORD _CNV_A_R_LINEAR_____24_CM 1 100. 0. 0.24992 DISPLAY_IDENTIFIER LAMB_SP_DELTA_CAT_PURGE[2] ECU_ADDRESS 0xd0005e28 FORMAT "%7.5" /end MEASUREMENT
/begin MEASUREMENT egtr[1].egtr_struct_defspfstii0.lv_inh_lamb_pls "Inhibition flag for forced lambda stimulation" UBYTE _CNV_S_2_RANGE__0___1_CM 1 100. 0. 1. DISPLAY_IDENTIFIER LV_INH_LAMB_PLS[2] ECU_ADDRESS 0xd0005e2a BIT_MASK 0x1 /end MEASUREMENT
/begin MEASUREMENT egtr[1].egtr_struct_defspcenr0.o2l_rls_pcat_purge "Oxygen loading to be released for pre cat purge" SLONG _CNV_A_R_EGTR_LINEA_819_CM 1 100. -669.923556 669.923555 DISPLAY_IDENTIFIER O2L_RLS_PCAT_PURGE[2] ECU_ADDRESS 0xd0005e2c FORMAT "%11.6" /end MEASUREMENT
/begin MEASUREMENT egtr[1].egtr_struct_defspcenr0.o2l_rls_tot_cat_purge "Total oxygen loading to be released for pre and main cat purge" SLONG _CNV_A_R_EGTR_LINEA_819_CM 1 100. -669.923556 669.923555 DISPLAY_IDENTIFIER O2L_RLS_TOT_CAT_PURGE[2] ECU_ADDRESS 0xd0005e30 FORMAT "%11.6" /end MEASUREMENT
/begin MEASUREMENT egtr[1].egtr_struct_defspcenr0.o2l_rls_rest_cat_purge "Estimated rest oxygen loading to be released for pre and main cat purge" SLONG _CNV_A_R_EGTR_LINEA_819_CM 1 100. -669.923556 669.923555 DISPLAY_IDENTIFIER O2L_RLS_REST_CAT_PURGE[2] ECU_ADDRESS 0xd0005e34 FORMAT "%11.6" /end MEASUREMENT
/begin MEASUREMENT egtr[1].egtr_struct_defspcenr0.o2l_rls_add_cat_purge "Oxygen loading to be added each sample step for cat purge air mass flow integral" SLONG _CNV_A_R_EGTR_LINEA_819_CM 1 100. -669.923556 669.923555 DISPLAY_IDENTIFIER O2L_RLS_ADD_CAT_PURGE[2] ECU_ADDRESS 0xd0005e38 FORMAT "%11.6" /end MEASUREMENT
/begin MEASUREMENT egtr[1].egtr_struct_defspcenr0.o2l_rls_main_cat_purge "Oxygen loading to be released for main cat purge" SLONG _CNV_A_R_EGTR_LINEA_819_CM 1 100. -669.923556 669.923555 DISPLAY_IDENTIFIER O2L_RLS_MAIN_CAT_PURGE[2] ECU_ADDRESS 0xd0005e3c FORMAT "%11.6" /end MEASUREMENT
/begin MEASUREMENT egtr[1].egtr_struct_defspcenr0.lamb_sp_delta_it_cat_purge "Lambda set point shift of cat purge function (internal value)" UWORD _CNV_A_R_LINEAR_____24_CM 1 100. 0. 0.24992 DISPLAY_IDENTIFIER LAMB_SP_DELTA_IT_CAT_PURGE[2] ECU_ADDRESS 0xd0005e40 FORMAT "%7.5" /end MEASUREMENT
/begin MEASUREMENT egtr[1].egtr_struct_defspcenr0.fac_o2l_rls_cat_purge "Temporary factor for O2 loading release calculation considering the lambda set point deviation" SWORD _CNV_A_R_EGTR_LINEA_820_CM 1 100. -0.25 0.249992 DISPLAY_IDENTIFIER FAC_O2L_RLS_CAT_PURGE[2] ECU_ADDRESS 0xd0005e42 FORMAT "%9.6" /end MEASUREMENT
/begin MEASUREMENT egtr[1].egtr_struct_defspcenr0.ratio_o2l_rls_cat_purge "Quotient used by cat purge: current rest oxygen loading / total oxygen loading" UBYTE _CNV_A_R_LINEAR_____28_CM 1 100. 0. 0.99609375 DISPLAY_IDENTIFIER RATIO_O2L_RLS_CAT_PURGE[2] ECU_ADDRESS 0xd0005e44 FORMAT "%5.3" /end MEASUREMENT
/begin MEASUREMENT egtr[1].egtr_struct_defspcenr0.lv_cat_purge_act "Flag indicating that cat purge function is active" UBYTE _CNV_S_2_RANGE__0___1_CM 1 100. 0. 1. DISPLAY_IDENTIFIER LV_CAT_PURGE_ACT[2] ECU_ADDRESS 0xd0005e45 BIT_MASK 0x1 /end MEASUREMENT
/begin MEASUREMENT egtr[1].egtr_struct_defspcenr0.lv_vls_down_act_cat_purge "Flag indicating that downstream signal is/was below calibration threshold" UBYTE _CNV_S_2_RANGE__0___1_CM 1 100. 0. 1. DISPLAY_IDENTIFIER LV_VLS_DOWN_ACT_CAT_PURGE[2] ECU_ADDRESS 0xd0005e46 BIT_MASK 0x1 /end MEASUREMENT
/begin MEASUREMENT egtr[1].egtr_struct_defspcenr0.lv_cat_purge_main_cat "Flag indicating that cat purge for main cat is active" UBYTE _CNV_S_2_RANGE__0___1_CM 1 100. 0. 1. DISPLAY_IDENTIFIER LV_CAT_PURGE_MAIN_CAT[2] ECU_ADDRESS 0xd0005e47 BIT_MASK 0x1 /end MEASUREMENT
/begin MEASUREMENT egtr[1].egtr_struct_defspcenr0.lv_cat_purge_pcat "Flag indicating that cat purge for pre cat is active" UBYTE _CNV_S_2_RANGE__0___1_CM 1 100. 0. 1. DISPLAY_IDENTIFIER LV_CAT_PURGE_PCAT[2] ECU_ADDRESS 0xd0005e48 BIT_MASK 0x1 /end MEASUREMENT
/begin MEASUREMENT egtr[1].egtr_struct_defspcenrd0.o2l_rls_sp_pcat_purge "Oxygen loading to be purged (released) during pre cat purge" UWORD _CNV_A_R_LINEAR_____812_CM 1 100. 0. 2.61684895833333 DISPLAY_IDENTIFIER O2L_RLS_SP_PCAT_PURGE[2] ECU_ADDRESS 0xd0005e4c FORMAT "%7.5" /end MEASUREMENT
/begin MEASUREMENT egtr[1].egtr_struct_defspcenrd0.fac_add_main_cat_purge "Additional weighting factor for pre and main cat differences" UBYTE _CNV_A_R_LINEAR_____103_CM 1 100. 0. 1.9921875 DISPLAY_IDENTIFIER FAC_ADD_MAIN_CAT_PURGE[2] ECU_ADDRESS 0xd0005e4e FORMAT "%8.6" /end MEASUREMENT
/begin MEASUREMENT egtr[1].egtr_struct_defspcenrd0.state_cat_purge "State indicating the activation reason of cat purge" UBYTE _CNV_S_6_EGTR_RANGE_822_CM 1 100. 0. 5. DISPLAY_IDENTIFIER STATE_CAT_PURGE[2] ECU_ADDRESS 0xd0005e4f /end MEASUREMENT
/begin MEASUREMENT egtr[1].egtr_struct_defspcenrd0.lv_cat_purge_post_puc_trig "Auxiliary flag indicating that cat purge after PUC was triggered" UBYTE _CNV_S_2_RANGE__0___1_CM 1 100. 0. 1. DISPLAY_IDENTIFIER LV_CAT_PURGE_POST_PUC_TRIG[2] ECU_ADDRESS 0xd0005e50 BIT_MASK 0x1 /end MEASUREMENT
/begin MEASUREMENT egtr[1].egtr_struct_defspcenrd0.lv_cat_purge_st "Flag indicating that cat purge can be started (set for one sample step)" UBYTE _CNV_S_2_RANGE__0___1_CM 1 100. 0. 1. DISPLAY_IDENTIFIER LV_CAT_PURGE_ST[2] ECU_ADDRESS 0xd0005e51 BIT_MASK 0x1 /end MEASUREMENT
/begin MEASUREMENT egtr[1].egtr_struct_defspcenri0.temp_main_cat_purge "Catalyst temperature of main cat for cat purge function" UWORD _CNV_A_R_LINEAR_____214_CM 1 100. -273.15 1774.7875 DISPLAY_IDENTIFIER TEMP_MAIN_CAT_PURGE[2] ECU_ADDRESS 0xd0005e52 FORMAT "%9.4" /end MEASUREMENT
/begin MEASUREMENT egtr[1].egtr_struct_defspcenri0.lamb_sp_delta_add_cat_purge "Additional lambda set point shift for cat purge output" UWORD _CNV_A_R_LINEAR_____24_CM 1 100. 0. 0.24993896484375 DISPLAY_IDENTIFIER LAMB_SP_DELTA_ADD_CAT_PURGE[2] ECU_ADDRESS 0xd0005e54 FORMAT "%7.5" /end MEASUREMENT
/begin MEASUREMENT egtr[1].egtr_struct_defspcenri0.lv_inh_cat_purge "Inhibition flag for cat purge function" UBYTE _CNV_S_2_RANGE__0___1_CM 1 100. 0. 1. DISPLAY_IDENTIFIER LV_INH_CAT_PURGE[2] ECU_ADDRESS 0xd0005e56 BIT_MASK 0x1 /end MEASUREMENT
/begin MEASUREMENT egtr[1].egtr_struct_fctdgcefld0.fac_lam_mv_delta_cat_ldc "difference between filtered and not filtered fac_lam_mv[i] for lambda limited dynamic" SWORD _CNV_A_R_LINEAR_____113_CM 1 100. -50. 49.9984741210938 DISPLAY_IDENTIFIER FAC_LAM_MV_DELTA_CAT_LDC[2] ECU_ADDRESS 0xd0005e58 FORMAT "%7.3" /end MEASUREMENT
/begin MEASUREMENT egtr[1].egtr_struct_fctdgcefld0.maf_int_cat_ldc "integral of mass air flow since limited dynamic conditions fulfilled" UWORD _CNV_A_R_CYBL_LINEA_135_CM 1 100. 0. 1456.33 DISPLAY_IDENTIFIER MAF_INT_CAT_LDC[2] ECU_ADDRESS 0xd0005e5a FORMAT "%11.6" /end MEASUREMENT
/begin MEASUREMENT egtr[1].egtr_struct_fctdgcefld0.lv_cat_ldc "status of limited dynamics for catalyst efficiency diagnosis" UBYTE _CNV_S_2_RANGE__0___1_CM 1 100. 0. 1. DISPLAY_IDENTIFIER LV_CAT_LDC[2] ECU_ADDRESS 0xd0005e5c BIT_MASK 0x1 /end MEASUREMENT
/begin MEASUREMENT egtr[1].egtr_struct_fctdgcefld0.lv_fac_lam_cat_ldc "status limited dynamic fac_lam_mv[nc_cbk_ex_nr]" UBYTE _CNV_S_2_RANGE__0___1_CM 1 100. 0. 1. DISPLAY_IDENTIFIER LV_FAC_LAM_CAT_LDC[2] ECU_ADDRESS 0xd0005e5d BIT_MASK 0x1 /end MEASUREMENT
/begin MEASUREMENT egtr[1].egtr_struct_fctdgcefif0.eff_cat_diag_obd "cat. diag. value for obd scantool mod 6 output" UBYTE _CNV_A_R_LINEAR_____103_CM 1 100. 0. 1.9921875 DISPLAY_IDENTIFIER EFF_CAT_DIAG_OBD[2] ECU_ADDRESS 0xd0005e5e FORMAT "%8.6" /end MEASUREMENT
/begin MEASUREMENT egtr[1].egtr_struct_fctdgcefif0.eff_cat_max_diag_obd "actually threshold for scantool mod 6 output" UBYTE _CNV_A_R_LINEAR_____103_CM 1 100. 0. 1.9921875 DISPLAY_IDENTIFIER EFF_CAT_MAX_DIAG_OBD[2] ECU_ADDRESS 0xd0005e5f FORMAT "%8.6" /end MEASUREMENT
/begin MEASUREMENT egtr[1].egtr_struct_fctdgcefif0.lv_cdn_diag_cat_diag "Flag condition for catalyst diagnosis active" UBYTE _CNV_S_2_RANGE__0___1_CM 1 100. 0. 1. DISPLAY_IDENTIFIER LV_CDN_DIAG_CAT_DIAG[2] ECU_ADDRESS 0xd0005e60 BIT_MASK 0x1 /end MEASUREMENT
/begin MEASUREMENT egtr[1].egtr_struct_fctdgcefif0.lv_end_diag_cat_diag "flag catalyst diagnosis finished for that driving cycle" UBYTE _CNV_S_2_RANGE__0___1_CM 1 100. 0. 1. DISPLAY_IDENTIFIER LV_END_DIAG_CAT_DIAG[2] ECU_ADDRESS 0xd0005e61 BIT_MASK 0x1 /end MEASUREMENT
/begin MEASUREMENT egtr[1].egtr_struct_fctdgcefif0.lv_err_cat_diag "Present failure catalyst efficiency" UBYTE _CNV_S_2_RANGE__0___1_CM 1 100. 0. 1. DISPLAY_IDENTIFIER LV_ERR_CAT_DIAG[2] ECU_ADDRESS 0xd0005e62 BIT_MASK 0x1 /end MEASUREMENT
/begin MEASUREMENT egtr[1].egtr_struct_fctdgcefac0.maf_int_dly_cat_diag "Air mass flow integral after conditions are fulfilled for catalyst diagnosis activation" UWORD _CNV_A_R_CYBL_LINEA_135_CM 1 100. 0. 1456.33 DISPLAY_IDENTIFIER MAF_INT_DLY_CAT_DIAG[2] ECU_ADDRESS 0xd0005e64 FORMAT "%11.6" /end MEASUREMENT
/begin MEASUREMENT egtr[1].egtr_struct_fctdgcefac0.lv_cat_diag_cdn_act "Activation condition for O2 sensor and catalyst efficiency diagnosis (OSC-method)" UBYTE _CNV_S_2_RANGE__0___1_CM 1 100. 0. 1. DISPLAY_IDENTIFIER LV_CAT_DIAG_CDN_ACT[2] ECU_ADDRESS 0xd0005e66 BIT_MASK 0x1 /end MEASUREMENT
/begin MEASUREMENT egtr[1].egtr_struct_fctdgcef0.ratio_mass_o2_cat_dif_sum "summation of mass_o2_cat_dif_ratio[i] over all valid monitoring cycles" ULONG _CNV_A_R_EGTR_LINEA_823_CM 1 100. 0. 131072. DISPLAY_IDENTIFIER RATIO_MASS_O2_CAT_DIF_SUM[2] ECU_ADDRESS 0xd0005e68 FORMAT "%14.7" /end MEASUREMENT
/begin MEASUREMENT egtr[1].egtr_struct_fctdgcef0.lamb_cat_down_sum "integral of downstream lambda through 1 diagnosis period for calculation of mean value" ULONG _CNV_A_R_EGTR_LINEA_823_CM 1 100. 0. 131072. DISPLAY_IDENTIFIER LAMB_CAT_DOWN_SUM[2] ECU_ADDRESS 0xd0005e6c FORMAT "%14.7" /end MEASUREMENT
/begin MEASUREMENT egtr[1].egtr_struct_fctdgcef0.ratio_mass_o2_cat_dif "weighted mass_o2_cat_dif_cyc[i] value related to o2-load upstream catalyst from lambda controller" UWORD _CNV_A_R_LINEAR_____9_CM 1 100. 0. 1.99996948242188 DISPLAY_IDENTIFIER RATIO_MASS_O2_CAT_DIF[2] ECU_ADDRESS 0xd0005e70 FORMAT "%7.5" /end MEASUREMENT
/begin MEASUREMENT egtr[1].egtr_struct_fctdgcef0.mass_o2_cat_dif_cyc "mass o2 downsteam catalyst to mean value through 1 diagnosis period" UWORD _CNV_A_R_EGTR_LINEA_824_CM 1 100. 0. 8.17765e-002 DISPLAY_IDENTIFIER MASS_O2_CAT_DIF_CYC[2] ECU_ADDRESS 0xd0005e72 FORMAT "%10.8" /end MEASUREMENT
/begin MEASUREMENT egtr[1].egtr_struct_fctdgcef0.lamb_cat_down_mv "downstream lambda mean value for complete diagnosis period" UWORD _CNV_A_R_LINEAR_____9_CM 1 100. 0. 1.99996948242188 DISPLAY_IDENTIFIER LAMB_CAT_DOWN_MV[2] ECU_ADDRESS 0xd0005e74 FORMAT "%7.5" /end MEASUREMENT
/begin MEASUREMENT egtr[1].egtr_struct_fctdgcef0.lamb_cat_down_st_cyc "lamb_cat_down[i] value at start of monitoring cycle" UWORD _CNV_A_R_LINEAR_____9_CM 1 100. 0. 1.99996948242188 DISPLAY_IDENTIFIER LAMB_CAT_DOWN_ST_CYC[2] ECU_ADDRESS 0xd0005e76 FORMAT "%7.5" /end MEASUREMENT
/begin MEASUREMENT egtr[1].egtr_struct_fctdgcef0.lamb_cat_down "lambda downstream of catalyst; linearization of downstream ls signal" UWORD _CNV_A_R_LINEAR_____9_CM 1 100. 0. 1.99996948242188 DISPLAY_IDENTIFIER LAMB_CAT_DOWN[2] ECU_ADDRESS 0xd0005e78 FORMAT "%7.5" /end MEASUREMENT
/begin MEASUREMENT egtr[1].egtr_struct_fctdgcef0.flow_o2_cat_dif "downstream O2 flow difference to mean value" UWORD _CNV_A_R_EGTR_LINEA_825_CM 1 100. 0. 2.04441325e-003 DISPLAY_IDENTIFIER FLOW_O2_CAT_DIF[2] ECU_ADDRESS 0xd0005e7a FORMAT "%10.8" /end MEASUREMENT
/begin MEASUREMENT egtr[1].egtr_struct_fctdgcef0.ctr_cat_diag "monitoring cycle counter" UWORD _CNV_A_R_LINEAR_____0_CM 1 100. 0. 511. DISPLAY_IDENTIFIER CTR_CAT_DIAG[2] ECU_ADDRESS 0xd0005e7c FORMAT "%5.0" /end MEASUREMENT
/begin MEASUREMENT egtr[1].egtr_struct_fctdgcef0.ctr_lamb_cat_down_sum "Counter for the summation of LAMB_CAT_DOWN_SUM for each period" UWORD _CNV_A_R_LINEAR_____0_CM 1 100. 0. 65535. DISPLAY_IDENTIFIER CTR_LAMB_CAT_DOWN_SUM[2] ECU_ADDRESS 0xd0005e7e FORMAT "%5.0" /end MEASUREMENT
/begin MEASUREMENT egtr[1].egtr_struct_fctdgcef0.ctr_lamb_out_cat_diag "counter of non valid cycle due to lamb_cat_down_mv[i] is not in right range, for switch off cat diag" UBYTE _CNV_A_R_LINEAR_____0_CM 1 100. 0. 255. DISPLAY_IDENTIFIER CTR_LAMB_OUT_CAT_DIAG[2] ECU_ADDRESS 0xd0005e80 FORMAT "%3.0" /end MEASUREMENT
/begin MEASUREMENT egtr[1].egtr_struct_fctdgcef0.ctr_tot_cat_diag "total sum of all completed diagnosis cycles since ecu programming" UBYTE _CNV_A_R_LINEAR_____0_CM 1 100. 0. 255. DISPLAY_IDENTIFIER CTR_TOT_CAT_DIAG[2] ECU_ADDRESS 0xd0005e81 FORMAT "%3.0" /end MEASUREMENT
/begin MEASUREMENT egtr[1].egtr_struct_fctdgcef0.eff_cat_diag_hom "Catalyst diagnosis value in OSC range (from lambda=1 cat diag )" UBYTE _CNV_A_R_LINEAR_____103_CM 1 100. 0. 1.9921875 DISPLAY_IDENTIFIER EFF_CAT_DIAG_HOM[2] ECU_ADDRESS 0xd0005e82 FORMAT "%8.6" /end MEASUREMENT
/begin MEASUREMENT egtr[1].egtr_struct_fctdgcef0.temp_cat_dif_dyn_stat "temperature difference between dynamic and stationary catalyst temperature (from cat. temperature model)" UBYTE _CNV_A_R_EGTR_LINEA_826_CM 1 100. -256. 254. DISPLAY_IDENTIFIER TEMP_CAT_DIF_DYN_STAT[2] ECU_ADDRESS 0xd0005e83 FORMAT "%4.0" /end MEASUREMENT
/begin MEASUREMENT egtr[1].egtr_struct_fctdgcef0.state_cat_diag "state of diagnosis" UBYTE _CNV_S_6_EGTR_RANGE_827_CM 1 100. 0. 5. DISPLAY_IDENTIFIER STATE_CAT_DIAG[2] ECU_ADDRESS 0xd0005e84 /end MEASUREMENT
/begin MEASUREMENT egtr[1].egtr_struct_fctdgcef0.state_cat_diag_cyc_vld "Summary validity bits, current monitoring cycle valid and involved in calculation of diagnosis value; 1H = 1CROSS; 2H = MVDEL; 4H = 2CROSS; 8H = DIFMV; 10H = RANGE; 20H = TEMP" UBYTE _CNV_A_R_LINEAR_____0_CM 1 100. 0. 63. DISPLAY_IDENTIFIER STATE_CAT_DIAG_CYC_VLD[2] ECU_ADDRESS 0xd0005e85 FORMAT "%3.0" /end MEASUREMENT
/begin MEASUREMENT egtr[1].egtr_struct_fctdgcef0.lv_lamb_pls_req_cat_diag "flag to switch forced stimulation parameters for osc/nox cat. diagnosis" UBYTE _CNV_S_2_RANGE__0___1_CM 1 100. 0. 1. DISPLAY_IDENTIFIER LV_LAMB_PLS_REQ_CAT_DIAG[2] ECU_ADDRESS 0xd0005e86 BIT_MASK 0x1 /end MEASUREMENT
/begin MEASUREMENT egtr[1].egtr_struct_fctdgcef0.lv_lam_adj_cat_diag "Flag to switch trim control parameters for OSC/NOX Cat. Diagnosis (only in case of NC_USE_EGTR = 0)" UBYTE _CNV_S_2_RANGE__0___1_CM 1 100. 0. 1. DISPLAY_IDENTIFIER LV_LAM_ADJ_CAT_DIAG[2] ECU_ADDRESS 0xd0005e87 BIT_MASK 0x1 /end MEASUREMENT
/begin MEASUREMENT egtr[1].egtr_struct_fctdgcefi0.state_rbm_cat "interface of monitor cat_diag for the rate based monitoring statistics" UBYTE _CNV_A_R_LINEAR_____0_CM 1 100. 0. 15. DISPLAY_IDENTIFIER STATE_RBM_CAT[2] ECU_ADDRESS 0xd0005e88 FORMAT "%3.0" /end MEASUREMENT
/begin MEASUREMENT egtr[1].egtr_struct_fctdgcefi0.lv_inh_diag_cat_diag "flag to inhibit catalyst diagnosis function if there is a component failure" UBYTE _CNV_A_R_LINEAR_____0_CM 1 100. 0. 1. DISPLAY_IDENTIFIER LV_INH_DIAG_CAT_DIAG[2] ECU_ADDRESS 0xd0005e89 FORMAT "%1.0" BIT_MASK 0x1 /end MEASUREMENT
/begin MEASUREMENT egtr[1].egtr_struct_fctdgcefi0.lv_inh_diag_rbm_cat_diag "flag to inhibit rbm catalyst diagnosis dc incrementation if there is a component failure" UBYTE _CNV_A_R_LINEAR_____0_CM 1 100. 0. 1. DISPLAY_IDENTIFIER LV_INH_DIAG_RBM_CAT_DIAG[2] ECU_ADDRESS 0xd0005e8a FORMAT "%1.0" BIT_MASK 0x1 /end MEASUREMENT
/begin MEASUREMENT egtr[1].egtr_struct_fctdgtdlac0.temp_ldc_cat_diag_afl "Filtered modelled catalyst dynamic temperature" UWORD _CNV_A_R_LINEAR_____214_CM 1 100. -273.15 1774.7875 DISPLAY_IDENTIFIER TEMP_LDC_CAT_DIAG_AFL[2] ECU_ADDRESS 0xd0005e8c FORMAT "%9.4" /end MEASUREMENT
/begin MEASUREMENT egtr[1].egtr_struct_fctdgtdlac0.lv_o2l_clc_act_opp_tmp "Activation for diagnosis regarding operating point" UBYTE _CNV_A_R_LINEAR_____0_CM 1 100. 0. 1. DISPLAY_IDENTIFIER LV_O2L_CLC_ACT_OPP_TMP[2] ECU_ADDRESS 0xd0005e8e FORMAT "%1.0" BIT_MASK 0x1 /end MEASUREMENT
/begin MEASUREMENT egtr[1].egtr_struct_fctdgtdlac0.lv_o2l_clc_act_cdn "General activation flag for calculation of oxygen capacity" UBYTE _CNV_A_R_LINEAR_____0_CM 1 100. 0. 1. DISPLAY_IDENTIFIER LV_O2L_CLC_ACT_CDN[2] ECU_ADDRESS 0xd0005e8f FORMAT "%1.0" BIT_MASK 0x1 /end MEASUREMENT
/begin MEASUREMENT egtr[1].egtr_struct_fctdgtdlac0.lv_o2l_clc_act_tco_tmp "Activation for diagnosis regarding coolant temperature" UBYTE _CNV_A_R_LINEAR_____0_CM 1 100. 0. 1. DISPLAY_IDENTIFIER LV_O2L_CLC_ACT_TCO_TMP[2] ECU_ADDRESS 0xd0005e90 FORMAT "%1.0" BIT_MASK 0x1 /end MEASUREMENT
/begin MEASUREMENT egtr[1].egtr_struct_fctdgtdlac0.lv_o2l_clc_act_temp_tmp "Activation for diagnosis regarding TWC temperature" UBYTE _CNV_A_R_LINEAR_____0_CM 1 100. 0. 1. DISPLAY_IDENTIFIER LV_O2L_CLC_ACT_TEMP_TMP[2] ECU_ADDRESS 0xd0005e91 FORMAT "%1.0" BIT_MASK 0x1 /end MEASUREMENT
/begin MEASUREMENT egtr[1].egtr_struct_fctdgtdlac0.lv_o2l_clc_act_ldc_temp_tmp "Activation for diagnosis regarding TWC temperature limited dynamic" UBYTE _CNV_A_R_LINEAR_____0_CM 1 100. 0. 1. DISPLAY_IDENTIFIER LV_O2L_CLC_ACT_LDC_TEMP_TMP[2] ECU_ADDRESS 0xd0005e92 FORMAT "%1.0" BIT_MASK 0x1 /end MEASUREMENT
/begin MEASUREMENT egtr[1].egtr_struct_fctdgtdldd0.action_clcO2L_data_l_ampl.o2l_mv "Mean value of O2L values calculated in regenerations phase" UWORD _CNV_A_R_LINEAR_____812_CM 1 100. 0. 2.61684895833333 DISPLAY_IDENTIFIER O2L_L_AMPL_MV[2] ECU_ADDRESS 0xd0005e94 FORMAT "%7.5" /end MEASUREMENT
/begin MEASUREMENT egtr[1].egtr_struct_fctdgtdldd0.action_clcO2L_data_l_ampl.o2l_sum "Sum of O2L values calculated during regenerations phase" UWORD _CNV_A_R_EGTR_LINEA_828_CM 1 100. 0. 20.93479 DISPLAY_IDENTIFIER O2L_L_AMPL_SUM[2] ECU_ADDRESS 0xd0005e96 FORMAT "%7.4" /end MEASUREMENT
/begin MEASUREMENT egtr[1].egtr_struct_fctdgtdldd0.action_clcO2L_data_l_ampl.ctr_sum "Counter for calculation of mean value of O2L calculated in regeneration phases" UBYTE _CNV_A_R_LINEAR_____0_CM 1 100. 0. 255. DISPLAY_IDENTIFIER CTR_O2L_SUM_L_AMPL[2] ECU_ADDRESS 0xd0005e98 FORMAT "%3.0" /end MEASUREMENT
/begin MEASUREMENT egtr[1].egtr_struct_fctdgtdldd0.action_clcO2L_data_h_ampl.o2l_mv "Mean value of O2L values calculated in regenerations phase" UWORD _CNV_A_R_LINEAR_____812_CM 1 100. 0. 2.61684895833333 DISPLAY_IDENTIFIER O2L_H_AMPL_MV[2] ECU_ADDRESS 0xd0005e9a FORMAT "%7.5" /end MEASUREMENT
/begin MEASUREMENT egtr[1].egtr_struct_fctdgtdldd0.action_clcO2L_data_h_ampl.o2l_sum "Sum of O2L values calculated during regenerations phase" UWORD _CNV_A_R_EGTR_LINEA_828_CM 1 100. 0. 20.93479 DISPLAY_IDENTIFIER O2L_H_AMPL_SUM[2] ECU_ADDRESS 0xd0005e9c FORMAT "%7.4" /end MEASUREMENT
/begin MEASUREMENT egtr[1].egtr_struct_fctdgtdldd0.action_clcO2L_data_h_ampl.ctr_sum "Counter for calculation of mean value of O2L calculated in regeneration phases" UBYTE _CNV_A_R_LINEAR_____0_CM 1 100. 0. 255. DISPLAY_IDENTIFIER CTR_O2L_SUM_H_AMPL[2] ECU_ADDRESS 0xd0005e9e FORMAT "%3.0" /end MEASUREMENT
/begin MEASUREMENT egtr[1].egtr_struct_fctdgtdldd0.action_clcO2L_data_park.o2l_mv "Mean value of O2L values calculated in regenerations phase" UWORD _CNV_A_R_LINEAR_____812_CM 1 100. 0. 2.61684895833333 DISPLAY_IDENTIFIER O2L_PARK_MV[2] ECU_ADDRESS 0xd0005ea0 FORMAT "%7.5" /end MEASUREMENT
/begin MEASUREMENT egtr[1].egtr_struct_fctdgtdldd0.action_clcO2L_data_park.o2l_sum "Sum of O2L values calculated during regenerations phase" UWORD _CNV_A_R_EGTR_LINEA_828_CM 1 100. 0. 20.93479 DISPLAY_IDENTIFIER O2L_PARK_SUM[2] ECU_ADDRESS 0xd0005ea2 FORMAT "%7.4" /end MEASUREMENT
/begin MEASUREMENT egtr[1].egtr_struct_fctdgtdldd0.action_clcO2L_data_park.ctr_sum "Counter for calculation of mean value of O2L calculated in regeneration phases" UBYTE _CNV_A_R_LINEAR_____0_CM 1 100. 0. 255. DISPLAY_IDENTIFIER CTR_O2L_SUM_PARK[2] ECU_ADDRESS 0xd0005ea4 FORMAT "%3.0" /end MEASUREMENT
/begin MEASUREMENT egtr[1].egtr_struct_fctdgtdldd0.action_clcO2L_data_load.o2l_mv "Mean value of O2L values calculated in regenerations phase" UWORD _CNV_A_R_LINEAR_____812_CM 1 100. 0. 2.61684895833333 DISPLAY_IDENTIFIER O2L_LOAD_MV[2] ECU_ADDRESS 0xd0005ea6 FORMAT "%7.5" /end MEASUREMENT
/begin MEASUREMENT egtr[1].egtr_struct_fctdgtdldd0.action_clcO2L_data_load.o2l_sum "Sum of O2L values calculated during regenerations phase" UWORD _CNV_A_R_EGTR_LINEA_828_CM 1 100. 0. 20.93479 DISPLAY_IDENTIFIER O2L_LOAD_SUM[2] ECU_ADDRESS 0xd0005ea8 FORMAT "%7.4" /end MEASUREMENT
/begin MEASUREMENT egtr[1].egtr_struct_fctdgtdldd0.action_clcO2L_data_load.ctr_sum "Counter for calculation of mean value of O2L calculated in regeneration phases" UBYTE _CNV_A_R_LINEAR_____0_CM 1 100. 0. 255. DISPLAY_IDENTIFIER CTR_O2L_SUM_LOAD[2] ECU_ADDRESS 0xd0005eaa FORMAT "%3.0" /end MEASUREMENT
/begin MEASUREMENT egtr[1].egtr_struct_fctdgtdldd0.o2l_cat_diag_afl "Finally O2L value for calculation of Error Symptom" UWORD _CNV_A_R_LINEAR_____812_CM 1 100. 0. 2.61684895833333 DISPLAY_IDENTIFIER O2L_CAT_DIAG_AFL[2] ECU_ADDRESS 0xd0005eac FORMAT "%7.5" /end MEASUREMENT
/begin MEASUREMENT egtr[1].egtr_struct_fctdgtdldd0.o2l_delta_afr_cdn "Delta between O2L values calculated during H_AMPL and L_AMPL regeneration phase" UWORD _CNV_A_R_EGTR_LINEA_829_CM 1 100. -1.30844444444444 1.30840451388889 DISPLAY_IDENTIFIER O2L_DELTA_AFR_CDN[2] ECU_ADDRESS 0xd0005eae FORMAT "%8.5" /end MEASUREMENT
/begin MEASUREMENT egtr[1].egtr_struct_fctdgtdldd0.o2l_afr_cdn_cor "Corrected O2L value with mathematic method" UWORD _CNV_A_R_LINEAR_____812_CM 1 100. 0. 2.61684895833333 DISPLAY_IDENTIFIER O2L_AFR_CDN_COR[2] ECU_ADDRESS 0xd0005eb0 FORMAT "%7.5" /end MEASUREMENT
/begin MEASUREMENT egtr[1].egtr_struct_fctdgtdldd0.o2l_afr_cdn_cor_mat "Corrected O2L value with empirical method" UWORD _CNV_A_R_LINEAR_____812_CM 1 100. 0. 2.61684895833333 DISPLAY_IDENTIFIER O2L_AFR_CDN_COR_MAT[2] ECU_ADDRESS 0xd0005eb2 FORMAT "%7.5" /end MEASUREMENT
/begin MEASUREMENT egtr[1].egtr_struct_fctdgtdldd0.o2l_afl_cdn_mat "Calculated O2L of PreCat in Lean Condition" UWORD _CNV_A_R_LINEAR_____812_CM 1 100. 0. 2.61684895833333 DISPLAY_IDENTIFIER O2L_AFL_CDN_MAT[2] ECU_ADDRESS 0xd0005eb4 FORMAT "%7.5" /end MEASUREMENT
/begin MEASUREMENT egtr[1].egtr_struct_fctdgtdldd0.o2l_sum_cat_diag_afl "Sum of O2L values of all phases for calculation of O2L_MMV_CAT_DIAG_AFL" UWORD _CNV_A_R_EGTR_LINEA_828_CM 1 100. 0. 20.93479 DISPLAY_IDENTIFIER O2L_SUM_CAT_DIAG_AFL[2] ECU_ADDRESS 0xd0005eb6 FORMAT "%7.4" /end MEASUREMENT
/begin MEASUREMENT egtr[1].egtr_struct_fctdgtdldd0.o2l_mmv_cat_diag_afl "Mean value of O2L values calculated in all phases" UWORD _CNV_A_R_LINEAR_____812_CM 1 100. 0. 2.61684895833333 DISPLAY_IDENTIFIER O2L_MMV_CAT_DIAG_AFL[2] ECU_ADDRESS 0xd0005eb8 FORMAT "%7.5" /end MEASUREMENT
/begin MEASUREMENT egtr[1].egtr_struct_fctdgtdldd0.fac_sum_o2l_mmv_tmp "Denominator for calculation of O2L_MMV_CAT_DIAG_AFL" UBYTE _CNV_A_R_LINEAR_____0_CM 1 100. 0. 255. DISPLAY_IDENTIFIER FAC_SUM_O2L_MMV_TMP[2] ECU_ADDRESS 0xd0005eba FORMAT "%3.0" /end MEASUREMENT
/begin MEASUREMENT egtr[1].egtr_struct_fctdgtdldd0.state_o2l_mv_clc_vld "Collected bits due to calculation of mean values at each phase" UBYTE _CNV_A_R_LINEAR_____0_CM 1 100. 0. 255. DISPLAY_IDENTIFIER STATE_O2L_MV_CLC_VLD[2] ECU_ADDRESS 0xd0005ebb FORMAT "%3.0" /end MEASUREMENT
/begin MEASUREMENT egtr[1].egtr_struct_fctdgtdldd0.lv_o2l_cat_diag_afl "Calculation of general O2L value was successful" UBYTE _CNV_A_R_LINEAR_____0_CM 1 100. 0. 1. DISPLAY_IDENTIFIER LV_O2L_CAT_DIAG_AFL[2] ECU_ADDRESS 0xd0005ebc FORMAT "%1.0" BIT_MASK 0x1 /end MEASUREMENT
/begin MEASUREMENT egtr[1].egtr_struct_fctdgtdldd0.lv_err_cat_diag_afl_tmp "Temporary present failure of diagnostic CAT_DIAG_AFL" UBYTE _CNV_A_R_LINEAR_____0_CM 1 100. 0. 1. DISPLAY_IDENTIFIER LV_ERR_CAT_DIAG_AFL_TMP[2] ECU_ADDRESS 0xd0005ebd FORMAT "%1.0" BIT_MASK 0x1 /end MEASUREMENT
/begin MEASUREMENT egtr[1].egtr_struct_fctdgtdldd0.lv_end_diag_afl_tmp "Temporary flag for end of the Diagnostic cycle without filtering" UBYTE _CNV_A_R_LINEAR_____0_CM 1 100. 0. 1. DISPLAY_IDENTIFIER LV_END_DIAG_AFL_TMP[2] ECU_ADDRESS 0xd0005ebe FORMAT "%1.0" BIT_MASK 0x1 /end MEASUREMENT
/begin MEASUREMENT egtr[1].egtr_struct_fctdgtdldd0.lv_o2l_mv_clc_end "Calculation of mean values during diagnosis cycle has been done" UBYTE _CNV_A_R_LINEAR_____0_CM 1 100. 0. 1. DISPLAY_IDENTIFIER LV_O2L_MV_CLC_END[2] ECU_ADDRESS 0xd0005ebf FORMAT "%1.0" BIT_MASK 0x1 /end MEASUREMENT
/begin MEASUREMENT egtr[1].egtr_struct_fctdgtdlai0.lv_inh_diag_cat_diag_afl "Inhibition condition for the TWC lean diagnosis" UBYTE _CNV_A_R_LINEAR_____0_CM 1 100. 0. 1. DISPLAY_IDENTIFIER LV_INH_DIAG_CAT_DIAG_AFL[2] ECU_ADDRESS 0xd0005ec0 FORMAT "%1.0" BIT_MASK 0x1 /end MEASUREMENT
/begin MEASUREMENT egtr[1].egtr_struct_fctdgtdlai0.lv_diag_err_sum_diag_afl "Collected flag of errors of other relevant diagnosis" UBYTE _CNV_A_R_LINEAR_____0_CM 1 100. 0. 1. DISPLAY_IDENTIFIER LV_DIAG_ERR_SUM_DIAG_AFL[2] ECU_ADDRESS 0xd0005ec1 FORMAT "%1.0" BIT_MASK 0x1 /end MEASUREMENT
/begin MEASUREMENT egtr[1].egtr_struct_fctdgtdlai0.lv_diag_end_sum_diag_afl "Collected flag that other relevant diagnosis are finished" UBYTE _CNV_A_R_LINEAR_____0_CM 1 100. 0. 1. DISPLAY_IDENTIFIER LV_DIAG_END_SUM_DIAG_AFL[2] ECU_ADDRESS 0xd0005ec2 FORMAT "%1.0" BIT_MASK 0x1 /end MEASUREMENT
/begin MEASUREMENT egtr[1].egtr_struct_fctdgtdlai0.lv_err_qvm_1 "Inhibition condition for the TWC lean diagnosis" UBYTE _CNV_A_R_LINEAR_____0_CM 1 100. 0. 1. DISPLAY_IDENTIFIER LV_ERR_QVM_1 ECU_ADDRESS 0xd0005ec3 FORMAT "%1.0" BIT_MASK 0x1 /end MEASUREMENT
/begin MEASUREMENT egtr[1].egtr_struct_fctdgtdlai0.lv_err_qvm_2 "Inhibition condition for the TWC lean diagnosis" UBYTE _CNV_A_R_LINEAR_____0_CM 1 100. 0. 1. DISPLAY_IDENTIFIER LV_ERR_QVM_2 ECU_ADDRESS 0xd0005ec4 FORMAT "%1.0" BIT_MASK 0x1 /end MEASUREMENT
/begin MEASUREMENT egtr[1].egtr_struct_fctdgtdlai0.lv_err_qvm_3 "Inhibition condition for the TWC lean diagnosis" UBYTE _CNV_A_R_LINEAR_____0_CM 1 100. 0. 1. DISPLAY_IDENTIFIER LV_ERR_QVM_3 ECU_ADDRESS 0xd0005ec5 FORMAT "%1.0" BIT_MASK 0x1 /end MEASUREMENT
/begin MEASUREMENT egtr[1].egtr_struct_fctdgtdlai0.lv_err_qvm "QVM" UBYTE _CNV_A_R_LINEAR_____0_CM 1 100. 0. 1. DISPLAY_IDENTIFIER LV_ERR_QVM ECU_ADDRESS 0xd0005ec6 FORMAT "%1.0" BIT_MASK 0x1 /end MEASUREMENT
/begin MEASUREMENT egtr[1].egtr_struct_fctdgtdloc0.action_O2L_data_h_ampl.o2l_pha "Calculated O2L" UWORD _CNV_A_R_LINEAR_____812_CM 1 100. 0. 2.61684895833333 DISPLAY_IDENTIFIER O2L_RGN_H_AMPL_PHA[2] ECU_ADDRESS 0xd0005ec8 FORMAT "%7.5" /end MEASUREMENT
/begin MEASUREMENT egtr[1].egtr_struct_fctdgtdloc0.action_O2L_data_h_ampl.o2l_int_pha "Calculated O2L Integral" UWORD _CNV_A_R_LINEAR_____812_CM 1 100. 0. 2.61684895833333 DISPLAY_IDENTIFIER O2L_INT_RGN_H_AMPL_PHA[2] ECU_ADDRESS 0xd0005eca FORMAT "%7.5" /end MEASUREMENT
/begin MEASUREMENT egtr[1].egtr_struct_fctdgtdloc0.action_O2L_data_h_ampl.lv_o2l_clc "Flag for calculation of O2L" UBYTE _CNV_A_R_LINEAR_____0_CM 1 100. 0. 1. DISPLAY_IDENTIFIER LV_O2L_CLC_RGN_H_AMPL[2] ECU_ADDRESS 0xd0005ecd FORMAT "%1.0" BIT_MASK 0x1 /end MEASUREMENT
/begin MEASUREMENT egtr[1].egtr_struct_fctdgtdloc0.action_O2L_data_l_ampl.o2l_pha "Calculated O2L" UWORD _CNV_A_R_LINEAR_____812_CM 1 100. 0. 2.61684895833333 DISPLAY_IDENTIFIER O2L_RGN_L_AMPL_PHA[2] ECU_ADDRESS 0xd0005ed0 FORMAT "%7.5" /end MEASUREMENT
/begin MEASUREMENT egtr[1].egtr_struct_fctdgtdloc0.action_O2L_data_l_ampl.o2l_int_pha "Calculated O2L Integral" UWORD _CNV_A_R_LINEAR_____812_CM 1 100. 0. 2.61684895833333 DISPLAY_IDENTIFIER O2L_INT_RGN_L_AMPL_PHA[2] ECU_ADDRESS 0xd0005ed2 FORMAT "%7.5" /end MEASUREMENT
/begin MEASUREMENT egtr[1].egtr_struct_fctdgtdloc0.action_O2L_data_l_ampl.lv_o2l_clc "Flag for calculation of O2L" UBYTE _CNV_A_R_LINEAR_____0_CM 1 100. 0. 1. DISPLAY_IDENTIFIER LV_O2L_CLC_RGN_L_AMPL[2] ECU_ADDRESS 0xd0005ed5 FORMAT "%1.0" BIT_MASK 0x1 /end MEASUREMENT
/begin MEASUREMENT egtr[1].egtr_struct_fctdgtdloc0.action_O2L_data_park.o2l_pha "Calculated O2L" UWORD _CNV_A_R_LINEAR_____812_CM 1 100. 0. 2.61684895833333 DISPLAY_IDENTIFIER O2L_PARK_PHA[2] ECU_ADDRESS 0xd0005ed8 FORMAT "%7.5" /end MEASUREMENT
/begin MEASUREMENT egtr[1].egtr_struct_fctdgtdloc0.action_O2L_data_park.o2l_int_pha "Calculated O2L Integral" UWORD _CNV_A_R_LINEAR_____812_CM 1 100. 0. 2.61684895833333 DISPLAY_IDENTIFIER O2L_INT_PARK_PHA[2] ECU_ADDRESS 0xd0005eda FORMAT "%7.5" /end MEASUREMENT
/begin MEASUREMENT egtr[1].egtr_struct_fctdgtdloc0.action_O2L_data_park.lv_o2l_clc "Flag for calculation of O2L" UBYTE _CNV_A_R_LINEAR_____0_CM 1 100. 0. 1. DISPLAY_IDENTIFIER LV_O2L_CLC_PARK[2] ECU_ADDRESS 0xd0005edd FORMAT "%1.0" BIT_MASK 0x1 /end MEASUREMENT
/begin MEASUREMENT egtr[1].egtr_struct_fctdgtdloc0.action_O2L_data_load.o2l_pha "Calculated O2L" UWORD _CNV_A_R_LINEAR_____812_CM 1 100. 0. 2.61684895833333 DISPLAY_IDENTIFIER O2L_LOAD_PHA[2] ECU_ADDRESS 0xd0005ee0 FORMAT "%7.5" /end MEASUREMENT
/begin MEASUREMENT egtr[1].egtr_struct_fctdgtdloc0.action_O2L_data_load.o2l_int_pha "Calculated O2L Integral" UWORD _CNV_A_R_LINEAR_____812_CM 1 100. 0. 2.61684895833333 DISPLAY_IDENTIFIER O2L_INT_LOAD_PHA[2] ECU_ADDRESS 0xd0005ee2 FORMAT "%7.5" /end MEASUREMENT
/begin MEASUREMENT egtr[1].egtr_struct_fctdgtdloc0.action_O2L_data_load.lv_o2l_clc "Flag for calculation of O2L" UBYTE _CNV_A_R_LINEAR_____0_CM 1 100. 0. 1. DISPLAY_IDENTIFIER LV_O2L_CLC_LOAD[2] ECU_ADDRESS 0xd0005ee5 FORMAT "%1.0" BIT_MASK 0x1 /end MEASUREMENT
/begin MEASUREMENT egtr[1].egtr_struct_fctdgtdloc0.state_o2l_clc_vld "Validation state for O2L integral calculation" UBYTE _CNV_A_R_LINEAR_____0_CM 1 100. 0. 255. DISPLAY_IDENTIFIER STATE_O2L_CLC_VLD[2] ECU_ADDRESS 0xd0005ee8 FORMAT "%3.0" /end MEASUREMENT
/begin MEASUREMENT egtr[1].egtr_struct_fctdgtdloc0.t_afl_cdn_out "Timer for exit from state LEAN_CDN" UWORD _CNV_A_R_LINEAR_____3_CM 1 100. 0. 655.35 DISPLAY_IDENTIFIER T_AFL_CDN_OUT[2] ECU_ADDRESS 0xd0005eea FORMAT "%6.2" /end MEASUREMENT
/begin MEASUREMENT egtr[1].egtr_struct_fctdgtdloc0.state_cat_diag_afl "OSC calculation state for TWC diagnosis at lean operation" UBYTE _CNV_S_4_RANGE_STAT_830_CM 1 100. 0. 3. DISPLAY_IDENTIFIER STATE_CAT_DIAG_AFL[2] ECU_ADDRESS 0xd0005eec /end MEASUREMENT
/begin MEASUREMENT egtr[1].egtr_struct_fctdgtdloc0.state_o2l_clc_end "State for O2L calculation   calculation is finished" UBYTE _CNV_A_R_LINEAR_____0_CM 1 100. 0. 255. DISPLAY_IDENTIFIER STATE_O2L_CLC_END[2] ECU_ADDRESS 0xd0005eed FORMAT "%3.0" /end MEASUREMENT
/begin MEASUREMENT egtr[1].egtr_struct_fctdgcefc0.eff_cat_diag "Catalyst diagnosis value in OSC range (only in case of NC_USE_EGTR = 0)" UBYTE _CNV_A_R_LINEAR_____103_CM 1 100. 0. 1.9921875 DISPLAY_IDENTIFIER EFF_CAT_DIAG[2] ECU_ADDRESS 0xd0005ef0 FORMAT "%8.6" /end MEASUREMENT
/begin MEASUREMENT egtr[1].egtr_struct_defsptdlld0.lamb_sp_diag_afl "Lambda setpoint for precatalyst lean diagnosis" UWORD _CNV_A_R_LINEAR_____129_CM 1 100. 0. 31.9990234375 DISPLAY_IDENTIFIER LAMB_SP_DIAG_AFL[2] ECU_ADDRESS 0xd0005ef2 FORMAT "%7.4" /end MEASUREMENT
/begin MEASUREMENT egtr[1].egtr_struct_defsptdlld0.state_rgn_cat_diag_afl "State for the calculation of lean TWC diagnosis due to state of system regeneration" UBYTE _CNV_A_R_LINEAR_____0_CM 1 100. 0. 3. DISPLAY_IDENTIFIER STATE_RGN_CAT_DIAG_AFL[2] ECU_ADDRESS 0xd0005ef4 FORMAT "%3.0" /end MEASUREMENT
/begin MEASUREMENT egtr[1].egtr_struct_defsptdlld0.lv_lamb_sp_diag_afl_park "Indicator of lambda value position at park state " UBYTE _CNV_S_2_RANGE__0___1_CM 1 100. 0. 1. DISPLAY_IDENTIFIER LV_LAMB_SP_DIAG_AFL_PARK[2] ECU_ADDRESS 0xd0005ef5 BIT_MASK 0x1 /end MEASUREMENT
/begin CHARACTERISTIC c_crlc_temp_cat_diag_afl "Correlation constant for calculation of filtered TWC temperature" VALUE 0xa0801a80 _REC_VAL_20_u1 0.99609375 _CNV_A_R_LINEAR_____28_CM 0. 0.99609375 DISPLAY_IDENTIFIER C_CRLC_TEMP_CAT_DIAG_AFL FORMAT "%5.3" /end CHARACTERISTIC
/begin CHARACTERISTIC c_maf_down_lim_cat_diag_afl "Lower limit of MAF_FG_CYL to allow of OSC calculation" VALUE 0xa0801ace _REC_VAL_20_u2 2047.96875 _CNV_A_R_LINEAR_____215_CM 0. 2047.96875 DISPLAY_IDENTIFIER C_MAF_DOWN_LIM_CAT_DIAG_AFL FORMAT "%10.5" /end CHARACTERISTIC
/begin CHARACTERISTIC c_maf_up_lim_cat_diag_afl "Upper limit of MAF_FG_CYL to allow of OSC calculation" VALUE 0xa0801ae0 _REC_VAL_20_u2 2047.96875 _CNV_A_R_LINEAR_____215_CM 0. 2047.96875 DISPLAY_IDENTIFIER C_MAF_UP_LIM_CAT_DIAG_AFL FORMAT "%10.5" /end CHARACTERISTIC
/begin CHARACTERISTIC c_n_32_down_lim_cat_diag_afl "Lower limit of N_32 to allow of OSC calculation" VALUE 0xa0801ae3 _REC_VAL_20_u1 8160. _CNV_A_R_LINEAR_____10_CM 0. 8160. DISPLAY_IDENTIFIER C_N_32_DOWN_LIM_CAT_DIAG_AFL FORMAT "%4.0" /end CHARACTERISTIC
/begin CHARACTERISTIC c_n_32_up_lim_cat_diag_afl "Upper limit of N_32 to allow of OSC calculation" VALUE 0xa0801ae4 _REC_VAL_20_u1 8160. _CNV_A_R_LINEAR_____10_CM 0. 8160. DISPLAY_IDENTIFIER C_N_32_UP_LIM_CAT_DIAG_AFL FORMAT "%4.0" /end CHARACTERISTIC
/begin CHARACTERISTIC c_tco_down_lim_cat_diag_afl "Lower limit of TCO to allow of OSC calculation" VALUE 0xa0801b0f _REC_VAL_20_u1 190.5 _CNV_A_R_LINEAR_____17_CM -48. 142.5 DISPLAY_IDENTIFIER C_TCO_DOWN_LIM_CAT_DIAG_AFL FORMAT "%6.2" /end CHARACTERISTIC
/begin CHARACTERISTIC c_tco_up_lim_cat_diag_afl "Upper limit of TCO to allow of OSC calculation" VALUE 0xa0801b13 _REC_VAL_20_u1 190.5 _CNV_A_R_LINEAR_____17_CM -48. 142.5 DISPLAY_IDENTIFIER C_TCO_UP_LIM_CAT_DIAG_AFL FORMAT "%6.2" /end CHARACTERISTIC
/begin CHARACTERISTIC c_temp_ldc_cat_diag_afl "Threshold for deactivation of OSC calculation regarding TWC temp. limited dynamic" VALUE 0xa0801b20 _REC_VAL_20_s2 4095.9375 _CNV_A_R_LINEAR_____130_CM -2048. 2047.9375 DISPLAY_IDENTIFIER C_TEMP_LDC_CAT_DIAG_AFL FORMAT "%10.4" /end CHARACTERISTIC
/begin CHARACTERISTIC c_temp_down_lim_cat_diag_afl "Lower limit of TWC temperature to allow of OSC calculation" VALUE 0xa0801b1c _REC_VAL_20_u2 2047.9375 _CNV_A_R_LINEAR_____214_CM -273.15 1774.7875 DISPLAY_IDENTIFIER C_TEMP_DOWN_LIM_CAT_DIAG_AFL FORMAT "%9.4" /end CHARACTERISTIC
/begin CHARACTERISTIC c_temp_up_lim_cat_diag_afl "Upper limit of TWC temperature to allow of OSC calculation" VALUE 0xa0801b26 _REC_VAL_20_u2 2047.9375 _CNV_A_R_LINEAR_____214_CM -273.15 1774.7875 DISPLAY_IDENTIFIER C_TEMP_UP_LIM_CAT_DIAG_AFL FORMAT "%9.4" /end CHARACTERISTIC
/begin MEASUREMENT lv_err_cat_diag_afl_2 "Present failure after filtering of diagnostic CAT_DIAG_AFL" UBYTE _CNV_S_2_RANGE__0___1_CM 1 100. 0. 1. DISPLAY_IDENTIFIER LV_ERR_CAT_DIAG_AFL_2 ECU_ADDRESS 0xd0007fe7 BIT_MASK 0x1 /end MEASUREMENT
/begin CHARACTERISTIC c_ctr_cyc_cat_diag_afl "Number of diagnosis cycles for calculation of error indicator" VALUE 0xa0801a81 _REC_VAL_20_u1 254. _CNV_A_R_LINEAR_____0_CM 1. 255. DISPLAY_IDENTIFIER C_CTR_CYC_CAT_DIAG_AFL FORMAT "%3.0" /end CHARACTERISTIC
/begin CHARACTERISTIC c_ctr_o2l_mv_clc "Number of necessary O2L calculations for calculation of mean value of each phase" VALUE 0xa0801a88 _REC_VAL_20_u1 254. _CNV_A_R_LINEAR_____0_CM 1. 255. DISPLAY_IDENTIFIER C_CTR_O2L_MV_CLC FORMAT "%3.0" /end CHARACTERISTIC
/begin CHARACTERISTIC c_fac_afr_cdn_mat "Factor for calculation of corrected diagnosis" VALUE 0xa0801a91 _REC_VAL_20_u1 15.9375 _CNV_A_R_EVAC_LINEA_298_CM 0. 15.9375 DISPLAY_IDENTIFIER C_FAC_AFR_CDN_MAT FORMAT "%7.4" /end CHARACTERISTIC
/begin CHARACTERISTIC c_o2l_thd_err_cat_diag_afl_sum "OBD threshold of diagnosis value to set of diagnosis error depending on diagonally O2L calculation" VALUE 0xa0801afe _REC_VAL_20_u2 2.616848958333331 _CNV_A_R_LINEAR_____812_CM 0. 2.61684895833333 DISPLAY_IDENTIFIER C_O2L_THD_ERR_CAT_DIAG_AFL_SUM FORMAT "%7.5" /end CHARACTERISTIC
/begin CHARACTERISTIC c_o2l_thd_err_cat_diag_afl[0] "OBD threshold of diagnosis value to set the diagnosis error" VALUE 0xa0801afa _REC_VAL_20_u2 2.616848958333331 _CNV_A_R_LINEAR_____812_CM 0. 2.61684895833333 DISPLAY_IDENTIFIER C_O2L_THD_ERR_CAT_DIAG_AFL[1] FORMAT "%7.5" /end CHARACTERISTIC
/begin CHARACTERISTIC c_o2l_thd_err_cat_diag_afl[1] "OBD threshold of diagnosis value to set the diagnosis error" VALUE 0xa0801afc _REC_VAL_20_u2 2.616848958333331 _CNV_A_R_LINEAR_____812_CM 0. 2.61684895833333 DISPLAY_IDENTIFIER C_O2L_THD_ERR_CAT_DIAG_AFL[2] FORMAT "%7.5" /end CHARACTERISTIC
/begin CHARACTERISTIC c_o2l_cat_diag_afl_max "Maximal O2L value used for initialization of diagnosis value" VALUE 0xa0801aec _REC_VAL_20_u2 2.616848958333331 _CNV_A_R_LINEAR_____812_CM 0. 2.61684895833333 DISPLAY_IDENTIFIER C_O2L_CAT_DIAG_AFL_MAX FORMAT "%7.5" /end CHARACTERISTIC
/begin CHARACTERISTIC c_state_o2l_err_clc "State for choice of O2L calculation strategy for calculation of diagnosis error" VALUE 0xa0801b05 _REC_VAL_20_u1 15. _CNV_A_R_LINEAR_____0_CM 0. 15. DISPLAY_IDENTIFIER C_STATE_O2L_ERR_CLC FORMAT "%3.0" /end CHARACTERISTIC
/begin CHARACTERISTIC lc_o2l_cat_diag_afl_sum "Manually set calculation of diagonally O2L to valid" VALUE 0xa0801b45 _REC_VAL_20_u1 1. _CNV_A_R_LINEAR_____0_CM 0. 1. DISPLAY_IDENTIFIER LC_O2L_CAT_DIAG_AFL_SUM FORMAT "%1.0" /end CHARACTERISTIC
/begin AXIS_PTS ldp_o2l_delta_ip_fac_cor "" 0xa08017f4 online_dummy _REC_AXS_20_u2 2.616848958333331 _CNV_A_R_EGTR_LINEA_829_CM 8 -1.30844444444444 1.30840451388889 FORMAT "%8.5" /end AXIS_PTS
/begin AXIS_PTS ldp_o2l_cat_diag_1_ip_o2l_sum "" 0xa08017bc online_dummy _REC_AXS_20_u2 2.616848958333331 _CNV_A_R_LINEAR_____812_CM 8 0. 2.61684895833333 FORMAT "%7.5" /end AXIS_PTS
/begin AXIS_PTS ldp_o2l_cat_diag_2_ip_o2l_sum "" 0xa08017d0 online_dummy _REC_AXS_20_u2 2.616848958333331 _CNV_A_R_LINEAR_____812_CM 8 0. 2.61684895833333 FORMAT "%7.5" /end AXIS_PTS
/begin CHARACTERISTIC ip_o2l_cat_diag_afl_sum "Diagonally calculation of O2L due to both cylinder branches" MAP 0xa080db50 _REC_MAP_20_u2_u2_u2 2.616848958333331 _CNV_A_R_LINEAR_____812_CM 0. 2.61684895833333 DISPLAY_IDENTIFIER IP_O2L_CAT_DIAG_AFL_SUM FORMAT "%7.5"
 /begin AXIS_DESCR COM_AXIS online_dummy _CNV_A_R_LINEAR_____812_CM 8 0. 2.61684895833333 FORMAT "%7.5" AXIS_PTS_REF ldp_o2l_cat_diag_1_ip_o2l_sum /end AXIS_DESCR
 /begin AXIS_DESCR COM_AXIS online_dummy _CNV_A_R_LINEAR_____812_CM 8 0. 2.61684895833333 FORMAT "%7.5" AXIS_PTS_REF ldp_o2l_cat_diag_2_ip_o2l_sum /end AXIS_DESCR
/end CHARACTERISTIC
/begin CHARACTERISTIC ip_fac_o2l_afr_cdn_cor "Correction factor for calculation of O2L value" CURVE 0xa080194c _REC_CUR_20_u1_u2 15.9375 _CNV_A_R_EVAC_LINEA_298_CM 0. 15.9375 DISPLAY_IDENTIFIER IP_FAC_O2L_AFR_CDN_COR FORMAT "%7.4"
 /begin AXIS_DESCR COM_AXIS online_dummy _CNV_A_R_EGTR_LINEA_829_CM 8 -1.30844444444444 1.30840451388889 FORMAT "%8.5" AXIS_PTS_REF ldp_o2l_delta_ip_fac_cor /end AXIS_DESCR
/end CHARACTERISTIC
/begin MEASUREMENT lv_err_cat_diag_afl_1 "Present failure after filtering of diagnostic CAT_DIAG_AFL" UBYTE _CNV_S_2_RANGE__0___1_CM 1 100. 0. 1. DISPLAY_IDENTIFIER LV_ERR_CAT_DIAG_AFL_1 ECU_ADDRESS 0xd0007fe6 BIT_MASK 0x1 /end MEASUREMENT
/begin MEASUREMENT o2l_cat_diag_afl_sum "Diagonal calculated O2L of both cylinder branches" UWORD _CNV_A_R_LINEAR_____812_CM 1 100. 0. 2.61684895833333 DISPLAY_IDENTIFIER O2L_CAT_DIAG_AFL_SUM ECU_ADDRESS 0xd00023f6 FORMAT "%7.5" /end MEASUREMENT
/begin MEASUREMENT lv_o2l_clc_ready "Calculation of general diagnosis value is finished" UBYTE _CNV_S_2_RANGE__0___1_CM 1 100. 0. 1. DISPLAY_IDENTIFIER LV_O2L_CLC_READY ECU_ADDRESS 0xd0002404 BIT_MASK 0x1 /end MEASUREMENT
/begin MEASUREMENT lv_o2l_cat_diag_afl_sum "Calculation of O2L_CAT_DIAG_AFL_SUM was successful" UBYTE _CNV_S_2_RANGE__0___1_CM 1 100. 0. 1. DISPLAY_IDENTIFIER LV_O2L_CAT_DIAG_AFL_SUM ECU_ADDRESS 0xd0002403 BIT_MASK 0x1 /end MEASUREMENT
/begin MEASUREMENT o2l_nt_mat "Calculated O2L value of NOx catalyst" UWORD _CNV_A_R_EGTR_LINEA_828_CM 1 100. 0. 20.93479 DISPLAY_IDENTIFIER O2L_NT_MAT ECU_ADDRESS 0xd00023f8 FORMAT "%7.4" /end MEASUREMENT
/begin MEASUREMENT ctr_cyc_cat_diag_afl "Counter of diagnosis cycles for calculation of error indicator" UBYTE _CNV_A_R_LINEAR_____0_CM 1 100. 0. 255. DISPLAY_IDENTIFIER CTR_CYC_CAT_DIAG_AFL ECU_ADDRESS 0xd00023fc FORMAT "%3.0" /end MEASUREMENT
/begin CHARACTERISTIC c_abc_inc_cat_diag_afl "Antibounce counter increment" VALUE 0xa0801a75 _REC_VAL_20_u1 255. _CNV_A_R_LINEAR_____0_CM 0. 255. DISPLAY_IDENTIFIER C_ABC_INC_CAT_DIAG_AFL FORMAT "%3.0" /end CHARACTERISTIC
/begin CHARACTERISTIC lc_diag_cat_diag_afl_deac[0] "Deactivation flag for the TWC lean diagnosis" VALUE 0xa0801b36 _REC_VAL_20_u1 1. _CNV_A_R_LINEAR_____0_CM 0. 1. DISPLAY_IDENTIFIER LC_DIAG_CAT_DIAG_AFL_DEAC[1] FORMAT "%1.0" /end CHARACTERISTIC
/begin CHARACTERISTIC lc_diag_cat_diag_afl_deac[1] "Deactivation flag for the TWC lean diagnosis" VALUE 0xa0801b37 _REC_VAL_20_u1 1. _CNV_A_R_LINEAR_____0_CM 0. 1. DISPLAY_IDENTIFIER LC_DIAG_CAT_DIAG_AFL_DEAC[2] FORMAT "%1.0" /end CHARACTERISTIC
/begin CHARACTERISTIC c_abc_dec_cat_diag_afl "Decrement value for antibounce counter" VALUE 0xa0801a74 _REC_VAL_20_u1 255. _CNV_A_R_LINEAR_____0_CM 0. 255. DISPLAY_IDENTIFIER C_ABC_DEC_CAT_DIAG_AFL FORMAT "%3.0" /end CHARACTERISTIC
/begin CHARACTERISTIC lc_diag_sum_diag_afl "Manually set of end and error sum flags of other relevant diagnosis to passed" VALUE 0xa0801b38 _REC_VAL_20_u1 1. _CNV_A_R_LINEAR_____0_CM 0. 1. DISPLAY_IDENTIFIER LC_DIAG_SUM_DIAG_AFL FORMAT "%1.0" /end CHARACTERISTIC
/begin CHARACTERISTIC c_abc_max_cat_diag_afl "Maximum value for antibounce counter" VALUE 0xa0801a76 _REC_VAL_20_u1 254. _CNV_A_R_LINEAR_____0_CM 1. 255. DISPLAY_IDENTIFIER C_ABC_MAX_CAT_DIAG_AFL FORMAT "%3.0" /end CHARACTERISTIC
/begin CHARACTERISTIC c_state_ns_obd_2_diag_afl "Choice of NS single diagnosis for calculation of summary bits" VALUE 0xa0801b02 _REC_VAL_20_u2 65535. _CNV_A_R_LINEAR_____0_CM 0. 65535. DISPLAY_IDENTIFIER C_STATE_NS_OBD_2_DIAG_AFL FORMAT "%5.0" /end CHARACTERISTIC
/begin CHARACTERISTIC c_t_afl_cdn_out "Maximal time to exit from LEAN_CDN state" VALUE 0xa0801b0c _REC_VAL_20_u2 655.35 _CNV_A_R_LINEAR_____3_CM 0. 655.35 DISPLAY_IDENTIFIER C_T_AFL_CDN_OUT FORMAT "%6.2" /end CHARACTERISTIC
/begin AXIS_PTS ldp_lamb_ls_up_ip_fac_diag_afl "" 0xa0801740 online_dummy _REC_AXS_20_u2 31.9990234375 _CNV_A_R_LINEAR_____129_CM 8 0. 31.9990234375 FORMAT "%7.4" /end AXIS_PTS
/begin CHARACTERISTIC ip_fac_lamb_diag_afl "O2L correction factor depending on lambda" CURVE 0xa0801920 _REC_CUR_20_u1_u2 3.984375 _CNV_A_R_LINEAR_____266_CM 0. 3.984375 DISPLAY_IDENTIFIER IP_FAC_LAMB_DIAG_AFL FORMAT "%8.6"
 /begin AXIS_DESCR COM_AXIS online_dummy _CNV_A_R_LINEAR_____129_CM 8 0. 31.9990234375 FORMAT "%7.4" AXIS_PTS_REF ldp_lamb_ls_up_ip_fac_diag_afl /end AXIS_DESCR
/end CHARACTERISTIC
/begin AXIS_PTS ldp_n_32_ip_fac_diag_afl "" 0xa08017ac n_32 _REC_AXS_20_u1 8160. _CNV_A_R_LINEAR_____10_CM 8 0. 8160. FORMAT "%4.0" /end AXIS_PTS
/begin AXIS_PTS ldp_maf_cyl_ip_fac_diag_afl "" 0xa0801754 maf_cyl _REC_AXS_20_u2 2047.96875 _CNV_A_R_LINEAR_____215_CM 8 0. 2047.96875 FORMAT "%10.5" /end AXIS_PTS
/begin CHARACTERISTIC ip_fac_opp_diag_afl "O2L correction factor depending on operating point" MAP 0xa0801978 _REC_MAP_20_u1_u1_u2 3.984375 _CNV_A_R_LINEAR_____266_CM 0. 3.984375 DISPLAY_IDENTIFIER IP_FAC_OPP_DIAG_AFL FORMAT "%8.6"
 /begin AXIS_DESCR COM_AXIS n_32 _CNV_A_R_LINEAR_____10_CM 8 0. 8160. FORMAT "%4.0" AXIS_PTS_REF ldp_n_32_ip_fac_diag_afl /end AXIS_DESCR
 /begin AXIS_DESCR COM_AXIS maf_cyl _CNV_A_R_LINEAR_____215_CM 8 0. 2047.96875 FORMAT "%10.5" AXIS_PTS_REF ldp_maf_cyl_ip_fac_diag_afl /end AXIS_DESCR
/end CHARACTERISTIC
/begin AXIS_PTS ldp_temp_stat_ip_fac_diag_afl "" 0xa0801878 online_dummy _REC_AXS_20_u2 2047.9375 _CNV_A_R_LINEAR_____214_CM 8 -273.15 1774.7875 FORMAT "%9.4" /end AXIS_PTS
/begin AXIS_PTS ldp_temp_dif_ip_fac_diag_afl "" 0xa0801854 online_dummy _REC_AXS_20_u2 4095.9375 _CNV_A_R_EGCP_LINEA_299_CM 8 -2048. 2047.9375 FORMAT "%10.4" /end AXIS_PTS
/begin CHARACTERISTIC ip_fac_temp_diag_afl "O2L correction factor depending on TWC temperature" MAP 0xa08019b8 _REC_MAP_20_u1_u2_u2 3.984375 _CNV_A_R_LINEAR_____266_CM 0. 3.984375 DISPLAY_IDENTIFIER IP_FAC_TEMP_DIAG_AFL FORMAT "%8.6"
 /begin AXIS_DESCR COM_AXIS online_dummy _CNV_A_R_LINEAR_____214_CM 8 -273.15 1774.7875 FORMAT "%9.4" AXIS_PTS_REF ldp_temp_stat_ip_fac_diag_afl /end AXIS_DESCR
 /begin AXIS_DESCR COM_AXIS online_dummy _CNV_A_R_EGCP_LINEA_299_CM 8 -2048. 2047.9375 FORMAT "%10.4" AXIS_PTS_REF ldp_temp_dif_ip_fac_diag_afl /end AXIS_DESCR
/end CHARACTERISTIC
/begin CHARACTERISTIC c_lamb_o2l_int_clc "Threshold of linear upstream lambda signal for calculation of O2L integral" VALUE 0xa0801aaa _REC_VAL_20_u2 31.9990234375 _CNV_A_R_LINEAR_____129_CM 0. 31.9990234375 DISPLAY_IDENTIFIER C_LAMB_O2L_INT_CLC FORMAT "%7.4" /end CHARACTERISTIC
/begin CHARACTERISTIC c_state_o2l_clc_ena "State to allow of calculation of O2L integrals" VALUE 0xa0801b04 _REC_VAL_20_u1 255. _CNV_A_R_LINEAR_____0_CM 0. 255. DISPLAY_IDENTIFIER C_STATE_O2L_CLC_ENA FORMAT "%3.0" /end CHARACTERISTIC
/begin CHARACTERISTIC c_state_ex_conf "Exhaust gas system configuration" VALUE 0xa0801b00 _REC_VAL_20_u1 3. _CNV_A_R_LINEAR_____0_CM 1. 4. DISPLAY_IDENTIFIER C_STATE_EX_CONF FORMAT "%3.0" /end CHARACTERISTIC
/begin CHARACTERISTIC c_vls_o2l_int_clc "Threshold of binary downstream lambda signal for calculation of O2L integral" VALUE 0xa0801b2c _REC_VAL_20_u2 4.9951171875 _CNV_A_R_LINEAR_____2_CM 0. 4.9951171875 DISPLAY_IDENTIFIER C_VLS_O2L_INT_CLC FORMAT "%5.3" /end CHARACTERISTIC
/begin CHARACTERISTIC c_vls_nox_o2l_int_clc "Threshold of binary NOx Sensor lambda signal for calculation of O2L integral" VALUE 0xa0801b2a _REC_VAL_20_u2 1400. _CNV_A_R_LINEAR_____219_CM -200. 1200. DISPLAY_IDENTIFIER C_VLS_NOX_O2L_INT_CLC FORMAT "%4.0" /end CHARACTERISTIC
/begin CHARACTERISTIC c_state_sens_down_miss_cbk "Indicator for bank without downstream lambda sensor" VALUE 0xa0801b0b _REC_VAL_20_u1 3. _CNV_A_R_LINEAR_____0_CM 1. 4. DISPLAY_IDENTIFIER C_STATE_SENS_DOWN_MISS_CBK FORMAT "%3.0" /end CHARACTERISTIC
/begin CHARACTERISTIC c_state_rgn_cat_diag_afl "Regenerations state for calculation PARK and LOAD at STATE_EX_CONF_2" VALUE 0xa0801b06 _REC_VAL_20_u1 8. _CNV_A_R_LINEAR_____0_CM 0. 8. DISPLAY_IDENTIFIER C_STATE_RGN_CAT_DIAG_AFL FORMAT "%3.0" /end CHARACTERISTIC
/begin AXIS_PTS ldpm_test_rec_idx_mon2 "" 0xa08009b4 test_rec_idx_mon2 _REC_AXS_20_u1 15. _CNV_A_R_LINEAR_____0_CM 15 0. 15. FORMAT "%3.0" /end AXIS_PTS
/begin AXIS_PTS ldpm_iga_dif_av_mon_ip_eff_mon "" 0xa080c8c8 online_dummy _REC_AXS_20_u2 -180. _CNV_A_R_LINEAR_____189_CM 8 0. -180. FORMAT "%8.4" /end AXIS_PTS
/begin AXIS_PTS ldpm_n_32_mon__fac_cha_mon "" 0xa080c8dc n_32 _REC_AXS_20_u1 8160. _CNV_A_R_LINEAR_____10_CM 11 0. 8160. FORMAT "%4.0" /end AXIS_PTS
/begin AXIS_PTS ldpm_n_32_mon_ip_iga_ref_mon "" 0xa080c8f4 n_32 _REC_AXS_20_u1 8160. _CNV_A_R_LINEAR_____10_CM 8 0. 8160. FORMAT "%4.0" /end AXIS_PTS
/begin AXIS_PTS ldpm_n_32_mon_ip_fac_tq_mon "" 0xa080c8e8 n_32_mon _REC_AXS_20_u1 8160. _CNV_A_R_LINEAR_____10_CM 8 0. 8160. FORMAT "%4.0" /end AXIS_PTS
/begin AXIS_PTS ldpm_pv_av_ad_mon_ip_fac_mon "" 0xa080c910 pv_av_ad_mon _REC_AXS_20_u1 99.609375 _CNV_A_R_LINEAR_____5_CM 8 0. 99.609375 FORMAT "%9.6" /end AXIS_PTS
/begin AXIS_PTS ldpm_iga_dif_av_mon2_ip_mon2 "" 0xa080097c online_dummy _REC_AXS_20_u2 -180. _CNV_A_R_LINEAR_____189_CM 8 0. -180. FORMAT "%8.4" /end AXIS_PTS
/begin AXIS_PTS ldpm_n_32_mon2_ip_fac_tq_mon2 "" 0xa0800990 n_32_mon2 _REC_AXS_20_u1 8160. _CNV_A_R_LINEAR_____10_CM 8 0. 8160. FORMAT "%4.0" /end AXIS_PTS
/begin AXIS_PTS ldpm_n_32_mon2_ip_iga_ref_mon2 "" 0xa080099c n_32_mon2 _REC_AXS_20_u1 8160. _CNV_A_R_LINEAR_____10_CM 8 0. 8160. FORMAT "%4.0" /end AXIS_PTS
/begin AXIS_PTS ldpm_pv_av_ad_mon2_ip_fac_mon2 "" 0xa08009a8 pv_av_ad_mon2 _REC_AXS_20_u1 99.609375 _CNV_A_R_LINEAR_____5_CM 8 0. 99.609375 FORMAT "%9.6" /end AXIS_PTS
/begin MEASUREMENT lv_err_pvs_ratio_mon "Logical variable for ratio-error between PVS channel 1 and 2" UBYTE _CNV_S_2_RANGE__0___1_CM 1 100. 0. 1. DISPLAY_IDENTIFIER LV_ERR_PVS_RATIO_MON ECU_ADDRESS 0xd000742c BIT_MASK 0x1 /end MEASUREMENT
/begin MEASUREMENT abc_pvs_ratio_mon "Anti bounce counter PVS ratio error" UBYTE _CNV_A_R_LINEAR_____0_CM 1 100. 0. 255. DISPLAY_IDENTIFIER ABC_PVS_RATIO_MON ECU_ADDRESS 0xd0001dde FORMAT "%3.0" /end MEASUREMENT
/begin MEASUREMENT pv_av_1_mon "Degree of activation of the accelerator pedal (channel 1)" UBYTE _CNV_A_R_LINEAR_____5_CM 1 100. 0. 99.609375 DISPLAY_IDENTIFIER PV_AV_1_MON ECU_ADDRESS 0xd0001e13 FORMAT "%9.6" /end MEASUREMENT
/begin MEASUREMENT pv_av_2_mon "Degree of activation of the accelerator pedal (channel 2)" UBYTE _CNV_A_R_LINEAR_____5_CM 1 100. 0. 99.609375 DISPLAY_IDENTIFIER PV_AV_2_MON ECU_ADDRESS 0xd0001e14 FORMAT "%9.6" /end MEASUREMENT
/begin MEASUREMENT lv_err_pvs_mon "Logical variable for different PVS diagnosis between L1 and L2" UBYTE _CNV_S_2_RANGE__0___1_CM 1 100. 0. 1. DISPLAY_IDENTIFIER LV_ERR_PVS_MON ECU_ADDRESS 0xd000742a BIT_MASK 0x1 /end MEASUREMENT
/begin MEASUREMENT pv_av_mon "Level 2 degree of activation of the accelerator pedal" UBYTE _CNV_A_R_LINEAR_____5_CM 1 100. 0. 99.609375 DISPLAY_IDENTIFIER PV_AV_MON ECU_ADDRESS 0xd0007405 FORMAT "%9.6" /end MEASUREMENT
/begin CHARACTERISTIC c_n_min_pvs_diag_mon "Minimum engine speed for PVS diagnosis" VALUE 0xa080cca3 _REC_VAL_20_u1 8160. _CNV_A_R_LINEAR_____10_CM 0. 8160. DISPLAY_IDENTIFIER C_N_MIN_PVS_DIAG_MON FORMAT "%4.0" /end CHARACTERISTIC
/begin CHARACTERISTIC c_abc_inc_pvs_ratio_mon "Anti bounce counter increment (additive value in case of error)" VALUE 0xa080cc4a _REC_VAL_20_u1 255. _CNV_A_R_LINEAR_____0_CM 0. 255. DISPLAY_IDENTIFIER C_ABC_INC_PVS_RATIO_MON FORMAT "%3.0" /end CHARACTERISTIC
/begin CHARACTERISTIC c_abc_max_pvs_ratio_mon "Value at which ratio error is recognized, when reached" VALUE 0xa080cc65 _REC_VAL_20_u1 254. _CNV_A_R_LINEAR_____0_CM 1. 255. DISPLAY_IDENTIFIER C_ABC_MAX_PVS_RATIO_MON FORMAT "%3.0" /end CHARACTERISTIC
/begin CHARACTERISTIC c_v_pvs_is_thd_1_mon "Threshold for idle speed PVS channel 1" VALUE 0xa080ccfa _REC_VAL_20_u2 4.9951171875 _CNV_A_R_LINEAR_____2_CM 0. 4.9951171875 DISPLAY_IDENTIFIER C_V_PVS_IS_THD_1_MON FORMAT "%5.3" /end CHARACTERISTIC
/begin CHARACTERISTIC c_v_pvs_is_thd_2_mon "Threshold for idle speed PVS channel 2" VALUE 0xa080ccfc _REC_VAL_20_u2 4.9951171875 _CNV_A_R_LINEAR_____2_CM 0. 4.9951171875 DISPLAY_IDENTIFIER C_V_PVS_IS_THD_2_MON FORMAT "%5.3" /end CHARACTERISTIC
/begin CHARACTERISTIC c_v_pvs_slop_1_mon "Slope of the PVS channel 1" VALUE 0xa080ccfe _REC_VAL_20_u1 79.6875 _CNV_A_R_LINEAR_____249_CM 0. 79.6875 DISPLAY_IDENTIFIER C_V_PVS_SLOP_1_MON FORMAT "%7.4" /end CHARACTERISTIC
/begin CHARACTERISTIC c_v_pvs_slop_2_mon "Slope of the PVS channel 2" VALUE 0xa080ccff _REC_VAL_20_u1 159.375 _CNV_A_R_ECM2_LINEA_844_CM 0. 159.375 DISPLAY_IDENTIFIER C_V_PVS_SLOP_2_MON FORMAT "%7.3" /end CHARACTERISTIC
/begin CHARACTERISTIC c_pv_lih_max_mon "Max. pedal position on case of any PVS error" VALUE 0xa080ccb2 _REC_VAL_20_u1 99.609375 _CNV_A_R_LINEAR_____5_CM 0. 99.609375 DISPLAY_IDENTIFIER C_PV_LIH_MAX_MON FORMAT "%9.6" /end CHARACTERISTIC
/begin MEASUREMENT v_pvs_1_mon "Pedal value sensor 1 raw acquisition" UWORD _CNV_A_R_LINEAR_____2_CM 1 100. 0. 4.9951171875 DISPLAY_IDENTIFIER V_PVS_1_MON ECU_ADDRESS 0xd00065e0 FORMAT "%5.3" /end MEASUREMENT
/begin MEASUREMENT v_pvs_2_mon "Pedal value sensor 2 raw acquisition" UWORD _CNV_A_R_LINEAR_____2_CM 1 100. 0. 4.9951171875 DISPLAY_IDENTIFIER V_PVS_2_MON ECU_ADDRESS 0xd00065e2 FORMAT "%5.3" /end MEASUREMENT
/begin CHARACTERISTIC ip_v_thd_ratio_chk_pvs_mon "Maximum PV ratio error allowed" CURVE 0xa080cc36 _REC_CUR_20_u1_u1 4.98046875 _CNV_A_R_LINEAR_____207_CM 0. 4.98046875 DISPLAY_IDENTIFIER IP_V_THD_RATIO_CHK_PVS_MON FORMAT "%4.2"
 /begin AXIS_DESCR COM_AXIS online_dummy _CNV_A_R_LINEAR_____207_CM 6 0. 4.98046875 FORMAT "%4.2" AXIS_PTS_REF ldp_v_min_pv_mon_ip_v_pvs_mon /end AXIS_DESCR
/end CHARACTERISTIC
/begin AXIS_PTS ldp_v_min_pv_mon_ip_v_pvs_mon "" 0xa080c8a0 online_dummy _REC_AXS_20_u1 4.98046875 _CNV_A_R_LINEAR_____207_CM 6 0. 4.98046875 FORMAT "%4.2" /end AXIS_PTS
/begin MEASUREMENT fac_v_slop_pvs_mon "Factor for correction of slop of channel 2 in ratio check" UBYTE _CNV_A_R_LINEAR_____266_CM 1 100. 0. 3.984375 DISPLAY_IDENTIFIER FAC_V_SLOP_PVS_MON ECU_ADDRESS 0xd0001e03 FORMAT "%8.6" /end MEASUREMENT
/begin MEASUREMENT tco_mon "Coolant temperature(monitoring level)" UBYTE _CNV_A_R_LINEAR_____17_CM 1 100. -48. 142.5 DISPLAY_IDENTIFIER TCO_MON ECU_ADDRESS 0xd000740d FORMAT "%6.2" /end MEASUREMENT
/begin MEASUREMENT t_tco_grd_mon "Timer for negative TCO gradient limitation" UBYTE _CNV_A_R_LINEAR_____261_CM 1 100. 0. 10.2 DISPLAY_IDENTIFIER T_TCO_GRD_MON ECU_ADDRESS 0xd0001e24 FORMAT "%5.2" /end MEASUREMENT
/begin CHARACTERISTIC c_tco_grd_max_mon "Maximum negative gradient for the coolant temperature" VALUE 0xa080ccc8 _REC_VAL_20_u1 190.5 _CNV_A_R_LINEAR_____25_CM 0. 190.5 DISPLAY_IDENTIFIER C_TCO_GRD_MAX_MON FORMAT "%6.2" /end CHARACTERISTIC
/begin CHARACTERISTIC c_t_tco_grd_max_mon "Minimum time before a new change fo TCO_MON is allowed" VALUE 0xa080ccc6 _REC_VAL_20_u1 10.2 _CNV_A_R_LINEAR_____261_CM 0. 10.2 DISPLAY_IDENTIFIER C_T_TCO_GRD_MAX_MON FORMAT "%5.2" /end CHARACTERISTIC
/begin CHARACTERISTIC c_tco_thd_min_mon "Threshold for the min. TCO temp. while TCO_SUB is higher than C_TCO_SUB_THD_MAX_MON" VALUE 0xa080cccc _REC_VAL_20_u1 190.5 _CNV_A_R_LINEAR_____17_CM -48. 142.5 DISPLAY_IDENTIFIER C_TCO_THD_MIN_MON FORMAT "%6.2" /end CHARACTERISTIC
/begin CHARACTERISTIC c_tco_sub_thd_max_mon "Threshold for the max. TCO_SUB temp. while TCO is lower than C_TCO_THD_MIN_MON" VALUE 0xa080ccca _REC_VAL_20_u2 190.5 _CNV_A_R_LINEAR_____439_CM -48. 142.5 DISPLAY_IDENTIFIER C_TCO_SUB_THD_MAX_MON FORMAT "%7.3" /end CHARACTERISTIC
/begin COMPU_METHOD _CNV_A_R_LINEAR_____0_CM "" RAT_FUNC "%6.3" "-" COEFFS 0 1. 0. 0 0 1 /end COMPU_METHOD
/begin COMPU_METHOD _CNV_S_2_RANGE__0___1_CM "" TAB_VERB "%6.3" "-" COMPU_TAB_REF _CNV_S_2_RANGE__0___1 /end COMPU_METHOD
/begin COMPU_VTAB _CNV_S_2_RANGE__0___1 "" TAB_VERB 2 0 "0" 1 "1" /end COMPU_VTAB
/begin COMPU_METHOD _CNV_A_R_LINEAR_____2_CM "" RAT_FUNC "%6.3" "V" COEFFS 0 204.8 0. 0 0 1 /end COMPU_METHOD
/begin COMPU_METHOD _CNV_A_R_LINEAR_____3_CM "" RAT_FUNC "%6.3" "s" COEFFS 0 100. 0. 0 0 1 /end COMPU_METHOD
/begin COMPU_METHOD _CNV_A_R_LINEAR_____4_CM "" RAT_FUNC "%6.3" "s" COEFFS 0 10. 0. 0 0 1 /end COMPU_METHOD
/begin COMPU_METHOD _CNV_A_R_LINEAR_____5_CM "" RAT_FUNC "%6.3" "%" COEFFS 0 2.56 0. 0 0 1 /end COMPU_METHOD
/begin COMPU_METHOD _CNV_A_R_LINEAR_____6_CM "" RAT_FUNC "%6.3" "km/h" COEFFS 0 1. 0. 0 0 1 /end COMPU_METHOD
/begin COMPU_METHOD _CNV_A_R_LINEAR_____8_CM "" RAT_FUNC "%6.3" "%" COEFFS 0 655.3599999999997 0. 0 0 1 /end COMPU_METHOD
/begin COMPU_METHOD _CNV_A_R_LINEAR_____9_CM "" RAT_FUNC "%6.3" "-" COEFFS 0 32767.99999999992 0. 0 0 1 /end COMPU_METHOD
/begin COMPU_METHOD _CNV_A_R_LINEAR_____10_CM "" RAT_FUNC "%6.3" "rpm" COEFFS 0 3.125e-002 0. 0 0 1 /end COMPU_METHOD
/begin COMPU_METHOD _CNV_A_R_LINEAR_____14_CM "" RAT_FUNC "%6.3" "rpm" COEFFS 0 1. 0. 0 0 1 /end COMPU_METHOD
/begin COMPU_METHOD _CNV_A_R_LINEAR_____15_CM "" RAT_FUNC "%6.3" "mg/stk" COEFFS 0 0.183585313174946 0. 0 0 1 /end COMPU_METHOD
/begin COMPU_METHOD _CNV_A_R_LINEAR_____17_CM "" RAT_FUNC "%6.3" "°C" COEFFS 0 1.333333333333333 64. 0 0 1 /end COMPU_METHOD
/begin COMPU_METHOD _CNV_A_R_LINEAR_____24_CM "" RAT_FUNC "%6.3" "-" COEFFS 0 16384. 0. 0 0 1 /end COMPU_METHOD
/begin COMPU_METHOD _CNV_A_R_LINEAR_____25_CM "" RAT_FUNC "%6.3" "°C" COEFFS 0 1.333333333333333 0. 0 0 1 /end COMPU_METHOD
/begin COMPU_METHOD _CNV_A_R_LINEAR_____27_CM "" RAT_FUNC "%6.3" "hPa" COEFFS 0 12.06017666543982 0. 0 0 1 /end COMPU_METHOD
/begin COMPU_METHOD _CNV_A_R_LINEAR_____28_CM "" RAT_FUNC "%6.3" "-" COEFFS 0 256. 0. 0 0 1 /end COMPU_METHOD
/begin COMPU_METHOD _CNV_A_R_LINEAR_____89_CM "" RAT_FUNC "%6.3" "-" COEFFS 0 65535.99999999996 0. 0 0 1 /end COMPU_METHOD
/begin COMPU_METHOD _CNV_A_R_LINEAR_____103_CM "" RAT_FUNC "%6.3" "-" COEFFS 0 128. 0. 0 0 1 /end COMPU_METHOD
/begin COMPU_METHOD _CNV_A_R_LINEAR_____110_CM "" RAT_FUNC "%6.3" "s" COEFFS 0 50. 0. 0 0 1 /end COMPU_METHOD
/begin COMPU_METHOD _CNV_A_R_LINEAR_____111_CM "" RAT_FUNC "%6.3" "mg/stk" COEFFS 0 47.18142548596112 0. 0 0 1 /end COMPU_METHOD
/begin COMPU_METHOD _CNV_A_R_LINEAR_____113_CM "" RAT_FUNC "%6.3" "%" COEFFS 0 655.3599999999997 -1.455191522836685e-011 0 0 1 /end COMPU_METHOD
/begin COMPU_METHOD _CNV_A_R_LINEAR_____129_CM "" RAT_FUNC "%6.3" "-" COEFFS 0 1024. 0. 0 0 1 /end COMPU_METHOD
/begin COMPU_METHOD _CNV_A_R_LINEAR_____130_CM "" RAT_FUNC "%6.3" "°C" COEFFS 0 16. 0. 0 0 1 /end COMPU_METHOD
/begin COMPU_METHOD _CNV_A_R_CYBL_LINEA_135_CM "" RAT_FUNC "%6.3" "g" COEFFS 0 45.00010299863355 0. 0 0 1 /end COMPU_METHOD
/begin COMPU_METHOD _CNV_A_R_LINEAR_____189_CM "" RAT_FUNC "%6.3" "°CRK" COEFFS 0 -16. 0. 0 0 1 /end COMPU_METHOD
/begin COMPU_METHOD _CNV_A_R_LINEAR_____207_CM "" RAT_FUNC "%6.3" "V" COEFFS 0 51.2 0. 0 0 1 /end COMPU_METHOD
/begin COMPU_METHOD _CNV_A_R_LINEAR_____214_CM "" RAT_FUNC "%6.3" "°C" COEFFS 0 16. 4370.4 0 0 1 /end COMPU_METHOD
/begin COMPU_METHOD _CNV_A_R_LINEAR_____215_CM "" RAT_FUNC "%6.3" "kg/h" COEFFS 0 32. 0. 0 0 1 /end COMPU_METHOD
/begin COMPU_METHOD _CNV_A_R_LINEAR_____219_CM "" RAT_FUNC "%6.3" "mV" COEFFS 0 1. 200. 0 0 1 /end COMPU_METHOD
/begin COMPU_METHOD _CNV_A_R_LINEAR_____249_CM "" RAT_FUNC "%6.3" "%/V" COEFFS 0 3.2 0. 0 0 1 /end COMPU_METHOD
/begin COMPU_METHOD _CNV_A_R_LINEAR_____259_CM "" RAT_FUNC "%6.3" "-" COEFFS 0 32768. 0. 0 0 1 /end COMPU_METHOD
/begin COMPU_METHOD _CNV_A_R_LINEAR_____261_CM "" RAT_FUNC "%6.3" "s" COEFFS 0 25. 0. 0 0 1 /end COMPU_METHOD
/begin COMPU_METHOD _CNV_A_R_LINEAR_____266_CM "" RAT_FUNC "%6.3" "-" COEFFS 0 64. 0. 0 0 1 /end COMPU_METHOD
/begin COMPU_METHOD _CNV_A_R_EVAC_LINEA_298_CM "" RAT_FUNC "%6.3" "-" COEFFS 0 16. 0. 0 0 1 /end COMPU_METHOD
/begin COMPU_METHOD _CNV_A_R_EGCP_LINEA_299_CM "Battery voltage" RAT_FUNC "%6.3" "°C" COEFFS 0 16. 32768. 0 0 1 /end COMPU_METHOD
/begin COMPU_METHOD _CNV_A_R_LINEAR_____314_CM "" RAT_FUNC "%6.3" "g" COEFFS 0 22.49999999999997 0. 0 0 1 /end COMPU_METHOD
/begin COMPU_METHOD _CNV_A_R_LINEAR_____439_CM "" RAT_FUNC "%6.3" "°C" COEFFS 0 341.3333333333333 16384. 0 0 1 /end COMPU_METHOD
/begin COMPU_METHOD _CNV_A_R_CPULOAD__0_448_CM "" RAT_FUNC "%6.3" "%" COEFFS 0 10.24 0. 0 0 1 /end COMPU_METHOD
/begin COMPU_METHOD _CNV_A_R_LINEAR_____522_CM "" RAT_FUNC "%6.3" "°C" COEFFS 0 0.5 0. 0 0 1 /end COMPU_METHOD
/begin COMPU_METHOD _CNV_A_R_EGTR_LINEA_811_CM "" RAT_FUNC "%6.3" "°C" COEFFS 0 15.99998046817778 4370.39466488276 0 0 1 /end COMPU_METHOD
/begin COMPU_METHOD _CNV_A_R_LINEAR_____812_CM "" RAT_FUNC "%6.3" "g" COEFFS 0 25043.4782608696 0. 0 0 1 /end COMPU_METHOD
/begin COMPU_METHOD _CNV_A_R_LINEAR_____813_CM "" RAT_FUNC "%6.3" "-" COEFFS 0 1024.000001200037 0. 0 0 1 /end COMPU_METHOD
/begin COMPU_METHOD _CNV_S_7_EGTR_RANGE_814_CM "" TAB_VERB "%6.3" "-" COMPU_TAB_REF _CNV_S_7_EGTR_RANGE_814 /end COMPU_METHOD
/begin COMPU_VTAB _CNV_S_7_EGTR_RANGE_814 "" TAB_VERB 7 0 "PLS_OFF" 1 "PLS_LSH_DIAG" 2 "PLS_CAT_DIAG" 3 "PLS_CAT_DIAG_TRAN" 4 "PLS_DYN_DIAG" 5 "PLS_IS" 6 "PLS_NOM" /end COMPU_VTAB
/begin COMPU_METHOD _CNV_A_R_EGTR_LINEA_815_CM "" RAT_FUNC "%6.3" "°C" COEFFS 0 0.125 34.14375 0 0 1 /end COMPU_METHOD
/begin COMPU_METHOD _CNV_A_R_LINEAR_____816_CM "" RAT_FUNC "%6.3" "-" COEFFS 0 204.8 0. 0 0 1 /end COMPU_METHOD
/begin COMPU_METHOD _CNV_A_R_EGTR_LINEA_817_CM "" RAT_FUNC "%6.3" "%/s" COEFFS 0 0.4095988699858748 0. 0 0 1 /end COMPU_METHOD
/begin COMPU_METHOD _CNV_A_R_EGTR_LINEA_818_CM "" RAT_FUNC "%6.3" "%/s" COEFFS 0 0.4095997693749099 -2.882813626001735e-004 0 0 1 /end COMPU_METHOD
/begin COMPU_METHOD _CNV_A_R_EGTR_LINEA_819_CM "" RAT_FUNC "%6.3" "g" COEFFS 0 3205565.216910782 1.102782249450684 0 0 1 /end COMPU_METHOD
/begin COMPU_METHOD _CNV_A_R_EGTR_LINEA_820_CM "" RAT_FUNC "%6.3" "-" COEFFS 0 131072.0971535545 2.428838861669647e-002 0 0 1 /end COMPU_METHOD
/begin COMPU_METHOD _CNV_S_3_EGTR_RANGE_821_CM "" TAB_VERB "%6.3" "-" COMPU_TAB_REF _CNV_S_3_EGTR_RANGE_821 /end COMPU_METHOD
/begin COMPU_VTAB _CNV_S_3_EGTR_RANGE_821 "" TAB_VERB 3 0 "OFF" 1 "AFL" 2 "AFR" /end COMPU_VTAB
/begin COMPU_METHOD _CNV_S_6_EGTR_RANGE_822_CM "" TAB_VERB "%6.3" "-" COMPU_TAB_REF _CNV_S_6_EGTR_RANGE_822 /end COMPU_METHOD
/begin COMPU_VTAB _CNV_S_6_EGTR_RANGE_822 "" TAB_VERB 6 0 "CAT_PURGE_OFF" 1 "CAT_PURGE_PUC" 2 "CAT_PURGE_SA" 3 "CAT_PURGE_HST" 4 "CAT_PURGE_CH" 5 "CAT_PURGE_GS_SCC" /end COMPU_VTAB
/begin COMPU_METHOD _CNV_A_R_EGTR_LINEA_823_CM "" RAT_FUNC "%6.3" "-" COEFFS 0 32767.99999237061 0. 0 0 1 /end COMPU_METHOD
/begin COMPU_METHOD _CNV_A_R_EGTR_LINEA_824_CM "" RAT_FUNC "%6.3" "g" COEFFS 0 801391.5978306726 0. 0 0 1 /end COMPU_METHOD
/begin COMPU_METHOD _CNV_A_R_EGTR_LINEA_825_CM "" RAT_FUNC "%6.3" "g/ms" COEFFS 0 32055652.15349685 0. 0 0 1 /end COMPU_METHOD
/begin COMPU_METHOD _CNV_A_R_EGTR_LINEA_826_CM "" RAT_FUNC "%6.3" "°C" COEFFS 0 0.5 128. 0 0 1 /end COMPU_METHOD
/begin COMPU_METHOD _CNV_S_6_EGTR_RANGE_827_CM "" TAB_VERB "%6.3" "-" COMPU_TAB_REF _CNV_S_6_EGTR_RANGE_827 /end COMPU_METHOD
/begin COMPU_VTAB _CNV_S_6_EGTR_RANGE_827 "" TAB_VERB 6 0 "PASSIVE" 1 "WAIT" 2 "CYC_LEAN" 3 "CYC_RICH" 4 "END" 5 "RAMP_UP" /end COMPU_VTAB
/begin COMPU_METHOD _CNV_A_R_EGTR_LINEA_828_CM "" RAT_FUNC "%6.3" "g" COEFFS 0 3130.435031829792 0. 0 0 1 /end COMPU_METHOD
/begin COMPU_METHOD _CNV_A_R_EGTR_LINEA_829_CM "" RAT_FUNC "%6.3" "g" COEFFS 0 25043.4782608696 32767.99999999993 0 0 1 /end COMPU_METHOD
/begin COMPU_METHOD _CNV_S_4_RANGE_STAT_830_CM "" TAB_VERB "%6.3" "-" COMPU_TAB_REF _CNV_S_4_RANGE_STAT_830 /end COMPU_METHOD
/begin COMPU_VTAB _CNV_S_4_RANGE_STAT_830 "" TAB_VERB 4 0 "PASSIVE" 1 "RICH_CDN" 2 "LEAN_CDN" 3 "WAIT" /end COMPU_VTAB
/begin COMPU_METHOD _CNV_A_R_ECM2_LINEA_844_CM "" RAT_FUNC "%6.3" "%/V" COEFFS 0 1.6 0. 0 0 1 /end COMPU_METHOD
/begin RECORD_LAYOUT _REC_VAL_20_u1 FNC_VALUES 1 UBYTE COLUMN_DIR DIRECT /end RECORD_LAYOUT
/begin RECORD_LAYOUT _REC_VAL_20_u2 FNC_VALUES 1 UWORD COLUMN_DIR DIRECT /end RECORD_LAYOUT
/begin RECORD_LAYOUT _REC_AXS_20_u1 NO_AXIS_PTS_X 1 UBYTE AXIS_PTS_X 2 UBYTE INDEX_INCR DIRECT /end RECORD_LAYOUT
/begin RECORD_LAYOUT _REC_MAP_20_u2_u1_u1 FNC_VALUES 1 UWORD COLUMN_DIR DIRECT /end RECORD_LAYOUT
/begin RECORD_LAYOUT _REC_CUR_20_u1_u1 FNC_VALUES 1 UBYTE COLUMN_DIR DIRECT /end RECORD_LAYOUT
/begin RECORD_LAYOUT _REC_VAL_20_s2 FNC_VALUES 1 SWORD COLUMN_DIR DIRECT /end RECORD_LAYOUT
/begin RECORD_LAYOUT _REC_MAP_20_u2_u2_u1 FNC_VALUES 1 UWORD COLUMN_DIR DIRECT /end RECORD_LAYOUT
/begin RECORD_LAYOUT _REC_AXS_20_u2 NO_AXIS_PTS_X 1 UWORD AXIS_PTS_X 2 UWORD INDEX_INCR DIRECT /end RECORD_LAYOUT
/begin RECORD_LAYOUT _REC_CUR_20_u2_u1 FNC_VALUES 1 UWORD COLUMN_DIR DIRECT /end RECORD_LAYOUT
/begin RECORD_LAYOUT _REC_CUR_20_u2_u2 FNC_VALUES 1 UWORD COLUMN_DIR DIRECT /end RECORD_LAYOUT
/begin RECORD_LAYOUT _REC_CUR_20_u1_u2 FNC_VALUES 1 UBYTE COLUMN_DIR DIRECT /end RECORD_LAYOUT
/begin RECORD_LAYOUT _REC_MAP_20_u2_u2_u2 FNC_VALUES 1 UWORD COLUMN_DIR DIRECT /end RECORD_LAYOUT
/begin RECORD_LAYOUT _REC_MAP_20_u2_u1_u2 FNC_VALUES 1 UWORD COLUMN_DIR DIRECT /end RECORD_LAYOUT
/begin RECORD_LAYOUT _REC_MAP_20_u1_u2_u2 FNC_VALUES 1 UBYTE COLUMN_DIR DIRECT /end RECORD_LAYOUT
/begin RECORD_LAYOUT _REC_MAP_20_u1_u1_u1 FNC_VALUES 1 UBYTE COLUMN_DIR DIRECT /end RECORD_LAYOUT
/begin RECORD_LAYOUT _REC_MAP_20_u1_u2_u1 FNC_VALUES 1 UBYTE COLUMN_DIR DIRECT /end RECORD_LAYOUT
/begin RECORD_LAYOUT _REC_MAP_20_u1_u1_u2 FNC_VALUES 1 UBYTE COLUMN_DIR DIRECT /end RECORD_LAYOUT
/begin FUNCTION IGRE_Ignition_diagnosis "Ignition_diagnosis"
 /begin DEF_CHARACTERISTIC c_abc_igc_scp c_iga_off_cycnr_hld c_sum_igc_scp c_esb_ign_cut_diag c_n_32_min_scp_igc_diag c_n_32_min_ol_scg_igc_diag c_tco_min_igc_diag c_tco_td_ad_swi /end DEF_CHARACTERISTIC
 /begin OUT_MEASUREMENT igc_diag_mis lv_err_igc_scp_0 lv_err_igc_scp_1 lv_err_igc_scp_2 lv_err_igc_scp_3 lv_err_igc_scp_4 lv_err_igc_scp_5 lv_err_igc_scp_6 lv_err_igc_scp_7 lv_err_igc_scg_0 lv_err_igc_scg_1 lv_err_igc_scg_2 lv_err_igc_scg_3 lv_err_igc_scg_4 lv_err_igc_scg_5 lv_err_igc_scg_6 lv_err_igc_scg_7 lv_err_igc_ol_1 lv_err_igc_ol_2 lv_err_igc_ol_3 lv_err_igc_ol_4 lv_err_igc_ol_5 lv_err_igc_ol_6 lv_err_igc_ol_7 lv_inh_igc[0] lv_inh_igc[1] lv_inh_igc[2] lv_inh_igc[3] lv_inh_igc[4] lv_inh_igc[5] lv_inh_igc[6] lv_inh_igc[7] lv_err_igc_ol_0 lv_inh_inj_diag_igc lv_err_igc lv_err_dur_igc_mpl lv_td_ad_acq_vld lv_td_ad_swi ctr_td_ad_swi /end OUT_MEASUREMENT
/end FUNCTION
/begin FUNCTION IGRE_Appli_inci_ignition_diag "Appli_inci_ignition_diag"
 /begin DEF_CHARACTERISTIC c_abc_inc_igc_scp c_abc_inc_igc_ol c_abc_inc_igc_scg c_abc_inc_dur_igc_mpl c_abc_dec_dur_igc_mpl c_abc_max_igc_scp c_abc_max_igc_scg c_abc_max_igc_ol c_abc_max_dur_igc_mpl /end DEF_CHARACTERISTIC
 /begin OUT_MEASUREMENT inh_iv_igc lv_inh_diag_igc_scp lv_inh_diag_igc_scg lv_inh_diag_igc_ol lv_inh_diag_dur_igc_mpl /end OUT_MEASUREMENT
/end FUNCTION
/begin FUNCTION C_7_EGTR "C_7_EGTR"
 /begin DEF_CHARACTERISTIC ldpm_maf_hb_1_egtr ldpm_eff_cat_diag_1_egtr ldpm_n_32_1_egtr /end DEF_CHARACTERISTIC
 /begin SUB_FUNCTION EGTR_Activ_forced_lambda_stim EGTR_Coord_forced_lambda_stim EGTR_Forced_lambda_stim_linear EGTR_Det_forced_lambda_stim EGTR_Coord_catalyst_enrichment EGTR_Appl_inci_forced_lambda EGTR_Catalyst_enrichment EGTR_O2L_det_cat_enrichment EGTR_Appl_inci_cat_enrichment /end SUB_FUNCTION
/end FUNCTION
/begin FUNCTION EGTR_Activ_forced_lambda_stim "_Activ_forced_lambda_stim"
 /begin DEF_CHARACTERISTIC c_lamb_sp_de_thd_lamb_pls_off c_lamb_sp_de_thd_lamb_pls_on c_lamb_sp_max_lamb_pls_act c_lamb_sp_min_lamb_pls_act c_maf_int_min_lamb_pls_act c_temp_cat_min_lamb_pls_act /end DEF_CHARACTERISTIC
 /begin OUT_MEASUREMENT egtr[0].egtr_struct_defspfstia0.maf_int_lamb_pls_act egtr[0].egtr_struct_defspfstia0.lv_lamb_pls_act egtr[0].egtr_struct_defspfstia0.lv_lamb_pls_diag_lsh_up egtr[0].egtr_struct_defspfstia0.lv_lamb_pls_act_cat_purge egtr[1].egtr_struct_defspfstia0.maf_int_lamb_pls_act egtr[1].egtr_struct_defspfstia0.lv_lamb_pls_act egtr[1].egtr_struct_defspfstia0.lv_lamb_pls_diag_lsh_up egtr[1].egtr_struct_defspfstia0.lv_lamb_pls_act_cat_purge /end OUT_MEASUREMENT
/end FUNCTION
/begin FUNCTION EGTR_Coord_forced_lambda_stim "_Coord_forced_lambda_stim"
 /begin DEF_CHARACTERISTIC c_fac_dif_thd_afl_pls_on c_fac_dif_thd_afl_pls_off c_fac_dif_thd_afr_pls_off c_fac_dif_thd_afr_pls_on lc_lamb_pls_cor_act_is lc_lamb_pls_ext /end DEF_CHARACTERISTIC
 /begin OUT_MEASUREMENT egtr[0].egtr_struct_defspfstic0.lamb_pls egtr[0].egtr_struct_defspfstic0.lv_lamb_pls_afl_cor_act egtr[0].egtr_struct_defspfstic0.lv_lamb_pls_afr_cor_act egtr[1].egtr_struct_defspfstic0.lamb_pls egtr[1].egtr_struct_defspfstic0.lv_lamb_pls_afl_cor_act egtr[1].egtr_struct_defspfstic0.lv_lamb_pls_afr_cor_act /end OUT_MEASUREMENT
/end FUNCTION
/begin FUNCTION EGTR_Forced_lambda_stim_linear "_Forced_lambda_stim_linear" /begin DEF_CHARACTERISTIC lc_o2l_pls_cbk_syn /end DEF_CHARACTERISTIC
 /begin OUT_MEASUREMENT lv_lamb_pls_syn_cbk egtr[0].egtr_struct_defspfsti0.o2l_add_lamb_pls egtr[0].egtr_struct_defspfsti0.o2l_lamb_pls egtr[0].egtr_struct_defspfsti0.o2l_sp_new_lamb_pls egtr[0].egtr_struct_defspfsti0.lamb_pls_o2l_osc egtr[0].egtr_struct_defspfsti0.fac_o2l_lamb_pls egtr[0].egtr_struct_defspfsti0.o2l_sp_half_lamb_pls egtr[0].egtr_struct_defspfsti0.state_lamb_pls egtr[0].egtr_struct_defspfsti0.lv_lamb_pls_o2l_osc_pos egtr[0].egtr_struct_defspfsti0.lv_lamb_pls_mst_cbk egtr[1].egtr_struct_defspfsti0.o2l_add_lamb_pls egtr[1].egtr_struct_defspfsti0.o2l_lamb_pls egtr[1].egtr_struct_defspfsti0.o2l_sp_new_lamb_pls egtr[1].egtr_struct_defspfsti0.lamb_pls_o2l_osc egtr[1].egtr_struct_defspfsti0.fac_o2l_lamb_pls egtr[1].egtr_struct_defspfsti0.o2l_sp_half_lamb_pls egtr[1].egtr_struct_defspfsti0.state_lamb_pls egtr[1].egtr_struct_defspfsti0.lv_lamb_pls_o2l_osc_pos egtr[1].egtr_struct_defspfsti0.lv_lamb_pls_mst_cbk /end OUT_MEASUREMENT
/end FUNCTION
/begin FUNCTION EGTR_Det_forced_lambda_stim "_Det_forced_lambda_stim"
 /begin DEF_CHARACTERISTIC c_lamb_delta_max_is_pls c_lamb_delta_max_lsh_diag_pls c_lamb_sp_de_dyn_diag_pls c_lamb_sp_de_is_pls c_lamb_sp_de_lsh_diag_pls c_nr_step_pls_nom_cat_diag c_o2l_sp_is_pls c_o2l_sp_lsh_diag_pls ldp_eff_cat_diag_ip_fac_1_pls ldp_t_ast_ip_fac_2_pls ip_fac_2_lamb_sp_de_pls ldp_temp_cat_ip_fac_2_pls ip_fac_1_lamb_sp_de_pls ip_lamb_delta_max_cat_diag_pls ip_lamb_delta_max_nom_pls ip_lamb_sp_de_cat_diag_pls ip_lamb_sp_de_nom_pls ip_o2l_sp_cat_diag_pls ip_o2l_sp_dyn_diag_pls ip_o2l_sp_nom_pls /end DEF_CHARACTERISTIC
 /begin OUT_MEASUREMENT state_lamb_pls_det_value lamb_sp_de_pls lamb_delta_max_pls ctr_step_pls_nom_cat_diag o2l_sp_pls /end OUT_MEASUREMENT
/end FUNCTION
/begin FUNCTION EGTR_Coord_catalyst_enrichment "_Coord_catalyst_enrichment"
 /begin OUT_MEASUREMENT egtr[0].egtr_struct_defspcenrc0.lamb_sp_delta_cat_purge egtr[1].egtr_struct_defspcenrc0.lamb_sp_delta_cat_purge /end OUT_MEASUREMENT
/end FUNCTION
/begin FUNCTION EGTR_Appl_inci_forced_lambda "_Appl_inci_forced_lambda"
 /begin DEF_CHARACTERISTIC lc_lamb_sti_off_lsl_ofs_adj lc_lamb_pls_inh[0] lc_lamb_pls_inh[1] /end DEF_CHARACTERISTIC
 /begin OUT_MEASUREMENT egtr[0].egtr_struct_defspfstii0.lv_inh_lamb_pls egtr[1].egtr_struct_defspfstii0.lv_inh_lamb_pls /end OUT_MEASUREMENT
/end FUNCTION
/begin FUNCTION EGTR_Catalyst_enrichment "_Catalyst_enrichment"
 /begin DEF_CHARACTERISTIC c_vls_down_thd_cat_purge ldp_temp_main_cat_purge_ip_fac ldp_maf_cyl_ip_lamb_sp ldp_ratio_o2l_rls_ip_lamb_sp ip_fac_main_cat_purge ip_lamb_sp_delta_cat_purge /end DEF_CHARACTERISTIC
 /begin OUT_MEASUREMENT egtr[0].egtr_struct_defspcenr0.o2l_rls_pcat_purge egtr[0].egtr_struct_defspcenr0.o2l_rls_tot_cat_purge egtr[0].egtr_struct_defspcenr0.o2l_rls_rest_cat_purge egtr[0].egtr_struct_defspcenr0.o2l_rls_add_cat_purge egtr[0].egtr_struct_defspcenr0.o2l_rls_main_cat_purge egtr[0].egtr_struct_defspcenr0.lamb_sp_delta_it_cat_purge egtr[0].egtr_struct_defspcenr0.fac_o2l_rls_cat_purge egtr[0].egtr_struct_defspcenr0.ratio_o2l_rls_cat_purge egtr[0].egtr_struct_defspcenr0.lv_cat_purge_act egtr[0].egtr_struct_defspcenr0.lv_vls_down_act_cat_purge egtr[0].egtr_struct_defspcenr0.lv_cat_purge_main_cat egtr[0].egtr_struct_defspcenr0.lv_cat_purge_pcat egtr[1].egtr_struct_defspcenr0.o2l_rls_pcat_purge egtr[1].egtr_struct_defspcenr0.o2l_rls_tot_cat_purge egtr[1].egtr_struct_defspcenr0.o2l_rls_rest_cat_purge egtr[1].egtr_struct_defspcenr0.o2l_rls_add_cat_purge egtr[1].egtr_struct_defspcenr0.o2l_rls_main_cat_purge egtr[1].egtr_struct_defspcenr0.lamb_sp_delta_it_cat_purge egtr[1].egtr_struct_defspcenr0.fac_o2l_rls_cat_purge egtr[1].egtr_struct_defspcenr0.ratio_o2l_rls_cat_purge egtr[1].egtr_struct_defspcenr0.lv_cat_purge_act egtr[1].egtr_struct_defspcenr0.lv_vls_down_act_cat_purge egtr[1].egtr_struct_defspcenr0.lv_cat_purge_main_cat egtr[1].egtr_struct_defspcenr0.lv_cat_purge_pcat /end OUT_MEASUREMENT
/end FUNCTION
/begin FUNCTION EGTR_O2L_det_cat_enrichment "_O2L_det_cat_enrichment"
 /begin DEF_CHARACTERISTIC c_fac_add_main_cat_purge_hst c_fac_add_main_cat_purge_sa c_maf_int_puc_act_min_cat_purge c_o2l_rls_max_pcat_purge c_o2l_rls_sp_pcat_purge_ch c_o2l_rls_sp_pcat_purge_hst c_o2l_rls_sp_pcat_purge_sa c_tco_thd_cat_purge_hst ldp_maf_int_puc_act_ip_o2l_rls ldp_temp_cat_ip_fac_pcat_purge ip_o2l_rls_sp_pcat_purge_puc ip_fac_o2l_rls_sp_pcat_purge c_fac_add_main_cat_purge_gs_scc c_maf_int_gs_scc_min_cat_purge c_fac_add_main_cat_purge_ch c_lamb_sp_ch_thd_cat_purge /end DEF_CHARACTERISTIC
 /begin OUT_MEASUREMENT egtr[0].egtr_struct_defspcenrd0.o2l_rls_sp_pcat_purge egtr[0].egtr_struct_defspcenrd0.fac_add_main_cat_purge egtr[0].egtr_struct_defspcenrd0.state_cat_purge egtr[0].egtr_struct_defspcenrd0.lv_cat_purge_post_puc_trig egtr[0].egtr_struct_defspcenrd0.lv_cat_purge_st egtr[1].egtr_struct_defspcenrd0.o2l_rls_sp_pcat_purge egtr[1].egtr_struct_defspcenrd0.fac_add_main_cat_purge egtr[1].egtr_struct_defspcenrd0.state_cat_purge egtr[1].egtr_struct_defspcenrd0.lv_cat_purge_post_puc_trig egtr[1].egtr_struct_defspcenrd0.lv_cat_purge_st /end OUT_MEASUREMENT
/end FUNCTION
/begin FUNCTION EGTR_Appl_inci_cat_enrichment "_Appl_inci_cat_enrichment"
 /begin DEF_CHARACTERISTIC c_maf_cyl_max_cat_purge c_n_max_cat_purge c_tco_min_cat_purge c_temp_dif_pcat_main_cat_purge[0] c_temp_dif_pcat_main_cat_purge[1] lc_cat_purge_inh[0] lc_cat_purge_inh[1] lc_ns_2_deac ldp_maf_cyl_ip_lamb_add_purge ldp_vls_nox_sens_ip_lamb_add ip_lamb_add_purge /end DEF_CHARACTERISTIC
 /begin OUT_MEASUREMENT lv_gs_scc maf_int_puc_act maf_int_puc_not_act maf_int_gs_scc egtr[0].egtr_struct_defspcenri0.temp_main_cat_purge egtr[0].egtr_struct_defspcenri0.lamb_sp_delta_add_cat_purge egtr[0].egtr_struct_defspcenri0.lv_inh_cat_purge egtr[1].egtr_struct_defspcenri0.temp_main_cat_purge egtr[1].egtr_struct_defspcenri0.lamb_sp_delta_add_cat_purge egtr[1].egtr_struct_defspcenri0.lv_inh_cat_purge /end OUT_MEASUREMENT
/end FUNCTION
/begin FUNCTION C_B_EGTR "C_B_EGTR : Diagnosis part for EGTR aggregate" /begin DEF_CHARACTERISTIC ldpm_n_32_3_egtr /end DEF_CHARACTERISTIC
 /begin SUB_FUNCTION EGTR_Lim_dyn_for_cat_eff_diag EGTR_Cat_eff_diag_err_intf_1bank EGTR_Cat_eff_diag_err_intf_2bank EGTR_Act_cond_cat_eff_diag_bin EGTR_Cat_eff_diag_lin_lamb_ctl EGTR_App_inc_cat_eff_diag EGTR_OSC_Calculation EGTR_Diag_value_determination EGTR_Diag_value_determination_AI EGTR_Activation_conditions EGTR_Coord_cat_diag_result EGTR_Calculation_lambda_setpoint /end SUB_FUNCTION
/end FUNCTION
/begin FUNCTION EGTR_Lim_dyn_for_cat_eff_diag "_Limited_dynamics_for_catalyst_efficiency_diagnosis"
 /begin DEF_CHARACTERISTIC c_crlc_maf_cat_ldc c_crlc_n_cat_ldc c_fac_lam_mv_dyw_cat c_load_grd_dec c_load_grd_min_sum_cat c_load_grd_sum_max c_load_grd_sum_min c_maf_dyw_cat_ldc c_maf_int_min_cat_ldc c_n_dyw_cat_ldc c_t_load_grd_dec_sum lc_fac_lam_rst_cat_ldc lc_maf_rst_cat_ldc lc_n_rst_cat_ldc /end DEF_CHARACTERISTIC
 /begin OUT_MEASUREMENT maf_mmv_cat_ldc n_mmv_cat_ldc load_grd_sum_cat_ldc load_grd_cat_ldc lv_load_grd_cat_ldc lv_maf_cat_ldc lv_n_cat_ldc egtr[0].egtr_struct_fctdgcefld0.fac_lam_mv_delta_cat_ldc egtr[0].egtr_struct_fctdgcefld0.maf_int_cat_ldc egtr[0].egtr_struct_fctdgcefld0.lv_cat_ldc egtr[0].egtr_struct_fctdgcefld0.lv_fac_lam_cat_ldc egtr[1].egtr_struct_fctdgcefld0.fac_lam_mv_delta_cat_ldc egtr[1].egtr_struct_fctdgcefld0.maf_int_cat_ldc egtr[1].egtr_struct_fctdgcefld0.lv_cat_ldc egtr[1].egtr_struct_fctdgcefld0.lv_fac_lam_cat_ldc /end OUT_MEASUREMENT
/end FUNCTION
/begin FUNCTION EGTR_Cat_eff_diag_err_intf_1bank "_Cat_eff_diag_err_interface_for_1_bank_system" /end FUNCTION
/begin FUNCTION EGTR_Cat_eff_diag_err_intf_2bank "_Cat_eff_diag_err_interface_for_2_bank_system"
 /begin DEF_CHARACTERISTIC c_eff_cat_max_50_diag c_eff_cat_max_diag c_eff_cat_max_diag_eol c_eff_cat_max_sum_diag lc_cat_diag_dis lc_cat_diag_resu ldp_eff_cat_diag_1_ip_eff_cat ldp_eff_cat_diag_2_ip_eff_cat ip_eff_cat_diag_sum /end DEF_CHARACTERISTIC
 /begin OUT_MEASUREMENT eff_cat_diag_sum egtr[0].egtr_struct_fctdgcefif0.eff_cat_diag_obd egtr[0].egtr_struct_fctdgcefif0.eff_cat_max_diag_obd egtr[0].egtr_struct_fctdgcefif0.lv_cdn_diag_cat_diag egtr[0].egtr_struct_fctdgcefif0.lv_end_diag_cat_diag egtr[0].egtr_struct_fctdgcefif0.lv_err_cat_diag egtr[1].egtr_struct_fctdgcefif0.eff_cat_diag_obd egtr[1].egtr_struct_fctdgcefif0.eff_cat_max_diag_obd egtr[1].egtr_struct_fctdgcefif0.lv_cdn_diag_cat_diag egtr[1].egtr_struct_fctdgcefif0.lv_end_diag_cat_diag egtr[1].egtr_struct_fctdgcefif0.lv_err_cat_diag /end OUT_MEASUREMENT
/end FUNCTION
/begin FUNCTION EGTR_Act_cond_cat_eff_diag_bin "_Act_cond_for_cat_eff_diag_binary_lambda_ctl"
 /begin DEF_CHARACTERISTIC c_amp_min_cat c_cl_max_cat c_maf_hys_cat c_maf_int_dly_cat_diag c_maf_int_sw_cat_diag c_tco_min_cat c_temp_hys_cat c_temp_max_cat c_temp_min_cat c_temp_min_cat_eol c_vs_max_cat c_vs_min_cat lc_cat_diag_cdn_act_man ip_maf_max_cat ip_maf_min_cat /end DEF_CHARACTERISTIC
 /begin OUT_MEASUREMENT egtr[0].egtr_struct_fctdgcefac0.maf_int_dly_cat_diag egtr[0].egtr_struct_fctdgcefac0.lv_cat_diag_cdn_act egtr[1].egtr_struct_fctdgcefac0.maf_int_dly_cat_diag egtr[1].egtr_struct_fctdgcefac0.lv_cat_diag_cdn_act /end OUT_MEASUREMENT
/end FUNCTION
/begin FUNCTION EGTR_Cat_eff_diag_lin_lamb_ctl ""
 /begin DEF_CHARACTERISTIC c_ctr_min_cat_diag c_ctr_min_cat_diag_eol c_ctr_lamb_out_cat_diag c_lamb_cat_mv_dif_max c_lamb_cat_mv_delta_max c_n_32_cat_diag_deac ip_fac_mass_o2_cat_diag_at ip_fac_mass_o2_cat_diag_mt ldp_temp_cat_dyn_mdl_ip_fac_cat ldp_temp_cat_dif_ip_fac_cat ip_lamb_cat ip_fac_temp_cat_dif_stat c_o2l_cat_afl c_lamb_cat_delta_max c_lamb_cat_delta_max_eol c_temp_cat_dif_dyn_max c_temp_cat_dif_dyn_st ldp_vls_temp_ip_lamb_cat /end DEF_CHARACTERISTIC
 /begin OUT_MEASUREMENT egtr[0].egtr_struct_fctdgcef0.ratio_mass_o2_cat_dif_sum egtr[0].egtr_struct_fctdgcef0.lamb_cat_down_sum egtr[0].egtr_struct_fctdgcef0.ratio_mass_o2_cat_dif egtr[0].egtr_struct_fctdgcef0.mass_o2_cat_dif_cyc egtr[0].egtr_struct_fctdgcef0.lamb_cat_down_mv egtr[0].egtr_struct_fctdgcef0.lamb_cat_down_st_cyc egtr[0].egtr_struct_fctdgcef0.lamb_cat_down egtr[0].egtr_struct_fctdgcef0.flow_o2_cat_dif egtr[0].egtr_struct_fctdgcef0.ctr_cat_diag egtr[0].egtr_struct_fctdgcef0.ctr_lamb_cat_down_sum egtr[0].egtr_struct_fctdgcef0.ctr_lamb_out_cat_diag egtr[0].egtr_struct_fctdgcef0.ctr_tot_cat_diag egtr[0].egtr_struct_fctdgcef0.eff_cat_diag_hom egtr[0].egtr_struct_fctdgcef0.temp_cat_dif_dyn_stat egtr[0].egtr_struct_fctdgcef0.state_cat_diag egtr[0].egtr_struct_fctdgcef0.state_cat_diag_cyc_vld egtr[0].egtr_struct_fctdgcef0.lv_lamb_pls_req_cat_diag egtr[0].egtr_struct_fctdgcef0.lv_lam_adj_cat_diag egtr[1].egtr_struct_fctdgcef0.ratio_mass_o2_cat_dif_sum egtr[1].egtr_struct_fctdgcef0.lamb_cat_down_sum egtr[1].egtr_struct_fctdgcef0.ratio_mass_o2_cat_dif egtr[1].egtr_struct_fctdgcef0.mass_o2_cat_dif_cyc egtr[1].egtr_struct_fctdgcef0.lamb_cat_down_mv egtr[1].egtr_struct_fctdgcef0.lamb_cat_down_st_cyc egtr[1].egtr_struct_fctdgcef0.lamb_cat_down egtr[1].egtr_struct_fctdgcef0.flow_o2_cat_dif egtr[1].egtr_struct_fctdgcef0.ctr_cat_diag egtr[1].egtr_struct_fctdgcef0.ctr_lamb_cat_down_sum egtr[1].egtr_struct_fctdgcef0.ctr_lamb_out_cat_diag egtr[1].egtr_struct_fctdgcef0.ctr_tot_cat_diag egtr[1].egtr_struct_fctdgcef0.eff_cat_diag_hom egtr[1].egtr_struct_fctdgcef0.temp_cat_dif_dyn_stat egtr[1].egtr_struct_fctdgcef0.state_cat_diag egtr[1].egtr_struct_fctdgcef0.state_cat_diag_cyc_vld egtr[1].egtr_struct_fctdgcef0.lv_lamb_pls_req_cat_diag egtr[1].egtr_struct_fctdgcef0.lv_lam_adj_cat_diag /end OUT_MEASUREMENT
/end FUNCTION
/begin FUNCTION EGTR_App_inc_cat_eff_diag "_App_inc_cat_eff_diag" /begin DEF_CHARACTERISTIC c_lamb_delta_p_lam_adj_max lc_inh_cat_diag_man_deac /end DEF_CHARACTERISTIC
 /begin OUT_MEASUREMENT load_cat_ldc egtr[0].egtr_struct_fctdgcefi0.state_rbm_cat egtr[0].egtr_struct_fctdgcefi0.lv_inh_diag_cat_diag egtr[0].egtr_struct_fctdgcefi0.lv_inh_diag_rbm_cat_diag egtr[1].egtr_struct_fctdgcefi0.state_rbm_cat egtr[1].egtr_struct_fctdgcefi0.lv_inh_diag_cat_diag egtr[1].egtr_struct_fctdgcefi0.lv_inh_diag_rbm_cat_diag /end OUT_MEASUREMENT
/end FUNCTION
/begin FUNCTION EGTR_OSC_Calculation ""
 /begin DEF_CHARACTERISTIC c_t_afl_cdn_out ldp_lamb_ls_up_ip_fac_diag_afl ip_fac_lamb_diag_afl ldp_n_32_ip_fac_diag_afl ldp_maf_cyl_ip_fac_diag_afl ip_fac_opp_diag_afl ldp_temp_stat_ip_fac_diag_afl ldp_temp_dif_ip_fac_diag_afl ip_fac_temp_diag_afl c_lamb_o2l_int_clc c_state_o2l_clc_ena c_state_ex_conf c_vls_o2l_int_clc c_vls_nox_o2l_int_clc c_state_sens_down_miss_cbk c_state_rgn_cat_diag_afl /end DEF_CHARACTERISTIC
 /begin OUT_MEASUREMENT egtr[0].egtr_struct_fctdgtdloc0.action_O2L_data_h_ampl.o2l_pha egtr[0].egtr_struct_fctdgtdloc0.action_O2L_data_h_ampl.o2l_int_pha egtr[0].egtr_struct_fctdgtdloc0.action_O2L_data_h_ampl.lv_o2l_clc egtr[0].egtr_struct_fctdgtdloc0.action_O2L_data_l_ampl.o2l_pha egtr[0].egtr_struct_fctdgtdloc0.action_O2L_data_l_ampl.o2l_int_pha egtr[0].egtr_struct_fctdgtdloc0.action_O2L_data_l_ampl.lv_o2l_clc egtr[0].egtr_struct_fctdgtdloc0.action_O2L_data_park.o2l_pha egtr[0].egtr_struct_fctdgtdloc0.action_O2L_data_park.o2l_int_pha egtr[0].egtr_struct_fctdgtdloc0.action_O2L_data_park.lv_o2l_clc egtr[0].egtr_struct_fctdgtdloc0.action_O2L_data_load.o2l_pha egtr[0].egtr_struct_fctdgtdloc0.action_O2L_data_load.o2l_int_pha egtr[0].egtr_struct_fctdgtdloc0.action_O2L_data_load.lv_o2l_clc egtr[0].egtr_struct_fctdgtdloc0.state_o2l_clc_vld egtr[0].egtr_struct_fctdgtdloc0.t_afl_cdn_out egtr[0].egtr_struct_fctdgtdloc0.state_cat_diag_afl egtr[0].egtr_struct_fctdgtdloc0.state_o2l_clc_end egtr[1].egtr_struct_fctdgtdloc0.action_O2L_data_h_ampl.o2l_pha egtr[1].egtr_struct_fctdgtdloc0.action_O2L_data_h_ampl.o2l_int_pha egtr[1].egtr_struct_fctdgtdloc0.action_O2L_data_h_ampl.lv_o2l_clc egtr[1].egtr_struct_fctdgtdloc0.action_O2L_data_l_ampl.o2l_pha egtr[1].egtr_struct_fctdgtdloc0.action_O2L_data_l_ampl.o2l_int_pha egtr[1].egtr_struct_fctdgtdloc0.action_O2L_data_l_ampl.lv_o2l_clc egtr[1].egtr_struct_fctdgtdloc0.action_O2L_data_park.o2l_pha egtr[1].egtr_struct_fctdgtdloc0.action_O2L_data_park.o2l_int_pha egtr[1].egtr_struct_fctdgtdloc0.action_O2L_data_park.lv_o2l_clc egtr[1].egtr_struct_fctdgtdloc0.action_O2L_data_load.o2l_pha egtr[1].egtr_struct_fctdgtdloc0.action_O2L_data_load.o2l_int_pha egtr[1].egtr_struct_fctdgtdloc0.action_O2L_data_load.lv_o2l_clc egtr[1].egtr_struct_fctdgtdloc0.state_o2l_clc_vld egtr[1].egtr_struct_fctdgtdloc0.t_afl_cdn_out egtr[1].egtr_struct_fctdgtdloc0.state_cat_diag_afl egtr[1].egtr_struct_fctdgtdloc0.state_o2l_clc_end /end OUT_MEASUREMENT
/end FUNCTION
/begin FUNCTION EGTR_Diag_value_determination ""
 /begin DEF_CHARACTERISTIC c_ctr_cyc_cat_diag_afl c_ctr_o2l_mv_clc c_fac_afr_cdn_mat c_o2l_thd_err_cat_diag_afl_sum c_o2l_thd_err_cat_diag_afl[0] c_o2l_thd_err_cat_diag_afl[1] c_o2l_cat_diag_afl_max c_state_o2l_err_clc lc_o2l_cat_diag_afl_sum ldp_o2l_delta_ip_fac_cor ldp_o2l_cat_diag_1_ip_o2l_sum ldp_o2l_cat_diag_2_ip_o2l_sum ip_o2l_cat_diag_afl_sum ip_fac_o2l_afr_cdn_cor /end DEF_CHARACTERISTIC
 /begin OUT_MEASUREMENT egtr[0].egtr_struct_fctdgtdldd0.action_clcO2L_data_l_ampl.o2l_mv egtr[0].egtr_struct_fctdgtdldd0.action_clcO2L_data_l_ampl.o2l_sum egtr[0].egtr_struct_fctdgtdldd0.action_clcO2L_data_l_ampl.ctr_sum egtr[0].egtr_struct_fctdgtdldd0.action_clcO2L_data_h_ampl.o2l_mv egtr[0].egtr_struct_fctdgtdldd0.action_clcO2L_data_h_ampl.o2l_sum egtr[0].egtr_struct_fctdgtdldd0.action_clcO2L_data_h_ampl.ctr_sum egtr[0].egtr_struct_fctdgtdldd0.action_clcO2L_data_park.o2l_mv egtr[0].egtr_struct_fctdgtdldd0.action_clcO2L_data_park.o2l_sum egtr[0].egtr_struct_fctdgtdldd0.action_clcO2L_data_park.ctr_sum egtr[0].egtr_struct_fctdgtdldd0.action_clcO2L_data_load.o2l_mv egtr[0].egtr_struct_fctdgtdldd0.action_clcO2L_data_load.o2l_sum egtr[0].egtr_struct_fctdgtdldd0.action_clcO2L_data_load.ctr_sum egtr[0].egtr_struct_fctdgtdldd0.o2l_cat_diag_afl egtr[0].egtr_struct_fctdgtdldd0.o2l_delta_afr_cdn egtr[0].egtr_struct_fctdgtdldd0.o2l_afr_cdn_cor egtr[0].egtr_struct_fctdgtdldd0.o2l_afr_cdn_cor_mat egtr[0].egtr_struct_fctdgtdldd0.o2l_afl_cdn_mat egtr[0].egtr_struct_fctdgtdldd0.o2l_sum_cat_diag_afl egtr[0].egtr_struct_fctdgtdldd0.o2l_mmv_cat_diag_afl egtr[0].egtr_struct_fctdgtdldd0.fac_sum_o2l_mmv_tmp egtr[0].egtr_struct_fctdgtdldd0.state_o2l_mv_clc_vld egtr[0].egtr_struct_fctdgtdldd0.lv_o2l_cat_diag_afl egtr[0].egtr_struct_fctdgtdldd0.lv_err_cat_diag_afl_tmp egtr[0].egtr_struct_fctdgtdldd0.lv_end_diag_afl_tmp egtr[0].egtr_struct_fctdgtdldd0.lv_o2l_mv_clc_end egtr[1].egtr_struct_fctdgtdldd0.action_clcO2L_data_l_ampl.o2l_mv egtr[1].egtr_struct_fctdgtdldd0.action_clcO2L_data_l_ampl.o2l_sum egtr[1].egtr_struct_fctdgtdldd0.action_clcO2L_data_l_ampl.ctr_sum egtr[1].egtr_struct_fctdgtdldd0.action_clcO2L_data_h_ampl.o2l_mv egtr[1].egtr_struct_fctdgtdldd0.action_clcO2L_data_h_ampl.o2l_sum egtr[1].egtr_struct_fctdgtdldd0.action_clcO2L_data_h_ampl.ctr_sum egtr[1].egtr_struct_fctdgtdldd0.action_clcO2L_data_park.o2l_mv egtr[1].egtr_struct_fctdgtdldd0.action_clcO2L_data_park.o2l_sum egtr[1].egtr_struct_fctdgtdldd0.action_clcO2L_data_park.ctr_sum egtr[1].egtr_struct_fctdgtdldd0.action_clcO2L_data_load.o2l_mv egtr[1].egtr_struct_fctdgtdldd0.action_clcO2L_data_load.o2l_sum egtr[1].egtr_struct_fctdgtdldd0.action_clcO2L_data_load.ctr_sum egtr[1].egtr_struct_fctdgtdldd0.o2l_cat_diag_afl egtr[1].egtr_struct_fctdgtdldd0.o2l_delta_afr_cdn egtr[1].egtr_struct_fctdgtdldd0.o2l_afr_cdn_cor egtr[1].egtr_struct_fctdgtdldd0.o2l_afr_cdn_cor_mat egtr[1].egtr_struct_fctdgtdldd0.o2l_afl_cdn_mat egtr[1].egtr_struct_fctdgtdldd0.o2l_sum_cat_diag_afl egtr[1].egtr_struct_fctdgtdldd0.o2l_mmv_cat_diag_afl egtr[1].egtr_struct_fctdgtdldd0.fac_sum_o2l_mmv_tmp egtr[1].egtr_struct_fctdgtdldd0.state_o2l_mv_clc_vld egtr[1].egtr_struct_fctdgtdldd0.lv_o2l_cat_diag_afl egtr[1].egtr_struct_fctdgtdldd0.lv_err_cat_diag_afl_tmp egtr[1].egtr_struct_fctdgtdldd0.lv_end_diag_afl_tmp egtr[1].egtr_struct_fctdgtdldd0.lv_o2l_mv_clc_end lv_err_cat_diag_afl_2 lv_err_cat_diag_afl_1 o2l_cat_diag_afl_sum lv_o2l_clc_ready lv_o2l_cat_diag_afl_sum o2l_nt_mat ctr_cyc_cat_diag_afl /end OUT_MEASUREMENT
/end FUNCTION
/begin FUNCTION EGTR_Diag_value_determination_AI ""
 /begin DEF_CHARACTERISTIC c_abc_inc_cat_diag_afl lc_diag_cat_diag_afl_deac[0] lc_diag_cat_diag_afl_deac[1] c_abc_dec_cat_diag_afl lc_diag_sum_diag_afl c_abc_max_cat_diag_afl c_state_ns_obd_2_diag_afl /end DEF_CHARACTERISTIC
 /begin OUT_MEASUREMENT egtr[0].egtr_struct_fctdgtdlai0.lv_inh_diag_cat_diag_afl egtr[0].egtr_struct_fctdgtdlai0.lv_diag_err_sum_diag_afl egtr[0].egtr_struct_fctdgtdlai0.lv_diag_end_sum_diag_afl egtr[0].egtr_struct_fctdgtdlai0.lv_err_qvm_1 egtr[0].egtr_struct_fctdgtdlai0.lv_err_qvm_2 egtr[0].egtr_struct_fctdgtdlai0.lv_err_qvm_3 egtr[0].egtr_struct_fctdgtdlai0.lv_err_qvm egtr[1].egtr_struct_fctdgtdlai0.lv_inh_diag_cat_diag_afl egtr[1].egtr_struct_fctdgtdlai0.lv_diag_err_sum_diag_afl egtr[1].egtr_struct_fctdgtdlai0.lv_diag_end_sum_diag_afl egtr[1].egtr_struct_fctdgtdlai0.lv_err_qvm_1 egtr[1].egtr_struct_fctdgtdlai0.lv_err_qvm_2 egtr[1].egtr_struct_fctdgtdlai0.lv_err_qvm_3 egtr[1].egtr_struct_fctdgtdlai0.lv_err_qvm /end OUT_MEASUREMENT
/end FUNCTION
/begin FUNCTION EGTR_Activation_conditions ""
 /begin DEF_CHARACTERISTIC c_crlc_temp_cat_diag_afl c_maf_down_lim_cat_diag_afl c_maf_up_lim_cat_diag_afl c_n_32_down_lim_cat_diag_afl c_n_32_up_lim_cat_diag_afl c_tco_down_lim_cat_diag_afl c_tco_up_lim_cat_diag_afl c_temp_ldc_cat_diag_afl c_temp_down_lim_cat_diag_afl c_temp_up_lim_cat_diag_afl /end DEF_CHARACTERISTIC
 /begin OUT_MEASUREMENT egtr[0].egtr_struct_fctdgtdlac0.temp_ldc_cat_diag_afl egtr[0].egtr_struct_fctdgtdlac0.lv_o2l_clc_act_opp_tmp egtr[0].egtr_struct_fctdgtdlac0.lv_o2l_clc_act_cdn egtr[0].egtr_struct_fctdgtdlac0.lv_o2l_clc_act_tco_tmp egtr[0].egtr_struct_fctdgtdlac0.lv_o2l_clc_act_temp_tmp egtr[0].egtr_struct_fctdgtdlac0.lv_o2l_clc_act_ldc_temp_tmp egtr[1].egtr_struct_fctdgtdlac0.temp_ldc_cat_diag_afl egtr[1].egtr_struct_fctdgtdlac0.lv_o2l_clc_act_opp_tmp egtr[1].egtr_struct_fctdgtdlac0.lv_o2l_clc_act_cdn egtr[1].egtr_struct_fctdgtdlac0.lv_o2l_clc_act_tco_tmp egtr[1].egtr_struct_fctdgtdlac0.lv_o2l_clc_act_temp_tmp egtr[1].egtr_struct_fctdgtdlac0.lv_o2l_clc_act_ldc_temp_tmp /end OUT_MEASUREMENT
/end FUNCTION
/begin FUNCTION EGTR_Coord_cat_diag_result ""
 /begin DEF_CHARACTERISTIC lc_eff_cat_diag_hom_ena lc_o2l_cat_diag_afl_ena ldp_o2l_cat_diag_afl_ip_eff_cat ip_eff_cat_diag_hom /end DEF_CHARACTERISTIC
 /begin OUT_MEASUREMENT egtr[0].egtr_struct_fctdgcefc0.eff_cat_diag egtr[1].egtr_struct_fctdgcefc0.eff_cat_diag /end OUT_MEASUREMENT
/end FUNCTION
/begin FUNCTION EGTR_Calculation_lambda_setpoint ""
 /begin DEF_CHARACTERISTIC c_lamb_sp_diag_afl_diag c_lamb_sp_diag_afl_pas c_lamb_sp_diag_park_shift c_state_rgn_ini_diag_afl[0] c_state_rgn_ini_diag_afl[1] lc_state_rgn_diag_afl ldp_n_32_ip_lamb_sp_diag_park_i ldp_maf_ip_lamb_sp_diag_park_i ip_lamb_sp_diag_park_i c_state_rgn_ini_diag_afl_pas c_lamb_sp_diag_park_bas /end DEF_CHARACTERISTIC
 /begin OUT_MEASUREMENT lv_diag_afl_req egtr[0].egtr_struct_defsptdlld0.lamb_sp_diag_afl egtr[0].egtr_struct_defsptdlld0.state_rgn_cat_diag_afl egtr[0].egtr_struct_defsptdlld0.lv_lamb_sp_diag_afl_park egtr[1].egtr_struct_defsptdlld0.lamb_sp_diag_afl egtr[1].egtr_struct_defsptdlld0.state_rgn_cat_diag_afl egtr[1].egtr_struct_defsptdlld0.lv_lamb_sp_diag_afl_park /end OUT_MEASUREMENT
/end FUNCTION
/begin FUNCTION C_E_ECM2 "C_E_ECM2"
 /begin DEF_CHARACTERISTIC ldpm_test_rec_idx_mon2 ldpm_iga_dif_av_mon_ip_eff_mon ldpm_n_32_mon__fac_cha_mon ldpm_n_32_mon_ip_iga_ref_mon ldpm_n_32_mon_ip_fac_tq_mon ldpm_pv_av_ad_mon_ip_fac_mon ldpm_iga_dif_av_mon2_ip_mon2 ldpm_n_32_mon2_ip_fac_tq_mon2 ldpm_n_32_mon2_ip_iga_ref_mon2 ldpm_pv_av_ad_mon2_ip_fac_mon2 /end DEF_CHARACTERISTIC
 /begin SUB_FUNCTION ECM2_TCO_monitoring ECM2_Monitoring_PVS ECM2_Monitoring_CAN_signals ECM2_Fault_reaction_process_mon ECM2_Mon_engine_speed_limitation ECM2_Mon_cruise_ctl_conditions ECM2_Desired_indicated_eng_tq ECM2_Actual_indicated_eng_tq ECM2_Mon_actual_indicated_eng_tq ECM2_Processor_monitoring_MON2 ECM2_Conf_process_mon_AI ECM2_Mon_analog_dig_conversion ECM2_Mon_N_32_using_sw_timer ECM2_Mon_tq_demand_is_controller ECM2_Monitoring_torque_losses ECM2_Monitoring_min_tq_clutch ECM2_Monitoring_max_tq_clutch ECM2_Err_mem_mng_process_mon ECM2_Actual_efficiencies ECM2_Actual_lambda_deviation ECM2_Actual_fuel_mass_flow ECM2_Cmb_mode_switch_requests ECM2_Mon_of_mass_fuel_flow ECM2_Err_mem_mng_process_mon_AI /end SUB_FUNCTION
/end FUNCTION
/begin FUNCTION ECM2_TCO_monitoring "TCO_monitoring"
 /begin DEF_CHARACTERISTIC c_tco_grd_max_mon c_t_tco_grd_max_mon c_tco_thd_min_mon c_tco_sub_thd_max_mon /end DEF_CHARACTERISTIC
 /begin OUT_MEASUREMENT tco_mon t_tco_grd_mon /end OUT_MEASUREMENT
/end FUNCTION
/begin FUNCTION ECM2_Monitoring_PVS "Monitoring_PVS"
 /begin DEF_CHARACTERISTIC c_n_min_pvs_diag_mon c_abc_inc_pvs_ratio_mon c_abc_max_pvs_ratio_mon c_v_pvs_is_thd_1_mon c_v_pvs_is_thd_2_mon c_v_pvs_slop_1_mon c_v_pvs_slop_2_mon c_pv_lih_max_mon ip_v_thd_ratio_chk_pvs_mon ldp_v_min_pv_mon_ip_v_pvs_mon /end DEF_CHARACTERISTIC
 /begin OUT_MEASUREMENT lv_err_pvs_ratio_mon abc_pvs_ratio_mon pv_av_1_mon pv_av_2_mon lv_err_pvs_mon pv_av_mon v_pvs_1_mon v_pvs_2_mon fac_v_slop_pvs_mon /end OUT_MEASUREMENT
/end FUNCTION
/end MODULE
/end PROJECT
