ASAP2_VERSION 1 3
/begin PROJECT _715C4500 "basisme9"
/begin HEADER "" VERSION "_715C4500" PROJECT_NO _715C4500 /end HEADER
/begin MODULE DIM ""
/begin MOD_COMMON "" BYTE_ORDER MSB_FIRST ALIGNMENT_BYTE 1 ALIGNMENT_WORD 2 ALIGNMENT_LONG 2 ALIGNMENT_FLOAT32_IEEE 4 /end MOD_COMMON
/begin CHARACTERISTIC ABGMSIGH "Abgastemperaturschwelle f¸r Signalunterbrechung mit Ri-Diagnose hinter KAT" VALUE 0xFCCCBC KwUb 1275. temp_ub_q5_o50 -50.00 1225. FORMAT "%5.0" /end CHARACTERISTIC
/begin CHARACTERISTIC ABGMSIGV "Abgastemperaturschwelle f¸r Signalunterbrechung mit Ri-Diagnose vor KAT" VALUE 0xFC1EE2 KwUb 1275. temp_ub_q5_o50 -50.00 1225. FORMAT "%5.0" /end CHARACTERISTIC
/begin CHARACTERISTIC ADKATNF "Normierungsfaktor f¸r Signalamplitude der Sonde bzw. Katbelastung" VALUE 0xFC1E74 KwUb 23.87 spg_ub_b24 0.00 23.87 FORMAT "%5.2" /end CHARACTERISTIC
/begin CHARACTERISTIC AGANGW "Anzahl Gangwechsel f¸r Diagnose Kupplungsschalter" VALUE 0xFCCD5E KwUb 255.0 dez 0.00 255.0 FORMAT "%5.1" /end CHARACTERISTIC
/begin CHARACTERISTIC AHKATMN "Schwellwert Katalysator gut,  AHKAT < AHKATMN" VALUE 0xFC1E75 KwUb 0.9961 fak_ub_b1 0.00 0.9961 /end CHARACTERISTIC
/begin CHARACTERISTIC AHKATMX "Schwellwert Katalysator defekt,  AHKAT > AHKATMX" VALUE 0xFC1E76 KwUb 0.9961 fak_ub_b1 0.00 0.9961 /end CHARACTERISTIC
/begin CHARACTERISTIC AHKATS "Schwellwert f¸r Summe AHKAT,AHKAT2 (Stereo )" VALUE 0xFC1E77 KwUb 1.992 fak_ub_b2 0.00 1.992 FORMAT "%5.3" /end CHARACTERISTIC
/begin CHARACTERISTIC AHKATSB "Schwellwert f¸r Summenbereichfehler (Stereo)" VALUE 0xFC1E78 KwUb 0.9961 fak_ub_b1 0.00 0.9961 /end CHARACTERISTIC
/begin CHARACTERISTIC AHKTTSW "Setztwert f¸r Zeitgeber in Signalauswertung" VALUE 0xFC1EAC KwUw 3276.750 t50msxs_uw_b3276p75 0.00 3276.750 FORMAT "%8.3" /end CHARACTERISTIC
/begin CHARACTERISTIC AKUPPLB "Anzahl Kupplung bet‰tigt f¸r Diagnose Kupplungsschalter" VALUE 0xFCCD5F KwUb 255.0 dez 0.00 255.0 FORMAT "%5.1" /end CHARACTERISTIC
/begin CHARACTERISTIC ALFO "Anfangswert f¸r Lernfilter bei fuel-on/fuel-off Adaption" VALUE 0xFC1CD8 KwWR32 2.000000000000E+037 fak_r32_1 -1.000000000000E+037 1.000000000000E+037 FORMAT "%43.4" /end CHARACTERISTIC
/begin CHARACTERISTIC ALFOF "Anfangswert f¸r Lernfilter bei fuel-off Adaption" VALUE 0xFC1B3C KwWR32 2.000000000000E+037 fak_r32_1 -1.000000000000E+037 1.000000000000E+037 FORMAT "%43.4" /end CHARACTERISTIC
/begin CHARACTERISTIC ANALUN "Anzahl Verbrennungen f¸r Ausblendungen nach erkanntem Auss., drehzahlabh‰ngig" CURVE 0xFC13AC GklWU8 255.0 dez 0.00 255.0 FORMAT "%5.1"
 /begin AXIS_DESCR COM_AXIS nmot nmot_ub_q40 8 0.00 10200. FORMAT "%5.0" AXIS_PTS_REF SNM08DMUB /end AXIS_DESCR
/end CHARACTERISTIC
/begin CHARACTERISTIC ANALUST "Anzahl Verbrennungen f¸r Ausblendungen nach erkanntem Auss., nach Start" VALUE 0xFC13B4 KwWU8 255.0 dez 0.00 255.0 FORMAT "%5.1" /end CHARACTERISTIC
/begin CHARACTERISTIC ANWFOHE "Anzahl NW-Umdr. f¸r Heilung" VALUE 0xFC1CD4 KwWU16 65535.00 dez 0.00 65535.00 FORMAT "%8.2" /end CHARACTERISTIC
/begin CHARACTERISTIC ANWFOST "Anzahl NW-Umdr. f¸r Reaktivierung fuel-on/-off Adaption nach Ausblendung" VALUE 0xFC1B34 KwWU16 32767.00 dez 0.00 32767.00 FORMAT "%8.2" /end CHARACTERISTIC
/begin CHARACTERISTIC ANWSTP "Anzahl NW-Umdr., die fuel-off Adaption lernt (nachdem eingeschwungen)" VALUE 0xFC1B36 KwWU16 32767.00 dez 0.00 32767.00 FORMAT "%8.2" /end CHARACTERISTIC
/begin CHARACTERISTIC ANZDPVK "Anzahl der Perioden f¸r Ready-Flag der Usvk-Perioden¸berwachung" VALUE 0xFC1EBC KwUb 255.0 dez 0.00 255.0 FORMAT "%5.1" /end CHARACTERISTIC
/begin CHARACTERISTIC ANZDYNSH "Anzahl der Dynamikmessungen f¸r Schwingungspr¸fung Sonde hinter KAT" VALUE 0xFCCC80 KwUb 255.0 dez 0.00 255.0 FORMAT "%5.1" /end CHARACTERISTIC
/begin CHARACTERISTIC ANZGEM "Anzahl der Gemischfehler" VALUE 0xFC1EE3 KwUb 255.0 dez 0.00 255.0 FORMAT "%5.1" /end CHARACTERISTIC
/begin CHARACTERISTIC ANZTP "Anzahl auszublendender Perioden f¸r Periodendauer¸berwachung" VALUE 0xFC1EBD KwUb 255.0 dez 0.00 255.0 FORMAT "%5.1" /end CHARACTERISTIC
/begin CHARACTERISTIC APEKTDX "max. Anzahl Fehlerpr¸fungen bei Kat-Diagnose" VALUE 0xFC1E79 KwUb 255.0 dez 0.00 255.0 FORMAT "%5.1" /end CHARACTERISTIC
/begin CHARACTERISTIC ATVFETTO "obere Grenze f¸r atvfett, CARB-Tester, DLSSA" VALUE 0xFCCCDA KwUb 10.20 t40msxs_ub_q0p04 0.00 10.20 FORMAT "%5.2" /end CHARACTERISTIC
/begin CHARACTERISTIC ATVFETTU "untere Grenze f¸r atvfett, CARB-Tester, DLSSA" VALUE 0xFCCCDB KwUb 10.20 t40msxs_ub_q0p04 0.00 10.20 FORMAT "%5.2" /end CHARACTERISTIC
/begin CHARACTERISTIC ATVMAGO "obere Grenze f¸r atvmager, CARB-Tester, DLSSA" VALUE 0xFCCCDC KwUb 10.20 t40msxs_ub_q0p04 0.00 10.20 FORMAT "%5.2" /end CHARACTERISTIC
/begin CHARACTERISTIC ATVMAGU "untere Grenze f¸r atvmager, CARB-Tester, DLSSA" VALUE 0xFCCCDD KwUb 10.20 t40msxs_ub_q0p04 0.00 10.20 FORMAT "%5.2" /end CHARACTERISTIC
/begin CHARACTERISTIC AVKATFS "Setztwert f¸r AVKATF wenn Powerfail" VALUE 0xFC1E7A KwUb 0.9961 fak_ub_b1 0.00 0.9961 /end CHARACTERISTIC
/begin CHARACTERISTIC CDFO "Codewort zum Ausschalten und R¸cksetzen der Adaption" VALUE 0xFC1B38 KwWU8 255.0 dez 0.00 255.0 FORMAT "%5.1" /end CHARACTERISTIC
/begin CHARACTERISTIC CDFOMOD "Codewort zum Festlegen des Modus der Fuel-on/-off Adaption" VALUE 0xFC1B39 KwWU8 255.0 dez 0.00 255.0 FORMAT "%5.1" /end CHARACTERISTIC
/begin CHARACTERISTIC CDKATLK "Codewort f¸r B_lrka aktiv" VALUE 0xFC1E7B KwUb 255.0 dez 0.00 255.0 FORMAT "%5.1" /end CHARACTERISTIC
/begin CHARACTERISTIC CPLRA "Codewort f¸r Umschaltung DKVS von HFM- auf P-System" VALUE 0xFCD7B0 KwUb 255.0 dez 0.00 255.0 FORMAT "%5.1" /end CHARACTERISTIC
/begin CHARACTERISTIC CWDKRNT "Codewort: KR-Diagnose Integratorsteigung" VALUE 0xFC667E KwUb 255.0 dez 0.00 255.0 FORMAT "%5.1" /end CHARACTERISTIC
/begin CHARACTERISTIC CWDKROF "Codewort: KR-Diagnose Resetwert" VALUE 0xFC667F KwUb 255.0 dez 0.00 255.0 FORMAT "%5.1" /end CHARACTERISTIC
/begin CHARACTERISTIC CWDKRTP "Codewort: KR-Diagnose Testimpuls" VALUE 0xFC669E KwUb 255.0 dez 0.00 255.0 FORMAT "%5.1" /end CHARACTERISTIC
/begin CHARACTERISTIC CWDKS1 "Codewort: Klopfsensordiagnose Sensor1" VALUE 0xFCE98C KwUb 255.0 dez 0.00 255.0 FORMAT "%5.1" /end CHARACTERISTIC
/begin CHARACTERISTIC CWDKS2 "Codewort: Klopfsensordiagnose Sensor 2" VALUE 0xFCE98D KwUb 255.0 dez 0.00 255.0 FORMAT "%5.1" /end CHARACTERISTIC
/begin CHARACTERISTIC CWDKS3 "Codewort: Klopfsensordiagnose Sensor 3" VALUE 0xFCE98E KwUb 255.0 dez 0.00 255.0 FORMAT "%5.1" /end CHARACTERISTIC
/begin CHARACTERISTIC CWDKS4 "Codewort: Klopfsensordiagnose Sensor 4" VALUE 0xFCE98F KwUb 255.0 dez 0.00 255.0 FORMAT "%5.1" /end CHARACTERISTIC
/begin CHARACTERISTIC CWDKVSS "Codewort f¸r Error in DKVS sperren, wenn andere Fehler vorliegen" VALUE 0xFCD7B1 KwUb 255.0 dez 0.00 255.0 FORMAT "%5.1" /end CHARACTERISTIC
/begin CHARACTERISTIC CWDLSAHK "Codewort CWDLSAHK f¸r Alterung Sonde hinter KAT" VALUE 0xFCCC81 KwUb 255.0 dez 0.00 255.0 FORMAT "%5.1" /end CHARACTERISTIC
/begin CHARACTERISTIC CWPSETS "Codewort f¸r Endstufendiagnose el. Thermostat" VALUE 0xFC2038 KwWU8 255.0 dez 0.00 255.0 FORMAT "%5.1" /end CHARACTERISTIC
/begin CHARACTERISTIC CWPSKOSE "Codewort f¸r Endstufendiagnose Klimakompressorsteuerung" VALUE 0xFCCD6B KwWU8 255.0 dez 0.00 255.0 FORMAT "%5.1" /end CHARACTERISTIC
/begin CHARACTERISTIC DASA "Anzahl der SAS-Phasen zur Erkennung LLS Fehler" VALUE 0xFCF24E KwUb 255.0 dez 0.00 255.0 FORMAT "%5.1" /end CHARACTERISTIC
/begin CHARACTERISTIC DFRMST "Delta frm-schwelle f¸r Erkennung der eingeschwungenen Grundadaption" VALUE 0xFCD7B2 KwUb 1.992 fak_ub_b2 0.00 1.992 FORMAT "%5.3" /end CHARACTERISTIC
/begin CHARACTERISTIC DFSEFON1 "drehzahlabh. max. plausible Abweichungen der FSE-Werte" VAL_BLK 0xFC1C3C KwbWR32 2.000000000000E+037 fak_r32_1 -1.000000000000E+037 1.000000000000E+037 FORMAT "%43.4" NUMBER 8 /end CHARACTERISTIC
/begin CHARACTERISTIC DFSEFON2 "drehzahlabh. max. plausible Abweichungen der FSE-Werte" VAL_BLK 0xFC1C5C KwbWR32 2.000000000000E+037 fak_r32_1 -1.000000000000E+037 1.000000000000E+037 FORMAT "%43.4" NUMBER 8 /end CHARACTERISTIC
/begin CHARACTERISTIC DFSERES "Differenz der Adaptionswerte zum Auslˆsen eines Reset der fuel-on/-off adaption" VALUE 0xFC1CDC KwWR32 2.000000000000E+037 fak_r32_1 -1.000000000000E+037 1.000000000000E+037 FORMAT "%43.4" /end CHARACTERISTIC
/begin CHARACTERISTIC DKATCW "einmaliger Lauf bzw. Initialisierung der DKAT-Funktion" VALUE 0xFC1E7C KwUb 255.0 dez 0.00 255.0 FORMAT "%5.1" /end CHARACTERISTIC
/begin CHARACTERISTIC DKROFN "Grenzwert der Integratorsteigung f¸r Nulltest" CURVE 0xFC6684 KlAUwSstUwWUw 6103.425 spgg_sw_b3052 0.00 6103.425 FORMAT "%8.3"
 /begin AXIS_DESCR STD_AXIS tmfln_w tus_uw_q3p2 6 0.00 209712.0 FORMAT "%8.1" DEPOSIT ABSOLUTE /end AXIS_DESCR
/end CHARACTERISTIC
/begin CHARACTERISTIC DKROKU "Untere Drehzahlschwelle f¸r Ermittlung Offsetkompensationswert" VALUE 0xFC6680 KwUb 10200. nmot_ub_q40 0.00 10200. FORMAT "%5.0" /end CHARACTERISTIC
/begin CHARACTERISTIC DLAMELSH "Delta-Lambda-Sollwert f¸r elektrische Sonendiagnose hinter KAT (Kurztrip)" VALUE 0xFCCCC6 KwUw 15.99976 fak_uw_b16 0.00 15.99976 FORMAT "%8.5" /end CHARACTERISTIC
/begin CHARACTERISTIC DLAMLASHF "Delta-Lambda-Sollwert (Fett) f¸r Test Schwingungspr¸fung hinter KAT" VALUE 0xFCCC92 KwUw 15.99976 fak_uw_b16 0.00 15.99976 FORMAT "%8.5" /end CHARACTERISTIC
/begin CHARACTERISTIC DLAMLASHM "Delta-Lambda-Sollwert (Mager) f¸r Test Schwingungspr¸fung hinter KAT" VALUE 0xFCCC94 KwUw 15.99976 fak_uw_b16 0.00 15.99976 FORMAT "%8.5" /end CHARACTERISTIC
/begin CHARACTERISTIC DLURMIN "Drehzahlabh. Laufunruhe-Referenz-Minimalwert 1" CURVE 0xFC1394 GklWU16 181.8962 luquant_w 0.00 181.8962 FORMAT "%8.4"
 /begin AXIS_DESCR COM_AXIS nmot nmot_ub_q40 8 0.00 10200. FORMAT "%5.0" AXIS_PTS_REF SNM08DMUB /end AXIS_DESCR
/end CHARACTERISTIC
/begin CHARACTERISTIC DMRKTD "Momentenreserve f¸r Katalysator-Diagnose" VALUE 0xFCCC2E KwUw 99.99847 rel_uw_b100 0.00 99.99847 FORMAT "%8.5" /end CHARACTERISTIC
/begin CHARACTERISTIC DMRLASH "Momentenreserve f¸r Diagnose Lambdasonden-Alterungs¸berwachung hinter KAT" VALUE 0xFCCC96 KwUw 99.99847 rel_uw_b100 0.00 99.99847 FORMAT "%8.5" /end CHARACTERISTIC
/begin CHARACTERISTIC DMRLSH "Momentenreserve f¸r Diagnose Lambdasonden hinter KAT" VALUE 0xFCCCC8 KwUw 99.99847 rel_uw_b100 0.00 99.99847 FORMAT "%8.5" /end CHARACTERISTIC
/begin CHARACTERISTIC DMXRDL "Begrenzung bei max. Laufunruhe-Referenzwert-ƒnderung von dlurs" VALUE 0xFC13A8 KwWR32 2.000000000000E+037 fak_r32_1 -1.000000000000E+037 1.000000000000E+037 FORMAT "%43.4" /end CHARACTERISTIC
/begin CHARACTERISTIC DMXRFL "Begrenzung bei max. Filter-Laufunruhe-Referenzwert-ƒnderung" VALUE 0xFC1A38 KwWR32 2.000000000000E+037 fak_r32_1 -1.000000000000E+037 1.000000000000E+037 FORMAT "%43.4" /end CHARACTERISTIC
/begin CHARACTERISTIC DMXRLU "Begrenzung bei max. Laufunruhe-Referenzwert-ƒnderung" VALUE 0xFC182C KwWR32 2.000000000000E+037 fak_r32_1 -1.000000000000E+037 1.000000000000E+037 FORMAT "%43.4" /end CHARACTERISTIC
/begin CHARACTERISTIC DNDLLRO "Maximale Drehzahlabweichung (Unterdrehzahl) f¸r Diagnose LLR" VALUE 0xFCF24F KwUb 1270. nmot_ub_q10 0.00 1270. FORMAT "%5.0" /end CHARACTERISTIC
/begin CHARACTERISTIC DNDLLRU "Maximale Drehzahlabweichung (‹berdrehzahl) f¸r Diagnose LLR" VALUE 0xFCF250 KwSb 1280. nmot_ub_q10 -1280. 0.00 FORMAT "%5.0" /end CHARACTERISTIC
/begin CHARACTERISTIC DRISIGH "Diagnoseschwelle Ri-Sonde f¸r Signalunterbrechung hinter KAT" VALUE 0xFCCCCA KwUw 131070.0 r_uw_q2 0.00 131070.0 FORMAT "%8.1" /end CHARACTERISTIC
/begin CHARACTERISTIC DRISIGV "Diagnoseschwelle Ri-Sonde f¸r Signalunterbrechung vor KAT" VALUE 0xFCCCFC KwUw 131070.0 r_uw_q2 0.00 131070.0 FORMAT "%8.1" /end CHARACTERISTIC
/begin CHARACTERISTIC DRLKTDP "Schwelle f¸r Last‰nderung in Kat-Diagnose" VALUE 0xFC1E7D KwSb 191.3 rel_sb_q0p75 -96.00 95.25 FORMAT "%5.2" /end CHARACTERISTIC
/begin CHARACTERISTIC FALRKTD "Verst‰rkungsfaktor f¸r Amplitude des Lambdareglers" VALUE 0xFC1E7E KwUb 7.969 fak_ub_b8 0.00 7.969 FORMAT "%5.3" /end CHARACTERISTIC
/begin CHARACTERISTIC FALRKTT "Verst‰rkungsfaktor f¸r Amplitude des Lambdareglers bei Testerbetrieb" VALUE 0xFC1E7F KwUb 7.969 fak_ub_b8 0.00 7.969 FORMAT "%5.3" /end CHARACTERISTIC
/begin CHARACTERISTIC FHDLLR "Hˆhenschwelle f¸r Durchf¸hrung Diagnose Leerlaufsteller" VALUE 0xFCF251 KwUb 3.984 fak_ub_b4 0.00 3.984 FORMAT "%5.3" /end CHARACTERISTIC
/begin CHARACTERISTIC FIAMALU "Anhebungsfaktor f¸r Filter Mehrfachaussetzererkennung" VALUE 0xFC1830 KwWR32 2.000000000000E+037 fak_r32_1 -1.000000000000E+037 1.000000000000E+037 FORMAT "%43.4" /end CHARACTERISTIC
/begin CHARACTERISTIC FIMALU "Filterfaktor Mehrfachaussetzererkennung" VALUE 0xFC1834 KwWR32 2.000000000000E+037 fak_r32_1 -1.000000000000E+037 1.000000000000E+037 FORMAT "%43.4" /end CHARACTERISTIC
/begin CHARACTERISTIC FLFO "Filterfaktor Lernfilter der fuel-on/-off Adaption" VALUE 0xFC1CE0 KwWR32 2.000000000000E+037 fak_r32_1 -1.000000000000E+037 1.000000000000E+037 FORMAT "%43.4" /end CHARACTERISTIC
/begin CHARACTERISTIC FLFOF "Filterfaktor Lernfilter der fuel-off Adaption" VALUE 0xFC1B40 KwWR32 2.000000000000E+037 fak_r32_1 -1.000000000000E+037 1.000000000000E+037 FORMAT "%43.4" /end CHARACTERISTIC
/begin CHARACTERISTIC FLUTN "Filterfaktor Laufunruhe-Filter" CURVE 0xFC13B8 KlAxU8SstxR32WR32 2.000000000000E+037 fak_r32_1 -1.000000000000E+037 1.000000000000E+037 FORMAT "%43.4"
 /begin AXIS_DESCR STD_AXIS nmot_f fak_r32_1 8 -1.000000000000E+037 1.000000000000E+037 FORMAT "%43.4" DEPOSIT ABSOLUTE /end AXIS_DESCR
/end CHARACTERISTIC
/begin CHARACTERISTIC FLUV1 "Schalter der Modifikation 1 der Laufunruhe-Berechnung" VALUE 0xFC1400 KwWU8 255.0 dez 0.00 255.0 FORMAT "%5.1" /end CHARACTERISTIC
/begin CHARACTERISTIC FOFAKT "Codewort zum Anhalten der Fuel-off Adaption" VALUE 0xFC1B3A KwWU8 255.0 dez 0.00 255.0 FORMAT "%5.1" /end CHARACTERISTIC
/begin CHARACTERISTIC FRAE "Delta-fra-Schwelle f¸r Erkennung der eingeschwungenen Grundadaption" VALUE 0xFCD7D4 KwUw 1.999969 fak_uw_b2 0.00 1.999969 FORMAT "%8.6" /end CHARACTERISTIC
/begin CHARACTERISTIC FRAODN "untere Diagnoseschwelle des Korrekturfaktors frao" VALUE 0xFCD7D6 KwUw 1.999969 fak_uw_b2 0.00 1.999969 FORMAT "%8.6" /end CHARACTERISTIC
/begin CHARACTERISTIC FRAODX "obere Diagnoseschwelle des Korrekturfaktors frao" VALUE 0xFCD7D8 KwUw 1.999969 fak_uw_b2 0.00 1.999969 FORMAT "%8.6" /end CHARACTERISTIC
/begin CHARACTERISTIC FRAUDN "untere Diagnoseschwelle des Korrekturfaktors frau" VALUE 0xFCD7DA KwUw 1.999969 fak_uw_b2 0.00 1.999969 FORMAT "%8.6" /end CHARACTERISTIC
/begin CHARACTERISTIC FRAUDX "obere Diagnoseschwelle des Korrekturfaktors frau" VALUE 0xFCD7DC KwUw 1.999969 fak_uw_b2 0.00 1.999969 FORMAT "%8.6" /end CHARACTERISTIC
/begin CHARACTERISTIC FRMLASHO "obere Schwelle f¸r Mittelwert des Lambdareglerfaktors" VALUE 0xFCCC98 KwUw 1.999969 fak_uw_b2 0.00 1.999969 FORMAT "%8.6" /end CHARACTERISTIC
/begin CHARACTERISTIC FRMLASHU "untere Schwelle f¸r Mittelwert des Lambdareglerfaktors" VALUE 0xFCCC9A KwUw 1.999969 fak_uw_b2 0.00 1.999969 FORMAT "%8.6" /end CHARACTERISTIC
/begin CHARACTERISTIC FRMSTTDN "untere Diagnoseschwelle (short test)" CURVE 0xFCD7B4 KlAUbSstUbWUb 1.992 fak_ub_b2 0.00 1.992 FORMAT "%5.3"
 /begin AXIS_DESCR STD_AXIS tans temp_ub_q0p75_o48 4 -48.00 143.3 FORMAT "%5.1" DEPOSIT ABSOLUTE /end AXIS_DESCR
/end CHARACTERISTIC
/begin CHARACTERISTIC FRMSTTDX "obere Diagnoseschwelle (short test)" CURVE 0xFCD7C0 KlAUbSstUbWUb 1.992 fak_ub_b2 0.00 1.992 FORMAT "%5.3"
 /begin AXIS_DESCR STD_AXIS tans temp_ub_q0p75_o48 4 -48.00 143.3 FORMAT "%5.1" DEPOSIT ABSOLUTE /end AXIS_DESCR
/end CHARACTERISTIC
/begin CHARACTERISTIC FS1FO "Filterfaktor Segmentzeit-Filter 1 der fuel-on/-off Adaption" VALUE 0xFC1CE4 KwWR32 2.000000000000E+037 fak_r32_1 -1.000000000000E+037 1.000000000000E+037 FORMAT "%43.4" /end CHARACTERISTIC
/begin CHARACTERISTIC FS1FOF "Filterfaktor Segmentzeit-Filter 1 der fuel-off Adaption" VALUE 0xFC1B44 KwWR32 2.000000000000E+037 fak_r32_1 -1.000000000000E+037 1.000000000000E+037 FORMAT "%43.4" /end CHARACTERISTIC
/begin CHARACTERISTIC FS2FO "Filterfaktor Segmentzeit-Filter 2 der fuel-on/-off Adaption" VALUE 0xFC1CE8 KwWR32 2.000000000000E+037 fak_r32_1 -1.000000000000E+037 1.000000000000E+037 FORMAT "%43.4" /end CHARACTERISTIC
/begin CHARACTERISTIC FS2FOF "Filterfaktor Segmentzeit-Filter 2 der fuel-off Adaption" VALUE 0xFC1B48 KwWR32 2.000000000000E+037 fak_r32_1 -1.000000000000E+037 1.000000000000E+037 FORMAT "%43.4" /end CHARACTERISTIC
/begin CHARACTERISTIC IMLKVSMX "Maximale Integrationsschwelle f¸r Fehlerfreigabe in DKVS (Tank leer)" VALUE 0xFCD7DE KwUw 233.0133 m_q0p00355 0.00 233.0133 FORMAT "%8.4" /end CHARACTERISTIC
/begin CHARACTERISTIC KATBFML "Filterzeitkonstante f¸r Signald‰mpfung in Katbelastung" CURVE 0xFC1E80 GklWUb 12.7498 zk50msxs_ub_b12p8 0.0501961 12.8000 FORMAT "%7.4"
 /begin AXIS_DESCR COM_AXIS ml m_ub_b1020 5 0.00 1020. FORMAT "%5.0" AXIS_PTS_REF SML05DKUB /end AXIS_DESCR
/end CHARACTERISTIC
/begin CHARACTERISTIC KATBFMN "Schwellwert f¸r kleine Katalysatorbelastung" VALUE 0xFC1E85 KwUb 0.9961 fak_ub_b1 0.00 0.9961 /end CHARACTERISTIC
/begin CHARACTERISTIC KATBFN "normierter Mittelwert der Sondenamplitude" VALUE 0xFC1E86 KwUb 0.9961 fak_ub_b1 0.00 0.9961 /end CHARACTERISTIC
/begin CHARACTERISTIC KATBFNM "Normierungsfaktor multiplikativ f¸r Katbelastung" VALUE 0xFC1E87 KwUb 1.330 spg_ub_b1p33 0.00 1.330 FORMAT "%5.3" /end CHARACTERISTIC
/begin CHARACTERISTIC KATBFNP "Normierungsfaktor additiv f¸r Katbelastung" VALUE 0xFC1E88 KwUb 1.330 spg_ub_b1p33 0.00 1.330 FORMAT "%5.3" /end CHARACTERISTIC
/begin CHARACTERISTIC KATBFSX "Max. Integrationsschwelle f¸r Stoppbedingung" VALUE 0xFC1E89 KwSb 1.992 fak_sb_b1 -1.000 0.9922 FORMAT "%5.3" /end CHARACTERISTIC
/begin CHARACTERISTIC KATBFXM "Maximale Katbelastungsschwelle f¸r Stoppbedingung" CURVE 0xFC1EAE GklWSw 1023.984 freq_sw_b512 -512.0000 511.9844 FORMAT "%8.4"
 /begin AXIS_DESCR COM_AXIS ml m_ub_b1020 5 0.00 1020. FORMAT "%5.0" AXIS_PTS_REF SML05DKUB /end AXIS_DESCR
/end CHARACTERISTIC
/begin CHARACTERISTIC KATBSG "Katalysatorspeichergrˆﬂe f¸r Katbelastung" VALUE 0xFC1E8A KwUb 220.5 m_ub_b221p35 0.8681 221.4 FORMAT "%5.1" /end CHARACTERISTIC
/begin CHARACTERISTIC KATBSH "Offset f¸r Lambdaregelung leicht im fetten Bereich" VALUE 0xFC1E8B KwUb 221.4 mgrad_ub_b221p35 0.00 221.4 FORMAT "%5.1" /end CHARACTERISTIC
/begin CHARACTERISTIC KATBSHF "Verst‰rkungsfaktor f¸r Regellagendifferenz" VALUE 0xFC1E8C KwUb 2653. mgrad_ub_b2652p5 0.00 2653. FORMAT "%5.0" /end CHARACTERISTIC
/begin CHARACTERISTIC KATBSHG "Begrenzungsfaktor der Regellagenkorrektur" VALUE 0xFC1E8D KwUb 0.9961 fak_ub_b1 0.00 0.9961 /end CHARACTERISTIC
/begin CHARACTERISTIC KFAMAL "Kennfeld Absenkungsfaktor f¸r Lur-Wert bei erkannten Mehrfachaussetzern" MAP 0xFC1704 GkfWU8 0.9961 fak_ub_b1 0.00 0.9961
 /begin AXIS_DESCR COM_AXIS rl rel_ub_q0p75 8 0.00 191.3 FORMAT "%5.1" AXIS_PTS_REF SRL08DMUB /end AXIS_DESCR
 /begin AXIS_DESCR COM_AXIS nmot nmot_ub_q40 8 0.00 10200. FORMAT "%5.0" AXIS_PTS_REF SNM08DMUB /end AXIS_DESCR
/end CHARACTERISTIC
/begin CHARACTERISTIC KFAMAL1 "Kennfeld Absenkungsfaktor f¸r Lur-Wert bei erkannten Mehrfachaussetzern" MAP 0xFC1744 GkfWU8 0.9961 fak_ub_b1 0.00 0.9961
 /begin AXIS_DESCR COM_AXIS rl rel_ub_q0p75 8 0.00 191.3 FORMAT "%5.1" AXIS_PTS_REF SRL08DMUB /end AXIS_DESCR
 /begin AXIS_DESCR COM_AXIS nmot nmot_ub_q40 8 0.00 10200. FORMAT "%5.0" AXIS_PTS_REF SNM08DMUB /end AXIS_DESCR
/end CHARACTERISTIC
/begin CHARACTERISTIC KFAMAL2 "Kennfeld Absenkungsfaktor f¸r Lur-Wert bei erkannten Mehrfachaussetzern" MAP 0xFC1784 GkfWU8 0.9961 fak_ub_b1 0.00 0.9961
 /begin AXIS_DESCR COM_AXIS rl rel_ub_q0p75 8 0.00 191.3 FORMAT "%5.1" AXIS_PTS_REF SRL08DMUB /end AXIS_DESCR
 /begin AXIS_DESCR COM_AXIS nmot nmot_ub_q40 8 0.00 10200. FORMAT "%5.0" AXIS_PTS_REF SNM08DMUB /end AXIS_DESCR
/end CHARACTERISTIC
/begin CHARACTERISTIC KFCFO1 "Kennfeld zur Definition der Bereichseigenschaften (dominant..)" MAP 0xFC1B6C GkfWU8 255.0 dez 0.00 255.0 FORMAT "%5.1"
 /begin AXIS_DESCR COM_AXIS nmot_w nmot_uw_q0p25 10 0.00 16383.75 FORMAT "%8.2" AXIS_PTS_REF SNM10DMUW1 /end AXIS_DESCR
 /begin AXIS_DESCR COM_AXIS rl rel_ub_q0p75 5 0.00 191.3 FORMAT "%5.1" AXIS_PTS_REF SRL05DMUB1 /end AXIS_DESCR
/end CHARACTERISTIC
/begin CHARACTERISTIC KFCFO2 "Kennfeld zur Definition der Bereichseigenschaften (dominant..)" MAP 0xFC1BA0 GkfWU8 255.0 dez 0.00 255.0 FORMAT "%5.1"
 /begin AXIS_DESCR COM_AXIS nmot_w nmot_uw_q0p25 10 0.00 16383.75 FORMAT "%8.2" AXIS_PTS_REF SNM10DMUW2 /end AXIS_DESCR
 /begin AXIS_DESCR COM_AXIS rl rel_ub_q0p75 5 0.00 191.3 FORMAT "%5.1" AXIS_PTS_REF SRL05DMUB2 /end AXIS_DESCR
/end CHARACTERISTIC
/begin CHARACTERISTIC KFDLUR "Kennfeld f¸r Laufunruhedifferenz dluts Referenzwert" MAP 0xFC1194 GkfWU16 181.8962 luquant_w 0.00 181.8962 FORMAT "%8.4"
 /begin AXIS_DESCR COM_AXIS rl rel_ub_q0p75 8 0.00 191.3 FORMAT "%5.1" AXIS_PTS_REF SRL08DMUB /end AXIS_DESCR
 /begin AXIS_DESCR COM_AXIS nmot nmot_ub_q40 8 0.00 10200. FORMAT "%5.0" AXIS_PTS_REF SNM08DMUB /end AXIS_DESCR
/end CHARACTERISTIC
/begin CHARACTERISTIC KFDLUR1 "Kennfeld f¸r Laufunruhedifferenz dluts Referenzwert" MAP 0xFC1214 GkfWU16 181.8962 luquant_w 0.00 181.8962 FORMAT "%8.4"
 /begin AXIS_DESCR COM_AXIS rl rel_ub_q0p75 8 0.00 191.3 FORMAT "%5.1" AXIS_PTS_REF SRL08DMUB /end AXIS_DESCR
 /begin AXIS_DESCR COM_AXIS nmot nmot_ub_q40 8 0.00 10200. FORMAT "%5.0" AXIS_PTS_REF SNM08DMUB /end AXIS_DESCR
/end CHARACTERISTIC
/begin CHARACTERISTIC KFDLUR2 "Kennfeld f¸r Laufunruhedifferenz dluts Referenzwert" MAP 0xFC1294 GkfWU16 181.8962 luquant_w 0.00 181.8962 FORMAT "%8.4"
 /begin AXIS_DESCR COM_AXIS rl rel_ub_q0p75 8 0.00 191.3 FORMAT "%5.1" AXIS_PTS_REF SRL08DMUB /end AXIS_DESCR
 /begin AXIS_DESCR COM_AXIS nmot nmot_ub_q40 8 0.00 10200. FORMAT "%5.0" AXIS_PTS_REF SNM08DMUB /end AXIS_DESCR
/end CHARACTERISTIC
/begin CHARACTERISTIC KFDLURS "Kennfeld f¸r Laufunruhedifferenz dluts Referenzwert" MAP 0xFC1314 GkfWU16 181.8962 luquant_w 0.00 181.8962 FORMAT "%8.4"
 /begin AXIS_DESCR COM_AXIS rl rel_ub_q0p75 8 0.00 191.3 FORMAT "%5.1" AXIS_PTS_REF SRL08DMUB /end AXIS_DESCR
 /begin AXIS_DESCR COM_AXIS nmot nmot_ub_q40 8 0.00 10200. FORMAT "%5.0" AXIS_PTS_REF SNM08DMUB /end AXIS_DESCR
/end CHARACTERISTIC
/begin CHARACTERISTIC KFLUAR "Kennfeld f¸r Laufunruhe-Abstandsmass-Referenzwert" MAP 0xFC1838 GkfWU16 181.8962 luquant_w 0.00 181.8962 FORMAT "%8.4"
 /begin AXIS_DESCR COM_AXIS rl rel_ub_q0p75 8 0.00 191.3 FORMAT "%5.1" AXIS_PTS_REF SRL08DMUB /end AXIS_DESCR
 /begin AXIS_DESCR COM_AXIS nmot nmot_ub_q40 8 0.00 10200. FORMAT "%5.0" AXIS_PTS_REF SNM08DMUB /end AXIS_DESCR
/end CHARACTERISTIC
/begin CHARACTERISTIC KFLUAR1 "Kennfeld f¸r Laufunruhe-Abstandsmass-Referenzwert" MAP 0xFC18B8 GkfWU16 181.8962 luquant_w 0.00 181.8962 FORMAT "%8.4"
 /begin AXIS_DESCR COM_AXIS rl rel_ub_q0p75 8 0.00 191.3 FORMAT "%5.1" AXIS_PTS_REF SRL08DMUB /end AXIS_DESCR
 /begin AXIS_DESCR COM_AXIS nmot nmot_ub_q40 8 0.00 10200. FORMAT "%5.0" AXIS_PTS_REF SNM08DMUB /end AXIS_DESCR
/end CHARACTERISTIC
/begin CHARACTERISTIC KFLUAR2 "Kennfeld f¸r Laufunruhe-Abstandsmass-Referenzwert" MAP 0xFC1938 GkfWU16 181.8962 luquant_w 0.00 181.8962 FORMAT "%8.4"
 /begin AXIS_DESCR COM_AXIS rl rel_ub_q0p75 8 0.00 191.3 FORMAT "%5.1" AXIS_PTS_REF SRL08DMUB /end AXIS_DESCR
 /begin AXIS_DESCR COM_AXIS nmot nmot_ub_q40 8 0.00 10200. FORMAT "%5.0" AXIS_PTS_REF SNM08DMUB /end AXIS_DESCR
/end CHARACTERISTIC
/begin CHARACTERISTIC KFLUARS "Kennfeld f¸r Laufunruhe-Abstandsmass-Referenzwert" MAP 0xFC19B8 GkfWU16 181.8962 luquant_w 0.00 181.8962 FORMAT "%8.4"
 /begin AXIS_DESCR COM_AXIS rl rel_ub_q0p75 8 0.00 191.3 FORMAT "%5.1" AXIS_PTS_REF SRL08DMUB /end AXIS_DESCR
 /begin AXIS_DESCR COM_AXIS nmot nmot_ub_q40 8 0.00 10200. FORMAT "%5.0" AXIS_PTS_REF SNM08DMUB /end AXIS_DESCR
/end CHARACTERISTIC
/begin CHARACTERISTIC KFLURB "Kennfeld f¸r Laufunruhe-Referenz-Basiswert" MAP 0xFC1404 GkfWU16 181.8962 luquant_w 0.00 181.8962 FORMAT "%8.4"
 /begin AXIS_DESCR COM_AXIS rl rel_ub_q0p75 8 0.00 191.3 FORMAT "%5.1" AXIS_PTS_REF SRL08DMUB /end AXIS_DESCR
 /begin AXIS_DESCR COM_AXIS nmot nmot_ub_q40 8 0.00 10200. FORMAT "%5.0" AXIS_PTS_REF SNM08DMUB /end AXIS_DESCR
/end CHARACTERISTIC
/begin CHARACTERISTIC KFLURB1 "Kennfeld f¸r Laufunruhe-Referenz-Basiswert" MAP 0xFC1484 GkfWU16 181.8962 luquant_w 0.00 181.8962 FORMAT "%8.4"
 /begin AXIS_DESCR COM_AXIS rl rel_ub_q0p75 8 0.00 191.3 FORMAT "%5.1" AXIS_PTS_REF SRL08DMUB /end AXIS_DESCR
 /begin AXIS_DESCR COM_AXIS nmot nmot_ub_q40 8 0.00 10200. FORMAT "%5.0" AXIS_PTS_REF SNM08DMUB /end AXIS_DESCR
/end CHARACTERISTIC
/begin CHARACTERISTIC KFLURB2 "Kennfeld f¸r Laufunruhe-Referenz-Basiswert" MAP 0xFC1504 GkfWU16 181.8962 luquant_w 0.00 181.8962 FORMAT "%8.4"
 /begin AXIS_DESCR COM_AXIS rl rel_ub_q0p75 8 0.00 191.3 FORMAT "%5.1" AXIS_PTS_REF SRL08DMUB /end AXIS_DESCR
 /begin AXIS_DESCR COM_AXIS nmot nmot_ub_q40 8 0.00 10200. FORMAT "%5.0" AXIS_PTS_REF SNM08DMUB /end AXIS_DESCR
/end CHARACTERISTIC
/begin CHARACTERISTIC KFLURBS "Kennfeld f¸r Laufunruhe-Referenz-Basiswert" MAP 0xFC1584 GkfWU16 181.8962 luquant_w 0.00 181.8962 FORMAT "%8.4"
 /begin AXIS_DESCR COM_AXIS rl rel_ub_q0p75 8 0.00 191.3 FORMAT "%5.1" AXIS_PTS_REF SRL08DMUB /end AXIS_DESCR
 /begin AXIS_DESCR COM_AXIS nmot nmot_ub_q40 8 0.00 10200. FORMAT "%5.0" AXIS_PTS_REF SNM08DMUB /end AXIS_DESCR
/end CHARACTERISTIC
/begin CHARACTERISTIC KFLURM "Kennfeld f¸r Laufunruhe-Referenzwert zur Mehrfachaussetzererkennung ->Lum-Vergl." MAP 0xFC1604 GkfWU16 181.8962 luquant_w 0.00 181.8962 FORMAT "%8.4"
 /begin AXIS_DESCR COM_AXIS rl rel_ub_q0p75 8 0.00 191.3 FORMAT "%5.1" AXIS_PTS_REF SRL08DMUB /end AXIS_DESCR
 /begin AXIS_DESCR COM_AXIS nmot nmot_ub_q40 8 0.00 10200. FORMAT "%5.0" AXIS_PTS_REF SNM08DMUB /end AXIS_DESCR
/end CHARACTERISTIC
/begin CHARACTERISTIC KFLURM1 "Kennfeld f¸r Laufunruhe-Referenzwert zur Mehrfachaussetzererkennung ->Lum-Vergl." MAP 0xFC1684 GkfWU16 181.8962 luquant_w 0.00 181.8962 FORMAT "%8.4"
 /begin AXIS_DESCR COM_AXIS rl rel_ub_q0p75 8 0.00 191.3 FORMAT "%5.1" AXIS_PTS_REF SRL08DMUB /end AXIS_DESCR
 /begin AXIS_DESCR COM_AXIS nmot nmot_ub_q40 8 0.00 10200. FORMAT "%5.0" AXIS_PTS_REF SNM08DMUB /end AXIS_DESCR
/end CHARACTERISTIC
/begin CHARACTERISTIC KFTPKOR "Korrekturkennfeld f¸r gemessene Periodendauer TP (tpsvkof)" MAP 0xFCCC30 KfAxUbAyUbSstxUbSstyUbWUb 1.992 fak_ub_b2 0.00 1.992 FORMAT "%5.3"
 /begin AXIS_DESCR STD_AXIS nmot nmot_ub_q40 8 0.00 10200. FORMAT "%5.0" DEPOSIT ABSOLUTE /end AXIS_DESCR
 /begin AXIS_DESCR STD_AXIS rl rel_ub_q0p75 7 0.00 191.3 FORMAT "%5.1" DEPOSIT ABSOLUTE /end AXIS_DESCR
/end CHARACTERISTIC
/begin CHARACTERISTIC KLCFOF1N "Kennlinie zur Definition der Bereichseigenschaften (dominant..)" CURVE 0xFC1AF4 GklWU8 255.0 dez 0.00 255.0 FORMAT "%5.1"
 /begin AXIS_DESCR COM_AXIS nmot_w nmot_uw_q0p25 6 0.00 16383.75 FORMAT "%8.2" AXIS_PTS_REF SNM06DMUW1 /end AXIS_DESCR
/end CHARACTERISTIC
/begin CHARACTERISTIC KLCFOF2N "Kennlinie zur Definition der Bereichseigenschaften (dominant..)" CURVE 0xFC1AFC GklWU8 255.0 dez 0.00 255.0 FORMAT "%5.1"
 /begin AXIS_DESCR COM_AXIS nmot_w nmot_uw_q0p25 6 0.00 16383.75 FORMAT "%8.2" AXIS_PTS_REF SNM06DMUW2 /end AXIS_DESCR
/end CHARACTERISTIC
/begin CHARACTERISTIC KLIDXFOFN1 "Kennlinie zur Definition des Bereichsindex" CURVE 0xFC1B04 GklWU8 4.000 dez 0.00 4.000 FORMAT "%5.3"
 /begin AXIS_DESCR COM_AXIS nmot_w nmot_uw_q0p25 6 0.00 16383.75 FORMAT "%8.2" AXIS_PTS_REF SNM06DMUW1 /end AXIS_DESCR
/end CHARACTERISTIC
/begin CHARACTERISTIC KLIDXFOFN2 "Kennlinie zur Definition des Bereichsindex" CURVE 0xFC1B0C GklWU8 4.000 dez 0.00 4.000 FORMAT "%5.3"
 /begin AXIS_DESCR COM_AXIS nmot_w nmot_uw_q0p25 6 0.00 16383.75 FORMAT "%8.2" AXIS_PTS_REF SNM06DMUW2 /end AXIS_DESCR
/end CHARACTERISTIC
/begin CHARACTERISTIC KLIDXFONN1 "Kennlinie zur Definition des Bereichsindex" CURVE 0xFC1C14 GklWU8 255.0 dez 0.00 255.0 FORMAT "%5.1"
 /begin AXIS_DESCR COM_AXIS nmot_w nmot_uw_q0p25 10 0.00 16383.75 FORMAT "%8.2" AXIS_PTS_REF SNM10DMUW1 /end AXIS_DESCR
/end CHARACTERISTIC
/begin CHARACTERISTIC KLIDXFONN2 "Kennlinie zur Definition des Bereichsindex" CURVE 0xFC1C20 GklWU8 255.0 dez 0.00 255.0 FORMAT "%5.1"
 /begin AXIS_DESCR COM_AXIS nmot_w nmot_uw_q0p25 10 0.00 16383.75 FORMAT "%8.2" AXIS_PTS_REF SNM10DMUW2 /end AXIS_DESCR
/end CHARACTERISTIC
/begin CHARACTERISTIC KLIDXFORL1 "Kennlinie zur Definition des Bereichsindex" CURVE 0xFC1C2C GklWU8 255.0 dez 0.00 255.0 FORMAT "%5.1"
 /begin AXIS_DESCR COM_AXIS rl rel_ub_q0p75 5 0.00 191.3 FORMAT "%5.1" AXIS_PTS_REF SRL05DMUB1 /end AXIS_DESCR
/end CHARACTERISTIC
/begin CHARACTERISTIC KLIDXFORL2 "Kennlinie zur Definition des Bereichsindex" CURVE 0xFC1C34 GklWU8 255.0 dez 0.00 255.0 FORMAT "%5.1"
 /begin AXIS_DESCR COM_AXIS rl rel_ub_q0p75 5 0.00 191.3 FORMAT "%5.1" AXIS_PTS_REF SRL05DMUB2 /end AXIS_DESCR
/end CHARACTERISTIC
/begin CHARACTERISTIC KMXSTG "Filterkonstante f¸r Filter max. Steigung f¸r Sonde hinter KAT" VALUE 0xFCCC9C KwUw 0.9999847 fak_uw_b1 0.00 0.9999847 FORMAT "%9.7" /end CHARACTERISTIC
/begin CHARACTERISTIC KRFHKS "Fehlerh‰ufigkeit Klopfsensoren" VALUE 0xFCE990 KwUb 255.0 dez 0.00 255.0 FORMAT "%5.1" /end CHARACTERISTIC
/begin CHARACTERISTIC KRFHT "Fehlerh‰ufigkeit Testimpuls" VALUE 0xFC6681 KwUb 254.0 dez 1.000 255.0 FORMAT "%5.1" /end CHARACTERISTIC
/begin CHARACTERISTIC KTLAMSTEIG "I-Faktor  f¸r  Rampensteigung lamlash im Kurztrip f¸r Testfunktion hinter KAT" VALUE 0xFCCC9E KwUw 0.9999847 fak_uw_b1 0.00 0.9999847 FORMAT "%9.7" /end CHARACTERISTIC
/begin CHARACTERISTIC LAMSONSVL "Schwelle f¸r Vollast Lambda-Betrieb bei der Sondenspannung ¸berpr¸ft wird" VALUE 0xFCCCA0 KwUw 15.99976 fak_uw_b16 0.00 15.99976 FORMAT "%8.5" /end CHARACTERISTIC
/begin CHARACTERISTIC LAMSTEIG "I-Faktor  f¸r  Rampensteigung lamlash f¸r Testfunktion hinter KAT" VALUE 0xFCCCA2 KwUw 0.9999847 fak_uw_b1 0.00 0.9999847 FORMAT "%9.7" /end CHARACTERISTIC
/begin CHARACTERISTIC LURBRL "Laufunruhe-Referenzwert bei Fahrzeug steht" CURVE 0xFC181E KlAxU8SstxU8WU16 181.8962 luquant_w 0.00 181.8962 FORMAT "%8.4"
 /begin AXIS_DESCR STD_AXIS rl rel_ub_q0p75 4 0.00 191.3 FORMAT "%5.1" DEPOSIT ABSOLUTE /end AXIS_DESCR
/end CHARACTERISTIC
/begin CHARACTERISTIC LURFOST "Laufruhe-Referenzwert f¸r stop fuel-on/-off Adaption, Vergleich mit lunw" VALUE 0xFC1B4C KwWR32 2.000000000000E+037 fak_r32_1 -1.000000000000E+037 1.000000000000E+037 FORMAT "%43.4" /end CHARACTERISTIC
/begin CHARACTERISTIC LURKTM "Tmot-abh‰ngiger Laufunruhe-Referenz-Korrekturwert" CURVE 0xFC17C4 GklWU16 181.8962 luquant_w 0.00 181.8962 FORMAT "%8.4"
 /begin AXIS_DESCR COM_AXIS tmot temp_ub_q0p75_o48 8 -48.00 143.3 FORMAT "%5.1" AXIS_PTS_REF STM08DMUB /end AXIS_DESCR
/end CHARACTERISTIC
/begin CHARACTERISTIC LURMIN1 "Drehzahlabh. Laufunruhe-Referenz-Minimalwert 1" CURVE 0xFC17D4 GklWU16 181.8962 luquant_w 0.00 181.8962 FORMAT "%8.4"
 /begin AXIS_DESCR COM_AXIS nmot nmot_ub_q40 8 0.00 10200. FORMAT "%5.0" AXIS_PTS_REF SNM08DMUB /end AXIS_DESCR
/end CHARACTERISTIC
/begin CHARACTERISTIC LURMIN2 "Drehzahlabh. Laufunruhe-Referenz-Minimalwert 2" CURVE 0xFC17E4 GklWU16 181.8962 luquant_w 0.00 181.8962 FORMAT "%8.4"
 /begin AXIS_DESCR COM_AXIS nmot nmot_ub_q40 8 0.00 10200. FORMAT "%5.0" AXIS_PTS_REF SNM08DMUB /end AXIS_DESCR
/end CHARACTERISTIC
/begin CHARACTERISTIC LURMIN3 "Drehzahlabh. Laufunruhe-Referenz-Minimalwert 3" CURVE 0xFC17F4 GklWU16 181.8962 luquant_w 0.00 181.8962 FORMAT "%8.4"
 /begin AXIS_DESCR COM_AXIS nmot nmot_ub_q40 8 0.00 10200. FORMAT "%5.0" AXIS_PTS_REF SNM08DMUB /end AXIS_DESCR
/end CHARACTERISTIC
/begin CHARACTERISTIC LURST "Laufunruhe-Referenzwertkorrektur nach Start" CURVE 0xFC1804 KlAxU8SstxU16WU16 181.8962 luquant_w 0.00 181.8962 FORMAT "%8.4"
 /begin AXIS_DESCR STD_AXIS tnst_w t10msxs_uw_b655p35 6 0.00 655.3500 FORMAT "%8.4" DEPOSIT ABSOLUTE /end AXIS_DESCR
/end CHARACTERISTIC
/begin CHARACTERISTIC MDERKFON "Anzahl Aussetzer f¸r Adaptionsstop (Heilung)" VALUE 0xFC1CD6 KwWU16 65535.00 dez 0.00 65535.00 FORMAT "%8.2" /end CHARACTERISTIC
/begin CHARACTERISTIC MLDKVSF "Luftmassenschwelle f¸r Fehlerfreigabe im DKVS (Tank leer)" VALUE 0xFCD7E0 KwUw 233.0133 m_q0p00355 0.00 233.0133 FORMAT "%8.4" /end CHARACTERISTIC
/begin CHARACTERISTIC MLDKVSG "Luftmassenschwelle f¸r Fehlerfreigabe Tank leer" VALUE 0xFCD7E2 KwUw 233.0133 m_q0p00355 0.00 233.0133 FORMAT "%8.4" /end CHARACTERISTIC
/begin CHARACTERISTIC MLLASH "Luftmassenschwelle f¸r Schwingungspr¸fung hinter KAT" VALUE 0xFCCCA4 KwUw 6553.500 m_q0p1 0.00 6553.500 FORMAT "%8.3" /end CHARACTERISTIC
/begin CHARACTERISTIC MLOSTEST "obere Luftmassenschwelle f¸r Testbeginn Schwingungspr¸fung hinter KAT" VALUE 0xFCCCA6 KwUw 6553.500 m_q0p1 0.00 6553.500 FORMAT "%8.3" /end CHARACTERISTIC
/begin CHARACTERISTIC MLUSSTG "Luftmassenschwelle f¸r Dynamikpr¸fung hinter KAT" VALUE 0xFCCCA8 KwUw 6553.500 m_q0p1 0.00 6553.500 FORMAT "%8.3" /end CHARACTERISTIC
/begin CHARACTERISTIC MLUSTEST "untere Luftmassenschwelle f¸r Testbeginn Schwingungspr¸fung hinter KAT" VALUE 0xFCCCAA KwUw 6553.500 m_q0p1 0.00 6553.500 FORMAT "%8.3" /end CHARACTERISTIC
/begin CHARACTERISTIC MLUSVL "Luftmassenschwelle f¸r Vollast-Pr¸fung f¸r Sonde hinter KAT" VALUE 0xFCCCAC KwUw 6553.500 m_q0p1 0.00 6553.500 FORMAT "%8.3" /end CHARACTERISTIC
/begin CHARACTERISTIC NDKSO "Obere Diagnoseschwelle f¸r Klopfsensordiagnose" VALUE 0xFC667C KwWU8 10200. nmot_ub_q40 0.00 10200. FORMAT "%5.0" /end CHARACTERISTIC
/begin CHARACTERISTIC NDKSU "Untere Diagnoseschwelle f¸r Klopfsensordiagnose" VALUE 0xFC667D KwWU8 10200. nmot_ub_q40 0.00 10200. FORMAT "%5.0" /end CHARACTERISTIC
/begin CHARACTERISTIC NDKTSO "Obere Drehzahlgrenze f¸r DKAT-aktiv" VALUE 0xFC1E8E KwUb 10200. nmot_ub_q40 0.00 10200. FORMAT "%5.0" /end CHARACTERISTIC
/begin CHARACTERISTIC NDKTSOT "Obere Drehzahlgrenze f¸r Funktionsanforderung" VALUE 0xFC1E8F KwUb 10200. nmot_ub_q40 0.00 10200. FORMAT "%5.0" /end CHARACTERISTIC
/begin CHARACTERISTIC NDKTSU "untere Drehzahlgrenze f¸r DKAT-aktiv" VALUE 0xFC1E90 KwUb 10200. nmot_ub_q40 0.00 10200. FORMAT "%5.0" /end CHARACTERISTIC
/begin CHARACTERISTIC NDKTSUT "Untere Drehzahlgrenze f¸r Funktionsanforderung" VALUE 0xFC1E91 KwUb 10200. nmot_ub_q40 0.00 10200. FORMAT "%5.0" /end CHARACTERISTIC
/begin CHARACTERISTIC NFLUV "Drehzahlschwelle der Modifikation der Laufunruhe-Berechnung" VALUE 0xFC1401 KwWU8 10200. nmot_ub_q40 0.00 10200. FORMAT "%5.0" /end CHARACTERISTIC
/begin CHARACTERISTIC NINITSK "Initialisierungswert f¸r Segmentzeitarray auf Drehzahlbasis" VALUE 0xFC13FC KwWU16 16383.75 nmot_uw_q0p25 0.00 16383.75 FORMAT "%8.2" /end CHARACTERISTIC
/begin CHARACTERISTIC NKTDX "Maximale Drehzahlgrenze DKAT f¸r Berechnung" VALUE 0xFC1E92 KwUb 10200. nmot_ub_q40 0.00 10200. FORMAT "%5.0" /end CHARACTERISTIC
/begin CHARACTERISTIC NMIDLU "Min. Drehzahl f¸r Ausblendung der Aussetzererkennung DMDDLU" VALUE 0xFC13A4 KwWU8 10200. nmot_ub_q40 0.00 10200. FORMAT "%5.0" /end CHARACTERISTIC
/begin CHARACTERISTIC NMNTKOMP "Drehzahlbegrenzung der Gradientenkorrektur nach Start, Minimalwert" VALUE 0xFC13FE KwWU16 16383.75 nmot_uw_q0p25 0.00 16383.75 FORMAT "%8.2" /end CHARACTERISTIC
/begin CHARACTERISTIC NTPKTO "obere Drehzahlschwelle f¸r Periodendauer-Kurztest" VALUE 0xFC1EBE KwUb 10200. nmot_ub_q40 0.00 10200. FORMAT "%5.0" /end CHARACTERISTIC
/begin CHARACTERISTIC NTPKTU "untere Drehzahlschwelle f¸r Periodendauer-Kurztest" VALUE 0xFC1EBF KwUb 10200. nmot_ub_q40 0.00 10200. FORMAT "%5.0" /end CHARACTERISTIC
/begin CHARACTERISTIC NTPVKO "obere Drehzahlschwelle f¸r Periodendauer¸berwachung vor Kat" VALUE 0xFC1EC0 KwUb 10200. nmot_ub_q40 0.00 10200. FORMAT "%5.0" /end CHARACTERISTIC
/begin CHARACTERISTIC NTPVKU "untere Drehzahlschwelle f¸r Periodendauer¸berwachung vor Kat" VALUE 0xFC1EC1 KwUb 10200. nmot_ub_q40 0.00 10200. FORMAT "%5.0" /end CHARACTERISTIC
/begin CHARACTERISTIC PHLSNHMN "Heizleistung f¸r ausreichende Sondenheizung" VALUE 0xFCCCBD KwUb 2.550 fak_ub_q0p01 0.00 2.550 FORMAT "%5.3" /end CHARACTERISTIC
/begin CHARACTERISTIC RISIGRESH "Schwelle f¸r Reset Signalunterbrechung mit Ri-Diagnose hinter KAT" VALUE 0xFCCCCC KwUw 131070.0 r_uw_q2 0.00 131070.0 FORMAT "%8.1" /end CHARACTERISTIC
/begin CHARACTERISTIC RISIGRESV "Schwelle f¸r Reset Signalunterbrechung mit Ri-Diagnose vor KAT" VALUE 0xFCCCFE KwUw 131070.0 r_uw_q2 0.00 131070.0 FORMAT "%8.1" /end CHARACTERISTIC
/begin CHARACTERISTIC RKAE "Delta rkat- bzw. rkaz-Schwelle f¸r Erkennung der eingeschwungenen Grundadaption" VALUE 0xFCD7E4 KwSw 3071.953 rel_sw_b1536 -1536.000 1535.953 FORMAT "%8.3" /end CHARACTERISTIC
/begin CHARACTERISTIC RKATDN "untere Diagnoseschwelle additive Korrektur pro Zeit" VALUE 0xFCD7E6 KwSw 3071.953 rel_sw_b1536 -1536.000 1535.953 FORMAT "%8.3" /end CHARACTERISTIC
/begin CHARACTERISTIC RKATDX "obere Diagnoseschwelle additive Korrektur pro Zeit" VALUE 0xFCD7E8 KwSw 3071.953 rel_sw_b1536 -1536.000 1535.953 FORMAT "%8.3" /end CHARACTERISTIC
/begin CHARACTERISTIC RKAZDN "untere Diagnoseschwelle additive Korrektur pro Z¸ndung" VALUE 0xFCD7EA KwSw 3071.953 rel_sw_b1536 -1536.000 1535.953 FORMAT "%8.3" /end CHARACTERISTIC
/begin CHARACTERISTIC RKAZDX "obere Diagnoseschwelle additive Korrektur pro Z¸ndung" VALUE 0xFCD7EC KwSw 3071.953 rel_sw_b1536 -1536.000 1535.953 FORMAT "%8.3" /end CHARACTERISTIC
/begin CHARACTERISTIC RLDKTOT "Obere Lastgrenze f¸r Funktionsanforderung" VALUE 0xFC1E93 KwUb 191.3 rel_ub_q0p75 0.00 191.3 FORMAT "%5.1" /end CHARACTERISTIC
/begin CHARACTERISTIC RLDKTSO "Obere Lastkennlinie f¸r DKAT-aktiv" CURVE 0xFC1E94 GklWUb 191.3 rel_ub_q0p75 0.00 191.3 FORMAT "%5.1"
 /begin AXIS_DESCR COM_AXIS nmot nmot_ub_q40 5 0.00 10200. FORMAT "%5.0" AXIS_PTS_REF SNM05DKUB /end AXIS_DESCR
/end CHARACTERISTIC
/begin CHARACTERISTIC RLDKTSU "Untere Lastkennlinie f¸r DKAT-aktiv" CURVE 0xFC1E9C GklWUb 191.3 rel_ub_q0p75 0.00 191.3 FORMAT "%5.1"
 /begin AXIS_DESCR COM_AXIS nmot nmot_ub_q40 5 0.00 10200. FORMAT "%5.0" AXIS_PTS_REF SNM05DKUB /end AXIS_DESCR
/end CHARACTERISTIC
/begin CHARACTERISTIC RLDKTUT "Untere Lastgrenze f¸r Funktionsanforderung" VALUE 0xFC1EA1 KwUb 191.3 rel_ub_q0p75 0.00 191.3 FORMAT "%5.1" /end CHARACTERISTIC
/begin CHARACTERISTIC RLDLLR "F¸llungsschwelle f¸r Diagnose LLR" VALUE 0xFCF252 KwUb 99.75 rel_ub_q0p75 0.00 99.75 FORMAT "%5.2" /end CHARACTERISTIC
/begin CHARACTERISTIC RLTPKTO "obere Lastschwelle f¸r Periodendauer-Kurztest" VALUE 0xFC1EC2 KwUb 191.3 rel_ub_q0p75 0.00 191.3 FORMAT "%5.1" /end CHARACTERISTIC
/begin CHARACTERISTIC RLTPKTU "untere Lastschwelle f¸r Periodendauer-Kurztest" VALUE 0xFC1EC3 KwUb 191.3 rel_ub_q0p75 0.00 191.3 FORMAT "%5.1" /end CHARACTERISTIC
/begin CHARACTERISTIC RLTPVKO "obere Lastschwelle f¸r Periodendauer¸berwachung vor Kat" VALUE 0xFC1EC4 KwUb 191.3 rel_ub_q0p75 0.00 191.3 FORMAT "%5.1" /end CHARACTERISTIC
/begin CHARACTERISTIC RLTPVKU "untere Lastschwelle f¸r Periodendauer¸berwachung vor Kat" VALUE 0xFC1EC5 KwUb 191.3 rel_ub_q0p75 0.00 191.3 FORMAT "%5.1" /end CHARACTERISTIC
/begin CHARACTERISTIC SAFK1 "Filterkonstante 1 f¸r Lambdasonden-Signalausgabe" VALUE 0xFCCCF2 KwUw 0.9999847 fak_uw_b1 0.00 0.9999847 FORMAT "%9.7" /end CHARACTERISTIC
/begin CHARACTERISTIC SAFK2 "Filterkonstante 2 f¸r Lambdasonden-Signalausgabe" VALUE 0xFCCCDE KwUb 0.9961 fak_ub_b1 0.00 0.9961 /end CHARACTERISTIC
/begin CHARACTERISTIC SI04DMUB1 "Kennlinie zur Definition der St¸tzstellen" VAL_BLK 0xFC1B14 KwbWR32 2.000000000000E+037 fak_r32_1 -1.000000000000E+037 1.000000000000E+037 FORMAT "%43.4" NUMBER 4 /end CHARACTERISTIC
/begin CHARACTERISTIC SI04DMUB2 "Kennlinie zur Definition der St¸tzstellen" VAL_BLK 0xFC1B24 KwbWR32 2.000000000000E+037 fak_r32_1 -1.000000000000E+037 1.000000000000E+037 FORMAT "%43.4" NUMBER 4 /end CHARACTERISTIC
/begin CHARACTERISTIC SIN08DMFL1 "St¸tzstellen KF Fuel-on-Adaption" VAL_BLK 0xFC1C7C KwbWR32 2.000000000000E+037 fak_r32_1 -1.000000000000E+037 1.000000000000E+037 FORMAT "%43.4" NUMBER 8 /end CHARACTERISTIC
/begin CHARACTERISTIC SIN08DMFL2 "St¸tzstellen KF Fuel-on-Adaption" VAL_BLK 0xFC1C9C KwbWR32 2.000000000000E+037 fak_r32_1 -1.000000000000E+037 1.000000000000E+037 FORMAT "%43.4" NUMBER 8 /end CHARACTERISTIC
/begin CHARACTERISTIC SIRL03DMF1 "St¸tzstellen KF Fuel-on-Adaption" VAL_BLK 0xFC1CBC KwbWR32 2.000000000000E+037 fak_r32_1 -1.000000000000E+037 1.000000000000E+037 FORMAT "%43.4" NUMBER 3 /end CHARACTERISTIC
/begin CHARACTERISTIC SIRL03DMF2 "St¸tzstellen KF Fuel-on-Adaption" VAL_BLK 0xFC1CC8 KwbWR32 2.000000000000E+037 fak_r32_1 -1.000000000000E+037 1.000000000000E+037 FORMAT "%43.4" NUMBER 3 /end CHARACTERISTIC
/begin CHARACTERISTIC SLFOFO1N "Obere Schwelle (Schwellwert-KL) f¸r Lernfilterwert bei fuel-off Adaption" CURVE 0xFC1AD4 GklWU16 0.9999847 fak_uw_b1 0.00 0.9999847 FORMAT "%9.7"
 /begin AXIS_DESCR COM_AXIS nmot_w nmot_uw_q0p25 4 0.00 16383.75 FORMAT "%8.2" AXIS_PTS_REF SNM04DMUW1 /end AXIS_DESCR
/end CHARACTERISTIC
/begin CHARACTERISTIC SLFOFO2N "Obere Schwelle (Schwellwert-KL) f¸r Lernfilterwert bei fuel-off Adaption" CURVE 0xFC1ADC GklWU16 0.9999847 fak_uw_b1 0.00 0.9999847 FORMAT "%9.7"
 /begin AXIS_DESCR COM_AXIS nmot_w nmot_uw_q0p25 4 0.00 16383.75 FORMAT "%8.2" AXIS_PTS_REF SNM04DMUW2 /end AXIS_DESCR
/end CHARACTERISTIC
/begin CHARACTERISTIC SLFOFU1N "untere Schwelle (Schwellwert-KL) f¸r Lernfilterwert bei fuel-off Adaption" CURVE 0xFC1AE4 GklWU16 0.9999847 fak_uw_b1 0.00 0.9999847 FORMAT "%9.7"
 /begin AXIS_DESCR COM_AXIS nmot_w nmot_uw_q0p25 4 0.00 16383.75 FORMAT "%8.2" AXIS_PTS_REF SNM04DMUW1 /end AXIS_DESCR
/end CHARACTERISTIC
/begin CHARACTERISTIC SLFOFU2N "untere Schwelle (Schwellwert-KL) f¸r Lernfilterwert bei fuel-off Adaption" CURVE 0xFC1AEC GklWU16 0.9999847 fak_uw_b1 0.00 0.9999847 FORMAT "%9.7"
 /begin AXIS_DESCR COM_AXIS nmot_w nmot_uw_q0p25 4 0.00 16383.75 FORMAT "%8.2" AXIS_PTS_REF SNM04DMUW2 /end AXIS_DESCR
/end CHARACTERISTIC
/begin CHARACTERISTIC SLFOO1N "Obere Schwelle (Schwellwert-KL) f¸r Lernfilterwert bei fuel-on/-off Adaption" CURVE 0xFC1BD2 GklWU16 181.8962 luquant_w 0.00 181.8962 FORMAT "%8.4"
 /begin AXIS_DESCR COM_AXIS nmot_w nmot_uw_q0p25 8 0.00 16383.75 FORMAT "%8.2" AXIS_PTS_REF SNM08DMUW1 /end AXIS_DESCR
/end CHARACTERISTIC
/begin CHARACTERISTIC SLFOO2N "Obere Schwelle (Schwellwert-KL) f¸r Lernfilterwert bei fuel-on/-off Adaption" CURVE 0xFC1BE2 GklWU16 181.8962 luquant_w 0.00 181.8962 FORMAT "%8.4"
 /begin AXIS_DESCR COM_AXIS nmot_w nmot_uw_q0p25 8 0.00 16383.75 FORMAT "%8.2" AXIS_PTS_REF SNM08DMUW2 /end AXIS_DESCR
/end CHARACTERISTIC
/begin CHARACTERISTIC SLFOU1N "Untere Schwelle (Schwellwert-KL) f¸r Lernfilterwert bei fuel-on/-off Adaption" CURVE 0xFC1BF2 GklWU16 181.8962 luquant_w 0.00 181.8962 FORMAT "%8.4"
 /begin AXIS_DESCR COM_AXIS nmot_w nmot_uw_q0p25 8 0.00 16383.75 FORMAT "%8.2" AXIS_PTS_REF SNM08DMUW1 /end AXIS_DESCR
/end CHARACTERISTIC
/begin CHARACTERISTIC SLFOU2N "Untere Schwelle (Schwellwert-KL) f¸r Lernfilterwert bei fuel-on/-off Adaption" CURVE 0xFC1C02 GklWU16 181.8962 luquant_w 0.00 181.8962 FORMAT "%8.4"
 /begin AXIS_DESCR COM_AXIS nmot_w nmot_uw_q0p25 8 0.00 16383.75 FORMAT "%8.2" AXIS_PTS_REF SNM08DMUW2 /end AXIS_DESCR
/end CHARACTERISTIC
/begin AXIS_PTS SML05DKUB "St¸tzstellenvert. Luftmasse" 0xFC0F80 ml SstAUbSstUb 1020. m_ub_b1020 5 0.00 1020. FORMAT "%5.0" DEPOSIT ABSOLUTE /end AXIS_PTS
/begin CHARACTERISTIC SMLDYN "Luftmassenschwelle f¸r Sondendynamik hinter KAT" VALUE 0xFCCCAE KwUw 182.0417 m_q0p00277 0.00 182.0417 FORMAT "%8.4" /end CHARACTERISTIC
/begin AXIS_PTS SNM04DMUW1 "Drehzahlst¸tzstellen" 0xFC0EDE nmot_w SstAU8SstU16 16383.75 nmot_uw_q0p25 4 0.00 16383.75 FORMAT "%8.2" DEPOSIT ABSOLUTE /end AXIS_PTS
/begin AXIS_PTS SNM04DMUW2 "Drehzahlst¸tzstellen" 0xFC0EE8 nmot_w SstAU8SstU16 16383.75 nmot_uw_q0p25 4 0.00 16383.75 FORMAT "%8.2" DEPOSIT ABSOLUTE /end AXIS_PTS
/begin AXIS_PTS SNM05DKUB "St¸tzstellenvert. nmot" 0xFC0FA0 nmot SstAUbSstUb 10200. nmot_ub_q40 5 0.00 10200. FORMAT "%5.0" DEPOSIT ABSOLUTE /end AXIS_PTS
/begin AXIS_PTS SNM06DMUW1 "Genzen der Drehzahlbereiche" 0xFC1B50 nmot_w SstAU8SstU16 16383.75 nmot_uw_q0p25 6 0.00 16383.75 FORMAT "%8.2" DEPOSIT ABSOLUTE /end AXIS_PTS
/begin AXIS_PTS SNM06DMUW2 "Genzen der Drehzahlbereiche" 0xFC1B5E nmot_w SstAU8SstU16 16383.75 nmot_uw_q0p25 6 0.00 16383.75 FORMAT "%8.2" DEPOSIT ABSOLUTE /end AXIS_PTS
/begin AXIS_PTS SNM08DMUB "SST-Verteilung in DMD, 8 Drehzahl-SST" 0xFC0FB8 nmot SstAUbSstUb 10200. nmot_ub_q40 8 0.00 10200. FORMAT "%5.0" DEPOSIT ABSOLUTE /end AXIS_PTS
/begin AXIS_PTS SNM08DMUW1 "St¸tzstellen KF Fuel-on-Adaption" 0xFC0EF2 nmot_w SstAU8SstU16 16383.75 nmot_uw_q0p25 8 0.00 16383.75 FORMAT "%8.2" DEPOSIT ABSOLUTE /end AXIS_PTS
/begin AXIS_PTS SNM08DMUW2 "St¸tzstellen KF Fuel-on-Adaption" 0xFC0F04 nmot_w SstAU8SstU16 16383.75 nmot_uw_q0p25 8 0.00 16383.75 FORMAT "%8.2" DEPOSIT ABSOLUTE /end AXIS_PTS
/begin AXIS_PTS SNM10DMUW1 "Bereichsgrenzen KF Fuel-on-Adaption" 0xFC1CEC nmot_w SstAU8SstU16 16383.75 nmot_uw_q0p25 10 0.00 16383.75 FORMAT "%8.2" DEPOSIT ABSOLUTE /end AXIS_PTS
/begin AXIS_PTS SNM10DMUW2 "Bereichsgrenzen KF Fuel-on-Adaption" 0xFC1D02 nmot_w SstAU8SstU16 16383.75 nmot_uw_q0p25 10 0.00 16383.75 FORMAT "%8.2" DEPOSIT ABSOLUTE /end AXIS_PTS
/begin AXIS_PTS SRL05DMUB1 "Bereichsgrenzen KF Fuel-on-Adaption" 0xFC1D18 rl SstAU8SstU8 191.3 rel_ub_q0p75 5 0.00 191.3 FORMAT "%5.1" DEPOSIT ABSOLUTE /end AXIS_PTS
/begin AXIS_PTS SRL05DMUB2 "Bereichsgrenzen KF Fuel-on-Adaption" 0xFC1D20 rl SstAU8SstU8 191.3 rel_ub_q0p75 5 0.00 191.3 FORMAT "%5.1" DEPOSIT ABSOLUTE /end AXIS_PTS
/begin AXIS_PTS SRL08DMUB "SST-Verteilung in DMD, 8 Last-SST" 0xFC1098 rl SstAUbSstUb 191.3 rel_ub_q0p75 8 0.00 191.3 FORMAT "%5.1" DEPOSIT ABSOLUTE /end AXIS_PTS
/begin AXIS_PTS STM08DMUB "8 Motortemperaturst¸tzstellen f¸r DMD" 0xFCC8DC tmot SstAUbSstUb 191.3 temp_ub_q0p75_o48 8 -48.00 143.3 FORMAT "%5.1" DEPOSIT ABSOLUTE /end AXIS_PTS
/begin CHARACTERISTIC TABGMCSD "Abgastemperaturschwelle f¸r CSD-Messung" VALUE 0xFC1ED6 KwUb 1275. temp_ub_q5_o50 -50.00 1225. FORMAT "%5.0" /end CHARACTERISTIC
/begin CHARACTERISTIC TABGSTG "Abgastemperaturschwelle f¸r Dynamik-Messung" VALUE 0xFCCC82 KwUb 1275. temp_ub_q5_o50 -50.00 1225. FORMAT "%5.0" /end CHARACTERISTIC
/begin CHARACTERISTIC TADLLR "Ansauglufttemperaturschwelle f¸r Diagnose Leerlaufsteller" VALUE 0xFCF253 KwUb 191.3 temp_ub_q0p75_o48 -48.00 143.3 FORMAT "%5.1" /end CHARACTERISTIC
/begin CHARACTERISTIC TASIG "Zeit f¸r Ausblendung von Stˆrspitzen auﬂerhalb Band f¸r Erk. Signalunterbrechung" VALUE 0xFC1ED7 KwUb 5.100 t20msxs_ub_b5p1 0.00 5.100 FORMAT "%5.3" /end CHARACTERISTIC
/begin CHARACTERISTIC TDKATAKT "Schwellwert Zyklus fertig wenn aktive ‹berwachungszeit > TDKATAKT" VALUE 0xFC1EB8 KwUw 3276.750 t50msxs_uw_b3276p75 0.00 3276.750 FORMAT "%8.3" /end CHARACTERISTIC
/begin CHARACTERISTIC TDKATATT "Schwellwert Zyklus fertig f¸r Funktionsanforderung" VALUE 0xFC1EBA KwUw 3276.750 t50msxs_uw_b3276p75 0.00 3276.750 FORMAT "%8.3" /end CHARACTERISTIC
/begin CHARACTERISTIC TDKUPNOG "Verzˆgerungszeit nach Gangwechsel bis erneute Gangwechselerk. mˆglich" VALUE 0xFCCD60 KwUb 255.0 t1sxs_ub_b255 0.00 255.0 FORMAT "%5.1" /end CHARACTERISTIC
/begin CHARACTERISTIC TDLLR "Wartezeit bis setzen der Bedingung Diagnose Leerlaufsteller" VALUE 0xFCF256 KwUw 255.0000 t200msxs_ub_b51 0.00 255.0000 FORMAT "%8.4" /end CHARACTERISTIC
/begin CHARACTERISTIC TDLLRMN "Wartezeit bis Fehlereintrag Steller geschlossen" VALUE 0xFCF258 KwUw 255.0000 t200msxs_ub_b51 0.00 255.0000 FORMAT "%8.4" /end CHARACTERISTIC
/begin CHARACTERISTIC TDLLRMX "Wartezeit bis Fehlereintrag Steller offen" VALUE 0xFCF25A KwUw 255.0000 t200msxs_ub_b51 0.00 255.0000 FORMAT "%8.4" /end CHARACTERISTIC
/begin CHARACTERISTIC TDLLRNF "Wartezeit bis Meldung kein Fehler bei Leerlaufsteller" VALUE 0xFCF25C KwUw 255.0000 t200msxs_ub_b51 0.00 255.0000 FORMAT "%8.4" /end CHARACTERISTIC
/begin CHARACTERISTIC TFDLLRO "Obere Schwelle f¸r Zeitfenster f¸r DLLR" VALUE 0xFCF25E KwUw 6553.500 t100msxs_uw_b6553p5 0.00 6553.500 FORMAT "%8.3" /end CHARACTERISTIC
/begin CHARACTERISTIC TFDLLRU "Untere Schwelle f¸r Zeitfenster f¸r DLLR" VALUE 0xFCF260 KwUw 6553.500 t100msxs_uw_b6553p5 0.00 6553.500 FORMAT "%8.3" /end CHARACTERISTIC
/begin CHARACTERISTIC TFRA "Erkennungszeit f¸r eingeschwungene Grundadaption von fra" VALUE 0xFCD7C9 KwUb 51.00 t200msxs_ub_b51 0.00 51.00 FORMAT "%5.2" /end CHARACTERISTIC
/begin CHARACTERISTIC TFRAOZ "Verweilzeit in FRAO f¸r Zyklusflag bei nicht eingeschw. Adaption" VALUE 0xFCD7CA KwUb 51.00 t200msxs_ub_b51 0.00 51.00 FORMAT "%5.2" /end CHARACTERISTIC
/begin CHARACTERISTIC TFRAUZ "Verweilzeit in FRAU f¸r Zyklusflag bei nicht eingeschw. Adaption" VALUE 0xFCD7CB KwUb 51.00 t200msxs_ub_b51 0.00 51.00 FORMAT "%5.2" /end CHARACTERISTIC
/begin CHARACTERISTIC TFRMB "Verzˆg.zeit f¸r Erkennung Mittelwert des Lambdareglers innerhalb Schwellen" VALUE 0xFCCC83 KwUb 25.50 t100msxs_ub_b25p5 0.00 25.50 FORMAT "%5.2" /end CHARACTERISTIC
/begin CHARACTERISTIC TFRMST "Erkennungszeit f¸r eingeschwungene Grundadaption von frm" VALUE 0xFCD7CC KwUb 51.00 t200msxs_ub_b51 0.00 51.00 FORMAT "%5.2" /end CHARACTERISTIC
/begin CHARACTERISTIC TFRMZST "Verweilzeit f¸r unplausibles frm-Signal (Kurztest)" VALUE 0xFCD7CD KwUb 51.00 t200msxs_ub_b51 0.00 51.00 FORMAT "%5.2" /end CHARACTERISTIC
/begin CHARACTERISTIC TKATMSHU "Kat-Temperatur f¸r ausreichende Sondenheizung" VALUE 0xFCCCBE KwUb 1275. temp_ub_q5_o50 -50.00 1225. FORMAT "%5.0" /end CHARACTERISTIC
/begin CHARACTERISTIC TKTPVK "Abgastemperatur Kat (aus ATM) f¸r TP-‹berwachung Sonde vor Kat" VALUE 0xFC1EC6 KwUb 1275. temp_ub_q5_o50 -50.00 1225. FORMAT "%5.0" /end CHARACTERISTIC
/begin CHARACTERISTIC TKTVHK "Kat-Modelltemperatur f¸r Schwingungspr¸fung SHK" VALUE 0xFC1EC7 KwUb 1275. temp_ub_q5_o50 -50.00 1225. FORMAT "%5.0" /end CHARACTERISTIC
/begin CHARACTERISTIC TKWPWMDMN "Minimales Tastverh‰ltnis Ansteuerung Kennfeldthermostat Endst.Diag." VALUE 0xFC2034 KwWS16 3376.800 fak_q0p1 -3276.800 100.0000 FORMAT "%8.3" /end CHARACTERISTIC
/begin CHARACTERISTIC TKWPWMDMX "Maximales Tastverh‰ltnis Ansteuerung Kennfeldthermostat Endst.Diag." VALUE 0xFC2036 KwWS16 3376.800 fak_q0p1 -3276.800 100.0000 FORMAT "%8.3" /end CHARACTERISTIC
/begin CHARACTERISTIC TLLASH "Verzˆg.zeit um lamlash_w zu sperren wenn lamsons_w ungleich lamlash_w ist" VALUE 0xFCCC84 KwUb 25.50 t100msxs_ub_b25p5 0.00 25.50 FORMAT "%5.2" /end CHARACTERISTIC
/begin CHARACTERISTIC TMASO "Zeit nach Schub f¸r gemeinsame Sondenmasse offen" VALUE 0xFCCCF6 KwUb 25.50 t100msxs_ub_b25p5 0.00 25.50 FORMAT "%5.2" /end CHARACTERISTIC
/begin CHARACTERISTIC TMDLLR "Motortemperaturschwelle f¸r Diagnose Leerlaufsteller" VALUE 0xFCF254 KwUb 191.3 temp_ub_q0p75_o48 -48.00 143.3 FORMAT "%5.1" /end CHARACTERISTIC
/begin CHARACTERISTIC TMFRST "Einschalttemperatur LR- Kurztest" VALUE 0xFCD7CE KwUb 191.3 temp_ub_q0p75_o48 -48.00 143.3 FORMAT "%5.1" /end CHARACTERISTIC
/begin CHARACTERISTIC TMINKAT "Minimale Kat-Temperatur f¸r ‹berwachung" VALUE 0xFC1EA2 KwUb 1275. temp_ub_q5_o50 -50.00 1225. FORMAT "%5.0" /end CHARACTERISTIC
/begin CHARACTERISTIC TMNEB "Motortemperaturschwelle f¸r Messung Nebenschluﬂ Sonde vor KAT" VALUE 0xFCCCF7 KwUb 191.3 temp_ub_q0p75_o48 -48.00 143.3 FORMAT "%5.1" /end CHARACTERISTIC
/begin CHARACTERISTIC TMNKATT "Minimale Kat-Temperatur f¸r ‹berwachung bei Testerbetrieb" VALUE 0xFC1EA3 KwUb 1275. temp_ub_q5_o50 -50.00 1225. FORMAT "%5.0" /end CHARACTERISTIC
/begin CHARACTERISTIC TMSH "Motortemperaturschwelle f¸r Erkennung Kaltstart f¸r Messung Sonde hinter KAT" VALUE 0xFCCCBF KwUb 191.3 temp_ub_q0p75_o48 -48.00 143.3 FORMAT "%5.1" /end CHARACTERISTIC
/begin CHARACTERISTIC TMSHA "Motorabstelltemperaturschwelle f¸r Messung Abk¸hlung Sonde hinter KAT" VALUE 0xFCCCC0 KwUb 191.3 temp_ub_q0p75_o48 -48.00 143.3 FORMAT "%5.1" /end CHARACTERISTIC
/begin CHARACTERISTIC TMSV "Motortemperaturschwelle f¸r Erkennung Kaltstart f¸r Messung Sonde vor KAT" VALUE 0xFCCCF8 KwUb 191.3 temp_ub_q0p75_o48 -48.00 143.3 FORMAT "%5.1" /end CHARACTERISTIC
/begin CHARACTERISTIC TMSVA "Motorabstelltemperaturschwelle f¸r Messung Abk¸hlung Sonde vor KAT" VALUE 0xFCCCF9 KwUb 191.3 temp_ub_q0p75_o48 -48.00 143.3 FORMAT "%5.1" /end CHARACTERISTIC
/begin CHARACTERISTIC TNALU "Testphasenl‰nge nach erkanntem Aussetzer" VALUE 0xFC13B5 KwWU8 255.0 dez 0.00 255.0 FORMAT "%5.1" /end CHARACTERISTIC
/begin CHARACTERISTIC TNSTDN "Zeit nach Start f¸r Diagnose Fehler Nebenschluﬂ (Monoflop)" VALUE 0xFC1EE4 KwUb 5.100 t20msxs_ub_b5p1 0.00 5.100 FORMAT "%5.3" /end CHARACTERISTIC
/begin CHARACTERISTIC TNSTDNH "Zeit nach Start f¸r Diagnose Adernschluﬂ (Monoflop)" VALUE 0xFC1ED8 KwUb 5.100 t20msxs_ub_b5p1 0.00 5.100 FORMAT "%5.3" /end CHARACTERISTIC
/begin CHARACTERISTIC TPSVKMN "minimale Periodendauer der Lambdasonde vor Kat, DLSSA" VALUE 0xFCCCDF KwUb 10.20 t40msxs_ub_q0p04 0.00 10.20 FORMAT "%5.2" /end CHARACTERISTIC
/begin CHARACTERISTIC TPSVKMX "maximale Periodendauer der Lambdasonde vor Kat, DLSSA" VALUE 0xFCCCE0 KwUb 10.20 t40msxs_ub_q0p04 0.00 10.20 FORMAT "%5.2" /end CHARACTERISTIC
/begin CHARACTERISTIC TRIPFASH "Mindest Zeitdauer f¸r aktive Lamda Regelung vor KAT" VALUE 0xFCCCB0 KwUw 6553.500 t100msxs_uw_b6553p5 0.00 6553.500 FORMAT "%8.3" /end CHARACTERISTIC
/begin CHARACTERISTIC TRKA "Erkennungszeit f¸r eingeschwungene Grundadaption von rkat bzw. rkaz" VALUE 0xFCD7CF KwUb 51.00 t200msxs_ub_b51 0.00 51.00 FORMAT "%5.2" /end CHARACTERISTIC
/begin CHARACTERISTIC TRKATZ "Aktivierungszeit von rkat bis Setzen Zyklusflag, wenn B_gae = FALSE" VALUE 0xFCD7D0 KwUb 51.00 t200msxs_ub_b51 0.00 51.00 FORMAT "%5.2" /end CHARACTERISTIC
/begin CHARACTERISTIC TRKAZZ "Aktivierungszeit von rkaz bis Setzen Zyklusflag, wenn B_gae = FALSE" VALUE 0xFCD7D1 KwUb 51.00 t200msxs_ub_b51 0.00 51.00 FORMAT "%5.2" /end CHARACTERISTIC
/begin CHARACTERISTIC TRSA "‹berwachungszeit Regelung (vor KAT)-> Sonde Aus" VALUE 0xFCCCFA KwUb 25.50 t100msxs_ub_b25p5 0.00 25.50 FORMAT "%5.2" /end CHARACTERISTIC
/begin CHARACTERISTIC TRSAFA "‹berwachungszeit Kabelbruch hinter KAT: Funktions Anforderung f¸r Kurz-Trip-Test" VALUE 0xFCCCCE KwUw 6553.500 t100msxs_uw_q100 0.00 6553.500 FORMAT "%8.3" /end CHARACTERISTIC
/begin CHARACTERISTIC TRSAH "‹berwachungszeit f¸r Kabelbruch (Spg. im Band) f¸r Sonde hinter KAT" VALUE 0xFCCCD0 KwUw 6553.500 t100msxs_uw_q100 0.00 6553.500 FORMAT "%8.3" /end CHARACTERISTIC
/begin CHARACTERISTIC TRSE "‹berwachungszeit -> Regelung ein" VALUE 0xFCCCC1 KwUb 25.50 t100msxs_ub_b25p5 0.00 25.50 FORMAT "%5.2" /end CHARACTERISTIC
/begin CHARACTERISTIC TSALASH "Zeit nach Schub f¸r ‹berpr¸fung Sonde hinter KAT" VALUE 0xFCCC85 KwUb 25.50 t100msxs_ub_b25p5 0.00 25.50 FORMAT "%5.2" /end CHARACTERISTIC
/begin CHARACTERISTIC TSTEAA "Sperrzeit nach B_te (TEA aktiv)" VALUE 0xFCCC79 KwUb 25.50 t100msxs_ub_b25p5 0.00 25.50 FORMAT "%5.2" /end CHARACTERISTIC
/begin CHARACTERISTIC TSVKKO "sch‰rfere obere Periodendauergrenze f¸r Lambdasonde vor Kat" VALUE 0xFC1ECA KwUw 655.3500 t10msxs_uw_b655p35 0.00 655.3500 FORMAT "%8.4" /end CHARACTERISTIC
/begin CHARACTERISTIC TSVKKTO "obere Periodendauergrenze f¸r SVK, Kurztest" VALUE 0xFC1ECC KwUw 655.3500 t10msxs_uw_b655p35 0.00 655.3500 FORMAT "%8.4" /end CHARACTERISTIC
/begin CHARACTERISTIC TSVKKTU "untere Periodendauergrenze f¸r SVK, Kurztest" VALUE 0xFC1ECE KwUw 655.3500 t10msxs_uw_b655p35 0.00 655.3500 FORMAT "%8.4" /end CHARACTERISTIC
/begin CHARACTERISTIC TSVKKU "sch‰rfere untere Periodendauergrenze f¸r Lambdasonde vor Kat" VALUE 0xFC1ED0 KwUw 655.3500 t10msxs_uw_b655p35 0.00 655.3500 FORMAT "%8.4" /end CHARACTERISTIC
/begin CHARACTERISTIC TSVKO "obere Periodendauergrenze f¸r die Lambda-Sonde vor Katalysator" VALUE 0xFC1ED2 KwUw 655.3500 t10msxs_uw_b655p35 0.00 655.3500 FORMAT "%8.4" /end CHARACTERISTIC
/begin CHARACTERISTIC TSVKU "untere Periodengrenze f¸r Lambda-Sonde vor Katalysator" VALUE 0xFC1ED4 KwUw 655.3500 t10msxs_uw_b655p35 0.00 655.3500 FORMAT "%8.4" /end CHARACTERISTIC
/begin CHARACTERISTIC TTBMH "Zeit f¸r theoretische Sondenbetriebsbereitschaft mit Heizung" VALUE 0xFCCCD2 KwUw 6553.500 t100msxs_uw_q100 0.00 6553.500 FORMAT "%8.3" /end CHARACTERISTIC
/begin CHARACTERISTIC TTLASH "Zeit f¸r Verweildauer der Sonde hinter KAT unter/oberhalb des Sollwertes" VALUE 0xFCCCB2 KwUw 6553.500 t100msxs_uw_b6553p5 0.00 6553.500 FORMAT "%8.3" /end CHARACTERISTIC
/begin CHARACTERISTIC TUSCHUB "Verzˆgerungszeit f¸r Stˆrspitzen bei Schubpr¸fung der Sonde hinter KAT" VALUE 0xFCCC86 KwUb 25.50 t100msxs_ub_b25p5 0.00 25.50 FORMAT "%5.2" /end CHARACTERISTIC
/begin CHARACTERISTIC TUSDU "Verzˆg.zeit f¸r Erkennung Adernschluﬂ und Sonde mit begr. Spannungshub v.K." VALUE 0xFCCD00 KwUw 6553.500 t100msxs_uw_q100 0.00 6553.500 FORMAT "%8.3" /end CHARACTERISTIC
/begin CHARACTERISTIC TUSDUC "Verzˆgerungszeit Code f¸r Erkennung Adernschluﬂ Sonde vor KAT" VALUE 0xFCCD02 KwUw 6553.500 t100msxs_uw_q100 0.00 6553.500 FORMAT "%8.3" /end CHARACTERISTIC
/begin CHARACTERISTIC TUSDUFA "Verzˆgerunszeit f¸r Erk. Adernschl. Lamdasonde h.KAT (Funkt. Anford. Kurz-Trip)" VALUE 0xFCCCD4 KwUw 6553.500 t100msxs_uw_q100 0.00 6553.500 FORMAT "%8.3" /end CHARACTERISTIC
/begin CHARACTERISTIC TUSDUH "Verzˆgerungszeit f¸r Erkennung Adernschluﬂ Lambdasonde hinter KAT" VALUE 0xFCCCD6 KwUw 6553.500 t100msxs_uw_q100 0.00 6553.500 FORMAT "%8.3" /end CHARACTERISTIC
/begin CHARACTERISTIC TUSEINH "Verzˆgerungzeit f¸r Einschalten der Sondenbetriebsbereitschaft hinter KAT" VALUE 0xFCCCC2 KwUb 255.0 t1sxs_ub_b255 0.00 255.0 FORMAT "%5.1" /end CHARACTERISTIC
/begin CHARACTERISTIC TUSEINV "Verzˆgerungzeit f¸r Einschalten der Sondenbetriebsbereitschaft vor KAT" VALUE 0xFCCCFB KwUb 255.0 t1sxs_ub_b255 0.00 255.0 FORMAT "%5.1" /end CHARACTERISTIC
/begin CHARACTERISTIC TUSENLASH "Zeitdauer bis Sonden Mager/Fett Erkennung erlaubt hinter Kat" VALUE 0xFCCCB4 KwUw 6553.500 t100msxs_uw_b6553p5 0.00 6553.500 FORMAT "%8.3" /end CHARACTERISTIC
/begin CHARACTERISTIC TUSFETT "Verzˆg.zeit f¸r Erkennung niederohmiger Nebenschluﬂ nach Ubatt vor KAT" VALUE 0xFCCD04 KwUw 6553.500 t100msxs_uw_q100 0.00 6553.500 FORMAT "%8.3" /end CHARACTERISTIC
/begin CHARACTERISTIC TUSHKRFM "Zeitdauer bis zur Freig. Wiederholungsmess. Schwingungspr. (Reset F/M-Flip-Flop)" VALUE 0xFCCCB6 KwUw 6553.500 t100msxs_uw_b6553p5 0.00 6553.500 FORMAT "%8.3" /end CHARACTERISTIC
/begin CHARACTERISTIC TUSHKVL "Verzˆgerungszeit f¸r Stˆrspitzen bei Vollastpr¸fung der Sonde hinter KAT" VALUE 0xFCCC87 KwUb 25.50 t100msxs_ub_b25p5 0.00 25.50 FORMAT "%5.2" /end CHARACTERISTIC
/begin CHARACTERISTIC TUSHSMIN "Mindestdauer f¸r Steigungsmessung f¸r enable Filter hinter Kat" VALUE 0xFCCC88 KwUb 25.50 t100msxs_ub_b25p5 0.00 25.50 FORMAT "%5.2" /end CHARACTERISTIC
/begin CHARACTERISTIC TUSKS "Entstˆrzeit f¸r Abschalten einzelner Funktionen Sonde hinter KAT" VALUE 0xFC1ED9 KwUb 5.100 t20msxs_ub_b5p1 0.00 5.100 FORMAT "%5.3" /end CHARACTERISTIC
/begin CHARACTERISTIC TUSLASH "Testzeit f¸t Dauer Anfettung/Abmagerung hinter KAT" VALUE 0xFCCCB8 KwUw 6553.500 t100msxs_uw_b6553p5 0.00 6553.500 FORMAT "%8.3" /end CHARACTERISTIC
/begin CHARACTERISTIC TUSMAX "‹berwachungszeit f¸r Usmax" VALUE 0xFCCCC3 KwUb 25.50 t100msxs_ub_b25p5 0.00 25.50 FORMAT "%5.2" /end CHARACTERISTIC
/begin CHARACTERISTIC TUSMSVL "Zeit nach Vollast f¸r ‹berpr¸fung Sonde hinter KAT" VALUE 0xFCCC89 KwUb 25.50 t100msxs_ub_b25p5 0.00 25.50 FORMAT "%5.2" /end CHARACTERISTIC
/begin CHARACTERISTIC TUSPNMN "min. Zeit der Sondenspannung zwischen pos. und neg. Flanke" VALUE 0xFCCCE1 KwUb 10.20 t40msxs_ub_q0p04 0.00 10.20 FORMAT "%5.2" /end CHARACTERISTIC
/begin CHARACTERISTIC TUSPNMX "max. Zeit der Sondenspannung zwischen pos. und neg. Flanke" VALUE 0xFCCCE2 KwUb 10.20 t40msxs_ub_q0p04 0.00 10.20 FORMAT "%5.2" /end CHARACTERISTIC
/begin CHARACTERISTIC TUSSA "Verzˆgerungszeit nach ‹ber/Unterschreiten der Regelschwelle hinter KAT" VALUE 0xFCCC8A KwUb 25.50 t100msxs_ub_b25p5 0.00 25.50 FORMAT "%5.2" /end CHARACTERISTIC
/begin CHARACTERISTIC TUSTAL "Verzˆg.zeit f¸r Erkennung Adernschluﬂ nach ""Tank leer"" fahren f¸r Sonde h. KAT" VALUE 0xFCCCD8 KwUw 6553.500 t100msxs_uw_q100 0.00 6553.500 FORMAT "%8.3" /end CHARACTERISTIC
/begin CHARACTERISTIC TUSTALLASH "Verzˆg.zeit f¸r Erkennung B_maxlash nach ""Tank leer"" fahren f¸r Sonde h. KAT" VALUE 0xFCCCBA KwUw 6553.500 t100msxs_uw_b6553p5 0.00 6553.500 FORMAT "%8.3" /end CHARACTERISTIC
/begin CHARACTERISTIC TVLRHMN "untere Grenze f¸r tv-Korrektur" VALUE 0xFCCC7A KwSb 2.550 t100msxs_sb_q0p01 -1.280 1.270 FORMAT "%5.3" /end CHARACTERISTIC
/begin CHARACTERISTIC TVLRHMN2 "untere Grenze f¸r tv-Korrektur ungleiche Parameter Bank2" VALUE 0xFCCC7B KwSb 2.550 t100msxs_sb_q0p01 -1.280 1.270 FORMAT "%5.3" /end CHARACTERISTIC
/begin CHARACTERISTIC TVLRHMX "obere Grenze f¸r tv-Korrektur" VALUE 0xFCCC7C KwSb 2.550 t100msxs_sb_q0p01 -1.280 1.270 FORMAT "%5.3" /end CHARACTERISTIC
/begin CHARACTERISTIC TVLRHMX2 "obere Grenze f¸r tv-Korrektur ungleiche Parameter Bank2" VALUE 0xFCCC7D KwSb 2.550 t100msxs_sb_q0p01 -1.280 1.270 FORMAT "%5.3" /end CHARACTERISTIC
/begin CHARACTERISTIC TWDDTV "Wartezeit f¸r Ready-Flag der Delta-TV Diagnose (DLSA)" VALUE 0xFCCC7E KwUw 65525.00 t1sxs_uw_b65535 10.00000 65535.00 FORMAT "%8.2" /end CHARACTERISTIC
/begin CHARACTERISTIC TWDKATST "Wartezeit nach Stoppbedingung f¸r Filter und Integrator" VALUE 0xFC1EA4 KwUb 12.75 t50msxs_ub_b12p75 0.00 12.75 FORMAT "%5.2" /end CHARACTERISTIC
/begin CHARACTERISTIC TWDLSSA "Mindestpr¸fzeit f¸r DLSSA-Extremwertbestimmung" VALUE 0xFCCCF4 KwUw 3276.750 t50msxs_uw_b3276p75 0.00 3276.750 FORMAT "%8.3" /end CHARACTERISTIC
/begin CHARACTERISTIC TWKTDLP "Wartezeit nach Parameterumschaltung in Lambdaregelung" VALUE 0xFC1EA5 KwUb 12.75 t50msxs_ub_b12p75 0.00 12.75 FORMAT "%5.2" /end CHARACTERISTIC
/begin CHARACTERISTIC UBDLS "Batteriespannungsschwelle zur Freigabe der Sonden-Diagnose" VALUE 0xFCCCC4 KwUb 24.02 spg_ubatt 0.00 24.02 FORMAT "%5.2" /end CHARACTERISTIC
/begin CHARACTERISTIC UDKRGOFS "Spannungsschwelle f¸r DIA/KR Grundoffset Verst‰rker" VALUE 0xFC6682 KwUb 4.980 spg_ub_b5 0.00 4.980 FORMAT "%5.3" /end CHARACTERISTIC
/begin CHARACTERISTIC UDKRTP "Integratorspannungsschwelle f¸r Dia KS - Auswerteschaltung Testimpuls" VALUE 0xFC669F KwUb 4.980 spg_ub_b5 0.00 4.980 FORMAT "%5.3" /end CHARACTERISTIC
/begin CHARACTERISTIC UDKSNO "Obere Referenzspannungsschwelle DIA KS" CURVE 0xFC65F8 KlAxU8SstxU16WU16 319.976 spg_uw_b1280 0.00 319.976 FORMAT "%7.3"
 /begin AXIS_DESCR STD_AXIS nmot nmot_ub_q40 16 0.00 10200. FORMAT "%5.0" DEPOSIT ABSOLUTE /end AXIS_DESCR
/end CHARACTERISTIC
/begin CHARACTERISTIC UDKSNU "untere Referenzspannungsschwelle DIA KS" CURVE 0xFC663A KlAxU8SstxU16WU16 319.976 spg_uw_b1280 0.00 319.976 FORMAT "%7.3"
 /begin AXIS_DESCR STD_AXIS nmot nmot_ub_q40 16 0.00 10200. FORMAT "%5.0" DEPOSIT ABSOLUTE /end AXIS_DESCR
/end CHARACTERISTIC
/begin CHARACTERISTIC USDBO "obere Schwelle f. Erk. Adernschluﬂ und defekte Sonde mit begrenztem Spannungshub" VALUE 0xFC1EE6 KwUw 319.9951 spg_uw_q0p00488_o1 -1.000000 318.9951 FORMAT "%8.4" /end CHARACTERISTIC
/begin CHARACTERISTIC USDBU "untere Schwelle f. Erk. Adernschluﬂ u. defekte Sonde mit begrenztem Spannungshub" VALUE 0xFC1EE8 KwUw 319.9951 spg_uw_q0p00488_o1 -1.000000 318.9951 FORMAT "%8.4" /end CHARACTERISTIC
/begin CHARACTERISTIC USFHK "Sondenspannungsschwelle f¸r Erkennung fett hinter Kat" VALUE 0xFC1EEA KwUw 319.9951 spg_uw_q0p00488_o1 -1.000000 318.9951 FORMAT "%8.4" /end CHARACTERISTIC
/begin CHARACTERISTIC USHKVL "Schwellwert f¸r Sondenspannung hinter KAT im Vollast-Betrieb" VALUE 0xFCCC8B KwUb 1.330 spg_ub_q0p0052_o0p2 -0.2000 1.130 FORMAT "%5.3" /end CHARACTERISTIC
/begin CHARACTERISTIC USHLEAN "Schwelle f¸r Magerspannung f¸r Reset Dynamikmessung der Sonde hinter KAT" VALUE 0xFCCC8C KwUb 1.330 spg_ub_q0p0052_o0p2 -0.2000 1.130 FORMAT "%5.3" /end CHARACTERISTIC
/begin CHARACTERISTIC USHRICH "Schwelle f¸r Fettspannung f¸r g¸ltige Dynamikmessung der Sonde hinter KAT" VALUE 0xFCCC8D KwUb 1.330 spg_ub_q0p0052_o0p2 -0.2000 1.130 FORMAT "%5.3" /end CHARACTERISTIC
/begin CHARACTERISTIC USHSTGMX "Wert f¸r maximale Steigung f¸r Startwert Filter" VALUE 0xFCCC8E KwUb 132.6 spgg_q0p52 0.00 132.6 FORMAT "%5.1" /end CHARACTERISTIC
/begin CHARACTERISTIC USHSTSOLL "Schwelle f¸r zul‰ssige Steigung der Sondenspannung hinter KAT" VALUE 0xFCCC8F KwUb 132.6 spgg_q0p52 0.00 132.6 FORMAT "%5.1" /end CHARACTERISTIC
/begin CHARACTERISTIC USIVMAXH "Init value f¸r max.Sondenspg. hinter Kat nach Powerfail u. Fehlersp. lˆschen" VALUE 0xFCCCE3 KwUb 1.330 spg_ub_b1p33 0.00 1.330 FORMAT "%5.3" /end CHARACTERISTIC
/begin CHARACTERISTIC USIVMAXV "Init value f¸r max. Sondenspg. vor Kat nach Powerfail u. Fehlersp. lˆschen" VALUE 0xFCCCE4 KwUb 1.330 spg_ub_b1p33 0.00 1.330 FORMAT "%5.3" /end CHARACTERISTIC
/begin CHARACTERISTIC USIVMINH "Init value f¸r min.Sondenspg. hinter Kat nach Powerfail u. Fehlersp. lˆschen" VALUE 0xFCCCE5 KwUb 1.330 spg_ub_b1p33 0.00 1.330 FORMAT "%5.3" /end CHARACTERISTIC
/begin CHARACTERISTIC USIVMINV "Init value f¸r min. Sondenspg. vor Kat nach Powerfail u. Fehlersp. lˆschen" VALUE 0xFCCCE6 KwUb 1.330 spg_ub_b1p33 0.00 1.330 FORMAT "%5.3" /end CHARACTERISTIC
/begin CHARACTERISTIC USMASO "Sondenspannungsschwelle f¸r gemeinsame Sondenmasse offen" VALUE 0xFC1EEC KwUw 319.9951 spg_uw_q0p00488_o1 -1.000000 318.9951 FORMAT "%8.4" /end CHARACTERISTIC
/begin CHARACTERISTIC USMAX "Schwelle f¸r Sondenkurzschluﬂ nach Ubat" VALUE 0xFC1EDA KwUw 319.9951 spg_uw_q0p00488_o1 -1.000000 318.9951 FORMAT "%8.4" /end CHARACTERISTIC
/begin CHARACTERISTIC USMHK "Sondenspannungsschwelle f¸r Erkennung mager hinter Kat" VALUE 0xFC1EEE KwUw 319.9951 spg_uw_q0p00488_o1 -1.000000 318.9951 FORMAT "%8.4" /end CHARACTERISTIC
/begin CHARACTERISTIC USMIN "Schwelle f¸r Sondenkurzschluﬂ nach Masse" VALUE 0xFC1EDC KwUw 319.9951 spg_uw_q0p00488_o1 -1.000000 318.9951 FORMAT "%8.4" /end CHARACTERISTIC
/begin CHARACTERISTIC USMNSAMN "min. erkannte Sondenspannung f¸r Signalausgabe (min. plaus. Wert)" VALUE 0xFCCCE7 KwUb 1.330 spg_ub_b1p33 0.00 1.330 FORMAT "%5.3" /end CHARACTERISTIC
/begin CHARACTERISTIC USMNSAMX "min. erkannte Sondenspannung f¸r Signalausgabe (max. plaus. Wert)" VALUE 0xFCCCE8 KwUb 1.330 spg_ub_b1p33 0.00 1.330 FORMAT "%5.3" /end CHARACTERISTIC
/begin CHARACTERISTIC USMNSHMN "min. erkannte Sondenspannung hinter Kat f¸r Signalausgabe (min. plaus. Wert)" VALUE 0xFCCCE9 KwUb 1.330 spg_ub_b1p33 0.00 1.330 FORMAT "%5.3" /end CHARACTERISTIC
/begin CHARACTERISTIC USMNSHMX "min. erkannte Sondenspannung hinter Kat f¸r Signalausgabe (max. plaus. Wert)" VALUE 0xFCCCEA KwUb 1.330 spg_ub_b1p33 0.00 1.330 FORMAT "%5.3" /end CHARACTERISTIC
/begin CHARACTERISTIC USMXSAMN "max. erkannte Sondenspannung f¸r Signalausgabe (min. plaus. Wert)" VALUE 0xFCCCEB KwUb 1.330 spg_ub_b1p33 0.00 1.330 FORMAT "%5.3" /end CHARACTERISTIC
/begin CHARACTERISTIC USMXSAMX "max. erkannte Sondenspannung f¸r Signalausgabe (max. plaus. Wert)" VALUE 0xFCCCEC KwUb 1.330 spg_ub_b1p33 0.00 1.330 FORMAT "%5.3" /end CHARACTERISTIC
/begin CHARACTERISTIC USMXSHMN "max. erkannte Sondenspannung hinter Kat f¸r Signalausgabe (min. plaus. Wert)" VALUE 0xFCCCED KwUb 1.330 spg_ub_b1p33 0.00 1.330 FORMAT "%5.3" /end CHARACTERISTIC
/begin CHARACTERISTIC USMXSHMX "max. erkannte Sondenspannung hinter Kat f¸r Signalausgabe (max. plaus. Wert)" VALUE 0xFCCCEE KwUb 1.330 spg_ub_b1p33 0.00 1.330 FORMAT "%5.3" /end CHARACTERISTIC
/begin CHARACTERISTIC USREF "Schwelle f¸r Sondenbetriebsbereitschaft bei fettem Gemisch (vor KAT)" VALUE 0xFC1EF0 KwUw 319.9951 spg_uw_q0p00488_o1 -1.000000 318.9951 FORMAT "%8.4" /end CHARACTERISTIC
/begin CHARACTERISTIC USREFH "Schwelle f¸r Sondenbetriebsbereitschaft hinter KAT bei fettem Gemisch" VALUE 0xFC1EDE KwUw 319.9951 spg_uw_q0p00488_o1 -1.000000 318.9951 FORMAT "%8.4" /end CHARACTERISTIC
/begin CHARACTERISTIC USREM "Schwelle f¸r Sondenbetriebsbereitschaft bei magerem Gemisch (vor KAT)" VALUE 0xFC1EF2 KwUw 319.9951 spg_uw_q0p00488_o1 -1.000000 318.9951 FORMAT "%8.4" /end CHARACTERISTIC
/begin CHARACTERISTIC USREMH "Schwelle f¸r Sondenbetriebsbereitschaft hinter KAT bei magerem Gemisch" VALUE 0xFC1EE0 KwUw 319.9951 spg_uw_q0p00488_o1 -1.000000 318.9951 FORMAT "%8.4" /end CHARACTERISTIC
/begin CHARACTERISTIC USRHKSHJ "Regelschwelle f¸r Regelung hinter Kat, DLSSA-Ausgabe umgerechn. Wert" VALUE 0xFCCCEF KwUb 1.330 spg_ub_b1p33 0.00 1.330 FORMAT "%5.3" /end CHARACTERISTIC
/begin CHARACTERISTIC USRJ "" VALUE 0xFCCCF0 KwUb 1.330 spg_ub_b1p33 0.00 1.330 FORMAT "%5.3" /end CHARACTERISTIC
/begin CHARACTERISTIC USSCHUB "Schwelle f¸r Sondenspannung hinter KAT nach Schub" VALUE 0xFCCC90 KwUb 1.330 spg_ub_q0p0052_o0p2 -0.2000 1.130 FORMAT "%5.3" /end CHARACTERISTIC
/begin CHARACTERISTIC VDKUPPLMN "min. vfzg-Schwelle f¸r Diagnose Kupplungsschalter" VALUE 0xFCCD61 KwUb 318.8 vfzg_ub_q1p25 0.00 318.8 FORMAT "%5.1" /end CHARACTERISTIC
/begin CHARACTERISTIC ZDKATAD "Filterzeitkonstante der Differenzierer f¸r Signalamplitude" VALUE 0xFC1EA6 KwUb 12.7498 zk50msxs_ub_b12p8 0.0501961 12.8000 FORMAT "%7.4" /end CHARACTERISTIC
/begin CHARACTERISTIC ZDKATAF "Zeitkonstante Betrags-Filter f¸r Signalamplitude" VALUE 0xFC1EA7 KwUb 12.7498 zk50msxs_ub_b12p8 0.0501961 12.8000 FORMAT "%7.4" /end CHARACTERISTIC
/begin CHARACTERISTIC ZDKATSH "Zeitkonstante Tiefpaﬂ, Regellagendifferenz" VALUE 0xFC1EA8 KwUb 12.7498 zk50msxs_ub_b12p8 0.0501961 12.8000 FORMAT "%7.4" /end CHARACTERISTIC
/begin CHARACTERISTIC ZDKTBD "Zeitkonstante der Differenzierer f¸r FR-Wechselanteil" VALUE 0xFC1EA9 KwUb 12.7498 zk50msxs_ub_b12p8 0.0501961 12.8000 FORMAT "%7.4" /end CHARACTERISTIC
/begin CHARACTERISTIC ZDKTBF "Zeitkonstante f¸r Gasvermischungsvorgang vor Katalysator" VALUE 0xFC1EAA KwUb 12.7498 zk50msxs_ub_b12p8 0.0501961 12.8000 FORMAT "%7.4" /end CHARACTERISTIC
/begin CHARACTERISTIC ZFRMST "Zeitkonstante f¸r frm-Filter (short test)" VALUE 0xFCD7D2 KwUb 50.9992 zk200msxs_ub_b51p2 0.200784 51.2000 FORMAT "%7.4" /end CHARACTERISTIC
/begin CHARACTERISTIC ZFTSVK "Zeitkonstante f¸r Filter Periodendauer der Sonde vor Katalysator" VALUE 0xFC1EC8 KwUb 0.9961 fak_ub_b1 0.00 0.9961 /end CHARACTERISTIC
/begin CHARACTERISTIC ZKTDRL "Zeitkonstante Tiefpaﬂ, rl-Filterung" VALUE 0xFC1EAB KwUb 12.7498 zk50msxs_ub_b12p8 0.0501961 12.8000 FORMAT "%7.4" /end CHARACTERISTIC
/begin CHARACTERISTIC ZLUTSFI "Zeitkonstante f¸r Filterung Laufunruhe-Testgrˆﬂe" VALUE 0xFC1D28 KwWR32 2.000000000000E+037 fak_r32_1 -1.000000000000E+037 1.000000000000E+037 FORMAT "%43.4" /end CHARACTERISTIC
/begin MEASUREMENT ahkat "Mittelwert der Amplitude Sondensignal hinter Kat. korrigiert mit KB" UBYTE fak_ub_b1 1 100 0 0.996094 ECU_ADDRESS 0x5B8E4D /end MEASUREMENT
/begin MEASUREMENT ahkat2 "Mittelwert der Amplitude Sondensignal hinter Kat. korrigiert mit KB (2.Bank)" UBYTE fak_ub_b1 1 100 0 0.996094 ECU_ADDRESS 0x5B8E4E /end MEASUREMENT
/begin MEASUREMENT ahkatn "Amplitude Sondensignal hinter Katalysator normiert" UBYTE fak_ub_b1 1 100 0 0.996094 ECU_ADDRESS 0x5B8E4F /end MEASUREMENT
/begin MEASUREMENT ahkatn2 "Amplitude Sondensignal hinter Katalysator normiert (Stereo 2.Bank)" UBYTE fak_ub_b1 1 100 0 0.996094 ECU_ADDRESS 0x5B8E50 /end MEASUREMENT
/begin MEASUREMENT ahktki2_w "Amplitude Sondensignal hinter Kat. korrigiert und integiert" UWORD t50msxs_uw_b819p2 1 100 0 819.188 FORMAT "%8.4" ECU_ADDRESS 0x5B90B2 /end MEASUREMENT
/begin MEASUREMENT ahktki_w "Amplitude Sondensignal hinter Katalysator korrigiert und integiert" UWORD t50msxs_uw_b819p2 1 100 0 819.188 FORMAT "%8.4" ECU_ADDRESS 0x5B90B4 /end MEASUREMENT
/begin MEASUREMENT ahktnk "Korrigierte Sondensignal-Amplitude normiert" UBYTE fak_ub_b1 1 100 0 0.996094 ECU_ADDRESS 0x5B8E51 /end MEASUREMENT
/begin MEASUREMENT ahktnk2 "korrigierte Sondensignal-Amplitude normiert (Stereo 2.Bank)" UBYTE fak_ub_b1 1 100 0 0.996094 ECU_ADDRESS 0x5B8E52 /end MEASUREMENT
/begin MEASUREMENT akatbn "Amplitude der Katalysatorbelastungssignal" UBYTE fak_ub_b1 1 100 0 0.996094 ECU_ADDRESS 0x5B8E53 /end MEASUREMENT
/begin MEASUREMENT akatbn2 "Amplitude des Katalysatorbelastungssignals (Stereo 2.Bank)" UBYTE fak_ub_b1 1 100 0 0.996094 ECU_ADDRESS 0x5B8E54 /end MEASUREMENT
/begin MEASUREMENT anwfofs "z‰hlt Anzahl der NW-Umdr. von Bedingungen f¸r Adaption erf¸llt bis Lernbeginn" UWORD dez 1 100 0 65535 FORMAT "%8.2" ECU_ADDRESS 0x5B8574 /end MEASUREMENT
/begin MEASUREMENT anwfoh_w "z‰hlt Anzahl der NW-Umdr. f¸r Heilung der fuel-on/-off Adaption" UWORD dez 1 100 0 65535 FORMAT "%8.2" ECU_ADDRESS 0x5B953E /end MEASUREMENT
/begin MEASUREMENT anwfos_w "z‰hlt Anzahl der NW-Umdr. von Bedingungen f¸r Adaption erf¸llt bis Lernbeginn" UWORD dez 1 100 0 65535 FORMAT "%8.2" ECU_ADDRESS 0x5B9540 /end MEASUREMENT
/begin MEASUREMENT anwst "z‰hlt Anzahl der NW-Umdr. bei denen fuel-off Adaption nach Fertiglernen aktiv" UWORD dez 1 100 0 65535 FORMAT "%8.2" ECU_ADDRESS 0x5B8576 /end MEASUREMENT
/begin MEASUREMENT anzgangw "Anzahl erkannter Gangwechsel" UBYTE dez 1 100 0 255 FORMAT "%5.1" ECU_ADDRESS 0x5B8E76 /end MEASUREMENT
/begin MEASUREMENT anzkupplb "Anzahl erkannter Kupplungsbet‰tigungen" UBYTE dez 1 100 0 255 FORMAT "%5.1" ECU_ADDRESS 0x5B8E77 /end MEASUREMENT
/begin MEASUREMENT apedkt "Anzahl der Pr¸fungen mit Fehlerergebnis bei Katdiagnose" UBYTE dez 1 100 0 255 FORMAT "%5.1" ECU_ADDRESS 0x5B8E55 /end MEASUREMENT
/begin MEASUREMENT apedkt2 "Anzahl der Pr¸fungen mit Fehlerergebnis bei Katdiagnose (Bank2)" UBYTE dez 1 100 0 255 FORMAT "%5.1" ECU_ADDRESS 0x5B8E56 /end MEASUREMENT
/begin MEASUREMENT atvfett "atv-Verschiebung nach FETT, DLSSA" UBYTE t40msxs_ub_q0p04 1 100 0 10.2 FORMAT "%5.2" ECU_ADDRESS 0x5B8678 /end MEASUREMENT
/begin MEASUREMENT atvmager "atv-Verschiebung nach MAGER, DLSSA" UBYTE t40msxs_ub_q0p04 1 100 0 10.2 FORMAT "%5.2" ECU_ADDRESS 0x5B8679 /end MEASUREMENT
/begin MEASUREMENT avkatf "AmplitudenVerh‰ltnis laafh/laafv gefiltert" UBYTE fak_ub_b1 1 100 0 0.996094 ECU_ADDRESS 0x3FDBA9 /end MEASUREMENT
/begin MEASUREMENT avkatf2 "Amplitudenverh‰ltnis laafh/laafv gefiltert Bank2" UBYTE fak_ub_b1 1 100 0 0.996094 ECU_ADDRESS 0x3FDBAA /end MEASUREMENT
/begin MEASUREMENT B_abgstg "Bedingung Modelltemperatur (tkatm od. tanhkm_w) hinter KAT ist oberhalb Schwelle" UBYTE B_TRUE 1 100 0 1 BIT_MASK 0x1 FORMAT "%13.11" ECU_ADDRESS 0x5B8E68 /end MEASUREMENT
/begin MEASUREMENT B_acsdh "Bedingung f¸r Pr¸fung Adernschluﬂ und CSD hinter Kat" UBYTE B_TRUE 1 100 0 1 BIT_MASK 0x1 FORMAT "%13.11" ECU_ADDRESS 0x3FBCD3 /end MEASUREMENT
/begin MEASUREMENT B_adcsd "Bedingung f¸r Pr¸fung Adernschluﬂ und CSD" UBYTE B_TRUE 1 100 0 1 BIT_MASK 0x1 FORMAT "%13.11" ECU_ADDRESS 0x3FBCDA /end MEASUREMENT
/begin MEASUREMENT B_adcsd2 "Bedingung f¸r Pr¸fung Adernschluﬂ und CSD Bank2" UBYTE B_TRUE 1 100 0 1 BIT_MASK 0x1 FORMAT "%13.11" ECU_ADDRESS 0x3FBCDB /end MEASUREMENT
/begin MEASUREMENT B_adde "Bedingung Adernschluﬂ oder defekte Sonde mit begrenztem Spannungshub" UBYTE B_TRUE 1 100 0 1 BIT_MASK 0x1 FORMAT "%13.11" ECU_ADDRESS 0x3FBCDC /end MEASUREMENT
/begin MEASUREMENT B_adde2 "Bedingung Adernschluﬂ oder defekte Sonde mit begrenztem Spannungshub Bank2" UBYTE B_TRUE 1 100 0 1 BIT_MASK 0x1 FORMAT "%13.11" ECU_ADDRESS 0x3FBCDD /end MEASUREMENT
/begin MEASUREMENT B_adsh "Bedingung Adernschluﬂ bei Lambdasonden hinter Kat" UWORD B_TRUE 1 100 0 1 BIT_MASK 0x400 FORMAT "%13.11" ECU_ADDRESS 0x5B90CC /end MEASUREMENT
/begin MEASUREMENT B_adshs "Bedingung Adernschluﬂ ""setzen"" bei Lambdasonden hinter Kat" UWORD B_TRUE 1 100 0 1 BIT_MASK 0x40 FORMAT "%13.11" ECU_ADDRESS 0x5B90CC /end MEASUREMENT
/begin MEASUREMENT B_adsvb "Verbot Betriebsbereitschaft wegen Adernschluﬂ" UWORD B_TRUE 1 100 0 1 BIT_MASK 0x100 FORMAT "%13.11" ECU_ADDRESS 0x3FDBCA /end MEASUREMENT
/begin MEASUREMENT B_adsvb2 "Verbot Betriebsbereitschaft wegen Adernschluﬂ Bank2" UWORD B_TRUE 1 100 0 1 BIT_MASK 0x200 FORMAT "%13.11" ECU_ADDRESS 0x3FDBCA /end MEASUREMENT
/begin MEASUREMENT B_analu "Ausblendung nach dem ersten erkannten Aussetzer l‰uft" UBYTE B_TRUE 1 100 0 1 BIT_MASK 0x1 FORMAT "%13.11" ECU_ADDRESS 0x5B8AE4 /end MEASUREMENT
/begin MEASUREMENT B_clradfof "Bedingung: Adaptionswerte Fuel-Off/-On selektiv loeschen" UBYTE B_TRUE 1 100 0 1 BIT_MASK 0x1 FORMAT "%13.11" ECU_ADDRESS 0x5B8570 /end MEASUREMENT
/begin MEASUREMENT B_ddylash "Bedingung Sonde hinter KAT dynamisch langsam" UBYTE B_TRUE 1 100 0 1 BIT_MASK 0x1 FORMAT "%13.11" ECU_ADDRESS 0x3FBCBE /end MEASUREMENT
/begin MEASUREMENT B_dkini "Bedingung f¸r DKAT-Funktion initialisieren" UBYTE B_TRUE 1 100 0 1 BIT_MASK 0x1 FORMAT "%13.11" ECU_ADDRESS 0x3FBC93 /end MEASUREMENT
/begin MEASUREMENT B_dkini2 "Bedingung f¸r DKAT-Funktion initialisieren (Stereo 2.Bank)" UBYTE B_TRUE 1 100 0 1 BIT_MASK 0x1 FORMAT "%13.11" ECU_ADDRESS 0x3FBC94 /end MEASUREMENT
/begin MEASUREMENT B_dklpi "interne Umschaltung d. Lambdregelungsparameter angefordert" UBYTE B_TRUE 1 100 0 1 BIT_MASK 0x1 FORMAT "%13.11" ECU_ADDRESS 0x3FBC95 /end MEASUREMENT
/begin MEASUREMENT B_dklpi2 "interne Umschaltung d. Lambdregelungsparameter angefordert, Bank2" UBYTE B_TRUE 1 100 0 1 BIT_MASK 0x1 FORMAT "%13.11" ECU_ADDRESS 0x3FBC96 /end MEASUREMENT
/begin MEASUREMENT B_dkten "DKAT f¸r diesen Trip nicht mehr aktiv" UBYTE B_TRUE 1 100 0 1 BIT_MASK 0x1 FORMAT "%13.11" ECU_ADDRESS 0x3FBC97 /end MEASUREMENT
/begin MEASUREMENT B_dkten2 "DKAT f¸r diesen Trip nicht mehr aktiv (Bank2)" UBYTE B_TRUE 1 100 0 1 BIT_MASK 0x1 FORMAT "%13.11" ECU_ADDRESS 0x3FBC98 /end MEASUREMENT
/begin MEASUREMENT B_dktlp "Umschaltung der Lambdaregelungsparameter angefordert" UBYTE B_TRUE 1 100 0 1 BIT_MASK 0x1 FORMAT "%13.11" ECU_ADDRESS 0x3FBC99 /end MEASUREMENT
/begin MEASUREMENT B_dktnr "DKAT: n/rl-Bereich verlassen" UBYTE B_TRUE 1 100 0 1 BIT_MASK 0x1 FORMAT "%13.11" ECU_ADDRESS 0x3FBC9A /end MEASUREMENT
/begin MEASUREMENT B_dktnr2 "DKAT: n/rl-Bereich verlassen, Bank2" UBYTE B_TRUE 1 100 0 1 BIT_MASK 0x1 FORMAT "%13.11" ECU_ADDRESS 0x3FBC9B /end MEASUREMENT
/begin MEASUREMENT B_dktsb "Bankspezifische Stoppbedingung" UBYTE B_TRUE 1 100 0 1 BIT_MASK 0x1 FORMAT "%13.11" ECU_ADDRESS 0x3FBC9C /end MEASUREMENT
/begin MEASUREMENT B_dktsb2 "Bankspezifische Stoppbedingung (Stereo 2.Bank)" UBYTE B_TRUE 1 100 0 1 BIT_MASK 0x1 FORMAT "%13.11" ECU_ADDRESS 0x3FBC9D /end MEASUREMENT
/begin MEASUREMENT B_dktsp "physikalische Stoppbedingung" UBYTE B_TRUE 1 100 0 1 BIT_MASK 0x1 FORMAT "%13.11" ECU_ADDRESS 0x3FBC9E /end MEASUREMENT
/begin MEASUREMENT B_dktsp2 "physikalische Stoppbedingung (Stereo 2.Bank)" UBYTE B_TRUE 1 100 0 1 BIT_MASK 0x1 FORMAT "%13.11" ECU_ADDRESS 0x3FBC9F /end MEASUREMENT
/begin MEASUREMENT B_dktst "DKAT-Funktion ist gestoppt (B_dktst=FALSE)" UBYTE B_TRUE 1 100 0 1 BIT_MASK 0x1 FORMAT "%13.11" ECU_ADDRESS 0x3FBCA0 /end MEASUREMENT
/begin MEASUREMENT B_dktst2 "DKAT-Funktion ist gestoppt (B_dktst=FALSE, Stereo 2.Bank)" UBYTE B_TRUE 1 100 0 1 BIT_MASK 0x1 FORMAT "%13.11" ECU_ADDRESS 0x3FBCA1 /end MEASUREMENT
/begin MEASUREMENT B_dktt "DKAT-Aktiv-Zeit abgelaufen" UBYTE B_TRUE 1 100 0 1 BIT_MASK 0x1 FORMAT "%13.11" ECU_ADDRESS 0x3FBCA2 /end MEASUREMENT
/begin MEASUREMENT B_dktt2 "DKAT-Aktiv-Zeit abgelaufen, Bank2" UBYTE B_TRUE 1 100 0 1 BIT_MASK 0x1 FORMAT "%13.11" ECU_ADDRESS 0x3FBCA3 /end MEASUREMENT
/begin MEASUREMENT B_dkvsef "Errorflag in DKVS trotz weitere Fehler im System freigeben" UBYTE B_TRUE 1 100 0 1 BIT_MASK 0x1 FORMAT "%13.11" ECU_ADDRESS 0x3FBD4D /end MEASUREMENT
/begin MEASUREMENT B_dkvsf "Bedingung: Freigabe des Fehlers" UBYTE B_TRUE 1 100 0 1 BIT_MASK 0x1 FORMAT "%13.11" ECU_ADDRESS 0x3FBD4E /end MEASUREMENT
/begin MEASUREMENT B_dkvsfm "Bedingung: Freigabe des Fehlers (Flipflop Ausgang)" UBYTE B_TRUE 1 100 0 1 BIT_MASK 0x1 FORMAT "%13.11" ECU_ADDRESS 0x3FDC1A /end MEASUREMENT
/begin MEASUREMENT B_dkvstr "Bedingung: Integrator bei Tankleer zur¸cksetzen" UBYTE B_TRUE 1 100 0 1 BIT_MASK 0x1 FORMAT "%13.11" ECU_ADDRESS 0x3FBD4F /end MEASUREMENT
/begin MEASUREMENT B_dkvszf "Zyklusflag in DKVS trotz weitere Fehler im System freigeben" UBYTE B_TRUE 1 100 0 1 BIT_MASK 0x1 FORMAT "%13.11" ECU_ADDRESS 0x5B872E /end MEASUREMENT
/begin MEASUREMENT B_dlaff "Anzahl der g¸ltigen Tp-Messungen erreicht seit B_dlatp=1" UBYTE B_TRUE 1 100 0 1 BIT_MASK 0x1 FORMAT "%13.11" ECU_ADDRESS 0x3FBCB2 /end MEASUREMENT
/begin MEASUREMENT B_dlaff2 "Anzahl der g¸ltigen Tp-Messungen erreicht seit B_dlatp2=1 Bank2" UBYTE B_TRUE 1 100 0 1 BIT_MASK 0x1 FORMAT "%13.11" ECU_ADDRESS 0x3FBCB3 /end MEASUREMENT
/begin MEASUREMENT B_dlams "Bedingung Lambdaverstellung f¸r Integrator hat max. Grenzwert erreicht." UBYTE B_TRUE 1 100 0 1 BIT_MASK 0x2 FORMAT "%13.11" ECU_ADDRESS 0x5B8E68 /end MEASUREMENT
/begin MEASUREMENT B_dlash "Bedingung Freigabe Schwingungspr¸fung hinter Kat." UBYTE B_TRUE 1 100 0 1 BIT_MASK 0x1 FORMAT "%13.11" ECU_ADDRESS 0x3FBCBF /end MEASUREMENT
/begin MEASUREMENT B_dlatp "Aktive Diagnose:Lambda-Sondenalterung TP" UBYTE B_TRUE 1 100 0 1 BIT_MASK 0x1 FORMAT "%13.11" ECU_ADDRESS 0x3FBCB4 /end MEASUREMENT
/begin MEASUREMENT B_dlatp2 "Aktive Diagnose:	Lambda-Sondenalterung TP (Bank 2)" UBYTE B_TRUE 1 100 0 1 BIT_MASK 0x1 FORMAT "%13.11" ECU_ADDRESS 0x3FBCB5 /end MEASUREMENT
/begin MEASUREMENT B_dlatv "Aktive Diagnose:	Lambda-Sondenalterung TV" UBYTE B_TRUE 1 100 0 1 BIT_MASK 0x1 FORMAT "%13.11" ECU_ADDRESS 0x3FBCB6 /end MEASUREMENT
/begin MEASUREMENT B_dlatv2 "Aktive Diagnose:	Lambda-Sondenalterung TV (Bank 2)" UBYTE B_TRUE 1 100 0 1 BIT_MASK 0x1 FORMAT "%13.11" ECU_ADDRESS 0x3FBCB7 /end MEASUREMENT
/begin MEASUREMENT B_dllr "Aktive diagnose: Leerlaufstellerdiagnose" UBYTE B_TRUE 1 100 0 1 BIT_MASK 0x1 FORMAT "%13.11" ECU_ADDRESS 0x3FBEF0 /end MEASUREMENT
/begin MEASUREMENT B_dllra "Bedingung DLLR Anforderung" UBYTE B_TRUE 1 100 0 1 BIT_MASK 0x1 FORMAT "%13.11" ECU_ADDRESS 0x3FBEF1 /end MEASUREMENT
/begin MEASUREMENT B_dluerk "Aussetzer erkannt, aus DMDDLU" UBYTE B_TRUE 1 100 0 1 BIT_MASK 0x1 FORMAT "%13.11" ECU_ADDRESS 0x5B8ADE /end MEASUREMENT
/begin MEASUREMENT B_dluerk_t "" UBYTE B_TRUE 1 100 0 1 BIT_MASK 0x1 FORMAT "%13.11" ECU_ADDRESS 0x5B8ADF /end MEASUREMENT
/begin MEASUREMENT B_dmaso "Bedingung gemeinsame Sondenmasse offen ""dynamisch""" UBYTE B_TRUE 1 100 0 1 BIT_MASK 0x1 FORMAT "%13.11" ECU_ADDRESS 0x3FBCDE /end MEASUREMENT
/begin MEASUREMENT B_dmaso2 "Bedingung gemeinsame Sondenmasse offen ""dynamisch"" Bank2" UBYTE B_TRUE 1 100 0 1 BIT_MASK 0x1 FORMAT "%13.11" ECU_ADDRESS 0x3FBCDF /end MEASUREMENT
/begin MEASUREMENT B_ds "KR: Sensordiagnose aktiv" UBYTE B_TRUE 1 100 0 1 FORMAT "%13.11" ARRAY_SIZE 4 ECU_ADDRESS 0x5B8878 /end MEASUREMENT
/begin MEASUREMENT B_dshen "Bedingung Freigabe Sondendiagnose hinter KAT" UBYTE B_TRUE 1 100 0 1 BIT_MASK 0x1 FORMAT "%13.11" ECU_ADDRESS 0x3FBCD4 /end MEASUREMENT
/begin MEASUREMENT B_dshk "Bedingung Diagnosefunktion in %DLSH und %DHLS mit i.O.-Meldung h. KAT" UBYTE B_TRUE 1 100 0 1 BIT_MASK 0x1 FORMAT "%13.11" ECU_ADDRESS 0x3FBCC0 /end MEASUREMENT
/begin MEASUREMENT B_dsven "Bedingung Freigabe Sondendiagnose vor KAT" UBYTE B_TRUE 1 100 0 1 BIT_MASK 0x1 FORMAT "%13.11" ECU_ADDRESS 0x3FBCE0 /end MEASUREMENT
/begin MEASUREMENT B_dsven2 "Bedingung Freigabe Sondendiagnose vor KAT Bank2" UBYTE B_TRUE 1 100 0 1 BIT_MASK 0x1 FORMAT "%13.11" ECU_ADDRESS 0x3FBCE1 /end MEASUREMENT
/begin MEASUREMENT B_dushkvl "Bed. Schwelle f¸r Sonde h. KAT bei Vollast nicht ¸berschritten" UBYTE B_TRUE 1 100 0 1 BIT_MASK 0x8 FORMAT "%13.11" ECU_ADDRESS 0x5B8E69 /end MEASUREMENT
/begin MEASUREMENT B_dushsch "Bedingung Schwelle f¸r Sonde hinter KAT im Schub nicht unterschritten" UBYTE B_TRUE 1 100 0 1 BIT_MASK 0x1 FORMAT "%13.11" ECU_ADDRESS 0x3FBCC1 /end MEASUREMENT
/begin MEASUREMENT B_dylash "Bedingung Sonde hinter KAT dynamisch langsam" UBYTE B_TRUE 1 100 0 1 BIT_MASK 0x1 FORMAT "%13.11" ECU_ADDRESS 0x3FDBC0 /end MEASUREMENT
/begin MEASUREMENT B_edkvs "Bedingung Adaptionsfehlerschwellen aktuell ¸berschritten" UBYTE B_TRUE 1 100 0 1 BIT_MASK 0x1 FORMAT "%13.11" ECU_ADDRESS 0x3FBD50 /end MEASUREMENT
/begin MEASUREMENT B_efrao "Bedingung Diagnoseschwellen obere multipl. Korrektur aktuell ¸berschritten" UBYTE B_TRUE 1 100 0 1 BIT_MASK 0x1 FORMAT "%13.11" ECU_ADDRESS 0x3FBD51 /end MEASUREMENT
/begin MEASUREMENT B_efrau "Bedingung Diagnoseschwellen untere multipl. Korrektur aktuell ¸berschritten" UBYTE B_TRUE 1 100 0 1 BIT_MASK 0x1 FORMAT "%13.11" ECU_ADDRESS 0x3FBD52 /end MEASUREMENT
/begin MEASUREMENT B_ekats "Summenfehler f¸r MODE 6" UBYTE B_TRUE 1 100 0 1 BIT_MASK 0x1 FORMAT "%13.11" ECU_ADDRESS 0x3FBCA4 /end MEASUREMENT
/begin MEASUREMENT B_ekats2 "Summenfehler f¸r MODE 6 (Stereo 2.Bank)" UBYTE B_TRUE 1 100 0 1 BIT_MASK 0x1 FORMAT "%13.11" ECU_ADDRESS 0x3FBCA5 /end MEASUREMENT
/begin MEASUREMENT B_enfmst "Bedingung Enable f¸r Filter; Maximum der Steigung ¸bernehmen hinter Kat" UBYTE B_TRUE 1 100 0 1 BIT_MASK 0x1 FORMAT "%13.11" ECU_ADDRESS 0x3FBCC2 /end MEASUREMENT
/begin MEASUREMENT B_enlash "Bedingung Test f¸r Schwingungspr¸fung abgeschlossen hinteer Kat" UBYTE B_TRUE 1 100 0 1 BIT_MASK 0x1 FORMAT "%13.11" ECU_ADDRESS 0x3FBCC3 /end MEASUREMENT
/begin MEASUREMENT B_enmaxla "Bedingung enable B_maxlash ""setzen"" bei Fehler Lambdasonden hinter Kat" UBYTE B_TRUE 1 100 0 1 BIT_MASK 0x2 FORMAT "%13.11" ECU_ADDRESS 0x5B8E69 /end MEASUREMENT
/begin MEASUREMENT B_entest "Bedingung Wartezeit abgeschlossen f¸r Test-‹berpr¸fung Sonde hinter KAT" UBYTE B_TRUE 1 100 0 1 BIT_MASK 0x1 FORMAT "%13.11" ECU_ADDRESS 0x3FBCC4 /end MEASUREMENT
/begin MEASUREMENT B_erdkt "Interner Fehler Kat-‹berwachung" UBYTE B_TRUE 1 100 0 1 BIT_MASK 0x1 FORMAT "%13.11" ECU_ADDRESS 0x3FBCA6 /end MEASUREMENT
/begin MEASUREMENT B_erdkt2 "Interner Fehler Kat-‹berwachung (Bank2)" UBYTE B_TRUE 1 100 0 1 BIT_MASK 0x1 FORMAT "%13.11" ECU_ADDRESS 0x3FBCA7 /end MEASUREMENT
/begin MEASUREMENT B_erkat "Bedingung Diagnoseschwellen additive Korr. pro Zeit aktuell ¸berschritten" UBYTE B_TRUE 1 100 0 1 BIT_MASK 0x1 FORMAT "%13.11" ECU_ADDRESS 0x3FBD53 /end MEASUREMENT
/begin MEASUREMENT B_erkaz "Bedingung Diagnoseschwellen additive Korr. pro Einspr.  aktuell ¸berschritten" UBYTE B_TRUE 1 100 0 1 BIT_MASK 0x1 FORMAT "%13.11" ECU_ADDRESS 0x3FBD54 /end MEASUREMENT
/begin MEASUREMENT B_firstnr "Bedingung fuel-on Adaption erster Bereich im Drehzahlbereich ready" UBYTE B_TRUE 1 100 0 1 BIT_MASK 0x1 FORMAT "%13.11" ECU_ADDRESS 0x5B8B3B /end MEASUREMENT
/begin MEASUREMENT B_fodon "Bedingung fuel-on Adaption in drehzahldominantem Bereich aktiv" UBYTE B_TRUE 1 100 0 1 BIT_MASK 0x20 FORMAT "%13.11" ECU_ADDRESS 0x5B8BE2 /end MEASUREMENT
/begin MEASUREMENT B_fof1 "Bedingung fuel-off Adaption in 1. Drehzahlbereich aktiv" UBYTE B_TRUE 1 100 0 1 BIT_MASK 0x1 FORMAT "%13.11" ECU_ADDRESS 0x5B8B2A /end MEASUREMENT
/begin MEASUREMENT B_fof2 "Bedingung fuel-off Adaption in 2. Drehzahlbereich aktiv" UBYTE B_TRUE 1 100 0 1 BIT_MASK 0x1 FORMAT "%13.11" ECU_ADDRESS 0x5B8B2B /end MEASUREMENT
/begin MEASUREMENT B_fof3 "Bedingung fuel-off Adaption in 3. Drehzahlbereich aktiv" UBYTE B_TRUE 1 100 0 1 BIT_MASK 0x1 FORMAT "%13.11" ECU_ADDRESS 0x5B8B2C /end MEASUREMENT
/begin MEASUREMENT B_fof4 "Bedingung fuel-off Adaption in 4. Drehzahlbereich aktiv" UBYTE B_TRUE 1 100 0 1 BIT_MASK 0x1 FORMAT "%13.11" ECU_ADDRESS 0x5B8B2D /end MEASUREMENT
/begin MEASUREMENT B_fofd "Bedingung fuel-off Adaption in dominantem Drehzahlbereich aktiv" UBYTE B_TRUE 1 100 0 1 BIT_MASK 0x1 FORMAT "%13.11" ECU_ADDRESS 0x5B8B2E /end MEASUREMENT
/begin MEASUREMENT B_fofdis "Bedingung fuel-off Adaption im aktuellen Betriebsbereich nicht erlaubt" UBYTE B_TRUE 1 100 0 1 BIT_MASK 0x1 FORMAT "%13.11" ECU_ADDRESS 0x5B8B2F /end MEASUREMENT
/begin MEASUREMENT B_fofdr "Bedingung fuel-off Adaption im dominanten Drehzahlbereich ready" UBYTE B_TRUE 1 100 0 1 BIT_MASK 0x1 FORMAT "%13.11" ECU_ADDRESS 0x3FD838 /end MEASUREMENT
/begin MEASUREMENT B_fofr "Bedingung fuel-off Adaption im aktuellen Drehzahlbereich ready" UBYTE B_TRUE 1 100 0 1 BIT_MASK 0x1 FORMAT "%13.11" ECU_ADDRESS 0x5B8B30 /end MEASUREMENT
/begin MEASUREMENT B_fofr1 "Drehzahlbereich 1 fertig gelernt (ready)" UBYTE B_TRUE 1 100 0 1 BIT_MASK 0x1 FORMAT "%13.11" ECU_ADDRESS 0x3FD839 /end MEASUREMENT
/begin MEASUREMENT B_fofr2 "Drehzahlbereich 2 fertig gelernt (ready)" UBYTE B_TRUE 1 100 0 1 BIT_MASK 0x1 FORMAT "%13.11" ECU_ADDRESS 0x3FD83A /end MEASUREMENT
/begin MEASUREMENT B_fofr3 "Drehzahlbereich 3 fertig gelernt (ready)" UBYTE B_TRUE 1 100 0 1 BIT_MASK 0x1 FORMAT "%13.11" ECU_ADDRESS 0x3FD83B /end MEASUREMENT
/begin MEASUREMENT B_fofr4 "Drehzahlbereich 4 fertig gelernt (ready)" UBYTE B_TRUE 1 100 0 1 BIT_MASK 0x1 FORMAT "%13.11" ECU_ADDRESS 0x3FD83C /end MEASUREMENT
/begin MEASUREMENT B_fofrun "Status fuel-off Adaption aktiv" UBYTE B_TRUE 1 100 0 1 BIT_MASK 0x1 FORMAT "%13.11" ECU_ADDRESS 0x5B8B31 /end MEASUREMENT
/begin MEASUREMENT B_fofrun0 "Bedingungen f¸r Fuel-off Adaption erf¸llt" UBYTE B_TRUE 1 100 0 1 BIT_MASK 0x1 FORMAT "%13.11" ECU_ADDRESS 0x5B8B32 /end MEASUREMENT
/begin MEASUREMENT B_fohe "aktueller Bereich ist ein Heilbereich" UBYTE B_TRUE 1 100 0 1 BIT_MASK 0x40 FORMAT "%13.11" ECU_ADDRESS 0x5B8BE2 /end MEASUREMENT
/begin MEASUREMENT B_fohold "fuel-on Adaption angehalten" UBYTE B_TRUE 1 100 0 1 BIT_MASK 0x1 FORMAT "%13.11" ECU_ADDRESS 0x3FDB44 /end MEASUREMENT
/begin MEASUREMENT B_folunw "Bedingung Laufunruhe zu groﬂ f¸r fuel-on/-off Adaption" UBYTE B_TRUE 1 100 0 1 BIT_MASK 0x1 FORMAT "%13.11" ECU_ADDRESS 0x5B8B33 /end MEASUREMENT
/begin MEASUREMENT B_fomod "zeigt Modus der fuel-on/-off Adaption (Codewort CDFOMOD)" UBYTE B_TRUE 1 100 0 1 BIT_MASK 0x1 FORMAT "%13.11" ECU_ADDRESS 0x3FD83D /end MEASUREMENT
/begin MEASUREMENT B_fomodold "" UBYTE B_TRUE 1 100 0 1 BIT_MASK 0x1 FORMAT "%13.11" ECU_ADDRESS 0x5B8B34 /end MEASUREMENT
/begin MEASUREMENT B_fondis "Bedingung fuel-on Adaption gestoppt" UBYTE B_TRUE 1 100 0 1 BIT_MASK 0x1 FORMAT "%13.11" ECU_ADDRESS 0x5B8BE3 /end MEASUREMENT
/begin MEASUREMENT B_fonresd "Anforderung Reset der Fuel-On Adaption durchf¸hren" UBYTE B_TRUE 1 100 0 1 BIT_MASK 0x1 FORMAT "%13.11" ECU_ADDRESS 0x5B8571 /end MEASUREMENT
/begin MEASUREMENT B_fonresf "Reset der Fuel-On Adaption durchgef¸hrt" UBYTE B_TRUE 1 100 0 1 BIT_MASK 0x1 FORMAT "%13.11" ECU_ADDRESS 0x5B8B3C /end MEASUREMENT
/begin MEASUREMENT B_fonrset "Reset der fuel-on Adaption" UBYTE B_TRUE 1 100 0 1 BIT_MASK 0x4 FORMAT "%13.11" ECU_ADDRESS 0x5B8BE3 /end MEASUREMENT
/begin MEASUREMENT B_for "Bedingung fuel-on/-off Adaption aktuell ready" UBYTE B_TRUE 1 100 0 1 BIT_MASK 0x10 FORMAT "%13.11" ECU_ADDRESS 0x5B8BE2 /end MEASUREMENT
/begin MEASUREMENT B_fora "Bedingung fuel-on Adaption aktuell ready (Array)" UBYTE default 1 100 0 1 FORMAT "%5.3" ARRAY_SIZE 24 ECU_ADDRESS 0x3FDB48 /end MEASUREMENT
/begin MEASUREMENT B_fora_old "" UBYTE default 1 100 0 1 FORMAT "%5.3" ARRAY_SIZE 24 ECU_ADDRESS 0x3FDB60 /end MEASUREMENT
/begin MEASUREMENT B_forn "Bedingung fuel-on/-off Adaption aktueller Drehzahlbereich ready" UBYTE B_TRUE 1 100 0 1 BIT_MASK 0x8 FORMAT "%13.11" ECU_ADDRESS 0x5B8BE2 /end MEASUREMENT
/begin MEASUREMENT B_forna "Bedingung fuel-on Adaption aktueller Drehzahlbereich ready (Array)" UBYTE default 1 100 0 1 FORMAT "%5.3" ARRAY_SIZE 9 ECU_ADDRESS 0x3FDB78 /end MEASUREMENT
/begin MEASUREMENT B_forun "Status fuel-on/-off Adaption aktiv" UBYTE B_TRUE 1 100 0 1 BIT_MASK 0x4 FORMAT "%13.11" ECU_ADDRESS 0x5B8BE2 /end MEASUREMENT
/begin MEASUREMENT B_forun0 "Status fuel-on/-off Adaption aktiv" UBYTE B_TRUE 1 100 0 1 BIT_MASK 0x2 FORMAT "%13.11" ECU_ADDRESS 0x5B8BE2 /end MEASUREMENT
/begin MEASUREMENT B_frste "Bedingung frm_w eingeschwungen (Kurztest)" UBYTE B_TRUE 1 100 0 1 BIT_MASK 0x1 FORMAT "%13.11" ECU_ADDRESS 0x3FBD55 /end MEASUREMENT
/begin MEASUREMENT B_gae "Bedingung Grundadaption eingeschwungen" UBYTE B_TRUE 1 100 0 1 BIT_MASK 0x1 FORMAT "%13.11" ECU_ADDRESS 0x3FBD56 /end MEASUREMENT
/begin MEASUREMENT B_gaefra "Bedingung Grundadaption (fra-Integrator) eingeschwungen" UBYTE B_TRUE 1 100 0 1 BIT_MASK 0x1 FORMAT "%13.11" ECU_ADDRESS 0x3FBD57 /end MEASUREMENT
/begin MEASUREMENT B_gaefra2 "Bedingung Grundadaption (fra2-Integrator) eingeschwungen" UBYTE B_TRUE 1 100 0 1 BIT_MASK 0x1 FORMAT "%13.11" ECU_ADDRESS 0x3FBD58 /end MEASUREMENT
/begin MEASUREMENT B_gaeing "Bedingung Grundadaption Bank 1 eingeschwungen" UBYTE B_TRUE 1 100 0 1 BIT_MASK 0x1 FORMAT "%13.11" ECU_ADDRESS 0x3FBD59 /end MEASUREMENT
/begin MEASUREMENT B_gaeing2 "Bedingung Grundadaption Bank 2 eingeschwungenen" UBYTE B_TRUE 1 100 0 1 BIT_MASK 0x1 FORMAT "%13.11" ECU_ADDRESS 0x3FBD5A /end MEASUREMENT
/begin MEASUREMENT B_gangok "Bedingung Gangwechselerkennung prinziell erlaubt" UBYTE B_TRUE 1 100 0 1 BIT_MASK 0x1 FORMAT "%13.11" ECU_ADDRESS 0x3FBD09 /end MEASUREMENT
/begin MEASUREMENT B_idxfof1 "Bedingung Betriebspunkt im 1. Drehzahhlbereich" UBYTE B_TRUE 1 100 0 1 BIT_MASK 0x1 FORMAT "%13.11" ECU_ADDRESS 0x5B8B35 /end MEASUREMENT
/begin MEASUREMENT B_idxfof2 "Bedingung Betriebspunkt im 2. Drehzahhlbereich" UBYTE B_TRUE 1 100 0 1 BIT_MASK 0x1 FORMAT "%13.11" ECU_ADDRESS 0x5B8B36 /end MEASUREMENT
/begin MEASUREMENT B_idxfof3 "Bedingung Betriebspunkt im 3. Drehzahhlbereich" UBYTE B_TRUE 1 100 0 1 BIT_MASK 0x1 FORMAT "%13.11" ECU_ADDRESS 0x5B8B37 /end MEASUREMENT
/begin MEASUREMENT B_idxfof4 "Bedingung Betriebspunkt im 4. Drehzahhlbereich" UBYTE B_TRUE 1 100 0 1 BIT_MASK 0x1 FORMAT "%13.11" ECU_ADDRESS 0x5B8B38 /end MEASUREMENT
/begin MEASUREMENT B_imlkvse "Bedingung Luftmassenintegral R¸cksetzen" UBYTE B_TRUE 1 100 0 1 BIT_MASK 0x2 FORMAT "%13.11" ECU_ADDRESS 0x3FDC1A /end MEASUREMENT
/begin MEASUREMENT B_kftdet "Variantenerkennung Kennfeldthermostat durchgef¸hrt" UBYTE B_TRUE 1 100 0 1 BIT_MASK 0x1 FORMAT "%13.11" ECU_ADDRESS 0x3FDBCE /end MEASUREMENT
/begin MEASUREMENT B_kftvar "Variantenbit f¸r Kennfeldthermostat vorhanden" UBYTE B_TRUE 1 100 0 1 BIT_MASK 0x1 FORMAT "%13.11" ECU_ADDRESS 0x3FDBCF /end MEASUREMENT
/begin MEASUREMENT B_krdws "Bedingung Klopfregelung Sicherheitssp‰tverstellung" UBYTE B_TRUE 1 100 0 1 BIT_MASK 0x1 FORMAT "%13.11" ECU_ADDRESS 0x3FBE3E /end MEASUREMENT
/begin MEASUREMENT B_krntfv "KR: Fehlerverdacht Nulltest" UBYTE B_TRUE 1 100 0 1 BIT_MASK 0x1 FORMAT "%13.11" ECU_ADDRESS 0x3FBE3F /end MEASUREMENT
/begin MEASUREMENT B_krtpfv "KR: Testimpuls Fehlerverdacht" UBYTE B_TRUE 1 100 0 1 BIT_MASK 0x1 FORMAT "%13.11" ECU_ADDRESS 0x3FBE44 /end MEASUREMENT
/begin MEASUREMENT B_ktrlash "Bedingung Kurztrip f¸r Schwingungspr¸fung durchf¸hren Sonde hinter KAT" UBYTE B_TRUE 1 100 0 1 BIT_MASK 0x4 FORMAT "%13.11" ECU_ADDRESS 0x5B8E68 /end MEASUREMENT
/begin MEASUREMENT B_kvsffl "Bedingung: Freigabe des Fehlers trotz Tank leer" UBYTE B_TRUE 1 100 0 1 BIT_MASK 0x1 FORMAT "%13.11" ECU_ADDRESS 0x3FBD5B /end MEASUREMENT
/begin MEASUREMENT B_lamend "Bedingung Ende der Lambdaverstellung in %LAMKO hinter Kat" UBYTE B_TRUE 1 100 0 1 BIT_MASK 0x1 FORMAT "%13.11" ECU_ADDRESS 0x3FBCC5 /end MEASUREMENT
/begin MEASUREMENT B_lamlash "Bedingung f¸r Abmagern/Anfetten in %LAMKO" UBYTE B_TRUE 1 100 0 1 BIT_MASK 0x1 FORMAT "%13.11" ECU_ADDRESS 0x3FBCC6 /end MEASUREMENT
/begin MEASUREMENT B_lamverg "Bedingung Vergleich Lambdasoll in %DLSAHK mit %LAMKO ¸bereinstimmend" UBYTE B_TRUE 1 100 0 1 BIT_MASK 0x1 FORMAT "%13.11" ECU_ADDRESS 0x3FBCC7 /end MEASUREMENT
/begin MEASUREMENT B_lldia "Diagnose Leerlaufregelung freigegeben" UBYTE B_TRUE 1 100 0 1 BIT_MASK 0x1 FORMAT "%13.11" ECU_ADDRESS 0x3FBEF2 /end MEASUREMENT
/begin MEASUREMENT B_lsads "Bedingung Sonde hat Adernschluﬂ" UWORD B_TRUE 1 100 0 1 BIT_MASK 0x400 FORMAT "%13.11" ECU_ADDRESS 0x3FDBCA /end MEASUREMENT
/begin MEASUREMENT B_lsads2 "Bedingung Sonde hat Adernschluﬂ Bank2" UWORD B_TRUE 1 100 0 1 BIT_MASK 0x800 FORMAT "%13.11" ECU_ADDRESS 0x3FDBCA /end MEASUREMENT
/begin MEASUREMENT B_lsafkn "Bedingung Sondenspannung v.K. auﬂerhalb vom Fenster, kein Nebenschluﬂ" UBYTE B_TRUE 1 100 0 1 BIT_MASK 0x1 FORMAT "%13.11" ECU_ADDRESS 0x3FBCE2 /end MEASUREMENT
/begin MEASUREMENT B_lsafkn2 "wie B_LSAFKN, bei Stereo-Lambdaregelung g¸ltig f¸r zweite Bank" UBYTE B_TRUE 1 100 0 1 BIT_MASK 0x1 FORMAT "%13.11" ECU_ADDRESS 0x3FBCE3 /end MEASUREMENT
/begin MEASUREMENT B_lsahksp "allgemeine Stop-Bedingungen f¸r die DLSAHK" UBYTE B_TRUE 1 100 0 1 BIT_MASK 0x1 FORMAT "%13.11" ECU_ADDRESS 0x3FBCC8 /end MEASUREMENT
/begin MEASUREMENT B_lsastp "allgemeine Stop-Bedingungen f¸r die DLSA" UBYTE B_TRUE 1 100 0 1 BIT_MASK 0x1 FORMAT "%13.11" ECU_ADDRESS 0x3FBCB8 /end MEASUREMENT
/begin MEASUREMENT B_lsastp2 "allgemeine Stop-Bedingungen f¸r die DLSA  Bank2" UBYTE B_TRUE 1 100 0 1 BIT_MASK 0x1 FORMAT "%13.11" ECU_ADDRESS 0x3FBCB9 /end MEASUREMENT
/begin MEASUREMENT B_lsfet "Bedingung Sondenspannung hat Nebenschluﬂ nach Ubatt" UWORD B_TRUE 1 100 0 1 BIT_MASK 0x4 FORMAT "%13.11" ECU_ADDRESS 0x3FDBCA /end MEASUREMENT
/begin MEASUREMENT B_lsfet2 "Bedingung Sondenspannung hat Nebenschluﬂ nach Ubatt Bank2" UWORD B_TRUE 1 100 0 1 BIT_MASK 0x8 FORMAT "%13.11" ECU_ADDRESS 0x3FDBCA /end MEASUREMENT
/begin MEASUREMENT B_lshklt "Bedingung Lambdasonde hinter Kat kalt" UBYTE B_TRUE 1 100 0 1 BIT_MASK 0x1 FORMAT "%13.11" ECU_ADDRESS 0x3FBCD5 /end MEASUREMENT
/begin MEASUREMENT B_lshswok "Bedingung Sonde hinter KAT nach Schwingungspr¸fung in Ordnung" UBYTE B_TRUE 1 100 0 1 BIT_MASK 0x1 FORMAT "%13.11" ECU_ADDRESS 0x5B866A /end MEASUREMENT
/begin MEASUREMENT B_lshub "Bedingung Sonde begrenzter Spannungshub" UWORD B_TRUE 1 100 0 1 BIT_MASK 0x40 FORMAT "%13.11" ECU_ADDRESS 0x3FDBCA /end MEASUREMENT
/begin MEASUREMENT B_lshub2 "Bedingung Sonde begrenzter Spannungshub Bank 2" UWORD B_TRUE 1 100 0 1 BIT_MASK 0x80 FORMAT "%13.11" ECU_ADDRESS 0x3FDBCA /end MEASUREMENT
/begin MEASUREMENT B_lsvklt "Bedingung Lambdasonde vor Kat kalt" UBYTE B_TRUE 1 100 0 1 BIT_MASK 0x1 FORMAT "%13.11" ECU_ADDRESS 0x3FBCE4 /end MEASUREMENT
/begin MEASUREMENT B_lsvklt2 "Bedingung Lambdasonde vor Kat kalt Bank2" UBYTE B_TRUE 1 100 0 1 BIT_MASK 0x1 FORMAT "%13.11" ECU_ADDRESS 0x3FBCE5 /end MEASUREMENT
/begin MEASUREMENT B_lsvn "Bedingung Nebenschluﬂ bei kalter Sonde vor Kat" UWORD B_TRUE 1 100 0 1 BIT_MASK 0x1 FORMAT "%13.11" ECU_ADDRESS 0x3FDBCA /end MEASUREMENT
/begin MEASUREMENT B_lsvn2 "Bedingung Nebenschluﬂ bei kalter Sonde vor Kat, Bank2" UWORD B_TRUE 1 100 0 1 BIT_MASK 0x2 FORMAT "%13.11" ECU_ADDRESS 0x3FDBCA /end MEASUREMENT
/begin MEASUREMENT B_luaerk "Aussetzer erkannt ¸ber Laufunruhe Abstandsmass, aus DMDLUA" UBYTE B_TRUE 1 100 0 1 BIT_MASK 0x1 FORMAT "%13.11" ECU_ADDRESS 0x5B8AEB /end MEASUREMENT
/begin MEASUREMENT B_luerk "Aussetzer erkannt, aus DMDLU" UBYTE B_TRUE 1 100 0 1 BIT_MASK 0x1 FORMAT "%13.11" ECU_ADDRESS 0x5B8AE9 /end MEASUREMENT
/begin MEASUREMENT B_luerk_t "" UBYTE B_TRUE 1 100 0 1 BIT_MASK 0x1 FORMAT "%13.11" ECU_ADDRESS 0x5B8AEA /end MEASUREMENT
/begin MEASUREMENT B_maso "Bedingung gemeinsame Sondenmasse offen" UWORD B_TRUE 1 100 0 1 BIT_MASK 0x10 FORMAT "%13.11" ECU_ADDRESS 0x3FDBCA /end MEASUREMENT
/begin MEASUREMENT B_maso2 "Bedingung gemeinsame Sondenmasse offen Bank2" UWORD B_TRUE 1 100 0 1 BIT_MASK 0x20 FORMAT "%13.11" ECU_ADDRESS 0x3FDBCA /end MEASUREMENT
/begin MEASUREMENT B_maxflsh "Kurzsschluﬂ nach UBatt bei Sonde hinter KAT erkannt" UBYTE B_TRUE 1 100 0 1 BIT_MASK 0x1 FORMAT "%13.11" ECU_ADDRESS 0x5B8E6D /end MEASUREMENT
/begin MEASUREMENT B_maxflsv "Kurzsschluﬂ nach UBatt bei Sonde vor KAT erkannt" UBYTE B_TRUE 1 100 0 1 BIT_MASK 0x1 FORMAT "%13.11" ECU_ADDRESS 0x5B868A /end MEASUREMENT
/begin MEASUREMENT B_maxflsv2 "Kurzsschluﬂ nach UBatt bei Sonde vor KAT erkannt Bank2" UBYTE B_TRUE 1 100 0 1 BIT_MASK 0x2 FORMAT "%13.11" ECU_ADDRESS 0x5B868A /end MEASUREMENT
/begin MEASUREMENT B_maxla "Maximalwert f¸r Schwingungs-Pr¸fung hinter KAT erkannt" UBYTE B_TRUE 1 100 0 1 BIT_MASK 0x4 FORMAT "%13.11" ECU_ADDRESS 0x5B8E69 /end MEASUREMENT
/begin MEASUREMENT B_maxlash "Maximalwert f¸r Schwingungs-Pr¸fung hinter KAT erkannt" UBYTE B_TRUE 1 100 0 1 BIT_MASK 0x1 FORMAT "%13.11" ECU_ADDRESS 0x3FBCC9 /end MEASUREMENT
/begin MEASUREMENT B_mderk "Aussetzer erkannt, Verkn¸pfung mehrerer Funktionen" UBYTE B_TRUE 1 100 0 1 BIT_MASK 0x1 FORMAT "%13.11" ECU_ADDRESS 0x5B8AE5 /end MEASUREMENT
/begin MEASUREMENT B_mdstim "Z¸ndungs-Aussetzer eingestellt, Stimuli-Signal vom Aussetzergenerator" UBYTE B_TRUE 1 100 0 1 BIT_MASK 0x1 FORMAT "%13.11" ECU_ADDRESS 0x5B8AE7 /end MEASUREMENT
/begin MEASUREMENT B_mdzyl1 "Zyl.-Kennung (f. Zeit>TALUST), LU-Berechng. gesperrt (f. Zeit<TALUST)" UBYTE B_TRUE 1 100 0 1 BIT_MASK 0x1 FORMAT "%13.11" ECU_ADDRESS 0x5B8B39 /end MEASUREMENT
/begin MEASUREMENT B_minflsh "Adernschluﬂ oder KS nach Masse bei Sonde  hinter KAT erkannt" UBYTE B_TRUE 1 100 0 1 BIT_MASK 0x4 FORMAT "%13.11" ECU_ADDRESS 0x5B8E6D /end MEASUREMENT
/begin MEASUREMENT B_minflsv "Adernschluﬂ oder Kurzschluﬂ nach Masse vor KAT erkannt" UBYTE B_TRUE 1 100 0 1 BIT_MASK 0x4 FORMAT "%13.11" ECU_ADDRESS 0x5B868A /end MEASUREMENT
/begin MEASUREMENT B_minflsv2 "Adernschluﬂ oder Kurzschluﬂ nach Masse vor KAT erkannt Bank2" UBYTE B_TRUE 1 100 0 1 BIT_MASK 0x8 FORMAT "%13.11" ECU_ADDRESS 0x5B868A /end MEASUREMENT
/begin MEASUREMENT B_minlash "Minimalwert f¸r Schwingungspr¸fung hinter KAT erkannt" UBYTE B_TRUE 1 100 0 1 BIT_MASK 0x1 FORMAT "%13.11" ECU_ADDRESS 0x3FBCCA /end MEASUREMENT
/begin MEASUREMENT B_mldyn "Bedingung erforderliche Luftmasse im Schubbetrieb f¸r Dynamikmessung erreicht" UBYTE B_TRUE 1 100 0 1 BIT_MASK 0x1 FORMAT "%13.11" ECU_ADDRESS 0x3FBCCB /end MEASUREMENT
/begin MEASUREMENT B_mlustest "Bedingung ml ist innerhalb den Schwellen" UBYTE B_TRUE 1 100 0 1 BIT_MASK 0x1 FORMAT "%13.11" ECU_ADDRESS 0x3FBCCC /end MEASUREMENT
/begin MEASUREMENT B_nmntkomp "" UBYTE B_TRUE 1 100 0 1 BIT_MASK 0x1 FORMAT "%13.11" ECU_ADDRESS 0x5B8AE8 /end MEASUREMENT
/begin MEASUREMENT B_noadsh "Bedingung kein Adernschluﬂ bei Lambdasonden hinter Kat" UWORD B_TRUE 1 100 0 1 BIT_MASK 0x100 FORMAT "%13.11" ECU_ADDRESS 0x5B90CC /end MEASUREMENT
/begin MEASUREMENT B_nolash "Bedingung Diagnosefunktion Schwingungs-Pr¸fung. i.O.-Meldung beendet." UBYTE B_TRUE 1 100 0 1 BIT_MASK 0x1 FORMAT "%13.11" ECU_ADDRESS 0x3FBCCD /end MEASUREMENT
/begin MEASUREMENT B_nolatp "Bedingung Diagnosefunktion Perioden-Dauer mit i.O.-Meldung beendet." UBYTE B_TRUE 1 100 0 1 BIT_MASK 0x1 FORMAT "%13.11" ECU_ADDRESS 0x3FBCBA /end MEASUREMENT
/begin MEASUREMENT B_nolatp2 "Bedingung Diagnosefunktion Perioden-Dauer mit i.O.-Meldung beendet. Bank2" UBYTE B_TRUE 1 100 0 1 BIT_MASK 0x1 FORMAT "%13.11" ECU_ADDRESS 0x3FBCBB /end MEASUREMENT
/begin MEASUREMENT B_nolatv "Bedingung Diagnosefunktion ATV-Pr¸fung mit i.O.-Meldung beendet." UBYTE B_TRUE 1 100 0 1 BIT_MASK 0x1 FORMAT "%13.11" ECU_ADDRESS 0x3FBCBC /end MEASUREMENT
/begin MEASUREMENT B_nolatv2 "Bedingung Diagnosefunktion ATV-Pr¸fung mit i.O.-Meldung beendet. Bank2" UBYTE B_TRUE 1 100 0 1 BIT_MASK 0x1 FORMAT "%13.11" ECU_ADDRESS 0x3FBCBD /end MEASUREMENT
/begin MEASUREMENT B_nollrflr "Bedingung LLR-Diagnosefunktion mit i.O.-Meldung beendet." UBYTE B_TRUE 1 100 0 1 BIT_MASK 0x1 FORMAT "%13.11" ECU_ADDRESS 0x3FBEF3 /end MEASUREMENT
/begin MEASUREMENT B_nolsh "Bedingung Diagnosefunktion mit i.O.-Meldung hinter KAT beendet." UBYTE B_TRUE 1 100 0 1 BIT_MASK 0x1 FORMAT "%13.11" ECU_ADDRESS 0x3FBCD6 /end MEASUREMENT
/begin MEASUREMENT B_nolsv "Bedingung Diagnosefunktion mit i.O.-Meldung vor KAT beendet." UBYTE B_TRUE 1 100 0 1 BIT_MASK 0x1 FORMAT "%13.11" ECU_ADDRESS 0x3FBCE6 /end MEASUREMENT
/begin MEASUREMENT B_nolsv2 "Bedingung Diagnosefunktion mit i.O.-Meldung vor KATbeendet  Bank2" UBYTE B_TRUE 1 100 0 1 BIT_MASK 0x1 FORMAT "%13.11" ECU_ADDRESS 0x3FBCE7 /end MEASUREMENT
/begin MEASUREMENT B_norkam "Bedingung additive Korrektur der Adaption pro Zeit oder Z¸ndung abgeschaltet" UBYTE B_TRUE 1 100 0 1 BIT_MASK 0x1 FORMAT "%13.11" ECU_ADDRESS 0x3FBD5C /end MEASUREMENT
/begin MEASUREMENT B_nplflsh "Adernschluﬂ bei Sonde hinter KAT erkannt" UBYTE B_TRUE 1 100 0 1 BIT_MASK 0x40 FORMAT "%13.11" ECU_ADDRESS 0x5B8E6D /end MEASUREMENT
/begin MEASUREMENT B_nplflsv "Adernschluﬂ bei Sonde vor KAT erkannt" UBYTE B_TRUE 1 100 0 1 BIT_MASK 0x40 FORMAT "%13.11" ECU_ADDRESS 0x5B868A /end MEASUREMENT
/begin MEASUREMENT B_nplflsv2 "Adernschluﬂ bei Sonde vor KAT erkannt Bank2" UBYTE B_TRUE 1 100 0 1 BIT_MASK 0x80 FORMAT "%13.11" ECU_ADDRESS 0x5B868A /end MEASUREMENT
/begin MEASUREMENT B_npllash "Bedingung  ""nicht plausibler Wert"" f¸r Sonde hinter KAT" UBYTE B_TRUE 1 100 0 1 BIT_MASK 0x4 FORMAT "%13.11" ECU_ADDRESS 0x5B8E6A /end MEASUREMENT
/begin MEASUREMENT B_plok "Plausibilit‰t der FSE-Werte in allen Drehzahlbereichen gegeben" UBYTE B_TRUE 1 100 0 1 BIT_MASK 0x2 FORMAT "%13.11" ECU_ADDRESS 0x5B8BE3 /end MEASUREMENT
/begin MEASUREMENT B_ploka "Plausibilit‰t der FSE-Werte in allen Drehzahlbereichen gegeben (Array)" UBYTE default 1 100 0 1 FORMAT "%5.3" ARRAY_SIZE 9 ECU_ADDRESS 0x3FDB84 /end MEASUREMENT
/begin MEASUREMENT B_plra "Bedingung f¸r Umschaltung DKVS von HFM- auf P-System" UBYTE B_TRUE 1 100 0 1 BIT_MASK 0x1 FORMAT "%13.11" ECU_ADDRESS 0x3FBD5D /end MEASUREMENT
/begin MEASUREMENT B_readap "Reset der fuel-off Adaption" UBYTE B_TRUE 1 100 0 1 BIT_MASK 0x1 FORMAT "%13.11" ECU_ADDRESS 0x5B8B3A /end MEASUREMENT
/begin MEASUREMENT B_refmax "Beding. Sondenspg. im plausiblen Bereich zwischen USREF und USMAX vor KAT" UBYTE B_TRUE 1 100 0 1 BIT_MASK 0x1 FORMAT "%13.11" ECU_ADDRESS 0x3FBCE8 /end MEASUREMENT
/begin MEASUREMENT B_refmax2 "Beding. Sondenspg. im plausiblen Bereich zwischen USREF und USMAX vor KAT Bank2" UBYTE B_TRUE 1 100 0 1 BIT_MASK 0x1 FORMAT "%13.11" ECU_ADDRESS 0x3FBCE9 /end MEASUREMENT
/begin MEASUREMENT B_resreq "" UBYTE B_TRUE 1 100 0 1 BIT_MASK 0x1 FORMAT "%13.11" ECU_ADDRESS 0x5B861C /end MEASUREMENT
/begin MEASUREMENT B_risigh "Bedingung Signalunterbrechung Sondenmasse mit Ri-Diagnose hinter KAT" UBYTE B_TRUE 1 100 0 1 BIT_MASK 0x1 FORMAT "%13.11" ECU_ADDRESS 0x3FBCD7 /end MEASUREMENT
/begin MEASUREMENT B_risigv "Bedingung Signalunterbrechung Sondenmasse mit Ri-Diagnose vor KAT" UBYTE B_TRUE 1 100 0 1 BIT_MASK 0x1 FORMAT "%13.11" ECU_ADDRESS 0x3FBCEA /end MEASUREMENT
/begin MEASUREMENT B_risigv2 "Bedingung Signalunterbrechung Sondenmasse mit Ri-Diagnose vor KAT Bank2" UBYTE B_TRUE 1 100 0 1 BIT_MASK 0x1 FORMAT "%13.11" ECU_ADDRESS 0x3FBCEB /end MEASUREMENT
/begin MEASUREMENT B_rkam "Bedingung einer der beiden additiven Bereiche aktiv" UBYTE B_TRUE 1 100 0 1 BIT_MASK 0x1 FORMAT "%13.11" ECU_ADDRESS 0x3FBD5E /end MEASUREMENT
/begin MEASUREMENT B_rkamr "Bedingung rkat oder rkaz auﬂerhalb reduzierter Schwellen" UBYTE B_TRUE 1 100 0 1 BIT_MASK 0x1 FORMAT "%13.11" ECU_ADDRESS 0x3FBD5F /end MEASUREMENT
/begin MEASUREMENT B_sbbhk "Bedingung Sonde betriebsbereit hinter Kat" UBYTE B_TRUE 1 100 0 1 BIT_MASK 0x1 FORMAT "%13.11" ECU_ADDRESS 0x3FBCD8 /end MEASUREMENT
/begin MEASUREMENT B_sbbvk "Bedingung Sonde betriebsbereit vor Kat" UBYTE B_TRUE 1 100 0 1 BIT_MASK 0x1 FORMAT "%13.11" ECU_ADDRESS 0x3FBCEC /end MEASUREMENT
/begin MEASUREMENT B_sbbvk2 "Bedingung Sonde betriebsbereit vor Kat, Bank 2" UBYTE B_TRUE 1 100 0 1 BIT_MASK 0x1 FORMAT "%13.11" ECU_ADDRESS 0x3FBCED /end MEASUREMENT
/begin MEASUREMENT B_sigflsh "Signalunterbrechung (Kabelbruch) Bei Sonde hinter KAT erkannt" UBYTE B_TRUE 1 100 0 1 BIT_MASK 0x10 FORMAT "%13.11" ECU_ADDRESS 0x5B8E6D /end MEASUREMENT
/begin MEASUREMENT B_sigflsv "Signalunterbrechung (Kabelbruch) bei Sonde vor KAT erkannt" UBYTE B_TRUE 1 100 0 1 BIT_MASK 0x10 FORMAT "%13.11" ECU_ADDRESS 0x5B868A /end MEASUREMENT
/begin MEASUREMENT B_sigflsv2 "Signalunterbrechung (Kabelbruch) bei Sonde vor KAT erkannt Bank2" UBYTE B_TRUE 1 100 0 1 BIT_MASK 0x20 FORMAT "%13.11" ECU_ADDRESS 0x5B868A /end MEASUREMENT
/begin MEASUREMENT B_siglash "Bedingung Sonden-Fehler hinter KAT im Schub erkannt" UBYTE B_TRUE 1 100 0 1 BIT_MASK 0x1 FORMAT "%13.11" ECU_ADDRESS 0x5B8E6A /end MEASUREMENT
/begin MEASUREMENT B_steigm "Bedingung Steigung des Sondensignals messen hinter KAT" UBYTE B_TRUE 1 100 0 1 BIT_MASK 0x1 FORMAT "%13.11" ECU_ADDRESS 0x3FBCCE /end MEASUREMENT
/begin MEASUREMENT B_szkat "Zykluszeit und Fehler in einer Bank abgelaufen" UBYTE B_TRUE 1 100 0 1 BIT_MASK 0x1 FORMAT "%13.11" ECU_ADDRESS 0x3FBCA8 /end MEASUREMENT
/begin MEASUREMENT B_szkat2 "Zykluszeit und Fehler in Bank2 abgelaufen" UBYTE B_TRUE 1 100 0 1 BIT_MASK 0x1 FORMAT "%13.11" ECU_ADDRESS 0x3FBCA9 /end MEASUREMENT
/begin MEASUREMENT B_teslash "Bedingung Test ausf¸hren f¸r ‹berpr¸fung Sonde hinter KAT" UBYTE B_TRUE 1 100 0 1 BIT_MASK 0x1 FORMAT "%13.11" ECU_ADDRESS 0x3FBCCF /end MEASUREMENT
/begin MEASUREMENT B_tnalu "Testphase nach erkanntem Aussetzer l‰uft" UBYTE B_TRUE 1 100 0 1 BIT_MASK 0x1 FORMAT "%13.11" ECU_ADDRESS 0x5B8AE6 /end MEASUREMENT
/begin MEASUREMENT B_trfash "Bedingung Kurztrip einleiten f¸r Schwingungspr¸fung Sonde hinter KAT" UBYTE B_TRUE 1 100 0 1 BIT_MASK 0x1 FORMAT "%13.11" ECU_ADDRESS 0x3FBCD0 /end MEASUREMENT
/begin MEASUREMENT B_trig "Bedingung f¸r Umschaltung der Verst‰rkerstufen und Skalierung des Referenzpegels" UBYTE B_TRUE 1 100 0 1 BIT_MASK 0x1 FORMAT "%13.11" ECU_ADDRESS 0x3FBCAA /end MEASUREMENT
/begin MEASUREMENT B_trig2 "" UBYTE B_TRUE 1 100 0 1 BIT_MASK 0x1 FORMAT "%13.11" ECU_ADDRESS 0x3FBCAB /end MEASUREMENT
/begin MEASUREMENT B_trsa "Bedingung Kabelbruch f¸r Sonde vor KAT" UBYTE B_TRUE 1 100 0 1 BIT_MASK 0x4 FORMAT "%13.11" ECU_ADDRESS 0x5B8E6F /end MEASUREMENT
/begin MEASUREMENT B_trsa2 "Bedingung Kabelbruch f¸r Sonde vor KAT Bank2" UBYTE B_TRUE 1 100 0 1 BIT_MASK 0x8 FORMAT "%13.11" ECU_ADDRESS 0x5B8E6F /end MEASUREMENT
/begin MEASUREMENT B_trsah "Bedingung Kabelbruch f¸r Sonde hinter KAT" UWORD B_TRUE 1 100 0 1 BIT_MASK 0x10 FORMAT "%13.11" ECU_ADDRESS 0x5B90CC /end MEASUREMENT
/begin MEASUREMENT B_ttbmh "Bedingung theoretische Sondenbetriebsbereitschaft mit Heizung" UBYTE B_TRUE 1 100 0 1 BIT_MASK 0x1 FORMAT "%13.11" ECU_ADDRESS 0x3FBCEE /end MEASUREMENT
/begin MEASUREMENT B_ttbmh2 "Bedingung theoretische Sondenbetriebsbereitschaft mit Heizung  Bank2" UBYTE B_TRUE 1 100 0 1 BIT_MASK 0x1 FORMAT "%13.11" ECU_ADDRESS 0x3FBCEF /end MEASUREMENT
/begin MEASUREMENT B_ttbmhh "Bedingung theoretische Sondenbetriebsbereitschaft hinter KAT mit Heizung" UBYTE B_TRUE 1 100 0 1 BIT_MASK 0x1 FORMAT "%13.11" ECU_ADDRESS 0x3FBCD9 /end MEASUREMENT
/begin MEASUREMENT B_tuspn "Bedingung f¸r ‹bernahme der Halbperiode (Zeit zw. pos. und neg. Flanke)" UBYTE B_TRUE 1 100 0 1 BIT_MASK 0x1 FORMAT "%13.11" ECU_ADDRESS 0x5B8E6E /end MEASUREMENT
/begin MEASUREMENT B_tusre "Bedingung Resultat f¸r gefilterte Halbperiode f¸r Sonde vor KAT" UBYTE B_TRUE 1 100 0 1 BIT_MASK 0x2 FORMAT "%13.11" ECU_ADDRESS 0x5B8E6E /end MEASUREMENT
/begin MEASUREMENT B_ueinh "Beding. Vorbereitung z. Einsch. d. Sondenbetriebsbereitschaft hinter KAT" UWORD B_TRUE 1 100 0 1 BIT_MASK 0x1 FORMAT "%13.11" ECU_ADDRESS 0x5B90CC /end MEASUREMENT
/begin MEASUREMENT B_ueinv "Bedingung Vorbereitung zur Einschaltung der Sondenbetriebsbereitschaft vor KAT" UBYTE B_TRUE 1 100 0 1 BIT_MASK 0x1 FORMAT "%13.11" ECU_ADDRESS 0x3FBCF0 /end MEASUREMENT
/begin MEASUREMENT B_ueinv2 "Bedingung Vorbereitung zur Einschaltung der Sondenbetriebsbereitschaft v. KAT 2" UBYTE B_TRUE 1 100 0 1 BIT_MASK 0x1 FORMAT "%13.11" ECU_ADDRESS 0x3FBCF1 /end MEASUREMENT
/begin MEASUREMENT B_uhsig "Bedingung Sondenspannung hinter KAT im Spannungsband f¸r Signalunterbrechung" UWORD B_TRUE 1 100 0 1 BIT_MASK 0x4 FORMAT "%13.11" ECU_ADDRESS 0x5B90CC /end MEASUREMENT
/begin MEASUREMENT B_uscherf "Bedingung Messung Sondenspannung hinter KAT f¸r Schubmessung erf¸llt" UBYTE B_TRUE 1 100 0 1 BIT_MASK 0x1 FORMAT "%13.11" ECU_ADDRESS 0x5B8E69 /end MEASUREMENT
/begin MEASUREMENT B_ushkf "Bedingung Sondenspannung hinter Kat ""Fett"" (Sollwert ¸berschritten)" UBYTE B_TRUE 1 100 0 1 BIT_MASK 0x1 FORMAT "%13.11" ECU_ADDRESS 0x3FBCD1 /end MEASUREMENT
/begin MEASUREMENT B_ushkm "Bedingung Sondenspannung hinter KAT ""Mager"" (Sollwert unterschritten)" UBYTE B_TRUE 1 100 0 1 BIT_MASK 0x1 FORMAT "%13.11" ECU_ADDRESS 0x3FBCD2 /end MEASUREMENT
/begin MEASUREMENT B_ushkrfm "Bedingung f¸r Wiederholungsmessung Schwingungspr. h. KAT (Reset F/M -Flip-Flop)" UBYTE B_TRUE 1 100 0 1 BIT_MASK 0x8 FORMAT "%13.11" ECU_ADDRESS 0x5B8E68 /end MEASUREMENT
/begin MEASUREMENT B_ushkvl "Bed. Schwelle f¸r Sonde h. KAT bei Vollast nicht ¸berschritten `statichisch`" UBYTE B_TRUE 1 100 0 1 BIT_MASK 0x40 FORMAT "%13.11" ECU_ADDRESS 0x3FDBC0 /end MEASUREMENT
/begin MEASUREMENT B_ushsch "Bed. Schwelle f¸r Sonde h. KAT im Schub nicht unterschritten `statichisch`" UBYTE B_TRUE 1 100 0 1 BIT_MASK 0x4 FORMAT "%13.11" ECU_ADDRESS 0x3FDBC0 /end MEASUREMENT
/begin MEASUREMENT B_usrhkmx "Bedingung f¸r fehlerhafte Sonden hinter KAT nach abgeschlossenem Test" UBYTE B_TRUE 1 100 0 1 BIT_MASK 0x10 FORMAT "%13.11" ECU_ADDRESS 0x3FDBC0 /end MEASUREMENT
/begin MEASUREMENT B_uvsig "Bedingung Sondenspannung vor KAT im Spannungsband f¸r Signalunterbrechung" UBYTE B_TRUE 1 100 0 1 BIT_MASK 0x1 FORMAT "%13.11" ECU_ADDRESS 0x5B8E6F /end MEASUREMENT
/begin MEASUREMENT B_uvsig2 "Bedingung Sondenspg. vor KAT im Spannungsband f¸r Signalunterbrechung Bank2" UBYTE B_TRUE 1 100 0 1 BIT_MASK 0x2 FORMAT "%13.11" ECU_ADDRESS 0x5B8E6F /end MEASUREMENT
/begin MEASUREMENT B_vadge "Bedingung Verdacht auf Adernschluﬂ oder Gemischfehler" UBYTE B_TRUE 1 100 0 1 BIT_MASK 0x1 FORMAT "%13.11" ECU_ADDRESS 0x3FBCF2 /end MEASUREMENT
/begin MEASUREMENT B_vadge2 "Bedingung Verdacht auf Adernschluﬂ oder Gemischfehler Bank2" UBYTE B_TRUE 1 100 0 1 BIT_MASK 0x1 FORMAT "%13.11" ECU_ADDRESS 0x3FBCF3 /end MEASUREMENT
/begin MEASUREMENT B_vgeflr "Bedingung Verdacht auf Gemischfehler" UWORD B_TRUE 1 100 0 1 BIT_MASK 0x1000 FORMAT "%13.11" ECU_ADDRESS 0x3FDBCA /end MEASUREMENT
/begin MEASUREMENT B_vgeflr2 "Bedingung Verdacht auf Gemischfehler Bank 2" UWORD B_TRUE 1 100 0 1 BIT_MASK 0x2000 FORMAT "%13.11" ECU_ADDRESS 0x3FDBCA /end MEASUREMENT
/begin MEASUREMENT B_zfrao "wenn gleich TRUE, dann ist FRAO gepr¸ft" UBYTE B_TRUE 1 100 0 1 BIT_MASK 0x4 FORMAT "%13.11" ECU_ADDRESS 0x5B872E /end MEASUREMENT
/begin MEASUREMENT B_zfrau "wenn gleich TRUE, dann ist FRAU gepr¸ft" UBYTE B_TRUE 1 100 0 1 BIT_MASK 0x2 FORMAT "%13.11" ECU_ADDRESS 0x5B872E /end MEASUREMENT
/begin MEASUREMENT B_zkatb "Bankspezifische Zykluszeit f¸r MODE 6" UBYTE B_TRUE 1 100 0 1 BIT_MASK 0x1 FORMAT "%13.11" ECU_ADDRESS 0x3FBCAC /end MEASUREMENT
/begin MEASUREMENT B_zkatb2 "Bankspezifische Zykluszeit f¸r MODE 6 (stereo 2.Bank)" UBYTE B_TRUE 1 100 0 1 BIT_MASK 0x1 FORMAT "%13.11" ECU_ADDRESS 0x3FBCAD /end MEASUREMENT
/begin MEASUREMENT B_zkats "Zykluszeit f¸r eine Bank abgelaufen" UBYTE B_TRUE 1 100 0 1 BIT_MASK 0x1 FORMAT "%13.11" ECU_ADDRESS 0x3FBCAE /end MEASUREMENT
/begin MEASUREMENT B_zkats2 "Zykluszeit f¸r 2. Bank abgelaufen" UBYTE B_TRUE 1 100 0 1 BIT_MASK 0x1 FORMAT "%13.11" ECU_ADDRESS 0x3FBCAF /end MEASUREMENT
/begin MEASUREMENT B_zkatz "Bedinging f¸r Summenfehler im MODE 6" UBYTE B_TRUE 1 100 0 1 BIT_MASK 0x1 FORMAT "%13.11" ECU_ADDRESS 0x3FBCB0 /end MEASUREMENT
/begin MEASUREMENT B_zkatz2 "Bedingung f¸r Summenfehler im MODE 6 (Stereo 2.Bank)" UBYTE B_TRUE 1 100 0 1 BIT_MASK 0x1 FORMAT "%13.11" ECU_ADDRESS 0x3FBCB1 /end MEASUREMENT
/begin MEASUREMENT B_zrkat "wenn gleich TRUE, dann ist RKAT gepr¸ft" UBYTE B_TRUE 1 100 0 1 BIT_MASK 0x8 FORMAT "%13.11" ECU_ADDRESS 0x5B872E /end MEASUREMENT
/begin MEASUREMENT B_zrkaz "wenn gleich TRUE, dann ist RKAZ gepr¸ft" UBYTE B_TRUE 1 100 0 1 BIT_MASK 0x10 FORMAT "%13.11" ECU_ADDRESS 0x5B872E /end MEASUREMENT
/begin MEASUREMENT B_zylind "zeigt, ob zylinderindividuelles (1) oder segmentweises (0) Lernen (nur fuel-off)" UBYTE B_TRUE 1 100 0 1 BIT_MASK 0x1 FORMAT "%13.11" ECU_ADDRESS 0x5B8572 /end MEASUREMENT
/begin MEASUREMENT case_nr "" UBYTE dez 1 100 0 255 FORMAT "%5.1" ECU_ADDRESS 0x5B8BE0 /end MEASUREMENT
/begin MEASUREMENT cfof "zeigt die Eigenschaften des aktuellen KF-Bereiches der Fuel-off Adaption" UBYTE dez 1 100 0 255 FORMAT "%5.1" ECU_ADDRESS 0x5B8578 /end MEASUREMENT
/begin MEASUREMENT cfoxx "zeigt die Eigenschaften des aktuellen KF-Bereiches der Fuel-on/-off Adaption" UBYTE dez 1 100 0 255 FORMAT "%5.1" ECU_ADDRESS 0x5B8BE1 /end MEASUREMENT
/begin MEASUREMENT convert1_f "" FLOAT32_IEEE fak_r32_1 1 100 -1e+037 1e+037 FORMAT "%43.4" ECU_ADDRESS 0x5B8524 /end MEASUREMENT
/begin MEASUREMENT convert2_f "" FLOAT32_IEEE fak_r32_1 1 100 -1e+037 1e+037 FORMAT "%43.4" ECU_ADDRESS 0x5B8528 /end MEASUREMENT
/begin MEASUREMENT convert_f "" FLOAT32_IEEE fak_r32_1 1 100 -1e+037 1e+037 FORMAT "%43.4" ECU_ADDRESS 0x5B852C /end MEASUREMENT
/begin MEASUREMENT dfseresz_w "Resetz‰hler Plausibilit‰tspr¸fung FSE" UWORD dez 1 100 0 65535 FORMAT "%8.2" ECU_ADDRESS 0x3FDB46 /end MEASUREMENT
/begin MEASUREMENT dfse_f "Differenz Adaptionswerte der fuel-on Adaption in bestimmtem Drehzahlbereich" FLOAT32_IEEE fak_r32_1 1 100 -1e+037 1e+037 FORMAT "%43.4" ARRAY_SIZE 9 ECU_ADDRESS 0x3FA954 /end MEASUREMENT
/begin MEASUREMENT dkatakt2_w "aktive ‹berwachungszeit f¸r DKAT (Steroe 2.Bank)" UWORD t50msxs_uw_b3276p75 1 100 0 3276.75 FORMAT "%8.3" ECU_ADDRESS 0x5B90B6 /end MEASUREMENT
/begin MEASUREMENT dkatakt_w "aktive ‹berwachungszeit f¸r DKAT" UWORD t50msxs_uw_b3276p75 1 100 0 3276.75 FORMAT "%8.3" ECU_ADDRESS 0x5B90B8 /end MEASUREMENT
/begin MEASUREMENT DKVSbits "" UBYTE dez 1 100 0 255 FORMAT "%5.1" ECU_ADDRESS 0x3FDC1A /end MEASUREMENT
/begin MEASUREMENT DKVSlokbits "" UBYTE dez 1 100 0 255 FORMAT "%5.1" ECU_ADDRESS 0x5B872E /end MEASUREMENT
/begin MEASUREMENT dlams_w "Maximalwert Lambdasoll f¸r Test Schwingungspr¸fung hinter KAT" UWORD fak_uw_b16 1 100 0 15.9998 FORMAT "%8.5" ECU_ADDRESS 0x5B866E /end MEASUREMENT
/begin MEASUREMENT DLSHerrors "" UBYTE dez 1 100 0 255 FORMAT "%5.1" ECU_ADDRESS 0x5B8E6D /end MEASUREMENT
/begin MEASUREMENT DLSHintbits "" UWORD dez 1 100 0 65535 FORMAT "%8.2" ECU_ADDRESS 0x5B90CC /end MEASUREMENT
/begin MEASUREMENT dlssabits "" UBYTE dez 1 100 0 255 FORMAT "%5.1" ECU_ADDRESS 0x5B8E6E /end MEASUREMENT
/begin MEASUREMENT DLSVbits "" UWORD dez 1 100 0 65535 FORMAT "%8.2" ECU_ADDRESS 0x3FDBCA /end MEASUREMENT
/begin MEASUREMENT DLSVerrors "" UBYTE dez 1 100 0 255 FORMAT "%5.1" ECU_ADDRESS 0x5B868A /end MEASUREMENT
/begin MEASUREMENT DLSVintbits "" UBYTE dez 1 100 0 255 FORMAT "%5.1" ECU_ADDRESS 0x5B8E6F /end MEASUREMENT
/begin MEASUREMENT dlursalt_f "" FLOAT32_IEEE fak_r32_1 1 100 -1e+037 1e+037 FORMAT "%43.4" ECU_ADDRESS 0x3FA608 /end MEASUREMENT
/begin MEASUREMENT dlurs_f "Laufunruhedifferenz-Referenzwert, signed" FLOAT32_IEEE fak_r32_1 1 100 -1e+037 1e+037 FORMAT "%43.4" ECU_ADDRESS 0x3FA60C /end MEASUREMENT
/begin MEASUREMENT dlutsk_f "Laufunruhedifferenz-Testgrˆﬂe, korrigiert" FLOAT32_IEEE fak_r32_1 1 100 -1e+037 1e+037 FORMAT "%43.4" ECU_ADDRESS 0x3FA7F0 /end MEASUREMENT
/begin MEASUREMENT dluts_f "Laufunruhedifferenz-Testgrˆﬂe, signed" FLOAT32_IEEE fak_r32_1 1 100 -1e+037 1e+037 FORMAT "%43.4" ECU_ADDRESS 0x3FA628 /end MEASUREMENT
/begin MEASUREMENT dmrdkt_w "Momenten-Reserve f¸r Katalysatordiagnose" UWORD rel_uw_b100 1 100 0 99.9985 FORMAT "%8.5" ECU_ADDRESS 0x5B8664 /end MEASUREMENT
/begin MEASUREMENT dmrlash_w "Momenten-Reserve f¸r Lambdasonden-Alterungs¸berwachung hinter Kat" UWORD rel_uw_b100 1 100 0 99.9985 FORMAT "%8.5" ECU_ADDRESS 0x5B8670 /end MEASUREMENT
/begin MEASUREMENT dmrlsh_w "Momenten-Reserve f¸r Sondendiagnose hinter Kat" UWORD rel_uw_b100 1 100 0 99.9985 FORMAT "%8.5" ECU_ADDRESS 0x5B8676 /end MEASUREMENT
/begin MEASUREMENT dtsarray_f "Differenzen zur Medianbildung/Dynamikkompensation, DMD" FLOAT32_IEEE fak_r32_1 1 100 -1e+037 1e+037 FORMAT "%43.4" ARRAY_SIZE 5 ECU_ADDRESS 0x3FA62C /end MEASUREMENT
/begin MEASUREMENT dtsk_f "" FLOAT32_IEEE fak_r32_1 1 100 -1e+037 1e+037 FORMAT "%43.4" ECU_ADDRESS 0x3FA640 /end MEASUREMENT
/begin MEASUREMENT erg1 "" FLOAT32_IEEE fak_r32_1 1 100 -1e+037 1e+037 FORMAT "%43.4" ECU_ADDRESS 0x3FA980 /end MEASUREMENT
/begin MEASUREMENT erg2 "" FLOAT32_IEEE fak_r32_1 1 100 -1e+037 1e+037 FORMAT "%43.4" ECU_ADDRESS 0x3FA984 /end MEASUREMENT
/begin MEASUREMENT esst_snm06dmuw1 "" ULONG dez 1 100 0 4.29497e+009 FORMAT "%13.2" ECU_ADDRESS 0x5B9998 /end MEASUREMENT
/begin MEASUREMENT esst_snm06dmuw2 "" ULONG dez 1 100 0 4.29497e+009 FORMAT "%13.2" ECU_ADDRESS 0x5B999C /end MEASUREMENT
/begin MEASUREMENT esst_snm10dmuw1 "" ULONG dez 1 100 0 4.29497e+009 FORMAT "%13.2" ECU_ADDRESS 0x5B99A0 /end MEASUREMENT
/begin MEASUREMENT esst_snm10dmuw2 "" ULONG dez 1 100 0 4.29497e+009 FORMAT "%13.2" ECU_ADDRESS 0x5B99A4 /end MEASUREMENT
/begin MEASUREMENT esst_srl05dmub1 "" ULONG dez 1 100 0 4.29497e+009 FORMAT "%13.2" ECU_ADDRESS 0x5B99A8 /end MEASUREMENT
/begin MEASUREMENT esst_srl05dmub2 "" ULONG dez 1 100 0 4.29497e+009 FORMAT "%13.2" ECU_ADDRESS 0x5B99AC /end MEASUREMENT
/begin MEASUREMENT E_hlpkrnt "Hilfserrorflag: Klopfregelung Nulltest" UBYTE B_TRUE 1 100 0 1 BIT_MASK 0x1 FORMAT "%13.11" ECU_ADDRESS 0x3FBE40 /end MEASUREMENT
/begin MEASUREMENT E_hlpkrof "Hilfserrorfleg: Klopfregelung Offset" UBYTE B_TRUE 1 100 0 1 BIT_MASK 0x1 FORMAT "%13.11" ECU_ADDRESS 0x3FBE41 /end MEASUREMENT
/begin MEASUREMENT E_hlpkrtp "Hilfserrorflag: Klopfregelung Testimpuls" UBYTE B_TRUE 1 100 0 1 BIT_MASK 0x1 FORMAT "%13.11" ECU_ADDRESS 0x3FBE45 /end MEASUREMENT
/begin MEASUREMENT falrdkt "Anforderung Katdiagnose: Modifikation der Lambdregelungsamplitude" UBYTE fak_ub_b8 1 100 0 7.96875 FORMAT "%5.3" ECU_ADDRESS 0x5B8E57 /end MEASUREMENT
/begin MEASUREMENT famal_f "Faktor zur Absenkung des LUR-Wertes bei Mehrfachaussetzern, aus KFFAMALU" FLOAT32_IEEE fak_r32_1 1 100 -1e+037 1e+037 FORMAT "%43.4" ECU_ADDRESS 0x3FA878 /end MEASUREMENT
/begin MEASUREMENT fanalun "" UBYTE dez 1 100 0 255 FORMAT "%5.1" ECU_ADDRESS 0x5B8B93 /end MEASUREMENT
/begin MEASUREMENT fdlurmin_f "Offset zur Differenzlaufunruhe bei unzureichender Adaption, aus DLURMIN" FLOAT32_IEEE fak_r32_1 1 100 -1e+037 1e+037 FORMAT "%43.4" ECU_ADDRESS 0x3FA610 /end MEASUREMENT
/begin MEASUREMENT fflutn_f "Filterfaktor ¸ber n f¸r Filterung der Laufunruhe" FLOAT32_IEEE fak_r32_1 1 100 -1e+037 1e+037 FORMAT "%43.4" ECU_ADDRESS 0x5B8530 /end MEASUREMENT
/begin MEASUREMENT ffon1 "Statusbyte 1 ‹bersicht fuel-on Adaption" UBYTE dez 1 100 0 255 FORMAT "%5.1" ECU_ADDRESS 0x5B8BE2 /end MEASUREMENT
/begin MEASUREMENT ffon2 "Statusbyte 2 ‹bersicht fuel-on Adaption" UBYTE dez 1 100 0 255 FORMAT "%5.1" ECU_ADDRESS 0x5B8BE3 /end MEASUREMENT
/begin MEASUREMENT fkfamal1_f "Absenkungsfaktor f¸r Laufunruheschwellwert bei Mehrfachaussetzern, aus KFAMAL" FLOAT32_IEEE fak_r32_1 1 100 -1e+037 1e+037 FORMAT "%43.4" ECU_ADDRESS 0x3FA87C /end MEASUREMENT
/begin MEASUREMENT fkfamal2_f "Absenkungsfaktor f¸r Laufunruheschwellwert bei Mehrfachaussetzern, aus KFAMAL" FLOAT32_IEEE fak_r32_1 1 100 -1e+037 1e+037 FORMAT "%43.4" ECU_ADDRESS 0x3FA880 /end MEASUREMENT
/begin MEASUREMENT fkfamal_f "Absenkungsfaktor f¸r Laufunruheschwellwert bei Mehrfachaussetzern, aus KFAMAL" FLOAT32_IEEE fak_r32_1 1 100 -1e+037 1e+037 FORMAT "%43.4" ECU_ADDRESS 0x3FA884 /end MEASUREMENT
/begin MEASUREMENT fkfdlur1_f "Basis Schwellwert f¸r Differenzlaufunruhe bei B_wk=1, Faktor aus KFDLUR1" FLOAT32_IEEE fak_r32_1 1 100 -1e+037 1e+037 FORMAT "%43.4" ECU_ADDRESS 0x3FA614 /end MEASUREMENT
/begin MEASUREMENT fkfdlur2_f "Basis Schwellwert f¸r Differenzlaufunruhe bei B_wkr=1, Faktor aus KFDLUR2" FLOAT32_IEEE fak_r32_1 1 100 -1e+037 1e+037 FORMAT "%43.4" ECU_ADDRESS 0x3FA618 /end MEASUREMENT
/begin MEASUREMENT fkfdlurs_f "Basis Schwellwert f¸r Differenzlaufunruhe bei B_sch=1, Faktor aus KFDLURS" FLOAT32_IEEE fak_r32_1 1 100 -1e+037 1e+037 FORMAT "%43.4" ECU_ADDRESS 0x3FA61C /end MEASUREMENT
/begin MEASUREMENT fkfdlur_f "Basis Schwellwert f¸r Differenzlaufunruhe, Faktor aus KFDLUR" FLOAT32_IEEE fak_r32_1 1 100 -1e+037 1e+037 FORMAT "%43.4" ECU_ADDRESS 0x3FA620 /end MEASUREMENT
/begin MEASUREMENT fkfluar1_f "Basis Schwellwert f¸r Laufunruhe-Abstandsmass, Faktor aus KFLUAR1" FLOAT32_IEEE fak_r32_1 1 100 -1e+037 1e+037 FORMAT "%43.4" ECU_ADDRESS 0x3FA8D8 /end MEASUREMENT
/begin MEASUREMENT fkfluar2_f "Basis Schwellwert f¸r Laufunruhe-Abstandsmass, Faktor aus KFLUAR2" FLOAT32_IEEE fak_r32_1 1 100 -1e+037 1e+037 FORMAT "%43.4" ECU_ADDRESS 0x3FA8DC /end MEASUREMENT
/begin MEASUREMENT fkfluars_f "Basis Schwellwert f¸r Laufunruhe-Abstandsmass, Faktor aus KFLUARS" FLOAT32_IEEE fak_r32_1 1 100 -1e+037 1e+037 FORMAT "%43.4" ECU_ADDRESS 0x3FA8E0 /end MEASUREMENT
/begin MEASUREMENT fkfluar_f "Basis Schwellwert f¸r Laufunruhe-Abstandsmass, Faktor aus KFLUAR" FLOAT32_IEEE fak_r32_1 1 100 -1e+037 1e+037 FORMAT "%43.4" ECU_ADDRESS 0x3FA8E4 /end MEASUREMENT
/begin MEASUREMENT fkflurb1_f "Basis Schwellwert f¸r Laufunruhe, Faktor aus KFLURB1" FLOAT32_IEEE fak_r32_1 1 100 -1e+037 1e+037 FORMAT "%43.4" ECU_ADDRESS 0x3FA888 /end MEASUREMENT
/begin MEASUREMENT fkflurb2_f "Basis Schwellwert f¸r Laufunruhe, Faktor aus KFLURB2" FLOAT32_IEEE fak_r32_1 1 100 -1e+037 1e+037 FORMAT "%43.4" ECU_ADDRESS 0x3FA88C /end MEASUREMENT
/begin MEASUREMENT fkflurbs_f "Basis Schwellwert f¸r Laufunruhe, Faktor aus KFLURBS" FLOAT32_IEEE fak_r32_1 1 100 -1e+037 1e+037 FORMAT "%43.4" ECU_ADDRESS 0x3FA890 /end MEASUREMENT
/begin MEASUREMENT fkflurb_f "Basis Schwellwert f¸r Laufunruhe, Faktor aus KFLURB" FLOAT32_IEEE fak_r32_1 1 100 -1e+037 1e+037 FORMAT "%43.4" ECU_ADDRESS 0x3FA894 /end MEASUREMENT
/begin MEASUREMENT fkflurm1_f "Faktor f¸r Laufunruhe-Referenzwert zur Mehrfachaussetzererkennung ->Lum-Vergl." FLOAT32_IEEE fak_r32_1 1 100 -1e+037 1e+037 FORMAT "%43.4" ECU_ADDRESS 0x3FA898 /end MEASUREMENT
/begin MEASUREMENT fkflurm_f "Faktor f¸r Laufunruhe-Referenzwert zur Mehrfachaussetzererkennung ->Lum-Vergl." FLOAT32_IEEE fak_r32_1 1 100 -1e+037 1e+037 FORMAT "%43.4" ECU_ADDRESS 0x3FA89C /end MEASUREMENT
/begin MEASUREMENT flmxof_f "aktuell maximaler Lernfilterwert" FLOAT32_IEEE fak_r32_1 1 100 -1e+037 1e+037 FORMAT "%43.4" ECU_ADDRESS 0x5B857C /end MEASUREMENT
/begin MEASUREMENT flmx_f "aktuell maximaler Lernfilterwert" FLOAT32_IEEE fak_r32_1 1 100 -1e+037 1e+037 FORMAT "%43.4" ECU_ADDRESS 0x3FA988 /end MEASUREMENT
/begin MEASUREMENT fln00_f "Lernfilterwert, negativ, Zyl. 0" FLOAT32_IEEE fak_r32_1 1 100 -1e+037 1e+037 FORMAT "%43.4" ARRAY_SIZE 24 ECU_ADDRESS 0x3FD104 /end MEASUREMENT
/begin MEASUREMENT fln01_f "Lernfilterwert, negativ, Zyl. 1" FLOAT32_IEEE fak_r32_1 1 100 -1e+037 1e+037 FORMAT "%43.4" ARRAY_SIZE 24 ECU_ADDRESS 0x3FD164 /end MEASUREMENT
/begin MEASUREMENT fln02_f "Lernfilterwert, negativ, Zyl. 2" FLOAT32_IEEE fak_r32_1 1 100 -1e+037 1e+037 FORMAT "%43.4" ARRAY_SIZE 24 ECU_ADDRESS 0x3FD1C4 /end MEASUREMENT
/begin MEASUREMENT fln03_f "Lernfilterwert, negativ, Zyl. 3" FLOAT32_IEEE fak_r32_1 1 100 -1e+037 1e+037 FORMAT "%43.4" ARRAY_SIZE 24 ECU_ADDRESS 0x3FD224 /end MEASUREMENT
/begin MEASUREMENT flnof1_f "Lernfilterwert, negativ, Drehzahlbereich 1" FLOAT32_IEEE fak_r32_1 1 100 -1e+037 1e+037 FORMAT "%43.4" ARRAY_SIZE 12 ECU_ADDRESS 0x3FD844 /end MEASUREMENT
/begin MEASUREMENT flnof2_f "Lernfilterwert, negativ, Drehzahlbereich 2" FLOAT32_IEEE fak_r32_1 1 100 -1e+037 1e+037 FORMAT "%43.4" ARRAY_SIZE 12 ECU_ADDRESS 0x3FD874 /end MEASUREMENT
/begin MEASUREMENT flnof3_f "Lernfilterwert, negativ, Drehzahlbereich 3" FLOAT32_IEEE fak_r32_1 1 100 -1e+037 1e+037 FORMAT "%43.4" ARRAY_SIZE 12 ECU_ADDRESS 0x3FD8A4 /end MEASUREMENT
/begin MEASUREMENT flnof4_f "Lernfilterwert, negativ, Drehzahlbereich 4" FLOAT32_IEEE fak_r32_1 1 100 -1e+037 1e+037 FORMAT "%43.4" ARRAY_SIZE 12 ECU_ADDRESS 0x3FD8D4 /end MEASUREMENT
/begin MEASUREMENT flp00_f "Lernfilterwert, positiv, Zyl. 0" FLOAT32_IEEE fak_r32_1 1 100 -1e+037 1e+037 FORMAT "%43.4" ARRAY_SIZE 24 ECU_ADDRESS 0x3FD284 /end MEASUREMENT
/begin MEASUREMENT flp01_f "Lernfilterwert, positiv, Zyl. 1" FLOAT32_IEEE fak_r32_1 1 100 -1e+037 1e+037 FORMAT "%43.4" ARRAY_SIZE 24 ECU_ADDRESS 0x3FD2E4 /end MEASUREMENT
/begin MEASUREMENT flp02_f "Lernfilterwert, positiv, Zyl. 2" FLOAT32_IEEE fak_r32_1 1 100 -1e+037 1e+037 FORMAT "%43.4" ARRAY_SIZE 24 ECU_ADDRESS 0x3FD344 /end MEASUREMENT
/begin MEASUREMENT flp03_f "Lernfilterwert, positiv, Zyl. 3" FLOAT32_IEEE fak_r32_1 1 100 -1e+037 1e+037 FORMAT "%43.4" ARRAY_SIZE 24 ECU_ADDRESS 0x3FD3A4 /end MEASUREMENT
/begin MEASUREMENT flpof1_f "Lernfilterwert, positiv, Drehzahlbereich 1" FLOAT32_IEEE fak_r32_1 1 100 -1e+037 1e+037 FORMAT "%43.4" ARRAY_SIZE 12 ECU_ADDRESS 0x3FD904 /end MEASUREMENT
/begin MEASUREMENT flpof2_f "Lernfilterwert, positiv, Drehzahlbereich 2" FLOAT32_IEEE fak_r32_1 1 100 -1e+037 1e+037 FORMAT "%43.4" ARRAY_SIZE 12 ECU_ADDRESS 0x3FD934 /end MEASUREMENT
/begin MEASUREMENT flpof3_f "Lernfilterwert, positiv, Drehzahlbereich 3" FLOAT32_IEEE fak_r32_1 1 100 -1e+037 1e+037 FORMAT "%43.4" ARRAY_SIZE 12 ECU_ADDRESS 0x3FD964 /end MEASUREMENT
/begin MEASUREMENT flpof4_f "Lernfilterwert, positiv, Drehzahlbereich 4" FLOAT32_IEEE fak_r32_1 1 100 -1e+037 1e+037 FORMAT "%43.4" ARRAY_SIZE 12 ECU_ADDRESS 0x3FD994 /end MEASUREMENT
/begin MEASUREMENT flurbrl_f "Laufunruhe-Referenzwert bei Fahrzeug steht" FLOAT32_IEEE fak_r32_1 1 100 -1e+037 1e+037 FORMAT "%43.4" ECU_ADDRESS 0x3FA8A0 /end MEASUREMENT
/begin MEASUREMENT flurktm_f "tmot-abh‰ngiger offset zum Laufunruhe-Referenzwert lurs/dlurs" FLOAT32_IEEE fak_r32_1 1 100 -1e+037 1e+037 FORMAT "%43.4" ECU_ADDRESS 0x3FA8A4 /end MEASUREMENT
/begin MEASUREMENT flurmin1_f "Drehzahlabh. Laufunruhe-Referenz-Minimalwert 1" FLOAT32_IEEE fak_r32_1 1 100 -1e+037 1e+037 FORMAT "%43.4" ECU_ADDRESS 0x3FA8A8 /end MEASUREMENT
/begin MEASUREMENT flurmin2_f "Drehzahlabh. Laufunruhe-Referenz-Minimalwert 2" FLOAT32_IEEE fak_r32_1 1 100 -1e+037 1e+037 FORMAT "%43.4" ECU_ADDRESS 0x3FA8AC /end MEASUREMENT
/begin MEASUREMENT flurmin3_f "Drehzahlabh. Laufunruhe-Referenz-Minimalwert 3" FLOAT32_IEEE fak_r32_1 1 100 -1e+037 1e+037 FORMAT "%43.4" ECU_ADDRESS 0x3FA8B0 /end MEASUREMENT
/begin MEASUREMENT flurmin_f "Wert von LUR falls Adaption nicht abgeschlossen, Wert aus LURMINN" FLOAT32_IEEE fak_r32_1 1 100 -1e+037 1e+037 FORMAT "%43.4" ECU_ADDRESS 0x3FA8B4 /end MEASUREMENT
/begin MEASUREMENT flurst_f "Korrekturfaktor f¸r Schwellwert Laufunruhe nach Start, Faktor aus LURST" FLOAT32_IEEE fak_r32_1 1 100 -1e+037 1e+037 FORMAT "%43.4" ECU_ADDRESS 0x3FA8B8 /end MEASUREMENT
/begin MEASUREMENT flutskzy_f "Filter der Laufunruhe-Testgrˆﬂe, korrigiert, Array ¸ber alle Zylinder" FLOAT32_IEEE fak_r32_1 1 100 -1e+037 1e+037 FORMAT "%43.4" ARRAY_SIZE 12 ECU_ADDRESS 0x3FA7F4 /end MEASUREMENT
/begin MEASUREMENT flutsk_f "Filter der Laufunruhe-Testgrˆﬂe, korrigiert" FLOAT32_IEEE fak_r32_1 1 100 -1e+037 1e+037 FORMAT "%43.4" ECU_ADDRESS 0x3FA824 /end MEASUREMENT
/begin MEASUREMENT flutszyl_f "Filter der Laufunruhe-Testgrˆﬂe, Array ¸ber alle Zylinder" FLOAT32_IEEE fak_r32_1 1 100 -1e+037 1e+037 FORMAT "%43.4" ARRAY_SIZE 12 ECU_ADDRESS 0x3FA644 /end MEASUREMENT
/begin MEASUREMENT fluts_f "Filter der Laufunruhe-Testgrˆﬂe" FLOAT32_IEEE fak_r32_1 1 100 -1e+037 1e+037 FORMAT "%43.4" ECU_ADDRESS 0x3FA674 /end MEASUREMENT
/begin MEASUREMENT fofresz "Resetz‰hler Lernfilterwert weggelaufen (Fuel-on Adaption)" UWORD dez 1 100 0 65535 FORMAT "%8.2" ECU_ADDRESS 0x3FD83E /end MEASUREMENT
/begin MEASUREMENT fofstat "Status der fuel-off Adaption im aktuellen Betriebsbereich" UBYTE dez 1 100 0 2 FORMAT "%5.3" ECU_ADDRESS 0x3FD840 /end MEASUREMENT
/begin MEASUREMENT fofstat_loc "" UBYTE dez 1 100 0 255 FORMAT "%5.1" ECU_ADDRESS 0x5B8BB8 /end MEASUREMENT
/begin MEASUREMENT fonstat "Status der fuel-on Adaption im aktuellen Betriebsbereich" UBYTE dez 1 100 0 255 FORMAT "%5.1" ECU_ADDRESS 0x3FDB8D /end MEASUREMENT
/begin MEASUREMENT fonstat_loc "" UBYTE dez 1 100 0 255 FORMAT "%5.1" ECU_ADDRESS 0x5B8BB9 /end MEASUREMENT
/begin MEASUREMENT frauzs_w "multiplikativer Gemischadaptionsfaktor unterer mult. Bereich (alter Wert)" UWORD fak_uw_b2 1 100 0 1.99997 FORMAT "%8.6" ECU_ADDRESS 0x5B8730 /end MEASUREMENT
/begin MEASUREMENT fs00_f "Filterwert Laufunruheabweichung, Zyl. 0" FLOAT32_IEEE fak_r32_1 1 100 -1e+037 1e+037 FORMAT "%43.4" ARRAY_SIZE 24 ECU_ADDRESS 0x3FD404 /end MEASUREMENT
/begin MEASUREMENT fs01_f "Filterwert Segmentabweichung, Zyl. 1" FLOAT32_IEEE fak_r32_1 1 100 -1e+037 1e+037 FORMAT "%43.4" ARRAY_SIZE 24 ECU_ADDRESS 0x3FD464 /end MEASUREMENT
/begin MEASUREMENT fs02_f "Filterwert Laufunruheabweichung, Zyl. 2" FLOAT32_IEEE fak_r32_1 1 100 -1e+037 1e+037 FORMAT "%43.4" ARRAY_SIZE 24 ECU_ADDRESS 0x3FD4C4 /end MEASUREMENT
/begin MEASUREMENT fs03_f "Filterwert Laufunruheabweichung, Zyl. 3" FLOAT32_IEEE fak_r32_1 1 100 -1e+037 1e+037 FORMAT "%43.4" ARRAY_SIZE 24 ECU_ADDRESS 0x3FD524 /end MEASUREMENT
/begin MEASUREMENT fse00_f "Filterwert Laufunruheabweichung, eingerechnet, Zyl. 0" FLOAT32_IEEE fak_r32_1 1 100 -1e+037 1e+037 FORMAT "%43.4" ARRAY_SIZE 24 ECU_ADDRESS 0x3FD584 /end MEASUREMENT
/begin MEASUREMENT fse01_f "Filterwert Laufunruheabweichung, eingerechnet, Zyl. 1" FLOAT32_IEEE fak_r32_1 1 100 -1e+037 1e+037 FORMAT "%43.4" ARRAY_SIZE 24 ECU_ADDRESS 0x3FD5E4 /end MEASUREMENT
/begin MEASUREMENT fse02_f "Filterwert Laufunruheabweichung, eingerechnet, Zyl. 2" FLOAT32_IEEE fak_r32_1 1 100 -1e+037 1e+037 FORMAT "%43.4" ARRAY_SIZE 24 ECU_ADDRESS 0x3FD644 /end MEASUREMENT
/begin MEASUREMENT fse03_f "Filterwert Laufunruheabweichung, eingerechnet, Zyl. 3" FLOAT32_IEEE fak_r32_1 1 100 -1e+037 1e+037 FORMAT "%43.4" ARRAY_SIZE 24 ECU_ADDRESS 0x3FD6A4 /end MEASUREMENT
/begin MEASUREMENT fsearray_f "" FLOAT32_IEEE fak_r32_1 1 100 -1e+037 1e+037 FORMAT "%43.4" ARRAY_SIZE 6 ECU_ADDRESS 0x3FA828 /end MEASUREMENT
/begin MEASUREMENT fsed_ind "" UBYTE dez 1 100 0 255 FORMAT "%5.1" ECU_ADDRESS 0x5B8BB6 /end MEASUREMENT
/begin MEASUREMENT fsed_len "" UBYTE dez 1 100 0 255 FORMAT "%5.1" ECU_ADDRESS 0x5B8BB7 /end MEASUREMENT
/begin MEASUREMENT fsenmz2_f "" FLOAT32_IEEE fak_r32_1 1 100 -1e+037 1e+037 FORMAT "%43.4" ECU_ADDRESS 0x3FA840 /end MEASUREMENT
/begin MEASUREMENT fseof1_f "aktueller Filterwert Segmentabweichung, zur Segmentzeit-Korrektur, Bereich 1" FLOAT32_IEEE fak_r32_1 1 100 -1e+037 1e+037 FORMAT "%43.4" ARRAY_SIZE 12 ECU_ADDRESS 0x3FD9C4 /end MEASUREMENT
/begin MEASUREMENT fseof2_f "aktueller Filterwert Segmentabweichung, zur Segmentzeit-Korrektur, Bereich 2" FLOAT32_IEEE fak_r32_1 1 100 -1e+037 1e+037 FORMAT "%43.4" ARRAY_SIZE 12 ECU_ADDRESS 0x3FD9F4 /end MEASUREMENT
/begin MEASUREMENT fseof3_f "aktueller Filterwert Segmentabweichung, zur Segmentzeit-Korrektur, Bereich 3" FLOAT32_IEEE fak_r32_1 1 100 -1e+037 1e+037 FORMAT "%43.4" ARRAY_SIZE 12 ECU_ADDRESS 0x3FDA24 /end MEASUREMENT
/begin MEASUREMENT fseof4_f "aktueller Filterwert Segmentabweichung, zur Segmentzeit-Korrektur, Bereich 4" FLOAT32_IEEE fak_r32_1 1 100 -1e+037 1e+037 FORMAT "%43.4" ARRAY_SIZE 12 ECU_ADDRESS 0x3FDA54 /end MEASUREMENT
/begin MEASUREMENT fseofkor_f "aktueller Faktor zur Segmentzeit-Korrektur" FLOAT32_IEEE fak_r32_1 1 100 -1e+037 1e+037 FORMAT "%43.4" ECU_ADDRESS 0x3FA928 /end MEASUREMENT
/begin MEASUREMENT fse_f "aktueller Korrekturwert Fuel-on Adaption" FLOAT32_IEEE fak_r32_1 1 100 -1e+037 1e+037 FORMAT "%43.4" ECU_ADDRESS 0x3FA98C /end MEASUREMENT
/begin MEASUREMENT fsof1_f "Filterwert Segmentabweichung, Betriebsbereich 1" FLOAT32_IEEE fak_r32_1 1 100 -1e+037 1e+037 FORMAT "%43.4" ARRAY_SIZE 12 ECU_ADDRESS 0x3FDA84 /end MEASUREMENT
/begin MEASUREMENT fsof2_f "Filterwert Segmentabweichung, Betriebsbereich 2" FLOAT32_IEEE fak_r32_1 1 100 -1e+037 1e+037 FORMAT "%43.4" ARRAY_SIZE 12 ECU_ADDRESS 0x3FDAB4 /end MEASUREMENT
/begin MEASUREMENT fsof3_f "Filterwert Segmentabweichung, Betriebsbereich 3" FLOAT32_IEEE fak_r32_1 1 100 -1e+037 1e+037 FORMAT "%43.4" ARRAY_SIZE 12 ECU_ADDRESS 0x3FDAE4 /end MEASUREMENT
/begin MEASUREMENT fsof4_f "Filterwert Segmentabweichung, Betriebsbereich 4" FLOAT32_IEEE fak_r32_1 1 100 -1e+037 1e+037 FORMAT "%43.4" ARRAY_SIZE 12 ECU_ADDRESS 0x3FDB14 /end MEASUREMENT
/begin MEASUREMENT hcount "" UBYTE dez 1 100 0 255 FORMAT "%5.1" ECU_ADDRESS 0x5B861D /end MEASUREMENT
/begin MEASUREMENT hdfse_f "" FLOAT32_IEEE fak_r32_1 1 100 -1e+037 1e+037 FORMAT "%43.4" ECU_ADDRESS 0x3FA990 /end MEASUREMENT
/begin MEASUREMENT hflmx_f "" FLOAT32_IEEE fak_r32_1 1 100 -1e+037 1e+037 FORMAT "%43.4" ECU_ADDRESS 0x5B8620 /end MEASUREMENT
/begin MEASUREMENT idxfob "Index: Kennzeichnet den aktuellen KF-Bereich (Drehz., Last)" UBYTE dez 1 100 0 255 FORMAT "%5.1" ECU_ADDRESS 0x5B8BE4 /end MEASUREMENT
/begin MEASUREMENT idxfobap "Index: Kennzeichnet den aktuellen KF-Bereich (Drehz., Last)" UBYTE dez 1 100 0 255 FORMAT "%5.1" ECU_ADDRESS 0x5B8BE5 /end MEASUREMENT
/begin MEASUREMENT idxfofl "Index: Kennzeichnet den aktuellen Unterbereich (fuel-off Adaption)" UBYTE dez 1 100 0 1 FORMAT "%5.3" ECU_ADDRESS 0x5B8579 /end MEASUREMENT
/begin MEASUREMENT idxfofn "Drehzahlindex f¸r Drehzahlbereich der fuel-off Adaption" UBYTE dez 1 100 0 4 FORMAT "%5.3" ECU_ADDRESS 0x5B857A /end MEASUREMENT
/begin MEASUREMENT idxfon "Drehzahlindex f¸r Betriebsbereich der fuel-on Adaption" UBYTE dez 1 100 0 255 FORMAT "%5.1" ECU_ADDRESS 0x5B8BE6 /end MEASUREMENT
/begin MEASUREMENT idxfonap "Drehzahlindex f¸r Betriebsbereich der fuel-on Adaption" UBYTE dez 1 100 0 255 FORMAT "%5.1" ECU_ADDRESS 0x5B8BE7 /end MEASUREMENT
/begin MEASUREMENT idxfonl "Index: Kennzeichnet den aktuellen Unterbereich" UBYTE dez 1 100 0 255 FORMAT "%5.1" ECU_ADDRESS 0x5B8BE8 /end MEASUREMENT
/begin MEASUREMENT idxfont "" UBYTE dez 1 100 0 255 FORMAT "%5.1" ECU_ADDRESS 0x5B8BE9 /end MEASUREMENT
/begin MEASUREMENT idxfon_nb "" UBYTE dez 1 100 0 255 FORMAT "%5.1" ECU_ADDRESS 0x5B8BEA /end MEASUREMENT
/begin MEASUREMENT idxforl "Lastindex f¸r Betriebsbereich der fuel-on Adaption" UBYTE dez 1 100 0 255 FORMAT "%5.1" ECU_ADDRESS 0x5B8BEB /end MEASUREMENT
/begin MEASUREMENT idxforlap "Lastindex f¸r Betriebsbereich der fuel-on Adaption" UBYTE dez 1 100 0 255 FORMAT "%5.1" ECU_ADDRESS 0x5B8BEC /end MEASUREMENT
/begin MEASUREMENT idxforlt "" UBYTE dez 1 100 0 255 FORMAT "%5.1" ECU_ADDRESS 0x5B8BED /end MEASUREMENT
/begin MEASUREMENT idxforl_nb "" UBYTE dez 1 100 0 255 FORMAT "%5.1" ECU_ADDRESS 0x5B8BEE /end MEASUREMENT
/begin MEASUREMENT idx_base "" UBYTE dez 1 100 0 255 FORMAT "%5.1" ECU_ADDRESS 0x5B8BEF /end MEASUREMENT
/begin MEASUREMENT idx_right "" UBYTE dez 1 100 0 255 FORMAT "%5.1" ECU_ADDRESS 0x5B8BF0 /end MEASUREMENT
/begin MEASUREMENT idx_up "" UBYTE dez 1 100 0 255 FORMAT "%5.1" ECU_ADDRESS 0x5B8BF1 /end MEASUREMENT
/begin MEASUREMENT idx_up_right "" UBYTE dez 1 100 0 255 FORMAT "%5.1" ECU_ADDRESS 0x5B8BF2 /end MEASUREMENT
/begin MEASUREMENT imlkvszs_w "Zwischenspeicher: Luftmasse nach Auftreten eines DKVS Fehles bei leerem Tank" UWORD m_q0p00355 1 100 0 233.013 FORMAT "%8.4" ECU_ADDRESS 0x3FDC18 /end MEASUREMENT
/begin MEASUREMENT imlkvs_w "Luftmasse nach Auftreten eines DKVS Fehles bei leerem Tank" UWORD m_q0p00355 1 100 0 233.013 FORMAT "%8.4" ECU_ADDRESS 0x5B8732 /end MEASUREMENT
/begin MEASUREMENT intlash_w "Integrator (Rampe) f¸r Lambdasoll Test Schwingungspr¸fung h. KAT" UWORD fak_uw_b16 1 100 0 15.9998 FORMAT "%8.5" ECU_ADDRESS 0x3FDBBE /end MEASUREMENT
/begin MEASUREMENT katbf "Signal nach Speicher normiert vergleichbar mit ushk" UBYTE spg_ub_q0p0052_o0p2 1 100 -0.2 1.13 FORMAT "%5.3" ECU_ADDRESS 0x5B8E58 /end MEASUREMENT
/begin MEASUREMENT katbf2 "Signal nach Speicher normiert vergleichbar mit ushk2 (stereo 2.Bank)" UBYTE spg_ub_q0p0052_o0p2 1 100 -0.2 1.13 FORMAT "%5.3" ECU_ADDRESS 0x5B8E59 /end MEASUREMENT
/begin MEASUREMENT katbfi2_w "Sauerstoff-Anteil vor dem Speicher (Kat-Modell Stereo 2.Bank)" SWORD freq_sw_b512 1 100 -512 511.984 FORMAT "%8.4" ECU_ADDRESS 0x5B90BA /end MEASUREMENT
/begin MEASUREMENT katbfi_w "Sauerstoff-Anteil vor dem Speicher (Kat-Modell)" SWORD freq_sw_b512 1 100 -512 511.984 FORMAT "%8.4" ECU_ADDRESS 0x5B90BC /end MEASUREMENT
/begin MEASUREMENT katbfs "Signal nach Speicher (Kat-Modell)" SBYTE fak_sb_b1 1 100 -1 0.992188 FORMAT "%5.3" ECU_ADDRESS 0x5B8E5A /end MEASUREMENT
/begin MEASUREMENT katbfs2 "Signal nach Speicher (Kat-Modell, Stereo 2.Bank)" SBYTE fak_sb_b1 1 100 -1 0.992188 FORMAT "%5.3" ECU_ADDRESS 0x5B8E5B /end MEASUREMENT
/begin MEASUREMENT katbftp "Signal nach Speicher normiert, tiefpaﬂgefiltert" UBYTE spg_ub_q0p0052 1 100 0 1.33 FORMAT "%5.3" ECU_ADDRESS 0x5B8E5C /end MEASUREMENT
/begin MEASUREMENT katbftp2 "Signal nach Speicher normiert, tiefpaﬂgefiltert (Bank2)" UBYTE spg_ub_q0p0052 1 100 0 1.33 FORMAT "%5.3" ECU_ADDRESS 0x5B8E5D /end MEASUREMENT
/begin MEASUREMENT katbshd2_w "Signal f¸r Fett-Verschiebung des Modells (Bank2)" SWORD mgrad_sw_b28p44 1 100 -28.4444 28.4436 FORMAT "%8.5" ECU_ADDRESS 0x5B90BE /end MEASUREMENT
/begin MEASUREMENT katbshd_w "Signal f¸r Fett-Verschiebung des Modells" SWORD mgrad_sw_b28p44 1 100 -28.4444 28.4436 FORMAT "%8.5" ECU_ADDRESS 0x5B90C0 /end MEASUREMENT
/begin MEASUREMENT kbdkt2_w "Katbelastungssignal, Bank2" SWORD mgrad_sw_b28p44 1 100 -28.4444 28.4436 FORMAT "%8.5" ECU_ADDRESS 0x5B90C2 /end MEASUREMENT
/begin MEASUREMENT kbdkt_w "Katbelastungssignal" SWORD mgrad_sw_b28p44 1 100 -28.4444 28.4436 FORMAT "%8.5" ECU_ADDRESS 0x5B90C4 /end MEASUREMENT
/begin MEASUREMENT lamelsh_w "Lambdasoll f¸r elektrische Sondendiagnose hinter KAT (Kurztrip)" UWORD fak_uw_b16 1 100 0 15.9998 FORMAT "%8.5" ECU_ADDRESS 0x5B90CE /end MEASUREMENT
/begin MEASUREMENT lamlash_w "Lambdasoll f¸r Test Schwingungspr¸fung hinter KAT" UWORD fak_uw_b16 1 100 0 15.9998 FORMAT "%8.5" ECU_ADDRESS 0x5B8672 /end MEASUREMENT
/begin MEASUREMENT luaralt_f "" FLOAT32_IEEE fak_r32_1 1 100 -1e+037 1e+037 FORMAT "%43.4" ECU_ADDRESS 0x3FA8E8 /end MEASUREMENT
/begin MEASUREMENT luarmn_f "Laufunruhe-Abstandsmass-Referenzwert Minimun" FLOAT32_IEEE fak_r32_1 1 100 -1e+037 1e+037 FORMAT "%43.4" ECU_ADDRESS 0x3FA8EC /end MEASUREMENT
/begin MEASUREMENT luaroff_f "Laufunruhe-Abstandsmass-Referenzwert offset" FLOAT32_IEEE fak_r32_1 1 100 -1e+037 1e+037 FORMAT "%43.4" ECU_ADDRESS 0x3FA8F0 /end MEASUREMENT
/begin MEASUREMENT luar_f "Laufunruhe-Abstandsmass-Referenzwert" FLOAT32_IEEE fak_r32_1 1 100 -1e+037 1e+037 FORMAT "%43.4" ECU_ADDRESS 0x3FA8F4 /end MEASUREMENT
/begin MEASUREMENT lums_f "Laufunruhe-Mittelwert f¸r Erkennung Mehrfachaussetzer, signed" FLOAT32_IEEE fak_r32_1 1 100 -1e+037 1e+037 FORMAT "%43.4" ECU_ADDRESS 0x3FA8BC /end MEASUREMENT
/begin MEASUREMENT lunw_f "Laufunruhe ¸ber 1 NW-Umdr." FLOAT32_IEEE fak_r32_1 1 100 -1e+037 1e+037 FORMAT "%43.4" ECU_ADDRESS 0x3FA678 /end MEASUREMENT
/begin MEASUREMENT lurmsalt_f "vorangegangener Wert von lurms_f" FLOAT32_IEEE fak_r32_1 1 100 -1e+037 1e+037 FORMAT "%43.4" ECU_ADDRESS 0x3FA8C0 /end MEASUREMENT
/begin MEASUREMENT lurms_f "Laufunruhe-Referenzwert f¸r Mehrfachaussetzererkennung, -> Vgl. mit Lum, signed" FLOAT32_IEEE fak_r32_1 1 100 -1e+037 1e+037 FORMAT "%43.4" ECU_ADDRESS 0x3FA8C4 /end MEASUREMENT
/begin MEASUREMENT lursalt_f "vorangegangener Wert von lurs_f" FLOAT32_IEEE fak_r32_1 1 100 -1e+037 1e+037 FORMAT "%43.4" ECU_ADDRESS 0x3FA8C8 /end MEASUREMENT
/begin MEASUREMENT lurs_f "Laufunruhe-Referenzwert, signed" FLOAT32_IEEE fak_r32_1 1 100 -1e+037 1e+037 FORMAT "%43.4" ECU_ADDRESS 0x3FA8CC /end MEASUREMENT
/begin MEASUREMENT lutsfi1_w "gefilterte Laufunruhe-Testgrˆﬂe von Zylinder 1,word" SWORD luquant_w 1 100 -90.9495 90.9467 FORMAT "%8.5" ECU_ADDRESS 0x3FDB8E /end MEASUREMENT
/begin MEASUREMENT lutsfi2_w "gefilterte Laufunruhe-Testgrˆﬂe von Zylinder 2,word" SWORD luquant_w 1 100 -90.9495 90.9467 FORMAT "%8.5" ECU_ADDRESS 0x3FDB90 /end MEASUREMENT
/begin MEASUREMENT lutsfi3_w "gefilterte Laufunruhe-Testgrˆﬂe von Zylinder 3,word" SWORD luquant_w 1 100 -90.9495 90.9467 FORMAT "%8.5" ECU_ADDRESS 0x3FDB92 /end MEASUREMENT
/begin MEASUREMENT lutsfi4_w "gefilterte Laufunruhe-Testgrˆﬂe von Zylinder 4,word" SWORD luquant_w 1 100 -90.9495 90.9467 FORMAT "%8.5" ECU_ADDRESS 0x3FDB94 /end MEASUREMENT
/begin MEASUREMENT lutskzyl_f "Laufunruhe-Testgrˆﬂe, signed, korrigiert, Array ¸ber alle Zylinder" FLOAT32_IEEE fak_r32_1 1 100 -1e+037 1e+037 FORMAT "%43.4" ARRAY_SIZE 12 ECU_ADDRESS 0x3FA844 /end MEASUREMENT
/begin MEASUREMENT lutsk_f "Laufunruhe-Testgrˆﬂe, signed, korrigiert, Monitor" FLOAT32_IEEE fak_r32_1 1 100 -1e+037 1e+037 FORMAT "%43.4" ECU_ADDRESS 0x3FA874 /end MEASUREMENT
/begin MEASUREMENT lutszyl_f "Laufunruhe-Testgrˆﬂe, Array ¸ber alle Zylinder" FLOAT32_IEEE fak_r32_1 1 100 -1e+037 1e+037 FORMAT "%43.4" ARRAY_SIZE 12 ECU_ADDRESS 0x3FA67C /end MEASUREMENT
/begin MEASUREMENT luts_f "Laufunruhe-Testgrˆﬂe" FLOAT32_IEEE fak_r32_1 1 100 -1e+037 1e+037 FORMAT "%43.4" ECU_ADDRESS 0x3FA6AC /end MEASUREMENT
/begin MEASUREMENT maxfse_f "" FLOAT32_IEEE fak_r32_1 1 100 -1e+037 1e+037 FORMAT "%43.4" ECU_ADDRESS 0x3FA994 /end MEASUREMENT
/begin MEASUREMENT minfse_f "" FLOAT32_IEEE fak_r32_1 1 100 -1e+037 1e+037 FORMAT "%43.4" ECU_ADDRESS 0x3FA998 /end MEASUREMENT
/begin MEASUREMENT mldyn_w "Luftmassenintegral im Schubbetrieb f¸r Sonde hinter Kat" UWORD m_q0p00277 1 100 0 182.042 FORMAT "%8.4" ECU_ADDRESS 0x5B8674 /end MEASUREMENT
/begin MEASUREMENT n1 "Drehzahl 1 U/min/Inkrement" UBYTE dez 1 100 0 255 FORMAT "%5.1" ECU_ADDRESS 0x5B8BF3 /end MEASUREMENT
/begin MEASUREMENT n2 "Drehzahl (2-Byte-Adresse)" UBYTE dez 1 100 0 255 FORMAT "%5.1" ECU_ADDRESS 0x5B8BF4 /end MEASUREMENT
/begin MEASUREMENT rkamzs_w "additive Gemischkorrektur (pro Zeit oder Z¸ndung); alter Wert" SWORD rel_sw_b1536 1 100 -1536 1535.95 FORMAT "%8.3" ECU_ADDRESS 0x5B8734 /end MEASUREMENT
/begin MEASUREMENT rkam_w "Auswahl additive Gemischkorrektur der Gemischadaption f¸r Bestimmung B_gae" SWORD rel_sw_b1536 1 100 -1536 1535.95 FORMAT "%8.3" ECU_ADDRESS 0x5B8736 /end MEASUREMENT
/begin MEASUREMENT rkats_w "additive Gemischkorrektur pro Zeit Bank 1 und 2 zusammen" SWORD rel_sw_b1536 1 100 -1536 1535.95 FORMAT "%8.3" ECU_ADDRESS 0x5B8738 /end MEASUREMENT
/begin MEASUREMENT rkrn_w "normierter Referenzpegel Klopfregelung" UWORD spg_uw_b1280 1 100 0 1279.96 FORMAT "%7.2" ARRAY_SIZE 8 ECU_ADDRESS 0x5B8868 /end MEASUREMENT
/begin MEASUREMENT rldkthp "Hochpaﬂgefiltertes rl-Signal" SBYTE rel_sb_q0p75 1 100 -96 95.25 FORMAT "%5.2" ECU_ADDRESS 0x5B8E5E /end MEASUREMENT
/begin MEASUREMENT rldkthp2 "Hochpaﬂgefiltertes rl-Signal, Bank2" SBYTE rel_sb_q0p75 1 100 -96 95.25 FORMAT "%5.2" ECU_ADDRESS 0x5B8E5F /end MEASUREMENT
/begin MEASUREMENT rl_base "" UBYTE dez 1 100 0 255 FORMAT "%5.1" ECU_ADDRESS 0x5B8BF5 /end MEASUREMENT
/begin MEASUREMENT rl_right "" UBYTE dez 1 100 0 255 FORMAT "%5.1" ECU_ADDRESS 0x5B8BF6 /end MEASUREMENT
/begin MEASUREMENT rl_up "" UBYTE dez 1 100 0 255 FORMAT "%5.1" ECU_ADDRESS 0x5B8BF7 /end MEASUREMENT
/begin MEASUREMENT rl_up_right "" UBYTE dez 1 100 0 255 FORMAT "%5.1" ECU_ADDRESS 0x5B8BF8 /end MEASUREMENT
/begin MEASUREMENT sicurrent_f "" FLOAT32_IEEE fak_r32_1 1 100 -1e+037 1e+037 FORMAT "%43.4" ECU_ADDRESS 0x5B8580 /end MEASUREMENT
/begin MEASUREMENT slfofo_f "obere Schwelle f¸r flmxof_f, aus Kennlinie SLFOFO1/2N" FLOAT32_IEEE fak_r32_1 1 100 -1e+037 1e+037 FORMAT "%43.4" ECU_ADDRESS 0x5B8584 /end MEASUREMENT
/begin MEASUREMENT slfofu_f "untere Schwelle f¸r flmxof_f, aus Kennlinie SLFOFU1/2N" FLOAT32_IEEE fak_r32_1 1 100 -1e+037 1e+037 FORMAT "%43.4" ECU_ADDRESS 0x5B8588 /end MEASUREMENT
/begin MEASUREMENT slfoo_f "obere Schwelle f¸r flmx_f, aus Kennlinie SLFOO1/2N" FLOAT32_IEEE fak_r32_1 1 100 -1e+037 1e+037 FORMAT "%43.4" ECU_ADDRESS 0x5B8624 /end MEASUREMENT
/begin MEASUREMENT slfou_f "untere Schwelle f¸r flmx_f, aus Kennlinie SLFOU1/2N" FLOAT32_IEEE fak_r32_1 1 100 -1e+037 1e+037 FORMAT "%43.4" ECU_ADDRESS 0x5B8628 /end MEASUREMENT
/begin MEASUREMENT stimiread "Index Stimuli-Bit" UBYTE dez 1 100 0 255 FORMAT "%5.1" ECU_ADDRESS 0x5B8B94 /end MEASUREMENT
/begin MEASUREMENT stimiwri "Index Stimuli-Bit" UBYTE dez 1 100 0 255 FORMAT "%5.1" ECU_ADDRESS 0x5B8B95 /end MEASUREMENT
/begin MEASUREMENT stim_array "DMD Stimuli-Bit, Array" UBYTE default 1 100 0 1 FORMAT "%5.3" ARRAY_SIZE 15 ECU_ADDRESS 0x5B8B98 /end MEASUREMENT
/begin MEASUREMENT tc6kata "Anzahl der Ausgabe-Codes SCAN-Tool Mode6 aus Kat-Diagnose" UBYTE dez 1 100 0 255 FORMAT "%5.1" ECU_ADDRESS 0x3FDBAB /end MEASUREMENT
/begin MEASUREMENT tc6katc "Ausgabe-Code SCAN-Tool Mode 6 aus KAT-Diagnose" UBYTE dez 1 100 0 255 FORMAT "%5.1" ECU_ADDRESS 0x3FDBAC /end MEASUREMENT
/begin MEASUREMENT tc6katc2 "Ausgabe-Code SCAN-Tool Mode 6 aus KAT-Diagnose, Bank2" UBYTE dez 1 100 0 255 FORMAT "%5.1" ECU_ADDRESS 0x3FDBAD /end MEASUREMENT
/begin MEASUREMENT tc6kats "Ausgabe Schwellwert SCAN-Tool Mode 6 aus KAT-Diagnose" UBYTE dez 1 100 0 255 FORMAT "%5.1" ECU_ADDRESS 0x3FDBAE /end MEASUREMENT
/begin MEASUREMENT tc6kats2 "Ausgabe Schwellwert SCAN-Tool Mode 6 aus KAT-Diagnose" UBYTE dez 1 100 0 255 FORMAT "%5.1" ECU_ADDRESS 0x3FDBAF /end MEASUREMENT
/begin MEASUREMENT tc6katw "Ausgabe Pr¸fwert SCAN-Tool Mode 6 aus KAT-Diagnose" UBYTE dez 1 100 0 255 FORMAT "%5.1" ECU_ADDRESS 0x3FDBB0 /end MEASUREMENT
/begin MEASUREMENT tc6katw2 "Ausgabe Pr¸fwert SCAN-Tool Mode 6 aus KAT-Diagnose, Bank2" UBYTE dez 1 100 0 255 FORMAT "%5.1" ECU_ADDRESS 0x3FDBB1 /end MEASUREMENT
/begin MEASUREMENT tdkomp_f "Dynamikkompensation zur Laufunruheberechnung, DMD" FLOAT32_IEEE fak_r32_1 1 100 -1e+037 1e+037 FORMAT "%43.4" ECU_ADDRESS 0x3FA6B0 /end MEASUREMENT
/begin MEASUREMENT tpsvkmf2_w "gefilterter Periodendauerwert des Sondensignals vor Kat, Bank2 (Word)" UWORD t10msxs_uw_b655p35 1 100 0 655.35 FORMAT "%8.4" ECU_ADDRESS 0x3FDBB4 /end MEASUREMENT
/begin MEASUREMENT tpsvkmf_w "gefilterter Periodendauerwert des Sondensignals vor Kat. (Word)" UWORD t10msxs_uw_b655p35 1 100 0 655.35 FORMAT "%8.4" ECU_ADDRESS 0x3FDBB6 /end MEASUREMENT
/begin MEASUREMENT tpsvkof2_w "gemessener Periodendauerwert der Sonde vor Kat., Bank2, ohne Filter" UWORD t10msxs_uw_b655p35 1 100 0 655.35 FORMAT "%8.4" ECU_ADDRESS 0x5B90C6 /end MEASUREMENT
/begin MEASUREMENT tpsvkof_w "gemessener Periodendauerwert der Sonde vor Kat., ohne Filter" UWORD t10msxs_uw_b655p35 1 100 0 655.35 FORMAT "%8.4" ECU_ADDRESS 0x5B90C8 /end MEASUREMENT
/begin MEASUREMENT tpsvlssa "Periodendauer (Sondensignal vor Kat) f¸r DLSSA" UBYTE t40msxs_ub_q0p04 1 100 0 10.2 FORMAT "%5.2" ECU_ADDRESS 0x3FDBC2 /end MEASUREMENT
/begin MEASUREMENT tsi1_f "" FLOAT32_IEEE fak_r32_1 1 100 -1e+037 1e+037 FORMAT "%43.4" ARRAY_SIZE 12 ECU_ADDRESS 0x5B858C /end MEASUREMENT
/begin MEASUREMENT tsi_f "" FLOAT32_IEEE fak_r32_1 1 100 -1e+037 1e+037 FORMAT "%43.4" ARRAY_SIZE 12 ECU_ADDRESS 0x5B85BC /end MEASUREMENT
/begin MEASUREMENT tskarray_f "korrigierte Segmentdauer, Array ¸ber die letzten Werte" FLOAT32_IEEE fak_r32_1 1 100 -1e+037 1e+037 FORMAT "%43.4" ARRAY_SIZE 16 ECU_ADDRESS 0x3FA6B4 /end MEASUREMENT
/begin MEASUREMENT tskdelay "DMD Verzˆgerung Auswertung Segmentzeit" SBYTE dez_sb 1 100 0 16 ECU_ADDRESS 0x5B8BA7 /end MEASUREMENT
/begin MEASUREMENT tskin "Index korrigierte Segmentzeit 'n', DMD" UBYTE dez 1 100 0 100 FORMAT "%5.1" ECU_ADDRESS 0x5B8BA8 /end MEASUREMENT
/begin MEASUREMENT tskinm1 "Index korrigierte Segmentzeit 'n-1', DMD" UBYTE dez 1 100 0 100 FORMAT "%5.1" ECU_ADDRESS 0x5B8BA9 /end MEASUREMENT
/begin MEASUREMENT tskinm2 "Index korrigierte Segmentzeit 'n-2', DMD" UBYTE dez 1 100 0 100 FORMAT "%5.1" ECU_ADDRESS 0x5B8BAA /end MEASUREMENT
/begin MEASUREMENT tskinmz2 "Index korrigierte Segmentzeit 'n-ZYLZA/2', DMD" UBYTE dez 1 100 0 100 FORMAT "%5.1" ECU_ADDRESS 0x5B8BAB /end MEASUREMENT
/begin MEASUREMENT tskinp1 "Index korrigierte Segmentzeit 'n+1', DMD" UBYTE dez 1 100 0 100 FORMAT "%5.1" ECU_ADDRESS 0x5B8BAC /end MEASUREMENT
/begin MEASUREMENT tskinpz2 "Index korrigierte Segmentzeit 'n+ZYLZA/2', DMD" UBYTE dez 1 100 0 100 FORMAT "%5.1" ECU_ADDRESS 0x5B8BAD /end MEASUREMENT
/begin MEASUREMENT tskiwri "Index korrigierte Segmentzeit 'aktuell', DMD" UBYTE dez 1 100 0 100 FORMAT "%5.1" ECU_ADDRESS 0x5B8BAE /end MEASUREMENT
/begin MEASUREMENT tskixmz "Index korrigierte Segmentzeit 'x-ZYLAZ/2', DMD" UBYTE dez 1 100 0 100 FORMAT "%5.1" ECU_ADDRESS 0x5B8BAF /end MEASUREMENT
/begin MEASUREMENT tskiy "Index korrigierte Segmentzeit 'y', DMD" UBYTE dez 1 100 0 100 FORMAT "%5.1" ECU_ADDRESS 0x5B8BB0 /end MEASUREMENT
/begin MEASUREMENT tskiym1 "Index korrigierte Segmentzeit 'y-1', DMD" UBYTE dez 1 100 0 100 FORMAT "%5.1" ECU_ADDRESS 0x5B8BB1 /end MEASUREMENT
/begin MEASUREMENT tskiyp1 "Index korrigierte Segmentzeit 'y+1', DMD" UBYTE dez 1 100 0 100 FORMAT "%5.1" ECU_ADDRESS 0x5B8BB2 /end MEASUREMENT
/begin MEASUREMENT tskiyp2 "Index korrigierte Segmentzeit 'y+2', DMD" UBYTE dez 1 100 0 100 FORMAT "%5.1" ECU_ADDRESS 0x5B8BB3 /end MEASUREMENT
/begin MEASUREMENT tskiyp3 "Index korrigierte Segmentzeit 'y+3', DMD" UBYTE dez 1 100 0 100 FORMAT "%5.1" ECU_ADDRESS 0x5B8BB4 /end MEASUREMENT
/begin MEASUREMENT tsklen "DMD L‰nge tsk-Array" UBYTE dez 1 100 0 100 FORMAT "%5.1" ECU_ADDRESS 0x5B8520 /end MEASUREMENT
/begin MEASUREMENT tskll_f "" FLOAT32_IEEE fak_r32_1 1 100 -1e+037 1e+037 FORMAT "%43.4" ECU_ADDRESS 0x3FA6F4 /end MEASUREMENT
/begin MEASUREMENT tsknm1_f "korrigierte Segmentdauer 'n-1'" FLOAT32_IEEE fak_r32_1 1 100 -1e+037 1e+037 FORMAT "%43.4" ECU_ADDRESS 0x3FA6F8 /end MEASUREMENT
/begin MEASUREMENT tsknm2_f "korrigierte Segmentdauer 'n-2'" FLOAT32_IEEE fak_r32_1 1 100 -1e+037 1e+037 FORMAT "%43.4" ECU_ADDRESS 0x3FA6FC /end MEASUREMENT
/begin MEASUREMENT tsknp1_f "korrigierte Segmentdauer 'n+1'" FLOAT32_IEEE fak_r32_1 1 100 -1e+037 1e+037 FORMAT "%43.4" ECU_ADDRESS 0x3FA700 /end MEASUREMENT
/begin MEASUREMENT tsknx3_f "korrigierte Segmentdauer 'n'^3" FLOAT32_IEEE fak_r32_1 1 100 -1e+037 1e+037 FORMAT "%43.4" ECU_ADDRESS 0x3FA704 /end MEASUREMENT
/begin MEASUREMENT tskn_f "korrigierte Segmentdauer 'n'" FLOAT32_IEEE fak_r32_1 1 100 -1e+037 1e+037 FORMAT "%43.4" ECU_ADDRESS 0x3FA708 /end MEASUREMENT
/begin MEASUREMENT tskyx3_f "korrigierte Segmentdauer 'y'^3" FLOAT32_IEEE fak_r32_1 1 100 -1e+037 1e+037 FORMAT "%43.4" ECU_ADDRESS 0x3FA70C /end MEASUREMENT
/begin MEASUREMENT tsk_f "korrigierte Segmentdauer" FLOAT32_IEEE fak_r32_1 1 100 -1e+037 1e+037 FORMAT "%43.4" ECU_ADDRESS 0x3FA92C /end MEASUREMENT
/begin MEASUREMENT tsmxkomp_f "Maximalwertbegrenzung der Segmentzeiten f¸r Kompensationsverfahren nach Start" FLOAT32_IEEE fak_r32_1 1 100 -1e+037 1e+037 FORMAT "%43.4" ECU_ADDRESS 0x3FA710 /end MEASUREMENT
/begin MEASUREMENT tuspnf "gefilterte Zeit zw. pos. und neg. usvk-Flanke, DLSSA" UBYTE t40msxs_ub_q0p04 1 100 0 10.2 FORMAT "%5.2" ECU_ADDRESS 0x3FDBC3 /end MEASUREMENT
/begin MEASUREMENT twdlssa_w "Timer f¸r Mindestpr¸fzeit f¸r DLSSA-Extremwertbestimmung" UWORD t50msxs_uw_b3276p75 1 100 0 3276.75 FORMAT "%8.3" ECU_ADDRESS 0x5B8682 /end MEASUREMENT
/begin MEASUREMENT twdlssh_w "Timer f¸r Mindestpr¸fzeit f¸r DLSSA-Extremwertbestimmung hinter KAT" UWORD t50msxs_uw_b3276p75 1 100 0 3276.75 FORMAT "%8.3" ECU_ADDRESS 0x5B8684 /end MEASUREMENT
/begin MEASUREMENT tzlsatv2_w "aktueller Zeitz‰hlerstand f¸r Ready-Flag der ATV-‹berwachung, Bank 2" UWORD t1sxs_uw_b65535 1 100 0 65535 FORMAT "%8.2" ECU_ADDRESS 0x5B8666 /end MEASUREMENT
/begin MEASUREMENT tzlsatv_w "aktueller Zeitz‰hlerstand f¸r Ready-Flag der ATV-‹berwachung" UWORD t1sxs_uw_b65535 1 100 0 65535 FORMAT "%8.2" ECU_ADDRESS 0x5B8668 /end MEASUREMENT
/begin MEASUREMENT urddktp "Regelspannungsdifferenz, tiefpaﬂgefiltert" SBYTE spg_sb_q0p01043 1 100 -1.33522 1.32478 FORMAT "%5.3" ECU_ADDRESS 0x5B8E60 /end MEASUREMENT
/begin MEASUREMENT urddktp2 "Regelspannungsdifferenz, tiefpaﬂgefiltert, Bank2" SBYTE spg_sb_q0p01043 1 100 -1.33522 1.32478 FORMAT "%5.3" ECU_ADDRESS 0x5B8E61 /end MEASUREMENT
/begin MEASUREMENT ushdktp "Spannung Lambdsonde hinter KAt, tiefpassgefiltert" UBYTE spg_ub_q0p0052 1 100 0 1.33 FORMAT "%5.3" ECU_ADDRESS 0x5B8E62 /end MEASUREMENT
/begin MEASUREMENT ushdktp2 "Spannung Lambdsonde hinter KAt, tiefpassgefiltert" UBYTE spg_ub_q0p0052 1 100 0 1.33 FORMAT "%5.3" ECU_ADDRESS 0x5B8E63 /end MEASUREMENT
/begin MEASUREMENT ushfmxstg "Gefilterte maximale Steigung der Sondenspannung hinter KAT" UBYTE spgg_q0p52 1 100 0 132.6 FORMAT "%5.1" ECU_ADDRESS 0x3FDBC1 /end MEASUREMENT
/begin MEASUREMENT ushkj "Spannung Lambdasonde hinter Kat, ohne Offset, DLSSA, Bank 1" UBYTE spg_ub_b1p33 1 100 0 1.33 FORMAT "%5.3" ECU_ADDRESS 0x5B867A /end MEASUREMENT
/begin MEASUREMENT ushkjf_w "Gefilterte Spannung Lambdasonde hinter Kat, ohne Offset, DLSSA" UWORD spg_uw_b1p33 1 100 0 1.33 FORMAT "%8.6" ECU_ADDRESS 0x5B8686 /end MEASUREMENT
/begin MEASUREMENT ushkmxstg "Maximale Steigung der Sondenspannung hinter KAT" UBYTE spgg_q0p52 1 100 0 132.6 FORMAT "%5.1" ECU_ADDRESS 0x5B8E6B /end MEASUREMENT
/begin MEASUREMENT ushksteig "Steigung der Sondenspannung hinter KAT" UBYTE spgg_q0p52 1 100 0 132.6 FORMAT "%5.1" ECU_ADDRESS 0x5B8E6C /end MEASUREMENT
/begin MEASUREMENT usmnsaa "minimal erkannter Sondenspannungswert v.K. (alt), DLSSA, Bank 1" UBYTE spg_ub_b1p33 1 100 0 1.33 FORMAT "%5.3" ECU_ADDRESS 0x5B867B /end MEASUREMENT
/begin MEASUREMENT usmnsan "minimal erkannter Sondenspannungswert v.K. (neu), DLSSA" UBYTE spg_ub_b1p33 1 100 0 1.33 FORMAT "%5.3" ECU_ADDRESS 0x3FDBC4 /end MEASUREMENT
/begin MEASUREMENT usmnsha "minimal erkannter Sondenspannungswert h.K. (alt), DLSSA, Bank 1" UBYTE spg_ub_b1p33 1 100 0 1.33 FORMAT "%5.3" ECU_ADDRESS 0x5B867C /end MEASUREMENT
/begin MEASUREMENT usmnshn "minimal erkannter Sondenspannungswert h.K. (neu), DLSSA" UBYTE spg_ub_b1p33 1 100 0 1.33 FORMAT "%5.3" ECU_ADDRESS 0x3FDBC5 /end MEASUREMENT
/begin MEASUREMENT usmxsaa "maximal erkannter Sondenspannungswert v.K. (alt), DLSSA, Bank1" UBYTE spg_ub_b1p33 1 100 0 1.33 FORMAT "%5.3" ECU_ADDRESS 0x5B867D /end MEASUREMENT
/begin MEASUREMENT usmxsan "maximal erkannter Sondenspannungswert v.K. (neu), DLSSA" UBYTE spg_ub_b1p33 1 100 0 1.33 FORMAT "%5.3" ECU_ADDRESS 0x3FDBC6 /end MEASUREMENT
/begin MEASUREMENT usmxsha "maximal erkannter Sondenspannungswert h.K. (alt), DLSSA, Bank 1" UBYTE spg_ub_b1p33 1 100 0 1.33 FORMAT "%5.3" ECU_ADDRESS 0x5B867E /end MEASUREMENT
/begin MEASUREMENT usmxshn "maximal erkannter Sondenspannungswert h.K. (neu), DLSSA" UBYTE spg_ub_b1p33 1 100 0 1.33 FORMAT "%5.3" ECU_ADDRESS 0x3FDBC7 /end MEASUREMENT
/begin MEASUREMENT usrhkmx "maximale Regelschwelle im Fehlerfall  f¸r Sonden-Diagnose hinter KAT" UBYTE spg_ub_q0p0052_o0p2 1 100 -0.2 1.13 FORMAT "%5.3" ECU_ADDRESS 0x3FDBBC /end MEASUREMENT
/begin MEASUREMENT usrhks "aktueller Regel-Sollwert f¸r Diagnose hinter KAT" UBYTE spg_ub_q0p0052_o0p2 1 100 -0.2 1.13 FORMAT "%5.3" ECU_ADDRESS 0x5B866B /end MEASUREMENT
/begin MEASUREMENT usrj "Regelschwelle der Lambdaregelung, ohne Offset, DLSSA" UBYTE spg_ub_b1p33 1 100 0 1.33 FORMAT "%5.3" ECU_ADDRESS 0x5B867F /end MEASUREMENT
/begin MEASUREMENT usvkj "Spannung Lambdasonde vor Kat, ohne Offset, DLSSA" UBYTE spg_ub_b1p33 1 100 0 1.33 FORMAT "%5.3" ECU_ADDRESS 0x5B8680 /end MEASUREMENT
/begin MEASUREMENT usvkjf_w "Gefilterte Spannung Lambdasonde vor Kat, ohne Offset, DLSSA" UWORD spg_uw_b1p33 1 100 0 1.33 FORMAT "%8.6" ECU_ADDRESS 0x5B8688 /end MEASUREMENT
/begin MEASUREMENT xs_f "aktueller Meﬂwert Basisgrˆﬂe f¸r Faktor Segmentzeitkorrektur" FLOAT32_IEEE fak_r32_1 1 100 -1e+037 1e+037 FORMAT "%43.4" ARRAY_SIZE 12 ECU_ADDRESS 0x5B85EC /end MEASUREMENT
/begin MEASUREMENT xzkrznt "Z‰hler Klopfregelung Zyklusflag Z_krnt" UBYTE dez 1 100 0 255 FORMAT "%5.1" ECU_ADDRESS 0x5B8F09 /end MEASUREMENT
/begin MEASUREMENT xzkrzof "Z‰hler Klopfregelung Zyklusflag Z_krof" UBYTE dez 1 100 0 255 FORMAT "%5.1" ECU_ADDRESS 0x5B8F0A /end MEASUREMENT
/begin MEASUREMENT xzkrzs "Z‰hler f¸r Zyklusflag Diagnose Klopfsensor" UBYTE dez 1 100 0 255 FORMAT "%5.1" ARRAY_SIZE 4 ECU_ADDRESS 0x5B8858 /end MEASUREMENT
/begin MEASUREMENT xzkrzs2 "Z‰hler Klopfregelung Zyklusflag Z_ks2" UBYTE dez 1 100 0 255 FORMAT "%5.1" ARRAY_SIZE 4 ECU_ADDRESS 0x5B885C /end MEASUREMENT
/begin MEASUREMENT xzkrztp "Z‰hler Klopfregelung Zyklusflag Z_krtp" UBYTE dez 1 100 0 255 FORMAT "%5.1" ECU_ADDRESS 0x5B8F0D /end MEASUREMENT
/begin MEASUREMENT xzsen "Entprellz‰hler Diagnose Klopfsensor" UBYTE dez 1 100 0 255 FORMAT "%5.1" ARRAY_SIZE 4 ECU_ADDRESS 0x5B8860 /end MEASUREMENT
/begin MEASUREMENT xzsen2 "Sicherheitsz‰hler Klopfsensor 2" UBYTE dez 1 100 0 255 FORMAT "%5.1" ARRAY_SIZE 4 ECU_ADDRESS 0x5B8864 /end MEASUREMENT
/begin MEASUREMENT xzskrnt "Sicherheitsz‰hler Klopfregelung Nulltest" UBYTE dez 1 100 0 255 FORMAT "%5.1" ECU_ADDRESS 0x5B8F0B /end MEASUREMENT
/begin MEASUREMENT xzskrof "Sicherheitsz‰hler Klopfregelung Offset" UBYTE dez 1 100 0 255 FORMAT "%5.1" ECU_ADDRESS 0x5B8F0C /end MEASUREMENT
/begin MEASUREMENT xzskrtp "Z‰hler Klopfregelung Errorflag E_krtp" UBYTE dez 1 100 0 255 FORMAT "%5.1" ECU_ADDRESS 0x5B8F0E /end MEASUREMENT
/begin MEASUREMENT z2_f "1/(ZYLZA/2)^2, float" FLOAT32_IEEE fak_r32_1 1 100 -1e+037 1e+037 FORMAT "%43.4" ECU_ADDRESS 0x5B8534 /end MEASUREMENT
/begin MEASUREMENT zlash_w "Zeitz‰hler f¸r Sondenspannung hinter KAT ober/unterhalb des Sollwertes" UWORD t100msxs_uw_b6553p5 1 100 0 6553.5 FORMAT "%8.3" ECU_ADDRESS 0x5B90CA /end MEASUREMENT
/begin MEASUREMENT zlsatp "aktueller Periodenz‰hler f¸r Ready-Flag der Periodendauer¸berwachung" UBYTE dez 1 100 0 255 FORMAT "%5.1" ECU_ADDRESS 0x5B8E64 /end MEASUREMENT
/begin MEASUREMENT zlsatp2 "aktueller Periodenz‰hler f¸r Ready-Flag der Periodendauer¸berwachung, Bank2" UBYTE dez 1 100 0 255 FORMAT "%5.1" ECU_ADDRESS 0x5B8E65 /end MEASUREMENT
/begin MEASUREMENT zwdynsh "Z‰hler f¸r Anzahl der Dynamikmessungen f¸r Sonde hinter KAT" UBYTE dez 1 100 0 255 FORMAT "%5.1" ECU_ADDRESS 0x5B866C /end MEASUREMENT
/begin MEASUREMENT zwgeflr "Z‰hlerwert Gemischfehler" UBYTE dez 1 100 0 255 FORMAT "%5.1" ECU_ADDRESS 0x3FDBC8 /end MEASUREMENT
/begin MEASUREMENT zwgeflr2 "Z‰hlerwert Gemischfehler Bank 2" UBYTE dez 1 100 0 255 FORMAT "%5.1" ECU_ADDRESS 0x3FDBC9 /end MEASUREMENT
/begin MEASUREMENT zwpvk "Warteperiodenzaehler Periodendauerueberwachung" UBYTE dez 1 100 0 255 FORMAT "%5.1" ECU_ADDRESS 0x5B8E66 /end MEASUREMENT
/begin MEASUREMENT zwpvk2 "Warteperiodenzaehler Periodendauerueberwachung, Bank 2" UBYTE dez 1 100 0 255 FORMAT "%5.1" ECU_ADDRESS 0x5B8E67 /end MEASUREMENT
/begin MEASUREMENT zyl2 "" UBYTE dez 1 100 0 12 FORMAT "%5.2" ECU_ADDRESS 0x5B857B /end MEASUREMENT
/begin MEASUREMENT zzyllfb "SW-Zylinderz‰hler f¸r DMD" SBYTE dez_sb 1 100 -16 24 ECU_ADDRESS 0x5B8BB5 /end MEASUREMENT
/begin MEASUREMENT Z_hlpkrnt "Hilfszyklusflag: Klopfregelung Nulltest" UBYTE B_TRUE 1 100 0 1 BIT_MASK 0x1 FORMAT "%13.11" ECU_ADDRESS 0x3FBE42 /end MEASUREMENT
/begin MEASUREMENT Z_hlpkrof "Hilfszyklusflag: Klopfregelung Offset" UBYTE B_TRUE 1 100 0 1 BIT_MASK 0x1 FORMAT "%13.11" ECU_ADDRESS 0x3FBE43 /end MEASUREMENT
/begin MEASUREMENT Z_hlpkrtp "Hilszyklusflag: Klopfregelung Testimpuls" UBYTE B_TRUE 1 100 0 1 BIT_MASK 0x1 FORMAT "%13.11" ECU_ADDRESS 0x3FBE46 /end MEASUREMENT
/begin FUNCTION DKAT "Eigendiagnose; Katalysatorkonvertierung"
 /begin DEF_CHARACTERISTIC ADKATNF AHKATMN AHKATMX AHKATS AHKATSB AHKTTSW APEKTDX AVKATFS CDKATLK DKATCW DMRKTD DRLKTDP FALRKTD FALRKTT KATBFML KATBFMN KATBFN KATBFNM KATBFNP KATBFSX KATBFXM KATBSG KATBSH KATBSHF KATBSHG NDKTSO NDKTSOT NDKTSU NDKTSUT NKTDX RLDKTOT RLDKTSO RLDKTSU RLDKTUT TDKATAKT TDKATATT TMINKAT TMNKATT TWDKATST TWKTDLP ZDKATAD ZDKATAF ZDKATSH ZDKTBD ZDKTBF ZKTDRL /end DEF_CHARACTERISTIC
 /begin REF_CHARACTERISTIC SML05DKUB SNM05DKUB /end REF_CHARACTERISTIC
 /begin IN_MEASUREMENT B_cdkat B_dtes B_edkvs B_edkvs2 B_fa B_fakat B_ll B_lr B_lr2 B_lrka B_mdarv B_mdkat B_pwf B_sbbhk B_tehb B_ukg cd_bits1_w esst_sml05dkub esst_snm05dkub fr2_w fr_w ml ml_w nmot rl tkatm ushk ushk2 /end IN_MEASUREMENT
 /begin OUT_MEASUREMENT ahkat ahkat2 avkatf avkatf2 B_dktlp dmrdkt_w falrdkt tc6kata tc6katc tc6katc2 tc6kats tc6kats2 tc6katw tc6katw2 /end OUT_MEASUREMENT
 /begin LOC_MEASUREMENT ahkatn ahkatn2 ahktki2_w ahktki_w ahktnk ahktnk2 akatbn akatbn2 apedkt apedkt2 B_dkini B_dkini2 B_dklpi B_dklpi2 B_dkten B_dkten2 B_dktnr B_dktnr2 B_dktsb B_dktsb2 B_dktsp B_dktsp2 B_dktst B_dktst2 B_dktt B_dktt2 B_ekats B_ekats2 B_erdkt B_erdkt2 B_szkat B_szkat2 B_trig B_trig2 B_zkatb B_zkatb2 B_zkats B_zkats2 B_zkatz B_zkatz2 dkatakt2_w dkatakt_w katbf katbf2 katbfi2_w katbfi_w katbfs katbfs2 katbftp katbftp2 katbshd2_w katbshd_w kbdkt2_w kbdkt_w rldkthp rldkthp2 urddktp urddktp2 ushdktp ushdktp2 /end LOC_MEASUREMENT
/end FUNCTION
/begin FUNCTION DKFTE "Endstufendiagnose; Kennfeldthermostat-Regelung" /begin DEF_CHARACTERISTIC CWPSETS TKWPWMDMN TKWPWMDMX /end DEF_CHARACTERISTIC /begin IN_MEASUREMENT B_clvar B_desee tkwpwm /end IN_MEASUREMENT /begin OUT_MEASUREMENT B_kftdet B_kftvar /end OUT_MEASUREMENT /end FUNCTION
/begin FUNCTION DKOSE "Diagnose Klimakompressor-Endstufe" /begin DEF_CHARACTERISTIC CWPSKOSE /end DEF_CHARACTERISTIC /begin REF_CHARACTERISTIC TVP /end REF_CHARACTERISTIC /begin IN_MEASUREMENT B_desee B_koe B_kovar /end IN_MEASUREMENT /begin SUB_FUNCTION DFPM_DKOSE /end SUB_FUNCTION /end FUNCTION
/begin FUNCTION DKRNT "Diagnose; Klopfregelung, Nulltest (OBDII)" /begin DEF_CHARACTERISTIC CWDKRNT CWDKROF DKROFN DKROKU KRFHT UDKRGOFS /end DEF_CHARACTERISTIC /begin REF_CHARACTERISTIC DKROKD /end REF_CHARACTERISTIC /begin IN_MEASUREMENT B_dnt B_pwf B_stend igod_w ikrma nmot tmfln_w tpnt_aktiv /end IN_MEASUREMENT /begin OUT_MEASUREMENT B_krntfv xzskrnt xzskrof /end OUT_MEASUREMENT /begin LOC_MEASUREMENT E_hlpkrnt E_hlpkrof xzkrznt xzkrzof Z_hlpkrnt Z_hlpkrof /end LOC_MEASUREMENT /end FUNCTION
/begin FUNCTION DKRS "Diagnose; Klopfsensor (OBDII)"
 /begin DEF_CHARACTERISTIC CWDKS1 CWDKS2 CWDKS3 CWDKS4 KRFHKS NDKSO NDKSU UDKSNO UDKSNU /end DEF_CHARACTERISTIC
 /begin REF_CHARACTERISTIC KSZA SENZZYL /end REF_CHARACTERISTIC
 /begin IN_MEASUREMENT B_kr B_krldy B_krndy B_pwf B_synph B_tmkr E_krnt E_krof E_krtp ks_sym nmot rkr sen_c95 vkr /end IN_MEASUREMENT
 /begin OUT_MEASUREMENT B_krdws rkrn_w xzkrzs xzkrzs2 xzsen xzsen2 /end OUT_MEASUREMENT
 /begin LOC_MEASUREMENT B_ds /end LOC_MEASUREMENT
/end FUNCTION
/begin FUNCTION DKRTP "Diagnose; Klopfregelung, Testimpuls (OBDII)" /begin DEF_CHARACTERISTIC CWDKRTP UDKRTP /end DEF_CHARACTERISTIC /begin REF_CHARACTERISTIC KRFHT /end REF_CHARACTERISTIC /begin IN_MEASUREMENT B_dtp B_pwf ikrma ikrmet tpnt_aktiv /end IN_MEASUREMENT /begin OUT_MEASUREMENT B_krtpfv xzskrtp /end OUT_MEASUREMENT /begin LOC_MEASUREMENT E_hlpkrtp xzkrztp Z_hlpkrtp /end LOC_MEASUREMENT /end FUNCTION
/begin FUNCTION DKUPPL "Diagnose Kupplungsschalter" /begin DEF_CHARACTERISTIC AGANGW AKUPPLB TDKUPNOG VDKUPPLMN /end DEF_CHARACTERISTIC /begin IN_MEASUREMENT B_autget B_brems B_lsd gangi S_kupp vfzg /end IN_MEASUREMENT /begin OUT_MEASUREMENT anzgangw anzkupplb B_gangok /end OUT_MEASUREMENT /end FUNCTION
/begin FUNCTION DKVS "Diagnose; Plausibilit‰tspr¸fung Kraftstoffversorgungssysteme"
 /begin DEF_CHARACTERISTIC CPLRA CWDKVSS DFRMST FRAE FRAODN FRAODX FRAUDN FRAUDX FRMSTTDN FRMSTTDX IMLKVSMX MLDKVSF MLDKVSG RKAE RKATDN RKATDX RKAZDN RKAZDX TFRA TFRAOZ TFRAUZ TFRMST TFRMZST TMFRST TRKA TRKATZ TRKAZZ ZFRMST /end DEF_CHARACTERISTIC
 /begin IN_MEASUREMENT B_cdkvs B_fa B_fakvs B_falra B_frao B_frau B_fraur B_lr B_lra B_lrare B_nofra B_norkat B_norkaz B_pwf B_rkat B_rkatr B_rkaz B_rkazr B_sa B_tal B_talval B_te cd_bits1_w frao_w frau_w frm_w ml rkat_w rkaz_w tans tmot /end IN_MEASUREMENT
 /begin OUT_MEASUREMENT B_dkvsf B_dkvstr B_edkvs B_gae B_gaefra B_gaefra2 B_gaeing B_gaeing2 B_kvsffl /end OUT_MEASUREMENT
 /begin LOC_MEASUREMENT B_dkvsef B_dkvsfm B_dkvszf B_efrao B_efrau B_erkat B_erkaz B_frste B_imlkvse B_norkam B_plra B_rkam B_rkamr B_zfrao B_zfrau B_zrkat B_zrkaz DKVSbits DKVSlokbits frauzs_w imlkvszs_w imlkvs_w rkamzs_w rkam_w rkats_w /end LOC_MEASUREMENT
/end FUNCTION
/begin FUNCTION DLLR "Diagnose: Leerlaufregelung Erkennung blockierter Steller"
 /begin DEF_CHARACTERISTIC DASA DNDLLRO DNDLLRU FHDLLR RLDLLR TADLLR TDLLR TDLLRMN TDLLRMX TDLLRNF TFDLLRO TFDLLRU TMDLLR /end DEF_CHARACTERISTIC
 /begin IN_MEASUREMENT B_cdllr B_dknolu B_dkpu B_dsls B_dtes B_ll B_llr B_lrar B_nldg B_nmot B_nswo1 B_sa B_st B_tehb cd_bits2_w dmllri_w dns fho limax_w limin_w rl tans tmot tnse_w vfzg /end IN_MEASUREMENT
 /begin OUT_MEASUREMENT B_dllr B_dllra /end OUT_MEASUREMENT
 /begin LOC_MEASUREMENT B_lldia B_nollrflr /end LOC_MEASUREMENT
/end FUNCTION
/begin FUNCTION DLSA "Lambdasondenalterungs¸berwachung, OBDII"
 /begin DEF_CHARACTERISTIC ANZDPVK ANZTP KFTPKOR NTPKTO NTPKTU NTPVKO NTPVKU RLTPKTO RLTPKTU RLTPVKO RLTPVKU TKTPVK TKTVHK TSTEAA TSVKKO TSVKKTO TSVKKTU TSVKKU TSVKO TSVKU TVLRHMN TVLRHMN2 TVLRHMX TVLRHMX2 TWDDTV ZFTSVK /end DEF_CHARACTERISTIC
 /begin IN_MEASUREMENT atv B_cdlatp B_cdlatv B_dsls B_dtest B_edkvs B_edkvs2 B_fa B_fatp B_fatp2 B_fatv B_fatv2 B_gasp B_lr B_lr2 B_lrhk B_lrtpp B_lrtpp2 B_mdarv B_st B_te B_tehb cd_bits2_w nmot rl tabgm tkatm tplrvk2_w tplrvk_w /end IN_MEASUREMENT
 /begin OUT_MEASUREMENT B_dlatp B_dlatp2 tpsvkmf2_w tpsvkmf_w tpsvkof2_w tpsvkof_w tzlsatv2_w tzlsatv_w zlsatp zlsatp2 zwpvk zwpvk2 /end OUT_MEASUREMENT
 /begin LOC_MEASUREMENT B_dlaff B_dlaff2 B_dlatv B_dlatv2 B_lsastp B_lsastp2 B_nolatp B_nolatp2 B_nolatv B_nolatv2 /end LOC_MEASUREMENT
/end FUNCTION
/begin FUNCTION DLSAHK "Lambdasondenalterungs¸berwachung hinter KAT"
 /begin DEF_CHARACTERISTIC ANZDYNSH CWDLSAHK DLAMLASHF DLAMLASHM DMRLASH FRMLASHO FRMLASHU KMXSTG KTLAMSTEIG LAMSONSVL LAMSTEIG MLLASH MLOSTEST MLUSSTG MLUSTEST MLUSVL SMLDYN TABGSTG TFRMB TLLASH TRIPFASH TSALASH TTLASH TUSCHUB TUSENLASH TUSHKRFM TUSHKVL TUSHSMIN TUSLASH TUSMSVL TUSSA TUSTALLASH USHKVL USHLEAN USHRICH USHSTGMX USHSTSOLL USSCHUB /end DEF_CHARACTERISTIC
 /begin IN_MEASUREMENT B_cdlash B_cwlshdyn B_cwlshsch B_cwlshvl B_dsls B_dtest B_edkvs B_evloc B_fa B_fash B_gaefra B_gaeing B_lr B_lrhk B_lrhkp B_lsh B_mdarv B_pwf B_sa B_sbbhk B_tal B_talval B_vlsumrb cd_bits2_w lamsons_w ml_w tkatm ushk usrhk /end IN_MEASUREMENT
 /begin OUT_MEASUREMENT B_ddylash B_dlash B_dshk B_dushsch B_enfmst B_enlash B_entest B_lamend B_lamlash B_lamverg B_lsahksp B_lshswok B_minlash B_mldyn B_mlustest B_nolash B_steigm B_teslash B_trfash B_ushkf B_ushkm dmrlash_w lamlash_w mldyn_w ushfmxstg ushkmxstg ushksteig zlash_w zwdynsh /end OUT_MEASUREMENT
 /begin LOC_MEASUREMENT B_abgstg B_dlams B_dushkvl B_dylash B_enmaxla B_ktrlash B_maxla B_maxlash B_npllash B_siglash B_uscherf B_ushkrfm B_ushkvl B_ushsch B_usrhkmx dlams_w intlash_w usrhkmx usrhks /end LOC_MEASUREMENT
/end FUNCTION
/begin FUNCTION DLSH "Diagnose; Sondenbetriebsbereitschaft hinter Kat"
 /begin DEF_CHARACTERISTIC ABGMSIGH DLAMELSH DMRLSH DRISIGH PHLSNHMN RISIGRESH TABGMCSD TASIG TKATMSHU TMSH TMSHA TNSTDNH TRSAFA TRSAH TRSE TTBMH TUSDUFA TUSDUH TUSEINH TUSKS TUSMAX TUSTAL UBDLS USMAX USMIN USREFH USREMH /end DEF_CHARACTERISTIC
 /begin IN_MEASUREMENT B_atmtpk B_cdlsh B_dsls B_dtes B_esls B_fa B_falsh B_frmax B_hshe B_lrhk B_nmot B_pwf B_sls B_st B_tal B_talval cd_bits1_w lamsons_w phlsnh rinh_w tkatm tmot tmotab ub ushk_w /end IN_MEASUREMENT
 /begin OUT_MEASUREMENT B_risigh B_sbbhk B_ttbmhh dmrlsh_w lamelsh_w /end OUT_MEASUREMENT
 /begin LOC_MEASUREMENT B_acsdh B_adsh B_adshs B_dshen B_lshklt B_maxflsh B_minflsh B_noadsh B_nolsh B_nplflsh B_sigflsh B_trsah B_ueinh B_uhsig DLSHerrors DLSHintbits /end LOC_MEASUREMENT
/end FUNCTION
/begin FUNCTION DLSSA "Signalausgabe Lambdasonden"
 /begin DEF_CHARACTERISTIC ATVFETTO ATVFETTU ATVMAGO ATVMAGU SAFK1 SAFK2 TPSVKMN TPSVKMX TUSPNMN TUSPNMX TWDLSSA USIVMAXH USIVMAXV USIVMINH USIVMINV USMNSAMN USMNSAMX USMNSHMN USMNSHMX USMXSAMN USMXSAMX USMXSHMN USMXSHMX USRHKSHJ USRJ /end DEF_CHARACTERISTIC
 /begin IN_MEASUREMENT atv B_dlatp B_lrhk B_lrtpp B_pwf tfrn_w tpsvkmf_w ushk usvk /end IN_MEASUREMENT
 /begin OUT_MEASUREMENT atvfett atvmager tpsvlssa tuspnf ushkj usmnsan usmnshn usmxsan usmxshn usrj usvkj /end OUT_MEASUREMENT
 /begin LOC_MEASUREMENT B_tuspn B_tusre dlssabits twdlssa_w twdlssh_w ushkjf_w usmnsaa usmnsha usmxsaa usmxsha usvkjf_w /end LOC_MEASUREMENT
/end FUNCTION
/begin FUNCTION DLSV "Diagnose; Sondenbetriebsbereitschaft vor Kat"
 /begin DEF_CHARACTERISTIC ABGMSIGV ANZGEM DRISIGV RISIGRESV TMASO TMNEB TMSV TMSVA TNSTDN TRSA TUSDU TUSDUC TUSEINV TUSFETT USDBO USDBU USFHK USMASO USMHK USREF USREM /end DEF_CHARACTERISTIC
 /begin REF_CHARACTERISTIC TABGMCSD TASIG TRSE TTBMH TUSKS TUSMAX UBDLS USMAX USMIN /end REF_CHARACTERISTIC
 /begin IN_MEASUREMENT B_atmtpa B_cdlsh B_cdlsv B_dsls B_dtes B_esls B_hsve B_hsve2 B_lr B_lr2 B_nmot B_pwf B_sa B_sls B_st cd_bits1_w lamsons_w rinv2_w rinv_w tabgm tmot tmotab ub ushk_w usvk2_w usvk_w /end IN_MEASUREMENT
 /begin OUT_MEASUREMENT B_dsven B_dsven2 B_lsafkn B_lsafkn2 B_sbbvk B_sbbvk2 B_ttbmh B_ttbmh2 zwgeflr zwgeflr2 /end OUT_MEASUREMENT
 /begin LOC_MEASUREMENT B_adcsd B_adcsd2 B_adde B_adde2 B_adsvb B_adsvb2 B_dmaso B_dmaso2 B_lsads B_lsads2 B_lsfet B_lsfet2 B_lshub B_lshub2 B_lsvklt B_lsvklt2 B_lsvn B_lsvn2 B_maso B_maso2 B_maxflsv B_maxflsv2 B_minflsv B_minflsv2 B_nolsv B_nolsv2 B_nplflsv B_nplflsv2 B_refmax B_refmax2 B_risigv B_risigv2 B_sigflsv B_sigflsv2 B_trsa B_trsa2 B_ueinv B_ueinv2 B_uvsig B_uvsig2 B_vadge B_vadge2 B_vgeflr B_vgeflr2 DLSVbits DLSVerrors DLSVintbits /end LOC_MEASUREMENT
/end FUNCTION
/begin FUNCTION DMDDLU "DMDDLU.exportedDiagnose Misfire Detection Differenzbildung der Laufunruhe" /begin DEF_CHARACTERISTIC DLURMIN DMXRDL KFDLUR KFDLUR1 KFDLUR2 KFDLURS NMIDLU /end DEF_CHARACTERISTIC /begin REF_CHARACTERISTIC SNM08DMUB SRL08DMUB /end REF_CHARACTERISTIC
 /begin IN_MEASUREMENT B_analu B_lustop B_mdstop B_sch B_wk B_wkr dlutsk_f esst_snm08dmub esst_srl08dmub flurktm_f fofstat fonstat nmot rl /end IN_MEASUREMENT
 /begin OUT_MEASUREMENT B_dluerk fdlurmin_f fkfdlur1_f fkfdlur2_f fkfdlurs_f fkfdlur_f /end OUT_MEASUREMENT
 /begin LOC_MEASUREMENT B_dluerk_t dlursalt_f dlurs_f /end LOC_MEASUREMENT
/end FUNCTION
/begin FUNCTION DMDFLU "DMDFLU.   Diagnose Misfire Detection Filterung der Laufunruhe" /begin DEF_CHARACTERISTIC ZLUTSFI /end DEF_CHARACTERISTIC /begin IN_MEASUREMENT B_ll B_pwf lutszyl_f luts_f zzyllfb /end IN_MEASUREMENT /begin OUT_MEASUREMENT lutsfi1_w lutsfi2_w lutsfi3_w lutsfi4_w /end OUT_MEASUREMENT /end FUNCTION
/begin FUNCTION DMDFOF "DMDFOF.   Diagnosis Misfire Detection Fuel-off Adaptation"
 /begin DEF_CHARACTERISTIC ALFOF ANWFOST ANWSTP CDFO CDFOMOD FLFOF FOFAKT FS1FOF FS2FOF KLCFOF1N KLCFOF2N KLIDXFOFN1 KLIDXFOFN2 LURFOST SI04DMUB1 SI04DMUB2 SLFOFO1N SLFOFO2N SLFOFU1N SLFOFU2N SNM06DMUW1 SNM06DMUW2 /end DEF_CHARACTERISTIC
 /begin REF_CHARACTERISTIC SNM04DMUW1 SNM04DMUW2 /end REF_CHARACTERISTIC
 /begin IN_MEASUREMENT B_autget B_fofstp B_fonresf B_mdstop B_pwf esst_snm04dmuw1 esst_snm04dmuw2 lunw_f nmot_f nmot_w tsroh_f zzyldmd zzyldmd_f /end IN_MEASUREMENT
 /begin OUT_MEASUREMENT B_clradfof B_fofr1 B_fofrun B_folunw B_fomod B_fonresd B_readap fofstat fseofkor_f tsk_f /end OUT_MEASUREMENT
 /begin LOC_MEASUREMENT anwfofs anwst B_fof1 B_fof2 B_fof3 B_fof4 B_fofd B_fofdis B_fofdr B_fofr B_fofr2 B_fofr3 B_fofr4 B_fofrun0 B_fomodold B_idxfof1 B_idxfof2 B_idxfof3 B_idxfof4 B_mdzyl1 B_zylind cfof esst_snm06dmuw1 esst_snm06dmuw2 flmxof_f flnof1_f flnof2_f flnof3_f flnof4_f flpof1_f flpof2_f flpof3_f flpof4_f fofresz fseof1_f fseof2_f fseof3_f fseof4_f fsof1_f fsof2_f fsof3_f fsof4_f idxfofl idxfofn sicurrent_f slfofo_f slfofu_f tsi1_f tsi_f xs_f zyl2 /end LOC_MEASUREMENT
/end FUNCTION
/begin FUNCTION DMDFON "DMDFON.exportedDiagnosis Misfire Detection Fuel-on Adaptation"
 /begin DEF_CHARACTERISTIC ALFO ANWFOHE DFSEFON1 DFSEFON2 DFSERES FLFO FS1FO FS2FO KFCFO1 KFCFO2 KLIDXFONN1 KLIDXFONN2 KLIDXFORL1 KLIDXFORL2 MDERKFON SIN08DMFL1 SIN08DMFL2 SIRL03DMF1 SIRL03DMF2 SLFOO1N SLFOO2N SLFOU1N SLFOU2N SNM10DMUW1 SNM10DMUW2 SRL05DMUB1 SRL05DMUB2 /end DEF_CHARACTERISTIC
 /begin REF_CHARACTERISTIC ANWFOST CDFO CDFOMOD SNM08DMUW1 SNM08DMUW2 /end REF_CHARACTERISTIC
 /begin IN_MEASUREMENT B_autget B_fofr1 B_folunw B_fomod B_fonresd B_fonresv B_fonstp B_lustop B_mderk B_mdstop B_milstp B_pwf esst_snm08dmuw1 esst_snm08dmuw2 fzabgs_w luts_f nmot_f nmot_w rl rl_f zzyllfb /end IN_MEASUREMENT
 /begin OUT_MEASUREMENT B_firstnr B_fonresf B_fonrset dfseresz_w ffon1 ffon2 fonstat fse_f /end OUT_MEASUREMENT
 /begin LOC_MEASUREMENT anwfoh_w anwfos_w B_fodon B_fohe B_fohold B_fondis B_for B_fora B_fora_old B_forn B_forna B_forun B_forun0 B_plok B_ploka B_resreq case_nr cfoxx dfse_f erg1 erg2 esst_snm10dmuw1 esst_snm10dmuw2 esst_srl05dmub1 esst_srl05dmub2 flmx_f fln00_f fln01_f fln02_f fln03_f flp00_f flp01_f flp02_f flp03_f fs00_f fs01_f fs02_f fs03_f fse00_f fse01_f fse02_f fse03_f hcount hdfse_f hflmx_f idxfob idxfobap idxfon idxfonap idxfonl idxfont idxfon_nb idxforl idxforlap idxforlt idxforl_nb idx_base idx_right idx_up idx_up_right maxfse_f minfse_f n1 n2 rl_base rl_right rl_up rl_up_right slfoo_f slfou_f /end LOC_MEASUREMENT
/end FUNCTION
/begin FUNCTION DMDLAD "DMDLAD.exportedLogic and Delay; Log. Verkn¸pfung versch. Blˆcke zur Aussetzererkennung" /begin DEF_CHARACTERISTIC ANALUN ANALUST TNALU /end DEF_CHARACTERISTIC /begin REF_CHARACTERISTIC SNM08DMUB /end REF_CHARACTERISTIC
 /begin IN_MEASUREMENT B_dluerk B_luaerk B_luerk B_lustop B_mdstop B_stpon esst_snm08dmub nmot /end IN_MEASUREMENT
 /begin OUT_MEASUREMENT B_analu B_mderk B_tnalu /end OUT_MEASUREMENT
 /begin LOC_MEASUREMENT fanalun /end LOC_MEASUREMENT
/end FUNCTION
/begin FUNCTION DMDLFB "Diagnose Misfire Detection Berechnung Laufunruhe luts und gefilterte fluts" /begin DEF_CHARACTERISTIC FLUTN FLUV1 NFLUV NINITSK NMNTKOMP /end DEF_CHARACTERISTIC
 /begin IN_MEASUREMENT B_lustop B_mdstop B_stimhelp dmdsegl_w nmot nmot_f tnst_w tsk_f zzyldmd /end IN_MEASUREMENT
 /begin OUT_MEASUREMENT dluts_f flutszyl_f fluts_f lunw_f lutszyl_f luts_f tskdelay tsknm1_f tsknm2_f tsknp1_f tsknx3_f tskn_f tsmxkomp_f z2_f zzyllfb /end OUT_MEASUREMENT
 /begin LOC_MEASUREMENT B_mdstim B_nmntkomp convert1_f convert2_f convert_f dtsarray_f dtsk_f fflutn_f stimiread stimiwri stim_array tdkomp_f tskarray_f tskin tskinm1 tskinm2 tskinmz2 tskinp1 tskinpz2 tskiwri tskixmz tskiy tskiym1 tskiyp1 tskiyp2 tskiyp3 tsklen tskll_f tskyx3_f /end LOC_MEASUREMENT
/end FUNCTION
/begin FUNCTION DMDLFK "Diagnose Misfire Detection Korrektur der Laufunruhe luts und fluts" /begin IN_MEASUREMENT B_fokstp B_mdstop dluts_f fluts_f fse_f luts_f zzyllfb /end IN_MEASUREMENT /begin OUT_MEASUREMENT dlutsk_f flutskzy_f flutsk_f lutskzyl_f lutsk_f /end OUT_MEASUREMENT /begin LOC_MEASUREMENT fsearray_f fsed_ind fsed_len fsenmz2_f /end LOC_MEASUREMENT /end FUNCTION
/begin FUNCTION DMDLU "DMDLU.exportedDiagnose misfire detection; Laufunruhe"
 /begin DEF_CHARACTERISTIC DMXRLU FIAMALU FIMALU KFAMAL KFAMAL1 KFAMAL2 KFLURB KFLURB1 KFLURB2 KFLURBS KFLURM KFLURM1 LURBRL LURKTM LURMIN1 LURMIN2 LURMIN3 LURST /end DEF_CHARACTERISTIC
 /begin REF_CHARACTERISTIC SNM08DMUB SRL08DMUB STM08DMUB /end REF_CHARACTERISTIC
 /begin IN_MEASUREMENT B_analu B_ll B_lustop B_mdstop B_wk B_wkr esst_snm08dmub esst_srl08dmub esst_stm08dmub fofstat fonstat lurminstat lutsk_f nmot rl tmot tnst_w tsknm1_f tsknm2_f tsknp1_f tsknx3_f tskn_f vfzg z2_f /end IN_MEASUREMENT
 /begin OUT_MEASUREMENT B_luerk fkfamal1_f fkfamal2_f fkfamal_f fkflurb1_f fkflurb2_f fkflurbs_f fkflurb_f fkflurm1_f fkflurm_f flurbrl_f flurktm_f flurmin1_f flurmin2_f flurmin3_f flurmin_f flurst_f /end OUT_MEASUREMENT
 /begin LOC_MEASUREMENT B_luerk_t famal_f fofstat_loc fonstat_loc lums_f lurmsalt_f lurms_f lursalt_f lurs_f /end LOC_MEASUREMENT
/end FUNCTION
/begin FUNCTION DMDLUA "DMDLUA.   Diagnose Misfire Detection Laufunruhe Abstandsmass" /begin DEF_CHARACTERISTIC DMXRFL KFLUAR KFLUAR1 KFLUAR2 KFLUARS /end DEF_CHARACTERISTIC /begin REF_CHARACTERISTIC SNM08DMUB SRL08DMUB /end REF_CHARACTERISTIC
 /begin IN_MEASUREMENT B_lustop B_mdstop B_sch B_wk B_wkr esst_snm08dmub esst_srl08dmub flurmin_f flutskzy_f flutsk_f nmot rl zzyllfb /end IN_MEASUREMENT
 /begin OUT_MEASUREMENT B_luaerk fkfluar1_f fkfluar2_f fkfluars_f fkfluar_f /end OUT_MEASUREMENT
 /begin LOC_MEASUREMENT luaralt_f luarmn_f luaroff_f luar_f /end LOC_MEASUREMENT
/end FUNCTION
/begin COMPU_METHOD B_TRUE "boolsche Zust‰nde, positive Logik" TAB_VERB "%6.3" "" COMPU_TAB_REF B_TRUE /end COMPU_METHOD
/begin COMPU_VTAB B_TRUE "boolsche Zust‰nde, positive Logik" TAB_VERB 2 0 "----" 1 "TRUE" /end COMPU_VTAB
/begin COMPU_METHOD dez "1 : 1 Umrechnug (dez/hex)" RAT_FUNC "%6.2" "" COEFFS 0 1 0 0 0 1 /end COMPU_METHOD
/begin COMPU_METHOD dez_sb "" RAT_FUNC "%4.1" "Anzahl" COEFFS 0 1 0 0 0 1 /end COMPU_METHOD
/begin COMPU_METHOD fak_q0p1 "" RAT_FUNC "%6.3" "-" COEFFS 0 1 0 0 0 0.1 /end COMPU_METHOD
/begin COMPU_METHOD fak_r32_1 "" RAT_FUNC "%43.21" "-" COEFFS 0 1 0 0 0 1 /end COMPU_METHOD
/begin COMPU_METHOD fak_sb_b1 "" RAT_FUNC "%6.4" "-" COEFFS 0 256 0 0 0 2 /end COMPU_METHOD
/begin COMPU_METHOD fak_ub_b1 "" RAT_FUNC "%6.4" "-" COEFFS 0 256 0 0 0 1 /end COMPU_METHOD
/begin COMPU_METHOD fak_ub_b2 "" RAT_FUNC "%6.4" "-" COEFFS 0 256 0 0 0 2 /end COMPU_METHOD
/begin COMPU_METHOD fak_ub_b4 "" RAT_FUNC "%6.4" "-" COEFFS 0 256 0 0 0 4 /end COMPU_METHOD
/begin COMPU_METHOD fak_ub_b8 "" RAT_FUNC "%6.4" "-" COEFFS 0 256 0 0 0 8 /end COMPU_METHOD
/begin COMPU_METHOD fak_ub_q0p01 "" RAT_FUNC "%6.4" "-" COEFFS 0 1 0 0 0 0.01 /end COMPU_METHOD
/begin COMPU_METHOD fak_uw_b1 "" RAT_FUNC "%7.6" "-" COEFFS 0 65536 0 0 0 1 /end COMPU_METHOD
/begin COMPU_METHOD fak_uw_b16 "" RAT_FUNC "%6.5" "-" COEFFS 0 65536 0 0 0 16 /end COMPU_METHOD
/begin COMPU_METHOD fak_uw_b2 "" RAT_FUNC "%7.6" "-" COEFFS 0 65536 0 0 0 2 /end COMPU_METHOD
/begin COMPU_METHOD freq_sw_b512 "" RAT_FUNC "%6.4" "1/s" COEFFS 0 65536 0 0 0 1024 /end COMPU_METHOD
/begin COMPU_METHOD luquant_w "Umrechnung Laufunruhe Word-Grˆﬂen in DMD" RAT_FUNC "%6.4" "(1/min/s)^2" COEFFS 0 256 0 0 0 0.710543 /end COMPU_METHOD
/begin COMPU_METHOD mgrad_sw_b28p44 "" RAT_FUNC "%6.5" "g/s" COEFFS 0 230.4 0 0 0 0.2 /end COMPU_METHOD
/begin COMPU_METHOD mgrad_ub_b221p35 "" RAT_FUNC "%6.2" "mg/s" COEFFS 0 230.4 0 0 0 200 /end COMPU_METHOD
/begin COMPU_METHOD mgrad_ub_b2652p5 "" RAT_FUNC "%6.1" "mg/(V*s)" COEFFS 0 9805.82 0 0 0 102000 /end COMPU_METHOD
/begin COMPU_METHOD m_q0p00277 "" RAT_FUNC "%6.4" "g" COEFFS 0 360 0 0 0 1 /end COMPU_METHOD
/begin COMPU_METHOD m_q0p00355 "" RAT_FUNC "%6.4" "kg" COEFFS 0 1125 0 0 0 4 /end COMPU_METHOD
/begin COMPU_METHOD m_q0p1 "" RAT_FUNC "%6.3" "kg/h" COEFFS 0 10 0 0 0 1 /end COMPU_METHOD
/begin COMPU_METHOD m_ub_b1020 "" RAT_FUNC "%6.2" "kg/h" COEFFS 0 1 0 0 0 4 /end COMPU_METHOD
/begin COMPU_METHOD m_ub_b221p35 "" RAT_FUNC "%6.2" "mg" COEFFS 0 230.4 0 0 0 200 /end COMPU_METHOD
/begin COMPU_METHOD nmot_ub_q10 "" RAT_FUNC "%6.1" "1/min" COEFFS 0 1 0 0 0 10 /end COMPU_METHOD
/begin COMPU_METHOD nmot_ub_q40 "" RAT_FUNC "%6.1" "1/min" COEFFS 0 1 0 0 0 40 /end COMPU_METHOD
/begin COMPU_METHOD nmot_uw_q0p25 "" RAT_FUNC "%6.3" "1/min" COEFFS 0 1 0 0 0 0.25 /end COMPU_METHOD
/begin COMPU_METHOD rel_sb_q0p75 "" RAT_FUNC "%6.3" "%" COEFFS 0 1 0 0 0 0.75 /end COMPU_METHOD
/begin COMPU_METHOD rel_sw_b1536 "" RAT_FUNC "%6.4" "%" COEFFS 0 65536 0 0 0 3072 /end COMPU_METHOD
/begin COMPU_METHOD rel_ub_q0p75 "" RAT_FUNC "%6.3" "%" COEFFS 0 1 0 0 0 0.75 /end COMPU_METHOD
/begin COMPU_METHOD rel_uw_b100 "" RAT_FUNC "%6.4" "%" COEFFS 0 65536 0 0 0 100 /end COMPU_METHOD
/begin COMPU_METHOD r_uw_q2 "" RAT_FUNC "%6.2" "Ohm" COEFFS 0 1 0 0 0 2 /end COMPU_METHOD
/begin COMPU_METHOD spgg_q0p52 "" RAT_FUNC "%6.3" "mV/ms" COEFFS 0 1 0 0 0 0.52 /end COMPU_METHOD
/begin COMPU_METHOD spgg_sw_b3052 "" RAT_FUNC "%6.3" "V/s" COEFFS 0 1 0 0 0 0.0931323 /end COMPU_METHOD
/begin COMPU_METHOD spg_sb_q0p01043 "" RAT_FUNC "%6.4" "V" COEFFS 0 255 0 0 0 2.66 /end COMPU_METHOD
/begin COMPU_METHOD spg_ubatt "" RAT_FUNC "%6.3" "V" COEFFS 0 1 0 0 0 0.0942 /end COMPU_METHOD
/begin COMPU_METHOD spg_ub_b1p33 "" RAT_FUNC "%6.4" "V" COEFFS 0 255 0 0 0 1.33 /end COMPU_METHOD
/begin COMPU_METHOD spg_ub_b24 "" RAT_FUNC "%6.3" "1/V" COEFFS 0 1 0 0 0 0.09362 /end COMPU_METHOD
/begin COMPU_METHOD spg_ub_b5 "" RAT_FUNC "%6.4" "V" COEFFS 0 256 0 0 0 5 /end COMPU_METHOD
/begin COMPU_METHOD spg_ub_q0p0052 "" RAT_FUNC "%6.4" "V" COEFFS 0 255 0 0 0 1.33 /end COMPU_METHOD
/begin COMPU_METHOD spg_ub_q0p0052_o0p2 "" RAT_FUNC "%6.3" "V" COEFFS 0 255 51 0 0 1.33 /end COMPU_METHOD
/begin COMPU_METHOD spg_uw_b1280 "" RAT_FUNC "%7.4" "V" COEFFS 0 1000 0 0 0 19.531 /end COMPU_METHOD
/begin COMPU_METHOD spg_uw_b1p33 "" RAT_FUNC "%7.6" "V" COEFFS 0 65535 0 0 0 1.33 /end COMPU_METHOD
/begin COMPU_METHOD spg_uw_q0p00488_o1 "" RAT_FUNC "%6.3" "V" COEFFS 0 1024 1024 0 0 5 /end COMPU_METHOD
/begin COMPU_METHOD t100msxs_sb_q0p01 "" RAT_FUNC "%6.4" "s" COEFFS 0 1 0 0 0 0.01 /end COMPU_METHOD
/begin COMPU_METHOD t100msxs_ub_b25p5 "" RAT_FUNC "%6.3" "s" COEFFS 0 1 0 0 0 0.1 /end COMPU_METHOD
/begin COMPU_METHOD t100msxs_uw_b6553p5 "" RAT_FUNC "%6.3" "s" COEFFS 0 1 0 0 0 0.1 /end COMPU_METHOD
/begin COMPU_METHOD t100msxs_uw_q100 "" RAT_FUNC "%6.3" "s" COEFFS 0 1 0 0 0 0.1 /end COMPU_METHOD
/begin COMPU_METHOD t10msxs_uw_b655p35 "" RAT_FUNC "%6.4" "s" COEFFS 0 1 0 0 0 0.01 /end COMPU_METHOD
/begin COMPU_METHOD t1sxs_ub_b255 "" RAT_FUNC "%6.2" "s" COEFFS 0 1 0 0 0 1 /end COMPU_METHOD
/begin COMPU_METHOD t1sxs_uw_b65535 "" RAT_FUNC "%6.2" "s" COEFFS 0 1 0 0 0 1 /end COMPU_METHOD
/begin COMPU_METHOD t200msxs_ub_b51 "" RAT_FUNC "%6.3" "s" COEFFS 0 1 0 0 0 0.2 /end COMPU_METHOD
/begin COMPU_METHOD t20msxs_ub_b5p1 "" RAT_FUNC "%6.4" "s" COEFFS 0 1 0 0 0 0.02 /end COMPU_METHOD
/begin COMPU_METHOD t40msxs_ub_q0p04 "" RAT_FUNC "%6.4" "s" COEFFS 0 1 0 0 0 0.04 /end COMPU_METHOD
/begin COMPU_METHOD t50msxs_ub_b12p75 "" RAT_FUNC "%6.4" "s" COEFFS 0 1 0 0 0 0.05 /end COMPU_METHOD
/begin COMPU_METHOD t50msxs_uw_b3276p75 "" RAT_FUNC "%6.4" "s" COEFFS 0 1 0 0 0 0.05 /end COMPU_METHOD
/begin COMPU_METHOD t50msxs_uw_b819p2 "" RAT_FUNC "%6.4" "s" COEFFS 0 1 0 0 0 0.0125 /end COMPU_METHOD
/begin COMPU_METHOD temp_ub_q0p75_o48 "" RAT_FUNC "%6.2" "Grad C" COEFFS 0 1 48 0 0 0.75 /end COMPU_METHOD
/begin COMPU_METHOD temp_ub_q5_o50 "" RAT_FUNC "%6.2" "Grad C" COEFFS 0 1 50 0 0 5 /end COMPU_METHOD
/begin COMPU_METHOD tus_uw_q3p2 "" RAT_FUNC "%6.2" "us" COEFFS 0 1 0 0 0 3.2 /end COMPU_METHOD
/begin COMPU_METHOD vfzg_ub_q1p25 "" RAT_FUNC "%6.2" "km/h" COEFFS 0 1 0 0 0 1.25 /end COMPU_METHOD
/begin COMPU_METHOD zk200msxs_ub_b51p2 "" RAT_FUNC "%6.3" "s" COEFFS 0 0 51.2 0 1 0 /end COMPU_METHOD
/begin COMPU_METHOD zk50msxs_ub_b12p8 "" RAT_FUNC "%6.3" "s" COEFFS 0 0 128 0 10 0 /end COMPU_METHOD
/begin COMPU_METHOD default "" RAT_FUNC "%6.2" "" COEFFS 0 1 0 0 0 1 /end COMPU_METHOD
/begin RECORD_LAYOUT GkfWU16 FNC_VALUES 1 UWORD COLUMN_DIR DIRECT /end RECORD_LAYOUT
/begin RECORD_LAYOUT GkfWU8 FNC_VALUES 1 UBYTE COLUMN_DIR DIRECT /end RECORD_LAYOUT
/begin RECORD_LAYOUT GklWSw FNC_VALUES 1 SWORD COLUMN_DIR DIRECT /end RECORD_LAYOUT
/begin RECORD_LAYOUT GklWU16 FNC_VALUES 1 UWORD COLUMN_DIR DIRECT /end RECORD_LAYOUT
/begin RECORD_LAYOUT GklWU8 FNC_VALUES 1 UBYTE COLUMN_DIR DIRECT /end RECORD_LAYOUT
/begin RECORD_LAYOUT GklWUb FNC_VALUES 1 UBYTE COLUMN_DIR DIRECT /end RECORD_LAYOUT
/begin RECORD_LAYOUT KfAxUbAyUbSstxUbSstyUbWUb NO_AXIS_PTS_X 1 UBYTE NO_AXIS_PTS_Y 2 UBYTE AXIS_PTS_X 3 UBYTE INDEX_INCR DIRECT AXIS_PTS_Y 4 UBYTE INDEX_INCR DIRECT FNC_VALUES 5 UBYTE COLUMN_DIR DIRECT /end RECORD_LAYOUT
/begin RECORD_LAYOUT KlAUbSstUbWUb NO_AXIS_PTS_X 1 UBYTE AXIS_PTS_X 2 UBYTE INDEX_INCR DIRECT FNC_VALUES 3 UBYTE COLUMN_DIR DIRECT /end RECORD_LAYOUT
/begin RECORD_LAYOUT KlAUwSstUwWUw NO_AXIS_PTS_X 1 UWORD AXIS_PTS_X 2 UWORD INDEX_INCR DIRECT FNC_VALUES 3 UWORD COLUMN_DIR DIRECT /end RECORD_LAYOUT
/begin RECORD_LAYOUT KlAxU8SstxR32WR32 NO_AXIS_PTS_X 1 ULONG AXIS_PTS_X 2 FLOAT32_IEEE INDEX_INCR DIRECT FNC_VALUES 3 FLOAT32_IEEE COLUMN_DIR DIRECT /end RECORD_LAYOUT
/begin RECORD_LAYOUT KlAxU8SstxU16WU16 NO_AXIS_PTS_X 1 UWORD AXIS_PTS_X 2 UWORD INDEX_INCR DIRECT FNC_VALUES 3 UWORD COLUMN_DIR DIRECT /end RECORD_LAYOUT
/begin RECORD_LAYOUT KlAxU8SstxU8WU16 NO_AXIS_PTS_X 1 UBYTE AXIS_PTS_X 2 UBYTE INDEX_INCR DIRECT FNC_VALUES 3 UWORD COLUMN_DIR DIRECT /end RECORD_LAYOUT
/begin RECORD_LAYOUT KwbWR32 FNC_VALUES 1 FLOAT32_IEEE COLUMN_DIR DIRECT /end RECORD_LAYOUT
/begin RECORD_LAYOUT KwSb FNC_VALUES 1 SBYTE COLUMN_DIR DIRECT /end RECORD_LAYOUT
/begin RECORD_LAYOUT KwSw FNC_VALUES 1 SWORD COLUMN_DIR DIRECT /end RECORD_LAYOUT
/begin RECORD_LAYOUT KwUb FNC_VALUES 1 UBYTE COLUMN_DIR DIRECT /end RECORD_LAYOUT
/begin RECORD_LAYOUT KwUw FNC_VALUES 1 UWORD COLUMN_DIR DIRECT /end RECORD_LAYOUT
/begin RECORD_LAYOUT KwWR32 FNC_VALUES 1 FLOAT32_IEEE COLUMN_DIR DIRECT /end RECORD_LAYOUT
/begin RECORD_LAYOUT KwWS16 FNC_VALUES 1 SWORD COLUMN_DIR DIRECT /end RECORD_LAYOUT
/begin RECORD_LAYOUT KwWU16 FNC_VALUES 1 UWORD COLUMN_DIR DIRECT /end RECORD_LAYOUT
/begin RECORD_LAYOUT KwWU8 FNC_VALUES 1 UBYTE COLUMN_DIR DIRECT /end RECORD_LAYOUT
/begin RECORD_LAYOUT SstAU8SstU16 NO_AXIS_PTS_X 1 UWORD AXIS_PTS_X 2 UWORD INDEX_INCR DIRECT /end RECORD_LAYOUT
/begin RECORD_LAYOUT SstAU8SstU8 NO_AXIS_PTS_X 1 UBYTE AXIS_PTS_X 2 UBYTE INDEX_INCR DIRECT /end RECORD_LAYOUT
/begin RECORD_LAYOUT SstAUbSstUb NO_AXIS_PTS_X 1 UBYTE AXIS_PTS_X 2 UBYTE INDEX_INCR DIRECT /end RECORD_LAYOUT
/end MODULE
/end PROJECT
