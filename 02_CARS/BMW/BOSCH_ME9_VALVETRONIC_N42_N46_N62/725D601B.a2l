ASAP2_VERSION 1 3
/begin PROJECT _725D601B "725D601B"
/begin HEADER "" VERSION "_725D601B" PROJECT_NO _725D601B /end HEADER
/begin MODULE DIM ""
/begin MOD_COMMON "" BYTE_ORDER MSB_FIRST ALIGNMENT_BYTE 1 ALIGNMENT_WORD 2 ALIGNMENT_LONG 2 ALIGNMENT_FLOAT32_IEEE 4 /end MOD_COMMON
/begin CHARACTERISTIC AFSTB "Anzahl rasterabh. Entprellung Fuellstandsbedingungen" VALUE 0xFD2274 KwUb 255.0 dez 0.00 255.0 FORMAT "%5.1" /end CHARACTERISTIC
/begin CHARACTERISTIC ANZRIBEH "Anzahl der Ri-Berechnungen hinter KAT" VALUE 0xFD27F2 KwUb 255.0 dez 0.00 255.0 FORMAT "%5.1" /end CHARACTERISTIC
/begin CHARACTERISTIC ANZRIWZGH "Anzahl der Ri-Berechnungen Wert zu groﬂ hinter Hauptkat" VALUE 0xFD27F3 KwUb 255.0 dez 0.00 255.0 FORMAT "%5.1" /end CHARACTERISTIC
/begin CHARACTERISTIC ANZTPMX "Maximale Anzahl von hintereinander erlaubten Tips" VALUE 0xFC2276 KwUb 255.0 dez 0.00 255.0 FORMAT "%5.1" /end CHARACTERISTIC
/begin CHARACTERISTIC ATISLATM "Anzti-Schwelle zur Umschaltung von lamns_w auf lamwl_w" CURVE 0xFD212A GklWUw 50176.00 dez 0.00 50176.00 FORMAT "%8.2"
 /begin AXIS_DESCR COM_AXIS tmst temp_ub_q0p75_o48 12 -48.00 143.3 FORMAT "%5.1" AXIS_PTS_REF STS12ESUB /end AXIS_DESCR
/end CHARACTERISTIC
/begin CHARACTERISTIC ATIWKSTM "Anzti-Schwelle zur Umschaltung von lamns_w auf lamwl_w bei Wiederholkaltstart" CURVE 0xFD2142 GklWUw 50176.00 dez 0.00 50176.00 FORMAT "%8.2"
 /begin AXIS_DESCR COM_AXIS tmst temp_ub_q0p75_o48 12 -48.00 143.3 FORMAT "%5.1" AXIS_PTS_REF STS12ESUB /end AXIS_DESCR
/end CHARACTERISTIC
/begin CHARACTERISTIC BRABEVI "Beschleunigung bei Rampe Beschleunigen" CURVE 0xFD05B8 KlAUwSstUwWUw 7110.547 bfzg_uw_q0p1085 0.00 7110.547 FORMAT "%8.3"
 /begin AXIS_DESCR STD_AXIS vfgr_w vfzg_uw_b512 8 0.00 511.9922 FORMAT "%8.4" DEPOSIT ABSOLUTE /end AXIS_DESCR
/end CHARACTERISTIC
/begin CHARACTERISTIC BRABEVI2 "Beschleunigung bei Rampe Beschleunigen im Sportmodus" CURVE 0xFD05DA KlAUwSstUwWUw 7110.547 bfzg_uw_q0p1085 0.00 7110.547 FORMAT "%8.3"
 /begin AXIS_DESCR STD_AXIS vfgr_w vfzg_uw_b512 8 0.00 511.9922 FORMAT "%8.4" DEPOSIT ABSOLUTE /end AXIS_DESCR
/end CHARACTERISTIC
/begin CHARACTERISTIC BRATD "Beschleunigung (Betrag) bei Rampe Tip-Down" VALUE 0xFC2277 KwUb 27.56 bfzg_ub_b27p67 0.00 27.56 FORMAT "%5.2" /end CHARACTERISTIC
/begin CHARACTERISTIC BRATU "Beschleunigung bei Rampe Tip-Up" VALUE 0xFC2278 KwUb 27.56 bfzg_ub_b27p67 0.00 27.56 FORMAT "%5.2" /end CHARACTERISTIC
/begin CHARACTERISTIC BRAWA1GA "Beschleunigung Rampe Wiederaufnahme im Lande-Mode Bereich 1" CURVE 0xFD05FC KlAUwSstUwWUw 7110.547 bfzg_uw_q0p1085 0.00 7110.547 FORMAT "%8.3"
 /begin AXIS_DESCR STD_AXIS vfgr_w vfzg_uw_b512 8 0.00 511.9922 FORMAT "%8.4" DEPOSIT ABSOLUTE /end AXIS_DESCR
/end CHARACTERISTIC
/begin CHARACTERISTIC BRAWA1GA2 "Beschleunigung Rampe Wiederaufnahme im Lande-Mode Bereich 1 Sportmodus" CURVE 0xFD061E KlAUwSstUwWUw 7110.547 bfzg_uw_q0p1085 0.00 7110.547 FORMAT "%8.3"
 /begin AXIS_DESCR STD_AXIS vfgr_w vfzg_uw_b512 8 0.00 511.9922 FORMAT "%8.4" DEPOSIT ABSOLUTE /end AXIS_DESCR
/end CHARACTERISTIC
/begin CHARACTERISTIC BRAWA2GA "Beschleunigung Rampe Wiederaufnahme im Lande-Mode Bereich 2" CURVE 0xFD0640 KlAUwSstUwWUw 7110.547 bfzg_uw_q0p1085 0.00 7110.547 FORMAT "%8.3"
 /begin AXIS_DESCR STD_AXIS vfgr_w vfzg_uw_b512 8 0.00 511.9922 FORMAT "%8.4" DEPOSIT ABSOLUTE /end AXIS_DESCR
/end CHARACTERISTIC
/begin CHARACTERISTIC BRAWA2GA2 "Beschleunigung Rampe Wiederaufnahme im Lande-Mode Bereich 2 Sportmodus" CURVE 0xFD0662 KlAUwSstUwWUw 7110.547 bfzg_uw_q0p1085 0.00 7110.547 FORMAT "%8.3"
 /begin AXIS_DESCR STD_AXIS vfgr_w vfzg_uw_b512 8 0.00 511.9922 FORMAT "%8.4" DEPOSIT ABSOLUTE /end AXIS_DESCR
/end CHARACTERISTIC
/begin CHARACTERISTIC BRAWA3GA "Beschleunigung Rampe Wiederaufnahme im Lande-Mode Bereich 3" CURVE 0xFD0684 KlAUwSstUwWUw 7110.547 bfzg_uw_q0p1085 0.00 7110.547 FORMAT "%8.3"
 /begin AXIS_DESCR STD_AXIS vfgr_w vfzg_uw_b512 8 0.00 511.9922 FORMAT "%8.4" DEPOSIT ABSOLUTE /end AXIS_DESCR
/end CHARACTERISTIC
/begin CHARACTERISTIC BRAWA3GA2 "Beschleunigung Rampe Wiederaufnahme im Lande-Mode Bereich 3 Sportmodus" CURVE 0xFD06A6 KlAUwSstUwWUw 7110.547 bfzg_uw_q0p1085 0.00 7110.547 FORMAT "%8.3"
 /begin AXIS_DESCR STD_AXIS vfgr_w vfzg_uw_b512 8 0.00 511.9922 FORMAT "%8.4" DEPOSIT ABSOLUTE /end AXIS_DESCR
/end CHARACTERISTIC
/begin CHARACTERISTIC BRAWAVI "Beschleunigung Rampe Wiederaufnahme" CURVE 0xFD06C8 KlAUwSstUwWUw 7110.547 bfzg_uw_q0p1085 0.00 7110.547 FORMAT "%8.3"
 /begin AXIS_DESCR STD_AXIS vfgr_w vfzg_uw_b512 8 0.00 511.9922 FORMAT "%8.4" DEPOSIT ABSOLUTE /end AXIS_DESCR
/end CHARACTERISTIC
/begin CHARACTERISTIC BRAWAVI2 "Beschleunigung Rampe Wiederaufnahme Sportmodus" CURVE 0xFD06EA KlAUwSstUwWUw 7110.547 bfzg_uw_q0p1085 0.00 7110.547 FORMAT "%8.3"
 /begin AXIS_DESCR STD_AXIS vfgr_w vfzg_uw_b512 8 0.00 511.9922 FORMAT "%8.4" DEPOSIT ABSOLUTE /end AXIS_DESCR
/end CHARACTERISTIC
/begin CHARACTERISTIC CWFGRMD "Codewort f¸r FGRMD" VALUE 0xFC2279 KwUb 255.0 dez 0.00 255.0 FORMAT "%5.1" /end CHARACTERISTIC
/begin CHARACTERISTIC CWFLSUBB "Codewort Freigabe Betriebsbereitschaft LSU" VALUE 0xFD0402 KwUb 255.0 dez 0.00 255.0 FORMAT "%5.1" /end CHARACTERISTIC
/begin CHARACTERISTIC CWGGEGAS "Codewort f¸r GGEGAS" VALUE 0xFD226E KwUb 255.0 dez 0.00 255.0 FORMAT "%5.1" /end CHARACTERISTIC
/begin CHARACTERISTIC CWGGFST "Codewort Gebergroesse Fuellstand" VALUE 0xFD2275 KwUb 255.0 dez 0.00 255.0 FORMAT "%5.1" /end CHARACTERISTIC
/begin CHARACTERISTIC CWGGHTOEL "Codewort f¸r Aktivierung Hohe Toel" VALUE 0xFD22AC KwWU8 255.0 DEZ 0.00 255.0 FORMAT "%5.1" /end CHARACTERISTIC
/begin CHARACTERISTIC CWGGLSH "Codeword f¸r Ri-Auswertung f¸r Sonde hinter KAT" VALUE 0xFD27F4 KwUb 255.0 dez 0.00 255.0 FORMAT "%5.1" /end CHARACTERISTIC
/begin CHARACTERISTIC CWGGMFL "Codewort f¸r %GGMFL ( Auswertung Multifunktionslenkrad)" VALUE 0xFC8082 KwWU8 255.0 dez 0.00 255.0 FORMAT "%5.1" /end CHARACTERISTIC
/begin CHARACTERISTIC CWWL "Codewort f¸r Warmlaufsteuerung" VALUE 0xFD1F6C KwUb 255.0 dez 0.00 255.0 FORMAT "%5.1" /end CHARACTERISTIC
/begin CHARACTERISTIC CW_FFZ "Codewort Folgefunken (aktiv: >0)" VALUE 0xFCD958 KwUb 255.0 DEZ 0.00 255.0 FORMAT "%5.1" /end CHARACTERISTIC
/begin CHARACTERISTIC CW_PDDSS "Codewort f¸r Fehlereintrag Plaus-Check Differenzdrucksensor" VALUE 0xFC800B KwUb 255.0 dez 0.00 255.0 FORMAT "%5.1" /end CHARACTERISTIC
/begin CHARACTERISTIC CW_VVTSLOW "" VALUE 0xFC5C26 KwWU8 1.000 dez 0.00 1.000 FORMAT "%5.3" /end CHARACTERISTIC
/begin CHARACTERISTIC DDSSDE "Ersatzgrˆﬂe Differenzdrucksensor Saugrohr im Fehlerfall" VALUE 0xFC7FF4 KwWS16 2559.961 p_sw_q0p039 -1280.000 1279.961 FORMAT "%8.3" /end CHARACTERISTIC
/begin CHARACTERISTIC DDSSGRAD "Gradient f¸r Differenzdrucksensor Saugrohr" VALUE 0xFC7FF6 KwWU16 1023.984 dgrad_uw_q0p015 0.00 1023.984 FORMAT "%8.3" /end CHARACTERISTIC
/begin CHARACTERISTIC DDSSOFS "Offset Differenzdrucksensor Saugrohr" VALUE 0xFC7FF8 KwWS16 2559.961 p_sw_q0p039 -1280.000 1279.961 FORMAT "%8.3" /end CHARACTERISTIC
/begin CHARACTERISTIC DHUBMD "Delta Hub bei ‹bergang B_GDVHUB zu B_GD" VALUE 0xFC5C10 KwWU16 12.00000 hub_uw_q0p001 0.00 12.00000 FORMAT "%8.5" /end CHARACTERISTIC
/begin CHARACTERISTIC DHUBMX "Maximalwert Hub Offset bei B_GDVHUB" VALUE 0xFC5C12 KwWU16 12.00000 hub_uw_q0p001 0.00 12.00000 FORMAT "%8.5" /end CHARACTERISTIC
/begin CHARACTERISTIC DHUBVH "Rampensteigung B_GB auf B_GDVHUB" VALUE 0xFC5C14 KwWU16 12.00000 hub_uw_q0p001 0.00 12.00000 FORMAT "%8.5" /end CHARACTERISTIC
/begin CHARACTERISTIC DHUBVHN "Erste Rampe bei Hub auffahren" VALUE 0xFC5C16 KwWU16 12.00000 hub_uw_q0p001 0.00 12.00000 FORMAT "%8.5" /end CHARACTERISTIC
/begin CHARACTERISTIC DHUBVHN1 "Zweite Rampe bei Hub auffahren" VALUE 0xFC5C18 KwWU16 12.00000 hub_uw_q0p001 0.00 12.00000 FORMAT "%8.5" /end CHARACTERISTIC
/begin CHARACTERISTIC DKROKD "Obere Drehzahlschwelle f¸r Nulltest-Diagnose Klopfregelung" VALUE 0xFC8064 KwUb 10200. nmot_ub_q40 0.00 10200. FORMAT "%5.0" /end CHARACTERISTIC
/begin CHARACTERISTIC DKROKMX "Maximaler Offsetkompensationswert" VALUE 0xFC8065 KwUb 4.980 spg_ub_b5 0.00 4.980 FORMAT "%5.3" /end CHARACTERISTIC
/begin CHARACTERISTIC DKROKO "Obere Drehzahlschwelle f¸r Ermittlung Offsetkompensationswert" VALUE 0xFC8066 KwUb 10200. nmot_ub_q40 0.00 10200. FORMAT "%5.0" /end CHARACTERISTIC
/begin CHARACTERISTIC DLAMNSWL "max. Abweichung f¸r lamnswl_w=1.0" VALUE 0xFC7374 KwUb 0.9961 fak_ub_b1 0.00 0.9961 /end CHARACTERISTIC
/begin CHARACTERISTIC DMRFGRAL "Delta Relatives Moment bei langsamer FGR-Abschaltung" VALUE 0xFC2272 KwUw 199.9969 rel_uw_b200 0.00 199.9969 FORMAT "%8.4" /end CHARACTERISTIC
/begin CHARACTERISTIC DNWE "" VALUE 0xFC5C27 KwWU8 10200. nmot_ub_q40 0.00 10200. FORMAT "%5.0" /end CHARACTERISTIC
/begin CHARACTERISTIC DNWELLK "Umschaltung auf LL-Kennlinie erst unterhalb von ( nwe + DNWELLK )" VALUE 0xFC5C28 KwWU8 10200. nmot_ub_q40 0.00 10200. FORMAT "%5.0" /end CHARACTERISTIC
/begin CHARACTERISTIC DPDSVLU "Delta Druckwert f¸r Signalvergleich Ladedruck mit Umgebungsdruck" VALUE 0xFD260E KwUw 2559.961 p_uw_q0p039 0.00 2559.961 FORMAT "%8.3" /end CHARACTERISTIC
/begin CHARACTERISTIC DPLLMX "Maximales Druckverh‰ltnis im LL gedrosselt" VALUE 0xFC525A KwWU16 1.999969 fak_uw_b2 0.00 1.999969 FORMAT "%8.6" /end CHARACTERISTIC
/begin CHARACTERISTIC DPSFGDVH "							" VALUE 0xFC4914 KwWU8 1.000 fak_ub_q0p00392 0.00 1.000 FORMAT "%5.3" /end CHARACTERISTIC
/begin CHARACTERISTIC DPSGRADDR "							" VALUE 0xFC48EE KwWS16 2559.961 zk_p_q0p039 -1280.000 1279.961 FORMAT "%8.3" /end CHARACTERISTIC
/begin CHARACTERISTIC DPSGRADTD "Filterparameter f¸r Druckvorsteuerungsfilter bei positivem Gradienten" VALUE 0xFC48F0 KwWU16 0.9999847 fak_uw_b1 0.00 0.9999847 FORMAT "%9.7" /end CHARACTERISTIC
/begin CHARACTERISTIC DPSGRADUTD "Filterparameter f¸r Druckvorsteuerungsfilter bei negativem Gradienten" VALUE 0xFC48F2 KwWU16 0.9999847 fak_uw_b1 0.00 0.9999847 FORMAT "%9.7" /end CHARACTERISTIC
/begin CHARACTERISTIC DPSGRENDK "Grenzwert Drosselklappensollwinkel zur Umschaltung der Filterzeitkonstanten" VALUE 0xFC525C KwWS16 2559.961 p_q0p039 -1280.000 1279.961 FORMAT "%8.3" /end CHARACTERISTIC
/begin CHARACTERISTIC DPSGRENZ "Begrenzung Differenzdruck Saugrohr f¸r ‹bergang ungedrosselt in gedrosselt" VALUE 0xFC48F4 KwWU16 1279.688 p_q0p039 0.00 1279.688 FORMAT "%8.3" /end CHARACTERISTIC
/begin CHARACTERISTIC DPSMN "minimaler Drosselfaktor f¸r Reglerstop" VALUE 0xFC48F6 KwWU16 1279.688 p_q0p039 0.00 1279.688 FORMAT "%8.3" /end CHARACTERISTIC
/begin CHARACTERISTIC DPSMX "maximaler Drosselfaktor f¸r Reglerstop" VALUE 0xFC48F8 KwWU16 1279.688 p_q0p039 0.00 1279.688 FORMAT "%8.3" /end CHARACTERISTIC
/begin CHARACTERISTIC DPSPLAUS "Kennlinie Schwellwert f¸r DPS Plausibilisierung" CURVE 0xFD2668 KlAUwSstSwWUw 2557.969 p_q0p039 -1278.984 1278.984 FORMAT "%8.3"
 /begin AXIS_DESCR STD_AXIS dpssolf_w p_sw_q0p039 8 -1280.000 1279.961 FORMAT "%8.3" DEPOSIT ABSOLUTE /end AXIS_DESCR
/end CHARACTERISTIC
/begin CHARACTERISTIC DPSRAMPE "Rampe f¸r Differenzdruck Saugrohr" VALUE 0xFC4915 KwWU8 9.961 p_q0p039 0.00 9.961 FORMAT "%5.3" /end CHARACTERISTIC
/begin CHARACTERISTIC DPSTDMAMX "" VALUE 0xFD126E KwUw 2559.96 p_q0p039s32768 -1280.00 1279.96 FORMAT "%7.2" /end CHARACTERISTIC
/begin CHARACTERISTIC DPUPVDK "Differenzdruck pu-pvdk" CURVE 0xFD2610 KlAUwSstUwWUw 2559.961 p_uw_q0p039 0.00 2559.961 FORMAT "%8.3"
 /begin AXIS_DESCR STD_AXIS ml_w m_uw_b6553p5 8 0.00 6553.500 FORMAT "%8.3" DEPOSIT ABSOLUTE /end AXIS_DESCR
/end CHARACTERISTIC
/begin CHARACTERISTIC DSUGRAD "Gradient f¸r Drucksensor Umgebung" VALUE 0xFD2632 KwUw 1023.984 dgrad_uw_q0p015 0.00 1023.984 FORMAT "%8.3" /end CHARACTERISTIC
/begin CHARACTERISTIC DSUOFS "Offset Drucksensor Umgebung" VALUE 0xFD2634 KwSw 2559.961 p_sw_q0p039 -1280.000 1279.961 FORMAT "%8.3" /end CHARACTERISTIC
/begin CHARACTERISTIC DUDKP1HY "Offset f¸r Hysterese bei Umschaltung auf verst‰rktes Signal von DK-Poti 1" VALUE 0xFC1F8C KwUw 79.99878 spg_uw_q0p001222 0.00 79.99878 FORMAT "%8.5" /end CHARACTERISTIC
/begin CHARACTERISTIC DUSRIH "Delta Sondenspannung hinter Kat zwischen Neu-und Altwert  f¸r Ri-Messung" VALUE 0xFC806A KwSw 319.9951 spg_sw_q0p00488 -160.0000 159.9951 FORMAT "%8.4" /end CHARACTERISTIC
/begin CHARACTERISTIC DUSSPH "Delta Sondensp. hinter Kat zwischen Neu-und 2 Altwerten f¸r Sonden Sprungmessung" VALUE 0xFC806C KwSw 319.9951 spg_sw_q0p00488 -160.0000 159.9951 FORMAT "%8.4" /end CHARACTERISTIC
/begin CHARACTERISTIC DVIVZTMX "Maximales Delta zw. Ist- und Zielgeschw. f¸r Tip-Erlaubnis" VALUE 0xFC227C KwUw 511.9922 vfzg_uw_b512 0.00 511.9922 FORMAT "%8.4" /end CHARACTERISTIC
/begin CHARACTERISTIC DVSAVO "Delta Geschwindigkeit f¸r R¸cksetzen Schubabschalteverbot vom FGR" VALUE 0xFC227E KwUw 511.9922 vfzg_uw_b512 0.00 511.9922 FORMAT "%8.4" /end CHARACTERISTIC
/begin CHARACTERISTIC DVSAVU "Delta Geschwindigkeit f¸r Setzen Schubabschalteverbot vom FGR" VALUE 0xFC2280 KwUw 511.9922 vfzg_uw_b512 0.00 511.9922 FORMAT "%8.4" /end CHARACTERISTIC
/begin CHARACTERISTIC DVSKNBGA "Delta Geschwindigkeit f¸r Setzwertkorrektur nach Beschleunigen" CURVE 0xFD070C KlAUwSstUwWUw 511.9922 vfzg_uw_b512 0.00 511.9922 FORMAT "%8.4"
 /begin AXIS_DESCR STD_AXIS gangi dez 8 0.00 255.0 FORMAT "%5.1" DEPOSIT ABSOLUTE /end AXIS_DESCR
/end CHARACTERISTIC
/begin CHARACTERISTIC DVSKNVGA "Delta Geschwindigkeit f¸r Setzwertkorrektur nach Verzˆgern" CURVE 0xFD072E KlAUwSstUwWUw 511.9922 vfzg_uw_b512 0.00 511.9922 FORMAT "%8.4"
 /begin AXIS_DESCR STD_AXIS gangi dez 8 0.00 255.0 FORMAT "%5.1" DEPOSIT ABSOLUTE /end AXIS_DESCR
/end CHARACTERISTIC
/begin CHARACTERISTIC DVTIPUD "ƒnderung der Zielgeschwindigkeit bei Tip-Up oder Tip-Down" VALUE 0xFC2282 KwUw 511.9922 vfzg_uw_b512 0.00 511.9922 FORMAT "%8.4" /end CHARACTERISTIC
/begin CHARACTERISTIC DVZVITMX "Maximales Delta zw. Ziel- und Istgeschw. f¸r Tip-Erlaubnis" VALUE 0xFC2284 KwUw 511.9922 vfzg_uw_b512 0.00 511.9922 FORMAT "%8.4" /end CHARACTERISTIC
/begin CHARACTERISTIC DVZVIWA "Delta zw. Ziel- und Istgeschw. f¸r ‹bergang von Konstantfahrt in Wiederaufnahme" VALUE 0xFC2286 KwUw 511.9922 vfzg_uw_b512 0.00 511.9922 FORMAT "%8.4" /end CHARACTERISTIC
/begin CHARACTERISTIC DVZVRWA1 "Delta zw. Ziel- und Sollgeschw. f¸r ‹bergang in WA-Lande-Mode Bereich 1" VALUE 0xFC2288 KwUw 511.9922 vfzg_uw_b512 0.00 511.9922 FORMAT "%8.4" /end CHARACTERISTIC
/begin CHARACTERISTIC DVZVRWA2 "Delta zw. Ziel- und Sollgeschw. f¸r ‹bergang in WA-Lande-Mode Bereich 2" VALUE 0xFC228A KwUw 511.9922 vfzg_uw_b512 0.00 511.9922 FORMAT "%8.4" /end CHARACTERISTIC
/begin CHARACTERISTIC DVZVRWA3 "Delta zw. Ziel- und Sollgeschw. f¸r ‹bergang in WA-Lande-Mode Bereich 3" VALUE 0xFC228C KwUw 511.9922 vfzg_uw_b512 0.00 511.9922 FORMAT "%8.4" /end CHARACTERISTIC
/begin CHARACTERISTIC DWDK12O "Maximal zul‰ssige Abweichung zwischen den DK-Winkeln aus Poti 1 und 2" VALUE 0xFC1F6E KwUb 100.0 relDK_ub_b100 0.00 100.0 FORMAT "%5.1" /end CHARACTERISTIC
/begin CHARACTERISTIC DWDK13O "Maximal zul‰ssige Abweichung zwischen DK-Winkel aus Poti 1 und Ersatzwert" VALUE 0xFC1F6F KwUb 100.0 relDK_ub_b100 0.00 100.0 FORMAT "%5.1" /end CHARACTERISTIC
/begin CHARACTERISTIC DWDK23O "Maximal zul‰ssige Abweichung zwischen DK-Winkel aus Poti 2 und Ersatzwert" VALUE 0xFC1F70 KwUb 100.0 relDK_ub_b100 0.00 100.0 FORMAT "%5.1" /end CHARACTERISTIC
/begin CHARACTERISTIC ERRVVTHUB "Notlaufhub" VALUE 0xFC5C1A KwWU16 12.00000 hub_uw_q0p001 0.00 12.00000 FORMAT "%8.5" /end CHARACTERISTIC
/begin CHARACTERISTIC EVHUBSOFKF "" VALUE 0xFD1270 KwUw 65.53500 hub_uw_q0p001 0.00 65.53500 FORMAT "%8.5" /end CHARACTERISTIC
/begin CHARACTERISTIC FFLDZ "Folgefunkenladezeit" CURVE 0xFCD99A KlAUwSstUwWUw 24.95000 txms_uw_q0p001 0.05000000 25.00000 FORMAT "%8.5"
 /begin AXIS_DESCR STD_AXIS ub_w spg_ubatt 8 0.00 6173.397 FORMAT "%8.3" DEPOSIT ABSOLUTE /end AXIS_DESCR
/end CHARACTERISTIC
/begin CHARACTERISTIC FFZOF "Folgefunkenoffenzeit" VALUE 0xFCD9BC KwUw 11.95000 txms_uw_q0p001 0.05000000 12.00000 FORMAT "%8.5" /end CHARACTERISTIC
/begin CHARACTERISTIC FHOE "Ersatzwert f¸r Hˆhe" VALUE 0xFD25F6 KwUb 3.984 fak_ub_b4 0.00 3.984 FORMAT "%5.3" /end CHARACTERISTIC
/begin CHARACTERISTIC FHOMIN "Minimaler Hˆhenfaktor" VALUE 0xFC4916 KwWU8 3.984 fak_ub_b4 0.00 3.984 FORMAT "%5.3" /end CHARACTERISTIC
/begin CHARACTERISTIC FHUBVNSMN "Untere Grenze f¸r fhubvnsf_w" VALUE 0xFC5C1C KwWU16 1.999969 fak_uw_b2 0.00 1.999969 FORMAT "%8.6" /end CHARACTERISTIC
/begin CHARACTERISTIC FHUBVNSMX "Obere Grenze f¸r fhubvnsf_w" VALUE 0xFC5C1E KwWU16 1.999969 fak_uw_b2 0.00 1.999969 FORMAT "%8.6" /end CHARACTERISTIC
/begin CHARACTERISTIC FHUBWLL "" CURVE 0xFC5BEA KlAxU8SstxU8WU8 0.9961 fakspr_q0p0039 0.00 0.9961
 /begin AXIS_DESCR STD_AXIS tmot temp_ub_q0p75_o48 6 -48.00 143.3 FORMAT "%5.1" DEPOSIT ABSOLUTE /end AXIS_DESCR
/end CHARACTERISTIC
/begin CHARACTERISTIC FKDPS "Filterkonstante f¸r DPS-Filter" VALUE 0xFC7FFA KwWU16 99.99847 rel_uw_b100 0.00 99.99847 FORMAT "%8.5" /end CHARACTERISTIC
/begin CHARACTERISTIC FMFKRN1 "Filtermittenfrequenz f¸r Bandpaﬂfilter Klopfregelung Zyl. 1" CURVE 0xFC800C KlAxU8SstxU8WU8 255.0 fmfkr_dez 0.00 255.0 FORMAT "%5.1"
 /begin AXIS_DESCR STD_AXIS nmot nmot_ub_q40 5 0.00 10200. FORMAT "%5.0" DEPOSIT ABSOLUTE /end AXIS_DESCR
/end CHARACTERISTIC
/begin CHARACTERISTIC FMFKRN2 "Filtermittenfrequenz f¸r Bandpaﬂfilter Klopfregelung Zyl. 2" CURVE 0xFC8017 KlAxU8SstxU8WU8 255.0 fmfkr_dez 0.00 255.0 FORMAT "%5.1"
 /begin AXIS_DESCR STD_AXIS nmot nmot_ub_q40 5 0.00 10200. FORMAT "%5.0" DEPOSIT ABSOLUTE /end AXIS_DESCR
/end CHARACTERISTIC
/begin CHARACTERISTIC FMFKRN3 "Filtermittenfrequenz f¸r Bandpaﬂfilter Klopfregelung Zyl. 3" CURVE 0xFC8022 KlAxU8SstxU8WU8 255.0 fmfkr_dez 0.00 255.0 FORMAT "%5.1"
 /begin AXIS_DESCR STD_AXIS nmot nmot_ub_q40 5 0.00 10200. FORMAT "%5.0" DEPOSIT ABSOLUTE /end AXIS_DESCR
/end CHARACTERISTIC
/begin CHARACTERISTIC FMFKRN4 "Filtermittenfrequenz f¸r Bandpaﬂfilter Klopfregelung Zyl. 4" CURVE 0xFC802D KlAxU8SstxU8WU8 255.0 fmfkr_dez 0.00 255.0 FORMAT "%5.1"
 /begin AXIS_DESCR STD_AXIS nmot nmot_ub_q40 5 0.00 10200. FORMAT "%5.0" DEPOSIT ABSOLUTE /end AXIS_DESCR
/end CHARACTERISTIC
/begin CHARACTERISTIC FMFKRN5 "Filtermittenfrequenz f¸r Bandpaﬂfilter Klopfregelung Zyl. 5" CURVE 0xFC8038 KlAxU8SstxU8WU8 255.0 fmfkr_dez 0.00 255.0 FORMAT "%5.1"
 /begin AXIS_DESCR STD_AXIS nmot nmot_ub_q40 5 0.00 10200. FORMAT "%5.0" DEPOSIT ABSOLUTE /end AXIS_DESCR
/end CHARACTERISTIC
/begin CHARACTERISTIC FMFKRN6 "Filtermittenfrequenz f¸r Bandpaﬂfilter Klopfregelung Zyl. 6" CURVE 0xFC8043 KlAxU8SstxU8WU8 255.0 fmfkr_dez 0.00 255.0 FORMAT "%5.1"
 /begin AXIS_DESCR STD_AXIS nmot nmot_ub_q40 5 0.00 10200. FORMAT "%5.0" DEPOSIT ABSOLUTE /end AXIS_DESCR
/end CHARACTERISTIC
/begin CHARACTERISTIC FMFKRN7 "Filtermittenfrequenz f¸r Bandpaﬂfilter Klopfregelung Zyl. 7" CURVE 0xFC804E KlAxU8SstxU8WU8 255.0 fmfkr_dez 0.00 255.0 FORMAT "%5.1"
 /begin AXIS_DESCR STD_AXIS nmot nmot_ub_q40 5 0.00 10200. FORMAT "%5.0" DEPOSIT ABSOLUTE /end AXIS_DESCR
/end CHARACTERISTIC
/begin CHARACTERISTIC FMFKRN8 "Filtermittenfrequenz f¸r Bandpaﬂfilter Klopfregelung Zyl. 8" CURVE 0xFC8059 KlAxU8SstxU8WU8 255.0 fmfkr_dez 0.00 255.0 FORMAT "%5.1"
 /begin AXIS_DESCR STD_AXIS nmot nmot_ub_q40 5 0.00 10200. FORMAT "%5.0" DEPOSIT ABSOLUTE /end AXIS_DESCR
/end CHARACTERISTIC
/begin CHARACTERISTIC FPHUBAPP "Hubverstellungskennlinie abh. vom Fahrpedal nur f. Applik." CURVE 0xFC5AB8 KlAxU8SstxU16WU16 12.00000 hub_uw_q0p001 0.00 12.00000 FORMAT "%8.5"
 /begin AXIS_DESCR STD_AXIS wped_w relPED_uw_b100 16 0.00 100.0000 FORMAT "%8.4" DEPOSIT ABSOLUTE /end AXIS_DESCR
/end CHARACTERISTIC
/begin CHARACTERISTIC FPUPSMAX "" VALUE 0xFC48FA KwWU16 7.999878 fak_uw_b8 0.00 7.999878 FORMAT "%8.6" /end CHARACTERISTIC
/begin CHARACTERISTIC FPWDKAPP "Drosselklappenkennlinie abh. von Fahrpedal nur f. Applik." CURVE 0xFC50A8 KlAxU8SstxU16WU16 99.99847 rel_uw_b100 0.00 99.99847 FORMAT "%8.5"
 /begin AXIS_DESCR STD_AXIS wped_w relPED_uw_b100 16 0.00 100.0000 FORMAT "%8.4" DEPOSIT ABSOLUTE /end AXIS_DESCR
/end CHARACTERISTIC
/begin CHARACTERISTIC FQFSTT "Quantisierungsfaktor Fuellstand" VALUE 0xFD2276 KwUb 25.50 vol_q0p1_l 0.00 25.50 FORMAT "%5.2" /end CHARACTERISTIC
/begin CHARACTERISTIC FRINOF "Faktor f¸r Bewertung alter Ri-Wert ohne Filter" VALUE 0xFC8068 KwUb 15.94 fak_ub_b16 0.00 15.94 FORMAT "%5.2" /end CHARACTERISTIC
/begin CHARACTERISTIC FSTDMN "minimaler Tankfuellstand fuer Tankdiagnosefunktionen" VALUE 0xFD2278 KwUw 6553.500 vol_q0p1_l 0.00 6553.500 FORMAT "%8.3" /end CHARACTERISTIC
/begin CHARACTERISTIC FSTDMX "maximaler Tankfuellstand fuer Tankdiagnosefunktionen" VALUE 0xFD227A KwUw 6553.500 vol_q0p1_l 0.00 6553.500 FORMAT "%8.3" /end CHARACTERISTIC
/begin CHARACTERISTIC FSTDTOL "Toleranz Fuellstandsdynamik" VALUE 0xFD227C KwUw 6553.500 vol_q0p1_l 0.00 6553.500 FORMAT "%8.3" /end CHARACTERISTIC
/begin CHARACTERISTIC FSTHYS "Hysterese fuer Tankfuellstandsschwellen B_tal, B_tav, etc." VALUE 0xFD227E KwUw 6553.500 vol_q0p1_l 0.00 6553.500 FORMAT "%8.3" /end CHARACTERISTIC
/begin CHARACTERISTIC FSTTAL "Tankfuellstand fuer ""Tank leer"" Erkennung" VALUE 0xFD2280 KwUw 6553.500 vol_q0p1_l 0.00 6553.500 FORMAT "%8.3" /end CHARACTERISTIC
/begin CHARACTERISTIC FSTTAL1 "Tankfuellstand fuer ""Tank leer"" Erkennung Tank1" VALUE 0xFD2282 KwUw 6553.500 vol_q0p1_l 0.00 6553.500 FORMAT "%8.3" /end CHARACTERISTIC
/begin CHARACTERISTIC FSTTAV "Tankfuellstand fuer ""Tank voll"" Erkennung" VALUE 0xFD2284 KwUw 6553.500 vol_q0p1_l 0.00 6553.500 FORMAT "%8.3" /end CHARACTERISTIC
/begin CHARACTERISTIC FSTTEW "Ersatzwert Fuellstand Kraftstofftank" VALUE 0xFD2286 KwUw 6553.500 vol_q0p1_l 0.00 6553.500 FORMAT "%8.3" /end CHARACTERISTIC
/begin CHARACTERISTIC FSTTMX "maximaler Tankinhalt" VALUE 0xFD2288 KwUw 319.9951 vol_q4p8828Em3_l 0.00 319.9951 FORMAT "%8.4" /end CHARACTERISTIC
/begin CHARACTERISTIC GVTMX "Gasvolumen Tank maximal" VALUE 0xFD228A KwUw 319.9951 vol_q4p8828Em3_l 0.00 319.9951 FORMAT "%8.4" /end CHARACTERISTIC
/begin CHARACTERISTIC HUBAPP "Hubsollwert f¸r Applikationszwecke" VALUE 0xFC5C20 KwWU16 12.00000 hub_uw_q0p001 0.00 12.00000 FORMAT "%8.5" /end CHARACTERISTIC
/begin CHARACTERISTIC HUBSGNL "Hubsollwert f¸r Steuerger‰tenachlauf" VALUE 0xFC5C22 KwWU16 12.00000 hub_uw_q0p001 0.00 12.00000 FORMAT "%8.5" /end CHARACTERISTIC
/begin CHARACTERISTIC HUBST "Schalter f¸r Hubvorsteuerung im Start" VALUE 0xFC5C29 KwWU8 1.000 dez 0.00 1.000 FORMAT "%5.3" /end CHARACTERISTIC
/begin CHARACTERISTIC KEMLN "Messfensterl‰nge f¸r Klopfregelung" CURVE 0xFD272E KlAUbSstUbWUb 191.3 zw_ub_q0p75 0.00 191.3 FORMAT "%5.1"
 /begin AXIS_DESCR STD_AXIS nmot nmot_ub_q40 16 0.00 10200. FORMAT "%5.0" DEPOSIT ABSOLUTE /end AXIS_DESCR
/end CHARACTERISTIC
/begin CHARACTERISTIC KFANFLVNS "Wichtung Fl‰chenanteil" MAP 0xFC5AA4 KfAxU8AyU8SstxU8SstyU8WU8 3.984 fak_ub_b4 0.00 3.984 FORMAT "%5.3"
 /begin AXIS_DESCR STD_AXIS nmot nmot_ub_q40 2 0.00 10200. FORMAT "%5.0" DEPOSIT ABSOLUTE /end AXIS_DESCR
 /begin AXIS_DESCR STD_AXIS rlvw rel_ub_q0p75 2 0.00 191.3 FORMAT "%5.1" DEPOSIT ABSOLUTE /end AXIS_DESCR
/end CHARACTERISTIC
/begin CHARACTERISTIC KFDPGRADDR "Kennfeld Differenzdruckgradient gedrosselt" MAP 0xFD1272 KfAxUwAyUwSstxUwSstyUwWSw 2559.961 zk_p_q0p039 -1280.000 1279.961 FORMAT "%8.3"
 /begin AXIS_DESCR STD_AXIS nmot_w nmot_uw_q0p25 6 0.00 16383.75 FORMAT "%8.2" DEPOSIT ABSOLUTE /end AXIS_DESCR
 /begin AXIS_DESCR STD_AXIS rl_w rel_uw_q0p0234 6 0.00 1535.977 FORMAT "%8.3" DEPOSIT ABSOLUTE /end AXIS_DESCR
/end CHARACTERISTIC
/begin CHARACTERISTIC KFDPGRAUD "Kennfeld Differenzdruckgradient ungedrosselt" MAP 0xFD12D6 KfAxUwAyUwSstxUwSstyUwWSw 2559.961 zk_p_q0p039 -1280.000 1279.961 FORMAT "%8.3"
 /begin AXIS_DESCR STD_AXIS nmot_w nmot_uw_q0p25 6 0.00 16383.75 FORMAT "%8.2" DEPOSIT ABSOLUTE /end AXIS_DESCR
 /begin AXIS_DESCR STD_AXIS rl_w rel_uw_q0p0234 6 0.00 1535.977 FORMAT "%8.3" DEPOSIT ABSOLUTE /end AXIS_DESCR
/end CHARACTERISTIC
/begin CHARACTERISTIC KFDPS "Kennfeld f¸r Differenzdruckvorgabe" MAP 0xFC41B0 KfAxU16AyU16SstxU16SstyU16WU16 2559.96 p_q0p039s32768 -1280.00 1279.96 FORMAT "%7.2"
 /begin AXIS_DESCR STD_AXIS nmot_w nmot_uw_q0p25 4 0.00 16383.75 FORMAT "%8.2" DEPOSIT ABSOLUTE /end AXIS_DESCR
 /begin AXIS_DESCR STD_AXIS rlvw_w rel_uw_q0p0234 4 0.00 1535.977 FORMAT "%8.3" DEPOSIT ABSOLUTE /end AXIS_DESCR
/end CHARACTERISTIC
/begin CHARACTERISTIC KFDPSMAX "Kennfeld f¸r maximale Differenzdruckvorgabe" MAP 0xFC41E4 KfAxU16AyU16SstxU16SstyU16WU16 2559.96 p_q0p039s32768 -1280.00 1279.96 FORMAT "%7.2"
 /begin AXIS_DESCR STD_AXIS nmot_w nmot_uw_q0p25 8 0.00 16383.75 FORMAT "%8.2" DEPOSIT ABSOLUTE /end AXIS_DESCR
 /begin AXIS_DESCR STD_AXIS rlvw_w rel_uw_q0p0234 8 0.00 1535.977 FORMAT "%8.3" DEPOSIT ABSOLUTE /end AXIS_DESCR
/end CHARACTERISTIC
/begin CHARACTERISTIC KFDPSMIN "Kennfeld f¸r minimale Differenzdruckvorgabe" MAP 0xFC4288 KfAxU16AyU16SstxU16SstyU16WU16 2559.96 p_q0p039s32768 -1280.00 1279.96 FORMAT "%7.2"
 /begin AXIS_DESCR STD_AXIS nmot_w nmot_uw_q0p25 8 0.00 16383.75 FORMAT "%8.2" DEPOSIT ABSOLUTE /end AXIS_DESCR
 /begin AXIS_DESCR STD_AXIS rlvw_w rel_uw_q0p0234 8 0.00 1535.977 FORMAT "%8.3" DEPOSIT ABSOLUTE /end AXIS_DESCR
/end CHARACTERISTIC
/begin CHARACTERISTIC KFDPSMX "Kennfeld maximaler Differenzdruck" MAP 0xFD268A KfAxUwAyUwSstxUwSstyUwWSw 2559.961 p_sw_q0p039 -1280.000 1279.961 FORMAT "%8.3"
 /begin AXIS_DESCR STD_AXIS wdkba_w relDK_q0p02441 8 -800.0000 799.9756 FORMAT "%8.4" DEPOSIT ABSOLUTE /end AXIS_DESCR
 /begin AXIS_DESCR STD_AXIS nmot_w nmot_uw_q0p25 8 0.00 16383.75 FORMAT "%8.2" DEPOSIT ABSOLUTE /end AXIS_DESCR
/end CHARACTERISTIC
/begin CHARACTERISTIC KFEHUB "Kennfeld f¸r Hubverstellung (ungedrosselt)" MAP 0xFC5268 KfAxU8AyU8SstxU16SstyU16WU16 12.00000 hub_uw_q0p001 0.00 12.00000 FORMAT "%8.5"
 /begin AXIS_DESCR STD_AXIS nmot_w nmot_uw_q0p25 16 0.00 16383.75 FORMAT "%8.2" DEPOSIT ABSOLUTE /end AXIS_DESCR
 /begin AXIS_DESCR STD_AXIS rlvwvvt_w rel_uw_q0p0234 16 0.00 1535.977 FORMAT "%8.3" DEPOSIT ABSOLUTE /end AXIS_DESCR
/end CHARACTERISTIC
/begin CHARACTERISTIC KFEHUBLL "Leerlauf Kennfeld f¸r Hubverstellung" MAP 0xFC54AC KfAxU8AyU8SstxU16SstyU16WU16 12.00000 hub_uw_q0p001 0.00 12.00000 FORMAT "%8.5"
 /begin AXIS_DESCR STD_AXIS mlsolkor_w m_uw_b1638p4 21 0.00 1638.375 FORMAT "%8.3" DEPOSIT ABSOLUTE /end AXIS_DESCR
 /begin AXIS_DESCR STD_AXIS nmot_w nmot_uw_q0p25 6 0.00 16383.75 FORMAT "%8.2" DEPOSIT ABSOLUTE /end AXIS_DESCR
/end CHARACTERISTIC
/begin CHARACTERISTIC KFEHUBLLK "" MAP 0xFC55E2 KfAxU8AyU8SstxU16SstyU16WU16 12.00000 hub_uw_q0p001 0.00 12.00000 FORMAT "%8.5"
 /begin AXIS_DESCR STD_AXIS mlsolkor_w m_uw_b1638p4 21 0.00 1638.375 FORMAT "%8.3" DEPOSIT ABSOLUTE /end AXIS_DESCR
 /begin AXIS_DESCR STD_AXIS nmot_w nmot_uw_q0p25 6 0.00 16383.75 FORMAT "%8.2" DEPOSIT ABSOLUTE /end AXIS_DESCR
/end CHARACTERISTIC
/begin CHARACTERISTIC KFEHUBST "Kennfeld f¸r Hubvorsteuerung im Start" MAP 0xFC5718 KfAxU8AyU8SstxU16SstyU16WU16 12.00000 hub_uw_q0p001 0.00 12.00000 FORMAT "%8.5"
 /begin AXIS_DESCR STD_AXIS nmot_w nmot_uw_q0p25 8 0.00 16383.75 FORMAT "%8.2" DEPOSIT ABSOLUTE /end AXIS_DESCR
 /begin AXIS_DESCR STD_AXIS rlvw_w rel_uw_q0p0234 8 0.00 1535.977 FORMAT "%8.3" DEPOSIT ABSOLUTE /end AXIS_DESCR
/end CHARACTERISTIC
/begin CHARACTERISTIC KFEHUBSTM "" MAP 0xFC57BC KfAxU8AyU8SstxU16SstyU16WU16 12.00000 hub_uw_q0p001 0.00 12.00000 FORMAT "%8.5"
 /begin AXIS_DESCR STD_AXIS nmot_w nmot_uw_q0p25 8 0.00 16383.75 FORMAT "%8.2" DEPOSIT ABSOLUTE /end AXIS_DESCR
 /begin AXIS_DESCR STD_AXIS tmst temp_ub_q0p75_o48 8 -48.00 143.3 FORMAT "%5.1" DEPOSIT ABSOLUTE /end AXIS_DESCR
/end CHARACTERISTIC
/begin CHARACTERISTIC KFESVNS "Wichtung ES-Volumen" MAP 0xFC5AAE KfAxU8AyU8SstxU8SstyU8WU8 1.992 fak_ub_b2 0.00 1.992 FORMAT "%5.3"
 /begin AXIS_DESCR STD_AXIS nmot nmot_ub_q40 2 0.00 10200. FORMAT "%5.0" DEPOSIT ABSOLUTE /end AXIS_DESCR
 /begin AXIS_DESCR STD_AXIS rlvw rel_ub_q0p75 2 0.00 191.3 FORMAT "%5.1" DEPOSIT ABSOLUTE /end AXIS_DESCR
/end CHARACTERISTIC
/begin CHARACTERISTIC KFFFANZ "Anzahl Folgefunken" MAP 0xFCD959 KfAxUbAyUbSstxUbSstyUbWUb 255.0 dez 0.00 255.0 FORMAT "%5.1"
 /begin AXIS_DESCR STD_AXIS tmot temp_ub_q0p75_o48 6 -48.00 143.3 FORMAT "%5.1" DEPOSIT ABSOLUTE /end AXIS_DESCR
 /begin AXIS_DESCR STD_AXIS nmot nmot_ub_q40 8 0.00 10200. FORMAT "%5.0" DEPOSIT ABSOLUTE /end AXIS_DESCR
/end CHARACTERISTIC
/begin CHARACTERISTIC KFFLAEAN "Kennfeld konstante Ansaugfl‰che" MAP 0xFC5860 KfAxU8AyU8SstxU16SstyU16WU16 1024.000 flae_uw_q0p016 0.00 1024.000 FORMAT "%8.3"
 /begin AXIS_DESCR STD_AXIS evhubs_tmp hub_uw_q0p001 16 0.00 65.53500 FORMAT "%8.5" DEPOSIT ABSOLUTE /end AXIS_DESCR
 /begin AXIS_DESCR STD_AXIS vse_spr sprzi_q0p1 16 0.00 6553.500 FORMAT "%8.3" DEPOSIT ABSOLUTE /end AXIS_DESCR
/end CHARACTERISTIC
/begin CHARACTERISTIC KFFWL "Kennfeld Warmlauffaktor" MAP 0xFD1F6D GkfWUb 1.992 fak_ub_b2 0.00 1.992 FORMAT "%5.3"
 /begin AXIS_DESCR COM_AXIS tmot temp_ub_q0p75_o48 12 -48.00 143.3 FORMAT "%5.1" AXIS_PTS_REF STM12ESUB /end AXIS_DESCR
 /begin AXIS_DESCR COM_AXIS tmst temp_ub_q0p75_o48 12 -48.00 143.3 FORMAT "%5.1" AXIS_PTS_REF STS12ESUB /end AXIS_DESCR
/end CHARACTERISTIC
/begin CHARACTERISTIC KFFWLVT "Kennfeld Warmlauffaktor im ungdrosselten Betrieb" MAP 0xFD1FFD GkfWUb 1.992 fak_ub_b2 0.00 1.992 FORMAT "%5.3"
 /begin AXIS_DESCR COM_AXIS tmot temp_ub_q0p75_o48 12 -48.00 143.3 FORMAT "%5.1" AXIS_PTS_REF STM12ESUB /end AXIS_DESCR
 /begin AXIS_DESCR COM_AXIS tmst temp_ub_q0p75_o48 12 -48.00 143.3 FORMAT "%5.1" AXIS_PTS_REF STS12ESUB /end AXIS_DESCR
/end CHARACTERISTIC
/begin CHARACTERISTIC KFFWLW "Kennfeld Wichtung Warmlauffaktor" MAP 0xFC7375 GkfWUb 0.9961 fak_ub_b1 0.00 0.9961
 /begin AXIS_DESCR COM_AXIS nmot nmot_ub_q40 12 0.00 10200. FORMAT "%5.0" AXIS_PTS_REF SNM12ESUB /end AXIS_DESCR
 /begin AXIS_DESCR COM_AXIS rl rel_ub_q0p75 12 0.00 191.3 FORMAT "%5.1" AXIS_PTS_REF SRL12ESUB /end AXIS_DESCR
/end CHARACTERISTIC
/begin CHARACTERISTIC KFFWLWVT "Kennfeld Wichtung Warmlauffaktor im ungedrosselten Betrieb" MAP 0xFC7405 GkfWUb 0.9961 fak_ub_b1 0.00 0.9961
 /begin AXIS_DESCR COM_AXIS nmot nmot_ub_q40 12 0.00 10200. FORMAT "%5.0" AXIS_PTS_REF SNM12ESUB /end AXIS_DESCR
 /begin AXIS_DESCR COM_AXIS rl rel_ub_q0p75 12 0.00 191.3 FORMAT "%5.1" AXIS_PTS_REF SRL12ESUB /end AXIS_DESCR
/end CHARACTERISTIC
/begin CHARACTERISTIC KFKHFM "Korrekturkennfeld f¸r HFM" MAP 0xFC7964 KfAxUbAyUbSstxUbSstyUbWUb 1.992 fak_ub_b2 0.00 1.992 FORMAT "%5.3"
 /begin AXIS_DESCR STD_AXIS nmot nmot_ub_q40 14 0.00 10200. FORMAT "%5.0" DEPOSIT ABSOLUTE /end AXIS_DESCR
 /begin AXIS_DESCR STD_AXIS rl rel_ub_q0p75 14 0.00 191.3 FORMAT "%5.1" DEPOSIT ABSOLUTE /end AXIS_DESCR
/end CHARACTERISTIC
/begin CHARACTERISTIC KFLASWLR "Kennfeld Lambda-Motor-Soll im Warmlauf bei aktiver LR" MAP 0xFD208D GkfWUb 1.992 fak_ub_b2 0.00 1.992 FORMAT "%5.3"
 /begin AXIS_DESCR COM_AXIS tmot temp_ub_q0p75_o48 12 -48.00 143.3 FORMAT "%5.1" AXIS_PTS_REF STM12ESUB /end AXIS_DESCR
 /begin AXIS_DESCR COM_AXIS tmst temp_ub_q0p75_o48 12 -48.00 143.3 FORMAT "%5.1" AXIS_PTS_REF STS12ESUB /end AXIS_DESCR
/end CHARACTERISTIC
/begin CHARACTERISTIC KFLM0812 "" MAP 0xFC432C KfAxU8AyU8SstxU16SstyU16WU16 1638.375 m_uw_b1638p4 0.00 1638.375 FORMAT "%8.3"
 /begin AXIS_DESCR STD_AXIS minhub_w hub_uw_q0p001 8 0.00 65.53500 FORMAT "%8.5" DEPOSIT ABSOLUTE /end AXIS_DESCR
 /begin AXIS_DESCR STD_AXIS nmot_w nmot_uw_q0p25 12 0.00 16383.75 FORMAT "%8.2" DEPOSIT ABSOLUTE /end AXIS_DESCR
/end CHARACTERISTIC
/begin CHARACTERISTIC KFMAKR "Kennfeld Meﬂfensteranfang Klopfregelung" MAP 0xFD274F KfAxUbAyUbSstxUbSstyUbWUb 191.3 zw_ub_q0p75 0.00 191.3 FORMAT "%5.1"
 /begin AXIS_DESCR STD_AXIS nmot nmot_ub_q40 16 0.00 10200. FORMAT "%5.0" DEPOSIT ABSOLUTE /end AXIS_DESCR
 /begin AXIS_DESCR STD_AXIS rl rel_ub_q0p75 8 0.00 191.3 FORMAT "%5.1" DEPOSIT ABSOLUTE /end AXIS_DESCR
/end CHARACTERISTIC
/begin CHARACTERISTIC KFMSZSVNS "" MAP 0xFC47B8 KfAxU8AyU8SstxU8SstyU8WU8 0.9961 fak_ub_b1 0.00 0.9961
 /begin AXIS_DESCR STD_AXIS nmot nmot_ub_q40 8 0.00 10200. FORMAT "%5.0" DEPOSIT ABSOLUTE /end AXIS_DESCR
 /begin AXIS_DESCR STD_AXIS rlvw rel_ub_q0p75 8 0.00 191.3 FORMAT "%5.1" DEPOSIT ABSOLUTE /end AXIS_DESCR
/end CHARACTERISTIC
/begin CHARACTERISTIC KFMSZSVNST "" MAP 0xFC480A KfAxU8AyU8SstxU8SstyU8WU8 0.9961 fak_ub_b1 0.00 0.9961
 /begin AXIS_DESCR STD_AXIS nmot nmot_ub_q40 8 0.00 10200. FORMAT "%5.0" DEPOSIT ABSOLUTE /end AXIS_DESCR
 /begin AXIS_DESCR STD_AXIS rlvw rel_ub_q0p75 8 0.00 191.3 FORMAT "%5.1" DEPOSIT ABSOLUTE /end AXIS_DESCR
/end CHARACTERISTIC
/begin CHARACTERISTIC KFTDKLM "" MAP 0xFC4418 KfAxU8AyU8SstxU16SstyU16WU16 1638.375 m_uw_b1638p4 0.00 1638.375 FORMAT "%8.3"
 /begin AXIS_DESCR STD_AXIS Vse_spri sprzi_q0p1 8 0.00 6553.500 FORMAT "%8.3" DEPOSIT ABSOLUTE /end AXIS_DESCR
 /begin AXIS_DESCR STD_AXIS Vsa_spri sprzi_q0p1 8 0.00 6553.500 FORMAT "%8.3" DEPOSIT ABSOLUTE /end AXIS_DESCR
/end CHARACTERISTIC
/begin CHARACTERISTIC KFTDKST "" MAP 0xFC44BC KfAxU8AyU8SstxU16SstyU16WU16 1.999969 fak_uw_b2 0.00 1.999969 FORMAT "%8.6"
 /begin AXIS_DESCR STD_AXIS Vse_spri sprzi_q0p1 8 0.00 6553.500 FORMAT "%8.3" DEPOSIT ABSOLUTE /end AXIS_DESCR
 /begin AXIS_DESCR STD_AXIS Vsa_spri sprzi_q0p1 8 0.00 6553.500 FORMAT "%8.3" DEPOSIT ABSOLUTE /end AXIS_DESCR
/end CHARACTERISTIC
/begin CHARACTERISTIC KFTDVNSFIL "" MAP 0xFC4934 KfAxUwAyUwSstxUwSstyUwWUw 655.34999985 zk10msxs_uw_b655 0.010000152590 655.36000000 FORMAT "%12.8"
 /begin AXIS_DESCR STD_AXIS minhub_w hub_uw_q0p001 8 0.00 65.53500 FORMAT "%8.5" DEPOSIT ABSOLUTE /end AXIS_DESCR
 /begin AXIS_DESCR STD_AXIS dpssol_uw p_q0p039 8 0.00 2559.961 FORMAT "%8.3" DEPOSIT ABSOLUTE /end AXIS_DESCR
/end CHARACTERISTIC
/begin CHARACTERISTIC KFTHFM "Temperaturkompensationskennfeld f¸r HFM" MAP 0xFC77D4 KfAxU8AyU8SstxU16SstyU16WU16 1.999969 fak_uw_b2 0.00 1.999969 FORMAT "%8.6"
 /begin AXIS_DESCR STD_AXIS tans16 temp_uw_q0p75_o48 8 -48.00000 49103.25 FORMAT "%8.2" DEPOSIT ABSOLUTE /end AXIS_DESCR
 /begin AXIS_DESCR STD_AXIS mshfmkor m_uw_b6553p5 12 0.00 6553.500 FORMAT "%8.3" DEPOSIT ABSOLUTE /end AXIS_DESCR
/end CHARACTERISTIC
/begin CHARACTERISTIC KFUMLTD "" MAP 0xFC4560 KfAxU8AyU8SstxU16SstyU16WU16 1.999969 fak_uw_b2 0.00 1.999969 FORMAT "%8.6"
 /begin AXIS_DESCR STD_AXIS minhub_w hub_uw_q0p001 8 0.00 65.53500 FORMAT "%8.5" DEPOSIT ABSOLUTE /end AXIS_DESCR
 /begin AXIS_DESCR STD_AXIS nmot_w nmot_uw_q0p25 12 0.00 16383.75 FORMAT "%8.2" DEPOSIT ABSOLUTE /end AXIS_DESCR
/end CHARACTERISTIC
/begin CHARACTERISTIC KFVHUBML "" MAP 0xFC464C KfAxU8AyU8SstxU16SstyU16WU16 23.30133 m_uw_b23p3 0.00 23.30133 FORMAT "%8.5"
 /begin AXIS_DESCR STD_AXIS tmst temp_ub_q0p75_o48 12 -48.00 143.3 FORMAT "%5.1" DEPOSIT ABSOLUTE /end AXIS_DESCR
 /begin AXIS_DESCR STD_AXIS fcoschmn_w fak_uw_b2 8 0.00 1.999969 FORMAT "%8.6" DEPOSIT ABSOLUTE /end AXIS_DESCR
/end CHARACTERISTIC
/begin CHARACTERISTIC KFVHUBON "" MAP 0xFC4738 KfAxU8AyU8SstxU16SstyU16WU16 6553.500 t100msxs_uw_b6553p5 0.00 6553.500 FORMAT "%8.3"
 /begin AXIS_DESCR STD_AXIS tmst temp_ub_q0p75_o48 6 -48.00 143.3 FORMAT "%5.1" DEPOSIT ABSOLUTE /end AXIS_DESCR
 /begin AXIS_DESCR STD_AXIS fcoschmn_w fak_uw_b2 8 0.00 1.999969 FORMAT "%8.6" DEPOSIT ABSOLUTE /end AXIS_DESCR
/end CHARACTERISTIC
/begin CHARACTERISTIC KFVOFFS "Geschwindigkeits-Offset f¸r FGR-Regler" MAP 0xFC228E KfAxUwAyUwSstxUwSstyUwWUw 511.9922 vfzg_uw_b512 0.00 511.9922 FORMAT "%8.4"
 /begin AXIS_DESCR STD_AXIS vziel_w vfzg_uw_b512 6 0.00 511.9922 FORMAT "%8.4" DEPOSIT ABSOLUTE /end AXIS_DESCR
 /begin AXIS_DESCR STD_AXIS gangi dez 8 0.00 255.0 FORMAT "%5.1" DEPOSIT ABSOLUTE /end AXIS_DESCR
/end CHARACTERISTIC
/begin CHARACTERISTIC KFWDKDPS "Kennfeld Drosselklappensollwinkel" MAP 0xFC4E2A KfAxU8AyU8SstxU16SstyU16WU16 99.99847 rel_uw_b100 0.00 99.99847 FORMAT "%8.5"
 /begin AXIS_DESCR STD_AXIS mlsoladte m_uw_b6553p5 21 0.00 6553.500 FORMAT "%8.3" DEPOSIT ABSOLUTE /end AXIS_DESCR
 /begin AXIS_DESCR STD_AXIS dpipol fak_uw_b2 8 0.00 1.999969 FORMAT "%8.6" DEPOSIT ABSOLUTE /end AXIS_DESCR
/end CHARACTERISTIC
/begin CHARACTERISTIC KFWDKMSN "Kennfeld f¸r Drosselklappen-Sollwinkel" MAP 0xFC4FB8 KfAxU8AyU8SstxU16SstyU16WU16 99.99847 rel_uw_b100 0.00 99.99847 FORMAT "%8.5"
 /begin AXIS_DESCR STD_AXIS mlwdkns_w m_uw_b6553p5 16 0.00 6553.500 FORMAT "%8.3" DEPOSIT ABSOLUTE /end AXIS_DESCR
 /begin AXIS_DESCR STD_AXIS nmot_w nmot_uw_q0p25 6 0.00 16383.75 FORMAT "%8.2" DEPOSIT ABSOLUTE /end AXIS_DESCR
/end CHARACTERISTIC
/begin CHARACTERISTIC KFZKHFM "Zeitkonstantenkennfeld f¸r Gl‰ttung der Luftmasse" MAP 0xFC78C0 KfAxU8AyU8SstxU16SstyU16WU16 655.34999985 zk10msxs_uw_b655 0.010000152590 655.36000000 FORMAT "%12.8"
 /begin AXIS_DESCR STD_AXIS nmot_w nmot_uw_q0p25 8 0.00 16383.75 FORMAT "%8.2" DEPOSIT ABSOLUTE /end AXIS_DESCR
 /begin AXIS_DESCR STD_AXIS rlvw_w rel_uw_q0p0234 8 0.00 1535.977 FORMAT "%8.3" DEPOSIT ABSOLUTE /end AXIS_DESCR
/end CHARACTERISTIC
/begin CHARACTERISTIC KKFFGRGA "Verst‰rkungsfaktor bei Konstantfahrt f¸r FGR-Regler" CURVE 0xFD0750 KlAUwSstUwWUw 3199.951 rel_uw_b3200 0.00 3199.951 FORMAT "%8.3"
 /begin AXIS_DESCR STD_AXIS gangi dez 8 0.00 255.0 FORMAT "%5.1" DEPOSIT ABSOLUTE /end AXIS_DESCR
/end CHARACTERISTIC
/begin CHARACTERISTIC KLAF "Ausfluﬂkennlinie" CURVE 0xFC4A40 FklWU16 0.9999847 fak_uw_b1 0.00 0.9999847 FORMAT "%9.7"
 /begin AXIS_DESCR FIX_AXIS kldpin_in fak_uw_q0p001 501 0.5000000 1.000000 FORMAT "%8.6" FIX_AXIS_PAR 500 0 501 /end AXIS_DESCR
/end CHARACTERISTIC
/begin CHARACTERISTIC KLDEXWSLOW "" CURVE 0xFC5BF7 KlAxU8SstxU8WU8 255.0 wink_ub_q1p0 0.00 255.0 FORMAT "%5.1"
 /begin AXIS_DESCR STD_AXIS nmot nmot_ub_q40 12 0.00 10200. FORMAT "%5.0" DEPOSIT ABSOLUTE /end AXIS_DESCR
/end CHARACTERISTIC
/begin CHARACTERISTIC KLDKVL "Vollast-Kennlinie f¸r Drosselklappen-Sollwinkel" CURVE 0xFC50EA KlAxU8SstxU16WU16 99.99847 rel_uw_b100 0.00 99.99847 FORMAT "%8.5"
 /begin AXIS_DESCR STD_AXIS nmot_w nmot_uw_q0p25 16 0.00 16383.75 FORMAT "%8.2" DEPOSIT ABSOLUTE /end AXIS_DESCR
/end CHARACTERISTIC
/begin CHARACTERISTIC KLDKVVTO "Kennlinie VVT Plausibilisierung oberer Grenzwertoffset" CURVE 0xFC49FC KlAxU8SstxU16WU16 1638.375 m_uw_b1638p4 0.00 1638.375 FORMAT "%8.3"
 /begin AXIS_DESCR STD_AXIS msdkuw_w m_uw_b6553p5 8 0.00 6553.500 FORMAT "%8.3" DEPOSIT ABSOLUTE /end AXIS_DESCR
/end CHARACTERISTIC
/begin CHARACTERISTIC KLDKVVTU "Kennlinie VVT Plausibilisierung unterer Grenzwertoffset" CURVE 0xFC4A1E KlAxU8SstxU16WU16 1638.375 m_uw_b1638p4 0.00 1638.375 FORMAT "%8.3"
 /begin AXIS_DESCR STD_AXIS msdkuw_w m_uw_b6553p5 8 0.00 6553.500 FORMAT "%8.3" DEPOSIT ABSOLUTE /end AXIS_DESCR
/end CHARACTERISTIC
/begin CHARACTERISTIC KLDPIPOL "Kennlinie dp Interpolation" CURVE 0xFC512C KlAxU8SstxU16WU16 1.999969 fak_uw_b2 0.00 1.999969 FORMAT "%8.6"
 /begin AXIS_DESCR STD_AXIS kldpin_w fak_uw_b2 24 0.00 1.999969 FORMAT "%8.6" DEPOSIT ABSOLUTE /end AXIS_DESCR
/end CHARACTERISTIC
/begin CHARACTERISTIC KLDPSDKM "Ueberblendung zwischen Ansteuerung DK bei gedrosseltem oder VVT-Betrieb" CURVE 0xFC518E KlAxU8SstxU16WU16 0.9999695 fak_uw_b2 0.00003051758 1.000000 FORMAT "%8.6"
 /begin AXIS_DESCR STD_AXIS kldpin_w fak_uw_b2 6 0.00 1.999969 FORMAT "%8.6" DEPOSIT ABSOLUTE /end AXIS_DESCR
/end CHARACTERISTIC
/begin CHARACTERISTIC KLDPSFAK "" CURVE 0xFC48C2 KlAxU8SstxU8WU8 1.000 fak_ub_q0p00392 0.00 1.000 FORMAT "%5.3"
 /begin AXIS_DESCR STD_AXIS dpsfakro fak_ub_q0p00392 6 0.00 1.000 FORMAT "%5.3" DEPOSIT ABSOLUTE /end AXIS_DESCR
/end CHARACTERISTIC
/begin CHARACTERISTIC KLDPSREGOF "" CURVE 0xFC51A8 KlAxU8SstxU16WU16 1.999969 fak_uw_b2 0.00 1.999969 FORMAT "%8.6"
 /begin AXIS_DESCR STD_AXIS dpssol_w p_q0p039 6 -1280.000 1279.961 FORMAT "%8.3" DEPOSIT ABSOLUTE /end AXIS_DESCR
/end CHARACTERISTIC
/begin CHARACTERISTIC KLEHUBVL "Vollast-Kennlinie f¸r Hubverstellung" CURVE 0xFC5AFA KlAxU8SstxU16WU16 12.00000 hub_uw_q0p001 0.00 12.00000 FORMAT "%8.5"
 /begin AXIS_DESCR STD_AXIS nmot_w nmot_uw_q0p25 16 0.00 16383.75 FORMAT "%8.2" DEPOSIT ABSOLUTE /end AXIS_DESCR
/end CHARACTERISTIC
/begin CHARACTERISTIC KLGANGGD "Kennlinie f¸r gedrosselt von Gang" CURVE 0xFC48CF KlAxU8SstxU8WU8 1.000 dez 0.00 1.000 FORMAT "%5.3"
 /begin AXIS_DESCR STD_AXIS gangauti dez 8 0.00 255.0 FORMAT "%5.1" DEPOSIT ABSOLUTE /end AXIS_DESCR
/end CHARACTERISTIC
/begin CHARACTERISTIC KLGDVNSFIL "" CURVE 0xFC49D8 KlAUwSstSwWUw 655.34999985 zk10msxs_uw_b655 0.010000152590 655.36000000 FORMAT "%12.8"
 /begin AXIS_DESCR STD_AXIS dpsfg_w p_sw_q0p039 8 -1280.000 1279.961 FORMAT "%8.3" DEPOSIT ABSOLUTE /end AXIS_DESCR
/end CHARACTERISTIC
/begin CHARACTERISTIC KLHUBEX "Kennlinie Hubverstellung <-> Exzenterwinkel" CURVE 0xFC5B3C KlAxU8SstxU16WU16 230.0000 wink_uw_q0p1 0.00 230.0000 FORMAT "%8.4"
 /begin AXIS_DESCR STD_AXIS evhubs_w hub_uw_q0p001 12 0.00 65.53500 FORMAT "%8.5" DEPOSIT ABSOLUTE /end AXIS_DESCR
/end CHARACTERISTIC
/begin CHARACTERISTIC KLRLGDAUS "Kennlinie gedrosselt aus aus Kennfeldpunkt" CURVE 0xFC485C KlAxU8SstxU16WU16 1535.977 rel_uw_q0p0234 0.00 1535.977 FORMAT "%8.3"
 /begin AXIS_DESCR STD_AXIS nmot_w nmot_uw_q0p25 8 0.00 16383.75 FORMAT "%8.2" DEPOSIT ABSOLUTE /end AXIS_DESCR
/end CHARACTERISTIC
/begin CHARACTERISTIC KLRLGDEIN "Kennlinie gedrosselt ein aus Kennfeldpunkt" CURVE 0xFC487E KlAxU8SstxU16WU16 1535.977 rel_uw_q0p0234 0.00 1535.977 FORMAT "%8.3"
 /begin AXIS_DESCR STD_AXIS nmot_w nmot_uw_q0p25 8 0.00 16383.75 FORMAT "%8.2" DEPOSIT ABSOLUTE /end AXIS_DESCR
/end CHARACTERISTIC
/begin CHARACTERISTIC KLTDFUEREG "" CURVE 0xFC48A0 KlAxU8SstxS16WS16 1638.375 m_uw_b1638p4 -819.2000 819.1750 FORMAT "%8.4"
 /begin AXIS_DESCR STD_AXIS rlfe_w rel_uw_q0p0234 8 -768.0000 767.9766 FORMAT "%8.4" DEPOSIT ABSOLUTE /end AXIS_DESCR
/end CHARACTERISTIC
/begin CHARACTERISTIC KLTVGDST "" CURVE 0xFC48E0 KlAxU8SstxU8WU8 25.50 t100msxs_ub_b25p5 0.00 25.50 FORMAT "%5.2"
 /begin AXIS_DESCR STD_AXIS tmst temp_ub_q0p75_o48 6 -48.00 143.3 FORMAT "%5.1" DEPOSIT ABSOLUTE /end AXIS_DESCR
/end CHARACTERISTIC
/begin CHARACTERISTIC KLVHUB "Hub bei B_GDVHUB" CURVE 0xFC5B6E KlAxU8SstxU16WU16 12.00000 hub_uw_q0p001 0.00 12.00000 FORMAT "%8.5"
 /begin AXIS_DESCR STD_AXIS nmot_w nmot_uw_q0p25 8 0.00 16383.75 FORMAT "%8.2" DEPOSIT ABSOLUTE /end AXIS_DESCR
/end CHARACTERISTIC
/begin CHARACTERISTIC KLVVTCLOSE "Kennlinie Hubverstellung in Abh‰ngigkeit von nmot" CURVE 0xFC5B90 KlAxU8SstxU16WU16 6553.500 wink_uw_q0p1 0.00 6553.500 FORMAT "%8.3"
 /begin AXIS_DESCR STD_AXIS nmot_w nmot_uw_q0p25 5 0.00 16383.75 FORMAT "%8.2" DEPOSIT ABSOLUTE /end AXIS_DESCR
/end CHARACTERISTIC
/begin CHARACTERISTIC KRAFGRGA "Verst‰rkungsfaktor bei Rampe f¸r FGR-Regler" CURVE 0xFD0772 KlAUwSstUwWUw 3199.951 rel_uw_b3200 0.00 3199.951 FORMAT "%8.3"
 /begin AXIS_DESCR STD_AXIS gangi dez 8 0.00 255.0 FORMAT "%5.1" DEPOSIT ABSOLUTE /end AXIS_DESCR
/end CHARACTERISTIC
/begin CHARACTERISTIC KWNSIGMA "Drehzahlschwelle f¸r Korrekturabschaltung" VALUE 0xFD22A4 KwUb 10200. nmot_ub_q40 0.00 10200. FORMAT "%5.0" /end CHARACTERISTIC
/begin CHARACTERISTIC LASWLTM "Offset Lambda-Motor-Soll bei inaktiver Lambdaregelung" CURVE 0xFD211D GklWSb 1.992 fak_sb_b1 -1.000 0.9922 FORMAT "%5.3"
 /begin AXIS_DESCR COM_AXIS tmot temp_ub_q0p75_o48 12 -48.00 143.3 FORMAT "%5.1" AXIS_PTS_REF STM12ESUB /end AXIS_DESCR
/end CHARACTERISTIC
/begin CHARACTERISTIC MINHUBOFT2 "" VALUE 0xFC48FC KwWU16 65.53500 hub_uw_q0p001 0.00 65.53500 FORMAT "%8.5" /end CHARACTERISTIC
/begin CHARACTERISTIC MINHUBOFTD "Offset minhub f¸r Bedingung B_lltd" VALUE 0xFC48FE KwWU16 65.53500 hub_uw_q0p001 0.00 65.53500 FORMAT "%8.5" /end CHARACTERISTIC
/begin CHARACTERISTIC MLHFM "Linearisierung der Heiﬂfilmspannung" CURVE 0xFC7A46 FklWUw 6553.500 m_uw_b6553p5 0.00 6553.500 FORMAT "%8.3"
 /begin AXIS_DESCR FIX_AXIS uhfm_w spg_q0p00977 512 0.00 4.990234 FORMAT "%8.6" FIX_AXIS_PAR 0 0 512 /end AXIS_DESCR
/end CHARACTERISTIC
/begin CHARACTERISTIC MLOFS "Kennlinienoffset HFM 5" VALUE 0xFC7E46 KwUw 6553.500 m_uw_b6553p5 0.00 6553.500 FORMAT "%8.3" /end CHARACTERISTIC
/begin CHARACTERISTIC MLTDDIV "Divisionsfaktor f¸r Ausgang Druckregler" VALUE 0xFC4931 KwUb 254.0 dez 1.000 255.0 FORMAT "%5.1" /end CHARACTERISTIC
/begin CHARACTERISTIC MLTDMAMN "" VALUE 0xFD133A KwSw 1638.375 m_uw_b1638p4 -819.2000 819.1750 FORMAT "%8.4" /end CHARACTERISTIC
/begin CHARACTERISTIC MLTDMAMX "" VALUE 0xFD133C KwSw 1638.375 m_uw_b1638p4 -819.2000 819.1750 FORMAT "%8.4" /end CHARACTERISTIC
/begin CHARACTERISTIC MRFGRMAX "Maximalwert f¸r relatives Moment aus FGR" VALUE 0xFC2274 KwUw 199.9969 rel_uw_b200 0.00 199.9969 FORMAT "%8.4" /end CHARACTERISTIC
/begin CHARACTERISTIC MRFGRMR "FGR-Korrekturkennlinie" CURVE 0xFC230E KlAUwSstUwWUw 199.9969 rel_uw_b200 0.00 199.9969 FORMAT "%8.4"
 /begin AXIS_DESCR STD_AXIS mrregl_w rel_uw_b200 8 0.00 199.9969 FORMAT "%8.4" DEPOSIT ABSOLUTE /end AXIS_DESCR
/end CHARACTERISTIC
/begin CHARACTERISTIC MRFGRSTA "Startwert f¸r Relatives Moment bei Aktivierung FGR-Regler" VALUE 0xFC2330 KwUw 199.9969 rel_uw_b200 0.00 199.9969 FORMAT "%8.4" /end CHARACTERISTIC
/begin CHARACTERISTIC MRMRFGR "Inverse FGR-Korrekturkennlinie" CURVE 0xFC2332 KlAUwSstUwWUw 199.9969 rel_uw_b200 0.00 199.9969 FORMAT "%8.4"
 /begin AXIS_DESCR STD_AXIS mrfgri_w rel_uw_b200 8 0.00 199.9969 FORMAT "%8.4" DEPOSIT ABSOLUTE /end AXIS_DESCR
/end CHARACTERISTIC
/begin CHARACTERISTIC MSNLG "Leckluft DK geschlossen" VALUE 0xFC525E KwWU16 6553.500 m_uw_b6553p5 0.00 6553.500 FORMAT "%8.3" /end CHARACTERISTIC
/begin CHARACTERISTIC NDKPPU "Minimaldrehzahl f¸r Plausibilisierung DK-Poti 2 nach unten im Normalbetrieb" VALUE 0xFC1F71 KwUb 10000. nmot_ub_q40 200.0 10200. FORMAT "%5.0" /end CHARACTERISTIC
/begin CHARACTERISTIC NDSVLO "obere Drehzahlschwelle f¸r Signalvergleich Ladedruck mit Umgebungsdruck" VALUE 0xFD25F7 KwUb 10200. nmot_ub_q40 0.00 10200. FORMAT "%5.0" /end CHARACTERISTIC
/begin CHARACTERISTIC NDSVLU "Drehzahlschwelle f¸r Signalvergleich Ladedruck mit Umgebungsdruck" VALUE 0xFD25F8 KwUb 10200. nmot_ub_q40 0.00 10200. FORMAT "%5.0" /end CHARACTERISTIC
/begin CHARACTERISTIC NGDHZONMN "Minimaldrehzahl f¸r Drosselung wg. Heizleistung" VALUE 0xFC4900 KwWU16 16383.75 nmot_uw_q0p25 0.00 16383.75 FORMAT "%8.2" /end CHARACTERISTIC
/begin CHARACTERISTIC NMOTGD "Untere Grenze nmot f¸r R¸cksetzen gedrosselter Warmlauf" VALUE 0xFC4902 KwWU16 16383.75 nmot_uw_q0p25 0.00 16383.75 FORMAT "%8.2" /end CHARACTERISTIC
/begin CHARACTERISTIC NOHUBMO "Schalter Exzenterhubmodell ausgeschaltet" VALUE 0xFC5C2A KwWU8 1.000 dez 0.00 1.000 FORMAT "%5.3" /end CHARACTERISTIC
/begin CHARACTERISTIC NTDMAO "" VALUE 0xFC4932 KwUb 2550. nmot_ub_q10 0.00 2550. FORMAT "%5.0" /end CHARACTERISTIC
/begin CHARACTERISTIC NTOELMX "Drehzahlschwelle f¸r Ersatzwert hohes toel" VALUE 0xFD22AD KwWU8 10200. nmot_ub_q40 0.00 10200. FORMAT "%5.0" /end CHARACTERISTIC
/begin CHARACTERISTIC NVGDSLL "Drehzahlschwelle  f¸r Drucksensorvergleich DSU/DSL im Leerlauf" VALUE 0xFD25F9 KwUb 10200. nmot_ub_q40 0.00 10200. FORMAT "%5.0" /end CHARACTERISTIC
/begin CHARACTERISTIC NWDK3 "Minimaldrehzahl f¸r Berechnung DK-Winkel-Ersatzwert aus F¸llungssignal" VALUE 0xFC1F72 KwUb 10000. nmot_ub_q40 200.0 10200. FORMAT "%5.0" /end CHARACTERISTIC
/begin CHARACTERISTIC PDDSHUBMX1 "Obere Hubgrenze f¸r Druckplausibilisierung ¸ber dpssol" VALUE 0xFC7FFC KwWU16 65.53500 hub_uw_q0p001 0.00 65.53500 FORMAT "%8.5" /end CHARACTERISTIC
/begin CHARACTERISTIC PDDSHUBMX2 "Obere Hubgrenze f¸r Druckplausibilisierung abhaengig ¸ber wdkba" VALUE 0xFC7FFE KwWU16 65.53500 hub_uw_q0p001 0.00 65.53500 FORMAT "%8.5" /end CHARACTERISTIC
/begin CHARACTERISTIC PUE "Ersatzwert f¸r Umgebungsdruck" VALUE 0xFD2636 KwUw 2559.961 p_uw_q0p039 0.00 2559.961 FORMAT "%8.3" /end CHARACTERISTIC
/begin CHARACTERISTIC PUMN "Umgebungsdruckbegrenzung minimal" VALUE 0xFD2638 KwUw 2559.961 p_uw_q0p039 0.00 2559.961 FORMAT "%8.3" /end CHARACTERISTIC
/begin CHARACTERISTIC PUMX "Umgebungsdruckbegrenzung maximal" VALUE 0xFD263A KwUw 2559.961 p_uw_q0p039 0.00 2559.961 FORMAT "%8.3" /end CHARACTERISTIC
/begin CHARACTERISTIC PUSPSMX "max. Abweichung von Umgebungsdruck und Saugrohrdruck" VALUE 0xFD263C KwUw 2559.961 p_uw_q0p039 0.00 2559.961 FORMAT "%8.3" /end CHARACTERISTIC
/begin CHARACTERISTIC PVDKPUD "Schwelle unterhalb welcher die Diff. zw. pvdkds und pu als 0 ausgegeben wird" VALUE 0xFD25FA KwUb 2550. p_ub_q10 0.00 2550. FORMAT "%5.0" /end CHARACTERISTIC
/begin CHARACTERISTIC RBEL "Belastungswiderstand f¸r Pumpstrom-Erzeugung" VALUE 0xFC806E KwUw 131070.0 r_uw_q2 0.00 131070.0 FORMAT "%8.1" /end CHARACTERISTIC
/begin CHARACTERISTIC RINHMX "Innenwiderstand Ri der Nernstsonde hinter KAT auf Maximalwert begrenzen" VALUE 0xFC8070 KwUw 131070.0 r_uw_q2 0.00 131070.0 FORMAT "%8.1" /end CHARACTERISTIC
/begin CHARACTERISTIC RKSP "Widerstand zwischen kongurierende Spannung und Sondensignal" VALUE 0xFC8072 KwUw 131070.0 r_uw_q2 0.00 131070.0 FORMAT "%8.1" /end CHARACTERISTIC
/begin CHARACTERISTIC RLGD "Untere Grenze rl f¸r R¸cksetzen gedrosselter Warmlauf" VALUE 0xFC4904 KwWU16 1535.977 rel_uw_q0p0234 0.00 1535.977 FORMAT "%8.3" /end CHARACTERISTIC
/begin CHARACTERISTIC RLGDHZONMN "Untere Grenze rl f¸r Drosselung wg. Heizleistung" VALUE 0xFC4906 KwWU16 1535.977 rel_uw_q0p0234 0.00 1535.977 FORMAT "%8.3" /end CHARACTERISTIC
/begin CHARACTERISTIC RPTES "Widerstand Pumpenstrommessung DM-TL" VALUE 0xFC77D0 KwWU16 99.99847 r_q0p00153 0.00 99.99847 FORMAT "%8.5" /end CHARACTERISTIC
/begin CHARACTERISTIC SENZZYL "Klopfsensoren f¸r SW-Zylinderz‰hler 0-7" VAL_BLK 0xFD27E9 KwbUb 3.000 dezsub1 1.000 4.000 FORMAT "%5.3" NUMBER 8 /end CHARACTERISTIC
/begin AXIS_PTS SNM12ESUB "SST-Verteilung f¸r die Motordrehzahl nmot" 0xFC13A8 nmot SstAUbSstUb 10200. nmot_ub_q40 12 0.00 10200. FORMAT "%5.0" DEPOSIT ABSOLUTE /end AXIS_PTS
/begin AXIS_PTS SRL12ESUB "Sst-Verteilung f¸r die relative F¸llung rl" 0xFC1404 rl SstAUbSstUb 191.3 rel_ub_q0p75 12 0.00 191.3 FORMAT "%5.1" DEPOSIT ABSOLUTE /end AXIS_PTS
/begin AXIS_PTS STM12ESUB "SST-Verteilung f¸r die Motortemperatur tmot" 0xFCF89C tmot SstAUbSstUb 191.3 temp_ub_q0p75_o48 12 -48.00 143.3 FORMAT "%5.1" DEPOSIT ABSOLUTE /end AXIS_PTS
/begin AXIS_PTS STS12ESUB "SST-Verteilung f¸r Motorstarttemperatur" 0xFC143E tmst SstAUbSstUb 191.3 temp_ub_q0p75_o48 12 -48.00 143.3 FORMAT "%5.1" DEPOSIT ABSOLUTE /end AXIS_PTS
/begin CHARACTERISTIC S_DPSRLVW "" VALUE 0xFC4917 KwWU8 1.000 dez 0.00 1.000 FORMAT "%5.3" /end CHARACTERISTIC
/begin CHARACTERISTIC S_DPSTDO "" VALUE 0xFC4918 KwWU8 1.000 dez 0.00 1.000 FORMAT "%5.3" /end CHARACTERISTIC
/begin CHARACTERISTIC S_EVHUBFRZ "Schalter Freeze Hub freigeben/sperren" VALUE 0xFC5C30 KwUb 255.0 dez 0.00 255.0 FORMAT "%5.1" /end CHARACTERISTIC
/begin CHARACTERISTIC S_FPUPS "" VALUE 0xFC4919 KwWU8 1.000 dez 0.00 1.000 FORMAT "%5.3" /end CHARACTERISTIC
/begin CHARACTERISTIC S_FPUPSSOL "Dichteberechnung fuer Hub ueber Solldruck ein" VALUE 0xFC491A KwWU8 1.000 dez 0.00 1.000 FORMAT "%5.3" /end CHARACTERISTIC
/begin CHARACTERISTIC S_GD "Schalter Gedrosselt manuell" VALUE 0xFC491B KwWU8 1.000 dez 0.00 1.000 FORMAT "%5.3" /end CHARACTERISTIC
/begin CHARACTERISTIC S_GDNMOT "" VALUE 0xFC491C KwWU8 1.000 dez 0.00 1.000 FORMAT "%5.3" /end CHARACTERISTIC
/begin CHARACTERISTIC S_GDVHUB "Schalter Gedrosselt mit Vollhub manuell" VALUE 0xFC491D KwWU8 1.000 dez 0.00 1.000 FORMAT "%5.3" /end CHARACTERISTIC
/begin CHARACTERISTIC S_HEIZL "Anforderung Heizleistungseingriff" VALUE 0xFC4933 KwUb 1.000 dez 0.00 1.000 FORMAT "%5.3" /end CHARACTERISTIC
/begin CHARACTERISTIC S_KRDWSGD "Schalter f¸r gedrosselten Betrieb bei KR-Notlauf" VALUE 0xFC491E KwWU8 255.0 dez 0.00 255.0 FORMAT "%5.1" /end CHARACTERISTIC
/begin CHARACTERISTIC S_LLGD "Schalter Gedrosselt nur im Leerlauf" VALUE 0xFC491F KwWU8 1.000 dez 0.00 1.000 FORMAT "%5.3" /end CHARACTERISTIC
/begin CHARACTERISTIC S_LLKTD "" VALUE 0xFC4920 KwWU8 1.000 dez 0.00 1.000 FORMAT "%5.3" /end CHARACTERISTIC
/begin CHARACTERISTIC S_LLTD "" VALUE 0xFC4921 KwWU8 1.000 dez 0.00 1.000 FORMAT "%5.3" /end CHARACTERISTIC
/begin CHARACTERISTIC S_STKOMF "" VALUE 0xFC4922 KwWU8 1.000 dez 0.00 1.000 FORMAT "%5.3" /end CHARACTERISTIC
/begin CHARACTERISTIC S_TDKF "Schalter Vorgabe minhub im LL der TL" VALUE 0xFC5C31 KwUb 255.0 dez 0.00 255.0 FORMAT "%5.1" /end CHARACTERISTIC
/begin CHARACTERISTIC S_TDST "" VALUE 0xFC4923 KwWU8 1.000 dez 0.00 1.000 FORMAT "%5.3" /end CHARACTERISTIC
/begin CHARACTERISTIC S_TEDPS "Schalter Differenzdruckvorgabe aus TE aktiv" VALUE 0xFC4924 KwWU8 1.000 dez 0.00 1.000 FORMAT "%5.3" /end CHARACTERISTIC
/begin CHARACTERISTIC TABMIN "Minimale Abstellzeit" VALUE 0xFC4908 KwWU16 65535.00 t1sxs_uw_q1 0.00 65535.00 FORMAT "%8.2" /end CHARACTERISTIC
/begin CHARACTERISTIC TCEKP "‹berwachung CAN time out f¸r EKP-Abschaltung" VALUE 0xFD226C KwWU8 25.40 t_q0p1 0.00 25.40 FORMAT "%5.2" /end CHARACTERISTIC
/begin CHARACTERISTIC TDDDSS "Entprellzeit Fehlererkennung Differenzdrucksensor Saugrohr" VALUE 0xFC8008 KwWU8 25.50 t_q0p1 0.00 25.50 FORMAT "%5.2" /end CHARACTERISTIC
/begin CHARACTERISTIC TDDDSS0 "Entprellzeit Signaldiagnose Differenzdrucksensor Saugrohr" VALUE 0xFC8009 KwWU8 25.50 t_q0p1 0.00 25.50 FORMAT "%5.2" /end CHARACTERISTIC
/begin CHARACTERISTIC TDDDSSIO "Entprellzeit Differenzdrucksensor in Ordnung" VALUE 0xFC800A KwWU8 25.50 t_q0p1 0.00 25.50 FORMAT "%5.2" /end CHARACTERISTIC
/begin CHARACTERISTIC TDDFU "Entprellzeit f¸r Fehlereintrag Druckksensor Umgebung" VALUE 0xFD25FB KwUb 25.50 t100msxs_ub_b25p5 0.00 25.50 FORMAT "%5.2" /end CHARACTERISTIC
/begin CHARACTERISTIC TDDFUUGD "Entprellzeit f¸r Fehlereintrag Druckksensor Umgebung" VALUE 0xFD25FC KwUb 25.50 t100msxs_ub_b25p5 0.00 25.50 FORMAT "%5.2" /end CHARACTERISTIC
/begin CHARACTERISTIC TDDSSPLAU1 "Filterzeitkonstante f¸r Plaus-Check dpssol" VALUE 0xFC8000 KwWU16 6553.4999985 zk100msxs_uw_b6553 0.10000152590 6553.6000000 FORMAT "%12.7" /end CHARACTERISTIC
/begin CHARACTERISTIC TDDSSPLAU2 "Filterzeitkonstante f¸r Plaus-Check wdkba" VALUE 0xFC8002 KwWU16 6553.4999985 zk100msxs_uw_b6553 0.10000152590 6553.6000000 FORMAT "%12.7" /end CHARACTERISTIC
/begin CHARACTERISTIC TDKPAW "Zeit f¸r DK-Poti-Auswahl" VALUE 0xFC1F73 KwUb 2.540 t10msxs_ub_b2p55 0.01000 2.550 FORMAT "%5.3" /end CHARACTERISTIC
/begin CHARACTERISTIC TDMFL "Verzˆgerungszeit MFL-Fehler" VALUE 0xFC8083 KwWU8 2.450 t10msxs_ub_b2p55 0.1000 2.550 FORMAT "%5.3" /end CHARACTERISTIC
/begin CHARACTERISTIC TDMFLH "Verzˆgerungszeit MFL-Fehler-Heilung" VALUE 0xFC8084 KwWU8 2.450 t10msxs_ub_b2p55 0.1000 2.550 FORMAT "%5.3" /end CHARACTERISTIC
/begin CHARACTERISTIC TDVGDSLL "Verzˆgerungszeit f¸r Drucksensorvergleich DSU/DSL im Leerlauf" VALUE 0xFD25FD KwUb 25.50 t100msxs_ub_b25p5 0.00 25.50 FORMAT "%5.2" /end CHARACTERISTIC
/begin CHARACTERISTIC TFGRARLG "Rampenlaufzeit bei langsamer FGR-Abschaltung" CURVE 0xFD05A6 KlAUbSstUbWUb 5.100 t20msxs_ub_b5p1 0.00 5.100 FORMAT "%5.3"
 /begin AXIS_DESCR STD_AXIS gangi dez 8 0.00 255.0 FORMAT "%5.1" DEPOSIT ABSOLUTE /end AXIS_DESCR
/end CHARACTERISTIC
/begin CHARACTERISTIC TFGRBTOFF "Zeit Null-Taste bet‰tigt (FGR. Mainswitchnachbildung ausschalten)" VALUE 0xFC8085 KwWU8 5.080 t20msxs_ub_b5p1 0.02000 5.100 FORMAT "%5.3" /end CHARACTERISTIC
/begin CHARACTERISTIC TFGRBTON "Zeit Null-Taste bet‰tigt (FGR. Mainswitchnachbildung einschalten)" VALUE 0xFC8086 KwWU8 5.080 t20msxs_ub_b5p1 0.02000 5.100 FORMAT "%5.3" /end CHARACTERISTIC
/begin CHARACTERISTIC TFGRBTUBT "Zeit Null-Taste min. nicht bet‰tigt" VALUE 0xFC8087 KwWU8 5.080 t20msxs_ub_b5p1 0.02000 5.100 FORMAT "%5.3" /end CHARACTERISTIC
/begin CHARACTERISTIC TFGRMNLE "Min. Zeit f¸r FGR-Lampe an (im Fehlerfall)" VALUE 0xFC8088 KwWU8 5.080 t20msxs_ub_b5p1 0.02000 5.100 FORMAT "%5.3" /end CHARACTERISTIC
/begin CHARACTERISTIC TFGRT2 "Delayzeit in der Tip SB/SV nach loslassen ‹berdr¸cken nicht erkannt werden darf" VALUE 0xFC8089 KwWU8 5.100 t20msxs_ub_b5p1 0.00 5.100 FORMAT "%5.3" /end CHARACTERISTIC
/begin CHARACTERISTIC TFGRTP "Zeit f¸r Tip-Erkennung bei FGR-Bedientasten" VALUE 0xFC227A KwUb 5.080 t20msxs_ub_b5p1 0.02000 5.100 FORMAT "%5.3" /end CHARACTERISTIC
/begin CHARACTERISTIC TFHUBS "Kennfeld Filterzeitkonstante f¸r Sollwert Hubverstellung" CURVE 0xFC5BA6 KlAxU8SstxU16WU16 655.34999985 zk10msxs_uw_b655 0.010000152590 655.36000000 FORMAT "%12.8"
 /begin AXIS_DESCR STD_AXIS rlvwvugd_w rel_uw_b200 8 0.00 199.9969 FORMAT "%8.4" DEPOSIT ABSOLUTE /end AXIS_DESCR
/end CHARACTERISTIC
/begin CHARACTERISTIC TFHUBSLL "" CURVE 0xFC5BC8 KlAxU8SstxU16WU16 655.34999985 zk10msxs_uw_b655 0.010000152590 655.36000000 FORMAT "%12.8"
 /begin AXIS_DESCR STD_AXIS rlvwvugd_w rel_uw_b200 8 0.00 199.9969 FORMAT "%8.4" DEPOSIT ABSOLUTE /end AXIS_DESCR
/end CHARACTERISTIC
/begin CHARACTERISTIC TFRLGD "Filterkonstante rl_w" VALUE 0xFC490A KwWU16 655.34999985 zk10msxs_uw_b655 0.010000152590 655.36000000 FORMAT "%12.8" /end CHARACTERISTIC
/begin CHARACTERISTIC TFWDKPN "Zeitkonstante f¸r Filterung der DK-Winkel vor Vergl. mit Ersatzwert aus F¸llung" CURVE 0xFC1F74 KlAUbSstUbWUb 2.54000 zk10msxs_ub_b2p55 0.0100000 2.55000 FORMAT "%7.5"
 /begin AXIS_DESCR STD_AXIS nmot nmot_ub_q40 6 0.00 10200. FORMAT "%5.0" DEPOSIT ABSOLUTE /end AXIS_DESCR
/end CHARACTERISTIC
/begin CHARACTERISTIC TFWDKSOM "Zeitkonstante f¸r Drosselklappensollwinkelfilterung bei Kl15 aus" VALUE 0xFC5260 KwWU16 655.34999985 zk10msxs_uw_b655 0.010000152590 655.36000000 FORMAT "%12.8" /end CHARACTERISTIC
/begin CHARACTERISTIC TGDHZNST "Zeit nach Startende, in der keine Drosselung wg. Heizleistung" VALUE 0xFC4925 KwWU8 25.50 t100msxs_ub_b25p5 0.00 25.50 FORMAT "%5.2" /end CHARACTERISTIC
/begin CHARACTERISTIC TGETHKO "obere Schwelle der Getriebe-Oeltemperatur f¸r Klimakompressor aus" VALUE 0xFD22AE KwWU8 191.3 temp_ub_q0p75_o48 -48.00 143.3 FORMAT "%5.1" /end CHARACTERISTIC
/begin CHARACTERISTIC TGETHKO2 "Schwelle Getriebe-Oeltemperatur f¸r Klimakompressor erlaubt" VALUE 0xFD22AF KwWU8 191.3 temp_ub_q0p75_o48 -48.00 143.3 FORMAT "%5.1" /end CHARACTERISTIC
/begin CHARACTERISTIC THSRIH "Zeitverzˆg. Bereitschaft der Ri-Messung nach eingesch. Sondenheizung hinter KAT" VALUE 0xFD27F6 KwUw 6553.500 t100msxs_uw_b6553p5 0.00 6553.500 FORMAT "%8.3" /end CHARACTERISTIC
/begin CHARACTERISTIC TMABMIN "Minimale Abstelltemperatur" VALUE 0xFC4926 KwWU8 191.3 temp_ub_q0p75_o48 -48.00 143.3 FORMAT "%5.1" /end CHARACTERISTIC
/begin CHARACTERISTIC TMFLBE "Fehlerentprellung keine neue MFL-Botschaft empfangen" VALUE 0xFC808A KwWU8 2.540 t10msxs_ub_b2p55 0.01000 2.550 FORMAT "%5.3" /end CHARACTERISTIC
/begin CHARACTERISTIC TMFLFQE "Fehlerentprellung: Telegrammfrequenz ausserhalb des Toleranzbandes" VALUE 0xFC808B KwWU8 2.540 t10msxs_ub_b2p55 0.01000 2.550 FORMAT "%5.3" /end CHARACTERISTIC
/begin CHARACTERISTIC TMFLTC "Fehlerentprellung: Toggelbit-Check" VALUE 0xFC808C KwWU8 2.540 t10msxs_ub_b2p55 0.01000 2.550 FORMAT "%5.3" /end CHARACTERISTIC
/begin CHARACTERISTIC TMGANGGD "min. Motortemperatur f¸r Umschaltung gedrosselt von Gang" VALUE 0xFC4927 KwWU8 191.3 temp_ub_q0p75_o48 -48.00 143.3 FORMAT "%5.1" /end CHARACTERISTIC
/begin CHARACTERISTIC TMGDHZONMN "Minimale Motortemp. f¸r Drosselung wg. Heizleistung" VALUE 0xFC4928 KwWU8 191.3 temp_ub_q0p75_o48 -48.00 143.3 FORMAT "%5.1" /end CHARACTERISTIC
/begin CHARACTERISTIC TMNGDVH "" VALUE 0xFC490C KwWU16 6553.500 t100msxs_uw_b6553p5 0.00 6553.500 FORMAT "%8.3" /end CHARACTERISTIC
/begin CHARACTERISTIC TMRLGD "min. Motortemperatur f¸r Umschaltung gedrosselt aus Kennfeldpunkt" VALUE 0xFC4929 KwWU8 191.3 temp_ub_q0p75_o48 -48.00 143.3 FORMAT "%5.1" /end CHARACTERISTIC
/begin CHARACTERISTIC TMSTHUBSTM "" VALUE 0xFC5C2B KwWU8 191.3 temp_ub_q0p75_o48 -48.00 143.3 FORMAT "%5.1" /end CHARACTERISTIC
/begin CHARACTERISTIC TN2FGRGA "Doppelte Nennerzeitkonstante f¸r FGR-Regler" CURVE 0xFD0794 KlAUwSstUwWUw 1310.700 t20msxs_uw_q0p02 0.00 1310.700 FORMAT "%8.3"
 /begin AXIS_DESCR STD_AXIS gangi dez 8 0.00 255.0 FORMAT "%5.1" DEPOSIT ABSOLUTE /end AXIS_DESCR
/end CHARACTERISTIC
/begin CHARACTERISTIC TNSGANGGD "Zeit nach Startende f¸r Freigabe gedrosselt von Gang" VALUE 0xFC492A KwWU8 25.50 t100msxs_ub_b25p5 0.00 25.50 FORMAT "%5.2" /end CHARACTERISTIC
/begin CHARACTERISTIC TNSRLGD "Zeit nach Startende f¸r Freigabe gedrosselt aus Kennfeldpunkt" VALUE 0xFC492B KwWU8 25.50 t100msxs_ub_b25p5 0.00 25.50 FORMAT "%5.2" /end CHARACTERISTIC
/begin CHARACTERISTIC TOELHGH "obere Oeltemperaturschwelle f¸r CC-Meldung Gang hochschalten" VALUE 0xFD22B0 KwWU8 255.0 temp_ub_q1_o48 -48.00 207.0 FORMAT "%5.1" /end CHARACTERISTIC
/begin CHARACTERISTIC TOELHGH2 "Oeltemperaturschwelle f¸r  f¸r CC-Meldung Gang hochschalten aus" VALUE 0xFD22B1 KwWU8 255.0 temp_ub_q1_o48 -48.00 207.0 FORMAT "%5.1" /end CHARACTERISTIC
/begin CHARACTERISTIC TOELHKO "obere Oeltemperaturschwelle f¸r KO aus" VALUE 0xFD22B2 KwWU8 255.0 temp_ub_q1_o48 -48.00 207.0 FORMAT "%5.1" /end CHARACTERISTIC
/begin CHARACTERISTIC TOELHKO2 "Oeltemperaturschwelle f¸r KO erlaubt" VALUE 0xFD22B3 KwWU8 255.0 temp_ub_q1_o48 -48.00 207.0 FORMAT "%5.1" /end CHARACTERISTIC
/begin CHARACTERISTIC TOELHMD "obere Oeltemperaturschwelle f¸r Leistungsbegrenzung" VALUE 0xFD22B4 KwWU8 255.0 temp_ub_q1_o48 -48.00 207.0 FORMAT "%5.1" /end CHARACTERISTIC
/begin CHARACTERISTIC TOELHMD2 "Oeltemperaturschwelle f¸r Leistungsbegrenzung aus" VALUE 0xFD22B5 KwWU8 255.0 temp_ub_q1_o48 -48.00 207.0 FORMAT "%5.1" /end CHARACTERISTIC
/begin CHARACTERISTIC TOELHOZ "obere Oeltemperaturschwelle bei Modellbildung" VALUE 0xFD22B6 KwWU8 255.0 temp_ub_q1_o48 -48.00 207.0 FORMAT "%5.1" /end CHARACTERISTIC
/begin CHARACTERISTIC TPULSIBH "Zeitverzˆg. f¸r Strompulsen im Spannungsband hinter KAT" VALUE 0xFD27F8 KwUw 6553.500 t100msxs_uw_b6553p5 0.00 6553.500 FORMAT "%8.3" /end CHARACTERISTIC
/begin CHARACTERISTIC TRIAKTH "Zeitdauer f¸r Ri-Berechnung aktuell hinter KAT" VALUE 0xFC8074 KwUw 6553.500 t100msxs_uw_b6553p5 0.00 6553.500 FORMAT "%8.3" /end CHARACTERISTIC
/begin CHARACTERISTIC TRIIMPH "Zeitdauer f¸r Pumpimpuls f¸r beide B‰nke hinter KAT" VALUE 0xFC8076 KwUw 655.3500 t10msxs_uw_b655p35 0.00 655.3500 FORMAT "%8.4" /end CHARACTERISTIC
/begin CHARACTERISTIC TSCHWGD "" VALUE 0xFC492C KwWU8 25.50 t100msxs_ub_b25p5 0.00 25.50 FORMAT "%5.2" /end CHARACTERISTIC
/begin CHARACTERISTIC TSTAEBR "Zeit f¸r Steckerabfall-Erkennung Bremse" VALUE 0xFD2272 KwUw 6553.500 t100msxs_uw_b6553p5 0.00 6553.500 FORMAT "%8.3" /end CHARACTERISTIC
/begin CHARACTERISTIC TSWKNBGA "Zeit bis Setzwertkorrektur nach Ende Beschleunigen" CURVE 0xFD07B6 KlAUwSstUwWUw 1310.700 t20msxs_uw_q0p02 0.00 1310.700 FORMAT "%8.3"
 /begin AXIS_DESCR STD_AXIS gangi dez 8 0.00 255.0 FORMAT "%5.1" DEPOSIT ABSOLUTE /end AXIS_DESCR
/end CHARACTERISTIC
/begin CHARACTERISTIC TSWKNVGA "Zeit bis Setzwertkorrektur nach Ende Verzˆgern" CURVE 0xFD07D8 KlAUwSstUwWUw 1310.700 t20msxs_uw_q0p02 0.00 1310.700 FORMAT "%8.3"
 /begin AXIS_DESCR STD_AXIS gangi dez 8 0.00 255.0 FORMAT "%5.1" DEPOSIT ABSOLUTE /end AXIS_DESCR
/end CHARACTERISTIC
/begin CHARACTERISTIC TTOELHGH "Zeit f¸r unzul‰ssigen Betriebsbereich (CC-Meldung Gang hochschalten)" VALUE 0xFD22A6 KwWU16 13107.00 t200msxs_uw_q0p2 0.00 13107.00 FORMAT "%8.2" /end CHARACTERISTIC
/begin CHARACTERISTIC TTOELHKO "Zeit f¸r unzul‰ssigen Betriebsbereich (KO aus)" VALUE 0xFD22A8 KwWU16 13107.00 t200msxs_uw_q0p2 0.00 13107.00 FORMAT "%8.2" /end CHARACTERISTIC
/begin CHARACTERISTIC TTOELHMD "Zeit f¸r unzul‰ssigen Betriebsbereich (Leistungsbegrenzung)" VALUE 0xFD22AA KwWU16 13107.00 t200msxs_uw_q0p2 0.00 13107.00 FORMAT "%8.2" /end CHARACTERISTIC
/begin CHARACTERISTIC TUMGOELMX "Umgebungstemperaturschwelle f¸r Ersatzwert hohes toel" VALUE 0xFD22B7 KwWU8 191.3 temp_ub_q0p75_o48 -48.00 143.3 FORMAT "%5.1" /end CHARACTERISTIC
/begin CHARACTERISTIC TUSBELH "Zeit f¸r Festhaltung der Sondenspannung nach Impulsbelastung  hinter KAT" VALUE 0xFC8069 KwUb 2.550 t10msxs_ub_b2p55 0.00 2.550 FORMAT "%5.3" /end CHARACTERISTIC
/begin CHARACTERISTIC TUSRIBERH "Zeitverzˆg. der Ri-Messung nach Verlassen des Kabelbruchbandes hinter KAT" VALUE 0xFC8078 KwUw 655.3500 t10msxs_uw_b655p35 0.00 655.3500 FORMAT "%8.4" /end CHARACTERISTIC
/begin CHARACTERISTIC TVDHUBVHN1 "Zeit bis zweite Rampe aktiv wird beim Hub auffahren" VALUE 0xFC5C24 KwWU16 65535.00 dez 0.00 65535.00 FORMAT "%8.2" /end CHARACTERISTIC
/begin CHARACTERISTIC TVDPSRLVW "" VALUE 0xFC490E KwWU16 655.3500 t10msxs_uw_b655p35 0.00 655.3500 FORMAT "%8.4" /end CHARACTERISTIC
/begin CHARACTERISTIC TVERBR "Verzˆgerungszeit f¸r Bremsschalter-Plausibilit‰tspr¸fung" VALUE 0xFD226F KwUb 25.50 t100msxs_ub_b25p5 0.00 25.50 FORMAT "%5.2" /end CHARACTERISTIC
/begin CHARACTERISTIC TVGANGGD "" VALUE 0xFC492D KwWU8 25.50 t100msxs_ub_b25p5 0.00 25.50 FORMAT "%5.2" /end CHARACTERISTIC
/begin CHARACTERISTIC TVGANGUD "" VALUE 0xFC492E KwWU8 25.50 t100msxs_ub_b25p5 0.00 25.50 FORMAT "%5.2" /end CHARACTERISTIC
/begin CHARACTERISTIC TVHALT "Verzoegerungszeit nach Fahrzeughalt" VALUE 0xFD228C KwUw 6553.500 t100msxs_uw_b6553p5 0.00 6553.500 FORMAT "%8.3" /end CHARACTERISTIC
/begin CHARACTERISTIC TVHEIZLGOF "" VALUE 0xFC492F KwWU8 25.50 t100msxs_ub_b25p5 0.00 25.50 FORMAT "%5.2" /end CHARACTERISTIC
/begin CHARACTERISTIC TVHEIZLGON "" VALUE 0xFC4930 KwWU8 25.50 t100msxs_ub_b25p5 0.00 25.50 FORMAT "%5.2" /end CHARACTERISTIC
/begin CHARACTERISTIC TVHUB "Verzˆgerung Sollwert Exzenterwellenwinkel" VALUE 0xFC5C2C KwWU8 7.000 dez 0.00 7.000 FORMAT "%5.3" /end CHARACTERISTIC
/begin CHARACTERISTIC TVKL15 "Verzoegerungszeit Klemme 15" VALUE 0xFD228E KwUw 6553.500 t100msxs_uw_b6553p5 0.00 6553.500 FORMAT "%8.3" /end CHARACTERISTIC
/begin CHARACTERISTIC TVKUP "Verzˆgerungszeit f¸r B_kupplv" VALUE 0xFC77D2 KwUb 5.100 t20msxs_ub_b5p1 0.00 5.100 FORMAT "%5.3" /end CHARACTERISTIC
/begin CHARACTERISTIC TVLADV "Zeitkonstante f¸r Integrator bei vlast-Berechnung" CURVE 0xFC2354 KlAUwSstSwWUw 1309.9800107 zk20msxs_uw_b1310 0.019989318685 1310.0000000 FORMAT "%12.7"
 /begin AXIS_DESCR STD_AXIS dvzvi_w vfzg_sw_q0p00781 8 -256.0000 255.9922 FORMAT "%8.4" DEPOSIT ABSOLUTE /end AXIS_DESCR
/end CHARACTERISTIC
/begin CHARACTERISTIC TVPDKP1 "Fehlertoleranzzeit bei Bereichspr¸fung DK-Poti 1" VALUE 0xFC1F81 KwUb 2.540 t10msxs_ub_b2p55 0.01000 2.550 FORMAT "%5.3" /end CHARACTERISTIC
/begin CHARACTERISTIC TVPDKP2 "Fehlertoleranzzeit bei Bereichspr¸fung DK-Poti 2" VALUE 0xFC1F82 KwUb 2.540 t10msxs_ub_b2p55 0.01000 2.550 FORMAT "%5.3" /end CHARACTERISTIC
/begin CHARACTERISTIC TVPWDK12 "Fehlertoleranzzeit bei Gleichlaufpr¸fung der DK-Potis" VALUE 0xFC1F83 KwUb 2.540 t10msxs_ub_b2p55 0.01000 2.550 FORMAT "%5.3" /end CHARACTERISTIC
/begin CHARACTERISTIC TVPWDK13 "Fehlertoleranzzeit bei Gleichlaufpr¸fung DK-Poti 1 und Ersatzwert aus F¸llung" VALUE 0xFC1F84 KwUb 2.540 t10msxs_ub_b2p55 0.01000 2.550 FORMAT "%5.3" /end CHARACTERISTIC
/begin CHARACTERISTIC TVPWDK23 "Fehlertoleranzzeit bei Gleichlaufpr¸fung DK-Poti 2 und Ersatzwert aus F¸llung" VALUE 0xFC1F85 KwUb 2.540 t10msxs_ub_b2p55 0.01000 2.550 FORMAT "%5.3" /end CHARACTERISTIC
/begin CHARACTERISTIC TVTDDPSADP "" VALUE 0xFC49FA KwUw 655.3500 fak_uw_q0p01 0.00 655.3500 FORMAT "%8.4" /end CHARACTERISTIC
/begin CHARACTERISTIC TVVTCLOSE "Zeitdauer f¸r Hub herunterfahren" VALUE 0xFC5C32 KwUw 655.3500 t10msxs_uw_b655p35 0.00 655.3500 FORMAT "%8.4" /end CHARACTERISTIC
/begin CHARACTERISTIC TVVTSLOW "" VALUE 0xFC5C2D KwWU8 2.550 t10msxs_ub_b2p55 0.00 2.550 FORMAT "%5.3" /end CHARACTERISTIC
/begin CHARACTERISTIC TVWDKS "Verzˆgerungszeit f¸r Drosselklappen-Sollwinkel" VALUE 0xFC5266 KwWU8 7.000 dez 0.00 7.000 FORMAT "%5.3" /end CHARACTERISTIC
/begin CHARACTERISTIC TWDKNV "Zeitkonstante f¸r Drosselklappensollwinkelfilterung" CURVE 0xFC51C2 KlAxU8SstxU16WU16 655.34999985 zk10msxs_uw_b655 0.010000152590 655.36000000 FORMAT "%12.8"
 /begin AXIS_DESCR STD_AXIS nmot_w nmot_uw_q0p25 8 0.00 16383.75 FORMAT "%8.2" DEPOSIT ABSOLUTE /end AXIS_DESCR
/end CHARACTERISTIC
/begin CHARACTERISTIC TWDKSV "Zeitkonstante f¸r Drosselklappensollwinkelfilterung" CURVE 0xFC51E4 KlAxU8SstxU16WU16 655.34999985 zk10msxs_uw_b655 0.010000152590 655.36000000 FORMAT "%12.8"
 /begin AXIS_DESCR STD_AXIS dpsvbgms_w fak_uw_b2 8 0.00 1.999969 FORMAT "%8.6" DEPOSIT ABSOLUTE /end AXIS_DESCR
/end CHARACTERISTIC
/begin CHARACTERISTIC TWDKSVST "" VALUE 0xFC5262 KwWU16 655.34999985 zk10msxs_uw_b655 0.010000152590 655.36000000 FORMAT "%12.8" /end CHARACTERISTIC
/begin CHARACTERISTIC TZ2FGRGA "Doppelte Z‰hlerzeitkonstante f¸r FGR-Regler" CURVE 0xFD07FA KlAUwSstUwWUw 1310.700 t20msxs_uw_q0p02 0.00 1310.700 FORMAT "%8.3"
 /begin AXIS_DESCR STD_AXIS gangi dez 8 0.00 255.0 FORMAT "%5.1" DEPOSIT ABSOLUTE /end AXIS_DESCR
/end CHARACTERISTIC
/begin CHARACTERISTIC UADPUMN "min. Spannungswert f¸r Diagnose Drucksensor" VALUE 0xFD25FE KwUb 4.980 spg_ub_q0p019 0.00 4.980 FORMAT "%5.3" /end CHARACTERISTIC
/begin CHARACTERISTIC UADPUMX "max. Spannungswert f¸r Diagnose Drucksensor" VALUE 0xFD25FF KwUb 4.980 spg_ub_q0p019 0.00 4.980 FORMAT "%5.3" /end CHARACTERISTIC
/begin CHARACTERISTIC UBMFLMN "min. UB-Schwelle f¸r Erkennung defektes MFL" VALUE 0xFC808D KwWU8 24.02 spg_ubatt 0.00 24.02 FORMAT "%5.2" /end CHARACTERISTIC
/begin CHARACTERISTIC UBVDKPO "Batteriespannungsschwelle f¸r Umschaltung auf verst‰rktes Signal von DK-Poti 1" VALUE 0xFC1F86 KwUb 24.02 spg_ubatt 0.00 24.02 FORMAT "%5.2" /end CHARACTERISTIC
/begin CHARACTERISTIC UBVDKPU "Batteriespannungsschwelle f¸r Umschaltung auf unverst‰rktes Signal von DK-Poti 1" VALUE 0xFC1F87 KwUb 24.02 spg_ubatt 0.00 24.02 FORMAT "%5.2" /end CHARACTERISTIC
/begin CHARACTERISTIC UDDSSMN "min. Spannungswert Diagnose Differenzdrucksensor Saugrohr" VALUE 0xFC8004 KwWU16 319.9951 spg_uw_q0p00488 0.00 319.9951 FORMAT "%8.4" /end CHARACTERISTIC
/begin CHARACTERISTIC UDDSSMX "max. Spannungswert Diagnose Differenzdrucksensor Saugrohr" VALUE 0xFC8006 KwWU16 319.9951 spg_uw_q0p00488 0.00 319.9951 FORMAT "%8.4" /end CHARACTERISTIC
/begin CHARACTERISTIC UDKP1O "Maximale zul‰ssige Spannung von DK-Poti 1" VALUE 0xFC1F88 KwUb 4.980 spg_ub_b5 0.00 4.980 FORMAT "%5.3" /end CHARACTERISTIC
/begin CHARACTERISTIC UDKP1U "Minimale zul‰ssige Spannung von DK-Poti 1" VALUE 0xFC1F89 KwUb 4.980 spg_ub_b5 0.00 4.980 FORMAT "%5.3" /end CHARACTERISTIC
/begin CHARACTERISTIC UDKP2O "Maximale zul‰ssige Spannung von DK-Poti 2" VALUE 0xFC1F8A KwUb 4.980 spg_ub_b5 0.00 4.980 FORMAT "%5.3" /end CHARACTERISTIC
/begin CHARACTERISTIC UDKP2U "Minimale zul‰ssige Spannung von DK-Poti 2" VALUE 0xFC1F8B KwUb 4.980 spg_ub_b5 0.00 4.980 FORMAT "%5.3" /end CHARACTERISTIC
/begin CHARACTERISTIC USRIMINH "Mindest Spannungs-Schwelle f¸r Ri-Messung der Sonde hinter KAT" VALUE 0xFC807A KwUw 319.9951 spg_uw_q0p00488_o1 -1.000000 318.9951 FORMAT "%8.4" /end CHARACTERISTIC
/begin CHARACTERISTIC USRIOH "Obere Spannungs-Schwelle f¸r Ri-Messung der Sonde hinter KAT" VALUE 0xFC807C KwUw 319.9951 spg_uw_q0p00488_o1 -1.000000 318.9951 FORMAT "%8.4" /end CHARACTERISTIC
/begin CHARACTERISTIC USRIUH "Untere Spannungs-Schwelle f¸r Ri-Messung der Sonde hinter KAT" VALUE 0xFC807E KwUw 319.9951 spg_uw_q0p00488_o1 -1.000000 318.9951 FORMAT "%8.4" /end CHARACTERISTIC
/begin CHARACTERISTIC VLMXVZ "Maximalwert f¸r vlast_w" CURVE 0xFC2376 KlAUwSstUwWUw 511.9844 vfzg_uw_b512 0.007812500 511.9922 FORMAT "%8.4"
 /begin AXIS_DESCR STD_AXIS vziel_w vfzg_uw_b512 6 0.00 511.9922 FORMAT "%8.4" DEPOSIT ABSOLUTE /end AXIS_DESCR
/end CHARACTERISTIC
/begin CHARACTERISTIC VSE_SPRON "Schalter f¸r Auswahl Istspreizung oder Normspreizung variable NWS" VALUE 0xFC5C2E KwWU8 1.000 dez 0.00 1.000 FORMAT "%5.3" /end CHARACTERISTIC
/begin CHARACTERISTIC WDKDSVLU "Drosselklappenschwelle f¸r Drucksensorplausibilisierung" CURVE 0xFD2600 KlAUbSstUbWUb 100.0 relDK_ub_b100 0.00 100.0 FORMAT "%5.1"
 /begin AXIS_DESCR STD_AXIS nmot nmot_ub_q40 6 0.00 10200. FORMAT "%5.0" DEPOSIT ABSOLUTE /end AXIS_DESCR
/end CHARACTERISTIC
/begin CHARACTERISTIC WDKSAPP "Drosselklappensollwert f¸r Applikationszwecke" VALUE 0xFC5264 KwWU16 99.99847 rel_uw_b100 0.00 99.99847 FORMAT "%8.5" /end CHARACTERISTIC
/begin CHARACTERISTIC WDKSNLN "Sollwinkel f¸r Drosselklappe bei Kl15 aus" CURVE 0xFC5206 KlAxU8SstxU16WU16 99.99847 rel_uw_b100 0.00 99.99847 FORMAT "%8.5"
 /begin AXIS_DESCR STD_AXIS nmot_w nmot_uw_q0p25 8 0.00 16383.75 FORMAT "%8.2" DEPOSIT ABSOLUTE /end AXIS_DESCR
/end CHARACTERISTIC
/begin CHARACTERISTIC WDKUGDN "KL Drosselklappenwinkel, ab der keine Drosselung mehr erfolgt" CURVE 0xFC5228 KlAxU16SstxU16WU16 99.99847 rel_uw_b100 0.00 99.99847 FORMAT "%8.5"
 /begin AXIS_DESCR STD_AXIS nmot nmot_ub_q40 12 0.00 10200. FORMAT "%5.0" DEPOSIT ABSOLUTE /end AXIS_DESCR
/end CHARACTERISTIC
/begin CHARACTERISTIC WPEDGD "Untere Grenze Fahrpedalstellung f¸r R¸cksetzen gedrosselter Warmlauf" VALUE 0xFC4910 KwWU16 100.0000 relPED_uw_b100 0.00 100.0000 FORMAT "%8.4" /end CHARACTERISTIC
/begin CHARACTERISTIC ZDSU "Zeitkonstante f¸r Filterung von pu und fho in GGDSU" VALUE 0xFD260D KwUb 25.4996 zk100msxs_ub_b25p5 0.100392 25.6000 FORMAT "%7.4" /end CHARACTERISTIC
/begin CHARACTERISTIC ZERBR "Fehlerz‰hler f¸r Bremsschalter-Unplausibilit‰ten" VALUE 0xFD2270 KwUb 255.0 dez 0.00 255.0 FORMAT "%5.1" /end CHARACTERISTIC
/begin CHARACTERISTIC ZFRIH "Abschw‰chungsfaktor f¸r Innenwiderstand Ri-Nernst-Filter hinter KAT" VALUE 0xFC8080 KwUw 0.9999847 fak_uw_b1 0.00 0.9999847 FORMAT "%9.7" /end CHARACTERISTIC
/begin CHARACTERISTIC ZKDFST "Zeitkonstante DT1-Filter Tankfuellstand" VALUE 0xFD2290 KwUw 6553.4999985 zk100msxs_uw_b6553 0.10000152590 6553.6000000 FORMAT "%12.7" /end CHARACTERISTIC
/begin CHARACTERISTIC ZKFSTV "Kennlinie Zeitkonstante Fuellstandssignal-Filter" CURVE 0xFD2292 KlAUwSstUwWUw 6553.4999985 zk100msxs_uw_b6553 0.10000152590 6553.6000000 FORMAT "%12.7"
 /begin AXIS_DESCR STD_AXIS vfzg vfzg_ub_q1p25 4 0.00 318.8 FORMAT "%5.1" DEPOSIT ABSOLUTE /end AXIS_DESCR
/end CHARACTERISTIC
/begin CHARACTERISTIC ZKLANSWL "Zeitkonstante Filterung lamnswl_w" VALUE 0xFC7496 KwUw 655.34999985 zk10msxs_uw_b655 0.010000152590 655.36000000 FORMAT "%12.8" /end CHARACTERISTIC
/begin CHARACTERISTIC ZKWESVNS "Zeitkonstante f¸r Tiefpaﬂ fhubvnss_w" VALUE 0xFC5C2F KwWU8 0.9961 fak_ub_b1 0.00 0.9961 /end CHARACTERISTIC
/begin CHARACTERISTIC ZTDDPS "" VALUE 0xFC4912 KwWU16 655.34999985 zk10msxs_uw_b655 0.010000152590 655.36000000 FORMAT "%12.8" /end CHARACTERISTIC
/begin MEASUREMENT anztpdn "Anzahl der hintereinander erfolgten Tip-Downs" UBYTE dez 1 100 0 255 FORMAT "%5.1" ECU_ADDRESS 0x403BB5 /end MEASUREMENT
/begin MEASUREMENT anztpup "Anzahl der hintereinander erfolgten Tip-Ups" UBYTE dez 1 100 0 255 FORMAT "%5.1" ECU_ADDRESS 0x403BB6 /end MEASUREMENT
/begin MEASUREMENT AS_bf0 "" UWORD B_TRUE 1 100 0 1 BIT_MASK 0x8 FORMAT "%13.11" ECU_ADDRESS 0x4046A4 /end MEASUREMENT
/begin MEASUREMENT AS_bf1 "" UWORD B_TRUE 1 100 0 1 BIT_MASK 0x10 FORMAT "%13.11" ECU_ADDRESS 0x4046A4 /end MEASUREMENT
/begin MEASUREMENT AS_bf2 "" UWORD B_TRUE 1 100 0 1 BIT_MASK 0x20 FORMAT "%13.11" ECU_ADDRESS 0x4046A4 /end MEASUREMENT
/begin MEASUREMENT AS_bf3 "" UWORD B_TRUE 1 100 0 1 BIT_MASK 0x40 FORMAT "%13.11" ECU_ADDRESS 0x4046A4 /end MEASUREMENT
/begin MEASUREMENT AS_g0 "" UWORD B_TRUE 1 100 0 1 BIT_MASK 0x1 FORMAT "%13.11" ECU_ADDRESS 0x4046A4 /end MEASUREMENT
/begin MEASUREMENT AS_g1 "" UWORD B_TRUE 1 100 0 1 BIT_MASK 0x2 FORMAT "%13.11" ECU_ADDRESS 0x4046A4 /end MEASUREMENT
/begin MEASUREMENT AS_g2 "" UWORD B_TRUE 1 100 0 1 BIT_MASK 0x4 FORMAT "%13.11" ECU_ADDRESS 0x4046A4 /end MEASUREMENT
/begin MEASUREMENT AS_ksa1 "" UWORD B_TRUE 1 100 0 1 BIT_MASK 0x80 FORMAT "%13.11" ECU_ADDRESS 0x4046A4 /end MEASUREMENT
/begin MEASUREMENT AS_ksa2 "" UWORD B_TRUE 1 100 0 1 BIT_MASK 0x100 FORMAT "%13.11" ECU_ADDRESS 0x4046A4 /end MEASUREMENT
/begin MEASUREMENT AS_ksa3 "" UWORD B_TRUE 1 100 0 1 BIT_MASK 0x200 FORMAT "%13.11" ECU_ADDRESS 0x4046A4 /end MEASUREMENT
/begin MEASUREMENT AS_kti "" UWORD B_TRUE 1 100 0 1 BIT_MASK 0x400 FORMAT "%13.11" ECU_ADDRESS 0x4046A4 /end MEASUREMENT
/begin MEASUREMENT brabevi_w "Beschleunigung bei Rampe Beschleunigen" UWORD bfzg_uw_q0p1085 1 100 0 7110.55 FORMAT "%8.3" ECU_ADDRESS 0x402C3E /end MEASUREMENT
/begin MEASUREMENT brawa1ga_w "Beschleunigung Rampe Wiederaufnahme im Lande-Mode Bereich 1" UWORD bfzg_uw_q0p1085 1 100 0 7110.55 FORMAT "%8.3" ECU_ADDRESS 0x402C40 /end MEASUREMENT
/begin MEASUREMENT brawa2ga_w "Beschleunigung Rampe Wiederaufnahme im Lande-Mode Bereich 2" UWORD bfzg_uw_q0p1085 1 100 0 7110.55 FORMAT "%8.3" ECU_ADDRESS 0x402C42 /end MEASUREMENT
/begin MEASUREMENT brawa3ga_w "Beschleunigung Rampe Wiederaufnahme im Lande-Mode Bereich 3" UWORD bfzg_uw_q0p1085 1 100 0 7110.55 FORMAT "%8.3" ECU_ADDRESS 0x402C44 /end MEASUREMENT
/begin MEASUREMENT brawavi_w "Beschleunigung Rampe Wiederaufnahme" UWORD bfzg_uw_q0p1085 1 100 0 7110.55 FORMAT "%8.3" ECU_ADDRESS 0x402C46 /end MEASUREMENT
/begin MEASUREMENT Btvdpsrlvw "							" UBYTE dez 1 100 0 255 FORMAT "%5.1" ECU_ADDRESS 0x402D00 /end MEASUREMENT
/begin MEASUREMENT B_airbag "Bedingung Airbag ausgelˆst" UBYTE B_TRUE 1 100 0 1 BIT_MASK 0x8 FORMAT "%13.11" ECU_ADDRESS 0x402DEA /end MEASUREMENT
/begin MEASUREMENT B_besch "Bedingung FGR im Zustand Beschleunigen" UWORD B_TRUE 1 100 0 1 BIT_MASK 0x1 FORMAT "%13.11" ECU_ADDRESS 0x403F0A /end MEASUREMENT
/begin MEASUREMENT B_biterr "Bedingung Biterror in Botschaft vorhanden" UBYTE B_TRUE 1 100 0 1 BIT_MASK 0x1 FORMAT "%13.11" ECU_ADDRESS 0x4037DA /end MEASUREMENT
/begin MEASUREMENT B_bl "Bedingung Bremslichtschalter bet‰tigt" UBYTE B_TRUE 1 100 0 1 BIT_MASK 0x1 FORMAT "%13.11" ECU_ADDRESS 0x3FC0EE /end MEASUREMENT
/begin MEASUREMENT B_br "Bedingung Bremstestschalter bet‰tigt" UBYTE B_TRUE 1 100 0 1 BIT_MASK 0x1 FORMAT "%13.11" ECU_ADDRESS 0x3FC0EF /end MEASUREMENT
/begin MEASUREMENT B_br2k "Bedingung Bremse bet‰tigt 2-kanalig erkannt" UBYTE B_TRUE 1 100 0 1 BIT_MASK 0x1 FORMAT "%13.11" ECU_ADDRESS 0x3FC0F0 /end MEASUREMENT
/begin MEASUREMENT B_brems "Bedingung Bremse bet‰tigt" UBYTE B_TRUE 1 100 0 1 BIT_MASK 0x1 FORMAT "%13.11" ECU_ADDRESS 0x3FC0F1 /end MEASUREMENT
/begin MEASUREMENT B_c95bf0 "Ansteuersignal zum Einstellen der Filtermittenfrequenz des CC195 (Pin BF0)" UBYTE B_TRUE 1 100 0 1 BIT_MASK 0x1 FORMAT "%13.11" ECU_ADDRESS 0x3FC140 /end MEASUREMENT
/begin MEASUREMENT B_c95bf1 "Ansteuersignal zum Einstellen der Filtermittenfrequenz des CC195 (Pin BF1)" UBYTE B_TRUE 1 100 0 1 BIT_MASK 0x1 FORMAT "%13.11" ECU_ADDRESS 0x3FC141 /end MEASUREMENT
/begin MEASUREMENT B_c95bf2 "Ansteuersignal zum Einstellen der Filtermittenfrequenz des CC195 (Pin BF2)" UBYTE B_TRUE 1 100 0 1 BIT_MASK 0x1 FORMAT "%13.11" ECU_ADDRESS 0x3FC142 /end MEASUREMENT
/begin MEASUREMENT B_c95bf3 "Ansteuersignal zum Eintstellen der Filtermittenfrequenz des CC195 (Pin BF3)" UBYTE B_TRUE 1 100 0 1 BIT_MASK 0x1 FORMAT "%13.11" ECU_ADDRESS 0x3FC143 /end MEASUREMENT
/begin MEASUREMENT B_c95ks3 "Ansteuersignal f¸r den Nulltest des CC195" UBYTE B_TRUE 1 100 0 1 BIT_MASK 0x1 FORMAT "%13.11" ECU_ADDRESS 0x3FC144 /end MEASUREMENT
/begin MEASUREMENT B_clradhoe "Bedingung: Adaptionswerte Hoehenfaktor selektiv loeschen" UBYTE B_TRUE 1 100 0 1 BIT_MASK 0x1 FORMAT "%13.11" ECU_ADDRESS 0x3FC10D /end MEASUREMENT
/begin MEASUREMENT B_crashgen "Sicherheitsabschaltung Generator bei Crasherkennung" UBYTE B_TRUE 1 100 0 1 BIT_MASK 0x4 FORMAT "%13.11" ECU_ADDRESS 0x402DEA /end MEASUREMENT
/begin MEASUREMENT B_dkp1e "Bedingung Fehler DK-Poti 1" UBYTE B_TRUE 1 100 0 1 BIT_MASK 0x1 FORMAT "%13.11" ECU_ADDRESS 0x3FBFB3 /end MEASUREMENT
/begin MEASUREMENT B_dkp1ev "Bedingung Vorl‰ufige Bereichsverletzung DK-Poti 1" UBYTE B_TRUE 1 100 0 1 BIT_MASK 0x1 FORMAT "%13.11" ECU_ADDRESS 0x3FBFB4 /end MEASUREMENT
/begin MEASUREMENT B_dkp1mn "Bedingung Bereichsverletzung DK-Poti 1 nach unten" UBYTE B_TRUE 1 100 0 1 BIT_MASK 0x1 FORMAT "%13.11" ECU_ADDRESS 0x3FBFB5 /end MEASUREMENT
/begin MEASUREMENT B_dkp1mx "Bedingung Bereichsverletzung DK-Poti 1 nach oben" UBYTE B_TRUE 1 100 0 1 BIT_MASK 0x1 FORMAT "%13.11" ECU_ADDRESS 0x3FBFB6 /end MEASUREMENT
/begin MEASUREMENT B_dkp1np "Bedingung DK-Poti 1 unplausibel zu Ersatzwert aus F¸llung" UBYTE B_TRUE 1 100 0 1 BIT_MASK 0x1 FORMAT "%13.11" ECU_ADDRESS 0x3FBFB7 /end MEASUREMENT
/begin MEASUREMENT B_dkp2e "Bedingung Fehler DK-Poti 2" UBYTE B_TRUE 1 100 0 1 BIT_MASK 0x1 FORMAT "%13.11" ECU_ADDRESS 0x3FBFB8 /end MEASUREMENT
/begin MEASUREMENT B_dkp2ev "Bedingung Vorl‰ufige Bereichsverletzung DK-Poti 2" UBYTE B_TRUE 1 100 0 1 BIT_MASK 0x1 FORMAT "%13.11" ECU_ADDRESS 0x3FBFB9 /end MEASUREMENT
/begin MEASUREMENT B_dkp2mn "Bedingung Bereichsverletzung DK-Poti 2 nach unten" UBYTE B_TRUE 1 100 0 1 BIT_MASK 0x1 FORMAT "%13.11" ECU_ADDRESS 0x3FBFBA /end MEASUREMENT
/begin MEASUREMENT B_dkp2mx "Bedingung Bereichsverletzung DK-Poti 2 nach oben" UBYTE B_TRUE 1 100 0 1 BIT_MASK 0x1 FORMAT "%13.11" ECU_ADDRESS 0x3FBFBB /end MEASUREMENT
/begin MEASUREMENT B_dkp2np "Bedingung DK-Poti 2 unplausibel zu Ersatzwert aus F¸llung" UBYTE B_TRUE 1 100 0 1 BIT_MASK 0x1 FORMAT "%13.11" ECU_ADDRESS 0x3FBFBC /end MEASUREMENT
/begin MEASUREMENT B_dkpaw "Bedingung DK-Poti-Auswahl f¸r DK-Sensor-Ersatzbetrieb" UBYTE B_TRUE 1 100 0 1 BIT_MASK 0x1 FORMAT "%13.11" ECU_ADDRESS 0x3FBFBD /end MEASUREMENT
/begin MEASUREMENT B_dksbeg "Bedingung DK-Sollwertbegrenzung" UBYTE B_TRUE 1 100 0 1 BIT_MASK 0x1 FORMAT "%13.11" ECU_ADDRESS 0x3FBFBE /end MEASUREMENT
/begin MEASUREMENT B_dkvvto "Bedingung VVT Luftmasse oberer Grenzwert ueberschritten" UBYTE B_TRUE 1 100 0 1 BIT_MASK 0x1 FORMAT "%13.11" ECU_ADDRESS 0x3FC077 /end MEASUREMENT
/begin MEASUREMENT B_dkvvtu "Bedingung VVT Luftmasse unterer Grenzwert unterschritten" UBYTE B_TRUE 1 100 0 1 BIT_MASK 0x1 FORMAT "%13.11" ECU_ADDRESS 0x3FC078 /end MEASUREMENT
/begin MEASUREMENT B_dnt "Aktive Diagnose: Klopfregelung Nulltest" UBYTE B_TRUE 1 100 0 1 BIT_MASK 0x1 FORMAT "%13.11" ECU_ADDRESS 0x3FC145 /end MEASUREMENT
/begin MEASUREMENT B_dntb "Bedingung Diagnose: Bereitschaft zum Nulltest (Nulltest im n‰chsten MF)" UBYTE B_TRUE 1 100 0 1 BIT_MASK 0x1 FORMAT "%13.11" ECU_ADDRESS 0x3FC146 /end MEASUREMENT
/begin MEASUREMENT B_dpsadp "Bedingung Differenzdruck Saugrohr Adaption eingeschaltet" UBYTE dez 1 100 0 255 FORMAT "%5.1" ECU_ADDRESS 0x402D01 /end MEASUREMENT
/begin MEASUREMENT B_dpsplau1 "Bedingung Plausibilitaetsband Differenzdrucksensor verlassen" UBYTE dez 1 100 0 255 FORMAT "%5.1" ECU_ADDRESS 0x403C00 /end MEASUREMENT
/begin MEASUREMENT B_dpsplau2 "" UBYTE dez 1 100 0 255 FORMAT "%5.1" ECU_ADDRESS 0x403C01 /end MEASUREMENT
/begin MEASUREMENT B_dtp "Aktive Diagnose: Klopfregelung Testimpuls" UBYTE B_TRUE 1 100 0 1 BIT_MASK 0x1 FORMAT "%13.11" ECU_ADDRESS 0x3FC147 /end MEASUREMENT
/begin MEASUREMENT B_dtpb "Bedingung Diagnose: Bereitschaft zum Testpuls (Testpuls im n‰chsten MF)" UBYTE B_TRUE 1 100 0 1 BIT_MASK 0x1 FORMAT "%13.11" ECU_ADDRESS 0x3FC148 /end MEASUREMENT
/begin MEASUREMENT B_dummy "" UBYTE B_TRUE 1 100 0 1 BIT_MASK 0x1 FORMAT "%13.11" ECU_ADDRESS 0x3FC149 /end MEASUREMENT
/begin MEASUREMENT B_edks "Bedingung Fehler Drosselklappen-Sensor" UBYTE B_TRUE 1 100 0 1 BIT_MASK 0x1 FORMAT "%13.11" ECU_ADDRESS 0x3FBFBF /end MEASUREMENT
/begin MEASUREMENT B_edpsplau "Fehler Plausibilit‰t Differenzdrucksensor" UBYTE dez 1 100 0 255 FORMAT "%5.1" ECU_ADDRESS 0x403C02 /end MEASUREMENT
/begin MEASUREMENT B_edsl "Bedingung Error Ladedrucksensor" UBYTE B_TRUE 1 100 0 1 BIT_MASK 0x1 FORMAT "%13.11" ECU_ADDRESS 0x3FC10E /end MEASUREMENT
/begin MEASUREMENT B_edsuu "Bedingung Error Umgebungsdrucksensor nicht zeitentprellt" UBYTE B_TRUE 1 100 0 1 BIT_MASK 0x1 FORMAT "%13.11" ECU_ADDRESS 0x3FE19E /end MEASUREMENT
/begin MEASUREMENT B_ekpcarmd "Bedingung EKP-Abschaltung ist im Arming-Zustand" UBYTE B_TRUE 1 100 0 1 BIT_MASK 0x2 FORMAT "%13.11" ECU_ADDRESS 0x402DEA /end MEASUREMENT
/begin MEASUREMENT B_ekpcena "Bedingung EKP-Abschaltung ist grunds‰tzlich freigegeben" UBYTE B_TRUE 1 100 0 1 BIT_MASK 0x1 FORMAT "%13.11" ECU_ADDRESS 0x402DEA /end MEASUREMENT
/begin MEASUREMENT B_elsxbb "Fehler LS vor Kat, der Betriebsbereitschaft zur¸cksetzt" UBYTE B_TRUE 1 100 0 1 BIT_MASK 0x2 FORMAT "%13.11" ECU_ADDRESS 0x403BA0 /end MEASUREMENT
/begin MEASUREMENT B_elsxbb2 "Fehler LS vor Kat, der Betriebsbereitschaft zur¸cksetzt, Bank2" UBYTE B_TRUE 1 100 0 1 BIT_MASK 0x8 FORMAT "%13.11" ECU_ADDRESS 0x403BA0 /end MEASUREMENT
/begin MEASUREMENT B_enrinh "Bedingung enable f¸r Ri-Nernst mit Filter hinter KAT" UBYTE B_TRUE 1 100 0 1 BIT_MASK 0x1 FORMAT "%13.11" ECU_ADDRESS 0x3FC152 /end MEASUREMENT
/begin MEASUREMENT B_enrinh2 "Bedingung enable f¸r Ri-Nernst mit Filter hinter KAT Bank2" UBYTE B_TRUE 1 100 0 1 BIT_MASK 0x1 FORMAT "%13.11" ECU_ADDRESS 0x3FC153 /end MEASUREMENT
/begin MEASUREMENT B_erbr "Bedingung Bremsschaltersignale unplausibel" UBYTE B_TRUE 1 100 0 1 BIT_MASK 0x1 FORMAT "%13.11" ECU_ADDRESS 0x3FC0F2 /end MEASUREMENT
/begin MEASUREMENT B_erinofh "Bedingung enable f¸r Ri-Nernst ohne Filter hinter KAT" UBYTE B_TRUE 1 100 0 1 BIT_MASK 0x1 FORMAT "%13.11" ECU_ADDRESS 0x3FC154 /end MEASUREMENT
/begin MEASUREMENT B_erinofh2 "Bedingung enable f¸r Ri-Nernst ohne Filter hinter KAT Bank2" UBYTE B_TRUE 1 100 0 1 BIT_MASK 0x1 FORMAT "%13.11" ECU_ADDRESS 0x3FC155 /end MEASUREMENT
/begin MEASUREMENT B_fe "Betriebsartenbyte" UBYTE dez 1 100 0 255 FORMAT "%5.1" ECU_ADDRESS 0x402D10 /end MEASUREMENT
/begin MEASUREMENT B_ff "Bedingung Folgefunkenz¸ndung" UBYTE B_TRUE 1 100 0 1 BIT_MASK 0x1 FORMAT "%13.11" ECU_ADDRESS 0x3FC372 /end MEASUREMENT
/begin MEASUREMENT B_fgrakt "Bedingung FGR-Regler aktiv" UWORD B_TRUE 1 100 0 1 BIT_MASK 0x4 FORMAT "%13.11" ECU_ADDRESS 0x403F0A /end MEASUREMENT
/begin MEASUREMENT B_fgrari "Bedingung FGR-Abschaltrampe Initialisierung" UBYTE B_TRUE 1 100 0 1 BIT_MASK 0x1 FORMAT "%13.11" ECU_ADDRESS 0x3FC05E /end MEASUREMENT
/begin MEASUREMENT B_fgrat "Bedingung: Tip-Schalter Aus am FGR-Bedienteil bet‰tigt" UBYTE B_TRUE 1 100 0 1 BIT_MASK 0x1 FORMAT "%13.11" ECU_ADDRESS 0x4037DB /end MEASUREMENT
/begin MEASUREMENT B_fgrdvi "Bedingung FGR-Regler Initialisierung der gespeicherten Regelabweichung" UWORD B_TRUE 1 100 0 1 BIT_MASK 0x8 FORMAT "%13.11" ECU_ADDRESS 0x403F0A /end MEASUREMENT
/begin MEASUREMENT B_fgren "Bedingung Fahrgeschwindigkeitsregelung aktiv (Enable)" UBYTE B_TRUE 1 100 0 1 BIT_MASK 0x1 FORMAT "%13.11" ECU_ADDRESS 0x3FC065 /end MEASUREMENT
/begin MEASUREMENT B_fgrene "Bedingung FGR-Regelung aktiv (Enable) erweitert" UBYTE B_TRUE 1 100 0 1 BIT_MASK 0x1 FORMAT "%13.11" ECU_ADDRESS 0x3FC05F /end MEASUREMENT
/begin MEASUREMENT B_fgrhe "Bedingung: FGR-Bedienteil-Fehler" UBYTE B_TRUE 1 100 0 1 BIT_MASK 0x1 FORMAT "%13.11" ECU_ADDRESS 0x4037DC /end MEASUREMENT
/begin MEASUREMENT B_fgrhsa "Bedingung: FGR-Hauptschalter aus" UBYTE B_TRUE 1 100 0 1 BIT_MASK 0x1 FORMAT "%13.11" ECU_ADDRESS 0x4037DD /end MEASUREMENT
/begin MEASUREMENT B_fgrkf "Bedingung: FGR im Zustand Konstantfahrt" UBYTE B_TRUE 1 100 0 1 BIT_MASK 0x1 FORMAT "%13.11" ECU_ADDRESS 0x3FC066 /end MEASUREMENT
/begin MEASUREMENT B_fgrkfm "Bedingung: FGR im Zustand Konstantfahrt (aus ME)" UBYTE B_TRUE 1 100 0 1 BIT_MASK 0x1 FORMAT "%13.11" ECU_ADDRESS 0x3FC060 /end MEASUREMENT
/begin MEASUREMENT B_fgrra "Bedingung FGR-Rampe" UWORD B_TRUE 1 100 0 1 BIT_MASK 0x10 FORMAT "%13.11" ECU_ADDRESS 0x403F0A /end MEASUREMENT
/begin MEASUREMENT B_fgrtb2 "Bedingung FGR-Taste Auswahl der n‰chsthˆheren Zielgeschwindigkeit" UBYTE B_TRUE 1 100 0 1 BIT_MASK 0x1 FORMAT "%13.11" ECU_ADDRESS 0x3FC171 /end MEASUREMENT
/begin MEASUREMENT B_fgrtbe "Bedingung FGR-Taste Beschleunigen" UBYTE B_TRUE 1 100 0 1 BIT_MASK 0x1 FORMAT "%13.11" ECU_ADDRESS 0x4037DE /end MEASUREMENT
/begin MEASUREMENT B_fgrtse "Bedingung FGR-Taste Setzen" UBYTE B_TRUE 1 100 0 1 BIT_MASK 0x1 FORMAT "%13.11" ECU_ADDRESS 0x4037DF /end MEASUREMENT
/begin MEASUREMENT B_fgrtv2 "Bedingung FGR-Taste Auswahl der n‰chstniederen Zielgeschwindigkeit" UBYTE B_TRUE 1 100 0 1 BIT_MASK 0x1 FORMAT "%13.11" ECU_ADDRESS 0x3FC172 /end MEASUREMENT
/begin MEASUREMENT B_fgrtve "Bedingung FGR-Taste Verzˆgern" UBYTE B_TRUE 1 100 0 1 BIT_MASK 0x1 FORMAT "%13.11" ECU_ADDRESS 0x4037E0 /end MEASUREMENT
/begin MEASUREMENT B_fgrtwa "Bedingung FGR-Taste Wiederaufnahme" UBYTE B_TRUE 1 100 0 1 BIT_MASK 0x1 FORMAT "%13.11" ECU_ADDRESS 0x4037E1 /end MEASUREMENT
/begin MEASUREMENT B_fgrvem "Bedingung: FGR im Zustand Verzˆgern (aus ME)" UBYTE B_TRUE 1 100 0 1 BIT_MASK 0x1 FORMAT "%13.11" ECU_ADDRESS 0x3FC061 /end MEASUREMENT
/begin MEASUREMENT B_fgrver "Bedingung: FGR im Zustand Verzˆgern" UBYTE B_TRUE 1 100 0 1 BIT_MASK 0x1 FORMAT "%13.11" ECU_ADDRESS 0x3FC067 /end MEASUREMENT
/begin MEASUREMENT B_fmfkrc "Filtermittenfrequenz des CC195/CC650 umgeschaltet" UBYTE B_TRUE 1 100 0 1 BIT_MASK 0x1 FORMAT "%13.11" ECU_ADDRESS 0x3FC14A /end MEASUREMENT
/begin MEASUREMENT B_fmfkrco "Filtermittenfrequenz umgeschaltet, neue Frequenz ist hˆher" UBYTE B_TRUE 1 100 0 1 BIT_MASK 0x1 FORMAT "%13.11" ECU_ADDRESS 0x3FC14B /end MEASUREMENT
/begin MEASUREMENT B_fmfkrcu "Filtermittenfrequenz umgeschaltet, neue Frequenz ist kleiner" UBYTE B_TRUE 1 100 0 1 BIT_MASK 0x1 FORMAT "%13.11" ECU_ADDRESS 0x3FC14C /end MEASUREMENT
/begin MEASUREMENT B_frz_hub "BMW" UBYTE dez 1 100 0 255 FORMAT "%5.1" ECU_ADDRESS 0x403799 /end MEASUREMENT
/begin MEASUREMENT B_fstdmn "Bedingung minimaler Tankfuellstand fuer Diagnosefunkionen" UBYTE B_TRUE 1 100 0 1 BIT_MASK 0x1 FORMAT "%13.11" ECU_ADDRESS 0x403BDE /end MEASUREMENT
/begin MEASUREMENT B_fstdmx "Bedingung maximaler Tankfuellstand fuer Diagnosefunktionen" UBYTE B_TRUE 1 100 0 1 BIT_MASK 0x2 FORMAT "%13.11" ECU_ADDRESS 0x403BDE /end MEASUREMENT
/begin MEASUREMENT B_fstdy "Bedingung Tankfuellstand dynamisch" UBYTE B_TRUE 1 100 0 1 BIT_MASK 0x1 FORMAT "%13.11" ECU_ADDRESS 0x403BE0 /end MEASUREMENT
/begin MEASUREMENT B_fststa "Bedingung Fuellstand nach Start" UBYTE B_TRUE 1 100 0 1 BIT_MASK 0x4 FORMAT "%13.11" ECU_ADDRESS 0x403BE0 /end MEASUREMENT
/begin MEASUREMENT B_fsttal "Bedigung Fuellstand Tank leer" UBYTE B_TRUE 1 100 0 1 BIT_MASK 0x20 FORMAT "%13.11" ECU_ADDRESS 0x403BDE /end MEASUREMENT
/begin MEASUREMENT B_fsttew "Bedingung Ersatzwert Tankfuellstand" UBYTE B_TRUE 1 100 0 1 BIT_MASK 0x2 FORMAT "%13.11" ECU_ADDRESS 0x403BE0 /end MEASUREMENT
/begin MEASUREMENT B_fsttg "Fuellstand Tank gueltig (auch im Steuergerdtenachlauf)" UBYTE B_TRUE 1 100 0 1 BIT_MASK 0x1 FORMAT "%13.11" ECU_ADDRESS 0x403BDF /end MEASUREMENT
/begin MEASUREMENT B_fsttsh "Bedingung Tankfuellstandssignal Sample/Hold" UBYTE B_TRUE 1 100 0 1 BIT_MASK 0x4 FORMAT "%13.11" ECU_ADDRESS 0x403BDE /end MEASUREMENT
/begin MEASUREMENT B_fsttval "Bedingung Fuellstand Tank validiert" UBYTE B_TRUE 1 100 0 1 BIT_MASK 0x8 FORMAT "%13.11" ECU_ADDRESS 0x403BDE /end MEASUREMENT
/begin MEASUREMENT B_gd "Bedingung gedrosselt" UBYTE dez 1 100 0 255 FORMAT "%5.1" ECU_ADDRESS 0x402D02 /end MEASUREMENT
/begin MEASUREMENT B_gdgang "Bedingung gedrosslet von Gang" UBYTE B_TRUE 1 100 0 1 FORMAT "%13.11" ECU_ADDRESS 0x403794 /end MEASUREMENT
/begin MEASUREMENT B_gdhz "Bedingung gedrosselt wegen Heizleistung" UBYTE dez 1 100 0 255 FORMAT "%5.1" ECU_ADDRESS 0x402D03 /end MEASUREMENT
/begin MEASUREMENT B_gdkf "Bedingung gedrosselt aus Kennfeldpunkt" UBYTE B_TRUE 1 100 0 1 FORMAT "%13.11" ECU_ADDRESS 0x403795 /end MEASUREMENT
/begin MEASUREMENT B_gdkfgang "Bedingung gedrosselt aus Kennfeldpunkt oder Gang" UBYTE B_TRUE 1 100 0 1 FORMAT "%13.11" ECU_ADDRESS 0x403796 /end MEASUREMENT
/begin MEASUREMENT B_gdon "Bedingung gedrosselt wegen Heizleistung oder Testeranforderung" UBYTE dez 1 100 0 255 FORMAT "%5.1" ECU_ADDRESS 0x402D04 /end MEASUREMENT
/begin MEASUREMENT B_gdst "Schnelle Rampe f¸r Vollhubeinstellung" UBYTE dez 1 100 0 255 FORMAT "%5.1" ECU_ADDRESS 0x402D05 /end MEASUREMENT
/begin MEASUREMENT B_gdvhub "Gedrosselt mit Vollhub" UBYTE dez 1 100 0 255 FORMAT "%5.1" ECU_ADDRESS 0x402D06 /end MEASUREMENT
/begin MEASUREMENT b_gdvhub_alt "" UBYTE dez 1 100 0 1 FORMAT "%5.3" ECU_ADDRESS 0x4038E0 /end MEASUREMENT
/begin MEASUREMENT B_gdvvtueb "							" UBYTE dez 1 100 0 255 FORMAT "%5.1" ECU_ADDRESS 0x402D07 /end MEASUREMENT
/begin MEASUREMENT B_gd_alt "							" UBYTE dez 1 100 0 255 FORMAT "%5.1" ECU_ADDRESS 0x402D08 /end MEASUREMENT
/begin MEASUREMENT B_genfprl "Bedingung Generatorfehler entprellt" UBYTE B_TRUE 1 100 0 1 FORMAT "%13.11" ECU_ADDRESS 0x403209 /end MEASUREMENT
/begin MEASUREMENT B_genfprl2 "" UBYTE B_TRUE 1 100 0 1 FORMAT "%13.11" ECU_ADDRESS 0x403213 /end MEASUREMENT
/begin MEASUREMENT B_gfbsupa2 "Bedingung Generatortyp unplausibel" UBYTE B_TRUE 1 100 0 1 FORMAT "%13.11" ECU_ADDRESS 0x403214 /end MEASUREMENT
/begin MEASUREMENT B_gfbsupak "Generator Typ unplausibel aus Fehlerspeicher" UBYTE B_TRUE 1 100 0 1 FORMAT "%13.11" ECU_ADDRESS 0x40320A /end MEASUREMENT
/begin MEASUREMENT B_gfelak "Generatorfehler elektrisch aus Fehlerspeicher" UBYTE B_TRUE 1 100 0 1 FORMAT "%13.11" ECU_ADDRESS 0x40320B /end MEASUREMENT
/begin MEASUREMENT B_gfelak2 "Generatorfehler elektrisch vorhanden" UBYTE B_TRUE 1 100 0 1 FORMAT "%13.11" ECU_ADDRESS 0x403215 /end MEASUREMENT
/begin MEASUREMENT B_gfhtak "Generatorfehler Uebertemperatur aus Fehlerspeicher" UBYTE B_TRUE 1 100 0 1 FORMAT "%13.11" ECU_ADDRESS 0x40320C /end MEASUREMENT
/begin MEASUREMENT B_gfhtak2 "" UBYTE B_TRUE 1 100 0 1 FORMAT "%13.11" ECU_ADDRESS 0x403216 /end MEASUREMENT
/begin MEASUREMENT B_gfmeak "Generatorfehler mechanisch aus Fehlerspeicher" UBYTE B_TRUE 1 100 0 1 FORMAT "%13.11" ECU_ADDRESS 0x40320D /end MEASUREMENT
/begin MEASUREMENT B_gfmeak2 "Generatorfehler elektrisch vorhanden" UBYTE B_TRUE 1 100 0 1 FORMAT "%13.11" ECU_ADDRESS 0x403217 /end MEASUREMENT
/begin MEASUREMENT B_gfnobsa2 "Kommunikationsfehler Generator" UBYTE B_TRUE 1 100 0 1 FORMAT "%13.11" ECU_ADDRESS 0x403218 /end MEASUREMENT
/begin MEASUREMENT B_gfnobsak "Generator BSD Kommunikationsverlust aus Fehlerspeicher" UBYTE B_TRUE 1 100 0 1 FORMAT "%13.11" ECU_ADDRESS 0x40320E /end MEASUREMENT
/begin MEASUREMENT B_hag "Bedingung Hˆhenadaption g¸ltig" UBYTE B_TRUE 1 100 0 1 BIT_MASK 0x1 FORMAT "%13.11" ECU_ADDRESS 0x3FC10F /end MEASUREMENT
/begin MEASUREMENT B_hubst "Bedingung f¸r Hubvorsteuerung im Start" UBYTE dez 1 100 0 255 FORMAT "%5.1" ECU_ADDRESS 0x40379A /end MEASUREMENT
/begin MEASUREMENT B_hz_tpoff "							" UBYTE B_TRUE 1 100 0 1 FORMAT "%13.11" ECU_ADDRESS 0x403797 /end MEASUREMENT
/begin MEASUREMENT B_hz_tpon "							" UBYTE B_TRUE 1 100 0 1 FORMAT "%13.11" ECU_ADDRESS 0x403798 /end MEASUREMENT
/begin MEASUREMENT B_ibsfprl "BSD Kommunikationsfehler zum IBS eingetragen" UBYTE B_TRUE 1 100 0 1 FORMAT "%13.11" ECU_ADDRESS 0x40321B /end MEASUREMENT
/begin MEASUREMENT B_ifbsak "IBS BSD Stoerung, Fehler eingetragen und anliegend" UBYTE B_TRUE 1 100 0 1 FORMAT "%13.11" ECU_ADDRESS 0x40321C /end MEASUREMENT
/begin MEASUREMENT B_ifebsak "IBS BSD Stoerung erweiterte Kommunikation; Fehler eingetragen und anliegend" UBYTE B_TRUE 1 100 0 1 FORMAT "%13.11" ECU_ADDRESS 0x40321D /end MEASUREMENT
/begin MEASUREMENT B_ifisak "Stromfehler eingetragen und anliegend" UBYTE B_TRUE 1 100 0 1 FORMAT "%13.11" ECU_ADDRESS 0x40321E /end MEASUREMENT
/begin MEASUREMENT B_ifsysak "IBS Systemfehler eingetragen und anliegend" UBYTE B_TRUE 1 100 0 1 FORMAT "%13.11" ECU_ADDRESS 0x40321F /end MEASUREMENT
/begin MEASUREMENT B_iftempak "Temp.Fehler eingetragen und anliegend" UBYTE B_TRUE 1 100 0 1 FORMAT "%13.11" ECU_ADDRESS 0x403220 /end MEASUREMENT
/begin MEASUREMENT B_ifuplak "" UBYTE B_TRUE 1 100 0 1 FORMAT "%13.11" ECU_ADDRESS 0x403221 /end MEASUREMENT
/begin MEASUREMENT B_ifusak "Sannungsfehler eingetragen und anliegend" UBYTE B_TRUE 1 100 0 1 FORMAT "%13.11" ECU_ADDRESS 0x403222 /end MEASUREMENT
/begin MEASUREMENT B_ifwugdak "" UBYTE B_TRUE 1 100 0 1 FORMAT "%13.11" ECU_ADDRESS 0x403223 /end MEASUREMENT
/begin MEASUREMENT B_ifwuplak "" UBYTE B_TRUE 1 100 0 1 FORMAT "%13.11" ECU_ADDRESS 0x403224 /end MEASUREMENT
/begin MEASUREMENT B_imlvhb "Bedingung Luftmasse f¸r B_gdst" UBYTE dez 1 100 0 255 FORMAT "%5.1" ECU_ADDRESS 0x402D09 /end MEASUREMENT
/begin MEASUREMENT B_kfnb "Bedingung Konstantfahrt nach Beschleunigen" UWORD B_TRUE 1 100 0 1 BIT_MASK 0x20 FORMAT "%13.11" ECU_ADDRESS 0x403F0A /end MEASUREMENT
/begin MEASUREMENT B_kfnv "Bedingung Konstantfahrt nach Verzˆgern" UWORD B_TRUE 1 100 0 1 BIT_MASK 0x40 FORMAT "%13.11" ECU_ADDRESS 0x403F0A /end MEASUREMENT
/begin MEASUREMENT B_krmfok "Bedingung: Berechnung des Messfensters abgeschlossen" UBYTE B_TRUE 1 100 0 1 BIT_MASK 0x1 FORMAT "%13.11" ECU_ADDRESS 0x3FC14D /end MEASUREMENT
/begin MEASUREMENT B_kuppl "Bedingung Kupplungspedal bet‰tigt" UBYTE B_TRUE 1 100 0 1 BIT_MASK 0x1 FORMAT "%13.11" ECU_ADDRESS 0x3FC0F3 /end MEASUREMENT
/begin MEASUREMENT B_kupplv "Bedingung Kupplung bet‰tigt verzˆgert" UBYTE B_TRUE 1 100 0 1 BIT_MASK 0x1 FORMAT "%13.11" ECU_ADDRESS 0x3FC0F4 /end MEASUREMENT
/begin MEASUREMENT B_kutoelh "Bedingung Kupplungspedal bet‰tigt bei hohem toel" UBYTE B_TRUE 1 100 0 1 BIT_MASK 0x1 FORMAT "%13.11" ECU_ADDRESS 0x3FE179 /end MEASUREMENT
/begin MEASUREMENT B_lawlon "lamwl_w ist aktiv" UBYTE B_TRUE 1 100 0 1 BIT_MASK 0x1 FORMAT "%13.11" ECU_ADDRESS 0x3FC0C7 /end MEASUREMENT
/begin MEASUREMENT B_llk "Bedingung nwe unterschritten (hysteresebehaftet)" UBYTE dez 1 100 0 255 FORMAT "%5.1" ECU_ADDRESS 0x40379B /end MEASUREMENT
/begin MEASUREMENT B_lltd "Leerlauf teilgedrosselt" UBYTE dez 1 100 0 255 FORMAT "%5.1" ECU_ADDRESS 0x402D0A /end MEASUREMENT
/begin MEASUREMENT B_measure "Bedingung Timer TGGLS wird nicht berechnet," UBYTE B_TRUE 1 100 0 1 BIT_MASK 0x1 FORMAT "%13.11" ECU_ADDRESS 0x3FC156 /end MEASUREMENT
/begin MEASUREMENT B_mfl "Bedingung: MFL vorhanden" UBYTE B_TRUE 1 100 0 1 BIT_MASK 0x1 FORMAT "%13.11" ECU_ADDRESS 0x3FE1BE /end MEASUREMENT
/begin MEASUREMENT B_mflon "" UBYTE B_TRUE 1 100 0 1 BIT_MASK 0x1 FORMAT "%13.11" ECU_ADDRESS 0x4037E2 /end MEASUREMENT
/begin MEASUREMENT B_mnmflv "Bedingung MFL-Signal weist Frequenzfehler auf" UBYTE B_TRUE 1 100 0 1 BIT_MASK 0x1 FORMAT "%13.11" ECU_ADDRESS 0x4037E3 /end MEASUREMENT
/begin MEASUREMENT B_mol_sf "Bedingung Sensorfehler ÷lzustandssensor" UBYTE B_TRUE 1 100 0 1 BIT_MASK 0x1 FORMAT "%13.11" ECU_ADDRESS 0x403109 /end MEASUREMENT
/begin MEASUREMENT B_mxmflv "Bedingung MFL-Signal weist Toggelbitfehler auf" UBYTE B_TRUE 1 100 0 1 BIT_MASK 0x1 FORMAT "%13.11" ECU_ADDRESS 0x4037E4 /end MEASUREMENT
/begin MEASUREMENT B_npmflv "Bedingung MFL-Signal nicht plausibel" UBYTE B_TRUE 1 100 0 1 BIT_MASK 0x1 FORMAT "%13.11" ECU_ADDRESS 0x4037E5 /end MEASUREMENT
/begin MEASUREMENT B_ntini "KR: Bedingung f¸r Initialisierungs-Nulltest" UBYTE B_TRUE 1 100 0 1 BIT_MASK 0x1 FORMAT "%13.11" ECU_ADDRESS 0x3FC14E /end MEASUREMENT
/begin MEASUREMENT B_nwe "Nockenwellen Entstufe angesteuert" UBYTE dez 1 100 0 255 FORMAT "%5.1" ECU_ADDRESS 0x40379C /end MEASUREMENT
/begin MEASUREMENT B_ot_isr "" UBYTE B_TRUE 1 100 0 1 BIT_MASK 0x1 FORMAT "%13.11" ECU_ADDRESS 0x3FC14F /end MEASUREMENT
/begin MEASUREMENT B_ozclfsp "Bedingung Fehlerspeicher lˆschen" UBYTE B_TRUE 1 100 0 1 BIT_MASK 0x2 FORMAT "%13.11" ECU_ADDRESS 0x403109 /end MEASUREMENT
/begin MEASUREMENT B_priph "Bedingung Port schalten f¸r Pumpimpuls hinter KAT" UBYTE B_TRUE 1 100 0 1 BIT_MASK 0x1 FORMAT "%13.11" ECU_ADDRESS 0x3FC157 /end MEASUREMENT
/begin MEASUREMENT B_priph2 "Bedingung Port schalten f¸r Pumpimpuls hinter KAT Bank2" UBYTE B_TRUE 1 100 0 1 BIT_MASK 0x1 FORMAT "%13.11" ECU_ADDRESS 0x3FC158 /end MEASUREMENT
/begin MEASUREMENT B_pulsibh "Bedingung Strom-Puls auch wenn Sonde im Band hinter KAT" UBYTE B_TRUE 1 100 0 1 BIT_MASK 0x1 FORMAT "%13.11" ECU_ADDRESS 0x403C1A /end MEASUREMENT
/begin MEASUREMENT B_pulsibh2 "Bedingung Strom-Puls auch wenn Sonde im Band hinter KAT Bank2" UBYTE B_TRUE 1 100 0 1 BIT_MASK 0x2 FORMAT "%13.11" ECU_ADDRESS 0x403C1A /end MEASUREMENT
/begin MEASUREMENT B_pump "Bedingung Starten des Timers TTGLS" UBYTE B_TRUE 1 100 0 1 BIT_MASK 0x1 FORMAT "%13.11" ECU_ADDRESS 0x3FC159 /end MEASUREMENT
/begin MEASUREMENT B_riakh "Bedingung f¸r Strom-Pumpen aktualisiert hinter KAT" UBYTE B_TRUE 1 100 0 1 BIT_MASK 0x1 FORMAT "%13.11" ECU_ADDRESS 0x3FC15A /end MEASUREMENT
/begin MEASUREMENT B_riakh2 "Bedingung f¸r Strom-Pumpen aktualisiert hinter KAT Bank2" UBYTE B_TRUE 1 100 0 1 BIT_MASK 0x1 FORMAT "%13.11" ECU_ADDRESS 0x3FC15B /end MEASUREMENT
/begin MEASUREMENT B_ribeh "Bedingung Innenwiderstand Ri berechnen f¸r Sonde hinter KAT" UBYTE B_TRUE 1 100 0 1 BIT_MASK 0x1 FORMAT "%13.11" ECU_ADDRESS 0x3FC15C /end MEASUREMENT
/begin MEASUREMENT B_ribeh2 "Bedingung Innenwiderstand Ri berechnen f¸r Sonde hinter KAT Bank2" UBYTE B_TRUE 1 100 0 1 BIT_MASK 0x1 FORMAT "%13.11" ECU_ADDRESS 0x3FC15D /end MEASUREMENT
/begin MEASUREMENT B_ribehv "Bedingung Innenwiderstand Ri verzˆgert berechnen f¸r Sonde hinter Hauptkat" UBYTE B_TRUE 1 100 0 1 BIT_MASK 0x1 FORMAT "%13.11" ECU_ADDRESS 0x3FC15E /end MEASUREMENT
/begin MEASUREMENT B_ribehv2 "Beding. Innenwiderstand Ri verzˆgert berechnen f¸r Sonde hinter Hauptkat  Bank2" UBYTE B_TRUE 1 100 0 1 BIT_MASK 0x1 FORMAT "%13.11" ECU_ADDRESS 0x3FC15F /end MEASUREMENT
/begin MEASUREMENT B_riibh "Bedingung Sondenspannung im zul‰ssigen Band f¸r Strompumpen hinter KAT" UBYTE B_TRUE 1 100 0 1 BIT_MASK 0x1 FORMAT "%13.11" ECU_ADDRESS 0x3FC160 /end MEASUREMENT
/begin MEASUREMENT B_riibh2 "Bedingung Sondenspannung im zul‰ssigen Band f¸r Strompumpen hinter KAT Bank2" UBYTE B_TRUE 1 100 0 1 BIT_MASK 0x1 FORMAT "%13.11" ECU_ADDRESS 0x3FC161 /end MEASUREMENT
/begin MEASUREMENT B_riimph "Bedingung Impuls f¸r Strom-Pumpen hinter KAT" UBYTE B_TRUE 1 100 0 1 BIT_MASK 0x1 FORMAT "%13.11" ECU_ADDRESS 0x3FC162 /end MEASUREMENT
/begin MEASUREMENT B_rimh "Bedingung (ADC-Trigger) f¸r Messen belastete Sondenspannung hinter KAT" UBYTE B_TRUE 1 100 0 1 BIT_MASK 0x1 FORMAT "%13.11" ECU_ADDRESS 0x3FC163 /end MEASUREMENT
/begin MEASUREMENT B_rimh2 "Bedingung (ADC-Trigger) f¸r Messen belastete Sondenspannung hinter KAT Bank2" UBYTE B_TRUE 1 100 0 1 BIT_MASK 0x1 FORMAT "%13.11" ECU_ADDRESS 0x3FC164 /end MEASUREMENT
/begin MEASUREMENT B_rinh "Bedingung Innenwiderstand Ri-Messung der Nernstsonde aktiv hinter Kat" UBYTE B_TRUE 1 100 0 1 BIT_MASK 0x1 FORMAT "%13.11" ECU_ADDRESS 0x3FC165 /end MEASUREMENT
/begin MEASUREMENT B_rinh2 "Bedingung Innenwiderstand Ri-Messung der Nernstsonde aktiv hinter KAT Bank2" UBYTE B_TRUE 1 100 0 1 BIT_MASK 0x1 FORMAT "%13.11" ECU_ADDRESS 0x3FC166 /end MEASUREMENT
/begin MEASUREMENT B_ripuh "Bedingung Strom-Pumpen f¸r Sonde hinter KAT" UBYTE B_TRUE 1 100 0 1 BIT_MASK 0x1 FORMAT "%13.11" ECU_ADDRESS 0x3FC167 /end MEASUREMENT
/begin MEASUREMENT B_ripuh2 "Bedingung Strom-Pumpen f¸r Sonde hinter KAT Bank2" UBYTE B_TRUE 1 100 0 1 BIT_MASK 0x1 FORMAT "%13.11" ECU_ADDRESS 0x3FC168 /end MEASUREMENT
/begin MEASUREMENT B_rireh "Bedingung Resultat f¸r Innenwiderstand Ri f¸r Sonde hinter KAT" UBYTE B_TRUE 1 100 0 1 BIT_MASK 0x1 FORMAT "%13.11" ECU_ADDRESS 0x3FC169 /end MEASUREMENT
/begin MEASUREMENT B_rireh2 "Bedingung Resultat f¸r Innenwiderstand Ri f¸r Sonde hinter KAT Bank2" UBYTE B_TRUE 1 100 0 1 BIT_MASK 0x1 FORMAT "%13.11" ECU_ADDRESS 0x3FC16A /end MEASUREMENT
/begin MEASUREMENT B_risph "Bedingung Sondensprung hinter KAT" UBYTE B_TRUE 1 100 0 1 BIT_MASK 0x1 FORMAT "%13.11" ECU_ADDRESS 0x3FC16B /end MEASUREMENT
/begin MEASUREMENT B_risph2 "Bedingung Sondensprung hinter KAT Bank2" UBYTE B_TRUE 1 100 0 1 BIT_MASK 0x1 FORMAT "%13.11" ECU_ADDRESS 0x3FC16C /end MEASUREMENT
/begin MEASUREMENT B_savfgr "Bedingung: Schubabschalteverbot durch FGR" UBYTE B_TRUE 1 100 0 1 BIT_MASK 0x1 FORMAT "%13.11" ECU_ADDRESS 0x3FC068 /end MEASUREMENT
/begin MEASUREMENT B_savm "Bedingung: Schubabschalteverbot durch FGR (aus ME)" UBYTE B_TRUE 1 100 0 1 BIT_MASK 0x1 FORMAT "%13.11" ECU_ADDRESS 0x3FC062 /end MEASUREMENT
/begin MEASUREMENT B_sbblsu "Bedingung LSU betriebsbereit vor Kat f(lamsons_w)" UBYTE B_TRUE 1 100 0 1 BIT_MASK 0x1 FORMAT "%13.11" ECU_ADDRESS 0x403BA0 /end MEASUREMENT
/begin MEASUREMENT B_sbblsu2 "Bedingung LSU betriebsbereit vor Kat, Bank 2 f(lamsons2_w)" UBYTE B_TRUE 1 100 0 1 BIT_MASK 0x4 FORMAT "%13.11" ECU_ADDRESS 0x403BA0 /end MEASUREMENT
/begin MEASUREMENT B_shuerf "Bedingung Sondenspannung hinter KAT erfassen" UBYTE B_TRUE 1 100 0 1 BIT_MASK 0x1 FORMAT "%13.11" ECU_ADDRESS 0x3FC16D /end MEASUREMENT
/begin MEASUREMENT B_shuerf2 "Bedingung Sondenspannung hinter KAT erfassen Bank2" UBYTE B_TRUE 1 100 0 1 BIT_MASK 0x1 FORMAT "%13.11" ECU_ADDRESS 0x3FC16E /end MEASUREMENT
/begin MEASUREMENT B_simflv "Bedingung MFL-Signal Timeout" UBYTE B_TRUE 1 100 0 1 BIT_MASK 0x1 FORMAT "%13.11" ECU_ADDRESS 0x4037E6 /end MEASUREMENT
/begin MEASUREMENT B_staebr "Bedingung Steckerabfall-Erkennung Bremse" UBYTE B_TRUE 1 100 0 1 BIT_MASK 0x1 FORMAT "%13.11" ECU_ADDRESS 0x3FC0F5 /end MEASUREMENT
/begin MEASUREMENT B_stmerker "Merker f¸r erfolgten Start" UBYTE dez 1 100 0 255 FORMAT "%5.1" ECU_ADDRESS 0x402D0B /end MEASUREMENT
/begin MEASUREMENT B_swknb "Bedingung Setzwertkorrektur nach Beschleunigen" UWORD B_TRUE 1 100 0 1 BIT_MASK 0x80 FORMAT "%13.11" ECU_ADDRESS 0x403F0A /end MEASUREMENT
/begin MEASUREMENT B_swknv "Bedingung Setzwertkorrektur nach Verzˆgern" UWORD B_TRUE 1 100 0 1 BIT_MASK 0x100 FORMAT "%13.11" ECU_ADDRESS 0x403F0A /end MEASUREMENT
/begin MEASUREMENT B_taerr "Bedingung Ansaugluftfehler" UBYTE B_TRUE 1 100 0 1 FORMAT "%13.11" ECU_ADDRESS 0x40320F /end MEASUREMENT
/begin MEASUREMENT B_tal "Bedingung Tank leer bzw. Reserve" UBYTE B_TRUE 1 100 0 1 BIT_MASK 0x40 FORMAT "%13.11" ECU_ADDRESS 0x403BDE /end MEASUREMENT
/begin MEASUREMENT B_talval "Bedingung : Bit Tank leer g¸ltig" UBYTE B_TRUE 1 100 0 1 BIT_MASK 0x80 FORMAT "%13.11" ECU_ADDRESS 0x403BDE /end MEASUREMENT
/begin MEASUREMENT B_tav "Bedingung Tank voll" UBYTE B_TRUE 1 100 0 1 BIT_MASK 0x10 FORMAT "%13.11" ECU_ADDRESS 0x403BDE /end MEASUREMENT
/begin MEASUREMENT B_tb2p "Bedingung Taste Beschleunigen ¸berdr¸ckt positive Flanke" UBYTE B_TRUE 1 100 0 1 BIT_MASK 0x1 FORMAT "%13.11" ECU_ADDRESS 0x3FC063 /end MEASUREMENT
/begin MEASUREMENT B_tbeh "Bedingung FGR-Funktionstaste ""Beschleunigen"" wird gehalten" UBYTE B_TRUE 1 100 0 1 BIT_MASK 0x1 FORMAT "%13.11" ECU_ADDRESS 0x3FC173 /end MEASUREMENT
/begin MEASUREMENT B_tbenh "Bedingung Taste Beschleunigen negative Flanke nach Halten" UWORD B_TRUE 1 100 0 1 BIT_MASK 0x200 FORMAT "%13.11" ECU_ADDRESS 0x403F0A /end MEASUREMENT
/begin MEASUREMENT B_tbent "Bedingung Taste Beschleunigen negative Flanke nach Tip" UWORD B_TRUE 1 100 0 1 BIT_MASK 0x400 FORMAT "%13.11" ECU_ADDRESS 0x403F0A /end MEASUREMENT
/begin MEASUREMENT B_tbep "Bedingung Taste Beschleunigen positive Flanke" UWORD B_TRUE 1 100 0 1 BIT_MASK 0x800 FORMAT "%13.11" ECU_ADDRESS 0x403F0A /end MEASUREMENT
/begin MEASUREMENT B_tbeph "Bedingung Taste Beschleunigen positive Flanke Halten" UWORD B_TRUE 1 100 0 1 BIT_MASK 0x1000 FORMAT "%13.11" ECU_ADDRESS 0x403F0A /end MEASUREMENT
/begin MEASUREMENT B_tctoggle "Toggelbit der MFL-Botschaft" UBYTE B_TRUE 1 100 0 1 BIT_MASK 0x1 FORMAT "%13.11" ECU_ADDRESS 0x4037E7 /end MEASUREMENT
/begin MEASUREMENT B_tdfuereg "Regler f¸r Druck teilgedrosselt l‰uft" UBYTE dez 1 100 0 255 FORMAT "%5.1" ECU_ADDRESS 0x402D0C /end MEASUREMENT
/begin MEASUREMENT B_tfwdksom "Zeitkonstante f¸r Filterung Drosselklappenwinkel ohne Momentenstruktur aktiv" UBYTE dez 1 100 0 255 FORMAT "%5.1" ECU_ADDRESS 0x402D11 /end MEASUREMENT
/begin MEASUREMENT B_tgethko "Bedingung hohe Getriebe-Oeltemperatur (Klimakompressor aus)" UBYTE B_TRUE 1 100 0 1 BIT_MASK 0x10 FORMAT "%13.11" ECU_ADDRESS 0x402E14 /end MEASUREMENT
/begin MEASUREMENT B_toelh1 "Bedingung Motorˆltemperatur hˆher als erste zul‰ssige Schwelle (KO aus)" UBYTE B_TRUE 1 100 0 1 BIT_MASK 0x1 FORMAT "%13.11" ECU_ADDRESS 0x3FC0F6 /end MEASUREMENT
/begin MEASUREMENT B_toelh1cc "Hohe Motorˆltemperatur f¸r Kombi-Ausgabe" UBYTE B_TRUE 1 100 0 1 BIT_MASK 0x1 FORMAT "%13.11" ECU_ADDRESS 0x3FC0F7 /end MEASUREMENT
/begin MEASUREMENT B_toelh2 "Bedingung Motorˆltemperatur hˆher als zweite zul‰ssige Schwelle (MD-Red. ein)" UBYTE B_TRUE 1 100 0 1 BIT_MASK 0x1 FORMAT "%13.11" ECU_ADDRESS 0x3FC0F8 /end MEASUREMENT
/begin MEASUREMENT B_toelhgh "Bedingung Motorˆltemperatur hoch, Gang wechseln (hochschalten)" UBYTE B_TRUE 1 100 0 1 BIT_MASK 0x1 FORMAT "%13.11" ECU_ADDRESS 0x3FC0F9 /end MEASUREMENT
/begin MEASUREMENT B_toelhgh1 "Bedingung hohe Oeltemperatur Gang hochschalten" UBYTE B_TRUE 1 100 0 1 BIT_MASK 0x20 FORMAT "%13.11" ECU_ADDRESS 0x402E14 /end MEASUREMENT
/begin MEASUREMENT B_toelhgh2 "Bedingung unzul‰ssiger Betriebsbereich, Gang hochschalten" UBYTE B_TRUE 1 100 0 1 BIT_MASK 0x40 FORMAT "%13.11" ECU_ADDRESS 0x402E14 /end MEASUREMENT
/begin MEASUREMENT B_toelhko "Bedingung hohe Oeltemperatur (KO aus)" UBYTE B_TRUE 1 100 0 1 BIT_MASK 0x1 FORMAT "%13.11" ECU_ADDRESS 0x402E14 /end MEASUREMENT
/begin MEASUREMENT B_toelhko2 "Bedingung unzul‰ssiger Betriebsbereich (KO aus)" UBYTE B_TRUE 1 100 0 1 BIT_MASK 0x2 FORMAT "%13.11" ECU_ADDRESS 0x402E14 /end MEASUREMENT
/begin MEASUREMENT B_toelhmd "Bedingung hohe Oeltemperatur (Leistungsreduzierung)" UBYTE B_TRUE 1 100 0 1 BIT_MASK 0x4 FORMAT "%13.11" ECU_ADDRESS 0x402E14 /end MEASUREMENT
/begin MEASUREMENT B_toelhmd2 "Bedingung unzul‰ssiger Betriebsbereich (Leistungsreduzierung)" UBYTE B_TRUE 1 100 0 1 BIT_MASK 0x8 FORMAT "%13.11" ECU_ADDRESS 0x402E14 /end MEASUREMENT
/begin MEASUREMENT B_tpderl "Bedingung Tip-Down erlaubt" UWORD B_TRUE 1 100 0 1 BIT_MASK 0x2000 FORMAT "%13.11" ECU_ADDRESS 0x403F0A /end MEASUREMENT
/begin MEASUREMENT B_tpdn "Bedingung FGR im Zustand Tip-Down" UWORD B_TRUE 1 100 0 1 BIT_MASK 0x4000 FORMAT "%13.11" ECU_ADDRESS 0x403F0A /end MEASUREMENT
/begin MEASUREMENT B_tpnt_aw "KR: Auswahl Nulltest oder Testimpuls" UBYTE B_TRUE 1 100 0 1 BIT_MASK 0x1 FORMAT "%13.11" ECU_ADDRESS 0x3FC150 /end MEASUREMENT
/begin MEASUREMENT B_tpnt_e "KR: Nulltest/Testimpuls freigegeben" UBYTE B_TRUE 1 100 0 1 BIT_MASK 0x1 FORMAT "%13.11" ECU_ADDRESS 0x3FC151 /end MEASUREMENT
/begin MEASUREMENT B_tpuerl "Bedingung Tip-Up erlaubt" UWORD B_TRUE 1 100 0 1 BIT_MASK 0x8000 FORMAT "%13.11" ECU_ADDRESS 0x403F0A /end MEASUREMENT
/begin MEASUREMENT B_tpup "Bedingung FGR im Zustand Tip-Up" UWORD B_TRUE 1 100 0 1 BIT_MASK 0x1 FORMAT "%13.11" ECU_ADDRESS 0x403F0C /end MEASUREMENT
/begin MEASUREMENT B_tsenh "Bedingung Taste Setzen negative Flanke nach Halten" UWORD B_TRUE 1 100 0 1 BIT_MASK 0x2 FORMAT "%13.11" ECU_ADDRESS 0x403F0C /end MEASUREMENT
/begin MEASUREMENT B_tsent "Bedingung Taste setzen negative Flanke nach Tip" UWORD B_TRUE 1 100 0 1 BIT_MASK 0x4 FORMAT "%13.11" ECU_ADDRESS 0x403F0C /end MEASUREMENT
/begin MEASUREMENT B_tumers "Bedingung Ansaugluftersatzwert" UBYTE B_TRUE 1 100 0 1 FORMAT "%13.11" ECU_ADDRESS 0x403210 /end MEASUREMENT
/begin MEASUREMENT B_tv2p "Bedingung Taste Verzˆgern ¸berdr¸ckt positive Flanke" UBYTE B_TRUE 1 100 0 1 BIT_MASK 0x1 FORMAT "%13.11" ECU_ADDRESS 0x3FC064 /end MEASUREMENT
/begin MEASUREMENT B_tveh "Bedingung FGR-Funktionstaste ""Verzˆgern"" wird gehalten" UBYTE B_TRUE 1 100 0 1 BIT_MASK 0x1 FORMAT "%13.11" ECU_ADDRESS 0x3FC174 /end MEASUREMENT
/begin MEASUREMENT B_tvenh "Bedingung Taste Verzˆgern negative Flanke nach Halten" UWORD B_TRUE 1 100 0 1 BIT_MASK 0x8 FORMAT "%13.11" ECU_ADDRESS 0x403F0C /end MEASUREMENT
/begin MEASUREMENT B_tvent "Bedingung Taste Verzˆgern negative Flanke nach Tip" UWORD B_TRUE 1 100 0 1 BIT_MASK 0x10 FORMAT "%13.11" ECU_ADDRESS 0x403F0C /end MEASUREMENT
/begin MEASUREMENT B_tvep "Bedingung Taste Verzˆgern positive Flanke" UWORD B_TRUE 1 100 0 1 BIT_MASK 0x20 FORMAT "%13.11" ECU_ADDRESS 0x403F0C /end MEASUREMENT
/begin MEASUREMENT B_tveph "Bedingung Taste Verzˆgern positive Flanke Halten" UWORD B_TRUE 1 100 0 1 BIT_MASK 0x40 FORMAT "%13.11" ECU_ADDRESS 0x403F0C /end MEASUREMENT
/begin MEASUREMENT B_twap "Bedingung Taste Wiederaufnahme positive Fanke" UWORD B_TRUE 1 100 0 1 BIT_MASK 0x80 FORMAT "%13.11" ECU_ADDRESS 0x403F0C /end MEASUREMENT
/begin MEASUREMENT B_ubvdkp "Bedingung Batteriespannung ausreichend f¸r Verst‰rkung von DK-Poti 1" UBYTE B_TRUE 1 100 0 1 BIT_MASK 0x1 FORMAT "%13.11" ECU_ADDRESS 0x3FBFC0 /end MEASUREMENT
/begin MEASUREMENT B_udk1nv "Bedingung Spannung DK-Poti 1 oberhalb des Verst‰rkungsbereichs" UBYTE B_TRUE 1 100 0 1 BIT_MASK 0x1 FORMAT "%13.11" ECU_ADDRESS 0x3FBFC1 /end MEASUREMENT
/begin MEASUREMENT B_uebetu "Bedingung ‹bergang Beschleunigen nach Tip-Up erfolgt" UWORD B_TRUE 1 100 0 1 BIT_MASK 0x100 FORMAT "%13.11" ECU_ADDRESS 0x403F0C /end MEASUREMENT
/begin MEASUREMENT B_uebrkf "Bedingung ‹bergang von begrenzter Rampe nach Konstantfahrt erfolgt" UWORD B_TRUE 1 100 0 1 BIT_MASK 0x200 FORMAT "%13.11" ECU_ADDRESS 0x403F0C /end MEASUREMENT
/begin MEASUREMENT B_uebvau "Bedingung ‹bergang von Beschleunigen oder Verzˆgern nach Aus erfolgt" UWORD B_TRUE 1 100 0 1 BIT_MASK 0x400 FORMAT "%13.11" ECU_ADDRESS 0x403F0C /end MEASUREMENT
/begin MEASUREMENT B_uevztd "Bedingung ‹bergang von Verzˆgern nach Tip-Down erfolgt" UWORD B_TRUE 1 100 0 1 BIT_MASK 0x800 FORMAT "%13.11" ECU_ADDRESS 0x403F0C /end MEASUREMENT
/begin MEASUREMENT B_usbeh "Bedingung f¸r Zeitz‰hler zur Ausblendung der Sondenbelastung hinter KAT" UBYTE B_TRUE 1 100 0 1 BIT_MASK 0x1 FORMAT "%13.11" ECU_ADDRESS 0x3FC16F /end MEASUREMENT
/begin MEASUREMENT B_usbeh2 "Bedingung f¸r Zeitz‰hler zur Ausblendung der Sondenbelastung hinter KAT Bank2" UBYTE B_TRUE 1 100 0 1 BIT_MASK 0x1 FORMAT "%13.11" ECU_ADDRESS 0x3FC170 /end MEASUREMENT
/begin MEASUREMENT B_vvtclose "Bedingung Hub herunterfahren" UBYTE dez 1 100 0 255 FORMAT "%5.1" ECU_ADDRESS 0x40379D /end MEASUREMENT
/begin MEASUREMENT B_vvtslow "Begrenzung Lagereglerdynamik aus VVT-Sollwertvorgabe" UBYTE B_TRUE 1 100 0 1 FORMAT "%13.11" ECU_ADDRESS 0x40379E /end MEASUREMENT
/begin MEASUREMENT B_wavo "Bedingung Wiederaufnahme von oben" UWORD B_TRUE 1 100 0 1 BIT_MASK 0x2 FORMAT "%13.11" ECU_ADDRESS 0x403F0A /end MEASUREMENT
/begin MEASUREMENT B_wdk12ev "Bedingung Vorl‰ufiger Gleichlauffehler der DK-Potis" UBYTE B_TRUE 1 100 0 1 BIT_MASK 0x1 FORMAT "%13.11" ECU_ADDRESS 0x3FBFC2 /end MEASUREMENT
/begin MEASUREMENT B_wdk13ev "Bedingung Vorl‰ufige Unplausibilit‰t zw. DK-Poti 1 und Ersatzwert aus F¸llung" UBYTE B_TRUE 1 100 0 1 BIT_MASK 0x1 FORMAT "%13.11" ECU_ADDRESS 0x3FBFC3 /end MEASUREMENT
/begin MEASUREMENT B_wdk1v "Bedingung Berechnung des DK-Winkels aus verst‰rktem Signal von Poti 1" UBYTE B_TRUE 1 100 0 1 BIT_MASK 0x1 FORMAT "%13.11" ECU_ADDRESS 0x3FBFC4 /end MEASUREMENT
/begin MEASUREMENT B_wdk23ev "Bedingung Vorl‰ufige Unplausibilit‰t zw. DK-Poti 2 und Ersatzwert aus F¸llung" UBYTE B_TRUE 1 100 0 1 BIT_MASK 0x1 FORMAT "%13.11" ECU_ADDRESS 0x3FBFC5 /end MEASUREMENT
/begin MEASUREMENT B_wdk2sel "Bedingung DK-Winkel-Berechnung f¸r Lageregler aus Poti 2" UBYTE B_TRUE 1 100 0 1 BIT_MASK 0x1 FORMAT "%13.11" ECU_ADDRESS 0x3FBFC6 /end MEASUREMENT
/begin MEASUREMENT B_wdk2st "Bedingung DK-Winkel-Berechnung f¸r Lageregler tempor‰r aus Poti 2" UBYTE B_TRUE 1 100 0 1 BIT_MASK 0x1 FORMAT "%13.11" ECU_ADDRESS 0x3FBFC7 /end MEASUREMENT
/begin MEASUREMENT B_wdksom "Drosselklappensollwinkel ohne Momentenstruktur aktiv" UBYTE dez 1 100 0 255 FORMAT "%5.1" ECU_ADDRESS 0x402D12 /end MEASUREMENT
/begin MEASUREMENT B_wiauf "Bedingung FGR im Zustand Wiederaufnahme" UWORD B_TRUE 1 100 0 1 BIT_MASK 0x1000 FORMAT "%13.11" ECU_ADDRESS 0x403F0C /end MEASUREMENT
/begin MEASUREMENT counter_mfa "" UWORD dez 1 100 0 65535 FORMAT "%8.2" ECU_ADDRESS 0x4046A0 /end MEASUREMENT
/begin MEASUREMENT counter_mfe "" UWORD dez 1 100 0 65535 FORMAT "%8.2" ECU_ADDRESS 0x4046A2 /end MEASUREMENT
/begin MEASUREMENT cpaw1 "Z‰hler f¸r Poti 1 bei DK-Poti-Auswahl" UBYTE dez 1 100 0 255 FORMAT "%5.1" ECU_ADDRESS 0x403B44 /end MEASUREMENT
/begin MEASUREMENT cpaw2 "Z‰hler f¸r Poti 2 bei DK-Poti-Auswahl" UBYTE dez 1 100 0 255 FORMAT "%5.1" ECU_ADDRESS 0x403B45 /end MEASUREMENT
/begin MEASUREMENT ctdkp1 "Fehlerzeitz‰hler f¸r Bereichspr¸fung DK-Poti 1" UBYTE t10msxs_ub_b2p55 1 100 0 2.55 FORMAT "%5.3" ECU_ADDRESS 0x403B46 /end MEASUREMENT
/begin MEASUREMENT ctdkp2 "Fehlerzeitz‰hler f¸r Bereichspr¸fung DK-Poti 2" UBYTE t10msxs_ub_b2p55 1 100 0 2.55 FORMAT "%5.3" ECU_ADDRESS 0x403B47 /end MEASUREMENT
/begin MEASUREMENT ctdkpaw "Zeitz‰hler f¸r DK-Poti-Auswahl" UBYTE t10msxs_ub_b2p55 1 100 0 2.55 FORMAT "%5.3" ECU_ADDRESS 0x403B48 /end MEASUREMENT
/begin MEASUREMENT ctrerbr "Fehlerz‰hler f¸r Bremsschalter-Plausibilisierung" UBYTE dez 1 100 0 255 FORMAT "%5.1" ECU_ADDRESS 0x402DED /end MEASUREMENT
/begin MEASUREMENT ctwdk12 "Fehlerzeitz‰hler f¸r Gleichlaufpr¸fung der DK-Potis" UBYTE t10msxs_ub_b2p55 1 100 0 2.55 FORMAT "%5.3" ECU_ADDRESS 0x403B49 /end MEASUREMENT
/begin MEASUREMENT ctwdk13 "Fehlerzeitz‰hler f¸r Plausibilit‰tspr¸fung DK-Poti 1 mit Ersatzwert aus F¸llung" UBYTE t10msxs_ub_b2p55 1 100 0 2.55 FORMAT "%5.3" ECU_ADDRESS 0x403B4A /end MEASUREMENT
/begin MEASUREMENT ctwdk23 "Fehlerzeitz‰hler f¸r Plausibilit‰tspr¸fung DK-Poti 2 mit Ersatzwert aus F¸llung" UBYTE t10msxs_ub_b2p55 1 100 0 2.55 FORMAT "%5.3" ECU_ADDRESS 0x403B4B /end MEASUREMENT
/begin MEASUREMENT ddps_w "Differenz delta Saugrohrdruck Vorsteuerung zu delta Saugrohrdruck gemessen" SWORD p_q0p039 1 100 -1280 1279.96 FORMAT "%8.3" ECU_ADDRESS 0x404544 /end MEASUREMENT
/begin MEASUREMENT devhubi2_w "Delta Istwert Hubverstellung Bank 2" SWORD hub_uw_q0p001 1 100 -12 12 FORMAT "%8.5" ECU_ADDRESS 0x4045B0 /end MEASUREMENT
/begin MEASUREMENT devhubi_w "Delta Istwert Hubverstellung" SWORD hub_uw_q0p001 1 100 -32.768 32.767 FORMAT "%8.5" ECU_ADDRESS 0x403FCE /end MEASUREMENT
/begin MEASUREMENT devhubs_w "Hubgradient evhubs" SWORD hub_uw_q0p001 1 100 -12 12 FORMAT "%8.5" ECU_ADDRESS 0x4045B2 /end MEASUREMENT
/begin MEASUREMENT dexwinks "" UBYTE wink_ub_q1p0 1 100 0 230 FORMAT "%5.1" ECU_ADDRESS 0x4038E1 /end MEASUREMENT
/begin MEASUREMENT dhubra_w "Hubrampe f¸r ‹bergang auf Vollhub" UWORD hub_uw_q0p001 1 100 0 12 FORMAT "%8.5" ECU_ADDRESS 0x4045B4 /end MEASUREMENT
/begin MEASUREMENT dmrar_w "Delta Relatives Moment bei Abschaltrampe FGR" UWORD rel_uw_b200 1 100 0 199.997 FORMAT "%8.4" ECU_ADDRESS 0x403EFE /end MEASUREMENT
/begin MEASUREMENT dpipol "Kennlinieninterpolation aus dp" UWORD fak_uw_b2 1 100 0 1.99997 FORMAT "%8.6" ECU_ADDRESS 0x404590 /end MEASUREMENT
/begin MEASUREMENT dpipoluw_w "" UWORD fak_uw_b2 1 100 0 1.99997 FORMAT "%8.6" ECU_ADDRESS 0x40458A /end MEASUREMENT
/begin MEASUREMENT dpsad_w "delta-Saugrohrdruck f¸r Adaption" SWORD p_sw_q0p039 1 100 -1280 1279.96 FORMAT "%8.3" ECU_ADDRESS 0x40468A /end MEASUREMENT
/begin MEASUREMENT dpsddss_w "delta Saugrohrdruck gemessen mit Differenzdrucksensor Saugrohr" SWORD p_sw_q0p039 1 100 -1280 1279.96 FORMAT "%8.3" ECU_ADDRESS 0x40468C /end MEASUREMENT
/begin MEASUREMENT dpsdif "Differenz dpsd_w Solldifferenzdruck Saugrohr" SWORD p_sw_q0p039 1 100 -1280 1279.96 FORMAT "%8.3" ECU_ADDRESS 0x40468E /end MEASUREMENT
/begin MEASUREMENT dpsdmx1_w "Maximalwert Differenzdruck fuer Diagnose aus dpssol" SWORD p_sw_q0p039 1 100 -1280 1279.96 FORMAT "%8.3" ECU_ADDRESS 0x404690 /end MEASUREMENT
/begin MEASUREMENT dpsdmx2_w "Maximalwert Differenzdruck fuer Diagnose aus wdkba" SWORD p_sw_q0p039 1 100 -1280 1279.96 FORMAT "%8.3" ECU_ADDRESS 0x404692 /end MEASUREMENT
/begin MEASUREMENT dpsd_w "Differenzdruck Saugrohr nach Filter f¸r Sensordiagnose" SWORD p_sw_q0p039 1 100 -1280 1279.96 FORMAT "%8.3" ECU_ADDRESS 0x404694 /end MEASUREMENT
/begin MEASUREMENT dpsfak "normierter Faktor delta Saugrohrdruck" UBYTE fak_ub_q0p00392 1 100 0 1 FORMAT "%5.3" ECU_ADDRESS 0x4038D4 /end MEASUREMENT
/begin MEASUREMENT dpsfakro "normierter Faktor delta Saugrohrdruck vor Kennlinie" UBYTE fak_ub_q0p00392 1 100 0 1 FORMAT "%5.3" ECU_ADDRESS 0x4038D5 /end MEASUREMENT
/begin MEASUREMENT dpsgedr_w "Differenzdruck Saugrohr gedrosselter Motor aus Modell" SWORD p_q0p039 1 100 -1280 1279.96 FORMAT "%8.3" ECU_ADDRESS 0x404546 /end MEASUREMENT
/begin MEASUREMENT dpsmanuw_w "Druckverhaeltnis Drosselklappe Sammler fuer Uberwachungsebene" UWORD fak_uw_b2 1 100 0 1.99997 FORMAT "%8.6" ECU_ADDRESS 0x40458C /end MEASUREMENT
/begin MEASUREMENT dpssolad_w "Differenzdruck Saugrohr in FUEDK" UWORD p_q0p039s32768 1 100 -1280 1279.96 FORMAT "%7.2" ECU_ADDRESS 0x404592 /end MEASUREMENT
/begin MEASUREMENT dpssolf_w "" SWORD p_sw_q0p039 1 100 -1280 1279.96 FORMAT "%8.3" ECU_ADDRESS 0x404696 /end MEASUREMENT
/begin MEASUREMENT dpssolgd_w "Differenzdruck gedrosselter Motor aus Modell" UWORD p_uw_q0p039 1 100 0 2559.96 FORMAT "%8.3" ECU_ADDRESS 0x404548 /end MEASUREMENT
/begin MEASUREMENT dpssoltdr_w "" UWORD p_q0p039s32768 1 100 -1280 1279.96 FORMAT "%7.2" ECU_ADDRESS 0x40454A /end MEASUREMENT
/begin MEASUREMENT dpssoltd_w "" UWORD p_q0p039s32768 1 100 -1280 1279.96 FORMAT "%7.2" ECU_ADDRESS 0x40454C /end MEASUREMENT
/begin MEASUREMENT dpssolud_w "Solldifferenzdruck Saugrohr ungedrosselt" SWORD p_q0p039 1 100 -1280 1279.96 FORMAT "%8.3" ECU_ADDRESS 0x40454E /end MEASUREMENT
/begin MEASUREMENT dpssol_ub "" UBYTE p_q10p0 1 100 0 2550 FORMAT "%5.0" ECU_ADDRESS 0x3FC3AC /end MEASUREMENT
/begin MEASUREMENT dpssol_uw "Solldifferenzdruck Saugrohr" UWORD p_q0p039 1 100 0 2559.96 FORMAT "%8.3" ECU_ADDRESS 0x404550 /end MEASUREMENT
/begin MEASUREMENT dpssol_w "Solldifferenzdruck Saugrohr" SWORD p_q0p039 1 100 -1280 1279.96 FORMAT "%8.3" ECU_ADDRESS 0x404552 /end MEASUREMENT
/begin MEASUREMENT dpssyn_w "********************************************************************************" SWORD p_sw_q0p039 1 100 -1280 1279.96 FORMAT "%8.3" ECU_ADDRESS 0x404698 /end MEASUREMENT
/begin MEASUREMENT dpsuddr_w "Differenzdruck Saugrohr f¸r ‹bergang ungedrosselt in gedrosselt" SWORD p_q0p039 1 100 -1280 1279.96 FORMAT "%8.3" ECU_ADDRESS 0x404554 /end MEASUREMENT
/begin MEASUREMENT dpsvvtte_w "" UWORD p_q0p039s32768 1 100 -1280 1279.96 FORMAT "%7.2" ECU_ADDRESS 0x404556 /end MEASUREMENT
/begin MEASUREMENT dpsvvt_w "" UWORD p_q0p039s32768 1 100 -1280 1279.96 FORMAT "%7.2" ECU_ADDRESS 0x404558 /end MEASUREMENT
/begin MEASUREMENT dps_w "delta-Saugrohrdruck" SWORD p_sw_q0p039 1 100 -1280 1279.96 FORMAT "%8.3" ECU_ADDRESS 0x40469A /end MEASUREMENT
/begin MEASUREMENT dpvdkspu_w "delta zwischen Druck vor Drosselklappe und Umgebungsdruck" UWORD p_uw_q0p039 1 100 0 2559.96 FORMAT "%8.3" ECU_ADDRESS 0x402EAC /end MEASUREMENT
/begin MEASUREMENT dvrabe_w "Delta Geschwindigkeit bei Beschleunigungsrampe" UWORD vfzg_uw_b512 1 100 0 511.992 FORMAT "%8.4" ECU_ADDRESS 0x403F04 /end MEASUREMENT
/begin MEASUREMENT dvrave_w "Delta Geschwindigkeit bei Verzˆgerungsrampe" UWORD vfzg_uw_b512 1 100 0 511.992 FORMAT "%8.4" ECU_ADDRESS 0x403F06 /end MEASUREMENT
/begin MEASUREMENT dvzvi_w "Differenz zwischen Ziel- und Istgeschwindigkeit" SWORD vfzg_sw_q0p00781 1 100 -256 255.992 FORMAT "%8.4" ECU_ADDRESS 0x403F08 /end MEASUREMENT
/begin MEASUREMENT dwdkba_w "Gradient DK-Winkel" SWORD relDK_q0p02441 1 100 -800 799.976 FORMAT "%8.4" ECU_ADDRESS 0x403E06 /end MEASUREMENT
/begin MEASUREMENT dwdks_w "ƒnderung des Drosselklappen-Sollwinkels" SWORD rel_sw_b50 1 100 -50 49.9985 FORMAT "%8.5" ECU_ADDRESS 0x404594 /end MEASUREMENT
/begin MEASUREMENT eprl1 "Entprellter Generatorfehler vorhanden" UBYTE B_TRUE 1 100 0 1 FORMAT "%13.11" ECU_ADDRESS 0x403211 /end MEASUREMENT
/begin MEASUREMENT eprl12 "" UBYTE B_TRUE 1 100 0 1 FORMAT "%13.11" ECU_ADDRESS 0x403219 /end MEASUREMENT
/begin MEASUREMENT eprl2 "Entprellter Kommunikationsfehler vorhanden" UBYTE B_TRUE 1 100 0 1 FORMAT "%13.11" ECU_ADDRESS 0x403212 /end MEASUREMENT
/begin MEASUREMENT eprl22 "" UBYTE B_TRUE 1 100 0 1 FORMAT "%13.11" ECU_ADDRESS 0x40321A /end MEASUREMENT
/begin MEASUREMENT evhubfrz_w "‹bergang ungedrosselt auf gedrosselt im Start Hubspeicher" UWORD hub_uw_q0p001 1 100 0 12 FORMAT "%8.5" ECU_ADDRESS 0x4045B6 /end MEASUREMENT
/begin MEASUREMENT evhubi2_10 "" UWORD hub_uw_q0p001 1 100 0 12 FORMAT "%8.5" ECU_ADDRESS 0x4045B8 /end MEASUREMENT
/begin MEASUREMENT evhubi2_20 "" UWORD hub_uw_q0p001 1 100 0 12 FORMAT "%8.5" ECU_ADDRESS 0x4045BA /end MEASUREMENT
/begin MEASUREMENT evhubi2_w "Istwert Hubverstellung Bank 2" UWORD hub_uw_q0p001 1 100 0 12 FORMAT "%8.5" ECU_ADDRESS 0x4045BC /end MEASUREMENT
/begin MEASUREMENT evhubi_10 "" UWORD hub_uw_q0p001 1 100 0 12 FORMAT "%8.5" ECU_ADDRESS 0x4045BE /end MEASUREMENT
/begin MEASUREMENT evhubi_20 "" UWORD hub_uw_q0p001 1 100 0 12 FORMAT "%8.5" ECU_ADDRESS 0x4045C0 /end MEASUREMENT
/begin MEASUREMENT evhubi_w "Istwert Hubverstellung" UWORD hub_uw_q0p001 1 100 0 12 FORMAT "%8.5" ECU_ADDRESS 0x4045C2 /end MEASUREMENT
/begin MEASUREMENT evhubmd_w "Einlassventilhub bei Momenteneinstellung ¸ber Hub" UWORD hub_uw_q0p001 1 100 0 12 FORMAT "%8.5" ECU_ADDRESS 0x4045C4 /end MEASUREMENT
/begin MEASUREMENT evhubsnf_w "Sollwert Hubverstellung ungefiltert" UWORD hub_uw_q0p001 1 100 0 12 FORMAT "%8.5" ECU_ADDRESS 0x4045C6 /end MEASUREMENT
/begin MEASUREMENT evhubs_10 "Sollwert Hubverstellung evhubs_w um 10 ms verzˆgert" UWORD hub_uw_q0p001 1 100 0 12 FORMAT "%8.5" ECU_ADDRESS 0x4045C8 /end MEASUREMENT
/begin MEASUREMENT evhubs_20 "Sollwert Hubverstellung evhubs_w um 20 ms verzˆgert" UWORD hub_uw_q0p001 1 100 0 12 FORMAT "%8.5" ECU_ADDRESS 0x4045CA /end MEASUREMENT
/begin MEASUREMENT evhubs_kf "Sollwert Einlassventilhub aus Hubkennfeldern" UWORD hub_uw_q0p001 1 100 0 12 FORMAT "%8.5" ECU_ADDRESS 0x4045CC /end MEASUREMENT
/begin MEASUREMENT evhubs_tmp "Source: Sollwert Hubverstellung aus KFEHUBT/KFEHUB" UWORD hub_uw_q0p001 1 100 0 12 FORMAT "%8.5" ECU_ADDRESS 0x4045CE /end MEASUREMENT
/begin MEASUREMENT evhubs_w "Sollwert Hubverstellung" UWORD hub_uw_q0p001 1 100 0 12 FORMAT "%8.5" ECU_ADDRESS 0x4045D0 /end MEASUREMENT
/begin MEASUREMENT evhubvh_w "Einlassventilhub bei B_gdvhub" UWORD hub_uw_q0p001 1 100 0 12 FORMAT "%8.5" ECU_ADDRESS 0x4045D2 /end MEASUREMENT
/begin MEASUREMENT exwinks "Sollwert Exzenterwinkel VVT" UBYTE wink_ub_q1p0 1 100 0 230 FORMAT "%5.1" ECU_ADDRESS 0x4038E2 /end MEASUREMENT
/begin MEASUREMENT exwinksp_w "Exzenterwellenwinkel Soll pr‰diziert" UWORD wink_uw_q0p1 1 100 0 230 FORMAT "%8.4" ECU_ADDRESS 0x4045D4 /end MEASUREMENT
/begin MEASUREMENT exwinks_w "Sollwert Exzenterwinkel VVT" UWORD wink_uw_q0p1 1 100 0 230 FORMAT "%8.4" ECU_ADDRESS 0x4045D6 /end MEASUREMENT
/begin MEASUREMENT fdpsdkm_w "Ausgang von KLDPSDKM" UWORD fak_uw_b2 1 100 0 1.99997 FORMAT "%8.6" ECU_ADDRESS 0x404596 /end MEASUREMENT
/begin MEASUREMENT ffzanz "Anzahl Folgefunken" UBYTE dez 1 100 0 255 FORMAT "%5.1" ECU_ADDRESS 0x403D25 /end MEASUREMENT
/begin MEASUREMENT ffztld_w "Ladezeit Folgefunken" UWORD txms_uw_q0p001 1 100 0 65.535 FORMAT "%8.5" ECU_ADDRESS 0x404356 /end MEASUREMENT
/begin MEASUREMENT ffztof_w "Offenzeit Folgefunken" UWORD txms_uw_q0p001 1 100 0 65.535 FORMAT "%8.5" ECU_ADDRESS 0x404358 /end MEASUREMENT
/begin MEASUREMENT FGRMDlokBits1 "" UWORD dez 1 100 0 65535 FORMAT "%8.2" ECU_ADDRESS 0x403F0A /end MEASUREMENT
/begin MEASUREMENT FGRMDlokBits2 "" UWORD dez 1 100 0 65535 FORMAT "%8.2" ECU_ADDRESS 0x403F0C /end MEASUREMENT
/begin MEASUREMENT fho "Korrekturfaktor Hˆhe" UBYTE fak_ub_b4 1 100 0 3.98438 FORMAT "%5.3" ECU_ADDRESS 0x402EA8 /end MEASUREMENT
/begin MEASUREMENT fho_w "Korrekturfaktor Hˆhe (word)" UWORD fak_uw_b4 1 100 0 3.99994 FORMAT "%8.6" ECU_ADDRESS 0x402EAE /end MEASUREMENT
/begin MEASUREMENT fhubvnsf_w "fhubvnss_w vor Tiefpaﬂfilter" UWORD fak_uw_b2 1 100 0 1.99997 FORMAT "%8.6" ECU_ADDRESS 0x4045D8 /end MEASUREMENT
/begin MEASUREMENT fhubvnsi_w "fhubvnss_w oder ¸ber NOHUBMO auf 1 geklemmt" UWORD fak_uw_b2 1 100 0 1.99997 FORMAT "%8.6" ECU_ADDRESS 0x4045DA /end MEASUREMENT
/begin MEASUREMENT fhubvnss_w "" UWORD fak_uw_b2 1 100 0 1.99997 FORMAT "%8.6" ECU_ADDRESS 0x4045DC /end MEASUREMENT
/begin MEASUREMENT fhubwll_au "" UBYTE fakspr_q0p0039 1 100 0 0.996094 ECU_ADDRESS 0x4038E3 /end MEASUREMENT
/begin MEASUREMENT fkhfm "HFM-Korrekturfaktor" UBYTE fak_ub_b2 1 100 0 1.99219 FORMAT "%5.3" ECU_ADDRESS 0x403BE1 /end MEASUREMENT
/begin MEASUREMENT fmfkrakt "Mittenfrequenz f¸r Bandpaﬂfilter Klopfregelung" UBYTE dez 1 100 0 255 FORMAT "%5.1" ECU_ADDRESS 0x403C03 /end MEASUREMENT
/begin MEASUREMENT fmfkraktne "Mittenfrequenz f¸r Bandpaﬂfilter Klopfregelung, neuer Wert" UBYTE dez 1 100 0 255 FORMAT "%5.1" ARRAY_SIZE 8 ECU_ADDRESS 0x402F48 /end MEASUREMENT
/begin MEASUREMENT fpups_w "Faktor Umgebung zu Saugrohrdruck" UWORD fak_uw_b8 1 100 0 7.99988 FORMAT "%8.6" ECU_ADDRESS 0x40455A /end MEASUREMENT
/begin MEASUREMENT fpvdkds "Faktor Druck vor Drosselklappe von Drucksensor" UBYTE fak_ub_b4 1 100 0 3.98438 FORMAT "%5.3" ECU_ADDRESS 0x403BF1 /end MEASUREMENT
/begin MEASUREMENT fpvdkdsl_w "Faktor Druck vor Drosselklappe von Ladedrucksensor (word)" UWORD fak_uw_b4 1 100 0 3.99994 FORMAT "%8.6" ECU_ADDRESS 0x40409C /end MEASUREMENT
/begin MEASUREMENT fpvdkdsu_w "Faktor Druck vor Drosselklappe von Umgebungsdrucksensor (word)" UWORD fak_uw_b4 1 100 0 3.99994 FORMAT "%8.6" ECU_ADDRESS 0x402EB0 /end MEASUREMENT
/begin MEASUREMENT fpvdkds_w "Faktor Druck vor Drosselklappe von Drucksensor (word)" UWORD fak_uw_b4 1 100 0 3.99994 FORMAT "%8.6" ECU_ADDRESS 0x40409E /end MEASUREMENT
/begin MEASUREMENT frhol_w "Faktor Luftdichte f(Ansauglufttemp., Hˆhe) 16-Bit" UWORD fak_uw_b2 1 100 0 1.99997 FORMAT "%8.6" ECU_ADDRESS 0x402EB2 /end MEASUREMENT
/begin MEASUREMENT fspvdqltBits_1s "" UBYTE dez 1 100 0 255 FORMAT "%5.1" ECU_ADDRESS 0x403109 /end MEASUREMENT
/begin MEASUREMENT fstadf_w "Tankfuellstand DT1-gefiltert" UWORD vol_q0p1_l 1 100 0 6553.5 FORMAT "%8.3" ECU_ADDRESS 0x402DF2 /end MEASUREMENT
/begin MEASUREMENT fstof_w "ungefilterter Fankf¸llstand" UWORD vol_q0p1_l 1 100 0 6553.5 FORMAT "%8.3" ECU_ADDRESS 0x402DF4 /end MEASUREMENT
/begin MEASUREMENT fstt "Fuellstand Kraftstofftank" UBYTE vol_q1_l 1 100 0 255 FORMAT "%5.1" ECU_ADDRESS 0x402DEE /end MEASUREMENT
/begin MEASUREMENT fsttaf_w "Tankfuellstand gefiltert" UWORD vol_q0p1_l 1 100 0 6553.5 FORMAT "%8.3" ECU_ADDRESS 0x402DF6 /end MEASUREMENT
/begin MEASUREMENT fsttval_w "Fuellstand Kraftstofftank validiert" UWORD vol_q0p1_l 1 100 0 6553.5 FORMAT "%8.3" ECU_ADDRESS 0x3FE172 /end MEASUREMENT
/begin MEASUREMENT fstt_w "Fuellstand Kraftstofftank" UWORD vol_q0p1_l 1 100 0 6553.5 FORMAT "%8.3" ECU_ADDRESS 0x402DF8 /end MEASUREMENT
/begin MEASUREMENT fstu_w "Tankf¸llstand (16-Bit)" UWORD vol_q0p1_l 1 100 0 6553.5 FORMAT "%8.3" ECU_ADDRESS 0x402DFA /end MEASUREMENT
/begin MEASUREMENT ftvdkho_w "Faktor zur Hˆhen- und Temperaturkorrektur" UWORD fak_uw_b8 1 100 0 7.99988 FORMAT "%8.6" ECU_ADDRESS 0x40455C /end MEASUREMENT
/begin MEASUREMENT fwl "Faktor Warmlauf" UBYTE fak_ub_b2 1 100 0 1.99219 FORMAT "%5.3" ECU_ADDRESS 0x403BDC /end MEASUREMENT
/begin MEASUREMENT gangtoelh "Ganginformation bei Erreichen hohes toel" UBYTE DEZ 1 100 0 255 FORMAT "%5.1" ECU_ADDRESS 0x3FE178 /end MEASUREMENT
/begin MEASUREMENT ggairbAusBits "" UBYTE dez 1 100 0 255 FORMAT "%5.1" ECU_ADDRESS 0x402DEA /end MEASUREMENT
/begin MEASUREMENT GgdsasNvBits "" UBYTE dez 1 100 0 255 FORMAT "%5.1" ECU_ADDRESS 0x3FE19E /end MEASUREMENT
/begin MEASUREMENT GGFSTTBits1 "" UBYTE dez 1 100 0 255 FORMAT "%5.1" ECU_ADDRESS 0x403BDE /end MEASUREMENT
/begin MEASUREMENT GGFSTTBits2 "" UBYTE dez 1 100 0 255 FORMAT "%5.1" ECU_ADDRESS 0x403BDF /end MEASUREMENT
/begin MEASUREMENT GGFSTTLokBits1 "" UBYTE dez 1 100 0 255 FORMAT "%5.1" ECU_ADDRESS 0x403BE0 /end MEASUREMENT
/begin MEASUREMENT gghtoelAusNov "" UBYTE dez 1 100 0 255 FORMAT "%5.1" ECU_ADDRESS 0x3FE179 /end MEASUREMENT
/begin MEASUREMENT gghtoelLokBits "" UBYTE dez 1 100 0 255 FORMAT "%5.1" ECU_ADDRESS 0x402E14 /end MEASUREMENT
/begin MEASUREMENT ggks_cc195_Bits "" UWORD default 1 100 0 65535 FORMAT "%8.2" ECU_ADDRESS 0x4046A4 /end MEASUREMENT
/begin MEASUREMENT gvtaf_w "freies Gasvolumen Kraftstofftank" UWORD vol_q0p1_l 1 100 0 6553.5 FORMAT "%8.3" ECU_ADDRESS 0x402DFC /end MEASUREMENT
/begin MEASUREMENT igod2_w "Integratorgradient f¸r Nulltest-Diagnose Klopfregelung (Zweiter CC195)" SWORD spgg_sw_b3052 1 100 -3051.76 3051.67 FORMAT "%8.3" ECU_ADDRESS 0x4040AE /end MEASUREMENT
/begin MEASUREMENT igod_w "Integratorgradient f¸r Nulltest-Diagnose Klopfregelung" SWORD spgg_sw_b3052 1 100 -3051.76 3051.67 FORMAT "%8.3" ECU_ADDRESS 0x4040B0 /end MEASUREMENT
/begin MEASUREMENT igokr2_w "Integratorgradient f¸r Offsetkorrektur Klopfregelung (Word) (Zweiter CC195)" SWORD spgg_sw_b3052 1 100 -3051.76 3051.67 FORMAT "%8.3" ECU_ADDRESS 0x4040B2 /end MEASUREMENT
/begin MEASUREMENT igokr_w "Integratorgradient f¸r Offsetkorrektur Klopfregelung (Word)" SWORD spgg_sw_b3052 1 100 -3051.76 3051.67 FORMAT "%8.3" ECU_ADDRESS 0x4040B4 /end MEASUREMENT
/begin MEASUREMENT ikr "Integratorwert Klopfregelung offsetkorrigiert" UBYTE spg_ub_b5 1 100 0 4.98047 FORMAT "%5.3" ARRAY_SIZE 8 ECU_ADDRESS 0x3FC3B1 /end MEASUREMENT
/begin MEASUREMENT ikrma "Integratorwert Klopfregelung Meﬂfensteranfang" UBYTE spg_ub_b5 1 100 0 4.98047 FORMAT "%5.3" ECU_ADDRESS 0x403C04 /end MEASUREMENT
/begin MEASUREMENT ikrma2 "Integratorwert Klopfregelung Meﬂfensteranfang (Zweiter CC195)" UBYTE spg_ub_b5 1 100 0 4.98047 FORMAT "%5.3" ECU_ADDRESS 0x403C05 /end MEASUREMENT
/begin MEASUREMENT ikrme "Integratorwert Klopfregelung Meﬂfensterende" UBYTE spg_ub_b5 1 100 0 4.98047 FORMAT "%5.3" ARRAY_SIZE 8 ECU_ADDRESS 0x3FC3B9 /end MEASUREMENT
/begin MEASUREMENT ikrmen "Integratorwert Klopfregelung Meﬂfensterende Nulltest" UBYTE spg_ub_b5 1 100 0 4.98047 FORMAT "%5.3" ECU_ADDRESS 0x403C06 /end MEASUREMENT
/begin MEASUREMENT ikrmen2 "Integratorwert Klopfregelung Meﬂfensterende Nulltest (Zweiter CC195)" UBYTE spg_ub_b5 1 100 0 4.98047 FORMAT "%5.3" ECU_ADDRESS 0x403C07 /end MEASUREMENT
/begin MEASUREMENT ikrmet "Integratorwert Klopfregelung Meﬂfensterende Testimpuls" UBYTE spg_ub_b5 1 100 0 4.98047 FORMAT "%5.3" ECU_ADDRESS 0x403C08 /end MEASUREMENT
/begin MEASUREMENT ikrmet2 "Integratorwert Klopfregelung Meﬂfensterende Testimpuls (Zweiter CC195)" UBYTE spg_ub_b5 1 100 0 4.98047 FORMAT "%5.3" ECU_ADDRESS 0x403C09 /end MEASUREMENT
/begin MEASUREMENT ikr_tst "Integratorwert Klopfregelung offsetkorregiert rollierend mit Zyl.z‰hler" UBYTE spg_ub_b5 1 100 0 4.98047 FORMAT "%5.3" ECU_ADDRESS 0x403C0A /end MEASUREMENT
/begin MEASUREMENT imlvhb_w "Durchgesetzte Luftmasse f¸r B_gd" UWORD m_uw_b23p3 1 100 0 23.3013 FORMAT "%8.5" ECU_ADDRESS 0x402D0E /end MEASUREMENT
/begin MEASUREMENT iokkr "Integratoroffsetkorrektur Klopfregelung" UBYTE spg_ub_b5 1 100 0 4.98047 FORMAT "%5.3" ECU_ADDRESS 0x403C0B /end MEASUREMENT
/begin MEASUREMENT iptes_w "Pumpenstrom Tankdiagnose" UWORD i_q6p1035_uA 1 100 0 399.994 FORMAT "%8.4" ECU_ADDRESS 0x40466C /end MEASUREMENT
/begin MEASUREMENT kfdpsmx_aus "" SWORD p_sw_q0p039 1 100 -1280 1279.96 FORMAT "%8.3" ECU_ADDRESS 0x40469C /end MEASUREMENT
/begin MEASUREMENT kfdps_aus "Soll-Differenzdruck Vvt" UWORD p_q0p039s32768 1 100 -1280 1279.96 FORMAT "%7.2" ECU_ADDRESS 0x40455E /end MEASUREMENT
/begin MEASUREMENT kffl_ausi "Ansaugfl‰che bei Spreizungsverstellung" UWORD flae_uw_q0p016 1 100 0 1024 FORMAT "%8.3" ECU_ADDRESS 0x4045DE /end MEASUREMENT
/begin MEASUREMENT kffl_ausn "Ansaugfl‰che bei Normbedingungen" UWORD flae_uw_q0p016 1 100 0 1024 FORMAT "%8.3" ECU_ADDRESS 0x4045E0 /end MEASUREMENT
/begin MEASUREMENT kfgr_w "Verst‰rkungsfaktor FGR-Regler" UWORD rel_uw_b3200 1 100 0 3199.95 FORMAT "%8.3" ECU_ADDRESS 0x403F0E /end MEASUREMENT
/begin MEASUREMENT kldpin_in "Eingang Kennlinie dp Interpolation in Integer f¸r Adressierung KLAF" UWORD fak_uw_q0p001 1 100 0 0.5 FORMAT "%9.7" ECU_ADDRESS 0x404598 /end MEASUREMENT
/begin MEASUREMENT kldpin_w "Eingang Kennlinie dp Interpolation" UWORD fak_uw_b2 1 100 0 1.99997 FORMAT "%8.6" ECU_ADDRESS 0x40459A /end MEASUREMENT
/begin MEASUREMENT klhubgd_aus "" UWORD hub_uw_q0p001 1 100 0 12 FORMAT "%8.5" ECU_ADDRESS 0x4045E2 /end MEASUREMENT
/begin MEASUREMENT kmstandold "Kilometerstand aus letztem Driving Cycle" UWORD km_uw_q10 1 100 0 655350 FORMAT "%8.1" ECU_ADDRESS 0x3FE140 /end MEASUREMENT
/begin MEASUREMENT kmtoelh "Kilometerstand bei Erreichen hohes toel" UWORD km_uw_q10 1 100 0 655350 FORMAT "%8.1" ECU_ADDRESS 0x3FE174 /end MEASUREMENT
/begin MEASUREMENT ks_sym "Eingang des Klopfauswerte-IC" UBYTE dez 1 100 0 255 FORMAT "%5.1" ARRAY_SIZE 4 ECU_ADDRESS 0x3FC3C1 /end MEASUREMENT
/begin MEASUREMENT lamnswl_w "Lambda-Motor-Soll f¸r Nachstart und Warmlauf" UWORD fak_uw_b16 1 100 0 15.9998 FORMAT "%8.5" ECU_ADDRESS 0x40404A /end MEASUREMENT
/begin MEASUREMENT lamwl_w "Lambda-Motor-Soll f¸r Warmlauf" UWORD fak_uw_b16 1 100 0 15.9998 FORMAT "%8.5" ECU_ADDRESS 0x40404C /end MEASUREMENT
/begin MEASUREMENT ldfki_w "Ladedruck Filterzeitkonstante aus Kennfeld" UWORD zk10msxs_uw_b655 1 100 0.0100002 655.36 FORMAT "%12.8" ECU_ADDRESS 0x4040A0 /end MEASUREMENT
/begin MEASUREMENT L_fgr "Status FGR-Bereitschafts-Leuchte" UBYTE B_TRUE 1 100 0 1 BIT_MASK 0x1 FORMAT "%13.11" ECU_ADDRESS 0x4037E8 /end MEASUREMENT
/begin MEASUREMENT maxtime_mfa "" UWORD txms_uw_q0p001 1 100 0 65.535 FORMAT "%8.5" ECU_ADDRESS 0x4046A6 /end MEASUREMENT
/begin MEASUREMENT maxtime_mfe "" UWORD txms_uw_q0p001 1 100 0 65.535 FORMAT "%8.5" ECU_ADDRESS 0x4046A8 /end MEASUREMENT
/begin MEASUREMENT mflctr "rollierender Z‰hler ""empfangene MFL-Botschaften""" UBYTE dez 1 100 0 255 FORMAT "%5.1" ECU_ADDRESS 0x403924 /end MEASUREMENT
/begin MEASUREMENT mflroh "Rohdaten des MFL (serielle Daten in mflroh kopiert)" UBYTE dez 1 100 0 255 FORMAT "%5.1" ECU_ADDRESS 0x403925 /end MEASUREMENT
/begin MEASUREMENT mintime_mfa "" UWORD txms_uw_q0p001 1 100 0 65.535 FORMAT "%8.5" ECU_ADDRESS 0x4046AA /end MEASUREMENT
/begin MEASUREMENT mintime_mfe "" UWORD txms_uw_q0p001 1 100 0 65.535 FORMAT "%8.5" ECU_ADDRESS 0x4046AC /end MEASUREMENT
/begin MEASUREMENT mitoelh "Istmoment bei Erreichen hohes toel" UWORD rel_uw_b100 1 100 0 99.9985 FORMAT "%8.5" ECU_ADDRESS 0x3FE176 /end MEASUREMENT
/begin MEASUREMENT mldtma_w "Ausgang Druckregler" SWORD m_uw_b1638p4 1 100 -819.2 819.175 FORMAT "%8.4" ECU_ADDRESS 0x404560 /end MEASUREMENT
/begin MEASUREMENT mlhfma_w "Luftmassenabtastwert von HFM 16-Bit" UWORD m_uw_b6553p5 1 100 0 6553.5 FORMAT "%8.3" ECU_ADDRESS 0x3FC400 /end MEASUREMENT
/begin MEASUREMENT mlhfmm_w "Luftmassen HFM-Mittelwert 16Bit-Wert" UWORD m_uw_b6553p5 1 100 0 6553.5 FORMAT "%8.3" ECU_ADDRESS 0x404082 /end MEASUREMENT
/begin MEASUREMENT mlhfmofs "Luftmasse HFM-Mittelwert inklusive Offset ohne Korrekturfaktoren" UWORD m_uw_b6553p5 1 100 0 6553.5 FORMAT "%8.3" ECU_ADDRESS 0x3FC402 /end MEASUREMENT
/begin MEASUREMENT mlhubmn_w "" UWORD m_uw_b1638p4 1 100 0 1638.38 FORMAT "%8.3" ECU_ADDRESS 0x404562 /end MEASUREMENT
/begin MEASUREMENT mlnsold_w "" UWORD m_uw_b1638p4 1 100 0 1638.38 FORMAT "%8.3" ECU_ADDRESS 0x404564 /end MEASUREMENT
/begin MEASUREMENT mlnsol_w "" UWORD m_uw_b1638p4 1 100 0 1638.38 FORMAT "%8.3" ECU_ADDRESS 0x404566 /end MEASUREMENT
/begin MEASUREMENT mlsoladte "Solluftmassenstrom inkl. Adaption und Tankentl¸ftung" UWORD m_uw_b6553p5 1 100 0 6553.5 FORMAT "%8.3" ECU_ADDRESS 0x40459C /end MEASUREMENT
/begin MEASUREMENT mlsolkor_w "korrigierter Soll-Luftmassenstrom" UWORD m_uw_b1638p4 1 100 0 1638.38 FORMAT "%8.3" ECU_ADDRESS 0x404568 /end MEASUREMENT
/begin MEASUREMENT mlsol_w "Soll-Luftmassenstrom" UWORD m_uw_b6553p5 1 100 0 6553.5 FORMAT "%8.3" ECU_ADDRESS 0x40456A /end MEASUREMENT
/begin MEASUREMENT mltdmao_w "" SWORD m_uw_b1638p4 1 100 -819.2 819.175 FORMAT "%8.4" ECU_ADDRESS 0x40456C /end MEASUREMENT
/begin MEASUREMENT mlwdkns_w "Normierter Luftmassenstrom f¸r Sollwinkelbestimmung Drosselklappe" UWORD m_uw_b6553p5 1 100 0 6553.5 FORMAT "%8.3" ECU_ADDRESS 0x40459E /end MEASUREMENT
/begin MEASUREMENT mrfgri_w "Relatives Moment Initialisierungswert f¸r FGR-Regler" UWORD rel_uw_b200 1 100 0 199.997 FORMAT "%8.4" ECU_ADDRESS 0x403F10 /end MEASUREMENT
/begin MEASUREMENT mrfgrm_w "Relativer Momentenwunsch von FGR (aus ME)" UWORD rel_uw_b200 1 100 0 199.997 FORMAT "%8.4" ECU_ADDRESS 0x403F12 /end MEASUREMENT
/begin MEASUREMENT mrfgru_w "Untere Grenze f¸r relatives Moment aus FGR" UWORD rel_uw_b200 1 100 0 199.997 FORMAT "%8.4" ECU_ADDRESS 0x403F00 /end MEASUREMENT
/begin MEASUREMENT mrfgrv_w "Relativer Momentenwunsch aus FGR vor Begrenzung" UWORD rel_uw_b200 1 100 0 199.997 FORMAT "%8.4" ECU_ADDRESS 0x403F28 /end MEASUREMENT
/begin MEASUREMENT mrfgr_w "Relative Momentenanforderung von FGR" UWORD rel_uw_b200 1 100 0 199.997 FORMAT "%8.4" ECU_ADDRESS 0x403F02 /end MEASUREMENT
/begin MEASUREMENT mrregl_w "Relatives Moment Reglerausgang FGR" UWORD rel_uw_b200 1 100 0 199.997 FORMAT "%8.4" ECU_ADDRESS 0x403F14 /end MEASUREMENT
/begin MEASUREMENT mrrgli_w "Initialisierungswert Relatives Moment f¸r FGR-Regler" UWORD rel_uw_b200 1 100 0 199.997 FORMAT "%8.4" ECU_ADDRESS 0x403F16 /end MEASUREMENT
/begin MEASUREMENT msdkuw_w "Norm. Massenstrom a. d. Drosselkl. aus Druckverh. und Drosselklappenstellung" UWORD m_uw_b6553p5 1 100 0 6553.5 FORMAT "%8.3" ECU_ADDRESS 0x40458E /end MEASUREMENT
/begin MEASUREMENT mshfmkor "Massenstrom HFM mit Korrektur ¸ber Varianz" UWORD m_uw_b6553p5 1 100 0 6553.5 FORMAT "%8.3" ECU_ADDRESS 0x3FC404 /end MEASUREMENT
/begin MEASUREMENT mshfmnof "Luftmassen HFM Mittelwert ohne Filter" UWORD m_uw_b6553p5 1 100 0 6553.5 FORMAT "%8.3" ECU_ADDRESS 0x3FC406 /end MEASUREMENT
/begin MEASUREMENT mshfm_w "Massenstrom HFM 16-Bit Grˆﬂe" UWORD m_uw_b6553p5 1 100 0 6553.5 FORMAT "%8.3" ECU_ADDRESS 0x3FC408 /end MEASUREMENT
/begin MEASUREMENT nmotkor "Motordrehzahl ansaugluftkorrigiert (zur Pulsationskorrektur)" UBYTE nmot_ub_q40 1 100 0 10200 FORMAT "%5.0" ECU_ADDRESS 0x403BE2 /end MEASUREMENT
/begin MEASUREMENT nmottoelh "Motordrehzahl bei Erreichen hohes toel" UBYTE nmot_ub_q40 1 100 0 10200 FORMAT "%5.0" ECU_ADDRESS 0x3FE17A /end MEASUREMENT
/begin MEASUREMENT ntoelh1 "Anzahl f¸r das Erreichen hohes toel (KO aus)" UBYTE DEZ 1 100 0 255 FORMAT "%5.1" ECU_ADDRESS 0x3FE17B /end MEASUREMENT
/begin MEASUREMENT percent_mfa "" UWORD rel_q0p1 1 100 0 6553.5 FORMAT "%8.3" ECU_ADDRESS 0x4046AE /end MEASUREMENT
/begin MEASUREMENT percent_mfe "" UWORD rel_q0p1 1 100 0 6553.5 FORMAT "%8.3" ECU_ADDRESS 0x4046B0 /end MEASUREMENT
/begin MEASUREMENT plsol "Soll-Ladedruck" UBYTE p_ub_q10 1 100 0 2550 FORMAT "%5.0" ECU_ADDRESS 0x4038D6 /end MEASUREMENT
/begin MEASUREMENT plsol_w "Soll-Ladedruck" UWORD p_uw_q0p039 1 100 0 2559.96 FORMAT "%8.3" ECU_ADDRESS 0x40456E /end MEASUREMENT
/begin MEASUREMENT pssol_w "Sollsaugrohrdruck" UWORD p_uw_q0p039 1 100 0 2559.96 FORMAT "%8.3" ECU_ADDRESS 0x404570 /end MEASUREMENT
/begin MEASUREMENT psspvdkd_w "Verh‰ltnis Sollsaugrohrdruck/Druck vor Drosselklappe von Drucksensor (word)" UWORD fak_uw_b4 1 100 0 3.99994 FORMAT "%8.6" ECU_ADDRESS 0x4040A2 /end MEASUREMENT
/begin MEASUREMENT pu "Umgebungsdruck" UBYTE p_ub_q5 1 100 0 1275 FORMAT "%5.0" ECU_ADDRESS 0x402EA9 /end MEASUREMENT
/begin MEASUREMENT pus_w "Umgebungsdruck ohne Umschaltung auf Ersatzwert bei Sensorfehler" UWORD p_uw_q0p039 1 100 0 2559.96 FORMAT "%8.3" ECU_ADDRESS 0x402EB4 /end MEASUREMENT
/begin MEASUREMENT pu_w "Umgebungsdruck" UWORD p_uw_q0p039 1 100 0 2559.96 FORMAT "%8.3" ECU_ADDRESS 0x402EB6 /end MEASUREMENT
/begin MEASUREMENT pvdkds "Druck vor Drosselklappe von Drucksensor" UBYTE p_ub_q10 1 100 0 2550 FORMAT "%5.0" ECU_ADDRESS 0x403BF2 /end MEASUREMENT
/begin MEASUREMENT pvdkdsl_w "Druck vor Drosselklappe von Ladedrucksensor (word)" UWORD p_uw_q0p039 1 100 0 2559.96 FORMAT "%8.3" ECU_ADDRESS 0x4040A4 /end MEASUREMENT
/begin MEASUREMENT pvdkdsu_w "Druck vor Drosselklappe von Umgebungsdrucksensor (word)" UWORD p_uw_q0p039 1 100 0 2559.96 FORMAT "%8.3" ECU_ADDRESS 0x402EB8 /end MEASUREMENT
/begin MEASUREMENT pvdkds_w "Druck vor Drosselklappe von Drucksensor (word)" UWORD p_uw_q0p039 1 100 0 2559.96 FORMAT "%8.3" ECU_ADDRESS 0x4040A6 /end MEASUREMENT
/begin MEASUREMENT pvdkmx_w "Maximaler Druck vor Drosselklappe Ausgangswert aus Kennlinie PVDKMX" UWORD p_uw_q0p039 1 100 0 2559.96 FORMAT "%8.3" ECU_ADDRESS 0x4040A8 /end MEASUREMENT
/begin MEASUREMENT pvdksf_w "gefilterter Druck vor Drosselklappe (Ladedruck) vom Drucksensor" UWORD p_uw_q0p039 1 100 0 2559.96 FORMAT "%8.3" ECU_ADDRESS 0x4040AA /end MEASUREMENT
/begin MEASUREMENT pvdkspud "Differenz zwischen Umgebungsdruck und Druck vor Drosselklappe" UBYTE p_ub_q10 1 100 0 2550 FORMAT "%5.0" ECU_ADDRESS 0x402EAA /end MEASUREMENT
/begin MEASUREMENT pvdks_w "Druck vor Drosselklappe ohne Umschaltung auf Ersatzwert bei Sensorfehler" UWORD p_uw_q0p039 1 100 0 2559.96 FORMAT "%8.3" ECU_ADDRESS 0x4040AC /end MEASUREMENT
/begin MEASUREMENT relmlhubmn "" UWORD fak_uw_b4 1 100 0 3.99994 FORMAT "%8.6" ECU_ADDRESS 0x404572 /end MEASUREMENT
/begin MEASUREMENT rfstt "relativer Fuellstand Kraftstofftank" UBYTE rel_ub_b127p5 1 100 0 127.5 FORMAT "%5.1" ECU_ADDRESS 0x402DEF /end MEASUREMENT
/begin MEASUREMENT rgvtaf "relatives freies Gasvolumen Kraftstofftank" UBYTE rel_ub_b127p5 1 100 0 127.5 FORMAT "%5.1" ECU_ADDRESS 0x402DF0 /end MEASUREMENT
/begin MEASUREMENT rinh2_w "Istwert (word) Innenwiderstand Ri-Nernstzelle der Lambdasonde hinter KAT Bank2" UWORD r_uw_q2 1 100 0 131070 FORMAT "%8.1" ECU_ADDRESS 0x4040BA /end MEASUREMENT
/begin MEASUREMENT rinh_w "Istwert (word) Innenwiderstand Ri-Nernstzelle der Lambdasonde hinter KAT" UWORD r_uw_q2 1 100 0 131070 FORMAT "%8.1" ECU_ADDRESS 0x4040BC /end MEASUREMENT
/begin MEASUREMENT rinofh2_w "Innenwiderstand (word) Ri Nernst ohne Filterung hinter KAT Bank2" UWORD r_uw_q2 1 100 0 131070 FORMAT "%8.1" ECU_ADDRESS 0x4040BE /end MEASUREMENT
/begin MEASUREMENT rinofha2_w "Innenwiderstand (word) Ri Nernst (alter Wert) ohne Filterung hinter KAT Bank2" UWORD r_uw_q2 1 100 0 131070 FORMAT "%8.1" ECU_ADDRESS 0x4040C0 /end MEASUREMENT
/begin MEASUREMENT rinofha_w "Innenwiderstand (word) Ri Nernst (alter Wert) ohne Filterung hinter KAT" UWORD r_uw_q2 1 100 0 131070 FORMAT "%8.1" ECU_ADDRESS 0x4040C2 /end MEASUREMENT
/begin MEASUREMENT rinofh_w "Innenwiderstand (word) Ri Nernst ohne Filterung hinter KAT" UWORD r_uw_q2 1 100 0 131070 FORMAT "%8.1" ECU_ADDRESS 0x4040C4 /end MEASUREMENT
/begin MEASUREMENT rlfe_w "" SWORD rel_uw_q0p0234 1 100 -768 767.977 FORMAT "%8.4" ECU_ADDRESS 0x404574 /end MEASUREMENT
/begin MEASUREMENT rlsolk_w "Korrigierte relative Sollf¸llung" UWORD rel_uw_q0p0234 1 100 0 1535.98 FORMAT "%8.3" ECU_ADDRESS 0x404576 /end MEASUREMENT
/begin MEASUREMENT rlvw "relative Luftf¸llung (druck- und hˆhenkorrigiert)" UBYTE rel_ub_q0p75 1 100 0 191.25 FORMAT "%5.1" ECU_ADDRESS 0x4038D7 /end MEASUREMENT
/begin MEASUREMENT rlvwvnstf_w "" UWORD rel_uw_q0p0234 1 100 0 1535.98 FORMAT "%8.3" ECU_ADDRESS 0x404578 /end MEASUREMENT
/begin MEASUREMENT rlvwvnst_w "" UWORD rel_uw_q0p0234 1 100 0 1535.98 FORMAT "%8.3" ECU_ADDRESS 0x40457A /end MEASUREMENT
/begin MEASUREMENT rlvwvnsvf_w "" UWORD rel_uw_q0p0234 1 100 0 1535.98 FORMAT "%8.3" ECU_ADDRESS 0x40457C /end MEASUREMENT
/begin MEASUREMENT rlvwvnsv_w "" UWORD rel_uw_q0p0234 1 100 0 1535.98 FORMAT "%8.3" ECU_ADDRESS 0x40457E /end MEASUREMENT
/begin MEASUREMENT rlvwvns_w "relative Fuellung fuer Spreizung" UWORD rel_uw_q0p0234 1 100 0 1535.98 FORMAT "%8.3" ECU_ADDRESS 0x404580 /end MEASUREMENT
/begin MEASUREMENT rlvwvvt_w "relative Fuellung" UWORD rel_uw_q0p0234 1 100 0 1535.98 FORMAT "%8.3" ECU_ADDRESS 0x404582 /end MEASUREMENT
/begin MEASUREMENT rlvw_w "relative Luftf¸llung (druck- und hˆhenkorrigiert) Word" UWORD rel_uw_q0p0234 1 100 0 1535.98 FORMAT "%8.3" ECU_ADDRESS 0x404584 /end MEASUREMENT
/begin MEASUREMENT runtime_mfa "" UWORD txms_uw_q0p001 1 100 0 65.535 FORMAT "%8.5" ECU_ADDRESS 0x4046B2 /end MEASUREMENT
/begin MEASUREMENT runtime_mfe "" UWORD txms_uw_q0p001 1 100 0 65.535 FORMAT "%8.5" ECU_ADDRESS 0x4046B4 /end MEASUREMENT
/begin MEASUREMENT sen_c95 "Klopfsensoreingang am Klopfauswerte-IC" UBYTE dez 1 100 0 255 FORMAT "%5.1" ARRAY_SIZE 8 ECU_ADDRESS 0x403C0C /end MEASUREMENT
/begin MEASUREMENT stekpab "Statusbyte der EKP-Abschaltung" UBYTE dez 1 100 0 255 FORMAT "%5.1" ECU_ADDRESS 0x402DEB /end MEASUREMENT
/begin MEASUREMENT S_VSGDVHUB "Bedingung: Umschalten Motor auf gedrosselt mit VVT-Vollhub" UBYTE dez 1 100 0 255 FORMAT "%5.1" ECU_ADDRESS 0x402D0D /end MEASUREMENT
/begin MEASUREMENT tans16 "" UWORD temp_uw_q0p75_o48 1 100 -48 49103.3 FORMAT "%8.2" ECU_ADDRESS 0x404084 /end MEASUREMENT
/begin MEASUREMENT tdexwslow "" UBYTE t10msxs_ub_b2p55 1 100 0 2.55 FORMAT "%5.3" ECU_ADDRESS 0x4038E4 /end MEASUREMENT
/begin MEASUREMENT tdmflc "Timer f¸r Entprellung Plaus-Fehler (MFL)" UBYTE t10msxs_ub_b2p55 1 100 0 2.55 FORMAT "%5.3" ECU_ADDRESS 0x403926 /end MEASUREMENT
/begin MEASUREMENT tekpcabto "Timeout-Timer EKP-Abschaltung ¸ber CAN" UBYTE t_q0p1 1 100 0 25.5 FORMAT "%5.2" ECU_ADDRESS 0x402DEC /end MEASUREMENT
/begin MEASUREMENT tframe "Telegramml‰nge der MFL-Botschaft" UWORD t_q0p4us 1 100 0 26214 FORMAT "%8.2" ECU_ADDRESS 0x4046B6 /end MEASUREMENT
/begin MEASUREMENT tfst2nq_dez "" UWORD dez 1 100 0 65535 FORMAT "%8.2" ECU_ADDRESS 0x402DFE /end MEASUREMENT
/begin MEASUREMENT tfst2nq_w "Tankfuellstand mit Standard-Quantisierung Tank2" UWORD vol_q0p1_l 1 100 0 6553.5 FORMAT "%8.3" ECU_ADDRESS 0x402E00 /end MEASUREMENT
/begin MEASUREMENT tfst2_dez "Dezimalwert von Fuellstandswert Tank 2" UWORD dez 1 100 0 65535 FORMAT "%8.2" ECU_ADDRESS 0x402E02 /end MEASUREMENT
/begin MEASUREMENT tfstnf_w "Tankfuellstand nach Tiefpa?" UWORD vol_q0p1_l 1 100 0 6553.5 FORMAT "%8.3" ECU_ADDRESS 0x402E04 /end MEASUREMENT
/begin MEASUREMENT tfstnq_dez "Dezimalwert der neuen Qunatisierung Fuellstandswert Tank 1" UWORD dez 1 100 0 65535 FORMAT "%8.2" ECU_ADDRESS 0x402E06 /end MEASUREMENT
/begin MEASUREMENT tfstnq_w "Tankfuellstand mit Standard-Quantisierung" UWORD vol_q0p1_l 1 100 0 6553.5 FORMAT "%8.3" ECU_ADDRESS 0x402E08 /end MEASUREMENT
/begin MEASUREMENT tfst_dez "Dezimalwert von Fuellstandswert Tank 1" UWORD dez 1 100 0 65535 FORMAT "%8.2" ECU_ADDRESS 0x402E0A /end MEASUREMENT
/begin MEASUREMENT tfst_w "Tankfuellstand" UWORD vol_q0p1_l 1 100 0 6553.5 FORMAT "%8.3" ECU_ADDRESS 0x402E0C /end MEASUREMENT
/begin MEASUREMENT tfwdksom_w "Zeitkonstante f¸r Filterung Drosselklappenwinkel ohne Momentenstruktur" UWORD zk10msxs_uw_b655 1 100 0.0100002 655.36 FORMAT "%12.8" ECU_ADDRESS 0x4045A0 /end MEASUREMENT
/begin MEASUREMENT tmflbc "Interner Timer f¸r Wechsel innerhalb Zustandsautomat (MFL)" UBYTE t20msxs_ub_b5p1 1 100 0 5.1 FORMAT "%5.3" ECU_ADDRESS 0x403927 /end MEASUREMENT
/begin MEASUREMENT tmflbec "Timer f¸r MFL-Timeout" UBYTE t10msxs_ub_b2p55 1 100 0 2.55 FORMAT "%5.3" ECU_ADDRESS 0x403928 /end MEASUREMENT
/begin MEASUREMENT tmflfqec "Timer f¸r Telegramm-Frequenzcheck" UBYTE t10msxs_ub_b2p55 1 100 0 2.55 FORMAT "%5.3" ECU_ADDRESS 0x403929 /end MEASUREMENT
/begin MEASUREMENT tmfln_w "Meﬂfensterl‰nge w‰hrend Nulltest, KR" UWORD tus_uw_q3p2 1 100 0 209712 FORMAT "%8.1" ECU_ADDRESS 0x4040B6 /end MEASUREMENT
/begin MEASUREMENT tmfltcc "Timer f¸r Toggelbitcheck" UBYTE t10msxs_ub_b2p55 1 100 0 2.55 FORMAT "%5.3" ECU_ADDRESS 0x40392A /end MEASUREMENT
/begin MEASUREMENT tmfl_w "Meﬂfensterl‰nge Klopfregelung" UWORD tus_uw_q3p2 1 100 0 209712 FORMAT "%8.1" ECU_ADDRESS 0x4040B8 /end MEASUREMENT
/begin MEASUREMENT tmottoelh "Motortemperatur bei Erreichen hohes toel" UBYTE temp_ub_q0p75_o48 1 100 -48 143.25 FORMAT "%5.1" ECU_ADDRESS 0x3FE17C /end MEASUREMENT
/begin MEASUREMENT tn2 "Segmentzeit pro Z¸ndung" UWORD tus_uw_q3p2 1 100 0 209712 FORMAT "%8.1" ECU_ADDRESS 0x402F42 /end MEASUREMENT
/begin MEASUREMENT tn2fgr_w "Doppelte Nennerzeitkonstante FGR-Regler" UWORD t20msxs_uw_q0p02 1 100 0 1310.7 FORMAT "%8.3" ECU_ADDRESS 0x403F18 /end MEASUREMENT
/begin MEASUREMENT toelh "÷ltemperatur bei Erreichen hohes toel" UBYTE temp_ub_q1_o48 1 100 -48 207 FORMAT "%5.1" ECU_ADDRESS 0x3FE17D /end MEASUREMENT
/begin MEASUREMENT toelhkos "Schwellenwert f¸r Erreichen hohes toel (KO aus)" UBYTE temp_ub_q1_o48 1 100 -48 207 FORMAT "%5.1" ECU_ADDRESS 0x3FE17E /end MEASUREMENT
/begin MEASUREMENT tpnt_aktiv "Aktivierung von KR-Funktionen" UBYTE dez 1 100 0 255 FORMAT "%5.1" ECU_ADDRESS 0x403C14 /end MEASUREMENT
/begin MEASUREMENT ttoelh_w "Zeit f¸r unzul‰ssigen Betriebsbereich" UWORD t200msxs_uw_q0p2 1 100 0 13107 FORMAT "%8.2" ECU_ADDRESS 0x402E12 /end MEASUREMENT
/begin MEASUREMENT Ttvdpsrlvw "" UWORD t10msxs_uw_b655p35 1 100 0 655.35 FORMAT "%8.4" ECU_ADDRESS 0x404586 /end MEASUREMENT
/begin MEASUREMENT tumgtoelh "Umgebungstemperatur bei Erreichen hohes toel" UBYTE temp_ub_q0p75_o48 1 100 -48 143.25 FORMAT "%5.1" ECU_ADDRESS 0x3FE17F /end MEASUREMENT
/begin MEASUREMENT tv_gdst "" UBYTE t100msxs_ub_b25p5 1 100 0 25.5 FORMAT "%5.2" ECU_ADDRESS 0x4038D8 /end MEASUREMENT
/begin MEASUREMENT tz2fgr_w "Doppelte Z‰hlerzeitkonstante FGR-Regler" UWORD t20msxs_uw_q0p02 1 100 0 1310.7 FORMAT "%8.3" ECU_ADDRESS 0x403F1A /end MEASUREMENT
/begin MEASUREMENT t_hubon "" UWORD t100msxs_uw_b6553p5 1 100 0 6553.5 FORMAT "%8.3" ECU_ADDRESS 0x404588 /end MEASUREMENT
/begin MEASUREMENT t_nmot "" UBYTE t100msxs_ub_b25p5 1 100 0 25.5 FORMAT "%5.2" ECU_ADDRESS 0x4038D9 /end MEASUREMENT
/begin MEASUREMENT t_rl "" UBYTE t100msxs_ub_b25p5 1 100 0 25.5 FORMAT "%5.2" ECU_ADDRESS 0x4038DA /end MEASUREMENT
/begin MEASUREMENT t_stend "" UBYTE t100msxs_ub_b25p5 1 100 0 25.5 FORMAT "%5.2" ECU_ADDRESS 0x4038DB /end MEASUREMENT
/begin MEASUREMENT t_stendgng "" UBYTE t100msxs_ub_b25p5 1 100 0 25.5 FORMAT "%5.2" ECU_ADDRESS 0x4038DC /end MEASUREMENT
/begin MEASUREMENT t_stendkfp "" UBYTE t100msxs_ub_b25p5 1 100 0 25.5 FORMAT "%5.2" ECU_ADDRESS 0x4038DD /end MEASUREMENT
/begin MEASUREMENT t_wped "" UBYTE t100msxs_ub_b25p5 1 100 0 25.5 FORMAT "%5.2" ECU_ADDRESS 0x4038DE /end MEASUREMENT
/begin MEASUREMENT uadki "eingelesener Integratorwert von Klopfauswerteschaltung" UWORD dez 1 100 0 65535 FORMAT "%8.2" ECU_ADDRESS 0x402F44 /end MEASUREMENT
/begin MEASUREMENT uadki2 "eingelesener Integratorwert von Klopfauswerteschaltung (Zweiter CC195)" UWORD dez 1 100 0 65535 FORMAT "%8.2" ECU_ADDRESS 0x402F46 /end MEASUREMENT
/begin MEASUREMENT uddssm_w "Spannung Differenzdrucksensor Saugrohr ¸ber ein Segment gemittelt" UWORD spg_uw_q0p00488 1 100 0 319.995 FORMAT "%8.4" ECU_ADDRESS 0x40469E /end MEASUREMENT
/begin MEASUREMENT uhfm_w "HFM-Spannung" UWORD spg_q0p00977 1 100 0 639.99 FORMAT "%8.4" ECU_ADDRESS 0x402E10 /end MEASUREMENT
/begin MEASUREMENT uptes_w "Spannung Pumpenstrom Tankdiagnose" UWORD spg_q0p00488 1 100 0 319.995 FORMAT "%8.4" ECU_ADDRESS 0x40466E /end MEASUREMENT
/begin MEASUREMENT usbeh2_w "Spannung (word) Lambdasonde mit Widerstand belastet hinter KAT Bank2" UWORD spg_uw_q0p00488_o1 1 100 -1 318.995 FORMAT "%8.4" ECU_ADDRESS 0x4040C6 /end MEASUREMENT
/begin MEASUREMENT usbeh_w "Spannung (word) Lambdasonde mit Widerstand belastet hinter KAT" UWORD spg_uw_q0p00488_o1 1 100 -1 318.995 FORMAT "%8.4" ECU_ADDRESS 0x4040C8 /end MEASUREMENT
/begin MEASUREMENT ushk "Spannung Lambdasonde hinter Katalysator" UBYTE spg_ub_q0p0052_o0p2 1 100 -0.2 1.13 FORMAT "%5.3" ECU_ADDRESS 0x403C1B /end MEASUREMENT
/begin MEASUREMENT ushk2 "Spannung Lambdasonde hinter Katalysator 2" UBYTE spg_ub_q0p0052_o0p2 1 100 -0.2 1.13 FORMAT "%5.3" ECU_ADDRESS 0x403C1C /end MEASUREMENT
/begin MEASUREMENT ushk2_w "Spannung Lambdasonde (4.88mV/LSB) hinter Katalysator 2" UWORD spg_uw_q0p00488_o1 1 100 -1 318.995 FORMAT "%8.4" ECU_ADDRESS 0x4040CA /end MEASUREMENT
/begin MEASUREMENT ushkr2_w "Spannung (word) Lambdasonde Rohwert hinter KAT Bank2" UWORD spg_uw_q0p00488_o1 1 100 -1 318.995 FORMAT "%8.4" ECU_ADDRESS 0x4040CC /end MEASUREMENT
/begin MEASUREMENT ushkr_w "Spannung (word) Lambdasonde Rohwert hinter KAT" UWORD spg_uw_q0p00488_o1 1 100 -1 318.995 FORMAT "%8.4" ECU_ADDRESS 0x4040CE /end MEASUREMENT
/begin MEASUREMENT ushk_w "Spannung Lambdasonde (4.88mV/LSB) hinter Katalysator" UWORD spg_uw_q0p00488_o1 1 100 -1 318.995 FORMAT "%8.4" ECU_ADDRESS 0x4040D0 /end MEASUREMENT
/begin MEASUREMENT ushmb2_w "Spannung (word,10 ms-Raster) Lambdasonde mit Widerst. belastet hinter KAT Bank2" UWORD spg_uw_q0p00488_o1 1 100 -1 318.995 FORMAT "%8.4" ECU_ADDRESS 0x4040D2 /end MEASUREMENT
/begin MEASUREMENT ushmb_w "Spannung (word, 10 ms-Raster) Lambdasonde mit Widerstand belastet hinter KAT" UWORD spg_uw_q0p00488_o1 1 100 -1 318.995 FORMAT "%8.4" ECU_ADDRESS 0x4040D4 /end MEASUREMENT
/begin MEASUREMENT ushob2_w "Spannung (word, 10 ms-Raster) Lambdasonde ohne Belastung hinter KAT Bank2" UWORD spg_uw_q0p00488_o1 1 100 -1 318.995 FORMAT "%8.4" ECU_ADDRESS 0x4040D6 /end MEASUREMENT
/begin MEASUREMENT ushob_w "Spannung (word, 10 ms-Raster) Lambdasonde ohne Belastung hinter KAT" UWORD spg_uw_q0p00488_o1 1 100 -1 318.995 FORMAT "%8.4" ECU_ADDRESS 0x4040D8 /end MEASUREMENT
/begin MEASUREMENT usobh2_w "Spannung (word) Lambdasonde ohne Belastung hinter KAT Bank2" UWORD spg_uw_q0p00488_o1 1 100 -1 318.995 FORMAT "%8.4" ECU_ADDRESS 0x4040DA /end MEASUREMENT
/begin MEASUREMENT usobh_w "Spannung (word) Lambdasonde ohne Belastung hinter KAT" UWORD spg_uw_q0p00488_o1 1 100 -1 318.995 FORMAT "%8.4" ECU_ADDRESS 0x4040DC /end MEASUREMENT
/begin MEASUREMENT uushmb2_w "Spannung (word,1 ms-Raster) Lambdasonde mit Widerstand belastet hinter KAT Bank2" UWORD spg_uw_q0p00488 1 100 0 319.995 FORMAT "%8.4" ECU_ADDRESS 0x3FC40A /end MEASUREMENT
/begin MEASUREMENT uushmb_w "Spannung (word, 1 ms-Raster) Lambdasonde mit Widerstand belastet hinter KAT" UWORD spg_uw_q0p00488 1 100 0 319.995 FORMAT "%8.4" ECU_ADDRESS 0x3FC40C /end MEASUREMENT
/begin MEASUREMENT uushob2_w "ADC-Spannung (word, 1 ms-Raster) Sonde ohne Belastung hinter Katalysator Bank2" UWORD spg_uw_q0p00488 1 100 0 319.995 FORMAT "%8.4" ECU_ADDRESS 0x3FC40E /end MEASUREMENT
/begin MEASUREMENT uushob_w "ADC-Spannung (word, 1 ms-Raster) Sonde ohne Belastung hinter Katalysator" UWORD spg_uw_q0p00488 1 100 0 319.995 FORMAT "%8.4" ECU_ADDRESS 0x3FC410 /end MEASUREMENT
/begin MEASUREMENT vfzgtoelh "Fahrzeuggeschwindigkeit bei Erreichen hohes toel" UBYTE vfzg_ub_q1p25 1 100 0 318.75 FORMAT "%5.1" ECU_ADDRESS 0x3FE180 /end MEASUREMENT
/begin MEASUREMENT vlast_w "Zus‰tzliche Offset-Geschwindigkeit f¸r FGR-Regler bei hˆherer Last" UWORD vfzg_uw_b512 1 100 0 511.992 FORMAT "%8.4" ECU_ADDRESS 0x403F1C /end MEASUREMENT
/begin MEASUREMENT voffs_w "Offsetgeschwindigkeit f¸r FGR-Regler" UWORD vfzg_uw_b512 1 100 0 511.992 FORMAT "%8.4" ECU_ADDRESS 0x403F1E /end MEASUREMENT
/begin MEASUREMENT vol_verh_w "Verh‰ltnis Zylindervolumen bei Normbedinungen zu Spreizungsverstellung" UWORD fak_uw_b4 1 100 0 3.99994 FORMAT "%8.6" ECU_ADDRESS 0x4045E4 /end MEASUREMENT
/begin MEASUREMENT vrbemx_w "Maximalwert f¸r vregl_w bei Beschleunigung" UWORD vfzg_uw_b512 1 100 0 511.992 FORMAT "%8.4" ECU_ADDRESS 0x403F20 /end MEASUREMENT
/begin MEASUREMENT vregl_w "Sollgeschwindigkeit f¸r FGR-Regler" UWORD vfzg_uw_b512 1 100 0 511.992 FORMAT "%8.4" ECU_ADDRESS 0x403F22 /end MEASUREMENT
/begin MEASUREMENT vrvemn_w "Minimalwert f¸r vregl_w bei Verzˆgern" UWORD vfzg_uw_b512 1 100 0 511.992 FORMAT "%8.4" ECU_ADDRESS 0x403F24 /end MEASUREMENT
/begin MEASUREMENT vsespris "gesch‰tzter Istwert Einlasspreizung variable NWS" UWORD sprzi_q0p1 1 100 0 6553.5 FORMAT "%8.3" ECU_ADDRESS 0x4045E6 /end MEASUREMENT
/begin MEASUREMENT vsesprn "Spreizung bei Normbedingungen" UWORD sprzi_q0p1 1 100 0 6553.5 FORMAT "%8.3" ECU_ADDRESS 0x4045E8 /end MEASUREMENT
/begin MEASUREMENT vsespr_tmp "Source: Einlasspreizung aus Vse_sprs/Vse_spri" UWORD sprzi_q0p1 1 100 0 192 FORMAT "%8.4" ECU_ADDRESS 0x4045EA /end MEASUREMENT
/begin MEASUREMENT vse_spr "Eingang VVT-Spreizung f¸r KFFLAEAN" UWORD sprzi_q0p1 1 100 0 6553.5 FORMAT "%8.3" ECU_ADDRESS 0x4045EC /end MEASUREMENT
/begin MEASUREMENT vziel_w "Zielgeschwindigkeit FGR" UWORD vfzg_uw_b512 1 100 0 511.992 FORMAT "%8.4" ECU_ADDRESS 0x403F26 /end MEASUREMENT
/begin MEASUREMENT wdk1 "Drosselklappenwinkel aus Poti 1" UBYTE relDK_ub_b100 1 100 0 100 FORMAT "%5.1" ECU_ADDRESS 0x403B4C /end MEASUREMENT
/begin MEASUREMENT wdk1g "DK-Winkel aus Poti 1 begrenzt u. gefiltert f¸r Vergl. mit Ersatzwert aus F¸llung" UBYTE relDK_ub_b100 1 100 0 100 FORMAT "%5.1" ECU_ADDRESS 0x403B4D /end MEASUREMENT
/begin MEASUREMENT wdk1_w "DK-Winkel aus Poti 1" SWORD relDK_q0p02441 1 100 -800 799.976 FORMAT "%8.4" ECU_ADDRESS 0x403E08 /end MEASUREMENT
/begin MEASUREMENT wdk2 "Drosselklappenwinkel aus Poti 2" UBYTE relDK_ub_b100 1 100 0 100 FORMAT "%5.1" ECU_ADDRESS 0x403B4E /end MEASUREMENT
/begin MEASUREMENT wdk2g "DK-Winkel aus Poti 2 begrenzt u. gefiltert f¸r Vergl. mit Ersatzwert aus F¸llung" UBYTE relDK_ub_b100 1 100 0 100 FORMAT "%5.1" ECU_ADDRESS 0x403B4F /end MEASUREMENT
/begin MEASUREMENT wdk2_w "DK-Winkel aus Poti 2" SWORD relDK_q0p02441 1 100 -800 799.976 FORMAT "%8.4" ECU_ADDRESS 0x403E0A /end MEASUREMENT
/begin MEASUREMENT wdk3g "Gefilterter Drosselklappenwinkel berechnet aus Hauptf¸llungssignal" UBYTE relDK_ub_b100 1 100 0 100 FORMAT "%5.1" ECU_ADDRESS 0x403B50 /end MEASUREMENT
/begin MEASUREMENT wdkba "Drosselklappenwinkel bezogen auf unteren Anschlag" UBYTE relDK_ub_b100 1 100 0 100 FORMAT "%5.1" ECU_ADDRESS 0x403B51 /end MEASUREMENT
/begin MEASUREMENT wdkba_w "Drosselklappenwinkel bezogen auf unteren Anschlag" SWORD relDK_q0p02441 1 100 -800 799.976 FORMAT "%8.4" ECU_ADDRESS 0x3FC3F4 /end MEASUREMENT
/begin MEASUREMENT wdks "Sollwert DK-Winkel, bezogen auf unteren Anschlag" UBYTE rel_ub_b99p6 1 100 0 99.6094 FORMAT "%5.2" ECU_ADDRESS 0x4038DF /end MEASUREMENT
/begin MEASUREMENT wdksgd "Winkel DK aus KLAF und KFWDKMSN VVT-Betrieb" UWORD rel_uw_b100 1 100 0 99.9985 FORMAT "%8.5" ECU_ADDRESS 0x4045A2 /end MEASUREMENT
/begin MEASUREMENT wdksom_w "Drosselklappensollwinkel ohne Momentenstruktur" UWORD rel_uw_b100 1 100 0 99.9985 FORMAT "%8.5" ECU_ADDRESS 0x4045A4 /end MEASUREMENT
/begin MEASUREMENT wdksp_w "Pr‰dizierter Drosselklappen-Sollwinkel" UWORD rel_uw_b100 1 100 0 99.9985 FORMAT "%8.5" ECU_ADDRESS 0x4045A6 /end MEASUREMENT
/begin MEASUREMENT wdksvt "Drosselklappenwinkel aus KFWDKDPS VVT Betrieb" UWORD rel_uw_b100 1 100 0 99.9985 FORMAT "%8.5" ECU_ADDRESS 0x4045A8 /end MEASUREMENT
/begin MEASUREMENT wdksv_w "Drosselklappen-Sollwinkel vor Applikationsschnittstelle (ungefiltert)" UWORD rel_uw_b100 1 100 0 99.9985 FORMAT "%8.5" ECU_ADDRESS 0x4045AA /end MEASUREMENT
/begin MEASUREMENT wdks_w "Sollwert Drosselklappenwinkel, bezogen auf (unteren) Anschlag" UWORD rel_uw_b100 1 100 0 99.9985 FORMAT "%8.5" ECU_ADDRESS 0x4045AC /end MEASUREMENT
/begin MEASUREMENT wdkugd_w "Drosselklappenwinkel, bei dem 95% F¸llung erreicht wird" UWORD rel_uw_b100 1 100 0 99.9985 FORMAT "%8.5" ECU_ADDRESS 0x4045AE /end MEASUREMENT
/begin MEASUREMENT wmfa "Meﬂfensteranfang in Grad Kurbelwinkel" UBYTE zw_ub_q0p75 1 100 0 191.25 FORMAT "%5.1" ECU_ADDRESS 0x403C15 /end MEASUREMENT
/begin MEASUREMENT wmfa_new "Meﬂfensteranfang: aktueller Wert aus KL/KF" UBYTE zw_ub_q0p75 1 100 0 191.25 FORMAT "%5.1" ECU_ADDRESS 0x403C16 /end MEASUREMENT
/begin MEASUREMENT wmfl "Meﬂfensterl‰nge in Grad Kurbelwinkel" UBYTE zw_ub_q0p75 1 100 0 191.25 FORMAT "%5.1" ECU_ADDRESS 0x403C17 /end MEASUREMENT
/begin MEASUREMENT wmfl_new "Meﬂfensterl‰nge: aktueller Wert aus KL/KF" UBYTE zw_ub_q0p75 1 100 0 191.25 FORMAT "%5.1" ECU_ADDRESS 0x403C18 /end MEASUREMENT
/begin MEASUREMENT wpedtoelh "Pedalwert bei Erreichen hohes toel" UBYTE relPED_ub_b100 1 100 0 100 FORMAT "%5.1" ECU_ADDRESS 0x3FE181 /end MEASUREMENT
/begin MEASUREMENT zaaccflag "Zustandsautomat Positionsflag" UBYTE dez 1 100 0 255 FORMAT "%5.1" ECU_ADDRESS 0x40392B /end MEASUREMENT
/begin MEASUREMENT zkfstf "Zeitkonstante Fuellstandssignalfilter" UWORD zk100msxs_uw_b6553 1 100 0.100002 6553.6 FORMAT "%12.7" ECU_ADDRESS 0x402E0E /end MEASUREMENT
/begin MEASUREMENT zriberh "Ri-Berechnungsz‰hler nach Start hinter KAT" UBYTE dez 1 100 0 255 FORMAT "%5.1" ECU_ADDRESS 0x403C1D /end MEASUREMENT
/begin MEASUREMENT zriberh2 "Ri-Berechnungsz‰hler nach Start hinter KAT Bank2" UBYTE dez 1 100 0 255 FORMAT "%5.1" ECU_ADDRESS 0x403C1E /end MEASUREMENT
/begin MEASUREMENT zrinh2_w "Zeitz‰hler zur Bereitstellung der aktuellen Bedingung Ri-Nernst hinter KAT Bank2" UWORD t100msxs_uw_b6553p5 1 100 0 6553.5 FORMAT "%8.3" ECU_ADDRESS 0x4040DE /end MEASUREMENT
/begin MEASUREMENT zrinh_w "Zeitz‰hler zur Bereitstellung der aktuellen Bedingung Ri-Nernst hinter KAT" UWORD t100msxs_uw_b6553p5 1 100 0 6553.5 FORMAT "%8.3" ECU_ADDRESS 0x4040E0 /end MEASUREMENT
/begin MEASUREMENT zriwzgh "Z‰hler f¸r hohe Ri-Werte hinter Haupt-KAT" UBYTE dez 1 100 0 255 FORMAT "%5.1" ECU_ADDRESS 0x402F50 /end MEASUREMENT
/begin MEASUREMENT zriwzgh2 "Z‰hler f¸r hohe Ri-Werte hinter Haupt-KAT Bank2" UBYTE dez 1 100 0 255 FORMAT "%5.1" ECU_ADDRESS 0x402F51 /end MEASUREMENT
/begin MEASUREMENT ztpnt_a "KR: Z‰hler f¸r die Freigabe von Nulltest oder Testimpuls" UBYTE dez 1 100 0 255 FORMAT "%5.1" ECU_ADDRESS 0x403C19 /end MEASUREMENT
/begin MEASUREMENT zzylkr "Zylinderz‰hler der Klopfregelung" UBYTE dez 1 100 0 255 FORMAT "%5.1" ECU_ADDRESS 0x3FC3C5 /end MEASUREMENT
/begin FUNCTION ESWL "17.10     Einspritzung Warmlauf"
 /begin DEF_CHARACTERISTIC ATISLATM ATIWKSTM CWWL DLAMNSWL KFFWL KFFWLVT KFFWLW KFFWLWVT KFLASWLR LASWLTM ZKLANSWL /end DEF_CHARACTERISTIC
 /begin REF_CHARACTERISTIC SNM12ESUB SRL12ESUB STM12ESUB STS12ESUB /end REF_CHARACTERISTIC
 /begin IN_MEASUREMENT anztib_w B_lrnda B_lrnda2 B_stend B_wks dpsfak esst_snm12esub esst_srl12esub esst_stm12esub esst_sts12esub lamns_w nmot rl tmot tmst /end IN_MEASUREMENT
 /begin OUT_MEASUREMENT fwl lamnswl_w /end OUT_MEASUREMENT
 /begin LOC_MEASUREMENT B_lawlon lamwl_w /end LOC_MEASUREMENT
/end FUNCTION
/begin FUNCTION FE "10.120    F¸llungseingriffe"
 /begin DEF_CHARACTERISTIC DPSFGDVH DPSGRADDR DPSGRADTD DPSGRADUTD DPSGRENZ DPSMN DPSMX DPSRAMPE DPSTDMAMX EVHUBSOFKF FHOMIN FPUPSMAX KFDPGRADDR KFDPGRAUD KFDPS KFDPSMAX KFDPSMIN KFLM0812 KFMSZSVNS KFMSZSVNST KFTDKLM KFTDKST KFTDVNSFIL KFUMLTD KFVHUBML KFVHUBON KLDPSFAK KLGANGGD KLGDVNSFIL KLRLGDAUS KLRLGDEIN KLTDFUEREG KLTVGDST MINHUBOFT2 MINHUBOFTD MLTDDIV MLTDMAMN MLTDMAMX NGDHZONMN NMOTGD NTDMAO RLGD RLGDHZONMN S_DPSRLVW S_DPSTDO S_FPUPS S_FPUPSSOL S_GD S_GDNMOT S_GDVHUB S_HEIZL S_KRDWSGD S_LLGD S_LLKTD S_LLTD S_STKOMF S_TDST S_TEDPS TABMIN TFRLGD TGDHZNST TMABMIN TMGANGGD TMGDHZONMN TMNGDVH TMRLGD TNSGANGGD TNSRLGD TSCHWGD TVDPSRLVW TVGANGGD TVGANGUD TVHEIZLGOF TVHEIZLGON TVTDDPSADP WPEDGD ZTDDPS /end DEF_CHARACTERISTIC
 /begin REF_CHARACTERISTIC CWMDAPP DHUBMX S_TDKF /end REF_CHARACTERISTIC
 /begin IN_MEASUREMENT bbhz_m B_dtevngd B_hz B_krdws B_ll B_llk B_llrein B_nmot B_psapp B_st B_stend B_vl B_vvtnotl dhubra_w dpsad_w dpsfg_w dpssolad_w dpste_w dps_w drlfue_w evhubs_kf E_ddss E_dk E_pddss fcoschmn_w fho fkmsdk_w fkmsvvt_w ftbr_w ftvdk fupsrl_w gangauti imlatm_w kmstand minhub_w msndko_w msnvvto_w nmot nmot_w nsol nstat pirg_w ps_w pu_w pvdkds_w rl rlsol_w rl_w tabst_w tmot tmotab tmst umsrln_w Vsa_spri Vse_spri wped_w /end IN_MEASUREMENT
 /begin OUT_MEASUREMENT Btvdpsrlvw B_dpsadp B_fe B_gd B_gdgang B_gdhz B_gdkf B_gdkfgang B_gdon B_gdst B_gdvhub B_gdvvtueb B_gd_alt B_imlvhb B_lltd B_stmerker B_tdfuereg ddps_w dpsfak dpsfakro dpsgedr_w dpssolgd_w dpssoltdr_w dpssoltd_w dpssolud_w dpssol_ub dpssol_uw dpssol_w dpsuddr_w dpsvvtte_w dpsvvt_w fpups_w ftvdkho_w imlvhb_w kfdps_aus mldtma_w mlhubmn_w mlnsold_w mlnsol_w mlsolkor_w mlsol_w mltdmao_w plsol plsol_w pssol_w rlfe_w rlvw rlvwvnstf_w rlvwvnst_w rlvwvnsvf_w rlvwvnsv_w rlvwvns_w rlvwvvt_w rlvw_w S_VSGDVHUB Ttvdpsrlvw tv_gdst t_hubon t_nmot t_rl t_stend t_stendgng t_stendkfp t_wped /end OUT_MEASUREMENT
 /begin LOC_MEASUREMENT B_hz_tpoff B_hz_tpon kmstandold relmlhubmn rlsolk_w /end LOC_MEASUREMENT
/end FUNCTION
/begin FUNCTION FE_UM "1.10      BMW Funktion" /begin DEF_CHARACTERISTIC KLDKVVTO KLDKVVTU /end DEF_CHARACTERISTIC /begin REF_CHARACTERISTIC KFDKMS KLDPIPOL /end REF_CHARACTERISTIC /begin IN_MEASUREMENT dps_w mlsolkori pvdkds_w wdkba_w /end IN_MEASUREMENT /begin OUT_MEASUREMENT B_dkvvto B_dkvvtu dpipoluw_w dpsmanuw_w msdkuw_w /end OUT_MEASUREMENT /end FUNCTION
/begin FUNCTION FFZ "8.40      Folgefunkenz¸ndung" /begin DEF_CHARACTERISTIC CW_FFZ FFLDZ FFZOF KFFFANZ /end DEF_CHARACTERISTIC /begin IN_MEASUREMENT B_stend nmot tmot ub_w zwout /end IN_MEASUREMENT /begin OUT_MEASUREMENT B_ff ffzanz ffztld_w ffztof_w /end OUT_MEASUREMENT /end FUNCTION
/begin FUNCTION FGRAUS "1.20      Abschaltung Fahrgeschwindigkeitsregler" /begin DEF_CHARACTERISTIC DMRFGRAL MRFGRMAX TFGRARLG /end DEF_CHARACTERISTIC
 /begin IN_MEASUREMENT B_acc B_fgr B_fgras B_fgren B_fgrver gangi mracc_w mrfgrv_w /end IN_MEASUREMENT
 /begin OUT_MEASUREMENT mrfgr_w /end OUT_MEASUREMENT
 /begin LOC_MEASUREMENT B_fgrari dmrar_w mrfgru_w /end LOC_MEASUREMENT
/end FUNCTION
/begin FUNCTION FGRMD "7.40      Funktionslogik und Regelalgorithmus Fahrgeschwindigkeitsregler"
 /begin DEF_CHARACTERISTIC ANZTPMX BRABEVI BRABEVI2 BRATD BRATU BRAWA1GA BRAWA1GA2 BRAWA2GA BRAWA2GA2 BRAWA3GA BRAWA3GA2 BRAWAVI BRAWAVI2 CWFGRMD DVIVZTMX DVSAVO DVSAVU DVSKNBGA DVSKNVGA DVTIPUD DVZVITMX DVZVIWA DVZVRWA1 DVZVRWA2 DVZVRWA3 KFVOFFS KKFFGRGA KRAFGRGA MRFGRMR MRFGRSTA MRMRFGR TFGRTP TN2FGRGA TSWKNBGA TSWKNVGA TVLADV TZ2FGRGA VLMXVZ /end DEF_CHARACTERISTIC
 /begin REF_CHARACTERISTIC MRFGRMAX VFGRMAX VFGRMIN /end REF_CHARACTERISTIC
 /begin IN_MEASUREMENT B_acc B_fgr B_fgrenv B_fgresv B_fgrhsa B_fgrtb2 B_fgrtbe B_fgrtse B_fgrtv2 B_fgrtve B_fgrtwa B_vziels gangi mrfgr_w mrped_w stmodvec vfgr_w vreglmax_w vreglmin_w vziels_w /end IN_MEASUREMENT
 /begin OUT_MEASUREMENT brabevi_w brawa1ga_w brawa2ga_w brawa3ga_w brawavi_w B_besch B_fgrene B_fgrkfm B_fgrvem B_savm B_tb2p B_tpdn B_tpup B_tv2p B_wiauf mrfgrm_w mrregl_w mrrgli_w vziel_w /end OUT_MEASUREMENT
 /begin LOC_MEASUREMENT anztpdn anztpup B_fgrakt B_fgrdvi B_fgrra B_kfnb B_kfnv B_swknb B_swknv B_tbenh B_tbent B_tbep B_tbeph B_tpderl B_tpuerl B_tsenh B_tsent B_tvenh B_tvent B_tvep B_tveph B_twap B_uebetu B_uebrkf B_uebvau B_uevztd B_wavo dvrabe_w dvrave_w dvzvi_w FGRMDlokBits1 FGRMDlokBits2 kfgr_w mrfgri_w tn2fgr_w tz2fgr_w vlast_w voffs_w vrbemx_w vregl_w vrvemn_w /end LOC_MEASUREMENT
/end FUNCTION
/begin FUNCTION FGRUE "5.10      ‹bersicht Fahrgeschwindigkeitsregler"
 /begin IN_MEASUREMENT B_acc B_fgrene B_fgrenv B_fgrkfm B_fgrvem B_savacc B_savm mracc_w mrfgrm_w /end IN_MEASUREMENT
 /begin OUT_MEASUREMENT B_fgren B_fgrkf B_fgrver B_savfgr mrfgrv_w /end OUT_MEASUREMENT
/end FUNCTION
/begin FUNCTION FLSUBB "1.70      Freigabe der Betriebsbereitschaft der LSU" /begin DEF_CHARACTERISTIC CWFLSUBB /end DEF_CHARACTERISTIC
 /begin IN_MEASUREMENT B_hstlsua B_hstlsua2 B_nmot B_ricalf B_ricalf2 B_rinnp B_rinnp2 B_stend ubsq_w /end IN_MEASUREMENT
 /begin OUT_MEASUREMENT B_elsxbb B_elsxbb2 B_sbblsu B_sbblsu2 /end OUT_MEASUREMENT
/end FUNCTION
/begin FUNCTION FSPVDGEN "1.40      Fehlerspeicherverwaltung Generator" /begin IN_MEASUREMENT B_dodgen B_dodgenbs B_pwf genfbsak genstatroh /end IN_MEASUREMENT
 /begin OUT_MEASUREMENT B_genfprl B_gfbsupak B_gfelak B_gfhtak B_gfmeak B_gfnobsak B_taerr B_tumers /end OUT_MEASUREMENT
 /begin LOC_MEASUREMENT eprl1 eprl2 /end LOC_MEASUREMENT
 /begin SUB_FUNCTION DFPM_FSPVDGEN INDEX_FSPVDGEN /end SUB_FUNCTION
/end FUNCTION
/begin FUNCTION FSPVDGEN2 "1.10" /begin IN_MEASUREMENT B_dodgen2 B_dodgenb2 genfbsak2 genstatro2 /end IN_MEASUREMENT
 /begin OUT_MEASUREMENT B_genfprl2 B_gfbsupa2 B_gfelak2 B_gfhtak2 B_gfmeak2 B_gfnobsa2 /end OUT_MEASUREMENT
 /begin LOC_MEASUREMENT eprl12 eprl22 /end LOC_MEASUREMENT
 /begin SUB_FUNCTION DFPM_FSPVDGEN2 INDEX_FSPVDGEN2 /end SUB_FUNCTION
/end FUNCTION
/begin FUNCTION FSPVDIBS "1.30" /begin IN_MEASUREMENT ibserstat1 ibserstat2 ibserstat3 /end IN_MEASUREMENT
 /begin OUT_MEASUREMENT B_ibsfprl B_ifbsak B_ifebsak B_ifisak B_ifsysak B_iftempak B_ifuplak B_ifusak B_ifwugdak B_ifwuplak /end OUT_MEASUREMENT
 /begin SUB_FUNCTION DFPM_FSPVDIBS INDEX_FSPVDIBS /end SUB_FUNCTION
/end FUNCTION
/begin FUNCTION FSPVDQLT "1.10      Plattformspezifische Fehlerspeicherverwaltung f¸r Diagnose"
 /begin IN_MEASUREMENT B_ozdiagok B_ozfsheal B_ozlerrb B_ozqerrb B_ozsierrb B_ozterrb dqltBits2_1s /end IN_MEASUREMENT
 /begin OUT_MEASUREMENT B_mol_sf B_ozclfsp fspvdqltBits_1s /end OUT_MEASUREMENT
 /begin SUB_FUNCTION DFPM_FSPVDQLT /end SUB_FUNCTION
/end FUNCTION
/begin FUNCTION FUEDK "10.180    F¸llungssteuerung (Berechnung DK-Sollwinkel)"
 /begin DEF_CHARACTERISTIC DPLLMX DPSGRENDK FPWDKAPP KFWDKDPS KFWDKMSN KLAF KLDKVL KLDPIPOL KLDPSDKM KLDPSREGOF MSNLG TFWDKSOM TVWDKS TWDKNV TWDKSV TWDKSVST WDKSAPP WDKSNLN WDKUGDN /end DEF_CHARACTERISTIC
 /begin REF_CHARACTERISTIC CWMDAPP /end REF_CHARACTERISTIC
 /begin IN_MEASUREMENT B_fpwdkap B_gd B_gdst B_kl15 B_ll B_nmot B_stend B_vl B_vvtnotl B_wdksap B_wdksapcw dpsdpsad_w dpsfak dpssol_w dpsvbgms_w fho fkmsdk_w ftvdk ftvdkho_w mldpsad mlsol_w msndko_w mssp_w mste nmot nmot_w pvdkds_w rlvwvugd_w rlvw_w wdkdpsad wped_w /end IN_MEASUREMENT
 /begin OUT_MEASUREMENT B_tfwdksom B_wdksom dpipol dpssolad_w dwdks_w fdpsdkm_w kldpin_in kldpin_w mlsoladte mlwdkns_w tfwdksom_w wdks wdksgd wdksom_w wdksp_w wdksvt wdksv_w wdks_w wdkugd_w /end OUT_MEASUREMENT
/end FUNCTION
/begin FUNCTION FUEVVT "2.40      F¸llungsbeeinflussung ¸ber VVT"
 /begin DEF_CHARACTERISTIC CW_VVTSLOW DHUBMD DHUBMX DHUBVH DHUBVHN DHUBVHN1 DNWE DNWELLK ERRVVTHUB FHUBVNSMN FHUBVNSMX FHUBWLL FPHUBAPP HUBAPP HUBSGNL HUBST KFANFLVNS KFEHUB KFEHUBLL KFEHUBLLK KFEHUBST KFEHUBSTM KFESVNS KFFLAEAN KLDEXWSLOW KLEHUBVL KLHUBEX KLVHUB KLVVTCLOSE NOHUBMO S_EVHUBFRZ S_TDKF TFHUBS TFHUBSLL TMSTHUBSTM TVDHUBVHN1 TVHUB TVVTCLOSE TVVTSLOW VSE_SPRON ZKWESVNS /end DEF_CHARACTERISTIC
 /begin REF_CHARACTERISTIC KLZYLN WESNESPR /end REF_CHARACTERISTIC
 /begin IN_MEASUREMENT Adevhubs Adexws B_fphubap B_gdst B_gdvhub B_hubap B_kl15 B_ll B_llrein B_lltd B_nmin B_stend B_vl B_vvtnotl dpsfak exwnki2_w exwnki_w E_vvt_hub minhub_w mlsolkor_w mlsol_w nmot nmot_w nwe rlvw rlvwvugd_w rlvwvvt_w rlvw_w tmot tmst Vse_spri Vse_sprn Vse_sprs wped_w /end IN_MEASUREMENT
 /begin OUT_MEASUREMENT B_frz_hub b_gdvhub_alt B_hubst B_llk B_nwe B_vvtclose B_vvtslow devhubi2_w devhubi_w devhubs_w dexwinks dhubra_w evhubfrz_w evhubi2_10 evhubi2_20 evhubi2_w evhubi_10 evhubi_20 evhubi_w evhubmd_w evhubsnf_w evhubs_10 evhubs_20 evhubs_kf evhubs_tmp evhubs_w evhubvh_w exwinks exwinksp_w exwinks_w fhubvnsf_w fhubvnsi_w fhubvnss_w fhubwll_au kffl_ausi kffl_ausn klhubgd_aus tdexwslow vol_verh_w vsespris vsesprn vsespr_tmp vse_spr /end OUT_MEASUREMENT
/end FUNCTION
/begin FUNCTION GGAIRB "1.30      Gebergrˆﬂe Airbag" /begin DEF_CHARACTERISTIC TCEKP /end DEF_CHARACTERISTIC /begin IN_MEASUREMENT B_nmot ekpausc /end IN_MEASUREMENT
 /begin OUT_MEASUREMENT B_airbag B_crashgen B_ekpcarmd B_ekpcena ggairbAusBits stekpab tekpcabto /end OUT_MEASUREMENT
/end FUNCTION
/begin FUNCTION GGDDSS "1.110     Gebergrˆﬂe Differenzdrucksensor Saugrohr"
 /begin DEF_CHARACTERISTIC CW_PDDSS DDSSDE DDSSGRAD DDSSOFS DPSPLAUS FKDPS KFDPSMX PDDSHUBMX1 PDDSHUBMX2 TDDDSS TDDDSS0 TDDDSSIO TDDSSPLAU1 TDDSSPLAU2 UDDSSMN UDDSSMX /end DEF_CHARACTERISTIC
 /begin IN_MEASUREMENT Btvdpsrlvw B_fpwdkap B_gd B_hfm B_iwfalse B_iwfalse2 B_lltd B_nmot B_pddssmn B_pddssmx B_stend B_vl B_vvtnotl B_wdksap dpssol_w evhubi_w nmot_w uddss_w wdkba_w /end IN_MEASUREMENT
 /begin OUT_MEASUREMENT B_dpsplau1 B_dpsplau2 B_edpsplau dpsad_w dpsddss_w dpsdif dpsd_w dpssyn_w dps_w uddssm_w /end OUT_MEASUREMENT
 /begin LOC_MEASUREMENT dpsdmx1_w dpsdmx2_w dpssolf_w kfdpsmx_aus /end LOC_MEASUREMENT
/end FUNCTION
/begin FUNCTION GGDMTL "2.10      Gebergroesse DM-TL" /begin DEF_CHARACTERISTIC RPTES /end DEF_CHARACTERISTIC /begin IN_MEASUREMENT B_nmin uuptes_w /end IN_MEASUREMENT /begin OUT_MEASUREMENT iptes_w uptes_w /end OUT_MEASUREMENT /end FUNCTION
/begin FUNCTION GGDSAS "11.10     Gebergrˆﬂe Drucksensoren auﬂerhalb Saugrohr"
 /begin DEF_CHARACTERISTIC DPDSVLU DPUPVDK DSUGRAD DSUOFS FHOE NDSVLO NDSVLU NVGDSLL PUE PUMN PUMX PUSPSMX PVDKPUD TDDFU TDDFUUGD TDVGDSLL UADPUMN UADPUMX WDKDSVLU ZDSU /end DEF_CHARACTERISTIC
 /begin IN_MEASUREMENT B_nmot ftu ml_w nmot plsol_w pspvdk_w pssol_w ps_w udsl_w udsu_w wdkba /end IN_MEASUREMENT
 /begin OUT_MEASUREMENT B_clradhoe B_edsl B_edsuu B_hag fho fho_w fpvdkds fpvdkds_w frhol_w GgdsasNvBits pu pus_w pu_w pvdkds pvdkds_w pvdkmx_w pvdksf_w pvdkspud pvdks_w /end OUT_MEASUREMENT
 /begin LOC_MEASUREMENT dpvdkspu_w fpvdkdsl_w fpvdkdsu_w ldfki_w psspvdkd_w pvdkdsl_w pvdkdsu_w /end LOC_MEASUREMENT
/end FUNCTION
/begin FUNCTION GGDVE "6.10      Gebergrˆﬂen Drosselklappensteller"
 /begin DEF_CHARACTERISTIC DUDKP1HY DWDK12O DWDK13O DWDK23O NDKPPU NWDK3 TDKPAW TFWDKPN TVPDKP1 TVPDKP2 TVPWDK12 TVPWDK13 TVPWDK23 UBVDKPO UBVDKPU UDKP1O UDKP1U UDKP2O UDKP2U /end DEF_CHARACTERISTIC
 /begin IN_MEASUREMENT B_dkpu B_ehfs B_st B_ubpvg B_wdkhfu dkpstg_w nmot ub udkp1a_w udkp1sv udkp1vo_w udkp1vv_w udkp1v_w udkp1_w udkp2a_w udkp2_w wdkhf_w /end IN_MEASUREMENT
 /begin OUT_MEASUREMENT B_dkp1e B_dkp1mn B_dkp1mx B_dkp1np B_dkp2e B_dkp2mn B_dkp2mx B_dkp2np B_dkpaw B_dksbeg B_edks B_wdk2sel dwdkba_w wdk1_w wdk2_w wdkba wdkba_w /end OUT_MEASUREMENT
 /begin LOC_MEASUREMENT B_dkp1ev B_dkp2ev B_ubvdkp B_udk1nv B_wdk12ev B_wdk13ev B_wdk1v B_wdk23ev B_wdk2st cpaw1 cpaw2 ctdkp1 ctdkp2 ctdkpaw ctwdk12 ctwdk13 ctwdk23 wdk1 wdk1g wdk2 wdk2g wdk3g /end LOC_MEASUREMENT
/end FUNCTION
/begin FUNCTION GGEGAS "8.50      Gebergrˆﬂe Brems- und Kupplungsschalter" /begin DEF_CHARACTERISTIC CWGGEGAS TSTAEBR TVERBR TVKUP ZERBR /end DEF_CHARACTERISTIC /begin IN_MEASUREMENT codget stssgkpl S_bls S_brs S_kupp /end IN_MEASUREMENT /begin OUT_MEASUREMENT B_bl B_br B_br2k B_brems B_kuppl B_kupplv ctrerbr /end OUT_MEASUREMENT /begin LOC_MEASUREMENT B_erbr B_staebr /end LOC_MEASUREMENT /end FUNCTION
/begin FUNCTION GGFSTT "1.50      Gebergroesse Fuellstandsgeber Tank"
 /begin DEF_CHARACTERISTIC AFSTB CWGGFST FQFSTT FSTDMN FSTDMX FSTDTOL FSTHYS FSTTAL FSTTAL1 FSTTAV FSTTEW FSTTMX GVTMX TVHALT TVKL15 ZKDFST ZKFSTV /end DEF_CHARACTERISTIC
 /begin IN_MEASUREMENT B_kl15 B_nachl B_pwf B_talcan tfst tfst2 vfzg /end IN_MEASUREMENT
 /begin OUT_MEASUREMENT B_fstdmn B_fstdmx B_fsttal B_fsttg B_fsttsh B_fsttval B_tal B_talval B_tav fstof_w fstt fsttaf_w fstt_w fstu_w GGFSTTBits1 GGFSTTBits2 gvtaf_w rfstt rgvtaf /end OUT_MEASUREMENT
 /begin LOC_MEASUREMENT B_fstdy B_fststa B_fsttew fstadf_w fsttval_w GGFSTTLokBits1 tfst2nq_dez tfst2nq_w tfst2_dez tfstnf_w tfstnq_dez tfstnq_w tfst_dez tfst_w zkfstf /end LOC_MEASUREMENT
/end FUNCTION
/begin FUNCTION GGHFM "59.70     Gebersignal HFM" /begin DEF_CHARACTERISTIC KFKHFM KFTHFM KFZKHFM KWNSIGMA MLHFM MLOFS /end DEF_CHARACTERISTIC /begin IN_MEASUREMENT B_st B_stend evhubi_w nmot nmot_w rl rlvw_w tans /end IN_MEASUREMENT
 /begin OUT_MEASUREMENT fkhfm mlhfma_w mlhfmm_w mlhfmofs mshfmkor mshfmnof mshfm_w nmotkor tans16 uhfm_w /end OUT_MEASUREMENT
/end FUNCTION
/begin FUNCTION GGHTOEL "1.40"
 /begin DEF_CHARACTERISTIC CWGGHTOEL NTOELMX TGETHKO TGETHKO2 TOELHGH TOELHGH2 TOELHKO TOELHKO2 TOELHMD TOELHMD2 TOELHOZ TTOELHGH TTOELHKO TTOELHMD TUMGOELMX /end DEF_CHARACTERISTIC
 /begin IN_MEASUREMENT B_clhtoel B_kuppl B_oeltemp gangi kmstand miist_w nmot tget tmot toeloz tumg vfzg wped /end IN_MEASUREMENT
 /begin OUT_MEASUREMENT B_kutoelh B_toelh1 B_toelh1cc B_toelh2 B_toelhgh gangtoelh gghtoelAusNov kmtoelh mitoelh nmottoelh ntoelh1 tmottoelh toelh toelhkos tumgtoelh vfzgtoelh wpedtoelh /end OUT_MEASUREMENT
 /begin LOC_MEASUREMENT B_tgethko B_toelhgh1 B_toelhgh2 B_toelhko B_toelhko2 B_toelhmd B_toelhmd2 gghtoelLokBits ttoelh_w /end LOC_MEASUREMENT
/end FUNCTION
/begin FUNCTION GGKS "10.40     Gebergrˆﬂe Klopfsensor"
 /begin DEF_CHARACTERISTIC DKROKD DKROKMX DKROKO FMFKRN1 FMFKRN2 FMFKRN3 FMFKRN4 FMFKRN5 FMFKRN6 FMFKRN7 FMFKRN8 KEMLN KFMAKR SENZZYL /end DEF_CHARACTERISTIC
 /begin REF_CHARACTERISTIC CWDKRTP KRANH KRFHT SNM16KRUB SRL04KRUB TMKR /end REF_CHARACTERISTIC
 /begin IN_MEASUREMENT B_kr B_krldy B_krndy B_krntfv B_krtpfv B_st B_stend B_tmkr common_rt esst_snm16krub esst_srl04krub kereffw nmot rl tmot tseg_l zzyl /end IN_MEASUREMENT
 /begin OUT_MEASUREMENT AS_bf0 AS_bf1 AS_bf2 AS_bf3 AS_g0 AS_g1 AS_g2 AS_ksa1 AS_ksa2 AS_ksa3 AS_kti B_c95bf0 B_c95bf1 B_c95bf2 B_c95bf3 B_c95ks3 B_dnt B_dntb B_dtp B_dtpb B_dummy B_fmfkrc B_fmfkrco B_fmfkrcu B_krmfok B_ntini B_ot_isr B_tpnt_aw B_tpnt_e counter_mfa counter_mfe fmfkrakt fmfkraktne ggks_cc195_Bits igod2_w igod_w igokr2_w igokr_w ikr ikrma ikrma2 ikrme ikrmen ikrmen2 ikrmet ikrmet2 ikr_tst iokkr ks_sym maxtime_mfa maxtime_mfe mintime_mfa mintime_mfe percent_mfa percent_mfe runtime_mfa runtime_mfe sen_c95 tmfln_w tmfl_w tn2 tpnt_aktiv uadki uadki2 wmfa wmfa_new wmfl wmfl_new ztpnt_a zzylkr /end OUT_MEASUREMENT
/end FUNCTION
/begin FUNCTION GGLSH "3.70      Gebergrˆﬂe Lambdasondensignal (Nernst-Type) hinter Kat"
 /begin DEF_CHARACTERISTIC ANZRIBEH ANZRIWZGH CWGGLSH DUSRIH DUSSPH FRINOF RBEL RINHMX RKSP THSRIH TPULSIBH TRIAKTH TRIIMPH TUSBELH TUSRIBERH USRIMINH USRIOH USRIUH ZFRIH /end DEF_CHARACTERISTIC
 /begin IN_MEASUREMENT B_atmtpk B_atmtpk2 B_lsh B_lsh2 B_lsv B_lsv2 B_ripuv B_ripuv2 B_svuerf B_svuerf2 B_ttbmhh B_ttbmhh2 B_uhsig B_uhsig2 uushk2_w uushk_w valutggls /end IN_MEASUREMENT
 /begin OUT_MEASUREMENT B_priph B_priph2 B_pump B_rinh B_rinh2 B_shuerf B_shuerf2 rinh2_w rinh_w ushk ushk2 ushk2_w ushk_w /end OUT_MEASUREMENT
 /begin LOC_MEASUREMENT B_enrinh B_enrinh2 B_erinofh B_erinofh2 B_measure B_pulsibh B_pulsibh2 B_riakh B_riakh2 B_ribeh B_ribeh2 B_ribehv B_ribehv2 B_riibh B_riibh2 B_riimph B_rimh B_rimh2 B_ripuh B_ripuh2 B_rireh B_rireh2 B_risph B_risph2 B_usbeh B_usbeh2 rinofh2_w rinofha2_w rinofha_w rinofh_w usbeh2_w usbeh_w ushkr2_w ushkr_w ushmb2_w ushmb_w ushob2_w ushob_w usobh2_w usobh_w uushmb2_w uushmb_w uushob2_w uushob_w zriberh zriberh2 zrinh2_w zrinh_w zriwzgh zriwzgh2 /end LOC_MEASUREMENT
/end FUNCTION
/begin FUNCTION GGMFL "4.20      Gebergrˆﬂe Multifunktionslenkrad"
 /begin DEF_CHARACTERISTIC CWGGMFL TDMFL TDMFLH TFGRBTOFF TFGRBTON TFGRBTUBT TFGRMNLE TFGRT2 TMFLBE TMFLFQE TMFLTC UBMFLMN /end DEF_CHARACTERISTIC
 /begin REF_CHARACTERISTIC TFGRTP /end REF_CHARACTERISTIC
 /begin IN_MEASUREMENT B_bt B_btefgr B_btfgr B_clvar B_fgrai B_fgral B_fgras B_fgren B_npszl_um B_pwf B_siszl_um codcan fgrbh_um ub /end IN_MEASUREMENT
 /begin OUT_MEASUREMENT B_fgrat B_fgrhe B_fgrhsa B_fgrtb2 B_fgrtbe B_fgrtse B_fgrtv2 B_fgrtve B_fgrtwa B_tbeh B_tveh L_fgr /end OUT_MEASUREMENT
 /begin LOC_MEASUREMENT B_biterr B_mfl B_mflon B_mnmflv B_mxmflv B_npmflv B_simflv B_tctoggle mflctr mflroh tdmflc tframe tmflbc tmflbec tmflfqec tmfltcc zaaccflag /end LOC_MEASUREMENT
/end FUNCTION
/begin COMPU_METHOD bfzg_ub_b27p67 "" RAT_FUNC "%6.3" "m/s^2" COEFFS 0 256 0 0 0 27.67 /end COMPU_METHOD
/begin COMPU_METHOD bfzg_uw_q0p1085 "" RAT_FUNC "%6.3" "m/s^2" COEFFS 0 1 0 0 0 0.1085 /end COMPU_METHOD
/begin COMPU_METHOD B_TRUE "boolsche Zust‰nde, positive Logik" TAB_VERB "%6.3" "" COMPU_TAB_REF B_TRUE /end COMPU_METHOD
/begin COMPU_VTAB B_TRUE "boolsche Zust‰nde, positive Logik" TAB_VERB 2 0 "----" 1 "TRUE" /end COMPU_VTAB
/begin COMPU_METHOD DEZ "1 : 1 Umrechnug (dez/hex)" RAT_FUNC "%6.2" "" COEFFS 0 1 0 0 0 1 /end COMPU_METHOD
/begin COMPU_METHOD dez "1 : 1 Umrechnug (dez/hex)" RAT_FUNC "%6.2" "" COEFFS 0 1 0 0 0 1 /end COMPU_METHOD
/begin COMPU_METHOD dezsub1 "" RAT_FUNC "%6.2" "-" COEFFS 0 1 -1 0 0 1 /end COMPU_METHOD
/begin COMPU_METHOD dgrad_uw_q0p015 "" RAT_FUNC "%6.4" "hPa/V" COEFFS 0 65536 0 0 0 1024 /end COMPU_METHOD
/begin COMPU_METHOD fakspr_q0p0039 "" RAT_FUNC "%6.4" "" COEFFS 0 256 0 0 0 1 /end COMPU_METHOD
/begin COMPU_METHOD fak_sb_b1 "" RAT_FUNC "%6.4" "-" COEFFS 0 256 0 0 0 2 /end COMPU_METHOD
/begin COMPU_METHOD fak_ub_b1 "" RAT_FUNC "%6.4" "-" COEFFS 0 256 0 0 0 1 /end COMPU_METHOD
/begin COMPU_METHOD fak_ub_b16 "" RAT_FUNC "%6.4" "-" COEFFS 0 256 0 0 0 16 /end COMPU_METHOD
/begin COMPU_METHOD fak_ub_b2 "" RAT_FUNC "%6.4" "-" COEFFS 0 256 0 0 0 2 /end COMPU_METHOD
/begin COMPU_METHOD fak_ub_b4 "" RAT_FUNC "%6.4" "-" COEFFS 0 256 0 0 0 4 /end COMPU_METHOD
/begin COMPU_METHOD fak_ub_q0p00392 "" RAT_FUNC "%6.4" "-" COEFFS 0 255 0 0 0 1 /end COMPU_METHOD
/begin COMPU_METHOD fak_uw_b1 "" RAT_FUNC "%7.6" "-" COEFFS 0 65536 0 0 0 1 /end COMPU_METHOD
/begin COMPU_METHOD fak_uw_b16 "" RAT_FUNC "%6.5" "-" COEFFS 0 65536 0 0 0 16 /end COMPU_METHOD
/begin COMPU_METHOD fak_uw_b2 "" RAT_FUNC "%7.6" "-" COEFFS 0 65536 0 0 0 2 /end COMPU_METHOD
/begin COMPU_METHOD fak_uw_b4 "" RAT_FUNC "%7.6" "-" COEFFS 0 65536 0 0 0 4 /end COMPU_METHOD
/begin COMPU_METHOD fak_uw_b8 "" RAT_FUNC "%6.5" "-" COEFFS 0 65536 0 0 0 8 /end COMPU_METHOD
/begin COMPU_METHOD fak_uw_q0p001 "" RAT_FUNC "%6.5" "-" COEFFS 0 65536 0 0 0 65.536 /end COMPU_METHOD
/begin COMPU_METHOD fak_uw_q0p01 "" RAT_FUNC "%6.4" "-" COEFFS 0 1 0 0 0 0.01 /end COMPU_METHOD
/begin COMPU_METHOD flae_uw_q0p016 "" RAT_FUNC "%6.4" "mm*gKW" COEFFS 0 1 0 0 0 0.016 /end COMPU_METHOD
/begin COMPU_METHOD fmfkr_dez "" RAT_FUNC "%6.2" "kHz" COEFFS 0 1 0 0 0 1 /end COMPU_METHOD
/begin COMPU_METHOD hub_uw_q0p001 "" RAT_FUNC "%6.5" "mm" COEFFS 0 1000 0 0 0 1 /end COMPU_METHOD
/begin COMPU_METHOD i_q6p1035_uA "" RAT_FUNC "%6.4" "mA" COEFFS 0 65536 0 0 0 400 /end COMPU_METHOD
/begin COMPU_METHOD km_uw_q10 "" RAT_FUNC "%6.1" "km" COEFFS 0 1 0 0 0 10 /end COMPU_METHOD
/begin COMPU_METHOD m_uw_b1638p4 "" RAT_FUNC "%6.4" "kg/h" COEFFS 0 1 0 0 0 0.025 /end COMPU_METHOD
/begin COMPU_METHOD m_uw_b23p3 "" RAT_FUNC "%6.5" "kg" COEFFS 0 2812.5 0 0 0 1 /end COMPU_METHOD
/begin COMPU_METHOD m_uw_b6553p5 "" RAT_FUNC "%6.3" "kg/h" COEFFS 0 1 0 0 0 0.1 /end COMPU_METHOD
/begin COMPU_METHOD nmot_ub_q10 "" RAT_FUNC "%6.1" "1/min" COEFFS 0 1 0 0 0 10 /end COMPU_METHOD
/begin COMPU_METHOD nmot_ub_q40 "" RAT_FUNC "%6.1" "1/min" COEFFS 0 1 0 0 0 40 /end COMPU_METHOD
/begin COMPU_METHOD nmot_uw_q0p25 "" RAT_FUNC "%6.3" "1/min" COEFFS 0 1 0 0 0 0.25 /end COMPU_METHOD
/begin COMPU_METHOD p_q0p039 "" RAT_FUNC "%6.4" "hPa" COEFFS 0 256 0 0 0 10 /end COMPU_METHOD
/begin COMPU_METHOD p_q0p039s32768 "" RAT_FUNC "%7.1" "hPa" COEFFS 0 256 327680 0 0 10 /end COMPU_METHOD
/begin COMPU_METHOD p_q10p0 "" RAT_FUNC "%6.1" "hPa" COEFFS 0 1 0 0 0 10 /end COMPU_METHOD
/begin COMPU_METHOD p_sw_q0p039 "" RAT_FUNC "%6.4" "hPa" COEFFS 0 256 0 0 0 10 /end COMPU_METHOD
/begin COMPU_METHOD p_ub_q10 "" RAT_FUNC "%6.1" "hPa" COEFFS 0 1 0 0 0 10 /end COMPU_METHOD
/begin COMPU_METHOD p_ub_q5 "" RAT_FUNC "%6.2" "hPa" COEFFS 0 1 0 0 0 5 /end COMPU_METHOD
/begin COMPU_METHOD p_uw_q0p039 "" RAT_FUNC "%6.4" "hPa" COEFFS 0 256 0 0 0 10 /end COMPU_METHOD
/begin COMPU_METHOD relDK_q0p02441 "" RAT_FUNC "%6.4" "%DK" COEFFS 0 65536 0 0 0 1600 /end COMPU_METHOD
/begin COMPU_METHOD relDK_ub_b100 "" RAT_FUNC "%6.3" "%DK" COEFFS 0 255 0 0 0 100 /end COMPU_METHOD
/begin COMPU_METHOD relPED_ub_b100 "" RAT_FUNC "%6.3" "%PED" COEFFS 0 255 0 0 0 100 /end COMPU_METHOD
/begin COMPU_METHOD relPED_uw_b100 "" RAT_FUNC "%6.4" "%PED" COEFFS 0 65535 0 0 0 100 /end COMPU_METHOD
/begin COMPU_METHOD rel_q0p1 "" RAT_FUNC "%6.3" "%" COEFFS 0 10 0 0 0 1 /end COMPU_METHOD
/begin COMPU_METHOD rel_sw_b50 "" RAT_FUNC "%6.4" "%" COEFFS 0 65536 0 0 0 100 /end COMPU_METHOD
/begin COMPU_METHOD rel_ub_b127p5 "" RAT_FUNC "%6.3" "%" COEFFS 0 2 0 0 0 1 /end COMPU_METHOD
/begin COMPU_METHOD rel_ub_b99p6 "" RAT_FUNC "%6.3" "%" COEFFS 0 256 0 0 0 100 /end COMPU_METHOD
/begin COMPU_METHOD rel_ub_q0p75 "" RAT_FUNC "%6.3" "%" COEFFS 0 1 0 0 0 0.75 /end COMPU_METHOD
/begin COMPU_METHOD rel_uw_b100 "" RAT_FUNC "%6.4" "%" COEFFS 0 65536 0 0 0 100 /end COMPU_METHOD
/begin COMPU_METHOD rel_uw_b200 "" RAT_FUNC "%6.4" "%" COEFFS 0 65536 0 0 0 200 /end COMPU_METHOD
/begin COMPU_METHOD rel_uw_b3200 "" RAT_FUNC "%6.4" "%" COEFFS 0 65536 0 0 0 3200 /end COMPU_METHOD
/begin COMPU_METHOD rel_uw_q0p0234 "" RAT_FUNC "%6.4" "%" COEFFS 0 32 0 0 0 0.75 /end COMPU_METHOD
/begin COMPU_METHOD r_q0p00153 "" RAT_FUNC "%6.4" "Ohm" COEFFS 0 65536 0 0 0 100 /end COMPU_METHOD
/begin COMPU_METHOD r_uw_q2 "" RAT_FUNC "%6.2" "Ohm" COEFFS 0 1 0 0 0 2 /end COMPU_METHOD
/begin COMPU_METHOD spgg_sw_b3052 "" RAT_FUNC "%6.3" "V/s" COEFFS 0 1 0 0 0 0.0931323 /end COMPU_METHOD
/begin COMPU_METHOD spg_q0p00488 "" RAT_FUNC "%6.4" "V" COEFFS 0 1024 0 0 0 5 /end COMPU_METHOD
/begin COMPU_METHOD spg_q0p00977 "" RAT_FUNC "%6.4" "V" COEFFS 0 256 0 0 0 2.5 /end COMPU_METHOD
/begin COMPU_METHOD spg_sw_q0p00488 "" RAT_FUNC "%6.4" "V" COEFFS 0 1024 0 0 0 5 /end COMPU_METHOD
/begin COMPU_METHOD spg_ubatt "" RAT_FUNC "%6.3" "V" COEFFS 0 1 0 0 0 0.0942 /end COMPU_METHOD
/begin COMPU_METHOD spg_ub_b5 "" RAT_FUNC "%6.4" "V" COEFFS 0 256 0 0 0 5 /end COMPU_METHOD
/begin COMPU_METHOD spg_ub_q0p0052_o0p2 "" RAT_FUNC "%6.3" "V" COEFFS 0 255 51 0 0 1.33 /end COMPU_METHOD
/begin COMPU_METHOD spg_ub_q0p019 "" RAT_FUNC "%6.4" "V" COEFFS 0 256 0 0 0 5 /end COMPU_METHOD
/begin COMPU_METHOD spg_uw_q0p001222 "" RAT_FUNC "%6.4" "V" COEFFS 0 65536 0 0 0 80 /end COMPU_METHOD
/begin COMPU_METHOD spg_uw_q0p00488 "" RAT_FUNC "%6.4" "V" COEFFS 0 1024 0 0 0 5 /end COMPU_METHOD
/begin COMPU_METHOD spg_uw_q0p00488_o1 "" RAT_FUNC "%6.3" "V" COEFFS 0 1024 1024 0 0 5 /end COMPU_METHOD
/begin COMPU_METHOD sprzi_q0p1 "" RAT_FUNC "%6.3" "Grad KW" COEFFS 0 10 0 0 0 1 /end COMPU_METHOD
/begin COMPU_METHOD t100msxs_ub_b25p5 "" RAT_FUNC "%6.3" "s" COEFFS 0 1 0 0 0 0.1 /end COMPU_METHOD
/begin COMPU_METHOD t100msxs_uw_b6553p5 "" RAT_FUNC "%6.3" "s" COEFFS 0 1 0 0 0 0.1 /end COMPU_METHOD
/begin COMPU_METHOD t10msxs_ub_b2p55 "" RAT_FUNC "%6.4" "s" COEFFS 0 1 0 0 0 0.01 /end COMPU_METHOD
/begin COMPU_METHOD t10msxs_uw_b655p35 "" RAT_FUNC "%6.4" "s" COEFFS 0 1 0 0 0 0.01 /end COMPU_METHOD
/begin COMPU_METHOD t1sxs_uw_q1 "" RAT_FUNC "%6.2" "s" COEFFS 0 1 0 0 0 1 /end COMPU_METHOD
/begin COMPU_METHOD t200msxs_uw_q0p2 "" RAT_FUNC "%6.3" "s" COEFFS 0 1 0 0 0 0.2 /end COMPU_METHOD
/begin COMPU_METHOD t20msxs_ub_b5p1 "" RAT_FUNC "%6.4" "s" COEFFS 0 1 0 0 0 0.02 /end COMPU_METHOD
/begin COMPU_METHOD t20msxs_uw_q0p02 "" RAT_FUNC "%6.4" "s" COEFFS 0 1 0 0 0 0.02 /end COMPU_METHOD
/begin COMPU_METHOD temp_ub_q0p75_o48 "" RAT_FUNC "%6.2" "Grad C" COEFFS 0 1 48 0 0 0.75 /end COMPU_METHOD
/begin COMPU_METHOD temp_ub_q1_o48 "" RAT_FUNC "%6.2" "" COEFFS 0 1 48 0 0 1 /end COMPU_METHOD
/begin COMPU_METHOD temp_uw_q0p75_o48 "" RAT_FUNC "%6.2" "Grad C" COEFFS 0 1 48 0 0 0.75 /end COMPU_METHOD
/begin COMPU_METHOD tus_uw_q3p2 "" RAT_FUNC "%6.2" "us" COEFFS 0 1 0 0 0 3.2 /end COMPU_METHOD
/begin COMPU_METHOD txms_uw_q0p001 "" RAT_FUNC "%6.5" "ms" COEFFS 0 1000 0 0 0 1 /end COMPU_METHOD
/begin COMPU_METHOD t_q0p1 "" RAT_FUNC "%6.3" "s" COEFFS 0 10 0 0 0 1 /end COMPU_METHOD
/begin COMPU_METHOD t_q0p4us "" RAT_FUNC "%6.3" "us" COEFFS 0 1 0 0 0 0.4 /end COMPU_METHOD
/begin COMPU_METHOD vfzg_sw_q0p00781 "" RAT_FUNC "%6.4" "km/h" COEFFS 0 1 0 0 0 0.0078125 /end COMPU_METHOD
/begin COMPU_METHOD vfzg_ub_q1p25 "" RAT_FUNC "%6.2" "km/h" COEFFS 0 1 0 0 0 1.25 /end COMPU_METHOD
/begin COMPU_METHOD vfzg_uw_b512 "" RAT_FUNC "%6.4" "km/h" COEFFS 0 65536 0 0 0 512 /end COMPU_METHOD
/begin COMPU_METHOD vol_q0p1_l "" RAT_FUNC "%6.3" "l" COEFFS 0 1 0 0 0 0.1 /end COMPU_METHOD
/begin COMPU_METHOD vol_q1_l "" RAT_FUNC "%6.2" "l" COEFFS 0 1 0 0 0 1 /end COMPU_METHOD
/begin COMPU_METHOD vol_q4p8828Em3_l "" RAT_FUNC "%6.4" "l" COEFFS 0 65536 0 0 0 320 /end COMPU_METHOD
/begin COMPU_METHOD wink_ub_q1p0 "" RAT_FUNC "%6.2" "Grad" COEFFS 0 1 0 0 0 1 /end COMPU_METHOD
/begin COMPU_METHOD wink_uw_q0p1 "" RAT_FUNC "%6.3" "Grad" COEFFS 0 10 0 0 0 1 /end COMPU_METHOD
/begin COMPU_METHOD zk100msxs_ub_b25p5 "" RAT_FUNC "%6.3" "s" COEFFS 0 0 256 0 10 0 /end COMPU_METHOD
/begin COMPU_METHOD zk100msxs_uw_b6553 "" RAT_FUNC "%6.1" "s" COEFFS 0 0 65536 0 10 0 /end COMPU_METHOD
/begin COMPU_METHOD zk10msxs_ub_b2p55 "" RAT_FUNC "%6.4" "s" COEFFS 0 0 255 0 100 0 /end COMPU_METHOD
/begin COMPU_METHOD zk10msxs_uw_b655 "" RAT_FUNC "%6.2" "s" COEFFS 0 0 65536 0 100 0 /end COMPU_METHOD
/begin COMPU_METHOD zk20msxs_uw_b1310 "" RAT_FUNC "%6.1" "s" COEFFS 0 0 1310 0 1 0 /end COMPU_METHOD
/begin COMPU_METHOD zk_p_q0p039 "" RAT_FUNC "%6.4" "hPa/100ms" COEFFS 0 256 0 0 0 10 /end COMPU_METHOD
/begin COMPU_METHOD zw_ub_q0p75 "" RAT_FUNC "%6.3" "Grad KW" COEFFS 0 255 0 0 0 191.25 /end COMPU_METHOD
/begin COMPU_METHOD default "" RAT_FUNC "%6.2" "" COEFFS 0 1 0 0 0 1 /end COMPU_METHOD
/begin RECORD_LAYOUT FklWU16 FNC_VALUES 1 UWORD COLUMN_DIR DIRECT /end RECORD_LAYOUT
/begin RECORD_LAYOUT FklWUw FNC_VALUES 1 UWORD COLUMN_DIR DIRECT /end RECORD_LAYOUT
/begin RECORD_LAYOUT GkfWUb FNC_VALUES 1 UBYTE COLUMN_DIR DIRECT /end RECORD_LAYOUT
/begin RECORD_LAYOUT GklWSb FNC_VALUES 1 SBYTE COLUMN_DIR DIRECT /end RECORD_LAYOUT
/begin RECORD_LAYOUT GklWUw FNC_VALUES 1 UWORD COLUMN_DIR DIRECT /end RECORD_LAYOUT
/begin RECORD_LAYOUT KfAxU16AyU16SstxU16SstyU16WU16 NO_AXIS_PTS_X 1 UWORD NO_AXIS_PTS_Y 2 UWORD AXIS_PTS_X 3 UWORD INDEX_INCR DIRECT AXIS_PTS_Y 4 UWORD INDEX_INCR DIRECT FNC_VALUES 5 UWORD COLUMN_DIR DIRECT /end RECORD_LAYOUT
/begin RECORD_LAYOUT KfAxU8AyU8SstxU16SstyU16WU16 NO_AXIS_PTS_X 1 UWORD NO_AXIS_PTS_Y 2 UWORD AXIS_PTS_X 3 UWORD INDEX_INCR DIRECT AXIS_PTS_Y 4 UWORD INDEX_INCR DIRECT FNC_VALUES 5 UWORD COLUMN_DIR DIRECT /end RECORD_LAYOUT
/begin RECORD_LAYOUT KfAxU8AyU8SstxU8SstyU8WU8 NO_AXIS_PTS_X 1 UBYTE NO_AXIS_PTS_Y 2 UBYTE AXIS_PTS_X 3 UBYTE INDEX_INCR DIRECT AXIS_PTS_Y 4 UBYTE INDEX_INCR DIRECT FNC_VALUES 5 UBYTE COLUMN_DIR DIRECT /end RECORD_LAYOUT
/begin RECORD_LAYOUT KfAxUbAyUbSstxUbSstyUbWUb NO_AXIS_PTS_X 1 UBYTE NO_AXIS_PTS_Y 2 UBYTE AXIS_PTS_X 3 UBYTE INDEX_INCR DIRECT AXIS_PTS_Y 4 UBYTE INDEX_INCR DIRECT FNC_VALUES 5 UBYTE COLUMN_DIR DIRECT /end RECORD_LAYOUT
/begin RECORD_LAYOUT KfAxUwAyUwSstxUwSstyUwWSw NO_AXIS_PTS_X 1 UWORD NO_AXIS_PTS_Y 2 UWORD AXIS_PTS_X 3 UWORD INDEX_INCR DIRECT AXIS_PTS_Y 4 UWORD INDEX_INCR DIRECT FNC_VALUES 5 SWORD COLUMN_DIR DIRECT /end RECORD_LAYOUT
/begin RECORD_LAYOUT KfAxUwAyUwSstxUwSstyUwWUw NO_AXIS_PTS_X 1 UWORD NO_AXIS_PTS_Y 2 UWORD AXIS_PTS_X 3 UWORD INDEX_INCR DIRECT AXIS_PTS_Y 4 UWORD INDEX_INCR DIRECT FNC_VALUES 5 UWORD COLUMN_DIR DIRECT /end RECORD_LAYOUT
/begin RECORD_LAYOUT KlAUbSstUbWUb NO_AXIS_PTS_X 1 UBYTE AXIS_PTS_X 2 UBYTE INDEX_INCR DIRECT FNC_VALUES 3 UBYTE COLUMN_DIR DIRECT /end RECORD_LAYOUT
/begin RECORD_LAYOUT KlAUwSstSwWUw NO_AXIS_PTS_X 1 UWORD AXIS_PTS_X 2 SWORD INDEX_INCR DIRECT FNC_VALUES 3 UWORD COLUMN_DIR DIRECT /end RECORD_LAYOUT
/begin RECORD_LAYOUT KlAUwSstUwWUw NO_AXIS_PTS_X 1 UWORD AXIS_PTS_X 2 UWORD INDEX_INCR DIRECT FNC_VALUES 3 UWORD COLUMN_DIR DIRECT /end RECORD_LAYOUT
/begin RECORD_LAYOUT KlAxU16SstxU16WU16 NO_AXIS_PTS_X 1 UWORD AXIS_PTS_X 2 UWORD INDEX_INCR DIRECT FNC_VALUES 3 UWORD COLUMN_DIR DIRECT /end RECORD_LAYOUT
/begin RECORD_LAYOUT KlAxU8SstxS16WS16 NO_AXIS_PTS_X 1 SWORD AXIS_PTS_X 2 SWORD INDEX_INCR DIRECT FNC_VALUES 3 SWORD COLUMN_DIR DIRECT /end RECORD_LAYOUT
/begin RECORD_LAYOUT KlAxU8SstxU16WU16 NO_AXIS_PTS_X 1 UWORD AXIS_PTS_X 2 UWORD INDEX_INCR DIRECT FNC_VALUES 3 UWORD COLUMN_DIR DIRECT /end RECORD_LAYOUT
/begin RECORD_LAYOUT KlAxU8SstxU8WU8 NO_AXIS_PTS_X 1 UBYTE AXIS_PTS_X 2 UBYTE INDEX_INCR DIRECT FNC_VALUES 3 UBYTE COLUMN_DIR DIRECT /end RECORD_LAYOUT
/begin RECORD_LAYOUT KwbUb FNC_VALUES 1 UBYTE COLUMN_DIR DIRECT /end RECORD_LAYOUT
/begin RECORD_LAYOUT KwSw FNC_VALUES 1 SWORD COLUMN_DIR DIRECT /end RECORD_LAYOUT
/begin RECORD_LAYOUT KwUb FNC_VALUES 1 UBYTE COLUMN_DIR DIRECT /end RECORD_LAYOUT
/begin RECORD_LAYOUT KwUw FNC_VALUES 1 UWORD COLUMN_DIR DIRECT /end RECORD_LAYOUT
/begin RECORD_LAYOUT KwWS16 FNC_VALUES 1 SWORD COLUMN_DIR DIRECT /end RECORD_LAYOUT
/begin RECORD_LAYOUT KwWU16 FNC_VALUES 1 UWORD COLUMN_DIR DIRECT /end RECORD_LAYOUT
/begin RECORD_LAYOUT KwWU8 FNC_VALUES 1 UBYTE COLUMN_DIR DIRECT /end RECORD_LAYOUT
/begin RECORD_LAYOUT SstAUbSstUb NO_AXIS_PTS_X 1 UBYTE AXIS_PTS_X 2 UBYTE INDEX_INCR DIRECT /end RECORD_LAYOUT
/end MODULE
/end PROJECT
