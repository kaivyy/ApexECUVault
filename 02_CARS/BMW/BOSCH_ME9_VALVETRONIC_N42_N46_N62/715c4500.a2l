ASAP2_VERSION 1 3
/begin PROJECT _715C4500 "basisme9"
/begin HEADER "" VERSION "_715C4500" PROJECT_NO _715C4500 /end HEADER
/begin MODULE DIM ""
/begin MOD_COMMON "" BYTE_ORDER MSB_FIRST ALIGNMENT_BYTE 1 ALIGNMENT_WORD 2 ALIGNMENT_LONG 2 ALIGNMENT_FLOAT32_IEEE 4 /end MOD_COMMON
/begin CHARACTERISTIC ADCC_MX_UM "Maximaler ADC-Wert bei nach low verzogenem ADC-Kanal bei der ADC-Pr¸fung" VALUE 0xFCC688 KwUb 2.490 spg_ub_q0p0098 0.00 2.490 FORMAT "%5.3" /end CHARACTERISTIC
/begin CHARACTERISTIC ADCC_T_UM "Fehlerzeit bei zueinander unplausiblen ADC-Werten f¸r sp1s" VALUE 0xFCC689 KwUb 5100.00 t20ms_ub_b5100 0.00 5100.00 /end CHARACTERISTIC
/begin CHARACTERISTIC ADCQ_T_UM "Fehlerzeit bei defekter ADC-Queue in der Queue¸berwachung" VALUE 0xFCC68A KwUb 2550.00 t10ms_ub_b2550 0.00 2550.00 /end CHARACTERISTIC
/begin CHARACTERISTIC ANWFOZA "Anzahl NW-Umdr. f¸r Z¸ndausblendung bei fuel-off Adaption" VALUE 0xFCB2D4 KwUb 255.0 dez 0.00 255.0 FORMAT "%5.1" /end CHARACTERISTIC
/begin CHARACTERISTIC AUSCH_T_UM "Maximale Anzahl von Antworten an das UM zur Heilung des FZ im Abschaltpfadtest" VALUE 0xFCC646 KwUb 255.0 dez 0.00 255.0 FORMAT "%5.1" /end CHARACTERISTIC
/begin CHARACTERISTIC AUSC_T_UM "zul‰ssige Anzahl von Pr¸fungen auf nicht angezogenes Hauptrelais in %UMAUSC" VALUE 0xFCC647 KwUb 255.0 dez 0.00 255.0 FORMAT "%5.1" /end CHARACTERISTIC
/begin CHARACTERISTIC AUSGH_T_UM "Heilungszeit f¸r Fehler in der zyklischen RAM-Pr¸fung der Funktions¸berwachung" VALUE 0xFCC694 KwUb 10200.0 t40ms_ub_b10200 0.00 10200.0 FORMAT "%7.1" /end CHARACTERISTIC
/begin CHARACTERISTIC AUSG_T_UM "Fehlertoleranzschwelle f¸r zyklische RAM-Pr¸fung in der Funktions¸berwachung" VALUE 0xFCC695 KwUb 255.0 dezsub1 1.000 256.0 FORMAT "%5.1" /end CHARACTERISTIC
/begin CHARACTERISTIC AUSZH_T_UM "Heilungszeit f¸r Fehler in der zyklischen ROM-Pr¸fung der Funktions¸berwachung" VALUE 0xFCC696 KwUb 10200.0 t40ms_ub_b10200 0.00 10200.0 FORMAT "%7.1" /end CHARACTERISTIC
/begin CHARACTERISTIC AUSZ_T_UM "Fehlertoleranzschwelle f¸r zyklische ROM-Pr¸fung in der Funktions¸berwachung" VALUE 0xFCC697 KwUb 255.0 dezsub1 1.000 256.0 FORMAT "%5.1" /end CHARACTERISTIC
/begin CHARACTERISTIC BREMS_T_UM "Entprellzeit f¸r bet‰tigte Bremse in der Funktions¸berwachung" VALUE 0xFCC434 KwUb 10200.0 t40ms_ub_b10200 0.00 10200.0 FORMAT "%7.1" /end CHARACTERISTIC
/begin CHARACTERISTIC BZ_MSR_M "MSR-Botschaftsz‰hler-Maske (0Fh f¸r 4-Bit-Botschaftsz‰hler)" VALUE 0xFCC4C9 KwUb 255.0 dez 0.00 255.0 FORMAT "%5.1" /end CHARACTERISTIC
/begin CHARACTERISTIC BZ_MSR_M_UC "" VALUE 0xFC0AC0 KwUb 255.0 dez 0.00 255.0 FORMAT "%5.1" /end CHARACTERISTIC
/begin CHARACTERISTIC B_APP_UGEN "Umschaltung auf manuelle Generatorspannungsvorgabe" VALUE 0xFC9ACA KwWU8 255.0 dez 0.00 255.0 FORMAT "%5.1" /end CHARACTERISTIC
/begin CHARACTERISTIC CWDVMX "Codewort SW-Schalter f¸r Integratorinit. bei VMAX-Regelung" VALUE 0xFC8380 KwUb 255.0 dez 0.00 255.0 FORMAT "%5.1" /end CHARACTERISTIC
/begin CHARACTERISTIC CWNOMSRU "Codewort MSR-‹berwachung nicht aktiv" VALUE 0xFCC4CA KwUb 255.0 dez 0.00 255.0 FORMAT "%5.1" /end CHARACTERISTIC
/begin CHARACTERISTIC CWNOMSRU_UC "" VALUE 0xFC0AC1 KwUb 255.0 dez 0.00 255.0 FORMAT "%5.1" /end CHARACTERISTIC
/begin CHARACTERISTIC CWTEACFG "ausserordentliche Konfiguration der Tankentl¸ftung" VALUE 0xFCFF8C KwUb 255.0 dez 0.00 255.0 FORMAT "%5.1" /end CHARACTERISTIC
/begin CHARACTERISTIC CWZWEVTMOD "Rover" VALUE 0xFCB413 KwWU8 255.0 dez 0.00 255.0 FORMAT "%5.1" /end CHARACTERISTIC
/begin CHARACTERISTIC CW_BDE_UC "Codewort f¸r Benzindirekteinspritzung im Befehlstest" VALUE 0xFC0E9C KwUb 255.0 dez 0.00 255.0 FORMAT "%5.1" /end CHARACTERISTIC
/begin CHARACTERISTIC CW_BDE_UM "Codewort f¸r Benzindirekteinspritzung in Funktions¸berwachung" VALUE 0xFCC642 KwUb 255.0 dez 0.00 255.0 FORMAT "%5.1" /end CHARACTERISTIC
/begin CHARACTERISTIC CW_NOROMCHKRESET "" VALUE 0xFC0E9D KwUb 255.0 dez 0.00 255.0 FORMAT "%5.1" /end CHARACTERISTIC
/begin CHARACTERISTIC DFTEAHB "Schwelle Gemischanteil Tankentl¸ftung zum Setzen Bit ""Hohe Beladung""" VALUE 0xFCFCA4 KwSb 1.992 fak_sb_b1 -1.000 0.9922 FORMAT "%5.3" /end CHARACTERISTIC
/begin CHARACTERISTIC DMSTES "Kennlinie maximale Zunahme Massenstrom Tankentl¸ftung" CURVE 0xFC9B96 KlAUwSstUwWUw 3276.800 m_uw_q3p2 0.00 3276.800 FORMAT "%8.3"
 /begin AXIS_DESCR STD_AXIS mstesoll_w m_uw_b25p6 6 0.00 25.59961 FORMAT "%8.5" DEPOSIT ABSOLUTE /end AXIS_DESCR
/end CHARACTERISTIC
/begin CHARACTERISTIC DSTEMIN "Minimalwert f¸r Weitertransport in Totzeitglied Gemischtransport" VALUE 0xFC9BB0 KwUw 0.9999695 fak_uw_b2 0.00 0.9999695 FORMAT "%9.7" /end CHARACTERISTIC
/begin CHARACTERISTIC DUETMOT "Delta Motor¸bertemperatur-Schwelle" VALUE 0xFC202C KwUb 191.3 temp_ub_b191p25 0.00 191.3 FORMAT "%5.1" /end CHARACTERISTIC
/begin CHARACTERISTIC DZWAML "Auf/Abregelgeschwindigkeit zwischen den Begrenzungskennfeldern" CURVE 0xFD02D6 KlAUbSstUbWSb 191.3 zw_sb_q0p75 -96.00 95.25 FORMAT "%5.2"
 /begin AXIS_DESCR STD_AXIS ml m_ub_b1020 12 0.00 1020. FORMAT "%5.0" DEPOSIT ABSOLUTE /end AXIS_DESCR
/end CHARACTERISTIC
/begin CHARACTERISTIC DZWSPM "Delta sp‰tester Z¸ndwinkel abh‰ngig von Motortemperatur" CURVE 0xFD02D0 GklWSb 191.3 zw_sb_q0p75 -96.00 95.25 FORMAT "%5.2"
 /begin AXIS_DESCR COM_AXIS tmot temp_ub_q0p75_o48 6 -48.00 143.3 FORMAT "%5.1" AXIS_PTS_REF STM06__UB /end AXIS_DESCR
/end CHARACTERISTIC
/begin CHARACTERISTIC DZWSTTA "Delta Z¸ndwinkel im Start" CURVE 0xFD02EF KlAUbSstUbWSb 191.3 zw_sb_q0p75 -96.00 95.25 FORMAT "%5.2"
 /begin AXIS_DESCR STD_AXIS tans temp_ub_q0p75_o48 6 -48.00 143.3 FORMAT "%5.1" DEPOSIT ABSOLUTE /end AXIS_DESCR
/end CHARACTERISTIC
/begin CHARACTERISTIC FBTEB "Faktor Begrenzung Lerngeschwindigkeit f¸r Beladung" CURVE 0xFCFCA8 KlAUbSstUbWUb 0.9961 fak_ub_b1 0.00 0.9961
 /begin AXIS_DESCR STD_AXIS ftefvab fak_ub_b0p03125 6 0.00 0.03113 FORMAT "%7.5" DEPOSIT ABSOLUTE /end AXIS_DESCR
/end CHARACTERISTIC
/begin CHARACTERISTIC FBTEVA "Faktor ftefva-abh‰ngige Lerngeschwindigkeit der Beladung" CURVE 0xFCFCB8 KlAUbSstUbWUb 0.9961 fak_ub_b1 0.00 0.9961 /begin AXIS_DESCR STD_AXIS ftefva fak_ub_b0p5 6 0.00 0.4980 DEPOSIT ABSOLUTE /end AXIS_DESCR /end CHARACTERISTIC
/begin CHARACTERISTIC FBZBTEML "Bewertungsfaktor Integrationsgeschwindigkeit Beladungsfaktor" CURVE 0xFCFCC8 KlAUbSstUbWUb 0.9961 fak_ub_b1 0.00 0.9961
 /begin AXIS_DESCR STD_AXIS abo dez 5 0.00 255.0 FORMAT "%5.1" DEPOSIT ABSOLUTE /end AXIS_DESCR
/end CHARACTERISTIC
/begin CHARACTERISTIC FETATEBN "Kennlinie f¸r drehzahlabh‰ngigen Sollwert des Motorwirkungsgrades" CURVE 0xFCFCD4 KlAUbSstUbWUb 0.9961 fak_ub_b1 0.00 0.9961
 /begin AXIS_DESCR STD_AXIS nmot nmot_ub_q40 5 0.00 10200. FORMAT "%5.0" DEPOSIT ABSOLUTE /end AXIS_DESCR
/end CHARACTERISTIC
/begin CHARACTERISTIC FGRC_BFGR_DAT_UC "" VAL_BLK 0xFC0990 KwbUb 255.0 dez 0.00 255.0 FORMAT "%5.1" NUMBER 16 /end CHARACTERISTIC
/begin CHARACTERISTIC FGRC_MIFA_DAT_UC "" VAL_BLK 0xFC09A0 KwbUb 99.61 rel_ub_b99p6 0.00 99.61 FORMAT "%5.2" NUMBER 16 /end CHARACTERISTIC
/begin CHARACTERISTIC FGRC_SFLAGS_DAT_UC "" VAL_BLK 0xFC09B0 KwbUb 255.0 dez 0.00 255.0 FORMAT "%5.1" NUMBER 16 /end CHARACTERISTIC
/begin CHARACTERISTIC FGRC_VFGR_DAT_UC "" VAL_BLK 0xFC09C0 KwbUw 4095.938 vfzg_uw_q0p0625 0.00 4095.938 FORMAT "%8.3" NUMBER 16 /end CHARACTERISTIC
/begin CHARACTERISTIC FGREN_T_UM "Toleranzzeit f¸r FGR-Einschaltung nach Erkennung FGR in der Funktions¸berwachung" VALUE 0xFCC435 KwUb 10200.0 t40ms_ub_b10200 0.00 10200.0 FORMAT "%7.1" /end CHARACTERISTIC
/begin CHARACTERISTIC FKATEB "Kennlinie Kraftstoffanteil Tankentl¸ftung abh. von te / TEMIN" CURVE 0xFCFCE0 KlAUbSstUbWUb 0.9961 fak_ub_b1 0.00 0.9961
 /begin AXIS_DESCR STD_AXIS qtetemin fak_ub_b4 5 0.00 3.984 FORMAT "%5.3" DEPOSIT ABSOLUTE /end AXIS_DESCR
/end CHARACTERISTIC
/begin CHARACTERISTIC FQTEDL "Kennlinie Faktor f¸r exponentielle Absteuerung Sp¸lrate" CURVE 0xFCFCEC KlAUbSstUbWUb 1.992 fak_ub_b2 0.00 1.992 FORMAT "%5.3"
 /begin AXIS_DESCR STD_AXIS dmlftef fak_ub_b0p5 5 0.00 0.4980 DEPOSIT ABSOLUTE /end AXIS_DESCR
/end CHARACTERISTIC
/begin CHARACTERISTIC FQTEPT "Kennlinie Tankunterdruckbegrenzung (pte)" CURVE 0xFCFCF8 KlAUbSstSbWSb 15.88 fak_sb_b16 0.00 15.88 FORMAT "%5.2"
 /begin AXIS_DESCR STD_AXIS pte p_sb_q32 6 0.00 63.75 FORMAT "%5.2" DEPOSIT ABSOLUTE /end AXIS_DESCR
/end CHARACTERISTIC
/begin CHARACTERISTIC FQTEVA "Progression bei Sp¸lratenaufsteuerung" CURVE 0xFCFD08 KlAUbSstUbWUb 15.94 fak_ub_b16 0.00 15.94 FORMAT "%5.2" /begin AXIS_DESCR STD_AXIS ftefva fak_ub_b0p5 6 0.00 0.4980 DEPOSIT ABSOLUTE /end AXIS_DESCR /end CHARACTERISTIC
/begin CHARACTERISTIC FRHB "fr-Schwelle f¸r mˆgliches R¸cksetzten Flip-Flop ""Hohe Beladung""" VALUE 0xFCFD15 KwUb 1.992 fak_ub_b2 0.00 1.992 FORMAT "%5.3" /end CHARACTERISTIC
/begin CHARACTERISTIC FSRFTEF "Faktor Steilheit Sp¸lratenregelung in der N‰he des gew¸nschten Krafstoffanteils" VALUE 0xFC9B4C KwUb 59.75 fak_ub_b64 4.000 63.75 FORMAT "%5.2" /end CHARACTERISTIC
/begin CHARACTERISTIC FTEADAB "Schwelle Beladung f¸r Abbruch TE-Phase" VALUE 0xFCFD16 KwSb 127.5 fak_sb_b64 -64.00 63.50 FORMAT "%5.2" /end CHARACTERISTIC
/begin CHARACTERISTIC FTEADMX "Maximalwert der Beladung des AKF's" VALUE 0xFCFD17 KwSb 127.5 fak_sb_b64 -64.00 63.50 FORMAT "%5.2" /end CHARACTERISTIC
/begin CHARACTERISTIC FTEFHB "Schwelle f¸r Sp¸lrate Tankentl¸ftung f¸r Erkennung hohe Beladung" VALUE 0xFCFD18 KwUb 0.4980 fak_ub_b0p5 0.00 0.4980 /end CHARACTERISTIC
/begin CHARACTERISTIC FTEHB "Schwelle f¸r Faktor Tankentl¸ftung f¸r Erkennung hohe Beladung" VALUE 0xFCFD19 KwSb 127.5 fak_sb_b64 -64.00 63.50 FORMAT "%5.2" /end CHARACTERISTIC
/begin CHARACTERISTIC FTEINIX "Kennlinie Max. Sp¸lrate abh‰ngig vom Integral Massenstrom TE nach TE Stop" CURVE 0xFCFD1C KlAUbSstUbWUb 0.1992 fak_ub_b0p5 0.00 0.1992
 /begin AXIS_DESCR STD_AXIS imsteini m_ub_q0p0444 5 0.00 11.32 FORMAT "%5.2" DEPOSIT ABSOLUTE /end AXIS_DESCR
/end CHARACTERISTIC
/begin CHARACTERISTIC FUMRBRK "Faktor Umrechnung HC-Konzentration in Beladung ftead" VALUE 0xFCFD27 KwUb 31.88 fak_ub_b32 0.00 31.88 FORMAT "%5.2" /end CHARACTERISTIC
/begin CHARACTERISTIC FVERMN "Kennlinie Faktor Vermischung Regeneriergas Tankentl¸ftung mit Frischluft" CURVE 0xFC9B50 KlAUbSstUbWUb 0.9961 fak_ub_b1 0.00 0.9961
 /begin AXIS_DESCR STD_AXIS nmot nmot_ub_q40 6 0.00 10200. FORMAT "%5.0" DEPOSIT ABSOLUTE /end AXIS_DESCR
/end CHARACTERISTIC
/begin CHARACTERISTIC FVERZDYN "Dynamischer Faktor Verzˆgerung Regeneriergas zw. Drosselklappe, Einspritzventil" CURVE 0xFC9BB2 GklWUw 0.003905886 t_min_q5p96em8 0.00 0.003905886 FORMAT "%11.9"
 /begin AXIS_DESCR COM_AXIS qmsdyn fak_ub_b16 5 0.00 15.94 FORMAT "%5.2" AXIS_PTS_REF SQM05TEUB /end AXIS_DESCR
/end CHARACTERISTIC
/begin CHARACTERISTIC FVRMDYN "dynamischer Faktor Vermischung Regeneriergas Tankentl¸ftung mit Frischluft" CURVE 0xFC9B60 GklWUb 7.969 fak_ub_b8 0.00 7.969 FORMAT "%5.3"
 /begin AXIS_DESCR COM_AXIS qmsdyn fak_ub_b16 5 0.00 15.94 FORMAT "%5.2" AXIS_PTS_REF SQM05TEUB /end AXIS_DESCR
/end CHARACTERISTIC
/begin CHARACTERISTIC FZWKHMX "Normierung f¸r Faktor Momentenreserve Katheizen" VALUE 0xFCBBD0 KwUb 0.9961 fak_ub_b1 0.00 0.9961 /end CHARACTERISTIC
/begin CHARACTERISTIC GENOFFTIME "maximale Generatorauszeit" VALUE 0xFC9ABA KwWU16 6553.500 t100msxs_uw_b6553p5 0.00 6553.500 FORMAT "%8.3" /end CHARACTERISTIC
/begin CHARACTERISTIC GENUMAX "maximale Generatorspannung" VALUE 0xFC9ABC KwWU16 16.00000 spg_sw_q0p001 0.00 16.00000 FORMAT "%8.5" /end CHARACTERISTIC
/begin CHARACTERISTIC GENURAMP "Spannungs‰nderung ugen V/100ms" VALUE 0xFC9ABE KwWU16 20.00000 spg_sw_q0p001 0.00 20.00000 FORMAT "%8.5" /end CHARACTERISTIC
/begin CHARACTERISTIC GENURAMPOF "Spannungsinkrement fuer Rampe, Generator ausschalten" VALUE 0xFC9AC0 KwWU16 20.00000 spg_sw_q0p001 0.00 20.00000 FORMAT "%8.5" /end CHARACTERISTIC
/begin CHARACTERISTIC GEN_APP_UG "Manuelle Generatorspannungsvorgabe" VALUE 0xFC9AC2 KwWU16 16.00000 spg_sw_q0p001 0.00 16.00000 FORMAT "%8.5" /end CHARACTERISTIC
/begin CHARACTERISTIC IP1A_MX_UM "max. Spannung f¸r DK-Istwert-Poti 1 am unteren Anschlag f¸r die Funktions¸berw." VALUE 0xFCC5CC KwUb 4.845 spg_ub_q0p019 0.00 4.845 FORMAT "%5.3" /end CHARACTERISTIC
/begin CHARACTERISTIC IP2A_MN_UM "min. Spannung f¸r DK-Istwert-Poti 2 am unteren Anschlag f¸r die Funktions¸berw." VALUE 0xFCC5CD KwUb 4.845 spg_ub_q0p019 0.00 4.845 FORMAT "%5.3" /end CHARACTERISTIC
/begin CHARACTERISTIC IPA_T_UM "Fehlertoleranzzeit f¸r unteren DK-Anschlag im ung¸ltigen Bereich f. d. Fkt¸berw." VALUE 0xFCC5CE KwUb 10200.0 t40ms_ub_b10200 0.00 10200.0 FORMAT "%7.1" /end CHARACTERISTIC
/begin CHARACTERISTIC KFETATE "Kennfeld gew¸nscher Wirkungsgrad bei Tankentl¸ftung bei Erreichen te = TEMIN" MAP 0xFCFE3A KfAxUwAyUwSstxSwSstyUwWUw 50.00000 rel_q0p00195 50.00000 100.0000 FORMAT "%8.4"
 /begin AXIS_DESCR STD_AXIS fteadf_w fak_q0p00195 3 -64.00000 63.99805 FORMAT "%8.5" DEPOSIT ABSOLUTE /end AXIS_DESCR
 /begin AXIS_DESCR STD_AXIS mifa_w rel_uw_b100 5 0.00 99.99847 FORMAT "%8.5" DEPOSIT ABSOLUTE /end AXIS_DESCR
/end CHARACTERISTIC
/begin CHARACTERISTIC KFFQTEFR "KF stetige Grenzwertregelung" MAP 0xFCFD28 KfAxUbAyUbSstxUbSstyUbWSb 15.88 fak_sb_b16 0.00 15.88 FORMAT "%5.2"
 /begin AXIS_DESCR STD_AXIS ml m_ub_b1020 8 0.00 1020. FORMAT "%5.0" DEPOSIT ABSOLUTE /end AXIS_DESCR
 /begin AXIS_DESCR STD_AXIS frmxa fak_ub_b2 8 0.00 1.992 FORMAT "%5.3" DEPOSIT ABSOLUTE /end AXIS_DESCR
/end CHARACTERISTIC
/begin CHARACTERISTIC KFFTEAN "Kennfeld Maximale Sp¸lrate bei Notlauftankentl¸ftung" MAP 0xFCFE6C KfAxUwAyUwSstxUwSstyUwWUw 0.1992188 fak_ub_b0p5 0.00 0.1992188 FORMAT "%9.7"
 /begin AXIS_DESCR STD_AXIS nmot_w nmot_uw_q0p25 10 0.00 16383.75 FORMAT "%8.2" DEPOSIT ABSOLUTE /end AXIS_DESCR
 /begin AXIS_DESCR STD_AXIS rlsol_w rel_uw_q0p0234 10 0.00 1535.977 FORMAT "%8.3" DEPOSIT ABSOLUTE /end AXIS_DESCR
/end CHARACTERISTIC
/begin CHARACTERISTIC KFFTEAX "Kennfeld maximale Sp¸lrate" MAP 0xFCFD7C KfAxUbAyUbSstxUbSstyUbWUb 0.1992 fak_ub_b0p5 0.00 0.1992
 /begin AXIS_DESCR STD_AXIS ml m_ub_b1020 5 0.00 1020. FORMAT "%5.0" DEPOSIT ABSOLUTE /end AXIS_DESCR
 /begin AXIS_DESCR STD_AXIS tans temp_ub_q0p75_o48 4 -48.00 143.3 FORMAT "%5.1" DEPOSIT ABSOLUTE /end AXIS_DESCR
/end CHARACTERISTIC
/begin CHARACTERISTIC KFFWK "Faktoren - Kennfeld f¸r KFWK" MAP 0xFCB8B8 GkfWSb 0.9922 fak_sb_b1 0.00 0.9922
 /begin AXIS_DESCR COM_AXIS nmot nmot_ub_q40 24 0.00 10200. FORMAT "%5.0" AXIS_PTS_REF SNM24ZUUB /end AXIS_DESCR
 /begin AXIS_DESCR COM_AXIS rl rel_ub_q0p75 16 0.00 191.3 FORMAT "%5.1" AXIS_PTS_REF SRL16ZUUB /end AXIS_DESCR
/end CHARACTERISTIC
/begin CHARACTERISTIC KFFWMXA "Kennfeld zur Wichtung Z¸ndwinkelkorrektur" MAP 0xFD027C KfAxUbAyUbSstxUbSstyUbWUb 1.992 fak_ub_b2 0.00 1.992 FORMAT "%5.3"
 /begin AXIS_DESCR STD_AXIS nmot nmot_ub_q40 8 0.00 10200. FORMAT "%5.0" DEPOSIT ABSOLUTE /end AXIS_DESCR
 /begin AXIS_DESCR STD_AXIS rl rel_ub_q0p75 8 0.00 191.3 FORMAT "%5.1" DEPOSIT ABSOLUTE /end AXIS_DESCR
/end CHARACTERISTIC
/begin CHARACTERISTIC KFKSZW "Z¸ndwinkelkennfeld bei Klopfschutz" MAP 0xFCBA38 GkfWSb 191.3 zw_sb_q0p75 -96.00 95.25 FORMAT "%5.2"
 /begin AXIS_DESCR COM_AXIS nmot nmot_ub_q40 24 0.00 10200. FORMAT "%5.0" AXIS_PTS_REF SNM24ZUUB /end AXIS_DESCR
 /begin AXIS_DESCR COM_AXIS rl rel_ub_q0p75 16 0.00 191.3 FORMAT "%5.1" AXIS_PTS_REF SRL16ZUUB /end AXIS_DESCR
/end CHARACTERISTIC
/begin CHARACTERISTIC KFMDZOF_UC "Kennfeld f¸r Offset-Toleranz in Abh‰ngigkeit vom zul. Moment im Befehlstest" MAP 0xFC0C50 GkfWUb 99.61 rel_ub_b99p6 0.00 99.61 FORMAT "%5.2"
 /begin AXIS_DESCR COM_AXIS mz_uc rel_ub_b99p6 8 0.00 99.61 FORMAT "%5.2" AXIS_PTS_REF MDV08_UC /end AXIS_DESCR
 /begin AXIS_DESCR COM_AXIS nmot_uc nmot_ub_q40 8 0.00 10200. FORMAT "%5.0" AXIS_PTS_REF MZUL_NMV08_UC /end AXIS_DESCR
/end CHARACTERISTIC
/begin CHARACTERISTIC KFMDZOF_UM "Kennfeld f¸r Offset-Toleranz in Abh‰ngigkeit vom zul‰ssigen Moment" MAP 0xFCC4D0 GkfWUb 99.61 rel_ub_b99p6 0.00 99.61 FORMAT "%5.2"
 /begin AXIS_DESCR COM_AXIS mz_um rel_ub_b99p6 8 0.00 99.61 FORMAT "%5.2" AXIS_PTS_REF MDV08_UM /end AXIS_DESCR
 /begin AXIS_DESCR COM_AXIS nmot_um nmot_ub_q40 8 0.00 10200. FORMAT "%5.0" AXIS_PTS_REF NMV08_UM /end AXIS_DESCR
/end CHARACTERISTIC
/begin CHARACTERISTIC KFMIRED "Kennfeld Abregelungsmoment f¸r VMAX-Regelung" MAP 0xFC8384 GkfWUb 99.61 rel_ub_b99p6 0.00 99.61 FORMAT "%5.2"
 /begin AXIS_DESCR COM_AXIS bfzglf bfzg_sb_q0p217 4 -27.78 27.56 FORMAT "%5.2" AXIS_PTS_REF SBF02MFSB /end AXIS_DESCR
 /begin AXIS_DESCR COM_AXIS rl_w rel_uw_q0p0234 4 0.00 1535.977 FORMAT "%8.3" AXIS_PTS_REF SRL03MFUW /end AXIS_DESCR
/end CHARACTERISTIC
/begin CHARACTERISTIC KFMI_UC "Kennfeld optimales Motormoment im Befehlstest" MAP 0xFC09E4 GkfWUb 99.61 rel_ub_b99p6 0.00 99.61 FORMAT "%5.2"
 /begin AXIS_DESCR COM_AXIS rl_uc rel_ub_q0p75 8 0.00 191.3 FORMAT "%5.1" AXIS_PTS_REF MIST_RLV08_UC /end AXIS_DESCR
 /begin AXIS_DESCR COM_AXIS nmot_uc nmot_ub_q40 8 0.00 10200. FORMAT "%5.0" AXIS_PTS_REF MIST_NMV08_UC /end AXIS_DESCR
/end CHARACTERISTIC
/begin CHARACTERISTIC KFMI_UM "Kennfeld optimales Motormoment in der Funktions¸berwachung" MAP 0xFCC438 GkfWUb 99.61 rel_ub_b99p6 0.00 99.61 FORMAT "%5.2"
 /begin AXIS_DESCR COM_AXIS rl_um rel_ub_q0p75 8 0.00 191.3 FORMAT "%5.1" AXIS_PTS_REF RLV08_UM /end AXIS_DESCR
 /begin AXIS_DESCR COM_AXIS nmot_um nmot_ub_q40 8 0.00 10200. FORMAT "%5.0" AXIS_PTS_REF NMV08_UM /end AXIS_DESCR
/end CHARACTERISTIC
/begin CHARACTERISTIC KFMPED_UC "Kennfeld f¸r zul‰ssiges Moment aus der Pedalstellung im Befehlstest" MAP 0xFC0C90 GkfWUb 99.61 rel_ub_b99p6 0.00 99.61 FORMAT "%5.2"
 /begin AXIS_DESCR COM_AXIS spsn_uc spg_ub_q0p019 8 0.00 4.845 FORMAT "%5.3" AXIS_PTS_REF MZUL_SPSNV08_UC /end AXIS_DESCR
 /begin AXIS_DESCR COM_AXIS nmot_uc nmot_ub_q40 8 0.00 10200. FORMAT "%5.0" AXIS_PTS_REF MZUL_NMV08_UC /end AXIS_DESCR
/end CHARACTERISTIC
/begin CHARACTERISTIC KFMPED_UM "Kennfeld f¸r zul‰ssiges Moment aus der Pedalstellung in der Funktions¸berwachg" MAP 0xFCC510 GkfWUb 99.61 rel_ub_b99p6 0.00 99.61 FORMAT "%5.2"
 /begin AXIS_DESCR COM_AXIS spsn_um spg_ub_q0p019 8 0.00 4.845 FORMAT "%5.3" AXIS_PTS_REF SPSNV08_UM /end AXIS_DESCR
 /begin AXIS_DESCR COM_AXIS nmot_um nmot_ub_q40 8 0.00 10200. FORMAT "%5.0" AXIS_PTS_REF NMV08_UM /end AXIS_DESCR
/end CHARACTERISTIC
/begin CHARACTERISTIC KFMPNS_UC "Kennfeld f¸r zul. Moment aus Pedalstellung bei kaltem Motor im Befehlstest" MAP 0xFC0CD0 GkfWUb 99.61 rel_ub_b99p6 0.00 99.61 FORMAT "%5.2"
 /begin AXIS_DESCR COM_AXIS spsn_uc spg_ub_q0p019 8 0.00 4.845 FORMAT "%5.3" AXIS_PTS_REF MZUL_SPSNV08_UC /end AXIS_DESCR
 /begin AXIS_DESCR COM_AXIS nmot_uc nmot_ub_q40 8 0.00 10200. FORMAT "%5.0" AXIS_PTS_REF MZUL_NMV08_UC /end AXIS_DESCR
/end CHARACTERISTIC
/begin CHARACTERISTIC KFMPNS_UM "Kennfeld f¸r zul. Moment aus Pedalstellung bei kaltem Motor" MAP 0xFCC550 GkfWUb 99.61 rel_ub_b99p6 0.00 99.61 FORMAT "%5.2"
 /begin AXIS_DESCR COM_AXIS spsn_um spg_ub_q0p019 8 0.00 4.845 FORMAT "%5.3" AXIS_PTS_REF SPSNV08_UM /end AXIS_DESCR
 /begin AXIS_DESCR COM_AXIS nmot_um nmot_ub_q40 8 0.00 10200. FORMAT "%5.0" AXIS_PTS_REF NMV08_UM /end AXIS_DESCR
/end CHARACTERISTIC
/begin CHARACTERISTIC KFQTE "Kennfeld Auf-/Absteuergeschwindigkeit der Sollsp¸lrate Tankentl¸ftung" MAP 0xFCFD9C GkfWUb 0.01216 perio_ub_b0p012207 0.00 0.01216 FORMAT "%7.5"
 /begin AXIS_DESCR COM_AXIS ml m_ub_b1020 8 0.00 1020. FORMAT "%5.0" AXIS_PTS_REF SML08TEUB /end AXIS_DESCR
 /begin AXIS_DESCR COM_AXIS frmit fak_ub_b2 8 0.00 1.992 FORMAT "%5.3" AXIS_PTS_REF SFR08TEUB /end AXIS_DESCR
/end CHARACTERISTIC
/begin CHARACTERISTIC KFRLIP_UM "Kennfeld f¸r rl - Berechnung aus Drosselklappenwinkel in der Funktions¸berwachg" MAP 0xFCC5D0 KfAxUbAyUbSstxUbSstyUbWUb 191.3 rel_ub_q0p75 0.00 191.3 FORMAT "%5.1"
 /begin AXIS_DESCR STD_AXIS ipsn_um spg_ub_q0p019 8 0.00 4.845 FORMAT "%5.3" DEPOSIT ABSOLUTE /end AXIS_DESCR
 /begin AXIS_DESCR STD_AXIS nmot_um nmot_ub_q40 8 0.00 10200. FORMAT "%5.0" DEPOSIT ABSOLUTE /end AXIS_DESCR
/end CHARACTERISTIC
/begin CHARACTERISTIC KFTADMS "dynamischer Bewertungsfaktor f¸r das Absteuern des TEV" MAP 0xFC9B65 KfAxUbAyUbSstxSbSstyUbWUb 1.992 fak_ub_b2 0.00 1.992 FORMAT "%5.3"
 /begin AXIS_DESCR STD_AXIS dmssginr fak_sb_b1 5 -1.000 0.9922 FORMAT "%5.3" DEPOSIT ABSOLUTE /end AXIS_DESCR
 /begin AXIS_DESCR STD_AXIS nmot nmot_ub_q40 4 0.00 10200. FORMAT "%5.0" DEPOSIT ABSOLUTE /end AXIS_DESCR
/end CHARACTERISTIC
/begin CHARACTERISTIC KFTATX "Kennfeld f¸r maximales Tastverh‰ltnis" MAP 0xFCFDDC KfAxUbAyUbSstxUbSstyUbWUb 99.61 rel_ub_b99p6 0.00 99.61 FORMAT "%5.2"
 /begin AXIS_DESCR STD_AXIS ml m_ub_b1020 10 0.00 1020. FORMAT "%5.0" DEPOSIT ABSOLUTE /end AXIS_DESCR
 /begin AXIS_DESCR STD_AXIS pspu fak_ub_b2 6 0.00 1.992 FORMAT "%5.3" DEPOSIT ABSOLUTE /end AXIS_DESCR
/end CHARACTERISTIC
/begin CHARACTERISTIC KFTEKA "Kennfeld Sollkraftstoffanteil bei Regenerierung" MAP 0xFCFF60 KfAxUbAyUbSstxUbSstyUbWSb 0.9922 fak_sb_b1 0.00 0.9922
 /begin AXIS_DESCR STD_AXIS nmot nmot_ub_q40 5 0.00 10200. FORMAT "%5.0" DEPOSIT ABSOLUTE /end AXIS_DESCR
 /begin AXIS_DESCR STD_AXIS rl rel_ub_q0p75 5 0.00 191.3 FORMAT "%5.1" DEPOSIT ABSOLUTE /end AXIS_DESCR
/end CHARACTERISTIC
/begin CHARACTERISTIC KFWK "Z¸ndwinkelkennfeld f¸r Klopfschutzfunktion" MAP 0xFCBBB9 KfAxUbAyUbSstxUbSstyUbWSb 191.3 zw_sb_q0p75 -96.00 95.25 FORMAT "%5.2"
 /begin AXIS_DESCR STD_AXIS tmot temp_ub_q0p75_o48 3 -48.00 143.3 FORMAT "%5.1" DEPOSIT ABSOLUTE /end AXIS_DESCR
 /begin AXIS_DESCR STD_AXIS tans temp_ub_q0p75_o48 4 -48.00 143.3 FORMAT "%5.1" DEPOSIT ABSOLUTE /end AXIS_DESCR
/end CHARACTERISTIC
/begin CHARACTERISTIC KFWKORAG1 "Rover" MAP 0xFCB418 GkfWSb 25.50 fak_q0p1 -12.80 12.70 FORMAT "%5.2"
 /begin AXIS_DESCR COM_AXIS nmot nmot_ub_q40 8 0.00 10200. FORMAT "%5.0" AXIS_PTS_REF SNM08ZUUB /end AXIS_DESCR
 /begin AXIS_DESCR COM_AXIS rl rel_ub_q0p75 8 0.00 191.3 FORMAT "%5.1" AXIS_PTS_REF SRL08ZUUB /end AXIS_DESCR
/end CHARACTERISTIC
/begin CHARACTERISTIC KFWKORAG2 "Rover" MAP 0xFCB458 GkfWSb 25.50 fak_q0p1 -12.80 12.70 FORMAT "%5.2"
 /begin AXIS_DESCR COM_AXIS nmot nmot_ub_q40 8 0.00 10200. FORMAT "%5.0" AXIS_PTS_REF SNM08ZUUB /end AXIS_DESCR
 /begin AXIS_DESCR COM_AXIS rl rel_ub_q0p75 8 0.00 191.3 FORMAT "%5.1" AXIS_PTS_REF SRL08ZUUB /end AXIS_DESCR
/end CHARACTERISTIC
/begin CHARACTERISTIC KFWKORAO1 "Rover" MAP 0xFCB498 GkfWUb 191.3 temp_ub_q0p75_o48 -48.00 143.3 FORMAT "%5.1"
 /begin AXIS_DESCR COM_AXIS nmot nmot_ub_q40 8 0.00 10200. FORMAT "%5.0" AXIS_PTS_REF SNM08ZUUB /end AXIS_DESCR
 /begin AXIS_DESCR COM_AXIS rl rel_ub_q0p75 8 0.00 191.3 FORMAT "%5.1" AXIS_PTS_REF SRL08ZUUB /end AXIS_DESCR
/end CHARACTERISTIC
/begin CHARACTERISTIC KFWKORAO2 "Rover" MAP 0xFCB4D8 GkfWUb 191.3 temp_ub_q0p75_o48 -48.00 143.3 FORMAT "%5.1"
 /begin AXIS_DESCR COM_AXIS nmot nmot_ub_q40 8 0.00 10200. FORMAT "%5.0" AXIS_PTS_REF SNM08ZUUB /end AXIS_DESCR
 /begin AXIS_DESCR COM_AXIS rl rel_ub_q0p75 8 0.00 191.3 FORMAT "%5.1" AXIS_PTS_REF SRL08ZUUB /end AXIS_DESCR
/end CHARACTERISTIC
/begin CHARACTERISTIC KFWZWWL "Wichtung Warmlauf-Z¸ndwinkel ¸ber Drehzahl und Last" MAP 0xFCC02C KfAxUbAyUbSstxUbSstyUbWUb 0.9961 fak_ub_b1 0.00 0.9961
 /begin AXIS_DESCR STD_AXIS nmot nmot_ub_q40 8 0.00 10200. FORMAT "%5.0" DEPOSIT ABSOLUTE /end AXIS_DESCR
 /begin AXIS_DESCR STD_AXIS rl rel_ub_q0p75 8 0.00 191.3 FORMAT "%5.1" DEPOSIT ABSOLUTE /end AXIS_DESCR
/end CHARACTERISTIC
/begin CHARACTERISTIC KFZWDI1 "Kennfeld Z¸ndung Teillast bei DISA Position 1" MAP 0xFCB518 GkfWSb 191.3 zw_sb_q0p75 -96.00 95.25 FORMAT "%5.2"
 /begin AXIS_DESCR COM_AXIS nmot nmot_ub_q40 24 0.00 10200. FORMAT "%5.0" AXIS_PTS_REF SNM24ZUUB1 /end AXIS_DESCR
 /begin AXIS_DESCR COM_AXIS rl rel_ub_q0p75 16 0.00 191.3 FORMAT "%5.1" AXIS_PTS_REF SRL16ZUUB /end AXIS_DESCR
/end CHARACTERISTIC
/begin CHARACTERISTIC KFZWDI2 "Kennfeld Z¸ndung Teillast bei DISA Position 2" MAP 0xFCB698 GkfWSb 191.3 zw_sb_q0p75 -96.00 95.25 FORMAT "%5.2"
 /begin AXIS_DESCR COM_AXIS nmot nmot_ub_q40 24 0.00 10200. FORMAT "%5.0" AXIS_PTS_REF SNM24ZUUB2 /end AXIS_DESCR
 /begin AXIS_DESCR COM_AXIS rl rel_ub_q0p75 16 0.00 191.3 FORMAT "%5.1" AXIS_PTS_REF SRL16ZUUB /end AXIS_DESCR
/end CHARACTERISTIC
/begin CHARACTERISTIC KFZWLL "Z¸ndwinkelkennfeld im Leerlauf" MAP 0xFCB3DC KfAxU8AyU8SstxU8SstyU8WS8 191.3 zw_sb_q0p75 -96.00 95.25 FORMAT "%5.2"
 /begin AXIS_DESCR STD_AXIS nmot nmot_ub_q40 8 0.00 10200. FORMAT "%5.0" DEPOSIT ABSOLUTE /end AXIS_DESCR
 /begin AXIS_DESCR STD_AXIS rl rel_ub_q0p75 5 0.00 191.3 FORMAT "%5.1" DEPOSIT ABSOLUTE /end AXIS_DESCR
/end CHARACTERISTIC
/begin CHARACTERISTIC KFZWMN "Min-Z¸ndwinkel" MAP 0xFCBC94 KfAxUbAyUbSstxUbSstyUbWSb 191.3 zw_sb_q0p75 -96.00 95.25 FORMAT "%5.2"
 /begin AXIS_DESCR STD_AXIS nmot nmot_ub_q40 16 0.00 10200. FORMAT "%5.0" DEPOSIT ABSOLUTE /end AXIS_DESCR
 /begin AXIS_DESCR STD_AXIS rl rel_ub_q0p75 12 0.00 191.3 FORMAT "%5.1" DEPOSIT ABSOLUTE /end AXIS_DESCR
/end CHARACTERISTIC
/begin CHARACTERISTIC KFZWMNKH "Min-Z¸ndwinkel Katheizen" MAP 0xFCBD72 KfAxUbAyUbSstxUbSstyUbWSb 191.3 zw_sb_q0p75 -96.00 95.25 FORMAT "%5.2"
 /begin AXIS_DESCR STD_AXIS nmot nmot_ub_q40 16 0.00 10200. FORMAT "%5.0" DEPOSIT ABSOLUTE /end AXIS_DESCR
 /begin AXIS_DESCR STD_AXIS rl rel_ub_q0p75 12 0.00 191.3 FORMAT "%5.1" DEPOSIT ABSOLUTE /end AXIS_DESCR
/end CHARACTERISTIC
/begin CHARACTERISTIC KFZWMNST "Min-Z¸ndwinkel f¸r Start und Nachstart" MAP 0xFCBE50 KfAxUbAyUbSstxUbSstyUbWSb 191.3 zw_sb_q0p75 -96.00 95.25 FORMAT "%5.2"
 /begin AXIS_DESCR STD_AXIS nmot nmot_ub_q40 16 0.00 10200. FORMAT "%5.0" DEPOSIT ABSOLUTE /end AXIS_DESCR
 /begin AXIS_DESCR STD_AXIS rl rel_ub_q0p75 12 0.00 191.3 FORMAT "%5.1" DEPOSIT ABSOLUTE /end AXIS_DESCR
/end CHARACTERISTIC
/begin CHARACTERISTIC KFZWMNT "Min-Z¸ndwinkel gedrosselt" MAP 0xFCBF2E KfAxUbAyUbSstxUbSstyUbWSb 191.3 zw_sb_q0p75 -96.00 95.25 FORMAT "%5.2"
 /begin AXIS_DESCR STD_AXIS nmot nmot_ub_q40 16 0.00 10200. FORMAT "%5.0" DEPOSIT ABSOLUTE /end AXIS_DESCR
 /begin AXIS_DESCR STD_AXIS rl rel_ub_q0p75 12 0.00 191.3 FORMAT "%5.1" DEPOSIT ABSOLUTE /end AXIS_DESCR
/end CHARACTERISTIC
/begin CHARACTERISTIC KFZWMS "Kennfeld mit dauerhaft sp‰test mˆglichem Z¸ndwinkel" MAP 0xFCBBD4 GkfWSb 191.3 zw_sb_q0p75 -96.00 95.25 FORMAT "%5.2"
 /begin AXIS_DESCR COM_AXIS nmot nmot_ub_q40 16 0.00 10200. FORMAT "%5.0" AXIS_PTS_REF SNM16ZUUB /end AXIS_DESCR
 /begin AXIS_DESCR COM_AXIS rl rel_ub_q0p75 12 0.00 191.3 FORMAT "%5.1" AXIS_PTS_REF SRL12ZUUB /end AXIS_DESCR
/end CHARACTERISTIC
/begin CHARACTERISTIC KFZWSTNMTM "Z¸ndwinkel im Start" MAP 0xFD02FC KfAxUbAyUbSstxUbSstyUbWSb 191.3 zw_sb_q0p75 -96.00 95.25 FORMAT "%5.2"
 /begin AXIS_DESCR STD_AXIS nmot nmot_ub_q40 6 0.00 10200. FORMAT "%5.0" DEPOSIT ABSOLUTE /end AXIS_DESCR
 /begin AXIS_DESCR STD_AXIS tmst temp_ub_q0p75_o48 6 -48.00 143.3 FORMAT "%5.1" DEPOSIT ABSOLUTE /end AXIS_DESCR
/end CHARACTERISTIC
/begin CHARACTERISTIC KFZWVL1 "Vollast - Z¸ndkennfeld bei DISA Position 1" MAP 0xFCB818 GkfWSb 191.3 zw_sb_q0p75 -96.00 95.25 FORMAT "%5.2"
 /begin AXIS_DESCR COM_AXIS nmot nmot_ub_q40 24 0.00 10200. FORMAT "%5.0" AXIS_PTS_REF SNM24ZUUB1 /end AXIS_DESCR
 /begin AXIS_DESCR COM_AXIS rl rel_ub_q0p75 3 0.00 191.3 FORMAT "%5.1" AXIS_PTS_REF SRL03ZUUB /end AXIS_DESCR
/end CHARACTERISTIC
/begin CHARACTERISTIC KFZWVL2 "Vollast - Z¸ndkennfeld bei DISA position 2" MAP 0xFCB860 GkfWSb 191.3 zw_sb_q0p75 -96.00 95.25 FORMAT "%5.2"
 /begin AXIS_DESCR COM_AXIS nmot nmot_ub_q40 24 0.00 10200. FORMAT "%5.0" AXIS_PTS_REF SNM24ZUUB2 /end AXIS_DESCR
 /begin AXIS_DESCR COM_AXIS rl rel_ub_q0p75 3 0.00 191.3 FORMAT "%5.1" AXIS_PTS_REF SRL03ZUUB /end AXIS_DESCR
/end CHARACTERISTIC
/begin CHARACTERISTIC KFZWWLTM "Delta Z¸ndwinkel im Warmlauf" MAP 0xFD032E KfAxUbAyUbSstxUbSstyUbWSb 191.3 zw_sb_q0p75 -96.00 95.25 FORMAT "%5.2"
 /begin AXIS_DESCR STD_AXIS tmot temp_ub_q0p75_o48 12 -48.00 143.3 FORMAT "%5.1" DEPOSIT ABSOLUTE /end AXIS_DESCR
 /begin AXIS_DESCR STD_AXIS tmst temp_ub_q0p75_o48 12 -48.00 143.3 FORMAT "%5.1" DEPOSIT ABSOLUTE /end AXIS_DESCR
/end CHARACTERISTIC
/begin CHARACTERISTIC KFZW_UC "Kennfeld f¸r optimalen Z¸ndwinkel im Befehlstest" MAP 0xFC0A24 GkfWSb 191.3 zw_sb_q0p75 -96.00 95.25 FORMAT "%5.2"
 /begin AXIS_DESCR COM_AXIS rl_uc rel_ub_q0p75 8 0.00 191.3 FORMAT "%5.1" AXIS_PTS_REF MIST_RLV08_UC /end AXIS_DESCR
 /begin AXIS_DESCR COM_AXIS nmot_uc nmot_ub_q40 8 0.00 10200. FORMAT "%5.0" AXIS_PTS_REF MIST_NMV08_UC /end AXIS_DESCR
/end CHARACTERISTIC
/begin CHARACTERISTIC KFZW_UM "Kennfeld f¸r optimalen Z¸ndwinkel in der Funktions¸berwachung" MAP 0xFCC478 GkfWSb 191.3 zw_sb_q0p75 -96.00 95.25 FORMAT "%5.2"
 /begin AXIS_DESCR COM_AXIS rl_um rel_ub_q0p75 8 0.00 191.3 FORMAT "%5.1" AXIS_PTS_REF RLV08_UM /end AXIS_DESCR
 /begin AXIS_DESCR COM_AXIS nmot_um nmot_ub_q40 8 0.00 10200. FORMAT "%5.0" AXIS_PTS_REF NMV08_UM /end AXIS_DESCR
/end CHARACTERISTIC
/begin CHARACTERISTIC KHCTEAMX "Maximalwert HC-Konzentration Regeneriergas Tankentl¸ftung(bei B_abor)" VALUE 0xFCFE2A KwSb 3.984 fak_sb_b2 -2.000 1.984 FORMAT "%5.3" /end CHARACTERISTIC
/begin CHARACTERISTIC KHCTEMN "Minimalwert HC-Konzentration Regeneriergas Tankentl¸ftung" VALUE 0xFCFE2B KwSb 3.984 fak_sb_b2 -2.000 1.984 FORMAT "%5.3" /end CHARACTERISTIC
/begin CHARACTERISTIC KHCTEMX "Maximalwert HC-Konzentration Regeneriergas Tankentl¸ftung" VALUE 0xFCFE2C KwSb 3.984 fak_sb_b2 -2.000 1.984 FORMAT "%5.3" /end CHARACTERISTIC
/begin CHARACTERISTIC KLETAZW_UC "ZW-Wirkungsgrad in Abh‰ngigkeit von delta ZW im Befehlstest" CURVE 0xFC0A64 KlAUbSstUbWUb 100.0 rel_ub_b127p5 0.00 100.0 FORMAT "%5.1"
 /begin AXIS_DESCR STD_AXIS dzw_uc zw_ub_q0p75 8 0.00 191.3 FORMAT "%5.1" DEPOSIT ABSOLUTE /end AXIS_DESCR
/end CHARACTERISTIC
/begin CHARACTERISTIC KLETAZW_UM "ZW-Wirkungsgrad in Abh‰ngigkeit von delta ZW in der Funktions¸berwachung" CURVE 0xFCC4B8 KlAUbSstUbWUb 100.0 rel_ub_b127p5 0.00 100.0 FORMAT "%5.1"
 /begin AXIS_DESCR STD_AXIS dzw_um zw_ub_q0p75 8 0.00 191.3 FORMAT "%5.1" DEPOSIT ABSOLUTE /end AXIS_DESCR
/end CHARACTERISTIC
/begin CHARACTERISTIC KLFGENSLP "imlpr-abh‰ngiger Faktor f¸r Generatorsollspannung bei SLP-Betrieb" CURVE 0xFC9AAC KlAxU8SstxU8WU8 0.9961 fak_ub_b1 0.00 0.9961 /begin AXIS_DESCR STD_AXIS imlpr fak_ub_b1 6 0.00 0.9961 DEPOSIT ABSOLUTE /end AXIS_DESCR /end CHARACTERISTIC
/begin CHARACTERISTIC KLNPED_UC "pedalsollwertabh. Drehzahlbegr. in der DK-Antrieb-Ersatzfunktion; Befehlstest" CURVE 0xFC0D94 KlAUbSstUbWUb 10200. nmot_ub_q40 0.00 10200. FORMAT "%5.0"
 /begin AXIS_DESCR STD_AXIS spsn_uc spg_ub_q0p019 8 0.00 4.845 FORMAT "%5.3" DEPOSIT ABSOLUTE /end AXIS_DESCR
/end CHARACTERISTIC
/begin CHARACTERISTIC KLNPED_UM "pedalsollwertabh. Drehzahlbegrenzung in der DK-Antrieb-Ersatzfunktion, Fkts¸berw" CURVE 0xFCC5B8 KlAUbSstUbWUb 10200. nmot_ub_q40 0.00 10200. FORMAT "%5.0"
 /begin AXIS_DESCR STD_AXIS spsn_um spg_ub_q0p019 8 0.00 4.845 FORMAT "%5.3" DEPOSIT ABSOLUTE /end AXIS_DESCR
/end CHARACTERISTIC
/begin CHARACTERISTIC KLUBATTMAX "batterietemperaturabh. Maximalwert der Generatorsollspannung bei SLP-Betrieb" CURVE 0xFC9A9C KlAxU8SstxU8WU16 16.00000 spg_sw_q0p001 0.00 16.00000 FORMAT "%8.5"
 /begin AXIS_DESCR STD_AXIS tbatt temp_ub_q0p75_o48 4 -48.00 143.3 FORMAT "%5.1" DEPOSIT ABSOLUTE /end AXIS_DESCR
/end CHARACTERISTIC
/begin CHARACTERISTIC KLZZWMNST "KL Zeitkonstante f¸r Abregelung ZW-Begrenzung im Nachstart" CURVE 0xFCC00C KlAUbSstUbWUw 655.34999985 zk10msxs_uw_b655 0.010000152590 655.36000000 FORMAT "%12.8"
 /begin AXIS_DESCR STD_AXIS tmst temp_ub_q0p75_o48 8 -48.00 143.3 FORMAT "%5.1" DEPOSIT ABSOLUTE /end AXIS_DESCR
/end CHARACTERISTIC
/begin CHARACTERISTIC KSZWE "Klopfschutzz¸ndwinkel Ersatzwert bei E_ta v E_tm" VALUE 0xFCBBB8 KwSb 191.3 zw_sb_q0p75 -96.00 95.25 FORMAT "%5.2" /end CHARACTERISTIC
/begin CHARACTERISTIC LAMTEMN "minimale Lambda-Schwelle, bei der die Tankentl¸ftung aktiv sein kann" VALUE 0xFCFF90 KwUw 15.99976 fak_uw_b16 0.00 15.99976 FORMAT "%8.5" /end CHARACTERISTIC
/begin CHARACTERISTIC LAMTEMX "maximale Lambda-Schwelle, bei der die Tankentl¸ftung aktiv sein kann" VALUE 0xFCFF92 KwUw 15.99976 fak_uw_b16 0.00 15.99976 FORMAT "%8.5" /end CHARACTERISTIC
/begin AXIS_PTS MDV08_UC "St¸tzstellenverteilung f¸r Moment im Befehlstest" 0xFC0D10 mz_uc SstAUbSstUb 99.61 rel_ub_b99p6 8 0.00 99.61 FORMAT "%5.2" DEPOSIT ABSOLUTE /end AXIS_PTS
/begin AXIS_PTS MDV08_UM "St¸tzstellenverteilung f¸r Moment in der Funktions¸berwachung" 0xFCC590 mz_um SstAUbSstUb 99.61 rel_ub_b99p6 8 0.00 99.61 FORMAT "%5.2" DEPOSIT ABSOLUTE /end AXIS_PTS
/begin CHARACTERISTIC MIST_NMOT_DAT_UC "" VAL_BLK 0xFC0A78 KwbUb 10200. nmot_ub_q40 0.00 10200. FORMAT "%5.0" NUMBER 16 /end CHARACTERISTIC
/begin AXIS_PTS MIST_NMV08_UC "" 0xFC0A88 nmot_uc SstAUbSstUb 10200. nmot_ub_q40 8 0.00 10200. FORMAT "%5.0" DEPOSIT ABSOLUTE /end AXIS_PTS
/begin AXIS_PTS MIST_RLV08_UC "" 0xFC0A94 rl_uc SstAUbSstUb 191.3 rel_ub_q0p75 8 0.00 191.3 FORMAT "%5.1" DEPOSIT ABSOLUTE /end AXIS_PTS
/begin CHARACTERISTIC MIST_RL_DAT_UC "" VAL_BLK 0xFC0AA0 KwbUb 191.3 rel_ub_q0p75 0.00 191.3 FORMAT "%5.1" NUMBER 16 /end CHARACTERISTIC
/begin CHARACTERISTIC MIST_ZWOUT_DAT_UC "" VAL_BLK 0xFC0AB0 KwbUb 191.3 zw_sb_q0p75 0.00 191.3 FORMAT "%5.1" NUMBER 16 /end CHARACTERISTIC
/begin CHARACTERISTIC MSDKLMMN "minimaler Massenstrom ¸ber Drosselklappe in TE" VALUE 0xFC9BBC KwUw 6553.500 m_uw_b6553p5 0.00 6553.500 FORMAT "%8.3" /end CHARACTERISTIC
/begin CHARACTERISTIC MSRC_ALVOLD_DAT_UC "" VAL_BLK 0xFC0AC4 KwbUb 255.0 dez 0.00 255.0 FORMAT "%5.1" NUMBER 16 /end CHARACTERISTIC
/begin CHARACTERISTIC MSRC_ASCCTR_DAT_UC "" VAL_BLK 0xFC0AD4 KwbUb 255.0 dez 0.00 255.0 FORMAT "%5.1" NUMBER 16 /end CHARACTERISTIC
/begin CHARACTERISTIC MSRC_ASRL_DAT_UC "" VAL_BLK 0xFC0AE4 KwbUb 255.0 dez 0.00 255.0 FORMAT "%5.1" NUMBER 16 /end CHARACTERISTIC
/begin CHARACTERISTIC MSRC_ASRS_DAT_UC "" VAL_BLK 0xFC0AF4 KwbUb 255.0 dez 0.00 255.0 FORMAT "%5.1" NUMBER 16 /end CHARACTERISTIC
/begin CHARACTERISTIC MSRC_C_DAT_UC "" VAL_BLK 0xFC0B04 KwbUb 255.0 dez 0.00 255.0 FORMAT "%5.1" NUMBER 16 /end CHARACTERISTIC
/begin CHARACTERISTIC MSRC_MDMSR_DAT_UC "" VAL_BLK 0xFC0B14 KwbUb 255.0 dez 0.00 255.0 FORMAT "%5.1" NUMBER 16 /end CHARACTERISTIC
/begin CHARACTERISTIC MSRC_SBIT_DAT_UC "" VAL_BLK 0xFC0B24 KwbUb 255.0 dez 0.00 255.0 FORMAT "%5.1" NUMBER 16 /end CHARACTERISTIC
/begin CHARACTERISTIC MSRC_T_UC "Fehlerzeit f¸r MSR-Eingriff-‹berwachung des Befehlstests" VALUE 0xFC0B34 KwUb 10200.0 t40ms_ub_b10200 0.00 10200.0 FORMAT "%7.1" /end CHARACTERISTIC
/begin CHARACTERISTIC MSRC_T_UM "Fehlerzeit f¸r MSR-Eingriff-‹berwachung der Funktions¸berwachung" VALUE 0xFCC4CB KwUb 10200.0 t40ms_ub_b10200 0.00 10200.0 FORMAT "%7.1" /end CHARACTERISTIC
/begin CHARACTERISTIC MVER_C_DAT_UC "" VAL_BLK 0xFC0B38 KwbUb 255.0 dez 0.00 255.0 FORMAT "%5.1" NUMBER 16 /end CHARACTERISTIC
/begin CHARACTERISTIC MVER_MI_DAT_UC "" VAL_BLK 0xFC0B48 KwbUb 255.0 dez 0.00 255.0 FORMAT "%5.1" NUMBER 16 /end CHARACTERISTIC
/begin CHARACTERISTIC MVER_MZF_DAT_UC "" VAL_BLK 0xFC0B58 KwbUb 255.0 dez 0.00 255.0 FORMAT "%5.1" NUMBER 16 /end CHARACTERISTIC
/begin CHARACTERISTIC MVER_MZO_DAT_UC "" VAL_BLK 0xFC0B68 KwbUb 255.0 dez 0.00 255.0 FORMAT "%5.1" NUMBER 16 /end CHARACTERISTIC
/begin CHARACTERISTIC MVER_RFLAGS_DAT_UC "" VAL_BLK 0xFC0B78 KwbUb 255.0 dez 0.00 255.0 FORMAT "%5.1" NUMBER 16 /end CHARACTERISTIC
/begin CHARACTERISTIC MVER_T_UC "Fehlerzeit beim Momentenvergleich im Befehlstest" VALUE 0xFC0B88 KwUb 10200.0 t40ms_ub_b10200 0.00 10200.0 FORMAT "%7.1" /end CHARACTERISTIC
/begin CHARACTERISTIC MVER_T_UM "Fehlerzeit beim Momentenvergleich in der Funktions¸berwachung" VALUE 0xFCC4CC KwUb 10200.0 t40ms_ub_b10200 0.00 10200.0 FORMAT "%7.1" /end CHARACTERISTIC
/begin CHARACTERISTIC MZFFIL_UC "Filter-Zeitkonstante f¸r verzˆgertes Moment im Befehlstest" VALUE 0xFC0B8C KwUb 10159.4 zk40ms_ub_b10200 40.6299 10200.0 FORMAT "%7.1" /end CHARACTERISTIC
/begin CHARACTERISTIC MZFFIL_UM "Filter-Zeitkonstante f¸r verzˆgertes Moment in der Funktions¸berwachung" VALUE 0xFCC4CD KwUb 10159.4 zk40ms_ub_b10200 40.6299 10200.0 FORMAT "%7.1" /end CHARACTERISTIC
/begin CHARACTERISTIC MZFTV_UC "Verzugszeit f¸r zul‰ssiges Moment mz_um im Befehlstest" VALUE 0xFC0B8D KwUb 280.000 t40ms_ub_b10200 40.0000 320.000 FORMAT "%7.3" /end CHARACTERISTIC
/begin CHARACTERISTIC MZFTV_UM "Verzugszeit f¸r zul‰ssiges Moment mz_um in der Funktions¸berwachg" VALUE 0xFCC4CE KwUb 280.000 t40ms_ub_b10200 40.0000 320.000 FORMAT "%7.3" /end CHARACTERISTIC
/begin CHARACTERISTIC MZF_LOW_DAT_UC "" VAL_BLK 0xFC0B90 KwbUb 0.3891 rel_ub_q0p00153 0.00 0.3891 NUMBER 16 /end CHARACTERISTIC
/begin CHARACTERISTIC MZF_MZF_DAT_UC "" VAL_BLK 0xFC0BA0 KwbUb 99.61 rel_ub_q0p3906 0.00 99.61 FORMAT "%5.2" NUMBER 16 /end CHARACTERISTIC
/begin CHARACTERISTIC MZF_MZ_DAT_UC "" VAL_BLK 0xFC0BB0 KwbUb 99.61 rel_ub_q0p3906 0.00 99.61 FORMAT "%5.2" NUMBER 16 /end CHARACTERISTIC
/begin CHARACTERISTIC MZF_PTR_DAT_UC "" VAL_BLK 0xFC0BC0 KwbUb 255.0 dez 0.00 255.0 FORMAT "%5.1" NUMBER 16 /end CHARACTERISTIC
/begin CHARACTERISTIC MZF_REG_DAT_UC "" MAP 0xFC0BD0 KfWUb 255.0 dez 0.00 255.0 FORMAT "%5.1"
 /begin AXIS_DESCR FIX_AXIS mzf_x_uc dez 16 0.00 15.00 FORMAT "%5.2" FIX_AXIS_PAR 0 0 16 /end AXIS_DESCR
 /begin AXIS_DESCR FIX_AXIS mzf_y_uc dez 8 0.00 7.000 FORMAT "%5.3" FIX_AXIS_PAR 0 0 8 /end AXIS_DESCR
/end CHARACTERISTIC
/begin CHARACTERISTIC MZUL_MFGR_DAT_UC "" VAL_BLK 0xFC0D1C KwbUb 99.61 rel_ub_q0p3906 0.00 99.61 FORMAT "%5.2" NUMBER 16 /end CHARACTERISTIC
/begin CHARACTERISTIC MZUL_MMSR_DAT_UC "" VAL_BLK 0xFC0D2C KwbUb 99.61 rel_ub_q0p3906 0.00 99.61 FORMAT "%5.2" NUMBER 16 /end CHARACTERISTIC
/begin CHARACTERISTIC MZUL_MSGS_DAT_UC "" VAL_BLK 0xFC0D3C KwbUb 99.61 rel_ub_q0p3906 0.00 99.61 FORMAT "%5.2" NUMBER 16 /end CHARACTERISTIC
/begin CHARACTERISTIC MZUL_NFLAGS_DAT_UC "" VAL_BLK 0xFC0D4C KwbUb 255.0 dez 0.00 255.0 FORMAT "%5.1" NUMBER 16 /end CHARACTERISTIC
/begin CHARACTERISTIC MZUL_NMOT_DAT_UC "" VAL_BLK 0xFC0D5C KwbUb 10200. nmot_ub_q40 0.00 10200. FORMAT "%5.0" NUMBER 16 /end CHARACTERISTIC
/begin AXIS_PTS MZUL_NMV08_UC "" 0xFC0D6C nmot_uc SstAUbSstUb 10200. nmot_ub_q40 8 0.00 10200. FORMAT "%5.0" DEPOSIT ABSOLUTE /end AXIS_PTS
/begin AXIS_PTS MZUL_SPSNV08_UC "" 0xFC0D78 spsn_uc SstAUbSstUb 4.845 spg_ub_q0p019 8 0.00 4.845 FORMAT "%5.3" DEPOSIT ABSOLUTE /end AXIS_PTS
/begin CHARACTERISTIC MZUL_SPSN_DAT_UC "" VAL_BLK 0xFC0D84 KwbUb 4.845 spg_ub_q0p019 0.00 4.845 FORMAT "%5.3" NUMBER 16 /end CHARACTERISTIC
/begin CHARACTERISTIC NACHANZ "" VALUE 0xFCB2D5 KwUb 255.0 dez 0.00 255.0 FORMAT "%5.1" /end CHARACTERISTIC
/begin CHARACTERISTIC NC_T_UM "Fehlertoleranzzeit f¸r Motordrehzahl¸berwachung f¸r Funktions¸berwachung" VALUE 0xFCC59C KwUb 10200.0 t40ms_ub_b10200 0.00 10200.0 FORMAT "%7.1" /end CHARACTERISTIC
/begin CHARACTERISTIC NDIFFO_UM "obere erlaubte Differenz zwischen nmot und nseg_um in der Funktions¸berwachung" VALUE 0xFCC59D KwUb 10200. nmot_ub_q40 0.00 10200. FORMAT "%5.0" /end CHARACTERISTIC
/begin CHARACTERISTIC NDIFFU_UM "untere erlaubte Differenz zwischen nmot und nseg_um in der Funktions¸berwachung" VALUE 0xFCC59E KwUb 10200. nmot_ub_q40 0.00 10200. FORMAT "%5.0" /end CHARACTERISTIC
/begin CHARACTERISTIC NKLO "Drehzahl - Klopfschutzschwelle" VALUE 0xFCB8A8 KwUb 10200. nmot_ub_q40 0.00 10200. FORMAT "%5.0" /end CHARACTERISTIC
/begin CHARACTERISTIC NMINVMX "Minimale Drehzahlschwelle zur VMAX-Regelung" VALUE 0xFC8394 KwUb 10200. nmot_ub_q40 0.00 10200. FORMAT "%5.0" /end CHARACTERISTIC
/begin CHARACTERISTIC NMIN_UM "minimale Drehzahl f¸r Motordrehzahl¸berwachung der Funktions¸berwachung" VALUE 0xFCC59F KwUb 10200. nmot_ub_q40 0.00 10200. FORMAT "%5.0" /end CHARACTERISTIC
/begin AXIS_PTS NMV08_UM "St¸tzstellenverteilung f¸r Motordrehzahl in der Funktions¸berwachung" 0xFCC5A0 nmot_um SstAUbSstUb 10200. nmot_ub_q40 8 0.00 10200. FORMAT "%5.0" DEPOSIT ABSOLUTE /end AXIS_PTS
/begin CHARACTERISTIC NRLIP_UM "Motordrehzahl-Schwelle f¸r den rl/rlip-Vergleich in der Funktions¸berwachg" VALUE 0xFCC622 KwUb 10200. nmot_ub_q40 0.00 10200. FORMAT "%5.0" /end CHARACTERISTIC
/begin CHARACTERISTIC NSC_T_UM "Nachstart¸berwachungszeit f¸r die Funktions¸berwachung" VALUE 0xFCC5B4 KwUw 2621.400 t40msxs_uw_q0p04 0.00 2621.400 FORMAT "%8.3" /end CHARACTERISTIC
/begin CHARACTERISTIC NSEGMAX_UM "Maximaldrehzahl in der Funktions¸berwachung" VALUE 0xFCC5A9 KwUb 10200. nmot_ub_q40 0.00 10200. FORMAT "%5.0" /end CHARACTERISTIC
/begin CHARACTERISTIC NSOF_T_UM "Entprellzeit f¸r Abschaltung der Nachstartaufweitung" VALUE 0xFCC5AE KwUb 10200.0 t40ms_ub_b10200 0.00 10200.0 FORMAT "%7.1" /end CHARACTERISTIC
/begin CHARACTERISTIC NTSCHW_UM "Drehzahlschwelle zur Umschaltung der erlaubten Toleranz in %UFNC der FU" VALUE 0xFCC5AA KwUb 10200. nmot_ub_q40 0.00 10200. FORMAT "%5.0" /end CHARACTERISTIC
/begin CHARACTERISTIC NVERZMN "minimale Drehzahl f¸r Verzˆgerung" VALUE 0xFC9BBE KwUw 16383.75 nmot_uw_q0p25 0.00 16383.75 FORMAT "%8.2" /end CHARACTERISTIC
/begin CHARACTERISTIC NZMAX_UM "Maximale Drehzahl aus Zahnz‰hlerberechnung bei fehlendem Synchro in der FU" VALUE 0xFCC71A KwUb 10200.0 t40ms_ub_b10200 0.00 10200.0 FORMAT "%7.1" /end CHARACTERISTIC
/begin CHARACTERISTIC N_START_UM "Motordrehzahlschwelle f¸r Unterdrehzahl-Ausstieg f¸r die Fkt.-‹berwachung" VALUE 0xFCC5AF KwUb 10200. nmot_ub_q40 0.00 10200. FORMAT "%5.0" /end CHARACTERISTIC
/begin CHARACTERISTIC N_STEND_UM "Motordrehzahlschwelle f¸r Startende in der Fkt.-‹berwachung" VALUE 0xFCC5B0 KwUb 10200. nmot_ub_q40 0.00 10200. FORMAT "%5.0" /end CHARACTERISTIC
/begin CHARACTERISTIC REAC_C1_DAT_UC "" VAL_BLK 0xFC0DA8 KwbUb 255.0 dez 0.00 255.0 FORMAT "%5.1" NUMBER 16 /end CHARACTERISTIC
/begin CHARACTERISTIC REAC_C2_DAT_UC "" VAL_BLK 0xFC0DB8 KwbUb 255.0 dez 0.00 255.0 FORMAT "%5.1" NUMBER 16 /end CHARACTERISTIC
/begin CHARACTERISTIC REAC_EVZAUS_DAT_UC "" VAL_BLK 0xFC0DC8 KwbUb 255.0 dez 0.00 255.0 FORMAT "%5.1" NUMBER 16 /end CHARACTERISTIC
/begin CHARACTERISTIC REAC_FUELA_DATH_UC "" VAL_BLK 0xFC0E0C KwbUw 4095.938 vfzg_uw_q0p0625 0.00 4095.938 FORMAT "%8.3" NUMBER 16 /end CHARACTERISTIC
/begin CHARACTERISTIC REAC_FUELA_DATL_UC "" VAL_BLK 0xFC0E2C KwbUw 4095.938 vfzg_uw_q0p0625 0.00 4095.938 FORMAT "%8.3" NUMBER 16 /end CHARACTERISTIC
/begin CHARACTERISTIC REAC_FUEL_DATH_UC "" VAL_BLK 0xFC0E4C KwbUw 4095.938 vfzg_uw_q0p0625 0.00 4095.938 FORMAT "%8.3" NUMBER 16 /end CHARACTERISTIC
/begin CHARACTERISTIC REAC_FUEL_DATL_UC "" VAL_BLK 0xFC0E6C KwbUw 4095.938 vfzg_uw_q0p0625 0.00 4095.938 FORMAT "%8.3" NUMBER 16 /end CHARACTERISTIC
/begin CHARACTERISTIC REAC_NMOT_DAT_UC "" VAL_BLK 0xFC0DD8 KwbUb 10200. nmot_ub_q40 0.00 10200. FORMAT "%5.0" NUMBER 16 /end CHARACTERISTIC
/begin CHARACTERISTIC REAC_RFLAGS_DAT_UC "" VAL_BLK 0xFC0DE8 KwbUb 255.0 dez 0.00 255.0 FORMAT "%5.1" NUMBER 16 /end CHARACTERISTIC
/begin CHARACTERISTIC REAC_SPSN_DAT_UC "" VAL_BLK 0xFC0DF8 KwbUb 4.845 spg_ub_q0p019 0.00 4.845 FORMAT "%5.3" NUMBER 16 /end CHARACTERISTIC
/begin CHARACTERISTIC REAC_T1_UC "Fehlerzeit bei der Funktions-Fehlerreaktions¸berwachung im Befehlstest" VALUE 0xFC0E08 KwUb 10200.0 t40ms_ub_b10200 0.00 10200.0 FORMAT "%7.1" /end CHARACTERISTIC
/begin CHARACTERISTIC REAC_T1_UM "Fehlerzeit bei der Funktions-Fehlerreaktions¸berwachung in der Funktions¸berw." VALUE 0xFCC5C9 KwUb 10200.0 t40ms_ub_b10200 0.00 10200.0 FORMAT "%7.1" /end CHARACTERISTIC
/begin CHARACTERISTIC REAC_T2_UC "Fehlerzeit bei der Funktions¸berwachungs-Fehlerreaktions¸berw. im Befehlstest" VALUE 0xFC0E09 KwUb 10200.0 t40ms_ub_b10200 0.00 10200.0 FORMAT "%7.1" /end CHARACTERISTIC
/begin CHARACTERISTIC REAC_T2_UM "Fehlerzeit bei der Funktions¸berwachungs-Fehlerreaktions¸berwachung" VALUE 0xFCC5CA KwUb 10200.0 t40ms_ub_b10200 0.00 10200.0 FORMAT "%7.1" /end CHARACTERISTIC
/begin CHARACTERISTIC RLC_T_UM "Fehlertoleranzzeit f¸r den rl-Vergleich mit der Funktion in der Funktions¸berw." VALUE 0xFCC623 KwUb 10200.0 t40ms_ub_b10200 0.00 10200.0 FORMAT "%7.1" /end CHARACTERISTIC
/begin CHARACTERISTIC RLIPFIL_UM "Filter-Zeitkonstante f¸r verzˆgerte Lastinfo rlipt_um in d. Funktions¸berwachung" VALUE 0xFCC624 KwUb 10159.4 zk40ms_ub_b10200 40.6299 10200.0 FORMAT "%7.1" /end CHARACTERISTIC
/begin CHARACTERISTIC RLIPTV_UM "Verzugszeit f¸r Lastinformation rlip_um in der Funktions¸berwachung" VALUE 0xFCC625 KwUb 280.000 t40ms_ub_b10200 40.0000 320.000 FORMAT "%7.3" /end CHARACTERISTIC
/begin CHARACTERISTIC RLIP_T_UM "Fehlertoleranzzeit f¸r den rl/rlip-Vergleich in der Funktions¸berwachg" VALUE 0xFCC626 KwUb 10200.0 t40ms_ub_b10200 0.00 10200.0 FORMAT "%7.1" /end CHARACTERISTIC
/begin CHARACTERISTIC RLKL "Lastsignal rl - Schwelle f¸r Klopfschutz" VALUE 0xFCB8A9 KwUb 191.3 rel_ub_q0p75 0.00 191.3 FORMAT "%5.1" /end CHARACTERISTIC
/begin AXIS_PTS RLV08_UM "Stutzstellenverteilung f¸r Lastinfo in der Funktions¸berwachung" 0xFCC628 rl_um SstAUbSstUb 191.3 rel_ub_q0p75 8 0.00 191.3 FORMAT "%5.1" DEPOSIT ABSOLUTE /end AXIS_PTS
/begin CHARACTERISTIC RL_BO_UM "Offset f¸r Toleranzgerade f(rl_um) f¸r rlipf_um in der Funktions¸berwachung" VALUE 0xFCC631 KwUb 191.3 rel_ub_q0p75 0.00 191.3 FORMAT "%5.1" /end CHARACTERISTIC
/begin CHARACTERISTIC RL_MO_UM "Steigung f¸r Toleranzgerade f(rl_um) f¸r rlipf_um in der Funktions¸berwachung" VALUE 0xFCC632 KwUb 255.0 dez 0.00 255.0 FORMAT "%5.1" /end CHARACTERISTIC
/begin CHARACTERISTIC ROMRSTA_UM "maximale Anzahl Resets bei Fehlererkennung im ROM-Check in der Initialisierung" VALUE 0xFCC718 KwUb 255.0 dez 0.00 255.0 FORMAT "%5.1" /end CHARACTERISTIC
/begin CHARACTERISTIC RoutingAddrTable_cu8 "" VAL_BLK 0xFC0890 KwbWU8 255.0 dez 0.00 255.0 FORMAT "%5.1" NUMBER 256 /end CHARACTERISTIC
/begin CHARACTERISTIC RoutingTableHeader_cu8 "" VAL_BLK 0xFC0870 KwbWU8 255.0 dez 0.00 255.0 FORMAT "%5.1" NUMBER 30 /end CHARACTERISTIC
/begin AXIS_PTS SBF02MFSB "" 0xFC8398 bfzglf SstAUbSstSb 55.34 bfzg_sb_q0p217 4 -27.78 27.56 FORMAT "%5.2" DEPOSIT ABSOLUTE /end AXIS_PTS
/begin AXIS_PTS SFR08TEUB "frmit abh‰ngige St¸tzstellen (Anzahl 8)" 0xFCC824 frmit SstAUbSstUb 1.992 fak_ub_b2 8 0.00 1.992 FORMAT "%5.3" DEPOSIT ABSOLUTE /end AXIS_PTS
/begin CHARACTERISTIC SGSC_MSGS_DAT_UC "" VAL_BLK 0xFC0E8C KwbUb 99.61 rel_ub_b99p6 0.00 99.61 FORMAT "%5.2" NUMBER 16 /end CHARACTERISTIC
/begin CHARACTERISTIC SKADRHZ_UC "Motorgrenzdrehzahl f¸r komplette Einspritzausblendung bei SKA in Befehlstest" VALUE 0xFC0E0A KwUb 10200. nmot_ub_q40 0.00 10200. FORMAT "%5.0" /end CHARACTERISTIC
/begin CHARACTERISTIC SKADRHZ_UM "Motorgrenzdrehzahl f¸r komplette Einspritzausblendung bei SKA" VALUE 0xFCC5CB KwUb 10200. nmot_ub_q40 0.00 10200. FORMAT "%5.0" /end CHARACTERISTIC
/begin AXIS_PTS SML08TEUB "ml abh‰ngige St¸tzstellen (Anzahl 8)" 0xFCC83C ml SstAUbSstUb 1020. m_ub_b1020 8 0.00 1020. FORMAT "%5.0" DEPOSIT ABSOLUTE /end AXIS_PTS
/begin AXIS_PTS SNM08ZUUB "St¸tzstellenverteilung Drehzahl, 8 Sst." 0xFC0FDC nmot SstAUbSstUb 10200. nmot_ub_q40 8 0.00 10200. FORMAT "%5.0" DEPOSIT ABSOLUTE /end AXIS_PTS
/begin AXIS_PTS SNM08__UB "St¸tzstellenverteilung Drehzahl, 8 Sst." 0xFC0FE8 nmot SstAUbSstUb 10200. nmot_ub_q40 8 0.00 10200. FORMAT "%5.0" DEPOSIT ABSOLUTE /end AXIS_PTS
/begin AXIS_PTS SNM16ZUUB "St¸tzstellenverteilung Drehzahl, 16 Sst." 0xFC1014 nmot SstAUbSstUb 10200. nmot_ub_q40 16 0.00 10200. FORMAT "%5.0" DEPOSIT ABSOLUTE /end AXIS_PTS
/begin AXIS_PTS SNM24ZUUB "St¸tzstellenverteilung Drehzahl, 24 Sst." 0xFC1028 nmot SstAUbSstUb 10200. nmot_ub_q40 24 0.00 10200. FORMAT "%5.0" DEPOSIT ABSOLUTE /end AXIS_PTS
/begin AXIS_PTS SNM24ZUUB1 "St¸tzstellenverteilung Drehzahl, 24 Sst." 0xFC1044 nmot SstAUbSstUb 10200. nmot_ub_q40 24 0.00 10200. FORMAT "%5.0" DEPOSIT ABSOLUTE /end AXIS_PTS
/begin AXIS_PTS SNM24ZUUB2 "St¸tzstellenverteilung Drehzahl, 24 Sst." 0xFC1060 nmot SstAUbSstUb 10200. nmot_ub_q40 24 0.00 10200. FORMAT "%5.0" DEPOSIT ABSOLUTE /end AXIS_PTS
/begin CHARACTERISTIC SP12LL_UM "maximale Differenz zwischen SP1S und SP2S unterhalb der Vollgas-Schwelle" VALUE 0xFCC634 KwUb 4.845 spg_ub_q0p019 0.00 4.845 FORMAT "%5.3" /end CHARACTERISTIC
/begin CHARACTERISTIC SP12VG_UM "maximale Differenz zwischen SP1S und SP2S oberhalb der Vollgas-Schwelle" VALUE 0xFCC635 KwUb 4.845 spg_ub_q0p019 0.00 4.845 FORMAT "%5.3" /end CHARACTERISTIC
/begin CHARACTERISTIC SPSC_MINUM "= SPSC_MIN_UM Pedal-Leergas-Grenze f¸r die Funktions¸berwachung" VALUE 0xFCC636 KwUb 4.845 spg_ub_q0p019 0.00 4.845 FORMAT "%5.3" /end CHARACTERISTIC
/begin CHARACTERISTIC SPSC_T_UM "Fehlerzeit bei zueinander unplausiblen Sollwerten in der Funktions¸berwachung" VALUE 0xFCC637 KwUb 10200.0 t40ms_ub_b10200 0.00 10200.0 FORMAT "%7.1" /end CHARACTERISTIC
/begin AXIS_PTS SPSNV08_UM "St¸tzstellenverteilung f¸r Pedalwert in der Funktions¸berwachung" 0xFCC638 spsn_um SstAUbSstUb 4.845 spg_ub_q0p019 8 0.00 4.845 FORMAT "%5.3" DEPOSIT ABSOLUTE /end AXIS_PTS
/begin CHARACTERISTIC SPSVG_UM "Vollgas-Sollwert-Schwelle zur Umschaltung der maximalen Differenz SP1S-SP2S" VALUE 0xFCC641 KwUb 4.845 spg_ub_q0p019 0.00 4.845 FORMAT "%5.3" /end CHARACTERISTIC
/begin AXIS_PTS SQM05TEUB "Luftmassenquotient-abh‰ngige St¸tzstellen (Anzahl =5)" 0xFC107C qmsdyn SstAUbSstUb 15.94 fak_ub_b16 5 0.00 15.94 FORMAT "%5.2" DEPOSIT ABSOLUTE /end AXIS_PTS
/begin AXIS_PTS SRL03MFUW "" 0xFC83A2 rl_w SstAUwSstUw 1535.977 rel_uw_q0p0234 4 0.00 1535.977 FORMAT "%8.3" DEPOSIT ABSOLUTE /end AXIS_PTS
/begin AXIS_PTS SRL03ZUUB "St¸tzstellenverteilung relative F¸llung, 3 Sst." 0xFC1084 rl SstAUbSstUb 191.3 rel_ub_q0p75 3 0.00 191.3 FORMAT "%5.1" DEPOSIT ABSOLUTE /end AXIS_PTS
/begin AXIS_PTS SRL08ZUUB "St¸tzstellenverteilung relative F¸llung, 8 Sst." 0xFC10B0 rl SstAUbSstUb 191.3 rel_ub_q0p75 8 0.00 191.3 FORMAT "%5.1" DEPOSIT ABSOLUTE /end AXIS_PTS
/begin AXIS_PTS SRL12ZUUB "St¸tzstellenverteilung relative Luftf¸llung, 12 St." 0xFC10CC rl SstAUbSstUb 191.3 rel_ub_q0p75 12 0.00 191.3 FORMAT "%5.1" DEPOSIT ABSOLUTE /end AXIS_PTS
/begin AXIS_PTS SRL16ZUUB "St¸tzstellenverteilung relative F¸llung, 16 Sst." 0xFC10DC rl SstAUbSstUb 191.3 rel_ub_q0p75 16 0.00 191.3 FORMAT "%5.1" DEPOSIT ABSOLUTE /end AXIS_PTS
/begin AXIS_PTS STM06__UB "St¸tzstellenverteilung Motortemperatur, 6 Sst." 0xFCC8D4 tmot SstAUbSstUb 191.3 temp_ub_q0p75_o48 6 -48.00 143.3 FORMAT "%5.1" DEPOSIT ABSOLUTE /end AXIS_PTS
/begin CHARACTERISTIC S_ENGENSLP "Codewort zum Freischalten der Generatorsollspannung bei SLP-Betrieb" VALUE 0xFC9ACB KwWU8 255.0 DEZ 0.00 255.0 FORMAT "%5.1" /end CHARACTERISTIC
/begin CHARACTERISTIC S_GOFFRAMP "" VALUE 0xFC9ACC KwWU8 255.0 dez 0.00 255.0 FORMAT "%5.1" /end CHARACTERISTIC
/begin CHARACTERISTIC S_KRZWSOL "" VALUE 0xFCB2D6 KwUb 255.0 dez 0.00 255.0 FORMAT "%5.1" /end CHARACTERISTIC
/begin CHARACTERISTIC TADEZW "Ersatzwert bei Tans-Fehler" VALUE 0xFCB414 KwWU8 191.3 temp_ub_q0p75_o48 -48.00 143.3 FORMAT "%5.1" /end CHARACTERISTIC
/begin CHARACTERISTIC TANSMN_UM "Ansauglufttemperaturschwelle zur Nachstartaufweitung in der Fkt.-‹berwachung" VALUE 0xFCC5B1 KwUb 191.3 temp_ub_q0p75_o48 -48.00 143.3 FORMAT "%5.1" /end CHARACTERISTIC
/begin CHARACTERISTIC TDIFMX_UM "Maximale Abweichung der Summe von Zeitdifferenzen zw. TPU u. CPU in der FU" VALUE 0xFCC722 KwUw 26.21400 txms_uw_q0p0004 0.00 26.21400 FORMAT "%8.5" /end CHARACTERISTIC
/begin CHARACTERISTIC TFTEINI "Zeit f¸r Erkennung TE Stop" VALUE 0xFC9BC0 KwUw 6553.500 t100msxs_uw_b6553p5 0.00 6553.500 FORMAT "%8.3" /end CHARACTERISTIC
/begin CHARACTERISTIC TMDEZW "Ersatzwert bei Tmot-Fehler" VALUE 0xFCB415 KwWU8 191.3 temp_ub_q0p75_o48 -48.00 143.3 FORMAT "%5.1" /end CHARACTERISTIC
/begin CHARACTERISTIC TMNSMN_UM "Motortemperaturschwelle f¸r die Nachstartaufweitung in der FKT.-‹berwachung" VALUE 0xFCC5B2 KwUb 191.3 temp_ub_q0p75_o48 -48.00 143.3 FORMAT "%5.1" /end CHARACTERISTIC
/begin CHARACTERISTIC TMSTTE "Starttemperaturschwelle, bei der die TE sofort aktiv werden kann" VALUE 0xFCFF8D KwUb 191.3 temp_ub_q0p75_o48 -48.00 143.3 FORMAT "%5.1" /end CHARACTERISTIC
/begin CHARACTERISTIC TMTE "TMOT - Schwelle f¸r Tankentl¸ftung" VALUE 0xFCFF8E KwUb 191.3 temp_ub_q0p75_o48 -48.00 143.3 FORMAT "%5.1" /end CHARACTERISTIC
/begin CHARACTERISTIC TPUCA_T_UM "Zeitlicher Abstand der zyklischen Aktivierung der TPU-Pr¸fung in der FU" VALUE 0xFCC71B KwUb 2550.00 t10ms_ub_b2550 0.00 2550.00 /end CHARACTERISTIC
/begin CHARACTERISTIC TPUCR_T_UM "Fehlerzeit des TPU-Code-RAM-Tests in der Funktions¸berwachung" VALUE 0xFCC71C KwUb 255.0 dez 0.00 255.0 FORMAT "%5.1" /end CHARACTERISTIC
/begin CHARACTERISTIC TPURA_T_UM "Zeitlicher Abstand der zyklischen Aktivierung des TPU-Code-RAM-Tests in der FU" VALUE 0xFCC71D KwUb 2550.00 t10ms_ub_b2550 0.00 2550.00 /end CHARACTERISTIC
/begin CHARACTERISTIC TPURSTA_UM "Maximale Anzahl von Resets aus der TPU-‹berwachung" VALUE 0xFCC71E KwUb 255.0 dez 0.00 255.0 FORMAT "%5.1" /end CHARACTERISTIC
/begin CHARACTERISTIC TPUST_T_UM "Zeitverzˆgerung nach Synchro zur Aktivierung der TPU-‹berwachung" VALUE 0xFCC71F KwUb 2550.00 t10ms_ub_b2550 0.00 2550.00 /end CHARACTERISTIC
/begin CHARACTERISTIC TPU_T_UM "Fehlerzeit der TPU-‹berwachung in der Funktions¸berwachung" VALUE 0xFCC720 KwUb 255.0 dez 0.00 255.0 FORMAT "%5.1" /end CHARACTERISTIC
/begin CHARACTERISTIC TQTEAB "Zeit f¸r Absteuerung Sp¸lrate Tankentl¸ftung" VALUE 0xFC9B84 KwUb 81.28 t20msxs_ub_q0p32 0.3200 81.60 FORMAT "%5.2" /end CHARACTERISTIC
/begin CHARACTERISTIC TQTEDAB "Zeit f¸r schnelle Absteuerung Sp¸lrate Tankentl¸ftung" VALUE 0xFC9B85 KwUb 81.28 t20msxs_ub_q0p32 0.3200 81.60 FORMAT "%5.2" /end CHARACTERISTIC
/begin CHARACTERISTIC TSEGMIN_UM "Minimale Segmentzeit in der Drehzahlberechnung mit Segmentzeiten in der FU" VALUE 0xFCC5AC KwUw 26.21400 txms_uw_q0p0004 0.00 26.21400 FORMAT "%8.5" /end CHARACTERISTIC
/begin CHARACTERISTIC TSUB "Schliesszeit" CURVE 0xFCB2DA FklWU16 65.53500 txms_uw_q0p001 0.00 65.53500 FORMAT "%8.5"
 /begin AXIS_DESCR FIX_AXIS ub spg_ubatt 128 0.00 23.93 FORMAT "%5.2" FIX_AXIS_PAR 0 1 128 /end AXIS_DESCR
/end CHARACTERISTIC
/begin CHARACTERISTIC TTEAUS "Zeit nach Start bis TEB aktiv wird" VALUE 0xFCFF94 KwUw 195.0000 t100msxs_uw_q100 5.000000 200.0000 FORMAT "%8.4" /end CHARACTERISTIC
/begin CHARACTERISTIC TUETM "Zeit¸bertemperatur nach Start" VALUE 0xFC202E KwUw 655.3500 t_q0p01 0.00 655.3500 FORMAT "%8.4" /end CHARACTERISTIC
/begin CHARACTERISTIC TVMXPR "Geschwindigkeit-Pr‰diktionshorizont f¸r VMAX-Regelung" VALUE 0xFC839D KwUb 2.550 t10msxs_ub_b2p55 0.00 2.550 FORMAT "%5.3" /end CHARACTERISTIC
/begin CHARACTERISTIC TVSATEM "Verzˆgerungszeit f¸r TEV zu nach SA-Bereitschaft" CURVE 0xFC9B88 KlAUbSstUbWUb 5.100 t20msxs_ub_b5p1 0.00 5.100 FORMAT "%5.3"
 /begin AXIS_DESCR STD_AXIS tmot temp_ub_q0p75_o48 6 -48.00 143.3 FORMAT "%5.1" DEPOSIT ABSOLUTE /end AXIS_DESCR
/end CHARACTERISTIC
/begin CHARACTERISTIC TVZWMSA "Zeit bis zum ‹bergehen auf Dauersp‰tbegrenzung" VALUE 0xFCC026 KwUw 655.3500 t10msxs_uw_b655p35 0.00 655.3500 FORMAT "%8.4" /end CHARACTERISTIC
/begin CHARACTERISTIC TVZWMSE "Zeit bis zum ‹bergehen auf Dynamiksp‰tbegrenzung" VALUE 0xFCC028 KwUw 655.3500 t10msxs_uw_b655p35 0.00 655.3500 FORMAT "%8.4" /end CHARACTERISTIC
/begin CHARACTERISTIC UETMOT "Motor¸bertemperatur-Schwelle" VALUE 0xFC202D KwUb 191.3 temp_ub_q0p75_o48 -48.00 143.3 FORMAT "%5.1" /end CHARACTERISTIC
/begin CHARACTERISTIC UGENOFF "" VALUE 0xFC9AC4 KwWU16 16.00000 spg_sw_q0p001 0.00 16.00000 FORMAT "%8.5" /end CHARACTERISTIC
/begin CHARACTERISTIC UGENOFFV0 "" VALUE 0xFC9AC6 KwWU16 16.00000 spg_sw_q0p001 0.00 16.00000 FORMAT "%8.5" /end CHARACTERISTIC
/begin CHARACTERISTIC U_GENSLP "Generatorsollspannung bei SLP-Betrieb" VALUE 0xFC9AC8 KwWU16 16.00000 spg_sw_q0p001 0.00 16.00000 FORMAT "%8.5" /end CHARACTERISTIC
/begin CHARACTERISTIC VABSCH "Vmax-Regler-Abschaltschwelle, variantenkodiert" VALUE 0xFC83AC KwUw 511.9922 vfzg_uw_q0p00781 0.00 511.9922 FORMAT "%8.4" /end CHARACTERISTIC
/begin CHARACTERISTIC VHYST "Vmax-Hystereseschwelle, variantenkodiert" VALUE 0xFC83AE KwUw 511.9922 vfzg_uw_q0p00781 0.00 511.9922 FORMAT "%8.4" /end CHARACTERISTIC
/begin CHARACTERISTIC VMAXO "Vmax-Begrenzungswert (Linie mit 16 Varianten)" VALUE 0xFC83B0 KwUw 511.9922 vfzg_uw_q0p00781 0.00 511.9922 FORMAT "%8.4" /end CHARACTERISTIC
/begin CHARACTERISTIC VMAXP "P-Glied bei VMAX-Regelung" VALUE 0xFC839E KwUb 99.70 rel_ub_q0p391 0.00 99.70 FORMAT "%5.2" /end CHARACTERISTIC
/begin CHARACTERISTIC VMIN_UC "Minimalgeschwindigkeit f¸r FGR-Betrieb im Befehlstest" VALUE 0xFC09E0 KwUw 511.9922 vfzg_uw_q0p00781 0.00 511.9922 FORMAT "%8.4" /end CHARACTERISTIC
/begin CHARACTERISTIC VMIN_UM "Minimalgeschwindigkeit f¸r FGR-Betrieb in der Funktions¸berwachung" VALUE 0xFCC436 KwUw 511.9922 vfzg_uw_q0p00781 0.00 511.9922 FORMAT "%8.4" /end CHARACTERISTIC
/begin CHARACTERISTIC VVORH "Vmax-Vorhaltschwelle, variantenkodiert" VALUE 0xFC83B2 KwUw 511.9922 vfzg_uw_q0p00781 0.00 511.9922 FORMAT "%8.4" /end CHARACTERISTIC
/begin CHARACTERISTIC watch_acmode "" VALUE 0xFCC7F4 KwSw 65535.00 dez -32768.00 32767.00 FORMAT "%8.2" /end CHARACTERISTIC
/begin CHARACTERISTIC watch_addr0_h "" VALUE 0xFCC7E2 KwUw 65535.00 dez 0.00 65535.00 FORMAT "%8.2" /end CHARACTERISTIC
/begin CHARACTERISTIC watch_addr0_l "" VALUE 0xFCC7E4 KwUw 65535.00 dez 0.00 65535.00 FORMAT "%8.2" /end CHARACTERISTIC
/begin CHARACTERISTIC watch_addr1_h "" VALUE 0xFCC7E6 KwUw 65535.00 dez 0.00 65535.00 FORMAT "%8.2" /end CHARACTERISTIC
/begin CHARACTERISTIC watch_addr1_l "" VALUE 0xFCC7E8 KwUw 65535.00 dez 0.00 65535.00 FORMAT "%8.2" /end CHARACTERISTIC
/begin CHARACTERISTIC watch_addr2_h "" VALUE 0xFCC7EA KwUw 65535.00 dez 0.00 65535.00 FORMAT "%8.2" /end CHARACTERISTIC
/begin CHARACTERISTIC watch_addr2_l "" VALUE 0xFCC7EC KwUw 65535.00 dez 0.00 65535.00 FORMAT "%8.2" /end CHARACTERISTIC
/begin CHARACTERISTIC watch_addr3_h "" VALUE 0xFCC7EE KwUw 65535.00 dez 0.00 65535.00 FORMAT "%8.2" /end CHARACTERISTIC
/begin CHARACTERISTIC watch_addr3_l "" VALUE 0xFCC7F0 KwUw 65535.00 dez 0.00 65535.00 FORMAT "%8.2" /end CHARACTERISTIC
/begin CHARACTERISTIC watch_addr4_h "" VALUE 0xFCC7F6 KwUw 65535.00 dez 0.00 65535.00 FORMAT "%8.2" /end CHARACTERISTIC
/begin CHARACTERISTIC watch_addr4_l "" VALUE 0xFCC7F8 KwUw 65535.00 dez 0.00 65535.00 FORMAT "%8.2" /end CHARACTERISTIC
/begin CHARACTERISTIC watch_addr5_h "" VALUE 0xFCC7FA KwUw 65535.00 dez 0.00 65535.00 FORMAT "%8.2" /end CHARACTERISTIC
/begin CHARACTERISTIC watch_addr5_l "" VALUE 0xFCC7FC KwUw 65535.00 dez 0.00 65535.00 FORMAT "%8.2" /end CHARACTERISTIC
/begin CHARACTERISTIC watch_cmode4 "" VALUE 0xFCC7FE KwSw 65535.00 dez -32768.00 32767.00 FORMAT "%8.2" /end CHARACTERISTIC
/begin CHARACTERISTIC watch_cmode5 "" VALUE 0xFCC800 KwSw 65535.00 dez -32768.00 32767.00 FORMAT "%8.2" /end CHARACTERISTIC
/begin CHARACTERISTIC watch_dcmode "" VALUE 0xFCC802 KwSw 65535.00 dez -32768.00 32767.00 FORMAT "%8.2" /end CHARACTERISTIC
/begin CHARACTERISTIC watch_mode "" VALUE 0xFCC7F2 KwSb 255.0 dez -128.0 127.0 FORMAT "%5.1" /end CHARACTERISTIC
/begin CHARACTERISTIC watch_newdata "" VALUE 0xFCC7E0 KwSb 255.0 dez -128.0 127.0 FORMAT "%5.1" /end CHARACTERISTIC
/begin CHARACTERISTIC watch_on "" VALUE 0xFCC7E1 KwSb 255.0 dez -128.0 127.0 FORMAT "%5.1" /end CHARACTERISTIC
/begin CHARACTERISTIC watch_rw4 "" VALUE 0xFCC804 KwSw 65535.00 dez -32768.00 32767.00 FORMAT "%8.2" /end CHARACTERISTIC
/begin CHARACTERISTIC watch_rw5 "" VALUE 0xFCC806 KwSw 65535.00 dez -32768.00 32767.00 FORMAT "%8.2" /end CHARACTERISTIC
/begin CHARACTERISTIC watch_sign4 "" VALUE 0xFCC808 KwSw 65535.00 dez -32768.00 32767.00 FORMAT "%8.2" /end CHARACTERISTIC
/begin CHARACTERISTIC watch_sign5 "" VALUE 0xFCC80A KwSw 65535.00 dez -32768.00 32767.00 FORMAT "%8.2" /end CHARACTERISTIC
/begin CHARACTERISTIC watch_size_bits4 "" VALUE 0xFCC80C KwSw 65535.00 dez -32768.00 32767.00 FORMAT "%8.2" /end CHARACTERISTIC
/begin CHARACTERISTIC watch_size_bits5 "" VALUE 0xFCC80E KwSw 65535.00 dez -32768.00 32767.00 FORMAT "%8.2" /end CHARACTERISTIC
/begin CHARACTERISTIC watch_value4_h "" VALUE 0xFCC810 KwUw 65535.00 dez 0.00 65535.00 FORMAT "%8.2" /end CHARACTERISTIC
/begin CHARACTERISTIC watch_value4_l "" VALUE 0xFCC812 KwUw 65535.00 dez 0.00 65535.00 FORMAT "%8.2" /end CHARACTERISTIC
/begin CHARACTERISTIC watch_value5_h "" VALUE 0xFCC814 KwUw 65535.00 dez 0.00 65535.00 FORMAT "%8.2" /end CHARACTERISTIC
/begin CHARACTERISTIC watch_value5_l "" VALUE 0xFCC816 KwUw 65535.00 dez 0.00 65535.00 FORMAT "%8.2" /end CHARACTERISTIC
/begin CHARACTERISTIC WESNESPR "Kennlinie f¸r ƒnderung des Einlassventil-÷ffnungswinkels" CURVE 0xFC5622 KlAUwSstUwWUw 65535.00 kw_q1 0.00 65535.00 FORMAT "%8.2"
 /begin AXIS_DESCR STD_AXIS evhubs_w hub_uw_q0p001 8 0.00 65.53500 FORMAT "%8.5" DEPOSIT ABSOLUTE /end AXIS_DESCR
/end CHARACTERISTIC
/begin CHARACTERISTIC WMNDOPZ "Sp‰tester Z¸ndwinkel im DZA Betrieb (Phasengebernotlauf)" VALUE 0xFCB2D7 KwSb 191.3 zw_sb_q0p75 -96.00 95.25 FORMAT "%5.2" /end CHARACTERISTIC
/begin CHARACTERISTIC WMXTA "Ansaugluft Korrekturz¸ndwinkel" CURVE 0xFCB8AA KlAUbSstUbWSb 191.3 zw_sb_q0p75 -96.00 95.25 FORMAT "%5.2"
 /begin AXIS_DESCR STD_AXIS wmtxa_in temp_ub_q0p75_o48 6 -48.00 143.3 FORMAT "%5.1" DEPOSIT ABSOLUTE /end AXIS_DESCR
/end CHARACTERISTIC
/begin CHARACTERISTIC WPHN "Phasengang" CURVE 0xFD0274 GklWSb 191.3 zw_sb_q0p75 -96.00 95.25 FORMAT "%5.2"
 /begin AXIS_DESCR COM_AXIS nmot nmot_ub_q40 8 0.00 10200. FORMAT "%5.0" AXIS_PTS_REF SNM08__UB /end AXIS_DESCR
/end CHARACTERISTIC
/begin CHARACTERISTIC ZBFIL "Zeitkonstante f¸r Beschleunigungsfilter" VALUE 0xFC839F KwUb 2.54000 zk10msxs_ub_b2p55 0.0100000 2.55000 FORMAT "%7.5" /end CHARACTERISTIC
/begin CHARACTERISTIC ZBTEML "Integrationsgeschwindigkeit Beladungsfaktor" CURVE 0xFCFE30 GklWUb 6.101 perio_ub_b6p125 0.00 6.101 FORMAT "%5.3"
 /begin AXIS_DESCR COM_AXIS ml m_ub_b1020 8 0.00 1020. FORMAT "%5.0" AXIS_PTS_REF SML08TEUB /end AXIS_DESCR
/end CHARACTERISTIC
/begin CHARACTERISTIC ZETATE "Rampensteilheit f¸r Ver‰nderung Motorwirkungsgrad durch Tankentl¸ftung" VALUE 0xFCFF86 KwUw 1279.590 rgrad_uw_b1280 0.3906250 1279.980 FORMAT "%8.3" /end CHARACTERISTIC
/begin CHARACTERISTIC ZIVMAX "I-Steigung f¸r VMAX-Regelung" VALUE 0xFC83A0 KwUb 25.4996 zk100msxs_ub_b25p5 0.100392 25.6000 FORMAT "%7.4" /end CHARACTERISTIC
/begin CHARACTERISTIC ZKFTEAD "Zeitkonstante gefilteter Faktor Beladung Sp¸lstrom bei Tankentl¸ftung" VALUE 0xFCFF88 KwUw 6553.50000 zk100msxs_uw_b6553 0.100001526 6553.60000 FORMAT "%10.5" /end CHARACTERISTIC
/begin CHARACTERISTIC ZMLTE "Zeitkonstante f¸r ml-Filter in beladungsabh. Tankentl¸ftung" VALUE 0xFCFF8A KwUw 6553.4999985 zk100msxs_uw_b655 0.10000152590 6553.6000000 FORMAT "%12.7" /end CHARACTERISTIC
/begin CHARACTERISTIC ZMSSGIN "Filterzeitkonstante f¸r Berechnung der relativen ƒnderung von mssgin_w" VALUE 0xFCFE38 KwUb 25.4996 zk100msxs_ub_b25p5 0.100392 25.6000 FORMAT "%7.4" /end CHARACTERISTIC
/begin CHARACTERISTIC ZWAPPL "Applikationsschnittstelle Z¸ndwinkelverstellung" VALUE 0xFCB2D8 KwSb 191.3 zw_sb_q0p75 -96.00 95.25 FORMAT "%5.2" /end CHARACTERISTIC
/begin CHARACTERISTIC ZWC_T_UM "Fehlertoleranzzeit der Z¸ndwinkel¸berwachung in der Funktions¸berw." VALUE 0xFCC643 KwUb 255.0 dez 0.00 255.0 FORMAT "%5.1" /end CHARACTERISTIC
/begin CHARACTERISTIC ZYLANZ_UM "Zylinderzahl f¸r die Z¸ndwinkel¸berwachung in der Funktions¸berw." VALUE 0xFCC644 KwUb 23.00 dez 1.000 24.00 FORMAT "%5.2" /end CHARACTERISTIC
/begin MEASUREMENT abfgrc_uc "Befehlstest: Modulspezifischer Antwortbeitrag aus %UFFGRC" UWORD dez 1 100 0 65535 FORMAT "%8.2" ECU_ADDRESS 0x5B903E /end MEASUREMENT
/begin MEASUREMENT abmist_uc "Befehlstest: Modulspezifischer Antwortbeitrag aus %UFMIST" UWORD dez 1 100 0 65535 FORMAT "%8.2" ECU_ADDRESS 0x5B9042 /end MEASUREMENT
/begin MEASUREMENT abmsrc_uc "Befehlstest: Modulspezifischer Antwortbeitrag aus %UFMSRC" UWORD dez 1 100 0 65535 FORMAT "%8.2" ECU_ADDRESS 0x5B9044 /end MEASUREMENT
/begin MEASUREMENT abmver_uc "Befehlstest: Modulspezifischer Antwortbeitrag aus %UFMVER" UWORD dez 1 100 0 65535 FORMAT "%8.2" ECU_ADDRESS 0x5B9046 /end MEASUREMENT
/begin MEASUREMENT abmzf_uc "Befehlstest: Modulspezifischer Antwortbeitrag aus %UFMZF" UWORD dez 1 100 0 65535 FORMAT "%8.2" ECU_ADDRESS 0x5B904A /end MEASUREMENT
/begin MEASUREMENT abmzul_uc "Befehlstest: Modulspezifischer Antwortbeitrag aus %UFMZUL" UWORD dez 1 100 0 65535 FORMAT "%8.2" ECU_ADDRESS 0x5B904C /end MEASUREMENT
/begin MEASUREMENT abreac_uc "Befehlstest: Modulspezifischer Antwortbeitrag aus %UFREAC" UWORD dez 1 100 0 65535 FORMAT "%8.2" ECU_ADDRESS 0x5B904E /end MEASUREMENT
/begin MEASUREMENT absgsc_uc "Befehlstest: Modulspezifischer Antwortbeitrag aus %UFSGSC" UWORD dez 1 100 0 65535 FORMAT "%8.2" ECU_ADDRESS 0x5B9050 /end MEASUREMENT
/begin MEASUREMENT abtres_um "Antwortbeitrag des Befehlstests in der Funktions¸berwachung" ULONG dez 1 100 0 4.29497e+009 FORMAT "%13.2" ECU_ADDRESS 0x5B9834 /end MEASUREMENT
/begin MEASUREMENT adcc_c_um "Fehlerz‰hler bei zueinander unplausiblen ADC-Werten f¸r sp1s" UBYTE t20ms_ub_b5100 1 100 0 5100 ECU_ADDRESS 0x3F98C3 /end MEASUREMENT
/begin MEASUREMENT adcc_c_ur "Doppelablage (DA) f¸r ADCC_C_UM" UBYTE dez 1 100 0 255 FORMAT "%5.1" ECU_ADDRESS 0x3F99A4 /end MEASUREMENT
/begin MEASUREMENT adcq_c_um "Fehlerz‰hler  in der ADC-Queue-‹berwachung" UBYTE t10ms_ub_b2550 1 100 0 2550 ECU_ADDRESS 0x3F98C4 /end MEASUREMENT
/begin MEASUREMENT adcq_c_ur "Doppelablage (DA) f¸r ADCQ_C_UM" UBYTE dez 1 100 0 255 FORMAT "%5.1" ECU_ADDRESS 0x3F99A5 /end MEASUREMENT
/begin MEASUREMENT adcq_um "Info aus dem ADC-Queue-Status Register" UBYTE dez 1 100 0 255 FORMAT "%5.1" ECU_ADDRESS 0x3F99A6 /end MEASUREMENT
/begin MEASUREMENT aktqu_uc "Aktuell im Befehlstest verwendete Frage" UBYTE dez 1 100 0 255 FORMAT "%5.1" ECU_ADDRESS 0x5B8DE0 /end MEASUREMENT
/begin MEASUREMENT alv_old_uc "" UBYTE dez 1 100 0 255 FORMAT "%5.1" ECU_ADDRESS 0x5B8DB5 /end MEASUREMENT
/begin MEASUREMENT alv_old_um "" UBYTE dez 1 100 0 255 FORMAT "%5.1" ECU_ADDRESS 0x3F9820 /end MEASUREMENT
/begin MEASUREMENT alv_old_ur "" UBYTE dez 1 100 0 255 FORMAT "%5.1" ECU_ADDRESS 0x3F9938 /end MEASUREMENT
/begin MEASUREMENT apakres_um "Antwortbeitrag der Programmablaufkontrolle in der Funktions¸berwachung" ULONG dez 1 100 0 4.29497e+009 FORMAT "%13.2" ECU_ADDRESS 0x5B9838 /end MEASUREMENT
/begin MEASUREMENT AS_wp "" UBYTE B_TRUE 1 100 0 1 BIT_MASK 0x1 FORMAT "%13.11" ECU_ADDRESS 0x3FBFD8 /end MEASUREMENT
/begin MEASUREMENT auscf_c_um "Fehlerz‰hler im DauerRAM f¸r nicht angezogenes Hauptrelais (Diagnose) in %UMAUSC" UBYTE dez 1 100 0 255 FORMAT "%5.1" ECU_ADDRESS 0x3FD7CC /end MEASUREMENT
/begin MEASUREMENT ausch_c_um "Heilungsz‰hler f¸r Anzahl von Antworten an das UM im Abschaltpfadtest" UBYTE dez 1 100 0 255 FORMAT "%5.1" ECU_ADDRESS 0x5B8DDF /end MEASUREMENT
/begin MEASUREMENT ausc_c_um "Pr¸fungsz‰hler im DauerRAM f¸r nicht angezogenes Hauptrelais im Abschaltpfadtest" UBYTE dez 1 100 0 255 FORMAT "%5.1" ECU_ADDRESS 0x3FD7CD /end MEASUREMENT
/begin MEASUREMENT ausc_ur "" UBYTE dez 1 100 0 255 FORMAT "%5.1" ECU_ADDRESS 0x3F99A3 /end MEASUREMENT
/begin MEASUREMENT ausgh_c_um "Heilungsz‰hler f¸r Fehler in der zyklischen RAM-Pr¸fung der Funktions¸berwachung" UBYTE t40ms_ub_b10200 1 100 0 10200 FORMAT "%7.1" ECU_ADDRESS 0x3F98C6 /end MEASUREMENT
/begin MEASUREMENT ausgh_c_ur "" UBYTE dez 1 100 0 255 FORMAT "%5.1" ECU_ADDRESS 0x3F99AA /end MEASUREMENT
/begin MEASUREMENT ausg_c_um "Fehlerz‰hler f¸r zyklische RAM-Pr¸fung in der Funktions¸berwachung" UBYTE dezsub1 1 100 1 256 FORMAT "%5.1" ECU_ADDRESS 0x3F98C7 /end MEASUREMENT
/begin MEASUREMENT ausg_c_ur "" UBYTE dez 1 100 0 255 FORMAT "%5.1" ECU_ADDRESS 0x3F99AB /end MEASUREMENT
/begin MEASUREMENT auszh_c_um "Heilungsz‰hler f¸r Fehler in der zyklischen ROM-Pr¸fung der Funktions¸berwachung" UBYTE t40ms_ub_b10200 1 100 0 10200 FORMAT "%7.1" ECU_ADDRESS 0x3F98C8 /end MEASUREMENT
/begin MEASUREMENT auszh_c_ur "" UBYTE dez 1 100 0 255 FORMAT "%5.1" ECU_ADDRESS 0x3F99AC /end MEASUREMENT
/begin MEASUREMENT ausz_c_um "Fehlerz‰hler f¸r zyklische ROM-Pr¸fung in der Funktions¸berwachung" UBYTE dezsub1 1 100 1 256 FORMAT "%5.1" ECU_ADDRESS 0x3F98C9 /end MEASUREMENT
/begin MEASUREMENT ausz_c_ur "" UBYTE dez 1 100 0 255 FORMAT "%5.1" ECU_ADDRESS 0x3F99AD /end MEASUREMENT
/begin MEASUREMENT bfzglf "Fahrzeugl‰ngsbeschleunigung gefiltert" SBYTE bfzg_sb_q0p217 1 100 -27.776 27.559 FORMAT "%5.2" ECU_ADDRESS 0x5B8FBC /end MEASUREMENT
/begin MEASUREMENT brems_c_um "Entprellz‰hler f¸r bet‰tigte Bremse in der Funktions¸berwachung" UBYTE t40ms_ub_b10200 1 100 0 10200 FORMAT "%7.1" ECU_ADDRESS 0x3F9818 /end MEASUREMENT
/begin MEASUREMENT brems_c_ur "Doppelablage (DA) f¸r BREMS_C_UM" UBYTE dez 1 100 0 255 FORMAT "%5.1" ECU_ADDRESS 0x3F9930 /end MEASUREMENT
/begin MEASUREMENT B_1stugen "Bedingung ctrgenutar noch nicht gueltig" UBYTE B_TRUE 1 100 0 1 FORMAT "%13.11" ECU_ADDRESS 0x5B89B2 /end MEASUREMENT
/begin MEASUREMENT B_adcc_um "Bedingung ADC-Test aktiv" UBYTE B_TRUE 1 100 0 1 BIT_MASK 0x1 FORMAT "%13.11" ECU_ADDRESS 0x3F98C0 /end MEASUREMENT
/begin MEASUREMENT B_ausc_act "Bedingung f¸r Abschaltpfadtest aktiv" UBYTE B_TRUE 1 100 0 1 BIT_MASK 0x1 FORMAT "%13.11" ECU_ADDRESS 0x3FBBFE /end MEASUREMENT
/begin MEASUREMENT B_ausc_um "Bedingung f¸r Abschaltpfadtest abgeschlossen in der Funktions¸berwachung" UBYTE B_TRUE 1 100 0 1 BIT_MASK 0x1 FORMAT "%13.11" ECU_ADDRESS 0x3FBBFF /end MEASUREMENT
/begin MEASUREMENT B_auswrt "" UBYTE B_TRUE 1 100 0 1 BIT_MASK 0x2 FORMAT "%13.11" ECU_ADDRESS 0x3FE95A /end MEASUREMENT
/begin MEASUREMENT B_brems_um "Bedingung Bremse getreten f¸r die Funktions¸berwachung" UBYTE B_TRUE 1 100 0 1 BIT_MASK 0x1 FORMAT "%13.11" ECU_ADDRESS 0x3F987C /end MEASUREMENT
/begin MEASUREMENT B_brfgr_um "Bedingung Bremse getreten f¸r die Funktions¸berwachung" UBYTE B_TRUE 1 100 0 1 BIT_MASK 0x2 FORMAT "%13.11" ECU_ADDRESS 0x3F987C /end MEASUREMENT
/begin MEASUREMENT B_bsl_um "erkannter Low-Pegel am FGR-Bedienhebelschalter Beschleunigen in Funktions¸berw." UBYTE B_TRUE 1 100 0 1 BIT_MASK 0x2 FORMAT "%13.11" ECU_ADDRESS 0x3F987D /end MEASUREMENT
/begin MEASUREMENT B_clvar "Bedingung Variante Lˆschen ¸ber KWP 2000* Service" UBYTE B_TRUE 1 100 0 1 BIT_MASK 0x1 FORMAT "%13.11" ECU_ADDRESS 0x3FDC6D /end MEASUREMENT
/begin MEASUREMENT B_dcdis_um "Fehlerreaktions-Info der Funktions¸berwachung (Abschaltung der DK-Steller-ES)" UBYTE B_TRUE 1 100 0 1 BIT_MASK 0x1 FORMAT "%13.11" ECU_ADDRESS 0x3F987B /end MEASUREMENT
/begin MEASUREMENT B_eculock "Verriegelungsanforderung Wegfahrsperre" UBYTE B_TRUE 1 100 0 1 BIT_MASK 0x1 FORMAT "%13.11" ECU_ADDRESS 0x3FBFD9 /end MEASUREMENT
/begin MEASUREMENT B_eep2err "" UBYTE B_TRUE 1 100 0 1 BIT_MASK 0x1 FORMAT "%13.11" ECU_ADDRESS 0x3FBFDA /end MEASUREMENT
/begin MEASUREMENT B_eeperr "" UBYTE B_TRUE 1 100 0 1 BIT_MASK 0x1 FORMAT "%13.11" ECU_ADDRESS 0x3FBFDB /end MEASUREMENT
/begin MEASUREMENT B_faadav "" UBYTE B_TRUE 1 100 0 1 BIT_MASK 0x1 FORMAT "%13.11" ECU_ADDRESS 0x3FBEA7 /end MEASUREMENT
/begin MEASUREMENT B_fgrea_um "FGR-/ACC-Einschaltung g¸ltig in der Funktions¸berwachung, zeitverzˆgert" UBYTE B_TRUE 1 100 0 1 BIT_MASK 0x80 FORMAT "%13.11" ECU_ADDRESS 0x3F987D /end MEASUREMENT
/begin MEASUREMENT B_fgr_bt "" UBYTE B_TRUE 1 100 0 1 BIT_MASK 0x1 FORMAT "%13.11" ECU_ADDRESS 0x3FBBF3 /end MEASUREMENT
/begin MEASUREMENT B_fgr_uc "FGR-/ACC-Momenteneingriff im Befehlstest erlaubt" UBYTE B_TRUE 1 100 0 1 BIT_MASK 0x1 FORMAT "%13.11" ECU_ADDRESS 0x3FBBF4 /end MEASUREMENT
/begin MEASUREMENT B_fgr_um "FGR-/ACC-Momenteneingriff in der Funktions¸berwachung erlaubt" UBYTE B_TRUE 1 100 0 1 BIT_MASK 0x1 FORMAT "%13.11" ECU_ADDRESS 0x3F981A /end MEASUREMENT
/begin MEASUREMENT B_fgr_umc "" UBYTE B_TRUE 1 100 0 1 BIT_MASK 0x2 FORMAT "%13.11" ECU_ADDRESS 0x3F987E /end MEASUREMENT
/begin MEASUREMENT b_flags_uc "Ebene 3 Byte f¸r Botschaft¸berwachung (alte Toggle Bits)" UBYTE dez 1 100 0 255 FORMAT "%5.1" ECU_ADDRESS 0x5B8DD5 /end MEASUREMENT
/begin MEASUREMENT b_flags_um "Flag f¸r Bitinformationen in der Funktions¸berwachung" UBYTE dez 1 100 0 255 FORMAT "%5.1" ECU_ADDRESS 0x3F9879 /end MEASUREMENT
/begin MEASUREMENT B_genoff "Bedingung Generator ausgeschaltet" UBYTE B_TRUE 1 100 0 1 FORMAT "%13.11" ECU_ADDRESS 0x5B8B6D /end MEASUREMENT
/begin MEASUREMENT B_genoffmd "Bedingung Generatus-off-Anforderung" UBYTE B_TRUE 1 100 0 1 FORMAT "%13.11" ECU_ADDRESS 0x5B8B6E /end MEASUREMENT
/begin MEASUREMENT B_genoffok "" UBYTE B_TRUE 1 100 0 1 FORMAT "%13.11" ECU_ADDRESS 0x5B8B6F /end MEASUREMENT
/begin MEASUREMENT B_gwrte "Bedingung fr-Grenzwertregelung Tankentl¸ftung aktiv" UBYTE B_TRUE 1 100 0 1 BIT_MASK 0x1 FORMAT "%13.11" ECU_ADDRESS 0x3FBFC9 /end MEASUREMENT
/begin MEASUREMENT B_inistw "" UBYTE B_TRUE 1 100 0 1 BIT_MASK 0x1 FORMAT "%13.11" ECU_ADDRESS 0x3FBFDC /end MEASUREMENT
/begin MEASUREMENT B_i_ska "Funktions-Fehlerreaktion irreversible SKA (Sicherheits-Kraftstoffabschaltung)" UBYTE B_TRUE 1 100 0 1 BIT_MASK 0x4 FORMAT "%13.11" ECU_ADDRESS 0x3F987B /end MEASUREMENT
/begin MEASUREMENT B_i_ska_uc "Ebene 3 irreversibles Fehlerbit fuer BT" UBYTE B_TRUE 1 100 0 1 BIT_MASK 0x1 FORMAT "%13.11" ECU_ADDRESS 0x3FBBFB /end MEASUREMENT
/begin MEASUREMENT B_i_ska_um "Fehlerreaktion irrev. SKA (Sicherheitskraftstoffabschaltung) aus Fkt-‹berwachung" UBYTE B_TRUE 1 100 0 1 BIT_MASK 0x1 FORMAT "%13.11" ECU_ADDRESS 0x3F9878 /end MEASUREMENT
/begin MEASUREMENT B_kkl_um "erkannter Low-Pegel am FGR-Bedienhebelschalter Kontrollkontakt in Funktions¸berw" UBYTE B_TRUE 1 100 0 1 BIT_MASK 0x8 FORMAT "%13.11" ECU_ADDRESS 0x3F987D /end MEASUREMENT
/begin MEASUREMENT B_krzwsol "" UBYTE B_TRUE 1 100 0 1 BIT_MASK 0x1 FORMAT "%13.11" ECU_ADDRESS 0x3FBFEA /end MEASUREMENT
/begin MEASUREMENT B_kwperr "" UBYTE B_TRUE 1 100 0 1 BIT_MASK 0x1 FORMAT "%13.11" ECU_ADDRESS 0x3FBFDD /end MEASUREMENT
/begin MEASUREMENT B_llzwe "" UBYTE B_TRUE 1 100 0 1 BIT_MASK 0x1 FORMAT "%13.11" ECU_ADDRESS 0x3FBFEB /end MEASUREMENT
/begin MEASUREMENT B_lrar "Bedingung reduzierte Korrekturbereiche in der LRA" UBYTE B_TRUE 1 100 0 1 BIT_MASK 0x1 FORMAT "%13.11" ECU_ADDRESS 0x3FBFCA /end MEASUREMENT
/begin MEASUREMENT B_motor "" UBYTE B_TRUE 1 100 0 1 BIT_MASK 0x20 FORMAT "%13.11" ECU_ADDRESS 0x3FE95A /end MEASUREMENT
/begin MEASUREMENT B_msthw_um "Bedingung Master-SG gem‰ﬂ Codier-Pin f¸r die Funktions¸berwachung" UBYTE B_TRUE 1 100 0 1 BIT_MASK 0x80 FORMAT "%13.11" ECU_ADDRESS 0x3F987E /end MEASUREMENT
/begin MEASUREMENT B_mzns_um "Nachstartaufweitung des zul‰sigen Moments in der Funktons¸berwachung aktiv" UBYTE B_TRUE 1 100 0 1 BIT_MASK 0x1 FORMAT "%13.11" ECU_ADDRESS 0x3F9848 /end MEASUREMENT
/begin MEASUREMENT B_naccf_um "" UBYTE B_TRUE 1 100 0 1 BIT_MASK 0x40 FORMAT "%13.11" ECU_ADDRESS 0x3F987D /end MEASUREMENT
/begin MEASUREMENT B_newqr_um "Bedingung f¸r neue Frage vom UM empfangen in der Funktions¸berwachung" UBYTE B_TRUE 1 100 0 1 BIT_MASK 0x1 FORMAT "%13.11" ECU_ADDRESS 0x3FBBFC /end MEASUREMENT
/begin MEASUREMENT B_nlh_um "Anforderung Notlauf  mit Lambda 1 aus Funktions¸berwachung" UBYTE B_TRUE 1 100 0 1 BIT_MASK 0x1 FORMAT "%13.11" ECU_ADDRESS 0x3F9879 /end MEASUREMENT
/begin MEASUREMENT B_noctrgen "" UBYTE B_TRUE 1 100 0 1 FORMAT "%13.11" ECU_ADDRESS 0x5B89B3 /end MEASUREMENT
/begin MEASUREMENT B_nomsr_uc "MSR-Momentenvorgabe im Befehlstest nicht ¸bernommen" UBYTE B_TRUE 1 100 0 1 BIT_MASK 0x1 FORMAT "%13.11" ECU_ADDRESS 0x3FBBF5 /end MEASUREMENT
/begin MEASUREMENT B_nomsr_um "MSR-Momentenvorgabe in der Funktions¸berwachung nicht ¸bernommen" UBYTE B_TRUE 1 100 0 1 BIT_MASK 0x1 FORMAT "%13.11" ECU_ADDRESS 0x3F981E /end MEASUREMENT
/begin MEASUREMENT B_nosgs_uc "SGS-Momentenvorgabe im Befehlstest nicht ¸bernommen" UBYTE B_TRUE 1 100 0 1 BIT_MASK 0x1 FORMAT "%13.11" ECU_ADDRESS 0x3FBBF9 /end MEASUREMENT
/begin MEASUREMENT B_nosgs_um "SGS-Momentenvorgabe in der Funktions¸berwachung nicht ¸bernommen" UBYTE B_TRUE 1 100 0 1 BIT_MASK 0x1 FORMAT "%13.11" ECU_ADDRESS 0x3F986C /end MEASUREMENT
/begin MEASUREMENT B_notlu "Anforderung Notluftfahren aus der Funktion" UBYTE B_TRUE 1 100 0 1 BIT_MASK 0x8 FORMAT "%13.11" ECU_ADDRESS 0x3F987B /end MEASUREMENT
/begin MEASUREMENT B_nouetm "Bedingung keine ‹bertemperatur im Nachlauf" UBYTE B_TRUE 1 100 0 1 BIT_MASK 0x1 FORMAT "%13.11" ECU_ADDRESS 0x3FDBCD /end MEASUREMENT
/begin MEASUREMENT B_nsakt_um "Nachstart aktiv f¸r die Fkt.-‹berwachung" UBYTE B_TRUE 1 100 0 1 BIT_MASK 0x4 FORMAT "%13.11" ECU_ADDRESS 0x3F987A /end MEASUREMENT
/begin MEASUREMENT B_nsend_um "Nachstart¸berwachungszeit abgelaufen f¸r die Fkt.-‹berwachung" UBYTE B_TRUE 1 100 0 1 BIT_MASK 0x1 FORMAT "%13.11" ECU_ADDRESS 0x3F987A /end MEASUREMENT
/begin MEASUREMENT B_nxptr_um "" UBYTE B_TRUE 1 100 0 1 BIT_MASK 0x1 FORMAT "%13.11" ECU_ADDRESS 0x3FBC00 /end MEASUREMENT
/begin MEASUREMENT B_nxtrp_um "Bedingung f¸r n‰chste Antwort korrekt an das UM ausgeben in der F‹" UBYTE B_TRUE 1 100 0 1 BIT_MASK 0x1 FORMAT "%13.11" ECU_ADDRESS 0x3FBBFD /end MEASUREMENT
/begin MEASUREMENT B_ptyerr "" UBYTE B_TRUE 1 100 0 1 BIT_MASK 0x1 FORMAT "%13.11" ECU_ADDRESS 0x3FBFDE /end MEASUREMENT
/begin MEASUREMENT B_pwgnotum "= b_pwgnot_um Funktions¸berwachungs-Fehlerreaktion PWG-Leerlauf (= b_pwgnot_sr)" UBYTE B_TRUE 1 100 0 1 BIT_MASK 0x1 FORMAT "%13.11" ECU_ADDRESS 0x3F9870 /end MEASUREMENT
/begin MEASUREMENT B_qtedab "Bedingung schnelle Absteuerung der Sp¸lrate" UBYTE B_TRUE 1 100 0 1 BIT_MASK 0x1 FORMAT "%13.11" ECU_ADDRESS 0x3FBFCF /end MEASUREMENT
/begin MEASUREMENT B_ramerr "" UBYTE B_TRUE 1 100 0 1 BIT_MASK 0x1 FORMAT "%13.11" ECU_ADDRESS 0x3FBFDF /end MEASUREMENT
/begin MEASUREMENT B_reaci_um "" UBYTE B_TRUE 1 100 0 1 BIT_MASK 0x10 FORMAT "%13.11" ECU_ADDRESS 0x3F987B /end MEASUREMENT
/begin MEASUREMENT B_read_active "" UBYTE B_TRUE 1 100 0 1 BIT_MASK 0x1 FORMAT "%13.11" ECU_ADDRESS 0x3FBFE0 /end MEASUREMENT
/begin MEASUREMENT B_recerr "" UBYTE B_TRUE 1 100 0 1 BIT_MASK 0x1 FORMAT "%13.11" ECU_ADDRESS 0x3FBFE1 /end MEASUREMENT
/begin MEASUREMENT B_resstw "" UBYTE B_TRUE 1 100 0 1 BIT_MASK 0x1 FORMAT "%13.11" ECU_ADDRESS 0x3FBFE2 /end MEASUREMENT
/begin MEASUREMENT B_rlini_um "" UBYTE B_TRUE 1 100 0 1 BIT_MASK 0x2 FORMAT "%13.11" ECU_ADDRESS 0x3F9879 /end MEASUREMENT
/begin MEASUREMENT B_rluf_um "" UBYTE B_TRUE 1 100 0 1 BIT_MASK 0x4 FORMAT "%13.11" ECU_ADDRESS 0x3F9879 /end MEASUREMENT
/begin MEASUREMENT B_srstz_um "Software-Reset-Anforderung aus der zyklischen ROM-Absicherung der Fkt-‹berwach." UBYTE B_TRUE 1 100 0 1 BIT_MASK 0x80 FORMAT "%13.11" ECU_ADDRESS 0x3F987B /end MEASUREMENT
/begin MEASUREMENT B_srst_um "Software-Reset-Anforderung aus der zyklischen RAM-Absicherung der Fkt-‹berwach." UBYTE B_TRUE 1 100 0 1 BIT_MASK 0x40 FORMAT "%13.11" ECU_ADDRESS 0x3F987B /end MEASUREMENT
/begin MEASUREMENT B_te "Bedingung Tankentl¸ftung" UBYTE B_TRUE 1 100 0 1 BIT_MASK 0x1 FORMAT "%13.11" ECU_ADDRESS 0x3FBFD0 /end MEASUREMENT
/begin MEASUREMENT B_teabb "Bedingung Tankentl¸ftung abbruchbereit" UBYTE B_TRUE 1 100 0 1 BIT_MASK 0x1 FORMAT "%13.11" ECU_ADDRESS 0x3FBFCB /end MEASUREMENT
/begin MEASUREMENT B_teakt "Bedingung Tankentl¸ftung aktiv (normaler Betrieb oder Notlauf)" UBYTE B_TRUE 1 100 0 1 BIT_MASK 0x1 FORMAT "%13.11" ECU_ADDRESS 0x3FBFCC /end MEASUREMENT
/begin MEASUREMENT B_tef "Bedingung Tankentl¸ftung prinzipiell freigegeben" UBYTE B_TRUE 1 100 0 1 BIT_MASK 0x1 FORMAT "%13.11" ECU_ADDRESS 0x3FBFD1 /end MEASUREMENT
/begin MEASUREMENT B_tehb "Bedingung Tankentl¸ftung mit hoher Beladung" UBYTE B_TRUE 1 100 0 1 BIT_MASK 0x1 FORMAT "%13.11" ECU_ADDRESS 0x3FBFCD /end MEASUREMENT
/begin MEASUREMENT B_tehbx "Bedingung Beladungsintegrator ftead am Maximalanschlag" UBYTE B_TRUE 1 100 0 1 BIT_MASK 0x1 FORMAT "%13.11" ECU_ADDRESS 0x3FBFCE /end MEASUREMENT
/begin MEASUREMENT B_tei "Bedingung Tankentl¸ftung funktionsintern" UBYTE B_TRUE 1 100 0 1 BIT_MASK 0x1 FORMAT "%13.11" ECU_ADDRESS 0x3FBFD2 /end MEASUREMENT
/begin MEASUREMENT B_ten "Bedingung Tankentl¸ftung im Notlaufbetrieb (ohne Lambdaregelung)" UBYTE B_TRUE 1 100 0 1 BIT_MASK 0x1 FORMAT "%13.11" ECU_ADDRESS 0x3FBFD3 /end MEASUREMENT
/begin MEASUREMENT B_tenmda "Notlauf TE beim Aussetzer" UBYTE B_TRUE 1 100 0 1 BIT_MASK 0x1 FORMAT "%13.11" ECU_ADDRESS 0x5B8A3E /end MEASUREMENT
/begin MEASUREMENT B_timerr "" UBYTE B_TRUE 1 100 0 1 BIT_MASK 0x1 FORMAT "%13.11" ECU_ADDRESS 0x3FBFE3 /end MEASUREMENT
/begin MEASUREMENT B_tpu_um "" UBYTE B_TRUE 1 100 0 1 BIT_MASK 0x20 FORMAT "%13.11" ECU_ADDRESS 0x3F987B /end MEASUREMENT
/begin MEASUREMENT B_ub_ska "Batteriespannung nicht o.k., Unterspannungsabschaltung aktiv" UBYTE B_TRUE 1 100 0 1 BIT_MASK 0x2 FORMAT "%13.11" ECU_ADDRESS 0x3F987B /end MEASUREMENT
/begin MEASUREMENT B_uetm "Bedingung ‹bertemperatur" UBYTE B_TRUE 1 100 0 1 BIT_MASK 0x1 FORMAT "%13.11" ECU_ADDRESS 0x3FBD0B /end MEASUREMENT
/begin MEASUREMENT B_uetmc "Bedingung ‹bertemperatur; CAN-Sende-Botschaft" UBYTE B_TRUE 1 100 0 1 BIT_MASK 0x1 FORMAT "%13.11" ECU_ADDRESS 0x3FBD0C /end MEASUREMENT
/begin MEASUREMENT B_vmax "Bedingung VMAX-Regelung aktiv" UBYTE B_TRUE 1 100 0 1 BIT_MASK 0x1 FORMAT "%13.11" ECU_ADDRESS 0x3FBF38 /end MEASUREMENT
/begin MEASUREMENT B_vzl_um "erkannter Low-Pegel am FGR-Bedienhebelschalter Verzˆgern in der Funktions¸berw." UBYTE B_TRUE 1 100 0 1 BIT_MASK 0x1 FORMAT "%13.11" ECU_ADDRESS 0x3F987D /end MEASUREMENT
/begin MEASUREMENT B_wal_um "erkannter Low-Pegel am FGR-Bedienhebelschalter Wiederaufnahme in Funktions¸berw." UBYTE B_TRUE 1 100 0 1 BIT_MASK 0x4 FORMAT "%13.11" ECU_ADDRESS 0x3F987D /end MEASUREMENT
/begin MEASUREMENT B_wcerr "" UBYTE B_TRUE 1 100 0 1 BIT_MASK 0x1 FORMAT "%13.11" ECU_ADDRESS 0x3FBFE4 /end MEASUREMENT
/begin MEASUREMENT B_wc_exa "" UBYTE B_TRUE 1 100 0 1 BIT_MASK 0x8 FORMAT "%13.11" ECU_ADDRESS 0x3FE95A /end MEASUREMENT
/begin MEASUREMENT B_wc_exn "" UBYTE B_TRUE 1 100 0 1 BIT_MASK 0x4 FORMAT "%13.11" ECU_ADDRESS 0x3FE95A /end MEASUREMENT
/begin MEASUREMENT B_wkora "Bedingung Z¸ndwinkelkorrektur f¸r Klopfschutz" UBYTE B_TRUE 1 100 0 1 BIT_MASK 0x1 FORMAT "%13.11" ECU_ADDRESS 0x3FBFEE /end MEASUREMENT
/begin MEASUREMENT B_write_active "" UBYTE B_TRUE 1 100 0 1 BIT_MASK 0x1 FORMAT "%13.11" ECU_ADDRESS 0x3FBFE5 /end MEASUREMENT
/begin MEASUREMENT B_wuerg "" UBYTE B_TRUE 1 100 0 1 BIT_MASK 0x10 FORMAT "%13.11" ECU_ADDRESS 0x3FE95A /end MEASUREMENT
/begin MEASUREMENT B_zndaus "Bedingung Z¸ndungsausblendung aktiv" UBYTE B_TRUE 1 100 0 1 BIT_MASK 0x1 FORMAT "%13.11" ECU_ADDRESS 0x3FBFE9 /end MEASUREMENT
/begin MEASUREMENT B_zwkra "Bedingung: Z¸ndwinkel der KR wird ausgegeben" UBYTE B_TRUE 1 100 0 1 BIT_MASK 0x1 FORMAT "%13.11" ECU_ADDRESS 0x3FBFEC /end MEASUREMENT
/begin MEASUREMENT B_zwmnste "Bedingung Abregelung der Z¸ndwinkelsp‰tbegrenzung erf¸llt" UBYTE B_TRUE 1 100 0 1 BIT_MASK 0x1 FORMAT "%13.11" ECU_ADDRESS 0x3FBFEF /end MEASUREMENT
/begin MEASUREMENT B_zwms "Bedingung Motorschutz-Z¸ndwinkelbegrenzung" UBYTE B_TRUE 1 100 0 1 BIT_MASK 0x1 FORMAT "%13.11" ECU_ADDRESS 0x3FBFF0 /end MEASUREMENT
/begin MEASUREMENT B_zwspae "Bedingung: Z¸ndwinkel zwspae bei Schubabschaltung wird ausgegeben" UBYTE B_TRUE 1 100 0 1 BIT_MASK 0x1 FORMAT "%13.11" ECU_ADDRESS 0x3FBFED /end MEASUREMENT
/begin MEASUREMENT c720alt_um "Zahnz‰hler720∞ des vorhergehenden Berechnungszeitpunkts im 10ms-Raster" UBYTE dez 1 100 0 255 FORMAT "%5.1" ECU_ADDRESS 0x3F98D1 /end MEASUREMENT
/begin MEASUREMENT c720alt_ur "Doppelablage (DA) f¸r C720ALT_UM" UBYTE dez 1 100 0 255 FORMAT "%5.1" ECU_ADDRESS 0x3F99B0 /end MEASUREMENT
/begin MEASUREMENT devoff "EV-Ausblendmaske bei Testeranforderung" UBYTE dez 1 100 0 255 FORMAT "%5.1" ECU_ADDRESS 0x5B8CAC /end MEASUREMENT
/begin MEASUREMENT dftef_w "Eingang Integrator Sp¸lrate" SWORD perio_sw_b1p562 1 100 -1.562 1.56195 FORMAT "%8.6" ECU_ADDRESS 0x5B9468 /end MEASUREMENT
/begin MEASUREMENT dkatefrg "Abweichung Kraftstoffanteil Tankentl¸ftung bei Sollsp¸lrate von Zielwert" SBYTE fak_sb_b1 1 100 -1 0.992188 FORMAT "%5.3" ECU_ADDRESS 0x5B8FE5 /end MEASUREMENT
/begin MEASUREMENT dkhc_w "Eingang Integrator HC-Konzentration" SWORD perio_sw_b6p125 1 100 -6.125 6.12481 FORMAT "%8.6" ECU_ADDRESS 0x5B8A36 /end MEASUREMENT
/begin MEASUREMENT dmlftef "Produkt Sp¸lrate mal prozentuale Luftmassen‰nderung" UBYTE fak_ub_b0p5 1 100 0 0.498047 ECU_ADDRESS 0x5B8FE6 /end MEASUREMENT
/begin MEASUREMENT dmssginr "relative ƒnderung des Massenstromes mssgin_w" SBYTE fak_sb_b1 1 100 -1 0.992188 FORMAT "%5.3" ECU_ADDRESS 0x5B8FE7 /end MEASUREMENT
/begin MEASUREMENT dmvmxi_w "Drehmoment I-Anteil bei VMAX-Regelung" SWORD rel_sw_b100 1 100 -100 99.9969 FORMAT "%8.4" ECU_ADDRESS 0x5B941E /end MEASUREMENT
/begin MEASUREMENT dmvmxp_w "Drehmoment P-Anteil bei VMAX-Regelung" SWORD rel_sw_b100 1 100 -100 99.9969 FORMAT "%8.4" ECU_ADDRESS 0x5B9420 /end MEASUREMENT
/begin MEASUREMENT drrev_sta "Zustand der Synchronisation" UBYTE dez 1 100 0 255 FORMAT "%5.1" ECU_ADDRESS 0x5B8C8E /end MEASUREMENT
/begin MEASUREMENT dstert20_w "Normierte Weitertransportstrecke Regeneriergas im Saugrohr im 20ms-Raster" UWORD fak_uw_b2 1 100 0 1.99997 FORMAT "%8.6" ECU_ADDRESS 0x5B946A /end MEASUREMENT
/begin MEASUREMENT dvprae_w "Pr‰dizierter Geschwindigkeitsanteil" UWORD vfzg_uw_q0p00781 1 100 0 511.992 FORMAT "%8.4" ECU_ADDRESS 0x5B9422 /end MEASUREMENT
/begin MEASUREMENT dvsi_w "Abweichung zwischen Soll- und Istgeschwindigkeit der VMAX-Regelung" SWORD vfzg_sw_q0p00781 1 100 -256 255.992 FORMAT "%8.4" ECU_ADDRESS 0x5B9424 /end MEASUREMENT
/begin MEASUREMENT dzwks "delta Z¸ndwinkel Klopfschutz" SBYTE zw_sb_q0p75 1 100 -96 95.25 FORMAT "%5.2" ECU_ADDRESS 0x5B9020 /end MEASUREMENT
/begin MEASUREMENT dzwmna "Min-Z¸ndwinkel ƒnderungsgeschwindigeit zw. Brenngrenze und Motorschutz" SBYTE zw_sb_q0p75 1 100 -96 95.25 FORMAT "%5.2" ECU_ADDRESS 0x5B9022 /end MEASUREMENT
/begin MEASUREMENT dzwspae "Korrektur-Z¸ndwinkel f¸r den sp‰test erlaubten Z¸ndwinkel" SBYTE zw_sb_q0p75 1 100 -96 95.25 FORMAT "%5.2" ECU_ADDRESS 0x5B9023 /end MEASUREMENT
/begin MEASUREMENT dzwtans "Rover" SBYTE zw_sb_q0p75 1 100 -96 95.25 FORMAT "%5.2" ECU_ADDRESS 0x5B9019 /end MEASUREMENT
/begin MEASUREMENT dzwtmot "Rover" SBYTE zw_sb_q0p75 1 100 -96 95.25 FORMAT "%5.2" ECU_ADDRESS 0x5B901A /end MEASUREMENT
/begin MEASUREMENT dzwwl "Delta Zuendwinkel aus Warmlauf" SBYTE zw_sb_q0p75 1 100 -96 95.25 FORMAT "%5.2" ECU_ADDRESS 0x5B902D /end MEASUREMENT
/begin MEASUREMENT dzw_uc "Delta Z¸ndwinkel zwischen zwopt und zwout im Befehlstest" UBYTE zw_ub_q0p75 1 100 0 191.25 FORMAT "%5.1" ECU_ADDRESS 0x5B8DAE /end MEASUREMENT
/begin MEASUREMENT dzw_um "Delta Z¸ndwinkel zwischen zwopt und zwout in der Funktions¸berwachung" UBYTE zw_ub_q0p75 1 100 0 191.25 FORMAT "%5.1" ECU_ADDRESS 0x3F981C /end MEASUREMENT
/begin MEASUREMENT dzw_ur "Doppelablage (DA) f¸r DZW_UM" UBYTE dez 1 100 0 255 FORMAT "%5.1" ECU_ADDRESS 0x3F9933 /end MEASUREMENT
/begin MEASUREMENT ei_adcc_um "irreversibles Fehlerbit bei der AD-Wandler-‹berwachung" UBYTE B_TRUE 1 100 0 1 BIT_MASK 0x1 FORMAT "%13.11" ECU_ADDRESS 0x3F98C1 /end MEASUREMENT
/begin MEASUREMENT ei_adcq_um "irreversibles Fehlerbit bei der AD-Wandler-Queue-‹berwachung" UBYTE B_TRUE 1 100 0 1 BIT_MASK 0x1 FORMAT "%13.11" ECU_ADDRESS 0x3F98C2 /end MEASUREMENT
/begin MEASUREMENT ei_ipa_um "irrev. Fehlerbit f¸r unterer DK-Anschlag im ung¸ltigen Bereich in der Fkt-‹berw." UBYTE B_TRUE 1 100 0 1 BIT_MASK 0x1 FORMAT "%13.11" ECU_ADDRESS 0x3F9854 /end MEASUREMENT
/begin MEASUREMENT ei_msrc_uc "irreversibles Fehlerbit bei der MSR-‹berwachung im Befehlstest" UBYTE B_TRUE 1 100 0 1 BIT_MASK 0x1 FORMAT "%13.11" ECU_ADDRESS 0x3FBBF6 /end MEASUREMENT
/begin MEASUREMENT ei_msrc_um "irreversibles Fehlerbit bei der MSR-‹berwachung der Funktions¸berwachung" UBYTE B_TRUE 1 100 0 1 BIT_MASK 0x1 FORMAT "%13.11" ECU_ADDRESS 0x3F981F /end MEASUREMENT
/begin MEASUREMENT ei_mver_uc "Ebene 3 irreversibles Fehlerbit fuer URCMVER aus BT" UBYTE B_TRUE 1 100 0 1 BIT_MASK 0x1 FORMAT "%13.11" ECU_ADDRESS 0x3FBBF7 /end MEASUREMENT
/begin MEASUREMENT ei_mver_um "irreversibles Fehlerbit beim Momentenvergleich der Funktions¸berwachung" UBYTE B_TRUE 1 100 0 1 BIT_MASK 0x1 FORMAT "%13.11" ECU_ADDRESS 0x3F9823 /end MEASUREMENT
/begin MEASUREMENT ei_nc_um "irreversibles Fehlerbit beim Drehzahlvergleich der Funktions¸berwachung" UBYTE B_TRUE 1 100 0 1 BIT_MASK 0x1 FORMAT "%13.11" ECU_ADDRESS 0x3F9840 /end MEASUREMENT
/begin MEASUREMENT ei_reac_uc "Ebene 3 irreversibles Fehlerbit fuer UFREAC aus BT" UBYTE B_TRUE 1 100 0 1 BIT_MASK 0x1 FORMAT "%13.11" ECU_ADDRESS 0x3FBBF8 /end MEASUREMENT
/begin MEASUREMENT ei_reac_um "irreversibles Fehlerbit der Fehlerreaktions¸berwachung der Funktions¸berwachung" UBYTE B_TRUE 1 100 0 1 BIT_MASK 0x1 FORMAT "%13.11" ECU_ADDRESS 0x3F984C /end MEASUREMENT
/begin MEASUREMENT ei_rlc_um "irreversibles Fehlerbit beim rl-Vergleich mit der Funktion in der Funktions¸berw" UBYTE B_TRUE 1 100 0 1 BIT_MASK 0x1 FORMAT "%13.11" ECU_ADDRESS 0x3F9855 /end MEASUREMENT
/begin MEASUREMENT ei_rlip_um "irreversibles Fehlerbit beim rl/rlip-Vergleich der Funktions¸berwachung" UBYTE B_TRUE 1 100 0 1 BIT_MASK 0x1 FORMAT "%13.11" ECU_ADDRESS 0x3F9856 /end MEASUREMENT
/begin MEASUREMENT ei_sgsc_uc "irreversibles Fehlerbit bei der SGS-‹berwachung im Befehlstest" UBYTE B_TRUE 1 100 0 1 BIT_MASK 0x1 FORMAT "%13.11" ECU_ADDRESS 0x3FBBFA /end MEASUREMENT
/begin MEASUREMENT ei_sgsc_um "irreversibles Fehlerbit bei der SGS-‹berwachung der Funktions¸berwachung" UBYTE B_TRUE 1 100 0 1 BIT_MASK 0x1 FORMAT "%13.11" ECU_ADDRESS 0x3F986D /end MEASUREMENT
/begin MEASUREMENT ei_spsc_um "irreversibles Fehlerbit bei d. Sollwertplausibilisierung d. Funktions¸berwachung" UBYTE B_TRUE 1 100 0 1 BIT_MASK 0x1 FORMAT "%13.11" ECU_ADDRESS 0x3F9871 /end MEASUREMENT
/begin MEASUREMENT ei_tpu_um "Irreversibles Fehlerbit der TPU-‹berwachung in der Funktions¸berwachung" UBYTE B_TRUE 1 100 0 1 BIT_MASK 0x1 FORMAT "%13.11" ECU_ADDRESS 0x3F98D0 /end MEASUREMENT
/begin MEASUREMENT ei_ubr_um "irrev. Fehlerbit zur Anforderung Fehlereintrag Hauptrelais-Diagnose aus %UMAUSC" UBYTE B_TRUE 1 100 0 1 BIT_MASK 0x1 FORMAT "%13.11" ECU_ADDRESS 0x3F98BF /end MEASUREMENT
/begin MEASUREMENT ei_zwc_um "irreversibles Fehlerbit bei der Z¸ndwinkel¸berwachung der Funktions¸berwachung" UBYTE B_TRUE 1 100 0 1 BIT_MASK 0x1 FORMAT "%13.11" ECU_ADDRESS 0x3F98BC /end MEASUREMENT
/begin MEASUREMENT esst_sbf02mfsb "" ULONG dez 1 100 0 4.29497e+009 FORMAT "%13.2" ECU_ADDRESS 0x5B9A8C /end MEASUREMENT
/begin MEASUREMENT esst_srl03mfuw "" ULONG dez 1 100 0 4.29497e+009 FORMAT "%13.2" ECU_ADDRESS 0x5B9A90 /end MEASUREMENT
/begin MEASUREMENT etate "Motorwirkungsgrad bei Tankentl¸ftung mit hoher Beladung" UBYTE rel_ub_b127p5 1 100 0 127.5 FORMAT "%5.1" ECU_ADDRESS 0x5B8A2A /end MEASUREMENT
/begin MEASUREMENT etateint "Integrator Motrwirkungsgrad bei Tankentl¸ftung" UBYTE rel_ub_b127p5 1 100 0 127.5 FORMAT "%5.1" ECU_ADDRESS 0x5B8A2B /end MEASUREMENT
/begin MEASUREMENT etatesol "beladungsabh‰ngiger Soll-Motorwirkungsgrad bei Betrieb mit Tankentl¸ftung" UBYTE rel_ub_b127p5 1 100 0 127.5 FORMAT "%5.1" ECU_ADDRESS 0x5B8A2C /end MEASUREMENT
/begin MEASUREMENT etazwmn "Minimum-Z¸ndwinkelwirkungsgrad" UBYTE rel_ub_b127p5 1 100 0 127.5 FORMAT "%5.1" ECU_ADDRESS 0x3FC05E /end MEASUREMENT
/begin MEASUREMENT etazw_uc "Ist-Z¸ndwinkelwirkungsgrad im Befehlstest" UBYTE rel_ub_b127p5 1 100 0 127.5 FORMAT "%5.1" ECU_ADDRESS 0x5B8DAF /end MEASUREMENT
/begin MEASUREMENT etazw_um "Ist-Z¸ndwinkelwirkungsgrad in der Funktions¸berwachung" UBYTE rel_ub_b127p5 1 100 0 127.5 FORMAT "%5.1" ECU_ADDRESS 0x3F9934 /end MEASUREMENT
/begin MEASUREMENT evzaust_bt "" UBYTE dez 1 100 0 255 FORMAT "%5.1" ECU_ADDRESS 0x5B8DD0 /end MEASUREMENT
/begin MEASUREMENT EwsNvBits "" UBYTE dez 1 100 0 255 FORMAT "%5.1" ECU_ADDRESS 0x3FE95A /end MEASUREMENT
/begin MEASUREMENT e_mem_um "Errorflag im DauerRAM f¸r Fehler im zyklischen Speichertest in der FU" UBYTE B_TRUE 1 100 0 1 BIT_MASK 0x1 FORMAT "%13.11" ECU_ADDRESS 0x3FD7D0 /end MEASUREMENT
/begin MEASUREMENT e_ram_um "Errorflag im DauerRAM f¸r RAM-Fehler in der Funktions¸berwachung" UBYTE B_TRUE 1 100 0 1 BIT_MASK 0x1 FORMAT "%13.11" ECU_ADDRESS 0x3FD7DA /end MEASUREMENT
/begin MEASUREMENT e_rom1_um "Errorflag im DauerRAM f¸r Fehler nur in einer ROM-Page in der Fkt.¸berwachung" UBYTE B_TRUE 1 100 0 1 BIT_MASK 0x1 FORMAT "%13.11" ECU_ADDRESS 0x3FD7DC /end MEASUREMENT
/begin MEASUREMENT e_romx_um "Errorflag im DauerRAM f¸r Fehler in mehreren ROM-Pages in der Fkt.¸berwachung" UBYTE B_TRUE 1 100 0 1 BIT_MASK 0x1 FORMAT "%13.11" ECU_ADDRESS 0x3FD7DD /end MEASUREMENT
/begin MEASUREMENT e_tpu_um "Fehlerflag im DauerRAM f¸r TPU-Fehler in der Funktions¸berwachung" UBYTE B_TRUE 1 100 0 1 BIT_MASK 0x1 FORMAT "%13.11" ECU_ADDRESS 0x3FD7E4 /end MEASUREMENT
/begin MEASUREMENT fbetate "gew¸nschter Motorwirkungsgrad als f(nmot) bei TE zur Vermeidung von te <= TEMIN" UBYTE fak_ub_b1 1 100 0 0.996094 ECU_ADDRESS 0x5B8A2D /end MEASUREMENT
/begin MEASUREMENT fbkate "Faktor Kraftstoffanteil Tankentl¸ftung abh‰ngig von te / TEMIN" UBYTE fak_ub_b1 1 100 0 0.996094 ECU_ADDRESS 0x5B8A2E /end MEASUREMENT
/begin MEASUREMENT fgren_c_um "" UBYTE t40ms_ub_b10200 1 100 0 10200 FORMAT "%7.1" ECU_ADDRESS 0x3F9819 /end MEASUREMENT
/begin MEASUREMENT fgren_c_ur "" UBYTE dez 1 100 0 255 FORMAT "%5.1" ECU_ADDRESS 0x3F9931 /end MEASUREMENT
/begin MEASUREMENT fgwrte "Eingriff Grenzwertregelung Tankentl¸ftung" SBYTE fak_sb_b16 1 100 -16 15.875 FORMAT "%5.2" ECU_ADDRESS 0x5B8A2F /end MEASUREMENT
/begin MEASUREMENT fkateapp "Faktor applizierter Krafstoffanteil Tankentl¸ftung" SBYTE fak_sb_b1 1 100 -1 0.992188 FORMAT "%5.3" ECU_ADDRESS 0x5B8A30 /end MEASUREMENT
/begin MEASUREMENT fkatefrg "Faktor Kraftstoffanteil Tankentl¸ftung bei Sollsp¸lrate" SBYTE fak_sb_b1 1 100 -1 0.992188 FORMAT "%5.3" ECU_ADDRESS 0x5B8FE8 /end MEASUREMENT
/begin MEASUREMENT fkatei "Faktor Kraftstoffanteil Tankentl¸ftung (aktueller Istwert)" SBYTE fak_sb_b1 1 100 -1 0.992188 FORMAT "%5.3" ECU_ADDRESS 0x5B8FE9 /end MEASUREMENT
/begin MEASUREMENT fkates "Faktor Kraftstoffanteil Tankentl¸ftung (Sollwert)" SBYTE fak_sb_b1 1 100 -1 0.992188 FORMAT "%5.3" ECU_ADDRESS 0x5B8A31 /end MEASUREMENT
/begin MEASUREMENT fngwrte "Faktor Regelung Sp¸lrate nach Grenzwertregeleingriff" SBYTE fak_sb_b16 1 100 -16 15.875 FORMAT "%5.2" ECU_ADDRESS 0x5B8FEA /end MEASUREMENT
/begin MEASUREMENT fregfte "Faktor Regelung Sp¸lrate vor Grenzwertregeleingriff" SBYTE fak_sb_b16 1 100 -16 15.875 FORMAT "%5.2" ECU_ADDRESS 0x5B8FEB /end MEASUREMENT
/begin MEASUREMENT frerr_c_um "FR-Fehlerz‰hler f¸r Differenz FZ-R¸ckmeldung/FZ-Erwartungswert in der Fkt.¸berw." UBYTE dez 1 100 0 255 FORMAT "%5.1" ECU_ADDRESS 0x3F999E /end MEASUREMENT
/begin MEASUREMENT frerr_c_ur "" UBYTE dez 1 100 0 255 FORMAT "%5.1" ECU_ADDRESS 0x3F999F /end MEASUREMENT
/begin MEASUREMENT frmit "Bei Stereo-LR: Mittelwert des fr,fr2 oder bei Ausfall einer Bank: fr der i.O. Bk" UBYTE fak_ub_b2 1 100 0 1.99219 FORMAT "%5.3" ECU_ADDRESS 0x5B8FEC /end MEASUREMENT
/begin MEASUREMENT frmit_w "Mittelwert aus fr und fr2 (16 bit)" UWORD fak_uw_b2 1 100 0 1.99997 FORMAT "%8.6" ECU_ADDRESS 0x5B946C /end MEASUREMENT
/begin MEASUREMENT frmxa "fr-Max-Auschlag: Bei Stereo-LR: der fr, der am weitesten von 1.0 entfernt" UBYTE fak_ub_b2 1 100 0 1.99219 FORMAT "%5.3" ECU_ADDRESS 0x5B8FED /end MEASUREMENT
/begin MEASUREMENT frmxaold_w "Mittelwert Lambdaregler - alter Wert (16 bit)" UWORD fak_uw_b2 1 100 0 1.99997 FORMAT "%8.6" ECU_ADDRESS 0x5B946E /end MEASUREMENT
/begin MEASUREMENT frmxa_w "fr-Max-Ausschlag: Bei Stereo LR der fr, der am weitesten von 1.0 weg (16 bit)" UWORD fak_uw_b2 1 100 0 1.99997 FORMAT "%8.6" ECU_ADDRESS 0x5B9470 /end MEASUREMENT
/begin MEASUREMENT frtar_c_um "Funktionsrechner Fehlerz‰hler-Erwartungswert der Funktions¸berwachung" UBYTE dez 1 100 0 255 FORMAT "%5.1" ECU_ADDRESS 0x5B8DDB /end MEASUREMENT
/begin MEASUREMENT ftadmste "Bewrtungsfaktor f¸r Absteuern des TEV bei dynamischer Vorg‰nge" UBYTE fak_ub_b2 1 100 0 1.99219 FORMAT "%5.3" ECU_ADDRESS 0x5B8FEE /end MEASUREMENT
/begin MEASUREMENT fteadf "gefilteter Faktor Beladung Sp¸lstrom bei Tankentl¸ftung" SBYTE fak_sb_q0p5 1 100 -64 63.5 FORMAT "%5.2" ECU_ADDRESS 0x5B8A32 /end MEASUREMENT
/begin MEASUREMENT fteadf_w "gefilteter Faktor Beladung Sp¸lstrom bei Tankentl¸ftung (16 Bit)" SWORD fak_q0p00195 1 100 -64 63.998 FORMAT "%8.5" ECU_ADDRESS 0x5B8A38 /end MEASUREMENT
/begin MEASUREMENT ftead_w "Beladung des Aktivkohlefilters" SWORD fak_sw_b64 1 100 -64 63.998 FORMAT "%8.5" ECU_ADDRESS 0x5B8A3A /end MEASUREMENT
/begin MEASUREMENT ftefsold_w "Letzter Sollwert der Sp¸lrate Tankentl¸ftung vor Absteuerung" UWORD fak_uw_b0p5 1 100 0 0.499992 FORMAT "%9.7" ECU_ADDRESS 0x5B9472 /end MEASUREMENT
/begin MEASUREMENT ftefsoll_w "Sollwert der Sp¸lrate Tankentl¸ftung" UWORD fak_uw_b0p5 1 100 0 0.499992 FORMAT "%9.7" ECU_ADDRESS 0x5B9474 /end MEASUREMENT
/begin MEASUREMENT ftefva "Sp¸lrate der Tankentl¸ftung" UBYTE fak_ub_b0p5 1 100 0 0.498047 ECU_ADDRESS 0x5B8FEF /end MEASUREMENT
/begin MEASUREMENT ftefvab "Begrenzungswert der Sp¸lrate Tankentl¸ftung" UBYTE fak_ub_b0p03125 1 100 0 0.0311279 FORMAT "%7.5" ECU_ADDRESS 0x5B8A33 /end MEASUREMENT
/begin MEASUREMENT ftefvamx_w "max. Sp¸lrate (Begrenzung absolut, 16 bit)" UWORD fak_uw_b0p5 1 100 0 0.499992 FORMAT "%9.7" ECU_ADDRESS 0x5B9476 /end MEASUREMENT
/begin MEASUREMENT ftefva_w "Sp¸lrate Tankentl¸ftung" UWORD fak_uw_b0p5 1 100 0 0.499992 FORMAT "%9.7" ECU_ADDRESS 0x5B9478 /end MEASUREMENT
/begin MEASUREMENT fteml "Aufsteuergeschwindigkeit der Sp¸lrate und des Massenstroms TEV" UBYTE perio_ub_b0p012207 1 100 0 0.0121593 FORMAT "%7.5" ECU_ADDRESS 0x5B8A34 /end MEASUREMENT
/begin MEASUREMENT fuel_co_bt "" ULONG dez 1 100 0 4.29497e+009 FORMAT "%13.2" ECU_ADDRESS 0x5B9824 /end MEASUREMENT
/begin MEASUREMENT fuel_co_uc "Um ein Abarbeitungsraster verzˆgerte (alte) Einspritzzeit im Befehlstest" ULONG dez 1 100 0 4.29497e+009 FORMAT "%13.2" ECU_ADDRESS 0x5B9828 /end MEASUREMENT
/begin MEASUREMENT fuel_co_um "Um ein Abarbeitungsraster verzˆgerte (alte) Einspritzzeit in der Funktions¸berw." ULONG dez 1 100 0 4.29497e+009 FORMAT "%13.2" ECU_ADDRESS 0x3F9850 /end MEASUREMENT
/begin MEASUREMENT fuel_co_ur "Doppelablage (DA) f¸r FUEL_CO_UM" ULONG dez 1 100 0 4.29497e+009 FORMAT "%13.2" ECU_ADDRESS 0x3F9970 /end MEASUREMENT
/begin MEASUREMENT fvermte_w "Faktor Vermischung Regeneriergas im Saugrohr" UWORD fak_uw_b1 1 100 0 0.999985 FORMAT "%9.7" ECU_ADDRESS 0x5B947A /end MEASUREMENT
/begin MEASUREMENT hwError_um "Fehler HW Zugriff aus CY310 Modulen" UBYTE dez 1 100 0 255 FORMAT "%5.1" ECU_ADDRESS 0x3FD7CE /end MEASUREMENT
/begin MEASUREMENT imsteini "Integral Massenstrom TEV nach l‰ngerem TE-Stop" UBYTE m_ub_q0p0444 1 100 0 11.322 FORMAT "%5.2" ECU_ADDRESS 0x5B8A35 /end MEASUREMENT
/begin MEASUREMENT inisynmon "Monitor-Array mit Gr¸nden der letzten Anforderung einer Neusynchronisation" UWORD dez 1 100 0 65535 FORMAT "%8.2" ARRAY_SIZE 2 ECU_ADDRESS 0x5B9728 /end MEASUREMENT
/begin MEASUREMENT ipa_c_um "Fehlerz‰hler f¸r unterer DK-Anschlag im ung¸ltigen Bereich f. d. Funktions¸berw." UBYTE t40ms_ub_b10200 1 100 0 10200 FORMAT "%7.1" ECU_ADDRESS 0x3F9857 /end MEASUREMENT
/begin MEASUREMENT ipa_c_ur "Doppelablage (DA) f¸r IPA_C_UM" UBYTE dez 1 100 0 255 FORMAT "%5.1" ECU_ADDRESS 0x3F9974 /end MEASUREMENT
/begin MEASUREMENT ipsn_um "aktive DK-Istwertpoti-Info ohne unteren Anschlag f¸r die Funktions¸berwachung" UBYTE spg_ub_q0p019 1 100 0 4.845 FORMAT "%5.3" ECU_ADDRESS 0x3F9858 /end MEASUREMENT
/begin MEASUREMENT ipsn_ur "Doppelablage (DA) f¸r IPSN_UM" UBYTE dez 1 100 0 255 FORMAT "%5.1" ECU_ADDRESS 0x3F9975 /end MEASUREMENT
/begin MEASUREMENT ivmax "Initialisierungswert Integrator f¸r VMAX-Regelung" SBYTE rel_sb_q0p78 1 100 -99.84 99.06 FORMAT "%5.2" ECU_ADDRESS 0x5B8FBD /end MEASUREMENT
/begin MEASUREMENT kfwkorag1 "" SBYTE fak_q0p1 1 100 -12.8 12.7 FORMAT "%5.2" ECU_ADDRESS 0x5B901B /end MEASUREMENT
/begin MEASUREMENT kfwkorag2 "" SBYTE fak_q0p1 1 100 -12.8 12.7 FORMAT "%5.2" ECU_ADDRESS 0x5B901C /end MEASUREMENT
/begin MEASUREMENT kfwkorao1 "" UBYTE temp_ub_q0p75_o48 1 100 -48 143.25 FORMAT "%5.1" ECU_ADDRESS 0x5B901D /end MEASUREMENT
/begin MEASUREMENT kfwkorao2 "" UBYTE temp_ub_q0p75_o48 1 100 -48 143.25 FORMAT "%5.1" ECU_ADDRESS 0x5B901E /end MEASUREMENT
/begin MEASUREMENT khc_w "Adaptierte HC-Konzentration Regenerierstrom" SWORD fak_sw_b2 1 100 -2 1.99994 FORMAT "%8.6" ECU_ADDRESS 0x5B8A3C /end MEASUREMENT
/begin MEASUREMENT kteev_w "Konzentration Regeneriergas im Saugrohr auf Hˆhe der Einspritzventile" UWORD fak_uw_b1 1 100 0 0.999985 FORMAT "%9.7" ECU_ADDRESS 0x5B947C /end MEASUREMENT
/begin MEASUREMENT ktetevvz_w "Konzentration Regeneriergas im Saugrohr verzˆgert" UWORD fak_uw_b1 1 100 0 0.999985 FORMAT "%9.7" ECU_ADDRESS 0x5B947E /end MEASUREMENT
/begin MEASUREMENT ktetev_w "Konzentration Regeneriergas im Saugrohr auf Hˆhe vom TEV" UWORD fak_uw_b1 1 100 0 0.999985 FORMAT "%9.7" ECU_ADDRESS 0x5B9480 /end MEASUREMENT
/begin MEASUREMENT lokBits_Tebeb "" UBYTE dez 1 100 0 255 FORMAT "%5.1" ECU_ADDRESS 0x5B8A3E /end MEASUREMENT
/begin MEASUREMENT mdif_w_uc "Differenz zwischen zul‰ssigem und Ist-Moment im Befehlstest" SWORD rel_ub_b99p6 1 100 -12800 12799.6 FORMAT "%8.2" ECU_ADDRESS 0x5B9048 /end MEASUREMENT
/begin MEASUREMENT mdif_w_um "Differenz zwischen zul‰ssigem und Ist-Moment in der Funktions¸berwachung" SWORD rel_ub_b99p6 1 100 -12800 12799.6 FORMAT "%8.2" ECU_ADDRESS 0x3F993E /end MEASUREMENT
/begin MEASUREMENT mdst08_uc "" ULONG dez 1 100 0 4.29497e+009 FORMAT "%13.2" ECU_ADDRESS 0x5B9818 /end MEASUREMENT
/begin MEASUREMENT mdst08_um "St¸tzstelle f¸r Momenten-Info (MZ_UM) zur Ermittlung des Momenten-Offsets in FU" ULONG dez 1 100 0 4.29497e+009 FORMAT "%13.2" ECU_ADDRESS 0x3F983C /end MEASUREMENT
/begin MEASUREMENT mdst08_ur "Doppelablage der St¸tzstelle f¸r Momenten-Info zur Ermittlung des Offsets in FU" ULONG dez 1 100 0 4.29497e+009 FORMAT "%13.2" ECU_ADDRESS 0x3F9954 /end MEASUREMENT
/begin MEASUREMENT mem_ur "Doppelablage (DA) im DauerRAM f¸r Bit E_MEM_UM" UBYTE dez 1 100 0 255 FORMAT "%5.1" ECU_ADDRESS 0x3FD7D1 /end MEASUREMENT
/begin MEASUREMENT mfgr_uc "Momentenwunsch aus der Fahrgeschwindigkeitsregelung im Befehlstest" UBYTE rel_ub_b99p6 1 100 0 99.6094 FORMAT "%5.2" ECU_ADDRESS 0x5B8DAC /end MEASUREMENT
/begin MEASUREMENT mfgr_um "Momentenwunsch aus der Fahrgeschwindigkeitsregelung f¸r die Funktions¸berwachung" UBYTE rel_ub_b99p6 1 100 0 99.6094 FORMAT "%5.2" ECU_ADDRESS 0x3F981B /end MEASUREMENT
/begin MEASUREMENT mfgr_ur "Doppelablage (DA) f¸r MFGR_UM" UBYTE dez 1 100 0 255 FORMAT "%5.1" ECU_ADDRESS 0x3F9932 /end MEASUREMENT
/begin MEASUREMENT mifa_bt "" UBYTE rel_ub_b99p6 1 100 0 99.6094 FORMAT "%5.2" ECU_ADDRESS 0x5B8DAD /end MEASUREMENT
/begin MEASUREMENT miopt_uc "optimales indiziertes Moment im Befehlstest" UBYTE rel_ub_b99p6 1 100 0 99.6094 FORMAT "%5.2" ECU_ADDRESS 0x5B8DB0 /end MEASUREMENT
/begin MEASUREMENT miopt_um "optimales indiziertes Moment in der Funktions¸berwachung" UBYTE rel_ub_b99p6 1 100 0 99.6094 FORMAT "%5.2" ECU_ADDRESS 0x3F9935 /end MEASUREMENT
/begin MEASUREMENT mired "indiziertes Reduktionsmoment zur VMAX-Regelung" UBYTE rel_ub_b99p6 1 100 0 99.6094 FORMAT "%5.2" ECU_ADDRESS 0x5B8FBE /end MEASUREMENT
/begin MEASUREMENT mitebg_w "Momentvorgabe f¸r Mindestf¸llung Tankentl¸ftung" UWORD rel_uw_b100 1 100 0 99.9985 FORMAT "%8.5" ECU_ADDRESS 0x5B9482 /end MEASUREMENT
/begin MEASUREMENT mivmxs "ind. Soll-Motormoment zur Integratorinitialisierung VMAX-Regelung" SBYTE rel_sb_q0p78 1 100 -99.84 99.06 FORMAT "%5.2" ECU_ADDRESS 0x5B8FBF /end MEASUREMENT
/begin MEASUREMENT mivmx_w "Indiziertes Sollmoment der VMAX-Regelung" UWORD rel_uw_b100 1 100 0 99.9985 FORMAT "%8.5" ECU_ADDRESS 0x5B9426 /end MEASUREMENT
/begin MEASUREMENT mi_uc "Berechnetes Ist-Moment im Befehlstest" UBYTE rel_ub_b99p6 1 100 0 99.6094 FORMAT "%5.2" ECU_ADDRESS 0x5B8DB1 /end MEASUREMENT
/begin MEASUREMENT mi_um "Berechnetes Ist-Moment in der Funktions¸berwachung" UBYTE rel_ub_b99p6 1 100 0 99.6094 FORMAT "%5.2" ECU_ADDRESS 0x3F981D /end MEASUREMENT
/begin MEASUREMENT mi_ur "DA (Doppelablage)  f¸r MI_UM" UBYTE dez 1 100 0 255 FORMAT "%5.1" ECU_ADDRESS 0x3F9936 /end MEASUREMENT
/begin MEASUREMENT mmsr_uc "zul‰ssiger MSR-Momentenwunsch f¸r die Funktions¸berwachung" UBYTE rel_ub_b99p6 1 100 0 99.6094 FORMAT "%5.2" ECU_ADDRESS 0x5B8DB6 /end MEASUREMENT
/begin MEASUREMENT mmsr_um "zul‰ssiger MSR-Momentenwunsch f¸r die Funktions¸berwachung" UBYTE rel_ub_b99p6 1 100 0 99.6094 FORMAT "%5.2" ECU_ADDRESS 0x3F9821 /end MEASUREMENT
/begin MEASUREMENT mmsr_ur "DA (Doppelablage)  f¸r MMSR_UM" UBYTE dez 1 100 0 255 FORMAT "%5.1" ECU_ADDRESS 0x3F9939 /end MEASUREMENT
/begin MEASUREMENT modul_c_um "Modulaufrufz‰hler f¸r Programm-Ablauf-Kontrolle (%URPAK)in der FU" UWORD dez 1 100 0 65535 FORMAT "%8.2" ECU_ADDRESS 0x5B9052 /end MEASUREMENT
/begin MEASUREMENT mped_uc "zul‰ssiges indiziertes Moment aus Fahrpedal im Befehlstest" UBYTE rel_ub_b99p6 1 100 0 99.6094 FORMAT "%5.2" ECU_ADDRESS 0x5B8DCB /end MEASUREMENT
/begin MEASUREMENT mped_um "zul‰ssiges indiziertes Moment aus Fahrpedal in der Funktions¸berwachung" UBYTE rel_ub_b99p6 1 100 0 99.6094 FORMAT "%5.2" ECU_ADDRESS 0x3F9950 /end MEASUREMENT
/begin MEASUREMENT msgs_uc "Soll- Motormoment aus Getriebe¸berwachung im Befehlstest" UBYTE rel_ub_b99p6 1 100 0 99.6094 FORMAT "%5.2" ECU_ADDRESS 0x5B8DD4 /end MEASUREMENT
/begin MEASUREMENT msgs_um "Soll- Motormoment aus Getriebe¸berwachung in der Funktions¸berwachung" UBYTE rel_ub_b99p6 1 100 0 99.6094 FORMAT "%5.2" ECU_ADDRESS 0x3F986E /end MEASUREMENT
/begin MEASUREMENT msgs_ur "Doppelablage (DA) f¸r MSGS_UM" UBYTE dez 1 100 0 255 FORMAT "%5.1" ECU_ADDRESS 0x3F9992 /end MEASUREMENT
/begin MEASUREMENT msrc_c_uc "Fehlerz‰hler f¸r MSR-‹berwachung des Befehlstestes" UBYTE t40ms_ub_b10200 1 100 0 10200 FORMAT "%7.1" ECU_ADDRESS 0x5B8DB7 /end MEASUREMENT
/begin MEASUREMENT msrc_c_um "Fehlerz‰hler f¸r MSR-Eingriff-‹berwachung der Funktions¸berwachung" UBYTE t40ms_ub_b10200 1 100 0 10200 FORMAT "%7.1" ECU_ADDRESS 0x3F9822 /end MEASUREMENT
/begin MEASUREMENT msrc_c_ur "Doppelablage (DA) f¸r MSRC_C_UM" UBYTE dez 1 100 0 255 FORMAT "%5.1" ECU_ADDRESS 0x3F993A /end MEASUREMENT
/begin MEASUREMENT mssginmn_w "Minmaler ins Saugrohr strˆmender Massenstrom (Drosselklappe + TEV)" UWORD m_uw_b6553p5 1 100 0 6553.5 FORMAT "%8.3" ECU_ADDRESS 0x5B9484 /end MEASUREMENT
/begin MEASUREMENT mssgin_w "Ins Saugrohr strˆmender Massenstrom (Drosselklappe + TEV)" UWORD m_uw_b6553p5 1 100 0 6553.5 FORMAT "%8.3" ECU_ADDRESS 0x5B9486 /end MEASUREMENT
/begin MEASUREMENT msteev_w "Massenstrom Regeneriergas auf Hˆhe Einspritzventil" UWORD m_uw_b25p6 1 100 0 25.5996 FORMAT "%8.5" ECU_ADDRESS 0x5B9488 /end MEASUREMENT
/begin MEASUREMENT mstesmx_w "Maximal mˆglicher Sollmassenstrom Tankentl¸ftung" UWORD m_uw_b25p6 1 100 0 25.5996 FORMAT "%8.5" ECU_ADDRESS 0x5B948A /end MEASUREMENT
/begin MEASUREMENT mstesoll_w "Massenstrom Tankentl¸ftung ins Saugrohr, Sollwert" UWORD m_uw_b25p6 1 100 0 25.5996 FORMAT "%8.5" ECU_ADDRESS 0x5B948C /end MEASUREMENT
/begin MEASUREMENT mver_c_uc "Fehlerz‰hler f¸r Momentenvergleich im Befehlstest" UBYTE t40ms_ub_b10200 1 100 0 10200 FORMAT "%7.1" ECU_ADDRESS 0x5B8DB8 /end MEASUREMENT
/begin MEASUREMENT mver_c_um "Fehlerz‰hler f¸r Momentenvergleich der Funktions¸berwachung" UBYTE t40ms_ub_b10200 1 100 0 10200 FORMAT "%7.1" ECU_ADDRESS 0x3F9824 /end MEASUREMENT
/begin MEASUREMENT mver_c_ur "Doppelablage (DA) f¸r MVER_C_UM" UBYTE dez 1 100 0 255 FORMAT "%5.1" ECU_ADDRESS 0x3F993C /end MEASUREMENT
/begin MEASUREMENT mzfo_uc "Gefiltertes zul‰ssiges Moment inclusive Offset im Befehlstest" UBYTE rel_ub_b99p6 1 100 0 99.6094 FORMAT "%5.2" ECU_ADDRESS 0x5B8DB9 /end MEASUREMENT
/begin MEASUREMENT mzfo_um "gefiltertes zul‰ssiges Moment inclusive Offset in der Funktions¸berwachung" UBYTE rel_ub_b99p6 1 100 0 99.6094 FORMAT "%5.2" ECU_ADDRESS 0x3F993D /end MEASUREMENT
/begin MEASUREMENT mzf_l_uc "Nachkommastellen f¸r gefiltertes zul‰ssiges Moment des Befehlstestes" UBYTE rel_ub_q0p00153 1 100 0 0.389074 ECU_ADDRESS 0x5B8DBC /end MEASUREMENT
/begin MEASUREMENT mzf_l_um "Nachkommastellen f¸r gefiltertes zul‰ssiges Moment der Funktions¸berwachung" UBYTE rel_ub_q0p00153 1 100 0 0.389074 ECU_ADDRESS 0x3F9828 /end MEASUREMENT
/begin MEASUREMENT mzf_l_ur "Doppelablage (DA) f¸r MZF_L_UM" UBYTE dez 1 100 0 255 FORMAT "%5.1" ECU_ADDRESS 0x3F9940 /end MEASUREMENT
/begin MEASUREMENT mzf_p_uc "Zeiger des Schieberegisters f¸r Verzugszeit mzf_r_ur im Momentenfilter des BT" UBYTE dez 1 100 0 255 FORMAT "%5.1" ECU_ADDRESS 0x5B8DBD /end MEASUREMENT
/begin MEASUREMENT mzf_p_um "Zeiger des Schieberegisters f¸r Verzugszeit mzf_r_um im Momentenfilter der FU" UBYTE dez 1 100 0 255 FORMAT "%5.1" ECU_ADDRESS 0x3F9829 /end MEASUREMENT
/begin MEASUREMENT mzf_p_ur "Doppelablage (DA) f¸r MZF_P_UM" UBYTE dez 1 100 0 255 FORMAT "%5.1" ECU_ADDRESS 0x3F9941 /end MEASUREMENT
/begin MEASUREMENT mzf_r_uc "Schieberegister f¸r Verzugszeit im Momentenfilter des Befehlstestes" UBYTE rel_ub_q0p3906 1 100 0 99.6094 FORMAT "%5.2" ARRAY_SIZE 8 ECU_ADDRESS 0x5B8DC0 /end MEASUREMENT
/begin MEASUREMENT mzf_r_um "Schieberegister f¸r Verzugszeit im Momentenfilter der Funktions¸berwachung" UBYTE rel_ub_q0p3906 1 100 0 99.6094 FORMAT "%5.2" ARRAY_SIZE 8 ECU_ADDRESS 0x3F982C /end MEASUREMENT
/begin MEASUREMENT mzf_r_ur "Doppelablage (DA) f¸r MZF_R_UM" UBYTE dez 1 100 0 255 FORMAT "%5.1" ARRAY_SIZE 8 ECU_ADDRESS 0x3F9944 /end MEASUREMENT
/begin MEASUREMENT mzf_uc "gefiltertes zul‰ssiges Moment im Befehlstest" UBYTE rel_ub_q0p3906 1 100 0 99.6094 FORMAT "%5.2" ECU_ADDRESS 0x5B8DC8 /end MEASUREMENT
/begin MEASUREMENT mzf_um "gefiltertes zul‰ssiges Moment der Funktions¸berwachung" UBYTE rel_ub_q0p3906 1 100 0 99.6094 FORMAT "%5.2" ECU_ADDRESS 0x3F9834 /end MEASUREMENT
/begin MEASUREMENT mzf_ur "Doppelablage (DA) f¸r MZF_UM" UBYTE dez 1 100 0 255 FORMAT "%5.1" ECU_ADDRESS 0x3F994C /end MEASUREMENT
/begin MEASUREMENT mzf_x_uc "" UBYTE dez 1 100 0 255 FORMAT "%5.1" ECU_ADDRESS 0x5B8DC9 /end MEASUREMENT
/begin MEASUREMENT mzf_y_uc "" UBYTE dez 1 100 0 255 FORMAT "%5.1" ECU_ADDRESS 0x5B8DCA /end MEASUREMENT
/begin MEASUREMENT mzo_uc "Toleranz-Offset f¸r das zul‰ssige Moment im Befehlstest" UBYTE rel_ub_b99p6 1 100 0 99.6094 FORMAT "%5.2" ECU_ADDRESS 0x5B8DCC /end MEASUREMENT
/begin MEASUREMENT mzo_um "Toleranz-Offset f¸rs zul‰ssige Moment in der Funktions¸berwachung" UBYTE rel_ub_b99p6 1 100 0 99.6094 FORMAT "%5.2" ECU_ADDRESS 0x3F9838 /end MEASUREMENT
/begin MEASUREMENT mzo_ur "Doppelablage (DA) f¸r MZO_UM" UBYTE dez 1 100 0 255 FORMAT "%5.1" ECU_ADDRESS 0x3F9951 /end MEASUREMENT
/begin MEASUREMENT mz_uc "resultierendes zul‰ssiges Moment im Befehlstest" UBYTE rel_ub_b99p6 1 100 0 99.6094 FORMAT "%5.2" ECU_ADDRESS 0x5B8DCD /end MEASUREMENT
/begin MEASUREMENT mz_um "resultierendes zul‰ssiges Moment aus der Koordination der Funktions¸berwachung" UBYTE rel_ub_b99p6 1 100 0 99.6094 FORMAT "%5.2" ECU_ADDRESS 0x3F9839 /end MEASUREMENT
/begin MEASUREMENT mz_ur "Doppelablage (DA) f¸r MZ_UM" UBYTE dez 1 100 0 255 FORMAT "%5.1" ECU_ADDRESS 0x3F9952 /end MEASUREMENT
/begin MEASUREMENT nc_c_um "Fehlerz‰hler f¸r Motordrehzahlvergleich f¸r die Funktions¸berwachung" UBYTE t40ms_ub_b10200 1 100 0 10200 FORMAT "%7.1" ECU_ADDRESS 0x3F9841 /end MEASUREMENT
/begin MEASUREMENT nc_c_ur "Doppelablage Fehlerz‰hler f¸r Motordrehzahlvergleich f¸r die Funktions¸berwachug" UBYTE dez 1 100 0 255 FORMAT "%5.1" ECU_ADDRESS 0x3F9958 /end MEASUREMENT
/begin MEASUREMENT newansw_um "Neue Antwort an das UM in der Funktions¸berwachung" ULONG dez 1 100 0 4.29497e+009 FORMAT "%13.2" ECU_ADDRESS 0x5B982C /end MEASUREMENT
/begin MEASUREMENT newqr_ur "" UBYTE dez 1 100 0 255 FORMAT "%5.1" ECU_ADDRESS 0x3F99A0 /end MEASUREMENT
/begin MEASUREMENT newque_um "Neue Frage vom UM, expandiert in der Funktions¸berwachung" ULONG dez 1 100 0 4.29497e+009 FORMAT "%13.2" ECU_ADDRESS 0x5B9830 /end MEASUREMENT
/begin MEASUREMENT newqu_um "Neue Frage vom UM in der Funktions¸berwachung" UBYTE dez 1 100 0 255 FORMAT "%5.1" ECU_ADDRESS 0x5B8DDC /end MEASUREMENT
/begin MEASUREMENT nmot_uc "Motordrehzahl im Befehlstest" UBYTE nmot_ub_q40 1 100 0 10200 FORMAT "%5.0" ECU_ADDRESS 0x5B8DCE /end MEASUREMENT
/begin MEASUREMENT nmot_um "Motordrehzahl in der Funktions¸berwachung" UBYTE nmot_ub_q40 1 100 0 10200 FORMAT "%5.0" ECU_ADDRESS 0x3F9842 /end MEASUREMENT
/begin MEASUREMENT nmot_ur "Doppelablage Motordrehzahl in der Funktions¸berwachung" UBYTE dez 1 100 0 255 FORMAT "%5.1" ECU_ADDRESS 0x3F9959 /end MEASUREMENT
/begin MEASUREMENT nmst08_uc "" ULONG dez 1 100 0 4.29497e+009 FORMAT "%13.2" ECU_ADDRESS 0x5B981C /end MEASUREMENT
/begin MEASUREMENT nmst08_um "St¸tzstelle f¸r Motordrehzahl in der Funktions¸berwachung (NMOT_UM)" ULONG dez 1 100 0 4.29497e+009 FORMAT "%13.2" ECU_ADDRESS 0x3F9844 /end MEASUREMENT
/begin MEASUREMENT nmst08_ur "Doppelablage der St¸tzstelle f¸r Motordrehzahl in der Funktions¸berwachung" ULONG dez 1 100 0 4.29497e+009 FORMAT "%13.2" ECU_ADDRESS 0x3F9960 /end MEASUREMENT
/begin MEASUREMENT nsc_c_um "Nachstart-Zeitz‰hler Nachstartaufweitung der FU" UWORD t40msxs_uw_q0p04 1 100 0 2621.4 FORMAT "%8.3" ECU_ADDRESS 0x3F984A /end MEASUREMENT
/begin MEASUREMENT nsc_c_ur "Komplement:Nachstart¸berwachungszeitz‰hler f¸r die Funktions¸berwachung" UWORD dez 1 100 0 65535 FORMAT "%8.2" ECU_ADDRESS 0x3F996A /end MEASUREMENT
/begin MEASUREMENT nseg_um "Motordrehzahl aus Segmentzeit in der Funktions¸berwachung" UBYTE nmot_ub_q40 1 100 0 10200 FORMAT "%5.0" ECU_ADDRESS 0x3F995A /end MEASUREMENT
/begin MEASUREMENT nska_uc "Grenzdrehzahl bei aktiver Fehlerreaktion im Befehlstest" UBYTE nmot_ub_q40 1 100 0 10200 FORMAT "%5.0" ECU_ADDRESS 0x5B8DD1 /end MEASUREMENT
/begin MEASUREMENT nska_um "Grenzdrehzahl bei aktiver Fehlerreaktion in der Funktions¸berwachung" UBYTE nmot_ub_q40 1 100 0 10200 FORMAT "%5.0" ECU_ADDRESS 0x3F996C /end MEASUREMENT
/begin MEASUREMENT nsof_c_um "Z‰hler Entprellzeit f¸r Abschaltung der Nachstartaufweitung" UBYTE t40ms_ub_b10200 1 100 0 10200 FORMAT "%7.1" ECU_ADDRESS 0x3F9849 /end MEASUREMENT
/begin MEASUREMENT nsof_c_ur "Komplement:Z‰hler Entprellzeit F¸r Abschaltung Nachstartaufweitung" UBYTE dez 1 100 0 255 FORMAT "%5.1" ECU_ADDRESS 0x3F9968 /end MEASUREMENT
/begin MEASUREMENT nxtrp_ur "" UBYTE dez 1 100 0 255 FORMAT "%5.1" ECU_ADDRESS 0x3F99A1 /end MEASUREMENT
/begin MEASUREMENT nz_um "Motordrehzahl aus Zahnz‰hlerdifferenz pro Zeit in der Funktions¸berwachung" UBYTE t40ms_ub_b10200 1 100 0 10200 FORMAT "%7.1" ECU_ADDRESS 0x3F99B1 /end MEASUREMENT
/begin MEASUREMENT n_flags_uc "Byte f¸r Nachstart-Bits des Befehlstestes" UBYTE dez 1 100 0 255 FORMAT "%5.1" ECU_ADDRESS 0x5B8DD6 /end MEASUREMENT
/begin MEASUREMENT n_flags_um "Byte f¸r Nachstart-Bits der Funktions¸berwachung" UBYTE dez 1 100 0 255 FORMAT "%5.1" ECU_ADDRESS 0x3F987A /end MEASUREMENT
/begin MEASUREMENT plstate_um "Zustand zur Plausibilisierung des UM in der Funktions¸berwachung" UBYTE dez 1 100 0 255 FORMAT "%5.1" ECU_ADDRESS 0x5B8DDD /end MEASUREMENT
/begin MEASUREMENT plstate_ur "" UBYTE dez 1 100 0 255 FORMAT "%5.1" ECU_ADDRESS 0x3F99A2 /end MEASUREMENT
/begin MEASUREMENT pm_akt "" UBYTE dez 1 100 0 255 FORMAT "%5.1" ECU_ADDRESS 0x3FB5B8 /end MEASUREMENT
/begin MEASUREMENT pm_fre "" UBYTE dez 1 100 0 255 FORMAT "%5.1" ECU_ADDRESS 0x3FB5B9 /end MEASUREMENT
/begin MEASUREMENT pm_mod "" UBYTE dez 1 100 0 255 FORMAT "%5.1" ECU_ADDRESS 0x3FB5BA /end MEASUREMENT
/begin MEASUREMENT pm_ta "" UBYTE dez 1 100 0 255 FORMAT "%5.1" ECU_ADDRESS 0x3FB5BB /end MEASUREMENT
/begin MEASUREMENT pm_td "" UBYTE dez 1 100 0 255 FORMAT "%5.1" ECU_ADDRESS 0x3FB5BC /end MEASUREMENT
/begin MEASUREMENT pspu "Quotient Saugrohrdruck Umgebungsdruck" UBYTE fak_ub_b2 1 100 0 1.99219 FORMAT "%5.3" ECU_ADDRESS 0x5B8FF0 /end MEASUREMENT
/begin MEASUREMENT pty_fctr "" UBYTE dez 1 100 0 255 FORMAT "%5.1" ECU_ADDRESS 0x5B8A86 /end MEASUREMENT
/begin MEASUREMENT qmsdyn "Quotient aus ml_w und mssgin_w" UBYTE fak_ub_b16 1 100 0 15.9375 FORMAT "%5.2" ECU_ADDRESS 0x5B8FF1 /end MEASUREMENT
/begin MEASUREMENT qtetemin "Quotient: te / TEMIN f¸r BDE teh_w/teminh_w bzw. tes_w/temins" UBYTE fak_ub_b4 1 100 0 3.98438 FORMAT "%5.3" ECU_ADDRESS 0x5B8FF2 /end MEASUREMENT
/begin MEASUREMENT ram_c_um "Fehlerz‰hler im Dauer-RAM f¸r RAM-Konsistenz-Pr¸fung (Diagnose) in der Fkt-‹berw" UBYTE dez 1 100 0 255 FORMAT "%5.1" ECU_ADDRESS 0x3FD7C4 /end MEASUREMENT
/begin MEASUREMENT ram_ur "" UBYTE dez 1 100 0 255 FORMAT "%5.1" ECU_ADDRESS 0x3FD7DB /end MEASUREMENT
/begin MEASUREMENT raster_um "Allgemeiner Z‰hler des 10ms Raster der Funktions¸berwachung" UWORD dez 1 100 0 65535 FORMAT "%8.2" ECU_ADDRESS 0x5B903C /end MEASUREMENT
/begin MEASUREMENT reac_c1_uc "Fehlerz‰hler 1 f¸r Fehlerreaktions¸berwachung im Befehlstest" UBYTE t40ms_ub_b10200 1 100 0 10200 FORMAT "%7.1" ECU_ADDRESS 0x5B8DD2 /end MEASUREMENT
/begin MEASUREMENT reac_c1_um "Fehlerz‰hler 1 f¸r Fehlerreaktions¸berwachung in Funktions¸berwachung" UBYTE t40ms_ub_b10200 1 100 0 10200 FORMAT "%7.1" ECU_ADDRESS 0x3F984D /end MEASUREMENT
/begin MEASUREMENT reac_c1_ur "Doppelablage (DA) f¸r REAC_C1_UM" UBYTE dez 1 100 0 255 FORMAT "%5.1" ECU_ADDRESS 0x3F996D /end MEASUREMENT
/begin MEASUREMENT reac_c2_uc "Fehlerz‰hler 2 f¸r Fehlerreaktions¸berwachung im Befehlstest" UBYTE t40ms_ub_b10200 1 100 0 10200 FORMAT "%7.1" ECU_ADDRESS 0x5B8DD3 /end MEASUREMENT
/begin MEASUREMENT reac_c2_um "Fehlerz‰hler 2 f¸r Fehlerreaktions¸berwachung in Funktions¸berwachung" UBYTE t40ms_ub_b10200 1 100 0 10200 FORMAT "%7.1" ECU_ADDRESS 0x3F984E /end MEASUREMENT
/begin MEASUREMENT reac_c2_ur "Doppelablage (DA) f¸r REAC_C2_UM" UBYTE dez 1 100 0 255 FORMAT "%5.1" ECU_ADDRESS 0x3F996E /end MEASUREMENT
/begin MEASUREMENT reac_c_um "Fehlerz‰hler im Dauer-RAM f¸r Fehlerreaktions¸berwachung (Diagnose) in der FU" UBYTE dez 1 100 0 255 FORMAT "%5.1" ECU_ADDRESS 0x3FD7C5 /end MEASUREMENT
/begin MEASUREMENT rec_fctr "" UBYTE dez 1 100 0 255 FORMAT "%5.1" ECU_ADDRESS 0x5B8A87 /end MEASUREMENT
/begin MEASUREMENT reset_indication_um "" UWORD dez 1 100 0 65535 FORMAT "%8.2" ECU_ADDRESS 0x3FD7CA /end MEASUREMENT
/begin MEASUREMENT rkte_w "Relativer Gemischanteil Tankentl¸ftung" SWORD rel_sw_q0p0468 1 100 -1536 1535.95 FORMAT "%8.3" ECU_ADDRESS 0x5B948E /end MEASUREMENT
/begin MEASUREMENT rlc_c_um "Fehlerz‰hler f¸r rl-Vergleich mit der Funktion in der Funktions¸berwachung" UBYTE t40ms_ub_b10200 1 100 0 10200 FORMAT "%7.1" ECU_ADDRESS 0x3F9859 /end MEASUREMENT
/begin MEASUREMENT rlc_c_ur "Doppelablage Fehlerz‰hler f¸r rl-Vergleich mit der Funktion in der FU" UBYTE dez 1 100 0 255 FORMAT "%5.1" ECU_ADDRESS 0x3F9976 /end MEASUREMENT
/begin MEASUREMENT rlipf_l_um "= rlipf_low_um Nachkommastelle von rlipf_um in der Funktions¸berwachung" UBYTE rel_ub_q0p0029 1 100 0 0.74707 ECU_ADDRESS 0x3F985A /end MEASUREMENT
/begin MEASUREMENT rlipf_l_ur "Komplement: relative Luftf¸llung aus Nebenlastsignal hinter Tiefpaﬂ" UBYTE dez 1 100 0 255 FORMAT "%5.1" ECU_ADDRESS 0x3F9977 /end MEASUREMENT
/begin MEASUREMENT rlipf_p_um "Zeiger des register rlipf_r_um in der Funktions¸berwachung" UBYTE dez 1 100 0 255 FORMAT "%5.1" ECU_ADDRESS 0x3F985B /end MEASUREMENT
/begin MEASUREMENT rlipf_p_ur "Doppelablage des Zeigers rlipf_p_um in der Funktions¸berwachung" UBYTE dez 1 100 0 255 FORMAT "%5.1" ECU_ADDRESS 0x3F9978 /end MEASUREMENT
/begin MEASUREMENT rlipf_r_um "Register f¸r zeitverzˆgerten Wert von rlip_um in der Funktions¸berwachung" UBYTE rel_ub_q0p75 1 100 0 191.25 FORMAT "%5.1" ARRAY_SIZE 8 ECU_ADDRESS 0x3F985C /end MEASUREMENT
/begin MEASUREMENT rlipf_r_ur "Doppelablage des Registers rlipf_r_um in der Funktions¸berwachung" UBYTE dez 1 100 0 255 FORMAT "%5.1" ARRAY_SIZE 8 ECU_ADDRESS 0x3F997C /end MEASUREMENT
/begin MEASUREMENT rlipf_um "relative Luftf¸llung aus Nebenlastsignal hinter Tiefpaﬂ in der Funktions¸berw." UBYTE rel_ub_q0p75 1 100 0 191.25 FORMAT "%5.1" ECU_ADDRESS 0x3F9864 /end MEASUREMENT
/begin MEASUREMENT rlipf_ur "Doppelablage relative Luftf¸llung aus Nebenlastsignal hinter Tiefpaﬂ in der FU" UBYTE dez 1 100 0 255 FORMAT "%5.1" ECU_ADDRESS 0x3F9984 /end MEASUREMENT
/begin MEASUREMENT rlip_c_um "Fehlerz‰hler f¸r rl/rlip-Vergleich in der Funktions¸berwachung" UBYTE t40ms_ub_b10200 1 100 0 10200 FORMAT "%7.1" ECU_ADDRESS 0x3F9865 /end MEASUREMENT
/begin MEASUREMENT rlip_c_ur "Doppelablage Fehlerz‰hler f¸r rl/rlip-Vergleich in der Funktions¸berwachung" UBYTE dez 1 100 0 255 FORMAT "%5.1" ECU_ADDRESS 0x3F9985 /end MEASUREMENT
/begin MEASUREMENT rlip_um "relative Luftf¸llung aus Nebenlastsignal f¸r die Funktions¸berwachung" UBYTE rel_ub_q0p75 1 100 0 191.25 FORMAT "%5.1" ECU_ADDRESS 0x3F9986 /end MEASUREMENT
/begin MEASUREMENT rlst08_uc "rlst08_um im Befehlstest" ULONG dez 1 100 0 4.29497e+009 FORMAT "%13.2" ECU_ADDRESS 0x5B9814 /end MEASUREMENT
/begin MEASUREMENT rlst08_um "St¸tzstelle der SSV RLV08_UM" ULONG dez 1 100 0 4.29497e+009 FORMAT "%13.2" ECU_ADDRESS 0x3F9868 /end MEASUREMENT
/begin MEASUREMENT rlst08_ur "Doppelablage von rlst08_um" ULONG dez 1 100 0 4.29497e+009 FORMAT "%13.2" ECU_ADDRESS 0x3F998C /end MEASUREMENT
/begin MEASUREMENT rlteev_w "Relative F¸llung verursacht durch Regeneriergas Tankentl¸ftung" UWORD rel_uw_b192 1 100 0 191.997 FORMAT "%8.4" ECU_ADDRESS 0x5B9490 /end MEASUREMENT
/begin MEASUREMENT rlzo_um "obere Toleranzgrenze f¸r rl aus Nebenlastsignal in der Funktions¸berwachung" UBYTE rel_ub_q0p75 1 100 0 191.25 FORMAT "%5.1" ECU_ADDRESS 0x3F9987 /end MEASUREMENT
/begin MEASUREMENT rl_uc "relative Luftf¸llung im Befehlstest" UBYTE rel_ub_q0p75 1 100 0 191.25 FORMAT "%5.1" ECU_ADDRESS 0x5B8DB2 /end MEASUREMENT
/begin MEASUREMENT rl_um "relative Luftf¸llung in der Funktions¸berwachung" UBYTE rel_ub_q0p75 1 100 0 191.25 FORMAT "%5.1" ECU_ADDRESS 0x3F9866 /end MEASUREMENT
/begin MEASUREMENT rl_ur "Doppelablage relative Luftf¸llung in der Funktions¸berwachung" UBYTE dez 1 100 0 255 FORMAT "%5.1" ECU_ADDRESS 0x3F9988 /end MEASUREMENT
/begin MEASUREMENT rl_w_um "relative Luftf¸llung (Word) in der Funktions¸berwachung" UWORD rel_uw_q0p0234 1 100 0 1535.98 FORMAT "%8.3" ECU_ADDRESS 0x3F9990 /end MEASUREMENT
/begin MEASUREMENT rom1_ur "" UBYTE dez 1 100 0 255 FORMAT "%5.1" ECU_ADDRESS 0x3FD7DE /end MEASUREMENT
/begin MEASUREMENT rompage_um "Adresse im DauerRAM der einzelnen fehlerhaften ROM-Page  in der Fkt.¸berw." UBYTE dez 1 100 0 255 FORMAT "%5.1" ECU_ADDRESS 0x3FD7DF /end MEASUREMENT
/begin MEASUREMENT rompage_ur "" UBYTE dez 1 100 0 255 FORMAT "%5.1" ECU_ADDRESS 0x3FD7E0 /end MEASUREMENT
/begin MEASUREMENT romrstc_um "Z‰hler im DauerRAM f¸r Resets bei ROM-Check-Fehler in der Init. in der FU" UBYTE dez 1 100 0 255 FORMAT "%5.1" ECU_ADDRESS 0x3FD7E1 /end MEASUREMENT
/begin MEASUREMENT romx_ur "" UBYTE dez 1 100 0 255 FORMAT "%5.1" ECU_ADDRESS 0x3FD7E2 /end MEASUREMENT
/begin MEASUREMENT romz_c_um "Fehlerz‰hler im Dauer-RAM f¸r ROM-Pr¸fung (Diagnose) in der Funktions¸berwachung" UBYTE dez 1 100 0 255 FORMAT "%5.1" ECU_ADDRESS 0x3FD7C6 /end MEASUREMENT
/begin MEASUREMENT r_flags_uc "Byte f¸r Fehlerreaktions-Bits des Befehlstest" UBYTE dez 1 100 0 255 FORMAT "%5.1" ECU_ADDRESS 0x5B8DD7 /end MEASUREMENT
/begin MEASUREMENT r_flags_um "Byte f¸r Fehlerreaktions-Bits der Funktions¸berwachung" UBYTE dez 1 100 0 255 FORMAT "%5.1" ECU_ADDRESS 0x3F987B /end MEASUREMENT
/begin MEASUREMENT sp1s_um "aktueller Wert f¸r Sollwert-Poti 1 (PWG) f¸r die Funktions¸berwachung" UBYTE spg_ub_q0p019 1 100 0 4.845 FORMAT "%5.3" ECU_ADDRESS 0x3F9994 /end MEASUREMENT
/begin MEASUREMENT sp2s_um "aktueller Wert f¸r Sollwert-Poti 2 (PWG) f¸r die Funktions¸berwachung" UBYTE spg_ub_q0p0098 1 100 0 2.49023 FORMAT "%5.3" ECU_ADDRESS 0x3F9995 /end MEASUREMENT
/begin MEASUREMENT spnst08_uc "" ULONG dez 1 100 0 4.29497e+009 FORMAT "%13.2" ECU_ADDRESS 0x5B9820 /end MEASUREMENT
/begin MEASUREMENT spnst08_um "St¸tzstelle f¸r aktive Sollwertpoti-Info (SPSN_UM) in FU" ULONG dez 1 100 0 4.29497e+009 FORMAT "%13.2" ECU_ADDRESS 0x3F9874 /end MEASUREMENT
/begin MEASUREMENT spnst08_ur "Doppelablage der St¸tzstelle f¸r aktive Sollwertpoti-Info in FU" ULONG dez 1 100 0 4.29497e+009 FORMAT "%13.2" ECU_ADDRESS 0x3F9998 /end MEASUREMENT
/begin MEASUREMENT spsc_c_um "Fehlerz‰hler bei zueinander unplausiblen Sollwerten in der Funktions¸berwachung" UBYTE t40ms_ub_b10200 1 100 0 10200 FORMAT "%7.1" ECU_ADDRESS 0x3F9872 /end MEASUREMENT
/begin MEASUREMENT spsc_c_ur "Doppelablage (DA) f¸r SPSC_C_UM" UBYTE dez 1 100 0 255 FORMAT "%5.1" ECU_ADDRESS 0x3F9996 /end MEASUREMENT
/begin MEASUREMENT spsn_uc "Pedalwert (8 Bit) im Befehlstest" UBYTE spg_ub_q0p019 1 100 0 4.845 FORMAT "%5.3" ECU_ADDRESS 0x5B8DCF /end MEASUREMENT
/begin MEASUREMENT spsn_um "Pedalsollwert (8 Bit) in der Funktions¸berwachung" UBYTE spg_ub_q0p019 1 100 0 4.845 FORMAT "%5.3" ECU_ADDRESS 0x3F9873 /end MEASUREMENT
/begin MEASUREMENT spsn_ur "Doppelablage (DA) f¸r SPSN_UM" UBYTE dez 1 100 0 255 FORMAT "%5.1" ECU_ADDRESS 0x3F9997 /end MEASUREMENT
/begin MEASUREMENT srst_c_um "Z‰hler im Dauer-RAM f¸r Software-Reset (Diagnose) aus der Funktions¸berwachung" UBYTE dez 1 100 0 255 FORMAT "%5.1" ECU_ADDRESS 0x3FD7C7 /end MEASUREMENT
/begin MEASUREMENT stw_prog_frei_mod "" UBYTE dez 1 100 0 255 FORMAT "%5.1" ECU_ADDRESS 0x5B8A88 /end MEASUREMENT
/begin MEASUREMENT stw_prog_frei_ta "" UBYTE dez 1 100 0 255 FORMAT "%5.1" ECU_ADDRESS 0x5B8A89 /end MEASUREMENT
/begin MEASUREMENT stw_prog_frei_td "" UBYTE dez 1 100 0 255 FORMAT "%5.1" ECU_ADDRESS 0x5B8A8A /end MEASUREMENT
/begin MEASUREMENT szout_w "Schlieﬂzeitausgabe" UWORD txms_uw_q0p001 1 100 0 65.535 FORMAT "%8.5" ECU_ADDRESS 0x5B949A /end MEASUREMENT
/begin MEASUREMENT s_flags_uc "Byte f¸r Status-Bits des Befehlstests" UBYTE dez 1 100 0 255 FORMAT "%5.1" ECU_ADDRESS 0x5B8DD8 /end MEASUREMENT
/begin MEASUREMENT s_flags_um "Byte f¸r Status-Bits der Funktions¸berwachung" UBYTE dez 1 100 0 255 FORMAT "%5.1" ECU_ADDRESS 0x3F987C /end MEASUREMENT
/begin MEASUREMENT tc72alt_um "System-Timerwert zum vorhergehen Berechnungszeitpunkt des 720∞ Zahnz‰hlers in FU" ULONG txms_uw_q0p0004 1 100 0 1.71799e+006 FORMAT "%13.5" ECU_ADDRESS 0x3F98D8 /end MEASUREMENT
/begin MEASUREMENT tc72alt_ur "Doppelablage (DA) f¸rTC72ALT_UM" ULONG dez 1 100 0 4.29497e+009 FORMAT "%13.2" ECU_ADDRESS 0x3F99BC /end MEASUREMENT
/begin MEASUREMENT tdifs1_um "Summe der Zeitdifferenzen zwischen der TPU- und der CPU-Segmentzeit in der FU" SLONG txms_uw_q0p0004 1 100 -858993 858993 FORMAT "%13.6" ECU_ADDRESS 0x3F99C0 /end MEASUREMENT
/begin MEASUREMENT tdifs1_ur "Doppelablagebyte f¸r tdifs1_um in der Funktions¸berwachung" SLONG dez 1 100 -2.14748e+009 2.14748e+009 FORMAT "%13.2" ECU_ADDRESS 0x3F99C4 /end MEASUREMENT
/begin MEASUREMENT tpuca_c_um "Z‰hler f¸r TPU-Pr¸fung aktiv in der Funktions¸berwachung" UBYTE t10ms_ub_b2550 1 100 0 2550 ECU_ADDRESS 0x3F98D2 /end MEASUREMENT
/begin MEASUREMENT tpuca_c_ur "Doppelablagebyte f¸r tpuca_c_um in der Funktions¸berwachung" UBYTE dez 1 100 0 255 FORMAT "%5.1" ECU_ADDRESS 0x3F99B2 /end MEASUREMENT
/begin MEASUREMENT tpucr_c_um "Fehlerz‰hler des TPU-Code-RAM-Tests in der Funktions¸berwachung" UBYTE dez 1 100 0 255 FORMAT "%5.1" ECU_ADDRESS 0x3F98D3 /end MEASUREMENT
/begin MEASUREMENT tpucr_c_ur "Doppelablagebyte f¸r tpucr_c_um in der Funktions¸berwachung" UBYTE dez 1 100 0 255 FORMAT "%5.1" ECU_ADDRESS 0x3F99B3 /end MEASUREMENT
/begin MEASUREMENT tpura_c_um "Z‰hler f¸r TPU-Code-RAM-Test aktiv in der Funktions¸berwachung" UBYTE t10ms_ub_b2550 1 100 0 2550 ECU_ADDRESS 0x3F98D4 /end MEASUREMENT
/begin MEASUREMENT tpura_c_ur "Doppelablagebyte f¸r tpura_c_um in der Funktions¸berwachung" UBYTE dez 1 100 0 255 FORMAT "%5.1" ECU_ADDRESS 0x3F99B4 /end MEASUREMENT
/begin MEASUREMENT tpurstc_um "Z‰hler im DauerRAM f¸r Resets aus der TPU-‹berwachung" UBYTE dez 1 100 0 255 FORMAT "%5.1" ECU_ADDRESS 0x3FD7E3 /end MEASUREMENT
/begin MEASUREMENT tpust_c_um "TPU-Start-Zeitz‰hler zur Aktivierung TPU-‹berwachung nach Synchronisation" UBYTE t10ms_ub_b2550 1 100 0 2550 ECU_ADDRESS 0x3F98D5 /end MEASUREMENT
/begin MEASUREMENT tpust_c_ur "" UBYTE dez 1 100 0 255 FORMAT "%5.1" ECU_ADDRESS 0x3F99B5 /end MEASUREMENT
/begin MEASUREMENT tpu_c_um "Fehlerz‰hler der TPU-‹berwachung in der Funktions¸berwachung" UBYTE dez 1 100 0 255 FORMAT "%5.1" ECU_ADDRESS 0x3F98D6 /end MEASUREMENT
/begin MEASUREMENT tpu_c_ur "Doppelablagebyte f¸r tpu_c_um in der Funktions¸berwachung" UBYTE dez 1 100 0 255 FORMAT "%5.1" ECU_ADDRESS 0x3F99B6 /end MEASUREMENT
/begin MEASUREMENT tseg_um "Segmentzeit aus Differenz der Timerst‰nde aus dem Sync in der FU" ULONG txms_uw_q0p0004 1 100 0 1.71799e+006 FORMAT "%13.5" ECU_ADDRESS 0x3F9964 /end MEASUREMENT
/begin MEASUREMENT tsm_alt_um "Timerwert des Sys.timers an vorhergeher Synchronmarke aus Sync-Raster in der FU" ULONG txms_uw_q0p0004 1 100 0 1.71799e+006 FORMAT "%13.5" ECU_ADDRESS 0x3F99C8 /end MEASUREMENT
/begin MEASUREMENT tsm_um "Timerwert des Systemtimers an Synchronmarke aus Sync-Raster in der FU" ULONG txms_uw_q0p0004 1 100 0 1.71799e+006 FORMAT "%13.5" ECU_ADDRESS 0x3F99CC /end MEASUREMENT
/begin MEASUREMENT ttimout "" UWORD dez 1 100 0 65535 FORMAT "%8.2" ECU_ADDRESS 0x3FE954 /end MEASUREMENT
/begin MEASUREMENT tweiter "" UWORD dez 1 100 0 65535 FORMAT "%8.2" ECU_ADDRESS 0x3FE956 /end MEASUREMENT
/begin MEASUREMENT twuerg "" UWORD dez 1 100 0 65535 FORMAT "%8.2" ECU_ADDRESS 0x3FE958 /end MEASUREMENT
/begin MEASUREMENT t_flags_uc "Byte f¸r Tempomat-Bits des Befehlstests" UBYTE dez 1 100 0 255 FORMAT "%5.1" ECU_ADDRESS 0x5B8DD9 /end MEASUREMENT
/begin MEASUREMENT t_flags_um "Byte f¸r Tempomat-Bits der Funktions¸berwachung" UBYTE dez 1 100 0 255 FORMAT "%5.1" ECU_ADDRESS 0x3F987D /end MEASUREMENT
/begin MEASUREMENT UetmNvBits "" UBYTE dez 1 100 0 255 FORMAT "%5.1" ECU_ADDRESS 0x3FDBCD /end MEASUREMENT
/begin MEASUREMENT ugenslp "Generatorsollspannung bei SLP-Betrieb" UWORD spg_sw_q0p001 1 100 0 16 FORMAT "%8.5" ECU_ADDRESS 0x5B89B4 /end MEASUREMENT
/begin MEASUREMENT ugloc "" SWORD spg_sw_q0p001 1 100 0 30 FORMAT "%8.5" ECU_ADDRESS 0x5B89B6 /end MEASUREMENT
/begin MEASUREMENT umerr_c_um "Fehlerz‰hler-R¸ckmeldung des UM in der Funktions¸berwachung" UBYTE dez 1 100 0 255 FORMAT "%5.1" ECU_ADDRESS 0x5B8DDE /end MEASUREMENT
/begin MEASUREMENT umrst_c_um "Z‰hler im Dauer-RAM f¸r Software-Reset (Diagnose) aus %UMKOM" UBYTE dez 1 100 0 255 FORMAT "%5.1" ECU_ADDRESS 0x3FD7C8 /end MEASUREMENT
/begin MEASUREMENT upwg2_um "Spannung PWG-Poti2 im ADC-Test in der Funktions¸berwachung" UWORD spg_q0p00977 1 100 0 639.99 FORMAT "%8.4" ECU_ADDRESS 0x3F99A8 /end MEASUREMENT
/begin MEASUREMENT uramp "" SWORD spg_sw_q0p001 1 100 0 30 FORMAT "%8.5" ECU_ADDRESS 0x5B89B8 /end MEASUREMENT
/begin MEASUREMENT urmcksco "Checksumme ¸ber Code der Funktions¸berwachung im zyklischen ROM-Test" UWORD dez 1 100 0 65535 FORMAT "%8.2" ARRAY_SIZE 2 ECU_ADDRESS 0x3FD7D2 /end MEASUREMENT
/begin MEASUREMENT urmcksda "Checksumme ¸ber Daten der Funktions¸berwachung im zyklischen ROM-Test" UWORD dez 1 100 0 65535 FORMAT "%8.2" ARRAY_SIZE 2 ECU_ADDRESS 0x3FD7D6 /end MEASUREMENT
/begin MEASUREMENT urmpatco "Patch-Adresse im Code der Funktions¸berwachung f¸r ‹berpr¸fung zykl. ROM-Test" UWORD dez 1 100 0 65535 FORMAT "%8.2" ARRAY_SIZE 2 ECU_ADDRESS 0x3F98CA /end MEASUREMENT
/begin MEASUREMENT vfgr_bt "" UWORD vfzg_uw_q0p0625 1 100 0 4095.94 FORMAT "%8.3" ECU_ADDRESS 0x5B9040 /end MEASUREMENT
/begin MEASUREMENT vfzgpr_w "Pr‰dizierte Fahrzeuggeschwindigkeit f¸r VMAX-Regelung" UWORD vfzg_uw_q0p00781 1 100 0 511.992 FORMAT "%8.4" ECU_ADDRESS 0x5B9428 /end MEASUREMENT
/begin MEASUREMENT watch_error "" SBYTE dez 1 100 -128 127 FORMAT "%5.1" ECU_ADDRESS 0x5B8B89 /end MEASUREMENT
/begin MEASUREMENT watch_state "" SBYTE dez 1 100 -128 127 FORMAT "%5.1" ECU_ADDRESS 0x5B8B8A /end MEASUREMENT
/begin MEASUREMENT wc_fctr "" UBYTE dez 1 100 0 255 FORMAT "%5.1" ECU_ADDRESS 0x5B8A8B /end MEASUREMENT
/begin MEASUREMENT wes "Winkelmarke Einlass schliesst bezogen auf Z¸nd-OT Zylinder 1" UBYTE kw_q3 1 100 0 765 FORMAT "%5.1" ECU_ADDRESS 0x5B8C51 /end MEASUREMENT
/begin MEASUREMENT wesnesprau "Ausgang aus Kennlinie WESNESPR" UWORD kw_q1 1 100 0 65535 FORMAT "%8.2" ECU_ADDRESS 0x5B967C /end MEASUREMENT
/begin MEASUREMENT wmtxa_in "Eingang Kennlinie WMTXA" UBYTE temp_ub_q0p75_o48 1 100 -48 143.25 FORMAT "%5.1" ECU_ADDRESS 0x5B8A8E /end MEASUREMENT
/begin MEASUREMENT wphg "Z¸ndwinkel DG-Phasenkorrektur" SBYTE zw_sb_q0p75 1 100 -96 95.25 FORMAT "%5.2" ECU_ADDRESS 0x5B8FFC /end MEASUREMENT
/begin MEASUREMENT wri_c_um "Fehlerz‰hler im Dauer-RAM f¸r RAM-Beschreibbarkeits-Pr¸fung (Diagnose) in der FU" UBYTE dez 1 100 0 255 FORMAT "%5.1" ECU_ADDRESS 0x3FD7C9 /end MEASUREMENT
/begin MEASUREMENT znachanz "Anzahl der Z¸ndungen im Nachlauf" UBYTE dez 1 100 0 255 FORMAT "%5.1" ECU_ADDRESS 0x3FC059 /end MEASUREMENT
/begin MEASUREMENT zsync_um "Kennung f¸r Synchronisation in der Funktions¸berwachung" UBYTE dez 1 100 0 255 FORMAT "%5.1" ECU_ADDRESS 0x3F995B /end MEASUREMENT
/begin MEASUREMENT zsync_ur "1-er Komplement zur Kennung f¸r Synchronisation in der Funktions¸berwachung" UBYTE dez 1 100 0 255 FORMAT "%5.1" ECU_ADDRESS 0x3F995C /end MEASUREMENT
/begin MEASUREMENT zsytp1_um "Kennung1 f¸r fehlendes Synchro" UBYTE dez 1 100 0 255 FORMAT "%5.1" ECU_ADDRESS 0x3F99B7 /end MEASUREMENT
/begin MEASUREMENT zsytp2_um "Kennung2 f¸r fehlendes Synchro" UBYTE dez 1 100 0 255 FORMAT "%5.1" ECU_ADDRESS 0x3F99B8 /end MEASUREMENT
/begin MEASUREMENT zwbas "Basisz¸ndwinkel" SBYTE zw_sb_q0p75 1 100 -96 95.25 FORMAT "%5.2" ECU_ADDRESS 0x3FC05A /end MEASUREMENT
/begin MEASUREMENT zwbasar "Basisz¸ndwinkelarray" SBYTE zw_sb_q0p75 1 100 -96 95.25 FORMAT "%5.2" ARRAY_SIZE 4 ECU_ADDRESS 0x5B9000 /end MEASUREMENT
/begin MEASUREMENT zwbaskrkor "" SBYTE zw_sb_q0p75 1 100 -96 95.25 FORMAT "%5.2" ARRAY_SIZE 4 ECU_ADDRESS 0x5B9004 /end MEASUREMENT
/begin MEASUREMENT zwc_c_um "Fehlerz‰hler f¸r Z¸ndwinkel¸berwachung in der Funktions¸berwachung" UBYTE dez 1 100 0 255 FORMAT "%5.1" ECU_ADDRESS 0x3F98BD /end MEASUREMENT
/begin MEASUREMENT zwc_c_ur "Doppelablage des Fehlerz‰hlers for ignition angle monitoring" UBYTE dez 1 100 0 255 FORMAT "%5.1" ECU_ADDRESS 0x3F999C /end MEASUREMENT
/begin MEASUREMENT zwgru "Grundz¸ndwinkel" SBYTE zw_sb_q0p75 1 100 -96 95.25 FORMAT "%5.2" ECU_ADDRESS 0x5B901F /end MEASUREMENT
/begin MEASUREMENT zwist "Ist-Z¸ndwinkel" SBYTE zw_sb_q0p75 1 100 -96 95.25 FORMAT "%5.2" ECU_ADDRESS 0x3FC05B /end MEASUREMENT
/begin MEASUREMENT zwkrafld "Bitmuster des zyl.ind. abgelegten B_zwkra" UBYTE dez 1 100 0 255 FORMAT "%5.1" ECU_ADDRESS 0x3FC05C /end MEASUREMENT
/begin MEASUREMENT zwks "abs. Z¸ndwinkel aus %KS_W bzw. %ZWKS" SBYTE zw_sb_q0p75 1 100 -96 95.25 FORMAT "%5.2" ECU_ADDRESS 0x5B9021 /end MEASUREMENT
/begin MEASUREMENT zwmn "Sp‰tester Z¸ndwinkel" SBYTE zw_sb_q0p75 1 100 -96 95.25 FORMAT "%5.2" ECU_ADDRESS 0x5B9024 /end MEASUREMENT
/begin MEASUREMENT zwmnd "dynamisch sp‰test zul‰ssiger Z¸ndwinkel" SBYTE zw_sb_q0p75 1 100 -96 95.25 FORMAT "%5.2" ECU_ADDRESS 0x5B9025 /end MEASUREMENT
/begin MEASUREMENT zwmnms "dauerhaft sp‰test mˆglicher Z¸ndwinkel" SBYTE zw_sb_q0p75 1 100 -96 95.25 FORMAT "%5.2" ECU_ADDRESS 0x5B9026 /end MEASUREMENT
/begin MEASUREMENT zwnst "" SBYTE zw_sb_q0p75 1 100 -96 95.25 FORMAT "%5.2" ECU_ADDRESS 0x5B9027 /end MEASUREMENT
/begin MEASUREMENT zwopt_uc "optimaler Z¸ndwinkel im Befehlstest" SBYTE zw_sb_q0p75 1 100 -96 95.25 FORMAT "%5.2" ECU_ADDRESS 0x5B8DB3 /end MEASUREMENT
/begin MEASUREMENT zwopt_um "optimaler Z¸ndwinkel in der Funktions¸berwachung" SBYTE zw_sb_q0p75 1 100 -96 95.25 FORMAT "%5.2" ECU_ADDRESS 0x3F9937 /end MEASUREMENT
/begin MEASUREMENT zwout "Z¸ndwinkel-Ausgabe" SBYTE zw_sb_q0p75 1 100 -96 95.25 FORMAT "%5.2" ECU_ADDRESS 0x3FC05D /end MEASUREMENT
/begin MEASUREMENT zwoutar "Z¸ndwinkel-Ausgabe Array" SBYTE zw_sb_q0p75 1 100 -96 95.25 FORMAT "%5.2" ARRAY_SIZE 4 ECU_ADDRESS 0x5B9008 /end MEASUREMENT
/begin MEASUREMENT zwoutcpl "Einerkomplement des Z¸ndwinkels f¸r die Funktions¸berwachung" SBYTE zw_sb_q0p75 1 100 -96 95.25 FORMAT "%5.2" ECU_ADDRESS 0x5B900C /end MEASUREMENT
/begin MEASUREMENT zwoutzyl "" SBYTE zw_sb_q0p75 1 100 -96 95.25 FORMAT "%5.2" ARRAY_SIZE 8 ECU_ADDRESS 0x5B9010 /end MEASUREMENT
/begin MEASUREMENT zwout_uc "Ausgabe-Z¸ndwinkel im Befehlstest" SBYTE zw_sb_q0p75 1 100 -96 95.25 FORMAT "%5.2" ECU_ADDRESS 0x5B8DB4 /end MEASUREMENT
/begin MEASUREMENT zwout_um "Ausgabe-Z¸ndwinkel f¸r die Funktions¸berwachung" SBYTE zw_sb_q0p75 1 100 -96 95.25 FORMAT "%5.2" ECU_ADDRESS 0x3F98BE /end MEASUREMENT
/begin MEASUREMENT zwout_ur "Doppelablage Ausgabe-Z¸ndwinkel f¸r die Funktins¸berwachung" SBYTE dez 1 100 -128 127 FORMAT "%5.1" ECU_ADDRESS 0x3F999D /end MEASUREMENT
/begin MEASUREMENT zwspae "Sp‰tester Z¸ndwinkel" SBYTE zw_sb_q0p75 1 100 -96 95.25 FORMAT "%5.2" ECU_ADDRESS 0x5B9028 /end MEASUREMENT
/begin MEASUREMENT zwstnm "Startz¸ndwinkel nmot-abh‰ngiger Anteil" SBYTE zw_sb_q0p75 1 100 -96 95.25 FORMAT "%5.2" ECU_ADDRESS 0x5B9029 /end MEASUREMENT
/begin MEASUREMENT zwstnmtm "Startz¸ndwinkel nmot/tmst abh‰ngiger Anteil" SBYTE zw_sb_q0p75 1 100 -96 95.25 FORMAT "%5.2" ECU_ADDRESS 0x5B902A /end MEASUREMENT
/begin MEASUREMENT zwstt "Z¸ndwinkel im Start" SBYTE zw_sb_q0p75 1 100 -96 95.25 FORMAT "%5.2" ECU_ADDRESS 0x5B902B /end MEASUREMENT
/begin MEASUREMENT zwstta "Startz¸ndwinkel tans-abh‰ngiger Anteil" SBYTE zw_sb_q0p75 1 100 -96 95.25 FORMAT "%5.2" ECU_ADDRESS 0x5B902C /end MEASUREMENT
/begin MEASUREMENT zwzyl1 "Z¸ndwinkel Zylinder 1" SBYTE zw_sb_q0p75 1 100 -96 95.25 FORMAT "%5.2" ECU_ADDRESS 0x5B9018 /end MEASUREMENT
/begin MEASUREMENT z_flags_uc "Byte f¸r Status-Bits beim 2-SG-Konzept im Befehlstestes" UBYTE dez 1 100 0 255 FORMAT "%5.1" ECU_ADDRESS 0x5B8DDA /end MEASUREMENT
/begin MEASUREMENT z_flags_um "Byte f¸r Status-Bits beim 2-SG-Konzept in der Funktions¸berwachung" UBYTE dez 1 100 0 255 FORMAT "%5.1" ECU_ADDRESS 0x3F987E /end MEASUREMENT
/begin FUNCTION TEB "Tankentl¸ftung beladungsabh‰ngig"
 /begin DEF_CHARACTERISTIC DFTEAHB DMSTES DSTEMIN FBTEB FBTEVA FBZBTEML FETATEBN FKATEB FQTEDL FQTEPT FQTEVA FRHB FSRFTEF FTEADAB FTEADMX FTEFHB FTEHB FTEINIX FUMRBRK FVERMN FVERZDYN FVRMDYN KFETATE KFFQTEFR KFFTEAN KFFTEAX KFQTE KFTADMS KFTATX KFTEKA KHCTEAMX KHCTEMN KHCTEMX MSDKLMMN NVERZMN TFTEINI TQTEAB TQTEDAB TVSATEM ZBTEML ZETATE ZKFTEAD ZMLTE ZMSSGIN /end DEF_CHARACTERISTIC
 /begin REF_CHARACTERISTIC KUMSRL SFR08TEUB SML08TEUB SQM05TEUB TEMIN /end REF_CHARACTERISTIC
 /begin IN_MEASUREMENT abo B_abor B_evloc B_frmax B_frmin B_lr B_nmot B_nswo1 B_qtedab B_sab B_te B_tef B_tei B_ten B_tep dpssol_w dps_uw dps_w esst_sfr08teub esst_sml08teub esst_sqm05teub frm_w mifa_w miopt_w ml mlsol_w ml_w msdkalm_w mste mstedte_w msteo_w mste_w nmot nmot_w ps_w pte pu rl rlsol_w tans te_w tmot umsrln_w wdkba /end IN_MEASUREMENT
 /begin OUT_MEASUREMENT B_lrar B_teabb B_tehb B_tehbx dmssginr etate fkatei frmit frmit_w frmxa frmxa_w fteadf ftead_w ftefsoll_w ftefva_w imsteini mitebg_w mssgin_w mstesoll_w pspu qmsdyn rkte_w /end OUT_MEASUREMENT
 /begin LOC_MEASUREMENT B_gwrte B_teakt dftef_w dkatefrg dkhc_w dmlftef dstert20_w etateint etatesol fbetate fbkate fgwrte fkateapp fkatefrg fkates fngwrte fregfte frmxaold_w ftadmste fteadf_w ftefsold_w ftefva ftefvab ftefvamx_w fteml fvermte_w khc_w kteev_w ktetevvz_w ktetev_w mssginmn_w msteev_w mstesmx_w qtetemin rlteev_w /end LOC_MEASUREMENT
/end FUNCTION
/begin FUNCTION TEBEB "Einschaltbedingungen Tankentl¸ftung" /begin DEF_CHARACTERISTIC CWTEACFG LAMTEMN LAMTEMX TMSTTE TMTE TTEAUS /end DEF_CHARACTERISTIC
 /begin IN_MEASUREMENT B_atmtpa B_dldpte B_dllra B_dsls B_dteaa B_eobdlr B_fraoan B_ftedab B_lamka B_lamsdef B_lr B_lrssa B_m8te B_mdarv B_mlrsa B_sbbvk B_sls B_tep lamsons_w tateist tatesoll tmot tmst /end IN_MEASUREMENT
 /begin OUT_MEASUREMENT B_qtedab B_te B_tef B_tei B_ten /end OUT_MEASUREMENT
 /begin LOC_MEASUREMENT B_tenmda lokBits_Tebeb /end LOC_MEASUREMENT
/end FUNCTION
/begin FUNCTION TI_CB_CERDD "" /end FUNCTION
/begin FUNCTION TI_CB_NS "" /end FUNCTION
/begin FUNCTION TI_CB_RCOOBC "" /begin IN_MEASUREMENT B_m8te B_mde8e /end IN_MEASUREMENT /end FUNCTION
/begin FUNCTION TI_CB_RERDTC "" /begin IN_MEASUREMENT fcmEnd /end IN_MEASUREMENT /end FUNCTION
/begin FUNCTION TI_CB_RFCMS "" /begin IN_MEASUREMENT fcmEnd /end IN_MEASUREMENT /end FUNCTION
/begin FUNCTION TI_CB_RFNCM ""
 /begin IN_MEASUREMENT B_cdkat B_cdsls B_cdtes B_cwdslt m6cmsl m6cmslv m6smslv_w m6smsl_w m6wmslv_w m6wmsl_w tc6katc tc6kats tc6katw tc6tesc tc6tess tc6tesw /end IN_MEASUREMENT
/end FUNCTION
/begin FUNCTION TI_CB_ROSMR ""
 /begin REF_CHARACTERISTIC ATVFETTO ATVFETTU ATVMAGO ATVMAGU TPSVKMN TPSVKMX TUSPNMN TUSPNMX USMNSAMN USMNSAMX USMNSHMN USMNSHMX USMXSAMN USMXSAMX USMXSHMN USMXSHMX USRHKSHJ /end REF_CHARACTERISTIC
 /begin IN_MEASUREMENT atvfett atvmager B_lsh B_lsh2 B_lsv B_lsv2 tpsvlssa tuspnf usmnsan usmnshn usmxsan usmxshn usrj /end IN_MEASUREMENT
/end FUNCTION
/begin FUNCTION TI_CB_RPTDD "" /begin REF_CHARACTERISTIC CWKONFLS CWOBD /end REF_CHARACTERISTIC
 /begin IN_MEASUREMENT B_cdkvs B_cdmd B_kmmilsct B_lsh B_lsh2 B_lsv B_lsv2 B_milstat B_sls B_slsfz evsup1 flglrs fra_w fr_w kmstmil_w mshfm_w nmot_w ready rml tanslin tmotlin ushkj usvkj vfzg wdkba zwzyl1 /end IN_MEASUREMENT
/end FUNCTION
/begin FUNCTION TI_CB_RPTFF "" /begin IN_MEASUREMENT B_xff ffzdfp /end IN_MEASUREMENT /end FUNCTION
/begin FUNCTION TI_CB_UTILITIES "" /begin IN_MEASUREMENT fcmEnd /end IN_MEASUREMENT /end FUNCTION
/begin FUNCTION TI_K2_CDI_B "" /begin IN_MEASUREMENT fcmEnd /end IN_MEASUREMENT /end FUNCTION
/begin FUNCTION ti_k2_er_b "" /begin IN_MEASUREMENT nmot_w /end IN_MEASUREMENT /end FUNCTION
/begin FUNCTION TI_K2_IOCBLI_B ""
 /begin REF_CHARACTERISTIC NFSACVMN NFSACVMX NFSMVMN NFSMVMX NLLMVMN NLLMVMX NSACMVMN NSACMVMX NSLBVMN NSLBVMX TMNV TMNVFS /end REF_CHARACTERISTIC
 /begin IN_MEASUREMENT anznmax anzpbr_w atveekpt B_ac B_acc B_agr B_akrfz B_ascpkw B_autget B_avset B_brems B_bt B_btavs B_btdisa B_btebl B_bteekp B_bteepcl B_btefgr B_btekp B_btemil B_btepcl B_btev1 B_btev2 B_btev3 B_btev4 B_btfgr B_bthsh B_bthsv B_btkos B_btmil B_btmls3 B_btslp B_btslv B_btsslv B_btsta B_bttev B_btvsa B_btvsa2 B_btvse B_btvse2 B_cotrim B_eblet B_ekpet B_etret B_faetr B_faglf B_famls B_glfet B_hshet B_hsvet B_kftvar B_kl15 B_koset B_kovar B_mfl B_mls3et B_nokatfz B_nsabg B_oeldr B_pn B_slpet B_slvet B_sslvet B_staet B_tevet co_pot disatst Disa_ist Disa_spg Ditv_aus dnfsacmv dnfsmv dnllmv dnsacmv dnslbv ES_fgrs ES_fgrsb ES_fgrsv fr_w gangi hshtim hsvtim kmstnmax kmstpbr_w mdverl_w mifa_w migs_w milsol_w mimsr_w mizsol_w mkfanb_w mracc_w mshfm_w nmaxvk_w nmot nmot_w nsol ps_w pu_w rinv_w rkrn_w rk_w rml taml tamldia tans tevtim te_w tka tkatm tmot tmst tnse_u toel_w tol tsg tumg t_bthsh t_bthsv t_bttev t_bttim uadki uddss_w udkp1v_w udkp1_w udkp2_w udsu_w ugen uhfm_w uhsh uhsv upwg1_w upwg2_w uthk uushk_w uusvk_w vfzg wdkba wnwatst wnwetst wnwi_w wped wtans wtka wtmot wtol wtsg wub zwout /end IN_MEASUREMENT
 /begin OUT_MEASUREMENT B_clvar /end OUT_MEASUREMENT
/end FUNCTION
/begin FUNCTION TI_K2_RDBCI_B ""
 /begin IN_MEASUREMENT B_akr B_atmtpa B_atmtpk B_bl B_br B_ebl B_eculock B_ekp B_estart B_etr B_fofr1 B_fs B_hshe B_hsve B_kd B_kh B_kl15 B_ko B_koe B_krdws B_kuppl B_ll B_llk B_lltd B_lr B_lrnrdy B_mil B_nsub B_nvrbupok B_pn B_sa B_sbbhk B_sbbvk B_slp B_slv B_sta B_te B_teakt B_tehb B_vl co_pot_w dffgen dfmonitor dfseresz_w dmllri_w dmrllr_w dmvadfk_w dmvadfs_w dmvadko_w dmvadll_w dmvad_w dpsraus_i dpssol_w dps_w dwkr dzws fcmEnd fho_w fkmsdka_w fkmsdk_w fkmsvvta_w fkmsvvt_w fofresz fprstep_c fra_w fr_w ftbr_w ftvdk lrnstep_c lutsfi1_w lutsfi2_w lutsfi3_w lutsfi4_w mdgen mdko mdwan_w miist_w mimin_w msdif_w mshfm_w msndko_w msnvvtoll msnvvto_w nmot_w nsol nsol_w rinh_w rkat_w rkrn_w rlsol_w rl_w tabgm taml tans tateist tedub te_w tkalin tmot tnse_w tsg tumg ub upwg1_w upwg_w usvk_w uulsuv_w uusvk_w vfzg Vsa_adp Vsa_adp_fl Vsa_spri Vsa_sprs Vsa_tv Vse_adp Vse_adp_fl Vse_spri Vse_sprs Vse_tv wdkba wdkba_w wdks_w wnwkwa_w wnwkwe_w wped_w zwist zwout /end IN_MEASUREMENT
/end FUNCTION
/begin FUNCTION ti_k2_rdbli_b "" /begin REF_CHARACTERISTIC NUEMAX S_WDKADOF /end REF_CHARACTERISTIC
 /begin IN_MEASUREMENT anznmax anzpbr_w B_acc B_agrrdy B_akr B_bl B_br B_cdagr B_cdhsv B_cdlsv B_cdsls B_cdtes B_dylsu B_dylsuav B_ebl B_ekp B_estart B_etr B_fgrat B_fgrhsa B_fgrtbe B_fgrtse B_fgrtve B_fgrtwa B_fhz B_gap B_hshe B_hsrdy B_hsve B_katfz B_katrdy B_kd B_kl15 B_ko B_koe B_kuppl B_lkrall B_ll B_llr B_lr B_lra B_lrat B_lrnakt B_lrnerf B_lrnfg B_lrnrdy B_lrnvb B_lrnws B_lsrdy B_nac B_nftev B_nsub B_pn B_sa B_sbbhk B_sbbvk B_slp B_slsrdy B_sta B_tesrdy B_umae B_umauab B_vl disa_sta Di_lernst dkatstat evz_austot fcmEnd flglrs fr_w kmstmil_w kmstnmax kmstpbr_w kva_korr llsstat lutsfi1_w lutsfi2_w lutsfi3_w lutsfi4_w L_fgr miist_w mshfm_w nmaxvk_w nmot_w nsol oscdktf_w rkrn_w slsstat tans tesstat te_w tkalin tmot top_w ub upwg1_w uusvk_w vfzg wdkba wnwi_w zwout /end IN_MEASUREMENT
/end FUNCTION
/begin FUNCTION TI_K2_RDTCBS_B "" /begin IN_MEASUREMENT fcmEnd /end IN_MEASUREMENT /end FUNCTION
/begin FUNCTION TI_K2_SPC_B "" /begin IN_MEASUREMENT B_bt B_fa nmot /end IN_MEASUREMENT /end FUNCTION
/begin FUNCTION ti_k2_sprbli_b ""
 /begin IN_MEASUREMENT B_clradbbo B_clradfof B_clradhoe B_clradkr B_clradkrd B_clradllr B_clradlr B_clradlra B_clradlrh B_clradmhb B_clradmsz B_clradvvt B_faavr B_fadisa B_fadk B_fadka B_faevz B_fakat B_fallas B_falls B_falr B_falra B_falsh B_falsv B_falsv2 B_fanws B_fanwsd B_fasls B_fates B_grdst B_wdksap /end IN_MEASUREMENT
/end FUNCTION
/begin FUNCTION ti_k2_strbli_b ""
 /begin IN_MEASUREMENT B_auswrt B_clradbbo B_clradfof B_clradhoe B_clradkr B_clradkrd B_clradllr B_clradlr B_clradlra B_clradlrh B_clradmhb B_clradmsz B_clradvvt B_dylsu B_dylsuav B_eepwf B_fa B_faavr B_fadisa B_fadk B_fadka B_faevz B_fakat B_fallas B_falls B_falr B_falra B_falsh B_falsv B_falsv2 B_fanws B_fanwsd B_fasls B_fates B_gap B_grdst B_inistw B_kl15 B_ll B_nmot B_resstw B_st B_timerr B_wdksap disa_sta evz_austot flglrs llsstat nmot_w nsolfa pm_akt pm_fre pm_mod pm_ta pm_td slsstat stw_prog_frei_mod stw_prog_frei_ta stw_prog_frei_td tesstat tmot top_w ttimout wnwstst /end IN_MEASUREMENT
 /begin OUT_MEASUREMENT B_faadav devoff /end OUT_MEASUREMENT
/end FUNCTION
/begin FUNCTION ti_k2_wdbci_b "" /begin IN_MEASUREMENT nmot_w top_w /end IN_MEASUREMENT /end FUNCTION
/begin FUNCTION ti_k2_wdbli_b "" /begin IN_MEASUREMENT kva_korr /end IN_MEASUREMENT /end FUNCTION
/begin FUNCTION TI_UTILIT "" /begin IN_MEASUREMENT fcmEnd /end IN_MEASUREMENT /end FUNCTION
/begin FUNCTION ti_vm_dnmt_b "" /begin IN_MEASUREMENT nmot_w /end IN_MEASUREMENT /end FUNCTION
/begin FUNCTION TI_VM_RDS2TCF_B "" /begin IN_MEASUREMENT fcmEnd /end IN_MEASUREMENT /end FUNCTION
/begin FUNCTION TI_VM_RDS2TCM_B "" /begin IN_MEASUREMENT fcmEnd FCMTab kmstand /end IN_MEASUREMENT /end FUNCTION
/begin FUNCTION UCFGRC ""
 /begin DEF_CHARACTERISTIC FGRC_BFGR_DAT_UC FGRC_MIFA_DAT_UC FGRC_SFLAGS_DAT_UC FGRC_VFGR_DAT_UC VMIN_UC /end DEF_CHARACTERISTIC
 /begin IN_MEASUREMENT aktqu_uc /end IN_MEASUREMENT
 /begin OUT_MEASUREMENT abfgrc_uc B_fgr_bt B_fgr_uc mfgr_uc mifa_bt vfgr_bt /end OUT_MEASUREMENT
/end FUNCTION
/begin FUNCTION UCMIST ""
 /begin DEF_CHARACTERISTIC KFMI_UC KFZW_UC KLETAZW_UC MIST_NMOT_DAT_UC MIST_NMV08_UC MIST_RLV08_UC MIST_RL_DAT_UC MIST_ZWOUT_DAT_UC /end DEF_CHARACTERISTIC
 /begin IN_MEASUREMENT aktqu_uc nmot_uc nmst08_uc /end IN_MEASUREMENT
 /begin OUT_MEASUREMENT abmist_uc mi_uc rlst08_uc rl_uc zwout_uc /end OUT_MEASUREMENT
 /begin LOC_MEASUREMENT dzw_uc etazw_uc miopt_uc zwopt_uc /end LOC_MEASUREMENT
/end FUNCTION
/begin FUNCTION UCMSRC ""
 /begin DEF_CHARACTERISTIC BZ_MSR_M_UC CWNOMSRU_UC MSRC_ALVOLD_DAT_UC MSRC_ASCCTR_DAT_UC MSRC_ASRL_DAT_UC MSRC_ASRS_DAT_UC MSRC_C_DAT_UC MSRC_MDMSR_DAT_UC MSRC_SBIT_DAT_UC MSRC_T_UC /end DEF_CHARACTERISTIC
 /begin IN_MEASUREMENT aktqu_uc /end IN_MEASUREMENT
 /begin OUT_MEASUREMENT abmsrc_uc B_nomsr_uc ei_msrc_uc mmsr_uc /end OUT_MEASUREMENT
 /begin LOC_MEASUREMENT alv_old_uc msrc_c_uc /end LOC_MEASUREMENT
/end FUNCTION
/begin FUNCTION UCMVER ""
 /begin DEF_CHARACTERISTIC MVER_C_DAT_UC MVER_MI_DAT_UC MVER_MZF_DAT_UC MVER_MZO_DAT_UC MVER_RFLAGS_DAT_UC MVER_T_UC /end DEF_CHARACTERISTIC
 /begin IN_MEASUREMENT aktqu_uc B_i_ska_uc mi_uc mzf_uc mzo_uc /end IN_MEASUREMENT
 /begin OUT_MEASUREMENT abmver_uc ei_mver_uc mver_c_uc mzfo_uc /end OUT_MEASUREMENT
 /begin LOC_MEASUREMENT mdif_w_uc /end LOC_MEASUREMENT
/end FUNCTION
/begin FUNCTION UCMZF ""
 /begin DEF_CHARACTERISTIC MZFFIL_UC MZFTV_UC MZF_LOW_DAT_UC MZF_MZF_DAT_UC MZF_MZ_DAT_UC MZF_PTR_DAT_UC MZF_REG_DAT_UC /end DEF_CHARACTERISTIC
 /begin IN_MEASUREMENT aktqu_uc mz_uc /end IN_MEASUREMENT
 /begin OUT_MEASUREMENT abmzf_uc mzf_l_uc mzf_p_uc mzf_r_uc mzf_uc /end OUT_MEASUREMENT
 /begin LOC_MEASUREMENT mzf_x_uc mzf_y_uc /end LOC_MEASUREMENT
/end FUNCTION
/begin FUNCTION UCMZUL ""
 /begin DEF_CHARACTERISTIC KFMDZOF_UC KFMPED_UC KFMPNS_UC MDV08_UC MZUL_MFGR_DAT_UC MZUL_MMSR_DAT_UC MZUL_MSGS_DAT_UC MZUL_NFLAGS_DAT_UC MZUL_NMOT_DAT_UC MZUL_NMV08_UC MZUL_SPSNV08_UC MZUL_SPSN_DAT_UC /end DEF_CHARACTERISTIC
 /begin IN_MEASUREMENT aktqu_uc mfgr_uc mmsr_uc msgs_uc /end IN_MEASUREMENT
 /begin OUT_MEASUREMENT abmzul_uc mped_uc mzo_uc mz_uc nmot_uc nmst08_uc spnst08_uc spsn_uc /end OUT_MEASUREMENT
 /begin LOC_MEASUREMENT mdst08_uc /end LOC_MEASUREMENT
/end FUNCTION
/begin FUNCTION UCREAC ""
 /begin DEF_CHARACTERISTIC KLNPED_UC REAC_C1_DAT_UC REAC_C2_DAT_UC REAC_EVZAUS_DAT_UC REAC_FUELA_DATH_UC REAC_FUELA_DATL_UC REAC_FUEL_DATH_UC REAC_FUEL_DATL_UC REAC_NMOT_DAT_UC REAC_RFLAGS_DAT_UC REAC_SPSN_DAT_UC REAC_T1_UC REAC_T2_UC SKADRHZ_UC /end DEF_CHARACTERISTIC
 /begin IN_MEASUREMENT aktqu_uc B_i_ska_uc nmot_uc spsn_uc /end IN_MEASUREMENT
 /begin OUT_MEASUREMENT abreac_uc ei_reac_uc evzaust_bt fuel_co_bt fuel_co_uc reac_c1_uc reac_c2_uc /end OUT_MEASUREMENT
 /begin LOC_MEASUREMENT nska_uc /end LOC_MEASUREMENT
/end FUNCTION
/begin FUNCTION UCSGSC "" /begin DEF_CHARACTERISTIC SGSC_MSGS_DAT_UC /end DEF_CHARACTERISTIC /begin IN_MEASUREMENT aktqu_uc /end IN_MEASUREMENT /begin OUT_MEASUREMENT absgsc_uc B_nosgs_uc ei_sgsc_uc msgs_uc /end OUT_MEASUREMENT /end FUNCTION
/begin FUNCTION UCURAM "" /begin DEF_CHARACTERISTIC CW_BDE_UC /end DEF_CHARACTERISTIC
 /begin OUT_MEASUREMENT b_flags_uc B_i_ska_uc n_flags_uc r_flags_uc s_flags_uc t_flags_uc z_flags_uc /end OUT_MEASUREMENT
/end FUNCTION
/begin FUNCTION UETM "Motor¸bertemperatur-Anzeige" /begin DEF_CHARACTERISTIC DUETMOT TUETM UETMOT /end DEF_CHARACTERISTIC /begin IN_MEASUREMENT B_kl15 B_pwf B_stend nmot tmot tnst_w /end IN_MEASUREMENT /begin OUT_MEASUREMENT B_uetm B_uetmc UetmNvBits /end OUT_MEASUREMENT /begin LOC_MEASUREMENT B_nouetm /end LOC_MEASUREMENT /end FUNCTION
/begin FUNCTION UFABLAUF "" /begin OUT_MEASUREMENT raster_um /end OUT_MEASUREMENT /end FUNCTION
/begin FUNCTION UFEING "EGAS ‹berwachungskonzept: Eingangssignal¸bernahme f¸r Funktions¸berwachung" /begin IN_MEASUREMENT B_i_ska_fr B_notlu_fr B_ub_ok modul_c_um raster_um /end IN_MEASUREMENT /end FUNCTION
/begin FUNCTION UFFGRC "EGAS ‹berwachungskonzept: FGR-‹berwachung der Funktions¸berwachung" /begin DEF_CHARACTERISTIC VMIN_UM /end DEF_CHARACTERISTIC /begin IN_MEASUREMENT B_fgr mifa modul_c_um raster_um vfgr_w /end IN_MEASUREMENT /begin OUT_MEASUREMENT B_fgr_um mfgr_um /end OUT_MEASUREMENT /begin LOC_MEASUREMENT mfgr_ur /end LOC_MEASUREMENT /end FUNCTION
/begin FUNCTION UFFGRE "EGAS ‹berwachungskonzept: FGR-Eingangsinfos f¸r die Funktions¸berwachung" /begin DEF_CHARACTERISTIC BREMS_T_UM FGREN_T_UM /end DEF_CHARACTERISTIC
 /begin IN_MEASUREMENT B_fgrab B_fgrat B_fgren B_fgrhsa B_fgrtbe B_fgrtve B_fgrtwa modul_c_um raster_um S_bls S_brs /end IN_MEASUREMENT
 /begin LOC_MEASUREMENT brems_c_um brems_c_ur fgren_c_um fgren_c_ur /end LOC_MEASUREMENT
/end FUNCTION
/begin FUNCTION UFMIST "EGAS ‹berwachungskonzept: Ist-Moment der Funktions¸berwachung" /begin DEF_CHARACTERISTIC KFMI_UM KFZW_UM KLETAZW_UM /end DEF_CHARACTERISTIC /begin REF_CHARACTERISTIC NMV08_UM RLV08_UM /end REF_CHARACTERISTIC
 /begin IN_MEASUREMENT modul_c_um nmot_um nmst08_um raster_um rlst08_um rl_um zwout_um /end IN_MEASUREMENT
 /begin OUT_MEASUREMENT mi_um /end OUT_MEASUREMENT
 /begin LOC_MEASUREMENT dzw_um dzw_ur etazw_um miopt_um mi_ur zwopt_um /end LOC_MEASUREMENT
/end FUNCTION
/begin FUNCTION UFMSRC "EGAS ‹berwachungskonzept: MSR-Eingriff-‹berwachung f¸r die Funktions¸berwachung" /begin DEF_CHARACTERISTIC BZ_MSR_M CWNOMSRU MSRC_T_UM /end DEF_CHARACTERISTIC /begin IN_MEASUREMENT modul_c_um raster_um /end IN_MEASUREMENT /begin OUT_MEASUREMENT B_nomsr_um ei_msrc_um mmsr_um mmsr_ur /end OUT_MEASUREMENT /begin LOC_MEASUREMENT alv_old_um alv_old_ur msrc_c_um msrc_c_ur /end LOC_MEASUREMENT /end FUNCTION
/begin FUNCTION UFMVER "EGAS ‹berwachungskonzept: Momentenvergleich der Funktions¸berwachung" /begin DEF_CHARACTERISTIC MVER_T_UM /end DEF_CHARACTERISTIC /begin IN_MEASUREMENT B_i_ska_um mi_um modul_c_um mzf_um mzo_um raster_um /end IN_MEASUREMENT /begin OUT_MEASUREMENT ei_mver_um /end OUT_MEASUREMENT /begin LOC_MEASUREMENT mdif_w_um mver_c_um mver_c_ur mzfo_um /end LOC_MEASUREMENT /end FUNCTION
/begin FUNCTION UFMZF "EGAS ‹berwachungskonzept: Momentenfilter f¸r die Funktions¸berwachung" /begin DEF_CHARACTERISTIC MZFFIL_UM MZFTV_UM /end DEF_CHARACTERISTIC /begin IN_MEASUREMENT modul_c_um mz_um raster_um /end IN_MEASUREMENT /begin OUT_MEASUREMENT mzf_um /end OUT_MEASUREMENT
 /begin LOC_MEASUREMENT mzf_l_um mzf_l_ur mzf_p_um mzf_p_ur mzf_r_um mzf_r_ur mzf_ur /end LOC_MEASUREMENT
/end FUNCTION
/begin FUNCTION UFMZUL "EGAS ‹berwachungskonzept: zul‰ssiges Moment der Funktions¸berwachung" /begin DEF_CHARACTERISTIC KFMDZOF_UM KFMPED_UM KFMPNS_UM MDV08_UM /end DEF_CHARACTERISTIC /begin REF_CHARACTERISTIC NMV08_UM SPSNV08_UM /end REF_CHARACTERISTIC
 /begin IN_MEASUREMENT mfgr_um mmsr_um modul_c_um msgs_um nmot_um nmst08_um raster_um spnst08_um spsn_um /end IN_MEASUREMENT
 /begin OUT_MEASUREMENT mzo_um mz_um /end OUT_MEASUREMENT
 /begin LOC_MEASUREMENT mdst08_um mdst08_ur mped_um mzo_ur mz_ur /end LOC_MEASUREMENT
/end FUNCTION
/begin FUNCTION UFNC "EGAS ‹berwachungskonzept: N-‹berwachung f¸r die Funktions¸berwachung"
 /begin DEF_CHARACTERISTIC NC_T_UM NDIFFO_UM NDIFFU_UM NMIN_UM NMV08_UM NSEGMAX_UM NTSCHW_UM TSEGMIN_UM /end DEF_CHARACTERISTIC
 /begin REF_CHARACTERISTIC ZYLANZ_UM /end REF_CHARACTERISTIC
 /begin IN_MEASUREMENT B_i_ska_um modul_c_um nmot raster_um tsm_alt_um tsm_um /end IN_MEASUREMENT
 /begin OUT_MEASUREMENT ei_nc_um nmot_um nmst08_um zsync_um zsync_ur /end OUT_MEASUREMENT
 /begin LOC_MEASUREMENT nc_c_um nc_c_ur nmot_ur nmst08_ur nseg_um tseg_um /end LOC_MEASUREMENT
/end FUNCTION
/begin FUNCTION UFNSC "EGAS ‹berwachungskonzept: Nachstart¸berwachung f¸r die Funktions¸berwachung"
 /begin DEF_CHARACTERISTIC NSC_T_UM NSOF_T_UM N_START_UM N_STEND_UM TANSMN_UM TMNSMN_UM /end DEF_CHARACTERISTIC
 /begin IN_MEASUREMENT modul_c_um nmot_um raster_um tans tmot /end IN_MEASUREMENT
 /begin OUT_MEASUREMENT B_mzns_um /end OUT_MEASUREMENT
 /begin LOC_MEASUREMENT nsc_c_um nsc_c_ur nsof_c_um nsof_c_ur /end LOC_MEASUREMENT
/end FUNCTION
/begin FUNCTION UFREAC "EGAS ‹berwachungskonzept: Fehlerreaktions¸berw.d.Funktions¸berwachung" /begin DEF_CHARACTERISTIC KLNPED_UM REAC_T1_UM REAC_T2_UM SKADRHZ_UM /end DEF_CHARACTERISTIC /begin IN_MEASUREMENT B_i_ska_um evz_austot modul_c_um nmot_um raster_um spsn_um /end IN_MEASUREMENT /begin OUT_MEASUREMENT ei_reac_um /end OUT_MEASUREMENT
 /begin LOC_MEASUREMENT fuel_co_um fuel_co_ur nska_um reac_c1_um reac_c1_ur reac_c2_um reac_c2_ur /end LOC_MEASUREMENT
/end FUNCTION
/begin FUNCTION UFRLC "EGAS ‹berwachungskonzept: Lastsignal¸berw. f¸r Funktions¸berwachung"
 /begin DEF_CHARACTERISTIC IP1A_MX_UM IP2A_MN_UM IPA_T_UM KFRLIP_UM NRLIP_UM RLC_T_UM RLIPFIL_UM RLIPTV_UM RLIP_T_UM RLV08_UM RL_BO_UM RL_MO_UM /end DEF_CHARACTERISTIC
 /begin IN_MEASUREMENT B_fedkb B_i_ska_um B_wdk2sel modul_c_um nmot_um raster_um rl rl_w udkp1a udkp2a /end IN_MEASUREMENT
 /begin OUT_MEASUREMENT ei_ipa_um ei_rlc_um ei_rlip_um rlst08_um rl_um /end OUT_MEASUREMENT
 /begin LOC_MEASUREMENT ipa_c_um ipa_c_ur ipsn_um ipsn_ur rlc_c_um rlc_c_ur rlipf_l_um rlipf_l_ur rlipf_p_um rlipf_p_ur rlipf_r_um rlipf_r_ur rlipf_um rlipf_ur rlip_c_um rlip_c_ur rlip_um rlst08_ur rlzo_um rl_ur rl_w_um /end LOC_MEASUREMENT
/end FUNCTION
/begin FUNCTION UFSGSC "EGAS ‹berwachungskonzept: SGS-Eingriff-‹berwachung f¸r die Funktions¸bersicht" /begin IN_MEASUREMENT modul_c_um raster_um /end IN_MEASUREMENT /begin OUT_MEASUREMENT B_nosgs_um ei_sgsc_um msgs_um /end OUT_MEASUREMENT /begin LOC_MEASUREMENT msgs_ur /end LOC_MEASUREMENT /end FUNCTION
/begin FUNCTION UFSPSC "EGAS ‹berwachungskonzept: Pedal-Sollwert-‹. f¸r Funktions¸berwachung"
 /begin DEF_CHARACTERISTIC SP12LL_UM SP12VG_UM SPSC_MINUM SPSC_T_UM SPSNV08_UM SPSVG_UM /end DEF_CHARACTERISTIC
 /begin IN_MEASUREMENT B_i_ska_um B_pwgnotfr B_sp1s B_sp2s B_spsmin modul_c_um raster_um /end IN_MEASUREMENT
 /begin OUT_MEASUREMENT B_pwgnotum ei_spsc_um spnst08_um spsn_um /end OUT_MEASUREMENT
 /begin LOC_MEASUREMENT sp1s_um sp2s_um spnst08_ur spsc_c_um spsc_c_ur spsn_ur /end LOC_MEASUREMENT
/end FUNCTION
/begin FUNCTION UFURAM "" /begin DEF_CHARACTERISTIC CW_BDE_UM /end DEF_CHARACTERISTIC
 /begin OUT_MEASUREMENT b_flags_um B_i_ska_um n_flags_um ram_c_um reac_c_um romz_c_um r_flags_um srst_c_um s_flags_um t_flags_um umrst_c_um wri_c_um z_flags_um /end OUT_MEASUREMENT
 /begin LOC_MEASUREMENT B_brems_um B_brfgr_um B_bsl_um B_dcdis_um B_fgrea_um B_fgr_umc B_i_ska B_kkl_um B_msthw_um B_naccf_um B_nlh_um B_notlu B_nsakt_um B_nsend_um B_reaci_um B_rlini_um B_rluf_um B_srstz_um B_srst_um B_tpu_um B_ub_ska B_vzl_um B_wal_um reset_indication_um /end LOC_MEASUREMENT
/end FUNCTION
/begin FUNCTION UFZWC "EGAS ‹berwachungskonzept: ZW-‹berwachung f¸r Funktions¸berwachung" /begin DEF_CHARACTERISTIC ZWC_T_UM ZYLANZ_UM /end DEF_CHARACTERISTIC /begin IN_MEASUREMENT B_i_ska_um modul_c_um raster_um zwout zwoutcpl /end IN_MEASUREMENT /begin OUT_MEASUREMENT ei_zwc_um zwout_um /end OUT_MEASUREMENT /begin LOC_MEASUREMENT zwc_c_um zwc_c_ur zwout_ur /end LOC_MEASUREMENT /end FUNCTION
/begin FUNCTION UGENKOR "UGENKOR.  Generator- Spannungsanhebung"
 /begin DEF_CHARACTERISTIC B_APP_UGEN GENOFFTIME GENUMAX GENURAMP GENURAMPOF GEN_APP_UG KLFGENSLP KLUBATTMAX S_ENGENSLP S_GOFFRAMP UGENOFF UGENOFFV0 U_GENSLP /end DEF_CHARACTERISTIC
 /begin IN_MEASUREMENT B_dslfa B_fasls B_nmot B_slp ctrgenutar imlpr tbatt ugen vfzg /end IN_MEASUREMENT
 /begin OUT_MEASUREMENT B_genoff B_genoffmd B_genoffok B_noctrgen ugenslp /end OUT_MEASUREMENT
 /begin LOC_MEASUREMENT B_1stugen ugloc uramp /end LOC_MEASUREMENT
/end FUNCTION
/begin FUNCTION UK2LNK "" /end FUNCTION
/begin FUNCTION UK2LNK_GTW "" /begin DEF_CHARACTERISTIC RoutingAddrTable_cu8 RoutingTableHeader_cu8 /end DEF_CHARACTERISTIC /end FUNCTION
/begin FUNCTION UMAUSC "EGAS ‹berwachungskonzept: Abschaltpfadtest ‹berwachungsmodul" /begin DEF_CHARACTERISTIC AUSCH_T_UM AUSC_T_UM /end DEF_CHARACTERISTIC
 /begin IN_MEASUREMENT B_i_ska_um B_ubdve evz_austot e_mem_um mem_ur newqu_um umerr_c_um /end IN_MEASUREMENT
 /begin OUT_MEASUREMENT auscf_c_um ausch_c_um ausc_c_um ausc_ur B_ausc_act B_ausc_um B_nxptr_um ei_ubr_um /end OUT_MEASUREMENT
 /begin LOC_MEASUREMENT hwError_um /end LOC_MEASUREMENT
/end FUNCTION
/begin FUNCTION UMKOM "EGAS ‹berwachungskonzept: Frage/Antwort-Kommunikation zw. UM und FR" /begin REF_CHARACTERISTIC AUSCH_T_UM /end REF_CHARACTERISTIC
 /begin IN_MEASUREMENT abtres_um apakres_um ausc_ur B_ausc_act B_ausc_um e_mem_um mem_ur /end IN_MEASUREMENT
 /begin OUT_MEASUREMENT B_newqr_um B_nxtrp_um frerr_c_um frerr_c_ur frtar_c_um newansw_um newqr_ur newque_um newqu_um umerr_c_um /end OUT_MEASUREMENT
 /begin LOC_MEASUREMENT nxtrp_ur plstate_um plstate_ur /end LOC_MEASUREMENT
/end FUNCTION
/begin FUNCTION URADCC "EGAS ‹berwachungskonzept: AD-Wandler-Test" /begin DEF_CHARACTERISTIC ADCC_MX_UM ADCC_T_UM ADCQ_T_UM /end DEF_CHARACTERISTIC /begin IN_MEASUREMENT B_i_ska_um B_pwgnotum modul_c_um raster_um /end IN_MEASUREMENT /begin OUT_MEASUREMENT B_adcc_um ei_adcc_um ei_adcq_um /end OUT_MEASUREMENT /begin LOC_MEASUREMENT adcc_c_um adcc_c_ur adcq_c_um adcq_c_ur adcq_um upwg2_um /end LOC_MEASUREMENT /end FUNCTION
/begin FUNCTION URCPU "EGAS ‹berwachungskonzept: Befehlstest mit Ebene 2'"
 /begin IN_MEASUREMENT abfgrc_uc abmist_uc abmsrc_uc abmver_uc abmzf_uc abmzul_uc abreac_uc absgsc_uc raster_um /end IN_MEASUREMENT
 /begin OUT_MEASUREMENT abtres_um /end OUT_MEASUREMENT
/end FUNCTION
/begin FUNCTION URMEM "EGAS ‹berwachungskonzept: Zyklischer Speichertest" /begin DEF_CHARACTERISTIC AUSGH_T_UM AUSG_T_UM AUSZH_T_UM AUSZ_T_UM /end DEF_CHARACTERISTIC /begin IN_MEASUREMENT modul_c_um raster_um /end IN_MEASUREMENT /begin OUT_MEASUREMENT e_mem_um mem_ur urmcksco urmcksda urmpatco /end OUT_MEASUREMENT
 /begin LOC_MEASUREMENT ausgh_c_um ausgh_c_ur ausg_c_um ausg_c_ur auszh_c_um auszh_c_ur ausz_c_um ausz_c_ur /end LOC_MEASUREMENT
/end FUNCTION
/begin FUNCTION URPAK "EGAS ‹berwachungskonzept: Programmablaufkontrolle" /begin IN_MEASUREMENT B_newqr_um newqr_ur newque_um raster_um /end IN_MEASUREMENT /begin OUT_MEASUREMENT aktqu_uc apakres_um modul_c_um /end OUT_MEASUREMENT /end FUNCTION
/begin FUNCTION URRAM "EGAS ‹berwachungskonzept: RAM-Test"
 /begin IN_MEASUREMENT B_pwf e_mem_um e_rom1_um e_romx_um mem_ur nmot_um rom1_ur rompage_um rompage_ur romx_ur wri_c_um /end IN_MEASUREMENT
 /begin OUT_MEASUREMENT e_ram_um ram_ur /end OUT_MEASUREMENT
/end FUNCTION
/begin FUNCTION URROM "EGAS ‹berwachungskonzept: ROM-Test" /begin DEF_CHARACTERISTIC CW_NOROMCHKRESET ROMRSTA_UM /end DEF_CHARACTERISTIC /begin IN_MEASUREMENT B_nlsiko B_pwf e_mem_um e_ram_um mem_ur ram_ur swOffDlBits /end IN_MEASUREMENT
 /begin OUT_MEASUREMENT e_rom1_um e_romx_um rom1_ur rompage_um rompage_ur romrstc_um romx_ur /end OUT_MEASUREMENT
/end FUNCTION
/begin FUNCTION URTPU "EGAS ‹berwachungskonzept: TPU-‹berwachung f¸r Funktions¸berwachung"
 /begin DEF_CHARACTERISTIC NZMAX_UM TDIFMX_UM TPUCA_T_UM TPUCR_T_UM TPURA_T_UM TPURSTA_UM TPUST_T_UM TPU_T_UM /end DEF_CHARACTERISTIC
 /begin IN_MEASUREMENT e_mem_um mem_ur modul_c_um synstate /end IN_MEASUREMENT
 /begin OUT_MEASUREMENT c720alt_um c720alt_ur ei_tpu_um e_tpu_um nz_um tc72alt_um tc72alt_ur tdifs1_um tdifs1_ur tsm_alt_um tsm_um zsytp1_um zsytp2_um /end OUT_MEASUREMENT
 /begin LOC_MEASUREMENT tpuca_c_um tpuca_c_ur tpucr_c_um tpucr_c_ur tpura_c_um tpura_c_ur tpurstc_um tpust_c_um tpust_c_ur tpu_c_um tpu_c_ur /end LOC_MEASUREMENT
/end FUNCTION
/begin FUNCTION UTIL ""
 /begin IN_MEASUREMENT B_bm B_nachl B_nmin B_stprel B_wakeup sync_level tsm_alt_um tsm_um /end IN_MEASUREMENT
 /begin OUT_MEASUREMENT drrev_sta inisynmon /end OUT_MEASUREMENT
/end FUNCTION
/begin FUNCTION VMAXMD "Drehmomentanforderung von VMAX-Regelung"
 /begin DEF_CHARACTERISTIC CWDVMX KFMIRED NMINVMX SBF02MFSB SRL03MFUW TVMXPR VABSCH VHYST VMAXO VMAXP VVORH ZBFIL ZIVMAX /end DEF_CHARACTERISTIC
 /begin REF_CHARACTERISTIC MDIMX /end REF_CHARACTERISTIC
 /begin IN_MEASUREMENT bfzgl_b mifab_w miist_w nmot rl_w vfgr_w /end IN_MEASUREMENT
 /begin OUT_MEASUREMENT bfzglf B_vmax esst_sbf02mfsb esst_srl03mfuw mivmx_w /end OUT_MEASUREMENT
 /begin LOC_MEASUREMENT dmvmxi_w dmvmxp_w dvprae_w dvsi_w ivmax mired mivmxs vfzgpr_w /end LOC_MEASUREMENT
/end FUNCTION
/begin FUNCTION Watchpoint ""
 /begin DEF_CHARACTERISTIC watch_addr0_h watch_addr0_l watch_addr1_h watch_addr1_l watch_addr2_h watch_addr2_l watch_addr3_h watch_addr3_l watch_newdata watch_on /end DEF_CHARACTERISTIC
/end FUNCTION
/begin FUNCTION Watchpoint_Extended ""
 /begin DEF_CHARACTERISTIC watch_acmode watch_addr4_h watch_addr4_l watch_addr5_h watch_addr5_l watch_cmode4 watch_cmode5 watch_dcmode watch_mode watch_rw4 watch_rw5 watch_sign4 watch_sign5 watch_size_bits4 watch_size_bits5 watch_value4_h watch_value4_l watch_value5_h watch_value5_l /end DEF_CHARACTERISTIC
 /begin LOC_MEASUREMENT watch_error watch_state /end LOC_MEASUREMENT
/end FUNCTION
/begin FUNCTION WES "Winkel Einlass Schliesst (BMW-Funktion)" /begin DEF_CHARACTERISTIC WESNESPR /end DEF_CHARACTERISTIC /begin IN_MEASUREMENT evhubs_w Vse_spri /end IN_MEASUREMENT /begin OUT_MEASUREMENT wes wesnesprau /end OUT_MEASUREMENT /end FUNCTION
/begin FUNCTION WFS "Wegfahrsperre" /begin IN_MEASUREMENT B_ez B_nmin B_zndaus /end IN_MEASUREMENT
 /begin OUT_MEASUREMENT AS_wp B_auswrt B_eculock B_eep2err B_eeperr B_inistw B_kwperr B_motor B_ptyerr B_ramerr B_read_active B_recerr B_resstw B_timerr B_wcerr B_wc_exa B_wc_exn B_write_active B_wuerg EwsNvBits pm_akt pm_fre pm_mod pm_ta pm_td pty_fctr rec_fctr stw_prog_frei_mod stw_prog_frei_ta stw_prog_frei_td ttimout tweiter twuerg wc_fctr /end OUT_MEASUREMENT
/end FUNCTION
/begin FUNCTION ZNDAUS "Z¸ndung: Anforderungen f¸r Ausblendung" /begin DEF_CHARACTERISTIC ANWFOZA /end DEF_CHARACTERISTIC /begin IN_MEASUREMENT B_fofrun B_sa zzyl /end IN_MEASUREMENT /begin OUT_MEASUREMENT B_zndaus /end OUT_MEASUREMENT /end FUNCTION
/begin FUNCTION ZUE "Grundfunktion - Z¸ndung" /begin DEF_CHARACTERISTIC NACHANZ S_KRZWSOL WMNDOPZ WPHN ZWAPPL /end DEF_CHARACTERISTIC /begin REF_CHARACTERISTIC SNM08__UB /end REF_CHARACTERISTIC
 /begin IN_MEASUREMENT B_allzwe B_kr B_krdws B_ll B_llrein B_nozwe B_sa B_zwappl dwkrkorll dwkrz dzwwl esst_snm08__ub nmot redist tpnt_aktiv vszw wkrdy zwgru zwsol zwspae zwstt zzylzue /end IN_MEASUREMENT
 /begin OUT_MEASUREMENT B_krzwsol B_llzwe B_zwkra B_zwspae znachanz zwbas zwbasar zwbaskrkor zwist zwkrafld zwout zwoutar zwoutcpl zwoutzyl zwzyl1 /end OUT_MEASUREMENT
 /begin LOC_MEASUREMENT wphg /end LOC_MEASUREMENT
/end FUNCTION
/begin FUNCTION ZUESZ "Z¸ndung, Berechnung Schlieﬂzeit" /begin DEF_CHARACTERISTIC TSUB /end DEF_CHARACTERISTIC /begin IN_MEASUREMENT B_stend ub /end IN_MEASUREMENT /begin OUT_MEASUREMENT szout_w /end OUT_MEASUREMENT /end FUNCTION
/begin FUNCTION ZWGRU "Grundz¸ndwinkel"
 /begin DEF_CHARACTERISTIC CWZWEVTMOD KFFWMXA KFWKORAG1 KFWKORAG2 KFWKORAO1 KFWKORAO2 KFZWDI1 KFZWDI2 KFZWLL KFZWVL1 KFZWVL2 NKLO RLKL TADEZW TMDEZW WMXTA /end DEF_CHARACTERISTIC
 /begin REF_CHARACTERISTIC SNM08ZUUB SNM24ZUUB SNM24ZUUB1 SNM24ZUUB2 SRL03ZUUB SRL08ZUUB SRL16ZUUB /end REF_CHARACTERISTIC
 /begin IN_MEASUREMENT B_disa B_kr B_krdws B_ll B_stend B_vl dzwoag dzwol esst_snm08zuub esst_snm24zuub esst_snm24zuub1 esst_snm24zuub2 esst_srl03zuub esst_srl08zuub esst_srl16zuub evtmod nmot rl tans tmot zwks /end IN_MEASUREMENT
 /begin OUT_MEASUREMENT dzwtans dzwtmot kfwkorag1 kfwkorag2 kfwkorao1 kfwkorao2 zwgru /end OUT_MEASUREMENT
 /begin LOC_MEASUREMENT B_wkora wmtxa_in /end LOC_MEASUREMENT
/end FUNCTION
/begin FUNCTION ZWKS "Z¸ndwinkel Klopfschutz" /begin DEF_CHARACTERISTIC KFFWK KFKSZW KFWK KSZWE /end DEF_CHARACTERISTIC /begin REF_CHARACTERISTIC SNM24ZUUB SRL16ZUUB /end REF_CHARACTERISTIC /begin IN_MEASUREMENT esst_snm24zuub esst_srl16zuub nmot rl tans tmot /end IN_MEASUREMENT /begin OUT_MEASUREMENT dzwks zwks /end OUT_MEASUREMENT /end FUNCTION
/begin FUNCTION ZWMIN "Berechnung des sp‰test erlaubten Z¸ndwinkels"
 /begin DEF_CHARACTERISTIC DZWAML DZWSPM FZWKHMX KFZWMN KFZWMNKH KFZWMNST KFZWMNT KFZWMS KLZZWMNST TVZWMSA TVZWMSE /end DEF_CHARACTERISTIC
 /begin REF_CHARACTERISTIC DZW2DZWQ SNM16ZUUB SRL12ZUUB STM06__UB /end REF_CHARACTERISTIC
 /begin IN_MEASUREMENT B_kh B_kw B_sa B_st dpsfak dzwkoef esst_snm16zuub esst_srl12zuub esst_stm06__ub fmdkh migs_w misolv_w misol_w ml nmot rl tmot tmst zwist zwopt /end IN_MEASUREMENT
 /begin OUT_MEASUREMENT B_zwms dzwspae etazwmn zwspae /end OUT_MEASUREMENT
 /begin LOC_MEASUREMENT B_zwmnste dzwmna zwmn zwmnd zwmnms zwnst /end LOC_MEASUREMENT
/end FUNCTION
/begin FUNCTION ZWSTT "Z¸ndung im Start" /begin DEF_CHARACTERISTIC DZWSTTA KFZWSTNMTM /end DEF_CHARACTERISTIC /begin IN_MEASUREMENT B_stend nmot tans tmst /end IN_MEASUREMENT /begin OUT_MEASUREMENT zwstnm zwstnmtm zwstt zwstta /end OUT_MEASUREMENT /end FUNCTION
/begin FUNCTION ZWWL "Warmlauf Z¸ndwinkel" /begin DEF_CHARACTERISTIC KFWZWWL KFZWWLTM /end DEF_CHARACTERISTIC /begin IN_MEASUREMENT nmot rl tmot tmst /end IN_MEASUREMENT /begin OUT_MEASUREMENT dzwwl /end OUT_MEASUREMENT /end FUNCTION
/begin COMPU_METHOD bfzg_sb_q0p217 "" RAT_FUNC "%6.3" "m/s^2" COEFFS 0 1 0 0 0 0.217 /end COMPU_METHOD
/begin COMPU_METHOD B_TRUE "boolsche Zust‰nde, positive Logik" TAB_VERB "%6.3" "" COMPU_TAB_REF B_TRUE /end COMPU_METHOD
/begin COMPU_VTAB B_TRUE "boolsche Zust‰nde, positive Logik" TAB_VERB 2 0 "----" 1 "TRUE" /end COMPU_VTAB
/begin COMPU_METHOD DEZ "1 : 1 Umrechnug (dez/hex)" RAT_FUNC "%6.2" "" COEFFS 0 1 0 0 0 1 /end COMPU_METHOD
/begin COMPU_METHOD dez "1 : 1 Umrechnug (dez/hex)" RAT_FUNC "%6.2" "" COEFFS 0 1 0 0 0 1 /end COMPU_METHOD
/begin COMPU_METHOD dezsub1 "" RAT_FUNC "%6.2" "-" COEFFS 0 1 -1 0 0 1 /end COMPU_METHOD
/begin COMPU_METHOD fak_q0p00195 "" RAT_FUNC "%6.4" "-" COEFFS 0 65536 0 0 0 128 /end COMPU_METHOD
/begin COMPU_METHOD fak_q0p1 "" RAT_FUNC "%6.3" "-" COEFFS 0 1 0 0 0 0.1 /end COMPU_METHOD
/begin COMPU_METHOD fak_sb_b1 "" RAT_FUNC "%6.4" "-" COEFFS 0 256 0 0 0 2 /end COMPU_METHOD
/begin COMPU_METHOD fak_sb_b16 "" RAT_FUNC "%6.3" "-" COEFFS 0 256 0 0 0 32 /end COMPU_METHOD
/begin COMPU_METHOD fak_sb_b2 "" RAT_FUNC "%6.4" "-" COEFFS 0 256 0 0 0 4 /end COMPU_METHOD
/begin COMPU_METHOD fak_sb_b64 "" RAT_FUNC "%6.3" "-" COEFFS 0 256 0 0 0 128 /end COMPU_METHOD
/begin COMPU_METHOD fak_sb_q0p5 "" RAT_FUNC "%6.3" "-" COEFFS 0 256 0 0 0 128 /end COMPU_METHOD
/begin COMPU_METHOD fak_sw_b2 "" RAT_FUNC "%7.6" "-" COEFFS 0 65536 0 0 0 4 /end COMPU_METHOD
/begin COMPU_METHOD fak_sw_b64 "" RAT_FUNC "%6.4" "-" COEFFS 0 65536 0 0 0 128 /end COMPU_METHOD
/begin COMPU_METHOD fak_ub_b0p03125 "" RAT_FUNC "%6.5" "-" COEFFS 0 256 0 0 0 0.03125 /end COMPU_METHOD
/begin COMPU_METHOD fak_ub_b0p5 "" RAT_FUNC "%6.4" "-" COEFFS 0 256 0 0 0 0.5 /end COMPU_METHOD
/begin COMPU_METHOD fak_ub_b1 "" RAT_FUNC "%6.4" "-" COEFFS 0 256 0 0 0 1 /end COMPU_METHOD
/begin COMPU_METHOD fak_ub_b16 "" RAT_FUNC "%6.4" "-" COEFFS 0 256 0 0 0 16 /end COMPU_METHOD
/begin COMPU_METHOD fak_ub_b2 "" RAT_FUNC "%6.4" "-" COEFFS 0 256 0 0 0 2 /end COMPU_METHOD
/begin COMPU_METHOD fak_ub_b32 "" RAT_FUNC "%6.3" "-" COEFFS 0 256 0 0 0 32 /end COMPU_METHOD
/begin COMPU_METHOD fak_ub_b4 "" RAT_FUNC "%6.4" "-" COEFFS 0 256 0 0 0 4 /end COMPU_METHOD
/begin COMPU_METHOD fak_ub_b64 "" RAT_FUNC "%6.3" "-" COEFFS 0 256 0 0 0 64 /end COMPU_METHOD
/begin COMPU_METHOD fak_ub_b8 "" RAT_FUNC "%6.4" "-" COEFFS 0 256 0 0 0 8 /end COMPU_METHOD
/begin COMPU_METHOD fak_uw_b0p5 "" RAT_FUNC "%8.7" "-" COEFFS 0 65536 0 0 0 0.5 /end COMPU_METHOD
/begin COMPU_METHOD fak_uw_b1 "" RAT_FUNC "%7.6" "-" COEFFS 0 65536 0 0 0 1 /end COMPU_METHOD
/begin COMPU_METHOD fak_uw_b16 "" RAT_FUNC "%6.5" "-" COEFFS 0 65536 0 0 0 16 /end COMPU_METHOD
/begin COMPU_METHOD fak_uw_b2 "" RAT_FUNC "%7.6" "-" COEFFS 0 65536 0 0 0 2 /end COMPU_METHOD
/begin COMPU_METHOD hub_uw_q0p001 "" RAT_FUNC "%6.5" "mm" COEFFS 0 1000 0 0 0 1 /end COMPU_METHOD
/begin COMPU_METHOD kw_q1 "" RAT_FUNC "%6.2" "Grad KW" COEFFS 0 1 0 0 0 1 /end COMPU_METHOD
/begin COMPU_METHOD kw_q3 "" RAT_FUNC "%6.2" "Grad KW" COEFFS 0 1 0 0 0 3 /end COMPU_METHOD
/begin COMPU_METHOD m_ub_b1020 "" RAT_FUNC "%6.2" "kg/h" COEFFS 0 1 0 0 0 4 /end COMPU_METHOD
/begin COMPU_METHOD m_ub_q0p0444 "" RAT_FUNC "%6.4" "g" COEFFS 0 1 0 0 0 0.0444 /end COMPU_METHOD
/begin COMPU_METHOD m_uw_b25p6 "" RAT_FUNC "%6.5" "kg/h" COEFFS 0 65536 0 0 0 25.6 /end COMPU_METHOD
/begin COMPU_METHOD m_uw_b6553p5 "" RAT_FUNC "%6.3" "kg/h" COEFFS 0 1 0 0 0 0.1 /end COMPU_METHOD
/begin COMPU_METHOD m_uw_q3p2 "" RAT_FUNC "%6.2" "kg/h" COEFFS 0 1 0 0 0 3.2 /end COMPU_METHOD
/begin COMPU_METHOD nmot_ub_q40 "" RAT_FUNC "%6.1" "1/min" COEFFS 0 1 0 0 0 40 /end COMPU_METHOD
/begin COMPU_METHOD nmot_uw_q0p25 "" RAT_FUNC "%6.3" "1/min" COEFFS 0 1 0 0 0 0.25 /end COMPU_METHOD
/begin COMPU_METHOD perio_sw_b1p562 "" RAT_FUNC "%7.6" "1/s" COEFFS 0 65536 0 0 0 3.124 /end COMPU_METHOD
/begin COMPU_METHOD perio_sw_b6p125 "" RAT_FUNC "%6.5" "1/s" COEFFS 0 65536 0 0 0 12.25 /end COMPU_METHOD
/begin COMPU_METHOD perio_ub_b0p012207 "" RAT_FUNC "%7.6" "1/s" COEFFS 0 256 0 0 0 0.012207 /end COMPU_METHOD
/begin COMPU_METHOD perio_ub_b6p125 "" RAT_FUNC "%6.4" "1/s" COEFFS 0 256 0 0 0 6.125 /end COMPU_METHOD
/begin COMPU_METHOD p_sb_q32 "" RAT_FUNC "%6.3" "hPa" COEFFS 0 256 0 0 0 64 /end COMPU_METHOD
/begin COMPU_METHOD rel_q0p00195 "" RAT_FUNC "%6.4" "%" COEFFS 0 65536 0 0 0 128 /end COMPU_METHOD
/begin COMPU_METHOD rel_sb_q0p78 "" RAT_FUNC "%6.3" "%" COEFFS 0 1 0 0 0 0.78 /end COMPU_METHOD
/begin COMPU_METHOD rel_sw_b100 "" RAT_FUNC "%6.4" "%" COEFFS 0 32768 0 0 0 100 /end COMPU_METHOD
/begin COMPU_METHOD rel_sw_q0p0468 "" RAT_FUNC "%6.4" "%" COEFFS 0 65536 0 0 0 3072 /end COMPU_METHOD
/begin COMPU_METHOD rel_ub_b127p5 "" RAT_FUNC "%6.3" "%" COEFFS 0 2 0 0 0 1 /end COMPU_METHOD
/begin COMPU_METHOD rel_ub_b99p6 "" RAT_FUNC "%6.3" "%" COEFFS 0 256 0 0 0 100 /end COMPU_METHOD
/begin COMPU_METHOD rel_ub_q0p00153 "" RAT_FUNC "%6.4" "%" COEFFS 0 256 0 0 0 0.3906 /end COMPU_METHOD
/begin COMPU_METHOD rel_ub_q0p0029 "" RAT_FUNC "%6.4" "%" COEFFS 0 256 0 0 0 0.75 /end COMPU_METHOD
/begin COMPU_METHOD rel_ub_q0p3906 "" RAT_FUNC "%6.3" "%" COEFFS 0 256 0 0 0 100 /end COMPU_METHOD
/begin COMPU_METHOD rel_ub_q0p391 "" RAT_FUNC "%6.3" "%/km/h" COEFFS 0 1 0 0 0 0.391 /end COMPU_METHOD
/begin COMPU_METHOD rel_ub_q0p75 "" RAT_FUNC "%6.3" "%" COEFFS 0 1 0 0 0 0.75 /end COMPU_METHOD
/begin COMPU_METHOD rel_uw_b100 "" RAT_FUNC "%6.4" "%" COEFFS 0 65536 0 0 0 100 /end COMPU_METHOD
/begin COMPU_METHOD rel_uw_b192 "" RAT_FUNC "%6.4" "%" COEFFS 0 65536 0 0 0 192 /end COMPU_METHOD
/begin COMPU_METHOD rel_uw_q0p0234 "" RAT_FUNC "%6.4" "%" COEFFS 0 32 0 0 0 0.75 /end COMPU_METHOD
/begin COMPU_METHOD rgrad_uw_b1280 "" RAT_FUNC "%6.4" "%/s" COEFFS 0 65536 0 0 0 1280 /end COMPU_METHOD
/begin COMPU_METHOD spg_q0p00977 "" RAT_FUNC "%6.4" "V" COEFFS 0 256 0 0 0 2.5 /end COMPU_METHOD
/begin COMPU_METHOD spg_sw_q0p001 "" RAT_FUNC "%6.5" "V" COEFFS 0 1000 0 0 0 1 /end COMPU_METHOD
/begin COMPU_METHOD spg_ubatt "" RAT_FUNC "%6.3" "V" COEFFS 0 1 0 0 0 0.0942 /end COMPU_METHOD
/begin COMPU_METHOD spg_ub_q0p0098 "" RAT_FUNC "%6.4" "V" COEFFS 0 256 0 0 0 2.5 /end COMPU_METHOD
/begin COMPU_METHOD spg_ub_q0p019 "" RAT_FUNC "%6.4" "V" COEFFS 0 1 0 0 0 0.019 /end COMPU_METHOD
/begin COMPU_METHOD t100msxs_uw_b6553p5 "" RAT_FUNC "%6.3" "s" COEFFS 0 1 0 0 0 0.1 /end COMPU_METHOD
/begin COMPU_METHOD t100msxs_uw_q100 "" RAT_FUNC "%6.3" "s" COEFFS 0 1 0 0 0 0.1 /end COMPU_METHOD
/begin COMPU_METHOD t10msxs_ub_b2p55 "" RAT_FUNC "%6.4" "s" COEFFS 0 1 0 0 0 0.01 /end COMPU_METHOD
/begin COMPU_METHOD t10msxs_uw_b655p35 "" RAT_FUNC "%6.4" "s" COEFFS 0 1 0 0 0 0.01 /end COMPU_METHOD
/begin COMPU_METHOD t10ms_ub_b2550 "" RAT_FUNC "%7.2" "ms" COEFFS 0 1 0 0 0 10 /end COMPU_METHOD
/begin COMPU_METHOD t20msxs_ub_b5p1 "" RAT_FUNC "%6.4" "s" COEFFS 0 1 0 0 0 0.02 /end COMPU_METHOD
/begin COMPU_METHOD t20msxs_ub_q0p32 "" RAT_FUNC "%6.3" "s" COEFFS 0 256 0 0 0 81.92 /end COMPU_METHOD
/begin COMPU_METHOD t20ms_ub_b5100 "" RAT_FUNC "%7.2" "ms" COEFFS 0 1 0 0 0 20 /end COMPU_METHOD
/begin COMPU_METHOD t40msxs_uw_q0p04 "" RAT_FUNC "%6.4" "s" COEFFS 0 1 0 0 0 0.04 /end COMPU_METHOD
/begin COMPU_METHOD t40ms_ub_b10200 "" RAT_FUNC "%7.2" "ms" COEFFS 0 1 0 0 0 40 /end COMPU_METHOD
/begin COMPU_METHOD temp_ub_b191p25 "" RAT_FUNC "%6.3" "Grad C" COEFFS 0 1 0 0 0 0.75 /end COMPU_METHOD
/begin COMPU_METHOD temp_ub_q0p75_o48 "" RAT_FUNC "%6.2" "Grad C" COEFFS 0 1 48 0 0 0.75 /end COMPU_METHOD
/begin COMPU_METHOD txms_uw_q0p0004 "" RAT_FUNC "%6.5" "ms" COEFFS 0 2500 0 0 0 1 /end COMPU_METHOD
/begin COMPU_METHOD txms_uw_q0p001 "" RAT_FUNC "%6.5" "ms" COEFFS 0 1000 0 0 0 1 /end COMPU_METHOD
/begin COMPU_METHOD t_min_q5p96em8 "" RAT_FUNC "%10.9" "min" COEFFS 0 1 0 0 0 5.96e-008 /end COMPU_METHOD
/begin COMPU_METHOD t_q0p01 "" RAT_FUNC "%6.4" "s" COEFFS 0 100 0 0 0 1 /end COMPU_METHOD
/begin COMPU_METHOD vfzg_sw_q0p00781 "" RAT_FUNC "%6.4" "km/h" COEFFS 0 1 0 0 0 0.0078125 /end COMPU_METHOD
/begin COMPU_METHOD vfzg_uw_q0p00781 "" RAT_FUNC "%6.4" "km/h" COEFFS 0 1 0 0 0 0.0078125 /end COMPU_METHOD
/begin COMPU_METHOD vfzg_uw_q0p0625 "" RAT_FUNC "%6.4" "km/h" COEFFS 0 1 0 0 0 0.0625 /end COMPU_METHOD
/begin COMPU_METHOD zk100msxs_ub_b25p5 "" RAT_FUNC "%6.3" "s" COEFFS 0 0 256 0 10 0 /end COMPU_METHOD
/begin COMPU_METHOD zk100msxs_uw_b655 "" RAT_FUNC "%6.1" "s" COEFFS 0 0 65536 0 10 0 /end COMPU_METHOD
/begin COMPU_METHOD zk100msxs_uw_b6553 "" RAT_FUNC "%10.3" "s" COEFFS 0 0 65536 0 10 0 /end COMPU_METHOD
/begin COMPU_METHOD zk10msxs_ub_b2p55 "" RAT_FUNC "%6.4" "s" COEFFS 0 0 255 0 100 0 /end COMPU_METHOD
/begin COMPU_METHOD zk10msxs_uw_b655 "" RAT_FUNC "%6.2" "s" COEFFS 0 0 65536 0 100 0 /end COMPU_METHOD
/begin COMPU_METHOD zk40ms_ub_b10200 "" RAT_FUNC "%6.1" "ms" COEFFS 0 0 10240 0 1 40 /end COMPU_METHOD
/begin COMPU_METHOD zw_sb_q0p75 "" RAT_FUNC "%6.3" "Grad KW" COEFFS 0 255 0 0 0 191.25 /end COMPU_METHOD
/begin COMPU_METHOD zw_ub_q0p75 "" RAT_FUNC "%6.3" "Grad KW" COEFFS 0 255 0 0 0 191.25 /end COMPU_METHOD
/begin COMPU_METHOD defaultAscii "" RAT_FUNC "%6.2" "" COEFFS 0 1 0 0 0 1 /end COMPU_METHOD
/begin RECORD_LAYOUT FklWU16 FNC_VALUES 1 UWORD COLUMN_DIR DIRECT /end RECORD_LAYOUT
/begin RECORD_LAYOUT GkfWSb FNC_VALUES 1 SBYTE COLUMN_DIR DIRECT /end RECORD_LAYOUT
/begin RECORD_LAYOUT GkfWUb FNC_VALUES 1 UBYTE COLUMN_DIR DIRECT /end RECORD_LAYOUT
/begin RECORD_LAYOUT GklWSb FNC_VALUES 1 SBYTE COLUMN_DIR DIRECT /end RECORD_LAYOUT
/begin RECORD_LAYOUT GklWUb FNC_VALUES 1 UBYTE COLUMN_DIR DIRECT /end RECORD_LAYOUT
/begin RECORD_LAYOUT GklWUw FNC_VALUES 1 UWORD COLUMN_DIR DIRECT /end RECORD_LAYOUT
/begin RECORD_LAYOUT KfAxU8AyU8SstxU8SstyU8WS8 NO_AXIS_PTS_X 1 UBYTE NO_AXIS_PTS_Y 2 UBYTE AXIS_PTS_X 3 UBYTE INDEX_INCR DIRECT AXIS_PTS_Y 4 UBYTE INDEX_INCR DIRECT FNC_VALUES 5 SBYTE COLUMN_DIR DIRECT /end RECORD_LAYOUT
/begin RECORD_LAYOUT KfAxUbAyUbSstxSbSstyUbWUb NO_AXIS_PTS_X 1 UBYTE NO_AXIS_PTS_Y 2 UBYTE AXIS_PTS_X 3 SBYTE INDEX_INCR DIRECT AXIS_PTS_Y 4 UBYTE INDEX_INCR DIRECT FNC_VALUES 5 UBYTE COLUMN_DIR DIRECT /end RECORD_LAYOUT
/begin RECORD_LAYOUT KfAxUbAyUbSstxUbSstyUbWSb NO_AXIS_PTS_X 1 UBYTE NO_AXIS_PTS_Y 2 UBYTE AXIS_PTS_X 3 UBYTE INDEX_INCR DIRECT AXIS_PTS_Y 4 UBYTE INDEX_INCR DIRECT FNC_VALUES 5 SBYTE COLUMN_DIR DIRECT /end RECORD_LAYOUT
/begin RECORD_LAYOUT KfAxUbAyUbSstxUbSstyUbWUb NO_AXIS_PTS_X 1 UBYTE NO_AXIS_PTS_Y 2 UBYTE AXIS_PTS_X 3 UBYTE INDEX_INCR DIRECT AXIS_PTS_Y 4 UBYTE INDEX_INCR DIRECT FNC_VALUES 5 UBYTE COLUMN_DIR DIRECT /end RECORD_LAYOUT
/begin RECORD_LAYOUT KfAxUwAyUwSstxSwSstyUwWUw NO_AXIS_PTS_X 1 UWORD NO_AXIS_PTS_Y 2 UWORD AXIS_PTS_X 3 SWORD INDEX_INCR DIRECT AXIS_PTS_Y 4 UWORD INDEX_INCR DIRECT FNC_VALUES 5 UWORD COLUMN_DIR DIRECT /end RECORD_LAYOUT
/begin RECORD_LAYOUT KfAxUwAyUwSstxUwSstyUwWUw NO_AXIS_PTS_X 1 UWORD NO_AXIS_PTS_Y 2 UWORD AXIS_PTS_X 3 UWORD INDEX_INCR DIRECT AXIS_PTS_Y 4 UWORD INDEX_INCR DIRECT FNC_VALUES 5 UWORD COLUMN_DIR DIRECT /end RECORD_LAYOUT
/begin RECORD_LAYOUT KfWUb FNC_VALUES 1 UBYTE COLUMN_DIR DIRECT /end RECORD_LAYOUT
/begin RECORD_LAYOUT KlAUbSstSbWSb NO_AXIS_PTS_X 1 UBYTE AXIS_PTS_X 2 SBYTE INDEX_INCR DIRECT FNC_VALUES 3 SBYTE COLUMN_DIR DIRECT /end RECORD_LAYOUT
/begin RECORD_LAYOUT KlAUbSstUbWSb NO_AXIS_PTS_X 1 UBYTE AXIS_PTS_X 2 UBYTE INDEX_INCR DIRECT FNC_VALUES 3 SBYTE COLUMN_DIR DIRECT /end RECORD_LAYOUT
/begin RECORD_LAYOUT KlAUbSstUbWUb NO_AXIS_PTS_X 1 UBYTE AXIS_PTS_X 2 UBYTE INDEX_INCR DIRECT FNC_VALUES 3 UBYTE COLUMN_DIR DIRECT /end RECORD_LAYOUT
/begin RECORD_LAYOUT KlAUbSstUbWUw NO_AXIS_PTS_X 1 UBYTE AXIS_PTS_X 2 UBYTE INDEX_INCR DIRECT FNC_VALUES 3 UWORD COLUMN_DIR DIRECT /end RECORD_LAYOUT
/begin RECORD_LAYOUT KlAUwSstUwWUw NO_AXIS_PTS_X 1 UWORD AXIS_PTS_X 2 UWORD INDEX_INCR DIRECT FNC_VALUES 3 UWORD COLUMN_DIR DIRECT /end RECORD_LAYOUT
/begin RECORD_LAYOUT KlAxU8SstxU8WU16 NO_AXIS_PTS_X 1 UBYTE AXIS_PTS_X 2 UBYTE INDEX_INCR DIRECT FNC_VALUES 3 UWORD COLUMN_DIR DIRECT /end RECORD_LAYOUT
/begin RECORD_LAYOUT KlAxU8SstxU8WU8 NO_AXIS_PTS_X 1 UBYTE AXIS_PTS_X 2 UBYTE INDEX_INCR DIRECT FNC_VALUES 3 UBYTE COLUMN_DIR DIRECT /end RECORD_LAYOUT
/begin RECORD_LAYOUT KwbUb FNC_VALUES 1 UBYTE COLUMN_DIR DIRECT /end RECORD_LAYOUT
/begin RECORD_LAYOUT KwbUw FNC_VALUES 1 UWORD COLUMN_DIR DIRECT /end RECORD_LAYOUT
/begin RECORD_LAYOUT KwbWU8 FNC_VALUES 1 UBYTE COLUMN_DIR DIRECT /end RECORD_LAYOUT
/begin RECORD_LAYOUT KwSb FNC_VALUES 1 SBYTE COLUMN_DIR DIRECT /end RECORD_LAYOUT
/begin RECORD_LAYOUT KwSw FNC_VALUES 1 SWORD COLUMN_DIR DIRECT /end RECORD_LAYOUT
/begin RECORD_LAYOUT KwUb FNC_VALUES 1 UBYTE COLUMN_DIR DIRECT /end RECORD_LAYOUT
/begin RECORD_LAYOUT KwUw FNC_VALUES 1 UWORD COLUMN_DIR DIRECT /end RECORD_LAYOUT
/begin RECORD_LAYOUT KwWU16 FNC_VALUES 1 UWORD COLUMN_DIR DIRECT /end RECORD_LAYOUT
/begin RECORD_LAYOUT KwWU8 FNC_VALUES 1 UBYTE COLUMN_DIR DIRECT /end RECORD_LAYOUT
/begin RECORD_LAYOUT SstAUbSstSb NO_AXIS_PTS_X 1 UBYTE AXIS_PTS_X 2 SBYTE INDEX_INCR DIRECT /end RECORD_LAYOUT
/begin RECORD_LAYOUT SstAUbSstUb NO_AXIS_PTS_X 1 UBYTE AXIS_PTS_X 2 UBYTE INDEX_INCR DIRECT /end RECORD_LAYOUT
/begin RECORD_LAYOUT SstAUwSstUw NO_AXIS_PTS_X 1 UWORD AXIS_PTS_X 2 UWORD INDEX_INCR DIRECT /end RECORD_LAYOUT
/end MODULE
/end PROJECT
