ASAP2_VERSION 1 3
/begin PROJECT P390 "BMW DDE6.2 6-Zylinder VP0.1 11.11.2003 CAN12H"
/begin HEADER "" VERSION "VP01_6Z_CAN12H" PROJECT_NO P390 /end HEADER
/begin MODULE DIM ""
/begin MOD_COMMON "" BYTE_ORDER MSB_FIRST ALIGNMENT_BYTE 1 ALIGNMENT_WORD 2 ALIGNMENT_LONG 4 ALIGNMENT_FLOAT32_IEEE 4 /end MOD_COMMON
/begin CHARACTERISTIC DSM_CDCDfp_Layer_TANS_C "CARB spezifischer Fehlercode fuer Fehlerpfad Dfp_Layer_TANS" VAL_BLK 0xC8BA0 Kwb_Wu16 65535.00 OneToOne 0.00 65535.00 FORMAT "%8.2" NUMBER 4 /end CHARACTERISTIC
/begin CHARACTERISTIC DSM_CDCDfp_ACCDSwtin_C "CARB spezifischer Fehlercode fuer Fehlerpfad Dfp_ACCDSwtin" VAL_BLK 0xC8BA8 Kwb_Wu16 65535.00 OneToOne 0.00 65535.00 FORMAT "%8.2" NUMBER 4 /end CHARACTERISTIC
/begin CHARACTERISTIC DSM_CDCDfp_ACC_PlausTrqDes_C "CARB spezifischer Fehlercode fuer Fehlerpfad Dfp_ACC_PlausTrqDes" VAL_BLK 0xC8BB0 Kwb_Wu16 65535.00 OneToOne 0.00 65535.00 FORMAT "%8.2" NUMBER 4 /end CHARACTERISTIC
/begin CHARACTERISTIC DSM_CDCDfp_ACC_trqInr_C "CARB spezifischer Fehlercode fuer Fehlerpfad Dfp_ACC_trqInr" VAL_BLK 0xC8BB8 Kwb_Wu16 65535.00 OneToOne 0.00 65535.00 FORMAT "%8.2" NUMBER 4 /end CHARACTERISTIC
/begin CHARACTERISTIC DSM_CDCDfp_ACTrq_C "CARB spezifischer Fehlercode fuer Fehlerpfad Dfp_ACTrq" VAL_BLK 0xC8BC0 Kwb_Wu16 65535.00 OneToOne 0.00 65535.00 FORMAT "%8.2" NUMBER 4 /end CHARACTERISTIC
/begin CHARACTERISTIC DSM_CDCDfp_ADCMon_C "CARB spezifischer Fehlercode fuer Fehlerpfad Dfp_ADCMon" VAL_BLK 0xC8BC8 Kwb_Wu16 65535.00 OneToOne 0.00 65535.00 FORMAT "%8.2" NUMBER 4 /end CHARACTERISTIC
/begin CHARACTERISTIC DSM_CDCDfp_AFSCDIdlAdjVal_C "CARB spezifischer Fehlercode fuer Fehlerpfad Dfp_AFSCDIdlAdjVal" VAL_BLK 0xC8BD0 Kwb_Wu16 65535.00 OneToOne 0.00 65535.00 FORMAT "%8.2" NUMBER 4 /end CHARACTERISTIC
/begin CHARACTERISTIC DSM_CDCDfp_AFSCDLdAdjVal_C "CARB spezifischer Fehlercode fuer Fehlerpfad Dfp_AFSCDLdAdjVal" VAL_BLK 0xC8BD8 Kwb_Wu16 65535.00 OneToOne 0.00 65535.00 FORMAT "%8.2" NUMBER 4 /end CHARACTERISTIC
/begin CHARACTERISTIC DSM_CDCDfp_AFSCD_AirTempDcyc_C "CARB spezifischer Fehlercode fuer Fehlerpfad Dfp_AFSCD_AirTempDcyc" VAL_BLK 0xC8BE0 Kwb_Wu16 65535.00 OneToOne 0.00 65535.00 FORMAT "%8.2" NUMBER 4 /end CHARACTERISTIC
/begin CHARACTERISTIC DSM_CDCDfp_AFSCD_PlOffsDrft_C "CARB spezifischer Fehlercode fuer Fehlerpfad Dfp_AFSCD_PlOffsDrft" VAL_BLK 0xC8BE8 Kwb_Wu16 65535.00 OneToOne 0.00 65535.00 FORMAT "%8.2" NUMBER 4 /end CHARACTERISTIC
/begin CHARACTERISTIC DSM_CDCDfp_AFSCD_PlSetyDrft_C "CARB spezifischer Fehlercode fuer Fehlerpfad Dfp_AFSCD_PlSetyDrft" VAL_BLK 0xC8BF0 Kwb_Wu16 65535.00 OneToOne 0.00 65535.00 FORMAT "%8.2" NUMBER 4 /end CHARACTERISTIC
/begin CHARACTERISTIC DSM_CDCDfp_AFSCD_SRCAirTemp_C "CARB spezifischer Fehlercode fuer Fehlerpfad Dfp_AFSCD_SRCAirTemp" VAL_BLK 0xC8BF8 Kwb_Wu16 65535.00 OneToOne 0.00 65535.00 FORMAT "%8.2" NUMBER 4 /end CHARACTERISTIC
/begin CHARACTERISTIC DSM_CDCDfp_AFSCD_SRCBatt_C "CARB spezifischer Fehlercode fuer Fehlerpfad Dfp_AFSCD_SRCBatt" VAL_BLK 0xC8C00 Kwb_Wu16 65535.00 OneToOne 0.00 65535.00 FORMAT "%8.2" NUMBER 4 /end CHARACTERISTIC
/begin CHARACTERISTIC DSM_CDCDfp_AFSCD_SRCCorrAirm_C "CARB spezifischer Fehlercode fuer Fehlerpfad Dfp_AFSCD_SRCCorrAirm" VAL_BLK 0xC8C08 Kwb_Wu16 65535.00 OneToOne 0.00 65535.00 FORMAT "%8.2" NUMBER 4 /end CHARACTERISTIC
/begin CHARACTERISTIC DSM_CDCDfp_AFSCD_SRCRawAirm_C "CARB spezifischer Fehlercode fuer Fehlerpfad Dfp_AFSCD_SRCRawAirm" VAL_BLK 0xC8C10 Kwb_Wu16 65535.00 OneToOne 0.00 65535.00 FORMAT "%8.2" NUMBER 4 /end CHARACTERISTIC
/begin CHARACTERISTIC DSM_CDCDfp_AFSCD_SRCRefSigPer_C "CARB spezifischer Fehlercode fuer Fehlerpfad Dfp_AFSCD_SRCRefSigPer" VAL_BLK 0xC8C18 Kwb_Wu16 65535.00 OneToOne 0.00 65535.00 FORMAT "%8.2" NUMBER 4 /end CHARACTERISTIC
/begin CHARACTERISTIC DSM_CDCDfp_AOHtCD_C "CARB spezifischer Fehlercode fuer Fehlerpfad Dfp_AOHtCD" VAL_BLK 0xC8C20 Kwb_Wu16 65535.00 OneToOne 0.00 65535.00 FORMAT "%8.2" NUMBER 4 /end CHARACTERISTIC
/begin CHARACTERISTIC DSM_CDCDfp_AOHtCD_AOHtDia1_C "CARB spezifischer Fehlercode fuer Fehlerpfad Dfp_AOHtCD_AOHtDia1" VAL_BLK 0xC8C28 Kwb_Wu16 65535.00 OneToOne 0.00 65535.00 FORMAT "%8.2" NUMBER 4 /end CHARACTERISTIC
/begin CHARACTERISTIC DSM_CDCDfp_AOHtCD_AOHtDia2_C "CARB spezifischer Fehlercode fuer Fehlerpfad Dfp_AOHtCD_AOHtDia2" VAL_BLK 0xC8C30 Kwb_Wu16 65535.00 OneToOne 0.00 65535.00 FORMAT "%8.2" NUMBER 4 /end CHARACTERISTIC
/begin CHARACTERISTIC DSM_CDCDfp_Layer_TUMG_C "CARB spezifischer Fehlercode fuer Fehlerpfad Dfp_Layer_TUMG" VAL_BLK 0xC8C38 Kwb_Wu16 65535.00 OneToOne 0.00 65535.00 FORMAT "%8.2" NUMBER 4 /end CHARACTERISTIC
/begin CHARACTERISTIC DSM_CDCDfp_AOHtCD_AOHtDia3_C "CARB spezifischer Fehlercode fuer Fehlerpfad Dfp_AOHtCD_AOHtDia3" VAL_BLK 0xC8C40 Kwb_Wu16 65535.00 OneToOne 0.00 65535.00 FORMAT "%8.2" NUMBER 4 /end CHARACTERISTIC
/begin CHARACTERISTIC DSM_CDCDfp_APP1_C "CARB spezifischer Fehlercode fuer Fehlerpfad Dfp_APP1" VAL_BLK 0xC8C48 Kwb_Wu16 65535.00 OneToOne 0.00 65535.00 FORMAT "%8.2" NUMBER 4 /end CHARACTERISTIC
/begin CHARACTERISTIC DSM_CDCDfp_Layer_GEN_C "CARB spezifischer Fehlercode fuer Fehlerpfad Dfp_Layer_GEN" VAL_BLK 0xC8C50 Kwb_Wu16 65535.00 OneToOne 0.00 65535.00 FORMAT "%8.2" NUMBER 4 /end CHARACTERISTIC
/begin CHARACTERISTIC DSM_CDCDfp_Layer_BSD_C "CARB spezifischer Fehlercode fuer Fehlerpfad Dfp_Layer_BSD" VAL_BLK 0xC8C58 Kwb_Wu16 65535.00 OneToOne 0.00 65535.00 FORMAT "%8.2" NUMBER 4 /end CHARACTERISTIC
/begin CHARACTERISTIC DSM_CDCDfp_APP2_C "CARB spezifischer Fehlercode fuer Fehlerpfad Dfp_APP2" VAL_BLK 0xC8C60 Kwb_Wu16 65535.00 OneToOne 0.00 65535.00 FORMAT "%8.2" NUMBER 4 /end CHARACTERISTIC
/begin CHARACTERISTIC DSM_CDCDfp_APSCD_C "CARB spezifischer Fehlercode fuer Fehlerpfad Dfp_APSCD" VAL_BLK 0xC8C68 Kwb_Wu16 65535.00 OneToOne 0.00 65535.00 FORMAT "%8.2" NUMBER 4 /end CHARACTERISTIC
/begin CHARACTERISTIC DSM_CDCDfp_ARS_C "CARB spezifischer Fehlercode fuer Fehlerpfad Dfp_ARS" VAL_BLK 0xC8C70 Kwb_Wu16 65535.00 OneToOne 0.00 65535.00 FORMAT "%8.2" NUMBER 4 /end CHARACTERISTIC
/begin CHARACTERISTIC DSM_CDCDfp_AccPedPlausBrk_C "CARB spezifischer Fehlercode fuer Fehlerpfad Dfp_AccPedPlausBrk" VAL_BLK 0xC8C78 Kwb_Wu16 65535.00 OneToOne 0.00 65535.00 FORMAT "%8.2" NUMBER 4 /end CHARACTERISTIC
/begin CHARACTERISTIC DSM_CDCDfp_AirCtlPlateBreak_C "DSM variable for Dfp_AirCtlPlateBreak_mp" VAL_BLK 0xC8C80 Kwb_Wu16 65535.00 OneToOne 0.00 65535.00 FORMAT "%8.2" NUMBER 4 /end CHARACTERISTIC
/begin CHARACTERISTIC DSM_CDCDfp_AirCtl_GovNegDev_C "CARB spezifischer Fehlercode fuer Fehlerpfad Dfp_AirCtl_GovNegDev" VAL_BLK 0xC8C88 Kwb_Wu16 65535.00 OneToOne 0.00 65535.00 FORMAT "%8.2" NUMBER 4 /end CHARACTERISTIC
/begin CHARACTERISTIC DSM_CDCDfp_AirCtl_GovNegDev2_C "CARB spezifischer Fehlercode fuer Fehlerpfad Dfp_AirCtl_GovNegDev2" VAL_BLK 0xC8C90 Kwb_Wu16 65535.00 OneToOne 0.00 65535.00 FORMAT "%8.2" NUMBER 4 /end CHARACTERISTIC
/begin CHARACTERISTIC DSM_CDCDfp_AirCtl_GovPosDev_C "CARB spezifischer Fehlercode fuer Fehlerpfad Dfp_AirCtl_GovPosDev" VAL_BLK 0xC8C98 Kwb_Wu16 65535.00 OneToOne 0.00 65535.00 FORMAT "%8.2" NUMBER 4 /end CHARACTERISTIC
/begin CHARACTERISTIC DSM_CDCDfp_AirCtl_GovPosDev2_C "CARB spezifischer Fehlercode fuer Fehlerpfad Dfp_AirCtl_GovPosDev2" VAL_BLK 0xC8CA0 Kwb_Wu16 65535.00 OneToOne 0.00 65535.00 FORMAT "%8.2" NUMBER 4 /end CHARACTERISTIC
/begin CHARACTERISTIC DSM_CDCDfp_AltCD_C "CARB spezifischer Fehlercode fuer Fehlerpfad Dfp_AltCD" VAL_BLK 0xC8CA8 Kwb_Wu16 65535.00 OneToOne 0.00 65535.00 FORMAT "%8.2" NUMBER 4 /end CHARACTERISTIC
/begin CHARACTERISTIC DSM_CDCDfp_Layer_QLT_C "CARB spezifischer Fehlercode fuer Fehlerpfad Dfp_Layer_QLT" VAL_BLK 0xC8CB0 Kwb_Wu16 65535.00 OneToOne 0.00 65535.00 FORMAT "%8.2" NUMBER 4 /end CHARACTERISTIC
/begin CHARACTERISTIC DSM_CDCDfp_BPACD_BPADia1_C "CARB spezifischer Fehlercode fuer Fehlerpfad Dfp_BPACD_BPADia1" VAL_BLK 0xC8CB8 Kwb_Wu16 65535.00 OneToOne 0.00 65535.00 FORMAT "%8.2" NUMBER 4 /end CHARACTERISTIC
/begin CHARACTERISTIC DSM_CDCDfp_Layer_IBS1_C "CARB spezifischer Fehlercode fuer Fehlerpfad Dfp_Layer_IBS1" VAL_BLK 0xC8CC0 Kwb_Wu16 65535.00 OneToOne 0.00 65535.00 FORMAT "%8.2" NUMBER 4 /end CHARACTERISTIC
/begin CHARACTERISTIC DSM_CDCDfp_Layer_IBS2_C "CARB spezifischer Fehlercode fuer Fehlerpfad Dfp_Layer_IBS2" VAL_BLK 0xC8CC8 Kwb_Wu16 65535.00 OneToOne 0.00 65535.00 FORMAT "%8.2" NUMBER 4 /end CHARACTERISTIC
/begin CHARACTERISTIC DSM_CDCDfp_Layer_IBS3_C "CARB spezifischer Fehlercode fuer Fehlerpfad Dfp_Layer_IBS3" VAL_BLK 0xC8CD0 Kwb_Wu16 65535.00 OneToOne 0.00 65535.00 FORMAT "%8.2" NUMBER 4 /end CHARACTERISTIC
/begin CHARACTERISTIC DSM_CDCDfp_Layer_PMBN_C "CARB spezifischer Fehlercode fuer Fehlerpfad Dfp_Layer_PMBN" VAL_BLK 0xC8CD8 Kwb_Wu16 65535.00 OneToOne 0.00 65535.00 FORMAT "%8.2" NUMBER 4 /end CHARACTERISTIC
/begin CHARACTERISTIC DSM_CDCDfp_Layer_PMBATT_C "CARB spezifischer Fehlercode fuer Fehlerpfad Dfp_Layer_PMBATT" VAL_BLK 0xC8CE0 Kwb_Wu16 65535.00 OneToOne 0.00 65535.00 FORMAT "%8.2" NUMBER 4 /end CHARACTERISTIC
/begin CHARACTERISTIC DSM_CDCDfp_BPACD_BPADia2_C "CARB spezifischer Fehlercode fuer Fehlerpfad Dfp_BPACD_BPADia2" VAL_BLK 0xC8CE8 Kwb_Wu16 65535.00 OneToOne 0.00 65535.00 FORMAT "%8.2" NUMBER 4 /end CHARACTERISTIC
/begin CHARACTERISTIC DSM_CDCDfp_BPACD_BPADia3_C "CARB spezifischer Fehlercode fuer Fehlerpfad Dfp_BPACD_BPADia3" VAL_BLK 0xC8CF0 Kwb_Wu16 65535.00 OneToOne 0.00 65535.00 FORMAT "%8.2" NUMBER 4 /end CHARACTERISTIC
/begin CHARACTERISTIC DSM_CDCDfp_BPACD_Max_C "CARB spezifischer Fehlercode fuer Fehlerpfad Dfp_BPACD_Max" VAL_BLK 0xC8CF8 Kwb_Wu16 65535.00 OneToOne 0.00 65535.00 FORMAT "%8.2" NUMBER 4 /end CHARACTERISTIC
/begin CHARACTERISTIC DSM_CDCDfp_BPACD_Min_C "CARB spezifischer Fehlercode fuer Fehlerpfad Dfp_BPACD_Min" VAL_BLK 0xC8D00 Kwb_Wu16 65535.00 OneToOne 0.00 65535.00 FORMAT "%8.2" NUMBER 4 /end CHARACTERISTIC
/begin CHARACTERISTIC DSM_CDCDfp_BPACD_SigNpl_C "CARB spezifischer Fehlercode fuer Fehlerpfad Dfp_BPACD_SigNpl" VAL_BLK 0xC8D08 Kwb_Wu16 65535.00 OneToOne 0.00 65535.00 FORMAT "%8.2" NUMBER 4 /end CHARACTERISTIC
/begin CHARACTERISTIC DSM_CDCDfp_BPSCD_C "CARB spezifischer Fehlercode fuer Fehlerpfad Dfp_BPSCD" VAL_BLK 0xC8D10 Kwb_Wu16 65535.00 OneToOne 0.00 65535.00 FORMAT "%8.2" NUMBER 4 /end CHARACTERISTIC
/begin CHARACTERISTIC DSM_CDCDfp_BattCD_C "CARB spezifischer Fehlercode fuer Fehlerpfad Dfp_BattCD" VAL_BLK 0xC8D18 Kwb_Wu16 65535.00 OneToOne 0.00 65535.00 FORMAT "%8.2" NUMBER 4 /end CHARACTERISTIC
/begin CHARACTERISTIC DSM_CDCDfp_BrkCD_C "CARB spezifischer Fehlercode fuer Fehlerpfad Dfp_BrkCD" VAL_BLK 0xC8D20 Kwb_Wu16 65535.00 OneToOne 0.00 65535.00 FORMAT "%8.2" NUMBER 4 /end CHARACTERISTIC
/begin CHARACTERISTIC DSM_CDCDfp_Bss_C "CARB spezifischer Fehlercode fuer Fehlerpfad Dfp_Bss" VAL_BLK 0xC8D28 Kwb_Wu16 65535.00 OneToOne 0.00 65535.00 FORMAT "%8.2" NUMBER 4 /end CHARACTERISTIC
/begin CHARACTERISTIC DSM_CDCDfp_CBACD_C "CARB spezifischer Fehlercode fuer Fehlerpfad Dfp_CBACD" VAL_BLK 0xC8D30 Kwb_Wu16 65535.00 OneToOne 0.00 65535.00 FORMAT "%8.2" NUMBER 4 /end CHARACTERISTIC
/begin CHARACTERISTIC DSM_CDCDfp_CTSCD_C "CARB spezifischer Fehlercode fuer Fehlerpfad Dfp_CTSCD" VAL_BLK 0xC8D38 Kwb_Wu16 65535.00 OneToOne 0.00 65535.00 FORMAT "%8.2" NUMBER 4 /end CHARACTERISTIC
/begin CHARACTERISTIC DSM_CDCDfp_Clg_DynTst_C "CARB spezifischer Fehlercode fuer Fehlerpfad Dfp_Clg_DynTst" VAL_BLK 0xC8D40 Kwb_Wu16 65535.00 OneToOne 0.00 65535.00 FORMAT "%8.2" NUMBER 4 /end CHARACTERISTIC
/begin CHARACTERISTIC DSM_CDCDfp_CmbChbMisfire1_C "CARB spezifischer Fehlercode fuer Fehlerpfad Dfp_CmbChbMisfire1" VAL_BLK 0xC8D48 Kwb_Wu16 65535.00 OneToOne 0.00 65535.00 FORMAT "%8.2" NUMBER 4 /end CHARACTERISTIC
/begin CHARACTERISTIC DSM_CDCDfp_CmbChbMisfire2_C "CARB spezifischer Fehlercode fuer Fehlerpfad Dfp_CmbChbMisfire2" VAL_BLK 0xC8D50 Kwb_Wu16 65535.00 OneToOne 0.00 65535.00 FORMAT "%8.2" NUMBER 4 /end CHARACTERISTIC
/begin CHARACTERISTIC DSM_CDCDfp_CmbChbMisfire3_C "CARB spezifischer Fehlercode fuer Fehlerpfad Dfp_CmbChbMisfire3" VAL_BLK 0xC8D58 Kwb_Wu16 65535.00 OneToOne 0.00 65535.00 FORMAT "%8.2" NUMBER 4 /end CHARACTERISTIC
/begin CHARACTERISTIC DSM_CDCDfp_CmbChbMisfire4_C "CARB spezifischer Fehlercode fuer Fehlerpfad Dfp_CmbChbMisfire4" VAL_BLK 0xC8D60 Kwb_Wu16 65535.00 OneToOne 0.00 65535.00 FORMAT "%8.2" NUMBER 4 /end CHARACTERISTIC
/begin CHARACTERISTIC DSM_CDCDfp_CmbChbMisfire5_C "CARB spezifischer Fehlercode fuer Fehlerpfad Dfp_CmbChbMisfire5" VAL_BLK 0xC8D68 Kwb_Wu16 65535.00 OneToOne 0.00 65535.00 FORMAT "%8.2" NUMBER 4 /end CHARACTERISTIC
/begin CHARACTERISTIC DSM_CDCDfp_CmbChbMisfire6_C "CARB spezifischer Fehlercode fuer Fehlerpfad Dfp_CmbChbMisfire6" VAL_BLK 0xC8D70 Kwb_Wu16 65535.00 OneToOne 0.00 65535.00 FORMAT "%8.2" NUMBER 4 /end CHARACTERISTIC
/begin CHARACTERISTIC DSM_CDCDfp_CmbChbMisfireMul_C "CARB spezifischer Fehlercode fuer Fehlerpfad Dfp_CmbChbMisfireMul" VAL_BLK 0xC8D78 Kwb_Wu16 65535.00 OneToOne 0.00 65535.00 FORMAT "%8.2" NUMBER 4 /end CHARACTERISTIC
/begin CHARACTERISTIC DSM_CDCDfp_CoVMDCSh_C "CARB spezifischer Fehlercode fuer Fehlerpfad Dfp_CoVMDCSh" VAL_BLK 0xC8D80 Kwb_Wu16 65535.00 OneToOne 0.00 65535.00 FORMAT "%8.2" NUMBER 4 /end CHARACTERISTIC
/begin CHARACTERISTIC DSM_CDCDfp_ConvCD_C "CARB spezifischer Fehlercode fuer Fehlerpfad Dfp_ConvCD" VAL_BLK 0xC8D88 Kwb_Wu16 65535.00 OneToOne 0.00 65535.00 FORMAT "%8.2" NUMBER 4 /end CHARACTERISTIC
/begin CHARACTERISTIC DSM_CDCDfp_CrCCDMFL_C "CARB spezifischer Fehlercode fuer Fehlerpfad Dfp_CrCCDMFL" VAL_BLK 0xC8D90 Kwb_Wu16 65535.00 OneToOne 0.00 65535.00 FORMAT "%8.2" NUMBER 4 /end CHARACTERISTIC
/begin CHARACTERISTIC DSM_CDCDfp_CrCtl_vCrCtl_C "CARB spezifischer Fehlercode fuer Fehlerpfad Dfp_CrCtl_vCrCtl" VAL_BLK 0xC8D98 Kwb_Wu16 65535.00 OneToOne 0.00 65535.00 FORMAT "%8.2" NUMBER 4 /end CHARACTERISTIC
/begin CHARACTERISTIC DSM_CDCDfp_Dummy1_C "CARB spezifischer Fehlercode fuer Fehlerpfad Dfp_Dummy1" VAL_BLK 0xC8DA0 Kwb_Wu16 65535.00 OneToOne 0.00 65535.00 FORMAT "%8.2" NUMBER 4 /end CHARACTERISTIC
/begin CHARACTERISTIC DSM_CDCDfp_EATSCD_C "CARB spezifischer Fehlercode fuer Fehlerpfad Dfp_EATSCD" VAL_BLK 0xC8DA8 Kwb_Wu16 65535.00 OneToOne 0.00 65535.00 FORMAT "%8.2" NUMBER 4 /end CHARACTERISTIC
/begin CHARACTERISTIC DSM_CDCDfp_EBAFCD_C "CARB spezifischer Fehlercode fuer Fehlerpfad Dfp_EBAFCD" VAL_BLK 0xC8DB0 Kwb_Wu16 65535.00 OneToOne 0.00 65535.00 FORMAT "%8.2" NUMBER 4 /end CHARACTERISTIC
/begin CHARACTERISTIC DSM_CDCDfp_EBFCD_C "CARB spezifischer Fehlercode fuer Fehlerpfad Dfp_EBFCD" VAL_BLK 0xC8DB8 Kwb_Wu16 65535.00 OneToOne 0.00 65535.00 FORMAT "%8.2" NUMBER 4 /end CHARACTERISTIC
/begin CHARACTERISTIC DSM_CDCDfp_EBTSCD_C "CARB spezifischer Fehlercode fuer Fehlerpfad Dfp_EBTSCD" VAL_BLK 0xC8DC0 Kwb_Wu16 65535.00 OneToOne 0.00 65535.00 FORMAT "%8.2" NUMBER 4 /end CHARACTERISTIC
/begin CHARACTERISTIC DSM_CDCDfp_EBTSCD_OvrTemp_C "CARB spezifischer Fehlercode fuer Fehlerpfad Dfp_EBTSCD_OvrTemp" VAL_BLK 0xC8DC8 Kwb_Wu16 65535.00 OneToOne 0.00 65535.00 FORMAT "%8.2" NUMBER 4 /end CHARACTERISTIC
/begin CHARACTERISTIC DSM_CDCDfp_EEPCDVarMng_C "CARB spezifischer Fehlercode fuer Fehlerpfad Dfp_EEPCDVarMng" VAL_BLK 0xC8DD0 Kwb_Wu16 65535.00 OneToOne 0.00 65535.00 FORMAT "%8.2" NUMBER 4 /end CHARACTERISTIC
/begin CHARACTERISTIC DSM_CDCDfp_EGPpCD_C "CARB spezifischer Fehlercode fuer Fehlerpfad Dfp_EGPpCD" VAL_BLK 0xC8DD8 Kwb_Wu16 65535.00 OneToOne 0.00 65535.00 FORMAT "%8.2" NUMBER 4 /end CHARACTERISTIC
/begin CHARACTERISTIC DSM_CDCDfp_EGPpCDTPreTrbn_C "CARB spezifischer Fehlercode fuer Fehlerpfad Dfp_EgPpCDTPreTrbn" VAL_BLK 0xC8DE0 Kwb_Wu16 65535.00 OneToOne 0.00 65535.00 FORMAT "%8.2" NUMBER 4 /end CHARACTERISTIC
/begin CHARACTERISTIC DSM_CDCDfp_Layer_PMRUHVERL_C "" VAL_BLK 0xC8DE8 Kwb_Wu16 65535.00 OneToOne 0.00 65535.00 FORMAT "%8.2" NUMBER 4 /end CHARACTERISTIC
/begin CHARACTERISTIC DSM_CDCDfp_EGRCD_Max_C "CARB spezifischer Fehlercode fuer Fehlerpfad Dfp_EGRCD_Max" VAL_BLK 0xC8DF0 Kwb_Wu16 65535.00 OneToOne 0.00 65535.00 FORMAT "%8.2" NUMBER 4 /end CHARACTERISTIC
/begin CHARACTERISTIC DSM_CDCDfp_EGRCD_Min_C "CARB spezifischer Fehlercode fuer Fehlerpfad Dfp_EGRCD_Min" VAL_BLK 0xC8DF8 Kwb_Wu16 65535.00 OneToOne 0.00 65535.00 FORMAT "%8.2" NUMBER 4 /end CHARACTERISTIC
/begin CHARACTERISTIC DSM_CDCDfp_EGRCD_SigNpl_C "CARB spezifischer Fehlercode fuer Fehlerpfad Dfp_EGRCD_SigNpl" VAL_BLK 0xC8E00 Kwb_Wu16 65535.00 OneToOne 0.00 65535.00 FORMAT "%8.2" NUMBER 4 /end CHARACTERISTIC
/begin CHARACTERISTIC DSM_CDCDfp_EGTRgnOilDil_C "CARB spezifischer Fehlercode fuer Fehlerpfad Dfp_EGTRgnOilDil" VAL_BLK 0xC8E08 Kwb_Wu16 65535.00 OneToOne 0.00 65535.00 FORMAT "%8.2" NUMBER 4 /end CHARACTERISTIC
/begin CHARACTERISTIC DSM_CDCDfp_Layer_TOENS_C "" VAL_BLK 0xC8E10 Kwb_Wu16 65535.00 OneToOne 0.00 65535.00 FORMAT "%8.2" NUMBER 4 /end CHARACTERISTIC
/begin CHARACTERISTIC DSM_CDCDfp_Layer_MANHYDR_C "" VAL_BLK 0xC8E18 Kwb_Wu16 65535.00 OneToOne 0.00 65535.00 FORMAT "%8.2" NUMBER 4 /end CHARACTERISTIC
/begin CHARACTERISTIC DSM_CDCDfp_Layer_MANLUFT_C "" VAL_BLK 0xC8E20 Kwb_Wu16 65535.00 OneToOne 0.00 65535.00 FORMAT "%8.2" NUMBER 4 /end CHARACTERISTIC
/begin CHARACTERISTIC DSM_CDCDfp_ETClbETFltInj1_C "CARB spezifischer Fehlercode fuer Fehlerpfad Dfp_ETClbETFltInj1" VAL_BLK 0xC8E28 Kwb_Wu16 65535.00 OneToOne 0.00 65535.00 FORMAT "%8.2" NUMBER 4 /end CHARACTERISTIC
/begin CHARACTERISTIC DSM_CDCDfp_ETClbETFltInj2_C "CARB spezifischer Fehlercode fuer Fehlerpfad Dfp_ETClbETFltInj2" VAL_BLK 0xC8E30 Kwb_Wu16 65535.00 OneToOne 0.00 65535.00 FORMAT "%8.2" NUMBER 4 /end CHARACTERISTIC
/begin CHARACTERISTIC DSM_CDCDfp_ETClbETFltInj3_C "CARB spezifischer Fehlercode fuer Fehlerpfad Dfp_ETClbETFltInj3" VAL_BLK 0xC8E38 Kwb_Wu16 65535.00 OneToOne 0.00 65535.00 FORMAT "%8.2" NUMBER 4 /end CHARACTERISTIC
/begin CHARACTERISTIC DSM_CDCDfp_ETClbETFltInj4_C "CARB spezifischer Fehlercode fuer Fehlerpfad Dfp_ETClbETFltInj4" VAL_BLK 0xC8E40 Kwb_Wu16 65535.00 OneToOne 0.00 65535.00 FORMAT "%8.2" NUMBER 4 /end CHARACTERISTIC
/begin CHARACTERISTIC DSM_CDCDfp_ETClbETFltInj5_C "CARB spezifischer Fehlercode fuer Fehlerpfad Dfp_ETClbETFltInj5" VAL_BLK 0xC8E48 Kwb_Wu16 65535.00 OneToOne 0.00 65535.00 FORMAT "%8.2" NUMBER 4 /end CHARACTERISTIC
/begin CHARACTERISTIC DSM_CDCDfp_ETClbETFltInj6_C "CARB spezifischer Fehlercode fuer Fehlerpfad Dfp_ETClbETFltInj6" VAL_BLK 0xC8E50 Kwb_Wu16 65535.00 OneToOne 0.00 65535.00 FORMAT "%8.2" NUMBER 4 /end CHARACTERISTIC
/begin CHARACTERISTIC DSM_CDCDfp_ETClbInj1_C "CARB spezifischer Fehlercode fuer Fehlerpfad Dfp_ETClbInj1" VAL_BLK 0xC8E58 Kwb_Wu16 65535.00 OneToOne 0.00 65535.00 FORMAT "%8.2" NUMBER 4 /end CHARACTERISTIC
/begin CHARACTERISTIC DSM_CDCDfp_ETClbInj2_C "CARB spezifischer Fehlercode fuer Fehlerpfad Dfp_ETClbInj2" VAL_BLK 0xC8E60 Kwb_Wu16 65535.00 OneToOne 0.00 65535.00 FORMAT "%8.2" NUMBER 4 /end CHARACTERISTIC
/begin CHARACTERISTIC DSM_CDCDfp_ETClbInj3_C "CARB spezifischer Fehlercode fuer Fehlerpfad Dfp_ETClbInj3" VAL_BLK 0xC8E68 Kwb_Wu16 65535.00 OneToOne 0.00 65535.00 FORMAT "%8.2" NUMBER 4 /end CHARACTERISTIC
/begin CHARACTERISTIC DSM_CDCDfp_ETClbInj4_C "CARB spezifischer Fehlercode fuer Fehlerpfad Dfp_ETClbInj4" VAL_BLK 0xC8E70 Kwb_Wu16 65535.00 OneToOne 0.00 65535.00 FORMAT "%8.2" NUMBER 4 /end CHARACTERISTIC
/begin CHARACTERISTIC DSM_CDCDfp_ETClbInj5_C "CARB spezifischer Fehlercode fuer Fehlerpfad Dfp_ETClbInj5" VAL_BLK 0xC8E78 Kwb_Wu16 65535.00 OneToOne 0.00 65535.00 FORMAT "%8.2" NUMBER 4 /end CHARACTERISTIC
/begin CHARACTERISTIC DSM_CDCDfp_ETClbInj6_C "CARB spezifischer Fehlercode fuer Fehlerpfad Dfp_ETClbInj6" VAL_BLK 0xC8E80 Kwb_Wu16 65535.00 OneToOne 0.00 65535.00 FORMAT "%8.2" NUMBER 4 /end CHARACTERISTIC
/begin CHARACTERISTIC DSM_CDCDfp_EngMCaS1_C "CARB spezifischer Fehlercode fuer Fehlerpfad Dfp_EngMCaS1" VAL_BLK 0xC8E88 Kwb_Wu16 65535.00 OneToOne 0.00 65535.00 FORMAT "%8.2" NUMBER 4 /end CHARACTERISTIC
/begin CHARACTERISTIC DSM_CDCDfp_EngMCrS1_C "CARB spezifischer Fehlercode fuer Fehlerpfad Dfp_EngMCrS1" VAL_BLK 0xC8E90 Kwb_Wu16 65535.00 OneToOne 0.00 65535.00 FORMAT "%8.2" NUMBER 4 /end CHARACTERISTIC
/begin CHARACTERISTIC DSM_CDCDfp_EngMOfsCaSCrS_C "CARB spezifischer Fehlercode fuer Fehlerpfad Dfp_EngMOfsCaSCrS" VAL_BLK 0xC8E98 Kwb_Wu16 65535.00 OneToOne 0.00 65535.00 FORMAT "%8.2" NUMBER 4 /end CHARACTERISTIC
/begin CHARACTERISTIC DSM_CDCDfp_EngMntCtl1_Dia1_C "" VAL_BLK 0xC8EA0 Kwb_Wu16 65535.00 OneToOne 0.00 65535.00 FORMAT "%8.2" NUMBER 4 /end CHARACTERISTIC
/begin CHARACTERISTIC DSM_CDCDfp_EngMntCtl1_Dia2_C "" VAL_BLK 0xC8EA8 Kwb_Wu16 65535.00 OneToOne 0.00 65535.00 FORMAT "%8.2" NUMBER 4 /end CHARACTERISTIC
/begin CHARACTERISTIC DSM_CDCDfp_EngMntCtl1_Dia3_C "" VAL_BLK 0xC8EB0 Kwb_Wu16 65535.00 OneToOne 0.00 65535.00 FORMAT "%8.2" NUMBER 4 /end CHARACTERISTIC
/begin CHARACTERISTIC DSM_CDCDfp_EngMntCtl1_Max_C "" VAL_BLK 0xC8EB8 Kwb_Wu16 65535.00 OneToOne 0.00 65535.00 FORMAT "%8.2" NUMBER 4 /end CHARACTERISTIC
/begin CHARACTERISTIC DSM_CDCDfp_EngMntCtl1_Min_C "" VAL_BLK 0xC8EC0 Kwb_Wu16 65535.00 OneToOne 0.00 65535.00 FORMAT "%8.2" NUMBER 4 /end CHARACTERISTIC
/begin CHARACTERISTIC DSM_CDCDfp_EngMntCtl1_SigNpl_C "" VAL_BLK 0xC8EC8 Kwb_Wu16 65535.00 OneToOne 0.00 65535.00 FORMAT "%8.2" NUMBER 4 /end CHARACTERISTIC
/begin CHARACTERISTIC DSM_CDCDfp_EngMntCtlCD_C "CARB spezifischer Fehlercode fuer Fehlerpfad Dfp_EngMntCtlCD" VAL_BLK 0xC8ED0 Kwb_Wu16 65535.00 OneToOne 0.00 65535.00 FORMAT "%8.2" NUMBER 4 /end CHARACTERISTIC
/begin CHARACTERISTIC DSM_CDCDfp_EngMntCtl_Dia1_C "" VAL_BLK 0xC8ED8 Kwb_Wu16 65535.00 OneToOne 0.00 65535.00 FORMAT "%8.2" NUMBER 4 /end CHARACTERISTIC
/begin CHARACTERISTIC DSM_CDCDfp_EngMntCtl_Dia2_C "" VAL_BLK 0xC8EE0 Kwb_Wu16 65535.00 OneToOne 0.00 65535.00 FORMAT "%8.2" NUMBER 4 /end CHARACTERISTIC
/begin CHARACTERISTIC DSM_CDCDfp_EngMntCtl_Dia3_C "" VAL_BLK 0xC8EE8 Kwb_Wu16 65535.00 OneToOne 0.00 65535.00 FORMAT "%8.2" NUMBER 4 /end CHARACTERISTIC
/begin CHARACTERISTIC DSM_CDCDfp_EngMntCtl_Max_C "" VAL_BLK 0xC8EF0 Kwb_Wu16 65535.00 OneToOne 0.00 65535.00 FORMAT "%8.2" NUMBER 4 /end CHARACTERISTIC
/begin CHARACTERISTIC DSM_CDCDfp_EngMntCtl_Min_C "" VAL_BLK 0xC8EF8 Kwb_Wu16 65535.00 OneToOne 0.00 65535.00 FORMAT "%8.2" NUMBER 4 /end CHARACTERISTIC
/begin CHARACTERISTIC DSM_CDCDfp_EngMntCtl_SigNpl_C "" VAL_BLK 0xC8F00 Kwb_Wu16 65535.00 OneToOne 0.00 65535.00 FORMAT "%8.2" NUMBER 4 /end CHARACTERISTIC
/begin CHARACTERISTIC DSM_CDCDfp_EngPrtFWODet_C "CARB spezifischer Fehlercode fuer Fehlerpfad Dfp_EngPrtFWODet" VAL_BLK 0xC8F08 Kwb_Wu16 65535.00 OneToOne 0.00 65535.00 FORMAT "%8.2" NUMBER 4 /end CHARACTERISTIC
/begin CHARACTERISTIC DSM_CDCDfp_FBCqDvt_C "CARB spezifischer Fehlercode fuer Fehlerpfad Dfp_FBCqDvt" VAL_BLK 0xC8F10 Kwb_Wu16 65535.00 OneToOne 0.00 65535.00 FORMAT "%8.2" NUMBER 4 /end CHARACTERISTIC
/begin CHARACTERISTIC DSM_CDCDfp_FMTC_NonMonotonMap_C "CARB spezifischer Fehlercode fuer Fehlerpfad Dfp_FMTC_NonMonotonMap" VAL_BLK 0xC8F18 Kwb_Wu16 65535.00 OneToOne 0.00 65535.00 FORMAT "%8.2" NUMBER 4 /end CHARACTERISTIC
/begin CHARACTERISTIC DSM_CDCDfp_FTSCD_C "CARB spezifischer Fehlercode fuer Fehlerpfad Dfp_FTSCD" VAL_BLK 0xC8F20 Kwb_Wu16 65535.00 OneToOne 0.00 65535.00 FORMAT "%8.2" NUMBER 4 /end CHARACTERISTIC
/begin CHARACTERISTIC DSM_CDCDfp_FanCD_C "CARB spezifischer Fehlercode fuer Fehlerpfad Dfp_FanCD" VAL_BLK 0xC8F28 Kwb_Wu16 65535.00 OneToOne 0.00 65535.00 FORMAT "%8.2" NUMBER 4 /end CHARACTERISTIC
/begin CHARACTERISTIC DSM_CDCDfp_FanCD_FanCtlr1_C "CARB spezifischer Fehlercode fuer Fehlerpfad Dfp_FanCD_FanCtlr1" VAL_BLK 0xC8F30 Kwb_Wu16 65535.00 OneToOne 0.00 65535.00 FORMAT "%8.2" NUMBER 4 /end CHARACTERISTIC
/begin CHARACTERISTIC DSM_CDCDfp_FanCD_FanCtlr2_C "CARB spezifischer Fehlercode fuer Fehlerpfad Dfp_FanCD_FanCtlr2" VAL_BLK 0xC8F38 Kwb_Wu16 65535.00 OneToOne 0.00 65535.00 FORMAT "%8.2" NUMBER 4 /end CHARACTERISTIC
/begin CHARACTERISTIC DSM_CDCDfp_FanCD_FanCtlr3_C "CARB spezifischer Fehlercode fuer Fehlerpfad Dfp_FanCD_FanCtlr3" VAL_BLK 0xC8F40 Kwb_Wu16 65535.00 OneToOne 0.00 65535.00 FORMAT "%8.2" NUMBER 4 /end CHARACTERISTIC
/begin CHARACTERISTIC DSM_CDCDfp_FlFCD_C "CARB spezifischer Fehlercode fuer Fehlerpfad Dfp_FlFCD" VAL_BLK 0xC8F48 Kwb_Wu16 65535.00 OneToOne 0.00 65535.00 FORMAT "%8.2" NUMBER 4 /end CHARACTERISTIC
/begin CHARACTERISTIC DSM_CDCDfp_FlMngSmkDefect_C "CARB spezifischer Fehlercode fuer Fehlerpfad Dfp_FlMngSmkDefect" VAL_BLK 0xC8F50 Kwb_Wu16 65535.00 OneToOne 0.00 65535.00 FORMAT "%8.2" NUMBER 4 /end CHARACTERISTIC
/begin CHARACTERISTIC DSM_CDCDfp_FrmMngBOS_RESET_C "CARB spezifischer Fehlercode fuer Fehlerpfad Dfp_FrmMngBOS_RESET" VAL_BLK 0xC8F58 Kwb_Wu16 65535.00 OneToOne 0.00 65535.00 FORMAT "%8.2" NUMBER 4 /end CHARACTERISTIC
/begin CHARACTERISTIC DSM_CDCDfp_FrmMngBOS_RESET_2_C "" VAL_BLK 0xC8F60 Kwb_Wu16 65535.00 OneToOne 0.00 65535.00 FORMAT "%8.2" NUMBER 4 /end CHARACTERISTIC
/begin CHARACTERISTIC DSM_CDCDfp_FrmMngDMANFAFS_C "CARB spezifischer Fehlercode fuer Fehlerpfad Dfp_FrmMngDMANFAFS" VAL_BLK 0xC8F68 Kwb_Wu16 65535.00 OneToOne 0.00 65535.00 FORMAT "%8.2" NUMBER 4 /end CHARACTERISTIC
/begin CHARACTERISTIC DSM_CDCDfp_FrmMngDRMANFSSG_C "CARB spezifischer Fehlercode fuer Fehlerpfad Dfp_FrmMngDRMANFSSG" VAL_BLK 0xC8F70 Kwb_Wu16 65535.00 OneToOne 0.00 65535.00 FORMAT "%8.2" NUMBER 4 /end CHARACTERISTIC
/begin CHARACTERISTIC DSM_CDCDfp_FrmMngGEARBX_DATA_C "P-Code (CARB) for faults in path" VAL_BLK 0xC8F78 Kwb_Wu16 65535.00 OneToOne 0.00 65535.00 FORMAT "%8.2" NUMBER 4 /end CHARACTERISTIC
/begin CHARACTERISTIC DSM_CDCDfp_FrmMngGEARBX_DATA2_C "CARB spezifischer Fehlercode fuer Fehlerpfad Dfp_FrmMngGEARBX_DATA2" VAL_BLK 0xC8F80 Kwb_Wu16 65535.00 OneToOne 0.00 65535.00 FORMAT "%8.2" NUMBER 4 /end CHARACTERISTIC
/begin CHARACTERISTIC DSM_CDCDfp_FrmMngHEAT_AC_C "P-Code (CARB) for faults in path" VAL_BLK 0xC8F88 Kwb_Wu16 65535.00 OneToOne 0.00 65535.00 FORMAT "%8.2" NUMBER 4 /end CHARACTERISTIC
/begin CHARACTERISTIC DSM_CDCDfp_FrmMngLENKRADWINKEL_C "CARB spezifischer Fehlercode fuer Fehlerpfad Dfp_FrmMngLENKRADWINKEL" VAL_BLK 0xC8F90 Kwb_Wu16 65535.00 OneToOne 0.00 65535.00 FORMAT "%8.2" NUMBER 4 /end CHARACTERISTIC
/begin CHARACTERISTIC DSM_CDCDfp_FrmMngMILEAGE_RANGE_C "CARB spezifischer Fehlercode fuer Fehlerpfad Dfp_FrmMngMILEAGE_RANGE" VAL_BLK 0xC8F98 Kwb_Wu16 65535.00 OneToOne 0.00 65535.00 FORMAT "%8.2" NUMBER 4 /end CHARACTERISTIC
/begin CHARACTERISTIC DSM_CDCDfp_FrmMngOPCRCTLACC_C "CARB spezifischer Fehlercode fuer Fehlerpfad Dfp_FrmMngOPCRCTLACC" VAL_BLK 0xC8FA0 Kwb_Wu16 65535.00 OneToOne 0.00 65535.00 FORMAT "%8.2" NUMBER 4 /end CHARACTERISTIC
/begin CHARACTERISTIC DSM_CDCDfp_FrmMngPRGG_CCTR_C "CARB spezifischer Fehlercode fuer Fehlerpfad Dfp_FrmMngPRGG_CCTR" VAL_BLK 0xC8FA8 Kwb_Wu16 65535.00 OneToOne 0.00 65535.00 FORMAT "%8.2" NUMBER 4 /end CHARACTERISTIC
/begin CHARACTERISTIC DSM_CDCDfp_FrmMngPWRMNG_LOADV_C "CARB spezifischer Fehlercode fuer Fehlerpfad Dfp_FrmMngPWRMNG_LOADV" VAL_BLK 0xC8FB0 Kwb_Wu16 65535.00 OneToOne 0.00 65535.00 FORMAT "%8.2" NUMBER 4 /end CHARACTERISTIC
/begin CHARACTERISTIC DSM_CDCDfp_FrmMngParkConsumer_C "CARB spezifischer Fehlercode fuer Fehlerpfad Dfp_FrmMngParkConsumer" VAL_BLK 0xC8FB8 Kwb_Wu16 65535.00 OneToOne 0.00 65535.00 FORMAT "%8.2" NUMBER 4 /end CHARACTERISTIC
/begin CHARACTERISTIC DSM_CDCDfp_FrmMngRQSTGEFAN_C "RQ_STG_EFAN - CAN-message related errors" VAL_BLK 0xC8FC0 Kwb_Wu16 65535.00 OneToOne 0.00 65535.00 FORMAT "%8.2" NUMBER 4 /end CHARACTERISTIC
/begin CHARACTERISTIC DSM_CDCDfp_FrmMngSSGErr_C "CARB spezifischer Fehlercode fuer Fehlerpfad Dfp_FrmMngSSGErr" VAL_BLK 0xC8FC8 Kwb_Wu16 65535.00 OneToOne 0.00 65535.00 FORMAT "%8.2" NUMBER 4 /end CHARACTERISTIC
/begin CHARACTERISTIC DSM_CDCDfp_FrmMngSSGShOff_C "CARB spezifischer Fehlercode fuer Fehlerpfad Dfp_FrmMngSSGShOff" VAL_BLK 0xC8FD0 Kwb_Wu16 65535.00 OneToOne 0.00 65535.00 FORMAT "%8.2" NUMBER 4 /end CHARACTERISTIC
/begin CHARACTERISTIC DSM_CDCDfp_FrmMngSTAT_ANH_C "CARB spezifischer Fehlercode fuer Fehlerpfad Dfp_FrmMngSTAT_ANH" VAL_BLK 0xC8FD8 Kwb_Wu16 65535.00 OneToOne 0.00 65535.00 FORMAT "%8.2" NUMBER 4 /end CHARACTERISTIC
/begin CHARACTERISTIC DSM_CDCDfp_FrmMngSTAT_ARS_C "P-Code (CARB) for faults in path" VAL_BLK 0xC8FE0 Kwb_Wu16 65535.00 OneToOne 0.00 65535.00 FORMAT "%8.2" NUMBER 4 /end CHARACTERISTIC
/begin CHARACTERISTIC DSM_CDCDfp_FrmMngSTAT_DSC_C "P-Code (CARB) for faults in path" VAL_BLK 0xC8FE8 Kwb_Wu16 65535.00 OneToOne 0.00 65535.00 FORMAT "%8.2" NUMBER 4 /end CHARACTERISTIC
/begin CHARACTERISTIC DSM_CDCDfp_FrmMngSTAT_EKP_C "CARB spezifischer Fehlercode fuer Fehlerpfad Dfp_FrmMngSTAT_EKP" VAL_BLK 0xC8FF0 Kwb_Wu16 65535.00 OneToOne 0.00 65535.00 FORMAT "%8.2" NUMBER 4 /end CHARACTERISTIC
/begin CHARACTERISTIC DSM_CDCDfp_FrmMngSTAT_KOMBI_C "CARB spezifischer Fehlercode fuer Fehlerpfad Dfp_FrmMngSTAT_KOMBI" VAL_BLK 0xC8FF8 Kwb_Wu16 65535.00 OneToOne 0.00 65535.00 FORMAT "%8.2" NUMBER 4 /end CHARACTERISTIC
/begin CHARACTERISTIC DSM_CDCDfp_FrmMngSTAT_SITZ_C "CARB spezifischer Fehlercode fuer Fehlerpfad Dfp_FrmMngSTAT_SITZ" VAL_BLK 0xC9000 Kwb_Wu16 65535.00 OneToOne 0.00 65535.00 FORMAT "%8.2" NUMBER 4 /end CHARACTERISTIC
/begin CHARACTERISTIC DSM_CDCDfp_FrmMngStOBDGbxMilOf_C "CARB spezifischer Fehlercode fuer Fehlerpfad Dfp_FrmMngStOBDGbxMilOf" VAL_BLK 0xC9008 Kwb_Wu16 65535.00 OneToOne 0.00 65535.00 FORMAT "%8.2" NUMBER 4 /end CHARACTERISTIC
/begin CHARACTERISTIC DSM_CDCDfp_FrmMngStOBDGbxMilOn_C "CARB spezifischer Fehlercode fuer Fehlerpfad Dfp_FrmMngStOBDGbxMilOn" VAL_BLK 0xC9010 Kwb_Wu16 65535.00 OneToOne 0.00 65535.00 FORMAT "%8.2" NUMBER 4 /end CHARACTERISTIC
/begin CHARACTERISTIC DSM_CDCDfp_FrmMngTEMPRELTIME_C "CARB spezifischer Fehlercode fuer Fehlerpfad Dfp_FrmMngTEMPRELTIME" VAL_BLK 0xC9018 Kwb_Wu16 65535.00 OneToOne 0.00 65535.00 FORMAT "%8.2" NUMBER 4 /end CHARACTERISTIC
/begin CHARACTERISTIC DSM_CDCDfp_FrmMngTERMINAL_C "P-Code (CARB) for faults in path" VAL_BLK 0xC9020 Kwb_Wu16 65535.00 OneToOne 0.00 65535.00 FORMAT "%8.2" NUMBER 4 /end CHARACTERISTIC
/begin CHARACTERISTIC DSM_CDCDfp_FrmMngTIME_DATE_C "CARB spezifischer Fehlercode fuer Fehlerpfad Dfp_FrmMngTIME_DATE" VAL_BLK 0xC9028 Kwb_Wu16 65535.00 OneToOne 0.00 65535.00 FORMAT "%8.2" NUMBER 4 /end CHARACTERISTIC
/begin CHARACTERISTIC DSM_CDCDfp_FrmMngTORQUE_DSC_C "P-Code (CARB) for faults in path" VAL_BLK 0xC9030 Kwb_Wu16 65535.00 OneToOne 0.00 65535.00 FORMAT "%8.2" NUMBER 4 /end CHARACTERISTIC
/begin CHARACTERISTIC DSM_CDCDfp_FrmMngTORQUE_GEARBX_C "P-Code (CARB) for faults in path" VAL_BLK 0xC9038 Kwb_Wu16 65535.00 OneToOne 0.00 65535.00 FORMAT "%8.2" NUMBER 4 /end CHARACTERISTIC
/begin CHARACTERISTIC DSM_CDCDfp_FrmMngTrq_ReqACC_C "CARB spezifischer Fehlercode fuer Fehlerpfad Dfp_FrmMngTrq_ReqACC" VAL_BLK 0xC9040 Kwb_Wu16 65535.00 OneToOne 0.00 65535.00 FORMAT "%8.2" NUMBER 4 /end CHARACTERISTIC
/begin CHARACTERISTIC DSM_CDCDfp_FrmMngVEH_MOD_C "VEH_MOD - CAN-message related errors" VAL_BLK 0xC9048 Kwb_Wu16 65535.00 OneToOne 0.00 65535.00 FORMAT "%8.2" NUMBER 4 /end CHARACTERISTIC
/begin CHARACTERISTIC DSM_CDCDfp_FrmMngVELOCITY_C "P-Code (CARB) for faults in path" VAL_BLK 0xC9050 Kwb_Wu16 65535.00 OneToOne 0.00 65535.00 FORMAT "%8.2" NUMBER 4 /end CHARACTERISTIC
/begin CHARACTERISTIC DSM_CDCDfp_FrmMngWHEEL_SPEED_C "CARB spezifischer Fehlercode fuer Fehlerpfad Dfp_FrmMngWHEEL_SPEED" VAL_BLK 0xC9058 Kwb_Wu16 65535.00 OneToOne 0.00 65535.00 FORMAT "%8.2" NUMBER 4 /end CHARACTERISTIC
/begin CHARACTERISTIC DSM_CDCDfp_FrmMngstCurr_C "Fehlercode Feld für Dfp_FrmMngstCurr" VAL_BLK 0xC9060 Kwb_Wu16 65535.00 OneToOne 0.00 65535.00 FORMAT "%8.2" NUMBER 4 /end CHARACTERISTIC
/begin CHARACTERISTIC DSM_CDCDfp_FrmMngswtPSPOff_C "Fehlercode Feld für Dfp_FrmMngswtPSP" VAL_BLK 0xC9068 Kwb_Wu16 65535.00 OneToOne 0.00 65535.00 FORMAT "%8.2" NUMBER 4 /end CHARACTERISTIC
/begin CHARACTERISTIC DSM_CDCDfp_GearbxIncMax_C "CARB spezifischer Fehlercode fuer Fehlerpfad Dfp_GearbxIncMax" VAL_BLK 0xC9070 Kwb_Wu16 65535.00 OneToOne 0.00 65535.00 FORMAT "%8.2" NUMBER 4 /end CHARACTERISTIC
/begin CHARACTERISTIC DSM_CDCDfp_GlwCD_C "CARB spezifischer Fehlercode fuer Fehlerpfad Dfp_GlwCD" VAL_BLK 0xC9078 Kwb_Wu16 65535.00 OneToOne 0.00 65535.00 FORMAT "%8.2" NUMBER 4 /end CHARACTERISTIC
/begin CHARACTERISTIC DSM_CDCDfp_GlwCDGlwCirc1_C "CARB spezifischer Fehlercode fuer Fehlerpfad Dfp_GlwCDGlwCirc1" VAL_BLK 0xC9080 Kwb_Wu16 65535.00 OneToOne 0.00 65535.00 FORMAT "%8.2" NUMBER 4 /end CHARACTERISTIC
/begin CHARACTERISTIC DSM_CDCDfp_GlwCDGlwCirc2_C "CARB spezifischer Fehlercode fuer Fehlerpfad Dfp_GlwCDGlwCirc2" VAL_BLK 0xC9088 Kwb_Wu16 65535.00 OneToOne 0.00 65535.00 FORMAT "%8.2" NUMBER 4 /end CHARACTERISTIC
/begin CHARACTERISTIC DSM_CDCDfp_GlwCDGlwCirc3_C "CARB spezifischer Fehlercode fuer Fehlerpfad Dfp_GlwCDGlwCirc3" VAL_BLK 0xC9090 Kwb_Wu16 65535.00 OneToOne 0.00 65535.00 FORMAT "%8.2" NUMBER 4 /end CHARACTERISTIC
/begin CHARACTERISTIC DSM_CDCDfp_GlwCDGlwCirc4_C "CARB spezifischer Fehlercode fuer Fehlerpfad Dfp_GlwCDGlwCirc4" VAL_BLK 0xC9098 Kwb_Wu16 65535.00 OneToOne 0.00 65535.00 FORMAT "%8.2" NUMBER 4 /end CHARACTERISTIC
/begin CHARACTERISTIC DSM_CDCDfp_GlwCDGlwCirc5_C "CARB spezifischer Fehlercode fuer Fehlerpfad Dfp_GlwCDGlwCirc5" VAL_BLK 0xC90A0 Kwb_Wu16 65535.00 OneToOne 0.00 65535.00 FORMAT "%8.2" NUMBER 4 /end CHARACTERISTIC
/begin CHARACTERISTIC DSM_CDCDfp_GlwCDGlwCirc6_C "CARB spezifischer Fehlercode fuer Fehlerpfad Dfp_GlwCDGlwCirc6" VAL_BLK 0xC90A8 Kwb_Wu16 65535.00 OneToOne 0.00 65535.00 FORMAT "%8.2" NUMBER 4 /end CHARACTERISTIC
/begin CHARACTERISTIC DSM_CDCDfp_GlwCDGlwCirc7_C "CARB spezifischer Fehlercode fuer Fehlerpfad Dfp_GlwCDGlwCirc7" VAL_BLK 0xC90B0 Kwb_Wu16 65535.00 OneToOne 0.00 65535.00 FORMAT "%8.2" NUMBER 4 /end CHARACTERISTIC
/begin CHARACTERISTIC DSM_CDCDfp_GlwCDGlwCirc8_C "CARB spezifischer Fehlercode fuer Fehlerpfad Dfp_GlwCDGlwCirc8" VAL_BLK 0xC90B8 Kwb_Wu16 65535.00 OneToOne 0.00 65535.00 FORMAT "%8.2" NUMBER 4 /end CHARACTERISTIC
/begin CHARACTERISTIC DSM_CDCDfp_GlwCtl_C "CARB spezifischer Fehlercode fuer Fehlerpfad Dfp_GlwCtl" VAL_BLK 0xC90C0 Kwb_Wu16 65535.00 OneToOne 0.00 65535.00 FORMAT "%8.2" NUMBER 4 /end CHARACTERISTIC
/begin CHARACTERISTIC DSM_CDCDfp_HWEMonCom_C "CARB spezifischer Fehlercode fuer Fehlerpfad Dfp_HWEMonCom" VAL_BLK 0xC90C8 Kwb_Wu16 65535.00 OneToOne 0.00 65535.00 FORMAT "%8.2" NUMBER 4 /end CHARACTERISTIC
/begin CHARACTERISTIC DSM_CDCDfp_HWEMonEEPROM_C "CARB spezifischer Fehlercode fuer Fehlerpfad Dfp_HWEMonEEPROM" VAL_BLK 0xC90D0 Kwb_Wu16 65535.00 OneToOne 0.00 65535.00 FORMAT "%8.2" NUMBER 4 /end CHARACTERISTIC
/begin CHARACTERISTIC DSM_CDCDfp_HWEMonRcyLocked_C "CARB spezifischer Fehlercode fuer Fehlerpfad Dfp_HWEMonRcyLocked" VAL_BLK 0xC90D8 Kwb_Wu16 65535.00 OneToOne 0.00 65535.00 FORMAT "%8.2" NUMBER 4 /end CHARACTERISTIC
/begin CHARACTERISTIC DSM_CDCDfp_HWEMonRcySuppressed_C "CARB spezifischer Fehlercode fuer Fehlerpfad Dfp_HWEMonRcySuppressed" VAL_BLK 0xC90E0 Kwb_Wu16 65535.00 OneToOne 0.00 65535.00 FORMAT "%8.2" NUMBER 4 /end CHARACTERISTIC
/begin CHARACTERISTIC DSM_CDCDfp_HWEMonRcyVisible_C "CARB spezifischer Fehlercode fuer Fehlerpfad Dfp_HWEMonRcyVisible" VAL_BLK 0xC90E8 Kwb_Wu16 65535.00 OneToOne 0.00 65535.00 FORMAT "%8.2" NUMBER 4 /end CHARACTERISTIC
/begin CHARACTERISTIC DSM_CDCDfp_HWEMonUMaxSupply_C "CARB spezifischer Fehlercode fuer Fehlerpfad Dfp_HWEMonUMaxSupply" VAL_BLK 0xC90F0 Kwb_Wu16 65535.00 OneToOne 0.00 65535.00 FORMAT "%8.2" NUMBER 4 /end CHARACTERISTIC
/begin CHARACTERISTIC DSM_CDCDfp_HWEMonUMinSupply_C "CARB spezifischer Fehlercode fuer Fehlerpfad Dfp_HWEMonUMinSupply" VAL_BLK 0xC90F8 Kwb_Wu16 65535.00 OneToOne 0.00 65535.00 FORMAT "%8.2" NUMBER 4 /end CHARACTERISTIC
/begin CHARACTERISTIC DSM_CDCDfp_IATSCD_C "CARB spezifischer Fehlercode fuer Fehlerpfad Dfp_IATSCD" VAL_BLK 0xC9100 Kwb_Wu16 65535.00 OneToOne 0.00 65535.00 FORMAT "%8.2" NUMBER 4 /end CHARACTERISTIC
/begin CHARACTERISTIC DSM_CDCDfp_IATSCD_CATS_C "CARB spezifischer Fehlercode fuer Fehlerpfad Dfp_IATSCD_CATS" VAL_BLK 0xC9108 Kwb_Wu16 65535.00 OneToOne 0.00 65535.00 FORMAT "%8.2" NUMBER 4 /end CHARACTERISTIC
/begin CHARACTERISTIC DSM_CDCDfp_ImmCtlImmCD_C "CARB spezifischer Fehlercode fuer Fehlerpfad Dfp_ImmCtlImmCD" VAL_BLK 0xC9110 Kwb_Wu16 65535.00 OneToOne 0.00 65535.00 FORMAT "%8.2" NUMBER 4 /end CHARACTERISTIC
/begin CHARACTERISTIC DSM_CDCDfp_ImmCtlImmEep_C "CARB spezifischer Fehlercode fuer Fehlerpfad Dfp_ImmCtlImmEep" VAL_BLK 0xC9118 Kwb_Wu16 65535.00 OneToOne 0.00 65535.00 FORMAT "%8.2" NUMBER 4 /end CHARACTERISTIC
/begin CHARACTERISTIC DSM_CDCDfp_ImmCtlMpl_C "CARB spezifischer Fehlercode fuer Fehlerpfad Dfp_ImmCtlMpl" VAL_BLK 0xC9120 Kwb_Wu16 65535.00 OneToOne 0.00 65535.00 FORMAT "%8.2" NUMBER 4 /end CHARACTERISTIC
/begin CHARACTERISTIC DSM_CDCDfp_IndSys1_C "CARB spezifischer Fehlercode fuer Fehlerpfad Dfp_IndSys1" VAL_BLK 0xC9128 Kwb_Wu16 65535.00 OneToOne 0.00 65535.00 FORMAT "%8.2" NUMBER 4 /end CHARACTERISTIC
/begin CHARACTERISTIC DSM_CDCDfp_IndSys2_C "CARB spezifischer Fehlercode fuer Fehlerpfad Dfp_IndSys2" VAL_BLK 0xC9130 Kwb_Wu16 65535.00 OneToOne 0.00 65535.00 FORMAT "%8.2" NUMBER 4 /end CHARACTERISTIC
/begin CHARACTERISTIC DSM_CDCDfp_InjCrv_InjLim_C "CARB spezifischer Fehlercode fuer Fehlerpfad Dfp_InjCrv_InjLim" VAL_BLK 0xC9138 Kwb_Wu16 65535.00 OneToOne 0.00 65535.00 FORMAT "%8.2" NUMBER 4 /end CHARACTERISTIC
/begin CHARACTERISTIC DSM_CDCDfp_InjCtlAdjQnt_C "CARB spezifischer Fehlercode fuer Fehlerpfad Dfp_InjCtlAdjQnt" VAL_BLK 0xC9140 Kwb_Wu16 65535.00 OneToOne 0.00 65535.00 FORMAT "%8.2" NUMBER 4 /end CHARACTERISTIC
/begin CHARACTERISTIC DSM_CDCDfp_InjCtlDrift_C "CARB spezifischer Fehlercode fuer Fehlerpfad Dfp_InjCtlDrift" VAL_BLK 0xC9148 Kwb_Wu16 65535.00 OneToOne 0.00 65535.00 FORMAT "%8.2" NUMBER 4 /end CHARACTERISTIC
/begin CHARACTERISTIC DSM_CDCDfp_InjVCDActrChrg_C "CARB spezifischer Fehlercode fuer Fehlerpfad Dfp_InjVCDActrChrg" VAL_BLK 0xC9150 Kwb_Wu16 65535.00 OneToOne 0.00 65535.00 FORMAT "%8.2" NUMBER 4 /end CHARACTERISTIC
/begin CHARACTERISTIC DSM_CDCDfp_InjVCDActrEnrg1_C "CARB spezifischer Fehlercode fuer Fehlerpfad Dfp_InjVCDActrEnrg1" VAL_BLK 0xC9158 Kwb_Wu16 65535.00 OneToOne 0.00 65535.00 FORMAT "%8.2" NUMBER 4 /end CHARACTERISTIC
/begin CHARACTERISTIC DSM_CDCDfp_InjVCDActrEnrg2_C "CARB spezifischer Fehlercode fuer Fehlerpfad Dfp_InjVCDActrEnrg2" VAL_BLK 0xC9160 Kwb_Wu16 65535.00 OneToOne 0.00 65535.00 FORMAT "%8.2" NUMBER 4 /end CHARACTERISTIC
/begin CHARACTERISTIC DSM_CDCDfp_InjVCDActrEnrg3_C "CARB spezifischer Fehlercode fuer Fehlerpfad Dfp_InjVCDActrEnrg3" VAL_BLK 0xC9168 Kwb_Wu16 65535.00 OneToOne 0.00 65535.00 FORMAT "%8.2" NUMBER 4 /end CHARACTERISTIC
/begin CHARACTERISTIC DSM_CDCDfp_InjVCDActrEnrg4_C "CARB spezifischer Fehlercode fuer Fehlerpfad Dfp_InjVCDActrEnrg4" VAL_BLK 0xC9170 Kwb_Wu16 65535.00 OneToOne 0.00 65535.00 FORMAT "%8.2" NUMBER 4 /end CHARACTERISTIC
/begin CHARACTERISTIC DSM_CDCDfp_InjVCDActrEnrg5_C "CARB spezifischer Fehlercode fuer Fehlerpfad Dfp_InjVCDActrEnrg5" VAL_BLK 0xC9178 Kwb_Wu16 65535.00 OneToOne 0.00 65535.00 FORMAT "%8.2" NUMBER 4 /end CHARACTERISTIC
/begin CHARACTERISTIC DSM_CDCDfp_InjVCDActrEnrg6_C "CARB spezifischer Fehlercode fuer Fehlerpfad Dfp_InjVCDActrEnrg6" VAL_BLK 0xC9180 Kwb_Wu16 65535.00 OneToOne 0.00 65535.00 FORMAT "%8.2" NUMBER 4 /end CHARACTERISTIC
/begin CHARACTERISTIC DSM_CDCDfp_InjVCDActrEnrg7_C "CARB spezifischer Fehlercode fuer Fehlerpfad Dfp_InjVCDActrEnrg7" VAL_BLK 0xC9188 Kwb_Wu16 65535.00 OneToOne 0.00 65535.00 FORMAT "%8.2" NUMBER 4 /end CHARACTERISTIC
/begin CHARACTERISTIC DSM_CDCDfp_InjVCDActrEnrg8_C "CARB spezifischer Fehlercode fuer Fehlerpfad Dfp_InjVCDActrEnrg8" VAL_BLK 0xC9190 Kwb_Wu16 65535.00 OneToOne 0.00 65535.00 FORMAT "%8.2" NUMBER 4 /end CHARACTERISTIC
/begin CHARACTERISTIC DSM_CDCDfp_InjVCDActrVolt_C "CARB spezifischer Fehlercode fuer Fehlerpfad Dfp_InjVCDActrVolt" VAL_BLK 0xC9198 Kwb_Wu16 65535.00 OneToOne 0.00 65535.00 FORMAT "%8.2" NUMBER 4 /end CHARACTERISTIC
/begin CHARACTERISTIC DSM_CDCDfp_InjVCDClsBank1_C "CARB spezifischer Fehlercode fuer Fehlerpfad Dfp_InjVCDClsBank1" VAL_BLK 0xC91A0 Kwb_Wu16 65535.00 OneToOne 0.00 65535.00 FORMAT "%8.2" NUMBER 4 /end CHARACTERISTIC
/begin CHARACTERISTIC DSM_CDCDfp_InjVCDClsBank2_C "CARB spezifischer Fehlercode fuer Fehlerpfad Dfp_InjVCDClsBank2" VAL_BLK 0xC91A8 Kwb_Wu16 65535.00 OneToOne 0.00 65535.00 FORMAT "%8.2" NUMBER 4 /end CHARACTERISTIC
/begin CHARACTERISTIC DSM_CDCDfp_InjVCDMonCab_C "CARB spezifischer Fehlercode fuer Fehlerpfad Dfp_InjVCDMonCab" VAL_BLK 0xC91B0 Kwb_Wu16 65535.00 OneToOne 0.00 65535.00 FORMAT "%8.2" NUMBER 4 /end CHARACTERISTIC
/begin CHARACTERISTIC DSM_CDCDfp_InjVCDMonSwt_C "CARB spezifischer Fehlercode fuer Fehlerpfad Dfp_InjVCDMonSwt" VAL_BLK 0xC91B8 Kwb_Wu16 65535.00 OneToOne 0.00 65535.00 FORMAT "%8.2" NUMBER 4 /end CHARACTERISTIC
/begin CHARACTERISTIC DSM_CDCDfp_InjVCDShOffDCDC_C "CARB spezifischer Fehlercode fuer Fehlerpfad Dfp_InjVCDShOffDCDC" VAL_BLK 0xC91C0 Kwb_Wu16 65535.00 OneToOne 0.00 65535.00 FORMAT "%8.2" NUMBER 4 /end CHARACTERISTIC
/begin CHARACTERISTIC DSM_CDCDfp_InjVCDUBuf_C "CARB spezifischer Fehlercode fuer Fehlerpfad Dfp_InjVCDUBuf" VAL_BLK 0xC91C8 Kwb_Wu16 65535.00 OneToOne 0.00 65535.00 FORMAT "%8.2" NUMBER 4 /end CHARACTERISTIC
/begin CHARACTERISTIC DSM_CDCDfp_InjVCD_CY370Ampl_C "CARB spezifischer Fehlercode fuer Fehlerpfad Dfp_InjVCD_CY370Ampl" VAL_BLK 0xC91D0 Kwb_Wu16 65535.00 OneToOne 0.00 65535.00 FORMAT "%8.2" NUMBER 4 /end CHARACTERISTIC
/begin CHARACTERISTIC DSM_CDCDfp_InjVlvBnk1A_C "CARB spezifischer Fehlercode fuer Fehlerpfad Dfp_InjVlvBnk1A" VAL_BLK 0xC91D8 Kwb_Wu16 65535.00 OneToOne 0.00 65535.00 FORMAT "%8.2" NUMBER 4 /end CHARACTERISTIC
/begin CHARACTERISTIC DSM_CDCDfp_InjVlvBnk1B_C "CARB spezifischer Fehlercode fuer Fehlerpfad Dfp_InjVlvBnk1B" VAL_BLK 0xC91E0 Kwb_Wu16 65535.00 OneToOne 0.00 65535.00 FORMAT "%8.2" NUMBER 4 /end CHARACTERISTIC
/begin CHARACTERISTIC DSM_CDCDfp_InjVlvBnk2A_C "CARB spezifischer Fehlercode fuer Fehlerpfad Dfp_InjVlvBnk2A" VAL_BLK 0xC91E8 Kwb_Wu16 65535.00 OneToOne 0.00 65535.00 FORMAT "%8.2" NUMBER 4 /end CHARACTERISTIC
/begin CHARACTERISTIC DSM_CDCDfp_InjVlvBnk2B_C "CARB spezifischer Fehlercode fuer Fehlerpfad Dfp_InjVlvBnk2B" VAL_BLK 0xC91F0 Kwb_Wu16 65535.00 OneToOne 0.00 65535.00 FORMAT "%8.2" NUMBER 4 /end CHARACTERISTIC
/begin CHARACTERISTIC DSM_CDCDfp_InjVlvChipA_C "CARB spezifischer Fehlercode fuer Fehlerpfad Dfp_InjVlvChipA" VAL_BLK 0xC91F8 Kwb_Wu16 65535.00 OneToOne 0.00 65535.00 FORMAT "%8.2" NUMBER 4 /end CHARACTERISTIC
/begin CHARACTERISTIC DSM_CDCDfp_InjVlvChipB_C "CARB spezifischer Fehlercode fuer Fehlerpfad Dfp_InjVlvChipB" VAL_BLK 0xC9200 Kwb_Wu16 65535.00 OneToOne 0.00 65535.00 FORMAT "%8.2" NUMBER 4 /end CHARACTERISTIC
/begin CHARACTERISTIC DSM_CDCDfp_InjVlvCyl1A_C "CARB spezifischer Fehlercode fuer Fehlerpfad Dfp_InjVlvCyl1A" VAL_BLK 0xC9208 Kwb_Wu16 65535.00 OneToOne 0.00 65535.00 FORMAT "%8.2" NUMBER 4 /end CHARACTERISTIC
/begin CHARACTERISTIC DSM_CDCDfp_InjVlvCyl1B_C "CARB spezifischer Fehlercode fuer Fehlerpfad Dfp_InjVlvCyl1B" VAL_BLK 0xC9210 Kwb_Wu16 65535.00 OneToOne 0.00 65535.00 FORMAT "%8.2" NUMBER 4 /end CHARACTERISTIC
/begin CHARACTERISTIC DSM_CDCDfp_InjVlvCyl1C_C "CARB spezifischer Fehlercode fuer Fehlerpfad Dfp_InjVlvCyl1C" VAL_BLK 0xC9218 Kwb_Wu16 65535.00 OneToOne 0.00 65535.00 FORMAT "%8.2" NUMBER 4 /end CHARACTERISTIC
/begin CHARACTERISTIC DSM_CDCDfp_InjVlvCyl2A_C "CARB spezifischer Fehlercode fuer Fehlerpfad Dfp_InjVlvCyl2A" VAL_BLK 0xC9220 Kwb_Wu16 65535.00 OneToOne 0.00 65535.00 FORMAT "%8.2" NUMBER 4 /end CHARACTERISTIC
/begin CHARACTERISTIC DSM_CDCDfp_InjVlvCyl2B_C "CARB spezifischer Fehlercode fuer Fehlerpfad Dfp_InjVlvCyl2B" VAL_BLK 0xC9228 Kwb_Wu16 65535.00 OneToOne 0.00 65535.00 FORMAT "%8.2" NUMBER 4 /end CHARACTERISTIC
/begin CHARACTERISTIC DSM_CDCDfp_InjVlvCyl2C_C "CARB spezifischer Fehlercode fuer Fehlerpfad Dfp_InjVlvCyl2C" VAL_BLK 0xC9230 Kwb_Wu16 65535.00 OneToOne 0.00 65535.00 FORMAT "%8.2" NUMBER 4 /end CHARACTERISTIC
/begin CHARACTERISTIC DSM_CDCDfp_InjVlvCyl3A_C "CARB spezifischer Fehlercode fuer Fehlerpfad Dfp_InjVlvCyl3A" VAL_BLK 0xC9238 Kwb_Wu16 65535.00 OneToOne 0.00 65535.00 FORMAT "%8.2" NUMBER 4 /end CHARACTERISTIC
/begin CHARACTERISTIC DSM_CDCDfp_InjVlvCyl3B_C "CARB spezifischer Fehlercode fuer Fehlerpfad Dfp_InjVlvCyl3B" VAL_BLK 0xC9240 Kwb_Wu16 65535.00 OneToOne 0.00 65535.00 FORMAT "%8.2" NUMBER 4 /end CHARACTERISTIC
/begin CHARACTERISTIC DSM_CDCDfp_InjVlvCyl3C_C "CARB spezifischer Fehlercode fuer Fehlerpfad Dfp_InjVlvCyl3C" VAL_BLK 0xC9248 Kwb_Wu16 65535.00 OneToOne 0.00 65535.00 FORMAT "%8.2" NUMBER 4 /end CHARACTERISTIC
/begin CHARACTERISTIC DSM_CDCDfp_InjVlvCyl4A_C "CARB spezifischer Fehlercode fuer Fehlerpfad Dfp_InjVlvCyl4A" VAL_BLK 0xC9250 Kwb_Wu16 65535.00 OneToOne 0.00 65535.00 FORMAT "%8.2" NUMBER 4 /end CHARACTERISTIC
/begin CHARACTERISTIC DSM_CDCDfp_InjVlvCyl4B_C "CARB spezifischer Fehlercode fuer Fehlerpfad Dfp_InjVlvCyl4B" VAL_BLK 0xC9258 Kwb_Wu16 65535.00 OneToOne 0.00 65535.00 FORMAT "%8.2" NUMBER 4 /end CHARACTERISTIC
/begin CHARACTERISTIC DSM_CDCDfp_InjVlvCyl4C_C "CARB spezifischer Fehlercode fuer Fehlerpfad Dfp_InjVlvCyl4C" VAL_BLK 0xC9260 Kwb_Wu16 65535.00 OneToOne 0.00 65535.00 FORMAT "%8.2" NUMBER 4 /end CHARACTERISTIC
/begin CHARACTERISTIC DSM_CDCDfp_InjVlvCyl5A_C "CARB spezifischer Fehlercode fuer Fehlerpfad Dfp_InjVlvCyl5A" VAL_BLK 0xC9268 Kwb_Wu16 65535.00 OneToOne 0.00 65535.00 FORMAT "%8.2" NUMBER 4 /end CHARACTERISTIC
/begin CHARACTERISTIC DSM_CDCDfp_InjVlvCyl5B_C "CARB spezifischer Fehlercode fuer Fehlerpfad Dfp_InjVlvCyl5B" VAL_BLK 0xC9270 Kwb_Wu16 65535.00 OneToOne 0.00 65535.00 FORMAT "%8.2" NUMBER 4 /end CHARACTERISTIC
/begin CHARACTERISTIC DSM_CDCDfp_InjVlvCyl5C_C "CARB spezifischer Fehlercode fuer Fehlerpfad Dfp_InjVlvCyl5C" VAL_BLK 0xC9278 Kwb_Wu16 65535.00 OneToOne 0.00 65535.00 FORMAT "%8.2" NUMBER 4 /end CHARACTERISTIC
/begin CHARACTERISTIC DSM_CDCDfp_InjVlvCyl6A_C "CARB spezifischer Fehlercode fuer Fehlerpfad Dfp_InjVlvCyl6A" VAL_BLK 0xC9280 Kwb_Wu16 65535.00 OneToOne 0.00 65535.00 FORMAT "%8.2" NUMBER 4 /end CHARACTERISTIC
/begin CHARACTERISTIC DSM_CDCDfp_InjVlvCyl6B_C "CARB spezifischer Fehlercode fuer Fehlerpfad Dfp_InjVlvCyl6B" VAL_BLK 0xC9288 Kwb_Wu16 65535.00 OneToOne 0.00 65535.00 FORMAT "%8.2" NUMBER 4 /end CHARACTERISTIC
/begin CHARACTERISTIC DSM_CDCDfp_InjVlvCyl6C_C "CARB spezifischer Fehlercode fuer Fehlerpfad Dfp_InjVlvCyl6C" VAL_BLK 0xC9290 Kwb_Wu16 65535.00 OneToOne 0.00 65535.00 FORMAT "%8.2" NUMBER 4 /end CHARACTERISTIC
/begin CHARACTERISTIC DSM_CDCDfp_InjVlvCyl7A_C "CARB spezifischer Fehlercode fuer Fehlerpfad Dfp_InjVlvCyl7A" VAL_BLK 0xC9298 Kwb_Wu16 65535.00 OneToOne 0.00 65535.00 FORMAT "%8.2" NUMBER 4 /end CHARACTERISTIC
/begin CHARACTERISTIC DSM_CDCDfp_InjVlvCyl7B_C "CARB spezifischer Fehlercode fuer Fehlerpfad Dfp_InjVlvCyl7B" VAL_BLK 0xC92A0 Kwb_Wu16 65535.00 OneToOne 0.00 65535.00 FORMAT "%8.2" NUMBER 4 /end CHARACTERISTIC
/begin CHARACTERISTIC DSM_CDCDfp_InjVlvCyl7C_C "CARB spezifischer Fehlercode fuer Fehlerpfad Dfp_InjVlvCyl7C" VAL_BLK 0xC92A8 Kwb_Wu16 65535.00 OneToOne 0.00 65535.00 FORMAT "%8.2" NUMBER 4 /end CHARACTERISTIC
/begin CHARACTERISTIC DSM_CDCDfp_InjVlvCyl8A_C "CARB spezifischer Fehlercode fuer Fehlerpfad Dfp_InjVlvCyl8A" VAL_BLK 0xC92B0 Kwb_Wu16 65535.00 OneToOne 0.00 65535.00 FORMAT "%8.2" NUMBER 4 /end CHARACTERISTIC
/begin CHARACTERISTIC DSM_CDCDfp_InjVlvCyl8B_C "CARB spezifischer Fehlercode fuer Fehlerpfad Dfp_InjVlvCyl8B" VAL_BLK 0xC92B8 Kwb_Wu16 65535.00 OneToOne 0.00 65535.00 FORMAT "%8.2" NUMBER 4 /end CHARACTERISTIC
/begin CHARACTERISTIC DSM_CDCDfp_InjVlvCyl8C_C "CARB spezifischer Fehlercode fuer Fehlerpfad Dfp_InjVlvCyl8C" VAL_BLK 0xC92C0 Kwb_Wu16 65535.00 OneToOne 0.00 65535.00 FORMAT "%8.2" NUMBER 4 /end CHARACTERISTIC
/begin CHARACTERISTIC DSM_CDCDfp_InjVlvNVC1_C "CARB spezifischer Fehlercode fuer Fehlerpfad Dfp_InjVlvNVC1" VAL_BLK 0xC92C8 Kwb_Wu16 65535.00 OneToOne 0.00 65535.00 FORMAT "%8.2" NUMBER 4 /end CHARACTERISTIC
/begin CHARACTERISTIC DSM_CDCDfp_InjVlvNVC2_C "CARB spezifischer Fehlercode fuer Fehlerpfad Dfp_InjVlvNVC2" VAL_BLK 0xC92D0 Kwb_Wu16 65535.00 OneToOne 0.00 65535.00 FORMAT "%8.2" NUMBER 4 /end CHARACTERISTIC
/begin CHARACTERISTIC DSM_CDCDfp_InjVlvNVC3_C "CARB spezifischer Fehlercode fuer Fehlerpfad Dfp_InjVlvNVC3" VAL_BLK 0xC92D8 Kwb_Wu16 65535.00 OneToOne 0.00 65535.00 FORMAT "%8.2" NUMBER 4 /end CHARACTERISTIC
/begin CHARACTERISTIC DSM_CDCDfp_InjVlvNVC4_C "CARB spezifischer Fehlercode fuer Fehlerpfad Dfp_InjVlvNVC4" VAL_BLK 0xC92E0 Kwb_Wu16 65535.00 OneToOne 0.00 65535.00 FORMAT "%8.2" NUMBER 4 /end CHARACTERISTIC
/begin CHARACTERISTIC DSM_CDCDfp_InjVlvNVC5_C "CARB spezifischer Fehlercode fuer Fehlerpfad Dfp_InjVlvNVC5" VAL_BLK 0xC92E8 Kwb_Wu16 65535.00 OneToOne 0.00 65535.00 FORMAT "%8.2" NUMBER 4 /end CHARACTERISTIC
/begin CHARACTERISTIC DSM_CDCDfp_InjVlvNVC6_C "CARB spezifischer Fehlercode fuer Fehlerpfad Dfp_InjVlvNVC6" VAL_BLK 0xC92F0 Kwb_Wu16 65535.00 OneToOne 0.00 65535.00 FORMAT "%8.2" NUMBER 4 /end CHARACTERISTIC
/begin CHARACTERISTIC DSM_CDCDfp_InjVlvNVC7_C "CARB spezifischer Fehlercode fuer Fehlerpfad Dfp_InjVlvNVC7" VAL_BLK 0xC92F8 Kwb_Wu16 65535.00 OneToOne 0.00 65535.00 FORMAT "%8.2" NUMBER 4 /end CHARACTERISTIC
/begin CHARACTERISTIC DSM_CDCDfp_InjVlvNVC8_C "CARB spezifischer Fehlercode fuer Fehlerpfad Dfp_InjVlvNVC8" VAL_BLK 0xC9300 Kwb_Wu16 65535.00 OneToOne 0.00 65535.00 FORMAT "%8.2" NUMBER 4 /end CHARACTERISTIC
/begin CHARACTERISTIC DSM_CDCDfp_LPACD_Max_C "CARB spezifischer Fehlercode fuer Fehlerpfad Dfp_LPACD_Max" VAL_BLK 0xC9308 Kwb_Wu16 65535.00 OneToOne 0.00 65535.00 FORMAT "%8.2" NUMBER 4 /end CHARACTERISTIC
/begin CHARACTERISTIC DSM_CDCDfp_LPACD_Min_C "CARB spezifischer Fehlercode fuer Fehlerpfad Dfp_LPACD_Min" VAL_BLK 0xC9310 Kwb_Wu16 65535.00 OneToOne 0.00 65535.00 FORMAT "%8.2" NUMBER 4 /end CHARACTERISTIC
/begin CHARACTERISTIC DSM_CDCDfp_LPACD_SigNpl_C "CARB spezifischer Fehlercode fuer Fehlerpfad Dfp_LPACD_SigNpl" VAL_BLK 0xC9318 Kwb_Wu16 65535.00 OneToOne 0.00 65535.00 FORMAT "%8.2" NUMBER 4 /end CHARACTERISTIC
/begin CHARACTERISTIC DSM_CDCDfp_LSUCDCircNernst0_C "CARB spezifischer Fehlercode fuer Fehlerpfad Dfp_LSUCDCircNernst0" VAL_BLK 0xC9320 Kwb_Wu16 65535.00 OneToOne 0.00 65535.00 FORMAT "%8.2" NUMBER 4 /end CHARACTERISTIC
/begin CHARACTERISTIC DSM_CDCDfp_LSUCDCircPumpCur0_C "CARB spezifischer Fehlercode fuer Fehlerpfad Dfp_LSUCDCircPumpCur0" VAL_BLK 0xC9328 Kwb_Wu16 65535.00 OneToOne 0.00 65535.00 FORMAT "%8.2" NUMBER 4 /end CHARACTERISTIC
/begin CHARACTERISTIC DSM_CDCDfp_LSUCDCircVirtGnd0_C "CARB spezifischer Fehlercode fuer Fehlerpfad Dfp_LSUCDCircVirtGnd0" VAL_BLK 0xC9330 Kwb_Wu16 65535.00 OneToOne 0.00 65535.00 FORMAT "%8.2" NUMBER 4 /end CHARACTERISTIC
/begin CHARACTERISTIC DSM_CDCDfp_LSUCDHeater0_C "CARB spezifischer Fehlercode fuer Fehlerpfad Dfp_LSUCDHeater0" VAL_BLK 0xC9338 Kwb_Wu16 65535.00 OneToOne 0.00 65535.00 FORMAT "%8.2" NUMBER 4 /end CHARACTERISTIC
/begin CHARACTERISTIC DSM_CDCDfp_LSUCDHtCoup0_C "CARB spezifischer Fehlercode fuer Fehlerpfad Dfp_LSUCDHtCoup0" VAL_BLK 0xC9340 Kwb_Wu16 65535.00 OneToOne 0.00 65535.00 FORMAT "%8.2" NUMBER 4 /end CHARACTERISTIC
/begin CHARACTERISTIC DSM_CDCDfp_LSUCDO20_C "CARB spezifischer Fehlercode fuer Fehlerpfad Dfp_LSUCDO20" VAL_BLK 0xC9348 Kwb_Wu16 65535.00 OneToOne 0.00 65535.00 FORMAT "%8.2" NUMBER 4 /end CHARACTERISTIC
/begin CHARACTERISTIC DSM_CDCDfp_LSUCDO2Clb0_C "CARB spezifischer Fehlercode fuer Fehlerpfad Dfp_LSUCDO2Clb0" VAL_BLK 0xC9350 Kwb_Wu16 65535.00 OneToOne 0.00 65535.00 FORMAT "%8.2" NUMBER 4 /end CHARACTERISTIC
/begin CHARACTERISTIC DSM_CDCDfp_LSUCDRiClb0_C "CARB spezifischer Fehlercode fuer Fehlerpfad Dfp_LSUCDRiClb0" VAL_BLK 0xC9358 Kwb_Wu16 65535.00 OneToOne 0.00 65535.00 FORMAT "%8.2" NUMBER 4 /end CHARACTERISTIC
/begin CHARACTERISTIC DSM_CDCDfp_LSUCDSPI0_C "CARB spezifischer Fehlercode fuer Fehlerpfad Dfp_LSUCDSPI0" VAL_BLK 0xC9360 Kwb_Wu16 65535.00 OneToOne 0.00 65535.00 FORMAT "%8.2" NUMBER 4 /end CHARACTERISTIC
/begin CHARACTERISTIC DSM_CDCDfp_LSUCDSPIBattLow0_C "CARB spezifischer Fehlercode fuer Fehlerpfad Dfp_LSUCDSPIBattLow0" VAL_BLK 0xC9368 Kwb_Wu16 65535.00 OneToOne 0.00 65535.00 FORMAT "%8.2" NUMBER 4 /end CHARACTERISTIC
/begin CHARACTERISTIC DSM_CDCDfp_LSUCDWireIP0_C "CARB spezifischer Fehlercode fuer Fehlerpfad Dfp_LSUCDWireIP0" VAL_BLK 0xC9370 Kwb_Wu16 65535.00 OneToOne 0.00 65535.00 FORMAT "%8.2" NUMBER 4 /end CHARACTERISTIC
/begin CHARACTERISTIC DSM_CDCDfp_LSUCtlRiExc0_C "CARB spezifischer Fehlercode fuer Fehlerpfad Dfp_LSUCtlRiExc0" VAL_BLK 0xC9378 Kwb_Wu16 65535.00 OneToOne 0.00 65535.00 FORMAT "%8.2" NUMBER 4 /end CHARACTERISTIC
/begin CHARACTERISTIC DSM_CDCDfp_LSUMon1Sens_C "CARB spezifischer Fehlercode fuer Fehlerpfad Dfp_LSUMon1Sens" VAL_BLK 0xC9380 Kwb_Wu16 65535.00 OneToOne 0.00 65535.00 FORMAT "%8.2" NUMBER 4 /end CHARACTERISTIC
/begin CHARACTERISTIC DSM_CDCDfp_LSUMon2Sens_C "CARB spezifischer Fehlercode fuer Fehlerpfad Dfp_LSUMon2Sens" VAL_BLK 0xC9388 Kwb_Wu16 65535.00 OneToOne 0.00 65535.00 FORMAT "%8.2" NUMBER 4 /end CHARACTERISTIC
/begin CHARACTERISTIC DSM_CDCDfp_LubCD_C "CARB spezifischer Fehlercode fuer Fehlerpfad Dfp_LubCD" VAL_BLK 0xC9390 Kwb_Wu16 65535.00 OneToOne 0.00 65535.00 FORMAT "%8.2" NUMBER 4 /end CHARACTERISTIC
/begin CHARACTERISTIC DSM_CDCDfp_MIL_C "CARB spezifischer Fehlercode fuer Fehlerpfad Dfp_MIL" VAL_BLK 0xC9398 Kwb_Wu16 65535.00 OneToOne 0.00 65535.00 FORMAT "%8.2" NUMBER 4 /end CHARACTERISTIC
/begin CHARACTERISTIC DSM_CDCDfp_MRlyCD_C "CARB spezifischer Fehlercode fuer Fehlerpfad Dfp_MRlyCD" VAL_BLK 0xC93A0 Kwb_Wu16 65535.00 OneToOne 0.00 65535.00 FORMAT "%8.2" NUMBER 4 /end CHARACTERISTIC
/begin CHARACTERISTIC DSM_CDCDfp_MSidCD_Comm_C "CARB spezifischer Fehlercode fuer Fehlerpfad Dfp_MSidCD_Comm" VAL_BLK 0xC93A8 Kwb_Wu16 65535.00 OneToOne 0.00 65535.00 FORMAT "%8.2" NUMBER 4 /end CHARACTERISTIC
/begin CHARACTERISTIC DSM_CDCDfp_MSidCD_Pin_C "CARB spezifischer Fehlercode fuer Fehlerpfad Dfp_MSidCD_Pin" VAL_BLK 0xC93B0 Kwb_Wu16 65535.00 OneToOne 0.00 65535.00 FORMAT "%8.2" NUMBER 4 /end CHARACTERISTIC
/begin CHARACTERISTIC DSM_CDCDfp_MSidCD_Sel_INI_C "CARB spezifischer Fehlercode fuer Fehlerpfad Dfp_MSidCD_Sel_INI" VAL_BLK 0xC93B8 Kwb_Wu16 65535.00 OneToOne 0.00 65535.00 FORMAT "%8.2" NUMBER 4 /end CHARACTERISTIC
/begin CHARACTERISTIC DSM_CDCDfp_MSidCD_Select_C "CARB spezifischer Fehlercode fuer Fehlerpfad Dfp_MSidCD_Select" VAL_BLK 0xC93C0 Kwb_Wu16 65535.00 OneToOne 0.00 65535.00 FORMAT "%8.2" NUMBER 4 /end CHARACTERISTIC
/begin CHARACTERISTIC DSM_CDCDfp_MeUnCDNoLoad_C "CARB spezifischer Fehlercode fuer Fehlerpfad Dfp_MeUnCDNoLoad" VAL_BLK 0xC93C8 Kwb_Wu16 65535.00 OneToOne 0.00 65535.00 FORMAT "%8.2" NUMBER 4 /end CHARACTERISTIC
/begin CHARACTERISTIC DSM_CDCDfp_MeUnCDSCBat_C "CARB spezifischer Fehlercode fuer Fehlerpfad Dfp_MeUnCDSCBat" VAL_BLK 0xC93D0 Kwb_Wu16 65535.00 OneToOne 0.00 65535.00 FORMAT "%8.2" NUMBER 4 /end CHARACTERISTIC
/begin CHARACTERISTIC DSM_CDCDfp_MeUnCDSCGnd_C "CARB spezifischer Fehlercode fuer Fehlerpfad Dfp_MeUnCDSCGnd" VAL_BLK 0xC93D8 Kwb_Wu16 65535.00 OneToOne 0.00 65535.00 FORMAT "%8.2" NUMBER 4 /end CHARACTERISTIC
/begin CHARACTERISTIC DSM_CDCDfp_MeUnCD_ADC_C "CARB spezifischer Fehlercode fuer Fehlerpfad Dfp_MeUnCD_ADC" VAL_BLK 0xC93E0 Kwb_Wu16 65535.00 OneToOne 0.00 65535.00 FORMAT "%8.2" NUMBER 4 /end CHARACTERISTIC
/begin CHARACTERISTIC DSM_CDCDfp_MeUnCD_SigTst_C "CARB spezifischer Fehlercode fuer Fehlerpfad Dfp_MeUnCD_SigTst" VAL_BLK 0xC93E8 Kwb_Wu16 65535.00 OneToOne 0.00 65535.00 FORMAT "%8.2" NUMBER 4 /end CHARACTERISTIC
/begin CHARACTERISTIC DSM_CDCDfp_Montr_C "CARB spezifischer Fehlercode fuer Fehlerpfad Dfp_Montr" VAL_BLK 0xC93F0 Kwb_Wu16 65535.00 OneToOne 0.00 65535.00 FORMAT "%8.2" NUMBER 4 /end CHARACTERISTIC
/begin CHARACTERISTIC DSM_CDCDfp_NetMngDeviceA_C "CARB spezifischer Fehlercode fuer Fehlerpfad Dfp_NetMngDeviceA" VAL_BLK 0xC93F8 Kwb_Wu16 65535.00 OneToOne 0.00 65535.00 FORMAT "%8.2" NUMBER 4 /end CHARACTERISTIC
/begin CHARACTERISTIC DSM_CDCDfp_NetMngDeviceB_C "CARB spezifischer Fehlercode fuer Fehlerpfad Dfp_NetMngDeviceB" VAL_BLK 0xC9400 Kwb_Wu16 65535.00 OneToOne 0.00 65535.00 FORMAT "%8.2" NUMBER 4 /end CHARACTERISTIC
/begin CHARACTERISTIC DSM_CDCDfp_NetMngDeviceC_C "CARB spezifischer Fehlercode fuer Fehlerpfad Dfp_NetMngDeviceC" VAL_BLK 0xC9408 Kwb_Wu16 65535.00 OneToOne 0.00 65535.00 FORMAT "%8.2" NUMBER 4 /end CHARACTERISTIC
/begin CHARACTERISTIC DSM_CDCDfp_OPSCD_Lamp_C "CARB spezifischer Fehlercode fuer Fehlerpfad Dfp_OPSCD_Lamp" VAL_BLK 0xC9410 Kwb_Wu16 65535.00 OneToOne 0.00 65535.00 FORMAT "%8.2" NUMBER 4 /end CHARACTERISTIC
/begin CHARACTERISTIC DSM_CDCDfp_OPSCD_anain_C "CARB spezifischer Fehlercode fuer Fehlerpfad Dfp_OPSCD_anain" VAL_BLK 0xC9418 Kwb_Wu16 65535.00 OneToOne 0.00 65535.00 FORMAT "%8.2" NUMBER 4 /end CHARACTERISTIC
/begin CHARACTERISTIC DSM_CDCDfp_OTSCD_C "CARB spezifischer Fehlercode fuer Fehlerpfad Dfp_OTSCD" VAL_BLK 0xC9420 Kwb_Wu16 65535.00 OneToOne 0.00 65535.00 FORMAT "%8.2" NUMBER 4 /end CHARACTERISTIC
/begin CHARACTERISTIC DSM_CDCDfp_OvRMon_C "CARB spezifischer Fehlercode fuer Fehlerpfad Dfp_OvRMon" VAL_BLK 0xC9428 Kwb_Wu16 65535.00 OneToOne 0.00 65535.00 FORMAT "%8.2" NUMBER 4 /end CHARACTERISTIC
/begin CHARACTERISTIC DSM_CDCDfp_OvRMonBrk_C "CARB specific fault code for fault path Dfp_OvRMonBrk" VAL_BLK 0xC9430 Kwb_Wu16 65535.00 OneToOne 0.00 65535.00 FORMAT "%8.2" NUMBER 4 /end CHARACTERISTIC
/begin CHARACTERISTIC DSM_CDCDfp_OvRMonSigA_C "CARB spezifischer Fehlercode fuer Fehlerpfad Dfp_OvRMonSigA" VAL_BLK 0xC9438 Kwb_Wu16 65535.00 OneToOne 0.00 65535.00 FORMAT "%8.2" NUMBER 4 /end CHARACTERISTIC
/begin CHARACTERISTIC DSM_CDCDfp_OxiCCDTPre_C "CARB spezifischer Fehlercode fuer Fehlerpfad Dfp_OxiCCDTPre" VAL_BLK 0xC9440 Kwb_Wu16 65535.00 OneToOne 0.00 65535.00 FORMAT "%8.2" NUMBER 4 /end CHARACTERISTIC
/begin CHARACTERISTIC DSM_CDCDfp_PCR_GovDevNeg_C "CARB spezifischer Fehlercode fuer Fehlerpfad Dfp_PCR_GovDevNeg" VAL_BLK 0xC9448 Kwb_Wu16 65535.00 OneToOne 0.00 65535.00 FORMAT "%8.2" NUMBER 4 /end CHARACTERISTIC
/begin CHARACTERISTIC DSM_CDCDfp_PCR_GovDevPos_C "CARB spezifischer Fehlercode fuer Fehlerpfad Dfp_PCR_GovDevPos" VAL_BLK 0xC9450 Kwb_Wu16 65535.00 OneToOne 0.00 65535.00 FORMAT "%8.2" NUMBER 4 /end CHARACTERISTIC
/begin CHARACTERISTIC DSM_CDCDfp_PCVCDNoLoad_C "CARB spezifischer Fehlercode fuer Fehlerpfad Dfp_PCVCDNoLoad" VAL_BLK 0xC9458 Kwb_Wu16 65535.00 OneToOne 0.00 65535.00 FORMAT "%8.2" NUMBER 4 /end CHARACTERISTIC
/begin CHARACTERISTIC DSM_CDCDfp_PCVCDSCBat_C "CARB spezifischer Fehlercode fuer Fehlerpfad Dfp_PCVCDSCBat" VAL_BLK 0xC9460 Kwb_Wu16 65535.00 OneToOne 0.00 65535.00 FORMAT "%8.2" NUMBER 4 /end CHARACTERISTIC
/begin CHARACTERISTIC DSM_CDCDfp_PCVCDSCGnd_C "CARB spezifischer Fehlercode fuer Fehlerpfad Dfp_PCVCDSCGnd" VAL_BLK 0xC9468 Kwb_Wu16 65535.00 OneToOne 0.00 65535.00 FORMAT "%8.2" NUMBER 4 /end CHARACTERISTIC
/begin CHARACTERISTIC DSM_CDCDfp_PCVCD_ADC_C "CARB spezifischer Fehlercode fuer Fehlerpfad Dfp_PCVCD_ADC" VAL_BLK 0xC9470 Kwb_Wu16 65535.00 OneToOne 0.00 65535.00 FORMAT "%8.2" NUMBER 4 /end CHARACTERISTIC
/begin CHARACTERISTIC DSM_CDCDfp_PCVCD_SigTst_C "CARB spezifischer Fehlercode fuer Fehlerpfad Dfp_PCVCD_SigTst" VAL_BLK 0xC9478 Kwb_Wu16 65535.00 OneToOne 0.00 65535.00 FORMAT "%8.2" NUMBER 4 /end CHARACTERISTIC
/begin CHARACTERISTIC DSM_CDCDfp_PFltAPSens_C "CARB spezifischer Fehlercode fuer Fehlerpfad Dfp_PFltAPSens" VAL_BLK 0xC9480 Kwb_Wu16 65535.00 OneToOne 0.00 65535.00 FORMAT "%8.2" NUMBER 4 /end CHARACTERISTIC
/begin CHARACTERISTIC DSM_CDCDfp_PFltCDPPre_C "CARB spezifischer Fehlercode fuer Fehlerpfad Dfp_PFltCDPPre" VAL_BLK 0xC9488 Kwb_Wu16 65535.00 OneToOne 0.00 65535.00 FORMAT "%8.2" NUMBER 4 /end CHARACTERISTIC
/begin CHARACTERISTIC DSM_CDCDfp_PFltCDTempPre_C "CARB spezifischer Fehlercode fuer Fehlerpfad Dfp_PFltCDTempPre" VAL_BLK 0xC9490 Kwb_Wu16 65535.00 OneToOne 0.00 65535.00 FORMAT "%8.2" NUMBER 4 /end CHARACTERISTIC
/begin CHARACTERISTIC DSM_CDCDfp_PFltChar_C "CARB spezifischer Fehlercode fuer Fehlerpfad Dfp_PFltChar" VAL_BLK 0xC9498 Kwb_Wu16 65535.00 OneToOne 0.00 65535.00 FORMAT "%8.2" NUMBER 4 /end CHARACTERISTIC
/begin CHARACTERISTIC DSM_CDCDfp_PFltEngPrt_C "CARB spezifischer Fehlercode fuer Fehlerpfad Dfp_PFltEngPrt" VAL_BLK 0xC94A0 Kwb_Wu16 65535.00 OneToOne 0.00 65535.00 FORMAT "%8.2" NUMBER 4 /end CHARACTERISTIC
/begin CHARACTERISTIC DSM_CDCDfp_PFltPresDynPlaus_C "CARB spezifischer Fehlercode fuer Fehlerpfad Dfp_PFltPresDynPlaus" VAL_BLK 0xC94A8 Kwb_Wu16 65535.00 OneToOne 0.00 65535.00 FORMAT "%8.2" NUMBER 4 /end CHARACTERISTIC
/begin CHARACTERISTIC DSM_CDCDfp_PFltPresSens_C "CARB spezifischer Fehlercode fuer Fehlerpfad Dfp_PFltPresSens" VAL_BLK 0xC94B0 Kwb_Wu16 65535.00 OneToOne 0.00 65535.00 FORMAT "%8.2" NUMBER 4 /end CHARACTERISTIC
/begin CHARACTERISTIC DSM_CDCDfp_PFltPresSensFrz_C "CARB spezifischer Fehlercode fuer Fehlerpfad Dfp_PFltPresSensFrz" VAL_BLK 0xC94B8 Kwb_Wu16 65535.00 OneToOne 0.00 65535.00 FORMAT "%8.2" NUMBER 4 /end CHARACTERISTIC
/begin CHARACTERISTIC DSM_CDCDfp_PFltPresSensHsLn_C "CARB spezifischer Fehlercode fuer Fehlerpfad Dfp_PFltPresSensHsLn" VAL_BLK 0xC94C0 Kwb_Wu16 65535.00 OneToOne 0.00 65535.00 FORMAT "%8.2" NUMBER 4 /end CHARACTERISTIC
/begin CHARACTERISTIC DSM_CDCDfp_PFltPresSensSot_C "CARB spezifischer Fehlercode fuer Fehlerpfad Dfp_PFltPresSensSot" VAL_BLK 0xC94C8 Kwb_Wu16 65535.00 OneToOne 0.00 65535.00 FORMAT "%8.2" NUMBER 4 /end CHARACTERISTIC
/begin CHARACTERISTIC DSM_CDCDfp_PFltRgnPerm_C "CARB spezifischer Fehlercode fuer Fehlerpfad Dfp_PFltRgnPerm" VAL_BLK 0xC94D0 Kwb_Wu16 65535.00 OneToOne 0.00 65535.00 FORMAT "%8.2" NUMBER 4 /end CHARACTERISTIC
/begin CHARACTERISTIC DSM_CDCDfp_PFltTempDwnStrm_C "CARB spezifischer Fehlercode fuer Fehlerpfad Dfp_PFltTempDwnStrm" VAL_BLK 0xC94D8 Kwb_Wu16 65535.00 OneToOne 0.00 65535.00 FORMAT "%8.2" NUMBER 4 /end CHARACTERISTIC
/begin CHARACTERISTIC DSM_CDCDfp_PFltTempSens_C "CARB spezifischer Fehlercode fuer Fehlerpfad Dfp_PFltTempSens" VAL_BLK 0xC94E0 Kwb_Wu16 65535.00 OneToOne 0.00 65535.00 FORMAT "%8.2" NUMBER 4 /end CHARACTERISTIC
/begin CHARACTERISTIC DSM_CDCDfp_PFltTempUpStrm_C "CARB spezifischer Fehlercode fuer Fehlerpfad Dfp_PFltTempUpStrm" VAL_BLK 0xC94E8 Kwb_Wu16 65535.00 OneToOne 0.00 65535.00 FORMAT "%8.2" NUMBER 4 /end CHARACTERISTIC
/begin CHARACTERISTIC DSM_CDCDfp_PFltmSotDiffMax_C "CARB spezifischer Fehlercode fuer Fehlerpfad Dfp_PFltmSotDiffMax" VAL_BLK 0xC94F0 Kwb_Wu16 65535.00 OneToOne 0.00 65535.00 FORMAT "%8.2" NUMBER 4 /end CHARACTERISTIC
/begin CHARACTERISTIC DSM_CDCDfp_QLTCD_C "CARB spezifischer Fehlercode fuer Fehlerpfad Dfp_QLTCD" VAL_BLK 0xC94F8 Kwb_Wu16 65535.00 OneToOne 0.00 65535.00 FORMAT "%8.2" NUMBER 4 /end CHARACTERISTIC
/begin CHARACTERISTIC DSM_CDCDfp_RTMMon_C "CARB spezifischer Fehlercode fuer Fehlerpfad Dfp_RTMMon" VAL_BLK 0xC9500 Kwb_Wu16 65535.00 OneToOne 0.00 65535.00 FORMAT "%8.2" NUMBER 4 /end CHARACTERISTIC
/begin CHARACTERISTIC DSM_CDCDfp_RailCD_C "CARB spezifischer Fehlercode fuer Fehlerpfad Dfp_RailCD" VAL_BLK 0xC9508 Kwb_Wu16 65535.00 OneToOne 0.00 65535.00 FORMAT "%8.2" NUMBER 4 /end CHARACTERISTIC
/begin CHARACTERISTIC DSM_CDCDfp_RailCDOfsTst_C "CARB spezifischer Fehlercode fuer Fehlerpfad Dfp_RailCDOfsTst" VAL_BLK 0xC9510 Kwb_Wu16 65535.00 OneToOne 0.00 65535.00 FORMAT "%8.2" NUMBER 4 /end CHARACTERISTIC
/begin CHARACTERISTIC DSM_CDCDfp_RailCD_PMonStrt_C "CARB spezifischer Fehlercode fuer Fehlerpfad Dfp_RailCD_PMonStrt" VAL_BLK 0xC9518 Kwb_Wu16 65535.00 OneToOne 0.00 65535.00 FORMAT "%8.2" NUMBER 4 /end CHARACTERISTIC
/begin CHARACTERISTIC DSM_CDCDfp_RailCtlModeMeUnDiag_C "CARB spezifischer Fehlercode fuer Fehlerpfad Dfp_RailCtlModeMeUnDiag" VAL_BLK 0xC9520 Kwb_Wu16 65535.00 OneToOne 0.00 65535.00 FORMAT "%8.2" NUMBER 4 /end CHARACTERISTIC
/begin CHARACTERISTIC DSM_CDCDfp_RailCtlModePCVDiag_C "CARB spezifischer Fehlercode fuer Fehlerpfad Dfp_RailCtlModePCVDiag" VAL_BLK 0xC9528 Kwb_Wu16 65535.00 OneToOne 0.00 65535.00 FORMAT "%8.2" NUMBER 4 /end CHARACTERISTIC
/begin CHARACTERISTIC DSM_CDCDfp_RailMeUn0_C "CARB spezifischer Fehlercode fuer Fehlerpfad Dfp_RailMeUn0" VAL_BLK 0xC9530 Kwb_Wu16 65535.00 OneToOne 0.00 65535.00 FORMAT "%8.2" NUMBER 4 /end CHARACTERISTIC
/begin CHARACTERISTIC DSM_CDCDfp_RailMeUn1_C "CARB spezifischer Fehlercode fuer Fehlerpfad Dfp_RailMeUn1" VAL_BLK 0xC9538 Kwb_Wu16 65535.00 OneToOne 0.00 65535.00 FORMAT "%8.2" NUMBER 4 /end CHARACTERISTIC
/begin CHARACTERISTIC DSM_CDCDfp_RailMeUn2_C "CARB spezifischer Fehlercode fuer Fehlerpfad Dfp_RailMeUn2" VAL_BLK 0xC9540 Kwb_Wu16 65535.00 OneToOne 0.00 65535.00 FORMAT "%8.2" NUMBER 4 /end CHARACTERISTIC
/begin CHARACTERISTIC DSM_CDCDfp_RailMeUn3_C "CARB spezifischer Fehlercode fuer Fehlerpfad Dfp_RailMeUn3" VAL_BLK 0xC9548 Kwb_Wu16 65535.00 OneToOne 0.00 65535.00 FORMAT "%8.2" NUMBER 4 /end CHARACTERISTIC
/begin CHARACTERISTIC DSM_CDCDfp_RailMeUn4_C "CARB spezifischer Fehlercode fuer Fehlerpfad Dfp_RailMeUn4" VAL_BLK 0xC9550 Kwb_Wu16 65535.00 OneToOne 0.00 65535.00 FORMAT "%8.2" NUMBER 4 /end CHARACTERISTIC
/begin CHARACTERISTIC DSM_CDCDfp_RailPCV0_C "CARB spezifischer Fehlercode fuer Fehlerpfad Dfp_RailPCV0" VAL_BLK 0xC9558 Kwb_Wu16 65535.00 OneToOne 0.00 65535.00 FORMAT "%8.2" NUMBER 4 /end CHARACTERISTIC
/begin CHARACTERISTIC DSM_CDCDfp_RailPCV1_C "CARB spezifischer Fehlercode fuer Fehlerpfad Dfp_RailPCV1" VAL_BLK 0xC9560 Kwb_Wu16 65535.00 OneToOne 0.00 65535.00 FORMAT "%8.2" NUMBER 4 /end CHARACTERISTIC
/begin CHARACTERISTIC DSM_CDCDfp_RailPCV2_C "CARB spezifischer Fehlercode fuer Fehlerpfad Dfp_RailPCV2" VAL_BLK 0xC9568 Kwb_Wu16 65535.00 OneToOne 0.00 65535.00 FORMAT "%8.2" NUMBER 4 /end CHARACTERISTIC
/begin CHARACTERISTIC DSM_CDCDfp_RailPCV3_C "CARB spezifischer Fehlercode fuer Fehlerpfad Dfp_RailPCV3" VAL_BLK 0xC9570 Kwb_Wu16 65535.00 OneToOne 0.00 65535.00 FORMAT "%8.2" NUMBER 4 /end CHARACTERISTIC
/begin CHARACTERISTIC DSM_CDCDfp_RailPCV4_C "CARB spezifischer Fehlercode fuer Fehlerpfad Dfp_RailPCV4" VAL_BLK 0xC9578 Kwb_Wu16 65535.00 OneToOne 0.00 65535.00 FORMAT "%8.2" NUMBER 4 /end CHARACTERISTIC
/begin CHARACTERISTIC DSM_CDCDfp_RailPCV5_C "CARB spezifischer Fehlercode fuer Fehlerpfad Dfp_RailPCV5" VAL_BLK 0xC9580 Kwb_Wu16 65535.00 OneToOne 0.00 65535.00 FORMAT "%8.2" NUMBER 4 /end CHARACTERISTIC
/begin CHARACTERISTIC DSM_CDCDfp_SOPTst_C "CARB spezifischer Fehlercode fuer Fehlerpfad Dfp_SOPTst" VAL_BLK 0xC9588 Kwb_Wu16 65535.00 OneToOne 0.00 65535.00 FORMAT "%8.2" NUMBER 4 /end CHARACTERISTIC
/begin CHARACTERISTIC DSM_CDCDfp_SSpMon1_C "CARB spezifischer Fehlercode fuer Fehlerpfad Dfp_SSpMon1" VAL_BLK 0xC9590 Kwb_Wu16 65535.00 OneToOne 0.00 65535.00 FORMAT "%8.2" NUMBER 4 /end CHARACTERISTIC
/begin CHARACTERISTIC DSM_CDCDfp_SSpMon2_C "CARB spezifischer Fehlercode fuer Fehlerpfad Dfp_SSpMon2" VAL_BLK 0xC9598 Kwb_Wu16 65535.00 OneToOne 0.00 65535.00 FORMAT "%8.2" NUMBER 4 /end CHARACTERISTIC
/begin CHARACTERISTIC DSM_CDCDfp_SSpMon3_C "CARB spezifischer Fehlercode fuer Fehlerpfad Dfp_SSpMon3" VAL_BLK 0xC95A0 Kwb_Wu16 65535.00 OneToOne 0.00 65535.00 FORMAT "%8.2" NUMBER 4 /end CHARACTERISTIC
/begin CHARACTERISTIC DSM_CDCDfp_ShutCD_C "CARB spezifischer Fehlercode fuer Fehlerpfad Dfp_ShutCD" VAL_BLK 0xC95A8 Kwb_Wu16 65535.00 OneToOne 0.00 65535.00 FORMAT "%8.2" NUMBER 4 /end CHARACTERISTIC
/begin CHARACTERISTIC DSM_CDCDfp_StSysTrqShutOff_C "CARB spezifischer Fehlercode fuer Fehlerpfad Dfp_StSysTrqShutOff" VAL_BLK 0xC95B0 Kwb_Wu16 65535.00 OneToOne 0.00 65535.00 FORMAT "%8.2" NUMBER 4 /end CHARACTERISTIC
/begin CHARACTERISTIC DSM_CDCDfp_StrtCD_Actr_C "CARB spezifischer Fehlercode fuer Fehlerpfad Dfp_StrtCD_Actr" VAL_BLK 0xC95B8 Kwb_Wu16 65535.00 OneToOne 0.00 65535.00 FORMAT "%8.2" NUMBER 4 /end CHARACTERISTIC
/begin CHARACTERISTIC DSM_CDCDfp_SysLamp_C "CARB spezifischer Fehlercode fuer Fehlerpfad Dfp_SysLamp" VAL_BLK 0xC95C0 Kwb_Wu16 65535.00 OneToOne 0.00 65535.00 FORMAT "%8.2" NUMBER 4 /end CHARACTERISTIC
/begin CHARACTERISTIC DSM_CDCDfp_T15CD_C "CARB spezifischer Fehlercode fuer Fehlerpfad Dfp_T15CD" VAL_BLK 0xC95C8 Kwb_Wu16 65535.00 OneToOne 0.00 65535.00 FORMAT "%8.2" NUMBER 4 /end CHARACTERISTIC
/begin CHARACTERISTIC DSM_CDCDfp_TGearbx_C "CARB spezifischer Fehlercode fuer Fehlerpfad Dfp_TGearbx" VAL_BLK 0xC95D0 Kwb_Wu16 65535.00 OneToOne 0.00 65535.00 FORMAT "%8.2" NUMBER 4 /end CHARACTERISTIC
/begin CHARACTERISTIC DSM_CDCDfp_TPUMon_C "CARB spezifischer Fehlercode fuer Fehlerpfad Dfp_TPUMon" VAL_BLK 0xC95D8 Kwb_Wu16 65535.00 OneToOne 0.00 65535.00 FORMAT "%8.2" NUMBER 4 /end CHARACTERISTIC
/begin CHARACTERISTIC DSM_CDCDfp_TVACD_Max_C "CARB spezifischer Fehlercode fuer Fehlerpfad Dfp_TVACD_Max" VAL_BLK 0xC95E0 Kwb_Wu16 65535.00 OneToOne 0.00 65535.00 FORMAT "%8.2" NUMBER 4 /end CHARACTERISTIC
/begin CHARACTERISTIC DSM_CDCDfp_TVACD_Min_C "CARB spezifischer Fehlercode fuer Fehlerpfad Dfp_TVACD_Min" VAL_BLK 0xC95E8 Kwb_Wu16 65535.00 OneToOne 0.00 65535.00 FORMAT "%8.2" NUMBER 4 /end CHARACTERISTIC
/begin CHARACTERISTIC DSM_CDCDfp_TVACD_SigNpl_C "CARB spezifischer Fehlercode fuer Fehlerpfad Dfp_TVACD_SigNpl" VAL_BLK 0xC95F0 Kwb_Wu16 65535.00 OneToOne 0.00 65535.00 FORMAT "%8.2" NUMBER 4 /end CHARACTERISTIC
/begin CHARACTERISTIC DSM_CDCDfp_TVACD_TVADia1_C "CARB spezifischer Fehlercode fuer Fehlerpfad Dfp_TVACD_TVADia1" VAL_BLK 0xC95F8 Kwb_Wu16 65535.00 OneToOne 0.00 65535.00 FORMAT "%8.2" NUMBER 4 /end CHARACTERISTIC
/begin CHARACTERISTIC DSM_CDCDfp_TVACD_TVADia2_C "CARB spezifischer Fehlercode fuer Fehlerpfad Dfp_TVACD_TVADia2" VAL_BLK 0xC9600 Kwb_Wu16 65535.00 OneToOne 0.00 65535.00 FORMAT "%8.2" NUMBER 4 /end CHARACTERISTIC
/begin CHARACTERISTIC DSM_CDCDfp_TVACD_TVADia3_C "CARB spezifischer Fehlercode fuer Fehlerpfad Dfp_TVACD_TVADia3" VAL_BLK 0xC9608 Kwb_Wu16 65535.00 OneToOne 0.00 65535.00 FORMAT "%8.2" NUMBER 4 /end CHARACTERISTIC
/begin CHARACTERISTIC DSM_CDCDfp_VSACD_Max_C "CARB spezifischer Fehlercode fuer Fehlerpfad Dfp_VSACD_Max" VAL_BLK 0xC9610 Kwb_Wu16 65535.00 OneToOne 0.00 65535.00 FORMAT "%8.2" NUMBER 4 /end CHARACTERISTIC
/begin CHARACTERISTIC DSM_CDCDfp_VSACD_Min_C "CARB spezifischer Fehlercode fuer Fehlerpfad Dfp_VSACD_Min" VAL_BLK 0xC9618 Kwb_Wu16 65535.00 OneToOne 0.00 65535.00 FORMAT "%8.2" NUMBER 4 /end CHARACTERISTIC
/begin CHARACTERISTIC DSM_CDCDfp_VSACD_SigNpl_C "CARB spezifischer Fehlercode fuer Fehlerpfad Dfp_VSACD_SigNpl" VAL_BLK 0xC9620 Kwb_Wu16 65535.00 OneToOne 0.00 65535.00 FORMAT "%8.2" NUMBER 4 /end CHARACTERISTIC
/begin CHARACTERISTIC DSM_CDCDfp_VSACD_VSADia1_C "CARB spezifischer Fehlercode fuer Fehlerpfad Dfp_VSACD_VSADia1" VAL_BLK 0xC9628 Kwb_Wu16 65535.00 OneToOne 0.00 65535.00 FORMAT "%8.2" NUMBER 4 /end CHARACTERISTIC
/begin CHARACTERISTIC DSM_CDCDfp_VSACD_VSADia2_C "CARB spezifischer Fehlercode fuer Fehlerpfad Dfp_VSACD_VSADia2" VAL_BLK 0xC9630 Kwb_Wu16 65535.00 OneToOne 0.00 65535.00 FORMAT "%8.2" NUMBER 4 /end CHARACTERISTIC
/begin CHARACTERISTIC DSM_CDCDfp_VSACD_VSADia3_C "CARB spezifischer Fehlercode fuer Fehlerpfad Dfp_VSACD_VSADia3" VAL_BLK 0xC9638 Kwb_Wu16 65535.00 OneToOne 0.00 65535.00 FORMAT "%8.2" NUMBER 4 /end CHARACTERISTIC
/begin CHARACTERISTIC DSM_CDCDfp_VSACD_VSADia4_C "CARB spezifischer Fehlercode fuer Fehlerpfad Dfp_VSACD_VSADia4" VAL_BLK 0xC9640 Kwb_Wu16 65535.00 OneToOne 0.00 65535.00 FORMAT "%8.2" NUMBER 4 /end CHARACTERISTIC
/begin CHARACTERISTIC DSM_CDCDfp_VSSCD1_C "CARB spezifischer Fehlercode fuer Fehlerpfad Dfp_VSSCD1" VAL_BLK 0xC9648 Kwb_Wu16 65535.00 OneToOne 0.00 65535.00 FORMAT "%8.2" NUMBER 4 /end CHARACTERISTIC
/begin CHARACTERISTIC DSM_CDCDfp_VSSCD2_C "CARB spezifischer Fehlercode fuer Fehlerpfad Dfp_VSSCD2" VAL_BLK 0xC9650 Kwb_Wu16 65535.00 OneToOne 0.00 65535.00 FORMAT "%8.2" NUMBER 4 /end CHARACTERISTIC
/begin CHARACTERISTIC DSM_CDCDfp_WdCom_C "CARB spezifischer Fehlercode fuer Fehlerpfad Dfp_WdCom" VAL_BLK 0xC9658 Kwb_Wu16 65535.00 OneToOne 0.00 65535.00 FORMAT "%8.2" NUMBER 4 /end CHARACTERISTIC
/begin CHARACTERISTIC DSM_FMKDfp_Layer_TANS_C "Ausblendbedingungen fuer Fehlerpfad Dfp_Layer_TANS" VALUE 0xC8A48 Kw_Wu8 255.0 OneToOne 0.00 255.0 FORMAT "%5.1" /end CHARACTERISTIC
/begin CHARACTERISTIC DSM_FMKDfp_ACCDSwtin_C "Ausblendbedingungen fuer Fehlerpfad Dfp_ACCDSwtin" VALUE 0xC8A49 Kw_Wu8 255.0 OneToOne 0.00 255.0 FORMAT "%5.1" /end CHARACTERISTIC
/begin CHARACTERISTIC DSM_FMKDfp_ACC_PlausTrqDes_C "Ausblendbedingungen fuer Fehlerpfad Dfp_ACC_PlausTrqDes" VALUE 0xC8A4A Kw_Wu8 255.0 OneToOne 0.00 255.0 FORMAT "%5.1" /end CHARACTERISTIC
/begin CHARACTERISTIC DSM_FMKDfp_ACC_trqInr_C "Ausblendbedingungen fuer Fehlerpfad Dfp_ACC_trqInr" VALUE 0xC8A4B Kw_Wu8 255.0 OneToOne 0.00 255.0 FORMAT "%5.1" /end CHARACTERISTIC
/begin CHARACTERISTIC DSM_FMKDfp_ACTrq_C "Ausblendbedingungen fuer Fehlerpfad Dfp_ACTrq" VALUE 0xC8A4C Kw_Wu8 255.0 OneToOne 0.00 255.0 FORMAT "%5.1" /end CHARACTERISTIC
/begin CHARACTERISTIC DSM_FMKDfp_ADCMon_C "Ausblendbedingungen fuer Fehlerpfad Dfp_ADCMon" VALUE 0xC8A4D Kw_Wu8 255.0 OneToOne 0.00 255.0 FORMAT "%5.1" /end CHARACTERISTIC
/begin CHARACTERISTIC DSM_FMKDfp_AFSCDIdlAdjVal_C "Ausblendbedingungen fuer Fehlerpfad Dfp_AFSCDIdlAdjVal" VALUE 0xC8A4E Kw_Wu8 255.0 OneToOne 0.00 255.0 FORMAT "%5.1" /end CHARACTERISTIC
/begin CHARACTERISTIC DSM_FMKDfp_AFSCDLdAdjVal_C "Ausblendbedingungen fuer Fehlerpfad Dfp_AFSCDLdAdjVal" VALUE 0xC8A4F Kw_Wu8 255.0 OneToOne 0.00 255.0 FORMAT "%5.1" /end CHARACTERISTIC
/begin CHARACTERISTIC DSM_FMKDfp_AFSCD_AirTempDcyc_C "Ausblendbedingungen fuer Fehlerpfad Dfp_AFSCD_AirTempDcyc" VALUE 0xC8A50 Kw_Wu8 255.0 OneToOne 0.00 255.0 FORMAT "%5.1" /end CHARACTERISTIC
/begin CHARACTERISTIC DSM_FMKDfp_AFSCD_PlOffsDrft_C "Ausblendbedingungen fuer Fehlerpfad Dfp_AFSCD_PlOffsDrft" VALUE 0xC8A51 Kw_Wu8 255.0 OneToOne 0.00 255.0 FORMAT "%5.1" /end CHARACTERISTIC
/begin CHARACTERISTIC DSM_FMKDfp_AFSCD_PlSetyDrft_C "Ausblendbedingungen fuer Fehlerpfad Dfp_AFSCD_PlSetyDrft" VALUE 0xC8A52 Kw_Wu8 255.0 OneToOne 0.00 255.0 FORMAT "%5.1" /end CHARACTERISTIC
/begin CHARACTERISTIC DSM_FMKDfp_AFSCD_SRCAirTemp_C "Ausblendbedingungen fuer Fehlerpfad Dfp_AFSCD_SRCAirTemp" VALUE 0xC8A53 Kw_Wu8 255.0 OneToOne 0.00 255.0 FORMAT "%5.1" /end CHARACTERISTIC
/begin CHARACTERISTIC DSM_FMKDfp_AFSCD_SRCBatt_C "Ausblendbedingungen fuer Fehlerpfad Dfp_AFSCD_SRCBatt" VALUE 0xC8A54 Kw_Wu8 255.0 OneToOne 0.00 255.0 FORMAT "%5.1" /end CHARACTERISTIC
/begin CHARACTERISTIC DSM_FMKDfp_AFSCD_SRCCorrAirm_C "Ausblendbedingungen fuer Fehlerpfad Dfp_AFSCD_SRCCorrAirm" VALUE 0xC8A55 Kw_Wu8 255.0 OneToOne 0.00 255.0 FORMAT "%5.1" /end CHARACTERISTIC
/begin CHARACTERISTIC DSM_FMKDfp_AFSCD_SRCRawAirm_C "Ausblendbedingungen fuer Fehlerpfad Dfp_AFSCD_SRCRawAirm" VALUE 0xC8A56 Kw_Wu8 255.0 OneToOne 0.00 255.0 FORMAT "%5.1" /end CHARACTERISTIC
/begin CHARACTERISTIC DSM_FMKDfp_AFSCD_SRCRefSigPer_C "Ausblendbedingungen fuer Fehlerpfad Dfp_AFSCD_SRCRefSigPer" VALUE 0xC8A57 Kw_Wu8 255.0 OneToOne 0.00 255.0 FORMAT "%5.1" /end CHARACTERISTIC
/begin CHARACTERISTIC DSM_FMKDfp_AOHtCD_C "Ausblendbedingungen fuer Fehlerpfad Dfp_AOHtCD" VALUE 0xC8A58 Kw_Wu8 255.0 OneToOne 0.00 255.0 FORMAT "%5.1" /end CHARACTERISTIC
/begin CHARACTERISTIC DSM_FMKDfp_AOHtCD_AOHtDia1_C "Ausblendbedingungen fuer Fehlerpfad Dfp_AOHtCD_AOHtDia1" VALUE 0xC8A59 Kw_Wu8 255.0 OneToOne 0.00 255.0 FORMAT "%5.1" /end CHARACTERISTIC
/begin CHARACTERISTIC DSM_FMKDfp_AOHtCD_AOHtDia2_C "Ausblendbedingungen fuer Fehlerpfad Dfp_AOHtCD_AOHtDia2" VALUE 0xC8A5A Kw_Wu8 255.0 OneToOne 0.00 255.0 FORMAT "%5.1" /end CHARACTERISTIC
/begin CHARACTERISTIC DSM_FMKDfp_Layer_TUMG_C "Ausblendbedingungen fuer Fehlerpfad Dfp_Layer_TUMG" VALUE 0xC8A5B Kw_Wu8 255.0 OneToOne 0.00 255.0 FORMAT "%5.1" /end CHARACTERISTIC
/begin CHARACTERISTIC DSM_FMKDfp_AOHtCD_AOHtDia3_C "Ausblendbedingungen fuer Fehlerpfad Dfp_AOHtCD_AOHtDia3" VALUE 0xC8A5C Kw_Wu8 255.0 OneToOne 0.00 255.0 FORMAT "%5.1" /end CHARACTERISTIC
/begin CHARACTERISTIC DSM_FMKDfp_APP1_C "Ausblendbedingungen fuer Fehlerpfad Dfp_APP1" VALUE 0xC8A5D Kw_Wu8 255.0 OneToOne 0.00 255.0 FORMAT "%5.1" /end CHARACTERISTIC
/begin CHARACTERISTIC DSM_FMKDfp_Layer_GEN_C "Ausblendbedingungen fuer Fehlerpfad Dfp_Layer_GEN" VALUE 0xC8A5E Kw_Wu8 255.0 OneToOne 0.00 255.0 FORMAT "%5.1" /end CHARACTERISTIC
/begin CHARACTERISTIC DSM_FMKDfp_Layer_BSD_C "Ausblendbedingungen fuer Fehlerpfad Dfp_Layer_BSD" VALUE 0xC8A5F Kw_Wu8 255.0 OneToOne 0.00 255.0 FORMAT "%5.1" /end CHARACTERISTIC
/begin CHARACTERISTIC DSM_FMKDfp_APP2_C "Ausblendbedingungen fuer Fehlerpfad Dfp_APP2" VALUE 0xC8A60 Kw_Wu8 255.0 OneToOne 0.00 255.0 FORMAT "%5.1" /end CHARACTERISTIC
/begin CHARACTERISTIC DSM_FMKDfp_APSCD_C "Ausblendbedingungen fuer Fehlerpfad Dfp_APSCD" VALUE 0xC8A61 Kw_Wu8 255.0 OneToOne 0.00 255.0 FORMAT "%5.1" /end CHARACTERISTIC
/begin CHARACTERISTIC DSM_FMKDfp_ARS_C "Ausblendbedingungen fuer Fehlerpfad Dfp_ARS" VALUE 0xC8A62 Kw_Wu8 255.0 OneToOne 0.00 255.0 FORMAT "%5.1" /end CHARACTERISTIC
/begin CHARACTERISTIC DSM_FMKDfp_AccPedPlausBrk_C "Ausblendbedingungen fuer Fehlerpfad Dfp_AccPedPlausBrk" VALUE 0xC8A63 Kw_Wu8 255.0 OneToOne 0.00 255.0 FORMAT "%5.1" /end CHARACTERISTIC
/begin CHARACTERISTIC DSM_FMKDfp_AirCtlPlateBreak_C "DSM variable for Dfp_AirCtlPlateBreak_mp" VALUE 0xC8A64 Kw_Wu8 255.0 OneToOne 0.00 255.0 FORMAT "%5.1" /end CHARACTERISTIC
/begin CHARACTERISTIC DSM_FMKDfp_AirCtl_GovNegDev_C "Ausblendbedingungen fuer Fehlerpfad Dfp_AirCtl_GovNegDev" VALUE 0xC8A65 Kw_Wu8 255.0 OneToOne 0.00 255.0 FORMAT "%5.1" /end CHARACTERISTIC
/begin CHARACTERISTIC DSM_FMKDfp_AirCtl_GovNegDev2_C "Ausblendbedingungen fuer Fehlerpfad Dfp_AirCtl_GovNegDev2" VALUE 0xC8A66 Kw_Wu8 255.0 OneToOne 0.00 255.0 FORMAT "%5.1" /end CHARACTERISTIC
/begin CHARACTERISTIC DSM_FMKDfp_AirCtl_GovPosDev_C "Ausblendbedingungen fuer Fehlerpfad Dfp_AirCtl_GovPosDev" VALUE 0xC8A67 Kw_Wu8 255.0 OneToOne 0.00 255.0 FORMAT "%5.1" /end CHARACTERISTIC
/begin CHARACTERISTIC DSM_FMKDfp_AirCtl_GovPosDev2_C "Ausblendbedingungen fuer Fehlerpfad Dfp_AirCtl_GovPosDev2" VALUE 0xC8A68 Kw_Wu8 255.0 OneToOne 0.00 255.0 FORMAT "%5.1" /end CHARACTERISTIC
/begin CHARACTERISTIC DSM_FMKDfp_AltCD_C "Ausblendbedingungen fuer Fehlerpfad Dfp_AltCD" VALUE 0xC8A69 Kw_Wu8 255.0 OneToOne 0.00 255.0 FORMAT "%5.1" /end CHARACTERISTIC
/begin CHARACTERISTIC DSM_FMKDfp_Layer_QLT_C "Ausblendbedingungen fuer Fehlerpfad Dfp_Layer_QLT" VALUE 0xC8A6A Kw_Wu8 255.0 OneToOne 0.00 255.0 FORMAT "%5.1" /end CHARACTERISTIC
/begin CHARACTERISTIC DSM_FMKDfp_BPACD_BPADia1_C "Ausblendbedingungen fuer Fehlerpfad Dfp_BPACD_BPADia1" VALUE 0xC8A6B Kw_Wu8 255.0 OneToOne 0.00 255.0 FORMAT "%5.1" /end CHARACTERISTIC
/begin CHARACTERISTIC DSM_FMKDfp_Layer_IBS1_C "Ausblendbedingungen fuer Fehlerpfad Dfp_Layer_IBS1" VALUE 0xC8A6C Kw_Wu8 255.0 OneToOne 0.00 255.0 FORMAT "%5.1" /end CHARACTERISTIC
/begin CHARACTERISTIC DSM_FMKDfp_Layer_IBS2_C "Ausblendbedingungen fuer Fehlerpfad Dfp_Layer_IBS2" VALUE 0xC8A6D Kw_Wu8 255.0 OneToOne 0.00 255.0 FORMAT "%5.1" /end CHARACTERISTIC
/begin CHARACTERISTIC DSM_FMKDfp_Layer_IBS3_C "Ausblendbedingungen fuer Fehlerpfad Dfp_Layer_IBS3" VALUE 0xC8A6E Kw_Wu8 255.0 OneToOne 0.00 255.0 FORMAT "%5.1" /end CHARACTERISTIC
/begin CHARACTERISTIC DSM_FMKDfp_Layer_PMBN_C "Ausblendbedingungen fuer Fehlerpfad Dfp_Layer_PMBN" VALUE 0xC8A6F Kw_Wu8 255.0 OneToOne 0.00 255.0 FORMAT "%5.1" /end CHARACTERISTIC
/begin CHARACTERISTIC DSM_FMKDfp_Layer_PMBATT_C "Ausblendbedingungen fuer Fehlerpfad Dfp_Layer_PMBATT" VALUE 0xC8A70 Kw_Wu8 255.0 OneToOne 0.00 255.0 FORMAT "%5.1" /end CHARACTERISTIC
/begin CHARACTERISTIC DSM_FMKDfp_BPACD_BPADia2_C "Ausblendbedingungen fuer Fehlerpfad Dfp_BPACD_BPADia2" VALUE 0xC8A71 Kw_Wu8 255.0 OneToOne 0.00 255.0 FORMAT "%5.1" /end CHARACTERISTIC
/begin CHARACTERISTIC DSM_FMKDfp_BPACD_BPADia3_C "Ausblendbedingungen fuer Fehlerpfad Dfp_BPACD_BPADia3" VALUE 0xC8A72 Kw_Wu8 255.0 OneToOne 0.00 255.0 FORMAT "%5.1" /end CHARACTERISTIC
/begin CHARACTERISTIC DSM_FMKDfp_BPACD_Max_C "Ausblendbedingungen fuer Fehlerpfad Dfp_BPACD_Max" VALUE 0xC8A73 Kw_Wu8 255.0 OneToOne 0.00 255.0 FORMAT "%5.1" /end CHARACTERISTIC
/begin CHARACTERISTIC DSM_FMKDfp_BPACD_Min_C "Ausblendbedingungen fuer Fehlerpfad Dfp_BPACD_Min" VALUE 0xC8A74 Kw_Wu8 255.0 OneToOne 0.00 255.0 FORMAT "%5.1" /end CHARACTERISTIC
/begin CHARACTERISTIC DSM_FMKDfp_BPACD_SigNpl_C "Ausblendbedingungen fuer Fehlerpfad Dfp_BPACD_SigNpl" VALUE 0xC8A75 Kw_Wu8 255.0 OneToOne 0.00 255.0 FORMAT "%5.1" /end CHARACTERISTIC
/begin CHARACTERISTIC DSM_FMKDfp_BPSCD_C "Ausblendbedingungen fuer Fehlerpfad Dfp_BPSCD" VALUE 0xC8A76 Kw_Wu8 255.0 OneToOne 0.00 255.0 FORMAT "%5.1" /end CHARACTERISTIC
/begin CHARACTERISTIC DSM_FMKDfp_BattCD_C "Ausblendbedingungen fuer Fehlerpfad Dfp_BattCD" VALUE 0xC8A77 Kw_Wu8 255.0 OneToOne 0.00 255.0 FORMAT "%5.1" /end CHARACTERISTIC
/begin CHARACTERISTIC DSM_FMKDfp_BrkCD_C "Ausblendbedingungen fuer Fehlerpfad Dfp_BrkCD" VALUE 0xC8A78 Kw_Wu8 255.0 OneToOne 0.00 255.0 FORMAT "%5.1" /end CHARACTERISTIC
/begin CHARACTERISTIC DSM_FMKDfp_Bss_C "Ausblendbedingungen fuer Fehlerpfad Dfp_Bss" VALUE 0xC8A79 Kw_Wu8 255.0 OneToOne 0.00 255.0 FORMAT "%5.1" /end CHARACTERISTIC
/begin CHARACTERISTIC DSM_FMKDfp_CBACD_C "Ausblendbedingungen fuer Fehlerpfad Dfp_CBACD" VALUE 0xC8A7A Kw_Wu8 255.0 OneToOne 0.00 255.0 FORMAT "%5.1" /end CHARACTERISTIC
/begin CHARACTERISTIC DSM_FMKDfp_CTSCD_C "Ausblendbedingungen fuer Fehlerpfad Dfp_CTSCD" VALUE 0xC8A7B Kw_Wu8 255.0 OneToOne 0.00 255.0 FORMAT "%5.1" /end CHARACTERISTIC
/begin CHARACTERISTIC DSM_FMKDfp_Clg_DynTst_C "Ausblendbedingungen fuer Fehlerpfad Dfp_Clg_DynTst" VALUE 0xC8A7C Kw_Wu8 255.0 OneToOne 0.00 255.0 FORMAT "%5.1" /end CHARACTERISTIC
/begin CHARACTERISTIC DSM_FMKDfp_CmbChbMisfire1_C "Ausblendbedingungen fuer Fehlerpfad Dfp_CmbChbMisfire1" VALUE 0xC8A7D Kw_Wu8 255.0 OneToOne 0.00 255.0 FORMAT "%5.1" /end CHARACTERISTIC
/begin CHARACTERISTIC DSM_FMKDfp_CmbChbMisfire2_C "Ausblendbedingungen fuer Fehlerpfad Dfp_CmbChbMisfire2" VALUE 0xC8A7E Kw_Wu8 255.0 OneToOne 0.00 255.0 FORMAT "%5.1" /end CHARACTERISTIC
/begin CHARACTERISTIC DSM_FMKDfp_CmbChbMisfire3_C "Ausblendbedingungen fuer Fehlerpfad Dfp_CmbChbMisfire3" VALUE 0xC8A7F Kw_Wu8 255.0 OneToOne 0.00 255.0 FORMAT "%5.1" /end CHARACTERISTIC
/begin CHARACTERISTIC DSM_FMKDfp_CmbChbMisfire4_C "Ausblendbedingungen fuer Fehlerpfad Dfp_CmbChbMisfire4" VALUE 0xC8A80 Kw_Wu8 255.0 OneToOne 0.00 255.0 FORMAT "%5.1" /end CHARACTERISTIC
/begin CHARACTERISTIC DSM_FMKDfp_CmbChbMisfire5_C "Ausblendbedingungen fuer Fehlerpfad Dfp_CmbChbMisfire5" VALUE 0xC8A81 Kw_Wu8 255.0 OneToOne 0.00 255.0 FORMAT "%5.1" /end CHARACTERISTIC
/begin CHARACTERISTIC DSM_FMKDfp_CmbChbMisfire6_C "Ausblendbedingungen fuer Fehlerpfad Dfp_CmbChbMisfire6" VALUE 0xC8A82 Kw_Wu8 255.0 OneToOne 0.00 255.0 FORMAT "%5.1" /end CHARACTERISTIC
/begin CHARACTERISTIC DSM_FMKDfp_CmbChbMisfireMul_C "Ausblendbedingungen fuer Fehlerpfad Dfp_CmbChbMisfireMul" VALUE 0xC8A83 Kw_Wu8 255.0 OneToOne 0.00 255.0 FORMAT "%5.1" /end CHARACTERISTIC
/begin CHARACTERISTIC DSM_FMKDfp_CoVMDCSh_C "Ausblendbedingungen fuer Fehlerpfad Dfp_CoVMDCSh" VALUE 0xC8A84 Kw_Wu8 255.0 OneToOne 0.00 255.0 FORMAT "%5.1" /end CHARACTERISTIC
/begin CHARACTERISTIC DSM_FMKDfp_ConvCD_C "Ausblendbedingungen fuer Fehlerpfad Dfp_ConvCD" VALUE 0xC8A85 Kw_Wu8 255.0 OneToOne 0.00 255.0 FORMAT "%5.1" /end CHARACTERISTIC
/begin CHARACTERISTIC DSM_FMKDfp_CrCCDMFL_C "Ausblendbedingungen fuer Fehlerpfad Dfp_CrCCDMFL" VALUE 0xC8A86 Kw_Wu8 255.0 OneToOne 0.00 255.0 FORMAT "%5.1" /end CHARACTERISTIC
/begin CHARACTERISTIC DSM_FMKDfp_CrCtl_vCrCtl_C "Ausblendbedingungen fuer Fehlerpfad Dfp_CrCtl_vCrCtl" VALUE 0xC8A87 Kw_Wu8 255.0 OneToOne 0.00 255.0 FORMAT "%5.1" /end CHARACTERISTIC
/begin CHARACTERISTIC DSM_FMKDfp_Dummy1_C "Ausblendbedingungen fuer Fehlerpfad Dfp_Dummy1" VALUE 0xC8A88 Kw_Wu8 255.0 OneToOne 0.00 255.0 FORMAT "%5.1" /end CHARACTERISTIC
/begin CHARACTERISTIC DSM_FMKDfp_EATSCD_C "Ausblendbedingungen fuer Fehlerpfad Dfp_EATSCD" VALUE 0xC8A89 Kw_Wu8 255.0 OneToOne 0.00 255.0 FORMAT "%5.1" /end CHARACTERISTIC
/begin CHARACTERISTIC DSM_FMKDfp_EBAFCD_C "Ausblendbedingungen fuer Fehlerpfad Dfp_EBAFCD" VALUE 0xC8A8A Kw_Wu8 255.0 OneToOne 0.00 255.0 FORMAT "%5.1" /end CHARACTERISTIC
/begin CHARACTERISTIC DSM_FMKDfp_EBFCD_C "Ausblendbedingungen fuer Fehlerpfad Dfp_EBFCD" VALUE 0xC8A8B Kw_Wu8 255.0 OneToOne 0.00 255.0 FORMAT "%5.1" /end CHARACTERISTIC
/begin CHARACTERISTIC DSM_FMKDfp_EBTSCD_C "Ausblendbedingungen fuer Fehlerpfad Dfp_EBTSCD" VALUE 0xC8A8C Kw_Wu8 255.0 OneToOne 0.00 255.0 FORMAT "%5.1" /end CHARACTERISTIC
/begin CHARACTERISTIC DSM_FMKDfp_EBTSCD_OvrTemp_C "Ausblendbedingungen fuer Fehlerpfad Dfp_EBTSCD_OvrTemp" VALUE 0xC8A8D Kw_Wu8 255.0 OneToOne 0.00 255.0 FORMAT "%5.1" /end CHARACTERISTIC
/begin CHARACTERISTIC DSM_FMKDfp_EEPCDVarMng_C "Ausblendbedingungen fuer Fehlerpfad Dfp_EEPCDVarMng" VALUE 0xC8A8E Kw_Wu8 255.0 OneToOne 0.00 255.0 FORMAT "%5.1" /end CHARACTERISTIC
/begin CHARACTERISTIC DSM_FMKDfp_EGPpCD_C "Ausblendbedingungen fuer Fehlerpfad Dfp_EGPpCD" VALUE 0xC8A8F Kw_Wu8 255.0 OneToOne 0.00 255.0 FORMAT "%5.1" /end CHARACTERISTIC
/begin CHARACTERISTIC DSM_FMKDfp_EGPpCDTPreTrbn_C "Ausblendbedingungen fuer Fehlerpfad Dfp_EgPpCDTPreTrbn" VALUE 0xC8A90 Kw_Wu8 255.0 OneToOne 0.00 255.0 FORMAT "%5.1" /end CHARACTERISTIC
/begin CHARACTERISTIC DSM_FMKDfp_Layer_PMRUHVERL_C "" VALUE 0xC8A91 Kw_Wu8 255.0 OneToOne 0.00 255.0 FORMAT "%5.1" /end CHARACTERISTIC
/begin CHARACTERISTIC DSM_FMKDfp_EGRCD_Max_C "Ausblendbedingungen fuer Fehlerpfad Dfp_EGRCD_Max" VALUE 0xC8A92 Kw_Wu8 255.0 OneToOne 0.00 255.0 FORMAT "%5.1" /end CHARACTERISTIC
/begin CHARACTERISTIC DSM_FMKDfp_EGRCD_Min_C "Ausblendbedingungen fuer Fehlerpfad Dfp_EGRCD_Min" VALUE 0xC8A93 Kw_Wu8 255.0 OneToOne 0.00 255.0 FORMAT "%5.1" /end CHARACTERISTIC
/begin CHARACTERISTIC DSM_FMKDfp_EGRCD_SigNpl_C "Ausblendbedingungen fuer Fehlerpfad Dfp_EGRCD_SigNpl" VALUE 0xC8A94 Kw_Wu8 255.0 OneToOne 0.00 255.0 FORMAT "%5.1" /end CHARACTERISTIC
/begin CHARACTERISTIC DSM_FMKDfp_EGTRgnOilDil_C "Ausblendbedingungen fuer Fehlerpfad Dfp_EGTRgnOilDil" VALUE 0xC8A95 Kw_Wu8 255.0 OneToOne 0.00 255.0 FORMAT "%5.1" /end CHARACTERISTIC
/begin CHARACTERISTIC DSM_FMKDfp_Layer_TOENS_C "" VALUE 0xC8A96 Kw_Wu8 255.0 OneToOne 0.00 255.0 FORMAT "%5.1" /end CHARACTERISTIC
/begin CHARACTERISTIC DSM_FMKDfp_Layer_MANHYDR_C "" VALUE 0xC8A97 Kw_Wu8 255.0 OneToOne 0.00 255.0 FORMAT "%5.1" /end CHARACTERISTIC
/begin CHARACTERISTIC DSM_FMKDfp_Layer_MANLUFT_C "" VALUE 0xC8A98 Kw_Wu8 255.0 OneToOne 0.00 255.0 FORMAT "%5.1" /end CHARACTERISTIC
/begin CHARACTERISTIC DSM_FMKDfp_ETClbETFltInj1_C "Ausblendbedingungen fuer Fehlerpfad Dfp_ETClbETFltInj1" VALUE 0xC8A99 Kw_Wu8 255.0 OneToOne 0.00 255.0 FORMAT "%5.1" /end CHARACTERISTIC
/begin CHARACTERISTIC DSM_FMKDfp_ETClbETFltInj2_C "Ausblendbedingungen fuer Fehlerpfad Dfp_ETClbETFltInj2" VALUE 0xC8A9A Kw_Wu8 255.0 OneToOne 0.00 255.0 FORMAT "%5.1" /end CHARACTERISTIC
/begin CHARACTERISTIC DSM_FMKDfp_ETClbETFltInj3_C "Ausblendbedingungen fuer Fehlerpfad Dfp_ETClbETFltInj3" VALUE 0xC8A9B Kw_Wu8 255.0 OneToOne 0.00 255.0 FORMAT "%5.1" /end CHARACTERISTIC
/begin CHARACTERISTIC DSM_FMKDfp_ETClbETFltInj4_C "Ausblendbedingungen fuer Fehlerpfad Dfp_ETClbETFltInj4" VALUE 0xC8A9C Kw_Wu8 255.0 OneToOne 0.00 255.0 FORMAT "%5.1" /end CHARACTERISTIC
/begin CHARACTERISTIC DSM_FMKDfp_ETClbETFltInj5_C "Ausblendbedingungen fuer Fehlerpfad Dfp_ETClbETFltInj5" VALUE 0xC8A9D Kw_Wu8 255.0 OneToOne 0.00 255.0 FORMAT "%5.1" /end CHARACTERISTIC
/begin CHARACTERISTIC DSM_FMKDfp_ETClbETFltInj6_C "Ausblendbedingungen fuer Fehlerpfad Dfp_ETClbETFltInj6" VALUE 0xC8A9E Kw_Wu8 255.0 OneToOne 0.00 255.0 FORMAT "%5.1" /end CHARACTERISTIC
/begin CHARACTERISTIC DSM_FMKDfp_ETClbInj1_C "Ausblendbedingungen fuer Fehlerpfad Dfp_ETClbInj1" VALUE 0xC8A9F Kw_Wu8 255.0 OneToOne 0.00 255.0 FORMAT "%5.1" /end CHARACTERISTIC
/begin CHARACTERISTIC DSM_FMKDfp_ETClbInj2_C "Ausblendbedingungen fuer Fehlerpfad Dfp_ETClbInj2" VALUE 0xC8AA0 Kw_Wu8 255.0 OneToOne 0.00 255.0 FORMAT "%5.1" /end CHARACTERISTIC
/begin CHARACTERISTIC DSM_FMKDfp_ETClbInj3_C "Ausblendbedingungen fuer Fehlerpfad Dfp_ETClbInj3" VALUE 0xC8AA1 Kw_Wu8 255.0 OneToOne 0.00 255.0 FORMAT "%5.1" /end CHARACTERISTIC
/begin CHARACTERISTIC DSM_FMKDfp_ETClbInj4_C "Ausblendbedingungen fuer Fehlerpfad Dfp_ETClbInj4" VALUE 0xC8AA2 Kw_Wu8 255.0 OneToOne 0.00 255.0 FORMAT "%5.1" /end CHARACTERISTIC
/begin CHARACTERISTIC DSM_FMKDfp_ETClbInj5_C "Ausblendbedingungen fuer Fehlerpfad Dfp_ETClbInj5" VALUE 0xC8AA3 Kw_Wu8 255.0 OneToOne 0.00 255.0 FORMAT "%5.1" /end CHARACTERISTIC
/begin CHARACTERISTIC DSM_FMKDfp_ETClbInj6_C "Ausblendbedingungen fuer Fehlerpfad Dfp_ETClbInj6" VALUE 0xC8AA4 Kw_Wu8 255.0 OneToOne 0.00 255.0 FORMAT "%5.1" /end CHARACTERISTIC
/begin CHARACTERISTIC DSM_FMKDfp_EngMCaS1_C "Ausblendbedingungen fuer Fehlerpfad Dfp_EngMCaS1" VALUE 0xC8AA5 Kw_Wu8 255.0 OneToOne 0.00 255.0 FORMAT "%5.1" /end CHARACTERISTIC
/begin CHARACTERISTIC DSM_FMKDfp_EngMCrS1_C "Ausblendbedingungen fuer Fehlerpfad Dfp_EngMCrS1" VALUE 0xC8AA6 Kw_Wu8 255.0 OneToOne 0.00 255.0 FORMAT "%5.1" /end CHARACTERISTIC
/begin CHARACTERISTIC DSM_FMKDfp_EngMOfsCaSCrS_C "Ausblendbedingungen fuer Fehlerpfad Dfp_EngMOfsCaSCrS" VALUE 0xC8AA7 Kw_Wu8 255.0 OneToOne 0.00 255.0 FORMAT "%5.1" /end CHARACTERISTIC
/begin CHARACTERISTIC DSM_FMKDfp_EngMntCtl1_Dia1_C "" VALUE 0xC8AA8 Kw_Wu8 255.0 OneToOne 0.00 255.0 FORMAT "%5.1" /end CHARACTERISTIC
/begin CHARACTERISTIC DSM_FMKDfp_EngMntCtl1_Dia2_C "" VALUE 0xC8AA9 Kw_Wu8 255.0 OneToOne 0.00 255.0 FORMAT "%5.1" /end CHARACTERISTIC
/begin CHARACTERISTIC DSM_FMKDfp_EngMntCtl1_Dia3_C "" VALUE 0xC8AAA Kw_Wu8 255.0 OneToOne 0.00 255.0 FORMAT "%5.1" /end CHARACTERISTIC
/begin CHARACTERISTIC DSM_FMKDfp_EngMntCtl1_Max_C "" VALUE 0xC8AAB Kw_Wu8 255.0 OneToOne 0.00 255.0 FORMAT "%5.1" /end CHARACTERISTIC
/begin CHARACTERISTIC DSM_FMKDfp_EngMntCtl1_Min_C "" VALUE 0xC8AAC Kw_Wu8 255.0 OneToOne 0.00 255.0 FORMAT "%5.1" /end CHARACTERISTIC
/begin CHARACTERISTIC DSM_FMKDfp_EngMntCtl1_SigNpl_C "" VALUE 0xC8AAD Kw_Wu8 255.0 OneToOne 0.00 255.0 FORMAT "%5.1" /end CHARACTERISTIC
/begin CHARACTERISTIC DSM_FMKDfp_EngMntCtlCD_C "Ausblendbedingungen fuer Fehlerpfad Dfp_EngMntCtlCD" VALUE 0xC8AAE Kw_Wu8 255.0 OneToOne 0.00 255.0 FORMAT "%5.1" /end CHARACTERISTIC
/begin CHARACTERISTIC DSM_FMKDfp_EngMntCtl_Dia1_C "" VALUE 0xC8AAF Kw_Wu8 255.0 OneToOne 0.00 255.0 FORMAT "%5.1" /end CHARACTERISTIC
/begin CHARACTERISTIC DSM_FMKDfp_EngMntCtl_Dia2_C "" VALUE 0xC8AB0 Kw_Wu8 255.0 OneToOne 0.00 255.0 FORMAT "%5.1" /end CHARACTERISTIC
/begin CHARACTERISTIC DSM_FMKDfp_EngMntCtl_Dia3_C "" VALUE 0xC8AB1 Kw_Wu8 255.0 OneToOne 0.00 255.0 FORMAT "%5.1" /end CHARACTERISTIC
/begin CHARACTERISTIC DSM_FMKDfp_EngMntCtl_Max_C "" VALUE 0xC8AB2 Kw_Wu8 255.0 OneToOne 0.00 255.0 FORMAT "%5.1" /end CHARACTERISTIC
/begin CHARACTERISTIC DSM_FMKDfp_EngMntCtl_Min_C "" VALUE 0xC8AB3 Kw_Wu8 255.0 OneToOne 0.00 255.0 FORMAT "%5.1" /end CHARACTERISTIC
/begin CHARACTERISTIC DSM_FMKDfp_EngMntCtl_SigNpl_C "" VALUE 0xC8AB4 Kw_Wu8 255.0 OneToOne 0.00 255.0 FORMAT "%5.1" /end CHARACTERISTIC
/begin CHARACTERISTIC DSM_FMKDfp_EngPrtFWODet_C "Ausblendbedingungen fuer Fehlerpfad Dfp_EngPrtFWODet" VALUE 0xC8AB5 Kw_Wu8 255.0 OneToOne 0.00 255.0 FORMAT "%5.1" /end CHARACTERISTIC
/begin CHARACTERISTIC DSM_FMKDfp_FBCqDvt_C "Ausblendbedingungen fuer Fehlerpfad Dfp_FBCqDvt" VALUE 0xC8AB6 Kw_Wu8 255.0 OneToOne 0.00 255.0 FORMAT "%5.1" /end CHARACTERISTIC
/begin CHARACTERISTIC DSM_FMKDfp_FMTC_NonMonotonMap_C "Ausblendbedingungen fuer Fehlerpfad Dfp_FMTC_NonMonotonMap" VALUE 0xC8AB7 Kw_Wu8 255.0 OneToOne 0.00 255.0 FORMAT "%5.1" /end CHARACTERISTIC
/begin CHARACTERISTIC DSM_FMKDfp_FTSCD_C "Ausblendbedingungen fuer Fehlerpfad Dfp_FTSCD" VALUE 0xC8AB8 Kw_Wu8 255.0 OneToOne 0.00 255.0 FORMAT "%5.1" /end CHARACTERISTIC
/begin CHARACTERISTIC DSM_FMKDfp_FanCD_C "Ausblendbedingungen fuer Fehlerpfad Dfp_FanCD" VALUE 0xC8AB9 Kw_Wu8 255.0 OneToOne 0.00 255.0 FORMAT "%5.1" /end CHARACTERISTIC
/begin CHARACTERISTIC DSM_FMKDfp_FanCD_FanCtlr1_C "Ausblendbedingungen fuer Fehlerpfad Dfp_FanCD_FanCtlr1" VALUE 0xC8ABA Kw_Wu8 255.0 OneToOne 0.00 255.0 FORMAT "%5.1" /end CHARACTERISTIC
/begin CHARACTERISTIC DSM_FMKDfp_FanCD_FanCtlr2_C "Ausblendbedingungen fuer Fehlerpfad Dfp_FanCD_FanCtlr2" VALUE 0xC8ABB Kw_Wu8 255.0 OneToOne 0.00 255.0 FORMAT "%5.1" /end CHARACTERISTIC
/begin CHARACTERISTIC DSM_FMKDfp_FanCD_FanCtlr3_C "Ausblendbedingungen fuer Fehlerpfad Dfp_FanCD_FanCtlr3" VALUE 0xC8ABC Kw_Wu8 255.0 OneToOne 0.00 255.0 FORMAT "%5.1" /end CHARACTERISTIC
/begin CHARACTERISTIC DSM_FMKDfp_FlFCD_C "Ausblendbedingungen fuer Fehlerpfad Dfp_FlFCD" VALUE 0xC8ABD Kw_Wu8 255.0 OneToOne 0.00 255.0 FORMAT "%5.1" /end CHARACTERISTIC
/begin CHARACTERISTIC DSM_FMKDfp_FlMngSmkDefect_C "Ausblendbedingungen fuer Fehlerpfad Dfp_FlMngSmkDefect" VALUE 0xC8ABE Kw_Wu8 255.0 OneToOne 0.00 255.0 FORMAT "%5.1" /end CHARACTERISTIC
/begin CHARACTERISTIC DSM_FMKDfp_FrmMngBOS_RESET_C "Ausblendbedingungen fuer Fehlerpfad Dfp_FrmMngBOS_RESET" VALUE 0xC8ABF Kw_Wu8 255.0 OneToOne 0.00 255.0 FORMAT "%5.1" /end CHARACTERISTIC
/begin CHARACTERISTIC DSM_FMKDfp_FrmMngBOS_RESET_2_C "" VALUE 0xC8AC0 Kw_Wu8 255.0 OneToOne 0.00 255.0 FORMAT "%5.1" /end CHARACTERISTIC
/begin CHARACTERISTIC DSM_FMKDfp_FrmMngDMANFAFS_C "Ausblendbedingungen fuer Fehlerpfad Dfp_FrmMngDMANFAFS" VALUE 0xC8AC1 Kw_Wu8 255.0 OneToOne 0.00 255.0 FORMAT "%5.1" /end CHARACTERISTIC
/begin CHARACTERISTIC DSM_FMKDfp_FrmMngDRMANFSSG_C "Ausblendbedingungen fuer Fehlerpfad Dfp_FrmMngDRMANFSSG" VALUE 0xC8AC2 Kw_Wu8 255.0 OneToOne 0.00 255.0 FORMAT "%5.1" /end CHARACTERISTIC
/begin CHARACTERISTIC DSM_FMKDfp_FrmMngGEARBX_DATA_C "Ausblendbedingungen fuer Fehlerpfad Dfp_FrmMngGEARBX_DATA" VALUE 0xC8AC3 Kw_Wu8 255.0 OneToOne 0.00 255.0 FORMAT "%5.1" /end CHARACTERISTIC
/begin CHARACTERISTIC DSM_FMKDfp_FrmMngGEARBX_DATA2_C "Ausblendbedingungen fuer Fehlerpfad Dfp_FrmMngGEARBX_DATA2" VALUE 0xC8AC4 Kw_Wu8 255.0 OneToOne 0.00 255.0 FORMAT "%5.1" /end CHARACTERISTIC
/begin CHARACTERISTIC DSM_FMKDfp_FrmMngHEAT_AC_C "Ausblendbedingungen fuer Fehlerpfad Dfp_FrmMngHEAT_AC" VALUE 0xC8AC5 Kw_Wu8 255.0 OneToOne 0.00 255.0 FORMAT "%5.1" /end CHARACTERISTIC
/begin CHARACTERISTIC DSM_FMKDfp_FrmMngLENKRADWINKEL_C "Ausblendbedingungen fuer Fehlerpfad Dfp_FrmMngLENKRADWINKEL" VALUE 0xC8AC6 Kw_Wu8 255.0 OneToOne 0.00 255.0 FORMAT "%5.1" /end CHARACTERISTIC
/begin CHARACTERISTIC DSM_FMKDfp_FrmMngMILEAGE_RANGE_C "Ausblendbedingungen fuer Fehlerpfad Dfp_FrmMngMILEAGE_RANGE" VALUE 0xC8AC7 Kw_Wu8 255.0 OneToOne 0.00 255.0 FORMAT "%5.1" /end CHARACTERISTIC
/begin CHARACTERISTIC DSM_FMKDfp_FrmMngOPCRCTLACC_C "Ausblendbedingungen fuer Fehlerpfad Dfp_FrmMngOPCRCTLACC" VALUE 0xC8AC8 Kw_Wu8 255.0 OneToOne 0.00 255.0 FORMAT "%5.1" /end CHARACTERISTIC
/begin CHARACTERISTIC DSM_FMKDfp_FrmMngPRGG_CCTR_C "Ausblendbedingungen fuer Fehlerpfad Dfp_FrmMngPRGG_CCTR" VALUE 0xC8AC9 Kw_Wu8 255.0 OneToOne 0.00 255.0 FORMAT "%5.1" /end CHARACTERISTIC
/begin CHARACTERISTIC DSM_FMKDfp_FrmMngPWRMNG_LOADV_C "Ausblendbedingungen fuer Fehlerpfad Dfp_FrmMngPWRMNG_LOADV" VALUE 0xC8ACA Kw_Wu8 255.0 OneToOne 0.00 255.0 FORMAT "%5.1" /end CHARACTERISTIC
/begin CHARACTERISTIC DSM_FMKDfp_FrmMngParkConsumer_C "Ausblendbedingungen fuer Fehlerpfad Dfp_FrmMngParkConsumer" VALUE 0xC8ACB Kw_Wu8 255.0 OneToOne 0.00 255.0 FORMAT "%5.1" /end CHARACTERISTIC
/begin CHARACTERISTIC DSM_FMKDfp_FrmMngRQSTGEFAN_C "RQ_STG_EFAN - CAN-message related errors" VALUE 0xC8ACC Kw_Wu8 255.0 OneToOne 0.00 255.0 FORMAT "%5.1" /end CHARACTERISTIC
/begin CHARACTERISTIC DSM_FMKDfp_FrmMngSSGErr_C "Ausblendbedingungen fuer Fehlerpfad Dfp_FrmMngSSGErr" VALUE 0xC8ACD Kw_Wu8 255.0 OneToOne 0.00 255.0 FORMAT "%5.1" /end CHARACTERISTIC
/begin CHARACTERISTIC DSM_FMKDfp_FrmMngSSGShOff_C "Ausblendbedingungen fuer Fehlerpfad Dfp_FrmMngSSGShOff" VALUE 0xC8ACE Kw_Wu8 255.0 OneToOne 0.00 255.0 FORMAT "%5.1" /end CHARACTERISTIC
/begin CHARACTERISTIC DSM_FMKDfp_FrmMngSTAT_ANH_C "Ausblendbedingungen fuer Fehlerpfad Dfp_FrmMngSTAT_ANH" VALUE 0xC8ACF Kw_Wu8 255.0 OneToOne 0.00 255.0 FORMAT "%5.1" /end CHARACTERISTIC
/begin CHARACTERISTIC DSM_FMKDfp_FrmMngSTAT_ARS_C "Ausblendbedingungen fuer Fehlerpfad Dfp_FrmMngSTAT_ARS" VALUE 0xC8AD0 Kw_Wu8 255.0 OneToOne 0.00 255.0 FORMAT "%5.1" /end CHARACTERISTIC
/begin CHARACTERISTIC DSM_FMKDfp_FrmMngSTAT_DSC_C "Ausblendbedingungen fuer Fehlerpfad Dfp_FrmMngSTAT_DSC" VALUE 0xC8AD1 Kw_Wu8 255.0 OneToOne 0.00 255.0 FORMAT "%5.1" /end CHARACTERISTIC
/begin CHARACTERISTIC DSM_FMKDfp_FrmMngSTAT_EKP_C "Ausblendbedingungen fuer Fehlerpfad Dfp_FrmMngSTAT_EKP" VALUE 0xC8AD2 Kw_Wu8 255.0 OneToOne 0.00 255.0 FORMAT "%5.1" /end CHARACTERISTIC
/begin CHARACTERISTIC DSM_FMKDfp_FrmMngSTAT_KOMBI_C "Ausblendbedingungen fuer Fehlerpfad Dfp_FrmMngSTAT_KOMBI" VALUE 0xC8AD3 Kw_Wu8 255.0 OneToOne 0.00 255.0 FORMAT "%5.1" /end CHARACTERISTIC
/begin CHARACTERISTIC DSM_FMKDfp_FrmMngSTAT_SITZ_C "Ausblendbedingungen fuer Fehlerpfad  Dfp_FrmMngSTAT_SITZ" VALUE 0xC8AD4 Kw_Wu8 255.0 OneToOne 0.00 255.0 FORMAT "%5.1" /end CHARACTERISTIC
/begin CHARACTERISTIC DSM_FMKDfp_FrmMngStOBDGbxMilOf_C "Ausblendbedingungen fuer Fehlerpfad Dfp_FrmMngStOBDGbxMilOf" VALUE 0xC8AD5 Kw_Wu8 255.0 OneToOne 0.00 255.0 FORMAT "%5.1" /end CHARACTERISTIC
/begin CHARACTERISTIC DSM_FMKDfp_FrmMngStOBDGbxMilOn_C "Ausblendbedingungen fuer Fehlerpfad Dfp_FrmMngStOBDGbxMilOn" VALUE 0xC8AD6 Kw_Wu8 255.0 OneToOne 0.00 255.0 FORMAT "%5.1" /end CHARACTERISTIC
/begin CHARACTERISTIC DSM_FMKDfp_FrmMngTEMPRELTIME_C "Ausblendbedingungen fuer Fehlerpfad Dfp_FrmMngTEMPRELTIME" VALUE 0xC8AD7 Kw_Wu8 255.0 OneToOne 0.00 255.0 FORMAT "%5.1" /end CHARACTERISTIC
/begin CHARACTERISTIC DSM_FMKDfp_FrmMngTERMINAL_C "Ausblendbedingungen fuer Fehlerpfad Dfp_FrmMngTERMINAL" VALUE 0xC8AD8 Kw_Wu8 255.0 OneToOne 0.00 255.0 FORMAT "%5.1" /end CHARACTERISTIC
/begin CHARACTERISTIC DSM_FMKDfp_FrmMngTIME_DATE_C "Ausblendbedingungen fuer Fehlerpfad Dfp_FrmMngTIME_DATE" VALUE 0xC8AD9 Kw_Wu8 255.0 OneToOne 0.00 255.0 FORMAT "%5.1" /end CHARACTERISTIC
/begin CHARACTERISTIC DSM_FMKDfp_FrmMngTORQUE_DSC_C "Ausblendbedingungen fuer Fehlerpfad Dfp_FrmMngTORQUE_DSC" VALUE 0xC8ADA Kw_Wu8 255.0 OneToOne 0.00 255.0 FORMAT "%5.1" /end CHARACTERISTIC
/begin CHARACTERISTIC DSM_FMKDfp_FrmMngTORQUE_GEARBX_C "Ausblendbedingungen fuer Fehlerpfad Dfp_FrmMngTORQUE_GEARBX" VALUE 0xC8ADB Kw_Wu8 255.0 OneToOne 0.00 255.0 FORMAT "%5.1" /end CHARACTERISTIC
/begin CHARACTERISTIC DSM_FMKDfp_FrmMngTrq_ReqACC_C "Ausblendbedingungen fuer Fehlerpfad Dfp_FrmMngTrq_ReqACC" VALUE 0xC8ADC Kw_Wu8 255.0 OneToOne 0.00 255.0 FORMAT "%5.1" /end CHARACTERISTIC
/begin CHARACTERISTIC DSM_FMKDfp_FrmMngVEH_MOD_C "VEH_MOD - CAN-message related errors" VALUE 0xC8ADD Kw_Wu8 255.0 OneToOne 0.00 255.0 FORMAT "%5.1" /end CHARACTERISTIC
/begin CHARACTERISTIC DSM_FMKDfp_FrmMngVELOCITY_C "Ausblendbedingungen fuer Fehlerpfad Dfp_FrmMngVELOCITY" VALUE 0xC8ADE Kw_Wu8 255.0 OneToOne 0.00 255.0 FORMAT "%5.1" /end CHARACTERISTIC
/begin CHARACTERISTIC DSM_FMKDfp_FrmMngWHEEL_SPEED_C "Ausblendbedingungen fuer Fehlerpfad Dfp_FrmMngWHEEL_SPEED" VALUE 0xC8ADF Kw_Wu8 255.0 OneToOne 0.00 255.0 FORMAT "%5.1" /end CHARACTERISTIC
/begin CHARACTERISTIC DSM_FMKDfp_FrmMngstCurr_C "Maskenlabel für Dfp_FrmMngstCurr" VALUE 0xC8AE0 Kw_Wu8 255.0 OneToOne 0.00 255.0 FORMAT "%5.1" /end CHARACTERISTIC
/begin CHARACTERISTIC DSM_FMKDfp_FrmMngswtPSPOff_C "Maskenlabel für Dfp_FrmMngswtPSPOff" VALUE 0xC8AE1 Kw_Wu8 255.0 OneToOne 0.00 255.0 FORMAT "%5.1" /end CHARACTERISTIC
/begin CHARACTERISTIC DSM_FMKDfp_GearbxIncMax_C "Ausblendbedingungen fuer Fehlerpfad Dfp_GearbxIncMax" VALUE 0xC8AE2 Kw_Wu8 255.0 OneToOne 0.00 255.0 FORMAT "%5.1" /end CHARACTERISTIC
/begin CHARACTERISTIC DSM_FMKDfp_GlwCD_C "Ausblendbedingungen fuer Fehlerpfad Dfp_GlwCD" VALUE 0xC8AE3 Kw_Wu8 255.0 OneToOne 0.00 255.0 FORMAT "%5.1" /end CHARACTERISTIC
/begin CHARACTERISTIC DSM_FMKDfp_GlwCDGlwCirc1_C "Ausblendbedingungen fuer Fehlerpfad Dfp_GlwCDGlwCirc1" VALUE 0xC8AE4 Kw_Wu8 255.0 OneToOne 0.00 255.0 FORMAT "%5.1" /end CHARACTERISTIC
/begin CHARACTERISTIC DSM_FMKDfp_GlwCDGlwCirc2_C "Ausblendbedingungen fuer Fehlerpfad Dfp_GlwCDGlwCirc2" VALUE 0xC8AE5 Kw_Wu8 255.0 OneToOne 0.00 255.0 FORMAT "%5.1" /end CHARACTERISTIC
/begin CHARACTERISTIC DSM_FMKDfp_GlwCDGlwCirc3_C "Ausblendbedingungen fuer Fehlerpfad Dfp_GlwCDGlwCirc3" VALUE 0xC8AE6 Kw_Wu8 255.0 OneToOne 0.00 255.0 FORMAT "%5.1" /end CHARACTERISTIC
/begin CHARACTERISTIC DSM_FMKDfp_GlwCDGlwCirc4_C "Ausblendbedingungen fuer Fehlerpfad Dfp_GlwCDGlwCirc4" VALUE 0xC8AE7 Kw_Wu8 255.0 OneToOne 0.00 255.0 FORMAT "%5.1" /end CHARACTERISTIC
/begin CHARACTERISTIC DSM_FMKDfp_GlwCDGlwCirc5_C "Ausblendbedingungen fuer Fehlerpfad Dfp_GlwCDGlwCirc5" VALUE 0xC8AE8 Kw_Wu8 255.0 OneToOne 0.00 255.0 FORMAT "%5.1" /end CHARACTERISTIC
/begin CHARACTERISTIC DSM_FMKDfp_GlwCDGlwCirc6_C "Ausblendbedingungen fuer Fehlerpfad Dfp_GlwCDGlwCirc6" VALUE 0xC8AE9 Kw_Wu8 255.0 OneToOne 0.00 255.0 FORMAT "%5.1" /end CHARACTERISTIC
/begin CHARACTERISTIC DSM_FMKDfp_GlwCDGlwCirc7_C "Ausblendbedingungen fuer Fehlerpfad Dfp_GlwCDGlwCirc7" VALUE 0xC8AEA Kw_Wu8 255.0 OneToOne 0.00 255.0 FORMAT "%5.1" /end CHARACTERISTIC
/begin CHARACTERISTIC DSM_FMKDfp_GlwCDGlwCirc8_C "Ausblendbedingungen fuer Fehlerpfad Dfp_GlwCDGlwCirc8" VALUE 0xC8AEB Kw_Wu8 255.0 OneToOne 0.00 255.0 FORMAT "%5.1" /end CHARACTERISTIC
/begin CHARACTERISTIC DSM_FMKDfp_GlwCtl_C "Ausblendbedingungen fuer Fehlerpfad Dfp_GlwCtl" VALUE 0xC8AEC Kw_Wu8 255.0 OneToOne 0.00 255.0 FORMAT "%5.1" /end CHARACTERISTIC
/begin CHARACTERISTIC DSM_FMKDfp_HWEMonCom_C "Ausblendbedingungen fuer Fehlerpfad Dfp_HWEMonCom" VALUE 0xC8AED Kw_Wu8 255.0 OneToOne 0.00 255.0 FORMAT "%5.1" /end CHARACTERISTIC
/begin CHARACTERISTIC DSM_FMKDfp_HWEMonEEPROM_C "Ausblendbedingungen fuer Fehlerpfad Dfp_HWEMonEEPROM" VALUE 0xC8AEE Kw_Wu8 255.0 OneToOne 0.00 255.0 FORMAT "%5.1" /end CHARACTERISTIC
/begin CHARACTERISTIC DSM_FMKDfp_HWEMonRcyLocked_C "Ausblendbedingungen fuer Fehlerpfad Dfp_HWEMonRcyLocked" VALUE 0xC8AEF Kw_Wu8 255.0 OneToOne 0.00 255.0 FORMAT "%5.1" /end CHARACTERISTIC
/begin CHARACTERISTIC DSM_FMKDfp_HWEMonRcySuppressed_C "Ausblendbedingungen fuer Fehlerpfad Dfp_HWEMonRcySuppressed" VALUE 0xC8AF0 Kw_Wu8 255.0 OneToOne 0.00 255.0 FORMAT "%5.1" /end CHARACTERISTIC
/begin CHARACTERISTIC DSM_FMKDfp_HWEMonRcyVisible_C "Ausblendbedingungen fuer Fehlerpfad Dfp_HWEMonRcyVisible" VALUE 0xC8AF1 Kw_Wu8 255.0 OneToOne 0.00 255.0 FORMAT "%5.1" /end CHARACTERISTIC
/begin CHARACTERISTIC DSM_FMKDfp_HWEMonUMaxSupply_C "Ausblendbedingungen fuer Fehlerpfad Dfp_HWEMonUMaxSupply" VALUE 0xC8AF2 Kw_Wu8 255.0 OneToOne 0.00 255.0 FORMAT "%5.1" /end CHARACTERISTIC
/begin CHARACTERISTIC DSM_FMKDfp_HWEMonUMinSupply_C "Ausblendbedingungen fuer Fehlerpfad Dfp_HWEMonUMinSupply" VALUE 0xC8AF3 Kw_Wu8 255.0 OneToOne 0.00 255.0 FORMAT "%5.1" /end CHARACTERISTIC
/begin CHARACTERISTIC DSM_FMKDfp_IATSCD_C "Ausblendbedingungen fuer Fehlerpfad Dfp_IATSCD" VALUE 0xC8AF4 Kw_Wu8 255.0 OneToOne 0.00 255.0 FORMAT "%5.1" /end CHARACTERISTIC
/begin CHARACTERISTIC DSM_FMKDfp_IATSCD_CATS_C "Ausblendbedingungen fuer Fehlerpfad Dfp_IATSCD_CATS" VALUE 0xC8AF5 Kw_Wu8 255.0 OneToOne 0.00 255.0 FORMAT "%5.1" /end CHARACTERISTIC
/begin CHARACTERISTIC DSM_FMKDfp_ImmCtlImmCD_C "Ausblendbedingungen fuer Fehlerpfad Dfp_ImmCtlImmCD" VALUE 0xC8AF6 Kw_Wu8 255.0 OneToOne 0.00 255.0 FORMAT "%5.1" /end CHARACTERISTIC
/begin CHARACTERISTIC DSM_FMKDfp_ImmCtlImmEep_C "Ausblendbedingungen fuer Fehlerpfad Dfp_ImmCtlImmEep" VALUE 0xC8AF7 Kw_Wu8 255.0 OneToOne 0.00 255.0 FORMAT "%5.1" /end CHARACTERISTIC
/begin CHARACTERISTIC DSM_FMKDfp_ImmCtlMpl_C "Ausblendbedingungen fuer Fehlerpfad Dfp_ImmCtlMpl" VALUE 0xC8AF8 Kw_Wu8 255.0 OneToOne 0.00 255.0 FORMAT "%5.1" /end CHARACTERISTIC
/begin CHARACTERISTIC DSM_FMKDfp_IndSys1_C "Ausblendbedingungen fuer Fehlerpfad Dfp_IndSys1" VALUE 0xC8AF9 Kw_Wu8 255.0 OneToOne 0.00 255.0 FORMAT "%5.1" /end CHARACTERISTIC
/begin CHARACTERISTIC DSM_FMKDfp_IndSys2_C "Ausblendbedingungen fuer Fehlerpfad Dfp_IndSys2" VALUE 0xC8AFA Kw_Wu8 255.0 OneToOne 0.00 255.0 FORMAT "%5.1" /end CHARACTERISTIC
/begin CHARACTERISTIC DSM_FMKDfp_InjCrv_InjLim_C "Ausblendbedingungen fuer Fehlerpfad Dfp_InjCrv_InjLim" VALUE 0xC8AFB Kw_Wu8 255.0 OneToOne 0.00 255.0 FORMAT "%5.1" /end CHARACTERISTIC
/begin CHARACTERISTIC DSM_FMKDfp_InjCtlAdjQnt_C "Ausblendbedingungen fuer Fehlerpfad Dfp_InjCtlAdjQnt" VALUE 0xC8AFC Kw_Wu8 255.0 OneToOne 0.00 255.0 FORMAT "%5.1" /end CHARACTERISTIC
/begin CHARACTERISTIC DSM_FMKDfp_InjCtlDrift_C "Ausblendbedingungen fuer Fehlerpfad Dfp_InjCtlDrift" VALUE 0xC8AFD Kw_Wu8 255.0 OneToOne 0.00 255.0 FORMAT "%5.1" /end CHARACTERISTIC
/begin CHARACTERISTIC DSM_FMKDfp_InjVCDActrChrg_C "Ausblendbedingungen fuer Fehlerpfad Dfp_InjVCDActrChrg" VALUE 0xC8AFE Kw_Wu8 255.0 OneToOne 0.00 255.0 FORMAT "%5.1" /end CHARACTERISTIC
/begin CHARACTERISTIC DSM_FMKDfp_InjVCDActrEnrg1_C "Ausblendbedingungen fuer Fehlerpfad Dfp_InjVCDActrEnrg1" VALUE 0xC8AFF Kw_Wu8 255.0 OneToOne 0.00 255.0 FORMAT "%5.1" /end CHARACTERISTIC
/begin CHARACTERISTIC DSM_FMKDfp_InjVCDActrEnrg2_C "Ausblendbedingungen fuer Fehlerpfad Dfp_InjVCDActrEnrg2" VALUE 0xC8B00 Kw_Wu8 255.0 OneToOne 0.00 255.0 FORMAT "%5.1" /end CHARACTERISTIC
/begin CHARACTERISTIC DSM_FMKDfp_InjVCDActrEnrg3_C "Ausblendbedingungen fuer Fehlerpfad Dfp_InjVCDActrEnrg3" VALUE 0xC8B01 Kw_Wu8 255.0 OneToOne 0.00 255.0 FORMAT "%5.1" /end CHARACTERISTIC
/begin CHARACTERISTIC DSM_FMKDfp_InjVCDActrEnrg4_C "Ausblendbedingungen fuer Fehlerpfad Dfp_InjVCDActrEnrg4" VALUE 0xC8B02 Kw_Wu8 255.0 OneToOne 0.00 255.0 FORMAT "%5.1" /end CHARACTERISTIC
/begin CHARACTERISTIC DSM_FMKDfp_InjVCDActrEnrg5_C "Ausblendbedingungen fuer Fehlerpfad Dfp_InjVCDActrEnrg5" VALUE 0xC8B03 Kw_Wu8 255.0 OneToOne 0.00 255.0 FORMAT "%5.1" /end CHARACTERISTIC
/begin CHARACTERISTIC DSM_FMKDfp_InjVCDActrEnrg6_C "Ausblendbedingungen fuer Fehlerpfad Dfp_InjVCDActrEnrg6" VALUE 0xC8B04 Kw_Wu8 255.0 OneToOne 0.00 255.0 FORMAT "%5.1" /end CHARACTERISTIC
/begin CHARACTERISTIC DSM_FMKDfp_InjVCDActrEnrg7_C "Ausblendbedingungen fuer Fehlerpfad Dfp_InjVCDActrEnrg7" VALUE 0xC8B05 Kw_Wu8 255.0 OneToOne 0.00 255.0 FORMAT "%5.1" /end CHARACTERISTIC
/begin CHARACTERISTIC DSM_FMKDfp_InjVCDActrEnrg8_C "Ausblendbedingungen fuer Fehlerpfad Dfp_InjVCDActrEnrg8" VALUE 0xC8B06 Kw_Wu8 255.0 OneToOne 0.00 255.0 FORMAT "%5.1" /end CHARACTERISTIC
/begin CHARACTERISTIC DSM_FMKDfp_InjVCDActrVolt_C "Ausblendbedingungen fuer Fehlerpfad Dfp_InjVCDActrVolt" VALUE 0xC8B07 Kw_Wu8 255.0 OneToOne 0.00 255.0 FORMAT "%5.1" /end CHARACTERISTIC
/begin CHARACTERISTIC DSM_FMKDfp_InjVCDClsBank1_C "Ausblendbedingungen fuer Fehlerpfad Dfp_InjVCDClsBank1" VALUE 0xC8B08 Kw_Wu8 255.0 OneToOne 0.00 255.0 FORMAT "%5.1" /end CHARACTERISTIC
/begin CHARACTERISTIC DSM_FMKDfp_InjVCDClsBank2_C "Ausblendbedingungen fuer Fehlerpfad Dfp_InjVCDClsBank2" VALUE 0xC8B09 Kw_Wu8 255.0 OneToOne 0.00 255.0 FORMAT "%5.1" /end CHARACTERISTIC
/begin CHARACTERISTIC DSM_FMKDfp_InjVCDMonCab_C "Ausblendbedingungen fuer Fehlerpfad Dfp_InjVCDMonCab" VALUE 0xC8B0A Kw_Wu8 255.0 OneToOne 0.00 255.0 FORMAT "%5.1" /end CHARACTERISTIC
/begin CHARACTERISTIC DSM_FMKDfp_InjVCDMonSwt_C "Ausblendbedingungen fuer Fehlerpfad Dfp_InjVCDMonSwt" VALUE 0xC8B0B Kw_Wu8 255.0 OneToOne 0.00 255.0 FORMAT "%5.1" /end CHARACTERISTIC
/begin CHARACTERISTIC DSM_FMKDfp_InjVCDShOffDCDC_C "Ausblendbedingungen fuer Fehlerpfad Dfp_InjVCDShOffDCDC" VALUE 0xC8B0C Kw_Wu8 255.0 OneToOne 0.00 255.0 FORMAT "%5.1" /end CHARACTERISTIC
/begin CHARACTERISTIC DSM_FMKDfp_InjVCDUBuf_C "Ausblendbedingungen fuer Fehlerpfad Dfp_InjVCDUBuf" VALUE 0xC8B0D Kw_Wu8 255.0 OneToOne 0.00 255.0 FORMAT "%5.1" /end CHARACTERISTIC
/begin CHARACTERISTIC DSM_FMKDfp_InjVCD_CY370Ampl_C "Ausblendbedingungen fuer Fehlerpfad Dfp_InjVCD_CY370Ampl" VALUE 0xC8B0E Kw_Wu8 255.0 OneToOne 0.00 255.0 FORMAT "%5.1" /end CHARACTERISTIC
/begin CHARACTERISTIC DSM_FMKDfp_InjVlvBnk1A_C "Ausblendbedingungen fuer Fehlerpfad Dfp_InjVlvBnk1A" VALUE 0xC8B0F Kw_Wu8 255.0 OneToOne 0.00 255.0 FORMAT "%5.1" /end CHARACTERISTIC
/begin CHARACTERISTIC DSM_FMKDfp_InjVlvBnk1B_C "Ausblendbedingungen fuer Fehlerpfad Dfp_InjVlvBnk1B" VALUE 0xC8B10 Kw_Wu8 255.0 OneToOne 0.00 255.0 FORMAT "%5.1" /end CHARACTERISTIC
/begin CHARACTERISTIC DSM_FMKDfp_InjVlvBnk2A_C "Ausblendbedingungen fuer Fehlerpfad Dfp_InjVlvBnk2A" VALUE 0xC8B11 Kw_Wu8 255.0 OneToOne 0.00 255.0 FORMAT "%5.1" /end CHARACTERISTIC
/begin CHARACTERISTIC DSM_FMKDfp_InjVlvBnk2B_C "Ausblendbedingungen fuer Fehlerpfad Dfp_InjVlvBnk2B" VALUE 0xC8B12 Kw_Wu8 255.0 OneToOne 0.00 255.0 FORMAT "%5.1" /end CHARACTERISTIC
/begin CHARACTERISTIC DSM_FMKDfp_InjVlvChipA_C "Ausblendbedingungen fuer Fehlerpfad Dfp_InjVlvChipA" VALUE 0xC8B13 Kw_Wu8 255.0 OneToOne 0.00 255.0 FORMAT "%5.1" /end CHARACTERISTIC
/begin CHARACTERISTIC DSM_FMKDfp_InjVlvChipB_C "Ausblendbedingungen fuer Fehlerpfad Dfp_InjVlvChipB" VALUE 0xC8B14 Kw_Wu8 255.0 OneToOne 0.00 255.0 FORMAT "%5.1" /end CHARACTERISTIC
/begin CHARACTERISTIC DSM_FMKDfp_InjVlvCyl1A_C "Ausblendbedingungen fuer Fehlerpfad Dfp_InjVlvCyl1A" VALUE 0xC8B15 Kw_Wu8 255.0 OneToOne 0.00 255.0 FORMAT "%5.1" /end CHARACTERISTIC
/begin CHARACTERISTIC DSM_FMKDfp_InjVlvCyl1B_C "Ausblendbedingungen fuer Fehlerpfad Dfp_InjVlvCyl1B" VALUE 0xC8B16 Kw_Wu8 255.0 OneToOne 0.00 255.0 FORMAT "%5.1" /end CHARACTERISTIC
/begin CHARACTERISTIC DSM_FMKDfp_InjVlvCyl1C_C "Ausblendbedingungen fuer Fehlerpfad Dfp_InjVlvCyl1C" VALUE 0xC8B17 Kw_Wu8 255.0 OneToOne 0.00 255.0 FORMAT "%5.1" /end CHARACTERISTIC
/begin CHARACTERISTIC DSM_FMKDfp_InjVlvCyl2A_C "Ausblendbedingungen fuer Fehlerpfad Dfp_InjVlvCyl2A" VALUE 0xC8B18 Kw_Wu8 255.0 OneToOne 0.00 255.0 FORMAT "%5.1" /end CHARACTERISTIC
/begin CHARACTERISTIC DSM_FMKDfp_InjVlvCyl2B_C "Ausblendbedingungen fuer Fehlerpfad Dfp_InjVlvCyl2B" VALUE 0xC8B19 Kw_Wu8 255.0 OneToOne 0.00 255.0 FORMAT "%5.1" /end CHARACTERISTIC
/begin CHARACTERISTIC DSM_FMKDfp_InjVlvCyl2C_C "Ausblendbedingungen fuer Fehlerpfad Dfp_InjVlvCyl2C" VALUE 0xC8B1A Kw_Wu8 255.0 OneToOne 0.00 255.0 FORMAT "%5.1" /end CHARACTERISTIC
/begin CHARACTERISTIC DSM_FMKDfp_InjVlvCyl3A_C "Ausblendbedingungen fuer Fehlerpfad Dfp_InjVlvCyl3A" VALUE 0xC8B1B Kw_Wu8 255.0 OneToOne 0.00 255.0 FORMAT "%5.1" /end CHARACTERISTIC
/begin CHARACTERISTIC DSM_FMKDfp_InjVlvCyl3B_C "Ausblendbedingungen fuer Fehlerpfad Dfp_InjVlvCyl3B" VALUE 0xC8B1C Kw_Wu8 255.0 OneToOne 0.00 255.0 FORMAT "%5.1" /end CHARACTERISTIC
/begin CHARACTERISTIC DSM_FMKDfp_InjVlvCyl3C_C "Ausblendbedingungen fuer Fehlerpfad Dfp_InjVlvCyl3C" VALUE 0xC8B1D Kw_Wu8 255.0 OneToOne 0.00 255.0 FORMAT "%5.1" /end CHARACTERISTIC
/begin CHARACTERISTIC DSM_FMKDfp_InjVlvCyl4A_C "Ausblendbedingungen fuer Fehlerpfad Dfp_InjVlvCyl4A" VALUE 0xC8B1E Kw_Wu8 255.0 OneToOne 0.00 255.0 FORMAT "%5.1" /end CHARACTERISTIC
/begin CHARACTERISTIC DSM_FMKDfp_InjVlvCyl4B_C "Ausblendbedingungen fuer Fehlerpfad Dfp_InjVlvCyl4B" VALUE 0xC8B1F Kw_Wu8 255.0 OneToOne 0.00 255.0 FORMAT "%5.1" /end CHARACTERISTIC
/begin CHARACTERISTIC DSM_FMKDfp_InjVlvCyl4C_C "Ausblendbedingungen fuer Fehlerpfad Dfp_InjVlvCyl4C" VALUE 0xC8B20 Kw_Wu8 255.0 OneToOne 0.00 255.0 FORMAT "%5.1" /end CHARACTERISTIC
/begin CHARACTERISTIC DSM_FMKDfp_InjVlvCyl5A_C "Ausblendbedingungen fuer Fehlerpfad Dfp_InjVlvCyl5A" VALUE 0xC8B21 Kw_Wu8 255.0 OneToOne 0.00 255.0 FORMAT "%5.1" /end CHARACTERISTIC
/begin CHARACTERISTIC DSM_FMKDfp_InjVlvCyl5B_C "Ausblendbedingungen fuer Fehlerpfad Dfp_InjVlvCyl5B" VALUE 0xC8B22 Kw_Wu8 255.0 OneToOne 0.00 255.0 FORMAT "%5.1" /end CHARACTERISTIC
/begin CHARACTERISTIC DSM_FMKDfp_InjVlvCyl5C_C "Ausblendbedingungen fuer Fehlerpfad Dfp_InjVlvCyl5C" VALUE 0xC8B23 Kw_Wu8 255.0 OneToOne 0.00 255.0 FORMAT "%5.1" /end CHARACTERISTIC
/begin CHARACTERISTIC DSM_FMKDfp_InjVlvCyl6A_C "Ausblendbedingungen fuer Fehlerpfad Dfp_InjVlvCyl6A" VALUE 0xC8B24 Kw_Wu8 255.0 OneToOne 0.00 255.0 FORMAT "%5.1" /end CHARACTERISTIC
/begin CHARACTERISTIC DSM_FMKDfp_InjVlvCyl6B_C "Ausblendbedingungen fuer Fehlerpfad Dfp_InjVlvCyl6B" VALUE 0xC8B25 Kw_Wu8 255.0 OneToOne 0.00 255.0 FORMAT "%5.1" /end CHARACTERISTIC
/begin CHARACTERISTIC DSM_FMKDfp_InjVlvCyl6C_C "Ausblendbedingungen fuer Fehlerpfad Dfp_InjVlvCyl6C" VALUE 0xC8B26 Kw_Wu8 255.0 OneToOne 0.00 255.0 FORMAT "%5.1" /end CHARACTERISTIC
/begin CHARACTERISTIC DSM_FMKDfp_InjVlvCyl7A_C "Ausblendbedingungen fuer Fehlerpfad Dfp_InjVlvCyl7A" VALUE 0xC8B27 Kw_Wu8 255.0 OneToOne 0.00 255.0 FORMAT "%5.1" /end CHARACTERISTIC
/begin CHARACTERISTIC DSM_FMKDfp_InjVlvCyl7B_C "Ausblendbedingungen fuer Fehlerpfad Dfp_InjVlvCyl7B" VALUE 0xC8B28 Kw_Wu8 255.0 OneToOne 0.00 255.0 FORMAT "%5.1" /end CHARACTERISTIC
/begin CHARACTERISTIC DSM_FMKDfp_InjVlvCyl7C_C "Ausblendbedingungen fuer Fehlerpfad Dfp_InjVlvCyl7C" VALUE 0xC8B29 Kw_Wu8 255.0 OneToOne 0.00 255.0 FORMAT "%5.1" /end CHARACTERISTIC
/begin CHARACTERISTIC DSM_FMKDfp_InjVlvCyl8A_C "Ausblendbedingungen fuer Fehlerpfad Dfp_InjVlvCyl8A" VALUE 0xC8B2A Kw_Wu8 255.0 OneToOne 0.00 255.0 FORMAT "%5.1" /end CHARACTERISTIC
/begin CHARACTERISTIC DSM_FMKDfp_InjVlvCyl8B_C "Ausblendbedingungen fuer Fehlerpfad Dfp_InjVlvCyl8B" VALUE 0xC8B2B Kw_Wu8 255.0 OneToOne 0.00 255.0 FORMAT "%5.1" /end CHARACTERISTIC
/begin CHARACTERISTIC DSM_FMKDfp_InjVlvCyl8C_C "Ausblendbedingungen fuer Fehlerpfad Dfp_InjVlvCyl8C" VALUE 0xC8B2C Kw_Wu8 255.0 OneToOne 0.00 255.0 FORMAT "%5.1" /end CHARACTERISTIC
/begin CHARACTERISTIC DSM_FMKDfp_InjVlvNVC1_C "Ausblendbedingungen fuer Fehlerpfad Dfp_InjVlvNVC1" VALUE 0xC8B2D Kw_Wu8 255.0 OneToOne 0.00 255.0 FORMAT "%5.1" /end CHARACTERISTIC
/begin CHARACTERISTIC DSM_FMKDfp_InjVlvNVC2_C "Ausblendbedingungen fuer Fehlerpfad Dfp_InjVlvNVC2" VALUE 0xC8B2E Kw_Wu8 255.0 OneToOne 0.00 255.0 FORMAT "%5.1" /end CHARACTERISTIC
/begin CHARACTERISTIC DSM_FMKDfp_InjVlvNVC3_C "Ausblendbedingungen fuer Fehlerpfad Dfp_InjVlvNVC3" VALUE 0xC8B2F Kw_Wu8 255.0 OneToOne 0.00 255.0 FORMAT "%5.1" /end CHARACTERISTIC
/begin CHARACTERISTIC DSM_FMKDfp_InjVlvNVC4_C "Ausblendbedingungen fuer Fehlerpfad Dfp_InjVlvNVC4" VALUE 0xC8B30 Kw_Wu8 255.0 OneToOne 0.00 255.0 FORMAT "%5.1" /end CHARACTERISTIC
/begin CHARACTERISTIC DSM_FMKDfp_InjVlvNVC5_C "Ausblendbedingungen fuer Fehlerpfad Dfp_InjVlvNVC5" VALUE 0xC8B31 Kw_Wu8 255.0 OneToOne 0.00 255.0 FORMAT "%5.1" /end CHARACTERISTIC
/begin CHARACTERISTIC DSM_FMKDfp_InjVlvNVC6_C "Ausblendbedingungen fuer Fehlerpfad Dfp_InjVlvNVC6" VALUE 0xC8B32 Kw_Wu8 255.0 OneToOne 0.00 255.0 FORMAT "%5.1" /end CHARACTERISTIC
/begin CHARACTERISTIC DSM_FMKDfp_InjVlvNVC7_C "Ausblendbedingungen fuer Fehlerpfad Dfp_InjVlvNVC7" VALUE 0xC8B33 Kw_Wu8 255.0 OneToOne 0.00 255.0 FORMAT "%5.1" /end CHARACTERISTIC
/begin CHARACTERISTIC DSM_FMKDfp_InjVlvNVC8_C "Ausblendbedingungen fuer Fehlerpfad Dfp_InjVlvNVC8" VALUE 0xC8B34 Kw_Wu8 255.0 OneToOne 0.00 255.0 FORMAT "%5.1" /end CHARACTERISTIC
/begin CHARACTERISTIC DSM_FMKDfp_LPACD_Max_C "Ausblendbedingungen fuer Fehlerpfad Dfp_LPACD_Max" VALUE 0xC8B35 Kw_Wu8 255.0 OneToOne 0.00 255.0 FORMAT "%5.1" /end CHARACTERISTIC
/begin CHARACTERISTIC DSM_FMKDfp_LPACD_Min_C "Ausblendbedingungen fuer Fehlerpfad Dfp_LPACD_Min" VALUE 0xC8B36 Kw_Wu8 255.0 OneToOne 0.00 255.0 FORMAT "%5.1" /end CHARACTERISTIC
/begin CHARACTERISTIC DSM_FMKDfp_LPACD_SigNpl_C "Ausblendbedingungen fuer Fehlerpfad Dfp_LPACD_SigNpl" VALUE 0xC8B37 Kw_Wu8 255.0 OneToOne 0.00 255.0 FORMAT "%5.1" /end CHARACTERISTIC
/begin CHARACTERISTIC DSM_FMKDfp_LSUCDCircNernst0_C "Ausblendbedingungen fuer Fehlerpfad Dfp_LSUCDCircNernst0" VALUE 0xC8B38 Kw_Wu8 255.0 OneToOne 0.00 255.0 FORMAT "%5.1" /end CHARACTERISTIC
/begin CHARACTERISTIC DSM_FMKDfp_LSUCDCircPumpCur0_C "Ausblendbedingungen fuer Fehlerpfad Dfp_LSUCDCircPumpCur0" VALUE 0xC8B39 Kw_Wu8 255.0 OneToOne 0.00 255.0 FORMAT "%5.1" /end CHARACTERISTIC
/begin CHARACTERISTIC DSM_FMKDfp_LSUCDCircVirtGnd0_C "Ausblendbedingungen fuer Fehlerpfad Dfp_LSUCDCircVirtGnd0" VALUE 0xC8B3A Kw_Wu8 255.0 OneToOne 0.00 255.0 FORMAT "%5.1" /end CHARACTERISTIC
/begin CHARACTERISTIC DSM_FMKDfp_LSUCDHeater0_C "Ausblendbedingungen fuer Fehlerpfad Dfp_LSUCDHeater0" VALUE 0xC8B3B Kw_Wu8 255.0 OneToOne 0.00 255.0 FORMAT "%5.1" /end CHARACTERISTIC
/begin CHARACTERISTIC DSM_FMKDfp_LSUCDHtCoup0_C "Ausblendbedingungen fuer Fehlerpfad Dfp_LSUCDHtCoup0" VALUE 0xC8B3C Kw_Wu8 255.0 OneToOne 0.00 255.0 FORMAT "%5.1" /end CHARACTERISTIC
/begin CHARACTERISTIC DSM_FMKDfp_LSUCDO20_C "Ausblendbedingungen fuer Fehlerpfad Dfp_LSUCDO20" VALUE 0xC8B3D Kw_Wu8 255.0 OneToOne 0.00 255.0 FORMAT "%5.1" /end CHARACTERISTIC
/begin CHARACTERISTIC DSM_FMKDfp_LSUCDO2Clb0_C "Ausblendbedingungen fuer Fehlerpfad Dfp_LSUCDO2Clb0" VALUE 0xC8B3E Kw_Wu8 255.0 OneToOne 0.00 255.0 FORMAT "%5.1" /end CHARACTERISTIC
/begin CHARACTERISTIC DSM_FMKDfp_LSUCDRiClb0_C "Ausblendbedingungen fuer Fehlerpfad Dfp_LSUCDRiClb0" VALUE 0xC8B3F Kw_Wu8 255.0 OneToOne 0.00 255.0 FORMAT "%5.1" /end CHARACTERISTIC
/begin CHARACTERISTIC DSM_FMKDfp_LSUCDSPI0_C "Ausblendbedingungen fuer Fehlerpfad Dfp_LSUCDSPI0" VALUE 0xC8B40 Kw_Wu8 255.0 OneToOne 0.00 255.0 FORMAT "%5.1" /end CHARACTERISTIC
/begin CHARACTERISTIC DSM_FMKDfp_LSUCDSPIBattLow0_C "Ausblendbedingungen fuer Fehlerpfad Dfp_LSUCDSPIBattLow0" VALUE 0xC8B41 Kw_Wu8 255.0 OneToOne 0.00 255.0 FORMAT "%5.1" /end CHARACTERISTIC
/begin CHARACTERISTIC DSM_FMKDfp_LSUCDWireIP0_C "Ausblendbedingungen fuer Fehlerpfad Dfp_LSUCDWireIP0" VALUE 0xC8B42 Kw_Wu8 255.0 OneToOne 0.00 255.0 FORMAT "%5.1" /end CHARACTERISTIC
/begin CHARACTERISTIC DSM_FMKDfp_LSUCtlRiExc0_C "Ausblendbedingungen fuer Fehlerpfad Dfp_LSUCtlRiExc0" VALUE 0xC8B43 Kw_Wu8 255.0 OneToOne 0.00 255.0 FORMAT "%5.1" /end CHARACTERISTIC
/begin CHARACTERISTIC DSM_FMKDfp_LSUMon1Sens_C "Ausblendbedingungen fuer Fehlerpfad Dfp_LSUMon1Sens" VALUE 0xC8B44 Kw_Wu8 255.0 OneToOne 0.00 255.0 FORMAT "%5.1" /end CHARACTERISTIC
/begin CHARACTERISTIC DSM_FMKDfp_LSUMon2Sens_C "Ausblendbedingungen fuer Fehlerpfad Dfp_LSUMon2Sens" VALUE 0xC8B45 Kw_Wu8 255.0 OneToOne 0.00 255.0 FORMAT "%5.1" /end CHARACTERISTIC
/begin CHARACTERISTIC DSM_FMKDfp_LubCD_C "Ausblendbedingungen fuer Fehlerpfad Dfp_LubCD" VALUE 0xC8B46 Kw_Wu8 255.0 OneToOne 0.00 255.0 FORMAT "%5.1" /end CHARACTERISTIC
/begin CHARACTERISTIC DSM_FMKDfp_MIL_C "Ausblendbedingungen fuer Fehlerpfad Dfp_MIL" VALUE 0xC8B47 Kw_Wu8 255.0 OneToOne 0.00 255.0 FORMAT "%5.1" /end CHARACTERISTIC
/begin CHARACTERISTIC DSM_FMKDfp_MRlyCD_C "Ausblendbedingungen fuer Fehlerpfad Dfp_MRlyCD" VALUE 0xC8B48 Kw_Wu8 255.0 OneToOne 0.00 255.0 FORMAT "%5.1" /end CHARACTERISTIC
/begin CHARACTERISTIC DSM_FMKDfp_MSidCD_Comm_C "Ausblendbedingungen fuer Fehlerpfad Dfp_MSidCD_Comm" VALUE 0xC8B49 Kw_Wu8 255.0 OneToOne 0.00 255.0 FORMAT "%5.1" /end CHARACTERISTIC
/begin CHARACTERISTIC DSM_FMKDfp_MSidCD_Pin_C "Ausblendbedingungen fuer Fehlerpfad Dfp_MSidCD_Pin" VALUE 0xC8B4A Kw_Wu8 255.0 OneToOne 0.00 255.0 FORMAT "%5.1" /end CHARACTERISTIC
/begin CHARACTERISTIC DSM_FMKDfp_MSidCD_Sel_INI_C "Ausblendbedingungen fuer Fehlerpfad Dfp_MSidCD_Sel_INI" VALUE 0xC8B4B Kw_Wu8 255.0 OneToOne 0.00 255.0 FORMAT "%5.1" /end CHARACTERISTIC
/begin CHARACTERISTIC DSM_FMKDfp_MSidCD_Select_C "Ausblendbedingungen fuer Fehlerpfad Dfp_MSidCD_Select" VALUE 0xC8B4C Kw_Wu8 255.0 OneToOne 0.00 255.0 FORMAT "%5.1" /end CHARACTERISTIC
/begin CHARACTERISTIC DSM_FMKDfp_MeUnCDNoLoad_C "Ausblendbedingungen fuer Fehlerpfad Dfp_MeUnCDNoLoad" VALUE 0xC8B4D Kw_Wu8 255.0 OneToOne 0.00 255.0 FORMAT "%5.1" /end CHARACTERISTIC
/begin CHARACTERISTIC DSM_FMKDfp_MeUnCDSCBat_C "Ausblendbedingungen fuer Fehlerpfad Dfp_MeUnCDSCBat" VALUE 0xC8B4E Kw_Wu8 255.0 OneToOne 0.00 255.0 FORMAT "%5.1" /end CHARACTERISTIC
/begin CHARACTERISTIC DSM_FMKDfp_MeUnCDSCGnd_C "Ausblendbedingungen fuer Fehlerpfad Dfp_MeUnCDSCGnd" VALUE 0xC8B4F Kw_Wu8 255.0 OneToOne 0.00 255.0 FORMAT "%5.1" /end CHARACTERISTIC
/begin CHARACTERISTIC DSM_FMKDfp_MeUnCD_ADC_C "Ausblendbedingungen fuer Fehlerpfad Dfp_MeUnCD_ADC" VALUE 0xC8B50 Kw_Wu8 255.0 OneToOne 0.00 255.0 FORMAT "%5.1" /end CHARACTERISTIC
/begin CHARACTERISTIC DSM_FMKDfp_MeUnCD_SigTst_C "Ausblendbedingungen fuer Fehlerpfad Dfp_MeUnCD_SigTst" VALUE 0xC8B51 Kw_Wu8 255.0 OneToOne 0.00 255.0 FORMAT "%5.1" /end CHARACTERISTIC
/begin CHARACTERISTIC DSM_FMKDfp_Montr_C "Ausblendbedingungen fuer Fehlerpfad Dfp_Montr" VALUE 0xC8B52 Kw_Wu8 255.0 OneToOne 0.00 255.0 FORMAT "%5.1" /end CHARACTERISTIC
/begin CHARACTERISTIC DSM_FMKDfp_NetMngDeviceA_C "Ausblendbedingungen fuer Fehlerpfad Dfp_NetMngDeviceA" VALUE 0xC8B53 Kw_Wu8 255.0 OneToOne 0.00 255.0 FORMAT "%5.1" /end CHARACTERISTIC
/begin CHARACTERISTIC DSM_FMKDfp_NetMngDeviceB_C "Ausblendbedingungen fuer Fehlerpfad Dfp_NetMngDeviceB" VALUE 0xC8B54 Kw_Wu8 255.0 OneToOne 0.00 255.0 FORMAT "%5.1" /end CHARACTERISTIC
/begin CHARACTERISTIC DSM_FMKDfp_NetMngDeviceC_C "Ausblendbedingungen fuer Fehlerpfad Dfp_NetMngDeviceC" VALUE 0xC8B55 Kw_Wu8 255.0 OneToOne 0.00 255.0 FORMAT "%5.1" /end CHARACTERISTIC
/begin CHARACTERISTIC DSM_FMKDfp_OPSCD_Lamp_C "Ausblendbedingungen fuer Fehlerpfad Dfp_OPSCD_Lamp" VALUE 0xC8B56 Kw_Wu8 255.0 OneToOne 0.00 255.0 FORMAT "%5.1" /end CHARACTERISTIC
/begin CHARACTERISTIC DSM_FMKDfp_OPSCD_anain_C "Ausblendbedingungen fuer Fehlerpfad Dfp_OPSCD_anain" VALUE 0xC8B57 Kw_Wu8 255.0 OneToOne 0.00 255.0 FORMAT "%5.1" /end CHARACTERISTIC
/begin CHARACTERISTIC DSM_FMKDfp_OTSCD_C "Ausblendbedingungen fuer Fehlerpfad Dfp_OTSCD" VALUE 0xC8B58 Kw_Wu8 255.0 OneToOne 0.00 255.0 FORMAT "%5.1" /end CHARACTERISTIC
/begin CHARACTERISTIC DSM_FMKDfp_OvRMon_C "Ausblendbedingungen fuer Fehlerpfad Dfp_OvRMon" VALUE 0xC8B59 Kw_Wu8 255.0 OneToOne 0.00 255.0 FORMAT "%5.1" /end CHARACTERISTIC
/begin CHARACTERISTIC DSM_FMKDfp_OvRMonBrk_C "Ausblendbedingungen fuer Fehlerpfad Dfp_OvRMonBrk" VALUE 0xC8B5A Kw_Wu8 255.0 OneToOne 0.00 255.0 FORMAT "%5.1" /end CHARACTERISTIC
/begin CHARACTERISTIC DSM_FMKDfp_OvRMonSigA_C "Ausblendbedingungen fuer Fehlerpfad Dfp_OvRMonSigA" VALUE 0xC8B5B Kw_Wu8 255.0 OneToOne 0.00 255.0 FORMAT "%5.1" /end CHARACTERISTIC
/begin CHARACTERISTIC DSM_FMKDfp_OxiCCDTPre_C "Ausblendbedingungen fuer Fehlerpfad Dfp_OxiCCDTPre" VALUE 0xC8B5C Kw_Wu8 255.0 OneToOne 0.00 255.0 FORMAT "%5.1" /end CHARACTERISTIC
/begin CHARACTERISTIC DSM_FMKDfp_PCR_GovDevNeg_C "Ausblendbedingungen fuer Fehlerpfad Dfp_PCR_GovDevNeg" VALUE 0xC8B5D Kw_Wu8 255.0 OneToOne 0.00 255.0 FORMAT "%5.1" /end CHARACTERISTIC
/begin CHARACTERISTIC DSM_FMKDfp_PCR_GovDevPos_C "Ausblendbedingungen fuer Fehlerpfad Dfp_PCR_GovDevPos" VALUE 0xC8B5E Kw_Wu8 255.0 OneToOne 0.00 255.0 FORMAT "%5.1" /end CHARACTERISTIC
/begin CHARACTERISTIC DSM_FMKDfp_PCVCDNoLoad_C "Ausblendbedingungen fuer Fehlerpfad Dfp_PCVCDNoLoad" VALUE 0xC8B5F Kw_Wu8 255.0 OneToOne 0.00 255.0 FORMAT "%5.1" /end CHARACTERISTIC
/begin CHARACTERISTIC DSM_FMKDfp_PCVCDSCBat_C "Ausblendbedingungen fuer Fehlerpfad Dfp_PCVCDSCBat" VALUE 0xC8B60 Kw_Wu8 255.0 OneToOne 0.00 255.0 FORMAT "%5.1" /end CHARACTERISTIC
/begin CHARACTERISTIC DSM_FMKDfp_PCVCDSCGnd_C "Ausblendbedingungen fuer Fehlerpfad Dfp_PCVCDSCGnd" VALUE 0xC8B61 Kw_Wu8 255.0 OneToOne 0.00 255.0 FORMAT "%5.1" /end CHARACTERISTIC
/begin CHARACTERISTIC DSM_FMKDfp_PCVCD_ADC_C "Ausblendbedingungen fuer Fehlerpfad Dfp_PCVCD_ADC" VALUE 0xC8B62 Kw_Wu8 255.0 OneToOne 0.00 255.0 FORMAT "%5.1" /end CHARACTERISTIC
/begin CHARACTERISTIC DSM_FMKDfp_PCVCD_SigTst_C "Ausblendbedingungen fuer Fehlerpfad Dfp_PCVCD_SigTst" VALUE 0xC8B63 Kw_Wu8 255.0 OneToOne 0.00 255.0 FORMAT "%5.1" /end CHARACTERISTIC
/begin CHARACTERISTIC DSM_FMKDfp_PFltAPSens_C "Ausblendbedingungen fuer Fehlerpfad Dfp_PFltAPSens" VALUE 0xC8B64 Kw_Wu8 255.0 OneToOne 0.00 255.0 FORMAT "%5.1" /end CHARACTERISTIC
/begin CHARACTERISTIC DSM_FMKDfp_PFltCDPPre_C "Ausblendbedingungen fuer Fehlerpfad Dfp_PFltCDPPre" VALUE 0xC8B65 Kw_Wu8 255.0 OneToOne 0.00 255.0 FORMAT "%5.1" /end CHARACTERISTIC
/begin CHARACTERISTIC DSM_FMKDfp_PFltCDTempPre_C "Ausblendbedingungen fuer Fehlerpfad Dfp_PFltCDTempPre" VALUE 0xC8B66 Kw_Wu8 255.0 OneToOne 0.00 255.0 FORMAT "%5.1" /end CHARACTERISTIC
/begin CHARACTERISTIC DSM_FMKDfp_PFltChar_C "Ausblendbedingungen fuer Fehlerpfad Dfp_PFltChar" VALUE 0xC8B67 Kw_Wu8 255.0 OneToOne 0.00 255.0 FORMAT "%5.1" /end CHARACTERISTIC
/begin CHARACTERISTIC DSM_FMKDfp_PFltEngPrt_C "Ausblendbedingungen fuer Fehlerpfad Dfp_PFltEngPrt" VALUE 0xC8B68 Kw_Wu8 255.0 OneToOne 0.00 255.0 FORMAT "%5.1" /end CHARACTERISTIC
/begin CHARACTERISTIC DSM_FMKDfp_PFltPresDynPlaus_C "Ausblendbedingungen fuer Fehlerpfad Dfp_PFltPresDynPlaus" VALUE 0xC8B69 Kw_Wu8 255.0 OneToOne 0.00 255.0 FORMAT "%5.1" /end CHARACTERISTIC
/begin CHARACTERISTIC DSM_FMKDfp_PFltPresSens_C "Ausblendbedingungen fuer Fehlerpfad Dfp_PFltPresSens" VALUE 0xC8B6A Kw_Wu8 255.0 OneToOne 0.00 255.0 FORMAT "%5.1" /end CHARACTERISTIC
/begin CHARACTERISTIC DSM_FMKDfp_PFltPresSensFrz_C "Ausblendbedingungen fuer Fehlerpfad Dfp_PFltPresSensFrz" VALUE 0xC8B6B Kw_Wu8 255.0 OneToOne 0.00 255.0 FORMAT "%5.1" /end CHARACTERISTIC
/begin CHARACTERISTIC DSM_FMKDfp_PFltPresSensHsLn_C "Ausblendbedingungen fuer Fehlerpfad Dfp_PFltPresSensHsLn" VALUE 0xC8B6C Kw_Wu8 255.0 OneToOne 0.00 255.0 FORMAT "%5.1" /end CHARACTERISTIC
/begin CHARACTERISTIC DSM_FMKDfp_PFltPresSensSot_C "Ausblendbedingungen fuer Fehlerpfad Dfp_PFltPresSensSot" VALUE 0xC8B6D Kw_Wu8 255.0 OneToOne 0.00 255.0 FORMAT "%5.1" /end CHARACTERISTIC
/begin CHARACTERISTIC DSM_FMKDfp_PFltRgnPerm_C "Ausblendbedingungen fuer Fehlerpfad Dfp_PFltRgnPerm" VALUE 0xC8B6E Kw_Wu8 255.0 OneToOne 0.00 255.0 FORMAT "%5.1" /end CHARACTERISTIC
/begin CHARACTERISTIC DSM_FMKDfp_PFltTempDwnStrm_C "Ausblendbedingungen fuer Fehlerpfad Dfp_PFltTempDwnStrm" VALUE 0xC8B6F Kw_Wu8 255.0 OneToOne 0.00 255.0 FORMAT "%5.1" /end CHARACTERISTIC
/begin CHARACTERISTIC DSM_FMKDfp_PFltTempSens_C "Ausblendbedingungen fuer Fehlerpfad Dfp_PFltTempSens" VALUE 0xC8B70 Kw_Wu8 255.0 OneToOne 0.00 255.0 FORMAT "%5.1" /end CHARACTERISTIC
/begin CHARACTERISTIC DSM_FMKDfp_PFltTempUpStrm_C "Ausblendbedingungen fuer Fehlerpfad Dfp_PFltTempUpStrm" VALUE 0xC8B71 Kw_Wu8 255.0 OneToOne 0.00 255.0 FORMAT "%5.1" /end CHARACTERISTIC
/begin CHARACTERISTIC DSM_FMKDfp_PFltmSotDiffMax_C "Ausblendbedingungen fuer Fehlerpfad Dfp_PFltmSotDiffMax" VALUE 0xC8B72 Kw_Wu8 255.0 OneToOne 0.00 255.0 FORMAT "%5.1" /end CHARACTERISTIC
/begin CHARACTERISTIC DSM_FMKDfp_QLTCD_C "Ausblendbedingungen fuer Fehlerpfad Dfp_QLTCD" VALUE 0xC8B73 Kw_Wu8 255.0 OneToOne 0.00 255.0 FORMAT "%5.1" /end CHARACTERISTIC
/begin CHARACTERISTIC DSM_FMKDfp_RTMMon_C "Ausblendbedingungen fuer Fehlerpfad Dfp_RTMMon" VALUE 0xC8B74 Kw_Wu8 255.0 OneToOne 0.00 255.0 FORMAT "%5.1" /end CHARACTERISTIC
/begin CHARACTERISTIC DSM_FMKDfp_RailCD_C "Ausblendbedingungen fuer Fehlerpfad Dfp_RailCD" VALUE 0xC8B75 Kw_Wu8 255.0 OneToOne 0.00 255.0 FORMAT "%5.1" /end CHARACTERISTIC
/begin CHARACTERISTIC DSM_FMKDfp_RailCDOfsTst_C "Ausblendbedingungen fuer Fehlerpfad Dfp_RailCDOfsTst" VALUE 0xC8B76 Kw_Wu8 255.0 OneToOne 0.00 255.0 FORMAT "%5.1" /end CHARACTERISTIC
/begin CHARACTERISTIC DSM_FMKDfp_RailCD_PMonStrt_C "Ausblendbedingungen fuer Fehlerpfad Dfp_RailCD_PMonStrt" VALUE 0xC8B77 Kw_Wu8 255.0 OneToOne 0.00 255.0 FORMAT "%5.1" /end CHARACTERISTIC
/begin CHARACTERISTIC DSM_FMKDfp_RailCtlModeMeUnDiag_C "Ausblendbedingungen fuer Fehlerpfad Dfp_RailCtlModeMeUnDiag" VALUE 0xC8B78 Kw_Wu8 255.0 OneToOne 0.00 255.0 FORMAT "%5.1" /end CHARACTERISTIC
/begin CHARACTERISTIC DSM_FMKDfp_RailCtlModePCVDiag_C "Ausblendbedingungen fuer Fehlerpfad Dfp_RailCtlModePCVDiag" VALUE 0xC8B79 Kw_Wu8 255.0 OneToOne 0.00 255.0 FORMAT "%5.1" /end CHARACTERISTIC
/begin CHARACTERISTIC DSM_FMKDfp_RailMeUn0_C "Ausblendbedingungen fuer Fehlerpfad Dfp_RailMeUn0" VALUE 0xC8B7A Kw_Wu8 255.0 OneToOne 0.00 255.0 FORMAT "%5.1" /end CHARACTERISTIC
/begin CHARACTERISTIC DSM_FMKDfp_RailMeUn1_C "Ausblendbedingungen fuer Fehlerpfad Dfp_RailMeUn1" VALUE 0xC8B7B Kw_Wu8 255.0 OneToOne 0.00 255.0 FORMAT "%5.1" /end CHARACTERISTIC
/begin CHARACTERISTIC DSM_FMKDfp_RailMeUn2_C "Ausblendbedingungen fuer Fehlerpfad Dfp_RailMeUn2" VALUE 0xC8B7C Kw_Wu8 255.0 OneToOne 0.00 255.0 FORMAT "%5.1" /end CHARACTERISTIC
/begin CHARACTERISTIC DSM_FMKDfp_RailMeUn3_C "Ausblendbedingungen fuer Fehlerpfad Dfp_RailMeUn3" VALUE 0xC8B7D Kw_Wu8 255.0 OneToOne 0.00 255.0 FORMAT "%5.1" /end CHARACTERISTIC
/begin CHARACTERISTIC DSM_FMKDfp_RailMeUn4_C "Ausblendbedingungen fuer Fehlerpfad Dfp_RailMeUn4" VALUE 0xC8B7E Kw_Wu8 255.0 OneToOne 0.00 255.0 FORMAT "%5.1" /end CHARACTERISTIC
/begin CHARACTERISTIC DSM_FMKDfp_RailPCV0_C "Ausblendbedingungen fuer Fehlerpfad Dfp_RailPCV0" VALUE 0xC8B7F Kw_Wu8 255.0 OneToOne 0.00 255.0 FORMAT "%5.1" /end CHARACTERISTIC
/begin CHARACTERISTIC DSM_FMKDfp_RailPCV1_C "Ausblendbedingungen fuer Fehlerpfad Dfp_RailPCV1" VALUE 0xC8B80 Kw_Wu8 255.0 OneToOne 0.00 255.0 FORMAT "%5.1" /end CHARACTERISTIC
/begin CHARACTERISTIC DSM_FMKDfp_RailPCV2_C "Ausblendbedingungen fuer Fehlerpfad Dfp_RailPCV2" VALUE 0xC8B81 Kw_Wu8 255.0 OneToOne 0.00 255.0 FORMAT "%5.1" /end CHARACTERISTIC
/begin CHARACTERISTIC DSM_FMKDfp_RailPCV3_C "Ausblendbedingungen fuer Fehlerpfad Dfp_RailPCV3" VALUE 0xC8B82 Kw_Wu8 255.0 OneToOne 0.00 255.0 FORMAT "%5.1" /end CHARACTERISTIC
/begin CHARACTERISTIC DSM_FMKDfp_RailPCV4_C "Ausblendbedingungen fuer Fehlerpfad Dfp_RailPCV4" VALUE 0xC8B83 Kw_Wu8 255.0 OneToOne 0.00 255.0 FORMAT "%5.1" /end CHARACTERISTIC
/begin CHARACTERISTIC DSM_FMKDfp_RailPCV5_C "Ausblendbedingungen fuer Fehlerpfad Dfp_RailPCV5" VALUE 0xC8B84 Kw_Wu8 255.0 OneToOne 0.00 255.0 FORMAT "%5.1" /end CHARACTERISTIC
/begin CHARACTERISTIC DSM_FMKDfp_SOPTst_C "Ausblendbedingungen fuer Fehlerpfad Dfp_SOPTst" VALUE 0xC8B85 Kw_Wu8 255.0 OneToOne 0.00 255.0 FORMAT "%5.1" /end CHARACTERISTIC
/begin CHARACTERISTIC DSM_FMKDfp_SSpMon1_C "Ausblendbedingungen fuer Fehlerpfad Dfp_SSpMon1" VALUE 0xC8B86 Kw_Wu8 255.0 OneToOne 0.00 255.0 FORMAT "%5.1" /end CHARACTERISTIC
/begin CHARACTERISTIC DSM_FMKDfp_SSpMon2_C "Ausblendbedingungen fuer Fehlerpfad Dfp_SSpMon2" VALUE 0xC8B87 Kw_Wu8 255.0 OneToOne 0.00 255.0 FORMAT "%5.1" /end CHARACTERISTIC
/begin CHARACTERISTIC DSM_FMKDfp_SSpMon3_C "Ausblendbedingungen fuer Fehlerpfad Dfp_SSpMon3" VALUE 0xC8B88 Kw_Wu8 255.0 OneToOne 0.00 255.0 FORMAT "%5.1" /end CHARACTERISTIC
/begin CHARACTERISTIC DSM_FMKDfp_ShutCD_C "Ausblendbedingungen fuer Fehlerpfad Dfp_ShutCD" VALUE 0xC8B89 Kw_Wu8 255.0 OneToOne 0.00 255.0 FORMAT "%5.1" /end CHARACTERISTIC
/begin CHARACTERISTIC DSM_FMKDfp_StSysTrqShutOff_C "Ausblendbedingungen fuer Fehlerpfad Dfp_StSysTrqShutOff" VALUE 0xC8B8A Kw_Wu8 255.0 OneToOne 0.00 255.0 FORMAT "%5.1" /end CHARACTERISTIC
/begin CHARACTERISTIC DSM_FMKDfp_StrtCD_Actr_C "Ausblendbedingungen fuer Fehlerpfad Dfp_StrtCD_Actr" VALUE 0xC8B8B Kw_Wu8 255.0 OneToOne 0.00 255.0 FORMAT "%5.1" /end CHARACTERISTIC
/begin CHARACTERISTIC DSM_FMKDfp_SysLamp_C "Ausblendbedingungen fuer Fehlerpfad Dfp_SysLamp" VALUE 0xC8B8C Kw_Wu8 255.0 OneToOne 0.00 255.0 FORMAT "%5.1" /end CHARACTERISTIC
/begin CHARACTERISTIC DSM_FMKDfp_T15CD_C "Ausblendbedingungen fuer Fehlerpfad Dfp_T15CD" VALUE 0xC8B8D Kw_Wu8 255.0 OneToOne 0.00 255.0 FORMAT "%5.1" /end CHARACTERISTIC
/begin CHARACTERISTIC DSM_FMKDfp_TGearbx_C "Ausblendbedingungen fuer Fehlerpfad Dfp_TGearbx" VALUE 0xC8B8E Kw_Wu8 255.0 OneToOne 0.00 255.0 FORMAT "%5.1" /end CHARACTERISTIC
/begin CHARACTERISTIC DSM_FMKDfp_TPUMon_C "Ausblendbedingungen fuer Fehlerpfad Dfp_TPUMon" VALUE 0xC8B8F Kw_Wu8 255.0 OneToOne 0.00 255.0 FORMAT "%5.1" /end CHARACTERISTIC
/begin CHARACTERISTIC DSM_FMKDfp_TVACD_Max_C "Ausblendbedingungen fuer Fehlerpfad Dfp_TVACD_Max" VALUE 0xC8B90 Kw_Wu8 255.0 OneToOne 0.00 255.0 FORMAT "%5.1" /end CHARACTERISTIC
/begin CHARACTERISTIC DSM_FMKDfp_TVACD_Min_C "Ausblendbedingungen fuer Fehlerpfad Dfp_TVACD_Min" VALUE 0xC8B91 Kw_Wu8 255.0 OneToOne 0.00 255.0 FORMAT "%5.1" /end CHARACTERISTIC
/begin CHARACTERISTIC DSM_FMKDfp_TVACD_SigNpl_C "Ausblendbedingungen fuer Fehlerpfad Dfp_TVACD_SigNpl" VALUE 0xC8B92 Kw_Wu8 255.0 OneToOne 0.00 255.0 FORMAT "%5.1" /end CHARACTERISTIC
/begin CHARACTERISTIC DSM_FMKDfp_TVACD_TVADia1_C "Ausblendbedingungen fuer Fehlerpfad Dfp_TVACD_TVADia1" VALUE 0xC8B93 Kw_Wu8 255.0 OneToOne 0.00 255.0 FORMAT "%5.1" /end CHARACTERISTIC
/begin CHARACTERISTIC DSM_FMKDfp_TVACD_TVADia2_C "Ausblendbedingungen fuer Fehlerpfad Dfp_TVACD_TVADia2" VALUE 0xC8B94 Kw_Wu8 255.0 OneToOne 0.00 255.0 FORMAT "%5.1" /end CHARACTERISTIC
/begin CHARACTERISTIC DSM_FMKDfp_TVACD_TVADia3_C "Ausblendbedingungen fuer Fehlerpfad Dfp_TVACD_TVADia3" VALUE 0xC8B95 Kw_Wu8 255.0 OneToOne 0.00 255.0 FORMAT "%5.1" /end CHARACTERISTIC
/begin CHARACTERISTIC DSM_FMKDfp_VSACD_Max_C "Ausblendbedingungen fuer Fehlerpfad Dfp_VSACD_Max" VALUE 0xC8B96 Kw_Wu8 255.0 OneToOne 0.00 255.0 FORMAT "%5.1" /end CHARACTERISTIC
/begin CHARACTERISTIC DSM_FMKDfp_VSACD_Min_C "Ausblendbedingungen fuer Fehlerpfad Dfp_VSACD_Min" VALUE 0xC8B97 Kw_Wu8 255.0 OneToOne 0.00 255.0 FORMAT "%5.1" /end CHARACTERISTIC
/begin CHARACTERISTIC DSM_FMKDfp_VSACD_SigNpl_C "Ausblendbedingungen fuer Fehlerpfad Dfp_VSACD_SigNpl" VALUE 0xC8B98 Kw_Wu8 255.0 OneToOne 0.00 255.0 FORMAT "%5.1" /end CHARACTERISTIC
/begin CHARACTERISTIC DSM_FMKDfp_VSACD_VSADia1_C "Ausblendbedingungen fuer Fehlerpfad Dfp_VSACD_VSADia1" VALUE 0xC8B99 Kw_Wu8 255.0 OneToOne 0.00 255.0 FORMAT "%5.1" /end CHARACTERISTIC
/begin CHARACTERISTIC DSM_FMKDfp_VSACD_VSADia2_C "Ausblendbedingungen fuer Fehlerpfad Dfp_VSACD_VSADia2" VALUE 0xC8B9A Kw_Wu8 255.0 OneToOne 0.00 255.0 FORMAT "%5.1" /end CHARACTERISTIC
/begin CHARACTERISTIC DSM_FMKDfp_VSACD_VSADia3_C "Ausblendbedingungen fuer Fehlerpfad Dfp_VSACD_VSADia3" VALUE 0xC8B9B Kw_Wu8 255.0 OneToOne 0.00 255.0 FORMAT "%5.1" /end CHARACTERISTIC
/begin CHARACTERISTIC DSM_FMKDfp_VSACD_VSADia4_C "Ausblendbedingungen fuer Fehlerpfad Dfp_VSACD_VSADia4" VALUE 0xC8B9C Kw_Wu8 255.0 OneToOne 0.00 255.0 FORMAT "%5.1" /end CHARACTERISTIC
/begin CHARACTERISTIC DSM_FMKDfp_VSSCD1_C "Ausblendbedingungen fuer Fehlerpfad Dfp_VSSCD1" VALUE 0xC8B9D Kw_Wu8 255.0 OneToOne 0.00 255.0 FORMAT "%5.1" /end CHARACTERISTIC
/begin CHARACTERISTIC DSM_FMKDfp_VSSCD2_C "Ausblendbedingungen fuer Fehlerpfad Dfp_VSSCD2" VALUE 0xC8B9E Kw_Wu8 255.0 OneToOne 0.00 255.0 FORMAT "%5.1" /end CHARACTERISTIC
/begin CHARACTERISTIC DSM_FMKDfp_WdCom_C "Ausblendbedingungen fuer Fehlerpfad Dfp_WdCom" VALUE 0xC8B9F Kw_Wu8 255.0 OneToOne 0.00 255.0 FORMAT "%5.1" /end CHARACTERISTIC
/begin FUNCTION dsm_auto_blk ""
 /begin DEF_CHARACTERISTIC DSM_FMKDfp_Layer_TANS_C DSM_FMKDfp_ACCDSwtin_C DSM_FMKDfp_ACC_PlausTrqDes_C DSM_FMKDfp_ACC_trqInr_C DSM_FMKDfp_ACTrq_C DSM_FMKDfp_ADCMon_C DSM_FMKDfp_AFSCDIdlAdjVal_C DSM_FMKDfp_AFSCDLdAdjVal_C DSM_FMKDfp_AFSCD_AirTempDcyc_C DSM_FMKDfp_AFSCD_PlOffsDrft_C DSM_FMKDfp_AFSCD_PlSetyDrft_C DSM_FMKDfp_AFSCD_SRCAirTemp_C DSM_FMKDfp_AFSCD_SRCBatt_C DSM_FMKDfp_AFSCD_SRCCorrAirm_C DSM_FMKDfp_AFSCD_SRCRawAirm_C DSM_FMKDfp_AFSCD_SRCRefSigPer_C DSM_FMKDfp_AOHtCD_C DSM_FMKDfp_AOHtCD_AOHtDia1_C DSM_FMKDfp_AOHtCD_AOHtDia2_C DSM_FMKDfp_Layer_TUMG_C DSM_FMKDfp_AOHtCD_AOHtDia3_C DSM_FMKDfp_APP1_C DSM_FMKDfp_Layer_GEN_C DSM_FMKDfp_Layer_BSD_C DSM_FMKDfp_APP2_C DSM_FMKDfp_APSCD_C DSM_FMKDfp_ARS_C DSM_FMKDfp_AccPedPlausBrk_C DSM_FMKDfp_AirCtlPlateBreak_C DSM_FMKDfp_AirCtl_GovNegDev_C DSM_FMKDfp_AirCtl_GovNegDev2_C DSM_FMKDfp_AirCtl_GovPosDev_C DSM_FMKDfp_AirCtl_GovPosDev2_C DSM_FMKDfp_AltCD_C DSM_FMKDfp_Layer_QLT_C DSM_FMKDfp_BPACD_BPADia1_C DSM_FMKDfp_Layer_IBS1_C DSM_FMKDfp_Layer_IBS2_C DSM_FMKDfp_Layer_IBS3_C DSM_FMKDfp_Layer_PMBN_C DSM_FMKDfp_Layer_PMBATT_C DSM_FMKDfp_BPACD_BPADia2_C DSM_FMKDfp_BPACD_BPADia3_C DSM_FMKDfp_BPACD_Max_C DSM_FMKDfp_BPACD_Min_C DSM_FMKDfp_BPACD_SigNpl_C DSM_FMKDfp_BPSCD_C DSM_FMKDfp_BattCD_C DSM_FMKDfp_BrkCD_C DSM_FMKDfp_Bss_C DSM_FMKDfp_CBACD_C DSM_FMKDfp_CTSCD_C DSM_FMKDfp_Clg_DynTst_C DSM_FMKDfp_CmbChbMisfire1_C DSM_FMKDfp_CmbChbMisfire2_C DSM_FMKDfp_CmbChbMisfire3_C DSM_FMKDfp_CmbChbMisfire4_C DSM_FMKDfp_CmbChbMisfire5_C DSM_FMKDfp_CmbChbMisfire6_C DSM_FMKDfp_CmbChbMisfireMul_C DSM_FMKDfp_CoVMDCSh_C DSM_FMKDfp_ConvCD_C DSM_FMKDfp_CrCCDMFL_C DSM_FMKDfp_CrCtl_vCrCtl_C DSM_FMKDfp_Dummy1_C DSM_FMKDfp_EATSCD_C DSM_FMKDfp_EBAFCD_C DSM_FMKDfp_EBFCD_C DSM_FMKDfp_EBTSCD_C DSM_FMKDfp_EBTSCD_OvrTemp_C DSM_FMKDfp_EEPCDVarMng_C DSM_FMKDfp_EGPpCD_C DSM_FMKDfp_EGPpCDTPreTrbn_C DSM_FMKDfp_Layer_PMRUHVERL_C DSM_FMKDfp_EGRCD_Max_C DSM_FMKDfp_EGRCD_Min_C DSM_FMKDfp_EGRCD_SigNpl_C DSM_FMKDfp_EGTRgnOilDil_C DSM_FMKDfp_Layer_TOENS_C DSM_FMKDfp_Layer_MANHYDR_C DSM_FMKDfp_Layer_MANLUFT_C DSM_FMKDfp_ETClbETFltInj1_C DSM_FMKDfp_ETClbETFltInj2_C DSM_FMKDfp_ETClbETFltInj3_C DSM_FMKDfp_ETClbETFltInj4_C DSM_FMKDfp_ETClbETFltInj5_C DSM_FMKDfp_ETClbETFltInj6_C DSM_FMKDfp_ETClbInj1_C DSM_FMKDfp_ETClbInj2_C DSM_FMKDfp_ETClbInj3_C DSM_FMKDfp_ETClbInj4_C DSM_FMKDfp_ETClbInj5_C DSM_FMKDfp_ETClbInj6_C DSM_FMKDfp_EngMCaS1_C DSM_FMKDfp_EngMCrS1_C DSM_FMKDfp_EngMOfsCaSCrS_C DSM_FMKDfp_EngMntCtl1_Dia1_C DSM_FMKDfp_EngMntCtl1_Dia2_C DSM_FMKDfp_EngMntCtl1_Dia3_C DSM_FMKDfp_EngMntCtl1_Max_C DSM_FMKDfp_EngMntCtl1_Min_C DSM_FMKDfp_EngMntCtl1_SigNpl_C DSM_FMKDfp_EngMntCtlCD_C DSM_FMKDfp_EngMntCtl_Dia1_C DSM_FMKDfp_EngMntCtl_Dia2_C DSM_FMKDfp_EngMntCtl_Dia3_C DSM_FMKDfp_EngMntCtl_Max_C DSM_FMKDfp_EngMntCtl_Min_C DSM_FMKDfp_EngMntCtl_SigNpl_C DSM_FMKDfp_EngPrtFWODet_C DSM_FMKDfp_FBCqDvt_C DSM_FMKDfp_FMTC_NonMonotonMap_C DSM_FMKDfp_FTSCD_C DSM_FMKDfp_FanCD_C DSM_FMKDfp_FanCD_FanCtlr1_C DSM_FMKDfp_FanCD_FanCtlr2_C DSM_FMKDfp_FanCD_FanCtlr3_C DSM_FMKDfp_FlFCD_C DSM_FMKDfp_FlMngSmkDefect_C DSM_FMKDfp_FrmMngBOS_RESET_C DSM_FMKDfp_FrmMngBOS_RESET_2_C DSM_FMKDfp_FrmMngDMANFAFS_C DSM_FMKDfp_FrmMngDRMANFSSG_C DSM_FMKDfp_FrmMngGEARBX_DATA_C DSM_FMKDfp_FrmMngGEARBX_DATA2_C DSM_FMKDfp_FrmMngHEAT_AC_C DSM_FMKDfp_FrmMngLENKRADWINKEL_C DSM_FMKDfp_FrmMngMILEAGE_RANGE_C DSM_FMKDfp_FrmMngOPCRCTLACC_C DSM_FMKDfp_FrmMngPRGG_CCTR_C DSM_FMKDfp_FrmMngPWRMNG_LOADV_C DSM_FMKDfp_FrmMngParkConsumer_C DSM_FMKDfp_FrmMngRQSTGEFAN_C DSM_FMKDfp_FrmMngSSGErr_C DSM_FMKDfp_FrmMngSSGShOff_C DSM_FMKDfp_FrmMngSTAT_ANH_C DSM_FMKDfp_FrmMngSTAT_ARS_C DSM_FMKDfp_FrmMngSTAT_DSC_C DSM_FMKDfp_FrmMngSTAT_EKP_C DSM_FMKDfp_FrmMngSTAT_KOMBI_C DSM_FMKDfp_FrmMngSTAT_SITZ_C DSM_FMKDfp_FrmMngStOBDGbxMilOf_C DSM_FMKDfp_FrmMngStOBDGbxMilOn_C DSM_FMKDfp_FrmMngTEMPRELTIME_C DSM_FMKDfp_FrmMngTERMINAL_C DSM_FMKDfp_FrmMngTIME_DATE_C DSM_FMKDfp_FrmMngTORQUE_DSC_C DSM_FMKDfp_FrmMngTORQUE_GEARBX_C DSM_FMKDfp_FrmMngTrq_ReqACC_C DSM_FMKDfp_FrmMngVEH_MOD_C DSM_FMKDfp_FrmMngVELOCITY_C DSM_FMKDfp_FrmMngWHEEL_SPEED_C DSM_FMKDfp_FrmMngstCurr_C DSM_FMKDfp_FrmMngswtPSPOff_C DSM_FMKDfp_GearbxIncMax_C DSM_FMKDfp_GlwCD_C DSM_FMKDfp_GlwCDGlwCirc1_C DSM_FMKDfp_GlwCDGlwCirc2_C DSM_FMKDfp_GlwCDGlwCirc3_C DSM_FMKDfp_GlwCDGlwCirc4_C DSM_FMKDfp_GlwCDGlwCirc5_C DSM_FMKDfp_GlwCDGlwCirc6_C DSM_FMKDfp_GlwCDGlwCirc7_C DSM_FMKDfp_GlwCDGlwCirc8_C DSM_FMKDfp_GlwCtl_C DSM_FMKDfp_HWEMonCom_C DSM_FMKDfp_HWEMonEEPROM_C DSM_FMKDfp_HWEMonRcyLocked_C DSM_FMKDfp_HWEMonRcySuppressed_C DSM_FMKDfp_HWEMonRcyVisible_C DSM_FMKDfp_HWEMonUMaxSupply_C DSM_FMKDfp_HWEMonUMinSupply_C DSM_FMKDfp_IATSCD_C DSM_FMKDfp_IATSCD_CATS_C DSM_FMKDfp_ImmCtlImmCD_C DSM_FMKDfp_ImmCtlImmEep_C DSM_FMKDfp_ImmCtlMpl_C DSM_FMKDfp_IndSys1_C DSM_FMKDfp_IndSys2_C DSM_FMKDfp_InjCrv_InjLim_C DSM_FMKDfp_InjCtlAdjQnt_C DSM_FMKDfp_InjCtlDrift_C DSM_FMKDfp_InjVCDActrChrg_C DSM_FMKDfp_InjVCDActrEnrg1_C DSM_FMKDfp_InjVCDActrEnrg2_C DSM_FMKDfp_InjVCDActrEnrg3_C DSM_FMKDfp_InjVCDActrEnrg4_C DSM_FMKDfp_InjVCDActrEnrg5_C DSM_FMKDfp_InjVCDActrEnrg6_C DSM_FMKDfp_InjVCDActrEnrg7_C DSM_FMKDfp_InjVCDActrEnrg8_C DSM_FMKDfp_InjVCDActrVolt_C DSM_FMKDfp_InjVCDClsBank1_C DSM_FMKDfp_InjVCDClsBank2_C DSM_FMKDfp_InjVCDMonCab_C DSM_FMKDfp_InjVCDMonSwt_C DSM_FMKDfp_InjVCDShOffDCDC_C DSM_FMKDfp_InjVCDUBuf_C DSM_FMKDfp_InjVCD_CY370Ampl_C DSM_FMKDfp_InjVlvBnk1A_C DSM_FMKDfp_InjVlvBnk1B_C DSM_FMKDfp_InjVlvBnk2A_C DSM_FMKDfp_InjVlvBnk2B_C DSM_FMKDfp_InjVlvChipA_C DSM_FMKDfp_InjVlvChipB_C DSM_FMKDfp_InjVlvCyl1A_C DSM_FMKDfp_InjVlvCyl1B_C DSM_FMKDfp_InjVlvCyl1C_C DSM_FMKDfp_InjVlvCyl2A_C DSM_FMKDfp_InjVlvCyl2B_C DSM_FMKDfp_InjVlvCyl2C_C DSM_FMKDfp_InjVlvCyl3A_C DSM_FMKDfp_InjVlvCyl3B_C DSM_FMKDfp_InjVlvCyl3C_C DSM_FMKDfp_InjVlvCyl4A_C DSM_FMKDfp_InjVlvCyl4B_C DSM_FMKDfp_InjVlvCyl4C_C DSM_FMKDfp_InjVlvCyl5A_C DSM_FMKDfp_InjVlvCyl5B_C DSM_FMKDfp_InjVlvCyl5C_C DSM_FMKDfp_InjVlvCyl6A_C DSM_FMKDfp_InjVlvCyl6B_C DSM_FMKDfp_InjVlvCyl6C_C DSM_FMKDfp_InjVlvCyl7A_C DSM_FMKDfp_InjVlvCyl7B_C DSM_FMKDfp_InjVlvCyl7C_C DSM_FMKDfp_InjVlvCyl8A_C DSM_FMKDfp_InjVlvCyl8B_C DSM_FMKDfp_InjVlvCyl8C_C DSM_FMKDfp_InjVlvNVC1_C DSM_FMKDfp_InjVlvNVC2_C DSM_FMKDfp_InjVlvNVC3_C DSM_FMKDfp_InjVlvNVC4_C DSM_FMKDfp_InjVlvNVC5_C DSM_FMKDfp_InjVlvNVC6_C DSM_FMKDfp_InjVlvNVC7_C DSM_FMKDfp_InjVlvNVC8_C DSM_FMKDfp_LPACD_Max_C DSM_FMKDfp_LPACD_Min_C DSM_FMKDfp_LPACD_SigNpl_C DSM_FMKDfp_LSUCDCircNernst0_C DSM_FMKDfp_LSUCDCircPumpCur0_C DSM_FMKDfp_LSUCDCircVirtGnd0_C DSM_FMKDfp_LSUCDHeater0_C DSM_FMKDfp_LSUCDHtCoup0_C DSM_FMKDfp_LSUCDO20_C DSM_FMKDfp_LSUCDO2Clb0_C DSM_FMKDfp_LSUCDRiClb0_C DSM_FMKDfp_LSUCDSPI0_C DSM_FMKDfp_LSUCDSPIBattLow0_C DSM_FMKDfp_LSUCDWireIP0_C DSM_FMKDfp_LSUCtlRiExc0_C DSM_FMKDfp_LSUMon1Sens_C DSM_FMKDfp_LSUMon2Sens_C DSM_FMKDfp_LubCD_C DSM_FMKDfp_MIL_C DSM_FMKDfp_MRlyCD_C DSM_FMKDfp_MSidCD_Comm_C DSM_FMKDfp_MSidCD_Pin_C DSM_FMKDfp_MSidCD_Sel_INI_C DSM_FMKDfp_MSidCD_Select_C DSM_FMKDfp_MeUnCDNoLoad_C DSM_FMKDfp_MeUnCDSCBat_C DSM_FMKDfp_MeUnCDSCGnd_C DSM_FMKDfp_MeUnCD_ADC_C DSM_FMKDfp_MeUnCD_SigTst_C DSM_FMKDfp_Montr_C DSM_FMKDfp_NetMngDeviceA_C DSM_FMKDfp_NetMngDeviceB_C DSM_FMKDfp_NetMngDeviceC_C DSM_FMKDfp_OPSCD_Lamp_C DSM_FMKDfp_OPSCD_anain_C DSM_FMKDfp_OTSCD_C DSM_FMKDfp_OvRMon_C DSM_FMKDfp_OvRMonBrk_C DSM_FMKDfp_OvRMonSigA_C DSM_FMKDfp_OxiCCDTPre_C DSM_FMKDfp_PCR_GovDevNeg_C DSM_FMKDfp_PCR_GovDevPos_C DSM_FMKDfp_PCVCDNoLoad_C DSM_FMKDfp_PCVCDSCBat_C DSM_FMKDfp_PCVCDSCGnd_C DSM_FMKDfp_PCVCD_ADC_C DSM_FMKDfp_PCVCD_SigTst_C DSM_FMKDfp_PFltAPSens_C DSM_FMKDfp_PFltCDPPre_C DSM_FMKDfp_PFltCDTempPre_C DSM_FMKDfp_PFltChar_C DSM_FMKDfp_PFltEngPrt_C DSM_FMKDfp_PFltPresDynPlaus_C DSM_FMKDfp_PFltPresSens_C DSM_FMKDfp_PFltPresSensFrz_C DSM_FMKDfp_PFltPresSensHsLn_C DSM_FMKDfp_PFltPresSensSot_C DSM_FMKDfp_PFltRgnPerm_C DSM_FMKDfp_PFltTempDwnStrm_C DSM_FMKDfp_PFltTempSens_C DSM_FMKDfp_PFltTempUpStrm_C DSM_FMKDfp_PFltmSotDiffMax_C DSM_FMKDfp_QLTCD_C DSM_FMKDfp_RTMMon_C DSM_FMKDfp_RailCD_C DSM_FMKDfp_RailCDOfsTst_C DSM_FMKDfp_RailCD_PMonStrt_C DSM_FMKDfp_RailCtlModeMeUnDiag_C DSM_FMKDfp_RailCtlModePCVDiag_C DSM_FMKDfp_RailMeUn0_C DSM_FMKDfp_RailMeUn1_C DSM_FMKDfp_RailMeUn2_C DSM_FMKDfp_RailMeUn3_C DSM_FMKDfp_RailMeUn4_C DSM_FMKDfp_RailPCV0_C DSM_FMKDfp_RailPCV1_C DSM_FMKDfp_RailPCV2_C DSM_FMKDfp_RailPCV3_C DSM_FMKDfp_RailPCV4_C DSM_FMKDfp_RailPCV5_C DSM_FMKDfp_SOPTst_C DSM_FMKDfp_SSpMon1_C DSM_FMKDfp_SSpMon2_C DSM_FMKDfp_SSpMon3_C DSM_FMKDfp_ShutCD_C DSM_FMKDfp_StSysTrqShutOff_C DSM_FMKDfp_StrtCD_Actr_C DSM_FMKDfp_SysLamp_C DSM_FMKDfp_T15CD_C DSM_FMKDfp_TGearbx_C DSM_FMKDfp_TPUMon_C DSM_FMKDfp_TVACD_Max_C DSM_FMKDfp_TVACD_Min_C DSM_FMKDfp_TVACD_SigNpl_C DSM_FMKDfp_TVACD_TVADia1_C DSM_FMKDfp_TVACD_TVADia2_C DSM_FMKDfp_TVACD_TVADia3_C DSM_FMKDfp_VSACD_Max_C DSM_FMKDfp_VSACD_Min_C DSM_FMKDfp_VSACD_SigNpl_C DSM_FMKDfp_VSACD_VSADia1_C DSM_FMKDfp_VSACD_VSADia2_C DSM_FMKDfp_VSACD_VSADia3_C DSM_FMKDfp_VSACD_VSADia4_C DSM_FMKDfp_VSSCD1_C DSM_FMKDfp_VSSCD2_C DSM_FMKDfp_WdCom_C /end DEF_CHARACTERISTIC
/end FUNCTION
/begin FUNCTION dsm_auto_cdc ""
 /begin DEF_CHARACTERISTIC DSM_CDCDfp_Layer_TANS_C DSM_CDCDfp_ACCDSwtin_C DSM_CDCDfp_ACC_PlausTrqDes_C DSM_CDCDfp_ACC_trqInr_C DSM_CDCDfp_ACTrq_C DSM_CDCDfp_ADCMon_C DSM_CDCDfp_AFSCDIdlAdjVal_C DSM_CDCDfp_AFSCDLdAdjVal_C DSM_CDCDfp_AFSCD_AirTempDcyc_C DSM_CDCDfp_AFSCD_PlOffsDrft_C DSM_CDCDfp_AFSCD_PlSetyDrft_C DSM_CDCDfp_AFSCD_SRCAirTemp_C DSM_CDCDfp_AFSCD_SRCBatt_C DSM_CDCDfp_AFSCD_SRCCorrAirm_C DSM_CDCDfp_AFSCD_SRCRawAirm_C DSM_CDCDfp_AFSCD_SRCRefSigPer_C DSM_CDCDfp_AOHtCD_C DSM_CDCDfp_AOHtCD_AOHtDia1_C DSM_CDCDfp_AOHtCD_AOHtDia2_C DSM_CDCDfp_Layer_TUMG_C DSM_CDCDfp_AOHtCD_AOHtDia3_C DSM_CDCDfp_APP1_C DSM_CDCDfp_Layer_GEN_C DSM_CDCDfp_Layer_BSD_C DSM_CDCDfp_APP2_C DSM_CDCDfp_APSCD_C DSM_CDCDfp_ARS_C DSM_CDCDfp_AccPedPlausBrk_C DSM_CDCDfp_AirCtlPlateBreak_C DSM_CDCDfp_AirCtl_GovNegDev_C DSM_CDCDfp_AirCtl_GovNegDev2_C DSM_CDCDfp_AirCtl_GovPosDev_C DSM_CDCDfp_AirCtl_GovPosDev2_C DSM_CDCDfp_AltCD_C DSM_CDCDfp_Layer_QLT_C DSM_CDCDfp_BPACD_BPADia1_C DSM_CDCDfp_Layer_IBS1_C DSM_CDCDfp_Layer_IBS2_C DSM_CDCDfp_Layer_IBS3_C DSM_CDCDfp_Layer_PMBN_C DSM_CDCDfp_Layer_PMBATT_C DSM_CDCDfp_BPACD_BPADia2_C DSM_CDCDfp_BPACD_BPADia3_C DSM_CDCDfp_BPACD_Max_C DSM_CDCDfp_BPACD_Min_C DSM_CDCDfp_BPACD_SigNpl_C DSM_CDCDfp_BPSCD_C DSM_CDCDfp_BattCD_C DSM_CDCDfp_BrkCD_C DSM_CDCDfp_Bss_C DSM_CDCDfp_CBACD_C DSM_CDCDfp_CTSCD_C DSM_CDCDfp_Clg_DynTst_C DSM_CDCDfp_CmbChbMisfire1_C DSM_CDCDfp_CmbChbMisfire2_C DSM_CDCDfp_CmbChbMisfire3_C DSM_CDCDfp_CmbChbMisfire4_C DSM_CDCDfp_CmbChbMisfire5_C DSM_CDCDfp_CmbChbMisfire6_C DSM_CDCDfp_CmbChbMisfireMul_C DSM_CDCDfp_CoVMDCSh_C DSM_CDCDfp_ConvCD_C DSM_CDCDfp_CrCCDMFL_C DSM_CDCDfp_CrCtl_vCrCtl_C DSM_CDCDfp_Dummy1_C DSM_CDCDfp_EATSCD_C DSM_CDCDfp_EBAFCD_C DSM_CDCDfp_EBFCD_C DSM_CDCDfp_EBTSCD_C DSM_CDCDfp_EBTSCD_OvrTemp_C DSM_CDCDfp_EEPCDVarMng_C DSM_CDCDfp_EGPpCD_C DSM_CDCDfp_EGPpCDTPreTrbn_C DSM_CDCDfp_Layer_PMRUHVERL_C DSM_CDCDfp_EGRCD_Max_C DSM_CDCDfp_EGRCD_Min_C DSM_CDCDfp_EGRCD_SigNpl_C DSM_CDCDfp_EGTRgnOilDil_C DSM_CDCDfp_Layer_TOENS_C DSM_CDCDfp_Layer_MANHYDR_C DSM_CDCDfp_Layer_MANLUFT_C DSM_CDCDfp_ETClbETFltInj1_C DSM_CDCDfp_ETClbETFltInj2_C DSM_CDCDfp_ETClbETFltInj3_C DSM_CDCDfp_ETClbETFltInj4_C DSM_CDCDfp_ETClbETFltInj5_C DSM_CDCDfp_ETClbETFltInj6_C DSM_CDCDfp_ETClbInj1_C DSM_CDCDfp_ETClbInj2_C DSM_CDCDfp_ETClbInj3_C DSM_CDCDfp_ETClbInj4_C DSM_CDCDfp_ETClbInj5_C DSM_CDCDfp_ETClbInj6_C DSM_CDCDfp_EngMCaS1_C DSM_CDCDfp_EngMCrS1_C DSM_CDCDfp_EngMOfsCaSCrS_C DSM_CDCDfp_EngMntCtl1_Dia1_C DSM_CDCDfp_EngMntCtl1_Dia2_C DSM_CDCDfp_EngMntCtl1_Dia3_C DSM_CDCDfp_EngMntCtl1_Max_C DSM_CDCDfp_EngMntCtl1_Min_C DSM_CDCDfp_EngMntCtl1_SigNpl_C DSM_CDCDfp_EngMntCtlCD_C DSM_CDCDfp_EngMntCtl_Dia1_C DSM_CDCDfp_EngMntCtl_Dia2_C DSM_CDCDfp_EngMntCtl_Dia3_C DSM_CDCDfp_EngMntCtl_Max_C DSM_CDCDfp_EngMntCtl_Min_C DSM_CDCDfp_EngMntCtl_SigNpl_C DSM_CDCDfp_EngPrtFWODet_C DSM_CDCDfp_FBCqDvt_C DSM_CDCDfp_FMTC_NonMonotonMap_C DSM_CDCDfp_FTSCD_C DSM_CDCDfp_FanCD_C DSM_CDCDfp_FanCD_FanCtlr1_C DSM_CDCDfp_FanCD_FanCtlr2_C DSM_CDCDfp_FanCD_FanCtlr3_C DSM_CDCDfp_FlFCD_C DSM_CDCDfp_FlMngSmkDefect_C DSM_CDCDfp_FrmMngBOS_RESET_C DSM_CDCDfp_FrmMngBOS_RESET_2_C DSM_CDCDfp_FrmMngDMANFAFS_C DSM_CDCDfp_FrmMngDRMANFSSG_C DSM_CDCDfp_FrmMngGEARBX_DATA_C DSM_CDCDfp_FrmMngGEARBX_DATA2_C DSM_CDCDfp_FrmMngHEAT_AC_C DSM_CDCDfp_FrmMngLENKRADWINKEL_C DSM_CDCDfp_FrmMngMILEAGE_RANGE_C DSM_CDCDfp_FrmMngOPCRCTLACC_C DSM_CDCDfp_FrmMngPRGG_CCTR_C DSM_CDCDfp_FrmMngPWRMNG_LOADV_C DSM_CDCDfp_FrmMngParkConsumer_C DSM_CDCDfp_FrmMngRQSTGEFAN_C DSM_CDCDfp_FrmMngSSGErr_C DSM_CDCDfp_FrmMngSSGShOff_C DSM_CDCDfp_FrmMngSTAT_ANH_C DSM_CDCDfp_FrmMngSTAT_ARS_C DSM_CDCDfp_FrmMngSTAT_DSC_C DSM_CDCDfp_FrmMngSTAT_EKP_C DSM_CDCDfp_FrmMngSTAT_KOMBI_C DSM_CDCDfp_FrmMngSTAT_SITZ_C DSM_CDCDfp_FrmMngStOBDGbxMilOf_C DSM_CDCDfp_FrmMngStOBDGbxMilOn_C DSM_CDCDfp_FrmMngTEMPRELTIME_C DSM_CDCDfp_FrmMngTERMINAL_C DSM_CDCDfp_FrmMngTIME_DATE_C DSM_CDCDfp_FrmMngTORQUE_DSC_C DSM_CDCDfp_FrmMngTORQUE_GEARBX_C DSM_CDCDfp_FrmMngTrq_ReqACC_C DSM_CDCDfp_FrmMngVEH_MOD_C DSM_CDCDfp_FrmMngVELOCITY_C DSM_CDCDfp_FrmMngWHEEL_SPEED_C DSM_CDCDfp_FrmMngstCurr_C DSM_CDCDfp_FrmMngswtPSPOff_C DSM_CDCDfp_GearbxIncMax_C DSM_CDCDfp_GlwCD_C DSM_CDCDfp_GlwCDGlwCirc1_C DSM_CDCDfp_GlwCDGlwCirc2_C DSM_CDCDfp_GlwCDGlwCirc3_C DSM_CDCDfp_GlwCDGlwCirc4_C DSM_CDCDfp_GlwCDGlwCirc5_C DSM_CDCDfp_GlwCDGlwCirc6_C DSM_CDCDfp_GlwCDGlwCirc7_C DSM_CDCDfp_GlwCDGlwCirc8_C DSM_CDCDfp_GlwCtl_C DSM_CDCDfp_HWEMonCom_C DSM_CDCDfp_HWEMonEEPROM_C DSM_CDCDfp_HWEMonRcyLocked_C DSM_CDCDfp_HWEMonRcySuppressed_C DSM_CDCDfp_HWEMonRcyVisible_C DSM_CDCDfp_HWEMonUMaxSupply_C DSM_CDCDfp_HWEMonUMinSupply_C DSM_CDCDfp_IATSCD_C DSM_CDCDfp_IATSCD_CATS_C DSM_CDCDfp_ImmCtlImmCD_C DSM_CDCDfp_ImmCtlImmEep_C DSM_CDCDfp_ImmCtlMpl_C DSM_CDCDfp_IndSys1_C DSM_CDCDfp_IndSys2_C DSM_CDCDfp_InjCrv_InjLim_C DSM_CDCDfp_InjCtlAdjQnt_C DSM_CDCDfp_InjCtlDrift_C DSM_CDCDfp_InjVCDActrChrg_C DSM_CDCDfp_InjVCDActrEnrg1_C DSM_CDCDfp_InjVCDActrEnrg2_C DSM_CDCDfp_InjVCDActrEnrg3_C DSM_CDCDfp_InjVCDActrEnrg4_C DSM_CDCDfp_InjVCDActrEnrg5_C DSM_CDCDfp_InjVCDActrEnrg6_C DSM_CDCDfp_InjVCDActrEnrg7_C DSM_CDCDfp_InjVCDActrEnrg8_C DSM_CDCDfp_InjVCDActrVolt_C DSM_CDCDfp_InjVCDClsBank1_C DSM_CDCDfp_InjVCDClsBank2_C DSM_CDCDfp_InjVCDMonCab_C DSM_CDCDfp_InjVCDMonSwt_C DSM_CDCDfp_InjVCDShOffDCDC_C DSM_CDCDfp_InjVCDUBuf_C DSM_CDCDfp_InjVCD_CY370Ampl_C DSM_CDCDfp_InjVlvBnk1A_C DSM_CDCDfp_InjVlvBnk1B_C DSM_CDCDfp_InjVlvBnk2A_C DSM_CDCDfp_InjVlvBnk2B_C DSM_CDCDfp_InjVlvChipA_C DSM_CDCDfp_InjVlvChipB_C DSM_CDCDfp_InjVlvCyl1A_C DSM_CDCDfp_InjVlvCyl1B_C DSM_CDCDfp_InjVlvCyl1C_C DSM_CDCDfp_InjVlvCyl2A_C DSM_CDCDfp_InjVlvCyl2B_C DSM_CDCDfp_InjVlvCyl2C_C DSM_CDCDfp_InjVlvCyl3A_C DSM_CDCDfp_InjVlvCyl3B_C DSM_CDCDfp_InjVlvCyl3C_C DSM_CDCDfp_InjVlvCyl4A_C DSM_CDCDfp_InjVlvCyl4B_C DSM_CDCDfp_InjVlvCyl4C_C DSM_CDCDfp_InjVlvCyl5A_C DSM_CDCDfp_InjVlvCyl5B_C DSM_CDCDfp_InjVlvCyl5C_C DSM_CDCDfp_InjVlvCyl6A_C DSM_CDCDfp_InjVlvCyl6B_C DSM_CDCDfp_InjVlvCyl6C_C DSM_CDCDfp_InjVlvCyl7A_C DSM_CDCDfp_InjVlvCyl7B_C DSM_CDCDfp_InjVlvCyl7C_C DSM_CDCDfp_InjVlvCyl8A_C DSM_CDCDfp_InjVlvCyl8B_C DSM_CDCDfp_InjVlvCyl8C_C DSM_CDCDfp_InjVlvNVC1_C DSM_CDCDfp_InjVlvNVC2_C DSM_CDCDfp_InjVlvNVC3_C DSM_CDCDfp_InjVlvNVC4_C DSM_CDCDfp_InjVlvNVC5_C DSM_CDCDfp_InjVlvNVC6_C DSM_CDCDfp_InjVlvNVC7_C DSM_CDCDfp_InjVlvNVC8_C DSM_CDCDfp_LPACD_Max_C DSM_CDCDfp_LPACD_Min_C DSM_CDCDfp_LPACD_SigNpl_C DSM_CDCDfp_LSUCDCircNernst0_C DSM_CDCDfp_LSUCDCircPumpCur0_C DSM_CDCDfp_LSUCDCircVirtGnd0_C DSM_CDCDfp_LSUCDHeater0_C DSM_CDCDfp_LSUCDHtCoup0_C DSM_CDCDfp_LSUCDO20_C DSM_CDCDfp_LSUCDO2Clb0_C DSM_CDCDfp_LSUCDRiClb0_C DSM_CDCDfp_LSUCDSPI0_C DSM_CDCDfp_LSUCDSPIBattLow0_C DSM_CDCDfp_LSUCDWireIP0_C DSM_CDCDfp_LSUCtlRiExc0_C DSM_CDCDfp_LSUMon1Sens_C DSM_CDCDfp_LSUMon2Sens_C DSM_CDCDfp_LubCD_C DSM_CDCDfp_MIL_C DSM_CDCDfp_MRlyCD_C DSM_CDCDfp_MSidCD_Comm_C DSM_CDCDfp_MSidCD_Pin_C DSM_CDCDfp_MSidCD_Sel_INI_C DSM_CDCDfp_MSidCD_Select_C DSM_CDCDfp_MeUnCDNoLoad_C DSM_CDCDfp_MeUnCDSCBat_C DSM_CDCDfp_MeUnCDSCGnd_C DSM_CDCDfp_MeUnCD_ADC_C DSM_CDCDfp_MeUnCD_SigTst_C DSM_CDCDfp_Montr_C DSM_CDCDfp_NetMngDeviceA_C DSM_CDCDfp_NetMngDeviceB_C DSM_CDCDfp_NetMngDeviceC_C DSM_CDCDfp_OPSCD_Lamp_C DSM_CDCDfp_OPSCD_anain_C DSM_CDCDfp_OTSCD_C DSM_CDCDfp_OvRMon_C DSM_CDCDfp_OvRMonBrk_C DSM_CDCDfp_OvRMonSigA_C DSM_CDCDfp_OxiCCDTPre_C DSM_CDCDfp_PCR_GovDevNeg_C DSM_CDCDfp_PCR_GovDevPos_C DSM_CDCDfp_PCVCDNoLoad_C DSM_CDCDfp_PCVCDSCBat_C DSM_CDCDfp_PCVCDSCGnd_C DSM_CDCDfp_PCVCD_ADC_C DSM_CDCDfp_PCVCD_SigTst_C DSM_CDCDfp_PFltAPSens_C DSM_CDCDfp_PFltCDPPre_C DSM_CDCDfp_PFltCDTempPre_C DSM_CDCDfp_PFltChar_C DSM_CDCDfp_PFltEngPrt_C DSM_CDCDfp_PFltPresDynPlaus_C DSM_CDCDfp_PFltPresSens_C DSM_CDCDfp_PFltPresSensFrz_C DSM_CDCDfp_PFltPresSensHsLn_C DSM_CDCDfp_PFltPresSensSot_C DSM_CDCDfp_PFltRgnPerm_C DSM_CDCDfp_PFltTempDwnStrm_C DSM_CDCDfp_PFltTempSens_C DSM_CDCDfp_PFltTempUpStrm_C DSM_CDCDfp_PFltmSotDiffMax_C DSM_CDCDfp_QLTCD_C DSM_CDCDfp_RTMMon_C DSM_CDCDfp_RailCD_C DSM_CDCDfp_RailCDOfsTst_C DSM_CDCDfp_RailCD_PMonStrt_C DSM_CDCDfp_RailCtlModeMeUnDiag_C DSM_CDCDfp_RailCtlModePCVDiag_C DSM_CDCDfp_RailMeUn0_C DSM_CDCDfp_RailMeUn1_C DSM_CDCDfp_RailMeUn2_C DSM_CDCDfp_RailMeUn3_C DSM_CDCDfp_RailMeUn4_C DSM_CDCDfp_RailPCV0_C DSM_CDCDfp_RailPCV1_C DSM_CDCDfp_RailPCV2_C DSM_CDCDfp_RailPCV3_C DSM_CDCDfp_RailPCV4_C DSM_CDCDfp_RailPCV5_C DSM_CDCDfp_SOPTst_C DSM_CDCDfp_SSpMon1_C DSM_CDCDfp_SSpMon2_C DSM_CDCDfp_SSpMon3_C DSM_CDCDfp_ShutCD_C DSM_CDCDfp_StSysTrqShutOff_C DSM_CDCDfp_StrtCD_Actr_C DSM_CDCDfp_SysLamp_C DSM_CDCDfp_T15CD_C DSM_CDCDfp_TGearbx_C DSM_CDCDfp_TPUMon_C DSM_CDCDfp_TVACD_Max_C DSM_CDCDfp_TVACD_Min_C DSM_CDCDfp_TVACD_SigNpl_C DSM_CDCDfp_TVACD_TVADia1_C DSM_CDCDfp_TVACD_TVADia2_C DSM_CDCDfp_TVACD_TVADia3_C DSM_CDCDfp_VSACD_Max_C DSM_CDCDfp_VSACD_Min_C DSM_CDCDfp_VSACD_SigNpl_C DSM_CDCDfp_VSACD_VSADia1_C DSM_CDCDfp_VSACD_VSADia2_C DSM_CDCDfp_VSACD_VSADia3_C DSM_CDCDfp_VSACD_VSADia4_C DSM_CDCDfp_VSSCD1_C DSM_CDCDfp_VSSCD2_C DSM_CDCDfp_WdCom_C /end DEF_CHARACTERISTIC
/end FUNCTION
/begin COMPU_METHOD FactHigh "Faktor mit Auflösung 1/4096, hauptsächlich für einen Faktorenbereich 0.1...10 verwendet" RAT_FUNC "%6.5" "-" COEFFS 0 8192 0 0 0 1 /end COMPU_METHOD
/begin COMPU_METHOD OneToOne "eins zu eins (physikalischer Wert ist gleich dem internen Wert)" RAT_FUNC "%6.2" "-" COEFFS 0 1 0 0 0 1 /end COMPU_METHOD
/begin RECORD_LAYOUT Kwb_Wu16 FNC_VALUES 1 UWORD COLUMN_DIR DIRECT /end RECORD_LAYOUT
/begin RECORD_LAYOUT Kw_Wu8 FNC_VALUES 1 UBYTE COLUMN_DIR DIRECT /end RECORD_LAYOUT
/end MODULE
/end PROJECT
