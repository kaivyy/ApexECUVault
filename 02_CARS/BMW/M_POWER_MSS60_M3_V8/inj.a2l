ASAP2_VERSION 1 30
/begin PROJECT MSS65-inj "Generiert am 14.10.05 um 11:34:36"
/begin HEADER "" VERSION "R341" /end HEADER
/begin MODULE _MSS65-inj "Generiert am 14.10.05 um 11:34:36"
/begin MOD_COMMON "" BYTE_ORDER MSB_FIRST ALIGNMENT_BYTE 1 ALIGNMENT_WORD 2 ALIGNMENT_LONG 4 ALIGNMENT_FLOAT32_IEEE 4 ALIGNMENT_FLOAT64_IEEE 8 /end MOD_COMMON
/begin CHARACTERISTIC CBATT_DEF "Ersatzwert Batteriekapazität" VALUE 0x75E64 TKW_VV_VV_UB 100.0 FORMULA_0487 1.0 255.0 /end CHARACTERISTIC
/begin CHARACTERISTIC CW_BATTCOD "Enable Handcodierung" VALUE 0x7455A TKW_VV_VV_UB 100.0 FORMULA_0003 0.0 2.0 /end CHARACTERISTIC
/begin CHARACTERISTIC CW_CCMASK "CC-Meldung Maske" VALUE 0x75ADA TKW_VV_VV_UB 100.0 FORMULA_0003 0.0 255.0 /end CHARACTERISTIC
/begin CHARACTERISTIC CW_PMDEFMASK "Bitcodierte Maske zum Setzen von PM Defekt" VALUE 0x75ADB TKW_VV_VV_UB 100.0 FORMULA_0003 0.0 255.0 /end CHARACTERISTIC
/begin CHARACTERISTIC CW_PMMASKDFP "Powermanagement Fehlerpseicher Maske" VALUE 0x75BBA TKW_VV_VV_UB 100.0 FORMULA_0003 0.0 255.0 /end CHARACTERISTIC
/begin CHARACTERISTIC K_ABKORROVER "schlechter absch_korr Schwelle ueberschritten" VALUE 0x75AC0 TKW_VV_VV_SW 100.0 FORMULA_0499 -50.0 49.9984016418457 FORMAT "%5.2" /end CHARACTERISTIC
/begin CHARACTERISTIC K_ABSCHKORA "Applikationswert für Korrektur Abschaltung" VALUE 0x7604A TKW_VV_VV_SW 100.0 FORMULA_0499 -50.0 49.9984016418457 FORMAT "%5.2" /end CHARACTERISTIC
/begin CHARACTERISTIC K_APPTBATINI "Enable Applikation Initwert Batterietemperatur" VALUE 0x7455B TKW_VV_VV_UB 100.0 FORMULA_0003 0.0 255.0 /end CHARACTERISTIC
/begin CHARACTERISTIC K_BATT_ALFAH "Alphatau-Wert Batterie hinten" VALUE 0x74546 TKW_VV_VV_UW 100.0 FORMULA_0460 1.52587890625e-005 0.9999847412109375 FORMAT "%7.4" /end CHARACTERISTIC
/begin CHARACTERISTIC K_BATT_ALFAV "Alphatau-Wert Batterie vorne" VALUE 0x74548 TKW_VV_VV_UW 100.0 FORMULA_0460 1.52587890625e-005 0.9999847412109375 FORMAT "%7.4" /end CHARACTERISTIC
/begin CHARACTERISTIC K_BATT_BETAV "Beta-Wert Batterie vorne" VALUE 0x7454A TKW_VV_VV_UW 100.0 FORMULA_0460 1.52587890625e-005 0.9999847412109375 FORMAT "%7.4" /end CHARACTERISTIC
/begin CHARACTERISTIC K_BATTHTAUVG "Zeitkonstante Batterie hinten bei VFZG>" VALUE 0x7453E TKW_VV_VV_UW 100.0 FORMULA_0460 0.0 0.9999847412109375 FORMAT "%7.4" /end CHARACTERISTIC
/begin CHARACTERISTIC K_BATTHTAUVK "Zeitkonstante Batterie hinten bei VFZG<" VALUE 0x74540 TKW_VV_VV_UW 100.0 FORMULA_0460 0.0 0.9999847412109375 FORMAT "%7.4" /end CHARACTERISTIC
/begin CHARACTERISTIC K_BATTINDAPP "batt_index appl." VALUE 0x75ADC TKW_VV_VV_UB 100.0 FORMULA_0003 0.0 255.0 /end CHARACTERISTIC
/begin CHARACTERISTIC K_BATTORT0 "Batterieeinbauort No1" VALUE 0x7455C TKW_VV_VV_UB 100.0 FORMULA_0003 0.0 2.0 /end CHARACTERISTIC
/begin CHARACTERISTIC K_BATTORT2 "Batterieeinbauort No2" VALUE 0x7455D TKW_VV_VV_UB 100.0 FORMULA_0003 0.0 2.0 /end CHARACTERISTIC
/begin CHARACTERISTIC K_BATTREGAPP "Batterietauschregristrieren App" VALUE 0x75ADD TKW_VV_VV_UB 100.0 FORMULA_0003 0.0 255.0 /end CHARACTERISTIC
/begin CHARACTERISTIC K_BATTVTAUVG "Zeitkonstante Batterie vorne bei VFZG>" VALUE 0x74542 TKW_VV_VV_UW 100.0 FORMULA_0460 0.0 0.9999847412109375 FORMAT "%7.4" /end CHARACTERISTIC
/begin CHARACTERISTIC K_BATTVTAUVK "Zeitkonstante Batterie bei VFZG<Zeitkonstante Batterie bei VFZG>" VALUE 0x74544 TKW_VV_VV_UW 100.0 FORMULA_0460 0.0 0.9999847412109375 FORMAT "%7.4" /end CHARACTERISTIC
/begin CHARACTERISTIC K_BATVFZGTAU "VFZG-Umschaltschwelle TAU Batterie" VALUE 0x7454C TKW_VV_VV_UW 100.0 FORMULA_0474 0.0 65535.0 /end CHARACTERISTIC
/begin CHARACTERISTIC K_BILA_OGRZ "Grenzwert oberhalb dessen eine Apassung durch soc_kor nicht zulässig ist" VALUE 0x76058 TKW_VV_VV_UW 100.0 FORMULA_0462 0.0 99.99839782714844 FORMAT "%5.2" /end CHARACTERISTIC
/begin CHARACTERISTIC K_BILA_UGRZ "" VALUE 0x7605A TKW_VV_VV_UW 100.0 FORMULA_0462 0.0 99.99839782714844 FORMAT "%5.2" /end CHARACTERISTIC
/begin CHARACTERISTIC K_CAN_ALIVE_ERR_MAX "Schwelle Aliveerror" VALUE 0x7077B TKW_VV_VV_UB 100.0 FORMULA_0003 0.0 255.0 /end CHARACTERISTIC
/begin CHARACTERISTIC K_CAN_CFG "CAN-Sonderfunktionen" VALUE 0x7077A TKW_VV_VV_UB 100.0 FORMULA_0624 0.0 255.0 /end CHARACTERISTIC
/begin CHARACTERISTIC K_CAN_CHKSUM_ERR_MAX "Schwelle Chksum-Error" VALUE 0x7077C TKW_VV_VV_UB 100.0 FORMULA_0003 0.0 255.0 /end CHARACTERISTIC
/begin CHARACTERISTIC K_CAN_CLAS_BAT_INIT "Batterieklasse" VALUE 0x7077F TKW_VV_VV_UB 100.0 FORMULA_0614 0.0 255.0 /end CHARACTERISTIC
/begin CHARACTERISTIC K_CAN_CRASH_CTR_TOUT "Crash-Kontrolle bei Timeout" VALUE 0x7077D TKW_VV_VV_UB 100.0 FORMULA_0625 0.0 255.0 /end CHARACTERISTIC
/begin CHARACTERISTIC K_CAN_ED_TSPERR "ED-Sperrzeit" VALUE 0x70778 TKW_VV_VV_UW 100.0 FORMULA_0606 0.0 327.6749877929688 FORMAT "%5.2" /end CHARACTERISTIC
/begin CHARACTERISTIC K_CAN_ED_UB_MIN "min. Ub fuer CAN-Diagnose" VALUE 0x70776 TKW_VV_VV_SW 100.0 FORMULA_0008 0.0 28.0 FORMAT "%4.1" /end CHARACTERISTIC
/begin CHARACTERISTIC K_CAN_I_SC_MAX_INIT "max. Kurzschlußstrom" VALUE 0x70782 TKW_VV_VV_UB 100.0 FORMULA_0616 0.0 2550.0 /end CHARACTERISTIC
/begin CHARACTERISTIC K_CAN_I_SC_MIN_INIT "min. Kurzschlußstrom" VALUE 0x70781 TKW_VV_VV_UB 100.0 FORMULA_0616 0.0 2550.0 /end CHARACTERISTIC
/begin CHARACTERISTIC K_CAN_KEY_NO_MCS "Schluesselnummer per MCS" VALUE 0x70783 TKW_VV_VV_UB 100.0 FORMULA_0003 0.0 255.0 /end CHARACTERISTIC
/begin CHARACTERISTIC K_CAN_QC_VEH_INIT "Ruhestrom Fahrzeug" VALUE 0x70780 TKW_VV_VV_UB 100.0 FORMULA_0615 0.0 255.0 /end CHARACTERISTIC
/begin CHARACTERISTIC K_CAN_TUMG_MCS "Tumg per MCS" VALUE 0x7077E TKW_VV_VV_UB 100.0 FORMULA_0626 -40.0 87.5 /end CHARACTERISTIC
/begin CHARACTERISTIC K_CBATTAPP "Cbattnenn appl." VALUE 0x75ADE TKW_VV_VV_UB 100.0 FORMULA_0487 0.0 255.0 /end CHARACTERISTIC
/begin CHARACTERISTIC K_CCPRIOSET "Schwelle von E65Prios ab dem ccmeldung aktiv ist." VALUE 0x75ADF TKW_VV_VV_UB 100.0 FORMULA_0003 0.0 7.0 /end CHARACTERISTIC
/begin CHARACTERISTIC K_CCPRIOTIME "Zeitverschiebung bis ccmeldung gesetzt wird." VALUE 0x75AE0 TKW_VV_VV_UB 100.0 FORMULA_0461 0.0 25.5 /end CHARACTERISTIC
/begin CHARACTERISTIC K_CCPWRSET "ctrpwrcos Schwelle ab dem CC Meldung aktiviert wird. " VALUE 0x75ACA TKW_VV_VV_UW 100.0 FORMULA_0010 0.0 65535.0 /end CHARACTERISTIC
/begin CHARACTERISTIC K_CRENGOF "" VALUE 0x70426 TKW_VV_VV_UW 100.0 FORMULA_0485 0.0 4095.9375 FORMAT "%6.3" /end CHARACTERISTIC
/begin CHARACTERISTIC K_CRVVTNOT "Wert vvt_iges bei vvt_es Fehlersignal" VALUE 0x70428 TKW_VV_VV_UW 100.0 FORMULA_0485 0.0 4095.9375 FORMAT "%6.3" /end CHARACTERISTIC
/begin CHARACTERISTIC K_CRVVTOF "" VALUE 0x7042A TKW_VV_VV_UW 100.0 FORMULA_0485 0.0 4095.9375 FORMAT "%6.3" /end CHARACTERISTIC
/begin CHARACTERISTIC K_CTRCBRA "" VALUE 0x75BEC TKW_VV_VV_UB 100.0 FORMULA_0003 0.0 255.0 /end CHARACTERISTIC
/begin CHARACTERISTIC K_CTRCBRAPP "Steuerung Stromzweige Applikationsgroesse" VALUE 0x75BED TKW_VV_VV_UB 100.0 FORMULA_0003 0.0 255.0 /end CHARACTERISTIC
/begin CHARACTERISTIC K_CTRCBRKBM "CTRCBR APP bei B_startfgk" VALUE 0x75BEE TKW_VV_VV_UB 100.0 FORMULA_0003 0.0 255.0 /end CHARACTERISTIC
/begin CHARACTERISTIC K_CTRPCOSAPP "Steuerung Standverbraucher Applikationsgroesse" VALUE 0x75BEF TKW_VV_VV_UB 100.0 FORMULA_0003 0.0 3.0 /end CHARACTERISTIC
/begin CHARACTERISTIC K_CTRPRIOAPP "Steuerung Spitzenreduzierung Prioritaet Applikationsgroesse" VALUE 0x75BF0 TKW_VV_VV_UB 100.0 FORMULA_0003 0.0 7.0 /end CHARACTERISTIC
/begin CHARACTERISTIC K_CTRPRIOCF "" VAL_BLK 0x75C42 TKW_VV_VV_UB 100.0 FORMULA_0003 0.0 255.0 NUMBER 7 /end CHARACTERISTIC
/begin CHARACTERISTIC K_CTRPWRCF "" VAL_BLK 0x75C18 TKW_VV_VV_UW 100.0 FORMULA_0010 0.0 65535.0 NUMBER 7 /end CHARACTERISTIC
/begin CHARACTERISTIC K_CTRPWRDF "" VAL_BLK 0x75C26 TKW_VV_VV_UW 100.0 FORMULA_0010 0.0 65535.0 NUMBER 14 /end CHARACTERISTIC
/begin CHARACTERISTIC K_DAB_KORR1 "Korrekturkonstante 1 für Abschaltung" VALUE 0x7604C TKW_VV_VV_SW 100.0 FORMULA_0499 -50.0 49.9984016418457 FORMAT "%5.2" /end CHARACTERISTIC
/begin CHARACTERISTIC K_DAB_KORR2 "Korrekturkonstante 2 für Abschaltung" VALUE 0x7604E TKW_VV_VV_SW 100.0 FORMULA_0499 -50.0 49.9984016418457 FORMAT "%5.2" /end CHARACTERISTIC
/begin CHARACTERISTIC K_DAB_KORR3 "Korrekturkonstante 3 für Abschaltung" VALUE 0x76050 TKW_VV_VV_SW 100.0 FORMULA_0499 -50.0 49.9984016418457 FORMAT "%5.2" /end CHARACTERISTIC
/begin CHARACTERISTIC K_DF_LP "K-Faktor des df-Tiefpass Filters zur Berechnung von ctrpwrdf" VALUE 0x75BF4 TKW_VV_VV_UB 100.0 FORMULA_0455 0.0 0.9959999918937683 /end CHARACTERISTIC
/begin CHARACTERISTIC K_DFFILTAPP "Schalter, um dffgenfilt auf DFFILT_APP umzustellen" VALUE 0x75BF1 TKW_VV_VV_UB 100.0 FORMULA_0475 0.0 99.60929870605469 /end CHARACTERISTIC
/begin CHARACTERISTIC K_DFKOMMERR "Ersatzwert Dffgen bei Gen. Komm. Fehler" VALUE 0x75BF2 TKW_VV_VV_UB 100.0 FORMULA_0475 0.0 99.60929870605469 /end CHARACTERISTIC
/begin CHARACTERISTIC K_DFLLMIN "DF unterhalb derer die LLDZanh. zurueckgenommen wird." VALUE 0x74642 TKW_VV_VV_UB 100.0 FORMULA_0475 0.0 99.60929870605469 /end CHARACTERISTIC
/begin CHARACTERISTIC K_DFMAX "Obere Schwelle DF Signal" VALUE 0x74643 TKW_VV_VV_UB 100.0 FORMULA_0475 0.0 99.60929870605469 /end CHARACTERISTIC
/begin CHARACTERISTIC K_DFOVERRIDE "Schwellwert wann Generator als ueberlastet erkannt wird" VALUE 0x760E6 TKW_VV_VV_UB 100.0 FORMULA_0475 0.0 99.60929870605469 /end CHARACTERISTIC
/begin CHARACTERISTIC K_DFPTC_LP "K-Faktor des df-Tiefpass Filters zur Berechnung von PTC" VALUE 0x75BF3 TKW_VV_VV_UB 100.0 FORMULA_0455 0.0 0.9959999918937683 /end CHARACTERISTIC
/begin CHARACTERISTIC K_DFRUTYP "DF-Rückschaltungstyp für LLR-Anhebung" VALUE 0x70604 TKW_VV_VV_UB 100.0 FORMULA_0003 0.0 255.0 /end CHARACTERISTIC
/begin CHARACTERISTIC K_DSOCA "Applikationsgrösse für d_soc" VALUE 0x76052 TKW_VV_VV_SW 100.0 FORMULA_0479 -100.0 99.99690246582031 FORMAT "%5.2" /end CHARACTERISTIC
/begin CHARACTERISTIC K_DSOCABSCH "Applikationsgrösse für d_soc" VALUE 0x76054 TKW_VV_VV_SW 100.0 FORMULA_0479 -100.0 99.99690246582031 FORMAT "%5.2" /end CHARACTERISTIC
/begin CHARACTERISTIC K_DSOCHYST "Hystereschwelle SOC" VALUE 0x7463C TKW_VV_VV_SW 100.0 FORMULA_0479 -100.0 99.99690246582031 FORMAT "%5.2" /end CHARACTERISTIC
/begin CHARACTERISTIC K_DSOCHYSTCC "DSOC Hyst. fuer B_ccbtnach reset " VALUE 0x75AC2 TKW_VV_VV_SW 100.0 FORMULA_0479 -100.0 99.99690246582031 FORMAT "%5.2" /end CHARACTERISTIC
/begin CHARACTERISTIC K_DSOCLLANH "Abstand zur Stfgrz, bei der die LLDZanh aktiviert wird." VALUE 0x7463E TKW_VV_VV_SW 100.0 FORMULA_0479 -100.0 99.99690246582031 FORMAT "%5.2" /end CHARACTERISTIC
/begin CHARACTERISTIC K_DSOCLOW "DSOC Grenze f. CCmeld Batt Nachladen" VALUE 0x75AC4 TKW_VV_VV_SW 100.0 FORMULA_0479 -100.0 99.99690246582031 FORMAT "%5.2" /end CHARACTERISTIC
/begin CHARACTERISTIC K_DSOCPCOS "dsoc, unterhalb derer die Standverbraucher deaktiviert werden." VALUE 0x75BBC TKW_VV_VV_SW 100.0 FORMULA_0479 -100.0 99.99690246582031 FORMAT "%5.2" /end CHARACTERISTIC
/begin CHARACTERISTIC K_DTANSKOR "Ansaugluftmodelloffset Aussentemperatur" VALUE 0x7452E TKW_VV_VV_SW 100.0 FORMULA_0431 -3276.800048828125 3276.699951171875 /end CHARACTERISTIC
/begin CHARACTERISTIC K_DUDTPTCAUS "K-Faktor für dudt-PTC Abschaltung" VALUE 0x75BC2 TKW_VV_VV_UW 100.0 FORMULA_0460 0.0 0.9999847412109375 FORMAT "%7.4" /end CHARACTERISTIC
/begin CHARACTERISTIC K_HISTDMERST "Manueller Reset d. Histogramm in der DME" VALUE 0x75AE1 TKW_VV_VV_UB 100.0 FORMULA_0003 0.0 255.0 /end CHARACTERISTIC
/begin CHARACTERISTIC K_HISTIBSRST "Manueller Histogramm Reset in IBS" VALUE 0x75AE2 TKW_VV_VV_UB 100.0 FORMULA_0003 0.0 255.0 /end CHARACTERISTIC
/begin CHARACTERISTIC K_I_FITAUSW "Grenzwert Fitstrom" VALUE 0x75EC4 TKW_VV_VV_UW 100.0 FORMULA_0508 -200.0 5042.7998046875 FORMAT "%6.3" /end CHARACTERISTIC
/begin CHARACTERISTIC K_IABGLMOT "Konstante Abgleichstrom Motor" VALUE 0x7041E TKW_VV_VV_SW 100.0 FORMULA_0486 -32.76800155639648 32.76699829101563 FORMAT "%6.3" /end CHARACTERISTIC
/begin CHARACTERISTIC K_IABGLNL "Konstante Abgleichstrom Kl. 15" VALUE 0x70420 TKW_VV_VV_SW 100.0 FORMULA_0486 -32.76800155639648 32.76699829101563 FORMAT "%6.3" /end CHARACTERISTIC
/begin CHARACTERISTIC K_IABGLST "Konstante Abgleichstrom Start" VALUE 0x70422 TKW_VV_VV_SW 100.0 FORMULA_0486 -32.76800155639648 32.76699829101563 FORMAT "%6.3" /end CHARACTERISTIC
/begin CHARACTERISTIC K_IB_COMMVAL "Anzahl Taskaufrufe zwischen periodischer Abfrage qlad und qelad" VALUE 0x75E65 TKW_VV_VV_UB 100.0 FORMULA_0003 0.0 255.0 /end CHARACTERISTIC
/begin CHARACTERISTIC K_IBSWAKEAPP "Bit, ob IBS Bus wecken darf oder nicht. Applikationsgroesse." VALUE 0x75BF5 TKW_VV_VV_UB 100.0 FORMULA_0003 0.0 255.0 /end CHARACTERISTIC
/begin CHARACTERISTIC K_IGENLLRANH "Generatorstromabstand für LL-Anhebung" VALUE 0x70605 TKW_VV_VV_UB 100.0 FORMULA_0463 0.0 254.0 /end CHARACTERISTIC
/begin CHARACTERISTIC K_IGRDETEC "U_gsoll - U_ibs Max für Freeze" VALUE 0x760D6 TKW_VV_VV_SW 100.0 FORMULA_0488 -128.0 127.9960021972656 FORMAT "%6.3" /end CHARACTERISTIC
/begin CHARACTERISTIC K_IKEINESA "Konstante Strom wenn keine SA" VALUE 0x70424 TKW_VV_VV_SW 100.0 FORMULA_0486 -32.76800155639648 32.76699829101563 FORMAT "%6.3" /end CHARACTERISTIC
/begin CHARACTERISTIC K_ILMINUMG "integrierte Lufmassenschwelle Aussentemperaturmodell" VALUE 0x7454E TKW_VV_VV_UW 100.0 FORMULA_0489 0.0 29.12660026550293 FORMAT "%6.3" /end CHARACTERISTIC
/begin CHARACTERISTIC K_IPMPMDEC "Prio-dekrementfaktor aufgrund IPM" VALUE 0x75BC4 TKW_VV_VV_UW 100.0 FORMULA_0507 0.0 450.0 FORMAT "%6.3" /end CHARACTERISTIC
/begin CHARACTERISTIC K_IPMPMINC "Prio-Inkrementfaktor aufgrund IPM" VALUE 0x75BC6 TKW_VV_VV_UW 100.0 FORMULA_0507 0.0 450.0 FORMAT "%6.3" /end CHARACTERISTIC
/begin CHARACTERISTIC K_IWAKEAPP "Wakeupgrenze Appl." VALUE 0x75AE3 TKW_VV_VV_UB 100.0 FORMULA_0496 0.0 0.2549999952316284 /end CHARACTERISTIC
/begin CHARACTERISTIC K_KBMCNT_APP "Zeit, indem KBM alle Straenge einschalten soll." VALUE 0x75BF6 TKW_VV_VV_UB 100.0 FORMULA_0461 0.0 25.5 /end CHARACTERISTIC
/begin CHARACTERISTIC K_KSOGRZAPP "Ikurz_ogrz appl." VALUE 0x75AE4 TKW_VV_VV_UB 100.0 FORMULA_0502 0.0 998.4000244140625 /end CHARACTERISTIC
/begin CHARACTERISTIC K_KSUGRZAPP "Ikurz_ugrz Appl." VALUE 0x75AE5 TKW_VV_VV_UB 100.0 FORMULA_0502 0.0 1000.0 /end CHARACTERISTIC
/begin CHARACTERISTIC K_LBATTMAXK "maximale Batterieladespannung Kofferraum" VALUE 0x7451A TKW_VV_VV_SW 100.0 FORMULA_0488 0.0 127.9960021972656 FORMAT "%6.3" /end CHARACTERISTIC
/begin CHARACTERISTIC K_LBATTMAXM "maximale Batterieladespannung" VALUE 0x7451C TKW_VV_VV_SW 100.0 FORMULA_0488 0.0 127.9960021972656 FORMAT "%6.3" /end CHARACTERISTIC
/begin CHARACTERISTIC K_LBATTMIN "minmale Batterieladespannung Licht an" VALUE 0x7451E TKW_VV_VV_SW 100.0 FORMULA_0488 0.0 127.9960021972656 FORMAT "%6.3" /end CHARACTERISTIC
/begin CHARACTERISTIC K_LBATTTUMG "" VALUE 0x74520 TKW_VV_VV_SW 100.0 FORMULA_0431 -3276.800048828125 3276.699951171875 /end CHARACTERISTIC
/begin CHARACTERISTIC K_LBATTTUMGBA "" VALUE 0x74522 TKW_VV_VV_SW 100.0 FORMULA_0431 -3276.800048828125 3276.699951171875 /end CHARACTERISTIC
/begin CHARACTERISTIC K_LLANHAPP "LLDZanh.-level, falls Generator fehlerhaft ist." VALUE 0x74644 TKW_VV_VV_UB 100.0 FORMULA_0003 0.0 255.0 /end CHARACTERISTIC
/begin CHARACTERISTIC K_LLPMAPP "Handapplikationswert für Leerlaufdrehzahlvorgabe" VALUE 0x74645 TKW_VV_VV_UB 100.0 FORMULA_0003 0.0 255.0 /end CHARACTERISTIC
/begin CHARACTERISTIC K_LLPMFILTK "Filterkonstante : Tiefpassfilter DF-Signal" VALUE 0x75BF7 TKW_VV_VV_UB 100.0 FORMULA_0455 0.0 0.9959999918937683 /end CHARACTERISTIC
/begin CHARACTERISTIC K_LLRABS_DF "DF-Schwelle für LL-Absenkung" VALUE 0x70606 TKW_VV_VV_UB 100.0 FORMULA_0475 0.0 99.60929870605469 /end CHARACTERISTIC
/begin CHARACTERISTIC K_LLRANH_DF "DF-Schwelle für LL-Anhebung" VALUE 0x70607 TKW_VV_VV_UB 100.0 FORMULA_0475 0.0 99.60929870605469 /end CHARACTERISTIC
/begin CHARACTERISTIC K_MCOBATTORT "Codierung Hand Batterieeinbauort" VALUE 0x7455E TKW_VV_VV_UB 100.0 FORMULA_0003 0.0 2.0 /end CHARACTERISTIC
/begin CHARACTERISTIC K_MN_PTCPI "Minimalwert des PI-Reglers PTC Ansteuerung" VALUE 0x75BC8 TKW_VV_VV_UW 100.0 FORMULA_0484 0.0 511.9920959472656 FORMAT "%5.2" /end CHARACTERISTIC
/begin CHARACTERISTIC K_MN_PWRDFPI "Minimaler Wert PI-Regler df Prio" VALUE 0x75BCA TKW_VV_VV_UW 100.0 FORMULA_0484 0.0 511.9920959472656 FORMAT "%5.2" /end CHARACTERISTIC
/begin CHARACTERISTIC K_MSKIBSDFP "Bitmaske Generator Fehler-> DFP" VALUE 0x7079E TKW_VV_VV_UB 100.0 FORMULA_0003 0.0 255.0 /end CHARACTERISTIC
/begin CHARACTERISTIC K_MSKIBSDFP2 "" VALUE 0x7079F TKW_VV_VV_UB 100.0 FORMULA_0003 0.0 255.0 /end CHARACTERISTIC
/begin CHARACTERISTIC K_MSKIBSDIAG "Test AK disable Diagnose" VALUE 0x707A0 TKW_VV_VV_UB 100.0 FORMULA_0003 0.0 255.0 /end CHARACTERISTIC
/begin CHARACTERISTIC K_MSKIBSERR "" VALUE 0x707A1 TKW_VV_VV_UB 100.0 FORMULA_0487 0.0 255.0 /end CHARACTERISTIC
/begin CHARACTERISTIC K_MSKIBSERR2 "" VALUE 0x707A2 TKW_VV_VV_UB 100.0 FORMULA_0487 0.0 255.0 /end CHARACTERISTIC
/begin CHARACTERISTIC K_MX_PTCPI "Maximalwert des PI-Reglers PTC Ansteuerung" VALUE 0x75BCC TKW_VV_VV_UW 100.0 FORMULA_0484 0.0 511.9920959472656 FORMAT "%5.2" /end CHARACTERISTIC
/begin CHARACTERISTIC K_NKW2HIPTC "Nkw i.O. PTC darf zugeschaltet werden." VALUE 0x75BBE TKW_VV_VV_SW 100.0 FORMULA_0006 -32768.0 32767.0 /end CHARACTERISTIC
/begin CHARACTERISTIC K_NKW2LOWPTC "Nkw zu niedrig, PTC wird abgeschaltet" VALUE 0x75BC0 TKW_VV_VV_SW 100.0 FORMULA_0006 -32768.0 32767.0 /end CHARACTERISTIC
/begin CHARACTERISTIC K_NLLMIN "Motordrehzahl unterhalb derer die LLDZanh. zurueckgenommen wird." VALUE 0x74640 TKW_VV_VV_SW 100.0 FORMULA_0006 -32768.0 32767.0 /end CHARACTERISTIC
/begin CHARACTERISTIC K_NMINUMG "Drehzahlschwelle Aussentemperaturmodell" VALUE 0x74530 TKW_VV_VV_SW 100.0 FORMULA_0006 0.0 32767.0 /end CHARACTERISTIC
/begin CHARACTERISTIC K_NTWBGLLGEN "Notlaufwert Leerlaufanhebung bei Generatorfehler" VALUE 0x70608 TKW_VV_VV_UB 100.0 FORMULA_0003 0.0 1.0 /end CHARACTERISTIC
/begin CHARACTERISTIC K_OFTUMGCAN "Offset Umgebungstemperatur CAN" VALUE 0x74532 TKW_VV_VV_SW 100.0 FORMULA_0431 -3276.800048828125 3276.699951171875 /end CHARACTERISTIC
/begin CHARACTERISTIC K_OFULADE "Offset Ladekennlinie Batthinten" VALUE 0x74534 TKW_VV_VV_SW 100.0 FORMULA_0488 -128.0 127.9960021972656 FORMAT "%6.3" /end CHARACTERISTIC
/begin CHARACTERISTIC K_OSPGAPP "Oberspannungsschwelle" VALUE 0x75ACC TKW_VV_VV_UW 100.0 FORMULA_0501 6.0 22.38369941711426 FORMAT "%6.3" /end CHARACTERISTIC
/begin CHARACTERISTIC K_OSPGHYST "Unterspannungshysterese" VALUE 0x75AC6 TKW_VV_VV_SW 100.0 FORMULA_0500 -8.192000389099121 8.191699981689453 FORMAT "%6.3" /end CHARACTERISTIC
/begin CHARACTERISTIC K_OSPGPRELLZ "Anzahl der Entprellungen für Oberspannungsfehlereintrag" VALUE 0x75AE6 TKW_VV_VV_UB 100.0 FORMULA_0003 0.0 255.0 /end CHARACTERISTIC
/begin CHARACTERISTIC K_OSPRELLDEC "Dekrement auf Entprellcounter Oberspannung" VALUE 0x75AE7 TKW_VV_VV_UB 100.0 FORMULA_0003 0.0 255.0 /end CHARACTERISTIC
/begin CHARACTERISTIC K_OSPRELLINC "Inkrement auf Entprellcounter Oberspannung" VALUE 0x75AE8 TKW_VV_VV_UB 100.0 FORMULA_0003 0.0 255.0 /end CHARACTERISTIC
/begin CHARACTERISTIC K_PLBATTUMG "Plausibilisierung-Schwelle Batterieumgebungstemperatur" VALUE 0x74536 TKW_VV_VV_SW 100.0 FORMULA_0431 0.0 3276.699951171875 /end CHARACTERISTIC
/begin CHARACTERISTIC K_PM_IPMON "IPM Massnahmen bzgl. PM aktiviert" VALUE 0x75BF8 TKW_VV_VV_UB 100.0 FORMULA_0003 0.0 3.0 /end CHARACTERISTIC
/begin CHARACTERISTIC K_PM_TABSMN "Applikationsgrösse für Abstellzeit tabsmn_w" VALUE 0x7605E TKW_VV_VV_UW 100.0 FORMULA_0514 0.0 65535.0 FORMAT "%4.1" /end CHARACTERISTIC
/begin CHARACTERISTIC K_PMQ_UX "Ruhespannung Extrapolationsteiler" VALUE 0x75E66 TKW_VV_VV_UB 100.0 FORMULA_0449 3.130000084638596e-002 7.968699932098389 /end CHARACTERISTIC
/begin CHARACTERISTIC K_PMTIMERSQ1 "Startwert Timer für soc_quali" VALUE 0x7605C TKW_VV_VV_UW 100.0 FORMULA_0010 0.0 65535.0 /end CHARACTERISTIC
/begin CHARACTERISTIC K_PMUBAT_MAX "Max. zugelassene Batteriespg " VALUE 0x760E2 TKW_VV_VV_UW 100.0 FORMULA_0501 6.0 22.38369941711426 FORMAT "%6.3" /end CHARACTERISTIC
/begin CHARACTERISTIC K_PMUBAT_MIN "Min. zugelassene Batteriespg" VALUE 0x760E4 TKW_VV_VV_UW 100.0 FORMULA_0501 6.0 22.38369941711426 FORMAT "%6.3" /end CHARACTERISTIC
/begin CHARACTERISTIC K_PMUGEN_MAX "Max zugelassene Generatorspg" VALUE 0x760D8 TKW_VV_VV_SW 100.0 FORMULA_0488 -128.0 127.9960021972656 FORMAT "%6.3" /end CHARACTERISTIC
/begin CHARACTERISTIC K_PMUGEN_MIN "Min zugelassene Generatorspg" VALUE 0x760DA TKW_VV_VV_SW 100.0 FORMULA_0488 -128.0 127.9960021972656 FORMAT "%6.3" /end CHARACTERISTIC
/begin CHARACTERISTIC K_PRELLDFAH "Prellzeit für LLR-Anhebung" VALUE 0x70609 TKW_VV_VV_UB 100.0 FORMULA_0461 0.0 25.5 /end CHARACTERISTIC
/begin CHARACTERISTIC K_PRELLDFRF "Prellzeit für LLR-Absenkung" VALUE 0x7060A TKW_VV_VV_UB 100.0 FORMULA_0461 0.0 25.5 /end CHARACTERISTIC
/begin CHARACTERISTIC K_PRIO_R "Prio Bei Kl.R" VALUE 0x75BFD TKW_VV_VV_UB 100.0 FORMULA_0003 0.0 7.0 /end CHARACTERISTIC
/begin CHARACTERISTIC K_PRIO15 "Prios bei Kl.15, Motor aus" VALUE 0x75BF9 TKW_VV_VV_UB 100.0 FORMULA_0003 0.0 7.0 /end CHARACTERISTIC
/begin CHARACTERISTIC K_PRIOCF_R "Prio Comfort Bei Kl.R" VALUE 0x75BFC TKW_VV_VV_UB 100.0 FORMULA_0003 0.0 7.0 /end CHARACTERISTIC
/begin CHARACTERISTIC K_PRIOCF15 "PrioCF bei kl.15, Motor aus" VALUE 0x75BFA TKW_VV_VV_UB 100.0 FORMULA_0003 0.0 7.0 /end CHARACTERISTIC
/begin CHARACTERISTIC K_PRIOCFAPP "Steuerung Spitzenreduzierung Prioritaet Komfort App" VALUE 0x75BFB TKW_VV_VV_UB 100.0 FORMULA_0003 0.0 7.0 /end CHARACTERISTIC
/begin CHARACTERISTIC K_PRIODF "" VAL_BLK 0x75C49 TKW_VV_VV_UB 100.0 FORMULA_0003 0.0 255.0 NUMBER 7 /end CHARACTERISTIC
/begin CHARACTERISTIC K_PSAU_ADAPT_MAX "Maximaler Adaptionswert fuer PSAUx" VALUE 0x76120 TKW_VV_VV_SW 100.0 FORMULA_0075 0.0 200.0 FORMAT "%4.1" /end CHARACTERISTIC
/begin CHARACTERISTIC K_PSAU_ADAPT_MIN "Minimaler Adaptionswert fuer PSAUx" VALUE 0x76122 TKW_VV_VV_SW 100.0 FORMULA_0075 -200.0 0.0 FORMAT "%4.1" /end CHARACTERISTIC
/begin CHARACTERISTIC K_PSAU_CFG "Psau Konfigbyte" VALUE 0x76126 TKW_VV_VV_UB 100.0 FORMULA_1048 0.0 255.0 /end CHARACTERISTIC
/begin CHARACTERISTIC K_PSAU_DIAG_MAX "MAX PSAU fuer Diagnose " VALUE 0x7611C TKW_VV_VV_SW 100.0 FORMULA_0075 0.0 1200.0 FORMAT "%4.1" /end CHARACTERISTIC
/begin CHARACTERISTIC K_PSAU_DIAG_MIN "MIN Saugrohrdruch fuer Diagnose " VALUE 0x7611E TKW_VV_VV_SW 100.0 FORMULA_0075 -625.0 2000.0 FORMAT "%4.1" /end CHARACTERISTIC
/begin CHARACTERISTIC K_PSAU_OFFSET "Offset des Drucksensors" VALUE 0x7611A TKW_VV_VV_SW 100.0 FORMULA_0075 -1000.0 2000.0 FORMAT "%4.1" /end CHARACTERISTIC
/begin CHARACTERISTIC K_PSAU_SENSOR_CFG "Psau Ersatzwertaktivierung" VALUE 0x76125 TKW_VV_VV_UB 100.0 FORMULA_1047 0.0 255.0 /end CHARACTERISTIC
/begin CHARACTERISTIC K_PSAU_STEIGUNG "Steigung des Drucksensors" VALUE 0x76118 TKW_VV_VV_UW 100.0 FORMULA_1046 0.0 819.0 FORMAT "%4.1" /end CHARACTERISTIC
/begin CHARACTERISTIC K_PSAU_TAU "Filterkonstante PSAU nur im Zeitraster, nicht im Segment" VALUE 0x76124 TKW_VV_VV_UB 100.0 FORMULA_0658 1.009999960660934e-002 2.559999942779541 /end CHARACTERISTIC
/begin CHARACTERISTIC K_PSAU_WF_DLY "Verzoegerungszeit fuer psau_wf" VALUE 0x76127 TKW_VV_VV_UB 100.0 FORMULA_0358 10.0 100.0 /end CHARACTERISTIC
/begin CHARACTERISTIC K_PTC_PI "K-Faktor des PI-Reglers PTC-Ansteuerung" VALUE 0x75BFF TKW_VV_VV_UB 100.0 FORMULA_0455 0.0 0.9959999918937683 /end CHARACTERISTIC
/begin CHARACTERISTIC K_PTCPWRAPP "Ansteuerung PWM-Ausgang für PTC-Zuheizer. Applikationsgroesse." VALUE 0x75BFE TKW_VV_VV_UB 100.0 FORMULA_0510 0.0 127.5 /end CHARACTERISTIC
/begin CHARACTERISTIC K_PWRCOS_R "PowerCos Bitcodiert bei Kl.R" VALUE 0x75BD6 TKW_VV_VV_UW 100.0 FORMULA_0010 0.0 65535.0 /end CHARACTERISTIC
/begin CHARACTERISTIC K_PWRCOS15 "PWRCOS bei Kl.15, Motor aus" VALUE 0x75BCE TKW_VV_VV_UW 100.0 FORMULA_0010 0.0 65535.0 /end CHARACTERISTIC
/begin CHARACTERISTIC K_PWRCOSAPP "Steuerung Leistung Verbraucher bitcodiert Applikationsgroesse" VALUE 0x75BD0 TKW_VV_VV_UW 100.0 FORMULA_0010 0.0 65535.0 /end CHARACTERISTIC
/begin CHARACTERISTIC K_PWRCOSHT "ctrpwrcos-Wert bei Generator Hochtemperatur" VALUE 0x75BD2 TKW_VV_VV_UW 100.0 FORMULA_0010 0.0 65535.0 /end CHARACTERISTIC
/begin CHARACTERISTIC K_PWRCOSULEV "Bitcodierte ctrpwrcos Zuschaltung bei Sulev" VALUE 0x75BD4 TKW_VV_VV_UW 100.0 FORMULA_0010 0.0 65535.0 /end CHARACTERISTIC
/begin CHARACTERISTIC K_PWRCSGNDEF "ctrpwrcos-Wert bei Gen. mechn. el. Fehler" VALUE 0x75BD8 TKW_VV_VV_UW 100.0 FORMULA_0010 0.0 65535.0 /end CHARACTERISTIC
/begin CHARACTERISTIC K_PWRCSKOMM "ctrpwrcos Wert bei Gen. Komm. Fehler" VALUE 0x75BDA TKW_VV_VV_UW 100.0 FORMULA_0010 0.0 65535.0 /end CHARACTERISTIC
/begin CHARACTERISTIC K_PWRDF_PI "K-Faktor des PI Reglers zur Berechnung von ctrpwrdf" VALUE 0x75C00 TKW_VV_VV_UB 100.0 FORMULA_0455 0.0 0.9959999918937683 /end CHARACTERISTIC
/begin CHARACTERISTIC K_Q_BILAPWF "Defaultwert für q_bila nach Powerfail" VALUE 0x75E5C TKW_VV_VV_UW 100.0 FORMULA_0498 0.0 1192.750244140625 FORMAT "%6.3" /end CHARACTERISTIC
/begin CHARACTERISTIC K_QSOCCL1 "Grenze zur Ladezustandsqualitätsklasse1" VALUE 0x76060 TKW_VV_VV_UW 100.0 FORMULA_0498 0.0 1192.750244140625 FORMAT "%6.3" /end CHARACTERISTIC
/begin CHARACTERISTIC K_QSOCCL2 "Grenze zur Ladezustandsqualitätsklasse2" VALUE 0x76062 TKW_VV_VV_UW 100.0 FORMULA_0498 0.0 1192.750244140625 FORMAT "%6.3" /end CHARACTERISTIC
/begin CHARACTERISTIC K_QSOCCL3 "Grenze zur Ladezustandsqualitätsklasse3" VALUE 0x76064 TKW_VV_VV_UW 100.0 FORMULA_0498 0.0 1192.750244140625 FORMAT "%6.3" /end CHARACTERISTIC
/begin CHARACTERISTIC K_QSTARTFGA "Applikationswert für q_startfgk" VALUE 0x76066 TKW_VV_VV_UW 100.0 FORMULA_0498 0.0 1192.750244140625 FORMAT "%6.3" /end CHARACTERISTIC
/begin CHARACTERISTIC K_RAM_CHK_CFG "Ramcheck Config" VALUE 0x76655 TKW_VV_VV_UB 100.0 FORMULA_0362 0.0 255.0 /end CHARACTERISTIC
/begin CHARACTERISTIC K_RAM_CHK_T "Zeit fuer den Ramcheck pro Aufruf" VALUE 0x76654 TKW_VV_VV_UB 100.0 FORMULA_0361 1.0 255.0 /end CHARACTERISTIC
/begin CHARACTERISTIC K_RESET_PI "PI-Reset-Zeit bei steigender Kl.15" VALUE 0x75C01 TKW_VV_VV_UB 100.0 FORMULA_0461 0.0 25.5 /end CHARACTERISTIC
/begin CHARACTERISTIC K_RF_DYN_TAU "Filterkonstante fuer rf_dyn" VALUE 0x7665B TKW_VV_VV_UB 100.0 FORMULA_0658 1.009999960660934e-002 2.559999942779541 /end CHARACTERISTIC
/begin CHARACTERISTIC K_RF_E2_DYN_DELTA "Dynamikschwelle RF" VALUE 0x79CCC TKW_VV_VV_SW 100.0 FORMULA_0007 0.0 2.0 FORMAT "%6.3" /end CHARACTERISTIC
/begin CHARACTERISTIC K_RF_E2_DYN_T "Zeit nach Dynamikabbruch durch rf" VALUE 0x79CCA TKW_VV_VV_UW 100.0 FORMULA_0021 0.0 655.0 FORMAT "%5.2" /end CHARACTERISTIC
/begin CHARACTERISTIC K_RF_E2_DYN_TAU "Filterkonstante fuer rf_e2_dyn" VALUE 0x79CC8 TKW_VV_VV_UB 100.0 FORMULA_0658 1.009999960660934e-002 2.559999942779541 /end CHARACTERISTIC
/begin CHARACTERISTIC K_RF_E2_HFM_TAU "Tau fuer RF-E2 Filterung" VALUE 0x79CCE TKW_VV_VV_UB 100.0 FORMULA_0645 5.100000184029341e-003 1.279999971389771 /end CHARACTERISTIC
/begin CHARACTERISTIC K_RF_E2_T_MAX "Maximale Fehlerzeit Last fuer Ebene 2." VALUE 0x79CC6 TKW_VV_VV_UW 100.0 FORMULA_0021 0.0 655.0 FORMAT "%5.2" /end CHARACTERISTIC
/begin CHARACTERISTIC K_RF_HUBVOLUMEN "Hubvolumen " VALUE 0x76656 TKW_VV_VV_UW 100.0 FORMULA_1065 1.0 9.0 FORMAT "%6.3" /end CHARACTERISTIC
/begin CHARACTERISTIC K_RF_LUFTDICHTE "Luftdichte" VALUE 0x76658 TKW_VV_VV_UW 100.0 FORMULA_1066 0.1000000014901161 1.799999952316284 FORMAT "%6.3" /end CHARACTERISTIC
/begin CHARACTERISTIC K_RF_ST_LL_RAMP "Dauer der RF Rampe von START nach LL" VALUE 0x7665A TKW_VV_VV_UB 100.0 FORMULA_1067 0.0 100.0 /end CHARACTERISTIC
/begin CHARACTERISTIC K_RG_M_MAX "MAX-Begrenzung RG-Masse" VALUE 0x76738 TKW_VV_VV_SW 100.0 FORMULA_0104 -500.0 1500.0 FORMAT "%4.1" /end CHARACTERISTIC
/begin CHARACTERISTIC K_RG_M_MIN "MIN-Begrenzung RG-Masse" VALUE 0x76736 TKW_VV_VV_SW 100.0 FORMULA_0104 -500.0 1500.0 FORMAT "%4.1" /end CHARACTERISTIC
/begin CHARACTERISTIC K_RG_T_UES_AV_MAX "Max. Ueberschneidungszeit" VALUE 0x76740 TKW_VV_VV_UW 100.0 FORMULA_0985 0.0 40.0 FORMAT "%5.2" /end CHARACTERISTIC
/begin CHARACTERISTIC K_RG_TABG_FAKTOR "Verhaelt tzyl zu tabg LW" VALUE 0x7673C TKW_VV_VV_UW 100.0 FORMULA_0073 0.0 4.0 FORMAT "%6.3" /end CHARACTERISTIC
/begin CHARACTERISTIC K_RG_V_TOTVOLUMEN "Masse RG im Totvolumen" VALUE 0x7673E TKW_VV_VV_SW 100.0 FORMULA_1071 0.0 3000.0 FORMAT "%4.1" /end CHARACTERISTIC
/begin CHARACTERISTIC K_RG_WE_ANZ_SEGM "Anzahl der Segm. fuer Auf bzw. Abregeln" VALUE 0x76742 TKW_VV_VV_UB 100.0 FORMULA_1070 0.0 100.0 /end CHARACTERISTIC
/begin CHARACTERISTIC K_RG_X_START "RG-Gehalt Zustand Start" VALUE 0x7673A TKW_VV_VV_SW 100.0 FORMULA_0100 -0.5 0.5 FORMAT "%5.2" /end CHARACTERISTIC
/begin CHARACTERISTIC K_RIN_GRENZ1 "Grenzwert Innenwiderstand Batterie1" VALUE 0x760A2 TKW_VV_VV_UB 100.0 FORMULA_0458 0.0 31.875 /end CHARACTERISTIC
/begin CHARACTERISTIC K_RIN_GRENZ2 "Grenzwert Innenwiderstand Batterie2" VALUE 0x760A3 TKW_VV_VV_UB 100.0 FORMULA_0458 0.0 31.875 /end CHARACTERISTIC
/begin CHARACTERISTIC K_RIN_GRENZ3 "Grenzwert Innenwiderstand Batterie3" VALUE 0x760A4 TKW_VV_VV_UB 100.0 FORMULA_0458 0.0 31.875 /end CHARACTERISTIC
/begin CHARACTERISTIC K_RIN_GRENZ4 "Grenzwert Innenwiderstand Batterie4" VALUE 0x760A5 TKW_VV_VV_UB 100.0 FORMULA_0458 0.0 31.875 /end CHARACTERISTIC
/begin CHARACTERISTIC K_RIN_GRENZ5 "Grenzwert Innenwiderstand Batterie5" VALUE 0x760A6 TKW_VV_VV_UB 100.0 FORMULA_0458 0.0 31.875 /end CHARACTERISTIC
/begin CHARACTERISTIC K_RIN_GRENZ6 "Grenzwert Innenwiderstand Batterie6" VALUE 0x760A7 TKW_VV_VV_UB 100.0 FORMULA_0458 0.0 31.875 /end CHARACTERISTIC
/begin CHARACTERISTIC K_RIN_GRENZ7 "Grenzwert Innenwiderstand Batterie7" VALUE 0x760A8 TKW_VV_VV_UB 100.0 FORMULA_0458 0.0 31.875 /end CHARACTERISTIC
/begin CHARACTERISTIC K_RIN_GRENZ8 "Grenzwert Innenwiderstand Batterie8" VALUE 0x760A9 TKW_VV_VV_UB 100.0 FORMULA_0458 0.0 31.875 /end CHARACTERISTIC
/begin CHARACTERISTIC K_RLEITUNGK "Widerstand Ladeleitung Batterie Kofferraum" VALUE 0x74528 TKW_VV_VV_UB 100.0 FORMULA_0458 0.0 31.875 /end CHARACTERISTIC
/begin CHARACTERISTIC K_RLEITUNGM "Widerstand Ladeleitung Batterie Motorraum" VALUE 0x74529 TKW_VV_VV_UB 100.0 FORMULA_0458 0.0 31.875 /end CHARACTERISTIC
/begin CHARACTERISTIC K_RPS_CFG "Auswahl RPS-Modell" VALUE 0x769B2 TKW_VV_VV_UB 100.0 FORMULA_1077 0.0 255.0 /end CHARACTERISTIC
/begin CHARACTERISTIC K_RQPCOSA "Parameter für SV-Anmeldung" VALUE 0x75C02 TKW_VV_VV_UB 100.0 FORMULA_0003 0.0 3.0 /end CHARACTERISTIC
/begin CHARACTERISTIC K_RQPCOSAPP "Anforderung Standverbraucher Applikationsgroesse" VALUE 0x75C03 TKW_VV_VV_UB 100.0 FORMULA_0003 0.0 255.0 /end CHARACTERISTIC
/begin CHARACTERISTIC K_RQULCP "RQPCOS Master umschalter" VALUE 0x75C04 TKW_VV_VV_UB 100.0 FORMULA_0003 0.0 4.0 /end CHARACTERISTIC
/begin CHARACTERISTIC K_RUHVERMODE "Ruhestromverletzungserkennungsmode" VALUE 0x75AE9 TKW_VV_VV_UB 100.0 FORMULA_0003 0.0 255.0 /end CHARACTERISTIC
/begin CHARACTERISTIC K_SA_MD_FW_REL_MIN "relatvie Momenentenschwelle Zugbetr. in Schubbetrieb direkt" VALUE 0x769B4 TKW_VV_VV_SW 100.0 FORMULA_0001 0.0 100.0 FORMAT "%4.1" /end CHARACTERISTIC
/begin CHARACTERISTIC K_SA_MD_HYS "absolute Drehmomenthyst. fuer Erkennung SA" VALUE 0x769B6 TKW_VV_VV_SW 100.0 FORMULA_0001 0.0 100.0 FORMAT "%4.1" /end CHARACTERISTIC
/begin CHARACTERISTIC K_SA_MD_IND_NE_MAX "max. ind. Motormoment nach Eingriff fuer direkten Ueberg. nach SA" VALUE 0x769B8 TKW_VV_VV_SW 100.0 FORMULA_0009 -100.0 1000.0 FORMAT "%4.1" /end CHARACTERISTIC
/begin CHARACTERISTIC K_SA_MD_IND_NE_MIN "absolute md-Schwelle fuer Aktivierung der SA" VALUE 0x769BA TKW_VV_VV_SW 100.0 FORMULA_0009 -100.0 1000.0 FORMAT "%4.1" /end CHARACTERISTIC
/begin CHARACTERISTIC K_SA_MSR_SPERRZEIT "Hysterese für tzmin" VALUE 0x769C4 TKW_VV_VV_UW 100.0 FORMULA_0109 0.0 325.0 FORMAT "%5.2" /end CHARACTERISTIC
/begin CHARACTERISTIC K_SA_N_HYS "allg. Hyst. SA-Drehzahl" VALUE 0x769C0 TKW_VV_VV_SW 100.0 FORMULA_0006 0.0 10000.0 /end CHARACTERISTIC
/begin CHARACTERISTIC K_SA_TKAT_MIN "minimale Katalysatortemp. fuer Freigabe SA" VALUE 0x769BC TKW_VV_VV_SW 100.0 FORMULA_0023 -1000.0 1000.0 FORMAT "%4.1" /end CHARACTERISTIC
/begin CHARACTERISTIC K_SA_TZ_MIN_HYS "Hysterese für tzmin" VALUE 0x769C2 TKW_VV_VV_SW 100.0 FORMULA_0102 -50.0 60.0 FORMAT "%4.1" /end CHARACTERISTIC
/begin CHARACTERISTIC K_SA_WE_MD_HYS "absolute md-Schwelle fuer Erkennung WE" VALUE 0x769BE TKW_VV_VV_SW 100.0 FORMULA_0001 0.0 100.0 FORMAT "%4.1" /end CHARACTERISTIC
/begin CHARACTERISTIC K_SELSPCOSA "Spezialverbraucher" VALUE 0x75C05 TKW_VV_VV_UB 100.0 FORMULA_0003 0.0 15.0 /end CHARACTERISTIC
/begin CHARACTERISTIC K_SELSPCSAPP "Auswahl Sonderverbraucher Applikationsgroesse" VALUE 0x75C06 TKW_VV_VV_UB 100.0 FORMULA_0003 0.0 15.0 /end CHARACTERISTIC
/begin CHARACTERISTIC K_SOC_BILAWA "Applikationswert soc_bila" VALUE 0x75E5E TKW_VV_VV_UW 100.0 FORMULA_0462 0.0 99.99839782714844 FORMAT "%5.2" /end CHARACTERISTIC
/begin CHARACTERISTIC K_SOC_QPWF "Ladezustandsqualität nach Powerfail" VALUE 0x75E60 TKW_VV_VV_UW 100.0 FORMULA_0498 0.0 1192.750244140625 FORMAT "%6.3" /end CHARACTERISTIC
/begin CHARACTERISTIC K_SOC_QUALIA "Applikationswert soc_quali" VALUE 0x75E62 TKW_VV_VV_UW 100.0 FORMULA_0498 0.0 1192.750244140625 FORMAT "%6.3" /end CHARACTERISTIC
/begin CHARACTERISTIC K_SOC_STAFGA "Applikationswert für SoC aus der Startfähigkeit" VALUE 0x7606E TKW_VV_VV_UW 100.0 FORMULA_0462 0.0 99.99839782714844 FORMAT "%5.2" /end CHARACTERISTIC
/begin CHARACTERISTIC K_SOCFITAPP "Applikationwert Soc aus der Fitberechnung" VALUE 0x75EC6 TKW_VV_VV_UW 100.0 FORMULA_0462 0.0 99.99839782714844 FORMAT "%5.2" /end CHARACTERISTIC
/begin CHARACTERISTIC K_SOCFITGRZ "Grenzwert für soc_fit" VALUE 0x76068 TKW_VV_VV_UW 100.0 FORMULA_0462 0.0 99.99839782714844 FORMAT "%5.2" /end CHARACTERISTIC
/begin CHARACTERISTIC K_SOCFITLIMH "Applikationskonstante zur Verbesserung SoC aus der Fitberechnung" VALUE 0x7606A TKW_VV_VV_UW 100.0 FORMULA_0462 0.0 99.99839782714844 FORMAT "%5.2" /end CHARACTERISTIC
/begin CHARACTERISTIC K_SOCFITLIML "Applikationskonstante zur Abwertung SoC aus der Fitberechnung" VALUE 0x7606C TKW_VV_VV_UW 100.0 FORMULA_0462 0.0 99.99839782714844 FORMAT "%5.2" /end CHARACTERISTIC
/begin CHARACTERISTIC K_STPCOSAPP "Status Standverbraucher Applikationsgroesse" VALUE 0x75C07 TKW_VV_VV_UB 100.0 FORMULA_0003 0.0 3.0 /end CHARACTERISTIC
/begin CHARACTERISTIC K_T_CCRUHVER "Dauer fuer CC-Meld. erhoehter Ruhestrom" VALUE 0x75AD4 TKW_VV_VV_UW 100.0 FORMULA_0071 0.0 6553.5 FORMAT "%4.1" /end CHARACTERISTIC
/begin CHARACTERISTIC K_T_IPMPRIO "max. Zeit, indem Prio aufgrund IPM gesteuert wird" VALUE 0x75C08 TKW_VV_VV_UB 100.0 FORMULA_0461 0.0 25.5 /end CHARACTERISTIC
/begin CHARACTERISTIC K_T_KMSHIFT "Delayzeit für Km_st Info-shift" VALUE 0x75AD6 TKW_VV_VV_UW 100.0 FORMULA_0071 0.0 6553.5 FORMAT "%4.1" /end CHARACTERISTIC
/begin CHARACTERISTIC K_T_NKPTCAUS "Zeit PTC aus aufgrund NKW zu niedrig." VALUE 0x75C09 TKW_VV_VV_UB 100.0 FORMULA_0461 0.0 25.5 /end CHARACTERISTIC
/begin CHARACTERISTIC K_T_OSPGRSET "Zeit für 1x Oberspannungsentprellungrücknahme" VALUE 0x75AED TKW_VV_VV_UB 100.0 FORMULA_0461 0.0 25.5 /end CHARACTERISTIC
/begin CHARACTERISTIC K_T_OSPGSET "Entrpellzeit FS_oberspannungserkennung" VALUE 0x75AEE TKW_VV_VV_UB 100.0 FORMULA_0461 0.0 25.5 /end CHARACTERISTIC
/begin CHARACTERISTIC K_T_PMBS "Zeit bis zum nächsten zyklischen senden" VALUE 0x75C0A TKW_VV_VV_UB 100.0 FORMULA_0476 0.0 255.0 /end CHARACTERISTIC
/begin CHARACTERISTIC K_T_PMVS "Zeit zwischen zwei zyklischen Sendungen von 3b3 " VALUE 0x75C0B TKW_VV_VV_UB 100.0 FORMULA_0476 0.0 255.0 /end CHARACTERISTIC
/begin CHARACTERISTIC K_T_PTCKWAN "PTC-Ein Wartezeit nach Motor an." VALUE 0x75C0C TKW_VV_VV_UB 100.0 FORMULA_0461 0.0 25.5 /end CHARACTERISTIC
/begin CHARACTERISTIC K_T_PTCPI "T-Faktor des PI-Reglers für PTC-Ansteuerung" VALUE 0x75BDE TKW_VV_VV_UW 100.0 FORMULA_0071 0.1000000014901161 6553.5 FORMAT "%4.1" /end CHARACTERISTIC
/begin CHARACTERISTIC K_T_RUHAUSW "Minimal verstrichene Zeit für Ruheverl. Auswertung" VALUE 0x75AEF TKW_VV_VV_UB 100.0 FORMULA_0503 0.0 238.0 /end CHARACTERISTIC
/begin CHARACTERISTIC K_T_SQSHIFT "Delayzeit für Soc_quali Info-shift" VALUE 0x75AF0 TKW_VV_VV_UB 100.0 FORMULA_0461 0.0 25.5 /end CHARACTERISTIC
/begin CHARACTERISTIC K_T_SULEVON "Zeit für SULEV-ctrpwrcos-prios nach Motorstart" VALUE 0x75BE0 TKW_VV_VV_UW 100.0 FORMULA_0071 0.0 6553.5 FORMAT "%4.1" /end CHARACTERISTIC
/begin CHARACTERISTIC K_T_USPGRSET "Uterspannung Resetzeit" VALUE 0x75AF1 TKW_VV_VV_UB 100.0 FORMULA_0461 0.0 25.5 /end CHARACTERISTIC
/begin CHARACTERISTIC K_T_USPGSET "Zeit für 1x Unterspannungsentprellung" VALUE 0x75AF2 TKW_VV_VV_UB 100.0 FORMULA_0461 0.0 25.5 /end CHARACTERISTIC
/begin CHARACTERISTIC K_T1PMINFO "T1 Zykluszeit fuer PM Fehlerinfo" VALUE 0x75AEA TKW_VV_VV_UB 100.0 FORMULA_0461 0.0 25.5 /end CHARACTERISTIC
/begin CHARACTERISTIC K_T2PMINFO "T2 Zykluszeit fuer PM Fehlerinfo" VALUE 0x75ACE TKW_VV_VV_UW 100.0 FORMULA_0071 0.0 6553.5 FORMAT "%4.1" /end CHARACTERISTIC
/begin CHARACTERISTIC K_T3PMINFO "T3 Zykluszeit fuer PM Fehlerinfo" VALUE 0x75AD0 TKW_VV_VV_UW 100.0 FORMULA_0071 0.0 6553.5 FORMAT "%4.1" /end CHARACTERISTIC
/begin CHARACTERISTIC K_TBATINIMAN "Applikation INITWERT Batterietemperatur" VALUE 0x74538 TKW_VV_VV_SW 100.0 FORMULA_0431 0.0 3276.699951171875 /end CHARACTERISTIC
/begin CHARACTERISTIC K_TBATNACHL "B_ccbtnach wird nach dieser Zeit aktiviert" VALUE 0x75AD2 TKW_VV_VV_UW 100.0 FORMULA_0071 0.0 6553.5 FORMAT "%4.1" /end CHARACTERISTIC
/begin CHARACTERISTIC K_TBATTFTAUV "Zeitkonstante 5*Tau Batterievorne" VALUE 0x74550 TKW_VV_VV_UW 100.0 FORMULA_0010 0.0 65535.0 /end CHARACTERISTIC
/begin CHARACTERISTIC K_TBATTTAUFH "Zeitkonstante Batterie 5*Tau hinten" VALUE 0x74552 TKW_VV_VV_UW 100.0 FORMULA_0010 0.0 65535.0 /end CHARACTERISTIC
/begin CHARACTERISTIC K_TCODIERPM "T1 Zyklus fuer Fehlerinfo" VALUE 0x75AEB TKW_VV_VV_UB 100.0 FORMULA_0461 0.0 25.5 /end CHARACTERISTIC
/begin CHARACTERISTIC K_TD_BNMOT "Zeit nach Motorlauf, wo die stufenweise (USTEPMIN) Berechnung von uibs aktiviert wird." VALUE 0x760E7 TKW_VV_VV_UB 100.0 FORMULA_0476 0.0 255.0 /end CHARACTERISTIC
/begin CHARACTERISTIC K_TD_PMUGEN "Taskzeit von PMUGENCALC, = Zeit wo die stufenweise Setzung von uibs berechnet wird." VALUE 0x760E8 TKW_VV_VV_UB 100.0 FORMULA_0476 0.0 255.0 /end CHARACTERISTIC
/begin CHARACTERISTIC K_TD_PWRDFPI "K-Faktor des PI Reglers zur Berechnung von ctrpwrdf" VALUE 0x75BDC TKW_VV_VV_UW 100.0 FORMULA_0071 0.1000000014901161 6553.5 FORMAT "%4.1" /end CHARACTERISTIC
/begin CHARACTERISTIC K_TIME_START "Zeittriggerschwelle nach Motorstart" VALUE 0x7609C TKW_VV_VV_UW 100.0 FORMULA_0021 0.0 655.3499755859375 FORMAT "%5.2" /end CHARACTERISTIC
/begin CHARACTERISTIC K_TIMERDLY "Verzoegerungszeit für Startwertberechnung" VALUE 0x7452A TKW_VV_VV_UB 100.0 FORMULA_0003 0.0 255.0 /end CHARACTERISTIC
/begin CHARACTERISTIC K_TRINGSHIFT "Ruhezeit nachdem der Ruhestrom-Ringspeicher eingetragen wird." VALUE 0x75AEC TKW_VV_VV_UB 100.0 FORMULA_0503 0.0 238.0 /end CHARACTERISTIC
/begin CHARACTERISTIC K_TSAISONFIL "Filterkonstante für t_saison" VALUE 0x76070 TKW_VV_VV_UW 100.0 FORMULA_0010 1.0 65535.0 /end CHARACTERISTIC
/begin CHARACTERISTIC K_TSAISPWF "Defaultwert Saison Temp bei DME Powerfail" VALUE 0x76056 TKW_VV_VV_SW 100.0 FORMULA_0431 -3276.800048828125 3276.699951171875 /end CHARACTERISTIC
/begin CHARACTERISTIC K_TUMGINI "Initialisierungswert Aussentemperaturmodell" VALUE 0x7453A TKW_VV_VV_SW 100.0 FORMULA_0431 -3276.800048828125 3276.699951171875 /end CHARACTERISTIC
/begin CHARACTERISTIC K_TUMGTAU "Zeitkonstante 5*Tau Aussentemperatur" VALUE 0x74554 TKW_VV_VV_UW 100.0 FORMULA_0010 0.0 65535.0 /end CHARACTERISTIC
/begin CHARACTERISTIC K_UB_GRENZ "Grenzwert Gradient d. Bordnetzspannung" VALUE 0x7609E TKW_VV_VV_UW 100.0 FORMULA_0432 0.0 6173.39697265625 FORMAT "%4.1" /end CHARACTERISTIC
/begin CHARACTERISTIC K_UBAT_LP "K-Faktor des ubatt-tiefpass Filters zur Berechnung von ctrpwrdf" VALUE 0x75BE2 TKW_VV_VV_UW 100.0 FORMULA_0460 0.0 0.9999847412109375 FORMAT "%7.4" /end CHARACTERISTIC
/begin CHARACTERISTIC K_UBATTNORM "Batterienormspannung" VALUE 0x7453C TKW_VV_VV_SW 100.0 FORMULA_0488 -128.0 127.9960021972656 FORMAT "%6.3" /end CHARACTERISTIC
/begin CHARACTERISTIC K_UBPTC_LP "K-Faktor des ubatt-Tiefpass Filters zur Berechnung von PTC" VALUE 0x75BE4 TKW_VV_VV_UW 100.0 FORMULA_0460 0.0 0.9999847412109375 FORMAT "%7.4" /end CHARACTERISTIC
/begin CHARACTERISTIC K_UBTAPP "Batteriespannung Applikationsgroesse" VALUE 0x75BE6 TKW_VV_VV_UW 100.0 FORMULA_0509 0.0 61.42499923706055 FORMAT "%6.3" /end CHARACTERISTIC
/begin CHARACTERISTIC K_UBTLOWMAX "Obere Unterspannungsgrenze" VALUE 0x75BE8 TKW_VV_VV_UW 100.0 FORMULA_0501 6.0 16.0 FORMAT "%6.3" /end CHARACTERISTIC
/begin CHARACTERISTIC K_UBTLOWMIN "Untere Unterspannungsgrenze" VALUE 0x75BEA TKW_VV_VV_UW 100.0 FORMULA_0501 6.0 16.0 FORMAT "%6.3" /end CHARACTERISTIC
/begin CHARACTERISTIC K_UGENNORM "Generator Normspannung" VALUE 0x760DC TKW_VV_VV_SW 100.0 FORMULA_0488 -128.0 127.9960021972656 FORMAT "%6.3" /end CHARACTERISTIC
/begin CHARACTERISTIC K_UIBSAPP "Manueller Applikationswert von Uibs an UGENKOR" VALUE 0x760DE TKW_VV_VV_SW 100.0 FORMULA_0488 -128.0 127.9960021972656 FORMAT "%6.3" /end CHARACTERISTIC
/begin CHARACTERISTIC K_UKOMPK "Applikationswert Kompensationsspannung Kafferraum" VALUE 0x74524 TKW_VV_VV_SW 100.0 FORMULA_0488 0.0 127.9960021972656 FORMAT "%6.3" /end CHARACTERISTIC
/begin CHARACTERISTIC K_UKOMPM "Applikationswert Kompensationsspannung Motorraum" VALUE 0x74526 TKW_VV_VV_SW 100.0 FORMULA_0488 0.0 127.9960021972656 FORMAT "%6.3" /end CHARACTERISTIC
/begin CHARACTERISTIC K_ULADE_TAU "Batterieladespannungs Zeitkonstante" VALUE 0x74556 TKW_VV_VV_UW 100.0 FORMULA_0460 0.0 0.9999847412109375 FORMAT "%7.4" /end CHARACTERISTIC
/begin CHARACTERISTIC K_ULEVA "Spannungslevel" VALUE 0x75C0D TKW_VV_VV_UB 100.0 FORMULA_0003 0.0 255.0 /end CHARACTERISTIC
/begin CHARACTERISTIC K_ULEVAPP "Spannungsebene Applikationsgroesse" VALUE 0x75C0E TKW_VV_VV_UB 100.0 FORMULA_0003 0.0 15.0 /end CHARACTERISTIC
/begin CHARACTERISTIC K_ULOWSETAPP "Entrpellzeit zentrale Unterspannung" VALUE 0x75C0F TKW_VV_VV_UB 100.0 FORMULA_0461 0.0 25.5 /end CHARACTERISTIC
/begin CHARACTERISTIC K_USPGAPP "Unterspannungschwelle" VALUE 0x75AD8 TKW_VV_VV_UW 100.0 FORMULA_0501 6.0 22.38369941711426 FORMAT "%6.3" /end CHARACTERISTIC
/begin CHARACTERISTIC K_USPGHYST "Unterspannungshysterese" VALUE 0x75AC8 TKW_VV_VV_SW 100.0 FORMULA_0500 -8.192000389099121 8.191699981689453 FORMAT "%6.3" /end CHARACTERISTIC
/begin CHARACTERISTIC K_USPGPRELLZ "Anzahl der FS_uspg Entprellungen für Fehlereintrag" VALUE 0x75AF3 TKW_VV_VV_UB 100.0 FORMULA_0003 0.0 255.0 /end CHARACTERISTIC
/begin CHARACTERISTIC K_USPRELLDEC "Dekrement auf Entprellcounter Unterspannung" VALUE 0x75AF4 TKW_VV_VV_UB 100.0 FORMULA_0003 0.0 255.0 /end CHARACTERISTIC
/begin CHARACTERISTIC K_USPRELLINC "Inkrement auf Entprellcounter Unterspannung" VALUE 0x75AF5 TKW_VV_VV_UB 100.0 FORMULA_0003 0.0 255.0 /end CHARACTERISTIC
/begin CHARACTERISTIC K_USTARTGRZ "Spannungsgrenzwert für Startauswertung " VALUE 0x760A0 TKW_VV_VV_UW 100.0 FORMULA_0501 6.0 22.38369941711426 FORMAT "%6.3" /end CHARACTERISTIC
/begin CHARACTERISTIC K_USTEPMIN "Min. Delta zw. Battsollspg und Battspg damit uibs veraendert wird." VALUE 0x760E0 TKW_VV_VV_SW 100.0 FORMULA_0488 -128.0 127.9960021972656 FORMAT "%6.3" /end CHARACTERISTIC
/begin CHARACTERISTIC K_VMINUMG "Fahrzeuggeschwindigkeitsschwelle Aussentemperaturmodell" VALUE 0x74558 TKW_VV_VV_UW 100.0 FORMULA_0474 0.0 65535.0 /end CHARACTERISTIC
/begin CHARACTERISTIC KF_DFIGEN1 "inv. Generator-DF-Ausgang" MAP 0x7065D TKF_UB_UB_UB 100.0 FORMULA_0475 0.0 99.60929870605469
 /begin AXIS_DESCR STD_AXIS NO_INPUT_QUANTITY FORMULA_0463 8 0.0 255.0 MAX_GRAD 0.0 /end AXIS_DESCR
 /begin AXIS_DESCR STD_AXIS I_genrllrah FORMULA_0463 8 0.0 255.0 MAX_GRAD 0.0 /end AXIS_DESCR
/end CHARACTERISTIC
/begin CHARACTERISTIC KF_DFIGEN2 "inv. Generator-DF-Ausgang" MAP 0x7060B TKF_UB_UB_UB 100.0 FORMULA_0475 0.0 99.60929870605469
 /begin AXIS_DESCR STD_AXIS NO_INPUT_QUANTITY FORMULA_0463 8 0.0 255.0 MAX_GRAD 0.0 /end AXIS_DESCR
 /begin AXIS_DESCR STD_AXIS I_genrllrah FORMULA_0463 8 0.0 255.0 MAX_GRAD 0.0 /end AXIS_DESCR
/end CHARACTERISTIC
/begin CHARACTERISTIC KF_DFIGEN3 "inv. Generator-DF-Ausgang" MAP 0x70701 TKF_UB_UB_UB 100.0 FORMULA_0475 0.0 99.60929870605469
 /begin AXIS_DESCR STD_AXIS NO_INPUT_QUANTITY FORMULA_0463 8 0.0 255.0 MAX_GRAD 0.0 /end AXIS_DESCR
 /begin AXIS_DESCR STD_AXIS I_genrllrah FORMULA_0463 8 0.0 255.0 MAX_GRAD 0.0 /end AXIS_DESCR
/end CHARACTERISTIC
/begin CHARACTERISTIC KF_DFIGEN4 "inv. Generator-DF-Ausgang" MAP 0x706AF TKF_UB_UB_UB 100.0 FORMULA_0475 0.0 99.60929870605469
 /begin AXIS_DESCR STD_AXIS NO_INPUT_QUANTITY FORMULA_0463 8 0.0 255.0 MAX_GRAD 0.0 /end AXIS_DESCR
 /begin AXIS_DESCR STD_AXIS I_genrllrah FORMULA_0463 8 0.0 255.0 MAX_GRAD 0.0 /end AXIS_DESCR
/end CHARACTERISTIC
/begin CHARACTERISTIC KF_ELUPWM39 "Strom E-Lüfter über pwm und ub" MAP 0x7056A TKF_UW_UB_UW 100.0 FORMULA_0485 0.0 64.0 FORMAT "%6.3"
 /begin AXIS_DESCR STD_AXIS L_pwmout FORMULA_0475 8 0.0 99.60929870605469 MAX_GRAD 0.0 /end AXIS_DESCR
 /begin AXIS_DESCR STD_AXIS V FORMULA_0474 8 0.0 360.0 MAX_GRAD 0.0 /end AXIS_DESCR
/end CHARACTERISTIC
/begin CHARACTERISTIC KF_ELUPWM60 "Strom E-Lüfter über pwm und ub" MAP 0x704D0 TKF_UW_UB_UW 100.0 FORMULA_0485 0.0 64.0 FORMAT "%6.3"
 /begin AXIS_DESCR STD_AXIS L_pwmout FORMULA_0475 8 0.0 99.60929870605469 MAX_GRAD 0.0 /end AXIS_DESCR
 /begin AXIS_DESCR STD_AXIS V FORMULA_0474 8 0.0 360.0 MAX_GRAD 0.0 /end AXIS_DESCR
/end CHARACTERISTIC
/begin CHARACTERISTIC KF_IBTSOLL "KFSollstrom aufgrund von Batterietemperatur und Ladezustand." MAP 0x75E08 TKF_SW_SW_UW 100.0 FORMULA_0508 -200.0 5042.7998046875 FORMAT "%6.3"
 /begin AXIS_DESCR STD_AXIS T_batt FORMULA_0431 5 -3276.800048828125 3276.699951171875 MAX_GRAD 0.0 /end AXIS_DESCR
 /begin AXIS_DESCR STD_AXIS D_soc FORMULA_0479 6 -100.0 99.99690246582031 MAX_GRAD 0.0 FORMAT "%5.2" /end AXIS_DESCR
/end CHARACTERISTIC
/begin CHARACTERISTIC KF_PMRIBAT1 "Kennfeld Innenwiderstand Batterie" MAP 0x75FEE TKF_UW_SW_UB 100.0 FORMULA_0513 0.0 0.2549999952316284
 /begin AXIS_DESCR STD_AXIS T_batt FORMULA_0431 4 -3276.800048828125 3276.699951171875 MAX_GRAD 0.0 /end AXIS_DESCR
 /begin AXIS_DESCR STD_AXIS I_batt FORMULA_0508 6 -200.0 5042.7998046875 MAX_GRAD 0.0 FORMAT "%6.3" /end AXIS_DESCR
/end CHARACTERISTIC
/begin CHARACTERISTIC KF_PMRIBAT2 "Kennfeld Innenwiderstand Batterie2" MAP 0x75FC0 TKF_UW_SW_UB 100.0 FORMULA_0513 0.0 0.2549999952316284
 /begin AXIS_DESCR STD_AXIS T_batt FORMULA_0431 4 -3276.800048828125 3276.699951171875 MAX_GRAD 0.0 /end AXIS_DESCR
 /begin AXIS_DESCR STD_AXIS I_batt FORMULA_0508 6 -200.0 5042.7998046875 MAX_GRAD 0.0 FORMAT "%6.3" /end AXIS_DESCR
/end CHARACTERISTIC
/begin CHARACTERISTIC KF_PMRIBAT3 "Kennfeld Innenwiderstand Batterie3" MAP 0x75F64 TKF_UW_SW_UB 100.0 FORMULA_0513 0.0 0.2549999952316284
 /begin AXIS_DESCR STD_AXIS T_batt FORMULA_0431 4 -3276.800048828125 3276.699951171875 MAX_GRAD 0.0 /end AXIS_DESCR
 /begin AXIS_DESCR STD_AXIS I_batt FORMULA_0508 6 -200.0 5042.7998046875 MAX_GRAD 0.0 FORMAT "%6.3" /end AXIS_DESCR
/end CHARACTERISTIC
/begin CHARACTERISTIC KF_PMRIBAT4 "Kennfeld Innenwiderstand Batterie4" MAP 0x75F92 TKF_UW_SW_UB 100.0 FORMULA_0513 0.0 0.2549999952316284
 /begin AXIS_DESCR STD_AXIS T_batt FORMULA_0431 4 -3276.800048828125 3276.699951171875 MAX_GRAD 0.0 /end AXIS_DESCR
 /begin AXIS_DESCR STD_AXIS I_batt FORMULA_0508 6 -200.0 5042.7998046875 MAX_GRAD 0.0 FORMAT "%6.3" /end AXIS_DESCR
/end CHARACTERISTIC
/begin CHARACTERISTIC KF_PMRIBAT5 "Kennfeld Innenwiderstand Batterie5" MAP 0x75F36 TKF_UW_SW_UB 100.0 FORMULA_0513 0.0 0.2549999952316284
 /begin AXIS_DESCR STD_AXIS T_batt FORMULA_0431 4 -3276.800048828125 3276.699951171875 MAX_GRAD 0.0 /end AXIS_DESCR
 /begin AXIS_DESCR STD_AXIS I_batt FORMULA_0508 6 -200.0 5042.7998046875 MAX_GRAD 0.0 FORMAT "%6.3" /end AXIS_DESCR
/end CHARACTERISTIC
/begin CHARACTERISTIC KF_PMRIBAT6 "Kennfeld Innenwiderstand Batterie6" MAP 0x75F08 TKF_UW_SW_UB 100.0 FORMULA_0513 0.0 0.2549999952316284
 /begin AXIS_DESCR STD_AXIS T_batt FORMULA_0431 4 -3276.800048828125 3276.699951171875 MAX_GRAD 0.0 /end AXIS_DESCR
 /begin AXIS_DESCR STD_AXIS I_batt FORMULA_0508 6 -200.0 5042.7998046875 MAX_GRAD 0.0 FORMAT "%6.3" /end AXIS_DESCR
/end CHARACTERISTIC
/begin CHARACTERISTIC KF_PMRIBAT7 "Kennfeld Innenwiderstand Batterie7" MAP 0x7601C TKF_UW_SW_UB 100.0 FORMULA_0513 0.0 0.2549999952316284
 /begin AXIS_DESCR STD_AXIS T_batt FORMULA_0431 4 -3276.800048828125 3276.699951171875 MAX_GRAD 0.0 /end AXIS_DESCR
 /begin AXIS_DESCR STD_AXIS I_batt FORMULA_0508 6 -200.0 5042.7998046875 MAX_GRAD 0.0 FORMAT "%6.3" /end AXIS_DESCR
/end CHARACTERISTIC
/begin CHARACTERISTIC KF_PMRIBAT8 "Kennfeld Innenwiderstand Batterie8" MAP 0x75EDA TKF_UW_SW_UB 100.0 FORMULA_0513 0.0 0.2549999952316284
 /begin AXIS_DESCR STD_AXIS T_batt FORMULA_0431 4 -3276.800048828125 3276.699951171875 MAX_GRAD 0.0 /end AXIS_DESCR
 /begin AXIS_DESCR STD_AXIS I_batt FORMULA_0508 6 -200.0 5042.7998046875 MAX_GRAD 0.0 FORMAT "%6.3" /end AXIS_DESCR
/end CHARACTERISTIC
/begin CHARACTERISTIC KF_PSAU_LLS_MDL_MDRFSOLL "Modell-KF fuer LLS-Leistendruck" MAP 0x76212 TKF_SW_SW_UW 100.0 FORMULA_0073 0.0 4.0 FORMAT "%6.3" /begin AXIS_DESCR STD_AXIS n FORMULA_0006 12 0.0 10000.0 MAX_GRAD 0.0 /end AXIS_DESCR
 /begin AXIS_DESCR STD_AXIS rf_mw FORMULA_0007 8 0.0 2.0 MAX_GRAD 0.0 FORMAT "%6.3" /end AXIS_DESCR
/end CHARACTERISTIC
/begin CHARACTERISTIC KF_PSAU_SR_MDL_MDRFSOLL "Modell-KF fuer Saugrohrdruck" MAP 0x76128 TKF_SW_SW_UW 100.0 FORMULA_0073 0.0 4.0 FORMAT "%6.3" /begin AXIS_DESCR STD_AXIS n FORMULA_0006 12 0.0 10000.0 MAX_GRAD 0.0 /end AXIS_DESCR
 /begin AXIS_DESCR STD_AXIS rf_mw FORMULA_0007 8 0.0 2.0 MAX_GRAD 0.0 FORMAT "%6.3" /end AXIS_DESCR
/end CHARACTERISTIC
/begin CHARACTERISTIC KF_RF_E2_MAX "Max. erlaubte Abweichung" MAP 0x79D42 TKF_SW_SW_SW 100.0 FORMULA_0706 -200.0 255.0 FORMAT "%4.1" /begin AXIS_DESCR STD_AXIS n FORMULA_0006 6 0.0 10000.0 MAX_GRAD 0.0 /end AXIS_DESCR
 /begin AXIS_DESCR STD_AXIS rf_b1 FORMULA_0007 8 0.0 2.0 MAX_GRAD 0.0 FORMAT "%6.3" /end AXIS_DESCR
/end CHARACTERISTIC
/begin CHARACTERISTIC KF_RF_PT_PUMG_WICHT "Gewichtung ueber PUMG" MAP 0x766D4 TKF_SW_SW_UW 100.0 FORMULA_0073 0.0 4.0 FORMAT "%6.3" /begin AXIS_DESCR STD_AXIS n FORMULA_0006 6 0.0 10000.0 MAX_GRAD 0.0 /end AXIS_DESCR
 /begin AXIS_DESCR STD_AXIS md_rf_soll FORMULA_0007 6 0.0 2.0 MAX_GRAD 0.0 FORMAT "%6.3" /end AXIS_DESCR
/end CHARACTERISTIC
/begin CHARACTERISTIC KF_RG_STAT "RG-Gehalt stationaer" MAP 0x767F8 TKF_SW_SW_SW 100.0 FORMULA_0100 -0.5 0.5 FORMAT "%5.2" /begin AXIS_DESCR STD_AXIS n FORMULA_0006 16 0.0 10000.0 MAX_GRAD 0.0 /end AXIS_DESCR
 /begin AXIS_DESCR STD_AXIS dr_rel FORMULA_0106 12 0.0 199.9938049316406 MAX_GRAD 0.0 FORMAT "%5.2" /end AXIS_DESCR
/end CHARACTERISTIC
/begin CHARACTERISTIC KF_SA_T_TRIG_MAX "Saugrohrdruckdelta" MAP 0x76A3E TKF_SW_SW_UW 100.0 FORMULA_0109 0.0 325.0 FORMAT "%5.2"
 /begin AXIS_DESCR STD_AXIS tmot_loc FORMULA_0023 4 -50.0 170.0 MAX_GRAD 0.0 FORMAT "%4.1" /end AXIS_DESCR
 /begin AXIS_DESCR STD_AXIS n FORMULA_0006 6 0.0 10000.0 MAX_GRAD 0.0 /end AXIS_DESCR
/end CHARACTERISTIC
/begin CHARACTERISTIC KF_SOC0UBIB "" MAP 0x75E94 TKF_SW_UW_UW 100.0 FORMULA_0498 0.0 1192.750244140625 FORMAT "%6.3"
 /begin AXIS_DESCR STD_AXIS Ubatt0 FORMULA_0501 3 6.0 22.38369941711426 MAX_GRAD 0.0 FORMAT "%6.3" /end AXIS_DESCR
 /begin AXIS_DESCR STD_AXIS Isoc0loc FORMULA_0511 5 -655.3599853515625 655.3400268554688 MAX_GRAD 0.0 FORMAT "%6.3" /end AXIS_DESCR
/end CHARACTERISTIC
/begin CHARACTERISTIC KF_SOCLF "Ladefaktor in Abhängigkeit von Temperatur und Ladezustand" MAP 0x75E7C TKF_UW_SW_UB 100.0 FORMULA_0465 1.569999940693378e-002 3.984299898147583
 /begin AXIS_DESCR STD_AXIS T_batt FORMULA_0431 3 -3276.800048828125 3276.699951171875 MAX_GRAD 0.0 /end AXIS_DESCR
 /begin AXIS_DESCR STD_AXIS Soc_b_loc FORMULA_0498 3 0.0 1192.750244140625 MAX_GRAD 0.0 FORMAT "%6.3" /end AXIS_DESCR
/end CHARACTERISTIC
/begin CHARACTERISTIC KF_USOLL "Batteriesollspannung aufgrund der Temperatur und soc." MAP 0x760F8 TKF_UW_SW_UW 100.0 FORMULA_0501 6.0 22.38369941711426 FORMAT "%6.3"
 /begin AXIS_DESCR STD_AXIS T_batt FORMULA_0431 3 -3276.800048828125 3276.699951171875 MAX_GRAD 0.0 /end AXIS_DESCR
 /begin AXIS_DESCR STD_AXIS Soc_rel FORMULA_0462 3 0.0 99.99839782714844 MAX_GRAD 0.0 FORMAT "%5.2" /end AXIS_DESCR
/end CHARACTERISTIC
/begin CHARACTERISTIC KL_BATTLSTR "Geschwindigkeitsfaktor Batterieumgebungstemperatur" CURVE 0x745A8 TKL_UW_VV_UW 100.0 FORMULA_0482 0.0 255.9960021972656 FORMAT "%5.2"
 /begin AXIS_DESCR STD_AXIS NO_INPUT_QUANTITY FORMULA_0474 6 0.0 360.0 MAX_GRAD 0.0 /end AXIS_DESCR
/end CHARACTERISTIC
/begin CHARACTERISTIC KL_CLASS2IND "Batterieklasse -> Batterieindex" CURVE 0x75B74 TKL_UB_VV_UB 100.0 FORMULA_0003 0.0 255.0 /begin AXIS_DESCR STD_AXIS Batt_class FORMULA_0003 8 0.0 255.0 MAX_GRAD 0.0 /end AXIS_DESCR /end CHARACTERISTIC
/begin CHARACTERISTIC KL_CLASS2NENN "Batterieklasse -> Batteriegroesse" CURVE 0x75B14 TKL_UB_VV_UB 100.0 FORMULA_0487 0.0 255.0 /begin AXIS_DESCR STD_AXIS Batt_class FORMULA_0003 8 0.0 255.0 MAX_GRAD 0.0 /end AXIS_DESCR /end CHARACTERISTIC
/begin CHARACTERISTIC KL_DFPRIO "Dffgen Prio Übersetzer" CURVE 0x75D40 TKL_UB_VV_SW 100.0 FORMULA_0505 -100.0 100.0 FORMAT "%5.2"
 /begin AXIS_DESCR STD_AXIS Dfpt1filt FORMULA_0475 6 0.0 99.60929870605469 MAX_GRAD 0.0 /end AXIS_DESCR
/end CHARACTERISTIC
/begin CHARACTERISTIC KL_DFPTC "Gefiltertes dffgen -> Prio_Gewichtung -Übersetzer" CURVE 0x75CD8 TKL_UB_VV_SW 100.0 FORMULA_0505 -100.0 100.0 FORMAT "%5.2"
 /begin AXIS_DESCR STD_AXIS Dfpt1ptc FORMULA_0475 6 0.0 99.60929870605469 MAX_GRAD 0.0 /end AXIS_DESCR
/end CHARACTERISTIC
/begin CHARACTERISTIC KL_DSOCPRIO "" CURVE 0x75DDA TKL_SW_VV_UW 100.0 FORMULA_0484 0.0 511.9920959472656 FORMAT "%5.2"
 /begin AXIS_DESCR STD_AXIS D_soc FORMULA_0479 5 -100.0 99.99690246582031 MAX_GRAD 0.0 FORMAT "%5.2" /end AXIS_DESCR
/end CHARACTERISTIC
/begin CHARACTERISTIC KL_DSOCPTC "Kennlinie dsoc auf PTC-Ansteuerung Übersetzer" CURVE 0x75DAE TKL_SW_VV_SW 100.0 FORMULA_0505 -150.0 150.0 FORMAT "%5.2"
 /begin AXIS_DESCR STD_AXIS D_soc FORMULA_0479 4 -100.0 99.99690246582031 MAX_GRAD 0.0 FORMAT "%5.2" /end AXIS_DESCR
/end CHARACTERISTIC
/begin CHARACTERISTIC KL_DUDTPTC "Übersetzer dudtmul -> PTC Add. Gewichtung" CURVE 0x75D98 TKL_SW_VV_UW 100.0 FORMULA_0507 0.0 550.0 FORMAT "%6.3"
 /begin AXIS_DESCR STD_AXIS Dudtmul FORMULA_0506 5 -48.23040008544922 48.22890090942383 MAX_GRAD 0.0 FORMAT "%7.4" /end AXIS_DESCR
/end CHARACTERISTIC
/begin CHARACTERISTIC KL_ELSLS "Kennlinie E-Lüfter Strom" CURVE 0x704B0 TKL_UW_VV_UW 100.0 FORMULA_0485 0.0 255.0 FORMAT "%6.3"
 /begin AXIS_DESCR STD_AXIS Ub FORMULA_0432 3 0.0 6173.39697265625 MAX_GRAD 0.0 FORMAT "%4.1" /end AXIS_DESCR
/end CHARACTERISTIC
/begin CHARACTERISTIC KL_ELTEMP39 "Temperaturfaktor Elüfter" CURVE 0x7042C TKL_SW_VV_UW 100.0 FORMULA_0484 0.0 511.9920959472656 FORMAT "%5.2"
 /begin AXIS_DESCR STD_AXIS Tans FORMULA_0431 6 -3276.800048828125 3276.699951171875 MAX_GRAD 0.0 /end AXIS_DESCR
/end CHARACTERISTIC
/begin CHARACTERISTIC KL_ELTEMP60 "Temperaturfaktor Elüfter" CURVE 0x70496 TKL_SW_VV_UW 100.0 FORMULA_0484 0.0 511.9920959472656 FORMAT "%5.2"
 /begin AXIS_DESCR STD_AXIS Tans FORMULA_0431 6 -3276.800048828125 3276.699951171875 MAX_GRAD 0.0 /end AXIS_DESCR
/end CHARACTERISTIC
/begin CHARACTERISTIC KL_ELUB39 "" CURVE 0x70480 TKL_UW_VV_UW 100.0 FORMULA_0484 0.0 511.9920959472656 FORMAT "%5.2"
 /begin AXIS_DESCR STD_AXIS Ub FORMULA_0432 5 0.0 6173.39697265625 MAX_GRAD 0.0 FORMAT "%4.1" /end AXIS_DESCR
/end CHARACTERISTIC
/begin CHARACTERISTIC KL_ELUB60 "" CURVE 0x70446 TKL_UW_VV_UW 100.0 FORMULA_0484 0.0 511.9920959472656 FORMAT "%5.2"
 /begin AXIS_DESCR STD_AXIS Ub FORMULA_0432 5 0.0 6173.39697265625 MAX_GRAD 0.0 FORMAT "%4.1" /end AXIS_DESCR
/end CHARACTERISTIC
/begin CHARACTERISTIC KL_EXPALH "Funktion EXP(-ALPHA*tabst_w) hinten" CURVE 0x745F0 TKL_UW_VV_UW 100.0 FORMULA_0460 0.0 0.9999847412109375 FORMAT "%7.4"
 /begin AXIS_DESCR STD_AXIS NO_INPUT_QUANTITY FORMULA_0010 11 0.0 65535.0 MAX_GRAD 0.0 /end AXIS_DESCR
/end CHARACTERISTIC
/begin CHARACTERISTIC KL_EXPALV "Funktion EXP(-ALPHA*tabst_w) hinten" CURVE 0x745C2 TKL_UW_VV_UW 100.0 FORMULA_0460 0.0 0.9999847412109375 FORMAT "%7.4"
 /begin AXIS_DESCR STD_AXIS Tn_abstell FORMULA_0010 11 0.0 65535.0 MAX_GRAD 0.0 /end AXIS_DESCR
/end CHARACTERISTIC
/begin CHARACTERISTIC KL_EXPBETAV "Funktion EXP (-BETA*tabst_w)" CURVE 0x7457A TKL_UW_VV_UW 100.0 FORMULA_0460 0.0 0.9999847412109375 FORMAT "%7.4"
 /begin AXIS_DESCR STD_AXIS NO_INPUT_QUANTITY FORMULA_0010 11 0.0 65535.0 MAX_GRAD 0.0 /end AXIS_DESCR
/end CHARACTERISTIC
/begin CHARACTERISTIC KL_FITGRZ "Grenzwert für soc_fit" CURVE 0x76078 TKL_SW_VV_UW 100.0 FORMULA_0462 0.0 99.99839782714844 FORMAT "%5.2"
 /begin AXIS_DESCR STD_AXIS T_saison FORMULA_0431 4 -3276.800048828125 3276.699951171875 MAX_GRAD 0.0 /end AXIS_DESCR
/end CHARACTERISTIC
/begin CHARACTERISTIC KL_I2PTC "I-Delta Übersetzer zu PTC Ansteuerung" CURVE 0x75C7C TKL_UW_VV_SW 100.0 FORMULA_0505 -100.0 100.0 FORMAT "%5.2"
 /begin AXIS_DESCR STD_AXIS Isolldiff FORMULA_0508 6 -200.0 5042.7998046875 MAX_GRAD 0.0 FORMAT "%6.3" /end AXIS_DESCR
/end CHARACTERISTIC
/begin CHARACTERISTIC KL_IABGLMOT "Abgleichstrom Motor" CURVE 0x7046E TKL_UW_VV_UB 100.0 FORMULA_0449 0.0 7.968699932098389
 /begin AXIS_DESCR STD_AXIS Ub FORMULA_0432 5 0.0 6173.39697265625 MAX_GRAD 0.0 FORMAT "%4.1" /end AXIS_DESCR
/end CHARACTERISTIC
/begin CHARACTERISTIC KL_IABGLNL "Abgleichstrom Kl. 15" CURVE 0x704BE TKL_UW_VV_UB 100.0 FORMULA_0449 0.0 7.968699932098389
 /begin AXIS_DESCR STD_AXIS Ub FORMULA_0432 5 0.0 6173.39697265625 MAX_GRAD 0.0 FORMAT "%4.1" /end AXIS_DESCR
/end CHARACTERISTIC
/begin CHARACTERISTIC KL_IABGLST "Abgleichstrom Start" CURVE 0x7045C TKL_UW_VV_UB 100.0 FORMULA_0449 0.0 7.968699932098389
 /begin AXIS_DESCR STD_AXIS Ub FORMULA_0432 5 0.0 6173.39697265625 MAX_GRAD 0.0 FORMAT "%4.1" /end AXIS_DESCR
/end CHARACTERISTIC
/begin CHARACTERISTIC KL_IREST "Noch verfuegbare Restleistung vom Generator." CURVE 0x75D6E TKL_UW_VV_SW 100.0 FORMULA_0505 -100.0 100.0 FORMAT "%5.2"
 /begin AXIS_DESCR STD_AXIS Pgenrest FORMULA_0507 10 0.0 16383.75 MAX_GRAD 0.0 FORMAT "%6.3" /end AXIS_DESCR
/end CHARACTERISTIC
/begin CHARACTERISTIC KL_ISOLLPR "Delta-I -> Prio Übersetzer" CURVE 0x75DC0 TKL_UW_VV_SW 100.0 FORMULA_0505 -100.0 100.0 FORMAT "%5.2"
 /begin AXIS_DESCR STD_AXIS Ibtdiff FORMULA_0508 6 -200.0 5042.7998046875 MAX_GRAD 0.0 FORMAT "%6.3" /end AXIS_DESCR
/end CHARACTERISTIC
/begin CHARACTERISTIC KL_ITNSTART "Startspannung abh. vom Itnstart" CURVE 0x760BA TKL_UB_VV_UW 100.0 FORMULA_0501 6.0 22.38369941711426 FORMAT "%6.3"
 /begin AXIS_DESCR STD_AXIS NO_INPUT_QUANTITY FORMULA_0516 4 0.0 996.0936889648438 MAX_GRAD 0.0 /end AXIS_DESCR
/end CHARACTERISTIC
/begin CHARACTERISTIC KL_LADEKENNL "Batterieladespannungskennlinie" CURVE 0x74560 TKL_SW_VV_SW 100.0 FORMULA_0488 0.0 127.9960021972656 FORMAT "%6.3"
 /begin AXIS_DESCR STD_AXIS T_battabst FORMULA_0431 6 -3276.800048828125 3276.699951171875 MAX_GRAD 0.0 /end AXIS_DESCR
/end CHARACTERISTIC
/begin CHARACTERISTIC KL_PMSOCVU "SoC-Wert aus der Fitberechnung" CURVE 0x75ECC TKL_UW_VV_UW 100.0 FORMULA_0462 0.0 99.99839782714844 FORMAT "%5.2"
 /begin AXIS_DESCR STD_AXIS Ubatts2 FORMULA_0501 3 6.0 22.38369941711426 MAX_GRAD 0.0 FORMAT "%6.3" /end AXIS_DESCR
/end CHARACTERISTIC
/begin CHARACTERISTIC KL_PRIO2PTC "Gewichtung der Prios auf Gewichtung fuer PTC Ansteuerung" CURVE 0x75D18 TKL_UW_VV_SW 100.0 FORMULA_0505 -100.0 100.0 FORMAT "%5.2"
 /begin AXIS_DESCR STD_AXIS Dfprio FORMULA_0507 5 0.0 16383.75 MAX_GRAD 0.0 FORMAT "%6.3" /end AXIS_DESCR
/end CHARACTERISTIC
/begin CHARACTERISTIC KL_PRIOCF "" CURVE 0x75C96 TKL_SW_VV_UB 100.0 FORMULA_0003 0.0 6.0
 /begin AXIS_DESCR STD_AXIS Dsoc2pi FORMULA_0505 7 -8192.0 8191.75 MAX_GRAD 0.0 FORMAT "%5.2" /end AXIS_DESCR
/end CHARACTERISTIC
/begin CHARACTERISTIC KL_PRIODF "" CURVE 0x75DF0 TKL_UW_VV_UB 100.0 FORMULA_0003 0.0 6.0
 /begin AXIS_DESCR STD_AXIS Dfprio FORMULA_0507 7 0.0 16383.75 MAX_GRAD 0.0 FORMAT "%6.3" /end AXIS_DESCR
/end CHARACTERISTIC
/begin CHARACTERISTIC KL_PTC "PWM-Übersetzer für PTC-Ansteuerung" CURVE 0x75C6A TKL_UW_VV_UB 100.0 FORMULA_0510 0.0 127.5
 /begin AXIS_DESCR STD_AXIS Allptcfilt FORMULA_0507 5 0.0 16383.75 MAX_GRAD 0.0 FORMAT "%6.3" /end AXIS_DESCR
/end CHARACTERISTIC
/begin CHARACTERISTIC KL_PWRCF "" CURVE 0x75CAE TKL_SW_VV_UB 100.0 FORMULA_0003 0.0 6.0
 /begin AXIS_DESCR STD_AXIS Dsoc2pi FORMULA_0505 7 -8192.0 8191.75 MAX_GRAD 0.0 FORMAT "%5.2" /end AXIS_DESCR
/end CHARACTERISTIC
/begin CHARACTERISTIC KL_PWRDF "" CURVE 0x75CEC TKL_UW_VV_UB 100.0 FORMULA_0003 0.0 13.0
 /begin AXIS_DESCR STD_AXIS Dfprio FORMULA_0507 14 0.0 16383.75 MAX_GRAD 0.0 FORMAT "%6.3" /end AXIS_DESCR
/end CHARACTERISTIC
/begin CHARACTERISTIC KL_RF_E2_HFM_AD "Kennlinie HFM Ebene 2" CURVE 0x79CD0 TKL_SW_VV_SW 100.0 FORMULA_0103 -100.0 1400.0 FORMAT "%4.1"
 /begin AXIS_DESCR STD_AXIS hfm_5ms_ad_b1 FORMULA_0114 11 0.0 1023.0 MAX_GRAD 0.0 /end AXIS_DESCR
/end CHARACTERISTIC
/begin CHARACTERISTIC KL_RF_E2_PUMG_KORR "Korrekturfaktor in Abh. vom Luftdruck" CURVE 0x79CFE TKL_SW_VV_SW 100.0 FORMULA_0073 -4.0 4.0 FORMAT "%6.3"
 /begin AXIS_DESCR STD_AXIS pumg FORMULA_0075 8 400.0 1200.0 MAX_GRAD 0.0 FORMAT "%4.1" /end AXIS_DESCR
/end CHARACTERISTIC
/begin CHARACTERISTIC KL_RF_E2_TAN_KORR "-" CURVE 0x79D20 TKL_SW_VV_UW 100.0 FORMULA_0073 0.0 4.0 FORMAT "%6.3"
 /begin AXIS_DESCR STD_AXIS temperatur FORMULA_0023 8 -50.0 170.0 MAX_GRAD 0.0 FORMAT "%4.1" /end AXIS_DESCR
/end CHARACTERISTIC
/begin CHARACTERISTIC KL_RF_PT_PUMG_KORR "Korrekturfaktor in Abh. vom Luftdruck" CURVE 0x766B2 TKL_SW_VV_UW 100.0 FORMULA_0073 0.0 4.0 FORMAT "%6.3"
 /begin AXIS_DESCR STD_AXIS pumg FORMULA_0075 8 400.0 1200.0 MAX_GRAD 0.0 FORMAT "%4.1" /end AXIS_DESCR
/end CHARACTERISTIC
/begin CHARACTERISTIC KL_RF_PT_TAN_KORR "-" CURVE 0x7666E TKL_SW_VV_UW 100.0 FORMULA_0073 0.0 4.0 FORMAT "%6.3"
 /begin AXIS_DESCR STD_AXIS temperatur FORMULA_0023 8 -50.0 170.0 MAX_GRAD 0.0 FORMAT "%4.1" /end AXIS_DESCR
/end CHARACTERISTIC
/begin CHARACTERISTIC KL_RF_PT_TANZYL_KORR "-" CURVE 0x76690 TKL_SW_VV_UW 100.0 FORMULA_0073 0.0 4.0 FORMAT "%6.3"
 /begin AXIS_DESCR STD_AXIS temperatur FORMULA_0023 8 -50.0 170.0 MAX_GRAD 0.0 FORMAT "%4.1" /end AXIS_DESCR
/end CHARACTERISTIC
/begin CHARACTERISTIC KL_RF_START "Start rf" CURVE 0x7665C TKL_SW_VV_SW 100.0 FORMULA_0007 0.0 2.0 FORMAT "%6.3" /begin AXIS_DESCR STD_AXIS n FORMULA_0006 4 0.0 10000.0 MAX_GRAD 0.0 /end AXIS_DESCR /end CHARACTERISTIC
/begin CHARACTERISTIC KL_RG_PHI_MEAN "Durchflussbeiwert RG" CURVE 0x767A8 TKL_SW_VV_SW 100.0 FORMULA_0558 -1.0 1.0 FORMAT "%7.4"
 /begin AXIS_DESCR STD_AXIS pzyl_pabg_Verhaeltniss FORMULA_1072 10 0.0 2.0 MAX_GRAD 0.0 FORMAT "%5.2" /end AXIS_DESCR
/end CHARACTERISTIC
/begin CHARACTERISTIC KL_RG_PRGVO_ASP_OFFSET "Druckoffset aus Ventilueberschneidung" CURVE 0x767D2 TKL_SW_VV_SW 100.0 FORMULA_0075 -2000.0 2000.0 FORMAT "%4.1"
 /begin AXIS_DESCR STD_AXIS van_vo_filt FORMULA_0102 9 -80.0 80.0 MAX_GRAD 0.0 FORMAT "%4.1" /end AXIS_DESCR
/end CHARACTERISTIC
/begin CHARACTERISTIC KL_RG_UES_A_MEAN "AVquerschnitt nach LOT" CURVE 0x76744 TKL_SW_VV_UW 100.0 FORMULA_0984 0.0 15.0 FORMAT "%6.3"
 /begin AXIS_DESCR STD_AXIS van_xd FORMULA_0102 12 0.0 160.0 MAX_GRAD 0.0 FORMAT "%4.1" /end AXIS_DESCR
/end CHARACTERISTIC
/begin CHARACTERISTIC KL_RG_UES_E_MEAN "EV-Querschnitt vor LOT" CURVE 0x76776 TKL_SW_VV_UW 100.0 FORMULA_0984 0.0 15.0 FORMAT "%6.3"
 /begin AXIS_DESCR STD_AXIS van_xd FORMULA_0102 12 0.0 160.0 MAX_GRAD 0.0 FORMAT "%4.1" /end AXIS_DESCR
/end CHARACTERISTIC
/begin CHARACTERISTIC KL_SA_N_DYN "Drehzalgradientenabhae. Offset fuer WA-Drezahlberechnung" CURVE 0x76A02 TKL_SW_VV_SW 100.0 FORMULA_0006 0.0 10000.0 /begin AXIS_DESCR STD_AXIS dn FORMULA_0105 4 -10000.0 10000.0 MAX_GRAD 0.0 /end AXIS_DESCR /end CHARACTERISTIC
/begin CHARACTERISTIC KL_SA_N_GANG "gangabhaengiger Offset fuer WE-drehzalberechnung" CURVE 0x769C6 TKL_SW_VV_SW 100.0 FORMULA_0006 0.0 10000.0 /begin AXIS_DESCR STD_AXIS gang FORMULA_0010 10 -1.0 10.0 MAX_GRAD 0.0 /end AXIS_DESCR /end CHARACTERISTIC
/begin CHARACTERISTIC KL_SA_N_HYS_GANG "gangabh. Hyst. SA-Drehzahl" CURVE 0x76A14 TKL_SW_VV_SW 100.0 FORMULA_0006 0.0 10000.0 /begin AXIS_DESCR STD_AXIS gang FORMULA_0010 10 -1.0 10.0 MAX_GRAD 0.0 /end AXIS_DESCR /end CHARACTERISTIC
/begin CHARACTERISTIC KL_SA_N_TMOT "tmot abhaeng. Offset fuer WA-berechnung" CURVE 0x769F0 TKL_SW_VV_SW 100.0 FORMULA_0006 0.0 10000.0
 /begin AXIS_DESCR STD_AXIS tmot FORMULA_0023 4 -50.0 170.0 MAX_GRAD 0.0 FORMAT "%4.1" /end AXIS_DESCR
/end CHARACTERISTIC
/begin CHARACTERISTIC KL_SOC0TEMP "Temperaturabhängige Stromkorrektur für Ruhespannungsmessung" CURVE 0x75E6A TKL_SW_VV_UB 100.0 FORMULA_0477 0.0 1.99210000038147
 /begin AXIS_DESCR STD_AXIS Tsocloc FORMULA_0431 5 -3276.800048828125 3276.699951171875 MAX_GRAD 0.0 /end AXIS_DESCR
/end CHARACTERISTIC
/begin CHARACTERISTIC KL_SOCPRIO "dsoc -> Prio Übersetzer" CURVE 0x75D2E TKL_SW_VV_SW 100.0 FORMULA_0505 -150.0 150.0 FORMAT "%5.2"
 /begin AXIS_DESCR STD_AXIS D_soc FORMULA_0479 4 -100.0 99.99690246582031 MAX_GRAD 0.0 FORMAT "%5.2" /end AXIS_DESCR
/end CHARACTERISTIC
/begin CHARACTERISTIC KL_SSOC "soc_s in Abh. von tsaison" CURVE 0x7608A TKL_SW_VV_UW 100.0 FORMULA_0462 0.0 99.99839782714844 FORMAT "%5.2"
 /begin AXIS_DESCR STD_AXIS T_saison FORMULA_0431 4 -3276.800048828125 3276.699951171875 MAX_GRAD 0.0 /end AXIS_DESCR
/end CHARACTERISTIC
/begin CHARACTERISTIC KL_T2RELMAX "Max Toleranzzeit von T2" CURVE 0x75B40 TKL_UW_VV_UW 100.0 FORMULA_0494 0.0 917490.0 FORMAT "%5.2"
 /begin AXIS_DESCR STD_AXIS T_histsum FORMULA_0492 6 0.0 3669960.0 MAX_GRAD 0.0 FORMAT "%5.2" /end AXIS_DESCR
/end CHARACTERISTIC
/begin CHARACTERISTIC KL_T2RELMXRG "Max Toleranzzeit von T2 Ringshift" CURVE 0x75B26 TKL_UW_VV_UW 100.0 FORMULA_0494 0.0 917490.0 FORMAT "%5.2"
 /begin AXIS_DESCR STD_AXIS T_histsum FORMULA_0492 6 0.0 3669960.0 MAX_GRAD 0.0 FORMAT "%5.2" /end AXIS_DESCR
/end CHARACTERISTIC
/begin CHARACTERISTIC KL_T3RELMAX "Max Toleranzzeit von T3" CURVE 0x75B5A TKL_UW_VV_UW 100.0 FORMULA_0494 0.0 917490.0 FORMAT "%5.2"
 /begin AXIS_DESCR STD_AXIS T_histsum FORMULA_0492 6 0.0 3669960.0 MAX_GRAD 0.0 FORMAT "%5.2" /end AXIS_DESCR
/end CHARACTERISTIC
/begin CHARACTERISTIC KL_T3RELMXRG "Max Toleranzzeit von T3 Ringshift" CURVE 0x75B86 TKL_UW_VV_UW 100.0 FORMULA_0494 0.0 917490.0 FORMAT "%5.2"
 /begin AXIS_DESCR STD_AXIS T_histsum FORMULA_0492 6 0.0 3669960.0 MAX_GRAD 0.0 FORMAT "%5.2" /end AXIS_DESCR
/end CHARACTERISTIC
/begin CHARACTERISTIC KL_T4RELMAX "Max Toleranzzeit von T4" CURVE 0x75BA0 TKL_UW_VV_UW 100.0 FORMULA_0494 0.0 917490.0 FORMAT "%5.2"
 /begin AXIS_DESCR STD_AXIS T_histsum FORMULA_0492 6 0.0 3669960.0 MAX_GRAD 0.0 FORMAT "%5.2" /end AXIS_DESCR
/end CHARACTERISTIC
/begin CHARACTERISTIC KL_T4RELMXRG "Max Toleranzzeit von T4 Ringshift" CURVE 0x75AFA TKL_UW_VV_UW 100.0 FORMULA_0494 0.0 917490.0 FORMAT "%5.2"
 /begin AXIS_DESCR STD_AXIS T_histsum FORMULA_0492 6 0.0 3669960.0 MAX_GRAD 0.0 FORMAT "%5.2" /end AXIS_DESCR
/end CHARACTERISTIC
/begin CHARACTERISTIC KL_UB_PTC "UBatt-Kennlinie für Ansteuerung PTC" CURVE 0x75C50 TKL_SW_VV_SW 100.0 FORMULA_0505 -100.0 100.0 FORMAT "%5.2"
 /begin AXIS_DESCR STD_AXIS Ubtpt1ptc FORMULA_0446 6 -32.0 31.99900054931641 MAX_GRAD 0.0 FORMAT "%7.4" /end AXIS_DESCR
/end CHARACTERISTIC
/begin CHARACTERISTIC KL_UBTPRIO "Delta-Spannung -> Prio Übersetzer" CURVE 0x75D54 TKL_SW_VV_SW 100.0 FORMULA_0505 -100.0 100.0 FORMAT "%5.2"
 /begin AXIS_DESCR STD_AXIS Ubdiffilt FORMULA_0446 6 -32.0 31.99900054931641 MAX_GRAD 0.0 FORMAT "%7.4" /end AXIS_DESCR
/end CHARACTERISTIC
/begin CHARACTERISTIC KL_UNSTART "Startspannung abhängig v.Motordrehzahl" CURVE 0x760B0 TKL_SW_VV_UW 100.0 FORMULA_0501 6.0 22.38369941711426 FORMAT "%6.3"
 /begin AXIS_DESCR STD_AXIS Nnmstart FORMULA_0006 2 -32768.0 32767.0 MAX_GRAD 0.0 /end AXIS_DESCR
/end CHARACTERISTIC
/begin CHARACTERISTIC KL_USOLL "Batteriesollspannung aufgrund von tbatt" CURVE 0x760EA TKL_SW_VV_UW 100.0 FORMULA_0501 6.0 22.38369941711426 FORMAT "%6.3"
 /begin AXIS_DESCR STD_AXIS T_batt FORMULA_0431 3 -3276.800048828125 3276.699951171875 MAX_GRAD 0.0 /end AXIS_DESCR
/end CHARACTERISTIC
/begin CHARACTERISTIC KL_UTSTART "Startspannung in Abhängigkeit von Temperatur Batterie" CURVE 0x760C8 TKL_SW_VV_SW 100.0 FORMULA_0500 -8.192000389099121 8.191699981689453 FORMAT "%6.3"
 /begin AXIS_DESCR STD_AXIS T_batt FORMULA_0431 3 -3276.800048828125 3276.699951171875 MAX_GRAD 0.0 /end AXIS_DESCR
/end CHARACTERISTIC
/begin CHARACTERISTIC KL_WUBPTC "KL Multiplikationsfaktor W_ub bei SpgEinbruch" CURVE 0x75CC6 TKL_UW_VV_UB 100.0 FORMULA_0465 0.0 3.984299898147583
 /begin AXIS_DESCR STD_AXIS Ub FORMULA_0432 5 0.0 6173.39697265625 MAX_GRAD 0.0 FORMAT "%4.1" /end AXIS_DESCR
/end CHARACTERISTIC
/begin CHARACTERISTIC S_ABSCHK "Schalter für Applikationswert absch_korr" VALUE 0x76072 TKW_VV_VV_UB 100.0 FORMULA_0003 0.0 255.0 /end CHARACTERISTIC
/begin CHARACTERISTIC S_BSDKOORD "" VALUE 0x7079D TKW_VV_VV_UB 100.0 FORMULA_0478 0.0 1.0 /end CHARACTERISTIC
/begin CHARACTERISTIC S_BSOCCALC "Enable Rücksetzten Ruhespannungen IBS" VALUE 0x75E67 TKW_VV_VV_UB 100.0 FORMULA_0003 0.0 255.0 /end CHARACTERISTIC
/begin CHARACTERISTIC S_DFKOMMERR "Maßnahmen bei Gen. Komm. Fehler aktiv" VALUE 0x75C10 TKW_VV_VV_UB 100.0 FORMULA_0478 0.0 1.0 /end CHARACTERISTIC
/begin CHARACTERISTIC S_DSOCS "Schalter für Applikationswert Delta SoC" VALUE 0x76073 TKW_VV_VV_UB 100.0 FORMULA_0003 0.0 255.0 /end CHARACTERISTIC
/begin CHARACTERISTIC S_IPMPTC "PTC Einschränkung aufgrund IPM" VALUE 0x75C11 TKW_VV_VV_UB 100.0 FORMULA_0478 0.0 1.0 /end CHARACTERISTIC
/begin CHARACTERISTIC S_LBATT1 "Applikationsschalter1 Auswahl Ersatztemperatur" VALUE 0x7452B TKW_VV_VV_UB 100.0 FORMULA_0478 0.0 1.0 /end CHARACTERISTIC
/begin CHARACTERISTIC S_LBATT2 "Applikationsschalter2 Auswahl Ersatztemperatur" VALUE 0x7452C TKW_VV_VV_UB 100.0 FORMULA_0478 0.0 1.0 /end CHARACTERISTIC
/begin CHARACTERISTIC S_LBATTAPPL "" VALUE 0x7455F TKW_VV_VV_UB 100.0 FORMULA_0478 0.0 1.0 /end CHARACTERISTIC
/begin CHARACTERISTIC S_N_IDLIBS "Schalter zum manuellen Setzen von LL aktiv" VALUE 0x74646 TKW_VV_VV_UB 100.0 FORMULA_0478 0.0 1.0 /end CHARACTERISTIC
/begin CHARACTERISTIC S_NKWITNSTRT "0 = Nkw-Auswertung, 1=Itnstart Auswertung" VALUE 0x760AA TKW_VV_VV_UB 100.0 FORMULA_0478 0.0 1.0 /end CHARACTERISTIC
/begin CHARACTERISTIC S_PM_TEST1 "Applikationsschalter um die Startberechnung zu erzwingen" VALUE 0x760AC TKW_VV_VV_UB 100.0 FORMULA_0003 0.0 255.0 /end CHARACTERISTIC
/begin CHARACTERISTIC S_PMMESS "Schalter Messemode aktiv" VALUE 0x75C12 TKW_VV_VV_UB 100.0 FORMULA_0478 0.0 1.0 /end CHARACTERISTIC
/begin CHARACTERISTIC S_PMSOCFIT "Schalter zur Applikation SoC aus der Fitberechnung" VALUE 0x75ECA TKW_VV_VV_UB 100.0 FORMULA_0003 0.0 255.0 /end CHARACTERISTIC
/begin CHARACTERISTIC S_PMSTARTQ "Applikationsschalter f. B_pmstartq" VALUE 0x760AB TKW_VV_VV_UB 100.0 FORMULA_0003 0.0 255.0 /end CHARACTERISTIC
/begin CHARACTERISTIC S_PMSV_HEIZ "Standheizen wird für Nibble-historie ausgewertet" VALUE 0x75AF6 TKW_VV_VV_UB 100.0 FORMULA_0478 0.0 1.0 /end CHARACTERISTIC
/begin CHARACTERISTIC S_PMSV_KLIMA "Standklimatisierung wird für Nibble-historie ausgewertet" VALUE 0x75AF7 TKW_VV_VV_UB 100.0 FORMULA_0478 0.0 1.0 /end CHARACTERISTIC
/begin CHARACTERISTIC S_PMSV_LUFT "Standlueften wird für Nibble-historie ausgewertet" VALUE 0x75AF8 TKW_VV_VV_UB 100.0 FORMULA_0478 0.0 1.0 /end CHARACTERISTIC
/begin CHARACTERISTIC S_PMTABSMN "Schalter für Applikation der Abstellzeit tabsmn_w" VALUE 0x76074 TKW_VV_VV_UB 100.0 FORMULA_0003 0.0 255.0 /end CHARACTERISTIC
/begin CHARACTERISTIC S_PRIOCFENA "" VALUE 0x75C13 TKW_VV_VV_UB 100.0 FORMULA_0478 0.0 1.0 /end CHARACTERISTIC
/begin CHARACTERISTIC S_PRIOMANUAL "Manueller Schalter fuer E60/E65-Can Botschaften" VALUE 0x75C14 TKW_VV_VV_UB 100.0 FORMULA_0003 0.0 255.0 /end CHARACTERISTIC
/begin CHARACTERISTIC S_PTCKOOR "Schalter Aktivierung PTC Koordinator im PMPRSVCALC" VALUE 0x75C15 TKW_VV_VV_UB 100.0 FORMULA_0478 0.0 1.0 /end CHARACTERISTIC
/begin CHARACTERISTIC S_PTCMANUAL "Schalter manueller PTC Wert aktivieren." VALUE 0x75C16 TKW_VV_VV_UB 100.0 FORMULA_0478 0.0 1.0 /end CHARACTERISTIC
/begin CHARACTERISTIC S_PWRCFENA "" VALUE 0x75C17 TKW_VV_VV_UB 100.0 FORMULA_0478 0.0 1.0 /end CHARACTERISTIC
/begin CHARACTERISTIC S_QSTARTFK "Schalter für Applikation q_startfgk" VALUE 0x76075 TKW_VV_VV_UB 100.0 FORMULA_0003 0.0 255.0 /end CHARACTERISTIC
/begin CHARACTERISTIC S_RIN "Schalter Applikation Innenwiderstandsprüfung" VALUE 0x760AD TKW_VV_VV_UB 100.0 FORMULA_0003 0.0 255.0 /end CHARACTERISTIC
/begin CHARACTERISTIC S_SOC_BILA "Schalter für Applik. soc_bila" VALUE 0x75E68 TKW_VV_VV_UB 100.0 FORMULA_0003 0.0 255.0 /end CHARACTERISTIC
/begin CHARACTERISTIC S_SOC_QUAL "Schalter für Applik. soc_quali" VALUE 0x75E69 TKW_VV_VV_UB 100.0 FORMULA_0003 0.0 255.0 /end CHARACTERISTIC
/begin CHARACTERISTIC S_SOCSTAFK "Schalter für Applikation SoC aus der Startfähigkeit" VALUE 0x76076 TKW_VV_VV_UB 100.0 FORMULA_0003 0.0 255.0 /end CHARACTERISTIC
/begin CHARACTERISTIC S_STARTAW "Startauswertung fertig" VALUE 0x760AE TKW_VV_VV_UB 100.0 FORMULA_0003 0.0 255.0 /end CHARACTERISTIC
/begin CHARACTERISTIC S_UIBS "Schalter für UIBS, wenn True dann uibs=UIBSAPP" VALUE 0x760E9 TKW_VV_VV_UB 100.0 FORMULA_0478 0.0 1.0 /end CHARACTERISTIC
/begin CHARACTERISTIC ZK_PMSOC "Zeitfaktor" VALUE 0x75EC8 TKW_VV_VV_UW 100.0 FORMULA_0460 0.0 0.9999847412109375 FORMAT "%7.4" /end CHARACTERISTIC
/begin MEASUREMENT Absch_korr "Korrekturwert Abschaltung" SWORD FORMULA_0499 0 0.0 -40.0 40.0 READ_WRITE ECU_ADDRESS 0x3FA992 /end MEASUREMENT
/begin MEASUREMENT All2ptc "Gesamtgewichtung für PTC-Ansteuerung" SWORD FORMULA_0505 0 0.0 -500.0 550.0 READ_WRITE ECU_ADDRESS 0x3FCB1C /end MEASUREMENT
/begin MEASUREMENT Allptcfilt "pi-geregelte Gewichtung für PTC-Ansteuerung" UWORD FORMULA_0507 0 0.0 0.0 550.0 READ_WRITE ECU_ADDRESS 0x3FCB42 /end MEASUREMENT
/begin MEASUREMENT Batt_index "Batterie Index" UBYTE FORMULA_0003 0 0.0 0.0 255.0 READ_WRITE ECU_ADDRESS 0x3FCAEC /end MEASUREMENT
/begin MEASUREMENT Batt_ort "Batterieeinbauort" UBYTE FORMULA_0003 0 0.0 0.0 255.0 READ_WRITE ECU_ADDRESS 0x3FAF20 /end MEASUREMENT
/begin MEASUREMENT Batt_tfil "Zeitkonstante Batterie" UWORD FORMULA_0460 0 0.0 0.0 0.9999847412109375 READ_WRITE ECU_ADDRESS 0x3FAF1E /end MEASUREMENT
/begin MEASUREMENT C_battnenn "Batteriekapazitaet" UBYTE FORMULA_0487 0 0.0 0.0 255.0 READ_WRITE ECU_ADDRESS 0x3FCAED /end MEASUREMENT
/begin MEASUREMENT can_alive_bedat_cnt "Fehler Alive" UBYTE FORMULA_0003 0 0.0 0.0 255.0 READ_WRITE ECU_ADDRESS 0x3FBD8F /end MEASUREMENT
/begin MEASUREMENT can_alive_BedFgr_cnt "Fehler Alive" UBYTE FORMULA_0003 0 0.0 0.0 255.0 READ_WRITE ECU_ADDRESS 0x3FBD5D /end MEASUREMENT
/begin MEASUREMENT can_alive_grb_cnt "Fehler Alive" UBYTE FORMULA_0003 0 0.0 0.0 255.0 READ_WRITE ECU_ADDRESS 0x3FBD32 /end MEASUREMENT
/begin MEASUREMENT can_alive_grb2_cnt "Fehler Alive" UBYTE FORMULA_0003 0 0.0 0.0 255.0 READ_WRITE ECU_ADDRESS 0x3FBD36 /end MEASUREMENT
/begin MEASUREMENT can_alive_grb3_cnt "Fehler Alive" UBYTE FORMULA_0003 0 0.0 0.0 255.0 READ_WRITE ECU_ADDRESS 0x3FBD3A /end MEASUREMENT
/begin MEASUREMENT can_alive_klst_cnt "Fehler Alive" UBYTE FORMULA_0003 0 0.0 0.0 255.0 READ_WRITE ECU_ADDRESS 0x3FBD28 /end MEASUREMENT
/begin MEASUREMENT can_alive_stkombi_cnt "Fehler Alive" UBYTE FORMULA_0003 0 0.0 0.0 255.0 READ_WRITE ECU_ADDRESS 0x3FBD89 /end MEASUREMENT
/begin MEASUREMENT can_alive_TorqReqDKG_cnt "Fehler Alive" UBYTE FORMULA_0003 0 0.0 0.0 255.0 READ_WRITE ECU_ADDRESS 0x3FBD2F /end MEASUREMENT
/begin MEASUREMENT can_alive_TorqReqDSC_cnt "Fehler Alive" UBYTE FORMULA_0003 0 0.0 0.0 255.0 READ_WRITE ECU_ADDRESS 0x3FBD3D /end MEASUREMENT
/begin MEASUREMENT can_alive_vehmod_cnt "Fehler Alive" UBYTE FORMULA_0003 0 0.0 0.0 255.0 READ_WRITE ECU_ADDRESS 0x3FBD4B /end MEASUREMENT
/begin MEASUREMENT can_alive_vfzg_cnt "Fehler Alive" UBYTE FORMULA_0003 0 0.0 0.0 255.0 READ_WRITE ECU_ADDRESS 0x3FBD4F /end MEASUREMENT
/begin MEASUREMENT can_atemp_timeout "ATemp-Timeout" UBYTE FORMULA_0609 0 0.0 0.0 255.0 READ_WRITE ECU_ADDRESS 0x3FBD9E /end MEASUREMENT
/begin MEASUREMENT can_ax_timeout "AX-Timeout" UBYTE FORMULA_0461 0 0.0 0.0 25.5 READ_WRITE ECU_ADDRESS 0x3FBD9F /end MEASUREMENT
/begin MEASUREMENT can_bedat_s "Schalter Bed. Audio Tel" UBYTE FORMULA_0621 0 0.0 0.0 255.0 READ_WRITE ECU_ADDRESS 0x3FBD92 /end MEASUREMENT
/begin MEASUREMENT can_bedat_timeout "BedAT-Timeout" UBYTE FORMULA_0214 0 0.0 0.0 255.0 READ_WRITE ECU_ADDRESS 0x3FBD8E /end MEASUREMENT
/begin MEASUREMENT can_bedfgr_timeout "BedFgr-Timeout" UBYTE FORMULA_0461 0 0.0 0.0 25.5 READ_WRITE ECU_ADDRESS 0x3FBD5C /end MEASUREMENT
/begin MEASUREMENT can_chksum_bedat_cnt "Fehler Komplement" UBYTE FORMULA_0003 0 0.0 0.0 255.0 READ_WRITE ECU_ADDRESS 0x3FBD91 /end MEASUREMENT
/begin MEASUREMENT can_chksum_BedFgr_cnt "Fehler Checksumme" UBYTE FORMULA_0003 0 0.0 0.0 255.0 READ_WRITE ECU_ADDRESS 0x3FBD5F /end MEASUREMENT
/begin MEASUREMENT can_chksum_grb_cnt "Fehler Checksumme" UBYTE FORMULA_0003 0 0.0 0.0 255.0 READ_WRITE ECU_ADDRESS 0x3FBD34 /end MEASUREMENT
/begin MEASUREMENT can_chksum_grb2_cnt "Fehler Checksumme" UBYTE FORMULA_0003 0 0.0 0.0 255.0 READ_WRITE ECU_ADDRESS 0x3FBD38 /end MEASUREMENT
/begin MEASUREMENT can_chksum_grb3_cnt "Fehler Checksumme" UBYTE FORMULA_0003 0 0.0 0.0 255.0 READ_WRITE ECU_ADDRESS 0x3FBD3C /end MEASUREMENT
/begin MEASUREMENT can_chksum_klst_cnt "Fehler Checksumme" UBYTE FORMULA_0003 0 0.0 0.0 255.0 READ_WRITE ECU_ADDRESS 0x3FBD2A /end MEASUREMENT
/begin MEASUREMENT can_chksum_TorqReqDKG_cnt "Fehler Checksumme" UBYTE FORMULA_0003 0 0.0 0.0 255.0 READ_WRITE ECU_ADDRESS 0x3FBD31 /end MEASUREMENT
/begin MEASUREMENT can_chksum_TorqReqDSC_cnt "Fehler Checksumme" UBYTE FORMULA_0003 0 0.0 0.0 255.0 READ_WRITE ECU_ADDRESS 0x3FBD3F /end MEASUREMENT
/begin MEASUREMENT can_chksum_vehmod_cnt "Fehler Checksumme" UBYTE FORMULA_0003 0 0.0 0.0 255.0 READ_WRITE ECU_ADDRESS 0x3FBD4D /end MEASUREMENT
/begin MEASUREMENT can_chksum_vfzg_cnt "Fehler Checksumme" UBYTE FORMULA_0003 0 0.0 0.0 255.0 READ_WRITE ECU_ADDRESS 0x3FBD51 /end MEASUREMENT
/begin MEASUREMENT can_clas_bat "Batterieklasse" UBYTE FORMULA_0614 0 0.0 0.0 255.0 READ_WRITE ECU_ADDRESS 0x3FBD60 /end MEASUREMENT
/begin MEASUREMENT can_crash_timeout "KKOS-Timeout" UBYTE FORMULA_0461 0 0.0 0.0 25.5 READ_WRITE ECU_ADDRESS 0x3FBD4E /end MEASUREMENT
/begin MEASUREMENT can_ctr_ilicht "Steuerung Innenlicht" UBYTE FORMULA_0618 0 0.0 0.0 255.0 READ_WRITE ECU_ADDRESS 0x3FBD67 /end MEASUREMENT
/begin MEASUREMENT can_ed_tsperr "ED-Sperrzeit fuer BusOn" UWORD FORMULA_0606 0 0.0 0.0 327.6749877929688 READ_WRITE ECU_ADDRESS 0x3FBD1C /end MEASUREMENT
/begin MEASUREMENT can_ed_tsperr_kl15 "ED-Sperrzeit fuer Kl15" UWORD FORMULA_0606 0 0.0 0.0 327.6749877929688 READ_WRITE ECU_ADDRESS 0x3FBD1E /end MEASUREMENT
/begin MEASUREMENT can_ev_repeat "Wiederholzaehler" UBYTE FORMULA_0003 0 0.0 0.0 255.0 READ_WRITE ARRAY_SIZE 3 ECU_ADDRESS 0x3FBD0D MATRIX_DIM 3 1 1 /end MEASUREMENT
/begin MEASUREMENT can_ev_timer "Timer" UBYTE FORMULA_0358 0 0.0 0.0 2550.0 READ_WRITE ARRAY_SIZE 3 ECU_ADDRESS 0x3FBD10 MATRIX_DIM 3 1 1 /end MEASUREMENT
/begin MEASUREMENT can_fgr_idx "Index FGR-Geschwindigkeit" UBYTE FORMULA_0003 0 0.0 0.0 4.0 READ_WRITE ECU_ADDRESS 0x3FBD68 /end MEASUREMENT
/begin MEASUREMENT can_fgr_v_idx_1 "FGR-Geschwindigkeit Index 1" UWORD FORMULA_0619 0 0.0 30.0 250.0 READ_WRITE ARRAY_SIZE 5 ECU_ADDRESS 0x3FBD6A MATRIX_DIM 5 1 1 /end MEASUREMENT
/begin MEASUREMENT can_fgr_v_idx_2 "FGR-Geschwindigkeit Index 2" UWORD FORMULA_0619 0 0.0 30.0 250.0 READ_WRITE ARRAY_SIZE 5 ECU_ADDRESS 0x3FBD74 MATRIX_DIM 5 1 1 /end MEASUREMENT
/begin MEASUREMENT can_fgr_v_idx_3 "FGR-Geschwindigkeit Index 3" UWORD FORMULA_0619 0 0.0 30.0 250.0 READ_WRITE ARRAY_SIZE 5 ECU_ADDRESS 0x3FBD7E MATRIX_DIM 5 1 1 /end MEASUREMENT
/begin MEASUREMENT can_fst_li "Fuellstand Tank-Links" UBYTE FORMULA_0559 0 0.0 0.0 127.5 READ_WRITE ECU_ADDRESS 0x3FBD44 /end MEASUREMENT
/begin MEASUREMENT can_fst_re "Fuellstand Tank-Rechts" UBYTE FORMULA_0559 0 0.0 0.0 127.5 READ_WRITE ECU_ADDRESS 0x3FBD45 /end MEASUREMENT
/begin MEASUREMENT can_fst_reserve "Reservelampe" UBYTE FORMULA_0611 0 0.0 0.0 255.0 READ_WRITE ECU_ADDRESS 0x3FBD46 /end MEASUREMENT
/begin MEASUREMENT can_fst_sum "Fuellstand Tank" UWORD FORMULA_0610 0 0.0 0.0 127.5 READ_WRITE ECU_ADDRESS 0x3FBD42 /end MEASUREMENT
/begin MEASUREMENT can_grb2_timeout "Getriebe2-Timeout" UBYTE FORMULA_0461 0 0.0 0.0 25.5 READ_WRITE ECU_ADDRESS 0x3FBD35 /end MEASUREMENT
/begin MEASUREMENT can_grb3_timeout "Getriebe3-Timeout" UBYTE FORMULA_0461 0 0.0 0.0 25.5 READ_WRITE ECU_ADDRESS 0x3FBD39 /end MEASUREMENT
/begin MEASUREMENT can_i_qc_veh "Ruhestrom Fahrzeug" UBYTE FORMULA_0615 0 0.0 0.0 255.0 READ_WRITE ECU_ADDRESS 0x3FBD61 /end MEASUREMENT
/begin MEASUREMENT can_i_sc_max "max. Kurzschlußstrom" UBYTE FORMULA_0616 0 0.0 0.0 2550.0 READ_WRITE ECU_ADDRESS 0x3FBD63 /end MEASUREMENT
/begin MEASUREMENT can_i_sc_min "min. Kurzschlußstrom" UBYTE FORMULA_0616 0 0.0 0.0 2550.0 READ_WRITE ECU_ADDRESS 0x3FBD62 /end MEASUREMENT
/begin MEASUREMENT can_kkos_elu "Anfoderung ELU" UBYTE FORMULA_0607 0 0.0 0.0 255.0 READ_WRITE ECU_ADDRESS 0x3FBD2E /end MEASUREMENT
/begin MEASUREMENT can_kkos_timeout "KKOS-Timeout" UBYTE FORMULA_0461 0 0.0 0.0 25.5 READ_WRITE ECU_ADDRESS 0x3FBD2D /end MEASUREMENT
/begin MEASUREMENT can_klst_s_roh "KLST-Rohinfo" UBYTE FORMULA_0003 0 0.0 0.0 255.0 READ_WRITE ECU_ADDRESS 0x3FBD2B /end MEASUREMENT
/begin MEASUREMENT can_klst_timeout "KLST-Timeout" UBYTE FORMULA_0461 0 0.0 0.0 25.5 READ_WRITE ECU_ADDRESS 0x3FBD2C /end MEASUREMENT
/begin MEASUREMENT can_kmst_timeout "KMST-Timeout" UBYTE FORMULA_0609 0 0.0 0.0 255.0 READ_WRITE ECU_ADDRESS 0x3FBD41 /end MEASUREMENT
/begin MEASUREMENT can_no_key_update "Schluesselnr.-Aktualisierungsverriegelung bei B_ZUST_ML" UBYTE FORMULA_0612 0 0.0 0.0 255.0 READ_WRITE ECU_ADDRESS 0x3FBD47 /end MEASUREMENT
/begin MEASUREMENT can_reichweite "Reichweite" UWORD FORMULA_0613 0 0.0 0.0 65535.0 READ_WRITE ECU_ADDRESS 0x3FBD48 /end MEASUREMENT
/begin MEASUREMENT can_st_ax "Empfangsstatus aLaengs" UWORD FORMULA_0116 0 0.0 0.0 65535.0 READ_WRITE ECU_ADDRESS 0x3FBD26 /end MEASUREMENT
/begin MEASUREMENT can_st_bedat "Empfangsstatus Bed. Audio Tel" UBYTE FORMULA_0117 0 0.0 0.0 255.0 READ_WRITE ECU_ADDRESS 0x3FBD23 /end MEASUREMENT
/begin MEASUREMENT can_st_crash "Empfangsstatus Crashabschaltung" UBYTE FORMULA_0117 0 0.0 0.0 255.0 READ_WRITE ECU_ADDRESS 0x3FBD21 /end MEASUREMENT
/begin MEASUREMENT can_st_grb3 "Empfangsstatus Getriebe 3" UWORD FORMULA_0116 0 0.0 0.0 65535.0 READ_WRITE ECU_ADDRESS 0x3FBD24 /end MEASUREMENT
/begin MEASUREMENT can_st_kmst "Empfangsstatus Kilometerstand" UBYTE FORMULA_0117 0 0.0 0.0 255.0 READ_WRITE ECU_ADDRESS 0x3FBD22 /end MEASUREMENT
/begin MEASUREMENT can_st_lrw "Empfangsstatus LRW" UBYTE FORMULA_0117 0 0.0 0.0 255.0 READ_WRITE ECU_ADDRESS 0x3FBD20 /end MEASUREMENT
/begin MEASUREMENT can_st_statanh "Empfangsstatus StatAnh" UBYTE FORMULA_0117 0 0.0 0.0 255.0 READ_WRITE ECU_ADDRESS 0x3FBD94 /end MEASUREMENT
/begin MEASUREMENT can_st_statr "Empfangsstatus StatR" UBYTE FORMULA_0117 0 0.0 0.0 255.0 READ_WRITE ECU_ADDRESS 0x3FBD96 /end MEASUREMENT
/begin MEASUREMENT can_st_toma "Empfangsstatus RadToleranz" UBYTE FORMULA_0117 0 0.0 0.0 255.0 READ_WRITE ECU_ADDRESS 0x3FBD98 /end MEASUREMENT
/begin MEASUREMENT can_stat_veh_mod "Status Fahrzeugmodus" UBYTE FORMULA_0617 0 0.0 0.0 255.0 READ_WRITE ARRAY_SIZE 3 ECU_ADDRESS 0x3FBD64 MATRIX_DIM 3 1 1 /end MEASUREMENT
/begin MEASUREMENT can_statanh_timeout "StatAnh-Timeout" UBYTE FORMULA_0214 0 0.0 0.0 255.0 READ_WRITE ECU_ADDRESS 0x3FBD93 /end MEASUREMENT
/begin MEASUREMENT can_statr_timeout "StatR-Timeout" UBYTE FORMULA_0214 0 0.0 0.0 255.0 READ_WRITE ECU_ADDRESS 0x3FBD95 /end MEASUREMENT
/begin MEASUREMENT can_toma_hl "RadToleranz HL" SBYTE FORMULA_0623 0 0.0 -12.80000019073486 12.69999980926514 READ_WRITE ECU_ADDRESS 0x3FBD9C /end MEASUREMENT
/begin MEASUREMENT can_toma_hr "RadToleranz HR" SBYTE FORMULA_0623 0 0.0 -12.80000019073486 12.69999980926514 READ_WRITE ECU_ADDRESS 0x3FBD9D /end MEASUREMENT
/begin MEASUREMENT can_toma_st "Status RadToleranz" UBYTE FORMULA_0622 0 0.0 0.0 255.0 READ_WRITE ECU_ADDRESS 0x3FBD99 /end MEASUREMENT
/begin MEASUREMENT can_toma_timeout "RadToleranz-Timeout" UBYTE FORMULA_0214 0 0.0 0.0 255.0 READ_WRITE ECU_ADDRESS 0x3FBD97 /end MEASUREMENT
/begin MEASUREMENT can_toma_vl "RadToleranz VL" SBYTE FORMULA_0623 0 0.0 -12.80000019073486 12.69999980926514 READ_WRITE ECU_ADDRESS 0x3FBD9A /end MEASUREMENT
/begin MEASUREMENT can_toma_vr "RadToleranz VR" SBYTE FORMULA_0623 0 0.0 -12.80000019073486 12.69999980926514 READ_WRITE ECU_ADDRESS 0x3FBD9B /end MEASUREMENT
/begin MEASUREMENT can_tuer_st "Tuerstatus" UBYTE FORMULA_0620 0 0.0 0.0 255.0 READ_WRITE ECU_ADDRESS 0x3FBD88 /end MEASUREMENT
/begin MEASUREMENT can_v_rad_hl "Radgeschw. HL - Rohwert" SWORD FORMULA_0076 0 0.0 -80.0 360.0 READ_WRITE ECU_ADDRESS 0x3FBD58 /end MEASUREMENT
/begin MEASUREMENT can_v_rad_hr "Radgeschw. HR - Rohwert" SWORD FORMULA_0076 0 0.0 -80.0 360.0 READ_WRITE ECU_ADDRESS 0x3FBD5A /end MEASUREMENT
/begin MEASUREMENT can_v_rad_vl "Radgeschw. VL - Rohwert" SWORD FORMULA_0076 0 0.0 -80.0 360.0 READ_WRITE ECU_ADDRESS 0x3FBD54 /end MEASUREMENT
/begin MEASUREMENT can_v_rad_vr "Radgeschw. VR - Rohwert" SWORD FORMULA_0076 0 0.0 -80.0 360.0 READ_WRITE ECU_ADDRESS 0x3FBD56 /end MEASUREMENT
/begin MEASUREMENT can_v_tacho "Tachogeschwindigkeit - Rohwert" SWORD FORMULA_0076 0 0.0 -80.0 360.0 READ_WRITE ECU_ADDRESS 0x3FBD8C /end MEASUREMENT
/begin MEASUREMENT can_v_vorne "vVorne - Rohwert" SWORD FORMULA_0076 0 0.0 -80.0 360.0 READ_WRITE ECU_ADDRESS 0x3FBD52 /end MEASUREMENT
/begin MEASUREMENT can_vehmod_timeout "VehMode-Timeout" UBYTE FORMULA_0609 0 0.0 0.0 255.0 READ_WRITE ECU_ADDRESS 0x3FBD4A /end MEASUREMENT
/begin MEASUREMENT can_verz_st "Verzoegerungs-Status" UBYTE FORMULA_0608 0 0.0 0.0 255.0 READ_WRITE ECU_ADDRESS 0x3FBD40 /end MEASUREMENT
/begin MEASUREMENT Cbatt_lo "Nennkapazität Batterie, lokal" UBYTE FORMULA_0487 0 0.0 1.0 255.0 READ_WRITE ECU_ADDRESS 0x3FCBA6 /end MEASUREMENT
/begin MEASUREMENT Codiercnt "Internet Zaehler fuer Anfrage Codierung" UBYTE FORMULA_0461 0 0.0 0.0 25.5 READ_WRITE ECU_ADDRESS 0x3FCAEE /end MEASUREMENT
/begin MEASUREMENT Ctrcbr "Steuerung_Stromzweige" UBYTE FORMULA_0003 0 0.0 0.0 255.0 READ_WRITE ECU_ADDRESS 0x3FCB73 /end MEASUREMENT
/begin MEASUREMENT Ctrcbr7 "lokales ctrcbr" UBYTE FORMULA_0003 0 0.0 0.0 255.0 READ_WRITE ECU_ADDRESS 0x3FCB74 /end MEASUREMENT
/begin MEASUREMENT Ctrcbrmem "altes ctrbr" UBYTE FORMULA_0003 0 0.0 0.0 255.0 READ_WRITE ECU_ADDRESS 0x3FCB75 /end MEASUREMENT
/begin MEASUREMENT Ctrpcos "Steuerung_Standverbraucher" UBYTE FORMULA_0003 0 0.0 0.0 3.0 READ_WRITE ECU_ADDRESS 0x3FCB76 /end MEASUREMENT
/begin MEASUREMENT Ctrpcos7 "lokales ctrpcos" UBYTE FORMULA_0003 0 0.0 0.0 3.0 READ_WRITE ECU_ADDRESS 0x3FA97D /end MEASUREMENT
/begin MEASUREMENT Ctrpcosmem "altes ctrpcos" UBYTE FORMULA_0003 0 0.0 0.0 3.0 READ_WRITE ECU_ADDRESS 0x3FCB77 /end MEASUREMENT
/begin MEASUREMENT Ctrprio "Steuerung_Spitzenreduzierung_Priorität" UBYTE FORMULA_0003 0 0.0 0.0 7.0 READ_WRITE ECU_ADDRESS 0x3FCB78 /end MEASUREMENT
/begin MEASUREMENT Ctrprio7 "lokales ctrprio" UBYTE FORMULA_0003 0 0.0 0.0 7.0 READ_WRITE ECU_ADDRESS 0x3FCB79 /end MEASUREMENT
/begin MEASUREMENT Ctrpriocf "Steuerung_Spitzenreduzierung_Priorität_Komfort" UBYTE FORMULA_0003 0 0.0 0.0 7.0 READ_WRITE ECU_ADDRESS 0x3FCB7A /end MEASUREMENT
/begin MEASUREMENT Ctrpriocf7 "lokales ctrpriocf" UBYTE FORMULA_0003 0 0.0 0.0 7.0 READ_WRITE ECU_ADDRESS 0x3FCB7B /end MEASUREMENT
/begin MEASUREMENT Ctrpriocfm "altes ctrpriocf" UBYTE FORMULA_0003 0 0.0 0.0 7.0 READ_WRITE ECU_ADDRESS 0x3FCB7C /end MEASUREMENT
/begin MEASUREMENT Ctrpriomem "altes ctrprio" UBYTE FORMULA_0003 0 0.0 0.0 7.0 READ_WRITE ECU_ADDRESS 0x3FCB7D /end MEASUREMENT
/begin MEASUREMENT Ctrpwrcf "Komfort-Teil von ctrpwrcos" UWORD FORMULA_0010 0 0.0 0.0 65535.0 READ_WRITE ECU_ADDRESS 0x3FCB44 /end MEASUREMENT
/begin MEASUREMENT Ctrpwrcos "Steuerung_Leistung_Verbraucher" UWORD FORMULA_0010 0 0.0 0.0 65535.0 READ_WRITE ECU_ADDRESS 0x3FCB46 /end MEASUREMENT
/begin MEASUREMENT Ctrpwrcos7 "lokales ctrpwrcos" UWORD FORMULA_0010 0 0.0 0.0 65535.0 READ_WRITE ECU_ADDRESS 0x3FCB48 /end MEASUREMENT
/begin MEASUREMENT Ctrpwrdf "df-Teil von ctrpwrcos" UWORD FORMULA_0010 0 0.0 0.0 65535.0 READ_WRITE ECU_ADDRESS 0x3FCB4A /end MEASUREMENT
/begin MEASUREMENT Ctrpwrmem "altes ctrpwrcos" UWORD FORMULA_0010 0 0.0 0.0 65535.0 READ_WRITE ECU_ADDRESS 0x3FCB4C /end MEASUREMENT
/begin MEASUREMENT Ctrpwspcos "Steuerung_Leistung_Sonderverbraucher" UBYTE FORMULA_0510 0 0.0 0.0 127.5 READ_WRITE ECU_ADDRESS 0x3FCB7E /end MEASUREMENT
/begin MEASUREMENT D_qelad "Delta Kapazität entladen" UWORD FORMULA_0498 0 0.0 0.0 1192.750244140625 READ_WRITE ECU_ADDRESS 0x3FCB9C /end MEASUREMENT
/begin MEASUREMENT D_qlad "Delta Kapazität geladen" UWORD FORMULA_0498 0 0.0 0.0 1192.750244140625 READ_WRITE ECU_ADDRESS 0x3FCB9E /end MEASUREMENT
/begin MEASUREMENT D_soc "Abstand zur Startfähigkeitsgrenze" SWORD FORMULA_0479 0 0.0 -100.0 99.99690246582031 READ_WRITE ECU_ADDRESS 0x3FA994 /end MEASUREMENT
/begin MEASUREMENT D_socw "Delta SoC" SWORD FORMULA_0479 0 0.0 -100.0 99.99690246582031 READ_WRITE ECU_ADDRESS 0x3FCBB0 /end MEASUREMENT
/begin MEASUREMENT D_udtptc "Spannungsdifferenz in 10ms" SBYTE FORMULA_0490 0 0.0 -12.05760002136231 11.96339988708496 READ_WRITE ECU_ADDRESS 0x3FCB72 /end MEASUREMENT
/begin MEASUREMENT Df2pi "DF-Gewichtung auf Prios" SWORD FORMULA_0505 0 0.0 -100.0 100.0 READ_WRITE ECU_ADDRESS 0x3FCB1E /end MEASUREMENT
/begin MEASUREMENT Dfall2pi "Gesamtgewichtung auf Prios" SWORD FORMULA_0505 0 0.0 -500.0 500.0 READ_WRITE ECU_ADDRESS 0x3FCB20 /end MEASUREMENT
/begin MEASUREMENT Dfallpi "PI-Geregelte Gesamtgewichtung auf Prios" UWORD FORMULA_0507 0 0.0 0.0 450.0 READ_WRITE ECU_ADDRESS 0x3FCB4E /end MEASUREMENT
/begin MEASUREMENT Dff_filt7 "lokales dffgenflit" UBYTE FORMULA_0475 0 0.0 0.0 99.60929870605469 READ_WRITE ECU_ADDRESS 0x3FCB7F /end MEASUREMENT
/begin MEASUREMENT Dfgenfilt "Über PT-1 gefiltertes dffgen-Signal" UBYTE FORMULA_0475 0 0.0 0.0 99.60929870605469 READ_WRITE ECU_ADDRESS 0x3FCB80 /end MEASUREMENT
/begin MEASUREMENT Dfpi2ptc "Gewichtung der Prios -> Gewichtung für PTC Ansteuerung" SWORD FORMULA_0505 0 0.0 -100.0 100.0 READ_WRITE ECU_ADDRESS 0x3FCB22 /end MEASUREMENT
/begin MEASUREMENT Dfprio "" UWORD FORMULA_0507 0 0.0 0.0 450.0 READ_WRITE ECU_ADDRESS 0x3FCB50 /end MEASUREMENT
/begin MEASUREMENT Dfpt1_2ptc "gefiltertes dffgen Gewichtung auf PTC-Ansteuerung" SWORD FORMULA_0505 0 0.0 -100.0 100.0 READ_WRITE ECU_ADDRESS 0x3FCB24 /end MEASUREMENT
/begin MEASUREMENT Dfpt1filt "Wert nach DF-Tiefpass Prio" UBYTE FORMULA_0475 0 0.0 0.0 99.60929870605469 READ_WRITE ECU_ADDRESS 0x3FCB81 /end MEASUREMENT
/begin MEASUREMENT Dfpt1ptc "Wert nach DFFGEN-Filter PTC" UBYTE FORMULA_0475 0 0.0 0.0 99.60929870605469 READ_WRITE ECU_ADDRESS 0x3FCB82 /end MEASUREMENT
/begin MEASUREMENT Dqelad7 "diff = qelad-qeladold7" UWORD FORMULA_0491 0 0.0 0.0 19087.86328125 READ_WRITE ECU_ADDRESS 0x3FCAD6 /end MEASUREMENT
/begin MEASUREMENT Dqlad7 "diff = qlad-qladold7" UWORD FORMULA_0491 0 0.0 0.0 19087.86328125 READ_WRITE ECU_ADDRESS 0x3FCAD8 /end MEASUREMENT
/begin MEASUREMENT Dsoc2pi "Batterieladezustand-Gewichtung auf Prios" SWORD FORMULA_0505 0 0.0 -150.0 150.0 READ_WRITE ECU_ADDRESS 0x3FCB26 /end MEASUREMENT
/begin MEASUREMENT Dsoc2ptc "dsoc Gewichtung auf PTC-Ansteuerung" SWORD FORMULA_0505 0 0.0 -150.0 150.0 READ_WRITE ECU_ADDRESS 0x3FCB28 /end MEASUREMENT
/begin MEASUREMENT Dudtmul "PTC dudt : gewichtetes Dudt" SWORD FORMULA_0506 0 0.0 -48.23040008544922 48.22890090942383 READ_WRITE ECU_ADDRESS 0x3FCB2A /end MEASUREMENT
/begin MEASUREMENT F_dudtptc "Inkrement auf Ptc_pwr aufgrund du/dt" UWORD FORMULA_0507 0 0.0 0.0 550.0 READ_WRITE ECU_ADDRESS 0x3FCB52 /end MEASUREMENT
/begin MEASUREMENT Fak_ttansel "Ansaugluftfaktor E-Lüfterstrom" UWORD FORMULA_0484 0 0.0 0.0 511.9920959472656 READ_WRITE ECU_ADDRESS 0x3FA9B8 /end MEASUREMENT
/begin MEASUREMENT Fak_tubel "Faktor Lüfterstrom aus Geschwindigkeit" UWORD FORMULA_0484 0 0.0 0.0 511.9920959472656 READ_WRITE ECU_ADDRESS 0x3FA9BA /end MEASUREMENT
/begin MEASUREMENT Fs_pm "Fehlerspeicher Powermanagement, Bitcodiert" UBYTE FORMULA_0003 0 0.0 0.0 255.0 READ_WRITE ECU_ADDRESS 0x3FA95E /end MEASUREMENT
/begin MEASUREMENT Gen_dfvorhs "DF-Signal Vorhersage" UBYTE FORMULA_0475 0 0.0 0.0 99.60929870605469 READ_WRITE ECU_ADDRESS 0x3FA9CE /end MEASUREMENT
/begin MEASUREMENT I_craweng "Strombedarf Motor" SWORD FORMULA_0469 0 0.0 -10.0 254.0 READ_WRITE ECU_ADDRESS 0x3FBCD4 /end MEASUREMENT
/begin MEASUREMENT I_elu_vvt "Strom E-Lüfter und VVT-System" UWORD FORMULA_0485 0 0.0 0.0 4095.9375 READ_WRITE ECU_ADDRESS 0x3FA9BC /end MEASUREMENT
/begin MEASUREMENT I_eluefter "E-Lüfter Stromaufnahme" UWORD FORMULA_0485 0 0.0 0.0 4095.9375 READ_WRITE ECU_ADDRESS 0x3FA9BE /end MEASUREMENT
/begin MEASUREMENT I_elupwm "Lüfterstrom ohne Temperatur- und Geschwindigkeitseinfluss" UWORD FORMULA_0485 0 0.0 0.0 64.0 READ_WRITE ECU_ADDRESS 0x3FA9C0 /end MEASUREMENT
/begin MEASUREMENT I_eluvfzg "Lüfterstrom ohne Geschwindigkeitseinfluss" UWORD FORMULA_0485 0 0.0 0.0 128.0 READ_WRITE ECU_ADDRESS 0x3FA9C2 /end MEASUREMENT
/begin MEASUREMENT I_genrllrah "" UBYTE FORMULA_0463 0 0.0 0.0 255.0 READ_WRITE ECU_ADDRESS 0x3FA9CF /end MEASUREMENT
/begin MEASUREMENT I_gle "Glühstrom" UWORD FORMULA_0485 0 0.0 0.0 4095.9375 READ_WRITE ECU_ADDRESS 0x3FA9C4 /end MEASUREMENT
/begin MEASUREMENT I_sls "berechnete Groesse Strombedarf Sekundärluftpumpe" UWORD FORMULA_0485 0 0.0 0.0 255.0 READ_WRITE ECU_ADDRESS 0x3FA9C6 /end MEASUREMENT
/begin MEASUREMENT Ib_commcnt "Zähler Taskaufrufe zwischen periodischer Abfrage qlad und qelad" UBYTE FORMULA_0003 0 0.0 0.0 255.0 READ_WRITE ECU_ADDRESS 0x3FCBA7 /end MEASUREMENT
/begin MEASUREMENT Ib_commsta "Statemaschine zeiger zur Abfrage qlad und qelad" UBYTE FORMULA_0003 0 0.0 0.0 255.0 READ_WRITE ECU_ADDRESS 0x3FCBA8 /end MEASUREMENT
/begin MEASUREMENT Ibs1_errstat "" UWORD FORMULA_0010 0 0.0 0.0 65535.0 READ_WRITE ECU_ADDRESS 0x3FBE46 /end MEASUREMENT
/begin MEASUREMENT Ibs2_errstat "" UWORD FORMULA_0010 0 0.0 0.0 65535.0 READ_WRITE ECU_ADDRESS 0x3FBE48 /end MEASUREMENT
/begin MEASUREMENT Ibs3_errstat "" UWORD FORMULA_0010 0 0.0 0.0 65535.0 READ_WRITE ECU_ADDRESS 0x3FBE4A /end MEASUREMENT
/begin MEASUREMENT Ibsbor_hb "highbyte ibsborctr" UBYTE FORMULA_0003 0 0.0 0.0 255.0 READ_WRITE ECU_ADDRESS 0x3FCAEF /end MEASUREMENT
/begin MEASUREMENT Ibsderrs1 "Fehlerzähler IBS BSD Kommunikation" UBYTE FORMULA_0003 0 0.0 0.0 255.0 READ_WRITE ECU_ADDRESS 0x3F992C /end MEASUREMENT
/begin MEASUREMENT Ibsderrs2 "Fehlerzähler IBS EBSD Kommunikation" UWORD FORMULA_0010 0 0.0 0.0 65535.0 READ_WRITE ECU_ADDRESS 0x3F992A /end MEASUREMENT
/begin MEASUREMENT Ibspreco2 "Vorteiler /10 fuer Ibsderrs2" UBYTE FORMULA_0003 0 0.0 0.0 255.0 READ_WRITE ECU_ADDRESS 0x3F992D /end MEASUREMENT
/begin MEASUREMENT Ibtdiff "Delta Ibtsoll-Ibatt" UWORD FORMULA_0508 0 0.0 -200.0 5042.7998046875 READ_WRITE ECU_ADDRESS 0x3FCB54 /end MEASUREMENT
/begin MEASUREMENT Ibtdiff2pi "Batterie-soll-strom Gewichtung auf Prios" SWORD FORMULA_0505 0 0.0 -100.0 100.0 READ_WRITE ECU_ADDRESS 0x3FCB2C /end MEASUREMENT
/begin MEASUREMENT Ibtsoll "Sollstrom aufgrund von tbatt und dsoc" UWORD FORMULA_0508 0 0.0 -200.0 5042.7998046875 READ_WRITE ECU_ADDRESS 0x3FCB56 /end MEASUREMENT
/begin MEASUREMENT Ideltaabs "Differenz der Startströme" UWORD FORMULA_0515 0 0.0 1.999999955296516e-002 1310.699951171875 READ_WRITE ECU_ADDRESS 0x3FCBBC /end MEASUREMENT
/begin MEASUREMENT Idiff2ptc "idiff Gewichtung auf die PTC-Ansteuerung" SWORD FORMULA_0505 0 0.0 -100.0 100.0 READ_WRITE ECU_ADDRESS 0x3FCB2E /end MEASUREMENT
/begin MEASUREMENT Igenrest "Generatorreststrom modelliert" UBYTE FORMULA_0463 0 0.0 0.0 255.0 READ_WRITE ECU_ADDRESS 0x3FCB83 /end MEASUREMENT
/begin MEASUREMENT Ikurz_ogrz "Obere Grenze Kurzschlußstrom" UBYTE FORMULA_0495 0 0.0 0.0 2550.0 READ_WRITE ECU_ADDRESS 0x3FCAF0 /end MEASUREMENT
/begin MEASUREMENT Ikurz_ugrz "Untere Grenze Kurzschlußstrom" UBYTE FORMULA_0495 0 0.0 0.0 2550.0 READ_WRITE ECU_ADDRESS 0x3FCAF1 /end MEASUREMENT
/begin MEASUREMENT Ipmdfprio "lokale Prioberechnungsvariable bei IPM aktiv" UWORD FORMULA_0507 0 0.0 0.0 450.0 READ_WRITE ECU_ADDRESS 0x3FCB58 /end MEASUREMENT
/begin MEASUREMENT Isoc0loc "Batteriestrom zum Zeitpunkt der Ruhespannungsmessung (lokal)" SWORD FORMULA_0511 0 0.0 -655.3599853515625 655.3400268554688 READ_WRITE ECU_ADDRESS 0x3FCB98 /end MEASUREMENT
/begin MEASUREMENT Isolldiff "Differenz isoll - ibatt_w für PTC Ansteuerung" UWORD FORMULA_0508 0 0.0 -200.0 5042.7998046875 READ_WRITE ECU_ADDRESS 0x3FCB5A /end MEASUREMENT
/begin MEASUREMENT Iwakeupgrz "Ruhestromverletzungsgrenze, ab hier weckt u.U. das IBS." UBYTE FORMULA_0496 0 0.0 0.0 0.2549999952316284 READ_WRITE ECU_ADDRESS 0x3FCAF2 /end MEASUREMENT
/begin MEASUREMENT Kalevcnt "Anzahl der Ruhespannungsmessungen" UBYTE FORMULA_0003 0 0.0 0.0 255.0 READ_WRITE ECU_ADDRESS 0x3FCBA9 /end MEASUREMENT
/begin MEASUREMENT kbmcount "Counter, gesetzt von KBMCNT_APP" UBYTE FORMULA_0461 0 0.0 0.0 25.5 READ_WRITE ECU_ADDRESS 0x3FCB95 /end MEASUREMENT
/begin MEASUREMENT Memprio1 "memory 1 PI-Regler dfall2pi E60Prio" UWORD FORMULA_0484 0 0.0 0.0 511.9920959472656 READ_WRITE ECU_ADDRESS 0x3FCB5C /end MEASUREMENT
/begin MEASUREMENT Memprio2 "memory 2 PI-Regler dfall2pi E60Prio" UWORD FORMULA_0484 0 0.0 0.0 511.9920959472656 READ_WRITE ECU_ADDRESS 0x3FCB5E /end MEASUREMENT
/begin MEASUREMENT Memptc1 "memory 1 PI-Regler all2ptc PTC" UWORD FORMULA_0484 0 0.0 0.0 511.9920959472656 READ_WRITE ECU_ADDRESS 0x3FCB60 /end MEASUREMENT
/begin MEASUREMENT Memptc2 "memory 2 PI-Regler all2ptc PTC" UWORD FORMULA_0484 0 0.0 0.0 511.9920959472656 READ_WRITE ECU_ADDRESS 0x3FCB62 /end MEASUREMENT
/begin MEASUREMENT N_gsllm "" SWORD FORMULA_0006 0 0.0 0.0 32767.0 READ_WRITE ECU_ADDRESS 0x3FA9CC /end MEASUREMENT
/begin MEASUREMENT N_idlgspec "Anforderung LL-Anhebung" UBYTE FORMULA_0003 0 0.0 0.0 255.0 READ_WRITE ECU_ADDRESS 0x3FBCD7 /end MEASUREMENT
/begin MEASUREMENT N_idlibs "Leerlaufdrehzahlvorgabe von LC-Powermanagement" UBYTE FORMULA_0003 0 0.0 0.0 255.0 READ_WRITE ECU_ADDRESS 0x3FC5F6 /end MEASUREMENT
/begin MEASUREMENT Nnmstart "Motordrehzahl nach Motorstart" SWORD FORMULA_0006 0 0.0 -32768.0 32767.0 READ_WRITE ECU_ADDRESS 0x3FCBB8 /end MEASUREMENT
/begin MEASUREMENT Ospgcnt "fs_Oberspannungscounter" UBYTE FORMULA_0461 0 0.0 0.0 25.5 READ_WRITE ECU_ADDRESS 0x3FCAF3 /end MEASUREMENT
/begin MEASUREMENT Ospgprell "Anzahl der entprellten FS_Oberspannungserkennung" UBYTE FORMULA_0003 0 0.0 0.0 255.0 READ_WRITE ECU_ADDRESS 0x3FCAF4 /end MEASUREMENT
/begin MEASUREMENT Ospgstat "Status Oberspannungserkennung" UBYTE FORMULA_0003 0 0.0 0.0 255.0 READ_WRITE ECU_ADDRESS 0x3FCAF5 /end MEASUREMENT
/begin MEASUREMENT Pgen2ptc "Gewichtung der Generatorrestleistung für PTC-Ansteuerung" SWORD FORMULA_0505 0 0.0 -100.0 100.0 READ_WRITE ECU_ADDRESS 0x3FCB30 /end MEASUREMENT
/begin MEASUREMENT Pgenrest "Generatorrestleistung (igenrest*ubatt_w)" UWORD FORMULA_0507 0 0.0 0.0 6400.0 READ_WRITE ECU_ADDRESS 0x3FCB64 /end MEASUREMENT
/begin MEASUREMENT Picntr "Counter fuer PI-Reset" UBYTE FORMULA_0461 0 0.0 0.0 25.5 READ_WRITE ECU_ADDRESS 0x3FCB84 /end MEASUREMENT
/begin MEASUREMENT Pm_klemmstat "Umweltbed. Klemmenstatus" UBYTE FORMULA_0003 0 0.0 0.0 255.0 READ_WRITE ECU_ADDRESS 0x3FCAF6 /end MEASUREMENT
/begin MEASUREMENT Pm_tsrdy "Status Berechnung Tsaison" UBYTE FORMULA_0478 0 0.0 0.0 1.0 READ_WRITE ECU_ADDRESS 0x3FA9A2 /end MEASUREMENT
/begin MEASUREMENT Pmbscount "zyklisches Senden entspricht 5 sek" UBYTE FORMULA_0003 0 0.0 0.0 255.0 READ_WRITE ECU_ADDRESS 0x3FCB85 /end MEASUREMENT
/begin MEASUREMENT Pminfo1 "Infospeicher 1 vom Powermanagement" UWORD FORMULA_0010 0 0.0 0.0 65535.0 READ_WRITE ARRAY_SIZE 37 ECU_ADDRESS 0x3FA90E MATRIX_DIM 37 1 1 /end MEASUREMENT
/begin MEASUREMENT Pminfo2 "Fehlerinfo2 vom Powermanagement" UBYTE FORMULA_0003 0 0.0 0.0 255.0 READ_WRITE ARRAY_SIZE 29 ECU_ADDRESS 0x3FA95F MATRIX_DIM 29 1 1 /end MEASUREMENT
/begin MEASUREMENT Pmstartsta "Schalter für Ablaufsteuerung" UBYTE FORMULA_0003 0 0.0 0.0 255.0 READ_WRITE ECU_ADDRESS 0x3FCBC2 /end MEASUREMENT
/begin MEASUREMENT Pmvscount "Zähler bis zum nächsten zyklischen Senden von 3b3" UBYTE FORMULA_0003 0 0.0 0.0 255.0 READ_WRITE ECU_ADDRESS 0x3FCB86 /end MEASUREMENT
/begin MEASUREMENT Priopizw1 "Pi-Regler zw1" SLONG FORMULA_0504 0 0.0 -512.0 512.0 READ_WRITE ECU_ADDRESS 0x3FCB0C /end MEASUREMENT
/begin MEASUREMENT Priopizw2 "Pi-Regler zw2" SLONG FORMULA_0504 0 0.0 -512.0 512.0 READ_WRITE ECU_ADDRESS 0x3FCB10 /end MEASUREMENT
/begin MEASUREMENT psau_ad_b1 "Eingelesener Spannungswert fuer Saugrohrdruck" SWORD FORMULA_0114 0 0.0 0.0 1023.0 READ_WRITE ECU_ADDRESS 0x3FCBFE /end MEASUREMENT
/begin MEASUREMENT psau_ad_b2 "Eingelesener Spannungswert fuer Saugrohrdruck" SWORD FORMULA_0114 0 0.0 0.0 1023.0 READ_WRITE ECU_ADDRESS 0x3FCC00 /end MEASUREMENT
/begin MEASUREMENT psau_adapt_b1 "Adaptionswert zum PUMG, (pumg-psau)" SWORD FORMULA_0075 0 0.0 -200.0 200.0 READ_WRITE ECU_ADDRESS 0x3FCC16 /end MEASUREMENT
/begin MEASUREMENT psau_adapt_b2 "Adaptionswert zum PUMG, (pumg-psau)" SWORD FORMULA_0075 0 0.0 -200.0 200.0 READ_WRITE ECU_ADDRESS 0x3FCC18 /end MEASUREMENT
/begin MEASUREMENT psau_asp_b1 "psau asp" SWORD FORMULA_0075 0 0.0 0.0 2000.0 READ_WRITE ECU_ADDRESS 0x3FCC0E /end MEASUREMENT
/begin MEASUREMENT psau_asp_b2 "psau asp" SWORD FORMULA_0075 0 0.0 0.0 2000.0 READ_WRITE ECU_ADDRESS 0x3FCC10 /end MEASUREMENT
/begin MEASUREMENT psau_lls_b1 "LLS-Leistendruck" SWORD FORMULA_0075 0 0.0 0.0 2000.0 READ_WRITE ECU_ADDRESS 0x3FCC22 /end MEASUREMENT
/begin MEASUREMENT psau_lls_b2 "LLS-Leistendruck" SWORD FORMULA_0075 0 0.0 0.0 2000.0 READ_WRITE ECU_ADDRESS 0x3FCC24 /end MEASUREMENT
/begin MEASUREMENT psau_lls_mdl_b1 "Modellwert fuer LLS-Leistendruck" SWORD FORMULA_0075 0 0.0 0.0 2000.0 READ_WRITE ECU_ADDRESS 0x3FCC1E /end MEASUREMENT
/begin MEASUREMENT psau_lls_mdl_b2 "Modellwert fuer LLS-Leistendruck" SWORD FORMULA_0075 0 0.0 0.0 2000.0 READ_WRITE ECU_ADDRESS 0x3FCC20 /end MEASUREMENT
/begin MEASUREMENT psau_mzyl_b1 "psau mzyl" SWORD FORMULA_0075 0 0.0 0.0 2000.0 READ_WRITE ECU_ADDRESS 0x3FCC0A /end MEASUREMENT
/begin MEASUREMENT psau_mzyl_b2 "psau mzyl" SWORD FORMULA_0075 0 0.0 0.0 2000.0 READ_WRITE ECU_ADDRESS 0x3FCC0C /end MEASUREMENT
/begin MEASUREMENT psau_phy_b1 "Physikalischer Wert ohne Diagnose und ohne Filter fuer Saugrohrdruck" SWORD FORMULA_0075 0 0.0 0.0 2000.0 READ_WRITE ECU_ADDRESS 0x3FCC02 /end MEASUREMENT
/begin MEASUREMENT psau_phy_b2 "Physikalischer Wert ohne Diagnose und ohne Filter fuer Saugrohrdruck" SWORD FORMULA_0075 0 0.0 0.0 2000.0 READ_WRITE ECU_ADDRESS 0x3FCC04 /end MEASUREMENT
/begin MEASUREMENT psau_roh_b1 "Physikalischer Wert mit Diagnose jedoch ohne Filter fuer Saugrohrdruck" SWORD FORMULA_0075 0 0.0 0.0 2000.0 READ_WRITE ECU_ADDRESS 0x3FCC06 /end MEASUREMENT
/begin MEASUREMENT psau_roh_b2 "Physikalischer Wert mit Diagnose jedoch ohne Filter fuer Saugrohrdruck" SWORD FORMULA_0075 0 0.0 0.0 2000.0 READ_WRITE ECU_ADDRESS 0x3FCC08 /end MEASUREMENT
/begin MEASUREMENT psau_sr_mdl_b1 "Modellwert fuer Saugrohrdruck" SWORD FORMULA_0075 0 0.0 0.0 2000.0 READ_WRITE ECU_ADDRESS 0x3FCC1A /end MEASUREMENT
/begin MEASUREMENT psau_sr_mdl_b2 "Modellwert fuer Saugrohrdruck" SWORD FORMULA_0075 0 0.0 0.0 2000.0 READ_WRITE ECU_ADDRESS 0x3FCC1C /end MEASUREMENT
/begin MEASUREMENT psau_wf_b1 "psau wf" SWORD FORMULA_0075 0 0.0 0.0 2000.0 READ_WRITE ECU_ADDRESS 0x3FCC12 /end MEASUREMENT
/begin MEASUREMENT psau_wf_b2 "psau wf" SWORD FORMULA_0075 0 0.0 0.0 2000.0 READ_WRITE ECU_ADDRESS 0x3FCC14 /end MEASUREMENT
/begin MEASUREMENT psau_wf_ptr_b1 "Pointer in die Delay Queue fuer den WF" SWORD FORMULA_0075 0 0.0 0.0 2000.0 READ_WRITE ECU_ADDRESS 0x3FCC26 /end MEASUREMENT
/begin MEASUREMENT psau_wf_ptr_b2 "Pointer in die Delay Queue fuer den WF" SWORD FORMULA_0075 0 0.0 0.0 2000.0 READ_WRITE ECU_ADDRESS 0x3FCC28 /end MEASUREMENT
/begin MEASUREMENT Ptc_pwr "Maximale Leistung, die der PTC einstellen darf." UBYTE FORMULA_0510 0 0.0 0.0 127.5 READ_WRITE ECU_ADDRESS 0x3FCB87 /end MEASUREMENT
/begin MEASUREMENT Ptc_pwr7 "lokales ptc_pwr" UBYTE FORMULA_0510 0 0.0 0.0 127.5 READ_WRITE ECU_ADDRESS 0x3FCB88 /end MEASUREMENT
/begin MEASUREMENT Ptcadd "Wg. Spgeinbruch zu addierender PTC Faktor" UWORD FORMULA_0507 0 0.0 0.0 550.0 READ_WRITE ECU_ADDRESS 0x3FCB66 /end MEASUREMENT
/begin MEASUREMENT Ptcpizw1 "PTC PI Regler zw1" SLONG FORMULA_0504 0 0.0 -512.0 512.0 READ_WRITE ECU_ADDRESS 0x3FCB14 /end MEASUREMENT
/begin MEASUREMENT Ptcpizw2 "PTC PI zw2" SLONG FORMULA_0504 0 0.0 -512.0 512.0 READ_WRITE ECU_ADDRESS 0x3FCB18 /end MEASUREMENT
/begin MEASUREMENT Pwrspmem "altes ctrpwspcos" UBYTE FORMULA_0510 0 0.0 0.0 127.5 READ_WRITE ECU_ADDRESS 0x3FCB89 /end MEASUREMENT
/begin MEASUREMENT Q_bila "Kapazität Batterie (long)" ULONG FORMULA_0512 0 0.0 0.0 1193.0464 READ_WRITE ECU_ADDRESS 0x3FA984 /end MEASUREMENT
/begin MEASUREMENT Q_startfgk "Abstand zur Startfähigkeitsgrenze" UWORD FORMULA_0498 0 0.0 0.0 1192.750244140625 READ_WRITE ECU_ADDRESS 0x3FA99A /end MEASUREMENT
/begin MEASUREMENT qadc_check_ccw_adr "CCW Check Adresse des Fehlers" UBYTE FORMULA_0037 0 0.0 0.0 255.0 READ_WRITE ECU_ADDRESS 0x3FCC4E /end MEASUREMENT
/begin MEASUREMENT qadc_check_ccw_st "CCW Check Status" UBYTE FORMULA_0359 0 0.0 0.0 255.0 READ_WRITE ECU_ADDRESS 0x3FCC4C /end MEASUREMENT
/begin MEASUREMENT qadc_err_cnt "CCW Check Fehlerzaehler" UBYTE FORMULA_0037 0 0.0 0.0 255.0 READ_WRITE ECU_ADDRESS 0x3FCC4D /end MEASUREMENT
/begin MEASUREMENT qadc_hfm_ad "letzter im Segment erfasster AD-Wert" SWORD FORMULA_0114 0 0.0 0.0 1023.0 READ_WRITE ECU_ADDRESS 0x3FCC7C /end MEASUREMENT
/begin MEASUREMENT qadc_hfm_anz_read "Anzahl der HFM Samples in der Queue" UWORD FORMULA_1058 0 0.0 0.0 65535.0 READ_WRITE ECU_ADDRESS 0x3FCC76 /end MEASUREMENT
/begin MEASUREMENT qadc_hfm_cwp_alt "Conversion Pointer bei letzter Auswertung" SWORD FORMULA_0010 0 0.0 -32768.0 32767.0 READ_WRITE ECU_ADDRESS 0x3FCC58 /end MEASUREMENT
/begin MEASUREMENT qadc_hfm_last_samples "Letzten Werte bei der Auswertung" UWORD FORMULA_0010 0 0.0 0.0 65535.0 READ_WRITE ARRAY_SIZE 2 ECU_ADDRESS 0x3FCC50 MATRIX_DIM 2 1 1 /end MEASUREMENT
/begin MEASUREMENT qadc_hfm_no_sample_cnt "Zaehler wieoft die Qadc Auswertfunktion ohne Werte " UWORD FORMULA_0010 0 0.0 0.0 65535.0 READ_WRITE ECU_ADDRESS 0x3FCC72 /end MEASUREMENT
/begin MEASUREMENT qadc_hfm_ovr_error_cnt "HFM Overflow error in QADC queue" UWORD FORMULA_0010 0 0.0 0.0 65535.0 READ_WRITE ECU_ADDRESS 0x3FCC6E /end MEASUREMENT
/begin MEASUREMENT qadc_hfm_phy "letzter im Segment erfasster ML-Wert" SWORD FORMULA_0103 0 0.0 -100.0 1400.0 READ_WRITE ECU_ADDRESS 0x3FCC7E /end MEASUREMENT
/begin MEASUREMENT qadc_hfm_phy_fil "letzter im Segment erfasster und gefilterter ML-Wert" SWORD FORMULA_0103 0 0.0 -100.0 1400.0 READ_WRITE ECU_ADDRESS 0x3FCC80 /end MEASUREMENT
/begin MEASUREMENT qadc_hfm_seg_mw "ml-Mittelwert ueber 90°KW" SWORD FORMULA_0103 0 0.0 -100.0 1400.0 READ_WRITE ECU_ADDRESS 0x3FCC82 /end MEASUREMENT
/begin MEASUREMENT qadc_hfm_sync_cnt_error "Synchronistation Fehlerzaehler QADC zu HFM-Aufbereitung" UBYTE FORMULA_0003 0 0.0 0.0 255.0 READ_WRITE ECU_ADDRESS 0x3FCC79 /end MEASUREMENT
/begin MEASUREMENT qadc_lavk_anz_b1 "Anzahl der Aufaddierten AD-Werte" UWORD FORMULA_0010 0 0.0 0.0 65535.0 READ_WRITE ECU_ADDRESS 0x3FCC5E /end MEASUREMENT
/begin MEASUREMENT qadc_lavk_anz_b2 "Anzahl der Aufaddierten AD-Werte" UWORD FORMULA_0010 0 0.0 0.0 65535.0 READ_WRITE ECU_ADDRESS 0x3FCC60 /end MEASUREMENT
/begin MEASUREMENT qadc_lavk_anz_read "Anzahl der LAVK Samples in der Queue" UWORD FORMULA_0010 0 0.0 0.0 65535.0 READ_WRITE ECU_ADDRESS 0x3FCC6C /end MEASUREMENT
/begin MEASUREMENT qadc_lavk_cwp_alt "Conversion Pointer bei letzter Auswertung" SWORD FORMULA_0010 0 0.0 -32768.0 32767.0 READ_WRITE ECU_ADDRESS 0x3FCC5A /end MEASUREMENT
/begin MEASUREMENT qadc_lavk_last_samples "Letzten Werte bei der Auswertung" UWORD FORMULA_0010 0 0.0 0.0 65535.0 READ_WRITE ARRAY_SIZE 2 ECU_ADDRESS 0x3FCC54 MATRIX_DIM 2 1 1 /end MEASUREMENT
/begin MEASUREMENT qadc_lavk_no_sample_cnt "Zaehler wieoft die Qadc Auswertfunktion ohne Werte " UWORD FORMULA_0010 0 0.0 0.0 65535.0 READ_WRITE ECU_ADDRESS 0x3FCC74 /end MEASUREMENT
/begin MEASUREMENT qadc_lavk_ovr_error_cnt "HFM Overflow error in QADC queue" UWORD FORMULA_0010 0 0.0 0.0 65535.0 READ_WRITE ECU_ADDRESS 0x3FCC70 /end MEASUREMENT
/begin MEASUREMENT qadc_lavk_sum_b1 "Summe der AD-Werte" ULONG FORMULA_0000 0 0.0 0.0 4294967295.0 READ_WRITE ECU_ADDRESS 0x3FCC64 /end MEASUREMENT
/begin MEASUREMENT qadc_lavk_sum_b2 "Summe der AD-Werte" ULONG FORMULA_0000 0 0.0 0.0 4294967295.0 READ_WRITE ECU_ADDRESS 0x3FCC68 /end MEASUREMENT
/begin MEASUREMENT qadc_lavk_wrp "Write Pointer in der Qadc-Queue" UBYTE FORMULA_0003 0 0.0 0.0 255.0 READ_WRITE ECU_ADDRESS 0x3FCC5D /end MEASUREMENT
/begin MEASUREMENT qadc_lsv_h_st "Status Handshake fuer LSV_H Messung" UBYTE FORMULA_0037 0 0.0 0.0 255.0 READ_WRITE ECU_ADDRESS 0x3FCC78 /end MEASUREMENT
/begin MEASUREMENT qadc_sync_hfm_zz_upd "Zahnzaehler bei letztem sync queue update HFM" UBYTE FORMULA_1057 0 0.0 0.0 119.0 READ_WRITE ECU_ADDRESS 0x3FCC5C /end MEASUREMENT
/begin MEASUREMENT qadca_unerlaubter_irq "IRQ Error qadc (nicht erlaubter IRQ)" UBYTE FORMULA_0037 0 0.0 0.0 255.0 READ_WRITE ECU_ADDRESS 0x3FCC7A /end MEASUREMENT
/begin MEASUREMENT Qeladold "Kapazität Entladen vor Abstellen" UWORD FORMULA_0498 0 0.0 0.0 1192.750244140625 READ_WRITE ECU_ADDRESS 0x3FA988 /end MEASUREMENT
/begin MEASUREMENT Qeladold7 "zuletzt gesp. qelad" UWORD FORMULA_0498 0 0.0 0.0 1192.750244140625 READ_WRITE ECU_ADDRESS 0x3FA958 /end MEASUREMENT
/begin MEASUREMENT Qladold "Kapazität Getladen vor Abstellen" UWORD FORMULA_0498 0 0.0 0.0 1192.750244140625 READ_WRITE ECU_ADDRESS 0x3FA98A /end MEASUREMENT
/begin MEASUREMENT Qladold7 "zuletzt gesp. qlad" UWORD FORMULA_0498 0 0.0 0.0 1192.750244140625 READ_WRITE ECU_ADDRESS 0x3FA95A /end MEASUREMENT
/begin MEASUREMENT Qladzwsp7 "qlad uebertragspeicher" UWORD FORMULA_0010 0 0.0 0.0 65535.0 READ_WRITE ECU_ADDRESS 0x3FCADA /end MEASUREMENT
/begin MEASUREMENT ram_chk_freq "Ueberprufeungsfreuquenz RAM" UWORD FORMULA_0360 0 0.0 0.0 655.3499755859375 READ_WRITE ECU_ADDRESS 0x3FCC8C /end MEASUREMENT
/begin MEASUREMENT ram_chk_rptr "aktueller RAM_CHK Zeiger" ULONG FORMULA_0000 0 0.0 0.0 4294967295.0 READ_WRITE ECU_ADDRESS 0x3FCC88 /end MEASUREMENT
/begin MEASUREMENT rf_dyn_la_cnt "Zaehler fuer die LA Dynamik Erkennung" UWORD FORMULA_0080 0 0.0 0.0 65535.0 READ_WRITE ECU_ADDRESS 0x3FCCA0 /end MEASUREMENT
/begin MEASUREMENT rf_dyn_o2_cnt "Zaehler fuer die O2 Dynamik Erkennung" UWORD FORMULA_0080 0 0.0 0.0 65535.0 READ_WRITE ECU_ADDRESS 0x3FCCA2 /end MEASUREMENT
/begin MEASUREMENT rf_dyn_st "Statusbyte fuer rf Dynamik" UBYTE FORMULA_0037 0 0.0 0.0 255.0 READ_WRITE ECU_ADDRESS 0x3FCCA4 /end MEASUREMENT
/begin MEASUREMENT rf_dyn_st_fplau "Statusbyte fuer rf Dynamik" UBYTE FORMULA_1061 0 0 0.0 255.0 READ_WRITE BIT_MASK 0x2 ECU_ADDRESS 0x3FCCA4 /end MEASUREMENT
/begin MEASUREMENT rf_dyn_st_la "Statusbyte fuer rf Dynamik" UBYTE FORMULA_1064 0 0 0.0 255.0 READ_WRITE BIT_MASK 0x10 ECU_ADDRESS 0x3FCCA4 /end MEASUREMENT
/begin MEASUREMENT rf_dyn_st_la_trim "Statusbyte fuer rf Dynamik" UBYTE FORMULA_1062 0 0 0.0 255.0 READ_WRITE BIT_MASK 0x4 ECU_ADDRESS 0x3FCCA4 /end MEASUREMENT
/begin MEASUREMENT rf_dyn_st_o2 "Statusbyte fuer rf Dynamik" UBYTE FORMULA_1063 0 0 0.0 255.0 READ_WRITE BIT_MASK 0x8 ECU_ADDRESS 0x3FCCA4 /end MEASUREMENT
/begin MEASUREMENT rf_dyn_st_te "Statusbyte fuer rf Dynamik" UBYTE FORMULA_1060 0 0 0.0 255.0 READ_WRITE BIT_MASK 0x1 ECU_ADDRESS 0x3FCCA4 /end MEASUREMENT
/begin MEASUREMENT rf_e2_abw_b1 "Abweichung RF-Ebene2 in Prozent" SWORD FORMULA_0022 0 0.0 0.0 200.0 READ_WRITE ECU_ADDRESS 0x3FD5F8 /end MEASUREMENT
/begin MEASUREMENT rf_e2_abw_b2 "Abweichung RF-Ebene2 in Prozent" SWORD FORMULA_0022 0 0.0 0.0 200.0 READ_WRITE ECU_ADDRESS 0x3FD5FA /end MEASUREMENT
/begin MEASUREMENT rf_e2_berech "relative Fuellung aus Ebene 2" SWORD FORMULA_0007 0 0.0 0.0 2.0 READ_WRITE ARRAY_SIZE 2 ECU_ADDRESS 0x3FD5FC MATRIX_DIM 2 1 1 /end MEASUREMENT
/begin MEASUREMENT rf_e2_dyn "PT1 gefilterter Wert fuer dir rf Dynamik Erkennung" SWORD FORMULA_0007 0 0.0 0.0 2.0 READ_WRITE ECU_ADDRESS 0x3FD606 /end MEASUREMENT
/begin MEASUREMENT rf_e2_dyn_delta "Delta gefiltert zum ungefiltertem" SWORD FORMULA_0187 0 0.0 -200.0 200.0 READ_WRITE ECU_ADDRESS 0x3FD608 /end MEASUREMENT
/begin MEASUREMENT rf_e2_dyn_st "Statusbyte fuer rf Dynamik" UBYTE FORMULA_1068 0 0 0.0 255.0 READ_WRITE BIT_MASK 0x1 ECU_ADDRESS 0x3FD604 /end MEASUREMENT
/begin MEASUREMENT rf_e2_ml_b1 "Luftmassenstrom aus HFM Ebene2" SWORD FORMULA_0103 0 0.0 -100.0 1400.0 READ_WRITE ECU_ADDRESS 0x3FD5F4 /end MEASUREMENT
/begin MEASUREMENT rf_e2_ml_b2 "Luftmassenstrom aus HFM Ebene2" SWORD FORMULA_0103 0 0.0 -100.0 1400.0 READ_WRITE ECU_ADDRESS 0x3FD5F6 /end MEASUREMENT
/begin MEASUREMENT rf_e2_t_b1 "Fehlerzeit rf fuer Ebene 2." UWORD FORMULA_0021 0 0.0 0.0 655.0 READ_WRITE ECU_ADDRESS 0x3FD600 /end MEASUREMENT
/begin MEASUREMENT rf_e2_t_b2 "Fehlerzeit rf fuer Ebene 2." UWORD FORMULA_0021 0 0.0 0.0 655.0 READ_WRITE ECU_ADDRESS 0x3FD602 /end MEASUREMENT
/begin MEASUREMENT rf_st_ll_ramp "Segmentzaehler fuer die rf Rampe von Start auf LL" UBYTE FORMULA_1059 0 0.0 0.0 127.5 READ_WRITE ECU_ADDRESS 0x3FCC9E /end MEASUREMENT
/begin MEASUREMENT rg_b1.a_mean_ues "Mittl. AV-querschnitt nach LOT" UWORD FORMULA_0984 0 0.0 0.0 15.0 READ_WRITE ECU_ADDRESS 0x3FCCBC /end MEASUREMENT
/begin MEASUREMENT rg_b1.e_mean_ues "Mittl. EV-querschnitt nach LOT" UWORD FORMULA_0984 0 0.0 0.0 15.0 READ_WRITE ECU_ADDRESS 0x3FCCBE /end MEASUREMENT
/begin MEASUREMENT rg_b1.gas_zustand "Faktor fuer Gaszustand RG" UWORD FORMULA_0010 0 0.0 0.0 65535.0 READ_WRITE ECU_ADDRESS 0x3FCCC4 /end MEASUREMENT
/begin MEASUREMENT rg_b1.m_av "RG-Masse ueber AV nach LOT" SWORD FORMULA_0104 0 0.0 -500.0 1500.0 READ_WRITE ECU_ADDRESS 0x3FCCB0 /end MEASUREMENT
/begin MEASUREMENT rg_b1.m_ev "RG-Masse ueber EV vor LOT" SWORD FORMULA_0104 0 0.0 -500.0 1500.0 READ_WRITE ECU_ADDRESS 0x3FCCB2 /end MEASUREMENT
/begin MEASUREMENT rg_b1.m_mod "Restgasmasse Moduliert" SWORD FORMULA_0104 0 0.0 -500.0 1500.0 READ_WRITE ECU_ADDRESS 0x3FCCAC /end MEASUREMENT
/begin MEASUREMENT rg_b1.m_stat "RG-Masse stationaer aus KF" SWORD FORMULA_0104 0 0.0 -500.0 1500.0 READ_WRITE ECU_ADDRESS 0x3FCCCE /end MEASUREMENT
/begin MEASUREMENT rg_b1.m_tot "Restgasmasse im Totvolumen" SWORD FORMULA_0104 0 0.0 -500.0 1500.0 READ_WRITE ECU_ADDRESS 0x3FCCAE /end MEASUREMENT
/begin MEASUREMENT rg_b1.mdt_av "Restgasmassenstrom durch AV" SWORD FORMULA_0103 0 0.0 -100.0 1400.0 READ_WRITE ECU_ADDRESS 0x3FCCC8 /end MEASUREMENT
/begin MEASUREMENT rg_b1.mdt_ev "Restgasmassenstrom durch EV" SWORD FORMULA_0103 0 0.0 -100.0 1400.0 READ_WRITE ECU_ADDRESS 0x3FCCCA /end MEASUREMENT
/begin MEASUREMENT rg_b1.pabg "Abgasgegendruck fuer das Restgasmodell" SWORD FORMULA_0075 0 0.0 0.0 2000.0 READ_WRITE ECU_ADDRESS 0x3FCCD4 /end MEASUREMENT
/begin MEASUREMENT rg_b1.phi_av_mean "Durchflussbeiwert fuer AV" SWORD FORMULA_0558 0 0.0 -9.999999747378752e-005 1.0 READ_WRITE ECU_ADDRESS 0x3FCCC0 /end MEASUREMENT
/begin MEASUREMENT rg_b1.phi_ev_mean "Durchflussbeiwert fuer EV" SWORD FORMULA_0558 0 0.0 -9.999999747378752e-005 1.0 READ_WRITE ECU_ADDRESS 0x3FCCC2 /end MEASUREMENT
/begin MEASUREMENT rg_b1.prgvo "Druck-Offset aus der Ventilueberschneidung" SWORD FORMULA_0075 0 0.0 0.0 2000.0 READ_WRITE ECU_ADDRESS 0x3FCCD0 /end MEASUREMENT
/begin MEASUREMENT rg_b1.psau "Saugrohrduck aus Druck ASP und Offset" SWORD FORMULA_0075 0 0.0 0.0 2000.0 READ_WRITE ECU_ADDRESS 0x3FCCD2 /end MEASUREMENT
/begin MEASUREMENT rg_b1.pzyl "pabg fuer das Restgasmodell" SWORD FORMULA_0075 0 0.0 0.0 2000.0 READ_WRITE ECU_ADDRESS 0x3FCCD6 /end MEASUREMENT
/begin MEASUREMENT rg_b1.rho "Dichte vom RG" SWORD FORMULA_1069 0 0.0 -8.0 7.99970006942749 READ_WRITE ECU_ADDRESS 0x3FCCC6 /end MEASUREMENT
/begin MEASUREMENT rg_b1.sa_ctr "Counter fuer die SA Ab/-Aufregelung" UBYTE FORMULA_1070 0 0.0 0.0 255.0 READ_WRITE ECU_ADDRESS 0x3FCCD8 /end MEASUREMENT
/begin MEASUREMENT rg_b1.t_ues_av "Ueberschneidungszeit vom AV" UWORD FORMULA_0985 0 0.0 0.0 40.0 READ_WRITE ECU_ADDRESS 0x3FCCB4 /end MEASUREMENT
/begin MEASUREMENT rg_b1.t_ues_ev "Ueberschneidungszeit vom EV" UWORD FORMULA_0985 0 0.0 0.0 40.0 READ_WRITE ECU_ADDRESS 0x3FCCB6 /end MEASUREMENT
/begin MEASUREMENT rg_b1.w_ues_av "Ueberschneidungswinkel vom AV" SWORD FORMULA_0102 0 0.0 50.0 160.0 READ_WRITE ECU_ADDRESS 0x3FCCB8 /end MEASUREMENT
/begin MEASUREMENT rg_b1.w_ues_ev "Ueberschneidungswinkel vom EV" SWORD FORMULA_0102 0 0.0 50.0 160.0 READ_WRITE ECU_ADDRESS 0x3FCCBA /end MEASUREMENT
/begin MEASUREMENT rg_b1.x_stat "RG-Gehalt stationaer aus KF" SWORD FORMULA_0100 0 0.0 -0.5 0.5 READ_WRITE ECU_ADDRESS 0x3FCCCC /end MEASUREMENT
/begin MEASUREMENT rg_b2.a_mean_ues "Mittl. AV-querschnitt nach LOT" UWORD FORMULA_0984 0 0.0 0.0 15.0 READ_WRITE ECU_ADDRESS 0x3FCCEA /end MEASUREMENT
/begin MEASUREMENT rg_b2.e_mean_ues "Mittl. EV-querschnitt nach LOT" UWORD FORMULA_0984 0 0.0 0.0 15.0 READ_WRITE ECU_ADDRESS 0x3FCCEC /end MEASUREMENT
/begin MEASUREMENT rg_b2.gas_zustand "Faktor fuer Gaszustand RG" UWORD FORMULA_0010 0 0.0 0.0 65535.0 READ_WRITE ECU_ADDRESS 0x3FCCF2 /end MEASUREMENT
/begin MEASUREMENT rg_b2.m_av "RG-Masse ueber AV nach LOT" SWORD FORMULA_0104 0 0.0 -500.0 1500.0 READ_WRITE ECU_ADDRESS 0x3FCCDE /end MEASUREMENT
/begin MEASUREMENT rg_b2.m_ev "RG-Masse ueber EV vor LOT" SWORD FORMULA_0104 0 0.0 -500.0 1500.0 READ_WRITE ECU_ADDRESS 0x3FCCE0 /end MEASUREMENT
/begin MEASUREMENT rg_b2.m_mod "Restgasmasse Moduliert" SWORD FORMULA_0104 0 0.0 -500.0 1500.0 READ_WRITE ECU_ADDRESS 0x3FCCDA /end MEASUREMENT
/begin MEASUREMENT rg_b2.m_stat "RG-Masse stationaer aus KF" SWORD FORMULA_0104 0 0.0 -500.0 1500.0 READ_WRITE ECU_ADDRESS 0x3FCCFC /end MEASUREMENT
/begin MEASUREMENT rg_b2.m_tot "Restgasmasse im Totvolumen" SWORD FORMULA_0104 0 0.0 -500.0 1500.0 READ_WRITE ECU_ADDRESS 0x3FCCDC /end MEASUREMENT
/begin MEASUREMENT rg_b2.mdt_av "Restgasmassenstrom durch AV" SWORD FORMULA_0103 0 0.0 -100.0 1400.0 READ_WRITE ECU_ADDRESS 0x3FCCF6 /end MEASUREMENT
/begin MEASUREMENT rg_b2.mdt_ev "Restgasmassenstrom durch EV" SWORD FORMULA_0103 0 0.0 -100.0 1400.0 READ_WRITE ECU_ADDRESS 0x3FCCF8 /end MEASUREMENT
/begin MEASUREMENT rg_b2.pabg "Abgasgegendruck fuer das Restgasmodell" SWORD FORMULA_0075 0 0.0 0.0 2000.0 READ_WRITE ECU_ADDRESS 0x3FCD02 /end MEASUREMENT
/begin MEASUREMENT rg_b2.phi_av_mean "Durchflussbeiwert fuer AV" SWORD FORMULA_0558 0 0.0 -9.999999747378752e-005 1.0 READ_WRITE ECU_ADDRESS 0x3FCCEE /end MEASUREMENT
/begin MEASUREMENT rg_b2.phi_ev_mean "Durchflussbeiwert fuer EV" SWORD FORMULA_0558 0 0.0 -9.999999747378752e-005 1.0 READ_WRITE ECU_ADDRESS 0x3FCCF0 /end MEASUREMENT
/begin MEASUREMENT rg_b2.prgvo "Druck-Offset aus der Ventilueberschneidung" SWORD FORMULA_0075 0 0.0 0.0 2000.0 READ_WRITE ECU_ADDRESS 0x3FCCFE /end MEASUREMENT
/begin MEASUREMENT rg_b2.psau "Saugrohrduck aus Druck ASP und Offset" SWORD FORMULA_0075 0 0.0 0.0 2000.0 READ_WRITE ECU_ADDRESS 0x3FCD00 /end MEASUREMENT
/begin MEASUREMENT rg_b2.pzyl "pabg fuer das Restgasmodell" SWORD FORMULA_0075 0 0.0 0.0 2000.0 READ_WRITE ECU_ADDRESS 0x3FCD04 /end MEASUREMENT
/begin MEASUREMENT rg_b2.rho "Dichte vom RG" SWORD FORMULA_1069 0 0.0 -8.0 7.99970006942749 READ_WRITE ECU_ADDRESS 0x3FCCF4 /end MEASUREMENT
/begin MEASUREMENT rg_b2.sa_ctr "Counter fuer die SA Ab/-Aufregelung" UBYTE FORMULA_1070 0 0.0 0.0 255.0 READ_WRITE ECU_ADDRESS 0x3FCD06 /end MEASUREMENT
/begin MEASUREMENT rg_b2.t_ues_av "Ueberschneidungszeit vom AV" UWORD FORMULA_0985 0 0.0 0.0 40.0 READ_WRITE ECU_ADDRESS 0x3FCCE2 /end MEASUREMENT
/begin MEASUREMENT rg_b2.t_ues_ev "Ueberschneidungszeit vom EV" UWORD FORMULA_0985 0 0.0 0.0 40.0 READ_WRITE ECU_ADDRESS 0x3FCCE4 /end MEASUREMENT
/begin MEASUREMENT rg_b2.w_ues_av "Ueberschneidungswinkel vom AV" SWORD FORMULA_0102 0 0.0 50.0 160.0 READ_WRITE ECU_ADDRESS 0x3FCCE6 /end MEASUREMENT
/begin MEASUREMENT rg_b2.w_ues_ev "Ueberschneidungswinkel vom EV" SWORD FORMULA_0102 0 0.0 50.0 160.0 READ_WRITE ECU_ADDRESS 0x3FCCE8 /end MEASUREMENT
/begin MEASUREMENT rg_b2.x_stat "RG-Gehalt stationaer aus KF" SWORD FORMULA_0100 0 0.0 -0.5 0.5 READ_WRITE ECU_ADDRESS 0x3FCCFA /end MEASUREMENT
/begin MEASUREMENT Rin_grenzh "Batt.Innenwiderstand Grenze" UBYTE FORMULA_0458 0 0.0 0.0 31.875 READ_WRITE ECU_ADDRESS 0x3FCBC3 /end MEASUREMENT
/begin MEASUREMENT Rin_start "Innenwiderstand Batterie beim Start" UBYTE FORMULA_0458 0 0.0 0.0 31.875 READ_WRITE ECU_ADDRESS 0x3FCBC4 /end MEASUREMENT
/begin MEASUREMENT rps_laa_f "RPS-Faktor-Lambdaadaption" UWORD FORMULA_0024 0 0.0 0.0 1.998999953269959 READ_WRITE ARRAY_SIZE 2 ECU_ADDRESS 0x3FCD38 MATRIX_DIM 2 1 1 /end MEASUREMENT
/begin MEASUREMENT rps_laa_offs "RPS-Offset-Lambdaadaption" SWORD FORMULA_0535 0 0.0 -512.0 511.0 READ_WRITE ARRAY_SIZE 2 ECU_ADDRESS 0x3FCD3C MATRIX_DIM 2 1 1 /end MEASUREMENT
/begin MEASUREMENT rps_laa_st "RPS-LA-Adaption-Status" UWORD FORMULA_1074 0 0.0 0.0 65535.0 READ_WRITE BIT_MASK 0x1F ARRAY_SIZE 2 ECU_ADDRESS 0x3FCD34 MATRIX_DIM 2 1 1 /end MEASUREMENT
/begin MEASUREMENT rps_lam_delta_lim "RPS-begrenzte Regelabweichung" SWORD FORMULA_0025 0 0.0 -2.0 1.999899983406067 READ_WRITE ARRAY_SIZE 2 ECU_ADDRESS 0x3FCD30 MATRIX_DIM 2 1 1 /end MEASUREMENT
/begin MEASUREMENT rps_lam_reg_f "RPS-Regeleingriff" UWORD FORMULA_0024 0 0.0 0.0 1.998999953269959 READ_WRITE ARRAY_SIZE 2 ECU_ADDRESS 0x3FCD2C MATRIX_DIM 2 1 1 /end MEASUREMENT
/begin MEASUREMENT rps_lam_reg_st "RPS-LA-Regler-Status" UWORD FORMULA_1073 0 0.0 0.0 65535.0 READ_WRITE BIT_MASK 0x7 ARRAY_SIZE 2 ECU_ADDRESS 0x3FCD28 MATRIX_DIM 2 1 1 /end MEASUREMENT
/begin MEASUREMENT rps_lam_soll_offs "RPS-Solllambda" SWORD FORMULA_0025 0 0.0 -0.5 0.5 READ_WRITE ARRAY_SIZE 2 ECU_ADDRESS 0x3FCD9C MATRIX_DIM 2 1 1 /end MEASUREMENT
/begin MEASUREMENT rps_pks_st "RPS-PKS-Status" UBYTE FORMULA_1075 0 0.0 0.0 255.0 READ_WRITE ECU_ADDRESS 0x3FCD4C /end MEASUREMENT
/begin MEASUREMENT rps_rg_1of2_.m_av "RPS-RG über Auslass" SWORD FORMULA_0100 0 0.0 -0.5 0.5 READ_WRITE ECU_ADDRESS 0x3FCD4E /end MEASUREMENT
/begin MEASUREMENT rps_rg_1of2_.m_ev "RPS-RG über Einlass" SWORD FORMULA_0100 0 0.0 -0.5 0.5 READ_WRITE ECU_ADDRESS 0x3FCD56 /end MEASUREMENT
/begin MEASUREMENT rps_rg_1of2_.m_mod "RPS-RG gesamt" SWORD FORMULA_0100 0 0.0 -0.5 0.5 READ_WRITE ECU_ADDRESS 0x3FCD52 /end MEASUREMENT
/begin MEASUREMENT rps_rg_1of2_.m_tot "RPS-RG im Totvolumen" SWORD FORMULA_0100 0 0.0 -0.5 0.5 READ_WRITE ECU_ADDRESS 0x3FCD50 /end MEASUREMENT
/begin MEASUREMENT rps_rg_1of2_.mdt_av "RPS-RGstrom über Auslass" SWORD FORMULA_0103 0 0.0 -100.0 1400.0 READ_WRITE ECU_ADDRESS 0x3FCD58 /end MEASUREMENT
/begin MEASUREMENT rps_rg_1of2_.myzl_ges_psau "RPS-mzyl aus psau" SWORD FORMULA_0104 0 0.0 -500.0 1500.0 READ_WRITE ECU_ADDRESS 0x3FCD54 /end MEASUREMENT
/begin MEASUREMENT rps_rg_2of2_.m_av "RPS-RG über Auslass" SWORD FORMULA_0100 0 0.0 -0.5 0.5 READ_WRITE ECU_ADDRESS 0x3FCD5A /end MEASUREMENT
/begin MEASUREMENT rps_rg_2of2_.m_ev "RPS-RG über Einlass" SWORD FORMULA_0100 0 0.0 -0.5 0.5 READ_WRITE ECU_ADDRESS 0x3FCD62 /end MEASUREMENT
/begin MEASUREMENT rps_rg_2of2_.m_mod "RPS-RG gesamt" SWORD FORMULA_0100 0 0.0 -0.5 0.5 READ_WRITE ECU_ADDRESS 0x3FCD5E /end MEASUREMENT
/begin MEASUREMENT rps_rg_2of2_.m_tot "RPS-RG im Totvolumen" SWORD FORMULA_0100 0 0.0 -0.5 0.5 READ_WRITE ECU_ADDRESS 0x3FCD5C /end MEASUREMENT
/begin MEASUREMENT rps_rg_2of2_.mdt_av "RPS-RGstrom über Auslass" SWORD FORMULA_0103 0 0.0 -100.0 1400.0 READ_WRITE ECU_ADDRESS 0x3FCD64 /end MEASUREMENT
/begin MEASUREMENT rps_rg_2of2_.myzl_ges_psau "RPS-mzyl aus psau" SWORD FORMULA_0104 0 0.0 -500.0 1500.0 READ_WRITE ECU_ADDRESS 0x3FCD60 /end MEASUREMENT
/begin MEASUREMENT rps_tan "tan-RPS" SWORD FORMULA_0023 0 0.0 -50.0 170.0 READ_WRITE ECU_ADDRESS 0x3FCD10 /end MEASUREMENT
/begin MEASUREMENT rps_tan_zust "Status tan-RPS" UBYTE FORMULA_0003 0 0.0 0.0 255.0 READ_WRITE ECU_ADDRESS 0x3FCD0E /end MEASUREMENT
/begin MEASUREMENT rps_te_st "RPS-TE Status" UWORD FORMULA_0010 0 0.0 0.0 65535.0 READ_WRITE ECU_ADDRESS 0x3FCD90 /end MEASUREMENT
/begin MEASUREMENT rps_tetv_freq "RPS-TE Frequenz Ventil" UWORD FORMULA_1076 0 0.0 10.0 50.0 READ_WRITE ECU_ADDRESS 0x3FCD92 /end MEASUREMENT
/begin MEASUREMENT rps_tetv_mks_zyl "RPS-TE Kraftstoffmasse" SWORD FORMULA_0111 0 0.0 -512.0 511.0 READ_WRITE ARRAY_SIZE 2 ECU_ADDRESS 0x3FCD94 MATRIX_DIM 2 1 1 /end MEASUREMENT
/begin MEASUREMENT rps_tetv_soll "RPS-TE Kraftstoffmasse" UWORD FORMULA_0107 0 0.0 0.0 100.0 READ_WRITE ARRAY_SIZE 2 ECU_ADDRESS 0x3FCD98 MATRIX_DIM 2 1 1 /end MEASUREMENT
/begin MEASUREMENT rps_tmot "RPS-Motortemperatur" SWORD FORMULA_0023 0 0.0 -50.0 170.0 READ_WRITE ECU_ADDRESS 0x3FCD4A /end MEASUREMENT
/begin MEASUREMENT rps_van_kh_st "RPS-Status Vanoskath" UWORD FORMULA_0010 0 0.0 0.0 65535.0 READ_WRITE ECU_ADDRESS 0x3FCD40 /end MEASUREMENT
/begin MEASUREMENT rps_van_soll_kh_off "RPS-Vanosoffset KH" SWORD FORMULA_0102 0 0.0 50.0 160.0 READ_WRITE ARRAY_SIZE 4 ECU_ADDRESS 0x3FCD42 MATRIX_DIM 4 1 1 /end MEASUREMENT
/begin MEASUREMENT rps_wf_mks "RPS-MKS aus Wandfilmmodell" SWORD FORMULA_0111 0 0.0 -512.0 511.0 READ_WRITE ARRAY_SIZE 10 ECU_ADDRESS 0x3FCD12 MATRIX_DIM 10 1 1 /end MEASUREMENT
/begin MEASUREMENT rps_wf_st "RPS-WF-Aktiv-Status" UWORD FORMULA_0080 0 0.0 0.0 65535.0 READ_WRITE ECU_ADDRESS 0x3FCD26 /end MEASUREMENT
/begin MEASUREMENT rps_zgla_f_zyl "RPS-ZGLA Faktor" UWORD FORMULA_0024 0 0.0 0.0 1.999899983406067 READ_WRITE ARRAY_SIZE 10 ECU_ADDRESS 0x3FCD66 MATRIX_DIM 10 1 1 /end MEASUREMENT
/begin MEASUREMENT rps_zgla_offs_zyl "RPS-ZGLA Offset" SWORD FORMULA_0535 0 0.0 -512.0 511.0 READ_WRITE ARRAY_SIZE 10 ECU_ADDRESS 0x3FCD7C MATRIX_DIM 10 1 1 /end MEASUREMENT
/begin MEASUREMENT rps_zgla_st "RPS-ZGLA Status" UWORD FORMULA_0010 0 0.0 0.0 65535.0 READ_WRITE ECU_ADDRESS 0x3FCD7A /end MEASUREMENT
/begin MEASUREMENT rps_zust_allg "Allg. Zustand" UBYTE FORMULA_0003 0 0.0 0.0 255.0 READ_WRITE ARRAY_SIZE 2 ECU_ADDRESS 0x3FCD0C MATRIX_DIM 2 1 1 /end MEASUREMENT
/begin MEASUREMENT Rqpcos "Anforderung_Standverbraucher" UBYTE FORMULA_0003 0 0.0 0.0 3.0 READ_WRITE ECU_ADDRESS 0x3FCB8A /end MEASUREMENT
/begin MEASUREMENT Rqpcos7 "lokales rqpcos" UBYTE FORMULA_0003 0 0.0 0.0 3.0 READ_WRITE ECU_ADDRESS 0x3FCB8B /end MEASUREMENT
/begin MEASUREMENT Rqpcosmem "altes rqpcos" UBYTE FORMULA_0003 0 0.0 0.0 3.0 READ_WRITE ECU_ADDRESS 0x3FCB8C /end MEASUREMENT
/begin MEASUREMENT sa_msr_t_sperre "MSR Sperrzeit fuer SA" UWORD FORMULA_0109 0 0.0 0.0 325.0 READ_WRITE ECU_ADDRESS 0x3FCDCC /end MEASUREMENT
/begin MEASUREMENT sa_n "Drehzahlschwelle fuer Schubabschalten" SWORD FORMULA_0006 0 0.0 0.0 10000.0 READ_WRITE ECU_ADDRESS 0x3FCDC6 /end MEASUREMENT
/begin MEASUREMENT sa_t_sa_trig "Verweilzeit im Zustand SA-Trigger" UWORD FORMULA_0109 0 0.0 0.0 325.0 READ_WRITE ECU_ADDRESS 0x3FCDC8 /end MEASUREMENT
/begin MEASUREMENT sa_t_sa_trig_max "Maximale Verweilzeit im Zustand SA-Trigger" UWORD FORMULA_0109 0 0.0 0.0 325.0 READ_WRITE ECU_ADDRESS 0x3FCDCA /end MEASUREMENT
/begin MEASUREMENT Selspcos "Auswahl_Sonderverbraucher" UBYTE FORMULA_0003 0 0.0 0.0 15.0 READ_WRITE ECU_ADDRESS 0x3FCB8D /end MEASUREMENT
/begin MEASUREMENT Selspcosme "altes selspcos" UBYTE FORMULA_0003 0 0.0 0.0 15.0 READ_WRITE ECU_ADDRESS 0x3FCB8E /end MEASUREMENT
/begin MEASUREMENT Soc_b_loc "lokal soc_bila f. KFSOCLF" UWORD FORMULA_0462 0 0.0 0.0 99.99839782714844 READ_WRITE ECU_ADDRESS 0x3FA98C /end MEASUREMENT
/begin MEASUREMENT Soc_bila "Ladezustand durch Bilanzierung und Ruhespannungsmessung ermittelt" UWORD FORMULA_0462 0 0.0 0.0 99.99839782714844 READ_WRITE ECU_ADDRESS 0x3FCBA0 /end MEASUREMENT
/begin MEASUREMENT Soc_fit "SoC aus der Fitformel" UWORD FORMULA_0462 0 0.0 0.0 99.99839782714844 READ_WRITE ECU_ADDRESS 0x3FA990 /end MEASUREMENT
/begin MEASUREMENT Soc_fit_temp "" UWORD FORMULA_0462 0 0.0 0.0 99.99839782714844 READ_WRITE ECU_ADDRESS 0x3FCBAA /end MEASUREMENT
/begin MEASUREMENT Soc_korr "Korrekturwert soc_bila" SWORD FORMULA_0479 0 0.0 -100.0 99.99690246582031 READ_WRITE ECU_ADDRESS 0x3FA996 /end MEASUREMENT
/begin MEASUREMENT Soc_q_kor "Korrekturwert Genauigkeit Ladezustandsbestimmung" UWORD FORMULA_0498 0 0.0 0.0 1192.750244140625 READ_WRITE ECU_ADDRESS 0x3FA99C /end MEASUREMENT
/begin MEASUREMENT Soc_q_loc "lokaler Zähler Genauigkeit Ladeztustandsbestimmung" UWORD FORMULA_0498 0 0.0 0.0 1192.750244140625 READ_WRITE ECU_ADDRESS 0x3FA98E /end MEASUREMENT
/begin MEASUREMENT Soc_quali "Zähler Genauigkeit Ladeztustandsbestimmung" UWORD FORMULA_0498 0 0.0 0.0 1192.750244140625 READ_WRITE ECU_ADDRESS 0x3FCBA2 /end MEASUREMENT
/begin MEASUREMENT Soc_rel "Relativzähler für Ladezustand SoC" UWORD FORMULA_0462 0 0.0 0.0 99.99839782714844 READ_WRITE ECU_ADDRESS 0x3FA99E /end MEASUREMENT
/begin MEASUREMENT Soc_stfgk "Startfähigkeitsgrenze" UWORD FORMULA_0462 0 0.0 0.0 99.99839782714844 READ_WRITE ECU_ADDRESS 0x3FA9A0 /end MEASUREMENT
/begin MEASUREMENT Soc_stfgkw "SoC Startfähigkeit" UWORD FORMULA_0462 0 0.0 0.0 99.99839782714844 READ_WRITE ECU_ADDRESS 0x3FCBB4 /end MEASUREMENT
/begin MEASUREMENT St_bgllgen0 "Statuswort" UBYTE FORMULA_0003 0 0.0 0.0 255.0 READ_WRITE ECU_ADDRESS 0x3FBCD6 /end MEASUREMENT
/begin MEASUREMENT St_bgllgen0.B_hysllrah "" UBYTE FORMULA_0423 0 0 0.0 255.0 READ_WRITE BIT_MASK 0x1 ECU_ADDRESS 0x3FBCD6 /end MEASUREMENT
/begin MEASUREMENT St_dibs0 "Statuswort" UBYTE FORMULA_0003 0 0.0 0.0 255.0 READ_WRITE ECU_ADDRESS 0x3F9928 /end MEASUREMENT
/begin MEASUREMENT St_dibs0.B_dibloc1 "Signal nv lave loc zur Flankenerkennung" UBYTE FORMULA_0423 0 0 0.0 255.0 READ_WRITE BIT_MASK 0x1 ECU_ADDRESS 0x3F9928 /end MEASUREMENT
/begin MEASUREMENT St_dibs0.B_dibloc2 "Signal nv lave loc zur Flankenerkennung" UBYTE FORMULA_0424 0 0 0.0 255.0 READ_WRITE BIT_MASK 0x2 ECU_ADDRESS 0x3F9928 /end MEASUREMENT
/begin MEASUREMENT St_dibs1 "Statuswort" UBYTE FORMULA_0003 0 0.0 0.0 255.0 READ_WRITE ECU_ADDRESS 0x3FBE44 /end MEASUREMENT
/begin MEASUREMENT St_dibs1.B_ifbsak "BSD Kommunikation zum IBS gestoert" UBYTE FORMULA_0425 0 0 0.0 255.0 READ_WRITE BIT_MASK 0x4 ECU_ADDRESS 0x3FBE44 /end MEASUREMENT
/begin MEASUREMENT St_dibs1.B_ifebsak "Fehler erweiterte BSD Kommunikation zum IBS" UBYTE FORMULA_0426 0 0 0.0 255.0 READ_WRITE BIT_MASK 0x8 ECU_ADDRESS 0x3FBE44 /end MEASUREMENT
/begin MEASUREMENT St_dibs1.B_ifuplak "Fehler IBS Version unplausibel" UBYTE FORMULA_0427 0 0 0.0 255.0 READ_WRITE BIT_MASK 0x10 ECU_ADDRESS 0x3FBE44 /end MEASUREMENT
/begin MEASUREMENT St_dibs2 "Statuswort" UBYTE FORMULA_0003 0 0.0 0.0 255.0 READ_WRITE ECU_ADDRESS 0x3FBE45 /end MEASUREMENT
/begin MEASUREMENT St_dibs2.B_ifisak "IBS Stromfehler" UBYTE FORMULA_0423 0 0 0.0 255.0 READ_WRITE BIT_MASK 0x1 ECU_ADDRESS 0x3FBE45 /end MEASUREMENT
/begin MEASUREMENT St_dibs2.B_ifsysak "" UBYTE FORMULA_0428 0 0 0.0 255.0 READ_WRITE BIT_MASK 0x20 ECU_ADDRESS 0x3FBE45 /end MEASUREMENT
/begin MEASUREMENT St_dibs2.B_iftempak "IBS Temperaturfehler" UBYTE FORMULA_0425 0 0 0.0 255.0 READ_WRITE BIT_MASK 0x4 ECU_ADDRESS 0x3FBE45 /end MEASUREMENT
/begin MEASUREMENT St_dibs2.B_ifusak "IBS Spannungsfehler" UBYTE FORMULA_0424 0 0 0.0 255.0 READ_WRITE BIT_MASK 0x2 ECU_ADDRESS 0x3FBE45 /end MEASUREMENT
/begin MEASUREMENT St_dibs2.B_ifwugdak "IBS KL15 Masseschluss" UBYTE FORMULA_0426 0 0 0.0 255.0 READ_WRITE BIT_MASK 0x8 ECU_ADDRESS 0x3FBE45 /end MEASUREMENT
/begin MEASUREMENT St_dibs2.B_ifwuplak "" UBYTE FORMULA_0427 0 0 0.0 255.0 READ_WRITE BIT_MASK 0x10 ECU_ADDRESS 0x3FBE45 /end MEASUREMENT
/begin MEASUREMENT St_lbattcal0 "Statuswort" UBYTE FORMULA_0003 0 0.0 0.0 255.0 READ_WRITE ECU_ADDRESS 0x3FC5E2 /end MEASUREMENT
/begin MEASUREMENT St_lbattcal0.B_dly_tbi "Bedingung für Startwertberechnung" UBYTE FORMULA_0428 0 0 0.0 255.0 READ_WRITE BIT_MASK 0x20 ECU_ADDRESS 0x3FC5E2 /end MEASUREMENT
/begin MEASUREMENT St_lbattcal0.B_lbatteinih "Ende Initialisierungsphase Lbattcal Batterie hinten" UBYTE FORMULA_0423 0 0 0.0 255.0 READ_WRITE BIT_MASK 0x1 ECU_ADDRESS 0x3FC5E2 /end MEASUREMENT
/begin MEASUREMENT St_lbattcal0.B_lbatteiniv "Ende Initialisierungsphase Lbattcal Batterie vorne" UBYTE FORMULA_0424 0 0 0.0 255.0 READ_WRITE BIT_MASK 0x2 ECU_ADDRESS 0x3FC5E2 /end MEASUREMENT
/begin MEASUREMENT St_lbattcal0.B_lbattenh "Enable Batterie hinten" UBYTE FORMULA_0425 0 0 0.0 255.0 READ_WRITE BIT_MASK 0x4 ECU_ADDRESS 0x3FC5E2 /end MEASUREMENT
/begin MEASUREMENT St_lbattcal0.B_lbattenv "Enable Batterie vorne" UBYTE FORMULA_0426 0 0 0.0 255.0 READ_WRITE BIT_MASK 0x8 ECU_ADDRESS 0x3FC5E2 /end MEASUREMENT
/begin MEASUREMENT St_lbattcal0.B_lbattinit "Initialisierung LBATTCAL beendet" UBYTE FORMULA_0427 0 0 0.0 255.0 READ_WRITE BIT_MASK 0x10 ECU_ADDRESS 0x3FC5E2 /end MEASUREMENT
/begin MEASUREMENT St_pmdiag0 "Statuswort" UBYTE FORMULA_0003 0 0.0 0.0 255.0 READ_WRITE ECU_ADDRESS 0x3FCAD4 /end MEASUREMENT
/begin MEASUREMENT St_pmdiag0.B_ccbtnach "CC Meldung : Batterie Nachladen" UBYTE FORMULA_0429 0 0 0.0 255.0 READ_WRITE BIT_MASK 0x40 ECU_ADDRESS 0x3FCAD4 /end MEASUREMENT
/begin MEASUREMENT St_pmdiag0.B_ccbttdfk "CC Meldung : Batterie verschlissen" UBYTE FORMULA_0425 0 0 0.0 255.0 READ_WRITE BIT_MASK 0x4 ECU_ADDRESS 0x3FCAD4 /end MEASUREMENT
/begin MEASUREMENT St_pmdiag0.B_ccbttknt "CC Meldung : Batteriekontakt pruefen" UBYTE FORMULA_0427 0 0 0.0 255.0 READ_WRITE BIT_MASK 0x10 ECU_ADDRESS 0x3FCAD4 /end MEASUREMENT
/begin MEASUREMENT St_pmdiag0.B_ccpmerr "CC Meldung : Powermgm ausser Betrieb" UBYTE FORMULA_0426 0 0 0.0 255.0 READ_WRITE BIT_MASK 0x8 ECU_ADDRESS 0x3FCAD4 /end MEASUREMENT
/begin MEASUREMENT St_pmdiag0.B_ccprio "CC Meldung : Komfortverbraucher eingeschraenkt" UBYTE FORMULA_0424 0 0 0.0 255.0 READ_WRITE BIT_MASK 0x2 ECU_ADDRESS 0x3FCAD4 /end MEASUREMENT
/begin MEASUREMENT St_pmdiag0.B_codierpm "Anfrage an CAS die Codierdaten erneut fuer PM zu senden." UBYTE FORMULA_0423 0 0 0.0 255.0 READ_WRITE BIT_MASK 0x1 ECU_ADDRESS 0x3FCAD4 /end MEASUREMENT
/begin MEASUREMENT St_pmdiag0.B_pcoschg "Bed. SVstatus darf geändert werden." UBYTE FORMULA_0428 0 0 0.0 255.0 READ_WRITE BIT_MASK 0x20 ECU_ADDRESS 0x3FCAD4 /end MEASUREMENT
/begin MEASUREMENT St_pmdiag0.B_tiefrset "Tiefentladungsbit, B_tiefset, im IBS löschen." UBYTE FORMULA_0430 0 0 0.0 255.0 READ_WRITE BIT_MASK 0x80 ECU_ADDRESS 0x3FCAD4 /end MEASUREMENT
/begin MEASUREMENT St_pmdiag1 "Statuswort" UBYTE FORMULA_0003 0 0.0 0.0 255.0 READ_WRITE ECU_ADDRESS 0x3FCAD5 /end MEASUREMENT
/begin MEASUREMENT St_pmdiag1.B_ccruhver "CC Meldung : erhoehter Ruhestrom" UBYTE FORMULA_0423 0 0 0.0 255.0 READ_WRITE BIT_MASK 0x1 ECU_ADDRESS 0x3FCAD5 /end MEASUREMENT
/begin MEASUREMENT St_pmdiag1.B_histrset "IBS Histrogramm darf gelöscht werden." UBYTE FORMULA_0424 0 0 0.0 255.0 READ_WRITE BIT_MASK 0x2 ECU_ADDRESS 0x3FCAD5 /end MEASUREMENT
/begin MEASUREMENT St_pmdiag1.B_qelad1step "Q_elad 1. Takt vorbei " UBYTE FORMULA_0428 0 0 0.0 255.0 READ_WRITE BIT_MASK 0x20 ECU_ADDRESS 0x3FCAD5 /end MEASUREMENT
/begin MEASUREMENT St_pmdiag1.B_ruhverl7 "Ruhestromverletzung derzeit vorhanden." UBYTE FORMULA_0427 0 0 0.0 255.0 READ_WRITE BIT_MASK 0x10 ECU_ADDRESS 0x3FCAD5 /end MEASUREMENT
/begin MEASUREMENT St_pmdiag1.B_sv_ihka "IHKA Standverbraucher aktiv" UBYTE FORMULA_0426 0 0 0.0 255.0 READ_WRITE BIT_MASK 0x8 ECU_ADDRESS 0x3FCAD5 /end MEASUREMENT
/begin MEASUREMENT St_pmdiag1.B_timer_rst "Dient zum Aufziehen des internen Delay Timers" UBYTE FORMULA_0425 0 0 0.0 255.0 READ_WRITE BIT_MASK 0x4 ECU_ADDRESS 0x3FCAD5 /end MEASUREMENT
/begin MEASUREMENT St_pmdiagnv "Statuswort" UBYTE FORMULA_0003 0 0.0 0.0 255.0 READ_WRITE ECU_ADDRESS 0x3FA90C /end MEASUREMENT
/begin MEASUREMENT St_pmdiagnv.B_ruhverl "ruhestromverletzung vorhanden" UBYTE FORMULA_0423 0 0 0.0 255.0 READ_WRITE BIT_MASK 0x1 ECU_ADDRESS 0x3FA90C /end MEASUREMENT
/begin MEASUREMENT St_pmprsv_nv "Statuswort" UBYTE FORMULA_0003 0 0.0 0.0 255.0 READ_WRITE ECU_ADDRESS 0x3FA97C /end MEASUREMENT
/begin MEASUREMENT St_pmprsv_nv.B_enwake7 "lokales B_enwake" UBYTE FORMULA_0423 0 0 0.0 255.0 READ_WRITE BIT_MASK 0x1 ECU_ADDRESS 0x3FA97C /end MEASUREMENT
/begin MEASUREMENT St_pmprsvcalc "Statuswort" UBYTE FORMULA_0003 0 0.0 0.0 255.0 READ_WRITE ECU_ADDRESS 0x3FCB08 /end MEASUREMENT
/begin MEASUREMENT St_pmprsvcalc.B_gendef "Bedingung Generator defekt während Motorbetrieb" UBYTE FORMULA_0428 0 0 0.0 255.0 READ_WRITE BIT_MASK 0x20 ECU_ADDRESS 0x3FCB08 /end MEASUREMENT
/begin MEASUREMENT St_pmprsvcalc.B_ipmaktiv "IPM Massnahmen bzgl. Prios aktiviert" UBYTE FORMULA_0426 0 0 0.0 255.0 READ_WRITE BIT_MASK 0x8 ECU_ADDRESS 0x3FCB08 /end MEASUREMENT
/begin MEASUREMENT St_pmprsvcalc.B_ipmtimer "IPM Timer für Prios aktiv" UBYTE FORMULA_0425 0 0 0.0 255.0 READ_WRITE BIT_MASK 0x4 ECU_ADDRESS 0x3FCB08 /end MEASUREMENT
/begin MEASUREMENT St_pmprsvcalc.B_kwdr_old "Dient zur Erkennung einer steigender Flanke B_kl15" UBYTE FORMULA_0427 0 0 0.0 255.0 READ_WRITE BIT_MASK 0x10 ECU_ADDRESS 0x3FCB08 /end MEASUREMENT
/begin MEASUREMENT St_pmprsvcalc.B_nkwptcio "NKW status für PTC i.o." UBYTE FORMULA_0429 0 0 0.0 255.0 READ_WRITE BIT_MASK 0x40 ECU_ADDRESS 0x3FCB08 /end MEASUREMENT
/begin MEASUREMENT St_pmprsvcalc.B_ptckoor "PTC Koordinator Maßnahmen Aktiv" UBYTE FORMULA_0430 0 0 0.0 255.0 READ_WRITE BIT_MASK 0x80 ECU_ADDRESS 0x3FCB08 /end MEASUREMENT
/begin MEASUREMENT St_pmprsvcalc.B_ubtlow "Bedingung Batterie in Unterspannungszustand" UBYTE FORMULA_0423 0 0 0.0 255.0 READ_WRITE BIT_MASK 0x1 ECU_ADDRESS 0x3FCB08 /end MEASUREMENT
/begin MEASUREMENT St_pmprsvcalc.B_uloreset "Bedingung Batterie nicht mehr in Unterspannungszustand" UBYTE FORMULA_0424 0 0 0.0 255.0 READ_WRITE BIT_MASK 0x2 ECU_ADDRESS 0x3FCB08 /end MEASUREMENT
/begin MEASUREMENT St_pmprsvcalc1 "Statuswort" UBYTE FORMULA_0003 0 0.0 0.0 255.0 READ_WRITE ECU_ADDRESS 0x3FCB09 /end MEASUREMENT
/begin MEASUREMENT St_pmprsvcalc1.B_dubt "Bedg., ob dubt > 100mV" UBYTE FORMULA_0424 0 0 0.0 255.0 READ_WRITE BIT_MASK 0x2 ECU_ADDRESS 0x3FCB09 /end MEASUREMENT
/begin MEASUREMENT St_pmprsvcalc1.B_enwakeup "Bit, ob IBS Bus wecken darf oder nicht." UBYTE FORMULA_0423 0 0 0.0 255.0 READ_WRITE BIT_MASK 0x1 ECU_ADDRESS 0x3FCB09 /end MEASUREMENT
/begin MEASUREMENT St_pmprsvcalc1.B_limcalc "Bedg. begrenzte Berechnung" UBYTE FORMULA_0428 0 0 0.0 255.0 READ_WRITE BIT_MASK 0x20 ECU_ADDRESS 0x3FCB09 /end MEASUREMENT
/begin MEASUREMENT St_pmprsvcalc1.B_notprsv "Bed.Notlauf aufg.Batt-Unterspg, Generatorstat und B_kl15 in PMPRSVCALC" UBYTE FORMULA_0429 0 0 0.0 255.0 READ_WRITE BIT_MASK 0x40 ECU_ADDRESS 0x3FCB09 /end MEASUREMENT
/begin MEASUREMENT St_pmprsvcalc1.B_pireset "Bedingung für PI-Reset" UBYTE FORMULA_0430 0 0 0.0 255.0 READ_WRITE BIT_MASK 0x80 ECU_ADDRESS 0x3FCB09 /end MEASUREMENT
/begin MEASUREMENT St_pmprsvcalc1.B_pmbsdanf "Bedg. ob 3b4 versendet wird" UBYTE FORMULA_0427 0 0 0.0 255.0 READ_WRITE BIT_MASK 0x10 ECU_ADDRESS 0x3FCB09 /end MEASUREMENT
/begin MEASUREMENT St_pmprsvcalc1.B_pmvsdanf "Bedg., ob 3b3 versendet wird" UBYTE FORMULA_0425 0 0 0.0 255.0 READ_WRITE BIT_MASK 0x4 ECU_ADDRESS 0x3FCB09 /end MEASUREMENT
/begin MEASUREMENT St_pmprsvcalc2 "Statuswort" UBYTE FORMULA_0003 0 0.0 0.0 255.0 READ_WRITE ECU_ADDRESS 0x3FCB0A /end MEASUREMENT
/begin MEASUREMENT St_pmprsvcalc2.B_kwdrise "Motorstart Rising" UBYTE FORMULA_0423 0 0 0.0 255.0 READ_WRITE BIT_MASK 0x1 ECU_ADDRESS 0x3FCB0A /end MEASUREMENT
/begin MEASUREMENT St_pmprsvcalc2.B_pmsulevon "PM Sulev Maßnahmen aktiv" UBYTE FORMULA_0424 0 0 0.0 255.0 READ_WRITE BIT_MASK 0x2 ECU_ADDRESS 0x3FCB0A /end MEASUREMENT
/begin MEASUREMENT St_pmsocalc1 "Statuswort" UBYTE FORMULA_0003 0 0.0 0.0 255.0 READ_WRITE ECU_ADDRESS 0x3FA980 /end MEASUREMENT
/begin MEASUREMENT St_pmsocalc1.B_ibspwf_e "Bedingung Powerfail IBS erkannt" UBYTE FORMULA_0423 0 0 0.0 255.0 READ_WRITE BIT_MASK 0x1 ECU_ADDRESS 0x3FA980 /end MEASUREMENT
/begin MEASUREMENT St_pmsoccalc "Statuswort" UBYTE FORMULA_0003 0 0.0 0.0 255.0 READ_WRITE ECU_ADDRESS 0x3FCB96 /end MEASUREMENT
/begin MEASUREMENT St_pmsoccalc.B_soc_pwf "Uo Kalibrierung durchgeführt" UBYTE FORMULA_0424 0 0 0.0 255.0 READ_WRITE BIT_MASK 0x2 ECU_ADDRESS 0x3FCB96 /end MEASUREMENT
/begin MEASUREMENT St_pmsoccalc.B_soccalc "Uo Kalibrierung durchgeführt" UBYTE FORMULA_0425 0 0 0.0 255.0 READ_WRITE BIT_MASK 0x4 ECU_ADDRESS 0x3FCB96 /end MEASUREMENT
/begin MEASUREMENT St_pmsockor0 "Statuswort" UBYTE FORMULA_0003 0 0.0 0.0 255.0 READ_WRITE ECU_ADDRESS 0x3FCBAE /end MEASUREMENT
/begin MEASUREMENT St_pmsockor0.B_abschfit "Bedingung Korrektur Startfähigkeitsgrenze durchgeführt" UBYTE FORMULA_0428 0 0 0.0 255.0 READ_WRITE BIT_MASK 0x20 ECU_ADDRESS 0x3FCBAE /end MEASUREMENT
/begin MEASUREMENT St_pmsockor0.B_pm_fit2 "Bedingung Hilfsvariable Fit 2" UBYTE FORMULA_0424 0 0 0.0 255.0 READ_WRITE BIT_MASK 0x2 ECU_ADDRESS 0x3FCBAE /end MEASUREMENT
/begin MEASUREMENT St_pmsockor0.B_pm_fit3 "Bedingung Hilfsvariable Fit 3" UBYTE FORMULA_0425 0 0 0.0 255.0 READ_WRITE BIT_MASK 0x4 ECU_ADDRESS 0x3FCBAE /end MEASUREMENT
/begin MEASUREMENT St_pmsockor0.B_pmsocini "wird beim INIT wahr um den Timer zurückzusetzen" UBYTE FORMULA_0426 0 0 0.0 255.0 READ_WRITE BIT_MASK 0x8 ECU_ADDRESS 0x3FCBAE /end MEASUREMENT
/begin MEASUREMENT St_pmsockor0.B_q_start "Bedingung Startqualität vollständig berechnet" UBYTE FORMULA_0427 0 0 0.0 255.0 READ_WRITE BIT_MASK 0x10 ECU_ADDRESS 0x3FCBAE /end MEASUREMENT
/begin MEASUREMENT St_pmsockor0.B_soc_npl "Bedingung SoC-Wert nicht plausibel" UBYTE FORMULA_0423 0 0 0.0 255.0 READ_WRITE BIT_MASK 0x1 ECU_ADDRESS 0x3FCBAE /end MEASUREMENT
/begin MEASUREMENT St_pmsocstart_nv0 "Statuswort" UBYTE FORMULA_0003 0 0.0 0.0 255.0 READ_WRITE ECU_ADDRESS 0x3FA9A3 /end MEASUREMENT
/begin MEASUREMENT St_pmsocstart_nv0.B_pmsqrdy "kt_ibs.dat" UBYTE FORMULA_0424 0 0 0.0 255.0 READ_WRITE BIT_MASK 0x2 ECU_ADDRESS 0x3FA9A3 /end MEASUREMENT
/begin MEASUREMENT St_pmsocstart_nv0.B_pmstartq "Bedingung Startqualität" UBYTE FORMULA_0423 0 0 0.0 255.0 READ_WRITE BIT_MASK 0x1 ECU_ADDRESS 0x3FA9A3 /end MEASUREMENT
/begin MEASUREMENT St_pmsocstart0 "Statuswort" UBYTE FORMULA_0003 0 0.0 0.0 255.0 READ_WRITE ECU_ADDRESS 0x3FCBB6 /end MEASUREMENT
/begin MEASUREMENT St_pmsocstart0.B_pmstart7 "Bed. Motorstart für Startauswertung PM" UBYTE FORMULA_0423 0 0 0.0 255.0 READ_WRITE BIT_MASK 0x1 ECU_ADDRESS 0x3FCBB6 /end MEASUREMENT
/begin MEASUREMENT St_pmsocstart0.B_resetsta "Bedingung Reset Startauswertung" UBYTE FORMULA_0424 0 0 0.0 255.0 READ_WRITE BIT_MASK 0x2 ECU_ADDRESS 0x3FCBB6 /end MEASUREMENT
/begin MEASUREMENT St_pmsocstart0.B_rstdatardy "Motor aus erkannt, Startwerte im IBS bereit zum löschen." UBYTE FORMULA_0425 0 0 0.0 255.0 READ_WRITE BIT_MASK 0x4 ECU_ADDRESS 0x3FCBB6 /end MEASUREMENT
/begin MEASUREMENT St_pmugencalc "Statuswort" UBYTE FORMULA_0003 0 0.0 0.0 255.0 READ_WRITE ECU_ADDRESS 0x3FCBC6 /end MEASUREMENT
/begin MEASUREMENT St_pmugencalc.B_genclcon "Wird auf true gesetzt wenn Motor und Generator bereits T_B_NMOT-Sekunden laufen." UBYTE FORMULA_0423 0 0 0.0 255.0 READ_WRITE BIT_MASK 0x1 ECU_ADDRESS 0x3FCBC6 /end MEASUREMENT
/begin MEASUREMENT Stat_sv_reg "Status Standverbraucher registriert" UWORD FORMULA_0010 0 0.0 0.0 65535.0 READ_WRITE ECU_ADDRESS 0x3FCADC /end MEASUREMENT
/begin MEASUREMENT Stat_sv_reg1 "LoByte Stat_sv_reg für Umweltbedingungen" UBYTE FORMULA_0003 0 0.0 0.0 255.0 READ_WRITE ECU_ADDRESS 0x3FCAF7 /end MEASUREMENT
/begin MEASUREMENT Stat_sv_reg2 "HiByte Stat_sv_reg für Umweltbedinung" UBYTE FORMULA_0003 0 0.0 0.0 255.0 READ_WRITE ECU_ADDRESS 0x3FCAF8 /end MEASUREMENT
/begin MEASUREMENT Stpcos "Status_Standverbraucher" UBYTE FORMULA_0003 0 0.0 0.0 3.0 READ_WRITE ECU_ADDRESS 0x3FCB8F /end MEASUREMENT
/begin MEASUREMENT Stpcos7 "lokales stpcos" UBYTE FORMULA_0003 0 0.0 0.0 3.0 READ_WRITE ECU_ADDRESS 0x3FA97E /end MEASUREMENT
/begin MEASUREMENT Stpcosmem "altes stpcos" UBYTE FORMULA_0003 0 0.0 0.0 3.0 READ_WRITE ECU_ADDRESS 0x3FCB90 /end MEASUREMENT
/begin MEASUREMENT Svaus "Status Standverbraucher sind aus " UBYTE FORMULA_0478 0 0.0 0.0 1.0 READ_WRITE ECU_ADDRESS 0x3FCAF9 /end MEASUREMENT
/begin MEASUREMENT T_batstiniv "Starttemperatur Batterie vorne" SWORD FORMULA_0431 0 0.0 -3276.800048828125 3276.699951171875 READ_WRITE ECU_ADDRESS 0x3FAF10 /end MEASUREMENT
/begin MEASUREMENT T_batt_ini "Startwert Batterietemperatur" SWORD FORMULA_0431 0 0.0 -3276.800048828125 3276.699951171875 READ_WRITE ECU_ADDRESS 0x3FAF12 /end MEASUREMENT
/begin MEASUREMENT T_batt_lb "Batterietemperatur" SWORD FORMULA_0431 0 0.0 -3276.800048828125 3276.699951171875 READ_WRITE ECU_ADDRESS 0x3FC5EA /end MEASUREMENT
/begin MEASUREMENT T_batt_zw "Temporäre Batterietemperatur" SWORD FORMULA_0431 0 0.0 -3276.800048828125 3276.699951171875 READ_WRITE ECU_ADDRESS 0x3FAF14 /end MEASUREMENT
/begin MEASUREMENT T_batt_zw2 "Temporäre Zwischengroesse" SWORD FORMULA_0431 0 0.0 -3276.800048828125 3276.699951171875 READ_WRITE ECU_ADDRESS 0x3FAF16 /end MEASUREMENT
/begin MEASUREMENT T_batt_zw3 "" SWORD FORMULA_0431 0 0.0 -3276.800048828125 3276.699951171875 READ_WRITE ECU_ADDRESS 0x3FAF18 /end MEASUREMENT
/begin MEASUREMENT T_battabst "Batterieabstelltemperatur" SWORD FORMULA_0431 0 0.0 -3276.800048828125 3276.699951171875 READ_WRITE ECU_ADDRESS 0x3FA872 /end MEASUREMENT
/begin MEASUREMENT T_bnmotakt "Zeit nachdem der Motor laeuft, hoert nach T_B_NMOT Sekunden auf." UBYTE FORMULA_0476 0 0.0 0.0 255.0 READ_WRITE ECU_ADDRESS 0x3FCBD4 /end MEASUREMENT
/begin MEASUREMENT T_count_dibs1 "" UBYTE FORMULA_0463 0 0.0 0.0 255.0 READ_WRITE ECU_ADDRESS 0x3FBE4C /end MEASUREMENT
/begin MEASUREMENT T_count_dibs2 "" UBYTE FORMULA_0463 0 0.0 0.0 255.0 READ_WRITE ECU_ADDRESS 0x3FBE4D /end MEASUREMENT
/begin MEASUREMENT T_count_dibs3 "" UBYTE FORMULA_0487 0 0.0 0.0 255.0 READ_WRITE ECU_ADDRESS 0x3FBE4E /end MEASUREMENT
/begin MEASUREMENT T_count_dibs4 "" UBYTE FORMULA_0487 0 0.0 0.0 255.0 READ_WRITE ECU_ADDRESS 0x3FBE4F /end MEASUREMENT
/begin MEASUREMENT T_delta "Zeit, die seit letzem Prozessaufruf verstrichen ist. Dient zur Taskkompatibilitaet." UBYTE FORMULA_0476 0 0.0 0.0 255.0 READ_WRITE ECU_ADDRESS 0x3FCBD5 /end MEASUREMENT
/begin MEASUREMENT T_histsum "Txhistiruh Summe" UWORD FORMULA_0492 0 0.0 0.0 3669960.0 READ_WRITE ECU_ADDRESS 0x3FCAE2 /end MEASUREMENT
/begin MEASUREMENT T_histsummin "Summe der Txhistiruh in Minuten" UWORD FORMULA_0493 0 0.0 0.0 61166.0 READ_WRITE ECU_ADDRESS 0x3FCAE4 /end MEASUREMENT
/begin MEASUREMENT T_saismem "T Saison zw. speicher" UBYTE FORMULA_0003 0 0.0 0.0 255.0 READ_WRITE ECU_ADDRESS 0x3FCAFF /end MEASUREMENT
/begin MEASUREMENT T_saison "Saison -Temperatur" SWORD FORMULA_0431 0 0.0 -3276.800048828125 3276.699951171875 READ_WRITE ECU_ADDRESS 0x3FA998 /end MEASUREMENT
/begin MEASUREMENT T_saisonalt "letzter Wert Saisontemperatur" SWORD FORMULA_0431 0 0.0 -3276.800048828125 3276.699951171875 READ_WRITE ECU_ADDRESS 0x3FCBB2 /end MEASUREMENT
/begin MEASUREMENT T1histshort "T1 Histogramm in 14.9333 MIn. Quantisiert" UBYTE FORMULA_0497 0 0.0 0.0 3808.0 READ_WRITE ECU_ADDRESS 0x3FCAFA /end MEASUREMENT
/begin MEASUREMENT T1pmcntr "T1PMINFO countdowncounter" UBYTE FORMULA_0461 0 0.0 0.0 25.5 READ_WRITE ECU_ADDRESS 0x3FCAFB /end MEASUREMENT
/begin MEASUREMENT T2hist "T2histitruh in sek." UWORD FORMULA_0494 0 0.0 0.0 917490.0 READ_WRITE ECU_ADDRESS 0x3FCAE6 /end MEASUREMENT
/begin MEASUREMENT T2histshort "T2 Histogramm als Umweltbed. bei Ruhestromverletzung" UBYTE FORMULA_0497 0 0.0 0.0 3808.0 READ_WRITE ECU_ADDRESS 0x3FCAFC /end MEASUREMENT
/begin MEASUREMENT T2pmcntr "T2PMINFO countdowncounter" UWORD FORMULA_0071 0 0.0 0.0 6553.5 READ_WRITE ECU_ADDRESS 0x3FCADE /end MEASUREMENT
/begin MEASUREMENT T3hist "T3histiruh in Sek" UWORD FORMULA_0494 0 0.0 0.0 917490.0 READ_WRITE ECU_ADDRESS 0x3FCAE8 /end MEASUREMENT
/begin MEASUREMENT T3histshort "T3 Histogramm als Umweltbed. bei Ruhestromverletzung" UBYTE FORMULA_0497 0 0.0 0.0 3808.0 READ_WRITE ECU_ADDRESS 0x3FCAFD /end MEASUREMENT
/begin MEASUREMENT T3pmcntr "T3PMINFO countdowncounter" UWORD FORMULA_0071 0 0.0 0.0 6553.5 READ_WRITE ECU_ADDRESS 0x3FCAE0 /end MEASUREMENT
/begin MEASUREMENT T4hist "T4histiruh in Sek" UWORD FORMULA_0494 0 0.0 0.0 917490.0 READ_WRITE ECU_ADDRESS 0x3FCAEA /end MEASUREMENT
/begin MEASUREMENT T4histshort "T4 Histogramm als Umweltbed. bei Ruhestromverletzung" UBYTE FORMULA_0497 0 0.0 0.0 3808.0 READ_WRITE ECU_ADDRESS 0x3FCAFE /end MEASUREMENT
/begin MEASUREMENT Tsocloc "Batterietemperatur zum Zeitpunkt der Ruhespannungsmessung (lokal)" SWORD FORMULA_0431 0 0.0 -3276.800048828125 3276.699951171875 READ_WRITE ECU_ADDRESS 0x3FCB9A /end MEASUREMENT
/begin MEASUREMENT Tumg_abst "Abstell-Aussentemperatur" SWORD FORMULA_0431 0 0.0 -3276.800048828125 3276.699951171875 READ_WRITE ECU_ADDRESS 0x3FA874 /end MEASUREMENT
/begin MEASUREMENT Tumg_battab "Abstell-Umgebungstemperatur Batterie" SWORD FORMULA_0431 0 0.0 -3276.800048828125 3276.699951171875 READ_WRITE ECU_ADDRESS 0x3FA876 /end MEASUREMENT
/begin MEASUREMENT Tumg_dt "Temporäre zwischengroesse" SWORD FORMULA_0431 0 0.0 -3276.800048828125 3276.699951171875 READ_WRITE ECU_ADDRESS 0x3FAF1A /end MEASUREMENT
/begin MEASUREMENT Tumg_ers "Aussentemperatur oder Ersatzwert" SWORD FORMULA_0431 0 0.0 -3276.800048828125 3276.699951171875 READ_WRITE ECU_ADDRESS 0x3FC5EC /end MEASUREMENT
/begin MEASUREMENT Tumg_tp "" SWORD FORMULA_0431 0 0.0 -3276.800048828125 3276.699951171875 READ_WRITE ECU_ADDRESS 0x3FAF1C /end MEASUREMENT
/begin MEASUREMENT U_gensollm "Generatorsollspannung" SWORD FORMULA_0488 0 0.0 -128.0 127.9960021972656 READ_WRITE ECU_ADDRESS 0x3FC5EE /end MEASUREMENT
/begin MEASUREMENT U_grenz "Grenzwert Spannung" UWORD FORMULA_0501 0 0.0 6.0 22.38369941711426 READ_WRITE ECU_ADDRESS 0x3FCBBE /end MEASUREMENT
/begin MEASUREMENT U_ibs "Generatorspannungsvorgabe von IBS" SWORD FORMULA_0488 0 0.0 -128.0 127.9960021972656 READ_WRITE ECU_ADDRESS 0x3FCBC8 /end MEASUREMENT
/begin MEASUREMENT U_igrdetec "U_gsoll - U_ibs für IGRLOW Detektierung" SWORD FORMULA_0488 0 0.0 -128.0 127.9960021972656 READ_WRITE ECU_ADDRESS 0x3FCBCA /end MEASUREMENT
/begin MEASUREMENT U_kompk "Zwischengröße" SWORD FORMULA_0488 0 0.0 0.0 127.9960021972656 READ_WRITE ECU_ADDRESS 0x3FC5E4 /end MEASUREMENT
/begin MEASUREMENT U_kompm "Zwischengröße" SWORD FORMULA_0488 0 0.0 0.0 127.9960021972656 READ_WRITE ECU_ADDRESS 0x3FC5E6 /end MEASUREMENT
/begin MEASUREMENT U_lade "Zwischengröße" SWORD FORMULA_0488 0 0.0 0.0 127.9960021972656 READ_WRITE ECU_ADDRESS 0x3FC5E8 /end MEASUREMENT
/begin MEASUREMENT U_startausw "U_tnstart - ugrenz" SWORD FORMULA_0500 0 0.0 -8.192000389099121 8.191699981689453 READ_WRITE ECU_ADDRESS 0x3FCBBA /end MEASUREMENT
/begin MEASUREMENT Ub_old "letzter Wert Batteriespannung" UWORD FORMULA_0432 0 0.0 0.0 6173.39697265625 READ_WRITE ECU_ADDRESS 0x3FCBC0 /end MEASUREMENT
/begin MEASUREMENT Ubatt0 "Aus Wertetripel ausgewählter Ruhespannungswert" UWORD FORMULA_0501 0 0.0 6.0 22.38369941711426 READ_WRITE ECU_ADDRESS 0x3FCBA4 /end MEASUREMENT
/begin MEASUREMENT Ubatts2 "Hilfswert2 Spannung aus Fitberechnung" UWORD FORMULA_0501 0 0.0 6.0 16.0 READ_WRITE ECU_ADDRESS 0x3FCBAC /end MEASUREMENT
/begin MEASUREMENT Ubattsoll "Batteriesollspannung aufgrund Batterietemperatur und Batt.-ladezustand. Weitere Nutzung in PMPRSVCALC." UWORD FORMULA_0501 0 0.0 6.0 22.38369941711426 READ_WRITE ECU_ADDRESS 0x3FCBD0 /end MEASUREMENT
/begin MEASUREMENT Ubattsoll7 "lokales ubattsoll" UWORD FORMULA_0501 0 0.0 6.0 22.38369941711426 READ_WRITE ECU_ADDRESS 0x3FCBD2 /end MEASUREMENT
/begin MEASUREMENT Ubdiff "ubattsoll - ubatt_w" SWORD FORMULA_0446 0 0.0 -32.0 31.99900054931641 READ_WRITE ECU_ADDRESS 0x3FCB32 /end MEASUREMENT
/begin MEASUREMENT Ubdiff2pi "Ubatt-Differenz-Gewichtung auf Prios" SWORD FORMULA_0505 0 0.0 -100.0 100.0 READ_WRITE ECU_ADDRESS 0x3FCB34 /end MEASUREMENT
/begin MEASUREMENT Ubdiffilt "Wert nach Ubdiff-Tiefpass Prio" SWORD FORMULA_0446 0 0.0 -32.0 31.99900054931641 READ_WRITE ECU_ADDRESS 0x3FCB36 /end MEASUREMENT
/begin MEASUREMENT Ubdiffptc "Delta Usoll-Ubatt PTC" SWORD FORMULA_0446 0 0.0 -32.0 31.99900054931641 READ_WRITE ECU_ADDRESS 0x3FCB38 /end MEASUREMENT
/begin MEASUREMENT Ubold7 "PTC dudt : alter Ub Wert zur Differenzbildung" UWORD FORMULA_0432 0 0.0 0.0 6173.39697265625 READ_WRITE ECU_ADDRESS 0x3FCB68 /end MEASUREMENT
/begin MEASUREMENT Ubt "Batteriespannung" UWORD FORMULA_0509 0 0.0 0.0 983.0250244140625 READ_WRITE ECU_ADDRESS 0x3FCB6A /end MEASUREMENT
/begin MEASUREMENT Ubt7 "Lokale Batteriespannung" UWORD FORMULA_0509 0 0.0 0.0 61.42499923706055 READ_WRITE ECU_ADDRESS 0x3FCB6C /end MEASUREMENT
/begin MEASUREMENT Ubt7mem "resultierendes ubt" SWORD FORMULA_0488 0 0.0 -128.0 127.9960021972656 READ_WRITE ECU_ADDRESS 0x3FCB3A /end MEASUREMENT
/begin MEASUREMENT Ubt7old "altes ubt" UWORD FORMULA_0509 0 0.0 0.0 61.42499923706055 READ_WRITE ECU_ADDRESS 0x3FCB6E /end MEASUREMENT
/begin MEASUREMENT Ubtpt12ptc "Ubatt Gewichtung für PTC Ansteuerung" SWORD FORMULA_0505 0 0.0 -100.0 100.0 READ_WRITE ECU_ADDRESS 0x3FCB3C /end MEASUREMENT
/begin MEASUREMENT Ubtpt1ptc "Ubdiffptc gefiltert" SWORD FORMULA_0446 0 0.0 -32.0 31.99900054931641 READ_WRITE ECU_ADDRESS 0x3FCB3E /end MEASUREMENT
/begin MEASUREMENT Udelta "Delta zw. Battsollspg und Battspg" SWORD FORMULA_0500 0 0.0 -8.192000389099121 8.191699981689453 READ_WRITE ECU_ADDRESS 0x3FCBCC /end MEASUREMENT
/begin MEASUREMENT Udeltaabs "Absolutwert von udelta" SWORD FORMULA_0500 0 0.0 0.0 8.191699981689453 READ_WRITE ECU_ADDRESS 0x3FCBCE /end MEASUREMENT
/begin MEASUREMENT Udeltaabsc "absoluter Wert von udelta" UWORD FORMULA_0509 0 0.0 0.0 61.42499923706055 READ_WRITE ECU_ADDRESS 0x3FCB70 /end MEASUREMENT
/begin MEASUREMENT Udeltac "inkrementierte Differenz zwischen altem und neuem ubt" SWORD FORMULA_0488 0 0.0 -128.0 127.9960021972656 READ_WRITE ECU_ADDRESS 0x3FCB40 /end MEASUREMENT
/begin MEASUREMENT Uibs7 "lokales uibs" SWORD FORMULA_0488 0 0.0 -128.0 127.9960021972656 READ_WRITE ECU_ADDRESS 0x3FB03E /end MEASUREMENT
/begin MEASUREMENT Ulev "Spannungsebene" UBYTE FORMULA_0003 0 0.0 0.0 15.0 READ_WRITE ECU_ADDRESS 0x3FCB91 /end MEASUREMENT
/begin MEASUREMENT Ulevmem "altes ulev" UBYTE FORMULA_0003 0 0.0 0.0 15.0 READ_WRITE ECU_ADDRESS 0x3FCB92 /end MEASUREMENT
/begin MEASUREMENT Ulow "Unterspannungsstatus : 0=i.O, 1=in between, 2=unterspannung" UBYTE FORMULA_0003 0 0.0 0.0 255.0 READ_WRITE ECU_ADDRESS 0x3FCB93 /end MEASUREMENT
/begin MEASUREMENT Ulowtimer "Zeit zur Unterspannungserkennung * Taskzeit (50*100ms = 5sec)" UBYTE FORMULA_0461 0 0.0 0.0 25.5 READ_WRITE ECU_ADDRESS 0x3FCB94 /end MEASUREMENT
/begin MEASUREMENT Uspgcnt "FS_Unterspannungscounter" UBYTE FORMULA_0461 0 0.0 0.0 25.5 READ_WRITE ECU_ADDRESS 0x3FCB00 /end MEASUREMENT
/begin MEASUREMENT Uspgprell "Anzahl der entprellten FS_Unterspannungserkennung." UBYTE FORMULA_0003 0 0.0 0.0 255.0 READ_WRITE ECU_ADDRESS 0x3FCB01 /end MEASUREMENT
/begin MEASUREMENT Uspgstat "FS_Unterspannungsstatus" UBYTE FORMULA_0003 0 0.0 0.0 255.0 READ_WRITE ECU_ADDRESS 0x3FCB02 /end MEASUREMENT
/begin MEASUREMENT Vvt_ib1_2 "Gesamtstrom VVT Bank1 bzw 4Zyl. und Bank2" UWORD FORMULA_0485 0 0.0 0.0 4095.9375 READ_WRITE ECU_ADDRESS 0x3FA9C8 /end MEASUREMENT
/begin MEASUREMENT Vvt_iges "Strombedarf des gesamten VVT-Systems" UWORD FORMULA_0485 0 0.0 0.0 192.0 READ_WRITE ECU_ADDRESS 0x3FA9CA /end MEASUREMENT
/begin MEASUREMENT Ztagedelta "verstrichene Tage" UBYTE FORMULA_0003 0 0.0 0.0 10.0 READ_WRITE ECU_ADDRESS 0x3FCB03 /end MEASUREMENT
/begin MEASUREMENT Ztageold "letzter Wert von ztageabs_w" UWORD FORMULA_0010 0 0.0 0.0 65535.0 READ_WRITE ECU_ADDRESS 0x3FA95C /end MEASUREMENT
/begin MEASUREMENT Ztagestate "Tageswechsel Statemachine Ctr" UBYTE FORMULA_0003 0 0.0 0.0 255.0 READ_WRITE ECU_ADDRESS 0x3FCB04 /end MEASUREMENT
/begin COMPU_METHOD FORMULA_0000 "FORMULA_0000" RAT_FUNC "%7.0" "-" COEFFS 0 1 0 0 0 1 /end COMPU_METHOD
/begin COMPU_METHOD FORMULA_0001 "FORMULA_0001" RAT_FUNC "%6.1" "%" COEFFS 0 10.0 0.0 0 0.0 1.0 /end COMPU_METHOD
/begin COMPU_METHOD FORMULA_0003 "FORMULA_0003" RAT_FUNC "%3.0" "-" COEFFS 0 1 0 0 0 1 /end COMPU_METHOD
/begin COMPU_METHOD FORMULA_0006 "FORMULA_0006" RAT_FUNC "%5.0" "Upm" COEFFS 0 1 0 0 0 1 /end COMPU_METHOD
/begin COMPU_METHOD FORMULA_0007 "FORMULA_0007" RAT_FUNC "%8.3" "-" COEFFS 0 10000.0 0.0 0 0.0 1.0 /end COMPU_METHOD
/begin COMPU_METHOD FORMULA_0008 "FORMULA_0008" RAT_FUNC "%6.1" "V" COEFFS 0 10.0 0.0 0 0.0 1.0 /end COMPU_METHOD
/begin COMPU_METHOD FORMULA_0009 "FORMULA_0009" RAT_FUNC "%6.1" "Nm" COEFFS 0 10.0 0.0 0 0.0 1.0 /end COMPU_METHOD
/begin COMPU_METHOD FORMULA_0010 "FORMULA_0010" RAT_FUNC "%5.0" "-" COEFFS 0 1 0 0 0 1 /end COMPU_METHOD
/begin COMPU_METHOD FORMULA_0021 "FORMULA_0021" RAT_FUNC "%7.2" "s" COEFFS 0 100.0 0.0 0 0.0 1.0 /end COMPU_METHOD
/begin COMPU_METHOD FORMULA_0022 "FORMULA_0022" RAT_FUNC "%7.2" "%" COEFFS 0 100.0 0.0 0 0.0 1.0 /end COMPU_METHOD
/begin COMPU_METHOD FORMULA_0023 "FORMULA_0023" RAT_FUNC "%6.1" "°C" COEFFS 0 10.0 2732.0 0 0.0 1.0 /end COMPU_METHOD
/begin COMPU_METHOD FORMULA_0024 "FORMULA_0024" RAT_FUNC "%9.4" "-" COEFFS 0 32768.0 0.0 0 0.0 1.0 /end COMPU_METHOD
/begin COMPU_METHOD FORMULA_0025 "FORMULA_0025" RAT_FUNC "%8.3" "-" COEFFS 0 16384.0 0.0 0 0.0 1.0 /end COMPU_METHOD
/begin COMPU_METHOD FORMULA_0037 "FORMULA_0037" RAT_FUNC "%5.2" "-" COEFFS 0 1 0 0 0 1 /end COMPU_METHOD
/begin COMPU_METHOD FORMULA_0071 "FORMULA_0071" RAT_FUNC "%6.1" "s" COEFFS 0 10.0 0.0 0 0.0 1.0 /end COMPU_METHOD
/begin COMPU_METHOD FORMULA_0073 "FORMULA_0073" RAT_FUNC "%8.3" "-" COEFFS 0 1024.0 0.0 0 0.0 1.0 /end COMPU_METHOD
/begin COMPU_METHOD FORMULA_0075 "FORMULA_0075" RAT_FUNC "%6.1" "mbar" COEFFS 0 16.0 0.0 0 0.0 1.0 /end COMPU_METHOD
/begin COMPU_METHOD FORMULA_0076 "FORMULA_0076" RAT_FUNC "%6.1" "km/h" COEFFS 0 16.0 0.0 0 0.0 1.0 /end COMPU_METHOD
/begin COMPU_METHOD FORMULA_0080 "FORMULA_0080" RAT_FUNC "%7.2" "-" COEFFS 0 1 0 0 0 1 /end COMPU_METHOD
/begin COMPU_METHOD FORMULA_0100 "FORMULA_0100" RAT_FUNC "%7.2" "-" COEFFS 0 10000.0 0.0 0 0.0 1.0 /end COMPU_METHOD
/begin COMPU_METHOD FORMULA_0102 "FORMULA_0102" RAT_FUNC "%6.1" "°KW" COEFFS 0 10.0 0.0 0 0.0 1.0 /end COMPU_METHOD
/begin COMPU_METHOD FORMULA_0103 "FORMULA_0103" RAT_FUNC "%6.1" "kg/h" COEFFS 0 10.0 0.0 0 0.0 1.0 /end COMPU_METHOD
/begin COMPU_METHOD FORMULA_0104 "FORMULA_0104" RAT_FUNC "%6.1" "mg/asp" COEFFS 0 10.0 0.0 0 0.0 1.0 /end COMPU_METHOD
/begin COMPU_METHOD FORMULA_0105 "FORMULA_0105" RAT_FUNC "%5.0" "Upm/s" COEFFS 0 1 0 0 0 1 /end COMPU_METHOD
/begin COMPU_METHOD FORMULA_0106 "FORMULA_0106" RAT_FUNC "%7.2" "%" COEFFS 0 163.84 0.0 0 0.0 1.0 /end COMPU_METHOD
/begin COMPU_METHOD FORMULA_0107 "FORMULA_0107" RAT_FUNC "%6.1" "%" COEFFS 0 10.24 0.0 0 0.0 1.0 /end COMPU_METHOD
/begin COMPU_METHOD FORMULA_0109 "FORMULA_0109" RAT_FUNC "%7.2" "s" COEFFS 0 200.0 0.0 0 0.0 1.0 /end COMPU_METHOD
/begin COMPU_METHOD FORMULA_0111 "FORMULA_0111" RAT_FUNC "%7.2" "mg" COEFFS 0 64.0 0.0 0 0.0 1.0 /end COMPU_METHOD
/begin COMPU_METHOD FORMULA_0114 "FORMULA_0114" RAT_FUNC "%5.0" "digit" COEFFS 0 1 0 0 0 1 /end COMPU_METHOD
/begin COMPU_METHOD FORMULA_0116 "FORMULA_0116" TAB_VERB "%5.0" "-" COMPU_TAB_REF FORMULA_0116_VTAB /end COMPU_METHOD
/begin COMPU_METHOD FORMULA_0117 "FORMULA_0117" TAB_VERB "%3.0" "-" COMPU_TAB_REF FORMULA_0117_VTAB /end COMPU_METHOD
/begin COMPU_METHOD FORMULA_0187 "FORMULA_0187" RAT_FUNC "%8.3" "100/10ms" COEFFS 0 100.0 0.0 0 0.0 1.0 /end COMPU_METHOD
/begin COMPU_METHOD FORMULA_0214 "FORMULA_0214" RAT_FUNC "%3.0" "s" COEFFS 0 1 0 0 0 1 /end COMPU_METHOD
/begin COMPU_METHOD FORMULA_0358 "FORMULA_0358" RAT_FUNC "%3.0" "ms" COEFFS 0 0.1 0.0 0 0.0 1.0 /end COMPU_METHOD
/begin COMPU_METHOD FORMULA_0359 "FORMULA_0359" TAB_VERB "%5.2" "-" COMPU_TAB_REF FORMULA_0359_VTAB /end COMPU_METHOD
/begin COMPU_METHOD FORMULA_0360 "FORMULA_0360" RAT_FUNC "%7.2" "kHz" COEFFS 0 100.0 0.0 0 0.0 1.0 /end COMPU_METHOD
/begin COMPU_METHOD FORMULA_0361 "FORMULA_0361" RAT_FUNC "%3.0" "us" COEFFS 0 1 0 0 0 1 /end COMPU_METHOD
/begin COMPU_METHOD FORMULA_0362 "FORMULA_0362" TAB_VERB "%5.2" "-" COMPU_TAB_REF FORMULA_0362_VTAB /end COMPU_METHOD
/begin COMPU_METHOD FORMULA_0423 "FORMULA_0423" TAB_VERB "%5.2" "-" COMPU_TAB_REF FORMULA_0423_VTAB /end COMPU_METHOD
/begin COMPU_METHOD FORMULA_0424 "FORMULA_0424" TAB_VERB "%5.2" "-" COMPU_TAB_REF FORMULA_0424_VTAB /end COMPU_METHOD
/begin COMPU_METHOD FORMULA_0425 "FORMULA_0425" TAB_VERB "%5.2" "-" COMPU_TAB_REF FORMULA_0425_VTAB /end COMPU_METHOD
/begin COMPU_METHOD FORMULA_0426 "FORMULA_0426" TAB_VERB "%5.2" "-" COMPU_TAB_REF FORMULA_0426_VTAB /end COMPU_METHOD
/begin COMPU_METHOD FORMULA_0427 "FORMULA_0427" TAB_VERB "%5.2" "-" COMPU_TAB_REF FORMULA_0427_VTAB /end COMPU_METHOD
/begin COMPU_METHOD FORMULA_0428 "FORMULA_0428" TAB_VERB "%5.2" "-" COMPU_TAB_REF FORMULA_0428_VTAB /end COMPU_METHOD
/begin COMPU_METHOD FORMULA_0429 "FORMULA_0429" TAB_VERB "%5.2" "-" COMPU_TAB_REF FORMULA_0429_VTAB /end COMPU_METHOD
/begin COMPU_METHOD FORMULA_0430 "FORMULA_0430" TAB_VERB "%5.2" "-" COMPU_TAB_REF FORMULA_0430_VTAB /end COMPU_METHOD
/begin COMPU_METHOD FORMULA_0431 "FORMULA_0431" RAT_FUNC "%5.0" "°C" COEFFS 0 10.0 0.0 0 0.0 1.0 /end COMPU_METHOD
/begin COMPU_METHOD FORMULA_0432 "FORMULA_0432" RAT_FUNC "%6.1" "V" COEFFS 0 10.61571125265393 0.0 0 0.0 1.0 /end COMPU_METHOD
/begin COMPU_METHOD FORMULA_0446 "FORMULA_0446" RAT_FUNC "%9.4" "-" COEFFS 0 1024.0 0.0 0 0.0 1.0 /end COMPU_METHOD
/begin COMPU_METHOD FORMULA_0449 "FORMULA_0449" RAT_FUNC "%5.2" "-" COEFFS 0 32.0 0.0 0 0.0 1.0 /end COMPU_METHOD
/begin COMPU_METHOD FORMULA_0455 "FORMULA_0455" RAT_FUNC "%5.2" "-" COEFFS 0 256.0 0.0 0 0.0 1.0 /end COMPU_METHOD
/begin COMPU_METHOD FORMULA_0458 "FORMULA_0458" RAT_FUNC "%5.2" "-" COEFFS 0 8.0 0.0 0 0.0 1.0 /end COMPU_METHOD
/begin COMPU_METHOD FORMULA_0460 "FORMULA_0460" RAT_FUNC "%9.4" "-" COEFFS 0 65536.0 0.0 0 0.0 1.0 /end COMPU_METHOD
/begin COMPU_METHOD FORMULA_0461 "FORMULA_0461" RAT_FUNC "%4.1" "s" COEFFS 0 10.0 0.0 0 0.0 1.0 /end COMPU_METHOD
/begin COMPU_METHOD FORMULA_0462 "FORMULA_0462" RAT_FUNC "%7.2" "%" COEFFS 0 655.36 0.0 0 0.0 1.0 /end COMPU_METHOD
/begin COMPU_METHOD FORMULA_0463 "FORMULA_0463" RAT_FUNC "%6.3" "" COEFFS 0 1 0 0 0 1 /end COMPU_METHOD
/begin COMPU_METHOD FORMULA_0465 "FORMULA_0465" RAT_FUNC "%5.2" "-" COEFFS 0 64.0 0.0 0 0.0 1.0 /end COMPU_METHOD
/begin COMPU_METHOD FORMULA_0469 "FORMULA_0469" RAT_FUNC "%8.3" "A" COEFFS 0 1 0 0 0 1 /end COMPU_METHOD
/begin COMPU_METHOD FORMULA_0474 "FORMULA_0474" RAT_FUNC "%5.0" "km/h" COEFFS 0 1 0 0 0 1 /end COMPU_METHOD
/begin COMPU_METHOD FORMULA_0475 "FORMULA_0475" RAT_FUNC "%5.2" "%" COEFFS 0 2.56 0.0 0 0.0 1.0 /end COMPU_METHOD
/begin COMPU_METHOD FORMULA_0476 "FORMULA_0476" RAT_FUNC "%5.2" "min" COEFFS 0 1 0 0 0 1 /end COMPU_METHOD
/begin COMPU_METHOD FORMULA_0477 "FORMULA_0477" RAT_FUNC "%5.2" "-" COEFFS 0 128.0 0.0 0 0.0 1.0 /end COMPU_METHOD
/begin COMPU_METHOD FORMULA_0478 "FORMULA_0478" RAT_FUNC "%4.1" "-" COEFFS 0 1 0 0 0 1 /end COMPU_METHOD
/begin COMPU_METHOD FORMULA_0479 "FORMULA_0479" RAT_FUNC "%7.2" "-" COEFFS 0 327.68 0.0 0 0.0 1.0 /end COMPU_METHOD
/begin COMPU_METHOD FORMULA_0482 "FORMULA_0482" RAT_FUNC "%7.2" "%" COEFFS 0 256.0 0.0 0 0.0 1.0 /end COMPU_METHOD
/begin COMPU_METHOD FORMULA_0484 "FORMULA_0484" RAT_FUNC "%7.2" "%" COEFFS 0 128.0 0.0 0 0.0 1.0 /end COMPU_METHOD
/begin COMPU_METHOD FORMULA_0485 "FORMULA_0485" RAT_FUNC "%8.3" "A" COEFFS 0 16.0 0.0 0 0.0 1.0 /end COMPU_METHOD
/begin COMPU_METHOD FORMULA_0486 "FORMULA_0486" RAT_FUNC "%8.3" "A" COEFFS 0 1000.0 0.0 0 0.0 1.0 /end COMPU_METHOD
/begin COMPU_METHOD FORMULA_0487 "FORMULA_0487" RAT_FUNC "%4.1" "-" COEFFS 0 1 0 0 0 1 /end COMPU_METHOD
/begin COMPU_METHOD FORMULA_0488 "FORMULA_0488" RAT_FUNC "%8.3" "V" COEFFS 0 256.0 0.0 0 0.0 1.0 /end COMPU_METHOD
/begin COMPU_METHOD FORMULA_0489 "FORMULA_0489" RAT_FUNC "%8.3" "kg" COEFFS 0 2250.0 0.0 0 0.0 1.0 /end COMPU_METHOD
/begin COMPU_METHOD FORMULA_0490 "FORMULA_0490" RAT_FUNC "%7.4" "V" COEFFS 0 10.61571125265393 0.0 0 0.0 1.0 /end COMPU_METHOD
/begin COMPU_METHOD FORMULA_0491 "FORMULA_0491" RAT_FUNC "%7.2" "" COEFFS 0 3.433333333333333 0.0 0 0.0 1.0 /end COMPU_METHOD
/begin COMPU_METHOD FORMULA_0492 "FORMULA_0492" RAT_FUNC "%7.2" "s" COEFFS 0 1.785714285714286e-002 0.0 0 0.0 1.0 /end COMPU_METHOD
/begin COMPU_METHOD FORMULA_0493 "FORMULA_0493" RAT_FUNC "%7.2" "min" COEFFS 0 1.071428571428571 0.0 0 0.0 1.0 /end COMPU_METHOD
/begin COMPU_METHOD FORMULA_0494 "FORMULA_0494" RAT_FUNC "%7.2" "s" COEFFS 0 7.142857142857143e-002 0.0 0 0.0 1.0 /end COMPU_METHOD
/begin COMPU_METHOD FORMULA_0495 "FORMULA_0495" RAT_FUNC "%5.2" "A" COEFFS 0 0.1 0.0 0 0.0 1.0 /end COMPU_METHOD
/begin COMPU_METHOD FORMULA_0496 "FORMULA_0496" RAT_FUNC "%6.3" "" COEFFS 0 800.0 0.0 0 0.0 1.0 /end COMPU_METHOD
/begin COMPU_METHOD FORMULA_0497 "FORMULA_0497" RAT_FUNC "%5.2" "min" COEFFS 0 6.696428571428571e-002 0.0 0 0.0 1.0 /end COMPU_METHOD
/begin COMPU_METHOD FORMULA_0498 "FORMULA_0498" RAT_FUNC "%8.3" "Ah" COEFFS 0 54.94444444444444 0.0 0 0.0 1.0 /end COMPU_METHOD
/begin COMPU_METHOD FORMULA_0499 "FORMULA_0499" RAT_FUNC "%7.2" "-" COEFFS 0 655.36 0.0 0 0.0 1.0 /end COMPU_METHOD
/begin COMPU_METHOD FORMULA_0500 "FORMULA_0500" RAT_FUNC "%8.3" "" COEFFS 0 4000.0 0.0 0 0.0 1.0 /end COMPU_METHOD
/begin COMPU_METHOD FORMULA_0501 "FORMULA_0501" RAT_FUNC "%8.3" "" COEFFS 0 4000.0 -24000.0 0 0.0 1.0 /end COMPU_METHOD
/begin COMPU_METHOD FORMULA_0502 "FORMULA_0502" RAT_FUNC "%5.2" "" COEFFS 0 0.1953125 0.0 0 0.0 1.0 /end COMPU_METHOD
/begin COMPU_METHOD FORMULA_0503 "FORMULA_0503" RAT_FUNC "%7.4" "min" COEFFS 0 1.071428571428571 0.0 0 0.0 1.0 /end COMPU_METHOD
/begin COMPU_METHOD FORMULA_0504 "FORMULA_0504" RAT_FUNC "%9.2" "" COEFFS 0 128.0 0.0 0 0.0 1.0 /end COMPU_METHOD
/begin COMPU_METHOD FORMULA_0505 "FORMULA_0505" RAT_FUNC "%7.2" "" COEFFS 0 4.0 0.0 0 0.0 1.0 /end COMPU_METHOD
/begin COMPU_METHOD FORMULA_0506 "FORMULA_0506" RAT_FUNC "%9.4" "-" COEFFS 0 679.4055201698513 0.0 0 0.0 1.0 /end COMPU_METHOD
/begin COMPU_METHOD FORMULA_0507 "FORMULA_0507" RAT_FUNC "%8.3" "" COEFFS 0 4.0 0.0 0 0.0 1.0 /end COMPU_METHOD
/begin COMPU_METHOD FORMULA_0508 "FORMULA_0508" RAT_FUNC "%8.3" "" COEFFS 0 12.5 2500.0 0 0.0 1.0 /end COMPU_METHOD
/begin COMPU_METHOD FORMULA_0509 "FORMULA_0509" RAT_FUNC "%8.3" "V" COEFFS 0 66.66666666666667 0.0 0 0.0 1.0 /end COMPU_METHOD
/begin COMPU_METHOD FORMULA_0510 "FORMULA_0510" RAT_FUNC "%5.2" "%" COEFFS 0 2.0 0.0 0 0.0 1.0 /end COMPU_METHOD
/begin COMPU_METHOD FORMULA_0511 "FORMULA_0511" RAT_FUNC "%8.3" "A" COEFFS 0 50.0 0.0 0 0.0 1.0 /end COMPU_METHOD
/begin COMPU_METHOD FORMULA_0512 "FORMULA_0512" RAT_FUNC "%11.4" "Ah" COEFFS 0 3600000.0 0.0 0 0.0 1.0 /end COMPU_METHOD
/begin COMPU_METHOD FORMULA_0513 "FORMULA_0513" RAT_FUNC "%6.3" "" COEFFS 0 1000.0 0.0 0 0.0 1.0 /end COMPU_METHOD
/begin COMPU_METHOD FORMULA_0514 "FORMULA_0514" RAT_FUNC "%6.1" "s" COEFFS 0 1 0 0 0 1 /end COMPU_METHOD
/begin COMPU_METHOD FORMULA_0515 "FORMULA_0515" RAT_FUNC "%8.3" "A" COEFFS 0 50.0 0.0 0 0.0 1.0 /end COMPU_METHOD
/begin COMPU_METHOD FORMULA_0516 "FORMULA_0516" RAT_FUNC "%6.3" "A" COEFFS 0 0.256 0.0 0 0.0 1.0 /end COMPU_METHOD
/begin COMPU_METHOD FORMULA_0535 "FORMULA_0535" RAT_FUNC "%8.3" "mg/ASP" COEFFS 0 64.0 0.0 0 0.0 1.0 /end COMPU_METHOD
/begin COMPU_METHOD FORMULA_0558 "FORMULA_0558" RAT_FUNC "%9.4" "-" COEFFS 0 10000.0 0.0 0 0.0 1.0 /end COMPU_METHOD
/begin COMPU_METHOD FORMULA_0559 "FORMULA_0559" RAT_FUNC "%4.1" "l" COEFFS 0 2.0 0.0 0 0.0 1.0 /end COMPU_METHOD
/begin COMPU_METHOD FORMULA_0606 "FORMULA_0606" RAT_FUNC "%7.2" "s" COEFFS 0 200.0 0.0 0 0.0 1.0 /end COMPU_METHOD
/begin COMPU_METHOD FORMULA_0607 "FORMULA_0607" RAT_FUNC "%3.0" "Sufe" COEFFS 0 1 0 0 0 1 /end COMPU_METHOD
/begin COMPU_METHOD FORMULA_0608 "FORMULA_0608" TAB_VERB "%3.0" "-" COMPU_TAB_REF FORMULA_0608_VTAB /end COMPU_METHOD
/begin COMPU_METHOD FORMULA_0609 "FORMULA_0609" RAT_FUNC "%4.1" "s" COEFFS 0 1 0 0 0 1 /end COMPU_METHOD
/begin COMPU_METHOD FORMULA_0610 "FORMULA_0610" RAT_FUNC "%6.1" "l" COEFFS 0 2.0 0.0 0 0.0 1.0 /end COMPU_METHOD
/begin COMPU_METHOD FORMULA_0611 "FORMULA_0611" TAB_VERB "%5.2" "-" COMPU_TAB_REF FORMULA_0611_VTAB /end COMPU_METHOD
/begin COMPU_METHOD FORMULA_0612 "FORMULA_0612" TAB_VERB "%5.2" "-" COMPU_TAB_REF FORMULA_0612_VTAB /end COMPU_METHOD
/begin COMPU_METHOD FORMULA_0613 "FORMULA_0613" RAT_FUNC "%5.0" "km" COEFFS 0 1 0 0 0 1 /end COMPU_METHOD
/begin COMPU_METHOD FORMULA_0614 "FORMULA_0614" RAT_FUNC "%3.0" ".Klasse" COEFFS 0 1 0 0 0 1 /end COMPU_METHOD
/begin COMPU_METHOD FORMULA_0615 "FORMULA_0615" RAT_FUNC "%3.0" "mA" COEFFS 0 1 0 0 0 1 /end COMPU_METHOD
/begin COMPU_METHOD FORMULA_0616 "FORMULA_0616" RAT_FUNC "%3.0" "A" COEFFS 0 0.1 0.0 0 0.0 1.0 /end COMPU_METHOD
/begin COMPU_METHOD FORMULA_0617 "FORMULA_0617" TAB_VERB "%3.0" "-" COMPU_TAB_REF FORMULA_0617_VTAB /end COMPU_METHOD
/begin COMPU_METHOD FORMULA_0618 "FORMULA_0618" TAB_VERB "%3.0" "-" COMPU_TAB_REF FORMULA_0618_VTAB /end COMPU_METHOD
/begin COMPU_METHOD FORMULA_0619 "FORMULA_0619" RAT_FUNC "%6.1" "-" COEFFS 0 10.0 0.0 0 0.0 1.0 /end COMPU_METHOD
/begin COMPU_METHOD FORMULA_0620 "FORMULA_0620" TAB_VERB "%3.0" "-" COMPU_TAB_REF FORMULA_0620_VTAB /end COMPU_METHOD
/begin COMPU_METHOD FORMULA_0621 "FORMULA_0621" TAB_VERB "%3.0" "-" COMPU_TAB_REF FORMULA_0621_VTAB /end COMPU_METHOD
/begin COMPU_METHOD FORMULA_0622 "FORMULA_0622" TAB_VERB "%3.0" "-" COMPU_TAB_REF FORMULA_0622_VTAB /end COMPU_METHOD
/begin COMPU_METHOD FORMULA_0623 "FORMULA_0623" RAT_FUNC "%4.1" "%" COEFFS 0 10.0 0.0 0 0.0 1.0 /end COMPU_METHOD
/begin COMPU_METHOD FORMULA_0624 "FORMULA_0624" TAB_VERB "%5.2" "-" COMPU_TAB_REF FORMULA_0624_VTAB /end COMPU_METHOD
/begin COMPU_METHOD FORMULA_0625 "FORMULA_0625" TAB_VERB "%3.0" "-" COMPU_TAB_REF FORMULA_0625_VTAB /end COMPU_METHOD
/begin COMPU_METHOD FORMULA_0626 "FORMULA_0626" RAT_FUNC "%4.1" "°C" COEFFS 0 2.0 80.0 0 0.0 1.0 /end COMPU_METHOD
/begin COMPU_METHOD FORMULA_0645 "FORMULA_0645" RAT_FUNC "%6.3" "s" COEFFS 0 0 1.28 0 1 0 /end COMPU_METHOD
/begin COMPU_METHOD FORMULA_0658 "FORMULA_0658" RAT_FUNC "%5.2" "s" COEFFS 0 0 2.56 0 1 0 /end COMPU_METHOD
/begin COMPU_METHOD FORMULA_0706 "FORMULA_0706" RAT_FUNC "%6.1" "%" COEFFS 0 100.0 0.0 0 0.0 1.0 /end COMPU_METHOD
/begin COMPU_METHOD FORMULA_0984 "FORMULA_0984" RAT_FUNC "%8.3" "qcm" COEFFS 0 1000.0 0.0 0 0.0 1.0 /end COMPU_METHOD
/begin COMPU_METHOD FORMULA_0985 "FORMULA_0985" RAT_FUNC "%7.2" "ms" COEFFS 0 100.0 0.0 0 0.0 1.0 /end COMPU_METHOD
/begin COMPU_METHOD FORMULA_1046 "FORMULA_1046" RAT_FUNC "%6.1" "mbar/V" COEFFS 0 80.0 0.0 0 0.0 1.0 /end COMPU_METHOD
/begin COMPU_METHOD FORMULA_1047 "FORMULA_1047" TAB_VERB "%5.2" "-" COMPU_TAB_REF FORMULA_1047_VTAB /end COMPU_METHOD
/begin COMPU_METHOD FORMULA_1048 "FORMULA_1048" TAB_VERB "%5.2" "-" COMPU_TAB_REF FORMULA_1048_VTAB /end COMPU_METHOD
/begin COMPU_METHOD FORMULA_1057 "FORMULA_1057" RAT_FUNC "%3.0" "z/asp" COEFFS 0 1 0 0 0 1 /end COMPU_METHOD
/begin COMPU_METHOD FORMULA_1058 "FORMULA_1058" RAT_FUNC "%7.2" "-/seg" COEFFS 0 1 0 0 0 1 /end COMPU_METHOD
/begin COMPU_METHOD FORMULA_1059 "FORMULA_1059" RAT_FUNC "%5.2" "Segmente" COEFFS 0 2.0 0.0 0 0.0 1.0 /end COMPU_METHOD
/begin COMPU_METHOD FORMULA_1060 "FORMULA_1060" TAB_VERB "%5.2" "-" COMPU_TAB_REF FORMULA_1060_VTAB /end COMPU_METHOD
/begin COMPU_METHOD FORMULA_1061 "FORMULA_1061" TAB_VERB "%5.2" "-" COMPU_TAB_REF FORMULA_1061_VTAB /end COMPU_METHOD
/begin COMPU_METHOD FORMULA_1062 "FORMULA_1062" TAB_VERB "%5.2" "-" COMPU_TAB_REF FORMULA_1062_VTAB /end COMPU_METHOD
/begin COMPU_METHOD FORMULA_1063 "FORMULA_1063" TAB_VERB "%5.2" "-" COMPU_TAB_REF FORMULA_1063_VTAB /end COMPU_METHOD
/begin COMPU_METHOD FORMULA_1064 "FORMULA_1064" TAB_VERB "%5.2" "-" COMPU_TAB_REF FORMULA_1064_VTAB /end COMPU_METHOD
/begin COMPU_METHOD FORMULA_1065 "FORMULA_1065" RAT_FUNC "%8.3" "dm**3" COEFFS 0 1000.0 0.0 0 0.0 1.0 /end COMPU_METHOD
/begin COMPU_METHOD FORMULA_1066 "FORMULA_1066" RAT_FUNC "%8.3" "Kg/m**3" COEFFS 0 1000.0 0.0 0 0.0 1.0 /end COMPU_METHOD
/begin COMPU_METHOD FORMULA_1067 "FORMULA_1067" RAT_FUNC "%3.0" "Segmente" COEFFS 0 2.0 0.0 0 0.0 1.0 /end COMPU_METHOD
/begin COMPU_METHOD FORMULA_1068 "FORMULA_1068" TAB_VERB "%5.2" "-" COMPU_TAB_REF FORMULA_1068_VTAB /end COMPU_METHOD
/begin COMPU_METHOD FORMULA_1069 "FORMULA_1069" RAT_FUNC "%9.4" "mg/ccm" COEFFS 0 4096.0 0.0 0 0.0 1.0 /end COMPU_METHOD
/begin COMPU_METHOD FORMULA_1070 "FORMULA_1070" RAT_FUNC "%3.0" "seg" COEFFS 0 1 0 0 0 1 /end COMPU_METHOD
/begin COMPU_METHOD FORMULA_1071 "FORMULA_1071" RAT_FUNC "%6.1" "ccm" COEFFS 0 10.0 0.0 0 0.0 1.0 /end COMPU_METHOD
/begin COMPU_METHOD FORMULA_1072 "FORMULA_1072" RAT_FUNC "%7.2" "-" COEFFS 0 1000.0 0.0 0 0.0 1.0 /end COMPU_METHOD
/begin COMPU_METHOD FORMULA_1073 "FORMULA_1073" TAB_VERB "%7.2" "-" COMPU_TAB_REF FORMULA_1073_VTAB /end COMPU_METHOD
/begin COMPU_METHOD FORMULA_1074 "FORMULA_1074" TAB_VERB "%7.2" "-" COMPU_TAB_REF FORMULA_1074_VTAB /end COMPU_METHOD
/begin COMPU_METHOD FORMULA_1075 "FORMULA_1075" TAB_VERB "%5.2" "-" COMPU_TAB_REF FORMULA_1075_VTAB /end COMPU_METHOD
/begin COMPU_METHOD FORMULA_1076 "FORMULA_1076" RAT_FUNC "%6.1" "Hz" COEFFS 0 10.0 0.0 0 0.0 1.0 /end COMPU_METHOD
/begin COMPU_METHOD FORMULA_1077 "FORMULA_1077" TAB_VERB "%5.2" "-" COMPU_TAB_REF FORMULA_1077_VTAB /end COMPU_METHOD
/begin COMPU_VTAB FORMULA_0116_VTAB "FORMULA_0116_VTAB" TAB_VERB 8 0 "O.K." 1 "BusOff" 2 "DPR" 4 "Timeout" 5 "BusOff+Timeout" 8 "Overflow" 16 "Chksum" 32 "Alive" DEFAULT_VALUE "Mehrfachfehler" /end COMPU_VTAB
/begin COMPU_VTAB FORMULA_0117_VTAB "FORMULA_0117_VTAB" TAB_VERB 8 0 "O.K." 1 "BusOff" 2 "DPR" 4 "Timeout" 5 "BusOff+Timeout" 8 "Overflow" 16 "Chksum" 32 "Alive" DEFAULT_VALUE "Mehrfachfehler" /end COMPU_VTAB
/begin COMPU_VTAB FORMULA_0359_VTAB "FORMULA_0359_VTAB" TAB_VERB 3 0 "OK" 1 "QADCA NIO" 2 "QADCB NIO" DEFAULT_VALUE "undef" /end COMPU_VTAB
/begin COMPU_VTAB FORMULA_0362_VTAB "FORMULA_0362_VTAB" TAB_VERB 2 0 "Aus" 1 "Ein" /end COMPU_VTAB
/begin COMPU_VTAB FORMULA_0423_VTAB "FORMULA_0423_VTAB" TAB_VERB 2 0 "FALSE" 1 "TRUE" DEFAULT_VALUE "TRUE" /end COMPU_VTAB
/begin COMPU_VTAB FORMULA_0424_VTAB "FORMULA_0424_VTAB" TAB_VERB 2 0 "FALSE" 1 "TRUE" DEFAULT_VALUE "TRUE" /end COMPU_VTAB
/begin COMPU_VTAB FORMULA_0425_VTAB "FORMULA_0425_VTAB" TAB_VERB 2 0 "FALSE" 1 "TRUE" DEFAULT_VALUE "TRUE" /end COMPU_VTAB
/begin COMPU_VTAB FORMULA_0426_VTAB "FORMULA_0426_VTAB" TAB_VERB 2 0 "FALSE" 1 "TRUE" DEFAULT_VALUE "TRUE" /end COMPU_VTAB
/begin COMPU_VTAB FORMULA_0427_VTAB "FORMULA_0427_VTAB" TAB_VERB 2 0 "FALSE" 1 "TRUE" DEFAULT_VALUE "TRUE" /end COMPU_VTAB
/begin COMPU_VTAB FORMULA_0428_VTAB "FORMULA_0428_VTAB" TAB_VERB 2 0 "FALSE" 1 "TRUE" DEFAULT_VALUE "TRUE" /end COMPU_VTAB
/begin COMPU_VTAB FORMULA_0429_VTAB "FORMULA_0429_VTAB" TAB_VERB 2 0 "FALSE" 1 "TRUE" DEFAULT_VALUE "TRUE" /end COMPU_VTAB
/begin COMPU_VTAB FORMULA_0430_VTAB "FORMULA_0430_VTAB" TAB_VERB 2 0 "FALSE" 1 "TRUE" DEFAULT_VALUE "TRUE" /end COMPU_VTAB
/begin COMPU_VTAB FORMULA_0608_VTAB "FORMULA_0608_VTAB" TAB_VERB 7 0 "keine" 1 "ACC aktz." 2 "EMF aktz." 3 "HBA aktz." 4 "Verzoegerung" 14 "abgelehnt" 15 "ungueltig" DEFAULT_VALUE "undef" /end COMPU_VTAB
/begin COMPU_VTAB FORMULA_0611_VTAB "FORMULA_0611_VTAB" TAB_VERB 2 0 "Aus" 1 "An" /end COMPU_VTAB
/begin COMPU_VTAB FORMULA_0612_VTAB "FORMULA_0612_VTAB" TAB_VERB 2 0 "unlocked" 1 "locked" DEFAULT_VALUE "undef" /end COMPU_VTAB
/begin COMPU_VTAB FORMULA_0617_VTAB "FORMULA_0617_VTAB" TAB_VERB 5 0 "keine Angabe" 1 "Komfort" 2 "Sport" 5 "Komfort erw." 6 "Sport erw." DEFAULT_VALUE "undef" /end COMPU_VTAB
/begin COMPU_VTAB FORMULA_0618_VTAB "FORMULA_0618_VTAB" TAB_VERB 2 0 "Ausschalten" 1 "Einschalten" DEFAULT_VALUE "undef" /end COMPU_VTAB
/begin COMPU_VTAB FORMULA_0620_VTAB "FORMULA_0620_VTAB" TAB_VERB 4 0 "beide zu" 1 "FAT offen" 2 "BFAT offen" 3 "beide offen" DEFAULT_VALUE "undef" /end COMPU_VTAB
/begin COMPU_VTAB FORMULA_0621_VTAB "FORMULA_0621_VTAB" TAB_VERB 2 0 "Aus" 1 "PTH/Mdrv" DEFAULT_VALUE "undef" /end COMPU_VTAB
/begin COMPU_VTAB FORMULA_0622_VTAB "FORMULA_0622_VTAB" TAB_VERB 2 0 "niO" 1 "ok" /end COMPU_VTAB
/begin COMPU_VTAB FORMULA_0624_VTAB "FORMULA_0624_VTAB" TAB_VERB 4 0 "Aus" 1 "OelAG ein" 2 "iStr" 3 "Oel+iStr" /end COMPU_VTAB
/begin COMPU_VTAB FORMULA_0625_VTAB "FORMULA_0625_VTAB" TAB_VERB 3 5 "EKP an" 10 "EKP aus" 15 "ungueltig" /end COMPU_VTAB
/begin COMPU_VTAB FORMULA_1047_VTAB "FORMULA_1047_VTAB" TAB_VERB 2 0 "absolut" 1 "differenz" DEFAULT_VALUE "ungueltig" /end COMPU_VTAB
/begin COMPU_VTAB FORMULA_1048_VTAB "FORMULA_1048_VTAB" TAB_VERB 2 0 "Modell" 1 "Messwert" DEFAULT_VALUE "ungueltig" /end COMPU_VTAB
/begin COMPU_VTAB FORMULA_1060_VTAB "FORMULA_1060_VTAB" TAB_VERB 1 0 "RF_DYN aus" DEFAULT_VALUE "RF_DYN ein" /end COMPU_VTAB
/begin COMPU_VTAB FORMULA_1061_VTAB "FORMULA_1061_VTAB" TAB_VERB 1 0 "RF_DYN aus" DEFAULT_VALUE "RF_DYN ein" /end COMPU_VTAB
/begin COMPU_VTAB FORMULA_1062_VTAB "FORMULA_1062_VTAB" TAB_VERB 1 0 "RF_DYN aus" DEFAULT_VALUE "RF_DYN ein" /end COMPU_VTAB
/begin COMPU_VTAB FORMULA_1063_VTAB "FORMULA_1063_VTAB" TAB_VERB 1 0 "RF_DYN aus" DEFAULT_VALUE "RF_DYN ein" /end COMPU_VTAB
/begin COMPU_VTAB FORMULA_1064_VTAB "FORMULA_1064_VTAB" TAB_VERB 1 0 "RF_DYN aus" DEFAULT_VALUE "RF_DYN ein" /end COMPU_VTAB
/begin COMPU_VTAB FORMULA_1068_VTAB "FORMULA_1068_VTAB" TAB_VERB 2 0 "RF_DYN aus" 1 "RF_DYN ein" /end COMPU_VTAB
/begin COMPU_VTAB FORMULA_1073_VTAB "FORMULA_1073_VTAB" TAB_VERB 3 1 "Regler-RESET" 2 "Regler aktiv" 4 "Regler inaktiv" /end COMPU_VTAB
/begin COMPU_VTAB FORMULA_1074_VTAB "FORMULA_1074_VTAB" TAB_VERB 5 1 "LAA-RESET" 2 "LAA-AUS" 4 "LAA-F" 8 "LAA-TE-F" 16 "LAA-OFFS" /end COMPU_VTAB
/begin COMPU_VTAB FORMULA_1075_VTAB "FORMULA_1075_VTAB" TAB_VERB 2 0 "kein Fehler" 1 "PKS-Fehler" /end COMPU_VTAB
/begin COMPU_VTAB FORMULA_1077_VTAB "FORMULA_1077_VTAB" TAB_VERB 18 0 "Inaktiv" 1 "Wandfilm" 2 "Lambdaregler" 3 "Lambdaadaption" 4 "Restgas" 5 "Abgasgegendruck" 6 "Ansauglufttemp" 7 "Fahrerwunsch" 8 "Leerlaufregler" 9 "Ionenstrom" 10 "Aussetzer" 11 "Vanoskatheizen" 12 "Motortemperatur" 13 "Kraftstoffdruck" 14 "Lastschlag" 15 "Zylindergleichst." 16 "Tankentlueftung" 17 "Aut. KF-Bedatung" DEFAULT_VALUE "undef" /end COMPU_VTAB
/begin FUNCTION Powermanagement ""
 /begin DEF_CHARACTERISTIC CBATT_DEF CW_BATTCOD CW_CCMASK CW_PMDEFMASK CW_PMMASKDFP K_ABKORROVER K_ABSCHKORA K_APPTBATINI K_BATT_ALFAH K_BATT_ALFAV K_BATT_BETAV K_BATTHTAUVG K_BATTHTAUVK K_BATTINDAPP K_BATTORT0 K_BATTORT2 K_BATTREGAPP K_BATTVTAUVG K_BATTVTAUVK K_BATVFZGTAU K_BILA_OGRZ K_BILA_UGRZ K_CBATTAPP K_CCPRIOSET K_CCPRIOTIME K_CCPWRSET K_CRENGOF K_CRVVTNOT K_CRVVTOF K_CTRCBRA K_CTRCBRAPP K_CTRCBRKBM K_CTRPCOSAPP K_CTRPRIOAPP K_CTRPRIOCF K_CTRPWRCF K_CTRPWRDF K_DAB_KORR1 K_DAB_KORR2 K_DAB_KORR3 K_DF_LP K_DFFILTAPP K_DFKOMMERR K_DFLLMIN K_DFMAX K_DFOVERRIDE K_DFPTC_LP K_DFRUTYP K_DSOCA K_DSOCABSCH K_DSOCHYST K_DSOCHYSTCC K_DSOCLLANH K_DSOCLOW K_DSOCPCOS K_DTANSKOR K_DUDTPTCAUS K_HISTDMERST K_HISTIBSRST K_I_FITAUSW K_IABGLMOT K_IABGLNL K_IABGLST K_IB_COMMVAL K_IBSWAKEAPP K_IGENLLRANH K_IGRDETEC K_IKEINESA K_ILMINUMG K_IPMPMDEC K_IPMPMINC K_IWAKEAPP K_KBMCNT_APP K_KSOGRZAPP K_KSUGRZAPP K_LBATTMAXK K_LBATTMAXM K_LBATTMIN K_LBATTTUMG K_LBATTTUMGBA K_LLANHAPP K_LLPMAPP K_LLPMFILTK K_LLRABS_DF K_LLRANH_DF K_MCOBATTORT K_MN_PTCPI K_MN_PWRDFPI K_MSKIBSDFP K_MSKIBSDFP2 K_MSKIBSDIAG K_MSKIBSERR K_MSKIBSERR2 K_MX_PTCPI K_NKW2HIPTC K_NKW2LOWPTC K_NLLMIN K_NMINUMG K_NTWBGLLGEN K_OFTUMGCAN K_OFULADE K_OSPGAPP K_OSPGHYST K_OSPGPRELLZ K_OSPRELLDEC K_OSPRELLINC K_PLBATTUMG K_PM_IPMON K_PM_TABSMN K_PMQ_UX K_PMTIMERSQ1 K_PMUBAT_MAX K_PMUBAT_MIN K_PMUGEN_MAX K_PMUGEN_MIN K_PRELLDFAH K_PRELLDFRF K_PRIO_R K_PRIO15 K_PRIOCF_R K_PRIOCF15 K_PRIOCFAPP K_PRIODF K_PTC_PI K_PTCPWRAPP K_PWRCOS_R K_PWRCOS15 K_PWRCOSAPP K_PWRCOSHT K_PWRCOSULEV K_PWRCSGNDEF K_PWRCSKOMM K_PWRDF_PI K_Q_BILAPWF K_QSOCCL1 K_QSOCCL2 K_QSOCCL3 K_QSTARTFGA K_RESET_PI K_RIN_GRENZ1 K_RIN_GRENZ2 K_RIN_GRENZ3 K_RIN_GRENZ4 K_RIN_GRENZ5 K_RIN_GRENZ6 K_RIN_GRENZ7 K_RIN_GRENZ8 K_RLEITUNGK K_RLEITUNGM K_RQPCOSA K_RQPCOSAPP K_RQULCP K_RUHVERMODE K_SELSPCOSA K_SELSPCSAPP K_SOC_BILAWA K_SOC_QPWF K_SOC_QUALIA K_SOC_STAFGA K_SOCFITAPP K_SOCFITGRZ K_SOCFITLIMH K_SOCFITLIML K_STPCOSAPP K_T_CCRUHVER K_T_IPMPRIO K_T_KMSHIFT K_T_NKPTCAUS K_T_OSPGRSET K_T_OSPGSET K_T_PMBS K_T_PMVS K_T_PTCKWAN K_T_PTCPI K_T_RUHAUSW K_T_SQSHIFT K_T_SULEVON K_T_USPGRSET K_T_USPGSET K_T1PMINFO K_T2PMINFO K_T3PMINFO K_TBATINIMAN K_TBATNACHL K_TBATTFTAUV K_TBATTTAUFH K_TCODIERPM K_TD_BNMOT K_TD_PMUGEN K_TD_PWRDFPI K_TIME_START K_TIMERDLY K_TRINGSHIFT K_TSAISONFIL K_TSAISPWF K_TUMGINI K_TUMGTAU K_UB_GRENZ K_UBAT_LP K_UBATTNORM K_UBPTC_LP K_UBTAPP K_UBTLOWMAX K_UBTLOWMIN K_UGENNORM K_UIBSAPP K_UKOMPK K_UKOMPM K_ULADE_TAU K_ULEVA K_ULEVAPP K_ULOWSETAPP K_USPGAPP K_USPGHYST K_USPGPRELLZ K_USPRELLDEC K_USPRELLINC K_USTARTGRZ K_USTEPMIN K_VMINUMG KF_DFIGEN1 KF_DFIGEN2 KF_DFIGEN3 KF_DFIGEN4 KF_ELUPWM39 KF_ELUPWM60 KF_IBTSOLL KF_PMRIBAT1 KF_PMRIBAT2 KF_PMRIBAT3 KF_PMRIBAT4 KF_PMRIBAT5 KF_PMRIBAT6 KF_PMRIBAT7 KF_PMRIBAT8 KF_SOC0UBIB KF_SOCLF KF_USOLL KL_BATTLSTR KL_CLASS2IND KL_CLASS2NENN KL_DFPRIO KL_DFPTC KL_DSOCPRIO KL_DSOCPTC KL_DUDTPTC KL_ELSLS KL_ELTEMP39 KL_ELTEMP60 KL_ELUB39 KL_ELUB60 KL_EXPALH KL_EXPALV KL_EXPBETAV KL_FITGRZ KL_I2PTC KL_IABGLMOT KL_IABGLNL KL_IABGLST KL_IREST KL_ISOLLPR KL_ITNSTART KL_LADEKENNL KL_PMSOCVU KL_PRIO2PTC KL_PRIOCF KL_PRIODF KL_PTC KL_PWRCF KL_PWRDF KL_SOC0TEMP KL_SOCPRIO KL_SSOC KL_T2RELMAX KL_T2RELMXRG KL_T3RELMAX KL_T3RELMXRG KL_T4RELMAX KL_T4RELMXRG KL_UB_PTC KL_UBTPRIO KL_UNSTART KL_USOLL KL_UTSTART KL_WUBPTC S_ABSCHK S_BSDKOORD S_BSOCCALC S_DFKOMMERR S_DSOCS S_IPMPTC S_LBATT1 S_LBATT2 S_LBATTAPPL S_N_IDLIBS S_NKWITNSTRT S_PM_TEST1 S_PMMESS S_PMSOCFIT S_PMSTARTQ S_PMSV_HEIZ S_PMSV_KLIMA S_PMSV_LUFT S_PMTABSMN S_PRIOCFENA S_PRIOMANUAL S_PTCKOOR S_PTCMANUAL S_PWRCFENA S_QSTARTFK S_RIN S_SOC_BILA S_SOC_QUAL S_SOCSTAFK S_STARTAW S_UIBS ZK_PMSOC /end DEF_CHARACTERISTIC
 /begin OUT_MEASUREMENT Absch_korr All2ptc Allptcfilt Batt_index Batt_ort Batt_tfil C_battnenn Cbatt_lo Codiercnt Ctrcbr Ctrcbr7 Ctrcbrmem Ctrpcos Ctrpcos7 Ctrpcosmem Ctrprio Ctrprio7 Ctrpriocf Ctrpriocf7 Ctrpriocfm Ctrpriomem Ctrpwrcf Ctrpwrcos Ctrpwrcos7 Ctrpwrdf Ctrpwrmem Ctrpwspcos D_qelad D_qlad D_soc D_socw D_udtptc Df2pi Dfall2pi Dfallpi Dff_filt7 Dfgenfilt Dfpi2ptc Dfprio Dfpt1_2ptc Dfpt1filt Dfpt1ptc Dqelad7 Dqlad7 Dsoc2pi Dsoc2ptc Dudtmul F_dudtptc Fak_ttansel Fak_tubel Fs_pm Gen_dfvorhs I_craweng I_elu_vvt I_eluefter I_elupwm I_eluvfzg I_genrllrah I_gle I_sls Ib_commcnt Ib_commsta Ibs1_errstat Ibs2_errstat Ibs3_errstat Ibsbor_hb Ibsderrs1 Ibsderrs2 Ibspreco2 Ibtdiff Ibtdiff2pi Ibtsoll Ideltaabs Idiff2ptc Igenrest Ikurz_ogrz Ikurz_ugrz Ipmdfprio Isoc0loc Isolldiff Iwakeupgrz Kalevcnt kbmcount Memprio1 Memprio2 Memptc1 Memptc2 N_gsllm N_idlgspec N_idlibs Nnmstart Ospgcnt Ospgprell Ospgstat Pgen2ptc Pgenrest Picntr Pm_klemmstat Pm_tsrdy Pmbscount Pminfo1 Pminfo2 Pmstartsta Pmvscount Priopizw1 Priopizw2 Ptc_pwr Ptc_pwr7 Ptcadd Ptcpizw1 Ptcpizw2 Pwrspmem Q_bila Q_startfgk Qeladold Qeladold7 Qladold Qladold7 Qladzwsp7 Rin_grenzh Rin_start Rqpcos Rqpcos7 Rqpcosmem Selspcos Selspcosme Soc_b_loc Soc_bila Soc_fit Soc_fit_temp Soc_korr Soc_q_kor Soc_q_loc Soc_quali Soc_rel Soc_stfgk Soc_stfgkw St_bgllgen0 St_bgllgen0.B_hysllrah St_dibs0 St_dibs0.B_dibloc1 St_dibs0.B_dibloc2 St_dibs1 St_dibs1.B_ifbsak St_dibs1.B_ifebsak St_dibs1.B_ifuplak St_dibs2 St_dibs2.B_ifisak St_dibs2.B_ifsysak St_dibs2.B_iftempak St_dibs2.B_ifusak St_dibs2.B_ifwugdak St_dibs2.B_ifwuplak St_lbattcal0 St_lbattcal0.B_dly_tbi St_lbattcal0.B_lbatteinih St_lbattcal0.B_lbatteiniv St_lbattcal0.B_lbattenh St_lbattcal0.B_lbattenv St_lbattcal0.B_lbattinit St_pmdiag0 St_pmdiag0.B_ccbtnach St_pmdiag0.B_ccbttdfk St_pmdiag0.B_ccbttknt St_pmdiag0.B_ccpmerr St_pmdiag0.B_ccprio St_pmdiag0.B_codierpm St_pmdiag0.B_pcoschg St_pmdiag0.B_tiefrset St_pmdiag1 St_pmdiag1.B_ccruhver St_pmdiag1.B_histrset St_pmdiag1.B_qelad1step St_pmdiag1.B_ruhverl7 St_pmdiag1.B_sv_ihka St_pmdiag1.B_timer_rst St_pmdiagnv St_pmdiagnv.B_ruhverl St_pmprsv_nv St_pmprsv_nv.B_enwake7 St_pmprsvcalc St_pmprsvcalc.B_gendef St_pmprsvcalc.B_ipmaktiv St_pmprsvcalc.B_ipmtimer St_pmprsvcalc.B_kwdr_old St_pmprsvcalc.B_nkwptcio St_pmprsvcalc.B_ptckoor St_pmprsvcalc.B_ubtlow St_pmprsvcalc.B_uloreset St_pmprsvcalc1 St_pmprsvcalc1.B_dubt St_pmprsvcalc1.B_enwakeup St_pmprsvcalc1.B_limcalc St_pmprsvcalc1.B_notprsv St_pmprsvcalc1.B_pireset St_pmprsvcalc1.B_pmbsdanf St_pmprsvcalc1.B_pmvsdanf St_pmprsvcalc2 St_pmprsvcalc2.B_kwdrise St_pmprsvcalc2.B_pmsulevon St_pmsocalc1 St_pmsocalc1.B_ibspwf_e St_pmsoccalc St_pmsoccalc.B_soc_pwf St_pmsoccalc.B_soccalc St_pmsockor0 St_pmsockor0.B_abschfit St_pmsockor0.B_pm_fit2 St_pmsockor0.B_pm_fit3 St_pmsockor0.B_pmsocini St_pmsockor0.B_q_start St_pmsockor0.B_soc_npl St_pmsocstart_nv0 St_pmsocstart_nv0.B_pmsqrdy St_pmsocstart_nv0.B_pmstartq St_pmsocstart0 St_pmsocstart0.B_pmstart7 St_pmsocstart0.B_resetsta St_pmsocstart0.B_rstdatardy St_pmugencalc St_pmugencalc.B_genclcon Stat_sv_reg Stat_sv_reg1 Stat_sv_reg2 Stpcos Stpcos7 Stpcosmem Svaus T_batstiniv T_batt_ini T_batt_lb T_batt_zw T_batt_zw2 T_batt_zw3 T_battabst T_bnmotakt T_count_dibs1 T_count_dibs2 T_count_dibs3 T_count_dibs4 T_delta T_histsum T_histsummin T_saismem T_saison T_saisonalt T1histshort T1pmcntr T2hist T2histshort T2pmcntr T3hist T3histshort T3pmcntr T4hist T4histshort Tsocloc Tumg_abst Tumg_battab Tumg_dt Tumg_ers Tumg_tp U_gensollm U_grenz U_ibs U_igrdetec U_kompk U_kompm U_lade U_startausw Ub_old Ubatt0 Ubatts2 Ubattsoll Ubattsoll7 Ubdiff Ubdiff2pi Ubdiffilt Ubdiffptc Ubold7 Ubt Ubt7 Ubt7mem Ubt7old Ubtpt12ptc Ubtpt1ptc Udelta Udeltaabs Udeltaabsc Udeltac Uibs7 Ulev Ulevmem Ulow Ulowtimer Uspgcnt Uspgprell Uspgstat Vvt_ib1_2 Vvt_iges Ztagedelta Ztageold Ztagestate /end OUT_MEASUREMENT
/end FUNCTION
/begin FUNCTION PSAU ""
 /begin DEF_CHARACTERISTIC K_PSAU_ADAPT_MAX K_PSAU_ADAPT_MIN K_PSAU_CFG K_PSAU_DIAG_MAX K_PSAU_DIAG_MIN K_PSAU_OFFSET K_PSAU_SENSOR_CFG K_PSAU_STEIGUNG K_PSAU_TAU K_PSAU_WF_DLY KF_PSAU_LLS_MDL_MDRFSOLL KF_PSAU_SR_MDL_MDRFSOLL /end DEF_CHARACTERISTIC
 /begin OUT_MEASUREMENT psau_ad_b1 psau_ad_b2 psau_adapt_b1 psau_adapt_b2 psau_asp_b1 psau_asp_b2 psau_lls_b1 psau_lls_b2 psau_lls_mdl_b1 psau_lls_mdl_b2 psau_mzyl_b1 psau_mzyl_b2 psau_phy_b1 psau_phy_b2 psau_roh_b1 psau_roh_b2 psau_sr_mdl_b1 psau_sr_mdl_b2 psau_wf_b1 psau_wf_b2 psau_wf_ptr_b1 psau_wf_ptr_b2 /end OUT_MEASUREMENT
/end FUNCTION
/begin FUNCTION PTCAN-Interface ""
 /begin DEF_CHARACTERISTIC K_CAN_ALIVE_ERR_MAX K_CAN_CFG K_CAN_CHKSUM_ERR_MAX K_CAN_CLAS_BAT_INIT K_CAN_CRASH_CTR_TOUT K_CAN_ED_TSPERR K_CAN_ED_UB_MIN K_CAN_I_SC_MAX_INIT K_CAN_I_SC_MIN_INIT K_CAN_KEY_NO_MCS K_CAN_QC_VEH_INIT K_CAN_TUMG_MCS /end DEF_CHARACTERISTIC
 /begin OUT_MEASUREMENT can_alive_bedat_cnt can_alive_BedFgr_cnt can_alive_grb_cnt can_alive_grb2_cnt can_alive_grb3_cnt can_alive_klst_cnt can_alive_stkombi_cnt can_alive_TorqReqDKG_cnt can_alive_TorqReqDSC_cnt can_alive_vehmod_cnt can_alive_vfzg_cnt can_atemp_timeout can_ax_timeout can_bedat_s can_bedat_timeout can_bedfgr_timeout can_chksum_bedat_cnt can_chksum_BedFgr_cnt can_chksum_grb_cnt can_chksum_grb2_cnt can_chksum_grb3_cnt can_chksum_klst_cnt can_chksum_TorqReqDKG_cnt can_chksum_TorqReqDSC_cnt can_chksum_vehmod_cnt can_chksum_vfzg_cnt can_clas_bat can_crash_timeout can_ctr_ilicht can_ed_tsperr can_ed_tsperr_kl15 can_ev_repeat can_ev_timer can_fgr_idx can_fgr_v_idx_1 can_fgr_v_idx_2 can_fgr_v_idx_3 can_fst_li can_fst_re can_fst_reserve can_fst_sum can_grb2_timeout can_grb3_timeout can_i_qc_veh can_i_sc_max can_i_sc_min can_kkos_elu can_kkos_timeout can_klst_s_roh can_klst_timeout can_kmst_timeout can_no_key_update can_reichweite can_st_ax can_st_bedat can_st_crash can_st_grb3 can_st_kmst can_st_lrw can_st_statanh can_st_statr can_st_toma can_stat_veh_mod can_statanh_timeout can_statr_timeout can_toma_hl can_toma_hr can_toma_st can_toma_timeout can_toma_vl can_toma_vr can_tuer_st can_v_rad_hl can_v_rad_hr can_v_rad_vl can_v_rad_vr can_v_tacho can_v_vorne can_vehmod_timeout can_verz_st /end OUT_MEASUREMENT
/end FUNCTION
/begin FUNCTION qadc_conf ""
 /begin OUT_MEASUREMENT qadc_check_ccw_adr qadc_check_ccw_st qadc_err_cnt qadc_hfm_ad qadc_hfm_anz_read qadc_hfm_cwp_alt qadc_hfm_last_samples qadc_hfm_no_sample_cnt qadc_hfm_ovr_error_cnt qadc_hfm_phy qadc_hfm_phy_fil qadc_hfm_seg_mw qadc_hfm_sync_cnt_error qadc_lavk_anz_b1 qadc_lavk_anz_b2 qadc_lavk_anz_read qadc_lavk_cwp_alt qadc_lavk_last_samples qadc_lavk_no_sample_cnt qadc_lavk_ovr_error_cnt qadc_lavk_sum_b1 qadc_lavk_sum_b2 qadc_lavk_wrp qadc_lsv_h_st qadc_sync_hfm_zz_upd qadca_unerlaubter_irq /end OUT_MEASUREMENT
/end FUNCTION
/begin FUNCTION RamCheck "" /begin DEF_CHARACTERISTIC K_RAM_CHK_CFG K_RAM_CHK_T /end DEF_CHARACTERISTIC /begin OUT_MEASUREMENT ram_chk_freq ram_chk_rptr /end OUT_MEASUREMENT /end FUNCTION
/begin FUNCTION Restgas ""
 /begin DEF_CHARACTERISTIC K_RG_M_MAX K_RG_M_MIN K_RG_T_UES_AV_MAX K_RG_TABG_FAKTOR K_RG_V_TOTVOLUMEN K_RG_WE_ANZ_SEGM K_RG_X_START KF_RG_STAT KL_RG_PHI_MEAN KL_RG_PRGVO_ASP_OFFSET KL_RG_UES_A_MEAN KL_RG_UES_E_MEAN /end DEF_CHARACTERISTIC
 /begin OUT_MEASUREMENT rg_b1.a_mean_ues rg_b1.e_mean_ues rg_b1.gas_zustand rg_b1.m_av rg_b1.m_ev rg_b1.m_mod rg_b1.m_stat rg_b1.m_tot rg_b1.mdt_av rg_b1.mdt_ev rg_b1.pabg rg_b1.phi_av_mean rg_b1.phi_ev_mean rg_b1.prgvo rg_b1.psau rg_b1.pzyl rg_b1.rho rg_b1.sa_ctr rg_b1.t_ues_av rg_b1.t_ues_ev rg_b1.w_ues_av rg_b1.w_ues_ev rg_b1.x_stat rg_b2.a_mean_ues rg_b2.e_mean_ues rg_b2.gas_zustand rg_b2.m_av rg_b2.m_ev rg_b2.m_mod rg_b2.m_stat rg_b2.m_tot rg_b2.mdt_av rg_b2.mdt_ev rg_b2.pabg rg_b2.phi_av_mean rg_b2.phi_ev_mean rg_b2.prgvo rg_b2.psau rg_b2.pzyl rg_b2.rho rg_b2.sa_ctr rg_b2.t_ues_av rg_b2.t_ues_ev rg_b2.w_ues_av rg_b2.w_ues_ev rg_b2.x_stat /end OUT_MEASUREMENT
/end FUNCTION
/begin FUNCTION RF ""
 /begin DEF_CHARACTERISTIC K_RF_DYN_TAU K_RF_HUBVOLUMEN K_RF_LUFTDICHTE K_RF_ST_LL_RAMP KL_RF_START /end DEF_CHARACTERISTIC
 /begin OUT_MEASUREMENT rf_dyn_la_cnt rf_dyn_o2_cnt rf_dyn_st rf_dyn_st_fplau rf_dyn_st_la rf_dyn_st_la_trim rf_dyn_st_o2 rf_dyn_st_te rf_st_ll_ramp /end OUT_MEASUREMENT
/end FUNCTION
/begin FUNCTION rf_e2 ""
 /begin DEF_CHARACTERISTIC K_RF_E2_DYN_DELTA K_RF_E2_DYN_T K_RF_E2_DYN_TAU K_RF_E2_HFM_TAU K_RF_E2_T_MAX KF_RF_E2_MAX KL_RF_E2_HFM_AD KL_RF_E2_PUMG_KORR KL_RF_E2_TAN_KORR /end DEF_CHARACTERISTIC
 /begin OUT_MEASUREMENT rf_e2_abw_b1 rf_e2_abw_b2 rf_e2_berech rf_e2_dyn rf_e2_dyn_delta rf_e2_dyn_st rf_e2_ml_b1 rf_e2_ml_b2 rf_e2_t_b1 rf_e2_t_b2 /end OUT_MEASUREMENT
/end FUNCTION
/begin FUNCTION rf_pt ""
 /begin DEF_CHARACTERISTIC KF_RF_PT_PUMG_WICHT KL_RF_PT_PUMG_KORR KL_RF_PT_TAN_KORR KL_RF_PT_TANZYL_KORR /end DEF_CHARACTERISTIC
/end FUNCTION
/begin FUNCTION rps "" /begin DEF_CHARACTERISTIC K_RPS_CFG /end DEF_CHARACTERISTIC
 /begin OUT_MEASUREMENT rps_laa_f rps_laa_offs rps_laa_st rps_lam_delta_lim rps_lam_reg_f rps_lam_reg_st rps_lam_soll_offs rps_pks_st rps_rg_1of2_.m_av rps_rg_1of2_.m_ev rps_rg_1of2_.m_mod rps_rg_1of2_.m_tot rps_rg_1of2_.mdt_av rps_rg_1of2_.myzl_ges_psau rps_rg_2of2_.m_av rps_rg_2of2_.m_ev rps_rg_2of2_.m_mod rps_rg_2of2_.m_tot rps_rg_2of2_.mdt_av rps_rg_2of2_.myzl_ges_psau rps_tan rps_tan_zust rps_te_st rps_tetv_freq rps_tetv_mks_zyl rps_tetv_soll rps_tmot rps_van_kh_st rps_van_soll_kh_off rps_wf_mks rps_wf_st rps_zgla_f_zyl rps_zgla_offs_zyl rps_zgla_st rps_zust_allg /end OUT_MEASUREMENT
/end FUNCTION
/begin FUNCTION RTA "" /end FUNCTION
/begin FUNCTION sa_we ""
 /begin DEF_CHARACTERISTIC K_SA_MD_FW_REL_MIN K_SA_MD_HYS K_SA_MD_IND_NE_MAX K_SA_MD_IND_NE_MIN K_SA_MSR_SPERRZEIT K_SA_N_HYS K_SA_TKAT_MIN K_SA_TZ_MIN_HYS K_SA_WE_MD_HYS KF_SA_T_TRIG_MAX KL_SA_N_DYN KL_SA_N_GANG KL_SA_N_HYS_GANG KL_SA_N_TMOT /end DEF_CHARACTERISTIC
 /begin OUT_MEASUREMENT sa_msr_t_sperre sa_n sa_t_sa_trig sa_t_sa_trig_max /end OUT_MEASUREMENT
/end FUNCTION
/begin RECORD_LAYOUT TKF_SW_SW_SW FNC_VALUES 5 SWORD COLUMN_DIR DIRECT AXIS_PTS_X 3 SWORD INDEX_INCR DIRECT AXIS_PTS_Y 4 SWORD INDEX_INCR DIRECT NO_AXIS_PTS_X 1 UBYTE NO_AXIS_PTS_Y 2 UBYTE /end RECORD_LAYOUT
/begin RECORD_LAYOUT TKF_SW_SW_UW FNC_VALUES 5 UWORD COLUMN_DIR DIRECT AXIS_PTS_X 3 SWORD INDEX_INCR DIRECT AXIS_PTS_Y 4 SWORD INDEX_INCR DIRECT NO_AXIS_PTS_X 1 UBYTE NO_AXIS_PTS_Y 2 UBYTE /end RECORD_LAYOUT
/begin RECORD_LAYOUT TKF_SW_UW_UW FNC_VALUES 5 UWORD COLUMN_DIR DIRECT AXIS_PTS_X 3 UWORD INDEX_INCR DIRECT AXIS_PTS_Y 4 SWORD INDEX_INCR DIRECT NO_AXIS_PTS_X 1 UBYTE NO_AXIS_PTS_Y 2 UBYTE /end RECORD_LAYOUT
/begin RECORD_LAYOUT TKF_UB_UB_UB FNC_VALUES 5 UBYTE COLUMN_DIR DIRECT AXIS_PTS_X 3 UBYTE INDEX_INCR DIRECT AXIS_PTS_Y 4 UBYTE INDEX_INCR DIRECT NO_AXIS_PTS_X 1 UBYTE NO_AXIS_PTS_Y 2 UBYTE /end RECORD_LAYOUT
/begin RECORD_LAYOUT TKF_UW_SW_UB FNC_VALUES 5 UBYTE COLUMN_DIR DIRECT AXIS_PTS_X 3 SWORD INDEX_INCR DIRECT AXIS_PTS_Y 4 UWORD INDEX_INCR DIRECT NO_AXIS_PTS_X 1 UBYTE NO_AXIS_PTS_Y 2 UBYTE /end RECORD_LAYOUT
/begin RECORD_LAYOUT TKF_UW_SW_UW FNC_VALUES 5 UWORD COLUMN_DIR DIRECT AXIS_PTS_X 3 SWORD INDEX_INCR DIRECT AXIS_PTS_Y 4 UWORD INDEX_INCR DIRECT NO_AXIS_PTS_X 1 UBYTE NO_AXIS_PTS_Y 2 UBYTE /end RECORD_LAYOUT
/begin RECORD_LAYOUT TKF_UW_UB_UW FNC_VALUES 5 UWORD COLUMN_DIR DIRECT AXIS_PTS_X 3 UBYTE INDEX_INCR DIRECT AXIS_PTS_Y 4 UWORD INDEX_INCR DIRECT NO_AXIS_PTS_X 1 UBYTE NO_AXIS_PTS_Y 2 UBYTE /end RECORD_LAYOUT
/begin RECORD_LAYOUT TKL_SW_VV_SW FNC_VALUES 4 SWORD COLUMN_DIR DIRECT AXIS_PTS_X 3 SWORD INDEX_INCR DIRECT NO_AXIS_PTS_X 1 UBYTE RESERVED 2 BYTE /end RECORD_LAYOUT
/begin RECORD_LAYOUT TKL_SW_VV_UB FNC_VALUES 4 UBYTE COLUMN_DIR DIRECT AXIS_PTS_X 3 SWORD INDEX_INCR DIRECT NO_AXIS_PTS_X 1 UBYTE RESERVED 2 BYTE /end RECORD_LAYOUT
/begin RECORD_LAYOUT TKL_SW_VV_UW FNC_VALUES 4 UWORD COLUMN_DIR DIRECT AXIS_PTS_X 3 SWORD INDEX_INCR DIRECT NO_AXIS_PTS_X 1 UBYTE RESERVED 2 BYTE /end RECORD_LAYOUT
/begin RECORD_LAYOUT TKL_UB_VV_SW FNC_VALUES 4 SWORD COLUMN_DIR DIRECT AXIS_PTS_X 3 UBYTE INDEX_INCR DIRECT NO_AXIS_PTS_X 1 UBYTE RESERVED 2 BYTE /end RECORD_LAYOUT
/begin RECORD_LAYOUT TKL_UB_VV_UB FNC_VALUES 4 UBYTE COLUMN_DIR DIRECT AXIS_PTS_X 3 UBYTE INDEX_INCR DIRECT NO_AXIS_PTS_X 1 UBYTE RESERVED 2 BYTE /end RECORD_LAYOUT
/begin RECORD_LAYOUT TKL_UB_VV_UW FNC_VALUES 4 UWORD COLUMN_DIR DIRECT AXIS_PTS_X 3 UBYTE INDEX_INCR DIRECT NO_AXIS_PTS_X 1 UBYTE RESERVED 2 BYTE /end RECORD_LAYOUT
/begin RECORD_LAYOUT TKL_UW_VV_SW FNC_VALUES 4 SWORD COLUMN_DIR DIRECT AXIS_PTS_X 3 UWORD INDEX_INCR DIRECT NO_AXIS_PTS_X 1 UBYTE RESERVED 2 BYTE /end RECORD_LAYOUT
/begin RECORD_LAYOUT TKL_UW_VV_UB FNC_VALUES 4 UBYTE COLUMN_DIR DIRECT AXIS_PTS_X 3 UWORD INDEX_INCR DIRECT NO_AXIS_PTS_X 1 UBYTE RESERVED 2 BYTE /end RECORD_LAYOUT
/begin RECORD_LAYOUT TKL_UW_VV_UW FNC_VALUES 4 UWORD COLUMN_DIR DIRECT AXIS_PTS_X 3 UWORD INDEX_INCR DIRECT NO_AXIS_PTS_X 1 UBYTE RESERVED 2 BYTE /end RECORD_LAYOUT
/begin RECORD_LAYOUT TKW_VV_VV_SW FNC_VALUES 1 SWORD COLUMN_DIR DIRECT /end RECORD_LAYOUT
/begin RECORD_LAYOUT TKW_VV_VV_UB FNC_VALUES 1 UBYTE COLUMN_DIR DIRECT /end RECORD_LAYOUT
/begin RECORD_LAYOUT TKW_VV_VV_UW FNC_VALUES 1 UWORD COLUMN_DIR DIRECT /end RECORD_LAYOUT
/end MODULE
/end PROJECT
