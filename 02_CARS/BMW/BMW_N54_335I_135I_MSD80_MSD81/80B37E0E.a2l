ASAP2_VERSION 1 41
/begin PROJECT MSD70 "Spray Guided DI-System with Piezo Injectors for 6-Cylinder"
/begin HEADER "_default_HeaderComment" PROJECT_NO _0B /end HEADER
/begin MODULE _default_ModuleName "_default_ModuleLongIdentifier"
/begin MOD_COMMON "_default_ModCommonComment" DEPOSIT ABSOLUTE BYTE_ORDER MSB_LAST ALIGNMENT_BYTE 1 ALIGNMENT_WORD 2 ALIGNMENT_LONG 2 ALIGNMENT_FLOAT32_IEEE 2 ALIGNMENT_FLOAT64_IEEE 4 /end MOD_COMMON
/begin MEASUREMENT Agr_rate_fg "AGR rate frisch gas" UWORD _CNV_R_R_Def_f_uw_b_576_CM 1 100. 0. 99.9984 DISPLAY_IDENTIFIER AGR_RATE_FG ECU_ADDRESS 0xd0006ffa FORMAT "%8.3" /end MEASUREMENT
/begin MEASUREMENT Agr_rate_ig "AGR rate inert gas" UWORD _CNV_R_R_Def_f_uw_b_576_CM 1 100. 0. 99.9984 DISPLAY_IDENTIFIER AGR_RATE_IG ECU_ADDRESS 0xd0006ff8 FORMAT "%8.3" /end MEASUREMENT
/begin MEASUREMENT Agrad "" SWORD _CNV_R_R_Def_f_sw_b_577_CM 1 100. -32. 31.999 DISPLAY_IDENTIFIER AGRAD ECU_ADDRESS 0xd0006f7e FORMAT "%9.4" /end MEASUREMENT
/begin MEASUREMENT Agrreg_diff_in "Reglereingang" SWORD _CNV_R_R_Def_p_sw_q_578_CM 1 100. -1280. 1279.9609 DISPLAY_IDENTIFIER AGRREG_DIFF_IN ECU_ADDRESS 0xd0006f6e FORMAT "%7.2" /end MEASUREMENT
/begin MEASUREMENT Agrreg_diff_lin "Linearisierter Reglereingang" SWORD _CNV_R_R_Def_p_sw_q_578_CM 1 100. -1280. 1279.9609 DISPLAY_IDENTIFIER AGRREG_DIFF_LIN ECU_ADDRESS 0xd0006f6c FORMAT "%7.2" /end MEASUREMENT
/begin MEASUREMENT Agrreg_i "Ps-regler I-Reglerausgang (AGR-Modell)" SWORD _CNV_R_R_Def_f_sw_b_577_CM 1 100. -32. 31.999 DISPLAY_IDENTIFIER AGRREG_I ECU_ADDRESS 0xd0006f9e FORMAT "%9.4" /end MEASUREMENT
/begin MEASUREMENT Agrreg_out "Reglerausgang AGR-Regler" SWORD _CNV_R_R_Def_f_sw_b_577_CM 1 100. -32. 31.999 DISPLAY_IDENTIFIER AGRREG_OUT ECU_ADDRESS 0xd0006f62 FORMAT "%9.4" /end MEASUREMENT
/begin MEASUREMENT Agrreg_p "Ps-regler P-Reglerausgang (AGR-Modell)" SWORD _CNV_R_R_Def_f_sw_b_577_CM 1 100. -32. 31.999 DISPLAY_IDENTIFIER AGRREG_P ECU_ADDRESS 0xd0006fa0 FORMAT "%9.4" /end MEASUREMENT
/begin MEASUREMENT Agrreg_pi "Ps-regler PI-Reglerausgang (AGR-Modell)" SWORD _CNV_R_R_Def_f_sw_b_577_CM 1 100. -32. 31.999 DISPLAY_IDENTIFIER AGRREG_PI ECU_ADDRESS 0xd0006f9c FORMAT "%9.4" /end MEASUREMENT
/begin MEASUREMENT Agrreg_st "Statuswert Agr-Regler" UBYTE _CNV_R_R_Def_dez_sl_575_CM 1 100. 0. 255. DISPLAY_IDENTIFIER AGRREG_ST ECU_ADDRESS 0xd0006f83 FORMAT "%3.0" /end MEASUREMENT
/begin MEASUREMENT Agrreg_tmp "Reglerausgang AGR-Regler" SWORD _CNV_R_R_Def_f_sw_b_577_CM 1 100. -32. 31.999 DISPLAY_IDENTIFIER AGRREG_TMP ECU_ADDRESS 0xd0006f7c FORMAT "%9.4" /end MEASUREMENT
/begin MEASUREMENT Agrregi "Differenzdruck Saugrohr Adaption I-Anteil (AGR-Modell)" UWORD _CNV_R_R_Def_f_uw_b_579_CM 1 100. 0. 1.9999 DISPLAY_IDENTIFIER AGRREGI ECU_ADDRESS 0xd0006f9a FORMAT "%14.5" /end MEASUREMENT
/begin MEASUREMENT Agrregp "Differenzdruck Saugrohr Adaption P-Anteil (AGR-Modell)" UWORD _CNV_R_R_Def_f_uw_b_580_CM 1 100. 0. 63.999 DISPLAY_IDENTIFIER AGRREGP ECU_ADDRESS 0xd0006f98 FORMAT "%9.4" /end MEASUREMENT
/begin MEASUREMENT Arbsp_cnt "Zähler für Anzahl Arbeitsspiele" UBYTE _CNV_R_R_Def_dez_sl_575_CM 1 100. 0. 255. DISPLAY_IDENTIFIER ARBSP_CNT ECU_ADDRESS 0xc0002474 FORMAT "%3.0" /end MEASUREMENT
/begin MEASUREMENT B_nplagr_reset "" UBYTE _CNV_R_R_Def_dez_sl_575_CM 1 100. 0. 255. DISPLAY_IDENTIFIER B_NPLAGR_RESET ECU_ADDRESS 0xc0004391 FORMAT "%3.0" /end MEASUREMENT
/begin MEASUREMENT B_nplpsr_reset "" UBYTE _CNV_R_R_Def_dez_sl_575_CM 1 100. 0. 255. DISPLAY_IDENTIFIER B_NPLPSR_RESET ECU_ADDRESS 0xc0004390 FORMAT "%3.0" /end MEASUREMENT
/begin MEASUREMENT Bszsi "Betriebsstundenzähler" ULONG _CNV_R_R_Def_dez_sl_575_CM 1 100. 0. 4294967295. DISPLAY_IDENTIFIER BSZSI ECU_ADDRESS 0xc00045fa FORMAT "%7.0" /end MEASUREMENT
/begin MEASUREMENT Bsztemp "temporärer Betriebsstundenzähler" UWORD _CNV_R_R_Def_dez_sl_575_CM 1 100. 0. 65535. DISPLAY_IDENTIFIER BSZTEMP ECU_ADDRESS 0xc0004612 FORMAT "%5.0" /end MEASUREMENT
/begin MEASUREMENT Chk16_ibs "Checksumme Parameter aus IBS" UWORD _CNV_R_R_Def_dez_sl_575_CM 1 100. 0. 65535. DISPLAY_IDENTIFIER CHK16_IBS ECU_ADDRESS 0xc0002508 FORMAT "%5.0" /end MEASUREMENT
/begin MEASUREMENT Chkpara "Checksumme Parameter intern" UWORD _CNV_R_R_Def_dez_sl_575_CM 1 100. 0. 65535. DISPLAY_IDENTIFIER CHKPARA ECU_ADDRESS 0xc000250a FORMAT "%5.0" /end MEASUREMENT
/begin MEASUREMENT Comcontrol "Kontrolle Diagnose Modul DIBS" UBYTE _CNV_R_R_Def_dez_sl_575_CM 1 100. 0. 255. DISPLAY_IDENTIFIER COMCONTROL ECU_ADDRESS 0xc00024a9 FORMAT "%3.0" /end MEASUREMENT
/begin MEASUREMENT Dfdp "Primärkennfeld FASTA Generatorauslastung " UWORD _CNV_R_R_Def_dez_sl_575_CM 1 100. 0. 65535. DISPLAY_IDENTIFIER DFDP ECU_ADDRESS 0xc0004614 FORMAT "%5.0" ARRAY_SIZE 16 MATRIX_DIM 16 1 1 /end MEASUREMENT
/begin MEASUREMENT Dfds "Sekundärkennfeld FASTA Generatorauslastung" UBYTE _CNV_R_R_Def_dez_sl_575_CM 1 100. 0. 255. DISPLAY_IDENTIFIER DFDS ECU_ADDRESS 0xc0004600 FORMAT "%3.0" ARRAY_SIZE 16 MATRIX_DIM 16 1 1 /end MEASUREMENT
/begin MEASUREMENT Dffgen_dt "Ableitung Dffgensignal" SWORD _CNV_R_R_Def_dt_sw__603_CM 1 100. -4096. 4095.875 DISPLAY_IDENTIFIER DFFGEN_DT ECU_ADDRESS 0xd00071da FORMAT "%7.2" /end MEASUREMENT
/begin MEASUREMENT Dffgen_f "Gefiltertes Dffgen" UBYTE _CNV_R_R_Def_f_ub_b_602_CM 1 100. 0. 99.60930000000001 DISPLAY_IDENTIFIER DFFGEN_F ECU_ADDRESS 0xd000720c FORMAT "%5.2" /end MEASUREMENT
/begin MEASUREMENT Dla_soll_puls "Differenzlambda für Pulsation" SWORD _CNV_R_R_Def_f_sw_b_607_CM 1 100. -8. 7.9997 DISPLAY_IDENTIFIER DLA_SOLL_PULS ECU_ADDRESS 0xd0007676 FORMAT "%9.4" ARRAY_SIZE 2 MATRIX_DIM 2 1 1 /end MEASUREMENT
/begin MEASUREMENT Dmd_gen_kor "Bedingung: Erhöhung der Zielreserve wenn Ierrdiff zu klein" SWORD _CNV_R_R_Def_m_sw_q_574_CM 1 100. -3276.8 3276.7 DISPLAY_IDENTIFIER DMD_GEN_KOR ECU_ADDRESS 0xd00072ba FORMAT "%7.2" /end MEASUREMENT
/begin MEASUREMENT Dps "Druckdifferenz zwischen Saugrohr und Umgebung" SWORD _CNV_R_R_Def_p_sw_q_578_CM 1 100. -1280. 1279.9609 DISPLAY_IDENTIFIER DPS ECU_ADDRESS 0xd0006ff4 FORMAT "%7.2" /end MEASUREMENT
/begin MEASUREMENT Dpsr_pk "Druckdifferenz, Pulsationskorrektiertwert" SWORD _CNV_R_R_Def_p_sw_q_578_CM 1 100. -1280. 1279.9609 DISPLAY_IDENTIFIER DPSR_PK ECU_ADDRESS 0xd0006f66 FORMAT "%7.2" /end MEASUREMENT
/begin MEASUREMENT Dzw_annm "Referenzwert für B_kftkr" SWORD _CNV_R_R_Def_zw_sw__599_CM 1 100. -50. 60. DISPLAY_IDENTIFIER DZW_ANNM ECU_ADDRESS 0xc0005192 FORMAT "%6.1" /end MEASUREMENT
/begin MEASUREMENT Dzw_anns "Sollausgangswert ohne Berücksichtigung Maximalwert aus Zwkr_mx" SWORD _CNV_R_R_Def_zw_sw__599_CM 1 100. -50. 60. DISPLAY_IDENTIFIER DZW_ANNS ECU_ADDRESS 0xd000712a FORMAT "%6.1" /end MEASUREMENT
/begin MEASUREMENT Dzw_eps "Fehler Lernalgorithmus" FLOAT32_IEEE _CNV_R_R_Def_dez_sl_575_CM 1 100. -1000000000000. 10000000000000. DISPLAY_IDENTIFIER DZW_EPS ECU_ADDRESS 0xc0002476 FORMAT "%14.7" /end MEASUREMENT
/begin MEASUREMENT Dzw_krann "Zündwinkeländerung aus Adaption Klopfregelung" SWORD _CNV_R_R_Def_zw_sw__599_CM 1 100. -50. 60. DISPLAY_IDENTIFIER DZW_KRANN ECU_ADDRESS 0xd0007122 FORMAT "%6.1" /end MEASUREMENT
/begin MEASUREMENT Dzw_krann_hs "Zündwinkeländerung aus Adaption Klopfregelung für Homogen-Schicht-Betrieb" SWORD _CNV_R_R_Def_zw_sw__599_CM 1 100. -50. 60. DISPLAY_IDENTIFIER DZW_KRANN_HS ECU_ADDRESS 0xd0007124 FORMAT "%6.1" /end MEASUREMENT
/begin MEASUREMENT Dzw_mm "Über 100ms gemittelter Wert Zw_diffmkr" SWORD _CNV_R_R_Def_zw_sw__599_CM 1 100. -50. 60. DISPLAY_IDENTIFIER DZW_MM ECU_ADDRESS 0xc000246e FORMAT "%6.1" /end MEASUREMENT
/begin MEASUREMENT Dzw_nn "Lernsollwert für Lolimot-KNN" SWORD _CNV_R_R_Def_zw_sw__599_CM 1 100. -50. 60. DISPLAY_IDENTIFIER DZW_NN ECU_ADDRESS 0xc0002472 FORMAT "%6.1" /end MEASUREMENT
/begin MEASUREMENT Ebsd_adr "EBSD Adresse im IBS" UBYTE _CNV_R_R_Def_dez_sl_575_CM 1 100. 0. 255. DISPLAY_IDENTIFIER EBSD_ADR ECU_ADDRESS 0xc00024fd FORMAT "%3.0" /end MEASUREMENT
/begin MEASUREMENT Ebsd_errdir "EBSD Übertragungsrichtung bei Fehler" UBYTE _CNV_R_R_Def_dez_sl_575_CM 1 100. 0. 255. DISPLAY_IDENTIFIER EBSD_ERRDIR ECU_ADDRESS 0xc00024fe FORMAT "%3.0" /end MEASUREMENT
/begin MEASUREMENT Ebsd_errep "EBSD Fehler repeat timer" UBYTE _CNV_R_R_Def_dez_sl_575_CM 1 100. 0. 255. DISPLAY_IDENTIFIER EBSD_ERREP ECU_ADDRESS 0xc0002500 FORMAT "%3.0" /end MEASUREMENT
/begin MEASUREMENT Ebsd_errin "EBSD Index bei Fehler" UBYTE _CNV_R_R_Def_dez_sl_575_CM 1 100. 0. 255. DISPLAY_IDENTIFIER EBSD_ERRIN ECU_ADDRESS 0xc00024ff FORMAT "%3.0" /end MEASUREMENT
/begin MEASUREMENT Ebsd_nbyt "Länge EBSD Variable" UBYTE _CNV_R_R_Def_dez_sl_575_CM 1 100. 0. 255. DISPLAY_IDENTIFIER EBSD_NBYT ECU_ADDRESS 0xc00024fb FORMAT "%3.0" /end MEASUREMENT
/begin MEASUREMENT Ebsd_timo "EBSD Fehler timeout counter" UBYTE _CNV_R_R_Def_dez_sl_575_CM 1 100. 0. 255. DISPLAY_IDENTIFIER EBSD_TIMO ECU_ADDRESS 0xc0002501 FORMAT "%3.0" /end MEASUREMENT
/begin MEASUREMENT Ebsd_varin "Index EBSD Variable" UBYTE _CNV_R_R_Def_dez_sl_575_CM 1 100. 0. 255. DISPLAY_IDENTIFIER EBSD_VARIN ECU_ADDRESS 0xc00024fa FORMAT "%3.0" /end MEASUREMENT
/begin MEASUREMENT Eta_ges_f "Gesamtwirkungsgrad" SWORD _CNV_R_R_Def_eta_sw_628_CM 1 100. 0. 100. DISPLAY_IDENTIFIER ETA_GES_F ECU_ADDRESS 0xd0007696 FORMAT "%8.3" /end MEASUREMENT
/begin MEASUREMENT Eta_labas "Basis Lambda Wirkungsgrad für Zulieferer" SWORD _CNV_R_R_Def_eta_sw_617_CM 1 100. -200. 199.9938 DISPLAY_IDENTIFIER ETA_LABAS ECU_ADDRESS 0xd0007688 FORMAT "%8.3" /end MEASUREMENT
/begin MEASUREMENT Eta_labas_sol "Basis Lambda Wirkungsgrad für Zulieferer" SWORD _CNV_R_R_Def_eta_sw_617_CM 1 100. -200. 199.9938 DISPLAY_IDENTIFIER ETA_LABAS_SOL ECU_ADDRESS 0xd000768a FORMAT "%8.3" /end MEASUREMENT
/begin MEASUREMENT Eta_laber_h "Berechneter Lambdawirkungsgrad für Homogen nach BMW Def" SWORD _CNV_R_R_Def_eta_sw_617_CM 1 100. -200. 199.9938 DISPLAY_IDENTIFIER ETA_LABER_H ECU_ADDRESS 0xd00076c6 FORMAT "%8.3" /end MEASUREMENT
/begin MEASUREMENT Eta_laber_h1 "Berechneter Lambdawirkungsgrad für Homogen nach BMW Def Bank 1" SWORD _CNV_R_R_Def_eta_sw_617_CM 1 100. -200. 199.9938 DISPLAY_IDENTIFIER ETA_LABER_H1 ECU_ADDRESS 0xd00076c4 FORMAT "%8.3" /end MEASUREMENT
/begin MEASUREMENT Eta_laber_h2 "Berechneter Lambdawirkungsgrad für Homogen nach BMW Def Bank 2" SWORD _CNV_R_R_Def_eta_sw_617_CM 1 100. -200. 199.9938 DISPLAY_IDENTIFIER ETA_LABER_H2 ECU_ADDRESS 0xd00076c2 FORMAT "%8.3" /end MEASUREMENT
/begin MEASUREMENT Eta_lamb_bas "Wirkungsgrad" SWORD _CNV_R_R_Def_eta_sw_617_CM 1 100. -200. 199.9938 DISPLAY_IDENTIFIER ETA_LAMB_BAS ECU_ADDRESS 0xd000769c FORMAT "%8.3" /end MEASUREMENT
/begin MEASUREMENT Eta_lamb_bas1 "Wirkungsgrad" SWORD _CNV_R_R_Def_eta_sw_617_CM 1 100. -200. 199.9938 DISPLAY_IDENTIFIER ETA_LAMB_BAS1 ECU_ADDRESS 0xd00076ac FORMAT "%8.3" /end MEASUREMENT
/begin MEASUREMENT Eta_lamb_bas2 "Wirkungsgrad" SWORD _CNV_R_R_Def_eta_sw_617_CM 1 100. -200. 199.9938 DISPLAY_IDENTIFIER ETA_LAMB_BAS2 ECU_ADDRESS 0xd00076ae FORMAT "%8.3" /end MEASUREMENT
/begin MEASUREMENT Eta_lamb_ist "Ist Lambda Wirkungsgrad im Homogenen nach BMW Def" SWORD _CNV_R_R_Def_eta_sw_617_CM 1 100. -200. 199.9938 DISPLAY_IDENTIFIER ETA_LAMB_IST ECU_ADDRESS 0xd000768e FORMAT "%8.3" /end MEASUREMENT
/begin MEASUREMENT Eta_lamb_ist1 "Ist Lambda Wirkungsgrad im Homogenen nach BMW Def Bank 1" SWORD _CNV_R_R_Def_eta_sw_617_CM 1 100. -200. 199.9938 DISPLAY_IDENTIFIER ETA_LAMB_IST1 ECU_ADDRESS 0xd00076be FORMAT "%8.3" /end MEASUREMENT
/begin MEASUREMENT Eta_lamb_ist2 "Ist Lambda Wirkungsgrad im Homogenen nach BMW Def Bank 2" SWORD _CNV_R_R_Def_eta_sw_617_CM 1 100. -200. 199.9938 DISPLAY_IDENTIFIER ETA_LAMB_IST2 ECU_ADDRESS 0xd00076c0 FORMAT "%8.3" /end MEASUREMENT
/begin MEASUREMENT Eta_lambda "Ist Lambda Wirkungsgrad im Homogenen für den Zulieferer" SWORD _CNV_R_R_Def_eta_sw_617_CM 1 100. -200. 199.9938 DISPLAY_IDENTIFIER ETA_LAMBDA ECU_ADDRESS 0xd0007690 FORMAT "%8.3" /end MEASUREMENT
/begin MEASUREMENT Eta_lambda_1 "Ist Lambda Wirkungsgrad im Homogenen für den Zulieferer Bank 1" SWORD _CNV_R_R_Def_eta_sw_617_CM 1 100. -200. 199.9938 DISPLAY_IDENTIFIER ETA_LAMBDA_1 ECU_ADDRESS 0xd0007692 FORMAT "%8.3" /end MEASUREMENT
/begin MEASUREMENT Eta_lambda_2 "Ist Lambda Wirkungsgrad im Homogenen für den Zulieferer Bank 2" SWORD _CNV_R_R_Def_eta_sw_617_CM 1 100. -200. 199.9938 DISPLAY_IDENTIFIER ETA_LAMBDA_2 ECU_ADDRESS 0xd0007694 FORMAT "%8.3" /end MEASUREMENT
/begin MEASUREMENT Eta_ls_ist "Wirkungsgrad aus Lamda Istwert" SWORD _CNV_R_R_Def_eta_sw_617_CM 1 100. -200. 199.9938 DISPLAY_IDENTIFIER ETA_LS_IST ECU_ADDRESS 0xd00076cc FORMAT "%8.3" /end MEASUREMENT
/begin MEASUREMENT Eta_ls_ist1 "Wirkungsgrad Bank2 aus Lamda Istwert" SWORD _CNV_R_R_Def_eta_sw_617_CM 1 100. -200. 199.9938 DISPLAY_IDENTIFIER ETA_LS_IST1 ECU_ADDRESS 0xd00076ca FORMAT "%8.3" /end MEASUREMENT
/begin MEASUREMENT Eta_ls_ist2 "Wirkungsgrad Bank2 aus Lamda Istwert" SWORD _CNV_R_R_Def_eta_sw_617_CM 1 100. -200. 199.9938 DISPLAY_IDENTIFIER ETA_LS_IST2 ECU_ADDRESS 0xd00076c8 FORMAT "%8.3" /end MEASUREMENT
/begin MEASUREMENT F_agr_kor "Korrekturfaktor AGR-Regler" UWORD _CNV_R_R_Def_f_uw_b_594_CM 1 100. 0. 15.9997 DISPLAY_IDENTIFIER F_AGR_KOR ECU_ADDRESS 0xd0006f8a FORMAT "%9.4" /end MEASUREMENT
/begin MEASUREMENT F_agrad "Überblendfaktor" UBYTE _CNV_R_R_Def_f_ub_b_625_CM 1 100. 0. 1.9921 DISPLAY_IDENTIFIER F_AGRAD ECU_ADDRESS 0xd0006f5e /end MEASUREMENT
/begin MEASUREMENT F_dms2dps "Faktor Deltamassenstroem -> Deltasaugrohrdruck" UWORD _CNV_R_R_Def_f_uw_b_629_CM 1 100. 0. 9.999800000000001 DISPLAY_IDENTIFIER F_DMS2DPS ECU_ADDRESS 0xd0006ff6 FORMAT "%9.4" /end MEASUREMENT
/begin MEASUREMENT F_dms2dps_max "Faktor Deltamassenstroem -> Deltasaugrohrdruck (max)" UWORD _CNV_R_R_Def_f_uw_b_629_CM 1 100. 0. 9.999800000000001 DISPLAY_IDENTIFIER F_DMS2DPS_MAX ECU_ADDRESS 0xd000702a FORMAT "%9.4" /end MEASUREMENT
/begin MEASUREMENT F_dms2dps_ur "Faktor Deltamassenstroem -> Deltasaugrohrdruck (umr)" UWORD _CNV_R_R_Def_f_uw_b_629_CM 1 100. 0. 9.999800000000001 DISPLAY_IDENTIFIER F_DMS2DPS_UR ECU_ADDRESS 0xd0007028 FORMAT "%9.4" /end MEASUREMENT
/begin MEASUREMENT F_psad_ramp "Ramp faktor" UWORD _CNV_R_R_Def_f_uw_b_579_CM 1 100. 0. 1.9999 DISPLAY_IDENTIFIER F_PSAD_RAMP ECU_ADDRESS 0xd0006f86 FORMAT "%14.5" /end MEASUREMENT
/begin MEASUREMENT F_psr_kor "Korrekturfaktor PSR" UWORD _CNV_R_R_Def_f_uw_b_594_CM 1 100. 0. 15.9997 DISPLAY_IDENTIFIER F_PSR_KOR ECU_ADDRESS 0xd0006f8c FORMAT "%9.4" /end MEASUREMENT
/begin MEASUREMENT F_tans0 "Faktor normalisierte Ansaugtemperatur" UWORD _CNV_R_R_Def_f_uw_b_579_CM 1 100. 0. 1.9999 DISPLAY_IDENTIFIER F_TANS0 ECU_ADDRESS 0xd0007026 FORMAT "%14.5" /end MEASUREMENT
/begin MEASUREMENT Fdib_ig "" SWORD _CNV_R_R_Def_i_sw_q_638_CM 1 100. -32768. 32767. DISPLAY_IDENTIFIER FDIB_IG ECU_ADDRESS 0xd00071dc FORMAT "%8.3" /end MEASUREMENT
/begin MEASUREMENT Fsclctr "Hilfszaehler IBS Fehler loeschen" UBYTE _CNV_R_R_Def_dez_sl_575_CM 1 100. 0. 255. DISPLAY_IDENTIFIER FSCLCTR ECU_ADDRESS 0xc0002503 FORMAT "%3.0" /end MEASUREMENT
/begin MEASUREMENT Gen_awnumm "Generatorkennfeldnummer" UBYTE _CNV_R_R_Def_dez_sl_575_CM 1 100. 1. 7. DISPLAY_IDENTIFIER GEN_AWNUMM ECU_ADDRESS 0xc0004610 FORMAT "%3.0" /end MEASUREMENT
/begin MEASUREMENT Gen_dts "Temperaturerhoehung im Generatorstator" SWORD _CNV_R_R_Def_t_sw_q_618_CM 1 100. -3276.8 3276.7 DISPLAY_IDENTIFIER GEN_DTS ECU_ADDRESS 0xc0005196 FORMAT "%6.1" /end MEASUREMENT
/begin MEASUREMENT Gen_feta "Generatorwirkungsgrad Berechnnugsterm" ULONG _CNV_R_R_Def_eta_ul_641_CM 1 100. 1.9073486328125e-006 5000. DISPLAY_IDENTIFIER GEN_FETA ECU_ADDRESS 0xd00071d2 FORMAT "%14.6" /end MEASUREMENT
/begin MEASUREMENT Gen_i_kaltun "DF korrektiert ueber Generatordrehzahl" UBYTE _CNV_R_R_DEZ_436_CM 1 100. 0. 255. DISPLAY_IDENTIFIER GEN_I_KALTUN ECU_ADDRESS 0xc0002356 /end MEASUREMENT
/begin MEASUREMENT Gen_nummer "Erkannte Generatornummer" UBYTE _CNV_R_R_Def_dez_sl_575_CM 1 100. 0. 255. DISPLAY_IDENTIFIER GEN_NUMMER ECU_ADDRESS 0xd000720d FORMAT "%3.0" /end MEASUREMENT
/begin MEASUREMENT Gen_rs "Statorwiderstand" UWORD _CNV_R_R_Def_f_uw_b_591_CM 1 100. 0. 0.9999847412109381 DISPLAY_IDENTIFIER GEN_RS ECU_ADDRESS 0xc00051c8 FORMAT "%14.5" /end MEASUREMENT
/begin MEASUREMENT Gen_spv "Generatorstatorverlustleistung" UWORD _CNV_R_R_Def_f_uw_b_630_CM 1 100. 0. 2047.9687 DISPLAY_IDENTIFIER GEN_SPV ECU_ADDRESS 0xc00051ca FORMAT "%7.2" /end MEASUREMENT
/begin MEASUREMENT Gen_sttemp "Generatorstarttemperatur" SWORD _CNV_R_R_Def_t_sw_q_618_CM 1 100. -3276.8 3276.7 DISPLAY_IDENTIFIER GEN_STTEMP ECU_ADDRESS 0xd00071de FORMAT "%6.1" /end MEASUREMENT
/begin MEASUREMENT Gen_tans "Generatoransauglufttemperatur" SWORD _CNV_R_R_Def_t_sw_q_618_CM 1 100. -3276.8 3276.7 DISPLAY_IDENTIFIER GEN_TANS ECU_ADDRESS 0xd00071e0 FORMAT "%6.1" /end MEASUREMENT
/begin MEASUREMENT Gen_tansend "Generatoransaugluftendwert" SWORD _CNV_R_R_Def_t_sw_q_618_CM 1 100. -3276.8 3276.7 DISPLAY_IDENTIFIER GEN_TANSEND ECU_ADDRESS 0xc0005198 FORMAT "%6.1" /end MEASUREMENT
/begin MEASUREMENT Gen_teta "Wirkungsgrad Generator W*PI temperaturkompensiert" UWORD _CNV_R_R_Def_f_uw_b_604_CM 1 100. 0. 31.9995 DISPLAY_IDENTIFIER GEN_TETA ECU_ADDRESS 0xd00071fc FORMAT "%9.4" /end MEASUREMENT
/begin MEASUREMENT Gen_weta "Wirkungsgrad Generator mit Omega*PI" UWORD _CNV_R_R_Def_f_uw_b_604_CM 1 100. 0. 31.9995 DISPLAY_IDENTIFIER GEN_WETA ECU_ADDRESS 0xd00071fe FORMAT "%9.4" /end MEASUREMENT
/begin MEASUREMENT I_basis "Basis Strombedarf FZG mit SLP" UBYTE _CNV_R_R_DEZ_436_CM 1 100. 0. 255. DISPLAY_IDENTIFIER I_BASIS ECU_ADDRESS 0xd000720e /end MEASUREMENT
/begin MEASUREMENT I_batt "Batteriestrom von IBS gemessen" UWORD _CNV_R_R_Def_i_uw_q_642_CM 1 100. -200. 5042.8 DISPLAY_IDENTIFIER I_BATT ECU_ADDRESS 0xc00024bc FORMAT "%8.3" /end MEASUREMENT
/begin MEASUREMENT I_gen "Generatorstrom" UBYTE _CNV_R_R_DEZ_436_CM 1 100. 0. 255. DISPLAY_IDENTIFIER I_GEN ECU_ADDRESS 0xd00071cc /end MEASUREMENT
/begin MEASUREMENT I_gen_end "Generatorstrom gemessen / gerechnet" UBYTE _CNV_R_R_DEZ_436_CM 1 100. 0. 254. DISPLAY_IDENTIFIER I_GEN_END ECU_ADDRESS 0xd000720f /end MEASUREMENT
/begin MEASUREMENT I_gen_g "Generatorstrom gesamt" UBYTE _CNV_R_R_DEZ_436_CM 1 100. 0. 255. DISPLAY_IDENTIFIER I_GEN_G ECU_ADDRESS 0xd0007210 /end MEASUREMENT
/begin MEASUREMENT I_gen_nafil "Generatorstrom nach Filter" UWORD _CNV_R_R_Def_i_uw_q_646_CM 1 100. 0. 256. DISPLAY_IDENTIFIER I_GEN_NAFIL ECU_ADDRESS 0xd0007200 FORMAT "%8.3" /end MEASUREMENT
/begin MEASUREMENT I_gen_vorfil "Generatorstrom vor Filter" UWORD _CNV_R_R_Def_i_uw_q_646_CM 1 100. 0. 256. DISPLAY_IDENTIFIER I_GEN_VORFIL ECU_ADDRESS 0xd0007202 FORMAT "%8.3" /end MEASUREMENT
/begin MEASUREMENT I_genipol1 "Invers interpolierte Generatorstrom 1. Kennfeld" SWORD _CNV_R_R_Def_i_ub_q_645_CM 1 100. -4096. 4095.875 DISPLAY_IDENTIFIER I_GENIPOL1 ECU_ADDRESS 0xd00071e2 FORMAT "%8.3" /end MEASUREMENT
/begin MEASUREMENT I_genipol2 "Invers interpolierte Generatorstrom 2. Kennfeld" SWORD _CNV_R_R_Def_i_ub_q_645_CM 1 100. -4096. 4095.875 DISPLAY_IDENTIFIER I_GENIPOL2 ECU_ADDRESS 0xd00071e4 FORMAT "%8.3" /end MEASUREMENT
/begin MEASUREMENT I_genipol3 "Invers interpolierte Generatorstrom 3. Kennfeld" SWORD _CNV_R_R_Def_i_ub_q_645_CM 1 100. -4096. 4095.875 DISPLAY_IDENTIFIER I_GENIPOL3 ECU_ADDRESS 0xd00071e6 FORMAT "%8.3" /end MEASUREMENT
/begin MEASUREMENT I_genmax "korrigiertes DF Signal ueber Temperatur, Generatordrehzahl, Generatorspannung" UBYTE _CNV_R_R_DEZ_436_CM 1 100. 0. 255. DISPLAY_IDENTIFIER I_GENMAX ECU_ADDRESS 0xd00071cd /end MEASUREMENT
/begin MEASUREMENT I_gentmp "Temporäre Größe zur Generatorstromberechnung" UWORD _CNV_R_R_Def_i_uw_q_646_CM 1 100. 0. 256. DISPLAY_IDENTIFIER I_GENTMP ECU_ADDRESS 0xd0007204 FORMAT "%8.3" /end MEASUREMENT
/begin MEASUREMENT I_gentp "Temporäre Größe zur Generatorstromberechnung" UWORD _CNV_R_R_Def_i_uw_q_646_CM 1 100. 0. 256. DISPLAY_IDENTIFIER I_GENTP ECU_ADDRESS 0xd0007206 FORMAT "%8.3" /end MEASUREMENT
/begin MEASUREMENT I_gm "Generatormischstrom" UBYTE _CNV_R_R_DEZ_436_CM 1 100. 0. 255. DISPLAY_IDENTIFIER I_GM ECU_ADDRESS 0xd0007211 /end MEASUREMENT
/begin MEASUREMENT I_gvor "Stromwert nach Überblendung" UBYTE _CNV_R_R_DEZ_436_CM 1 100. 0. 255. DISPLAY_IDENTIFIER I_GVOR ECU_ADDRESS 0xd0007212 /end MEASUREMENT
/begin MEASUREMENT I_soc0 "Strom bei Ruhespannungsmessung" SWORD _CNV_R_R_Def_i_sw_q_647_CM 1 100. -655.36 655.34 DISPLAY_IDENTIFIER I_SOC0 ECU_ADDRESS 0xc00024cc FORMAT "%8.3" /end MEASUREMENT
/begin MEASUREMENT I_tnstart "Batteriestrom im Start" UWORD _CNV_R_R_Def_i_uw_q_648_CM 1 100. 0. 1310.7 DISPLAY_IDENTIFIER I_TNSTART ECU_ADDRESS 0xc00024e0 FORMAT "%8.3" /end MEASUREMENT
/begin MEASUREMENT I_vorstart "Batteriestrom vor Start" UWORD _CNV_R_R_Def_i_uw_q_649_CM 1 100. -200. 1110.7 DISPLAY_IDENTIFIER I_VORSTART ECU_ADDRESS 0xc00024de FORMAT "%7.2" /end MEASUREMENT
/begin MEASUREMENT Ib_chk16 "Checksumme EBSD Übertragung aus IBS" UWORD _CNV_R_R_Def_dez_sl_575_CM 1 100. 0. 65535. DISPLAY_IDENTIFIER IB_CHK16 ECU_ADDRESS 0xc0002506 FORMAT "%5.0" /end MEASUREMENT
/begin MEASUREMENT Ib_parlen "Länge IBS Parameterliste" UBYTE _CNV_R_R_Def_dez_sl_575_CM 1 100. 0. 255. DISPLAY_IDENTIFIER IB_PARLEN ECU_ADDRESS 0xc00024b0 FORMAT "%3.0" /end MEASUREMENT
/begin MEASUREMENT Ibhwversi "IBS Hardware Version" UBYTE _CNV_R_R_Def_dez_sl_575_CM 1 100. 0. 255. DISPLAY_IDENTIFIER IBHWVERSI ECU_ADDRESS 0xc00024af FORMAT "%3.0" /end MEASUREMENT
/begin MEASUREMENT Ibs_errors "Fehler Reg. aus IBS gelesen" UBYTE _CNV_R_R_Def_dez_sl_575_CM 1 100. 0. 255. DISPLAY_IDENTIFIER IBS_ERRORS ECU_ADDRESS 0xc00024a4 FORMAT "%3.0" /end MEASUREMENT
/begin MEASUREMENT Ibs_msgind "Index auf EBSD Botschaft" UBYTE _CNV_R_R_Def_dez_sl_575_CM 1 100. 0. 255. DISPLAY_IDENTIFIER IBS_MSGIND ECU_ADDRESS 0xc00024a5 FORMAT "%3.0" /end MEASUREMENT
/begin MEASUREMENT Ibs_msgsta "EBSD Fehler Status" UBYTE _CNV_R_R_Def_dez_sl_575_CM 1 100. 0. 255. DISPLAY_IDENTIFIER IBS_MSGSTA ECU_ADDRESS 0xc00024a6 FORMAT "%3.0" /end MEASUREMENT
/begin MEASUREMENT Ibs_reg5 "IBS Register 5 Var.not used: now St_ibsreg5" UBYTE _CNV_R_R_Def_dez_sl_575_CM 1 100. 0. 255. DISPLAY_IDENTIFIER IBS_REG5 ECU_ADDRESS 0xc00024a3 FORMAT "%3.0" /end MEASUREMENT
/begin MEASUREMENT Ibs_start "Status Statemachine Startup Kommunikation" UBYTE _CNV_R_R_Def_dez_sl_575_CM 1 100. 0. 255. DISPLAY_IDENTIFIER IBS_START ECU_ADDRESS 0xc00024a8 FORMAT "%3.0" /end MEASUREMENT
/begin MEASUREMENT Ibsbclctri "IBS Fehlerzähler" UBYTE _CNV_R_R_Def_dez_sl_575_CM 1 100. 0. 255. DISPLAY_IDENTIFIER IBSBCLCTRI ECU_ADDRESS 0xc00024b2 FORMAT "%3.0" /end MEASUREMENT
/begin MEASUREMENT Ibsborctr "IBS Fehlerzähler" UWORD _CNV_R_R_Def_dez_sl_575_CM 1 100. 0. 65535. DISPLAY_IDENTIFIER IBSBORCTR ECU_ADDRESS 0xc00024c0 FORMAT "%5.0" /end MEASUREMENT
/begin MEASUREMENT Ibsdncsctr "IBS Fehlerzähler download checksum" UBYTE _CNV_R_R_Def_dez_sl_575_CM 1 100. 0. 255. DISPLAY_IDENTIFIER IBSDNCSCTR ECU_ADDRESS 0xc00024b6 FORMAT "%3.0" /end MEASUREMENT
/begin MEASUREMENT Ibseromctr "IBS Fehlerzähler" UBYTE _CNV_R_R_Def_dez_sl_575_CM 1 100. 0. 255. DISPLAY_IDENTIFIER IBSEROMCTR ECU_ADDRESS 0xc00024b3 FORMAT "%3.0" /end MEASUREMENT
/begin MEASUREMENT Ibsiicctri "IBS Fehlerzähler" UBYTE _CNV_R_R_Def_dez_sl_575_CM 1 100. 0. 255. DISPLAY_IDENTIFIER IBSIICCTRI ECU_ADDRESS 0xc00024b1 FORMAT "%3.0" /end MEASUREMENT
/begin MEASUREMENT Ibslvdctr "IBS Fehlerzähler" UWORD _CNV_R_R_Def_dez_sl_575_CM 1 100. 0. 65535. DISPLAY_IDENTIFIER IBSLVDCTR ECU_ADDRESS 0xc00024ba FORMAT "%5.0" /end MEASUREMENT
/begin MEASUREMENT Ibsporctr "IBS Fehlerzähler power on" UWORD _CNV_R_R_Def_dez_sl_575_CM 1 100. 0. 65535. DISPLAY_IDENTIFIER IBSPORCTR ECU_ADDRESS 0xc00024c4 FORMAT "%5.0" /end MEASUREMENT
/begin MEASUREMENT Ibspromctr "IBS Fehlerzähler" UBYTE _CNV_R_R_Def_dez_sl_575_CM 1 100. 0. 255. DISPLAY_IDENTIFIER IBSPROMCTR ECU_ADDRESS 0xc00024b5 FORMAT "%3.0" /end MEASUREMENT
/begin MEASUREMENT Ibsptyctr "IBS Fehlerzähler BSD parity" UWORD _CNV_R_R_Def_dez_sl_575_CM 1 100. 0. 65535. DISPLAY_IDENTIFIER IBSPTYCTR ECU_ADDRESS 0xc00024c6 FORMAT "%5.0" /end MEASUREMENT
/begin MEASUREMENT Ibsramctr "IBS Fehlerzähler" UBYTE _CNV_R_R_Def_dez_sl_575_CM 1 100. 0. 255. DISPLAY_IDENTIFIER IBSRAMCTR ECU_ADDRESS 0xc00024b4 FORMAT "%3.0" /end MEASUREMENT
/begin MEASUREMENT Ibswbase "IBS Software Baseline" UBYTE _CNV_R_R_Def_dez_sl_575_CM 1 100. 0. 255. DISPLAY_IDENTIFIER IBSWBASE ECU_ADDRESS 0xc00024ad FORMAT "%3.0" /end MEASUREMENT
/begin MEASUREMENT Ibswchang "IBS Software Änderungs Status" UBYTE _CNV_R_R_Def_dez_sl_575_CM 1 100. 0. 255. DISPLAY_IDENTIFIER IBSWCHANG ECU_ADDRESS 0xc00024ae FORMAT "%3.0" /end MEASUREMENT
/begin MEASUREMENT Ibswdtctr "IBS Fehlerzähler watchdog" UWORD _CNV_R_R_Def_dez_sl_575_CM 1 100. 0. 65535. DISPLAY_IDENTIFIER IBSWDTCTR ECU_ADDRESS 0xc00024c2 FORMAT "%5.0" /end MEASUREMENT
/begin MEASUREMENT Ierrdiff "Differenz zwischen Ierr und Ierrgrenz" SWORD _CNV_R_R_Def_i_ub_q_645_CM 1 100. -4096. 4095.875 DISPLAY_IDENTIFIER IERRDIFF ECU_ADDRESS 0xd00072bc FORMAT "%8.3" /end MEASUREMENT
/begin MEASUREMENT Ierrgrenz "Grenzerregerstrom" UBYTE _CNV_R_R_Def_i_ub_q_645_CM 1 100. 0. 31.875 DISPLAY_IDENTIFIER IERRGRENZ ECU_ADDRESS 0xd00071ce /end MEASUREMENT
/begin MEASUREMENT Ierrgrenz_ht "Grenzerregerstrom durch Überhitzung Dioden" UBYTE _CNV_R_R_Def_i_ub_q_645_CM 1 100. 0. 31.875 DISPLAY_IDENTIFIER IERRGRENZ_HT ECU_ADDRESS 0xd00071cf /end MEASUREMENT
/begin MEASUREMENT Ierrgrenz_md "Grenzerregerstrom Momentenbasiert" UBYTE _CNV_R_R_Def_i_ub_q_645_CM 1 100. 0. 31.875 DISPLAY_IDENTIFIER IERRGRENZ_MD ECU_ADDRESS 0xd00071d0 /end MEASUREMENT
/begin MEASUREMENT Igenk "Generatorstrom aufsummiert im Sekundentakt" FLOAT32_IEEE _CNV_R_R_Def_dez_sl_575_CM 1 100. -3.40282346638529e+038 3.40282346638529e+038 DISPLAY_IDENTIFIER IGENK ECU_ADDRESS 0xc00045f6 FORMAT "%14.7" /end MEASUREMENT
/begin MEASUREMENT Kf_iu1 "Ausgang Kennfeldipol 1" SWORD _CNV_R_R_Def_i_sw_q_653_CM 1 100. -1024. 1023.9687 DISPLAY_IDENTIFIER KF_IU1 ECU_ADDRESS 0xc0002350 FORMAT "%8.3" /end MEASUREMENT
/begin MEASUREMENT Kf_iu2 "Ausgang Kennfeldipol 2" SWORD _CNV_R_R_Def_i_sw_q_653_CM 1 100. -1024. 1023.9687 DISPLAY_IDENTIFIER KF_IU2 ECU_ADDRESS 0xc0002352 FORMAT "%8.3" /end MEASUREMENT
/begin MEASUREMENT Kf_iu3 "Ausgang Kennfeldipol 3" SWORD _CNV_R_R_Def_i_sw_q_653_CM 1 100. -1024. 1023.9687 DISPLAY_IDENTIFIER KF_IU3 ECU_ADDRESS 0xc0002354 FORMAT "%8.3" /end MEASUREMENT
/begin MEASUREMENT Kh_sum "Anzahl aufgetretener Klopfereignisse" UBYTE _CNV_R_R_Def_dez_sl_575_CM 1 100. 0. 255. DISPLAY_IDENTIFIER KH_SUM ECU_ADDRESS 0xc0002475 FORMAT "%3.0" /end MEASUREMENT
/begin MEASUREMENT Khnn "Klopfhäufigkeit aus Lolimot-KNN" SWORD _CNV_R_R_Def_f_sw_b_597_CM 1 100. -100. 99.9969 DISPLAY_IDENTIFIER KHNN ECU_ADDRESS 0xd0007126 FORMAT "%8.3" /end MEASUREMENT
/begin MEASUREMENT Kl_vsaug_aus "Faktor Deltamassenstroem -> Deltasaugrohrdruck (max)" UWORD _CNV_R_R_Def_f_uw_b_629_CM 1 100. 0. 9.999800000000001 DISPLAY_IDENTIFIER KL_VSAUG_AUS ECU_ADDRESS 0xd000702c FORMAT "%9.4" /end MEASUREMENT
/begin MEASUREMENT Kr_kh "Aktuelle Klopfhäufigkeit aus Mittelwertfilter" SWORD _CNV_R_R_Def_f_sw_b_597_CM 1 100. -100. 99.9969 DISPLAY_IDENTIFIER KR_KH ECU_ADDRESS 0xd0007128 FORMAT "%8.3" /end MEASUREMENT
/begin MEASUREMENT Kr_kh_eps "Fehler Lernalgorithmus KHNN" FLOAT32_IEEE _CNV_R_R_Def_dez_sl_575_CM 1 100. -1000000000000. 10000000000000. DISPLAY_IDENTIFIER KR_KH_EPS ECU_ADDRESS 0xc000247a FORMAT "%14.7" /end MEASUREMENT
/begin MEASUREMENT Krnn_test "Zündwinkeländerung aus Adaption Klopfregelung für Testerabfrage" SWORD _CNV_R_R_Def_zw_sw__599_CM 1 100. -50. 60. DISPLAY_IDENTIFIER KRNN_TEST ECU_ADDRESS 0xc0002470 FORMAT "%6.1" /end MEASUREMENT
/begin MEASUREMENT Kt_ibsstatus "Status BSD Statemachine" UBYTE _CNV_R_R_Def_dez_sl_575_CM 1 100. 0. 255. DISPLAY_IDENTIFIER KT_IBSSTATUS ECU_ADDRESS 0xc00024a7 FORMAT "%3.0" /end MEASUREMENT
/begin MEASUREMENT Ktib_chk16 "Checksumme EBSD Übertragung intern" UWORD _CNV_R_R_Def_dez_sl_575_CM 1 100. 0. 65535. DISPLAY_IDENTIFIER KTIB_CHK16 ECU_ADDRESS 0xc0002504 FORMAT "%5.0" /end MEASUREMENT
/begin MEASUREMENT Ktupcsctr "kt_ibs Fehlerzähler EBSD Checksumme" UWORD _CNV_R_R_Def_dez_sl_575_CM 1 100. 0. 65535. DISPLAY_IDENTIFIER KTUPCSCTR ECU_ADDRESS 0xc00024f0 FORMAT "%5.0" /end MEASUREMENT
/begin MEASUREMENT La_abgas1 "Berechnetes Lambda im Abgas inklusive Durchspülung in sch, hos und hom Bank 1" UWORD _CNV_R_R_Def_f_uw_b_594_CM 1 100. 0. 15.9997 DISPLAY_IDENTIFIER LA_ABGAS1 ECU_ADDRESS 0xd000767a FORMAT "%9.4" /end MEASUREMENT
/begin MEASUREMENT La_abgas2 "Berechnetes Lambda im Abgas inklusive Durchspülung in sch, hos und hom Bank 1" UWORD _CNV_R_R_Def_f_uw_b_594_CM 1 100. 0. 15.9997 DISPLAY_IDENTIFIER LA_ABGAS2 ECU_ADDRESS 0xd000767c FORMAT "%9.4" /end MEASUREMENT
/begin MEASUREMENT La_bas1 "Basis Lambda-Sollwert, Bank 1 (Zulieferer)" UWORD _CNV_R_R_Def_f_uw_b_594_CM 1 100. 0. 15.9997 DISPLAY_IDENTIFIER LA_BAS1 ECU_ADDRESS 0xd000768c FORMAT "%9.4" /end MEASUREMENT
/begin MEASUREMENT La_bas2 "Basis Lambda-Sollwert, Bank 2 (Zulieferer)" UWORD _CNV_R_R_Def_f_uw_b_594_CM 1 100. 0. 15.9997 DISPLAY_IDENTIFIER LA_BAS2 ECU_ADDRESS 0xd0007698 FORMAT "%9.4" /end MEASUREMENT
/begin MEASUREMENT La_ber_h "Lambdawert Homogen berechnet und gemittelt" UWORD _CNV_R_R_Def_f_uw_b_594_CM 1 100. 0. 15.9997 DISPLAY_IDENTIFIER LA_BER_H ECU_ADDRESS 0xd00076ba FORMAT "%9.4" /end MEASUREMENT
/begin MEASUREMENT La_ber_h1 "Lambdawert berechnet Homogen Bank 1" UWORD _CNV_R_R_Def_f_uw_b_594_CM 1 100. 0. 15.9997 DISPLAY_IDENTIFIER LA_BER_H1 ECU_ADDRESS 0xd00076b6 FORMAT "%9.4" /end MEASUREMENT
/begin MEASUREMENT La_ber_h2 "Lambdawert berechnet Homogen Bank 2" UWORD _CNV_R_R_Def_f_uw_b_594_CM 1 100. 0. 15.9997 DISPLAY_IDENTIFIER LA_BER_H2 ECU_ADDRESS 0xd00076b8 FORMAT "%9.4" /end MEASUREMENT
/begin MEASUREMENT La_hom1 "Lambda-Basiswert bei Homogen Bank 1" UWORD _CNV_R_R_Def_f_uw_b_594_CM 1 100. 0. 15.9997 DISPLAY_IDENTIFIER LA_HOM1 ECU_ADDRESS 0xd00076b0 FORMAT "%9.4" /end MEASUREMENT
/begin MEASUREMENT La_hom2 "Lambda-Basiswert bei Homogen Bank 2" UWORD _CNV_R_R_Def_f_uw_b_594_CM 1 100. 0. 15.9997 DISPLAY_IDENTIFIER LA_HOM2 ECU_ADDRESS 0xd00076b2 FORMAT "%9.4" /end MEASUREMENT
/begin MEASUREMENT La_hom_vst1 "LambdaWert aus Lambda Koordinator vorgesteuert Bank 1" UWORD _CNV_R_R_Def_f_uw_b_594_CM 1 100. 0. 15.9997 DISPLAY_IDENTIFIER LA_HOM_VST1 ECU_ADDRESS 0xd00076a8 FORMAT "%9.4" /end MEASUREMENT
/begin MEASUREMENT La_hom_vst2 "LambdaWert aus Lambda Koordinator vorgesteuert Bank 2" UWORD _CNV_R_R_Def_f_uw_b_594_CM 1 100. 0. 15.9997 DISPLAY_IDENTIFIER LA_HOM_VST2 ECU_ADDRESS 0xd00076aa FORMAT "%9.4" /end MEASUREMENT
/begin MEASUREMENT La_ist_mitt "Lambda ist, mittelwerte, gefiltert" UWORD _CNV_R_R_Def_f_uw_b_594_CM 1 100. 0. 15.9997 DISPLAY_IDENTIFIER LA_IST_MITT ECU_ADDRESS 0xd0006ffc FORMAT "%9.4" /end MEASUREMENT
/begin MEASUREMENT La_ref_homm "Lambda-Basiswert bei Homogen mager" UWORD _CNV_R_R_Def_f_uw_b_594_CM 1 100. 0. 15.9997 DISPLAY_IDENTIFIER LA_REF_HOMM ECU_ADDRESS 0xd000769a FORMAT "%9.4" /end MEASUREMENT
/begin MEASUREMENT La_soll "Lambda-Sollwert" UWORD _CNV_R_R_Def_f_uw_b_594_CM 1 100. 0. 15.9997 DISPLAY_IDENTIFIER LA_SOLL ECU_ADDRESS 0xd000767e FORMAT "%9.4" /end MEASUREMENT
/begin MEASUREMENT La_soll1 "Lambda-Sollwert Bank 1" UWORD _CNV_R_R_Def_f_uw_b_594_CM 1 100. 0. 15.9997 DISPLAY_IDENTIFIER LA_SOLL1 ECU_ADDRESS 0xd0007680 FORMAT "%9.4" /end MEASUREMENT
/begin MEASUREMENT La_soll2 "Lambda-Sollwert Bank 2" UWORD _CNV_R_R_Def_f_uw_b_594_CM 1 100. 0. 15.9997 DISPLAY_IDENTIFIER LA_SOLL2 ECU_ADDRESS 0xd0007682 FORMAT "%9.4" /end MEASUREMENT
/begin MEASUREMENT La_soll_h1 "Lambda-Sollwert Bank 1" ULONG _CNV_R_R_Def_f_ul_b_656_CM 1 100. 0. 31.9999 DISPLAY_IDENTIFIER LA_SOLL_H1 ECU_ADDRESS 0xd000769e FORMAT "%14.5" /end MEASUREMENT
/begin MEASUREMENT La_soll_h2 "Lambda-Sollwert Bank 2" ULONG _CNV_R_R_Def_f_ul_b_656_CM 1 100. 0. 31.9999 DISPLAY_IDENTIFIER LA_SOLL_H2 ECU_ADDRESS 0xd00076a2 FORMAT "%14.5" /end MEASUREMENT
/begin MEASUREMENT La_soll_ko1 "LambdaWert aus Lambda Koordinator Bank 1" UWORD _CNV_R_R_Def_f_uw_b_594_CM 1 100. 0. 15.9997 DISPLAY_IDENTIFIER LA_SOLL_KO1 ECU_ADDRESS 0xd0007684 FORMAT "%9.4" /end MEASUREMENT
/begin MEASUREMENT La_soll_ko2 "LambdaWert aus Lambda Koordinator Bank 2" UWORD _CNV_R_R_Def_f_uw_b_594_CM 1 100. 0. 15.9997 DISPLAY_IDENTIFIER LA_SOLL_KO2 ECU_ADDRESS 0xd0007686 FORMAT "%9.4" /end MEASUREMENT
/begin MEASUREMENT La_wup "Lambda Offset bei Warm up" UWORD _CNV_R_R_Def_f_uw_b_594_CM 1 100. 0. 15.9997 DISPLAY_IDENTIFIER LA_WUP ECU_ADDRESS 0xd00076b4 FORMAT "%9.4" /end MEASUREMENT
/begin MEASUREMENT La_wupkor "Lambda Offset bei Warm up über Tmot korrigiert" SWORD _CNV_R_R_Def_f_sw_b_607_CM 1 100. -8. 7.9997 DISPLAY_IDENTIFIER LA_WUPKOR ECU_ADDRESS 0xd00076bc FORMAT "%9.4" /end MEASUREMENT
/begin MEASUREMENT Lolimot_agradaus "" FLOAT32_IEEE _CNV_R_R_Def_dez_sl_575_CM 1 100. -1000000000000. 10000000000000. DISPLAY_IDENTIFIER LOLIMOT_AGRADAUS ECU_ADDRESS 0xc0001b7a FORMAT "%14.7" /end MEASUREMENT
/begin MEASUREMENT Lolimot_agradein "" FLOAT32_IEEE _CNV_R_R_Def_dez_sl_575_CM 1 100. -1000000000000. 10000000000000. DISPLAY_IDENTIFIER LOLIMOT_AGRADEIN ECU_ADDRESS 0xc0001b82 FORMAT "%14.7" /end MEASUREMENT
/begin MEASUREMENT Lolimot_agradlern "" FLOAT32_IEEE _CNV_R_R_Def_dez_sl_575_CM 1 100. -1000000000000. 10000000000000. DISPLAY_IDENTIFIER LOLIMOT_AGRADLERN ECU_ADDRESS 0xc0001b7e FORMAT "%14.7" /end MEASUREMENT
/begin MEASUREMENT Lolimot_psadaus "" FLOAT32_IEEE _CNV_R_R_Def_dez_sl_575_CM 1 100. -1000000000000. 10000000000000. DISPLAY_IDENTIFIER LOLIMOT_PSADAUS ECU_ADDRESS 0xc0001b76 FORMAT "%14.7" /end MEASUREMENT
/begin MEASUREMENT Lolimot_psadein "" FLOAT32_IEEE _CNV_R_R_Def_dez_sl_575_CM 1 100. -1000000000000. 10000000000000. DISPLAY_IDENTIFIER LOLIMOT_PSADEIN ECU_ADDRESS 0xc0001b72 FORMAT "%14.7" /end MEASUREMENT
/begin MEASUREMENT Lolimot_psadlern "" FLOAT32_IEEE _CNV_R_R_Def_dez_sl_575_CM 1 100. -1000000000000. 10000000000000. DISPLAY_IDENTIFIER LOLIMOT_PSADLERN ECU_ADDRESS 0xc0001b6e FORMAT "%14.7" /end MEASUREMENT
/begin MEASUREMENT Lst_turb "Turbinenleistung" UWORD _CNV_R_R_Def_lst_uw_657_CM 1 100. 0. 131070. DISPLAY_IDENTIFIER LST_TURB ECU_ADDRESS 0xd000709a FORMAT "%5.0" /end MEASUREMENT
/begin MEASUREMENT Lst_verd "Verdichterleistung" UWORD _CNV_R_R_Def_lst_uw_657_CM 1 100. 0. 131070. DISPLAY_IDENTIFIER LST_VERD ECU_ADDRESS 0xd000709c FORMAT "%5.0" /end MEASUREMENT
/begin MEASUREMENT Lst_verd_f "Verdichterleistung gefiltert" UWORD _CNV_R_R_Def_lst_uw_657_CM 1 100. 0. 131070. DISPLAY_IDENTIFIER LST_VERD_F ECU_ADDRESS 0xd000709e FORMAT "%5.0" /end MEASUREMENT
/begin MEASUREMENT Mareg_er_agrad "" SWORD _CNV_R_R_Def_f_uw_b_579_CM 1 100. -1. 0.9999 DISPLAY_IDENTIFIER MAREG_ER_AGRAD ECU_ADDRESS 0xd0006f88 FORMAT "%14.5" /end MEASUREMENT
/begin MEASUREMENT Mareg_er_psad "" SWORD _CNV_R_R_Def_f_uw_b_579_CM 1 100. -1. 0.9999 DISPLAY_IDENTIFIER MAREG_ER_PSAD ECU_ADDRESS 0xd0006f84 FORMAT "%14.5" /end MEASUREMENT
/begin MEASUREMENT Md_dmm "Delta Moment pro Rechenraster für Generatorgrenzmoment" SWORD _CNV_R_R_Def_m_sw_q_659_CM 1 100. -327.68 327.67 DISPLAY_IDENTIFIER MD_DMM ECU_ADDRESS 0xd00072be FORMAT "%7.2" /end MEASUREMENT
/begin MEASUREMENT Md_gen_roh "" SWORD _CNV_R_R_Def_m_sw_q_574_CM 1 100. -3276.8 3276.7 DISPLAY_IDENTIFIER MD_GEN_ROH ECU_ADDRESS 0xd00071e8 FORMAT "%7.2" /end MEASUREMENT
/begin MEASUREMENT Md_genfil "gefiltertes Generatormoment absolut" SWORD _CNV_R_R_Def_m_sw_q_574_CM 1 100. -3276.8 3276.7 DISPLAY_IDENTIFIER MD_GENFIL ECU_ADDRESS 0xd00071ea FORMAT "%7.2" /end MEASUREMENT
/begin MEASUREMENT Md_gennm "gefiltertes Generatormoment absolut Ausgang" SWORD _CNV_R_R_Def_m_sw_q_574_CM 1 100. -3276.8 3276.7 DISPLAY_IDENTIFIER MD_GENNM ECU_ADDRESS 0xd00071be FORMAT "%7.2" /end MEASUREMENT
/begin MEASUREMENT Md_gennm_end "temporäre Grösse Generatormomentberechnung" SWORD _CNV_R_R_Def_m_sw_q_574_CM 1 100. -3276.8 3276.7 DISPLAY_IDENTIFIER MD_GENNM_END ECU_ADDRESS 0xd00071ec FORMAT "%7.2" /end MEASUREMENT
/begin MEASUREMENT Md_gennmgg "Generatormoment gefiltert für GEN_GRENZ" SWORD _CNV_R_R_Def_m_sw_q_574_CM 1 100. -3276.8 3276.7 DISPLAY_IDENTIFIER MD_GENNMGG ECU_ADDRESS 0xd00072c0 FORMAT "%7.2" /end MEASUREMENT
/begin MEASUREMENT Md_gennmnofil "Generatormoment ungefiltert" SWORD _CNV_R_R_Def_m_sw_q_574_CM 1 100. -3276.8 3276.7 DISPLAY_IDENTIFIER MD_GENNMNOFIL ECU_ADDRESS 0xd00072b6 FORMAT "%7.2" /end MEASUREMENT
/begin MEASUREMENT Md_gennmtp "Ungefiltertes unkorrigiertes Generatormoment" SWORD _CNV_R_R_Def_m_sw_q_574_CM 1 100. -3276.8 3276.7 DISPLAY_IDENTIFIER MD_GENNMTP ECU_ADDRESS 0xd00071c0 FORMAT "%7.2" /end MEASUREMENT
/begin MEASUREMENT Md_gennmufi "Generatormoment absolut" SWORD _CNV_R_R_Def_m_sw_q_574_CM 1 100. -3276.8 3276.7 DISPLAY_IDENTIFIER MD_GENNMUFI ECU_ADDRESS 0xd00071ee FORMAT "%7.2" /end MEASUREMENT
/begin MEASUREMENT Md_genrel "relatives Generatormoment Ausgang" UWORD _CNV_R_R_Def_f_uw_b_576_CM 1 100. 0. 99.9984 DISPLAY_IDENTIFIER MD_GENREL ECU_ADDRESS 0xd0007208 FORMAT "%8.3" /end MEASUREMENT
/begin MEASUREMENT Md_genvf "relatives Generatordrehmoment" UWORD _CNV_R_R_Def_f_uw_b_576_CM 1 100. 0. 99.9984 DISPLAY_IDENTIFIER MD_GENVF ECU_ADDRESS 0xd00071ca FORMAT "%8.3" /end MEASUREMENT
/begin MEASUREMENT Md_grenz_int "Generatorgrenzmoment aus Integration" SWORD _CNV_R_R_Def_m_sw_q_659_CM 1 100. -327.68 327.67 DISPLAY_IDENTIFIER MD_GRENZ_INT ECU_ADDRESS 0xd00072c2 FORMAT "%7.2" /end MEASUREMENT
/begin MEASUREMENT Md_grenz_kor "Korrigiertes Grenzmoment" SWORD _CNV_R_R_Def_m_sw_q_574_CM 1 100. -3276.8 3276.7 DISPLAY_IDENTIFIER MD_GRENZ_KOR ECU_ADDRESS 0xd00071f0 FORMAT "%7.2" /end MEASUREMENT
/begin MEASUREMENT Md_grenz_res "Generatorgrenzmoment aus Addition der Zielreserve" SWORD _CNV_R_R_Def_m_sw_q_659_CM 1 100. -327.68 327.67 DISPLAY_IDENTIFIER MD_GRENZ_RES ECU_ADDRESS 0xd00072c4 FORMAT "%7.2" /end MEASUREMENT
/begin MEASUREMENT Md_gresziel "Zielreserve für Generator BN i.O." SWORD _CNV_R_R_Def_m_sw_q_659_CM 1 100. -327.68 327.67 DISPLAY_IDENTIFIER MD_GRESZIEL ECU_ADDRESS 0xd00072c6 FORMAT "%7.2" /end MEASUREMENT
/begin MEASUREMENT Md_gresziel2 "Zielreserve für Generator BN n.i.O." SWORD _CNV_R_R_Def_m_sw_q_659_CM 1 100. -327.68 327.67 DISPLAY_IDENTIFIER MD_GRESZIEL2 ECU_ADDRESS 0xd00072c8 FORMAT "%7.2" /end MEASUREMENT
/begin MEASUREMENT Md_greszielkorr "Korrigierte Zielreserve für Generator" SWORD _CNV_R_R_Def_m_sw_q_659_CM 1 100. -327.68 327.67 DISPLAY_IDENTIFIER MD_GRESZIELKORR ECU_ADDRESS 0xd00072ca FORMAT "%7.2" /end MEASUREMENT
/begin MEASUREMENT Md_mgmax "Maximalmoment Generator" SWORD _CNV_R_R_Def_m_sw_q_574_CM 1 100. -3276.8 3276.7 DISPLAY_IDENTIFIER MD_MGMAX ECU_ADDRESS 0xd00072b8 FORMAT "%7.2" /end MEASUREMENT
/begin MEASUREMENT Mrnn_test_pr "Ausgang KNN Psreg" SWORD _CNV_R_R_Def_f_sw_b_608_CM 1 100. -2. 1.9999 DISPLAY_IDENTIFIER MRNN_TEST_PR ECU_ADDRESS 0xc0001b6c FORMAT "%14.5" /end MEASUREMENT
/begin MEASUREMENT Msagrv_fg "Norm. Massenstrom AGR frisch gas" UWORD _CNV_R_R_Def_ms_uw__611_CM 1 100. 0. 2047.9687 DISPLAY_IDENTIFIER MSAGRV_FG ECU_ADDRESS 0xd0007010 FORMAT "%8.3" /end MEASUREMENT
/begin MEASUREMENT Msagrv_ig "Norm. Massenstrom AGR inert gas" UWORD _CNV_R_R_Def_ms_uw__611_CM 1 100. 0. 2047.9687 DISPLAY_IDENTIFIER MSAGRV_IG ECU_ADDRESS 0xd000700e FORMAT "%8.3" /end MEASUREMENT
/begin MEASUREMENT Msdksr "Massenstrom DK fuer Saugrohr" UWORD _CNV_R_R_Def_ms_uw__611_CM 1 100. 0. 2047.9687 DISPLAY_IDENTIFIER MSDKSR ECU_ADDRESS 0xd0007012 FORMAT "%8.3" /end MEASUREMENT
/begin MEASUREMENT Msdksr_bersr "Massenstrom DK fuer Saugrohr Wert für EISY_SR Berechnung" UWORD _CNV_R_R_Def_ms_uw__611_CM 1 100. 0. 2047.9687 DISPLAY_IDENTIFIER MSDKSR_BERSR ECU_ADDRESS 0xd0007022 FORMAT "%8.3" /end MEASUREMENT
/begin MEASUREMENT Mssr_diff "Massenstrom differenz" SWORD _CNV_R_R_Def_ms_uw__611_CM 1 100. -1024. 1023.9687 DISPLAY_IDENTIFIER MSSR_DIFF ECU_ADDRESS 0xd0007014 FORMAT "%8.3" /end MEASUREMENT
/begin MEASUREMENT Mssrzu "Massenstrom zum Saugrohr" SWORD _CNV_R_R_Def_ms_uw__611_CM 1 100. -1024. 1023.9687 DISPLAY_IDENTIFIER MSSRZU ECU_ADDRESS 0xd0007016 FORMAT "%8.3" /end MEASUREMENT
/begin MEASUREMENT Msverd "Verdichtermassenstrom" UWORD _CNV_R_R_Def_ms_uw__611_CM 1 100. 0. 2047.9687 DISPLAY_IDENTIFIER MSVERD ECU_ADDRESS 0xd0007098 FORMAT "%8.3" /end MEASUREMENT
/begin MEASUREMENT Mszyl_bersr "Massenstrom Zylinder Wert für EISY_SR Berechnung" UWORD _CNV_R_R_Def_ms_uw__611_CM 1 100. 0. 2047.9687 DISPLAY_IDENTIFIER MSZYL_BERSR ECU_ADDRESS 0xd0007024 FORMAT "%8.3" /end MEASUREMENT
/begin MEASUREMENT N_gen "Generatordrehzahl" SWORD _CNV_R_R_Def_n_sw_q_612_CM 1 100. 0. 32767. DISPLAY_IDENTIFIER N_GEN ECU_ADDRESS 0xd00071c2 FORMAT "%5.0" /end MEASUREMENT
/begin MEASUREMENT N_gen_tmp "Temporäre Generatordrehzahl" SWORD _CNV_R_R_Def_n_sw_q_612_CM 1 100. 0. 32767. DISPLAY_IDENTIFIER N_GEN_TMP ECU_ADDRESS 0xd00071c4 FORMAT "%5.0" /end MEASUREMENT
/begin MEASUREMENT Nelueft_gen "Drehzahlanforderung E-Lüfter Generator" UBYTE _CNV_R_R_Def_f_ub_b_602_CM 1 100. 0. 99.60930000000001 DISPLAY_IDENTIFIER NELUEFT_GEN ECU_ADDRESS 0xc0005195 FORMAT "%5.2" /end MEASUREMENT
/begin MEASUREMENT Nkw_s "Motordrehzahl U/s" SWORD _CNV_R_R_Def_n_sw_q_612_CM 1 100. -32768. 32767. DISPLAY_IDENTIFIER NKW_S ECU_ADDRESS 0xd00071f2 FORMAT "%5.0" /end MEASUREMENT
/begin MEASUREMENT P_gen_ab "elektrische Generatorleistung" ULONG _CNV_R_R_Def_f_uw_b_630_CM 1 100. 0. 4096. DISPLAY_IDENTIFIER P_GEN_AB ECU_ADDRESS 0xd00071d6 FORMAT "%10.3" /end MEASUREMENT
/begin MEASUREMENT P_totdiode "Verlustleistung der Diode" UWORD _CNV_R_R_Def_f_uw_b_632_CM 1 100. 0. 255.996 DISPLAY_IDENTIFIER P_TOTDIODE ECU_ADDRESS 0xc00051cc FORMAT "%8.3" /end MEASUREMENT
/begin MEASUREMENT Pr_ms_fak "Druckreglerausgang, Faktor" UWORD _CNV_R_R_Def_f_uw_b_579_CM 1 100. 0. 1.9999 DISPLAY_IDENTIFIER PR_MS_FAK ECU_ADDRESS 0xd0006f72 FORMAT "%14.5" /end MEASUREMENT
/begin MEASUREMENT Pr_ms_off "Druckreglerausgang, Offset" SWORD _CNV_R_R_Def_ms_uw__611_CM 1 100. -1024. 1023.9687 DISPLAY_IDENTIFIER PR_MS_OFF ECU_ADDRESS 0xd0006f74 FORMAT "%8.3" /end MEASUREMENT
/begin MEASUREMENT Pr_msagr_fak "Druckreglerausgang, Faktor" UWORD _CNV_R_R_Def_f_uw_b_604_CM 1 100. 0. 31.9995 DISPLAY_IDENTIFIER PR_MSAGR_FAK ECU_ADDRESS 0xd0006f70 FORMAT "%9.4" /end MEASUREMENT
/begin MEASUREMENT Ps "Absolut Druck im Saugrohr" UWORD _CNV_R_R_Def_p_sw_q_578_CM 1 100. 0. 2559.9609 DISPLAY_IDENTIFIER PS ECU_ADDRESS 0xd0006ff2 FORMAT "%7.2" /end MEASUREMENT
/begin MEASUREMENT Ps_alt "Druck im Saugrohr alt" UWORD _CNV_R_R_Def_p_sw_q_578_CM 1 100. 0. 2559.9609 DISPLAY_IDENTIFIER PS_ALT ECU_ADDRESS 0xd000701c FORMAT "%7.2" /end MEASUREMENT
/begin MEASUREMENT Ps_diff "Differenz Druck im Saugrohr" SWORD _CNV_R_R_Def_p_sw_q_578_CM 1 100. -1280. 1279.9609 DISPLAY_IDENTIFIER PS_DIFF ECU_ADDRESS 0xd0007018 FORMAT "%7.2" /end MEASUREMENT
/begin MEASUREMENT Ps_f "Absolut Druck im Saugrohr (gefiltert)" UWORD _CNV_R_R_Def_p_sw_q_578_CM 1 100. 0. 2559.9609 DISPLAY_IDENTIFIER PS_F ECU_ADDRESS 0xd0006fa2 FORMAT "%7.2" /end MEASUREMENT
/begin MEASUREMENT Ps_int "Differenz Druck im Saugrohr intern" UWORD _CNV_R_R_Def_p_sw_q_578_CM 1 100. 0. 2559.9609 DISPLAY_IDENTIFIER PS_INT ECU_ADDRESS 0xd000701a FORMAT "%7.2" /end MEASUREMENT
/begin MEASUREMENT Ps_ist "Delta Differenzdruck Saugrohr" UWORD _CNV_R_R_Def_p_sw_q_578_CM 1 100. 0. 2559.9609 DISPLAY_IDENTIFIER PS_IST ECU_ADDRESS 0xd0006f64 FORMAT "%7.2" /end MEASUREMENT
/begin MEASUREMENT Ps_mx "Maximal möglicher Druck" UWORD _CNV_R_R_Def_p_sw_q_578_CM 1 100. 0. 2559.9609 DISPLAY_IDENTIFIER PS_MX ECU_ADDRESS 0xd000701e FORMAT "%7.2" /end MEASUREMENT
/begin MEASUREMENT Ps_ok "Druck im Saugrohr nicht korrigiert" UWORD _CNV_R_R_Def_p_sw_q_578_CM 1 100. 0. 2559.9609 DISPLAY_IDENTIFIER PS_OK ECU_ADDRESS 0xd0007020 FORMAT "%7.2" /end MEASUREMENT
/begin MEASUREMENT Psad "" SWORD _CNV_R_R_Def_f_sw_b_608_CM 1 100. -2. 1.9999 DISPLAY_IDENTIFIER PSAD ECU_ADDRESS 0xd0006f80 FORMAT "%14.5" /end MEASUREMENT
/begin MEASUREMENT Psagr_fg "Druck Frisch-Gas" ULONG _CNV_R_R_Def_p_ul_b_689_CM 1 100. 0. 2559.9999 DISPLAY_IDENTIFIER PSAGR_FG ECU_ADDRESS 0xd0007002 FORMAT "%11.4" /end MEASUREMENT
/begin MEASUREMENT Psagr_fg_diff "Druckdifferenz AGR frisch gas" SLONG _CNV_R_R_Def_p_ul_b_689_CM 1 100. -1280. 1279.9999 DISPLAY_IDENTIFIER PSAGR_FG_DIFF ECU_ADDRESS 0xd000700a FORMAT "%11.4" /end MEASUREMENT
/begin MEASUREMENT Psagr_ig "Druck Inert-Gas" ULONG _CNV_R_R_Def_p_ul_b_689_CM 1 100. 0. 2559.9999 DISPLAY_IDENTIFIER PSAGR_IG ECU_ADDRESS 0xd0006ffe FORMAT "%11.4" /end MEASUREMENT
/begin MEASUREMENT Psagr_ig_diff "Druckdifferenz AGR inert gas" SLONG _CNV_R_R_Def_p_ul_b_689_CM 1 100. -1280. 1279.9999 DISPLAY_IDENTIFIER PSAGR_IG_DIFF ECU_ADDRESS 0xd0007006 FORMAT "%11.4" /end MEASUREMENT
/begin MEASUREMENT Psreg_diff "Delta Differenzdruck Saugrohr" SWORD _CNV_R_R_Def_p_sw_q_578_CM 1 100. -1280. 1279.9609 DISPLAY_IDENTIFIER PSREG_DIFF ECU_ADDRESS 0xd0006f8e FORMAT "%7.2" /end MEASUREMENT
/begin MEASUREMENT Psreg_diff_in "Reglereingang" SWORD _CNV_R_R_Def_p_sw_q_578_CM 1 100. -1280. 1279.9609 DISPLAY_IDENTIFIER PSREG_DIFF_IN ECU_ADDRESS 0xd0006f6a FORMAT "%7.2" /end MEASUREMENT
/begin MEASUREMENT Psreg_diff_lin "Linearisierter Reglereingang" SWORD _CNV_R_R_Def_p_sw_q_578_CM 1 100. -1280. 1279.9609 DISPLAY_IDENTIFIER PSREG_DIFF_LIN ECU_ADDRESS 0xd0006f68 FORMAT "%7.2" /end MEASUREMENT
/begin MEASUREMENT Psreg_i "Ps-regler I-Reglerausgang" SWORD _CNV_R_R_Def_f_sw_b_608_CM 1 100. -2. 1.9999 DISPLAY_IDENTIFIER PSREG_I ECU_ADDRESS 0xd0006f94 FORMAT "%14.5" /end MEASUREMENT
/begin MEASUREMENT Psreg_out "Reglerausgang PS-Regler" SWORD _CNV_R_R_Def_f_sw_b_608_CM 1 100. -2. 1.9999 DISPLAY_IDENTIFIER PSREG_OUT ECU_ADDRESS 0xd0006f60 FORMAT "%14.5" /end MEASUREMENT
/begin MEASUREMENT Psreg_p "Ps-regler P-Reglerausgang" SWORD _CNV_R_R_Def_f_sw_b_608_CM 1 100. -2. 1.9999 DISPLAY_IDENTIFIER PSREG_P ECU_ADDRESS 0xd0006f96 FORMAT "%14.5" /end MEASUREMENT
/begin MEASUREMENT Psreg_pi "Ps-regler PI-Reglerausgang" SWORD _CNV_R_R_Def_f_sw_b_608_CM 1 100. -2. 1.9999 DISPLAY_IDENTIFIER PSREG_PI ECU_ADDRESS 0xd0006f92 FORMAT "%14.5" /end MEASUREMENT
/begin MEASUREMENT Psreg_st "Statuswert Ps-Regler" UBYTE _CNV_R_R_Def_dez_sl_575_CM 1 100. 0. 255. DISPLAY_IDENTIFIER PSREG_ST ECU_ADDRESS 0xd0006f82 FORMAT "%3.0" /end MEASUREMENT
/begin MEASUREMENT Psreg_tmp "Reglerausgang PS-Regler" SWORD _CNV_R_R_Def_f_sw_b_608_CM 1 100. -2. 1.9999 DISPLAY_IDENTIFIER PSREG_TMP ECU_ADDRESS 0xd0006f78 FORMAT "%14.5" /end MEASUREMENT
/begin MEASUREMENT Psregi "Differenzdruck Saugrohr Adaption I-Anteil" UWORD _CNV_R_R_Def_f_uw_b_579_CM 1 100. 0. 1.9999 DISPLAY_IDENTIFIER PSREGI ECU_ADDRESS 0xd0006f7a FORMAT "%14.5" /end MEASUREMENT
/begin MEASUREMENT Psregms_out "Druckreglerausgang, MS Normalisiert" SWORD _CNV_R_R_Def_ms_uw__611_CM 1 100. -1024. 1023.9687 DISPLAY_IDENTIFIER PSREGMS_OUT ECU_ADDRESS 0xd0006f76 FORMAT "%8.3" /end MEASUREMENT
/begin MEASUREMENT Psregp "Differenzdruck Saugrohr Adaption P-Anteil" UWORD _CNV_R_R_Def_f_uw_b_580_CM 1 100. 0. 63.999 DISPLAY_IDENTIFIER PSREGP ECU_ADDRESS 0xd0006f90 FORMAT "%9.4" /end MEASUREMENT
/begin MEASUREMENT Qelad "Delta Batterieentladung" UWORD _CNV_R_R_Def_ql_uw__596_CM 1 100. 0. 1192.7502 DISPLAY_IDENTIFIER QELAD ECU_ADDRESS 0xc00024ca FORMAT "%8.3" /end MEASUREMENT
/begin MEASUREMENT Qeladsoc0 "Entladung bei Ruhespannungsmessung" UWORD _CNV_R_R_Def_ql_uw__596_CM 1 100. 0. 1192.7502 DISPLAY_IDENTIFIER QELADSOC0 ECU_ADDRESS 0xc00024d8 FORMAT "%8.3" /end MEASUREMENT
/begin MEASUREMENT Qlad "Delta Batterieladung" UWORD _CNV_R_R_Def_ql_uw__596_CM 1 100. 0. 1192.7502 DISPLAY_IDENTIFIER QLAD ECU_ADDRESS 0xc00024c8 FORMAT "%8.3" /end MEASUREMENT
/begin MEASUREMENT Qladsoc0 "Ladung bei Ruhespannungsmessung" UWORD _CNV_R_R_Def_ql_uw__596_CM 1 100. 0. 1192.7502 DISPLAY_IDENTIFIER QLADSOC0 ECU_ADDRESS 0xc00024d6 FORMAT "%8.3" /end MEASUREMENT
/begin MEASUREMENT R5cyctim "Timer f. zyklisches Senden IBS Reg. 5" UBYTE _CNV_R_R_Def_dez_sl_575_CM 1 100. 0. 255. DISPLAY_IDENTIFIER R5CYCTIM ECU_ADDRESS 0xc0002502 FORMAT "%3.0" /end MEASUREMENT
/begin MEASUREMENT Snibs "Seriennummer" ULONG _CNV_R_R_Def_dez_sl_575_CM 1 100. 0. 4294967295. DISPLAY_IDENTIFIER SNIBS ECU_ADDRESS 0xc00024f6 FORMAT "%7.0" /end MEASUREMENT
/begin MEASUREMENT St_eisy_agrreg "Statuswort" UBYTE _CNV_R_R_Def_dez_sl_575_CM 1 100. 0. 255. DISPLAY_IDENTIFIER ST_EISY_AGRREG ECU_ADDRESS 0xd0006f5d FORMAT "%3.0" /end MEASUREMENT
/begin MEASUREMENT St_eisy_agrreg.B_agrad_akt "Statuswort" UBYTE _CNV_S_2_Def_bit_ub_703_CM 1 100. 0. 8. DISPLAY_IDENTIFIER B_AGRAD_AKT ECU_ADDRESS 0xd0006f5d BIT_MASK 0x8 /end MEASUREMENT
/begin MEASUREMENT St_eisy_agrreg.B_agradges_mn "Statuswort" UBYTE _CNV_S_2_Def_bit_ub_702_CM 1 100. 0. 4. DISPLAY_IDENTIFIER B_AGRADGES_MN ECU_ADDRESS 0xd0006f5d BIT_MASK 0x4 /end MEASUREMENT
/begin MEASUREMENT St_eisy_agrreg.B_agradges_mx "Statuswort" UBYTE _CNV_S_2_Def_bit_ub_701_CM 1 100. 0. 2. DISPLAY_IDENTIFIER B_AGRADGES_MX ECU_ADDRESS 0xd0006f5d BIT_MASK 0x2 /end MEASUREMENT
/begin MEASUREMENT St_eisy_agrreg.B_agrreg_akt "Statuswort" UBYTE _CNV_S_2_Def_bit_ub_700_CM 1 100. 0. 1. DISPLAY_IDENTIFIER B_AGRREG_AKT ECU_ADDRESS 0xd0006f5d BIT_MASK 0x1 /end MEASUREMENT
/begin MEASUREMENT St_eisy_agrreg.B_agrreg_off "Statuswort" UBYTE _CNV_S_2_Def_bit_ub_704_CM 1 100. 0. 16. DISPLAY_IDENTIFIER B_AGRREG_OFF ECU_ADDRESS 0xd0006f5d BIT_MASK 0x10 /end MEASUREMENT
/begin MEASUREMENT St_eisy_agrreg.B_agrregi_mn "Statuswort" UBYTE _CNV_S_2_Def_bit_ub_706_CM 1 100. 0. 64. DISPLAY_IDENTIFIER B_AGRREGI_MN ECU_ADDRESS 0xd0006f5d BIT_MASK 0x40 /end MEASUREMENT
/begin MEASUREMENT St_eisy_agrreg.B_agrregi_mx "Statuswort" UBYTE _CNV_S_2_Def_bit_ub_705_CM 1 100. 0. 32. DISPLAY_IDENTIFIER B_AGRREGI_MX ECU_ADDRESS 0xd0006f5d BIT_MASK 0x20 /end MEASUREMENT
/begin MEASUREMENT St_eisy_psreg "Statuswort" UBYTE _CNV_R_R_Def_dez_sl_575_CM 1 100. 0. 255. DISPLAY_IDENTIFIER ST_EISY_PSREG ECU_ADDRESS 0xd0006f5c FORMAT "%3.0" /end MEASUREMENT
/begin MEASUREMENT St_eisy_psreg.B_pddssmn "Bedingung Adaption Differenzdruck auf unterer Schwelle" UBYTE _CNV_S_2_Def_bit_ub_700_CM 1 100. 0. 1. DISPLAY_IDENTIFIER B_PDDSSMN ECU_ADDRESS 0xd0006f5c BIT_MASK 0x1 /end MEASUREMENT
/begin MEASUREMENT St_eisy_psreg.B_pddssmx "Bedingung Adaption Differenzdruck auf oberer Schwelle" UBYTE _CNV_S_2_Def_bit_ub_701_CM 1 100. 0. 2. DISPLAY_IDENTIFIER B_PDDSSMX ECU_ADDRESS 0xd0006f5c BIT_MASK 0x2 /end MEASUREMENT
/begin MEASUREMENT St_eisy_psreg.B_psad_akt "Statuswort" UBYTE _CNV_S_2_Def_bit_ub_704_CM 1 100. 0. 16. DISPLAY_IDENTIFIER B_PSAD_AKT ECU_ADDRESS 0xd0006f5c BIT_MASK 0x10 /end MEASUREMENT
/begin MEASUREMENT St_eisy_psreg.B_psadges_mn "Statuswort" UBYTE _CNV_S_2_Def_bit_ub_705_CM 1 100. 0. 32. DISPLAY_IDENTIFIER B_PSADGES_MN ECU_ADDRESS 0xd0006f5c BIT_MASK 0x20 /end MEASUREMENT
/begin MEASUREMENT St_eisy_psreg.B_psadges_mx "Statuswort" UBYTE _CNV_S_2_Def_bit_ub_706_CM 1 100. 0. 64. DISPLAY_IDENTIFIER B_PSADGES_MX ECU_ADDRESS 0xd0006f5c BIT_MASK 0x40 /end MEASUREMENT
/begin MEASUREMENT St_eisy_psreg.B_psreg_akt "Bedingung Druckregler freigegeben" UBYTE _CNV_S_2_Def_bit_ub_703_CM 1 100. 0. 8. DISPLAY_IDENTIFIER B_PSREG_AKT ECU_ADDRESS 0xd0006f5c BIT_MASK 0x8 /end MEASUREMENT
/begin MEASUREMENT St_eisy_psreg.B_psreg_off "Bedingung Druckregler ausgeschalten" UBYTE _CNV_S_2_Def_bit_ub_702_CM 1 100. 0. 4. DISPLAY_IDENTIFIER B_PSREG_OFF ECU_ADDRESS 0xd0006f5c BIT_MASK 0x4 /end MEASUREMENT
/begin MEASUREMENT St_eisysr "Statuswort Eisy_sr" UBYTE _CNV_R_R_Def_dez_sl_575_CM 1 100. 0. 255. DISPLAY_IDENTIFIER ST_EISYSR ECU_ADDRESS 0xd0006ff0 FORMAT "%3.0" /end MEASUREMENT
/begin MEASUREMENT St_eisysr.B_psintmx "Bedingung PS Berechnung in Begrenzung" UBYTE _CNV_S_2_Def_bit_ub_700_CM 1 100. 0. 1. DISPLAY_IDENTIFIER B_PSINTMX ECU_ADDRESS 0xd0006ff0 BIT_MASK 0x1 /end MEASUREMENT
/begin MEASUREMENT St_gengrenz "Statuswort" UBYTE _CNV_R_R_Def_dez_sl_575_CM 1 100. 0. 255. DISPLAY_IDENTIFIER ST_GENGRENZ ECU_ADDRESS 0xd00072b4 FORMAT "%3.0" /end MEASUREMENT
/begin MEASUREMENT St_gengrenz.B_bnnio "Bedingung: Bordnetz n.i.O." UBYTE _CNV_S_2_Def_bit_ub_702_CM 1 100. 0. 4. DISPLAY_IDENTIFIER B_BNNIO ECU_ADDRESS 0xd00072b4 BIT_MASK 0x4 /end MEASUREMENT
/begin MEASUREMENT St_gengrenz.B_gengcalc "Bedingung: Ringpuffer weiter takten" UBYTE _CNV_S_2_Def_bit_ub_701_CM 1 100. 0. 2. DISPLAY_IDENTIFIER B_GENGCALC ECU_ADDRESS 0xd00072b4 BIT_MASK 0x2 /end MEASUREMENT
/begin MEASUREMENT St_gengrenz.B_ierrhys "Bedingung: Erhöhung der Zielreserve wenn Ierrdiff zu klein" UBYTE _CNV_S_2_Def_bit_ub_700_CM 1 100. 0. 1. DISPLAY_IDENTIFIER B_IERRHYS ECU_ADDRESS 0xd00072b4 BIT_MASK 0x1 /end MEASUREMENT
/begin MEASUREMENT St_ibebsd1 "Statuswort ibebsd1" UBYTE _CNV_R_R_Def_dez_sl_575_CM 1 100. 0. 255. DISPLAY_IDENTIFIER ST_IBEBSD1 ECU_ADDRESS 0xc00024aa FORMAT "%3.0" /end MEASUREMENT
/begin MEASUREMENT St_ibebsd1.B_eb_busy "Bedingung EBSD Übertragungsrichtung schreiben" UBYTE _CNV_S_2_Def_bit_ub_703_CM 1 100. 0. 8. DISPLAY_IDENTIFIER B_EB_BUSY ECU_ADDRESS 0xc00024aa BIT_MASK 0x8 /end MEASUREMENT
/begin MEASUREMENT St_ibebsd1.B_eb_txok "Bedingung EBSD Übertragungsrichtung schreiben" UBYTE _CNV_S_2_Def_bit_ub_702_CM 1 100. 0. 4. DISPLAY_IDENTIFIER B_EB_TXOK ECU_ADDRESS 0xc00024aa BIT_MASK 0x4 /end MEASUREMENT
/begin MEASUREMENT St_ibebsd1.B_ibs_msgrdy "Bedingung EBSD Botschaft von IBS empfangen" UBYTE _CNV_S_2_Def_bit_ub_700_CM 1 100. 0. 1. DISPLAY_IDENTIFIER B_IBS_MSGRDY ECU_ADDRESS 0xc00024aa BIT_MASK 0x1 /end MEASUREMENT
/begin MEASUREMENT St_ibebsd1.B_ibs_msgwri "Bedingung EBSD Übertragungsrichtung schreiben" UBYTE _CNV_S_2_Def_bit_ub_701_CM 1 100. 0. 2. DISPLAY_IDENTIFIER B_IBS_MSGWRI ECU_ADDRESS 0xc00024aa BIT_MASK 0x2 /end MEASUREMENT
/begin MEASUREMENT St_ibmix "Statuswort ibmix" UBYTE _CNV_R_R_Def_dez_sl_575_CM 1 100. 0. 255. DISPLAY_IDENTIFIER ST_IBMIX ECU_ADDRESS 0xc00024ac FORMAT "%3.0" /end MEASUREMENT
/begin MEASUREMENT St_ibmix.B_ibrhilo "toggle Bit Register0/ 1 hi- od. lo byte" UBYTE _CNV_S_2_Def_bit_ub_700_CM 1 100. 0. 1. DISPLAY_IDENTIFIER B_IBRHILO ECU_ADDRESS 0xc00024ac BIT_MASK 0x1 /end MEASUREMENT
/begin MEASUREMENT St_ibmix.B_ibttog "global toggle bit" UBYTE _CNV_S_2_Def_bit_ub_701_CM 1 100. 0. 2. DISPLAY_IDENTIFIER B_IBTTOG ECU_ADDRESS 0xc00024ac BIT_MASK 0x2 /end MEASUREMENT
/begin MEASUREMENT St_ibserr "Statuswort ibserr" UBYTE _CNV_R_R_Def_dez_sl_575_CM 1 100. 0. 255. DISPLAY_IDENTIFIER ST_IBSERR ECU_ADDRESS 0xc00024ab FORMAT "%3.0" /end MEASUREMENT
/begin MEASUREMENT St_ibserr.B_ibfbsd "Bedingung BSD Fehler" UBYTE _CNV_S_2_Def_bit_ub_700_CM 1 100. 0. 1. DISPLAY_IDENTIFIER B_IBFBSD ECU_ADDRESS 0xc00024ab BIT_MASK 0x1 /end MEASUREMENT
/begin MEASUREMENT St_ibserr.B_ibfebsd "Bedingung EBSD Fehler" UBYTE _CNV_S_2_Def_bit_ub_701_CM 1 100. 0. 2. DISPLAY_IDENTIFIER B_IBFEBSD ECU_ADDRESS 0xc00024ab BIT_MASK 0x2 /end MEASUREMENT
/begin MEASUREMENT St_ibserr.B_ibunplau "Bedingung IBS Version unplausibel" UBYTE _CNV_S_2_Def_bit_ub_702_CM 1 100. 0. 4. DISPLAY_IDENTIFIER B_IBUNPLAU ECU_ADDRESS 0xc00024ab BIT_MASK 0x4 /end MEASUREMENT
/begin MEASUREMENT St_ibsreg4 "Statuswort ibsreg4" UBYTE _CNV_R_R_Def_dez_sl_575_CM 1 100. 0. 255. DISPLAY_IDENTIFIER ST_IBSREG4 ECU_ADDRESS 0xc00024a1 FORMAT "%3.0" /end MEASUREMENT
/begin MEASUREMENT St_ibsreg4.B_ibspwf "Bedingung IBS powerfail erkannt" UBYTE _CNV_S_2_Def_bit_ub_704_CM 1 100. 0. 16. DISPLAY_IDENTIFIER B_IBSPWF ECU_ADDRESS 0xc00024a1 BIT_MASK 0x10 /end MEASUREMENT
/begin MEASUREMENT St_ibsreg4.B_startfgk "Bedingung Startfähigkeit gefährdet" UBYTE _CNV_S_2_Def_bit_ub_700_CM 1 100. 0. 1. DISPLAY_IDENTIFIER B_STARTFGK ECU_ADDRESS 0xc00024a1 BIT_MASK 0x1 /end MEASUREMENT
/begin MEASUREMENT St_ibsreg4.B_strtaw "Bedingung Startauswertung gerechnet" UBYTE _CNV_S_2_Def_bit_ub_701_CM 1 100. 0. 2. DISPLAY_IDENTIFIER B_STRTAW ECU_ADDRESS 0xc00024a1 BIT_MASK 0x2 /end MEASUREMENT
/begin MEASUREMENT St_ibsreg4.B_tiefset "Bedingung Tiefentladung" UBYTE _CNV_S_2_Def_bit_ub_705_CM 1 100. 0. 32. DISPLAY_IDENTIFIER B_TIEFSET ECU_ADDRESS 0xc00024a1 BIT_MASK 0x20 /end MEASUREMENT
/begin MEASUREMENT St_ibsreg5 "Statuswort ibsreg5" UBYTE _CNV_R_R_Def_dez_sl_575_CM 1 100. 0. 255. DISPLAY_IDENTIFIER ST_IBSREG5 ECU_ADDRESS 0xc00024a2 FORMAT "%3.0" /end MEASUREMENT
/begin MEASUREMENT St_ibsreg5.B_fsclr "Bedingung IBS interne Fehler loeschen" UBYTE _CNV_S_2_Def_bit_ub_703_CM 1 100. 0. 8. DISPLAY_IDENTIFIER B_FSCLR ECU_ADDRESS 0xc00024a2 BIT_MASK 0x8 /end MEASUREMENT
/begin MEASUREMENT St_imdgen0 "Statuswort" UBYTE _CNV_R_R_Def_dez_sl_575_CM 1 100. 0. 255. DISPLAY_IDENTIFIER ST_IMDGEN0 ECU_ADDRESS 0xd00071bc FORMAT "%3.0" /end MEASUREMENT
/begin MEASUREMENT St_imdgen0.B_firstemp "Bedingung Generatorstarttemperatur-Berechnung" UBYTE _CNV_S_2_Def_bit_ub_700_CM 1 100. 0. 1. DISPLAY_IDENTIFIER B_FIRSTEMP ECU_ADDRESS 0xd00071bc BIT_MASK 0x1 /end MEASUREMENT
/begin MEASUREMENT St_imdgen0.B_gene "Generatormoment enable/disable" UBYTE _CNV_S_2_Def_bit_ub_701_CM 1 100. 0. 2. DISPLAY_IDENTIFIER B_GENE ECU_ADDRESS 0xd00071bc BIT_MASK 0x2 /end MEASUREMENT
/begin MEASUREMENT St_imdgen0.B_generken "Generatorerkennung noch nicht erfolgt" UBYTE _CNV_S_2_Def_bit_ub_702_CM 1 100. 0. 4. DISPLAY_IDENTIFIER B_GENERKEN ECU_ADDRESS 0xd00071bc BIT_MASK 0x4 /end MEASUREMENT
/begin MEASUREMENT St_imdgen0.B_mod_calc "Bedingung Momentenmodell muß gerechnet werden" UBYTE _CNV_S_2_Def_bit_ub_703_CM 1 100. 0. 8. DISPLAY_IDENTIFIER B_MOD_CALC ECU_ADDRESS 0xd00071bc BIT_MASK 0x8 /end MEASUREMENT
/begin MEASUREMENT St_imdgen_1s "Statuswort" UBYTE _CNV_R_R_Def_dez_sl_575_CM 1 100. 0. 255. DISPLAY_IDENTIFIER ST_IMDGEN_1S ECU_ADDRESS 0xc0005194 FORMAT "%3.0" /end MEASUREMENT
/begin MEASUREMENT St_imdgen_1s.B_genht "Bedingung Generator Hochtemperatur" UBYTE _CNV_S_2_Def_bit_ub_700_CM 1 100. 0. 1. DISPLAY_IDENTIFIER B_GENHT ECU_ADDRESS 0xc0005194 BIT_MASK 0x1 /end MEASUREMENT
/begin MEASUREMENT St_imdgen_1s.B_genhtkrit "Statuswort" UBYTE _CNV_S_2_Def_bit_ub_701_CM 1 100. 0. 2. DISPLAY_IDENTIFIER B_GENHTKRIT ECU_ADDRESS 0xc0005194 BIT_MASK 0x2 /end MEASUREMENT
/begin MEASUREMENT St_imdgen_1s.B_genhtkritv "Bedingung kritische Temparatur vor Entprellung" UBYTE _CNV_S_2_Def_bit_ub_702_CM 1 100. 0. 4. DISPLAY_IDENTIFIER B_GENHTKRITV ECU_ADDRESS 0xc0005194 BIT_MASK 0x4 /end MEASUREMENT
/begin MEASUREMENT St_imdgen_1s.B_genhtmxgra "Maximale Gradient Chiptemparatur überstiegen" UBYTE _CNV_S_2_Def_bit_ub_704_CM 1 100. 0. 16. DISPLAY_IDENTIFIER B_GENHTMXGRA ECU_ADDRESS 0xc0005194 BIT_MASK 0x10 /end MEASUREMENT
/begin MEASUREMENT St_imdgen_1s.B_ierrgrenzh "Grenzstrom aus Hochtemperatur Generator aktiv" UBYTE _CNV_S_2_Def_bit_ub_705_CM 1 100. 0. 32. DISPLAY_IDENTIFIER B_IERRGRENZH ECU_ADDRESS 0xc0005194 BIT_MASK 0x20 /end MEASUREMENT
/begin MEASUREMENT St_imdgen_1s.B_tdiodekrit "Diodentemparatur im kritischen Bereich" UBYTE _CNV_S_2_Def_bit_ub_703_CM 1 100. 0. 8. DISPLAY_IDENTIFIER B_TDIODEKRIT ECU_ADDRESS 0xc0005194 BIT_MASK 0x8 /end MEASUREMENT
/begin MEASUREMENT St_imdgen_nv0 "Statuswort" UBYTE _CNV_R_R_Def_dez_sl_575_CM 1 100. 0. 255. DISPLAY_IDENTIFIER ST_IMDGEN_NV0 ECU_ADDRESS 0xd00071bd FORMAT "%3.0" /end MEASUREMENT
/begin MEASUREMENT St_imdgen_nv0.B_genfkupl "Generatortyp unplausibel" UBYTE _CNV_S_2_Def_bit_ub_700_CM 1 100. 0. 1. DISPLAY_IDENTIFIER B_GENFKUPL ECU_ADDRESS 0xd00071bd BIT_MASK 0x1 /end MEASUREMENT
/begin MEASUREMENT St_imdgen_nv0.B_heizen "Bedingung Generator in Heizphase" UBYTE _CNV_S_2_Def_bit_ub_701_CM 1 100. 0. 2. DISPLAY_IDENTIFIER B_HEIZEN ECU_ADDRESS 0xd00071bd BIT_MASK 0x2 /end MEASUREMENT
/begin MEASUREMENT St_imdgen_nv1 "Statuswort" UBYTE _CNV_R_R_Def_dez_sl_575_CM 1 100. 0. 255. DISPLAY_IDENTIFIER ST_IMDGEN_NV1 ECU_ADDRESS 0xc00045f4 FORMAT "%3.0" /end MEASUREMENT
/begin MEASUREMENT St_imdgen_nv1.B_bszsichok "Abspeichern Fasta Daten in Hauptkennfeld erfolgreich" UBYTE _CNV_S_2_Def_bit_ub_700_CM 1 100. 0. 1. DISPLAY_IDENTIFIER B_BSZSICHOK ECU_ADDRESS 0xc00045f4 BIT_MASK 0x1 /end MEASUREMENT
/begin MEASUREMENT St_krann "Statuswort KRANN" UBYTE _CNV_R_R_Def_dez_sl_575_CM 1 100. 0. 255. DISPLAY_IDENTIFIER ST_KRANN ECU_ADDRESS 0xc000246c FORMAT "%3.0" /end MEASUREMENT
/begin MEASUREMENT St_krann.B_khnnlern "Bedingung Adaption KHNN freigegeben" UBYTE _CNV_S_2_Def_bit_ub_704_CM 1 100. 0. 16. DISPLAY_IDENTIFIER B_KHNNLERN ECU_ADDRESS 0xc000246c BIT_MASK 0x10 /end MEASUREMENT
/begin MEASUREMENT St_krann.B_nnlern "Bedingung Adaption KRANN freigegeben" UBYTE _CNV_S_2_Def_bit_ub_700_CM 1 100. 0. 1. DISPLAY_IDENTIFIER B_NNLERN ECU_ADDRESS 0xc000246c BIT_MASK 0x1 /end MEASUREMENT
/begin MEASUREMENT St_krann_1000ms "Statuswort KRANN, Bitgrößen im 1000ms-Raster" UBYTE _CNV_R_R_Def_dez_sl_575_CM 1 100. 0. 255. DISPLAY_IDENTIFIER ST_KRANN_1000MS ECU_ADDRESS 0xc0005190 FORMAT "%3.0" /end MEASUREMENT
/begin MEASUREMENT St_krann_1000ms.B_kftkr "Bedingung für Kennfeldthermostat" UBYTE _CNV_S_2_Def_bit_ub_701_CM 1 100. 0. 2. DISPLAY_IDENTIFIER B_KFTKR ECU_ADDRESS 0xc0005190 BIT_MASK 0x2 /end MEASUREMENT
/begin MEASUREMENT St_krann_seg "Statuswort KRANN, Bitgrößen im Segment-Raster" UBYTE _CNV_R_R_Def_dez_sl_575_CM 1 100. 0. 255. DISPLAY_IDENTIFIER ST_KRANN_SEG ECU_ADDRESS 0xd0007120 FORMAT "%3.0" /end MEASUREMENT
/begin MEASUREMENT St_krann_seg.B_krakt_hs "Bedingung Klopfregelung Umschaltung in Homogen-Schicht" UBYTE _CNV_S_2_Def_bit_ub_701_CM 1 100. 0. 2. DISPLAY_IDENTIFIER B_KRAKT_HS ECU_ADDRESS 0xd0007120 BIT_MASK 0x2 /end MEASUREMENT
/begin MEASUREMENT St_krann_seg.B_krein "Bedingung Klopfregelung" UBYTE _CNV_S_2_Def_bit_ub_702_CM 1 100. 0. 4. DISPLAY_IDENTIFIER B_KREIN ECU_ADDRESS 0xd0007120 BIT_MASK 0x4 /end MEASUREMENT
/begin MEASUREMENT St_krann_seg.B_krzykl_verz "Bedingung Klopfregelung Zyklenverzögerung bei Umschaltung der Betriebsart" UBYTE _CNV_S_2_Def_bit_ub_700_CM 1 100. 0. 1. DISPLAY_IDENTIFIER B_KRZYKL_VERZ ECU_ADDRESS 0xd0007120 BIT_MASK 0x1 /end MEASUREMENT
/begin MEASUREMENT St_lamko "Statuswort Lambdakoordinator" UBYTE _CNV_R_R_Def_dez_sl_575_CM 1 100. 0. 255. DISPLAY_IDENTIFIER ST_LAMKO ECU_ADDRESS 0xd0007674 FORMAT "%3.0" /end MEASUREMENT
/begin MEASUREMENT St_lamko.B_laprio_ko "Bedingung Lambda aus Koordinator muss unbedingt gestellet werden" UBYTE _CNV_S_2_Def_bit_ub_700_CM 1 100. 0. 1. DISPLAY_IDENTIFIER B_LAPRIO_KO ECU_ADDRESS 0xd0007674 BIT_MASK 0x1 /end MEASUREMENT
/begin MEASUREMENT St_lamko.B_ls_treu "Bedingung Wirkungsgrade aus Modell" UBYTE _CNV_S_2_Def_bit_ub_701_CM 1 100. 0. 2. DISPLAY_IDENTIFIER B_LS_TREU ECU_ADDRESS 0xd0007674 BIT_MASK 0x2 /end MEASUREMENT
/begin MEASUREMENT St_sleep "Statuswort Einschlafverhalten" UBYTE _CNV_R_R_Def_dez_sl_575_CM 1 100. 0. 255. DISPLAY_IDENTIFIER ST_SLEEP ECU_ADDRESS 0xc00024a0 FORMAT "%3.0" /end MEASUREMENT
/begin MEASUREMENT St_sleep.B_sleepwait "Signal Verzoegerung Sleep Indication" UBYTE _CNV_S_2_Def_bit_ub_700_CM 1 100. 0. 1. DISPLAY_IDENTIFIER B_SLEEPWAIT ECU_ADDRESS 0xc00024a0 BIT_MASK 0x1 /end MEASUREMENT
/begin MEASUREMENT T1histiruh "Ruhestromhistogramm Klasse 1" UWORD _CNV_R_R_Def_dez_sl_575_CM 1 100. 0. 65535. DISPLAY_IDENTIFIER T1HISTIRUH ECU_ADDRESS 0xc00024e2 FORMAT "%5.0" /end MEASUREMENT
/begin MEASUREMENT T2histiruh "Ruhestromhistogramm Klasse 2" UWORD _CNV_R_R_Def_dez_sl_575_CM 1 100. 0. 65535. DISPLAY_IDENTIFIER T2HISTIRUH ECU_ADDRESS 0xc00024e4 FORMAT "%5.0" /end MEASUREMENT
/begin MEASUREMENT T3histiruh "Ruhestromhistogramm Klasse 3" UWORD _CNV_R_R_Def_dez_sl_575_CM 1 100. 0. 65535. DISPLAY_IDENTIFIER T3HISTIRUH ECU_ADDRESS 0xc00024e6 FORMAT "%5.0" /end MEASUREMENT
/begin MEASUREMENT T4histiruh "Ruhestromhistogramm Klasse 4" UWORD _CNV_R_R_Def_dez_sl_575_CM 1 100. 0. 65535. DISPLAY_IDENTIFIER T4HISTIRUH ECU_ADDRESS 0xc00024e8 FORMAT "%5.0" /end MEASUREMENT
/begin MEASUREMENT T_batt_ibs "Batterietemperatur" SWORD _CNV_R_R_Def_t_sw_q_618_CM 1 100. -3276.8 3276.7 DISPLAY_IDENTIFIER T_BATT_IBS ECU_ADDRESS 0xc00024ea FORMAT "%6.1" /end MEASUREMENT
/begin MEASUREMENT T_batt_max "Maximale Batt. Temperatur bei Stillstand" SWORD _CNV_R_R_Def_t_sw_q_618_CM 1 100. -3276.8 3276.7 DISPLAY_IDENTIFIER T_BATT_MAX ECU_ADDRESS 0xc00024ec FORMAT "%6.1" /end MEASUREMENT
/begin MEASUREMENT T_batt_min "Minimale Batt. Temperatur bei Stillstand" SWORD _CNV_R_R_Def_t_sw_q_618_CM 1 100. -3276.8 3276.7 DISPLAY_IDENTIFIER T_BATT_MIN ECU_ADDRESS 0xc00024ee FORMAT "%6.1" /end MEASUREMENT
/begin MEASUREMENT T_battsoc0 "Batterietemperatur bei Ruhespannungsmessung" SWORD _CNV_R_R_Def_t_sw_q_618_CM 1 100. -3276.8 3276.7 DISPLAY_IDENTIFIER T_BATTSOC0 ECU_ADDRESS 0xc00024ce FORMAT "%6.1" /end MEASUREMENT
/begin MEASUREMENT T_battsoci "T_battsoc0, Rohwert aus IBS" UBYTE _CNV_R_R_Def_dez_sl_575_CM 1 100. 0. 255. DISPLAY_IDENTIFIER T_BATTSOCI ECU_ADDRESS 0xc00024b7 FORMAT "%3.0" /end MEASUREMENT
/begin MEASUREMENT T_chipfilsdt "Differenzenquotient schnellgefilterte Chiptemparatur" SWORD _CNV_R_R_Def_t_sw_q_618_CM 1 100. -3276.8 3276.7 DISPLAY_IDENTIFIER T_CHIPFILSDT ECU_ADDRESS 0xc000519a FORMAT "%6.1" /end MEASUREMENT
/begin MEASUREMENT T_diode "Diodentemparatur" SWORD _CNV_R_R_Def_t_sw_q_618_CM 1 100. -3276.8 3276.7 DISPLAY_IDENTIFIER T_DIODE ECU_ADDRESS 0xc000519c FORMAT "%6.1" /end MEASUREMENT
/begin MEASUREMENT T_diodedelta "Deltatemparatur Diode" SWORD _CNV_R_R_Def_t_sw_q_618_CM 1 100. -3276.8 3276.7 DISPLAY_IDENTIFIER T_DIODEDELTA ECU_ADDRESS 0xc000519e FORMAT "%6.1" /end MEASUREMENT
/begin MEASUREMENT Tans_gen "Ansauglufttemparatur Generator" SWORD _CNV_R_R_Def_t_sw_q_618_CM 1 100. -3276.8 3276.7 DISPLAY_IDENTIFIER TANS_GEN ECU_ADDRESS 0xc00051a0 FORMAT "%6.1" /end MEASUREMENT
/begin MEASUREMENT Tbatt_maxi "T_batt_max, Rohwert aus IBS" UBYTE _CNV_R_R_Def_dez_sl_575_CM 1 100. 0. 255. DISPLAY_IDENTIFIER TBATT_MAXI ECU_ADDRESS 0xc00024b8 FORMAT "%3.0" /end MEASUREMENT
/begin MEASUREMENT Tbatt_mini "T_batt_min, Rohwert aus IBS" UBYTE _CNV_R_R_Def_dez_sl_575_CM 1 100. 0. 255. DISPLAY_IDENTIFIER TBATT_MINI ECU_ADDRESS 0xc00024b9 FORMAT "%3.0" /end MEASUREMENT
/begin MEASUREMENT Tchip_diff1 "" SWORD _CNV_R_R_Def_t_sw_q_618_CM 1 100. -3276.8 3276.7 DISPLAY_IDENTIFIER TCHIP_DIFF1 ECU_ADDRESS 0xc000234c FORMAT "%6.1" /end MEASUREMENT
/begin MEASUREMENT Tchip_diff2 "" SWORD _CNV_R_R_Def_t_sw_q_618_CM 1 100. -3276.8 3276.7 DISPLAY_IDENTIFIER TCHIP_DIFF2 ECU_ADDRESS 0xc000234e FORMAT "%6.1" /end MEASUREMENT
/begin MEASUREMENT Tchip_fil_l "Wirkliche Chiptemperatur vom Generatorregler als Mittelwert gefiltert" SWORD _CNV_R_R_Def_t_sw_q_618_CM 1 100. -3276.8 3276.7 DISPLAY_IDENTIFIER TCHIP_FIL_L ECU_ADDRESS 0xd00071f4 FORMAT "%6.1" /end MEASUREMENT
/begin MEASUREMENT Tchip_fil_s "Wirkliche Chiptemperatur vom Generatorregler als Mittelwert gefiltert" SWORD _CNV_R_R_Def_t_sw_q_618_CM 1 100. -3276.8 3276.7 DISPLAY_IDENTIFIER TCHIP_FIL_S ECU_ADDRESS 0xd00071f6 FORMAT "%6.1" /end MEASUREMENT
/begin MEASUREMENT Tchip_ist "Wirkliche Chiptemperatur vom Generatorregler" SWORD _CNV_R_R_Def_t_sw_q_618_CM 1 100. -3276.8 3276.7 DISPLAY_IDENTIFIER TCHIP_IST ECU_ADDRESS 0xc00051a2 FORMAT "%6.1" /end MEASUREMENT
/begin MEASUREMENT Tchip_mwa "Array zur Mittelwerbildung Tchip_ist" SWORD _CNV_R_R_Def_t_sw_q_618_CM 1 100. -3276.8 3276.7 DISPLAY_IDENTIFIER TCHIP_MWA ECU_ADDRESS 0xc00051a4 FORMAT "%6.1" ARRAY_SIZE 16 MATRIX_DIM 16 1 1 /end MEASUREMENT
/begin MEASUREMENT Tchip_sum "Summenwert Tchip zur Mittelwertbildung" SWORD _CNV_R_R_Def_t_sw_q_618_CM 1 100. -3276.8 3276.7 DISPLAY_IDENTIFIER TCHIP_SUM ECU_ADDRESS 0xc00051c4 FORMAT "%6.1" /end MEASUREMENT
/begin MEASUREMENT Tgen "Generatortemperatur" SWORD _CNV_R_R_Def_t_sw_q_618_CM 1 100. -3276.8 3276.7 DISPLAY_IDENTIFIER TGEN ECU_ADDRESS 0xd00071c6 FORMAT "%6.1" /end MEASUREMENT
/begin MEASUREMENT Tgen_ab "Abstelltemperatur Generator" SWORD _CNV_R_R_Def_t_sw_q_618_CM 1 100. -3276.8 3276.7 DISPLAY_IDENTIFIER TGEN_AB ECU_ADDRESS 0xc00045fe FORMAT "%6.1" /end MEASUREMENT
/begin MEASUREMENT Tgen_dt "Temperaturdifferenz zwischen Abstelltemperatur und Umgebungstemperatur" SWORD _CNV_R_R_Def_t_sw_q_618_CM 1 100. -48. 384. DISPLAY_IDENTIFIER TGEN_DT ECU_ADDRESS 0xd00071f8 FORMAT "%6.1" /end MEASUREMENT
/begin MEASUREMENT Tgen_end "Generatortemperatur endgültig" SWORD _CNV_R_R_Def_t_sw_q_618_CM 1 100. -3276.8 3276.7 DISPLAY_IDENTIFIER TGEN_END ECU_ADDRESS 0xd00071c8 FORMAT "%6.1" /end MEASUREMENT
/begin MEASUREMENT Tgen_exp "Delta Abkühltemperatur" SWORD _CNV_R_R_Def_t_sw_q_618_CM 1 100. -48. 384. DISPLAY_IDENTIFIER TGEN_EXP ECU_ADDRESS 0xd00071fa FORMAT "%6.1" /end MEASUREMENT
/begin MEASUREMENT Tgen_fil "gefilterte Generatortemperatur" SWORD _CNV_R_R_Def_t_sw_q_618_CM 1 100. -3276.8 3276.7 DISPLAY_IDENTIFIER TGEN_FIL ECU_ADDRESS 0xc00051c6 FORMAT "%6.1" /end MEASUREMENT
/begin MEASUREMENT Tst_countv "Testcounter-Wert" UWORD _CNV_R_R_Def_dez_sl_575_CM 1 100. 0. 65535. DISPLAY_IDENTIFIER TST_COUNTV ECU_ADDRESS 0xc00051ce FORMAT "%5.0" /end MEASUREMENT
/begin MEASUREMENT Tst_fil_out "Testfilter Ausgang" UWORD _CNV_R_R_Def_t_uw_q_728_CM 1 100. 0. 768. DISPLAY_IDENTIFIER TST_FIL_OUT ECU_ADDRESS 0xc00051d0 FORMAT "%7.2" /end MEASUREMENT
/begin MEASUREMENT U1soc0 "Ruhespannung 1" UWORD _CNV_R_R_Def_u_uw_q_730_CM 1 100. 6. 22.3837 DISPLAY_IDENTIFIER U1SOC0 ECU_ADDRESS 0xc00024d0 FORMAT "%9.4" /end MEASUREMENT
/begin MEASUREMENT U2soc0 "Ruhespannung 1" UWORD _CNV_R_R_Def_u_uw_q_730_CM 1 100. 6. 22.3837 DISPLAY_IDENTIFIER U2SOC0 ECU_ADDRESS 0xc00024d2 FORMAT "%9.4" /end MEASUREMENT
/begin MEASUREMENT U3soc0 "Ruhespannung 1" UWORD _CNV_R_R_Def_u_uw_q_730_CM 1 100. 6. 22.3837 DISPLAY_IDENTIFIER U3SOC0 ECU_ADDRESS 0xc00024d4 FORMAT "%9.4" /end MEASUREMENT
/begin MEASUREMENT U_batt "Batteriespannung von IBS gemessen" UWORD _CNV_R_R_Def_u_uw_q_730_CM 1 100. 6. 22.3837 DISPLAY_IDENTIFIER U_BATT ECU_ADDRESS 0xc00024be FORMAT "%9.4" /end MEASUREMENT
/begin MEASUREMENT U_tnstart "Spannung im Start" UWORD _CNV_R_R_Def_u_uw_q_730_CM 1 100. 6. 22.3837 DISPLAY_IDENTIFIER U_TNSTART ECU_ADDRESS 0xc00024dc FORMAT "%9.4" /end MEASUREMENT
/begin MEASUREMENT U_vordiode "Diodenvorwärtsspannung" UWORD _CNV_R_R_Def_u_uw_q_734_CM 1 100. 0. 319.9951 DISPLAY_IDENTIFIER U_VORDIODE ECU_ADDRESS 0xc00051d2 FORMAT "%8.3" /end MEASUREMENT
/begin MEASUREMENT U_vorstart "Spannung vor Start" UWORD _CNV_R_R_Def_u_uw_q_730_CM 1 100. 6. 22.3837 DISPLAY_IDENTIFIER U_VORSTART ECU_ADDRESS 0xc00024da FORMAT "%9.4" /end MEASUREMENT
/begin MEASUREMENT Ugen_calc "Berechnete Generatorspannung" UWORD _CNV_R_R_Def_u_uw_q_731_CM 1 100. 0. 6553.5 DISPLAY_IDENTIFIER UGEN_CALC ECU_ADDRESS 0xd000720a FORMAT "%8.3" /end MEASUREMENT
/begin MEASUREMENT Unind "EBSD Puffer Index" UBYTE _CNV_R_R_Def_dez_sl_575_CM 1 100. 0. 255. DISPLAY_IDENTIFIER UNIND ECU_ADDRESS 0xc00024fc FORMAT "%3.0" /end MEASUREMENT
/begin MEASUREMENT Z_ggbn "Zähler: Bordnetzspannung n.i.O." UWORD _CNV_R_R_Def_dez_sl_575_CM 1 100. 0. 65535. DISPLAY_IDENTIFIER Z_GGBN ECU_ADDRESS 0xc00046f8 FORMAT "%5.0" /end MEASUREMENT
/begin MEASUREMENT Z_norm_agrad "" FLOAT32_IEEE _CNV_R_R_Def_dez_sl_575_CM 1 100. -1000000000000. 10000000000000. DISPLAY_IDENTIFIER Z_NORM_AGRAD ECU_ADDRESS 0xc0004388 FORMAT "%14.7" ARRAY_SIZE 2 MATRIX_DIM 2 1 1 /end MEASUREMENT
/begin MEASUREMENT Z_norm_psad "" FLOAT32_IEEE _CNV_R_R_Def_dez_sl_575_CM 1 100. -1000000000000. 10000000000000. DISPLAY_IDENTIFIER Z_NORM_PSAD ECU_ADDRESS 0xc0004364 FORMAT "%14.7" ARRAY_SIZE 5 MATRIX_DIM 5 1 1 /end MEASUREMENT
/begin MEASUREMENT Z_tchip "Zaehler für Mittelwerbildung Tchip_ist" UBYTE _CNV_R_R_Def_dez_sl_575_CM 1 100. 0. 255. DISPLAY_IDENTIFIER Z_TCHIP ECU_ADDRESS 0xc00051d4 FORMAT "%3.0" /end MEASUREMENT
/begin MEASUREMENT Zbibs "Zusbaunummer" ULONG _CNV_R_R_Def_dez_sl_575_CM 1 100. 0. 4294967295. DISPLAY_IDENTIFIER ZBIBS ECU_ADDRESS 0xc00024f2 FORMAT "%7.0" /end MEASUREMENT
/begin MEASUREMENT Zk_eta "Zeitkonstante zur Filterung von Eta_ges" UWORD _CNV_R_R_Def_f_uw_b_576_CM 1 100. 0. 99.9984 DISPLAY_IDENTIFIER ZK_ETA ECU_ADDRESS 0xd00076a6 FORMAT "%8.3" /end MEASUREMENT
/begin MEASUREMENT w_agradnn_Agrpos "" FLOAT32_IEEE _CNV_R_R_Def_dez_sl_575_CM 1 100. -1000000000000. 10000000000000. DISPLAY_IDENTIFIER W_AGRADNN_AGRPOS ECU_ADDRESS 0xc0004380 FORMAT "%14.7" ARRAY_SIZE 2 MATRIX_DIM 2 1 1 /end MEASUREMENT
/begin MEASUREMENT w_agradnn_bias "" FLOAT32_IEEE _CNV_R_R_Def_dez_sl_575_CM 1 100. -1000000000000. 10000000000000. DISPLAY_IDENTIFIER W_AGRADNN_BIAS ECU_ADDRESS 0xc0004378 FORMAT "%14.7" ARRAY_SIZE 2 MATRIX_DIM 2 1 1 /end MEASUREMENT
/begin MEASUREMENT w_ba_ist "Gewichte KRANN, Eingang Ba_ist" FLOAT32_IEEE _CNV_R_R_Def_dez_sl_575_CM 1 100. -1000000000000. 10000000000000. DISPLAY_IDENTIFIER W_BA_IST ECU_ADDRESS 0xc00044c0 FORMAT "%14.7" ARRAY_SIZE 15 MATRIX_DIM 15 1 1 /end MEASUREMENT
/begin MEASUREMENT w_bias "Gewichte KRANN, Biasterm" FLOAT32_IEEE _CNV_R_R_Def_dez_sl_575_CM 1 100. -1000000000000. 10000000000000. DISPLAY_IDENTIFIER W_BIAS ECU_ADDRESS 0xc0004394 FORMAT "%14.7" ARRAY_SIZE 15 MATRIX_DIM 15 1 1 /end MEASUREMENT
/begin MEASUREMENT w_kh_bias "Gewichte KHNN, Biasterm" FLOAT32_IEEE _CNV_R_R_Def_dez_sl_575_CM 1 100. -1000000000000. 10000000000000. DISPLAY_IDENTIFIER W_KH_BIAS ECU_ADDRESS 0xc00044fc FORMAT "%14.7" ARRAY_SIZE 15 MATRIX_DIM 15 1 1 /end MEASUREMENT
/begin MEASUREMENT w_kh_nkw "Gewichte KHNN, Eingang Nkw" FLOAT32_IEEE _CNV_R_R_Def_dez_sl_575_CM 1 100. -1000000000000. 10000000000000. DISPLAY_IDENTIFIER W_KH_NKW ECU_ADDRESS 0xc0004538 FORMAT "%14.7" ARRAY_SIZE 15 MATRIX_DIM 15 1 1 /end MEASUREMENT
/begin MEASUREMENT w_kh_rk "Gewichte KHNN, Eingang Rk_soll_s" FLOAT32_IEEE _CNV_R_R_Def_dez_sl_575_CM 1 100. -1000000000000. 10000000000000. DISPLAY_IDENTIFIER W_KH_RK ECU_ADDRESS 0xc0004574 FORMAT "%14.7" ARRAY_SIZE 15 MATRIX_DIM 15 1 1 /end MEASUREMENT
/begin MEASUREMENT w_kh_tans "Gewichte KHNN, Eingang Tans" FLOAT32_IEEE _CNV_R_R_Def_dez_sl_575_CM 1 100. -1000000000000. 10000000000000. DISPLAY_IDENTIFIER W_KH_TANS ECU_ADDRESS 0xc00045b0 FORMAT "%14.7" ARRAY_SIZE 15 MATRIX_DIM 15 1 1 /end MEASUREMENT
/begin MEASUREMENT w_nkw "Gewichte KRANN, Eingang Nkw" FLOAT32_IEEE _CNV_R_R_Def_dez_sl_575_CM 1 100. -1000000000000. 10000000000000. DISPLAY_IDENTIFIER W_NKW ECU_ADDRESS 0xc00043d0 FORMAT "%14.7" ARRAY_SIZE 15 MATRIX_DIM 15 1 1 /end MEASUREMENT
/begin MEASUREMENT w_psadnn_N "" FLOAT32_IEEE _CNV_R_R_Def_dez_sl_575_CM 1 100. -1000000000000. 10000000000000. DISPLAY_IDENTIFIER W_PSADNN_N ECU_ADDRESS 0xc0004328 FORMAT "%14.7" ARRAY_SIZE 5 MATRIX_DIM 5 1 1 /end MEASUREMENT
/begin MEASUREMENT w_psadnn_Vsa_spri "" FLOAT32_IEEE _CNV_R_R_Def_dez_sl_575_CM 1 100. -1000000000000. 10000000000000. DISPLAY_IDENTIFIER W_PSADNN_VSA_SPRI ECU_ADDRESS 0xc0004350 FORMAT "%14.7" ARRAY_SIZE 5 MATRIX_DIM 5 1 1 /end MEASUREMENT
/begin MEASUREMENT w_psadnn_Vse_spri "" FLOAT32_IEEE _CNV_R_R_Def_dez_sl_575_CM 1 100. -1000000000000. 10000000000000. DISPLAY_IDENTIFIER W_PSADNN_VSE_SPRI ECU_ADDRESS 0xc000433c FORMAT "%14.7" ARRAY_SIZE 5 MATRIX_DIM 5 1 1 /end MEASUREMENT
/begin MEASUREMENT w_psadnn_bias "" FLOAT32_IEEE _CNV_R_R_Def_dez_sl_575_CM 1 100. -1000000000000. 10000000000000. DISPLAY_IDENTIFIER W_PSADNN_BIAS ECU_ADDRESS 0xc0004314 FORMAT "%14.7" ARRAY_SIZE 5 MATRIX_DIM 5 1 1 /end MEASUREMENT
/begin MEASUREMENT w_rk "Gewichte KRANN, Eingang Rk_soll_kr" FLOAT32_IEEE _CNV_R_R_Def_dez_sl_575_CM 1 100. -1000000000000. 10000000000000. DISPLAY_IDENTIFIER W_RK ECU_ADDRESS 0xc000440c FORMAT "%14.7" ARRAY_SIZE 15 MATRIX_DIM 15 1 1 /end MEASUREMENT
/begin MEASUREMENT w_tans "Gewichte KRANN, Eingang Tans" FLOAT32_IEEE _CNV_R_R_Def_dez_sl_575_CM 1 100. -1000000000000. 10000000000000. DISPLAY_IDENTIFIER W_TANS ECU_ADDRESS 0xc0004448 FORMAT "%14.7" ARRAY_SIZE 15 MATRIX_DIM 15 1 1 /end MEASUREMENT
/begin MEASUREMENT w_tmot "Gewichte KRANN, Eingang Tmot" FLOAT32_IEEE _CNV_R_R_Def_dez_sl_575_CM 1 100. -1000000000000. 10000000000000. DISPLAY_IDENTIFIER W_TMOT ECU_ADDRESS 0xc0004484 FORMAT "%14.7" ARRAY_SIZE 15 MATRIX_DIM 15 1 1 /end MEASUREMENT
/begin AXIS_PTS GAX_5MODELLE "Modelle eines LOLIMOT-KNN mit 5 Neuronen (Zähler)" 0xa1012964 Modelle _REC_AXS_20_u1 255. _CNV_R_R_Def_dez_sl_575_CM 5 0. 255. FORMAT "%3.0" /end AXIS_PTS
/begin AXIS_PTS GAX_KHMOD "Modelle der LOLIMOT-KNN (Zähler für KHNN)" 0xa1014750 Modelle _REC_AXS_20_u1 255. _CNV_R_R_Def_dez_sl_575_CM 6 0. 255. FORMAT "%3.0" /end AXIS_PTS
/begin AXIS_PTS GAX_KRMOD "Modelle der LOLIMOT-KNN (Zähler für KRANN)" 0xa101473c Modelle _REC_AXS_20_u1 255. _CNV_R_R_Def_dez_sl_575_CM 15 0. 255. FORMAT "%3.0" /end AXIS_PTS
/begin CHARACTERISTIC CW_KATHEIZRP "Freischalten Muster Katheizmanager" VALUE 0xa1019d8c _REC_VAL_20_u1 99.45 _CNV_R_R_Def_dez_sl_575_CM 0. 255. FORMAT "%3.0" /end CHARACTERISTIC
/begin CHARACTERISTIC KF_AGR_KOR "Korrekturfaktor PSR" MAP 0xa1012ad8 _REC_MAP_52_UBYTE_u2_u2_u2 15.9997 _CNV_R_R_Def_f_uw_b_594_CM 0. 15.9997 FORMAT "%7.4"
 /begin AXIS_DESCR STD_AXIS Pspvdk_soll _CNV_R_R_Def_f_sw_b_608_CM 8 0. 3.9999 FORMAT "%14.5" /end AXIS_DESCR
 /begin AXIS_DESCR STD_AXIS Pvdkds _CNV_R_R_Def_p_sw_q_578_CM 8 0. 2559.9609 FORMAT "%5.2" /end AXIS_DESCR
/end CHARACTERISTIC
/begin CHARACTERISTIC KF_DLA_GL "Korrekturen durch Zylindergleichstellung" MAP 0xa101a220 _REC_MAP_52_UBYTE_s2_s2_s2 15.9997 _CNV_R_R_Def_f_sw_b_607_CM -8. 7.9997 FORMAT "%7.4"
 /begin AXIS_DESCR STD_AXIS Nkw _CNV_R_R_Def_n_sw_q_612_CM 8 -32768. 32767. FORMAT "%5.0" /end AXIS_DESCR
 /begin AXIS_DESCR STD_AXIS Rf _CNV_R_R_Def_rf_sw__616_CM 8 -327.68 327.67 FORMAT "%7.4" /end AXIS_DESCR
/end CHARACTERISTIC
/begin CHARACTERISTIC KF_ETA_TURBO "Kennfeld Turboladerwirkungsgrad" MAP 0xa10133e8 _REC_MAP_52_UBYTE_u2_s2_s2 3.9999 _CNV_R_R_Def_f_sw_b_608_CM 0. 3.9999 FORMAT "%14.5"
 /begin AXIS_DESCR STD_AXIS Nkw _CNV_R_R_Def_n_sw_q_612_CM 8 -32768. 32767. FORMAT "%5.0" /end AXIS_DESCR
 /begin AXIS_DESCR STD_AXIS NO_INPUT_QUANTITY _CNV_R_R_Def_rf_sw__616_CM 8 -327.68 327.67 FORMAT "%7.4" /end AXIS_DESCR
/end CHARACTERISTIC
/begin CHARACTERISTIC KF_GENTYP_NEU "Auswahlkennfeld Generatortyp" MAP 0xa10168e0 _REC_MAP_52_u1_u1_u1 6. _CNV_R_R_Def_dez_sl_575_CM 1. 7. FORMAT "%3.0"
 /begin AXIS_DESCR STD_AXIS Gen_manufak _CNV_R_R_Def_dez_sl_575_CM 6 0. 255. FORMAT "%3.0" /end AXIS_DESCR
 /begin AXIS_DESCR STD_AXIS Gen_typkenn _CNV_R_R_Def_dez_sl_575_CM 32 0. 255. FORMAT "%3.0" /end AXIS_DESCR
/end CHARACTERISTIC
/begin CHARACTERISTIC KF_GENWETA4 "Wirkungsgrad4 Generator mit 2*PI" MAP 0xa101641c _REC_MAP_52_u1_u1_s2 7.9687 _CNV_R_R_Def_f_ub_b_753_CM 0. 7.9687 FORMAT "%5.2" /begin AXIS_DESCR STD_AXIS I_gm _CNV_R_R_DEZ_436_CM 8 0. 255. /end AXIS_DESCR
 /begin AXIS_DESCR STD_AXIS N_gen _CNV_R_R_Def_n_sw_q_612_CM 8 -32768. 32767. FORMAT "%5.0" /end AXIS_DESCR
/end CHARACTERISTIC
/begin CHARACTERISTIC KF_IERRGREHT "Generatorstrombegrenzung bei Generatorhochtemparatur" MAP 0xa10166d0 _REC_MAP_52_u1_s2_s2 31.875 _CNV_R_R_Def_i_ub_q_645_CM 0. 31.875
 /begin AXIS_DESCR STD_AXIS N_gen _CNV_R_R_Def_n_sw_q_612_CM 3 -32768. 32767. FORMAT "%5.0" /end AXIS_DESCR
 /begin AXIS_DESCR STD_AXIS Gen_awnumm _CNV_R_R_Def_dez_sl_575_CM 6 -32768. 32767. FORMAT "%5.0" /end AXIS_DESCR
/end CHARACTERISTIC
/begin CHARACTERISTIC KF_IGENDF4 "Generatorstrom4 DF-Kennfeld" MAP 0xa1016590 _REC_MAP_52_u1_u1_u1 99.45 _CNV_R_R_DEZ_436_CM 0. 255.
 /begin AXIS_DESCR STD_AXIS Dffgen _CNV_R_R_Def_f_ub_b_602_CM 7 0. 99.60930000000001 FORMAT "%5.2" /end AXIS_DESCR
 /begin AXIS_DESCR STD_AXIS I_genmax _CNV_R_R_DEZ_436_CM 8 0. 255. /end AXIS_DESCR
/end CHARACTERISTIC
/begin CHARACTERISTIC KF_IGENKA4 "Kaltkennfeld 4 Generator" MAP 0xa10156c4 _REC_MAP_52_u1_u2_s2 99.45 _CNV_R_R_DEZ_436_CM 0. 255. /begin AXIS_DESCR STD_AXIS U_gen _CNV_R_R_Def_u_uw_q_731_CM 8 0. 6553.5 /end AXIS_DESCR
 /begin AXIS_DESCR STD_AXIS N_gen _CNV_R_R_Def_n_sw_q_612_CM 10 -32768. 32767. FORMAT "%5.0" /end AXIS_DESCR
/end CHARACTERISTIC
/begin CHARACTERISTIC KF_IGENWA4 "Warmkennfeld 4 Generator" MAP 0xa10153a0 _REC_MAP_52_u1_u1_s2 99.45 _CNV_R_R_DEZ_436_CM 0. 255. /begin AXIS_DESCR STD_AXIS Gen_i_kaltun _CNV_R_R_DEZ_436_CM 6 0. 255. /end AXIS_DESCR
 /begin AXIS_DESCR STD_AXIS Tgen_end _CNV_R_R_Def_t_sw_q_618_CM 8 -3276.8 3276.7 FORMAT "%4.1" /end AXIS_DESCR
/end CHARACTERISTIC
/begin CHARACTERISTIC KF_IU1T1_1 "" MAP 0xa10154dc _REC_MAP_52_UBYTE_s2_s2_s2 102.398435 _CNV_R_R_Def_i_sw_q_653_CM -1024. 1023.9687
 /begin AXIS_DESCR STD_AXIS NO_INPUT_QUANTITY _CNV_R_R_Def_i_ub_q_645_CM 10 -4096. 4095.875 /end AXIS_DESCR
 /begin AXIS_DESCR STD_AXIS N_gen _CNV_R_R_Def_n_sw_q_612_CM 10 -32768. 32767. FORMAT "%5.0" /end AXIS_DESCR
/end CHARACTERISTIC
/begin CHARACTERISTIC KF_IU1T1_2 "" MAP 0xa1014c00 _REC_MAP_52_UBYTE_s2_s2_s2 102.398435 _CNV_R_R_Def_i_sw_q_653_CM -1024. 1023.9687
 /begin AXIS_DESCR STD_AXIS NO_INPUT_QUANTITY _CNV_R_R_Def_i_ub_q_645_CM 10 -4096. 4095.875 /end AXIS_DESCR
 /begin AXIS_DESCR STD_AXIS N_gen _CNV_R_R_Def_n_sw_q_612_CM 10 -32768. 32767. FORMAT "%5.0" /end AXIS_DESCR
/end CHARACTERISTIC
/begin CHARACTERISTIC KF_IU1T1_3 "" MAP 0xa1014fd0 _REC_MAP_52_UBYTE_s2_s2_s2 102.398435 _CNV_R_R_Def_i_sw_q_653_CM -1024. 1023.9687
 /begin AXIS_DESCR STD_AXIS NO_INPUT_QUANTITY _CNV_R_R_Def_i_ub_q_645_CM 10 -4096. 4095.875 /end AXIS_DESCR
 /begin AXIS_DESCR STD_AXIS N_gen _CNV_R_R_Def_n_sw_q_612_CM 10 -32768. 32767. FORMAT "%5.0" /end AXIS_DESCR
/end CHARACTERISTIC
/begin CHARACTERISTIC KF_IU1T1_4 "" MAP 0xa1015830 _REC_MAP_52_UBYTE_s2_s2_s2 102.398435 _CNV_R_R_Def_i_sw_q_653_CM -1024. 1023.9687
 /begin AXIS_DESCR STD_AXIS NO_INPUT_QUANTITY _CNV_R_R_Def_i_ub_q_645_CM 10 -4096. 4095.875 /end AXIS_DESCR
 /begin AXIS_DESCR STD_AXIS N_gen _CNV_R_R_Def_n_sw_q_612_CM 10 -32768. 32767. FORMAT "%5.0" /end AXIS_DESCR
/end CHARACTERISTIC
/begin CHARACTERISTIC KF_IU1T1_5 "" MAP 0xa1015c00 _REC_MAP_52_UBYTE_s2_s2_s2 102.398435 _CNV_R_R_Def_i_sw_q_653_CM -1024. 1023.9687
 /begin AXIS_DESCR STD_AXIS NO_INPUT_QUANTITY _CNV_R_R_Def_i_ub_q_645_CM 10 -4096. 4095.875 /end AXIS_DESCR
 /begin AXIS_DESCR STD_AXIS N_gen _CNV_R_R_Def_n_sw_q_612_CM 10 -32768. 32767. FORMAT "%5.0" /end AXIS_DESCR
/end CHARACTERISTIC
/begin CHARACTERISTIC KF_IU1T1_6 "" MAP 0xa1015de8 _REC_MAP_52_UBYTE_s2_s2_s2 102.398435 _CNV_R_R_Def_i_sw_q_653_CM -1024. 1023.9687
 /begin AXIS_DESCR STD_AXIS NO_INPUT_QUANTITY _CNV_R_R_Def_i_ub_q_645_CM 10 -4096. 4095.875 /end AXIS_DESCR
 /begin AXIS_DESCR STD_AXIS N_gen _CNV_R_R_Def_n_sw_q_612_CM 10 -32768. 32767. FORMAT "%5.0" /end AXIS_DESCR
/end CHARACTERISTIC
/begin CHARACTERISTIC KF_IU1T2_1 "" MAP 0xa10155d0 _REC_MAP_52_UBYTE_s2_s2_s2 102.398435 _CNV_R_R_Def_i_sw_q_653_CM -1024. 1023.9687
 /begin AXIS_DESCR STD_AXIS NO_INPUT_QUANTITY _CNV_R_R_Def_i_ub_q_645_CM 10 -4096. 4095.875 /end AXIS_DESCR
 /begin AXIS_DESCR STD_AXIS N_gen _CNV_R_R_Def_n_sw_q_612_CM 10 -32768. 32767. FORMAT "%5.0" /end AXIS_DESCR
/end CHARACTERISTIC
/begin CHARACTERISTIC KF_IU1T2_2 "" MAP 0xa1014de8 _REC_MAP_52_UBYTE_s2_s2_s2 102.398435 _CNV_R_R_Def_i_sw_q_653_CM -1024. 1023.9687
 /begin AXIS_DESCR STD_AXIS NO_INPUT_QUANTITY _CNV_R_R_Def_i_ub_q_645_CM 10 -4096. 4095.875 /end AXIS_DESCR
 /begin AXIS_DESCR STD_AXIS N_gen _CNV_R_R_Def_n_sw_q_612_CM 10 -32768. 32767. FORMAT "%5.0" /end AXIS_DESCR
/end CHARACTERISTIC
/begin CHARACTERISTIC KF_IU1T2_3 "" MAP 0xa10151b8 _REC_MAP_52_UBYTE_s2_s2_s2 102.398435 _CNV_R_R_Def_i_sw_q_653_CM -1024. 1023.9687
 /begin AXIS_DESCR STD_AXIS NO_INPUT_QUANTITY _CNV_R_R_Def_i_ub_q_645_CM 10 -4096. 4095.875 /end AXIS_DESCR
 /begin AXIS_DESCR STD_AXIS N_gen _CNV_R_R_Def_n_sw_q_612_CM 10 -32768. 32767. FORMAT "%5.0" /end AXIS_DESCR
/end CHARACTERISTIC
/begin CHARACTERISTIC KF_IU1T2_4 "" MAP 0xa1015a18 _REC_MAP_52_UBYTE_s2_s2_s2 102.398435 _CNV_R_R_Def_i_sw_q_653_CM -1024. 1023.9687
 /begin AXIS_DESCR STD_AXIS NO_INPUT_QUANTITY _CNV_R_R_Def_i_ub_q_645_CM 10 -4096. 4095.875 /end AXIS_DESCR
 /begin AXIS_DESCR STD_AXIS N_gen _CNV_R_R_Def_n_sw_q_612_CM 10 -32768. 32767. FORMAT "%5.0" /end AXIS_DESCR
/end CHARACTERISTIC
/begin CHARACTERISTIC KF_IU1T2_5 "" MAP 0xa1015b0c _REC_MAP_52_UBYTE_s2_s2_s2 102.398435 _CNV_R_R_Def_i_sw_q_653_CM -1024. 1023.9687
 /begin AXIS_DESCR STD_AXIS NO_INPUT_QUANTITY _CNV_R_R_Def_i_ub_q_645_CM 10 -4096. 4095.875 /end AXIS_DESCR
 /begin AXIS_DESCR STD_AXIS N_gen _CNV_R_R_Def_n_sw_q_612_CM 10 -32768. 32767. FORMAT "%5.0" /end AXIS_DESCR
/end CHARACTERISTIC
/begin CHARACTERISTIC KF_IU1T2_6 "" MAP 0xa1015edc _REC_MAP_52_UBYTE_s2_s2_s2 102.398435 _CNV_R_R_Def_i_sw_q_653_CM -1024. 1023.9687
 /begin AXIS_DESCR STD_AXIS NO_INPUT_QUANTITY _CNV_R_R_Def_i_ub_q_645_CM 10 -4096. 4095.875 /end AXIS_DESCR
 /begin AXIS_DESCR STD_AXIS N_gen _CNV_R_R_Def_n_sw_q_612_CM 10 -32768. 32767. FORMAT "%5.0" /end AXIS_DESCR
/end CHARACTERISTIC
/begin CHARACTERISTIC KF_IU2T1_1 "" MAP 0xa10152ac _REC_MAP_52_UBYTE_s2_s2_s2 102.398435 _CNV_R_R_Def_i_sw_q_653_CM -1024. 1023.9687
 /begin AXIS_DESCR STD_AXIS NO_INPUT_QUANTITY _CNV_R_R_Def_i_ub_q_645_CM 10 -4096. 4095.875 /end AXIS_DESCR
 /begin AXIS_DESCR STD_AXIS N_gen _CNV_R_R_Def_n_sw_q_612_CM 10 -32768. 32767. FORMAT "%5.0" /end AXIS_DESCR
/end CHARACTERISTIC
/begin CHARACTERISTIC KF_IU2T1_2 "" MAP 0xa1014edc _REC_MAP_52_UBYTE_s2_s2_s2 102.398435 _CNV_R_R_Def_i_sw_q_653_CM -1024. 1023.9687
 /begin AXIS_DESCR STD_AXIS NO_INPUT_QUANTITY _CNV_R_R_Def_i_ub_q_645_CM 10 -4096. 4095.875 /end AXIS_DESCR
 /begin AXIS_DESCR STD_AXIS N_gen _CNV_R_R_Def_n_sw_q_612_CM 10 -32768. 32767. FORMAT "%5.0" /end AXIS_DESCR
/end CHARACTERISTIC
/begin CHARACTERISTIC KF_IU2T1_3 "" MAP 0xa1014b0c _REC_MAP_52_UBYTE_s2_s2_s2 102.398435 _CNV_R_R_Def_i_sw_q_653_CM -1024. 1023.9687
 /begin AXIS_DESCR STD_AXIS NO_INPUT_QUANTITY _CNV_R_R_Def_i_ub_q_645_CM 10 -4096. 4095.875 /end AXIS_DESCR
 /begin AXIS_DESCR STD_AXIS N_gen _CNV_R_R_Def_n_sw_q_612_CM 10 -32768. 32767. FORMAT "%5.0" /end AXIS_DESCR
/end CHARACTERISTIC
/begin CHARACTERISTIC KF_IU2T1_4 "" MAP 0xa1015924 _REC_MAP_52_UBYTE_s2_s2_s2 102.398435 _CNV_R_R_Def_i_sw_q_653_CM -1024. 1023.9687
 /begin AXIS_DESCR STD_AXIS NO_INPUT_QUANTITY _CNV_R_R_Def_i_ub_q_645_CM 10 -4096. 4095.875 /end AXIS_DESCR
 /begin AXIS_DESCR STD_AXIS N_gen _CNV_R_R_Def_n_sw_q_612_CM 10 -32768. 32767. FORMAT "%5.0" /end AXIS_DESCR
/end CHARACTERISTIC
/begin CHARACTERISTIC KF_IU2T1_5 "" MAP 0xa1015cf4 _REC_MAP_52_UBYTE_s2_s2_s2 102.398435 _CNV_R_R_Def_i_sw_q_653_CM -1024. 1023.9687
 /begin AXIS_DESCR STD_AXIS NO_INPUT_QUANTITY _CNV_R_R_Def_i_ub_q_645_CM 10 -4096. 4095.875 /end AXIS_DESCR
 /begin AXIS_DESCR STD_AXIS N_gen _CNV_R_R_Def_n_sw_q_612_CM 10 -32768. 32767. FORMAT "%5.0" /end AXIS_DESCR
/end CHARACTERISTIC
/begin CHARACTERISTIC KF_IU2T1_6 "" MAP 0xa1015fd0 _REC_MAP_52_UBYTE_s2_s2_s2 102.398435 _CNV_R_R_Def_i_sw_q_653_CM -1024. 1023.9687
 /begin AXIS_DESCR STD_AXIS NO_INPUT_QUANTITY _CNV_R_R_Def_i_ub_q_645_CM 10 -4096. 4095.875 /end AXIS_DESCR
 /begin AXIS_DESCR STD_AXIS N_gen _CNV_R_R_Def_n_sw_q_612_CM 10 -32768. 32767. FORMAT "%5.0" /end AXIS_DESCR
/end CHARACTERISTIC
/begin CHARACTERISTIC KF_LABAS_1 "Basislambda im Homgenen Bank 1" MAP 0xa1019eec _REC_MAP_52_UBYTE_u2_s2_s2 15.9997 _CNV_R_R_Def_f_uw_b_594_CM 0. 15.9997 FORMAT "%7.4"
 /begin AXIS_DESCR STD_AXIS Nkw _CNV_R_R_Def_n_sw_q_612_CM 12 -32768. 32767. FORMAT "%5.0" /end AXIS_DESCR
 /begin AXIS_DESCR STD_AXIS Rf _CNV_R_R_Def_rf_sw__616_CM 12 -327.68 327.67 FORMAT "%7.4" /end AXIS_DESCR
/end CHARACTERISTIC
/begin CHARACTERISTIC KF_LABAS_2 "Basislambda im Homgenen Bank 2" MAP 0xa101a040 _REC_MAP_52_UBYTE_u2_s2_s2 15.9997 _CNV_R_R_Def_f_uw_b_594_CM 0. 15.9997 FORMAT "%7.4"
 /begin AXIS_DESCR STD_AXIS Nkw _CNV_R_R_Def_n_sw_q_612_CM 12 -32768. 32767. FORMAT "%5.0" /end AXIS_DESCR
 /begin AXIS_DESCR STD_AXIS Rf _CNV_R_R_Def_rf_sw__616_CM 12 -327.68 327.67 FORMAT "%7.4" /end AXIS_DESCR
/end CHARACTERISTIC
/begin CHARACTERISTIC KF_LAHOMBAS "Basislambda im Homgen Mager Betrieb" MAP 0xa1019e48 _REC_MAP_52_UBYTE_u2_s2_s2 15.9997 _CNV_R_R_Def_f_uw_b_594_CM 0. 15.9997 FORMAT "%7.4"
 /begin AXIS_DESCR STD_AXIS Nkw _CNV_R_R_Def_n_sw_q_612_CM 8 -32768. 32767. FORMAT "%5.0" /end AXIS_DESCR
 /begin AXIS_DESCR STD_AXIS Mdi_soll_l _CNV_R_R_Def_ml_uw__662_CM 8 -3276.8 3276.7 FORMAT "%5.2" /end AXIS_DESCR
/end CHARACTERISTIC
/begin CHARACTERISTIC KF_LAWUP "Offset für Warm up" MAP 0xa101a194 _REC_MAP_52_UBYTE_u2_s2_s2 15.9997 _CNV_R_R_Def_f_uw_b_594_CM 0. 15.9997 FORMAT "%7.4"
 /begin AXIS_DESCR STD_AXIS Nkw _CNV_R_R_Def_n_sw_q_612_CM 6 -32768. 32767. FORMAT "%5.0" /end AXIS_DESCR
 /begin AXIS_DESCR STD_AXIS Rf _CNV_R_R_Def_rf_sw__616_CM 6 -327.68 327.67 FORMAT "%7.4" /end AXIS_DESCR
/end CHARACTERISTIC
/begin CHARACTERISTIC KF_LAWUP_LL "Offset für Warm up im Leerlauf" MAP 0xa101a1f8 _REC_MAP_52_UBYTE_u2_s2_s2 15.9997 _CNV_R_R_Def_f_uw_b_594_CM 0. 15.9997 FORMAT "%7.4"
 /begin AXIS_DESCR STD_AXIS Nkw _CNV_R_R_Def_n_sw_q_612_CM 3 -32768. 32767. FORMAT "%5.0" /end AXIS_DESCR
 /begin AXIS_DESCR STD_AXIS Rf _CNV_R_R_Def_rf_sw__616_CM 4 -327.68 327.67 FORMAT "%7.4" /end AXIS_DESCR
/end CHARACTERISTIC
/begin CHARACTERISTIC KF_MDGENFIL "Kennfeld Filterkonstante Generatormoment" MAP 0xa1016384 _REC_MAP_52_UBYTE_u2_u2_s2 0.9999847412109381 _CNV_R_R_Def_f_uw_b_591_CM 0. 0.9999847412109381 FORMAT "%14.5" /begin AXIS_DESCR STD_AXIS Dffgen_f _CNV_R_R_Def_f_uw_b_576_CM 6 0. 99.9984 /end AXIS_DESCR
 /begin AXIS_DESCR STD_AXIS NO_INPUT_QUANTITY _CNV_R_R_Def_dt_sw__603_CM 6 -4096. 4095.875 FORMAT "%5.2" /end AXIS_DESCR
/end CHARACTERISTIC
/begin CHARACTERISTIC KF_MU1T1_1 "" MAP 0xa10150c4 _REC_MAP_52_UBYTE_s2_s2_s2 131.07 _CNV_R_R_Def_m_sw_q_574_CM -3276.8 3276.7 FORMAT "%5.2"
 /begin AXIS_DESCR STD_AXIS Ierr _CNV_R_R_Def_i_ub_q_645_CM 10 -4096. 4095.875 /end AXIS_DESCR
 /begin AXIS_DESCR STD_AXIS N_gen _CNV_R_R_Def_n_sw_q_612_CM 10 -32768. 32767. FORMAT "%5.0" /end AXIS_DESCR
/end CHARACTERISTIC
/begin CHARACTERISTIC KF_MU1T1_2 "" MAP 0xa10165dc _REC_MAP_52_UBYTE_s2_s2_s2 131.07 _CNV_R_R_Def_m_sw_q_574_CM -3276.8 3276.7 FORMAT "%5.2"
 /begin AXIS_DESCR STD_AXIS Ierr _CNV_R_R_Def_i_ub_q_645_CM 10 -4096. 4095.875 /end AXIS_DESCR
 /begin AXIS_DESCR STD_AXIS N_gen _CNV_R_R_Def_n_sw_q_612_CM 10 -32768. 32767. FORMAT "%5.0" /end AXIS_DESCR
/end CHARACTERISTIC
/begin CHARACTERISTIC KF_MU1T1_3 "" MAP 0xa10167ec _REC_MAP_52_UBYTE_s2_s2_s2 131.07 _CNV_R_R_Def_m_sw_q_574_CM -3276.8 3276.7 FORMAT "%5.2"
 /begin AXIS_DESCR STD_AXIS Ierr _CNV_R_R_Def_i_ub_q_645_CM 10 -4096. 4095.875 /end AXIS_DESCR
 /begin AXIS_DESCR STD_AXIS N_gen _CNV_R_R_Def_n_sw_q_612_CM 10 -32768. 32767. FORMAT "%5.0" /end AXIS_DESCR
/end CHARACTERISTIC
/begin CHARACTERISTIC KF_MU1T1_4 "" MAP 0xa1016bb0 _REC_MAP_52_UBYTE_s2_s2_s2 131.07 _CNV_R_R_Def_m_sw_q_574_CM -3276.8 3276.7 FORMAT "%5.2"
 /begin AXIS_DESCR STD_AXIS Ierr _CNV_R_R_Def_i_ub_q_645_CM 10 -4096. 4095.875 /end AXIS_DESCR
 /begin AXIS_DESCR STD_AXIS N_gen _CNV_R_R_Def_n_sw_q_612_CM 10 -32768. 32767. FORMAT "%5.0" /end AXIS_DESCR
/end CHARACTERISTIC
/begin CHARACTERISTIC KF_MU1T1_5 "" MAP 0xa1016e8c _REC_MAP_52_UBYTE_s2_s2_s2 131.07 _CNV_R_R_Def_m_sw_q_574_CM -3276.8 3276.7 FORMAT "%5.2"
 /begin AXIS_DESCR STD_AXIS Ierr _CNV_R_R_Def_i_ub_q_645_CM 10 -4096. 4095.875 /end AXIS_DESCR
 /begin AXIS_DESCR STD_AXIS N_gen _CNV_R_R_Def_n_sw_q_612_CM 10 -32768. 32767. FORMAT "%5.0" /end AXIS_DESCR
/end CHARACTERISTIC
/begin CHARACTERISTIC KF_MU1T1_6 "" MAP 0xa1016f80 _REC_MAP_52_UBYTE_s2_s2_s2 131.07 _CNV_R_R_Def_m_sw_q_574_CM -3276.8 3276.7 FORMAT "%5.2"
 /begin AXIS_DESCR STD_AXIS Ierr _CNV_R_R_Def_i_ub_q_645_CM 10 -4096. 4095.875 /end AXIS_DESCR
 /begin AXIS_DESCR STD_AXIS N_gen _CNV_R_R_Def_n_sw_q_612_CM 10 -32768. 32767. FORMAT "%5.0" /end AXIS_DESCR
/end CHARACTERISTIC
/begin CHARACTERISTIC KF_MU1T2_1 "" MAP 0xa101649c _REC_MAP_52_UBYTE_s2_s2_s2 131.07 _CNV_R_R_Def_m_sw_q_574_CM -3276.8 3276.7 FORMAT "%5.2"
 /begin AXIS_DESCR STD_AXIS Ierr _CNV_R_R_Def_i_ub_q_645_CM 10 -4096. 4095.875 /end AXIS_DESCR
 /begin AXIS_DESCR STD_AXIS N_gen _CNV_R_R_Def_n_sw_q_612_CM 10 -32768. 32767. FORMAT "%5.0" /end AXIS_DESCR
/end CHARACTERISTIC
/begin CHARACTERISTIC KF_MU1T2_2 "" MAP 0xa10166f8 _REC_MAP_52_UBYTE_s2_s2_s2 131.07 _CNV_R_R_Def_m_sw_q_574_CM -3276.8 3276.7 FORMAT "%5.2"
 /begin AXIS_DESCR STD_AXIS Ierr _CNV_R_R_Def_i_ub_q_645_CM 10 -4096. 4095.875 /end AXIS_DESCR
 /begin AXIS_DESCR STD_AXIS N_gen _CNV_R_R_Def_n_sw_q_612_CM 10 -32768. 32767. FORMAT "%5.0" /end AXIS_DESCR
/end CHARACTERISTIC
/begin CHARACTERISTIC KF_MU1T2_3 "" MAP 0xa1016290 _REC_MAP_52_UBYTE_s2_s2_s2 131.07 _CNV_R_R_Def_m_sw_q_574_CM -3276.8 3276.7 FORMAT "%5.2"
 /begin AXIS_DESCR STD_AXIS Ierr _CNV_R_R_Def_i_ub_q_645_CM 10 -4096. 4095.875 /end AXIS_DESCR
 /begin AXIS_DESCR STD_AXIS N_gen _CNV_R_R_Def_n_sw_q_612_CM 10 -32768. 32767. FORMAT "%5.0" /end AXIS_DESCR
/end CHARACTERISTIC
/begin CHARACTERISTIC KF_MU1T2_4 "" MAP 0xa10169c8 _REC_MAP_52_UBYTE_s2_s2_s2 131.07 _CNV_R_R_Def_m_sw_q_574_CM -3276.8 3276.7 FORMAT "%5.2"
 /begin AXIS_DESCR STD_AXIS Ierr _CNV_R_R_Def_i_ub_q_645_CM 10 -4096. 4095.875 /end AXIS_DESCR
 /begin AXIS_DESCR STD_AXIS N_gen _CNV_R_R_Def_n_sw_q_612_CM 10 -32768. 32767. FORMAT "%5.0" /end AXIS_DESCR
/end CHARACTERISTIC
/begin CHARACTERISTIC KF_MU1T2_5 "" MAP 0xa1016ca4 _REC_MAP_52_UBYTE_s2_s2_s2 131.07 _CNV_R_R_Def_m_sw_q_574_CM -3276.8 3276.7 FORMAT "%5.2"
 /begin AXIS_DESCR STD_AXIS Ierr _CNV_R_R_Def_i_ub_q_645_CM 10 -4096. 4095.875 /end AXIS_DESCR
 /begin AXIS_DESCR STD_AXIS N_gen _CNV_R_R_Def_n_sw_q_612_CM 10 -32768. 32767. FORMAT "%5.0" /end AXIS_DESCR
/end CHARACTERISTIC
/begin CHARACTERISTIC KF_MU1T2_6 "" MAP 0xa1017074 _REC_MAP_52_UBYTE_s2_s2_s2 131.07 _CNV_R_R_Def_m_sw_q_574_CM -3276.8 3276.7 FORMAT "%5.2"
 /begin AXIS_DESCR STD_AXIS Ierr _CNV_R_R_Def_i_ub_q_645_CM 10 -4096. 4095.875 /end AXIS_DESCR
 /begin AXIS_DESCR STD_AXIS N_gen _CNV_R_R_Def_n_sw_q_612_CM 10 -32768. 32767. FORMAT "%5.0" /end AXIS_DESCR
/end CHARACTERISTIC
/begin CHARACTERISTIC KF_MU2T1_1 "" MAP 0xa10153e8 _REC_MAP_52_UBYTE_s2_s2_s2 131.07 _CNV_R_R_Def_m_sw_q_574_CM -3276.8 3276.7 FORMAT "%5.2"
 /begin AXIS_DESCR STD_AXIS Ierr _CNV_R_R_Def_i_ub_q_645_CM 10 -4096. 4095.875 /end AXIS_DESCR
 /begin AXIS_DESCR STD_AXIS N_gen _CNV_R_R_Def_n_sw_q_612_CM 10 -32768. 32767. FORMAT "%5.0" /end AXIS_DESCR
/end CHARACTERISTIC
/begin CHARACTERISTIC KF_MU2T1_2 "" MAP 0xa1014cf4 _REC_MAP_52_UBYTE_s2_s2_s2 131.07 _CNV_R_R_Def_m_sw_q_574_CM -3276.8 3276.7 FORMAT "%5.2"
 /begin AXIS_DESCR STD_AXIS Ierr _CNV_R_R_Def_i_ub_q_645_CM 10 -4096. 4095.875 /end AXIS_DESCR
 /begin AXIS_DESCR STD_AXIS N_gen _CNV_R_R_Def_n_sw_q_612_CM 10 -32768. 32767. FORMAT "%5.0" /end AXIS_DESCR
/end CHARACTERISTIC
/begin CHARACTERISTIC KF_MU2T1_3 "" MAP 0xa101573c _REC_MAP_52_UBYTE_s2_s2_s2 131.07 _CNV_R_R_Def_m_sw_q_574_CM -3276.8 3276.7 FORMAT "%5.2"
 /begin AXIS_DESCR STD_AXIS Ierr _CNV_R_R_Def_i_ub_q_645_CM 10 -4096. 4095.875 /end AXIS_DESCR
 /begin AXIS_DESCR STD_AXIS N_gen _CNV_R_R_Def_n_sw_q_612_CM 10 -32768. 32767. FORMAT "%5.0" /end AXIS_DESCR
/end CHARACTERISTIC
/begin CHARACTERISTIC KF_MU2T1_4 "" MAP 0xa1016abc _REC_MAP_52_UBYTE_s2_s2_s2 131.07 _CNV_R_R_Def_m_sw_q_574_CM -3276.8 3276.7 FORMAT "%5.2"
 /begin AXIS_DESCR STD_AXIS Ierr _CNV_R_R_Def_i_ub_q_645_CM 10 -4096. 4095.875 /end AXIS_DESCR
 /begin AXIS_DESCR STD_AXIS N_gen _CNV_R_R_Def_n_sw_q_612_CM 10 -32768. 32767. FORMAT "%5.0" /end AXIS_DESCR
/end CHARACTERISTIC
/begin CHARACTERISTIC KF_MU2T1_5 "" MAP 0xa1016d98 _REC_MAP_52_UBYTE_s2_s2_s2 131.07 _CNV_R_R_Def_m_sw_q_574_CM -3276.8 3276.7 FORMAT "%5.2"
 /begin AXIS_DESCR STD_AXIS Ierr _CNV_R_R_Def_i_ub_q_645_CM 10 -4096. 4095.875 /end AXIS_DESCR
 /begin AXIS_DESCR STD_AXIS N_gen _CNV_R_R_Def_n_sw_q_612_CM 10 -32768. 32767. FORMAT "%5.0" /end AXIS_DESCR
/end CHARACTERISTIC
/begin CHARACTERISTIC KF_MU2T1_6 "" MAP 0xa1017168 _REC_MAP_52_UBYTE_s2_s2_s2 131.07 _CNV_R_R_Def_m_sw_q_574_CM -3276.8 3276.7 FORMAT "%5.2"
 /begin AXIS_DESCR STD_AXIS Ierr _CNV_R_R_Def_i_ub_q_645_CM 10 -4096. 4095.875 /end AXIS_DESCR
 /begin AXIS_DESCR STD_AXIS N_gen _CNV_R_R_Def_n_sw_q_612_CM 10 -32768. 32767. FORMAT "%5.0" /end AXIS_DESCR
/end CHARACTERISTIC
/begin CHARACTERISTIC KF_PSREGAGR_I "Ps regler I-Anteil bei AGR" MAP 0xa1012c18 _REC_MAP_52_UBYTE_u2_s2_u2 1.9999 _CNV_R_R_Def_f_uw_b_579_CM 0. 1.9999 FORMAT "%14.5"
 /begin AXIS_DESCR STD_AXIS Nkw _CNV_R_R_Def_n_sw_q_612_CM 4 -32768. 32767. FORMAT "%5.0" /end AXIS_DESCR
 /begin AXIS_DESCR STD_AXIS Pspvdk_soll _CNV_R_R_Def_f_sw_b_608_CM 4 0. 3.9999 FORMAT "%14.5" /end AXIS_DESCR
/end CHARACTERISTIC
/begin CHARACTERISTIC KF_PSREGAGR_P "Ps regler P-Anteil bei AGR" MAP 0xa1012be4 _REC_MAP_52_UBYTE_u2_s2_u2 63.99900000000001 _CNV_R_R_Def_f_uw_b_580_CM 0. 63.999 FORMAT "%7.4"
 /begin AXIS_DESCR STD_AXIS Nkw _CNV_R_R_Def_n_sw_q_612_CM 4 -32768. 32767. FORMAT "%5.0" /end AXIS_DESCR
 /begin AXIS_DESCR STD_AXIS Pspvdk_soll _CNV_R_R_Def_f_sw_b_608_CM 4 0. 3.9999 FORMAT "%14.5" /end AXIS_DESCR
/end CHARACTERISTIC
/begin CHARACTERISTIC KF_PSREG_I "Ps regler I-Anteil" MAP 0xa1012bb0 _REC_MAP_52_UBYTE_u2_s2_u2 1.9999 _CNV_R_R_Def_f_uw_b_579_CM 0. 1.9999 FORMAT "%14.5"
 /begin AXIS_DESCR STD_AXIS Nkw _CNV_R_R_Def_n_sw_q_612_CM 4 -32768. 32767. FORMAT "%5.0" /end AXIS_DESCR
 /begin AXIS_DESCR STD_AXIS Pspvdk_soll _CNV_R_R_Def_f_sw_b_608_CM 4 0. 3.9999 FORMAT "%14.5" /end AXIS_DESCR
/end CHARACTERISTIC
/begin CHARACTERISTIC KF_PSREG_P "Ps regler P-Anteil" MAP 0xa1012b7c _REC_MAP_52_UBYTE_u2_s2_u2 63.99900000000001 _CNV_R_R_Def_f_uw_b_580_CM 0. 63.999 FORMAT "%7.4"
 /begin AXIS_DESCR STD_AXIS Nkw _CNV_R_R_Def_n_sw_q_612_CM 4 -32768. 32767. FORMAT "%5.0" /end AXIS_DESCR
 /begin AXIS_DESCR STD_AXIS Pspvdk_soll _CNV_R_R_Def_f_sw_b_608_CM 4 0. 3.9999 FORMAT "%14.5" /end AXIS_DESCR
/end CHARACTERISTIC
/begin CHARACTERISTIC KF_PSR_KOR "Korrekturfaktor PSR" MAP 0xa1012a34 _REC_MAP_52_UBYTE_u2_u2_u2 15.9997 _CNV_R_R_Def_f_uw_b_594_CM 0. 15.9997 FORMAT "%7.4"
 /begin AXIS_DESCR STD_AXIS Pspvdk_soll _CNV_R_R_Def_f_sw_b_608_CM 8 0. 3.9999 FORMAT "%14.5" /end AXIS_DESCR
 /begin AXIS_DESCR STD_AXIS Pvdkds _CNV_R_R_Def_p_sw_q_578_CM 8 0. 2559.9609 FORMAT "%5.2" /end AXIS_DESCR
/end CHARACTERISTIC
/begin CHARACTERISTIC KF_TANSGENKO "Kennfeld zur Bestimmung Ansauglufttemparatur Generator" MAP 0xa10163e8 _REC_MAP_52_UBYTE_s2_s2_s2 131.07 _CNV_R_R_Def_t_sw_q_618_CM -3276.8 3276.7 FORMAT "%4.1"
 /begin AXIS_DESCR STD_AXIS Tchip_fil_l _CNV_R_R_Def_t_sw_q_618_CM 4 -3276.8 3276.7 FORMAT "%4.1" /end AXIS_DESCR
 /begin AXIS_DESCR STD_AXIS N_gen _CNV_R_R_Def_n_sw_q_612_CM 4 -32768. 32767. FORMAT "%5.0" /end AXIS_DESCR
/end CHARACTERISTIC
/begin CHARACTERISTIC KF_UFDIODE "Kennfeld für Diodenvorwärtsspannung" MAP 0xa1016478 _REC_MAP_52_UBYTE_u2_s2_u1 99.198481 _CNV_R_R_Def_u_uw_q_734_CM 0. 319.9951
 /begin AXIS_DESCR STD_AXIS Tans_gen _CNV_R_R_Def_t_sw_q_618_CM 2 -3276.8 3276.7 FORMAT "%4.1" /end AXIS_DESCR
 /begin AXIS_DESCR STD_AXIS Gen_awnumm _CNV_R_R_Def_dez_sl_575_CM 6 0. 255. FORMAT "%3.0" /end AXIS_DESCR
/end CHARACTERISTIC
/begin CHARACTERISTIC KL_CAGRAD_AGRPOS "" CURVE 0xa10129e8 _REC_CUR_20_s2_u1 99.99690000000001 _CNV_R_R_Def_f_sw_b_597_CM 0. 99.9969
 /begin AXIS_DESCR COM_AXIS Modelle _CNV_R_R_Def_dez_sl_575_CM 5 0. 255. FORMAT "%3.0" AXIS_PTS_REF GAX_5MODELLE /end AXIS_DESCR
/end CHARACTERISTIC
/begin CHARACTERISTIC KL_CKH_NKW "Zentren Lolimot-Modelle Eingang Nkw, KHNN" CURVE 0xa1014898 _REC_CUR_20_s2_u1 65535. _CNV_R_R_Def_n_sw_q_612_CM -32768. 32767. FORMAT "%5.0"
 /begin AXIS_DESCR COM_AXIS Modelle _CNV_R_R_Def_dez_sl_575_CM 6 0. 255. FORMAT "%3.0" AXIS_PTS_REF GAX_KHMOD /end AXIS_DESCR
/end CHARACTERISTIC
/begin CHARACTERISTIC KL_CKH_RK "Zentren Lolimot-Modelle Eingang Rk_soll_s, KHNN" CURVE 0xa10148a4 _REC_CUR_20_s2_u1 3199.951100000001 _CNV_R_R_Def_rk_sw__697_CM -1600. 1599.9511
 /begin AXIS_DESCR COM_AXIS Modelle _CNV_R_R_Def_dez_sl_575_CM 6 0. 255. FORMAT "%3.0" AXIS_PTS_REF GAX_KHMOD /end AXIS_DESCR
/end CHARACTERISTIC
/begin CHARACTERISTIC KL_CKH_TANS "Zentren Lolimot-Modelle Eingang Tans, KHNN" CURVE 0xa10148b0 _REC_CUR_20_s2_u1 6553.5 _CNV_R_R_Def_t_sw_q_618_CM -3276.8 3276.7 FORMAT "%4.1"
 /begin AXIS_DESCR COM_AXIS Modelle _CNV_R_R_Def_dez_sl_575_CM 6 0. 255. FORMAT "%3.0" AXIS_PTS_REF GAX_KHMOD /end AXIS_DESCR
/end CHARACTERISTIC
/begin CHARACTERISTIC KL_CKR_BA_IST "Zentren Lolimot-Modelle Eingang Ba_ist, KRANN" CURVE 0xa10147d8 _REC_CUR_20_s2_u1 655.35 _CNV_R_R_Def_lf_ub__675_CM -327.68 327.67 FORMAT "%5.2"
 /begin AXIS_DESCR COM_AXIS Modelle _CNV_R_R_Def_dez_sl_575_CM 15 0. 255. FORMAT "%3.0" AXIS_PTS_REF GAX_KRMOD /end AXIS_DESCR
/end CHARACTERISTIC
/begin CHARACTERISTIC KL_CKR_NKW "Zentren Lolimot-Modelle Eingang Nkw, KRANN" CURVE 0xa1014758 _REC_CUR_20_s2_u1 65535. _CNV_R_R_Def_n_sw_q_612_CM -32768. 32767. FORMAT "%5.0"
 /begin AXIS_DESCR COM_AXIS Modelle _CNV_R_R_Def_dez_sl_575_CM 15 0. 255. FORMAT "%3.0" AXIS_PTS_REF GAX_KRMOD /end AXIS_DESCR
/end CHARACTERISTIC
/begin CHARACTERISTIC KL_CKR_RK "Zentren Lolimot-Modelle Eingang Rk_soll_kr, KRANN" CURVE 0xa1014778 _REC_CUR_20_s2_u1 3199.951100000001 _CNV_R_R_Def_rk_sw__697_CM -1600. 1599.9511
 /begin AXIS_DESCR COM_AXIS Modelle _CNV_R_R_Def_dez_sl_575_CM 15 0. 255. FORMAT "%3.0" AXIS_PTS_REF GAX_KRMOD /end AXIS_DESCR
/end CHARACTERISTIC
/begin CHARACTERISTIC KL_CKR_TANS "Zentren Lolimot-Modelle Eingang Tans, KRANN" CURVE 0xa1014798 _REC_CUR_20_s2_u1 6553.5 _CNV_R_R_Def_t_sw_q_618_CM -3276.8 3276.7 FORMAT "%4.1"
 /begin AXIS_DESCR COM_AXIS Modelle _CNV_R_R_Def_dez_sl_575_CM 15 0. 255. FORMAT "%3.0" AXIS_PTS_REF GAX_KRMOD /end AXIS_DESCR
/end CHARACTERISTIC
/begin CHARACTERISTIC KL_CKR_TMOT "Zentren Lolimot-Modelle Eingang Tmot, KRANN" CURVE 0xa10147b8 _REC_CUR_20_s2_u1 655.35 _CNV_R_R_Def_t_sw_q_620_CM -327.68 327.67 FORMAT "%5.2"
 /begin AXIS_DESCR COM_AXIS Modelle _CNV_R_R_Def_dez_sl_575_CM 15 0. 255. FORMAT "%3.0" AXIS_PTS_REF GAX_KRMOD /end AXIS_DESCR
/end CHARACTERISTIC
/begin CHARACTERISTIC KL_CPSAD_N "" CURVE 0xa101296c _REC_CUR_20_s2_u1 65535. _CNV_R_R_Def_n_sw_q_612_CM -32768. 32767. FORMAT "%5.0"
 /begin AXIS_DESCR COM_AXIS Modelle _CNV_R_R_Def_dez_sl_575_CM 5 0. 255. FORMAT "%3.0" AXIS_PTS_REF GAX_5MODELLE /end AXIS_DESCR
/end CHARACTERISTIC
/begin CHARACTERISTIC KL_CPSAD_VSA_SPRI "" CURVE 0xa1012984 _REC_CUR_20_u2_u1 6553.5 _CNV_R_R_Def_spr_sw_583_CM 0. 6553.5 FORMAT "%5.2"
 /begin AXIS_DESCR COM_AXIS Modelle _CNV_R_R_Def_dez_sl_575_CM 5 0. 255. FORMAT "%3.0" AXIS_PTS_REF GAX_5MODELLE /end AXIS_DESCR
/end CHARACTERISTIC
/begin CHARACTERISTIC KL_CPSAD_VSE_SPRI "" CURVE 0xa1012978 _REC_CUR_20_u2_u1 6553.5 _CNV_R_R_Def_spr_sw_583_CM 0. 6553.5 FORMAT "%5.2"
 /begin AXIS_DESCR COM_AXIS Modelle _CNV_R_R_Def_dez_sl_575_CM 5 0. 255. FORMAT "%3.0" AXIS_PTS_REF GAX_5MODELLE /end AXIS_DESCR
/end CHARACTERISTIC
/begin CHARACTERISTIC KL_DLA_GLTM "Kennlinie Korrekturfaktor Zylindergleichstellung" CURVE 0xa1019e24 _REC_CUR_TKL_UW_VV__s2_s2 15.9997 _CNV_R_R_Def_f_sw_b_607_CM -8. 7.9997 FORMAT "%7.4"
 /begin AXIS_DESCR STD_AXIS Tmot _CNV_R_R_Def_t_sw_q_620_CM 8 -327.68 327.67 FORMAT "%5.2" /end AXIS_DESCR
/end CHARACTERISTIC
/begin CHARACTERISTIC KL_DPLF "Druckverlust über Luftfilter" CURVE 0xa1013358 _REC_CUR_TKL_UW_VV__u2_s2 102.398436 _CNV_R_R_Def_p_sw_q_578_CM 0. 2559.9609
 /begin AXIS_DESCR STD_AXIS Nkw _CNV_R_R_Def_n_sw_q_612_CM 8 -32768. 32767. FORMAT "%5.0" /end AXIS_DESCR
/end CHARACTERISTIC
/begin CHARACTERISTIC KL_ETAAGRAD "" CURVE 0xa1012a00 _REC_CUR_TKL_UW_VV__S4_S4 0. _CNV_R_R_Def_dez_sl_575_CM 0. 10000000000000. FORMAT "%14.7"
 /begin AXIS_DESCR STD_AXIS NO_INPUT_QUANTITY _CNV_R_R_Def_dez_sl_575_CM 6 -1000000000000. 10000000000000. FORMAT "%14.7" /end AXIS_DESCR
/end CHARACTERISTIC
/begin CHARACTERISTIC KL_ETAKRFR "Lernfaktor für Frühverstellung" CURVE 0xa1014708 _REC_CUR_TKL_UW_VV__S4_S4 0. _CNV_R_R_Def_dez_sl_575_CM -1000000000000. 10000000000000. FORMAT "%14.7"
 /begin AXIS_DESCR STD_AXIS NO_INPUT_QUANTITY _CNV_R_R_Def_dez_sl_575_CM 6 -1000000000000. 10000000000000. FORMAT "%14.7" /end AXIS_DESCR
/end CHARACTERISTIC
/begin CHARACTERISTIC KL_ETAKRSP "Lernfaktor für Spätverstellung" CURVE 0xa10146d4 _REC_CUR_TKL_UW_VV__S4_S4 0. _CNV_R_R_Def_dez_sl_575_CM -1000000000000. 10000000000000. FORMAT "%14.7"
 /begin AXIS_DESCR STD_AXIS NO_INPUT_QUANTITY _CNV_R_R_Def_dez_sl_575_CM 6 -1000000000000. 10000000000000. FORMAT "%14.7" /end AXIS_DESCR
/end CHARACTERISTIC
/begin CHARACTERISTIC KL_ETAPSAD "" CURVE 0xa10129b4 _REC_CUR_TKL_UW_VV__S4_S4 0. _CNV_R_R_Def_dez_sl_575_CM 0. 10000000000000. FORMAT "%14.7"
 /begin AXIS_DESCR STD_AXIS NO_INPUT_QUANTITY _CNV_R_R_Def_dez_sl_575_CM 6 -1000000000000. 10000000000000. FORMAT "%14.7" /end AXIS_DESCR
/end CHARACTERISTIC
/begin CHARACTERISTIC KL_ETA_LAMBDA "" CURVE 0xa1019d58 _REC_CUR_TKL_UW_VV__s2_u2 99.99844999999999 _CNV_R_R_Def_eta_sw_617_CM -200. 199.9938
 /begin AXIS_DESCR STD_AXIS NO_INPUT_QUANTITY _CNV_R_R_Def_f_uw_b_594_CM 8 0. 15.9997 FORMAT "%7.4" /end AXIS_DESCR
/end CHARACTERISTIC
/begin CHARACTERISTIC KL_FPDIODE4 "Verlustleistungsfaktor eines Diodenpaars4" CURVE 0xa101627c _REC_CUR_TKL_UW_VV__u1_s2 1.9921 _CNV_R_R_Def_f_ub_b_625_CM 0. 1.9921
 /begin AXIS_DESCR STD_AXIS Tgen _CNV_R_R_Def_t_sw_q_618_CM 5 -3276.8 3276.7 FORMAT "%4.1" /end AXIS_DESCR
/end CHARACTERISTIC
/begin CHARACTERISTIC KL_GENEXP4 "Abkühlkurve Generator4" CURVE 0xa10161e8 _REC_CUR_TKL_UW_VV__u1_u2 0.996 _CNV_R_R_Def_f_ub_b_573_CM 0. 0.996
 /begin AXIS_DESCR STD_AXIS Tn_abstell _CNV_R_R_Def_dez_sl_575_CM 13 0. 65535. FORMAT "%5.0" /end AXIS_DESCR
/end CHARACTERISTIC
/begin CHARACTERISTIC KL_GENTETA4 "Temperatur_eta_faktor Generator4" CURVE 0xa1016158 _REC_CUR_TKL_UW_VV__u2_s2 1.9999 _CNV_R_R_Def_f_uw_b_579_CM 0. 1.9999 FORMAT "%14.5"
 /begin AXIS_DESCR STD_AXIS Tgen _CNV_R_R_Def_t_sw_q_618_CM 3 -3276.8 3276.7 FORMAT "%4.1" /end AXIS_DESCR
/end CHARACTERISTIC
/begin CHARACTERISTIC KL_KFTKRMN "Kennlinie Zeitverzögerung Mszyl über Drehzahl (untere Schwelle)" CURVE 0xa1014680 _REC_CUR_TKL_UW_VV__s2_s2 100.1 _CNV_R_R_Def_zw_sw__599_CM -50. 60. FORMAT "%5.2"
 /begin AXIS_DESCR STD_AXIS Nkw _CNV_R_R_Def_n_sw_q_612_CM 6 -32768. 32767. FORMAT "%5.0" /end AXIS_DESCR
/end CHARACTERISTIC
/begin CHARACTERISTIC KL_KFTKRMX "Kennlinie Zeitverzögerung Mszyl über Drehzahl (obere Schwelle)" CURVE 0xa1014664 _REC_CUR_TKL_UW_VV__s2_s2 100.1 _CNV_R_R_Def_zw_sw__599_CM -50. 60. FORMAT "%5.2"
 /begin AXIS_DESCR STD_AXIS Nkw _CNV_R_R_Def_n_sw_q_612_CM 6 -32768. 32767. FORMAT "%5.0" /end AXIS_DESCR
/end CHARACTERISTIC
/begin CHARACTERISTIC KL_LABASKOR "Kennlinie Warmup Korrektur  abh. von Tmot" CURVE 0xa1019e08 _REC_CUR_TKL_UW_VV__s1_s2 1.9921 _CNV_R_R_Def_f_sb_b_699_CM -1. 0.9921
 /begin AXIS_DESCR STD_AXIS Tmot _CNV_R_R_Def_t_sw_q_620_CM 8 -327.68 327.67 FORMAT "%5.2" /end AXIS_DESCR
/end CHARACTERISTIC
/begin CHARACTERISTIC KL_LA_VL1 "Kennlinie für Volllast Homogen Bank1" CURVE 0xa1019d9c _REC_CUR_TKL_UW_VV__u2_s2 15.9997 _CNV_R_R_Def_f_uw_b_594_CM 0. 15.9997 FORMAT "%7.4"
 /begin AXIS_DESCR STD_AXIS Nkw _CNV_R_R_Def_n_sw_q_612_CM 8 -32768. 32767. FORMAT "%5.0" /end AXIS_DESCR
/end CHARACTERISTIC
/begin CHARACTERISTIC KL_LA_VL2 "Kennlinie für Volllast Homogen Bank2" CURVE 0xa1019dc0 _REC_CUR_TKL_UW_VV__u2_s2 15.9997 _CNV_R_R_Def_f_uw_b_594_CM 0. 15.9997 FORMAT "%7.4"
 /begin AXIS_DESCR STD_AXIS Nkw _CNV_R_R_Def_n_sw_q_612_CM 8 -32768. 32767. FORMAT "%5.0" /end AXIS_DESCR
/end CHARACTERISTIC
/begin CHARACTERISTIC KL_MDZIEL "Zielmomentenreserve für Generator bei BN i.O." CURVE 0xa1017c34 _REC_CUR_TKL_UW_VV__s2_s2 98.30250000000001 _CNV_R_R_Def_m_sw_q_659_CM -327.68 327.67 FORMAT "%5.2"
 /begin AXIS_DESCR STD_AXIS Md_res_real _CNV_R_R_Def_m_sw_q_574_CM 6 -3276.8 3276.7 FORMAT "%5.2" /end AXIS_DESCR
/end CHARACTERISTIC
/begin CHARACTERISTIC KL_MDZIEL2 "Zielmomentenreserve für Generator bei BN n.i.O." CURVE 0xa1017c04 _REC_CUR_TKL_UW_VV__s2_s2 98.30250000000001 _CNV_R_R_Def_m_sw_q_659_CM -327.68 327.67 FORMAT "%5.2"
 /begin AXIS_DESCR STD_AXIS Md_res_real _CNV_R_R_Def_m_sw_q_574_CM 6 -3276.8 3276.7 FORMAT "%5.2" /end AXIS_DESCR
/end CHARACTERISTIC
/begin CHARACTERISTIC KL_MDZIELNKWKORR "Drehzahlkorrektur für Zielreserve" CURVE 0xa1017c50 _REC_CUR_TKL_UW_VV__s2_s2 98.30250000000001 _CNV_R_R_Def_m_sw_q_659_CM -327.68 327.67 FORMAT "%5.2"
 /begin AXIS_DESCR STD_AXIS Nkw _CNV_R_R_Def_n_sw_q_612_CM 6 -32768. 32767. FORMAT "%5.0" /end AXIS_DESCR
/end CHARACTERISTIC
/begin CHARACTERISTIC KL_NABNTEIL "Momentenoffset auf Zielreserve Generatorlimitierung" CURVE 0xa1017c20 _REC_CUR_TKL_UW_VV__s2_u1 98.30250000000001 _CNV_R_R_Def_m_sw_q_659_CM -327.68 327.67 FORMAT "%5.2" /begin AXIS_DESCR STD_AXIS Ierr _CNV_R_R_Def_i_ub_q_645_CM 6 0. 31.875 /end AXIS_DESCR /end CHARACTERISTIC
/begin CHARACTERISTIC KL_NELUEFTGE "E-Lüfteranforderung Generator" CURVE 0xa10161ac _REC_CUR_TKL_UW_VV__u1_u1 99.60930000000001 _CNV_R_R_Def_f_ub_b_602_CM 0. 99.60930000000001 FORMAT "%5.2"
 /begin AXIS_DESCR STD_AXIS Gen_awnumm _CNV_R_R_Def_dez_sl_575_CM 6 0. 255. FORMAT "%3.0" /end AXIS_DESCR
/end CHARACTERISTIC
/begin CHARACTERISTIC KL_PRAT2FLOW_TURB "Turbinengleichung" CURVE 0xa10133c4 _REC_CUR_TKL_UW_VV__u2_u2 0.9999847412109381 _CNV_R_R_Def_f_uw_b_591_CM 0. 0.9999847412109381 FORMAT "%14.5"
 /begin AXIS_DESCR STD_AXIS NO_INPUT_QUANTITY _CNV_R_R_Def_f_sw_b_608_CM 8 0. 3.9999 FORMAT "%14.5" /end AXIS_DESCR
/end CHARACTERISTIC
/begin CHARACTERISTIC KL_PRAT2FLOW_VERD "Verdichtergleichung" CURVE 0xa10133a0 _REC_CUR_TKL_UW_VV__u2_u2 0.9999694824218756 _CNV_R_R_Def_f_uw_b_591_CM 1.52587890625e-005 0.9999847412109381 FORMAT "%14.5"
 /begin AXIS_DESCR STD_AXIS NO_INPUT_QUANTITY _CNV_R_R_Def_f_sw_b_608_CM 8 0. 3.9999 FORMAT "%14.5" /end AXIS_DESCR
/end CHARACTERISTIC
/begin CHARACTERISTIC KL_RKMIN_KH "Kennlinie Rk_soll_kr-Schwelle für KHNN" CURVE 0xa10146b8 _REC_CUR_TKL_UW_VV__s2_s2 95.99853300000001 _CNV_R_R_Def_rk_sw__697_CM -1600. 1599.9511 FORMAT "%5.2"
 /begin AXIS_DESCR STD_AXIS Nkw _CNV_R_R_Def_n_sw_q_612_CM 6 -32768. 32767. FORMAT "%5.0" /end AXIS_DESCR
/end CHARACTERISTIC
/begin CHARACTERISTIC KL_RKMIN_KR "Kennlinie Rk_soll_kr-Schwelle" CURVE 0xa101469c _REC_CUR_TKL_UW_VV__s2_s2 95.99853300000001 _CNV_R_R_Def_rk_sw__697_CM -1600. 1599.9511 FORMAT "%5.2"
 /begin AXIS_DESCR STD_AXIS Nkw _CNV_R_R_Def_n_sw_q_612_CM 6 -32768. 32767. FORMAT "%5.0" /end AXIS_DESCR
/end CHARACTERISTIC
/begin CHARACTERISTIC KL_RTH0FAK4 "RTHfaktor4 ueber Generatorstrom" CURVE 0xa1016168 _REC_CUR_TKL_UW_VV__u1_u1 3.9843 _CNV_R_R_Def_f_ub_b_670_CM 0. 3.9843 FORMAT "%5.2" /begin AXIS_DESCR STD_AXIS I_gen_end _CNV_R_R_DEZ_436_CM 11 0. 255. /end AXIS_DESCR /end CHARACTERISTIC
/begin CHARACTERISTIC KL_RTHFAK4 "RTHfaktor4 ueber Generatorstrom Fahrt" CURVE 0xa1016230 _REC_CUR_TKL_UW_VV__u1_u1 3.9843 _CNV_R_R_Def_f_ub_b_670_CM 0. 3.9843 FORMAT "%5.2" /begin AXIS_DESCR STD_AXIS I_gen_end _CNV_R_R_DEZ_436_CM 11 0. 255. /end AXIS_DESCR /end CHARACTERISTIC
/begin CHARACTERISTIC KL_RTHGEN4 "RTH-Kennfeld Generator4" CURVE 0xa1016260 _REC_CUR_TKL_UW_VV__u2_s2 1. _CNV_R_R_Def_f_uw_b_580_CM 0. 1. FORMAT "%7.4"
 /begin AXIS_DESCR STD_AXIS N_gen _CNV_R_R_Def_n_sw_q_612_CM 6 -32768. 32767. FORMAT "%5.0" /end AXIS_DESCR
/end CHARACTERISTIC
/begin CHARACTERISTIC KL_RTHJADIOD "Temperaturkoeffizient der Diode" CURVE 0xa1016144 _REC_CUR_TKL_UW_VV__u2_u1 99.9984 _CNV_R_R_Def_f_uw_b_576_CM 0. 99.9984
 /begin AXIS_DESCR STD_AXIS Gen_awnumm _CNV_R_R_Def_dez_sl_575_CM 6 0. 255. FORMAT "%3.0" /end AXIS_DESCR
/end CHARACTERISTIC
/begin CHARACTERISTIC KL_SAGRAD_AGRPOS "" CURVE 0xa10129f4 _REC_CUR_20_s2_u1 99.99690000000001 _CNV_R_R_Def_f_sw_b_597_CM 0. 99.9969
 /begin AXIS_DESCR COM_AXIS Modelle _CNV_R_R_Def_dez_sl_575_CM 5 0. 255. FORMAT "%3.0" AXIS_PTS_REF GAX_5MODELLE /end AXIS_DESCR
/end CHARACTERISTIC
/begin CHARACTERISTIC KL_SKH_NKW "Breiten Lolimot-Modelle Eingang Nkw, KHNN" CURVE 0xa10148bc _REC_CUR_20_s2_u1 65535. _CNV_R_R_Def_n_sw_q_612_CM -32768. 32767. FORMAT "%5.0"
 /begin AXIS_DESCR COM_AXIS Modelle _CNV_R_R_Def_dez_sl_575_CM 6 0. 255. FORMAT "%3.0" AXIS_PTS_REF GAX_KHMOD /end AXIS_DESCR
/end CHARACTERISTIC
/begin CHARACTERISTIC KL_SKH_RK "Breiten Lolimot-Modelle Eingang Rk_soll_s, KHNN" CURVE 0xa10148c8 _REC_CUR_20_s2_u1 3199.951100000001 _CNV_R_R_Def_rk_sw__697_CM -1600. 1599.9511
 /begin AXIS_DESCR COM_AXIS Modelle _CNV_R_R_Def_dez_sl_575_CM 6 0. 255. FORMAT "%3.0" AXIS_PTS_REF GAX_KHMOD /end AXIS_DESCR
/end CHARACTERISTIC
/begin CHARACTERISTIC KL_SKH_TANS "Breiten Lolimot-Modelle Eingang Tans, KHNN" CURVE 0xa10148d4 _REC_CUR_20_s2_u1 6553.5 _CNV_R_R_Def_t_sw_q_618_CM -3276.8 3276.7 FORMAT "%4.1"
 /begin AXIS_DESCR COM_AXIS Modelle _CNV_R_R_Def_dez_sl_575_CM 6 0. 255. FORMAT "%3.0" AXIS_PTS_REF GAX_KHMOD /end AXIS_DESCR
/end CHARACTERISTIC
/begin CHARACTERISTIC KL_SKR_BA_IST "Breiten Lolimot-Modelle Eingang Ba_ist, KRANN" CURVE 0xa1014878 _REC_CUR_20_s2_u1 655.35 _CNV_R_R_Def_lf_ub__675_CM -327.68 327.67 FORMAT "%5.2"
 /begin AXIS_DESCR COM_AXIS Modelle _CNV_R_R_Def_dez_sl_575_CM 15 0. 255. FORMAT "%3.0" AXIS_PTS_REF GAX_KRMOD /end AXIS_DESCR
/end CHARACTERISTIC
/begin CHARACTERISTIC KL_SKR_NKW "Breiten Lolimot-Modelle Eingang Nkw, KRANN" CURVE 0xa10147f8 _REC_CUR_20_s2_u1 65535. _CNV_R_R_Def_n_sw_q_612_CM -32768. 32767. FORMAT "%5.0"
 /begin AXIS_DESCR COM_AXIS Modelle _CNV_R_R_Def_dez_sl_575_CM 15 0. 255. FORMAT "%3.0" AXIS_PTS_REF GAX_KRMOD /end AXIS_DESCR
/end CHARACTERISTIC
/begin CHARACTERISTIC KL_SKR_RK "Breiten Lolimot-Modelle Eingang Rk_soll_kr, KRANN" CURVE 0xa1014818 _REC_CUR_20_s2_u1 3199.951100000001 _CNV_R_R_Def_rk_sw__697_CM -1600. 1599.9511
 /begin AXIS_DESCR COM_AXIS Modelle _CNV_R_R_Def_dez_sl_575_CM 15 0. 255. FORMAT "%3.0" AXIS_PTS_REF GAX_KRMOD /end AXIS_DESCR
/end CHARACTERISTIC
/begin CHARACTERISTIC KL_SKR_TANS "Breiten Lolimot-Modelle Eingang Tans, KRANN" CURVE 0xa1014838 _REC_CUR_20_s2_u1 6553.5 _CNV_R_R_Def_t_sw_q_618_CM -3276.8 3276.7 FORMAT "%4.1"
 /begin AXIS_DESCR COM_AXIS Modelle _CNV_R_R_Def_dez_sl_575_CM 15 0. 255. FORMAT "%3.0" AXIS_PTS_REF GAX_KRMOD /end AXIS_DESCR
/end CHARACTERISTIC
/begin CHARACTERISTIC KL_SKR_TMOT "Breiten Lolimot-Modelle Eingang Tmot, KRANN" CURVE 0xa1014858 _REC_CUR_20_s2_u1 655.35 _CNV_R_R_Def_t_sw_q_620_CM -327.68 327.67 FORMAT "%5.2"
 /begin AXIS_DESCR COM_AXIS Modelle _CNV_R_R_Def_dez_sl_575_CM 15 0. 255. FORMAT "%3.0" AXIS_PTS_REF GAX_KRMOD /end AXIS_DESCR
/end CHARACTERISTIC
/begin CHARACTERISTIC KL_SPSAD_N "" CURVE 0xa1012990 _REC_CUR_20_s2_u1 65535. _CNV_R_R_Def_n_sw_q_612_CM -32768. 32767. FORMAT "%5.0"
 /begin AXIS_DESCR COM_AXIS Modelle _CNV_R_R_Def_dez_sl_575_CM 5 0. 255. FORMAT "%3.0" AXIS_PTS_REF GAX_5MODELLE /end AXIS_DESCR
/end CHARACTERISTIC
/begin CHARACTERISTIC KL_SPSAD_VSA_SPRI "" CURVE 0xa10129a8 _REC_CUR_20_u2_u1 6553.5 _CNV_R_R_Def_spr_sw_583_CM 0. 6553.5 FORMAT "%5.2"
 /begin AXIS_DESCR COM_AXIS Modelle _CNV_R_R_Def_dez_sl_575_CM 5 0. 255. FORMAT "%3.0" AXIS_PTS_REF GAX_5MODELLE /end AXIS_DESCR
/end CHARACTERISTIC
/begin CHARACTERISTIC KL_SPSAD_VSE_SPRI "" CURVE 0xa101299c _REC_CUR_20_u2_u1 6553.5 _CNV_R_R_Def_spr_sw_583_CM 0. 6553.5 FORMAT "%5.2"
 /begin AXIS_DESCR COM_AXIS Modelle _CNV_R_R_Def_dez_sl_575_CM 5 0. 255. FORMAT "%3.0" AXIS_PTS_REF GAX_5MODELLE /end AXIS_DESCR
/end CHARACTERISTIC
/begin CHARACTERISTIC KL_SRSTAB_SPUEL "SR Stabilisierungsfaktor" CURVE 0xa1012c64 _REC_CUR_TKL_UW_VV__u2_u2 1.9999 _CNV_R_R_Def_f_uw_b_579_CM 0. 1.9999 FORMAT "%14.5"
 /begin AXIS_DESCR STD_AXIS Pakps_kor _CNV_R_R_Def_f_uw_b_579_CM 10 0. 1.9999 FORMAT "%14.5" /end AXIS_DESCR
/end CHARACTERISTIC
/begin CHARACTERISTIC KL_TANSGEN4 "Kennlinie Generatoransaugluft4" CURVE 0xa10161bc _REC_CUR_TKL_UW_VV__s2_u2 131.07 _CNV_R_R_Def_t_sw_q_618_CM -3276.8 3276.7 FORMAT "%4.1"
 /begin AXIS_DESCR STD_AXIS NO_INPUT_QUANTITY _CNV_R_R_Def_v_uw_q_737_CM 10 0. 360. FORMAT "%5.0" /end AXIS_DESCR
/end CHARACTERISTIC
/begin CHARACTERISTIC KL_TCHIPOFFS "Offset zur gemessenen Chiptemperatur Herstellerspezifisch" CURVE 0xa1016214 _REC_CUR_TKL_UW_VV__s2_u1 131.07 _CNV_R_R_Def_t_sw_q_618_CM -3276.8 3276.7 FORMAT "%4.1"
 /begin AXIS_DESCR STD_AXIS Gen_manufak _CNV_R_R_Def_dez_sl_575_CM 8 0. 255. FORMAT "%3.0" /end AXIS_DESCR
/end CHARACTERISTIC
/begin CHARACTERISTIC KL_TMAXDIODE "Zulässige Diodenmaximaltemperatur" CURVE 0xa1016184 _REC_CUR_TKL_UW_VV__s2_u1 131.07 _CNV_R_R_Def_t_sw_q_618_CM -3276.8 3276.7 FORMAT "%4.1"
 /begin AXIS_DESCR STD_AXIS Gen_awnumm _CNV_R_R_Def_dez_sl_575_CM 6 0. 255. FORMAT "%3.0" /end AXIS_DESCR
/end CHARACTERISTIC
/begin CHARACTERISTIC KL_T_CHIP1 "" CURVE 0xa101624c _REC_CUR_TKL_UW_VV__s2_u1 131.07 _CNV_R_R_Def_t_sw_q_618_CM -3276.8 3276.7 FORMAT "%4.1"
 /begin AXIS_DESCR STD_AXIS Gen_awnumm _CNV_R_R_Def_dez_sl_575_CM 6 0. 255. FORMAT "%3.0" /end AXIS_DESCR
/end CHARACTERISTIC
/begin CHARACTERISTIC KL_T_CHIP2 "" CURVE 0xa1016198 _REC_CUR_TKL_UW_VV__s2_u1 131.07 _CNV_R_R_Def_t_sw_q_618_CM -3276.8 3276.7 FORMAT "%4.1"
 /begin AXIS_DESCR STD_AXIS Gen_awnumm _CNV_R_R_Def_dez_sl_575_CM 6 0. 255. FORMAT "%3.0" /end AXIS_DESCR
/end CHARACTERISTIC
/begin CHARACTERISTIC KL_VSAUG_GDN "Faktor Maximal Saugrohrdruck, Gedrosselt Neg" CURVE 0xa1012cf8 _REC_CUR_TKL_UW_VV__u2_s2 9.999800000000001 _CNV_R_R_Def_f_uw_b_629_CM 0. 9.999800000000001 FORMAT "%7.4"
 /begin AXIS_DESCR STD_AXIS Nkw _CNV_R_R_Def_n_sw_q_612_CM 12 -32768. 32767. FORMAT "%5.0" /end AXIS_DESCR
/end CHARACTERISTIC
/begin CHARACTERISTIC KL_VSAUG_GDP "Faktor Maximal Saugrohrdruck, Gedrosselt Pos" CURVE 0xa1012cc4 _REC_CUR_TKL_UW_VV__u2_s2 9.999800000000001 _CNV_R_R_Def_f_uw_b_629_CM 0. 9.999800000000001 FORMAT "%7.4"
 /begin AXIS_DESCR STD_AXIS Nkw _CNV_R_R_Def_n_sw_q_612_CM 12 -32768. 32767. FORMAT "%5.0" /end AXIS_DESCR
/end CHARACTERISTIC
/begin CHARACTERISTIC KL_VSAUG_UG "Faktor Maximal Saugrohrdruck, Un-gedrosselt" CURVE 0xa1012c90 _REC_CUR_TKL_UW_VV__u2_s2 9.999800000000001 _CNV_R_R_Def_f_uw_b_629_CM 0. 9.999800000000001 FORMAT "%7.4"
 /begin AXIS_DESCR STD_AXIS Nkw _CNV_R_R_Def_n_sw_q_612_CM 12 -32768. 32767. FORMAT "%5.0" /end AXIS_DESCR
/end CHARACTERISTIC
/begin CHARACTERISTIC KL_ZK_ETALAMZW "Zk zur Filterung von Eta_ges" CURVE 0xa1019de4 _REC_CUR_TKL_UW_VV__u2_s2 99.9984 _CNV_R_R_Def_f_uw_b_576_CM 0. 99.9984
 /begin AXIS_DESCR STD_AXIS Nkw _CNV_R_R_Def_n_sw_q_612_CM 8 -32768. 32767. FORMAT "%5.0" /end AXIS_DESCR
/end CHARACTERISTIC
/begin CHARACTERISTIC KL_ZK_PSSMOD "" CURVE 0xa1012950 _REC_CUR_TKL_UW_VV__u2_s2 0.9999 _CNV_R_R_Def_f_uw_b_591_CM 0. 0.9999 FORMAT "%14.5"
 /begin AXIS_DESCR STD_AXIS Nkw _CNV_R_R_Def_n_sw_q_612_CM 4 -32768. 32767. FORMAT "%5.0" /end AXIS_DESCR
/end CHARACTERISTIC
/begin CHARACTERISTIC KL_ZK_TURBINE "" CURVE 0xa101337c _REC_CUR_TKL_UW_VV__u2_s2 0.9999847412109381 _CNV_R_R_Def_f_uw_b_591_CM 0. 0.9999847412109381 FORMAT "%14.5"
 /begin AXIS_DESCR STD_AXIS Nkw _CNV_R_R_Def_n_sw_q_612_CM 8 -32768. 32767. FORMAT "%5.0" /end AXIS_DESCR
/end CHARACTERISTIC
/begin CHARACTERISTIC K_AGRADGES_MN "" VALUE 0xa10128fe _REC_VAL_20_s2 63.999 _CNV_R_R_Def_f_sw_b_577_CM -32. 31.999 FORMAT "%7.4" /end CHARACTERISTIC
/begin CHARACTERISTIC K_AGRADGES_MX "" VALUE 0xa1012900 _REC_VAL_20_s2 63.999 _CNV_R_R_Def_f_sw_b_577_CM -32. 31.999 FORMAT "%7.4" /end CHARACTERISTIC
/begin CHARACTERISTIC K_AGRADMX "" VALUE 0xa101294a _REC_VAL_20_S4 0. _CNV_R_R_Def_dez_sl_575_CM -1000000000000. 10000000000000. FORMAT "%14.7" /end CHARACTERISTIC
/begin CHARACTERISTIC K_AGRREGIMN "AGR-Regler I-Anteil Minimalwert" VALUE 0xa1012918 _REC_VAL_20_s2 63.999 _CNV_R_R_Def_f_sw_b_577_CM -32. 31.999 FORMAT "%7.4" /end CHARACTERISTIC
/begin CHARACTERISTIC K_AGRREGIMX "AGR-Regler I-Anteil Maximalwert" VALUE 0xa101291a _REC_VAL_20_s2 63.999 _CNV_R_R_Def_f_sw_b_577_CM -32. 31.999 FORMAT "%7.4" /end CHARACTERISTIC
/begin CHARACTERISTIC K_AGRREGINN_MN "" VALUE 0xa10128fa _REC_VAL_20_s2 63.999 _CNV_R_R_Def_f_sw_b_577_CM -32. 31.999 FORMAT "%7.4" /end CHARACTERISTIC
/begin CHARACTERISTIC K_AGRREGINN_MX "" VALUE 0xa10128fc _REC_VAL_20_s2 63.999 _CNV_R_R_Def_f_sw_b_577_CM -32. 31.999 FORMAT "%7.4" /end CHARACTERISTIC
/begin CHARACTERISTIC K_AGRREGMN "PS-Regler Minimalwert" VALUE 0xa10128e0 _REC_VAL_20_s2 63.999 _CNV_R_R_Def_f_sw_b_577_CM -32. 31.999 FORMAT "%7.4" /end CHARACTERISTIC
/begin CHARACTERISTIC K_AGRREGMX "PS-Regler Maximalwert" VALUE 0xa10128e2 _REC_VAL_20_s2 63.999 _CNV_R_R_Def_f_sw_b_577_CM -32. 31.999 FORMAT "%7.4" /end CHARACTERISTIC
/begin CHARACTERISTIC K_ANZ_AGRADNN "" VALUE 0xa10128ed _REC_VAL_20_u1 5. _CNV_R_R_Def_dez_sl_575_CM 0. 5. FORMAT "%3.0" /end CHARACTERISTIC
/begin CHARACTERISTIC K_ANZ_ARBSP "Anzahl der zu mittelnden Arbeitsspiele" VALUE 0xa1014630 _REC_VAL_20_u1 20. _CNV_R_R_Def_dez_sl_575_CM 0. 20. FORMAT "%3.0" /end CHARACTERISTIC
/begin CHARACTERISTIC K_ANZ_PSADNN "" VALUE 0xa10128f1 _REC_VAL_20_u1 5. _CNV_R_R_Def_dez_sl_575_CM 0. 5. FORMAT "%3.0" /end CHARACTERISTIC
/begin CHARACTERISTIC K_DFFGENFIL "Filterkonstante Dffgen" VALUE 0xa1016104 _REC_VAL_20_u1 0.996 _CNV_R_R_Def_f_ub_b_573_CM 0. 0.996 /end CHARACTERISTIC
/begin CHARACTERISTIC K_DF_DEAKAPP "Df-Schwelle für IG 0A Zwangssetzung" VALUE 0xa1016105 _REC_VAL_20_u1 99.60930000000001 _CNV_R_R_Def_f_ub_b_602_CM 0. 99.60930000000001 FORMAT "%5.2" /end CHARACTERISTIC
/begin CHARACTERISTIC K_DI1000DT "" VALUE 0xa1017276 _REC_VAL_20_u1 12.75 _CNV_R_R_Def_td_ub__763_CM 0. 12.75 FORMAT "%5.2" /end CHARACTERISTIC
/begin CHARACTERISTIC K_DI1000STG "" VALUE 0xa1017274 _REC_VAL_20_u1 20.4 _CNV_R_R_Def_i_ub_q_770_CM 0. 20.4 FORMAT "%5.2" /end CHARACTERISTIC
/begin CHARACTERISTIC K_DI1000TGRZ "" VALUE 0xa101726b _REC_VAL_20_u1 99.45 _CNV_R_R_Def_td_uw__682_CM 0. 255. FORMAT "%5.2" /end CHARACTERISTIC
/begin CHARACTERISTIC K_DI200DT "" VALUE 0xa1017275 _REC_VAL_20_u1 12.75 _CNV_R_R_Def_td_ub__763_CM 0. 12.75 FORMAT "%5.2" /end CHARACTERISTIC
/begin CHARACTERISTIC K_DI200STG "" VALUE 0xa1017273 _REC_VAL_20_u1 5.1 _CNV_R_R_Def_i_sw_q_647_CM 0. 5.1 FORMAT "%5.2" /end CHARACTERISTIC
/begin CHARACTERISTIC K_DIHIGHGRZ "" VALUE 0xa101726f _REC_VAL_20_u1 20.4 _CNV_R_R_Def_i_ub_q_770_CM 0. 20.4 FORMAT "%5.2" /end CHARACTERISTIC
/begin CHARACTERISTIC K_DILOWGRZ "" VALUE 0xa101726e _REC_VAL_20_u1 5.1 _CNV_R_R_Def_i_sw_q_647_CM 0. 5.1 FORMAT "%5.2" /end CHARACTERISTIC
/begin CHARACTERISTIC K_DIPL5 "" VALUE 0xa1017279 _REC_VAL_20_u1 99.45 _CNV_R_R_Def_dez_sl_575_CM 0. 255. FORMAT "%3.0" /end CHARACTERISTIC
/begin CHARACTERISTIC K_DIPL6 "" VALUE 0xa101727a _REC_VAL_20_u1 99.45 _CNV_R_R_Def_dez_sl_575_CM 0. 255. FORMAT "%3.0" /end CHARACTERISTIC
/begin CHARACTERISTIC K_DIPL7 "" VALUE 0xa101727b _REC_VAL_20_u1 99.45 _CNV_R_R_Def_dez_sl_575_CM 0. 255. FORMAT "%3.0" /end CHARACTERISTIC
/begin CHARACTERISTIC K_DIPL8 "" VALUE 0xa101727c _REC_VAL_20_u1 99.45 _CNV_R_R_Def_dez_sl_575_CM 0. 255. FORMAT "%3.0" /end CHARACTERISTIC
/begin CHARACTERISTIC K_DKL15FIL "" VALUE 0xa1017271 _REC_VAL_20_u1 1.5937 _CNV_R_R_Def_td_ub__771_CM 0. 1.5937 FORMAT "%7.4" /end CHARACTERISTIC
/begin CHARACTERISTIC K_DLA_PULS "Faktor" VALUE 0xa1019d90 _REC_VAL_20_u2 1.9999 _CNV_R_R_Def_f_uw_b_579_CM 0. 1.9999 FORMAT "%14.5" /end CHARACTERISTIC
/begin CHARACTERISTIC K_DMDGEN_FAK "Korrekturfaktor zulässige Generatordynamik" VALUE 0xa1017bf8 _REC_VAL_20_u2 1.9999 _CNV_R_R_Def_f_uw_b_579_CM 0. 1.9999 FORMAT "%14.5" /end CHARACTERISTIC
/begin CHARACTERISTIC K_DMDGEN_OFF "Korrekturoffset zulässige Generatordynamik" VALUE 0xa1017bf2 _REC_VAL_20_s2 131.07 _CNV_R_R_Def_m_sw_q_574_CM -3276.8 3276.7 FORMAT "%5.2" /end CHARACTERISTIC
/begin CHARACTERISTIC K_DPSMN "Minwert Dpssol für Freigabe Dps Adaption" VALUE 0xa1012902 _REC_VAL_20_s2 102.398436 _CNV_R_R_Def_p_sw_q_578_CM -1280. 1279.9609 FORMAT "%5.2" /end CHARACTERISTIC
/begin CHARACTERISTIC K_DPSMX "Maxwert Dpssol für Freigabe Dps Adaption" VALUE 0xa1012904 _REC_VAL_20_s2 102.398436 _CNV_R_R_Def_p_sw_q_578_CM -1280. 1279.9609 FORMAT "%5.2" /end CHARACTERISTIC
/begin CHARACTERISTIC K_DPS_INTMN "Offset für Pvdkds" VALUE 0xa1012c60 _REC_VAL_20_u2 102.398436 _CNV_R_R_Def_p_sw_q_578_CM 0. 2559.9609 FORMAT "%5.2" /end CHARACTERISTIC
/begin CHARACTERISTIC K_DTMAXGRZI "" VALUE 0xa101726d _REC_VAL_20_u1 99.45 _CNV_R_R_Def_td_uw__682_CM 0. 255. FORMAT "%5.2" /end CHARACTERISTIC
/begin CHARACTERISTIC K_DUIGRZ "" VALUE 0xa101726c _REC_VAL_20_u1 5.1 _CNV_R_R_Def_i_sw_q_647_CM 0. 5.1 FORMAT "%5.2" /end CHARACTERISTIC
/begin CHARACTERISTIC K_DUMINTGRZ "" VALUE 0xa1017270 _REC_VAL_20_u1 12.75 _CNV_R_R_Def_td_ub__763_CM 0. 12.75 FORMAT "%5.2" /end CHARACTERISTIC
/begin CHARACTERISTIC K_DUREFMAX "" VALUE 0xa1017272 _REC_VAL_20_u1 4.998 _CNV_R_R_Def_u_ub_q_772_CM 0. 4.998 FORMAT "%7.4" /end CHARACTERISTIC
/begin CHARACTERISTIC K_DUREFMINI "" VALUE 0xa101727d _REC_VAL_20_u1 4.998 _CNV_R_R_Def_u_ub_q_772_CM 0. 4.998 FORMAT "%7.4" /end CHARACTERISTIC
/begin CHARACTERISTIC K_DWKRMNN "Erlaubtes Delta zwischen KR-Winkel und erlerntem Winkel" VALUE 0xa1014644 _REC_VAL_20_s2 50.1 _CNV_R_R_Def_zw_sw__599_CM -50. 0.1 FORMAT "%4.1" /end CHARACTERISTIC
/begin CHARACTERISTIC K_EIN_KHNN "Anzahl Eingänge für KHNN" VALUE 0xa101462d _REC_VAL_20_u1 3. _CNV_R_R_Def_dez_sl_575_CM 0. 3. FORMAT "%3.0" /end CHARACTERISTIC
/begin CHARACTERISTIC K_EIN_KRANN "Anzahl Eingänge für KRANN" VALUE 0xa101462c _REC_VAL_20_u1 5. _CNV_R_R_Def_dez_sl_575_CM 0. 5. FORMAT "%3.0" /end CHARACTERISTIC
/begin CHARACTERISTIC K_ENABSDIBS "kt_ibs enable Kommunikation" VALUE 0xa1017290 _REC_VAL_20_u1 99.45 _CNV_R_R_Def_dez_sl_575_CM 0. 255. FORMAT "%3.0" /end CHARACTERISTIC
/begin CHARACTERISTIC K_ENGENTANS "Schwelle Motortemperatur fuer Freigabe Generaturansaugluft " VALUE 0xa10160c2 _REC_VAL_20_s2 131.07 _CNV_R_R_Def_t_sw_q_618_CM -3276.8 3276.7 FORMAT "%4.1" /end CHARACTERISTIC
/begin CHARACTERISTIC K_ENISOC0 "" VALUE 0xa101725c _REC_VAL_20_u1 5.1 _CNV_R_R_Def_i_sw_q_647_CM 0. 5.1 FORMAT "%5.2" /end CHARACTERISTIC
/begin CHARACTERISTIC K_ENUSOC0 "" VALUE 0xa101725d _REC_VAL_20_u1 16.32 _CNV_R_R_Def_u_ub_q_773_CM 6. 22.32 FORMAT "%5.2" /end CHARACTERISTIC
/begin CHARACTERISTIC K_EN_MDGEN "" VALUE 0xa1016106 _REC_VAL_20_u1 99.45 _CNV_R_R_Def_dez_sl_575_CM 0. 255. FORMAT "%3.0" /end CHARACTERISTIC
/begin CHARACTERISTIC K_ERREPEAT "EBSD Fehler repeat" VALUE 0xa1017291 _REC_VAL_20_u1 99.45 _CNV_R_R_Def_dez_sl_575_CM 0. 255. FORMAT "%3.0" /end CHARACTERISTIC
/begin CHARACTERISTIC K_ETAGES_MN "untere Begrenzung Wirkungsgrad" VALUE 0xa1019d98 _REC_VAL_20_s2 100. _CNV_R_R_Def_eta_sw_628_CM 0. 100. /end CHARACTERISTIC
/begin CHARACTERISTIC K_ETAGES_MX "obere Begrenzung Wirkungsgrad" VALUE 0xa1019d96 _REC_VAL_20_s2 100. _CNV_R_R_Def_eta_sw_628_CM 0. 100. /end CHARACTERISTIC
/begin CHARACTERISTIC K_ETAKHNEG "Lernfaktor KHNN in negative Richtung" VALUE 0xa1014656 _REC_VAL_20_S4 0. _CNV_R_R_Def_dez_sl_575_CM -1000000000000. 10000000000000. FORMAT "%14.7" /end CHARACTERISTIC
/begin CHARACTERISTIC K_ETAKHNEGHS "Lernfaktor KHNN in negative Richtung für Homogen-Schicht" VALUE 0xa101465a _REC_VAL_20_S4 0. _CNV_R_R_Def_dez_sl_575_CM -1000000000000. 10000000000000. FORMAT "%14.7" /end CHARACTERISTIC
/begin CHARACTERISTIC K_ETAKHPOS "Lernfaktor KHNN in positive Richtung" VALUE 0xa101464e _REC_VAL_20_S4 0. _CNV_R_R_Def_dez_sl_575_CM -1000000000000. 10000000000000. FORMAT "%14.7" /end CHARACTERISTIC
/begin CHARACTERISTIC K_ETAKHPOSHS "Lernfaktor KHNN in positive Richtung für Homogen-Schicht" VALUE 0xa1014652 _REC_VAL_20_S4 0. _CNV_R_R_Def_dez_sl_575_CM -1000000000000. 10000000000000. FORMAT "%14.7" /end CHARACTERISTIC
/begin CHARACTERISTIC K_ETA_M_TURBO "Wirkungsgrad Turbolader" VALUE 0xa101334c _REC_VAL_20_u2 3.9999 _CNV_R_R_Def_f_sw_b_608_CM 0. 3.9999 FORMAT "%14.5" /end CHARACTERISTIC
/begin CHARACTERISTIC K_FAGRAD "Schrittweite für Überblendfaktor F_agrad" VALUE 0xa10128e9 _REC_VAL_20_u1 1.9921 _CNV_R_R_Def_f_ub_b_625_CM 0. 1.9921 /end CHARACTERISTIC
/begin CHARACTERISTIC K_FU_LST_TURB "Faktor Umrechnung Turbinenleistung" VALUE 0xa101334e _REC_VAL_20_u2 0.9999847412109381 _CNV_R_R_Def_f_uw_b_591_CM 0. 0.9999847412109381 FORMAT "%14.5" /end CHARACTERISTIC
/begin CHARACTERISTIC K_FU_MSVERD "Faktor Umrechnung Verdichterleistung" VALUE 0xa1013350 _REC_VAL_20_u2 3.9999 _CNV_R_R_Def_f_sw_b_608_CM 0. 3.9999 FORMAT "%14.5" /end CHARACTERISTIC
/begin CHARACTERISTIC K_GENDIFAK4 "Stromfaktor Diode4" VALUE 0xa1016107 _REC_VAL_20_u1 0.996 _CNV_R_R_Def_f_ub_b_573_CM 0. 0.996 /end CHARACTERISTIC
/begin CHARACTERISTIC K_GENGCALC "Zeitraster, in dem Md_gennm für GEN_GRENZ übernommen wird (Ringpuffer)" VALUE 0xa1017bfa _REC_VAL_20_u2 98.30250000000001 _CNV_R_R_Def_td_uw__679_CM 0. 655.35 FORMAT "%5.2" /end CHARACTERISTIC
/begin CHARACTERISTIC K_GENITYP "Generatorstrotyp 0=gerechnet / 1=gemessen" VALUE 0xa1016108 _REC_VAL_20_u1 1. _CNV_R_R_Def_dez_sl_575_CM 0. 1. FORMAT "%3.0" /end CHARACTERISTIC
/begin CHARACTERISTIC K_GENMDNMOF "Offset des Generatormoments" VALUE 0xa1014b00 _REC_VAL_20_s2 131.07 _CNV_R_R_Def_m_sw_q_574_CM -3276.8 3276.7 FORMAT "%5.2" /end CHARACTERISTIC
/begin CHARACTERISTIC K_GENMXGRADH "Maximal zulässiger Gradient Chiptemperatur" VALUE 0xa10160c4 _REC_VAL_20_s2 131.07 _CNV_R_R_Def_t_sw_q_618_CM -3276.8 3276.7 FORMAT "%4.1" /end CHARACTERISTIC
/begin CHARACTERISTIC K_GENRS0_4 "Generatorstatorwiderstand4 bei 25°" VALUE 0xa10160de _REC_VAL_20_u2 0.9999847412109381 _CNV_R_R_Def_f_uw_b_591_CM 0. 0.9999847412109381 FORMAT "%14.5" /end CHARACTERISTIC
/begin CHARACTERISTIC K_GENSTFAK4 "Stromfaktor Statorspule4" VALUE 0xa1016109 _REC_VAL_20_u1 0.996 _CNV_R_R_Def_f_ub_b_573_CM 0. 0.996 /end CHARACTERISTIC
/begin CHARACTERISTIC K_GENTEMPAPP "Geneeratortemperatur mauelle Vorgabe" VALUE 0xa10160c6 _REC_VAL_20_s2 131.07 _CNV_R_R_Def_t_sw_q_618_CM -3276.8 3276.7 FORMAT "%4.1" /end CHARACTERISTIC
/begin CHARACTERISTIC K_GENTEMPMAN "Manuelle Generatorvorgabe" VALUE 0xa101610a _REC_VAL_20_u1 99.45 _CNV_R_R_Def_dez_sl_575_CM 0. 255. FORMAT "%3.0" /end CHARACTERISTIC
/begin CHARACTERISTIC K_GENTMOTDT "" VALUE 0xa10160c8 _REC_VAL_20_s2 131.07 _CNV_R_R_Def_t_sw_q_618_CM -3276.8 3276.7 FORMAT "%4.1" /end CHARACTERISTIC
/begin CHARACTERISTIC K_GENTMOTOF4 "Offset Generatoransaugluft" VALUE 0xa10160ca _REC_VAL_20_s2 131.07 _CNV_R_R_Def_t_sw_q_618_CM -3276.8 3276.7 FORMAT "%4.1" /end CHARACTERISTIC
/begin CHARACTERISTIC K_GENTYP "Generatortyp" VALUE 0xa101610b _REC_VAL_20_u1 99.45 _CNV_R_R_Def_dez_sl_575_CM 0. 255. FORMAT "%3.0" /end CHARACTERISTIC
/begin CHARACTERISTIC K_GENTYPFELD "Generatorkennfeldzuordnung" VAL_BLK 0xa1016124 _REC_VAL_2_u1 5. _CNV_R_R_Def_dez_sl_575_CM 1. 6. FORMAT "%3.0" NUMBER 32 /end CHARACTERISTIC
/begin CHARACTERISTIC K_GENUEBSETZ "Generatorübersetzung" VALUE 0xa1014b08 _REC_VAL_20_u1 3.9686 _CNV_R_R_Def_f_ub_b_670_CM 1.57e-002 3.9843 FORMAT "%5.2" /end CHARACTERISTIC
/begin CHARACTERISTIC K_GENUEBSETZ4 "Generatoruebersetzung4" VALUE 0xa1014b09 _REC_VAL_20_u1 3.9843 _CNV_R_R_Def_f_ub_b_670_CM 0. 3.9843 FORMAT "%5.2" /end CHARACTERISTIC
/begin CHARACTERISTIC K_GENUMGTYP "" VALUE 0xa101610c _REC_VAL_20_u1 99.45 _CNV_R_R_Def_dez_sl_575_CM 0. 255. FORMAT "%3.0" /end CHARACTERISTIC
/begin CHARACTERISTIC K_GENVFZGSW "geschwindigkeitsabhängige Generatoransaugluftschwelle" VALUE 0xa10160e0 _REC_VAL_20_u2 0. _CNV_R_R_Def_v_uw_q_737_CM 0. 65535. FORMAT "%5.0" /end CHARACTERISTIC
/begin CHARACTERISTIC K_GEN_IGOF "Offsetwert Generatorstrom" VALUE 0xa10160e2 _REC_VAL_20_u2 99.06 _CNV_R_R_Def_f_uw_b_630_CM 0. 254. FORMAT "%5.2" /end CHARACTERISTIC
/begin CHARACTERISTIC K_HTGENDFGRO "Schwelle Generaorauslastung zur E-Lüfteranforderung" VALUE 0xa101610d _REC_VAL_20_u1 99.45 _CNV_R_R_Def_dez_sl_575_CM 0. 255. FORMAT "%3.0" /end CHARACTERISTIC
/begin CHARACTERISTIC K_IBSTSTERR "EBSD Fehler repeat" VALUE 0xa1017293 _REC_VAL_20_u1 99.45 _CNV_R_R_Def_dez_sl_575_CM 0. 255. FORMAT "%3.0" /end CHARACTERISTIC
/begin CHARACTERISTIC K_IBSVERSION "Liste der kompatiblen IBS SW- Versionen" VAL_BLK 0xa1017280 _REC_VAL_2_u1 99.45 _CNV_R_R_Def_dez_sl_575_CM 0. 255. FORMAT "%3.0" NUMBER 16 /end CHARACTERISTIC
/begin CHARACTERISTIC K_IBTEMPMAXI "" VALUE 0xa101727e _REC_VAL_20_u1 99.45 _CNV_R_R_Def_dez_sl_575_CM 0. 255. FORMAT "%3.0" /end CHARACTERISTIC
/begin CHARACTERISTIC K_IBTEMPMINI "" VALUE 0xa101727f _REC_VAL_20_u1 99.45 _CNV_R_R_Def_dez_sl_575_CM 0. 255. FORMAT "%3.0" /end CHARACTERISTIC
/begin CHARACTERISTIC K_IBUNPLADEL "EBSD Fehler repeat" VALUE 0xa1017292 _REC_VAL_20_u1 99.45 _CNV_R_R_Def_dez_sl_575_CM 0. 255. FORMAT "%3.0" /end CHARACTERISTIC
/begin CHARACTERISTIC K_IERRGRAPPL "Applikatinswert Grenzerregerstrom" VALUE 0xa101610e _REC_VAL_20_u1 31.875 _CNV_R_R_Def_i_ub_q_645_CM 0. 31.875 /end CHARACTERISTIC
/begin CHARACTERISTIC K_IERRHYSMAX "Obere Schwelle für Hystereseerkennung (Aufweitung der Zielreserve)" VALUE 0xa1017bf4 _REC_VAL_20_s2 81.91875 _CNV_R_R_Def_i_ub_q_645_CM -4096. 4095.875 /end CHARACTERISTIC
/begin CHARACTERISTIC K_IERRHYSMN "Untere Schwelle für Hystereseerkennung (Aufweitung der Zielreserve)" VALUE 0xa1017bf6 _REC_VAL_20_s2 81.91875 _CNV_R_R_Def_i_ub_q_645_CM -4096. 4095.875 /end CHARACTERISTIC
/begin CHARACTERISTIC K_IERRHYSMN2 "Hysterese für Grenzerregerstromaufrundung" VALUE 0xa10160cc _REC_VAL_20_s2 81.91875 _CNV_R_R_Def_i_ub_q_645_CM -4096. 4095.875 /end CHARACTERISTIC
/begin CHARACTERISTIC K_IERRHYSMX2 "Hysterese für Grenzerregerstromaufrundung" VALUE 0xa10160ce _REC_VAL_20_s2 81.91875 _CNV_R_R_Def_i_ub_q_645_CM -4096. 4095.875 /end CHARACTERISTIC
/begin CHARACTERISTIC K_IGBASIS "Generatorgrundstrombedarf FZG " VALUE 0xa101610f _REC_VAL_20_u1 99.45 _CNV_R_R_DEZ_436_CM 0. 255. /end CHARACTERISTIC
/begin CHARACTERISTIC K_IGBASISOFF "Generatorgrundstrombedarf FZG bei Genred" VALUE 0xa1016110 _REC_VAL_20_u1 99.45 _CNV_R_R_DEZ_436_CM 0. 255. /end CHARACTERISTIC
/begin CHARACTERISTIC K_IGNOTWERT "" VALUE 0xa1016111 _REC_VAL_20_u1 99.45 _CNV_R_R_DEZ_436_CM 0. 255. /end CHARACTERISTIC
/begin CHARACTERISTIC K_IMDGENNRRW "Schwellwert zum Rechenrasterwechsel Momentenberechung" VALUE 0xa10160d0 _REC_VAL_20_s2 0. _CNV_R_R_Def_n_sw_q_612_CM -32768. 32767. FORMAT "%5.0" /end CHARACTERISTIC
/begin CHARACTERISTIC K_ISLEEPGRZ "" VALUE 0xa101726a _REC_VAL_20_u1 5.1 _CNV_R_R_Def_i_sw_q_647_CM 0. 5.1 FORMAT "%5.2" /end CHARACTERISTIC
/begin CHARACTERISTIC K_ISTARTTRIG "" VALUE 0xa1017261 _REC_VAL_20_u1 104.448 _CNV_R_R_Def_i_ub_q_774_CM 0. 1305.6 FORMAT "%5.2" /end CHARACTERISTIC
/begin CHARACTERISTIC K_I_VERTEIL "Stromverteilung" VALUE 0xa1016112 _REC_VAL_20_u1 3.9686 _CNV_R_R_Def_f_ub_b_670_CM 1.57e-002 3.9843 FORMAT "%5.2" /end CHARACTERISTIC
/begin CHARACTERISTIC K_KHNNMX "Maximalwert für Gewichte KHNN" VALUE 0xa101464a _REC_VAL_20_S4 0. _CNV_R_R_Def_dez_sl_575_CM -1000000000000. 10000000000000. FORMAT "%14.7" /end CHARACTERISTIC
/begin CHARACTERISTIC K_KHNN_F "Faktor für manuelle Gewichtsverstellung per Applikation" VALUE 0xa101465e _REC_VAL_20_S4 0. _CNV_R_R_Def_dez_sl_575_CM -1000000000000. 10000000000000. FORMAT "%14.7" /end CHARACTERISTIC
/begin CHARACTERISTIC K_KRANNMX "Maximalwert für Gewichte KRANN" VALUE 0xa1014646 _REC_VAL_20_S4 0. _CNV_R_R_Def_dez_sl_575_CM -1000000000000. 10000000000000. FORMAT "%14.7" /end CHARACTERISTIC
/begin CHARACTERISTIC K_KRZYKL_AUS "Anzahl der auszublendenden Arbeitsspiele bei BA-Umschaltung" VALUE 0xa1014631 _REC_VAL_20_u1 20. _CNV_R_R_Def_dez_sl_575_CM 0. 20. FORMAT "%3.0" /end CHARACTERISTIC
/begin CHARACTERISTIC K_LAMHOMMAN1 "Lambda-Sollwert Homogen über Applikation Bank 1" VALUE 0xa1019d92 _REC_VAL_20_u2 15.9997 _CNV_R_R_Def_f_uw_b_594_CM 0. 15.9997 FORMAT "%7.4" /end CHARACTERISTIC
/begin CHARACTERISTIC K_LAMHOMMAN2 "Lambda-Sollwert Homogen über Applikation Bank 2" VALUE 0xa1019d94 _REC_VAL_20_u2 15.9997 _CNV_R_R_Def_f_uw_b_594_CM 0. 15.9997 FORMAT "%7.4" /end CHARACTERISTIC
/begin CHARACTERISTIC K_LOLIAGRAD_MN "" VALUE 0xa1012946 _REC_VAL_20_S4 0. _CNV_R_R_Def_dez_sl_575_CM -1000000000000. 10000000000000. FORMAT "%14.7" /end CHARACTERISTIC
/begin CHARACTERISTIC K_LOLIAGRAD_MX "" VALUE 0xa1012942 _REC_VAL_20_S4 0. _CNV_R_R_Def_dez_sl_575_CM -1000000000000. 10000000000000. FORMAT "%14.7" /end CHARACTERISTIC
/begin CHARACTERISTIC K_LOLIPSAD_MN "" VALUE 0xa101293a _REC_VAL_20_S4 0. _CNV_R_R_Def_dez_sl_575_CM -1000000000000. 10000000000000. FORMAT "%14.7" /end CHARACTERISTIC
/begin CHARACTERISTIC K_LOLIPSAD_MX "" VALUE 0xa1012936 _REC_VAL_20_S4 0. _CNV_R_R_Def_dez_sl_575_CM -1000000000000. 10000000000000. FORMAT "%14.7" /end CHARACTERISTIC
/begin CHARACTERISTIC K_MANAWNUMM "Manuelle Vorgabe Generatortyp" VALUE 0xa1016113 _REC_VAL_20_u1 5. _CNV_R_R_Def_dez_sl_575_CM 1. 6. FORMAT "%3.0" /end CHARACTERISTIC
/begin CHARACTERISTIC K_MA_LAMKO "Konfigurieren der Eingänge des Lambda Koordinators" VAL_BLK 0xa1019d7c _REC_VAL_2_u1 99.45 _CNV_R_R_Def_dez_sl_575_CM 0. 255. FORMAT "%3.0" NUMBER 16 /end CHARACTERISTIC
/begin CHARACTERISTIC K_MDGENGGFIL "Filterkonstante Filterung lokales Generatormoment" VALUE 0xa1017bfc _REC_VAL_20_u2 0.9999694824218756 _CNV_R_R_Def_f_uw_b_591_CM 1.52587890625e-005 0.9999847412109381 FORMAT "%14.5" /end CHARACTERISTIC
/begin CHARACTERISTIC K_MOD_KHNN "Anzahl Modelle für KHNN" VALUE 0xa101462f _REC_VAL_20_u1 6. _CNV_R_R_Def_dez_sl_575_CM 0. 6. FORMAT "%3.0" /end CHARACTERISTIC
/begin CHARACTERISTIC K_MOD_KRANN "Anzahl Modelle für KRANN" VALUE 0xa101462e _REC_VAL_20_u1 15. _CNV_R_R_Def_dez_sl_575_CM 0. 15. FORMAT "%3.0" /end CHARACTERISTIC
/begin CHARACTERISTIC K_NABNSCH "Schwellwert für Generatorbegrenzung (BN n.i.O.)" VALUE 0xa1017bfe _REC_VAL_20_u1 1.9921 _CNV_R_R_Def_f_ub_b_625_CM 0. 1.9921 /end CHARACTERISTIC
/begin CHARACTERISTIC K_NGENHTMN1 "Untere Drehzahlschwelle für kritischen Bereich Didentemparatur" VALUE 0xa10160d2 _REC_VAL_20_s2 0. _CNV_R_R_Def_n_sw_q_612_CM 0. 32767. FORMAT "%5.0" /end CHARACTERISTIC
/begin CHARACTERISTIC K_NGENHTMX1 "Obere Drehzahlschwelle für kritischen Bereich Didentemparatur" VALUE 0xa10160d4 _REC_VAL_20_s2 0. _CNV_R_R_Def_n_sw_q_612_CM 0. 32767. FORMAT "%5.0" /end CHARACTERISTIC
/begin CHARACTERISTIC K_NKRF "Nkw-Schwelle" VALUE 0xa1014642 _REC_VAL_20_s2 0. _CNV_R_R_Def_n_sw_q_612_CM -32768. 32767. FORMAT "%5.0" /end CHARACTERISTIC
/begin CHARACTERISTIC K_NKWPSADNN_RAMP "Nkw ramp enable" VALUE 0xa1012928 _REC_VAL_20_s2 0. _CNV_R_R_Def_n_sw_q_612_CM -32768. 32767. FORMAT "%5.0" /end CHARACTERISTIC
/begin CHARACTERISTIC K_NNADQUOT_AGRAD "" VALUE 0xa101293e _REC_VAL_20_S4 0. _CNV_R_R_Def_dez_sl_575_CM -1000000000000. 10000000000000. FORMAT "%14.7" /end CHARACTERISTIC
/begin CHARACTERISTIC K_NNADQUOT_PSAD "" VALUE 0xa101292e _REC_VAL_20_S4 0. _CNV_R_R_Def_dez_sl_575_CM -1000000000000. 10000000000000. FORMAT "%14.7" /end CHARACTERISTIC
/begin CHARACTERISTIC K_NPK "Schwelle für Pulsationskorrektierung" VALUE 0xa101290c _REC_VAL_20_s2 0. _CNV_R_R_Def_n_sw_q_612_CM -32768. 32767. FORMAT "%5.0" /end CHARACTERISTIC
/begin CHARACTERISTIC K_NSCHW_CALC "" VALUE 0xa10160d6 _REC_VAL_20_s2 0. _CNV_R_R_Def_n_sw_q_612_CM 0. 32767. FORMAT "%5.0" /end CHARACTERISTIC
/begin CHARACTERISTIC K_NSTSTAT1 "" VALUE 0xa1014b02 _REC_VAL_20_s2 0. _CNV_R_R_Def_n_sw_q_612_CM -32768. 32767. FORMAT "%5.0" /end CHARACTERISTIC
/begin CHARACTERISTIC K_NSTSTAT2 "" VALUE 0xa1014b04 _REC_VAL_20_s2 0. _CNV_R_R_Def_n_sw_q_612_CM -32768. 32767. FORMAT "%5.0" /end CHARACTERISTIC
/begin CHARACTERISTIC K_NSTSTAT3 "" VALUE 0xa1014b06 _REC_VAL_20_s2 0. _CNV_R_R_Def_n_sw_q_612_CM -32768. 32767. FORMAT "%5.0" /end CHARACTERISTIC
/begin CHARACTERISTIC K_PKATPAK_MN "" VALUE 0xa1013352 _REC_VAL_20_u2 3.9999 _CNV_R_R_Def_f_sw_b_608_CM 0. 3.9999 FORMAT "%14.5" /end CHARACTERISTIC
/begin CHARACTERISTIC K_PRELLGTMOT "Prellzeit für Tmot-Schwelle" VALUE 0xa1016114 _REC_VAL_20_u1 99.45 _CNV_R_R_Def_td_uw__682_CM 0. 255. FORMAT "%5.2" /end CHARACTERISTIC
/begin CHARACTERISTIC K_PROUT2MS_F "Konvertierungsfaktor Ms to Faktor" VALUE 0xa1012912 _REC_VAL_20_s2 102.398435 _CNV_R_R_Def_ms_uw__611_CM -1024. 1023.9687 /end CHARACTERISTIC
/begin CHARACTERISTIC K_PR_MS_FAK "Ps-Regler Faktor Ersatzwert" VALUE 0xa101290e _REC_VAL_20_u2 1.9999 _CNV_R_R_Def_f_uw_b_579_CM 0. 1.9999 FORMAT "%14.5" /end CHARACTERISTIC
/begin CHARACTERISTIC K_PR_MS_OFF "Ps-Regler Offset Ersatzwert" VALUE 0xa1012910 _REC_VAL_20_s2 102.398435 _CNV_R_R_Def_ms_uw__611_CM -1024. 1023.9687 /end CHARACTERISTIC
/begin CHARACTERISTIC K_PSADGES_MN "" VALUE 0xa10128f6 _REC_VAL_20_s2 3.9999 _CNV_R_R_Def_f_sw_b_608_CM -2. 1.9999 FORMAT "%14.5" /end CHARACTERISTIC
/begin CHARACTERISTIC K_PSADGES_MX "" VALUE 0xa10128f8 _REC_VAL_20_s2 3.9999 _CNV_R_R_Def_f_sw_b_608_CM -2. 1.9999 FORMAT "%14.5" /end CHARACTERISTIC
/begin CHARACTERISTIC K_PSADMX "" VALUE 0xa1012932 _REC_VAL_20_S4 0. _CNV_R_R_Def_dez_sl_575_CM -1000000000000. 10000000000000. FORMAT "%14.7" /end CHARACTERISTIC
/begin CHARACTERISTIC K_PSAGR_FGMN "Min schwelle Psagr_fg" VALUE 0xa1012c5c _REC_VAL_20_u4 102.399996 _CNV_R_R_Def_p_ul_b_689_CM 0. 2559.9999 FORMAT "%7.4" /end CHARACTERISTIC
/begin CHARACTERISTIC K_PSAGR_FGMX "Max schwelle Psagr_fg" VALUE 0xa1012c58 _REC_VAL_20_u4 102.399996 _CNV_R_R_Def_p_ul_b_689_CM 0. 2559.9999 FORMAT "%7.4" /end CHARACTERISTIC
/begin CHARACTERISTIC K_PSAGR_IGMN "Min schwelle Psagr_ig" VALUE 0xa1012c54 _REC_VAL_20_u4 102.399996 _CNV_R_R_Def_p_ul_b_689_CM 0. 2559.9999 FORMAT "%7.4" /end CHARACTERISTIC
/begin CHARACTERISTIC K_PSAGR_IGMX "Max schwelle Psagr_ig" VALUE 0xa1012c50 _REC_VAL_20_u4 102.399996 _CNV_R_R_Def_p_ul_b_689_CM 0. 2559.9999 FORMAT "%7.4" /end CHARACTERISTIC
/begin CHARACTERISTIC K_PSMIN "Minimalwert für Ps" VALUE 0xa1012c62 _REC_VAL_20_u2 102.398436 _CNV_R_R_Def_p_sw_q_578_CM 0. 2559.9609 FORMAT "%5.2" /end CHARACTERISTIC
/begin CHARACTERISTIC K_PSPVDK_MN "Pspvdk_soll Min Schwelle für Druckreglerfreigabe" VALUE 0xa1012906 _REC_VAL_20_u2 3.9999 _CNV_R_R_Def_f_sw_b_608_CM 0. 3.9999 FORMAT "%14.5" /end CHARACTERISTIC
/begin CHARACTERISTIC K_PSPVDK_MX "Pspvdk_soll Max Schwelle für Druckreglerfreigabe" VALUE 0xa1012908 _REC_VAL_20_u2 3.9999 _CNV_R_R_Def_f_sw_b_608_CM 0. 3.9999 FORMAT "%14.5" /end CHARACTERISTIC
/begin CHARACTERISTIC K_PSREGIMN "PS-Regler I-Anteil Minimalwert" VALUE 0xa1012914 _REC_VAL_20_s2 3.9999 _CNV_R_R_Def_f_sw_b_608_CM -2. 1.9999 FORMAT "%14.5" /end CHARACTERISTIC
/begin CHARACTERISTIC K_PSREGIMX "PS-Regler I-Anteil Maximalwert" VALUE 0xa1012916 _REC_VAL_20_s2 3.9999 _CNV_R_R_Def_f_sw_b_608_CM -2. 1.9999 FORMAT "%14.5" /end CHARACTERISTIC
/begin CHARACTERISTIC K_PSREGINN_MN "" VALUE 0xa10128f2 _REC_VAL_20_s2 3.9999 _CNV_R_R_Def_f_sw_b_608_CM -2. 1.9999 FORMAT "%14.5" /end CHARACTERISTIC
/begin CHARACTERISTIC K_PSREGINN_MX "" VALUE 0xa10128f4 _REC_VAL_20_s2 3.9999 _CNV_R_R_Def_f_sw_b_608_CM -2. 1.9999 FORMAT "%14.5" /end CHARACTERISTIC
/begin CHARACTERISTIC K_PSREGMN "PS-Regler Minimalwert" VALUE 0xa10128dc _REC_VAL_20_s2 3.9999 _CNV_R_R_Def_f_sw_b_608_CM -2. 1.9999 FORMAT "%14.5" /end CHARACTERISTIC
/begin CHARACTERISTIC K_PSREGMX "PS-Regler Maximalwert" VALUE 0xa10128de _REC_VAL_20_s2 3.9999 _CNV_R_R_Def_f_sw_b_608_CM -2. 1.9999 FORMAT "%14.5" /end CHARACTERISTIC
/begin CHARACTERISTIC K_PSRON_MSAGRMN "Min. AGR Wert für Freigabe Druckregler" VALUE 0xa101291c _REC_VAL_20_u2 102.398435 _CNV_R_R_Def_ms_uw__611_CM 0. 2047.9687 /end CHARACTERISTIC
/begin CHARACTERISTIC K_PSRON_MSAGRMX "Max. AGR Wert für Freigabe Druckregler" VALUE 0xa101291e _REC_VAL_20_u2 102.398435 _CNV_R_R_Def_ms_uw__611_CM 0. 2047.9687 /end CHARACTERISTIC
/begin CHARACTERISTIC K_PSRON_NMN "Min. Drehzahl für Freigabe Druckregler" VALUE 0xa1012920 _REC_VAL_20_s2 0. _CNV_R_R_Def_n_sw_q_612_CM -32768. 32767. FORMAT "%5.0" /end CHARACTERISTIC
/begin CHARACTERISTIC K_PSRON_NMX "Max. Drehzahl für Freigabe Druckregler" VALUE 0xa1012922 _REC_VAL_20_s2 0. _CNV_R_R_Def_n_sw_q_612_CM -32768. 32767. FORMAT "%5.0" /end CHARACTERISTIC
/begin CHARACTERISTIC K_PSRON_TMMN "Min. Motortemperatur für Freigabe Druckregler" VALUE 0xa1012924 _REC_VAL_20_s2 98.30250000000001 _CNV_R_R_Def_t_sw_q_620_CM -327.68 327.67 FORMAT "%5.2" /end CHARACTERISTIC
/begin CHARACTERISTIC K_R_LADLTG "" VALUE 0xa10160e4 _REC_VAL_20_u2 102.39843 _CNV_R_R_Def_r_uw_b_778_CM 0. 1023.9843 FORMAT "%5.0" /end CHARACTERISTIC
/begin CHARACTERISTIC K_SLEEPWAIT "" VALUE 0xa1017296 _REC_VAL_20_u1 99.45 _CNV_R_R_Def_dez_sl_575_CM 0. 255. FORMAT "%4.1" /end CHARACTERISTIC
/begin CHARACTERISTIC K_S_CLERRIBS "IBS Fehlerlöschen schaltbar" VALUE 0xa1017294 _REC_VAL_20_u1 99.45 _CNV_R_R_Def_dez_sl_575_CM 0. 255. FORMAT "%3.0" /end CHARACTERISTIC
/begin CHARACTERISTIC K_T1SCHWELLE "" VALUE 0xa1017267 _REC_VAL_20_u1 10.2 _CNV_R_R_Def_i_ub_q_780_CM 0. 10.2 FORMAT "%5.2" /end CHARACTERISTIC
/begin CHARACTERISTIC K_T1SOC0 "" VALUE 0xa101725e _REC_VAL_20_u1 0. _CNV_R_R_Def_td_ub__781_CM 0. 65280. FORMAT "%5.2" /end CHARACTERISTIC
/begin CHARACTERISTIC K_T2SCHWELLE "" VALUE 0xa1017268 _REC_VAL_20_u1 10.2 _CNV_R_R_Def_i_ub_q_780_CM 0. 10.2 FORMAT "%5.2" /end CHARACTERISTIC
/begin CHARACTERISTIC K_T2SOC0 "" VALUE 0xa101725f _REC_VAL_20_u1 0. _CNV_R_R_Def_td_ub__781_CM 0. 65280. FORMAT "%5.2" /end CHARACTERISTIC
/begin CHARACTERISTIC K_T3SCHWELLE "" VALUE 0xa1017269 _REC_VAL_20_u1 10.2 _CNV_R_R_Def_i_ub_q_780_CM 0. 10.2 FORMAT "%5.2" /end CHARACTERISTIC
/begin CHARACTERISTIC K_T3SOC0 "" VALUE 0xa1017260 _REC_VAL_20_u1 0. _CNV_R_R_Def_td_ub__781_CM 0. 65280. FORMAT "%5.2" /end CHARACTERISTIC
/begin CHARACTERISTIC K_TCHIPFIL "Filterkonstante schneller Tchip Filter" VALUE 0xa10160e6 _REC_VAL_20_u2 0.9999847412109381 _CNV_R_R_Def_f_uw_b_591_CM 0. 0.9999847412109381 FORMAT "%14.5" /end CHARACTERISTIC
/begin CHARACTERISTIC K_TDFIERR "Maximalzeit Weitertaktung BSD" VALUE 0xa1017bf0 _REC_VAL_20_u2 98.30250000000001 _CNV_R_R_Def_td_uw__679_CM 0. 655.35 FORMAT "%5.2" /end CHARACTERISTIC
/begin CHARACTERISTIC K_TDNGENKRIT "Verzögerung Generator im kritischen Drehzahlbereich" VALUE 0xa1016115 _REC_VAL_20_u1 99.45 _CNV_R_R_Def_td_uw__682_CM 0. 255. FORMAT "%5.2" /end CHARACTERISTIC
/begin CHARACTERISTIC K_TDSTEND "Verzögerungszeit für B_startende" VALUE 0xa1014632 _REC_VAL_20_u1 25.4997 _CNV_R_R_Def_zk100m_782_CM 0.1003 25.6 FORMAT "%4.1" /end CHARACTERISTIC
/begin CHARACTERISTIC K_TDSTEND_KH "Verzögerungszeit für B_startende KHNN" VALUE 0xa1014633 _REC_VAL_20_u1 25.4997 _CNV_R_R_Def_zk100m_782_CM 0.1003 25.6 FORMAT "%4.1" /end CHARACTERISTIC
/begin CHARACTERISTIC K_TDTCHIPKRI "Verzögerung Generatorhochtemperatur" VALUE 0xa1016116 _REC_VAL_20_u1 99.45 _CNV_R_R_Def_td_uw__682_CM 0. 255. FORMAT "%5.2" /end CHARACTERISTIC
/begin CHARACTERISTIC K_TDTCHIPMX "Verzögerung erhöhte Chiptemperatur" VALUE 0xa1016117 _REC_VAL_20_u1 99.45 _CNV_R_R_Def_dez_sl_575_CM 0. 255. FORMAT "%3.0" /end CHARACTERISTIC
/begin CHARACTERISTIC K_TDUBFZMN "Verzögerung Bordnetzschwelle" VALUE 0xa1016118 _REC_VAL_20_u1 99.45 _CNV_R_R_Def_td_uw__682_CM 0. 255. FORMAT "%5.2" /end CHARACTERISTIC
/begin CHARACTERISTIC K_TD_PSRON "" VALUE 0xa101290a _REC_VAL_20_u2 0. _CNV_R_R_Def_dez_sl_575_CM 0. 65535. FORMAT "%5.0" /end CHARACTERISTIC
/begin CHARACTERISTIC K_TFIGENHT "Filterkonstante verteilter Generatorstrom" VALUE 0xa1016119 _REC_VAL_20_u1 0.9920000000000001 _CNV_R_R_Def_f_ub_b_573_CM 4.e-003 0.996 /end CHARACTERISTIC
/begin CHARACTERISTIC K_TFTDIODE "Filterkonstante Deltatemparatur Diode" VALUE 0xa10160e8 _REC_VAL_20_u2 0.9999694824218756 _CNV_R_R_Def_f_uw_b_591_CM 1.52587890625e-005 0.9999847412109381 FORMAT "%14.5" /end CHARACTERISTIC
/begin CHARACTERISTIC K_TGENMXGRAD "Schwellwert für Erkennung mayimaler Gradient" VALUE 0xa10160d8 _REC_VAL_20_s2 131.07 _CNV_R_R_Def_t_sw_q_618_CM -3276.8 3276.7 FORMAT "%4.1" /end CHARACTERISTIC
/begin CHARACTERISTIC K_TGENMXTHD "Schwellwert für überhöhte Temparatur Generator" VALUE 0xa10160da _REC_VAL_20_s2 131.07 _CNV_R_R_Def_t_sw_q_618_CM -3276.8 3276.7 FORMAT "%4.1" /end CHARACTERISTIC
/begin CHARACTERISTIC K_TGENRSHT "Reset bei unterschrittener Chiptemperatur" VALUE 0xa10160dc _REC_VAL_20_s2 131.07 _CNV_R_R_Def_t_sw_q_618_CM -3276.8 3276.7 FORMAT "%4.1" /end CHARACTERISTIC
/begin CHARACTERISTIC K_TIGMISCH "" VALUE 0xa101611a _REC_VAL_20_u1 2.55 _CNV_R_R_Def_td_uw__679_CM 0. 2.55 FORMAT "%5.2" /end CHARACTERISTIC
/begin CHARACTERISTIC K_TLCHTEP "Entprellung Hochtemperatur Generator" VALUE 0xa101611b _REC_VAL_20_u1 99.45 _CNV_R_R_Def_td_uw__682_CM 0. 255. FORMAT "%5.2" /end CHARACTERISTIC
/begin CHARACTERISTIC K_TMKHNN "Tmot-Schwelle KHNN" VALUE 0xa101463c _REC_VAL_20_s2 98.30250000000001 _CNV_R_R_Def_t_sw_q_620_CM -327.68 327.67 FORMAT "%5.2" /end CHARACTERISTIC
/begin CHARACTERISTIC K_TMKHNNLRN "Tmot-Schwelle KHNN lernen" VALUE 0xa1014640 _REC_VAL_20_s2 98.30250000000001 _CNV_R_R_Def_t_sw_q_620_CM -327.68 327.67 FORMAT "%5.2" /end CHARACTERISTIC
/begin CHARACTERISTIC K_TMKRANN "Tmot-Schwelle KRANN" VALUE 0xa101463a _REC_VAL_20_s2 98.30250000000001 _CNV_R_R_Def_t_sw_q_620_CM -327.68 327.67 FORMAT "%5.2" /end CHARACTERISTIC
/begin CHARACTERISTIC K_TMKRANNLRN "Tmot-Schwelle KRANN lernen" VALUE 0xa101463e _REC_VAL_20_s2 98.30250000000001 _CNV_R_R_Def_t_sw_q_620_CM -327.68 327.67 FORMAT "%5.2" /end CHARACTERISTIC
/begin CHARACTERISTIC K_TMPCOM_DIV "" VALUE 0xa1017278 _REC_VAL_20_u1 99.45 _CNV_R_R_Def_dez_sl_575_CM 0. 255. FORMAT "%3.0" /end CHARACTERISTIC
/begin CHARACTERISTIC K_TMPCOM_MUL "" VALUE 0xa1017277 _REC_VAL_20_u1 99.45 _CNV_R_R_Def_dez_sl_575_CM 0. 255. FORMAT "%3.0" /end CHARACTERISTIC
/begin CHARACTERISTIC K_TMPSADNN_RAMP "Tmot ramp enable" VALUE 0xa1012926 _REC_VAL_20_s2 98.30250000000001 _CNV_R_R_Def_t_sw_q_620_CM -327.68 327.67 FORMAT "%5.2" /end CHARACTERISTIC
/begin CHARACTERISTIC K_TNSPSADNN_RAMP "Zeit nach Start ramp enable" VALUE 0xa101292a _REC_VAL_20_u2 98.30250000000001 _CNV_R_R_Def_td_uw__679_CM 0. 655.35 FORMAT "%5.2" /end CHARACTERISTIC
/begin CHARACTERISTIC K_TNUSTART "" VALUE 0xa1017262 _REC_VAL_20_u1 3.1875 _CNV_R_R_Def_td_ub__784_CM 0. 3.1875 FORMAT "%5.2" /end CHARACTERISTIC
/begin CHARACTERISTIC K_TNUSTARTFL "" VALUE 0xa1017263 _REC_VAL_20_u1 0.51 _CNV_R_R_Def_td_ub__785_CM 1.e-002 0.52 /end CHARACTERISTIC
/begin CHARACTERISTIC K_TPT1TICO "" VALUE 0xa1017298 _REC_VAL_20_u2 98.30250000000001 _CNV_R_R_Def_td_ub__763_CM 0. 3276.75 FORMAT "%5.2" /end CHARACTERISTIC
/begin CHARACTERISTIC K_TSLEEPRUH "" VALUE 0xa1017266 _REC_VAL_20_u1 81.60000000000001 _CNV_R_R_Def_td_ub__786_CM 0. 4080. FORMAT "%5.2" /end CHARACTERISTIC
/begin CHARACTERISTIC K_TSTCNTEN "" VALUE 0xa101611c _REC_VAL_20_u1 99.45 _CNV_R_R_Def_dez_sl_575_CM 0. 255. FORMAT "%3.0" /end CHARACTERISTIC
/begin CHARACTERISTIC K_TSTFIL_IN "" VALUE 0xa10160ea _REC_VAL_20_u2 0. _CNV_R_R_Def_t_uw_q_728_CM 0. 49151.25 FORMAT "%5.2" /end CHARACTERISTIC
/begin CHARACTERISTIC K_TSTFIL_INI "" VALUE 0xa101611d _REC_VAL_20_u1 99.45 _CNV_R_R_Def_dez_sl_575_CM 0. 255. FORMAT "%3.0" /end CHARACTERISTIC
/begin CHARACTERISTIC K_T_CLERRIBS "" VALUE 0xa1017295 _REC_VAL_20_u1 99.45 _CNV_R_R_Def_dez_sl_575_CM 0. 255. FORMAT "%3.0" /end CHARACTERISTIC
/begin CHARACTERISTIC K_T_UTIEFSET "" VALUE 0xa1017265 _REC_VAL_20_u1 99.45 _CNV_R_R_Def_td_uw__682_CM 0. 255. FORMAT "%5.2" /end CHARACTERISTIC
/begin CHARACTERISTIC K_UBOFF "" VALUE 0xa10160ec _REC_VAL_20_u2 131.07 _CNV_R_R_Def_u_uw_q_731_CM 0. 6553.5 /end CHARACTERISTIC
/begin CHARACTERISTIC K_UDIODERMS4 "RMS-Schwellspannung Generatordiode4" VALUE 0xa101611e _REC_VAL_20_u1 1.9921 _CNV_R_R_Def_f_ub_b_625_CM 0. 1.9921 /end CHARACTERISTIC
/begin CHARACTERISTIC K_UGENHTMN "Schwellwert Bordnetzspannung Reset Generatorstrombefrenzung durch Hochtemperatur" VALUE 0xa10160ee _REC_VAL_20_u2 123.46794 _CNV_R_R_Def_u_sb_q_598_CM 0. 6173.397 FORMAT "%4.1" /end CHARACTERISTIC
/begin CHARACTERISTIC K_UTIEFAPP "" VALUE 0xa1017264 _REC_VAL_20_u1 16.32 _CNV_R_R_Def_u_ub_q_773_CM 6. 22.32 FORMAT "%5.2" /end CHARACTERISTIC
/begin CHARACTERISTIC K_ZKLAMFIL "Lambda filterzeitkonstante" VALUE 0xa1012c4e _REC_VAL_20_u2 655.35 _CNV_R_R_Def_zk10ms_723_CM 1.e-002 655.36 FORMAT "%7.4" /end CHARACTERISTIC
/begin CHARACTERISTIC K_ZK_AGROFF "Faktor zur Gegenkopplung AGR-Regler" VALUE 0xa10128eb _REC_VAL_20_u1 1.9921 _CNV_R_R_Def_f_ub_b_625_CM 0. 1.9921 /end CHARACTERISTIC
/begin CHARACTERISTIC K_ZK_PSADRAMP "Ramp gradient" VALUE 0xa101292c _REC_VAL_20_u2 1.9999 _CNV_R_R_Def_f_uw_b_579_CM 0. 1.9999 FORMAT "%14.5" /end CHARACTERISTIC
/begin CHARACTERISTIC K_ZK_PSROFF "Faktor zur Gegenkopplung AGR-Regler" VALUE 0xa10128ea _REC_VAL_20_u1 1.9921 _CNV_R_R_Def_f_ub_b_625_CM 0. 1.9921 /end CHARACTERISTIC
/begin CHARACTERISTIC K_ZK_TURBINE "Zeitkonstante Turbolader" VALUE 0xa1013354 _REC_VAL_20_u2 0.9999847412109381 _CNV_R_R_Def_f_uw_b_591_CM 0. 0.9999847412109381 FORMAT "%14.5" /end CHARACTERISTIC
/begin CHARACTERISTIC K_ZMGENIG "" VALUE 0xa10160f0 _REC_VAL_20_u2 131.07 _CNV_R_R_Def_td_ub__593_CM 0. 6553.5 FORMAT "%4.1" /end CHARACTERISTIC
/begin CHARACTERISTIC K_ZMGENS0HZ4 "Zeitkonstante Generatorstator4 Aufheizung im Stand" VALUE 0xa10160f2 _REC_VAL_20_u2 0.9999847412109381 _CNV_R_R_Def_f_uw_b_591_CM 0. 0.9999847412109381 FORMAT "%14.5" /end CHARACTERISTIC
/begin CHARACTERISTIC K_ZMGENS0KL4 "Zeitkonstante Abkühlung Generator im Stand4" VALUE 0xa10160f4 _REC_VAL_20_u2 0.9999847412109381 _CNV_R_R_Def_f_uw_b_591_CM 0. 0.9999847412109381 FORMAT "%14.5" /end CHARACTERISTIC
/begin CHARACTERISTIC K_ZMGENSTHZ4 "Zeitkonstante Generatorstator4 Aufheizung" VALUE 0xa10160f6 _REC_VAL_20_u2 0.9999847412109381 _CNV_R_R_Def_f_uw_b_591_CM 0. 0.9999847412109381 FORMAT "%14.5" /end CHARACTERISTIC
/begin CHARACTERISTIC K_ZMGENSTKL4 "Zeitkonstante Abkühlung Generator4" VALUE 0xa10160f8 _REC_VAL_20_u2 0.9999847412109381 _CNV_R_R_Def_f_uw_b_591_CM 0. 0.9999847412109381 FORMAT "%14.5" /end CHARACTERISTIC
/begin CHARACTERISTIC K_ZMGENTWA "" VALUE 0xa10160fa _REC_VAL_20_u2 0.9999847412109381 _CNV_R_R_Def_f_uw_b_591_CM 0. 0.9999847412109381 FORMAT "%14.5" /end CHARACTERISTIC
/begin CHARACTERISTIC K_ZMGN0TANS4 "Zeitkonstante Generatoransaugluft4 bei vfzg = 0" VALUE 0xa10160fc _REC_VAL_20_u2 0.9999847412109381 _CNV_R_R_Def_f_uw_b_591_CM 0. 0.9999847412109381 FORMAT "%14.5" /end CHARACTERISTIC
/begin CHARACTERISTIC K_ZMGNTANS4 "Zeitkonstante Generatoransaugluft4" VALUE 0xa10160fe _REC_VAL_20_u2 0.9999847412109381 _CNV_R_R_Def_f_uw_b_591_CM 0. 0.9999847412109381 FORMAT "%14.5" /end CHARACTERISTIC
/begin CHARACTERISTIC K_ZMIGMISCH "Zeitkonstante IG Mischung" VALUE 0xa1016100 _REC_VAL_20_u2 0.9999847412109381 _CNV_R_R_Def_f_uw_b_591_CM 0. 0.9999847412109381 FORMAT "%14.5" /end CHARACTERISTIC
/begin CHARACTERISTIC K_ZMTESTFIL "" VALUE 0xa1016102 _REC_VAL_20_u2 0.9999847412109381 _CNV_R_R_Def_f_uw_b_591_CM 0. 0.9999847412109381 FORMAT "%14.5" /end CHARACTERISTIC
/begin CHARACTERISTIC S_AGRAD_ON "" VALUE 0xa10128ec _REC_VAL_20_u1 1. _CNV_R_R_Def_dez_sl_575_CM 0. 1. FORMAT "%3.0" /end CHARACTERISTIC
/begin CHARACTERISTIC S_DESU_FETT "Schalter Aktivierung Einrechnung" VALUE 0xa1019d55 _REC_VAL_20_u1 99.45 _CNV_R_R_Def_dez_sl_575_CM 0. 255. FORMAT "%3.0" /end CHARACTERISTIC
/begin CHARACTERISTIC S_DESU_PULS "Schalter Aktivierung Einrechnung" VALUE 0xa1019d54 _REC_VAL_20_u1 99.45 _CNV_R_R_Def_dez_sl_575_CM 0. 255. FORMAT "%3.0" /end CHARACTERISTIC
/begin CHARACTERISTIC S_ETALAM_IST "Umschaltung Berechnung Eta_lambda " VALUE 0xa1019d56 _REC_VAL_20_u1 1. _CNV_R_R_Def_dez_sl_575_CM 0. 1. FORMAT "%3.0" /end CHARACTERISTIC
/begin CHARACTERISTIC S_HTDETEC "Schalter zur Aktivierung Überwachung Diodentemparatur" VALUE 0xa101611f _REC_VAL_20_u1 1. _CNV_R_R_Def_dez_sl_575_CM 0. 1. FORMAT "%4.1" /end CHARACTERISTIC
/begin CHARACTERISTIC S_IERRGRAPPL "Freischaltung Applikationswert Grenzerregerstrom" VALUE 0xa1016120 _REC_VAL_20_u1 1. _CNV_R_R_Def_dez_sl_575_CM 0. 1. FORMAT "%4.1" /end CHARACTERISTIC
/begin CHARACTERISTIC S_IGMISCH "" VALUE 0xa1016121 _REC_VAL_20_u1 1. _CNV_R_R_Def_dez_sl_575_CM 0. 1. FORMAT "%4.1" /end CHARACTERISTIC
/begin CHARACTERISTIC S_KHNNLERN "Applikationsschalter zum erzwungenen Lernen KHNN" VALUE 0xa1014639 _REC_VAL_20_u1 1. _CNV_R_R_Def_dez_sl_575_CM 0. 1. FORMAT "%3.0" /end CHARACTERISTIC
/begin CHARACTERISTIC S_KHNN_EIN "Einschalter KHNN" VALUE 0xa1014637 _REC_VAL_20_u1 1. _CNV_R_R_Def_dez_sl_575_CM 0. 1. FORMAT "%3.0" /end CHARACTERISTIC
/begin CHARACTERISTIC S_KHNN_F "Einschalter manuelle Gewichtsverstellung" VALUE 0xa1014636 _REC_VAL_20_u1 1. _CNV_R_R_Def_dez_sl_575_CM 0. 1. FORMAT "%3.0" /end CHARACTERISTIC
/begin CHARACTERISTIC S_KRANN "Einschalter Adaption" VALUE 0xa1014634 _REC_VAL_20_u1 1. _CNV_R_R_Def_dez_sl_575_CM 0. 1. FORMAT "%3.0" /end CHARACTERISTIC
/begin CHARACTERISTIC S_KRANNLERN "Applikationsschalter zum erzwungenen Lernen KRANN" VALUE 0xa1014638 _REC_VAL_20_u1 1. _CNV_R_R_Def_dez_sl_575_CM 0. 1. FORMAT "%3.0" /end CHARACTERISTIC
/begin CHARACTERISTIC S_KRANNLL "Einschalter Auslesen KRANN im Leerlauf" VALUE 0xa1014635 _REC_VAL_20_u1 1. _CNV_R_R_Def_dez_sl_575_CM 0. 1. FORMAT "%3.0" /end CHARACTERISTIC
/begin CHARACTERISTIC S_LAMHOMMAN "Schalter Lambda-Sollwert Homogen über Applikation setzen" VALUE 0xa1019d8d _REC_VAL_20_u1 99.45 _CNV_R_R_Def_dez_sl_575_CM 0. 255. FORMAT "%3.0" /end CHARACTERISTIC
/begin CHARACTERISTIC S_LS_TREU "Schalter Umschalten auf Wirkungsgradberechnung mit Modellwerten" VALUE 0xa1019d8e _REC_VAL_20_u1 99.45 _CNV_R_R_Def_dez_sl_575_CM 0. 255. FORMAT "%3.0" /end CHARACTERISTIC
/begin CHARACTERISTIC S_MDGEN_RINF "1: Ringpuffer aktiviert" VALUE 0xa1017bff _REC_VAL_20_u1 1. _CNV_R_R_Def_dez_sl_575_CM 0. 1. FORMAT "%4.1" /end CHARACTERISTIC
/begin CHARACTERISTIC S_MDWAHLGG "1: Lokal gefiltertes Generatormoment wird verwendet" VALUE 0xa1017c00 _REC_VAL_20_u1 1. _CNV_R_R_Def_dez_sl_575_CM 0. 1. FORMAT "%4.1" /end CHARACTERISTIC
/begin CHARACTERISTIC S_NPLAGR_RESET "" VALUE 0xa10128ee _REC_VAL_20_u1 1. _CNV_R_R_Def_dez_sl_575_CM 0. 1. FORMAT "%3.0" /end CHARACTERISTIC
/begin CHARACTERISTIC S_NPLPSR_RESET "" VALUE 0xa10128f0 _REC_VAL_20_u1 1. _CNV_R_R_Def_dez_sl_575_CM 0. 1. FORMAT "%3.0" /end CHARACTERISTIC
/begin CHARACTERISTIC S_PREGSOL "Schalter Regelung mit Ps oder Pssol" VALUE 0xa10128e6 _REC_VAL_20_u1 1. _CNV_R_R_Def_dez_sl_575_CM 0. 1. FORMAT "%3.0" /end CHARACTERISTIC
/begin CHARACTERISTIC S_PR_MS_FAK "Schalter Regler Ausgang Berechnung Modus" VALUE 0xa10128e7 _REC_VAL_20_u1 1. _CNV_R_R_Def_dez_sl_575_CM 0. 1. FORMAT "%3.0" /end CHARACTERISTIC
/begin CHARACTERISTIC S_PSAD_ON "" VALUE 0xa10128ef _REC_VAL_20_u1 1. _CNV_R_R_Def_dez_sl_575_CM 0. 1. FORMAT "%3.0" /end CHARACTERISTIC
/begin CHARACTERISTIC S_PSREGOFF "Schalter Differenzdruck Saugrohr Adaption ausgeschaltet" VALUE 0xa10128e5 _REC_VAL_20_u1 1. _CNV_R_R_Def_dez_sl_575_CM 0. 1. FORMAT "%3.0" /end CHARACTERISTIC
/begin CHARACTERISTIC S_PSRVLOFF "Schaltet !B_vl zu B_psreg_akt (bei CW_MPR_KOORD = 0x1)" VALUE 0xa10128e8 _REC_VAL_20_u1 1. _CNV_R_R_Def_dez_sl_575_CM 0. 1. FORMAT "%3.0" /end CHARACTERISTIC
/begin CHARACTERISTIC S_RDGENTYP "Schalter Freigabe Manuelle Vorgabe Generatortyp" VALUE 0xa1016122 _REC_VAL_20_u1 99.45 _CNV_R_R_Def_dez_sl_575_CM 0. 255. FORMAT "%3.0" /end CHARACTERISTIC
/begin CHARACTERISTIC S_SDF_ABS "Schalter Absolutdrucksensor eingebaut" VALUE 0xa10128e4 _REC_VAL_20_u1 1. _CNV_R_R_Def_dez_sl_575_CM 0. 1. FORMAT "%3.0" /end CHARACTERISTIC
/begin CHARACTERISTIC S_SRSTAB_PIRG "SR Stabilisierung mit Pirg eingeschaltet" VALUE 0xa1012c4c _REC_VAL_20_u1 99.45 _CNV_R_R_Def_dez_sl_575_CM 0. 255. FORMAT "%3.0" /end CHARACTERISTIC
/begin COMPU_METHOD _CNV_R_R_DEZ_436_CM "" RAT_FUNC "%6.3" "" COEFFS 0. 1. 0. 0. 0. 1. /end COMPU_METHOD
/begin COMPU_METHOD _CNV_R_R_Def_f_ub_b_573_CM "Def_f_ub_b1" RAT_FUNC "%6.3" "-" COEFFS 0. 256. 0. 0. 0. 1. /end COMPU_METHOD
/begin COMPU_METHOD _CNV_R_R_Def_m_sw_q_574_CM "Def_m_sw_q0p1" RAT_FUNC "%6.3" "Nm" COEFFS 0. 10. 0. 0. 0. 1. /end COMPU_METHOD
/begin COMPU_METHOD _CNV_R_R_Def_dez_sl_575_CM "Def_dez_sl_q1" RAT_FUNC "%6.3" "-" COEFFS 0. 1. 0. 0. 0. 1. /end COMPU_METHOD
/begin COMPU_METHOD _CNV_R_R_Def_f_uw_b_576_CM "Def_f_uw_b100" RAT_FUNC "%6.3" "%" COEFFS 0. 65536. 0. 0. 0. 100. /end COMPU_METHOD
/begin COMPU_METHOD _CNV_R_R_Def_f_sw_b_577_CM "Def_f_sw_b32" RAT_FUNC "%6.3" "-" COEFFS 0. 32768. 0. 0. 0. 32. /end COMPU_METHOD
/begin COMPU_METHOD _CNV_R_R_Def_p_sw_q_578_CM "Def_p_sw_q0p039" RAT_FUNC "%6.3" "hPa" COEFFS 0. 256. 0. 0. 0. 10. /end COMPU_METHOD
/begin COMPU_METHOD _CNV_R_R_Def_f_uw_b_579_CM "Def_f_uw_b2" RAT_FUNC "%6.3" "-" COEFFS 0. 65536. 0. 0. 0. 2. /end COMPU_METHOD
/begin COMPU_METHOD _CNV_R_R_Def_f_uw_b_580_CM "Def_f_uw_b64" RAT_FUNC "%6.3" "-" COEFFS 0. 65536. 0. 0. 0. 64. /end COMPU_METHOD
/begin COMPU_METHOD _CNV_R_R_Def_spr_sw_583_CM "Def_spr_sw_q0p1" RAT_FUNC "%6.3" "° KW" COEFFS 0. 10. 0. 0. 0. 1. /end COMPU_METHOD
/begin COMPU_METHOD _CNV_R_R_Def_f_uw_b_591_CM "Def_f_uw_b1" RAT_FUNC "%6.3" "-" COEFFS 0. 65536. 0. 0. 0. 1. /end COMPU_METHOD
/begin COMPU_METHOD _CNV_R_R_Def_td_ub__593_CM "Def_td_ub_q0p1" RAT_FUNC "%6.3" "s" COEFFS 0. 10. 0. 0. 0. 1. /end COMPU_METHOD
/begin COMPU_METHOD _CNV_R_R_Def_f_uw_b_594_CM "Def_f_uw_b16" RAT_FUNC "%6.3" "-" COEFFS 0. 65536. 0. 0. 0. 16. /end COMPU_METHOD
/begin COMPU_METHOD _CNV_R_R_Def_ql_uw__596_CM "Def_ql_uw_q0p0182" RAT_FUNC "%6.3" "Ah" COEFFS 0. 989. 0. 0. 0. 18. /end COMPU_METHOD
/begin COMPU_METHOD _CNV_R_R_Def_f_sw_b_597_CM "Def_f_sw_b100" RAT_FUNC "%6.3" "-" COEFFS 0. 32768. 0. 0. 0. 100. /end COMPU_METHOD
/begin COMPU_METHOD _CNV_R_R_Def_u_sb_q_598_CM "Def_u_sb_q0p0942" RAT_FUNC "%6.3" "V" COEFFS 0. 1. 0. 0. 0. 9.420000000000001e-002 /end COMPU_METHOD
/begin COMPU_METHOD _CNV_R_R_Def_zw_sw__599_CM "Def_zw_sw_q0p1" RAT_FUNC "%6.3" "°" COEFFS 0. 10. 0. 0. 0. 1. /end COMPU_METHOD
/begin COMPU_METHOD _CNV_R_R_Def_f_ub_b_602_CM "Def_f_ub_b100" RAT_FUNC "%6.3" "%" COEFFS 0. 256. 0. 0. 0. 100. /end COMPU_METHOD
/begin COMPU_METHOD _CNV_R_R_Def_dt_sw__603_CM "Def_dt_sw_b4096" RAT_FUNC "%6.3" "m/s" COEFFS 0. 32768. 0. 0. 0. 4096. /end COMPU_METHOD
/begin COMPU_METHOD _CNV_R_R_Def_f_uw_b_604_CM "Def_f_uw_b32" RAT_FUNC "%6.3" "-" COEFFS 0. 65536. 0. 0. 0. 32. /end COMPU_METHOD
/begin COMPU_METHOD _CNV_R_R_Def_f_sw_b_607_CM "Def_f_sw_b8" RAT_FUNC "%6.3" "-" COEFFS 0. 32768. 0. 0. 0. 8. /end COMPU_METHOD
/begin COMPU_METHOD _CNV_R_R_Def_f_sw_b_608_CM "Def_f_sw_b2" RAT_FUNC "%6.3" "-" COEFFS 0. 65536. 0. 0. 0. 4. /end COMPU_METHOD
/begin COMPU_METHOD _CNV_R_R_Def_ms_uw__611_CM "Def_ms_uw_q0p03125" RAT_FUNC "%6.3" "kg/h" COEFFS 0. 32. 0. 0. 0. 1. /end COMPU_METHOD
/begin COMPU_METHOD _CNV_R_R_Def_n_sw_q_612_CM "Def_n_sw_q1p0" RAT_FUNC "%6.3" "Upm" COEFFS 0. 1. 0. 0. 0. 1. /end COMPU_METHOD
/begin COMPU_METHOD _CNV_R_R_Def_rf_sw__616_CM "Def_rf_sw_q0p01" RAT_FUNC "%6.3" "%" COEFFS 0. 100. 0. 0. 0. 1. /end COMPU_METHOD
/begin COMPU_METHOD _CNV_R_R_Def_eta_sw_617_CM "Def_eta_sw_b200" RAT_FUNC "%6.3" "%" COEFFS 0. 32768. 0. 0. 0. 200. /end COMPU_METHOD
/begin COMPU_METHOD _CNV_R_R_Def_t_sw_q_618_CM "Def_t_sw_q0p1" RAT_FUNC "%6.3" "°C" COEFFS 0. 10. 0. 0. 0. 1. /end COMPU_METHOD
/begin COMPU_METHOD _CNV_R_R_Def_t_sw_q_620_CM "Def_t_sw_q0p01" RAT_FUNC "%6.3" "°C" COEFFS 0. 100. 0. 0. 0. 1. /end COMPU_METHOD
/begin COMPU_METHOD _CNV_R_R_Def_f_ub_b_625_CM "Def_f_ub_b2" RAT_FUNC "%6.3" "-" COEFFS 0. 256. 0. 0. 0. 2. /end COMPU_METHOD
/begin COMPU_METHOD _CNV_R_R_Def_eta_sw_628_CM "Def_eta_sw_q0p00305" RAT_FUNC "%6.3" "%" COEFFS 0. 32767. 0. 0. 0. 100. /end COMPU_METHOD
/begin COMPU_METHOD _CNV_R_R_Def_f_uw_b_629_CM "Def_f_uw_b10" RAT_FUNC "%6.3" "%" COEFFS 0. 65536. 0. 0. 0. 10. /end COMPU_METHOD
/begin COMPU_METHOD _CNV_R_R_Def_f_uw_b_630_CM "Def_f_uw_b2048" RAT_FUNC "%6.3" "-" COEFFS 0. 65536. 0. 0. 0. 2048. /end COMPU_METHOD
/begin COMPU_METHOD _CNV_R_R_Def_f_uw_b_632_CM "Def_f_uw_b256" RAT_FUNC "%6.3" "-" COEFFS 0. 65536. 0. 0. 0. 256. /end COMPU_METHOD
/begin COMPU_METHOD _CNV_R_R_Def_i_sw_q_638_CM "Def_i_sw_q1" RAT_FUNC "%6.3" "A" COEFFS 0. 1. 0. 0. 0. 1. /end COMPU_METHOD
/begin COMPU_METHOD _CNV_R_R_Def_eta_ul_641_CM "Def_eta_ul_b8192" RAT_FUNC "%6.3" "-" COEFFS 0. 524288. 0. 0. 0. 1. /end COMPU_METHOD
/begin COMPU_METHOD _CNV_R_R_Def_i_uw_q_642_CM "Def_i_uw_q0p08_o200" RAT_FUNC "%6.3" "" COEFFS 0. 25. 5000. 0. 0. 2. /end COMPU_METHOD
/begin COMPU_METHOD _CNV_R_R_Def_i_ub_q_645_CM "Def_i_ub_q0p125" RAT_FUNC "%6.3" "A" COEFFS 0. 8. 0. 0. 0. 1. /end COMPU_METHOD
/begin COMPU_METHOD _CNV_R_R_Def_i_uw_q_646_CM "Def_i_uw_q0p03125" RAT_FUNC "%6.3" "A" COEFFS 0. 65536. 0. 0. 0. 2048. /end COMPU_METHOD
/begin COMPU_METHOD _CNV_R_R_Def_i_sw_q_647_CM "Def_i_sw_q0p02" RAT_FUNC "%6.3" "A" COEFFS 0. 50. 0. 0. 0. 1. /end COMPU_METHOD
/begin COMPU_METHOD _CNV_R_R_Def_i_uw_q_648_CM "Def_i_uw_q0p02" RAT_FUNC "%6.3" "A" COEFFS 0. 1. 0. 0. 0. 2.e-002 /end COMPU_METHOD
/begin COMPU_METHOD _CNV_R_R_Def_i_uw_q_649_CM "Def_i_uw_q0p02_o200" RAT_FUNC "%6.3" "A" COEFFS 0. 50. 10000. 0. 0. 1. /end COMPU_METHOD
/begin COMPU_METHOD _CNV_R_R_Def_i_sw_q_653_CM "Def_i_sw_q0p03125" RAT_FUNC "%6.3" "A" COEFFS 0. 32. 0. 0. 0. 1. /end COMPU_METHOD
/begin COMPU_METHOD _CNV_R_R_Def_f_ul_b_656_CM "Def_f_ul_b32" RAT_FUNC "%6.3" "-" COEFFS 0. 16384. 0. 0. 0. 1. /end COMPU_METHOD
/begin COMPU_METHOD _CNV_R_R_Def_lst_uw_657_CM "Def_lst_uw_b131072" RAT_FUNC "%6.3" "W" COEFFS 0. 1. 0. 0. 0. 2. /end COMPU_METHOD
/begin COMPU_METHOD _CNV_R_R_Def_m_sw_q_659_CM "Def_m_sw_q0p01" RAT_FUNC "%6.3" "Nm" COEFFS 0. 100. 0. 0. 0. 1. /end COMPU_METHOD
/begin COMPU_METHOD _CNV_R_R_Def_ml_uw__662_CM "Def_ml_uw_q0p1" RAT_FUNC "%6.3" "kg/h" COEFFS 0. 10. 0. 0. 0. 1. /end COMPU_METHOD
/begin COMPU_METHOD _CNV_R_R_Def_f_ub_b_670_CM "Def_f_ub_b4" RAT_FUNC "%6.3" "-" COEFFS 0. 256. 0. 0. 0. 4. /end COMPU_METHOD
/begin COMPU_METHOD _CNV_R_R_Def_lf_ub__675_CM "Def_lf_ub_q0p01" RAT_FUNC "%6.3" "-" COEFFS 0. 100. 0. 0. 0. 1. /end COMPU_METHOD
/begin COMPU_METHOD _CNV_R_R_Def_td_uw__679_CM "Def_td_uw_q0p01" RAT_FUNC "%6.3" "s" COEFFS 0. 100. 0. 0. 0. 1. /end COMPU_METHOD
/begin COMPU_METHOD _CNV_R_R_Def_td_uw__682_CM "Def_td_uw_q1" RAT_FUNC "%6.3" "s" COEFFS 0. 1. 0. 0. 0. 1. /end COMPU_METHOD
/begin COMPU_METHOD _CNV_R_R_Def_p_ul_b_689_CM "Def_p_ul_b2560" RAT_FUNC "%6.3" "hPa" COEFFS 0. 16777216. 0. 0. 0. 10. /end COMPU_METHOD
/begin COMPU_METHOD _CNV_R_R_Def_rk_sw__697_CM "Def_rk_sw_b1600" RAT_FUNC "%6.3" "%" COEFFS 0. 2048. 0. 0. 0. 100. /end COMPU_METHOD
/begin COMPU_METHOD _CNV_R_R_Def_f_sb_b_699_CM "Def_f_sb_b1" RAT_FUNC "%6.3" "-" COEFFS 0. 128. 0. 0. 0. 1. /end COMPU_METHOD
/begin COMPU_METHOD _CNV_S_2_Def_bit_ub_700_CM "Def_bit_ub_0" TAB_VERB "%6.3" "-" COMPU_TAB_REF _CNV_S_2_Def_bit_ub_700 /end COMPU_METHOD
/begin COMPU_VTAB _CNV_S_2_Def_bit_ub_700 "Def_bit_ub_0" TAB_VERB 2 0 "FALSE" 1 "TRUE" /end COMPU_VTAB
/begin COMPU_METHOD _CNV_S_2_Def_bit_ub_701_CM "Def_bit_ub_1" TAB_VERB "%6.3" "-" COMPU_TAB_REF _CNV_S_2_Def_bit_ub_701 /end COMPU_METHOD
/begin COMPU_VTAB _CNV_S_2_Def_bit_ub_701 "Def_bit_ub_1" TAB_VERB 2 0 "FALSE" 2 "TRUE" /end COMPU_VTAB
/begin COMPU_METHOD _CNV_S_2_Def_bit_ub_702_CM "Def_bit_ub_2" TAB_VERB "%6.3" "-" COMPU_TAB_REF _CNV_S_2_Def_bit_ub_702 /end COMPU_METHOD
/begin COMPU_VTAB _CNV_S_2_Def_bit_ub_702 "Def_bit_ub_2" TAB_VERB 2 0 "FALSE" 4 "TRUE" /end COMPU_VTAB
/begin COMPU_METHOD _CNV_S_2_Def_bit_ub_703_CM "Def_bit_ub_3" TAB_VERB "%6.3" "-" COMPU_TAB_REF _CNV_S_2_Def_bit_ub_703 /end COMPU_METHOD
/begin COMPU_VTAB _CNV_S_2_Def_bit_ub_703 "Def_bit_ub_3" TAB_VERB 2 0 "FALSE" 8 "TRUE" /end COMPU_VTAB
/begin COMPU_METHOD _CNV_S_2_Def_bit_ub_704_CM "Def_bit_ub_4" TAB_VERB "%6.3" "-" COMPU_TAB_REF _CNV_S_2_Def_bit_ub_704 /end COMPU_METHOD
/begin COMPU_VTAB _CNV_S_2_Def_bit_ub_704 "Def_bit_ub_4" TAB_VERB 2 0 "FALSE" 16 "TRUE" /end COMPU_VTAB
/begin COMPU_METHOD _CNV_S_2_Def_bit_ub_705_CM "Def_bit_ub_5" TAB_VERB "%6.3" "-" COMPU_TAB_REF _CNV_S_2_Def_bit_ub_705 /end COMPU_METHOD
/begin COMPU_VTAB _CNV_S_2_Def_bit_ub_705 "Def_bit_ub_5" TAB_VERB 2 0 "FALSE" 32 "TRUE" /end COMPU_VTAB
/begin COMPU_METHOD _CNV_S_2_Def_bit_ub_706_CM "Def_bit_ub_6" TAB_VERB "%6.3" "-" COMPU_TAB_REF _CNV_S_2_Def_bit_ub_706 /end COMPU_METHOD
/begin COMPU_VTAB _CNV_S_2_Def_bit_ub_706 "Def_bit_ub_6" TAB_VERB 2 0 "FALSE" 64 "TRUE" /end COMPU_VTAB
/begin COMPU_METHOD _CNV_R_R_Def_zk10ms_723_CM "Def_zk10ms_uw_b655p36" RAT_FUNC "%6.3" "s" COEFFS 0. 0. 655.36 0. 1. 0. /end COMPU_METHOD
/begin COMPU_METHOD _CNV_R_R_Def_t_uw_q_728_CM "Def_t_uw_q0p075" RAT_FUNC "%6.3" "°C" COEFFS 0. 1. 0. 0. 0. 0.75 /end COMPU_METHOD
/begin COMPU_METHOD _CNV_R_R_Def_u_uw_q_730_CM "Def_u_uw_q0p25em3_o6" RAT_FUNC "%6.3" "" COEFFS 0. -4000. 24000. 0. 0. -1. /end COMPU_METHOD
/begin COMPU_METHOD _CNV_R_R_Def_u_uw_q_731_CM "Def_u_uw_q0p1" RAT_FUNC "%6.3" "V" COEFFS 0. 10. 0. 0. 0. 1. /end COMPU_METHOD
/begin COMPU_METHOD _CNV_R_R_Def_u_uw_q_734_CM "Def_u_uw_q0p00488" RAT_FUNC "%6.3" "V" COEFFS 0. 1024. 0. 0. 0. 5. /end COMPU_METHOD
/begin COMPU_METHOD _CNV_R_R_Def_v_uw_q_737_CM "Def_v_uw_q1p0" RAT_FUNC "%6.3" "km/h" COEFFS 0. 1. 0. 0. 0. 1. /end COMPU_METHOD
/begin COMPU_METHOD _CNV_R_R_Def_f_ub_b_753_CM "Def_f_ub_b8" RAT_FUNC "%6.3" "-" COEFFS 0. 256. 0. 0. 0. 8. /end COMPU_METHOD
/begin COMPU_METHOD _CNV_R_R_Def_td_ub__763_CM "Def_td_ub_q0p05" RAT_FUNC "%6.3" "s" COEFFS 0. 20. 0. 0. 0. 1. /end COMPU_METHOD
/begin COMPU_METHOD _CNV_R_R_Def_i_ub_q_770_CM "Def_i_ub_q0p08" RAT_FUNC "%6.3" "A" COEFFS 0. 25. 0. 0. 0. 2. /end COMPU_METHOD
/begin COMPU_METHOD _CNV_R_R_Def_td_ub__771_CM "Def_td_ub_q0p00625" RAT_FUNC "%6.3" "s" COEFFS 0. 160. 0. 0. 0. 1. /end COMPU_METHOD
/begin COMPU_METHOD _CNV_R_R_Def_u_ub_q_772_CM "Def_u_ub_q0p0196" RAT_FUNC "%6.3" "V" COEFFS 0. 1. 0. 0. 0. 1.96e-002 /end COMPU_METHOD
/begin COMPU_METHOD _CNV_R_R_Def_u_ub_q_773_CM "Def_u_ub_q0p064_o6" RAT_FUNC "%6.3" "V" COEFFS 0. -125. 750. 0. 0. -8. /end COMPU_METHOD
/begin COMPU_METHOD _CNV_R_R_Def_i_ub_q_774_CM "Def_i_ub_q5p12" RAT_FUNC "%6.3" "" COEFFS 0. 25. 0. 0. 0. 128. /end COMPU_METHOD
/begin COMPU_METHOD _CNV_R_R_Def_r_uw_b_778_CM "Def_r_uw_b1024" RAT_FUNC "%6.3" "mOhm" COEFFS 0. 64. 0. 0. 0. 1. /end COMPU_METHOD
/begin COMPU_METHOD _CNV_R_R_Def_i_ub_q_780_CM "Def_i_ub_q0p04" RAT_FUNC "%6.3" "A" COEFFS 0. 25. 0. 0. 0. 1. /end COMPU_METHOD
/begin COMPU_METHOD _CNV_R_R_Def_td_ub__781_CM "Def_td_ub_q256" RAT_FUNC "%6.3" "s" COEFFS 0. 1. 0. 0. 0. 256. /end COMPU_METHOD
/begin COMPU_METHOD _CNV_R_R_Def_zk100m_782_CM "Def_zk100ms_ub_b25p6" RAT_FUNC "%6.3" "s" COEFFS 0. 0. 25.6 0. 1. 0. /end COMPU_METHOD
/begin COMPU_METHOD _CNV_R_R_Def_td_ub__784_CM "Def_td_ub_q0p0125" RAT_FUNC "%6.3" "s" COEFFS 0. 80. 0. 0. 0. 1. /end COMPU_METHOD
/begin COMPU_METHOD _CNV_R_R_Def_td_ub__785_CM "Def_td_ub_q0p002_o01" RAT_FUNC "%6.3" "s" COEFFS 0. -1. 1.e-002 0. 0. -2.e-003 /end COMPU_METHOD
/begin COMPU_METHOD _CNV_R_R_Def_td_ub__786_CM "Def_td_ub_q16" RAT_FUNC "%6.3" "s" COEFFS 0. 1. 0. 0. 0. 16. /end COMPU_METHOD
/begin RECORD_LAYOUT _REC_VAL_20_u1 FNC_VALUES 1 UBYTE COLUMN_DIR DIRECT /end RECORD_LAYOUT
/begin RECORD_LAYOUT _REC_VAL_20_u2 FNC_VALUES 1 UWORD COLUMN_DIR DIRECT /end RECORD_LAYOUT
/begin RECORD_LAYOUT _REC_AXS_20_u1 NO_AXIS_PTS_X 1 UBYTE AXIS_PTS_X 2 UBYTE INDEX_INCR DIRECT /end RECORD_LAYOUT
/begin RECORD_LAYOUT _REC_VAL_20_s2 FNC_VALUES 1 SWORD COLUMN_DIR DIRECT /end RECORD_LAYOUT
/begin RECORD_LAYOUT _REC_CUR_20_u2_u1 FNC_VALUES 1 UWORD COLUMN_DIR DIRECT /end RECORD_LAYOUT
/begin RECORD_LAYOUT _REC_VAL_20_u4 FNC_VALUES 1 ULONG COLUMN_DIR DIRECT /end RECORD_LAYOUT
/begin RECORD_LAYOUT _REC_CUR_20_s2_u1 FNC_VALUES 1 SWORD COLUMN_DIR DIRECT /end RECORD_LAYOUT
/begin RECORD_LAYOUT _REC_MAP_52_UBYTE_u2_s2_s2 NO_AXIS_PTS_X 1 UBYTE NO_AXIS_PTS_Y 2 UBYTE AXIS_PTS_X 3 SWORD INDEX_INCR DIRECT AXIS_PTS_Y 4 SWORD INDEX_INCR DIRECT FNC_VALUES 5 UWORD COLUMN_DIR DIRECT /end RECORD_LAYOUT
/begin RECORD_LAYOUT _REC_MAP_52_UBYTE_u2_s2_u2 NO_AXIS_PTS_X 1 UBYTE NO_AXIS_PTS_Y 2 UBYTE AXIS_PTS_X 3 SWORD INDEX_INCR DIRECT AXIS_PTS_Y 4 UWORD INDEX_INCR DIRECT FNC_VALUES 5 UWORD COLUMN_DIR DIRECT /end RECORD_LAYOUT
/begin RECORD_LAYOUT _REC_MAP_52_UBYTE_u2_u2_u2 NO_AXIS_PTS_X 1 UBYTE NO_AXIS_PTS_Y 2 UBYTE AXIS_PTS_X 3 UWORD INDEX_INCR DIRECT AXIS_PTS_Y 4 UWORD INDEX_INCR DIRECT FNC_VALUES 5 UWORD COLUMN_DIR DIRECT /end RECORD_LAYOUT
/begin RECORD_LAYOUT _REC_MAP_52_u1_s2_s2 NO_AXIS_PTS_X 1 UBYTE NO_AXIS_PTS_Y 2 UBYTE AXIS_PTS_X 3 SWORD INDEX_INCR DIRECT AXIS_PTS_Y 4 SWORD INDEX_INCR DIRECT FNC_VALUES 5 UBYTE COLUMN_DIR DIRECT /end RECORD_LAYOUT
/begin RECORD_LAYOUT _REC_MAP_52_UBYTE_s2_s2_s2 NO_AXIS_PTS_X 1 UBYTE NO_AXIS_PTS_Y 2 UBYTE AXIS_PTS_X 3 SWORD INDEX_INCR DIRECT AXIS_PTS_Y 4 SWORD INDEX_INCR DIRECT FNC_VALUES 5 SWORD COLUMN_DIR DIRECT /end RECORD_LAYOUT
/begin RECORD_LAYOUT _REC_MAP_52_UBYTE_u2_u2_s2 NO_AXIS_PTS_X 1 UBYTE NO_AXIS_PTS_Y 2 UBYTE AXIS_PTS_X 3 UWORD INDEX_INCR DIRECT AXIS_PTS_Y 4 SWORD INDEX_INCR DIRECT FNC_VALUES 5 UWORD COLUMN_DIR DIRECT /end RECORD_LAYOUT
/begin RECORD_LAYOUT _REC_MAP_52_u1_u2_s2 NO_AXIS_PTS_X 1 UBYTE NO_AXIS_PTS_Y 2 UBYTE AXIS_PTS_X 3 UWORD INDEX_INCR DIRECT AXIS_PTS_Y 4 SWORD INDEX_INCR DIRECT FNC_VALUES 5 UBYTE COLUMN_DIR DIRECT /end RECORD_LAYOUT
/begin RECORD_LAYOUT _REC_MAP_52_u1_u1_u1 NO_AXIS_PTS_X 1 UBYTE NO_AXIS_PTS_Y 2 UBYTE AXIS_PTS_X 3 UBYTE INDEX_INCR DIRECT AXIS_PTS_Y 4 UBYTE INDEX_INCR DIRECT FNC_VALUES 5 UBYTE COLUMN_DIR DIRECT /end RECORD_LAYOUT
/begin RECORD_LAYOUT _REC_MAP_52_u1_u1_s2 NO_AXIS_PTS_X 1 UBYTE NO_AXIS_PTS_Y 2 UBYTE AXIS_PTS_X 3 UBYTE INDEX_INCR DIRECT AXIS_PTS_Y 4 SWORD INDEX_INCR DIRECT FNC_VALUES 5 UBYTE COLUMN_DIR DIRECT /end RECORD_LAYOUT
/begin RECORD_LAYOUT _REC_MAP_52_UBYTE_u2_s2_u1 NO_AXIS_PTS_X 1 UBYTE NO_AXIS_PTS_Y 2 UBYTE AXIS_PTS_X 3 SWORD INDEX_INCR DIRECT AXIS_PTS_Y 4 UBYTE INDEX_INCR DIRECT FNC_VALUES 5 UWORD COLUMN_DIR DIRECT /end RECORD_LAYOUT
/begin RECORD_LAYOUT _REC_CUR_TKL_UW_VV__u2_u2 NO_AXIS_PTS_X 1 UBYTE RESERVED 2 BYTE AXIS_PTS_X 3 UWORD INDEX_INCR DIRECT FNC_VALUES 4 UWORD COLUMN_DIR DIRECT /end RECORD_LAYOUT
/begin RECORD_LAYOUT _REC_CUR_TKL_UW_VV__u2_s2 NO_AXIS_PTS_X 1 UBYTE RESERVED 2 BYTE AXIS_PTS_X 3 SWORD INDEX_INCR DIRECT FNC_VALUES 4 UWORD COLUMN_DIR DIRECT /end RECORD_LAYOUT
/begin RECORD_LAYOUT _REC_CUR_TKL_UW_VV__u1_s2 NO_AXIS_PTS_X 1 UBYTE RESERVED 2 BYTE AXIS_PTS_X 3 SWORD INDEX_INCR DIRECT FNC_VALUES 4 UBYTE COLUMN_DIR DIRECT /end RECORD_LAYOUT
/begin RECORD_LAYOUT _REC_CUR_TKL_UW_VV__u1_u2 NO_AXIS_PTS_X 1 UBYTE RESERVED 2 BYTE AXIS_PTS_X 3 UWORD INDEX_INCR DIRECT FNC_VALUES 4 UBYTE COLUMN_DIR DIRECT /end RECORD_LAYOUT
/begin RECORD_LAYOUT _REC_CUR_TKL_UW_VV__s2_u2 NO_AXIS_PTS_X 1 UBYTE RESERVED 2 BYTE AXIS_PTS_X 3 UWORD INDEX_INCR DIRECT FNC_VALUES 4 SWORD COLUMN_DIR DIRECT /end RECORD_LAYOUT
/begin RECORD_LAYOUT _REC_CUR_TKL_UW_VV__s2_s2 NO_AXIS_PTS_X 1 UBYTE RESERVED 2 BYTE AXIS_PTS_X 3 SWORD INDEX_INCR DIRECT FNC_VALUES 4 SWORD COLUMN_DIR DIRECT /end RECORD_LAYOUT
/begin RECORD_LAYOUT _REC_CUR_TKL_UW_VV__u1_u1 NO_AXIS_PTS_X 1 UBYTE RESERVED 2 BYTE AXIS_PTS_X 3 UBYTE INDEX_INCR DIRECT FNC_VALUES 4 UBYTE COLUMN_DIR DIRECT /end RECORD_LAYOUT
/begin RECORD_LAYOUT _REC_CUR_TKL_UW_VV__s2_u1 NO_AXIS_PTS_X 1 UBYTE RESERVED 2 BYTE AXIS_PTS_X 3 UBYTE INDEX_INCR DIRECT FNC_VALUES 4 SWORD COLUMN_DIR DIRECT /end RECORD_LAYOUT
/begin RECORD_LAYOUT _REC_CUR_TKL_UW_VV__S4_S4 NO_AXIS_PTS_X 1 UBYTE RESERVED 2 BYTE AXIS_PTS_X 3 FLOAT32_IEEE INDEX_INCR DIRECT FNC_VALUES 4 FLOAT32_IEEE COLUMN_DIR DIRECT /end RECORD_LAYOUT
/begin RECORD_LAYOUT _REC_CUR_TKL_UW_VV__u2_u1 NO_AXIS_PTS_X 1 UBYTE RESERVED 2 BYTE AXIS_PTS_X 3 UBYTE INDEX_INCR DIRECT FNC_VALUES 4 UWORD COLUMN_DIR DIRECT /end RECORD_LAYOUT
/begin RECORD_LAYOUT _REC_CUR_TKL_UW_VV__s1_s2 NO_AXIS_PTS_X 1 UBYTE RESERVED 2 BYTE AXIS_PTS_X 3 SWORD INDEX_INCR DIRECT FNC_VALUES 4 SBYTE COLUMN_DIR DIRECT /end RECORD_LAYOUT
/begin RECORD_LAYOUT _REC_VAL_20_S4 FNC_VALUES 1 FLOAT32_IEEE COLUMN_DIR DIRECT /end RECORD_LAYOUT
/begin RECORD_LAYOUT _REC_VAL_2_u1 FNC_VALUES 1 UBYTE COLUMN_DIR DIRECT /end RECORD_LAYOUT
/begin FUNCTION EISY_PSREG ""
 /begin DEF_CHARACTERISTIC GAX_5MODELLE KF_AGR_KOR KF_PSREGAGR_I KF_PSREGAGR_P KF_PSREG_I KF_PSREG_P KF_PSR_KOR KL_CAGRAD_AGRPOS KL_CPSAD_N KL_CPSAD_VSA_SPRI KL_CPSAD_VSE_SPRI KL_ETAAGRAD KL_ETAPSAD KL_SAGRAD_AGRPOS KL_SPSAD_N KL_SPSAD_VSA_SPRI KL_SPSAD_VSE_SPRI KL_ZK_PSSMOD K_AGRADGES_MN K_AGRADGES_MX K_AGRADMX K_AGRREGIMN K_AGRREGIMX K_AGRREGINN_MN K_AGRREGINN_MX K_AGRREGMN K_AGRREGMX K_ANZ_AGRADNN K_ANZ_PSADNN K_DPSMN K_DPSMX K_FAGRAD K_LOLIAGRAD_MN K_LOLIAGRAD_MX K_LOLIPSAD_MN K_LOLIPSAD_MX K_NKWPSADNN_RAMP K_NNADQUOT_AGRAD K_NNADQUOT_PSAD K_NPK K_PROUT2MS_F K_PR_MS_FAK K_PR_MS_OFF K_PSADGES_MN K_PSADGES_MX K_PSADMX K_PSPVDK_MN K_PSPVDK_MX K_PSREGIMN K_PSREGIMX K_PSREGINN_MN K_PSREGINN_MX K_PSREGMN K_PSREGMX K_PSRON_MSAGRMN K_PSRON_MSAGRMX K_PSRON_NMN K_PSRON_NMX K_PSRON_TMMN K_TD_PSRON K_TMPSADNN_RAMP K_TNSPSADNN_RAMP K_ZK_AGROFF K_ZK_PSADRAMP K_ZK_PSROFF S_AGRAD_ON S_NPLAGR_RESET S_NPLPSR_RESET S_PREGSOL S_PR_MS_FAK S_PSAD_ON S_PSREGOFF S_PSRVLOFF S_SDF_ABS /end DEF_CHARACTERISTIC
 /begin OUT_MEASUREMENT Agrad Agrreg_diff_in Agrreg_diff_lin Agrreg_i Agrreg_out Agrreg_p Agrreg_pi Agrreg_st Agrreg_tmp Agrregi Agrregp B_nplagr_reset B_nplpsr_reset Dpsr_pk F_agr_kor F_agrad F_psad_ramp F_psr_kor Lolimot_agradaus Lolimot_agradein Lolimot_agradlern Lolimot_psadaus Lolimot_psadein Lolimot_psadlern Mareg_er_agrad Mareg_er_psad Mrnn_test_pr Pr_ms_fak Pr_ms_off Pr_msagr_fak Ps_f Ps_ist Psad Psreg_diff Psreg_diff_in Psreg_diff_lin Psreg_i Psreg_out Psreg_p Psreg_pi Psreg_st Psreg_tmp Psregi Psregms_out Psregp St_eisy_agrreg St_eisy_agrreg.B_agrad_akt St_eisy_agrreg.B_agradges_mn St_eisy_agrreg.B_agradges_mx St_eisy_agrreg.B_agrreg_akt St_eisy_agrreg.B_agrreg_off St_eisy_agrreg.B_agrregi_mn St_eisy_agrreg.B_agrregi_mx St_eisy_psreg St_eisy_psreg.B_pddssmn St_eisy_psreg.B_pddssmx St_eisy_psreg.B_psad_akt St_eisy_psreg.B_psadges_mn St_eisy_psreg.B_psadges_mx St_eisy_psreg.B_psreg_akt St_eisy_psreg.B_psreg_off Z_norm_agrad Z_norm_psad w_agradnn_Agrpos w_agradnn_bias w_psadnn_N w_psadnn_Vsa_spri w_psadnn_Vse_spri w_psadnn_bias /end OUT_MEASUREMENT
/end FUNCTION
/begin FUNCTION EISY_SR ""
 /begin DEF_CHARACTERISTIC KL_SRSTAB_SPUEL KL_VSAUG_GDN KL_VSAUG_GDP KL_VSAUG_UG K_DPS_INTMN K_PSAGR_FGMN K_PSAGR_FGMX K_PSAGR_IGMN K_PSAGR_IGMX K_PSMIN K_ZKLAMFIL S_SRSTAB_PIRG /end DEF_CHARACTERISTIC
 /begin OUT_MEASUREMENT Agr_rate_fg Agr_rate_ig Dps F_dms2dps F_dms2dps_max F_dms2dps_ur F_tans0 Kl_vsaug_aus La_ist_mitt Msagrv_fg Msagrv_ig Msdksr Msdksr_bersr Mssr_diff Mssrzu Mszyl_bersr Ps Ps_alt Ps_diff Ps_int Ps_mx Ps_ok Psagr_fg Psagr_fg_diff Psagr_ig Psagr_ig_diff St_eisysr St_eisysr.B_psintmx /end OUT_MEASUREMENT
/end FUNCTION
/begin FUNCTION EISY_VERD ""
 /begin DEF_CHARACTERISTIC KF_ETA_TURBO KL_DPLF KL_PRAT2FLOW_TURB KL_PRAT2FLOW_VERD KL_ZK_TURBINE K_ETA_M_TURBO K_FU_LST_TURB K_FU_MSVERD K_PKATPAK_MN K_ZK_TURBINE /end DEF_CHARACTERISTIC
 /begin OUT_MEASUREMENT Lst_turb Lst_verd Lst_verd_f Msverd /end OUT_MEASUREMENT
/end FUNCTION
/begin FUNCTION GEN_GRENZ ""
 /begin DEF_CHARACTERISTIC KL_MDZIEL KL_MDZIEL2 KL_MDZIELNKWKORR KL_NABNTEIL K_DMDGEN_FAK K_DMDGEN_OFF K_GENGCALC K_IERRHYSMAX K_IERRHYSMN K_MDGENGGFIL K_NABNSCH K_TDFIERR S_MDGEN_RINF S_MDWAHLGG /end DEF_CHARACTERISTIC
 /begin OUT_MEASUREMENT Dmd_gen_kor Ierrdiff Md_dmm Md_gennmgg Md_gennmnofil Md_grenz_int Md_grenz_res Md_gresziel Md_gresziel2 Md_greszielkorr Md_mgmax St_gengrenz St_gengrenz.B_bnnio St_gengrenz.B_gengcalc St_gengrenz.B_ierrhys Z_ggbn /end OUT_MEASUREMENT
/end FUNCTION
/begin FUNCTION IMDGEN ""
 /begin DEF_CHARACTERISTIC KF_GENTYP_NEU KF_GENWETA4 KF_IERRGREHT KF_IGENDF4 KF_IGENKA4 KF_IGENWA4 KF_IU1T1_1 KF_IU1T1_2 KF_IU1T1_3 KF_IU1T1_4 KF_IU1T1_5 KF_IU1T1_6 KF_IU1T2_1 KF_IU1T2_2 KF_IU1T2_3 KF_IU1T2_4 KF_IU1T2_5 KF_IU1T2_6 KF_IU2T1_1 KF_IU2T1_2 KF_IU2T1_3 KF_IU2T1_4 KF_IU2T1_5 KF_IU2T1_6 KF_MDGENFIL KF_MU1T1_1 KF_MU1T1_2 KF_MU1T1_3 KF_MU1T1_4 KF_MU1T1_5 KF_MU1T1_6 KF_MU1T2_1 KF_MU1T2_2 KF_MU1T2_3 KF_MU1T2_4 KF_MU1T2_5 KF_MU1T2_6 KF_MU2T1_1 KF_MU2T1_2 KF_MU2T1_3 KF_MU2T1_4 KF_MU2T1_5 KF_MU2T1_6 KF_TANSGENKO KF_UFDIODE KL_FPDIODE4 KL_GENEXP4 KL_GENTETA4 KL_NELUEFTGE KL_RTH0FAK4 KL_RTHFAK4 KL_RTHGEN4 KL_RTHJADIOD KL_TANSGEN4 KL_TCHIPOFFS KL_TMAXDIODE KL_T_CHIP1 KL_T_CHIP2 K_DFFGENFIL K_DF_DEAKAPP K_ENGENTANS K_EN_MDGEN K_GENDIFAK4 K_GENITYP K_GENMDNMOF K_GENMXGRADH K_GENRS0_4 K_GENSTFAK4 K_GENTEMPAPP K_GENTEMPMAN K_GENTMOTDT K_GENTMOTOF4 K_GENTYP K_GENTYPFELD K_GENUEBSETZ K_GENUEBSETZ4 K_GENUMGTYP K_GENVFZGSW K_GEN_IGOF K_HTGENDFGRO K_IERRGRAPPL K_IERRHYSMN2 K_IERRHYSMX2 K_IGBASIS K_IGBASISOFF K_IGNOTWERT K_IMDGENNRRW K_I_VERTEIL K_MANAWNUMM K_NGENHTMN1 K_NGENHTMX1 K_NSCHW_CALC K_NSTSTAT1 K_NSTSTAT2 K_NSTSTAT3 K_PRELLGTMOT K_R_LADLTG K_TCHIPFIL K_TDNGENKRIT K_TDTCHIPKRI K_TDTCHIPMX K_TDUBFZMN K_TFIGENHT K_TFTDIODE K_TGENMXGRAD K_TGENMXTHD K_TGENRSHT K_TIGMISCH K_TLCHTEP K_TSTCNTEN K_TSTFIL_IN K_TSTFIL_INI K_UBOFF K_UDIODERMS4 K_UGENHTMN K_ZMGENIG K_ZMGENS0HZ4 K_ZMGENS0KL4 K_ZMGENSTHZ4 K_ZMGENSTKL4 K_ZMGENTWA K_ZMGN0TANS4 K_ZMGNTANS4 K_ZMIGMISCH K_ZMTESTFIL S_HTDETEC S_IERRGRAPPL S_IGMISCH S_RDGENTYP /end DEF_CHARACTERISTIC
 /begin OUT_MEASUREMENT Bszsi Bsztemp Dfdp Dfds Dffgen_dt Dffgen_f Fdib_ig Gen_awnumm Gen_dts Gen_feta Gen_i_kaltun Gen_nummer Gen_rs Gen_spv Gen_sttemp Gen_tans Gen_tansend Gen_teta Gen_weta I_basis I_gen I_gen_end I_gen_g I_gen_nafil I_gen_vorfil I_genipol1 I_genipol2 I_genipol3 I_genmax I_gentmp I_gentp I_gm I_gvor Ierrgrenz Ierrgrenz_ht Ierrgrenz_md Igenk Kf_iu1 Kf_iu2 Kf_iu3 Md_gen_roh Md_genfil Md_gennm Md_gennm_end Md_gennmtp Md_gennmufi Md_genrel Md_genvf Md_grenz_kor N_gen N_gen_tmp Nelueft_gen Nkw_s P_gen_ab P_totdiode St_imdgen0 St_imdgen0.B_firstemp St_imdgen0.B_gene St_imdgen0.B_generken St_imdgen0.B_mod_calc St_imdgen_1s St_imdgen_1s.B_genht St_imdgen_1s.B_genhtkrit St_imdgen_1s.B_genhtkritv St_imdgen_1s.B_genhtmxgra St_imdgen_1s.B_ierrgrenzh St_imdgen_1s.B_tdiodekrit St_imdgen_nv0 St_imdgen_nv0.B_genfkupl St_imdgen_nv0.B_heizen St_imdgen_nv1 St_imdgen_nv1.B_bszsichok T_chipfilsdt T_diode T_diodedelta Tans_gen Tchip_diff1 Tchip_diff2 Tchip_fil_l Tchip_fil_s Tchip_ist Tchip_mwa Tchip_sum Tgen Tgen_ab Tgen_dt Tgen_end Tgen_exp Tgen_fil Tst_countv Tst_fil_out U_vordiode Ugen_calc Z_tchip /end OUT_MEASUREMENT
/end FUNCTION
/begin FUNCTION KRANN ""
 /begin DEF_CHARACTERISTIC GAX_KHMOD GAX_KRMOD KL_CKH_NKW KL_CKH_RK KL_CKH_TANS KL_CKR_BA_IST KL_CKR_NKW KL_CKR_RK KL_CKR_TANS KL_CKR_TMOT KL_ETAKRFR KL_ETAKRSP KL_KFTKRMN KL_KFTKRMX KL_RKMIN_KH KL_RKMIN_KR KL_SKH_NKW KL_SKH_RK KL_SKH_TANS KL_SKR_BA_IST KL_SKR_NKW KL_SKR_RK KL_SKR_TANS KL_SKR_TMOT K_ANZ_ARBSP K_DWKRMNN K_EIN_KHNN K_EIN_KRANN K_ETAKHNEG K_ETAKHNEGHS K_ETAKHPOS K_ETAKHPOSHS K_KHNNMX K_KHNN_F K_KRANNMX K_KRZYKL_AUS K_MOD_KHNN K_MOD_KRANN K_NKRF K_TDSTEND K_TDSTEND_KH K_TMKHNN K_TMKHNNLRN K_TMKRANN K_TMKRANNLRN S_KHNNLERN S_KHNN_EIN S_KHNN_F S_KRANN S_KRANNLERN S_KRANNLL /end DEF_CHARACTERISTIC
 /begin OUT_MEASUREMENT Arbsp_cnt Dzw_annm Dzw_anns Dzw_eps Dzw_krann Dzw_krann_hs Dzw_mm Dzw_nn Kh_sum Khnn Kr_kh Kr_kh_eps Krnn_test St_krann St_krann.B_khnnlern St_krann.B_nnlern St_krann_1000ms St_krann_1000ms.B_kftkr St_krann_seg St_krann_seg.B_krakt_hs St_krann_seg.B_krein St_krann_seg.B_krzykl_verz w_ba_ist w_bias w_kh_bias w_kh_nkw w_kh_rk w_kh_tans w_nkw w_rk w_tans w_tmot /end OUT_MEASUREMENT
/end FUNCTION
/begin FUNCTION KT_IBS ""
 /begin DEF_CHARACTERISTIC K_DI1000DT K_DI1000STG K_DI1000TGRZ K_DI200DT K_DI200STG K_DIHIGHGRZ K_DILOWGRZ K_DIPL5 K_DIPL6 K_DIPL7 K_DIPL8 K_DKL15FIL K_DTMAXGRZI K_DUIGRZ K_DUMINTGRZ K_DUREFMAX K_DUREFMINI K_ENABSDIBS K_ENISOC0 K_ENUSOC0 K_ERREPEAT K_IBSTSTERR K_IBSVERSION K_IBTEMPMAXI K_IBTEMPMINI K_IBUNPLADEL K_ISLEEPGRZ K_ISTARTTRIG K_SLEEPWAIT K_S_CLERRIBS K_T1SCHWELLE K_T1SOC0 K_T2SCHWELLE K_T2SOC0 K_T3SCHWELLE K_T3SOC0 K_TMPCOM_DIV K_TMPCOM_MUL K_TNUSTART K_TNUSTARTFL K_TPT1TICO K_TSLEEPRUH K_T_CLERRIBS K_T_UTIEFSET K_UTIEFAPP /end DEF_CHARACTERISTIC
 /begin OUT_MEASUREMENT Chk16_ibs Chkpara Comcontrol Ebsd_adr Ebsd_errdir Ebsd_errep Ebsd_errin Ebsd_nbyt Ebsd_timo Ebsd_varin Fsclctr I_batt I_soc0 I_tnstart I_vorstart Ib_chk16 Ib_parlen Ibhwversi Ibs_errors Ibs_msgind Ibs_msgsta Ibs_reg5 Ibs_start Ibsbclctri Ibsborctr Ibsdncsctr Ibseromctr Ibsiicctri Ibslvdctr Ibsporctr Ibspromctr Ibsptyctr Ibsramctr Ibswbase Ibswchang Ibswdtctr Kt_ibsstatus Ktib_chk16 Ktupcsctr Qelad Qeladsoc0 Qlad Qladsoc0 R5cyctim Snibs St_ibebsd1 St_ibebsd1.B_eb_busy St_ibebsd1.B_eb_txok St_ibebsd1.B_ibs_msgrdy St_ibebsd1.B_ibs_msgwri St_ibmix St_ibmix.B_ibrhilo St_ibmix.B_ibttog St_ibserr St_ibserr.B_ibfbsd St_ibserr.B_ibfebsd St_ibserr.B_ibunplau St_ibsreg4 St_ibsreg4.B_ibspwf St_ibsreg4.B_startfgk St_ibsreg4.B_strtaw St_ibsreg4.B_tiefset St_ibsreg5 St_ibsreg5.B_fsclr St_sleep St_sleep.B_sleepwait T1histiruh T2histiruh T3histiruh T4histiruh T_batt_ibs T_batt_max T_batt_min T_battsoc0 T_battsoci Tbatt_maxi Tbatt_mini U1soc0 U2soc0 U3soc0 U_batt U_tnstart U_vorstart Unind Zbibs /end OUT_MEASUREMENT
/end FUNCTION
/begin FUNCTION LAMKO ""
 /begin DEF_CHARACTERISTIC CW_KATHEIZRP KF_DLA_GL KF_LABAS_1 KF_LABAS_2 KF_LAHOMBAS KF_LAWUP KF_LAWUP_LL KL_DLA_GLTM KL_ETA_LAMBDA KL_LABASKOR KL_LA_VL1 KL_LA_VL2 KL_ZK_ETALAMZW K_DLA_PULS K_ETAGES_MN K_ETAGES_MX K_LAMHOMMAN1 K_LAMHOMMAN2 K_MA_LAMKO S_DESU_FETT S_DESU_PULS S_ETALAM_IST S_LAMHOMMAN S_LS_TREU /end DEF_CHARACTERISTIC
 /begin OUT_MEASUREMENT Dla_soll_puls Eta_ges_f Eta_labas Eta_labas_sol Eta_laber_h Eta_laber_h1 Eta_laber_h2 Eta_lamb_bas Eta_lamb_bas1 Eta_lamb_bas2 Eta_lamb_ist Eta_lamb_ist1 Eta_lamb_ist2 Eta_lambda Eta_lambda_1 Eta_lambda_2 Eta_ls_ist Eta_ls_ist1 Eta_ls_ist2 La_abgas1 La_abgas2 La_bas1 La_bas2 La_ber_h La_ber_h1 La_ber_h2 La_hom1 La_hom2 La_hom_vst1 La_hom_vst2 La_ref_homm La_soll La_soll1 La_soll2 La_soll_h1 La_soll_h2 La_soll_ko1 La_soll_ko2 La_wup La_wupkor St_lamko St_lamko.B_laprio_ko St_lamko.B_ls_treu Zk_eta /end OUT_MEASUREMENT
/end FUNCTION
/end MODULE
/end PROJECT
