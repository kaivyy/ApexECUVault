ASAP2_VERSION 1 41
/begin PROJECT MSD85 "Spray Guided DI-System with Piezo Injectors for 8-Cylinder"
/begin HEADER "_default_HeaderComment" PROJECT_NO _91 /end HEADER
/begin MODULE _default_ModuleName "_default_ModuleLongIdentifier"
/begin MOD_COMMON "_default_ModCommonComment" DEPOSIT ABSOLUTE BYTE_ORDER MSB_LAST ALIGNMENT_BYTE 1 ALIGNMENT_WORD 2 ALIGNMENT_LONG 2 ALIGNMENT_FLOAT32_IEEE 2 ALIGNMENT_FLOAT64_IEEE 4 /end MOD_COMMON
/begin CHARACTERISTIC lc_abc_bench "logical constant to manage the anti-bounce bench mode" VALUE 0xa0804edc _REC_VAL_20_u1 1. _CNV_A_R_LINEAR_____0_CM 0. 1. DISPLAY_IDENTIFIER LC_ABC_BENCH FORMAT "%1.0" /end CHARACTERISTIC
/begin CHARACTERISTIC lc_err_det_upd "Logical constant to manage the visualisation of the sporadic error" VALUE 0xa0804edd _REC_VAL_20_u1 1. _CNV_A_R_LINEAR_____0_CM 0. 1. DISPLAY_IDENTIFIER LC_ERR_DET_UPD FORMAT "%1.0" /end CHARACTERISTIC
/begin MEASUREMENT ctr_err_intm_nr "Number of failures stored in intermittent failures array" UBYTE _CNV_A_R_LINEAR_____0_CM 1 100. 0. 255. DISPLAY_IDENTIFIER CTR_ERR_INTM_NR ECU_ADDRESS 0xd000758c FORMAT "%3.0" /end MEASUREMENT
/begin MEASUREMENT lv_abc_inh "Anti-Bounce filtering inhibition" UBYTE _CNV_S_2_RANGE__0___1_CM 1 100. 0. 1. DISPLAY_IDENTIFIER LV_ABC_INH ECU_ADDRESS 0xd0008140 BIT_MASK 0x1 /end MEASUREMENT
/begin MEASUREMENT err_intm_ctr_frc[0] "Frequency of reappearence of failure stored in ERR_INTM_DIAG_INST[NC_NR_ERR_INTM]" UBYTE _CNV_A_R_LINEAR_____0_CM 1 100. 0. 255. DISPLAY_IDENTIFIER ERR_INTM_CTR_FRC[0] ECU_ADDRESS 0xd000758d FORMAT "%3.0" /end MEASUREMENT
/begin MEASUREMENT err_intm_diag_inst[0] "Array of diagnosis instances with intermittent failure" UWORD _CNV_S_471_ERRM_RANGE_474_CM 1 100. 0. 470. DISPLAY_IDENTIFIER ERR_INTM_DIAG_INST[0] ECU_ADDRESS 0xd0006750 /end MEASUREMENT
/begin CHARACTERISTIC c_state_ready_obd_1 "Status configuration for readiness code (continuous tests)" VALUE 0xa0804ec5 _REC_VAL_20_u1 255. _CNV_A_R_LINEAR_____0_CM 0. 255. DISPLAY_IDENTIFIER C_STATE_READY_OBD_1 FORMAT "%3.0" /end CHARACTERISTIC
/begin CHARACTERISTIC c_state_ready_obd_2 "Status configuration for readiness code (non continuous tests)" VALUE 0xa0804ec6 _REC_VAL_20_u1 255. _CNV_A_R_LINEAR_____0_CM 0. 255. DISPLAY_IDENTIFIER C_STATE_READY_OBD_2 FORMAT "%3.0" /end CHARACTERISTIC
/begin CHARACTERISTIC c_state_ready_obd_3 "Status configuration for readiness code (customer specific)" VALUE 0xa0804ec7 _REC_VAL_20_u1 255. _CNV_A_R_LINEAR_____0_CM 0. 255. DISPLAY_IDENTIFIER C_STATE_READY_OBD_3 FORMAT "%3.0" /end CHARACTERISTIC
/begin CHARACTERISTIC c_state_ready_cmpl_obd_1 "Readiness MIS, FSD, CC directly set to ready" VALUE 0xa0804ec4 _REC_VAL_20_u1 255. _CNV_A_R_LINEAR_____0_CM 0. 255. DISPLAY_IDENTIFIER C_STATE_READY_CMPL_OBD_1 FORMAT "%3.0" /end CHARACTERISTIC
/begin MEASUREMENT lv_dc "driving cycle status flag" UBYTE _CNV_S_2_RANGE__0___1_CM 1 100. 0. 1. DISPLAY_IDENTIFIER LV_DC ECU_ADDRESS 0xd0008141 BIT_MASK 0x1 /end MEASUREMENT
/begin MEASUREMENT lv_wup_cyc "warm-up cycle status flag" UBYTE _CNV_S_2_RANGE__0___1_CM 1 100. 0. 1. DISPLAY_IDENTIFIER LV_WUP_CYC ECU_ADDRESS 0xd000814e BIT_MASK 0x1 /end MEASUREMENT
/begin MEASUREMENT lv_state_wup "tco state for exceeding the warm-up cycle tco threshold" UBYTE _CNV_S_2_RANGE__0___1_CM 1 100. 0. 1. DISPLAY_IDENTIFIER LV_STATE_WUP ECU_ADDRESS 0xd0008148 BIT_MASK 0x1 /end MEASUREMENT
/begin CHARACTERISTIC c_tco_wup_thd "minimum vlaue for warm-up cycle detection." VALUE 0xa0804ed9 _REC_VAL_20_u1 190.5 _CNV_A_R_LINEAR_____17_CM -48. 142.5 DISPLAY_IDENTIFIER C_TCO_WUP_THD FORMAT "%6.2" /end CHARACTERISTIC
/begin CHARACTERISTIC c_tco_wup_inc "minimum increase of the coolant temperature for warm-up cycle detection." VALUE 0xa0804ed8 _REC_VAL_20_u1 190.5 _CNV_A_R_LINEAR_____17_CM -48. 142.5 DISPLAY_IDENTIFIER C_TCO_WUP_INC FORMAT "%6.2" /end CHARACTERISTIC
/begin CHARACTERISTIC lc_err_fmy_his_clr "Set this calibration to 1 for clearing the history memory" VALUE 0xa0804edf _REC_VAL_20_u1 1. _CNV_A_R_LINEAR_____0_CM 0. 1. DISPLAY_IDENTIFIER LC_ERR_FMY_HIS_CLR FORMAT "%1.0" /end CHARACTERISTIC
/begin MEASUREMENT ctr_err_his_nr "Number of failures stored in the history memory" UBYTE _CNV_A_R_LINEAR_____0_CM 1 100. 0. 255. DISPLAY_IDENTIFIER CTR_ERR_HIS_NR ECU_ADDRESS 0xd00080cd FORMAT "%3.0" /end MEASUREMENT
/begin MEASUREMENT err_his_dtc[0] "DTC of failure in history memory" UWORD _CNV_A_R_LINEAR_____0_CM 1 100. 0. 65535. DISPLAY_IDENTIFIER ERR_HIS_DTC[1] ECU_ADDRESS 0xd0009fe4 FORMAT "%5.0" /end MEASUREMENT
/begin MEASUREMENT err_his_dtc[1] "DTC of failure in history memory" UWORD _CNV_A_R_LINEAR_____0_CM 1 100. 0. 65535. DISPLAY_IDENTIFIER ERR_HIS_DTC[2] ECU_ADDRESS 0xd0009fe6 FORMAT "%5.0" /end MEASUREMENT
/begin MEASUREMENT err_his_dtc[2] "DTC of failure in history memory" UWORD _CNV_A_R_LINEAR_____0_CM 1 100. 0. 65535. DISPLAY_IDENTIFIER ERR_HIS_DTC[3] ECU_ADDRESS 0xd0009fe8 FORMAT "%5.0" /end MEASUREMENT
/begin MEASUREMENT err_his_dtc[3] "DTC of failure in history memory" UWORD _CNV_A_R_LINEAR_____0_CM 1 100. 0. 65535. DISPLAY_IDENTIFIER ERR_HIS_DTC[4] ECU_ADDRESS 0xd0009fea FORMAT "%5.0" /end MEASUREMENT
/begin MEASUREMENT err_his_dtc[4] "DTC of failure in history memory" UWORD _CNV_A_R_LINEAR_____0_CM 1 100. 0. 65535. DISPLAY_IDENTIFIER ERR_HIS_DTC[5] ECU_ADDRESS 0xd0009fec FORMAT "%5.0" /end MEASUREMENT
/begin MEASUREMENT err_his_dtc[5] "DTC of failure in history memory" UWORD _CNV_A_R_LINEAR_____0_CM 1 100. 0. 65535. DISPLAY_IDENTIFIER ERR_HIS_DTC[6] ECU_ADDRESS 0xd0009fee FORMAT "%5.0" /end MEASUREMENT
/begin MEASUREMENT err_his_dtc[6] "DTC of failure in history memory" UWORD _CNV_A_R_LINEAR_____0_CM 1 100. 0. 65535. DISPLAY_IDENTIFIER ERR_HIS_DTC[7] ECU_ADDRESS 0xd0009ff0 FORMAT "%5.0" /end MEASUREMENT
/begin MEASUREMENT err_his_dtc[7] "DTC of failure in history memory" UWORD _CNV_A_R_LINEAR_____0_CM 1 100. 0. 65535. DISPLAY_IDENTIFIER ERR_HIS_DTC[8] ECU_ADDRESS 0xd0009ff2 FORMAT "%5.0" /end MEASUREMENT
/begin MEASUREMENT err_his_dtc[8] "DTC of failure in history memory" UWORD _CNV_A_R_LINEAR_____0_CM 1 100. 0. 65535. DISPLAY_IDENTIFIER ERR_HIS_DTC[9] ECU_ADDRESS 0xd0009ff4 FORMAT "%5.0" /end MEASUREMENT
/begin MEASUREMENT err_his_dtc[9] "DTC of failure in history memory" UWORD _CNV_A_R_LINEAR_____0_CM 1 100. 0. 65535. DISPLAY_IDENTIFIER ERR_HIS_DTC[10] ECU_ADDRESS 0xd0009ff6 FORMAT "%5.0" /end MEASUREMENT
/begin MEASUREMENT err_his[0][0] "Others data in history memory" UBYTE _CNV_A_R_LINEAR_____0_CM 1 100. 0. 255. DISPLAY_IDENTIFIER ERR_HIS[1][1] ECU_ADDRESS 0xd00080d0 FORMAT "%3.0" /end MEASUREMENT
/begin MEASUREMENT err_his[0][1] "Others data in history memory" UBYTE _CNV_A_R_LINEAR_____0_CM 1 100. 0. 255. DISPLAY_IDENTIFIER ERR_HIS[1][2] ECU_ADDRESS 0xd00080d1 FORMAT "%3.0" /end MEASUREMENT
/begin MEASUREMENT err_his[0][2] "Others data in history memory" UBYTE _CNV_A_R_LINEAR_____0_CM 1 100. 0. 255. DISPLAY_IDENTIFIER ERR_HIS[1][3] ECU_ADDRESS 0xd00080d2 FORMAT "%3.0" /end MEASUREMENT
/begin MEASUREMENT err_his[0][3] "Others data in history memory" UBYTE _CNV_A_R_LINEAR_____0_CM 1 100. 0. 255. DISPLAY_IDENTIFIER ERR_HIS[1][4] ECU_ADDRESS 0xd00080d3 FORMAT "%3.0" /end MEASUREMENT
/begin MEASUREMENT err_his[0][4] "Others data in history memory" UBYTE _CNV_A_R_LINEAR_____0_CM 1 100. 0. 255. DISPLAY_IDENTIFIER ERR_HIS[1][5] ECU_ADDRESS 0xd00080d4 FORMAT "%3.0" /end MEASUREMENT
/begin MEASUREMENT err_his[0][5] "Others data in history memory" UBYTE _CNV_A_R_LINEAR_____0_CM 1 100. 0. 255. DISPLAY_IDENTIFIER ERR_HIS[1][6] ECU_ADDRESS 0xd00080d5 FORMAT "%3.0" /end MEASUREMENT
/begin MEASUREMENT err_his[0][6] "Others data in history memory" UBYTE _CNV_A_R_LINEAR_____0_CM 1 100. 0. 255. DISPLAY_IDENTIFIER ERR_HIS[1][7] ECU_ADDRESS 0xd00080d6 FORMAT "%3.0" /end MEASUREMENT
/begin MEASUREMENT err_his[0][7] "Others data in history memory" UBYTE _CNV_A_R_LINEAR_____0_CM 1 100. 0. 255. DISPLAY_IDENTIFIER ERR_HIS[1][8] ECU_ADDRESS 0xd00080d7 FORMAT "%3.0" /end MEASUREMENT
/begin MEASUREMENT err_his[0][8] "Others data in history memory" UBYTE _CNV_A_R_LINEAR_____0_CM 1 100. 0. 255. DISPLAY_IDENTIFIER ERR_HIS[1][9] ECU_ADDRESS 0xd00080d8 FORMAT "%3.0" /end MEASUREMENT
/begin MEASUREMENT err_his[1][0] "Others data in history memory" UBYTE _CNV_A_R_LINEAR_____0_CM 1 100. 0. 255. DISPLAY_IDENTIFIER ERR_HIS[2][1] ECU_ADDRESS 0xd00080d9 FORMAT "%3.0" /end MEASUREMENT
/begin MEASUREMENT err_his[1][1] "Others data in history memory" UBYTE _CNV_A_R_LINEAR_____0_CM 1 100. 0. 255. DISPLAY_IDENTIFIER ERR_HIS[2][2] ECU_ADDRESS 0xd00080da FORMAT "%3.0" /end MEASUREMENT
/begin MEASUREMENT err_his[1][2] "Others data in history memory" UBYTE _CNV_A_R_LINEAR_____0_CM 1 100. 0. 255. DISPLAY_IDENTIFIER ERR_HIS[2][3] ECU_ADDRESS 0xd00080db FORMAT "%3.0" /end MEASUREMENT
/begin MEASUREMENT err_his[1][3] "Others data in history memory" UBYTE _CNV_A_R_LINEAR_____0_CM 1 100. 0. 255. DISPLAY_IDENTIFIER ERR_HIS[2][4] ECU_ADDRESS 0xd00080dc FORMAT "%3.0" /end MEASUREMENT
/begin MEASUREMENT err_his[1][4] "Others data in history memory" UBYTE _CNV_A_R_LINEAR_____0_CM 1 100. 0. 255. DISPLAY_IDENTIFIER ERR_HIS[2][5] ECU_ADDRESS 0xd00080dd FORMAT "%3.0" /end MEASUREMENT
/begin MEASUREMENT err_his[1][5] "Others data in history memory" UBYTE _CNV_A_R_LINEAR_____0_CM 1 100. 0. 255. DISPLAY_IDENTIFIER ERR_HIS[2][6] ECU_ADDRESS 0xd00080de FORMAT "%3.0" /end MEASUREMENT
/begin MEASUREMENT err_his[1][6] "Others data in history memory" UBYTE _CNV_A_R_LINEAR_____0_CM 1 100. 0. 255. DISPLAY_IDENTIFIER ERR_HIS[2][7] ECU_ADDRESS 0xd00080df FORMAT "%3.0" /end MEASUREMENT
/begin MEASUREMENT err_his[1][7] "Others data in history memory" UBYTE _CNV_A_R_LINEAR_____0_CM 1 100. 0. 255. DISPLAY_IDENTIFIER ERR_HIS[2][8] ECU_ADDRESS 0xd00080e0 FORMAT "%3.0" /end MEASUREMENT
/begin MEASUREMENT err_his[1][8] "Others data in history memory" UBYTE _CNV_A_R_LINEAR_____0_CM 1 100. 0. 255. DISPLAY_IDENTIFIER ERR_HIS[2][9] ECU_ADDRESS 0xd00080e1 FORMAT "%3.0" /end MEASUREMENT
/begin MEASUREMENT err_his[2][0] "Others data in history memory" UBYTE _CNV_A_R_LINEAR_____0_CM 1 100. 0. 255. DISPLAY_IDENTIFIER ERR_HIS[3][1] ECU_ADDRESS 0xd00080e2 FORMAT "%3.0" /end MEASUREMENT
/begin MEASUREMENT err_his[2][1] "Others data in history memory" UBYTE _CNV_A_R_LINEAR_____0_CM 1 100. 0. 255. DISPLAY_IDENTIFIER ERR_HIS[3][2] ECU_ADDRESS 0xd00080e3 FORMAT "%3.0" /end MEASUREMENT
/begin MEASUREMENT err_his[2][2] "Others data in history memory" UBYTE _CNV_A_R_LINEAR_____0_CM 1 100. 0. 255. DISPLAY_IDENTIFIER ERR_HIS[3][3] ECU_ADDRESS 0xd00080e4 FORMAT "%3.0" /end MEASUREMENT
/begin MEASUREMENT err_his[2][3] "Others data in history memory" UBYTE _CNV_A_R_LINEAR_____0_CM 1 100. 0. 255. DISPLAY_IDENTIFIER ERR_HIS[3][4] ECU_ADDRESS 0xd00080e5 FORMAT "%3.0" /end MEASUREMENT
/begin MEASUREMENT err_his[2][4] "Others data in history memory" UBYTE _CNV_A_R_LINEAR_____0_CM 1 100. 0. 255. DISPLAY_IDENTIFIER ERR_HIS[3][5] ECU_ADDRESS 0xd00080e6 FORMAT "%3.0" /end MEASUREMENT
/begin MEASUREMENT err_his[2][5] "Others data in history memory" UBYTE _CNV_A_R_LINEAR_____0_CM 1 100. 0. 255. DISPLAY_IDENTIFIER ERR_HIS[3][6] ECU_ADDRESS 0xd00080e7 FORMAT "%3.0" /end MEASUREMENT
/begin MEASUREMENT err_his[2][6] "Others data in history memory" UBYTE _CNV_A_R_LINEAR_____0_CM 1 100. 0. 255. DISPLAY_IDENTIFIER ERR_HIS[3][7] ECU_ADDRESS 0xd00080e8 FORMAT "%3.0" /end MEASUREMENT
/begin MEASUREMENT err_his[2][7] "Others data in history memory" UBYTE _CNV_A_R_LINEAR_____0_CM 1 100. 0. 255. DISPLAY_IDENTIFIER ERR_HIS[3][8] ECU_ADDRESS 0xd00080e9 FORMAT "%3.0" /end MEASUREMENT
/begin MEASUREMENT err_his[2][8] "Others data in history memory" UBYTE _CNV_A_R_LINEAR_____0_CM 1 100. 0. 255. DISPLAY_IDENTIFIER ERR_HIS[3][9] ECU_ADDRESS 0xd00080ea FORMAT "%3.0" /end MEASUREMENT
/begin MEASUREMENT err_his[3][0] "Others data in history memory" UBYTE _CNV_A_R_LINEAR_____0_CM 1 100. 0. 255. DISPLAY_IDENTIFIER ERR_HIS[4][1] ECU_ADDRESS 0xd00080eb FORMAT "%3.0" /end MEASUREMENT
/begin MEASUREMENT err_his[3][1] "Others data in history memory" UBYTE _CNV_A_R_LINEAR_____0_CM 1 100. 0. 255. DISPLAY_IDENTIFIER ERR_HIS[4][2] ECU_ADDRESS 0xd00080ec FORMAT "%3.0" /end MEASUREMENT
/begin MEASUREMENT err_his[3][2] "Others data in history memory" UBYTE _CNV_A_R_LINEAR_____0_CM 1 100. 0. 255. DISPLAY_IDENTIFIER ERR_HIS[4][3] ECU_ADDRESS 0xd00080ed FORMAT "%3.0" /end MEASUREMENT
/begin MEASUREMENT err_his[3][3] "Others data in history memory" UBYTE _CNV_A_R_LINEAR_____0_CM 1 100. 0. 255. DISPLAY_IDENTIFIER ERR_HIS[4][4] ECU_ADDRESS 0xd00080ee FORMAT "%3.0" /end MEASUREMENT
/begin MEASUREMENT err_his[3][4] "Others data in history memory" UBYTE _CNV_A_R_LINEAR_____0_CM 1 100. 0. 255. DISPLAY_IDENTIFIER ERR_HIS[4][5] ECU_ADDRESS 0xd00080ef FORMAT "%3.0" /end MEASUREMENT
/begin MEASUREMENT err_his[3][5] "Others data in history memory" UBYTE _CNV_A_R_LINEAR_____0_CM 1 100. 0. 255. DISPLAY_IDENTIFIER ERR_HIS[4][6] ECU_ADDRESS 0xd00080f0 FORMAT "%3.0" /end MEASUREMENT
/begin MEASUREMENT err_his[3][6] "Others data in history memory" UBYTE _CNV_A_R_LINEAR_____0_CM 1 100. 0. 255. DISPLAY_IDENTIFIER ERR_HIS[4][7] ECU_ADDRESS 0xd00080f1 FORMAT "%3.0" /end MEASUREMENT
/begin MEASUREMENT err_his[3][7] "Others data in history memory" UBYTE _CNV_A_R_LINEAR_____0_CM 1 100. 0. 255. DISPLAY_IDENTIFIER ERR_HIS[4][8] ECU_ADDRESS 0xd00080f2 FORMAT "%3.0" /end MEASUREMENT
/begin MEASUREMENT err_his[3][8] "Others data in history memory" UBYTE _CNV_A_R_LINEAR_____0_CM 1 100. 0. 255. DISPLAY_IDENTIFIER ERR_HIS[4][9] ECU_ADDRESS 0xd00080f3 FORMAT "%3.0" /end MEASUREMENT
/begin MEASUREMENT err_his[4][0] "Others data in history memory" UBYTE _CNV_A_R_LINEAR_____0_CM 1 100. 0. 255. DISPLAY_IDENTIFIER ERR_HIS[5][1] ECU_ADDRESS 0xd00080f4 FORMAT "%3.0" /end MEASUREMENT
/begin MEASUREMENT err_his[4][1] "Others data in history memory" UBYTE _CNV_A_R_LINEAR_____0_CM 1 100. 0. 255. DISPLAY_IDENTIFIER ERR_HIS[5][2] ECU_ADDRESS 0xd00080f5 FORMAT "%3.0" /end MEASUREMENT
/begin MEASUREMENT err_his[4][2] "Others data in history memory" UBYTE _CNV_A_R_LINEAR_____0_CM 1 100. 0. 255. DISPLAY_IDENTIFIER ERR_HIS[5][3] ECU_ADDRESS 0xd00080f6 FORMAT "%3.0" /end MEASUREMENT
/begin MEASUREMENT err_his[4][3] "Others data in history memory" UBYTE _CNV_A_R_LINEAR_____0_CM 1 100. 0. 255. DISPLAY_IDENTIFIER ERR_HIS[5][4] ECU_ADDRESS 0xd00080f7 FORMAT "%3.0" /end MEASUREMENT
/begin MEASUREMENT err_his[4][4] "Others data in history memory" UBYTE _CNV_A_R_LINEAR_____0_CM 1 100. 0. 255. DISPLAY_IDENTIFIER ERR_HIS[5][5] ECU_ADDRESS 0xd00080f8 FORMAT "%3.0" /end MEASUREMENT
/begin MEASUREMENT err_his[4][5] "Others data in history memory" UBYTE _CNV_A_R_LINEAR_____0_CM 1 100. 0. 255. DISPLAY_IDENTIFIER ERR_HIS[5][6] ECU_ADDRESS 0xd00080f9 FORMAT "%3.0" /end MEASUREMENT
/begin MEASUREMENT err_his[4][6] "Others data in history memory" UBYTE _CNV_A_R_LINEAR_____0_CM 1 100. 0. 255. DISPLAY_IDENTIFIER ERR_HIS[5][7] ECU_ADDRESS 0xd00080fa FORMAT "%3.0" /end MEASUREMENT
/begin MEASUREMENT err_his[4][7] "Others data in history memory" UBYTE _CNV_A_R_LINEAR_____0_CM 1 100. 0. 255. DISPLAY_IDENTIFIER ERR_HIS[5][8] ECU_ADDRESS 0xd00080fb FORMAT "%3.0" /end MEASUREMENT
/begin MEASUREMENT err_his[4][8] "Others data in history memory" UBYTE _CNV_A_R_LINEAR_____0_CM 1 100. 0. 255. DISPLAY_IDENTIFIER ERR_HIS[5][9] ECU_ADDRESS 0xd00080fc FORMAT "%3.0" /end MEASUREMENT
/begin MEASUREMENT err_his[5][0] "Others data in history memory" UBYTE _CNV_A_R_LINEAR_____0_CM 1 100. 0. 255. DISPLAY_IDENTIFIER ERR_HIS[6][1] ECU_ADDRESS 0xd00080fd FORMAT "%3.0" /end MEASUREMENT
/begin MEASUREMENT err_his[5][1] "Others data in history memory" UBYTE _CNV_A_R_LINEAR_____0_CM 1 100. 0. 255. DISPLAY_IDENTIFIER ERR_HIS[6][2] ECU_ADDRESS 0xd00080fe FORMAT "%3.0" /end MEASUREMENT
/begin MEASUREMENT err_his[5][2] "Others data in history memory" UBYTE _CNV_A_R_LINEAR_____0_CM 1 100. 0. 255. DISPLAY_IDENTIFIER ERR_HIS[6][3] ECU_ADDRESS 0xd00080ff FORMAT "%3.0" /end MEASUREMENT
/begin MEASUREMENT err_his[5][3] "Others data in history memory" UBYTE _CNV_A_R_LINEAR_____0_CM 1 100. 0. 255. DISPLAY_IDENTIFIER ERR_HIS[6][4] ECU_ADDRESS 0xd0008100 FORMAT "%3.0" /end MEASUREMENT
/begin MEASUREMENT err_his[5][4] "Others data in history memory" UBYTE _CNV_A_R_LINEAR_____0_CM 1 100. 0. 255. DISPLAY_IDENTIFIER ERR_HIS[6][5] ECU_ADDRESS 0xd0008101 FORMAT "%3.0" /end MEASUREMENT
/begin MEASUREMENT err_his[5][5] "Others data in history memory" UBYTE _CNV_A_R_LINEAR_____0_CM 1 100. 0. 255. DISPLAY_IDENTIFIER ERR_HIS[6][6] ECU_ADDRESS 0xd0008102 FORMAT "%3.0" /end MEASUREMENT
/begin MEASUREMENT err_his[5][6] "Others data in history memory" UBYTE _CNV_A_R_LINEAR_____0_CM 1 100. 0. 255. DISPLAY_IDENTIFIER ERR_HIS[6][7] ECU_ADDRESS 0xd0008103 FORMAT "%3.0" /end MEASUREMENT
/begin MEASUREMENT err_his[5][7] "Others data in history memory" UBYTE _CNV_A_R_LINEAR_____0_CM 1 100. 0. 255. DISPLAY_IDENTIFIER ERR_HIS[6][8] ECU_ADDRESS 0xd0008104 FORMAT "%3.0" /end MEASUREMENT
/begin MEASUREMENT err_his[5][8] "Others data in history memory" UBYTE _CNV_A_R_LINEAR_____0_CM 1 100. 0. 255. DISPLAY_IDENTIFIER ERR_HIS[6][9] ECU_ADDRESS 0xd0008105 FORMAT "%3.0" /end MEASUREMENT
/begin MEASUREMENT err_his[6][0] "Others data in history memory" UBYTE _CNV_A_R_LINEAR_____0_CM 1 100. 0. 255. DISPLAY_IDENTIFIER ERR_HIS[7][1] ECU_ADDRESS 0xd0008106 FORMAT "%3.0" /end MEASUREMENT
/begin MEASUREMENT err_his[6][1] "Others data in history memory" UBYTE _CNV_A_R_LINEAR_____0_CM 1 100. 0. 255. DISPLAY_IDENTIFIER ERR_HIS[7][2] ECU_ADDRESS 0xd0008107 FORMAT "%3.0" /end MEASUREMENT
/begin MEASUREMENT err_his[6][2] "Others data in history memory" UBYTE _CNV_A_R_LINEAR_____0_CM 1 100. 0. 255. DISPLAY_IDENTIFIER ERR_HIS[7][3] ECU_ADDRESS 0xd0008108 FORMAT "%3.0" /end MEASUREMENT
/begin MEASUREMENT err_his[6][3] "Others data in history memory" UBYTE _CNV_A_R_LINEAR_____0_CM 1 100. 0. 255. DISPLAY_IDENTIFIER ERR_HIS[7][4] ECU_ADDRESS 0xd0008109 FORMAT "%3.0" /end MEASUREMENT
/begin MEASUREMENT err_his[6][4] "Others data in history memory" UBYTE _CNV_A_R_LINEAR_____0_CM 1 100. 0. 255. DISPLAY_IDENTIFIER ERR_HIS[7][5] ECU_ADDRESS 0xd000810a FORMAT "%3.0" /end MEASUREMENT
/begin MEASUREMENT err_his[6][5] "Others data in history memory" UBYTE _CNV_A_R_LINEAR_____0_CM 1 100. 0. 255. DISPLAY_IDENTIFIER ERR_HIS[7][6] ECU_ADDRESS 0xd000810b FORMAT "%3.0" /end MEASUREMENT
/begin MEASUREMENT err_his[6][6] "Others data in history memory" UBYTE _CNV_A_R_LINEAR_____0_CM 1 100. 0. 255. DISPLAY_IDENTIFIER ERR_HIS[7][7] ECU_ADDRESS 0xd000810c FORMAT "%3.0" /end MEASUREMENT
/begin MEASUREMENT err_his[6][7] "Others data in history memory" UBYTE _CNV_A_R_LINEAR_____0_CM 1 100. 0. 255. DISPLAY_IDENTIFIER ERR_HIS[7][8] ECU_ADDRESS 0xd000810d FORMAT "%3.0" /end MEASUREMENT
/begin MEASUREMENT err_his[6][8] "Others data in history memory" UBYTE _CNV_A_R_LINEAR_____0_CM 1 100. 0. 255. DISPLAY_IDENTIFIER ERR_HIS[7][9] ECU_ADDRESS 0xd000810e FORMAT "%3.0" /end MEASUREMENT
/begin MEASUREMENT err_his[7][0] "Others data in history memory" UBYTE _CNV_A_R_LINEAR_____0_CM 1 100. 0. 255. DISPLAY_IDENTIFIER ERR_HIS[8][1] ECU_ADDRESS 0xd000810f FORMAT "%3.0" /end MEASUREMENT
/begin MEASUREMENT err_his[7][1] "Others data in history memory" UBYTE _CNV_A_R_LINEAR_____0_CM 1 100. 0. 255. DISPLAY_IDENTIFIER ERR_HIS[8][2] ECU_ADDRESS 0xd0008110 FORMAT "%3.0" /end MEASUREMENT
/begin MEASUREMENT err_his[7][2] "Others data in history memory" UBYTE _CNV_A_R_LINEAR_____0_CM 1 100. 0. 255. DISPLAY_IDENTIFIER ERR_HIS[8][3] ECU_ADDRESS 0xd0008111 FORMAT "%3.0" /end MEASUREMENT
/begin MEASUREMENT err_his[7][3] "Others data in history memory" UBYTE _CNV_A_R_LINEAR_____0_CM 1 100. 0. 255. DISPLAY_IDENTIFIER ERR_HIS[8][4] ECU_ADDRESS 0xd0008112 FORMAT "%3.0" /end MEASUREMENT
/begin MEASUREMENT err_his[7][4] "Others data in history memory" UBYTE _CNV_A_R_LINEAR_____0_CM 1 100. 0. 255. DISPLAY_IDENTIFIER ERR_HIS[8][5] ECU_ADDRESS 0xd0008113 FORMAT "%3.0" /end MEASUREMENT
/begin MEASUREMENT err_his[7][5] "Others data in history memory" UBYTE _CNV_A_R_LINEAR_____0_CM 1 100. 0. 255. DISPLAY_IDENTIFIER ERR_HIS[8][6] ECU_ADDRESS 0xd0008114 FORMAT "%3.0" /end MEASUREMENT
/begin MEASUREMENT err_his[7][6] "Others data in history memory" UBYTE _CNV_A_R_LINEAR_____0_CM 1 100. 0. 255. DISPLAY_IDENTIFIER ERR_HIS[8][7] ECU_ADDRESS 0xd0008115 FORMAT "%3.0" /end MEASUREMENT
/begin MEASUREMENT err_his[7][7] "Others data in history memory" UBYTE _CNV_A_R_LINEAR_____0_CM 1 100. 0. 255. DISPLAY_IDENTIFIER ERR_HIS[8][8] ECU_ADDRESS 0xd0008116 FORMAT "%3.0" /end MEASUREMENT
/begin MEASUREMENT err_his[7][8] "Others data in history memory" UBYTE _CNV_A_R_LINEAR_____0_CM 1 100. 0. 255. DISPLAY_IDENTIFIER ERR_HIS[8][9] ECU_ADDRESS 0xd0008117 FORMAT "%3.0" /end MEASUREMENT
/begin MEASUREMENT err_his[8][0] "Others data in history memory" UBYTE _CNV_A_R_LINEAR_____0_CM 1 100. 0. 255. DISPLAY_IDENTIFIER ERR_HIS[9][1] ECU_ADDRESS 0xd0008118 FORMAT "%3.0" /end MEASUREMENT
/begin MEASUREMENT err_his[8][1] "Others data in history memory" UBYTE _CNV_A_R_LINEAR_____0_CM 1 100. 0. 255. DISPLAY_IDENTIFIER ERR_HIS[9][2] ECU_ADDRESS 0xd0008119 FORMAT "%3.0" /end MEASUREMENT
/begin MEASUREMENT err_his[8][2] "Others data in history memory" UBYTE _CNV_A_R_LINEAR_____0_CM 1 100. 0. 255. DISPLAY_IDENTIFIER ERR_HIS[9][3] ECU_ADDRESS 0xd000811a FORMAT "%3.0" /end MEASUREMENT
/begin MEASUREMENT err_his[8][3] "Others data in history memory" UBYTE _CNV_A_R_LINEAR_____0_CM 1 100. 0. 255. DISPLAY_IDENTIFIER ERR_HIS[9][4] ECU_ADDRESS 0xd000811b FORMAT "%3.0" /end MEASUREMENT
/begin MEASUREMENT err_his[8][4] "Others data in history memory" UBYTE _CNV_A_R_LINEAR_____0_CM 1 100. 0. 255. DISPLAY_IDENTIFIER ERR_HIS[9][5] ECU_ADDRESS 0xd000811c FORMAT "%3.0" /end MEASUREMENT
/begin MEASUREMENT err_his[8][5] "Others data in history memory" UBYTE _CNV_A_R_LINEAR_____0_CM 1 100. 0. 255. DISPLAY_IDENTIFIER ERR_HIS[9][6] ECU_ADDRESS 0xd000811d FORMAT "%3.0" /end MEASUREMENT
/begin MEASUREMENT err_his[8][6] "Others data in history memory" UBYTE _CNV_A_R_LINEAR_____0_CM 1 100. 0. 255. DISPLAY_IDENTIFIER ERR_HIS[9][7] ECU_ADDRESS 0xd000811e FORMAT "%3.0" /end MEASUREMENT
/begin MEASUREMENT err_his[8][7] "Others data in history memory" UBYTE _CNV_A_R_LINEAR_____0_CM 1 100. 0. 255. DISPLAY_IDENTIFIER ERR_HIS[9][8] ECU_ADDRESS 0xd000811f FORMAT "%3.0" /end MEASUREMENT
/begin MEASUREMENT err_his[8][8] "Others data in history memory" UBYTE _CNV_A_R_LINEAR_____0_CM 1 100. 0. 255. DISPLAY_IDENTIFIER ERR_HIS[9][9] ECU_ADDRESS 0xd0008120 FORMAT "%3.0" /end MEASUREMENT
/begin MEASUREMENT err_his[9][0] "Others data in history memory" UBYTE _CNV_A_R_LINEAR_____0_CM 1 100. 0. 255. DISPLAY_IDENTIFIER ERR_HIS[10][1] ECU_ADDRESS 0xd0008121 FORMAT "%3.0" /end MEASUREMENT
/begin MEASUREMENT err_his[9][1] "Others data in history memory" UBYTE _CNV_A_R_LINEAR_____0_CM 1 100. 0. 255. DISPLAY_IDENTIFIER ERR_HIS[10][2] ECU_ADDRESS 0xd0008122 FORMAT "%3.0" /end MEASUREMENT
/begin MEASUREMENT err_his[9][2] "Others data in history memory" UBYTE _CNV_A_R_LINEAR_____0_CM 1 100. 0. 255. DISPLAY_IDENTIFIER ERR_HIS[10][3] ECU_ADDRESS 0xd0008123 FORMAT "%3.0" /end MEASUREMENT
/begin MEASUREMENT err_his[9][3] "Others data in history memory" UBYTE _CNV_A_R_LINEAR_____0_CM 1 100. 0. 255. DISPLAY_IDENTIFIER ERR_HIS[10][4] ECU_ADDRESS 0xd0008124 FORMAT "%3.0" /end MEASUREMENT
/begin MEASUREMENT err_his[9][4] "Others data in history memory" UBYTE _CNV_A_R_LINEAR_____0_CM 1 100. 0. 255. DISPLAY_IDENTIFIER ERR_HIS[10][5] ECU_ADDRESS 0xd0008125 FORMAT "%3.0" /end MEASUREMENT
/begin MEASUREMENT err_his[9][5] "Others data in history memory" UBYTE _CNV_A_R_LINEAR_____0_CM 1 100. 0. 255. DISPLAY_IDENTIFIER ERR_HIS[10][6] ECU_ADDRESS 0xd0008126 FORMAT "%3.0" /end MEASUREMENT
/begin MEASUREMENT err_his[9][6] "Others data in history memory" UBYTE _CNV_A_R_LINEAR_____0_CM 1 100. 0. 255. DISPLAY_IDENTIFIER ERR_HIS[10][7] ECU_ADDRESS 0xd0008127 FORMAT "%3.0" /end MEASUREMENT
/begin MEASUREMENT err_his[9][7] "Others data in history memory" UBYTE _CNV_A_R_LINEAR_____0_CM 1 100. 0. 255. DISPLAY_IDENTIFIER ERR_HIS[10][8] ECU_ADDRESS 0xd0008128 FORMAT "%3.0" /end MEASUREMENT
/begin MEASUREMENT err_his[9][8] "Others data in history memory" UBYTE _CNV_A_R_LINEAR_____0_CM 1 100. 0. 255. DISPLAY_IDENTIFIER ERR_HIS[10][9] ECU_ADDRESS 0xd0008129 FORMAT "%3.0" /end MEASUREMENT
/begin CHARACTERISTIC c_ctr_scdn_equ_dc_max "Maximum value of the driving cycle counter for similar conditions erase" VALUE 0xa0804ee4 _REC_VAL_20_u1 255. _CNV_A_R_LINEAR_____0_CM 0. 255. DISPLAY_IDENTIFIER C_CTR_SCDN_EQU_DC_MAX FORMAT "%3.0" /end CHARACTERISTIC
/begin CHARACTERISTIC c_n_scdn_equ "engine speed threshold for similar conditions detection (375 rpm)" VALUE 0xa0804ef6 _REC_VAL_20_u2 8160. _CNV_A_R_LINEAR_____14_CM 0. 8160. DISPLAY_IDENTIFIER C_N_SCDN_EQU FORMAT "%4.0" /end CHARACTERISTIC
/begin CHARACTERISTIC c_load_scdn_equ "LOAD value for similar conditions detection (typical 20%)" VALUE 0xa0804ef4 _REC_VAL_20_u1 99.609375 _CNV_A_R_LINEAR_____5_CM 0. 99.609375 DISPLAY_IDENTIFIER C_LOAD_SCDN_EQU FORMAT "%9.6" /end CHARACTERISTIC
/begin CHARACTERISTIC lc_ena_scdn "Boolean to indicate if similar conditions are inhibited (0) or not (1)" VALUE 0xa0804ef8 _REC_VAL_20_u1 1. _CNV_A_R_LINEAR_____0_CM 0. 1. DISPLAY_IDENTIFIER LC_ENA_SCDN FORMAT "%1.0" /end CHARACTERISTIC
/begin CHARACTERISTIC c_ctr_scdn_not_err_thd[0] "threshold for ratio CTR_SCDN_EQU/CTR_SCDN_SUM" VALUE 0xa0804ee8 _REC_VAL_20_u1 99.609375 _CNV_A_R_LINEAR_____5_CM 0. 99.609375 DISPLAY_IDENTIFIER C_CTR_SCDN_NOT_ERR_THD[0] FORMAT "%9.6" /end CHARACTERISTIC
/begin CHARACTERISTIC c_ctr_scdn_not_err_thd[1] "threshold for ratio CTR_SCDN_EQU/CTR_SCDN_SUM" VALUE 0xa0804ee9 _REC_VAL_20_u1 99.609375 _CNV_A_R_LINEAR_____5_CM 0. 99.609375 DISPLAY_IDENTIFIER C_CTR_SCDN_NOT_ERR_THD[1] FORMAT "%9.6" /end CHARACTERISTIC
/begin CHARACTERISTIC c_ctr_scdn_not_err_thd[2] "threshold for ratio CTR_SCDN_EQU/CTR_SCDN_SUM" VALUE 0xa0804eea _REC_VAL_20_u1 99.609375 _CNV_A_R_LINEAR_____5_CM 0. 99.609375 DISPLAY_IDENTIFIER C_CTR_SCDN_NOT_ERR_THD[2] FORMAT "%9.6" /end CHARACTERISTIC
/begin CHARACTERISTIC c_ctr_scdn_not_err_thd[3] "threshold for ratio CTR_SCDN_EQU/CTR_SCDN_SUM" VALUE 0xa0804eeb _REC_VAL_20_u1 99.609375 _CNV_A_R_LINEAR_____5_CM 0. 99.609375 DISPLAY_IDENTIFIER C_CTR_SCDN_NOT_ERR_THD[3] FORMAT "%9.6" /end CHARACTERISTIC
/begin CHARACTERISTIC c_ctr_scdn_not_err_thd[4] "threshold for ratio CTR_SCDN_EQU/CTR_SCDN_SUM" VALUE 0xa0804eec _REC_VAL_20_u1 99.609375 _CNV_A_R_LINEAR_____5_CM 0. 99.609375 DISPLAY_IDENTIFIER C_CTR_SCDN_NOT_ERR_THD[4] FORMAT "%9.6" /end CHARACTERISTIC
/begin CHARACTERISTIC c_ctr_scdn_not_err_thd[5] "threshold for ratio CTR_SCDN_EQU/CTR_SCDN_SUM" VALUE 0xa0804eed _REC_VAL_20_u1 99.609375 _CNV_A_R_LINEAR_____5_CM 0. 99.609375 DISPLAY_IDENTIFIER C_CTR_SCDN_NOT_ERR_THD[5] FORMAT "%9.6" /end CHARACTERISTIC
/begin CHARACTERISTIC c_ctr_scdn_not_err_thd[6] "threshold for ratio CTR_SCDN_EQU/CTR_SCDN_SUM" VALUE 0xa0804eee _REC_VAL_20_u1 99.609375 _CNV_A_R_LINEAR_____5_CM 0. 99.609375 DISPLAY_IDENTIFIER C_CTR_SCDN_NOT_ERR_THD[6] FORMAT "%9.6" /end CHARACTERISTIC
/begin CHARACTERISTIC c_ctr_scdn_not_err_thd[7] "threshold for ratio CTR_SCDN_EQU/CTR_SCDN_SUM" VALUE 0xa0804eef _REC_VAL_20_u1 99.609375 _CNV_A_R_LINEAR_____5_CM 0. 99.609375 DISPLAY_IDENTIFIER C_CTR_SCDN_NOT_ERR_THD[7] FORMAT "%9.6" /end CHARACTERISTIC
/begin CHARACTERISTIC c_ctr_scdn_not_err_thd[8] "threshold for ratio CTR_SCDN_EQU/CTR_SCDN_SUM" VALUE 0xa0804ef0 _REC_VAL_20_u1 99.609375 _CNV_A_R_LINEAR_____5_CM 0. 99.609375 DISPLAY_IDENTIFIER C_CTR_SCDN_NOT_ERR_THD[8] FORMAT "%9.6" /end CHARACTERISTIC
/begin CHARACTERISTIC c_ctr_scdn_not_err_thd[9] "threshold for ratio CTR_SCDN_EQU/CTR_SCDN_SUM" VALUE 0xa0804ef1 _REC_VAL_20_u1 99.609375 _CNV_A_R_LINEAR_____5_CM 0. 99.609375 DISPLAY_IDENTIFIER C_CTR_SCDN_NOT_ERR_THD[9] FORMAT "%9.6" /end CHARACTERISTIC
/begin CHARACTERISTIC c_ctr_scdn_not_err_thd[10] "threshold for ratio CTR_SCDN_EQU/CTR_SCDN_SUM" VALUE 0xa0804ef2 _REC_VAL_20_u1 99.609375 _CNV_A_R_LINEAR_____5_CM 0. 99.609375 DISPLAY_IDENTIFIER C_CTR_SCDN_NOT_ERR_THD[10] FORMAT "%9.6" /end CHARACTERISTIC
/begin CHARACTERISTIC c_ctr_scdn_not_err_thd[11] "threshold for ratio CTR_SCDN_EQU/CTR_SCDN_SUM" VALUE 0xa0804ef3 _REC_VAL_20_u1 99.609375 _CNV_A_R_LINEAR_____5_CM 0. 99.609375 DISPLAY_IDENTIFIER C_CTR_SCDN_NOT_ERR_THD[11] FORMAT "%9.6" /end CHARACTERISTIC
/begin MEASUREMENT fmy_stat_com_2_boff.err_info_stat.lv_err_mem "storage in dynamic failure memory of the diagnosis instance COM_2_BOFF" UWORD _CNV_S_2_RANGE__0___1_CM 1 100. 0. 1. DISPLAY_IDENTIFIER LV_ERR_MEM_COM_2_BOFF ECU_ADDRESS 0xd00094fa BIT_MASK 0x8 /end MEASUREMENT
/begin MEASUREMENT fmy_stat_com_2_boff.err_info_stat.lv_ready "readiness status of the diagnosis instance COM_2_BOFF" UWORD _CNV_S_2_RANGE__0___1_CM 1 100. 0. 1. DISPLAY_IDENTIFIER LV_READY_COM_2_BOFF ECU_ADDRESS 0xd00094fa BIT_MASK 0x10 /end MEASUREMENT
/begin MEASUREMENT fmy_stat_com_2_boff.err_info_stat.lv_end_diag "end of diagnosis of the diagnosis instance COM_2_BOFF" UWORD _CNV_S_2_RANGE__0___1_CM 1 100. 0. 1. DISPLAY_IDENTIFIER LV_END_DIAG_COM_2_BOFF ECU_ADDRESS 0xd00094fa BIT_MASK 0x20 /end MEASUREMENT
/begin MEASUREMENT fmy_stat_com_2_boff.err_info_stat.lv_cdn_diag "diagnosis condition of the diagnosis instance COM_2_BOFF" UWORD _CNV_S_2_RANGE__0___1_CM 1 100. 0. 1. DISPLAY_IDENTIFIER LV_CDN_DIAG_COM_2_BOFF ECU_ADDRESS 0xd00094fa BIT_MASK 0x40 /end MEASUREMENT
/begin MEASUREMENT fmy_stat_com_2_boff.err_info_stat.err_sym "symptoms of the diagnosis instance COM_2_BOFF" UWORD _CNV_S_16_RANGE_ERR__349_CM 1 100. 0. 15. DISPLAY_IDENTIFIER ERR_SYM_COM_2_BOFF ECU_ADDRESS 0xd00094fa BIT_MASK 0x780 /end MEASUREMENT
/begin MEASUREMENT fmy_stat_com_2_t_absl_icl.ctr_abc "anti bounce counter for diagnosis instance COM_2_T_ABSL_ICL" UBYTE _CNV_A_R_LINEAR_____0_CM 1 100. 0. 255. DISPLAY_IDENTIFIER CTR_ABC_COM_2_T_ABSL_ICL ECU_ADDRESS 0xd0009530 FORMAT "%3.0" /end MEASUREMENT
/begin MEASUREMENT fmy_stat_com_2_t_absl_icl.ctr_end_diag "counter for end of diagnosis for diagnosis instance COM_2_T_ABSL_ICL" UBYTE _CNV_A_R_LINEAR_____0_CM 1 100. 0. 255. DISPLAY_IDENTIFIER CTR_ABC_END_DIAG_COM_2_T_ABSL_ICL ECU_ADDRESS 0xd0009531 FORMAT "%3.0" /end MEASUREMENT
/begin MEASUREMENT fmy_stat_com_2_t_absl_icl.err_info_stat.lv_err_mem "storage in dynamic failure memory of the diagnosis instance COM_2_T_ABSL_ICL" UWORD _CNV_S_2_RANGE__0___1_CM 1 100. 0. 1. DISPLAY_IDENTIFIER LV_ERR_MEM_COM_2_T_ABSL_ICL ECU_ADDRESS 0xd0009532 BIT_MASK 0x8 /end MEASUREMENT
/begin MEASUREMENT fmy_stat_com_2_t_absl_icl.err_info_stat.lv_ready "readiness status of the diagnosis instance COM_2_T_ABSL_ICL" UWORD _CNV_S_2_RANGE__0___1_CM 1 100. 0. 1. DISPLAY_IDENTIFIER LV_READY_COM_2_T_ABSL_ICL ECU_ADDRESS 0xd0009532 BIT_MASK 0x10 /end MEASUREMENT
/begin MEASUREMENT fmy_stat_com_2_t_absl_icl.err_info_stat.lv_end_diag "end of diagnosis of the diagnosis instance COM_2_T_ABSL_ICL" UWORD _CNV_S_2_RANGE__0___1_CM 1 100. 0. 1. DISPLAY_IDENTIFIER LV_END_DIAG_COM_2_T_ABSL_ICL ECU_ADDRESS 0xd0009532 BIT_MASK 0x20 /end MEASUREMENT
/begin MEASUREMENT fmy_stat_com_2_t_absl_icl.err_info_stat.lv_cdn_diag "diagnosis condition of the diagnosis instance COM_2_T_ABSL_ICL" UWORD _CNV_S_2_RANGE__0___1_CM 1 100. 0. 1. DISPLAY_IDENTIFIER LV_CDN_DIAG_COM_2_T_ABSL_ICL ECU_ADDRESS 0xd0009532 BIT_MASK 0x40 /end MEASUREMENT
/begin MEASUREMENT fmy_stat_com_2_t_absl_icl.err_info_stat.err_sym "symptoms of the diagnosis instance COM_2_T_ABSL_ICL" UWORD _CNV_S_16_RANGE_ERR__349_CM 1 100. 0. 15. DISPLAY_IDENTIFIER ERR_SYM_COM_2_T_ABSL_ICL ECU_ADDRESS 0xd0009532 BIT_MASK 0x780 /end MEASUREMENT
/begin MEASUREMENT fmy_stat_com_2_cas.ctr_abc "anti bounce counter for diagnosis instance COM_2_CAS" UBYTE _CNV_A_R_LINEAR_____0_CM 1 100. 0. 255. DISPLAY_IDENTIFIER CTR_ABC_COM_2_CAS ECU_ADDRESS 0xd00094fc FORMAT "%3.0" /end MEASUREMENT
/begin MEASUREMENT fmy_stat_com_2_cas.ctr_end_diag "counter for end of diagnosis for diagnosis instance COM_2_CAS" UBYTE _CNV_A_R_LINEAR_____0_CM 1 100. 0. 255. DISPLAY_IDENTIFIER CTR_ABC_END_DIAG_COM_2_CAS ECU_ADDRESS 0xd00094fd FORMAT "%3.0" /end MEASUREMENT
/begin MEASUREMENT fmy_stat_com_2_cas.err_info_stat.lv_err_mem "storage in dynamic failure memory of the diagnosis instance COM_2_CAS" UWORD _CNV_S_2_RANGE__0___1_CM 1 100. 0. 1. DISPLAY_IDENTIFIER LV_ERR_MEM_COM_2_CAS ECU_ADDRESS 0xd00094fe BIT_MASK 0x8 /end MEASUREMENT
/begin MEASUREMENT fmy_stat_com_2_cas.err_info_stat.lv_ready "readiness status of the diagnosis instance COM_2_CAS" UWORD _CNV_S_2_RANGE__0___1_CM 1 100. 0. 1. DISPLAY_IDENTIFIER LV_READY_COM_2_CAS ECU_ADDRESS 0xd00094fe BIT_MASK 0x10 /end MEASUREMENT
/begin MEASUREMENT fmy_stat_com_2_cas.err_info_stat.lv_end_diag "end of diagnosis of the diagnosis instance COM_2_CAS" UWORD _CNV_S_2_RANGE__0___1_CM 1 100. 0. 1. DISPLAY_IDENTIFIER LV_END_DIAG_COM_2_CAS ECU_ADDRESS 0xd00094fe BIT_MASK 0x20 /end MEASUREMENT
/begin MEASUREMENT fmy_stat_com_2_cas.err_info_stat.lv_cdn_diag "diagnosis condition of the diagnosis instance COM_2_CAS" UWORD _CNV_S_2_RANGE__0___1_CM 1 100. 0. 1. DISPLAY_IDENTIFIER LV_CDN_DIAG_COM_2_CAS ECU_ADDRESS 0xd00094fe BIT_MASK 0x40 /end MEASUREMENT
/begin MEASUREMENT fmy_stat_com_2_cas.err_info_stat.err_sym "symptoms of the diagnosis instance COM_2_CAS" UWORD _CNV_S_16_RANGE_ERR__349_CM 1 100. 0. 15. DISPLAY_IDENTIFIER ERR_SYM_COM_2_CAS ECU_ADDRESS 0xd00094fe BIT_MASK 0x780 /end MEASUREMENT
/begin MEASUREMENT fmy_stat_com_2_etcu_disp.ctr_abc "anti bounce counter for diagnosis instance COM_2_ETCU_DISP" UBYTE _CNV_A_R_LINEAR_____0_CM 1 100. 0. 255. DISPLAY_IDENTIFIER CTR_ABC_COM_2_ETCU_DISP ECU_ADDRESS 0xd0009510 FORMAT "%3.0" /end MEASUREMENT
/begin MEASUREMENT fmy_stat_com_2_etcu_disp.ctr_end_diag "counter for end of diagnosis for diagnosis instance COM_2_ETCU_DISP" UBYTE _CNV_A_R_LINEAR_____0_CM 1 100. 0. 255. DISPLAY_IDENTIFIER CTR_ABC_END_DIAG_COM_2_ETCU_DISP ECU_ADDRESS 0xd0009511 FORMAT "%3.0" /end MEASUREMENT
/begin MEASUREMENT fmy_stat_com_2_etcu_disp.err_info_stat.lv_err_mem "storage in dynamic failure memory of the diagnosis instance COM_2_ETCU_DISP" UWORD _CNV_S_2_RANGE__0___1_CM 1 100. 0. 1. DISPLAY_IDENTIFIER LV_ERR_MEM_COM_2_ETCU_DISP ECU_ADDRESS 0xd0009512 BIT_MASK 0x8 /end MEASUREMENT
/begin MEASUREMENT fmy_stat_com_2_etcu_disp.err_info_stat.lv_ready "readiness status of the diagnosis instance COM_2_ETCU_DISP" UWORD _CNV_S_2_RANGE__0___1_CM 1 100. 0. 1. DISPLAY_IDENTIFIER LV_READY_COM_2_ETCU_DISP ECU_ADDRESS 0xd0009512 BIT_MASK 0x10 /end MEASUREMENT
/begin MEASUREMENT fmy_stat_com_2_etcu_disp.err_info_stat.lv_end_diag "end of diagnosis of the diagnosis instance COM_2_ETCU_DISP" UWORD _CNV_S_2_RANGE__0___1_CM 1 100. 0. 1. DISPLAY_IDENTIFIER LV_END_DIAG_COM_2_ETCU_DISP ECU_ADDRESS 0xd0009512 BIT_MASK 0x20 /end MEASUREMENT
/begin MEASUREMENT fmy_stat_com_2_etcu_disp.err_info_stat.lv_cdn_diag "diagnosis condition of the diagnosis instance COM_2_ETCU_DISP" UWORD _CNV_S_2_RANGE__0___1_CM 1 100. 0. 1. DISPLAY_IDENTIFIER LV_CDN_DIAG_COM_2_ETCU_DISP ECU_ADDRESS 0xd0009512 BIT_MASK 0x40 /end MEASUREMENT
/begin MEASUREMENT fmy_stat_com_2_etcu_disp.err_info_stat.err_sym "symptoms of the diagnosis instance COM_2_ETCU_DISP" UWORD _CNV_S_16_RANGE_ERR__349_CM 1 100. 0. 15. DISPLAY_IDENTIFIER ERR_SYM_COM_2_ETCU_DISP ECU_ADDRESS 0xd0009512 BIT_MASK 0x780 /end MEASUREMENT
/begin MEASUREMENT fmy_stat_com_2_pow_off.ctr_abc "anti bounce counter for diagnosis instance COM_2_POW_OFF" UBYTE _CNV_A_R_LINEAR_____0_CM 1 100. 0. 255. DISPLAY_IDENTIFIER CTR_ABC_COM_2_POW_OFF ECU_ADDRESS 0xd0009528 FORMAT "%3.0" /end MEASUREMENT
/begin MEASUREMENT fmy_stat_com_2_pow_off.ctr_end_diag "counter for end of diagnosis for diagnosis instance COM_2_POW_OFF" UBYTE _CNV_A_R_LINEAR_____0_CM 1 100. 0. 255. DISPLAY_IDENTIFIER CTR_ABC_END_DIAG_COM_2_POW_OFF ECU_ADDRESS 0xd0009529 FORMAT "%3.0" /end MEASUREMENT
/begin MEASUREMENT fmy_stat_com_2_pow_off.err_info_stat.lv_err_mem "storage in dynamic failure memory of the diagnosis instance COM_2_POW_OFF" UWORD _CNV_S_2_RANGE__0___1_CM 1 100. 0. 1. DISPLAY_IDENTIFIER LV_ERR_MEM_COM_2_POW_OFF ECU_ADDRESS 0xd000952a BIT_MASK 0x8 /end MEASUREMENT
/begin MEASUREMENT fmy_stat_com_2_pow_off.err_info_stat.lv_ready "readiness status of the diagnosis instance COM_2_POW_OFF" UWORD _CNV_S_2_RANGE__0___1_CM 1 100. 0. 1. DISPLAY_IDENTIFIER LV_READY_COM_2_POW_OFF ECU_ADDRESS 0xd000952a BIT_MASK 0x10 /end MEASUREMENT
/begin MEASUREMENT fmy_stat_com_2_pow_off.err_info_stat.lv_end_diag "end of diagnosis of the diagnosis instance COM_2_POW_OFF" UWORD _CNV_S_2_RANGE__0___1_CM 1 100. 0. 1. DISPLAY_IDENTIFIER LV_END_DIAG_COM_2_POW_OFF ECU_ADDRESS 0xd000952a BIT_MASK 0x20 /end MEASUREMENT
/begin MEASUREMENT fmy_stat_com_2_pow_off.err_info_stat.lv_cdn_diag "diagnosis condition of the diagnosis instance COM_2_POW_OFF" UWORD _CNV_S_2_RANGE__0___1_CM 1 100. 0. 1. DISPLAY_IDENTIFIER LV_CDN_DIAG_COM_2_POW_OFF ECU_ADDRESS 0xd000952a BIT_MASK 0x40 /end MEASUREMENT
/begin MEASUREMENT fmy_stat_com_2_pow_off.err_info_stat.err_sym "symptoms of the diagnosis instance COM_2_POW_OFF" UWORD _CNV_S_16_RANGE_ERR__349_CM 1 100. 0. 15. DISPLAY_IDENTIFIER ERR_SYM_COM_2_POW_OFF ECU_ADDRESS 0xd000952a BIT_MASK 0x780 /end MEASUREMENT
/begin MEASUREMENT fmy_stat_com_2_abs_icl.ctr_abc "anti bounce counter for diagnosis instance COM_2_ABS_ICL" UBYTE _CNV_A_R_LINEAR_____0_CM 1 100. 0. 255. DISPLAY_IDENTIFIER CTR_ABC_COM_2_ABS_ICL ECU_ADDRESS 0xd00094f0 FORMAT "%3.0" /end MEASUREMENT
/begin MEASUREMENT fmy_stat_com_2_abs_icl.ctr_end_diag "counter for end of diagnosis for diagnosis instance COM_2_ABS_ICL" UBYTE _CNV_A_R_LINEAR_____0_CM 1 100. 0. 255. DISPLAY_IDENTIFIER CTR_ABC_END_DIAG_COM_2_ABS_ICL ECU_ADDRESS 0xd00094f1 FORMAT "%3.0" /end MEASUREMENT
/begin MEASUREMENT fmy_stat_com_2_abs_icl.err_info_stat.lv_err_mem "storage in dynamic failure memory of the diagnosis instance COM_2_ABS_ICL" UWORD _CNV_S_2_RANGE__0___1_CM 1 100. 0. 1. DISPLAY_IDENTIFIER LV_ERR_MEM_COM_2_ABS_ICL ECU_ADDRESS 0xd00094f2 BIT_MASK 0x8 /end MEASUREMENT
/begin MEASUREMENT fmy_stat_com_2_abs_icl.err_info_stat.lv_ready "readiness status of the diagnosis instance COM_2_ABS_ICL" UWORD _CNV_S_2_RANGE__0___1_CM 1 100. 0. 1. DISPLAY_IDENTIFIER LV_READY_COM_2_ABS_ICL ECU_ADDRESS 0xd00094f2 BIT_MASK 0x10 /end MEASUREMENT
/begin MEASUREMENT fmy_stat_com_2_abs_icl.err_info_stat.lv_end_diag "end of diagnosis of the diagnosis instance COM_2_ABS_ICL" UWORD _CNV_S_2_RANGE__0___1_CM 1 100. 0. 1. DISPLAY_IDENTIFIER LV_END_DIAG_COM_2_ABS_ICL ECU_ADDRESS 0xd00094f2 BIT_MASK 0x20 /end MEASUREMENT
/begin MEASUREMENT fmy_stat_com_2_abs_icl.err_info_stat.lv_cdn_diag "diagnosis condition of the diagnosis instance COM_2_ABS_ICL" UWORD _CNV_S_2_RANGE__0___1_CM 1 100. 0. 1. DISPLAY_IDENTIFIER LV_CDN_DIAG_COM_2_ABS_ICL ECU_ADDRESS 0xd00094f2 BIT_MASK 0x40 /end MEASUREMENT
/begin MEASUREMENT fmy_stat_com_2_abs_icl.err_info_stat.err_sym "symptoms of the diagnosis instance COM_2_ABS_ICL" UWORD _CNV_S_16_RANGE_ERR__349_CM 1 100. 0. 15. DISPLAY_IDENTIFIER ERR_SYM_COM_2_ABS_ICL ECU_ADDRESS 0xd00094f2 BIT_MASK 0x780 /end MEASUREMENT
/begin MEASUREMENT fmy_stat_com_2_trl.ctr_abc "anti bounce counter for diagnosis instance COM_2_TRL" UBYTE _CNV_A_R_LINEAR_____0_CM 1 100. 0. 255. DISPLAY_IDENTIFIER CTR_ABC_COM_2_TRL ECU_ADDRESS 0xd0009544 FORMAT "%3.0" /end MEASUREMENT
/begin MEASUREMENT fmy_stat_com_2_trl.ctr_end_diag "counter for end of diagnosis for diagnosis instance COM_2_TRL" UBYTE _CNV_A_R_LINEAR_____0_CM 1 100. 0. 255. DISPLAY_IDENTIFIER CTR_ABC_END_DIAG_COM_2_TRL ECU_ADDRESS 0xd0009545 FORMAT "%3.0" /end MEASUREMENT
/begin MEASUREMENT fmy_stat_com_2_trl.err_info_stat.lv_err_mem "storage in dynamic failure memory of the diagnosis instance COM_2_TRL" UWORD _CNV_S_2_RANGE__0___1_CM 1 100. 0. 1. DISPLAY_IDENTIFIER LV_ERR_MEM_COM_2_TRL ECU_ADDRESS 0xd0009546 BIT_MASK 0x8 /end MEASUREMENT
/begin MEASUREMENT fmy_stat_com_2_trl.err_info_stat.lv_ready "readiness status of the diagnosis instance COM_2_TRL" UWORD _CNV_S_2_RANGE__0___1_CM 1 100. 0. 1. DISPLAY_IDENTIFIER LV_READY_COM_2_TRL ECU_ADDRESS 0xd0009546 BIT_MASK 0x10 /end MEASUREMENT
/begin MEASUREMENT fmy_stat_com_2_trl.err_info_stat.lv_end_diag "end of diagnosis of the diagnosis instance COM_2_TRL" UWORD _CNV_S_2_RANGE__0___1_CM 1 100. 0. 1. DISPLAY_IDENTIFIER LV_END_DIAG_COM_2_TRL ECU_ADDRESS 0xd0009546 BIT_MASK 0x20 /end MEASUREMENT
/begin MEASUREMENT fmy_stat_com_2_trl.err_info_stat.lv_cdn_diag "diagnosis condition of the diagnosis instance COM_2_TRL" UWORD _CNV_S_2_RANGE__0___1_CM 1 100. 0. 1. DISPLAY_IDENTIFIER LV_CDN_DIAG_COM_2_TRL ECU_ADDRESS 0xd0009546 BIT_MASK 0x40 /end MEASUREMENT
/begin MEASUREMENT fmy_stat_com_2_trl.err_info_stat.err_sym "symptoms of the diagnosis instance COM_2_TRL" UWORD _CNV_S_16_RANGE_ERR__349_CM 1 100. 0. 15. DISPLAY_IDENTIFIER ERR_SYM_COM_2_TRL ECU_ADDRESS 0xd0009546 BIT_MASK 0x780 /end MEASUREMENT
/begin MEASUREMENT fmy_stat_com_2_hiv.ctr_abc "anti bounce counter for diagnosis instance COM_2_HIV" UBYTE _CNV_A_R_LINEAR_____0_CM 1 100. 0. 255. DISPLAY_IDENTIFIER CTR_ABC_COM_2_HIV ECU_ADDRESS 0xd000951c FORMAT "%3.0" /end MEASUREMENT
/begin MEASUREMENT fmy_stat_com_2_hiv.ctr_end_diag "counter for end of diagnosis for diagnosis instance COM_2_HIV" UBYTE _CNV_A_R_LINEAR_____0_CM 1 100. 0. 255. DISPLAY_IDENTIFIER CTR_ABC_END_DIAG_COM_2_HIV ECU_ADDRESS 0xd000951d FORMAT "%3.0" /end MEASUREMENT
/begin MEASUREMENT fmy_stat_com_2_hiv.err_info_stat.lv_err_mem "storage in dynamic failure memory of the diagnosis instance COM_2_HIV" UWORD _CNV_S_2_RANGE__0___1_CM 1 100. 0. 1. DISPLAY_IDENTIFIER LV_ERR_MEM_COM_2_HIV ECU_ADDRESS 0xd000951e BIT_MASK 0x8 /end MEASUREMENT
/begin MEASUREMENT fmy_stat_com_2_hiv.err_info_stat.lv_ready "readiness status of the diagnosis instance COM_2_HIV" UWORD _CNV_S_2_RANGE__0___1_CM 1 100. 0. 1. DISPLAY_IDENTIFIER LV_READY_COM_2_HIV ECU_ADDRESS 0xd000951e BIT_MASK 0x10 /end MEASUREMENT
/begin MEASUREMENT fmy_stat_com_2_hiv.err_info_stat.lv_end_diag "end of diagnosis of the diagnosis instance COM_2_HIV" UWORD _CNV_S_2_RANGE__0___1_CM 1 100. 0. 1. DISPLAY_IDENTIFIER LV_END_DIAG_COM_2_HIV ECU_ADDRESS 0xd000951e BIT_MASK 0x20 /end MEASUREMENT
/begin MEASUREMENT fmy_stat_com_2_hiv.err_info_stat.lv_cdn_diag "diagnosis condition of the diagnosis instance COM_2_HIV" UWORD _CNV_S_2_RANGE__0___1_CM 1 100. 0. 1. DISPLAY_IDENTIFIER LV_CDN_DIAG_COM_2_HIV ECU_ADDRESS 0xd000951e BIT_MASK 0x40 /end MEASUREMENT
/begin MEASUREMENT fmy_stat_com_2_hiv.err_info_stat.err_sym "symptoms of the diagnosis instance COM_2_HIV" UWORD _CNV_S_16_RANGE_ERR__349_CM 1 100. 0. 15. DISPLAY_IDENTIFIER ERR_SYM_COM_2_HIV ECU_ADDRESS 0xd000951e BIT_MASK 0x780 /end MEASUREMENT
/begin MEASUREMENT fmy_stat_com_2_icl.ctr_abc "anti bounce counter for diagnosis instance COM_2_ICL" UBYTE _CNV_A_R_LINEAR_____0_CM 1 100. 0. 255. DISPLAY_IDENTIFIER CTR_ABC_COM_2_ICL ECU_ADDRESS 0xd0009520 FORMAT "%3.0" /end MEASUREMENT
/begin MEASUREMENT fmy_stat_com_2_icl.ctr_end_diag "counter for end of diagnosis for diagnosis instance COM_2_ICL" UBYTE _CNV_A_R_LINEAR_____0_CM 1 100. 0. 255. DISPLAY_IDENTIFIER CTR_ABC_END_DIAG_COM_2_ICL ECU_ADDRESS 0xd0009521 FORMAT "%3.0" /end MEASUREMENT
/begin MEASUREMENT fmy_stat_com_2_icl.err_info_stat.lv_err_mem "storage in dynamic failure memory of the diagnosis instance COM_2_ICL" UWORD _CNV_S_2_RANGE__0___1_CM 1 100. 0. 1. DISPLAY_IDENTIFIER LV_ERR_MEM_COM_2_ICL ECU_ADDRESS 0xd0009522 BIT_MASK 0x8 /end MEASUREMENT
/begin MEASUREMENT fmy_stat_com_2_icl.err_info_stat.lv_ready "readiness status of the diagnosis instance COM_2_ICL" UWORD _CNV_S_2_RANGE__0___1_CM 1 100. 0. 1. DISPLAY_IDENTIFIER LV_READY_COM_2_ICL ECU_ADDRESS 0xd0009522 BIT_MASK 0x10 /end MEASUREMENT
/begin MEASUREMENT fmy_stat_com_2_icl.err_info_stat.lv_end_diag "end of diagnosis of the diagnosis instance COM_2_ICL" UWORD _CNV_S_2_RANGE__0___1_CM 1 100. 0. 1. DISPLAY_IDENTIFIER LV_END_DIAG_COM_2_ICL ECU_ADDRESS 0xd0009522 BIT_MASK 0x20 /end MEASUREMENT
/begin MEASUREMENT fmy_stat_com_2_icl.err_info_stat.lv_cdn_diag "diagnosis condition of the diagnosis instance COM_2_ICL" UWORD _CNV_S_2_RANGE__0___1_CM 1 100. 0. 1. DISPLAY_IDENTIFIER LV_CDN_DIAG_COM_2_ICL ECU_ADDRESS 0xd0009522 BIT_MASK 0x40 /end MEASUREMENT
/begin MEASUREMENT fmy_stat_com_2_icl.err_info_stat.err_sym "symptoms of the diagnosis instance COM_2_ICL" UWORD _CNV_S_16_RANGE_ERR__349_CM 1 100. 0. 15. DISPLAY_IDENTIFIER ERR_SYM_COM_2_ICL ECU_ADDRESS 0xd0009522 BIT_MASK 0x780 /end MEASUREMENT
/begin MEASUREMENT fmy_stat_com_2_gear_rev.ctr_abc "anti bounce counter for diagnosis instance COM_2_GEAR_REV" UBYTE _CNV_A_R_LINEAR_____0_CM 1 100. 0. 255. DISPLAY_IDENTIFIER CTR_ABC_COM_2_GEAR_REV ECU_ADDRESS 0xd0009518 FORMAT "%3.0" /end MEASUREMENT
/begin MEASUREMENT fmy_stat_com_2_gear_rev.ctr_end_diag "counter for end of diagnosis for diagnosis instance COM_2_GEAR_REV" UBYTE _CNV_A_R_LINEAR_____0_CM 1 100. 0. 255. DISPLAY_IDENTIFIER CTR_ABC_END_DIAG_COM_2_GEAR_REV ECU_ADDRESS 0xd0009519 FORMAT "%3.0" /end MEASUREMENT
/begin MEASUREMENT fmy_stat_com_2_gear_rev.err_info_stat.lv_err_mem "storage in dynamic failure memory of the diagnosis instance COM_2_GEAR_REV" UWORD _CNV_S_2_RANGE__0___1_CM 1 100. 0. 1. DISPLAY_IDENTIFIER LV_ERR_MEM_COM_2_GEAR_REV ECU_ADDRESS 0xd000951a BIT_MASK 0x8 /end MEASUREMENT
/begin MEASUREMENT fmy_stat_com_2_gear_rev.err_info_stat.lv_ready "readiness status of the diagnosis instance COM_2_GEAR_REV" UWORD _CNV_S_2_RANGE__0___1_CM 1 100. 0. 1. DISPLAY_IDENTIFIER LV_READY_COM_2_GEAR_REV ECU_ADDRESS 0xd000951a BIT_MASK 0x10 /end MEASUREMENT
/begin MEASUREMENT fmy_stat_com_2_gear_rev.err_info_stat.lv_end_diag "end of diagnosis of the diagnosis instance COM_2_GEAR_REV" UWORD _CNV_S_2_RANGE__0___1_CM 1 100. 0. 1. DISPLAY_IDENTIFIER LV_END_DIAG_COM_2_GEAR_REV ECU_ADDRESS 0xd000951a BIT_MASK 0x20 /end MEASUREMENT
/begin MEASUREMENT fmy_stat_com_2_gear_rev.err_info_stat.lv_cdn_diag "diagnosis condition of the diagnosis instance COM_2_GEAR_REV" UWORD _CNV_S_2_RANGE__0___1_CM 1 100. 0. 1. DISPLAY_IDENTIFIER LV_CDN_DIAG_COM_2_GEAR_REV ECU_ADDRESS 0xd000951a BIT_MASK 0x40 /end MEASUREMENT
/begin MEASUREMENT fmy_stat_com_2_gear_rev.err_info_stat.err_sym "symptoms of the diagnosis instance COM_2_GEAR_REV" UWORD _CNV_S_16_RANGE_ERR__349_CM 1 100. 0. 15. DISPLAY_IDENTIFIER ERR_SYM_COM_2_GEAR_REV ECU_ADDRESS 0xd000951a BIT_MASK 0x780 /end MEASUREMENT
/begin MEASUREMENT fmy_stat_com_2_cdn_door.ctr_abc "anti bounce counter for diagnosis instance COM_2_CDN_DOOR" UBYTE _CNV_A_R_LINEAR_____0_CM 1 100. 0. 255. DISPLAY_IDENTIFIER CTR_ABC_COM_2_CDN_DOOR ECU_ADDRESS 0xd0009504 FORMAT "%3.0" /end MEASUREMENT
/begin MEASUREMENT fmy_stat_com_2_cdn_door.ctr_end_diag "counter for end of diagnosis for diagnosis instance COM_2_CDN_DOOR" UBYTE _CNV_A_R_LINEAR_____0_CM 1 100. 0. 255. DISPLAY_IDENTIFIER CTR_ABC_END_DIAG_COM_2_CDN_DOOR ECU_ADDRESS 0xd0009505 FORMAT "%3.0" /end MEASUREMENT
/begin MEASUREMENT fmy_stat_com_2_cdn_door.err_info_stat.lv_err_mem "storage in dynamic failure memory of the diagnosis instance COM_2_CDN_DOOR" UWORD _CNV_S_2_RANGE__0___1_CM 1 100. 0. 1. DISPLAY_IDENTIFIER LV_ERR_MEM_COM_2_CDN_DOOR ECU_ADDRESS 0xd0009506 BIT_MASK 0x8 /end MEASUREMENT
/begin MEASUREMENT fmy_stat_com_2_cdn_door.err_info_stat.lv_ready "readiness status of the diagnosis instance COM_2_CDN_DOOR" UWORD _CNV_S_2_RANGE__0___1_CM 1 100. 0. 1. DISPLAY_IDENTIFIER LV_READY_COM_2_CDN_DOOR ECU_ADDRESS 0xd0009506 BIT_MASK 0x10 /end MEASUREMENT
/begin MEASUREMENT fmy_stat_com_2_cdn_door.err_info_stat.lv_end_diag "end of diagnosis of the diagnosis instance COM_2_CDN_DOOR" UWORD _CNV_S_2_RANGE__0___1_CM 1 100. 0. 1. DISPLAY_IDENTIFIER LV_END_DIAG_COM_2_CDN_DOOR ECU_ADDRESS 0xd0009506 BIT_MASK 0x20 /end MEASUREMENT
/begin MEASUREMENT fmy_stat_com_2_cdn_door.err_info_stat.lv_cdn_diag "diagnosis condition of the diagnosis instance COM_2_CDN_DOOR" UWORD _CNV_S_2_RANGE__0___1_CM 1 100. 0. 1. DISPLAY_IDENTIFIER LV_CDN_DIAG_COM_2_CDN_DOOR ECU_ADDRESS 0xd0009506 BIT_MASK 0x40 /end MEASUREMENT
/begin MEASUREMENT fmy_stat_com_2_cdn_door.err_info_stat.err_sym "symptoms of the diagnosis instance COM_2_CDN_DOOR" UWORD _CNV_S_16_RANGE_ERR__349_CM 1 100. 0. 15. DISPLAY_IDENTIFIER ERR_SYM_COM_2_CDN_DOOR ECU_ADDRESS 0xd0009506 BIT_MASK 0x780 /end MEASUREMENT
/begin MEASUREMENT fmy_stat_com_3_boff.ctr_abc "anti bounce counter for diagnosis instance COM_3_BOFF" UBYTE _CNV_A_R_LINEAR_____0_CM 1 100. 0. 255. DISPLAY_IDENTIFIER CTR_ABC_COM_3_BOFF ECU_ADDRESS 0xd0009548 FORMAT "%3.0" /end MEASUREMENT
/begin MEASUREMENT fmy_stat_com_3_boff.ctr_end_diag "counter for end of diagnosis for diagnosis instance COM_3_BOFF" UBYTE _CNV_A_R_LINEAR_____0_CM 1 100. 0. 255. DISPLAY_IDENTIFIER CTR_ABC_END_DIAG_COM_3_BOFF ECU_ADDRESS 0xd0009549 FORMAT "%3.0" /end MEASUREMENT
/begin MEASUREMENT fmy_stat_com_3_boff.err_info_stat.lv_err_mem "storage in dynamic failure memory of the diagnosis instance COM_3_BOFF" UWORD _CNV_S_2_RANGE__0___1_CM 1 100. 0. 1. DISPLAY_IDENTIFIER LV_ERR_MEM_COM_3_BOFF ECU_ADDRESS 0xd000954a BIT_MASK 0x8 /end MEASUREMENT
/begin MEASUREMENT fmy_stat_com_3_boff.err_info_stat.lv_ready "readiness status of the diagnosis instance COM_3_BOFF" UWORD _CNV_S_2_RANGE__0___1_CM 1 100. 0. 1. DISPLAY_IDENTIFIER LV_READY_COM_3_BOFF ECU_ADDRESS 0xd000954a BIT_MASK 0x10 /end MEASUREMENT
/begin MEASUREMENT fmy_stat_com_3_boff.err_info_stat.lv_end_diag "end of diagnosis of the diagnosis instance COM_3_BOFF" UWORD _CNV_S_2_RANGE__0___1_CM 1 100. 0. 1. DISPLAY_IDENTIFIER LV_END_DIAG_COM_3_BOFF ECU_ADDRESS 0xd000954a BIT_MASK 0x20 /end MEASUREMENT
/begin MEASUREMENT fmy_stat_com_3_boff.err_info_stat.lv_cdn_diag "diagnosis condition of the diagnosis instance COM_3_BOFF" UWORD _CNV_S_2_RANGE__0___1_CM 1 100. 0. 1. DISPLAY_IDENTIFIER LV_CDN_DIAG_COM_3_BOFF ECU_ADDRESS 0xd000954a BIT_MASK 0x40 /end MEASUREMENT
/begin MEASUREMENT fmy_stat_com_3_boff.err_info_stat.err_sym "symptoms of the diagnosis instance COM_3_BOFF" UWORD _CNV_S_16_RANGE_ERR__349_CM 1 100. 0. 15. DISPLAY_IDENTIFIER ERR_SYM_COM_3_BOFF ECU_ADDRESS 0xd000954a BIT_MASK 0x780 /end MEASUREMENT
/begin MEASUREMENT fmy_stat_com_3_efp.ctr_abc "anti bounce counter for diagnosis instance COM_3_EFP" UBYTE _CNV_A_R_LINEAR_____0_CM 1 100. 0. 255. DISPLAY_IDENTIFIER CTR_ABC_COM_3_EFP ECU_ADDRESS 0xd000954c FORMAT "%3.0" /end MEASUREMENT
/begin MEASUREMENT fmy_stat_com_3_efp.ctr_end_diag "counter for end of diagnosis for diagnosis instance COM_3_EFP" UBYTE _CNV_A_R_LINEAR_____0_CM 1 100. 0. 255. DISPLAY_IDENTIFIER CTR_ABC_END_DIAG_COM_3_EFP ECU_ADDRESS 0xd000954d FORMAT "%3.0" /end MEASUREMENT
/begin MEASUREMENT fmy_stat_com_3_efp.err_info_stat.lv_err_mem "storage in dynamic failure memory of the diagnosis instance COM_3_EFP" UWORD _CNV_S_2_RANGE__0___1_CM 1 100. 0. 1. DISPLAY_IDENTIFIER LV_ERR_MEM_COM_3_EFP ECU_ADDRESS 0xd000954e BIT_MASK 0x8 /end MEASUREMENT
/begin MEASUREMENT fmy_stat_com_3_efp.err_info_stat.lv_ready "readiness status of the diagnosis instance COM_3_EFP" UWORD _CNV_S_2_RANGE__0___1_CM 1 100. 0. 1. DISPLAY_IDENTIFIER LV_READY_COM_3_EFP ECU_ADDRESS 0xd000954e BIT_MASK 0x10 /end MEASUREMENT
/begin MEASUREMENT fmy_stat_com_3_efp.err_info_stat.lv_end_diag "end of diagnosis of the diagnosis instance COM_3_EFP" UWORD _CNV_S_2_RANGE__0___1_CM 1 100. 0. 1. DISPLAY_IDENTIFIER LV_END_DIAG_COM_3_EFP ECU_ADDRESS 0xd000954e BIT_MASK 0x20 /end MEASUREMENT
/begin MEASUREMENT fmy_stat_com_3_efp.err_info_stat.lv_cdn_diag "diagnosis condition of the diagnosis instance COM_3_EFP" UWORD _CNV_S_2_RANGE__0___1_CM 1 100. 0. 1. DISPLAY_IDENTIFIER LV_CDN_DIAG_COM_3_EFP ECU_ADDRESS 0xd000954e BIT_MASK 0x40 /end MEASUREMENT
/begin MEASUREMENT fmy_stat_com_3_efp.err_info_stat.err_sym "symptoms of the diagnosis instance COM_3_EFP" UWORD _CNV_S_16_RANGE_ERR__349_CM 1 100. 0. 15. DISPLAY_IDENTIFIER ERR_SYM_COM_3_EFP ECU_ADDRESS 0xd000954e BIT_MASK 0x780 /end MEASUREMENT
/begin MEASUREMENT fmy_stat_com_3_tq_etcu.ctr_abc "anti bounce counter for diagnosis instance COM_3_TQ_ETCU" UBYTE _CNV_A_R_LINEAR_____0_CM 1 100. 0. 255. DISPLAY_IDENTIFIER CTR_ABC_COM_3_TQ_ETCU ECU_ADDRESS 0xd0009560 FORMAT "%3.0" /end MEASUREMENT
/begin MEASUREMENT fmy_stat_com_3_tq_etcu.ctr_end_diag "counter for end of diagnosis for diagnosis instance COM_3_TQ_ETCU" UBYTE _CNV_A_R_LINEAR_____0_CM 1 100. 0. 255. DISPLAY_IDENTIFIER CTR_ABC_END_DIAG_COM_3_TQ_ETCU ECU_ADDRESS 0xd0009561 FORMAT "%3.0" /end MEASUREMENT
/begin MEASUREMENT fmy_stat_com_3_tq_etcu.err_info_stat.lv_err_mem "storage in dynamic failure memory of the diagnosis instance COM_3_TQ_ETCU" UWORD _CNV_S_2_RANGE__0___1_CM 1 100. 0. 1. DISPLAY_IDENTIFIER LV_ERR_MEM_COM_3_TQ_ETCU ECU_ADDRESS 0xd0009562 BIT_MASK 0x8 /end MEASUREMENT
/begin MEASUREMENT fmy_stat_com_3_tq_etcu.err_info_stat.lv_ready "readiness status of the diagnosis instance COM_3_TQ_ETCU" UWORD _CNV_S_2_RANGE__0___1_CM 1 100. 0. 1. DISPLAY_IDENTIFIER LV_READY_COM_3_TQ_ETCU ECU_ADDRESS 0xd0009562 BIT_MASK 0x10 /end MEASUREMENT
/begin MEASUREMENT fmy_stat_com_3_tq_etcu.err_info_stat.lv_end_diag "end of diagnosis of the diagnosis instance COM_3_TQ_ETCU" UWORD _CNV_S_2_RANGE__0___1_CM 1 100. 0. 1. DISPLAY_IDENTIFIER LV_END_DIAG_COM_3_TQ_ETCU ECU_ADDRESS 0xd0009562 BIT_MASK 0x20 /end MEASUREMENT
/begin MEASUREMENT fmy_stat_com_3_tq_etcu.err_info_stat.lv_cdn_diag "diagnosis condition of the diagnosis instance COM_3_TQ_ETCU" UWORD _CNV_S_2_RANGE__0___1_CM 1 100. 0. 1. DISPLAY_IDENTIFIER LV_CDN_DIAG_COM_3_TQ_ETCU ECU_ADDRESS 0xd0009562 BIT_MASK 0x40 /end MEASUREMENT
/begin MEASUREMENT fmy_stat_com_3_tq_etcu.err_info_stat.err_sym "symptoms of the diagnosis instance COM_3_TQ_ETCU" UWORD _CNV_S_16_RANGE_ERR__349_CM 1 100. 0. 15. DISPLAY_IDENTIFIER ERR_SYM_COM_3_TQ_ETCU ECU_ADDRESS 0xd0009562 BIT_MASK 0x780 /end MEASUREMENT
/begin MEASUREMENT fmy_stat_com_3_etcu.ctr_abc "anti bounce counter for diagnosis instance COM_3_ETCU" UBYTE _CNV_A_R_LINEAR_____0_CM 1 100. 0. 255. DISPLAY_IDENTIFIER CTR_ABC_COM_3_ETCU ECU_ADDRESS 0xd0009550 FORMAT "%3.0" /end MEASUREMENT
/begin MEASUREMENT fmy_stat_com_3_etcu.ctr_end_diag "counter for end of diagnosis for diagnosis instance COM_3_ETCU" UBYTE _CNV_A_R_LINEAR_____0_CM 1 100. 0. 255. DISPLAY_IDENTIFIER CTR_ABC_END_DIAG_COM_3_ETCU ECU_ADDRESS 0xd0009551 FORMAT "%3.0" /end MEASUREMENT
/begin MEASUREMENT fmy_stat_com_3_etcu.err_info_stat.lv_err_mem "storage in dynamic failure memory of the diagnosis instance COM_3_ETCU" UWORD _CNV_S_2_RANGE__0___1_CM 1 100. 0. 1. DISPLAY_IDENTIFIER LV_ERR_MEM_COM_3_ETCU ECU_ADDRESS 0xd0009552 BIT_MASK 0x8 /end MEASUREMENT
/begin MEASUREMENT fmy_stat_com_3_etcu.err_info_stat.lv_ready "readiness status of the diagnosis instance COM_3_ETCU" UWORD _CNV_S_2_RANGE__0___1_CM 1 100. 0. 1. DISPLAY_IDENTIFIER LV_READY_COM_3_ETCU ECU_ADDRESS 0xd0009552 BIT_MASK 0x10 /end MEASUREMENT
/begin MEASUREMENT fmy_stat_com_3_etcu.err_info_stat.lv_end_diag "end of diagnosis of the diagnosis instance COM_3_ETCU" UWORD _CNV_S_2_RANGE__0___1_CM 1 100. 0. 1. DISPLAY_IDENTIFIER LV_END_DIAG_COM_3_ETCU ECU_ADDRESS 0xd0009552 BIT_MASK 0x20 /end MEASUREMENT
/begin MEASUREMENT fmy_stat_com_3_etcu.err_info_stat.lv_cdn_diag "diagnosis condition of the diagnosis instance COM_3_ETCU" UWORD _CNV_S_2_RANGE__0___1_CM 1 100. 0. 1. DISPLAY_IDENTIFIER LV_CDN_DIAG_COM_3_ETCU ECU_ADDRESS 0xd0009552 BIT_MASK 0x40 /end MEASUREMENT
/begin MEASUREMENT fmy_stat_com_3_etcu.err_info_stat.err_sym "symptoms of the diagnosis instance COM_3_ETCU" UWORD _CNV_S_16_RANGE_ERR__349_CM 1 100. 0. 15. DISPLAY_IDENTIFIER ERR_SYM_COM_3_ETCU ECU_ADDRESS 0xd0009552 BIT_MASK 0x780 /end MEASUREMENT
/begin MEASUREMENT fmy_stat_com_3_etcu_disp.ctr_abc "anti bounce counter for diagnosis instance COM_3_ETCU_DISP" UBYTE _CNV_A_R_LINEAR_____0_CM 1 100. 0. 255. DISPLAY_IDENTIFIER CTR_ABC_COM_3_ETCU_DISP ECU_ADDRESS 0xd0009554 FORMAT "%3.0" /end MEASUREMENT
/begin MEASUREMENT fmy_stat_com_3_etcu_disp.ctr_end_diag "counter for end of diagnosis for diagnosis instance COM_3_ETCU_DISP" UBYTE _CNV_A_R_LINEAR_____0_CM 1 100. 0. 255. DISPLAY_IDENTIFIER CTR_ABC_END_DIAG_COM_3_ETCU_DISP ECU_ADDRESS 0xd0009555 FORMAT "%3.0" /end MEASUREMENT
/begin MEASUREMENT fmy_stat_com_3_etcu_disp.err_info_stat.lv_err_mem "storage in dynamic failure memory of the diagnosis instance COM_3_ETCU_DISP" UWORD _CNV_S_2_RANGE__0___1_CM 1 100. 0. 1. DISPLAY_IDENTIFIER LV_ERR_MEM_COM_3_ETCU_DISP ECU_ADDRESS 0xd0009556 BIT_MASK 0x8 /end MEASUREMENT
/begin MEASUREMENT fmy_stat_com_3_etcu_disp.err_info_stat.lv_ready "readiness status of the diagnosis instance COM_3_ETCU_DISP" UWORD _CNV_S_2_RANGE__0___1_CM 1 100. 0. 1. DISPLAY_IDENTIFIER LV_READY_COM_3_ETCU_DISP ECU_ADDRESS 0xd0009556 BIT_MASK 0x10 /end MEASUREMENT
/begin MEASUREMENT fmy_stat_com_3_etcu_disp.err_info_stat.lv_end_diag "end of diagnosis of the diagnosis instance COM_3_ETCU_DISP" UWORD _CNV_S_2_RANGE__0___1_CM 1 100. 0. 1. DISPLAY_IDENTIFIER LV_END_DIAG_COM_3_ETCU_DISP ECU_ADDRESS 0xd0009556 BIT_MASK 0x20 /end MEASUREMENT
/begin MEASUREMENT fmy_stat_com_3_etcu_disp.err_info_stat.lv_cdn_diag "diagnosis condition of the diagnosis instance COM_3_ETCU_DISP" UWORD _CNV_S_2_RANGE__0___1_CM 1 100. 0. 1. DISPLAY_IDENTIFIER LV_CDN_DIAG_COM_3_ETCU_DISP ECU_ADDRESS 0xd0009556 BIT_MASK 0x40 /end MEASUREMENT
/begin MEASUREMENT fmy_stat_com_3_etcu_disp.err_info_stat.err_sym "symptoms of the diagnosis instance COM_3_ETCU_DISP" UWORD _CNV_S_16_RANGE_ERR__349_CM 1 100. 0. 15. DISPLAY_IDENTIFIER ERR_SYM_COM_3_ETCU_DISP ECU_ADDRESS 0xd0009556 BIT_MASK 0x780 /end MEASUREMENT
/begin MEASUREMENT fmy_stat_com_3_etcu_obd.ctr_abc "anti bounce counter for diagnosis instance COM_3_ETCU_OBD" UBYTE _CNV_A_R_LINEAR_____0_CM 1 100. 0. 255. DISPLAY_IDENTIFIER CTR_ABC_COM_3_ETCU_OBD ECU_ADDRESS 0xd0009558 FORMAT "%3.0" /end MEASUREMENT
/begin MEASUREMENT fmy_stat_com_3_etcu_obd.ctr_end_diag "counter for end of diagnosis for diagnosis instance COM_3_ETCU_OBD" UBYTE _CNV_A_R_LINEAR_____0_CM 1 100. 0. 255. DISPLAY_IDENTIFIER CTR_ABC_END_DIAG_COM_3_ETCU_OBD ECU_ADDRESS 0xd0009559 FORMAT "%3.0" /end MEASUREMENT
/begin MEASUREMENT fmy_stat_com_3_etcu_obd.err_info_stat.lv_err_mem "storage in dynamic failure memory of the diagnosis instance COM_3_ETCU_OBD" UWORD _CNV_S_2_RANGE__0___1_CM 1 100. 0. 1. DISPLAY_IDENTIFIER LV_ERR_MEM_COM_3_ETCU_OBD ECU_ADDRESS 0xd000955a BIT_MASK 0x8 /end MEASUREMENT
/begin MEASUREMENT fmy_stat_com_3_etcu_obd.err_info_stat.lv_ready "readiness status of the diagnosis instance COM_3_ETCU_OBD" UWORD _CNV_S_2_RANGE__0___1_CM 1 100. 0. 1. DISPLAY_IDENTIFIER LV_READY_COM_3_ETCU_OBD ECU_ADDRESS 0xd000955a BIT_MASK 0x10 /end MEASUREMENT
/begin MEASUREMENT fmy_stat_com_3_etcu_obd.err_info_stat.lv_end_diag "end of diagnosis of the diagnosis instance COM_3_ETCU_OBD" UWORD _CNV_S_2_RANGE__0___1_CM 1 100. 0. 1. DISPLAY_IDENTIFIER LV_END_DIAG_COM_3_ETCU_OBD ECU_ADDRESS 0xd000955a BIT_MASK 0x20 /end MEASUREMENT
/begin MEASUREMENT fmy_stat_com_3_etcu_obd.err_info_stat.lv_cdn_diag "diagnosis condition of the diagnosis instance COM_3_ETCU_OBD" UWORD _CNV_S_2_RANGE__0___1_CM 1 100. 0. 1. DISPLAY_IDENTIFIER LV_CDN_DIAG_COM_3_ETCU_OBD ECU_ADDRESS 0xd000955a BIT_MASK 0x40 /end MEASUREMENT
/begin MEASUREMENT fmy_stat_com_3_etcu_obd.err_info_stat.err_sym "symptoms of the diagnosis instance COM_3_ETCU_OBD" UWORD _CNV_S_16_RANGE_ERR__349_CM 1 100. 0. 15. DISPLAY_IDENTIFIER ERR_SYM_COM_3_ETCU_OBD ECU_ADDRESS 0xd000955a BIT_MASK 0x780 /end MEASUREMENT
/begin MEASUREMENT fmy_stat_com_3_gb.ctr_abc "anti bounce counter for diagnosis instance COM_3_GB" UBYTE _CNV_A_R_LINEAR_____0_CM 1 100. 0. 255. DISPLAY_IDENTIFIER CTR_ABC_COM_3_GB ECU_ADDRESS 0xd000955c FORMAT "%3.0" /end MEASUREMENT
/begin MEASUREMENT fmy_stat_com_3_gb.ctr_end_diag "counter for end of diagnosis for diagnosis instance COM_3_GB" UBYTE _CNV_A_R_LINEAR_____0_CM 1 100. 0. 255. DISPLAY_IDENTIFIER CTR_ABC_END_DIAG_COM_3_GB ECU_ADDRESS 0xd000955d FORMAT "%3.0" /end MEASUREMENT
/begin MEASUREMENT fmy_stat_com_3_gb.err_info_stat.lv_err_mem "storage in dynamic failure memory of the diagnosis instance COM_3_GB" UWORD _CNV_S_2_RANGE__0___1_CM 1 100. 0. 1. DISPLAY_IDENTIFIER LV_ERR_MEM_COM_3_GB ECU_ADDRESS 0xd000955e BIT_MASK 0x8 /end MEASUREMENT
/begin MEASUREMENT fmy_stat_com_3_gb.err_info_stat.lv_ready "readiness status of the diagnosis instance COM_3_GB" UWORD _CNV_S_2_RANGE__0___1_CM 1 100. 0. 1. DISPLAY_IDENTIFIER LV_READY_COM_3_GB ECU_ADDRESS 0xd000955e BIT_MASK 0x10 /end MEASUREMENT
/begin MEASUREMENT fmy_stat_com_3_gb.err_info_stat.lv_end_diag "end of diagnosis of the diagnosis instance COM_3_GB" UWORD _CNV_S_2_RANGE__0___1_CM 1 100. 0. 1. DISPLAY_IDENTIFIER LV_END_DIAG_COM_3_GB ECU_ADDRESS 0xd000955e BIT_MASK 0x20 /end MEASUREMENT
/begin MEASUREMENT fmy_stat_com_3_gb.err_info_stat.lv_cdn_diag "diagnosis condition of the diagnosis instance COM_3_GB" UWORD _CNV_S_2_RANGE__0___1_CM 1 100. 0. 1. DISPLAY_IDENTIFIER LV_CDN_DIAG_COM_3_GB ECU_ADDRESS 0xd000955e BIT_MASK 0x40 /end MEASUREMENT
/begin MEASUREMENT fmy_stat_com_3_gb.err_info_stat.err_sym "symptoms of the diagnosis instance COM_3_GB" UWORD _CNV_S_16_RANGE_ERR__349_CM 1 100. 0. 15. DISPLAY_IDENTIFIER ERR_SYM_COM_3_GB ECU_ADDRESS 0xd000955e BIT_MASK 0x780 /end MEASUREMENT
/begin MEASUREMENT fmy_stat_teg_sens_1.ctr_abc "anti bounce counter for diagnosis instance TEG_SENS_1" UBYTE _CNV_A_R_LINEAR_____0_CM 1 100. 0. 255. DISPLAY_IDENTIFIER CTR_ABC_TEG_SENS_1 ECU_ADDRESS 0xd0009a34 FORMAT "%3.0" /end MEASUREMENT
/begin MEASUREMENT fmy_stat_teg_sens_1.ctr_end_diag "counter for end of diagnosis for diagnosis instance TEG_SENS_1" UBYTE _CNV_A_R_LINEAR_____0_CM 1 100. 0. 255. DISPLAY_IDENTIFIER CTR_ABC_END_DIAG_TEG_SENS_1 ECU_ADDRESS 0xd0009a35 FORMAT "%3.0" /end MEASUREMENT
/begin MEASUREMENT fmy_stat_teg_sens_1.err_info_stat.lv_err_mem "storage in dynamic failure memory of the diagnosis instance TEG_SENS_1" UWORD _CNV_S_2_RANGE__0___1_CM 1 100. 0. 1. DISPLAY_IDENTIFIER LV_ERR_MEM_TEG_SENS_1 ECU_ADDRESS 0xd0009a36 BIT_MASK 0x8 /end MEASUREMENT
/begin MEASUREMENT fmy_stat_teg_sens_1.err_info_stat.lv_ready "readiness status of the diagnosis instance TEG_SENS_1" UWORD _CNV_S_2_RANGE__0___1_CM 1 100. 0. 1. DISPLAY_IDENTIFIER LV_READY_TEG_SENS_1 ECU_ADDRESS 0xd0009a36 BIT_MASK 0x10 /end MEASUREMENT
/begin MEASUREMENT fmy_stat_teg_sens_1.err_info_stat.lv_end_diag "end of diagnosis of the diagnosis instance TEG_SENS_1" UWORD _CNV_S_2_RANGE__0___1_CM 1 100. 0. 1. DISPLAY_IDENTIFIER LV_END_DIAG_TEG_SENS_1 ECU_ADDRESS 0xd0009a36 BIT_MASK 0x20 /end MEASUREMENT
/begin MEASUREMENT fmy_stat_teg_sens_1.err_info_stat.lv_cdn_diag "diagnosis condition of the diagnosis instance TEG_SENS_1" UWORD _CNV_S_2_RANGE__0___1_CM 1 100. 0. 1. DISPLAY_IDENTIFIER LV_CDN_DIAG_TEG_SENS_1 ECU_ADDRESS 0xd0009a36 BIT_MASK 0x40 /end MEASUREMENT
/begin MEASUREMENT fmy_stat_teg_sens_1.err_info_stat.err_sym "symptoms of the diagnosis instance TEG_SENS_1" UWORD _CNV_S_16_RANGE_ERR__349_CM 1 100. 0. 15. DISPLAY_IDENTIFIER ERR_SYM_TEG_SENS_1 ECU_ADDRESS 0xd0009a36 BIT_MASK 0x780 /end MEASUREMENT
/begin MEASUREMENT fmy_stat_teg_sens_2.ctr_abc "anti bounce counter for diagnosis instance TEG_SENS_2" UBYTE _CNV_A_R_LINEAR_____0_CM 1 100. 0. 255. DISPLAY_IDENTIFIER CTR_ABC_TEG_SENS_2 ECU_ADDRESS 0xd0009a38 FORMAT "%3.0" /end MEASUREMENT
/begin MEASUREMENT fmy_stat_teg_sens_2.ctr_end_diag "counter for end of diagnosis for diagnosis instance TEG_SENS_2" UBYTE _CNV_A_R_LINEAR_____0_CM 1 100. 0. 255. DISPLAY_IDENTIFIER CTR_ABC_END_DIAG_TEG_SENS_2 ECU_ADDRESS 0xd0009a39 FORMAT "%3.0" /end MEASUREMENT
/begin MEASUREMENT fmy_stat_teg_sens_2.err_info_stat.lv_err_mem "storage in dynamic failure memory of the diagnosis instance TEG_SENS_2" UWORD _CNV_S_2_RANGE__0___1_CM 1 100. 0. 1. DISPLAY_IDENTIFIER LV_ERR_MEM_TEG_SENS_2 ECU_ADDRESS 0xd0009a3a BIT_MASK 0x8 /end MEASUREMENT
/begin MEASUREMENT fmy_stat_teg_sens_2.err_info_stat.lv_ready "readiness status of the diagnosis instance TEG_SENS_2" UWORD _CNV_S_2_RANGE__0___1_CM 1 100. 0. 1. DISPLAY_IDENTIFIER LV_READY_TEG_SENS_2 ECU_ADDRESS 0xd0009a3a BIT_MASK 0x10 /end MEASUREMENT
/begin MEASUREMENT fmy_stat_teg_sens_2.err_info_stat.lv_end_diag "end of diagnosis of the diagnosis instance TEG_SENS_2" UWORD _CNV_S_2_RANGE__0___1_CM 1 100. 0. 1. DISPLAY_IDENTIFIER LV_END_DIAG_TEG_SENS_2 ECU_ADDRESS 0xd0009a3a BIT_MASK 0x20 /end MEASUREMENT
/begin MEASUREMENT fmy_stat_teg_sens_2.err_info_stat.lv_cdn_diag "diagnosis condition of the diagnosis instance TEG_SENS_2" UWORD _CNV_S_2_RANGE__0___1_CM 1 100. 0. 1. DISPLAY_IDENTIFIER LV_CDN_DIAG_TEG_SENS_2 ECU_ADDRESS 0xd0009a3a BIT_MASK 0x40 /end MEASUREMENT
/begin MEASUREMENT fmy_stat_teg_sens_2.err_info_stat.err_sym "symptoms of the diagnosis instance TEG_SENS_2" UWORD _CNV_S_16_RANGE_ERR__349_CM 1 100. 0. 15. DISPLAY_IDENTIFIER ERR_SYM_TEG_SENS_2 ECU_ADDRESS 0xd0009a3a BIT_MASK 0x780 /end MEASUREMENT
/begin MEASUREMENT fmy_stat_amp_plaus_cus.ctr_abc "anti bounce counter for diagnosis instance AMP_PLAUS_CUS" UBYTE _CNV_A_R_LINEAR_____0_CM 1 100. 0. 255. DISPLAY_IDENTIFIER CTR_ABC_AMP_PLAUS_CUS ECU_ADDRESS 0xd00093e4 FORMAT "%3.0" /end MEASUREMENT
/begin MEASUREMENT fmy_stat_amp_plaus_cus.ctr_end_diag "counter for end of diagnosis for diagnosis instance AMP_PLAUS_CUS" UBYTE _CNV_A_R_LINEAR_____0_CM 1 100. 0. 255. DISPLAY_IDENTIFIER CTR_ABC_END_DIAG_AMP_PLAUS_CUS ECU_ADDRESS 0xd00093e5 FORMAT "%3.0" /end MEASUREMENT
/begin MEASUREMENT fmy_stat_amp_plaus_cus.err_info_stat.lv_err_mem "storage in dynamic failure memory of the diagnosis instance AMP_PLAUS_CUS" UWORD _CNV_S_2_RANGE__0___1_CM 1 100. 0. 1. DISPLAY_IDENTIFIER LV_ERR_MEM_AMP_PLAUS_CUS ECU_ADDRESS 0xd00093e6 BIT_MASK 0x8 /end MEASUREMENT
/begin MEASUREMENT fmy_stat_amp_plaus_cus.err_info_stat.lv_ready "readiness status of the diagnosis instance AMP_PLAUS_CUS" UWORD _CNV_S_2_RANGE__0___1_CM 1 100. 0. 1. DISPLAY_IDENTIFIER LV_READY_AMP_PLAUS_CUS ECU_ADDRESS 0xd00093e6 BIT_MASK 0x10 /end MEASUREMENT
/begin MEASUREMENT fmy_stat_amp_plaus_cus.err_info_stat.lv_end_diag "end of diagnosis of the diagnosis instance AMP_PLAUS_CUS" UWORD _CNV_S_2_RANGE__0___1_CM 1 100. 0. 1. DISPLAY_IDENTIFIER LV_END_DIAG_AMP_PLAUS_CUS ECU_ADDRESS 0xd00093e6 BIT_MASK 0x20 /end MEASUREMENT
/begin MEASUREMENT fmy_stat_amp_plaus_cus.err_info_stat.lv_cdn_diag "diagnosis condition of the diagnosis instance AMP_PLAUS_CUS" UWORD _CNV_S_2_RANGE__0___1_CM 1 100. 0. 1. DISPLAY_IDENTIFIER LV_CDN_DIAG_AMP_PLAUS_CUS ECU_ADDRESS 0xd00093e6 BIT_MASK 0x40 /end MEASUREMENT
/begin MEASUREMENT fmy_stat_amp_plaus_cus.err_info_stat.err_sym "symptoms of the diagnosis instance AMP_PLAUS_CUS" UWORD _CNV_S_16_RANGE_ERR__349_CM 1 100. 0. 15. DISPLAY_IDENTIFIER ERR_SYM_AMP_PLAUS_CUS ECU_ADDRESS 0xd00093e6 BIT_MASK 0x780 /end MEASUREMENT
/begin MEASUREMENT fmy_stat_tcha_prs_low.ctr_abc "anti bounce counter for diagnosis instance TCHA_PRS_LOW" UBYTE _CNV_A_R_LINEAR_____0_CM 1 100. 0. 255. DISPLAY_IDENTIFIER CTR_ABC_TCHA_PRS_LOW ECU_ADDRESS 0xd0009a08 FORMAT "%3.0" /end MEASUREMENT
/begin MEASUREMENT fmy_stat_tcha_prs_low.ctr_end_diag "counter for end of diagnosis for diagnosis instance TCHA_PRS_LOW" UBYTE _CNV_A_R_LINEAR_____0_CM 1 100. 0. 255. DISPLAY_IDENTIFIER CTR_ABC_END_DIAG_TCHA_PRS_LOW ECU_ADDRESS 0xd0009a09 FORMAT "%3.0" /end MEASUREMENT
/begin MEASUREMENT fmy_stat_tcha_prs_low.err_info_stat.lv_err_mem "storage in dynamic failure memory of the diagnosis instance TCHA_PRS_LOW" UWORD _CNV_S_2_RANGE__0___1_CM 1 100. 0. 1. DISPLAY_IDENTIFIER LV_ERR_MEM_TCHA_PRS_LOW ECU_ADDRESS 0xd0009a0a BIT_MASK 0x8 /end MEASUREMENT
/begin MEASUREMENT fmy_stat_tcha_prs_low.err_info_stat.lv_ready "readiness status of the diagnosis instance TCHA_PRS_LOW" UWORD _CNV_S_2_RANGE__0___1_CM 1 100. 0. 1. DISPLAY_IDENTIFIER LV_READY_TCHA_PRS_LOW ECU_ADDRESS 0xd0009a0a BIT_MASK 0x10 /end MEASUREMENT
/begin MEASUREMENT fmy_stat_tcha_prs_low.err_info_stat.lv_end_diag "end of diagnosis of the diagnosis instance TCHA_PRS_LOW" UWORD _CNV_S_2_RANGE__0___1_CM 1 100. 0. 1. DISPLAY_IDENTIFIER LV_END_DIAG_TCHA_PRS_LOW ECU_ADDRESS 0xd0009a0a BIT_MASK 0x20 /end MEASUREMENT
/begin MEASUREMENT fmy_stat_tcha_prs_low.err_info_stat.lv_cdn_diag "diagnosis condition of the diagnosis instance TCHA_PRS_LOW" UWORD _CNV_S_2_RANGE__0___1_CM 1 100. 0. 1. DISPLAY_IDENTIFIER LV_CDN_DIAG_TCHA_PRS_LOW ECU_ADDRESS 0xd0009a0a BIT_MASK 0x40 /end MEASUREMENT
/begin MEASUREMENT fmy_stat_tcha_prs_low.err_info_stat.err_sym "symptoms of the diagnosis instance TCHA_PRS_LOW" UWORD _CNV_S_16_RANGE_ERR__349_CM 1 100. 0. 15. DISPLAY_IDENTIFIER ERR_SYM_TCHA_PRS_LOW ECU_ADDRESS 0xd0009a0a BIT_MASK 0x780 /end MEASUREMENT
/begin MEASUREMENT fmy_stat_tcha_leak.ctr_abc "anti bounce counter for diagnosis instance TCHA_LEAK" UBYTE _CNV_A_R_LINEAR_____0_CM 1 100. 0. 255. DISPLAY_IDENTIFIER CTR_ABC_TCHA_LEAK ECU_ADDRESS 0xd00099fc FORMAT "%3.0" /end MEASUREMENT
/begin MEASUREMENT fmy_stat_tcha_leak.ctr_end_diag "counter for end of diagnosis for diagnosis instance TCHA_LEAK" UBYTE _CNV_A_R_LINEAR_____0_CM 1 100. 0. 255. DISPLAY_IDENTIFIER CTR_ABC_END_DIAG_TCHA_LEAK ECU_ADDRESS 0xd00099fd FORMAT "%3.0" /end MEASUREMENT
/begin MEASUREMENT fmy_stat_tcha_leak.err_info_stat.lv_err_mem "storage in dynamic failure memory of the diagnosis instance TCHA_LEAK" UWORD _CNV_S_2_RANGE__0___1_CM 1 100. 0. 1. DISPLAY_IDENTIFIER LV_ERR_MEM_TCHA_LEAK ECU_ADDRESS 0xd00099fe BIT_MASK 0x8 /end MEASUREMENT
/begin MEASUREMENT fmy_stat_tcha_leak.err_info_stat.lv_ready "readiness status of the diagnosis instance TCHA_LEAK" UWORD _CNV_S_2_RANGE__0___1_CM 1 100. 0. 1. DISPLAY_IDENTIFIER LV_READY_TCHA_LEAK ECU_ADDRESS 0xd00099fe BIT_MASK 0x10 /end MEASUREMENT
/begin MEASUREMENT fmy_stat_tcha_leak.err_info_stat.lv_end_diag "end of diagnosis of the diagnosis instance TCHA_LEAK" UWORD _CNV_S_2_RANGE__0___1_CM 1 100. 0. 1. DISPLAY_IDENTIFIER LV_END_DIAG_TCHA_LEAK ECU_ADDRESS 0xd00099fe BIT_MASK 0x20 /end MEASUREMENT
/begin MEASUREMENT fmy_stat_tcha_leak.err_info_stat.lv_cdn_diag "diagnosis condition of the diagnosis instance TCHA_LEAK" UWORD _CNV_S_2_RANGE__0___1_CM 1 100. 0. 1. DISPLAY_IDENTIFIER LV_CDN_DIAG_TCHA_LEAK ECU_ADDRESS 0xd00099fe BIT_MASK 0x40 /end MEASUREMENT
/begin MEASUREMENT fmy_stat_tcha_leak.err_info_stat.err_sym "symptoms of the diagnosis instance TCHA_LEAK" UWORD _CNV_S_16_RANGE_ERR__349_CM 1 100. 0. 15. DISPLAY_IDENTIFIER ERR_SYM_TCHA_LEAK ECU_ADDRESS 0xd00099fe BIT_MASK 0x780 /end MEASUREMENT
/begin MEASUREMENT fmy_stat_tcha_prs_dif.ctr_abc "anti bounce counter for diagnosis instance TCHA_PRS_DIF" UBYTE _CNV_A_R_LINEAR_____0_CM 1 100. 0. 255. DISPLAY_IDENTIFIER CTR_ABC_TCHA_PRS_DIF ECU_ADDRESS 0xd0009a00 FORMAT "%3.0" /end MEASUREMENT
/begin MEASUREMENT fmy_stat_tcha_prs_dif.ctr_end_diag "counter for end of diagnosis for diagnosis instance TCHA_PRS_DIF" UBYTE _CNV_A_R_LINEAR_____0_CM 1 100. 0. 255. DISPLAY_IDENTIFIER CTR_ABC_END_DIAG_TCHA_PRS_DIF ECU_ADDRESS 0xd0009a01 FORMAT "%3.0" /end MEASUREMENT
/begin MEASUREMENT fmy_stat_tcha_prs_dif.err_info_stat.lv_err_mem "storage in dynamic failure memory of the diagnosis instance TCHA_PRS_DIF" UWORD _CNV_S_2_RANGE__0___1_CM 1 100. 0. 1. DISPLAY_IDENTIFIER LV_ERR_MEM_TCHA_PRS_DIF ECU_ADDRESS 0xd0009a02 BIT_MASK 0x8 /end MEASUREMENT
/begin MEASUREMENT fmy_stat_tcha_prs_dif.err_info_stat.lv_ready "readiness status of the diagnosis instance TCHA_PRS_DIF" UWORD _CNV_S_2_RANGE__0___1_CM 1 100. 0. 1. DISPLAY_IDENTIFIER LV_READY_TCHA_PRS_DIF ECU_ADDRESS 0xd0009a02 BIT_MASK 0x10 /end MEASUREMENT
/begin MEASUREMENT fmy_stat_tcha_prs_dif.err_info_stat.lv_end_diag "end of diagnosis of the diagnosis instance TCHA_PRS_DIF" UWORD _CNV_S_2_RANGE__0___1_CM 1 100. 0. 1. DISPLAY_IDENTIFIER LV_END_DIAG_TCHA_PRS_DIF ECU_ADDRESS 0xd0009a02 BIT_MASK 0x20 /end MEASUREMENT
/begin MEASUREMENT fmy_stat_tcha_prs_dif.err_info_stat.lv_cdn_diag "diagnosis condition of the diagnosis instance TCHA_PRS_DIF" UWORD _CNV_S_2_RANGE__0___1_CM 1 100. 0. 1. DISPLAY_IDENTIFIER LV_CDN_DIAG_TCHA_PRS_DIF ECU_ADDRESS 0xd0009a02 BIT_MASK 0x40 /end MEASUREMENT
/begin MEASUREMENT fmy_stat_tcha_prs_dif.err_info_stat.err_sym "symptoms of the diagnosis instance TCHA_PRS_DIF" UWORD _CNV_S_16_RANGE_ERR__349_CM 1 100. 0. 15. DISPLAY_IDENTIFIER ERR_SYM_TCHA_PRS_DIF ECU_ADDRESS 0xd0009a02 BIT_MASK 0x780 /end MEASUREMENT
/begin MEASUREMENT fmy_stat_tcha_prs_high.ctr_abc "anti bounce counter for diagnosis instance TCHA_PRS_HIGH" UBYTE _CNV_A_R_LINEAR_____0_CM 1 100. 0. 255. DISPLAY_IDENTIFIER CTR_ABC_TCHA_PRS_HIGH ECU_ADDRESS 0xd0009a04 FORMAT "%3.0" /end MEASUREMENT
/begin MEASUREMENT fmy_stat_tcha_prs_high.ctr_end_diag "counter for end of diagnosis for diagnosis instance TCHA_PRS_HIGH" UBYTE _CNV_A_R_LINEAR_____0_CM 1 100. 0. 255. DISPLAY_IDENTIFIER CTR_ABC_END_DIAG_TCHA_PRS_HIGH ECU_ADDRESS 0xd0009a05 FORMAT "%3.0" /end MEASUREMENT
/begin MEASUREMENT fmy_stat_tcha_prs_high.err_info_stat.lv_err_mem "storage in dynamic failure memory of the diagnosis instance TCHA_PRS_HIGH" UWORD _CNV_S_2_RANGE__0___1_CM 1 100. 0. 1. DISPLAY_IDENTIFIER LV_ERR_MEM_TCHA_PRS_HIGH ECU_ADDRESS 0xd0009a06 BIT_MASK 0x8 /end MEASUREMENT
/begin MEASUREMENT fmy_stat_tcha_prs_high.err_info_stat.lv_ready "readiness status of the diagnosis instance TCHA_PRS_HIGH" UWORD _CNV_S_2_RANGE__0___1_CM 1 100. 0. 1. DISPLAY_IDENTIFIER LV_READY_TCHA_PRS_HIGH ECU_ADDRESS 0xd0009a06 BIT_MASK 0x10 /end MEASUREMENT
/begin MEASUREMENT fmy_stat_tcha_prs_high.err_info_stat.lv_end_diag "end of diagnosis of the diagnosis instance TCHA_PRS_HIGH" UWORD _CNV_S_2_RANGE__0___1_CM 1 100. 0. 1. DISPLAY_IDENTIFIER LV_END_DIAG_TCHA_PRS_HIGH ECU_ADDRESS 0xd0009a06 BIT_MASK 0x20 /end MEASUREMENT
/begin MEASUREMENT fmy_stat_tcha_prs_high.err_info_stat.lv_cdn_diag "diagnosis condition of the diagnosis instance TCHA_PRS_HIGH" UWORD _CNV_S_2_RANGE__0___1_CM 1 100. 0. 1. DISPLAY_IDENTIFIER LV_CDN_DIAG_TCHA_PRS_HIGH ECU_ADDRESS 0xd0009a06 BIT_MASK 0x40 /end MEASUREMENT
/begin MEASUREMENT fmy_stat_tcha_prs_high.err_info_stat.err_sym "symptoms of the diagnosis instance TCHA_PRS_HIGH" UWORD _CNV_S_16_RANGE_ERR__349_CM 1 100. 0. 15. DISPLAY_IDENTIFIER ERR_SYM_TCHA_PRS_HIGH ECU_ADDRESS 0xd0009a06 BIT_MASK 0x780 /end MEASUREMENT
/begin MEASUREMENT fmy_stat_put_plaus.ctr_abc "anti bounce counter for diagnosis instance PUT_PLAUS" UBYTE _CNV_A_R_LINEAR_____0_CM 1 100. 0. 255. DISPLAY_IDENTIFIER CTR_ABC_PUT_PLAUS ECU_ADDRESS 0xd000990c FORMAT "%3.0" /end MEASUREMENT
/begin MEASUREMENT fmy_stat_put_plaus.ctr_end_diag "counter for end of diagnosis for diagnosis instance PUT_PLAUS" UBYTE _CNV_A_R_LINEAR_____0_CM 1 100. 0. 255. DISPLAY_IDENTIFIER CTR_ABC_END_DIAG_PUT_PLAUS ECU_ADDRESS 0xd000990d FORMAT "%3.0" /end MEASUREMENT
/begin MEASUREMENT fmy_stat_put_plaus.err_info_stat.lv_err_mem "storage in dynamic failure memory of the diagnosis instance PUT_PLAUS" UWORD _CNV_S_2_RANGE__0___1_CM 1 100. 0. 1. DISPLAY_IDENTIFIER LV_ERR_MEM_PUT_PLAUS ECU_ADDRESS 0xd000990e BIT_MASK 0x8 /end MEASUREMENT
/begin MEASUREMENT fmy_stat_put_plaus.err_info_stat.lv_ready "readiness status of the diagnosis instance PUT_PLAUS" UWORD _CNV_S_2_RANGE__0___1_CM 1 100. 0. 1. DISPLAY_IDENTIFIER LV_READY_PUT_PLAUS ECU_ADDRESS 0xd000990e BIT_MASK 0x10 /end MEASUREMENT
/begin MEASUREMENT fmy_stat_put_plaus.err_info_stat.lv_end_diag "end of diagnosis of the diagnosis instance PUT_PLAUS" UWORD _CNV_S_2_RANGE__0___1_CM 1 100. 0. 1. DISPLAY_IDENTIFIER LV_END_DIAG_PUT_PLAUS ECU_ADDRESS 0xd000990e BIT_MASK 0x20 /end MEASUREMENT
/begin MEASUREMENT fmy_stat_put_plaus.err_info_stat.lv_cdn_diag "diagnosis condition of the diagnosis instance PUT_PLAUS" UWORD _CNV_S_2_RANGE__0___1_CM 1 100. 0. 1. DISPLAY_IDENTIFIER LV_CDN_DIAG_PUT_PLAUS ECU_ADDRESS 0xd000990e BIT_MASK 0x40 /end MEASUREMENT
/begin MEASUREMENT fmy_stat_put_plaus.err_info_stat.err_sym "symptoms of the diagnosis instance PUT_PLAUS" UWORD _CNV_S_16_RANGE_ERR__349_CM 1 100. 0. 15. DISPLAY_IDENTIFIER ERR_SYM_PUT_PLAUS ECU_ADDRESS 0xd000990e BIT_MASK 0x780 /end MEASUREMENT
/begin MEASUREMENT fmy_stat_map_plaus.ctr_abc "anti bounce counter for diagnosis instance MAP_PLAUS" UBYTE _CNV_A_R_LINEAR_____0_CM 1 100. 0. 255. DISPLAY_IDENTIFIER CTR_ABC_MAP_PLAUS ECU_ADDRESS 0xd000980c FORMAT "%3.0" /end MEASUREMENT
/begin MEASUREMENT fmy_stat_map_plaus.ctr_end_diag "counter for end of diagnosis for diagnosis instance MAP_PLAUS" UBYTE _CNV_A_R_LINEAR_____0_CM 1 100. 0. 255. DISPLAY_IDENTIFIER CTR_ABC_END_DIAG_MAP_PLAUS ECU_ADDRESS 0xd000980d FORMAT "%3.0" /end MEASUREMENT
/begin MEASUREMENT fmy_stat_map_plaus.err_info_stat.lv_err_mem "storage in dynamic failure memory of the diagnosis instance MAP_PLAUS" UWORD _CNV_S_2_RANGE__0___1_CM 1 100. 0. 1. DISPLAY_IDENTIFIER LV_ERR_MEM_MAP_PLAUS ECU_ADDRESS 0xd000980e BIT_MASK 0x8 /end MEASUREMENT
/begin MEASUREMENT fmy_stat_map_plaus.err_info_stat.lv_ready "readiness status of the diagnosis instance MAP_PLAUS" UWORD _CNV_S_2_RANGE__0___1_CM 1 100. 0. 1. DISPLAY_IDENTIFIER LV_READY_MAP_PLAUS ECU_ADDRESS 0xd000980e BIT_MASK 0x10 /end MEASUREMENT
/begin MEASUREMENT fmy_stat_map_plaus.err_info_stat.lv_end_diag "end of diagnosis of the diagnosis instance MAP_PLAUS" UWORD _CNV_S_2_RANGE__0___1_CM 1 100. 0. 1. DISPLAY_IDENTIFIER LV_END_DIAG_MAP_PLAUS ECU_ADDRESS 0xd000980e BIT_MASK 0x20 /end MEASUREMENT
/begin MEASUREMENT fmy_stat_map_plaus.err_info_stat.lv_cdn_diag "diagnosis condition of the diagnosis instance MAP_PLAUS" UWORD _CNV_S_2_RANGE__0___1_CM 1 100. 0. 1. DISPLAY_IDENTIFIER LV_CDN_DIAG_MAP_PLAUS ECU_ADDRESS 0xd000980e BIT_MASK 0x40 /end MEASUREMENT
/begin MEASUREMENT fmy_stat_map_plaus.err_info_stat.err_sym "symptoms of the diagnosis instance MAP_PLAUS" UWORD _CNV_S_16_RANGE_ERR__349_CM 1 100. 0. 15. DISPLAY_IDENTIFIER ERR_SYM_MAP_PLAUS ECU_ADDRESS 0xd000980e BIT_MASK 0x780 /end MEASUREMENT
/begin MEASUREMENT fmy_stat_tq_cst.ctr_abc "anti bounce counter for diagnosis instance TQ_CST" UBYTE _CNV_A_R_LINEAR_____0_CM 1 100. 0. 255. DISPLAY_IDENTIFIER CTR_ABC_TQ_CST ECU_ADDRESS 0xd0009ab4 FORMAT "%3.0" /end MEASUREMENT
/begin MEASUREMENT fmy_stat_tq_cst.ctr_end_diag "counter for end of diagnosis for diagnosis instance TQ_CST" UBYTE _CNV_A_R_LINEAR_____0_CM 1 100. 0. 255. DISPLAY_IDENTIFIER CTR_ABC_END_DIAG_TQ_CST ECU_ADDRESS 0xd0009ab5 FORMAT "%3.0" /end MEASUREMENT
/begin MEASUREMENT fmy_stat_tq_cst.err_info_stat.lv_err_mem "storage in dynamic failure memory of the diagnosis instance TQ_CST" UWORD _CNV_S_2_RANGE__0___1_CM 1 100. 0. 1. DISPLAY_IDENTIFIER LV_ERR_MEM_TQ_CST ECU_ADDRESS 0xd0009ab6 BIT_MASK 0x8 /end MEASUREMENT
/begin MEASUREMENT fmy_stat_tq_cst.err_info_stat.lv_ready "readiness status of the diagnosis instance TQ_CST" UWORD _CNV_S_2_RANGE__0___1_CM 1 100. 0. 1. DISPLAY_IDENTIFIER LV_READY_TQ_CST ECU_ADDRESS 0xd0009ab6 BIT_MASK 0x10 /end MEASUREMENT
/begin MEASUREMENT fmy_stat_tq_cst.err_info_stat.lv_end_diag "end of diagnosis of the diagnosis instance TQ_CST" UWORD _CNV_S_2_RANGE__0___1_CM 1 100. 0. 1. DISPLAY_IDENTIFIER LV_END_DIAG_TQ_CST ECU_ADDRESS 0xd0009ab6 BIT_MASK 0x20 /end MEASUREMENT
/begin MEASUREMENT fmy_stat_tq_cst.err_info_stat.lv_cdn_diag "diagnosis condition of the diagnosis instance TQ_CST" UWORD _CNV_S_2_RANGE__0___1_CM 1 100. 0. 1. DISPLAY_IDENTIFIER LV_CDN_DIAG_TQ_CST ECU_ADDRESS 0xd0009ab6 BIT_MASK 0x40 /end MEASUREMENT
/begin MEASUREMENT fmy_stat_tq_cst.err_info_stat.err_sym "symptoms of the diagnosis instance TQ_CST" UWORD _CNV_S_16_RANGE_ERR__349_CM 1 100. 0. 15. DISPLAY_IDENTIFIER ERR_SYM_TQ_CST ECU_ADDRESS 0xd0009ab6 BIT_MASK 0x780 /end MEASUREMENT
/begin MEASUREMENT fmy_stat_gen_el.ctr_abc "anti bounce counter for diagnosis instance GEN_EL" UBYTE _CNV_A_R_LINEAR_____0_CM 1 100. 0. 255. DISPLAY_IDENTIFIER CTR_ABC_GEN_EL ECU_ADDRESS 0xd00096cc FORMAT "%3.0" /end MEASUREMENT
/begin MEASUREMENT fmy_stat_gen_el.ctr_end_diag "counter for end of diagnosis for diagnosis instance GEN_EL" UBYTE _CNV_A_R_LINEAR_____0_CM 1 100. 0. 255. DISPLAY_IDENTIFIER CTR_ABC_END_DIAG_GEN_EL ECU_ADDRESS 0xd00096cd FORMAT "%3.0" /end MEASUREMENT
/begin MEASUREMENT fmy_stat_gen_el.err_info_stat.lv_err_mem "storage in dynamic failure memory of the diagnosis instance GEN_EL" UWORD _CNV_S_2_RANGE__0___1_CM 1 100. 0. 1. DISPLAY_IDENTIFIER LV_ERR_MEM_GEN_EL ECU_ADDRESS 0xd00096ce BIT_MASK 0x8 /end MEASUREMENT
/begin MEASUREMENT fmy_stat_gen_el.err_info_stat.lv_ready "readiness status of the diagnosis instance GEN_EL" UWORD _CNV_S_2_RANGE__0___1_CM 1 100. 0. 1. DISPLAY_IDENTIFIER LV_READY_GEN_EL ECU_ADDRESS 0xd00096ce BIT_MASK 0x10 /end MEASUREMENT
/begin MEASUREMENT fmy_stat_gen_el.err_info_stat.lv_end_diag "end of diagnosis of the diagnosis instance GEN_EL" UWORD _CNV_S_2_RANGE__0___1_CM 1 100. 0. 1. DISPLAY_IDENTIFIER LV_END_DIAG_GEN_EL ECU_ADDRESS 0xd00096ce BIT_MASK 0x20 /end MEASUREMENT
/begin MEASUREMENT fmy_stat_gen_el.err_info_stat.lv_cdn_diag "diagnosis condition of the diagnosis instance GEN_EL" UWORD _CNV_S_2_RANGE__0___1_CM 1 100. 0. 1. DISPLAY_IDENTIFIER LV_CDN_DIAG_GEN_EL ECU_ADDRESS 0xd00096ce BIT_MASK 0x40 /end MEASUREMENT
/begin MEASUREMENT fmy_stat_gen_el.err_info_stat.err_sym "symptoms of the diagnosis instance GEN_EL" UWORD _CNV_S_16_RANGE_ERR__349_CM 1 100. 0. 15. DISPLAY_IDENTIFIER ERR_SYM_GEN_EL ECU_ADDRESS 0xd00096ce BIT_MASK 0x780 /end MEASUREMENT
/begin MEASUREMENT fmy_stat_gen_mec.ctr_abc "anti bounce counter for diagnosis instance GEN_MEC" UBYTE _CNV_A_R_LINEAR_____0_CM 1 100. 0. 255. DISPLAY_IDENTIFIER CTR_ABC_GEN_MEC ECU_ADDRESS 0xd00096d8 FORMAT "%3.0" /end MEASUREMENT
/begin MEASUREMENT fmy_stat_gen_mec.ctr_end_diag "counter for end of diagnosis for diagnosis instance GEN_MEC" UBYTE _CNV_A_R_LINEAR_____0_CM 1 100. 0. 255. DISPLAY_IDENTIFIER CTR_ABC_END_DIAG_GEN_MEC ECU_ADDRESS 0xd00096d9 FORMAT "%3.0" /end MEASUREMENT
/begin MEASUREMENT fmy_stat_gen_mec.err_info_stat.lv_err_mem "storage in dynamic failure memory of the diagnosis instance GEN_MEC" UWORD _CNV_S_2_RANGE__0___1_CM 1 100. 0. 1. DISPLAY_IDENTIFIER LV_ERR_MEM_GEN_MEC ECU_ADDRESS 0xd00096da BIT_MASK 0x8 /end MEASUREMENT
/begin MEASUREMENT fmy_stat_gen_mec.err_info_stat.lv_ready "readiness status of the diagnosis instance GEN_MEC" UWORD _CNV_S_2_RANGE__0___1_CM 1 100. 0. 1. DISPLAY_IDENTIFIER LV_READY_GEN_MEC ECU_ADDRESS 0xd00096da BIT_MASK 0x10 /end MEASUREMENT
/begin MEASUREMENT fmy_stat_gen_mec.err_info_stat.lv_end_diag "end of diagnosis of the diagnosis instance GEN_MEC" UWORD _CNV_S_2_RANGE__0___1_CM 1 100. 0. 1. DISPLAY_IDENTIFIER LV_END_DIAG_GEN_MEC ECU_ADDRESS 0xd00096da BIT_MASK 0x20 /end MEASUREMENT
/begin MEASUREMENT fmy_stat_gen_mec.err_info_stat.lv_cdn_diag "diagnosis condition of the diagnosis instance GEN_MEC" UWORD _CNV_S_2_RANGE__0___1_CM 1 100. 0. 1. DISPLAY_IDENTIFIER LV_CDN_DIAG_GEN_MEC ECU_ADDRESS 0xd00096da BIT_MASK 0x40 /end MEASUREMENT
/begin MEASUREMENT fmy_stat_gen_mec.err_info_stat.err_sym "symptoms of the diagnosis instance GEN_MEC" UWORD _CNV_S_16_RANGE_ERR__349_CM 1 100. 0. 15. DISPLAY_IDENTIFIER ERR_SYM_GEN_MEC ECU_ADDRESS 0xd00096da BIT_MASK 0x780 /end MEASUREMENT
/begin MEASUREMENT fmy_stat_gen_h_temp.ctr_abc "anti bounce counter for diagnosis instance GEN_H_TEMP" UBYTE _CNV_A_R_LINEAR_____0_CM 1 100. 0. 255. DISPLAY_IDENTIFIER CTR_ABC_GEN_H_TEMP ECU_ADDRESS 0xd00096d0 FORMAT "%3.0" /end MEASUREMENT
/begin MEASUREMENT fmy_stat_gen_h_temp.ctr_end_diag "counter for end of diagnosis for diagnosis instance GEN_H_TEMP" UBYTE _CNV_A_R_LINEAR_____0_CM 1 100. 0. 255. DISPLAY_IDENTIFIER CTR_ABC_END_DIAG_GEN_H_TEMP ECU_ADDRESS 0xd00096d1 FORMAT "%3.0" /end MEASUREMENT
/begin MEASUREMENT fmy_stat_gen_h_temp.err_info_stat.lv_err_mem "storage in dynamic failure memory of the diagnosis instance GEN_H_TEMP" UWORD _CNV_S_2_RANGE__0___1_CM 1 100. 0. 1. DISPLAY_IDENTIFIER LV_ERR_MEM_GEN_H_TEMP ECU_ADDRESS 0xd00096d2 BIT_MASK 0x8 /end MEASUREMENT
/begin MEASUREMENT fmy_stat_gen_h_temp.err_info_stat.lv_ready "readiness status of the diagnosis instance GEN_H_TEMP" UWORD _CNV_S_2_RANGE__0___1_CM 1 100. 0. 1. DISPLAY_IDENTIFIER LV_READY_GEN_H_TEMP ECU_ADDRESS 0xd00096d2 BIT_MASK 0x10 /end MEASUREMENT
/begin MEASUREMENT fmy_stat_gen_h_temp.err_info_stat.lv_end_diag "end of diagnosis of the diagnosis instance GEN_H_TEMP" UWORD _CNV_S_2_RANGE__0___1_CM 1 100. 0. 1. DISPLAY_IDENTIFIER LV_END_DIAG_GEN_H_TEMP ECU_ADDRESS 0xd00096d2 BIT_MASK 0x20 /end MEASUREMENT
/begin MEASUREMENT fmy_stat_gen_h_temp.err_info_stat.lv_cdn_diag "diagnosis condition of the diagnosis instance GEN_H_TEMP" UWORD _CNV_S_2_RANGE__0___1_CM 1 100. 0. 1. DISPLAY_IDENTIFIER LV_CDN_DIAG_GEN_H_TEMP ECU_ADDRESS 0xd00096d2 BIT_MASK 0x40 /end MEASUREMENT
/begin MEASUREMENT fmy_stat_gen_h_temp.err_info_stat.err_sym "symptoms of the diagnosis instance GEN_H_TEMP" UWORD _CNV_S_16_RANGE_ERR__349_CM 1 100. 0. 15. DISPLAY_IDENTIFIER ERR_SYM_GEN_H_TEMP ECU_ADDRESS 0xd00096d2 BIT_MASK 0x780 /end MEASUREMENT
/begin MEASUREMENT fmy_stat_gen_typ_not_plaus.ctr_abc "anti bounce counter for diagnosis instance GEN_TYP_NOT_PLAUS" UBYTE _CNV_A_R_LINEAR_____0_CM 1 100. 0. 255. DISPLAY_IDENTIFIER CTR_ABC_GEN_TYP_NOT_PLAUS ECU_ADDRESS 0xd00096e0 FORMAT "%3.0" /end MEASUREMENT
/begin MEASUREMENT fmy_stat_gen_typ_not_plaus.ctr_end_diag "counter for end of diagnosis for diagnosis instance GEN_TYP_NOT_PLAUS" UBYTE _CNV_A_R_LINEAR_____0_CM 1 100. 0. 255. DISPLAY_IDENTIFIER CTR_ABC_END_DIAG_GEN_TYP_NOT_PLAUS ECU_ADDRESS 0xd00096e1 FORMAT "%3.0" /end MEASUREMENT
/begin MEASUREMENT fmy_stat_gen_typ_not_plaus.err_info_stat.lv_err_mem "storage in dynamic failure memory of the diagnosis instance GEN_TYP_NOT_PLAUS" UWORD _CNV_S_2_RANGE__0___1_CM 1 100. 0. 1. DISPLAY_IDENTIFIER LV_ERR_MEM_GEN_TYP_NOT_PLAUS ECU_ADDRESS 0xd00096e2 BIT_MASK 0x8 /end MEASUREMENT
/begin MEASUREMENT fmy_stat_gen_typ_not_plaus.err_info_stat.lv_ready "readiness status of the diagnosis instance GEN_TYP_NOT_PLAUS" UWORD _CNV_S_2_RANGE__0___1_CM 1 100. 0. 1. DISPLAY_IDENTIFIER LV_READY_GEN_TYP_NOT_PLAUS ECU_ADDRESS 0xd00096e2 BIT_MASK 0x10 /end MEASUREMENT
/begin MEASUREMENT fmy_stat_gen_typ_not_plaus.err_info_stat.lv_end_diag "end of diagnosis of the diagnosis instance GEN_TYP_NOT_PLAUS" UWORD _CNV_S_2_RANGE__0___1_CM 1 100. 0. 1. DISPLAY_IDENTIFIER LV_END_DIAG_GEN_TYP_NOT_PLAUS ECU_ADDRESS 0xd00096e2 BIT_MASK 0x20 /end MEASUREMENT
/begin MEASUREMENT fmy_stat_gen_typ_not_plaus.err_info_stat.lv_cdn_diag "diagnosis condition of the diagnosis instance GEN_TYP_NOT_PLAUS" UWORD _CNV_S_2_RANGE__0___1_CM 1 100. 0. 1. DISPLAY_IDENTIFIER LV_CDN_DIAG_GEN_TYP_NOT_PLAUS ECU_ADDRESS 0xd00096e2 BIT_MASK 0x40 /end MEASUREMENT
/begin MEASUREMENT fmy_stat_gen_typ_not_plaus.err_info_stat.err_sym "symptoms of the diagnosis instance GEN_TYP_NOT_PLAUS" UWORD _CNV_S_16_RANGE_ERR__349_CM 1 100. 0. 15. DISPLAY_IDENTIFIER ERR_SYM_GEN_TYP_NOT_PLAUS ECU_ADDRESS 0xd00096e2 BIT_MASK 0x780 /end MEASUREMENT
/begin MEASUREMENT fmy_stat_gen_msg_lost.ctr_abc "anti bounce counter for diagnosis instance GEN_MSG_LOST" UBYTE _CNV_A_R_LINEAR_____0_CM 1 100. 0. 255. DISPLAY_IDENTIFIER CTR_ABC_GEN_MSG_LOST ECU_ADDRESS 0xd00096dc FORMAT "%3.0" /end MEASUREMENT
/begin MEASUREMENT fmy_stat_gen_msg_lost.ctr_end_diag "counter for end of diagnosis for diagnosis instance GEN_MSG_LOST" UBYTE _CNV_A_R_LINEAR_____0_CM 1 100. 0. 255. DISPLAY_IDENTIFIER CTR_ABC_END_DIAG_GEN_MSG_LOST ECU_ADDRESS 0xd00096dd FORMAT "%3.0" /end MEASUREMENT
/begin MEASUREMENT fmy_stat_gen_msg_lost.err_info_stat.lv_err_mem "storage in dynamic failure memory of the diagnosis instance GEN_MSG_LOST" UWORD _CNV_S_2_RANGE__0___1_CM 1 100. 0. 1. DISPLAY_IDENTIFIER LV_ERR_MEM_GEN_MSG_LOST ECU_ADDRESS 0xd00096de BIT_MASK 0x8 /end MEASUREMENT
/begin MEASUREMENT fmy_stat_gen_msg_lost.err_info_stat.lv_ready "readiness status of the diagnosis instance GEN_MSG_LOST" UWORD _CNV_S_2_RANGE__0___1_CM 1 100. 0. 1. DISPLAY_IDENTIFIER LV_READY_GEN_MSG_LOST ECU_ADDRESS 0xd00096de BIT_MASK 0x10 /end MEASUREMENT
/begin MEASUREMENT fmy_stat_gen_msg_lost.err_info_stat.lv_end_diag "end of diagnosis of the diagnosis instance GEN_MSG_LOST" UWORD _CNV_S_2_RANGE__0___1_CM 1 100. 0. 1. DISPLAY_IDENTIFIER LV_END_DIAG_GEN_MSG_LOST ECU_ADDRESS 0xd00096de BIT_MASK 0x20 /end MEASUREMENT
/begin MEASUREMENT fmy_stat_gen_msg_lost.err_info_stat.lv_cdn_diag "diagnosis condition of the diagnosis instance GEN_MSG_LOST" UWORD _CNV_S_2_RANGE__0___1_CM 1 100. 0. 1. DISPLAY_IDENTIFIER LV_CDN_DIAG_GEN_MSG_LOST ECU_ADDRESS 0xd00096de BIT_MASK 0x40 /end MEASUREMENT
/begin MEASUREMENT fmy_stat_gen_msg_lost.err_info_stat.err_sym "symptoms of the diagnosis instance GEN_MSG_LOST" UWORD _CNV_S_16_RANGE_ERR__349_CM 1 100. 0. 15. DISPLAY_IDENTIFIER ERR_SYM_GEN_MSG_LOST ECU_ADDRESS 0xd00096de BIT_MASK 0x780 /end MEASUREMENT
/begin MEASUREMENT fmy_stat_gen_clc_v_not_plaus.ctr_abc "anti bounce counter for diagnosis instance GEN_CLC_V_NOT_PLAUS" UBYTE _CNV_A_R_LINEAR_____0_CM 1 100. 0. 255. DISPLAY_IDENTIFIER CTR_ABC_GEN_CLC_V_NOT_PLAUS ECU_ADDRESS 0xd00096c0 FORMAT "%3.0" /end MEASUREMENT
/begin MEASUREMENT fmy_stat_gen_clc_v_not_plaus.ctr_end_diag "counter for end of diagnosis for diagnosis instance GEN_CLC_V_NOT_PLAUS" UBYTE _CNV_A_R_LINEAR_____0_CM 1 100. 0. 255. DISPLAY_IDENTIFIER CTR_ABC_END_DIAG_GEN_CLC_V_NOT_PLAUS ECU_ADDRESS 0xd00096c1 FORMAT "%3.0" /end MEASUREMENT
/begin MEASUREMENT fmy_stat_gen_clc_v_not_plaus.err_info_stat.lv_err_mem "storage in dynamic failure memory of the diagnosis instance GEN_CLC_V_NOT_PLAUS" UWORD _CNV_S_2_RANGE__0___1_CM 1 100. 0. 1. DISPLAY_IDENTIFIER LV_ERR_MEM_GEN_CLC_V_NOT_PLAUS ECU_ADDRESS 0xd00096c2 BIT_MASK 0x8 /end MEASUREMENT
/begin MEASUREMENT fmy_stat_gen_clc_v_not_plaus.err_info_stat.lv_ready "readiness status of the diagnosis instance GEN_CLC_V_NOT_PLAUS" UWORD _CNV_S_2_RANGE__0___1_CM 1 100. 0. 1. DISPLAY_IDENTIFIER LV_READY_GEN_CLC_V_NOT_PLAUS ECU_ADDRESS 0xd00096c2 BIT_MASK 0x10 /end MEASUREMENT
/begin MEASUREMENT fmy_stat_gen_clc_v_not_plaus.err_info_stat.lv_end_diag "end of diagnosis of the diagnosis instance GEN_CLC_V_NOT_PLAUS" UWORD _CNV_S_2_RANGE__0___1_CM 1 100. 0. 1. DISPLAY_IDENTIFIER LV_END_DIAG_GEN_CLC_V_NOT_PLAUS ECU_ADDRESS 0xd00096c2 BIT_MASK 0x20 /end MEASUREMENT
/begin MEASUREMENT fmy_stat_gen_clc_v_not_plaus.err_info_stat.lv_cdn_diag "diagnosis condition of the diagnosis instance GEN_CLC_V_NOT_PLAUS" UWORD _CNV_S_2_RANGE__0___1_CM 1 100. 0. 1. DISPLAY_IDENTIFIER LV_CDN_DIAG_GEN_CLC_V_NOT_PLAUS ECU_ADDRESS 0xd00096c2 BIT_MASK 0x40 /end MEASUREMENT
/begin MEASUREMENT fmy_stat_gen_clc_v_not_plaus.err_info_stat.err_sym "symptoms of the diagnosis instance GEN_CLC_V_NOT_PLAUS" UWORD _CNV_S_16_RANGE_ERR__349_CM 1 100. 0. 15. DISPLAY_IDENTIFIER ERR_SYM_GEN_CLC_V_NOT_PLAUS ECU_ADDRESS 0xd00096c2 BIT_MASK 0x780 /end MEASUREMENT
/begin MEASUREMENT fmy_stat_gen_h_temp_clc.ctr_abc "anti bounce counter for diagnosis instance GEN_H_TEMP_CLC" UBYTE _CNV_A_R_LINEAR_____0_CM 1 100. 0. 255. DISPLAY_IDENTIFIER CTR_ABC_GEN_H_TEMP_CLC ECU_ADDRESS 0xd00096d4 FORMAT "%3.0" /end MEASUREMENT
/begin MEASUREMENT fmy_stat_gen_h_temp_clc.ctr_end_diag "counter for end of diagnosis for diagnosis instance GEN_H_TEMP_CLC" UBYTE _CNV_A_R_LINEAR_____0_CM 1 100. 0. 255. DISPLAY_IDENTIFIER CTR_ABC_END_DIAG_GEN_H_TEMP_CLC ECU_ADDRESS 0xd00096d5 FORMAT "%3.0" /end MEASUREMENT
/begin MEASUREMENT fmy_stat_gen_h_temp_clc.err_info_stat.lv_err_mem "storage in dynamic failure memory of the diagnosis instance GEN_H_TEMP_CLC" UWORD _CNV_S_2_RANGE__0___1_CM 1 100. 0. 1. DISPLAY_IDENTIFIER LV_ERR_MEM_GEN_H_TEMP_CLC ECU_ADDRESS 0xd00096d6 BIT_MASK 0x8 /end MEASUREMENT
/begin MEASUREMENT fmy_stat_gen_h_temp_clc.err_info_stat.lv_ready "readiness status of the diagnosis instance GEN_H_TEMP_CLC" UWORD _CNV_S_2_RANGE__0___1_CM 1 100. 0. 1. DISPLAY_IDENTIFIER LV_READY_GEN_H_TEMP_CLC ECU_ADDRESS 0xd00096d6 BIT_MASK 0x10 /end MEASUREMENT
/begin MEASUREMENT fmy_stat_gen_h_temp_clc.err_info_stat.lv_end_diag "end of diagnosis of the diagnosis instance GEN_H_TEMP_CLC" UWORD _CNV_S_2_RANGE__0___1_CM 1 100. 0. 1. DISPLAY_IDENTIFIER LV_END_DIAG_GEN_H_TEMP_CLC ECU_ADDRESS 0xd00096d6 BIT_MASK 0x20 /end MEASUREMENT
/begin MEASUREMENT fmy_stat_gen_h_temp_clc.err_info_stat.lv_cdn_diag "diagnosis condition of the diagnosis instance GEN_H_TEMP_CLC" UWORD _CNV_S_2_RANGE__0___1_CM 1 100. 0. 1. DISPLAY_IDENTIFIER LV_CDN_DIAG_GEN_H_TEMP_CLC ECU_ADDRESS 0xd00096d6 BIT_MASK 0x40 /end MEASUREMENT
/begin MEASUREMENT fmy_stat_gen_h_temp_clc.err_info_stat.err_sym "symptoms of the diagnosis instance GEN_H_TEMP_CLC" UWORD _CNV_S_16_RANGE_ERR__349_CM 1 100. 0. 15. DISPLAY_IDENTIFIER ERR_SYM_GEN_H_TEMP_CLC ECU_ADDRESS 0xd00096d6 BIT_MASK 0x780 /end MEASUREMENT
/begin MEASUREMENT fmy_stat_gen_ctl_not_plaus.ctr_abc "anti bounce counter for diagnosis instance GEN_CTL_NOT_PLAUS" UBYTE _CNV_A_R_LINEAR_____0_CM 1 100. 0. 255. DISPLAY_IDENTIFIER CTR_ABC_GEN_CTL_NOT_PLAUS ECU_ADDRESS 0xd00096c4 FORMAT "%3.0" /end MEASUREMENT
/begin MEASUREMENT fmy_stat_gen_ctl_not_plaus.ctr_end_diag "counter for end of diagnosis for diagnosis instance GEN_CTL_NOT_PLAUS" UBYTE _CNV_A_R_LINEAR_____0_CM 1 100. 0. 255. DISPLAY_IDENTIFIER CTR_ABC_END_DIAG_GEN_CTL_NOT_PLAUS ECU_ADDRESS 0xd00096c5 FORMAT "%3.0" /end MEASUREMENT
/begin MEASUREMENT fmy_stat_gen_ctl_not_plaus.err_info_stat.lv_err_mem "storage in dynamic failure memory of the diagnosis instance GEN_CTL_NOT_PLAUS" UWORD _CNV_S_2_RANGE__0___1_CM 1 100. 0. 1. DISPLAY_IDENTIFIER LV_ERR_MEM_GEN_CTL_NOT_PLAUS ECU_ADDRESS 0xd00096c6 BIT_MASK 0x8 /end MEASUREMENT
/begin MEASUREMENT fmy_stat_gen_ctl_not_plaus.err_info_stat.lv_ready "readiness status of the diagnosis instance GEN_CTL_NOT_PLAUS" UWORD _CNV_S_2_RANGE__0___1_CM 1 100. 0. 1. DISPLAY_IDENTIFIER LV_READY_GEN_CTL_NOT_PLAUS ECU_ADDRESS 0xd00096c6 BIT_MASK 0x10 /end MEASUREMENT
/begin MEASUREMENT fmy_stat_gen_ctl_not_plaus.err_info_stat.lv_end_diag "end of diagnosis of the diagnosis instance GEN_CTL_NOT_PLAUS" UWORD _CNV_S_2_RANGE__0___1_CM 1 100. 0. 1. DISPLAY_IDENTIFIER LV_END_DIAG_GEN_CTL_NOT_PLAUS ECU_ADDRESS 0xd00096c6 BIT_MASK 0x20 /end MEASUREMENT
/begin MEASUREMENT fmy_stat_gen_ctl_not_plaus.err_info_stat.lv_cdn_diag "diagnosis condition of the diagnosis instance GEN_CTL_NOT_PLAUS" UWORD _CNV_S_2_RANGE__0___1_CM 1 100. 0. 1. DISPLAY_IDENTIFIER LV_CDN_DIAG_GEN_CTL_NOT_PLAUS ECU_ADDRESS 0xd00096c6 BIT_MASK 0x40 /end MEASUREMENT
/begin MEASUREMENT fmy_stat_gen_ctl_not_plaus.err_info_stat.err_sym "symptoms of the diagnosis instance GEN_CTL_NOT_PLAUS" UWORD _CNV_S_16_RANGE_ERR__349_CM 1 100. 0. 15. DISPLAY_IDENTIFIER ERR_SYM_GEN_CTL_NOT_PLAUS ECU_ADDRESS 0xd00096c6 BIT_MASK 0x780 /end MEASUREMENT
/begin MEASUREMENT fmy_stat_slv_ivvt_in.ctr_abc "anti bounce counter for diagnosis instance SLV_IVVT_IN" UBYTE _CNV_A_R_LINEAR_____0_CM 1 100. 0. 255. DISPLAY_IDENTIFIER CTR_ABC_SLV_IVVT_IN ECU_ADDRESS 0xd00099a0 FORMAT "%3.0" /end MEASUREMENT
/begin MEASUREMENT fmy_stat_slv_ivvt_in.ctr_end_diag "counter for end of diagnosis for diagnosis instance SLV_IVVT_IN" UBYTE _CNV_A_R_LINEAR_____0_CM 1 100. 0. 255. DISPLAY_IDENTIFIER CTR_ABC_END_DIAG_SLV_IVVT_IN ECU_ADDRESS 0xd00099a1 FORMAT "%3.0" /end MEASUREMENT
/begin MEASUREMENT fmy_stat_slv_ivvt_in.err_info_stat.lv_err_mem "storage in dynamic failure memory of the diagnosis instance SLV_IVVT_IN" UWORD _CNV_S_2_RANGE__0___1_CM 1 100. 0. 1. DISPLAY_IDENTIFIER LV_ERR_MEM_SLV_IVVT_IN ECU_ADDRESS 0xd00099a2 BIT_MASK 0x8 /end MEASUREMENT
/begin MEASUREMENT fmy_stat_slv_ivvt_in.err_info_stat.lv_ready "readiness status of the diagnosis instance SLV_IVVT_IN" UWORD _CNV_S_2_RANGE__0___1_CM 1 100. 0. 1. DISPLAY_IDENTIFIER LV_READY_SLV_IVVT_IN ECU_ADDRESS 0xd00099a2 BIT_MASK 0x10 /end MEASUREMENT
/begin MEASUREMENT fmy_stat_slv_ivvt_in.err_info_stat.lv_end_diag "end of diagnosis of the diagnosis instance SLV_IVVT_IN" UWORD _CNV_S_2_RANGE__0___1_CM 1 100. 0. 1. DISPLAY_IDENTIFIER LV_END_DIAG_SLV_IVVT_IN ECU_ADDRESS 0xd00099a2 BIT_MASK 0x20 /end MEASUREMENT
/begin MEASUREMENT fmy_stat_slv_ivvt_in.err_info_stat.lv_cdn_diag "diagnosis condition of the diagnosis instance SLV_IVVT_IN" UWORD _CNV_S_2_RANGE__0___1_CM 1 100. 0. 1. DISPLAY_IDENTIFIER LV_CDN_DIAG_SLV_IVVT_IN ECU_ADDRESS 0xd00099a2 BIT_MASK 0x40 /end MEASUREMENT
/begin MEASUREMENT fmy_stat_slv_ivvt_in.err_info_stat.err_sym "symptoms of the diagnosis instance SLV_IVVT_IN" UWORD _CNV_S_16_RANGE_ERR__349_CM 1 100. 0. 15. DISPLAY_IDENTIFIER ERR_SYM_SLV_IVVT_IN ECU_ADDRESS 0xd00099a2 BIT_MASK 0x780 /end MEASUREMENT
/begin MEASUREMENT fmy_stat_slv_ivvt_ex.ctr_abc "anti bounce counter for diagnosis instance SLV_IVVT_EX" UBYTE _CNV_A_R_LINEAR_____0_CM 1 100. 0. 255. DISPLAY_IDENTIFIER CTR_ABC_SLV_IVVT_EX ECU_ADDRESS 0xd0009994 FORMAT "%3.0" /end MEASUREMENT
/begin MEASUREMENT fmy_stat_slv_ivvt_ex.ctr_end_diag "counter for end of diagnosis for diagnosis instance SLV_IVVT_EX" UBYTE _CNV_A_R_LINEAR_____0_CM 1 100. 0. 255. DISPLAY_IDENTIFIER CTR_ABC_END_DIAG_SLV_IVVT_EX ECU_ADDRESS 0xd0009995 FORMAT "%3.0" /end MEASUREMENT
/begin MEASUREMENT fmy_stat_slv_ivvt_ex.err_info_stat.lv_err_mem "storage in dynamic failure memory of the diagnosis instance SLV_IVVT_EX" UWORD _CNV_S_2_RANGE__0___1_CM 1 100. 0. 1. DISPLAY_IDENTIFIER LV_ERR_MEM_SLV_IVVT_EX ECU_ADDRESS 0xd0009996 BIT_MASK 0x8 /end MEASUREMENT
/begin MEASUREMENT fmy_stat_slv_ivvt_ex.err_info_stat.lv_ready "readiness status of the diagnosis instance SLV_IVVT_EX" UWORD _CNV_S_2_RANGE__0___1_CM 1 100. 0. 1. DISPLAY_IDENTIFIER LV_READY_SLV_IVVT_EX ECU_ADDRESS 0xd0009996 BIT_MASK 0x10 /end MEASUREMENT
/begin MEASUREMENT fmy_stat_slv_ivvt_ex.err_info_stat.lv_end_diag "end of diagnosis of the diagnosis instance SLV_IVVT_EX" UWORD _CNV_S_2_RANGE__0___1_CM 1 100. 0. 1. DISPLAY_IDENTIFIER LV_END_DIAG_SLV_IVVT_EX ECU_ADDRESS 0xd0009996 BIT_MASK 0x20 /end MEASUREMENT
/begin MEASUREMENT fmy_stat_slv_ivvt_ex.err_info_stat.lv_cdn_diag "diagnosis condition of the diagnosis instance SLV_IVVT_EX" UWORD _CNV_S_2_RANGE__0___1_CM 1 100. 0. 1. DISPLAY_IDENTIFIER LV_CDN_DIAG_SLV_IVVT_EX ECU_ADDRESS 0xd0009996 BIT_MASK 0x40 /end MEASUREMENT
/begin MEASUREMENT fmy_stat_slv_ivvt_ex.err_info_stat.err_sym "symptoms of the diagnosis instance SLV_IVVT_EX" UWORD _CNV_S_16_RANGE_ERR__349_CM 1 100. 0. 15. DISPLAY_IDENTIFIER ERR_SYM_SLV_IVVT_EX ECU_ADDRESS 0xd0009996 BIT_MASK 0x780 /end MEASUREMENT
/begin MEASUREMENT fmy_stat_conv_mon_1.ctr_abc "anti bounce counter for diagnosis instance CONV_MON_1" UBYTE _CNV_A_R_LINEAR_____0_CM 1 100. 0. 255. DISPLAY_IDENTIFIER CTR_ABC_CONV_MON_1 ECU_ADDRESS 0xd0009564 FORMAT "%3.0" /end MEASUREMENT
/begin MEASUREMENT fmy_stat_conv_mon_1.ctr_end_diag "counter for end of diagnosis for diagnosis instance CONV_MON_1" UBYTE _CNV_A_R_LINEAR_____0_CM 1 100. 0. 255. DISPLAY_IDENTIFIER CTR_ABC_END_DIAG_CONV_MON_1 ECU_ADDRESS 0xd0009565 FORMAT "%3.0" /end MEASUREMENT
/begin MEASUREMENT fmy_stat_conv_mon_1.err_info_stat.lv_err_mem "storage in dynamic failure memory of the diagnosis instance CONV_MON_1" UWORD _CNV_S_2_RANGE__0___1_CM 1 100. 0. 1. DISPLAY_IDENTIFIER LV_ERR_MEM_CONV_MON_1 ECU_ADDRESS 0xd0009566 BIT_MASK 0x8 /end MEASUREMENT
/begin MEASUREMENT fmy_stat_conv_mon_1.err_info_stat.lv_ready "readiness status of the diagnosis instance CONV_MON_1" UWORD _CNV_S_2_RANGE__0___1_CM 1 100. 0. 1. DISPLAY_IDENTIFIER LV_READY_CONV_MON_1 ECU_ADDRESS 0xd0009566 BIT_MASK 0x10 /end MEASUREMENT
/begin MEASUREMENT fmy_stat_conv_mon_1.err_info_stat.lv_end_diag "end of diagnosis of the diagnosis instance CONV_MON_1" UWORD _CNV_S_2_RANGE__0___1_CM 1 100. 0. 1. DISPLAY_IDENTIFIER LV_END_DIAG_CONV_MON_1 ECU_ADDRESS 0xd0009566 BIT_MASK 0x20 /end MEASUREMENT
/begin MEASUREMENT fmy_stat_conv_mon_1.err_info_stat.lv_cdn_diag "diagnosis condition of the diagnosis instance CONV_MON_1" UWORD _CNV_S_2_RANGE__0___1_CM 1 100. 0. 1. DISPLAY_IDENTIFIER LV_CDN_DIAG_CONV_MON_1 ECU_ADDRESS 0xd0009566 BIT_MASK 0x40 /end MEASUREMENT
/begin MEASUREMENT fmy_stat_conv_mon_1.err_info_stat.err_sym "symptoms of the diagnosis instance CONV_MON_1" UWORD _CNV_S_16_RANGE_ERR__349_CM 1 100. 0. 15. DISPLAY_IDENTIFIER ERR_SYM_CONV_MON_1 ECU_ADDRESS 0xd0009566 BIT_MASK 0x780 /end MEASUREMENT
/begin MEASUREMENT fmy_stat_n_32_mon_1.ctr_abc "anti bounce counter for diagnosis instance N_32_MON_1" UBYTE _CNV_A_R_LINEAR_____0_CM 1 100. 0. 255. DISPLAY_IDENTIFIER CTR_ABC_N_32_MON_1 ECU_ADDRESS 0xd000986c FORMAT "%3.0" /end MEASUREMENT
/begin MEASUREMENT fmy_stat_n_32_mon_1.ctr_end_diag "counter for end of diagnosis for diagnosis instance N_32_MON_1" UBYTE _CNV_A_R_LINEAR_____0_CM 1 100. 0. 255. DISPLAY_IDENTIFIER CTR_ABC_END_DIAG_N_32_MON_1 ECU_ADDRESS 0xd000986d FORMAT "%3.0" /end MEASUREMENT
/begin MEASUREMENT fmy_stat_n_32_mon_1.err_info_stat.lv_err_mem "storage in dynamic failure memory of the diagnosis instance N_32_MON_1" UWORD _CNV_S_2_RANGE__0___1_CM 1 100. 0. 1. DISPLAY_IDENTIFIER LV_ERR_MEM_N_32_MON_1 ECU_ADDRESS 0xd000986e BIT_MASK 0x8 /end MEASUREMENT
/begin MEASUREMENT fmy_stat_n_32_mon_1.err_info_stat.lv_ready "readiness status of the diagnosis instance N_32_MON_1" UWORD _CNV_S_2_RANGE__0___1_CM 1 100. 0. 1. DISPLAY_IDENTIFIER LV_READY_N_32_MON_1 ECU_ADDRESS 0xd000986e BIT_MASK 0x10 /end MEASUREMENT
/begin MEASUREMENT fmy_stat_n_32_mon_1.err_info_stat.lv_end_diag "end of diagnosis of the diagnosis instance N_32_MON_1" UWORD _CNV_S_2_RANGE__0___1_CM 1 100. 0. 1. DISPLAY_IDENTIFIER LV_END_DIAG_N_32_MON_1 ECU_ADDRESS 0xd000986e BIT_MASK 0x20 /end MEASUREMENT
/begin MEASUREMENT fmy_stat_n_32_mon_1.err_info_stat.lv_cdn_diag "diagnosis condition of the diagnosis instance N_32_MON_1" UWORD _CNV_S_2_RANGE__0___1_CM 1 100. 0. 1. DISPLAY_IDENTIFIER LV_CDN_DIAG_N_32_MON_1 ECU_ADDRESS 0xd000986e BIT_MASK 0x40 /end MEASUREMENT
/begin MEASUREMENT fmy_stat_n_32_mon_1.err_info_stat.err_sym "symptoms of the diagnosis instance N_32_MON_1" UWORD _CNV_S_16_RANGE_ERR__349_CM 1 100. 0. 15. DISPLAY_IDENTIFIER ERR_SYM_N_32_MON_1 ECU_ADDRESS 0xd000986e BIT_MASK 0x780 /end MEASUREMENT
/begin MEASUREMENT fmy_stat_pvs_mon_1.ctr_abc "anti bounce counter for diagnosis instance PVS_MON_1" UBYTE _CNV_A_R_LINEAR_____0_CM 1 100. 0. 255. DISPLAY_IDENTIFIER CTR_ABC_PVS_MON_1 ECU_ADDRESS 0xd0009920 FORMAT "%3.0" /end MEASUREMENT
/begin MEASUREMENT fmy_stat_pvs_mon_1.ctr_end_diag "counter for end of diagnosis for diagnosis instance PVS_MON_1" UBYTE _CNV_A_R_LINEAR_____0_CM 1 100. 0. 255. DISPLAY_IDENTIFIER CTR_ABC_END_DIAG_PVS_MON_1 ECU_ADDRESS 0xd0009921 FORMAT "%3.0" /end MEASUREMENT
/begin MEASUREMENT fmy_stat_pvs_mon_1.err_info_stat.lv_err_mem "storage in dynamic failure memory of the diagnosis instance PVS_MON_1" UWORD _CNV_S_2_RANGE__0___1_CM 1 100. 0. 1. DISPLAY_IDENTIFIER LV_ERR_MEM_PVS_MON_1 ECU_ADDRESS 0xd0009922 BIT_MASK 0x8 /end MEASUREMENT
/begin MEASUREMENT fmy_stat_pvs_mon_1.err_info_stat.lv_ready "readiness status of the diagnosis instance PVS_MON_1" UWORD _CNV_S_2_RANGE__0___1_CM 1 100. 0. 1. DISPLAY_IDENTIFIER LV_READY_PVS_MON_1 ECU_ADDRESS 0xd0009922 BIT_MASK 0x10 /end MEASUREMENT
/begin MEASUREMENT fmy_stat_pvs_mon_1.err_info_stat.lv_end_diag "end of diagnosis of the diagnosis instance PVS_MON_1" UWORD _CNV_S_2_RANGE__0___1_CM 1 100. 0. 1. DISPLAY_IDENTIFIER LV_END_DIAG_PVS_MON_1 ECU_ADDRESS 0xd0009922 BIT_MASK 0x20 /end MEASUREMENT
/begin MEASUREMENT fmy_stat_pvs_mon_1.err_info_stat.lv_cdn_diag "diagnosis condition of the diagnosis instance PVS_MON_1" UWORD _CNV_S_2_RANGE__0___1_CM 1 100. 0. 1. DISPLAY_IDENTIFIER LV_CDN_DIAG_PVS_MON_1 ECU_ADDRESS 0xd0009922 BIT_MASK 0x40 /end MEASUREMENT
/begin MEASUREMENT fmy_stat_pvs_mon_1.err_info_stat.err_sym "symptoms of the diagnosis instance PVS_MON_1" UWORD _CNV_S_16_RANGE_ERR__349_CM 1 100. 0. 15. DISPLAY_IDENTIFIER ERR_SYM_PVS_MON_1 ECU_ADDRESS 0xd0009922 BIT_MASK 0x780 /end MEASUREMENT
/begin MEASUREMENT fmy_stat_tq_dif_isc_mon_1.ctr_abc "anti bounce counter for diagnosis instance TQ_DIF_ISC_MON_1" UBYTE _CNV_A_R_LINEAR_____0_CM 1 100. 0. 255. DISPLAY_IDENTIFIER CTR_ABC_TQ_DIF_ISC_MON_1 ECU_ADDRESS 0xd0009ab8 FORMAT "%3.0" /end MEASUREMENT
/begin MEASUREMENT fmy_stat_tq_dif_isc_mon_1.ctr_end_diag "counter for end of diagnosis for diagnosis instance TQ_DIF_ISC_MON_1" UBYTE _CNV_A_R_LINEAR_____0_CM 1 100. 0. 255. DISPLAY_IDENTIFIER CTR_ABC_END_DIAG_TQ_DIF_ISC_MON_1 ECU_ADDRESS 0xd0009ab9 FORMAT "%3.0" /end MEASUREMENT
/begin MEASUREMENT fmy_stat_tq_dif_isc_mon_1.err_info_stat.lv_err_mem "storage in dynamic failure memory of the diagnosis instance TQ_DIF_ISC_MON_1" UWORD _CNV_S_2_RANGE__0___1_CM 1 100. 0. 1. DISPLAY_IDENTIFIER LV_ERR_MEM_TQ_DIF_ISC_MON_1 ECU_ADDRESS 0xd0009aba BIT_MASK 0x8 /end MEASUREMENT
/begin MEASUREMENT fmy_stat_tq_dif_isc_mon_1.err_info_stat.lv_ready "readiness status of the diagnosis instance TQ_DIF_ISC_MON_1" UWORD _CNV_S_2_RANGE__0___1_CM 1 100. 0. 1. DISPLAY_IDENTIFIER LV_READY_TQ_DIF_ISC_MON_1 ECU_ADDRESS 0xd0009aba BIT_MASK 0x10 /end MEASUREMENT
/begin MEASUREMENT fmy_stat_tq_dif_isc_mon_1.err_info_stat.lv_end_diag "end of diagnosis of the diagnosis instance TQ_DIF_ISC_MON_1" UWORD _CNV_S_2_RANGE__0___1_CM 1 100. 0. 1. DISPLAY_IDENTIFIER LV_END_DIAG_TQ_DIF_ISC_MON_1 ECU_ADDRESS 0xd0009aba BIT_MASK 0x20 /end MEASUREMENT
/begin MEASUREMENT fmy_stat_tq_dif_isc_mon_1.err_info_stat.lv_cdn_diag "diagnosis condition of the diagnosis instance TQ_DIF_ISC_MON_1" UWORD _CNV_S_2_RANGE__0___1_CM 1 100. 0. 1. DISPLAY_IDENTIFIER LV_CDN_DIAG_TQ_DIF_ISC_MON_1 ECU_ADDRESS 0xd0009aba BIT_MASK 0x40 /end MEASUREMENT
/begin MEASUREMENT fmy_stat_tq_dif_isc_mon_1.err_info_stat.err_sym "symptoms of the diagnosis instance TQ_DIF_ISC_MON_1" UWORD _CNV_S_16_RANGE_ERR__349_CM 1 100. 0. 15. DISPLAY_IDENTIFIER ERR_SYM_TQ_DIF_ISC_MON_1 ECU_ADDRESS 0xd0009aba BIT_MASK 0x780 /end MEASUREMENT
/begin MEASUREMENT fmy_stat_tq_req_mon_1.ctr_abc "anti bounce counter for diagnosis instance TQ_REQ_MON_1" UBYTE _CNV_A_R_LINEAR_____0_CM 1 100. 0. 255. DISPLAY_IDENTIFIER CTR_ABC_TQ_REQ_MON_1 ECU_ADDRESS 0xd0009ac4 FORMAT "%3.0" /end MEASUREMENT
/begin MEASUREMENT fmy_stat_tq_req_mon_1.ctr_end_diag "counter for end of diagnosis for diagnosis instance TQ_REQ_MON_1" UBYTE _CNV_A_R_LINEAR_____0_CM 1 100. 0. 255. DISPLAY_IDENTIFIER CTR_ABC_END_DIAG_TQ_REQ_MON_1 ECU_ADDRESS 0xd0009ac5 FORMAT "%3.0" /end MEASUREMENT
/begin MEASUREMENT fmy_stat_tq_req_mon_1.err_info_stat.lv_err_mem "storage in dynamic failure memory of the diagnosis instance TQ_REQ_MON_1" UWORD _CNV_S_2_RANGE__0___1_CM 1 100. 0. 1. DISPLAY_IDENTIFIER LV_ERR_MEM_TQ_REQ_MON_1 ECU_ADDRESS 0xd0009ac6 BIT_MASK 0x8 /end MEASUREMENT
/begin MEASUREMENT fmy_stat_tq_req_mon_1.err_info_stat.lv_ready "readiness status of the diagnosis instance TQ_REQ_MON_1" UWORD _CNV_S_2_RANGE__0___1_CM 1 100. 0. 1. DISPLAY_IDENTIFIER LV_READY_TQ_REQ_MON_1 ECU_ADDRESS 0xd0009ac6 BIT_MASK 0x10 /end MEASUREMENT
/begin MEASUREMENT fmy_stat_tq_req_mon_1.err_info_stat.lv_end_diag "end of diagnosis of the diagnosis instance TQ_REQ_MON_1" UWORD _CNV_S_2_RANGE__0___1_CM 1 100. 0. 1. DISPLAY_IDENTIFIER LV_END_DIAG_TQ_REQ_MON_1 ECU_ADDRESS 0xd0009ac6 BIT_MASK 0x20 /end MEASUREMENT
/begin MEASUREMENT fmy_stat_tq_req_mon_1.err_info_stat.lv_cdn_diag "diagnosis condition of the diagnosis instance TQ_REQ_MON_1" UWORD _CNV_S_2_RANGE__0___1_CM 1 100. 0. 1. DISPLAY_IDENTIFIER LV_CDN_DIAG_TQ_REQ_MON_1 ECU_ADDRESS 0xd0009ac6 BIT_MASK 0x40 /end MEASUREMENT
/begin MEASUREMENT fmy_stat_tq_req_mon_1.err_info_stat.err_sym "symptoms of the diagnosis instance TQ_REQ_MON_1" UWORD _CNV_S_16_RANGE_ERR__349_CM 1 100. 0. 15. DISPLAY_IDENTIFIER ERR_SYM_TQ_REQ_MON_1 ECU_ADDRESS 0xd0009ac6 BIT_MASK 0x780 /end MEASUREMENT
/begin MEASUREMENT fmy_stat_tq_ext_mon_1.ctr_abc "anti bounce counter for diagnosis instance TQ_EXT_MON_1" UBYTE _CNV_A_R_LINEAR_____0_CM 1 100. 0. 255. DISPLAY_IDENTIFIER CTR_ABC_TQ_EXT_MON_1 ECU_ADDRESS 0xd0009abc FORMAT "%3.0" /end MEASUREMENT
/begin MEASUREMENT fmy_stat_tq_ext_mon_1.ctr_end_diag "counter for end of diagnosis for diagnosis instance TQ_EXT_MON_1" UBYTE _CNV_A_R_LINEAR_____0_CM 1 100. 0. 255. DISPLAY_IDENTIFIER CTR_ABC_END_DIAG_TQ_EXT_MON_1 ECU_ADDRESS 0xd0009abd FORMAT "%3.0" /end MEASUREMENT
/begin MEASUREMENT fmy_stat_tq_ext_mon_1.err_info_stat.lv_err_mem "storage in dynamic failure memory of the diagnosis instance TQ_EXT_MON_1" UWORD _CNV_S_2_RANGE__0___1_CM 1 100. 0. 1. DISPLAY_IDENTIFIER LV_ERR_MEM_TQ_EXT_MON_1 ECU_ADDRESS 0xd0009abe BIT_MASK 0x8 /end MEASUREMENT
/begin MEASUREMENT fmy_stat_tq_ext_mon_1.err_info_stat.lv_ready "readiness status of the diagnosis instance TQ_EXT_MON_1" UWORD _CNV_S_2_RANGE__0___1_CM 1 100. 0. 1. DISPLAY_IDENTIFIER LV_READY_TQ_EXT_MON_1 ECU_ADDRESS 0xd0009abe BIT_MASK 0x10 /end MEASUREMENT
/begin MEASUREMENT fmy_stat_tq_ext_mon_1.err_info_stat.lv_end_diag "end of diagnosis of the diagnosis instance TQ_EXT_MON_1" UWORD _CNV_S_2_RANGE__0___1_CM 1 100. 0. 1. DISPLAY_IDENTIFIER LV_END_DIAG_TQ_EXT_MON_1 ECU_ADDRESS 0xd0009abe BIT_MASK 0x20 /end MEASUREMENT
/begin MEASUREMENT fmy_stat_tq_ext_mon_1.err_info_stat.lv_cdn_diag "diagnosis condition of the diagnosis instance TQ_EXT_MON_1" UWORD _CNV_S_2_RANGE__0___1_CM 1 100. 0. 1. DISPLAY_IDENTIFIER LV_CDN_DIAG_TQ_EXT_MON_1 ECU_ADDRESS 0xd0009abe BIT_MASK 0x40 /end MEASUREMENT
/begin MEASUREMENT fmy_stat_tq_ext_mon_1.err_info_stat.err_sym "symptoms of the diagnosis instance TQ_EXT_MON_1" UWORD _CNV_S_16_RANGE_ERR__349_CM 1 100. 0. 15. DISPLAY_IDENTIFIER ERR_SYM_TQ_EXT_MON_1 ECU_ADDRESS 0xd0009abe BIT_MASK 0x780 /end MEASUREMENT
/begin MEASUREMENT fmy_stat_tqi_av_mon_1.ctr_abc "anti bounce counter for diagnosis instance TQI_AV_MON_1" UBYTE _CNV_A_R_LINEAR_____0_CM 1 100. 0. 255. DISPLAY_IDENTIFIER CTR_ABC_TQI_AV_MON_1 ECU_ADDRESS 0xd0009ac8 FORMAT "%3.0" /end MEASUREMENT
/begin MEASUREMENT fmy_stat_tqi_av_mon_1.ctr_end_diag "counter for end of diagnosis for diagnosis instance TQI_AV_MON_1" UBYTE _CNV_A_R_LINEAR_____0_CM 1 100. 0. 255. DISPLAY_IDENTIFIER CTR_ABC_END_DIAG_TQI_AV_MON_1 ECU_ADDRESS 0xd0009ac9 FORMAT "%3.0" /end MEASUREMENT
/begin MEASUREMENT fmy_stat_tqi_av_mon_1.err_info_stat.lv_err_mem "storage in dynamic failure memory of the diagnosis instance TQI_AV_MON_1" UWORD _CNV_S_2_RANGE__0___1_CM 1 100. 0. 1. DISPLAY_IDENTIFIER LV_ERR_MEM_TQI_AV_MON_1 ECU_ADDRESS 0xd0009aca BIT_MASK 0x8 /end MEASUREMENT
/begin MEASUREMENT fmy_stat_tqi_av_mon_1.err_info_stat.lv_ready "readiness status of the diagnosis instance TQI_AV_MON_1" UWORD _CNV_S_2_RANGE__0___1_CM 1 100. 0. 1. DISPLAY_IDENTIFIER LV_READY_TQI_AV_MON_1 ECU_ADDRESS 0xd0009aca BIT_MASK 0x10 /end MEASUREMENT
/begin MEASUREMENT fmy_stat_tqi_av_mon_1.err_info_stat.lv_end_diag "end of diagnosis of the diagnosis instance TQI_AV_MON_1" UWORD _CNV_S_2_RANGE__0___1_CM 1 100. 0. 1. DISPLAY_IDENTIFIER LV_END_DIAG_TQI_AV_MON_1 ECU_ADDRESS 0xd0009aca BIT_MASK 0x20 /end MEASUREMENT
/begin MEASUREMENT fmy_stat_tqi_av_mon_1.err_info_stat.lv_cdn_diag "diagnosis condition of the diagnosis instance TQI_AV_MON_1" UWORD _CNV_S_2_RANGE__0___1_CM 1 100. 0. 1. DISPLAY_IDENTIFIER LV_CDN_DIAG_TQI_AV_MON_1 ECU_ADDRESS 0xd0009aca BIT_MASK 0x40 /end MEASUREMENT
/begin MEASUREMENT fmy_stat_tqi_av_mon_1.err_info_stat.err_sym "symptoms of the diagnosis instance TQI_AV_MON_1" UWORD _CNV_S_16_RANGE_ERR__349_CM 1 100. 0. 15. DISPLAY_IDENTIFIER ERR_SYM_TQI_AV_MON_1 ECU_ADDRESS 0xd0009aca BIT_MASK 0x780 /end MEASUREMENT
/begin MEASUREMENT fmy_stat_tqi_n_max_mon_1.ctr_abc "anti bounce counter for diagnosis instance TQI_N_MAX_MON_1" UBYTE _CNV_A_R_LINEAR_____0_CM 1 100. 0. 255. DISPLAY_IDENTIFIER CTR_ABC_TQI_N_MAX_MON_1 ECU_ADDRESS 0xd0009ad0 FORMAT "%3.0" /end MEASUREMENT
/begin MEASUREMENT fmy_stat_tqi_n_max_mon_1.ctr_end_diag "counter for end of diagnosis for diagnosis instance TQI_N_MAX_MON_1" UBYTE _CNV_A_R_LINEAR_____0_CM 1 100. 0. 255. DISPLAY_IDENTIFIER CTR_ABC_END_DIAG_TQI_N_MAX_MON_1 ECU_ADDRESS 0xd0009ad1 FORMAT "%3.0" /end MEASUREMENT
/begin MEASUREMENT fmy_stat_tqi_n_max_mon_1.err_info_stat.lv_err_mem "storage in dynamic failure memory of the diagnosis instance TQI_N_MAX_MON_1" UWORD _CNV_S_2_RANGE__0___1_CM 1 100. 0. 1. DISPLAY_IDENTIFIER LV_ERR_MEM_TQI_N_MAX_MON_1 ECU_ADDRESS 0xd0009ad2 BIT_MASK 0x8 /end MEASUREMENT
/begin MEASUREMENT fmy_stat_tqi_n_max_mon_1.err_info_stat.lv_ready "readiness status of the diagnosis instance TQI_N_MAX_MON_1" UWORD _CNV_S_2_RANGE__0___1_CM 1 100. 0. 1. DISPLAY_IDENTIFIER LV_READY_TQI_N_MAX_MON_1 ECU_ADDRESS 0xd0009ad2 BIT_MASK 0x10 /end MEASUREMENT
/begin MEASUREMENT fmy_stat_tqi_n_max_mon_1.err_info_stat.lv_end_diag "end of diagnosis of the diagnosis instance TQI_N_MAX_MON_1" UWORD _CNV_S_2_RANGE__0___1_CM 1 100. 0. 1. DISPLAY_IDENTIFIER LV_END_DIAG_TQI_N_MAX_MON_1 ECU_ADDRESS 0xd0009ad2 BIT_MASK 0x20 /end MEASUREMENT
/begin MEASUREMENT fmy_stat_tqi_n_max_mon_1.err_info_stat.lv_cdn_diag "diagnosis condition of the diagnosis instance TQI_N_MAX_MON_1" UWORD _CNV_S_2_RANGE__0___1_CM 1 100. 0. 1. DISPLAY_IDENTIFIER LV_CDN_DIAG_TQI_N_MAX_MON_1 ECU_ADDRESS 0xd0009ad2 BIT_MASK 0x40 /end MEASUREMENT
/begin MEASUREMENT fmy_stat_tqi_n_max_mon_1.err_info_stat.err_sym "symptoms of the diagnosis instance TQI_N_MAX_MON_1" UWORD _CNV_S_16_RANGE_ERR__349_CM 1 100. 0. 15. DISPLAY_IDENTIFIER ERR_SYM_TQI_N_MAX_MON_1 ECU_ADDRESS 0xd0009ad2 BIT_MASK 0x780 /end MEASUREMENT
/begin MEASUREMENT fmy_stat_mff_mon_1.ctr_abc "anti bounce counter for diagnosis instance MFF_MON_1" UBYTE _CNV_A_R_LINEAR_____0_CM 1 100. 0. 255. DISPLAY_IDENTIFIER CTR_ABC_MFF_MON_1 ECU_ADDRESS 0xd000982c FORMAT "%3.0" /end MEASUREMENT
/begin MEASUREMENT fmy_stat_mff_mon_1.ctr_end_diag "counter for end of diagnosis for diagnosis instance MFF_MON_1" UBYTE _CNV_A_R_LINEAR_____0_CM 1 100. 0. 255. DISPLAY_IDENTIFIER CTR_ABC_END_DIAG_MFF_MON_1 ECU_ADDRESS 0xd000982d FORMAT "%3.0" /end MEASUREMENT
/begin MEASUREMENT fmy_stat_mff_mon_1.err_info_stat.lv_err_mem "storage in dynamic failure memory of the diagnosis instance MFF_MON_1" UWORD _CNV_S_2_RANGE__0___1_CM 1 100. 0. 1. DISPLAY_IDENTIFIER LV_ERR_MEM_MFF_MON_1 ECU_ADDRESS 0xd000982e BIT_MASK 0x8 /end MEASUREMENT
/begin MEASUREMENT fmy_stat_mff_mon_1.err_info_stat.lv_ready "readiness status of the diagnosis instance MFF_MON_1" UWORD _CNV_S_2_RANGE__0___1_CM 1 100. 0. 1. DISPLAY_IDENTIFIER LV_READY_MFF_MON_1 ECU_ADDRESS 0xd000982e BIT_MASK 0x10 /end MEASUREMENT
/begin MEASUREMENT fmy_stat_mff_mon_1.err_info_stat.lv_end_diag "end of diagnosis of the diagnosis instance MFF_MON_1" UWORD _CNV_S_2_RANGE__0___1_CM 1 100. 0. 1. DISPLAY_IDENTIFIER LV_END_DIAG_MFF_MON_1 ECU_ADDRESS 0xd000982e BIT_MASK 0x20 /end MEASUREMENT
/begin MEASUREMENT fmy_stat_mff_mon_1.err_info_stat.lv_cdn_diag "diagnosis condition of the diagnosis instance MFF_MON_1" UWORD _CNV_S_2_RANGE__0___1_CM 1 100. 0. 1. DISPLAY_IDENTIFIER LV_CDN_DIAG_MFF_MON_1 ECU_ADDRESS 0xd000982e BIT_MASK 0x40 /end MEASUREMENT
/begin MEASUREMENT fmy_stat_mff_mon_1.err_info_stat.err_sym "symptoms of the diagnosis instance MFF_MON_1" UWORD _CNV_S_16_RANGE_ERR__349_CM 1 100. 0. 15. DISPLAY_IDENTIFIER ERR_SYM_MFF_MON_1 ECU_ADDRESS 0xd000982e BIT_MASK 0x780 /end MEASUREMENT
/begin MEASUREMENT fmy_stat_cru_inh_mon_1.ctr_abc "anti bounce counter for diagnosis instance CRU_INH_MON_1" UBYTE _CNV_A_R_LINEAR_____0_CM 1 100. 0. 255. DISPLAY_IDENTIFIER CTR_ABC_CRU_INH_MON_1 ECU_ADDRESS 0xd000957c FORMAT "%3.0" /end MEASUREMENT
/begin MEASUREMENT fmy_stat_cru_inh_mon_1.ctr_end_diag "counter for end of diagnosis for diagnosis instance CRU_INH_MON_1" UBYTE _CNV_A_R_LINEAR_____0_CM 1 100. 0. 255. DISPLAY_IDENTIFIER CTR_ABC_END_DIAG_CRU_INH_MON_1 ECU_ADDRESS 0xd000957d FORMAT "%3.0" /end MEASUREMENT
/begin MEASUREMENT fmy_stat_cru_inh_mon_1.err_info_stat.lv_err_mem "storage in dynamic failure memory of the diagnosis instance CRU_INH_MON_1" UWORD _CNV_S_2_RANGE__0___1_CM 1 100. 0. 1. DISPLAY_IDENTIFIER LV_ERR_MEM_CRU_INH_MON_1 ECU_ADDRESS 0xd000957e BIT_MASK 0x8 /end MEASUREMENT
/begin MEASUREMENT fmy_stat_cru_inh_mon_1.err_info_stat.lv_ready "readiness status of the diagnosis instance CRU_INH_MON_1" UWORD _CNV_S_2_RANGE__0___1_CM 1 100. 0. 1. DISPLAY_IDENTIFIER LV_READY_CRU_INH_MON_1 ECU_ADDRESS 0xd000957e BIT_MASK 0x10 /end MEASUREMENT
/begin MEASUREMENT fmy_stat_cru_inh_mon_1.err_info_stat.lv_end_diag "end of diagnosis of the diagnosis instance CRU_INH_MON_1" UWORD _CNV_S_2_RANGE__0___1_CM 1 100. 0. 1. DISPLAY_IDENTIFIER LV_END_DIAG_CRU_INH_MON_1 ECU_ADDRESS 0xd000957e BIT_MASK 0x20 /end MEASUREMENT
/begin MEASUREMENT fmy_stat_cru_inh_mon_1.err_info_stat.lv_cdn_diag "diagnosis condition of the diagnosis instance CRU_INH_MON_1" UWORD _CNV_S_2_RANGE__0___1_CM 1 100. 0. 1. DISPLAY_IDENTIFIER LV_CDN_DIAG_CRU_INH_MON_1 ECU_ADDRESS 0xd000957e BIT_MASK 0x40 /end MEASUREMENT
/begin MEASUREMENT fmy_stat_cru_inh_mon_1.err_info_stat.err_sym "symptoms of the diagnosis instance CRU_INH_MON_1" UWORD _CNV_S_16_RANGE_ERR__349_CM 1 100. 0. 15. DISPLAY_IDENTIFIER ERR_SYM_CRU_INH_MON_1 ECU_ADDRESS 0xd000957e BIT_MASK 0x780 /end MEASUREMENT
/begin MEASUREMENT fmy_stat_swi_afs_mon.ctr_abc "anti bounce counter for diagnosis instance SWI_AFS_MON" UBYTE _CNV_A_R_LINEAR_____0_CM 1 100. 0. 255. DISPLAY_IDENTIFIER CTR_ABC_SWI_AFS_MON ECU_ADDRESS 0xd00099c0 FORMAT "%3.0" /end MEASUREMENT
/begin MEASUREMENT fmy_stat_swi_afs_mon.ctr_end_diag "counter for end of diagnosis for diagnosis instance SWI_AFS_MON" UBYTE _CNV_A_R_LINEAR_____0_CM 1 100. 0. 255. DISPLAY_IDENTIFIER CTR_ABC_END_DIAG_SWI_AFS_MON ECU_ADDRESS 0xd00099c1 FORMAT "%3.0" /end MEASUREMENT
/begin MEASUREMENT fmy_stat_swi_afs_mon.err_info_stat.lv_err_mem "storage in dynamic failure memory of the diagnosis instance SWI_AFS_MON" UWORD _CNV_S_2_RANGE__0___1_CM 1 100. 0. 1. DISPLAY_IDENTIFIER LV_ERR_MEM_SWI_AFS_MON ECU_ADDRESS 0xd00099c2 BIT_MASK 0x8 /end MEASUREMENT
/begin MEASUREMENT fmy_stat_swi_afs_mon.err_info_stat.lv_ready "readiness status of the diagnosis instance SWI_AFS_MON" UWORD _CNV_S_2_RANGE__0___1_CM 1 100. 0. 1. DISPLAY_IDENTIFIER LV_READY_SWI_AFS_MON ECU_ADDRESS 0xd00099c2 BIT_MASK 0x10 /end MEASUREMENT
/begin MEASUREMENT fmy_stat_swi_afs_mon.err_info_stat.lv_end_diag "end of diagnosis of the diagnosis instance SWI_AFS_MON" UWORD _CNV_S_2_RANGE__0___1_CM 1 100. 0. 1. DISPLAY_IDENTIFIER LV_END_DIAG_SWI_AFS_MON ECU_ADDRESS 0xd00099c2 BIT_MASK 0x20 /end MEASUREMENT
/begin MEASUREMENT fmy_stat_swi_afs_mon.err_info_stat.lv_cdn_diag "diagnosis condition of the diagnosis instance SWI_AFS_MON" UWORD _CNV_S_2_RANGE__0___1_CM 1 100. 0. 1. DISPLAY_IDENTIFIER LV_CDN_DIAG_SWI_AFS_MON ECU_ADDRESS 0xd00099c2 BIT_MASK 0x40 /end MEASUREMENT
/begin MEASUREMENT fmy_stat_swi_afs_mon.err_info_stat.err_sym "symptoms of the diagnosis instance SWI_AFS_MON" UWORD _CNV_S_16_RANGE_ERR__349_CM 1 100. 0. 15. DISPLAY_IDENTIFIER ERR_SYM_SWI_AFS_MON ECU_ADDRESS 0xd00099c2 BIT_MASK 0x780 /end MEASUREMENT
/begin MEASUREMENT fmy_stat_iv_0.ctr_abc "anti bounce counter for diagnosis instance IV_0" UBYTE _CNV_A_R_LINEAR_____0_CM 1 100. 0. 255. DISPLAY_IDENTIFIER CTR_ABC_IV_0 ECU_ADDRESS 0xd000976c FORMAT "%3.0" /end MEASUREMENT
/begin MEASUREMENT fmy_stat_iv_0.ctr_end_diag "counter for end of diagnosis for diagnosis instance IV_0" UBYTE _CNV_A_R_LINEAR_____0_CM 1 100. 0. 255. DISPLAY_IDENTIFIER CTR_ABC_END_DIAG_IV_0 ECU_ADDRESS 0xd000976d FORMAT "%3.0" /end MEASUREMENT
/begin MEASUREMENT fmy_stat_iv_0.err_info_stat.lv_err_mem "storage in dynamic failure memory of the diagnosis instance IV_0" UWORD _CNV_S_2_RANGE__0___1_CM 1 100. 0. 1. DISPLAY_IDENTIFIER LV_ERR_MEM_IV_0 ECU_ADDRESS 0xd000976e BIT_MASK 0x8 /end MEASUREMENT
/begin MEASUREMENT fmy_stat_iv_0.err_info_stat.lv_ready "readiness status of the diagnosis instance IV_0" UWORD _CNV_S_2_RANGE__0___1_CM 1 100. 0. 1. DISPLAY_IDENTIFIER LV_READY_IV_0 ECU_ADDRESS 0xd000976e BIT_MASK 0x10 /end MEASUREMENT
/begin MEASUREMENT fmy_stat_iv_0.err_info_stat.lv_end_diag "end of diagnosis of the diagnosis instance IV_0" UWORD _CNV_S_2_RANGE__0___1_CM 1 100. 0. 1. DISPLAY_IDENTIFIER LV_END_DIAG_IV_0 ECU_ADDRESS 0xd000976e BIT_MASK 0x20 /end MEASUREMENT
/begin MEASUREMENT fmy_stat_iv_0.err_info_stat.lv_cdn_diag "diagnosis condition of the diagnosis instance IV_0" UWORD _CNV_S_2_RANGE__0___1_CM 1 100. 0. 1. DISPLAY_IDENTIFIER LV_CDN_DIAG_IV_0 ECU_ADDRESS 0xd000976e BIT_MASK 0x40 /end MEASUREMENT
/begin MEASUREMENT fmy_stat_iv_0.err_info_stat.err_sym "symptoms of the diagnosis instance IV_0" UWORD _CNV_S_16_RANGE_ERR__349_CM 1 100. 0. 15. DISPLAY_IDENTIFIER ERR_SYM_IV_0 ECU_ADDRESS 0xd000976e BIT_MASK 0x780 /end MEASUREMENT
/begin MEASUREMENT fmy_stat_iv_1.ctr_abc "anti bounce counter for diagnosis instance IV_1" UBYTE _CNV_A_R_LINEAR_____0_CM 1 100. 0. 255. DISPLAY_IDENTIFIER CTR_ABC_IV_1 ECU_ADDRESS 0xd0009770 FORMAT "%3.0" /end MEASUREMENT
/begin MEASUREMENT fmy_stat_iv_1.ctr_end_diag "counter for end of diagnosis for diagnosis instance IV_1" UBYTE _CNV_A_R_LINEAR_____0_CM 1 100. 0. 255. DISPLAY_IDENTIFIER CTR_ABC_END_DIAG_IV_1 ECU_ADDRESS 0xd0009771 FORMAT "%3.0" /end MEASUREMENT
/begin MEASUREMENT fmy_stat_iv_1.err_info_stat.lv_err_mem "storage in dynamic failure memory of the diagnosis instance IV_1" UWORD _CNV_S_2_RANGE__0___1_CM 1 100. 0. 1. DISPLAY_IDENTIFIER LV_ERR_MEM_IV_1 ECU_ADDRESS 0xd0009772 BIT_MASK 0x8 /end MEASUREMENT
/begin MEASUREMENT fmy_stat_iv_1.err_info_stat.lv_ready "readiness status of the diagnosis instance IV_1" UWORD _CNV_S_2_RANGE__0___1_CM 1 100. 0. 1. DISPLAY_IDENTIFIER LV_READY_IV_1 ECU_ADDRESS 0xd0009772 BIT_MASK 0x10 /end MEASUREMENT
/begin MEASUREMENT fmy_stat_iv_1.err_info_stat.lv_end_diag "end of diagnosis of the diagnosis instance IV_1" UWORD _CNV_S_2_RANGE__0___1_CM 1 100. 0. 1. DISPLAY_IDENTIFIER LV_END_DIAG_IV_1 ECU_ADDRESS 0xd0009772 BIT_MASK 0x20 /end MEASUREMENT
/begin MEASUREMENT fmy_stat_iv_1.err_info_stat.lv_cdn_diag "diagnosis condition of the diagnosis instance IV_1" UWORD _CNV_S_2_RANGE__0___1_CM 1 100. 0. 1. DISPLAY_IDENTIFIER LV_CDN_DIAG_IV_1 ECU_ADDRESS 0xd0009772 BIT_MASK 0x40 /end MEASUREMENT
/begin MEASUREMENT fmy_stat_iv_1.err_info_stat.err_sym "symptoms of the diagnosis instance IV_1" UWORD _CNV_S_16_RANGE_ERR__349_CM 1 100. 0. 15. DISPLAY_IDENTIFIER ERR_SYM_IV_1 ECU_ADDRESS 0xd0009772 BIT_MASK 0x780 /end MEASUREMENT
/begin MEASUREMENT fmy_stat_iv_2.ctr_abc "anti bounce counter for diagnosis instance IV_2" UBYTE _CNV_A_R_LINEAR_____0_CM 1 100. 0. 255. DISPLAY_IDENTIFIER CTR_ABC_IV_2 ECU_ADDRESS 0xd0009774 FORMAT "%3.0" /end MEASUREMENT
/begin MEASUREMENT fmy_stat_iv_2.ctr_end_diag "counter for end of diagnosis for diagnosis instance IV_2" UBYTE _CNV_A_R_LINEAR_____0_CM 1 100. 0. 255. DISPLAY_IDENTIFIER CTR_ABC_END_DIAG_IV_2 ECU_ADDRESS 0xd0009775 FORMAT "%3.0" /end MEASUREMENT
/begin MEASUREMENT fmy_stat_iv_2.err_info_stat.lv_err_mem "storage in dynamic failure memory of the diagnosis instance IV_2" UWORD _CNV_S_2_RANGE__0___1_CM 1 100. 0. 1. DISPLAY_IDENTIFIER LV_ERR_MEM_IV_2 ECU_ADDRESS 0xd0009776 BIT_MASK 0x8 /end MEASUREMENT
/begin MEASUREMENT fmy_stat_iv_2.err_info_stat.lv_ready "readiness status of the diagnosis instance IV_2" UWORD _CNV_S_2_RANGE__0___1_CM 1 100. 0. 1. DISPLAY_IDENTIFIER LV_READY_IV_2 ECU_ADDRESS 0xd0009776 BIT_MASK 0x10 /end MEASUREMENT
/begin MEASUREMENT fmy_stat_iv_2.err_info_stat.lv_end_diag "end of diagnosis of the diagnosis instance IV_2" UWORD _CNV_S_2_RANGE__0___1_CM 1 100. 0. 1. DISPLAY_IDENTIFIER LV_END_DIAG_IV_2 ECU_ADDRESS 0xd0009776 BIT_MASK 0x20 /end MEASUREMENT
/begin MEASUREMENT fmy_stat_iv_2.err_info_stat.lv_cdn_diag "diagnosis condition of the diagnosis instance IV_2" UWORD _CNV_S_2_RANGE__0___1_CM 1 100. 0. 1. DISPLAY_IDENTIFIER LV_CDN_DIAG_IV_2 ECU_ADDRESS 0xd0009776 BIT_MASK 0x40 /end MEASUREMENT
/begin MEASUREMENT fmy_stat_iv_2.err_info_stat.err_sym "symptoms of the diagnosis instance IV_2" UWORD _CNV_S_16_RANGE_ERR__349_CM 1 100. 0. 15. DISPLAY_IDENTIFIER ERR_SYM_IV_2 ECU_ADDRESS 0xd0009776 BIT_MASK 0x780 /end MEASUREMENT
/begin MEASUREMENT fmy_stat_iv_3.ctr_abc "anti bounce counter for diagnosis instance IV_3" UBYTE _CNV_A_R_LINEAR_____0_CM 1 100. 0. 255. DISPLAY_IDENTIFIER CTR_ABC_IV_3 ECU_ADDRESS 0xd0009778 FORMAT "%3.0" /end MEASUREMENT
/begin MEASUREMENT fmy_stat_iv_3.ctr_end_diag "counter for end of diagnosis for diagnosis instance IV_3" UBYTE _CNV_A_R_LINEAR_____0_CM 1 100. 0. 255. DISPLAY_IDENTIFIER CTR_ABC_END_DIAG_IV_3 ECU_ADDRESS 0xd0009779 FORMAT "%3.0" /end MEASUREMENT
/begin MEASUREMENT fmy_stat_iv_3.err_info_stat.lv_err_mem "storage in dynamic failure memory of the diagnosis instance IV_3" UWORD _CNV_S_2_RANGE__0___1_CM 1 100. 0. 1. DISPLAY_IDENTIFIER LV_ERR_MEM_IV_3 ECU_ADDRESS 0xd000977a BIT_MASK 0x8 /end MEASUREMENT
/begin MEASUREMENT fmy_stat_iv_3.err_info_stat.lv_ready "readiness status of the diagnosis instance IV_3" UWORD _CNV_S_2_RANGE__0___1_CM 1 100. 0. 1. DISPLAY_IDENTIFIER LV_READY_IV_3 ECU_ADDRESS 0xd000977a BIT_MASK 0x10 /end MEASUREMENT
/begin MEASUREMENT fmy_stat_iv_3.err_info_stat.lv_end_diag "end of diagnosis of the diagnosis instance IV_3" UWORD _CNV_S_2_RANGE__0___1_CM 1 100. 0. 1. DISPLAY_IDENTIFIER LV_END_DIAG_IV_3 ECU_ADDRESS 0xd000977a BIT_MASK 0x20 /end MEASUREMENT
/begin MEASUREMENT fmy_stat_iv_3.err_info_stat.lv_cdn_diag "diagnosis condition of the diagnosis instance IV_3" UWORD _CNV_S_2_RANGE__0___1_CM 1 100. 0. 1. DISPLAY_IDENTIFIER LV_CDN_DIAG_IV_3 ECU_ADDRESS 0xd000977a BIT_MASK 0x40 /end MEASUREMENT
/begin MEASUREMENT fmy_stat_iv_3.err_info_stat.err_sym "symptoms of the diagnosis instance IV_3" UWORD _CNV_S_16_RANGE_ERR__349_CM 1 100. 0. 15. DISPLAY_IDENTIFIER ERR_SYM_IV_3 ECU_ADDRESS 0xd000977a BIT_MASK 0x780 /end MEASUREMENT
/begin MEASUREMENT fmy_stat_iv_4.ctr_abc "anti bounce counter for diagnosis instance IV_4" UBYTE _CNV_A_R_LINEAR_____0_CM 1 100. 0. 255. DISPLAY_IDENTIFIER CTR_ABC_IV_4 ECU_ADDRESS 0xd000977c FORMAT "%3.0" /end MEASUREMENT
/begin MEASUREMENT fmy_stat_iv_4.ctr_end_diag "counter for end of diagnosis for diagnosis instance IV_4" UBYTE _CNV_A_R_LINEAR_____0_CM 1 100. 0. 255. DISPLAY_IDENTIFIER CTR_ABC_END_DIAG_IV_4 ECU_ADDRESS 0xd000977d FORMAT "%3.0" /end MEASUREMENT
/begin MEASUREMENT fmy_stat_iv_4.err_info_stat.lv_err_mem "storage in dynamic failure memory of the diagnosis instance IV_4" UWORD _CNV_S_2_RANGE__0___1_CM 1 100. 0. 1. DISPLAY_IDENTIFIER LV_ERR_MEM_IV_4 ECU_ADDRESS 0xd000977e BIT_MASK 0x8 /end MEASUREMENT
/begin MEASUREMENT fmy_stat_iv_4.err_info_stat.lv_ready "readiness status of the diagnosis instance IV_4" UWORD _CNV_S_2_RANGE__0___1_CM 1 100. 0. 1. DISPLAY_IDENTIFIER LV_READY_IV_4 ECU_ADDRESS 0xd000977e BIT_MASK 0x10 /end MEASUREMENT
/begin MEASUREMENT fmy_stat_iv_4.err_info_stat.lv_end_diag "end of diagnosis of the diagnosis instance IV_4" UWORD _CNV_S_2_RANGE__0___1_CM 1 100. 0. 1. DISPLAY_IDENTIFIER LV_END_DIAG_IV_4 ECU_ADDRESS 0xd000977e BIT_MASK 0x20 /end MEASUREMENT
/begin MEASUREMENT fmy_stat_iv_4.err_info_stat.lv_cdn_diag "diagnosis condition of the diagnosis instance IV_4" UWORD _CNV_S_2_RANGE__0___1_CM 1 100. 0. 1. DISPLAY_IDENTIFIER LV_CDN_DIAG_IV_4 ECU_ADDRESS 0xd000977e BIT_MASK 0x40 /end MEASUREMENT
/begin MEASUREMENT fmy_stat_iv_4.err_info_stat.err_sym "symptoms of the diagnosis instance IV_4" UWORD _CNV_S_16_RANGE_ERR__349_CM 1 100. 0. 15. DISPLAY_IDENTIFIER ERR_SYM_IV_4 ECU_ADDRESS 0xd000977e BIT_MASK 0x780 /end MEASUREMENT
/begin MEASUREMENT fmy_stat_iv_5.ctr_abc "anti bounce counter for diagnosis instance IV_5" UBYTE _CNV_A_R_LINEAR_____0_CM 1 100. 0. 255. DISPLAY_IDENTIFIER CTR_ABC_IV_5 ECU_ADDRESS 0xd0009780 FORMAT "%3.0" /end MEASUREMENT
/begin MEASUREMENT fmy_stat_iv_5.ctr_end_diag "counter for end of diagnosis for diagnosis instance IV_5" UBYTE _CNV_A_R_LINEAR_____0_CM 1 100. 0. 255. DISPLAY_IDENTIFIER CTR_ABC_END_DIAG_IV_5 ECU_ADDRESS 0xd0009781 FORMAT "%3.0" /end MEASUREMENT
/begin MEASUREMENT fmy_stat_iv_5.err_info_stat.lv_err_mem "storage in dynamic failure memory of the diagnosis instance IV_5" UWORD _CNV_S_2_RANGE__0___1_CM 1 100. 0. 1. DISPLAY_IDENTIFIER LV_ERR_MEM_IV_5 ECU_ADDRESS 0xd0009782 BIT_MASK 0x8 /end MEASUREMENT
/begin MEASUREMENT fmy_stat_iv_5.err_info_stat.lv_ready "readiness status of the diagnosis instance IV_5" UWORD _CNV_S_2_RANGE__0___1_CM 1 100. 0. 1. DISPLAY_IDENTIFIER LV_READY_IV_5 ECU_ADDRESS 0xd0009782 BIT_MASK 0x10 /end MEASUREMENT
/begin MEASUREMENT fmy_stat_iv_5.err_info_stat.lv_end_diag "end of diagnosis of the diagnosis instance IV_5" UWORD _CNV_S_2_RANGE__0___1_CM 1 100. 0. 1. DISPLAY_IDENTIFIER LV_END_DIAG_IV_5 ECU_ADDRESS 0xd0009782 BIT_MASK 0x20 /end MEASUREMENT
/begin MEASUREMENT fmy_stat_iv_5.err_info_stat.lv_cdn_diag "diagnosis condition of the diagnosis instance IV_5" UWORD _CNV_S_2_RANGE__0___1_CM 1 100. 0. 1. DISPLAY_IDENTIFIER LV_CDN_DIAG_IV_5 ECU_ADDRESS 0xd0009782 BIT_MASK 0x40 /end MEASUREMENT
/begin MEASUREMENT fmy_stat_iv_5.err_info_stat.err_sym "symptoms of the diagnosis instance IV_5" UWORD _CNV_S_16_RANGE_ERR__349_CM 1 100. 0. 15. DISPLAY_IDENTIFIER ERR_SYM_IV_5 ECU_ADDRESS 0xd0009782 BIT_MASK 0x780 /end MEASUREMENT
/begin MEASUREMENT fmy_stat_iv_6.ctr_abc "anti bounce counter for diagnosis instance IV_6" UBYTE _CNV_A_R_LINEAR_____0_CM 1 100. 0. 255. DISPLAY_IDENTIFIER CTR_ABC_IV_6 ECU_ADDRESS 0xd0009784 FORMAT "%3.0" /end MEASUREMENT
/begin MEASUREMENT fmy_stat_iv_6.ctr_end_diag "counter for end of diagnosis for diagnosis instance IV_6" UBYTE _CNV_A_R_LINEAR_____0_CM 1 100. 0. 255. DISPLAY_IDENTIFIER CTR_ABC_END_DIAG_IV_6 ECU_ADDRESS 0xd0009785 FORMAT "%3.0" /end MEASUREMENT
/begin MEASUREMENT fmy_stat_iv_6.err_info_stat.lv_err_mem "storage in dynamic failure memory of the diagnosis instance IV_6" UWORD _CNV_S_2_RANGE__0___1_CM 1 100. 0. 1. DISPLAY_IDENTIFIER LV_ERR_MEM_IV_6 ECU_ADDRESS 0xd0009786 BIT_MASK 0x8 /end MEASUREMENT
/begin MEASUREMENT fmy_stat_iv_6.err_info_stat.lv_ready "readiness status of the diagnosis instance IV_6" UWORD _CNV_S_2_RANGE__0___1_CM 1 100. 0. 1. DISPLAY_IDENTIFIER LV_READY_IV_6 ECU_ADDRESS 0xd0009786 BIT_MASK 0x10 /end MEASUREMENT
/begin MEASUREMENT fmy_stat_iv_6.err_info_stat.lv_end_diag "end of diagnosis of the diagnosis instance IV_6" UWORD _CNV_S_2_RANGE__0___1_CM 1 100. 0. 1. DISPLAY_IDENTIFIER LV_END_DIAG_IV_6 ECU_ADDRESS 0xd0009786 BIT_MASK 0x20 /end MEASUREMENT
/begin MEASUREMENT fmy_stat_iv_6.err_info_stat.lv_cdn_diag "diagnosis condition of the diagnosis instance IV_6" UWORD _CNV_S_2_RANGE__0___1_CM 1 100. 0. 1. DISPLAY_IDENTIFIER LV_CDN_DIAG_IV_6 ECU_ADDRESS 0xd0009786 BIT_MASK 0x40 /end MEASUREMENT
/begin MEASUREMENT fmy_stat_iv_6.err_info_stat.err_sym "symptoms of the diagnosis instance IV_6" UWORD _CNV_S_16_RANGE_ERR__349_CM 1 100. 0. 15. DISPLAY_IDENTIFIER ERR_SYM_IV_6 ECU_ADDRESS 0xd0009786 BIT_MASK 0x780 /end MEASUREMENT
/begin MEASUREMENT fmy_stat_iv_7.ctr_abc "anti bounce counter for diagnosis instance IV_7" UBYTE _CNV_A_R_LINEAR_____0_CM 1 100. 0. 255. DISPLAY_IDENTIFIER CTR_ABC_IV_7 ECU_ADDRESS 0xd0009788 FORMAT "%3.0" /end MEASUREMENT
/begin MEASUREMENT fmy_stat_iv_7.ctr_end_diag "counter for end of diagnosis for diagnosis instance IV_7" UBYTE _CNV_A_R_LINEAR_____0_CM 1 100. 0. 255. DISPLAY_IDENTIFIER CTR_ABC_END_DIAG_IV_7 ECU_ADDRESS 0xd0009789 FORMAT "%3.0" /end MEASUREMENT
/begin MEASUREMENT fmy_stat_iv_7.err_info_stat.lv_err_mem "storage in dynamic failure memory of the diagnosis instance IV_7" UWORD _CNV_S_2_RANGE__0___1_CM 1 100. 0. 1. DISPLAY_IDENTIFIER LV_ERR_MEM_IV_7 ECU_ADDRESS 0xd000978a BIT_MASK 0x8 /end MEASUREMENT
/begin MEASUREMENT fmy_stat_iv_7.err_info_stat.lv_ready "readiness status of the diagnosis instance IV_7" UWORD _CNV_S_2_RANGE__0___1_CM 1 100. 0. 1. DISPLAY_IDENTIFIER LV_READY_IV_7 ECU_ADDRESS 0xd000978a BIT_MASK 0x10 /end MEASUREMENT
/begin MEASUREMENT fmy_stat_iv_7.err_info_stat.lv_end_diag "end of diagnosis of the diagnosis instance IV_7" UWORD _CNV_S_2_RANGE__0___1_CM 1 100. 0. 1. DISPLAY_IDENTIFIER LV_END_DIAG_IV_7 ECU_ADDRESS 0xd000978a BIT_MASK 0x20 /end MEASUREMENT
/begin MEASUREMENT fmy_stat_iv_7.err_info_stat.lv_cdn_diag "diagnosis condition of the diagnosis instance IV_7" UWORD _CNV_S_2_RANGE__0___1_CM 1 100. 0. 1. DISPLAY_IDENTIFIER LV_CDN_DIAG_IV_7 ECU_ADDRESS 0xd000978a BIT_MASK 0x40 /end MEASUREMENT
/begin MEASUREMENT fmy_stat_iv_7.err_info_stat.err_sym "symptoms of the diagnosis instance IV_7" UWORD _CNV_S_16_RANGE_ERR__349_CM 1 100. 0. 15. DISPLAY_IDENTIFIER ERR_SYM_IV_7 ECU_ADDRESS 0xd000978a BIT_MASK 0x780 /end MEASUREMENT
/begin MEASUREMENT fmy_stat_iv_sc_0.ctr_abc "anti bounce counter for diagnosis instance IV_SC_0" UBYTE _CNV_A_R_LINEAR_____0_CM 1 100. 0. 255. DISPLAY_IDENTIFIER CTR_ABC_IV_SC_0 ECU_ADDRESS 0xd000978c FORMAT "%3.0" /end MEASUREMENT
/begin MEASUREMENT fmy_stat_iv_sc_0.ctr_end_diag "counter for end of diagnosis for diagnosis instance IV_SC_0" UBYTE _CNV_A_R_LINEAR_____0_CM 1 100. 0. 255. DISPLAY_IDENTIFIER CTR_ABC_END_DIAG_IV_SC_0 ECU_ADDRESS 0xd000978d FORMAT "%3.0" /end MEASUREMENT
/begin MEASUREMENT fmy_stat_iv_sc_0.err_info_stat.lv_err_mem "storage in dynamic failure memory of the diagnosis instance IV_SC_0" UWORD _CNV_S_2_RANGE__0___1_CM 1 100. 0. 1. DISPLAY_IDENTIFIER LV_ERR_MEM_IV_SC_0 ECU_ADDRESS 0xd000978e BIT_MASK 0x8 /end MEASUREMENT
/begin MEASUREMENT fmy_stat_iv_sc_0.err_info_stat.lv_ready "readiness status of the diagnosis instance IV_SC_0" UWORD _CNV_S_2_RANGE__0___1_CM 1 100. 0. 1. DISPLAY_IDENTIFIER LV_READY_IV_SC_0 ECU_ADDRESS 0xd000978e BIT_MASK 0x10 /end MEASUREMENT
/begin MEASUREMENT fmy_stat_iv_sc_0.err_info_stat.lv_end_diag "end of diagnosis of the diagnosis instance IV_SC_0" UWORD _CNV_S_2_RANGE__0___1_CM 1 100. 0. 1. DISPLAY_IDENTIFIER LV_END_DIAG_IV_SC_0 ECU_ADDRESS 0xd000978e BIT_MASK 0x20 /end MEASUREMENT
/begin MEASUREMENT fmy_stat_iv_sc_0.err_info_stat.lv_cdn_diag "diagnosis condition of the diagnosis instance IV_SC_0" UWORD _CNV_S_2_RANGE__0___1_CM 1 100. 0. 1. DISPLAY_IDENTIFIER LV_CDN_DIAG_IV_SC_0 ECU_ADDRESS 0xd000978e BIT_MASK 0x40 /end MEASUREMENT
/begin MEASUREMENT fmy_stat_iv_sc_0.err_info_stat.err_sym "symptoms of the diagnosis instance IV_SC_0" UWORD _CNV_S_16_RANGE_ERR__349_CM 1 100. 0. 15. DISPLAY_IDENTIFIER ERR_SYM_IV_SC_0 ECU_ADDRESS 0xd000978e BIT_MASK 0x780 /end MEASUREMENT
/begin MEASUREMENT fmy_stat_iv_sc_1.ctr_abc "anti bounce counter for diagnosis instance IV_SC_1" UBYTE _CNV_A_R_LINEAR_____0_CM 1 100. 0. 255. DISPLAY_IDENTIFIER CTR_ABC_IV_SC_1 ECU_ADDRESS 0xd0009790 FORMAT "%3.0" /end MEASUREMENT
/begin MEASUREMENT fmy_stat_iv_sc_1.ctr_end_diag "counter for end of diagnosis for diagnosis instance IV_SC_1" UBYTE _CNV_A_R_LINEAR_____0_CM 1 100. 0. 255. DISPLAY_IDENTIFIER CTR_ABC_END_DIAG_IV_SC_1 ECU_ADDRESS 0xd0009791 FORMAT "%3.0" /end MEASUREMENT
/begin MEASUREMENT fmy_stat_iv_sc_1.err_info_stat.lv_err_mem "storage in dynamic failure memory of the diagnosis instance IV_SC_1" UWORD _CNV_S_2_RANGE__0___1_CM 1 100. 0. 1. DISPLAY_IDENTIFIER LV_ERR_MEM_IV_SC_1 ECU_ADDRESS 0xd0009792 BIT_MASK 0x8 /end MEASUREMENT
/begin MEASUREMENT fmy_stat_iv_sc_1.err_info_stat.lv_ready "readiness status of the diagnosis instance IV_SC_1" UWORD _CNV_S_2_RANGE__0___1_CM 1 100. 0. 1. DISPLAY_IDENTIFIER LV_READY_IV_SC_1 ECU_ADDRESS 0xd0009792 BIT_MASK 0x10 /end MEASUREMENT
/begin MEASUREMENT fmy_stat_iv_sc_1.err_info_stat.lv_end_diag "end of diagnosis of the diagnosis instance IV_SC_1" UWORD _CNV_S_2_RANGE__0___1_CM 1 100. 0. 1. DISPLAY_IDENTIFIER LV_END_DIAG_IV_SC_1 ECU_ADDRESS 0xd0009792 BIT_MASK 0x20 /end MEASUREMENT
/begin MEASUREMENT fmy_stat_iv_sc_1.err_info_stat.lv_cdn_diag "diagnosis condition of the diagnosis instance IV_SC_1" UWORD _CNV_S_2_RANGE__0___1_CM 1 100. 0. 1. DISPLAY_IDENTIFIER LV_CDN_DIAG_IV_SC_1 ECU_ADDRESS 0xd0009792 BIT_MASK 0x40 /end MEASUREMENT
/begin MEASUREMENT fmy_stat_iv_sc_1.err_info_stat.err_sym "symptoms of the diagnosis instance IV_SC_1" UWORD _CNV_S_16_RANGE_ERR__349_CM 1 100. 0. 15. DISPLAY_IDENTIFIER ERR_SYM_IV_SC_1 ECU_ADDRESS 0xd0009792 BIT_MASK 0x780 /end MEASUREMENT
/begin MEASUREMENT fmy_stat_iv_sc_2.ctr_abc "anti bounce counter for diagnosis instance IV_SC_2" UBYTE _CNV_A_R_LINEAR_____0_CM 1 100. 0. 255. DISPLAY_IDENTIFIER CTR_ABC_IV_SC_2 ECU_ADDRESS 0xd0009794 FORMAT "%3.0" /end MEASUREMENT
/begin MEASUREMENT fmy_stat_iv_sc_2.ctr_end_diag "counter for end of diagnosis for diagnosis instance IV_SC_2" UBYTE _CNV_A_R_LINEAR_____0_CM 1 100. 0. 255. DISPLAY_IDENTIFIER CTR_ABC_END_DIAG_IV_SC_2 ECU_ADDRESS 0xd0009795 FORMAT "%3.0" /end MEASUREMENT
/begin MEASUREMENT fmy_stat_iv_sc_2.err_info_stat.lv_err_mem "storage in dynamic failure memory of the diagnosis instance IV_SC_2" UWORD _CNV_S_2_RANGE__0___1_CM 1 100. 0. 1. DISPLAY_IDENTIFIER LV_ERR_MEM_IV_SC_2 ECU_ADDRESS 0xd0009796 BIT_MASK 0x8 /end MEASUREMENT
/begin MEASUREMENT fmy_stat_iv_sc_2.err_info_stat.lv_ready "readiness status of the diagnosis instance IV_SC_2" UWORD _CNV_S_2_RANGE__0___1_CM 1 100. 0. 1. DISPLAY_IDENTIFIER LV_READY_IV_SC_2 ECU_ADDRESS 0xd0009796 BIT_MASK 0x10 /end MEASUREMENT
/begin MEASUREMENT fmy_stat_iv_sc_2.err_info_stat.lv_end_diag "end of diagnosis of the diagnosis instance IV_SC_2" UWORD _CNV_S_2_RANGE__0___1_CM 1 100. 0. 1. DISPLAY_IDENTIFIER LV_END_DIAG_IV_SC_2 ECU_ADDRESS 0xd0009796 BIT_MASK 0x20 /end MEASUREMENT
/begin MEASUREMENT fmy_stat_iv_sc_2.err_info_stat.lv_cdn_diag "diagnosis condition of the diagnosis instance IV_SC_2" UWORD _CNV_S_2_RANGE__0___1_CM 1 100. 0. 1. DISPLAY_IDENTIFIER LV_CDN_DIAG_IV_SC_2 ECU_ADDRESS 0xd0009796 BIT_MASK 0x40 /end MEASUREMENT
/begin MEASUREMENT fmy_stat_iv_sc_2.err_info_stat.err_sym "symptoms of the diagnosis instance IV_SC_2" UWORD _CNV_S_16_RANGE_ERR__349_CM 1 100. 0. 15. DISPLAY_IDENTIFIER ERR_SYM_IV_SC_2 ECU_ADDRESS 0xd0009796 BIT_MASK 0x780 /end MEASUREMENT
/begin MEASUREMENT fmy_stat_iv_sc_3.ctr_abc "anti bounce counter for diagnosis instance IV_SC_3" UBYTE _CNV_A_R_LINEAR_____0_CM 1 100. 0. 255. DISPLAY_IDENTIFIER CTR_ABC_IV_SC_3 ECU_ADDRESS 0xd0009798 FORMAT "%3.0" /end MEASUREMENT
/begin MEASUREMENT fmy_stat_iv_sc_3.ctr_end_diag "counter for end of diagnosis for diagnosis instance IV_SC_3" UBYTE _CNV_A_R_LINEAR_____0_CM 1 100. 0. 255. DISPLAY_IDENTIFIER CTR_ABC_END_DIAG_IV_SC_3 ECU_ADDRESS 0xd0009799 FORMAT "%3.0" /end MEASUREMENT
/begin MEASUREMENT fmy_stat_iv_sc_3.err_info_stat.lv_err_mem "storage in dynamic failure memory of the diagnosis instance IV_SC_3" UWORD _CNV_S_2_RANGE__0___1_CM 1 100. 0. 1. DISPLAY_IDENTIFIER LV_ERR_MEM_IV_SC_3 ECU_ADDRESS 0xd000979a BIT_MASK 0x8 /end MEASUREMENT
/begin MEASUREMENT fmy_stat_iv_sc_3.err_info_stat.lv_ready "readiness status of the diagnosis instance IV_SC_3" UWORD _CNV_S_2_RANGE__0___1_CM 1 100. 0. 1. DISPLAY_IDENTIFIER LV_READY_IV_SC_3 ECU_ADDRESS 0xd000979a BIT_MASK 0x10 /end MEASUREMENT
/begin MEASUREMENT fmy_stat_iv_sc_3.err_info_stat.lv_end_diag "end of diagnosis of the diagnosis instance IV_SC_3" UWORD _CNV_S_2_RANGE__0___1_CM 1 100. 0. 1. DISPLAY_IDENTIFIER LV_END_DIAG_IV_SC_3 ECU_ADDRESS 0xd000979a BIT_MASK 0x20 /end MEASUREMENT
/begin MEASUREMENT fmy_stat_iv_sc_3.err_info_stat.lv_cdn_diag "diagnosis condition of the diagnosis instance IV_SC_3" UWORD _CNV_S_2_RANGE__0___1_CM 1 100. 0. 1. DISPLAY_IDENTIFIER LV_CDN_DIAG_IV_SC_3 ECU_ADDRESS 0xd000979a BIT_MASK 0x40 /end MEASUREMENT
/begin MEASUREMENT fmy_stat_iv_sc_3.err_info_stat.err_sym "symptoms of the diagnosis instance IV_SC_3" UWORD _CNV_S_16_RANGE_ERR__349_CM 1 100. 0. 15. DISPLAY_IDENTIFIER ERR_SYM_IV_SC_3 ECU_ADDRESS 0xd000979a BIT_MASK 0x780 /end MEASUREMENT
/begin MEASUREMENT fmy_stat_iv_sc_4.ctr_abc "anti bounce counter for diagnosis instance IV_SC_4" UBYTE _CNV_A_R_LINEAR_____0_CM 1 100. 0. 255. DISPLAY_IDENTIFIER CTR_ABC_IV_SC_4 ECU_ADDRESS 0xd000979c FORMAT "%3.0" /end MEASUREMENT
/begin MEASUREMENT fmy_stat_iv_sc_4.ctr_end_diag "counter for end of diagnosis for diagnosis instance IV_SC_4" UBYTE _CNV_A_R_LINEAR_____0_CM 1 100. 0. 255. DISPLAY_IDENTIFIER CTR_ABC_END_DIAG_IV_SC_4 ECU_ADDRESS 0xd000979d FORMAT "%3.0" /end MEASUREMENT
/begin MEASUREMENT fmy_stat_iv_sc_4.err_info_stat.lv_err_mem "storage in dynamic failure memory of the diagnosis instance IV_SC_4" UWORD _CNV_S_2_RANGE__0___1_CM 1 100. 0. 1. DISPLAY_IDENTIFIER LV_ERR_MEM_IV_SC_4 ECU_ADDRESS 0xd000979e BIT_MASK 0x8 /end MEASUREMENT
/begin MEASUREMENT fmy_stat_iv_sc_4.err_info_stat.lv_ready "readiness status of the diagnosis instance IV_SC_4" UWORD _CNV_S_2_RANGE__0___1_CM 1 100. 0. 1. DISPLAY_IDENTIFIER LV_READY_IV_SC_4 ECU_ADDRESS 0xd000979e BIT_MASK 0x10 /end MEASUREMENT
/begin MEASUREMENT fmy_stat_iv_sc_4.err_info_stat.lv_end_diag "end of diagnosis of the diagnosis instance IV_SC_4" UWORD _CNV_S_2_RANGE__0___1_CM 1 100. 0. 1. DISPLAY_IDENTIFIER LV_END_DIAG_IV_SC_4 ECU_ADDRESS 0xd000979e BIT_MASK 0x20 /end MEASUREMENT
/begin MEASUREMENT fmy_stat_iv_sc_4.err_info_stat.lv_cdn_diag "diagnosis condition of the diagnosis instance IV_SC_4" UWORD _CNV_S_2_RANGE__0___1_CM 1 100. 0. 1. DISPLAY_IDENTIFIER LV_CDN_DIAG_IV_SC_4 ECU_ADDRESS 0xd000979e BIT_MASK 0x40 /end MEASUREMENT
/begin MEASUREMENT fmy_stat_iv_sc_4.err_info_stat.err_sym "symptoms of the diagnosis instance IV_SC_4" UWORD _CNV_S_16_RANGE_ERR__349_CM 1 100. 0. 15. DISPLAY_IDENTIFIER ERR_SYM_IV_SC_4 ECU_ADDRESS 0xd000979e BIT_MASK 0x780 /end MEASUREMENT
/begin MEASUREMENT fmy_stat_iv_sc_5.ctr_abc "anti bounce counter for diagnosis instance IV_SC_5" UBYTE _CNV_A_R_LINEAR_____0_CM 1 100. 0. 255. DISPLAY_IDENTIFIER CTR_ABC_IV_SC_5 ECU_ADDRESS 0xd00097a0 FORMAT "%3.0" /end MEASUREMENT
/begin MEASUREMENT fmy_stat_iv_sc_5.ctr_end_diag "counter for end of diagnosis for diagnosis instance IV_SC_5" UBYTE _CNV_A_R_LINEAR_____0_CM 1 100. 0. 255. DISPLAY_IDENTIFIER CTR_ABC_END_DIAG_IV_SC_5 ECU_ADDRESS 0xd00097a1 FORMAT "%3.0" /end MEASUREMENT
/begin MEASUREMENT fmy_stat_iv_sc_5.err_info_stat.lv_err_mem "storage in dynamic failure memory of the diagnosis instance IV_SC_5" UWORD _CNV_S_2_RANGE__0___1_CM 1 100. 0. 1. DISPLAY_IDENTIFIER LV_ERR_MEM_IV_SC_5 ECU_ADDRESS 0xd00097a2 BIT_MASK 0x8 /end MEASUREMENT
/begin MEASUREMENT fmy_stat_iv_sc_5.err_info_stat.lv_ready "readiness status of the diagnosis instance IV_SC_5" UWORD _CNV_S_2_RANGE__0___1_CM 1 100. 0. 1. DISPLAY_IDENTIFIER LV_READY_IV_SC_5 ECU_ADDRESS 0xd00097a2 BIT_MASK 0x10 /end MEASUREMENT
/begin MEASUREMENT fmy_stat_iv_sc_5.err_info_stat.lv_end_diag "end of diagnosis of the diagnosis instance IV_SC_5" UWORD _CNV_S_2_RANGE__0___1_CM 1 100. 0. 1. DISPLAY_IDENTIFIER LV_END_DIAG_IV_SC_5 ECU_ADDRESS 0xd00097a2 BIT_MASK 0x20 /end MEASUREMENT
/begin MEASUREMENT fmy_stat_iv_sc_5.err_info_stat.lv_cdn_diag "diagnosis condition of the diagnosis instance IV_SC_5" UWORD _CNV_S_2_RANGE__0___1_CM 1 100. 0. 1. DISPLAY_IDENTIFIER LV_CDN_DIAG_IV_SC_5 ECU_ADDRESS 0xd00097a2 BIT_MASK 0x40 /end MEASUREMENT
/begin MEASUREMENT fmy_stat_iv_sc_5.err_info_stat.err_sym "symptoms of the diagnosis instance IV_SC_5" UWORD _CNV_S_16_RANGE_ERR__349_CM 1 100. 0. 15. DISPLAY_IDENTIFIER ERR_SYM_IV_SC_5 ECU_ADDRESS 0xd00097a2 BIT_MASK 0x780 /end MEASUREMENT
/begin MEASUREMENT fmy_stat_iv_sc_6.ctr_abc "anti bounce counter for diagnosis instance IV_SC_6" UBYTE _CNV_A_R_LINEAR_____0_CM 1 100. 0. 255. DISPLAY_IDENTIFIER CTR_ABC_IV_SC_6 ECU_ADDRESS 0xd00097a4 FORMAT "%3.0" /end MEASUREMENT
/begin MEASUREMENT fmy_stat_iv_sc_6.ctr_end_diag "counter for end of diagnosis for diagnosis instance IV_SC_6" UBYTE _CNV_A_R_LINEAR_____0_CM 1 100. 0. 255. DISPLAY_IDENTIFIER CTR_ABC_END_DIAG_IV_SC_6 ECU_ADDRESS 0xd00097a5 FORMAT "%3.0" /end MEASUREMENT
/begin MEASUREMENT fmy_stat_iv_sc_6.err_info_stat.lv_err_mem "storage in dynamic failure memory of the diagnosis instance IV_SC_6" UWORD _CNV_S_2_RANGE__0___1_CM 1 100. 0. 1. DISPLAY_IDENTIFIER LV_ERR_MEM_IV_SC_6 ECU_ADDRESS 0xd00097a6 BIT_MASK 0x8 /end MEASUREMENT
/begin MEASUREMENT fmy_stat_iv_sc_6.err_info_stat.lv_ready "readiness status of the diagnosis instance IV_SC_6" UWORD _CNV_S_2_RANGE__0___1_CM 1 100. 0. 1. DISPLAY_IDENTIFIER LV_READY_IV_SC_6 ECU_ADDRESS 0xd00097a6 BIT_MASK 0x10 /end MEASUREMENT
/begin MEASUREMENT fmy_stat_iv_sc_6.err_info_stat.lv_end_diag "end of diagnosis of the diagnosis instance IV_SC_6" UWORD _CNV_S_2_RANGE__0___1_CM 1 100. 0. 1. DISPLAY_IDENTIFIER LV_END_DIAG_IV_SC_6 ECU_ADDRESS 0xd00097a6 BIT_MASK 0x20 /end MEASUREMENT
/begin MEASUREMENT fmy_stat_iv_sc_6.err_info_stat.lv_cdn_diag "diagnosis condition of the diagnosis instance IV_SC_6" UWORD _CNV_S_2_RANGE__0___1_CM 1 100. 0. 1. DISPLAY_IDENTIFIER LV_CDN_DIAG_IV_SC_6 ECU_ADDRESS 0xd00097a6 BIT_MASK 0x40 /end MEASUREMENT
/begin MEASUREMENT fmy_stat_iv_sc_6.err_info_stat.err_sym "symptoms of the diagnosis instance IV_SC_6" UWORD _CNV_S_16_RANGE_ERR__349_CM 1 100. 0. 15. DISPLAY_IDENTIFIER ERR_SYM_IV_SC_6 ECU_ADDRESS 0xd00097a6 BIT_MASK 0x780 /end MEASUREMENT
/begin MEASUREMENT fmy_stat_iv_sc_7.ctr_abc "anti bounce counter for diagnosis instance IV_SC_7" UBYTE _CNV_A_R_LINEAR_____0_CM 1 100. 0. 255. DISPLAY_IDENTIFIER CTR_ABC_IV_SC_7 ECU_ADDRESS 0xd00097a8 FORMAT "%3.0" /end MEASUREMENT
/begin MEASUREMENT fmy_stat_iv_sc_7.ctr_end_diag "counter for end of diagnosis for diagnosis instance IV_SC_7" UBYTE _CNV_A_R_LINEAR_____0_CM 1 100. 0. 255. DISPLAY_IDENTIFIER CTR_ABC_END_DIAG_IV_SC_7 ECU_ADDRESS 0xd00097a9 FORMAT "%3.0" /end MEASUREMENT
/begin MEASUREMENT fmy_stat_iv_sc_7.err_info_stat.lv_err_mem "storage in dynamic failure memory of the diagnosis instance IV_SC_7" UWORD _CNV_S_2_RANGE__0___1_CM 1 100. 0. 1. DISPLAY_IDENTIFIER LV_ERR_MEM_IV_SC_7 ECU_ADDRESS 0xd00097aa BIT_MASK 0x8 /end MEASUREMENT
/begin MEASUREMENT fmy_stat_iv_sc_7.err_info_stat.lv_ready "readiness status of the diagnosis instance IV_SC_7" UWORD _CNV_S_2_RANGE__0___1_CM 1 100. 0. 1. DISPLAY_IDENTIFIER LV_READY_IV_SC_7 ECU_ADDRESS 0xd00097aa BIT_MASK 0x10 /end MEASUREMENT
/begin MEASUREMENT fmy_stat_iv_sc_7.err_info_stat.lv_end_diag "end of diagnosis of the diagnosis instance IV_SC_7" UWORD _CNV_S_2_RANGE__0___1_CM 1 100. 0. 1. DISPLAY_IDENTIFIER LV_END_DIAG_IV_SC_7 ECU_ADDRESS 0xd00097aa BIT_MASK 0x20 /end MEASUREMENT
/begin MEASUREMENT fmy_stat_iv_sc_7.err_info_stat.lv_cdn_diag "diagnosis condition of the diagnosis instance IV_SC_7" UWORD _CNV_S_2_RANGE__0___1_CM 1 100. 0. 1. DISPLAY_IDENTIFIER LV_CDN_DIAG_IV_SC_7 ECU_ADDRESS 0xd00097aa BIT_MASK 0x40 /end MEASUREMENT
/begin MEASUREMENT fmy_stat_iv_sc_7.err_info_stat.err_sym "symptoms of the diagnosis instance IV_SC_7" UWORD _CNV_S_16_RANGE_ERR__349_CM 1 100. 0. 15. DISPLAY_IDENTIFIER ERR_SYM_IV_SC_7 ECU_ADDRESS 0xd00097aa BIT_MASK 0x780 /end MEASUREMENT
/begin MEASUREMENT fmy_stat_pbk_iv_1.ctr_abc "anti bounce counter for diagnosis instance PBK_IV_1" UBYTE _CNV_A_R_LINEAR_____0_CM 1 100. 0. 255. DISPLAY_IDENTIFIER CTR_ABC_PBK_IV_1 ECU_ADDRESS 0xd00098b0 FORMAT "%3.0" /end MEASUREMENT
/begin MEASUREMENT fmy_stat_pbk_iv_1.ctr_end_diag "counter for end of diagnosis for diagnosis instance PBK_IV_1" UBYTE _CNV_A_R_LINEAR_____0_CM 1 100. 0. 255. DISPLAY_IDENTIFIER CTR_ABC_END_DIAG_PBK_IV_1 ECU_ADDRESS 0xd00098b1 FORMAT "%3.0" /end MEASUREMENT
/begin MEASUREMENT fmy_stat_pbk_iv_1.err_info_stat.lv_err_mem "storage in dynamic failure memory of the diagnosis instance PBK_IV_1" UWORD _CNV_S_2_RANGE__0___1_CM 1 100. 0. 1. DISPLAY_IDENTIFIER LV_ERR_MEM_PBK_IV_1 ECU_ADDRESS 0xd00098b2 BIT_MASK 0x8 /end MEASUREMENT
/begin MEASUREMENT fmy_stat_pbk_iv_1.err_info_stat.lv_ready "readiness status of the diagnosis instance PBK_IV_1" UWORD _CNV_S_2_RANGE__0___1_CM 1 100. 0. 1. DISPLAY_IDENTIFIER LV_READY_PBK_IV_1 ECU_ADDRESS 0xd00098b2 BIT_MASK 0x10 /end MEASUREMENT
/begin MEASUREMENT fmy_stat_pbk_iv_1.err_info_stat.lv_end_diag "end of diagnosis of the diagnosis instance PBK_IV_1" UWORD _CNV_S_2_RANGE__0___1_CM 1 100. 0. 1. DISPLAY_IDENTIFIER LV_END_DIAG_PBK_IV_1 ECU_ADDRESS 0xd00098b2 BIT_MASK 0x20 /end MEASUREMENT
/begin MEASUREMENT fmy_stat_pbk_iv_1.err_info_stat.lv_cdn_diag "diagnosis condition of the diagnosis instance PBK_IV_1" UWORD _CNV_S_2_RANGE__0___1_CM 1 100. 0. 1. DISPLAY_IDENTIFIER LV_CDN_DIAG_PBK_IV_1 ECU_ADDRESS 0xd00098b2 BIT_MASK 0x40 /end MEASUREMENT
/begin MEASUREMENT fmy_stat_pbk_iv_1.err_info_stat.err_sym "symptoms of the diagnosis instance PBK_IV_1" UWORD _CNV_S_16_RANGE_ERR__349_CM 1 100. 0. 15. DISPLAY_IDENTIFIER ERR_SYM_PBK_IV_1 ECU_ADDRESS 0xd00098b2 BIT_MASK 0x780 /end MEASUREMENT
/begin MEASUREMENT fmy_stat_pbk_iv_2.ctr_abc "anti bounce counter for diagnosis instance PBK_IV_2" UBYTE _CNV_A_R_LINEAR_____0_CM 1 100. 0. 255. DISPLAY_IDENTIFIER CTR_ABC_PBK_IV_2 ECU_ADDRESS 0xd00098b4 FORMAT "%3.0" /end MEASUREMENT
/begin MEASUREMENT fmy_stat_pbk_iv_2.ctr_end_diag "counter for end of diagnosis for diagnosis instance PBK_IV_2" UBYTE _CNV_A_R_LINEAR_____0_CM 1 100. 0. 255. DISPLAY_IDENTIFIER CTR_ABC_END_DIAG_PBK_IV_2 ECU_ADDRESS 0xd00098b5 FORMAT "%3.0" /end MEASUREMENT
/begin MEASUREMENT fmy_stat_pbk_iv_2.err_info_stat.lv_err_mem "storage in dynamic failure memory of the diagnosis instance PBK_IV_2" UWORD _CNV_S_2_RANGE__0___1_CM 1 100. 0. 1. DISPLAY_IDENTIFIER LV_ERR_MEM_PBK_IV_2 ECU_ADDRESS 0xd00098b6 BIT_MASK 0x8 /end MEASUREMENT
/begin MEASUREMENT fmy_stat_pbk_iv_2.err_info_stat.lv_ready "readiness status of the diagnosis instance PBK_IV_2" UWORD _CNV_S_2_RANGE__0___1_CM 1 100. 0. 1. DISPLAY_IDENTIFIER LV_READY_PBK_IV_2 ECU_ADDRESS 0xd00098b6 BIT_MASK 0x10 /end MEASUREMENT
/begin MEASUREMENT fmy_stat_pbk_iv_2.err_info_stat.lv_end_diag "end of diagnosis of the diagnosis instance PBK_IV_2" UWORD _CNV_S_2_RANGE__0___1_CM 1 100. 0. 1. DISPLAY_IDENTIFIER LV_END_DIAG_PBK_IV_2 ECU_ADDRESS 0xd00098b6 BIT_MASK 0x20 /end MEASUREMENT
/begin MEASUREMENT fmy_stat_pbk_iv_2.err_info_stat.lv_cdn_diag "diagnosis condition of the diagnosis instance PBK_IV_2" UWORD _CNV_S_2_RANGE__0___1_CM 1 100. 0. 1. DISPLAY_IDENTIFIER LV_CDN_DIAG_PBK_IV_2 ECU_ADDRESS 0xd00098b6 BIT_MASK 0x40 /end MEASUREMENT
/begin MEASUREMENT fmy_stat_pbk_iv_2.err_info_stat.err_sym "symptoms of the diagnosis instance PBK_IV_2" UWORD _CNV_S_16_RANGE_ERR__349_CM 1 100. 0. 15. DISPLAY_IDENTIFIER ERR_SYM_PBK_IV_2 ECU_ADDRESS 0xd00098b6 BIT_MASK 0x780 /end MEASUREMENT
/begin MEASUREMENT fmy_stat_pbk_iv_3.ctr_abc "anti bounce counter for diagnosis instance PBK_IV_3" UBYTE _CNV_A_R_LINEAR_____0_CM 1 100. 0. 255. DISPLAY_IDENTIFIER CTR_ABC_PBK_IV_3 ECU_ADDRESS 0xd00098b8 FORMAT "%3.0" /end MEASUREMENT
/begin MEASUREMENT fmy_stat_pbk_iv_3.ctr_end_diag "counter for end of diagnosis for diagnosis instance PBK_IV_3" UBYTE _CNV_A_R_LINEAR_____0_CM 1 100. 0. 255. DISPLAY_IDENTIFIER CTR_ABC_END_DIAG_PBK_IV_3 ECU_ADDRESS 0xd00098b9 FORMAT "%3.0" /end MEASUREMENT
/begin MEASUREMENT fmy_stat_pbk_iv_3.err_info_stat.lv_err_mem "storage in dynamic failure memory of the diagnosis instance PBK_IV_3" UWORD _CNV_S_2_RANGE__0___1_CM 1 100. 0. 1. DISPLAY_IDENTIFIER LV_ERR_MEM_PBK_IV_3 ECU_ADDRESS 0xd00098ba BIT_MASK 0x8 /end MEASUREMENT
/begin MEASUREMENT fmy_stat_pbk_iv_3.err_info_stat.lv_ready "readiness status of the diagnosis instance PBK_IV_3" UWORD _CNV_S_2_RANGE__0___1_CM 1 100. 0. 1. DISPLAY_IDENTIFIER LV_READY_PBK_IV_3 ECU_ADDRESS 0xd00098ba BIT_MASK 0x10 /end MEASUREMENT
/begin MEASUREMENT fmy_stat_pbk_iv_3.err_info_stat.lv_end_diag "end of diagnosis of the diagnosis instance PBK_IV_3" UWORD _CNV_S_2_RANGE__0___1_CM 1 100. 0. 1. DISPLAY_IDENTIFIER LV_END_DIAG_PBK_IV_3 ECU_ADDRESS 0xd00098ba BIT_MASK 0x20 /end MEASUREMENT
/begin MEASUREMENT fmy_stat_pbk_iv_3.err_info_stat.lv_cdn_diag "diagnosis condition of the diagnosis instance PBK_IV_3" UWORD _CNV_S_2_RANGE__0___1_CM 1 100. 0. 1. DISPLAY_IDENTIFIER LV_CDN_DIAG_PBK_IV_3 ECU_ADDRESS 0xd00098ba BIT_MASK 0x40 /end MEASUREMENT
/begin MEASUREMENT fmy_stat_pbk_iv_3.err_info_stat.err_sym "symptoms of the diagnosis instance PBK_IV_3" UWORD _CNV_S_16_RANGE_ERR__349_CM 1 100. 0. 15. DISPLAY_IDENTIFIER ERR_SYM_PBK_IV_3 ECU_ADDRESS 0xd00098ba BIT_MASK 0x780 /end MEASUREMENT
/begin MEASUREMENT fmy_stat_pbk_iv_4.ctr_abc "anti bounce counter for diagnosis instance PBK_IV_4" UBYTE _CNV_A_R_LINEAR_____0_CM 1 100. 0. 255. DISPLAY_IDENTIFIER CTR_ABC_PBK_IV_4 ECU_ADDRESS 0xd00098bc FORMAT "%3.0" /end MEASUREMENT
/begin MEASUREMENT fmy_stat_pbk_iv_4.ctr_end_diag "counter for end of diagnosis for diagnosis instance PBK_IV_4" UBYTE _CNV_A_R_LINEAR_____0_CM 1 100. 0. 255. DISPLAY_IDENTIFIER CTR_ABC_END_DIAG_PBK_IV_4 ECU_ADDRESS 0xd00098bd FORMAT "%3.0" /end MEASUREMENT
/begin MEASUREMENT fmy_stat_pbk_iv_4.err_info_stat.lv_err_mem "storage in dynamic failure memory of the diagnosis instance PBK_IV_4" UWORD _CNV_S_2_RANGE__0___1_CM 1 100. 0. 1. DISPLAY_IDENTIFIER LV_ERR_MEM_PBK_IV_4 ECU_ADDRESS 0xd00098be BIT_MASK 0x8 /end MEASUREMENT
/begin MEASUREMENT fmy_stat_pbk_iv_4.err_info_stat.lv_ready "readiness status of the diagnosis instance PBK_IV_4" UWORD _CNV_S_2_RANGE__0___1_CM 1 100. 0. 1. DISPLAY_IDENTIFIER LV_READY_PBK_IV_4 ECU_ADDRESS 0xd00098be BIT_MASK 0x10 /end MEASUREMENT
/begin MEASUREMENT fmy_stat_pbk_iv_4.err_info_stat.lv_end_diag "end of diagnosis of the diagnosis instance PBK_IV_4" UWORD _CNV_S_2_RANGE__0___1_CM 1 100. 0. 1. DISPLAY_IDENTIFIER LV_END_DIAG_PBK_IV_4 ECU_ADDRESS 0xd00098be BIT_MASK 0x20 /end MEASUREMENT
/begin MEASUREMENT fmy_stat_pbk_iv_4.err_info_stat.lv_cdn_diag "diagnosis condition of the diagnosis instance PBK_IV_4" UWORD _CNV_S_2_RANGE__0___1_CM 1 100. 0. 1. DISPLAY_IDENTIFIER LV_CDN_DIAG_PBK_IV_4 ECU_ADDRESS 0xd00098be BIT_MASK 0x40 /end MEASUREMENT
/begin MEASUREMENT fmy_stat_pbk_iv_4.err_info_stat.err_sym "symptoms of the diagnosis instance PBK_IV_4" UWORD _CNV_S_16_RANGE_ERR__349_CM 1 100. 0. 15. DISPLAY_IDENTIFIER ERR_SYM_PBK_IV_4 ECU_ADDRESS 0xd00098be BIT_MASK 0x780 /end MEASUREMENT
/begin MEASUREMENT cdn_diag_prev_ecras_el "Diagnostic condition of last failure symptom ECRAS_EL" UBYTE _CNV_S_16_RANGE_ERR__349_CM 1 100. 0. 15. DISPLAY_IDENTIFIER CDN_DIAG_PREV_ECRAS_EL ECU_ADDRESS 0xd00027bc /end MEASUREMENT
/begin MEASUREMENT cdn_diag_prev_dmtlh "Diagnostic condition of last failure symptom DMTLH" UBYTE _CNV_S_16_RANGE_ERR__349_CM 1 100. 0. 15. DISPLAY_IDENTIFIER CDN_DIAG_PREV_DMTLH ECU_ADDRESS 0xd00027bd /end MEASUREMENT
/begin MEASUREMENT cdn_diag_prev_rly_accout "Diagnostic condition of last failure symptom RLY_ACCOUT" UBYTE _CNV_S_16_RANGE_ERR__349_CM 1 100. 0. 15. DISPLAY_IDENTIFIER CDN_DIAG_PREV_RLY_ACCOUT ECU_ADDRESS 0xd00027be /end MEASUREMENT
/begin MEASUREMENT cdn_diag_prev_dmtls "Diagnostic condition of last failure symptom DMTLS" UBYTE _CNV_S_16_RANGE_ERR__349_CM 1 100. 0. 15. DISPLAY_IDENTIFIER CDN_DIAG_PREV_DMTLS ECU_ADDRESS 0xd00027bf /end MEASUREMENT
/begin MEASUREMENT cdn_diag_prev_dmtl_pump "Diagnostic condition of last failure symptom DMTL_PUMP" UBYTE _CNV_S_16_RANGE_ERR__349_CM 1 100. 0. 15. DISPLAY_IDENTIFIER CDN_DIAG_PREV_DMTL_PUMP ECU_ADDRESS 0xd00027c0 /end MEASUREMENT
/begin MEASUREMENT cdn_diag_prev_ebox_cfa "Diagnostic condition of last failure symptom EBOX_CFA" UBYTE _CNV_S_16_RANGE_ERR__349_CM 1 100. 0. 15. DISPLAY_IDENTIFIER CDN_DIAG_PREV_EBOX_CFA ECU_ADDRESS 0xd00027c1 /end MEASUREMENT
/begin MEASUREMENT cdn_diag_prev_ef "Diagnostic condition of last failure symptom EF" UBYTE _CNV_S_16_RANGE_ERR__349_CM 1 100. 0. 15. DISPLAY_IDENTIFIER CDN_DIAG_PREV_EF ECU_ADDRESS 0xd00027c2 /end MEASUREMENT
/begin MEASUREMENT cdn_diag_prev_rly_st "Diagnostic condition of last failure symptom RLY_ST" UBYTE _CNV_S_16_RANGE_ERR__349_CM 1 100. 0. 15. DISPLAY_IDENTIFIER CDN_DIAG_PREV_RLY_ST ECU_ADDRESS 0xd00027c3 /end MEASUREMENT
/begin MEASUREMENT cdn_diag_prev_lsh_up_1 "Diagnostic condition of last failure symptom LSH_UP_1" UBYTE _CNV_S_16_RANGE_ERR__349_CM 1 100. 0. 15. DISPLAY_IDENTIFIER CDN_DIAG_PREV_LSH_UP_1 ECU_ADDRESS 0xd00027c4 /end MEASUREMENT
/begin MEASUREMENT cdn_diag_prev_sof "Diagnostic condition of last failure symptom SOF" UBYTE _CNV_S_16_RANGE_ERR__349_CM 1 100. 0. 15. DISPLAY_IDENTIFIER CDN_DIAG_PREV_SOF ECU_ADDRESS 0xd00027c5 /end MEASUREMENT
/begin MEASUREMENT cdn_diag_prev_rly_crcv_heat "Diagnostic condition of last failure symptom RLY_CRCV_HEAT" UBYTE _CNV_S_16_RANGE_ERR__349_CM 1 100. 0. 15. DISPLAY_IDENTIFIER CDN_DIAG_PREV_RLY_CRCV_HEAT ECU_ADDRESS 0xd00027c6 /end MEASUREMENT
/begin MEASUREMENT cdn_diag_prev_ctl_lsl_up_1 "Diagnostic condition of last failure symptom CTL_LSL_UP_1" UBYTE _CNV_S_16_RANGE_ERR__349_CM 1 100. 0. 15. DISPLAY_IDENTIFIER CDN_DIAG_PREV_CTL_LSL_UP_1 ECU_ADDRESS 0xd00027c7 /end MEASUREMENT
/begin MEASUREMENT cdn_diag_prev_lsh_up_2 "Diagnostic condition of last failure symptom LSH_UP_2" UBYTE _CNV_S_16_RANGE_ERR__349_CM 1 100. 0. 15. DISPLAY_IDENTIFIER CDN_DIAG_PREV_LSH_UP_2 ECU_ADDRESS 0xd00027c8 /end MEASUREMENT
/begin MEASUREMENT cdn_diag_prev_ctl_lsl_up_2 "Diagnostic condition of last failure symptom CTL_LSL_UP_2" UBYTE _CNV_S_16_RANGE_ERR__349_CM 1 100. 0. 15. DISPLAY_IDENTIFIER CDN_DIAG_PREV_CTL_LSL_UP_2 ECU_ADDRESS 0xd00027c9 /end MEASUREMENT
/begin MEASUREMENT cdn_diag_prev_lsh_down_1 "Diagnostic condition of last failure symptom LSH_DOWN_1" UBYTE _CNV_S_16_RANGE_ERR__349_CM 1 100. 0. 15. DISPLAY_IDENTIFIER CDN_DIAG_PREV_LSH_DOWN_1 ECU_ADDRESS 0xd00027ca /end MEASUREMENT
/begin MEASUREMENT cdn_diag_prev_lsh_down_2 "Diagnostic condition of last failure symptom LSH_DOWN_2" UBYTE _CNV_S_16_RANGE_ERR__349_CM 1 100. 0. 15. DISPLAY_IDENTIFIER CDN_DIAG_PREV_LSH_DOWN_2 ECU_ADDRESS 0xd00027cb /end MEASUREMENT
/begin MEASUREMENT cdn_diag_prev_el_cps "Diagnostic condition of last failure symptom EL_CPS" UBYTE _CNV_S_16_RANGE_ERR__349_CM 1 100. 0. 15. DISPLAY_IDENTIFIER CDN_DIAG_PREV_EL_CPS ECU_ADDRESS 0xd00027cc /end MEASUREMENT
/begin MEASUREMENT cdn_diag_prev_ect_el "Diagnostic condition of last failure symptom ECT_EL" UBYTE _CNV_S_16_RANGE_ERR__349_CM 1 100. 0. 15. DISPLAY_IDENTIFIER CDN_DIAG_PREV_ECT_EL ECU_ADDRESS 0xd00027cd /end MEASUREMENT
/begin MEASUREMENT cdn_diag_prev_slv_ivvt_in_1 "Diagnostic condition of last failure symptom SLV_IVVT_IN_1" UBYTE _CNV_S_16_RANGE_ERR__349_CM 1 100. 0. 15. DISPLAY_IDENTIFIER CDN_DIAG_PREV_SLV_IVVT_IN_1 ECU_ADDRESS 0xd00027ce /end MEASUREMENT
/begin MEASUREMENT cdn_diag_prev_slv_ivvt_in_2 "Diagnostic condition of last failure symptom SLV_IVVT_IN_2" UBYTE _CNV_S_16_RANGE_ERR__349_CM 1 100. 0. 15. DISPLAY_IDENTIFIER CDN_DIAG_PREV_SLV_IVVT_IN_2 ECU_ADDRESS 0xd00027cf /end MEASUREMENT
/begin MEASUREMENT cdn_diag_prev_slv_ivvt_ex_1 "Diagnostic condition of last failure symptom SLV_IVVT_EX_1" UBYTE _CNV_S_16_RANGE_ERR__349_CM 1 100. 0. 15. DISPLAY_IDENTIFIER CDN_DIAG_PREV_SLV_IVVT_EX_1 ECU_ADDRESS 0xd00027d0 /end MEASUREMENT
/begin MEASUREMENT cdn_diag_prev_slv_ivvt_ex_2 "Diagnostic condition of last failure symptom SLV_IVVT_EX_2" UBYTE _CNV_S_16_RANGE_ERR__349_CM 1 100. 0. 15. DISPLAY_IDENTIFIER CDN_DIAG_PREV_SLV_IVVT_EX_2 ECU_ADDRESS 0xd00027d1 /end MEASUREMENT
/begin MEASUREMENT cdn_diag_prev_ecf_el_1 "Diagnostic condition of last failure symptom ECF_EL_1" UBYTE _CNV_S_16_RANGE_ERR__349_CM 1 100. 0. 15. DISPLAY_IDENTIFIER CDN_DIAG_PREV_ECF_EL_1 ECU_ADDRESS 0xd00027d2 /end MEASUREMENT
/begin MEASUREMENT cdn_diag_prev_rfp_dr_1 "Diagnostic condition of last failure symptom RFP_DR_1" UBYTE _CNV_S_16_RANGE_ERR__349_CM 1 100. 0. 15. DISPLAY_IDENTIFIER CDN_DIAG_PREV_RFP_DR_1 ECU_ADDRESS 0xd00027d3 /end MEASUREMENT
/begin MEASUREMENT cdn_diag_prev_rfp_dr_2 "Diagnostic condition of last failure symptom RFP_DR_2" UBYTE _CNV_S_16_RANGE_ERR__349_CM 1 100. 0. 15. DISPLAY_IDENTIFIER CDN_DIAG_PREV_RFP_DR_2 ECU_ADDRESS 0xd00027d4 /end MEASUREMENT
/begin MEASUREMENT cdn_diag_prev_wg_1_dr "Diagnostic condition of last failure symptom WG_1_DR" UBYTE _CNV_S_16_RANGE_ERR__349_CM 1 100. 0. 15. DISPLAY_IDENTIFIER CDN_DIAG_PREV_WG_1_DR ECU_ADDRESS 0xd00027d5 /end MEASUREMENT
/begin MEASUREMENT cdn_diag_prev_wg_2_dr "Diagnostic condition of last failure symptom WG_2_DR" UBYTE _CNV_S_16_RANGE_ERR__349_CM 1 100. 0. 15. DISPLAY_IDENTIFIER CDN_DIAG_PREV_WG_2_DR ECU_ADDRESS 0xd00027d6 /end MEASUREMENT
/begin MEASUREMENT cdn_diag_prev_iv_0 "Diagnostic condition of last failure symptom IV_0" UBYTE _CNV_S_16_RANGE_ERR__349_CM 1 100. 0. 15. DISPLAY_IDENTIFIER CDN_DIAG_PREV_IV_0 ECU_ADDRESS 0xd00027d8 /end MEASUREMENT
/begin MEASUREMENT cdn_diag_prev_iv_1 "Diagnostic condition of last failure symptom IV_1" UBYTE _CNV_S_16_RANGE_ERR__349_CM 1 100. 0. 15. DISPLAY_IDENTIFIER CDN_DIAG_PREV_IV_1 ECU_ADDRESS 0xd00027d9 /end MEASUREMENT
/begin MEASUREMENT cdn_diag_prev_iv_2 "Diagnostic condition of last failure symptom IV_2" UBYTE _CNV_S_16_RANGE_ERR__349_CM 1 100. 0. 15. DISPLAY_IDENTIFIER CDN_DIAG_PREV_IV_2 ECU_ADDRESS 0xd00027da /end MEASUREMENT
/begin MEASUREMENT cdn_diag_prev_iv_3 "Diagnostic condition of last failure symptom IV_3" UBYTE _CNV_S_16_RANGE_ERR__349_CM 1 100. 0. 15. DISPLAY_IDENTIFIER CDN_DIAG_PREV_IV_3 ECU_ADDRESS 0xd00027db /end MEASUREMENT
/begin MEASUREMENT cdn_diag_prev_iv_4 "Diagnostic condition of last failure symptom IV_4" UBYTE _CNV_S_16_RANGE_ERR__349_CM 1 100. 0. 15. DISPLAY_IDENTIFIER CDN_DIAG_PREV_IV_4 ECU_ADDRESS 0xd00027dc /end MEASUREMENT
/begin MEASUREMENT cdn_diag_prev_iv_5 "Diagnostic condition of last failure symptom IV_5" UBYTE _CNV_S_16_RANGE_ERR__349_CM 1 100. 0. 15. DISPLAY_IDENTIFIER CDN_DIAG_PREV_IV_5 ECU_ADDRESS 0xd00027dd /end MEASUREMENT
/begin MEASUREMENT cdn_diag_prev_iv_6 "Diagnostic condition of last failure symptom IV_6" UBYTE _CNV_S_16_RANGE_ERR__349_CM 1 100. 0. 15. DISPLAY_IDENTIFIER CDN_DIAG_PREV_IV_6 ECU_ADDRESS 0xd00027de /end MEASUREMENT
/begin MEASUREMENT cdn_diag_prev_iv_7 "Diagnostic condition of last failure symptom IV_7" UBYTE _CNV_S_16_RANGE_ERR__349_CM 1 100. 0. 15. DISPLAY_IDENTIFIER CDN_DIAG_PREV_IV_7 ECU_ADDRESS 0xd00027df /end MEASUREMENT
/begin MEASUREMENT cdn_diag_prev_pbk_iv_1 "Diagnostic condition of last failure symptom PBK_IV_1" UBYTE _CNV_S_16_RANGE_ERR__349_CM 1 100. 0. 15. DISPLAY_IDENTIFIER CDN_DIAG_PREV_PBK_IV_1 ECU_ADDRESS 0xd00027e0 /end MEASUREMENT
/begin MEASUREMENT cdn_diag_prev_pbk_iv_2 "Diagnostic condition of last failure symptom PBK_IV_2" UBYTE _CNV_S_16_RANGE_ERR__349_CM 1 100. 0. 15. DISPLAY_IDENTIFIER CDN_DIAG_PREV_PBK_IV_2 ECU_ADDRESS 0xd00027e1 /end MEASUREMENT
/begin MEASUREMENT cdn_diag_prev_pbk_iv_3 "Diagnostic condition of last failure symptom PBK_IV_3" UBYTE _CNV_S_16_RANGE_ERR__349_CM 1 100. 0. 15. DISPLAY_IDENTIFIER CDN_DIAG_PREV_PBK_IV_3 ECU_ADDRESS 0xd00027e2 /end MEASUREMENT
/begin MEASUREMENT cdn_diag_prev_pbk_iv_4 "Diagnostic condition of last failure symptom PBK_IV_4" UBYTE _CNV_S_16_RANGE_ERR__349_CM 1 100. 0. 15. DISPLAY_IDENTIFIER CDN_DIAG_PREV_PBK_IV_4 ECU_ADDRESS 0xd00027e3 /end MEASUREMENT
/begin MEASUREMENT cdn_diag_prev_poil_dr "Diagnostic condition of last failure symptom POIL_DR" UBYTE _CNV_S_16_RANGE_ERR__349_CM 1 100. 0. 15. DISPLAY_IDENTIFIER CDN_DIAG_PREV_POIL_DR ECU_ADDRESS 0xd00027e4 /end MEASUREMENT
/begin COMPU_METHOD _CNV_A_R_LINEAR_____0_CM "" RAT_FUNC "%6.3" "-" COEFFS 0 1. 0. 0 0 1 /end COMPU_METHOD
/begin COMPU_METHOD _CNV_S_2_RANGE__0___1_CM "" TAB_VERB "%6.3" "-" COMPU_TAB_REF _CNV_S_2_RANGE__0___1 /end COMPU_METHOD
/begin COMPU_VTAB _CNV_S_2_RANGE__0___1 "" TAB_VERB 2 0 "0" 1 "1" /end COMPU_VTAB
/begin COMPU_METHOD _CNV_A_R_LINEAR_____5_CM "" RAT_FUNC "%6.3" "%" COEFFS 0 2.56 0. 0 0 1 /end COMPU_METHOD
/begin COMPU_METHOD _CNV_A_R_LINEAR_____14_CM "" RAT_FUNC "%6.3" "rpm" COEFFS 0 1. 0. 0 0 1 /end COMPU_METHOD
/begin COMPU_METHOD _CNV_A_R_LINEAR_____17_CM "" RAT_FUNC "%6.3" "°C" COEFFS 0 1.333333333333333 64. 0 0 1 /end COMPU_METHOD
/begin COMPU_METHOD _CNV_S_16_RANGE_ERR__349_CM "" TAB_VERB "%6.3" "-" COMPU_TAB_REF _CNV_S_16_RANGE_ERR__349 /end COMPU_METHOD
/begin COMPU_VTAB _CNV_S_16_RANGE_ERR__349 "" TAB_VERB 16 0 "NO_SYM" 1 "SYM_0" 2 "SYM_1" 3 "SYM_0, SYM_1" 4 "SYM_2" 5 "SYM_0, SYM_2" 6 "SYM_1, SYM_2" 7 "SYM_0, SYM_1, SYM_2" 8 "SYM_3" 9 "SYM_0, SYM_3" 10 "SYM_1, SYM_3" 11 "SYM_0, SYM_1,SYM_3" 12 "SYM_2, SYM_3" 13 "SYM_0, SYM_2, SYM_3" 14 "SYM_1, SYM_2, SYM_3" 15 "SYM_0, SYM_1, SYM_2, SYM_3" /end COMPU_VTAB
/begin COMPU_METHOD _CNV_S_471_ERRM_RANGE_474_CM "" TAB_VERB "%6.3" "" COMPU_TAB_REF _CNV_S_471_ERRM_RANGE_474 /end COMPU_METHOD
/begin COMPU_VTAB _CNV_S_471_ERRM_RANGE_474 "" TAB_VERB 471 0 "NO_ERROR" 1 "IMOB_0" 2 "IMOB_1" 3 "IMOB_2" 4 "IMOB_3" 5 "TCO_EL" 6 "TCO_GRD" 7 "TCO_STUCK" 8 "TCO_STUCK_RNG" 9 "TCO_PLAUS" 10 "TCO_2_EL" 11 "TCO_2_GRD" 12 "TCO_2_PLAUS" 13 "ECT_EL" 14 "ECF_EL_1" 15 "ECF_EL_2" 16 "ECFPWM_FB_1" 17 "ECFPWM_FB_2" 18 "TH" 19 "FTL_MIN" 20 "TIA_EL_1" 21 "TIA_EL_2" 22 "TIA_THR_EL_1" 23 "TIA_THR_EL_2" 24 "AMP" 25 "AMP_PLAUS" 26 "MAF" 27 "EL_CPS" 28 "SLV_IVVT_IN_1" 29 "SLV_IVVT_IN_2" 30 "SLV_IVVT_EX_1" 31 "SLV_IVVT_EX_2" 32 "ECU_CKS" 33 "VS" 34 "KNKS_1" 35 "KNKS_2" 36 "KNKS_3" 37 "KNKS_4" 38 "RFP_DR_1" 39 "RFP_DR_2" 40 "WG_1_DR" 41 "WG_2_DR" 42 "PUT_EL_1" 43 "PUT_EL_2" 44 "IGC_SCP_0" 45 "IGC_SCP_1" 46 "IGC_SCP_2" 47 "IGC_SCP_3" 48 "IGC_SCP_4" 49 "IGC_SCP_5" 50 "IGC_SCP_6" 51 "IGC_SCP_7" 52 "IGC_SCG_0" 53 "IGC_SCG_1" 54 "IGC_SCG_2" 55 "IGC_SCG_3" 56 "IGC_SCG_4" 57 "IGC_SCG_5" 58 "IGC_SCG_6" 59 "IGC_SCG_7" 60 "IGC_OL_0" 61 "IGC_OL_1" 62 "IGC_OL_2" 63 "IGC_OL_3" 64 "IGC_OL_4" 65 "IGC_OL_5" 66 "IGC_OL_6" 67 "IGC_OL_7" 68 "DUR_IGC_MPL" 69 "V_REF_1" 70 "V_REF_2" 71 "PVS_1" 72 "PVS_2" 73 "PVS_RATIO" 74 "PVS_DOUBLE" 75 "PVS_BLS_NOT_PLAUS" 76 "MTC_CTL_1" 77 "GEN" 78 "GEN_DIAG" 79 "ALTER_BN" 80 "ALTER_BN_BAT" 81 "T_ES" 82 "MAP_DIP_PLAUS" 83 "TOIL_LEVEL" 84 "ALTER_BN_RGN" 85 "PER_CAM_IN_1" 86 "PER_CAM_EX_1" 87 "SYN_CAM_IN_1" 88 "SYN_CAM_EX_1" 89 "REF_CRK_CAM_IN_1" 90 "REF_CRK_CAM_EX_1" 91 "PER_CAM_IN_2" 92 "PER_CAM_EX_2" 93 "SYN_CAM_IN_2" 94 "SYN_CAM_EX_2" 95 "REF_CRK_CAM_IN_2" 96 "REF_CRK_CAM_EX_2" 97 "CRK_TOOTH" 98 "CRK_TOOTH_PER" 99 "CRK_SYN" 100 "CRK_PLAUS" 101 "PLAUS_CAM_IN_1" 102 "PLAUS_CAM_EX_1" 103 "SYN_CRK_CAM_IN_1" 104 "SYN_CRK_CAM_EX_1" 105 "TOOTH_OFF_IN_1" 106 "TOOTH_OFF_EX_1" 107 "PLAUS_CAM_IN_2" 108 "PLAUS_CAM_EX_2" 109 "SYN_CRK_CAM_IN_2" 110 "SYN_CRK_CAM_EX_2" 111 "TOOTH_OFF_IN_2" 112 "TOOTH_OFF_EX_2" 113 "CAN_BOFF" 114 "RLY_MAIN" 115 "RLY_MAIN_DLY" 116 "RLY_ACCOUT" 117 "ISC" 118 "ISC_CST" 119 "IM_BLS_PLAUS" 120 "IM_BTS_PLAUS" 121 "MSW_TOG" 122 "MSW_2" 123 "MSW_3" 124 "MIS_0" 125 "MIS_1" 126 "MIS_2" 127 "MIS_3" 128 "MIS_4" 129 "MIS_5" 130 "MIS_6" 131 "MIS_7" 132 "MIS_MPL" 133 "MIS_FTL_L" 134 "EF" 135 "TECU" 136 "EBOX_CFA" 137 "ECU_RAM" 138 "TQI_LIM" 139 "DMTLS" 140 "DMTL_PUMP" 141 "DMTLM" 142 "ROUGH_LEAK" 143 "SMALL_LEAK" 144 "CHK_FUC" 145 "SOF" 146 "SOF_REQ" 147 "RLY_CRCV_HEAT" 148 "RLY_ST" 149 "BSD" 150 "POIL_SWI" 151 "TOUT_EFP_CAN" 152 "DIAGCPS" 153 "DCC" 154 "LDM" 155 "DMTLH" 156 "CS" 157 "SPI_MPS" 158 "SPI_KNK" 159 "SENS_POIL" 160 "POIL_DR" 161 "BN_TQ_DCC" 162 "BN_TQ_PSTE_2" 163 "BN_TQ_PSTE_3" 164 "BN_ARS" 165 "BN_CAS" 166 "BN_TQ_TCS" 167 "BN_VS_TCS" 168 "BN_TCS" 169 "BN_TQ_ETCU" 170 "BN_ETCU" 171 "BN_ETCU_2" 172 "BN_ETCU_3" 173 "BN_ETCU_DISP" 174 "BN_TQ_AMT" 175 "BN_ACC" 176 "BN_T_ICL" 177 "BN_VEH_MOD" 178 "BN_KM_ICL" 179 "BN_ICL" 180 "BN_POW_VB" 181 "BN_POW_GEN" 182 "BN_MSW" 183 "BN_ANG_PSTE" 184 "BN_GEAR_REV" 185 "BN_LTG_HDLP_L" 186 "BN_LDM" 187 "BN_TRL" 188 "BN_HIV" 189 "BN_T_CLK" 190 "BN_EFP_CRASH" 191 "BN_CDN_DOOR" 192 "BN_REQ_PBR" 193 "BN_PBR" 194 "BN_EFP" 195 "LOAD_TPS_PLAUS" 196 "EGY_MIN" 197 "LOCAN_BOFF" 198 "CWP_PLAUS" 199 "CWP_INT_OFF" 200 "CWP_PWR" 201 "CWP_COM_PLAUS" 202 "QOIL_SENS" 203 "BAT_SENS" 204 "BAT_SENS_IT" 205 "BAT_SENS_IT_EL" 206 "ECU_NVMY" 207 "GS" 208 "PLAUS_IGK_BN" 209 "TQ_REQ_CAN" 210 "MAP_SENS_1" 211 "MAP_SENS_2" 212 "DTC_TRM" 213 "MEC_IVVT_IN_1" 214 "MEC_IVVT_IN_2" 215 "MEC_IVVT_EX" 216 "TOUT_NOX_SENS_1" 217 "TOUT_NOX_SENS_2" 218 "VVL_ROT" 219 "RLY_VVL" 220 "NOX_SENS_1" 221 "NS_OBD_1_1" 222 "NS_OBD_1_2" 223 "OVL_ECU_VVL" 224 "DR_SC_VVL" 225 "CRIT_OVL_ECU_VVL" 226 "NOX_SENS_2" 227 "CUR_H_VVL" 228 "TEG_PCAT_DOWN" 229 "T_SEG_ER" 230 "SEG_AD_ER" 231 "VS_PLAUS" 232 "FTL_OBD" 233 "FTL_LE_CAN" 234 "FTL_RI_CAN" 235 "TIA_PLAUS" 236 "TAM_CAN" 237 "TAM_PLAUS" 238 "MAP_SHIFT_1" 239 "MAP_SHIFT_2" 240 "CAT_DIAG_1" 241 "CAT_DIAG_2" 242 "CAT_DIAG_AFL_1" 243 "CAT_DIAG_AFL_2" 244 "SCG_LS_DOWN_1" 245 "SCP_LS_DOWN_1" 246 "OC_LS_DOWN_1" 247 "PUC_LS_DOWN_1" 248 "FL_LS_DOWN_1" 249 "LSL_UP_IF_1" 250 "EL_LSL_UP_1" 251 "LSH_UP_1" 252 "LSH_DOWN_1" 253 "VLS_DOWN_DIF_1" 254 "LSH_LSL_UP_1" 255 "AIR_LSL_UP_1" 256 "PUE_LS_DOWN_1" 257 "SWT_LS_DOWN_1" 258 "OBD_LSH_DOWN_1" 259 "DYN_VLD_LS_UP_1" 260 "PUC_VLD_LS_UP_1" 261 "OBD_VLD_LSH_UP_1" 262 "CHK_LS_DOWN_1" 263 "SHIFT_AFL_LSL_UP_1" 264 "SHIFT_AFR_LSL_UP_1" 265 "OC_LSL_UP_1" 266 "DELTA_I_LAM_1" 267 "OFS_LSL_UP_1" 268 "TTIP_MES_LSH_UP_1" 269 "CTL_LSL_UP_1" 270 "CHG_LS_DOWN" 271 "SCG_LS_DOWN_2" 272 "SCP_LS_DOWN_2" 273 "OC_LS_DOWN_2" 274 "PUC_LS_DOWN_2" 275 "FL_LS_DOWN_2" 276 "LSL_UP_IF_2" 277 "EL_LSL_UP_2" 278 "LSH_UP_2" 279 "LSH_DOWN_2" 280 "VLS_DOWN_DIF_2" 281 "LSH_LSL_UP_2" 282 "AIR_LSL_UP_2" 283 "PUE_LS_DOWN_2" 284 "SWT_LS_DOWN_2" 285 "OBD_LSH_DOWN_2" 286 "DYN_VLD_LS_UP_2" 287 "PUC_VLD_LS_UP_2" 288 "OBD_VLD_LSH_UP_2" 289 "CHK_LS_DOWN_2" 290 "SHIFT_AFL_LSL_UP_2" 291 "SHIFT_AFR_LSL_UP_2" 292 "OC_LSL_UP_2" 293 "DELTA_I_LAM_2" 294 "OFS_LSL_UP_2" 295 "TTIP_MES_LSH_UP_2" 296 "CTL_LSL_UP_2" 297 "CHG_LS_UP" 298 "ALTER_COM" 299 "CWP_COM" 300 "QOIL_COM" 301 "SENS_BAT_SMT_COM" 302 "ECRASPWM_FB" 303 "ECRAS_EL" 304 "ECRAS_UP_FB" 305 "ECRAS_DOWN_FB" 306 "WARM_RST" 307 "ACR_AD" 308 "SENS_ACR" 309 "ACR_CTL" 310 "ACR_DR" 311 "VAR_COD" 312 "VEH_POW_VAR" 313 "FUP_MFP_PLAUS" 314 "H_PRS_SYS" 315 "FUP_0" 316 "FUP_1" 317 "VCV_FPC_0" 318 "FUP_EFP" 319 "EFPPWM_PLAUS" 320 "L_PRS_SYS" 321 "VCV_FPC_1" 322 "FSD_1" 323 "FSD_2" 324 "FSD_LAM_LIM_1" 325 "FSD_LAM_LIM_2" 326 "FSD_H_RNG_1" 327 "FSD_H_RNG_2" 328 "CYL_BAL_LAM_0" 329 "CYL_BAL_LAM_1" 330 "CYL_BAL_LAM_2" 331 "CYL_BAL_LAM_3" 332 "CYL_BAL_LAM_4" 333 "CYL_BAL_LAM_5" 334 "CYL_BAL_LAM_6" 335 "CYL_BAL_LAM_7" 336 "CYL_BAL_ER_0" 337 "CYL_BAL_ER_1" 338 "CYL_BAL_ER_2" 339 "CYL_BAL_ER_3" 340 "CYL_BAL_ER_4" 341 "CYL_BAL_ER_5" 342 "CYL_BAL_ER_6" 343 "CYL_BAL_ER_7" 344 "MON_3" 345 "MAF_FRQ_RNG_0" 346 "MAF_FRQ_GRD_0" 347 "MAF_FRQ_EL_0" 348 "MAF_FRQ_RNG_1" 349 "MAF_FRQ_GRD_1" 350 "MAF_FRQ_EL_1" 351 "TPS_1_1" 352 "TPS_1_2" 353 "TPS_2_1" 354 "TPS_2_2" 355 "TPS_MAF_1_1" 356 "TPS_MAF_1_2" 357 "TPS_MAF_2_1" 358 "TPS_MAF_2_2" 359 "TPS_RATIO_1" 360 "TPS_RATIO_2" 361 "TPS_AD_1" 362 "TPS_AD_2" 363 "ETC_PWM_1" 364 "ETC_PWM_2" 365 "ETC_CTL_1" 366 "ETC_CTL_2" 367 "TPS_AD_SPR_1" 368 "TPS_AD_SPR_2" 369 "ETC_DR_1" 370 "ETC_DR_2" 371 "TPS_ST_CHK_1" 372 "TPS_ST_CHK_2" 373 "COM_1_TQ_LOSS_CORD" 374 "COM_1_SWI_GEAR" 375 "COM_1_VEH_MOD" 376 "COM_1_BRAKE_TCS" 377 "COM_1_TQ_DRIV_ASI" 378 "COM_1_TQ_TCS" 379 "COM_1_TQB_TCS" 380 "COM_1_WHEEL_TCS" 381 "COM_1_REQ_TQDW" 382 "COM_1_TQ_PSTE" 383 "COM_1_ANG_PSTE" 384 "COM_1_AC_TRV" 385 "COM_1_AC_LGT" 386 "COM_1_TQ_ARS" 387 "COM_1_ARS" 388 "COM_1_VS" 389 "COM_1_TCS" 390 "COM_1_BOFF" 391 "COM_2_EFP_CRASH" 392 "COM_2_GB" 393 "COM_2_ETCU" 394 "COM_2_TQ_ETCU" 395 "COM_2_STATE_VEH" 396 "COM_2_CAS_2" 397 "COM_2_ACC" 398 "COM_2_KM_ICL" 399 "COM_2_T_ICL" 400 "COM_2_TAM_ICL" 401 "COM_2_T_CLK" 402 "COM_2_BOFF" 403 "COM_2_T_ABSL_ICL" 404 "COM_2_CAS" 405 "COM_2_ETCU_DISP" 406 "COM_2_POW_OFF" 407 "COM_2_ABS_ICL" 408 "COM_2_TRL" 409 "COM_2_HIV" 410 "COM_2_ICL" 411 "COM_2_GEAR_REV" 412 "COM_2_CDN_DOOR" 413 "COM_3_BOFF" 414 "COM_3_EFP" 415 "COM_3_TQ_ETCU" 416 "COM_3_ETCU" 417 "COM_3_ETCU_DISP" 418 "COM_3_ETCU_OBD" 419 "COM_3_GB" 420 "TEG_SENS_1" 421 "TEG_SENS_2" 422 "AMP_PLAUS_CUS" 423 "TCHA_PRS_LOW" 424 "TCHA_LEAK" 425 "TCHA_PRS_DIF" 426 "TCHA_PRS_HIGH" 427 "PUT_PLAUS" 428 "MAP_PLAUS" 429 "TQ_CST" 430 "GEN_EL" 431 "GEN_MEC" 432 "GEN_H_TEMP" 433 "GEN_TYP_NOT_PLAUS" 434 "GEN_MSG_LOST" 435 "GEN_CLC_V_NOT_PLAUS" 436 "GEN_H_TEMP_CLC" 437 "GEN_CTL_NOT_PLAUS" 438 "SLV_IVVT_IN" 439 "SLV_IVVT_EX" 440 "CONV_MON_1" 441 "N_32_MON_1" 442 "PVS_MON_1" 443 "TQ_DIF_ISC_MON_1" 444 "TQ_REQ_MON_1" 445 "TQ_EXT_MON_1" 446 "TQI_AV_MON_1" 447 "TQI_N_MAX_MON_1" 448 "MFF_MON_1" 449 "CRU_INH_MON_1" 450 "SWI_AFS_MON" 451 "IV_0" 452 "IV_1" 453 "IV_2" 454 "IV_3" 455 "IV_4" 456 "IV_5" 457 "IV_6" 458 "IV_7" 459 "IV_SC_0" 460 "IV_SC_1" 461 "IV_SC_2" 462 "IV_SC_3" 463 "IV_SC_4" 464 "IV_SC_5" 465 "IV_SC_6" 466 "IV_SC_7" 467 "PBK_IV_1" 468 "PBK_IV_2" 469 "PBK_IV_3" 470 "PBK_IV_4" /end COMPU_VTAB
/begin RECORD_LAYOUT _REC_VAL_20_u1 FNC_VALUES 1 UBYTE COLUMN_DIR DIRECT /end RECORD_LAYOUT
/begin RECORD_LAYOUT _REC_VAL_20_u2 FNC_VALUES 1 UWORD COLUMN_DIR DIRECT /end RECORD_LAYOUT
/begin FUNCTION ERRM_Table_of_Failures "Table_of_Failures"
 /begin OUT_MEASUREMENT fmy_stat_com_2_boff.err_info_stat.lv_err_mem fmy_stat_com_2_boff.err_info_stat.lv_ready fmy_stat_com_2_boff.err_info_stat.lv_end_diag fmy_stat_com_2_boff.err_info_stat.lv_cdn_diag fmy_stat_com_2_boff.err_info_stat.err_sym fmy_stat_com_2_t_absl_icl.ctr_abc fmy_stat_com_2_t_absl_icl.ctr_end_diag fmy_stat_com_2_t_absl_icl.err_info_stat.lv_err_mem fmy_stat_com_2_t_absl_icl.err_info_stat.lv_ready fmy_stat_com_2_t_absl_icl.err_info_stat.lv_end_diag fmy_stat_com_2_t_absl_icl.err_info_stat.lv_cdn_diag fmy_stat_com_2_t_absl_icl.err_info_stat.err_sym fmy_stat_com_2_cas.ctr_abc fmy_stat_com_2_cas.ctr_end_diag fmy_stat_com_2_cas.err_info_stat.lv_err_mem fmy_stat_com_2_cas.err_info_stat.lv_ready fmy_stat_com_2_cas.err_info_stat.lv_end_diag fmy_stat_com_2_cas.err_info_stat.lv_cdn_diag fmy_stat_com_2_cas.err_info_stat.err_sym fmy_stat_com_2_etcu_disp.ctr_abc fmy_stat_com_2_etcu_disp.ctr_end_diag fmy_stat_com_2_etcu_disp.err_info_stat.lv_err_mem fmy_stat_com_2_etcu_disp.err_info_stat.lv_ready fmy_stat_com_2_etcu_disp.err_info_stat.lv_end_diag fmy_stat_com_2_etcu_disp.err_info_stat.lv_cdn_diag fmy_stat_com_2_etcu_disp.err_info_stat.err_sym fmy_stat_com_2_pow_off.ctr_abc fmy_stat_com_2_pow_off.ctr_end_diag fmy_stat_com_2_pow_off.err_info_stat.lv_err_mem fmy_stat_com_2_pow_off.err_info_stat.lv_ready fmy_stat_com_2_pow_off.err_info_stat.lv_end_diag fmy_stat_com_2_pow_off.err_info_stat.lv_cdn_diag fmy_stat_com_2_pow_off.err_info_stat.err_sym fmy_stat_com_2_abs_icl.ctr_abc fmy_stat_com_2_abs_icl.ctr_end_diag fmy_stat_com_2_abs_icl.err_info_stat.lv_err_mem fmy_stat_com_2_abs_icl.err_info_stat.lv_ready fmy_stat_com_2_abs_icl.err_info_stat.lv_end_diag fmy_stat_com_2_abs_icl.err_info_stat.lv_cdn_diag fmy_stat_com_2_abs_icl.err_info_stat.err_sym fmy_stat_com_2_trl.ctr_abc fmy_stat_com_2_trl.ctr_end_diag fmy_stat_com_2_trl.err_info_stat.lv_err_mem fmy_stat_com_2_trl.err_info_stat.lv_ready fmy_stat_com_2_trl.err_info_stat.lv_end_diag fmy_stat_com_2_trl.err_info_stat.lv_cdn_diag fmy_stat_com_2_trl.err_info_stat.err_sym fmy_stat_com_2_hiv.ctr_abc fmy_stat_com_2_hiv.ctr_end_diag fmy_stat_com_2_hiv.err_info_stat.lv_err_mem fmy_stat_com_2_hiv.err_info_stat.lv_ready fmy_stat_com_2_hiv.err_info_stat.lv_end_diag fmy_stat_com_2_hiv.err_info_stat.lv_cdn_diag fmy_stat_com_2_hiv.err_info_stat.err_sym fmy_stat_com_2_icl.ctr_abc fmy_stat_com_2_icl.ctr_end_diag fmy_stat_com_2_icl.err_info_stat.lv_err_mem fmy_stat_com_2_icl.err_info_stat.lv_ready fmy_stat_com_2_icl.err_info_stat.lv_end_diag fmy_stat_com_2_icl.err_info_stat.lv_cdn_diag fmy_stat_com_2_icl.err_info_stat.err_sym fmy_stat_com_2_gear_rev.ctr_abc fmy_stat_com_2_gear_rev.ctr_end_diag fmy_stat_com_2_gear_rev.err_info_stat.lv_err_mem fmy_stat_com_2_gear_rev.err_info_stat.lv_ready fmy_stat_com_2_gear_rev.err_info_stat.lv_end_diag fmy_stat_com_2_gear_rev.err_info_stat.lv_cdn_diag fmy_stat_com_2_gear_rev.err_info_stat.err_sym fmy_stat_com_2_cdn_door.ctr_abc fmy_stat_com_2_cdn_door.ctr_end_diag fmy_stat_com_2_cdn_door.err_info_stat.lv_err_mem fmy_stat_com_2_cdn_door.err_info_stat.lv_ready fmy_stat_com_2_cdn_door.err_info_stat.lv_end_diag fmy_stat_com_2_cdn_door.err_info_stat.lv_cdn_diag fmy_stat_com_2_cdn_door.err_info_stat.err_sym fmy_stat_com_3_boff.ctr_abc fmy_stat_com_3_boff.ctr_end_diag fmy_stat_com_3_boff.err_info_stat.lv_err_mem fmy_stat_com_3_boff.err_info_stat.lv_ready fmy_stat_com_3_boff.err_info_stat.lv_end_diag fmy_stat_com_3_boff.err_info_stat.lv_cdn_diag fmy_stat_com_3_boff.err_info_stat.err_sym fmy_stat_com_3_efp.ctr_abc fmy_stat_com_3_efp.ctr_end_diag fmy_stat_com_3_efp.err_info_stat.lv_err_mem fmy_stat_com_3_efp.err_info_stat.lv_ready fmy_stat_com_3_efp.err_info_stat.lv_end_diag fmy_stat_com_3_efp.err_info_stat.lv_cdn_diag fmy_stat_com_3_efp.err_info_stat.err_sym fmy_stat_com_3_tq_etcu.ctr_abc fmy_stat_com_3_tq_etcu.ctr_end_diag fmy_stat_com_3_tq_etcu.err_info_stat.lv_err_mem fmy_stat_com_3_tq_etcu.err_info_stat.lv_ready fmy_stat_com_3_tq_etcu.err_info_stat.lv_end_diag fmy_stat_com_3_tq_etcu.err_info_stat.lv_cdn_diag fmy_stat_com_3_tq_etcu.err_info_stat.err_sym fmy_stat_com_3_etcu.ctr_abc fmy_stat_com_3_etcu.ctr_end_diag fmy_stat_com_3_etcu.err_info_stat.lv_err_mem fmy_stat_com_3_etcu.err_info_stat.lv_ready fmy_stat_com_3_etcu.err_info_stat.lv_end_diag fmy_stat_com_3_etcu.err_info_stat.lv_cdn_diag fmy_stat_com_3_etcu.err_info_stat.err_sym fmy_stat_com_3_etcu_disp.ctr_abc fmy_stat_com_3_etcu_disp.ctr_end_diag fmy_stat_com_3_etcu_disp.err_info_stat.lv_err_mem fmy_stat_com_3_etcu_disp.err_info_stat.lv_ready fmy_stat_com_3_etcu_disp.err_info_stat.lv_end_diag fmy_stat_com_3_etcu_disp.err_info_stat.lv_cdn_diag fmy_stat_com_3_etcu_disp.err_info_stat.err_sym fmy_stat_com_3_etcu_obd.ctr_abc fmy_stat_com_3_etcu_obd.ctr_end_diag fmy_stat_com_3_etcu_obd.err_info_stat.lv_err_mem fmy_stat_com_3_etcu_obd.err_info_stat.lv_ready fmy_stat_com_3_etcu_obd.err_info_stat.lv_end_diag fmy_stat_com_3_etcu_obd.err_info_stat.lv_cdn_diag fmy_stat_com_3_etcu_obd.err_info_stat.err_sym fmy_stat_com_3_gb.ctr_abc fmy_stat_com_3_gb.ctr_end_diag fmy_stat_com_3_gb.err_info_stat.lv_err_mem fmy_stat_com_3_gb.err_info_stat.lv_ready fmy_stat_com_3_gb.err_info_stat.lv_end_diag fmy_stat_com_3_gb.err_info_stat.lv_cdn_diag fmy_stat_com_3_gb.err_info_stat.err_sym fmy_stat_teg_sens_1.ctr_abc fmy_stat_teg_sens_1.ctr_end_diag fmy_stat_teg_sens_1.err_info_stat.lv_err_mem fmy_stat_teg_sens_1.err_info_stat.lv_ready fmy_stat_teg_sens_1.err_info_stat.lv_end_diag fmy_stat_teg_sens_1.err_info_stat.lv_cdn_diag fmy_stat_teg_sens_1.err_info_stat.err_sym fmy_stat_teg_sens_2.ctr_abc fmy_stat_teg_sens_2.ctr_end_diag fmy_stat_teg_sens_2.err_info_stat.lv_err_mem fmy_stat_teg_sens_2.err_info_stat.lv_ready fmy_stat_teg_sens_2.err_info_stat.lv_end_diag fmy_stat_teg_sens_2.err_info_stat.lv_cdn_diag fmy_stat_teg_sens_2.err_info_stat.err_sym fmy_stat_amp_plaus_cus.ctr_abc fmy_stat_amp_plaus_cus.ctr_end_diag fmy_stat_amp_plaus_cus.err_info_stat.lv_err_mem fmy_stat_amp_plaus_cus.err_info_stat.lv_ready fmy_stat_amp_plaus_cus.err_info_stat.lv_end_diag fmy_stat_amp_plaus_cus.err_info_stat.lv_cdn_diag fmy_stat_amp_plaus_cus.err_info_stat.err_sym fmy_stat_tcha_prs_low.ctr_abc fmy_stat_tcha_prs_low.ctr_end_diag fmy_stat_tcha_prs_low.err_info_stat.lv_err_mem fmy_stat_tcha_prs_low.err_info_stat.lv_ready fmy_stat_tcha_prs_low.err_info_stat.lv_end_diag fmy_stat_tcha_prs_low.err_info_stat.lv_cdn_diag fmy_stat_tcha_prs_low.err_info_stat.err_sym fmy_stat_tcha_leak.ctr_abc fmy_stat_tcha_leak.ctr_end_diag fmy_stat_tcha_leak.err_info_stat.lv_err_mem fmy_stat_tcha_leak.err_info_stat.lv_ready fmy_stat_tcha_leak.err_info_stat.lv_end_diag fmy_stat_tcha_leak.err_info_stat.lv_cdn_diag fmy_stat_tcha_leak.err_info_stat.err_sym fmy_stat_tcha_prs_dif.ctr_abc fmy_stat_tcha_prs_dif.ctr_end_diag fmy_stat_tcha_prs_dif.err_info_stat.lv_err_mem fmy_stat_tcha_prs_dif.err_info_stat.lv_ready fmy_stat_tcha_prs_dif.err_info_stat.lv_end_diag fmy_stat_tcha_prs_dif.err_info_stat.lv_cdn_diag fmy_stat_tcha_prs_dif.err_info_stat.err_sym fmy_stat_tcha_prs_high.ctr_abc fmy_stat_tcha_prs_high.ctr_end_diag fmy_stat_tcha_prs_high.err_info_stat.lv_err_mem fmy_stat_tcha_prs_high.err_info_stat.lv_ready fmy_stat_tcha_prs_high.err_info_stat.lv_end_diag fmy_stat_tcha_prs_high.err_info_stat.lv_cdn_diag fmy_stat_tcha_prs_high.err_info_stat.err_sym fmy_stat_put_plaus.ctr_abc fmy_stat_put_plaus.ctr_end_diag fmy_stat_put_plaus.err_info_stat.lv_err_mem fmy_stat_put_plaus.err_info_stat.lv_ready fmy_stat_put_plaus.err_info_stat.lv_end_diag fmy_stat_put_plaus.err_info_stat.lv_cdn_diag fmy_stat_put_plaus.err_info_stat.err_sym fmy_stat_map_plaus.ctr_abc fmy_stat_map_plaus.ctr_end_diag fmy_stat_map_plaus.err_info_stat.lv_err_mem fmy_stat_map_plaus.err_info_stat.lv_ready fmy_stat_map_plaus.err_info_stat.lv_end_diag fmy_stat_map_plaus.err_info_stat.lv_cdn_diag fmy_stat_map_plaus.err_info_stat.err_sym fmy_stat_tq_cst.ctr_abc fmy_stat_tq_cst.ctr_end_diag fmy_stat_tq_cst.err_info_stat.lv_err_mem fmy_stat_tq_cst.err_info_stat.lv_ready fmy_stat_tq_cst.err_info_stat.lv_end_diag fmy_stat_tq_cst.err_info_stat.lv_cdn_diag fmy_stat_tq_cst.err_info_stat.err_sym fmy_stat_gen_el.ctr_abc fmy_stat_gen_el.ctr_end_diag fmy_stat_gen_el.err_info_stat.lv_err_mem fmy_stat_gen_el.err_info_stat.lv_ready fmy_stat_gen_el.err_info_stat.lv_end_diag fmy_stat_gen_el.err_info_stat.lv_cdn_diag fmy_stat_gen_el.err_info_stat.err_sym fmy_stat_gen_mec.ctr_abc fmy_stat_gen_mec.ctr_end_diag fmy_stat_gen_mec.err_info_stat.lv_err_mem fmy_stat_gen_mec.err_info_stat.lv_ready fmy_stat_gen_mec.err_info_stat.lv_end_diag fmy_stat_gen_mec.err_info_stat.lv_cdn_diag fmy_stat_gen_mec.err_info_stat.err_sym fmy_stat_gen_h_temp.ctr_abc fmy_stat_gen_h_temp.ctr_end_diag fmy_stat_gen_h_temp.err_info_stat.lv_err_mem fmy_stat_gen_h_temp.err_info_stat.lv_ready fmy_stat_gen_h_temp.err_info_stat.lv_end_diag fmy_stat_gen_h_temp.err_info_stat.lv_cdn_diag fmy_stat_gen_h_temp.err_info_stat.err_sym fmy_stat_gen_typ_not_plaus.ctr_abc fmy_stat_gen_typ_not_plaus.ctr_end_diag fmy_stat_gen_typ_not_plaus.err_info_stat.lv_err_mem fmy_stat_gen_typ_not_plaus.err_info_stat.lv_ready fmy_stat_gen_typ_not_plaus.err_info_stat.lv_end_diag fmy_stat_gen_typ_not_plaus.err_info_stat.lv_cdn_diag fmy_stat_gen_typ_not_plaus.err_info_stat.err_sym fmy_stat_gen_msg_lost.ctr_abc fmy_stat_gen_msg_lost.ctr_end_diag fmy_stat_gen_msg_lost.err_info_stat.lv_err_mem fmy_stat_gen_msg_lost.err_info_stat.lv_ready fmy_stat_gen_msg_lost.err_info_stat.lv_end_diag fmy_stat_gen_msg_lost.err_info_stat.lv_cdn_diag fmy_stat_gen_msg_lost.err_info_stat.err_sym fmy_stat_gen_clc_v_not_plaus.ctr_abc fmy_stat_gen_clc_v_not_plaus.ctr_end_diag fmy_stat_gen_clc_v_not_plaus.err_info_stat.lv_err_mem fmy_stat_gen_clc_v_not_plaus.err_info_stat.lv_ready fmy_stat_gen_clc_v_not_plaus.err_info_stat.lv_end_diag fmy_stat_gen_clc_v_not_plaus.err_info_stat.lv_cdn_diag fmy_stat_gen_clc_v_not_plaus.err_info_stat.err_sym fmy_stat_gen_h_temp_clc.ctr_abc fmy_stat_gen_h_temp_clc.ctr_end_diag fmy_stat_gen_h_temp_clc.err_info_stat.lv_err_mem fmy_stat_gen_h_temp_clc.err_info_stat.lv_ready fmy_stat_gen_h_temp_clc.err_info_stat.lv_end_diag fmy_stat_gen_h_temp_clc.err_info_stat.lv_cdn_diag fmy_stat_gen_h_temp_clc.err_info_stat.err_sym fmy_stat_gen_ctl_not_plaus.ctr_abc fmy_stat_gen_ctl_not_plaus.ctr_end_diag fmy_stat_gen_ctl_not_plaus.err_info_stat.lv_err_mem fmy_stat_gen_ctl_not_plaus.err_info_stat.lv_ready fmy_stat_gen_ctl_not_plaus.err_info_stat.lv_end_diag fmy_stat_gen_ctl_not_plaus.err_info_stat.lv_cdn_diag fmy_stat_gen_ctl_not_plaus.err_info_stat.err_sym fmy_stat_slv_ivvt_in.ctr_abc fmy_stat_slv_ivvt_in.ctr_end_diag fmy_stat_slv_ivvt_in.err_info_stat.lv_err_mem fmy_stat_slv_ivvt_in.err_info_stat.lv_ready fmy_stat_slv_ivvt_in.err_info_stat.lv_end_diag fmy_stat_slv_ivvt_in.err_info_stat.lv_cdn_diag fmy_stat_slv_ivvt_in.err_info_stat.err_sym fmy_stat_slv_ivvt_ex.ctr_abc fmy_stat_slv_ivvt_ex.ctr_end_diag fmy_stat_slv_ivvt_ex.err_info_stat.lv_err_mem fmy_stat_slv_ivvt_ex.err_info_stat.lv_ready fmy_stat_slv_ivvt_ex.err_info_stat.lv_end_diag fmy_stat_slv_ivvt_ex.err_info_stat.lv_cdn_diag fmy_stat_slv_ivvt_ex.err_info_stat.err_sym fmy_stat_conv_mon_1.ctr_abc fmy_stat_conv_mon_1.ctr_end_diag fmy_stat_conv_mon_1.err_info_stat.lv_err_mem fmy_stat_conv_mon_1.err_info_stat.lv_ready fmy_stat_conv_mon_1.err_info_stat.lv_end_diag fmy_stat_conv_mon_1.err_info_stat.lv_cdn_diag fmy_stat_conv_mon_1.err_info_stat.err_sym fmy_stat_n_32_mon_1.ctr_abc fmy_stat_n_32_mon_1.ctr_end_diag fmy_stat_n_32_mon_1.err_info_stat.lv_err_mem fmy_stat_n_32_mon_1.err_info_stat.lv_ready fmy_stat_n_32_mon_1.err_info_stat.lv_end_diag fmy_stat_n_32_mon_1.err_info_stat.lv_cdn_diag fmy_stat_n_32_mon_1.err_info_stat.err_sym fmy_stat_pvs_mon_1.ctr_abc fmy_stat_pvs_mon_1.ctr_end_diag fmy_stat_pvs_mon_1.err_info_stat.lv_err_mem fmy_stat_pvs_mon_1.err_info_stat.lv_ready fmy_stat_pvs_mon_1.err_info_stat.lv_end_diag fmy_stat_pvs_mon_1.err_info_stat.lv_cdn_diag fmy_stat_pvs_mon_1.err_info_stat.err_sym fmy_stat_tq_dif_isc_mon_1.ctr_abc fmy_stat_tq_dif_isc_mon_1.ctr_end_diag fmy_stat_tq_dif_isc_mon_1.err_info_stat.lv_err_mem fmy_stat_tq_dif_isc_mon_1.err_info_stat.lv_ready fmy_stat_tq_dif_isc_mon_1.err_info_stat.lv_end_diag fmy_stat_tq_dif_isc_mon_1.err_info_stat.lv_cdn_diag fmy_stat_tq_dif_isc_mon_1.err_info_stat.err_sym fmy_stat_tq_req_mon_1.ctr_abc fmy_stat_tq_req_mon_1.ctr_end_diag fmy_stat_tq_req_mon_1.err_info_stat.lv_err_mem fmy_stat_tq_req_mon_1.err_info_stat.lv_ready fmy_stat_tq_req_mon_1.err_info_stat.lv_end_diag fmy_stat_tq_req_mon_1.err_info_stat.lv_cdn_diag fmy_stat_tq_req_mon_1.err_info_stat.err_sym fmy_stat_tq_ext_mon_1.ctr_abc fmy_stat_tq_ext_mon_1.ctr_end_diag fmy_stat_tq_ext_mon_1.err_info_stat.lv_err_mem fmy_stat_tq_ext_mon_1.err_info_stat.lv_ready fmy_stat_tq_ext_mon_1.err_info_stat.lv_end_diag fmy_stat_tq_ext_mon_1.err_info_stat.lv_cdn_diag fmy_stat_tq_ext_mon_1.err_info_stat.err_sym fmy_stat_tqi_av_mon_1.ctr_abc fmy_stat_tqi_av_mon_1.ctr_end_diag fmy_stat_tqi_av_mon_1.err_info_stat.lv_err_mem fmy_stat_tqi_av_mon_1.err_info_stat.lv_ready fmy_stat_tqi_av_mon_1.err_info_stat.lv_end_diag fmy_stat_tqi_av_mon_1.err_info_stat.lv_cdn_diag fmy_stat_tqi_av_mon_1.err_info_stat.err_sym fmy_stat_tqi_n_max_mon_1.ctr_abc fmy_stat_tqi_n_max_mon_1.ctr_end_diag fmy_stat_tqi_n_max_mon_1.err_info_stat.lv_err_mem fmy_stat_tqi_n_max_mon_1.err_info_stat.lv_ready fmy_stat_tqi_n_max_mon_1.err_info_stat.lv_end_diag fmy_stat_tqi_n_max_mon_1.err_info_stat.lv_cdn_diag fmy_stat_tqi_n_max_mon_1.err_info_stat.err_sym fmy_stat_mff_mon_1.ctr_abc fmy_stat_mff_mon_1.ctr_end_diag fmy_stat_mff_mon_1.err_info_stat.lv_err_mem fmy_stat_mff_mon_1.err_info_stat.lv_ready fmy_stat_mff_mon_1.err_info_stat.lv_end_diag fmy_stat_mff_mon_1.err_info_stat.lv_cdn_diag fmy_stat_mff_mon_1.err_info_stat.err_sym fmy_stat_cru_inh_mon_1.ctr_abc fmy_stat_cru_inh_mon_1.ctr_end_diag fmy_stat_cru_inh_mon_1.err_info_stat.lv_err_mem fmy_stat_cru_inh_mon_1.err_info_stat.lv_ready fmy_stat_cru_inh_mon_1.err_info_stat.lv_end_diag fmy_stat_cru_inh_mon_1.err_info_stat.lv_cdn_diag fmy_stat_cru_inh_mon_1.err_info_stat.err_sym fmy_stat_swi_afs_mon.ctr_abc fmy_stat_swi_afs_mon.ctr_end_diag fmy_stat_swi_afs_mon.err_info_stat.lv_err_mem fmy_stat_swi_afs_mon.err_info_stat.lv_ready fmy_stat_swi_afs_mon.err_info_stat.lv_end_diag fmy_stat_swi_afs_mon.err_info_stat.lv_cdn_diag fmy_stat_swi_afs_mon.err_info_stat.err_sym fmy_stat_iv_0.ctr_abc fmy_stat_iv_0.ctr_end_diag fmy_stat_iv_0.err_info_stat.lv_err_mem fmy_stat_iv_0.err_info_stat.lv_ready fmy_stat_iv_0.err_info_stat.lv_end_diag fmy_stat_iv_0.err_info_stat.lv_cdn_diag fmy_stat_iv_0.err_info_stat.err_sym fmy_stat_iv_1.ctr_abc fmy_stat_iv_1.ctr_end_diag fmy_stat_iv_1.err_info_stat.lv_err_mem fmy_stat_iv_1.err_info_stat.lv_ready fmy_stat_iv_1.err_info_stat.lv_end_diag fmy_stat_iv_1.err_info_stat.lv_cdn_diag fmy_stat_iv_1.err_info_stat.err_sym fmy_stat_iv_2.ctr_abc fmy_stat_iv_2.ctr_end_diag fmy_stat_iv_2.err_info_stat.lv_err_mem fmy_stat_iv_2.err_info_stat.lv_ready fmy_stat_iv_2.err_info_stat.lv_end_diag fmy_stat_iv_2.err_info_stat.lv_cdn_diag fmy_stat_iv_2.err_info_stat.err_sym fmy_stat_iv_3.ctr_abc fmy_stat_iv_3.ctr_end_diag fmy_stat_iv_3.err_info_stat.lv_err_mem fmy_stat_iv_3.err_info_stat.lv_ready fmy_stat_iv_3.err_info_stat.lv_end_diag fmy_stat_iv_3.err_info_stat.lv_cdn_diag fmy_stat_iv_3.err_info_stat.err_sym fmy_stat_iv_4.ctr_abc fmy_stat_iv_4.ctr_end_diag fmy_stat_iv_4.err_info_stat.lv_err_mem fmy_stat_iv_4.err_info_stat.lv_ready fmy_stat_iv_4.err_info_stat.lv_end_diag fmy_stat_iv_4.err_info_stat.lv_cdn_diag fmy_stat_iv_4.err_info_stat.err_sym fmy_stat_iv_5.ctr_abc fmy_stat_iv_5.ctr_end_diag fmy_stat_iv_5.err_info_stat.lv_err_mem fmy_stat_iv_5.err_info_stat.lv_ready fmy_stat_iv_5.err_info_stat.lv_end_diag fmy_stat_iv_5.err_info_stat.lv_cdn_diag fmy_stat_iv_5.err_info_stat.err_sym fmy_stat_iv_6.ctr_abc fmy_stat_iv_6.ctr_end_diag fmy_stat_iv_6.err_info_stat.lv_err_mem fmy_stat_iv_6.err_info_stat.lv_ready fmy_stat_iv_6.err_info_stat.lv_end_diag fmy_stat_iv_6.err_info_stat.lv_cdn_diag fmy_stat_iv_6.err_info_stat.err_sym fmy_stat_iv_7.ctr_abc fmy_stat_iv_7.ctr_end_diag fmy_stat_iv_7.err_info_stat.lv_err_mem fmy_stat_iv_7.err_info_stat.lv_ready fmy_stat_iv_7.err_info_stat.lv_end_diag fmy_stat_iv_7.err_info_stat.lv_cdn_diag fmy_stat_iv_7.err_info_stat.err_sym fmy_stat_iv_sc_0.ctr_abc fmy_stat_iv_sc_0.ctr_end_diag fmy_stat_iv_sc_0.err_info_stat.lv_err_mem fmy_stat_iv_sc_0.err_info_stat.lv_ready fmy_stat_iv_sc_0.err_info_stat.lv_end_diag fmy_stat_iv_sc_0.err_info_stat.lv_cdn_diag fmy_stat_iv_sc_0.err_info_stat.err_sym fmy_stat_iv_sc_1.ctr_abc fmy_stat_iv_sc_1.ctr_end_diag fmy_stat_iv_sc_1.err_info_stat.lv_err_mem fmy_stat_iv_sc_1.err_info_stat.lv_ready fmy_stat_iv_sc_1.err_info_stat.lv_end_diag fmy_stat_iv_sc_1.err_info_stat.lv_cdn_diag fmy_stat_iv_sc_1.err_info_stat.err_sym fmy_stat_iv_sc_2.ctr_abc fmy_stat_iv_sc_2.ctr_end_diag fmy_stat_iv_sc_2.err_info_stat.lv_err_mem fmy_stat_iv_sc_2.err_info_stat.lv_ready fmy_stat_iv_sc_2.err_info_stat.lv_end_diag fmy_stat_iv_sc_2.err_info_stat.lv_cdn_diag fmy_stat_iv_sc_2.err_info_stat.err_sym fmy_stat_iv_sc_3.ctr_abc fmy_stat_iv_sc_3.ctr_end_diag fmy_stat_iv_sc_3.err_info_stat.lv_err_mem fmy_stat_iv_sc_3.err_info_stat.lv_ready fmy_stat_iv_sc_3.err_info_stat.lv_end_diag fmy_stat_iv_sc_3.err_info_stat.lv_cdn_diag fmy_stat_iv_sc_3.err_info_stat.err_sym fmy_stat_iv_sc_4.ctr_abc fmy_stat_iv_sc_4.ctr_end_diag fmy_stat_iv_sc_4.err_info_stat.lv_err_mem fmy_stat_iv_sc_4.err_info_stat.lv_ready fmy_stat_iv_sc_4.err_info_stat.lv_end_diag fmy_stat_iv_sc_4.err_info_stat.lv_cdn_diag fmy_stat_iv_sc_4.err_info_stat.err_sym fmy_stat_iv_sc_5.ctr_abc fmy_stat_iv_sc_5.ctr_end_diag fmy_stat_iv_sc_5.err_info_stat.lv_err_mem fmy_stat_iv_sc_5.err_info_stat.lv_ready fmy_stat_iv_sc_5.err_info_stat.lv_end_diag fmy_stat_iv_sc_5.err_info_stat.lv_cdn_diag fmy_stat_iv_sc_5.err_info_stat.err_sym fmy_stat_iv_sc_6.ctr_abc fmy_stat_iv_sc_6.ctr_end_diag fmy_stat_iv_sc_6.err_info_stat.lv_err_mem fmy_stat_iv_sc_6.err_info_stat.lv_ready fmy_stat_iv_sc_6.err_info_stat.lv_end_diag fmy_stat_iv_sc_6.err_info_stat.lv_cdn_diag fmy_stat_iv_sc_6.err_info_stat.err_sym fmy_stat_iv_sc_7.ctr_abc fmy_stat_iv_sc_7.ctr_end_diag fmy_stat_iv_sc_7.err_info_stat.lv_err_mem fmy_stat_iv_sc_7.err_info_stat.lv_ready fmy_stat_iv_sc_7.err_info_stat.lv_end_diag fmy_stat_iv_sc_7.err_info_stat.lv_cdn_diag fmy_stat_iv_sc_7.err_info_stat.err_sym fmy_stat_pbk_iv_1.ctr_abc fmy_stat_pbk_iv_1.ctr_end_diag fmy_stat_pbk_iv_1.err_info_stat.lv_err_mem fmy_stat_pbk_iv_1.err_info_stat.lv_ready fmy_stat_pbk_iv_1.err_info_stat.lv_end_diag fmy_stat_pbk_iv_1.err_info_stat.lv_cdn_diag fmy_stat_pbk_iv_1.err_info_stat.err_sym fmy_stat_pbk_iv_2.ctr_abc fmy_stat_pbk_iv_2.ctr_end_diag fmy_stat_pbk_iv_2.err_info_stat.lv_err_mem fmy_stat_pbk_iv_2.err_info_stat.lv_ready fmy_stat_pbk_iv_2.err_info_stat.lv_end_diag fmy_stat_pbk_iv_2.err_info_stat.lv_cdn_diag fmy_stat_pbk_iv_2.err_info_stat.err_sym fmy_stat_pbk_iv_3.ctr_abc fmy_stat_pbk_iv_3.ctr_end_diag fmy_stat_pbk_iv_3.err_info_stat.lv_err_mem fmy_stat_pbk_iv_3.err_info_stat.lv_ready fmy_stat_pbk_iv_3.err_info_stat.lv_end_diag fmy_stat_pbk_iv_3.err_info_stat.lv_cdn_diag fmy_stat_pbk_iv_3.err_info_stat.err_sym fmy_stat_pbk_iv_4.ctr_abc fmy_stat_pbk_iv_4.ctr_end_diag fmy_stat_pbk_iv_4.err_info_stat.lv_err_mem fmy_stat_pbk_iv_4.err_info_stat.lv_ready fmy_stat_pbk_iv_4.err_info_stat.lv_end_diag fmy_stat_pbk_iv_4.err_info_stat.lv_cdn_diag fmy_stat_pbk_iv_4.err_info_stat.err_sym cdn_diag_prev_ecras_el cdn_diag_prev_dmtlh cdn_diag_prev_rly_accout cdn_diag_prev_dmtls cdn_diag_prev_dmtl_pump cdn_diag_prev_ebox_cfa cdn_diag_prev_ef cdn_diag_prev_rly_st cdn_diag_prev_lsh_up_1 cdn_diag_prev_sof cdn_diag_prev_rly_crcv_heat cdn_diag_prev_ctl_lsl_up_1 cdn_diag_prev_lsh_up_2 cdn_diag_prev_ctl_lsl_up_2 cdn_diag_prev_lsh_down_1 cdn_diag_prev_lsh_down_2 cdn_diag_prev_el_cps cdn_diag_prev_ect_el cdn_diag_prev_slv_ivvt_in_1 cdn_diag_prev_slv_ivvt_in_2 cdn_diag_prev_slv_ivvt_ex_1 cdn_diag_prev_slv_ivvt_ex_2 cdn_diag_prev_ecf_el_1 cdn_diag_prev_rfp_dr_1 cdn_diag_prev_rfp_dr_2 cdn_diag_prev_wg_1_dr cdn_diag_prev_wg_2_dr cdn_diag_prev_iv_0 cdn_diag_prev_iv_1 cdn_diag_prev_iv_2 cdn_diag_prev_iv_3 cdn_diag_prev_iv_4 cdn_diag_prev_iv_5 cdn_diag_prev_iv_6 cdn_diag_prev_iv_7 cdn_diag_prev_pbk_iv_1 cdn_diag_prev_pbk_iv_2 cdn_diag_prev_pbk_iv_3 cdn_diag_prev_pbk_iv_4 cdn_diag_prev_poil_dr /end OUT_MEASUREMENT
/end FUNCTION
/begin FUNCTION ERRM_Anti_bounce_Algorithm "Anti_bounce_Algorithm" /begin DEF_CHARACTERISTIC lc_abc_bench lc_err_det_upd /end DEF_CHARACTERISTIC /end FUNCTION
/begin FUNCTION ERRM_Debounce_algorithm_Appl_Inc "Debounce_Algorithm_Appl_Inc"
 /begin OUT_MEASUREMENT ctr_err_intm_nr lv_abc_inh err_intm_ctr_frc[0] err_intm_diag_inst[0] /end OUT_MEASUREMENT
/end FUNCTION
/begin FUNCTION C_B_ERRM "C_B_ERRM"
 /begin SUB_FUNCTION ERRM_Cycle_Manager ERRM_Similar_Conditions ERRM_Com_Interface ERRM_History_Memory ERRM_Lamp_Management ERRM_Failure_Classes ERRM_Com_Interface_Appl_Inc ERRM_Configuration_Module ERRM_DTC_Management ERRM_Similar_Conditions_Appl_Inc ERRM_Environmental_data_Appl_Inc ERRM_Dyn_Error_Management ERRM_Readiness_Codes ERRM_Environmental_data ERRM_Statistical_Data ERRM_Rate_Base_Monitoring ERRM_Dyn_Error_Managmt_Appl_Inc ERRM_Statistical_Data_Appl_Inc ERRM_Rate_Base_Monitoring_Appl_I ERRM_Lamp_Management_Appl_Inc ERRM_DTC_Management_Appl_Inc /end SUB_FUNCTION
/end FUNCTION
/begin FUNCTION ERRM_Cycle_Manager "Cycle_Manager" /begin DEF_CHARACTERISTIC c_tco_wup_thd c_tco_wup_inc /end DEF_CHARACTERISTIC /begin OUT_MEASUREMENT lv_dc lv_wup_cyc lv_state_wup /end OUT_MEASUREMENT /end FUNCTION
/begin FUNCTION ERRM_Similar_Conditions "Similar_Conditions"
 /begin DEF_CHARACTERISTIC c_ctr_scdn_equ_dc_max c_n_scdn_equ c_load_scdn_equ lc_ena_scdn c_ctr_scdn_not_err_thd[0] c_ctr_scdn_not_err_thd[1] c_ctr_scdn_not_err_thd[2] c_ctr_scdn_not_err_thd[3] c_ctr_scdn_not_err_thd[4] c_ctr_scdn_not_err_thd[5] c_ctr_scdn_not_err_thd[6] c_ctr_scdn_not_err_thd[7] c_ctr_scdn_not_err_thd[8] c_ctr_scdn_not_err_thd[9] c_ctr_scdn_not_err_thd[10] c_ctr_scdn_not_err_thd[11] /end DEF_CHARACTERISTIC
/end FUNCTION
/begin FUNCTION ERRM_Com_Interface "Communication_Interface"
 /begin DEF_CHARACTERISTIC c_state_ready_obd_1 c_state_ready_obd_2 c_state_ready_obd_3 c_state_ready_cmpl_obd_1 /end DEF_CHARACTERISTIC
/end FUNCTION
/begin FUNCTION ERRM_History_Memory "History_Memory" /begin DEF_CHARACTERISTIC lc_err_fmy_his_clr /end DEF_CHARACTERISTIC
 /begin OUT_MEASUREMENT ctr_err_his_nr err_his_dtc[0] err_his_dtc[1] err_his_dtc[2] err_his_dtc[3] err_his_dtc[4] err_his_dtc[5] err_his_dtc[6] err_his_dtc[7] err_his_dtc[8] err_his_dtc[9] err_his[0][0] err_his[0][1] err_his[0][2] err_his[0][3] err_his[0][4] err_his[0][5] err_his[0][6] err_his[0][7] err_his[0][8] err_his[1][0] err_his[1][1] err_his[1][2] err_his[1][3] err_his[1][4] err_his[1][5] err_his[1][6] err_his[1][7] err_his[1][8] err_his[2][0] err_his[2][1] err_his[2][2] err_his[2][3] err_his[2][4] err_his[2][5] err_his[2][6] err_his[2][7] err_his[2][8] err_his[3][0] err_his[3][1] err_his[3][2] err_his[3][3] err_his[3][4] err_his[3][5] err_his[3][6] err_his[3][7] err_his[3][8] err_his[4][0] err_his[4][1] err_his[4][2] err_his[4][3] err_his[4][4] err_his[4][5] err_his[4][6] err_his[4][7] err_his[4][8] err_his[5][0] err_his[5][1] err_his[5][2] err_his[5][3] err_his[5][4] err_his[5][5] err_his[5][6] err_his[5][7] err_his[5][8] err_his[6][0] err_his[6][1] err_his[6][2] err_his[6][3] err_his[6][4] err_his[6][5] err_his[6][6] err_his[6][7] err_his[6][8] err_his[7][0] err_his[7][1] err_his[7][2] err_his[7][3] err_his[7][4] err_his[7][5] err_his[7][6] err_his[7][7] err_his[7][8] err_his[8][0] err_his[8][1] err_his[8][2] err_his[8][3] err_his[8][4] err_his[8][5] err_his[8][6] err_his[8][7] err_his[8][8] err_his[9][0] err_his[9][1] err_his[9][2] err_his[9][3] err_his[9][4] err_his[9][5] err_his[9][6] err_his[9][7] err_his[9][8] /end OUT_MEASUREMENT
/end FUNCTION
/end MODULE
/end PROJECT
