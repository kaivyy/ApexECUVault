ASAP2_VERSION 1 3
/begin PROJECT P390 "BMW DDE6.2 6-Zylinder VP0.1 11.11.2003 CAN12H"
/begin HEADER "" VERSION "VP01_6Z_CAN12H" PROJECT_NO P390 /end HEADER
/begin MODULE DIM ""
/begin MOD_COMMON "" BYTE_ORDER MSB_FIRST ALIGNMENT_BYTE 1 ALIGNMENT_WORD 2 ALIGNMENT_LONG 4 ALIGNMENT_FLOAT32_IEEE 4 /end MOD_COMMON
/begin CHARACTERISTIC DSM_EnvDfp_Layer_TANS_C "Fehlerpfad spezifische Umweltbedingungen fuer Fehlerpfad Dfp_Layer_TANS" VAL_BLK 0xCA278 Kwb_Wu8 255.000000000 SigName 0.00 255.000000000 FORMAT "%13.9" NUMBER 10 /end CHARACTERISTIC
/begin CHARACTERISTIC DSM_EnvDfp_ACCDSwtin_C "Fehlerpfad spezifische Umweltbedingungen fuer Fehlerpfad Dfp_ACCDSwtin" VAL_BLK 0xCA282 Kwb_Wu8 255.000000000 SigName 0.00 255.000000000 FORMAT "%13.9" NUMBER 10 /end CHARACTERISTIC
/begin CHARACTERISTIC DSM_EnvDfp_ACC_PlausTrqDes_C "Fehlerpfad spezifische Umweltbedingungen fuer Fehlerpfad Dfp_ACC_PlausTrqDes" VAL_BLK 0xCA28C Kwb_Wu8 255.000000000 SigName 0.00 255.000000000 FORMAT "%13.9" NUMBER 10 /end CHARACTERISTIC
/begin CHARACTERISTIC DSM_EnvDfp_ACC_trqInr_C "Fehlerpfad spezifische Umweltbedingungen fuer Fehlerpfad Dfp_ACC_trqInr" VAL_BLK 0xCA296 Kwb_Wu8 255.000000000 SigName 0.00 255.000000000 FORMAT "%13.9" NUMBER 10 /end CHARACTERISTIC
/begin CHARACTERISTIC DSM_EnvDfp_ACTrq_C "Fehlerpfad spezifische Umweltbedingungen fuer Fehlerpfad Dfp_ACTrq" VAL_BLK 0xCA2A0 Kwb_Wu8 255.000000000 SigName 0.00 255.000000000 FORMAT "%13.9" NUMBER 10 /end CHARACTERISTIC
/begin CHARACTERISTIC DSM_EnvDfp_ADCMon_C "Fehlerpfad spezifische Umweltbedingungen fuer Fehlerpfad Dfp_ADCMon" VAL_BLK 0xCA2AA Kwb_Wu8 255.000000000 SigName 0.00 255.000000000 FORMAT "%13.9" NUMBER 10 /end CHARACTERISTIC
/begin CHARACTERISTIC DSM_EnvDfp_AFSCDIdlAdjVal_C "Fehlerpfad spezifische Umweltbedingungen fuer Fehlerpfad Dfp_AFSCDIdlAdjVal" VAL_BLK 0xCA2B4 Kwb_Wu8 255.000000000 SigName 0.00 255.000000000 FORMAT "%13.9" NUMBER 10 /end CHARACTERISTIC
/begin CHARACTERISTIC DSM_EnvDfp_AFSCDLdAdjVal_C "Fehlerpfad spezifische Umweltbedingungen fuer Fehlerpfad Dfp_AFSCDLdAdjVal" VAL_BLK 0xCA2BE Kwb_Wu8 255.000000000 SigName 0.00 255.000000000 FORMAT "%13.9" NUMBER 10 /end CHARACTERISTIC
/begin CHARACTERISTIC DSM_EnvDfp_AFSCD_AirTempDcyc_C "Fehlerpfad spezifische Umweltbedingungen fuer Fehlerpfad Dfp_AFSCD_AirTempDcyc" VAL_BLK 0xCA2C8 Kwb_Wu8 255.000000000 SigName 0.00 255.000000000 FORMAT "%13.9" NUMBER 10 /end CHARACTERISTIC
/begin CHARACTERISTIC DSM_EnvDfp_AFSCD_PlOffsDrft_C "Fehlerpfad spezifische Umweltbedingungen fuer Fehlerpfad Dfp_AFSCD_PlOffsDrft" VAL_BLK 0xCA2D2 Kwb_Wu8 255.000000000 SigName 0.00 255.000000000 FORMAT "%13.9" NUMBER 10 /end CHARACTERISTIC
/begin CHARACTERISTIC DSM_EnvDfp_AFSCD_PlSetyDrft_C "Fehlerpfad spezifische Umweltbedingungen fuer Fehlerpfad Dfp_AFSCD_PlSetyDrft" VAL_BLK 0xCA2DC Kwb_Wu8 255.000000000 SigName 0.00 255.000000000 FORMAT "%13.9" NUMBER 10 /end CHARACTERISTIC
/begin CHARACTERISTIC DSM_EnvDfp_AFSCD_SRCAirTemp_C "Fehlerpfad spezifische Umweltbedingungen fuer Fehlerpfad Dfp_AFSCD_SRCAirTemp" VAL_BLK 0xCA2E6 Kwb_Wu8 255.000000000 SigName 0.00 255.000000000 FORMAT "%13.9" NUMBER 10 /end CHARACTERISTIC
/begin CHARACTERISTIC DSM_EnvDfp_AFSCD_SRCBatt_C "Fehlerpfad spezifische Umweltbedingungen fuer Fehlerpfad Dfp_AFSCD_SRCBatt" VAL_BLK 0xCA2F0 Kwb_Wu8 255.000000000 SigName 0.00 255.000000000 FORMAT "%13.9" NUMBER 10 /end CHARACTERISTIC
/begin CHARACTERISTIC DSM_EnvDfp_AFSCD_SRCCorrAirm_C "Fehlerpfad spezifische Umweltbedingungen fuer Fehlerpfad Dfp_AFSCD_SRCCorrAirm" VAL_BLK 0xCA2FA Kwb_Wu8 255.000000000 SigName 0.00 255.000000000 FORMAT "%13.9" NUMBER 10 /end CHARACTERISTIC
/begin CHARACTERISTIC DSM_EnvDfp_AFSCD_SRCRawAirm_C "Fehlerpfad spezifische Umweltbedingungen fuer Fehlerpfad Dfp_AFSCD_SRCRawAirm" VAL_BLK 0xCA304 Kwb_Wu8 255.000000000 SigName 0.00 255.000000000 FORMAT "%13.9" NUMBER 10 /end CHARACTERISTIC
/begin CHARACTERISTIC DSM_EnvDfp_AFSCD_SRCRefSigPer_C "Fehlerpfad spezifische Umweltbedingungen fuer Fehlerpfad Dfp_AFSCD_SRCRefSigPer" VAL_BLK 0xCA30E Kwb_Wu8 255.000000000 SigName 0.00 255.000000000 FORMAT "%13.9" NUMBER 10 /end CHARACTERISTIC
/begin CHARACTERISTIC DSM_EnvDfp_AOHtCD_C "Fehlerpfad spezifische Umweltbedingungen fuer Fehlerpfad Dfp_AOHtCD" VAL_BLK 0xCA318 Kwb_Wu8 255.000000000 SigName 0.00 255.000000000 FORMAT "%13.9" NUMBER 10 /end CHARACTERISTIC
/begin CHARACTERISTIC DSM_EnvDfp_AOHtCD_AOHtDia1_C "Fehlerpfad spezifische Umweltbedingungen fuer Fehlerpfad Dfp_AOHtCD_AOHtDia1" VAL_BLK 0xCA322 Kwb_Wu8 255.000000000 SigName 0.00 255.000000000 FORMAT "%13.9" NUMBER 10 /end CHARACTERISTIC
/begin CHARACTERISTIC DSM_EnvDfp_AOHtCD_AOHtDia2_C "Fehlerpfad spezifische Umweltbedingungen fuer Fehlerpfad Dfp_AOHtCD_AOHtDia2" VAL_BLK 0xCA32C Kwb_Wu8 255.000000000 SigName 0.00 255.000000000 FORMAT "%13.9" NUMBER 10 /end CHARACTERISTIC
/begin CHARACTERISTIC DSM_EnvDfp_Layer_TUMG_C "Fehlerpfad spezifische Umweltbedingungen fuer Fehlerpfad Dfp_Layer_TUMG" VAL_BLK 0xCA336 Kwb_Wu8 255.000000000 SigName 0.00 255.000000000 FORMAT "%13.9" NUMBER 10 /end CHARACTERISTIC
/begin CHARACTERISTIC DSM_EnvDfp_AOHtCD_AOHtDia3_C "Fehlerpfad spezifische Umweltbedingungen fuer Fehlerpfad Dfp_AOHtCD_AOHtDia3" VAL_BLK 0xCA340 Kwb_Wu8 255.000000000 SigName 0.00 255.000000000 FORMAT "%13.9" NUMBER 10 /end CHARACTERISTIC
/begin CHARACTERISTIC DSM_EnvDfp_APP1_C "Fehlerpfad spezifische Umweltbedingungen fuer Fehlerpfad Dfp_APP1" VAL_BLK 0xCA34A Kwb_Wu8 255.000000000 SigName 0.00 255.000000000 FORMAT "%13.9" NUMBER 10 /end CHARACTERISTIC
/begin CHARACTERISTIC DSM_EnvDfp_Layer_GEN_C "Fehlerpfad spezifische Umweltbedingungen fuer Fehlerpfad Dfp_Layer_GEN" VAL_BLK 0xCA354 Kwb_Wu8 255.000000000 SigName 0.00 255.000000000 FORMAT "%13.9" NUMBER 10 /end CHARACTERISTIC
/begin CHARACTERISTIC DSM_EnvDfp_Layer_BSD_C "Fehlerpfad spezifische Umweltbedingungen fuer Fehlerpfad Dfp_Layer_BSD" VAL_BLK 0xCA35E Kwb_Wu8 255.000000000 SigName 0.00 255.000000000 FORMAT "%13.9" NUMBER 10 /end CHARACTERISTIC
/begin CHARACTERISTIC DSM_EnvDfp_APP2_C "Fehlerpfad spezifische Umweltbedingungen fuer Fehlerpfad Dfp_APP2" VAL_BLK 0xCA368 Kwb_Wu8 255.000000000 SigName 0.00 255.000000000 FORMAT "%13.9" NUMBER 10 /end CHARACTERISTIC
/begin CHARACTERISTIC DSM_EnvDfp_APSCD_C "Fehlerpfad spezifische Umweltbedingungen fuer Fehlerpfad Dfp_APSCD" VAL_BLK 0xCA372 Kwb_Wu8 255.000000000 SigName 0.00 255.000000000 FORMAT "%13.9" NUMBER 10 /end CHARACTERISTIC
/begin CHARACTERISTIC DSM_EnvDfp_ARS_C "Fehlerpfad spezifische Umweltbedingungen fuer Fehlerpfad Dfp_ARS" VAL_BLK 0xCA37C Kwb_Wu8 255.000000000 SigName 0.00 255.000000000 FORMAT "%13.9" NUMBER 10 /end CHARACTERISTIC
/begin CHARACTERISTIC DSM_EnvDfp_AccPedPlausBrk_C "Fehlerpfad spezifische Umweltbedingungen fuer Fehlerpfad Dfp_AccPedPlausBrk" VAL_BLK 0xCA386 Kwb_Wu8 255.000000000 SigName 0.00 255.000000000 FORMAT "%13.9" NUMBER 10 /end CHARACTERISTIC
/begin CHARACTERISTIC DSM_EnvDfp_AirCtlPlateBreak_C "DSM variable for Dfp_AirCtlPlateBreak_mp" VAL_BLK 0xCA390 Kwb_Wu8 255.000000000 SigName 0.00 255.000000000 FORMAT "%13.9" NUMBER 10 /end CHARACTERISTIC
/begin CHARACTERISTIC DSM_EnvDfp_AirCtl_GovNegDev_C "Fehlerpfad spezifische Umweltbedingungen fuer Fehlerpfad Dfp_AirCtl_GovNegDev" VAL_BLK 0xCA39A Kwb_Wu8 255.000000000 SigName 0.00 255.000000000 FORMAT "%13.9" NUMBER 10 /end CHARACTERISTIC
/begin CHARACTERISTIC DSM_EnvDfp_AirCtl_GovNegDev2_C "Fehlerpfad spezifische Umweltbedingungen fuer Fehlerpfad Dfp_AirCtl_GovNegDev2" VAL_BLK 0xCA3A4 Kwb_Wu8 255.000000000 SigName 0.00 255.000000000 FORMAT "%13.9" NUMBER 10 /end CHARACTERISTIC
/begin CHARACTERISTIC DSM_EnvDfp_AirCtl_GovPosDev_C "Fehlerpfad spezifische Umweltbedingungen fuer Fehlerpfad Dfp_AirCtl_GovPosDev" VAL_BLK 0xCA3AE Kwb_Wu8 255.000000000 SigName 0.00 255.000000000 FORMAT "%13.9" NUMBER 10 /end CHARACTERISTIC
/begin CHARACTERISTIC DSM_EnvDfp_AirCtl_GovPosDev2_C "Fehlerpfad spezifische Umweltbedingungen fuer Fehlerpfad Dfp_AirCtl_GovPosDev2" VAL_BLK 0xCA3B8 Kwb_Wu8 255.000000000 SigName 0.00 255.000000000 FORMAT "%13.9" NUMBER 10 /end CHARACTERISTIC
/begin CHARACTERISTIC DSM_EnvDfp_AltCD_C "Fehlerpfad spezifische Umweltbedingungen fuer Fehlerpfad Dfp_AltCD" VAL_BLK 0xCA3C2 Kwb_Wu8 255.000000000 SigName 0.00 255.000000000 FORMAT "%13.9" NUMBER 10 /end CHARACTERISTIC
/begin CHARACTERISTIC DSM_EnvDfp_Layer_QLT_C "Fehlerpfad spezifische Umweltbedingungen fuer Fehlerpfad Dfp_Layer_QLT" VAL_BLK 0xCA3CC Kwb_Wu8 255.000000000 SigName 0.00 255.000000000 FORMAT "%13.9" NUMBER 10 /end CHARACTERISTIC
/begin CHARACTERISTIC DSM_EnvDfp_BPACD_BPADia1_C "Fehlerpfad spezifische Umweltbedingungen fuer Fehlerpfad Dfp_BPACD_BPADia1" VAL_BLK 0xCA3D6 Kwb_Wu8 255.000000000 SigName 0.00 255.000000000 FORMAT "%13.9" NUMBER 10 /end CHARACTERISTIC
/begin CHARACTERISTIC DSM_EnvDfp_Layer_IBS1_C "Fehlerpfad spezifische Umweltbedingungen fuer Fehlerpfad Dfp_Layer_IBS1" VAL_BLK 0xCA3E0 Kwb_Wu8 255.000000000 SigName 0.00 255.000000000 FORMAT "%13.9" NUMBER 10 /end CHARACTERISTIC
/begin CHARACTERISTIC DSM_EnvDfp_Layer_IBS2_C "Fehlerpfad spezifische Umweltbedingungen fuer Fehlerpfad Dfp_Layer_IBS2" VAL_BLK 0xCA3EA Kwb_Wu8 255.000000000 SigName 0.00 255.000000000 FORMAT "%13.9" NUMBER 10 /end CHARACTERISTIC
/begin CHARACTERISTIC DSM_EnvDfp_Layer_IBS3_C "Fehlerpfad spezifische Umweltbedingungen fuer Fehlerpfad Dfp_Layer_IBS3" VAL_BLK 0xCA3F4 Kwb_Wu8 255.000000000 SigName 0.00 255.000000000 FORMAT "%13.9" NUMBER 10 /end CHARACTERISTIC
/begin CHARACTERISTIC DSM_EnvDfp_Layer_PMBN_C "Fehlerpfad spezifische Umweltbedingungen fuer Fehlerpfad Dfp_Layer_PMBN" VAL_BLK 0xCA3FE Kwb_Wu8 255.000000000 SigName 0.00 255.000000000 FORMAT "%13.9" NUMBER 10 /end CHARACTERISTIC
/begin CHARACTERISTIC DSM_EnvDfp_Layer_PMBATT_C "Fehlerpfad spezifische Umweltbedingungen fuer Fehlerpfad Dfp_Layer_PMBATT" VAL_BLK 0xCA408 Kwb_Wu8 255.000000000 SigName 0.00 255.000000000 FORMAT "%13.9" NUMBER 10 /end CHARACTERISTIC
/begin CHARACTERISTIC DSM_EnvDfp_BPACD_BPADia2_C "Fehlerpfad spezifische Umweltbedingungen fuer Fehlerpfad Dfp_BPACD_BPADia2" VAL_BLK 0xCA412 Kwb_Wu8 255.000000000 SigName 0.00 255.000000000 FORMAT "%13.9" NUMBER 10 /end CHARACTERISTIC
/begin CHARACTERISTIC DSM_EnvDfp_BPACD_BPADia3_C "Fehlerpfad spezifische Umweltbedingungen fuer Fehlerpfad Dfp_BPACD_BPADia3" VAL_BLK 0xCA41C Kwb_Wu8 255.000000000 SigName 0.00 255.000000000 FORMAT "%13.9" NUMBER 10 /end CHARACTERISTIC
/begin CHARACTERISTIC DSM_EnvDfp_BPACD_Max_C "Fehlerpfad spezifische Umweltbedingungen fuer Fehlerpfad Dfp_BPACD_Max" VAL_BLK 0xCA426 Kwb_Wu8 255.000000000 SigName 0.00 255.000000000 FORMAT "%13.9" NUMBER 10 /end CHARACTERISTIC
/begin CHARACTERISTIC DSM_EnvDfp_BPACD_Min_C "Fehlerpfad spezifische Umweltbedingungen fuer Fehlerpfad Dfp_BPACD_Min" VAL_BLK 0xCA430 Kwb_Wu8 255.000000000 SigName 0.00 255.000000000 FORMAT "%13.9" NUMBER 10 /end CHARACTERISTIC
/begin CHARACTERISTIC DSM_EnvDfp_BPACD_SigNpl_C "Fehlerpfad spezifische Umweltbedingungen fuer Fehlerpfad Dfp_BPACD_SigNpl" VAL_BLK 0xCA43A Kwb_Wu8 255.000000000 SigName 0.00 255.000000000 FORMAT "%13.9" NUMBER 10 /end CHARACTERISTIC
/begin CHARACTERISTIC DSM_EnvDfp_BPSCD_C "Fehlerpfad spezifische Umweltbedingungen fuer Fehlerpfad Dfp_BPSCD" VAL_BLK 0xCA444 Kwb_Wu8 255.000000000 SigName 0.00 255.000000000 FORMAT "%13.9" NUMBER 10 /end CHARACTERISTIC
/begin CHARACTERISTIC DSM_EnvDfp_BattCD_C "Fehlerpfad spezifische Umweltbedingungen fuer Fehlerpfad Dfp_BattCD" VAL_BLK 0xCA44E Kwb_Wu8 255.000000000 SigName 0.00 255.000000000 FORMAT "%13.9" NUMBER 10 /end CHARACTERISTIC
/begin CHARACTERISTIC DSM_EnvDfp_BrkCD_C "Fehlerpfad spezifische Umweltbedingungen fuer Fehlerpfad Dfp_BrkCD" VAL_BLK 0xCA458 Kwb_Wu8 255.000000000 SigName 0.00 255.000000000 FORMAT "%13.9" NUMBER 10 /end CHARACTERISTIC
/begin CHARACTERISTIC DSM_EnvDfp_Bss_C "Fehlerpfad spezifische Umweltbedingungen fuer Fehlerpfad Dfp_Bss" VAL_BLK 0xCA462 Kwb_Wu8 255.000000000 SigName 0.00 255.000000000 FORMAT "%13.9" NUMBER 10 /end CHARACTERISTIC
/begin CHARACTERISTIC DSM_EnvDfp_CBACD_C "Fehlerpfad spezifische Umweltbedingungen fuer Fehlerpfad Dfp_CBACD" VAL_BLK 0xCA46C Kwb_Wu8 255.000000000 SigName 0.00 255.000000000 FORMAT "%13.9" NUMBER 10 /end CHARACTERISTIC
/begin CHARACTERISTIC DSM_EnvDfp_CTSCD_C "Fehlerpfad spezifische Umweltbedingungen fuer Fehlerpfad Dfp_CTSCD" VAL_BLK 0xCA476 Kwb_Wu8 255.000000000 SigName 0.00 255.000000000 FORMAT "%13.9" NUMBER 10 /end CHARACTERISTIC
/begin CHARACTERISTIC DSM_EnvDfp_Clg_DynTst_C "Fehlerpfad spezifische Umweltbedingungen fuer Fehlerpfad Dfp_Clg_DynTst" VAL_BLK 0xCA480 Kwb_Wu8 255.000000000 SigName 0.00 255.000000000 FORMAT "%13.9" NUMBER 10 /end CHARACTERISTIC
/begin CHARACTERISTIC DSM_EnvDfp_CmbChbMisfire1_C "Fehlerpfad spezifische Umweltbedingungen fuer Fehlerpfad Dfp_CmbChbMisfire1" VAL_BLK 0xCA48A Kwb_Wu8 255.000000000 SigName 0.00 255.000000000 FORMAT "%13.9" NUMBER 10 /end CHARACTERISTIC
/begin CHARACTERISTIC DSM_EnvDfp_CmbChbMisfire2_C "Fehlerpfad spezifische Umweltbedingungen fuer Fehlerpfad Dfp_CmbChbMisfire2" VAL_BLK 0xCA494 Kwb_Wu8 255.000000000 SigName 0.00 255.000000000 FORMAT "%13.9" NUMBER 10 /end CHARACTERISTIC
/begin CHARACTERISTIC DSM_EnvDfp_CmbChbMisfire3_C "Fehlerpfad spezifische Umweltbedingungen fuer Fehlerpfad Dfp_CmbChbMisfire3" VAL_BLK 0xCA49E Kwb_Wu8 255.000000000 SigName 0.00 255.000000000 FORMAT "%13.9" NUMBER 10 /end CHARACTERISTIC
/begin CHARACTERISTIC DSM_EnvDfp_CmbChbMisfire4_C "Fehlerpfad spezifische Umweltbedingungen fuer Fehlerpfad Dfp_CmbChbMisfire4" VAL_BLK 0xCA4A8 Kwb_Wu8 255.000000000 SigName 0.00 255.000000000 FORMAT "%13.9" NUMBER 10 /end CHARACTERISTIC
/begin CHARACTERISTIC DSM_EnvDfp_CmbChbMisfire5_C "Fehlerpfad spezifische Umweltbedingungen fuer Fehlerpfad Dfp_CmbChbMisfire5" VAL_BLK 0xCA4B2 Kwb_Wu8 255.000000000 SigName 0.00 255.000000000 FORMAT "%13.9" NUMBER 10 /end CHARACTERISTIC
/begin CHARACTERISTIC DSM_EnvDfp_CmbChbMisfire6_C "Fehlerpfad spezifische Umweltbedingungen fuer Fehlerpfad Dfp_CmbChbMisfire6" VAL_BLK 0xCA4BC Kwb_Wu8 255.000000000 SigName 0.00 255.000000000 FORMAT "%13.9" NUMBER 10 /end CHARACTERISTIC
/begin CHARACTERISTIC DSM_EnvDfp_CmbChbMisfireMul_C "Fehlerpfad spezifische Umweltbedingungen fuer Fehlerpfad Dfp_CmbChbMisfireMul" VAL_BLK 0xCA4C6 Kwb_Wu8 255.000000000 SigName 0.00 255.000000000 FORMAT "%13.9" NUMBER 10 /end CHARACTERISTIC
/begin CHARACTERISTIC DSM_EnvDfp_CoVMDCSh_C "Fehlerpfad spezifische Umweltbedingungen fuer Fehlerpfad Dfp_CoVMDCSh" VAL_BLK 0xCA4D0 Kwb_Wu8 255.000000000 SigName 0.00 255.000000000 FORMAT "%13.9" NUMBER 10 /end CHARACTERISTIC
/begin CHARACTERISTIC DSM_EnvDfp_ConvCD_C "Fehlerpfad spezifische Umweltbedingungen fuer Fehlerpfad Dfp_ConvCD" VAL_BLK 0xCA4DA Kwb_Wu8 255.000000000 SigName 0.00 255.000000000 FORMAT "%13.9" NUMBER 10 /end CHARACTERISTIC
/begin CHARACTERISTIC DSM_EnvDfp_CrCCDMFL_C "Fehlerpfad spezifische Umweltbedingungen fuer Fehlerpfad Dfp_CrCCDMFL" VAL_BLK 0xCA4E4 Kwb_Wu8 255.000000000 SigName 0.00 255.000000000 FORMAT "%13.9" NUMBER 10 /end CHARACTERISTIC
/begin CHARACTERISTIC DSM_EnvDfp_CrCtl_vCrCtl_C "Fehlerpfad spezifische Umweltbedingungen fuer Fehlerpfad Dfp_CrCtl_vCrCtl" VAL_BLK 0xCA4EE Kwb_Wu8 255.000000000 SigName 0.00 255.000000000 FORMAT "%13.9" NUMBER 10 /end CHARACTERISTIC
/begin CHARACTERISTIC DSM_EnvDfp_Dummy1_C "Fehlerpfad spezifische Umweltbedingungen fuer Fehlerpfad Dfp_Dummy1" VAL_BLK 0xCA4F8 Kwb_Wu8 255.000000000 SigName 0.00 255.000000000 FORMAT "%13.9" NUMBER 10 /end CHARACTERISTIC
/begin CHARACTERISTIC DSM_EnvDfp_EATSCD_C "Fehlerpfad spezifische Umweltbedingungen fuer Fehlerpfad Dfp_EATSCD" VAL_BLK 0xCA502 Kwb_Wu8 255.000000000 SigName 0.00 255.000000000 FORMAT "%13.9" NUMBER 10 /end CHARACTERISTIC
/begin CHARACTERISTIC DSM_EnvDfp_EBAFCD_C "Fehlerpfad spezifische Umweltbedingungen fuer Fehlerpfad Dfp_EBAFCD" VAL_BLK 0xCA50C Kwb_Wu8 255.000000000 SigName 0.00 255.000000000 FORMAT "%13.9" NUMBER 10 /end CHARACTERISTIC
/begin CHARACTERISTIC DSM_EnvDfp_EBFCD_C "Fehlerpfad spezifische Umweltbedingungen fuer Fehlerpfad Dfp_EBFCD" VAL_BLK 0xCA516 Kwb_Wu8 255.000000000 SigName 0.00 255.000000000 FORMAT "%13.9" NUMBER 10 /end CHARACTERISTIC
/begin CHARACTERISTIC DSM_EnvDfp_EBTSCD_C "Fehlerpfad spezifische Umweltbedingungen fuer Fehlerpfad Dfp_EBTSCD" VAL_BLK 0xCA520 Kwb_Wu8 255.000000000 SigName 0.00 255.000000000 FORMAT "%13.9" NUMBER 10 /end CHARACTERISTIC
/begin CHARACTERISTIC DSM_EnvDfp_EBTSCD_OvrTemp_C "Fehlerpfad spezifische Umweltbedingungen fuer Fehlerpfad Dfp_EBTSCD_OvrTemp" VAL_BLK 0xCA52A Kwb_Wu8 255.000000000 SigName 0.00 255.000000000 FORMAT "%13.9" NUMBER 10 /end CHARACTERISTIC
/begin CHARACTERISTIC DSM_EnvDfp_EEPCDVarMng_C "Fehlerpfad spezifische Umweltbedingungen fuer Fehlerpfad Dfp_EEPCDVarMng" VAL_BLK 0xCA534 Kwb_Wu8 255.000000000 SigName 0.00 255.000000000 FORMAT "%13.9" NUMBER 10 /end CHARACTERISTIC
/begin CHARACTERISTIC DSM_EnvDfp_EGPpCD_C "Fehlerpfad spezifische Umweltbedingungen fuer Fehlerpfad Dfp_EGPpCD" VAL_BLK 0xCA53E Kwb_Wu8 255.000000000 SigName 0.00 255.000000000 FORMAT "%13.9" NUMBER 10 /end CHARACTERISTIC
/begin CHARACTERISTIC DSM_EnvDfp_EGPpCDTPreTrbn_C "Fehlerpfad spezifische Umweltbedingungen fuer Fehlerpfad Dfp_EgPpCDTPreTrbn" VAL_BLK 0xCA548 Kwb_Wu8 255.000000000 SigName 0.00 255.000000000 FORMAT "%13.9" NUMBER 10 /end CHARACTERISTIC
/begin CHARACTERISTIC DSM_EnvDfp_Layer_PMRUHVERL_C "" VAL_BLK 0xCA552 Kwb_Wu8 255.000000000 SigName 0.00 255.000000000 FORMAT "%13.9" NUMBER 10 /end CHARACTERISTIC
/begin CHARACTERISTIC DSM_EnvDfp_EGRCD_Max_C "Fehlerpfad spezifische Umweltbedingungen fuer Fehlerpfad Dfp_EGRCD_Max" VAL_BLK 0xCA55C Kwb_Wu8 255.000000000 SigName 0.00 255.000000000 FORMAT "%13.9" NUMBER 10 /end CHARACTERISTIC
/begin CHARACTERISTIC DSM_EnvDfp_EGRCD_Min_C "Fehlerpfad spezifische Umweltbedingungen fuer Fehlerpfad Dfp_EGRCD_Min" VAL_BLK 0xCA566 Kwb_Wu8 255.000000000 SigName 0.00 255.000000000 FORMAT "%13.9" NUMBER 10 /end CHARACTERISTIC
/begin CHARACTERISTIC DSM_EnvDfp_EGRCD_SigNpl_C "Fehlerpfad spezifische Umweltbedingungen fuer Fehlerpfad Dfp_EGRCD_SigNpl" VAL_BLK 0xCA570 Kwb_Wu8 255.000000000 SigName 0.00 255.000000000 FORMAT "%13.9" NUMBER 10 /end CHARACTERISTIC
/begin CHARACTERISTIC DSM_EnvDfp_EGTRgnOilDil_C "Fehlerpfad spezifische Umweltbedingungen fuer Fehlerpfad Dfp_EGTRgnOilDil" VAL_BLK 0xCA57A Kwb_Wu8 255.000000000 SigName 0.00 255.000000000 FORMAT "%13.9" NUMBER 10 /end CHARACTERISTIC
/begin CHARACTERISTIC DSM_EnvDfp_Layer_TOENS_C "" VAL_BLK 0xCA584 Kwb_Wu8 255.000000000 SigName 0.00 255.000000000 FORMAT "%13.9" NUMBER 10 /end CHARACTERISTIC
/begin CHARACTERISTIC DSM_EnvDfp_Layer_MANHYDR_C "" VAL_BLK 0xCA58E Kwb_Wu8 255.000000000 SigName 0.00 255.000000000 FORMAT "%13.9" NUMBER 10 /end CHARACTERISTIC
/begin CHARACTERISTIC DSM_EnvDfp_Layer_MANLUFT_C "" VAL_BLK 0xCA598 Kwb_Wu8 255.000000000 SigName 0.00 255.000000000 FORMAT "%13.9" NUMBER 10 /end CHARACTERISTIC
/begin CHARACTERISTIC DSM_EnvDfp_ETClbETFltInj1_C "Fehlerpfad spezifische Umweltbedingungen fuer Fehlerpfad Dfp_ETClbETFltInj1" VAL_BLK 0xCA5A2 Kwb_Wu8 255.000000000 SigName 0.00 255.000000000 FORMAT "%13.9" NUMBER 10 /end CHARACTERISTIC
/begin CHARACTERISTIC DSM_EnvDfp_ETClbETFltInj2_C "Fehlerpfad spezifische Umweltbedingungen fuer Fehlerpfad Dfp_ETClbETFltInj2" VAL_BLK 0xCA5AC Kwb_Wu8 255.000000000 SigName 0.00 255.000000000 FORMAT "%13.9" NUMBER 10 /end CHARACTERISTIC
/begin CHARACTERISTIC DSM_EnvDfp_ETClbETFltInj3_C "Fehlerpfad spezifische Umweltbedingungen fuer Fehlerpfad Dfp_ETClbETFltInj3" VAL_BLK 0xCA5B6 Kwb_Wu8 255.000000000 SigName 0.00 255.000000000 FORMAT "%13.9" NUMBER 10 /end CHARACTERISTIC
/begin CHARACTERISTIC DSM_EnvDfp_ETClbETFltInj4_C "Fehlerpfad spezifische Umweltbedingungen fuer Fehlerpfad Dfp_ETClbETFltInj4" VAL_BLK 0xCA5C0 Kwb_Wu8 255.000000000 SigName 0.00 255.000000000 FORMAT "%13.9" NUMBER 10 /end CHARACTERISTIC
/begin CHARACTERISTIC DSM_EnvDfp_ETClbETFltInj5_C "Fehlerpfad spezifische Umweltbedingungen fuer Fehlerpfad Dfp_ETClbETFltInj5" VAL_BLK 0xCA5CA Kwb_Wu8 255.000000000 SigName 0.00 255.000000000 FORMAT "%13.9" NUMBER 10 /end CHARACTERISTIC
/begin CHARACTERISTIC DSM_EnvDfp_ETClbETFltInj6_C "Fehlerpfad spezifische Umweltbedingungen fuer Fehlerpfad Dfp_ETClbETFltInj6" VAL_BLK 0xCA5D4 Kwb_Wu8 255.000000000 SigName 0.00 255.000000000 FORMAT "%13.9" NUMBER 10 /end CHARACTERISTIC
/begin CHARACTERISTIC DSM_EnvDfp_ETClbInj1_C "Fehlerpfad spezifische Umweltbedingungen fuer Fehlerpfad Dfp_ETClbInj1" VAL_BLK 0xCA5DE Kwb_Wu8 255.000000000 SigName 0.00 255.000000000 FORMAT "%13.9" NUMBER 10 /end CHARACTERISTIC
/begin CHARACTERISTIC DSM_EnvDfp_ETClbInj2_C "Fehlerpfad spezifische Umweltbedingungen fuer Fehlerpfad Dfp_ETClbInj2" VAL_BLK 0xCA5E8 Kwb_Wu8 255.000000000 SigName 0.00 255.000000000 FORMAT "%13.9" NUMBER 10 /end CHARACTERISTIC
/begin CHARACTERISTIC DSM_EnvDfp_ETClbInj3_C "Fehlerpfad spezifische Umweltbedingungen fuer Fehlerpfad Dfp_ETClbInj3" VAL_BLK 0xCA5F2 Kwb_Wu8 255.000000000 SigName 0.00 255.000000000 FORMAT "%13.9" NUMBER 10 /end CHARACTERISTIC
/begin CHARACTERISTIC DSM_EnvDfp_ETClbInj4_C "Fehlerpfad spezifische Umweltbedingungen fuer Fehlerpfad Dfp_ETClbInj4" VAL_BLK 0xCA5FC Kwb_Wu8 255.000000000 SigName 0.00 255.000000000 FORMAT "%13.9" NUMBER 10 /end CHARACTERISTIC
/begin CHARACTERISTIC DSM_EnvDfp_ETClbInj5_C "Fehlerpfad spezifische Umweltbedingungen fuer Fehlerpfad Dfp_ETClbInj5" VAL_BLK 0xCA606 Kwb_Wu8 255.000000000 SigName 0.00 255.000000000 FORMAT "%13.9" NUMBER 10 /end CHARACTERISTIC
/begin CHARACTERISTIC DSM_EnvDfp_ETClbInj6_C "Fehlerpfad spezifische Umweltbedingungen fuer Fehlerpfad Dfp_ETClbInj6" VAL_BLK 0xCA610 Kwb_Wu8 255.000000000 SigName 0.00 255.000000000 FORMAT "%13.9" NUMBER 10 /end CHARACTERISTIC
/begin CHARACTERISTIC DSM_EnvDfp_EngMCaS1_C "Fehlerpfad spezifische Umweltbedingungen fuer Fehlerpfad Dfp_EngMCaS1" VAL_BLK 0xCA61A Kwb_Wu8 255.000000000 SigName 0.00 255.000000000 FORMAT "%13.9" NUMBER 10 /end CHARACTERISTIC
/begin CHARACTERISTIC DSM_EnvDfp_EngMCrS1_C "Fehlerpfad spezifische Umweltbedingungen fuer Fehlerpfad Dfp_EngMCrS1" VAL_BLK 0xCA624 Kwb_Wu8 255.000000000 SigName 0.00 255.000000000 FORMAT "%13.9" NUMBER 10 /end CHARACTERISTIC
/begin CHARACTERISTIC DSM_EnvDfp_EngMOfsCaSCrS_C "Fehlerpfad spezifische Umweltbedingungen fuer Fehlerpfad Dfp_EngMOfsCaSCrS" VAL_BLK 0xCA62E Kwb_Wu8 255.000000000 SigName 0.00 255.000000000 FORMAT "%13.9" NUMBER 10 /end CHARACTERISTIC
/begin CHARACTERISTIC DSM_EnvDfp_EngMntCtl1_Dia1_C "" VAL_BLK 0xCA638 Kwb_Wu8 255.000000000 SigName 0.00 255.000000000 FORMAT "%13.9" NUMBER 10 /end CHARACTERISTIC
/begin CHARACTERISTIC DSM_EnvDfp_EngMntCtl1_Dia2_C "" VAL_BLK 0xCA642 Kwb_Wu8 255.000000000 SigName 0.00 255.000000000 FORMAT "%13.9" NUMBER 10 /end CHARACTERISTIC
/begin CHARACTERISTIC DSM_EnvDfp_EngMntCtl1_Dia3_C "" VAL_BLK 0xCA64C Kwb_Wu8 255.000000000 SigName 0.00 255.000000000 FORMAT "%13.9" NUMBER 10 /end CHARACTERISTIC
/begin CHARACTERISTIC DSM_EnvDfp_EngMntCtl1_Max_C "" VAL_BLK 0xCA656 Kwb_Wu8 255.000000000 SigName 0.00 255.000000000 FORMAT "%13.9" NUMBER 10 /end CHARACTERISTIC
/begin CHARACTERISTIC DSM_EnvDfp_EngMntCtl1_Min_C "" VAL_BLK 0xCA660 Kwb_Wu8 255.000000000 SigName 0.00 255.000000000 FORMAT "%13.9" NUMBER 10 /end CHARACTERISTIC
/begin CHARACTERISTIC DSM_EnvDfp_EngMntCtl1_SigNpl_C "" VAL_BLK 0xCA66A Kwb_Wu8 255.000000000 SigName 0.00 255.000000000 FORMAT "%13.9" NUMBER 10 /end CHARACTERISTIC
/begin CHARACTERISTIC DSM_EnvDfp_EngMntCtlCD_C "Fehlerpfad spezifische Umweltbedingungen fuer Fehlerpfad Dfp_EngMntCtlCD" VAL_BLK 0xCA674 Kwb_Wu8 255.000000000 SigName 0.00 255.000000000 FORMAT "%13.9" NUMBER 10 /end CHARACTERISTIC
/begin CHARACTERISTIC DSM_EnvDfp_EngMntCtl_Dia1_C "" VAL_BLK 0xCA67E Kwb_Wu8 255.000000000 SigName 0.00 255.000000000 FORMAT "%13.9" NUMBER 10 /end CHARACTERISTIC
/begin CHARACTERISTIC DSM_EnvDfp_EngMntCtl_Dia2_C "" VAL_BLK 0xCA688 Kwb_Wu8 255.000000000 SigName 0.00 255.000000000 FORMAT "%13.9" NUMBER 10 /end CHARACTERISTIC
/begin CHARACTERISTIC DSM_EnvDfp_EngMntCtl_Dia3_C "" VAL_BLK 0xCA692 Kwb_Wu8 255.000000000 SigName 0.00 255.000000000 FORMAT "%13.9" NUMBER 10 /end CHARACTERISTIC
/begin CHARACTERISTIC DSM_EnvDfp_EngMntCtl_Max_C "" VAL_BLK 0xCA69C Kwb_Wu8 255.000000000 SigName 0.00 255.000000000 FORMAT "%13.9" NUMBER 10 /end CHARACTERISTIC
/begin CHARACTERISTIC DSM_EnvDfp_EngMntCtl_Min_C "" VAL_BLK 0xCA6A6 Kwb_Wu8 255.000000000 SigName 0.00 255.000000000 FORMAT "%13.9" NUMBER 10 /end CHARACTERISTIC
/begin CHARACTERISTIC DSM_EnvDfp_EngMntCtl_SigNpl_C "" VAL_BLK 0xCA6B0 Kwb_Wu8 255.000000000 SigName 0.00 255.000000000 FORMAT "%13.9" NUMBER 10 /end CHARACTERISTIC
/begin CHARACTERISTIC DSM_EnvDfp_EngPrtFWODet_C "Fehlerpfad spezifische Umweltbedingungen fuer Fehlerpfad Dfp_EngPrtFWODet" VAL_BLK 0xCA6BA Kwb_Wu8 255.000000000 SigName 0.00 255.000000000 FORMAT "%13.9" NUMBER 10 /end CHARACTERISTIC
/begin CHARACTERISTIC DSM_EnvDfp_FBCqDvt_C "Fehlerpfad spezifische Umweltbedingungen fuer Fehlerpfad Dfp_FBCqDvt" VAL_BLK 0xCA6C4 Kwb_Wu8 255.000000000 SigName 0.00 255.000000000 FORMAT "%13.9" NUMBER 10 /end CHARACTERISTIC
/begin CHARACTERISTIC DSM_EnvDfp_FMTC_NonMonotonMap_C "Fehlerpfad spezifische Umweltbedingungen fuer Fehlerpfad Dfp_FMTC_NonMonotonMap" VAL_BLK 0xCA6CE Kwb_Wu8 255.000000000 SigName 0.00 255.000000000 FORMAT "%13.9" NUMBER 10 /end CHARACTERISTIC
/begin CHARACTERISTIC DSM_EnvDfp_FTSCD_C "Fehlerpfad spezifische Umweltbedingungen fuer Fehlerpfad Dfp_FTSCD" VAL_BLK 0xCA6D8 Kwb_Wu8 255.000000000 SigName 0.00 255.000000000 FORMAT "%13.9" NUMBER 10 /end CHARACTERISTIC
/begin CHARACTERISTIC DSM_EnvDfp_FanCD_C "Fehlerpfad spezifische Umweltbedingungen fuer Fehlerpfad Dfp_FanCD" VAL_BLK 0xCA6E2 Kwb_Wu8 255.000000000 SigName 0.00 255.000000000 FORMAT "%13.9" NUMBER 10 /end CHARACTERISTIC
/begin CHARACTERISTIC DSM_EnvDfp_FanCD_FanCtlr1_C "Fehlerpfad spezifische Umweltbedingungen fuer Fehlerpfad Dfp_FanCD_FanCtlr1" VAL_BLK 0xCA6EC Kwb_Wu8 255.000000000 SigName 0.00 255.000000000 FORMAT "%13.9" NUMBER 10 /end CHARACTERISTIC
/begin CHARACTERISTIC DSM_EnvDfp_FanCD_FanCtlr2_C "Fehlerpfad spezifische Umweltbedingungen fuer Fehlerpfad Dfp_FanCD_FanCtlr2" VAL_BLK 0xCA6F6 Kwb_Wu8 255.000000000 SigName 0.00 255.000000000 FORMAT "%13.9" NUMBER 10 /end CHARACTERISTIC
/begin CHARACTERISTIC DSM_EnvDfp_FanCD_FanCtlr3_C "Fehlerpfad spezifische Umweltbedingungen fuer Fehlerpfad Dfp_FanCD_FanCtlr3" VAL_BLK 0xCA700 Kwb_Wu8 255.000000000 SigName 0.00 255.000000000 FORMAT "%13.9" NUMBER 10 /end CHARACTERISTIC
/begin CHARACTERISTIC DSM_EnvDfp_FlFCD_C "Fehlerpfad spezifische Umweltbedingungen fuer Fehlerpfad Dfp_FlFCD" VAL_BLK 0xCA70A Kwb_Wu8 255.000000000 SigName 0.00 255.000000000 FORMAT "%13.9" NUMBER 10 /end CHARACTERISTIC
/begin CHARACTERISTIC DSM_EnvDfp_FlMngSmkDefect_C "Fehlerpfad spezifische Umweltbedingungen fuer Fehlerpfad Dfp_FlMngSmkDefect" VAL_BLK 0xCA714 Kwb_Wu8 255.000000000 SigName 0.00 255.000000000 FORMAT "%13.9" NUMBER 10 /end CHARACTERISTIC
/begin CHARACTERISTIC DSM_EnvDfp_FrmMngBOS_RESET_C "Fehlerpfad spezifische Umweltbedingungen fuer Fehlerpfad Dfp_FrmMngBOS_RESET" VAL_BLK 0xCA71E Kwb_Wu8 255.000000000 SigName 0.00 255.000000000 FORMAT "%13.9" NUMBER 10 /end CHARACTERISTIC
/begin CHARACTERISTIC DSM_EnvDfp_FrmMngBOS_RESET_2_C "" VAL_BLK 0xCA728 Kwb_Wu8 255.000000000 SigName 0.00 255.000000000 FORMAT "%13.9" NUMBER 10 /end CHARACTERISTIC
/begin CHARACTERISTIC DSM_EnvDfp_FrmMngDMANFAFS_C "Fehlerpfad spezifische Umweltbedingungen fuer Fehlerpfad Dfp_FrmMngDMANFAFS" VAL_BLK 0xCA732 Kwb_Wu8 255.000000000 SigName 0.00 255.000000000 FORMAT "%13.9" NUMBER 10 /end CHARACTERISTIC
/begin CHARACTERISTIC DSM_EnvDfp_FrmMngDRMANFSSG_C "Fehlerpfad spezifische Umweltbedingungen fuer Fehlerpfad Dfp_FrmMngDRMANFSSG" VAL_BLK 0xCA73C Kwb_Wu8 255.000000000 SigName 0.00 255.000000000 FORMAT "%13.9" NUMBER 10 /end CHARACTERISTIC
/begin CHARACTERISTIC DSM_EnvDfp_FrmMngGEARBX_DATA_C "environment conditions (customerspecific) for path" VAL_BLK 0xCA746 Kwb_Wu8 255.000000000 SigName 0.00 255.000000000 FORMAT "%13.9" NUMBER 10 /end CHARACTERISTIC
/begin CHARACTERISTIC DSM_EnvDfp_FrmMngGEARBX_DATA2_C "Fehlerpfad spezifische Umweltbedingungen fuer Fehlerpfad Dfp_FrmMngGEARBX_DATA2" VAL_BLK 0xCA750 Kwb_Wu8 255.000000000 SigName 0.00 255.000000000 FORMAT "%13.9" NUMBER 10 /end CHARACTERISTIC
/begin CHARACTERISTIC DSM_EnvDfp_FrmMngHEAT_AC_C "environment conditions (customerspecific) for path" VAL_BLK 0xCA75A Kwb_Wu8 255.000000000 SigName 0.00 255.000000000 FORMAT "%13.9" NUMBER 10 /end CHARACTERISTIC
/begin CHARACTERISTIC DSM_EnvDfp_FrmMngLENKRADWINKEL_C "Fehlerpfad spezifische Umweltbedingungen fuer Fehlerpfad Dfp_FrmMngLENKRADWINKEL" VAL_BLK 0xCA764 Kwb_Wu8 255.000000000 SigName 0.00 255.000000000 FORMAT "%13.9" NUMBER 10 /end CHARACTERISTIC
/begin CHARACTERISTIC DSM_EnvDfp_FrmMngMILEAGE_RANGE_C "Fehlerpfad spezifische Umweltbedingungen fuer Fehlerpfad Dfp_FrmMngMILEAGE_RANGE" VAL_BLK 0xCA76E Kwb_Wu8 255.000000000 SigName 0.00 255.000000000 FORMAT "%13.9" NUMBER 10 /end CHARACTERISTIC
/begin CHARACTERISTIC DSM_EnvDfp_FrmMngOPCRCTLACC_C "Fehlerpfad spezifische Umweltbedingungen fuer Fehlerpfad Dfp_FrmMngOPCRCTLACC" VAL_BLK 0xCA778 Kwb_Wu8 255.000000000 SigName 0.00 255.000000000 FORMAT "%13.9" NUMBER 10 /end CHARACTERISTIC
/begin CHARACTERISTIC DSM_EnvDfp_FrmMngPRGG_CCTR_C "Fehlerpfad spezifische Umweltbedingungen fuer Fehlerpfad Dfp_FrmMngPRGG_CCTR" VAL_BLK 0xCA782 Kwb_Wu8 255.000000000 SigName 0.00 255.000000000 FORMAT "%13.9" NUMBER 10 /end CHARACTERISTIC
/begin CHARACTERISTIC DSM_EnvDfp_FrmMngPWRMNG_LOADV_C "Fehlerpfad spezifische Umweltbedingungen fuer Fehlerpfad Dfp_FrmMngPWRMNG_LOADV" VAL_BLK 0xCA78C Kwb_Wu8 255.000000000 SigName 0.00 255.000000000 FORMAT "%13.9" NUMBER 10 /end CHARACTERISTIC
/begin CHARACTERISTIC DSM_EnvDfp_FrmMngParkConsumer_C "Fehlerpfad spezifische Umweltbedinungen fuer Fehlerpfad Dfp_FrmMngParkConsumer" VAL_BLK 0xCA796 Kwb_Wu8 255.000000000 SigName 0.00 255.000000000 FORMAT "%13.9" NUMBER 10 /end CHARACTERISTIC
/begin CHARACTERISTIC DSM_EnvDfp_FrmMngRQSTGEFAN_C "RQ_STG_EFAN - CAN-message related errors" VAL_BLK 0xCA7A0 Kwb_Wu8 255.000000000 SigName 0.00 255.000000000 FORMAT "%13.9" NUMBER 10 /end CHARACTERISTIC
/begin CHARACTERISTIC DSM_EnvDfp_FrmMngSSGErr_C "Fehlerpfad spezifische Umweltbedingungen fuer Fehlerpfad Dfp_FrmMngSSGErr" VAL_BLK 0xCA7AA Kwb_Wu8 255.000000000 SigName 0.00 255.000000000 FORMAT "%13.9" NUMBER 10 /end CHARACTERISTIC
/begin CHARACTERISTIC DSM_EnvDfp_FrmMngSSGShOff_C "Fehlerpfad spezifische Umweltbedingungen fuer Fehlerpfad Dfp_FrmMngSSGShOff" VAL_BLK 0xCA7B4 Kwb_Wu8 255.000000000 SigName 0.00 255.000000000 FORMAT "%13.9" NUMBER 10 /end CHARACTERISTIC
/begin CHARACTERISTIC DSM_EnvDfp_FrmMngSTAT_ANH_C "Fehlerpfad spezifische Umweltbedingungen fuer Fehlerpfad Dfp_FrmMngSTAT_ANH" VAL_BLK 0xCA7BE Kwb_Wu8 255.000000000 SigName 0.00 255.000000000 FORMAT "%13.9" NUMBER 10 /end CHARACTERISTIC
/begin CHARACTERISTIC DSM_EnvDfp_FrmMngSTAT_ARS_C "environment conditions (customerspecific) for path" VAL_BLK 0xCA7C8 Kwb_Wu8 255.000000000 SigName 0.00 255.000000000 FORMAT "%13.9" NUMBER 10 /end CHARACTERISTIC
/begin CHARACTERISTIC DSM_EnvDfp_FrmMngSTAT_DSC_C "environment conditions (customerspecific) for path" VAL_BLK 0xCA7D2 Kwb_Wu8 255.000000000 SigName 0.00 255.000000000 FORMAT "%13.9" NUMBER 10 /end CHARACTERISTIC
/begin CHARACTERISTIC DSM_EnvDfp_FrmMngSTAT_EKP_C "Fehlerpfad spezifische Umweltbedingungen fuer Fehlerpfad Dfp_FrmMngSTAT_EKP" VAL_BLK 0xCA7DC Kwb_Wu8 255.000000000 SigName 0.00 255.000000000 FORMAT "%13.9" NUMBER 10 /end CHARACTERISTIC
/begin CHARACTERISTIC DSM_EnvDfp_FrmMngSTAT_KOMBI_C "Fehlerpfad spezifische Umweltbedingungen fuer Fehlerpfad Dfp_FrmMngSTAT_KOMBI" VAL_BLK 0xCA7E6 Kwb_Wu8 255.000000000 SigName 0.00 255.000000000 FORMAT "%13.9" NUMBER 10 /end CHARACTERISTIC
/begin CHARACTERISTIC DSM_EnvDfp_FrmMngSTAT_SITZ_C "Fehlerpfad spezifische Umweltbedingungen fuer Fehlerpfad  Dfp_FrmMngSTAT_SITZ" VAL_BLK 0xCA7F0 Kwb_Wu8 255.000000000 SigName 0.00 255.000000000 FORMAT "%13.9" NUMBER 10 /end CHARACTERISTIC
/begin CHARACTERISTIC DSM_EnvDfp_FrmMngStOBDGbxMilOf_C "Fehlerpfad spezifische Umweltbedingungen fuer Fehlerpfad Dfp_FrmMngStOBDGbxMilOf" VAL_BLK 0xCA7FA Kwb_Wu8 255.000000000 SigName 0.00 255.000000000 FORMAT "%13.9" NUMBER 10 /end CHARACTERISTIC
/begin CHARACTERISTIC DSM_EnvDfp_FrmMngStOBDGbxMilOn_C "Fehlerpfad spezifische Umweltbedingungen fuer Fehlerpfad Dfp_FrmMngStOBDGbxMilOn" VAL_BLK 0xCA804 Kwb_Wu8 255.000000000 SigName 0.00 255.000000000 FORMAT "%13.9" NUMBER 10 /end CHARACTERISTIC
/begin CHARACTERISTIC DSM_EnvDfp_FrmMngTEMPRELTIME_C "Fehlerpfad spezifische Umweltbedingungen fuer Fehlerpfad Dfp_FrmMngTEMPRELTIME" VAL_BLK 0xCA80E Kwb_Wu8 255.000000000 SigName 0.00 255.000000000 FORMAT "%13.9" NUMBER 10 /end CHARACTERISTIC
/begin CHARACTERISTIC DSM_EnvDfp_FrmMngTERMINAL_C "environment conditions (customerspecific) for path" VAL_BLK 0xCA818 Kwb_Wu8 255.000000000 SigName 0.00 255.000000000 FORMAT "%13.9" NUMBER 10 /end CHARACTERISTIC
/begin CHARACTERISTIC DSM_EnvDfp_FrmMngTIME_DATE_C "Fehlerpfad spezifische Umweltbedingungen fuer Fehlerpfad Dfp_FrmMngTIME_DATE" VAL_BLK 0xCA822 Kwb_Wu8 255.000000000 SigName 0.00 255.000000000 FORMAT "%13.9" NUMBER 10 /end CHARACTERISTIC
/begin CHARACTERISTIC DSM_EnvDfp_FrmMngTORQUE_DSC_C "environment conditions (customerspecific) for path" VAL_BLK 0xCA82C Kwb_Wu8 255.000000000 SigName 0.00 255.000000000 FORMAT "%13.9" NUMBER 10 /end CHARACTERISTIC
/begin CHARACTERISTIC DSM_EnvDfp_FrmMngTORQUE_GEARBX_C "environment conditions (customerspecific) for path" VAL_BLK 0xCA836 Kwb_Wu8 255.000000000 SigName 0.00 255.000000000 FORMAT "%13.9" NUMBER 10 /end CHARACTERISTIC
/begin CHARACTERISTIC DSM_EnvDfp_FrmMngTrq_ReqACC_C "Fehlerpfad spezifische Umweltbedingungen fuer Fehlerpfad Dfp_FrmMngTrq_ReqACC" VAL_BLK 0xCA840 Kwb_Wu8 255.000000000 SigName 0.00 255.000000000 FORMAT "%13.9" NUMBER 10 /end CHARACTERISTIC
/begin CHARACTERISTIC DSM_EnvDfp_FrmMngVEH_MOD_C "VEH_MOD - CAN-message related errors" VAL_BLK 0xCA84A Kwb_Wu8 255.000000000 SigName 0.00 255.000000000 FORMAT "%13.9" NUMBER 10 /end CHARACTERISTIC
/begin CHARACTERISTIC DSM_EnvDfp_FrmMngVELOCITY_C "environment conditions (customerspecific) for path" VAL_BLK 0xCA854 Kwb_Wu8 255.000000000 SigName 0.00 255.000000000 FORMAT "%13.9" NUMBER 10 /end CHARACTERISTIC
/begin CHARACTERISTIC DSM_EnvDfp_FrmMngWHEEL_SPEED_C "Fehlerpfad spezifische Umweltbedingungen fuer Fehlerpfad Dfp_FrmMngWHEEL_SPEED" VAL_BLK 0xCA85E Kwb_Wu8 255.000000000 SigName 0.00 255.000000000 FORMAT "%13.9" NUMBER 10 /end CHARACTERISTIC
/begin CHARACTERISTIC DSM_EnvDfp_FrmMngstCurr_C "Umweltbedingung für Dfp_FrmMngstCurr" VAL_BLK 0xCA868 Kwb_Wu8 255.000000000 SigName 0.00 255.000000000 FORMAT "%13.9" NUMBER 10 /end CHARACTERISTIC
/begin CHARACTERISTIC DSM_EnvDfp_FrmMngswtPSPOff_C "Umweltbedingung für Dfp_FrmMngswtPSPOff" VAL_BLK 0xCA872 Kwb_Wu8 255.000000000 SigName 0.00 255.000000000 FORMAT "%13.9" NUMBER 10 /end CHARACTERISTIC
/begin CHARACTERISTIC DSM_EnvDfp_GearbxIncMax_C "Fehlerpfad spezifische Umweltbedingungen fuer Fehlerpfad Dfp_GearbxIncMax" VAL_BLK 0xCA87C Kwb_Wu8 255.000000000 SigName 0.00 255.000000000 FORMAT "%13.9" NUMBER 10 /end CHARACTERISTIC
/begin CHARACTERISTIC DSM_EnvDfp_GlwCD_C "Fehlerpfad spezifische Umweltbedingungen fuer Fehlerpfad Dfp_GlwCD" VAL_BLK 0xCA886 Kwb_Wu8 255.000000000 SigName 0.00 255.000000000 FORMAT "%13.9" NUMBER 10 /end CHARACTERISTIC
/begin CHARACTERISTIC DSM_EnvDfp_GlwCDGlwCirc1_C "Fehlerpfad spezifische Umweltbedingungen fuer Fehlerpfad Dfp_GlwCDGlwCirc1" VAL_BLK 0xCA890 Kwb_Wu8 255.000000000 SigName 0.00 255.000000000 FORMAT "%13.9" NUMBER 10 /end CHARACTERISTIC
/begin CHARACTERISTIC DSM_EnvDfp_GlwCDGlwCirc2_C "Fehlerpfad spezifische Umweltbedingungen fuer Fehlerpfad Dfp_GlwCDGlwCirc2" VAL_BLK 0xCA89A Kwb_Wu8 255.000000000 SigName 0.00 255.000000000 FORMAT "%13.9" NUMBER 10 /end CHARACTERISTIC
/begin CHARACTERISTIC DSM_EnvDfp_GlwCDGlwCirc3_C "Fehlerpfad spezifische Umweltbedingungen fuer Fehlerpfad Dfp_GlwCDGlwCirc3" VAL_BLK 0xCA8A4 Kwb_Wu8 255.000000000 SigName 0.00 255.000000000 FORMAT "%13.9" NUMBER 10 /end CHARACTERISTIC
/begin CHARACTERISTIC DSM_EnvDfp_GlwCDGlwCirc4_C "Fehlerpfad spezifische Umweltbedingungen fuer Fehlerpfad Dfp_GlwCDGlwCirc4" VAL_BLK 0xCA8AE Kwb_Wu8 255.000000000 SigName 0.00 255.000000000 FORMAT "%13.9" NUMBER 10 /end CHARACTERISTIC
/begin CHARACTERISTIC DSM_EnvDfp_GlwCDGlwCirc5_C "Fehlerpfad spezifische Umweltbedingungen fuer Fehlerpfad Dfp_GlwCDGlwCirc5" VAL_BLK 0xCA8B8 Kwb_Wu8 255.000000000 SigName 0.00 255.000000000 FORMAT "%13.9" NUMBER 10 /end CHARACTERISTIC
/begin CHARACTERISTIC DSM_EnvDfp_GlwCDGlwCirc6_C "Fehlerpfad spezifische Umweltbedingungen fuer Fehlerpfad Dfp_GlwCDGlwCirc6" VAL_BLK 0xCA8C2 Kwb_Wu8 255.000000000 SigName 0.00 255.000000000 FORMAT "%13.9" NUMBER 10 /end CHARACTERISTIC
/begin CHARACTERISTIC DSM_EnvDfp_GlwCDGlwCirc7_C "Fehlerpfad spezifische Umweltbedingungen fuer Fehlerpfad Dfp_GlwCDGlwCirc7" VAL_BLK 0xCA8CC Kwb_Wu8 255.000000000 SigName 0.00 255.000000000 FORMAT "%13.9" NUMBER 10 /end CHARACTERISTIC
/begin CHARACTERISTIC DSM_EnvDfp_GlwCDGlwCirc8_C "Fehlerpfad spezifische Umweltbedingungen fuer Fehlerpfad Dfp_GlwCDGlwCirc8" VAL_BLK 0xCA8D6 Kwb_Wu8 255.000000000 SigName 0.00 255.000000000 FORMAT "%13.9" NUMBER 10 /end CHARACTERISTIC
/begin CHARACTERISTIC DSM_EnvDfp_GlwCtl_C "Fehlerpfad spezifische Umweltbedingungen fuer Fehlerpfad Dfp_GlwCtl" VAL_BLK 0xCA8E0 Kwb_Wu8 255.000000000 SigName 0.00 255.000000000 FORMAT "%13.9" NUMBER 10 /end CHARACTERISTIC
/begin CHARACTERISTIC DSM_EnvDfp_HWEMonCom_C "Fehlerpfad spezifische Umweltbedingungen fuer Fehlerpfad Dfp_HWEMonCom" VAL_BLK 0xCA8EA Kwb_Wu8 255.000000000 SigName 0.00 255.000000000 FORMAT "%13.9" NUMBER 10 /end CHARACTERISTIC
/begin CHARACTERISTIC DSM_EnvDfp_HWEMonEEPROM_C "Fehlerpfad spezifische Umweltbedingungen fuer Fehlerpfad Dfp_HWEMonEEPROM" VAL_BLK 0xCA8F4 Kwb_Wu8 255.000000000 SigName 0.00 255.000000000 FORMAT "%13.9" NUMBER 10 /end CHARACTERISTIC
/begin CHARACTERISTIC DSM_EnvDfp_HWEMonRcyLocked_C "Fehlerpfad spezifische Umweltbedingungen fuer Fehlerpfad Dfp_HWEMonRcyLocked" VAL_BLK 0xCA8FE Kwb_Wu8 255.000000000 SigName 0.00 255.000000000 FORMAT "%13.9" NUMBER 10 /end CHARACTERISTIC
/begin CHARACTERISTIC DSM_EnvDfp_HWEMonRcySuppressed_C "Fehlerpfad spezifische Umweltbedingungen fuer Fehlerpfad Dfp_HWEMonRcySuppressed" VAL_BLK 0xCA908 Kwb_Wu8 255.000000000 SigName 0.00 255.000000000 FORMAT "%13.9" NUMBER 10 /end CHARACTERISTIC
/begin CHARACTERISTIC DSM_EnvDfp_HWEMonRcyVisible_C "Fehlerpfad spezifische Umweltbedingungen fuer Fehlerpfad Dfp_HWEMonRcyVisible" VAL_BLK 0xCA912 Kwb_Wu8 255.000000000 SigName 0.00 255.000000000 FORMAT "%13.9" NUMBER 10 /end CHARACTERISTIC
/begin CHARACTERISTIC DSM_EnvDfp_HWEMonUMaxSupply_C "Fehlerpfad spezifische Umweltbedingungen fuer Fehlerpfad Dfp_HWEMonUMaxSupply" VAL_BLK 0xCA91C Kwb_Wu8 255.000000000 SigName 0.00 255.000000000 FORMAT "%13.9" NUMBER 10 /end CHARACTERISTIC
/begin CHARACTERISTIC DSM_EnvDfp_HWEMonUMinSupply_C "Fehlerpfad spezifische Umweltbedingungen fuer Fehlerpfad Dfp_HWEMonUMinSupply" VAL_BLK 0xCA926 Kwb_Wu8 255.000000000 SigName 0.00 255.000000000 FORMAT "%13.9" NUMBER 10 /end CHARACTERISTIC
/begin CHARACTERISTIC DSM_EnvDfp_IATSCD_C "Fehlerpfad spezifische Umweltbedingungen fuer Fehlerpfad Dfp_IATSCD" VAL_BLK 0xCA930 Kwb_Wu8 255.000000000 SigName 0.00 255.000000000 FORMAT "%13.9" NUMBER 10 /end CHARACTERISTIC
/begin CHARACTERISTIC DSM_EnvDfp_IATSCD_CATS_C "Fehlerpfad spezifische Umweltbedingungen fuer Fehlerpfad Dfp_IATSCD_CATS" VAL_BLK 0xCA93A Kwb_Wu8 255.000000000 SigName 0.00 255.000000000 FORMAT "%13.9" NUMBER 10 /end CHARACTERISTIC
/begin CHARACTERISTIC DSM_EnvDfp_ImmCtlImmCD_C "Fehlerpfad spezifische Umweltbedingungen fuer Fehlerpfad Dfp_ImmCtlImmCD" VAL_BLK 0xCA944 Kwb_Wu8 255.000000000 SigName 0.00 255.000000000 FORMAT "%13.9" NUMBER 10 /end CHARACTERISTIC
/begin CHARACTERISTIC DSM_EnvDfp_ImmCtlImmEep_C "Fehlerpfad spezifische Umweltbedingungen fuer Fehlerpfad Dfp_ImmCtlImmEep" VAL_BLK 0xCA94E Kwb_Wu8 255.000000000 SigName 0.00 255.000000000 FORMAT "%13.9" NUMBER 10 /end CHARACTERISTIC
/begin CHARACTERISTIC DSM_EnvDfp_ImmCtlMpl_C "Fehlerpfad spezifische Umweltbedingungen fuer Fehlerpfad Dfp_ImmCtlMpl" VAL_BLK 0xCA958 Kwb_Wu8 255.000000000 SigName 0.00 255.000000000 FORMAT "%13.9" NUMBER 10 /end CHARACTERISTIC
/begin CHARACTERISTIC DSM_EnvDfp_IndSys1_C "Fehlerpfad spezifische Umweltbedingungen fuer Fehlerpfad Dfp_IndSys1" VAL_BLK 0xCA962 Kwb_Wu8 255.000000000 SigName 0.00 255.000000000 FORMAT "%13.9" NUMBER 10 /end CHARACTERISTIC
/begin CHARACTERISTIC DSM_EnvDfp_IndSys2_C "Fehlerpfad spezifische Umweltbedingungen fuer Fehlerpfad Dfp_IndSys2" VAL_BLK 0xCA96C Kwb_Wu8 255.000000000 SigName 0.00 255.000000000 FORMAT "%13.9" NUMBER 10 /end CHARACTERISTIC
/begin CHARACTERISTIC DSM_EnvDfp_InjCrv_InjLim_C "Fehlerpfad spezifische Umweltbedingungen fuer Fehlerpfad Dfp_InjCrv_InjLim" VAL_BLK 0xCA976 Kwb_Wu8 255.000000000 SigName 0.00 255.000000000 FORMAT "%13.9" NUMBER 10 /end CHARACTERISTIC
/begin CHARACTERISTIC DSM_EnvDfp_InjCtlAdjQnt_C "Fehlerpfad spezifische Umweltbedingungen fuer Fehlerpfad Dfp_InjCtlAdjQnt" VAL_BLK 0xCA980 Kwb_Wu8 255.000000000 SigName 0.00 255.000000000 FORMAT "%13.9" NUMBER 10 /end CHARACTERISTIC
/begin CHARACTERISTIC DSM_EnvDfp_InjCtlDrift_C "Fehlerpfad spezifische Umweltbedingungen fuer Fehlerpfad Dfp_InjCtlDrift" VAL_BLK 0xCA98A Kwb_Wu8 255.000000000 SigName 0.00 255.000000000 FORMAT "%13.9" NUMBER 10 /end CHARACTERISTIC
/begin CHARACTERISTIC DSM_EnvDfp_InjVCDActrChrg_C "Fehlerpfad spezifische Umweltbedingungen fuer Fehlerpfad Dfp_InjVCDActrChrg" VAL_BLK 0xCA994 Kwb_Wu8 255.000000000 SigName 0.00 255.000000000 FORMAT "%13.9" NUMBER 10 /end CHARACTERISTIC
/begin CHARACTERISTIC DSM_EnvDfp_InjVCDActrEnrg1_C "Fehlerpfad spezifische Umweltbedingungen fuer Fehlerpfad Dfp_InjVCDActrEnrg1" VAL_BLK 0xCA99E Kwb_Wu8 255.000000000 SigName 0.00 255.000000000 FORMAT "%13.9" NUMBER 10 /end CHARACTERISTIC
/begin CHARACTERISTIC DSM_EnvDfp_InjVCDActrEnrg2_C "Fehlerpfad spezifische Umweltbedingungen fuer Fehlerpfad Dfp_InjVCDActrEnrg2" VAL_BLK 0xCA9A8 Kwb_Wu8 255.000000000 SigName 0.00 255.000000000 FORMAT "%13.9" NUMBER 10 /end CHARACTERISTIC
/begin CHARACTERISTIC DSM_EnvDfp_InjVCDActrEnrg3_C "Fehlerpfad spezifische Umweltbedingungen fuer Fehlerpfad Dfp_InjVCDActrEnrg3" VAL_BLK 0xCA9B2 Kwb_Wu8 255.000000000 SigName 0.00 255.000000000 FORMAT "%13.9" NUMBER 10 /end CHARACTERISTIC
/begin CHARACTERISTIC DSM_EnvDfp_InjVCDActrEnrg4_C "Fehlerpfad spezifische Umweltbedingungen fuer Fehlerpfad Dfp_InjVCDActrEnrg4" VAL_BLK 0xCA9BC Kwb_Wu8 255.000000000 SigName 0.00 255.000000000 FORMAT "%13.9" NUMBER 10 /end CHARACTERISTIC
/begin CHARACTERISTIC DSM_EnvDfp_InjVCDActrEnrg5_C "Fehlerpfad spezifische Umweltbedingungen fuer Fehlerpfad Dfp_InjVCDActrEnrg5" VAL_BLK 0xCA9C6 Kwb_Wu8 255.000000000 SigName 0.00 255.000000000 FORMAT "%13.9" NUMBER 10 /end CHARACTERISTIC
/begin CHARACTERISTIC DSM_EnvDfp_InjVCDActrEnrg6_C "Fehlerpfad spezifische Umweltbedingungen fuer Fehlerpfad Dfp_InjVCDActrEnrg6" VAL_BLK 0xCA9D0 Kwb_Wu8 255.000000000 SigName 0.00 255.000000000 FORMAT "%13.9" NUMBER 10 /end CHARACTERISTIC
/begin CHARACTERISTIC DSM_EnvDfp_InjVCDActrEnrg7_C "Fehlerpfad spezifische Umweltbedingungen fuer Fehlerpfad Dfp_InjVCDActrEnrg7" VAL_BLK 0xCA9DA Kwb_Wu8 255.000000000 SigName 0.00 255.000000000 FORMAT "%13.9" NUMBER 10 /end CHARACTERISTIC
/begin CHARACTERISTIC DSM_EnvDfp_InjVCDActrEnrg8_C "Fehlerpfad spezifische Umweltbedingungen fuer Fehlerpfad Dfp_InjVCDActrEnrg8" VAL_BLK 0xCA9E4 Kwb_Wu8 255.000000000 SigName 0.00 255.000000000 FORMAT "%13.9" NUMBER 10 /end CHARACTERISTIC
/begin CHARACTERISTIC DSM_EnvDfp_InjVCDActrVolt_C "Fehlerpfad spezifische Umweltbedingungen fuer Fehlerpfad Dfp_InjVCDActrVolt" VAL_BLK 0xCA9EE Kwb_Wu8 255.000000000 SigName 0.00 255.000000000 FORMAT "%13.9" NUMBER 10 /end CHARACTERISTIC
/begin CHARACTERISTIC DSM_EnvDfp_InjVCDClsBank1_C "Fehlerpfad spezifische Umweltbedingungen fuer Fehlerpfad Dfp_InjVCDClsBank1" VAL_BLK 0xCA9F8 Kwb_Wu8 255.000000000 SigName 0.00 255.000000000 FORMAT "%13.9" NUMBER 10 /end CHARACTERISTIC
/begin CHARACTERISTIC DSM_EnvDfp_InjVCDClsBank2_C "Fehlerpfad spezifische Umweltbedingungen fuer Fehlerpfad Dfp_InjVCDClsBank2" VAL_BLK 0xCAA02 Kwb_Wu8 255.000000000 SigName 0.00 255.000000000 FORMAT "%13.9" NUMBER 10 /end CHARACTERISTIC
/begin CHARACTERISTIC DSM_EnvDfp_InjVCDMonCab_C "Fehlerpfad spezifische Umweltbedingungen fuer Fehlerpfad Dfp_InjVCDMonCab" VAL_BLK 0xCAA0C Kwb_Wu8 255.000000000 SigName 0.00 255.000000000 FORMAT "%13.9" NUMBER 10 /end CHARACTERISTIC
/begin CHARACTERISTIC DSM_EnvDfp_InjVCDMonSwt_C "Fehlerpfad spezifische Umweltbedingungen fuer Fehlerpfad Dfp_InjVCDMonSwt" VAL_BLK 0xCAA16 Kwb_Wu8 255.000000000 SigName 0.00 255.000000000 FORMAT "%13.9" NUMBER 10 /end CHARACTERISTIC
/begin CHARACTERISTIC DSM_EnvDfp_InjVCDShOffDCDC_C "Fehlerpfad spezifische Umweltbedingungen fuer Fehlerpfad Dfp_InjVCDShOffDCDC" VAL_BLK 0xCAA20 Kwb_Wu8 255.000000000 SigName 0.00 255.000000000 FORMAT "%13.9" NUMBER 10 /end CHARACTERISTIC
/begin CHARACTERISTIC DSM_EnvDfp_InjVCDUBuf_C "Fehlerpfad spezifische Umweltbedingungen fuer Fehlerpfad Dfp_InjVCDUBuf" VAL_BLK 0xCAA2A Kwb_Wu8 255.000000000 SigName 0.00 255.000000000 FORMAT "%13.9" NUMBER 10 /end CHARACTERISTIC
/begin CHARACTERISTIC DSM_EnvDfp_InjVCD_CY370Ampl_C "Fehlerpfad spezifische Umweltbedingungen fuer Fehlerpfad Dfp_InjVCD_CY370Ampl" VAL_BLK 0xCAA34 Kwb_Wu8 255.000000000 SigName 0.00 255.000000000 FORMAT "%13.9" NUMBER 10 /end CHARACTERISTIC
/begin CHARACTERISTIC DSM_EnvDfp_InjVlvBnk1A_C "Fehlerpfad spezifische Umweltbedingungen fuer Fehlerpfad Dfp_InjVlvBnk1A" VAL_BLK 0xCAA3E Kwb_Wu8 255.000000000 SigName 0.00 255.000000000 FORMAT "%13.9" NUMBER 10 /end CHARACTERISTIC
/begin CHARACTERISTIC DSM_EnvDfp_InjVlvBnk1B_C "Fehlerpfad spezifische Umweltbedingungen fuer Fehlerpfad Dfp_InjVlvBnk1B" VAL_BLK 0xCAA48 Kwb_Wu8 255.000000000 SigName 0.00 255.000000000 FORMAT "%13.9" NUMBER 10 /end CHARACTERISTIC
/begin CHARACTERISTIC DSM_EnvDfp_InjVlvBnk2A_C "Fehlerpfad spezifische Umweltbedingungen fuer Fehlerpfad Dfp_InjVlvBnk2A" VAL_BLK 0xCAA52 Kwb_Wu8 255.000000000 SigName 0.00 255.000000000 FORMAT "%13.9" NUMBER 10 /end CHARACTERISTIC
/begin CHARACTERISTIC DSM_EnvDfp_InjVlvBnk2B_C "Fehlerpfad spezifische Umweltbedingungen fuer Fehlerpfad Dfp_InjVlvBnk2B" VAL_BLK 0xCAA5C Kwb_Wu8 255.000000000 SigName 0.00 255.000000000 FORMAT "%13.9" NUMBER 10 /end CHARACTERISTIC
/begin CHARACTERISTIC DSM_EnvDfp_InjVlvChipA_C "Fehlerpfad spezifische Umweltbedingungen fuer Fehlerpfad Dfp_InjVlvChipA" VAL_BLK 0xCAA66 Kwb_Wu8 255.000000000 SigName 0.00 255.000000000 FORMAT "%13.9" NUMBER 10 /end CHARACTERISTIC
/begin CHARACTERISTIC DSM_EnvDfp_InjVlvChipB_C "Fehlerpfad spezifische Umweltbedingungen fuer Fehlerpfad Dfp_InjVlvChipB" VAL_BLK 0xCAA70 Kwb_Wu8 255.000000000 SigName 0.00 255.000000000 FORMAT "%13.9" NUMBER 10 /end CHARACTERISTIC
/begin CHARACTERISTIC DSM_EnvDfp_InjVlvCyl1A_C "Fehlerpfad spezifische Umweltbedingungen fuer Fehlerpfad Dfp_InjVlvCyl1A" VAL_BLK 0xCAA7A Kwb_Wu8 255.000000000 SigName 0.00 255.000000000 FORMAT "%13.9" NUMBER 10 /end CHARACTERISTIC
/begin CHARACTERISTIC DSM_EnvDfp_InjVlvCyl1B_C "Fehlerpfad spezifische Umweltbedingungen fuer Fehlerpfad Dfp_InjVlvCyl1B" VAL_BLK 0xCAA84 Kwb_Wu8 255.000000000 SigName 0.00 255.000000000 FORMAT "%13.9" NUMBER 10 /end CHARACTERISTIC
/begin CHARACTERISTIC DSM_EnvDfp_InjVlvCyl1C_C "Fehlerpfad spezifische Umweltbedingungen fuer Fehlerpfad Dfp_InjVlvCyl1C" VAL_BLK 0xCAA8E Kwb_Wu8 255.000000000 SigName 0.00 255.000000000 FORMAT "%13.9" NUMBER 10 /end CHARACTERISTIC
/begin CHARACTERISTIC DSM_EnvDfp_InjVlvCyl2A_C "Fehlerpfad spezifische Umweltbedingungen fuer Fehlerpfad Dfp_InjVlvCyl2A" VAL_BLK 0xCAA98 Kwb_Wu8 255.000000000 SigName 0.00 255.000000000 FORMAT "%13.9" NUMBER 10 /end CHARACTERISTIC
/begin CHARACTERISTIC DSM_EnvDfp_InjVlvCyl2B_C "Fehlerpfad spezifische Umweltbedingungen fuer Fehlerpfad Dfp_InjVlvCyl2B" VAL_BLK 0xCAAA2 Kwb_Wu8 255.000000000 SigName 0.00 255.000000000 FORMAT "%13.9" NUMBER 10 /end CHARACTERISTIC
/begin CHARACTERISTIC DSM_EnvDfp_InjVlvCyl2C_C "Fehlerpfad spezifische Umweltbedingungen fuer Fehlerpfad Dfp_InjVlvCyl2C" VAL_BLK 0xCAAAC Kwb_Wu8 255.000000000 SigName 0.00 255.000000000 FORMAT "%13.9" NUMBER 10 /end CHARACTERISTIC
/begin CHARACTERISTIC DSM_EnvDfp_InjVlvCyl3A_C "Fehlerpfad spezifische Umweltbedingungen fuer Fehlerpfad Dfp_InjVlvCyl3A" VAL_BLK 0xCAAB6 Kwb_Wu8 255.000000000 SigName 0.00 255.000000000 FORMAT "%13.9" NUMBER 10 /end CHARACTERISTIC
/begin CHARACTERISTIC DSM_EnvDfp_InjVlvCyl3B_C "Fehlerpfad spezifische Umweltbedingungen fuer Fehlerpfad Dfp_InjVlvCyl3B" VAL_BLK 0xCAAC0 Kwb_Wu8 255.000000000 SigName 0.00 255.000000000 FORMAT "%13.9" NUMBER 10 /end CHARACTERISTIC
/begin CHARACTERISTIC DSM_EnvDfp_InjVlvCyl3C_C "Fehlerpfad spezifische Umweltbedingungen fuer Fehlerpfad Dfp_InjVlvCyl3C" VAL_BLK 0xCAACA Kwb_Wu8 255.000000000 SigName 0.00 255.000000000 FORMAT "%13.9" NUMBER 10 /end CHARACTERISTIC
/begin CHARACTERISTIC DSM_EnvDfp_InjVlvCyl4A_C "Fehlerpfad spezifische Umweltbedingungen fuer Fehlerpfad Dfp_InjVlvCyl4A" VAL_BLK 0xCAAD4 Kwb_Wu8 255.000000000 SigName 0.00 255.000000000 FORMAT "%13.9" NUMBER 10 /end CHARACTERISTIC
/begin CHARACTERISTIC DSM_EnvDfp_InjVlvCyl4B_C "Fehlerpfad spezifische Umweltbedingungen fuer Fehlerpfad Dfp_InjVlvCyl4B" VAL_BLK 0xCAADE Kwb_Wu8 255.000000000 SigName 0.00 255.000000000 FORMAT "%13.9" NUMBER 10 /end CHARACTERISTIC
/begin CHARACTERISTIC DSM_EnvDfp_InjVlvCyl4C_C "Fehlerpfad spezifische Umweltbedingungen fuer Fehlerpfad Dfp_InjVlvCyl4C" VAL_BLK 0xCAAE8 Kwb_Wu8 255.000000000 SigName 0.00 255.000000000 FORMAT "%13.9" NUMBER 10 /end CHARACTERISTIC
/begin CHARACTERISTIC DSM_EnvDfp_InjVlvCyl5A_C "Fehlerpfad spezifische Umweltbedingungen fuer Fehlerpfad Dfp_InjVlvCyl5A" VAL_BLK 0xCAAF2 Kwb_Wu8 255.000000000 SigName 0.00 255.000000000 FORMAT "%13.9" NUMBER 10 /end CHARACTERISTIC
/begin CHARACTERISTIC DSM_EnvDfp_InjVlvCyl5B_C "Fehlerpfad spezifische Umweltbedingungen fuer Fehlerpfad Dfp_InjVlvCyl5B" VAL_BLK 0xCAAFC Kwb_Wu8 255.000000000 SigName 0.00 255.000000000 FORMAT "%13.9" NUMBER 10 /end CHARACTERISTIC
/begin CHARACTERISTIC DSM_EnvDfp_InjVlvCyl5C_C "Fehlerpfad spezifische Umweltbedingungen fuer Fehlerpfad Dfp_InjVlvCyl5C" VAL_BLK 0xCAB06 Kwb_Wu8 255.000000000 SigName 0.00 255.000000000 FORMAT "%13.9" NUMBER 10 /end CHARACTERISTIC
/begin CHARACTERISTIC DSM_EnvDfp_InjVlvCyl6A_C "Fehlerpfad spezifische Umweltbedingungen fuer Fehlerpfad Dfp_InjVlvCyl6A" VAL_BLK 0xCAB10 Kwb_Wu8 255.000000000 SigName 0.00 255.000000000 FORMAT "%13.9" NUMBER 10 /end CHARACTERISTIC
/begin CHARACTERISTIC DSM_EnvDfp_InjVlvCyl6B_C "Fehlerpfad spezifische Umweltbedingungen fuer Fehlerpfad Dfp_InjVlvCyl6B" VAL_BLK 0xCAB1A Kwb_Wu8 255.000000000 SigName 0.00 255.000000000 FORMAT "%13.9" NUMBER 10 /end CHARACTERISTIC
/begin CHARACTERISTIC DSM_EnvDfp_InjVlvCyl6C_C "Fehlerpfad spezifische Umweltbedingungen fuer Fehlerpfad Dfp_InjVlvCyl6C" VAL_BLK 0xCAB24 Kwb_Wu8 255.000000000 SigName 0.00 255.000000000 FORMAT "%13.9" NUMBER 10 /end CHARACTERISTIC
/begin CHARACTERISTIC DSM_EnvDfp_InjVlvCyl7A_C "Fehlerpfad spezifische Umweltbedingungen fuer Fehlerpfad Dfp_InjVlvCyl7A" VAL_BLK 0xCAB2E Kwb_Wu8 255.000000000 SigName 0.00 255.000000000 FORMAT "%13.9" NUMBER 10 /end CHARACTERISTIC
/begin CHARACTERISTIC DSM_EnvDfp_InjVlvCyl7B_C "Fehlerpfad spezifische Umweltbedingungen fuer Fehlerpfad Dfp_InjVlvCyl7B" VAL_BLK 0xCAB38 Kwb_Wu8 255.000000000 SigName 0.00 255.000000000 FORMAT "%13.9" NUMBER 10 /end CHARACTERISTIC
/begin CHARACTERISTIC DSM_EnvDfp_InjVlvCyl7C_C "Fehlerpfad spezifische Umweltbedingungen fuer Fehlerpfad Dfp_InjVlvCyl7C" VAL_BLK 0xCAB42 Kwb_Wu8 255.000000000 SigName 0.00 255.000000000 FORMAT "%13.9" NUMBER 10 /end CHARACTERISTIC
/begin CHARACTERISTIC DSM_EnvDfp_InjVlvCyl8A_C "Fehlerpfad spezifische Umweltbedingungen fuer Fehlerpfad Dfp_InjVlvCyl8A" VAL_BLK 0xCAB4C Kwb_Wu8 255.000000000 SigName 0.00 255.000000000 FORMAT "%13.9" NUMBER 10 /end CHARACTERISTIC
/begin CHARACTERISTIC DSM_EnvDfp_InjVlvCyl8B_C "Fehlerpfad spezifische Umweltbedingungen fuer Fehlerpfad Dfp_InjVlvCyl8B" VAL_BLK 0xCAB56 Kwb_Wu8 255.000000000 SigName 0.00 255.000000000 FORMAT "%13.9" NUMBER 10 /end CHARACTERISTIC
/begin CHARACTERISTIC DSM_EnvDfp_InjVlvCyl8C_C "Fehlerpfad spezifische Umweltbedingungen fuer Fehlerpfad Dfp_InjVlvCyl8C" VAL_BLK 0xCAB60 Kwb_Wu8 255.000000000 SigName 0.00 255.000000000 FORMAT "%13.9" NUMBER 10 /end CHARACTERISTIC
/begin CHARACTERISTIC DSM_EnvDfp_InjVlvNVC1_C "Fehlerpfad spezifische Umweltbedingungen fuer Fehlerpfad Dfp_InjVlvNVC1" VAL_BLK 0xCAB6A Kwb_Wu8 255.000000000 SigName 0.00 255.000000000 FORMAT "%13.9" NUMBER 10 /end CHARACTERISTIC
/begin CHARACTERISTIC DSM_EnvDfp_InjVlvNVC2_C "Fehlerpfad spezifische Umweltbedingungen fuer Fehlerpfad Dfp_InjVlvNVC2" VAL_BLK 0xCAB74 Kwb_Wu8 255.000000000 SigName 0.00 255.000000000 FORMAT "%13.9" NUMBER 10 /end CHARACTERISTIC
/begin CHARACTERISTIC DSM_EnvDfp_InjVlvNVC3_C "Fehlerpfad spezifische Umweltbedingungen fuer Fehlerpfad Dfp_InjVlvNVC3" VAL_BLK 0xCAB7E Kwb_Wu8 255.000000000 SigName 0.00 255.000000000 FORMAT "%13.9" NUMBER 10 /end CHARACTERISTIC
/begin CHARACTERISTIC DSM_EnvDfp_InjVlvNVC4_C "Fehlerpfad spezifische Umweltbedingungen fuer Fehlerpfad Dfp_InjVlvNVC4" VAL_BLK 0xCAB88 Kwb_Wu8 255.000000000 SigName 0.00 255.000000000 FORMAT "%13.9" NUMBER 10 /end CHARACTERISTIC
/begin CHARACTERISTIC DSM_EnvDfp_InjVlvNVC5_C "Fehlerpfad spezifische Umweltbedingungen fuer Fehlerpfad Dfp_InjVlvNVC5" VAL_BLK 0xCAB92 Kwb_Wu8 255.000000000 SigName 0.00 255.000000000 FORMAT "%13.9" NUMBER 10 /end CHARACTERISTIC
/begin CHARACTERISTIC DSM_EnvDfp_InjVlvNVC6_C "Fehlerpfad spezifische Umweltbedingungen fuer Fehlerpfad Dfp_InjVlvNVC6" VAL_BLK 0xCAB9C Kwb_Wu8 255.000000000 SigName 0.00 255.000000000 FORMAT "%13.9" NUMBER 10 /end CHARACTERISTIC
/begin CHARACTERISTIC DSM_EnvDfp_InjVlvNVC7_C "Fehlerpfad spezifische Umweltbedingungen fuer Fehlerpfad Dfp_InjVlvNVC7" VAL_BLK 0xCABA6 Kwb_Wu8 255.000000000 SigName 0.00 255.000000000 FORMAT "%13.9" NUMBER 10 /end CHARACTERISTIC
/begin CHARACTERISTIC DSM_EnvDfp_InjVlvNVC8_C "Fehlerpfad spezifische Umweltbedingungen fuer Fehlerpfad Dfp_InjVlvNVC8" VAL_BLK 0xCABB0 Kwb_Wu8 255.000000000 SigName 0.00 255.000000000 FORMAT "%13.9" NUMBER 10 /end CHARACTERISTIC
/begin CHARACTERISTIC DSM_EnvDfp_LPACD_Max_C "Fehlerpfad spezifische Umweltbedingungen fuer Fehlerpfad Dfp_LPACD_Max" VAL_BLK 0xCABBA Kwb_Wu8 255.000000000 SigName 0.00 255.000000000 FORMAT "%13.9" NUMBER 10 /end CHARACTERISTIC
/begin CHARACTERISTIC DSM_EnvDfp_LPACD_Min_C "Fehlerpfad spezifische Umweltbedingungen fuer Fehlerpfad Dfp_LPACD_Min" VAL_BLK 0xCABC4 Kwb_Wu8 255.000000000 SigName 0.00 255.000000000 FORMAT "%13.9" NUMBER 10 /end CHARACTERISTIC
/begin CHARACTERISTIC DSM_EnvDfp_LPACD_SigNpl_C "Fehlerpfad spezifische Umweltbedingungen fuer Fehlerpfad Dfp_LPACD_SigNpl" VAL_BLK 0xCABCE Kwb_Wu8 255.000000000 SigName 0.00 255.000000000 FORMAT "%13.9" NUMBER 10 /end CHARACTERISTIC
/begin CHARACTERISTIC DSM_EnvDfp_LSUCDCircNernst0_C "Fehlerpfad spezifische Umweltbedingungen fuer Fehlerpfad Dfp_LSUCDCircNernst0" VAL_BLK 0xCABD8 Kwb_Wu8 255.000000000 SigName 0.00 255.000000000 FORMAT "%13.9" NUMBER 10 /end CHARACTERISTIC
/begin CHARACTERISTIC DSM_EnvDfp_LSUCDCircPumpCur0_C "Fehlerpfad spezifische Umweltbedingungen fuer Fehlerpfad Dfp_LSUCDCircPumpCur0" VAL_BLK 0xCABE2 Kwb_Wu8 255.000000000 SigName 0.00 255.000000000 FORMAT "%13.9" NUMBER 10 /end CHARACTERISTIC
/begin CHARACTERISTIC DSM_EnvDfp_LSUCDCircVirtGnd0_C "Fehlerpfad spezifische Umweltbedingungen fuer Fehlerpfad Dfp_LSUCDCircVirtGnd0" VAL_BLK 0xCABEC Kwb_Wu8 255.000000000 SigName 0.00 255.000000000 FORMAT "%13.9" NUMBER 10 /end CHARACTERISTIC
/begin CHARACTERISTIC DSM_EnvDfp_LSUCDHeater0_C "Fehlerpfad spezifische Umweltbedingungen fuer Fehlerpfad Dfp_LSUCDHeater0" VAL_BLK 0xCABF6 Kwb_Wu8 255.000000000 SigName 0.00 255.000000000 FORMAT "%13.9" NUMBER 10 /end CHARACTERISTIC
/begin CHARACTERISTIC DSM_EnvDfp_LSUCDHtCoup0_C "Fehlerpfad spezifische Umweltbedingungen fuer Fehlerpfad Dfp_LSUCDHtCoup0" VAL_BLK 0xCAC00 Kwb_Wu8 255.000000000 SigName 0.00 255.000000000 FORMAT "%13.9" NUMBER 10 /end CHARACTERISTIC
/begin CHARACTERISTIC DSM_EnvDfp_LSUCDO20_C "Fehlerpfad spezifische Umweltbedingungen fuer Fehlerpfad Dfp_LSUCDO20" VAL_BLK 0xCAC0A Kwb_Wu8 255.000000000 SigName 0.00 255.000000000 FORMAT "%13.9" NUMBER 10 /end CHARACTERISTIC
/begin CHARACTERISTIC DSM_EnvDfp_LSUCDO2Clb0_C "Fehlerpfad spezifische Umweltbedingungen fuer Fehlerpfad Dfp_LSUCDO2Clb0" VAL_BLK 0xCAC14 Kwb_Wu8 255.000000000 SigName 0.00 255.000000000 FORMAT "%13.9" NUMBER 10 /end CHARACTERISTIC
/begin CHARACTERISTIC DSM_EnvDfp_LSUCDRiClb0_C "Fehlerpfad spezifische Umweltbedingungen fuer Fehlerpfad Dfp_LSUCDRiClb0" VAL_BLK 0xCAC1E Kwb_Wu8 255.000000000 SigName 0.00 255.000000000 FORMAT "%13.9" NUMBER 10 /end CHARACTERISTIC
/begin CHARACTERISTIC DSM_EnvDfp_LSUCDSPI0_C "Fehlerpfad spezifische Umweltbedingungen fuer Fehlerpfad Dfp_LSUCDSPI0" VAL_BLK 0xCAC28 Kwb_Wu8 255.000000000 SigName 0.00 255.000000000 FORMAT "%13.9" NUMBER 10 /end CHARACTERISTIC
/begin CHARACTERISTIC DSM_EnvDfp_LSUCDSPIBattLow0_C "Fehlerpfad spezifische Umweltbedingungen fuer Fehlerpfad Dfp_LSUCDSPIBattLow0" VAL_BLK 0xCAC32 Kwb_Wu8 255.000000000 SigName 0.00 255.000000000 FORMAT "%13.9" NUMBER 10 /end CHARACTERISTIC
/begin CHARACTERISTIC DSM_EnvDfp_LSUCDWireIP0_C "Fehlerpfad spezifische Umweltbedingungen fuer Fehlerpfad Dfp_LSUCDWireIP0" VAL_BLK 0xCAC3C Kwb_Wu8 255.000000000 SigName 0.00 255.000000000 FORMAT "%13.9" NUMBER 10 /end CHARACTERISTIC
/begin CHARACTERISTIC DSM_EnvDfp_LSUCtlRiExc0_C "Fehlerpfad spezifische Umweltbedingungen fuer Fehlerpfad Dfp_LSUCtlRiExc0" VAL_BLK 0xCAC46 Kwb_Wu8 255.000000000 SigName 0.00 255.000000000 FORMAT "%13.9" NUMBER 10 /end CHARACTERISTIC
/begin CHARACTERISTIC DSM_EnvDfp_LSUMon1Sens_C "Fehlerpfad spezifische Umweltbedingungen fuer Fehlerpfad Dfp_LSUMon1Sens" VAL_BLK 0xCAC50 Kwb_Wu8 255.000000000 SigName 0.00 255.000000000 FORMAT "%13.9" NUMBER 10 /end CHARACTERISTIC
/begin CHARACTERISTIC DSM_EnvDfp_LSUMon2Sens_C "Fehlerpfad spezifische Umweltbedingungen fuer Fehlerpfad Dfp_LSUMon2Sens" VAL_BLK 0xCAC5A Kwb_Wu8 255.000000000 SigName 0.00 255.000000000 FORMAT "%13.9" NUMBER 10 /end CHARACTERISTIC
/begin CHARACTERISTIC DSM_EnvDfp_LubCD_C "Fehlerpfad spezifische Umweltbedingungen fuer Fehlerpfad Dfp_LubCD" VAL_BLK 0xCAC64 Kwb_Wu8 255.000000000 SigName 0.00 255.000000000 FORMAT "%13.9" NUMBER 10 /end CHARACTERISTIC
/begin CHARACTERISTIC DSM_EnvDfp_MIL_C "Fehlerpfad spezifische Umweltbedingungen fuer Fehlerpfad Dfp_MIL" VAL_BLK 0xCAC6E Kwb_Wu8 255.000000000 SigName 0.00 255.000000000 FORMAT "%13.9" NUMBER 10 /end CHARACTERISTIC
/begin CHARACTERISTIC DSM_EnvDfp_MRlyCD_C "Fehlerpfad spezifische Umweltbedingungen fuer Fehlerpfad Dfp_MRlyCD" VAL_BLK 0xCAC78 Kwb_Wu8 255.000000000 SigName 0.00 255.000000000 FORMAT "%13.9" NUMBER 10 /end CHARACTERISTIC
/begin CHARACTERISTIC DSM_EnvDfp_MSidCD_Comm_C "Fehlerpfad spezifische Umweltbedingungen fuer Fehlerpfad Dfp_MSidCD_Comm" VAL_BLK 0xCAC82 Kwb_Wu8 255.000000000 SigName 0.00 255.000000000 FORMAT "%13.9" NUMBER 10 /end CHARACTERISTIC
/begin CHARACTERISTIC DSM_EnvDfp_MSidCD_Pin_C "Fehlerpfad spezifische Umweltbedingungen fuer Fehlerpfad Dfp_MSidCD_Pin" VAL_BLK 0xCAC8C Kwb_Wu8 255.000000000 SigName 0.00 255.000000000 FORMAT "%13.9" NUMBER 10 /end CHARACTERISTIC
/begin CHARACTERISTIC DSM_EnvDfp_MSidCD_Sel_INI_C "Fehlerpfad spezifische Umweltbedingungen fuer Fehlerpfad Dfp_MSidCD_Sel_INI" VAL_BLK 0xCAC96 Kwb_Wu8 255.000000000 SigName 0.00 255.000000000 FORMAT "%13.9" NUMBER 10 /end CHARACTERISTIC
/begin CHARACTERISTIC DSM_EnvDfp_MSidCD_Select_C "Fehlerpfad spezifische Umweltbedingungen fuer Fehlerpfad Dfp_MSidCD_Select" VAL_BLK 0xCACA0 Kwb_Wu8 255.000000000 SigName 0.00 255.000000000 FORMAT "%13.9" NUMBER 10 /end CHARACTERISTIC
/begin CHARACTERISTIC DSM_EnvDfp_MeUnCDNoLoad_C "Fehlerpfad spezifische Umweltbedingungen fuer Fehlerpfad Dfp_MeUnCDNoLoad" VAL_BLK 0xCACAA Kwb_Wu8 255.000000000 SigName 0.00 255.000000000 FORMAT "%13.9" NUMBER 10 /end CHARACTERISTIC
/begin CHARACTERISTIC DSM_EnvDfp_MeUnCDSCBat_C "Fehlerpfad spezifische Umweltbedingungen fuer Fehlerpfad Dfp_MeUnCDSCBat" VAL_BLK 0xCACB4 Kwb_Wu8 255.000000000 SigName 0.00 255.000000000 FORMAT "%13.9" NUMBER 10 /end CHARACTERISTIC
/begin CHARACTERISTIC DSM_EnvDfp_MeUnCDSCGnd_C "Fehlerpfad spezifische Umweltbedingungen fuer Fehlerpfad Dfp_MeUnCDSCGnd" VAL_BLK 0xCACBE Kwb_Wu8 255.000000000 SigName 0.00 255.000000000 FORMAT "%13.9" NUMBER 10 /end CHARACTERISTIC
/begin CHARACTERISTIC DSM_EnvDfp_MeUnCD_ADC_C "Fehlerpfad spezifische Umweltbedingungen fuer Fehlerpfad Dfp_MeUnCD_ADC" VAL_BLK 0xCACC8 Kwb_Wu8 255.000000000 SigName 0.00 255.000000000 FORMAT "%13.9" NUMBER 10 /end CHARACTERISTIC
/begin CHARACTERISTIC DSM_EnvDfp_MeUnCD_SigTst_C "Fehlerpfad spezifische Umweltbedingungen fuer Fehlerpfad Dfp_MeUnCD_SigTst" VAL_BLK 0xCACD2 Kwb_Wu8 255.000000000 SigName 0.00 255.000000000 FORMAT "%13.9" NUMBER 10 /end CHARACTERISTIC
/begin CHARACTERISTIC DSM_EnvDfp_Montr_C "Fehlerpfad spezifische Umweltbedingungen fuer Fehlerpfad Dfp_Montr" VAL_BLK 0xCACDC Kwb_Wu8 255.000000000 SigName 0.00 255.000000000 FORMAT "%13.9" NUMBER 10 /end CHARACTERISTIC
/begin CHARACTERISTIC DSM_EnvDfp_NetMngDeviceA_C "Fehlerpfad spezifische Umweltbedingungen fuer Fehlerpfad Dfp_NetMngDeviceA" VAL_BLK 0xCACE6 Kwb_Wu8 255.000000000 SigName 0.00 255.000000000 FORMAT "%13.9" NUMBER 10 /end CHARACTERISTIC
/begin CHARACTERISTIC DSM_EnvDfp_NetMngDeviceB_C "Fehlerpfad spezifische Umweltbedingungen fuer Fehlerpfad Dfp_NetMngDeviceB" VAL_BLK 0xCACF0 Kwb_Wu8 255.000000000 SigName 0.00 255.000000000 FORMAT "%13.9" NUMBER 10 /end CHARACTERISTIC
/begin CHARACTERISTIC DSM_EnvDfp_NetMngDeviceC_C "Fehlerpfad spezifische Umweltbedingungen fuer Fehlerpfad Dfp_NetMngDeviceC" VAL_BLK 0xCACFA Kwb_Wu8 255.000000000 SigName 0.00 255.000000000 FORMAT "%13.9" NUMBER 10 /end CHARACTERISTIC
/begin CHARACTERISTIC DSM_EnvDfp_OPSCD_Lamp_C "Fehlerpfad spezifische Umweltbedingungen fuer Fehlerpfad Dfp_OPSCD_Lamp" VAL_BLK 0xCAD04 Kwb_Wu8 255.000000000 SigName 0.00 255.000000000 FORMAT "%13.9" NUMBER 10 /end CHARACTERISTIC
/begin CHARACTERISTIC DSM_EnvDfp_OPSCD_anain_C "Fehlerpfad spezifische Umweltbedingungen fuer Fehlerpfad Dfp_OPSCD_anain" VAL_BLK 0xCAD0E Kwb_Wu8 255.000000000 SigName 0.00 255.000000000 FORMAT "%13.9" NUMBER 10 /end CHARACTERISTIC
/begin CHARACTERISTIC DSM_EnvDfp_OTSCD_C "Fehlerpfad spezifische Umweltbedingungen fuer Fehlerpfad Dfp_OTSCD" VAL_BLK 0xCAD18 Kwb_Wu8 255.000000000 SigName 0.00 255.000000000 FORMAT "%13.9" NUMBER 10 /end CHARACTERISTIC
/begin CHARACTERISTIC DSM_EnvDfp_OvRMon_C "Fehlerpfad spezifische Umweltbedingungen fuer Fehlerpfad Dfp_OvRMon" VAL_BLK 0xCAD22 Kwb_Wu8 255.000000000 SigName 0.00 255.000000000 FORMAT "%13.9" NUMBER 10 /end CHARACTERISTIC
/begin CHARACTERISTIC DSM_EnvDfp_OvRMonBrk_C "path specific environment  condition for fault path Dfp_OvRMonBrk" VAL_BLK 0xCAD2C Kwb_Wu8 255.000000000 SigName 0.00 255.000000000 FORMAT "%13.9" NUMBER 10 /end CHARACTERISTIC
/begin CHARACTERISTIC DSM_EnvDfp_OvRMonSigA_C "Fehlerpfad spezifische Umweltbedingungen fuer Fehlerpfad Dfp_OvRMonSigA" VAL_BLK 0xCAD36 Kwb_Wu8 255.000000000 SigName 0.00 255.000000000 FORMAT "%13.9" NUMBER 10 /end CHARACTERISTIC
/begin CHARACTERISTIC DSM_EnvDfp_OxiCCDTPre_C "Fehlerpfad spezifische Umweltbedingungen fuer Fehlerpfad Dfp_OxiCCDTPre" VAL_BLK 0xCAD40 Kwb_Wu8 255.000000000 SigName 0.00 255.000000000 FORMAT "%13.9" NUMBER 10 /end CHARACTERISTIC
/begin CHARACTERISTIC DSM_EnvDfp_PCR_GovDevNeg_C "Fehlerpfad spezifische Umweltbedingungen fuer Fehlerpfad Dfp_PCR_GovDevNeg" VAL_BLK 0xCAD4A Kwb_Wu8 255.000000000 SigName 0.00 255.000000000 FORMAT "%13.9" NUMBER 10 /end CHARACTERISTIC
/begin CHARACTERISTIC DSM_EnvDfp_PCR_GovDevPos_C "Fehlerpfad spezifische Umweltbedingungen fuer Fehlerpfad Dfp_PCR_GovDevPos" VAL_BLK 0xCAD54 Kwb_Wu8 255.000000000 SigName 0.00 255.000000000 FORMAT "%13.9" NUMBER 10 /end CHARACTERISTIC
/begin CHARACTERISTIC DSM_EnvDfp_PCVCDNoLoad_C "Fehlerpfad spezifische Umweltbedingungen fuer Fehlerpfad Dfp_PCVCDNoLoad" VAL_BLK 0xCAD5E Kwb_Wu8 255.000000000 SigName 0.00 255.000000000 FORMAT "%13.9" NUMBER 10 /end CHARACTERISTIC
/begin CHARACTERISTIC DSM_EnvDfp_PCVCDSCBat_C "Fehlerpfad spezifische Umweltbedingungen fuer Fehlerpfad Dfp_PCVCDSCBat" VAL_BLK 0xCAD68 Kwb_Wu8 255.000000000 SigName 0.00 255.000000000 FORMAT "%13.9" NUMBER 10 /end CHARACTERISTIC
/begin CHARACTERISTIC DSM_EnvDfp_PCVCDSCGnd_C "Fehlerpfad spezifische Umweltbedingungen fuer Fehlerpfad Dfp_PCVCDSCGnd" VAL_BLK 0xCAD72 Kwb_Wu8 255.000000000 SigName 0.00 255.000000000 FORMAT "%13.9" NUMBER 10 /end CHARACTERISTIC
/begin CHARACTERISTIC DSM_EnvDfp_PCVCD_ADC_C "Fehlerpfad spezifische Umweltbedingungen fuer Fehlerpfad Dfp_PCVCD_ADC" VAL_BLK 0xCAD7C Kwb_Wu8 255.000000000 SigName 0.00 255.000000000 FORMAT "%13.9" NUMBER 10 /end CHARACTERISTIC
/begin CHARACTERISTIC DSM_EnvDfp_PCVCD_SigTst_C "Fehlerpfad spezifische Umweltbedingungen fuer Fehlerpfad Dfp_PCVCD_SigTst" VAL_BLK 0xCAD86 Kwb_Wu8 255.000000000 SigName 0.00 255.000000000 FORMAT "%13.9" NUMBER 10 /end CHARACTERISTIC
/begin CHARACTERISTIC DSM_EnvDfp_PFltAPSens_C "Fehlerpfad spezifische Umweltbedingungen fuer Fehlerpfad Dfp_PFltAPSens" VAL_BLK 0xCAD90 Kwb_Wu8 255.000000000 SigName 0.00 255.000000000 FORMAT "%13.9" NUMBER 10 /end CHARACTERISTIC
/begin CHARACTERISTIC DSM_EnvDfp_PFltCDPPre_C "Fehlerpfad spezifische Umweltbedingungen fuer Fehlerpfad Dfp_PFltCDPPre" VAL_BLK 0xCAD9A Kwb_Wu8 255.000000000 SigName 0.00 255.000000000 FORMAT "%13.9" NUMBER 10 /end CHARACTERISTIC
/begin CHARACTERISTIC DSM_EnvDfp_PFltCDTempPre_C "Fehlerpfad spezifische Umweltbedingungen fuer Fehlerpfad Dfp_PFltCDTempPre" VAL_BLK 0xCADA4 Kwb_Wu8 255.000000000 SigName 0.00 255.000000000 FORMAT "%13.9" NUMBER 10 /end CHARACTERISTIC
/begin CHARACTERISTIC DSM_EnvDfp_PFltChar_C "Fehlerpfad spezifische Umweltbedingungen fuer Fehlerpfad Dfp_PFltChar" VAL_BLK 0xCADAE Kwb_Wu8 255.000000000 SigName 0.00 255.000000000 FORMAT "%13.9" NUMBER 10 /end CHARACTERISTIC
/begin CHARACTERISTIC DSM_EnvDfp_PFltEngPrt_C "Fehlerpfad spezifische Umweltbedingungen fuer Fehlerpfad Dfp_PFltEngPrt" VAL_BLK 0xCADB8 Kwb_Wu8 255.000000000 SigName 0.00 255.000000000 FORMAT "%13.9" NUMBER 10 /end CHARACTERISTIC
/begin CHARACTERISTIC DSM_EnvDfp_PFltPresDynPlaus_C "Fehlerpfad spezifische Umweltbedingungen fuer Fehlerpfad Dfp_PFltPresDynPlaus" VAL_BLK 0xCADC2 Kwb_Wu8 255.000000000 SigName 0.00 255.000000000 FORMAT "%13.9" NUMBER 10 /end CHARACTERISTIC
/begin CHARACTERISTIC DSM_EnvDfp_PFltPresSens_C "Fehlerpfad spezifische Umweltbedingungen fuer Fehlerpfad Dfp_PFltPresSens" VAL_BLK 0xCADCC Kwb_Wu8 255.000000000 SigName 0.00 255.000000000 FORMAT "%13.9" NUMBER 10 /end CHARACTERISTIC
/begin CHARACTERISTIC DSM_EnvDfp_PFltPresSensFrz_C "Fehlerpfad spezifische Umweltbedingungen fuer Fehlerpfad Dfp_PFltPresSensFrz" VAL_BLK 0xCADD6 Kwb_Wu8 255.000000000 SigName 0.00 255.000000000 FORMAT "%13.9" NUMBER 10 /end CHARACTERISTIC
/begin CHARACTERISTIC DSM_EnvDfp_PFltPresSensHsLn_C "Fehlerpfad spezifische Umweltbedingungen fuer Fehlerpfad Dfp_PFltPresSensHsLn" VAL_BLK 0xCADE0 Kwb_Wu8 255.000000000 SigName 0.00 255.000000000 FORMAT "%13.9" NUMBER 10 /end CHARACTERISTIC
/begin CHARACTERISTIC DSM_EnvDfp_PFltPresSensSot_C "Fehlerpfad spezifische Umweltbedingungen fuer Fehlerpfad Dfp_PFltPresSensSot" VAL_BLK 0xCADEA Kwb_Wu8 255.000000000 SigName 0.00 255.000000000 FORMAT "%13.9" NUMBER 10 /end CHARACTERISTIC
/begin CHARACTERISTIC DSM_EnvDfp_PFltRgnPerm_C "Fehlerpfad spezifische Umweltbedingungen fuer Fehlerpfad Dfp_PFltRgnPerm" VAL_BLK 0xCADF4 Kwb_Wu8 255.000000000 SigName 0.00 255.000000000 FORMAT "%13.9" NUMBER 10 /end CHARACTERISTIC
/begin CHARACTERISTIC DSM_EnvDfp_PFltTempDwnStrm_C "Fehlerpfad spezifische Umweltbedingungen fuer Fehlerpfad Dfp_PFltTempDwnStrm" VAL_BLK 0xCADFE Kwb_Wu8 255.000000000 SigName 0.00 255.000000000 FORMAT "%13.9" NUMBER 10 /end CHARACTERISTIC
/begin CHARACTERISTIC DSM_EnvDfp_PFltTempSens_C "Fehlerpfad spezifische Umweltbedingungen fuer Fehlerpfad Dfp_PFltTempSens" VAL_BLK 0xCAE08 Kwb_Wu8 255.000000000 SigName 0.00 255.000000000 FORMAT "%13.9" NUMBER 10 /end CHARACTERISTIC
/begin CHARACTERISTIC DSM_EnvDfp_PFltTempUpStrm_C "Fehlerpfad spezifische Umweltbedingungen fuer Fehlerpfad Dfp_PFltTempUpStrm" VAL_BLK 0xCAE12 Kwb_Wu8 255.000000000 SigName 0.00 255.000000000 FORMAT "%13.9" NUMBER 10 /end CHARACTERISTIC
/begin CHARACTERISTIC DSM_EnvDfp_PFltmSotDiffMax_C "Fehlerpfad spezifische Umweltbedingungen fuer Fehlerpfad Dfp_PFltmSotDiffMax" VAL_BLK 0xCAE1C Kwb_Wu8 255.000000000 SigName 0.00 255.000000000 FORMAT "%13.9" NUMBER 10 /end CHARACTERISTIC
/begin CHARACTERISTIC DSM_EnvDfp_QLTCD_C "Fehlerpfad spezifische Umweltbedingungen fuer Fehlerpfad Dfp_QLTCD" VAL_BLK 0xCAE26 Kwb_Wu8 255.000000000 SigName 0.00 255.000000000 FORMAT "%13.9" NUMBER 10 /end CHARACTERISTIC
/begin CHARACTERISTIC DSM_EnvDfp_RTMMon_C "Pfadsepzifische Umweltbedingungen für den Fehlerpfad Dfp_RTMMon" VAL_BLK 0xCAE30 Kwb_Wu8 255.000000000 SigName 0.00 255.000000000 FORMAT "%13.9" NUMBER 10 /end CHARACTERISTIC
/begin CHARACTERISTIC DSM_EnvDfp_RailCD_C "Fehlerpfad spezifische Umweltbedingungen fuer Fehlerpfad Dfp_RailCD" VAL_BLK 0xCAE3A Kwb_Wu8 255.000000000 SigName 0.00 255.000000000 FORMAT "%13.9" NUMBER 10 /end CHARACTERISTIC
/begin CHARACTERISTIC DSM_EnvDfp_RailCDOfsTst_C "Fehlerpfad spezifische Umweltbedingungen fuer Fehlerpfad Dfp_RailCDOfsTst" VAL_BLK 0xCAE44 Kwb_Wu8 255.000000000 SigName 0.00 255.000000000 FORMAT "%13.9" NUMBER 10 /end CHARACTERISTIC
/begin CHARACTERISTIC DSM_EnvDfp_RailCD_PMonStrt_C "Fehlerpfad spezifische Umweltbedingungen fuer Fehlerpfad Dfp_RailCD_PMonStrt" VAL_BLK 0xCAE4E Kwb_Wu8 255.000000000 SigName 0.00 255.000000000 FORMAT "%13.9" NUMBER 10 /end CHARACTERISTIC
/begin CHARACTERISTIC DSM_EnvDfp_RailCtlModeMeUnDiag_C "Fehlerpfad spezifische Umweltbedingungen fuer Fehlerpfad Dfp_RailCtlModeMeUnDiag" VAL_BLK 0xCAE58 Kwb_Wu8 255.000000000 SigName 0.00 255.000000000 FORMAT "%13.9" NUMBER 10 /end CHARACTERISTIC
/begin CHARACTERISTIC DSM_EnvDfp_RailCtlModePCVDiag_C "Fehlerpfad spezifische Umweltbedingungen fuer Fehlerpfad Dfp_RailCtlModePCVDiag" VAL_BLK 0xCAE62 Kwb_Wu8 255.000000000 SigName 0.00 255.000000000 FORMAT "%13.9" NUMBER 10 /end CHARACTERISTIC
/begin CHARACTERISTIC DSM_EnvDfp_RailMeUn0_C "Fehlerpfad spezifische Umweltbedingungen fuer Fehlerpfad Dfp_RailMeUn0" VAL_BLK 0xCAE6C Kwb_Wu8 255.000000000 SigName 0.00 255.000000000 FORMAT "%13.9" NUMBER 10 /end CHARACTERISTIC
/begin CHARACTERISTIC DSM_EnvDfp_RailMeUn1_C "Fehlerpfad spezifische Umweltbedingungen fuer Fehlerpfad Dfp_RailMeUn1" VAL_BLK 0xCAE76 Kwb_Wu8 255.000000000 SigName 0.00 255.000000000 FORMAT "%13.9" NUMBER 10 /end CHARACTERISTIC
/begin CHARACTERISTIC DSM_EnvDfp_RailMeUn2_C "Fehlerpfad spezifische Umweltbedingungen fuer Fehlerpfad Dfp_RailMeUn2" VAL_BLK 0xCAE80 Kwb_Wu8 255.000000000 SigName 0.00 255.000000000 FORMAT "%13.9" NUMBER 10 /end CHARACTERISTIC
/begin CHARACTERISTIC DSM_EnvDfp_RailMeUn3_C "Fehlerpfad spezifische Umweltbedingungen fuer Fehlerpfad Dfp_RailMeUn3" VAL_BLK 0xCAE8A Kwb_Wu8 255.000000000 SigName 0.00 255.000000000 FORMAT "%13.9" NUMBER 10 /end CHARACTERISTIC
/begin CHARACTERISTIC DSM_EnvDfp_RailMeUn4_C "Fehlerpfad spezifische Umweltbedingungen fuer Fehlerpfad Dfp_RailMeUn4" VAL_BLK 0xCAE94 Kwb_Wu8 255.000000000 SigName 0.00 255.000000000 FORMAT "%13.9" NUMBER 10 /end CHARACTERISTIC
/begin CHARACTERISTIC DSM_EnvDfp_RailPCV0_C "Fehlerpfad spezifische Umweltbedingungen fuer Fehlerpfad Dfp_RailPCV0" VAL_BLK 0xCAE9E Kwb_Wu8 255.000000000 SigName 0.00 255.000000000 FORMAT "%13.9" NUMBER 10 /end CHARACTERISTIC
/begin CHARACTERISTIC DSM_EnvDfp_RailPCV1_C "Fehlerpfad spezifische Umweltbedingungen fuer Fehlerpfad Dfp_RailPCV1" VAL_BLK 0xCAEA8 Kwb_Wu8 255.000000000 SigName 0.00 255.000000000 FORMAT "%13.9" NUMBER 10 /end CHARACTERISTIC
/begin CHARACTERISTIC DSM_EnvDfp_RailPCV2_C "Fehlerpfad spezifische Umweltbedingungen fuer Fehlerpfad Dfp_RailPCV2" VAL_BLK 0xCAEB2 Kwb_Wu8 255.000000000 SigName 0.00 255.000000000 FORMAT "%13.9" NUMBER 10 /end CHARACTERISTIC
/begin CHARACTERISTIC DSM_EnvDfp_RailPCV3_C "Fehlerpfad spezifische Umweltbedingungen fuer Fehlerpfad Dfp_RailPCV3" VAL_BLK 0xCAEBC Kwb_Wu8 255.000000000 SigName 0.00 255.000000000 FORMAT "%13.9" NUMBER 10 /end CHARACTERISTIC
/begin CHARACTERISTIC DSM_EnvDfp_RailPCV4_C "Fehlerpfad spezifische Umweltbedingungen fuer Fehlerpfad Dfp_RailPCV4" VAL_BLK 0xCAEC6 Kwb_Wu8 255.000000000 SigName 0.00 255.000000000 FORMAT "%13.9" NUMBER 10 /end CHARACTERISTIC
/begin CHARACTERISTIC DSM_EnvDfp_RailPCV5_C "Fehlerpfad spezifische Umweltbedingungen fuer Fehlerpfad Dfp_RailPCV5" VAL_BLK 0xCAED0 Kwb_Wu8 255.000000000 SigName 0.00 255.000000000 FORMAT "%13.9" NUMBER 10 /end CHARACTERISTIC
/begin CHARACTERISTIC DSM_EnvDfp_SOPTst_C "Fehlerpfad spezifische Umweltbedingungen fuer Fehlerpfad Dfp_SOPTst" VAL_BLK 0xCAEDA Kwb_Wu8 255.000000000 SigName 0.00 255.000000000 FORMAT "%13.9" NUMBER 10 /end CHARACTERISTIC
/begin CHARACTERISTIC DSM_EnvDfp_SSpMon1_C "Fehlerpfad spezifische Umweltbedingungen fuer Fehlerpfad Dfp_SSpMon1" VAL_BLK 0xCAEE4 Kwb_Wu8 255.000000000 SigName 0.00 255.000000000 FORMAT "%13.9" NUMBER 10 /end CHARACTERISTIC
/begin CHARACTERISTIC DSM_EnvDfp_SSpMon2_C "Fehlerpfad spezifische Umweltbedingungen fuer Fehlerpfad Dfp_SSpMon2" VAL_BLK 0xCAEEE Kwb_Wu8 255.000000000 SigName 0.00 255.000000000 FORMAT "%13.9" NUMBER 10 /end CHARACTERISTIC
/begin CHARACTERISTIC DSM_EnvDfp_SSpMon3_C "Fehlerpfad spezifische Umweltbedingungen fuer Fehlerpfad Dfp_SSpMon3" VAL_BLK 0xCAEF8 Kwb_Wu8 255.000000000 SigName 0.00 255.000000000 FORMAT "%13.9" NUMBER 10 /end CHARACTERISTIC
/begin CHARACTERISTIC DSM_EnvDfp_ShutCD_C "Fehlerpfad spezifische Umweltbedingungen fuer Fehlerpfad Dfp_ShutCD" VAL_BLK 0xCAF02 Kwb_Wu8 255.000000000 SigName 0.00 255.000000000 FORMAT "%13.9" NUMBER 10 /end CHARACTERISTIC
/begin CHARACTERISTIC DSM_EnvDfp_StSysTrqShutOff_C "Fehlerpfad spezifische Umweltbedingungen fuer Fehlerpfad Dfp_StSysTrqShutOff" VAL_BLK 0xCAF0C Kwb_Wu8 255.000000000 SigName 0.00 255.000000000 FORMAT "%13.9" NUMBER 10 /end CHARACTERISTIC
/begin CHARACTERISTIC DSM_EnvDfp_StrtCD_Actr_C "Fehlerpfad spezifische Umweltbedingungen fuer Fehlerpfad Dfp_StrtCD_Actr" VAL_BLK 0xCAF16 Kwb_Wu8 255.000000000 SigName 0.00 255.000000000 FORMAT "%13.9" NUMBER 10 /end CHARACTERISTIC
/begin CHARACTERISTIC DSM_EnvDfp_SysLamp_C "Fehlerpfad spezifische Umweltbedingungen fuer Fehlerpfad Dfp_SysLamp" VAL_BLK 0xCAF20 Kwb_Wu8 255.000000000 SigName 0.00 255.000000000 FORMAT "%13.9" NUMBER 10 /end CHARACTERISTIC
/begin CHARACTERISTIC DSM_EnvDfp_T15CD_C "Fehlerpfad spezifische Umweltbedingungen fuer Fehlerpfad Dfp_T15CD" VAL_BLK 0xCAF2A Kwb_Wu8 255.000000000 SigName 0.00 255.000000000 FORMAT "%13.9" NUMBER 10 /end CHARACTERISTIC
/begin CHARACTERISTIC DSM_EnvDfp_TGearbx_C "Fehlerpfad spezifische Umweltbedingungen fuer Fehlerpfad Dfp_TGearbx" VAL_BLK 0xCAF34 Kwb_Wu8 255.000000000 SigName 0.00 255.000000000 FORMAT "%13.9" NUMBER 10 /end CHARACTERISTIC
/begin CHARACTERISTIC DSM_EnvDfp_TPUMon_C "Fehlerpfad spezifische Umweltbedingungen fuer Fehlerpfad Dfp_TPUMon" VAL_BLK 0xCAF3E Kwb_Wu8 255.000000000 SigName 0.00 255.000000000 FORMAT "%13.9" NUMBER 10 /end CHARACTERISTIC
/begin CHARACTERISTIC DSM_EnvDfp_TVACD_Max_C "Fehlerpfad spezifische Umweltbedingungen fuer Fehlerpfad Dfp_TVACD_Max" VAL_BLK 0xCAF48 Kwb_Wu8 255.000000000 SigName 0.00 255.000000000 FORMAT "%13.9" NUMBER 10 /end CHARACTERISTIC
/begin CHARACTERISTIC DSM_EnvDfp_TVACD_Min_C "Fehlerpfad spezifische Umweltbedingungen fuer Fehlerpfad Dfp_TVACD_Min" VAL_BLK 0xCAF52 Kwb_Wu8 255.000000000 SigName 0.00 255.000000000 FORMAT "%13.9" NUMBER 10 /end CHARACTERISTIC
/begin CHARACTERISTIC DSM_EnvDfp_TVACD_SigNpl_C "Fehlerpfad spezifische Umweltbedingungen fuer Fehlerpfad Dfp_TVACD_SigNpl" VAL_BLK 0xCAF5C Kwb_Wu8 255.000000000 SigName 0.00 255.000000000 FORMAT "%13.9" NUMBER 10 /end CHARACTERISTIC
/begin CHARACTERISTIC DSM_EnvDfp_TVACD_TVADia1_C "Fehlerpfad spezifische Umweltbedingungen fuer Fehlerpfad Dfp_TVACD_TVADia1" VAL_BLK 0xCAF66 Kwb_Wu8 255.000000000 SigName 0.00 255.000000000 FORMAT "%13.9" NUMBER 10 /end CHARACTERISTIC
/begin CHARACTERISTIC DSM_EnvDfp_TVACD_TVADia2_C "Fehlerpfad spezifische Umweltbedingungen fuer Fehlerpfad Dfp_TVACD_TVADia2" VAL_BLK 0xCAF70 Kwb_Wu8 255.000000000 SigName 0.00 255.000000000 FORMAT "%13.9" NUMBER 10 /end CHARACTERISTIC
/begin CHARACTERISTIC DSM_EnvDfp_TVACD_TVADia3_C "Fehlerpfad spezifische Umweltbedingungen fuer Fehlerpfad Dfp_TVACD_TVADia3" VAL_BLK 0xCAF7A Kwb_Wu8 255.000000000 SigName 0.00 255.000000000 FORMAT "%13.9" NUMBER 10 /end CHARACTERISTIC
/begin CHARACTERISTIC DSM_EnvDfp_VSACD_Max_C "Fehlerpfad spezifische Umweltbedingungen fuer Fehlerpfad Dfp_VSACD_Max" VAL_BLK 0xCAF84 Kwb_Wu8 255.000000000 SigName 0.00 255.000000000 FORMAT "%13.9" NUMBER 10 /end CHARACTERISTIC
/begin CHARACTERISTIC DSM_EnvDfp_VSACD_Min_C "Fehlerpfad spezifische Umweltbedingungen fuer Fehlerpfad Dfp_VSACD_Min" VAL_BLK 0xCAF8E Kwb_Wu8 255.000000000 SigName 0.00 255.000000000 FORMAT "%13.9" NUMBER 10 /end CHARACTERISTIC
/begin CHARACTERISTIC DSM_EnvDfp_VSACD_SigNpl_C "Fehlerpfad spezifische Umweltbedingungen fuer Fehlerpfad Dfp_VSACD_SigNpl" VAL_BLK 0xCAF98 Kwb_Wu8 255.000000000 SigName 0.00 255.000000000 FORMAT "%13.9" NUMBER 10 /end CHARACTERISTIC
/begin CHARACTERISTIC DSM_EnvDfp_VSACD_VSADia1_C "Fehlerpfad spezifische Umweltbedingungen fuer Fehlerpfad Dfp_VSACD_VSADia1" VAL_BLK 0xCAFA2 Kwb_Wu8 255.000000000 SigName 0.00 255.000000000 FORMAT "%13.9" NUMBER 10 /end CHARACTERISTIC
/begin CHARACTERISTIC DSM_EnvDfp_VSACD_VSADia2_C "Fehlerpfad spezifische Umweltbedingungen fuer Fehlerpfad Dfp_VSACD_VSADia2" VAL_BLK 0xCAFAC Kwb_Wu8 255.000000000 SigName 0.00 255.000000000 FORMAT "%13.9" NUMBER 10 /end CHARACTERISTIC
/begin CHARACTERISTIC DSM_EnvDfp_VSACD_VSADia3_C "Fehlerpfad spezifische Umweltbedingungen fuer Fehlerpfad Dfp_VSACD_VSADia3" VAL_BLK 0xCAFB6 Kwb_Wu8 255.000000000 SigName 0.00 255.000000000 FORMAT "%13.9" NUMBER 10 /end CHARACTERISTIC
/begin CHARACTERISTIC DSM_EnvDfp_VSACD_VSADia4_C "Fehlerpfad spezifische Umweltbedingungen fuer Fehlerpfad Dfp_VSACD_VSADia4" VAL_BLK 0xCAFC0 Kwb_Wu8 255.000000000 SigName 0.00 255.000000000 FORMAT "%13.9" NUMBER 10 /end CHARACTERISTIC
/begin CHARACTERISTIC DSM_EnvDfp_VSSCD1_C "Fehlerpfad spezifische Umweltbedingungen fuer Fehlerpfad Dfp_VSSCD1" VAL_BLK 0xCAFCA Kwb_Wu8 255.000000000 SigName 0.00 255.000000000 FORMAT "%13.9" NUMBER 10 /end CHARACTERISTIC
/begin CHARACTERISTIC DSM_EnvDfp_VSSCD2_C "Fehlerpfad spezifische Umweltbedingungen fuer Fehlerpfad Dfp_VSSCD2" VAL_BLK 0xCAFD4 Kwb_Wu8 255.000000000 SigName 0.00 255.000000000 FORMAT "%13.9" NUMBER 10 /end CHARACTERISTIC
/begin CHARACTERISTIC DSM_EnvDfp_WdCom_C "Fehlerpfad spezifische Umweltbedingungen fuer Fehlerpfad Dfp_WdCom" VAL_BLK 0xCAFDE Kwb_Wu8 255.000000000 SigName 0.00 255.000000000 FORMAT "%13.9" NUMBER 10 /end CHARACTERISTIC
/begin MEASUREMENT Dfp_ACCDSwtin_mp "Messpunkt fuer Fehlerpfad  Dfp_ACCDSwtin" UWORD OneToOne 1 100 0.00 65535.00 FORMAT "%8.2" ECU_ADDRESS 0x8FE590 /end MEASUREMENT
/begin MEASUREMENT Dfp_AccPedPlausBrk_mp "Fehlerpfad für Unplausibilität AccPed-Brk" UWORD OneToOne 1 100 0.00 65535.00 FORMAT "%8.2" ECU_ADDRESS 0x8FE592 /end MEASUREMENT
/begin MEASUREMENT Dfp_ACC_PlausTrqDes_mp "Bremse ist ACC_PlausTrqTmrDead_C [s] getreten & ACC fordert noch immer Moment." UWORD OneToOne 1 100 0.00 65535.00 FORMAT "%8.2" ECU_ADDRESS 0x8FE594 /end MEASUREMENT
/begin MEASUREMENT Dfp_ACC_trqInr_mp "Too much Torque ACC" UWORD OneToOne 1 100 0.00 65535.00 FORMAT "%8.2" ECU_ADDRESS 0x8FE596 /end MEASUREMENT
/begin MEASUREMENT Dfp_ACTrq_mp "Messpunkt fuer Fehlerpfad  Dfp_ACTrq" UWORD OneToOne 1 100 0.00 65535.00 FORMAT "%8.2" ECU_ADDRESS 0x8FE598 /end MEASUREMENT
/begin MEASUREMENT Dfp_ADCMon_mp "Messpunkt fuer Fehlerpfad  Dfp_ADCMon" UWORD OneToOne 1 100 0.00 65535.00 FORMAT "%8.2" ECU_ADDRESS 0x8FE59A /end MEASUREMENT
/begin MEASUREMENT Dfp_AFSCDIdlAdjVal_mp "Messpunkt fuer Fehlerpfad  Dfp_AFSCDIdlAdjVal" UWORD OneToOne 1 100 0.00 65535.00 FORMAT "%8.2" ECU_ADDRESS 0x8FE59C /end MEASUREMENT
/begin MEASUREMENT Dfp_AFSCDLdAdjVal_mp "Messpunkt fuer Fehlerpfad  Dfp_AFSCDLdAdjVal" UWORD OneToOne 1 100 0.00 65535.00 FORMAT "%8.2" ECU_ADDRESS 0x8FE59E /end MEASUREMENT
/begin MEASUREMENT Dfp_AFSCD_AirTempDcyc_mp "Messpunkt fuer Fehlerpfad  Dfp_AFSCD_AirTempDcyc" UWORD OneToOne 1 100 0.00 65535.00 FORMAT "%8.2" ECU_ADDRESS 0x8FE5A0 /end MEASUREMENT
/begin MEASUREMENT Dfp_AFSCD_PlOffsDrft_mp "Messpunkt fuer Fehlerpfad  Dfp_AFSCD_PlOffsDrft" UWORD OneToOne 1 100 0.00 65535.00 FORMAT "%8.2" ECU_ADDRESS 0x8FE5A2 /end MEASUREMENT
/begin MEASUREMENT Dfp_AFSCD_PlSetyDrft_mp "Messpunkt fuer Fehlerpfad  Dfp_AFSCD_PlSetyDrft" UWORD OneToOne 1 100 0.00 65535.00 FORMAT "%8.2" ECU_ADDRESS 0x8FE5A4 /end MEASUREMENT
/begin MEASUREMENT Dfp_AFSCD_SRCAirTemp_mp "Fehlerpfad für Prüfung auf optimal Lufttemperatur" UWORD OneToOne 1 100 0.00 65535.00 FORMAT "%8.2" ECU_ADDRESS 0x8FE5A6 /end MEASUREMENT
/begin MEASUREMENT Dfp_AFSCD_SRCBatt_mp "Fehlerpfad für Prüfung auf optimale Batteriespannung" UWORD OneToOne 1 100 0.00 65535.00 FORMAT "%8.2" ECU_ADDRESS 0x8FE5A8 /end MEASUREMENT
/begin MEASUREMENT Dfp_AFSCD_SRCCorrAirm_mp "Fehlerpfad für SRC des korrigierten Sensorsignals (HFM6)" UWORD OneToOne 1 100 0.00 65535.00 FORMAT "%8.2" ECU_ADDRESS 0x8FE5AA /end MEASUREMENT
/begin MEASUREMENT Dfp_AFSCD_SRCRawAirm_mp "Fehlerpfad für SRC des unkorrigierten Sensorsignals (HFM6)" UWORD OneToOne 1 100 0.00 65535.00 FORMAT "%8.2" ECU_ADDRESS 0x8FE5AC /end MEASUREMENT
/begin MEASUREMENT Dfp_AFSCD_SRCRefSigPer_mp "Fehlerpfad für SRC des Referenzsignals (Lufttemperatur-Periodendauer beim HFM6)" UWORD OneToOne 1 100 0.00 65535.00 FORMAT "%8.2" ECU_ADDRESS 0x8FE5AE /end MEASUREMENT
/begin MEASUREMENT Dfp_AirCtlPlateBreak_mp "Dfp for plate break monitoring" UWORD OneToOne 1 100 0.00 65535.00 FORMAT "%8.2" ECU_ADDRESS 0x8FE5B0 /end MEASUREMENT
/begin MEASUREMENT Dfp_AirCtl_GovNegDev2_mp "AirCtl permanent governor2 negative deviatio" UWORD OneToOne 1 100 0.00 65535.00 FORMAT "%8.2" ECU_ADDRESS 0x8FE5B2 /end MEASUREMENT
/begin MEASUREMENT Dfp_AirCtl_GovNegDev_mp "Messpunkt fuer Fehlerpfad  Dfp_AirCtl_GovNegDev" UWORD OneToOne 1 100 0.00 65535.00 FORMAT "%8.2" ECU_ADDRESS 0x8FE5B4 /end MEASUREMENT
/begin MEASUREMENT Dfp_AirCtl_GovPosDev2_mp "AirCtl permanent governor2 positive deviation" UWORD OneToOne 1 100 0.00 65535.00 FORMAT "%8.2" ECU_ADDRESS 0x8FE5B6 /end MEASUREMENT
/begin MEASUREMENT Dfp_AirCtl_GovPosDev_mp "Messpunkt fuer Fehlerpfad  Dfp_AirCtl_GovPosDev" UWORD OneToOne 1 100 0.00 65535.00 FORMAT "%8.2" ECU_ADDRESS 0x8FE5B8 /end MEASUREMENT
/begin MEASUREMENT Dfp_AltCD_mp "Fehlerpfad des Generators (Kommunikationsfehler)" UWORD OneToOne 1 100 0.00 65535.00 FORMAT "%8.2" ECU_ADDRESS 0x8FE5BA /end MEASUREMENT
/begin MEASUREMENT Dfp_AOHtCD_AOHtDia1_mp "Messpunkt fuer Fehlerpfad  Dfp_AOHtCD_AOHtDia1" UWORD OneToOne 1 100 0.00 65535.00 FORMAT "%8.2" ECU_ADDRESS 0x8FE5BC /end MEASUREMENT
/begin MEASUREMENT Dfp_AOHtCD_AOHtDia2_mp "Messpunkt fuer Fehlerpfad  Dfp_AOHtCD_AOHtDia2" UWORD OneToOne 1 100 0.00 65535.00 FORMAT "%8.2" ECU_ADDRESS 0x8FE5BE /end MEASUREMENT
/begin MEASUREMENT Dfp_AOHtCD_AOHtDia3_mp "Messpunkt fuer Fehlerpfad  Dfp_AOHtCD_AOHtDia3" UWORD OneToOne 1 100 0.00 65535.00 FORMAT "%8.2" ECU_ADDRESS 0x8FE5C0 /end MEASUREMENT
/begin MEASUREMENT Dfp_AOHtCD_mp "Messpunkt fuer Fehlerpfad bei PWM Endstufenfehler" UWORD OneToOne 1 100 0.00 65535.00 FORMAT "%8.2" ECU_ADDRESS 0x8FE5C2 /end MEASUREMENT
/begin MEASUREMENT Dfp_APP1_mp "Messpunkt fuer Fehlerpfad  Dfp_APP1" UWORD OneToOne 1 100 0.00 65535.00 FORMAT "%8.2" ECU_ADDRESS 0x8FE5C4 /end MEASUREMENT
/begin MEASUREMENT Dfp_APP2_mp "Messpunkt fuer Fehlerpfad  Dfp_APP2" UWORD OneToOne 1 100 0.00 65535.00 FORMAT "%8.2" ECU_ADDRESS 0x8FE5C6 /end MEASUREMENT
/begin MEASUREMENT Dfp_APSCD_mp "Messpunkt fuer Fehlerpfad  Dfp_APSCD" UWORD OneToOne 1 100 0.00 65535.00 FORMAT "%8.2" ECU_ADDRESS 0x8FE5C8 /end MEASUREMENT
/begin MEASUREMENT Dfp_ARS_mp "Fault path for ARS" UWORD OneToOne 1 100 0.00 65535.00 FORMAT "%8.2" ECU_ADDRESS 0x8FE5CA /end MEASUREMENT
/begin MEASUREMENT Dfp_BattCD_mp "Messpunkt fuer Fehlerpfad  Dfp_BattCD" UWORD OneToOne 1 100 0.00 65535.00 FORMAT "%8.2" ECU_ADDRESS 0x8FE5CC /end MEASUREMENT
/begin MEASUREMENT Dfp_BPACD_BPADia1_mp "Messpunkt fuer Fehlerpfad  Dfp_BPACD_BPADia1" UWORD OneToOne 1 100 0.00 65535.00 FORMAT "%8.2" ECU_ADDRESS 0x8FE5CE /end MEASUREMENT
/begin MEASUREMENT Dfp_BPACD_BPADia2_mp "Messpunkt fuer Fehlerpfad  Dfp_BPACD_BPADia2" UWORD OneToOne 1 100 0.00 65535.00 FORMAT "%8.2" ECU_ADDRESS 0x8FE5D0 /end MEASUREMENT
/begin MEASUREMENT Dfp_BPACD_BPADia3_mp "Messpunkt fuer Fehlerpfad  Dfp_BPACD_BPADia3" UWORD OneToOne 1 100 0.00 65535.00 FORMAT "%8.2" ECU_ADDRESS 0x8FE5D2 /end MEASUREMENT
/begin MEASUREMENT Dfp_BPACD_Max_mp "Fehlerpfad für Kurzschluss nach Batteriespannung des Ladedruckstrellers" UWORD OneToOne 1 100 0.00 65535.00 FORMAT "%8.2" ECU_ADDRESS 0x8FE5D4 /end MEASUREMENT
/begin MEASUREMENT Dfp_BPACD_Min_mp "Fehlerpfad für Kurzschluss nach Masse des Ladedruckstellers" UWORD OneToOne 1 100 0.00 65535.00 FORMAT "%8.2" ECU_ADDRESS 0x8FE5D6 /end MEASUREMENT
/begin MEASUREMENT Dfp_BPACD_SigNpl_mp "Fehlerpfad für Lastabfall und Übertemperatur des Ladedruckstellers" UWORD OneToOne 1 100 0.00 65535.00 FORMAT "%8.2" ECU_ADDRESS 0x8FE5D8 /end MEASUREMENT
/begin MEASUREMENT Dfp_BPSCD_mp "Messpunkt fuer Fehlerpfad  Dfp_BPSCD" UWORD OneToOne 1 100 0.00 65535.00 FORMAT "%8.2" ECU_ADDRESS 0x8FE5DA /end MEASUREMENT
/begin MEASUREMENT Dfp_BrkCD_mp "Messpunkt fuer Fehlerpfad  Dfp_BrkCD" UWORD OneToOne 1 100 0.00 65535.00 FORMAT "%8.2" ECU_ADDRESS 0x8FE5DC /end MEASUREMENT
/begin MEASUREMENT Dfp_Bss_mp "Messpunkt fuer Fehlerpfad  Dfp_Bss" UWORD OneToOne 1 100 0.00 65535.00 FORMAT "%8.2" ECU_ADDRESS 0x8FE5DE /end MEASUREMENT
/begin MEASUREMENT Dfp_CBACD_mp "Messpunkt fuer Fehlerpfad  Dfp_CBACD" UWORD OneToOne 1 100 0.00 65535.00 FORMAT "%8.2" ECU_ADDRESS 0x8FE5E0 /end MEASUREMENT
/begin MEASUREMENT Dfp_Clg_DynTst_mp "Messpunkt fuer Fehlerpfad  Dfp_Clg_DynTst" UWORD OneToOne 1 100 0.00 65535.00 FORMAT "%8.2" ECU_ADDRESS 0x8FE5E2 /end MEASUREMENT
/begin MEASUREMENT Dfp_CmbChbMisfire1_mp "Fehlerpfad Zündaussetzer in Zylinder 1" UWORD OneToOne 1 100 0.00 65535.00 FORMAT "%8.2" ECU_ADDRESS 0x8FE5E4 /end MEASUREMENT
/begin MEASUREMENT Dfp_CmbChbMisfire2_mp "Fehlerpfad Zündaussetzer in Zylinder 2" UWORD OneToOne 1 100 0.00 65535.00 FORMAT "%8.2" ECU_ADDRESS 0x8FE5E6 /end MEASUREMENT
/begin MEASUREMENT Dfp_CmbChbMisfire3_mp "Fehlerpfad Zündaussetzer in Zylinder 3" UWORD OneToOne 1 100 0.00 65535.00 FORMAT "%8.2" ECU_ADDRESS 0x8FE5E8 /end MEASUREMENT
/begin MEASUREMENT Dfp_CmbChbMisfire4_mp "Fehlerpfad Zündaussetzer in Zylinder 4" UWORD OneToOne 1 100 0.00 65535.00 FORMAT "%8.2" ECU_ADDRESS 0x8FE5EA /end MEASUREMENT
/begin MEASUREMENT Dfp_CmbChbMisfire5_mp "Fehlerpfad Zündaussetzer in Zylinder 5" UWORD OneToOne 1 100 0.00 65535.00 FORMAT "%8.2" ECU_ADDRESS 0x8FE5EC /end MEASUREMENT
/begin MEASUREMENT Dfp_CmbChbMisfire6_mp "Fehlerpfad Zündaussetzer in Zylinder 6" UWORD OneToOne 1 100 0.00 65535.00 FORMAT "%8.2" ECU_ADDRESS 0x8FE5EE /end MEASUREMENT
/begin MEASUREMENT Dfp_CmbChbMisfireMul_mp "Fehlerpfad Zündaussetzer in mehreren Zylindern" UWORD OneToOne 1 100 0.00 65535.00 FORMAT "%8.2" ECU_ADDRESS 0x8FE5F0 /end MEASUREMENT
/begin MEASUREMENT Dfp_ConvCD_mp "Messpunkt fuer Fehlerpfad  Dfp_ConvCD" UWORD OneToOne 1 100 0.00 65535.00 FORMAT "%8.2" ECU_ADDRESS 0x8FE5F2 /end MEASUREMENT
/begin MEASUREMENT Dfp_CoVMDCSh_mp "Fehlerpfade physikalische Unplausibilität der  Motorschlupfregelung" UWORD OneToOne 1 100 0.00 65535.00 FORMAT "%8.2" ECU_ADDRESS 0x8FE5F4 /end MEASUREMENT
/begin MEASUREMENT Dfp_CrCCDMFL_mp "Messpunkt fuer Fehlerpfad  Dfp_CrCCDMFL" UWORD OneToOne 1 100 0.00 65535.00 FORMAT "%8.2" ECU_ADDRESS 0x8FE5F6 /end MEASUREMENT
/begin MEASUREMENT Dfp_CrCtl_vCrCtl_mp "Erkennung gefilterte Offset-Geschwindigkeit über Grenze beim Stufentempomat" UWORD OneToOne 1 100 0.00 65535.00 FORMAT "%8.2" ECU_ADDRESS 0x8FE5F8 /end MEASUREMENT
/begin MEASUREMENT Dfp_CTSCD_mp "Messpunkt fuer Fehlerpfad  Dfp_CTSCD" UWORD OneToOne 1 100 0.00 65535.00 FORMAT "%8.2" ECU_ADDRESS 0x8FE5FA /end MEASUREMENT
/begin MEASUREMENT Dfp_Dummy1_mp "Messpunkt fuer Fehlerpfad  Dfp_Dummy1" UWORD OneToOne 1 100 0.00 65535.00 FORMAT "%8.2" ECU_ADDRESS 0x8FE5FC /end MEASUREMENT
/begin MEASUREMENT Dfp_EATSCD_mp "Messpunkt fuer Fehlerpfad  Dfp_EATSCD" UWORD OneToOne 1 100 0.00 65535.00 FORMAT "%8.2" ECU_ADDRESS 0x8FE5FE /end MEASUREMENT
/begin MEASUREMENT Dfp_EBAFCD_mp "Messpunkt fuer Fehlerpfad  Dfp_EBAFCD" UWORD OneToOne 1 100 0.00 65535.00 FORMAT "%8.2" ECU_ADDRESS 0x8FE600 /end MEASUREMENT
/begin MEASUREMENT Dfp_EBFCD_mp "Messpunkt fuer Fehlerpfad  Dfp_EBFCD" UWORD OneToOne 1 100 0.00 65535.00 FORMAT "%8.2" ECU_ADDRESS 0x8FE602 /end MEASUREMENT
/begin MEASUREMENT Dfp_EBTSCD_mp "Messpunkt fuer Fehlerpfad  Dfp_EBTSCD" UWORD OneToOne 1 100 0.00 65535.00 FORMAT "%8.2" ECU_ADDRESS 0x8FE604 /end MEASUREMENT
/begin MEASUREMENT Dfp_EBTSCD_OvrTemp_mp "Messpunkt fuer Fehlerpfad  Dfp_EBTSCD_OvrTemp" UWORD OneToOne 1 100 0.00 65535.00 FORMAT "%8.2" ECU_ADDRESS 0x8FE606 /end MEASUREMENT
/begin MEASUREMENT Dfp_EEPCDVarMng_mp "Messpunkt fuer Fehlerpfad  Dfp_EEPCDVarMng" UWORD OneToOne 1 100 0.00 65535.00 FORMAT "%8.2" ECU_ADDRESS 0x8FE608 /end MEASUREMENT
/begin MEASUREMENT Dfp_EGPpCDTPreTrbn_mp "Messpunkt fuer Fehlerpfad  Dfp_EgPpCD" UWORD OneToOne 1 100 0.00 65535.00 FORMAT "%8.2" ECU_ADDRESS 0x8FE60A /end MEASUREMENT
/begin MEASUREMENT Dfp_EGPpCD_mp "Messpunkt fuer Fehlerpfad  Dfp_EGPpCD" UWORD OneToOne 1 100 0.00 65535.00 FORMAT "%8.2" ECU_ADDRESS 0x8FE60C /end MEASUREMENT
/begin MEASUREMENT Dfp_EGRCD_Max_mp "Fehlerpfad für Kurzschluss nach Batteriespannung des Abgasrückführstellers" UWORD OneToOne 1 100 0.00 65535.00 FORMAT "%8.2" ECU_ADDRESS 0x8FE60E /end MEASUREMENT
/begin MEASUREMENT Dfp_EGRCD_Min_mp "Fehlerpfad für Kurzschluss nach Masse des Abgasrückführstellers" UWORD OneToOne 1 100 0.00 65535.00 FORMAT "%8.2" ECU_ADDRESS 0x8FE610 /end MEASUREMENT
/begin MEASUREMENT Dfp_EGRCD_SigNpl_mp "Fehlerpfad für Lastabfall und Übertemperatur des Abgasrückführstellers" UWORD OneToOne 1 100 0.00 65535.00 FORMAT "%8.2" ECU_ADDRESS 0x8FE612 /end MEASUREMENT
/begin MEASUREMENT Dfp_EGTRgnOilDil_mp "Fehlerpfad maximale Zeit für Ölverdünnung überschritten" UWORD OneToOne 1 100 0.00 65535.00 FORMAT "%8.2" ECU_ADDRESS 0x8FE614 /end MEASUREMENT
/begin MEASUREMENT Dfp_EngMCaS1_mp "Meßpunkt für Fehlerpfad Dfp_EngMCaS1" UWORD OneToOne 1 100 0.00 65535.00 FORMAT "%8.2" ECU_ADDRESS 0x8FE616 /end MEASUREMENT
/begin MEASUREMENT Dfp_EngMCrS1_mp "Meßpunkt für Fehlerpfad Dfp_EngMCrS1" UWORD OneToOne 1 100 0.00 65535.00 FORMAT "%8.2" ECU_ADDRESS 0x8FE618 /end MEASUREMENT
/begin MEASUREMENT Dfp_EngMntCtl1_Dia1_mp "" UWORD OneToOne 1 100 0.00 65535.00 FORMAT "%8.2" ECU_ADDRESS 0x8FE61A /end MEASUREMENT
/begin MEASUREMENT Dfp_EngMntCtl1_Dia2_mp "" UWORD OneToOne 1 100 0.00 65535.00 FORMAT "%8.2" ECU_ADDRESS 0x8FE61C /end MEASUREMENT
/begin MEASUREMENT Dfp_EngMntCtl1_Dia3_mp "" UWORD OneToOne 1 100 0.00 65535.00 FORMAT "%8.2" ECU_ADDRESS 0x8FE61E /end MEASUREMENT
/begin MEASUREMENT Dfp_EngMntCtl1_Max_mp "" UWORD OneToOne 1 100 0.00 65535.00 FORMAT "%8.2" ECU_ADDRESS 0x8FE620 /end MEASUREMENT
/begin MEASUREMENT Dfp_EngMntCtl1_Min_mp "" UWORD OneToOne 1 100 0.00 65535.00 FORMAT "%8.2" ECU_ADDRESS 0x8FE622 /end MEASUREMENT
/begin MEASUREMENT Dfp_EngMntCtl1_SigNpl_mp "" UWORD OneToOne 1 100 0.00 65535.00 FORMAT "%8.2" ECU_ADDRESS 0x8FE624 /end MEASUREMENT
/begin MEASUREMENT Dfp_EngMntCtlCD_mp "Messpunkt fuer Fehlerpfad  Dfp_EngMntCtlCD" UWORD OneToOne 1 100 0.00 65535.00 FORMAT "%8.2" ECU_ADDRESS 0x8FE626 /end MEASUREMENT
/begin MEASUREMENT Dfp_EngMntCtl_Dia1_mp "" UWORD OneToOne 1 100 0.00 65535.00 FORMAT "%8.2" ECU_ADDRESS 0x8FE628 /end MEASUREMENT
/begin MEASUREMENT Dfp_EngMntCtl_Dia2_mp "" UWORD OneToOne 1 100 0.00 65535.00 FORMAT "%8.2" ECU_ADDRESS 0x8FE62A /end MEASUREMENT
/begin MEASUREMENT Dfp_EngMntCtl_Dia3_mp "" UWORD OneToOne 1 100 0.00 65535.00 FORMAT "%8.2" ECU_ADDRESS 0x8FE62C /end MEASUREMENT
/begin MEASUREMENT Dfp_EngMntCtl_Max_mp "" UWORD OneToOne 1 100 0.00 65535.00 FORMAT "%8.2" ECU_ADDRESS 0x8FE62E /end MEASUREMENT
/begin MEASUREMENT Dfp_EngMntCtl_Min_mp "" UWORD OneToOne 1 100 0.00 65535.00 FORMAT "%8.2" ECU_ADDRESS 0x8FE630 /end MEASUREMENT
/begin MEASUREMENT Dfp_EngMntCtl_SigNpl_mp "" UWORD OneToOne 1 100 0.00 65535.00 FORMAT "%8.2" ECU_ADDRESS 0x8FE632 /end MEASUREMENT
/begin MEASUREMENT Dfp_EngMOfsCaSCrS_mp "Meßpunkt fuer Fehlerpfad Dfp_EngMOfsCaSCrS" UWORD OneToOne 1 100 0.00 65535.00 FORMAT "%8.2" ECU_ADDRESS 0x8FE634 /end MEASUREMENT
/begin MEASUREMENT Dfp_EngPrtFWODet_mp "Messpunkt fuer Fehlerpfad  Dfp_EngPrtFWODet" UWORD OneToOne 1 100 0.00 65535.00 FORMAT "%8.2" ECU_ADDRESS 0x8FE636 /end MEASUREMENT
/begin MEASUREMENT Dfp_ETClbETFltInj1_mp "Messpunkt fuer Fehlerpfad  Dfp_ETClbETFltInj1" UWORD OneToOne 1 100 0.00 65535.00 FORMAT "%8.2" ECU_ADDRESS 0x8FE638 /end MEASUREMENT
/begin MEASUREMENT Dfp_ETClbETFltInj2_mp "Messpunkt fuer Fehlerpfad  Dfp_ETClbETFltInj2" UWORD OneToOne 1 100 0.00 65535.00 FORMAT "%8.2" ECU_ADDRESS 0x8FE63A /end MEASUREMENT
/begin MEASUREMENT Dfp_ETClbETFltInj3_mp "Messpunkt fuer Fehlerpfad  Dfp_ETClbETFltInj3" UWORD OneToOne 1 100 0.00 65535.00 FORMAT "%8.2" ECU_ADDRESS 0x8FE63C /end MEASUREMENT
/begin MEASUREMENT Dfp_ETClbETFltInj4_mp "Messpunkt fuer Fehlerpfad  Dfp_ETClbETFltInj4" UWORD OneToOne 1 100 0.00 65535.00 FORMAT "%8.2" ECU_ADDRESS 0x8FE63E /end MEASUREMENT
/begin MEASUREMENT Dfp_ETClbETFltInj5_mp "Messpunkt fuer Fehlerpfad  Dfp_ETClbETFltInj5" UWORD OneToOne 1 100 0.00 65535.00 FORMAT "%8.2" ECU_ADDRESS 0x8FE640 /end MEASUREMENT
/begin MEASUREMENT Dfp_ETClbETFltInj6_mp "Messpunkt fuer Fehlerpfad  Dfp_ETClbETFltInj6" UWORD OneToOne 1 100 0.00 65535.00 FORMAT "%8.2" ECU_ADDRESS 0x8FE642 /end MEASUREMENT
/begin MEASUREMENT Dfp_ETClbInj1_mp "Messpunkt fuer Fehlerpfad  Dfp_ETClbInj1" UWORD OneToOne 1 100 0.00 65535.00 FORMAT "%8.2" ECU_ADDRESS 0x8FE644 /end MEASUREMENT
/begin MEASUREMENT Dfp_ETClbInj2_mp "Messpunkt fuer Fehlerpfad  Dfp_ETClbInj2" UWORD OneToOne 1 100 0.00 65535.00 FORMAT "%8.2" ECU_ADDRESS 0x8FE646 /end MEASUREMENT
/begin MEASUREMENT Dfp_ETClbInj3_mp "Messpunkt fuer Fehlerpfad  Dfp_ETClbInj3" UWORD OneToOne 1 100 0.00 65535.00 FORMAT "%8.2" ECU_ADDRESS 0x8FE648 /end MEASUREMENT
/begin MEASUREMENT Dfp_ETClbInj4_mp "Messpunkt fuer Fehlerpfad  Dfp_ETClbInj4" UWORD OneToOne 1 100 0.00 65535.00 FORMAT "%8.2" ECU_ADDRESS 0x8FE64A /end MEASUREMENT
/begin MEASUREMENT Dfp_ETClbInj5_mp "Messpunkt fuer Fehlerpfad  Dfp_ETClbInj5" UWORD OneToOne 1 100 0.00 65535.00 FORMAT "%8.2" ECU_ADDRESS 0x8FE64C /end MEASUREMENT
/begin MEASUREMENT Dfp_ETClbInj6_mp "Messpunkt fuer Fehlerpfad  Dfp_ETClbInj6" UWORD OneToOne 1 100 0.00 65535.00 FORMAT "%8.2" ECU_ADDRESS 0x8FE64E /end MEASUREMENT
/begin MEASUREMENT Dfp_FanCD_FanCtlr1_mp "Messpunkt fuer Fehlerpfad  Dfp_FanCD_FanCtlr1" UWORD OneToOne 1 100 0.00 65535.00 FORMAT "%8.2" ECU_ADDRESS 0x8FE650 /end MEASUREMENT
/begin MEASUREMENT Dfp_FanCD_FanCtlr2_mp "Messpunkt fuer Fehlerpfad  Dfp_FanCD_FanCtlr2" UWORD OneToOne 1 100 0.00 65535.00 FORMAT "%8.2" ECU_ADDRESS 0x8FE652 /end MEASUREMENT
/begin MEASUREMENT Dfp_FanCD_FanCtlr3_mp "Messpunkt fuer Fehlerpfad  Dfp_FanCD_FanCtlr3" UWORD OneToOne 1 100 0.00 65535.00 FORMAT "%8.2" ECU_ADDRESS 0x8FE654 /end MEASUREMENT
/begin MEASUREMENT Dfp_FanCD_mp "Fehlerpfad signalisiert Fehler in der Zuleitung zum Lüfter" UWORD OneToOne 1 100 0.00 65535.00 FORMAT "%8.2" ECU_ADDRESS 0x8FE656 /end MEASUREMENT
/begin MEASUREMENT Dfp_FBCqDvt_mp "Messpunkt fuer Fehlerpfad  Dfp_FBCqDvt" UWORD OneToOne 1 100 0.00 65535.00 FORMAT "%8.2" ECU_ADDRESS 0x8FE658 /end MEASUREMENT
/begin MEASUREMENT Dfp_FlFCD_mp "Messpunkt fuer Fehlerpfad  Dfp_FlFCD" UWORD OneToOne 1 100 0.00 65535.00 FORMAT "%8.2" ECU_ADDRESS 0x8FE65A /end MEASUREMENT
/begin MEASUREMENT Dfp_FlMngSmkDefect_mp "Messpunkt fuer Fehlerpfad  Dfp_FlMngSmkDefect" UWORD OneToOne 1 100 0.00 65535.00 FORMAT "%8.2" ECU_ADDRESS 0x8FE65C /end MEASUREMENT
/begin MEASUREMENT Dfp_FMTC_NonMonotonMap_mp "Prüfung Monotonie der Mengenstützpunkte über Moment in FMTC_trq2qBas_MAP" UWORD OneToOne 1 100 0.00 65535.00 FORMAT "%8.2" ECU_ADDRESS 0x8FE65E /end MEASUREMENT
/begin MEASUREMENT Dfp_FrmMngBOS_RESET_2_mp "Messpunkt fuer Fehlerpfad  Dfp_FrmMngBOS_RESET_2" UWORD OneToOne 1 100 0.00 65535.00 FORMAT "%8.2" ECU_ADDRESS 0x8FE660 /end MEASUREMENT
/begin MEASUREMENT Dfp_FrmMngBOS_RESET_mp "BOS_RESET - CAN-message related errors" UWORD OneToOne 1 100 0.00 65535.00 FORMAT "%8.2" ECU_ADDRESS 0x8FE662 /end MEASUREMENT
/begin MEASUREMENT Dfp_FrmMngDMANFAFS_mp "Messpunkt fuer Fehlerpfad  Dfp_FrmMngDMANFAFS" UWORD OneToOne 1 100 0.00 65535.00 FORMAT "%8.2" ECU_ADDRESS 0x8FE664 /end MEASUREMENT
/begin MEASUREMENT Dfp_FrmMngDRMANFSSG_mp "Messpunkt fuer Fehlerpfad  Dfp_FrmMngDRMANFSSG" UWORD OneToOne 1 100 0.00 65535.00 FORMAT "%8.2" ECU_ADDRESS 0x8FE666 /end MEASUREMENT
/begin MEASUREMENT Dfp_FrmMngGEARBX_DATA2_mp "Messpunkt fuer Fehlerpfad  Dfp_FrmMngGEARBX_DATA2" UWORD OneToOne 1 100 0.00 65535.00 FORMAT "%8.2" ECU_ADDRESS 0x8FE668 /end MEASUREMENT
/begin MEASUREMENT Dfp_FrmMngGEARBX_DATA_mp "GEARBX_DATA CAN12h-message related faults" UWORD OneToOne 1 100 0.00 65535.00 FORMAT "%8.2" ECU_ADDRESS 0x8FE66A /end MEASUREMENT
/begin MEASUREMENT Dfp_FrmMngHEAT_AC_mp "HEAT_AC CAN12h-message related faults" UWORD OneToOne 1 100 0.00 65535.00 FORMAT "%8.2" ECU_ADDRESS 0x8FE66C /end MEASUREMENT
/begin MEASUREMENT Dfp_FrmMngLENKRADWINKEL_mp "Messpunkt fuer Fehlerpfad  Dfp_FrmMngLENKRADWINKEL" UWORD OneToOne 1 100 0.00 65535.00 FORMAT "%8.2" ECU_ADDRESS 0x8FE66E /end MEASUREMENT
/begin MEASUREMENT Dfp_FrmMngMILEAGE_RANGE_mp "Messpunkt fuer Fehlerpfad  Dfp_FrmMngMILEAGE_RANGE" UWORD OneToOne 1 100 0.00 65535.00 FORMAT "%8.2" ECU_ADDRESS 0x8FE670 /end MEASUREMENT
/begin MEASUREMENT Dfp_FrmMngOPCRCTLACC_mp "Messpunkt fuer Fehlerpfad  Dfp_FrmMngOPCRCTLACC" UWORD OneToOne 1 100 0.00 65535.00 FORMAT "%8.2" ECU_ADDRESS 0x8FE672 /end MEASUREMENT
/begin MEASUREMENT Dfp_FrmMngParkConsumer_mp "Messpunkt fuer Fehlerpfad  Dfp_FrmMngParkConsumer" UWORD OneToOne 1 100 0.00 65535.00 FORMAT "%8.2" ECU_ADDRESS 0x8FE674 /end MEASUREMENT
/begin MEASUREMENT Dfp_FrmMngPRGG_CCTR_mp "Messpunkt fuer Fehlerpfad  Dfp_FrmMngPRGG_CCTR" UWORD OneToOne 1 100 0.00 65535.00 FORMAT "%8.2" ECU_ADDRESS 0x8FE676 /end MEASUREMENT
/begin MEASUREMENT Dfp_FrmMngPWRMNG_LOADV_mp "Messpunkt fuer Fehlerpfad  Dfp_FrmMngPWRMNG_LOADV" UWORD OneToOne 1 100 0.00 65535.00 FORMAT "%8.2" ECU_ADDRESS 0x8FE678 /end MEASUREMENT
/begin MEASUREMENT Dfp_FrmMngRQSTGEFAN_mp "RQ_STG_EFAN - CAN-message related errors" UWORD OneToOne 1 100 0.00 65535.00 FORMAT "%8.2" ECU_ADDRESS 0x8FE67A /end MEASUREMENT
/begin MEASUREMENT Dfp_FrmMngSSGErr_mp "Messpunkt fuer Fehlerpfad  Dfp_FrmMngSSGErr" UWORD OneToOne 1 100 0.00 65535.00 FORMAT "%8.2" ECU_ADDRESS 0x8FE67C /end MEASUREMENT
/begin MEASUREMENT Dfp_FrmMngSSGShOff_mp "Messpunkt fuer Fehlerpfad  Dfp_FrmMngSSGShOff" UWORD OneToOne 1 100 0.00 65535.00 FORMAT "%8.2" ECU_ADDRESS 0x8FE67E /end MEASUREMENT
/begin MEASUREMENT Dfp_FrmMngSTAT_ANH_mp "Messpunkt fuer Fehlerpfad  Dfp_FrmMngSTAT_ANH" UWORD OneToOne 1 100 0.00 65535.00 FORMAT "%8.2" ECU_ADDRESS 0x8FE680 /end MEASUREMENT
/begin MEASUREMENT Dfp_FrmMngSTAT_ARS_mp "STAT_ARS CAN12h-message related faults" UWORD OneToOne 1 100 0.00 65535.00 FORMAT "%8.2" ECU_ADDRESS 0x8FE682 /end MEASUREMENT
/begin MEASUREMENT Dfp_FrmMngSTAT_DSC_mp "STAT_DSC CAN12h-message related faults" UWORD OneToOne 1 100 0.00 65535.00 FORMAT "%8.2" ECU_ADDRESS 0x8FE684 /end MEASUREMENT
/begin MEASUREMENT Dfp_FrmMngSTAT_EKP_mp "Fehlerpfad für STAT_EKP" UWORD OneToOne 1 100 0.00 65535.00 FORMAT "%8.2" ECU_ADDRESS 0x8FE686 /end MEASUREMENT
/begin MEASUREMENT Dfp_FrmMngSTAT_KOMBI_mp "STAT_KOMBI - CAN-message related errors" UWORD OneToOne 1 100 0.00 65535.00 FORMAT "%8.2" ECU_ADDRESS 0x8FE688 /end MEASUREMENT
/begin MEASUREMENT Dfp_FrmMngSTAT_SITZ_mp "Defect fault path for STAT_SITZBELEGUNG_GURT - CAN-message related errors" UWORD OneToOne 1 100 0.00 65535.00 FORMAT "%8.2" ECU_ADDRESS 0x8FE68A /end MEASUREMENT
/begin MEASUREMENT Dfp_FrmMngstCurr_mp "Messpunkt für Dfp von FrmMng_stCurr Botschaft" UWORD OneToOne 1 100 0.00 65535.00 FORMAT "%8.2" ECU_ADDRESS 0x8FE68C /end MEASUREMENT
/begin MEASUREMENT Dfp_FrmMngStOBDGbxMilOf_mp "error path of Gear Box MIL OFF" UWORD OneToOne 1 100 0.00 65535.00 FORMAT "%8.2" ECU_ADDRESS 0x8FE68E /end MEASUREMENT
/begin MEASUREMENT Dfp_FrmMngStOBDGbxMilOn_mp "error path of Gear Box MIL ON" UWORD OneToOne 1 100 0.00 65535.00 FORMAT "%8.2" ECU_ADDRESS 0x8FE690 /end MEASUREMENT
/begin MEASUREMENT Dfp_FrmMngswtPSPOff_mp "Messpunkt für Dfp von FrmMng_swtPSPOff Botschaft" UWORD OneToOne 1 100 0.00 65535.00 FORMAT "%8.2" ECU_ADDRESS 0x8FE692 /end MEASUREMENT
/begin MEASUREMENT Dfp_FrmMngTEMPRELTIME_mp "A_TEMP_RELATIVZEIT - CAN-message related errors" UWORD OneToOne 1 100 0.00 65535.00 FORMAT "%8.2" ECU_ADDRESS 0x8FE694 /end MEASUREMENT
/begin MEASUREMENT Dfp_FrmMngTERMINAL_mp "TERMINAL CAN12h-message related faults" UWORD OneToOne 1 100 0.00 65535.00 FORMAT "%8.2" ECU_ADDRESS 0x8FE696 /end MEASUREMENT
/begin MEASUREMENT Dfp_FrmMngTIME_DATE_mp "Messpunkt fuer Fehlerpfad  Dfp_FrmMngTIME_DATE" UWORD OneToOne 1 100 0.00 65535.00 FORMAT "%8.2" ECU_ADDRESS 0x8FE698 /end MEASUREMENT
/begin MEASUREMENT Dfp_FrmMngTORQUE_DSC_mp "TORQUE_DSC CAN12h-message related faults" UWORD OneToOne 1 100 0.00 65535.00 FORMAT "%8.2" ECU_ADDRESS 0x8FE69A /end MEASUREMENT
/begin MEASUREMENT Dfp_FrmMngTORQUE_GEARBX_mp "TORQUE_GEARBX CAN12h-message related faults" UWORD OneToOne 1 100 0.00 65535.00 FORMAT "%8.2" ECU_ADDRESS 0x8FE69C /end MEASUREMENT
/begin MEASUREMENT Dfp_FrmMngTrq_ReqACC_mp "Messpunkt fuer Fehlerpfad  Dfp_FrmMngTrq_ReqACC" UWORD OneToOne 1 100 0.00 65535.00 FORMAT "%8.2" ECU_ADDRESS 0x8FE69E /end MEASUREMENT
/begin MEASUREMENT Dfp_FrmMngVEH_MOD_mp "VEH_MOD - CAN-message related errors" UWORD OneToOne 1 100 0.00 65535.00 FORMAT "%8.2" ECU_ADDRESS 0x8FE6A0 /end MEASUREMENT
/begin MEASUREMENT Dfp_FrmMngVELOCITY_mp "VELOCITY CAN12h-message related faults" UWORD OneToOne 1 100 0.00 65535.00 FORMAT "%8.2" ECU_ADDRESS 0x8FE6A2 /end MEASUREMENT
/begin MEASUREMENT Dfp_FrmMngWHEEL_SPEED_mp "WHEEL_SPEED - CAN-message related errors" UWORD OneToOne 1 100 0.00 65535.00 FORMAT "%8.2" ECU_ADDRESS 0x8FE6A4 /end MEASUREMENT
/begin MEASUREMENT Dfp_FTSCD_mp "Messpunkt fuer Fehlerpfad  Dfp_FTSCD" UWORD OneToOne 1 100 0.00 65535.00 FORMAT "%8.2" ECU_ADDRESS 0x8FE6A6 /end MEASUREMENT
/begin MEASUREMENT Dfp_GearbxIncMax_mp "Fehlerpfad  physikalische Unplausibilität des erhöhenden Getriebeeingriffs" UWORD OneToOne 1 100 0.00 65535.00 FORMAT "%8.2" ECU_ADDRESS 0x8FE6A8 /end MEASUREMENT
/begin MEASUREMENT Dfp_GlwCDGlwCirc1_mp "Messpunkt fuer Fehlerpfad  Dfp_GlwCDGlwCirc1" UWORD OneToOne 1 100 0.00 65535.00 FORMAT "%8.2" ECU_ADDRESS 0x8FE6AA /end MEASUREMENT
/begin MEASUREMENT Dfp_GlwCDGlwCirc2_mp "Messpunkt fuer Fehlerpfad  Dfp_GlwCDGlwCirc2" UWORD OneToOne 1 100 0.00 65535.00 FORMAT "%8.2" ECU_ADDRESS 0x8FE6AC /end MEASUREMENT
/begin MEASUREMENT Dfp_GlwCDGlwCirc3_mp "Messpunkt fuer Fehlerpfad  Dfp_GlwCDGlwCirc3" UWORD OneToOne 1 100 0.00 65535.00 FORMAT "%8.2" ECU_ADDRESS 0x8FE6AE /end MEASUREMENT
/begin MEASUREMENT Dfp_GlwCDGlwCirc4_mp "Messpunkt fuer Fehlerpfad  Dfp_GlwCDGlwCirc4" UWORD OneToOne 1 100 0.00 65535.00 FORMAT "%8.2" ECU_ADDRESS 0x8FE6B0 /end MEASUREMENT
/begin MEASUREMENT Dfp_GlwCDGlwCirc5_mp "Messpunkt fuer Fehlerpfad  Dfp_GlwCDGlwCirc5" UWORD OneToOne 1 100 0.00 65535.00 FORMAT "%8.2" ECU_ADDRESS 0x8FE6B2 /end MEASUREMENT
/begin MEASUREMENT Dfp_GlwCDGlwCirc6_mp "Messpunkt fuer Fehlerpfad  Dfp_GlwCDGlwCirc6" UWORD OneToOne 1 100 0.00 65535.00 FORMAT "%8.2" ECU_ADDRESS 0x8FE6B4 /end MEASUREMENT
/begin MEASUREMENT Dfp_GlwCDGlwCirc7_mp "Messpunkt fuer Fehlerpfad  Dfp_GlwCDGlwCirc7" UWORD OneToOne 1 100 0.00 65535.00 FORMAT "%8.2" ECU_ADDRESS 0x8FE6B6 /end MEASUREMENT
/begin MEASUREMENT Dfp_GlwCDGlwCirc8_mp "Messpunkt fuer Fehlerpfad  Dfp_GlwCDGlwCirc8" UWORD OneToOne 1 100 0.00 65535.00 FORMAT "%8.2" ECU_ADDRESS 0x8FE6B8 /end MEASUREMENT
/begin MEASUREMENT Dfp_GlwCD_mp "Messpunkt fuer Fehlerpfad  Dfp_GlwCD" UWORD OneToOne 1 100 0.00 65535.00 FORMAT "%8.2" ECU_ADDRESS 0x8FE6BA /end MEASUREMENT
/begin MEASUREMENT Dfp_GlwCtl_mp "Glüh-Steuerungs-Rückmeldungs-Fehler" UWORD OneToOne 1 100 0.00 65535.00 FORMAT "%8.2" ECU_ADDRESS 0x8FE6BC /end MEASUREMENT
/begin MEASUREMENT Dfp_HWEMonCom_mp "Messpunkt fuer Fehlerpfad  Dfp_HWEMonCom" UWORD OneToOne 1 100 0.00 65535.00 FORMAT "%8.2" ECU_ADDRESS 0x8FE6BE /end MEASUREMENT
/begin MEASUREMENT Dfp_HWEMonEEPROM_mp "Messpunkt fuer Fehlerpfad  Dfp_HWEMonEEPROM" UWORD OneToOne 1 100 0.00 65535.00 FORMAT "%8.2" ECU_ADDRESS 0x8FE6C0 /end MEASUREMENT
/begin MEASUREMENT Dfp_HWEMonRcyLocked_mp "Messpunkt fuer Fehlerpfad  Dfp_HWEMonRcyLocked" UWORD OneToOne 1 100 0.00 65535.00 FORMAT "%8.2" ECU_ADDRESS 0x8FE6C2 /end MEASUREMENT
/begin MEASUREMENT Dfp_HWEMonRcySuppressed_mp "Messpunkt fuer Fehlerpfad  Dfp_HWEMonRcySuppressed" UWORD OneToOne 1 100 0.00 65535.00 FORMAT "%8.2" ECU_ADDRESS 0x8FE6C4 /end MEASUREMENT
/begin MEASUREMENT Dfp_HWEMonRcyVisible_mp "Messpunkt fuer Fehlerpfad  Dfp_HWEMonRcyVisible" UWORD OneToOne 1 100 0.00 65535.00 FORMAT "%8.2" ECU_ADDRESS 0x8FE6C6 /end MEASUREMENT
/begin MEASUREMENT Dfp_HWEMonUMaxSupply_mp "Messpunkt fuer Fehlerpfad  Dfp_HWEMonUMaxSupply" UWORD OneToOne 1 100 0.00 65535.00 FORMAT "%8.2" ECU_ADDRESS 0x8FE6C8 /end MEASUREMENT
/begin MEASUREMENT Dfp_HWEMonUMinSupply_mp "Messpunkt fuer Fehlerpfad  Dfp_HWEMonUMinSupply" UWORD OneToOne 1 100 0.00 65535.00 FORMAT "%8.2" ECU_ADDRESS 0x8FE6CA /end MEASUREMENT
/begin MEASUREMENT Dfp_IATSCD_CATS_mp "Fehlerpfad Ladelufttemperaturwert nach Ladeluftkühler" UWORD OneToOne 1 100 0.00 65535.00 FORMAT "%8.2" ECU_ADDRESS 0x8FE6CC /end MEASUREMENT
/begin MEASUREMENT Dfp_IATSCD_mp "Messpunkt fuer Fehlerpfad  Dfp_IATSCD" UWORD OneToOne 1 100 0.00 65535.00 FORMAT "%8.2" ECU_ADDRESS 0x8FE6CE /end MEASUREMENT
/begin MEASUREMENT Dfp_ImmCtlImmCD_mp "Messpunkt fuer Fehlerpfad  Dfp_ImmCtlImmCD" UWORD OneToOne 1 100 0.00 65535.00 FORMAT "%8.2" ECU_ADDRESS 0x8FE6D0 /end MEASUREMENT
/begin MEASUREMENT Dfp_ImmCtlImmEep_mp "Messpunkt fuer Fehlerpfad  Dfp_ImmCtlImmEep" UWORD OneToOne 1 100 0.00 65535.00 FORMAT "%8.2" ECU_ADDRESS 0x8FE6D2 /end MEASUREMENT
/begin MEASUREMENT Dfp_ImmCtlMpl_mp "Messpunkt fuer Fehlerpfad  Dfp_ImmCtlMpl" UWORD OneToOne 1 100 0.00 65535.00 FORMAT "%8.2" ECU_ADDRESS 0x8FE6D4 /end MEASUREMENT
/begin MEASUREMENT Dfp_IndSys1_mp "IndSys1 defect path" UWORD OneToOne 1 100 0.00 65535.00 FORMAT "%8.2" ECU_ADDRESS 0x8FE6D6 /end MEASUREMENT
/begin MEASUREMENT Dfp_IndSys2_mp "IndSys2 defect path" UWORD OneToOne 1 100 0.00 65535.00 FORMAT "%8.2" ECU_ADDRESS 0x8FE6D8 /end MEASUREMENT
/begin MEASUREMENT Dfp_InjCrv_InjLim_mp "Messpunkt fuer Fehlerpfad Dfp_InjCrv_InjLim" UWORD OneToOne 1 100 0.00 65535.00 FORMAT "%8.2" ECU_ADDRESS 0x8FE6DA /end MEASUREMENT
/begin MEASUREMENT Dfp_InjCtlAdjQnt_mp "Messpunkt fuer Fehlerpfad  Dfp_InjCtlAdjQnt" UWORD OneToOne 1 100 0.00 65535.00 FORMAT "%8.2" ECU_ADDRESS 0x8FE6DC /end MEASUREMENT
/begin MEASUREMENT Dfp_InjCtlDrift_mp "Messpunkt fuer Fehlerpfad  Dfp_InjCtlDrift" UWORD OneToOne 1 100 0.00 65535.00 FORMAT "%8.2" ECU_ADDRESS 0x8FE6DE /end MEASUREMENT
/begin MEASUREMENT Dfp_InjVCDActrChrg_mp "Messpunkt fuer Fehlerpfad  Dfp_InjVCDActrChrg" UWORD OneToOne 1 100 0.00 65535.00 FORMAT "%8.2" ECU_ADDRESS 0x8FE6E0 /end MEASUREMENT
/begin MEASUREMENT Dfp_InjVCDActrEnrg1_mp "Messpunkt fuer Fehlerpfad  Dfp_InjVCDActrEnrg1" UWORD OneToOne 1 100 0.00 65535.00 FORMAT "%8.2" ECU_ADDRESS 0x8FE6E2 /end MEASUREMENT
/begin MEASUREMENT Dfp_InjVCDActrEnrg2_mp "Messpunkt fuer Fehlerpfad  Dfp_InjVCDActrEnrg2" UWORD OneToOne 1 100 0.00 65535.00 FORMAT "%8.2" ECU_ADDRESS 0x8FE6E4 /end MEASUREMENT
/begin MEASUREMENT Dfp_InjVCDActrEnrg3_mp "Messpunkt fuer Fehlerpfad  Dfp_InjVCDActrEnrg3" UWORD OneToOne 1 100 0.00 65535.00 FORMAT "%8.2" ECU_ADDRESS 0x8FE6E6 /end MEASUREMENT
/begin MEASUREMENT Dfp_InjVCDActrEnrg4_mp "Messpunkt fuer Fehlerpfad  Dfp_InjVCDActrEnrg4" UWORD OneToOne 1 100 0.00 65535.00 FORMAT "%8.2" ECU_ADDRESS 0x8FE6E8 /end MEASUREMENT
/begin MEASUREMENT Dfp_InjVCDActrEnrg5_mp "Messpunkt fuer Fehlerpfad  Dfp_InjVCDActrEnrg5" UWORD OneToOne 1 100 0.00 65535.00 FORMAT "%8.2" ECU_ADDRESS 0x8FE6EA /end MEASUREMENT
/begin MEASUREMENT Dfp_InjVCDActrEnrg6_mp "Messpunkt fuer Fehlerpfad  Dfp_InjVCDActrEnrg6" UWORD OneToOne 1 100 0.00 65535.00 FORMAT "%8.2" ECU_ADDRESS 0x8FE6EC /end MEASUREMENT
/begin MEASUREMENT Dfp_InjVCDActrEnrg7_mp "Messpunkt fuer Fehlerpfad  Dfp_InjVCDActrEnrg7" UWORD OneToOne 1 100 0.00 65535.00 FORMAT "%8.2" ECU_ADDRESS 0x8FE6EE /end MEASUREMENT
/begin MEASUREMENT Dfp_InjVCDActrEnrg8_mp "Messpunkt fuer Fehlerpfad  Dfp_InjVCDActrEnrg8" UWORD OneToOne 1 100 0.00 65535.00 FORMAT "%8.2" ECU_ADDRESS 0x8FE6F0 /end MEASUREMENT
/begin MEASUREMENT Dfp_InjVCDActrVolt_mp "Messpunkt fuer Fehlerpfad  Dfp_InjVCDActrVolt" UWORD OneToOne 1 100 0.00 65535.00 FORMAT "%8.2" ECU_ADDRESS 0x8FE6F2 /end MEASUREMENT
/begin MEASUREMENT Dfp_InjVCDClsBank1_mp "Messpunkt fuer Fehlerpfad  Dfp_InjVCDClsBank1" UWORD OneToOne 1 100 0.00 65535.00 FORMAT "%8.2" ECU_ADDRESS 0x8FE6F4 /end MEASUREMENT
/begin MEASUREMENT Dfp_InjVCDClsBank2_mp "Messpunkt fuer Fehlerpfad  Dfp_InjVCDClsBank2" UWORD OneToOne 1 100 0.00 65535.00 FORMAT "%8.2" ECU_ADDRESS 0x8FE6F6 /end MEASUREMENT
/begin MEASUREMENT Dfp_InjVCDMonCab_mp "Messpunkt fuer Fehlerpfad  Dfp_InjVCDMonCab" UWORD OneToOne 1 100 0.00 65535.00 FORMAT "%8.2" ECU_ADDRESS 0x8FE6F8 /end MEASUREMENT
/begin MEASUREMENT Dfp_InjVCDMonSwt_mp "Messpunkt fuer Fehlerpfad  Dfp_InjVCDMonSwt" UWORD OneToOne 1 100 0.00 65535.00 FORMAT "%8.2" ECU_ADDRESS 0x8FE6FA /end MEASUREMENT
/begin MEASUREMENT Dfp_InjVCDShOffDCDC_mp "Fehlerpfad ""Ladeschalterkurzschluss""" UWORD OneToOne 1 100 0.00 65535.00 FORMAT "%8.2" ECU_ADDRESS 0x8FE6FC /end MEASUREMENT
/begin MEASUREMENT Dfp_InjVCDUBuf_mp "Messpunkt fuer Fehlerpfad  Dfp_InjVCDUBuf" UWORD OneToOne 1 100 0.00 65535.00 FORMAT "%8.2" ECU_ADDRESS 0x8FE6FE /end MEASUREMENT
/begin MEASUREMENT Dfp_InjVCD_CY370Ampl_mp "Fehlerpfad für Verstärkerabgleich vom CY370" UWORD OneToOne 1 100 0.00 65535.00 FORMAT "%8.2" ECU_ADDRESS 0x8FE700 /end MEASUREMENT
/begin MEASUREMENT Dfp_InjVlvBnk1A_mp "A Fehlerpfad für Bank 1" UWORD OneToOne 1 100 0.00 65535.00 FORMAT "%8.2" ECU_ADDRESS 0x8FE702 /end MEASUREMENT
/begin MEASUREMENT Dfp_InjVlvBnk1B_mp "B Fehlerpfad für Bank 1" UWORD OneToOne 1 100 0.00 65535.00 FORMAT "%8.2" ECU_ADDRESS 0x8FE704 /end MEASUREMENT
/begin MEASUREMENT Dfp_InjVlvBnk2A_mp "A Fehlerpfad für Bank 2" UWORD OneToOne 1 100 0.00 65535.00 FORMAT "%8.2" ECU_ADDRESS 0x8FE706 /end MEASUREMENT
/begin MEASUREMENT Dfp_InjVlvBnk2B_mp "B Fehlerpfad für Bank 2" UWORD OneToOne 1 100 0.00 65535.00 FORMAT "%8.2" ECU_ADDRESS 0x8FE708 /end MEASUREMENT
/begin MEASUREMENT Dfp_InjVlvChipA_mp "A Fehlerpfad  für Baustein" UWORD OneToOne 1 100 0.00 65535.00 FORMAT "%8.2" ECU_ADDRESS 0x8FE70A /end MEASUREMENT
/begin MEASUREMENT Dfp_InjVlvChipB_mp "B Fehlerpfad für Baustein" UWORD OneToOne 1 100 0.00 65535.00 FORMAT "%8.2" ECU_ADDRESS 0x8FE70C /end MEASUREMENT
/begin MEASUREMENT Dfp_InjVlvCyl1A_mp "A Fehlerpfad  für Zylinder 1" UWORD OneToOne 1 100 0.00 65535.00 FORMAT "%8.2" ECU_ADDRESS 0x8FE70E /end MEASUREMENT
/begin MEASUREMENT Dfp_InjVlvCyl1B_mp "B Fehlerpfad  für Zylinder 1" UWORD OneToOne 1 100 0.00 65535.00 FORMAT "%8.2" ECU_ADDRESS 0x8FE710 /end MEASUREMENT
/begin MEASUREMENT Dfp_InjVlvCyl1C_mp "Messpunkt fuer Fehlerpfad  Dfp_InjVlvCyl1C" UWORD OneToOne 1 100 0.00 65535.00 FORMAT "%8.2" ECU_ADDRESS 0x8FE712 /end MEASUREMENT
/begin MEASUREMENT Dfp_InjVlvCyl2A_mp "A Fehlerpfad  für Zylinder 2" UWORD OneToOne 1 100 0.00 65535.00 FORMAT "%8.2" ECU_ADDRESS 0x8FE714 /end MEASUREMENT
/begin MEASUREMENT Dfp_InjVlvCyl2B_mp "B Fehlerpfad  für Zylinder 2" UWORD OneToOne 1 100 0.00 65535.00 FORMAT "%8.2" ECU_ADDRESS 0x8FE716 /end MEASUREMENT
/begin MEASUREMENT Dfp_InjVlvCyl2C_mp "Messpunkt fuer Fehlerpfad  Dfp_InjVlvCyl2C" UWORD OneToOne 1 100 0.00 65535.00 FORMAT "%8.2" ECU_ADDRESS 0x8FE718 /end MEASUREMENT
/begin MEASUREMENT Dfp_InjVlvCyl3A_mp "A Fehlerpfad  für Zylinder 3" UWORD OneToOne 1 100 0.00 65535.00 FORMAT "%8.2" ECU_ADDRESS 0x8FE71A /end MEASUREMENT
/begin MEASUREMENT Dfp_InjVlvCyl3B_mp "B Fehlerpfad  für Zylinder 3" UWORD OneToOne 1 100 0.00 65535.00 FORMAT "%8.2" ECU_ADDRESS 0x8FE71C /end MEASUREMENT
/begin MEASUREMENT Dfp_InjVlvCyl3C_mp "Messpunkt fuer Fehlerpfad  Dfp_InjVlvCyl3C" UWORD OneToOne 1 100 0.00 65535.00 FORMAT "%8.2" ECU_ADDRESS 0x8FE71E /end MEASUREMENT
/begin MEASUREMENT Dfp_InjVlvCyl4A_mp "A Fehlerpfad  für Zylinder 4" UWORD OneToOne 1 100 0.00 65535.00 FORMAT "%8.2" ECU_ADDRESS 0x8FE720 /end MEASUREMENT
/begin MEASUREMENT Dfp_InjVlvCyl4B_mp "B Fehlerpfad  für Zylinder 4" UWORD OneToOne 1 100 0.00 65535.00 FORMAT "%8.2" ECU_ADDRESS 0x8FE722 /end MEASUREMENT
/begin MEASUREMENT Dfp_InjVlvCyl4C_mp "Messpunkt fuer Fehlerpfad  Dfp_InjVlvCyl4C" UWORD OneToOne 1 100 0.00 65535.00 FORMAT "%8.2" ECU_ADDRESS 0x8FE724 /end MEASUREMENT
/begin MEASUREMENT Dfp_InjVlvCyl5A_mp "A Fehlerpfad  für Zylinder 5" UWORD OneToOne 1 100 0.00 65535.00 FORMAT "%8.2" ECU_ADDRESS 0x8FE726 /end MEASUREMENT
/begin MEASUREMENT Dfp_InjVlvCyl5B_mp "B Fehlerpfad  für Zylinder 5" UWORD OneToOne 1 100 0.00 65535.00 FORMAT "%8.2" ECU_ADDRESS 0x8FE728 /end MEASUREMENT
/begin MEASUREMENT Dfp_InjVlvCyl5C_mp "Messpunkt fuer Fehlerpfad  Dfp_InjVlvCyl5C" UWORD OneToOne 1 100 0.00 65535.00 FORMAT "%8.2" ECU_ADDRESS 0x8FE72A /end MEASUREMENT
/begin MEASUREMENT Dfp_InjVlvCyl6A_mp "A Fehlerpfad  für Zylinder 6" UWORD OneToOne 1 100 0.00 65535.00 FORMAT "%8.2" ECU_ADDRESS 0x8FE72C /end MEASUREMENT
/begin MEASUREMENT Dfp_InjVlvCyl6B_mp "B Fehlerpfad  für Zylinder 6" UWORD OneToOne 1 100 0.00 65535.00 FORMAT "%8.2" ECU_ADDRESS 0x8FE72E /end MEASUREMENT
/begin MEASUREMENT Dfp_InjVlvCyl6C_mp "Messpunkt fuer Fehlerpfad  Dfp_InjVlvCyl6C" UWORD OneToOne 1 100 0.00 65535.00 FORMAT "%8.2" ECU_ADDRESS 0x8FE730 /end MEASUREMENT
/begin MEASUREMENT Dfp_InjVlvCyl7A_mp "A Fehlerpfad  für Zylinder 7" UWORD OneToOne 1 100 0.00 65535.00 FORMAT "%8.2" ECU_ADDRESS 0x8FE732 /end MEASUREMENT
/begin MEASUREMENT Dfp_InjVlvCyl7B_mp "B Fehlerpfad  für Zylinder 7" UWORD OneToOne 1 100 0.00 65535.00 FORMAT "%8.2" ECU_ADDRESS 0x8FE734 /end MEASUREMENT
/begin MEASUREMENT Dfp_InjVlvCyl7C_mp "Messpunkt fuer Fehlerpfad  Dfp_InjVlvCyl7C" UWORD OneToOne 1 100 0.00 65535.00 FORMAT "%8.2" ECU_ADDRESS 0x8FE736 /end MEASUREMENT
/begin MEASUREMENT Dfp_InjVlvCyl8A_mp "A Fehlerpfad  für Zylinder 8" UWORD OneToOne 1 100 0.00 65535.00 FORMAT "%8.2" ECU_ADDRESS 0x8FE738 /end MEASUREMENT
/begin MEASUREMENT Dfp_InjVlvCyl8B_mp "B Fehlerpfad  für Zylinder 8" UWORD OneToOne 1 100 0.00 65535.00 FORMAT "%8.2" ECU_ADDRESS 0x8FE73A /end MEASUREMENT
/begin MEASUREMENT Dfp_InjVlvCyl8C_mp "Messpunkt fuer Fehlerpfad  Dfp_InjVlvCyl8C" UWORD OneToOne 1 100 0.00 65535.00 FORMAT "%8.2" ECU_ADDRESS 0x8FE73C /end MEASUREMENT
/begin MEASUREMENT Dfp_InjVlvNVC1_mp "Messpunkt für Fehlerpfad Dfp_InjVlvNVC1" UWORD OneToOne 1 100 0.00 65535.00 FORMAT "%8.2" ECU_ADDRESS 0x8FE73E /end MEASUREMENT
/begin MEASUREMENT Dfp_InjVlvNVC2_mp "Messpunkt für Fehlerpfad Dfp_InjVlvNVC2" UWORD OneToOne 1 100 0.00 65535.00 FORMAT "%8.2" ECU_ADDRESS 0x8FE740 /end MEASUREMENT
/begin MEASUREMENT Dfp_InjVlvNVC3_mp "Messpunkt für Fehlerpfad Dfp_InjVlvNVC3" UWORD OneToOne 1 100 0.00 65535.00 FORMAT "%8.2" ECU_ADDRESS 0x8FE742 /end MEASUREMENT
/begin MEASUREMENT Dfp_InjVlvNVC4_mp "Messpunkt für Fehlerpfad Dfp_InjVlvNVC4" UWORD OneToOne 1 100 0.00 65535.00 FORMAT "%8.2" ECU_ADDRESS 0x8FE744 /end MEASUREMENT
/begin MEASUREMENT Dfp_InjVlvNVC5_mp "Messpunkt für Fehlerpfad Dfp_InjVlvNVC5" UWORD OneToOne 1 100 0.00 65535.00 FORMAT "%8.2" ECU_ADDRESS 0x8FE746 /end MEASUREMENT
/begin MEASUREMENT Dfp_InjVlvNVC6_mp "Messpunkt für Fehlerpfad Dfp_InjVlvNVC6" UWORD OneToOne 1 100 0.00 65535.00 FORMAT "%8.2" ECU_ADDRESS 0x8FE748 /end MEASUREMENT
/begin MEASUREMENT Dfp_InjVlvNVC7_mp "Messpunkt für Fehlerpfad Dfp_InjVlvNVC7" UWORD OneToOne 1 100 0.00 65535.00 FORMAT "%8.2" ECU_ADDRESS 0x8FE74A /end MEASUREMENT
/begin MEASUREMENT Dfp_InjVlvNVC8_mp "Messpunkt für Fehlerpfad Dfp_InjVlvNVC8" UWORD OneToOne 1 100 0.00 65535.00 FORMAT "%8.2" ECU_ADDRESS 0x8FE74C /end MEASUREMENT
/begin MEASUREMENT Dfp_Layer_BSD_mp "Messpunkt fuer Fehlerpfad  Dfp_Layer_BSD" UWORD OneToOne 1 100 0.00 65535.00 FORMAT "%8.2" ECU_ADDRESS 0x8FE74E /end MEASUREMENT
/begin MEASUREMENT Dfp_Layer_GEN_mp "Messpunkt fuer Fehlerpfad  Dfp_Layer_GEN" UWORD OneToOne 1 100 0.00 65535.00 FORMAT "%8.2" ECU_ADDRESS 0x8FE750 /end MEASUREMENT
/begin MEASUREMENT Dfp_Layer_IBS1_mp "Messpunkt fuer Fehlerpfad  Dfp_Layer_IBS1" UWORD OneToOne 1 100 0.00 65535.00 FORMAT "%8.2" ECU_ADDRESS 0x8FE752 /end MEASUREMENT
/begin MEASUREMENT Dfp_Layer_IBS2_mp "Messpunkt fuer Fehlerpfad  Dfp_Layer_IBS2" UWORD OneToOne 1 100 0.00 65535.00 FORMAT "%8.2" ECU_ADDRESS 0x8FE754 /end MEASUREMENT
/begin MEASUREMENT Dfp_Layer_IBS3_mp "Messpunkt fuer Fehlerpfad  Dfp_Layer_IBS3" UWORD OneToOne 1 100 0.00 65535.00 FORMAT "%8.2" ECU_ADDRESS 0x8FE756 /end MEASUREMENT
/begin MEASUREMENT Dfp_Layer_MANHYDR_mp "" UWORD OneToOne 1 100 0.00 65535.00 FORMAT "%8.2" ECU_ADDRESS 0x8FE758 /end MEASUREMENT
/begin MEASUREMENT Dfp_Layer_MANLUFT_mp "" UWORD OneToOne 1 100 0.00 65535.00 FORMAT "%8.2" ECU_ADDRESS 0x8FE75A /end MEASUREMENT
/begin MEASUREMENT Dfp_Layer_PMBATT_mp "Messpunkt fuer Fehlerpfad  Dfp_Layer_PMBATT" UWORD OneToOne 1 100 0.00 65535.00 FORMAT "%8.2" ECU_ADDRESS 0x8FE75C /end MEASUREMENT
/begin MEASUREMENT Dfp_Layer_PMBN_mp "Messpunkt fuer Fehlerpfad  Dfp_Layer_PMBN" UWORD OneToOne 1 100 0.00 65535.00 FORMAT "%8.2" ECU_ADDRESS 0x8FE75E /end MEASUREMENT
/begin MEASUREMENT Dfp_Layer_PMRUHVERL_mp "" UWORD OneToOne 1 100 0.00 65535.00 FORMAT "%8.2" ECU_ADDRESS 0x8FE760 /end MEASUREMENT
/begin MEASUREMENT Dfp_Layer_QLT_mp "Messpunkt fuer Fehlerpfad  Dfp_Layer_QLT" UWORD OneToOne 1 100 0.00 65535.00 FORMAT "%8.2" ECU_ADDRESS 0x8FE762 /end MEASUREMENT
/begin MEASUREMENT Dfp_Layer_TANS_mp "Messpunkt fuer Fehlerpfad  Dfp_Layer_TANS" UWORD OneToOne 1 100 0.00 65535.00 FORMAT "%8.2" ECU_ADDRESS 0x8FE764 /end MEASUREMENT
/begin MEASUREMENT Dfp_Layer_TOENS_mp "" UWORD OneToOne 1 100 0.00 65535.00 FORMAT "%8.2" ECU_ADDRESS 0x8FE766 /end MEASUREMENT
/begin MEASUREMENT Dfp_Layer_TUMG_mp "Messpunkt fuer Fehlerpfad  Dfp_Layer_TUMG" UWORD OneToOne 1 100 0.00 65535.00 FORMAT "%8.2" ECU_ADDRESS 0x8FE768 /end MEASUREMENT
/begin MEASUREMENT Dfp_LPACD_Max_mp "Messpunkt fuer Fehlerpfad  Dfp_LPACD_Max" UWORD OneToOne 1 100 0.00 65535.00 FORMAT "%8.2" ECU_ADDRESS 0x8FE76A /end MEASUREMENT
/begin MEASUREMENT Dfp_LPACD_Min_mp "Messpunkt fuer Fehlerpfad  Dfp_LPACD_Min" UWORD OneToOne 1 100 0.00 65535.00 FORMAT "%8.2" ECU_ADDRESS 0x8FE76C /end MEASUREMENT
/begin MEASUREMENT Dfp_LPACD_SigNpl_mp "Messpunkt fuer Fehlerpfad  Dfp_LPACD_SigNpl" UWORD OneToOne 1 100 0.00 65535.00 FORMAT "%8.2" ECU_ADDRESS 0x8FE76E /end MEASUREMENT
/begin MEASUREMENT Dfp_LSUCDCircNernst0_mp "Messpunkt fuer Fehlerpfad  Dfp_LSUCDCircNernst0" UWORD OneToOne 1 100 0.00 65535.00 FORMAT "%8.2" ECU_ADDRESS 0x8FE770 /end MEASUREMENT
/begin MEASUREMENT Dfp_LSUCDCircPumpCur0_mp "Messpunkt fuer Fehlerpfad  Dfp_LSUCDCircPumpCur0" UWORD OneToOne 1 100 0.00 65535.00 FORMAT "%8.2" ECU_ADDRESS 0x8FE772 /end MEASUREMENT
/begin MEASUREMENT Dfp_LSUCDCircVirtGnd0_mp "Messpunkt fuer Fehlerpfad  Dfp_LSUCDCircVirtGnd0" UWORD OneToOne 1 100 0.00 65535.00 FORMAT "%8.2" ECU_ADDRESS 0x8FE774 /end MEASUREMENT
/begin MEASUREMENT Dfp_LSUCDHeater0_mp "Messpunkt fuer Fehlerpfad  Dfp_LSUCDHeater0" UWORD OneToOne 1 100 0.00 65535.00 FORMAT "%8.2" ECU_ADDRESS 0x8FE776 /end MEASUREMENT
/begin MEASUREMENT Dfp_LSUCDHtCoup0_mp "Messpunkt fuer Fehlerpfad  Dfp_LSUCDHtCoup0" UWORD OneToOne 1 100 0.00 65535.00 FORMAT "%8.2" ECU_ADDRESS 0x8FE778 /end MEASUREMENT
/begin MEASUREMENT Dfp_LSUCDO20_mp "Messpunkt fuer Fehlerpfad  Dfp_LSUCDO20" UWORD OneToOne 1 100 0.00 65535.00 FORMAT "%8.2" ECU_ADDRESS 0x8FE77A /end MEASUREMENT
/begin MEASUREMENT Dfp_LSUCDO2Clb0_mp "Messpunkt fuer Fehlerpfad  Dfp_LSUCDO2Clb0" UWORD OneToOne 1 100 0.00 65535.00 FORMAT "%8.2" ECU_ADDRESS 0x8FE77C /end MEASUREMENT
/begin MEASUREMENT Dfp_LSUCDRiClb0_mp "Messpunkt fuer Fehlerpfad  Dfp_LSUCDRiClb0" UWORD OneToOne 1 100 0.00 65535.00 FORMAT "%8.2" ECU_ADDRESS 0x8FE77E /end MEASUREMENT
/begin MEASUREMENT Dfp_LSUCDSPI0_mp "Messpunkt fuer Fehlerpfad  Dfp_LSUCDSPI0" UWORD OneToOne 1 100 0.00 65535.00 FORMAT "%8.2" ECU_ADDRESS 0x8FE780 /end MEASUREMENT
/begin MEASUREMENT Dfp_LSUCDSPIBattLow0_mp "Fehlerpfad für niedrige Batteriespannung" UWORD OneToOne 1 100 0.00 65535.00 FORMAT "%8.2" ECU_ADDRESS 0x8FE782 /end MEASUREMENT
/begin MEASUREMENT Dfp_LSUCDWireIP0_mp "Messpunkt fuer Fehlerpfad  Dfp_LSUCDWireIP0" UWORD OneToOne 1 100 0.00 65535.00 FORMAT "%8.2" ECU_ADDRESS 0x8FE784 /end MEASUREMENT
/begin MEASUREMENT Dfp_LSUCtlRiExc0_mp "Messpunkt fuer Fehlerpfad  Dfp_LSUCtlRiExc0" UWORD OneToOne 1 100 0.00 65535.00 FORMAT "%8.2" ECU_ADDRESS 0x8FE786 /end MEASUREMENT
/begin MEASUREMENT Dfp_LSUMon1Sens_mp "Messpunkt fuer Fehlerpfad  Dfp_LSUMon1Sens" UWORD OneToOne 1 100 0.00 65535.00 FORMAT "%8.2" ECU_ADDRESS 0x8FE788 /end MEASUREMENT
/begin MEASUREMENT Dfp_LSUMon2Sens_mp "Messpunkt fuer Fehlerpfad  Dfp_LSUMon2Sens" UWORD OneToOne 1 100 0.00 65535.00 FORMAT "%8.2" ECU_ADDRESS 0x8FE78A /end MEASUREMENT
/begin MEASUREMENT Dfp_LubCD_mp "Fehlerpfad LubCD (Motorölkombinationsgeber)" UWORD OneToOne 1 100 0.00 65535.00 FORMAT "%8.2" ECU_ADDRESS 0x8FE78C /end MEASUREMENT
/begin MEASUREMENT Dfp_MeUnCDNoLoad_mp "Fehlerpfad für Lastabfall der Zumesseinheit" UWORD OneToOne 1 100 0.00 65535.00 FORMAT "%8.2" ECU_ADDRESS 0x8FE78E /end MEASUREMENT
/begin MEASUREMENT Dfp_MeUnCDSCBat_mp "Fehlerpfad für Kurzschluss zur Batteriespannung der Zumesseinheit" UWORD OneToOne 1 100 0.00 65535.00 FORMAT "%8.2" ECU_ADDRESS 0x8FE790 /end MEASUREMENT
/begin MEASUREMENT Dfp_MeUnCDSCGnd_mp "Fehlerpfad für Kurzschluss nach Masse der Zumesseinheit" UWORD OneToOne 1 100 0.00 65535.00 FORMAT "%8.2" ECU_ADDRESS 0x8FE792 /end MEASUREMENT
/begin MEASUREMENT Dfp_MeUnCD_ADC_mp "Fehlerpfad für die Signalerfassung des Stroms durch die Zumesseinheit" UWORD OneToOne 1 100 0.00 65535.00 FORMAT "%8.2" ECU_ADDRESS 0x8FE794 /end MEASUREMENT
/begin MEASUREMENT Dfp_MeUnCD_SigTst_mp "Messpunkt fuer Fehlerpfad  Dfp_MeUnCD_SigTst" UWORD OneToOne 1 100 0.00 65535.00 FORMAT "%8.2" ECU_ADDRESS 0x8FE796 /end MEASUREMENT
/begin MEASUREMENT Dfp_MIL_mp "Messpunkt fuer Fehlerpfad  Dfp_MIL" UWORD OneToOne 1 100 0.00 65535.00 FORMAT "%8.2" ECU_ADDRESS 0x8FE798 /end MEASUREMENT
/begin MEASUREMENT Dfp_Montr_mp "Messpunkt fuer Fehlerpfad  Dfp_Montr" UWORD OneToOne 1 100 0.00 65535.00 FORMAT "%8.2" ECU_ADDRESS 0x8FE79A /end MEASUREMENT
/begin MEASUREMENT Dfp_MRlyCD_mp "Messpunkt fuer Fehlerpfad  Dfp_MRlyCD" UWORD OneToOne 1 100 0.00 65535.00 FORMAT "%8.2" ECU_ADDRESS 0x8FE79C /end MEASUREMENT
/begin MEASUREMENT Dfp_MSidCD_Comm_mp "Messpunkt fuer Fehlerpfad  Dfp_MSidCD_Comm" UWORD OneToOne 1 100 0.00 65535.00 FORMAT "%8.2" ECU_ADDRESS 0x8FE79E /end MEASUREMENT
/begin MEASUREMENT Dfp_MSidCD_Pin_mp "Messpunkt fuer Fehlerpfad  Dfp_MSidCD_Pin" UWORD OneToOne 1 100 0.00 65535.00 FORMAT "%8.2" ECU_ADDRESS 0x8FE7A0 /end MEASUREMENT
/begin MEASUREMENT Dfp_MSidCD_Select_mp "Messpunkt fuer Fehlerpfad  Dfp_MSidCD_Select" UWORD OneToOne 1 100 0.00 65535.00 FORMAT "%8.2" ECU_ADDRESS 0x8FE7A2 /end MEASUREMENT
/begin MEASUREMENT Dfp_MSidCD_Sel_INI_mp "Messpunkt fuer Fehlerpfad  Dfp_MSidCD_Sel_INI" UWORD OneToOne 1 100 0.00 65535.00 FORMAT "%8.2" ECU_ADDRESS 0x8FE7A4 /end MEASUREMENT
/begin MEASUREMENT Dfp_NetMngDeviceA_mp "Fehlerpfad für CAN Baustein A" UWORD OneToOne 1 100 0.00 65535.00 FORMAT "%8.2" ECU_ADDRESS 0x8FE7A6 /end MEASUREMENT
/begin MEASUREMENT Dfp_NetMngDeviceB_mp "Fehlerpfad für CAN Baustein B" UWORD OneToOne 1 100 0.00 65535.00 FORMAT "%8.2" ECU_ADDRESS 0x8FE7A8 /end MEASUREMENT
/begin MEASUREMENT Dfp_NetMngDeviceC_mp "Messpunkt fuer Fehlerpfad  Dfp_NetMngDeviceC" UWORD OneToOne 1 100 0.00 65535.00 FORMAT "%8.2" ECU_ADDRESS 0x8FE7AA /end MEASUREMENT
/begin MEASUREMENT Dfp_OPSCD_anain_mp "Messpunkt fuer Fehlerpfad  Dfp_OPSCD_anain" UWORD OneToOne 1 100 0.00 65535.00 FORMAT "%8.2" ECU_ADDRESS 0x8FE7AC /end MEASUREMENT
/begin MEASUREMENT Dfp_OPSCD_Lamp_mp "Fehlerpfad Endstufenfehler Öllampe" UWORD OneToOne 1 100 0.00 65535.00 FORMAT "%8.2" ECU_ADDRESS 0x8FE7AE /end MEASUREMENT
/begin MEASUREMENT Dfp_OTSCD_mp "Fehlerpfad Öltemperaturwert" UWORD OneToOne 1 100 0.00 65535.00 FORMAT "%8.2" ECU_ADDRESS 0x8FE7B0 /end MEASUREMENT
/begin MEASUREMENT Dfp_OvRMonBrk_mp "measurment point for fault path Dfp_OvRMonBrk" UWORD OneToOne 1 100 0.00 65535.00 FORMAT "%8.2" ECU_ADDRESS 0x8FE7B2 /end MEASUREMENT
/begin MEASUREMENT Dfp_OvRMonSigA_mp "Fehlerpfad für Drehzahlplausibilisierung in der Schubüberwachung" UWORD OneToOne 1 100 0.00 65535.00 FORMAT "%8.2" ECU_ADDRESS 0x8FE7B4 /end MEASUREMENT
/begin MEASUREMENT Dfp_OvRMon_mp "Messpunkt fuer Fehlerpfad  Dfp_OvRMon" UWORD OneToOne 1 100 0.00 65535.00 FORMAT "%8.2" ECU_ADDRESS 0x8FE7B6 /end MEASUREMENT
/begin MEASUREMENT Dfp_OxiCCDTPre_mp "Messpunkt fuer Fehlerpfad  Dfp_OxiCCDTPre" UWORD OneToOne 1 100 0.00 65535.00 FORMAT "%8.2" ECU_ADDRESS 0x8FE7B8 /end MEASUREMENT
/begin MEASUREMENT Dfp_PCR_GovDevNeg_mp "Messpunkt fuer Fehlerpfad  Dfp_PCR_GovDevNeg" UWORD OneToOne 1 100 0.00 65535.00 FORMAT "%8.2" ECU_ADDRESS 0x8FE7BA /end MEASUREMENT
/begin MEASUREMENT Dfp_PCR_GovDevPos_mp "Messpunkt fuer Fehlerpfad  Dfp_PCR_GovDevPos" UWORD OneToOne 1 100 0.00 65535.00 FORMAT "%8.2" ECU_ADDRESS 0x8FE7BC /end MEASUREMENT
/begin MEASUREMENT Dfp_PCVCDNoLoad_mp "Messpunkt fuer Fehlerpfad Lastabfall des Druckregelventils" UWORD OneToOne 1 100 0.00 65535.00 FORMAT "%8.2" ECU_ADDRESS 0x8FE7BE /end MEASUREMENT
/begin MEASUREMENT Dfp_PCVCDSCBat_mp "Messpunkt für Fehlerpfad Kurzschluss zur Batteriespannung des Druckregelventils" UWORD OneToOne 1 100 0.00 65535.00 FORMAT "%8.2" ECU_ADDRESS 0x8FE7C0 /end MEASUREMENT
/begin MEASUREMENT Dfp_PCVCDSCGnd_mp "Messpunkt für Fehlerpfad Kurzschluss nach Masse des Druckregelventils" UWORD OneToOne 1 100 0.00 65535.00 FORMAT "%8.2" ECU_ADDRESS 0x8FE7C2 /end MEASUREMENT
/begin MEASUREMENT Dfp_PCVCD_ADC_mp "Messpunkt fuer Fehlerpfad  Dfp_PCVCD_ADC" UWORD OneToOne 1 100 0.00 65535.00 FORMAT "%8.2" ECU_ADDRESS 0x8FE7C4 /end MEASUREMENT
/begin MEASUREMENT Dfp_PCVCD_SigTst_mp "Messpunkt fuer Fehlerpfad  Dfp_PCVCD_SigTst" UWORD OneToOne 1 100 0.00 65535.00 FORMAT "%8.2" ECU_ADDRESS 0x8FE7C6 /end MEASUREMENT
/begin MEASUREMENT Dfp_PFltAPSens_mp "Fehlerfad für Atmosphärendrucksensor" UWORD OneToOne 1 100 0.00 65535.00 FORMAT "%8.2" ECU_ADDRESS 0x8FE7C8 /end MEASUREMENT
/begin MEASUREMENT Dfp_PFltCDPPre_mp "Messpunkt fuer Fehlerpfad  Dfp_PFltCDPPre" UWORD OneToOne 1 100 0.00 65535.00 FORMAT "%8.2" ECU_ADDRESS 0x8FE7CA /end MEASUREMENT
/begin MEASUREMENT Dfp_PFltCDTempPre_mp "Fehlerpfad der Abgastemperatur vor dem Partikelfilter" UWORD OneToOne 1 100 0.00 65535.00 FORMAT "%8.2" ECU_ADDRESS 0x8FE7CC /end MEASUREMENT
/begin MEASUREMENT Dfp_PFltChar_mp "Digitaler Fehlerpfad für Fliesswiderstand Partikelfilter" UWORD OneToOne 1 100 0.00 65535.00 FORMAT "%8.2" ECU_ADDRESS 0x8FE7CE /end MEASUREMENT
/begin MEASUREMENT Dfp_PFltEngPrt_mp "Messpunkt fuer Fehlerpfad  Dfp_PFltEngPrt" UWORD OneToOne 1 100 0.00 65535.00 FORMAT "%8.2" ECU_ADDRESS 0x8FE7D0 /end MEASUREMENT
/begin MEASUREMENT Dfp_PFltmSotDiffMax_mp "Messpunkt fuer Fehlerpfad  Dfp_PFltmSotDiffMax" UWORD OneToOne 1 100 0.00 65535.00 FORMAT "%8.2" ECU_ADDRESS 0x8FE7D2 /end MEASUREMENT
/begin MEASUREMENT Dfp_PFltPresDynPlaus_mp "Messpunkt fuer Fehlerpfad  Dfp_PFltPresDynPlaus" UWORD OneToOne 1 100 0.00 65535.00 FORMAT "%8.2" ECU_ADDRESS 0x8FE7D4 /end MEASUREMENT
/begin MEASUREMENT Dfp_PFltPresSensFrz_mp "Messpunkt fuer Fehlerpfad  Dfp_PFltPresSensFrz" UWORD OneToOne 1 100 0.00 65535.00 FORMAT "%8.2" ECU_ADDRESS 0x8FE7D6 /end MEASUREMENT
/begin MEASUREMENT Dfp_PFltPresSensHsLn_mp "Messpunkt fuer Fehlerpfad  Dfp_PFltPresSensHsLn" UWORD OneToOne 1 100 0.00 65535.00 FORMAT "%8.2" ECU_ADDRESS 0x8FE7D8 /end MEASUREMENT
/begin MEASUREMENT Dfp_PFltPresSensSot_mp "Messpunkt fuer Fehlerpfad  Dfp_PFltPresSensSot" UWORD OneToOne 1 100 0.00 65535.00 FORMAT "%8.2" ECU_ADDRESS 0x8FE7DA /end MEASUREMENT
/begin MEASUREMENT Dfp_PFltPresSens_mp "Messpunkt fuer Fehlerpfad  Dfp_PFltPresSens" UWORD OneToOne 1 100 0.00 65535.00 FORMAT "%8.2" ECU_ADDRESS 0x8FE7DC /end MEASUREMENT
/begin MEASUREMENT Dfp_PFltRgnPerm_mp "Messpunkt fuer Fehlerpfad  Dfp_PFltRgnPerm" UWORD OneToOne 1 100 0.00 65535.00 FORMAT "%8.2" ECU_ADDRESS 0x8FE7DE /end MEASUREMENT
/begin MEASUREMENT Dfp_PFltTempDwnStrm_mp "Digitaler Fehlerpfad für zweiten Abgastemperatursensor" UWORD OneToOne 1 100 0.00 65535.00 FORMAT "%8.2" ECU_ADDRESS 0x8FE7E0 /end MEASUREMENT
/begin MEASUREMENT Dfp_PFltTempSens_mp "Messpunkt fuer Fehlerpfad  Dfp_PFltTempSens" UWORD OneToOne 1 100 0.00 65535.00 FORMAT "%8.2" ECU_ADDRESS 0x8FE7E2 /end MEASUREMENT
/begin MEASUREMENT Dfp_PFltTempUpStrm_mp "Digitaler Fehlerpfad für ersten Abgastemperatursensor" UWORD OneToOne 1 100 0.00 65535.00 FORMAT "%8.2" ECU_ADDRESS 0x8FE7E4 /end MEASUREMENT
/begin MEASUREMENT Dfp_QLTCD_mp "Messpunkt fuer Fehlerpfad  Dfp_QLTCD" UWORD OneToOne 1 100 0.00 65535.00 FORMAT "%8.2" ECU_ADDRESS 0x8FE7E6 /end MEASUREMENT
/begin MEASUREMENT Dfp_RailCDOfsTst_mp "Fehlerpfad für Offset-Überwachung des Raildrucksensors" UWORD OneToOne 1 100 0.00 65535.00 FORMAT "%8.2" ECU_ADDRESS 0x8FE7E8 /end MEASUREMENT
/begin MEASUREMENT Dfp_RailCD_mp "Messpunkt fuer Fehlerpfad  Dfp_RailCD" UWORD OneToOne 1 100 0.00 65535.00 FORMAT "%8.2" ECU_ADDRESS 0x8FE7EA /end MEASUREMENT
/begin MEASUREMENT Dfp_RailCD_PMonStrt_mp "Messpunkt fuer Fehlerpfad  Dfp_RailCD_PMonStrt" UWORD OneToOne 1 100 0.00 65535.00 FORMAT "%8.2" ECU_ADDRESS 0x8FE7EC /end MEASUREMENT
/begin MEASUREMENT Dfp_RailCtlModeMeUnDiag_mp "Messpunkt fuer Fehlerpfad  Dfp_RailCtlModeMeUnDiag" UWORD OneToOne 1 100 0.00 65535.00 FORMAT "%8.2" ECU_ADDRESS 0x8FE7EE /end MEASUREMENT
/begin MEASUREMENT Dfp_RailCtlModePCVDiag_mp "Messpunkt fuer Fehlerpfad  Dfp_RailCtlModePCVDiag" UWORD OneToOne 1 100 0.00 65535.00 FORMAT "%8.2" ECU_ADDRESS 0x8FE7F0 /end MEASUREMENT
/begin MEASUREMENT Dfp_RailMeUn0_mp "Fehlerpfad für Überwachung auf positive Regelabweichung" UWORD OneToOne 1 100 0.00 65535.00 FORMAT "%8.2" ECU_ADDRESS 0x8FE7F2 /end MEASUREMENT
/begin MEASUREMENT Dfp_RailMeUn1_mp "Fehlerpfad für Überwachung auf positive Regelabweichung und Sollwert des Volumenstroms durch die Zumesseinheit" UWORD OneToOne 1 100 0.00 65535.00 FORMAT "%8.2" ECU_ADDRESS 0x8FE7F4 /end MEASUREMENT
/begin MEASUREMENT Dfp_RailMeUn2_mp "Fehlerpfad für Überwachung auf negative Regelabweichung bei Nullförderung" UWORD OneToOne 1 100 0.00 65535.00 FORMAT "%8.2" ECU_ADDRESS 0x8FE7F6 /end MEASUREMENT
/begin MEASUREMENT Dfp_RailMeUn3_mp "Fehlerpfad für Überwachung auf minimalen Raildruck" UWORD OneToOne 1 100 0.00 65535.00 FORMAT "%8.2" ECU_ADDRESS 0x8FE7F8 /end MEASUREMENT
/begin MEASUREMENT Dfp_RailMeUn4_mp "Fehlerpfad für Überwachung auf maximalen Raildruck" UWORD OneToOne 1 100 0.00 65535.00 FORMAT "%8.2" ECU_ADDRESS 0x8FE7FA /end MEASUREMENT
/begin MEASUREMENT Dfp_RailPCV0_mp "Fehlerpfad für Überwachung auf positive Regelabweichung" UWORD OneToOne 1 100 0.00 65535.00 FORMAT "%8.2" ECU_ADDRESS 0x8FE7FC /end MEASUREMENT
/begin MEASUREMENT Dfp_RailPCV1_mp "Fehlerpfad für Überwachung auf positive Regelabweichung kombiniert mit Stellgröße des Druckregelventils" UWORD OneToOne 1 100 0.00 65535.00 FORMAT "%8.2" ECU_ADDRESS 0x8FE7FE /end MEASUREMENT
/begin MEASUREMENT Dfp_RailPCV2_mp "Fehlerpfad für Überwachung auf negative Regelabweichung kombiniert mit Stellgröße des Druckregelventils" UWORD OneToOne 1 100 0.00 65535.00 FORMAT "%8.2" ECU_ADDRESS 0x8FE800 /end MEASUREMENT
/begin MEASUREMENT Dfp_RailPCV3_mp "Fehlerpfad für Überwachung auf minimalen Raildruck" UWORD OneToOne 1 100 0.00 65535.00 FORMAT "%8.2" ECU_ADDRESS 0x8FE802 /end MEASUREMENT
/begin MEASUREMENT Dfp_RailPCV4_mp "Fehlerpfad für Überwachung auf maximalen Raildruck" UWORD OneToOne 1 100 0.00 65535.00 FORMAT "%8.2" ECU_ADDRESS 0x8FE804 /end MEASUREMENT
/begin MEASUREMENT Dfp_RailPCV5_mp "Fehlerpfad für Plausibilisierung des Raildrucks mit dem Strom durch das Druckregelventil" UWORD OneToOne 1 100 0.00 65535.00 FORMAT "%8.2" ECU_ADDRESS 0x8FE806 /end MEASUREMENT
/begin MEASUREMENT Dfp_RTMMon_mp "Messpunkt für den Fehlerpfad Dfp_RTMMon" UWORD OneToOne 1 100 0.00 65535.00 FORMAT "%8.2" ECU_ADDRESS 0x8FE808 /end MEASUREMENT
/begin MEASUREMENT Dfp_ShutCD_mp "Messpunkt fuer Fehlerpfad  Dfp_ShutCD" UWORD OneToOne 1 100 0.00 65535.00 FORMAT "%8.2" ECU_ADDRESS 0x8FE80A /end MEASUREMENT
/begin MEASUREMENT Dfp_SOPTst_mp "Messpunkt fuer Fehlerpfad  Dfp_SOPTst" UWORD OneToOne 1 100 0.00 65535.00 FORMAT "%8.2" ECU_ADDRESS 0x8FE80C /end MEASUREMENT
/begin MEASUREMENT Dfp_SSpMon1_mp "Meßpunkt des Fehlerpfades für Sensorversorgungsspannung 1" UWORD OneToOne 1 100 0.00 65535.00 FORMAT "%8.2" ECU_ADDRESS 0x8FE80E /end MEASUREMENT
/begin MEASUREMENT Dfp_SSpMon2_mp "Meßpunkt des Fehlerpfades für Sensorversorgungsspannung 2" UWORD OneToOne 1 100 0.00 65535.00 FORMAT "%8.2" ECU_ADDRESS 0x8FE810 /end MEASUREMENT
/begin MEASUREMENT Dfp_SSpMon3_mp "Meßpunkt des Fehlerpfades für Sensorversorgungsspannung 3" UWORD OneToOne 1 100 0.00 65535.00 FORMAT "%8.2" ECU_ADDRESS 0x8FE812 /end MEASUREMENT
/begin MEASUREMENT Dfp_StrtCD_Actr_mp "Fehlerpfad für Starterrelais Endstufe" UWORD OneToOne 1 100 0.00 65535.00 FORMAT "%8.2" ECU_ADDRESS 0x8FE814 /end MEASUREMENT
/begin MEASUREMENT Dfp_StSysTrqShutOff_mp "Zustand Fehlerpfad Start o. Kl.50" UWORD OneToOne 1 100 0.00 65535.00 FORMAT "%8.2" ECU_ADDRESS 0x8FE816 /end MEASUREMENT
/begin MEASUREMENT Dfp_SysLamp_mp "Messpunkt fuer Fehlerpfad  Dfp_SysLamp" UWORD OneToOne 1 100 0.00 65535.00 FORMAT "%8.2" ECU_ADDRESS 0x8FE818 /end MEASUREMENT
/begin MEASUREMENT Dfp_T15CD_mp "Messpunkt fuer Fehlerpfad  Dfp_T15CD" UWORD OneToOne 1 100 0.00 65535.00 FORMAT "%8.2" ECU_ADDRESS 0x8FE81A /end MEASUREMENT
/begin MEASUREMENT Dfp_TGearbx_mp "Messpunkt fuer Fehlerpfad  Dfp_TGearbx" UWORD OneToOne 1 100 0.00 65535.00 FORMAT "%8.2" ECU_ADDRESS 0x8FE81C /end MEASUREMENT
/begin MEASUREMENT Dfp_TPUMon_mp "Messpunkt fuer Fehlerpfad  Dfp_TPUMon" UWORD OneToOne 1 100 0.00 65535.00 FORMAT "%8.2" ECU_ADDRESS 0x8FE81E /end MEASUREMENT
/begin MEASUREMENT Dfp_TVACD_Max_mp "Fehlerpfad für Kurzschluss nach Batteriespannung des Drosselklappenstellers" UWORD OneToOne 1 100 0.00 65535.00 FORMAT "%8.2" ECU_ADDRESS 0x8FE820 /end MEASUREMENT
/begin MEASUREMENT Dfp_TVACD_Min_mp "Fehlerpfad für Kurzschluss nach Masse des Drosselklappenstellers" UWORD OneToOne 1 100 0.00 65535.00 FORMAT "%8.2" ECU_ADDRESS 0x8FE822 /end MEASUREMENT
/begin MEASUREMENT Dfp_TVACD_SigNpl_mp "Fehlerpfad für Lastabfall und Übertemperatur des Drosselklappenstellers" UWORD OneToOne 1 100 0.00 65535.00 FORMAT "%8.2" ECU_ADDRESS 0x8FE824 /end MEASUREMENT
/begin MEASUREMENT Dfp_TVACD_TVADia1_mp "Messpunkt für Fehlerpfad Dfp_TVACD_TVADia1" UWORD OneToOne 1 100 0.00 65535.00 FORMAT "%8.2" ECU_ADDRESS 0x8FE826 /end MEASUREMENT
/begin MEASUREMENT Dfp_TVACD_TVADia2_mp "Messpunkt für Fehlerpfad Dfp_TVACD_TVADia2" UWORD OneToOne 1 100 0.00 65535.00 FORMAT "%8.2" ECU_ADDRESS 0x8FE828 /end MEASUREMENT
/begin MEASUREMENT Dfp_TVACD_TVADia3_mp "Messpunkt für Fehlerpfad Dfp_TVACD_TVADia3" UWORD OneToOne 1 100 0.00 65535.00 FORMAT "%8.2" ECU_ADDRESS 0x8FE82A /end MEASUREMENT
/begin MEASUREMENT Dfp_VSACD_Max_mp "Fehlerpfad für Kurzschluss nach Batteriespannung des Drallniveaustellers" UWORD OneToOne 1 100 0.00 65535.00 FORMAT "%8.2" ECU_ADDRESS 0x8FE82C /end MEASUREMENT
/begin MEASUREMENT Dfp_VSACD_Min_mp "Fehlerpfad für Kurzschluss nach Masse des Drallniveaustellers" UWORD OneToOne 1 100 0.00 65535.00 FORMAT "%8.2" ECU_ADDRESS 0x8FE82E /end MEASUREMENT
/begin MEASUREMENT Dfp_VSACD_SigNpl_mp "Fehlerpfad für Lastabfall und Übertemperatur des Drallniveaustellers" UWORD OneToOne 1 100 0.00 65535.00 FORMAT "%8.2" ECU_ADDRESS 0x8FE830 /end MEASUREMENT
/begin MEASUREMENT Dfp_VSACD_VSADia1_mp "Messpunkt fuer Fehlerpfad  Dfp_VSACD_VSADia1" UWORD OneToOne 1 100 0.00 65535.00 FORMAT "%8.2" ECU_ADDRESS 0x8FE832 /end MEASUREMENT
/begin MEASUREMENT Dfp_VSACD_VSADia2_mp "Messpunkt fuer Fehlerpfad  Dfp_VSACD_VSADia2" UWORD OneToOne 1 100 0.00 65535.00 FORMAT "%8.2" ECU_ADDRESS 0x8FE834 /end MEASUREMENT
/begin MEASUREMENT Dfp_VSACD_VSADia3_mp "Messpunkt fuer Fehlerpfad  Dfp_VSACD_VSADia3" UWORD OneToOne 1 100 0.00 65535.00 FORMAT "%8.2" ECU_ADDRESS 0x8FE836 /end MEASUREMENT
/begin MEASUREMENT Dfp_VSACD_VSADia4_mp "Fehlerpfad für Drallklappensteller Diagnose viertes Fenster" UWORD OneToOne 1 100 0.00 65535.00 FORMAT "%8.2" ECU_ADDRESS 0x8FE838 /end MEASUREMENT
/begin MEASUREMENT Dfp_VSSCD1_mp "Messpunkt fuer Fehlerpfad  Dfp_VSSCD1" UWORD OneToOne 1 100 0.00 65535.00 FORMAT "%8.2" ECU_ADDRESS 0x8FE83A /end MEASUREMENT
/begin MEASUREMENT Dfp_VSSCD2_mp "Messpunkt fuer Fehlerpfad  Dfp_VSSCD2" UWORD OneToOne 1 100 0.00 65535.00 FORMAT "%8.2" ECU_ADDRESS 0x8FE83C /end MEASUREMENT
/begin MEASUREMENT Dfp_WdCom_mp "Messpunkt fuer Fehlerpfad  Dfp_WdCom" UWORD OneToOne 1 100 0.00 65535.00 FORMAT "%8.2" ECU_ADDRESS 0x8FE83E /end MEASUREMENT
/begin FUNCTION dsm_auto_dfpmp ""
 /begin OUT_MEASUREMENT Dfp_ACCDSwtin_mp Dfp_AccPedPlausBrk_mp Dfp_ACC_PlausTrqDes_mp Dfp_ACC_trqInr_mp Dfp_ACTrq_mp Dfp_ADCMon_mp Dfp_AFSCDIdlAdjVal_mp Dfp_AFSCDLdAdjVal_mp Dfp_AFSCD_AirTempDcyc_mp Dfp_AFSCD_PlOffsDrft_mp Dfp_AFSCD_PlSetyDrft_mp Dfp_AFSCD_SRCAirTemp_mp Dfp_AFSCD_SRCBatt_mp Dfp_AFSCD_SRCCorrAirm_mp Dfp_AFSCD_SRCRawAirm_mp Dfp_AFSCD_SRCRefSigPer_mp Dfp_AirCtlPlateBreak_mp Dfp_AirCtl_GovNegDev2_mp Dfp_AirCtl_GovNegDev_mp Dfp_AirCtl_GovPosDev2_mp Dfp_AirCtl_GovPosDev_mp Dfp_AltCD_mp Dfp_AOHtCD_AOHtDia1_mp Dfp_AOHtCD_AOHtDia2_mp Dfp_AOHtCD_AOHtDia3_mp Dfp_AOHtCD_mp Dfp_APP1_mp Dfp_APP2_mp Dfp_APSCD_mp Dfp_ARS_mp Dfp_BattCD_mp Dfp_BPACD_BPADia1_mp Dfp_BPACD_BPADia2_mp Dfp_BPACD_BPADia3_mp Dfp_BPACD_Max_mp Dfp_BPACD_Min_mp Dfp_BPACD_SigNpl_mp Dfp_BPSCD_mp Dfp_BrkCD_mp Dfp_Bss_mp Dfp_CBACD_mp Dfp_Clg_DynTst_mp Dfp_CmbChbMisfire1_mp Dfp_CmbChbMisfire2_mp Dfp_CmbChbMisfire3_mp Dfp_CmbChbMisfire4_mp Dfp_CmbChbMisfire5_mp Dfp_CmbChbMisfire6_mp Dfp_CmbChbMisfireMul_mp Dfp_ConvCD_mp Dfp_CoVMDCSh_mp Dfp_CrCCDMFL_mp Dfp_CrCtl_vCrCtl_mp Dfp_CTSCD_mp Dfp_Dummy1_mp Dfp_EATSCD_mp Dfp_EBAFCD_mp Dfp_EBFCD_mp Dfp_EBTSCD_mp Dfp_EBTSCD_OvrTemp_mp Dfp_EEPCDVarMng_mp Dfp_EGPpCDTPreTrbn_mp Dfp_EGPpCD_mp Dfp_EGRCD_Max_mp Dfp_EGRCD_Min_mp Dfp_EGRCD_SigNpl_mp Dfp_EGTRgnOilDil_mp Dfp_EngMCaS1_mp Dfp_EngMCrS1_mp Dfp_EngMntCtl1_Dia1_mp Dfp_EngMntCtl1_Dia2_mp Dfp_EngMntCtl1_Dia3_mp Dfp_EngMntCtl1_Max_mp Dfp_EngMntCtl1_Min_mp Dfp_EngMntCtl1_SigNpl_mp Dfp_EngMntCtlCD_mp Dfp_EngMntCtl_Dia1_mp Dfp_EngMntCtl_Dia2_mp Dfp_EngMntCtl_Dia3_mp Dfp_EngMntCtl_Max_mp Dfp_EngMntCtl_Min_mp Dfp_EngMntCtl_SigNpl_mp Dfp_EngMOfsCaSCrS_mp Dfp_EngPrtFWODet_mp Dfp_ETClbETFltInj1_mp Dfp_ETClbETFltInj2_mp Dfp_ETClbETFltInj3_mp Dfp_ETClbETFltInj4_mp Dfp_ETClbETFltInj5_mp Dfp_ETClbETFltInj6_mp Dfp_ETClbInj1_mp Dfp_ETClbInj2_mp Dfp_ETClbInj3_mp Dfp_ETClbInj4_mp Dfp_ETClbInj5_mp Dfp_ETClbInj6_mp Dfp_FanCD_FanCtlr1_mp Dfp_FanCD_FanCtlr2_mp Dfp_FanCD_FanCtlr3_mp Dfp_FanCD_mp Dfp_FBCqDvt_mp Dfp_FlFCD_mp Dfp_FlMngSmkDefect_mp Dfp_FMTC_NonMonotonMap_mp Dfp_FrmMngBOS_RESET_2_mp Dfp_FrmMngBOS_RESET_mp Dfp_FrmMngDMANFAFS_mp Dfp_FrmMngDRMANFSSG_mp Dfp_FrmMngGEARBX_DATA2_mp Dfp_FrmMngGEARBX_DATA_mp Dfp_FrmMngHEAT_AC_mp Dfp_FrmMngLENKRADWINKEL_mp Dfp_FrmMngMILEAGE_RANGE_mp Dfp_FrmMngOPCRCTLACC_mp Dfp_FrmMngParkConsumer_mp Dfp_FrmMngPRGG_CCTR_mp Dfp_FrmMngPWRMNG_LOADV_mp Dfp_FrmMngRQSTGEFAN_mp Dfp_FrmMngSSGErr_mp Dfp_FrmMngSSGShOff_mp Dfp_FrmMngSTAT_ANH_mp Dfp_FrmMngSTAT_ARS_mp Dfp_FrmMngSTAT_DSC_mp Dfp_FrmMngSTAT_EKP_mp Dfp_FrmMngSTAT_KOMBI_mp Dfp_FrmMngSTAT_SITZ_mp Dfp_FrmMngstCurr_mp Dfp_FrmMngStOBDGbxMilOf_mp Dfp_FrmMngStOBDGbxMilOn_mp Dfp_FrmMngswtPSPOff_mp Dfp_FrmMngTEMPRELTIME_mp Dfp_FrmMngTERMINAL_mp Dfp_FrmMngTIME_DATE_mp Dfp_FrmMngTORQUE_DSC_mp Dfp_FrmMngTORQUE_GEARBX_mp Dfp_FrmMngTrq_ReqACC_mp Dfp_FrmMngVEH_MOD_mp Dfp_FrmMngVELOCITY_mp Dfp_FrmMngWHEEL_SPEED_mp Dfp_FTSCD_mp Dfp_GearbxIncMax_mp Dfp_GlwCDGlwCirc1_mp Dfp_GlwCDGlwCirc2_mp Dfp_GlwCDGlwCirc3_mp Dfp_GlwCDGlwCirc4_mp Dfp_GlwCDGlwCirc5_mp Dfp_GlwCDGlwCirc6_mp Dfp_GlwCDGlwCirc7_mp Dfp_GlwCDGlwCirc8_mp Dfp_GlwCD_mp Dfp_GlwCtl_mp Dfp_HWEMonCom_mp Dfp_HWEMonEEPROM_mp Dfp_HWEMonRcyLocked_mp Dfp_HWEMonRcySuppressed_mp Dfp_HWEMonRcyVisible_mp Dfp_HWEMonUMaxSupply_mp Dfp_HWEMonUMinSupply_mp Dfp_IATSCD_CATS_mp Dfp_IATSCD_mp Dfp_ImmCtlImmCD_mp Dfp_ImmCtlImmEep_mp Dfp_ImmCtlMpl_mp Dfp_IndSys1_mp Dfp_IndSys2_mp Dfp_InjCrv_InjLim_mp Dfp_InjCtlAdjQnt_mp Dfp_InjCtlDrift_mp Dfp_InjVCDActrChrg_mp Dfp_InjVCDActrEnrg1_mp Dfp_InjVCDActrEnrg2_mp Dfp_InjVCDActrEnrg3_mp Dfp_InjVCDActrEnrg4_mp Dfp_InjVCDActrEnrg5_mp Dfp_InjVCDActrEnrg6_mp Dfp_InjVCDActrEnrg7_mp Dfp_InjVCDActrEnrg8_mp Dfp_InjVCDActrVolt_mp Dfp_InjVCDClsBank1_mp Dfp_InjVCDClsBank2_mp Dfp_InjVCDMonCab_mp Dfp_InjVCDMonSwt_mp Dfp_InjVCDShOffDCDC_mp Dfp_InjVCDUBuf_mp Dfp_InjVCD_CY370Ampl_mp Dfp_InjVlvBnk1A_mp Dfp_InjVlvBnk1B_mp Dfp_InjVlvBnk2A_mp Dfp_InjVlvBnk2B_mp Dfp_InjVlvChipA_mp Dfp_InjVlvChipB_mp Dfp_InjVlvCyl1A_mp Dfp_InjVlvCyl1B_mp Dfp_InjVlvCyl1C_mp Dfp_InjVlvCyl2A_mp Dfp_InjVlvCyl2B_mp Dfp_InjVlvCyl2C_mp Dfp_InjVlvCyl3A_mp Dfp_InjVlvCyl3B_mp Dfp_InjVlvCyl3C_mp Dfp_InjVlvCyl4A_mp Dfp_InjVlvCyl4B_mp Dfp_InjVlvCyl4C_mp Dfp_InjVlvCyl5A_mp Dfp_InjVlvCyl5B_mp Dfp_InjVlvCyl5C_mp Dfp_InjVlvCyl6A_mp Dfp_InjVlvCyl6B_mp Dfp_InjVlvCyl6C_mp Dfp_InjVlvCyl7A_mp Dfp_InjVlvCyl7B_mp Dfp_InjVlvCyl7C_mp Dfp_InjVlvCyl8A_mp Dfp_InjVlvCyl8B_mp Dfp_InjVlvCyl8C_mp Dfp_InjVlvNVC1_mp Dfp_InjVlvNVC2_mp Dfp_InjVlvNVC3_mp Dfp_InjVlvNVC4_mp Dfp_InjVlvNVC5_mp Dfp_InjVlvNVC6_mp Dfp_InjVlvNVC7_mp Dfp_InjVlvNVC8_mp Dfp_Layer_BSD_mp Dfp_Layer_GEN_mp Dfp_Layer_IBS1_mp Dfp_Layer_IBS2_mp Dfp_Layer_IBS3_mp Dfp_Layer_MANHYDR_mp Dfp_Layer_MANLUFT_mp Dfp_Layer_PMBATT_mp Dfp_Layer_PMBN_mp Dfp_Layer_PMRUHVERL_mp Dfp_Layer_QLT_mp Dfp_Layer_TANS_mp Dfp_Layer_TOENS_mp Dfp_Layer_TUMG_mp Dfp_LPACD_Max_mp Dfp_LPACD_Min_mp Dfp_LPACD_SigNpl_mp Dfp_LSUCDCircNernst0_mp Dfp_LSUCDCircPumpCur0_mp Dfp_LSUCDCircVirtGnd0_mp Dfp_LSUCDHeater0_mp Dfp_LSUCDHtCoup0_mp Dfp_LSUCDO20_mp Dfp_LSUCDO2Clb0_mp Dfp_LSUCDRiClb0_mp Dfp_LSUCDSPI0_mp Dfp_LSUCDSPIBattLow0_mp Dfp_LSUCDWireIP0_mp Dfp_LSUCtlRiExc0_mp Dfp_LSUMon1Sens_mp Dfp_LSUMon2Sens_mp Dfp_LubCD_mp Dfp_MeUnCDNoLoad_mp Dfp_MeUnCDSCBat_mp Dfp_MeUnCDSCGnd_mp Dfp_MeUnCD_ADC_mp Dfp_MeUnCD_SigTst_mp Dfp_MIL_mp Dfp_Montr_mp Dfp_MRlyCD_mp Dfp_MSidCD_Comm_mp Dfp_MSidCD_Pin_mp Dfp_MSidCD_Select_mp Dfp_MSidCD_Sel_INI_mp Dfp_NetMngDeviceA_mp Dfp_NetMngDeviceB_mp Dfp_NetMngDeviceC_mp Dfp_OPSCD_anain_mp Dfp_OPSCD_Lamp_mp Dfp_OTSCD_mp Dfp_OvRMonBrk_mp Dfp_OvRMonSigA_mp Dfp_OvRMon_mp Dfp_OxiCCDTPre_mp Dfp_PCR_GovDevNeg_mp Dfp_PCR_GovDevPos_mp Dfp_PCVCDNoLoad_mp Dfp_PCVCDSCBat_mp Dfp_PCVCDSCGnd_mp Dfp_PCVCD_ADC_mp Dfp_PCVCD_SigTst_mp Dfp_PFltAPSens_mp Dfp_PFltCDPPre_mp Dfp_PFltCDTempPre_mp Dfp_PFltChar_mp Dfp_PFltEngPrt_mp Dfp_PFltmSotDiffMax_mp Dfp_PFltPresDynPlaus_mp Dfp_PFltPresSensFrz_mp Dfp_PFltPresSensHsLn_mp Dfp_PFltPresSensSot_mp Dfp_PFltPresSens_mp Dfp_PFltRgnPerm_mp Dfp_PFltTempDwnStrm_mp Dfp_PFltTempSens_mp Dfp_PFltTempUpStrm_mp Dfp_QLTCD_mp Dfp_RailCDOfsTst_mp Dfp_RailCD_mp Dfp_RailCD_PMonStrt_mp Dfp_RailCtlModeMeUnDiag_mp Dfp_RailCtlModePCVDiag_mp Dfp_RailMeUn0_mp Dfp_RailMeUn1_mp Dfp_RailMeUn2_mp Dfp_RailMeUn3_mp Dfp_RailMeUn4_mp Dfp_RailPCV0_mp Dfp_RailPCV1_mp Dfp_RailPCV2_mp Dfp_RailPCV3_mp Dfp_RailPCV4_mp Dfp_RailPCV5_mp Dfp_RTMMon_mp Dfp_ShutCD_mp Dfp_SOPTst_mp Dfp_SSpMon1_mp Dfp_SSpMon2_mp Dfp_SSpMon3_mp Dfp_StrtCD_Actr_mp Dfp_StSysTrqShutOff_mp Dfp_SysLamp_mp Dfp_T15CD_mp Dfp_TGearbx_mp Dfp_TPUMon_mp Dfp_TVACD_Max_mp Dfp_TVACD_Min_mp Dfp_TVACD_SigNpl_mp Dfp_TVACD_TVADia1_mp Dfp_TVACD_TVADia2_mp Dfp_TVACD_TVADia3_mp Dfp_VSACD_Max_mp Dfp_VSACD_Min_mp Dfp_VSACD_SigNpl_mp Dfp_VSACD_VSADia1_mp Dfp_VSACD_VSADia2_mp Dfp_VSACD_VSADia3_mp Dfp_VSACD_VSADia4_mp Dfp_VSSCD1_mp Dfp_VSSCD2_mp Dfp_WdCom_mp /end OUT_MEASUREMENT
/end FUNCTION
/begin FUNCTION dsm_auto_env16 "" /end FUNCTION
/begin FUNCTION dsm_auto_env8 ""
 /begin DEF_CHARACTERISTIC DSM_EnvDfp_Layer_TANS_C DSM_EnvDfp_ACCDSwtin_C DSM_EnvDfp_ACC_PlausTrqDes_C DSM_EnvDfp_ACC_trqInr_C DSM_EnvDfp_ACTrq_C DSM_EnvDfp_ADCMon_C DSM_EnvDfp_AFSCDIdlAdjVal_C DSM_EnvDfp_AFSCDLdAdjVal_C DSM_EnvDfp_AFSCD_AirTempDcyc_C DSM_EnvDfp_AFSCD_PlOffsDrft_C DSM_EnvDfp_AFSCD_PlSetyDrft_C DSM_EnvDfp_AFSCD_SRCAirTemp_C DSM_EnvDfp_AFSCD_SRCBatt_C DSM_EnvDfp_AFSCD_SRCCorrAirm_C DSM_EnvDfp_AFSCD_SRCRawAirm_C DSM_EnvDfp_AFSCD_SRCRefSigPer_C DSM_EnvDfp_AOHtCD_C DSM_EnvDfp_AOHtCD_AOHtDia1_C DSM_EnvDfp_AOHtCD_AOHtDia2_C DSM_EnvDfp_Layer_TUMG_C DSM_EnvDfp_AOHtCD_AOHtDia3_C DSM_EnvDfp_APP1_C DSM_EnvDfp_Layer_GEN_C DSM_EnvDfp_Layer_BSD_C DSM_EnvDfp_APP2_C DSM_EnvDfp_APSCD_C DSM_EnvDfp_ARS_C DSM_EnvDfp_AccPedPlausBrk_C DSM_EnvDfp_AirCtlPlateBreak_C DSM_EnvDfp_AirCtl_GovNegDev_C DSM_EnvDfp_AirCtl_GovNegDev2_C DSM_EnvDfp_AirCtl_GovPosDev_C DSM_EnvDfp_AirCtl_GovPosDev2_C DSM_EnvDfp_AltCD_C DSM_EnvDfp_Layer_QLT_C DSM_EnvDfp_BPACD_BPADia1_C DSM_EnvDfp_Layer_IBS1_C DSM_EnvDfp_Layer_IBS2_C DSM_EnvDfp_Layer_IBS3_C DSM_EnvDfp_Layer_PMBN_C DSM_EnvDfp_Layer_PMBATT_C DSM_EnvDfp_BPACD_BPADia2_C DSM_EnvDfp_BPACD_BPADia3_C DSM_EnvDfp_BPACD_Max_C DSM_EnvDfp_BPACD_Min_C DSM_EnvDfp_BPACD_SigNpl_C DSM_EnvDfp_BPSCD_C DSM_EnvDfp_BattCD_C DSM_EnvDfp_BrkCD_C DSM_EnvDfp_Bss_C DSM_EnvDfp_CBACD_C DSM_EnvDfp_CTSCD_C DSM_EnvDfp_Clg_DynTst_C DSM_EnvDfp_CmbChbMisfire1_C DSM_EnvDfp_CmbChbMisfire2_C DSM_EnvDfp_CmbChbMisfire3_C DSM_EnvDfp_CmbChbMisfire4_C DSM_EnvDfp_CmbChbMisfire5_C DSM_EnvDfp_CmbChbMisfire6_C DSM_EnvDfp_CmbChbMisfireMul_C DSM_EnvDfp_CoVMDCSh_C DSM_EnvDfp_ConvCD_C DSM_EnvDfp_CrCCDMFL_C DSM_EnvDfp_CrCtl_vCrCtl_C DSM_EnvDfp_Dummy1_C DSM_EnvDfp_EATSCD_C DSM_EnvDfp_EBAFCD_C DSM_EnvDfp_EBFCD_C DSM_EnvDfp_EBTSCD_C DSM_EnvDfp_EBTSCD_OvrTemp_C DSM_EnvDfp_EEPCDVarMng_C DSM_EnvDfp_EGPpCD_C DSM_EnvDfp_EGPpCDTPreTrbn_C DSM_EnvDfp_Layer_PMRUHVERL_C DSM_EnvDfp_EGRCD_Max_C DSM_EnvDfp_EGRCD_Min_C DSM_EnvDfp_EGRCD_SigNpl_C DSM_EnvDfp_EGTRgnOilDil_C DSM_EnvDfp_Layer_TOENS_C DSM_EnvDfp_Layer_MANHYDR_C DSM_EnvDfp_Layer_MANLUFT_C DSM_EnvDfp_ETClbETFltInj1_C DSM_EnvDfp_ETClbETFltInj2_C DSM_EnvDfp_ETClbETFltInj3_C DSM_EnvDfp_ETClbETFltInj4_C DSM_EnvDfp_ETClbETFltInj5_C DSM_EnvDfp_ETClbETFltInj6_C DSM_EnvDfp_ETClbInj1_C DSM_EnvDfp_ETClbInj2_C DSM_EnvDfp_ETClbInj3_C DSM_EnvDfp_ETClbInj4_C DSM_EnvDfp_ETClbInj5_C DSM_EnvDfp_ETClbInj6_C DSM_EnvDfp_EngMCaS1_C DSM_EnvDfp_EngMCrS1_C DSM_EnvDfp_EngMOfsCaSCrS_C DSM_EnvDfp_EngMntCtl1_Dia1_C DSM_EnvDfp_EngMntCtl1_Dia2_C DSM_EnvDfp_EngMntCtl1_Dia3_C DSM_EnvDfp_EngMntCtl1_Max_C DSM_EnvDfp_EngMntCtl1_Min_C DSM_EnvDfp_EngMntCtl1_SigNpl_C DSM_EnvDfp_EngMntCtlCD_C DSM_EnvDfp_EngMntCtl_Dia1_C DSM_EnvDfp_EngMntCtl_Dia2_C DSM_EnvDfp_EngMntCtl_Dia3_C DSM_EnvDfp_EngMntCtl_Max_C DSM_EnvDfp_EngMntCtl_Min_C DSM_EnvDfp_EngMntCtl_SigNpl_C DSM_EnvDfp_EngPrtFWODet_C DSM_EnvDfp_FBCqDvt_C DSM_EnvDfp_FMTC_NonMonotonMap_C DSM_EnvDfp_FTSCD_C DSM_EnvDfp_FanCD_C DSM_EnvDfp_FanCD_FanCtlr1_C DSM_EnvDfp_FanCD_FanCtlr2_C DSM_EnvDfp_FanCD_FanCtlr3_C DSM_EnvDfp_FlFCD_C DSM_EnvDfp_FlMngSmkDefect_C DSM_EnvDfp_FrmMngBOS_RESET_C DSM_EnvDfp_FrmMngBOS_RESET_2_C DSM_EnvDfp_FrmMngDMANFAFS_C DSM_EnvDfp_FrmMngDRMANFSSG_C DSM_EnvDfp_FrmMngGEARBX_DATA_C DSM_EnvDfp_FrmMngGEARBX_DATA2_C DSM_EnvDfp_FrmMngHEAT_AC_C DSM_EnvDfp_FrmMngLENKRADWINKEL_C DSM_EnvDfp_FrmMngMILEAGE_RANGE_C DSM_EnvDfp_FrmMngOPCRCTLACC_C DSM_EnvDfp_FrmMngPRGG_CCTR_C DSM_EnvDfp_FrmMngPWRMNG_LOADV_C DSM_EnvDfp_FrmMngParkConsumer_C DSM_EnvDfp_FrmMngRQSTGEFAN_C DSM_EnvDfp_FrmMngSSGErr_C DSM_EnvDfp_FrmMngSSGShOff_C DSM_EnvDfp_FrmMngSTAT_ANH_C DSM_EnvDfp_FrmMngSTAT_ARS_C DSM_EnvDfp_FrmMngSTAT_DSC_C DSM_EnvDfp_FrmMngSTAT_EKP_C DSM_EnvDfp_FrmMngSTAT_KOMBI_C DSM_EnvDfp_FrmMngSTAT_SITZ_C DSM_EnvDfp_FrmMngStOBDGbxMilOf_C DSM_EnvDfp_FrmMngStOBDGbxMilOn_C DSM_EnvDfp_FrmMngTEMPRELTIME_C DSM_EnvDfp_FrmMngTERMINAL_C DSM_EnvDfp_FrmMngTIME_DATE_C DSM_EnvDfp_FrmMngTORQUE_DSC_C DSM_EnvDfp_FrmMngTORQUE_GEARBX_C DSM_EnvDfp_FrmMngTrq_ReqACC_C DSM_EnvDfp_FrmMngVEH_MOD_C DSM_EnvDfp_FrmMngVELOCITY_C DSM_EnvDfp_FrmMngWHEEL_SPEED_C DSM_EnvDfp_FrmMngstCurr_C DSM_EnvDfp_FrmMngswtPSPOff_C DSM_EnvDfp_GearbxIncMax_C DSM_EnvDfp_GlwCD_C DSM_EnvDfp_GlwCDGlwCirc1_C DSM_EnvDfp_GlwCDGlwCirc2_C DSM_EnvDfp_GlwCDGlwCirc3_C DSM_EnvDfp_GlwCDGlwCirc4_C DSM_EnvDfp_GlwCDGlwCirc5_C DSM_EnvDfp_GlwCDGlwCirc6_C DSM_EnvDfp_GlwCDGlwCirc7_C DSM_EnvDfp_GlwCDGlwCirc8_C DSM_EnvDfp_GlwCtl_C DSM_EnvDfp_HWEMonCom_C DSM_EnvDfp_HWEMonEEPROM_C DSM_EnvDfp_HWEMonRcyLocked_C DSM_EnvDfp_HWEMonRcySuppressed_C DSM_EnvDfp_HWEMonRcyVisible_C DSM_EnvDfp_HWEMonUMaxSupply_C DSM_EnvDfp_HWEMonUMinSupply_C DSM_EnvDfp_IATSCD_C DSM_EnvDfp_IATSCD_CATS_C DSM_EnvDfp_ImmCtlImmCD_C DSM_EnvDfp_ImmCtlImmEep_C DSM_EnvDfp_ImmCtlMpl_C DSM_EnvDfp_IndSys1_C DSM_EnvDfp_IndSys2_C DSM_EnvDfp_InjCrv_InjLim_C DSM_EnvDfp_InjCtlAdjQnt_C DSM_EnvDfp_InjCtlDrift_C DSM_EnvDfp_InjVCDActrChrg_C DSM_EnvDfp_InjVCDActrEnrg1_C DSM_EnvDfp_InjVCDActrEnrg2_C DSM_EnvDfp_InjVCDActrEnrg3_C DSM_EnvDfp_InjVCDActrEnrg4_C DSM_EnvDfp_InjVCDActrEnrg5_C DSM_EnvDfp_InjVCDActrEnrg6_C DSM_EnvDfp_InjVCDActrEnrg7_C DSM_EnvDfp_InjVCDActrEnrg8_C DSM_EnvDfp_InjVCDActrVolt_C DSM_EnvDfp_InjVCDClsBank1_C DSM_EnvDfp_InjVCDClsBank2_C DSM_EnvDfp_InjVCDMonCab_C DSM_EnvDfp_InjVCDMonSwt_C DSM_EnvDfp_InjVCDShOffDCDC_C DSM_EnvDfp_InjVCDUBuf_C DSM_EnvDfp_InjVCD_CY370Ampl_C DSM_EnvDfp_InjVlvBnk1A_C DSM_EnvDfp_InjVlvBnk1B_C DSM_EnvDfp_InjVlvBnk2A_C DSM_EnvDfp_InjVlvBnk2B_C DSM_EnvDfp_InjVlvChipA_C DSM_EnvDfp_InjVlvChipB_C DSM_EnvDfp_InjVlvCyl1A_C DSM_EnvDfp_InjVlvCyl1B_C DSM_EnvDfp_InjVlvCyl1C_C DSM_EnvDfp_InjVlvCyl2A_C DSM_EnvDfp_InjVlvCyl2B_C DSM_EnvDfp_InjVlvCyl2C_C DSM_EnvDfp_InjVlvCyl3A_C DSM_EnvDfp_InjVlvCyl3B_C DSM_EnvDfp_InjVlvCyl3C_C DSM_EnvDfp_InjVlvCyl4A_C DSM_EnvDfp_InjVlvCyl4B_C DSM_EnvDfp_InjVlvCyl4C_C DSM_EnvDfp_InjVlvCyl5A_C DSM_EnvDfp_InjVlvCyl5B_C DSM_EnvDfp_InjVlvCyl5C_C DSM_EnvDfp_InjVlvCyl6A_C DSM_EnvDfp_InjVlvCyl6B_C DSM_EnvDfp_InjVlvCyl6C_C DSM_EnvDfp_InjVlvCyl7A_C DSM_EnvDfp_InjVlvCyl7B_C DSM_EnvDfp_InjVlvCyl7C_C DSM_EnvDfp_InjVlvCyl8A_C DSM_EnvDfp_InjVlvCyl8B_C DSM_EnvDfp_InjVlvCyl8C_C DSM_EnvDfp_InjVlvNVC1_C DSM_EnvDfp_InjVlvNVC2_C DSM_EnvDfp_InjVlvNVC3_C DSM_EnvDfp_InjVlvNVC4_C DSM_EnvDfp_InjVlvNVC5_C DSM_EnvDfp_InjVlvNVC6_C DSM_EnvDfp_InjVlvNVC7_C DSM_EnvDfp_InjVlvNVC8_C DSM_EnvDfp_LPACD_Max_C DSM_EnvDfp_LPACD_Min_C DSM_EnvDfp_LPACD_SigNpl_C DSM_EnvDfp_LSUCDCircNernst0_C DSM_EnvDfp_LSUCDCircPumpCur0_C DSM_EnvDfp_LSUCDCircVirtGnd0_C DSM_EnvDfp_LSUCDHeater0_C DSM_EnvDfp_LSUCDHtCoup0_C DSM_EnvDfp_LSUCDO20_C DSM_EnvDfp_LSUCDO2Clb0_C DSM_EnvDfp_LSUCDRiClb0_C DSM_EnvDfp_LSUCDSPI0_C DSM_EnvDfp_LSUCDSPIBattLow0_C DSM_EnvDfp_LSUCDWireIP0_C DSM_EnvDfp_LSUCtlRiExc0_C DSM_EnvDfp_LSUMon1Sens_C DSM_EnvDfp_LSUMon2Sens_C DSM_EnvDfp_LubCD_C DSM_EnvDfp_MIL_C DSM_EnvDfp_MRlyCD_C DSM_EnvDfp_MSidCD_Comm_C DSM_EnvDfp_MSidCD_Pin_C DSM_EnvDfp_MSidCD_Sel_INI_C DSM_EnvDfp_MSidCD_Select_C DSM_EnvDfp_MeUnCDNoLoad_C DSM_EnvDfp_MeUnCDSCBat_C DSM_EnvDfp_MeUnCDSCGnd_C DSM_EnvDfp_MeUnCD_ADC_C DSM_EnvDfp_MeUnCD_SigTst_C DSM_EnvDfp_Montr_C DSM_EnvDfp_NetMngDeviceA_C DSM_EnvDfp_NetMngDeviceB_C DSM_EnvDfp_NetMngDeviceC_C DSM_EnvDfp_OPSCD_Lamp_C DSM_EnvDfp_OPSCD_anain_C DSM_EnvDfp_OTSCD_C DSM_EnvDfp_OvRMon_C DSM_EnvDfp_OvRMonBrk_C DSM_EnvDfp_OvRMonSigA_C DSM_EnvDfp_OxiCCDTPre_C DSM_EnvDfp_PCR_GovDevNeg_C DSM_EnvDfp_PCR_GovDevPos_C DSM_EnvDfp_PCVCDNoLoad_C DSM_EnvDfp_PCVCDSCBat_C DSM_EnvDfp_PCVCDSCGnd_C DSM_EnvDfp_PCVCD_ADC_C DSM_EnvDfp_PCVCD_SigTst_C DSM_EnvDfp_PFltAPSens_C DSM_EnvDfp_PFltCDPPre_C DSM_EnvDfp_PFltCDTempPre_C DSM_EnvDfp_PFltChar_C DSM_EnvDfp_PFltEngPrt_C DSM_EnvDfp_PFltPresDynPlaus_C DSM_EnvDfp_PFltPresSens_C DSM_EnvDfp_PFltPresSensFrz_C DSM_EnvDfp_PFltPresSensHsLn_C DSM_EnvDfp_PFltPresSensSot_C DSM_EnvDfp_PFltRgnPerm_C DSM_EnvDfp_PFltTempDwnStrm_C DSM_EnvDfp_PFltTempSens_C DSM_EnvDfp_PFltTempUpStrm_C DSM_EnvDfp_PFltmSotDiffMax_C DSM_EnvDfp_QLTCD_C DSM_EnvDfp_RTMMon_C DSM_EnvDfp_RailCD_C DSM_EnvDfp_RailCDOfsTst_C DSM_EnvDfp_RailCD_PMonStrt_C DSM_EnvDfp_RailCtlModeMeUnDiag_C DSM_EnvDfp_RailCtlModePCVDiag_C DSM_EnvDfp_RailMeUn0_C DSM_EnvDfp_RailMeUn1_C DSM_EnvDfp_RailMeUn2_C DSM_EnvDfp_RailMeUn3_C DSM_EnvDfp_RailMeUn4_C DSM_EnvDfp_RailPCV0_C DSM_EnvDfp_RailPCV1_C DSM_EnvDfp_RailPCV2_C DSM_EnvDfp_RailPCV3_C DSM_EnvDfp_RailPCV4_C DSM_EnvDfp_RailPCV5_C DSM_EnvDfp_SOPTst_C DSM_EnvDfp_SSpMon1_C DSM_EnvDfp_SSpMon2_C DSM_EnvDfp_SSpMon3_C DSM_EnvDfp_ShutCD_C DSM_EnvDfp_StSysTrqShutOff_C DSM_EnvDfp_StrtCD_Actr_C DSM_EnvDfp_SysLamp_C DSM_EnvDfp_T15CD_C DSM_EnvDfp_TGearbx_C DSM_EnvDfp_TPUMon_C DSM_EnvDfp_TVACD_Max_C DSM_EnvDfp_TVACD_Min_C DSM_EnvDfp_TVACD_SigNpl_C DSM_EnvDfp_TVACD_TVADia1_C DSM_EnvDfp_TVACD_TVADia2_C DSM_EnvDfp_TVACD_TVADia3_C DSM_EnvDfp_VSACD_Max_C DSM_EnvDfp_VSACD_Min_C DSM_EnvDfp_VSACD_SigNpl_C DSM_EnvDfp_VSACD_VSADia1_C DSM_EnvDfp_VSACD_VSADia2_C DSM_EnvDfp_VSACD_VSADia3_C DSM_EnvDfp_VSACD_VSADia4_C DSM_EnvDfp_VSSCD1_C DSM_EnvDfp_VSSCD2_C DSM_EnvDfp_WdCom_C /end DEF_CHARACTERISTIC
/end FUNCTION
/begin FUNCTION dsm_auto_fid_scd "" /end FUNCTION
/begin FUNCTION dsm_auto_fid_scd_msg "" /end FUNCTION
/begin COMPU_METHOD OneToOne "eins zu eins (physikalischer Wert ist gleich dem internen Wert)" RAT_FUNC "%6.2" "-" COEFFS 0 1 0 0 0 1 /end COMPU_METHOD
/begin COMPU_METHOD SigName "Verbale Umrechnung für Signal Referenz Nummern" TAB_VERB "%6.3" "-" COMPU_TAB_REF SigName /end COMPU_METHOD
/begin COMPU_VTAB SigName "Verbale Umrechnung für Signal Referenz Nummern" TAB_VERB 96 0 "Sig_unused" 4 "CoEng_rTrq__Carb_r_DLen1" 5 "CTSCD_tClntLin__Carb_t_DLen1" 11 "BPSCD_pLin__Carb_p_DLen1" 12 "Eng_nAvrg__Carb_n_DLen2" 13 "VSSCD_vSensVal__Carb_v_DLen1" 15 "AFSCD_tAir_mp__Carb_t_DLen1" 16 "AFSCD_dmAirRawPerTime__Carb_mAirTim_DLen2" 28 "Signals_PID0x1C_C__OneToOne_DLen1" 33 "DSMDur_ctDfctDur1__Carb_l_DLen2" 80 "AFSCD_mAirPerCyl__mAirCyl_DLen2" 81 "AFSCD_rAir__dcyc_DLen2" 82 "AFSCD_dmAirPerTime__mAirTim_DLen2" 83 "PFlt_lSum_mp__lenPFlt_DLen2" 84 "PFlt_pDiff__p_DLen2" 85 "InjCtl_qCurr__q_DLen2" 86 "PFlt_lSumu16_mp__lenu16PFlt_DLen2" 87 "PFlt_lSnceRgnu16_mp__lenrgnu16PFlt_DLen2" 88 "PFlt_tiOpu16_mp__tiOpu16PFlt_DLen2" 89 "InjCtl_qSetUnBal__q_DLen2" 90 "PFlt_tiSnceRgnu16_mp__tiOprgnu16PFlt_DLen2" 91 "FTSCD_tFuel__t_DLen2" 92 "PFltCD_pPre__pkPa_DLen2" 93 "OxiCCD_tPre__t_DLen2" 94 "PFltCD_tPre__t_DLen2" 95 "APPCD_rLinAPP1__r_DLen2" 96 "APPCD_rLinAPP2__r_DLen2" 97 "GlwCtl_stLampOut__OneToOne_DLen1" 99 "ErLpCD_stMil__OneToOne_DLen1" 100 "APPCD_uRawAPP1__u_DLen2" 101 "APPCD_uRawAPP2__u_DLen2" 102 "APPCD_rFlt__r_DLen2" 103 "FanCD_dcycRaw_mp__dcyc_DLen2" 104 "PFlt_mSot__mSoot_DLen2" 105 "PSPCD_dvolOut__FlCon_DLen2" 106 "EBAFCD_stSigOut__OneToOne_DLen1" 108 "PFlt_mAshOil__mSoot_DLen2" 109 "PFlt_numEngPOp__OneToOne_DLen1" 110 "APSCD_pVal__p_DLen2" 111 "APSCD_uRaw__u_DLen2" 112 "PFlt_numRgn_mp__OneToOne_DLen1" 115 "HWEMon_numRecovery__OneToOne_DLen1" 122 "EGRCD_rOut__dcyc_DLen2" 123 "BPACD_rOut__dcyc_DLen2" 124 "GlwCtl_rPwrOut__OneToOne_DLen1" 126 "PFlt_qFl_mp__FlConPFlt_DLen2" 130 "AltCD_rAltLoad__r_DLen2" 136 "AirCtl_mDesVal__mAirCyl_DLen2" 138 "PCR_pDesVal__p_DLen2" 143 "CTSCD_uRaw__u_DLen2" 144 "CTSCD_tClnt__t_DLen2" 145 "Eng_nAvrg__n_DLen2" 147 "BattCD_u__uBatt_DLen2" 148 "VSSCD_v__v_DLen2" 150 "FMTC_trqInr__trq_DLen2" 151 "LIGov_trq__trq_DLen2" 152 "LIGov_nSetpoint__n_DLen2" 154 "IATSCD_tAirCats__t_DLen2" 155 "IATSCD_uRaw__u_DLen2" 156 "IATSCD_tAir__t_DLen2" 157 "BPSCD_uRawVal__u_DLen2" 158 "BPSCD_pOutVal__p_DLen2" 159 "VehDa_tiEngOn__timEng_DLen2" 175 "OPSCD_stSigOut__OneToOne_DLen1" 176 "EngM_stSync__OneToOne_DLen1" 180 "T2histshort__OneToOne_DLen1" 181 "T3histshort__OneToOne_DLen1" 182 "T4histshort__OneToOne_DLen1" 183 "Stat_sv_reg1__OneToOne_DLen1" 184 "Stat_sv_reg2__OneToOne_DLen1" 185 "Tn_abstell__Tn_abstell_DLen2" 186 "U_gen__U_gen_DLen2" 187 "U_batt__U_batt_DLen2" 194 "RailCD_pPeak__pRail_DLen2" 195 "Rail_pSetPoint__pRail_DLen2" 210 "PFlt_stEngPOp__OneToOne_DLen1" 211 "RailCD_uPeakRaw__u_DLen2" 212 "FTSCD_uRaw__u_DLen2" 221 "PFlt_stIntr_mp__OneToOne_DLen1" 222 "PFlt_stLck_mp__OneToOne_DLen1" 233 "AOHtCD_rOut_mp__dcyc_DLen2" 234 "TVACD_rOut__dcyc_DLen2" 235 "VSACD_rOut__dcyc_DLen2" 236 "MeUnCD_dcycOut_mp__dcyc_DLen2" 237 "PCVCD_dcycOut_mp__dcyc_DLen2" 238 "CBACD_stLogicOut_mp__OneToOne_DLen1" 239 "LPACD_rOut__dcyc_DLen2" 247 "PFlt_dvol__volph_DLen2" 248 "PFlt_pEngPrtMax_mp__p_DLen2" 249 "PFlt_st1_mp__stLL16_DLen2" 250 "PFlt_st1_mp__stHH16_DLen2" 251 "PFlt_st2_mp__stLL16_DLen2" 252 "PFlt_st2_mp__stHH16_DLen2" 253 "HWEMon_recLocLow_mp__stLL16_DLen2" 254 "HWEMon_recLocLow_mp__stHH16_DLen2" 255 "HWEMon_recLocHigh_mp__stLL16_DLen2" /end COMPU_VTAB
/begin RECORD_LAYOUT Kwb_Wu8 FNC_VALUES 1 UBYTE COLUMN_DIR DIRECT /end RECORD_LAYOUT
/end MODULE
/end PROJECT
