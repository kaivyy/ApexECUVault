ASAP2_VERSION 1 3
/begin PROJECT _725D601B "725D601B"
/begin HEADER "" VERSION "_725D601B" PROJECT_NO _725D601B /end HEADER
/begin MODULE DIM ""
/begin MOD_COMMON "" BYTE_ORDER MSB_FIRST ALIGNMENT_BYTE 1 ALIGNMENT_WORD 2 ALIGNMENT_LONG 2 ALIGNMENT_FLOAT32_IEEE 4 /end MOD_COMMON
/begin CHARACTERISTIC CDCANWS "Codewort Carb: Nockenwellensteuerung Auslass Nockenwelle" VAL_BLK 0xFD5D18 KwbWU16 65535.00 DEZ 0.00 65535.00 FORMAT "%8.2" NUMBER 4 /end CHARACTERISTIC
/begin CHARACTERISTIC CDCANWS2 "Codewort Carb: Nockenwellensteuerung Auslass Nockenwelle 2" VAL_BLK 0xFD5D20 KwbWU16 65535.00 DEZ 0.00 65535.00 FORMAT "%8.2" NUMBER 4 /end CHARACTERISTIC
/begin CHARACTERISTIC CDCCVVT "Codewort CARB: CAN-Schnittstelle, Timeout VVT" VAL_BLK 0xFD5DC8 KwbUw 65535.00 dez 0.00 65535.00 FORMAT "%8.2" NUMBER 4 /end CHARACTERISTIC
/begin CHARACTERISTIC CDCETS "Codewort CARB: Elektrisches Thermostat" VAL_BLK 0xFD6018 KwbWU16 65535.00 dez 0.00 65535.00 FORMAT "%8.2" NUMBER 4 /end CHARACTERISTIC
/begin CHARACTERISTIC CDCFRAO "Codewort CARB: LR-Adaption obere multiplikativ" VAL_BLK 0xFD6078 KwbUw 65535.00 dez 0.00 65535.00 FORMAT "%8.2" NUMBER 4 /end CHARACTERISTIC
/begin CHARACTERISTIC CDCFRAO2 "Codewort CARB: LR-Adaption obere multiplikativ Bank 2" VAL_BLK 0xFD6080 KwbUw 65535.00 dez 0.00 65535.00 FORMAT "%8.2" NUMBER 4 /end CHARACTERISTIC
/begin CHARACTERISTIC CDCFRAU "Codewort CARB: LR-Adaption untere multiplikativ" VAL_BLK 0xFD6088 KwbUw 65535.00 dez 0.00 65535.00 FORMAT "%8.2" NUMBER 4 /end CHARACTERISTIC
/begin CHARACTERISTIC CDCFRAU2 "Codewort CARB: LR-Adaption untere multiplikativ Bank 2" VAL_BLK 0xFD6090 KwbUw 65535.00 dez 0.00 65535.00 FORMAT "%8.2" NUMBER 4 /end CHARACTERISTIC
/begin CHARACTERISTIC CDCFRST "Codewort CARB: LR-Abweichung" VAL_BLK 0xFD6098 KwbUw 65535.00 dez 0.00 65535.00 FORMAT "%8.2" NUMBER 4 /end CHARACTERISTIC
/begin CHARACTERISTIC CDCFRST2 "Codewort CARB: LR-Abweichung Bank 2" VAL_BLK 0xFD60A0 KwbUw 65535.00 dez 0.00 65535.00 FORMAT "%8.2" NUMBER 4 /end CHARACTERISTIC
/begin CHARACTERISTIC CDCICLSU "" VAL_BLK 0xFD6118 KwbWU16 65535.00 dez 0.00 65535.00 FORMAT "%8.2" NUMBER 4 /end CHARACTERISTIC
/begin CHARACTERISTIC CDCICLSU2 "" VAL_BLK 0xFD6120 KwbWU16 65535.00 dez 0.00 65535.00 FORMAT "%8.2" NUMBER 4 /end CHARACTERISTIC
/begin CHARACTERISTIC CDCKAT "Codewort CARB:	Katalysator-Konvertierung" VAL_BLK 0xFD6128 KwbWU16 65535.00 dez 0.00 65535.00 FORMAT "%8.2" NUMBER 4 /end CHARACTERISTIC
/begin CHARACTERISTIC CDCKAT2 "Codewort CARB:	Katalysator-Konvertierung	(Bank 2)" VAL_BLK 0xFD6130 KwbWU16 65535.00 dez 0.00 65535.00 FORMAT "%8.2" NUMBER 4 /end CHARACTERISTIC
/begin CHARACTERISTIC CDCKOSE "Codewort CARB: Klima- Kompressorsteurung Endstufe" VAL_BLK 0xFD6138 KwbWU16 65535.00 dez 0.00 65535.00 FORMAT "%8.2" NUMBER 4 /end CHARACTERISTIC
/begin CHARACTERISTIC CDCKRNT "Codewort CARB:	Klopfregelung Nulltest" VAL_BLK 0xFD6148 KwbUw 65535.00 dez 0.00 65535.00 FORMAT "%8.2" NUMBER 4 /end CHARACTERISTIC
/begin CHARACTERISTIC CDCKRNT2 "" VAL_BLK 0xFD6150 KwbUw 65535.00 dez 0.00 65535.00 FORMAT "%8.2" NUMBER 4 /end CHARACTERISTIC
/begin CHARACTERISTIC CDCKROF "Codewort CARB: Klopfregelung Offset" VAL_BLK 0xFD6158 KwbUw 65535.00 dez 0.00 65535.00 FORMAT "%8.2" NUMBER 4 /end CHARACTERISTIC
/begin CHARACTERISTIC CDCKROF2 "" VAL_BLK 0xFD6160 KwbUw 65535.00 dez 0.00 65535.00 FORMAT "%8.2" NUMBER 4 /end CHARACTERISTIC
/begin CHARACTERISTIC CDCKRTP "Codewort CARB: Klopfregelung Testimpulse" VAL_BLK 0xFD6168 KwbUw 65535.00 dez 0.00 65535.00 FORMAT "%8.2" NUMBER 4 /end CHARACTERISTIC
/begin CHARACTERISTIC CDCKRTP2 "" VAL_BLK 0xFD6170 KwbUw 65535.00 dez 0.00 65535.00 FORMAT "%8.2" NUMBER 4 /end CHARACTERISTIC
/begin CHARACTERISTIC CDCKS1 "Codewort CARB:	Klopfsensor 1" VAL_BLK 0xFD6178 KwbUw 65535.00 dez 0.00 65535.00 FORMAT "%8.2" NUMBER 4 /end CHARACTERISTIC
/begin CHARACTERISTIC CDCKS2 "Codewort CARB:	Klopfsensor 2" VAL_BLK 0xFD6180 KwbUw 65535.00 dez 0.00 65535.00 FORMAT "%8.2" NUMBER 4 /end CHARACTERISTIC
/begin CHARACTERISTIC CDCKS3 "Codewort CARB:	Klopfsensor 3" VAL_BLK 0xFD6188 KwbUw 65535.00 dez 0.00 65535.00 FORMAT "%8.2" NUMBER 4 /end CHARACTERISTIC
/begin CHARACTERISTIC CDCKS4 "Codewort CARB:	Klopfsensor 4" VAL_BLK 0xFD6190 KwbUw 65535.00 dez 0.00 65535.00 FORMAT "%8.2" NUMBER 4 /end CHARACTERISTIC
/begin CHARACTERISTIC CDCKUPPL "Codewort CARB: Kupplungspedalwertgeber" VAL_BLK 0xFD6198 KwbUw 65535.00 dez 0.00 65535.00 FORMAT "%8.2" NUMBER 4 /end CHARACTERISTIC
/begin CHARACTERISTIC CDCLASH "Codewort CARB:	Lambda-Sondenalterung hinter Kat." VAL_BLK 0xFD61A0 KwbUw 65535.00 dez 0.00 65535.00 FORMAT "%8.2" NUMBER 4 /end CHARACTERISTIC
/begin CHARACTERISTIC CDCLASH2 "Codewort CARB:	Lambda-Sondenalterung hinter Kat. (Bank 2)" VAL_BLK 0xFD61A8 KwbUw 65535.00 dez 0.00 65535.00 FORMAT "%8.2" NUMBER 4 /end CHARACTERISTIC
/begin CHARACTERISTIC CDCLAVH "Codewort CARB:	Lambda-Sondenalterung (Vollast) hinter Kat." VAL_BLK 0xFD61B0 KwbUw 65535.00 dez 0.00 65535.00 FORMAT "%8.2" NUMBER 4 /end CHARACTERISTIC
/begin CHARACTERISTIC CDCLAVH2 "" VAL_BLK 0xFD61B8 KwbUw 65535.00 dez 0.00 65535.00 FORMAT "%8.2" NUMBER 4 /end CHARACTERISTIC
/begin CHARACTERISTIC CDCLLR "Codewort CARB: Leerlaufregelung am Anschlag" VAL_BLK 0xFD61C0 KwbUw 65535.00 dez 0.00 65535.00 FORMAT "%8.2" NUMBER 4 /end CHARACTERISTIC
/begin CHARACTERISTIC CDCLSH "Codewort CARB:	Lambda-Sonde hinter Kat" VAL_BLK 0xFD61D0 KwbUw 65535.00 dez 0.00 65535.00 FORMAT "%8.2" NUMBER 4 /end CHARACTERISTIC
/begin CHARACTERISTIC CDCLSH2 "Codewort CARB:	Lambda-Sonde 2 hinter Kat" VAL_BLK 0xFD61D8 KwbUw 65535.00 dez 0.00 65535.00 FORMAT "%8.2" NUMBER 4 /end CHARACTERISTIC
/begin CHARACTERISTIC CDCLSUIA "" VAL_BLK 0xFD61E0 KwbWU16 65535.00 dez 0.00 65535.00 FORMAT "%8.2" NUMBER 4 /end CHARACTERISTIC
/begin CHARACTERISTIC CDCLSUIA2 "" VAL_BLK 0xFD61E8 KwbWU16 65535.00 dez 0.00 65535.00 FORMAT "%8.2" NUMBER 4 /end CHARACTERISTIC
/begin CHARACTERISTIC CDCLSUIP "" VAL_BLK 0xFD61F0 KwbWU16 65535.00 dez 0.00 65535.00 FORMAT "%8.2" NUMBER 4 /end CHARACTERISTIC
/begin CHARACTERISTIC CDCLSUIP2 "" VAL_BLK 0xFD61F8 KwbWU16 65535.00 dez 0.00 65535.00 FORMAT "%8.2" NUMBER 4 /end CHARACTERISTIC
/begin CHARACTERISTIC CDCLSUKS "" VAL_BLK 0xFD6200 KwbWU16 65535.00 dez 0.00 65535.00 FORMAT "%8.2" NUMBER 4 /end CHARACTERISTIC
/begin CHARACTERISTIC CDCLSUKS2 "" VAL_BLK 0xFD6208 KwbWU16 65535.00 dez 0.00 65535.00 FORMAT "%8.2" NUMBER 4 /end CHARACTERISTIC
/begin CHARACTERISTIC CDCLSUUN "" VAL_BLK 0xFD6210 KwbWU16 65535.00 dez 0.00 65535.00 FORMAT "%8.2" NUMBER 4 /end CHARACTERISTIC
/begin CHARACTERISTIC CDCLSUUN2 "" VAL_BLK 0xFD6218 KwbWU16 65535.00 dez 0.00 65535.00 FORMAT "%8.2" NUMBER 4 /end CHARACTERISTIC
/begin CHARACTERISTIC CDCLSUVM "" VAL_BLK 0xFD6220 KwbWU16 65535.00 dez 0.00 65535.00 FORMAT "%8.2" NUMBER 4 /end CHARACTERISTIC
/begin CHARACTERISTIC CDCLSUVM2 "" VAL_BLK 0xFD6228 KwbWU16 65535.00 dez 0.00 65535.00 FORMAT "%8.2" NUMBER 4 /end CHARACTERISTIC
/begin CHARACTERISTIC CDCMD "Codewort CARB: Aussetzer, Summenfehler (multiple)" VAL_BLK 0xFD6248 KwbWU16 65535.00 dez 0.00 65535.00 FORMAT "%8.2" NUMBER 4 /end CHARACTERISTIC
/begin CHARACTERISTIC CDCMD00 "Codewort CARB: Aussetzer Zyl. 0" VAL_BLK 0xFD6250 KwbWU16 65535.00 dez 0.00 65535.00 FORMAT "%8.2" NUMBER 4 /end CHARACTERISTIC
/begin CHARACTERISTIC CDCMD01 "Codewort CARB: Aussetzer Zyl. 1" VAL_BLK 0xFD6258 KwbWU16 65535.00 dez 0.00 65535.00 FORMAT "%8.2" NUMBER 4 /end CHARACTERISTIC
/begin CHARACTERISTIC CDCMD02 "Codewort CARB: Aussetzer Zylinder 2" VAL_BLK 0xFD6260 KwbWU16 65535.00 dez 0.00 65535.00 FORMAT "%8.2" NUMBER 4 /end CHARACTERISTIC
/begin CHARACTERISTIC CDCMD03 "Codewort CARB: Aussetzer Zylinder 3" VAL_BLK 0xFD6268 KwbWU16 65535.00 dez 0.00 65535.00 FORMAT "%8.2" NUMBER 4 /end CHARACTERISTIC
/begin CHARACTERISTIC CDCMD04 "Codewort CARB: Aussetzer Zylinder 4" VAL_BLK 0xFD6270 KwbWU16 65535.00 dez 0.00 65535.00 FORMAT "%8.2" NUMBER 4 /end CHARACTERISTIC
/begin CHARACTERISTIC CDCMD05 "Codewort CARB: Aussetzer Zylinder 5" VAL_BLK 0xFD6278 KwbWU16 65535.00 dez 0.00 65535.00 FORMAT "%8.2" NUMBER 4 /end CHARACTERISTIC
/begin CHARACTERISTIC CDCMD06 "Codewort CARB: Aussetzer Zylinder 6" VAL_BLK 0xFD6280 KwbWU16 65535.00 dez 0.00 65535.00 FORMAT "%8.2" NUMBER 4 /end CHARACTERISTIC
/begin CHARACTERISTIC CDCMD07 "Codewort CARB: Aussetzer Zylinder 7" VAL_BLK 0xFD6288 KwbWU16 65535.00 dez 0.00 65535.00 FORMAT "%8.2" NUMBER 4 /end CHARACTERISTIC
/begin CHARACTERISTIC CDCMD08 "Codewort CARB: Aussetzer Zylinder 8" VAL_BLK 0xFD6290 KwbWU16 65535.00 dez 0.00 65535.00 FORMAT "%8.2" NUMBER 4 /end CHARACTERISTIC
/begin CHARACTERISTIC CDCMD09 "Codewort CARB: Aussetzer Zylinder 9" VAL_BLK 0xFD6298 KwbWU16 65535.00 dez 0.00 65535.00 FORMAT "%8.2" NUMBER 4 /end CHARACTERISTIC
/begin CHARACTERISTIC CDCMD10 "Codewort CARB: Aussetzer Zylinder 10" VAL_BLK 0xFD62A0 KwbWU16 65535.00 dez 0.00 65535.00 FORMAT "%8.2" NUMBER 4 /end CHARACTERISTIC
/begin CHARACTERISTIC CDCMD11 "Codewort CARB: Aussetzer Zylinder 11" VAL_BLK 0xFD62A8 KwbWU16 65535.00 dez 0.00 65535.00 FORMAT "%8.2" NUMBER 4 /end CHARACTERISTIC
/begin CHARACTERISTIC CDCMLE "Codewort CARB: Endstufe Motor L¸fter" VAL_BLK 0xFD62C8 KwbWU16 65535.00 dez 0.00 65535.00 FORMAT "%8.2" NUMBER 4 /end CHARACTERISTIC
/begin CHARACTERISTIC CDCNVRBUP "Codewort CARB: NVRAM Backup" VAL_BLK 0xFD62E0 KwbUw 65535.00 dez 0.00 65535.00 FORMAT "%8.2" NUMBER 4 /end CHARACTERISTIC
/begin CHARACTERISTIC CDCRKAT "Codewort CARB: LR-Adaption QL-additiv" VAL_BLK 0xFD6358 KwbUw 65535.00 dez 0.00 65535.00 FORMAT "%8.2" NUMBER 4 /end CHARACTERISTIC
/begin CHARACTERISTIC CDCRKAT2 "Codewort CARB: LR-Adaption QL-additiv Bank 2" VAL_BLK 0xFD6360 KwbUw 65535.00 dez 0.00 65535.00 FORMAT "%8.2" NUMBER 4 /end CHARACTERISTIC
/begin CHARACTERISTIC CDCRKAZ "Codewort CARB: LR-Adaption ti-additiv" VAL_BLK 0xFD6368 KwbUw 65535.00 dez 0.00 65535.00 FORMAT "%8.2" NUMBER 4 /end CHARACTERISTIC
/begin CHARACTERISTIC CDCRKAZ2 "Codewort CARB: LR-Adaption ti-additiv Bank 2" VAL_BLK 0xFD6370 KwbUw 65535.00 dez 0.00 65535.00 FORMAT "%8.2" NUMBER 4 /end CHARACTERISTIC
/begin CHARACTERISTIC CDKANWS "Codewort Kunde: Nockenwellensteuerung Auslass Nockenwelle" VALUE 0xFD64D6 KwWU16 65535.00 DEZ 0.00 65535.00 FORMAT "%8.2" /end CHARACTERISTIC
/begin CHARACTERISTIC CDKANWS2 "Codewort Kunde: Nockenwellensteuerung Auslass Nockenwelle 2" VALUE 0xFD64D8 KwWU16 65535.00 DEZ 0.00 65535.00 FORMAT "%8.2" /end CHARACTERISTIC
/begin CHARACTERISTIC CDKCVVT "Codewort Kunde: LOCAN-Timeout VVT- Botschaft" VALUE 0xFD6502 KwUw 65535.00 dez 0.00 65535.00 FORMAT "%8.2" /end CHARACTERISTIC
/begin CHARACTERISTIC CDKETS "Codewort Kunde: Elektrisches Thermostat" VALUE 0xFD6596 KwWU16 65535.00 dez 0.00 65535.00 FORMAT "%8.2" /end CHARACTERISTIC
/begin CHARACTERISTIC CDKFRAO "Codewort Kunde: LR- Adaption multi. obere Schwelle" VALUE 0xFD65AE KwUw 65535.00 dez 0.00 65535.00 FORMAT "%8.2" /end CHARACTERISTIC
/begin CHARACTERISTIC CDKFRAO2 "Codewort Kunde: LR- Adaption mult. oderer Bereich" VALUE 0xFD65B0 KwUw 65535.00 dez 0.00 65535.00 FORMAT "%8.2" /end CHARACTERISTIC
/begin CHARACTERISTIC CDKFRAU "Codewort Kunde: LR- Adaption multi. untere Schwelle" VALUE 0xFD65B2 KwUw 65535.00 dez 0.00 65535.00 FORMAT "%8.2" /end CHARACTERISTIC
/begin CHARACTERISTIC CDKFRAU2 "Codewort Kunde: LR- Adaption mult. untere Schwelle Bank 2" VALUE 0xFD65B4 KwUw 65535.00 dez 0.00 65535.00 FORMAT "%8.2" /end CHARACTERISTIC
/begin CHARACTERISTIC CDKFRST "Codewort Kunde: LR- Abweichung" VALUE 0xFD65B6 KwUw 65535.00 dez 0.00 65535.00 FORMAT "%8.2" /end CHARACTERISTIC
/begin CHARACTERISTIC CDKFRST2 "Codewort Kunde: LR- Abweichung Bank 2" VALUE 0xFD65B8 KwUw 65535.00 dez 0.00 65535.00 FORMAT "%8.2" /end CHARACTERISTIC
/begin CHARACTERISTIC CDKICLSU "" VALUE 0xFD65D6 KwWU16 65535.00 dez 0.00 65535.00 FORMAT "%8.2" /end CHARACTERISTIC
/begin CHARACTERISTIC CDKICLSU2 "" VALUE 0xFD65D8 KwWU16 65535.00 dez 0.00 65535.00 FORMAT "%8.2" /end CHARACTERISTIC
/begin CHARACTERISTIC CDKKAT "Codewort Kunde:	Katalysator-Konvertierung" VALUE 0xFD65DA KwWU16 65535.00 dez 0.00 65535.00 FORMAT "%8.2" /end CHARACTERISTIC
/begin CHARACTERISTIC CDKKAT2 "Codewort Kunde:	Katalysator-Konvertierung	(Bank 2)" VALUE 0xFD65DC KwWU16 65535.00 dez 0.00 65535.00 FORMAT "%8.2" /end CHARACTERISTIC
/begin CHARACTERISTIC CDKKOSE "Codewort Kunde: Klima- Kompressorsteurung Endstufe" VALUE 0xFD65DE KwWU16 65535.00 dez 0.00 65535.00 FORMAT "%8.2" /end CHARACTERISTIC
/begin CHARACTERISTIC CDKKRNT "Codewort Kunde:	Klopfregelung Nulltest" VALUE 0xFD65E2 KwUw 65535.00 dez 0.00 65535.00 FORMAT "%8.2" /end CHARACTERISTIC
/begin CHARACTERISTIC CDKKRNT2 "" VALUE 0xFD65E4 KwUw 65535.00 dez 0.00 65535.00 FORMAT "%8.2" /end CHARACTERISTIC
/begin CHARACTERISTIC CDKKROF "Codewort Kunde:	Klopfregelung Offset" VALUE 0xFD65E6 KwUw 65535.00 dez 0.00 65535.00 FORMAT "%8.2" /end CHARACTERISTIC
/begin CHARACTERISTIC CDKKROF2 "" VALUE 0xFD65E8 KwUw 65535.00 dez 0.00 65535.00 FORMAT "%8.2" /end CHARACTERISTIC
/begin CHARACTERISTIC CDKKRTP "Codewort Kunde: Klopfregelung Testimpuls" VALUE 0xFD65EA KwUw 65535.00 dez 0.00 65535.00 FORMAT "%8.2" /end CHARACTERISTIC
/begin CHARACTERISTIC CDKKRTP2 "" VALUE 0xFD65EC KwUw 65535.00 dez 0.00 65535.00 FORMAT "%8.2" /end CHARACTERISTIC
/begin CHARACTERISTIC CDKKS1 "Codewort Kunde:	Klopfsensor 1" VALUE 0xFD65EE KwUw 65535.00 dez 0.00 65535.00 FORMAT "%8.2" /end CHARACTERISTIC
/begin CHARACTERISTIC CDKKS2 "Codewort Kunde:	Klopfsensor 2" VALUE 0xFD65F0 KwUw 65535.00 dez 0.00 65535.00 FORMAT "%8.2" /end CHARACTERISTIC
/begin CHARACTERISTIC CDKKS3 "Codewort Kunde:	Klopfsensor 3" VALUE 0xFD65F2 KwUw 65535.00 dez 0.00 65535.00 FORMAT "%8.2" /end CHARACTERISTIC
/begin CHARACTERISTIC CDKKS4 "Codewort Kunde:	Klopfsensor 4" VALUE 0xFD65F4 KwUw 65535.00 dez 0.00 65535.00 FORMAT "%8.2" /end CHARACTERISTIC
/begin CHARACTERISTIC CDKKUPPL "Codewort Kunde: Pedalwertgeber Kupplung" VALUE 0xFD65F6 KwUw 65535.00 dez 0.00 65535.00 FORMAT "%8.2" /end CHARACTERISTIC
/begin CHARACTERISTIC CDKLASH "Codewort Kunde: Lambda-Sondenalterung hinter Kat." VALUE 0xFD65F8 KwUw 65535.00 dez 0.00 65535.00 FORMAT "%8.2" /end CHARACTERISTIC
/begin CHARACTERISTIC CDKLASH2 "Codewort Kunde: Lambda-Sondenalterung hinter Kat.  Bank 2" VALUE 0xFD65FA KwUw 65535.00 dez 0.00 65535.00 FORMAT "%8.2" /end CHARACTERISTIC
/begin CHARACTERISTIC CDKLAVH "" VALUE 0xFD65FC KwUw 65535.00 dez 0.00 65535.00 FORMAT "%8.2" /end CHARACTERISTIC
/begin CHARACTERISTIC CDKLAVH2 "" VALUE 0xFD65FE KwUw 65535.00 dez 0.00 65535.00 FORMAT "%8.2" /end CHARACTERISTIC
/begin CHARACTERISTIC CDKLLR "Codewort Kunde: Leerlaufregelung am Anschlag" VALUE 0xFD6600 KwUw 65535.00 dez 0.00 65535.00 FORMAT "%8.2" /end CHARACTERISTIC
/begin CHARACTERISTIC CDKLSH "Codewort Kunde: Lambda-Sonde hinter Kat" VALUE 0xFD6604 KwUw 65535.00 dez 0.00 65535.00 FORMAT "%8.2" /end CHARACTERISTIC
/begin CHARACTERISTIC CDKLSH2 "Codewort Kunde: Lambda-Sonde 2 hinter Kat" VALUE 0xFD6606 KwUw 65535.00 dez 0.00 65535.00 FORMAT "%8.2" /end CHARACTERISTIC
/begin CHARACTERISTIC CDKLSUIA "" VALUE 0xFD6608 KwWU16 65535.00 dez 0.00 65535.00 FORMAT "%8.2" /end CHARACTERISTIC
/begin CHARACTERISTIC CDKLSUIA2 "" VALUE 0xFD660A KwWU16 65535.00 dez 0.00 65535.00 FORMAT "%8.2" /end CHARACTERISTIC
/begin CHARACTERISTIC CDKLSUIP "" VALUE 0xFD660C KwWU16 65535.00 dez 0.00 65535.00 FORMAT "%8.2" /end CHARACTERISTIC
/begin CHARACTERISTIC CDKLSUIP2 "" VALUE 0xFD660E KwWU16 65535.00 dez 0.00 65535.00 FORMAT "%8.2" /end CHARACTERISTIC
/begin CHARACTERISTIC CDKLSUKS "" VALUE 0xFD6610 KwWU16 65535.00 dez 0.00 65535.00 FORMAT "%8.2" /end CHARACTERISTIC
/begin CHARACTERISTIC CDKLSUKS2 "" VALUE 0xFD6612 KwWU16 65535.00 dez 0.00 65535.00 FORMAT "%8.2" /end CHARACTERISTIC
/begin CHARACTERISTIC CDKLSUUN "" VALUE 0xFD6614 KwWU16 65535.00 dez 0.00 65535.00 FORMAT "%8.2" /end CHARACTERISTIC
/begin CHARACTERISTIC CDKLSUUN2 "" VALUE 0xFD6616 KwWU16 65535.00 dez 0.00 65535.00 FORMAT "%8.2" /end CHARACTERISTIC
/begin CHARACTERISTIC CDKLSUVM "" VALUE 0xFD6618 KwWU16 65535.00 dez 0.00 65535.00 FORMAT "%8.2" /end CHARACTERISTIC
/begin CHARACTERISTIC CDKLSUVM2 "" VALUE 0xFD661A KwWU16 65535.00 dez 0.00 65535.00 FORMAT "%8.2" /end CHARACTERISTIC
/begin CHARACTERISTIC CDKMD "Codewort Kunde: Aussetzer, Summenfehler (multiple)" VALUE 0xFD6622 KwWU16 65535.00 dez 0.00 65535.00 FORMAT "%8.2" /end CHARACTERISTIC
/begin CHARACTERISTIC CDKMD00 "Codewort Kunde: Aussetzer Zyl. 0" VALUE 0xFD6624 KwWU16 65535.00 dez 0.00 65535.00 FORMAT "%8.2" /end CHARACTERISTIC
/begin CHARACTERISTIC CDKMD01 "Codewort Kunde: Aussetzer Zyl. 1" VALUE 0xFD6626 KwWU16 65535.00 dez 0.00 65535.00 FORMAT "%8.2" /end CHARACTERISTIC
/begin CHARACTERISTIC CDKMD02 "Codewort Kunde: Aussetzer Zylinder 2" VALUE 0xFD6628 KwWU16 65535.00 dez 0.00 65535.00 FORMAT "%8.2" /end CHARACTERISTIC
/begin CHARACTERISTIC CDKMD03 "Codewort Kunde: Aussetzer Zylinder 3" VALUE 0xFD662A KwWU16 65535.00 dez 0.00 65535.00 FORMAT "%8.2" /end CHARACTERISTIC
/begin CHARACTERISTIC CDKMD04 "Codewort Kunde: Aussetzer Zylinder 4" VALUE 0xFD662C KwWU16 65535.00 dez 0.00 65535.00 FORMAT "%8.2" /end CHARACTERISTIC
/begin CHARACTERISTIC CDKMD05 "Codewort Kunde: Aussetzer Zylinder 5" VALUE 0xFD662E KwWU16 65535.00 dez 0.00 65535.00 FORMAT "%8.2" /end CHARACTERISTIC
/begin CHARACTERISTIC CDKMD06 "Codewort Kunde: Aussetzer Zylinder 6" VALUE 0xFD6630 KwWU16 65535.00 dez 0.00 65535.00 FORMAT "%8.2" /end CHARACTERISTIC
/begin CHARACTERISTIC CDKMD07 "Codewort Kunde: Aussetzer Zylinder 7" VALUE 0xFD6632 KwWU16 65535.00 dez 0.00 65535.00 FORMAT "%8.2" /end CHARACTERISTIC
/begin CHARACTERISTIC CDKMD08 "Codewort Kunde: Aussetzer Zylinder 8" VALUE 0xFD6634 KwWU16 65535.00 dez 0.00 65535.00 FORMAT "%8.2" /end CHARACTERISTIC
/begin CHARACTERISTIC CDKMD09 "Codewort Kunde: Aussetzer Zylinder 9" VALUE 0xFD6636 KwWU16 65535.00 dez 0.00 65535.00 FORMAT "%8.2" /end CHARACTERISTIC
/begin CHARACTERISTIC CDKMD10 "Codewort Kunde: Aussetzer Zylinder 10" VALUE 0xFD6638 KwWU16 65535.00 dez 0.00 65535.00 FORMAT "%8.2" /end CHARACTERISTIC
/begin CHARACTERISTIC CDKMD11 "Codewort Kunde: Aussetzer Zylinder 11" VALUE 0xFD663A KwWU16 65535.00 dez 0.00 65535.00 FORMAT "%8.2" /end CHARACTERISTIC
/begin CHARACTERISTIC CDKMLE "Codewort Kunde: Motorl¸fter- Endstufe" VALUE 0xFD6642 KwWU16 65535.00 dez 0.00 65535.00 FORMAT "%8.2" /end CHARACTERISTIC
/begin CHARACTERISTIC CDKNVRBUP "Codewort Kunde: NVRAM Backup" VALUE 0xFD6648 KwUw 65535.00 dez 0.00 65535.00 FORMAT "%8.2" /end CHARACTERISTIC
/begin CHARACTERISTIC CDKRKAT "Codewort Kunde: LR- Adaption pro Zeit" VALUE 0xFD6666 KwUw 65535.00 dez 0.00 65535.00 FORMAT "%8.2" /end CHARACTERISTIC
/begin CHARACTERISTIC CDKRKAT2 "Codewort Kunde: LR- Adaption pro Zeit Bank 2" VALUE 0xFD6668 KwUw 65535.00 dez 0.00 65535.00 FORMAT "%8.2" /end CHARACTERISTIC
/begin CHARACTERISTIC CDKRKAZ "Codewort Kunde: LR- Adaption additiv pro Z¸ndung" VALUE 0xFD666A KwUw 65535.00 dez 0.00 65535.00 FORMAT "%8.2" /end CHARACTERISTIC
/begin CHARACTERISTIC CDKRKAZ2 "Codewort Kunde: Lambdaregelungsadaption Kraftstoff (Bank 2)" VALUE 0xFD666C KwUw 65535.00 dez 0.00 65535.00 FORMAT "%8.2" /end CHARACTERISTIC
/begin CHARACTERISTIC CDTANWS "Codewort Tester: Nockenwellensteuerung Auslass Nockenwelle" VALUE 0xFD66CA KwWU16 65535.00 DEZ 0.00 65535.00 FORMAT "%8.2" /end CHARACTERISTIC
/begin CHARACTERISTIC CDTANWS2 "Codewort Tester: Nockenwellensteuerung Auslass Nockenwelle 2" VALUE 0xFD66CC KwWU16 65535.00 DEZ 0.00 65535.00 FORMAT "%8.2" /end CHARACTERISTIC
/begin CHARACTERISTIC CDTCVVT "Codewort Tester: LOCAN-Schnittstelle, Timeout VVT" VALUE 0xFD66F6 KwUw 65535.00 dez 0.00 65535.00 FORMAT "%8.2" /end CHARACTERISTIC
/begin CHARACTERISTIC CDTETS "Codewort Tester: Elektrisches Thermostat" VALUE 0xFD678A KwWU16 65535.00 dez 0.00 65535.00 FORMAT "%8.2" /end CHARACTERISTIC
/begin CHARACTERISTIC CDTFRAO "Codewort Tester: LR-Adaption multiplikativ obere Schwelle" VALUE 0xFD67A2 KwUw 65535.00 dez 0.00 65535.00 FORMAT "%8.2" /end CHARACTERISTIC
/begin CHARACTERISTIC CDTFRAO2 "Codewort Tester: LR-Adaption multiplikativ obere Schwelle Bank 2" VALUE 0xFD67A4 KwUw 65535.00 dez 0.00 65535.00 FORMAT "%8.2" /end CHARACTERISTIC
/begin CHARACTERISTIC CDTFRAU "Codewort Tester: LR-Adaption multiplikativ untere Schwelle" VALUE 0xFD67A6 KwUw 65535.00 dez 0.00 65535.00 FORMAT "%8.2" /end CHARACTERISTIC
/begin CHARACTERISTIC CDTFRAU2 "Codewort Tester: LR-Adaption multiplikativ untere Schwelle Bank 2" VALUE 0xFD67A8 KwUw 65535.00 dez 0.00 65535.00 FORMAT "%8.2" /end CHARACTERISTIC
/begin CHARACTERISTIC CDTFRST "Codewort Tester: LR-Abweichung" VALUE 0xFD67AA KwUw 65535.00 dez 0.00 65535.00 FORMAT "%8.2" /end CHARACTERISTIC
/begin CHARACTERISTIC CDTFRST2 "Codewort Tester: LR-Abweichung Bank 2" VALUE 0xFD67AC KwUw 65535.00 dez 0.00 65535.00 FORMAT "%8.2" /end CHARACTERISTIC
/begin CHARACTERISTIC CDTICLSU "Codewort Tester: Auswerte-IC f¸r LSU" VALUE 0xFD67CA KwWU16 65535.00 dez 0.00 65535.00 FORMAT "%8.2" /end CHARACTERISTIC
/begin CHARACTERISTIC CDTICLSU2 "Codewort Tester: Auswerte-IC f¸r LSU, Bank 2" VALUE 0xFD67CC KwWU16 65535.00 dez 0.00 65535.00 FORMAT "%8.2" /end CHARACTERISTIC
/begin CHARACTERISTIC CDTKAT "Codewort Tester: Katalysator-Konvertierung" VALUE 0xFD67CE KwWU16 65535.00 dez 0.00 65535.00 FORMAT "%8.2" /end CHARACTERISTIC
/begin CHARACTERISTIC CDTKAT2 "Codewort Tester: Katalysator-Konvertierung (Bank 2)" VALUE 0xFD67D0 KwWU16 65535.00 dez 0.00 65535.00 FORMAT "%8.2" /end CHARACTERISTIC
/begin CHARACTERISTIC CDTKOSE "Codewort Tester: Klima- Kompressorsteurung Endstufe" VALUE 0xFD67D2 KwWU16 65535.00 dez 0.00 65535.00 FORMAT "%8.2" /end CHARACTERISTIC
/begin CHARACTERISTIC CDTKRNT "Codewort Tester: Klopfregelung Nulltest" VALUE 0xFD67D6 KwUw 65535.00 dez 0.00 65535.00 FORMAT "%8.2" /end CHARACTERISTIC
/begin CHARACTERISTIC CDTKRNT2 "Codewort Tester: Klopfregelung Nulltest, Bank 2" VALUE 0xFD67D8 KwUw 65535.00 dez 0.00 65535.00 FORMAT "%8.2" /end CHARACTERISTIC
/begin CHARACTERISTIC CDTKROF "Codewort Tester: Klopfregelung Offset" VALUE 0xFD67DA KwUw 65535.00 dez 0.00 65535.00 FORMAT "%8.2" /end CHARACTERISTIC
/begin CHARACTERISTIC CDTKROF2 "Codewort Tester: Klopfregelung Offset, Bank 2" VALUE 0xFD67DC KwUw 65535.00 dez 0.00 65535.00 FORMAT "%8.2" /end CHARACTERISTIC
/begin CHARACTERISTIC CDTKRTP "Codewort Tester: Klopfregelung Testimpuls" VALUE 0xFD67DE KwUw 65535.00 dez 0.00 65535.00 FORMAT "%8.2" /end CHARACTERISTIC
/begin CHARACTERISTIC CDTKRTP2 "Codewort Tester: Klopfregelung Testimpuls, Bank 2" VALUE 0xFD67E0 KwUw 65535.00 dez 0.00 65535.00 FORMAT "%8.2" /end CHARACTERISTIC
/begin CHARACTERISTIC CDTKS1 "Codewort Tester: Klopfsensor 1" VALUE 0xFD67E2 KwUw 65535.00 dez 0.00 65535.00 FORMAT "%8.2" /end CHARACTERISTIC
/begin CHARACTERISTIC CDTKS2 "Codewort Tester: Klopfsensor 2" VALUE 0xFD67E4 KwUw 65535.00 dez 0.00 65535.00 FORMAT "%8.2" /end CHARACTERISTIC
/begin CHARACTERISTIC CDTKS3 "Codewort Tester: Klopfsensor 3" VALUE 0xFD67E6 KwUw 65535.00 dez 0.00 65535.00 FORMAT "%8.2" /end CHARACTERISTIC
/begin CHARACTERISTIC CDTKS4 "Codewort Tester: Klopfsensor 4" VALUE 0xFD67E8 KwUw 65535.00 dez 0.00 65535.00 FORMAT "%8.2" /end CHARACTERISTIC
/begin CHARACTERISTIC CDTKUPPL "Fehlerpfadcode: Pedalwertgeber Kupplung" VALUE 0xFD67EA KwUw 65535.00 dez 0.00 65535.00 FORMAT "%8.2" /end CHARACTERISTIC
/begin CHARACTERISTIC CDTLASH "Codewort Tester: Lambda-Sondenalterung hinter Kat" VALUE 0xFD67EC KwUw 65535.00 dez 0.00 65535.00 FORMAT "%8.2" /end CHARACTERISTIC
/begin CHARACTERISTIC CDTLASH2 "Codewort Tester: Lambda-Sondenalterung hinter Kat. Bank2" VALUE 0xFD67EE KwUw 65535.00 dez 0.00 65535.00 FORMAT "%8.2" /end CHARACTERISTIC
/begin CHARACTERISTIC CDTLAVH "" VALUE 0xFD67F0 KwUw 65535.00 dez 0.00 65535.00 FORMAT "%8.2" /end CHARACTERISTIC
/begin CHARACTERISTIC CDTLAVH2 "" VALUE 0xFD67F2 KwUw 65535.00 dez 0.00 65535.00 FORMAT "%8.2" /end CHARACTERISTIC
/begin CHARACTERISTIC CDTLLR "Codewort Tester: Leerlaufregelung am Anschlag" VALUE 0xFD67F4 KwUw 65535.00 dez 0.00 65535.00 FORMAT "%8.2" /end CHARACTERISTIC
/begin CHARACTERISTIC CDTLSH "Codewort Tester: Lambda-Sonde hinter Kat" VALUE 0xFD67F8 KwUw 65535.00 dez 0.00 65535.00 FORMAT "%8.2" /end CHARACTERISTIC
/begin CHARACTERISTIC CDTLSH2 "Codewort Tester: Lambda-Sonde 2 hinter Kat" VALUE 0xFD67FA KwUw 65535.00 dez 0.00 65535.00 FORMAT "%8.2" /end CHARACTERISTIC
/begin CHARACTERISTIC CDTLSUIA "Codewort Tester: Diagnose Lambdasondenleitung an Bond IA" VALUE 0xFD67FC KwWU16 65535.00 dez 0.00 65535.00 FORMAT "%8.2" /end CHARACTERISTIC
/begin CHARACTERISTIC CDTLSUIA2 "Codewort Tester: Diagnose Lambdasondenleitung an Bond IA, Bank 2" VALUE 0xFD67FE KwWU16 65535.00 dez 0.00 65535.00 FORMAT "%8.2" /end CHARACTERISTIC
/begin CHARACTERISTIC CDTLSUIP "" VALUE 0xFD6800 KwWU16 65535.00 dez 0.00 65535.00 FORMAT "%8.2" /end CHARACTERISTIC
/begin CHARACTERISTIC CDTLSUIP2 "" VALUE 0xFD6802 KwWU16 65535.00 dez 0.00 65535.00 FORMAT "%8.2" /end CHARACTERISTIC
/begin CHARACTERISTIC CDTLSUKS "" VALUE 0xFD6804 KwWU16 65535.00 dez 0.00 65535.00 FORMAT "%8.2" /end CHARACTERISTIC
/begin CHARACTERISTIC CDTLSUKS2 "" VALUE 0xFD6806 KwWU16 65535.00 dez 0.00 65535.00 FORMAT "%8.2" /end CHARACTERISTIC
/begin CHARACTERISTIC CDTLSUUN "Codewort Tester: Diagnose Lambdasondenleitung an Bond UN" VALUE 0xFD6808 KwWU16 65535.00 dez 0.00 65535.00 FORMAT "%8.2" /end CHARACTERISTIC
/begin CHARACTERISTIC CDTLSUUN2 "Codewort Tester: Diagnose Lambdasondenleitung an Bond UN, Bank 2" VALUE 0xFD680A KwWU16 65535.00 dez 0.00 65535.00 FORMAT "%8.2" /end CHARACTERISTIC
/begin CHARACTERISTIC CDTLSUVM "Codewort Tester: Diagnose Lambdasondenleitung an Bond VM" VALUE 0xFD680C KwWU16 65535.00 dez 0.00 65535.00 FORMAT "%8.2" /end CHARACTERISTIC
/begin CHARACTERISTIC CDTLSUVM2 "Codewort Tester: Diagnose Lambdasondenleitung an Bond VM, Bank 2" VALUE 0xFD680E KwWU16 65535.00 dez 0.00 65535.00 FORMAT "%8.2" /end CHARACTERISTIC
/begin CHARACTERISTIC CDTMD "Codewort Tester: Aussetzer, Summenfehler (multiple)" VALUE 0xFD6816 KwWU16 65535.00 dez 0.00 65535.00 FORMAT "%8.2" /end CHARACTERISTIC
/begin CHARACTERISTIC CDTMD00 "Codewort Tester: Aussetzer Zyl. 0" VALUE 0xFD6818 KwWU16 65535.00 dez 0.00 65535.00 FORMAT "%8.2" /end CHARACTERISTIC
/begin CHARACTERISTIC CDTMD01 "Codewort Tester: Aussetzer Zyl. 1" VALUE 0xFD681A KwWU16 65535.00 dez 0.00 65535.00 FORMAT "%8.2" /end CHARACTERISTIC
/begin CHARACTERISTIC CDTMD02 "Codewort Tester: Aussetzer Zylinder 2" VALUE 0xFD681C KwWU16 65535.00 dez 0.00 65535.00 FORMAT "%8.2" /end CHARACTERISTIC
/begin CHARACTERISTIC CDTMD03 "Codewort Tester: Aussetzer Zylinder 3" VALUE 0xFD681E KwWU16 65535.00 dez 0.00 65535.00 FORMAT "%8.2" /end CHARACTERISTIC
/begin CHARACTERISTIC CDTMD04 "Codewort Tester: Aussetzer Zylinder 4" VALUE 0xFD6820 KwWU16 65535.00 dez 0.00 65535.00 FORMAT "%8.2" /end CHARACTERISTIC
/begin CHARACTERISTIC CDTMD05 "Codewort Tester: Aussetzer Zylinder 5" VALUE 0xFD6822 KwWU16 65535.00 dez 0.00 65535.00 FORMAT "%8.2" /end CHARACTERISTIC
/begin CHARACTERISTIC CDTMD06 "Codewort Tester: Aussetzer Zylinder 6" VALUE 0xFD6824 KwWU16 65535.00 dez 0.00 65535.00 FORMAT "%8.2" /end CHARACTERISTIC
/begin CHARACTERISTIC CDTMD07 "Codewort Tester: Aussetzer Zylinder 7" VALUE 0xFD6826 KwWU16 65535.00 dez 0.00 65535.00 FORMAT "%8.2" /end CHARACTERISTIC
/begin CHARACTERISTIC CDTMD08 "Codewort Tester: Aussetzer Zylinder 8" VALUE 0xFD6828 KwWU16 65535.00 dez 0.00 65535.00 FORMAT "%8.2" /end CHARACTERISTIC
/begin CHARACTERISTIC CDTMD09 "Codewort Tester: Aussetzer Zylinder 9" VALUE 0xFD682A KwWU16 65535.00 dez 0.00 65535.00 FORMAT "%8.2" /end CHARACTERISTIC
/begin CHARACTERISTIC CDTMD10 "Codewort Tester: Aussetzer Zylinder 10" VALUE 0xFD682C KwWU16 65535.00 dez 0.00 65535.00 FORMAT "%8.2" /end CHARACTERISTIC
/begin CHARACTERISTIC CDTMD11 "Codewort Tester: Aussetzer Zylinder 11" VALUE 0xFD682E KwWU16 65535.00 dez 0.00 65535.00 FORMAT "%8.2" /end CHARACTERISTIC
/begin CHARACTERISTIC CDTMLE "Codewort Tester: Endstufe L¸fter" VALUE 0xFD6836 KwWU16 65535.00 dez 0.00 65535.00 FORMAT "%8.2" /end CHARACTERISTIC
/begin CHARACTERISTIC CDTNVRBUP "Codewort Tester: NVRAM Backup" VALUE 0xFD683C KwUw 65535.00 dez 0.00 65535.00 FORMAT "%8.2" /end CHARACTERISTIC
/begin CHARACTERISTIC CDTRKAT "Codewort Tester: LR-Adaption additiv pro Zeit" VALUE 0xFD685A KwUw 65535.00 dez 0.00 65535.00 FORMAT "%8.2" /end CHARACTERISTIC
/begin CHARACTERISTIC CDTRKAT2 "Codewort Tester: LR-Adaption additiv pro Zeit bank 2" VALUE 0xFD685C KwUw 65535.00 dez 0.00 65535.00 FORMAT "%8.2" /end CHARACTERISTIC
/begin CHARACTERISTIC CDTRKAZ "Codewort Tester: LR-Adaption additiv pro Z¸ndung" VALUE 0xFD685E KwUw 65535.00 dez 0.00 65535.00 FORMAT "%8.2" /end CHARACTERISTIC
/begin CHARACTERISTIC CDTRKAZ2 "Codewort Tester: LR-Adaption additiv pro Z¸ndung bank 2" VALUE 0xFD6860 KwUw 65535.00 dez 0.00 65535.00 FORMAT "%8.2" /end CHARACTERISTIC
/begin CHARACTERISTIC CLAANWS "Fehlerklasse: Nockenwellensteuerung Auslass Nockenwelle" VALUE 0xFD5726 KwWU8 255.0 DEZ 0.00 255.0 FORMAT "%5.1" /end CHARACTERISTIC
/begin CHARACTERISTIC CLAANWS2 "Fehlerklasse: Nockenwellensteuerung Auslass Nockenwelle 2" VALUE 0xFD5727 KwWU8 255.0 DEZ 0.00 255.0 FORMAT "%5.1" /end CHARACTERISTIC
/begin CHARACTERISTIC CLACVVT "Fehlerklasse: LOCAN-Timeout VVT-Botschaft" VALUE 0xFD573C KwUb 255.0 dez 0.00 255.0 FORMAT "%5.1" /end CHARACTERISTIC
/begin CHARACTERISTIC CLAETS "Fehlerklasse: ETS-Endstufe" VALUE 0xFD5786 KwWU8 255.0 dez 0.00 255.0 FORMAT "%5.1" /end CHARACTERISTIC
/begin CHARACTERISTIC CLAFRAO "Fehlerklasse: LR-Adaption oberer Bereich" VALUE 0xFD5792 KwUb 255.0 dez 0.00 255.0 FORMAT "%5.1" /end CHARACTERISTIC
/begin CHARACTERISTIC CLAFRAO2 "Fehlerklasse: LR-Adaption oberer Bereich Bank 2" VALUE 0xFD5793 KwUb 255.0 dez 0.00 255.0 FORMAT "%5.1" /end CHARACTERISTIC
/begin CHARACTERISTIC CLAFRAU "Fehlerklasse: LR-Adaption unterer Bereich" VALUE 0xFD5794 KwUb 255.0 dez 0.00 255.0 FORMAT "%5.1" /end CHARACTERISTIC
/begin CHARACTERISTIC CLAFRAU2 "Fehlerklasse: LR-Adaption unterer Bereich Bank 2" VALUE 0xFD5795 KwUb 255.0 dez 0.00 255.0 FORMAT "%5.1" /end CHARACTERISTIC
/begin CHARACTERISTIC CLAFRST "Fehlerklasse: LR-Abweichung" VALUE 0xFD5796 KwUb 255.0 dez 0.00 255.0 FORMAT "%5.1" /end CHARACTERISTIC
/begin CHARACTERISTIC CLAFRST2 "Fehlerklasse : LR-Abweichung Bank 2" VALUE 0xFD5797 KwUb 255.0 dez 0.00 255.0 FORMAT "%5.1" /end CHARACTERISTIC
/begin CHARACTERISTIC CLAICLSU "Fehlerklasse: Auswerte-IC f¸r LSU" VALUE 0xFD57A6 KwWU8 255.0 dez 0.00 255.0 FORMAT "%5.1" /end CHARACTERISTIC
/begin CHARACTERISTIC CLAICLSU2 "Fehlerklasse: Auswerte-IC f¸r LSU, Bank 2" VALUE 0xFD57A7 KwWU8 255.0 dez 0.00 255.0 FORMAT "%5.1" /end CHARACTERISTIC
/begin CHARACTERISTIC CLAKAT "Fehlerklasse: Katalysator" VALUE 0xFD57A8 KwWU8 255.0 dez 0.00 255.0 FORMAT "%5.1" /end CHARACTERISTIC
/begin CHARACTERISTIC CLAKAT2 "Fehlerklasse: Katalysator Bank 2" VALUE 0xFD57A9 KwWU8 255.0 dez 0.00 255.0 FORMAT "%5.1" /end CHARACTERISTIC
/begin CHARACTERISTIC CLAKOSE "Fehlerklasse: Klima- Kompressorsteurung Endstufe" VALUE 0xFD57AA KwWU8 255.0 dez 0.00 255.0 FORMAT "%5.1" /end CHARACTERISTIC
/begin CHARACTERISTIC CLAKRNT "Fehlerklasse: Klopfregelung Nulltest" VALUE 0xFD57AC KwUb 255.0 dez 0.00 255.0 FORMAT "%5.1" /end CHARACTERISTIC
/begin CHARACTERISTIC CLAKRNT2 "Fehlerklasse: Klopfregelung Nulltest, Bank 2" VALUE 0xFD57AD KwUb 255.0 dez 0.00 255.0 FORMAT "%5.1" /end CHARACTERISTIC
/begin CHARACTERISTIC CLAKROF "Fehlerklasse: Klopfreglung Offset" VALUE 0xFD57AE KwUb 255.0 dez 0.00 255.0 FORMAT "%5.1" /end CHARACTERISTIC
/begin CHARACTERISTIC CLAKROF2 "Fehlerklasse: Klopfreglung Offset, Bank 2" VALUE 0xFD57AF KwUb 255.0 dez 0.00 255.0 FORMAT "%5.1" /end CHARACTERISTIC
/begin CHARACTERISTIC CLAKRTP "Fehlerklasse: Klopfregelung Testimpuls" VALUE 0xFD57B0 KwUb 255.0 dez 0.00 255.0 FORMAT "%5.1" /end CHARACTERISTIC
/begin CHARACTERISTIC CLAKRTP2 "Fehlerklasse: Klopfregelung Testimpuls, Bank 2" VALUE 0xFD57B1 KwUb 255.0 dez 0.00 255.0 FORMAT "%5.1" /end CHARACTERISTIC
/begin CHARACTERISTIC CLAKS1 "Fehlerklasse: Klopfsensor 1" VALUE 0xFD57B2 KwUb 255.0 dez 0.00 255.0 FORMAT "%5.1" /end CHARACTERISTIC
/begin CHARACTERISTIC CLAKS2 "Fehlerklasse: Klopfsensor 2" VALUE 0xFD57B3 KwUb 255.0 dez 0.00 255.0 FORMAT "%5.1" /end CHARACTERISTIC
/begin CHARACTERISTIC CLAKS3 "Fehlerklasse: Klopfsensor 3" VALUE 0xFD57B4 KwUb 255.0 dez 0.00 255.0 FORMAT "%5.1" /end CHARACTERISTIC
/begin CHARACTERISTIC CLAKS4 "Fehlerklasse: Klopfsensor 4" VALUE 0xFD57B5 KwUb 255.0 dez 0.00 255.0 FORMAT "%5.1" /end CHARACTERISTIC
/begin CHARACTERISTIC CLAKUPPL "Fehlerklasse: Pedalwertgeber Kupplung" VALUE 0xFD57B6 KwUb 255.0 dez 0.00 255.0 FORMAT "%5.1" /end CHARACTERISTIC
/begin CHARACTERISTIC CLALASH "Fehlerklasse: Lambdasondenalterung hinter Kat" VALUE 0xFD57B7 KwUb 255.0 dez 0.00 255.0 FORMAT "%5.1" /end CHARACTERISTIC
/begin CHARACTERISTIC CLALASH2 "Fehlerklasse: Lambdasondenalterung hinter Kat Bank2" VALUE 0xFD57B8 KwUb 255.0 dez 0.00 255.0 FORMAT "%5.1" /end CHARACTERISTIC
/begin CHARACTERISTIC CLALAVH "" VALUE 0xFD57B9 KwUb 255.0 dez 0.00 255.0 FORMAT "%5.1" /end CHARACTERISTIC
/begin CHARACTERISTIC CLALAVH2 "" VALUE 0xFD57BA KwUb 255.0 dez 0.00 255.0 FORMAT "%5.1" /end CHARACTERISTIC
/begin CHARACTERISTIC CLALLR "Fehlerklasse: Leerlaufregelung" VALUE 0xFD57BB KwUb 255.0 dez 0.00 255.0 FORMAT "%5.1" /end CHARACTERISTIC
/begin CHARACTERISTIC CLALSH "Fehlerklasse: Lambdasonde hinter Kat" VALUE 0xFD57BD KwUb 255.0 dez 0.00 255.0 FORMAT "%5.1" /end CHARACTERISTIC
/begin CHARACTERISTIC CLALSH2 "Fehlerklasse: Lambdasonde 2 hinter Kat" VALUE 0xFD57BE KwUb 255.0 dez 0.00 255.0 FORMAT "%5.1" /end CHARACTERISTIC
/begin CHARACTERISTIC CLALSUIA "Fehlerklasse: Diagnose Lambdasondenleitung an Bond IA" VALUE 0xFD57BF KwWU8 255.0 dez 0.00 255.0 FORMAT "%5.1" /end CHARACTERISTIC
/begin CHARACTERISTIC CLALSUIA2 "Fehlerklasse: Diagnose Lambdasondenleitung an Bond IA, Bank 2" VALUE 0xFD57C0 KwWU8 255.0 dez 0.00 255.0 FORMAT "%5.1" /end CHARACTERISTIC
/begin CHARACTERISTIC CLALSUIP "" VALUE 0xFD57C1 KwWU8 255.0 dez 0.00 255.0 FORMAT "%5.1" /end CHARACTERISTIC
/begin CHARACTERISTIC CLALSUIP2 "" VALUE 0xFD57C2 KwWU8 255.0 dez 0.00 255.0 FORMAT "%5.1" /end CHARACTERISTIC
/begin CHARACTERISTIC CLALSUKS "" VALUE 0xFD57C3 KwWU8 255.0 dez 0.00 255.0 FORMAT "%5.1" /end CHARACTERISTIC
/begin CHARACTERISTIC CLALSUKS2 "" VALUE 0xFD57C4 KwWU8 255.0 dez 0.00 255.0 FORMAT "%5.1" /end CHARACTERISTIC
/begin CHARACTERISTIC CLALSUUN "Fehlerklasse: Diagnose Lambdasondenleitung an Bond UN" VALUE 0xFD57C5 KwWU8 255.0 dez 0.00 255.0 FORMAT "%5.1" /end CHARACTERISTIC
/begin CHARACTERISTIC CLALSUUN2 "Fehlerklasse: Diagnose Lambdasondenleitung an Bond UN, Bank 2" VALUE 0xFD57C6 KwWU8 255.0 dez 0.00 255.0 FORMAT "%5.1" /end CHARACTERISTIC
/begin CHARACTERISTIC CLALSUVM "Fehlerklasse: Diagnose Lambdasondenleitung an Bond VM" VALUE 0xFD57C7 KwWU8 255.0 dez 0.00 255.0 FORMAT "%5.1" /end CHARACTERISTIC
/begin CHARACTERISTIC CLALSUVM2 "Fehlerklasse: Diagnose Lambdasondenleitung an Bond VM, Bank 2" VALUE 0xFD57C8 KwWU8 255.0 dez 0.00 255.0 FORMAT "%5.1" /end CHARACTERISTIC
/begin CHARACTERISTIC CLAMD "Fehlerklasse:  Aussetzer, Summenfehler (multiple)" VALUE 0xFD57CC KwWU8 255.0 dez 0.00 255.0 FORMAT "%5.1" /end CHARACTERISTIC
/begin CHARACTERISTIC CLAMD00 "Fehlerklasse:  Aussetzer Zyl. 0" VALUE 0xFD57CD KwWU8 255.0 dez 0.00 255.0 FORMAT "%5.1" /end CHARACTERISTIC
/begin CHARACTERISTIC CLAMD01 "Fehlerklasse:  Aussetzer Zyl. 1" VALUE 0xFD57CE KwWU8 255.0 dez 0.00 255.0 FORMAT "%5.1" /end CHARACTERISTIC
/begin CHARACTERISTIC CLAMD02 "Fehlerklasse:  Aussetzer Zylinder 2" VALUE 0xFD57CF KwWU8 255.0 dez 0.00 255.0 FORMAT "%5.1" /end CHARACTERISTIC
/begin CHARACTERISTIC CLAMD03 "Fehlerklasse:  Aussetzer Zylinder 3" VALUE 0xFD57D0 KwWU8 255.0 dez 0.00 255.0 FORMAT "%5.1" /end CHARACTERISTIC
/begin CHARACTERISTIC CLAMD04 "Fehlerklasse:  Aussetzer Zylinder 4" VALUE 0xFD57D1 KwWU8 255.0 dez 0.00 255.0 FORMAT "%5.1" /end CHARACTERISTIC
/begin CHARACTERISTIC CLAMD05 "Fehlerklasse:  Aussetzer Zylinder 5" VALUE 0xFD57D2 KwWU8 255.0 dez 0.00 255.0 FORMAT "%5.1" /end CHARACTERISTIC
/begin CHARACTERISTIC CLAMD06 "Fehlerklasse:  Aussetzer Zylinder 6" VALUE 0xFD57D3 KwWU8 255.0 dez 0.00 255.0 FORMAT "%5.1" /end CHARACTERISTIC
/begin CHARACTERISTIC CLAMD07 "Fehlerklasse:  Aussetzer Zylinder 7" VALUE 0xFD57D4 KwWU8 255.0 dez 0.00 255.0 FORMAT "%5.1" /end CHARACTERISTIC
/begin CHARACTERISTIC CLAMD08 "Fehlerklasse:  Aussetzer Zylinder 8" VALUE 0xFD57D5 KwWU8 255.0 dez 0.00 255.0 FORMAT "%5.1" /end CHARACTERISTIC
/begin CHARACTERISTIC CLAMD09 "Fehlerklasse:  Aussetzer Zylinder 9" VALUE 0xFD57D6 KwWU8 255.0 dez 0.00 255.0 FORMAT "%5.1" /end CHARACTERISTIC
/begin CHARACTERISTIC CLAMD10 "Fehlerklasse:  Aussetzer Zylinder 10" VALUE 0xFD57D7 KwWU8 255.0 dez 0.00 255.0 FORMAT "%5.1" /end CHARACTERISTIC
/begin CHARACTERISTIC CLAMD11 "Fehlerklasse:  Aussetzer Zylinder 11" VALUE 0xFD57D8 KwWU8 255.0 dez 0.00 255.0 FORMAT "%5.1" /end CHARACTERISTIC
/begin CHARACTERISTIC CLAMLE "Fehlerklasse: Motorl¸fter Endstufe" VALUE 0xFD57DC KwWU8 255.0 dez 0.00 255.0 FORMAT "%5.1" /end CHARACTERISTIC
/begin CHARACTERISTIC CLANVRBUP "Fehlerklasse: NVRAM Backup" VALUE 0xFD57DF KwUb 255.0 dez 0.00 255.0 FORMAT "%5.1" /end CHARACTERISTIC
/begin CHARACTERISTIC CLARKAT "Fehlerklasse: LR-Adaption additiver Bereich pro Zeit" VALUE 0xFD57EE KwUb 255.0 dez 0.00 255.0 FORMAT "%5.1" /end CHARACTERISTIC
/begin CHARACTERISTIC CLARKAT2 "Fehlerklasse: LR-Adaption additiver Bereich pro Zeit Bank 2" VALUE 0xFD57EF KwUb 255.0 dez 0.00 255.0 FORMAT "%5.1" /end CHARACTERISTIC
/begin CHARACTERISTIC CLARKAZ "Fehlerklasse: LR-Adaption additiver Bereich pro Z¸ndung" VALUE 0xFD57F0 KwUb 255.0 dez 0.00 255.0 FORMAT "%5.1" /end CHARACTERISTIC
/begin CHARACTERISTIC CLARKAZ2 "Fehlerklasse: LR-Adaption additiver Bereich pro Z¸ndung Bank 2" VALUE 0xFD57F1 KwUb 255.0 dez 0.00 255.0 FORMAT "%5.1" /end CHARACTERISTIC
/begin CHARACTERISTIC FFTANWS "Freeze Frame Tabelle: Nockenwellensteuerung Auslass Nockenwelle" VAL_BLK 0xFD5829 KwbWU8 255.0 DEZ 0.00 255.0 FORMAT "%5.1" NUMBER 4 /end CHARACTERISTIC
/begin CHARACTERISTIC FFTANWS2 "Freeze Frame Tabelle: Nockenwellensteuerung Auslass Nockenwelle 2" VAL_BLK 0xFD582D KwbWU8 255.0 DEZ 0.00 255.0 FORMAT "%5.1" NUMBER 4 /end CHARACTERISTIC
/begin CHARACTERISTIC FFTCVVT "Freeze Frame Tabelle: LoCAN-Timeout VVT-Botschaft" VAL_BLK 0xFD5881 KwbUb 255.0 dez 0.00 255.0 FORMAT "%5.1" NUMBER 4 /end CHARACTERISTIC
/begin CHARACTERISTIC FFTETS "Freeze Frame Tabelle: ETS-Endstufe" VAL_BLK 0xFD59A9 KwbWU8 255.0 dez 0.00 255.0 FORMAT "%5.1" NUMBER 4 /end CHARACTERISTIC
/begin CHARACTERISTIC FFTFRAO "Freeze Frame Tabelle: FRAO Gemischadaption" VAL_BLK 0xFD59D9 KwbUb 255.0 dez 0.00 255.0 FORMAT "%5.1" NUMBER 4 /end CHARACTERISTIC
/begin CHARACTERISTIC FFTFRAO2 "Freeze Frame Tabelle: FRAO Gemischadaption Bank 2" VAL_BLK 0xFD59DD KwbUb 255.0 dez 0.00 255.0 FORMAT "%5.1" NUMBER 4 /end CHARACTERISTIC
/begin CHARACTERISTIC FFTFRAU "Freeze Frame Tabelle: FRAU Gemischadaption" VAL_BLK 0xFD59E1 KwbUb 255.0 dez 0.00 255.0 FORMAT "%5.1" NUMBER 4 /end CHARACTERISTIC
/begin CHARACTERISTIC FFTFRAU2 "Freeze Frame Tabelle: FRAU Gemischadaption Bank 2" VAL_BLK 0xFD59E5 KwbUb 255.0 dez 0.00 255.0 FORMAT "%5.1" NUMBER 4 /end CHARACTERISTIC
/begin CHARACTERISTIC FFTFRST "Freeze Frame Tabelle: LR-Abweichung" VAL_BLK 0xFD59E9 KwbUb 255.0 dez 0.00 255.0 FORMAT "%5.1" NUMBER 4 /end CHARACTERISTIC
/begin CHARACTERISTIC FFTFRST2 "Freeze Frame Tabelle: LR-Abweichung Bank 2" VAL_BLK 0xFD59ED KwbUb 255.0 dez 0.00 255.0 FORMAT "%5.1" NUMBER 4 /end CHARACTERISTIC
/begin CHARACTERISTIC FFTICLSU "Tabelle Umweltbedingungen: Auswerte-IC f¸r LSU" VAL_BLK 0xFD5A29 KwbWU8 255.0 dez 0.00 255.0 FORMAT "%5.1" NUMBER 4 /end CHARACTERISTIC
/begin CHARACTERISTIC FFTICLSU2 "Tabelle Umweltbedingungen: Auswerte-IC f¸r LSU, Bank 2" VAL_BLK 0xFD5A2D KwbWU8 255.0 dez 0.00 255.0 FORMAT "%5.1" NUMBER 4 /end CHARACTERISTIC
/begin CHARACTERISTIC FFTKAT "Freeze Frame Tabelle: Katalysator" VAL_BLK 0xFD5A31 KwbWU8 255.0 dez 0.00 255.0 FORMAT "%5.1" NUMBER 4 /end CHARACTERISTIC
/begin CHARACTERISTIC FFTKAT2 "Freeze Frame Tabelle: Katalysator" VAL_BLK 0xFD5A35 KwbWU8 255.0 dez 0.00 255.0 FORMAT "%5.1" NUMBER 4 /end CHARACTERISTIC
/begin CHARACTERISTIC FFTKOSE "Freeze Frame Tabelle: Klima- Kompressorsteurung Endstufe" VAL_BLK 0xFD5A39 KwbWU8 255.0 dez 0.00 255.0 FORMAT "%5.1" NUMBER 4 /end CHARACTERISTIC
/begin CHARACTERISTIC FFTKRNT "Freeze frame Tabelle: Klopfregelung Nulltest" VAL_BLK 0xFD5A41 KwbUb 255.0 dez 0.00 255.0 FORMAT "%5.1" NUMBER 4 /end CHARACTERISTIC
/begin CHARACTERISTIC FFTKRNT2 "Freeze frame Tabelle: Klopfregelung Nulltest, Bank 2" VAL_BLK 0xFD5A45 KwbUb 255.0 dez 0.00 255.0 FORMAT "%5.1" NUMBER 4 /end CHARACTERISTIC
/begin CHARACTERISTIC FFTKROF "Freeze Frame Tabelle: Klopfregelung Offset" VAL_BLK 0xFD5A49 KwbUb 255.0 dez 0.00 255.0 FORMAT "%5.1" NUMBER 4 /end CHARACTERISTIC
/begin CHARACTERISTIC FFTKROF2 "Freeze Frame Tabelle: Klopfregelung Offset, Bank 2" VAL_BLK 0xFD5A4D KwbUb 255.0 dez 0.00 255.0 FORMAT "%5.1" NUMBER 4 /end CHARACTERISTIC
/begin CHARACTERISTIC FFTKRTP "Freeze Frame Tabelle: Klopfregelung Testimpuls" VAL_BLK 0xFD5A51 KwbUb 255.0 dez 0.00 255.0 FORMAT "%5.1" NUMBER 4 /end CHARACTERISTIC
/begin CHARACTERISTIC FFTKRTP2 "Freeze Frame Tabelle: Klopfregelung Testimpuls, Bank 2" VAL_BLK 0xFD5A55 KwbUb 255.0 dez 0.00 255.0 FORMAT "%5.1" NUMBER 4 /end CHARACTERISTIC
/begin CHARACTERISTIC FFTKS1 "Freeze Frame Tabelle: Klopfsensor 1" VAL_BLK 0xFD5A59 KwbUb 255.0 dez 0.00 255.0 FORMAT "%5.1" NUMBER 4 /end CHARACTERISTIC
/begin CHARACTERISTIC FFTKS2 "Freeze Frame Tabelle: Klopfsensor 2" VAL_BLK 0xFD5A5D KwbUb 255.0 dez 0.00 255.0 FORMAT "%5.1" NUMBER 4 /end CHARACTERISTIC
/begin CHARACTERISTIC FFTKS3 "Freeze Frame Tabelle: Klopfsensor 3" VAL_BLK 0xFD5A61 KwbUb 255.0 dez 0.00 255.0 FORMAT "%5.1" NUMBER 4 /end CHARACTERISTIC
/begin CHARACTERISTIC FFTKS4 "Freeze Frame Tabelle: Klopfsensor 4" VAL_BLK 0xFD5A65 KwbUb 255.0 dez 0.00 255.0 FORMAT "%5.1" NUMBER 4 /end CHARACTERISTIC
/begin CHARACTERISTIC FFTKUPPL "Freeze Frame Tabelle: Pedalwertgeber Kupplung" VAL_BLK 0xFD5A69 KwbUb 255.0 dez 0.00 255.0 FORMAT "%5.1" NUMBER 4 /end CHARACTERISTIC
/begin CHARACTERISTIC FFTLASH "Tabelle Umweltbedingungen Lambdasonde hinter Kat" VAL_BLK 0xFD5A6D KwbUb 255.0 dez 0.00 255.0 FORMAT "%5.1" NUMBER 4 /end CHARACTERISTIC
/begin CHARACTERISTIC FFTLASH2 "Tabelle Umweltbedingungen Lambdasonde hinter Kat Bank2" VAL_BLK 0xFD5A71 KwbUb 255.0 dez 0.00 255.0 FORMAT "%5.1" NUMBER 4 /end CHARACTERISTIC
/begin CHARACTERISTIC FFTLAVH "" VAL_BLK 0xFD5A75 KwbUb 255.0 dez 0.00 255.0 FORMAT "%5.1" NUMBER 4 /end CHARACTERISTIC
/begin CHARACTERISTIC FFTLAVH2 "" VAL_BLK 0xFD5A79 KwbUb 255.0 dez 0.00 255.0 FORMAT "%5.1" NUMBER 4 /end CHARACTERISTIC
/begin CHARACTERISTIC FFTLLR "Freeze Frame Tabelle: Leerlaufregelung" VAL_BLK 0xFD5A7D KwbUb 255.0 dez 0.00 255.0 FORMAT "%5.1" NUMBER 4 /end CHARACTERISTIC
/begin CHARACTERISTIC FFTLSH "Tabelle Umweltbedingungen Lambdasonde hinter Kat" VAL_BLK 0xFD5A85 KwbUb 255.0 dez 0.00 255.0 FORMAT "%5.1" NUMBER 4 /end CHARACTERISTIC
/begin CHARACTERISTIC FFTLSH2 "Tabelle Umweltbedingungen Lambdasonde hinter Kat Bank 2" VAL_BLK 0xFD5A89 KwbUb 255.0 dez 0.00 255.0 FORMAT "%5.1" NUMBER 4 /end CHARACTERISTIC
/begin CHARACTERISTIC FFTLSUIA "Tabelle Umweltbedingungen: Diagnose Lambdasondenleitung an Bond IA" VAL_BLK 0xFD5A8D KwbWU8 255.0 dez 0.00 255.0 FORMAT "%5.1" NUMBER 4 /end CHARACTERISTIC
/begin CHARACTERISTIC FFTLSUIA2 "Tabelle Umweltbedingungen: Diagnose Lambdasondenleitung an Bond IA, Bank 2" VAL_BLK 0xFD5A91 KwbWU8 255.0 dez 0.00 255.0 FORMAT "%5.1" NUMBER 4 /end CHARACTERISTIC
/begin CHARACTERISTIC FFTLSUIP "" VAL_BLK 0xFD5A95 KwbWU8 255.0 dez 0.00 255.0 FORMAT "%5.1" NUMBER 4 /end CHARACTERISTIC
/begin CHARACTERISTIC FFTLSUIP2 "" VAL_BLK 0xFD5A99 KwbWU8 255.0 dez 0.00 255.0 FORMAT "%5.1" NUMBER 4 /end CHARACTERISTIC
/begin CHARACTERISTIC FFTLSUKS "" VAL_BLK 0xFD5A9D KwbWU8 255.0 dez 0.00 255.0 FORMAT "%5.1" NUMBER 4 /end CHARACTERISTIC
/begin CHARACTERISTIC FFTLSUKS2 "" VAL_BLK 0xFD5AA1 KwbWU8 255.0 dez 0.00 255.0 FORMAT "%5.1" NUMBER 4 /end CHARACTERISTIC
/begin CHARACTERISTIC FFTLSUUN "Tabelle Umweltbedingungen: Diagnose Lambdasondenleitung an Bond UN" VAL_BLK 0xFD5AA5 KwbWU8 255.0 dez 0.00 255.0 FORMAT "%5.1" NUMBER 4 /end CHARACTERISTIC
/begin CHARACTERISTIC FFTLSUUN2 "Tabelle Umweltbedingungen: Diagnose Lambdasondenleitung an Bond UN, Bank 2" VAL_BLK 0xFD5AA9 KwbWU8 255.0 dez 0.00 255.0 FORMAT "%5.1" NUMBER 4 /end CHARACTERISTIC
/begin CHARACTERISTIC FFTLSUVM "Tabelle Umweltbedingungen: Diagnose Lambdasondenleitung an Bond VM" VAL_BLK 0xFD5AAD KwbWU8 255.0 dez 0.00 255.0 FORMAT "%5.1" NUMBER 4 /end CHARACTERISTIC
/begin CHARACTERISTIC FFTLSUVM2 "Tabelle Umweltbedingungen: Diagnose Lambdasondenleitung an Bond VM, Bank 2" VAL_BLK 0xFD5AB1 KwbWU8 255.0 dez 0.00 255.0 FORMAT "%5.1" NUMBER 4 /end CHARACTERISTIC
/begin CHARACTERISTIC FFTMD "Freeze Frame Tabelle: Aussetzer, Summenfehler (multiple)" VAL_BLK 0xFD5AC1 KwbWU8 255.0 dez 0.00 255.0 FORMAT "%5.1" NUMBER 4 /end CHARACTERISTIC
/begin CHARACTERISTIC FFTMD00 "Freeze Frame Tabelle: Aussetzer Zyl. 0" VAL_BLK 0xFD5AC5 KwbWU8 255.0 dez 0.00 255.0 FORMAT "%5.1" NUMBER 4 /end CHARACTERISTIC
/begin CHARACTERISTIC FFTMD01 "Freeze Frame Tabelle: Aussetzer Zyl. 1" VAL_BLK 0xFD5AC9 KwbWU8 255.0 dez 0.00 255.0 FORMAT "%5.1" NUMBER 4 /end CHARACTERISTIC
/begin CHARACTERISTIC FFTMD02 "Freeze Frame Tabelle: Aussetzer Zylinder 2" VAL_BLK 0xFD5ACD KwbWU8 255.0 dez 0.00 255.0 FORMAT "%5.1" NUMBER 4 /end CHARACTERISTIC
/begin CHARACTERISTIC FFTMD03 "Freeze Frame Tabelle: Aussetzer Zylinder 3" VAL_BLK 0xFD5AD1 KwbWU8 255.0 dez 0.00 255.0 FORMAT "%5.1" NUMBER 4 /end CHARACTERISTIC
/begin CHARACTERISTIC FFTMD04 "Freeze Frame Tabelle: Aussetzer Zylinder 4" VAL_BLK 0xFD5AD5 KwbWU8 255.0 dez 0.00 255.0 FORMAT "%5.1" NUMBER 4 /end CHARACTERISTIC
/begin CHARACTERISTIC FFTMD05 "Freeze Frame Tabelle: Aussetzer Zylinder 5" VAL_BLK 0xFD5AD9 KwbWU8 255.0 dez 0.00 255.0 FORMAT "%5.1" NUMBER 4 /end CHARACTERISTIC
/begin CHARACTERISTIC FFTMD06 "Freeze Frame Tabelle: Aussetzer Zylinder 6" VAL_BLK 0xFD5ADD KwbWU8 255.0 dez 0.00 255.0 FORMAT "%5.1" NUMBER 4 /end CHARACTERISTIC
/begin CHARACTERISTIC FFTMD07 "Freeze Frame Tabelle: Aussetzer Zylinder 7" VAL_BLK 0xFD5AE1 KwbWU8 255.0 dez 0.00 255.0 FORMAT "%5.1" NUMBER 4 /end CHARACTERISTIC
/begin CHARACTERISTIC FFTMD08 "Freeze Frame Tabelle: Aussetzer Zylinder 8" VAL_BLK 0xFD5AE5 KwbWU8 255.0 dez 0.00 255.0 FORMAT "%5.1" NUMBER 4 /end CHARACTERISTIC
/begin CHARACTERISTIC FFTMD09 "Freeze Frame Tabelle: Aussetzer Zylinder 9" VAL_BLK 0xFD5AE9 KwbWU8 255.0 dez 0.00 255.0 FORMAT "%5.1" NUMBER 4 /end CHARACTERISTIC
/begin CHARACTERISTIC FFTMD10 "Freeze Frame Tabelle: Aussetzer Zylinder 10" VAL_BLK 0xFD5AED KwbWU8 255.0 dez 0.00 255.0 FORMAT "%5.1" NUMBER 4 /end CHARACTERISTIC
/begin CHARACTERISTIC FFTMD11 "Freeze Frame Tabelle: Aussetzer Zylinder 11" VAL_BLK 0xFD5AF1 KwbWU8 255.0 dez 0.00 255.0 FORMAT "%5.1" NUMBER 4 /end CHARACTERISTIC
/begin CHARACTERISTIC FFTMLE "Freeze Frame Tabelle: Motorl¸fter Endstufe" VAL_BLK 0xFD5B01 KwbWU8 255.0 dez 0.00 255.0 FORMAT "%5.1" NUMBER 4 /end CHARACTERISTIC
/begin CHARACTERISTIC FFTNVRBUP "Freeze Frame Tabelle: NVRAM Backup" VAL_BLK 0xFD5B0D KwbUb 255.0 dez 0.00 255.0 FORMAT "%5.1" NUMBER 4 /end CHARACTERISTIC
/begin CHARACTERISTIC FFTRKAT "Freeze Frame Tabelle: RKAT Gemischadaption" VAL_BLK 0xFD5B49 KwbUb 255.0 dez 0.00 255.0 FORMAT "%5.1" NUMBER 4 /end CHARACTERISTIC
/begin CHARACTERISTIC FFTRKAT2 "Freeze Frame Tabelle: RKAT Gemischadaption Bank 2" VAL_BLK 0xFD5B4D KwbUb 255.0 dez 0.00 255.0 FORMAT "%5.1" NUMBER 4 /end CHARACTERISTIC
/begin CHARACTERISTIC FFTRKAZ "Freeze Frame Tabelle: RKAZ Gemischadaption" VAL_BLK 0xFD5B51 KwbUb 255.0 dez 0.00 255.0 FORMAT "%5.1" NUMBER 4 /end CHARACTERISTIC
/begin CHARACTERISTIC FFTRKAZ2 "Freeze Frame Tabelle: RKAZ Gemischadaption Bank 2" VAL_BLK 0xFD5B55 KwbUb 255.0 dez 0.00 255.0 FORMAT "%5.1" NUMBER 4 /end CHARACTERISTIC
/begin CHARACTERISTIC TSFANWS "Fehlersummenzeit: Nockenwellensteuerung Auslass Nockenwelle" VALUE 0xFD5C08 KwWU8 255.0 DEZ 0.00 255.0 FORMAT "%5.1" /end CHARACTERISTIC
/begin CHARACTERISTIC TSFANWS2 "Fehlersummenzeit: Nockenwellensteuerung Auslass Nockenwelle 2" VALUE 0xFD5C09 KwWU8 255.0 DEZ 0.00 255.0 FORMAT "%5.1" /end CHARACTERISTIC
/begin CHARACTERISTIC TSFCVVT "Fehlersummenzeit: LOCAN-Schnittstelle, Timeout VVT" VALUE 0xFD5C1E KwUb 255.0 dez 0.00 255.0 FORMAT "%5.1" /end CHARACTERISTIC
/begin CHARACTERISTIC TSFETS "Fehlersummenzeit: Elektrisches Thermostat" VALUE 0xFD5C68 KwWU8 255.0 dez 0.00 255.0 FORMAT "%5.1" /end CHARACTERISTIC
/begin CHARACTERISTIC TSFFRAO "Fehlersummenzeit: LR-Adaption oberer Bereich" VALUE 0xFD5C74 KwUb 255.0 dez 0.00 255.0 FORMAT "%5.1" /end CHARACTERISTIC
/begin CHARACTERISTIC TSFFRAO2 "Fehlersummenzeit: LR-Adaption oberer Bereich Bank 2" VALUE 0xFD5C75 KwUb 255.0 dez 0.00 255.0 FORMAT "%5.1" /end CHARACTERISTIC
/begin CHARACTERISTIC TSFFRAU "Fehlersummenzeit: LR-Adaption unterer Bereich" VALUE 0xFD5C76 KwUb 255.0 dez 0.00 255.0 FORMAT "%5.1" /end CHARACTERISTIC
/begin CHARACTERISTIC TSFFRAU2 "Fehlersummenzeit: LR-Adaption unterer Bereich Bank 2" VALUE 0xFD5C77 KwUb 255.0 dez 0.00 255.0 FORMAT "%5.1" /end CHARACTERISTIC
/begin CHARACTERISTIC TSFFRST "Fehlersummenzeit: LR-Abweichung" VALUE 0xFD5C78 KwUb 255.0 dez 0.00 255.0 FORMAT "%5.1" /end CHARACTERISTIC
/begin CHARACTERISTIC TSFFRST2 "Fehlersummenzeit: LR-Abweichung Bank 2" VALUE 0xFD5C79 KwUb 255.0 dez 0.00 255.0 FORMAT "%5.1" /end CHARACTERISTIC
/begin CHARACTERISTIC TSFICLSU "Fehlersummenzeit: Auswerte-IC f¸r LSU" VALUE 0xFD5C88 KwWU8 255.0 dez 0.00 255.0 FORMAT "%5.1" /end CHARACTERISTIC
/begin CHARACTERISTIC TSFICLSU2 "Fehlersummenzeit: Auswerte-IC f¸r LSU, Bank 2" VALUE 0xFD5C89 KwWU8 255.0 dez 0.00 255.0 FORMAT "%5.1" /end CHARACTERISTIC
/begin CHARACTERISTIC TSFKAT "Fehlersummenzeit: Katalysator-Konvertierung" VALUE 0xFD5C8A KwWU8 255.0 dez 0.00 255.0 FORMAT "%5.1" /end CHARACTERISTIC
/begin CHARACTERISTIC TSFKAT2 "Fehlersummenzeit: Katalysator-Konvertierung (Bank 2)" VALUE 0xFD5C8B KwWU8 255.0 dez 0.00 255.0 FORMAT "%5.1" /end CHARACTERISTIC
/begin CHARACTERISTIC TSFKOSE "Fehlersummenzeit: Klima- Kompressorsteurung Endstufe" VALUE 0xFD5C8C KwWU8 255.0 dez 0.00 255.0 FORMAT "%5.1" /end CHARACTERISTIC
/begin CHARACTERISTIC TSFKRNT "Fehlersummenzeit: Klopfregelung Nulltest" VALUE 0xFD5C8E KwUb 255.0 dez 0.00 255.0 FORMAT "%5.1" /end CHARACTERISTIC
/begin CHARACTERISTIC TSFKRNT2 "Fehlersummenzeit: Klopfregelung Nulltest, Bank 2" VALUE 0xFD5C8F KwUb 255.0 dez 0.00 255.0 FORMAT "%5.1" /end CHARACTERISTIC
/begin CHARACTERISTIC TSFKROF "Fehlersummenzeit: Klopfregelung Offset" VALUE 0xFD5C90 KwUb 255.0 dez 0.00 255.0 FORMAT "%5.1" /end CHARACTERISTIC
/begin CHARACTERISTIC TSFKROF2 "Fehlersummenzeit: Klopfregelung Offset, Bank 2" VALUE 0xFD5C91 KwUb 255.0 dez 0.00 255.0 FORMAT "%5.1" /end CHARACTERISTIC
/begin CHARACTERISTIC TSFKRTP "Fehlersummenzeit: Klopfregelung Testimpuls" VALUE 0xFD5C92 KwUb 255.0 dez 0.00 255.0 FORMAT "%5.1" /end CHARACTERISTIC
/begin CHARACTERISTIC TSFKRTP2 "Fehlersummenzeit: Klopfregelung Testimpuls, Bank 2" VALUE 0xFD5C93 KwUb 255.0 dez 0.00 255.0 FORMAT "%5.1" /end CHARACTERISTIC
/begin CHARACTERISTIC TSFKS1 "Fehlersummenzeit: Klopfsensor 1" VALUE 0xFD5C94 KwUb 255.0 dez 0.00 255.0 FORMAT "%5.1" /end CHARACTERISTIC
/begin CHARACTERISTIC TSFKS2 "Fehlersummenzeit: Klopfsensor 2" VALUE 0xFD5C95 KwUb 255.0 dez 0.00 255.0 FORMAT "%5.1" /end CHARACTERISTIC
/begin CHARACTERISTIC TSFKS3 "Fehlersummenzeit: Klopfsensor 3" VALUE 0xFD5C96 KwUb 255.0 dez 0.00 255.0 FORMAT "%5.1" /end CHARACTERISTIC
/begin CHARACTERISTIC TSFKS4 "Fehlersummenzeit: Klopfsensor 4" VALUE 0xFD5C97 KwUb 255.0 dez 0.00 255.0 FORMAT "%5.1" /end CHARACTERISTIC
/begin CHARACTERISTIC TSFKUPPL "Fehlersummenzeit: Pedalwertgeber Kupplung" VALUE 0xFD5C98 KwUb 255.0 dez 0.00 255.0 FORMAT "%5.1" /end CHARACTERISTIC
/begin CHARACTERISTIC TSFLASH "Fehlersummenzeit: Lambda-Sondenalterung hinter Kat." VALUE 0xFD5C99 KwUb 255.0 dez 0.00 255.0 FORMAT "%5.1" /end CHARACTERISTIC
/begin CHARACTERISTIC TSFLASH2 "Fehlersummenzeit: Lambda-Sondenalterung hinter Kat. (Bank 2)" VALUE 0xFD5C9A KwUb 255.0 dez 0.00 255.0 FORMAT "%5.1" /end CHARACTERISTIC
/begin CHARACTERISTIC TSFLAVH "" VALUE 0xFD5C9B KwUb 255.0 dez 0.00 255.0 FORMAT "%5.1" /end CHARACTERISTIC
/begin CHARACTERISTIC TSFLAVH2 "" VALUE 0xFD5C9C KwUb 255.0 dez 0.00 255.0 FORMAT "%5.1" /end CHARACTERISTIC
/begin CHARACTERISTIC TSFLLR "Fehlersummenzeit: Leerlaufregelung am Anschlag" VALUE 0xFD5C9D KwUb 255.0 dez 0.00 255.0 FORMAT "%5.1" /end CHARACTERISTIC
/begin CHARACTERISTIC TSFLSH "Fehlersummenzeit: Lambda-Sonde hinter Kat" VALUE 0xFD5C9F KwUb 255.0 dez 0.00 255.0 FORMAT "%5.1" /end CHARACTERISTIC
/begin CHARACTERISTIC TSFLSH2 "Fehlersummenzeit: Lambda-Sonde 2 hinter Kat" VALUE 0xFD5CA0 KwUb 255.0 dez 0.00 255.0 FORMAT "%5.1" /end CHARACTERISTIC
/begin CHARACTERISTIC TSFLSUIA "Fehlersummenzeit: Diagnose Lambdasondenleitung an Bond IA" VALUE 0xFD5CA1 KwWU8 255.0 dez 0.00 255.0 FORMAT "%5.1" /end CHARACTERISTIC
/begin CHARACTERISTIC TSFLSUIA2 "Fehlersummenzeit: Diagnose Lambdasondenleitung an Bond IA, Bank 2" VALUE 0xFD5CA2 KwWU8 255.0 dez 0.00 255.0 FORMAT "%5.1" /end CHARACTERISTIC
/begin CHARACTERISTIC TSFLSUIP "" VALUE 0xFD5CA3 KwWU8 255.0 dez 0.00 255.0 FORMAT "%5.1" /end CHARACTERISTIC
/begin CHARACTERISTIC TSFLSUIP2 "" VALUE 0xFD5CA4 KwWU8 255.0 dez 0.00 255.0 FORMAT "%5.1" /end CHARACTERISTIC
/begin CHARACTERISTIC TSFLSUKS "" VALUE 0xFD5CA5 KwWU8 255.0 dez 0.00 255.0 FORMAT "%5.1" /end CHARACTERISTIC
/begin CHARACTERISTIC TSFLSUKS2 "" VALUE 0xFD5CA6 KwWU8 255.0 dez 0.00 255.0 FORMAT "%5.1" /end CHARACTERISTIC
/begin CHARACTERISTIC TSFLSUUN "Fehlersummenzeit: Diagnose Lambdasondenleitung an Bond UN" VALUE 0xFD5CA7 KwWU8 255.0 dez 0.00 255.0 FORMAT "%5.1" /end CHARACTERISTIC
/begin CHARACTERISTIC TSFLSUUN2 "Fehlersummenzeit: Diagnose Lambdasondenleitung an Bond UN, Bank 2" VALUE 0xFD5CA8 KwWU8 255.0 dez 0.00 255.0 FORMAT "%5.1" /end CHARACTERISTIC
/begin CHARACTERISTIC TSFLSUVM "Fehlersummenzeit: Diagnose Lambdasondenleitung an Bond VM" VALUE 0xFD5CA9 KwWU8 255.0 dez 0.00 255.0 FORMAT "%5.1" /end CHARACTERISTIC
/begin CHARACTERISTIC TSFLSUVM2 "Fehlersummenzeit: Diagnose Lambdasondenleitung an Bond VM, Bank 2" VALUE 0xFD5CAA KwWU8 255.0 dez 0.00 255.0 FORMAT "%5.1" /end CHARACTERISTIC
/begin CHARACTERISTIC TSFMD "Fehlersummenzeit: Aussetzer, Summenfehler (multiple)" VALUE 0xFD5CAE KwWU8 255.0 dez 0.00 255.0 FORMAT "%5.1" /end CHARACTERISTIC
/begin CHARACTERISTIC TSFMD00 "Fehlersummenzeit: Aussetzer Zyl. 0" VALUE 0xFD5CAF KwWU8 255.0 dez 0.00 255.0 FORMAT "%5.1" /end CHARACTERISTIC
/begin CHARACTERISTIC TSFMD01 "Fehlersummenzeit: Aussetzer Zyl. 1" VALUE 0xFD5CB0 KwWU8 255.0 dez 0.00 255.0 FORMAT "%5.1" /end CHARACTERISTIC
/begin CHARACTERISTIC TSFMD02 "Fehlersummenzeit: Aussetzer Zylinder 2" VALUE 0xFD5CB1 KwWU8 255.0 dez 0.00 255.0 FORMAT "%5.1" /end CHARACTERISTIC
/begin CHARACTERISTIC TSFMD03 "Fehlersummenzeit: Aussetzer Zylinder 3" VALUE 0xFD5CB2 KwWU8 255.0 dez 0.00 255.0 FORMAT "%5.1" /end CHARACTERISTIC
/begin CHARACTERISTIC TSFMD04 "Fehlersummenzeit: Aussetzer Zylinder 4" VALUE 0xFD5CB3 KwWU8 255.0 dez 0.00 255.0 FORMAT "%5.1" /end CHARACTERISTIC
/begin CHARACTERISTIC TSFMD05 "Fehlersummenzeit: Aussetzer Zylinder 5" VALUE 0xFD5CB4 KwWU8 255.0 dez 0.00 255.0 FORMAT "%5.1" /end CHARACTERISTIC
/begin CHARACTERISTIC TSFMD06 "Fehlersummenzeit: Aussetzer Zylinder 6" VALUE 0xFD5CB5 KwWU8 255.0 dez 0.00 255.0 FORMAT "%5.1" /end CHARACTERISTIC
/begin CHARACTERISTIC TSFMD07 "Fehlersummenzeit: Aussetzer Zylinder 7" VALUE 0xFD5CB6 KwWU8 255.0 dez 0.00 255.0 FORMAT "%5.1" /end CHARACTERISTIC
/begin CHARACTERISTIC TSFMD08 "Fehlersummenzeit: Aussetzer Zylinder 8" VALUE 0xFD5CB7 KwWU8 255.0 dez 0.00 255.0 FORMAT "%5.1" /end CHARACTERISTIC
/begin CHARACTERISTIC TSFMD09 "Fehlersummenzeit: Aussetzer Zylinder 9" VALUE 0xFD5CB8 KwWU8 255.0 dez 0.00 255.0 FORMAT "%5.1" /end CHARACTERISTIC
/begin CHARACTERISTIC TSFMD10 "Fehlersummenzeit: Aussetzer Zylinder 10" VALUE 0xFD5CB9 KwWU8 255.0 dez 0.00 255.0 FORMAT "%5.1" /end CHARACTERISTIC
/begin CHARACTERISTIC TSFMD11 "Fehlersummenzeit: Aussetzer Zylinder 11" VALUE 0xFD5CBA KwWU8 255.0 dez 0.00 255.0 FORMAT "%5.1" /end CHARACTERISTIC
/begin CHARACTERISTIC TSFMLE "Fehlersummenzeit: L¸fterendstufe" VALUE 0xFD5CBE KwWU8 255.0 dez 0.00 255.0 FORMAT "%5.1" /end CHARACTERISTIC
/begin CHARACTERISTIC TSFNVRBUP "Fehlersummenzeit: NVRAM Backup" VALUE 0xFD5CC1 KwUb 255.0 dez 0.00 255.0 FORMAT "%5.1" /end CHARACTERISTIC
/begin CHARACTERISTIC TSFRKAT "Fehlersummenzeit: LR-Adaption additiver Bereich pro Zeit" VALUE 0xFD5CD0 KwUb 255.0 dez 0.00 255.0 FORMAT "%5.1" /end CHARACTERISTIC
/begin CHARACTERISTIC TSFRKAT2 "Fehlersummenzeit: LR-Adaption additiver Bereich pro Zeit Bank 2" VALUE 0xFD5CD1 KwUb 255.0 dez 0.00 255.0 FORMAT "%5.1" /end CHARACTERISTIC
/begin CHARACTERISTIC TSFRKAZ "Fehlersummenzeit: LR-Adaption additiver Bereich pro Z¸ndung" VALUE 0xFD5CD2 KwUb 255.0 dez 0.00 255.0 FORMAT "%5.1" /end CHARACTERISTIC
/begin CHARACTERISTIC TSFRKAZ2 "Fehlersummenzeit: LR-Adaption additiver Bereich pro Z¸ndung Bank 2" VALUE 0xFD5CD3 KwUb 255.0 dez 0.00 255.0 FORMAT "%5.1" /end CHARACTERISTIC
/begin MEASUREMENT B_beanws "Bedingung Bandende-Funktionsanforderung NWS Endstufe (Bank1, Auslaﬂ)" UWORD B_TRUE 1 100 0 1 BIT_MASK 0x20 FORMAT "%13.11" ECU_ADDRESS 0x3FE3B4 /end MEASUREMENT
/begin MEASUREMENT B_beanws2 "Bedingung Bandende-Funktionsanforderung NWS Endstufe (Bank2, Auslaﬂ)" UWORD B_TRUE 1 100 0 1 BIT_MASK 0x20 FORMAT "%13.11" ECU_ADDRESS 0x3FE3B6 /end MEASUREMENT
/begin MEASUREMENT B_becvvt "Bedingung Bandende-Funktionsanforderung LOCANVVT" UWORD B_TRUE 1 100 0 1 BIT_MASK 0x20 FORMAT "%13.11" ECU_ADDRESS 0x3FE3E0 /end MEASUREMENT
/begin MEASUREMENT B_beets "Bedingung Bandendeanforderung f¸r el. Thermostat-Endstufe" UWORD B_TRUE 1 100 0 1 BIT_MASK 0x20 FORMAT "%13.11" ECU_ADDRESS 0x3FE474 /end MEASUREMENT
/begin MEASUREMENT B_befrao "Bedingung: Bandendefunktionanford. f¸r FRAO" UWORD B_TRUE 1 100 0 1 BIT_MASK 0x20 FORMAT "%13.11" ECU_ADDRESS 0x3FE48C /end MEASUREMENT
/begin MEASUREMENT B_befrao2 "Bedingung: Bandendefunktionanford. f¸r FRAO2" UWORD B_TRUE 1 100 0 1 BIT_MASK 0x20 FORMAT "%13.11" ECU_ADDRESS 0x3FE48E /end MEASUREMENT
/begin MEASUREMENT B_befrau "Bedingung: Bandendefunktionanford. f¸r FRAU" UWORD B_TRUE 1 100 0 1 BIT_MASK 0x20 FORMAT "%13.11" ECU_ADDRESS 0x3FE490 /end MEASUREMENT
/begin MEASUREMENT B_befrau2 "Bedingung: Bandendefunktionanford. f¸r FRAU2" UWORD B_TRUE 1 100 0 1 BIT_MASK 0x20 FORMAT "%13.11" ECU_ADDRESS 0x3FE492 /end MEASUREMENT
/begin MEASUREMENT B_befrst "Bedingung: Bandendefunktionanford. f¸r LR- Kurztest" UWORD B_TRUE 1 100 0 1 BIT_MASK 0x20 FORMAT "%13.11" ECU_ADDRESS 0x3FE494 /end MEASUREMENT
/begin MEASUREMENT B_befrst2 "Bedingung: Bandendefunktionanford. f¸r LR- Kurztest (Bank 2)" UWORD B_TRUE 1 100 0 1 BIT_MASK 0x20 FORMAT "%13.11" ECU_ADDRESS 0x3FE496 /end MEASUREMENT
/begin MEASUREMENT B_beiclsu "Bedingung: Bandendefunktionanford. f¸r Pr¸fung Auswerte-IC der LSU" UWORD B_TRUE 1 100 0 1 BIT_MASK 0x20 FORMAT "%13.11" ECU_ADDRESS 0x3FE4B4 /end MEASUREMENT
/begin MEASUREMENT B_beiclsu2 "Bedingung: Bandendefunktionanford. f¸r Pr¸fung Auswerte-IC der LSU, Bank 2" UWORD B_TRUE 1 100 0 1 BIT_MASK 0x20 FORMAT "%13.11" ECU_ADDRESS 0x3FE4B6 /end MEASUREMENT
/begin MEASUREMENT B_bekat "Bedingung Bandende-Funktionsanforderung Katalysatordiagnose" UWORD B_TRUE 1 100 0 1 BIT_MASK 0x20 FORMAT "%13.11" ECU_ADDRESS 0x3FE4B8 /end MEASUREMENT
/begin MEASUREMENT B_bekat2 "Bedingung Bandende-Funktionsanforderung Katalysatordiagnose, Bank2" UWORD B_TRUE 1 100 0 1 BIT_MASK 0x20 FORMAT "%13.11" ECU_ADDRESS 0x3FE4BA /end MEASUREMENT
/begin MEASUREMENT B_bekose "Bedingung Bandendeanforderung f¸r Klimakompressor" UWORD B_TRUE 1 100 0 1 BIT_MASK 0x20 FORMAT "%13.11" ECU_ADDRESS 0x3FE4BC /end MEASUREMENT
/begin MEASUREMENT B_bekrnt "Bedingung Bandende-Funktionsanforderung Klopfregelung Diagnose Nulltest" UWORD B_TRUE 1 100 0 1 BIT_MASK 0x20 FORMAT "%13.11" ECU_ADDRESS 0x3FE4C0 /end MEASUREMENT
/begin MEASUREMENT B_bekrnt2 "" UWORD B_TRUE 1 100 0 1 BIT_MASK 0x20 FORMAT "%13.11" ECU_ADDRESS 0x3FE4C2 /end MEASUREMENT
/begin MEASUREMENT B_bekrof "Bedingung Bandende-Funktionsanforderung Klopfregelung Diagnose Integrator Offset" UWORD B_TRUE 1 100 0 1 BIT_MASK 0x20 FORMAT "%13.11" ECU_ADDRESS 0x3FE4C4 /end MEASUREMENT
/begin MEASUREMENT B_bekrof2 "" UWORD B_TRUE 1 100 0 1 BIT_MASK 0x20 FORMAT "%13.11" ECU_ADDRESS 0x3FE4C6 /end MEASUREMENT
/begin MEASUREMENT B_bekrtp "Bedingung Bandende-Funktionsanforderung Klopfregelung Diagnose Testpuls" UWORD B_TRUE 1 100 0 1 BIT_MASK 0x20 FORMAT "%13.11" ECU_ADDRESS 0x3FE4C8 /end MEASUREMENT
/begin MEASUREMENT B_bekrtp2 "" UWORD B_TRUE 1 100 0 1 BIT_MASK 0x20 FORMAT "%13.11" ECU_ADDRESS 0x3FE4CA /end MEASUREMENT
/begin MEASUREMENT B_beks1 "Bedingung Bandende-Funktionsanforderung Diagnose Klopfsensor 1" UWORD B_TRUE 1 100 0 1 BIT_MASK 0x20 FORMAT "%13.11" ECU_ADDRESS 0x3FE4CC /end MEASUREMENT
/begin MEASUREMENT B_beks2 "Bedingung Bandende-Funktionsanforderung Diagnose Klopfsensor 2" UWORD B_TRUE 1 100 0 1 BIT_MASK 0x20 FORMAT "%13.11" ECU_ADDRESS 0x3FE4CE /end MEASUREMENT
/begin MEASUREMENT B_beks3 "Bedingung Bandende-Funktionsanforderung Diagnose Klopfsensor 3" UWORD B_TRUE 1 100 0 1 BIT_MASK 0x20 FORMAT "%13.11" ECU_ADDRESS 0x3FE4D0 /end MEASUREMENT
/begin MEASUREMENT B_beks4 "Bedingung Bandende-Funktionsanforderung Diagnose Klopfsensor 1" UWORD B_TRUE 1 100 0 1 BIT_MASK 0x20 FORMAT "%13.11" ECU_ADDRESS 0x3FE4D2 /end MEASUREMENT
/begin MEASUREMENT B_bekuppl "Bedingung Bandende-Funktionsanforderung Kupplungssensor" UWORD B_TRUE 1 100 0 1 BIT_MASK 0x20 FORMAT "%13.11" ECU_ADDRESS 0x3FE4D4 /end MEASUREMENT
/begin MEASUREMENT B_belash "Bedingung Bandende-Funktionsanforderung Schwingungspr¸fung hinter KAT" UWORD B_TRUE 1 100 0 1 BIT_MASK 0x20 FORMAT "%13.11" ECU_ADDRESS 0x3FE4D6 /end MEASUREMENT
/begin MEASUREMENT B_belash2 "Bedingung Bandende-Funktionsanforderung Schwingungspr¸fung hinter KAT Bank2" UWORD B_TRUE 1 100 0 1 BIT_MASK 0x20 FORMAT "%13.11" ECU_ADDRESS 0x3FE4D8 /end MEASUREMENT
/begin MEASUREMENT B_belavh "Bedingung Bandende-Funktionsanforderung Vollast-Pr¸fung hinter KAT" UWORD B_TRUE 1 100 0 1 BIT_MASK 0x20 FORMAT "%13.11" ECU_ADDRESS 0x3FE4DA /end MEASUREMENT
/begin MEASUREMENT B_belavh2 "Bedingung Bandende-Funktionsanforderung Vollast-Pr¸fung hinter KAT Bank2" UWORD B_TRUE 1 100 0 1 BIT_MASK 0x20 FORMAT "%13.11" ECU_ADDRESS 0x3FE4DC /end MEASUREMENT
/begin MEASUREMENT B_bellr "Bedingung Bandende-Funktionsanforderung Leerlaufregelung" UWORD B_TRUE 1 100 0 1 BIT_MASK 0x20 FORMAT "%13.11" ECU_ADDRESS 0x3FE4DE /end MEASUREMENT
/begin MEASUREMENT B_belsh "Bedingung Bandende-Funktionsanforderung elktr. Diag. Lambda-Sonde hinter KAT" UWORD B_TRUE 1 100 0 1 BIT_MASK 0x20 FORMAT "%13.11" ECU_ADDRESS 0x3FE4E2 /end MEASUREMENT
/begin MEASUREMENT B_belsh2 "Bedingung Bandende-Funktionsanford. elktr. Diag. Lambda-Sonde hinter KAT Bank2" UWORD B_TRUE 1 100 0 1 BIT_MASK 0x20 FORMAT "%13.11" ECU_ADDRESS 0x3FE4E4 /end MEASUREMENT
/begin MEASUREMENT B_belsuia "Bedingung: Bandende-Fkt.-Anforderung: LSU-Leitungspr¸fung IA" UWORD B_TRUE 1 100 0 1 BIT_MASK 0x20 FORMAT "%13.11" ECU_ADDRESS 0x3FE4E6 /end MEASUREMENT
/begin MEASUREMENT B_belsuia2 "Bedingung: Bandende-Fkt.-Anforderung: LSU-Leitungspr¸fung IA, Bank 2" UWORD B_TRUE 1 100 0 1 BIT_MASK 0x20 FORMAT "%13.11" ECU_ADDRESS 0x3FE4E8 /end MEASUREMENT
/begin MEASUREMENT B_belsuip "Bedingung: Bandende-Fkt.-Anforderung: LSU-Leitungspr¸fung IP" UWORD B_TRUE 1 100 0 1 BIT_MASK 0x20 FORMAT "%13.11" ECU_ADDRESS 0x3FE4EA /end MEASUREMENT
/begin MEASUREMENT B_belsuip2 "Bedingung: Bandende-Fkt.-Anforderung: LSU-Leitungspr¸fung IP, B2" UWORD B_TRUE 1 100 0 1 BIT_MASK 0x20 FORMAT "%13.11" ECU_ADDRESS 0x3FE4EC /end MEASUREMENT
/begin MEASUREMENT B_belsuks "Bedingung: Bandende-Fkt.-Anforderung: LSU-Leitungspr¸fung Kurzschluss" UWORD B_TRUE 1 100 0 1 BIT_MASK 0x20 FORMAT "%13.11" ECU_ADDRESS 0x3FE4EE /end MEASUREMENT
/begin MEASUREMENT B_belsuks2 "Bedingung: Bandende-Fkt.-Anforderung: LSU-Leitungspr¸fung Kurzschluss, B2" UWORD B_TRUE 1 100 0 1 BIT_MASK 0x20 FORMAT "%13.11" ECU_ADDRESS 0x3FE4F0 /end MEASUREMENT
/begin MEASUREMENT B_belsuun "Bedingung: Bandende-Fkt.-Anforderung: LSU-Leitungspr¸fung UN" UWORD B_TRUE 1 100 0 1 BIT_MASK 0x20 FORMAT "%13.11" ECU_ADDRESS 0x3FE4F2 /end MEASUREMENT
/begin MEASUREMENT B_belsuun2 "Bedingung: Bandende-Fkt.-Anforderung: LSU-Leitungspr¸fung UN, Bank 2" UWORD B_TRUE 1 100 0 1 BIT_MASK 0x20 FORMAT "%13.11" ECU_ADDRESS 0x3FE4F4 /end MEASUREMENT
/begin MEASUREMENT B_belsuvm "Bedingung: Bandende-Fkt.-Anforderung: LSU-Leitungspr¸fung VM" UWORD B_TRUE 1 100 0 1 BIT_MASK 0x20 FORMAT "%13.11" ECU_ADDRESS 0x3FE4F6 /end MEASUREMENT
/begin MEASUREMENT B_belsuvm2 "Bedingung: Bandende-Fkt.-Anforderung: LSU-Leitungspr¸fung VM, Bank 2" UWORD B_TRUE 1 100 0 1 BIT_MASK 0x20 FORMAT "%13.11" ECU_ADDRESS 0x3FE4F8 /end MEASUREMENT
/begin MEASUREMENT B_bemd "Bedingung Bandende-Funktionsanforderung Erkennung mehrfacher Aussetzer" UWORD B_TRUE 1 100 0 1 BIT_MASK 0x20 FORMAT "%13.11" ECU_ADDRESS 0x3FE500 /end MEASUREMENT
/begin MEASUREMENT B_bemd00 "Bedingung Bandende-Funktionsanforderung" UWORD B_TRUE 1 100 0 1 BIT_MASK 0x20 FORMAT "%13.11" ECU_ADDRESS 0x3FE502 /end MEASUREMENT
/begin MEASUREMENT B_bemd01 "Bedingung Bandende-Funktionsanforderung" UWORD B_TRUE 1 100 0 1 BIT_MASK 0x20 FORMAT "%13.11" ECU_ADDRESS 0x3FE504 /end MEASUREMENT
/begin MEASUREMENT B_bemd02 "Bedingung Bandende-Funktionsanforderung" UWORD B_TRUE 1 100 0 1 BIT_MASK 0x20 FORMAT "%13.11" ECU_ADDRESS 0x3FE506 /end MEASUREMENT
/begin MEASUREMENT B_bemd03 "Bedingung Bandende-Funktionsanforderung" UWORD B_TRUE 1 100 0 1 BIT_MASK 0x20 FORMAT "%13.11" ECU_ADDRESS 0x3FE508 /end MEASUREMENT
/begin MEASUREMENT B_bemd04 "Bedingung Bandende-Funktionsanforderung" UWORD B_TRUE 1 100 0 1 BIT_MASK 0x20 FORMAT "%13.11" ECU_ADDRESS 0x3FE50A /end MEASUREMENT
/begin MEASUREMENT B_bemd05 "Bedingung Bandende-Funktionsanforderung" UWORD B_TRUE 1 100 0 1 BIT_MASK 0x20 FORMAT "%13.11" ECU_ADDRESS 0x3FE50C /end MEASUREMENT
/begin MEASUREMENT B_bemd06 "Bedingung Bandende-Funktionsanforderung" UWORD B_TRUE 1 100 0 1 BIT_MASK 0x20 FORMAT "%13.11" ECU_ADDRESS 0x3FE50E /end MEASUREMENT
/begin MEASUREMENT B_bemd07 "Bedingung Bandende-Funktionsanforderung" UWORD B_TRUE 1 100 0 1 BIT_MASK 0x20 FORMAT "%13.11" ECU_ADDRESS 0x3FE510 /end MEASUREMENT
/begin MEASUREMENT B_bemd08 "Bedingung Bandende-Funktionsanforderung" UWORD B_TRUE 1 100 0 1 BIT_MASK 0x20 FORMAT "%13.11" ECU_ADDRESS 0x3FE512 /end MEASUREMENT
/begin MEASUREMENT B_bemd09 "Bedingung Bandende-Funktionsanforderung" UWORD B_TRUE 1 100 0 1 BIT_MASK 0x20 FORMAT "%13.11" ECU_ADDRESS 0x3FE514 /end MEASUREMENT
/begin MEASUREMENT B_bemd10 "Bedingung Bandende-Funktionsanforderung" UWORD B_TRUE 1 100 0 1 BIT_MASK 0x20 FORMAT "%13.11" ECU_ADDRESS 0x3FE516 /end MEASUREMENT
/begin MEASUREMENT B_bemd11 "Bedingung Bandende-Funktionsanforderung" UWORD B_TRUE 1 100 0 1 BIT_MASK 0x20 FORMAT "%13.11" ECU_ADDRESS 0x3FE518 /end MEASUREMENT
/begin MEASUREMENT B_bemle "Bedingung Bandendeanforderung f¸r Fehler Endstufe Motorl¸fter" UWORD B_TRUE 1 100 0 1 BIT_MASK 0x20 FORMAT "%13.11" ECU_ADDRESS 0x3FE520 /end MEASUREMENT
/begin MEASUREMENT B_benvrbup "Bedingung Bandende-Funktionsanforderung NVRAM-Backup-Diagnose" UWORD B_TRUE 1 100 0 1 BIT_MASK 0x20 FORMAT "%13.11" ECU_ADDRESS 0x3FE526 /end MEASUREMENT
/begin MEASUREMENT B_berkat "Bedingung: Bandendefunktionanford. f¸r RKAT" UWORD B_TRUE 1 100 0 1 BIT_MASK 0x20 FORMAT "%13.11" ECU_ADDRESS 0x3FE544 /end MEASUREMENT
/begin MEASUREMENT B_berkat2 "Bedingung: Bandendefunktionanford. f¸r RKAT2" UWORD B_TRUE 1 100 0 1 BIT_MASK 0x20 FORMAT "%13.11" ECU_ADDRESS 0x3FE546 /end MEASUREMENT
/begin MEASUREMENT B_berkaz "Bedingung: Bandendefunktionanford. f¸r RKAZ" UWORD B_TRUE 1 100 0 1 BIT_MASK 0x20 FORMAT "%13.11" ECU_ADDRESS 0x3FE548 /end MEASUREMENT
/begin MEASUREMENT B_berkaz2 "Bedingung: Bandendefunktionanford. f¸r RKAZ2" UWORD B_TRUE 1 100 0 1 BIT_MASK 0x20 FORMAT "%13.11" ECU_ADDRESS 0x3FE54A /end MEASUREMENT
/begin MEASUREMENT B_bkanws "Bedingung Ersatzwert aktiv: NWS (Bank1, Auslaﬂ)" UWORD B_TRUE 1 100 0 1 BIT_MASK 0x40 FORMAT "%13.11" ECU_ADDRESS 0x3FE3B4 /end MEASUREMENT
/begin MEASUREMENT B_bkanws2 "Bedingung Ersatzwert aktiv: NWS (Bank2, Auslaﬂ)" UWORD B_TRUE 1 100 0 1 BIT_MASK 0x40 FORMAT "%13.11" ECU_ADDRESS 0x3FE3B6 /end MEASUREMENT
/begin MEASUREMENT B_bkcvvt "Bedingung Backup LOCANVVT" UWORD B_TRUE 1 100 0 1 BIT_MASK 0x40 FORMAT "%13.11" ECU_ADDRESS 0x3FE3E0 /end MEASUREMENT
/begin MEASUREMENT B_bkets "Bedingung: Ersatzwert aktiv bei el. Thermostat-Endstufe" UWORD B_TRUE 1 100 0 1 BIT_MASK 0x40 FORMAT "%13.11" ECU_ADDRESS 0x3FE474 /end MEASUREMENT
/begin MEASUREMENT B_bkfrao "Ersatzwert f¸r FRAO aktiv" UWORD B_TRUE 1 100 0 1 BIT_MASK 0x40 FORMAT "%13.11" ECU_ADDRESS 0x3FE48C /end MEASUREMENT
/begin MEASUREMENT B_bkfrao2 "Ersatzwert f¸r FRAO aktiv Bank 2" UWORD B_TRUE 1 100 0 1 BIT_MASK 0x40 FORMAT "%13.11" ECU_ADDRESS 0x3FE48E /end MEASUREMENT
/begin MEASUREMENT B_bkfrau "Ersatzwert f¸r FRAU aktiv" UWORD B_TRUE 1 100 0 1 BIT_MASK 0x40 FORMAT "%13.11" ECU_ADDRESS 0x3FE490 /end MEASUREMENT
/begin MEASUREMENT B_bkfrau2 "Ersatzwert f¸r FRAU aktiv Bank 2" UWORD B_TRUE 1 100 0 1 BIT_MASK 0x40 FORMAT "%13.11" ECU_ADDRESS 0x3FE492 /end MEASUREMENT
/begin MEASUREMENT B_bkfrst "Bedingung: LR-Abweichung" UWORD B_TRUE 1 100 0 1 BIT_MASK 0x40 FORMAT "%13.11" ECU_ADDRESS 0x3FE494 /end MEASUREMENT
/begin MEASUREMENT B_bkfrst2 "Bedingung: LR-Abweichung Bank 2" UWORD B_TRUE 1 100 0 1 BIT_MASK 0x40 FORMAT "%13.11" ECU_ADDRESS 0x3FE496 /end MEASUREMENT
/begin MEASUREMENT B_bkiclsu "Bedingung Ersatzwert aktiv: Auswerte-IC f¸r LSU" UWORD B_TRUE 1 100 0 1 BIT_MASK 0x40 FORMAT "%13.11" ECU_ADDRESS 0x3FE4B4 /end MEASUREMENT
/begin MEASUREMENT B_bkiclsu2 "Bedingung Ersatzwert aktiv: Auswerte-IC f¸r LSU,Bank2" UWORD B_TRUE 1 100 0 1 BIT_MASK 0x40 FORMAT "%13.11" ECU_ADDRESS 0x3FE4B6 /end MEASUREMENT
/begin MEASUREMENT B_bkkat "Bedingung Ersatzwert f¸r Katalysator" UWORD B_TRUE 1 100 0 1 BIT_MASK 0x40 FORMAT "%13.11" ECU_ADDRESS 0x3FE4B8 /end MEASUREMENT
/begin MEASUREMENT B_bkkat2 "Bedingung Ersatzwert f¸r Katalysator, Bank2" UWORD B_TRUE 1 100 0 1 BIT_MASK 0x40 FORMAT "%13.11" ECU_ADDRESS 0x3FE4BA /end MEASUREMENT
/begin MEASUREMENT B_bkkose "Bedingung: Ersatzwert aktiv bei Klimakompressor" UWORD B_TRUE 1 100 0 1 BIT_MASK 0x40 FORMAT "%13.11" ECU_ADDRESS 0x3FE4BC /end MEASUREMENT
/begin MEASUREMENT B_bkkrnt "Bedingung: Klopfregelung Nulltest aktiv" UWORD B_TRUE 1 100 0 1 BIT_MASK 0x40 FORMAT "%13.11" ECU_ADDRESS 0x3FE4C0 /end MEASUREMENT
/begin MEASUREMENT B_bkkrnt2 "" UWORD B_TRUE 1 100 0 1 BIT_MASK 0x40 FORMAT "%13.11" ECU_ADDRESS 0x3FE4C2 /end MEASUREMENT
/begin MEASUREMENT B_bkkrof "Bedingung: Klopfregelung Offset aktiv" UWORD B_TRUE 1 100 0 1 BIT_MASK 0x40 FORMAT "%13.11" ECU_ADDRESS 0x3FE4C4 /end MEASUREMENT
/begin MEASUREMENT B_bkkrof2 "" UWORD B_TRUE 1 100 0 1 BIT_MASK 0x40 FORMAT "%13.11" ECU_ADDRESS 0x3FE4C6 /end MEASUREMENT
/begin MEASUREMENT B_bkkrtp "Bedingung: Klopfregelung Testimpuls aktiv" UWORD B_TRUE 1 100 0 1 BIT_MASK 0x40 FORMAT "%13.11" ECU_ADDRESS 0x3FE4C8 /end MEASUREMENT
/begin MEASUREMENT B_bkkrtp2 "" UWORD B_TRUE 1 100 0 1 BIT_MASK 0x40 FORMAT "%13.11" ECU_ADDRESS 0x3FE4CA /end MEASUREMENT
/begin MEASUREMENT B_bkks1 "Bedingung: Klopfsensor 1 aktiv" UWORD B_TRUE 1 100 0 1 BIT_MASK 0x40 FORMAT "%13.11" ECU_ADDRESS 0x3FE4CC /end MEASUREMENT
/begin MEASUREMENT B_bkks2 "Bedingung: Klopfsensor 2 aktiv" UWORD B_TRUE 1 100 0 1 BIT_MASK 0x40 FORMAT "%13.11" ECU_ADDRESS 0x3FE4CE /end MEASUREMENT
/begin MEASUREMENT B_bkks3 "Bedingung: Klopfsensor 3 aktiv" UWORD B_TRUE 1 100 0 1 BIT_MASK 0x40 FORMAT "%13.11" ECU_ADDRESS 0x3FE4D0 /end MEASUREMENT
/begin MEASUREMENT B_bkks4 "Bedingung: Klopfsensor 4 aktiv" UWORD B_TRUE 1 100 0 1 BIT_MASK 0x40 FORMAT "%13.11" ECU_ADDRESS 0x3FE4D2 /end MEASUREMENT
/begin MEASUREMENT B_bkkuppl "Ersatzwert aktiv" UWORD B_TRUE 1 100 0 1 BIT_MASK 0x40 FORMAT "%13.11" ECU_ADDRESS 0x3FE4D4 /end MEASUREMENT
/begin MEASUREMENT B_bklash "Bedingung: Lambdasondenalterung hinter Kat." UWORD B_TRUE 1 100 0 1 BIT_MASK 0x40 FORMAT "%13.11" ECU_ADDRESS 0x3FE4D6 /end MEASUREMENT
/begin MEASUREMENT B_bklash2 "Bedingung: Lambdasondenalterung hinter Kat. Bank2" UWORD B_TRUE 1 100 0 1 BIT_MASK 0x40 FORMAT "%13.11" ECU_ADDRESS 0x3FE4D8 /end MEASUREMENT
/begin MEASUREMENT B_bklavh "Bedingung: Lambdasondenalterung (Vollast) hinter Kat." UWORD B_TRUE 1 100 0 1 BIT_MASK 0x40 FORMAT "%13.11" ECU_ADDRESS 0x3FE4DA /end MEASUREMENT
/begin MEASUREMENT B_bklavh2 "Bedingung: Lambdasondenalterung (Vollast) hinter Kat. Bank2" UWORD B_TRUE 1 100 0 1 BIT_MASK 0x40 FORMAT "%13.11" ECU_ADDRESS 0x3FE4DC /end MEASUREMENT
/begin MEASUREMENT B_bkllr "Bedingung: Leerlaufregelung aktiv" UWORD B_TRUE 1 100 0 1 BIT_MASK 0x40 FORMAT "%13.11" ECU_ADDRESS 0x3FE4DE /end MEASUREMENT
/begin MEASUREMENT B_bklsh "Bedingung: Lambdasonde hinter Kat. aktiv" UWORD B_TRUE 1 100 0 1 BIT_MASK 0x40 FORMAT "%13.11" ECU_ADDRESS 0x3FE4E2 /end MEASUREMENT
/begin MEASUREMENT B_bklsh2 "Bedingung: Lambdasonde hinter Kat. aktiv Bank2" UWORD B_TRUE 1 100 0 1 BIT_MASK 0x40 FORMAT "%13.11" ECU_ADDRESS 0x3FE4E4 /end MEASUREMENT
/begin MEASUREMENT B_bklsuia "Bedingung Ersatzwert aktiv: LSU-Leitungspr¸fung IA" UWORD B_TRUE 1 100 0 1 BIT_MASK 0x40 FORMAT "%13.11" ECU_ADDRESS 0x3FE4E6 /end MEASUREMENT
/begin MEASUREMENT B_bklsuia2 "Bedingung Ersatzwert aktiv: LSU-Leitungspr¸fung IA, Bank 2" UWORD B_TRUE 1 100 0 1 BIT_MASK 0x40 FORMAT "%13.11" ECU_ADDRESS 0x3FE4E8 /end MEASUREMENT
/begin MEASUREMENT B_bklsuip "Bedingung Ersatzwert aktiv: LSU-Leitungspr¸fung IP" UWORD B_TRUE 1 100 0 1 BIT_MASK 0x40 FORMAT "%13.11" ECU_ADDRESS 0x3FE4EA /end MEASUREMENT
/begin MEASUREMENT B_bklsuip2 "Bedingung Ersatzwert aktiv: LSU-Leitungspr¸fung IP, B2" UWORD B_TRUE 1 100 0 1 BIT_MASK 0x40 FORMAT "%13.11" ECU_ADDRESS 0x3FE4EC /end MEASUREMENT
/begin MEASUREMENT B_bklsuks "Bedingung Ersatzwert aktiv: LSU-Leitungspr¸fungen auf Kurzschluss" UWORD B_TRUE 1 100 0 1 BIT_MASK 0x40 FORMAT "%13.11" ECU_ADDRESS 0x3FE4EE /end MEASUREMENT
/begin MEASUREMENT B_bklsuks2 "Bedingung Ersatzwert aktiv: LSU-Leitungspr¸fungen auf Kurzschluss, B2" UWORD B_TRUE 1 100 0 1 BIT_MASK 0x40 FORMAT "%13.11" ECU_ADDRESS 0x3FE4F0 /end MEASUREMENT
/begin MEASUREMENT B_bklsuun "Bedingung Ersatzwert aktiv: LSU-Leitungspr¸fung UN" UWORD B_TRUE 1 100 0 1 BIT_MASK 0x40 FORMAT "%13.11" ECU_ADDRESS 0x3FE4F2 /end MEASUREMENT
/begin MEASUREMENT B_bklsuun2 "Bedingung Ersatzwert aktiv: LSU-Leitungspr¸fung UN, Bank 2" UWORD B_TRUE 1 100 0 1 BIT_MASK 0x40 FORMAT "%13.11" ECU_ADDRESS 0x3FE4F4 /end MEASUREMENT
/begin MEASUREMENT B_bklsuvm "Bedingung Ersatzwert aktiv: LSU-Leitungspr¸fung VM" UWORD B_TRUE 1 100 0 1 BIT_MASK 0x40 FORMAT "%13.11" ECU_ADDRESS 0x3FE4F6 /end MEASUREMENT
/begin MEASUREMENT B_bklsuvm2 "Bedingung Ersatzwert aktiv: LSU-Leitungspr¸fung VM, Bank 2" UWORD B_TRUE 1 100 0 1 BIT_MASK 0x40 FORMAT "%13.11" ECU_ADDRESS 0x3FE4F8 /end MEASUREMENT
/begin MEASUREMENT B_bkmd "Flag f¸r Ersatzwert: Aussetzer, Summenfehler (multiple)" UWORD B_TRUE 1 100 0 1 BIT_MASK 0x40 FORMAT "%13.11" ECU_ADDRESS 0x3FE500 /end MEASUREMENT
/begin MEASUREMENT B_bkmd00 "Flag f¸r Ersatzwert: Aussetzer Z¸ndung 0" UWORD B_TRUE 1 100 0 1 BIT_MASK 0x40 FORMAT "%13.11" ECU_ADDRESS 0x3FE502 /end MEASUREMENT
/begin MEASUREMENT B_bkmd01 "Flag f¸r Ersatzwert: Aussetzer Z¸ndung 1" UWORD B_TRUE 1 100 0 1 BIT_MASK 0x40 FORMAT "%13.11" ECU_ADDRESS 0x3FE504 /end MEASUREMENT
/begin MEASUREMENT B_bkmd02 "Flag f¸r Ersatzwert: Aussetzer Z¸ndung 2" UWORD B_TRUE 1 100 0 1 BIT_MASK 0x40 FORMAT "%13.11" ECU_ADDRESS 0x3FE506 /end MEASUREMENT
/begin MEASUREMENT B_bkmd03 "Flag f¸r Ersatzwert: Aussetzer Z¸ndung 3" UWORD B_TRUE 1 100 0 1 BIT_MASK 0x40 FORMAT "%13.11" ECU_ADDRESS 0x3FE508 /end MEASUREMENT
/begin MEASUREMENT B_bkmd04 "Flag f¸r Ersatzwert: Aussetzer Z¸ndung 4" UWORD B_TRUE 1 100 0 1 BIT_MASK 0x40 FORMAT "%13.11" ECU_ADDRESS 0x3FE50A /end MEASUREMENT
/begin MEASUREMENT B_bkmd05 "Flag f¸r Ersatzwert: Aussetzer Z¸ndung 5" UWORD B_TRUE 1 100 0 1 BIT_MASK 0x40 FORMAT "%13.11" ECU_ADDRESS 0x3FE50C /end MEASUREMENT
/begin MEASUREMENT B_bkmd06 "Flag f¸r Ersatzwert: Aussetzer Z¸ndung 6" UWORD B_TRUE 1 100 0 1 BIT_MASK 0x40 FORMAT "%13.11" ECU_ADDRESS 0x3FE50E /end MEASUREMENT
/begin MEASUREMENT B_bkmd07 "Flag f¸r Ersatzwert: Aussetzer Z¸ndung 7" UWORD B_TRUE 1 100 0 1 BIT_MASK 0x40 FORMAT "%13.11" ECU_ADDRESS 0x3FE510 /end MEASUREMENT
/begin MEASUREMENT B_bkmd08 "Flag f¸r Ersatzwert: Aussetzer Z¸ndung 8" UWORD B_TRUE 1 100 0 1 BIT_MASK 0x40 FORMAT "%13.11" ECU_ADDRESS 0x3FE512 /end MEASUREMENT
/begin MEASUREMENT B_bkmd09 "Flag f¸r Ersatzwert: Aussetzer Z¸ndung 9" UWORD B_TRUE 1 100 0 1 BIT_MASK 0x40 FORMAT "%13.11" ECU_ADDRESS 0x3FE514 /end MEASUREMENT
/begin MEASUREMENT B_bkmd10 "Flag f¸r Ersatzwert: Aussetzer Z¸ndung 10" UWORD B_TRUE 1 100 0 1 BIT_MASK 0x40 FORMAT "%13.11" ECU_ADDRESS 0x3FE516 /end MEASUREMENT
/begin MEASUREMENT B_bkmd11 "Flag f¸r Ersatzwert: Aussetzer Z¸ndung 11" UWORD B_TRUE 1 100 0 1 BIT_MASK 0x40 FORMAT "%13.11" ECU_ADDRESS 0x3FE518 /end MEASUREMENT
/begin MEASUREMENT B_bkmle "Bedingung Ersatzwert aktiv Motorl¸fter" UWORD B_TRUE 1 100 0 1 BIT_MASK 0x40 FORMAT "%13.11" ECU_ADDRESS 0x3FE520 /end MEASUREMENT
/begin MEASUREMENT B_bknvrbup "Bedingung Ersatzwert aktiv NVRAM-Backup-Diagnose" UWORD B_TRUE 1 100 0 1 BIT_MASK 0x40 FORMAT "%13.11" ECU_ADDRESS 0x3FE526 /end MEASUREMENT
/begin MEASUREMENT B_bkrkat "Ersatzwert f¸r RKAT aktiv" UWORD B_TRUE 1 100 0 1 BIT_MASK 0x40 FORMAT "%13.11" ECU_ADDRESS 0x3FE544 /end MEASUREMENT
/begin MEASUREMENT B_bkrkat2 "Ersatzwert f¸r RKAT aktiv Bank 2" UWORD B_TRUE 1 100 0 1 BIT_MASK 0x40 FORMAT "%13.11" ECU_ADDRESS 0x3FE546 /end MEASUREMENT
/begin MEASUREMENT B_bkrkaz "Ersatzwert f¸r RKAZ aktiv" UWORD B_TRUE 1 100 0 1 BIT_MASK 0x40 FORMAT "%13.11" ECU_ADDRESS 0x3FE548 /end MEASUREMENT
/begin MEASUREMENT B_bkrkaz2 "Ersatzwert f¸r RKAZ aktiv Bank 2" UWORD B_TRUE 1 100 0 1 BIT_MASK 0x40 FORMAT "%13.11" ECU_ADDRESS 0x3FE54A /end MEASUREMENT
/begin MEASUREMENT B_clanws "Bedingung Fehlerpfad Nockenwellensteuerung (Auslaﬂ,Bank1) lˆschen" UWORD B_TRUE 1 100 0 1 BIT_MASK 0x80 FORMAT "%13.11" ECU_ADDRESS 0x3FE3B4 /end MEASUREMENT
/begin MEASUREMENT B_clanws2 "Bedingung Fehlerpfad Nockenwellensteuerung (Auslaﬂ,Bank2) lˆschen" UWORD B_TRUE 1 100 0 1 BIT_MASK 0x80 FORMAT "%13.11" ECU_ADDRESS 0x3FE3B6 /end MEASUREMENT
/begin MEASUREMENT B_clcvvt "Bedingung Fehlerpfad CVVT  lˆschen" UWORD B_TRUE 1 100 0 1 BIT_MASK 0x80 FORMAT "%13.11" ECU_ADDRESS 0x3FE3E0 /end MEASUREMENT
/begin MEASUREMENT B_clets "Bedingung Fehlerpfad ETS lˆschen" UWORD B_TRUE 1 100 0 1 BIT_MASK 0x80 FORMAT "%13.11" ECU_ADDRESS 0x3FE474 /end MEASUREMENT
/begin MEASUREMENT B_clfrao "Bedingung Fehlerpfad FRAO lˆschen (obere Multipl. Bereich)" UWORD B_TRUE 1 100 0 1 BIT_MASK 0x80 FORMAT "%13.11" ECU_ADDRESS 0x3FE48C /end MEASUREMENT
/begin MEASUREMENT B_clfrao2 "Bedingung Fehlerpfad FRAO2 lˆschen (Stereo)" UWORD B_TRUE 1 100 0 1 BIT_MASK 0x80 FORMAT "%13.11" ECU_ADDRESS 0x3FE48E /end MEASUREMENT
/begin MEASUREMENT B_clfrau "Bedingung Fehlerpfad FRAU lˆschen (untere Multipl. Bereich)" UWORD B_TRUE 1 100 0 1 BIT_MASK 0x80 FORMAT "%13.11" ECU_ADDRESS 0x3FE490 /end MEASUREMENT
/begin MEASUREMENT B_clfrau2 "Bedingung Fehlerpfad FRAU2 lˆschen (Stereo)" UWORD B_TRUE 1 100 0 1 BIT_MASK 0x80 FORMAT "%13.11" ECU_ADDRESS 0x3FE492 /end MEASUREMENT
/begin MEASUREMENT B_clfrst "Bedingung Fehlerpfad FRST lˆschen (Kurztest)" UWORD B_TRUE 1 100 0 1 BIT_MASK 0x80 FORMAT "%13.11" ECU_ADDRESS 0x3FE494 /end MEASUREMENT
/begin MEASUREMENT B_clfrst2 "Bedingung Fehlerpfad FRST lˆschen (Kurztest Bank 2)" UWORD B_TRUE 1 100 0 1 BIT_MASK 0x80 FORMAT "%13.11" ECU_ADDRESS 0x3FE496 /end MEASUREMENT
/begin MEASUREMENT B_cliclsu "Bedingung Fehler E_iclsu lˆschen" UWORD B_TRUE 1 100 0 1 BIT_MASK 0x80 FORMAT "%13.11" ECU_ADDRESS 0x3FE4B4 /end MEASUREMENT
/begin MEASUREMENT B_cliclsu2 "Bedingung Fehler E_iclsu lˆschen, Bank 2" UWORD B_TRUE 1 100 0 1 BIT_MASK 0x80 FORMAT "%13.11" ECU_ADDRESS 0x3FE4B6 /end MEASUREMENT
/begin MEASUREMENT B_clkat "Bedingung Fehlerpfad DKAT lˆschen" UWORD B_TRUE 1 100 0 1 BIT_MASK 0x80 FORMAT "%13.11" ECU_ADDRESS 0x3FE4B8 /end MEASUREMENT
/begin MEASUREMENT B_clkat2 "Bedingung Fehlerpfad Dkat lˆschen (Stereo)" UWORD B_TRUE 1 100 0 1 BIT_MASK 0x80 FORMAT "%13.11" ECU_ADDRESS 0x3FE4BA /end MEASUREMENT
/begin MEASUREMENT B_clkose "Bedingung: Fehlerpfad Endstufe Klimakompressor lˆschen" UWORD B_TRUE 1 100 0 1 BIT_MASK 0x80 FORMAT "%13.11" ECU_ADDRESS 0x3FE4BC /end MEASUREMENT
/begin MEASUREMENT B_clkrnt "Bedingung Fehlerpfad KR-Diagnose Integratorsteigung lˆschen" UWORD B_TRUE 1 100 0 1 BIT_MASK 0x80 FORMAT "%13.11" ECU_ADDRESS 0x3FE4C0 /end MEASUREMENT
/begin MEASUREMENT B_clkrnt2 "Bedingung Fehlerpfad KR-Diagnose Integratorsteigung lˆschen (2. CC195)" UWORD B_TRUE 1 100 0 1 BIT_MASK 0x80 FORMAT "%13.11" ECU_ADDRESS 0x3FE4C2 /end MEASUREMENT
/begin MEASUREMENT B_clkrof "Bedingung Fehlerpfad KR-Diagnose Resetwert lˆschen" UWORD B_TRUE 1 100 0 1 BIT_MASK 0x80 FORMAT "%13.11" ECU_ADDRESS 0x3FE4C4 /end MEASUREMENT
/begin MEASUREMENT B_clkrof2 "Bedingung Fehlerpfad KR-Diagnose Resetwert lˆschen (2. CC195)" UWORD B_TRUE 1 100 0 1 BIT_MASK 0x80 FORMAT "%13.11" ECU_ADDRESS 0x3FE4C6 /end MEASUREMENT
/begin MEASUREMENT B_clkrtp "Bedingung Fehlerpfad KR-Diagnose Testimpuls lˆschen" UWORD B_TRUE 1 100 0 1 BIT_MASK 0x80 FORMAT "%13.11" ECU_ADDRESS 0x3FE4C8 /end MEASUREMENT
/begin MEASUREMENT B_clkrtp2 "Bedingung Fehlerpfad KR-Diagnose Testimpuls lˆschen (2. CC195)" UWORD B_TRUE 1 100 0 1 BIT_MASK 0x80 FORMAT "%13.11" ECU_ADDRESS 0x3FE4CA /end MEASUREMENT
/begin MEASUREMENT B_clks1 "Bedingung: Fehlerpfad lˆschen, Klopfsensor 1" UWORD B_TRUE 1 100 0 1 BIT_MASK 0x80 FORMAT "%13.11" ECU_ADDRESS 0x3FE4CC /end MEASUREMENT
/begin MEASUREMENT B_clks2 "Bedingung: Fehlerpfad lˆschen, Klopfsensor 2" UWORD B_TRUE 1 100 0 1 BIT_MASK 0x80 FORMAT "%13.11" ECU_ADDRESS 0x3FE4CE /end MEASUREMENT
/begin MEASUREMENT B_clks3 "Bedingung: Fehlerpfad lˆschen, Klopfsensor 3" UWORD B_TRUE 1 100 0 1 BIT_MASK 0x80 FORMAT "%13.11" ECU_ADDRESS 0x3FE4D0 /end MEASUREMENT
/begin MEASUREMENT B_clks4 "Bedingung: Fehlerpfad lˆschen, Klopfsensor 4" UWORD B_TRUE 1 100 0 1 BIT_MASK 0x80 FORMAT "%13.11" ECU_ADDRESS 0x3FE4D2 /end MEASUREMENT
/begin MEASUREMENT B_clkuppl "Bedingung: Fehlerpfad KUPPL (Gebergrˆﬂe Kupplung) lˆschen" UWORD B_TRUE 1 100 0 1 BIT_MASK 0x80 FORMAT "%13.11" ECU_ADDRESS 0x3FE4D4 /end MEASUREMENT
/begin MEASUREMENT B_cllash "Fehlerpfad in DLSAHK lˆschen." UWORD B_TRUE 1 100 0 1 BIT_MASK 0x80 FORMAT "%13.11" ECU_ADDRESS 0x3FE4D6 /end MEASUREMENT
/begin MEASUREMENT B_cllash2 "Fehlerpfad in DLSAHK lˆschen Bank2" UWORD B_TRUE 1 100 0 1 BIT_MASK 0x80 FORMAT "%13.11" ECU_ADDRESS 0x3FE4D8 /end MEASUREMENT
/begin MEASUREMENT B_cllavh "Fehlerpfad in DLSAVH lˆschen." UWORD B_TRUE 1 100 0 1 BIT_MASK 0x80 FORMAT "%13.11" ECU_ADDRESS 0x3FE4DA /end MEASUREMENT
/begin MEASUREMENT B_cllavh2 "Fehlerpfad in DLSAVH lˆschen  Bank2" UWORD B_TRUE 1 100 0 1 BIT_MASK 0x80 FORMAT "%13.11" ECU_ADDRESS 0x3FE4DC /end MEASUREMENT
/begin MEASUREMENT B_clllr "Bedingung Fehlerpfad DLLR lˆschen" UWORD B_TRUE 1 100 0 1 BIT_MASK 0x80 FORMAT "%13.11" ECU_ADDRESS 0x3FE4DE /end MEASUREMENT
/begin MEASUREMENT B_cllsh "Fehlerpfad in DLSH lˆschen" UWORD B_TRUE 1 100 0 1 BIT_MASK 0x80 FORMAT "%13.11" ECU_ADDRESS 0x3FE4E2 /end MEASUREMENT
/begin MEASUREMENT B_cllsh2 "Fehlerpfad in DLSH lˆschen.  Bank 2" UWORD B_TRUE 1 100 0 1 BIT_MASK 0x80 FORMAT "%13.11" ECU_ADDRESS 0x3FE4E4 /end MEASUREMENT
/begin MEASUREMENT B_cllsuia "Bedingung Fehler E_lsuia lˆschen," UWORD B_TRUE 1 100 0 1 BIT_MASK 0x80 FORMAT "%13.11" ECU_ADDRESS 0x3FE4E6 /end MEASUREMENT
/begin MEASUREMENT B_cllsuia2 "Bedingung Fehler E_lsuia2 lˆschen, Bank 2" UWORD B_TRUE 1 100 0 1 BIT_MASK 0x80 FORMAT "%13.11" ECU_ADDRESS 0x3FE4E8 /end MEASUREMENT
/begin MEASUREMENT B_cllsuip "Bedingung Fehler E_lsuip lˆschen," UWORD B_TRUE 1 100 0 1 BIT_MASK 0x80 FORMAT "%13.11" ECU_ADDRESS 0x3FE4EA /end MEASUREMENT
/begin MEASUREMENT B_cllsuip2 "Bedingung Fehler E_lsuip2 lˆschen," UWORD B_TRUE 1 100 0 1 BIT_MASK 0x80 FORMAT "%13.11" ECU_ADDRESS 0x3FE4EC /end MEASUREMENT
/begin MEASUREMENT B_cllsuks "Bedingung Fehler E_lsuks lˆschen," UWORD B_TRUE 1 100 0 1 BIT_MASK 0x80 FORMAT "%13.11" ECU_ADDRESS 0x3FE4EE /end MEASUREMENT
/begin MEASUREMENT B_cllsuks2 "Bedingung Fehler E_lsuks2 lˆschen," UWORD B_TRUE 1 100 0 1 BIT_MASK 0x80 FORMAT "%13.11" ECU_ADDRESS 0x3FE4F0 /end MEASUREMENT
/begin MEASUREMENT B_cllsuun "Bedingung Fehler E_lsuun lˆschen," UWORD B_TRUE 1 100 0 1 BIT_MASK 0x80 FORMAT "%13.11" ECU_ADDRESS 0x3FE4F2 /end MEASUREMENT
/begin MEASUREMENT B_cllsuun2 "Bedingung Fehler E_lsuun2 lˆschen, Bank 2" UWORD B_TRUE 1 100 0 1 BIT_MASK 0x80 FORMAT "%13.11" ECU_ADDRESS 0x3FE4F4 /end MEASUREMENT
/begin MEASUREMENT B_cllsuvm "Bedingung Fehler E_lsuvm lˆschen" UWORD B_TRUE 1 100 0 1 BIT_MASK 0x80 FORMAT "%13.11" ECU_ADDRESS 0x3FE4F6 /end MEASUREMENT
/begin MEASUREMENT B_cllsuvm2 "Bedingung Fehler E_lsuvm2 lˆschen, Bank 2" UWORD B_TRUE 1 100 0 1 BIT_MASK 0x80 FORMAT "%13.11" ECU_ADDRESS 0x3FE4F8 /end MEASUREMENT
/begin MEASUREMENT B_clmd "Flag f¸r Lˆschung: Aussetzer, Summenfehler (multiple)" UWORD B_TRUE 1 100 0 1 BIT_MASK 0x80 FORMAT "%13.11" ECU_ADDRESS 0x3FE500 /end MEASUREMENT
/begin MEASUREMENT B_clmd00 "Flag f¸r Lˆschung: Aussetzer Z¸ndung 0" UWORD B_TRUE 1 100 0 1 BIT_MASK 0x80 FORMAT "%13.11" ECU_ADDRESS 0x3FE502 /end MEASUREMENT
/begin MEASUREMENT B_clmd01 "Flag f¸r Lˆschung: Aussetzer Z¸ndung 1" UWORD B_TRUE 1 100 0 1 BIT_MASK 0x80 FORMAT "%13.11" ECU_ADDRESS 0x3FE504 /end MEASUREMENT
/begin MEASUREMENT B_clmd02 "Flag f¸r Lˆschung: Aussetzer Z¸ndung 2" UWORD B_TRUE 1 100 0 1 BIT_MASK 0x80 FORMAT "%13.11" ECU_ADDRESS 0x3FE506 /end MEASUREMENT
/begin MEASUREMENT B_clmd03 "Flag f¸r Lˆschung: Aussetzer Z¸ndung 3" UWORD B_TRUE 1 100 0 1 BIT_MASK 0x80 FORMAT "%13.11" ECU_ADDRESS 0x3FE508 /end MEASUREMENT
/begin MEASUREMENT B_clmd04 "Flag f¸r Lˆschung: Aussetzer Z¸ndung 4" UWORD B_TRUE 1 100 0 1 BIT_MASK 0x80 FORMAT "%13.11" ECU_ADDRESS 0x3FE50A /end MEASUREMENT
/begin MEASUREMENT B_clmd05 "Flag f¸r Lˆschung: Aussetzer Z¸ndung 5" UWORD B_TRUE 1 100 0 1 BIT_MASK 0x80 FORMAT "%13.11" ECU_ADDRESS 0x3FE50C /end MEASUREMENT
/begin MEASUREMENT B_clmd06 "Flag f¸r Lˆschung: Aussetzer Z¸ndung 6" UWORD B_TRUE 1 100 0 1 BIT_MASK 0x80 FORMAT "%13.11" ECU_ADDRESS 0x3FE50E /end MEASUREMENT
/begin MEASUREMENT B_clmd07 "Flag f¸r Lˆschung: Aussetzer Z¸ndung 7" UWORD B_TRUE 1 100 0 1 BIT_MASK 0x80 FORMAT "%13.11" ECU_ADDRESS 0x3FE510 /end MEASUREMENT
/begin MEASUREMENT B_clmd08 "Flag f¸r Lˆschung: Aussetzer Z¸ndung 8" UWORD B_TRUE 1 100 0 1 BIT_MASK 0x80 FORMAT "%13.11" ECU_ADDRESS 0x3FE512 /end MEASUREMENT
/begin MEASUREMENT B_clmd09 "Flag f¸r Lˆschung: Aussetzer Z¸ndung 9" UWORD B_TRUE 1 100 0 1 BIT_MASK 0x80 FORMAT "%13.11" ECU_ADDRESS 0x3FE514 /end MEASUREMENT
/begin MEASUREMENT B_clmd10 "Flag f¸r Lˆschung: Aussetzer Z¸ndung 10" UWORD B_TRUE 1 100 0 1 BIT_MASK 0x80 FORMAT "%13.11" ECU_ADDRESS 0x3FE516 /end MEASUREMENT
/begin MEASUREMENT B_clmd11 "Flag f¸r Lˆschung: Aussetzer Z¸ndung 11" UWORD B_TRUE 1 100 0 1 BIT_MASK 0x80 FORMAT "%13.11" ECU_ADDRESS 0x3FE518 /end MEASUREMENT
/begin MEASUREMENT B_clmle "Bedingung: Fehlerpfad Endstufe Motor L¸fter lˆschen" UWORD B_TRUE 1 100 0 1 BIT_MASK 0x80 FORMAT "%13.11" ECU_ADDRESS 0x3FE520 /end MEASUREMENT
/begin MEASUREMENT B_clnvrbup "" UWORD B_TRUE 1 100 0 1 BIT_MASK 0x80 FORMAT "%13.11" ECU_ADDRESS 0x3FE526 /end MEASUREMENT
/begin MEASUREMENT B_clrkat "Bedingung Fehlerpfad RKAT lˆschen (add. pro Zeit)" UWORD B_TRUE 1 100 0 1 BIT_MASK 0x80 FORMAT "%13.11" ECU_ADDRESS 0x3FE544 /end MEASUREMENT
/begin MEASUREMENT B_clrkat2 "Bedingung Fehlerpfad RKAT2 lˆschen (Stereo)" UWORD B_TRUE 1 100 0 1 BIT_MASK 0x80 FORMAT "%13.11" ECU_ADDRESS 0x3FE546 /end MEASUREMENT
/begin MEASUREMENT B_clrkaz "Bedingung Fehlerpfad RKAZ lˆschen (add. pro Z¸ndung)" UWORD B_TRUE 1 100 0 1 BIT_MASK 0x80 FORMAT "%13.11" ECU_ADDRESS 0x3FE548 /end MEASUREMENT
/begin MEASUREMENT B_clrkaz2 "Bedingung Fehlerpfad RKAZ2 lˆschen (Stereo)" UWORD B_TRUE 1 100 0 1 BIT_MASK 0x80 FORMAT "%13.11" ECU_ADDRESS 0x3FE54A /end MEASUREMENT
/begin MEASUREMENT B_falash "" UWORD B_TRUE 1 100 0 1 BIT_MASK 0x10 FORMAT "%13.11" ECU_ADDRESS 0x3FE4D6 /end MEASUREMENT
/begin MEASUREMENT B_falash2 "" UWORD B_TRUE 1 100 0 1 BIT_MASK 0x10 FORMAT "%13.11" ECU_ADDRESS 0x3FE4D8 /end MEASUREMENT
/begin MEASUREMENT B_ftanws "Bedingung: Fehlereintrag durch Tester f¸r NWS (Auslaﬂ, Bank1)" UWORD B_TRUE 1 100 0 1 BIT_MASK 0x10 FORMAT "%13.11" ECU_ADDRESS 0x3FE3B4 /end MEASUREMENT
/begin MEASUREMENT B_ftanws2 "Bedingung: Fehlereintrag durch Tester f¸r NWS (Auslaﬂ, Bank2)" UWORD B_TRUE 1 100 0 1 BIT_MASK 0x10 FORMAT "%13.11" ECU_ADDRESS 0x3FE3B6 /end MEASUREMENT
/begin MEASUREMENT B_ftcvvt "Text wird von H.Bajic nachgetragen" UWORD B_TRUE 1 100 0 1 BIT_MASK 0x10 FORMAT "%13.11" ECU_ADDRESS 0x3FE3E0 /end MEASUREMENT
/begin MEASUREMENT B_ftets "Bedingung: Fehlereintrag durch Tester f¸r el. Thermostat-Endstufe" UWORD B_TRUE 1 100 0 1 BIT_MASK 0x10 FORMAT "%13.11" ECU_ADDRESS 0x3FE474 /end MEASUREMENT
/begin MEASUREMENT B_ftfrao "Bedingung Fehlereintrag durch Tester f¸r FRAO" UWORD B_TRUE 1 100 0 1 BIT_MASK 0x10 FORMAT "%13.11" ECU_ADDRESS 0x3FE48C /end MEASUREMENT
/begin MEASUREMENT B_ftfrao2 "Bedingung Fehlereintrag durch Tester f¸r FRAO2" UWORD B_TRUE 1 100 0 1 BIT_MASK 0x10 FORMAT "%13.11" ECU_ADDRESS 0x3FE48E /end MEASUREMENT
/begin MEASUREMENT B_ftfrau "Bedingung Fehlereintrag durch Tester f¸r FRAU" UWORD B_TRUE 1 100 0 1 BIT_MASK 0x10 FORMAT "%13.11" ECU_ADDRESS 0x3FE490 /end MEASUREMENT
/begin MEASUREMENT B_ftfrau2 "Bedingung Fehlereintrag durch Tester f¸r FRAU2" UWORD B_TRUE 1 100 0 1 BIT_MASK 0x10 FORMAT "%13.11" ECU_ADDRESS 0x3FE492 /end MEASUREMENT
/begin MEASUREMENT B_ftfrst "Bedingung Fehlereintrag durch Tester f¸r FRST (FR-Kurztest)" UWORD B_TRUE 1 100 0 1 BIT_MASK 0x10 FORMAT "%13.11" ECU_ADDRESS 0x3FE494 /end MEASUREMENT
/begin MEASUREMENT B_ftfrst2 "Bedingung Fehlereintrag durch Tester f¸r FRST (FR-Kurztest Bank 2)" UWORD B_TRUE 1 100 0 1 BIT_MASK 0x10 FORMAT "%13.11" ECU_ADDRESS 0x3FE496 /end MEASUREMENT
/begin MEASUREMENT B_fticlsu "Bedingung Fehlereintrag durch Tester f¸r Auswerte-IC der LSU" UWORD B_TRUE 1 100 0 1 BIT_MASK 0x10 FORMAT "%13.11" ECU_ADDRESS 0x3FE4B4 /end MEASUREMENT
/begin MEASUREMENT B_fticlsu2 "Bedingung Fehlereintrag durch Tester f¸r Auswerte-IC der LSU, Bank 2" UWORD B_TRUE 1 100 0 1 BIT_MASK 0x10 FORMAT "%13.11" ECU_ADDRESS 0x3FE4B6 /end MEASUREMENT
/begin MEASUREMENT B_ftkat "Bedingung: Fehlereintrag durch Tester f¸r Katalysator" UWORD B_TRUE 1 100 0 1 BIT_MASK 0x10 FORMAT "%13.11" ECU_ADDRESS 0x3FE4B8 /end MEASUREMENT
/begin MEASUREMENT B_ftkat2 "Bedingung: Fehlereintrag durch Tester f¸r Katalysator, Bank2" UWORD B_TRUE 1 100 0 1 BIT_MASK 0x10 FORMAT "%13.11" ECU_ADDRESS 0x3FE4BA /end MEASUREMENT
/begin MEASUREMENT B_ftkose "Bedingung: Fehlereintrag durch Tester f¸r Klimakompressor" UWORD B_TRUE 1 100 0 1 BIT_MASK 0x10 FORMAT "%13.11" ECU_ADDRESS 0x3FE4BC /end MEASUREMENT
/begin MEASUREMENT B_ftkrnt "" UWORD B_TRUE 1 100 0 1 BIT_MASK 0x10 FORMAT "%13.11" ECU_ADDRESS 0x3FE4C0 /end MEASUREMENT
/begin MEASUREMENT B_ftkrnt2 "" UWORD B_TRUE 1 100 0 1 BIT_MASK 0x10 FORMAT "%13.11" ECU_ADDRESS 0x3FE4C2 /end MEASUREMENT
/begin MEASUREMENT B_ftkrof "" UWORD B_TRUE 1 100 0 1 BIT_MASK 0x10 FORMAT "%13.11" ECU_ADDRESS 0x3FE4C4 /end MEASUREMENT
/begin MEASUREMENT B_ftkrof2 "" UWORD B_TRUE 1 100 0 1 BIT_MASK 0x10 FORMAT "%13.11" ECU_ADDRESS 0x3FE4C6 /end MEASUREMENT
/begin MEASUREMENT B_ftkrtp "" UWORD B_TRUE 1 100 0 1 BIT_MASK 0x10 FORMAT "%13.11" ECU_ADDRESS 0x3FE4C8 /end MEASUREMENT
/begin MEASUREMENT B_ftkrtp2 "" UWORD B_TRUE 1 100 0 1 BIT_MASK 0x10 FORMAT "%13.11" ECU_ADDRESS 0x3FE4CA /end MEASUREMENT
/begin MEASUREMENT B_ftks1 "Bedingung:Fehlereintrag durch Tester, Klopfsensor 1" UWORD B_TRUE 1 100 0 1 BIT_MASK 0x10 FORMAT "%13.11" ECU_ADDRESS 0x3FE4CC /end MEASUREMENT
/begin MEASUREMENT B_ftks2 "Bedingung:Fehlereintrag durch Tester, Klopfsensor 2" UWORD B_TRUE 1 100 0 1 BIT_MASK 0x10 FORMAT "%13.11" ECU_ADDRESS 0x3FE4CE /end MEASUREMENT
/begin MEASUREMENT B_ftks3 "Bedingung:Fehlereintrag durch Tester, Klopfsensor 3" UWORD B_TRUE 1 100 0 1 BIT_MASK 0x10 FORMAT "%13.11" ECU_ADDRESS 0x3FE4D0 /end MEASUREMENT
/begin MEASUREMENT B_ftks4 "Bedingung:Fehlereintrag durch Tester, Klopfsensor 4" UWORD B_TRUE 1 100 0 1 BIT_MASK 0x10 FORMAT "%13.11" ECU_ADDRESS 0x3FE4D2 /end MEASUREMENT
/begin MEASUREMENT B_ftkuppl "Bedingung: Fehlereintrag durch Tester f¸r Kupplungssensor" UWORD B_TRUE 1 100 0 1 BIT_MASK 0x10 FORMAT "%13.11" ECU_ADDRESS 0x3FE4D4 /end MEASUREMENT
/begin MEASUREMENT B_ftlavh "Bedingung Fehlereintrag durch Tester Lambda Sonde (Vollast-Pr¸fung)  hinter KAT" UWORD B_TRUE 1 100 0 1 BIT_MASK 0x10 FORMAT "%13.11" ECU_ADDRESS 0x3FE4DA /end MEASUREMENT
/begin MEASUREMENT B_ftlavh2 "Bed. Fehlereintrag durch Tester Lambda Sonde (Vollast-Pr¸fung)  hinter KAT Bank2" UWORD B_TRUE 1 100 0 1 BIT_MASK 0x10 FORMAT "%13.11" ECU_ADDRESS 0x3FE4DC /end MEASUREMENT
/begin MEASUREMENT B_ftllr "Bedingung: Fehlereintrag durch Tester Lehrlaufregelung" UWORD B_TRUE 1 100 0 1 BIT_MASK 0x10 FORMAT "%13.11" ECU_ADDRESS 0x3FE4DE /end MEASUREMENT
/begin MEASUREMENT B_ftlsh "Bedingung Fehlereintrag durch Tester Lambda Sonde hinter KAT" UWORD B_TRUE 1 100 0 1 BIT_MASK 0x10 FORMAT "%13.11" ECU_ADDRESS 0x3FE4E2 /end MEASUREMENT
/begin MEASUREMENT B_ftlsh2 "Bedingung Fehlereintrag durch Tester Lambda Sonde hinter KAT Bank2" UWORD B_TRUE 1 100 0 1 BIT_MASK 0x10 FORMAT "%13.11" ECU_ADDRESS 0x3FE4E4 /end MEASUREMENT
/begin MEASUREMENT B_ftlsuia "Bedingung: Fehlereintrag durch Tester f¸r LSU-Leitung IA" UWORD B_TRUE 1 100 0 1 BIT_MASK 0x10 FORMAT "%13.11" ECU_ADDRESS 0x3FE4E6 /end MEASUREMENT
/begin MEASUREMENT B_ftlsuia2 "Bedingung: Fehlereintrag durch Tester f¸r LSU-Leitung IA, Bank 2" UWORD B_TRUE 1 100 0 1 BIT_MASK 0x10 FORMAT "%13.11" ECU_ADDRESS 0x3FE4E8 /end MEASUREMENT
/begin MEASUREMENT B_ftlsuip "Bedingung: Fehlereintrag durch Tester f¸r LSU-Leitung IP" UWORD B_TRUE 1 100 0 1 BIT_MASK 0x10 FORMAT "%13.11" ECU_ADDRESS 0x3FE4EA /end MEASUREMENT
/begin MEASUREMENT B_ftlsuip2 "Bedingung: Fehlereintrag durch Tester f¸r LSU-Leitung IP, B2" UWORD B_TRUE 1 100 0 1 BIT_MASK 0x10 FORMAT "%13.11" ECU_ADDRESS 0x3FE4EC /end MEASUREMENT
/begin MEASUREMENT B_ftlsuks "Bedingung: Fehlereintrag durch Tester f¸r LSU-Leitungen" UWORD B_TRUE 1 100 0 1 BIT_MASK 0x10 FORMAT "%13.11" ECU_ADDRESS 0x3FE4EE /end MEASUREMENT
/begin MEASUREMENT B_ftlsuks2 "Bedingung: Fehlereintrag durch Tester f¸r LSU-Leitungen, B2" UWORD B_TRUE 1 100 0 1 BIT_MASK 0x10 FORMAT "%13.11" ECU_ADDRESS 0x3FE4F0 /end MEASUREMENT
/begin MEASUREMENT B_ftlsuun "Bedingung: Fehlereintrag durch Tester f¸r LSU-Leitung UN" UWORD B_TRUE 1 100 0 1 BIT_MASK 0x10 FORMAT "%13.11" ECU_ADDRESS 0x3FE4F2 /end MEASUREMENT
/begin MEASUREMENT B_ftlsuun2 "Bedingung: Fehlereintrag durch Tester f¸r LSU-Leitung UN, Bank 2" UWORD B_TRUE 1 100 0 1 BIT_MASK 0x10 FORMAT "%13.11" ECU_ADDRESS 0x3FE4F4 /end MEASUREMENT
/begin MEASUREMENT B_ftlsuvm "Bedingung: Fehlereintrag durch Tester f¸r LSU-Leitung VM" UWORD B_TRUE 1 100 0 1 BIT_MASK 0x10 FORMAT "%13.11" ECU_ADDRESS 0x3FE4F6 /end MEASUREMENT
/begin MEASUREMENT B_ftlsuvm2 "Bedingung: Fehlereintrag durch Tester f¸r LSU-Leitung VM, Bank 2" UWORD B_TRUE 1 100 0 1 BIT_MASK 0x10 FORMAT "%13.11" ECU_ADDRESS 0x3FE4F8 /end MEASUREMENT
/begin MEASUREMENT B_ftmd "Bedingung: Fehlereintrag durch Tester f¸r MD" UWORD B_TRUE 1 100 0 1 BIT_MASK 0x10 FORMAT "%13.11" ECU_ADDRESS 0x3FE500 /end MEASUREMENT
/begin MEASUREMENT B_ftmd00 "Bedingung Fehlereintrag durch Tester" UWORD B_TRUE 1 100 0 1 BIT_MASK 0x10 FORMAT "%13.11" ECU_ADDRESS 0x3FE502 /end MEASUREMENT
/begin MEASUREMENT B_ftmd01 "Bedingung Fehlereintrag durch Tester" UWORD B_TRUE 1 100 0 1 BIT_MASK 0x10 FORMAT "%13.11" ECU_ADDRESS 0x3FE504 /end MEASUREMENT
/begin MEASUREMENT B_ftmd02 "Bedingung Fehlereintrag durch Tester" UWORD B_TRUE 1 100 0 1 BIT_MASK 0x10 FORMAT "%13.11" ECU_ADDRESS 0x3FE506 /end MEASUREMENT
/begin MEASUREMENT B_ftmd03 "Bedingung Fehlereintrag durch Tester" UWORD B_TRUE 1 100 0 1 BIT_MASK 0x10 FORMAT "%13.11" ECU_ADDRESS 0x3FE508 /end MEASUREMENT
/begin MEASUREMENT B_ftmd04 "Bedingung Fehlereintrag durch Tester" UWORD B_TRUE 1 100 0 1 BIT_MASK 0x10 FORMAT "%13.11" ECU_ADDRESS 0x3FE50A /end MEASUREMENT
/begin MEASUREMENT B_ftmd05 "Bedingung Fehlereintrag durch Tester" UWORD B_TRUE 1 100 0 1 BIT_MASK 0x10 FORMAT "%13.11" ECU_ADDRESS 0x3FE50C /end MEASUREMENT
/begin MEASUREMENT B_ftmd06 "Bedingung Fehlereintrag durch Tester" UWORD B_TRUE 1 100 0 1 BIT_MASK 0x10 FORMAT "%13.11" ECU_ADDRESS 0x3FE50E /end MEASUREMENT
/begin MEASUREMENT B_ftmd07 "Bedingung Fehlereintrag durch Tester" UWORD B_TRUE 1 100 0 1 BIT_MASK 0x10 FORMAT "%13.11" ECU_ADDRESS 0x3FE510 /end MEASUREMENT
/begin MEASUREMENT B_ftmd08 "Bedingung Fehlereintrag durch Tester" UWORD B_TRUE 1 100 0 1 BIT_MASK 0x10 FORMAT "%13.11" ECU_ADDRESS 0x3FE512 /end MEASUREMENT
/begin MEASUREMENT B_ftmd09 "Bedingung Fehlereintrag durch Tester" UWORD B_TRUE 1 100 0 1 BIT_MASK 0x10 FORMAT "%13.11" ECU_ADDRESS 0x3FE514 /end MEASUREMENT
/begin MEASUREMENT B_ftmd10 "Bedingung Fehlereintrag durch Tester" UWORD B_TRUE 1 100 0 1 BIT_MASK 0x10 FORMAT "%13.11" ECU_ADDRESS 0x3FE516 /end MEASUREMENT
/begin MEASUREMENT B_ftmd11 "Bedingung Fehlereintrag durch Tester" UWORD B_TRUE 1 100 0 1 BIT_MASK 0x10 FORMAT "%13.11" ECU_ADDRESS 0x3FE518 /end MEASUREMENT
/begin MEASUREMENT B_ftmle "Bedingung: Fehlereintrag durch Tester f¸r Motorl¸fter" UWORD B_TRUE 1 100 0 1 BIT_MASK 0x10 FORMAT "%13.11" ECU_ADDRESS 0x3FE520 /end MEASUREMENT
/begin MEASUREMENT B_ftnvrbup "Bedingung Fehlereintrag durch Tester NVRAM-Backup-Diagnose" UWORD B_TRUE 1 100 0 1 BIT_MASK 0x10 FORMAT "%13.11" ECU_ADDRESS 0x3FE526 /end MEASUREMENT
/begin MEASUREMENT B_ftrkat "Bedingung Fehlereintrag durch Tester f¸r RKAT" UWORD B_TRUE 1 100 0 1 BIT_MASK 0x10 FORMAT "%13.11" ECU_ADDRESS 0x3FE544 /end MEASUREMENT
/begin MEASUREMENT B_ftrkat2 "Bedingung Fehlereintrag durch Tester f¸r RKAT2" UWORD B_TRUE 1 100 0 1 BIT_MASK 0x10 FORMAT "%13.11" ECU_ADDRESS 0x3FE546 /end MEASUREMENT
/begin MEASUREMENT B_ftrkaz "Bedingung Fehlereintrag durch Tester f¸r RKAZ" UWORD B_TRUE 1 100 0 1 BIT_MASK 0x10 FORMAT "%13.11" ECU_ADDRESS 0x3FE548 /end MEASUREMENT
/begin MEASUREMENT B_ftrkaz2 "Bedingung Fehlereintrag durch Tester f¸r RKAZ2" UWORD B_TRUE 1 100 0 1 BIT_MASK 0x10 FORMAT "%13.11" ECU_ADDRESS 0x3FE54A /end MEASUREMENT
/begin MEASUREMENT B_mnanws "Bed. Nockenwellenverstellung hat Fr¸hposition nicht erreicht (Auslaﬂ,Bank1)" UWORD B_TRUE 1 100 0 1 BIT_MASK 0x200 FORMAT "%13.11" ECU_ADDRESS 0x3FE3B4 /end MEASUREMENT
/begin MEASUREMENT B_mnanws2 "Bed. Nockenwellenverstellung hat Fr¸hposition nicht erreicht (Auslaﬂ,Bank2)" UWORD B_TRUE 1 100 0 1 BIT_MASK 0x200 FORMAT "%13.11" ECU_ADDRESS 0x3FE3B6 /end MEASUREMENT
/begin MEASUREMENT B_mncvvt "Fehlertyp min.: CAN-Schnittstelle, Timeout VVT-Botschaft" UWORD B_TRUE 1 100 0 1 BIT_MASK 0x200 FORMAT "%13.11" ECU_ADDRESS 0x3FE3E0 /end MEASUREMENT
/begin MEASUREMENT B_mnets "Fehlertype: Kurzschluﬂ nach Masse Endstufe Elektr. Thermostat" UWORD B_TRUE 1 100 0 1 BIT_MASK 0x200 FORMAT "%13.11" ECU_ADDRESS 0x3FE474 /end MEASUREMENT
/begin MEASUREMENT B_mnfrao "Bedingung untere Plausibilit‰tsschwelle unterschritten (obere Multipl.)" UWORD B_TRUE 1 100 0 1 BIT_MASK 0x200 FORMAT "%13.11" ECU_ADDRESS 0x3FE48C /end MEASUREMENT
/begin MEASUREMENT B_mnfrao2 "Bedingung untere Plausibilit‰tsschwelle unterschritten (Stereo)" UWORD B_TRUE 1 100 0 1 BIT_MASK 0x200 FORMAT "%13.11" ECU_ADDRESS 0x3FE48E /end MEASUREMENT
/begin MEASUREMENT B_mnfrau "Bedingung untere Plausibilit‰tsschwelle unterschritten (untere Multipl.)" UWORD B_TRUE 1 100 0 1 BIT_MASK 0x200 FORMAT "%13.11" ECU_ADDRESS 0x3FE490 /end MEASUREMENT
/begin MEASUREMENT B_mnfrau2 "Bedingung untere Plausibilit‰tsschwelle unterschritten (Stereo)" UWORD B_TRUE 1 100 0 1 BIT_MASK 0x200 FORMAT "%13.11" ECU_ADDRESS 0x3FE492 /end MEASUREMENT
/begin MEASUREMENT B_mnfrst "Bedingung untere Plausibilit‰tsschwelle unterschritten(short test)" UWORD B_TRUE 1 100 0 1 BIT_MASK 0x200 FORMAT "%13.11" ECU_ADDRESS 0x3FE494 /end MEASUREMENT
/begin MEASUREMENT B_mnfrst2 "Bedingung untere Plausibilit‰tsschwelle unterschritten(short test Stereo" UWORD B_TRUE 1 100 0 1 BIT_MASK 0x200 FORMAT "%13.11" ECU_ADDRESS 0x3FE496 /end MEASUREMENT
/begin MEASUREMENT B_mniclsu "Bedingung MIN-Fehler Auswerte-IC f¸r die LSU" UWORD B_TRUE 1 100 0 1 BIT_MASK 0x200 FORMAT "%13.11" ECU_ADDRESS 0x3FE4B4 /end MEASUREMENT
/begin MEASUREMENT B_mniclsu2 "Bedingung MIN-Fehler Auswerte-IC f¸r die LSU, Bank 2" UWORD B_TRUE 1 100 0 1 BIT_MASK 0x200 FORMAT "%13.11" ECU_ADDRESS 0x3FE4B6 /end MEASUREMENT
/begin MEASUREMENT B_mnkat "Fehlertyp 'Minimalwert' erkannt (Katalysator defekt)" UWORD B_TRUE 1 100 0 1 BIT_MASK 0x200 FORMAT "%13.11" ECU_ADDRESS 0x3FE4B8 /end MEASUREMENT
/begin MEASUREMENT B_mnkat2 "Fehlertyp min.: Katalysator Bank2" UWORD B_TRUE 1 100 0 1 BIT_MASK 0x200 FORMAT "%13.11" ECU_ADDRESS 0x3FE4BA /end MEASUREMENT
/begin MEASUREMENT B_mnkose "Fehlertype: Kurzschluﬂ nach Masse Endstufe Klimakompressor" UWORD B_TRUE 1 100 0 1 BIT_MASK 0x200 FORMAT "%13.11" ECU_ADDRESS 0x3FE4BC /end MEASUREMENT
/begin MEASUREMENT B_mnkrnt "Fehlertyp min.: Klopfregelung Nulltest" UWORD B_TRUE 1 100 0 1 BIT_MASK 0x200 FORMAT "%13.11" ECU_ADDRESS 0x3FE4C0 /end MEASUREMENT
/begin MEASUREMENT B_mnkrnt2 "Fehlertyp min.: Klopfregelung Nulltest (zweiter CC195)" UWORD B_TRUE 1 100 0 1 BIT_MASK 0x200 FORMAT "%13.11" ECU_ADDRESS 0x3FE4C2 /end MEASUREMENT
/begin MEASUREMENT B_mnkrof "Fehlertyp min.: Klopfregelung Offset" UWORD B_TRUE 1 100 0 1 BIT_MASK 0x200 FORMAT "%13.11" ECU_ADDRESS 0x3FE4C4 /end MEASUREMENT
/begin MEASUREMENT B_mnkrof2 "Fehlertyp min.: Klopfregelung Offset (zweiter CC195)" UWORD B_TRUE 1 100 0 1 BIT_MASK 0x200 FORMAT "%13.11" ECU_ADDRESS 0x3FE4C6 /end MEASUREMENT
/begin MEASUREMENT B_mnkrtp "Fehlertyp min.: Klopfregelung Testimpuls" UWORD B_TRUE 1 100 0 1 BIT_MASK 0x200 FORMAT "%13.11" ECU_ADDRESS 0x3FE4C8 /end MEASUREMENT
/begin MEASUREMENT B_mnkrtp2 "Fehlertyp min.: Klopfregelung Testimpuls (zweiter CC195)" UWORD B_TRUE 1 100 0 1 BIT_MASK 0x200 FORMAT "%13.11" ECU_ADDRESS 0x3FE4CA /end MEASUREMENT
/begin MEASUREMENT B_mnks1 "Bedingung: Min-Fehler Klopfsensor 1" UWORD B_TRUE 1 100 0 1 BIT_MASK 0x200 FORMAT "%13.11" ECU_ADDRESS 0x3FE4CC /end MEASUREMENT
/begin MEASUREMENT B_mnks2 "Bedingung: Min-Fehler Klopfsensor 2" UWORD B_TRUE 1 100 0 1 BIT_MASK 0x200 FORMAT "%13.11" ECU_ADDRESS 0x3FE4CE /end MEASUREMENT
/begin MEASUREMENT B_mnks3 "Bedingung: Min-Fehler Klopfsensor 3" UWORD B_TRUE 1 100 0 1 BIT_MASK 0x200 FORMAT "%13.11" ECU_ADDRESS 0x3FE4D0 /end MEASUREMENT
/begin MEASUREMENT B_mnks4 "Bedingung: Min-fehler Klopfsensor 4" UWORD B_TRUE 1 100 0 1 BIT_MASK 0x200 FORMAT "%13.11" ECU_ADDRESS 0x3FE4D2 /end MEASUREMENT
/begin MEASUREMENT B_mnkuppl "Fehlertyp KUPPL: Minimalwert unterschritten" UWORD B_TRUE 1 100 0 1 BIT_MASK 0x200 FORMAT "%13.11" ECU_ADDRESS 0x3FE4D4 /end MEASUREMENT
/begin MEASUREMENT B_mnlash "Fehlertyp 'Minimalwert' f¸r Schwingungspr¸fung hinter KAT erkannt" UWORD B_TRUE 1 100 0 1 BIT_MASK 0x200 FORMAT "%13.11" ECU_ADDRESS 0x3FE4D6 /end MEASUREMENT
/begin MEASUREMENT B_mnlash2 "Fehlertyp 'Minimalwert' f¸r Schwingungspr¸fung hinter KAT erkannt Bank2" UWORD B_TRUE 1 100 0 1 BIT_MASK 0x200 FORMAT "%13.11" ECU_ADDRESS 0x3FE4D8 /end MEASUREMENT
/begin MEASUREMENT B_mnlavh "Fehlertyp 'Minimalwert' f¸r Vollast-Pr¸fung hinter KAT erkannt" UWORD B_TRUE 1 100 0 1 BIT_MASK 0x200 FORMAT "%13.11" ECU_ADDRESS 0x3FE4DA /end MEASUREMENT
/begin MEASUREMENT B_mnlavh2 "Fehlertyp 'Minimalwert' f¸r Vollast-Pr¸fung hinter KAT erkannt Bank2" UWORD B_TRUE 1 100 0 1 BIT_MASK 0x200 FORMAT "%13.11" ECU_ADDRESS 0x3FE4DC /end MEASUREMENT
/begin MEASUREMENT B_mnllr "Fehler 'Leerlaufdrehzahl zu klein'" UWORD B_TRUE 1 100 0 1 BIT_MASK 0x200 FORMAT "%13.11" ECU_ADDRESS 0x3FE4DE /end MEASUREMENT
/begin MEASUREMENT B_mnlsh "Fehlertyp 'Minimalwert' hinter KAT erkannt" UWORD B_TRUE 1 100 0 1 BIT_MASK 0x200 FORMAT "%13.11" ECU_ADDRESS 0x3FE4E2 /end MEASUREMENT
/begin MEASUREMENT B_mnlsh2 "Fehlertyp 'Minimalwert' hinter KAT erkannt  Bank2" UWORD B_TRUE 1 100 0 1 BIT_MASK 0x200 FORMAT "%13.11" ECU_ADDRESS 0x3FE4E4 /end MEASUREMENT
/begin MEASUREMENT B_mnlsuia "Fehlertyp 'Minimalwert'  an Sondenleitung IA erkannt" UWORD B_TRUE 1 100 0 1 BIT_MASK 0x200 FORMAT "%13.11" ECU_ADDRESS 0x3FE4E6 /end MEASUREMENT
/begin MEASUREMENT B_mnlsuia2 "Fehlertyp 'Minimalwert'  an Sondenleitung IA erkannt, Bank 2" UWORD B_TRUE 1 100 0 1 BIT_MASK 0x200 FORMAT "%13.11" ECU_ADDRESS 0x3FE4E8 /end MEASUREMENT
/begin MEASUREMENT B_mnlsuip "Fehlertyp 'Minimalwert'  an Sondenleitung IP erkannt" UWORD B_TRUE 1 100 0 1 BIT_MASK 0x200 FORMAT "%13.11" ECU_ADDRESS 0x3FE4EA /end MEASUREMENT
/begin MEASUREMENT B_mnlsuip2 "Fehlertyp 'Minimalwert'  an Sondenleitung IP erkannt, B2" UWORD B_TRUE 1 100 0 1 BIT_MASK 0x200 FORMAT "%13.11" ECU_ADDRESS 0x3FE4EC /end MEASUREMENT
/begin MEASUREMENT B_mnlsuks "Fehlertyp 'Minimalwert'  des Fehlers E_lsuks" UWORD B_TRUE 1 100 0 1 BIT_MASK 0x200 FORMAT "%13.11" ECU_ADDRESS 0x3FE4EE /end MEASUREMENT
/begin MEASUREMENT B_mnlsuks2 "Fehlertyp 'Minimalwert'  des Fehlers E_lsuks2" UWORD B_TRUE 1 100 0 1 BIT_MASK 0x200 FORMAT "%13.11" ECU_ADDRESS 0x3FE4F0 /end MEASUREMENT
/begin MEASUREMENT B_mnlsuun "Fehlertyp 'Minimalwert'  an Sondenleitung UN erkannt" UWORD B_TRUE 1 100 0 1 BIT_MASK 0x200 FORMAT "%13.11" ECU_ADDRESS 0x3FE4F2 /end MEASUREMENT
/begin MEASUREMENT B_mnlsuun2 "Fehlertyp 'Minimalwert'  an Sondenleitung UN erkannt, Bank 2" UWORD B_TRUE 1 100 0 1 BIT_MASK 0x200 FORMAT "%13.11" ECU_ADDRESS 0x3FE4F4 /end MEASUREMENT
/begin MEASUREMENT B_mnlsuvm "Fehlertyp 'Minimalwert'  an Sondenleitung VM erkannt" UWORD B_TRUE 1 100 0 1 BIT_MASK 0x200 FORMAT "%13.11" ECU_ADDRESS 0x3FE4F6 /end MEASUREMENT
/begin MEASUREMENT B_mnlsuvm2 "Fehlertyp 'Minimalwert'  an Sondenleitung VM erkannt, Bank 2" UWORD B_TRUE 1 100 0 1 BIT_MASK 0x200 FORMAT "%13.11" ECU_ADDRESS 0x3FE4F8 /end MEASUREMENT
/begin MEASUREMENT B_mnmd "Fehlertyp min.: Aussetzer, Summenfehler (multiple)" UWORD B_TRUE 1 100 0 1 BIT_MASK 0x200 FORMAT "%13.11" ECU_ADDRESS 0x3FE500 /end MEASUREMENT
/begin MEASUREMENT B_mnmd00 "Fehlertyp min.: Aussetzer Z¸ndung 0" UWORD B_TRUE 1 100 0 1 BIT_MASK 0x200 FORMAT "%13.11" ECU_ADDRESS 0x3FE502 /end MEASUREMENT
/begin MEASUREMENT B_mnmd01 "Fehlertyp min.: Aussetzer Z¸ndung 1" UWORD B_TRUE 1 100 0 1 BIT_MASK 0x200 FORMAT "%13.11" ECU_ADDRESS 0x3FE504 /end MEASUREMENT
/begin MEASUREMENT B_mnmd02 "Fehlertyp min.: Aussetzer Z¸ndung 2" UWORD B_TRUE 1 100 0 1 BIT_MASK 0x200 FORMAT "%13.11" ECU_ADDRESS 0x3FE506 /end MEASUREMENT
/begin MEASUREMENT B_mnmd03 "Fehlertyp min.: Aussetzer Z¸ndung 3" UWORD B_TRUE 1 100 0 1 BIT_MASK 0x200 FORMAT "%13.11" ECU_ADDRESS 0x3FE508 /end MEASUREMENT
/begin MEASUREMENT B_mnmd04 "Fehlertyp min.: Aussetzer Z¸ndung 4" UWORD B_TRUE 1 100 0 1 BIT_MASK 0x200 FORMAT "%13.11" ECU_ADDRESS 0x3FE50A /end MEASUREMENT
/begin MEASUREMENT B_mnmd05 "Fehlertyp min.: Aussetzer Z¸ndung 5" UWORD B_TRUE 1 100 0 1 BIT_MASK 0x200 FORMAT "%13.11" ECU_ADDRESS 0x3FE50C /end MEASUREMENT
/begin MEASUREMENT B_mnmd06 "Fehlertyp min.: Aussetzer Z¸ndung 6" UWORD B_TRUE 1 100 0 1 BIT_MASK 0x200 FORMAT "%13.11" ECU_ADDRESS 0x3FE50E /end MEASUREMENT
/begin MEASUREMENT B_mnmd07 "Fehlertyp min.: Aussetzer Z¸ndung 7" UWORD B_TRUE 1 100 0 1 BIT_MASK 0x200 FORMAT "%13.11" ECU_ADDRESS 0x3FE510 /end MEASUREMENT
/begin MEASUREMENT B_mnmd08 "Fehlertyp min.: Aussetzer Z¸ndung 8" UWORD B_TRUE 1 100 0 1 BIT_MASK 0x200 FORMAT "%13.11" ECU_ADDRESS 0x3FE512 /end MEASUREMENT
/begin MEASUREMENT B_mnmd09 "Fehlertyp min.: Aussetzer Z¸ndung 9" UWORD B_TRUE 1 100 0 1 BIT_MASK 0x200 FORMAT "%13.11" ECU_ADDRESS 0x3FE514 /end MEASUREMENT
/begin MEASUREMENT B_mnmd10 "Fehlertyp min.: Aussetzer Z¸ndung 10" UWORD B_TRUE 1 100 0 1 BIT_MASK 0x200 FORMAT "%13.11" ECU_ADDRESS 0x3FE516 /end MEASUREMENT
/begin MEASUREMENT B_mnmd11 "Fehlertyp min.: Aussetzer Z¸ndung 11" UWORD B_TRUE 1 100 0 1 BIT_MASK 0x200 FORMAT "%13.11" ECU_ADDRESS 0x3FE518 /end MEASUREMENT
/begin MEASUREMENT B_mnmle "Fehlertype: Kurzschluﬂ nach Masse Endstufe Motor L¸fter" UWORD B_TRUE 1 100 0 1 BIT_MASK 0x200 FORMAT "%13.11" ECU_ADDRESS 0x3FE520 /end MEASUREMENT
/begin MEASUREMENT B_mnnvrbup "Fehlerart: NVRAM-Backup Schreib-Fehler erkannt" UWORD B_TRUE 1 100 0 1 BIT_MASK 0x200 FORMAT "%13.11" ECU_ADDRESS 0x3FE526 /end MEASUREMENT
/begin MEASUREMENT B_mnrkat "Bedingung untere Plausibilit‰tsschwelle unterschritten (add. pro Zeit)" UWORD B_TRUE 1 100 0 1 BIT_MASK 0x200 FORMAT "%13.11" ECU_ADDRESS 0x3FE544 /end MEASUREMENT
/begin MEASUREMENT B_mnrkat2 "Bedingung untere Plausibilit‰tsschwelle unterschritten (Stereo)" UWORD B_TRUE 1 100 0 1 BIT_MASK 0x200 FORMAT "%13.11" ECU_ADDRESS 0x3FE546 /end MEASUREMENT
/begin MEASUREMENT B_mnrkaz "Bedingung untere Plausibilit‰tsschwelle unterschritten (add. pro Z¸ndung)" UWORD B_TRUE 1 100 0 1 BIT_MASK 0x200 FORMAT "%13.11" ECU_ADDRESS 0x3FE548 /end MEASUREMENT
/begin MEASUREMENT B_mnrkaz2 "Bedingung untere Plausibilit‰tsschwelle unterschritten (Stereo)" UWORD B_TRUE 1 100 0 1 BIT_MASK 0x200 FORMAT "%13.11" ECU_ADDRESS 0x3FE54A /end MEASUREMENT
/begin MEASUREMENT B_mxanws "Bed. Nockenwellenverstellung hat Sp‰tposition nicht erreicht (Auslaﬂ,Bank1)" UWORD B_TRUE 1 100 0 1 BIT_MASK 0x100 FORMAT "%13.11" ECU_ADDRESS 0x3FE3B4 /end MEASUREMENT
/begin MEASUREMENT B_mxanws2 "Bed. Nockenwellenverstellung hat Sp‰tposition nicht erreicht (Auslaﬂ,Bank2)" UWORD B_TRUE 1 100 0 1 BIT_MASK 0x100 FORMAT "%13.11" ECU_ADDRESS 0x3FE3B6 /end MEASUREMENT
/begin MEASUREMENT B_mxcvvt "Fehlertyp max.: CAN-Schnittstelle, Timeout VVT-Botschaft" UWORD B_TRUE 1 100 0 1 BIT_MASK 0x100 FORMAT "%13.11" ECU_ADDRESS 0x3FE3E0 /end MEASUREMENT
/begin MEASUREMENT B_mxets "Fehlertype: Kurzschluﬂ nach Ubatt Endstufe Elektr. Thermostat" UWORD B_TRUE 1 100 0 1 BIT_MASK 0x100 FORMAT "%13.11" ECU_ADDRESS 0x3FE474 /end MEASUREMENT
/begin MEASUREMENT B_mxfrao "Bedingung obere Plausibilit‰tsschwelle ¸berschritten (obere Multipl.)" UWORD B_TRUE 1 100 0 1 BIT_MASK 0x100 FORMAT "%13.11" ECU_ADDRESS 0x3FE48C /end MEASUREMENT
/begin MEASUREMENT B_mxfrao2 "Bedingung obere Plausibilit‰tsschwelle ¸berschritten (Stereo)" UWORD B_TRUE 1 100 0 1 BIT_MASK 0x100 FORMAT "%13.11" ECU_ADDRESS 0x3FE48E /end MEASUREMENT
/begin MEASUREMENT B_mxfrau "Bedingung obere Plausiblit‰tsschwelle ¸berschritten (untere Multipl.)" UWORD B_TRUE 1 100 0 1 BIT_MASK 0x100 FORMAT "%13.11" ECU_ADDRESS 0x3FE490 /end MEASUREMENT
/begin MEASUREMENT B_mxfrau2 "Bedingung obere Plausibilit‰tsschwelle ¸berschritten (mult. 2. Bank)" UWORD B_TRUE 1 100 0 1 BIT_MASK 0x100 FORMAT "%13.11" ECU_ADDRESS 0x3FE492 /end MEASUREMENT
/begin MEASUREMENT B_mxfrst "Bedingung obere Plausiblit‰tsschwelle ¸berschritten (short test" UWORD B_TRUE 1 100 0 1 BIT_MASK 0x100 FORMAT "%13.11" ECU_ADDRESS 0x3FE494 /end MEASUREMENT
/begin MEASUREMENT B_mxfrst2 "Bedingung obere Plausiblit‰tsschwelle ¸berschritten (short test Stereo" UWORD B_TRUE 1 100 0 1 BIT_MASK 0x100 FORMAT "%13.11" ECU_ADDRESS 0x3FE496 /end MEASUREMENT
/begin MEASUREMENT B_mxiclsu "Bedingung MAX-Fehler Auswerte-IC f¸r die LSU" UWORD B_TRUE 1 100 0 1 BIT_MASK 0x100 FORMAT "%13.11" ECU_ADDRESS 0x3FE4B4 /end MEASUREMENT
/begin MEASUREMENT B_mxiclsu2 "Bedingung MAX-Fehler Auswerte-IC f¸r die LSU, Bank 2" UWORD B_TRUE 1 100 0 1 BIT_MASK 0x100 FORMAT "%13.11" ECU_ADDRESS 0x3FE4B6 /end MEASUREMENT
/begin MEASUREMENT B_mxkat "Bedingung obere Plausibilit‰tsschwelle ¸berschritten" UWORD B_TRUE 1 100 0 1 BIT_MASK 0x100 FORMAT "%13.11" ECU_ADDRESS 0x3FE4B8 /end MEASUREMENT
/begin MEASUREMENT B_mxkat2 "Bedingung obere Plausibilit‰tsschwelle ¸berschritten (Stereo)" UWORD B_TRUE 1 100 0 1 BIT_MASK 0x100 FORMAT "%13.11" ECU_ADDRESS 0x3FE4BA /end MEASUREMENT
/begin MEASUREMENT B_mxkose "Fehlertype: Kurzschluﬂ nach Ubatt Endstufe Klimakompressor" UWORD B_TRUE 1 100 0 1 BIT_MASK 0x100 FORMAT "%13.11" ECU_ADDRESS 0x3FE4BC /end MEASUREMENT
/begin MEASUREMENT B_mxkrnt "Fehlertyp max.: Klopfregelung Nulltest" UWORD B_TRUE 1 100 0 1 BIT_MASK 0x100 FORMAT "%13.11" ECU_ADDRESS 0x3FE4C0 /end MEASUREMENT
/begin MEASUREMENT B_mxkrnt2 "Fehlertyp max.: Klopfregelung Nulltest (zweiter CC195)" UWORD B_TRUE 1 100 0 1 BIT_MASK 0x100 FORMAT "%13.11" ECU_ADDRESS 0x3FE4C2 /end MEASUREMENT
/begin MEASUREMENT B_mxkrof "Fehlertyp max.: Klopfregelung Offset" UWORD B_TRUE 1 100 0 1 BIT_MASK 0x100 FORMAT "%13.11" ECU_ADDRESS 0x3FE4C4 /end MEASUREMENT
/begin MEASUREMENT B_mxkrof2 "Fehlertyp max.: Klopfregelung Offset (zweiter CC195)" UWORD B_TRUE 1 100 0 1 BIT_MASK 0x100 FORMAT "%13.11" ECU_ADDRESS 0x3FE4C6 /end MEASUREMENT
/begin MEASUREMENT B_mxkrtp "Fehlertyp max.: Klopfregelung Testimpuls" UWORD B_TRUE 1 100 0 1 BIT_MASK 0x100 FORMAT "%13.11" ECU_ADDRESS 0x3FE4C8 /end MEASUREMENT
/begin MEASUREMENT B_mxkrtp2 "Fehlertyp max.: Klopfregelung Testimpuls (zweiter CC195)" UWORD B_TRUE 1 100 0 1 BIT_MASK 0x100 FORMAT "%13.11" ECU_ADDRESS 0x3FE4CA /end MEASUREMENT
/begin MEASUREMENT B_mxks1 "Bedingung: Max-Fehler Klopfsensor 1" UWORD B_TRUE 1 100 0 1 BIT_MASK 0x100 FORMAT "%13.11" ECU_ADDRESS 0x3FE4CC /end MEASUREMENT
/begin MEASUREMENT B_mxks2 "Bedingung: Max-Fehler Klopfsensor 2" UWORD B_TRUE 1 100 0 1 BIT_MASK 0x100 FORMAT "%13.11" ECU_ADDRESS 0x3FE4CE /end MEASUREMENT
/begin MEASUREMENT B_mxks3 "Bedingung: Max-Fehler Klopfsensor 3" UWORD B_TRUE 1 100 0 1 BIT_MASK 0x100 FORMAT "%13.11" ECU_ADDRESS 0x3FE4D0 /end MEASUREMENT
/begin MEASUREMENT B_mxks4 "Bedingung: Max-Fehler Klopfsensor 4" UWORD B_TRUE 1 100 0 1 BIT_MASK 0x100 FORMAT "%13.11" ECU_ADDRESS 0x3FE4D2 /end MEASUREMENT
/begin MEASUREMENT B_mxkuppl "Fehlertyp KUPPL: Maximalwert ¸berschritten" UWORD B_TRUE 1 100 0 1 BIT_MASK 0x100 FORMAT "%13.11" ECU_ADDRESS 0x3FE4D4 /end MEASUREMENT
/begin MEASUREMENT B_mxlash "Fehlertyp 'Maximalwert' f¸r Schwingungs-Pr¸fung hinter KAT erkannt" UWORD B_TRUE 1 100 0 1 BIT_MASK 0x100 FORMAT "%13.11" ECU_ADDRESS 0x3FE4D6 /end MEASUREMENT
/begin MEASUREMENT B_mxlash2 "Fehlertyp 'Maximalwert' f¸r Schwingungs-Pr¸fung hinter KAT erkannt Bank2" UWORD B_TRUE 1 100 0 1 BIT_MASK 0x100 FORMAT "%13.11" ECU_ADDRESS 0x3FE4D8 /end MEASUREMENT
/begin MEASUREMENT B_mxlavh "Fehlertyp 'Maximalwert' f¸r Vollast-Pr¸fung hinter KAT erkannt" UWORD B_TRUE 1 100 0 1 BIT_MASK 0x100 FORMAT "%13.11" ECU_ADDRESS 0x3FE4DA /end MEASUREMENT
/begin MEASUREMENT B_mxlavh2 "Fehlertyp 'Maximalwert' f¸r Vollast-Pr¸fung hinter KAT erkannt Bank2" UWORD B_TRUE 1 100 0 1 BIT_MASK 0x100 FORMAT "%13.11" ECU_ADDRESS 0x3FE4DC /end MEASUREMENT
/begin MEASUREMENT B_mxllr "Fehler 'Leerlaufdrehzahl zu groﬂ'" UWORD B_TRUE 1 100 0 1 BIT_MASK 0x100 FORMAT "%13.11" ECU_ADDRESS 0x3FE4DE /end MEASUREMENT
/begin MEASUREMENT B_mxlsh "Fehlertyp 'Maximalwert' hinter KAT erkannt" UWORD B_TRUE 1 100 0 1 BIT_MASK 0x100 FORMAT "%13.11" ECU_ADDRESS 0x3FE4E2 /end MEASUREMENT
/begin MEASUREMENT B_mxlsh2 "Fehlertyp 'Maximalwert' hinter KAT erkannt Bank2" UWORD B_TRUE 1 100 0 1 BIT_MASK 0x100 FORMAT "%13.11" ECU_ADDRESS 0x3FE4E4 /end MEASUREMENT
/begin MEASUREMENT B_mxlsuia "Fehlertyp 'Maximalwert'  an Sondenleitung IA erkannt" UWORD B_TRUE 1 100 0 1 BIT_MASK 0x100 FORMAT "%13.11" ECU_ADDRESS 0x3FE4E6 /end MEASUREMENT
/begin MEASUREMENT B_mxlsuia2 "Fehlertyp 'Maximalwert'  an Sondenleitung IA erkannt, Bank 2" UWORD B_TRUE 1 100 0 1 BIT_MASK 0x100 FORMAT "%13.11" ECU_ADDRESS 0x3FE4E8 /end MEASUREMENT
/begin MEASUREMENT B_mxlsuip "Fehlertyp 'Maximalwert'  an Sondenleitung IP erkannt" UWORD B_TRUE 1 100 0 1 BIT_MASK 0x100 FORMAT "%13.11" ECU_ADDRESS 0x3FE4EA /end MEASUREMENT
/begin MEASUREMENT B_mxlsuip2 "Fehlertyp 'Maximalwert'  an Sondenleitung IP erkannt" UWORD B_TRUE 1 100 0 1 BIT_MASK 0x100 FORMAT "%13.11" ECU_ADDRESS 0x3FE4EC /end MEASUREMENT
/begin MEASUREMENT B_mxlsuks "Fehlertyp 'Maximalwert'  des Fehlers E_lsuks" UWORD B_TRUE 1 100 0 1 BIT_MASK 0x100 FORMAT "%13.11" ECU_ADDRESS 0x3FE4EE /end MEASUREMENT
/begin MEASUREMENT B_mxlsuks2 "Fehlertyp 'Maximalwert'  des Fehlers E_lsuks2" UWORD B_TRUE 1 100 0 1 BIT_MASK 0x100 FORMAT "%13.11" ECU_ADDRESS 0x3FE4F0 /end MEASUREMENT
/begin MEASUREMENT B_mxlsuun "Fehlertyp 'Maximalwert'  an Sondenleitung UN erkannt" UWORD B_TRUE 1 100 0 1 BIT_MASK 0x100 FORMAT "%13.11" ECU_ADDRESS 0x3FE4F2 /end MEASUREMENT
/begin MEASUREMENT B_mxlsuun2 "Fehlertyp 'Maximalwert'  an Sondenleitung UN erkannt, Bank 2" UWORD B_TRUE 1 100 0 1 BIT_MASK 0x100 FORMAT "%13.11" ECU_ADDRESS 0x3FE4F4 /end MEASUREMENT
/begin MEASUREMENT B_mxlsuvm "Fehlertyp 'Maximalwert'  an Sondenleitung VM erkannt" UWORD B_TRUE 1 100 0 1 BIT_MASK 0x100 FORMAT "%13.11" ECU_ADDRESS 0x3FE4F6 /end MEASUREMENT
/begin MEASUREMENT B_mxlsuvm2 "Fehlertyp 'Maximalwert'  an Sondenleitung VM erkannt, Bank 2" UWORD B_TRUE 1 100 0 1 BIT_MASK 0x100 FORMAT "%13.11" ECU_ADDRESS 0x3FE4F8 /end MEASUREMENT
/begin MEASUREMENT B_mxmd "Fehlertyp max.: Aussetzer, Summenfehler (multiple)" UWORD B_TRUE 1 100 0 1 BIT_MASK 0x100 FORMAT "%13.11" ECU_ADDRESS 0x3FE500 /end MEASUREMENT
/begin MEASUREMENT B_mxmd00 "Fehlertyp max.: Aussetzer Z¸ndung 0" UWORD B_TRUE 1 100 0 1 BIT_MASK 0x100 FORMAT "%13.11" ECU_ADDRESS 0x3FE502 /end MEASUREMENT
/begin MEASUREMENT B_mxmd01 "Fehlertyp max.: Aussetzer Z¸ndung 1" UWORD B_TRUE 1 100 0 1 BIT_MASK 0x100 FORMAT "%13.11" ECU_ADDRESS 0x3FE504 /end MEASUREMENT
/begin MEASUREMENT B_mxmd02 "Fehlertyp max.: Aussetzer Z¸ndung 2" UWORD B_TRUE 1 100 0 1 BIT_MASK 0x100 FORMAT "%13.11" ECU_ADDRESS 0x3FE506 /end MEASUREMENT
/begin MEASUREMENT B_mxmd03 "Fehlertyp max.: Aussetzer Z¸ndung 3" UWORD B_TRUE 1 100 0 1 BIT_MASK 0x100 FORMAT "%13.11" ECU_ADDRESS 0x3FE508 /end MEASUREMENT
/begin MEASUREMENT B_mxmd04 "Fehlertyp max.: Aussetzer Z¸ndung 4" UWORD B_TRUE 1 100 0 1 BIT_MASK 0x100 FORMAT "%13.11" ECU_ADDRESS 0x3FE50A /end MEASUREMENT
/begin MEASUREMENT B_mxmd05 "Fehlertyp max.: Aussetzer Z¸ndung 5" UWORD B_TRUE 1 100 0 1 BIT_MASK 0x100 FORMAT "%13.11" ECU_ADDRESS 0x3FE50C /end MEASUREMENT
/begin MEASUREMENT B_mxmd06 "Fehlertyp max.: Aussetzer Z¸ndung 6" UWORD B_TRUE 1 100 0 1 BIT_MASK 0x100 FORMAT "%13.11" ECU_ADDRESS 0x3FE50E /end MEASUREMENT
/begin MEASUREMENT B_mxmd07 "Fehlertyp max.: Aussetzer Z¸ndung 7" UWORD B_TRUE 1 100 0 1 BIT_MASK 0x100 FORMAT "%13.11" ECU_ADDRESS 0x3FE510 /end MEASUREMENT
/begin MEASUREMENT B_mxmd08 "Fehlertyp max.: Aussetzer Z¸ndung 8" UWORD B_TRUE 1 100 0 1 BIT_MASK 0x100 FORMAT "%13.11" ECU_ADDRESS 0x3FE512 /end MEASUREMENT
/begin MEASUREMENT B_mxmd09 "Fehlertyp max.: Aussetzer Z¸ndung 9" UWORD B_TRUE 1 100 0 1 BIT_MASK 0x100 FORMAT "%13.11" ECU_ADDRESS 0x3FE514 /end MEASUREMENT
/begin MEASUREMENT B_mxmd10 "Fehlertyp max.: Aussetzer Z¸ndung 10" UWORD B_TRUE 1 100 0 1 BIT_MASK 0x100 FORMAT "%13.11" ECU_ADDRESS 0x3FE516 /end MEASUREMENT
/begin MEASUREMENT B_mxmd11 "Fehlertyp max.: Aussetzer Z¸ndung 11" UWORD B_TRUE 1 100 0 1 BIT_MASK 0x100 FORMAT "%13.11" ECU_ADDRESS 0x3FE518 /end MEASUREMENT
/begin MEASUREMENT B_mxmle "Fehlertype: Kurzschluﬂ nach Ubatt Endstufe Motor L¸fter" UWORD B_TRUE 1 100 0 1 BIT_MASK 0x100 FORMAT "%13.11" ECU_ADDRESS 0x3FE520 /end MEASUREMENT
/begin MEASUREMENT B_mxnvrbup "Fehlerart: NVRAM-Backup Lese-Fehler erkannt" UWORD B_TRUE 1 100 0 1 BIT_MASK 0x100 FORMAT "%13.11" ECU_ADDRESS 0x3FE526 /end MEASUREMENT
/begin MEASUREMENT B_mxrkat "Bedingung obere Plausibilit‰tsschwelle ¸berschritten (add. pro Zeit)" UWORD B_TRUE 1 100 0 1 BIT_MASK 0x100 FORMAT "%13.11" ECU_ADDRESS 0x3FE544 /end MEASUREMENT
/begin MEASUREMENT B_mxrkat2 "Bedingung obere Plausibilit‰tsschwelle ¸berschritten (Stereo)" UWORD B_TRUE 1 100 0 1 BIT_MASK 0x100 FORMAT "%13.11" ECU_ADDRESS 0x3FE546 /end MEASUREMENT
/begin MEASUREMENT B_mxrkaz "Bedingung obere Plausibilit‰tsschwelle ¸berschritten (add. pro Z¸ndung)" UWORD B_TRUE 1 100 0 1 BIT_MASK 0x100 FORMAT "%13.11" ECU_ADDRESS 0x3FE548 /end MEASUREMENT
/begin MEASUREMENT B_mxrkaz2 "Bedingung obere Plausibilit‰tsschwelle ¸berschritten (Stereo)" UWORD B_TRUE 1 100 0 1 BIT_MASK 0x100 FORMAT "%13.11" ECU_ADDRESS 0x3FE54A /end MEASUREMENT
/begin MEASUREMENT B_npanws "Bed. Nockenwellenverstellung hat unplausible Position (Auslaﬂ,Bank1)" UWORD B_TRUE 1 100 0 1 BIT_MASK 0x800 FORMAT "%13.11" ECU_ADDRESS 0x3FE3B4 /end MEASUREMENT
/begin MEASUREMENT B_npanws2 "Bed. Nockenwellenverstellung hat unplausible Position (Auslaﬂ,Bank2)" UWORD B_TRUE 1 100 0 1 BIT_MASK 0x800 FORMAT "%13.11" ECU_ADDRESS 0x3FE3B6 /end MEASUREMENT
/begin MEASUREMENT B_npcvvt "Fehlerart:CAN-Schnittstelle, Timeout VVT-Botschaft" UWORD B_TRUE 1 100 0 1 BIT_MASK 0x800 FORMAT "%13.11" ECU_ADDRESS 0x3FE3E0 /end MEASUREMENT
/begin MEASUREMENT B_npets "Bedingung f¸r Fehlertyp 'Wert unplausibel' f¸r el. Thermostat-Endstufe erkannt" UWORD B_TRUE 1 100 0 1 BIT_MASK 0x800 FORMAT "%13.11" ECU_ADDRESS 0x3FE474 /end MEASUREMENT
/begin MEASUREMENT B_npfrao "Bedingung FRAO ist unplausibel" UWORD B_TRUE 1 100 0 1 BIT_MASK 0x800 FORMAT "%13.11" ECU_ADDRESS 0x3FE48C /end MEASUREMENT
/begin MEASUREMENT B_npfrao2 "Bedingung FRAO ist unplausibel Bank 2" UWORD B_TRUE 1 100 0 1 BIT_MASK 0x800 FORMAT "%13.11" ECU_ADDRESS 0x3FE48E /end MEASUREMENT
/begin MEASUREMENT B_npfrau "Bedingung FRAU ist unplausibel" UWORD B_TRUE 1 100 0 1 BIT_MASK 0x800 FORMAT "%13.11" ECU_ADDRESS 0x3FE490 /end MEASUREMENT
/begin MEASUREMENT B_npfrau2 "Bedingung FRAU ist unplausibel Bank 2" UWORD B_TRUE 1 100 0 1 BIT_MASK 0x800 FORMAT "%13.11" ECU_ADDRESS 0x3FE492 /end MEASUREMENT
/begin MEASUREMENT B_npfrst "Fehlertyp 'unplausibles Pr¸fresultat' erkannt (DKVS Kurztest)" UWORD B_TRUE 1 100 0 1 BIT_MASK 0x800 FORMAT "%13.11" ECU_ADDRESS 0x3FE494 /end MEASUREMENT
/begin MEASUREMENT B_npfrst2 "Fehlertyp 'unplausibles Pr¸fresultat' erkannt (DKVS Kurztest Bank 2)" UWORD B_TRUE 1 100 0 1 BIT_MASK 0x800 FORMAT "%13.11" ECU_ADDRESS 0x3FE496 /end MEASUREMENT
/begin MEASUREMENT B_npiclsu "Bedingung Plausibilit‰tsfehler Auswerte-IC f¸r LSU" UWORD B_TRUE 1 100 0 1 BIT_MASK 0x800 FORMAT "%13.11" ECU_ADDRESS 0x3FE4B4 /end MEASUREMENT
/begin MEASUREMENT B_npiclsu2 "Bedingung Plausibilit‰tsfehler Auswerte-IC f¸r LSU, Bank 2" UWORD B_TRUE 1 100 0 1 BIT_MASK 0x800 FORMAT "%13.11" ECU_ADDRESS 0x3FE4B6 /end MEASUREMENT
/begin MEASUREMENT B_npkat "Fehlertyp 'unplausibles Pr¸fresultat' erkannt (Katalysator)" UWORD B_TRUE 1 100 0 1 BIT_MASK 0x800 FORMAT "%13.11" ECU_ADDRESS 0x3FE4B8 /end MEASUREMENT
/begin MEASUREMENT B_npkat2 "Fehlertyp 'unplausibles Pr¸fresultat' erkannt (Katalysator)2" UWORD B_TRUE 1 100 0 1 BIT_MASK 0x800 FORMAT "%13.11" ECU_ADDRESS 0x3FE4BA /end MEASUREMENT
/begin MEASUREMENT B_npkose "Bedingung f¸r Fehlertyp 'Wert unplausibel' f¸r Klimakompressor-Endstufe erkannt" UWORD B_TRUE 1 100 0 1 BIT_MASK 0x800 FORMAT "%13.11" ECU_ADDRESS 0x3FE4BC /end MEASUREMENT
/begin MEASUREMENT B_npkrnt "Bedingung Plausibilit‰tsfehler der KR-Diagnose Integratorsteigung" UWORD B_TRUE 1 100 0 1 BIT_MASK 0x800 FORMAT "%13.11" ECU_ADDRESS 0x3FE4C0 /end MEASUREMENT
/begin MEASUREMENT B_npkrnt2 "Bedingung Plausibilit‰tsfehler der KR-Diagnose Integratorsteigung, Bank 2" UWORD B_TRUE 1 100 0 1 BIT_MASK 0x800 FORMAT "%13.11" ECU_ADDRESS 0x3FE4C2 /end MEASUREMENT
/begin MEASUREMENT B_npkrof "Bedingung Plausibilit‰tsfehler der KR-Diagnose Resetwert" UWORD B_TRUE 1 100 0 1 BIT_MASK 0x800 FORMAT "%13.11" ECU_ADDRESS 0x3FE4C4 /end MEASUREMENT
/begin MEASUREMENT B_npkrof2 "Bedingung Plausibilit‰tsfehler der KR-Diagnose Resetwert, Bank 2" UWORD B_TRUE 1 100 0 1 BIT_MASK 0x800 FORMAT "%13.11" ECU_ADDRESS 0x3FE4C6 /end MEASUREMENT
/begin MEASUREMENT B_npkrtp "Bedingung Plausibilit‰tsfehler der KR-Diagnose Testimpuls" UWORD B_TRUE 1 100 0 1 BIT_MASK 0x800 FORMAT "%13.11" ECU_ADDRESS 0x3FE4C8 /end MEASUREMENT
/begin MEASUREMENT B_npkrtp2 "Bedingung Plausibilit‰tsfehler der KR-Diagnose Testimpuls, Bank 2" UWORD B_TRUE 1 100 0 1 BIT_MASK 0x800 FORMAT "%13.11" ECU_ADDRESS 0x3FE4CA /end MEASUREMENT
/begin MEASUREMENT B_npks1 "Nicht plausibler Fehler: Klopfsensor 1" UWORD B_TRUE 1 100 0 1 BIT_MASK 0x800 FORMAT "%13.11" ECU_ADDRESS 0x3FE4CC /end MEASUREMENT
/begin MEASUREMENT B_npks2 "Nicht plausibler Fehler: Klopfsensor 2" UWORD B_TRUE 1 100 0 1 BIT_MASK 0x800 FORMAT "%13.11" ECU_ADDRESS 0x3FE4CE /end MEASUREMENT
/begin MEASUREMENT B_npks3 "Nicht plausibler Fehler: Klopfsensor 3" UWORD B_TRUE 1 100 0 1 BIT_MASK 0x800 FORMAT "%13.11" ECU_ADDRESS 0x3FE4D0 /end MEASUREMENT
/begin MEASUREMENT B_npks4 "Nicht plausibler Fehler: Klopfsensor 4" UWORD B_TRUE 1 100 0 1 BIT_MASK 0x800 FORMAT "%13.11" ECU_ADDRESS 0x3FE4D2 /end MEASUREMENT
/begin MEASUREMENT B_npkuppl "Fehlertyp KUPPL: Pr¸fresultat nicht plausibel" UWORD B_TRUE 1 100 0 1 BIT_MASK 0x800 FORMAT "%13.11" ECU_ADDRESS 0x3FE4D4 /end MEASUREMENT
/begin MEASUREMENT B_nplash "Fehlertyp 'Wert unplausibel' f¸r Schwingungs-Pr¸fung hinter KAT erkannt" UWORD B_TRUE 1 100 0 1 BIT_MASK 0x800 FORMAT "%13.11" ECU_ADDRESS 0x3FE4D6 /end MEASUREMENT
/begin MEASUREMENT B_nplash2 "Fehlertyp 'Wert unplausibel' f¸r Schwingungs-Pr¸fung hinter KAT erkannt Bank2" UWORD B_TRUE 1 100 0 1 BIT_MASK 0x800 FORMAT "%13.11" ECU_ADDRESS 0x3FE4D8 /end MEASUREMENT
/begin MEASUREMENT B_nplavh "Fehlertyp 'Wert unplausibel' f¸r Vollast-Pr¸fung hinter KAT erkannt" UWORD B_TRUE 1 100 0 1 BIT_MASK 0x800 FORMAT "%13.11" ECU_ADDRESS 0x3FE4DA /end MEASUREMENT
/begin MEASUREMENT B_nplavh2 "Fehlertyp 'Wert unplausibel' f¸r Vollast-Pr¸fung hinter KAT erkannt Bank2" UWORD B_TRUE 1 100 0 1 BIT_MASK 0x800 FORMAT "%13.11" ECU_ADDRESS 0x3FE4DC /end MEASUREMENT
/begin MEASUREMENT B_npllr "Nicht plausibler Fehler: Leerlaufregelung" UWORD B_TRUE 1 100 0 1 BIT_MASK 0x800 FORMAT "%13.11" ECU_ADDRESS 0x3FE4DE /end MEASUREMENT
/begin MEASUREMENT B_nplsh "Fehlertyp 'Wert unplausibel' hinter KAT erkannt" UWORD B_TRUE 1 100 0 1 BIT_MASK 0x800 FORMAT "%13.11" ECU_ADDRESS 0x3FE4E2 /end MEASUREMENT
/begin MEASUREMENT B_nplsh2 "Fehlertyp 'Wert unplausibel' hinter KAT erkannt Bank2" UWORD B_TRUE 1 100 0 1 BIT_MASK 0x800 FORMAT "%13.11" ECU_ADDRESS 0x3FE4E4 /end MEASUREMENT
/begin MEASUREMENT B_nplsuia "Fehlertyp 'Plausibilit‰tsfehler'  an Sondenleitung IA aufgetreten" UWORD B_TRUE 1 100 0 1 BIT_MASK 0x800 FORMAT "%13.11" ECU_ADDRESS 0x3FE4E6 /end MEASUREMENT
/begin MEASUREMENT B_nplsuia2 "Fehlertyp 'Plausibilit‰tsfehler'  an Sondenleitung IA aufgetreten, Bank 2" UWORD B_TRUE 1 100 0 1 BIT_MASK 0x800 FORMAT "%13.11" ECU_ADDRESS 0x3FE4E8 /end MEASUREMENT
/begin MEASUREMENT B_nplsuip "Fehlertyp 'Plausibilit‰tsfehler'  an Sondenleitung IP aufgetreten" UWORD B_TRUE 1 100 0 1 BIT_MASK 0x800 FORMAT "%13.11" ECU_ADDRESS 0x3FE4EA /end MEASUREMENT
/begin MEASUREMENT B_nplsuip2 "Fehlertyp 'Plausibilit‰tsfehler'  an Sondenleitung IP aufgetreten, B2" UWORD B_TRUE 1 100 0 1 BIT_MASK 0x800 FORMAT "%13.11" ECU_ADDRESS 0x3FE4EC /end MEASUREMENT
/begin MEASUREMENT B_nplsuks "Fehlertyp 'Plausibilit‰t'  des Fehlers E_lsuks" UWORD B_TRUE 1 100 0 1 BIT_MASK 0x800 FORMAT "%13.11" ECU_ADDRESS 0x3FE4EE /end MEASUREMENT
/begin MEASUREMENT B_nplsuks2 "Fehlertyp 'Plausibilit‰t'  des Fehlers E_lsuks, B2" UWORD B_TRUE 1 100 0 1 BIT_MASK 0x800 FORMAT "%13.11" ECU_ADDRESS 0x3FE4F0 /end MEASUREMENT
/begin MEASUREMENT B_nplsuun "Fehlertyp 'Plausibilit‰tsfehler'  an Sondenleitung UN aufgetreten" UWORD B_TRUE 1 100 0 1 BIT_MASK 0x800 FORMAT "%13.11" ECU_ADDRESS 0x3FE4F2 /end MEASUREMENT
/begin MEASUREMENT B_nplsuun2 "Fehlertyp 'Plausibilit‰tsfehler'  an Sondenleitung UN aufgetreten, Bank 2" UWORD B_TRUE 1 100 0 1 BIT_MASK 0x800 FORMAT "%13.11" ECU_ADDRESS 0x3FE4F4 /end MEASUREMENT
/begin MEASUREMENT B_nplsuvm "Fehlertyp 'Plausibilit‰tsfehler'  an Sondenleitung VM aufgetreten" UWORD B_TRUE 1 100 0 1 BIT_MASK 0x800 FORMAT "%13.11" ECU_ADDRESS 0x3FE4F6 /end MEASUREMENT
/begin MEASUREMENT B_nplsuvm2 "Fehlertyp 'Plausibilit‰tsfehler'  an Sondenleitung VM aufgetreten, Bank 2" UWORD B_TRUE 1 100 0 1 BIT_MASK 0x800 FORMAT "%13.11" ECU_ADDRESS 0x3FE4F8 /end MEASUREMENT
/begin MEASUREMENT B_npmd "Fehlertyp unplaus.: Aussetzer, Summenfehler (multiple)" UWORD B_TRUE 1 100 0 1 BIT_MASK 0x800 FORMAT "%13.11" ECU_ADDRESS 0x3FE500 /end MEASUREMENT
/begin MEASUREMENT B_npmd00 "Fehlertyp unplaus.: Aussetzer Z¸ndung 0" UWORD B_TRUE 1 100 0 1 BIT_MASK 0x800 FORMAT "%13.11" ECU_ADDRESS 0x3FE502 /end MEASUREMENT
/begin MEASUREMENT B_npmd01 "Fehlertyp unplaus.: Aussetzer Z¸ndung 1" UWORD B_TRUE 1 100 0 1 BIT_MASK 0x800 FORMAT "%13.11" ECU_ADDRESS 0x3FE504 /end MEASUREMENT
/begin MEASUREMENT B_npmd02 "Fehlertyp unplaus.: Aussetzer Z¸ndung 2" UWORD B_TRUE 1 100 0 1 BIT_MASK 0x800 FORMAT "%13.11" ECU_ADDRESS 0x3FE506 /end MEASUREMENT
/begin MEASUREMENT B_npmd03 "Fehlertyp unplaus.: Aussetzer Z¸ndung 3" UWORD B_TRUE 1 100 0 1 BIT_MASK 0x800 FORMAT "%13.11" ECU_ADDRESS 0x3FE508 /end MEASUREMENT
/begin MEASUREMENT B_npmd04 "Fehlertyp unplaus.: Aussetzer Z¸ndung 4" UWORD B_TRUE 1 100 0 1 BIT_MASK 0x800 FORMAT "%13.11" ECU_ADDRESS 0x3FE50A /end MEASUREMENT
/begin MEASUREMENT B_npmd05 "Fehlertyp unplaus.: Aussetzer Z¸ndung 5" UWORD B_TRUE 1 100 0 1 BIT_MASK 0x800 FORMAT "%13.11" ECU_ADDRESS 0x3FE50C /end MEASUREMENT
/begin MEASUREMENT B_npmd06 "Fehlertyp unplaus.: Aussetzer Z¸ndung 6" UWORD B_TRUE 1 100 0 1 BIT_MASK 0x800 FORMAT "%13.11" ECU_ADDRESS 0x3FE50E /end MEASUREMENT
/begin MEASUREMENT B_npmd07 "Fehlertyp unplaus.: Aussetzer Z¸ndung 7" UWORD B_TRUE 1 100 0 1 BIT_MASK 0x800 FORMAT "%13.11" ECU_ADDRESS 0x3FE510 /end MEASUREMENT
/begin MEASUREMENT B_npmd08 "Fehlertyp unplaus.: Aussetzer Z¸ndung 8" UWORD B_TRUE 1 100 0 1 BIT_MASK 0x800 FORMAT "%13.11" ECU_ADDRESS 0x3FE512 /end MEASUREMENT
/begin MEASUREMENT B_npmd09 "Fehlertyp unplaus.: Aussetzer Z¸ndung 9" UWORD B_TRUE 1 100 0 1 BIT_MASK 0x800 FORMAT "%13.11" ECU_ADDRESS 0x3FE514 /end MEASUREMENT
/begin MEASUREMENT B_npmd10 "Fehlertyp unplaus.: Aussetzer Z¸ndung 10" UWORD B_TRUE 1 100 0 1 BIT_MASK 0x800 FORMAT "%13.11" ECU_ADDRESS 0x3FE516 /end MEASUREMENT
/begin MEASUREMENT B_npmd11 "Fehlertyp unplaus.: Aussetzer Z¸ndung 11" UWORD B_TRUE 1 100 0 1 BIT_MASK 0x800 FORMAT "%13.11" ECU_ADDRESS 0x3FE518 /end MEASUREMENT
/begin MEASUREMENT B_npmle "Fehlertyp unplaus.: Motorl¸fter" UWORD B_TRUE 1 100 0 1 BIT_MASK 0x800 FORMAT "%13.11" ECU_ADDRESS 0x3FE520 /end MEASUREMENT
/begin MEASUREMENT B_npnvrbup "Fehlerart NVRAM-Backup nicht plausibel (nicht verwendet)" UWORD B_TRUE 1 100 0 1 BIT_MASK 0x800 FORMAT "%13.11" ECU_ADDRESS 0x3FE526 /end MEASUREMENT
/begin MEASUREMENT B_nprkat "Bedingung RKAT ist unplausibel" UWORD B_TRUE 1 100 0 1 BIT_MASK 0x800 FORMAT "%13.11" ECU_ADDRESS 0x3FE544 /end MEASUREMENT
/begin MEASUREMENT B_nprkat2 "Bedingung RKAT ist unplausibel Bank 2" UWORD B_TRUE 1 100 0 1 BIT_MASK 0x800 FORMAT "%13.11" ECU_ADDRESS 0x3FE546 /end MEASUREMENT
/begin MEASUREMENT B_nprkaz "Bedingung RKAZ ist unplausibel" UWORD B_TRUE 1 100 0 1 BIT_MASK 0x800 FORMAT "%13.11" ECU_ADDRESS 0x3FE548 /end MEASUREMENT
/begin MEASUREMENT B_nprkaz2 "Bedingung RKAZ ist unplausibel Bank 2" UWORD B_TRUE 1 100 0 1 BIT_MASK 0x800 FORMAT "%13.11" ECU_ADDRESS 0x3FE54A /end MEASUREMENT
/begin MEASUREMENT B_sianws "Fehlerart: Leitungsabfall Nockenwellensteuerungsventil (Bank1, Auslaﬂ)" UWORD B_TRUE 1 100 0 1 BIT_MASK 0x400 FORMAT "%13.11" ECU_ADDRESS 0x3FE3B4 /end MEASUREMENT
/begin MEASUREMENT B_sianws2 "Fehlerart: Leitungsabfall Nockenwellensteuerungsventil (Bank2, Auslaﬂ)" UWORD B_TRUE 1 100 0 1 BIT_MASK 0x400 FORMAT "%13.11" ECU_ADDRESS 0x3FE3B6 /end MEASUREMENT
/begin MEASUREMENT B_sicvvt "Signalfehler CAN-Timeout VVT-Botschaft" UWORD B_TRUE 1 100 0 1 BIT_MASK 0x400 FORMAT "%13.11" ECU_ADDRESS 0x3FE3E0 /end MEASUREMENT
/begin MEASUREMENT B_siets "Fehlertype: Leitungsabfall Endstufe Elektr. Thermostat" UWORD B_TRUE 1 100 0 1 BIT_MASK 0x400 FORMAT "%13.11" ECU_ADDRESS 0x3FE474 /end MEASUREMENT
/begin MEASUREMENT B_sifrao "Fehlertyp 'Signal fehlt' for FRAO erkannt" UWORD B_TRUE 1 100 0 1 BIT_MASK 0x400 FORMAT "%13.11" ECU_ADDRESS 0x3FE48C /end MEASUREMENT
/begin MEASUREMENT B_sifrao2 "Fehlertyp 'Signal fehlt' for FRAO erkannt Bank 2" UWORD B_TRUE 1 100 0 1 BIT_MASK 0x400 FORMAT "%13.11" ECU_ADDRESS 0x3FE48E /end MEASUREMENT
/begin MEASUREMENT B_sifrau "Fehlertyp 'Signal fehlt' f¸r FRAU erkannt" UWORD B_TRUE 1 100 0 1 BIT_MASK 0x400 FORMAT "%13.11" ECU_ADDRESS 0x3FE490 /end MEASUREMENT
/begin MEASUREMENT B_sifrau2 "Fehlertyp 'Signal fehlt' f¸r FRAU erkannt Bank 2" UWORD B_TRUE 1 100 0 1 BIT_MASK 0x400 FORMAT "%13.11" ECU_ADDRESS 0x3FE492 /end MEASUREMENT
/begin MEASUREMENT B_sifrst "Fehlerart: LR-Abweichung" UWORD B_TRUE 1 100 0 1 BIT_MASK 0x400 FORMAT "%13.11" ECU_ADDRESS 0x3FE494 /end MEASUREMENT
/begin MEASUREMENT B_sifrst2 "Fehlerart: LR-Abweichung Bank 2" UWORD B_TRUE 1 100 0 1 BIT_MASK 0x400 FORMAT "%13.11" ECU_ADDRESS 0x3FE496 /end MEASUREMENT
/begin MEASUREMENT B_siiclsu "Bedingung Signalfehler Auswerte-IC f¸r LSU" UWORD B_TRUE 1 100 0 1 BIT_MASK 0x400 FORMAT "%13.11" ECU_ADDRESS 0x3FE4B4 /end MEASUREMENT
/begin MEASUREMENT B_siiclsu2 "Bedingung Signalfehler Auswerte-IC f¸r LSU, Bank 2" UWORD B_TRUE 1 100 0 1 BIT_MASK 0x400 FORMAT "%13.11" ECU_ADDRESS 0x3FE4B6 /end MEASUREMENT
/begin MEASUREMENT B_sikat "Fehlertyp 'Signal fehlt' f¸r DKAT erkannt" UWORD B_TRUE 1 100 0 1 BIT_MASK 0x400 FORMAT "%13.11" ECU_ADDRESS 0x3FE4B8 /end MEASUREMENT
/begin MEASUREMENT B_sikat2 "Fehlertyp 'Signal fehlt' f¸r DKAT 2 erkannt" UWORD B_TRUE 1 100 0 1 BIT_MASK 0x400 FORMAT "%13.11" ECU_ADDRESS 0x3FE4BA /end MEASUREMENT
/begin MEASUREMENT B_sikose "Fehlertype: Leitungsabfall Endstufe Klimakompressor" UWORD B_TRUE 1 100 0 1 BIT_MASK 0x400 FORMAT "%13.11" ECU_ADDRESS 0x3FE4BC /end MEASUREMENT
/begin MEASUREMENT B_sikrnt "Fehlertyp: Klopfregelung Nulltest" UWORD B_TRUE 1 100 0 1 BIT_MASK 0x400 FORMAT "%13.11" ECU_ADDRESS 0x3FE4C0 /end MEASUREMENT
/begin MEASUREMENT B_sikrnt2 "" UWORD B_TRUE 1 100 0 1 BIT_MASK 0x400 FORMAT "%13.11" ECU_ADDRESS 0x3FE4C2 /end MEASUREMENT
/begin MEASUREMENT B_sikrof "Fehlertyp: Klopfregelung Offset" UWORD B_TRUE 1 100 0 1 BIT_MASK 0x400 FORMAT "%13.11" ECU_ADDRESS 0x3FE4C4 /end MEASUREMENT
/begin MEASUREMENT B_sikrof2 "" UWORD B_TRUE 1 100 0 1 BIT_MASK 0x400 FORMAT "%13.11" ECU_ADDRESS 0x3FE4C6 /end MEASUREMENT
/begin MEASUREMENT B_sikrtp "Fehlertyp: Klopfregelung Testimpuls" UWORD B_TRUE 1 100 0 1 BIT_MASK 0x400 FORMAT "%13.11" ECU_ADDRESS 0x3FE4C8 /end MEASUREMENT
/begin MEASUREMENT B_sikrtp2 "" UWORD B_TRUE 1 100 0 1 BIT_MASK 0x400 FORMAT "%13.11" ECU_ADDRESS 0x3FE4CA /end MEASUREMENT
/begin MEASUREMENT B_siks1 "Fehlertyp: Klopfsensor 1" UWORD B_TRUE 1 100 0 1 BIT_MASK 0x400 FORMAT "%13.11" ECU_ADDRESS 0x3FE4CC /end MEASUREMENT
/begin MEASUREMENT B_siks2 "Fehlertyp: Klopfsensor 2" UWORD B_TRUE 1 100 0 1 BIT_MASK 0x400 FORMAT "%13.11" ECU_ADDRESS 0x3FE4CE /end MEASUREMENT
/begin MEASUREMENT B_siks3 "Fehlertyp: Klopfsensor 3" UWORD B_TRUE 1 100 0 1 BIT_MASK 0x400 FORMAT "%13.11" ECU_ADDRESS 0x3FE4D0 /end MEASUREMENT
/begin MEASUREMENT B_siks4 "Fehlertyp: Klopfsensor 4" UWORD B_TRUE 1 100 0 1 BIT_MASK 0x400 FORMAT "%13.11" ECU_ADDRESS 0x3FE4D2 /end MEASUREMENT
/begin MEASUREMENT B_sikuppl "Fehlertyp KUPPL: Signal inaktiv" UWORD B_TRUE 1 100 0 1 BIT_MASK 0x400 FORMAT "%13.11" ECU_ADDRESS 0x3FE4D4 /end MEASUREMENT
/begin MEASUREMENT B_silash "Fehlertyp: Lambdasondenalterung hinter Kat." UWORD B_TRUE 1 100 0 1 BIT_MASK 0x400 FORMAT "%13.11" ECU_ADDRESS 0x3FE4D6 /end MEASUREMENT
/begin MEASUREMENT B_silash2 "Fehlertyp: Lambdasondenalterung hinter Kat. Bank 2" UWORD B_TRUE 1 100 0 1 BIT_MASK 0x400 FORMAT "%13.11" ECU_ADDRESS 0x3FE4D8 /end MEASUREMENT
/begin MEASUREMENT B_silavh "Fehlertyp: Lambdasondenalterung  (Vollast-Pr¸fung) hinter Kat." UWORD B_TRUE 1 100 0 1 BIT_MASK 0x400 FORMAT "%13.11" ECU_ADDRESS 0x3FE4DA /end MEASUREMENT
/begin MEASUREMENT B_silavh2 "Fehlertyp: Lambdasondenalterung  (Vollast-Pr¸fung) hinter Kat. Bank2" UWORD B_TRUE 1 100 0 1 BIT_MASK 0x400 FORMAT "%13.11" ECU_ADDRESS 0x3FE4DC /end MEASUREMENT
/begin MEASUREMENT B_sillr "Fehlertyp: Leerlaufregelung" UWORD B_TRUE 1 100 0 1 BIT_MASK 0x400 FORMAT "%13.11" ECU_ADDRESS 0x3FE4DE /end MEASUREMENT
/begin MEASUREMENT B_silsh "Fehlertyp 'Signal fehlt' hinter KAT erkannt" UWORD B_TRUE 1 100 0 1 BIT_MASK 0x400 FORMAT "%13.11" ECU_ADDRESS 0x3FE4E2 /end MEASUREMENT
/begin MEASUREMENT B_silsh2 "Fehlertyp 'Signal fehlt' hinter KAT erkannt Bank2" UWORD B_TRUE 1 100 0 1 BIT_MASK 0x400 FORMAT "%13.11" ECU_ADDRESS 0x3FE4E4 /end MEASUREMENT
/begin MEASUREMENT B_silsuia "Fehlertyp 'Signalfehler'  an Sondenleitung IA aufgetreten" UWORD B_TRUE 1 100 0 1 BIT_MASK 0x400 FORMAT "%13.11" ECU_ADDRESS 0x3FE4E6 /end MEASUREMENT
/begin MEASUREMENT B_silsuia2 "Fehlertyp 'Signalfehler'  an Sondenleitung IA aufgetreten, Bank 2" UWORD B_TRUE 1 100 0 1 BIT_MASK 0x400 FORMAT "%13.11" ECU_ADDRESS 0x3FE4E8 /end MEASUREMENT
/begin MEASUREMENT B_silsuip "Fehlertyp 'Signalfehler'  an Sondenleitung IP aufgetreten" UWORD B_TRUE 1 100 0 1 BIT_MASK 0x400 FORMAT "%13.11" ECU_ADDRESS 0x3FE4EA /end MEASUREMENT
/begin MEASUREMENT B_silsuip2 "Fehlertyp 'Signalfehler'  an Sondenleitung IP aufgetreten, B2" UWORD B_TRUE 1 100 0 1 BIT_MASK 0x400 FORMAT "%13.11" ECU_ADDRESS 0x3FE4EC /end MEASUREMENT
/begin MEASUREMENT B_silsuks "Fehlertyp 'Signalwert'  des Fehlers E_lsuks" UWORD B_TRUE 1 100 0 1 BIT_MASK 0x400 FORMAT "%13.11" ECU_ADDRESS 0x3FE4EE /end MEASUREMENT
/begin MEASUREMENT B_silsuks2 "Fehlertyp 'Signalwert'  des Fehlers E_lsuks, B2" UWORD B_TRUE 1 100 0 1 BIT_MASK 0x400 FORMAT "%13.11" ECU_ADDRESS 0x3FE4F0 /end MEASUREMENT
/begin MEASUREMENT B_silsuun "Fehlertyp 'Signalfehler'  an Sondenleitung UN aufgetreten" UWORD B_TRUE 1 100 0 1 BIT_MASK 0x400 FORMAT "%13.11" ECU_ADDRESS 0x3FE4F2 /end MEASUREMENT
/begin MEASUREMENT B_silsuun2 "Fehlertyp 'Signalfehler'  an Sondenleitung UN aufgetreten, Bank 2" UWORD B_TRUE 1 100 0 1 BIT_MASK 0x400 FORMAT "%13.11" ECU_ADDRESS 0x3FE4F4 /end MEASUREMENT
/begin MEASUREMENT B_silsuvm "Fehlertyp 'Signalfehler'  an Sondenleitung VM aufgetreten" UWORD B_TRUE 1 100 0 1 BIT_MASK 0x400 FORMAT "%13.11" ECU_ADDRESS 0x3FE4F6 /end MEASUREMENT
/begin MEASUREMENT B_silsuvm2 "Fehlertyp 'Signalfehler'  an Sondenleitung VM aufgetreten, Bank 2" UWORD B_TRUE 1 100 0 1 BIT_MASK 0x400 FORMAT "%13.11" ECU_ADDRESS 0x3FE4F8 /end MEASUREMENT
/begin MEASUREMENT B_simd "Fehlertyp sig.: Aussetzer, Summenfehler (multiple)" UWORD B_TRUE 1 100 0 1 BIT_MASK 0x400 FORMAT "%13.11" ECU_ADDRESS 0x3FE500 /end MEASUREMENT
/begin MEASUREMENT B_simd00 "Fehlertyp sig.: Aussetzer Z¸ndung 0" UWORD B_TRUE 1 100 0 1 BIT_MASK 0x400 FORMAT "%13.11" ECU_ADDRESS 0x3FE502 /end MEASUREMENT
/begin MEASUREMENT B_simd01 "Fehlertyp sig.: Aussetzer Z¸ndung 1" UWORD B_TRUE 1 100 0 1 BIT_MASK 0x400 FORMAT "%13.11" ECU_ADDRESS 0x3FE504 /end MEASUREMENT
/begin MEASUREMENT B_simd02 "Fehlertyp sig.: Aussetzer Z¸ndung 2" UWORD B_TRUE 1 100 0 1 BIT_MASK 0x400 FORMAT "%13.11" ECU_ADDRESS 0x3FE506 /end MEASUREMENT
/begin MEASUREMENT B_simd03 "Fehlertyp sig.: Aussetzer Z¸ndung 3" UWORD B_TRUE 1 100 0 1 BIT_MASK 0x400 FORMAT "%13.11" ECU_ADDRESS 0x3FE508 /end MEASUREMENT
/begin MEASUREMENT B_simd04 "Fehlertyp sig.: Aussetzer Z¸ndung 4" UWORD B_TRUE 1 100 0 1 BIT_MASK 0x400 FORMAT "%13.11" ECU_ADDRESS 0x3FE50A /end MEASUREMENT
/begin MEASUREMENT B_simd05 "Fehlertyp sig.: Aussetzer Z¸ndung 5" UWORD B_TRUE 1 100 0 1 BIT_MASK 0x400 FORMAT "%13.11" ECU_ADDRESS 0x3FE50C /end MEASUREMENT
/begin MEASUREMENT B_simd06 "Fehlertyp sig.: Aussetzer Z¸ndung 6" UWORD B_TRUE 1 100 0 1 BIT_MASK 0x400 FORMAT "%13.11" ECU_ADDRESS 0x3FE50E /end MEASUREMENT
/begin MEASUREMENT B_simd07 "Fehlertyp sig.: Aussetzer Z¸ndung 7" UWORD B_TRUE 1 100 0 1 BIT_MASK 0x400 FORMAT "%13.11" ECU_ADDRESS 0x3FE510 /end MEASUREMENT
/begin MEASUREMENT B_simd08 "Fehlertyp sig.: Aussetzer Z¸ndung 8" UWORD B_TRUE 1 100 0 1 BIT_MASK 0x400 FORMAT "%13.11" ECU_ADDRESS 0x3FE512 /end MEASUREMENT
/begin MEASUREMENT B_simd09 "Fehlertyp sig.: Aussetzer Z¸ndung 9" UWORD B_TRUE 1 100 0 1 BIT_MASK 0x400 FORMAT "%13.11" ECU_ADDRESS 0x3FE514 /end MEASUREMENT
/begin MEASUREMENT B_simd10 "Fehlertyp sig.: Aussetzer Z¸ndung 10" UWORD B_TRUE 1 100 0 1 BIT_MASK 0x400 FORMAT "%13.11" ECU_ADDRESS 0x3FE516 /end MEASUREMENT
/begin MEASUREMENT B_simd11 "Fehlertyp sig.: Aussetzer Z¸ndung 11" UWORD B_TRUE 1 100 0 1 BIT_MASK 0x400 FORMAT "%13.11" ECU_ADDRESS 0x3FE518 /end MEASUREMENT
/begin MEASUREMENT B_simle "Fehlertype: Leitungsabfall Endstufe Motor L¸fter" UWORD B_TRUE 1 100 0 1 BIT_MASK 0x400 FORMAT "%13.11" ECU_ADDRESS 0x3FE520 /end MEASUREMENT
/begin MEASUREMENT B_sinvrbup "Fehlertyp NVRAM-Backup Signal (nicht verwendet)" UWORD B_TRUE 1 100 0 1 BIT_MASK 0x400 FORMAT "%13.11" ECU_ADDRESS 0x3FE526 /end MEASUREMENT
/begin MEASUREMENT B_sirkat "Fehlertyp 'Signal fehlt' for RKAT erkannt" UWORD B_TRUE 1 100 0 1 BIT_MASK 0x400 FORMAT "%13.11" ECU_ADDRESS 0x3FE544 /end MEASUREMENT
/begin MEASUREMENT B_sirkat2 "Fehlertyp 'Signal fehlt' for RKAT erkannt Bank 2" UWORD B_TRUE 1 100 0 1 BIT_MASK 0x400 FORMAT "%13.11" ECU_ADDRESS 0x3FE546 /end MEASUREMENT
/begin MEASUREMENT B_sirkaz "Fehlertyp 'Signal fehlt' for RKAZ erkannt" UWORD B_TRUE 1 100 0 1 BIT_MASK 0x400 FORMAT "%13.11" ECU_ADDRESS 0x3FE548 /end MEASUREMENT
/begin MEASUREMENT B_sirkaz2 "Fehlertyp 'Signal fehlt' for RKAZ erkannt Bank 2" UWORD B_TRUE 1 100 0 1 BIT_MASK 0x400 FORMAT "%13.11" ECU_ADDRESS 0x3FE54A /end MEASUREMENT
/begin MEASUREMENT E_anws "Errorflag: Nockenwellensteuerung (Auslaﬂ,Bank1)" UWORD B_TRUE 1 100 0 1 BIT_MASK 0x1 FORMAT "%13.11" ECU_ADDRESS 0x3FE3B4 /end MEASUREMENT
/begin MEASUREMENT E_anws2 "Errorflag: Nockenwellensteuerung (Auslaﬂ,Bank2)" UWORD B_TRUE 1 100 0 1 BIT_MASK 0x1 FORMAT "%13.11" ECU_ADDRESS 0x3FE3B6 /end MEASUREMENT
/begin MEASUREMENT E_cvvt "Errorflag: LOCAN-Schnittstelle, Timeout VVT-SG" UWORD B_TRUE 1 100 0 1 BIT_MASK 0x1 FORMAT "%13.11" ECU_ADDRESS 0x3FE3E0 /end MEASUREMENT
/begin MEASUREMENT E_ets "Errorflag: elektronisches Thermostat" UWORD B_TRUE 1 100 0 1 BIT_MASK 0x1 FORMAT "%13.11" ECU_ADDRESS 0x3FE474 /end MEASUREMENT
/begin MEASUREMENT E_frao "Errorflag: LR-Adaption oberer multiplikativer Bereich" UWORD B_TRUE 1 100 0 1 BIT_MASK 0x1 FORMAT "%13.11" ECU_ADDRESS 0x3FE48C /end MEASUREMENT
/begin MEASUREMENT E_frao2 "Errorflag: LR-Adaption oberer multiplikativer Bereich (Bank 2)" UWORD B_TRUE 1 100 0 1 BIT_MASK 0x1 FORMAT "%13.11" ECU_ADDRESS 0x3FE48E /end MEASUREMENT
/begin MEASUREMENT E_frau "Errorflag: LR-Adaption unterer multiplikativer Bereich" UWORD B_TRUE 1 100 0 1 BIT_MASK 0x1 FORMAT "%13.11" ECU_ADDRESS 0x3FE490 /end MEASUREMENT
/begin MEASUREMENT E_frau2 "Errorflag: LR-Adaption unterer multiplikativer Bereich (Bank 2)" UWORD B_TRUE 1 100 0 1 BIT_MASK 0x1 FORMAT "%13.11" ECU_ADDRESS 0x3FE492 /end MEASUREMENT
/begin MEASUREMENT E_frst "Errorflag: Fehler aus Diagnose Kraftstoffversorgungssystem (Kurztest)" UWORD B_TRUE 1 100 0 1 BIT_MASK 0x1 FORMAT "%13.11" ECU_ADDRESS 0x3FE494 /end MEASUREMENT
/begin MEASUREMENT E_frst2 "Errorflag: Fehler aus Diagnose Kraftstoffvers.-System (Kurztest Bank 2)" UWORD B_TRUE 1 100 0 1 BIT_MASK 0x1 FORMAT "%13.11" ECU_ADDRESS 0x3FE496 /end MEASUREMENT
/begin MEASUREMENT E_iclsu "Errorflag: Fehler Auswerte-IC f¸r die LSU (Spg.-Versorgung, Kommunikation)" UWORD B_TRUE 1 100 0 1 BIT_MASK 0x1 FORMAT "%13.11" ECU_ADDRESS 0x3FE4B4 /end MEASUREMENT
/begin MEASUREMENT E_iclsu2 "Errorflag: Fehler Auswerte-IC f¸r die LSU, Bank 2" UWORD B_TRUE 1 100 0 1 BIT_MASK 0x1 FORMAT "%13.11" ECU_ADDRESS 0x3FE4B6 /end MEASUREMENT
/begin MEASUREMENT E_kat "Errorflag: Katalysator-Konvertierung" UWORD B_TRUE 1 100 0 1 BIT_MASK 0x1 FORMAT "%13.11" ECU_ADDRESS 0x3FE4B8 /end MEASUREMENT
/begin MEASUREMENT E_kat2 "Errorflag: Katalysator-Konvertierung	(Bank 2)" UWORD B_TRUE 1 100 0 1 BIT_MASK 0x1 FORMAT "%13.11" ECU_ADDRESS 0x3FE4BA /end MEASUREMENT
/begin MEASUREMENT E_kose "Errorflag: Klimakompressorsteuerung, Endstufe" UWORD B_TRUE 1 100 0 1 BIT_MASK 0x1 FORMAT "%13.11" ECU_ADDRESS 0x3FE4BC /end MEASUREMENT
/begin MEASUREMENT E_krnt "Errorflag: Klopfregelung Nulltest" UWORD B_TRUE 1 100 0 1 BIT_MASK 0x1 FORMAT "%13.11" ECU_ADDRESS 0x3FE4C0 /end MEASUREMENT
/begin MEASUREMENT E_krnt2 "Errorflag: Klopfregelung Nulltest (zweiter CC195)" UWORD B_TRUE 1 100 0 1 BIT_MASK 0x1 FORMAT "%13.11" ECU_ADDRESS 0x3FE4C2 /end MEASUREMENT
/begin MEASUREMENT E_krof "Errorflag: Klopfregelung Offset" UWORD B_TRUE 1 100 0 1 BIT_MASK 0x1 FORMAT "%13.11" ECU_ADDRESS 0x3FE4C4 /end MEASUREMENT
/begin MEASUREMENT E_krof2 "Errorflag: Klopfregelung Offset (zweiter CC195)" UWORD B_TRUE 1 100 0 1 BIT_MASK 0x1 FORMAT "%13.11" ECU_ADDRESS 0x3FE4C6 /end MEASUREMENT
/begin MEASUREMENT E_krtp "Errorflag: Klopfregelung Testimpuls" UWORD B_TRUE 1 100 0 1 BIT_MASK 0x1 FORMAT "%13.11" ECU_ADDRESS 0x3FE4C8 /end MEASUREMENT
/begin MEASUREMENT E_krtp2 "Errorflag: Klopfregelung Testimpuls (zweiter CC195)" UWORD B_TRUE 1 100 0 1 BIT_MASK 0x1 FORMAT "%13.11" ECU_ADDRESS 0x3FE4CA /end MEASUREMENT
/begin MEASUREMENT E_ks1 "Errorflag: Klopfsensor 1" UWORD B_TRUE 1 100 0 1 BIT_MASK 0x1 FORMAT "%13.11" ECU_ADDRESS 0x3FE4CC /end MEASUREMENT
/begin MEASUREMENT E_ks2 "Errorflag: Klopfsensor 2" UWORD B_TRUE 1 100 0 1 BIT_MASK 0x1 FORMAT "%13.11" ECU_ADDRESS 0x3FE4CE /end MEASUREMENT
/begin MEASUREMENT E_ks3 "Errorflag: Klopfsensor 3" UWORD B_TRUE 1 100 0 1 BIT_MASK 0x1 FORMAT "%13.11" ECU_ADDRESS 0x3FE4D0 /end MEASUREMENT
/begin MEASUREMENT E_ks4 "Errorflag: Klopfsensor 4" UWORD B_TRUE 1 100 0 1 BIT_MASK 0x1 FORMAT "%13.11" ECU_ADDRESS 0x3FE4D2 /end MEASUREMENT
/begin MEASUREMENT E_kuppl "Fehlerflag: Gebergrˆﬂe Kupplung" UWORD B_TRUE 1 100 0 1 BIT_MASK 0x1 FORMAT "%13.11" ECU_ADDRESS 0x3FE4D4 /end MEASUREMENT
/begin MEASUREMENT E_lash "Errorflag: Lambda-Sondenalterung hinter Katalysator" UWORD B_TRUE 1 100 0 1 BIT_MASK 0x1 FORMAT "%13.11" ECU_ADDRESS 0x3FE4D6 /end MEASUREMENT
/begin MEASUREMENT E_lash2 "Errorflag: Lambda-Sondenalterung hinter Kat. (Bank 2)" UWORD B_TRUE 1 100 0 1 BIT_MASK 0x1 FORMAT "%13.11" ECU_ADDRESS 0x3FE4D8 /end MEASUREMENT
/begin MEASUREMENT E_lavh "Errorflag: Lambda-Sondenalterung im Vollast hinter Katalysator" UWORD B_TRUE 1 100 0 1 BIT_MASK 0x1 FORMAT "%13.11" ECU_ADDRESS 0x3FE4DA /end MEASUREMENT
/begin MEASUREMENT E_lavh2 "Errorflag: Lambda-Sondenalterung im Vollast hinter Katalysator Bank2" UWORD B_TRUE 1 100 0 1 BIT_MASK 0x1 FORMAT "%13.11" ECU_ADDRESS 0x3FE4DC /end MEASUREMENT
/begin MEASUREMENT E_llr "Errorflag: Leerlaufregelung" UWORD B_TRUE 1 100 0 1 BIT_MASK 0x1 FORMAT "%13.11" ECU_ADDRESS 0x3FE4DE /end MEASUREMENT
/begin MEASUREMENT E_lsh "Errorflag: Lambda-Sonde hinter Kat" UWORD B_TRUE 1 100 0 1 BIT_MASK 0x1 FORMAT "%13.11" ECU_ADDRESS 0x3FE4E2 /end MEASUREMENT
/begin MEASUREMENT E_lsh2 "Errorflag: Lambda-Sonde hinter Kat Bank2" UWORD B_TRUE 1 100 0 1 BIT_MASK 0x1 FORMAT "%13.11" ECU_ADDRESS 0x3FE4E4 /end MEASUREMENT
/begin MEASUREMENT E_lsuia "Errorflag: Diagnose Lambdasondenleitung an Bond IA (Leitungsunterbrechung)" UWORD B_TRUE 1 100 0 1 BIT_MASK 0x1 FORMAT "%13.11" ECU_ADDRESS 0x3FE4E6 /end MEASUREMENT
/begin MEASUREMENT E_lsuia2 "Errorflag: Diagnose Lambdasondenleitung an Bond IA (Leitungsunterbrechung)" UWORD B_TRUE 1 100 0 1 BIT_MASK 0x1 FORMAT "%13.11" ECU_ADDRESS 0x3FE4E8 /end MEASUREMENT
/begin MEASUREMENT E_lsuip "Errorflag:  Fehler Leitungsunterbrechung an IP" UWORD B_TRUE 1 100 0 1 BIT_MASK 0x1 FORMAT "%13.11" ECU_ADDRESS 0x3FE4EA /end MEASUREMENT
/begin MEASUREMENT E_lsuip2 "Errorflag:  Fehler Leitungsunterbrechung an IP, Bank 2" UWORD B_TRUE 1 100 0 1 BIT_MASK 0x1 FORMAT "%13.11" ECU_ADDRESS 0x3FE4EC /end MEASUREMENT
/begin MEASUREMENT E_lsuks "Errorflag:  Kurzschluﬂ Sondenleitung" UWORD B_TRUE 1 100 0 1 BIT_MASK 0x1 FORMAT "%13.11" ECU_ADDRESS 0x3FE4EE /end MEASUREMENT
/begin MEASUREMENT E_lsuks2 "Errorflag:  Kurzschluﬂ Sondenleitung, Bank 2" UWORD B_TRUE 1 100 0 1 BIT_MASK 0x1 FORMAT "%13.11" ECU_ADDRESS 0x3FE4F0 /end MEASUREMENT
/begin MEASUREMENT E_lsuun "Errorflag: Diagnose Lambdasondenleitung an Bond UN" UWORD B_TRUE 1 100 0 1 BIT_MASK 0x1 FORMAT "%13.11" ECU_ADDRESS 0x3FE4F2 /end MEASUREMENT
/begin MEASUREMENT E_lsuun2 "Errorflag: Diagnose Lambdasondenleitung an Bond UN, Bank 2" UWORD B_TRUE 1 100 0 1 BIT_MASK 0x1 FORMAT "%13.11" ECU_ADDRESS 0x3FE4F4 /end MEASUREMENT
/begin MEASUREMENT E_lsuvm "Errorflag: Diagnose Lambdasondenleitung an Bond VM" UWORD B_TRUE 1 100 0 1 BIT_MASK 0x1 FORMAT "%13.11" ECU_ADDRESS 0x3FE4F6 /end MEASUREMENT
/begin MEASUREMENT E_lsuvm2 "Errorflag: Diagnose Lambdasondenleitung an Bond VM, Bank 2" UWORD B_TRUE 1 100 0 1 BIT_MASK 0x1 FORMAT "%13.11" ECU_ADDRESS 0x3FE4F8 /end MEASUREMENT
/begin MEASUREMENT E_md "Errorflag: Aussetzer, Summenfehler (multiple)" UWORD B_TRUE 1 100 0 1 BIT_MASK 0x1 FORMAT "%13.11" ECU_ADDRESS 0x3FE500 /end MEASUREMENT
/begin MEASUREMENT E_md00 "Errorflag: Aussetzer Z¸ndung 0" UWORD B_TRUE 1 100 0 1 BIT_MASK 0x1 FORMAT "%13.11" ECU_ADDRESS 0x3FE502 /end MEASUREMENT
/begin MEASUREMENT E_md01 "Errorflag: Aussetzer Z¸ndung 1" UWORD B_TRUE 1 100 0 1 BIT_MASK 0x1 FORMAT "%13.11" ECU_ADDRESS 0x3FE504 /end MEASUREMENT
/begin MEASUREMENT E_md02 "Errorflag: Aussetzer Z¸ndung 2" UWORD B_TRUE 1 100 0 1 BIT_MASK 0x1 FORMAT "%13.11" ECU_ADDRESS 0x3FE506 /end MEASUREMENT
/begin MEASUREMENT E_md03 "Errorflag: Aussetzer Z¸ndung 3" UWORD B_TRUE 1 100 0 1 BIT_MASK 0x1 FORMAT "%13.11" ECU_ADDRESS 0x3FE508 /end MEASUREMENT
/begin MEASUREMENT E_md04 "Errorflag: Aussetzer Z¸ndung 4" UWORD B_TRUE 1 100 0 1 BIT_MASK 0x1 FORMAT "%13.11" ECU_ADDRESS 0x3FE50A /end MEASUREMENT
/begin MEASUREMENT E_md05 "Errorflag: Aussetzer Z¸ndung 5" UWORD B_TRUE 1 100 0 1 BIT_MASK 0x1 FORMAT "%13.11" ECU_ADDRESS 0x3FE50C /end MEASUREMENT
/begin MEASUREMENT E_md06 "Errorflag: Aussetzer Z¸ndung 6" UWORD B_TRUE 1 100 0 1 BIT_MASK 0x1 FORMAT "%13.11" ECU_ADDRESS 0x3FE50E /end MEASUREMENT
/begin MEASUREMENT E_md07 "Errorflag: Aussetzer Z¸ndung 7" UWORD B_TRUE 1 100 0 1 BIT_MASK 0x1 FORMAT "%13.11" ECU_ADDRESS 0x3FE510 /end MEASUREMENT
/begin MEASUREMENT E_md08 "Errorflag: Aussetzer Z¸ndung 8" UWORD B_TRUE 1 100 0 1 BIT_MASK 0x1 FORMAT "%13.11" ECU_ADDRESS 0x3FE512 /end MEASUREMENT
/begin MEASUREMENT E_md09 "Errorflag: Aussetzer Z¸ndung 9" UWORD B_TRUE 1 100 0 1 BIT_MASK 0x1 FORMAT "%13.11" ECU_ADDRESS 0x3FE514 /end MEASUREMENT
/begin MEASUREMENT E_md10 "Errorflag: Aussetzer Z¸ndung 10" UWORD B_TRUE 1 100 0 1 BIT_MASK 0x1 FORMAT "%13.11" ECU_ADDRESS 0x3FE516 /end MEASUREMENT
/begin MEASUREMENT E_md11 "Errorflag: Aussetzer Z¸ndung 11" UWORD B_TRUE 1 100 0 1 BIT_MASK 0x1 FORMAT "%13.11" ECU_ADDRESS 0x3FE518 /end MEASUREMENT
/begin MEASUREMENT E_mle "Errorflag: L¸fterendstufe" UWORD B_TRUE 1 100 0 1 BIT_MASK 0x1 FORMAT "%13.11" ECU_ADDRESS 0x3FE520 /end MEASUREMENT
/begin MEASUREMENT E_nvrbup "Errorflag: NVRAM-Backup Schreib-/Lese-Fehler" UWORD B_TRUE 1 100 0 1 BIT_MASK 0x1 FORMAT "%13.11" ECU_ADDRESS 0x3FE526 /end MEASUREMENT
/begin MEASUREMENT E_rkat "Errorflag DKVS (additive Korrektur pro Zeit)" UWORD B_TRUE 1 100 0 1 BIT_MASK 0x1 FORMAT "%13.11" ECU_ADDRESS 0x3FE544 /end MEASUREMENT
/begin MEASUREMENT E_rkat2 "Errorflag DKVS (additive Korrektur pro Zeit Bank 2)" UWORD B_TRUE 1 100 0 1 BIT_MASK 0x1 FORMAT "%13.11" ECU_ADDRESS 0x3FE546 /end MEASUREMENT
/begin MEASUREMENT E_rkaz "Errorflag DKVS (additive Korrektur pro Z¸ndung)" UWORD B_TRUE 1 100 0 1 BIT_MASK 0x1 FORMAT "%13.11" ECU_ADDRESS 0x3FE548 /end MEASUREMENT
/begin MEASUREMENT E_rkaz2 "Errorflag DKVS (additive Korrektur pro Z¸ndung Bank 2)" UWORD B_TRUE 1 100 0 1 BIT_MASK 0x1 FORMAT "%13.11" ECU_ADDRESS 0x3FE54A /end MEASUREMENT
/begin MEASUREMENT sfpanws "Status Fehlerpfad: Nockenwellensteuerung (Auslaﬂ, Bank1)" UWORD dez 1 100 0 65535 FORMAT "%8.2" ECU_ADDRESS 0x3FE3B4 /end MEASUREMENT
/begin MEASUREMENT sfpanws2 "Status Fehlerpfad: Nockenwellensteuerung (Auslaﬂ, Bank2)" UWORD dez 1 100 0 65535 FORMAT "%8.2" ECU_ADDRESS 0x3FE3B6 /end MEASUREMENT
/begin MEASUREMENT sfpcvvt "Status Fehlerpfad: Diagnose LOCAN-Timeout VVT-Schnittstelle" UWORD dez 1 100 0 65535 FORMAT "%8.2" ECU_ADDRESS 0x3FE3E0 /end MEASUREMENT
/begin MEASUREMENT sfpets "Status Fehlerpfad: Diagnose el.Thermostat-Endstufe" UWORD dez 1 100 0 65535 FORMAT "%8.2" ECU_ADDRESS 0x3FE474 /end MEASUREMENT
/begin MEASUREMENT sfpfrao "Status Fehlerpfad: LR-Adaption oberer multiplikativer Bereich" UWORD dez 1 100 0 65535 FORMAT "%8.2" ECU_ADDRESS 0x3FE48C /end MEASUREMENT
/begin MEASUREMENT sfpfrao2 "Status Fehlerpfad: LR Adaption oberer multiplikativer Bereich (Bank2)" UWORD dez 1 100 0 65535 FORMAT "%8.2" ECU_ADDRESS 0x3FE48E /end MEASUREMENT
/begin MEASUREMENT sfpfrau "Status Fehlerpfad: LR Adaption unterer multiplikativer Bereich" UWORD dez 1 100 0 65535 FORMAT "%8.2" ECU_ADDRESS 0x3FE490 /end MEASUREMENT
/begin MEASUREMENT sfpfrau2 "Status Fehlerpfad: LR Adaption unterer multiplikativer Bereich (Bank2)" UWORD dez 1 100 0 65535 FORMAT "%8.2" ECU_ADDRESS 0x3FE492 /end MEASUREMENT
/begin MEASUREMENT sfpfrst "Status Fehlerpfad: LR-Abweichung" UWORD dez 1 100 0 65535 FORMAT "%8.2" ECU_ADDRESS 0x3FE494 /end MEASUREMENT
/begin MEASUREMENT sfpfrst2 "Status Fehlerpfad: LR-Abweichung Bank 2" UWORD dez 1 100 0 65535 FORMAT "%8.2" ECU_ADDRESS 0x3FE496 /end MEASUREMENT
/begin MEASUREMENT sfpiclsu "Status Fehlerpfad E_ICLSU" UWORD dez 1 100 0 65535 FORMAT "%8.2" ECU_ADDRESS 0x3FE4B4 /end MEASUREMENT
/begin MEASUREMENT sfpiclsu2 "Status Fehlerpfad E_ICLSU, Bank 2" UWORD dez 1 100 0 65535 FORMAT "%8.2" ECU_ADDRESS 0x3FE4B6 /end MEASUREMENT
/begin MEASUREMENT sfpkat "Status Fehlerpfad: Katalysator-‹berwachung" UWORD dez 1 100 0 65535 FORMAT "%8.2" ECU_ADDRESS 0x3FE4B8 /end MEASUREMENT
/begin MEASUREMENT sfpkat2 "Status Fehlerpfad: Katalysator-‹berwachung Bank 2" UWORD dez 1 100 0 65535 FORMAT "%8.2" ECU_ADDRESS 0x3FE4BA /end MEASUREMENT
/begin MEASUREMENT sfpkose "Status Fehlerpfad: Diagnose Klimakompressor-Endstufe" UWORD dez 1 100 0 65535 FORMAT "%8.2" ECU_ADDRESS 0x3FE4BC /end MEASUREMENT
/begin MEASUREMENT sfpkrnt "Status Fehlerpfad: Klopfregelung Nulltest" UWORD dez 1 100 0 65535 FORMAT "%8.2" ECU_ADDRESS 0x3FE4C0 /end MEASUREMENT
/begin MEASUREMENT sfpkrnt2 "Status Fehlerpfad: Klopfregelung Nulltest (zweiter CC195)" UWORD dez 1 100 0 65535 FORMAT "%8.2" ECU_ADDRESS 0x3FE4C2 /end MEASUREMENT
/begin MEASUREMENT sfpkrof "Status Fehlerpfad: Klopfregelung Offset" UWORD dez 1 100 0 65535 FORMAT "%8.2" ECU_ADDRESS 0x3FE4C4 /end MEASUREMENT
/begin MEASUREMENT sfpkrof2 "Status Fehlerpfad: Klopfregelung Offset (zweiter CC195)" UWORD dez 1 100 0 65535 FORMAT "%8.2" ECU_ADDRESS 0x3FE4C6 /end MEASUREMENT
/begin MEASUREMENT sfpkrtp "Status Fehlerpfad: Klopfregelung Testimpuls" UWORD dez 1 100 0 65535 FORMAT "%8.2" ECU_ADDRESS 0x3FE4C8 /end MEASUREMENT
/begin MEASUREMENT sfpkrtp2 "Status Fehlerpfad: Klopfregelung Testimpuls (zweiter CC195)" UWORD dez 1 100 0 65535 FORMAT "%8.2" ECU_ADDRESS 0x3FE4CA /end MEASUREMENT
/begin MEASUREMENT sfpks1 "Status Fehlerpfad: Klopfsensor 1" UWORD dez 1 100 0 65535 FORMAT "%8.2" ECU_ADDRESS 0x3FE4CC /end MEASUREMENT
/begin MEASUREMENT sfpks2 "Status Fehlerpfad: Klopfsensor 2" UWORD dez 1 100 0 65535 FORMAT "%8.2" ECU_ADDRESS 0x3FE4CE /end MEASUREMENT
/begin MEASUREMENT sfpks3 "Status Fehlerpfad: Klopfsensor 3" UWORD dez 1 100 0 65535 FORMAT "%8.2" ECU_ADDRESS 0x3FE4D0 /end MEASUREMENT
/begin MEASUREMENT sfpks4 "Status Fehlerpfad: Klopfsensor 4" UWORD dez 1 100 0 65535 FORMAT "%8.2" ECU_ADDRESS 0x3FE4D2 /end MEASUREMENT
/begin MEASUREMENT sfpkuppl "Status Fehlerpfad KUPPL: Gebergrˆﬂe Kupplung" UWORD dez 1 100 0 65535 FORMAT "%8.2" ECU_ADDRESS 0x3FE4D4 /end MEASUREMENT
/begin MEASUREMENT sfplash "Status Fehlerpfad: Lambdasondenalterung hinter Kat" UWORD dez 1 100 0 65535 FORMAT "%8.2" ECU_ADDRESS 0x3FE4D6 /end MEASUREMENT
/begin MEASUREMENT sfplash2 "Status Fehlerpfad: Lambdasondenalterung hinter Kat Bank2" UWORD dez 1 100 0 65535 FORMAT "%8.2" ECU_ADDRESS 0x3FE4D8 /end MEASUREMENT
/begin MEASUREMENT sfplavh "Status Fehlerpfad: Lambdasondenalterung (Vollastpr¸fung) hinter Kat" UWORD default 1 100 0 65535 FORMAT "%8.2" ECU_ADDRESS 0x3FE4DA /end MEASUREMENT
/begin MEASUREMENT sfplavh2 "Status Fehlerpfad: Lambdasondenalterung(Vollastpr¸fung) hinter Kat Bank2" UWORD default 1 100 0 65535 FORMAT "%8.2" ECU_ADDRESS 0x3FE4DC /end MEASUREMENT
/begin MEASUREMENT sfpllr "Status Fehlerpfad: Leerlaufregelung" UWORD dez 1 100 0 65535 FORMAT "%8.2" ECU_ADDRESS 0x3FE4DE /end MEASUREMENT
/begin MEASUREMENT sfplsh "Status Fehlerpfad: Diagnose Lambdasonde hinter Kat" UWORD dez 1 100 0 65535 FORMAT "%8.2" ECU_ADDRESS 0x3FE4E2 /end MEASUREMENT
/begin MEASUREMENT sfplsh2 "Status Fehlerpfad: Diagnose Lambdasonde hinter Kat Bank2" UWORD dez 1 100 0 65535 FORMAT "%8.2" ECU_ADDRESS 0x3FE4E4 /end MEASUREMENT
/begin MEASUREMENT sfplsuia "Status Fehlerpfad: LSU-Leitung IA: Unterbrechung" UWORD dez 1 100 0 65535 FORMAT "%8.2" ECU_ADDRESS 0x3FE4E6 /end MEASUREMENT
/begin MEASUREMENT sfplsuia2 "Status Fehlerpfad: LSU-Leitung IA defekt, Bank 2" UWORD dez 1 100 0 65535 FORMAT "%8.2" ECU_ADDRESS 0x3FE4E8 /end MEASUREMENT
/begin MEASUREMENT sfplsuip "Status Fehlerpfad: LSU-Leitung IP defekt" UWORD dez 1 100 0 65535 FORMAT "%8.2" ECU_ADDRESS 0x3FE4EA /end MEASUREMENT
/begin MEASUREMENT sfplsuip2 "Status Fehlerpfad: LSU-Leitung IP defekt, Bank2" UWORD dez 1 100 0 65535 FORMAT "%8.2" ECU_ADDRESS 0x3FE4EC /end MEASUREMENT
/begin MEASUREMENT sfplsuks "Status Fehlerpfad: LSU-Leitungen haben Kurzschluﬂ" UWORD dez 1 100 0 65535 FORMAT "%8.2" ECU_ADDRESS 0x3FE4EE /end MEASUREMENT
/begin MEASUREMENT sfplsuks2 "Status Fehlerpfad: LSU-Leitungen haben Kurzschluﬂ, Bank 2" UWORD dez 1 100 0 65535 FORMAT "%8.2" ECU_ADDRESS 0x3FE4F0 /end MEASUREMENT
/begin MEASUREMENT sfplsuun "Status Fehlerpfad: LSU-Leitung UN defekt" UWORD dez 1 100 0 65535 FORMAT "%8.2" ECU_ADDRESS 0x3FE4F2 /end MEASUREMENT
/begin MEASUREMENT sfplsuun2 "Status Fehlerpfad: LSU-Leitung UN defekt, Bank 2" UWORD dez 1 100 0 65535 FORMAT "%8.2" ECU_ADDRESS 0x3FE4F4 /end MEASUREMENT
/begin MEASUREMENT sfplsuvm "Status Fehlerpfad: LSU-Leitung VM defekt" UWORD dez 1 100 0 65535 FORMAT "%8.2" ECU_ADDRESS 0x3FE4F6 /end MEASUREMENT
/begin MEASUREMENT sfplsuvm2 "Status Fehlerpfad: LSU-Leitung VM defekt, Bank 2" UWORD dez 1 100 0 65535 FORMAT "%8.2" ECU_ADDRESS 0x3FE4F8 /end MEASUREMENT
/begin MEASUREMENT sfpmd "Statuswort:  Aussetzer, Summenfehler (multiple)" UWORD dez 1 100 0 65535 FORMAT "%8.2" ECU_ADDRESS 0x3FE500 /end MEASUREMENT
/begin MEASUREMENT sfpmd00 "Statuswort:  Aussetzer Z¸ndung 0" UWORD dez 1 100 0 65535 FORMAT "%8.2" ECU_ADDRESS 0x3FE502 /end MEASUREMENT
/begin MEASUREMENT sfpmd01 "Statuswort:  Aussetzer Z¸ndung 1" UWORD dez 1 100 0 65535 FORMAT "%8.2" ECU_ADDRESS 0x3FE504 /end MEASUREMENT
/begin MEASUREMENT sfpmd02 "Statuswort:  Aussetzer Z¸ndung 2" UWORD dez 1 100 0 65535 FORMAT "%8.2" ECU_ADDRESS 0x3FE506 /end MEASUREMENT
/begin MEASUREMENT sfpmd03 "Statuswort:  Aussetzer Z¸ndung 3" UWORD dez 1 100 0 65535 FORMAT "%8.2" ECU_ADDRESS 0x3FE508 /end MEASUREMENT
/begin MEASUREMENT sfpmd04 "Statuswort:  Aussetzer Z¸ndung 4" UWORD dez 1 100 0 65535 FORMAT "%8.2" ECU_ADDRESS 0x3FE50A /end MEASUREMENT
/begin MEASUREMENT sfpmd05 "Statuswort:  Aussetzer Z¸ndung 5" UWORD dez 1 100 0 65535 FORMAT "%8.2" ECU_ADDRESS 0x3FE50C /end MEASUREMENT
/begin MEASUREMENT sfpmd06 "Statuswort:  Aussetzer Z¸ndung 6" UWORD dez 1 100 0 65535 FORMAT "%8.2" ECU_ADDRESS 0x3FE50E /end MEASUREMENT
/begin MEASUREMENT sfpmd07 "Statuswort:  Aussetzer Z¸ndung 7" UWORD dez 1 100 0 65535 FORMAT "%8.2" ECU_ADDRESS 0x3FE510 /end MEASUREMENT
/begin MEASUREMENT sfpmd08 "Statuswort:  Aussetzer Z¸ndung 8" UWORD dez 1 100 0 65535 FORMAT "%8.2" ECU_ADDRESS 0x3FE512 /end MEASUREMENT
/begin MEASUREMENT sfpmd09 "Statuswort:  Aussetzer Z¸ndung 9" UWORD dez 1 100 0 65535 FORMAT "%8.2" ECU_ADDRESS 0x3FE514 /end MEASUREMENT
/begin MEASUREMENT sfpmd10 "Statuswort:  Aussetzer Z¸ndung 10" UWORD dez 1 100 0 65535 FORMAT "%8.2" ECU_ADDRESS 0x3FE516 /end MEASUREMENT
/begin MEASUREMENT sfpmd11 "Statuswort:  Aussetzer Z¸ndung 11" UWORD dez 1 100 0 65535 FORMAT "%8.2" ECU_ADDRESS 0x3FE518 /end MEASUREMENT
/begin MEASUREMENT sfpmle "Status Fehlerpfad: MLE - Endstufe" UWORD dez 1 100 0 65535 FORMAT "%8.2" ECU_ADDRESS 0x3FE520 /end MEASUREMENT
/begin MEASUREMENT sfpnvrbup "Status Fehlerpfad: NVRAM-Backup" UWORD dez 1 100 0 65535 FORMAT "%8.2" ECU_ADDRESS 0x3FE526 /end MEASUREMENT
/begin MEASUREMENT sfprkat "Status Fehlerpfad: LR Adaption additive Korrektur pro Zeit" UWORD dez 1 100 0 65535 FORMAT "%8.2" ECU_ADDRESS 0x3FE544 /end MEASUREMENT
/begin MEASUREMENT sfprkat2 "Status Fehlerpfad: LR Adaption additive Korrektur pro Zeit (Bank 2)" UWORD dez 1 100 0 65535 FORMAT "%8.2" ECU_ADDRESS 0x3FE546 /end MEASUREMENT
/begin MEASUREMENT sfprkaz "Status Fehlerpfad: LR Adaption additive Korrektur pro Z¸ndung" UWORD dez 1 100 0 65535 FORMAT "%8.2" ECU_ADDRESS 0x3FE548 /end MEASUREMENT
/begin MEASUREMENT sfprkaz2 "Status Fehlerpfad: LR Adaption additive Korrektur pro Z¸ndung (Bank 2)" UWORD dez 1 100 0 65535 FORMAT "%8.2" ECU_ADDRESS 0x3FE54A /end MEASUREMENT
/begin MEASUREMENT TYP_anws "" UWORD B_TRUE 1 100 0 1 BIT_MASK 0xf00 FORMAT "%13.11" ECU_ADDRESS 0x3FE3B4 /end MEASUREMENT
/begin MEASUREMENT TYP_anws2 "" UWORD B_TRUE 1 100 0 1 BIT_MASK 0xf00 FORMAT "%13.11" ECU_ADDRESS 0x3FE3B6 /end MEASUREMENT
/begin MEASUREMENT TYP_cvvt "" UWORD B_TRUE 1 100 0 1 BIT_MASK 0xf00 FORMAT "%13.11" ECU_ADDRESS 0x3FE3E0 /end MEASUREMENT
/begin MEASUREMENT TYP_ets "" UWORD B_TRUE 1 100 0 1 BIT_MASK 0xf00 FORMAT "%13.11" ECU_ADDRESS 0x3FE474 /end MEASUREMENT
/begin MEASUREMENT TYP_frao "" UWORD B_TRUE 1 100 0 1 BIT_MASK 0xf00 FORMAT "%13.11" ECU_ADDRESS 0x3FE48C /end MEASUREMENT
/begin MEASUREMENT TYP_frao2 "" UWORD B_TRUE 1 100 0 1 BIT_MASK 0xf00 FORMAT "%13.11" ECU_ADDRESS 0x3FE48E /end MEASUREMENT
/begin MEASUREMENT TYP_frau "" UWORD B_TRUE 1 100 0 1 BIT_MASK 0xf00 FORMAT "%13.11" ECU_ADDRESS 0x3FE490 /end MEASUREMENT
/begin MEASUREMENT TYP_frau2 "" UWORD B_TRUE 1 100 0 1 BIT_MASK 0xf00 FORMAT "%13.11" ECU_ADDRESS 0x3FE492 /end MEASUREMENT
/begin MEASUREMENT TYP_frst "" UWORD B_TRUE 1 100 0 1 BIT_MASK 0xf00 FORMAT "%13.11" ECU_ADDRESS 0x3FE494 /end MEASUREMENT
/begin MEASUREMENT TYP_frst2 "" UWORD B_TRUE 1 100 0 1 BIT_MASK 0xf00 FORMAT "%13.11" ECU_ADDRESS 0x3FE496 /end MEASUREMENT
/begin MEASUREMENT TYP_iclsu "" UWORD B_TRUE 1 100 0 1 BIT_MASK 0xf00 FORMAT "%13.11" ECU_ADDRESS 0x3FE4B4 /end MEASUREMENT
/begin MEASUREMENT TYP_iclsu2 "" UWORD B_TRUE 1 100 0 1 BIT_MASK 0xf00 FORMAT "%13.11" ECU_ADDRESS 0x3FE4B6 /end MEASUREMENT
/begin MEASUREMENT TYP_kat "Fehlertyp: Katalysator-Diagnose" UWORD B_TRUE 1 100 0 1 BIT_MASK 0xf00 FORMAT "%13.11" ECU_ADDRESS 0x3FE4B8 /end MEASUREMENT
/begin MEASUREMENT TYP_kat2 "" UWORD B_TRUE 1 100 0 1 BIT_MASK 0xf00 FORMAT "%13.11" ECU_ADDRESS 0x3FE4BA /end MEASUREMENT
/begin MEASUREMENT TYP_kose "" UWORD B_TRUE 1 100 0 1 BIT_MASK 0xf00 FORMAT "%13.11" ECU_ADDRESS 0x3FE4BC /end MEASUREMENT
/begin MEASUREMENT TYP_krnt "" UWORD B_TRUE 1 100 0 1 BIT_MASK 0xf00 FORMAT "%13.11" ECU_ADDRESS 0x3FE4C0 /end MEASUREMENT
/begin MEASUREMENT TYP_krnt2 "" UWORD B_TRUE 1 100 0 1 BIT_MASK 0xf00 FORMAT "%13.11" ECU_ADDRESS 0x3FE4C2 /end MEASUREMENT
/begin MEASUREMENT TYP_krof "" UWORD B_TRUE 1 100 0 1 BIT_MASK 0xf00 FORMAT "%13.11" ECU_ADDRESS 0x3FE4C4 /end MEASUREMENT
/begin MEASUREMENT TYP_krof2 "" UWORD B_TRUE 1 100 0 1 BIT_MASK 0xf00 FORMAT "%13.11" ECU_ADDRESS 0x3FE4C6 /end MEASUREMENT
/begin MEASUREMENT TYP_krtp "" UWORD B_TRUE 1 100 0 1 BIT_MASK 0xf00 FORMAT "%13.11" ECU_ADDRESS 0x3FE4C8 /end MEASUREMENT
/begin MEASUREMENT TYP_krtp2 "" UWORD B_TRUE 1 100 0 1 BIT_MASK 0xf00 FORMAT "%13.11" ECU_ADDRESS 0x3FE4CA /end MEASUREMENT
/begin MEASUREMENT TYP_ks1 "" UWORD B_TRUE 1 100 0 1 BIT_MASK 0xf00 FORMAT "%13.11" ECU_ADDRESS 0x3FE4CC /end MEASUREMENT
/begin MEASUREMENT TYP_ks2 "" UWORD B_TRUE 1 100 0 1 BIT_MASK 0xf00 FORMAT "%13.11" ECU_ADDRESS 0x3FE4CE /end MEASUREMENT
/begin MEASUREMENT TYP_ks3 "" UWORD B_TRUE 1 100 0 1 BIT_MASK 0xf00 FORMAT "%13.11" ECU_ADDRESS 0x3FE4D0 /end MEASUREMENT
/begin MEASUREMENT TYP_ks4 "" UWORD B_TRUE 1 100 0 1 BIT_MASK 0xf00 FORMAT "%13.11" ECU_ADDRESS 0x3FE4D2 /end MEASUREMENT
/begin MEASUREMENT TYP_kuppl "Fehlertyp: Gebergrˆﬂe Kupplungsschalter" UWORD B_TRUE 1 100 0 1 BIT_MASK 0xf00 FORMAT "%13.11" ECU_ADDRESS 0x3FE4D4 /end MEASUREMENT
/begin MEASUREMENT TYP_lash "Fehlertyp: Lambda- Sondenalterung hinter Kat" UWORD B_TRUE 1 100 0 1 BIT_MASK 0xf00 FORMAT "%13.11" ECU_ADDRESS 0x3FE4D6 /end MEASUREMENT
/begin MEASUREMENT TYP_lash2 "Fehlertyp: Lambda-Sondenalterung hinter Kat Bank2" UWORD B_TRUE 1 100 0 1 BIT_MASK 0xf00 FORMAT "%13.11" ECU_ADDRESS 0x3FE4D8 /end MEASUREMENT
/begin MEASUREMENT TYP_lavh "" UWORD B_TRUE 1 100 0 1 BIT_MASK 0xf00 FORMAT "%13.11" ECU_ADDRESS 0x3FE4DA /end MEASUREMENT
/begin MEASUREMENT TYP_lavh2 "" UWORD B_TRUE 1 100 0 1 BIT_MASK 0xf00 FORMAT "%13.11" ECU_ADDRESS 0x3FE4DC /end MEASUREMENT
/begin MEASUREMENT TYP_LLR "" UWORD B_TRUE 1 100 0 1 BIT_MASK 0xf00 FORMAT "%13.11" ECU_ADDRESS 0x3FE4DE /end MEASUREMENT
/begin MEASUREMENT TYP_lsh "Fehlertyp: Lambdasonde 1 hinter Kat" UWORD B_TRUE 1 100 0 1 BIT_MASK 0xf00 FORMAT "%13.11" ECU_ADDRESS 0x3FE4E2 /end MEASUREMENT
/begin MEASUREMENT TYP_lsh2 "Fehlertyp: Lambdasonde 2 hinter Kat" UWORD B_TRUE 1 100 0 1 BIT_MASK 0xf00 FORMAT "%13.11" ECU_ADDRESS 0x3FE4E4 /end MEASUREMENT
/begin MEASUREMENT TYP_lsuia "" UWORD B_TRUE 1 100 0 1 BIT_MASK 0xf00 FORMAT "%13.11" ECU_ADDRESS 0x3FE4E6 /end MEASUREMENT
/begin MEASUREMENT TYP_lsuia2 "" UWORD B_TRUE 1 100 0 1 BIT_MASK 0xf00 FORMAT "%13.11" ECU_ADDRESS 0x3FE4E8 /end MEASUREMENT
/begin MEASUREMENT TYP_lsuip "" UWORD B_TRUE 1 100 0 1 BIT_MASK 0xf00 FORMAT "%13.11" ECU_ADDRESS 0x3FE4EA /end MEASUREMENT
/begin MEASUREMENT TYP_lsuip2 "" UWORD B_TRUE 1 100 0 1 BIT_MASK 0xf00 FORMAT "%13.11" ECU_ADDRESS 0x3FE4EC /end MEASUREMENT
/begin MEASUREMENT TYP_lsuks "" UWORD B_TRUE 1 100 0 1 BIT_MASK 0xf00 FORMAT "%13.11" ECU_ADDRESS 0x3FE4EE /end MEASUREMENT
/begin MEASUREMENT TYP_lsuks2 "" UWORD B_TRUE 1 100 0 1 BIT_MASK 0xf00 FORMAT "%13.11" ECU_ADDRESS 0x3FE4F0 /end MEASUREMENT
/begin MEASUREMENT TYP_lsuun "" UWORD B_TRUE 1 100 0 1 BIT_MASK 0xf00 FORMAT "%13.11" ECU_ADDRESS 0x3FE4F2 /end MEASUREMENT
/begin MEASUREMENT TYP_lsuun2 "" UWORD B_TRUE 1 100 0 1 BIT_MASK 0xf00 FORMAT "%13.11" ECU_ADDRESS 0x3FE4F4 /end MEASUREMENT
/begin MEASUREMENT TYP_lsuvm "" UWORD B_TRUE 1 100 0 1 BIT_MASK 0xf00 FORMAT "%13.11" ECU_ADDRESS 0x3FE4F6 /end MEASUREMENT
/begin MEASUREMENT TYP_lsuvm2 "" UWORD B_TRUE 1 100 0 1 BIT_MASK 0xf00 FORMAT "%13.11" ECU_ADDRESS 0x3FE4F8 /end MEASUREMENT
/begin MEASUREMENT TYP_md "Fehlertyp:  Aussetzer, Summenfehler (multiple)" UWORD B_TRUE 1 100 0 1 BIT_MASK 0xf00 FORMAT "%13.11" ECU_ADDRESS 0x3FE500 /end MEASUREMENT
/begin MEASUREMENT TYP_md00 "Fehlertyp:  Aussetzer Z¸ndung 0" UWORD B_TRUE 1 100 0 1 BIT_MASK 0xf00 FORMAT "%13.11" ECU_ADDRESS 0x3FE502 /end MEASUREMENT
/begin MEASUREMENT TYP_md01 "Fehlertyp:  Aussetzer Z¸ndung 1" UWORD B_TRUE 1 100 0 1 BIT_MASK 0xf00 FORMAT "%13.11" ECU_ADDRESS 0x3FE504 /end MEASUREMENT
/begin MEASUREMENT TYP_md02 "Fehlertyp:  Aussetzer Z¸ndung 2" UWORD B_TRUE 1 100 0 1 BIT_MASK 0xf00 FORMAT "%13.11" ECU_ADDRESS 0x3FE506 /end MEASUREMENT
/begin MEASUREMENT TYP_md03 "Fehlertyp:  Aussetzer Z¸ndung 3" UWORD B_TRUE 1 100 0 1 BIT_MASK 0xf00 FORMAT "%13.11" ECU_ADDRESS 0x3FE508 /end MEASUREMENT
/begin MEASUREMENT TYP_md04 "Fehlertyp:  Aussetzer Z¸ndung 4" UWORD B_TRUE 1 100 0 1 BIT_MASK 0xf00 FORMAT "%13.11" ECU_ADDRESS 0x3FE50A /end MEASUREMENT
/begin MEASUREMENT TYP_md05 "Fehlertyp:  Aussetzer Z¸ndung 5" UWORD B_TRUE 1 100 0 1 BIT_MASK 0xf00 FORMAT "%13.11" ECU_ADDRESS 0x3FE50C /end MEASUREMENT
/begin MEASUREMENT TYP_md06 "Fehlertyp:  Aussetzer Z¸ndung 6" UWORD B_TRUE 1 100 0 1 BIT_MASK 0xf00 FORMAT "%13.11" ECU_ADDRESS 0x3FE50E /end MEASUREMENT
/begin MEASUREMENT TYP_md07 "Fehlertyp:  Aussetzer Z¸ndung 7" UWORD B_TRUE 1 100 0 1 BIT_MASK 0xf00 FORMAT "%13.11" ECU_ADDRESS 0x3FE510 /end MEASUREMENT
/begin MEASUREMENT TYP_md08 "Fehlertyp:  Aussetzer Z¸ndung 8" UWORD B_TRUE 1 100 0 1 BIT_MASK 0xf00 FORMAT "%13.11" ECU_ADDRESS 0x3FE512 /end MEASUREMENT
/begin MEASUREMENT TYP_md09 "Fehlertyp:  Aussetzer Z¸ndung 9" UWORD B_TRUE 1 100 0 1 BIT_MASK 0xf00 FORMAT "%13.11" ECU_ADDRESS 0x3FE514 /end MEASUREMENT
/begin MEASUREMENT TYP_md10 "Fehlertyp:  Aussetzer Z¸ndung 10" UWORD B_TRUE 1 100 0 1 BIT_MASK 0xf00 FORMAT "%13.11" ECU_ADDRESS 0x3FE516 /end MEASUREMENT
/begin MEASUREMENT TYP_md11 "Fehlertyp:  Aussetzer Z¸ndung 11" UWORD B_TRUE 1 100 0 1 BIT_MASK 0xf00 FORMAT "%13.11" ECU_ADDRESS 0x3FE518 /end MEASUREMENT
/begin MEASUREMENT TYP_mle "" UWORD B_TRUE 1 100 0 1 BIT_MASK 0xf00 FORMAT "%13.11" ECU_ADDRESS 0x3FE520 /end MEASUREMENT
/begin MEASUREMENT TYP_nvrbup "" UWORD B_TRUE 1 100 0 1 BIT_MASK 0xf00 FORMAT "%13.11" ECU_ADDRESS 0x3FE526 /end MEASUREMENT
/begin MEASUREMENT TYP_rkat "" UWORD B_TRUE 1 100 0 1 BIT_MASK 0xf00 FORMAT "%13.11" ECU_ADDRESS 0x3FE544 /end MEASUREMENT
/begin MEASUREMENT TYP_rkat2 "" UWORD B_TRUE 1 100 0 1 BIT_MASK 0xf00 FORMAT "%13.11" ECU_ADDRESS 0x3FE546 /end MEASUREMENT
/begin MEASUREMENT TYP_rkaz "" UWORD B_TRUE 1 100 0 1 BIT_MASK 0xf00 FORMAT "%13.11" ECU_ADDRESS 0x3FE548 /end MEASUREMENT
/begin MEASUREMENT TYP_rkaz2 "" UWORD B_TRUE 1 100 0 1 BIT_MASK 0xf00 FORMAT "%13.11" ECU_ADDRESS 0x3FE54A /end MEASUREMENT
/begin MEASUREMENT Z_anws "Zyklusflag: Nockenwellensteuerung (Auslaﬂ,Bank1)" UWORD B_TRUE 1 100 0 1 BIT_MASK 0x2 FORMAT "%13.11" ECU_ADDRESS 0x3FE3B4 /end MEASUREMENT
/begin MEASUREMENT Z_anws2 "Zyklusflag: Nockenwellensteuerung (Auslaﬂ,Bank2)" UWORD B_TRUE 1 100 0 1 BIT_MASK 0x2 FORMAT "%13.11" ECU_ADDRESS 0x3FE3B6 /end MEASUREMENT
/begin MEASUREMENT Z_cvvt "Zyklusflag: LOCAN-Schnittstelle, Timeout VVT-SG" UWORD B_TRUE 1 100 0 1 BIT_MASK 0x2 FORMAT "%13.11" ECU_ADDRESS 0x3FE3E0 /end MEASUREMENT
/begin MEASUREMENT Z_ets "Zyklusflag: elektronisches Thermostat" UWORD B_TRUE 1 100 0 1 BIT_MASK 0x2 FORMAT "%13.11" ECU_ADDRESS 0x3FE474 /end MEASUREMENT
/begin MEASUREMENT Z_frao "Zyklusflag:LR-Adaption oberer multiplikativer Bereich" UWORD B_TRUE 1 100 0 1 BIT_MASK 0x2 FORMAT "%13.11" ECU_ADDRESS 0x3FE48C /end MEASUREMENT
/begin MEASUREMENT Z_frao2 "Zyklusflag:LR-Adaption oberer multiplikativer Bereich Bank2" UWORD B_TRUE 1 100 0 1 BIT_MASK 0x2 FORMAT "%13.11" ECU_ADDRESS 0x3FE48E /end MEASUREMENT
/begin MEASUREMENT Z_frau "Zyklusflag:LR-Adaption unterer multiplikativer Bereich" UWORD B_TRUE 1 100 0 1 BIT_MASK 0x2 FORMAT "%13.11" ECU_ADDRESS 0x3FE490 /end MEASUREMENT
/begin MEASUREMENT Z_frau2 "Zyklusflag:LR-Adaption unterer multiplikativer Bereich Bank 2" UWORD B_TRUE 1 100 0 1 BIT_MASK 0x2 FORMAT "%13.11" ECU_ADDRESS 0x3FE492 /end MEASUREMENT
/begin MEASUREMENT Z_frst "Zyklusmeldung Diagnose Kraftstoffversorgungssystem (Kurztest)" UWORD B_TRUE 1 100 0 1 BIT_MASK 0x2 FORMAT "%13.11" ECU_ADDRESS 0x3FE494 /end MEASUREMENT
/begin MEASUREMENT Z_frst2 "Zyklusmeldung Diagnose Kraftstoffversorgungssystem (Kurztest Bank 2)" UWORD B_TRUE 1 100 0 1 BIT_MASK 0x2 FORMAT "%13.11" ECU_ADDRESS 0x3FE496 /end MEASUREMENT
/begin MEASUREMENT Z_iclsu "Zyklusflag: Auswerte-IC f¸r die LSU" UWORD B_TRUE 1 100 0 1 BIT_MASK 0x2 FORMAT "%13.11" ECU_ADDRESS 0x3FE4B4 /end MEASUREMENT
/begin MEASUREMENT Z_iclsu2 "Zyklusflag: Auswerte-IC f¸r die LSU, Bank 2" UWORD B_TRUE 1 100 0 1 BIT_MASK 0x2 FORMAT "%13.11" ECU_ADDRESS 0x3FE4B6 /end MEASUREMENT
/begin MEASUREMENT Z_kat "Zyklusflag:	Katalysator-Konvertierung" UWORD B_TRUE 1 100 0 1 BIT_MASK 0x2 FORMAT "%13.11" ECU_ADDRESS 0x3FE4B8 /end MEASUREMENT
/begin MEASUREMENT Z_kat2 "Zyklusflag:	Katalysator-Konvertierung	(Bank 2)" UWORD B_TRUE 1 100 0 1 BIT_MASK 0x2 FORMAT "%13.11" ECU_ADDRESS 0x3FE4BA /end MEASUREMENT
/begin MEASUREMENT Z_kose "Zyklusflag:Klimakompressorsteuerung, Endstufe" UWORD B_TRUE 1 100 0 1 BIT_MASK 0x2 FORMAT "%13.11" ECU_ADDRESS 0x3FE4BC /end MEASUREMENT
/begin MEASUREMENT Z_krnt "Zyklusflag: Klopfregelung Nulltest" UWORD B_TRUE 1 100 0 1 BIT_MASK 0x2 FORMAT "%13.11" ECU_ADDRESS 0x3FE4C0 /end MEASUREMENT
/begin MEASUREMENT Z_krnt2 "Zyklusflag: Klopfregelung Nulltest (zweiter CC195)" UWORD B_TRUE 1 100 0 1 BIT_MASK 0x2 FORMAT "%13.11" ECU_ADDRESS 0x3FE4C2 /end MEASUREMENT
/begin MEASUREMENT Z_krof "Zyklusflag: Klopfregelung Offset" UWORD B_TRUE 1 100 0 1 BIT_MASK 0x2 FORMAT "%13.11" ECU_ADDRESS 0x3FE4C4 /end MEASUREMENT
/begin MEASUREMENT Z_krof2 "Zyklusflag:  Klopfregelung Offset (zweiter CC195)" UWORD B_TRUE 1 100 0 1 BIT_MASK 0x2 FORMAT "%13.11" ECU_ADDRESS 0x3FE4C6 /end MEASUREMENT
/begin MEASUREMENT Z_krtp "Zyklusflag: Klopfregelung Testimpuls" UWORD B_TRUE 1 100 0 1 BIT_MASK 0x2 FORMAT "%13.11" ECU_ADDRESS 0x3FE4C8 /end MEASUREMENT
/begin MEASUREMENT Z_krtp2 "Zyklusflag: Klopfregelung Testimpuls (zweiter CC195)" UWORD B_TRUE 1 100 0 1 BIT_MASK 0x2 FORMAT "%13.11" ECU_ADDRESS 0x3FE4CA /end MEASUREMENT
/begin MEASUREMENT Z_ks1 "Zyklusflag: Klopfsensor 1" UWORD B_TRUE 1 100 0 1 BIT_MASK 0x2 FORMAT "%13.11" ECU_ADDRESS 0x3FE4CC /end MEASUREMENT
/begin MEASUREMENT Z_ks2 "Zyklusflag: Klopfsensor 2" UWORD B_TRUE 1 100 0 1 BIT_MASK 0x2 FORMAT "%13.11" ECU_ADDRESS 0x3FE4CE /end MEASUREMENT
/begin MEASUREMENT Z_ks3 "Zyklusflag: Klopfsensor 3" UWORD B_TRUE 1 100 0 1 BIT_MASK 0x2 FORMAT "%13.11" ECU_ADDRESS 0x3FE4D0 /end MEASUREMENT
/begin MEASUREMENT Z_ks4 "Zyklusflag: Klopfsensor 4" UWORD B_TRUE 1 100 0 1 BIT_MASK 0x2 FORMAT "%13.11" ECU_ADDRESS 0x3FE4D2 /end MEASUREMENT
/begin MEASUREMENT Z_kuppl "Zyklusflag: Kupplung betaetigt" UWORD B_TRUE 1 100 0 1 BIT_MASK 0x2 FORMAT "%13.11" ECU_ADDRESS 0x3FE4D4 /end MEASUREMENT
/begin MEASUREMENT Z_lash "Zyklusflag:Lambda-Sondenalterung hinter Kat." UWORD B_TRUE 1 100 0 1 BIT_MASK 0x2 FORMAT "%13.11" ECU_ADDRESS 0x3FE4D6 /end MEASUREMENT
/begin MEASUREMENT Z_lash2 "Zyklusflag:	Lambda-Sondenalterung hinter Kat. (Bank 2)" UWORD B_TRUE 1 100 0 1 BIT_MASK 0x2 FORMAT "%13.11" ECU_ADDRESS 0x3FE4D8 /end MEASUREMENT
/begin MEASUREMENT Z_lavh "Zyklusflag:Lambda-Sondenalterung im Vollast hinter Kat." UWORD B_TRUE 1 100 0 1 BIT_MASK 0x2 FORMAT "%13.11" ECU_ADDRESS 0x3FE4DA /end MEASUREMENT
/begin MEASUREMENT Z_lavh2 "Zyklusflag:Lambda-Sondenalterung im Vollast hinter Kat. Bank2" UWORD B_TRUE 1 100 0 1 BIT_MASK 0x2 FORMAT "%13.11" ECU_ADDRESS 0x3FE4DC /end MEASUREMENT
/begin MEASUREMENT Z_llr "Zyklusflag: Diagnose Leerlaufregelung, Steller" UWORD B_TRUE 1 100 0 1 BIT_MASK 0x2 FORMAT "%13.11" ECU_ADDRESS 0x3FE4DE /end MEASUREMENT
/begin MEASUREMENT Z_lsh "Zyklusflag: Lambda-Sonde hinter Kat" UWORD B_TRUE 1 100 0 1 BIT_MASK 0x2 FORMAT "%13.11" ECU_ADDRESS 0x3FE4E2 /end MEASUREMENT
/begin MEASUREMENT Z_lsh2 "Zyklusflag: Lambda-Sonde hinter Kat Bank2" UWORD B_TRUE 1 100 0 1 BIT_MASK 0x2 FORMAT "%13.11" ECU_ADDRESS 0x3FE4E4 /end MEASUREMENT
/begin MEASUREMENT Z_lsuia "Zyklusflag: Diagnose Lambdasondenleitung an Bond IA" UWORD B_TRUE 1 100 0 1 BIT_MASK 0x2 FORMAT "%13.11" ECU_ADDRESS 0x3FE4E6 /end MEASUREMENT
/begin MEASUREMENT Z_lsuia2 "Zyklusflag: Diagnose Lambdasondenleitung an Bond IA, Bank 2" UWORD B_TRUE 1 100 0 1 BIT_MASK 0x2 FORMAT "%13.11" ECU_ADDRESS 0x3FE4E8 /end MEASUREMENT
/begin MEASUREMENT Z_lsuip "Zyklusflag:  Leitungsunterbrechung an ip" UWORD B_TRUE 1 100 0 1 BIT_MASK 0x2 FORMAT "%13.11" ECU_ADDRESS 0x3FE4EA /end MEASUREMENT
/begin MEASUREMENT Z_lsuip2 "Zyklusflag:  Leitungsunterbrechung an ip, Bank 2" UWORD B_TRUE 1 100 0 1 BIT_MASK 0x2 FORMAT "%13.11" ECU_ADDRESS 0x3FE4EC /end MEASUREMENT
/begin MEASUREMENT Z_lsuks "Zyklusflag:  Kurzschluﬂ Sondenleitung" UWORD B_TRUE 1 100 0 1 BIT_MASK 0x2 FORMAT "%13.11" ECU_ADDRESS 0x3FE4EE /end MEASUREMENT
/begin MEASUREMENT Z_lsuks2 "Zyklusflag:  Kurzschluﬂ Sondenleitung, Bank 2" UWORD B_TRUE 1 100 0 1 BIT_MASK 0x2 FORMAT "%13.11" ECU_ADDRESS 0x3FE4F0 /end MEASUREMENT
/begin MEASUREMENT Z_lsuun "Zyklusflag: Diagnose Lambdasondenleitung an Bond UN" UWORD B_TRUE 1 100 0 1 BIT_MASK 0x2 FORMAT "%13.11" ECU_ADDRESS 0x3FE4F2 /end MEASUREMENT
/begin MEASUREMENT Z_lsuun2 "Zyklusflag: Diagnose Lambdasondenleitung an Bond UN, Bank 2" UWORD B_TRUE 1 100 0 1 BIT_MASK 0x2 FORMAT "%13.11" ECU_ADDRESS 0x3FE4F4 /end MEASUREMENT
/begin MEASUREMENT Z_lsuvm "Zyklusflag: Diagnose Lambdasondenleitung an Bond VM" UWORD B_TRUE 1 100 0 1 BIT_MASK 0x2 FORMAT "%13.11" ECU_ADDRESS 0x3FE4F6 /end MEASUREMENT
/begin MEASUREMENT Z_lsuvm2 "Zyklusflag: Diagnose Lambdasondenleitung an Bond VM, Bank 2" UWORD B_TRUE 1 100 0 1 BIT_MASK 0x2 FORMAT "%13.11" ECU_ADDRESS 0x3FE4F8 /end MEASUREMENT
/begin MEASUREMENT Z_md "Zyklusflag: Aussetzer, Summenfehler (multiple)" UWORD B_TRUE 1 100 0 1 BIT_MASK 0x2 FORMAT "%13.11" ECU_ADDRESS 0x3FE500 /end MEASUREMENT
/begin MEASUREMENT Z_md00 "Zyklusflag: Aussetzer Z¸ndung 0" UWORD B_TRUE 1 100 0 1 BIT_MASK 0x2 FORMAT "%13.11" ECU_ADDRESS 0x3FE502 /end MEASUREMENT
/begin MEASUREMENT Z_md01 "Zyklusflag: Aussetzer Z¸ndung 1" UWORD B_TRUE 1 100 0 1 BIT_MASK 0x2 FORMAT "%13.11" ECU_ADDRESS 0x3FE504 /end MEASUREMENT
/begin MEASUREMENT Z_md02 "Zyklusflag: Aussetzer Z¸ndung 2" UWORD B_TRUE 1 100 0 1 BIT_MASK 0x2 FORMAT "%13.11" ECU_ADDRESS 0x3FE506 /end MEASUREMENT
/begin MEASUREMENT Z_md03 "Zyklusflag: Aussetzer Z¸ndung 3" UWORD B_TRUE 1 100 0 1 BIT_MASK 0x2 FORMAT "%13.11" ECU_ADDRESS 0x3FE508 /end MEASUREMENT
/begin MEASUREMENT Z_md04 "Zyklusflag: Aussetzer Z¸ndung 4" UWORD B_TRUE 1 100 0 1 BIT_MASK 0x2 FORMAT "%13.11" ECU_ADDRESS 0x3FE50A /end MEASUREMENT
/begin MEASUREMENT Z_md05 "Zyklusflag: Aussetzer Z¸ndung 5" UWORD B_TRUE 1 100 0 1 BIT_MASK 0x2 FORMAT "%13.11" ECU_ADDRESS 0x3FE50C /end MEASUREMENT
/begin MEASUREMENT Z_md06 "Zyklusflag: Aussetzer Z¸ndung 6" UWORD B_TRUE 1 100 0 1 BIT_MASK 0x2 FORMAT "%13.11" ECU_ADDRESS 0x3FE50E /end MEASUREMENT
/begin MEASUREMENT Z_md07 "Zyklusflag: Aussetzer Z¸ndung 7" UWORD B_TRUE 1 100 0 1 BIT_MASK 0x2 FORMAT "%13.11" ECU_ADDRESS 0x3FE510 /end MEASUREMENT
/begin MEASUREMENT Z_md08 "Zyklusflag: Aussetzer Z¸ndung 8" UWORD B_TRUE 1 100 0 1 BIT_MASK 0x2 FORMAT "%13.11" ECU_ADDRESS 0x3FE512 /end MEASUREMENT
/begin MEASUREMENT Z_md09 "Zyklusflag: Aussetzer Z¸ndung 9" UWORD B_TRUE 1 100 0 1 BIT_MASK 0x2 FORMAT "%13.11" ECU_ADDRESS 0x3FE514 /end MEASUREMENT
/begin MEASUREMENT Z_md10 "Zyklusflag: Aussetzer Z¸ndung 10" UWORD B_TRUE 1 100 0 1 BIT_MASK 0x2 FORMAT "%13.11" ECU_ADDRESS 0x3FE516 /end MEASUREMENT
/begin MEASUREMENT Z_md11 "Zyklusflag: Aussetzer Z¸ndung 11" UWORD B_TRUE 1 100 0 1 BIT_MASK 0x2 FORMAT "%13.11" ECU_ADDRESS 0x3FE518 /end MEASUREMENT
/begin MEASUREMENT Z_mle "Zyklusflag: L¸fterendstufe" UWORD B_TRUE 1 100 0 1 BIT_MASK 0x2 FORMAT "%13.11" ECU_ADDRESS 0x3FE520 /end MEASUREMENT
/begin MEASUREMENT Z_nvrbup "Zyklusflag: NVRAM-Backup Schreib-/Lese-Fehler" UWORD B_TRUE 1 100 0 1 BIT_MASK 0x2 FORMAT "%13.11" ECU_ADDRESS 0x3FE526 /end MEASUREMENT
/begin MEASUREMENT Z_rkat "Zyklusflag:LR-Adaption additiv pro Zeit" UWORD B_TRUE 1 100 0 1 BIT_MASK 0x2 FORMAT "%13.11" ECU_ADDRESS 0x3FE544 /end MEASUREMENT
/begin MEASUREMENT Z_rkat2 "Zyklusflag:LR-Adaption additiv pro Zeit Bank 2" UWORD B_TRUE 1 100 0 1 BIT_MASK 0x2 FORMAT "%13.11" ECU_ADDRESS 0x3FE546 /end MEASUREMENT
/begin MEASUREMENT Z_rkaz "Zyklusflag:LR-Adaption additiv pro Einspritzung" UWORD B_TRUE 1 100 0 1 BIT_MASK 0x2 FORMAT "%13.11" ECU_ADDRESS 0x3FE548 /end MEASUREMENT
/begin MEASUREMENT Z_rkaz2 "Zyklusflag:LR-Adaption additiv pro Einspritzung Bank 2" UWORD B_TRUE 1 100 0 1 BIT_MASK 0x2 FORMAT "%13.11" ECU_ADDRESS 0x3FE54A /end MEASUREMENT
/begin FUNCTION DFPM_DICLSU ""
 /begin DEF_CHARACTERISTIC CDCICLSU CDCICLSU2 CDCLSUIA CDCLSUIA2 CDCLSUIP CDCLSUIP2 CDCLSUKS CDCLSUKS2 CDCLSUUN CDCLSUUN2 CDCLSUVM CDCLSUVM2 CDKICLSU CDKICLSU2 CDKLSUIA CDKLSUIA2 CDKLSUIP CDKLSUIP2 CDKLSUKS CDKLSUKS2 CDKLSUUN CDKLSUUN2 CDKLSUVM CDKLSUVM2 CDTICLSU CDTICLSU2 CDTLSUIA CDTLSUIA2 CDTLSUIP CDTLSUIP2 CDTLSUKS CDTLSUKS2 CDTLSUUN CDTLSUUN2 CDTLSUVM CDTLSUVM2 CLAICLSU CLAICLSU2 CLALSUIA CLALSUIA2 CLALSUIP CLALSUIP2 CLALSUKS CLALSUKS2 CLALSUUN CLALSUUN2 CLALSUVM CLALSUVM2 FFTICLSU FFTICLSU2 FFTLSUIA FFTLSUIA2 FFTLSUIP FFTLSUIP2 FFTLSUKS FFTLSUKS2 FFTLSUUN FFTLSUUN2 FFTLSUVM FFTLSUVM2 TSFICLSU TSFICLSU2 TSFLSUIA TSFLSUIA2 TSFLSUIP TSFLSUIP2 TSFLSUKS TSFLSUKS2 TSFLSUUN TSFLSUUN2 TSFLSUVM TSFLSUVM2 /end DEF_CHARACTERISTIC
 /begin OUT_MEASUREMENT B_beiclsu B_beiclsu2 B_belsuia B_belsuia2 B_belsuip B_belsuip2 B_belsuks B_belsuks2 B_belsuun B_belsuun2 B_belsuvm B_belsuvm2 B_bkiclsu B_bkiclsu2 B_bklsuia B_bklsuia2 B_bklsuip B_bklsuip2 B_bklsuks B_bklsuks2 B_bklsuun B_bklsuun2 B_bklsuvm B_bklsuvm2 B_cliclsu B_cliclsu2 B_cllsuia B_cllsuia2 B_cllsuip B_cllsuip2 B_cllsuks B_cllsuks2 B_cllsuun B_cllsuun2 B_cllsuvm B_cllsuvm2 B_fticlsu B_fticlsu2 B_ftlsuia B_ftlsuia2 B_ftlsuip B_ftlsuip2 B_ftlsuks B_ftlsuks2 B_ftlsuun B_ftlsuun2 B_ftlsuvm B_ftlsuvm2 B_mniclsu B_mniclsu2 B_mnlsuia B_mnlsuia2 B_mnlsuip B_mnlsuip2 B_mnlsuks B_mnlsuks2 B_mnlsuun B_mnlsuun2 B_mnlsuvm B_mnlsuvm2 B_mxiclsu B_mxiclsu2 B_mxlsuia B_mxlsuia2 B_mxlsuip B_mxlsuip2 B_mxlsuks B_mxlsuks2 B_mxlsuun B_mxlsuun2 B_mxlsuvm B_mxlsuvm2 B_npiclsu B_npiclsu2 B_nplsuia B_nplsuia2 B_nplsuip B_nplsuip2 B_nplsuks B_nplsuks2 B_nplsuun B_nplsuun2 B_nplsuvm B_nplsuvm2 B_siiclsu B_siiclsu2 B_silsuia B_silsuia2 B_silsuip B_silsuip2 B_silsuks B_silsuks2 B_silsuun B_silsuun2 B_silsuvm B_silsuvm2 E_iclsu E_iclsu2 E_lsuia E_lsuia2 E_lsuip E_lsuip2 E_lsuks E_lsuks2 E_lsuun E_lsuun2 E_lsuvm E_lsuvm2 sfpiclsu sfpiclsu2 sfplsuia sfplsuia2 sfplsuip sfplsuip2 sfplsuks sfplsuks2 sfplsuun sfplsuun2 sfplsuvm sfplsuvm2 TYP_iclsu TYP_iclsu2 TYP_lsuia TYP_lsuia2 TYP_lsuip TYP_lsuip2 TYP_lsuks TYP_lsuks2 TYP_lsuun TYP_lsuun2 TYP_lsuvm TYP_lsuvm2 Z_iclsu Z_iclsu2 Z_lsuia Z_lsuia2 Z_lsuip Z_lsuip2 Z_lsuks Z_lsuks2 Z_lsuun Z_lsuun2 Z_lsuvm Z_lsuvm2 /end OUT_MEASUREMENT
/end FUNCTION
/begin FUNCTION DFPM_DKATSP ""
 /begin DEF_CHARACTERISTIC CDCKAT CDCKAT2 CDKKAT CDKKAT2 CDTKAT CDTKAT2 CLAKAT CLAKAT2 FFTKAT FFTKAT2 TSFKAT TSFKAT2 /end DEF_CHARACTERISTIC
 /begin OUT_MEASUREMENT B_bekat B_bekat2 B_bkkat B_bkkat2 B_clkat B_clkat2 B_ftkat B_ftkat2 B_mnkat B_mnkat2 B_mxkat B_mxkat2 B_npkat B_npkat2 B_sikat B_sikat2 E_kat E_kat2 sfpkat sfpkat2 TYP_kat TYP_kat2 Z_kat Z_kat2 /end OUT_MEASUREMENT
/end FUNCTION
/begin FUNCTION DFPM_DKFTE "" /begin DEF_CHARACTERISTIC CDCETS CDKETS CDTETS CLAETS FFTETS TSFETS /end DEF_CHARACTERISTIC
 /begin OUT_MEASUREMENT B_beets B_bkets B_clets B_ftets B_mnets B_mxets B_npets B_siets E_ets sfpets TYP_ets Z_ets /end OUT_MEASUREMENT
/end FUNCTION
/begin FUNCTION DFPM_DKOSE "" /begin DEF_CHARACTERISTIC CDCKOSE CDKKOSE CDTKOSE CLAKOSE FFTKOSE TSFKOSE /end DEF_CHARACTERISTIC
 /begin OUT_MEASUREMENT B_bekose B_bkkose B_clkose B_ftkose B_mnkose B_mxkose B_npkose B_sikose E_kose sfpkose TYP_kose Z_kose /end OUT_MEASUREMENT
/end FUNCTION
/begin FUNCTION DFPM_DKRNT ""
 /begin DEF_CHARACTERISTIC CDCKRNT CDCKRNT2 CDCKROF CDCKROF2 CDKKRNT CDKKRNT2 CDKKROF CDKKROF2 CDTKRNT CDTKRNT2 CDTKROF CDTKROF2 CLAKRNT CLAKRNT2 CLAKROF CLAKROF2 FFTKRNT FFTKRNT2 FFTKROF FFTKROF2 TSFKRNT TSFKRNT2 TSFKROF TSFKROF2 /end DEF_CHARACTERISTIC
 /begin OUT_MEASUREMENT B_bekrnt B_bekrnt2 B_bekrof B_bekrof2 B_bkkrnt B_bkkrnt2 B_bkkrof B_bkkrof2 B_clkrnt B_clkrnt2 B_clkrof B_clkrof2 B_ftkrnt B_ftkrnt2 B_ftkrof B_ftkrof2 B_mnkrnt B_mnkrnt2 B_mnkrof B_mnkrof2 B_mxkrnt B_mxkrnt2 B_mxkrof B_mxkrof2 B_npkrnt B_npkrnt2 B_npkrof B_npkrof2 B_sikrnt B_sikrnt2 B_sikrof B_sikrof2 E_krnt E_krnt2 E_krof E_krof2 sfpkrnt sfpkrnt2 sfpkrof sfpkrof2 TYP_krnt TYP_krnt2 TYP_krof TYP_krof2 Z_krnt Z_krnt2 Z_krof Z_krof2 /end OUT_MEASUREMENT
/end FUNCTION
/begin FUNCTION DFPM_DKRS ""
 /begin DEF_CHARACTERISTIC CDCKS1 CDCKS2 CDCKS3 CDCKS4 CDKKS1 CDKKS2 CDKKS3 CDKKS4 CDTKS1 CDTKS2 CDTKS3 CDTKS4 CLAKS1 CLAKS2 CLAKS3 CLAKS4 FFTKS1 FFTKS2 FFTKS3 FFTKS4 TSFKS1 TSFKS2 TSFKS3 TSFKS4 /end DEF_CHARACTERISTIC
 /begin OUT_MEASUREMENT B_beks1 B_beks2 B_beks3 B_beks4 B_bkks1 B_bkks2 B_bkks3 B_bkks4 B_clks1 B_clks2 B_clks3 B_clks4 B_ftks1 B_ftks2 B_ftks3 B_ftks4 B_mnks1 B_mnks2 B_mnks3 B_mnks4 B_mxks1 B_mxks2 B_mxks3 B_mxks4 B_npks1 B_npks2 B_npks3 B_npks4 B_siks1 B_siks2 B_siks3 B_siks4 E_ks1 E_ks2 E_ks3 E_ks4 sfpks1 sfpks2 sfpks3 sfpks4 TYP_ks1 TYP_ks2 TYP_ks3 TYP_ks4 Z_ks1 Z_ks2 Z_ks3 Z_ks4 /end OUT_MEASUREMENT
/end FUNCTION
/begin FUNCTION DFPM_DKRTP ""
 /begin DEF_CHARACTERISTIC CDCKRTP CDCKRTP2 CDKKRTP CDKKRTP2 CDTKRTP CDTKRTP2 CLAKRTP CLAKRTP2 FFTKRTP FFTKRTP2 TSFKRTP TSFKRTP2 /end DEF_CHARACTERISTIC
 /begin OUT_MEASUREMENT B_bekrtp B_bekrtp2 B_bkkrtp B_bkkrtp2 B_clkrtp B_clkrtp2 B_ftkrtp B_ftkrtp2 B_mnkrtp B_mnkrtp2 B_mxkrtp B_mxkrtp2 B_npkrtp B_npkrtp2 B_sikrtp B_sikrtp2 E_krtp E_krtp2 sfpkrtp sfpkrtp2 TYP_krtp TYP_krtp2 Z_krtp Z_krtp2 /end OUT_MEASUREMENT
/end FUNCTION
/begin FUNCTION DFPM_DKUPPL "" /begin DEF_CHARACTERISTIC CDCKUPPL CDKKUPPL CDTKUPPL CLAKUPPL FFTKUPPL TSFKUPPL /end DEF_CHARACTERISTIC
 /begin OUT_MEASUREMENT B_bekuppl B_bkkuppl B_clkuppl B_ftkuppl B_mnkuppl B_mxkuppl B_npkuppl B_sikuppl E_kuppl sfpkuppl TYP_kuppl Z_kuppl /end OUT_MEASUREMENT
/end FUNCTION
/begin FUNCTION DFPM_DKVS ""
 /begin DEF_CHARACTERISTIC CDCFRAO CDCFRAO2 CDCFRAU CDCFRAU2 CDCFRST CDCFRST2 CDCRKAT CDCRKAT2 CDCRKAZ CDCRKAZ2 CDKFRAO CDKFRAO2 CDKFRAU CDKFRAU2 CDKFRST CDKFRST2 CDKRKAT CDKRKAT2 CDKRKAZ CDKRKAZ2 CDTFRAO CDTFRAO2 CDTFRAU CDTFRAU2 CDTFRST CDTFRST2 CDTRKAT CDTRKAT2 CDTRKAZ CDTRKAZ2 CLAFRAO CLAFRAO2 CLAFRAU CLAFRAU2 CLAFRST CLAFRST2 CLARKAT CLARKAT2 CLARKAZ CLARKAZ2 FFTFRAO FFTFRAO2 FFTFRAU FFTFRAU2 FFTFRST FFTFRST2 FFTRKAT FFTRKAT2 FFTRKAZ FFTRKAZ2 TSFFRAO TSFFRAO2 TSFFRAU TSFFRAU2 TSFFRST TSFFRST2 TSFRKAT TSFRKAT2 TSFRKAZ TSFRKAZ2 /end DEF_CHARACTERISTIC
 /begin OUT_MEASUREMENT B_befrao B_befrao2 B_befrau B_befrau2 B_befrst B_befrst2 B_berkat B_berkat2 B_berkaz B_berkaz2 B_bkfrao B_bkfrao2 B_bkfrau B_bkfrau2 B_bkfrst B_bkfrst2 B_bkrkat B_bkrkat2 B_bkrkaz B_bkrkaz2 B_clfrao B_clfrao2 B_clfrau B_clfrau2 B_clfrst B_clfrst2 B_clrkat B_clrkat2 B_clrkaz B_clrkaz2 B_ftfrao B_ftfrao2 B_ftfrau B_ftfrau2 B_ftfrst B_ftfrst2 B_ftrkat B_ftrkat2 B_ftrkaz B_ftrkaz2 B_mnfrao B_mnfrao2 B_mnfrau B_mnfrau2 B_mnfrst B_mnfrst2 B_mnrkat B_mnrkat2 B_mnrkaz B_mnrkaz2 B_mxfrao B_mxfrao2 B_mxfrau B_mxfrau2 B_mxfrst B_mxfrst2 B_mxrkat B_mxrkat2 B_mxrkaz B_mxrkaz2 B_npfrao B_npfrao2 B_npfrau B_npfrau2 B_npfrst B_npfrst2 B_nprkat B_nprkat2 B_nprkaz B_nprkaz2 B_sifrao B_sifrao2 B_sifrau B_sifrau2 B_sifrst B_sifrst2 B_sirkat B_sirkat2 B_sirkaz B_sirkaz2 E_frao E_frao2 E_frau E_frau2 E_frst E_frst2 E_rkat E_rkat2 E_rkaz E_rkaz2 sfpfrao sfpfrao2 sfpfrau sfpfrau2 sfpfrst sfpfrst2 sfprkat sfprkat2 sfprkaz sfprkaz2 TYP_frao TYP_frao2 TYP_frau TYP_frau2 TYP_frst TYP_frst2 TYP_rkat TYP_rkat2 TYP_rkaz TYP_rkaz2 Z_frao Z_frao2 Z_frau Z_frau2 Z_frst Z_frst2 Z_rkat Z_rkat2 Z_rkaz Z_rkaz2 /end OUT_MEASUREMENT
/end FUNCTION
/begin FUNCTION DFPM_DLLR "" /begin DEF_CHARACTERISTIC CDCLLR CDKLLR CDTLLR CLALLR FFTLLR TSFLLR /end DEF_CHARACTERISTIC
 /begin OUT_MEASUREMENT B_bellr B_bkllr B_clllr B_ftllr B_mnllr B_mxllr B_npllr B_sillr E_llr sfpllr TYP_LLR Z_llr /end OUT_MEASUREMENT
/end FUNCTION
/begin FUNCTION DFPM_DLOCVVT "" /begin DEF_CHARACTERISTIC CDCCVVT CDKCVVT CDTCVVT CLACVVT FFTCVVT TSFCVVT /end DEF_CHARACTERISTIC
 /begin OUT_MEASUREMENT B_becvvt B_bkcvvt B_clcvvt B_ftcvvt B_mncvvt B_mxcvvt B_npcvvt B_sicvvt E_cvvt sfpcvvt TYP_cvvt Z_cvvt /end OUT_MEASUREMENT
/end FUNCTION
/begin FUNCTION DFPM_DLSAHK ""
 /begin DEF_CHARACTERISTIC CDCLASH CDCLASH2 CDCLAVH CDCLAVH2 CDKLASH CDKLASH2 CDKLAVH CDKLAVH2 CDTLASH CDTLASH2 CDTLAVH CDTLAVH2 CLALASH CLALASH2 CLALAVH CLALAVH2 FFTLASH FFTLASH2 FFTLAVH FFTLAVH2 TSFLASH TSFLASH2 TSFLAVH TSFLAVH2 /end DEF_CHARACTERISTIC
 /begin OUT_MEASUREMENT B_belash B_belash2 B_belavh B_belavh2 B_bklash B_bklash2 B_bklavh B_bklavh2 B_cllash B_cllash2 B_cllavh B_cllavh2 B_falash B_falash2 B_ftlavh B_ftlavh2 B_mnlash B_mnlash2 B_mnlavh B_mnlavh2 B_mxlash B_mxlash2 B_mxlavh B_mxlavh2 B_nplash B_nplash2 B_nplavh B_nplavh2 B_silash B_silash2 B_silavh B_silavh2 E_lash E_lash2 E_lavh E_lavh2 sfplash sfplash2 sfplavh sfplavh2 TYP_lash TYP_lash2 TYP_lavh TYP_lavh2 Z_lash Z_lash2 Z_lavh Z_lavh2 /end OUT_MEASUREMENT
/end FUNCTION
/begin FUNCTION DFPM_DLSH ""
 /begin DEF_CHARACTERISTIC CDCLSH CDCLSH2 CDKLSH CDKLSH2 CDTLSH CDTLSH2 CLALSH CLALSH2 FFTLSH FFTLSH2 TSFLSH TSFLSH2 /end DEF_CHARACTERISTIC
 /begin OUT_MEASUREMENT B_belsh B_belsh2 B_bklsh B_bklsh2 B_cllsh B_cllsh2 B_ftlsh B_ftlsh2 B_mnlsh B_mnlsh2 B_mxlsh B_mxlsh2 B_nplsh B_nplsh2 B_silsh B_silsh2 E_lsh E_lsh2 sfplsh sfplsh2 TYP_lsh TYP_lsh2 Z_lsh Z_lsh2 /end OUT_MEASUREMENT
/end FUNCTION
/begin FUNCTION DFPM_DMDMIL "DMDMIL."
 /begin DEF_CHARACTERISTIC CDCMD CDCMD00 CDCMD01 CDCMD02 CDCMD03 CDCMD04 CDCMD05 CDCMD06 CDCMD07 CDCMD08 CDCMD09 CDCMD10 CDCMD11 CDKMD CDKMD00 CDKMD01 CDKMD02 CDKMD03 CDKMD04 CDKMD05 CDKMD06 CDKMD07 CDKMD08 CDKMD09 CDKMD10 CDKMD11 CDTMD CDTMD00 CDTMD01 CDTMD02 CDTMD03 CDTMD04 CDTMD05 CDTMD06 CDTMD07 CDTMD08 CDTMD09 CDTMD10 CDTMD11 CLAMD CLAMD00 CLAMD01 CLAMD02 CLAMD03 CLAMD04 CLAMD05 CLAMD06 CLAMD07 CLAMD08 CLAMD09 CLAMD10 CLAMD11 FFTMD FFTMD00 FFTMD01 FFTMD02 FFTMD03 FFTMD04 FFTMD05 FFTMD06 FFTMD07 FFTMD08 FFTMD09 FFTMD10 FFTMD11 TSFMD TSFMD00 TSFMD01 TSFMD02 TSFMD03 TSFMD04 TSFMD05 TSFMD06 TSFMD07 TSFMD08 TSFMD09 TSFMD10 TSFMD11 /end DEF_CHARACTERISTIC
 /begin OUT_MEASUREMENT B_bemd B_bemd00 B_bemd01 B_bemd02 B_bemd03 B_bemd04 B_bemd05 B_bemd06 B_bemd07 B_bemd08 B_bemd09 B_bemd10 B_bemd11 B_bkmd B_bkmd00 B_bkmd01 B_bkmd02 B_bkmd03 B_bkmd04 B_bkmd05 B_bkmd06 B_bkmd07 B_bkmd08 B_bkmd09 B_bkmd10 B_bkmd11 B_clmd B_clmd00 B_clmd01 B_clmd02 B_clmd03 B_clmd04 B_clmd05 B_clmd06 B_clmd07 B_clmd08 B_clmd09 B_clmd10 B_clmd11 B_ftmd B_ftmd00 B_ftmd01 B_ftmd02 B_ftmd03 B_ftmd04 B_ftmd05 B_ftmd06 B_ftmd07 B_ftmd08 B_ftmd09 B_ftmd10 B_ftmd11 B_mnmd B_mnmd00 B_mnmd01 B_mnmd02 B_mnmd03 B_mnmd04 B_mnmd05 B_mnmd06 B_mnmd07 B_mnmd08 B_mnmd09 B_mnmd10 B_mnmd11 B_mxmd B_mxmd00 B_mxmd01 B_mxmd02 B_mxmd03 B_mxmd04 B_mxmd05 B_mxmd06 B_mxmd07 B_mxmd08 B_mxmd09 B_mxmd10 B_mxmd11 B_npmd B_npmd00 B_npmd01 B_npmd02 B_npmd03 B_npmd04 B_npmd05 B_npmd06 B_npmd07 B_npmd08 B_npmd09 B_npmd10 B_npmd11 B_simd B_simd00 B_simd01 B_simd02 B_simd03 B_simd04 B_simd05 B_simd06 B_simd07 B_simd08 B_simd09 B_simd10 B_simd11 E_md E_md00 E_md01 E_md02 E_md03 E_md04 E_md05 E_md06 E_md07 E_md08 E_md09 E_md10 E_md11 sfpmd sfpmd00 sfpmd01 sfpmd02 sfpmd03 sfpmd04 sfpmd05 sfpmd06 sfpmd07 sfpmd08 sfpmd09 sfpmd10 sfpmd11 TYP_md TYP_md00 TYP_md01 TYP_md02 TYP_md03 TYP_md04 TYP_md05 TYP_md06 TYP_md07 TYP_md08 TYP_md09 TYP_md10 TYP_md11 Z_md Z_md00 Z_md01 Z_md02 Z_md03 Z_md04 Z_md05 Z_md06 Z_md07 Z_md08 Z_md09 Z_md10 Z_md11 /end OUT_MEASUREMENT
/end FUNCTION
/begin FUNCTION DFPM_DMLSE "" /begin DEF_CHARACTERISTIC CDCMLE CDKMLE CDTMLE CLAMLE FFTMLE TSFMLE /end DEF_CHARACTERISTIC
 /begin OUT_MEASUREMENT B_bemle B_bkmle B_clmle B_ftmle B_mnmle B_mxmle B_npmle B_simle E_mle sfpmle TYP_mle Z_mle /end OUT_MEASUREMENT
/end FUNCTION
/begin FUNCTION DFPM_DNVRBUP ""
 /begin DEF_CHARACTERISTIC CDCNVRBUP CDKNVRBUP CDTNVRBUP CLANVRBUP FFTNVRBUP TSFNVRBUP /end DEF_CHARACTERISTIC
 /begin OUT_MEASUREMENT B_benvrbup B_bknvrbup B_clnvrbup B_ftnvrbup B_mnnvrbup B_mxnvrbup B_npnvrbup B_sinvrbup E_nvrbup sfpnvrbup TYP_nvrbup Z_nvrbup /end OUT_MEASUREMENT
/end FUNCTION
/begin FUNCTION DFPM_DNWSAUS "DNWSAUS.exported"
 /begin DEF_CHARACTERISTIC CDCANWS CDCANWS2 CDKANWS CDKANWS2 CDTANWS CDTANWS2 CLAANWS CLAANWS2 FFTANWS FFTANWS2 TSFANWS TSFANWS2 /end DEF_CHARACTERISTIC
 /begin OUT_MEASUREMENT B_beanws B_beanws2 B_bkanws B_bkanws2 B_clanws B_clanws2 B_ftanws B_ftanws2 B_mnanws B_mnanws2 B_mxanws B_mxanws2 B_npanws B_npanws2 B_sianws B_sianws2 E_anws E_anws2 sfpanws sfpanws2 TYP_anws TYP_anws2 Z_anws Z_anws2 /end OUT_MEASUREMENT
/end FUNCTION
/begin COMPU_METHOD B_TRUE "boolsche Zust‰nde, positive Logik" TAB_VERB "%6.3" "" COMPU_TAB_REF B_TRUE /end COMPU_METHOD
/begin COMPU_VTAB B_TRUE "boolsche Zust‰nde, positive Logik" TAB_VERB 2 0 "----" 1 "TRUE" /end COMPU_VTAB
/begin COMPU_METHOD DEZ "1 : 1 Umrechnug (dez/hex)" RAT_FUNC "%6.2" "" COEFFS 0 1 0 0 0 1 /end COMPU_METHOD
/begin COMPU_METHOD dez "1 : 1 Umrechnug (dez/hex)" RAT_FUNC "%6.2" "" COEFFS 0 1 0 0 0 1 /end COMPU_METHOD
/begin COMPU_METHOD default "" RAT_FUNC "%6.2" "" COEFFS 0 1 0 0 0 1 /end COMPU_METHOD
/begin RECORD_LAYOUT KwbUb FNC_VALUES 1 UBYTE COLUMN_DIR DIRECT /end RECORD_LAYOUT
/begin RECORD_LAYOUT KwbUw FNC_VALUES 1 UWORD COLUMN_DIR DIRECT /end RECORD_LAYOUT
/begin RECORD_LAYOUT KwbWU16 FNC_VALUES 1 UWORD COLUMN_DIR DIRECT /end RECORD_LAYOUT
/begin RECORD_LAYOUT KwbWU8 FNC_VALUES 1 UBYTE COLUMN_DIR DIRECT /end RECORD_LAYOUT
/begin RECORD_LAYOUT KwUb FNC_VALUES 1 UBYTE COLUMN_DIR DIRECT /end RECORD_LAYOUT
/begin RECORD_LAYOUT KwUw FNC_VALUES 1 UWORD COLUMN_DIR DIRECT /end RECORD_LAYOUT
/begin RECORD_LAYOUT KwWU16 FNC_VALUES 1 UWORD COLUMN_DIR DIRECT /end RECORD_LAYOUT
/begin RECORD_LAYOUT KwWU8 FNC_VALUES 1 UBYTE COLUMN_DIR DIRECT /end RECORD_LAYOUT
/end MODULE
/end PROJECT
