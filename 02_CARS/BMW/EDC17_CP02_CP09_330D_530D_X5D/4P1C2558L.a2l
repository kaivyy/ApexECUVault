ASAP2_VERSION 1 4
/begin PROJECT P_558 "EDC17_CP02"
/begin HEADER "" VERSION "V1C1" PROJECT_NO P_558 /end HEADER
/begin MODULE DIM ""
/begin MOD_COMMON "" BYTE_ORDER MSB_LAST ALIGNMENT_BYTE 1 ALIGNMENT_WORD 2 ALIGNMENT_LONG 4 ALIGNMENT_FLOAT32_IEEE 4 /end MOD_COMMON
/begin CHARACTERISTIC DFES_Env.xSet1_CA "/" VAL_BLK 0x80071E80 ValA_Wu16 161.000000000 Signals_IntSigNumVerb 0.00 161.000000000 FORMAT "%13.9" NUMBER 25 /end CHARACTERISTIC
/begin CHARACTERISTIC DFES_Env.xSet2_CA "/" VAL_BLK 0x80071EB2 ValA_Wu16 161.000000000 Signals_IntSigNumVerb 0.00 161.000000000 FORMAT "%13.9" NUMBER 25 /end CHARACTERISTIC
/begin CHARACTERISTIC DFES_Env.xSet3_CA "/" VAL_BLK 0x80071EE4 ValA_Wu16 161.000000000 Signals_IntSigNumVerb 0.00 161.000000000 FORMAT "%13.9" NUMBER 25 /end CHARACTERISTIC
/begin CHARACTERISTIC DFES_Env.xSet4_CA "/" VAL_BLK 0x80071F16 ValA_Wu16 161.000000000 Signals_IntSigNumVerb 0.00 161.000000000 FORMAT "%13.9" NUMBER 25 /end CHARACTERISTIC
/begin CHARACTERISTIC DFES_Env.xSet5_CA "/" VAL_BLK 0x80071F48 ValA_Wu16 161.000000000 Signals_IntSigNumVerb 0.00 161.000000000 FORMAT "%13.9" NUMBER 25 /end CHARACTERISTIC
/begin CHARACTERISTIC DFES_Env.xSet6_CA "/" VAL_BLK 0x80071F7A ValA_Wu16 161.000000000 Signals_IntSigNumVerb 0.00 161.000000000 FORMAT "%13.9" NUMBER 25 /end CHARACTERISTIC
/begin CHARACTERISTIC DFES_Env.xSet7_CA "/" VAL_BLK 0x80071FAC ValA_Wu16 161.000000000 Signals_IntSigNumVerb 0.00 161.000000000 FORMAT "%13.9" NUMBER 25 /end CHARACTERISTIC
/begin CHARACTERISTIC DFES_Env.xSet8_CA "/" VAL_BLK 0x80071FDE ValA_Wu16 161.000000000 Signals_IntSigNumVerb 0.00 161.000000000 FORMAT "%13.9" NUMBER 25 /end CHARACTERISTIC
/begin CHARACTERISTIC DFES_Env.xSet9_CA "/" VAL_BLK 0x80072010 ValA_Wu16 161.000000000 Signals_IntSigNumVerb 0.00 161.000000000 FORMAT "%13.9" NUMBER 25 /end CHARACTERISTIC
/begin CHARACTERISTIC DFES_Env.xSet10_CA "/" VAL_BLK 0x80072042 ValA_Wu16 161.000000000 Signals_IntSigNumVerb 0.00 161.000000000 FORMAT "%13.9" NUMBER 25 /end CHARACTERISTIC
/begin CHARACTERISTIC DFES_Env.xSet11_CA "/" VAL_BLK 0x80072074 ValA_Wu16 161.000000000 Signals_IntSigNumVerb 0.00 161.000000000 FORMAT "%13.9" NUMBER 25 /end CHARACTERISTIC
/begin CHARACTERISTIC DFES_Env.xSet12_CA "/" VAL_BLK 0x800720A6 ValA_Wu16 161.000000000 Signals_IntSigNumVerb 0.00 161.000000000 FORMAT "%13.9" NUMBER 25 /end CHARACTERISTIC
/begin CHARACTERISTIC DFES_Env.xSet13_CA "/" VAL_BLK 0x800720D8 ValA_Wu16 161.000000000 Signals_IntSigNumVerb 0.00 161.000000000 FORMAT "%13.9" NUMBER 25 /end CHARACTERISTIC
/begin CHARACTERISTIC DFES_Env.xSet14_CA "/" VAL_BLK 0x8007210A ValA_Wu16 161.000000000 Signals_IntSigNumVerb 0.00 161.000000000 FORMAT "%13.9" NUMBER 25 /end CHARACTERISTIC
/begin CHARACTERISTIC DFES_Env.xSet15_CA "/" VAL_BLK 0x8007213C ValA_Wu16 161.000000000 Signals_IntSigNumVerb 0.00 161.000000000 FORMAT "%13.9" NUMBER 25 /end CHARACTERISTIC
/begin CHARACTERISTIC DFES_Env.xSet16_CA "/" VAL_BLK 0x8007216E ValA_Wu16 161.000000000 Signals_IntSigNumVerb 0.00 161.000000000 FORMAT "%13.9" NUMBER 25 /end CHARACTERISTIC
/begin CHARACTERISTIC DFES_Env.xSet17_CA "/" VAL_BLK 0x800721A0 ValA_Wu16 161.000000000 Signals_IntSigNumVerb 0.00 161.000000000 FORMAT "%13.9" NUMBER 25 /end CHARACTERISTIC
/begin CHARACTERISTIC DFES_Env.xSet18_CA "/" VAL_BLK 0x800721D2 ValA_Wu16 161.000000000 Signals_IntSigNumVerb 0.00 161.000000000 FORMAT "%13.9" NUMBER 25 /end CHARACTERISTIC
/begin CHARACTERISTIC DFES_Env.xSet19_CA "/" VAL_BLK 0x80072204 ValA_Wu16 161.000000000 Signals_IntSigNumVerb 0.00 161.000000000 FORMAT "%13.9" NUMBER 25 /end CHARACTERISTIC
/begin CHARACTERISTIC DFES_Env.xSet20_CA "/" VAL_BLK 0x80072236 ValA_Wu16 161.000000000 Signals_IntSigNumVerb 0.00 161.000000000 FORMAT "%13.9" NUMBER 25 /end CHARACTERISTIC
/begin CHARACTERISTIC DFES_Env.xSet21_CA "/" VAL_BLK 0x80072268 ValA_Wu16 161.000000000 Signals_IntSigNumVerb 0.00 161.000000000 FORMAT "%13.9" NUMBER 25 /end CHARACTERISTIC
/begin CHARACTERISTIC DFES_Env.xSet22_CA "/" VAL_BLK 0x8007229A ValA_Wu16 161.000000000 Signals_IntSigNumVerb 0.00 161.000000000 FORMAT "%13.9" NUMBER 25 /end CHARACTERISTIC
/begin CHARACTERISTIC DFES_Env.xSet23_CA "/" VAL_BLK 0x800722CC ValA_Wu16 161.000000000 Signals_IntSigNumVerb 0.00 161.000000000 FORMAT "%13.9" NUMBER 25 /end CHARACTERISTIC
/begin CHARACTERISTIC DFES_Env.xSet24_CA "/" VAL_BLK 0x800722FE ValA_Wu16 161.000000000 Signals_IntSigNumVerb 0.00 161.000000000 FORMAT "%13.9" NUMBER 25 /end CHARACTERISTIC
/begin CHARACTERISTIC DFES_Env.xSet25_CA "/" VAL_BLK 0x80072330 ValA_Wu16 161.000000000 Signals_IntSigNumVerb 0.00 161.000000000 FORMAT "%13.9" NUMBER 25 /end CHARACTERISTIC
/begin CHARACTERISTIC DFES_Env.xSet26_CA "/" VAL_BLK 0x80072362 ValA_Wu16 161.000000000 Signals_IntSigNumVerb 0.00 161.000000000 FORMAT "%13.9" NUMBER 25 /end CHARACTERISTIC
/begin CHARACTERISTIC DFES_Env.xSet27_CA "/" VAL_BLK 0x80072394 ValA_Wu16 161.000000000 Signals_IntSigNumVerb 0.00 161.000000000 FORMAT "%13.9" NUMBER 25 /end CHARACTERISTIC
/begin CHARACTERISTIC DFES_Env.xSet28_CA "/" VAL_BLK 0x800723C6 ValA_Wu16 161.000000000 Signals_IntSigNumVerb 0.00 161.000000000 FORMAT "%13.9" NUMBER 25 /end CHARACTERISTIC
/begin CHARACTERISTIC DFES_Env.xSet29_CA "/" VAL_BLK 0x800723F8 ValA_Wu16 161.000000000 Signals_IntSigNumVerb 0.00 161.000000000 FORMAT "%13.9" NUMBER 25 /end CHARACTERISTIC
/begin CHARACTERISTIC DFES_Env.xSet30_CA "/" VAL_BLK 0x8007242A ValA_Wu16 161.000000000 Signals_IntSigNumVerb 0.00 161.000000000 FORMAT "%13.9" NUMBER 25 /end CHARACTERISTIC
/begin CHARACTERISTIC DFES_Env.xSet31_CA "/" VAL_BLK 0x8007245C ValA_Wu16 161.000000000 Signals_IntSigNumVerb 0.00 161.000000000 FORMAT "%13.9" NUMBER 25 /end CHARACTERISTIC
/begin CHARACTERISTIC DFES_Env.xSet32_CA "/" VAL_BLK 0x8007248E ValA_Wu16 161.000000000 Signals_IntSigNumVerb 0.00 161.000000000 FORMAT "%13.9" NUMBER 25 /end CHARACTERISTIC
/begin CHARACTERISTIC DFES_Env.xSet33_CA "/" VAL_BLK 0x800724C0 ValA_Wu16 161.000000000 Signals_IntSigNumVerb 0.00 161.000000000 FORMAT "%13.9" NUMBER 25 /end CHARACTERISTIC
/begin CHARACTERISTIC DFES_Env.xSet34_CA "/" VAL_BLK 0x800724F2 ValA_Wu16 161.000000000 Signals_IntSigNumVerb 0.00 161.000000000 FORMAT "%13.9" NUMBER 25 /end CHARACTERISTIC
/begin CHARACTERISTIC DFES_Env.xSet35_CA "/" VAL_BLK 0x80072524 ValA_Wu16 161.000000000 Signals_IntSigNumVerb 0.00 161.000000000 FORMAT "%13.9" NUMBER 25 /end CHARACTERISTIC
/begin CHARACTERISTIC DFES_Env.xSet36_CA "/" VAL_BLK 0x80072556 ValA_Wu16 161.000000000 Signals_IntSigNumVerb 0.00 161.000000000 FORMAT "%13.9" NUMBER 25 /end CHARACTERISTIC
/begin CHARACTERISTIC DFES_Env.xSet37_CA "/" VAL_BLK 0x80072588 ValA_Wu16 161.000000000 Signals_IntSigNumVerb 0.00 161.000000000 FORMAT "%13.9" NUMBER 25 /end CHARACTERISTIC
/begin CHARACTERISTIC DFES_Env.xSet38_CA "/" VAL_BLK 0x800725BA ValA_Wu16 161.000000000 Signals_IntSigNumVerb 0.00 161.000000000 FORMAT "%13.9" NUMBER 25 /end CHARACTERISTIC
/begin CHARACTERISTIC DFES_Env.xSet39_CA "/" VAL_BLK 0x800725EC ValA_Wu16 161.000000000 Signals_IntSigNumVerb 0.00 161.000000000 FORMAT "%13.9" NUMBER 25 /end CHARACTERISTIC
/begin CHARACTERISTIC DFES_Env.xSet40_CA "/" VAL_BLK 0x8007261E ValA_Wu16 161.000000000 Signals_IntSigNumVerb 0.00 161.000000000 FORMAT "%13.9" NUMBER 25 /end CHARACTERISTIC
/begin CHARACTERISTIC DFES_Env.xSet41_CA "/" VAL_BLK 0x80072650 ValA_Wu16 161.000000000 Signals_IntSigNumVerb 0.00 161.000000000 FORMAT "%13.9" NUMBER 25 /end CHARACTERISTIC
/begin CHARACTERISTIC DFES_Env.xSet42_CA "/" VAL_BLK 0x80072682 ValA_Wu16 161.000000000 Signals_IntSigNumVerb 0.00 161.000000000 FORMAT "%13.9" NUMBER 25 /end CHARACTERISTIC
/begin CHARACTERISTIC DFES_Env.xSet43_CA "/" VAL_BLK 0x800726B4 ValA_Wu16 161.000000000 Signals_IntSigNumVerb 0.00 161.000000000 FORMAT "%13.9" NUMBER 25 /end CHARACTERISTIC
/begin CHARACTERISTIC DFES_Env.xSet44_CA "/" VAL_BLK 0x800726E6 ValA_Wu16 161.000000000 Signals_IntSigNumVerb 0.00 161.000000000 FORMAT "%13.9" NUMBER 25 /end CHARACTERISTIC
/begin CHARACTERISTIC DFES_Env.xSet45_CA "/" VAL_BLK 0x80072718 ValA_Wu16 161.000000000 Signals_IntSigNumVerb 0.00 161.000000000 FORMAT "%13.9" NUMBER 25 /end CHARACTERISTIC
/begin CHARACTERISTIC DFES_Env.xSet46_CA "/" VAL_BLK 0x8007274A ValA_Wu16 161.000000000 Signals_IntSigNumVerb 0.00 161.000000000 FORMAT "%13.9" NUMBER 25 /end CHARACTERISTIC
/begin CHARACTERISTIC DFES_Env.xSet47_CA "/" VAL_BLK 0x8007277C ValA_Wu16 161.000000000 Signals_IntSigNumVerb 0.00 161.000000000 FORMAT "%13.9" NUMBER 25 /end CHARACTERISTIC
/begin CHARACTERISTIC DFES_Env.xSet48_CA "/" VAL_BLK 0x800727AE ValA_Wu16 161.000000000 Signals_IntSigNumVerb 0.00 161.000000000 FORMAT "%13.9" NUMBER 25 /end CHARACTERISTIC
/begin CHARACTERISTIC DFES_Env.xSet49_CA "/" VAL_BLK 0x800727E0 ValA_Wu16 161.000000000 Signals_IntSigNumVerb 0.00 161.000000000 FORMAT "%13.9" NUMBER 25 /end CHARACTERISTIC
/begin CHARACTERISTIC DFES_Env.xSet50_CA "/" VAL_BLK 0x80072812 ValA_Wu16 161.000000000 Signals_IntSigNumVerb 0.00 161.000000000 FORMAT "%13.9" NUMBER 25 /end CHARACTERISTIC
/begin CHARACTERISTIC DFES_Env.xSet51_CA "/" VAL_BLK 0x80072844 ValA_Wu16 161.000000000 Signals_IntSigNumVerb 0.00 161.000000000 FORMAT "%13.9" NUMBER 25 /end CHARACTERISTIC
/begin CHARACTERISTIC DFES_Env.xSet52_CA "/" VAL_BLK 0x80072876 ValA_Wu16 161.000000000 Signals_IntSigNumVerb 0.00 161.000000000 FORMAT "%13.9" NUMBER 25 /end CHARACTERISTIC
/begin CHARACTERISTIC DFES_Env.xSet53_CA "/" VAL_BLK 0x800728A8 ValA_Wu16 161.000000000 Signals_IntSigNumVerb 0.00 161.000000000 FORMAT "%13.9" NUMBER 25 /end CHARACTERISTIC
/begin CHARACTERISTIC DFES_Env.xSet54_CA "/" VAL_BLK 0x800728DA ValA_Wu16 161.000000000 Signals_IntSigNumVerb 0.00 161.000000000 FORMAT "%13.9" NUMBER 25 /end CHARACTERISTIC
/begin CHARACTERISTIC DFES_Env.xSet55_CA "/" VAL_BLK 0x8007290C ValA_Wu16 161.000000000 Signals_IntSigNumVerb 0.00 161.000000000 FORMAT "%13.9" NUMBER 25 /end CHARACTERISTIC
/begin CHARACTERISTIC DFES_Env.xSet56_CA "/" VAL_BLK 0x8007293E ValA_Wu16 161.000000000 Signals_IntSigNumVerb 0.00 161.000000000 FORMAT "%13.9" NUMBER 25 /end CHARACTERISTIC
/begin CHARACTERISTIC DFES_Env.xSet57_CA "/" VAL_BLK 0x80072970 ValA_Wu16 161.000000000 Signals_IntSigNumVerb 0.00 161.000000000 FORMAT "%13.9" NUMBER 25 /end CHARACTERISTIC
/begin CHARACTERISTIC DFES_Env.xSet58_CA "/" VAL_BLK 0x800729A2 ValA_Wu16 161.000000000 Signals_IntSigNumVerb 0.00 161.000000000 FORMAT "%13.9" NUMBER 25 /end CHARACTERISTIC
/begin CHARACTERISTIC DFES_Env.xSet59_CA "/" VAL_BLK 0x800729D4 ValA_Wu16 161.000000000 Signals_IntSigNumVerb 0.00 161.000000000 FORMAT "%13.9" NUMBER 25 /end CHARACTERISTIC
/begin CHARACTERISTIC DFES_Env.xSet60_CA "/" VAL_BLK 0x80072A06 ValA_Wu16 161.000000000 Signals_IntSigNumVerb 0.00 161.000000000 FORMAT "%13.9" NUMBER 25 /end CHARACTERISTIC
/begin CHARACTERISTIC DFES_Env.xSet61_CA "/" VAL_BLK 0x80072A38 ValA_Wu16 161.000000000 Signals_IntSigNumVerb 0.00 161.000000000 FORMAT "%13.9" NUMBER 25 /end CHARACTERISTIC
/begin CHARACTERISTIC DFES_Env.xSet62_CA "/" VAL_BLK 0x80072A6A ValA_Wu16 161.000000000 Signals_IntSigNumVerb 0.00 161.000000000 FORMAT "%13.9" NUMBER 25 /end CHARACTERISTIC
/begin CHARACTERISTIC DFES_Env.xSet63_CA "/" VAL_BLK 0x80072A9C ValA_Wu16 161.000000000 Signals_IntSigNumVerb 0.00 161.000000000 FORMAT "%13.9" NUMBER 25 /end CHARACTERISTIC
/begin CHARACTERISTIC DFES_Env.xSet64_CA "/" VAL_BLK 0x80072ACE ValA_Wu16 161.000000000 Signals_IntSigNumVerb 0.00 161.000000000 FORMAT "%13.9" NUMBER 25 /end CHARACTERISTIC
/begin CHARACTERISTIC DFES_Env.xSet65_CA "/" VAL_BLK 0x80072B00 ValA_Wu16 161.000000000 Signals_IntSigNumVerb 0.00 161.000000000 FORMAT "%13.9" NUMBER 25 /end CHARACTERISTIC
/begin CHARACTERISTIC DFES_Env.xSet66_CA "/" VAL_BLK 0x80072B32 ValA_Wu16 161.000000000 Signals_IntSigNumVerb 0.00 161.000000000 FORMAT "%13.9" NUMBER 25 /end CHARACTERISTIC
/begin CHARACTERISTIC DFES_Env.xSet67_CA "/" VAL_BLK 0x80072B64 ValA_Wu16 161.000000000 Signals_IntSigNumVerb 0.00 161.000000000 FORMAT "%13.9" NUMBER 25 /end CHARACTERISTIC
/begin CHARACTERISTIC DFES_Env.xSet68_CA "/" VAL_BLK 0x80072B96 ValA_Wu16 161.000000000 Signals_IntSigNumVerb 0.00 161.000000000 FORMAT "%13.9" NUMBER 25 /end CHARACTERISTIC
/begin CHARACTERISTIC DFES_Env.xSet69_CA "/" VAL_BLK 0x80072BC8 ValA_Wu16 161.000000000 Signals_IntSigNumVerb 0.00 161.000000000 FORMAT "%13.9" NUMBER 25 /end CHARACTERISTIC
/begin CHARACTERISTIC DFES_Env.xSet70_CA "/" VAL_BLK 0x80072BFA ValA_Wu16 161.000000000 Signals_IntSigNumVerb 0.00 161.000000000 FORMAT "%13.9" NUMBER 25 /end CHARACTERISTIC
/begin CHARACTERISTIC DFES_Env.xSet71_CA "/" VAL_BLK 0x80072C2C ValA_Wu16 161.000000000 Signals_IntSigNumVerb 0.00 161.000000000 FORMAT "%13.9" NUMBER 25 /end CHARACTERISTIC
/begin CHARACTERISTIC DFES_Env.xSet72_CA "/" VAL_BLK 0x80072C5E ValA_Wu16 161.000000000 Signals_IntSigNumVerb 0.00 161.000000000 FORMAT "%13.9" NUMBER 25 /end CHARACTERISTIC
/begin CHARACTERISTIC DFES_Env.xSet73_CA "/" VAL_BLK 0x80072C90 ValA_Wu16 161.000000000 Signals_IntSigNumVerb 0.00 161.000000000 FORMAT "%13.9" NUMBER 25 /end CHARACTERISTIC
/begin CHARACTERISTIC DFES_Env.xSet74_CA "/" VAL_BLK 0x80072CC2 ValA_Wu16 161.000000000 Signals_IntSigNumVerb 0.00 161.000000000 FORMAT "%13.9" NUMBER 25 /end CHARACTERISTIC
/begin CHARACTERISTIC DFES_Env.xSet75_CA "/" VAL_BLK 0x80072CF4 ValA_Wu16 161.000000000 Signals_IntSigNumVerb 0.00 161.000000000 FORMAT "%13.9" NUMBER 25 /end CHARACTERISTIC
/begin CHARACTERISTIC DFES_Env.xSet76_CA "/" VAL_BLK 0x80072D26 ValA_Wu16 161.000000000 Signals_IntSigNumVerb 0.00 161.000000000 FORMAT "%13.9" NUMBER 25 /end CHARACTERISTIC
/begin CHARACTERISTIC DFES_Env.xSet77_CA "/" VAL_BLK 0x80072D58 ValA_Wu16 161.000000000 Signals_IntSigNumVerb 0.00 161.000000000 FORMAT "%13.9" NUMBER 25 /end CHARACTERISTIC
/begin CHARACTERISTIC DFES_Env.xSet78_CA "/" VAL_BLK 0x80072D8A ValA_Wu16 161.000000000 Signals_IntSigNumVerb 0.00 161.000000000 FORMAT "%13.9" NUMBER 25 /end CHARACTERISTIC
/begin CHARACTERISTIC DFES_Env.xSet79_CA "/" VAL_BLK 0x80072DBC ValA_Wu16 161.000000000 Signals_IntSigNumVerb 0.00 161.000000000 FORMAT "%13.9" NUMBER 25 /end CHARACTERISTIC
/begin CHARACTERISTIC DFES_Env.xSet80_CA "/" VAL_BLK 0x80072DEE ValA_Wu16 161.000000000 Signals_IntSigNumVerb 0.00 161.000000000 FORMAT "%13.9" NUMBER 25 /end CHARACTERISTIC
/begin CHARACTERISTIC DFES_Env.xSet81_CA "/" VAL_BLK 0x80072E20 ValA_Wu16 161.000000000 Signals_IntSigNumVerb 0.00 161.000000000 FORMAT "%13.9" NUMBER 25 /end CHARACTERISTIC
/begin CHARACTERISTIC DFES_Env.xSet82_CA "/" VAL_BLK 0x80072E52 ValA_Wu16 161.000000000 Signals_IntSigNumVerb 0.00 161.000000000 FORMAT "%13.9" NUMBER 25 /end CHARACTERISTIC
/begin CHARACTERISTIC DFES_Env.xSet83_CA "/" VAL_BLK 0x80072E84 ValA_Wu16 161.000000000 Signals_IntSigNumVerb 0.00 161.000000000 FORMAT "%13.9" NUMBER 25 /end CHARACTERISTIC
/begin CHARACTERISTIC DFES_Env.xSet84_CA "/" VAL_BLK 0x80072EB6 ValA_Wu16 161.000000000 Signals_IntSigNumVerb 0.00 161.000000000 FORMAT "%13.9" NUMBER 25 /end CHARACTERISTIC
/begin CHARACTERISTIC DFES_Env.xSet85_CA "/" VAL_BLK 0x80072EE8 ValA_Wu16 161.000000000 Signals_IntSigNumVerb 0.00 161.000000000 FORMAT "%13.9" NUMBER 25 /end CHARACTERISTIC
/begin CHARACTERISTIC DFES_Env.xSet86_CA "/" VAL_BLK 0x80072F1A ValA_Wu16 161.000000000 Signals_IntSigNumVerb 0.00 161.000000000 FORMAT "%13.9" NUMBER 25 /end CHARACTERISTIC
/begin CHARACTERISTIC DFES_Env.xSet87_CA "/" VAL_BLK 0x80072F4C ValA_Wu16 161.000000000 Signals_IntSigNumVerb 0.00 161.000000000 FORMAT "%13.9" NUMBER 25 /end CHARACTERISTIC
/begin CHARACTERISTIC DFES_Env.xSet88_CA "/" VAL_BLK 0x80072F7E ValA_Wu16 161.000000000 Signals_IntSigNumVerb 0.00 161.000000000 FORMAT "%13.9" NUMBER 25 /end CHARACTERISTIC
/begin CHARACTERISTIC DFES_Env.xSet89_CA "/" VAL_BLK 0x80072FB0 ValA_Wu16 161.000000000 Signals_IntSigNumVerb 0.00 161.000000000 FORMAT "%13.9" NUMBER 25 /end CHARACTERISTIC
/begin CHARACTERISTIC DFES_Env.xSet90_CA "/" VAL_BLK 0x80072FE2 ValA_Wu16 161.000000000 Signals_IntSigNumVerb 0.00 161.000000000 FORMAT "%13.9" NUMBER 25 /end CHARACTERISTIC
/begin CHARACTERISTIC DFES_Env.xSet91_CA "/" VAL_BLK 0x80073014 ValA_Wu16 161.000000000 Signals_IntSigNumVerb 0.00 161.000000000 FORMAT "%13.9" NUMBER 25 /end CHARACTERISTIC
/begin CHARACTERISTIC DFES_Env.xSet92_CA "/" VAL_BLK 0x80073046 ValA_Wu16 161.000000000 Signals_IntSigNumVerb 0.00 161.000000000 FORMAT "%13.9" NUMBER 25 /end CHARACTERISTIC
/begin CHARACTERISTIC DFES_Env.xSet93_CA "/" VAL_BLK 0x80073078 ValA_Wu16 161.000000000 Signals_IntSigNumVerb 0.00 161.000000000 FORMAT "%13.9" NUMBER 25 /end CHARACTERISTIC
/begin CHARACTERISTIC DFES_Env.xSet94_CA "/" VAL_BLK 0x800730AA ValA_Wu16 161.000000000 Signals_IntSigNumVerb 0.00 161.000000000 FORMAT "%13.9" NUMBER 25 /end CHARACTERISTIC
/begin CHARACTERISTIC DFES_Env.xSet95_CA "/" VAL_BLK 0x800730DC ValA_Wu16 161.000000000 Signals_IntSigNumVerb 0.00 161.000000000 FORMAT "%13.9" NUMBER 25 /end CHARACTERISTIC
/begin CHARACTERISTIC DFES_Env.xSet96_CA "/" VAL_BLK 0x8007310E ValA_Wu16 161.000000000 Signals_IntSigNumVerb 0.00 161.000000000 FORMAT "%13.9" NUMBER 25 /end CHARACTERISTIC
/begin CHARACTERISTIC DFES_Env.xSet97_CA "/" VAL_BLK 0x80073140 ValA_Wu16 161.000000000 Signals_IntSigNumVerb 0.00 161.000000000 FORMAT "%13.9" NUMBER 25 /end CHARACTERISTIC
/begin CHARACTERISTIC DFES_Env.xSet98_CA "/" VAL_BLK 0x80073172 ValA_Wu16 161.000000000 Signals_IntSigNumVerb 0.00 161.000000000 FORMAT "%13.9" NUMBER 25 /end CHARACTERISTIC
/begin CHARACTERISTIC DFES_Env.xSet99_CA "/" VAL_BLK 0x800731A4 ValA_Wu16 161.000000000 Signals_IntSigNumVerb 0.00 161.000000000 FORMAT "%13.9" NUMBER 25 /end CHARACTERISTIC
/begin CHARACTERISTIC DFES_Env.xSet100_CA "/" VAL_BLK 0x800731D6 ValA_Wu16 161.000000000 Signals_IntSigNumVerb 0.00 161.000000000 FORMAT "%13.9" NUMBER 25 /end CHARACTERISTIC
/begin CHARACTERISTIC DFES_Env.xSet101_CA "/" VAL_BLK 0x80073208 ValA_Wu16 161.000000000 Signals_IntSigNumVerb 0.00 161.000000000 FORMAT "%13.9" NUMBER 25 /end CHARACTERISTIC
/begin CHARACTERISTIC DFES_Env.xSet102_CA "/" VAL_BLK 0x8007323A ValA_Wu16 161.000000000 Signals_IntSigNumVerb 0.00 161.000000000 FORMAT "%13.9" NUMBER 25 /end CHARACTERISTIC
/begin CHARACTERISTIC DFES_Env.xSet103_CA "/" VAL_BLK 0x8007326C ValA_Wu16 161.000000000 Signals_IntSigNumVerb 0.00 161.000000000 FORMAT "%13.9" NUMBER 25 /end CHARACTERISTIC
/begin CHARACTERISTIC DFES_Env.xSet104_CA "/" VAL_BLK 0x8007329E ValA_Wu16 161.000000000 Signals_IntSigNumVerb 0.00 161.000000000 FORMAT "%13.9" NUMBER 25 /end CHARACTERISTIC
/begin CHARACTERISTIC DFES_Env.xSet105_CA "/" VAL_BLK 0x800732D0 ValA_Wu16 161.000000000 Signals_IntSigNumVerb 0.00 161.000000000 FORMAT "%13.9" NUMBER 25 /end CHARACTERISTIC
/begin CHARACTERISTIC DFES_Env.xSet106_CA "/" VAL_BLK 0x80073302 ValA_Wu16 161.000000000 Signals_IntSigNumVerb 0.00 161.000000000 FORMAT "%13.9" NUMBER 25 /end CHARACTERISTIC
/begin CHARACTERISTIC DFES_Env.xSet107_CA "/" VAL_BLK 0x80073334 ValA_Wu16 161.000000000 Signals_IntSigNumVerb 0.00 161.000000000 FORMAT "%13.9" NUMBER 25 /end CHARACTERISTIC
/begin CHARACTERISTIC DFES_Env.xSet108_CA "/" VAL_BLK 0x80073366 ValA_Wu16 161.000000000 Signals_IntSigNumVerb 0.00 161.000000000 FORMAT "%13.9" NUMBER 25 /end CHARACTERISTIC
/begin CHARACTERISTIC DFES_Env.xSet109_CA "/" VAL_BLK 0x80073398 ValA_Wu16 161.000000000 Signals_IntSigNumVerb 0.00 161.000000000 FORMAT "%13.9" NUMBER 25 /end CHARACTERISTIC
/begin CHARACTERISTIC DFES_Env.xSet110_CA "/" VAL_BLK 0x800733CA ValA_Wu16 161.000000000 Signals_IntSigNumVerb 0.00 161.000000000 FORMAT "%13.9" NUMBER 25 /end CHARACTERISTIC
/begin CHARACTERISTIC DFES_GrpRpr.DFC_AirCtlGovDvtEOMMax_C "/" VALUE 0x800733FC Val_Wu16 576. DFC_Verb 0.00 576. FORMAT "%2.0" /end CHARACTERISTIC
/begin CHARACTERISTIC DFES_GrpRpr.DFC_AirCtlGovDvtEOMMin_C "/" VALUE 0x800733FE Val_Wu16 576. DFC_Verb 0.00 576. FORMAT "%2.0" /end CHARACTERISTIC
/begin CHARACTERISTIC DFES_GrpRpr.DFC_AirCtlGovDvtMax_C "/" VALUE 0x80073400 Val_Wu16 576. DFC_Verb 0.00 576. FORMAT "%2.0" /end CHARACTERISTIC
/begin CHARACTERISTIC DFES_GrpRpr.DFC_AirCtlGovDvtMin_C "/" VALUE 0x80073402 Val_Wu16 576. DFC_Verb 0.00 576. FORMAT "%2.0" /end CHARACTERISTIC
/begin CHARACTERISTIC DFES_GrpRpr.DFC_Cj945SpiCom1_C "/" VALUE 0x80073404 Val_Wu16 576. DFC_Verb 0.00 576. FORMAT "%2.0" /end CHARACTERISTIC
/begin CHARACTERISTIC DFES_GrpRpr.DFC_ComButtonMSASig_C "/" VALUE 0x80073406 Val_Wu16 576. DFC_Verb 0.00 576. FORMAT "%2.0" /end CHARACTERISTIC
/begin CHARACTERISTIC DFES_GrpRpr.DFC_ComButtonMSATo_C "/" VALUE 0x80073408 Val_Wu16 576. DFC_Verb 0.00 576. FORMAT "%2.0" /end CHARACTERISTIC
/begin CHARACTERISTIC DFES_GrpRpr.DFC_ComGearboxData2Sig_C "/" VALUE 0x8007340A Val_Wu16 576. DFC_Verb 0.00 576. FORMAT "%2.0" /end CHARACTERISTIC
/begin CHARACTERISTIC DFES_GrpRpr.DFC_ComGearboxData2To_C "/" VALUE 0x8007340C Val_Wu16 576. DFC_Verb 0.00 576. FORMAT "%2.0" /end CHARACTERISTIC
/begin CHARACTERISTIC DFES_GrpRpr.DFC_ComGearboxDataSig_C "/" VALUE 0x8007340E Val_Wu16 576. DFC_Verb 0.00 576. FORMAT "%2.0" /end CHARACTERISTIC
/begin CHARACTERISTIC DFES_GrpRpr.DFC_ComGearboxDataTo_C "/" VALUE 0x80073410 Val_Wu16 576. DFC_Verb 0.00 576. FORMAT "%2.0" /end CHARACTERISTIC
/begin CHARACTERISTIC DFES_GrpRpr.DFC_ComHeatACSig_C "/" VALUE 0x80073412 Val_Wu16 576. DFC_Verb 0.00 576. FORMAT "%2.0" /end CHARACTERISTIC
/begin CHARACTERISTIC DFES_GrpRpr.DFC_ComHeatACTo_C "/" VALUE 0x80073414 Val_Wu16 576. DFC_Verb 0.00 576. FORMAT "%2.0" /end CHARACTERISTIC
/begin CHARACTERISTIC DFES_GrpRpr.DFC_ComLenkradwinkelSig_C "/" VALUE 0x80073416 Val_Wu16 576. DFC_Verb 0.00 576. FORMAT "%2.0" /end CHARACTERISTIC
/begin CHARACTERISTIC DFES_GrpRpr.DFC_ComLenkradwinkelTo_C "/" VALUE 0x80073418 Val_Wu16 576. DFC_Verb 0.00 576. FORMAT "%2.0" /end CHARACTERISTIC
/begin CHARACTERISTIC DFES_GrpRpr.DFC_ComMileageRangeSig_C "/" VALUE 0x8007341A Val_Wu16 576. DFC_Verb 0.00 576. FORMAT "%2.0" /end CHARACTERISTIC
/begin CHARACTERISTIC DFES_GrpRpr.DFC_ComMileageRangeTo_C "/" VALUE 0x8007341C Val_Wu16 576. DFC_Verb 0.00 576. FORMAT "%2.0" /end CHARACTERISTIC
/begin CHARACTERISTIC DFES_GrpRpr.DFC_ComPspSig_C "/" VALUE 0x8007341E Val_Wu16 576. DFC_Verb 0.00 576. FORMAT "%2.0" /end CHARACTERISTIC
/begin CHARACTERISTIC DFES_GrpRpr.DFC_ComPspTo_C "/" VALUE 0x80073420 Val_Wu16 576. DFC_Verb 0.00 576. FORMAT "%2.0" /end CHARACTERISTIC
/begin CHARACTERISTIC DFES_GrpRpr.DFC_ComShutOffPSPSig_C "/" VALUE 0x80073422 Val_Wu16 576. DFC_Verb 0.00 576. FORMAT "%2.0" /end CHARACTERISTIC
/begin CHARACTERISTIC DFES_GrpRpr.DFC_ComShutOffPSPTo_C "/" VALUE 0x80073424 Val_Wu16 576. DFC_Verb 0.00 576. FORMAT "%2.0" /end CHARACTERISTIC
/begin CHARACTERISTIC DFES_GrpRpr.DFC_ComStKombiCtr_C "/" VALUE 0x80073426 Val_Wu16 576. DFC_Verb 0.00 576. FORMAT "%2.0" /end CHARACTERISTIC
/begin CHARACTERISTIC DFES_GrpRpr.DFC_ComStKombiSig_C "/" VALUE 0x80073428 Val_Wu16 576. DFC_Verb 0.00 576. FORMAT "%2.0" /end CHARACTERISTIC
/begin CHARACTERISTIC DFES_GrpRpr.DFC_ComStKombiTo_C "/" VALUE 0x8007342A Val_Wu16 576. DFC_Verb 0.00 576. FORMAT "%2.0" /end CHARACTERISTIC
/begin CHARACTERISTIC DFES_GrpRpr.DFC_ComStateARSCtr_C "/" VALUE 0x8007342C Val_Wu16 576. DFC_Verb 0.00 576. FORMAT "%2.0" /end CHARACTERISTIC
/begin CHARACTERISTIC DFES_GrpRpr.DFC_ComStateARSSig_C "/" VALUE 0x8007342E Val_Wu16 576. DFC_Verb 0.00 576. FORMAT "%2.0" /end CHARACTERISTIC
/begin CHARACTERISTIC DFES_GrpRpr.DFC_ComStateARSTo_C "/" VALUE 0x80073430 Val_Wu16 576. DFC_Verb 0.00 576. FORMAT "%2.0" /end CHARACTERISTIC
/begin CHARACTERISTIC DFES_GrpRpr.DFC_ComStateDscSig_C "/" VALUE 0x80073432 Val_Wu16 576. DFC_Verb 0.00 576. FORMAT "%2.0" /end CHARACTERISTIC
/begin CHARACTERISTIC DFES_GrpRpr.DFC_ComStateDscTo_C "/" VALUE 0x80073434 Val_Wu16 576. DFC_Verb 0.00 576. FORMAT "%2.0" /end CHARACTERISTIC
/begin CHARACTERISTIC DFES_GrpRpr.DFC_ComStateSeatSig_C "/" VALUE 0x80073436 Val_Wu16 576. DFC_Verb 0.00 576. FORMAT "%2.0" /end CHARACTERISTIC
/begin CHARACTERISTIC DFES_GrpRpr.DFC_ComStateSeatTo_C "/" VALUE 0x80073438 Val_Wu16 576. DFC_Verb 0.00 576. FORMAT "%2.0" /end CHARACTERISTIC
/begin CHARACTERISTIC DFES_GrpRpr.DFC_ComTempRelTimeSig_C "/" VALUE 0x8007343A Val_Wu16 576. DFC_Verb 0.00 576. FORMAT "%2.0" /end CHARACTERISTIC
/begin CHARACTERISTIC DFES_GrpRpr.DFC_ComTempRelTimeTo_C "/" VALUE 0x8007343C Val_Wu16 576. DFC_Verb 0.00 576. FORMAT "%2.0" /end CHARACTERISTIC
/begin CHARACTERISTIC DFES_GrpRpr.DFC_ComTerminalChk_C "/" VALUE 0x8007343E Val_Wu16 576. DFC_Verb 0.00 576. FORMAT "%2.0" /end CHARACTERISTIC
/begin CHARACTERISTIC DFES_GrpRpr.DFC_ComTerminalCtr_C "/" VALUE 0x80073440 Val_Wu16 576. DFC_Verb 0.00 576. FORMAT "%2.0" /end CHARACTERISTIC
/begin CHARACTERISTIC DFES_GrpRpr.DFC_ComTerminalSig_C "/" VALUE 0x80073442 Val_Wu16 576. DFC_Verb 0.00 576. FORMAT "%2.0" /end CHARACTERISTIC
/begin CHARACTERISTIC DFES_GrpRpr.DFC_ComTerminalTo_C "/" VALUE 0x80073444 Val_Wu16 576. DFC_Verb 0.00 576. FORMAT "%2.0" /end CHARACTERISTIC
/begin CHARACTERISTIC DFES_GrpRpr.DFC_ComTimeDateSig_C "/" VALUE 0x80073446 Val_Wu16 576. DFC_Verb 0.00 576. FORMAT "%2.0" /end CHARACTERISTIC
/begin CHARACTERISTIC DFES_GrpRpr.DFC_ComTimeDateTo_C "/" VALUE 0x80073448 Val_Wu16 576. DFC_Verb 0.00 576. FORMAT "%2.0" /end CHARACTERISTIC
/begin CHARACTERISTIC DFES_GrpRpr.DFC_ComTrailerSig_C "/" VALUE 0x8007344A Val_Wu16 576. DFC_Verb 0.00 576. FORMAT "%2.0" /end CHARACTERISTIC
/begin CHARACTERISTIC DFES_GrpRpr.DFC_ComTrailerTo_C "/" VALUE 0x8007344C Val_Wu16 576. DFC_Verb 0.00 576. FORMAT "%2.0" /end CHARACTERISTIC
/begin CHARACTERISTIC DFES_GrpRpr.DFC_ComTrqDemandAfsChk_C "/" VALUE 0x8007344E Val_Wu16 576. DFC_Verb 0.00 576. FORMAT "%2.0" /end CHARACTERISTIC
/begin CHARACTERISTIC DFES_GrpRpr.DFC_ComTrqDemandAfsCtr_C "/" VALUE 0x80073450 Val_Wu16 576. DFC_Verb 0.00 576. FORMAT "%2.0" /end CHARACTERISTIC
/begin CHARACTERISTIC DFES_GrpRpr.DFC_ComTrqDemandAfsSig_C "/" VALUE 0x80073452 Val_Wu16 576. DFC_Verb 0.00 576. FORMAT "%2.0" /end CHARACTERISTIC
/begin CHARACTERISTIC DFES_GrpRpr.DFC_ComTrqDemandAfsTo_C "/" VALUE 0x80073454 Val_Wu16 576. DFC_Verb 0.00 576. FORMAT "%2.0" /end CHARACTERISTIC
/begin CHARACTERISTIC DFES_GrpRpr.DFC_ComTrqDemandDscChk_C "/" VALUE 0x80073456 Val_Wu16 576. DFC_Verb 0.00 576. FORMAT "%2.0" /end CHARACTERISTIC
/begin CHARACTERISTIC DFES_GrpRpr.DFC_ComTrqDemandDscCtr_C "/" VALUE 0x80073458 Val_Wu16 576. DFC_Verb 0.00 576. FORMAT "%2.0" /end CHARACTERISTIC
/begin CHARACTERISTIC DFES_GrpRpr.DFC_ComTrqDemandDscSig_C "/" VALUE 0x8007345A Val_Wu16 576. DFC_Verb 0.00 576. FORMAT "%2.0" /end CHARACTERISTIC
/begin CHARACTERISTIC DFES_GrpRpr.DFC_ComTrqDemandDscTo_C "/" VALUE 0x8007345C Val_Wu16 576. DFC_Verb 0.00 576. FORMAT "%2.0" /end CHARACTERISTIC
/begin CHARACTERISTIC DFES_GrpRpr.DFC_ComTrqDemandGbxChk_C "/" VALUE 0x8007345E Val_Wu16 576. DFC_Verb 0.00 576. FORMAT "%2.0" /end CHARACTERISTIC
/begin CHARACTERISTIC DFES_GrpRpr.DFC_ComTrqDemandGbxCtr_C "/" VALUE 0x80073460 Val_Wu16 576. DFC_Verb 0.00 576. FORMAT "%2.0" /end CHARACTERISTIC
/begin CHARACTERISTIC DFES_GrpRpr.DFC_ComTrqDemandGbxSig_C "/" VALUE 0x80073462 Val_Wu16 576. DFC_Verb 0.00 576. FORMAT "%2.0" /end CHARACTERISTIC
/begin CHARACTERISTIC DFES_GrpRpr.DFC_ComTrqDemandGbxTo_C "/" VALUE 0x80073464 Val_Wu16 576. DFC_Verb 0.00 576. FORMAT "%2.0" /end CHARACTERISTIC
/begin CHARACTERISTIC DFES_GrpRpr.DFC_ComVelocitySig_C "/" VALUE 0x80073466 Val_Wu16 576. DFC_Verb 0.00 576. FORMAT "%2.0" /end CHARACTERISTIC
/begin CHARACTERISTIC DFES_GrpRpr.DFC_ComVelocityTo_C "/" VALUE 0x80073468 Val_Wu16 576. DFC_Verb 0.00 576. FORMAT "%2.0" /end CHARACTERISTIC
/begin CHARACTERISTIC DFES_GrpRpr.DFC_ComWheelSpeedSig_C "/" VALUE 0x8007346A Val_Wu16 576. DFC_Verb 0.00 576. FORMAT "%2.0" /end CHARACTERISTIC
/begin CHARACTERISTIC DFES_GrpRpr.DFC_ComWheelSpeedTo_C "/" VALUE 0x8007346C Val_Wu16 576. DFC_Verb 0.00 576. FORMAT "%2.0" /end CHARACTERISTIC
/begin CHARACTERISTIC DFES_GrpRpr.DFC_ComZvKlappenSig_C "/" VALUE 0x8007346E Val_Wu16 576. DFC_Verb 0.00 576. FORMAT "%2.0" /end CHARACTERISTIC
/begin CHARACTERISTIC DFES_GrpRpr.DFC_ComZvKlappenTo_C "/" VALUE 0x80073470 Val_Wu16 576. DFC_Verb 0.00 576. FORMAT "%2.0" /end CHARACTERISTIC
/begin CHARACTERISTIC DFES_GrpRpr.DFC_Cy150SpiCom_C "/" VALUE 0x80073472 Val_Wu16 576. DFC_Verb 0.00 576. FORMAT "%2.0" /end CHARACTERISTIC
/begin CHARACTERISTIC DFES_GrpRpr.DFC_Cy320SpiCom_C "/" VALUE 0x80073474 Val_Wu16 576. DFC_Verb 0.00 576. FORMAT "%2.0" /end CHARACTERISTIC
/begin CHARACTERISTIC DFES_GrpRpr.DFC_ETCtlDvtInrMax_C "/" VALUE 0x80073476 Val_Wu16 576. DFC_Verb 0.00 576. FORMAT "%2.0" /end CHARACTERISTIC
/begin CHARACTERISTIC DFES_GrpRpr.DFC_ETCtlDvtInrMin_C "/" VALUE 0x80073478 Val_Wu16 576. DFC_Verb 0.00 576. FORMAT "%2.0" /end CHARACTERISTIC
/begin CHARACTERISTIC DFES_GrpRpr.DFC_ETCtlDvtOutrMax_C "/" VALUE 0x8007347A Val_Wu16 576. DFC_Verb 0.00 576. FORMAT "%2.0" /end CHARACTERISTIC
/begin CHARACTERISTIC DFES_GrpRpr.DFC_ETCtlDvtOutrMin_C "/" VALUE 0x8007347C Val_Wu16 576. DFC_Verb 0.00 576. FORMAT "%2.0" /end CHARACTERISTIC
/begin CHARACTERISTIC DFES_GrpRpr.DFC_Fan4WinErr1_C "/" VALUE 0x8007347E Val_Wu16 576. DFC_Verb 0.00 576. FORMAT "%2.0" /end CHARACTERISTIC
/begin CHARACTERISTIC DFES_GrpRpr.DFC_Fan4WinErr2_C "/" VALUE 0x80073480 Val_Wu16 576. DFC_Verb 0.00 576. FORMAT "%2.0" /end CHARACTERISTIC
/begin CHARACTERISTIC DFES_GrpRpr.DFC_Fan4WinErr3_C "/" VALUE 0x80073482 Val_Wu16 576. DFC_Verb 0.00 576. FORMAT "%2.0" /end CHARACTERISTIC
/begin CHARACTERISTIC DFES_GrpRpr.DFC_Fan4WinErr4_C "/" VALUE 0x80073484 Val_Wu16 576. DFC_Verb 0.00 576. FORMAT "%2.0" /end CHARACTERISTIC
/begin CHARACTERISTIC DFES_GrpRpr.DFC_FanSCG_C "/" VALUE 0x80073486 Val_Wu16 576. DFC_Verb 0.00 576. FORMAT "%2.0" /end CHARACTERISTIC
/begin CHARACTERISTIC DFES_GrpRpr.DFC_PCRGovDvtLPMax_C "/" VALUE 0x80073488 Val_Wu16 576. DFC_Verb 0.00 576. FORMAT "%2.0" /end CHARACTERISTIC
/begin CHARACTERISTIC DFES_GrpRpr.DFC_PCRGovDvtLPMin_C "/" VALUE 0x8007348A Val_Wu16 576. DFC_Verb 0.00 576. FORMAT "%2.0" /end CHARACTERISTIC
/begin CHARACTERISTIC DFES_GrpRpr.DFC_PCRGovDvtMax_C "/" VALUE 0x8007348C Val_Wu16 576. DFC_Verb 0.00 576. FORMAT "%2.0" /end CHARACTERISTIC
/begin CHARACTERISTIC DFES_GrpRpr.DFC_PCRGovDvtMin_C "/" VALUE 0x8007348E Val_Wu16 576. DFC_Verb 0.00 576. FORMAT "%2.0" /end CHARACTERISTIC
/begin CHARACTERISTIC DFES_GrpRpr.DFC_RailCPC1_C "/" VALUE 0x80073490 Val_Wu16 576. DFC_Verb 0.00 576. FORMAT "%2.0" /end CHARACTERISTIC
/begin CHARACTERISTIC DFES_GrpRpr.DFC_RailCPC3_C "/" VALUE 0x80073492 Val_Wu16 576. DFC_Verb 0.00 576. FORMAT "%2.0" /end CHARACTERISTIC
/begin CHARACTERISTIC DFES_GrpRpr.DFC_RailCPC4_C "/" VALUE 0x80073494 Val_Wu16 576. DFC_Verb 0.00 576. FORMAT "%2.0" /end CHARACTERISTIC
/begin CHARACTERISTIC DFES_GrpRpr.DFC_RailMeUn0_C "/" VALUE 0x80073496 Val_Wu16 576. DFC_Verb 0.00 576. FORMAT "%2.0" /end CHARACTERISTIC
/begin CHARACTERISTIC DFES_GrpRpr.DFC_RailMeUn1_C "/" VALUE 0x80073498 Val_Wu16 576. DFC_Verb 0.00 576. FORMAT "%2.0" /end CHARACTERISTIC
/begin CHARACTERISTIC DFES_GrpRpr.DFC_RailMeUn2_C "/" VALUE 0x8007349A Val_Wu16 576. DFC_Verb 0.00 576. FORMAT "%2.0" /end CHARACTERISTIC
/begin CHARACTERISTIC DFES_GrpRpr.DFC_RailMeUn3_C "/" VALUE 0x8007349C Val_Wu16 576. DFC_Verb 0.00 576. FORMAT "%2.0" /end CHARACTERISTIC
/begin CHARACTERISTIC DFES_GrpRpr.DFC_RailMeUn4_C "/" VALUE 0x8007349E Val_Wu16 576. DFC_Verb 0.00 576. FORMAT "%2.0" /end CHARACTERISTIC
/begin CHARACTERISTIC DFES_GrpRpr.DFC_RailPCV0_C "/" VALUE 0x800734A0 Val_Wu16 576. DFC_Verb 0.00 576. FORMAT "%2.0" /end CHARACTERISTIC
/begin CHARACTERISTIC DFES_GrpRpr.DFC_RailPCV1_C "/" VALUE 0x800734A2 Val_Wu16 576. DFC_Verb 0.00 576. FORMAT "%2.0" /end CHARACTERISTIC
/begin CHARACTERISTIC DFES_GrpRpr.DFC_RailPCV2_C "/" VALUE 0x800734A4 Val_Wu16 576. DFC_Verb 0.00 576. FORMAT "%2.0" /end CHARACTERISTIC
/begin CHARACTERISTIC DFES_GrpRpr.DFC_RailPCV3_C "/" VALUE 0x800734A6 Val_Wu16 576. DFC_Verb 0.00 576. FORMAT "%2.0" /end CHARACTERISTIC
/begin CHARACTERISTIC DFES_GrpRpr.DFC_RailPCV4_C "/" VALUE 0x800734A8 Val_Wu16 576. DFC_Verb 0.00 576. FORMAT "%2.0" /end CHARACTERISTIC
/begin CHARACTERISTIC DFES_GrpRpr.DFC_RailPMonStrt_C "/" VALUE 0x800734AA Val_Wu16 576. DFC_Verb 0.00 576. FORMAT "%2.0" /end CHARACTERISTIC
/begin CHARACTERISTIC DFES_GrpRpr.DFC_SSpMon1_C "/" VALUE 0x800734AC Val_Wu16 576. DFC_Verb 0.00 576. FORMAT "%2.0" /end CHARACTERISTIC
/begin CHARACTERISTIC DFES_GrpRpr.DFC_SSpMon2_C "/" VALUE 0x800734AE Val_Wu16 576. DFC_Verb 0.00 576. FORMAT "%2.0" /end CHARACTERISTIC
/begin CHARACTERISTIC DFES_GrpRpr.DFC_SSpMon3_C "/" VALUE 0x800734B0 Val_Wu16 576. DFC_Verb 0.00 576. FORMAT "%2.0" /end CHARACTERISTIC
/begin CHARACTERISTIC DFES_GrpRpr.DFC_Sia_E1_C "/" VALUE 0x800734B2 Val_Wu16 576. DFC_Verb 0.00 576. FORMAT "%2.0" /end CHARACTERISTIC
/begin CHARACTERISTIC DFES_GrpRpr.DFC_Sia_E10_C "/" VALUE 0x800734B4 Val_Wu16 576. DFC_Verb 0.00 576. FORMAT "%2.0" /end CHARACTERISTIC
/begin CHARACTERISTIC DFES_GrpRpr.DFC_Sia_E11_C "/" VALUE 0x800734B6 Val_Wu16 576. DFC_Verb 0.00 576. FORMAT "%2.0" /end CHARACTERISTIC
/begin CHARACTERISTIC DFES_GrpRpr.DFC_Sia_E12_C "/" VALUE 0x800734B8 Val_Wu16 576. DFC_Verb 0.00 576. FORMAT "%2.0" /end CHARACTERISTIC
/begin CHARACTERISTIC DFES_GrpRpr.DFC_Sia_E13_C "/" VALUE 0x800734BA Val_Wu16 576. DFC_Verb 0.00 576. FORMAT "%2.0" /end CHARACTERISTIC
/begin CHARACTERISTIC DFES_GrpRpr.DFC_Sia_E14_C "/" VALUE 0x800734BC Val_Wu16 576. DFC_Verb 0.00 576. FORMAT "%2.0" /end CHARACTERISTIC
/begin CHARACTERISTIC DFES_GrpRpr.DFC_Sia_E15_C "/" VALUE 0x800734BE Val_Wu16 576. DFC_Verb 0.00 576. FORMAT "%2.0" /end CHARACTERISTIC
/begin CHARACTERISTIC DFES_GrpRpr.DFC_Sia_E2_C "/" VALUE 0x800734C0 Val_Wu16 576. DFC_Verb 0.00 576. FORMAT "%2.0" /end CHARACTERISTIC
/begin CHARACTERISTIC DFES_GrpRpr.DFC_Sia_E3_C "/" VALUE 0x800734C2 Val_Wu16 576. DFC_Verb 0.00 576. FORMAT "%2.0" /end CHARACTERISTIC
/begin CHARACTERISTIC DFES_GrpRpr.DFC_Sia_E4_C "/" VALUE 0x800734C4 Val_Wu16 576. DFC_Verb 0.00 576. FORMAT "%2.0" /end CHARACTERISTIC
/begin CHARACTERISTIC DFES_GrpRpr.DFC_Sia_E5_C "/" VALUE 0x800734C6 Val_Wu16 576. DFC_Verb 0.00 576. FORMAT "%2.0" /end CHARACTERISTIC
/begin CHARACTERISTIC DFES_GrpRpr.DFC_Sia_E6_C "/" VALUE 0x800734C8 Val_Wu16 576. DFC_Verb 0.00 576. FORMAT "%2.0" /end CHARACTERISTIC
/begin CHARACTERISTIC DFES_GrpRpr.DFC_Sia_E7_C "/" VALUE 0x800734CA Val_Wu16 576. DFC_Verb 0.00 576. FORMAT "%2.0" /end CHARACTERISTIC
/begin CHARACTERISTIC DFES_GrpRpr.DFC_Sia_E8_C "/" VALUE 0x800734CC Val_Wu16 576. DFC_Verb 0.00 576. FORMAT "%2.0" /end CHARACTERISTIC
/begin CHARACTERISTIC DFES_GrpRpr.DFC_Sia_E9_C "/" VALUE 0x800734CE Val_Wu16 576. DFC_Verb 0.00 576. FORMAT "%2.0" /end CHARACTERISTIC
/begin CHARACTERISTIC DFES_GrpRpr.DFC_ThrVlv4WinErr1_C "/" VALUE 0x800734D0 Val_Wu16 576. DFC_Verb 0.00 576. FORMAT "%2.0" /end CHARACTERISTIC
/begin CHARACTERISTIC DFES_GrpRpr.DFC_ThrVlv4WinErr2_C "/" VALUE 0x800734D2 Val_Wu16 576. DFC_Verb 0.00 576. FORMAT "%2.0" /end CHARACTERISTIC
/begin CHARACTERISTIC DFES_GrpRpr.DFC_ThrVlv4WinErr3_C "/" VALUE 0x800734D4 Val_Wu16 576. DFC_Verb 0.00 576. FORMAT "%2.0" /end CHARACTERISTIC
/begin CHARACTERISTIC DFES_GrpRpr.DFC_ThrVlv4WinErr4_C "/" VALUE 0x800734D6 Val_Wu16 576. DFC_Verb 0.00 576. FORMAT "%2.0" /end CHARACTERISTIC
/begin CHARACTERISTIC DFES_GrpRpr.DFC_ThrVlvSCG_C "/" VALUE 0x800734D8 Val_Wu16 576. DFC_Verb 0.00 576. FORMAT "%2.0" /end CHARACTERISTIC
/begin CHARACTERISTIC DFES_GrpRpr.DFC_TrbCh4WinErr1_C "/" VALUE 0x800734DA Val_Wu16 576. DFC_Verb 0.00 576. FORMAT "%2.0" /end CHARACTERISTIC
/begin CHARACTERISTIC DFES_GrpRpr.DFC_TrbCh4WinErr2_C "/" VALUE 0x800734DC Val_Wu16 576. DFC_Verb 0.00 576. FORMAT "%2.0" /end CHARACTERISTIC
/begin CHARACTERISTIC DFES_GrpRpr.DFC_TrbCh4WinErr3_C "/" VALUE 0x800734DE Val_Wu16 576. DFC_Verb 0.00 576. FORMAT "%2.0" /end CHARACTERISTIC
/begin CHARACTERISTIC DFES_GrpRpr.DFC_TrbCh4WinErr4_C "/" VALUE 0x800734E0 Val_Wu16 576. DFC_Verb 0.00 576. FORMAT "%2.0" /end CHARACTERISTIC
/begin CHARACTERISTIC DFES_GrpRpr.DFC_TrbChSCG_C "/" VALUE 0x800734E2 Val_Wu16 576. DFC_Verb 0.00 576. FORMAT "%2.0" /end CHARACTERISTIC
/begin CHARACTERISTIC DFES_GrpRpr.DFC_TrbChSRCMax_C "/" VALUE 0x800734E4 Val_Wu16 576. DFC_Verb 0.00 576. FORMAT "%2.0" /end CHARACTERISTIC
/begin CHARACTERISTIC DFES_GrpRpr.DFC_TrbChSRCMin_C "/" VALUE 0x800734E6 Val_Wu16 576. DFC_Verb 0.00 576. FORMAT "%2.0" /end CHARACTERISTIC
/begin CHARACTERISTIC DFES_GrpRpr.DFC_WaHtEl4WinErr1_C "/" VALUE 0x800734E8 Val_Wu16 576. DFC_Verb 0.00 576. FORMAT "%2.0" /end CHARACTERISTIC
/begin CHARACTERISTIC DFES_GrpRpr.DFC_WaHtEl4WinErr2_C "/" VALUE 0x800734EA Val_Wu16 576. DFC_Verb 0.00 576. FORMAT "%2.0" /end CHARACTERISTIC
/begin CHARACTERISTIC DFES_GrpRpr.DFC_WaHtEl4WinErr3_C "/" VALUE 0x800734EC Val_Wu16 576. DFC_Verb 0.00 576. FORMAT "%2.0" /end CHARACTERISTIC
/begin CHARACTERISTIC DFES_GrpRpr.DFC_WaHtEl4WinErr4_C "/" VALUE 0x800734EE Val_Wu16 576. DFC_Verb 0.00 576. FORMAT "%2.0" /end CHARACTERISTIC
/begin CHARACTERISTIC DFES_GrpRpr.DFC_WaHtElSCG_C "/" VALUE 0x800734F0 Val_Wu16 576. DFC_Verb 0.00 576. FORMAT "%2.0" /end CHARACTERISTIC
/begin CHARACTERISTIC DFES_GrpRpr.DFC_ETClbETFltMax_C "/" VALUE 0x800734F2 Val_Wu16 576. DFC_Verb 0.00 576. FORMAT "%2.0" /end CHARACTERISTIC
/begin CHARACTERISTIC DFES_GrpRpr.DFC_ETClbETFltMin_C "/" VALUE 0x800734F4 Val_Wu16 576. DFC_Verb 0.00 576. FORMAT "%2.0" /end CHARACTERISTIC
/begin CHARACTERISTIC DFES_GrpRpr.DFC_InjCrvInjLimChrgBal_C "/" VALUE 0x800734F6 Val_Wu16 576. DFC_Verb 0.00 576. FORMAT "%2.0" /end CHARACTERISTIC
/begin CHARACTERISTIC DFES_GrpRpr.DFC_InjCrvInjLimQntBal_C "/" VALUE 0x800734F8 Val_Wu16 576. DFC_Verb 0.00 576. FORMAT "%2.0" /end CHARACTERISTIC
/begin CHARACTERISTIC DFES_GrpRpr.DFC_InjCrvInjLimSys_C "/" VALUE 0x800734FA Val_Wu16 576. DFC_Verb 0.00 576. FORMAT "%2.0" /end CHARACTERISTIC
/begin CHARACTERISTIC DFES_GrpRpr.DFC_InjCrvNumInjRtmLim_C "/" VALUE 0x800734FC Val_Wu16 576. DFC_Verb 0.00 576. FORMAT "%2.0" /end CHARACTERISTIC
/begin CHARACTERISTIC DFES_GrpRpr.DFC_LSUHtCoupSig_0_C "/" VALUE 0x800734FE Val_Wu16 576. DFC_Verb 0.00 576. FORMAT "%2.0" /end CHARACTERISTIC
/begin CHARACTERISTIC DFES_GrpRpr.DFC_LSUHtCoupSig_1_C "/" VALUE 0x80073500 Val_Wu16 576. DFC_Verb 0.00 576. FORMAT "%2.0" /end CHARACTERISTIC
/begin CHARACTERISTIC DFES_GrpRpr.DFC_LSUHtCoupSig_2_C "/" VALUE 0x80073502 Val_Wu16 576. DFC_Verb 0.00 576. FORMAT "%2.0" /end CHARACTERISTIC
/begin CHARACTERISTIC DFES_GrpRpr.DFC_LSUHtCoupSig_3_C "/" VALUE 0x80073504 Val_Wu16 576. DFC_Verb 0.00 576. FORMAT "%2.0" /end CHARACTERISTIC
/begin CHARACTERISTIC DFES_GrpRpr.DFC_CtT_C "/" VALUE 0x80073506 Val_Wu16 576. DFC_Verb 0.00 576. FORMAT "%2.0" /end CHARACTERISTIC
/begin CHARACTERISTIC DFES_GrpRpr.DFC_DSMDummy_C "/" VALUE 0x80073508 Val_Wu16 576. DFC_Verb 0.00 576. FORMAT "%2.0" /end CHARACTERISTIC
/begin CHARACTERISTIC DFES_GrpRpr.DFC_MeUnOL_C "/" VALUE 0x8007350A Val_Wu16 576. DFC_Verb 0.00 576. FORMAT "%2.0" /end CHARACTERISTIC
/begin CHARACTERISTIC DFES_GrpRpr.DFC_MeUnSCB_C "/" VALUE 0x8007350C Val_Wu16 576. DFC_Verb 0.00 576. FORMAT "%2.0" /end CHARACTERISTIC
/begin CHARACTERISTIC DFES_GrpRpr.DFC_MeUnSRCMax_C "/" VALUE 0x8007350E Val_Wu16 576. DFC_Verb 0.00 576. FORMAT "%2.0" /end CHARACTERISTIC
/begin CHARACTERISTIC DFES_GrpRpr.DFC_MeUnSRCMin_C "/" VALUE 0x80073510 Val_Wu16 576. DFC_Verb 0.00 576. FORMAT "%2.0" /end CHARACTERISTIC
/begin CHARACTERISTIC DFES_GrpRpr.DFC_PCVOL_C "/" VALUE 0x80073512 Val_Wu16 576. DFC_Verb 0.00 576. FORMAT "%2.0" /end CHARACTERISTIC
/begin CHARACTERISTIC DFES_GrpRpr.DFC_PCVSCB_C "/" VALUE 0x80073514 Val_Wu16 576. DFC_Verb 0.00 576. FORMAT "%2.0" /end CHARACTERISTIC
/begin CHARACTERISTIC DFES_GrpRpr.DFC_PCVSRCMax_C "/" VALUE 0x80073516 Val_Wu16 576. DFC_Verb 0.00 576. FORMAT "%2.0" /end CHARACTERISTIC
/begin CHARACTERISTIC DFES_GrpRpr.DFC_PCVSRCMin_C "/" VALUE 0x80073518 Val_Wu16 576. DFC_Verb 0.00 576. FORMAT "%2.0" /end CHARACTERISTIC
/begin CHARACTERISTIC DFES_GrpRpr.DFC_RailPSRCMax_C "/" VALUE 0x8007351A Val_Wu16 576. DFC_Verb 0.00 576. FORMAT "%2.0" /end CHARACTERISTIC
/begin CHARACTERISTIC DFES_GrpRpr.DFC_RailPSRCMin_C "/" VALUE 0x8007351C Val_Wu16 576. DFC_Verb 0.00 576. FORMAT "%2.0" /end CHARACTERISTIC
/begin CHARACTERISTIC DFES_GrpRpr.DFC_IVActrVltgSRCMax_C "/" VALUE 0x8007351E Val_Wu16 576. DFC_Verb 0.00 576. FORMAT "%2.0" /end CHARACTERISTIC
/begin CHARACTERISTIC DFES_GrpRpr.DFC_IVActrVltgSRCMin_C "/" VALUE 0x80073520 Val_Wu16 576. DFC_Verb 0.00 576. FORMAT "%2.0" /end CHARACTERISTIC
/begin CHARACTERISTIC DFES_GrpRpr.DFC_IVPSplyDCDC_C "/" VALUE 0x80073522 Val_Wu16 576. DFC_Verb 0.00 576. FORMAT "%2.0" /end CHARACTERISTIC
/begin CHARACTERISTIC DFES_GrpRpr.DFC_IVPSplyVltgSRCMax_C "/" VALUE 0x80073524 Val_Wu16 576. DFC_Verb 0.00 576. FORMAT "%2.0" /end CHARACTERISTIC
/begin CHARACTERISTIC DFES_GrpRpr.DFC_IVPSplyVltgSRCMin_C "/" VALUE 0x80073526 Val_Wu16 576. DFC_Verb 0.00 576. FORMAT "%2.0" /end CHARACTERISTIC
/begin CHARACTERISTIC DFES_GrpRpr.DFC_AFSOffsDrftMax_C "/" VALUE 0x80073528 Val_Wu16 576. DFC_Verb 0.00 576. FORMAT "%2.0" /end CHARACTERISTIC
/begin CHARACTERISTIC DFES_GrpRpr.DFC_AFSOffsDrftMin_C "/" VALUE 0x8007352A Val_Wu16 576. DFC_Verb 0.00 576. FORMAT "%2.0" /end CHARACTERISTIC
/begin CHARACTERISTIC DFES_GrpRpr.DFC_AFSSRCCorMax_C "/" VALUE 0x8007352C Val_Wu16 576. DFC_Verb 0.00 576. FORMAT "%2.0" /end CHARACTERISTIC
/begin CHARACTERISTIC DFES_GrpRpr.DFC_AFSSRCCorMin_C "/" VALUE 0x8007352E Val_Wu16 576. DFC_Verb 0.00 576. FORMAT "%2.0" /end CHARACTERISTIC
/begin CHARACTERISTIC DFES_GrpRpr.DFC_AFSSRCRawMax_C "/" VALUE 0x80073530 Val_Wu16 576. DFC_Verb 0.00 576. FORMAT "%2.0" /end CHARACTERISTIC
/begin CHARACTERISTIC DFES_GrpRpr.DFC_AFSSRCRawMin_C "/" VALUE 0x80073532 Val_Wu16 576. DFC_Verb 0.00 576. FORMAT "%2.0" /end CHARACTERISTIC
/begin CHARACTERISTIC DFES_GrpRpr.DFC_AFSSetyDrftMax_C "/" VALUE 0x80073534 Val_Wu16 576. DFC_Verb 0.00 576. FORMAT "%2.0" /end CHARACTERISTIC
/begin CHARACTERISTIC DFES_GrpRpr.DFC_AFSSetyDrftMin_C "/" VALUE 0x80073536 Val_Wu16 576. DFC_Verb 0.00 576. FORMAT "%2.0" /end CHARACTERISTIC
/begin CHARACTERISTIC DFES_GrpRpr.DFC_AirCClntPAnaSRCMax_C "/" VALUE 0x80073538 Val_Wu16 576. DFC_Verb 0.00 576. FORMAT "%2.0" /end CHARACTERISTIC
/begin CHARACTERISTIC DFES_GrpRpr.DFC_AirCClntPAnaSRCMin_C "/" VALUE 0x8007353A Val_Wu16 576. DFC_Verb 0.00 576. FORMAT "%2.0" /end CHARACTERISTIC
/begin CHARACTERISTIC DFES_GrpRpr.DFC_AirCClntPPerSRCMax_C "/" VALUE 0x8007353C Val_Wu16 576. DFC_Verb 0.00 576. FORMAT "%2.0" /end CHARACTERISTIC
/begin CHARACTERISTIC DFES_GrpRpr.DFC_AirCClntPPerSRCMin_C "/" VALUE 0x8007353E Val_Wu16 576. DFC_Verb 0.00 576. FORMAT "%2.0" /end CHARACTERISTIC
/begin CHARACTERISTIC DFES_GrpRpr.DFC_AirCClntPdcycSRCMax_C "/" VALUE 0x80073540 Val_Wu16 576. DFC_Verb 0.00 576. FORMAT "%2.0" /end CHARACTERISTIC
/begin CHARACTERISTIC DFES_GrpRpr.DFC_AirCClntPdcycSRCMin_C "/" VALUE 0x80073542 Val_Wu16 576. DFC_Verb 0.00 576. FORMAT "%2.0" /end CHARACTERISTIC
/begin CHARACTERISTIC DFES_GrpRpr.DFC_AirCCmprOL_C "/" VALUE 0x80073544 Val_Wu16 576. DFC_Verb 0.00 576. FORMAT "%2.0" /end CHARACTERISTIC
/begin CHARACTERISTIC DFES_GrpRpr.DFC_AirCCmprRedTrqOL_C "/" VALUE 0x80073546 Val_Wu16 576. DFC_Verb 0.00 576. FORMAT "%2.0" /end CHARACTERISTIC
/begin CHARACTERISTIC DFES_GrpRpr.DFC_AirCCmprRedTrqSCB_C "/" VALUE 0x80073548 Val_Wu16 576. DFC_Verb 0.00 576. FORMAT "%2.0" /end CHARACTERISTIC
/begin CHARACTERISTIC DFES_GrpRpr.DFC_AirCCmprRedTrqSCG_C "/" VALUE 0x8007354A Val_Wu16 576. DFC_Verb 0.00 576. FORMAT "%2.0" /end CHARACTERISTIC
/begin CHARACTERISTIC DFES_GrpRpr.DFC_AirCCmprSCB_C "/" VALUE 0x8007354C Val_Wu16 576. DFC_Verb 0.00 576. FORMAT "%2.0" /end CHARACTERISTIC
/begin CHARACTERISTIC DFES_GrpRpr.DFC_AirCCmprSCG_C "/" VALUE 0x8007354E Val_Wu16 576. DFC_Verb 0.00 576. FORMAT "%2.0" /end CHARACTERISTIC
/begin CHARACTERISTIC DFES_GrpRpr.DFC_AirCSwtNpl_C "/" VALUE 0x80073550 Val_Wu16 576. DFC_Verb 0.00 576. FORMAT "%2.0" /end CHARACTERISTIC
/begin CHARACTERISTIC DFES_GrpRpr.DFC_AirCSwtSig_C "/" VALUE 0x80073552 Val_Wu16 576. DFC_Verb 0.00 576. FORMAT "%2.0" /end CHARACTERISTIC
/begin CHARACTERISTIC DFES_GrpRpr.DFC_BattUSRCMax_C "/" VALUE 0x80073554 Val_Wu16 576. DFC_Verb 0.00 576. FORMAT "%2.0" /end CHARACTERISTIC
/begin CHARACTERISTIC DFES_GrpRpr.DFC_BattUSRCMin_C "/" VALUE 0x80073556 Val_Wu16 576. DFC_Verb 0.00 576. FORMAT "%2.0" /end CHARACTERISTIC
/begin CHARACTERISTIC DFES_GrpRpr.DFC_BrkNpl_C "/" VALUE 0x80073558 Val_Wu16 576. DFC_Verb 0.00 576. FORMAT "%2.0" /end CHARACTERISTIC
/begin CHARACTERISTIC DFES_GrpRpr.DFC_BrkPSRCMax_C "/" VALUE 0x8007355A Val_Wu16 576. DFC_Verb 0.00 576. FORMAT "%2.0" /end CHARACTERISTIC
/begin CHARACTERISTIC DFES_GrpRpr.DFC_BrkPSRCMin_C "/" VALUE 0x8007355C Val_Wu16 576. DFC_Verb 0.00 576. FORMAT "%2.0" /end CHARACTERISTIC
/begin CHARACTERISTIC DFES_GrpRpr.DFC_BrkSig_C "/" VALUE 0x8007355E Val_Wu16 576. DFC_Verb 0.00 576. FORMAT "%2.0" /end CHARACTERISTIC
/begin CHARACTERISTIC DFES_GrpRpr.DFC_CByVlvOL_C "/" VALUE 0x80073560 Val_Wu16 576. DFC_Verb 0.00 576. FORMAT "%2.0" /end CHARACTERISTIC
/begin CHARACTERISTIC DFES_GrpRpr.DFC_CByVlvSCB_C "/" VALUE 0x80073562 Val_Wu16 576. DFC_Verb 0.00 576. FORMAT "%2.0" /end CHARACTERISTIC
/begin CHARACTERISTIC DFES_GrpRpr.DFC_CByVlvSCG_C "/" VALUE 0x80073564 Val_Wu16 576. DFC_Verb 0.00 576. FORMAT "%2.0" /end CHARACTERISTIC
/begin CHARACTERISTIC DFES_GrpRpr.DFC_CEngDsTSRCMax_C "/" VALUE 0x80073566 Val_Wu16 576. DFC_Verb 0.00 576. FORMAT "%2.0" /end CHARACTERISTIC
/begin CHARACTERISTIC DFES_GrpRpr.DFC_CEngDsTSRCMin_C "/" VALUE 0x80073568 Val_Wu16 576. DFC_Verb 0.00 576. FORMAT "%2.0" /end CHARACTERISTIC
/begin CHARACTERISTIC DFES_GrpRpr.DFC_CEngDsTSig_C "/" VALUE 0x8007356A Val_Wu16 576. DFC_Verb 0.00 576. FORMAT "%2.0" /end CHARACTERISTIC
/begin CHARACTERISTIC DFES_GrpRpr.DFC_CEngUsTSRCMax_C "/" VALUE 0x8007356C Val_Wu16 576. DFC_Verb 0.00 576. FORMAT "%2.0" /end CHARACTERISTIC
/begin CHARACTERISTIC DFES_GrpRpr.DFC_CEngUsTSRCMin_C "/" VALUE 0x8007356E Val_Wu16 576. DFC_Verb 0.00 576. FORMAT "%2.0" /end CHARACTERISTIC
/begin CHARACTERISTIC DFES_GrpRpr.DFC_CThmstOL_C "/" VALUE 0x80073570 Val_Wu16 576. DFC_Verb 0.00 576. FORMAT "%2.0" /end CHARACTERISTIC
/begin CHARACTERISTIC DFES_GrpRpr.DFC_CThmstSCB_C "/" VALUE 0x80073572 Val_Wu16 576. DFC_Verb 0.00 576. FORMAT "%2.0" /end CHARACTERISTIC
/begin CHARACTERISTIC DFES_GrpRpr.DFC_CThmstSCG_C "/" VALUE 0x80073574 Val_Wu16 576. DFC_Verb 0.00 576. FORMAT "%2.0" /end CHARACTERISTIC
/begin CHARACTERISTIC DFES_GrpRpr.DFC_ClthSig_C "/" VALUE 0x80073576 Val_Wu16 576. DFC_Verb 0.00 576. FORMAT "%2.0" /end CHARACTERISTIC
/begin CHARACTERISTIC DFES_GrpRpr.DFC_ECBVlvOL_C "/" VALUE 0x80073578 Val_Wu16 576. DFC_Verb 0.00 576. FORMAT "%2.0" /end CHARACTERISTIC
/begin CHARACTERISTIC DFES_GrpRpr.DFC_ECBVlvSCB_C "/" VALUE 0x8007357A Val_Wu16 576. DFC_Verb 0.00 576. FORMAT "%2.0" /end CHARACTERISTIC
/begin CHARACTERISTIC DFES_GrpRpr.DFC_ECBVlvSCG_C "/" VALUE 0x8007357C Val_Wu16 576. DFC_Verb 0.00 576. FORMAT "%2.0" /end CHARACTERISTIC
/begin CHARACTERISTIC DFES_GrpRpr.DFC_ECBVlvSRCMax_C "/" VALUE 0x8007357E Val_Wu16 576. DFC_Verb 0.00 576. FORMAT "%2.0" /end CHARACTERISTIC
/begin CHARACTERISTIC DFES_GrpRpr.DFC_ECBVlvSRCMin_C "/" VALUE 0x80073580 Val_Wu16 576. DFC_Verb 0.00 576. FORMAT "%2.0" /end CHARACTERISTIC
/begin CHARACTERISTIC DFES_GrpRpr.DFC_EGRVlvGovDvtMax_C "/" VALUE 0x80073582 Val_Wu16 576. DFC_Verb 0.00 576. FORMAT "%2.0" /end CHARACTERISTIC
/begin CHARACTERISTIC DFES_GrpRpr.DFC_EGRVlvGovDvtMin_C "/" VALUE 0x80073584 Val_Wu16 576. DFC_Verb 0.00 576. FORMAT "%2.0" /end CHARACTERISTIC
/begin CHARACTERISTIC DFES_GrpRpr.DFC_EGRVlvOL_C "/" VALUE 0x80073586 Val_Wu16 576. DFC_Verb 0.00 576. FORMAT "%2.0" /end CHARACTERISTIC
/begin CHARACTERISTIC DFES_GrpRpr.DFC_EGRVlvSCB_C "/" VALUE 0x80073588 Val_Wu16 576. DFC_Verb 0.00 576. FORMAT "%2.0" /end CHARACTERISTIC
/begin CHARACTERISTIC DFES_GrpRpr.DFC_EGRVlvSCG_C "/" VALUE 0x8007358A Val_Wu16 576. DFC_Verb 0.00 576. FORMAT "%2.0" /end CHARACTERISTIC
/begin CHARACTERISTIC DFES_GrpRpr.DFC_EGRVlvSRCMax_C "/" VALUE 0x8007358C Val_Wu16 576. DFC_Verb 0.00 576. FORMAT "%2.0" /end CHARACTERISTIC
/begin CHARACTERISTIC DFES_GrpRpr.DFC_EGRVlvSRCMin_C "/" VALUE 0x8007358E Val_Wu16 576. DFC_Verb 0.00 576. FORMAT "%2.0" /end CHARACTERISTIC
/begin CHARACTERISTIC DFES_GrpRpr.DFC_EMDmpOL_0_C "/" VALUE 0x80073590 Val_Wu16 576. DFC_Verb 0.00 576. FORMAT "%2.0" /end CHARACTERISTIC
/begin CHARACTERISTIC DFES_GrpRpr.DFC_EMDmpOL_1_C "/" VALUE 0x80073592 Val_Wu16 576. DFC_Verb 0.00 576. FORMAT "%2.0" /end CHARACTERISTIC
/begin CHARACTERISTIC DFES_GrpRpr.DFC_EMDmpSCB_0_C "/" VALUE 0x80073594 Val_Wu16 576. DFC_Verb 0.00 576. FORMAT "%2.0" /end CHARACTERISTIC
/begin CHARACTERISTIC DFES_GrpRpr.DFC_EMDmpSCB_1_C "/" VALUE 0x80073596 Val_Wu16 576. DFC_Verb 0.00 576. FORMAT "%2.0" /end CHARACTERISTIC
/begin CHARACTERISTIC DFES_GrpRpr.DFC_EMDmpSCG_0_C "/" VALUE 0x80073598 Val_Wu16 576. DFC_Verb 0.00 576. FORMAT "%2.0" /end CHARACTERISTIC
/begin CHARACTERISTIC DFES_GrpRpr.DFC_EMDmpSCG_1_C "/" VALUE 0x8007359A Val_Wu16 576. DFC_Verb 0.00 576. FORMAT "%2.0" /end CHARACTERISTIC
/begin CHARACTERISTIC DFES_GrpRpr.DFC_EngStAOL_C "/" VALUE 0x8007359C Val_Wu16 576. DFC_Verb 0.00 576. FORMAT "%2.0" /end CHARACTERISTIC
/begin CHARACTERISTIC DFES_GrpRpr.DFC_EngStASCB_C "/" VALUE 0x8007359E Val_Wu16 576. DFC_Verb 0.00 576. FORMAT "%2.0" /end CHARACTERISTIC
/begin CHARACTERISTIC DFES_GrpRpr.DFC_EngStASCG_C "/" VALUE 0x800735A0 Val_Wu16 576. DFC_Verb 0.00 576. FORMAT "%2.0" /end CHARACTERISTIC
/begin CHARACTERISTIC DFES_GrpRpr.DFC_EnvPSRCMax_C "/" VALUE 0x800735A2 Val_Wu16 576. DFC_Verb 0.00 576. FORMAT "%2.0" /end CHARACTERISTIC
/begin CHARACTERISTIC DFES_GrpRpr.DFC_EnvPSRCMin_C "/" VALUE 0x800735A4 Val_Wu16 576. DFC_Verb 0.00 576. FORMAT "%2.0" /end CHARACTERISTIC
/begin CHARACTERISTIC DFES_GrpRpr.DFC_EnvPSig_C "/" VALUE 0x800735A6 Val_Wu16 576. DFC_Verb 0.00 576. FORMAT "%2.0" /end CHARACTERISTIC
/begin CHARACTERISTIC DFES_GrpRpr.DFC_EnvTSRCMax_C "/" VALUE 0x800735A8 Val_Wu16 576. DFC_Verb 0.00 576. FORMAT "%2.0" /end CHARACTERISTIC
/begin CHARACTERISTIC DFES_GrpRpr.DFC_EnvTSRCMin_C "/" VALUE 0x800735AA Val_Wu16 576. DFC_Verb 0.00 576. FORMAT "%2.0" /end CHARACTERISTIC
/begin CHARACTERISTIC DFES_GrpRpr.DFC_FanOL_C "/" VALUE 0x800735AC Val_Wu16 576. DFC_Verb 0.00 576. FORMAT "%2.0" /end CHARACTERISTIC
/begin CHARACTERISTIC DFES_GrpRpr.DFC_FanSCB_C "/" VALUE 0x800735AE Val_Wu16 576. DFC_Verb 0.00 576. FORMAT "%2.0" /end CHARACTERISTIC
/begin CHARACTERISTIC DFES_GrpRpr.DFC_FlFltSig_C "/" VALUE 0x800735B0 Val_Wu16 576. DFC_Verb 0.00 576. FORMAT "%2.0" /end CHARACTERISTIC
/begin CHARACTERISTIC DFES_GrpRpr.DFC_FuelTSRCMax_C "/" VALUE 0x800735B2 Val_Wu16 576. DFC_Verb 0.00 576. FORMAT "%2.0" /end CHARACTERISTIC
/begin CHARACTERISTIC DFES_GrpRpr.DFC_FuelTSRCMin_C "/" VALUE 0x800735B4 Val_Wu16 576. DFC_Verb 0.00 576. FORMAT "%2.0" /end CHARACTERISTIC
/begin CHARACTERISTIC DFES_GrpRpr.DFC_GbxNPosPPerSRCMax_C "/" VALUE 0x800735B6 Val_Wu16 576. DFC_Verb 0.00 576. FORMAT "%2.0" /end CHARACTERISTIC
/begin CHARACTERISTIC DFES_GrpRpr.DFC_GbxNPosPPerSRCMin_C "/" VALUE 0x800735B8 Val_Wu16 576. DFC_Verb 0.00 576. FORMAT "%2.0" /end CHARACTERISTIC
/begin CHARACTERISTIC DFES_GrpRpr.DFC_GbxNPosPdcycSRCMax_C "/" VALUE 0x800735BA Val_Wu16 576. DFC_Verb 0.00 576. FORMAT "%2.0" /end CHARACTERISTIC
/begin CHARACTERISTIC DFES_GrpRpr.DFC_GbxNPosPdcycSRCMin_C "/" VALUE 0x800735BC Val_Wu16 576. DFC_Verb 0.00 576. FORMAT "%2.0" /end CHARACTERISTIC
/begin CHARACTERISTIC DFES_GrpRpr.DFC_GbxNPosSig_C "/" VALUE 0x800735BE Val_Wu16 576. DFC_Verb 0.00 576. FORMAT "%2.0" /end CHARACTERISTIC
/begin CHARACTERISTIC DFES_GrpRpr.DFC_GlwPlgBSDOL_0_C "/" VALUE 0x800735C0 Val_Wu16 576. DFC_Verb 0.00 576. FORMAT "%2.0" /end CHARACTERISTIC
/begin CHARACTERISTIC DFES_GrpRpr.DFC_GlwPlgBSDOL_1_C "/" VALUE 0x800735C2 Val_Wu16 576. DFC_Verb 0.00 576. FORMAT "%2.0" /end CHARACTERISTIC
/begin CHARACTERISTIC DFES_GrpRpr.DFC_GlwPlgBSDOL_2_C "/" VALUE 0x800735C4 Val_Wu16 576. DFC_Verb 0.00 576. FORMAT "%2.0" /end CHARACTERISTIC
/begin CHARACTERISTIC DFES_GrpRpr.DFC_GlwPlgBSDOL_3_C "/" VALUE 0x800735C6 Val_Wu16 576. DFC_Verb 0.00 576. FORMAT "%2.0" /end CHARACTERISTIC
/begin CHARACTERISTIC DFES_GrpRpr.DFC_GlwPlgBSDOL_4_C "/" VALUE 0x800735C8 Val_Wu16 576. DFC_Verb 0.00 576. FORMAT "%2.0" /end CHARACTERISTIC
/begin CHARACTERISTIC DFES_GrpRpr.DFC_GlwPlgBSDOL_5_C "/" VALUE 0x800735CA Val_Wu16 576. DFC_Verb 0.00 576. FORMAT "%2.0" /end CHARACTERISTIC
/begin CHARACTERISTIC DFES_GrpRpr.DFC_GlwPlgBSDOL_6_C "/" VALUE 0x800735CC Val_Wu16 576. DFC_Verb 0.00 576. FORMAT "%2.0" /end CHARACTERISTIC
/begin CHARACTERISTIC DFES_GrpRpr.DFC_GlwPlgBSDOL_7_C "/" VALUE 0x800735CE Val_Wu16 576. DFC_Verb 0.00 576. FORMAT "%2.0" /end CHARACTERISTIC
/begin CHARACTERISTIC DFES_GrpRpr.DFC_GlwPlgBSDOT_0_C "/" VALUE 0x800735D0 Val_Wu16 576. DFC_Verb 0.00 576. FORMAT "%2.0" /end CHARACTERISTIC
/begin CHARACTERISTIC DFES_GrpRpr.DFC_GlwPlgBSDOT_1_C "/" VALUE 0x800735D2 Val_Wu16 576. DFC_Verb 0.00 576. FORMAT "%2.0" /end CHARACTERISTIC
/begin CHARACTERISTIC DFES_GrpRpr.DFC_GlwPlgBSDOT_2_C "/" VALUE 0x800735D4 Val_Wu16 576. DFC_Verb 0.00 576. FORMAT "%2.0" /end CHARACTERISTIC
/begin CHARACTERISTIC DFES_GrpRpr.DFC_GlwPlgBSDOT_3_C "/" VALUE 0x800735D6 Val_Wu16 576. DFC_Verb 0.00 576. FORMAT "%2.0" /end CHARACTERISTIC
/begin CHARACTERISTIC DFES_GrpRpr.DFC_GlwPlgBSDOT_4_C "/" VALUE 0x800735D8 Val_Wu16 576. DFC_Verb 0.00 576. FORMAT "%2.0" /end CHARACTERISTIC
/begin CHARACTERISTIC DFES_GrpRpr.DFC_GlwPlgBSDOT_5_C "/" VALUE 0x800735DA Val_Wu16 576. DFC_Verb 0.00 576. FORMAT "%2.0" /end CHARACTERISTIC
/begin CHARACTERISTIC DFES_GrpRpr.DFC_GlwPlgBSDOT_6_C "/" VALUE 0x800735DC Val_Wu16 576. DFC_Verb 0.00 576. FORMAT "%2.0" /end CHARACTERISTIC
/begin CHARACTERISTIC DFES_GrpRpr.DFC_GlwPlgBSDOT_7_C "/" VALUE 0x800735DE Val_Wu16 576. DFC_Verb 0.00 576. FORMAT "%2.0" /end CHARACTERISTIC
/begin CHARACTERISTIC DFES_GrpRpr.DFC_GlwPlgBSDSC_0_C "/" VALUE 0x800735E0 Val_Wu16 576. DFC_Verb 0.00 576. FORMAT "%2.0" /end CHARACTERISTIC
/begin CHARACTERISTIC DFES_GrpRpr.DFC_GlwPlgBSDSC_1_C "/" VALUE 0x800735E2 Val_Wu16 576. DFC_Verb 0.00 576. FORMAT "%2.0" /end CHARACTERISTIC
/begin CHARACTERISTIC DFES_GrpRpr.DFC_GlwPlgBSDSC_2_C "/" VALUE 0x800735E4 Val_Wu16 576. DFC_Verb 0.00 576. FORMAT "%2.0" /end CHARACTERISTIC
/begin CHARACTERISTIC DFES_GrpRpr.DFC_GlwPlgBSDSC_3_C "/" VALUE 0x800735E6 Val_Wu16 576. DFC_Verb 0.00 576. FORMAT "%2.0" /end CHARACTERISTIC
/begin CHARACTERISTIC DFES_GrpRpr.DFC_GlwPlgBSDSC_4_C "/" VALUE 0x800735E8 Val_Wu16 576. DFC_Verb 0.00 576. FORMAT "%2.0" /end CHARACTERISTIC
/begin CHARACTERISTIC DFES_GrpRpr.DFC_GlwPlgBSDSC_5_C "/" VALUE 0x800735EA Val_Wu16 576. DFC_Verb 0.00 576. FORMAT "%2.0" /end CHARACTERISTIC
/begin CHARACTERISTIC DFES_GrpRpr.DFC_GlwPlgBSDSC_6_C "/" VALUE 0x800735EC Val_Wu16 576. DFC_Verb 0.00 576. FORMAT "%2.0" /end CHARACTERISTIC
/begin CHARACTERISTIC DFES_GrpRpr.DFC_GlwPlgBSDSC_7_C "/" VALUE 0x800735EE Val_Wu16 576. DFC_Verb 0.00 576. FORMAT "%2.0" /end CHARACTERISTIC
/begin CHARACTERISTIC DFES_GrpRpr.DFC_GlwPlgComErr_C "/" VALUE 0x800735F0 Val_Wu16 576. DFC_Verb 0.00 576. FORMAT "%2.0" /end CHARACTERISTIC
/begin CHARACTERISTIC DFES_GrpRpr.DFC_InjVlvPresMin_C "/" VALUE 0x800735F2 Val_Wu16 576. DFC_Verb 0.00 576. FORMAT "%2.0" /end CHARACTERISTIC
/begin CHARACTERISTIC DFES_GrpRpr.DFC_LSUCircNernstMax_0_C "/" VALUE 0x800735F4 Val_Wu16 576. DFC_Verb 0.00 576. FORMAT "%2.0" /end CHARACTERISTIC
/begin CHARACTERISTIC DFES_GrpRpr.DFC_LSUCircNernstMax_1_C "/" VALUE 0x800735F6 Val_Wu16 576. DFC_Verb 0.00 576. FORMAT "%2.0" /end CHARACTERISTIC
/begin CHARACTERISTIC DFES_GrpRpr.DFC_LSUCircNernstMax_2_C "/" VALUE 0x800735F8 Val_Wu16 576. DFC_Verb 0.00 576. FORMAT "%2.0" /end CHARACTERISTIC
/begin CHARACTERISTIC DFES_GrpRpr.DFC_LSUCircNernstMax_3_C "/" VALUE 0x800735FA Val_Wu16 576. DFC_Verb 0.00 576. FORMAT "%2.0" /end CHARACTERISTIC
/begin CHARACTERISTIC DFES_GrpRpr.DFC_LSUCircNernstMin_0_C "/" VALUE 0x800735FC Val_Wu16 576. DFC_Verb 0.00 576. FORMAT "%2.0" /end CHARACTERISTIC
/begin CHARACTERISTIC DFES_GrpRpr.DFC_LSUCircNernstMin_1_C "/" VALUE 0x800735FE Val_Wu16 576. DFC_Verb 0.00 576. FORMAT "%2.0" /end CHARACTERISTIC
/begin CHARACTERISTIC DFES_GrpRpr.DFC_LSUCircNernstMin_2_C "/" VALUE 0x80073600 Val_Wu16 576. DFC_Verb 0.00 576. FORMAT "%2.0" /end CHARACTERISTIC
/begin CHARACTERISTIC DFES_GrpRpr.DFC_LSUCircNernstMin_3_C "/" VALUE 0x80073602 Val_Wu16 576. DFC_Verb 0.00 576. FORMAT "%2.0" /end CHARACTERISTIC
/begin CHARACTERISTIC DFES_GrpRpr.DFC_LSUCircNernstSig_0_C "/" VALUE 0x80073604 Val_Wu16 576. DFC_Verb 0.00 576. FORMAT "%2.0" /end CHARACTERISTIC
/begin CHARACTERISTIC DFES_GrpRpr.DFC_LSUCircNernstSig_1_C "/" VALUE 0x80073606 Val_Wu16 576. DFC_Verb 0.00 576. FORMAT "%2.0" /end CHARACTERISTIC
/begin CHARACTERISTIC DFES_GrpRpr.DFC_LSUCircNernstSig_2_C "/" VALUE 0x80073608 Val_Wu16 576. DFC_Verb 0.00 576. FORMAT "%2.0" /end CHARACTERISTIC
/begin CHARACTERISTIC DFES_GrpRpr.DFC_LSUCircNernstSig_3_C "/" VALUE 0x8007360A Val_Wu16 576. DFC_Verb 0.00 576. FORMAT "%2.0" /end CHARACTERISTIC
/begin CHARACTERISTIC DFES_GrpRpr.DFC_LSUCircPmpCurMax_0_C "/" VALUE 0x8007360C Val_Wu16 576. DFC_Verb 0.00 576. FORMAT "%2.0" /end CHARACTERISTIC
/begin CHARACTERISTIC DFES_GrpRpr.DFC_LSUCircPmpCurMax_1_C "/" VALUE 0x8007360E Val_Wu16 576. DFC_Verb 0.00 576. FORMAT "%2.0" /end CHARACTERISTIC
/begin CHARACTERISTIC DFES_GrpRpr.DFC_LSUCircPmpCurMax_2_C "/" VALUE 0x80073610 Val_Wu16 576. DFC_Verb 0.00 576. FORMAT "%2.0" /end CHARACTERISTIC
/begin CHARACTERISTIC DFES_GrpRpr.DFC_LSUCircPmpCurMax_3_C "/" VALUE 0x80073612 Val_Wu16 576. DFC_Verb 0.00 576. FORMAT "%2.0" /end CHARACTERISTIC
/begin CHARACTERISTIC DFES_GrpRpr.DFC_LSUCircPmpCurMin_0_C "/" VALUE 0x80073614 Val_Wu16 576. DFC_Verb 0.00 576. FORMAT "%2.0" /end CHARACTERISTIC
/begin CHARACTERISTIC DFES_GrpRpr.DFC_LSUCircPmpCurMin_1_C "/" VALUE 0x80073616 Val_Wu16 576. DFC_Verb 0.00 576. FORMAT "%2.0" /end CHARACTERISTIC
/begin CHARACTERISTIC DFES_GrpRpr.DFC_LSUCircPmpCurMin_2_C "/" VALUE 0x80073618 Val_Wu16 576. DFC_Verb 0.00 576. FORMAT "%2.0" /end CHARACTERISTIC
/begin CHARACTERISTIC DFES_GrpRpr.DFC_LSUCircPmpCurMin_3_C "/" VALUE 0x8007361A Val_Wu16 576. DFC_Verb 0.00 576. FORMAT "%2.0" /end CHARACTERISTIC
/begin CHARACTERISTIC DFES_GrpRpr.DFC_LSUCircPmpCurSig_0_C "/" VALUE 0x8007361C Val_Wu16 576. DFC_Verb 0.00 576. FORMAT "%2.0" /end CHARACTERISTIC
/begin CHARACTERISTIC DFES_GrpRpr.DFC_LSUCircPmpCurSig_1_C "/" VALUE 0x8007361E Val_Wu16 576. DFC_Verb 0.00 576. FORMAT "%2.0" /end CHARACTERISTIC
/begin CHARACTERISTIC DFES_GrpRpr.DFC_LSUCircPmpCurSig_2_C "/" VALUE 0x80073620 Val_Wu16 576. DFC_Verb 0.00 576. FORMAT "%2.0" /end CHARACTERISTIC
/begin CHARACTERISTIC DFES_GrpRpr.DFC_LSUCircPmpCurSig_3_C "/" VALUE 0x80073622 Val_Wu16 576. DFC_Verb 0.00 576. FORMAT "%2.0" /end CHARACTERISTIC
/begin CHARACTERISTIC DFES_GrpRpr.DFC_LSUCircVirtGndMax_0_C "/" VALUE 0x80073624 Val_Wu16 576. DFC_Verb 0.00 576. FORMAT "%2.0" /end CHARACTERISTIC
/begin CHARACTERISTIC DFES_GrpRpr.DFC_LSUCircVirtGndMax_1_C "/" VALUE 0x80073626 Val_Wu16 576. DFC_Verb 0.00 576. FORMAT "%2.0" /end CHARACTERISTIC
/begin CHARACTERISTIC DFES_GrpRpr.DFC_LSUCircVirtGndMax_2_C "/" VALUE 0x80073628 Val_Wu16 576. DFC_Verb 0.00 576. FORMAT "%2.0" /end CHARACTERISTIC
/begin CHARACTERISTIC DFES_GrpRpr.DFC_LSUCircVirtGndMax_3_C "/" VALUE 0x8007362A Val_Wu16 576. DFC_Verb 0.00 576. FORMAT "%2.0" /end CHARACTERISTIC
/begin CHARACTERISTIC DFES_GrpRpr.DFC_LSUCircVirtGndMin_0_C "/" VALUE 0x8007362C Val_Wu16 576. DFC_Verb 0.00 576. FORMAT "%2.0" /end CHARACTERISTIC
/begin CHARACTERISTIC DFES_GrpRpr.DFC_LSUCircVirtGndMin_1_C "/" VALUE 0x8007362E Val_Wu16 576. DFC_Verb 0.00 576. FORMAT "%2.0" /end CHARACTERISTIC
/begin CHARACTERISTIC DFES_GrpRpr.DFC_LSUCircVirtGndMin_2_C "/" VALUE 0x80073630 Val_Wu16 576. DFC_Verb 0.00 576. FORMAT "%2.0" /end CHARACTERISTIC
/begin CHARACTERISTIC DFES_GrpRpr.DFC_LSUCircVirtGndMin_3_C "/" VALUE 0x80073632 Val_Wu16 576. DFC_Verb 0.00 576. FORMAT "%2.0" /end CHARACTERISTIC
/begin CHARACTERISTIC DFES_GrpRpr.DFC_LSUCircVirtGndSig_0_C "/" VALUE 0x80073634 Val_Wu16 576. DFC_Verb 0.00 576. FORMAT "%2.0" /end CHARACTERISTIC
/begin CHARACTERISTIC DFES_GrpRpr.DFC_LSUCircVirtGndSig_1_C "/" VALUE 0x80073636 Val_Wu16 576. DFC_Verb 0.00 576. FORMAT "%2.0" /end CHARACTERISTIC
/begin CHARACTERISTIC DFES_GrpRpr.DFC_LSUCircVirtGndSig_2_C "/" VALUE 0x80073638 Val_Wu16 576. DFC_Verb 0.00 576. FORMAT "%2.0" /end CHARACTERISTIC
/begin CHARACTERISTIC DFES_GrpRpr.DFC_LSUCircVirtGndSig_3_C "/" VALUE 0x8007363A Val_Wu16 576. DFC_Verb 0.00 576. FORMAT "%2.0" /end CHARACTERISTIC
/begin CHARACTERISTIC DFES_GrpRpr.DFC_LSUHtrMax_0_C "/" VALUE 0x8007363C Val_Wu16 576. DFC_Verb 0.00 576. FORMAT "%2.0" /end CHARACTERISTIC
/begin CHARACTERISTIC DFES_GrpRpr.DFC_LSUHtrMax_1_C "/" VALUE 0x8007363E Val_Wu16 576. DFC_Verb 0.00 576. FORMAT "%2.0" /end CHARACTERISTIC
/begin CHARACTERISTIC DFES_GrpRpr.DFC_LSUHtrMax_2_C "/" VALUE 0x80073640 Val_Wu16 576. DFC_Verb 0.00 576. FORMAT "%2.0" /end CHARACTERISTIC
/begin CHARACTERISTIC DFES_GrpRpr.DFC_LSUHtrMax_3_C "/" VALUE 0x80073642 Val_Wu16 576. DFC_Verb 0.00 576. FORMAT "%2.0" /end CHARACTERISTIC
/begin CHARACTERISTIC DFES_GrpRpr.DFC_LSUHtrMin_0_C "/" VALUE 0x80073644 Val_Wu16 576. DFC_Verb 0.00 576. FORMAT "%2.0" /end CHARACTERISTIC
/begin CHARACTERISTIC DFES_GrpRpr.DFC_LSUHtrMin_1_C "/" VALUE 0x80073646 Val_Wu16 576. DFC_Verb 0.00 576. FORMAT "%2.0" /end CHARACTERISTIC
/begin CHARACTERISTIC DFES_GrpRpr.DFC_LSUHtrMin_2_C "/" VALUE 0x80073648 Val_Wu16 576. DFC_Verb 0.00 576. FORMAT "%2.0" /end CHARACTERISTIC
/begin CHARACTERISTIC DFES_GrpRpr.DFC_LSUHtrMin_3_C "/" VALUE 0x8007364A Val_Wu16 576. DFC_Verb 0.00 576. FORMAT "%2.0" /end CHARACTERISTIC
/begin CHARACTERISTIC DFES_GrpRpr.DFC_LSUHtrSig_0_C "/" VALUE 0x8007364C Val_Wu16 576. DFC_Verb 0.00 576. FORMAT "%2.0" /end CHARACTERISTIC
/begin CHARACTERISTIC DFES_GrpRpr.DFC_LSUHtrSig_1_C "/" VALUE 0x8007364E Val_Wu16 576. DFC_Verb 0.00 576. FORMAT "%2.0" /end CHARACTERISTIC
/begin CHARACTERISTIC DFES_GrpRpr.DFC_LSUHtrSig_2_C "/" VALUE 0x80073650 Val_Wu16 576. DFC_Verb 0.00 576. FORMAT "%2.0" /end CHARACTERISTIC
/begin CHARACTERISTIC DFES_GrpRpr.DFC_LSUHtrSig_3_C "/" VALUE 0x80073652 Val_Wu16 576. DFC_Verb 0.00 576. FORMAT "%2.0" /end CHARACTERISTIC
/begin CHARACTERISTIC DFES_GrpRpr.DFC_LSUO2Max_0_C "/" VALUE 0x80073654 Val_Wu16 576. DFC_Verb 0.00 576. FORMAT "%2.0" /end CHARACTERISTIC
/begin CHARACTERISTIC DFES_GrpRpr.DFC_LSUO2Max_1_C "/" VALUE 0x80073656 Val_Wu16 576. DFC_Verb 0.00 576. FORMAT "%2.0" /end CHARACTERISTIC
/begin CHARACTERISTIC DFES_GrpRpr.DFC_LSUO2Max_2_C "/" VALUE 0x80073658 Val_Wu16 576. DFC_Verb 0.00 576. FORMAT "%2.0" /end CHARACTERISTIC
/begin CHARACTERISTIC DFES_GrpRpr.DFC_LSUO2Max_3_C "/" VALUE 0x8007365A Val_Wu16 576. DFC_Verb 0.00 576. FORMAT "%2.0" /end CHARACTERISTIC
/begin CHARACTERISTIC DFES_GrpRpr.DFC_LSUO2Min_0_C "/" VALUE 0x8007365C Val_Wu16 576. DFC_Verb 0.00 576. FORMAT "%2.0" /end CHARACTERISTIC
/begin CHARACTERISTIC DFES_GrpRpr.DFC_LSUO2Min_1_C "/" VALUE 0x8007365E Val_Wu16 576. DFC_Verb 0.00 576. FORMAT "%2.0" /end CHARACTERISTIC
/begin CHARACTERISTIC DFES_GrpRpr.DFC_LSUO2Min_2_C "/" VALUE 0x80073660 Val_Wu16 576. DFC_Verb 0.00 576. FORMAT "%2.0" /end CHARACTERISTIC
/begin CHARACTERISTIC DFES_GrpRpr.DFC_LSUO2Min_3_C "/" VALUE 0x80073662 Val_Wu16 576. DFC_Verb 0.00 576. FORMAT "%2.0" /end CHARACTERISTIC
/begin CHARACTERISTIC DFES_GrpRpr.DFC_LSUSPIBattLowMin_0_C "/" VALUE 0x80073664 Val_Wu16 576. DFC_Verb 0.00 576. FORMAT "%2.0" /end CHARACTERISTIC
/begin CHARACTERISTIC DFES_GrpRpr.DFC_LSUSPIBattLowMin_1_C "/" VALUE 0x80073666 Val_Wu16 576. DFC_Verb 0.00 576. FORMAT "%2.0" /end CHARACTERISTIC
/begin CHARACTERISTIC DFES_GrpRpr.DFC_LSUSPIBattLowMin_2_C "/" VALUE 0x80073668 Val_Wu16 576. DFC_Verb 0.00 576. FORMAT "%2.0" /end CHARACTERISTIC
/begin CHARACTERISTIC DFES_GrpRpr.DFC_LSUSPIBattLowMin_3_C "/" VALUE 0x8007366A Val_Wu16 576. DFC_Verb 0.00 576. FORMAT "%2.0" /end CHARACTERISTIC
/begin CHARACTERISTIC DFES_GrpRpr.DFC_LSUSPISig_0_C "/" VALUE 0x8007366C Val_Wu16 576. DFC_Verb 0.00 576. FORMAT "%2.0" /end CHARACTERISTIC
/begin CHARACTERISTIC DFES_GrpRpr.DFC_LSUSPISig_1_C "/" VALUE 0x8007366E Val_Wu16 576. DFC_Verb 0.00 576. FORMAT "%2.0" /end CHARACTERISTIC
/begin CHARACTERISTIC DFES_GrpRpr.DFC_LSUSPISig_2_C "/" VALUE 0x80073670 Val_Wu16 576. DFC_Verb 0.00 576. FORMAT "%2.0" /end CHARACTERISTIC
/begin CHARACTERISTIC DFES_GrpRpr.DFC_LSUSPISig_3_C "/" VALUE 0x80073672 Val_Wu16 576. DFC_Verb 0.00 576. FORMAT "%2.0" /end CHARACTERISTIC
/begin CHARACTERISTIC DFES_GrpRpr.DFC_LSUtExcMax_0_C "/" VALUE 0x80073674 Val_Wu16 576. DFC_Verb 0.00 576. FORMAT "%2.0" /end CHARACTERISTIC
/begin CHARACTERISTIC DFES_GrpRpr.DFC_LSUtExcMax_1_C "/" VALUE 0x80073676 Val_Wu16 576. DFC_Verb 0.00 576. FORMAT "%2.0" /end CHARACTERISTIC
/begin CHARACTERISTIC DFES_GrpRpr.DFC_LSUtExcMax_2_C "/" VALUE 0x80073678 Val_Wu16 576. DFC_Verb 0.00 576. FORMAT "%2.0" /end CHARACTERISTIC
/begin CHARACTERISTIC DFES_GrpRpr.DFC_LSUtExcMax_3_C "/" VALUE 0x8007367A Val_Wu16 576. DFC_Verb 0.00 576. FORMAT "%2.0" /end CHARACTERISTIC
/begin CHARACTERISTIC DFES_GrpRpr.DFC_LSUtExcMin_0_C "/" VALUE 0x8007367C Val_Wu16 576. DFC_Verb 0.00 576. FORMAT "%2.0" /end CHARACTERISTIC
/begin CHARACTERISTIC DFES_GrpRpr.DFC_LSUtExcMin_1_C "/" VALUE 0x8007367E Val_Wu16 576. DFC_Verb 0.00 576. FORMAT "%2.0" /end CHARACTERISTIC
/begin CHARACTERISTIC DFES_GrpRpr.DFC_LSUtExcMin_2_C "/" VALUE 0x80073680 Val_Wu16 576. DFC_Verb 0.00 576. FORMAT "%2.0" /end CHARACTERISTIC
/begin CHARACTERISTIC DFES_GrpRpr.DFC_LSUtExcMin_3_C "/" VALUE 0x80073682 Val_Wu16 576. DFC_Verb 0.00 576. FORMAT "%2.0" /end CHARACTERISTIC
/begin CHARACTERISTIC DFES_GrpRpr.DFC_MILOL_C "/" VALUE 0x80073684 Val_Wu16 576. DFC_Verb 0.00 576. FORMAT "%2.0" /end CHARACTERISTIC
/begin CHARACTERISTIC DFES_GrpRpr.DFC_MILSCB_C "/" VALUE 0x80073686 Val_Wu16 576. DFC_Verb 0.00 576. FORMAT "%2.0" /end CHARACTERISTIC
/begin CHARACTERISTIC DFES_GrpRpr.DFC_MILSCG_C "/" VALUE 0x80073688 Val_Wu16 576. DFC_Verb 0.00 576. FORMAT "%2.0" /end CHARACTERISTIC
/begin CHARACTERISTIC DFES_GrpRpr.DFC_MeUnSCG_C "/" VALUE 0x8007368A Val_Wu16 576. DFC_Verb 0.00 576. FORMAT "%2.0" /end CHARACTERISTIC
/begin CHARACTERISTIC DFES_GrpRpr.DFC_NplHsChngPPFltDiff_C "/" VALUE 0x8007368C Val_Wu16 576. DFC_Verb 0.00 576. FORMAT "%2.0" /end CHARACTERISTIC
/begin CHARACTERISTIC DFES_GrpRpr.DFC_NplPAirFltDs_C "/" VALUE 0x8007368E Val_Wu16 576. DFC_Verb 0.00 576. FORMAT "%2.0" /end CHARACTERISTIC
/begin CHARACTERISTIC DFES_GrpRpr.DFC_NplTPFltUs_C "/" VALUE 0x80073690 Val_Wu16 576. DFC_Verb 0.00 576. FORMAT "%2.0" /end CHARACTERISTIC
/begin CHARACTERISTIC DFES_GrpRpr.DFC_OilComErr_C "/" VALUE 0x80073692 Val_Wu16 576. DFC_Verb 0.00 576. FORMAT "%2.0" /end CHARACTERISTIC
/begin CHARACTERISTIC DFES_GrpRpr.DFC_OilPLmpOL_C "/" VALUE 0x80073694 Val_Wu16 576. DFC_Verb 0.00 576. FORMAT "%2.0" /end CHARACTERISTIC
/begin CHARACTERISTIC DFES_GrpRpr.DFC_OilPLmpSCB_C "/" VALUE 0x80073696 Val_Wu16 576. DFC_Verb 0.00 576. FORMAT "%2.0" /end CHARACTERISTIC
/begin CHARACTERISTIC DFES_GrpRpr.DFC_OilPLmpSCG_C "/" VALUE 0x80073698 Val_Wu16 576. DFC_Verb 0.00 576. FORMAT "%2.0" /end CHARACTERISTIC
/begin CHARACTERISTIC DFES_GrpRpr.DFC_OilPNpl_C "/" VALUE 0x8007369A Val_Wu16 576. DFC_Verb 0.00 576. FORMAT "%2.0" /end CHARACTERISTIC
/begin CHARACTERISTIC DFES_GrpRpr.DFC_OilTNpl_C "/" VALUE 0x8007369C Val_Wu16 576. DFC_Verb 0.00 576. FORMAT "%2.0" /end CHARACTERISTIC
/begin CHARACTERISTIC DFES_GrpRpr.DFC_OilTSRCMax_C "/" VALUE 0x8007369E Val_Wu16 576. DFC_Verb 0.00 576. FORMAT "%2.0" /end CHARACTERISTIC
/begin CHARACTERISTIC DFES_GrpRpr.DFC_OilTSRCMin_C "/" VALUE 0x800736A0 Val_Wu16 576. DFC_Verb 0.00 576. FORMAT "%2.0" /end CHARACTERISTIC
/begin CHARACTERISTIC DFES_GrpRpr.DFC_PCACDsEnvPPls_C "/" VALUE 0x800736A2 Val_Wu16 576. DFC_Verb 0.00 576. FORMAT "%2.0" /end CHARACTERISTIC
/begin CHARACTERISTIC DFES_GrpRpr.DFC_PCACDsSRCMax_C "/" VALUE 0x800736A4 Val_Wu16 576. DFC_Verb 0.00 576. FORMAT "%2.0" /end CHARACTERISTIC
/begin CHARACTERISTIC DFES_GrpRpr.DFC_PCACDsSRCMin_C "/" VALUE 0x800736A6 Val_Wu16 576. DFC_Verb 0.00 576. FORMAT "%2.0" /end CHARACTERISTIC
/begin CHARACTERISTIC DFES_GrpRpr.DFC_PCVSCG_C "/" VALUE 0x800736A8 Val_Wu16 576. DFC_Verb 0.00 576. FORMAT "%2.0" /end CHARACTERISTIC
/begin CHARACTERISTIC DFES_GrpRpr.DFC_PFltCharPDiffMin_C "/" VALUE 0x800736AA Val_Wu16 576. DFC_Verb 0.00 576. FORMAT "%2.0" /end CHARACTERISTIC
/begin CHARACTERISTIC DFES_GrpRpr.DFC_PFltDstrMin_C "/" VALUE 0x800736AC Val_Wu16 576. DFC_Verb 0.00 576. FORMAT "%2.0" /end CHARACTERISTIC
/begin CHARACTERISTIC DFES_GrpRpr.DFC_PFltEngPrt_C "/" VALUE 0x800736AE Val_Wu16 576. DFC_Verb 0.00 576. FORMAT "%2.0" /end CHARACTERISTIC
/begin CHARACTERISTIC DFES_GrpRpr.DFC_PFltLmpOL_C "/" VALUE 0x800736B0 Val_Wu16 576. DFC_Verb 0.00 576. FORMAT "%2.0" /end CHARACTERISTIC
/begin CHARACTERISTIC DFES_GrpRpr.DFC_PFltLmpSCB_C "/" VALUE 0x800736B2 Val_Wu16 576. DFC_Verb 0.00 576. FORMAT "%2.0" /end CHARACTERISTIC
/begin CHARACTERISTIC DFES_GrpRpr.DFC_PFltLmpSCG_C "/" VALUE 0x800736B4 Val_Wu16 576. DFC_Verb 0.00 576. FORMAT "%2.0" /end CHARACTERISTIC
/begin CHARACTERISTIC DFES_GrpRpr.DFC_PFltRgnPerm_C "/" VALUE 0x800736B6 Val_Wu16 576. DFC_Verb 0.00 576. FORMAT "%2.0" /end CHARACTERISTIC
/begin CHARACTERISTIC DFES_GrpRpr.DFC_PFltSRCMaxFlwRstn_C "/" VALUE 0x800736B8 Val_Wu16 576. DFC_Verb 0.00 576. FORMAT "%2.0" /end CHARACTERISTIC
/begin CHARACTERISTIC DFES_GrpRpr.DFC_PFltSRCMinFlwRstn_C "/" VALUE 0x800736BA Val_Wu16 576. DFC_Verb 0.00 576. FORMAT "%2.0" /end CHARACTERISTIC
/begin CHARACTERISTIC DFES_GrpRpr.DFC_PFltSotMsDvtMax_C "/" VALUE 0x800736BC Val_Wu16 576. DFC_Verb 0.00 576. FORMAT "%2.0" /end CHARACTERISTIC
/begin CHARACTERISTIC DFES_GrpRpr.DFC_PFltSotMsDvtMin_C "/" VALUE 0x800736BE Val_Wu16 576. DFC_Verb 0.00 576. FORMAT "%2.0" /end CHARACTERISTIC
/begin CHARACTERISTIC DFES_GrpRpr.DFC_PFltSotMsMax_C "/" VALUE 0x800736C0 Val_Wu16 576. DFC_Verb 0.00 576. FORMAT "%2.0" /end CHARACTERISTIC
/begin CHARACTERISTIC DFES_GrpRpr.DFC_PSPOL_C "/" VALUE 0x800736C2 Val_Wu16 576. DFC_Verb 0.00 576. FORMAT "%2.0" /end CHARACTERISTIC
/begin CHARACTERISTIC DFES_GrpRpr.DFC_PSPSCB_C "/" VALUE 0x800736C4 Val_Wu16 576. DFC_Verb 0.00 576. FORMAT "%2.0" /end CHARACTERISTIC
/begin CHARACTERISTIC DFES_GrpRpr.DFC_PSPSCG_C "/" VALUE 0x800736C6 Val_Wu16 576. DFC_Verb 0.00 576. FORMAT "%2.0" /end CHARACTERISTIC
/begin CHARACTERISTIC DFES_GrpRpr.DFC_SRCHighAPP1_C "/" VALUE 0x800736C8 Val_Wu16 576. DFC_Verb 0.00 576. FORMAT "%2.0" /end CHARACTERISTIC
/begin CHARACTERISTIC DFES_GrpRpr.DFC_SRCHighAPP2_C "/" VALUE 0x800736CA Val_Wu16 576. DFC_Verb 0.00 576. FORMAT "%2.0" /end CHARACTERISTIC
/begin CHARACTERISTIC DFES_GrpRpr.DFC_SRCLowAPP1_C "/" VALUE 0x800736CC Val_Wu16 576. DFC_Verb 0.00 576. FORMAT "%2.0" /end CHARACTERISTIC
/begin CHARACTERISTIC DFES_GrpRpr.DFC_SRCLowAPP2_C "/" VALUE 0x800736CE Val_Wu16 576. DFC_Verb 0.00 576. FORMAT "%2.0" /end CHARACTERISTIC
/begin CHARACTERISTIC DFES_GrpRpr.DFC_SRCMaxPAirFltDs_C "/" VALUE 0x800736D0 Val_Wu16 576. DFC_Verb 0.00 576. FORMAT "%2.0" /end CHARACTERISTIC
/begin CHARACTERISTIC DFES_GrpRpr.DFC_SRCMaxPPFltUs_C "/" VALUE 0x800736D2 Val_Wu16 576. DFC_Verb 0.00 576. FORMAT "%2.0" /end CHARACTERISTIC
/begin CHARACTERISTIC DFES_GrpRpr.DFC_SRCMaxTECU_C "/" VALUE 0x800736D4 Val_Wu16 576. DFC_Verb 0.00 576. FORMAT "%2.0" /end CHARACTERISTIC
/begin CHARACTERISTIC DFES_GrpRpr.DFC_SRCMaxTOxiCatUs_C "/" VALUE 0x800736D6 Val_Wu16 576. DFC_Verb 0.00 576. FORMAT "%2.0" /end CHARACTERISTIC
/begin CHARACTERISTIC DFES_GrpRpr.DFC_SRCMaxTPFltUs_C "/" VALUE 0x800736D8 Val_Wu16 576. DFC_Verb 0.00 576. FORMAT "%2.0" /end CHARACTERISTIC
/begin CHARACTERISTIC DFES_GrpRpr.DFC_SRCMinPAirFltDs_C "/" VALUE 0x800736DA Val_Wu16 576. DFC_Verb 0.00 576. FORMAT "%2.0" /end CHARACTERISTIC
/begin CHARACTERISTIC DFES_GrpRpr.DFC_SRCMinPPFltUs_C "/" VALUE 0x800736DC Val_Wu16 576. DFC_Verb 0.00 576. FORMAT "%2.0" /end CHARACTERISTIC
/begin CHARACTERISTIC DFES_GrpRpr.DFC_SRCMinTECU_C "/" VALUE 0x800736DE Val_Wu16 576. DFC_Verb 0.00 576. FORMAT "%2.0" /end CHARACTERISTIC
/begin CHARACTERISTIC DFES_GrpRpr.DFC_SRCMinTOxiCatUs_C "/" VALUE 0x800736E0 Val_Wu16 576. DFC_Verb 0.00 576. FORMAT "%2.0" /end CHARACTERISTIC
/begin CHARACTERISTIC DFES_GrpRpr.DFC_SRCMinTPFltUs_C "/" VALUE 0x800736E2 Val_Wu16 576. DFC_Verb 0.00 576. FORMAT "%2.0" /end CHARACTERISTIC
/begin CHARACTERISTIC DFES_GrpRpr.DFC_SVSOL_C "/" VALUE 0x800736E4 Val_Wu16 576. DFC_Verb 0.00 576. FORMAT "%2.0" /end CHARACTERISTIC
/begin CHARACTERISTIC DFES_GrpRpr.DFC_SVSSCB_C "/" VALUE 0x800736E6 Val_Wu16 576. DFC_Verb 0.00 576. FORMAT "%2.0" /end CHARACTERISTIC
/begin CHARACTERISTIC DFES_GrpRpr.DFC_SVSSCG_C "/" VALUE 0x800736E8 Val_Wu16 576. DFC_Verb 0.00 576. FORMAT "%2.0" /end CHARACTERISTIC
/begin CHARACTERISTIC DFES_GrpRpr.DFC_StrtOL_C "/" VALUE 0x800736EA Val_Wu16 576. DFC_Verb 0.00 576. FORMAT "%2.0" /end CHARACTERISTIC
/begin CHARACTERISTIC DFES_GrpRpr.DFC_StrtSCB_C "/" VALUE 0x800736EC Val_Wu16 576. DFC_Verb 0.00 576. FORMAT "%2.0" /end CHARACTERISTIC
/begin CHARACTERISTIC DFES_GrpRpr.DFC_StrtSCG_C "/" VALUE 0x800736EE Val_Wu16 576. DFC_Verb 0.00 576. FORMAT "%2.0" /end CHARACTERISTIC
/begin CHARACTERISTIC DFES_GrpRpr.DFC_SyncAPP_C "/" VALUE 0x800736F0 Val_Wu16 576. DFC_Verb 0.00 576. FORMAT "%2.0" /end CHARACTERISTIC
/begin CHARACTERISTIC DFES_GrpRpr.DFC_T15Npl_C "/" VALUE 0x800736F2 Val_Wu16 576. DFC_Verb 0.00 576. FORMAT "%2.0" /end CHARACTERISTIC
/begin CHARACTERISTIC DFES_GrpRpr.DFC_TAFSDtyCycHi_C "/" VALUE 0x800736F4 Val_Wu16 576. DFC_Verb 0.00 576. FORMAT "%2.0" /end CHARACTERISTIC
/begin CHARACTERISTIC DFES_GrpRpr.DFC_TAFSDtyCycLo_C "/" VALUE 0x800736F6 Val_Wu16 576. DFC_Verb 0.00 576. FORMAT "%2.0" /end CHARACTERISTIC
/begin CHARACTERISTIC DFES_GrpRpr.DFC_TAFSPerHi_C "/" VALUE 0x800736F8 Val_Wu16 576. DFC_Verb 0.00 576. FORMAT "%2.0" /end CHARACTERISTIC
/begin CHARACTERISTIC DFES_GrpRpr.DFC_TAFSPerLo_C "/" VALUE 0x800736FA Val_Wu16 576. DFC_Verb 0.00 576. FORMAT "%2.0" /end CHARACTERISTIC
/begin CHARACTERISTIC DFES_GrpRpr.DFC_TCACDsSRCMax_C "/" VALUE 0x800736FC Val_Wu16 576. DFC_Verb 0.00 576. FORMAT "%2.0" /end CHARACTERISTIC
/begin CHARACTERISTIC DFES_GrpRpr.DFC_TCACDsSRCMin_C "/" VALUE 0x800736FE Val_Wu16 576. DFC_Verb 0.00 576. FORMAT "%2.0" /end CHARACTERISTIC
/begin CHARACTERISTIC DFES_GrpRpr.DFC_ThrVlvOL_C "/" VALUE 0x80073700 Val_Wu16 576. DFC_Verb 0.00 576. FORMAT "%2.0" /end CHARACTERISTIC
/begin CHARACTERISTIC DFES_GrpRpr.DFC_ThrVlvSCB_C "/" VALUE 0x80073702 Val_Wu16 576. DFC_Verb 0.00 576. FORMAT "%2.0" /end CHARACTERISTIC
/begin CHARACTERISTIC DFES_GrpRpr.DFC_ThrVlvSRCMax_C "/" VALUE 0x80073704 Val_Wu16 576. DFC_Verb 0.00 576. FORMAT "%2.0" /end CHARACTERISTIC
/begin CHARACTERISTIC DFES_GrpRpr.DFC_ThrVlvSRCMin_C "/" VALUE 0x80073706 Val_Wu16 576. DFC_Verb 0.00 576. FORMAT "%2.0" /end CHARACTERISTIC
/begin CHARACTERISTIC DFES_GrpRpr.DFC_TrbChLPOL_C "/" VALUE 0x80073708 Val_Wu16 576. DFC_Verb 0.00 576. FORMAT "%2.0" /end CHARACTERISTIC
/begin CHARACTERISTIC DFES_GrpRpr.DFC_TrbChLPSCB_C "/" VALUE 0x8007370A Val_Wu16 576. DFC_Verb 0.00 576. FORMAT "%2.0" /end CHARACTERISTIC
/begin CHARACTERISTIC DFES_GrpRpr.DFC_TrbChLPSCG_C "/" VALUE 0x8007370C Val_Wu16 576. DFC_Verb 0.00 576. FORMAT "%2.0" /end CHARACTERISTIC
/begin CHARACTERISTIC DFES_GrpRpr.DFC_TrbChOL_C "/" VALUE 0x8007370E Val_Wu16 576. DFC_Verb 0.00 576. FORMAT "%2.0" /end CHARACTERISTIC
/begin CHARACTERISTIC DFES_GrpRpr.DFC_TrbChSCB_C "/" VALUE 0x80073710 Val_Wu16 576. DFC_Verb 0.00 576. FORMAT "%2.0" /end CHARACTERISTIC
/begin CHARACTERISTIC DFES_GrpRpr.DFC_VSwVlvGovDvtMax_C "/" VALUE 0x80073712 Val_Wu16 576. DFC_Verb 0.00 576. FORMAT "%2.0" /end CHARACTERISTIC
/begin CHARACTERISTIC DFES_GrpRpr.DFC_VSwVlvGovDvtMin_C "/" VALUE 0x80073714 Val_Wu16 576. DFC_Verb 0.00 576. FORMAT "%2.0" /end CHARACTERISTIC
/begin CHARACTERISTIC DFES_GrpRpr.DFC_VSwVlvOL_C "/" VALUE 0x80073716 Val_Wu16 576. DFC_Verb 0.00 576. FORMAT "%2.0" /end CHARACTERISTIC
/begin CHARACTERISTIC DFES_GrpRpr.DFC_VSwVlvSCB_C "/" VALUE 0x80073718 Val_Wu16 576. DFC_Verb 0.00 576. FORMAT "%2.0" /end CHARACTERISTIC
/begin CHARACTERISTIC DFES_GrpRpr.DFC_VSwVlvSCG_C "/" VALUE 0x8007371A Val_Wu16 576. DFC_Verb 0.00 576. FORMAT "%2.0" /end CHARACTERISTIC
/begin CHARACTERISTIC DFES_GrpRpr.DFC_VSwVlvSRCMax_C "/" VALUE 0x8007371C Val_Wu16 576. DFC_Verb 0.00 576. FORMAT "%2.0" /end CHARACTERISTIC
/begin CHARACTERISTIC DFES_GrpRpr.DFC_VSwVlvSRCMin_C "/" VALUE 0x8007371E Val_Wu16 576. DFC_Verb 0.00 576. FORMAT "%2.0" /end CHARACTERISTIC
/begin CHARACTERISTIC DFES_GrpRpr.DFC_VehVHW_C "/" VALUE 0x80073720 Val_Wu16 576. DFC_Verb 0.00 576. FORMAT "%2.0" /end CHARACTERISTIC
/begin CHARACTERISTIC DFES_GrpRpr.DFC_VehVMax_C "/" VALUE 0x80073722 Val_Wu16 576. DFC_Verb 0.00 576. FORMAT "%2.0" /end CHARACTERISTIC
/begin CHARACTERISTIC DFES_GrpRpr.DFC_VehVPlaus_C "/" VALUE 0x80073724 Val_Wu16 576. DFC_Verb 0.00 576. FORMAT "%2.0" /end CHARACTERISTIC
/begin CHARACTERISTIC DFES_GrpRpr.DFC_VehVSig_C "/" VALUE 0x80073726 Val_Wu16 576. DFC_Verb 0.00 576. FORMAT "%2.0" /end CHARACTERISTIC
/begin CHARACTERISTIC DFES_GrpRpr.DFC_WaHtElOL_C "/" VALUE 0x80073728 Val_Wu16 576. DFC_Verb 0.00 576. FORMAT "%2.0" /end CHARACTERISTIC
/begin CHARACTERISTIC DFES_GrpRpr.DFC_WaHtElSCB_C "/" VALUE 0x8007372A Val_Wu16 576. DFC_Verb 0.00 576. FORMAT "%2.0" /end CHARACTERISTIC
/begin CHARACTERISTIC DFES_GrpRpr.DFC_ClthNpl_C "/" VALUE 0x8007372C Val_Wu16 576. DFC_Verb 0.00 576. FORMAT "%2.0" /end CHARACTERISTIC
/begin CHARACTERISTIC DFES_GrpRpr.DFC_ETClbETMax_0_C "/" VALUE 0x8007372E Val_Wu16 576. DFC_Verb 0.00 576. FORMAT "%2.0" /end CHARACTERISTIC
/begin CHARACTERISTIC DFES_GrpRpr.DFC_ETClbETMax_1_C "/" VALUE 0x80073730 Val_Wu16 576. DFC_Verb 0.00 576. FORMAT "%2.0" /end CHARACTERISTIC
/begin CHARACTERISTIC DFES_GrpRpr.DFC_ETClbETMax_2_C "/" VALUE 0x80073732 Val_Wu16 576. DFC_Verb 0.00 576. FORMAT "%2.0" /end CHARACTERISTIC
/begin CHARACTERISTIC DFES_GrpRpr.DFC_ETClbETMax_3_C "/" VALUE 0x80073734 Val_Wu16 576. DFC_Verb 0.00 576. FORMAT "%2.0" /end CHARACTERISTIC
/begin CHARACTERISTIC DFES_GrpRpr.DFC_ETClbETMax_4_C "/" VALUE 0x80073736 Val_Wu16 576. DFC_Verb 0.00 576. FORMAT "%2.0" /end CHARACTERISTIC
/begin CHARACTERISTIC DFES_GrpRpr.DFC_ETClbETMax_5_C "/" VALUE 0x80073738 Val_Wu16 576. DFC_Verb 0.00 576. FORMAT "%2.0" /end CHARACTERISTIC
/begin CHARACTERISTIC DFES_GrpRpr.DFC_ETClbETMin_0_C "/" VALUE 0x8007373A Val_Wu16 576. DFC_Verb 0.00 576. FORMAT "%2.0" /end CHARACTERISTIC
/begin CHARACTERISTIC DFES_GrpRpr.DFC_ETClbETMin_1_C "/" VALUE 0x8007373C Val_Wu16 576. DFC_Verb 0.00 576. FORMAT "%2.0" /end CHARACTERISTIC
/begin CHARACTERISTIC DFES_GrpRpr.DFC_ETClbETMin_2_C "/" VALUE 0x8007373E Val_Wu16 576. DFC_Verb 0.00 576. FORMAT "%2.0" /end CHARACTERISTIC
/begin CHARACTERISTIC DFES_GrpRpr.DFC_ETClbETMin_3_C "/" VALUE 0x80073740 Val_Wu16 576. DFC_Verb 0.00 576. FORMAT "%2.0" /end CHARACTERISTIC
/begin CHARACTERISTIC DFES_GrpRpr.DFC_ETClbETMin_4_C "/" VALUE 0x80073742 Val_Wu16 576. DFC_Verb 0.00 576. FORMAT "%2.0" /end CHARACTERISTIC
/begin CHARACTERISTIC DFES_GrpRpr.DFC_ETClbETMin_5_C "/" VALUE 0x80073744 Val_Wu16 576. DFC_Verb 0.00 576. FORMAT "%2.0" /end CHARACTERISTIC
/begin CHARACTERISTIC DFES_GrpRpr.DFC_IVDiaBnkShCirBSH_0_C "/" VALUE 0x80073746 Val_Wu16 576. DFC_Verb 0.00 576. FORMAT "%2.0" /end CHARACTERISTIC
/begin CHARACTERISTIC DFES_GrpRpr.DFC_IVDiaBnkShCirBSH_1_C "/" VALUE 0x80073748 Val_Wu16 576. DFC_Verb 0.00 576. FORMAT "%2.0" /end CHARACTERISTIC
/begin CHARACTERISTIC DFES_GrpRpr.DFC_IVDiaBnkShCirChSwt_0_C "/" VALUE 0x8007374A Val_Wu16 576. DFC_Verb 0.00 576. FORMAT "%2.0" /end CHARACTERISTIC
/begin CHARACTERISTIC DFES_GrpRpr.DFC_IVDiaBnkShCirChSwt_1_C "/" VALUE 0x8007374C Val_Wu16 576. DFC_Verb 0.00 576. FORMAT "%2.0" /end CHARACTERISTIC
/begin CHARACTERISTIC DFES_GrpRpr.DFC_IVDiaBnkShCirHSBatt_0_C "/" VALUE 0x8007374E Val_Wu16 576. DFC_Verb 0.00 576. FORMAT "%2.0" /end CHARACTERISTIC
/begin CHARACTERISTIC DFES_GrpRpr.DFC_IVDiaBnkShCirHSBatt_1_C "/" VALUE 0x80073750 Val_Wu16 576. DFC_Verb 0.00 576. FORMAT "%2.0" /end CHARACTERISTIC
/begin CHARACTERISTIC DFES_GrpRpr.DFC_IVDiaBnkShCirHiRstnc_0_C "/" VALUE 0x80073752 Val_Wu16 576. DFC_Verb 0.00 576. FORMAT "%2.0" /end CHARACTERISTIC
/begin CHARACTERISTIC DFES_GrpRpr.DFC_IVDiaBnkShCirHiRstnc_1_C "/" VALUE 0x80073754 Val_Wu16 576. DFC_Verb 0.00 576. FORMAT "%2.0" /end CHARACTERISTIC
/begin CHARACTERISTIC DFES_GrpRpr.DFC_IVDiaBnkShCirLSHSGnd_0_C "/" VALUE 0x80073756 Val_Wu16 576. DFC_Verb 0.00 576. FORMAT "%2.0" /end CHARACTERISTIC
/begin CHARACTERISTIC DFES_GrpRpr.DFC_IVDiaBnkShCirLSHSGnd_1_C "/" VALUE 0x80073758 Val_Wu16 576. DFC_Verb 0.00 576. FORMAT "%2.0" /end CHARACTERISTIC
/begin CHARACTERISTIC DFES_GrpRpr.DFC_IVDiaBnkShCirTransfer_0_C "/" VALUE 0x8007375A Val_Wu16 576. DFC_Verb 0.00 576. FORMAT "%2.0" /end CHARACTERISTIC
/begin CHARACTERISTIC DFES_GrpRpr.DFC_IVDiaBnkShCirTransfer_1_C "/" VALUE 0x8007375C Val_Wu16 576. DFC_Verb 0.00 576. FORMAT "%2.0" /end CHARACTERISTIC
/begin CHARACTERISTIC DFES_GrpRpr.DFC_IVDiaCylNoCls_0_C "/" VALUE 0x8007375E Val_Wu16 576. DFC_Verb 0.00 576. FORMAT "%2.0" /end CHARACTERISTIC
/begin CHARACTERISTIC DFES_GrpRpr.DFC_IVDiaCylNoCls_1_C "/" VALUE 0x80073760 Val_Wu16 576. DFC_Verb 0.00 576. FORMAT "%2.0" /end CHARACTERISTIC
/begin CHARACTERISTIC DFES_GrpRpr.DFC_IVDiaCylNoCls_2_C "/" VALUE 0x80073762 Val_Wu16 576. DFC_Verb 0.00 576. FORMAT "%2.0" /end CHARACTERISTIC
/begin CHARACTERISTIC DFES_GrpRpr.DFC_IVDiaCylNoCls_3_C "/" VALUE 0x80073764 Val_Wu16 576. DFC_Verb 0.00 576. FORMAT "%2.0" /end CHARACTERISTIC
/begin CHARACTERISTIC DFES_GrpRpr.DFC_IVDiaCylNoCls_4_C "/" VALUE 0x80073766 Val_Wu16 576. DFC_Verb 0.00 576. FORMAT "%2.0" /end CHARACTERISTIC
/begin CHARACTERISTIC DFES_GrpRpr.DFC_IVDiaCylNoCls_5_C "/" VALUE 0x80073768 Val_Wu16 576. DFC_Verb 0.00 576. FORMAT "%2.0" /end CHARACTERISTIC
/begin CHARACTERISTIC DFES_GrpRpr.DFC_IVDiaCylNoLd_0_C "/" VALUE 0x8007376A Val_Wu16 576. DFC_Verb 0.00 576. FORMAT "%2.0" /end CHARACTERISTIC
/begin CHARACTERISTIC DFES_GrpRpr.DFC_IVDiaCylNoLd_1_C "/" VALUE 0x8007376C Val_Wu16 576. DFC_Verb 0.00 576. FORMAT "%2.0" /end CHARACTERISTIC
/begin CHARACTERISTIC DFES_GrpRpr.DFC_IVDiaCylNoLd_2_C "/" VALUE 0x8007376E Val_Wu16 576. DFC_Verb 0.00 576. FORMAT "%2.0" /end CHARACTERISTIC
/begin CHARACTERISTIC DFES_GrpRpr.DFC_IVDiaCylNoLd_3_C "/" VALUE 0x80073770 Val_Wu16 576. DFC_Verb 0.00 576. FORMAT "%2.0" /end CHARACTERISTIC
/begin CHARACTERISTIC DFES_GrpRpr.DFC_IVDiaCylNoLd_4_C "/" VALUE 0x80073772 Val_Wu16 576. DFC_Verb 0.00 576. FORMAT "%2.0" /end CHARACTERISTIC
/begin CHARACTERISTIC DFES_GrpRpr.DFC_IVDiaCylNoLd_5_C "/" VALUE 0x80073774 Val_Wu16 576. DFC_Verb 0.00 576. FORMAT "%2.0" /end CHARACTERISTIC
/begin CHARACTERISTIC DFES_GrpRpr.DFC_IVDiaCylShCirHiRstnc_0_C "/" VALUE 0x80073776 Val_Wu16 576. DFC_Verb 0.00 576. FORMAT "%2.0" /end CHARACTERISTIC
/begin CHARACTERISTIC DFES_GrpRpr.DFC_IVDiaCylShCirHiRstnc_1_C "/" VALUE 0x80073778 Val_Wu16 576. DFC_Verb 0.00 576. FORMAT "%2.0" /end CHARACTERISTIC
/begin CHARACTERISTIC DFES_GrpRpr.DFC_IVDiaCylShCirHiRstnc_2_C "/" VALUE 0x8007377A Val_Wu16 576. DFC_Verb 0.00 576. FORMAT "%2.0" /end CHARACTERISTIC
/begin CHARACTERISTIC DFES_GrpRpr.DFC_IVDiaCylShCirHiRstnc_3_C "/" VALUE 0x8007377C Val_Wu16 576. DFC_Verb 0.00 576. FORMAT "%2.0" /end CHARACTERISTIC
/begin CHARACTERISTIC DFES_GrpRpr.DFC_IVDiaCylShCirHiRstnc_4_C "/" VALUE 0x8007377E Val_Wu16 576. DFC_Verb 0.00 576. FORMAT "%2.0" /end CHARACTERISTIC
/begin CHARACTERISTIC DFES_GrpRpr.DFC_IVDiaCylShCirHiRstnc_5_C "/" VALUE 0x80073780 Val_Wu16 576. DFC_Verb 0.00 576. FORMAT "%2.0" /end CHARACTERISTIC
/begin CHARACTERISTIC DFES_GrpRpr.DFC_IVDiaCylShCirLSBatt_0_C "/" VALUE 0x80073782 Val_Wu16 576. DFC_Verb 0.00 576. FORMAT "%2.0" /end CHARACTERISTIC
/begin CHARACTERISTIC DFES_GrpRpr.DFC_IVDiaCylShCirLSBatt_1_C "/" VALUE 0x80073784 Val_Wu16 576. DFC_Verb 0.00 576. FORMAT "%2.0" /end CHARACTERISTIC
/begin CHARACTERISTIC DFES_GrpRpr.DFC_IVDiaCylShCirLSBatt_2_C "/" VALUE 0x80073786 Val_Wu16 576. DFC_Verb 0.00 576. FORMAT "%2.0" /end CHARACTERISTIC
/begin CHARACTERISTIC DFES_GrpRpr.DFC_IVDiaCylShCirLSBatt_3_C "/" VALUE 0x80073788 Val_Wu16 576. DFC_Verb 0.00 576. FORMAT "%2.0" /end CHARACTERISTIC
/begin CHARACTERISTIC DFES_GrpRpr.DFC_IVDiaCylShCirLSBatt_4_C "/" VALUE 0x8007378A Val_Wu16 576. DFC_Verb 0.00 576. FORMAT "%2.0" /end CHARACTERISTIC
/begin CHARACTERISTIC DFES_GrpRpr.DFC_IVDiaCylShCirLSBatt_5_C "/" VALUE 0x8007378C Val_Wu16 576. DFC_Verb 0.00 576. FORMAT "%2.0" /end CHARACTERISTIC
/begin CHARACTERISTIC DFES_GrpRpr.DFC_IVDiaCylShCirLSHS_0_C "/" VALUE 0x8007378E Val_Wu16 576. DFC_Verb 0.00 576. FORMAT "%2.0" /end CHARACTERISTIC
/begin CHARACTERISTIC DFES_GrpRpr.DFC_IVDiaCylShCirLSHS_1_C "/" VALUE 0x80073790 Val_Wu16 576. DFC_Verb 0.00 576. FORMAT "%2.0" /end CHARACTERISTIC
/begin CHARACTERISTIC DFES_GrpRpr.DFC_IVDiaCylShCirLSHS_2_C "/" VALUE 0x80073792 Val_Wu16 576. DFC_Verb 0.00 576. FORMAT "%2.0" /end CHARACTERISTIC
/begin CHARACTERISTIC DFES_GrpRpr.DFC_IVDiaCylShCirLSHS_3_C "/" VALUE 0x80073794 Val_Wu16 576. DFC_Verb 0.00 576. FORMAT "%2.0" /end CHARACTERISTIC
/begin CHARACTERISTIC DFES_GrpRpr.DFC_IVDiaCylShCirLSHS_4_C "/" VALUE 0x80073796 Val_Wu16 576. DFC_Verb 0.00 576. FORMAT "%2.0" /end CHARACTERISTIC
/begin CHARACTERISTIC DFES_GrpRpr.DFC_IVDiaCylShCirLSHS_5_C "/" VALUE 0x80073798 Val_Wu16 576. DFC_Verb 0.00 576. FORMAT "%2.0" /end CHARACTERISTIC
/begin CHARACTERISTIC DFES_GrpRpr.DFC_IVDiaCylShCirLsLs_0_C "/" VALUE 0x8007379A Val_Wu16 576. DFC_Verb 0.00 576. FORMAT "%2.0" /end CHARACTERISTIC
/begin CHARACTERISTIC DFES_GrpRpr.DFC_IVDiaCylShCirLsLs_1_C "/" VALUE 0x8007379C Val_Wu16 576. DFC_Verb 0.00 576. FORMAT "%2.0" /end CHARACTERISTIC
/begin CHARACTERISTIC DFES_GrpRpr.DFC_IVDiaCylShCirLsLs_2_C "/" VALUE 0x8007379E Val_Wu16 576. DFC_Verb 0.00 576. FORMAT "%2.0" /end CHARACTERISTIC
/begin CHARACTERISTIC DFES_GrpRpr.DFC_IVDiaCylShCirLsLs_3_C "/" VALUE 0x800737A0 Val_Wu16 576. DFC_Verb 0.00 576. FORMAT "%2.0" /end CHARACTERISTIC
/begin CHARACTERISTIC DFES_GrpRpr.DFC_IVDiaCylShCirLsLs_4_C "/" VALUE 0x800737A2 Val_Wu16 576. DFC_Verb 0.00 576. FORMAT "%2.0" /end CHARACTERISTIC
/begin CHARACTERISTIC DFES_GrpRpr.DFC_IVDiaCylShCirLsLs_5_C "/" VALUE 0x800737A4 Val_Wu16 576. DFC_Verb 0.00 576. FORMAT "%2.0" /end CHARACTERISTIC
/begin CHARACTERISTIC DFES_GrpRpr.DFC_IVDiaSPICfg_C "/" VALUE 0x800737A6 Val_Wu16 576. DFC_Verb 0.00 576. FORMAT "%2.0" /end CHARACTERISTIC
/begin CHARACTERISTIC DFES_GrpRpr.DFC_IVDiaSPIColl_C "/" VALUE 0x800737A8 Val_Wu16 576. DFC_Verb 0.00 576. FORMAT "%2.0" /end CHARACTERISTIC
/begin CHARACTERISTIC DFES_GrpRpr.DFC_IVDiaSPICtrl_C "/" VALUE 0x800737AA Val_Wu16 576. DFC_Verb 0.00 576. FORMAT "%2.0" /end CHARACTERISTIC
/begin CHARACTERISTIC DFES_GrpRpr.DFC_IVDiaSPIRam_C "/" VALUE 0x800737AC Val_Wu16 576. DFC_Verb 0.00 576. FORMAT "%2.0" /end CHARACTERISTIC
/begin CHARACTERISTIC DFES_GrpRpr.DFC_IVDiaSPITrans_C "/" VALUE 0x800737AE Val_Wu16 576. DFC_Verb 0.00 576. FORMAT "%2.0" /end CHARACTERISTIC
/begin CHARACTERISTIC DFES_GrpRpr.DFC_LSUCmpChk_0_C "/" VALUE 0x800737B0 Val_Wu16 576. DFC_Verb 0.00 576. FORMAT "%2.0" /end CHARACTERISTIC
/begin CHARACTERISTIC DFES_GrpRpr.DFC_LSUCmpChk_1_C "/" VALUE 0x800737B2 Val_Wu16 576. DFC_Verb 0.00 576. FORMAT "%2.0" /end CHARACTERISTIC
/begin CHARACTERISTIC DFES_GrpRpr.DFC_LSUCmpChk_2_C "/" VALUE 0x800737B4 Val_Wu16 576. DFC_Verb 0.00 576. FORMAT "%2.0" /end CHARACTERISTIC
/begin CHARACTERISTIC DFES_GrpRpr.DFC_LSUCmpChk_3_C "/" VALUE 0x800737B6 Val_Wu16 576. DFC_Verb 0.00 576. FORMAT "%2.0" /end CHARACTERISTIC
/begin CHARACTERISTIC DFES_GrpRpr.DFC_LSUCmpChk_4_C "/" VALUE 0x800737B8 Val_Wu16 576. DFC_Verb 0.00 576. FORMAT "%2.0" /end CHARACTERISTIC
/begin CHARACTERISTIC DFES_GrpRpr.DFC_LSUCmpChk_5_C "/" VALUE 0x800737BA Val_Wu16 576. DFC_Verb 0.00 576. FORMAT "%2.0" /end CHARACTERISTIC
/begin CHARACTERISTIC DFES_GrpRpr.DFC_LSUDynChk_0_C "/" VALUE 0x800737BC Val_Wu16 576. DFC_Verb 0.00 576. FORMAT "%2.0" /end CHARACTERISTIC
/begin CHARACTERISTIC DFES_GrpRpr.DFC_LSUDynChk_1_C "/" VALUE 0x800737BE Val_Wu16 576. DFC_Verb 0.00 576. FORMAT "%2.0" /end CHARACTERISTIC
/begin CHARACTERISTIC DFES_GrpRpr.DFC_LSUDynChk_2_C "/" VALUE 0x800737C0 Val_Wu16 576. DFC_Verb 0.00 576. FORMAT "%2.0" /end CHARACTERISTIC
/begin CHARACTERISTIC DFES_GrpRpr.DFC_LSUDynChk_3_C "/" VALUE 0x800737C2 Val_Wu16 576. DFC_Verb 0.00 576. FORMAT "%2.0" /end CHARACTERISTIC
/begin CHARACTERISTIC DFES_GrpRpr.DFC_LSUO2ClbMax_0_C "/" VALUE 0x800737C4 Val_Wu16 576. DFC_Verb 0.00 576. FORMAT "%2.0" /end CHARACTERISTIC
/begin CHARACTERISTIC DFES_GrpRpr.DFC_LSUO2ClbMax_1_C "/" VALUE 0x800737C6 Val_Wu16 576. DFC_Verb 0.00 576. FORMAT "%2.0" /end CHARACTERISTIC
/begin CHARACTERISTIC DFES_GrpRpr.DFC_LSUO2ClbMax_2_C "/" VALUE 0x800737C8 Val_Wu16 576. DFC_Verb 0.00 576. FORMAT "%2.0" /end CHARACTERISTIC
/begin CHARACTERISTIC DFES_GrpRpr.DFC_LSUO2ClbMax_3_C "/" VALUE 0x800737CA Val_Wu16 576. DFC_Verb 0.00 576. FORMAT "%2.0" /end CHARACTERISTIC
/begin CHARACTERISTIC DFES_GrpRpr.DFC_LSUO2ClbMin_0_C "/" VALUE 0x800737CC Val_Wu16 576. DFC_Verb 0.00 576. FORMAT "%2.0" /end CHARACTERISTIC
/begin CHARACTERISTIC DFES_GrpRpr.DFC_LSUO2ClbMin_1_C "/" VALUE 0x800737CE Val_Wu16 576. DFC_Verb 0.00 576. FORMAT "%2.0" /end CHARACTERISTIC
/begin CHARACTERISTIC DFES_GrpRpr.DFC_LSUO2ClbMin_2_C "/" VALUE 0x800737D0 Val_Wu16 576. DFC_Verb 0.00 576. FORMAT "%2.0" /end CHARACTERISTIC
/begin CHARACTERISTIC DFES_GrpRpr.DFC_LSUO2ClbMin_3_C "/" VALUE 0x800737D2 Val_Wu16 576. DFC_Verb 0.00 576. FORMAT "%2.0" /end CHARACTERISTIC
/begin CHARACTERISTIC DFES_GrpRpr.DFC_LSUO2PlausMax_0_C "/" VALUE 0x800737D4 Val_Wu16 576. DFC_Verb 0.00 576. FORMAT "%2.0" /end CHARACTERISTIC
/begin CHARACTERISTIC DFES_GrpRpr.DFC_LSUO2PlausMax_1_C "/" VALUE 0x800737D6 Val_Wu16 576. DFC_Verb 0.00 576. FORMAT "%2.0" /end CHARACTERISTIC
/begin CHARACTERISTIC DFES_GrpRpr.DFC_LSUO2PlausMax_2_C "/" VALUE 0x800737D8 Val_Wu16 576. DFC_Verb 0.00 576. FORMAT "%2.0" /end CHARACTERISTIC
/begin CHARACTERISTIC DFES_GrpRpr.DFC_LSUO2PlausMax_3_C "/" VALUE 0x800737DA Val_Wu16 576. DFC_Verb 0.00 576. FORMAT "%2.0" /end CHARACTERISTIC
/begin CHARACTERISTIC DFES_GrpRpr.DFC_LSUO2PlausMin_0_C "/" VALUE 0x800737DC Val_Wu16 576. DFC_Verb 0.00 576. FORMAT "%2.0" /end CHARACTERISTIC
/begin CHARACTERISTIC DFES_GrpRpr.DFC_LSUO2PlausMin_1_C "/" VALUE 0x800737DE Val_Wu16 576. DFC_Verb 0.00 576. FORMAT "%2.0" /end CHARACTERISTIC
/begin CHARACTERISTIC DFES_GrpRpr.DFC_LSUO2PlausMin_2_C "/" VALUE 0x800737E0 Val_Wu16 576. DFC_Verb 0.00 576. FORMAT "%2.0" /end CHARACTERISTIC
/begin CHARACTERISTIC DFES_GrpRpr.DFC_LSUO2PlausMin_3_C "/" VALUE 0x800737E2 Val_Wu16 576. DFC_Verb 0.00 576. FORMAT "%2.0" /end CHARACTERISTIC
/begin CHARACTERISTIC DFES_GrpRpr.DFC_LSURiClbMax_0_C "/" VALUE 0x800737E4 Val_Wu16 576. DFC_Verb 0.00 576. FORMAT "%2.0" /end CHARACTERISTIC
/begin CHARACTERISTIC DFES_GrpRpr.DFC_LSURiClbMax_1_C "/" VALUE 0x800737E6 Val_Wu16 576. DFC_Verb 0.00 576. FORMAT "%2.0" /end CHARACTERISTIC
/begin CHARACTERISTIC DFES_GrpRpr.DFC_LSURiClbMax_2_C "/" VALUE 0x800737E8 Val_Wu16 576. DFC_Verb 0.00 576. FORMAT "%2.0" /end CHARACTERISTIC
/begin CHARACTERISTIC DFES_GrpRpr.DFC_LSURiClbMax_3_C "/" VALUE 0x800737EA Val_Wu16 576. DFC_Verb 0.00 576. FORMAT "%2.0" /end CHARACTERISTIC
/begin CHARACTERISTIC DFES_GrpRpr.DFC_LSURiClbMin_0_C "/" VALUE 0x800737EC Val_Wu16 576. DFC_Verb 0.00 576. FORMAT "%2.0" /end CHARACTERISTIC
/begin CHARACTERISTIC DFES_GrpRpr.DFC_LSURiClbMin_1_C "/" VALUE 0x800737EE Val_Wu16 576. DFC_Verb 0.00 576. FORMAT "%2.0" /end CHARACTERISTIC
/begin CHARACTERISTIC DFES_GrpRpr.DFC_LSURiClbMin_2_C "/" VALUE 0x800737F0 Val_Wu16 576. DFC_Verb 0.00 576. FORMAT "%2.0" /end CHARACTERISTIC
/begin CHARACTERISTIC DFES_GrpRpr.DFC_LSURiClbMin_3_C "/" VALUE 0x800737F2 Val_Wu16 576. DFC_Verb 0.00 576. FORMAT "%2.0" /end CHARACTERISTIC
/begin CHARACTERISTIC DFES_GrpRpr.DFC_LSUWireIPSig_0_C "/" VALUE 0x800737F4 Val_Wu16 576. DFC_Verb 0.00 576. FORMAT "%2.0" /end CHARACTERISTIC
/begin CHARACTERISTIC DFES_GrpRpr.DFC_LSUWireIPSig_1_C "/" VALUE 0x800737F6 Val_Wu16 576. DFC_Verb 0.00 576. FORMAT "%2.0" /end CHARACTERISTIC
/begin CHARACTERISTIC DFES_GrpRpr.DFC_LSUWireIPSig_2_C "/" VALUE 0x800737F8 Val_Wu16 576. DFC_Verb 0.00 576. FORMAT "%2.0" /end CHARACTERISTIC
/begin CHARACTERISTIC DFES_GrpRpr.DFC_LSUWireIPSig_3_C "/" VALUE 0x800737FA Val_Wu16 576. DFC_Verb 0.00 576. FORMAT "%2.0" /end CHARACTERISTIC
/begin CHARACTERISTIC DFES_GrpRpr.DFC_AFSDrftIdlAdjVal_C "/" VALUE 0x800737FC Val_Wu16 576. DFC_Verb 0.00 576. FORMAT "%2.0" /end CHARACTERISTIC
/begin CHARACTERISTIC DFES_GrpRpr.DFC_AFSDrftLdAdjVal_C "/" VALUE 0x800737FE Val_Wu16 576. DFC_Verb 0.00 576. FORMAT "%2.0" /end CHARACTERISTIC
/begin CHARACTERISTIC DFES_GrpRpr.DFC_AdcI_ADC0_Cal_C "/" VALUE 0x80073800 Val_Wu16 576. DFC_Verb 0.00 576. FORMAT "%2.0" /end CHARACTERISTIC
/begin CHARACTERISTIC DFES_GrpRpr.DFC_AdcI_ADC0_Conv_C "/" VALUE 0x80073802 Val_Wu16 576. DFC_Verb 0.00 576. FORMAT "%2.0" /end CHARACTERISTIC
/begin CHARACTERISTIC DFES_GrpRpr.DFC_CmbChbMisfireMax_0_C "/" VALUE 0x80073804 Val_Wu16 576. DFC_Verb 0.00 576. FORMAT "%2.0" /end CHARACTERISTIC
/begin CHARACTERISTIC DFES_GrpRpr.DFC_CmbChbMisfireMax_1_C "/" VALUE 0x80073806 Val_Wu16 576. DFC_Verb 0.00 576. FORMAT "%2.0" /end CHARACTERISTIC
/begin CHARACTERISTIC DFES_GrpRpr.DFC_CmbChbMisfireMax_2_C "/" VALUE 0x80073808 Val_Wu16 576. DFC_Verb 0.00 576. FORMAT "%2.0" /end CHARACTERISTIC
/begin CHARACTERISTIC DFES_GrpRpr.DFC_CmbChbMisfireMax_3_C "/" VALUE 0x8007380A Val_Wu16 576. DFC_Verb 0.00 576. FORMAT "%2.0" /end CHARACTERISTIC
/begin CHARACTERISTIC DFES_GrpRpr.DFC_CmbChbMisfireMax_4_C "/" VALUE 0x8007380C Val_Wu16 576. DFC_Verb 0.00 576. FORMAT "%2.0" /end CHARACTERISTIC
/begin CHARACTERISTIC DFES_GrpRpr.DFC_CmbChbMisfireMax_5_C "/" VALUE 0x8007380E Val_Wu16 576. DFC_Verb 0.00 576. FORMAT "%2.0" /end CHARACTERISTIC
/begin CHARACTERISTIC DFES_GrpRpr.DFC_CmbChbMisfireMul_C "/" VALUE 0x80073810 Val_Wu16 576. DFC_Verb 0.00 576. FORMAT "%2.0" /end CHARACTERISTIC
/begin CHARACTERISTIC DFES_GrpRpr.DFC_INJVLVBUSY_C "/" VALUE 0x80073812 Val_Wu16 576. DFC_Verb 0.00 576. FORMAT "%2.0" /end CHARACTERISTIC
/begin CHARACTERISTIC DFES_GrpRpr.DFC_IVAdjIVA_0_C "/" VALUE 0x80073814 Val_Wu16 576. DFC_Verb 0.00 576. FORMAT "%2.0" /end CHARACTERISTIC
/begin CHARACTERISTIC DFES_GrpRpr.DFC_IVAdjIVA_1_C "/" VALUE 0x80073816 Val_Wu16 576. DFC_Verb 0.00 576. FORMAT "%2.0" /end CHARACTERISTIC
/begin CHARACTERISTIC DFES_GrpRpr.DFC_IVAdjIVA_2_C "/" VALUE 0x80073818 Val_Wu16 576. DFC_Verb 0.00 576. FORMAT "%2.0" /end CHARACTERISTIC
/begin CHARACTERISTIC DFES_GrpRpr.DFC_IVAdjIVA_3_C "/" VALUE 0x8007381A Val_Wu16 576. DFC_Verb 0.00 576. FORMAT "%2.0" /end CHARACTERISTIC
/begin CHARACTERISTIC DFES_GrpRpr.DFC_IVAdjIVA_4_C "/" VALUE 0x8007381C Val_Wu16 576. DFC_Verb 0.00 576. FORMAT "%2.0" /end CHARACTERISTIC
/begin CHARACTERISTIC DFES_GrpRpr.DFC_IVAdjIVA_5_C "/" VALUE 0x8007381E Val_Wu16 576. DFC_Verb 0.00 576. FORMAT "%2.0" /end CHARACTERISTIC
/begin CHARACTERISTIC DFES_GrpRpr.DFC_InjCtlAdjQntEEPCS_C "/" VALUE 0x80073820 Val_Wu16 576. DFC_Verb 0.00 576. FORMAT "%2.0" /end CHARACTERISTIC
/begin CHARACTERISTIC DFES_GrpRpr.DFC_InjCtlDriftEEPCS_C "/" VALUE 0x80073822 Val_Wu16 576. DFC_Verb 0.00 576. FORMAT "%2.0" /end CHARACTERISTIC
/begin CHARACTERISTIC DFES_GrpRpr.DFC_MRlyErlyOpng_C "/" VALUE 0x80073824 Val_Wu16 576. DFC_Verb 0.00 576. FORMAT "%2.0" /end CHARACTERISTIC
/begin CHARACTERISTIC DFES_GrpRpr.DFC_MRlyStk_C "/" VALUE 0x80073826 Val_Wu16 576. DFC_Verb 0.00 576. FORMAT "%2.0" /end CHARACTERISTIC
/begin CHARACTERISTIC DFES_GrpRpr.DFC_SensFrzPPFltUs_C "/" VALUE 0x80073828 Val_Wu16 576. DFC_Verb 0.00 576. FORMAT "%2.0" /end CHARACTERISTIC
/begin CHARACTERISTIC DFES_GrpRpr.DFC_T15Sig_C "/" VALUE 0x8007382A Val_Wu16 576. DFC_Verb 0.00 576. FORMAT "%2.0" /end CHARACTERISTIC
/begin CHARACTERISTIC DFES_GrpRpr.DFC_AirCtlRmpTOut_C "/" VALUE 0x8007382C Val_Wu16 576. DFC_Verb 0.00 576. FORMAT "%2.0" /end CHARACTERISTIC
/begin CHARACTERISTIC DFES_GrpRpr.DFC_CEngDsTDynTst_C "/" VALUE 0x8007382E Val_Wu16 576. DFC_Verb 0.00 576. FORMAT "%2.0" /end CHARACTERISTIC
/begin CHARACTERISTIC DFES_GrpRpr.DFC_EGRVlvJamVlvClsd_C "/" VALUE 0x80073830 Val_Wu16 576. DFC_Verb 0.00 576. FORMAT "%2.0" /end CHARACTERISTIC
/begin CHARACTERISTIC DFES_GrpRpr.DFC_EGRVlvJamVlvOpn_C "/" VALUE 0x80073832 Val_Wu16 576. DFC_Verb 0.00 576. FORMAT "%2.0" /end CHARACTERISTIC
/begin CHARACTERISTIC DFES_GrpRpr.DFC_EGRVlvLgTDrft_C "/" VALUE 0x80073834 Val_Wu16 576. DFC_Verb 0.00 576. FORMAT "%2.0" /end CHARACTERISTIC
/begin CHARACTERISTIC DFES_GrpRpr.DFC_EGRVlvOfsLrnJamVlv_C "/" VALUE 0x80073836 Val_Wu16 576. DFC_Verb 0.00 576. FORMAT "%2.0" /end CHARACTERISTIC
/begin CHARACTERISTIC DFES_GrpRpr.DFC_EGRVlvShTDrft_C "/" VALUE 0x80073838 Val_Wu16 576. DFC_Verb 0.00 576. FORMAT "%2.0" /end CHARACTERISTIC
/begin CHARACTERISTIC DFES_GrpRpr.DFC_EGTRgnOilDilMax_C "/" VALUE 0x8007383A Val_Wu16 576. DFC_Verb 0.00 576. FORMAT "%2.0" /end CHARACTERISTIC
/begin CHARACTERISTIC DFES_GrpRpr.DFC_EngICO_C "/" VALUE 0x8007383C Val_Wu16 576. DFC_Verb 0.00 576. FORMAT "%2.0" /end CHARACTERISTIC
/begin CHARACTERISTIC DFES_GrpRpr.DFC_EpmCaSI1ErrSig_C "/" VALUE 0x8007383E Val_Wu16 576. DFC_Verb 0.00 576. FORMAT "%2.0" /end CHARACTERISTIC
/begin CHARACTERISTIC DFES_GrpRpr.DFC_EpmCaSI1NoSig_C "/" VALUE 0x80073840 Val_Wu16 576. DFC_Verb 0.00 576. FORMAT "%2.0" /end CHARACTERISTIC
/begin CHARACTERISTIC DFES_GrpRpr.DFC_EpmCaSI1OfsErr_C "/" VALUE 0x80073842 Val_Wu16 576. DFC_Verb 0.00 576. FORMAT "%2.0" /end CHARACTERISTIC
/begin CHARACTERISTIC DFES_GrpRpr.DFC_EpmCrSErrSig_C "/" VALUE 0x80073844 Val_Wu16 576. DFC_Verb 0.00 576. FORMAT "%2.0" /end CHARACTERISTIC
/begin CHARACTERISTIC DFES_GrpRpr.DFC_EpmCrSNoSig_C "/" VALUE 0x80073846 Val_Wu16 576. DFC_Verb 0.00 576. FORMAT "%2.0" /end CHARACTERISTIC
/begin CHARACTERISTIC DFES_GrpRpr.DFC_MoCADCCmp_C "/" VALUE 0x80073848 Val_Wu16 576. DFC_Verb 0.00 576. FORMAT "%2.0" /end CHARACTERISTIC
/begin CHARACTERISTIC DFES_GrpRpr.DFC_MoCADCTst_C "/" VALUE 0x8007384A Val_Wu16 576. DFC_Verb 0.00 576. FORMAT "%2.0" /end CHARACTERISTIC
/begin CHARACTERISTIC DFES_GrpRpr.DFC_MoCADCVltgRatio_C "/" VALUE 0x8007384C Val_Wu16 576. DFC_Verb 0.00 576. FORMAT "%2.0" /end CHARACTERISTIC
/begin CHARACTERISTIC DFES_GrpRpr.DFC_MoCSOPLoLi_C "/" VALUE 0x8007384E Val_Wu16 576. DFC_Verb 0.00 576. FORMAT "%2.0" /end CHARACTERISTIC
/begin CHARACTERISTIC DFES_GrpRpr.DFC_MoCSOPMM_C "/" VALUE 0x80073850 Val_Wu16 576. DFC_Verb 0.00 576. FORMAT "%2.0" /end CHARACTERISTIC
/begin CHARACTERISTIC DFES_GrpRpr.DFC_MoCSOPTimeOut_C "/" VALUE 0x80073852 Val_Wu16 576. DFC_Verb 0.00 576. FORMAT "%2.0" /end CHARACTERISTIC
/begin CHARACTERISTIC DFES_GrpRpr.DFC_MoCSOPUpLi_C "/" VALUE 0x80073854 Val_Wu16 576. DFC_Verb 0.00 576. FORMAT "%2.0" /end CHARACTERISTIC
/begin CHARACTERISTIC DFES_GrpRpr.DFC_MoFAPP_C "/" VALUE 0x80073856 Val_Wu16 576. DFC_Verb 0.00 576. FORMAT "%2.0" /end CHARACTERISTIC
/begin CHARACTERISTIC DFES_GrpRpr.DFC_MoFESpd_C "/" VALUE 0x80073858 Val_Wu16 576. DFC_Verb 0.00 576. FORMAT "%2.0" /end CHARACTERISTIC
/begin CHARACTERISTIC DFES_GrpRpr.DFC_MoFInjDatPhi_C "/" VALUE 0x8007385A Val_Wu16 576. DFC_Verb 0.00 576. FORMAT "%2.0" /end CHARACTERISTIC
/begin CHARACTERISTIC DFES_GrpRpr.DFC_MoFInjDatQnt_C "/" VALUE 0x8007385C Val_Wu16 576. DFC_Verb 0.00 576. FORMAT "%2.0" /end CHARACTERISTIC
/begin CHARACTERISTIC DFES_GrpRpr.DFC_MoFInjQnt_C "/" VALUE 0x8007385E Val_Wu16 576. DFC_Verb 0.00 576. FORMAT "%2.0" /end CHARACTERISTIC
/begin CHARACTERISTIC DFES_GrpRpr.DFC_MoFOvR_C "/" VALUE 0x80073860 Val_Wu16 576. DFC_Verb 0.00 576. FORMAT "%2.0" /end CHARACTERISTIC
/begin CHARACTERISTIC DFES_GrpRpr.DFC_MoFQntCor_C "/" VALUE 0x80073862 Val_Wu16 576. DFC_Verb 0.00 576. FORMAT "%2.0" /end CHARACTERISTIC
/begin CHARACTERISTIC DFES_GrpRpr.DFC_MoFTrqCmp_C "/" VALUE 0x80073864 Val_Wu16 576. DFC_Verb 0.00 576. FORMAT "%2.0" /end CHARACTERISTIC
/begin CHARACTERISTIC DFES_GrpRpr.DFC_NplTOxiCatUs_C "/" VALUE 0x80073866 Val_Wu16 576. DFC_Verb 0.00 576. FORMAT "%2.0" /end CHARACTERISTIC
/begin CHARACTERISTIC DFES_GrpRpr.DFC_PhyModNonMonMapNpl_C "/" VALUE 0x80073868 Val_Wu16 576. DFC_Verb 0.00 576. FORMAT "%2.0" /end CHARACTERISTIC
/begin CHARACTERISTIC DFES_GrpRpr.DFC_RailPOfsTstMax_C "/" VALUE 0x8007386A Val_Wu16 576. DFC_Verb 0.00 576. FORMAT "%2.0" /end CHARACTERISTIC
/begin CHARACTERISTIC DFES_GrpRpr.DFC_RailPOfsTstMin_C "/" VALUE 0x8007386C Val_Wu16 576. DFC_Verb 0.00 576. FORMAT "%2.0" /end CHARACTERISTIC
/begin CHARACTERISTIC DFES_GrpRpr.DFC_SWReset_0_C "/" VALUE 0x8007386E Val_Wu16 576. DFC_Verb 0.00 576. FORMAT "%2.0" /end CHARACTERISTIC
/begin CHARACTERISTIC DFES_GrpRpr.DFC_SWReset_1_C "/" VALUE 0x80073870 Val_Wu16 576. DFC_Verb 0.00 576. FORMAT "%2.0" /end CHARACTERISTIC
/begin CHARACTERISTIC DFES_GrpRpr.DFC_SWReset_2_C "/" VALUE 0x80073872 Val_Wu16 576. DFC_Verb 0.00 576. FORMAT "%2.0" /end CHARACTERISTIC
/begin CHARACTERISTIC DFES_GrpRpr.DFC_VSwVlvJamVlv_C "/" VALUE 0x80073874 Val_Wu16 576. DFC_Verb 0.00 576. FORMAT "%2.0" /end CHARACTERISTIC
/begin CHARACTERISTIC DFES_GrpRpr.DFC_VSwVlvLgTDrft_C "/" VALUE 0x80073876 Val_Wu16 576. DFC_Verb 0.00 576. FORMAT "%2.0" /end CHARACTERISTIC
/begin CHARACTERISTIC DFES_GrpRpr.DFC_VSwVlvOfsLrnJamVlv_C "/" VALUE 0x80073878 Val_Wu16 576. DFC_Verb 0.00 576. FORMAT "%2.0" /end CHARACTERISTIC
/begin CHARACTERISTIC DFES_GrpRpr.DFC_VSwVlvShTDrft_C "/" VALUE 0x8007387A Val_Wu16 576. DFC_Verb 0.00 576. FORMAT "%2.0" /end CHARACTERISTIC
/begin CHARACTERISTIC DFES_numClsDlt_CA "" VAL_BLK 0x8007387C ValA_Wu8 255.0 DFES_OneToOne 0.00 255.0 FORMAT "%5.1" NUMBER 30 /end CHARACTERISTIC
/begin CHARACTERISTIC DFES_numClsFaultCycl_CA "" VAL_BLK 0x8007389A ValA_Wu8 255.0 DFES_OneToOne 0.00 255.0 FORMAT "%5.1" NUMBER 30 /end CHARACTERISTIC
/begin CHARACTERISTIC DFES_numClsHealCycl_CA "" VAL_BLK 0x800738B8 ValA_Wu8 255.0 DFES_OneToOne 0.00 255.0 FORMAT "%5.1" NUMBER 30 /end CHARACTERISTIC
/begin CHARACTERISTIC DFES_numClsPndDlt_CA "" VAL_BLK 0x800738D6 ValA_Wu8 255.0 DFES_OneToOne 0.00 255.0 FORMAT "%5.1" NUMBER 30 /end CHARACTERISTIC
/begin CHARACTERISTIC DFES_numClsSvcDlt_CA "" VAL_BLK 0x800738F4 ValA_Wu8 255.0 DFES_OneToOne 0.00 255.0 FORMAT "%5.1" NUMBER 30 /end CHARACTERISTIC
/begin CHARACTERISTIC DFES_numClsSVSFaultCycl_CA "" VAL_BLK 0x80073912 ValA_Wu8 255.0 DFES_OneToOne 0.00 255.0 FORMAT "%5.1" NUMBER 30 /end CHARACTERISTIC
/begin CHARACTERISTIC DFES_numClsSVSHealCycl_CA "" VAL_BLK 0x80073930 ValA_Wu8 255.0 DFES_OneToOne 0.00 255.0 FORMAT "%5.1" NUMBER 30 /end CHARACTERISTIC
/begin CHARACTERISTIC DFES_xAsgnExtdFrzFrSig_CA "" VAL_BLK 0x8007394E ValA_Wu16 161.000000000 Signals_IntSigNumVerb 0.00 161.000000000 FORMAT "%13.9" NUMBER 1 /end CHARACTERISTIC
/begin CHARACTERISTIC DFES_xAsgnFrzFrSig_CA "" VAL_BLK 0x80073950 ValA_Wu16 161.000000000 Signals_IntSigNumVerb 0.00 161.000000000 FORMAT "%13.9" NUMBER 11 /end CHARACTERISTIC
/begin CHARACTERISTIC DFES_xClsDltTrg_CA "" VAL_BLK 0x80073966 ValA_Wu8 6. DSMAUX_DTRGVerb 0.00 6. FORMAT "%2.0" NUMBER 30 /end CHARACTERISTIC
/begin CHARACTERISTIC DFES_xClsFaultTrg_CA "" VAL_BLK 0x80073984 ValA_Wu8 6. DSMAUX_DTRGVerb 0.00 6. FORMAT "%2.0" NUMBER 30 /end CHARACTERISTIC
/begin CHARACTERISTIC DFES_xClsFltMIL_CA "" VAL_BLK 0x800739A2 ValA_Wu8 8.00000000000 DFES_LampFlt 0.00 8.00000000000 FORMAT "%13.11" NUMBER 30 /end CHARACTERISTIC
/begin CHARACTERISTIC DFES_xClsFltSVS_CA "" VAL_BLK 0x800739C0 ValA_Wu8 8.00000000000 DFES_LampFlt 0.00 8.00000000000 FORMAT "%13.11" NUMBER 30 /end CHARACTERISTIC
/begin CHARACTERISTIC DFES_xClsHealTrg_CA "" VAL_BLK 0x800739DE ValA_Wu8 6. DSMAUX_DTRGVerb 0.00 6. FORMAT "%2.0" NUMBER 30 /end CHARACTERISTIC
/begin CHARACTERISTIC DFES_xClsPndDltTrg_CA "" VAL_BLK 0x800739FC ValA_Wu8 6. DSMAUX_DTRGVerb 0.00 6. FORMAT "%2.0" NUMBER 30 /end CHARACTERISTIC
/begin CHARACTERISTIC DFES_xClsPrio_CA "" VAL_BLK 0x80073A1A ValA_Wu8 228.000000000 DFES_TstVisAndPrio 4.00000000000 232.000000000 FORMAT "%13.9" NUMBER 30 /end CHARACTERISTIC
/begin CHARACTERISTIC DFES_xClsSvcDltTrg_CA "" VAL_BLK 0x80073A38 ValA_Wu8 6. DSMAUX_DTRGVerb 0.00 6. FORMAT "%2.0" NUMBER 30 /end CHARACTERISTIC
/begin CHARACTERISTIC DFES_xClsSVSFaultTrg_CA "" VAL_BLK 0x80073A56 ValA_Wu8 6. DSMAUX_DTRGVerb 0.00 6. FORMAT "%2.0" NUMBER 30 /end CHARACTERISTIC
/begin CHARACTERISTIC DFES_xClsSVSHealTrg_CA "" VAL_BLK 0x80073A74 ValA_Wu8 6. DSMAUX_DTRGVerb 0.00 6. FORMAT "%2.0" NUMBER 30 /end CHARACTERISTIC
/begin MEASUREMENT DFES_ctDef "" UBYTE DFES_OneToOne 1 100 0.00 255.0 FORMAT "%5.1" ARRAY_SIZE 20 ECU_ADDRESS 0xD000BFE6 /end MEASUREMENT
/begin MEASUREMENT DFES_ctDel "" UBYTE DFES_OneToOne 1 100 0.00 255.0 FORMAT "%5.1" ARRAY_SIZE 20 ECU_ADDRESS 0xD000C036 /end MEASUREMENT
/begin MEASUREMENT DFES_ctFrq "" UBYTE DFES_OneToOne 1 100 0.00 255.0 FORMAT "%5.1" ARRAY_SIZE 20 ECU_ADDRESS 0xD000C04A /end MEASUREMENT
/begin MEASUREMENT DFES_ctManuDef "" UBYTE DFES_OneToOne 1 100 0.00 255.0 FORMAT "%5.1" ARRAY_SIZE 20 ECU_ADDRESS 0xD000C00E /end MEASUREMENT
/begin MEASUREMENT DFES_ctManuOk "" UBYTE DFES_OneToOne 1 100 0.00 255.0 FORMAT "%5.1" ARRAY_SIZE 20 ECU_ADDRESS 0xD000C022 /end MEASUREMENT
/begin MEASUREMENT DFES_ctOk "" UBYTE DFES_OneToOne 1 100 0.00 255.0 FORMAT "%5.1" ARRAY_SIZE 20 ECU_ADDRESS 0xD000BFFA /end MEASUREMENT
/begin MEASUREMENT DFES_EnvBlock "" UBYTE DFES_OneToOne 1 100 0.00 255.0 FORMAT "%5.1" ARRAY_SIZE 1023 ECU_ADDRESS 0xD000C1B2 /end MEASUREMENT
/begin MEASUREMENT DFES_FrzFrVal "" UBYTE DFES_OneToOne 1 100 0.00 255.0 FORMAT "%5.1" ARRAY_SIZE 320 ECU_ADDRESS 0xD000C072 /end MEASUREMENT
/begin MEASUREMENT DFES_idxHash "" UBYTE DFES_OneToOne 1 100 0.00 255.0 FORMAT "%5.1" ARRAY_SIZE 20 ECU_ADDRESS 0xD00082CA /end MEASUREMENT
/begin MEASUREMENT DFES_idxLink "" UBYTE DFES_OneToOne 1 100 0.00 255.0 FORMAT "%5.1" ARRAY_SIZE 20 ECU_ADDRESS 0xD00082A2 /end MEASUREMENT
/begin MEASUREMENT DFES_idxPrioQueue "" UBYTE DFES_OneToOne 1 100 0.00 255.0 FORMAT "%5.1" ARRAY_SIZE 20 ECU_ADDRESS 0xD00082B6 /end MEASUREMENT
/begin MEASUREMENT DFES_idxSequence "" UBYTE DFES_OneToOne 1 100 0.00 255.0 FORMAT "%5.1" ARRAY_SIZE 20 ECU_ADDRESS 0xD000D470 /end MEASUREMENT
/begin MEASUREMENT DFES_idxVisible "" UBYTE DFES_OneToOne 1 100 0.00 255.0 FORMAT "%5.1" ARRAY_SIZE 20 ECU_ADDRESS 0xD0008266 /end MEASUREMENT
/begin MEASUREMENT DFES_numDFC "" UWORD DFCDSQ_Verb 1 100 0.00 656. FORMAT "%2.0" ARRAY_SIZE 20 ECU_ADDRESS 0xD000BF6E /end MEASUREMENT
/begin MEASUREMENT DFES_Order "" UWORD DFES_OneToOne 1 100 0.00 65535.00 FORMAT "%8.2" ARRAY_SIZE 20 ECU_ADDRESS 0xD0005F0C /end MEASUREMENT
/begin MEASUREMENT DFES_OutLamps "" UBYTE DFES_OneToOne 1 100 0.00 255.0 FORMAT "%5.1" ARRAY_SIZE 20 ECU_ADDRESS 0xD000827A /end MEASUREMENT
/begin MEASUREMENT DFES_OutTester "" UBYTE DFES_OneToOne 1 100 0.00 255.0 FORMAT "%5.1" ARRAY_SIZE 20 ECU_ADDRESS 0xD000828E /end MEASUREMENT
/begin MEASUREMENT DFES_stChk "" UBYTE DFES_stCheck_Verb 1 100 0.00 23.0000000000 FORMAT "%13.10" ARRAY_SIZE 20 ECU_ADDRESS 0xD000BFAA /end MEASUREMENT
/begin MEASUREMENT DFES_stChkFault "" UBYTE DFES_OneToOne 1 100 0.00 255.0 FORMAT "%5.1" ARRAY_SIZE 20 ECU_ADDRESS 0xD000BFBE /end MEASUREMENT
/begin MEASUREMENT DFES_stCounters "" UBYTE DFES_stCnt_Verb 1 100 0.00 85.0000000000 FORMAT "%13.10" ARRAY_SIZE 20 ECU_ADDRESS 0xD000BFD2 /end MEASUREMENT
/begin MEASUREMENT DFES_stEntry "" UBYTE DFES_stEntry_Verb 1 100 0.00 142.000000000 FORMAT "%13.9" ARRAY_SIZE 20 ECU_ADDRESS 0xD000BF96 /end MEASUREMENT
/begin FUNCTION dfes_auto ""
 /begin DEF_CHARACTERISTIC DFES_Env.xSet1_CA DFES_Env.xSet2_CA DFES_Env.xSet3_CA DFES_Env.xSet4_CA DFES_Env.xSet5_CA DFES_Env.xSet6_CA DFES_Env.xSet7_CA DFES_Env.xSet8_CA DFES_Env.xSet9_CA DFES_Env.xSet10_CA DFES_Env.xSet11_CA DFES_Env.xSet12_CA DFES_Env.xSet13_CA DFES_Env.xSet14_CA DFES_Env.xSet15_CA DFES_Env.xSet16_CA DFES_Env.xSet17_CA DFES_Env.xSet18_CA DFES_Env.xSet19_CA DFES_Env.xSet20_CA DFES_Env.xSet21_CA DFES_Env.xSet22_CA DFES_Env.xSet23_CA DFES_Env.xSet24_CA DFES_Env.xSet25_CA DFES_Env.xSet26_CA DFES_Env.xSet27_CA DFES_Env.xSet28_CA DFES_Env.xSet29_CA DFES_Env.xSet30_CA DFES_Env.xSet31_CA DFES_Env.xSet32_CA DFES_Env.xSet33_CA DFES_Env.xSet34_CA DFES_Env.xSet35_CA DFES_Env.xSet36_CA DFES_Env.xSet37_CA DFES_Env.xSet38_CA DFES_Env.xSet39_CA DFES_Env.xSet40_CA DFES_Env.xSet41_CA DFES_Env.xSet42_CA DFES_Env.xSet43_CA DFES_Env.xSet44_CA DFES_Env.xSet45_CA DFES_Env.xSet46_CA DFES_Env.xSet47_CA DFES_Env.xSet48_CA DFES_Env.xSet49_CA DFES_Env.xSet50_CA DFES_Env.xSet51_CA DFES_Env.xSet52_CA DFES_Env.xSet53_CA DFES_Env.xSet54_CA DFES_Env.xSet55_CA DFES_Env.xSet56_CA DFES_Env.xSet57_CA DFES_Env.xSet58_CA DFES_Env.xSet59_CA DFES_Env.xSet60_CA DFES_Env.xSet61_CA DFES_Env.xSet62_CA DFES_Env.xSet63_CA DFES_Env.xSet64_CA DFES_Env.xSet65_CA DFES_Env.xSet66_CA DFES_Env.xSet67_CA DFES_Env.xSet68_CA DFES_Env.xSet69_CA DFES_Env.xSet70_CA DFES_Env.xSet71_CA DFES_Env.xSet72_CA DFES_Env.xSet73_CA DFES_Env.xSet74_CA DFES_Env.xSet75_CA DFES_Env.xSet76_CA DFES_Env.xSet77_CA DFES_Env.xSet78_CA DFES_Env.xSet79_CA DFES_Env.xSet80_CA DFES_Env.xSet81_CA DFES_Env.xSet82_CA DFES_Env.xSet83_CA DFES_Env.xSet84_CA DFES_Env.xSet85_CA DFES_Env.xSet86_CA DFES_Env.xSet87_CA DFES_Env.xSet88_CA DFES_Env.xSet89_CA DFES_Env.xSet90_CA DFES_Env.xSet91_CA DFES_Env.xSet92_CA DFES_Env.xSet93_CA DFES_Env.xSet94_CA DFES_Env.xSet95_CA DFES_Env.xSet96_CA DFES_Env.xSet97_CA DFES_Env.xSet98_CA DFES_Env.xSet99_CA DFES_Env.xSet100_CA DFES_Env.xSet101_CA DFES_Env.xSet102_CA DFES_Env.xSet103_CA DFES_Env.xSet104_CA DFES_Env.xSet105_CA DFES_Env.xSet106_CA DFES_Env.xSet107_CA DFES_Env.xSet108_CA DFES_Env.xSet109_CA DFES_Env.xSet110_CA DFES_GrpRpr.DFC_AirCtlGovDvtEOMMax_C DFES_GrpRpr.DFC_AirCtlGovDvtEOMMin_C DFES_GrpRpr.DFC_AirCtlGovDvtMax_C DFES_GrpRpr.DFC_AirCtlGovDvtMin_C DFES_GrpRpr.DFC_Cj945SpiCom1_C DFES_GrpRpr.DFC_ComButtonMSASig_C DFES_GrpRpr.DFC_ComButtonMSATo_C DFES_GrpRpr.DFC_ComGearboxData2Sig_C DFES_GrpRpr.DFC_ComGearboxData2To_C DFES_GrpRpr.DFC_ComGearboxDataSig_C DFES_GrpRpr.DFC_ComGearboxDataTo_C DFES_GrpRpr.DFC_ComHeatACSig_C DFES_GrpRpr.DFC_ComHeatACTo_C DFES_GrpRpr.DFC_ComLenkradwinkelSig_C DFES_GrpRpr.DFC_ComLenkradwinkelTo_C DFES_GrpRpr.DFC_ComMileageRangeSig_C DFES_GrpRpr.DFC_ComMileageRangeTo_C DFES_GrpRpr.DFC_ComPspSig_C DFES_GrpRpr.DFC_ComPspTo_C DFES_GrpRpr.DFC_ComShutOffPSPSig_C DFES_GrpRpr.DFC_ComShutOffPSPTo_C DFES_GrpRpr.DFC_ComStKombiCtr_C DFES_GrpRpr.DFC_ComStKombiSig_C DFES_GrpRpr.DFC_ComStKombiTo_C DFES_GrpRpr.DFC_ComStateARSCtr_C DFES_GrpRpr.DFC_ComStateARSSig_C DFES_GrpRpr.DFC_ComStateARSTo_C DFES_GrpRpr.DFC_ComStateDscSig_C DFES_GrpRpr.DFC_ComStateDscTo_C DFES_GrpRpr.DFC_ComStateSeatSig_C DFES_GrpRpr.DFC_ComStateSeatTo_C DFES_GrpRpr.DFC_ComTempRelTimeSig_C DFES_GrpRpr.DFC_ComTempRelTimeTo_C DFES_GrpRpr.DFC_ComTerminalChk_C DFES_GrpRpr.DFC_ComTerminalCtr_C DFES_GrpRpr.DFC_ComTerminalSig_C DFES_GrpRpr.DFC_ComTerminalTo_C DFES_GrpRpr.DFC_ComTimeDateSig_C DFES_GrpRpr.DFC_ComTimeDateTo_C DFES_GrpRpr.DFC_ComTrailerSig_C DFES_GrpRpr.DFC_ComTrailerTo_C DFES_GrpRpr.DFC_ComTrqDemandAfsChk_C DFES_GrpRpr.DFC_ComTrqDemandAfsCtr_C DFES_GrpRpr.DFC_ComTrqDemandAfsSig_C DFES_GrpRpr.DFC_ComTrqDemandAfsTo_C DFES_GrpRpr.DFC_ComTrqDemandDscChk_C DFES_GrpRpr.DFC_ComTrqDemandDscCtr_C DFES_GrpRpr.DFC_ComTrqDemandDscSig_C DFES_GrpRpr.DFC_ComTrqDemandDscTo_C DFES_GrpRpr.DFC_ComTrqDemandGbxChk_C DFES_GrpRpr.DFC_ComTrqDemandGbxCtr_C DFES_GrpRpr.DFC_ComTrqDemandGbxSig_C DFES_GrpRpr.DFC_ComTrqDemandGbxTo_C DFES_GrpRpr.DFC_ComVelocitySig_C DFES_GrpRpr.DFC_ComVelocityTo_C DFES_GrpRpr.DFC_ComWheelSpeedSig_C DFES_GrpRpr.DFC_ComWheelSpeedTo_C DFES_GrpRpr.DFC_ComZvKlappenSig_C DFES_GrpRpr.DFC_ComZvKlappenTo_C DFES_GrpRpr.DFC_Cy150SpiCom_C DFES_GrpRpr.DFC_Cy320SpiCom_C DFES_GrpRpr.DFC_ETCtlDvtInrMax_C DFES_GrpRpr.DFC_ETCtlDvtInrMin_C DFES_GrpRpr.DFC_ETCtlDvtOutrMax_C DFES_GrpRpr.DFC_ETCtlDvtOutrMin_C DFES_GrpRpr.DFC_Fan4WinErr1_C DFES_GrpRpr.DFC_Fan4WinErr2_C DFES_GrpRpr.DFC_Fan4WinErr3_C DFES_GrpRpr.DFC_Fan4WinErr4_C DFES_GrpRpr.DFC_FanSCG_C DFES_GrpRpr.DFC_PCRGovDvtLPMax_C DFES_GrpRpr.DFC_PCRGovDvtLPMin_C DFES_GrpRpr.DFC_PCRGovDvtMax_C DFES_GrpRpr.DFC_PCRGovDvtMin_C DFES_GrpRpr.DFC_RailCPC1_C DFES_GrpRpr.DFC_RailCPC3_C DFES_GrpRpr.DFC_RailCPC4_C DFES_GrpRpr.DFC_RailMeUn0_C DFES_GrpRpr.DFC_RailMeUn1_C DFES_GrpRpr.DFC_RailMeUn2_C DFES_GrpRpr.DFC_RailMeUn3_C DFES_GrpRpr.DFC_RailMeUn4_C DFES_GrpRpr.DFC_RailPCV0_C DFES_GrpRpr.DFC_RailPCV1_C DFES_GrpRpr.DFC_RailPCV2_C DFES_GrpRpr.DFC_RailPCV3_C DFES_GrpRpr.DFC_RailPCV4_C DFES_GrpRpr.DFC_RailPMonStrt_C DFES_GrpRpr.DFC_SSpMon1_C DFES_GrpRpr.DFC_SSpMon2_C DFES_GrpRpr.DFC_SSpMon3_C DFES_GrpRpr.DFC_Sia_E1_C DFES_GrpRpr.DFC_Sia_E10_C DFES_GrpRpr.DFC_Sia_E11_C DFES_GrpRpr.DFC_Sia_E12_C DFES_GrpRpr.DFC_Sia_E13_C DFES_GrpRpr.DFC_Sia_E14_C DFES_GrpRpr.DFC_Sia_E15_C DFES_GrpRpr.DFC_Sia_E2_C DFES_GrpRpr.DFC_Sia_E3_C DFES_GrpRpr.DFC_Sia_E4_C DFES_GrpRpr.DFC_Sia_E5_C DFES_GrpRpr.DFC_Sia_E6_C DFES_GrpRpr.DFC_Sia_E7_C DFES_GrpRpr.DFC_Sia_E8_C DFES_GrpRpr.DFC_Sia_E9_C DFES_GrpRpr.DFC_ThrVlv4WinErr1_C DFES_GrpRpr.DFC_ThrVlv4WinErr2_C DFES_GrpRpr.DFC_ThrVlv4WinErr3_C DFES_GrpRpr.DFC_ThrVlv4WinErr4_C DFES_GrpRpr.DFC_ThrVlvSCG_C DFES_GrpRpr.DFC_TrbCh4WinErr1_C DFES_GrpRpr.DFC_TrbCh4WinErr2_C DFES_GrpRpr.DFC_TrbCh4WinErr3_C DFES_GrpRpr.DFC_TrbCh4WinErr4_C DFES_GrpRpr.DFC_TrbChSCG_C DFES_GrpRpr.DFC_TrbChSRCMax_C DFES_GrpRpr.DFC_TrbChSRCMin_C DFES_GrpRpr.DFC_WaHtEl4WinErr1_C DFES_GrpRpr.DFC_WaHtEl4WinErr2_C DFES_GrpRpr.DFC_WaHtEl4WinErr3_C DFES_GrpRpr.DFC_WaHtEl4WinErr4_C DFES_GrpRpr.DFC_WaHtElSCG_C DFES_GrpRpr.DFC_ETClbETFltMax_C DFES_GrpRpr.DFC_ETClbETFltMin_C DFES_GrpRpr.DFC_InjCrvInjLimChrgBal_C DFES_GrpRpr.DFC_InjCrvInjLimQntBal_C DFES_GrpRpr.DFC_InjCrvInjLimSys_C DFES_GrpRpr.DFC_InjCrvNumInjRtmLim_C DFES_GrpRpr.DFC_LSUHtCoupSig_0_C DFES_GrpRpr.DFC_LSUHtCoupSig_1_C DFES_GrpRpr.DFC_LSUHtCoupSig_2_C DFES_GrpRpr.DFC_LSUHtCoupSig_3_C DFES_GrpRpr.DFC_CtT_C DFES_GrpRpr.DFC_DSMDummy_C DFES_GrpRpr.DFC_MeUnOL_C DFES_GrpRpr.DFC_MeUnSCB_C DFES_GrpRpr.DFC_MeUnSRCMax_C DFES_GrpRpr.DFC_MeUnSRCMin_C DFES_GrpRpr.DFC_PCVOL_C DFES_GrpRpr.DFC_PCVSCB_C DFES_GrpRpr.DFC_PCVSRCMax_C DFES_GrpRpr.DFC_PCVSRCMin_C DFES_GrpRpr.DFC_RailPSRCMax_C DFES_GrpRpr.DFC_RailPSRCMin_C DFES_GrpRpr.DFC_IVActrVltgSRCMax_C DFES_GrpRpr.DFC_IVActrVltgSRCMin_C DFES_GrpRpr.DFC_IVPSplyDCDC_C DFES_GrpRpr.DFC_IVPSplyVltgSRCMax_C DFES_GrpRpr.DFC_IVPSplyVltgSRCMin_C DFES_GrpRpr.DFC_AFSOffsDrftMax_C DFES_GrpRpr.DFC_AFSOffsDrftMin_C DFES_GrpRpr.DFC_AFSSRCCorMax_C DFES_GrpRpr.DFC_AFSSRCCorMin_C DFES_GrpRpr.DFC_AFSSRCRawMax_C DFES_GrpRpr.DFC_AFSSRCRawMin_C DFES_GrpRpr.DFC_AFSSetyDrftMax_C DFES_GrpRpr.DFC_AFSSetyDrftMin_C DFES_GrpRpr.DFC_AirCClntPAnaSRCMax_C DFES_GrpRpr.DFC_AirCClntPAnaSRCMin_C DFES_GrpRpr.DFC_AirCClntPPerSRCMax_C DFES_GrpRpr.DFC_AirCClntPPerSRCMin_C DFES_GrpRpr.DFC_AirCClntPdcycSRCMax_C DFES_GrpRpr.DFC_AirCClntPdcycSRCMin_C DFES_GrpRpr.DFC_AirCCmprOL_C DFES_GrpRpr.DFC_AirCCmprRedTrqOL_C DFES_GrpRpr.DFC_AirCCmprRedTrqSCB_C DFES_GrpRpr.DFC_AirCCmprRedTrqSCG_C DFES_GrpRpr.DFC_AirCCmprSCB_C DFES_GrpRpr.DFC_AirCCmprSCG_C DFES_GrpRpr.DFC_AirCSwtNpl_C DFES_GrpRpr.DFC_AirCSwtSig_C DFES_GrpRpr.DFC_BattUSRCMax_C DFES_GrpRpr.DFC_BattUSRCMin_C DFES_GrpRpr.DFC_BrkNpl_C DFES_GrpRpr.DFC_BrkPSRCMax_C DFES_GrpRpr.DFC_BrkPSRCMin_C DFES_GrpRpr.DFC_BrkSig_C DFES_GrpRpr.DFC_CByVlvOL_C DFES_GrpRpr.DFC_CByVlvSCB_C DFES_GrpRpr.DFC_CByVlvSCG_C DFES_GrpRpr.DFC_CEngDsTSRCMax_C DFES_GrpRpr.DFC_CEngDsTSRCMin_C DFES_GrpRpr.DFC_CEngDsTSig_C DFES_GrpRpr.DFC_CEngUsTSRCMax_C DFES_GrpRpr.DFC_CEngUsTSRCMin_C DFES_GrpRpr.DFC_CThmstOL_C DFES_GrpRpr.DFC_CThmstSCB_C DFES_GrpRpr.DFC_CThmstSCG_C DFES_GrpRpr.DFC_ClthSig_C DFES_GrpRpr.DFC_ECBVlvOL_C DFES_GrpRpr.DFC_ECBVlvSCB_C DFES_GrpRpr.DFC_ECBVlvSCG_C DFES_GrpRpr.DFC_ECBVlvSRCMax_C DFES_GrpRpr.DFC_ECBVlvSRCMin_C DFES_GrpRpr.DFC_EGRVlvGovDvtMax_C DFES_GrpRpr.DFC_EGRVlvGovDvtMin_C DFES_GrpRpr.DFC_EGRVlvOL_C DFES_GrpRpr.DFC_EGRVlvSCB_C DFES_GrpRpr.DFC_EGRVlvSCG_C DFES_GrpRpr.DFC_EGRVlvSRCMax_C DFES_GrpRpr.DFC_EGRVlvSRCMin_C DFES_GrpRpr.DFC_EMDmpOL_0_C DFES_GrpRpr.DFC_EMDmpOL_1_C DFES_GrpRpr.DFC_EMDmpSCB_0_C DFES_GrpRpr.DFC_EMDmpSCB_1_C DFES_GrpRpr.DFC_EMDmpSCG_0_C DFES_GrpRpr.DFC_EMDmpSCG_1_C DFES_GrpRpr.DFC_EngStAOL_C DFES_GrpRpr.DFC_EngStASCB_C DFES_GrpRpr.DFC_EngStASCG_C DFES_GrpRpr.DFC_EnvPSRCMax_C DFES_GrpRpr.DFC_EnvPSRCMin_C DFES_GrpRpr.DFC_EnvPSig_C DFES_GrpRpr.DFC_EnvTSRCMax_C DFES_GrpRpr.DFC_EnvTSRCMin_C DFES_GrpRpr.DFC_FanOL_C DFES_GrpRpr.DFC_FanSCB_C DFES_GrpRpr.DFC_FlFltSig_C DFES_GrpRpr.DFC_FuelTSRCMax_C DFES_GrpRpr.DFC_FuelTSRCMin_C DFES_GrpRpr.DFC_GbxNPosPPerSRCMax_C DFES_GrpRpr.DFC_GbxNPosPPerSRCMin_C DFES_GrpRpr.DFC_GbxNPosPdcycSRCMax_C DFES_GrpRpr.DFC_GbxNPosPdcycSRCMin_C DFES_GrpRpr.DFC_GbxNPosSig_C DFES_GrpRpr.DFC_GlwPlgBSDOL_0_C DFES_GrpRpr.DFC_GlwPlgBSDOL_1_C DFES_GrpRpr.DFC_GlwPlgBSDOL_2_C DFES_GrpRpr.DFC_GlwPlgBSDOL_3_C DFES_GrpRpr.DFC_GlwPlgBSDOL_4_C DFES_GrpRpr.DFC_GlwPlgBSDOL_5_C DFES_GrpRpr.DFC_GlwPlgBSDOL_6_C DFES_GrpRpr.DFC_GlwPlgBSDOL_7_C DFES_GrpRpr.DFC_GlwPlgBSDOT_0_C DFES_GrpRpr.DFC_GlwPlgBSDOT_1_C DFES_GrpRpr.DFC_GlwPlgBSDOT_2_C DFES_GrpRpr.DFC_GlwPlgBSDOT_3_C DFES_GrpRpr.DFC_GlwPlgBSDOT_4_C DFES_GrpRpr.DFC_GlwPlgBSDOT_5_C DFES_GrpRpr.DFC_GlwPlgBSDOT_6_C DFES_GrpRpr.DFC_GlwPlgBSDOT_7_C DFES_GrpRpr.DFC_GlwPlgBSDSC_0_C DFES_GrpRpr.DFC_GlwPlgBSDSC_1_C DFES_GrpRpr.DFC_GlwPlgBSDSC_2_C DFES_GrpRpr.DFC_GlwPlgBSDSC_3_C DFES_GrpRpr.DFC_GlwPlgBSDSC_4_C DFES_GrpRpr.DFC_GlwPlgBSDSC_5_C DFES_GrpRpr.DFC_GlwPlgBSDSC_6_C DFES_GrpRpr.DFC_GlwPlgBSDSC_7_C DFES_GrpRpr.DFC_GlwPlgComErr_C DFES_GrpRpr.DFC_InjVlvPresMin_C DFES_GrpRpr.DFC_LSUCircNernstMax_0_C DFES_GrpRpr.DFC_LSUCircNernstMax_1_C DFES_GrpRpr.DFC_LSUCircNernstMax_2_C DFES_GrpRpr.DFC_LSUCircNernstMax_3_C DFES_GrpRpr.DFC_LSUCircNernstMin_0_C DFES_GrpRpr.DFC_LSUCircNernstMin_1_C DFES_GrpRpr.DFC_LSUCircNernstMin_2_C DFES_GrpRpr.DFC_LSUCircNernstMin_3_C DFES_GrpRpr.DFC_LSUCircNernstSig_0_C DFES_GrpRpr.DFC_LSUCircNernstSig_1_C DFES_GrpRpr.DFC_LSUCircNernstSig_2_C DFES_GrpRpr.DFC_LSUCircNernstSig_3_C DFES_GrpRpr.DFC_LSUCircPmpCurMax_0_C DFES_GrpRpr.DFC_LSUCircPmpCurMax_1_C DFES_GrpRpr.DFC_LSUCircPmpCurMax_2_C DFES_GrpRpr.DFC_LSUCircPmpCurMax_3_C DFES_GrpRpr.DFC_LSUCircPmpCurMin_0_C DFES_GrpRpr.DFC_LSUCircPmpCurMin_1_C DFES_GrpRpr.DFC_LSUCircPmpCurMin_2_C DFES_GrpRpr.DFC_LSUCircPmpCurMin_3_C DFES_GrpRpr.DFC_LSUCircPmpCurSig_0_C DFES_GrpRpr.DFC_LSUCircPmpCurSig_1_C DFES_GrpRpr.DFC_LSUCircPmpCurSig_2_C DFES_GrpRpr.DFC_LSUCircPmpCurSig_3_C DFES_GrpRpr.DFC_LSUCircVirtGndMax_0_C DFES_GrpRpr.DFC_LSUCircVirtGndMax_1_C DFES_GrpRpr.DFC_LSUCircVirtGndMax_2_C DFES_GrpRpr.DFC_LSUCircVirtGndMax_3_C DFES_GrpRpr.DFC_LSUCircVirtGndMin_0_C DFES_GrpRpr.DFC_LSUCircVirtGndMin_1_C DFES_GrpRpr.DFC_LSUCircVirtGndMin_2_C DFES_GrpRpr.DFC_LSUCircVirtGndMin_3_C DFES_GrpRpr.DFC_LSUCircVirtGndSig_0_C DFES_GrpRpr.DFC_LSUCircVirtGndSig_1_C DFES_GrpRpr.DFC_LSUCircVirtGndSig_2_C DFES_GrpRpr.DFC_LSUCircVirtGndSig_3_C DFES_GrpRpr.DFC_LSUHtrMax_0_C DFES_GrpRpr.DFC_LSUHtrMax_1_C DFES_GrpRpr.DFC_LSUHtrMax_2_C DFES_GrpRpr.DFC_LSUHtrMax_3_C DFES_GrpRpr.DFC_LSUHtrMin_0_C DFES_GrpRpr.DFC_LSUHtrMin_1_C DFES_GrpRpr.DFC_LSUHtrMin_2_C DFES_GrpRpr.DFC_LSUHtrMin_3_C DFES_GrpRpr.DFC_LSUHtrSig_0_C DFES_GrpRpr.DFC_LSUHtrSig_1_C DFES_GrpRpr.DFC_LSUHtrSig_2_C DFES_GrpRpr.DFC_LSUHtrSig_3_C DFES_GrpRpr.DFC_LSUO2Max_0_C DFES_GrpRpr.DFC_LSUO2Max_1_C DFES_GrpRpr.DFC_LSUO2Max_2_C DFES_GrpRpr.DFC_LSUO2Max_3_C DFES_GrpRpr.DFC_LSUO2Min_0_C DFES_GrpRpr.DFC_LSUO2Min_1_C DFES_GrpRpr.DFC_LSUO2Min_2_C DFES_GrpRpr.DFC_LSUO2Min_3_C DFES_GrpRpr.DFC_LSUSPIBattLowMin_0_C DFES_GrpRpr.DFC_LSUSPIBattLowMin_1_C DFES_GrpRpr.DFC_LSUSPIBattLowMin_2_C DFES_GrpRpr.DFC_LSUSPIBattLowMin_3_C DFES_GrpRpr.DFC_LSUSPISig_0_C DFES_GrpRpr.DFC_LSUSPISig_1_C DFES_GrpRpr.DFC_LSUSPISig_2_C DFES_GrpRpr.DFC_LSUSPISig_3_C DFES_GrpRpr.DFC_LSUtExcMax_0_C DFES_GrpRpr.DFC_LSUtExcMax_1_C DFES_GrpRpr.DFC_LSUtExcMax_2_C DFES_GrpRpr.DFC_LSUtExcMax_3_C DFES_GrpRpr.DFC_LSUtExcMin_0_C DFES_GrpRpr.DFC_LSUtExcMin_1_C DFES_GrpRpr.DFC_LSUtExcMin_2_C DFES_GrpRpr.DFC_LSUtExcMin_3_C DFES_GrpRpr.DFC_MILOL_C DFES_GrpRpr.DFC_MILSCB_C DFES_GrpRpr.DFC_MILSCG_C DFES_GrpRpr.DFC_MeUnSCG_C DFES_GrpRpr.DFC_NplHsChngPPFltDiff_C DFES_GrpRpr.DFC_NplPAirFltDs_C DFES_GrpRpr.DFC_NplTPFltUs_C DFES_GrpRpr.DFC_OilComErr_C DFES_GrpRpr.DFC_OilPLmpOL_C DFES_GrpRpr.DFC_OilPLmpSCB_C DFES_GrpRpr.DFC_OilPLmpSCG_C DFES_GrpRpr.DFC_OilPNpl_C DFES_GrpRpr.DFC_OilTNpl_C DFES_GrpRpr.DFC_OilTSRCMax_C DFES_GrpRpr.DFC_OilTSRCMin_C DFES_GrpRpr.DFC_PCACDsEnvPPls_C DFES_GrpRpr.DFC_PCACDsSRCMax_C DFES_GrpRpr.DFC_PCACDsSRCMin_C DFES_GrpRpr.DFC_PCVSCG_C DFES_GrpRpr.DFC_PFltCharPDiffMin_C DFES_GrpRpr.DFC_PFltDstrMin_C DFES_GrpRpr.DFC_PFltEngPrt_C DFES_GrpRpr.DFC_PFltLmpOL_C DFES_GrpRpr.DFC_PFltLmpSCB_C DFES_GrpRpr.DFC_PFltLmpSCG_C DFES_GrpRpr.DFC_PFltRgnPerm_C DFES_GrpRpr.DFC_PFltSRCMaxFlwRstn_C DFES_GrpRpr.DFC_PFltSRCMinFlwRstn_C DFES_GrpRpr.DFC_PFltSotMsDvtMax_C DFES_GrpRpr.DFC_PFltSotMsDvtMin_C DFES_GrpRpr.DFC_PFltSotMsMax_C DFES_GrpRpr.DFC_PSPOL_C DFES_GrpRpr.DFC_PSPSCB_C DFES_GrpRpr.DFC_PSPSCG_C DFES_GrpRpr.DFC_SRCHighAPP1_C DFES_GrpRpr.DFC_SRCHighAPP2_C DFES_GrpRpr.DFC_SRCLowAPP1_C DFES_GrpRpr.DFC_SRCLowAPP2_C DFES_GrpRpr.DFC_SRCMaxPAirFltDs_C DFES_GrpRpr.DFC_SRCMaxPPFltUs_C DFES_GrpRpr.DFC_SRCMaxTECU_C DFES_GrpRpr.DFC_SRCMaxTOxiCatUs_C DFES_GrpRpr.DFC_SRCMaxTPFltUs_C DFES_GrpRpr.DFC_SRCMinPAirFltDs_C DFES_GrpRpr.DFC_SRCMinPPFltUs_C DFES_GrpRpr.DFC_SRCMinTECU_C DFES_GrpRpr.DFC_SRCMinTOxiCatUs_C DFES_GrpRpr.DFC_SRCMinTPFltUs_C DFES_GrpRpr.DFC_SVSOL_C DFES_GrpRpr.DFC_SVSSCB_C DFES_GrpRpr.DFC_SVSSCG_C DFES_GrpRpr.DFC_StrtOL_C DFES_GrpRpr.DFC_StrtSCB_C DFES_GrpRpr.DFC_StrtSCG_C DFES_GrpRpr.DFC_SyncAPP_C DFES_GrpRpr.DFC_T15Npl_C DFES_GrpRpr.DFC_TAFSDtyCycHi_C DFES_GrpRpr.DFC_TAFSDtyCycLo_C DFES_GrpRpr.DFC_TAFSPerHi_C DFES_GrpRpr.DFC_TAFSPerLo_C DFES_GrpRpr.DFC_TCACDsSRCMax_C DFES_GrpRpr.DFC_TCACDsSRCMin_C DFES_GrpRpr.DFC_ThrVlvOL_C DFES_GrpRpr.DFC_ThrVlvSCB_C DFES_GrpRpr.DFC_ThrVlvSRCMax_C DFES_GrpRpr.DFC_ThrVlvSRCMin_C DFES_GrpRpr.DFC_TrbChLPOL_C DFES_GrpRpr.DFC_TrbChLPSCB_C DFES_GrpRpr.DFC_TrbChLPSCG_C DFES_GrpRpr.DFC_TrbChOL_C DFES_GrpRpr.DFC_TrbChSCB_C DFES_GrpRpr.DFC_VSwVlvGovDvtMax_C DFES_GrpRpr.DFC_VSwVlvGovDvtMin_C DFES_GrpRpr.DFC_VSwVlvOL_C DFES_GrpRpr.DFC_VSwVlvSCB_C DFES_GrpRpr.DFC_VSwVlvSCG_C DFES_GrpRpr.DFC_VSwVlvSRCMax_C DFES_GrpRpr.DFC_VSwVlvSRCMin_C DFES_GrpRpr.DFC_VehVHW_C DFES_GrpRpr.DFC_VehVMax_C DFES_GrpRpr.DFC_VehVPlaus_C DFES_GrpRpr.DFC_VehVSig_C DFES_GrpRpr.DFC_WaHtElOL_C DFES_GrpRpr.DFC_WaHtElSCB_C DFES_GrpRpr.DFC_ClthNpl_C DFES_GrpRpr.DFC_ETClbETMax_0_C DFES_GrpRpr.DFC_ETClbETMax_1_C DFES_GrpRpr.DFC_ETClbETMax_2_C DFES_GrpRpr.DFC_ETClbETMax_3_C DFES_GrpRpr.DFC_ETClbETMax_4_C DFES_GrpRpr.DFC_ETClbETMax_5_C DFES_GrpRpr.DFC_ETClbETMin_0_C DFES_GrpRpr.DFC_ETClbETMin_1_C DFES_GrpRpr.DFC_ETClbETMin_2_C DFES_GrpRpr.DFC_ETClbETMin_3_C DFES_GrpRpr.DFC_ETClbETMin_4_C DFES_GrpRpr.DFC_ETClbETMin_5_C DFES_GrpRpr.DFC_IVDiaBnkShCirBSH_0_C DFES_GrpRpr.DFC_IVDiaBnkShCirBSH_1_C DFES_GrpRpr.DFC_IVDiaBnkShCirChSwt_0_C DFES_GrpRpr.DFC_IVDiaBnkShCirChSwt_1_C DFES_GrpRpr.DFC_IVDiaBnkShCirHSBatt_0_C DFES_GrpRpr.DFC_IVDiaBnkShCirHSBatt_1_C DFES_GrpRpr.DFC_IVDiaBnkShCirHiRstnc_0_C DFES_GrpRpr.DFC_IVDiaBnkShCirHiRstnc_1_C DFES_GrpRpr.DFC_IVDiaBnkShCirLSHSGnd_0_C DFES_GrpRpr.DFC_IVDiaBnkShCirLSHSGnd_1_C DFES_GrpRpr.DFC_IVDiaBnkShCirTransfer_0_C DFES_GrpRpr.DFC_IVDiaBnkShCirTransfer_1_C DFES_GrpRpr.DFC_IVDiaCylNoCls_0_C DFES_GrpRpr.DFC_IVDiaCylNoCls_1_C DFES_GrpRpr.DFC_IVDiaCylNoCls_2_C DFES_GrpRpr.DFC_IVDiaCylNoCls_3_C DFES_GrpRpr.DFC_IVDiaCylNoCls_4_C DFES_GrpRpr.DFC_IVDiaCylNoCls_5_C DFES_GrpRpr.DFC_IVDiaCylNoLd_0_C DFES_GrpRpr.DFC_IVDiaCylNoLd_1_C DFES_GrpRpr.DFC_IVDiaCylNoLd_2_C DFES_GrpRpr.DFC_IVDiaCylNoLd_3_C DFES_GrpRpr.DFC_IVDiaCylNoLd_4_C DFES_GrpRpr.DFC_IVDiaCylNoLd_5_C DFES_GrpRpr.DFC_IVDiaCylShCirHiRstnc_0_C DFES_GrpRpr.DFC_IVDiaCylShCirHiRstnc_1_C DFES_GrpRpr.DFC_IVDiaCylShCirHiRstnc_2_C DFES_GrpRpr.DFC_IVDiaCylShCirHiRstnc_3_C DFES_GrpRpr.DFC_IVDiaCylShCirHiRstnc_4_C DFES_GrpRpr.DFC_IVDiaCylShCirHiRstnc_5_C DFES_GrpRpr.DFC_IVDiaCylShCirLSBatt_0_C DFES_GrpRpr.DFC_IVDiaCylShCirLSBatt_1_C DFES_GrpRpr.DFC_IVDiaCylShCirLSBatt_2_C DFES_GrpRpr.DFC_IVDiaCylShCirLSBatt_3_C DFES_GrpRpr.DFC_IVDiaCylShCirLSBatt_4_C DFES_GrpRpr.DFC_IVDiaCylShCirLSBatt_5_C DFES_GrpRpr.DFC_IVDiaCylShCirLSHS_0_C DFES_GrpRpr.DFC_IVDiaCylShCirLSHS_1_C DFES_GrpRpr.DFC_IVDiaCylShCirLSHS_2_C DFES_GrpRpr.DFC_IVDiaCylShCirLSHS_3_C DFES_GrpRpr.DFC_IVDiaCylShCirLSHS_4_C DFES_GrpRpr.DFC_IVDiaCylShCirLSHS_5_C DFES_GrpRpr.DFC_IVDiaCylShCirLsLs_0_C DFES_GrpRpr.DFC_IVDiaCylShCirLsLs_1_C DFES_GrpRpr.DFC_IVDiaCylShCirLsLs_2_C DFES_GrpRpr.DFC_IVDiaCylShCirLsLs_3_C DFES_GrpRpr.DFC_IVDiaCylShCirLsLs_4_C DFES_GrpRpr.DFC_IVDiaCylShCirLsLs_5_C DFES_GrpRpr.DFC_IVDiaSPICfg_C DFES_GrpRpr.DFC_IVDiaSPIColl_C DFES_GrpRpr.DFC_IVDiaSPICtrl_C DFES_GrpRpr.DFC_IVDiaSPIRam_C DFES_GrpRpr.DFC_IVDiaSPITrans_C DFES_GrpRpr.DFC_LSUCmpChk_0_C DFES_GrpRpr.DFC_LSUCmpChk_1_C DFES_GrpRpr.DFC_LSUCmpChk_2_C DFES_GrpRpr.DFC_LSUCmpChk_3_C DFES_GrpRpr.DFC_LSUCmpChk_4_C DFES_GrpRpr.DFC_LSUCmpChk_5_C DFES_GrpRpr.DFC_LSUDynChk_0_C DFES_GrpRpr.DFC_LSUDynChk_1_C DFES_GrpRpr.DFC_LSUDynChk_2_C DFES_GrpRpr.DFC_LSUDynChk_3_C DFES_GrpRpr.DFC_LSUO2ClbMax_0_C DFES_GrpRpr.DFC_LSUO2ClbMax_1_C DFES_GrpRpr.DFC_LSUO2ClbMax_2_C DFES_GrpRpr.DFC_LSUO2ClbMax_3_C DFES_GrpRpr.DFC_LSUO2ClbMin_0_C DFES_GrpRpr.DFC_LSUO2ClbMin_1_C DFES_GrpRpr.DFC_LSUO2ClbMin_2_C DFES_GrpRpr.DFC_LSUO2ClbMin_3_C DFES_GrpRpr.DFC_LSUO2PlausMax_0_C DFES_GrpRpr.DFC_LSUO2PlausMax_1_C DFES_GrpRpr.DFC_LSUO2PlausMax_2_C DFES_GrpRpr.DFC_LSUO2PlausMax_3_C DFES_GrpRpr.DFC_LSUO2PlausMin_0_C DFES_GrpRpr.DFC_LSUO2PlausMin_1_C DFES_GrpRpr.DFC_LSUO2PlausMin_2_C DFES_GrpRpr.DFC_LSUO2PlausMin_3_C DFES_GrpRpr.DFC_LSURiClbMax_0_C DFES_GrpRpr.DFC_LSURiClbMax_1_C DFES_GrpRpr.DFC_LSURiClbMax_2_C DFES_GrpRpr.DFC_LSURiClbMax_3_C DFES_GrpRpr.DFC_LSURiClbMin_0_C DFES_GrpRpr.DFC_LSURiClbMin_1_C DFES_GrpRpr.DFC_LSURiClbMin_2_C DFES_GrpRpr.DFC_LSURiClbMin_3_C DFES_GrpRpr.DFC_LSUWireIPSig_0_C DFES_GrpRpr.DFC_LSUWireIPSig_1_C DFES_GrpRpr.DFC_LSUWireIPSig_2_C DFES_GrpRpr.DFC_LSUWireIPSig_3_C DFES_GrpRpr.DFC_AFSDrftIdlAdjVal_C DFES_GrpRpr.DFC_AFSDrftLdAdjVal_C DFES_GrpRpr.DFC_AdcI_ADC0_Cal_C DFES_GrpRpr.DFC_AdcI_ADC0_Conv_C DFES_GrpRpr.DFC_CmbChbMisfireMax_0_C DFES_GrpRpr.DFC_CmbChbMisfireMax_1_C DFES_GrpRpr.DFC_CmbChbMisfireMax_2_C DFES_GrpRpr.DFC_CmbChbMisfireMax_3_C DFES_GrpRpr.DFC_CmbChbMisfireMax_4_C DFES_GrpRpr.DFC_CmbChbMisfireMax_5_C DFES_GrpRpr.DFC_CmbChbMisfireMul_C DFES_GrpRpr.DFC_INJVLVBUSY_C DFES_GrpRpr.DFC_IVAdjIVA_0_C DFES_GrpRpr.DFC_IVAdjIVA_1_C DFES_GrpRpr.DFC_IVAdjIVA_2_C DFES_GrpRpr.DFC_IVAdjIVA_3_C DFES_GrpRpr.DFC_IVAdjIVA_4_C DFES_GrpRpr.DFC_IVAdjIVA_5_C DFES_GrpRpr.DFC_InjCtlAdjQntEEPCS_C DFES_GrpRpr.DFC_InjCtlDriftEEPCS_C DFES_GrpRpr.DFC_MRlyErlyOpng_C DFES_GrpRpr.DFC_MRlyStk_C DFES_GrpRpr.DFC_SensFrzPPFltUs_C DFES_GrpRpr.DFC_T15Sig_C DFES_GrpRpr.DFC_AirCtlRmpTOut_C DFES_GrpRpr.DFC_CEngDsTDynTst_C DFES_GrpRpr.DFC_EGRVlvJamVlvClsd_C DFES_GrpRpr.DFC_EGRVlvJamVlvOpn_C DFES_GrpRpr.DFC_EGRVlvLgTDrft_C DFES_GrpRpr.DFC_EGRVlvOfsLrnJamVlv_C DFES_GrpRpr.DFC_EGRVlvShTDrft_C DFES_GrpRpr.DFC_EGTRgnOilDilMax_C DFES_GrpRpr.DFC_EngICO_C DFES_GrpRpr.DFC_EpmCaSI1ErrSig_C DFES_GrpRpr.DFC_EpmCaSI1NoSig_C DFES_GrpRpr.DFC_EpmCaSI1OfsErr_C DFES_GrpRpr.DFC_EpmCrSErrSig_C DFES_GrpRpr.DFC_EpmCrSNoSig_C DFES_GrpRpr.DFC_MoCADCCmp_C DFES_GrpRpr.DFC_MoCADCTst_C DFES_GrpRpr.DFC_MoCADCVltgRatio_C DFES_GrpRpr.DFC_MoCSOPLoLi_C DFES_GrpRpr.DFC_MoCSOPMM_C DFES_GrpRpr.DFC_MoCSOPTimeOut_C DFES_GrpRpr.DFC_MoCSOPUpLi_C DFES_GrpRpr.DFC_MoFAPP_C DFES_GrpRpr.DFC_MoFESpd_C DFES_GrpRpr.DFC_MoFInjDatPhi_C DFES_GrpRpr.DFC_MoFInjDatQnt_C DFES_GrpRpr.DFC_MoFInjQnt_C DFES_GrpRpr.DFC_MoFOvR_C DFES_GrpRpr.DFC_MoFQntCor_C DFES_GrpRpr.DFC_MoFTrqCmp_C DFES_GrpRpr.DFC_NplTOxiCatUs_C DFES_GrpRpr.DFC_PhyModNonMonMapNpl_C DFES_GrpRpr.DFC_RailPOfsTstMax_C DFES_GrpRpr.DFC_RailPOfsTstMin_C DFES_GrpRpr.DFC_SWReset_0_C DFES_GrpRpr.DFC_SWReset_1_C DFES_GrpRpr.DFC_SWReset_2_C DFES_GrpRpr.DFC_VSwVlvJamVlv_C DFES_GrpRpr.DFC_VSwVlvLgTDrft_C DFES_GrpRpr.DFC_VSwVlvOfsLrnJamVlv_C DFES_GrpRpr.DFC_VSwVlvShTDrft_C DFES_numClsDlt_CA DFES_numClsFaultCycl_CA DFES_numClsHealCycl_CA DFES_numClsPndDlt_CA DFES_numClsSvcDlt_CA DFES_numClsSVSFaultCycl_CA DFES_numClsSVSHealCycl_CA DFES_xAsgnExtdFrzFrSig_CA DFES_xAsgnFrzFrSig_CA DFES_xClsDltTrg_CA DFES_xClsFaultTrg_CA DFES_xClsFltMIL_CA DFES_xClsFltSVS_CA DFES_xClsHealTrg_CA DFES_xClsPndDltTrg_CA DFES_xClsPrio_CA DFES_xClsSvcDltTrg_CA DFES_xClsSVSFaultTrg_CA DFES_xClsSVSHealTrg_CA /end DEF_CHARACTERISTIC
 /begin OUT_MEASUREMENT DFES_ctDef DFES_ctDel DFES_ctFrq DFES_ctManuDef DFES_ctManuOk DFES_ctOk DFES_EnvBlock DFES_FrzFrVal DFES_idxHash DFES_idxLink DFES_idxPrioQueue DFES_idxSequence DFES_idxVisible DFES_numDFC DFES_Order DFES_OutLamps DFES_OutTester DFES_stChk DFES_stChkFault DFES_stCounters DFES_stEntry /end OUT_MEASUREMENT
/end FUNCTION
/begin COMPU_METHOD DFCDSQ_Verb "" TAB_VERB "%2.1" "-" COMPU_TAB_REF DFCDSQ_Verb /end COMPU_METHOD
/begin COMPU_VTAB DFCDSQ_Verb "" TAB_VERB 657 0 "NoInhibit" 1 "DFC_AirCtlGovDvtEOMMax" 2 "DFC_AirCtlGovDvtEOMMin" 3 "DFC_AirCtlGovDvtMax" 4 "DFC_AirCtlGovDvtMin" 5 "DFC_Cj945SpiCom1" 6 "DFC_ComButtonMSASig" 7 "DFC_ComButtonMSATo" 8 "DFC_ComGearboxData2Sig" 9 "DFC_ComGearboxData2To" 10 "DFC_ComGearboxDataSig" 11 "DFC_ComGearboxDataTo" 12 "DFC_ComHeatACSig" 13 "DFC_ComHeatACTo" 14 "DFC_ComLenkradwinkelSig" 15 "DFC_ComLenkradwinkelTo" 16 "DFC_ComMileageRangeSig" 17 "DFC_ComMileageRangeTo" 18 "DFC_ComPspSig" 19 "DFC_ComPspTo" 20 "DFC_ComShutOffPSPSig" 21 "DFC_ComShutOffPSPTo" 22 "DFC_ComStKombiCtr" 23 "DFC_ComStKombiSig" 24 "DFC_ComStKombiTo" 25 "DFC_ComStateARSCtr" 26 "DFC_ComStateARSSig" 27 "DFC_ComStateARSTo" 28 "DFC_ComStateDscSig" 29 "DFC_ComStateDscTo" 30 "DFC_ComStateSeatSig" 31 "DFC_ComStateSeatTo" 32 "DFC_ComTempRelTimeSig" 33 "DFC_ComTempRelTimeTo" 34 "DFC_ComTerminalChk" 35 "DFC_ComTerminalCtr" 36 "DFC_ComTerminalSig" 37 "DFC_ComTerminalTo" 38 "DFC_ComTimeDateSig" 39 "DFC_ComTimeDateTo" 40 "DFC_ComTrailerSig" 41 "DFC_ComTrailerTo" 42 "DFC_ComTrqDemandAfsChk" 43 "DFC_ComTrqDemandAfsCtr" 44 "DFC_ComTrqDemandAfsSig" 45 "DFC_ComTrqDemandAfsTo" 46 "DFC_ComTrqDemandDscChk" 47 "DFC_ComTrqDemandDscCtr" 48 "DFC_ComTrqDemandDscSig" 49 "DFC_ComTrqDemandDscTo" 50 "DFC_ComTrqDemandGbxChk" 51 "DFC_ComTrqDemandGbxCtr" 52 "DFC_ComTrqDemandGbxSig" 53 "DFC_ComTrqDemandGbxTo" 54 "DFC_ComVelocitySig" 55 "DFC_ComVelocityTo" 56 "DFC_ComWheelSpeedSig" 57 "DFC_ComWheelSpeedTo" 58 "DFC_ComZvKlappenSig" 59 "DFC_ComZvKlappenTo" 60 "DFC_Cy150SpiCom" 61 "DFC_Cy320SpiCom" 62 "DFC_ETCtlDvtInrMax" 63 "DFC_ETCtlDvtInrMin" 64 "DFC_ETCtlDvtOutrMax" 65 "DFC_ETCtlDvtOutrMin" 66 "DFC_Fan4WinErr1" 67 "DFC_Fan4WinErr2" 68 "DFC_Fan4WinErr3" 69 "DFC_Fan4WinErr4" 70 "DFC_FanSCG" 71 "DFC_PCRGovDvtLPMax" 72 "DFC_PCRGovDvtLPMin" 73 "DFC_PCRGovDvtMax" 74 "DFC_PCRGovDvtMin" 75 "DFC_RailCPC1" 76 "DFC_RailCPC3" 77 "DFC_RailCPC4" 78 "DFC_RailMeUn0" 79 "DFC_RailMeUn1" 80 "DFC_RailMeUn2" 81 "DFC_RailMeUn3" 82 "DFC_RailMeUn4" 83 "DFC_RailPCV0" 84 "DFC_RailPCV1" 85 "DFC_RailPCV2" 86 "DFC_RailPCV3" 87 "DFC_RailPCV4" 88 "DFC_RailPMonStrt" 89 "DFC_SSpMon1" 90 "DFC_SSpMon2" 91 "DFC_SSpMon3" 92 "DFC_Sia_E1" 93 "DFC_Sia_E10" 94 "DFC_Sia_E11" 95 "DFC_Sia_E12" 96 "DFC_Sia_E13" 97 "DFC_Sia_E14" 98 "DFC_Sia_E15" 99 "DFC_Sia_E2" 100 "DFC_Sia_E3" 101 "DFC_Sia_E4" 102 "DFC_Sia_E5" 103 "DFC_Sia_E6" 104 "DFC_Sia_E7" 105 "DFC_Sia_E8" 106 "DFC_Sia_E9" 107 "DFC_ThrVlv4WinErr1" 108 "DFC_ThrVlv4WinErr2" 109 "DFC_ThrVlv4WinErr3" 110 "DFC_ThrVlv4WinErr4" 111 "DFC_ThrVlvSCG" 112 "DFC_TrbCh4WinErr1" 113 "DFC_TrbCh4WinErr2" 114 "DFC_TrbCh4WinErr3" 115 "DFC_TrbCh4WinErr4" 116 "DFC_TrbChSCG" 117 "DFC_TrbChSRCMax" 118 "DFC_TrbChSRCMin" 119 "DFC_WaHtEl4WinErr1" 120 "DFC_WaHtEl4WinErr2" 121 "DFC_WaHtEl4WinErr3" 122 "DFC_WaHtEl4WinErr4" 123 "DFC_WaHtElSCG" 124 "DFC_ETClbETFltMax" 125 "DFC_ETClbETFltMin" 126 "DFC_InjCrvInjLimChrgBal" 127 "DFC_InjCrvInjLimQntBal" 128 "DFC_InjCrvInjLimSys" 129 "DFC_InjCrvNumInjRtmLim" 130 "DFC_LSUHtCoupSig_0" 131 "DFC_LSUHtCoupSig_1" 132 "DFC_LSUHtCoupSig_2" 133 "DFC_LSUHtCoupSig_3" 134 "DFC_CtT" 135 "DFC_DSMDummy" 136 "DFC_MeUnOL" 137 "DFC_MeUnSCB" 138 "DFC_MeUnSRCMax" 139 "DFC_MeUnSRCMin" 140 "DFC_PCVOL" 141 "DFC_PCVSCB" 142 "DFC_PCVSRCMax" 143 "DFC_PCVSRCMin" 144 "DFC_RailPSRCMax" 145 "DFC_RailPSRCMin" 146 "DFC_IVActrVltgSRCMax" 147 "DFC_IVActrVltgSRCMin" 148 "DFC_IVPSplyDCDC" 149 "DFC_IVPSplyVltgSRCMax" 150 "DFC_IVPSplyVltgSRCMin" 151 "DFC_AFSOffsDrftMax" 152 "DFC_AFSOffsDrftMin" 153 "DFC_AFSSRCCorMax" 154 "DFC_AFSSRCCorMin" 155 "DFC_AFSSRCRawMax" 156 "DFC_AFSSRCRawMin" 157 "DFC_AFSSetyDrftMax" 158 "DFC_AFSSetyDrftMin" 159 "DFC_AirCClntPAnaSRCMax" 160 "DFC_AirCClntPAnaSRCMin" 161 "DFC_AirCClntPPerSRCMax" 162 "DFC_AirCClntPPerSRCMin" 163 "DFC_AirCClntPdcycSRCMax" 164 "DFC_AirCClntPdcycSRCMin" 165 "DFC_AirCCmprOL" 166 "DFC_AirCCmprRedTrqOL" 167 "DFC_AirCCmprRedTrqSCB" 168 "DFC_AirCCmprRedTrqSCG" 169 "DFC_AirCCmprSCB" 170 "DFC_AirCCmprSCG" 171 "DFC_AirCSwtNpl" 172 "DFC_AirCSwtSig" 173 "DFC_BattUSRCMax" 174 "DFC_BattUSRCMin" 175 "DFC_BrkNpl" 176 "DFC_BrkPSRCMax" 177 "DFC_BrkPSRCMin" 178 "DFC_BrkSig" 179 "DFC_CByVlvOL" 180 "DFC_CByVlvSCB" 181 "DFC_CByVlvSCG" 182 "DFC_CEngDsTSRCMax" 183 "DFC_CEngDsTSRCMin" 184 "DFC_CEngDsTSig" 185 "DFC_CEngUsTSRCMax" 186 "DFC_CEngUsTSRCMin" 187 "DFC_CThmstOL" 188 "DFC_CThmstSCB" 189 "DFC_CThmstSCG" 190 "DFC_ClthSig" 191 "DFC_ECBVlvOL" 192 "DFC_ECBVlvSCB" 193 "DFC_ECBVlvSCG" 194 "DFC_ECBVlvSRCMax" 195 "DFC_ECBVlvSRCMin" 196 "DFC_EGRVlvGovDvtMax" 197 "DFC_EGRVlvGovDvtMin" 198 "DFC_EGRVlvOL" 199 "DFC_EGRVlvSCB" 200 "DFC_EGRVlvSCG" 201 "DFC_EGRVlvSRCMax" 202 "DFC_EGRVlvSRCMin" 203 "DFC_EMDmpOL_0" 204 "DFC_EMDmpOL_1" 205 "DFC_EMDmpSCB_0" 206 "DFC_EMDmpSCB_1" 207 "DFC_EMDmpSCG_0" 208 "DFC_EMDmpSCG_1" 209 "DFC_EngStAOL" 210 "DFC_EngStASCB" 211 "DFC_EngStASCG" 212 "DFC_EnvPSRCMax" 213 "DFC_EnvPSRCMin" 214 "DFC_EnvPSig" 215 "DFC_EnvTSRCMax" 216 "DFC_EnvTSRCMin" 217 "DFC_FanOL" 218 "DFC_FanSCB" 219 "DFC_FlFltSig" 220 "DFC_FuelTSRCMax" 221 "DFC_FuelTSRCMin" 222 "DFC_GbxNPosPPerSRCMax" 223 "DFC_GbxNPosPPerSRCMin" 224 "DFC_GbxNPosPdcycSRCMax" 225 "DFC_GbxNPosPdcycSRCMin" 226 "DFC_GbxNPosSig" 227 "DFC_GlwPlgBSDOL_0" 228 "DFC_GlwPlgBSDOL_1" 229 "DFC_GlwPlgBSDOL_2" 230 "DFC_GlwPlgBSDOL_3" 231 "DFC_GlwPlgBSDOL_4" 232 "DFC_GlwPlgBSDOL_5" 233 "DFC_GlwPlgBSDOL_6" 234 "DFC_GlwPlgBSDOL_7" 235 "DFC_GlwPlgBSDOT_0" 236 "DFC_GlwPlgBSDOT_1" 237 "DFC_GlwPlgBSDOT_2" 238 "DFC_GlwPlgBSDOT_3" 239 "DFC_GlwPlgBSDOT_4" 240 "DFC_GlwPlgBSDOT_5" 241 "DFC_GlwPlgBSDOT_6" 242 "DFC_GlwPlgBSDOT_7" 243 "DFC_GlwPlgBSDSC_0" 244 "DFC_GlwPlgBSDSC_1" 245 "DFC_GlwPlgBSDSC_2" 246 "DFC_GlwPlgBSDSC_3" 247 "DFC_GlwPlgBSDSC_4" 248 "DFC_GlwPlgBSDSC_5" 249 "DFC_GlwPlgBSDSC_6" 250 "DFC_GlwPlgBSDSC_7" 251 "DFC_GlwPlgComErr" 252 "DFC_InjVlvPresMin" 253 "DFC_LSUCircNernstMax_0" 254 "DFC_LSUCircNernstMax_1" 255 "DFC_LSUCircNernstMax_2" 256 "DFC_LSUCircNernstMax_3" 257 "DFC_LSUCircNernstMin_0" 258 "DFC_LSUCircNernstMin_1" 259 "DFC_LSUCircNernstMin_2" 260 "DFC_LSUCircNernstMin_3" 261 "DFC_LSUCircNernstSig_0" 262 "DFC_LSUCircNernstSig_1" 263 "DFC_LSUCircNernstSig_2" 264 "DFC_LSUCircNernstSig_3" 265 "DFC_LSUCircPmpCurMax_0" 266 "DFC_LSUCircPmpCurMax_1" 267 "DFC_LSUCircPmpCurMax_2" 268 "DFC_LSUCircPmpCurMax_3" 269 "DFC_LSUCircPmpCurMin_0" 270 "DFC_LSUCircPmpCurMin_1" 271 "DFC_LSUCircPmpCurMin_2" 272 "DFC_LSUCircPmpCurMin_3" 273 "DFC_LSUCircPmpCurSig_0" 274 "DFC_LSUCircPmpCurSig_1" 275 "DFC_LSUCircPmpCurSig_2" 276 "DFC_LSUCircPmpCurSig_3" 277 "DFC_LSUCircVirtGndMax_0" 278 "DFC_LSUCircVirtGndMax_1" 279 "DFC_LSUCircVirtGndMax_2" 280 "DFC_LSUCircVirtGndMax_3" 281 "DFC_LSUCircVirtGndMin_0" 282 "DFC_LSUCircVirtGndMin_1" 283 "DFC_LSUCircVirtGndMin_2" 284 "DFC_LSUCircVirtGndMin_3" 285 "DFC_LSUCircVirtGndSig_0" 286 "DFC_LSUCircVirtGndSig_1" 287 "DFC_LSUCircVirtGndSig_2" 288 "DFC_LSUCircVirtGndSig_3" 289 "DFC_LSUHtrMax_0" 290 "DFC_LSUHtrMax_1" 291 "DFC_LSUHtrMax_2" 292 "DFC_LSUHtrMax_3" 293 "DFC_LSUHtrMin_0" 294 "DFC_LSUHtrMin_1" 295 "DFC_LSUHtrMin_2" 296 "DFC_LSUHtrMin_3" 297 "DFC_LSUHtrSig_0" 298 "DFC_LSUHtrSig_1" 299 "DFC_LSUHtrSig_2" 300 "DFC_LSUHtrSig_3" 301 "DFC_LSUO2Max_0" 302 "DFC_LSUO2Max_1" 303 "DFC_LSUO2Max_2" 304 "DFC_LSUO2Max_3" 305 "DFC_LSUO2Min_0" 306 "DFC_LSUO2Min_1" 307 "DFC_LSUO2Min_2" 308 "DFC_LSUO2Min_3" 309 "DFC_LSUSPIBattLowMin_0" 310 "DFC_LSUSPIBattLowMin_1" 311 "DFC_LSUSPIBattLowMin_2" 312 "DFC_LSUSPIBattLowMin_3" 313 "DFC_LSUSPISig_0" 314 "DFC_LSUSPISig_1" 315 "DFC_LSUSPISig_2" 316 "DFC_LSUSPISig_3" 317 "DFC_LSUtExcMax_0" 318 "DFC_LSUtExcMax_1" 319 "DFC_LSUtExcMax_2" 320 "DFC_LSUtExcMax_3" 321 "DFC_LSUtExcMin_0" 322 "DFC_LSUtExcMin_1" 323 "DFC_LSUtExcMin_2" 324 "DFC_LSUtExcMin_3" 325 "DFC_MILOL" 326 "DFC_MILSCB" 327 "DFC_MILSCG" 328 "DFC_MeUnSCG" 329 "DFC_NplHsChngPPFltDiff" 330 "DFC_NplPAirFltDs" 331 "DFC_NplTPFltUs" 332 "DFC_OilComErr" 333 "DFC_OilPLmpOL" 334 "DFC_OilPLmpSCB" 335 "DFC_OilPLmpSCG" 336 "DFC_OilPNpl" 337 "DFC_OilTNpl" 338 "DFC_OilTSRCMax" 339 "DFC_OilTSRCMin" 340 "DFC_PCACDsEnvPPls" 341 "DFC_PCACDsSRCMax" 342 "DFC_PCACDsSRCMin" 343 "DFC_PCVSCG" 344 "DFC_PFltCharPDiffMin" 345 "DFC_PFltDstrMin" 346 "DFC_PFltEngPrt" 347 "DFC_PFltLmpOL" 348 "DFC_PFltLmpSCB" 349 "DFC_PFltLmpSCG" 350 "DFC_PFltRgnPerm" 351 "DFC_PFltSRCMaxFlwRstn" 352 "DFC_PFltSRCMinFlwRstn" 353 "DFC_PFltSotMsDvtMax" 354 "DFC_PFltSotMsDvtMin" 355 "DFC_PFltSotMsMax" 356 "DFC_PSPOL" 357 "DFC_PSPSCB" 358 "DFC_PSPSCG" 359 "DFC_SRCHighAPP1" 360 "DFC_SRCHighAPP2" 361 "DFC_SRCLowAPP1" 362 "DFC_SRCLowAPP2" 363 "DFC_SRCMaxPAirFltDs" 364 "DFC_SRCMaxPPFltUs" 365 "DFC_SRCMaxTECU" 366 "DFC_SRCMaxTOxiCatUs" 367 "DFC_SRCMaxTPFltUs" 368 "DFC_SRCMinPAirFltDs" 369 "DFC_SRCMinPPFltUs" 370 "DFC_SRCMinTECU" 371 "DFC_SRCMinTOxiCatUs" 372 "DFC_SRCMinTPFltUs" 373 "DFC_SVSOL" 374 "DFC_SVSSCB" 375 "DFC_SVSSCG" 376 "DFC_StrtOL" 377 "DFC_StrtSCB" 378 "DFC_StrtSCG" 379 "DFC_SyncAPP" 380 "DFC_T15Npl" 381 "DFC_TAFSDtyCycHi" 382 "DFC_TAFSDtyCycLo" 383 "DFC_TAFSPerHi" 384 "DFC_TAFSPerLo" 385 "DFC_TCACDsSRCMax" 386 "DFC_TCACDsSRCMin" 387 "DFC_ThrVlvOL" 388 "DFC_ThrVlvSCB" 389 "DFC_ThrVlvSRCMax" 390 "DFC_ThrVlvSRCMin" 391 "DFC_TrbChLPOL" 392 "DFC_TrbChLPSCB" 393 "DFC_TrbChLPSCG" 394 "DFC_TrbChOL" 395 "DFC_TrbChSCB" 396 "DFC_VSwVlvGovDvtMax" 397 "DFC_VSwVlvGovDvtMin" 398 "DFC_VSwVlvOL" 399 "DFC_VSwVlvSCB" 400 "DFC_VSwVlvSCG" 401 "DFC_VSwVlvSRCMax" 402 "DFC_VSwVlvSRCMin" 403 "DFC_VehVHW" 404 "DFC_VehVMax" 405 "DFC_VehVPlaus" 406 "DFC_VehVSig" 407 "DFC_WaHtElOL" 408 "DFC_WaHtElSCB" 409 "DFC_ClthNpl" 410 "DFC_ETClbETMax_0" 411 "DFC_ETClbETMax_1" 412 "DFC_ETClbETMax_2" 413 "DFC_ETClbETMax_3" 414 "DFC_ETClbETMax_4" 415 "DFC_ETClbETMax_5" 416 "DFC_ETClbETMin_0" 417 "DFC_ETClbETMin_1" 418 "DFC_ETClbETMin_2" 419 "DFC_ETClbETMin_3" 420 "DFC_ETClbETMin_4" 421 "DFC_ETClbETMin_5" 422 "DFC_IVDiaBnkShCirBSH_0" 423 "DFC_IVDiaBnkShCirBSH_1" 424 "DFC_IVDiaBnkShCirChSwt_0" 425 "DFC_IVDiaBnkShCirChSwt_1" 426 "DFC_IVDiaBnkShCirHSBatt_0" 427 "DFC_IVDiaBnkShCirHSBatt_1" 428 "DFC_IVDiaBnkShCirHiRstnc_0" 429 "DFC_IVDiaBnkShCirHiRstnc_1" 430 "DFC_IVDiaBnkShCirLSHSGnd_0" 431 "DFC_IVDiaBnkShCirLSHSGnd_1" 432 "DFC_IVDiaBnkShCirTransfer_0" 433 "DFC_IVDiaBnkShCirTransfer_1" 434 "DFC_IVDiaCylNoCls_0" 435 "DFC_IVDiaCylNoCls_1" 436 "DFC_IVDiaCylNoCls_2" 437 "DFC_IVDiaCylNoCls_3" 438 "DFC_IVDiaCylNoCls_4" 439 "DFC_IVDiaCylNoCls_5" 440 "DFC_IVDiaCylNoLd_0" 441 "DFC_IVDiaCylNoLd_1" 442 "DFC_IVDiaCylNoLd_2" 443 "DFC_IVDiaCylNoLd_3" 444 "DFC_IVDiaCylNoLd_4" 445 "DFC_IVDiaCylNoLd_5" 446 "DFC_IVDiaCylShCirHiRstnc_0" 447 "DFC_IVDiaCylShCirHiRstnc_1" 448 "DFC_IVDiaCylShCirHiRstnc_2" 449 "DFC_IVDiaCylShCirHiRstnc_3" 450 "DFC_IVDiaCylShCirHiRstnc_4" 451 "DFC_IVDiaCylShCirHiRstnc_5" 452 "DFC_IVDiaCylShCirLSBatt_0" 453 "DFC_IVDiaCylShCirLSBatt_1" 454 "DFC_IVDiaCylShCirLSBatt_2" 455 "DFC_IVDiaCylShCirLSBatt_3" 456 "DFC_IVDiaCylShCirLSBatt_4" 457 "DFC_IVDiaCylShCirLSBatt_5" 458 "DFC_IVDiaCylShCirLSHS_0" 459 "DFC_IVDiaCylShCirLSHS_1" 460 "DFC_IVDiaCylShCirLSHS_2" 461 "DFC_IVDiaCylShCirLSHS_3" 462 "DFC_IVDiaCylShCirLSHS_4" 463 "DFC_IVDiaCylShCirLSHS_5" 464 "DFC_IVDiaCylShCirLsLs_0" 465 "DFC_IVDiaCylShCirLsLs_1" 466 "DFC_IVDiaCylShCirLsLs_2" 467 "DFC_IVDiaCylShCirLsLs_3" 468 "DFC_IVDiaCylShCirLsLs_4" 469 "DFC_IVDiaCylShCirLsLs_5" 470 "DFC_IVDiaSPICfg" 471 "DFC_IVDiaSPIColl" 472 "DFC_IVDiaSPICtrl" 473 "DFC_IVDiaSPIRam" 474 "DFC_IVDiaSPITrans" 475 "DFC_LSUCmpChk_0" 476 "DFC_LSUCmpChk_1" 477 "DFC_LSUCmpChk_2" 478 "DFC_LSUCmpChk_3" 479 "DFC_LSUCmpChk_4" 480 "DFC_LSUCmpChk_5" 481 "DFC_LSUDynChk_0" 482 "DFC_LSUDynChk_1" 483 "DFC_LSUDynChk_2" 484 "DFC_LSUDynChk_3" 485 "DFC_LSUO2ClbMax_0" 486 "DFC_LSUO2ClbMax_1" 487 "DFC_LSUO2ClbMax_2" 488 "DFC_LSUO2ClbMax_3" 489 "DFC_LSUO2ClbMin_0" 490 "DFC_LSUO2ClbMin_1" 491 "DFC_LSUO2ClbMin_2" 492 "DFC_LSUO2ClbMin_3" 493 "DFC_LSUO2PlausMax_0" 494 "DFC_LSUO2PlausMax_1" 495 "DFC_LSUO2PlausMax_2" 496 "DFC_LSUO2PlausMax_3" 497 "DFC_LSUO2PlausMin_0" 498 "DFC_LSUO2PlausMin_1" 499 "DFC_LSUO2PlausMin_2" 500 "DFC_LSUO2PlausMin_3" 501 "DFC_LSURiClbMax_0" 502 "DFC_LSURiClbMax_1" 503 "DFC_LSURiClbMax_2" 504 "DFC_LSURiClbMax_3" 505 "DFC_LSURiClbMin_0" 506 "DFC_LSURiClbMin_1" 507 "DFC_LSURiClbMin_2" 508 "DFC_LSURiClbMin_3" 509 "DFC_LSUWireIPSig_0" 510 "DFC_LSUWireIPSig_1" 511 "DFC_LSUWireIPSig_2" 512 "DFC_LSUWireIPSig_3" 513 "DFC_AFSDrftIdlAdjVal" 514 "DFC_AFSDrftLdAdjVal" 515 "DFC_AdcI_ADC0_Cal" 516 "DFC_AdcI_ADC0_Conv" 517 "DFC_CmbChbMisfireMax_0" 518 "DFC_CmbChbMisfireMax_1" 519 "DFC_CmbChbMisfireMax_2" 520 "DFC_CmbChbMisfireMax_3" 521 "DFC_CmbChbMisfireMax_4" 522 "DFC_CmbChbMisfireMax_5" 523 "DFC_CmbChbMisfireMul" 524 "DFC_INJVLVBUSY" 525 "DFC_IVAdjIVA_0" 526 "DFC_IVAdjIVA_1" 527 "DFC_IVAdjIVA_2" 528 "DFC_IVAdjIVA_3" 529 "DFC_IVAdjIVA_4" 530 "DFC_IVAdjIVA_5" 531 "DFC_InjCtlAdjQntEEPCS" 532 "DFC_InjCtlDriftEEPCS" 533 "DFC_MRlyErlyOpng" 534 "DFC_MRlyStk" 535 "DFC_SensFrzPPFltUs" 536 "DFC_T15Sig" 537 "DFC_AirCtlRmpTOut" 538 "DFC_CEngDsTDynTst" 539 "DFC_EGRVlvJamVlvClsd" 540 "DFC_EGRVlvJamVlvOpn" 541 "DFC_EGRVlvLgTDrft" 542 "DFC_EGRVlvOfsLrnJamVlv" 543 "DFC_EGRVlvShTDrft" 544 "DFC_EGTRgnOilDilMax" 545 "DFC_EngICO" 546 "DFC_EpmCaSI1ErrSig" 547 "DFC_EpmCaSI1NoSig" 548 "DFC_EpmCaSI1OfsErr" 549 "DFC_EpmCrSErrSig" 550 "DFC_EpmCrSNoSig" 551 "DFC_MoCADCCmp" 552 "DFC_MoCADCTst" 553 "DFC_MoCADCVltgRatio" 554 "DFC_MoCSOPLoLi" 555 "DFC_MoCSOPMM" 556 "DFC_MoCSOPTimeOut" 557 "DFC_MoCSOPUpLi" 558 "DFC_MoFAPP" 559 "DFC_MoFESpd" 560 "DFC_MoFInjDatPhi" 561 "DFC_MoFInjDatQnt" 562 "DFC_MoFInjQnt" 563 "DFC_MoFOvR" 564 "DFC_MoFQntCor" 565 "DFC_MoFTrqCmp" 566 "DFC_NplTOxiCatUs" 567 "DFC_PhyModNonMonMapNpl" 568 "DFC_RailPOfsTstMax" 569 "DFC_RailPOfsTstMin" 570 "DFC_SWReset_0" 571 "DFC_SWReset_1" 572 "DFC_SWReset_2" 573 "DFC_VSwVlvJamVlv" 574 "DFC_VSwVlvLgTDrft" 575 "DFC_VSwVlvOfsLrnJamVlv" 576 "DFC_VSwVlvShTDrft" 577 "DSQ_AFS" 578 "DSQ_BattU" 579 "DSQ_BrkP" 580 "DSQ_CByVlvActr" 581 "DSQ_CEngDsT" 582 "DSQ_CEngUsT" 583 "DSQ_CThmstActr" 584 "DSQ_Com_aDirect" 585 "DSQ_Com_aSide" 586 "DSQ_Com_nTSC" 587 "DSQ_Com_pBrkSys" 588 "DSQ_Com_stButtonMSA" 589 "DSQ_Com_stClCtr" 590 "DSQ_Com_stDSC" 591 "DSQ_Com_stDecellDSC" 592 "DSQ_Com_stDrWghSeat" 593 "DSQ_Com_stGear" 594 "DSQ_Com_stKeyVld" 595 "DSQ_Com_stReqMSA" 596 "DSQ_Com_stT15" 597 "DSQ_Com_stT50" 598 "DSQ_Com_stTrqDSCDes" 599 "DSQ_Com_swtDrBltb" 600 "DSQ_Com_tEnvT" 601 "DSQ_Com_tGbxOil" 602 "DSQ_Com_trqAC" 603 "DSQ_Com_trqARSCur" 604 "DSQ_Com_trqARSDes" 605 "DSQ_Com_trqAvlAFS" 606 "DSQ_Com_trqDSCDes" 607 "DSQ_Com_trqGbxDes" 608 "DSQ_Com_trqGbxFrc" 609 "DSQ_Com_trqGbxMax" 610 "DSQ_Com_trqTarAFS" 611 "DSQ_Com_v" 612 "DSQ_Com_vBd" 613 "DSQ_DSMInhibitAlways" 614 "DSQ_ECBVlvActr" 615 "DSQ_ECBVlvSens" 616 "DSQ_EGRVlvActr" 617 "DSQ_EGRVlvSens" 618 "DSQ_EMDmp_0" 619 "DSQ_EMDmp_1" 620 "DSQ_EngPrtFWOsc" 621 "DSQ_EnvP" 622 "DSQ_EnvT" 623 "DSQ_FanActr" 624 "DSQ_FuelT" 625 "DSQ_LAYER2EDCMSAStp" 626 "DSQ_LSUO2_0" 627 "DSQ_LSUO2_1" 628 "DSQ_LSUO2_2" 629 "DSQ_LSUO2_3" 630 "DSQ_MeUnActr" 631 "DSQ_NSCDsRLamO2" 632 "DSQ_OilStSens" 633 "DSQ_OilT" 634 "DSQ_PAirFltDs" 635 "DSQ_PCACDs" 636 "DSQ_PCVActr" 637 "DSQ_PPFltUs" 638 "DSQ_TAFS" 639 "DSQ_TCACDs" 640 "DSQ_TECU" 641 "DSQ_TOxiCatUs" 642 "DSQ_TPFltUs" 643 "DSQ_ThrVlvActr" 644 "DSQ_ThrVlvSens" 645 "DSQ_TrbChActr" 646 "DSQ_TrbChLPActr" 647 "DSQ_TrbChSens" 648 "DSQ_TrbnDsRLamO2" 649 "DSQ_VSwVlvActr" 650 "DSQ_VSwVlvSens" 651 "DSQ_VehV" 652 "DSQ_WaHtElActr" 653 "DSQ_stAPP" 654 "DSQ_stAPP1" 655 "DSQ_stAPP2" 656 "DSQ_stLSUSrvTstDem" DEFAULT_VALUE "---" /end COMPU_VTAB
/begin COMPU_METHOD DFC_Verb "" TAB_VERB "%2.1" "-" COMPU_TAB_REF DFC_Verb /end COMPU_METHOD
/begin COMPU_VTAB DFC_Verb "" TAB_VERB 577 0 "DFC_Unused" 1 "DFC_AirCtlGovDvtEOMMax" 2 "DFC_AirCtlGovDvtEOMMin" 3 "DFC_AirCtlGovDvtMax" 4 "DFC_AirCtlGovDvtMin" 5 "DFC_Cj945SpiCom1" 6 "DFC_ComButtonMSASig" 7 "DFC_ComButtonMSATo" 8 "DFC_ComGearboxData2Sig" 9 "DFC_ComGearboxData2To" 10 "DFC_ComGearboxDataSig" 11 "DFC_ComGearboxDataTo" 12 "DFC_ComHeatACSig" 13 "DFC_ComHeatACTo" 14 "DFC_ComLenkradwinkelSig" 15 "DFC_ComLenkradwinkelTo" 16 "DFC_ComMileageRangeSig" 17 "DFC_ComMileageRangeTo" 18 "DFC_ComPspSig" 19 "DFC_ComPspTo" 20 "DFC_ComShutOffPSPSig" 21 "DFC_ComShutOffPSPTo" 22 "DFC_ComStKombiCtr" 23 "DFC_ComStKombiSig" 24 "DFC_ComStKombiTo" 25 "DFC_ComStateARSCtr" 26 "DFC_ComStateARSSig" 27 "DFC_ComStateARSTo" 28 "DFC_ComStateDscSig" 29 "DFC_ComStateDscTo" 30 "DFC_ComStateSeatSig" 31 "DFC_ComStateSeatTo" 32 "DFC_ComTempRelTimeSig" 33 "DFC_ComTempRelTimeTo" 34 "DFC_ComTerminalChk" 35 "DFC_ComTerminalCtr" 36 "DFC_ComTerminalSig" 37 "DFC_ComTerminalTo" 38 "DFC_ComTimeDateSig" 39 "DFC_ComTimeDateTo" 40 "DFC_ComTrailerSig" 41 "DFC_ComTrailerTo" 42 "DFC_ComTrqDemandAfsChk" 43 "DFC_ComTrqDemandAfsCtr" 44 "DFC_ComTrqDemandAfsSig" 45 "DFC_ComTrqDemandAfsTo" 46 "DFC_ComTrqDemandDscChk" 47 "DFC_ComTrqDemandDscCtr" 48 "DFC_ComTrqDemandDscSig" 49 "DFC_ComTrqDemandDscTo" 50 "DFC_ComTrqDemandGbxChk" 51 "DFC_ComTrqDemandGbxCtr" 52 "DFC_ComTrqDemandGbxSig" 53 "DFC_ComTrqDemandGbxTo" 54 "DFC_ComVelocitySig" 55 "DFC_ComVelocityTo" 56 "DFC_ComWheelSpeedSig" 57 "DFC_ComWheelSpeedTo" 58 "DFC_ComZvKlappenSig" 59 "DFC_ComZvKlappenTo" 60 "DFC_Cy150SpiCom" 61 "DFC_Cy320SpiCom" 62 "DFC_ETCtlDvtInrMax" 63 "DFC_ETCtlDvtInrMin" 64 "DFC_ETCtlDvtOutrMax" 65 "DFC_ETCtlDvtOutrMin" 66 "DFC_Fan4WinErr1" 67 "DFC_Fan4WinErr2" 68 "DFC_Fan4WinErr3" 69 "DFC_Fan4WinErr4" 70 "DFC_FanSCG" 71 "DFC_PCRGovDvtLPMax" 72 "DFC_PCRGovDvtLPMin" 73 "DFC_PCRGovDvtMax" 74 "DFC_PCRGovDvtMin" 75 "DFC_RailCPC1" 76 "DFC_RailCPC3" 77 "DFC_RailCPC4" 78 "DFC_RailMeUn0" 79 "DFC_RailMeUn1" 80 "DFC_RailMeUn2" 81 "DFC_RailMeUn3" 82 "DFC_RailMeUn4" 83 "DFC_RailPCV0" 84 "DFC_RailPCV1" 85 "DFC_RailPCV2" 86 "DFC_RailPCV3" 87 "DFC_RailPCV4" 88 "DFC_RailPMonStrt" 89 "DFC_SSpMon1" 90 "DFC_SSpMon2" 91 "DFC_SSpMon3" 92 "DFC_Sia_E1" 93 "DFC_Sia_E10" 94 "DFC_Sia_E11" 95 "DFC_Sia_E12" 96 "DFC_Sia_E13" 97 "DFC_Sia_E14" 98 "DFC_Sia_E15" 99 "DFC_Sia_E2" 100 "DFC_Sia_E3" 101 "DFC_Sia_E4" 102 "DFC_Sia_E5" 103 "DFC_Sia_E6" 104 "DFC_Sia_E7" 105 "DFC_Sia_E8" 106 "DFC_Sia_E9" 107 "DFC_ThrVlv4WinErr1" 108 "DFC_ThrVlv4WinErr2" 109 "DFC_ThrVlv4WinErr3" 110 "DFC_ThrVlv4WinErr4" 111 "DFC_ThrVlvSCG" 112 "DFC_TrbCh4WinErr1" 113 "DFC_TrbCh4WinErr2" 114 "DFC_TrbCh4WinErr3" 115 "DFC_TrbCh4WinErr4" 116 "DFC_TrbChSCG" 117 "DFC_TrbChSRCMax" 118 "DFC_TrbChSRCMin" 119 "DFC_WaHtEl4WinErr1" 120 "DFC_WaHtEl4WinErr2" 121 "DFC_WaHtEl4WinErr3" 122 "DFC_WaHtEl4WinErr4" 123 "DFC_WaHtElSCG" 124 "DFC_ETClbETFltMax" 125 "DFC_ETClbETFltMin" 126 "DFC_InjCrvInjLimChrgBal" 127 "DFC_InjCrvInjLimQntBal" 128 "DFC_InjCrvInjLimSys" 129 "DFC_InjCrvNumInjRtmLim" 130 "DFC_LSUHtCoupSig_0" 131 "DFC_LSUHtCoupSig_1" 132 "DFC_LSUHtCoupSig_2" 133 "DFC_LSUHtCoupSig_3" 134 "DFC_CtT" 135 "DFC_DSMDummy" 136 "DFC_MeUnOL" 137 "DFC_MeUnSCB" 138 "DFC_MeUnSRCMax" 139 "DFC_MeUnSRCMin" 140 "DFC_PCVOL" 141 "DFC_PCVSCB" 142 "DFC_PCVSRCMax" 143 "DFC_PCVSRCMin" 144 "DFC_RailPSRCMax" 145 "DFC_RailPSRCMin" 146 "DFC_IVActrVltgSRCMax" 147 "DFC_IVActrVltgSRCMin" 148 "DFC_IVPSplyDCDC" 149 "DFC_IVPSplyVltgSRCMax" 150 "DFC_IVPSplyVltgSRCMin" 151 "DFC_AFSOffsDrftMax" 152 "DFC_AFSOffsDrftMin" 153 "DFC_AFSSRCCorMax" 154 "DFC_AFSSRCCorMin" 155 "DFC_AFSSRCRawMax" 156 "DFC_AFSSRCRawMin" 157 "DFC_AFSSetyDrftMax" 158 "DFC_AFSSetyDrftMin" 159 "DFC_AirCClntPAnaSRCMax" 160 "DFC_AirCClntPAnaSRCMin" 161 "DFC_AirCClntPPerSRCMax" 162 "DFC_AirCClntPPerSRCMin" 163 "DFC_AirCClntPdcycSRCMax" 164 "DFC_AirCClntPdcycSRCMin" 165 "DFC_AirCCmprOL" 166 "DFC_AirCCmprRedTrqOL" 167 "DFC_AirCCmprRedTrqSCB" 168 "DFC_AirCCmprRedTrqSCG" 169 "DFC_AirCCmprSCB" 170 "DFC_AirCCmprSCG" 171 "DFC_AirCSwtNpl" 172 "DFC_AirCSwtSig" 173 "DFC_BattUSRCMax" 174 "DFC_BattUSRCMin" 175 "DFC_BrkNpl" 176 "DFC_BrkPSRCMax" 177 "DFC_BrkPSRCMin" 178 "DFC_BrkSig" 179 "DFC_CByVlvOL" 180 "DFC_CByVlvSCB" 181 "DFC_CByVlvSCG" 182 "DFC_CEngDsTSRCMax" 183 "DFC_CEngDsTSRCMin" 184 "DFC_CEngDsTSig" 185 "DFC_CEngUsTSRCMax" 186 "DFC_CEngUsTSRCMin" 187 "DFC_CThmstOL" 188 "DFC_CThmstSCB" 189 "DFC_CThmstSCG" 190 "DFC_ClthSig" 191 "DFC_ECBVlvOL" 192 "DFC_ECBVlvSCB" 193 "DFC_ECBVlvSCG" 194 "DFC_ECBVlvSRCMax" 195 "DFC_ECBVlvSRCMin" 196 "DFC_EGRVlvGovDvtMax" 197 "DFC_EGRVlvGovDvtMin" 198 "DFC_EGRVlvOL" 199 "DFC_EGRVlvSCB" 200 "DFC_EGRVlvSCG" 201 "DFC_EGRVlvSRCMax" 202 "DFC_EGRVlvSRCMin" 203 "DFC_EMDmpOL_0" 204 "DFC_EMDmpOL_1" 205 "DFC_EMDmpSCB_0" 206 "DFC_EMDmpSCB_1" 207 "DFC_EMDmpSCG_0" 208 "DFC_EMDmpSCG_1" 209 "DFC_EngStAOL" 210 "DFC_EngStASCB" 211 "DFC_EngStASCG" 212 "DFC_EnvPSRCMax" 213 "DFC_EnvPSRCMin" 214 "DFC_EnvPSig" 215 "DFC_EnvTSRCMax" 216 "DFC_EnvTSRCMin" 217 "DFC_FanOL" 218 "DFC_FanSCB" 219 "DFC_FlFltSig" 220 "DFC_FuelTSRCMax" 221 "DFC_FuelTSRCMin" 222 "DFC_GbxNPosPPerSRCMax" 223 "DFC_GbxNPosPPerSRCMin" 224 "DFC_GbxNPosPdcycSRCMax" 225 "DFC_GbxNPosPdcycSRCMin" 226 "DFC_GbxNPosSig" 227 "DFC_GlwPlgBSDOL_0" 228 "DFC_GlwPlgBSDOL_1" 229 "DFC_GlwPlgBSDOL_2" 230 "DFC_GlwPlgBSDOL_3" 231 "DFC_GlwPlgBSDOL_4" 232 "DFC_GlwPlgBSDOL_5" 233 "DFC_GlwPlgBSDOL_6" 234 "DFC_GlwPlgBSDOL_7" 235 "DFC_GlwPlgBSDOT_0" 236 "DFC_GlwPlgBSDOT_1" 237 "DFC_GlwPlgBSDOT_2" 238 "DFC_GlwPlgBSDOT_3" 239 "DFC_GlwPlgBSDOT_4" 240 "DFC_GlwPlgBSDOT_5" 241 "DFC_GlwPlgBSDOT_6" 242 "DFC_GlwPlgBSDOT_7" 243 "DFC_GlwPlgBSDSC_0" 244 "DFC_GlwPlgBSDSC_1" 245 "DFC_GlwPlgBSDSC_2" 246 "DFC_GlwPlgBSDSC_3" 247 "DFC_GlwPlgBSDSC_4" 248 "DFC_GlwPlgBSDSC_5" 249 "DFC_GlwPlgBSDSC_6" 250 "DFC_GlwPlgBSDSC_7" 251 "DFC_GlwPlgComErr" 252 "DFC_InjVlvPresMin" 253 "DFC_LSUCircNernstMax_0" 254 "DFC_LSUCircNernstMax_1" 255 "DFC_LSUCircNernstMax_2" 256 "DFC_LSUCircNernstMax_3" 257 "DFC_LSUCircNernstMin_0" 258 "DFC_LSUCircNernstMin_1" 259 "DFC_LSUCircNernstMin_2" 260 "DFC_LSUCircNernstMin_3" 261 "DFC_LSUCircNernstSig_0" 262 "DFC_LSUCircNernstSig_1" 263 "DFC_LSUCircNernstSig_2" 264 "DFC_LSUCircNernstSig_3" 265 "DFC_LSUCircPmpCurMax_0" 266 "DFC_LSUCircPmpCurMax_1" 267 "DFC_LSUCircPmpCurMax_2" 268 "DFC_LSUCircPmpCurMax_3" 269 "DFC_LSUCircPmpCurMin_0" 270 "DFC_LSUCircPmpCurMin_1" 271 "DFC_LSUCircPmpCurMin_2" 272 "DFC_LSUCircPmpCurMin_3" 273 "DFC_LSUCircPmpCurSig_0" 274 "DFC_LSUCircPmpCurSig_1" 275 "DFC_LSUCircPmpCurSig_2" 276 "DFC_LSUCircPmpCurSig_3" 277 "DFC_LSUCircVirtGndMax_0" 278 "DFC_LSUCircVirtGndMax_1" 279 "DFC_LSUCircVirtGndMax_2" 280 "DFC_LSUCircVirtGndMax_3" 281 "DFC_LSUCircVirtGndMin_0" 282 "DFC_LSUCircVirtGndMin_1" 283 "DFC_LSUCircVirtGndMin_2" 284 "DFC_LSUCircVirtGndMin_3" 285 "DFC_LSUCircVirtGndSig_0" 286 "DFC_LSUCircVirtGndSig_1" 287 "DFC_LSUCircVirtGndSig_2" 288 "DFC_LSUCircVirtGndSig_3" 289 "DFC_LSUHtrMax_0" 290 "DFC_LSUHtrMax_1" 291 "DFC_LSUHtrMax_2" 292 "DFC_LSUHtrMax_3" 293 "DFC_LSUHtrMin_0" 294 "DFC_LSUHtrMin_1" 295 "DFC_LSUHtrMin_2" 296 "DFC_LSUHtrMin_3" 297 "DFC_LSUHtrSig_0" 298 "DFC_LSUHtrSig_1" 299 "DFC_LSUHtrSig_2" 300 "DFC_LSUHtrSig_3" 301 "DFC_LSUO2Max_0" 302 "DFC_LSUO2Max_1" 303 "DFC_LSUO2Max_2" 304 "DFC_LSUO2Max_3" 305 "DFC_LSUO2Min_0" 306 "DFC_LSUO2Min_1" 307 "DFC_LSUO2Min_2" 308 "DFC_LSUO2Min_3" 309 "DFC_LSUSPIBattLowMin_0" 310 "DFC_LSUSPIBattLowMin_1" 311 "DFC_LSUSPIBattLowMin_2" 312 "DFC_LSUSPIBattLowMin_3" 313 "DFC_LSUSPISig_0" 314 "DFC_LSUSPISig_1" 315 "DFC_LSUSPISig_2" 316 "DFC_LSUSPISig_3" 317 "DFC_LSUtExcMax_0" 318 "DFC_LSUtExcMax_1" 319 "DFC_LSUtExcMax_2" 320 "DFC_LSUtExcMax_3" 321 "DFC_LSUtExcMin_0" 322 "DFC_LSUtExcMin_1" 323 "DFC_LSUtExcMin_2" 324 "DFC_LSUtExcMin_3" 325 "DFC_MILOL" 326 "DFC_MILSCB" 327 "DFC_MILSCG" 328 "DFC_MeUnSCG" 329 "DFC_NplHsChngPPFltDiff" 330 "DFC_NplPAirFltDs" 331 "DFC_NplTPFltUs" 332 "DFC_OilComErr" 333 "DFC_OilPLmpOL" 334 "DFC_OilPLmpSCB" 335 "DFC_OilPLmpSCG" 336 "DFC_OilPNpl" 337 "DFC_OilTNpl" 338 "DFC_OilTSRCMax" 339 "DFC_OilTSRCMin" 340 "DFC_PCACDsEnvPPls" 341 "DFC_PCACDsSRCMax" 342 "DFC_PCACDsSRCMin" 343 "DFC_PCVSCG" 344 "DFC_PFltCharPDiffMin" 345 "DFC_PFltDstrMin" 346 "DFC_PFltEngPrt" 347 "DFC_PFltLmpOL" 348 "DFC_PFltLmpSCB" 349 "DFC_PFltLmpSCG" 350 "DFC_PFltRgnPerm" 351 "DFC_PFltSRCMaxFlwRstn" 352 "DFC_PFltSRCMinFlwRstn" 353 "DFC_PFltSotMsDvtMax" 354 "DFC_PFltSotMsDvtMin" 355 "DFC_PFltSotMsMax" 356 "DFC_PSPOL" 357 "DFC_PSPSCB" 358 "DFC_PSPSCG" 359 "DFC_SRCHighAPP1" 360 "DFC_SRCHighAPP2" 361 "DFC_SRCLowAPP1" 362 "DFC_SRCLowAPP2" 363 "DFC_SRCMaxPAirFltDs" 364 "DFC_SRCMaxPPFltUs" 365 "DFC_SRCMaxTECU" 366 "DFC_SRCMaxTOxiCatUs" 367 "DFC_SRCMaxTPFltUs" 368 "DFC_SRCMinPAirFltDs" 369 "DFC_SRCMinPPFltUs" 370 "DFC_SRCMinTECU" 371 "DFC_SRCMinTOxiCatUs" 372 "DFC_SRCMinTPFltUs" 373 "DFC_SVSOL" 374 "DFC_SVSSCB" 375 "DFC_SVSSCG" 376 "DFC_StrtOL" 377 "DFC_StrtSCB" 378 "DFC_StrtSCG" 379 "DFC_SyncAPP" 380 "DFC_T15Npl" 381 "DFC_TAFSDtyCycHi" 382 "DFC_TAFSDtyCycLo" 383 "DFC_TAFSPerHi" 384 "DFC_TAFSPerLo" 385 "DFC_TCACDsSRCMax" 386 "DFC_TCACDsSRCMin" 387 "DFC_ThrVlvOL" 388 "DFC_ThrVlvSCB" 389 "DFC_ThrVlvSRCMax" 390 "DFC_ThrVlvSRCMin" 391 "DFC_TrbChLPOL" 392 "DFC_TrbChLPSCB" 393 "DFC_TrbChLPSCG" 394 "DFC_TrbChOL" 395 "DFC_TrbChSCB" 396 "DFC_VSwVlvGovDvtMax" 397 "DFC_VSwVlvGovDvtMin" 398 "DFC_VSwVlvOL" 399 "DFC_VSwVlvSCB" 400 "DFC_VSwVlvSCG" 401 "DFC_VSwVlvSRCMax" 402 "DFC_VSwVlvSRCMin" 403 "DFC_VehVHW" 404 "DFC_VehVMax" 405 "DFC_VehVPlaus" 406 "DFC_VehVSig" 407 "DFC_WaHtElOL" 408 "DFC_WaHtElSCB" 409 "DFC_ClthNpl" 410 "DFC_ETClbETMax_0" 411 "DFC_ETClbETMax_1" 412 "DFC_ETClbETMax_2" 413 "DFC_ETClbETMax_3" 414 "DFC_ETClbETMax_4" 415 "DFC_ETClbETMax_5" 416 "DFC_ETClbETMin_0" 417 "DFC_ETClbETMin_1" 418 "DFC_ETClbETMin_2" 419 "DFC_ETClbETMin_3" 420 "DFC_ETClbETMin_4" 421 "DFC_ETClbETMin_5" 422 "DFC_IVDiaBnkShCirBSH_0" 423 "DFC_IVDiaBnkShCirBSH_1" 424 "DFC_IVDiaBnkShCirChSwt_0" 425 "DFC_IVDiaBnkShCirChSwt_1" 426 "DFC_IVDiaBnkShCirHSBatt_0" 427 "DFC_IVDiaBnkShCirHSBatt_1" 428 "DFC_IVDiaBnkShCirHiRstnc_0" 429 "DFC_IVDiaBnkShCirHiRstnc_1" 430 "DFC_IVDiaBnkShCirLSHSGnd_0" 431 "DFC_IVDiaBnkShCirLSHSGnd_1" 432 "DFC_IVDiaBnkShCirTransfer_0" 433 "DFC_IVDiaBnkShCirTransfer_1" 434 "DFC_IVDiaCylNoCls_0" 435 "DFC_IVDiaCylNoCls_1" 436 "DFC_IVDiaCylNoCls_2" 437 "DFC_IVDiaCylNoCls_3" 438 "DFC_IVDiaCylNoCls_4" 439 "DFC_IVDiaCylNoCls_5" 440 "DFC_IVDiaCylNoLd_0" 441 "DFC_IVDiaCylNoLd_1" 442 "DFC_IVDiaCylNoLd_2" 443 "DFC_IVDiaCylNoLd_3" 444 "DFC_IVDiaCylNoLd_4" 445 "DFC_IVDiaCylNoLd_5" 446 "DFC_IVDiaCylShCirHiRstnc_0" 447 "DFC_IVDiaCylShCirHiRstnc_1" 448 "DFC_IVDiaCylShCirHiRstnc_2" 449 "DFC_IVDiaCylShCirHiRstnc_3" 450 "DFC_IVDiaCylShCirHiRstnc_4" 451 "DFC_IVDiaCylShCirHiRstnc_5" 452 "DFC_IVDiaCylShCirLSBatt_0" 453 "DFC_IVDiaCylShCirLSBatt_1" 454 "DFC_IVDiaCylShCirLSBatt_2" 455 "DFC_IVDiaCylShCirLSBatt_3" 456 "DFC_IVDiaCylShCirLSBatt_4" 457 "DFC_IVDiaCylShCirLSBatt_5" 458 "DFC_IVDiaCylShCirLSHS_0" 459 "DFC_IVDiaCylShCirLSHS_1" 460 "DFC_IVDiaCylShCirLSHS_2" 461 "DFC_IVDiaCylShCirLSHS_3" 462 "DFC_IVDiaCylShCirLSHS_4" 463 "DFC_IVDiaCylShCirLSHS_5" 464 "DFC_IVDiaCylShCirLsLs_0" 465 "DFC_IVDiaCylShCirLsLs_1" 466 "DFC_IVDiaCylShCirLsLs_2" 467 "DFC_IVDiaCylShCirLsLs_3" 468 "DFC_IVDiaCylShCirLsLs_4" 469 "DFC_IVDiaCylShCirLsLs_5" 470 "DFC_IVDiaSPICfg" 471 "DFC_IVDiaSPIColl" 472 "DFC_IVDiaSPICtrl" 473 "DFC_IVDiaSPIRam" 474 "DFC_IVDiaSPITrans" 475 "DFC_LSUCmpChk_0" 476 "DFC_LSUCmpChk_1" 477 "DFC_LSUCmpChk_2" 478 "DFC_LSUCmpChk_3" 479 "DFC_LSUCmpChk_4" 480 "DFC_LSUCmpChk_5" 481 "DFC_LSUDynChk_0" 482 "DFC_LSUDynChk_1" 483 "DFC_LSUDynChk_2" 484 "DFC_LSUDynChk_3" 485 "DFC_LSUO2ClbMax_0" 486 "DFC_LSUO2ClbMax_1" 487 "DFC_LSUO2ClbMax_2" 488 "DFC_LSUO2ClbMax_3" 489 "DFC_LSUO2ClbMin_0" 490 "DFC_LSUO2ClbMin_1" 491 "DFC_LSUO2ClbMin_2" 492 "DFC_LSUO2ClbMin_3" 493 "DFC_LSUO2PlausMax_0" 494 "DFC_LSUO2PlausMax_1" 495 "DFC_LSUO2PlausMax_2" 496 "DFC_LSUO2PlausMax_3" 497 "DFC_LSUO2PlausMin_0" 498 "DFC_LSUO2PlausMin_1" 499 "DFC_LSUO2PlausMin_2" 500 "DFC_LSUO2PlausMin_3" 501 "DFC_LSURiClbMax_0" 502 "DFC_LSURiClbMax_1" 503 "DFC_LSURiClbMax_2" 504 "DFC_LSURiClbMax_3" 505 "DFC_LSURiClbMin_0" 506 "DFC_LSURiClbMin_1" 507 "DFC_LSURiClbMin_2" 508 "DFC_LSURiClbMin_3" 509 "DFC_LSUWireIPSig_0" 510 "DFC_LSUWireIPSig_1" 511 "DFC_LSUWireIPSig_2" 512 "DFC_LSUWireIPSig_3" 513 "DFC_AFSDrftIdlAdjVal" 514 "DFC_AFSDrftLdAdjVal" 515 "DFC_AdcI_ADC0_Cal" 516 "DFC_AdcI_ADC0_Conv" 517 "DFC_CmbChbMisfireMax_0" 518 "DFC_CmbChbMisfireMax_1" 519 "DFC_CmbChbMisfireMax_2" 520 "DFC_CmbChbMisfireMax_3" 521 "DFC_CmbChbMisfireMax_4" 522 "DFC_CmbChbMisfireMax_5" 523 "DFC_CmbChbMisfireMul" 524 "DFC_INJVLVBUSY" 525 "DFC_IVAdjIVA_0" 526 "DFC_IVAdjIVA_1" 527 "DFC_IVAdjIVA_2" 528 "DFC_IVAdjIVA_3" 529 "DFC_IVAdjIVA_4" 530 "DFC_IVAdjIVA_5" 531 "DFC_InjCtlAdjQntEEPCS" 532 "DFC_InjCtlDriftEEPCS" 533 "DFC_MRlyErlyOpng" 534 "DFC_MRlyStk" 535 "DFC_SensFrzPPFltUs" 536 "DFC_T15Sig" 537 "DFC_AirCtlRmpTOut" 538 "DFC_CEngDsTDynTst" 539 "DFC_EGRVlvJamVlvClsd" 540 "DFC_EGRVlvJamVlvOpn" 541 "DFC_EGRVlvLgTDrft" 542 "DFC_EGRVlvOfsLrnJamVlv" 543 "DFC_EGRVlvShTDrft" 544 "DFC_EGTRgnOilDilMax" 545 "DFC_EngICO" 546 "DFC_EpmCaSI1ErrSig" 547 "DFC_EpmCaSI1NoSig" 548 "DFC_EpmCaSI1OfsErr" 549 "DFC_EpmCrSErrSig" 550 "DFC_EpmCrSNoSig" 551 "DFC_MoCADCCmp" 552 "DFC_MoCADCTst" 553 "DFC_MoCADCVltgRatio" 554 "DFC_MoCSOPLoLi" 555 "DFC_MoCSOPMM" 556 "DFC_MoCSOPTimeOut" 557 "DFC_MoCSOPUpLi" 558 "DFC_MoFAPP" 559 "DFC_MoFESpd" 560 "DFC_MoFInjDatPhi" 561 "DFC_MoFInjDatQnt" 562 "DFC_MoFInjQnt" 563 "DFC_MoFOvR" 564 "DFC_MoFQntCor" 565 "DFC_MoFTrqCmp" 566 "DFC_NplTOxiCatUs" 567 "DFC_PhyModNonMonMapNpl" 568 "DFC_RailPOfsTstMax" 569 "DFC_RailPOfsTstMin" 570 "DFC_SWReset_0" 571 "DFC_SWReset_1" 572 "DFC_SWReset_2" 573 "DFC_VSwVlvJamVlv" 574 "DFC_VSwVlvLgTDrft" 575 "DFC_VSwVlvOfsLrnJamVlv" 576 "DFC_VSwVlvShTDrft" DEFAULT_VALUE "---" /end COMPU_VTAB
/begin COMPU_METHOD DFES_LampFlt "" TAB_VERB "%6.3" "-" COMPU_TAB_REF DFES_LampFlt /end COMPU_METHOD
/begin COMPU_VTAB DFES_LampFlt "" TAB_VERB 6 0 "NO_Lamp_Activation" 1 "Continous_Lamp_Support" 2 "Blinking_Lamp_Support" 3 "Blinking_and_Continous_Lamp_Supp" 4 "Continuous_SVS_Support_LDF" 8 "Continuous_SVS_Support_LDF_FLC" /end COMPU_VTAB
/begin COMPU_METHOD DFES_OneToOne "" RAT_FUNC "%6.2" "-" COEFFS 0 1 0 0 0 1 /end COMPU_METHOD
/begin COMPU_METHOD DFES_stCheck_Verb "" TAB_VERB "%6.3" "-" COMPU_TAB_REF DFES_stCheck_Verb /end COMPU_METHOD
/begin COMPU_VTAB DFES_stCheck_Verb "" TAB_VERB 16 0 "OkNoTst" 1 "OkTested" 2 "OkHealed" 3 "OkRstNoTst" 4 "DefectNoTst" 5 "DefectDelay" 6 "Defect" 7 "DefectRstNoTst" 16 "SimCond_OkNoTst" 17 "SimCond_OkTested" 18 "SimCond_OkHealed" 19 "SimCond_OkRstNoTst" 20 "SimCond_DefectNoTst" 21 "SimCond_DefectDelay" 22 "SimCond_Defect" 23 "SimCond_DefectRstNoTst" /end COMPU_VTAB
/begin COMPU_METHOD DFES_stCnt_Verb "" TAB_VERB "%6.3" "-" COMPU_TAB_REF DFES_stCnt_Verb /end COMPU_METHOD
/begin COMPU_VTAB DFES_stCnt_Verb "" TAB_VERB 36 0 "SVS_NONE__MIL_NONE" 1 "SVS_NONE__MIL_HLC_TRG" 2 "SVS_NONE__MIL_HLC_ELAP" 3 "SVS_NONE__MIL_FLC_CNT" 4 "SVS_NONE__MIL_FLC_TIME" 5 "SVS_NONE__MIL_HLC_TIME" 16 "SVS_HLC_TRG__MIL_NONE" 17 "SVS_HLC_TRG__MIL_HLC_TRG" 18 "SVS_HLC_TRG__MIL_HLC_ELAP" 19 "SVS_HLC_TRG__MIL_FLC_CNT" 20 "SVS_HLC_TRG__MIL_FLC_TIME" 21 "SVS_HLC_TRG__MIL_HLC_TIME" 32 "SVS_HLC_ELAP__MIL_NONE" 33 "SVS_HLC_ELAP__MIL_HLC_TRG" 34 "SVS_HLC_ELAP__MIL_HLC_ELAP" 35 "SVS_HLC_ELAP__MIL_FLC_CNT" 36 "SVS_HLC_ELAP__MIL_FLC_TIME" 37 "SVS_HLC_ELAP__MIL_HLC_TIME" 48 "SVS_FLC_CNT__MIL_NONE" 49 "SVS_FLC_CNT__MIL_HLC_TRG" 50 "SVS_FLC_CNT__MIL_HLC_ELAP" 51 "SVS_FLC_CNT__MIL_FLC_CNT" 52 "SVS_FLC_CNT__MIL_FLC_TIME" 53 "SVS_FLC_CNT__MIL_HLC_TIME" 64 "SVS_FLC_TIME__MIL_NONE" 65 "SVS_FLC_TIME__MIL_HLC_TRG" 66 "SVS_FLC_TIME__MIL_HLC_ELAP" 67 "SVS_FLC_TIME__MIL_FLC_CNT" 68 "SVS_FLC_TIME__MIL_FLC_TIME" 69 "SVS_FLC_TIME__MIL_HLC_TIME" 80 "SVS_HLC_TIME__MIL_NONE" 81 "SVS_HLC_TIME__MIL_HLC_TRG" 82 "SVS_HLC_TIME__MIL_HLC_ELAP" 83 "SVS_HLC_TIME__MIL_FLC_CNT" 84 "SVS_HLC_TIME__MIL_FLC_TIME" 85 "SVS_HLC_TIME__MIL_HLC_TIME" /end COMPU_VTAB
/begin COMPU_METHOD DFES_stEntry_Verb "" TAB_VERB "%6.3" "-" COMPU_TAB_REF DFES_stEntry_Verb /end COMPU_METHOD
/begin COMPU_VTAB DFES_stEntry_Verb "" TAB_VERB 30 0 "NoEntry" 1 "Erased" 2 "PrivateTemporary" 3 "SVSOff_FreezeFrameOnly" 4 "SVSOff_DelayActiveDefect" 5 "SVSOff_ServiceNoDefect" 6 "SVSOff_ServiceDefect" 7 "SVSOff_ServiceHistoryDefect" 8 "SVSOff_ServiceHistoryNoDefect" 9 "SVSOff_DelayActiveNoDefect" 10 "SVSOff_PendingDefect" 11 "SVSOff_DebouncedDefect" 12 "SVSOff_HistoryPendingDefect" 13 "SVSOff_HealingNoDefect" 14 "SVSOff_HistoryNoDefect" 128 "SVSOn_NoEntry" 129 "SVSOn_Erased" 130 "SVSOn_PrivateTemporary" 131 "SVSOn_FreezeFrameOnly" 132 "SVSOn_DelayActiveDefect" 133 "SVSOn_ServiceNoDefect" 134 "SVSOn_ServiceDefect" 135 "SVSOn_ServiceHistoryDefect" 136 "SVSOn_ServiceHistoryNoDefect" 137 "SVSOn_DelayActiveNoDefect" 138 "SVSOn_PendingDefect" 139 "SVSOn_DebouncedDefect" 140 "SVSOn_HistoryPendingDefect" 141 "SVSOn_HealingNoDefect" 142 "HistoryNoDefect" /end COMPU_VTAB
/begin COMPU_METHOD DFES_TstVisAndPrio "" TAB_VERB "%6.3" "-" COMPU_TAB_REF DFES_TstVisAndPrio /end COMPU_METHOD
/begin COMPU_VTAB DFES_TstVisAndPrio "" TAB_VERB 8 4 "invisible_for_all_Testers" 32 "ServiceLow" 40 "ServiceHigh" 96 "OBDLow" 104 "OBDHigh" 168 "ServiceHigh_MaxPrio" 224 "ServiceHigh_OBDLow_MaxPrio" 232 "ServiceHigh_OBDHigh_MaxPrio" /end COMPU_VTAB
/begin COMPU_METHOD DSMAUX_DTRGVerb "" TAB_VERB "%2.1" "-" COMPU_TAB_REF DSMAUX_DTRGVerb /end COMPU_METHOD
/begin COMPU_VTAB DSMAUX_DTRGVerb "" TAB_VERB 7 0 "DTRG_Time200ms" 1 "DTRG_SimilarCondHLC" 2 "DTRG_AlwaysTrue" 3 "DTRG_DrivingCycleFLC" 4 "DTRG_DrivingCycleHLC" 5 "DTRG_NoTrigger" 6 "DTRG_WarmUpCycle" DEFAULT_VALUE "---" /end COMPU_VTAB
/begin COMPU_METHOD Signals_IntSigNumVerb "" TAB_VERB "%6.3" "-" COMPU_TAB_REF Signals_IntSigNumVerb /end COMPU_METHOD
/begin COMPU_VTAB Signals_IntSigNumVerb "" TAB_VERB 162 0 "SIGNALS_Signals_Default" 1 "SIGNALS_ETClb_ctLrn_mp[0]" 2 "SIGNALS_ETClb_ctLrn_mp[1]" 3 "SIGNALS_ETClb_ctLrn_mp[2]" 4 "SIGNALS_ETClb_dtiETFlt0_mp[0]" 5 "SIGNALS_ETClb_dtiETFlt0_mp[1]" 6 "SIGNALS_ETClb_dtiETFlt0_mp[2]" 7 "SIGNALS_ETClb_dtiETFlt0_mp[3]" 8 "SIGNALS_ETClb_dtiETFlt0_mp[4]" 9 "SIGNALS_ETClb_dtiETFlt0_mp[5]" 10 "SIGNALS_ETClb_dtiETFlt1_mp[0]" 11 "SIGNALS_ETClb_dtiETFlt1_mp[1]" 12 "SIGNALS_ETClb_dtiETFlt1_mp[2]" 13 "SIGNALS_ETClb_dtiETFlt1_mp[3]" 14 "SIGNALS_ETClb_dtiETFlt1_mp[4]" 15 "SIGNALS_ETClb_dtiETFlt1_mp[5]" 16 "SIGNALS_ETClb_dtiETFlt2_mp[0]" 17 "SIGNALS_ETClb_dtiETFlt2_mp[1]" 18 "SIGNALS_ETClb_dtiETFlt2_mp[2]" 19 "SIGNALS_ETClb_dtiETFlt2_mp[3]" 20 "SIGNALS_ETClb_dtiETFlt2_mp[4]" 21 "SIGNALS_ETClb_dtiETFlt2_mp[5]" 22 "SIGNALS_ETClb_pRailSet[0]" 23 "SIGNALS_ETClb_pRailSet[1]" 24 "SIGNALS_ETClb_pRailSet[2]" 25 "SIGNALS_ETClb_stCor" 26 "SIGNALS_ETClb_stRlsCylCor_mp" 27 "SIGNALS_ETClb_tiETAvrg[0]" 28 "SIGNALS_ETClb_tiETAvrg[1]" 29 "SIGNALS_ETClb_tiETAvrg[2]" 30 "SIGNALS_ETClb_tiETMax[0]" 31 "SIGNALS_ETClb_tiETMax[1]" 32 "SIGNALS_ETClb_tiETMax[2]" 33 "SIGNALS_ETClb_tiETMin[0]" 34 "SIGNALS_ETClb_tiETMin[1]" 35 "SIGNALS_ETClb_tiETMin[2]" 36 "SIGNALS_InjUn_stStrt" 37 "SIGNALS_InjVlv_tiMI1ET_mp" 38 "SIGNALS_InjVlv_tiPiI1ET_mp" 39 "SIGNALS_InjVlv_volMI1_mp" 40 "SIGNALS_InjVlv_volPiI1_mp" 41 "SIGNALS_MeUn_dvolSet" 42 "SIGNALS_MeUn_iActFlt_mp" 43 "SIGNALS_MeUn_iSet_mp" 44 "SIGNALS_MeUn_uRaw_mp" 45 "SIGNALS_PCV_iActFlt_mp" 46 "SIGNALS_PCV_iSet" 47 "SIGNALS_PCV_pSet" 48 "SIGNALS_PCV_uRaw_mp" 49 "SIGNALS_PFltSrv_stCondTstr" 50 "SIGNALS_PFltSrv_stRgnTstr" 51 "SIGNALS_PID01h" 52 "SIGNALS_PSP_stPs_mp" 53 "SIGNALS_RailP_pCurr_mp" 54 "SIGNALS_RailP_pLin" 55 "SIGNALS_Rail_dvolPreCtl" 56 "SIGNALS_Rail_stCtlLoop" 57 "SIGNALS_AFS_dm" 58 "SIGNALS_AFS_dmSens" 59 "SIGNALS_AFS_mAirPerCyl" 60 "SIGNALS_APP_rFlt_mp" 61 "SIGNALS_APP_rUnFlt" 62 "SIGNALS_APP_uRaw1" 63 "SIGNALS_APP_uRaw2" 64 "SIGNALS_ASMod_dvolPFltEG" 65 "SIGNALS_Absch_korr" 66 "SIGNALS_ActMod_trq" 67 "SIGNALS_ActMod_trqInr" 68 "SIGNALS_AirCtl_mDesVal" 69 "SIGNALS_Air_pCACDs" 70 "SIGNALS_Air_pSensPCACDs" 71 "SIGNALS_Air_rRawTAFS" 72 "SIGNALS_Air_tCACDs" 73 "SIGNALS_Air_uRawPCACDs" 74 "SIGNALS_Air_uRawTCACDs" 75 "SIGNALS_AltIO_rAltLoad" 76 "SIGNALS_BattU_uSens" 77 "SIGNALS_CEngDsT_t" 78 "SIGNALS_CEngDsT_tSens" 79 "SIGNALS_CEngDsT_uRaw" 80 "SIGNALS_CoEOM_stOpModeAct" 81 "SIGNALS_CoETS_rTrq" 82 "SIGNALS_CoEng_st" 83 "SIGNALS_Com_lSum" 84 "SIGNALS_Com_nPsp" 85 "SIGNALS_Com_rPspSetPoint" 86 "SIGNALS_DSMDur_ctGlb_0" 87 "SIGNALS_DSMRdy_xPId41" 88 "SIGNALS_D_soc" 89 "SIGNALS_EGRVlv_rPs" 90 "SIGNALS_EMDmp_stPs" 91 "SIGNALS_EngDa_tiEngOn" 92 "SIGNALS_EnvP_p" 93 "SIGNALS_EnvP_uRaw" 94 "SIGNALS_EpmCaS_phiOfsCorr" 95 "SIGNALS_EpmHCrS_stSigMode" 96 "SIGNALS_Epm_nEng" 97 "SIGNALS_Epm_stOpMode" 98 "SIGNALS_Epm_stSync" 99 "SIGNALS_Exh_pAdapPPFltDiff" 100 "SIGNALS_Exh_pPFltUs" 101 "SIGNALS_Exh_tOxiCatUs" 102 "SIGNALS_Exh_tPFltUs" 103 "SIGNALS_Exh_uRawPPFltUs" 104 "SIGNALS_Exh_uRawTOxiCatUs" 105 "SIGNALS_Exh_uRawTPFltUs" 106 "SIGNALS_FBC_qDvtCylPhys_01" 107 "SIGNALS_FBC_qDvtCylPhys_02" 108 "SIGNALS_FBC_qDvtCylPhys_03" 109 "SIGNALS_FBC_qDvtCylPhys_04" 110 "SIGNALS_FBC_qDvtCylPhys_05" 111 "SIGNALS_FBC_qDvtCylPhys_06" 112 "SIGNALS_FBC_qDvtCylPhys_07" 113 "SIGNALS_FBC_qDvtCylPhys_08" 114 "SIGNALS_FBC_qDvtCylPhys_09" 115 "SIGNALS_FBC_qDvtCylPhys_10" 116 "SIGNALS_Fan_rPs" 117 "SIGNALS_FlFlt_stRaw" 118 "SIGNALS_FuelT_t" 119 "SIGNALS_FuelT_uRaw" 120 "SIGNALS_GlwPlg_numPwrOut" 121 "SIGNALS_ISC_nSetPLo" 122 "SIGNALS_ISC_trq" 123 "SIGNALS_I_batt" 124 "SIGNALS_InjCtl_qCurr" 125 "SIGNALS_InjCtl_qSetUnBal" 126 "SIGNALS_LSU_rO2Adap[0]" 127 "SIGNALS_MeUn_rPs_mp" 128 "SIGNALS_MoFInjDat_tiTDCAvrg" 129 "SIGNALS_OilPLmp_st" 130 "SIGNALS_Oil_tSwmp" 131 "SIGNALS_Oz_oelkm" 132 "SIGNALS_PCR_pDesVal" 133 "SIGNALS_PCV_rPs_mp" 134 "SIGNALS_PFltLd_mOilAshEG_mp" 135 "SIGNALS_PFltLd_mSot" 136 "SIGNALS_PFltLd_mSotSim" 137 "SIGNALS_PFltRgn_qFl_mp" 138 "SIGNALS_PFltRgn_stIntr" 139 "SIGNALS_PFltRgn_stLck" 140 "SIGNALS_PID41h" 141 "SIGNALS_PSP_dvolOut" 142 "SIGNALS_PthSet_trqInrSet" 143 "SIGNALS_RailP_pFlt" 144 "SIGNALS_RailP_uRaw" 145 "SIGNALS_Rail_pSetPoint" 146 "SIGNALS_Stat_sv_reg" 147 "SIGNALS_T2hist" 148 "SIGNALS_T3hist" 149 "SIGNALS_T4hist" 150 "SIGNALS_T_batt" 151 "SIGNALS_ThrVlv_rPs" 152 "SIGNALS_Tn_abstell" 153 "SIGNALS_Toel" 154 "SIGNALS_TrbCh_r" 155 "SIGNALS_TrbCh_rPs" 156 "SIGNALS_U_batt" 157 "SIGNALS_U_gen" 158 "SIGNALS_VSwVlv_rPs" 159 "SIGNALS_VehV_v" 160 "SIGNALS_VehV_vSens" 161 "SIGNALS_WaHtEl_rPs" /end COMPU_VTAB
/begin RECORD_LAYOUT ValA_Wu16 FNC_VALUES 1 UWORD COLUMN_DIR DIRECT /end RECORD_LAYOUT
/begin RECORD_LAYOUT ValA_Wu8 FNC_VALUES 1 UBYTE COLUMN_DIR DIRECT /end RECORD_LAYOUT
/begin RECORD_LAYOUT Val_Wu16 FNC_VALUES 1 UWORD COLUMN_DIR DIRECT /end RECORD_LAYOUT
/end MODULE
/end PROJECT
