ASAP2_VERSION 1 3
/begin PROJECT P383 "BMW DDE6.3 8-Zylinder V9E.3 11.10.2004 CAN12H"
/begin HEADER "" VERSION "V9E.3_8Z_CAN12H" PROJECT_NO P383 /end HEADER
/begin MODULE DIM ""
/begin MOD_COMMON "" BYTE_ORDER MSB_FIRST ALIGNMENT_BYTE 1 ALIGNMENT_WORD 2 ALIGNMENT_LONG 4 ALIGNMENT_FLOAT32_IEEE 4 /end MOD_COMMON
/begin CHARACTERISTIC DSM_EnvDfp_Layer_TANS_C "Fehlerpfad spezifische Umweltbedingungen fuer Fehlerpfad Dfp_Layer_TANS" VAL_BLK 0xCD6D0 Kwb_Wu8 255.000000000 SigName 0.00 255.000000000 FORMAT "%13.9" NUMBER 10 /end CHARACTERISTIC
/begin CHARACTERISTIC DSM_EnvDfp_ACCDSwtin_C "Fehlerpfad spezifische Umweltbedingungen fuer Fehlerpfad Dfp_ACCDSwtin" VAL_BLK 0xCD6DA Kwb_Wu8 255.000000000 SigName 0.00 255.000000000 FORMAT "%13.9" NUMBER 10 /end CHARACTERISTIC
/begin CHARACTERISTIC DSM_EnvDfp_ACC_PlausTrqDes_C "Fehlerpfad spezifische Umweltbedingungen fuer Fehlerpfad Dfp_ACC_PlausTrqDes" VAL_BLK 0xCD6E4 Kwb_Wu8 255.000000000 SigName 0.00 255.000000000 FORMAT "%13.9" NUMBER 10 /end CHARACTERISTIC
/begin CHARACTERISTIC DSM_EnvDfp_ACC_trqInr_C "Fehlerpfad spezifische Umweltbedingungen fuer Fehlerpfad Dfp_ACC_trqInr" VAL_BLK 0xCD6EE Kwb_Wu8 255.000000000 SigName 0.00 255.000000000 FORMAT "%13.9" NUMBER 10 /end CHARACTERISTIC
/begin CHARACTERISTIC DSM_EnvDfp_ACTrq_C "Fehlerpfad spezifische Umweltbedingungen fuer Fehlerpfad Dfp_ACTrq" VAL_BLK 0xCD6F8 Kwb_Wu8 255.000000000 SigName 0.00 255.000000000 FORMAT "%13.9" NUMBER 10 /end CHARACTERISTIC
/begin CHARACTERISTIC DSM_EnvDfp_ADCMon_C "Fehlerpfad spezifische Umweltbedingungen fuer Fehlerpfad Dfp_ADCMon" VAL_BLK 0xCD702 Kwb_Wu8 255.000000000 SigName 0.00 255.000000000 FORMAT "%13.9" NUMBER 10 /end CHARACTERISTIC
/begin CHARACTERISTIC DSM_EnvDfp_AFSCDIdlAdjVal_C "Fehlerpfad spezifische Umweltbedingungen fuer Fehlerpfad Dfp_AFSCDIdlAdjVal" VAL_BLK 0xCD70C Kwb_Wu8 255.000000000 SigName 0.00 255.000000000 FORMAT "%13.9" NUMBER 10 /end CHARACTERISTIC
/begin CHARACTERISTIC DSM_EnvDfp_AFSCDLdAdjVal_C "Fehlerpfad spezifische Umweltbedingungen fuer Fehlerpfad Dfp_AFSCDLdAdjVal" VAL_BLK 0xCD716 Kwb_Wu8 255.000000000 SigName 0.00 255.000000000 FORMAT "%13.9" NUMBER 10 /end CHARACTERISTIC
/begin CHARACTERISTIC DSM_EnvDfp_AFSCDPlAirPerCylDif_C "Fehlerpfad spezifische Umweltbedingungen fuer Fehlerpfad Dfp_AFSCDPlAirPerCylDif" VAL_BLK 0xCD720 Kwb_Wu8 255.000000000 SigName 0.00 255.000000000 FORMAT "%13.9" NUMBER 10 /end CHARACTERISTIC
/begin CHARACTERISTIC DSM_EnvDfp_AFSCD_AirTempDcyc_C "Fehlerpfad spezifische Umweltbedingungen fuer Fehlerpfad Dfp_AFSCD_AirTempDcyc" VAL_BLK 0xCD72A Kwb_Wu8 255.000000000 SigName 0.00 255.000000000 FORMAT "%13.9" NUMBER 10 /end CHARACTERISTIC
/begin CHARACTERISTIC DSM_EnvDfp_AFSCD_AirTempDcyc2_C "Fehlerpfad spezifische Umweltbedingungen fuer Fehlerpfad Dfp_AFSCD_AirTempDcyc2" VAL_BLK 0xCD734 Kwb_Wu8 255.000000000 SigName 0.00 255.000000000 FORMAT "%13.9" NUMBER 10 /end CHARACTERISTIC
/begin CHARACTERISTIC DSM_EnvDfp_AFSCD_PlOffsDrft_C "Fehlerpfad spezifische Umweltbedingungen fuer Fehlerpfad Dfp_AFSCD_PlOffsDrft" VAL_BLK 0xCD73E Kwb_Wu8 255.000000000 SigName 0.00 255.000000000 FORMAT "%13.9" NUMBER 10 /end CHARACTERISTIC
/begin CHARACTERISTIC DSM_EnvDfp_AFSCD_PlOffsDrft2_C "Fehlerpfad spezifische Umweltbedingungen fuer Fehlerpfad Dfp_AFSCD_PlOffsDrft2" VAL_BLK 0xCD748 Kwb_Wu8 255.000000000 SigName 0.00 255.000000000 FORMAT "%13.9" NUMBER 10 /end CHARACTERISTIC
/begin CHARACTERISTIC DSM_EnvDfp_AFSCD_PlSetyDrft_C "Fehlerpfad spezifische Umweltbedingungen fuer Fehlerpfad Dfp_AFSCD_PlSetyDrft" VAL_BLK 0xCD752 Kwb_Wu8 255.000000000 SigName 0.00 255.000000000 FORMAT "%13.9" NUMBER 10 /end CHARACTERISTIC
/begin CHARACTERISTIC DSM_EnvDfp_AFSCD_SRCAirTemp_C "Fehlerpfad spezifische Umweltbedingungen fuer Fehlerpfad Dfp_AFSCD_SRCAirTemp" VAL_BLK 0xCD75C Kwb_Wu8 255.000000000 SigName 0.00 255.000000000 FORMAT "%13.9" NUMBER 10 /end CHARACTERISTIC
/begin CHARACTERISTIC DSM_EnvDfp_AFSCD_SRCAirTemp2_C "Fehlerpfad spezifische Umweltbedingungen fuer Fehlerpfad Dfp_AFSCD_SRCAirTemp2" VAL_BLK 0xCD766 Kwb_Wu8 255.000000000 SigName 0.00 255.000000000 FORMAT "%13.9" NUMBER 10 /end CHARACTERISTIC
/begin CHARACTERISTIC DSM_EnvDfp_AFSCD_SRCBatt_C "Fehlerpfad spezifische Umweltbedingungen fuer Fehlerpfad Dfp_AFSCD_SRCBatt" VAL_BLK 0xCD770 Kwb_Wu8 255.000000000 SigName 0.00 255.000000000 FORMAT "%13.9" NUMBER 10 /end CHARACTERISTIC
/begin CHARACTERISTIC DSM_EnvDfp_AFSCD_SRCBatt2_C "Fehlerpfad spezifische Umweltbedingungen fuer Fehlerpfad Dfp_AFSCD_SRCBatt2" VAL_BLK 0xCD77A Kwb_Wu8 255.000000000 SigName 0.00 255.000000000 FORMAT "%13.9" NUMBER 10 /end CHARACTERISTIC
/begin CHARACTERISTIC DSM_EnvDfp_AFSCD_SRCCorrAirm_C "Fehlerpfad spezifische Umweltbedingungen fuer Fehlerpfad Dfp_AFSCD_SRCCorrAirm" VAL_BLK 0xCD784 Kwb_Wu8 255.000000000 SigName 0.00 255.000000000 FORMAT "%13.9" NUMBER 10 /end CHARACTERISTIC
/begin CHARACTERISTIC DSM_EnvDfp_Layer_TUMG_C "Fehlerpfad spezifische Umweltbedingungen fuer Fehlerpfad Dfp_Layer_TUMG" VAL_BLK 0xCD78E Kwb_Wu8 255.000000000 SigName 0.00 255.000000000 FORMAT "%13.9" NUMBER 10 /end CHARACTERISTIC
/begin CHARACTERISTIC DSM_EnvDfp_AFSCD_SRCCorrAirm2_C "Fehlerpfad spezifische Umweltbedingungen fuer Fehlerpfad Dfp_AFSCD_SRCCorrAirm2" VAL_BLK 0xCD798 Kwb_Wu8 255.000000000 SigName 0.00 255.000000000 FORMAT "%13.9" NUMBER 10 /end CHARACTERISTIC
/begin CHARACTERISTIC DSM_EnvDfp_AFSCD_SRCRawAirm_C "Fehlerpfad spezifische Umweltbedingungen fuer Fehlerpfad Dfp_AFSCD_SRCRawAirm" VAL_BLK 0xCD7A2 Kwb_Wu8 255.000000000 SigName 0.00 255.000000000 FORMAT "%13.9" NUMBER 10 /end CHARACTERISTIC
/begin CHARACTERISTIC DSM_EnvDfp_Layer_GEN_C "Fehlerpfad spezifische Umweltbedingungen fuer Fehlerpfad Dfp_Layer_GEN" VAL_BLK 0xCD7AC Kwb_Wu8 255.000000000 SigName 0.00 255.000000000 FORMAT "%13.9" NUMBER 10 /end CHARACTERISTIC
/begin CHARACTERISTIC DSM_EnvDfp_Layer_BSD_C "Fehlerpfad spezifische Umweltbedingungen fuer Fehlerpfad Dfp_Layer_BSD" VAL_BLK 0xCD7B6 Kwb_Wu8 255.000000000 SigName 0.00 255.000000000 FORMAT "%13.9" NUMBER 10 /end CHARACTERISTIC
/begin CHARACTERISTIC DSM_EnvDfp_AFSCD_SRCRawAirm2_C "Fehlerpfad spezifische Umweltbedingungen fuer Fehlerpfad Dfp_AFSCD_SRCRawAirm2" VAL_BLK 0xCD7C0 Kwb_Wu8 255.000000000 SigName 0.00 255.000000000 FORMAT "%13.9" NUMBER 10 /end CHARACTERISTIC
/begin CHARACTERISTIC DSM_EnvDfp_AFSCD_SRCRefSigPer_C "Fehlerpfad spezifische Umweltbedingungen fuer Fehlerpfad Dfp_AFSCD_SRCRefSigPer" VAL_BLK 0xCD7CA Kwb_Wu8 255.000000000 SigName 0.00 255.000000000 FORMAT "%13.9" NUMBER 10 /end CHARACTERISTIC
/begin CHARACTERISTIC DSM_EnvDfp_AFSCD_SRCRefSigPer2_C "Fehlerpfad spezifische Umweltbedingungen fuer Fehlerpfad Dfp_AFSCD_SRCRefSigPer2" VAL_BLK 0xCD7D4 Kwb_Wu8 255.000000000 SigName 0.00 255.000000000 FORMAT "%13.9" NUMBER 10 /end CHARACTERISTIC
/begin CHARACTERISTIC DSM_EnvDfp_AOHtCD_C "Fehlerpfad spezifische Umweltbedingungen fuer Fehlerpfad Dfp_AOHtCD" VAL_BLK 0xCD7DE Kwb_Wu8 255.000000000 SigName 0.00 255.000000000 FORMAT "%13.9" NUMBER 10 /end CHARACTERISTIC
/begin CHARACTERISTIC DSM_EnvDfp_AOHtCD_AOHtDia1_C "Fehlerpfad spezifische Umweltbedingungen fuer Fehlerpfad Dfp_AOHtCD_AOHtDia1" VAL_BLK 0xCD7E8 Kwb_Wu8 255.000000000 SigName 0.00 255.000000000 FORMAT "%13.9" NUMBER 10 /end CHARACTERISTIC
/begin CHARACTERISTIC DSM_EnvDfp_AOHtCD_AOHtDia2_C "Fehlerpfad spezifische Umweltbedingungen fuer Fehlerpfad Dfp_AOHtCD_AOHtDia2" VAL_BLK 0xCD7F2 Kwb_Wu8 255.000000000 SigName 0.00 255.000000000 FORMAT "%13.9" NUMBER 10 /end CHARACTERISTIC
/begin CHARACTERISTIC DSM_EnvDfp_AOHtCD_AOHtDia3_C "Fehlerpfad spezifische Umweltbedingungen fuer Fehlerpfad Dfp_AOHtCD_AOHtDia3" VAL_BLK 0xCD7FC Kwb_Wu8 255.000000000 SigName 0.00 255.000000000 FORMAT "%13.9" NUMBER 10 /end CHARACTERISTIC
/begin CHARACTERISTIC DSM_EnvDfp_APP1_C "Fehlerpfad spezifische Umweltbedingungen fuer Fehlerpfad Dfp_APP1" VAL_BLK 0xCD806 Kwb_Wu8 255.000000000 SigName 0.00 255.000000000 FORMAT "%13.9" NUMBER 10 /end CHARACTERISTIC
/begin CHARACTERISTIC DSM_EnvDfp_APP2_C "Fehlerpfad spezifische Umweltbedingungen fuer Fehlerpfad Dfp_APP2" VAL_BLK 0xCD810 Kwb_Wu8 255.000000000 SigName 0.00 255.000000000 FORMAT "%13.9" NUMBER 10 /end CHARACTERISTIC
/begin CHARACTERISTIC DSM_EnvDfp_APPCDCmpd_C "Fehlerpfad spezifische Umweltbedingungen fuer Fehlerpfad Dfp_APPCDCmpd" VAL_BLK 0xCD81A Kwb_Wu8 255.000000000 SigName 0.00 255.000000000 FORMAT "%13.9" NUMBER 10 /end CHARACTERISTIC
/begin CHARACTERISTIC DSM_EnvDfp_Layer_QLT_C "Fehlerpfad spezifische Umweltbedingungen fuer Fehlerpfad Dfp_Layer_QLT" VAL_BLK 0xCD824 Kwb_Wu8 255.000000000 SigName 0.00 255.000000000 FORMAT "%13.9" NUMBER 10 /end CHARACTERISTIC
/begin CHARACTERISTIC DSM_EnvDfp_APPSync_C "Fehlerpfad spezifische Umweltbedingungen fuer Fehlerpfad Dfp_APPSync" VAL_BLK 0xCD82E Kwb_Wu8 255.000000000 SigName 0.00 255.000000000 FORMAT "%13.9" NUMBER 10 /end CHARACTERISTIC
/begin CHARACTERISTIC DSM_EnvDfp_Layer_IBS1_C "Fehlerpfad spezifische Umweltbedingungen fuer Fehlerpfad Dfp_Layer_IBS1" VAL_BLK 0xCD838 Kwb_Wu8 255.000000000 SigName 0.00 255.000000000 FORMAT "%13.9" NUMBER 10 /end CHARACTERISTIC
/begin CHARACTERISTIC DSM_EnvDfp_Layer_IBS2_C "Fehlerpfad spezifische Umweltbedingungen fuer Fehlerpfad Dfp_Layer_IBS2" VAL_BLK 0xCD842 Kwb_Wu8 255.000000000 SigName 0.00 255.000000000 FORMAT "%13.9" NUMBER 10 /end CHARACTERISTIC
/begin CHARACTERISTIC DSM_EnvDfp_Layer_IBS3_C "Fehlerpfad spezifische Umweltbedingungen fuer Fehlerpfad Dfp_Layer_IBS3" VAL_BLK 0xCD84C Kwb_Wu8 255.000000000 SigName 0.00 255.000000000 FORMAT "%13.9" NUMBER 10 /end CHARACTERISTIC
/begin CHARACTERISTIC DSM_EnvDfp_Layer_PMBN_C "Fehlerpfad spezifische Umweltbedingungen fuer Fehlerpfad Dfp_Layer_PMBN" VAL_BLK 0xCD856 Kwb_Wu8 255.000000000 SigName 0.00 255.000000000 FORMAT "%13.9" NUMBER 10 /end CHARACTERISTIC
/begin CHARACTERISTIC DSM_EnvDfp_Layer_PMBATT_C "Fehlerpfad spezifische Umweltbedingungen fuer Fehlerpfad Dfp_Layer_PMBATT" VAL_BLK 0xCD860 Kwb_Wu8 255.000000000 SigName 0.00 255.000000000 FORMAT "%13.9" NUMBER 10 /end CHARACTERISTIC
/begin CHARACTERISTIC DSM_EnvDfp_APSCD_C "Fehlerpfad spezifische Umweltbedingungen fuer Fehlerpfad Dfp_APSCD" VAL_BLK 0xCD86A Kwb_Wu8 255.000000000 SigName 0.00 255.000000000 FORMAT "%13.9" NUMBER 10 /end CHARACTERISTIC
/begin CHARACTERISTIC DSM_EnvDfp_ARS_C "Fehlerpfad spezifische Umweltbedingungen fuer Fehlerpfad Dfp_ARS" VAL_BLK 0xCD874 Kwb_Wu8 255.000000000 SigName 0.00 255.000000000 FORMAT "%13.9" NUMBER 10 /end CHARACTERISTIC
/begin CHARACTERISTIC DSM_EnvDfp_AccPedPlausBrk_C "Fehlerpfad spezifische Umweltbedingungen fuer Fehlerpfad Dfp_AccPedPlausBrk" VAL_BLK 0xCD87E Kwb_Wu8 255.000000000 SigName 0.00 255.000000000 FORMAT "%13.9" NUMBER 10 /end CHARACTERISTIC
/begin CHARACTERISTIC DSM_EnvDfp_AddPCDTnkLvl_C "Fehlerpfad spezifische Umweltbedingungen fuer Fehlerpfad Dfp_AddPCDTnkLvl" VAL_BLK 0xCD888 Kwb_Wu8 255.000000000 SigName 0.00 255.000000000 FORMAT "%13.9" NUMBER 10 /end CHARACTERISTIC
/begin CHARACTERISTIC DSM_EnvDfp_AirCtlGvnrDvtRgnMax_C "Fehlerpfad spezifische Umweltbedingungen fuer Fehlerpfad Dfp_AirCtlGvnrDvtRgnMax" VAL_BLK 0xCD892 Kwb_Wu8 255.000000000 SigName 0.00 255.000000000 FORMAT "%13.9" NUMBER 10 /end CHARACTERISTIC
/begin CHARACTERISTIC DSM_EnvDfp_AirCtlGvnrDvtRgnMin_C "Fehlerpfad spezifische Umweltbedingungen fuer Fehlerpfad Dfp_AirCtlGvnrDvtRgnMin" VAL_BLK 0xCD89C Kwb_Wu8 255.000000000 SigName 0.00 255.000000000 FORMAT "%13.9" NUMBER 10 /end CHARACTERISTIC
/begin CHARACTERISTIC DSM_EnvDfp_AirCtlGvnrDvtRgnMn2_C "Fehlerpfad spezifische Umweltbedingungen fuer Fehlerpfad Dfp_AirCtlGvnrDvtRgnMn2" VAL_BLK 0xCD8A6 Kwb_Wu8 255.000000000 SigName 0.00 255.000000000 FORMAT "%13.9" NUMBER 10 /end CHARACTERISTIC
/begin CHARACTERISTIC DSM_EnvDfp_AirCtlGvnrDvtRgnMx2_C "Fehlerpfad spezifische Umweltbedingungen fuer Fehlerpfad Dfp_AirCtlGvnrDvtRgnMx2" VAL_BLK 0xCD8B0 Kwb_Wu8 255.000000000 SigName 0.00 255.000000000 FORMAT "%13.9" NUMBER 10 /end CHARACTERISTIC
/begin CHARACTERISTIC DSM_EnvDfp_AirCtlPlateBreak_C "DSM variable for Dfp_AirCtlPlateBreak_mp" VAL_BLK 0xCD8BA Kwb_Wu8 255.000000000 SigName 0.00 255.000000000 FORMAT "%13.9" NUMBER 10 /end CHARACTERISTIC
/begin CHARACTERISTIC DSM_EnvDfp_AirCtlRmpTO_C "Fehlerpfad spezifische Umweltbedingungen fuer Fehlerpfad Dfp_AirCtlRmpTO" VAL_BLK 0xCD8C4 Kwb_Wu8 255.000000000 SigName 0.00 255.000000000 FORMAT "%13.9" NUMBER 10 /end CHARACTERISTIC
/begin CHARACTERISTIC DSM_EnvDfp_AirCtl_GovNegDev_C "Fehlerpfad spezifische Umweltbedingungen fuer Fehlerpfad Dfp_AirCtl_GovNegDev" VAL_BLK 0xCD8CE Kwb_Wu8 255.000000000 SigName 0.00 255.000000000 FORMAT "%13.9" NUMBER 10 /end CHARACTERISTIC
/begin CHARACTERISTIC DSM_EnvDfp_AirCtl_GovNegDev2_C "Fehlerpfad spezifische Umweltbedingungen fuer Fehlerpfad Dfp_AirCtl_GovNegDev2" VAL_BLK 0xCD8D8 Kwb_Wu8 255.000000000 SigName 0.00 255.000000000 FORMAT "%13.9" NUMBER 10 /end CHARACTERISTIC
/begin CHARACTERISTIC DSM_EnvDfp_AirCtl_GovPosDev_C "Fehlerpfad spezifische Umweltbedingungen fuer Fehlerpfad Dfp_AirCtl_GovPosDev" VAL_BLK 0xCD8E2 Kwb_Wu8 255.000000000 SigName 0.00 255.000000000 FORMAT "%13.9" NUMBER 10 /end CHARACTERISTIC
/begin CHARACTERISTIC DSM_EnvDfp_AirCtl_GovPosDev2_C "Fehlerpfad spezifische Umweltbedingungen fuer Fehlerpfad Dfp_AirCtl_GovPosDev2" VAL_BLK 0xCD8EC Kwb_Wu8 255.000000000 SigName 0.00 255.000000000 FORMAT "%13.9" NUMBER 10 /end CHARACTERISTIC
/begin CHARACTERISTIC DSM_EnvDfp_AltCD_C "Fehlerpfad spezifische Umweltbedingungen fuer Fehlerpfad Dfp_AltCD" VAL_BLK 0xCD8F6 Kwb_Wu8 255.000000000 SigName 0.00 255.000000000 FORMAT "%13.9" NUMBER 10 /end CHARACTERISTIC
/begin CHARACTERISTIC DSM_EnvDfp_BPACD_BPADia1_C "Fehlerpfad spezifische Umweltbedingungen fuer Fehlerpfad Dfp_BPACD_BPADia1" VAL_BLK 0xCD900 Kwb_Wu8 255.000000000 SigName 0.00 255.000000000 FORMAT "%13.9" NUMBER 10 /end CHARACTERISTIC
/begin CHARACTERISTIC DSM_EnvDfp_BPACD_BPADia1v2_C "Fehlerpfad spezifische Umweltbedingungen fuer Fehlerpfad Dfp_BPACD_BPADia1v2" VAL_BLK 0xCD90A Kwb_Wu8 255.000000000 SigName 0.00 255.000000000 FORMAT "%13.9" NUMBER 10 /end CHARACTERISTIC
/begin CHARACTERISTIC DSM_EnvDfp_BPACD_BPADia2_C "Fehlerpfad spezifische Umweltbedingungen fuer Fehlerpfad Dfp_BPACD_BPADia2" VAL_BLK 0xCD914 Kwb_Wu8 255.000000000 SigName 0.00 255.000000000 FORMAT "%13.9" NUMBER 10 /end CHARACTERISTIC
/begin CHARACTERISTIC DSM_EnvDfp_BPACD_BPADia2v2_C "Fehlerpfad spezifische Umweltbedingungen fuer Fehlerpfad Dfp_BPACD_BPADia2v2" VAL_BLK 0xCD91E Kwb_Wu8 255.000000000 SigName 0.00 255.000000000 FORMAT "%13.9" NUMBER 10 /end CHARACTERISTIC
/begin CHARACTERISTIC DSM_EnvDfp_BPACD_BPADia3_C "Fehlerpfad spezifische Umweltbedingungen fuer Fehlerpfad Dfp_BPACD_BPADia3" VAL_BLK 0xCD928 Kwb_Wu8 255.000000000 SigName 0.00 255.000000000 FORMAT "%13.9" NUMBER 10 /end CHARACTERISTIC
/begin CHARACTERISTIC DSM_EnvDfp_BPACD_BPADia3v2_C "Fehlerpfad spezifische Umweltbedingungen fuer Fehlerpfad Dfp_BPACD_BPADia3v2" VAL_BLK 0xCD932 Kwb_Wu8 255.000000000 SigName 0.00 255.000000000 FORMAT "%13.9" NUMBER 10 /end CHARACTERISTIC
/begin CHARACTERISTIC DSM_EnvDfp_BPACD_BPADia4_C "Fehlerpfad spezifische Umweltbedingungen fuer Fehlerpfad Dfp_BPACD_BPADia4" VAL_BLK 0xCD93C Kwb_Wu8 255.000000000 SigName 0.00 255.000000000 FORMAT "%13.9" NUMBER 10 /end CHARACTERISTIC
/begin CHARACTERISTIC DSM_EnvDfp_BPACD_BPADia4v2_C "Fehlerpfad spezifische Umweltbedingungen fuer Fehlerpfad Dfp_BPACD_BPADia4v2" VAL_BLK 0xCD946 Kwb_Wu8 255.000000000 SigName 0.00 255.000000000 FORMAT "%13.9" NUMBER 10 /end CHARACTERISTIC
/begin CHARACTERISTIC DSM_EnvDfp_BPACD_Max_C "Fehlerpfad spezifische Umweltbedingungen fuer Fehlerpfad Dfp_BPACD_Max" VAL_BLK 0xCD950 Kwb_Wu8 255.000000000 SigName 0.00 255.000000000 FORMAT "%13.9" NUMBER 10 /end CHARACTERISTIC
/begin CHARACTERISTIC DSM_EnvDfp_BPACD_Max2_C "Fehlerpfad spezifische Umweltbedingungen fuer Fehlerpfad Dfp_BPACD_Max2" VAL_BLK 0xCD95A Kwb_Wu8 255.000000000 SigName 0.00 255.000000000 FORMAT "%13.9" NUMBER 10 /end CHARACTERISTIC
/begin CHARACTERISTIC DSM_EnvDfp_BPACD_Min_C "Fehlerpfad spezifische Umweltbedingungen fuer Fehlerpfad Dfp_BPACD_Min" VAL_BLK 0xCD964 Kwb_Wu8 255.000000000 SigName 0.00 255.000000000 FORMAT "%13.9" NUMBER 10 /end CHARACTERISTIC
/begin CHARACTERISTIC DSM_EnvDfp_BPACD_Min2_C "Fehlerpfad spezifische Umweltbedingungen fuer Fehlerpfad Dfp_BPACD_Min2" VAL_BLK 0xCD96E Kwb_Wu8 255.000000000 SigName 0.00 255.000000000 FORMAT "%13.9" NUMBER 10 /end CHARACTERISTIC
/begin CHARACTERISTIC DSM_EnvDfp_BPACD_SigNpl_C "Fehlerpfad spezifische Umweltbedingungen fuer Fehlerpfad Dfp_BPACD_SigNpl" VAL_BLK 0xCD978 Kwb_Wu8 255.000000000 SigName 0.00 255.000000000 FORMAT "%13.9" NUMBER 10 /end CHARACTERISTIC
/begin CHARACTERISTIC DSM_EnvDfp_BPACD_SigNpl2_C "Fehlerpfad spezifische Umweltbedingungen fuer Fehlerpfad Dfp_BPACD_SigNpl2" VAL_BLK 0xCD982 Kwb_Wu8 255.000000000 SigName 0.00 255.000000000 FORMAT "%13.9" NUMBER 10 /end CHARACTERISTIC
/begin CHARACTERISTIC DSM_EnvDfp_BPSCD_C "Fehlerpfad spezifische Umweltbedingungen fuer Fehlerpfad Dfp_BPSCD" VAL_BLK 0xCD98C Kwb_Wu8 255.000000000 SigName 0.00 255.000000000 FORMAT "%13.9" NUMBER 10 /end CHARACTERISTIC
/begin CHARACTERISTIC DSM_EnvDfp_BattCD_C "Fehlerpfad spezifische Umweltbedingungen fuer Fehlerpfad Dfp_BattCD" VAL_BLK 0xCD996 Kwb_Wu8 255.000000000 SigName 0.00 255.000000000 FORMAT "%13.9" NUMBER 10 /end CHARACTERISTIC
/begin CHARACTERISTIC DSM_EnvDfp_BrkCD_C "Fehlerpfad spezifische Umweltbedingungen fuer Fehlerpfad Dfp_BrkCD" VAL_BLK 0xCD9A0 Kwb_Wu8 255.000000000 SigName 0.00 255.000000000 FORMAT "%13.9" NUMBER 10 /end CHARACTERISTIC
/begin CHARACTERISTIC DSM_EnvDfp_Layer_PMRUHVERL_C "Fehlerpfad spezifische Umweltbedingungen fuer Fehlerpfad Dfp_Layer_PMRUHVERL" VAL_BLK 0xCD9AA Kwb_Wu8 255.000000000 SigName 0.00 255.000000000 FORMAT "%13.9" NUMBER 10 /end CHARACTERISTIC
/begin CHARACTERISTIC DSM_EnvDfp_Bss_C "Fehlerpfad spezifische Umweltbedingungen fuer Fehlerpfad Dfp_Bss" VAL_BLK 0xCD9B4 Kwb_Wu8 255.000000000 SigName 0.00 255.000000000 FORMAT "%13.9" NUMBER 10 /end CHARACTERISTIC
/begin CHARACTERISTIC DSM_EnvDfp_CBACD_C "Fehlerpfad spezifische Umweltbedingungen fuer Fehlerpfad Dfp_CBACD" VAL_BLK 0xCD9BE Kwb_Wu8 255.000000000 SigName 0.00 255.000000000 FORMAT "%13.9" NUMBER 10 /end CHARACTERISTIC
/begin CHARACTERISTIC DSM_EnvDfp_CTSCD_C "Fehlerpfad spezifische Umweltbedingungen fuer Fehlerpfad Dfp_CTSCD" VAL_BLK 0xCD9C8 Kwb_Wu8 255.000000000 SigName 0.00 255.000000000 FORMAT "%13.9" NUMBER 10 /end CHARACTERISTIC
/begin CHARACTERISTIC DSM_EnvDfp_Clg_DynTst_C "Fehlerpfad spezifische Umweltbedingungen fuer Fehlerpfad Dfp_Clg_DynTst" VAL_BLK 0xCD9D2 Kwb_Wu8 255.000000000 SigName 0.00 255.000000000 FORMAT "%13.9" NUMBER 10 /end CHARACTERISTIC
/begin CHARACTERISTIC DSM_EnvDfp_Layer_TOENS_C "Fehlerpfad spezifische Umweltbedingungen fuer Fehlerpfad Dfp_Layer_TOENS" VAL_BLK 0xCD9DC Kwb_Wu8 255.000000000 SigName 0.00 255.000000000 FORMAT "%13.9" NUMBER 10 /end CHARACTERISTIC
/begin CHARACTERISTIC DSM_EnvDfp_Layer_MANHYDR_C "Fehlerpfad spezifische Umweltbedingungen fuer Fehlerpfad Dfp_Layer_MANHYDR" VAL_BLK 0xCD9E6 Kwb_Wu8 255.000000000 SigName 0.00 255.000000000 FORMAT "%13.9" NUMBER 10 /end CHARACTERISTIC
/begin CHARACTERISTIC DSM_EnvDfp_Layer_MANLUFT_C "Fehlerpfad spezifische Umweltbedingungen fuer Fehlerpfad Dfp_Layer_MANLUFT" VAL_BLK 0xCD9F0 Kwb_Wu8 255.000000000 SigName 0.00 255.000000000 FORMAT "%13.9" NUMBER 10 /end CHARACTERISTIC
/begin CHARACTERISTIC DSM_EnvDfp_CmbChbMisfire1_C "Fehlerpfad spezifische Umweltbedingungen fuer Fehlerpfad Dfp_CmbChbMisfire1" VAL_BLK 0xCD9FA Kwb_Wu8 255.000000000 SigName 0.00 255.000000000 FORMAT "%13.9" NUMBER 10 /end CHARACTERISTIC
/begin CHARACTERISTIC DSM_EnvDfp_CmbChbMisfire2_C "Fehlerpfad spezifische Umweltbedingungen fuer Fehlerpfad Dfp_CmbChbMisfire2" VAL_BLK 0xCDA04 Kwb_Wu8 255.000000000 SigName 0.00 255.000000000 FORMAT "%13.9" NUMBER 10 /end CHARACTERISTIC
/begin CHARACTERISTIC DSM_EnvDfp_CmbChbMisfire3_C "Fehlerpfad spezifische Umweltbedingungen fuer Fehlerpfad Dfp_CmbChbMisfire3" VAL_BLK 0xCDA0E Kwb_Wu8 255.000000000 SigName 0.00 255.000000000 FORMAT "%13.9" NUMBER 10 /end CHARACTERISTIC
/begin CHARACTERISTIC DSM_EnvDfp_CmbChbMisfire4_C "Fehlerpfad spezifische Umweltbedingungen fuer Fehlerpfad Dfp_CmbChbMisfire4" VAL_BLK 0xCDA18 Kwb_Wu8 255.000000000 SigName 0.00 255.000000000 FORMAT "%13.9" NUMBER 10 /end CHARACTERISTIC
/begin CHARACTERISTIC DSM_EnvDfp_CmbChbMisfire5_C "Fehlerpfad spezifische Umweltbedingungen fuer Fehlerpfad Dfp_CmbChbMisfire5" VAL_BLK 0xCDA22 Kwb_Wu8 255.000000000 SigName 0.00 255.000000000 FORMAT "%13.9" NUMBER 10 /end CHARACTERISTIC
/begin CHARACTERISTIC DSM_EnvDfp_CmbChbMisfire6_C "Fehlerpfad spezifische Umweltbedingungen fuer Fehlerpfad Dfp_CmbChbMisfire6" VAL_BLK 0xCDA2C Kwb_Wu8 255.000000000 SigName 0.00 255.000000000 FORMAT "%13.9" NUMBER 10 /end CHARACTERISTIC
/begin CHARACTERISTIC DSM_EnvDfp_CmbChbMisfire7_C "Fehlerpfad spezifische Umweltbedingungen fuer Fehlerpfad Dfp_CmbChbMisfire7" VAL_BLK 0xCDA36 Kwb_Wu8 255.000000000 SigName 0.00 255.000000000 FORMAT "%13.9" NUMBER 10 /end CHARACTERISTIC
/begin CHARACTERISTIC DSM_EnvDfp_CmbChbMisfire8_C "Fehlerpfad spezifische Umweltbedingungen fuer Fehlerpfad Dfp_CmbChbMisfire8" VAL_BLK 0xCDA40 Kwb_Wu8 255.000000000 SigName 0.00 255.000000000 FORMAT "%13.9" NUMBER 10 /end CHARACTERISTIC
/begin CHARACTERISTIC DSM_EnvDfp_CmbChbMisfireMul_C "Fehlerpfad spezifische Umweltbedingungen fuer Fehlerpfad Dfp_CmbChbMisfireMul" VAL_BLK 0xCDA4A Kwb_Wu8 255.000000000 SigName 0.00 255.000000000 FORMAT "%13.9" NUMBER 10 /end CHARACTERISTIC
/begin CHARACTERISTIC DSM_EnvDfp_CoDT_TRQ_Des_C "Fehlerpfad spezifische Umweltbedingungen fuer Fehlerpfad Dfp_CoDT_TRQ_Des" VAL_BLK 0xCDA54 Kwb_Wu8 255.000000000 SigName 0.00 255.000000000 FORMAT "%13.9" NUMBER 10 /end CHARACTERISTIC
/begin CHARACTERISTIC DSM_EnvDfp_CoDT_TRQ_Lead_C "Fehlerpfad spezifische Umweltbedingungen fuer Fehlerpfad Dfp_CoDT_TRQ_Lead" VAL_BLK 0xCDA5E Kwb_Wu8 255.000000000 SigName 0.00 255.000000000 FORMAT "%13.9" NUMBER 10 /end CHARACTERISTIC
/begin CHARACTERISTIC DSM_EnvDfp_CoEng_GbxRpmRduc_C "Fehlerpfad spezifische Umweltbedingungen fuer Fehlerpfad Dfp_CoEng_GbxRpmRduc" VAL_BLK 0xCDA68 Kwb_Wu8 255.000000000 SigName 0.00 255.000000000 FORMAT "%13.9" NUMBER 10 /end CHARACTERISTIC
/begin CHARACTERISTIC DSM_EnvDfp_CoVMDCSh_C "Fehlerpfad spezifische Umweltbedingungen fuer Fehlerpfad Dfp_CoVMDCSh" VAL_BLK 0xCDA72 Kwb_Wu8 255.000000000 SigName 0.00 255.000000000 FORMAT "%13.9" NUMBER 10 /end CHARACTERISTIC
/begin CHARACTERISTIC DSM_EnvDfp_ConvCD_C "Fehlerpfad spezifische Umweltbedingungen fuer Fehlerpfad Dfp_ConvCD" VAL_BLK 0xCDA7C Kwb_Wu8 255.000000000 SigName 0.00 255.000000000 FORMAT "%13.9" NUMBER 10 /end CHARACTERISTIC
/begin CHARACTERISTIC DSM_EnvDfp_CrCCDMFL_C "Fehlerpfad spezifische Umweltbedingungen fuer Fehlerpfad Dfp_CrCCDMFL" VAL_BLK 0xCDA86 Kwb_Wu8 255.000000000 SigName 0.00 255.000000000 FORMAT "%13.9" NUMBER 10 /end CHARACTERISTIC
/begin CHARACTERISTIC DSM_EnvDfp_CrCtl_vCrCtl_C "Fehlerpfad spezifische Umweltbedingungen fuer Fehlerpfad Dfp_CrCtl_vCrCtl" VAL_BLK 0xCDA90 Kwb_Wu8 255.000000000 SigName 0.00 255.000000000 FORMAT "%13.9" NUMBER 10 /end CHARACTERISTIC
/begin CHARACTERISTIC DSM_EnvDfp_EATSCD_C "Fehlerpfad spezifische Umweltbedingungen fuer Fehlerpfad Dfp_EATSCD" VAL_BLK 0xCDA9A Kwb_Wu8 255.000000000 SigName 0.00 255.000000000 FORMAT "%13.9" NUMBER 10 /end CHARACTERISTIC
/begin CHARACTERISTIC DSM_EnvDfp_EBAFCD_C "Fehlerpfad spezifische Umweltbedingungen fuer Fehlerpfad Dfp_EBAFCD" VAL_BLK 0xCDAA4 Kwb_Wu8 255.000000000 SigName 0.00 255.000000000 FORMAT "%13.9" NUMBER 10 /end CHARACTERISTIC
/begin CHARACTERISTIC DSM_EnvDfp_EBFCD_C "Fehlerpfad spezifische Umweltbedingungen fuer Fehlerpfad Dfp_EBFCD" VAL_BLK 0xCDAAE Kwb_Wu8 255.000000000 SigName 0.00 255.000000000 FORMAT "%13.9" NUMBER 10 /end CHARACTERISTIC
/begin CHARACTERISTIC DSM_EnvDfp_EBTSCD_C "Fehlerpfad spezifische Umweltbedingungen fuer Fehlerpfad Dfp_EBTSCD" VAL_BLK 0xCDAB8 Kwb_Wu8 255.000000000 SigName 0.00 255.000000000 FORMAT "%13.9" NUMBER 10 /end CHARACTERISTIC
/begin CHARACTERISTIC DSM_EnvDfp_EBTSCD_OvrTemp_C "Fehlerpfad spezifische Umweltbedingungen fuer Fehlerpfad Dfp_EBTSCD_OvrTemp" VAL_BLK 0xCDAC2 Kwb_Wu8 255.000000000 SigName 0.00 255.000000000 FORMAT "%13.9" NUMBER 10 /end CHARACTERISTIC
/begin CHARACTERISTIC DSM_EnvDfp_EEPCDVarMng_C "Fehlerpfad spezifische Umweltbedingungen fuer Fehlerpfad Dfp_EEPCDVarMng" VAL_BLK 0xCDACC Kwb_Wu8 255.000000000 SigName 0.00 255.000000000 FORMAT "%13.9" NUMBER 10 /end CHARACTERISTIC
/begin CHARACTERISTIC DSM_EnvDfp_EGPpCD_C "Fehlerpfad spezifische Umweltbedingungen fuer Fehlerpfad Dfp_EGPpCD" VAL_BLK 0xCDAD6 Kwb_Wu8 255.000000000 SigName 0.00 255.000000000 FORMAT "%13.9" NUMBER 10 /end CHARACTERISTIC
/begin CHARACTERISTIC DSM_EnvDfp_EGRCD_Max_C "Fehlerpfad spezifische Umweltbedingungen fuer Fehlerpfad Dfp_EGRCD_Max" VAL_BLK 0xCDAE0 Kwb_Wu8 255.000000000 SigName 0.00 255.000000000 FORMAT "%13.9" NUMBER 10 /end CHARACTERISTIC
/begin CHARACTERISTIC DSM_EnvDfp_EGRCD_Max2_C "Fehlerpfad spezifische Umweltbedingungen fuer Fehlerpfad Dfp_EGRCD_Max2" VAL_BLK 0xCDAEA Kwb_Wu8 255.000000000 SigName 0.00 255.000000000 FORMAT "%13.9" NUMBER 10 /end CHARACTERISTIC
/begin CHARACTERISTIC DSM_EnvDfp_EGRCD_Min_C "Fehlerpfad spezifische Umweltbedingungen fuer Fehlerpfad Dfp_EGRCD_Min" VAL_BLK 0xCDAF4 Kwb_Wu8 255.000000000 SigName 0.00 255.000000000 FORMAT "%13.9" NUMBER 10 /end CHARACTERISTIC
/begin CHARACTERISTIC DSM_EnvDfp_EGRCD_Min2_C "Fehlerpfad spezifische Umweltbedingungen fuer Fehlerpfad Dfp_EGRCD_Min2" VAL_BLK 0xCDAFE Kwb_Wu8 255.000000000 SigName 0.00 255.000000000 FORMAT "%13.9" NUMBER 10 /end CHARACTERISTIC
/begin CHARACTERISTIC DSM_EnvDfp_EGRCD_PWMInDia1_C "Fehlerpfad spezifische Umweltbedingungen fuer Fehlerpfad Dfp_EGRCD_PWMInDia1" VAL_BLK 0xCDB08 Kwb_Wu8 255.000000000 SigName 0.00 255.000000000 FORMAT "%13.9" NUMBER 10 /end CHARACTERISTIC
/begin CHARACTERISTIC DSM_EnvDfp_EGRCD_PWMInDia2_C "Fehlerpfad spezifische Umweltbedingungen fuer Fehlerpfad Dfp_EGRCD_PWMInDia2" VAL_BLK 0xCDB12 Kwb_Wu8 255.000000000 SigName 0.00 255.000000000 FORMAT "%13.9" NUMBER 10 /end CHARACTERISTIC
/begin CHARACTERISTIC DSM_EnvDfp_EGRCD_PWMInDia21_C "Fehlerpfad spezifische Umweltbedingungen fuer Fehlerpfad Dfp_EGRCD_PWMInDia21" VAL_BLK 0xCDB1C Kwb_Wu8 255.000000000 SigName 0.00 255.000000000 FORMAT "%13.9" NUMBER 10 /end CHARACTERISTIC
/begin CHARACTERISTIC DSM_EnvDfp_EGRCD_PWMInDia22_C "Fehlerpfad spezifische Umweltbedingungen fuer Fehlerpfad Dfp_EGRCD_PWMInDia22" VAL_BLK 0xCDB26 Kwb_Wu8 255.000000000 SigName 0.00 255.000000000 FORMAT "%13.9" NUMBER 10 /end CHARACTERISTIC
/begin CHARACTERISTIC DSM_EnvDfp_EGRCD_PWMInDia23_C "Fehlerpfad spezifische Umweltbedingungen fuer Fehlerpfad Dfp_EGRCD_PWMInDia23" VAL_BLK 0xCDB30 Kwb_Wu8 255.000000000 SigName 0.00 255.000000000 FORMAT "%13.9" NUMBER 10 /end CHARACTERISTIC
/begin CHARACTERISTIC DSM_EnvDfp_EGRCD_PWMInDia24_C "Fehlerpfad spezifische Umweltbedingungen fuer Fehlerpfad Dfp_EGRCD_PWMInDia24" VAL_BLK 0xCDB3A Kwb_Wu8 255.000000000 SigName 0.00 255.000000000 FORMAT "%13.9" NUMBER 10 /end CHARACTERISTIC
/begin CHARACTERISTIC DSM_EnvDfp_EGRCD_PWMInDia3_C "Fehlerpfad spezifische Umweltbedingungen fuer Fehlerpfad Dfp_EGRCD_PWMInDia3" VAL_BLK 0xCDB44 Kwb_Wu8 255.000000000 SigName 0.00 255.000000000 FORMAT "%13.9" NUMBER 10 /end CHARACTERISTIC
/begin CHARACTERISTIC DSM_EnvDfp_EGRCD_PWMInDia4_C "Fehlerpfad spezifische Umweltbedingungen fuer Fehlerpfad Dfp_EGRCD_PWMInDia4" VAL_BLK 0xCDB4E Kwb_Wu8 255.000000000 SigName 0.00 255.000000000 FORMAT "%13.9" NUMBER 10 /end CHARACTERISTIC
/begin CHARACTERISTIC DSM_EnvDfp_EGRCD_SigDia_C "Fehlerpfad spezifische Umweltbedingungen fuer Fehlerpfad Dfp_EGRCD_SigDia" VAL_BLK 0xCDB58 Kwb_Wu8 255.000000000 SigName 0.00 255.000000000 FORMAT "%13.9" NUMBER 10 /end CHARACTERISTIC
/begin CHARACTERISTIC DSM_EnvDfp_EGRCD_SigDia2_C "Fehlerpfad spezifische Umweltbedingungen fuer Fehlerpfad Dfp_EGRCD_SigDia2" VAL_BLK 0xCDB62 Kwb_Wu8 255.000000000 SigName 0.00 255.000000000 FORMAT "%13.9" NUMBER 10 /end CHARACTERISTIC
/begin CHARACTERISTIC DSM_EnvDfp_EGRCD_SigNpl_C "Fehlerpfad spezifische Umweltbedingungen fuer Fehlerpfad Dfp_EGRCD_SigNpl" VAL_BLK 0xCDB6C Kwb_Wu8 255.000000000 SigName 0.00 255.000000000 FORMAT "%13.9" NUMBER 10 /end CHARACTERISTIC
/begin CHARACTERISTIC DSM_EnvDfp_EGRCD_SigNpl2_C "Fehlerpfad spezifische Umweltbedingungen fuer Fehlerpfad Dfp_EGRCD_SigNpl2" VAL_BLK 0xCDB76 Kwb_Wu8 255.000000000 SigName 0.00 255.000000000 FORMAT "%13.9" NUMBER 10 /end CHARACTERISTIC
/begin CHARACTERISTIC DSM_EnvDfp_EGTOilLvlCrit_C "Fehlerpfad spezifische Umweltbedingungen fuer Fehlerpfad Dfp_EGTOilLvlCrit" VAL_BLK 0xCDB80 Kwb_Wu8 255.000000000 SigName 0.00 255.000000000 FORMAT "%13.9" NUMBER 10 /end CHARACTERISTIC
/begin CHARACTERISTIC DSM_EnvDfp_EGTOilVscCrit_C "Fehlerpfad spezifische Umweltbedingungen fuer Fehlerpfad Dfp_EGTOilVscCrit" VAL_BLK 0xCDB8A Kwb_Wu8 255.000000000 SigName 0.00 255.000000000 FORMAT "%13.9" NUMBER 10 /end CHARACTERISTIC
/begin CHARACTERISTIC DSM_EnvDfp_EGTRgnOilDil_C "Fehlerpfad spezifische Umweltbedingungen fuer Fehlerpfad Dfp_EGTRgnOilDil" VAL_BLK 0xCDB94 Kwb_Wu8 255.000000000 SigName 0.00 255.000000000 FORMAT "%13.9" NUMBER 10 /end CHARACTERISTIC
/begin CHARACTERISTIC DSM_EnvDfp_EGTTempGvnrInrB1_C "Fehlerpfad spezifische Umweltbedingungen fuer Fehlerpfad Dfp_EGTTempGvnrInrB1" VAL_BLK 0xCDB9E Kwb_Wu8 255.000000000 SigName 0.00 255.000000000 FORMAT "%13.9" NUMBER 10 /end CHARACTERISTIC
/begin CHARACTERISTIC DSM_EnvDfp_EGTTempGvnrInrB2_C "Fehlerpfad spezifische Umweltbedingungen fuer Fehlerpfad Dfp_EGTTempGvnrInrB2" VAL_BLK 0xCDBA8 Kwb_Wu8 255.000000000 SigName 0.00 255.000000000 FORMAT "%13.9" NUMBER 10 /end CHARACTERISTIC
/begin CHARACTERISTIC DSM_EnvDfp_EGTTempGvnrOutrB1_C "Fehlerpfad spezifische Umweltbedingungen fuer Fehlerpfad Dfp_EGTTempGvnrOutrB1" VAL_BLK 0xCDBB2 Kwb_Wu8 255.000000000 SigName 0.00 255.000000000 FORMAT "%13.9" NUMBER 10 /end CHARACTERISTIC
/begin CHARACTERISTIC DSM_EnvDfp_EGTTempGvnrOutrB2_C "Fehlerpfad spezifische Umweltbedingungen fuer Fehlerpfad Dfp_EGTTempGvnrOutrB2" VAL_BLK 0xCDBBC Kwb_Wu8 255.000000000 SigName 0.00 255.000000000 FORMAT "%13.9" NUMBER 10 /end CHARACTERISTIC
/begin CHARACTERISTIC DSM_EnvDfp_ETClbETFltInj1_C "Fehlerpfad spezifische Umweltbedingungen fuer Fehlerpfad Dfp_ETClbETFltInj1" VAL_BLK 0xCDBC6 Kwb_Wu8 255.000000000 SigName 0.00 255.000000000 FORMAT "%13.9" NUMBER 10 /end CHARACTERISTIC
/begin CHARACTERISTIC DSM_EnvDfp_ETClbETFltInj2_C "Fehlerpfad spezifische Umweltbedingungen fuer Fehlerpfad Dfp_ETClbETFltInj2" VAL_BLK 0xCDBD0 Kwb_Wu8 255.000000000 SigName 0.00 255.000000000 FORMAT "%13.9" NUMBER 10 /end CHARACTERISTIC
/begin CHARACTERISTIC DSM_EnvDfp_ETClbETFltInj3_C "Fehlerpfad spezifische Umweltbedingungen fuer Fehlerpfad Dfp_ETClbETFltInj3" VAL_BLK 0xCDBDA Kwb_Wu8 255.000000000 SigName 0.00 255.000000000 FORMAT "%13.9" NUMBER 10 /end CHARACTERISTIC
/begin CHARACTERISTIC DSM_EnvDfp_ETClbETFltInj4_C "Fehlerpfad spezifische Umweltbedingungen fuer Fehlerpfad Dfp_ETClbETFltInj4" VAL_BLK 0xCDBE4 Kwb_Wu8 255.000000000 SigName 0.00 255.000000000 FORMAT "%13.9" NUMBER 10 /end CHARACTERISTIC
/begin CHARACTERISTIC DSM_EnvDfp_ETClbETFltInj5_C "Fehlerpfad spezifische Umweltbedingungen fuer Fehlerpfad Dfp_ETClbETFltInj5" VAL_BLK 0xCDBEE Kwb_Wu8 255.000000000 SigName 0.00 255.000000000 FORMAT "%13.9" NUMBER 10 /end CHARACTERISTIC
/begin CHARACTERISTIC DSM_EnvDfp_ETClbETFltInj6_C "Fehlerpfad spezifische Umweltbedingungen fuer Fehlerpfad Dfp_ETClbETFltInj6" VAL_BLK 0xCDBF8 Kwb_Wu8 255.000000000 SigName 0.00 255.000000000 FORMAT "%13.9" NUMBER 10 /end CHARACTERISTIC
/begin CHARACTERISTIC DSM_EnvDfp_ETClbETFltInj7_C "Fehlerpfad spezifische Umweltbedingungen fuer Fehlerpfad Dfp_ETClbETFltInj7" VAL_BLK 0xCDC02 Kwb_Wu8 255.000000000 SigName 0.00 255.000000000 FORMAT "%13.9" NUMBER 10 /end CHARACTERISTIC
/begin CHARACTERISTIC DSM_EnvDfp_ETClbETFltInj8_C "Fehlerpfad spezifische Umweltbedingungen fuer Fehlerpfad Dfp_ETClbETFltInj8" VAL_BLK 0xCDC0C Kwb_Wu8 255.000000000 SigName 0.00 255.000000000 FORMAT "%13.9" NUMBER 10 /end CHARACTERISTIC
/begin CHARACTERISTIC DSM_EnvDfp_ETClbInj1_C "Fehlerpfad spezifische Umweltbedingungen fuer Fehlerpfad Dfp_ETClbInj1" VAL_BLK 0xCDC16 Kwb_Wu8 255.000000000 SigName 0.00 255.000000000 FORMAT "%13.9" NUMBER 10 /end CHARACTERISTIC
/begin CHARACTERISTIC DSM_EnvDfp_ETClbInj2_C "Fehlerpfad spezifische Umweltbedingungen fuer Fehlerpfad Dfp_ETClbInj2" VAL_BLK 0xCDC20 Kwb_Wu8 255.000000000 SigName 0.00 255.000000000 FORMAT "%13.9" NUMBER 10 /end CHARACTERISTIC
/begin CHARACTERISTIC DSM_EnvDfp_ETClbInj3_C "Fehlerpfad spezifische Umweltbedingungen fuer Fehlerpfad Dfp_ETClbInj3" VAL_BLK 0xCDC2A Kwb_Wu8 255.000000000 SigName 0.00 255.000000000 FORMAT "%13.9" NUMBER 10 /end CHARACTERISTIC
/begin CHARACTERISTIC DSM_EnvDfp_ETClbInj4_C "Fehlerpfad spezifische Umweltbedingungen fuer Fehlerpfad Dfp_ETClbInj4" VAL_BLK 0xCDC34 Kwb_Wu8 255.000000000 SigName 0.00 255.000000000 FORMAT "%13.9" NUMBER 10 /end CHARACTERISTIC
/begin CHARACTERISTIC DSM_EnvDfp_ETClbInj5_C "Fehlerpfad spezifische Umweltbedingungen fuer Fehlerpfad Dfp_ETClbInj5" VAL_BLK 0xCDC3E Kwb_Wu8 255.000000000 SigName 0.00 255.000000000 FORMAT "%13.9" NUMBER 10 /end CHARACTERISTIC
/begin CHARACTERISTIC DSM_EnvDfp_ETClbInj6_C "Fehlerpfad spezifische Umweltbedingungen fuer Fehlerpfad Dfp_ETClbInj6" VAL_BLK 0xCDC48 Kwb_Wu8 255.000000000 SigName 0.00 255.000000000 FORMAT "%13.9" NUMBER 10 /end CHARACTERISTIC
/begin CHARACTERISTIC DSM_EnvDfp_ETClbInj7_C "Fehlerpfad spezifische Umweltbedingungen fuer Fehlerpfad Dfp_ETClbInj7" VAL_BLK 0xCDC52 Kwb_Wu8 255.000000000 SigName 0.00 255.000000000 FORMAT "%13.9" NUMBER 10 /end CHARACTERISTIC
/begin CHARACTERISTIC DSM_EnvDfp_ETClbInj8_C "Fehlerpfad spezifische Umweltbedingungen fuer Fehlerpfad Dfp_ETClbInj8" VAL_BLK 0xCDC5C Kwb_Wu8 255.000000000 SigName 0.00 255.000000000 FORMAT "%13.9" NUMBER 10 /end CHARACTERISTIC
/begin CHARACTERISTIC DSM_EnvDfp_EngMCaS1_C "Fehlerpfad spezifische Umweltbedingungen fuer Fehlerpfad Dfp_EngMCaS1" VAL_BLK 0xCDC66 Kwb_Wu8 255.000000000 SigName 0.00 255.000000000 FORMAT "%13.9" NUMBER 10 /end CHARACTERISTIC
/begin CHARACTERISTIC DSM_EnvDfp_EngMCrS1_C "Fehlerpfad spezifische Umweltbedingungen fuer Fehlerpfad Dfp_EngMCrS1" VAL_BLK 0xCDC70 Kwb_Wu8 255.000000000 SigName 0.00 255.000000000 FORMAT "%13.9" NUMBER 10 /end CHARACTERISTIC
/begin CHARACTERISTIC DSM_EnvDfp_EngMOfsCaSCrS_C "Fehlerpfad spezifische Umweltbedingungen fuer Fehlerpfad Dfp_EngMOfsCaSCrS" VAL_BLK 0xCDC7A Kwb_Wu8 255.000000000 SigName 0.00 255.000000000 FORMAT "%13.9" NUMBER 10 /end CHARACTERISTIC
/begin CHARACTERISTIC DSM_EnvDfp_EngMntCtlCD_C "Fehlerpfad spezifische Umweltbedingungen fuer Fehlerpfad Dfp_EngMntCtlCD" VAL_BLK 0xCDC84 Kwb_Wu8 255.000000000 SigName 0.00 255.000000000 FORMAT "%13.9" NUMBER 10 /end CHARACTERISTIC
/begin CHARACTERISTIC DSM_EnvDfp_FBCqDvt_C "Fehlerpfad spezifische Umweltbedingungen fuer Fehlerpfad Dfp_FBCqDvt" VAL_BLK 0xCDC8E Kwb_Wu8 255.000000000 SigName 0.00 255.000000000 FORMAT "%13.9" NUMBER 10 /end CHARACTERISTIC
/begin CHARACTERISTIC DSM_EnvDfp_FMAErrMod_C "Fehlerpfad spezifische Umweltbedingungen fuer Fehlerpfad Dfp_FMAErrMod" VAL_BLK 0xCDC98 Kwb_Wu8 255.000000000 SigName 0.00 255.000000000 FORMAT "%13.9" NUMBER 10 /end CHARACTERISTIC
/begin CHARACTERISTIC DSM_EnvDfp_FMTC_NonMonotonMap_C "Fehlerpfad spezifische Umweltbedingungen fuer Fehlerpfad Dfp_FMTC_NonMonotonMap" VAL_BLK 0xCDCA2 Kwb_Wu8 255.000000000 SigName 0.00 255.000000000 FORMAT "%13.9" NUMBER 10 /end CHARACTERISTIC
/begin CHARACTERISTIC DSM_EnvDfp_FTSCD_C "Fehlerpfad spezifische Umweltbedingungen fuer Fehlerpfad Dfp_FTSCD" VAL_BLK 0xCDCAC Kwb_Wu8 255.000000000 SigName 0.00 255.000000000 FORMAT "%13.9" NUMBER 10 /end CHARACTERISTIC
/begin CHARACTERISTIC DSM_EnvDfp_FanCD_C "Fehlerpfad spezifische Umweltbedingungen fuer Fehlerpfad Dfp_FanCD" VAL_BLK 0xCDCB6 Kwb_Wu8 255.000000000 SigName 0.00 255.000000000 FORMAT "%13.9" NUMBER 10 /end CHARACTERISTIC
/begin CHARACTERISTIC DSM_EnvDfp_FanCD_FanCtlr1_C "Fehlerpfad spezifische Umweltbedingungen fuer Fehlerpfad Dfp_FanCD_FanCtlr1" VAL_BLK 0xCDCC0 Kwb_Wu8 255.000000000 SigName 0.00 255.000000000 FORMAT "%13.9" NUMBER 10 /end CHARACTERISTIC
/begin CHARACTERISTIC DSM_EnvDfp_FanCD_FanCtlr2_C "Fehlerpfad spezifische Umweltbedingungen fuer Fehlerpfad Dfp_FanCD_FanCtlr2" VAL_BLK 0xCDCCA Kwb_Wu8 255.000000000 SigName 0.00 255.000000000 FORMAT "%13.9" NUMBER 10 /end CHARACTERISTIC
/begin CHARACTERISTIC DSM_EnvDfp_FanCD_FanCtlr3_C "Fehlerpfad spezifische Umweltbedingungen fuer Fehlerpfad Dfp_FanCD_FanCtlr3" VAL_BLK 0xCDCD4 Kwb_Wu8 255.000000000 SigName 0.00 255.000000000 FORMAT "%13.9" NUMBER 10 /end CHARACTERISTIC
/begin CHARACTERISTIC DSM_EnvDfp_FlFCD_C "Fehlerpfad spezifische Umweltbedingungen fuer Fehlerpfad Dfp_FlFCD" VAL_BLK 0xCDCDE Kwb_Wu8 255.000000000 SigName 0.00 255.000000000 FORMAT "%13.9" NUMBER 10 /end CHARACTERISTIC
/begin CHARACTERISTIC DSM_EnvDfp_FlMngSmkDefect_C "Fehlerpfad spezifische Umweltbedingungen fuer Fehlerpfad Dfp_FlMngSmkDefect" VAL_BLK 0xCDCE8 Kwb_Wu8 255.000000000 SigName 0.00 255.000000000 FORMAT "%13.9" NUMBER 10 /end CHARACTERISTIC
/begin CHARACTERISTIC DSM_EnvDfp_FlSCDT1_C "Fehlerpfad spezifische Umweltbedingungen fuer Fehlerpfad Dfp_FlSCDT1" VAL_BLK 0xCDCF2 Kwb_Wu8 255.000000000 SigName 0.00 255.000000000 FORMAT "%13.9" NUMBER 10 /end CHARACTERISTIC
/begin CHARACTERISTIC DSM_EnvDfp_FrmMngANFRADMOMPT_C "Fehlerpfad spezifische Umweltbedingungen fuer Fehlerpfad Dfp_FrmMngANFRADMOMPT" VAL_BLK 0xCDCFC Kwb_Wu8 255.000000000 SigName 0.00 255.000000000 FORMAT "%13.9" NUMBER 10 /end CHARACTERISTIC
/begin CHARACTERISTIC DSM_EnvDfp_FrmMngASC1_C "Fehlerpfad spezifische Umweltbedingungen fuer Fehlerpfad Dfp_FrmMngASC1" VAL_BLK 0xCDD06 Kwb_Wu8 255.000000000 SigName 0.00 255.000000000 FORMAT "%13.9" NUMBER 10 /end CHARACTERISTIC
/begin CHARACTERISTIC DSM_EnvDfp_FrmMngASC2_C "Fehlerpfad spezifische Umweltbedingungen fuer Fehlerpfad Dfp_FrmMngASC2" VAL_BLK 0xCDD10 Kwb_Wu8 255.000000000 SigName 0.00 255.000000000 FORMAT "%13.9" NUMBER 10 /end CHARACTERISTIC
/begin CHARACTERISTIC DSM_EnvDfp_FrmMngASC3_C "Fehlerpfad spezifische Umweltbedingungen fuer Fehlerpfad Dfp_FrmMngASC3" VAL_BLK 0xCDD1A Kwb_Wu8 255.000000000 SigName 0.00 255.000000000 FORMAT "%13.9" NUMBER 10 /end CHARACTERISTIC
/begin CHARACTERISTIC DSM_EnvDfp_FrmMngASC4_C "Fehlerpfad spezifische Umweltbedingungen fuer Fehlerpfad Dfp_FrmMngASC4" VAL_BLK 0xCDD24 Kwb_Wu8 255.000000000 SigName 0.00 255.000000000 FORMAT "%13.9" NUMBER 10 /end CHARACTERISTIC
/begin CHARACTERISTIC DSM_EnvDfp_FrmMngBOS_RESET_C "Fehlerpfad spezifische Umweltbedingungen fuer Fehlerpfad Dfp_FrmMngBOS_RESET" VAL_BLK 0xCDD2E Kwb_Wu8 255.000000000 SigName 0.00 255.000000000 FORMAT "%13.9" NUMBER 10 /end CHARACTERISTIC
/begin CHARACTERISTIC DSM_EnvDfp_FrmMngBOS_RESET2_C "Fehlerpfad spezifische Umweltbedingungen fuer Fehlerpfad Dfp_FrmMngBOS_RESET2" VAL_BLK 0xCDD38 Kwb_Wu8 255.000000000 SigName 0.00 255.000000000 FORMAT "%13.9" NUMBER 10 /end CHARACTERISTIC
/begin CHARACTERISTIC DSM_EnvDfp_FrmMngDMANFAFS_C "Fehlerpfad spezifische Umweltbedingungen fuer Fehlerpfad Dfp_FrmMngDMANFAFS" VAL_BLK 0xCDD42 Kwb_Wu8 255.000000000 SigName 0.00 255.000000000 FORMAT "%13.9" NUMBER 10 /end CHARACTERISTIC
/begin CHARACTERISTIC DSM_EnvDfp_FrmMngDRMANFSSG_C "Fehlerpfad spezifische Umweltbedingungen fuer Fehlerpfad Dfp_FrmMngDRMANFSSG" VAL_BLK 0xCDD4C Kwb_Wu8 255.000000000 SigName 0.00 255.000000000 FORMAT "%13.9" NUMBER 10 /end CHARACTERISTIC
/begin CHARACTERISTIC DSM_EnvDfp_FrmMngEGS1_C "Fehlerpfad spezifische Umweltbedingungen fuer Fehlerpfad Dfp_FrmMngEGS1" VAL_BLK 0xCDD56 Kwb_Wu8 255.000000000 SigName 0.00 255.000000000 FORMAT "%13.9" NUMBER 10 /end CHARACTERISTIC
/begin CHARACTERISTIC DSM_EnvDfp_FrmMngEGS2_C "Fehlerpfad spezifische Umweltbedingungen fuer Fehlerpfad Dfp_FrmMngEGS2" VAL_BLK 0xCDD60 Kwb_Wu8 255.000000000 SigName 0.00 255.000000000 FORMAT "%13.9" NUMBER 10 /end CHARACTERISTIC
/begin CHARACTERISTIC DSM_EnvDfp_FrmMngGEARBX_DATA_C "environment conditions (customerspecific) for path" VAL_BLK 0xCDD6A Kwb_Wu8 255.000000000 SigName 0.00 255.000000000 FORMAT "%13.9" NUMBER 10 /end CHARACTERISTIC
/begin CHARACTERISTIC DSM_EnvDfp_FrmMngGEARBX_DATA2_C "Fehlerpfad spezifische Umweltbedingungen fuer Fehlerpfad Dfp_FrmMngGEARBX_DATA2" VAL_BLK 0xCDD74 Kwb_Wu8 255.000000000 SigName 0.00 255.000000000 FORMAT "%13.9" NUMBER 10 /end CHARACTERISTIC
/begin CHARACTERISTIC DSM_EnvDfp_FrmMngHEAT_AC_C "environment conditions (customerspecific) for path" VAL_BLK 0xCDD7E Kwb_Wu8 255.000000000 SigName 0.00 255.000000000 FORMAT "%13.9" NUMBER 10 /end CHARACTERISTIC
/begin CHARACTERISTIC DSM_EnvDfp_FrmMngINSTR2_C "Fehlerpfad spezifische Umweltbedingungen fuer Fehlerpfad Dfp_FrmMngINSTR2" VAL_BLK 0xCDD88 Kwb_Wu8 255.000000000 SigName 0.00 255.000000000 FORMAT "%13.9" NUMBER 10 /end CHARACTERISTIC
/begin CHARACTERISTIC DSM_EnvDfp_FrmMngINSTR3_C "Fehlerpfad spezifische Umweltbedingungen fuer Fehlerpfad Dfp_FrmMngINSTR3" VAL_BLK 0xCDD92 Kwb_Wu8 255.000000000 SigName 0.00 255.000000000 FORMAT "%13.9" NUMBER 10 /end CHARACTERISTIC
/begin CHARACTERISTIC DSM_EnvDfp_FrmMngLENKRADWINKEL_C "Fehlerpfad spezifische Umweltbedingungen fuer Fehlerpfad Dfp_FrmMngLENKRADWINKEL" VAL_BLK 0xCDD9C Kwb_Wu8 255.000000000 SigName 0.00 255.000000000 FORMAT "%13.9" NUMBER 10 /end CHARACTERISTIC
/begin CHARACTERISTIC DSM_EnvDfp_FrmMngMILEAGE_RANGE_C "Fehlerpfad spezifische Umweltbedingungen fuer Fehlerpfad Dfp_FrmMngMILEAGE_RANGE" VAL_BLK 0xCDDA6 Kwb_Wu8 255.000000000 SigName 0.00 255.000000000 FORMAT "%13.9" NUMBER 10 /end CHARACTERISTIC
/begin CHARACTERISTIC DSM_EnvDfp_FrmMngMSPHISYNC_C "Fehlerpfad spezifische Umweltbedingungen fuer Fehlerpfad Dfp_FrmMngMSPHISYNC" VAL_BLK 0xCDDB0 Kwb_Wu8 255.000000000 SigName 0.00 255.000000000 FORMAT "%13.9" NUMBER 10 /end CHARACTERISTIC
/begin CHARACTERISTIC DSM_EnvDfp_FrmMngMST4_C "Fehlerpfad spezifische Umweltbedingungen fuer Fehlerpfad Dfp_FrmMngMST4" VAL_BLK 0xCDDBA Kwb_Wu8 255.000000000 SigName 0.00 255.000000000 FORMAT "%13.9" NUMBER 10 /end CHARACTERISTIC
/begin CHARACTERISTIC DSM_EnvDfp_FrmMngMST5_C "Fehlerpfad spezifische Umweltbedingungen fuer Fehlerpfad Dfp_FrmMngMST5" VAL_BLK 0xCDDC4 Kwb_Wu8 255.000000000 SigName 0.00 255.000000000 FORMAT "%13.9" NUMBER 10 /end CHARACTERISTIC
/begin CHARACTERISTIC DSM_EnvDfp_FrmMngOPCRCTLACC_C "Fehlerpfad spezifische Umweltbedingungen fuer Fehlerpfad Dfp_FrmMngOPCRCTLACC" VAL_BLK 0xCDDCE Kwb_Wu8 255.000000000 SigName 0.00 255.000000000 FORMAT "%13.9" NUMBER 10 /end CHARACTERISTIC
/begin CHARACTERISTIC DSM_EnvDfp_FrmMngPRGG_CCTR_C "Fehlerpfad spezifische Umweltbedingungen fuer Fehlerpfad Dfp_FrmMngPRGG_CCTR" VAL_BLK 0xCDDD8 Kwb_Wu8 255.000000000 SigName 0.00 255.000000000 FORMAT "%13.9" NUMBER 10 /end CHARACTERISTIC
/begin CHARACTERISTIC DSM_EnvDfp_FrmMngPWRMNG_LOADV_C "Fehlerpfad spezifische Umweltbedingungen fuer Fehlerpfad Dfp_FrmMngPWRMNG_LOADV" VAL_BLK 0xCDDE2 Kwb_Wu8 255.000000000 SigName 0.00 255.000000000 FORMAT "%13.9" NUMBER 10 /end CHARACTERISTIC
/begin CHARACTERISTIC DSM_EnvDfp_FrmMngParkConsumer_C "Fehlerpfad spezifische Umweltbedinungen fuer Fehlerpfad Dfp_FrmMngParkConsumer" VAL_BLK 0xCDDEC Kwb_Wu8 255.000000000 SigName 0.00 255.000000000 FORMAT "%13.9" NUMBER 10 /end CHARACTERISTIC
/begin CHARACTERISTIC DSM_EnvDfp_FrmMngRQSTGEFAN_C "Fehlerpfad spezifische Umweltbedingungen fuer Fehlerpfad Dfp_FrmMngRQSTGEFAN_C" VAL_BLK 0xCDDF6 Kwb_Wu8 255.000000000 SigName 0.00 255.000000000 FORMAT "%13.9" NUMBER 10 /end CHARACTERISTIC
/begin CHARACTERISTIC DSM_EnvDfp_FrmMngSLV4_C "Fehlerpfad spezifische Umweltbedingungen fuer Fehlerpfad Dfp_FrmMngSLV4" VAL_BLK 0xCDE00 Kwb_Wu8 255.000000000 SigName 0.00 255.000000000 FORMAT "%13.9" NUMBER 10 /end CHARACTERISTIC
/begin CHARACTERISTIC DSM_EnvDfp_FrmMngSLV5_C "Fehlerpfad spezifische Umweltbedingungen fuer Fehlerpfad Dfp_FrmMngSLV5" VAL_BLK 0xCDE0A Kwb_Wu8 255.000000000 SigName 0.00 255.000000000 FORMAT "%13.9" NUMBER 10 /end CHARACTERISTIC
/begin CHARACTERISTIC DSM_EnvDfp_FrmMngSSGErr_C "Fehlerpfad spezifische Umweltbedingungen fuer Fehlerpfad Dfp_FrmMngSSGErr" VAL_BLK 0xCDE14 Kwb_Wu8 255.000000000 SigName 0.00 255.000000000 FORMAT "%13.9" NUMBER 10 /end CHARACTERISTIC
/begin CHARACTERISTIC DSM_EnvDfp_FrmMngSSGShOff_C "Fehlerpfad spezifische Umweltbedingungen fuer Fehlerpfad Dfp_FrmMngSSGShOff" VAL_BLK 0xCDE1E Kwb_Wu8 255.000000000 SigName 0.00 255.000000000 FORMAT "%13.9" NUMBER 10 /end CHARACTERISTIC
/begin CHARACTERISTIC DSM_EnvDfp_FrmMngSTAT_ANH_C "Fehlerpfad spezifische Umweltbedingungen fuer Fehlerpfad Dfp_FrmMngSTAT_ANH" VAL_BLK 0xCDE28 Kwb_Wu8 255.000000000 SigName 0.00 255.000000000 FORMAT "%13.9" NUMBER 10 /end CHARACTERISTIC
/begin CHARACTERISTIC DSM_EnvDfp_FrmMngSTAT_ARS_C "environment conditions (customerspecific) for path" VAL_BLK 0xCDE32 Kwb_Wu8 255.000000000 SigName 0.00 255.000000000 FORMAT "%13.9" NUMBER 10 /end CHARACTERISTIC
/begin CHARACTERISTIC DSM_EnvDfp_FrmMngSTAT_DSC_C "environment conditions (customerspecific) for path" VAL_BLK 0xCDE3C Kwb_Wu8 255.000000000 SigName 0.00 255.000000000 FORMAT "%13.9" NUMBER 10 /end CHARACTERISTIC
/begin CHARACTERISTIC DSM_EnvDfp_FrmMngSTAT_EKP_C "Fehlerpfad spezifische Umweltbedingungen fuer Fehlerpfad Dfp_FrmMngSTAT_EKP" VAL_BLK 0xCDE46 Kwb_Wu8 255.000000000 SigName 0.00 255.000000000 FORMAT "%13.9" NUMBER 10 /end CHARACTERISTIC
/begin CHARACTERISTIC DSM_EnvDfp_FrmMngSTAT_KOMBI_C "Fehlerpfad spezifische Umweltbedingungen fuer Fehlerpfad Dfp_FrmMngSTAT_KOMBI" VAL_BLK 0xCDE50 Kwb_Wu8 255.000000000 SigName 0.00 255.000000000 FORMAT "%13.9" NUMBER 10 /end CHARACTERISTIC
/begin CHARACTERISTIC DSM_EnvDfp_FrmMngSTAT_SITZ_C "Fehlerpfad spezifische Umweltbedingungen fuer Fehlerpfad  Dfp_FrmMngSTAT_SITZ" VAL_BLK 0xCDE5A Kwb_Wu8 255.000000000 SigName 0.00 255.000000000 FORMAT "%13.9" NUMBER 10 /end CHARACTERISTIC
/begin CHARACTERISTIC DSM_EnvDfp_FrmMngStOBDGbxMilOf_C "Fehlerpfad spezifische Umweltbedingungen fuer Fehlerpfad Dfp_FrmMngStOBDGbxMilOf" VAL_BLK 0xCDE64 Kwb_Wu8 255.000000000 SigName 0.00 255.000000000 FORMAT "%13.9" NUMBER 10 /end CHARACTERISTIC
/begin CHARACTERISTIC DSM_EnvDfp_FrmMngStOBDGbxMilOn_C "Fehlerpfad spezifische Umweltbedingungen fuer Fehlerpfad Dfp_FrmMngStOBDGbxMilOn" VAL_BLK 0xCDE6E Kwb_Wu8 255.000000000 SigName 0.00 255.000000000 FORMAT "%13.9" NUMBER 10 /end CHARACTERISTIC
/begin CHARACTERISTIC DSM_EnvDfp_FrmMngTEMPRELTIME_C "Fehlerpfad spezifische Umweltbedingungen fuer Fehlerpfad Dfp_FrmMngTEMPRELTIME" VAL_BLK 0xCDE78 Kwb_Wu8 255.000000000 SigName 0.00 255.000000000 FORMAT "%13.9" NUMBER 10 /end CHARACTERISTIC
/begin CHARACTERISTIC DSM_EnvDfp_FrmMngTERMINAL_C "environment conditions (customerspecific) for path" VAL_BLK 0xCDE82 Kwb_Wu8 255.000000000 SigName 0.00 255.000000000 FORMAT "%13.9" NUMBER 10 /end CHARACTERISTIC
/begin CHARACTERISTIC DSM_EnvDfp_FrmMngTIME_DATE_C "Fehlerpfad spezifische Umweltbedingungen fuer Fehlerpfad Dfp_FrmMngTIME_DATE" VAL_BLK 0xCDE8C Kwb_Wu8 255.000000000 SigName 0.00 255.000000000 FORMAT "%13.9" NUMBER 10 /end CHARACTERISTIC
/begin CHARACTERISTIC DSM_EnvDfp_FrmMngTORQUE_DSC_C "environment conditions (customerspecific) for path" VAL_BLK 0xCDE96 Kwb_Wu8 255.000000000 SigName 0.00 255.000000000 FORMAT "%13.9" NUMBER 10 /end CHARACTERISTIC
/begin CHARACTERISTIC DSM_EnvDfp_FrmMngTORQUE_GEARBX_C "environment conditions (customerspecific) for path" VAL_BLK 0xCDEA0 Kwb_Wu8 255.000000000 SigName 0.00 255.000000000 FORMAT "%13.9" NUMBER 10 /end CHARACTERISTIC
/begin CHARACTERISTIC DSM_EnvDfp_FrmMngTrq_ReqACC_C "Fehlerpfad spezifische Umweltbedingungen fuer Fehlerpfad Dfp_FrmMngTrq_ReqACC" VAL_BLK 0xCDEAA Kwb_Wu8 255.000000000 SigName 0.00 255.000000000 FORMAT "%13.9" NUMBER 10 /end CHARACTERISTIC
/begin CHARACTERISTIC DSM_EnvDfp_FrmMngVEH_MOD_C "Fehlerpfad spezifische Umweltbedingungen fuer Fehlerpfad Dfp_FrmMngVEH_MOD_C" VAL_BLK 0xCDEB4 Kwb_Wu8 255.000000000 SigName 0.00 255.000000000 FORMAT "%13.9" NUMBER 10 /end CHARACTERISTIC
/begin CHARACTERISTIC DSM_EnvDfp_FrmMngVELOCITY_C "environment conditions (customerspecific) for path" VAL_BLK 0xCDEBE Kwb_Wu8 255.000000000 SigName 0.00 255.000000000 FORMAT "%13.9" NUMBER 10 /end CHARACTERISTIC
/begin CHARACTERISTIC DSM_EnvDfp_FrmMngWHEEL_SPEED_C "Fehlerpfad spezifische Umweltbedingungen fuer Fehlerpfad Dfp_FrmMngWHEEL_SPEED" VAL_BLK 0xCDEC8 Kwb_Wu8 255.000000000 SigName 0.00 255.000000000 FORMAT "%13.9" NUMBER 10 /end CHARACTERISTIC
/begin CHARACTERISTIC DSM_EnvDfp_FrmMngstCurr_C "Umweltbedingung für Dfp_FrmMngstCurr" VAL_BLK 0xCDED2 Kwb_Wu8 255.000000000 SigName 0.00 255.000000000 FORMAT "%13.9" NUMBER 10 /end CHARACTERISTIC
/begin CHARACTERISTIC DSM_EnvDfp_FrmMngswtPSPOff_C "Umweltbedingung für Dfp_FrmMngswtPSPOff" VAL_BLK 0xCDEDC Kwb_Wu8 255.000000000 SigName 0.00 255.000000000 FORMAT "%13.9" NUMBER 10 /end CHARACTERISTIC
/begin CHARACTERISTIC DSM_EnvDfp_GearbxIncMax_C "Fehlerpfad spezifische Umweltbedingungen fuer Fehlerpfad Dfp_GearbxIncMax" VAL_BLK 0xCDEE6 Kwb_Wu8 255.000000000 SigName 0.00 255.000000000 FORMAT "%13.9" NUMBER 10 /end CHARACTERISTIC
/begin CHARACTERISTIC DSM_EnvDfp_GlwCD_C "Fehlerpfad spezifische Umweltbedingungen fuer Fehlerpfad Dfp_GlwCD" VAL_BLK 0xCDEF0 Kwb_Wu8 255.000000000 SigName 0.00 255.000000000 FORMAT "%13.9" NUMBER 10 /end CHARACTERISTIC
/begin CHARACTERISTIC DSM_EnvDfp_GlwCDGlwCirc1_C "Fehlerpfad spezifische Umweltbedingungen fuer Fehlerpfad Dfp_GlwCDGlwCirc1" VAL_BLK 0xCDEFA Kwb_Wu8 255.000000000 SigName 0.00 255.000000000 FORMAT "%13.9" NUMBER 10 /end CHARACTERISTIC
/begin CHARACTERISTIC DSM_EnvDfp_GlwCDGlwCirc2_C "Fehlerpfad spezifische Umweltbedingungen fuer Fehlerpfad Dfp_GlwCDGlwCirc2" VAL_BLK 0xCDF04 Kwb_Wu8 255.000000000 SigName 0.00 255.000000000 FORMAT "%13.9" NUMBER 10 /end CHARACTERISTIC
/begin CHARACTERISTIC DSM_EnvDfp_GlwCDGlwCirc3_C "Fehlerpfad spezifische Umweltbedingungen fuer Fehlerpfad Dfp_GlwCDGlwCirc3" VAL_BLK 0xCDF0E Kwb_Wu8 255.000000000 SigName 0.00 255.000000000 FORMAT "%13.9" NUMBER 10 /end CHARACTERISTIC
/begin CHARACTERISTIC DSM_EnvDfp_GlwCDGlwCirc4_C "Fehlerpfad spezifische Umweltbedingungen fuer Fehlerpfad Dfp_GlwCDGlwCirc4" VAL_BLK 0xCDF18 Kwb_Wu8 255.000000000 SigName 0.00 255.000000000 FORMAT "%13.9" NUMBER 10 /end CHARACTERISTIC
/begin CHARACTERISTIC DSM_EnvDfp_GlwCDGlwCirc5_C "Fehlerpfad spezifische Umweltbedingungen fuer Fehlerpfad Dfp_GlwCDGlwCirc5" VAL_BLK 0xCDF22 Kwb_Wu8 255.000000000 SigName 0.00 255.000000000 FORMAT "%13.9" NUMBER 10 /end CHARACTERISTIC
/begin CHARACTERISTIC DSM_EnvDfp_GlwCDGlwCirc6_C "Fehlerpfad spezifische Umweltbedingungen fuer Fehlerpfad Dfp_GlwCDGlwCirc6" VAL_BLK 0xCDF2C Kwb_Wu8 255.000000000 SigName 0.00 255.000000000 FORMAT "%13.9" NUMBER 10 /end CHARACTERISTIC
/begin CHARACTERISTIC DSM_EnvDfp_GlwCDGlwCirc7_C "Fehlerpfad spezifische Umweltbedingungen fuer Fehlerpfad Dfp_GlwCDGlwCirc7" VAL_BLK 0xCDF36 Kwb_Wu8 255.000000000 SigName 0.00 255.000000000 FORMAT "%13.9" NUMBER 10 /end CHARACTERISTIC
/begin CHARACTERISTIC DSM_EnvDfp_GlwCDGlwCirc8_C "Fehlerpfad spezifische Umweltbedingungen fuer Fehlerpfad Dfp_GlwCDGlwCirc8" VAL_BLK 0xCDF40 Kwb_Wu8 255.000000000 SigName 0.00 255.000000000 FORMAT "%13.9" NUMBER 10 /end CHARACTERISTIC
/begin CHARACTERISTIC DSM_EnvDfp_GlwCtl_C "Fehlerpfad spezifische Umweltbedingungen fuer Fehlerpfad Dfp_GlwCtl" VAL_BLK 0xCDF4A Kwb_Wu8 255.000000000 SigName 0.00 255.000000000 FORMAT "%13.9" NUMBER 10 /end CHARACTERISTIC
/begin CHARACTERISTIC DSM_EnvDfp_HWEMonCom_C "Fehlerpfad spezifische Umweltbedingungen fuer Fehlerpfad Dfp_HWEMonCom" VAL_BLK 0xCDF54 Kwb_Wu8 255.000000000 SigName 0.00 255.000000000 FORMAT "%13.9" NUMBER 10 /end CHARACTERISTIC
/begin CHARACTERISTIC DSM_EnvDfp_HWEMonEEPROM_C "Fehlerpfad spezifische Umweltbedingungen fuer Fehlerpfad Dfp_HWEMonEEPROM" VAL_BLK 0xCDF5E Kwb_Wu8 255.000000000 SigName 0.00 255.000000000 FORMAT "%13.9" NUMBER 10 /end CHARACTERISTIC
/begin CHARACTERISTIC DSM_EnvDfp_HWEMonRcyLocked_C "Fehlerpfad spezifische Umweltbedingungen fuer Fehlerpfad Dfp_HWEMonRcyLocked" VAL_BLK 0xCDF68 Kwb_Wu8 255.000000000 SigName 0.00 255.000000000 FORMAT "%13.9" NUMBER 10 /end CHARACTERISTIC
/begin CHARACTERISTIC DSM_EnvDfp_HWEMonRcySuppressed_C "Fehlerpfad spezifische Umweltbedingungen fuer Fehlerpfad Dfp_HWEMonRcySuppressed" VAL_BLK 0xCDF72 Kwb_Wu8 255.000000000 SigName 0.00 255.000000000 FORMAT "%13.9" NUMBER 10 /end CHARACTERISTIC
/begin CHARACTERISTIC DSM_EnvDfp_HWEMonRcyVisible_C "Fehlerpfad spezifische Umweltbedingungen fuer Fehlerpfad Dfp_HWEMonRcyVisible" VAL_BLK 0xCDF7C Kwb_Wu8 255.000000000 SigName 0.00 255.000000000 FORMAT "%13.9" NUMBER 10 /end CHARACTERISTIC
/begin CHARACTERISTIC DSM_EnvDfp_HWEMonUMaxSupply_C "Fehlerpfad spezifische Umweltbedingungen fuer Fehlerpfad Dfp_HWEMonUMaxSupply" VAL_BLK 0xCDF86 Kwb_Wu8 255.000000000 SigName 0.00 255.000000000 FORMAT "%13.9" NUMBER 10 /end CHARACTERISTIC
/begin CHARACTERISTIC DSM_EnvDfp_HWEMonUMinSupply_C "Fehlerpfad spezifische Umweltbedingungen fuer Fehlerpfad Dfp_HWEMonUMinSupply" VAL_BLK 0xCDF90 Kwb_Wu8 255.000000000 SigName 0.00 255.000000000 FORMAT "%13.9" NUMBER 10 /end CHARACTERISTIC
/begin CHARACTERISTIC DSM_EnvDfp_IATSCD_C "Fehlerpfad spezifische Umweltbedingungen fuer Fehlerpfad Dfp_IATSCD" VAL_BLK 0xCDF9A Kwb_Wu8 255.000000000 SigName 0.00 255.000000000 FORMAT "%13.9" NUMBER 10 /end CHARACTERISTIC
/begin CHARACTERISTIC DSM_EnvDfp_IATSCD_CATS_C "Fehlerpfad spezifische Umweltbedingungen fuer Fehlerpfad Dfp_IATSCD_CATS" VAL_BLK 0xCDFA4 Kwb_Wu8 255.000000000 SigName 0.00 255.000000000 FORMAT "%13.9" NUMBER 10 /end CHARACTERISTIC
/begin CHARACTERISTIC DSM_EnvDfp_IATSCD_CATSSec_C "Fehlerpfad spezifische Umweltbedingungen fuer Fehlerpfad Dfp_IATSCD_CATSSec" VAL_BLK 0xCDFAE Kwb_Wu8 255.000000000 SigName 0.00 255.000000000 FORMAT "%13.9" NUMBER 10 /end CHARACTERISTIC
/begin CHARACTERISTIC DSM_EnvDfp_ImmCtlImmCD_C "Fehlerpfad spezifische Umweltbedingungen fuer Fehlerpfad Dfp_ImmCtlImmCD" VAL_BLK 0xCDFB8 Kwb_Wu8 255.000000000 SigName 0.00 255.000000000 FORMAT "%13.9" NUMBER 10 /end CHARACTERISTIC
/begin CHARACTERISTIC DSM_EnvDfp_ImmCtlImmEep_C "Fehlerpfad spezifische Umweltbedingungen fuer Fehlerpfad Dfp_ImmCtlImmEep" VAL_BLK 0xCDFC2 Kwb_Wu8 255.000000000 SigName 0.00 255.000000000 FORMAT "%13.9" NUMBER 10 /end CHARACTERISTIC
/begin CHARACTERISTIC DSM_EnvDfp_ImmCtlMpl_C "Fehlerpfad spezifische Umweltbedingungen fuer Fehlerpfad Dfp_ImmCtlMpl" VAL_BLK 0xCDFCC Kwb_Wu8 255.000000000 SigName 0.00 255.000000000 FORMAT "%13.9" NUMBER 10 /end CHARACTERISTIC
/begin CHARACTERISTIC DSM_EnvDfp_IndSys1_C "Fehlerpfad spezifische Umweltbedingungen fuer Fehlerpfad Dfp_IndSys1" VAL_BLK 0xCDFD6 Kwb_Wu8 255.000000000 SigName 0.00 255.000000000 FORMAT "%13.9" NUMBER 10 /end CHARACTERISTIC
/begin CHARACTERISTIC DSM_EnvDfp_IndSys2_C "Fehlerpfad spezifische Umweltbedingungen fuer Fehlerpfad Dfp_IndSys2" VAL_BLK 0xCDFE0 Kwb_Wu8 255.000000000 SigName 0.00 255.000000000 FORMAT "%13.9" NUMBER 10 /end CHARACTERISTIC
/begin CHARACTERISTIC DSM_EnvDfp_InjCrv_InjLim_C "Fehlerpfad spezifische Umweltbedingungen fuer Fehlerpfad Dfp_InjCrv_InjLim" VAL_BLK 0xCDFEA Kwb_Wu8 255.000000000 SigName 0.00 255.000000000 FORMAT "%13.9" NUMBER 10 /end CHARACTERISTIC
/begin CHARACTERISTIC DSM_EnvDfp_InjCtlAdjQnt_C "Fehlerpfad spezifische Umweltbedingungen fuer Fehlerpfad Dfp_InjCtlAdjQnt" VAL_BLK 0xCDFF4 Kwb_Wu8 255.000000000 SigName 0.00 255.000000000 FORMAT "%13.9" NUMBER 10 /end CHARACTERISTIC
/begin CHARACTERISTIC DSM_EnvDfp_InjCtlDrift_C "Fehlerpfad spezifische Umweltbedingungen fuer Fehlerpfad Dfp_InjCtlDrift" VAL_BLK 0xCDFFE Kwb_Wu8 255.000000000 SigName 0.00 255.000000000 FORMAT "%13.9" NUMBER 10 /end CHARACTERISTIC
/begin CHARACTERISTIC DSM_EnvDfp_InjVCDActrChrg_C "Fehlerpfad spezifische Umweltbedingungen fuer Fehlerpfad Dfp_InjVCDActrChrg" VAL_BLK 0xCE008 Kwb_Wu8 255.000000000 SigName 0.00 255.000000000 FORMAT "%13.9" NUMBER 10 /end CHARACTERISTIC
/begin CHARACTERISTIC DSM_EnvDfp_InjVCDActrEnrg1_C "Fehlerpfad spezifische Umweltbedingungen fuer Fehlerpfad Dfp_InjVCDActrEnrg1" VAL_BLK 0xCE012 Kwb_Wu8 255.000000000 SigName 0.00 255.000000000 FORMAT "%13.9" NUMBER 10 /end CHARACTERISTIC
/begin CHARACTERISTIC DSM_EnvDfp_InjVCDActrEnrg2_C "Fehlerpfad spezifische Umweltbedingungen fuer Fehlerpfad Dfp_InjVCDActrEnrg2" VAL_BLK 0xCE01C Kwb_Wu8 255.000000000 SigName 0.00 255.000000000 FORMAT "%13.9" NUMBER 10 /end CHARACTERISTIC
/begin CHARACTERISTIC DSM_EnvDfp_InjVCDActrEnrg3_C "Fehlerpfad spezifische Umweltbedingungen fuer Fehlerpfad Dfp_InjVCDActrEnrg3" VAL_BLK 0xCE026 Kwb_Wu8 255.000000000 SigName 0.00 255.000000000 FORMAT "%13.9" NUMBER 10 /end CHARACTERISTIC
/begin CHARACTERISTIC DSM_EnvDfp_InjVCDActrEnrg4_C "Fehlerpfad spezifische Umweltbedingungen fuer Fehlerpfad Dfp_InjVCDActrEnrg4" VAL_BLK 0xCE030 Kwb_Wu8 255.000000000 SigName 0.00 255.000000000 FORMAT "%13.9" NUMBER 10 /end CHARACTERISTIC
/begin CHARACTERISTIC DSM_EnvDfp_InjVCDActrEnrg5_C "Fehlerpfad spezifische Umweltbedingungen fuer Fehlerpfad Dfp_InjVCDActrEnrg5" VAL_BLK 0xCE03A Kwb_Wu8 255.000000000 SigName 0.00 255.000000000 FORMAT "%13.9" NUMBER 10 /end CHARACTERISTIC
/begin CHARACTERISTIC DSM_EnvDfp_InjVCDActrEnrg6_C "Fehlerpfad spezifische Umweltbedingungen fuer Fehlerpfad Dfp_InjVCDActrEnrg6" VAL_BLK 0xCE044 Kwb_Wu8 255.000000000 SigName 0.00 255.000000000 FORMAT "%13.9" NUMBER 10 /end CHARACTERISTIC
/begin CHARACTERISTIC DSM_EnvDfp_InjVCDActrEnrg7_C "Fehlerpfad spezifische Umweltbedingungen fuer Fehlerpfad Dfp_InjVCDActrEnrg7" VAL_BLK 0xCE04E Kwb_Wu8 255.000000000 SigName 0.00 255.000000000 FORMAT "%13.9" NUMBER 10 /end CHARACTERISTIC
/begin CHARACTERISTIC DSM_EnvDfp_InjVCDActrEnrg8_C "Fehlerpfad spezifische Umweltbedingungen fuer Fehlerpfad Dfp_InjVCDActrEnrg8" VAL_BLK 0xCE058 Kwb_Wu8 255.000000000 SigName 0.00 255.000000000 FORMAT "%13.9" NUMBER 10 /end CHARACTERISTIC
/begin CHARACTERISTIC DSM_EnvDfp_InjVCDActrVolt_C "Fehlerpfad spezifische Umweltbedingungen fuer Fehlerpfad Dfp_InjVCDActrVolt" VAL_BLK 0xCE062 Kwb_Wu8 255.000000000 SigName 0.00 255.000000000 FORMAT "%13.9" NUMBER 10 /end CHARACTERISTIC
/begin CHARACTERISTIC DSM_EnvDfp_InjVCDClsBank1_C "Fehlerpfad spezifische Umweltbedingungen fuer Fehlerpfad Dfp_InjVCDClsBank1" VAL_BLK 0xCE06C Kwb_Wu8 255.000000000 SigName 0.00 255.000000000 FORMAT "%13.9" NUMBER 10 /end CHARACTERISTIC
/begin CHARACTERISTIC DSM_EnvDfp_InjVCDClsBank2_C "Fehlerpfad spezifische Umweltbedingungen fuer Fehlerpfad Dfp_InjVCDClsBank2" VAL_BLK 0xCE076 Kwb_Wu8 255.000000000 SigName 0.00 255.000000000 FORMAT "%13.9" NUMBER 10 /end CHARACTERISTIC
/begin CHARACTERISTIC DSM_EnvDfp_InjVCDMonCab_C "Fehlerpfad spezifische Umweltbedingungen fuer Fehlerpfad Dfp_InjVCDMonCab" VAL_BLK 0xCE080 Kwb_Wu8 255.000000000 SigName 0.00 255.000000000 FORMAT "%13.9" NUMBER 10 /end CHARACTERISTIC
/begin CHARACTERISTIC DSM_EnvDfp_InjVCDMonSwt_C "Fehlerpfad spezifische Umweltbedingungen fuer Fehlerpfad Dfp_InjVCDMonSwt" VAL_BLK 0xCE08A Kwb_Wu8 255.000000000 SigName 0.00 255.000000000 FORMAT "%13.9" NUMBER 10 /end CHARACTERISTIC
/begin CHARACTERISTIC DSM_EnvDfp_InjVCDShOffDCDC_C "Fehlerpfad spezifische Umweltbedingungen fuer Fehlerpfad Dfp_InjVCDShOffDCDC" VAL_BLK 0xCE094 Kwb_Wu8 255.000000000 SigName 0.00 255.000000000 FORMAT "%13.9" NUMBER 10 /end CHARACTERISTIC
/begin CHARACTERISTIC DSM_EnvDfp_InjVCDUBuf1_C "Fehlerpfad spezifische Umweltbedingungen fuer Fehlerpfad Dfp_InjVCDUBuf1" VAL_BLK 0xCE09E Kwb_Wu8 255.000000000 SigName 0.00 255.000000000 FORMAT "%13.9" NUMBER 10 /end CHARACTERISTIC
/begin CHARACTERISTIC DSM_EnvDfp_InjVCDUBuf2_C "Fehlerpfad spezifische Umweltbedingungen fuer Fehlerpfad Dfp_InjVCDUBuf2" VAL_BLK 0xCE0A8 Kwb_Wu8 255.000000000 SigName 0.00 255.000000000 FORMAT "%13.9" NUMBER 10 /end CHARACTERISTIC
/begin CHARACTERISTIC DSM_EnvDfp_InjVCD_CY370Ampl_C "Fehlerpfad spezifische Umweltbedingungen fuer Fehlerpfad Dfp_InjVCD_CY370Ampl" VAL_BLK 0xCE0B2 Kwb_Wu8 255.000000000 SigName 0.00 255.000000000 FORMAT "%13.9" NUMBER 10 /end CHARACTERISTIC
/begin CHARACTERISTIC DSM_EnvDfp_InjVCD_DrvTime_C "Fehlerpfad spezifische Umweltbedingungen fuer Fehlerpfad Dfp_InjVCD_DrvTime" VAL_BLK 0xCE0BC Kwb_Wu8 255.000000000 SigName 0.00 255.000000000 FORMAT "%13.9" NUMBER 10 /end CHARACTERISTIC
/begin CHARACTERISTIC DSM_EnvDfp_InjVCD_DrvTimeRcy_C "Fehlerpfad spezifische Umweltbedingungen fuer Fehlerpfad Dfp_InjVCD_DrvTimeRcy" VAL_BLK 0xCE0C6 Kwb_Wu8 255.000000000 SigName 0.00 255.000000000 FORMAT "%13.9" NUMBER 10 /end CHARACTERISTIC
/begin CHARACTERISTIC DSM_EnvDfp_InjVCD_TPUErr_C "Fehlerpfad spezifische Umweltbedingungen fuer Fehlerpfad Dfp_InjVCDTpuErr" VAL_BLK 0xCE0D0 Kwb_Wu8 255.000000000 SigName 0.00 255.000000000 FORMAT "%13.9" NUMBER 10 /end CHARACTERISTIC
/begin CHARACTERISTIC DSM_EnvDfp_InjVlvBnk1A_C "Fehlerpfad spezifische Umweltbedingungen fuer Fehlerpfad Dfp_InjVlvBnk1A" VAL_BLK 0xCE0DA Kwb_Wu8 255.000000000 SigName 0.00 255.000000000 FORMAT "%13.9" NUMBER 10 /end CHARACTERISTIC
/begin CHARACTERISTIC DSM_EnvDfp_InjVlvBnk1B_C "Fehlerpfad spezifische Umweltbedingungen fuer Fehlerpfad Dfp_InjVlvBnk1B" VAL_BLK 0xCE0E4 Kwb_Wu8 255.000000000 SigName 0.00 255.000000000 FORMAT "%13.9" NUMBER 10 /end CHARACTERISTIC
/begin CHARACTERISTIC DSM_EnvDfp_InjVlvBnk2A_C "Fehlerpfad spezifische Umweltbedingungen fuer Fehlerpfad Dfp_InjVlvBnk2A" VAL_BLK 0xCE0EE Kwb_Wu8 255.000000000 SigName 0.00 255.000000000 FORMAT "%13.9" NUMBER 10 /end CHARACTERISTIC
/begin CHARACTERISTIC DSM_EnvDfp_InjVlvBnk2B_C "Fehlerpfad spezifische Umweltbedingungen fuer Fehlerpfad Dfp_InjVlvBnk2B" VAL_BLK 0xCE0F8 Kwb_Wu8 255.000000000 SigName 0.00 255.000000000 FORMAT "%13.9" NUMBER 10 /end CHARACTERISTIC
/begin CHARACTERISTIC DSM_EnvDfp_InjVlvChipA_C "Fehlerpfad spezifische Umweltbedingungen fuer Fehlerpfad Dfp_InjVlvChipA" VAL_BLK 0xCE102 Kwb_Wu8 255.000000000 SigName 0.00 255.000000000 FORMAT "%13.9" NUMBER 10 /end CHARACTERISTIC
/begin CHARACTERISTIC DSM_EnvDfp_InjVlvChipB_C "Fehlerpfad spezifische Umweltbedingungen fuer Fehlerpfad Dfp_InjVlvChipB" VAL_BLK 0xCE10C Kwb_Wu8 255.000000000 SigName 0.00 255.000000000 FORMAT "%13.9" NUMBER 10 /end CHARACTERISTIC
/begin CHARACTERISTIC DSM_EnvDfp_InjVlvCyl1A_C "Fehlerpfad spezifische Umweltbedingungen fuer Fehlerpfad Dfp_InjVlvCyl1A" VAL_BLK 0xCE116 Kwb_Wu8 255.000000000 SigName 0.00 255.000000000 FORMAT "%13.9" NUMBER 10 /end CHARACTERISTIC
/begin CHARACTERISTIC DSM_EnvDfp_InjVlvCyl1B_C "Fehlerpfad spezifische Umweltbedingungen fuer Fehlerpfad Dfp_InjVlvCyl1B" VAL_BLK 0xCE120 Kwb_Wu8 255.000000000 SigName 0.00 255.000000000 FORMAT "%13.9" NUMBER 10 /end CHARACTERISTIC
/begin CHARACTERISTIC DSM_EnvDfp_InjVlvCyl1C_C "Fehlerpfad spezifische Umweltbedingungen fuer Fehlerpfad Dfp_InjVlvCyl1C" VAL_BLK 0xCE12A Kwb_Wu8 255.000000000 SigName 0.00 255.000000000 FORMAT "%13.9" NUMBER 10 /end CHARACTERISTIC
/begin CHARACTERISTIC DSM_EnvDfp_InjVlvCyl2A_C "Fehlerpfad spezifische Umweltbedingungen fuer Fehlerpfad Dfp_InjVlvCyl2A" VAL_BLK 0xCE134 Kwb_Wu8 255.000000000 SigName 0.00 255.000000000 FORMAT "%13.9" NUMBER 10 /end CHARACTERISTIC
/begin CHARACTERISTIC DSM_EnvDfp_InjVlvCyl2B_C "Fehlerpfad spezifische Umweltbedingungen fuer Fehlerpfad Dfp_InjVlvCyl2B" VAL_BLK 0xCE13E Kwb_Wu8 255.000000000 SigName 0.00 255.000000000 FORMAT "%13.9" NUMBER 10 /end CHARACTERISTIC
/begin CHARACTERISTIC DSM_EnvDfp_InjVlvCyl2C_C "Fehlerpfad spezifische Umweltbedingungen fuer Fehlerpfad Dfp_InjVlvCyl2C" VAL_BLK 0xCE148 Kwb_Wu8 255.000000000 SigName 0.00 255.000000000 FORMAT "%13.9" NUMBER 10 /end CHARACTERISTIC
/begin CHARACTERISTIC DSM_EnvDfp_InjVlvCyl3A_C "Fehlerpfad spezifische Umweltbedingungen fuer Fehlerpfad Dfp_InjVlvCyl3A" VAL_BLK 0xCE152 Kwb_Wu8 255.000000000 SigName 0.00 255.000000000 FORMAT "%13.9" NUMBER 10 /end CHARACTERISTIC
/begin CHARACTERISTIC DSM_EnvDfp_InjVlvCyl3B_C "Fehlerpfad spezifische Umweltbedingungen fuer Fehlerpfad Dfp_InjVlvCyl3B" VAL_BLK 0xCE15C Kwb_Wu8 255.000000000 SigName 0.00 255.000000000 FORMAT "%13.9" NUMBER 10 /end CHARACTERISTIC
/begin CHARACTERISTIC DSM_EnvDfp_InjVlvCyl3C_C "Fehlerpfad spezifische Umweltbedingungen fuer Fehlerpfad Dfp_InjVlvCyl3C" VAL_BLK 0xCE166 Kwb_Wu8 255.000000000 SigName 0.00 255.000000000 FORMAT "%13.9" NUMBER 10 /end CHARACTERISTIC
/begin CHARACTERISTIC DSM_EnvDfp_InjVlvCyl4A_C "Fehlerpfad spezifische Umweltbedingungen fuer Fehlerpfad Dfp_InjVlvCyl4A" VAL_BLK 0xCE170 Kwb_Wu8 255.000000000 SigName 0.00 255.000000000 FORMAT "%13.9" NUMBER 10 /end CHARACTERISTIC
/begin CHARACTERISTIC DSM_EnvDfp_InjVlvCyl4B_C "Fehlerpfad spezifische Umweltbedingungen fuer Fehlerpfad Dfp_InjVlvCyl4B" VAL_BLK 0xCE17A Kwb_Wu8 255.000000000 SigName 0.00 255.000000000 FORMAT "%13.9" NUMBER 10 /end CHARACTERISTIC
/begin CHARACTERISTIC DSM_EnvDfp_InjVlvCyl4C_C "Fehlerpfad spezifische Umweltbedingungen fuer Fehlerpfad Dfp_InjVlvCyl4C" VAL_BLK 0xCE184 Kwb_Wu8 255.000000000 SigName 0.00 255.000000000 FORMAT "%13.9" NUMBER 10 /end CHARACTERISTIC
/begin CHARACTERISTIC DSM_EnvDfp_InjVlvCyl5A_C "Fehlerpfad spezifische Umweltbedingungen fuer Fehlerpfad Dfp_InjVlvCyl5A" VAL_BLK 0xCE18E Kwb_Wu8 255.000000000 SigName 0.00 255.000000000 FORMAT "%13.9" NUMBER 10 /end CHARACTERISTIC
/begin CHARACTERISTIC DSM_EnvDfp_InjVlvCyl5B_C "Fehlerpfad spezifische Umweltbedingungen fuer Fehlerpfad Dfp_InjVlvCyl5B" VAL_BLK 0xCE198 Kwb_Wu8 255.000000000 SigName 0.00 255.000000000 FORMAT "%13.9" NUMBER 10 /end CHARACTERISTIC
/begin CHARACTERISTIC DSM_EnvDfp_InjVlvCyl5C_C "Fehlerpfad spezifische Umweltbedingungen fuer Fehlerpfad Dfp_InjVlvCyl5C" VAL_BLK 0xCE1A2 Kwb_Wu8 255.000000000 SigName 0.00 255.000000000 FORMAT "%13.9" NUMBER 10 /end CHARACTERISTIC
/begin CHARACTERISTIC DSM_EnvDfp_InjVlvCyl6A_C "Fehlerpfad spezifische Umweltbedingungen fuer Fehlerpfad Dfp_InjVlvCyl6A" VAL_BLK 0xCE1AC Kwb_Wu8 255.000000000 SigName 0.00 255.000000000 FORMAT "%13.9" NUMBER 10 /end CHARACTERISTIC
/begin CHARACTERISTIC DSM_EnvDfp_InjVlvCyl6B_C "Fehlerpfad spezifische Umweltbedingungen fuer Fehlerpfad Dfp_InjVlvCyl6B" VAL_BLK 0xCE1B6 Kwb_Wu8 255.000000000 SigName 0.00 255.000000000 FORMAT "%13.9" NUMBER 10 /end CHARACTERISTIC
/begin CHARACTERISTIC DSM_EnvDfp_InjVlvCyl6C_C "Fehlerpfad spezifische Umweltbedingungen fuer Fehlerpfad Dfp_InjVlvCyl6C" VAL_BLK 0xCE1C0 Kwb_Wu8 255.000000000 SigName 0.00 255.000000000 FORMAT "%13.9" NUMBER 10 /end CHARACTERISTIC
/begin CHARACTERISTIC DSM_EnvDfp_InjVlvCyl7A_C "Fehlerpfad spezifische Umweltbedingungen fuer Fehlerpfad Dfp_InjVlvCyl7A" VAL_BLK 0xCE1CA Kwb_Wu8 255.000000000 SigName 0.00 255.000000000 FORMAT "%13.9" NUMBER 10 /end CHARACTERISTIC
/begin CHARACTERISTIC DSM_EnvDfp_InjVlvCyl7B_C "Fehlerpfad spezifische Umweltbedingungen fuer Fehlerpfad Dfp_InjVlvCyl7B" VAL_BLK 0xCE1D4 Kwb_Wu8 255.000000000 SigName 0.00 255.000000000 FORMAT "%13.9" NUMBER 10 /end CHARACTERISTIC
/begin CHARACTERISTIC DSM_EnvDfp_InjVlvCyl7C_C "Fehlerpfad spezifische Umweltbedingungen fuer Fehlerpfad Dfp_InjVlvCyl7C" VAL_BLK 0xCE1DE Kwb_Wu8 255.000000000 SigName 0.00 255.000000000 FORMAT "%13.9" NUMBER 10 /end CHARACTERISTIC
/begin CHARACTERISTIC DSM_EnvDfp_InjVlvCyl8A_C "Fehlerpfad spezifische Umweltbedingungen fuer Fehlerpfad Dfp_InjVlvCyl8A" VAL_BLK 0xCE1E8 Kwb_Wu8 255.000000000 SigName 0.00 255.000000000 FORMAT "%13.9" NUMBER 10 /end CHARACTERISTIC
/begin CHARACTERISTIC DSM_EnvDfp_InjVlvCyl8B_C "Fehlerpfad spezifische Umweltbedingungen fuer Fehlerpfad Dfp_InjVlvCyl8B" VAL_BLK 0xCE1F2 Kwb_Wu8 255.000000000 SigName 0.00 255.000000000 FORMAT "%13.9" NUMBER 10 /end CHARACTERISTIC
/begin CHARACTERISTIC DSM_EnvDfp_InjVlvCyl8C_C "Fehlerpfad spezifische Umweltbedingungen fuer Fehlerpfad Dfp_InjVlvCyl8C" VAL_BLK 0xCE1FC Kwb_Wu8 255.000000000 SigName 0.00 255.000000000 FORMAT "%13.9" NUMBER 10 /end CHARACTERISTIC
/begin CHARACTERISTIC DSM_EnvDfp_InjVlvNVC1_C "Fehlerpfad spezifische Umweltbedingungen fuer Fehlerpfad Dfp_InjVlvNVC1" VAL_BLK 0xCE206 Kwb_Wu8 255.000000000 SigName 0.00 255.000000000 FORMAT "%13.9" NUMBER 10 /end CHARACTERISTIC
/begin CHARACTERISTIC DSM_EnvDfp_InjVlvNVC2_C "Fehlerpfad spezifische Umweltbedingungen fuer Fehlerpfad Dfp_InjVlvNVC2" VAL_BLK 0xCE210 Kwb_Wu8 255.000000000 SigName 0.00 255.000000000 FORMAT "%13.9" NUMBER 10 /end CHARACTERISTIC
/begin CHARACTERISTIC DSM_EnvDfp_InjVlvNVC3_C "Fehlerpfad spezifische Umweltbedingungen fuer Fehlerpfad Dfp_InjVlvNVC3" VAL_BLK 0xCE21A Kwb_Wu8 255.000000000 SigName 0.00 255.000000000 FORMAT "%13.9" NUMBER 10 /end CHARACTERISTIC
/begin CHARACTERISTIC DSM_EnvDfp_InjVlvNVC4_C "Fehlerpfad spezifische Umweltbedingungen fuer Fehlerpfad Dfp_InjVlvNVC4" VAL_BLK 0xCE224 Kwb_Wu8 255.000000000 SigName 0.00 255.000000000 FORMAT "%13.9" NUMBER 10 /end CHARACTERISTIC
/begin CHARACTERISTIC DSM_EnvDfp_InjVlvNVC5_C "Fehlerpfad spezifische Umweltbedingungen fuer Fehlerpfad Dfp_InjVlvNVC5" VAL_BLK 0xCE22E Kwb_Wu8 255.000000000 SigName 0.00 255.000000000 FORMAT "%13.9" NUMBER 10 /end CHARACTERISTIC
/begin CHARACTERISTIC DSM_EnvDfp_InjVlvNVC6_C "Fehlerpfad spezifische Umweltbedingungen fuer Fehlerpfad Dfp_InjVlvNVC6" VAL_BLK 0xCE238 Kwb_Wu8 255.000000000 SigName 0.00 255.000000000 FORMAT "%13.9" NUMBER 10 /end CHARACTERISTIC
/begin CHARACTERISTIC DSM_EnvDfp_InjVlvNVC7_C "Fehlerpfad spezifische Umweltbedingungen fuer Fehlerpfad Dfp_InjVlvNVC7" VAL_BLK 0xCE242 Kwb_Wu8 255.000000000 SigName 0.00 255.000000000 FORMAT "%13.9" NUMBER 10 /end CHARACTERISTIC
/begin CHARACTERISTIC DSM_EnvDfp_InjVlvNVC8_C "Fehlerpfad spezifische Umweltbedingungen fuer Fehlerpfad Dfp_InjVlvNVC8" VAL_BLK 0xCE24C Kwb_Wu8 255.000000000 SigName 0.00 255.000000000 FORMAT "%13.9" NUMBER 10 /end CHARACTERISTIC
/begin CHARACTERISTIC DSM_EnvDfp_KeyCheck_C "Fehlerpfad spezifische Umweltbedingungen fuer Fehlerpfad Dfp_KeyCheck" VAL_BLK 0xCE256 Kwb_Wu8 255.000000000 SigName 0.00 255.000000000 FORMAT "%13.9" NUMBER 10 /end CHARACTERISTIC
/begin CHARACTERISTIC DSM_EnvDfp_LIGovECUTransMode_C "Fehlerpfad spezifische Umweltbedingungen fuer Fehlerpfad Dfp_LIGovECUTransMode" VAL_BLK 0xCE260 Kwb_Wu8 255.000000000 SigName 0.00 255.000000000 FORMAT "%13.9" NUMBER 10 /end CHARACTERISTIC
/begin CHARACTERISTIC DSM_EnvDfp_LPACD_Max_C "Fehlerpfad spezifische Umweltbedingungen fuer Fehlerpfad Dfp_LPACD_Max" VAL_BLK 0xCE26A Kwb_Wu8 255.000000000 SigName 0.00 255.000000000 FORMAT "%13.9" NUMBER 10 /end CHARACTERISTIC
/begin CHARACTERISTIC DSM_EnvDfp_LPACD_Min_C "Fehlerpfad spezifische Umweltbedingungen fuer Fehlerpfad Dfp_LPACD_Min" VAL_BLK 0xCE274 Kwb_Wu8 255.000000000 SigName 0.00 255.000000000 FORMAT "%13.9" NUMBER 10 /end CHARACTERISTIC
/begin CHARACTERISTIC DSM_EnvDfp_LPACD_SigNpl_C "Fehlerpfad spezifische Umweltbedingungen fuer Fehlerpfad Dfp_LPACD_SigNpl" VAL_BLK 0xCE27E Kwb_Wu8 255.000000000 SigName 0.00 255.000000000 FORMAT "%13.9" NUMBER 10 /end CHARACTERISTIC
/begin CHARACTERISTIC DSM_EnvDfp_LSUCDCircNernst0B1_C "Fehlerpfad spezifische Umweltbedingungen fuer Fehlerpfad Dfp_LSUCDCircNernst0B1" VAL_BLK 0xCE288 Kwb_Wu8 255.000000000 SigName 0.00 255.000000000 FORMAT "%13.9" NUMBER 10 /end CHARACTERISTIC
/begin CHARACTERISTIC DSM_EnvDfp_LSUCDCircNernst0B2_C "Fehlerpfad spezifische Umweltbedingungen fuer Fehlerpfad Dfp_LSUCDCircNernst0B2" VAL_BLK 0xCE292 Kwb_Wu8 255.000000000 SigName 0.00 255.000000000 FORMAT "%13.9" NUMBER 10 /end CHARACTERISTIC
/begin CHARACTERISTIC DSM_EnvDfp_LSUCDCircPumpCur0B1_C "Fehlerpfad spezifische Umweltbedingungen fuer Fehlerpfad Dfp_LSUCDCircPumpCur0B1" VAL_BLK 0xCE29C Kwb_Wu8 255.000000000 SigName 0.00 255.000000000 FORMAT "%13.9" NUMBER 10 /end CHARACTERISTIC
/begin CHARACTERISTIC DSM_EnvDfp_LSUCDCircPumpCur0B2_C "Fehlerpfad spezifische Umweltbedingungen fuer Fehlerpfad Dfp_LSUCDCircPumpCur0B2" VAL_BLK 0xCE2A6 Kwb_Wu8 255.000000000 SigName 0.00 255.000000000 FORMAT "%13.9" NUMBER 10 /end CHARACTERISTIC
/begin CHARACTERISTIC DSM_EnvDfp_LSUCDCircVirtGnd0B1_C "Fehlerpfad spezifische Umweltbedingungen fuer Fehlerpfad Dfp_LSUCDCircVirtGnd0B1" VAL_BLK 0xCE2B0 Kwb_Wu8 255.000000000 SigName 0.00 255.000000000 FORMAT "%13.9" NUMBER 10 /end CHARACTERISTIC
/begin CHARACTERISTIC DSM_EnvDfp_LSUCDCircVirtGnd0B2_C "Fehlerpfad spezifische Umweltbedingungen fuer Fehlerpfad Dfp_LSUCDCircVirtGnd0B2" VAL_BLK 0xCE2BA Kwb_Wu8 255.000000000 SigName 0.00 255.000000000 FORMAT "%13.9" NUMBER 10 /end CHARACTERISTIC
/begin CHARACTERISTIC DSM_EnvDfp_LSUCDHeater0B1_C "Fehlerpfad spezifische Umweltbedingungen fuer Fehlerpfad Dfp_LSUCDHeater0B1" VAL_BLK 0xCE2C4 Kwb_Wu8 255.000000000 SigName 0.00 255.000000000 FORMAT "%13.9" NUMBER 10 /end CHARACTERISTIC
/begin CHARACTERISTIC DSM_EnvDfp_LSUCDHeater0B2_C "Fehlerpfad spezifische Umweltbedingungen fuer Fehlerpfad Dfp_LSUCDHeater0B2" VAL_BLK 0xCE2CE Kwb_Wu8 255.000000000 SigName 0.00 255.000000000 FORMAT "%13.9" NUMBER 10 /end CHARACTERISTIC
/begin CHARACTERISTIC DSM_EnvDfp_LSUCDHtCoup0B1_C "Fehlerpfad spezifische Umweltbedingungen fuer Fehlerpfad Dfp_LSUCDHtCoup0B1" VAL_BLK 0xCE2D8 Kwb_Wu8 255.000000000 SigName 0.00 255.000000000 FORMAT "%13.9" NUMBER 10 /end CHARACTERISTIC
/begin CHARACTERISTIC DSM_EnvDfp_LSUCDHtCoup0B2_C "Fehlerpfad spezifische Umweltbedingungen fuer Fehlerpfad Dfp_LSUCDHtCoup0B2" VAL_BLK 0xCE2E2 Kwb_Wu8 255.000000000 SigName 0.00 255.000000000 FORMAT "%13.9" NUMBER 10 /end CHARACTERISTIC
/begin CHARACTERISTIC DSM_EnvDfp_LSUCDO20B1_C "Fehlerpfad spezifische Umweltbedingungen fuer Fehlerpfad Dfp_LSUCDO20B1" VAL_BLK 0xCE2EC Kwb_Wu8 255.000000000 SigName 0.00 255.000000000 FORMAT "%13.9" NUMBER 10 /end CHARACTERISTIC
/begin CHARACTERISTIC DSM_EnvDfp_LSUCDO20B2_C "Fehlerpfad spezifische Umweltbedingungen fuer Fehlerpfad Dfp_LSUCDO20B2" VAL_BLK 0xCE2F6 Kwb_Wu8 255.000000000 SigName 0.00 255.000000000 FORMAT "%13.9" NUMBER 10 /end CHARACTERISTIC
/begin CHARACTERISTIC DSM_EnvDfp_LSUCDO2Clb0B1_C "Fehlerpfad spezifische Umweltbedingungen fuer Fehlerpfad Dfp_LSUCDO2Clb0B1" VAL_BLK 0xCE300 Kwb_Wu8 255.000000000 SigName 0.00 255.000000000 FORMAT "%13.9" NUMBER 10 /end CHARACTERISTIC
/begin CHARACTERISTIC DSM_EnvDfp_LSUCDO2Clb0B2_C "Fehlerpfad spezifische Umweltbedingungen fuer Fehlerpfad Dfp_LSUCDO2Clb0B2" VAL_BLK 0xCE30A Kwb_Wu8 255.000000000 SigName 0.00 255.000000000 FORMAT "%13.9" NUMBER 10 /end CHARACTERISTIC
/begin CHARACTERISTIC DSM_EnvDfp_LSUCDRiClb0B1_C "Fehlerpfad spezifische Umweltbedingungen fuer Fehlerpfad Dfp_LSUCDRiClb0B1" VAL_BLK 0xCE314 Kwb_Wu8 255.000000000 SigName 0.00 255.000000000 FORMAT "%13.9" NUMBER 10 /end CHARACTERISTIC
/begin CHARACTERISTIC DSM_EnvDfp_LSUCDRiClb0B2_C "Fehlerpfad spezifische Umweltbedingungen fuer Fehlerpfad Dfp_LSUCDRiClb0B2" VAL_BLK 0xCE31E Kwb_Wu8 255.000000000 SigName 0.00 255.000000000 FORMAT "%13.9" NUMBER 10 /end CHARACTERISTIC
/begin CHARACTERISTIC DSM_EnvDfp_LSUCDSPI0B1_C "Fehlerpfad spezifische Umweltbedingungen fuer Fehlerpfad Dfp_LSUCDSPI0B1" VAL_BLK 0xCE328 Kwb_Wu8 255.000000000 SigName 0.00 255.000000000 FORMAT "%13.9" NUMBER 10 /end CHARACTERISTIC
/begin CHARACTERISTIC DSM_EnvDfp_LSUCDSPI0B2_C "Fehlerpfad spezifische Umweltbedingungen fuer Fehlerpfad Dfp_LSUCDSPI0B2" VAL_BLK 0xCE332 Kwb_Wu8 255.000000000 SigName 0.00 255.000000000 FORMAT "%13.9" NUMBER 10 /end CHARACTERISTIC
/begin CHARACTERISTIC DSM_EnvDfp_LSUCDSPIBattLow0B1_C "Fehlerpfad spezifische Umweltbedingungen fuer Fehlerpfad Dfp_LSUCDSPIBattLow0B1" VAL_BLK 0xCE33C Kwb_Wu8 255.000000000 SigName 0.00 255.000000000 FORMAT "%13.9" NUMBER 10 /end CHARACTERISTIC
/begin CHARACTERISTIC DSM_EnvDfp_LSUCDSPIBattLow0B2_C "Fehlerpfad spezifische Umweltbedingungen fuer Fehlerpfad Dfp_LSUCDSPIBattLow0B2" VAL_BLK 0xCE346 Kwb_Wu8 255.000000000 SigName 0.00 255.000000000 FORMAT "%13.9" NUMBER 10 /end CHARACTERISTIC
/begin CHARACTERISTIC DSM_EnvDfp_LSUCDWireIP0B1_C "Fehlerpfad spezifische Umweltbedingungen fuer Fehlerpfad Dfp_LSUCDWireIP0B1" VAL_BLK 0xCE350 Kwb_Wu8 255.000000000 SigName 0.00 255.000000000 FORMAT "%13.9" NUMBER 10 /end CHARACTERISTIC
/begin CHARACTERISTIC DSM_EnvDfp_LSUCDWireIP0B2_C "Fehlerpfad spezifische Umweltbedingungen fuer Fehlerpfad Dfp_LSUCDWireIP0B2" VAL_BLK 0xCE35A Kwb_Wu8 255.000000000 SigName 0.00 255.000000000 FORMAT "%13.9" NUMBER 10 /end CHARACTERISTIC
/begin CHARACTERISTIC DSM_EnvDfp_LSUCtlRiExc0B1_C "Fehlerpfad spezifische Umweltbedingungen fuer Fehlerpfad Dfp_LSUCtlRiExc0B1" VAL_BLK 0xCE364 Kwb_Wu8 255.000000000 SigName 0.00 255.000000000 FORMAT "%13.9" NUMBER 10 /end CHARACTERISTIC
/begin CHARACTERISTIC DSM_EnvDfp_LSUCtlRiExc0B2_C "Fehlerpfad spezifische Umweltbedingungen fuer Fehlerpfad Dfp_LSUCtlRiExc0B2" VAL_BLK 0xCE36E Kwb_Wu8 255.000000000 SigName 0.00 255.000000000 FORMAT "%13.9" NUMBER 10 /end CHARACTERISTIC
/begin CHARACTERISTIC DSM_EnvDfp_LSUMon1SensB1_C "Fehlerpfad spezifische Umweltbedingungen fuer Fehlerpfad Dfp_LSUMon1SensB1" VAL_BLK 0xCE378 Kwb_Wu8 255.000000000 SigName 0.00 255.000000000 FORMAT "%13.9" NUMBER 10 /end CHARACTERISTIC
/begin CHARACTERISTIC DSM_EnvDfp_LSUMon1SensB2_C "Fehlerpfad spezifische Umweltbedingungen fuer Fehlerpfad Dfp_LSUMon1SensB2" VAL_BLK 0xCE382 Kwb_Wu8 255.000000000 SigName 0.00 255.000000000 FORMAT "%13.9" NUMBER 10 /end CHARACTERISTIC
/begin CHARACTERISTIC DSM_EnvDfp_LSUMon2SensB1_C "Fehlerpfad spezifische Umweltbedingungen fuer Fehlerpfad Dfp_LSUMon2SensB1" VAL_BLK 0xCE38C Kwb_Wu8 255.000000000 SigName 0.00 255.000000000 FORMAT "%13.9" NUMBER 10 /end CHARACTERISTIC
/begin CHARACTERISTIC DSM_EnvDfp_LSUMon2SensB2_C "Fehlerpfad spezifische Umweltbedingungen fuer Fehlerpfad Dfp_LSUMon2SensB2" VAL_BLK 0xCE396 Kwb_Wu8 255.000000000 SigName 0.00 255.000000000 FORMAT "%13.9" NUMBER 10 /end CHARACTERISTIC
/begin CHARACTERISTIC DSM_EnvDfp_MIL_C "Fehlerpfad spezifische Umweltbedingungen fuer Fehlerpfad Dfp_MIL" VAL_BLK 0xCE3A0 Kwb_Wu8 255.000000000 SigName 0.00 255.000000000 FORMAT "%13.9" NUMBER 10 /end CHARACTERISTIC
/begin CHARACTERISTIC DSM_EnvDfp_MRlyCD_C "Fehlerpfad spezifische Umweltbedingungen fuer Fehlerpfad Dfp_MRlyCD" VAL_BLK 0xCE3AA Kwb_Wu8 255.000000000 SigName 0.00 255.000000000 FORMAT "%13.9" NUMBER 10 /end CHARACTERISTIC
/begin CHARACTERISTIC DSM_EnvDfp_MSMon_C "Fehlerpfad spezifische Umweltbedingungen fuer Fehlerpfad Dfp_MSMon" VAL_BLK 0xCE3B4 Kwb_Wu8 255.000000000 SigName 0.00 255.000000000 FORMAT "%13.9" NUMBER 10 /end CHARACTERISTIC
/begin CHARACTERISTIC DSM_EnvDfp_MSMonConsist_C "Fehlerpfad spezifische Umweltbedingungen fuer Fehlerpfad Dfp_MSMonConsist" VAL_BLK 0xCE3BE Kwb_Wu8 255.000000000 SigName 0.00 255.000000000 FORMAT "%13.9" NUMBER 10 /end CHARACTERISTIC
/begin CHARACTERISTIC DSM_EnvDfp_MSMonPFlt1_C "Fehlerpfad spezifische Umweltbedingungen fuer Fehlerpfad Dfp_MSMonPFlt1" VAL_BLK 0xCE3C8 Kwb_Wu8 255.000000000 SigName 0.00 255.000000000 FORMAT "%13.9" NUMBER 10 /end CHARACTERISTIC
/begin CHARACTERISTIC DSM_EnvDfp_MSMonPFlt2_C "Fehlerpfad spezifische Umweltbedingungen fuer Fehlerpfad Dfp_MSMonPFlt2" VAL_BLK 0xCE3D2 Kwb_Wu8 255.000000000 SigName 0.00 255.000000000 FORMAT "%13.9" NUMBER 10 /end CHARACTERISTIC
/begin CHARACTERISTIC DSM_EnvDfp_MSMonPFlt3_C "Fehlerpfad spezifische Umweltbedingungen fuer Fehlerpfad Dfp_MSMonPFlt3" VAL_BLK 0xCE3DC Kwb_Wu8 255.000000000 SigName 0.00 255.000000000 FORMAT "%13.9" NUMBER 10 /end CHARACTERISTIC
/begin CHARACTERISTIC DSM_EnvDfp_MSMonPFlt4_C "Fehlerpfad spezifische Umweltbedingungen fuer Fehlerpfad Dfp_MSMonPFlt4" VAL_BLK 0xCE3E6 Kwb_Wu8 255.000000000 SigName 0.00 255.000000000 FORMAT "%13.9" NUMBER 10 /end CHARACTERISTIC
/begin CHARACTERISTIC DSM_EnvDfp_MSMon_ARS_TO_C "Fehlerpfad spezifische Umweltbedingungen fuer Fehlerpfad Dfp_MSMon_ARS_TO" VAL_BLK 0xCE3F0 Kwb_Wu8 255.000000000 SigName 0.00 255.000000000 FORMAT "%13.9" NUMBER 10 /end CHARACTERISTIC
/begin CHARACTERISTIC DSM_EnvDfp_MSMon_AirCtl_C "Fehlerpfad spezifische Umweltbedingungen fuer Fehlerpfad Dfp_MSMon_AirCtl" VAL_BLK 0xCE3FA Kwb_Wu8 255.000000000 SigName 0.00 255.000000000 FORMAT "%13.9" NUMBER 10 /end CHARACTERISTIC
/begin CHARACTERISTIC DSM_EnvDfp_MSMon_AirSys0_C "Fehlerpfad spezifische Umweltbedingungen fuer Fehlerpfad Dfp_MSMon_AirSys0" VAL_BLK 0xCE404 Kwb_Wu8 255.000000000 SigName 0.00 255.000000000 FORMAT "%13.9" NUMBER 10 /end CHARACTERISTIC
/begin CHARACTERISTIC DSM_EnvDfp_MSMon_AirSys1_C "Fehlerpfad spezifische Umweltbedingungen fuer Fehlerpfad Dfp_MSMon_AirSys1" VAL_BLK 0xCE40E Kwb_Wu8 255.000000000 SigName 0.00 255.000000000 FORMAT "%13.9" NUMBER 10 /end CHARACTERISTIC
/begin CHARACTERISTIC DSM_EnvDfp_MSMon_AirSys2_C "Fehlerpfad spezifische Umweltbedingungen fuer Fehlerpfad Dfp_MSMon_AirSys2" VAL_BLK 0xCE418 Kwb_Wu8 255.000000000 SigName 0.00 255.000000000 FORMAT "%13.9" NUMBER 10 /end CHARACTERISTIC
/begin CHARACTERISTIC DSM_EnvDfp_MSMon_AirSys3_C "Fehlerpfad spezifische Umweltbedingungen fuer Fehlerpfad Dfp_MSMon_AirSys3" VAL_BLK 0xCE422 Kwb_Wu8 255.000000000 SigName 0.00 255.000000000 FORMAT "%13.9" NUMBER 10 /end CHARACTERISTIC
/begin CHARACTERISTIC DSM_EnvDfp_MSMon_AirSys4_C "Fehlerpfad spezifische Umweltbedingungen fuer Fehlerpfad Dfp_MSMon_AirSys4" VAL_BLK 0xCE42C Kwb_Wu8 255.000000000 SigName 0.00 255.000000000 FORMAT "%13.9" NUMBER 10 /end CHARACTERISTIC
/begin CHARACTERISTIC DSM_EnvDfp_MSMon_AirSys7_C "Fehlerpfad spezifische Umweltbedingungen fuer Fehlerpfad Dfp_MSMon_AirSys7" VAL_BLK 0xCE436 Kwb_Wu8 255.000000000 SigName 0.00 255.000000000 FORMAT "%13.9" NUMBER 10 /end CHARACTERISTIC
/begin CHARACTERISTIC DSM_EnvDfp_MSMon_CanDef_C "Fehlerpfad spezifische Umweltbedingungen fuer Fehlerpfad Dfp_MSMon_CanDef" VAL_BLK 0xCE440 Kwb_Wu8 255.000000000 SigName 0.00 255.000000000 FORMAT "%13.9" NUMBER 10 /end CHARACTERISTIC
/begin CHARACTERISTIC DSM_EnvDfp_MSMon_CoEng_OffVeh_C "Fehlerpfad spezifische Umweltbedingungen fuer Fehlerpfad Dfp_MSMon_CoEng_OffVeh_C" VAL_BLK 0xCE44A Kwb_Wu8 255.000000000 SigName 0.00 255.000000000 FORMAT "%13.9" NUMBER 10 /end CHARACTERISTIC
/begin CHARACTERISTIC DSM_EnvDfp_MSMon_CoEng_Rev1_C "Fehlerpfad spezifische Umweltbedingungen fuer Fehlerpfad Dfp_MSMon_CoEng_Rev1_C" VAL_BLK 0xCE454 Kwb_Wu8 255.000000000 SigName 0.00 255.000000000 FORMAT "%13.9" NUMBER 10 /end CHARACTERISTIC
/begin CHARACTERISTIC DSM_EnvDfp_MSMon_CoEng_Rev2_C "Fehlerpfad spezifische Umweltbedingungen fuer Fehlerpfad Dfp_MSMon_CoEng_Rev2_C" VAL_BLK 0xCE45E Kwb_Wu8 255.000000000 SigName 0.00 255.000000000 FORMAT "%13.9" NUMBER 10 /end CHARACTERISTIC
/begin CHARACTERISTIC DSM_EnvDfp_MSMon_CoEng_RevMS_C "Fehlerpfad spezifische Umweltbedingungen fuer Fehlerpfad Dfp_MSMon_CoEng_RevMS_C" VAL_BLK 0xCE468 Kwb_Wu8 255.000000000 SigName 0.00 255.000000000 FORMAT "%13.9" NUMBER 10 /end CHARACTERISTIC
/begin CHARACTERISTIC DSM_EnvDfp_MSMon_DSC_TO_C "Fehlerpfad spezifische Umweltbedingungen fuer Fehlerpfad Dfp_MSMon_DSC_TO" VAL_BLK 0xCE472 Kwb_Wu8 255.000000000 SigName 0.00 255.000000000 FORMAT "%13.9" NUMBER 10 /end CHARACTERISTIC
/begin CHARACTERISTIC DSM_EnvDfp_MSMon_EGS_TO_C "Fehlerpfad spezifische Umweltbedingungen fuer Fehlerpfad Dfp_MSMon_EGS_TO" VAL_BLK 0xCE47C Kwb_Wu8 255.000000000 SigName 0.00 255.000000000 FORMAT "%13.9" NUMBER 10 /end CHARACTERISTIC
/begin CHARACTERISTIC DSM_EnvDfp_MSMon_FrmMngCoEng_C "Fehlerpfad spezifische Umweltbedingungen fuer Fehlerpfad Dfp_MSMon_FrmMngCoEng" VAL_BLK 0xCE486 Kwb_Wu8 255.000000000 SigName 0.00 255.000000000 FORMAT "%13.9" NUMBER 10 /end CHARACTERISTIC
/begin CHARACTERISTIC DSM_EnvDfp_MSMon_FrmMngPT_C "Fehlerpfad spezifische Umweltbedingungen fuer Fehlerpfad Dfp_MSMon_FrmMngPT_C" VAL_BLK 0xCE490 Kwb_Wu8 255.000000000 SigName 0.00 255.000000000 FORMAT "%13.9" NUMBER 10 /end CHARACTERISTIC
/begin CHARACTERISTIC DSM_EnvDfp_MSMon_FrmMngPT2_C "Fehlerpfad spezifische Umweltbedingungen fuer Fehlerpfad Dfp_MSMon_FrmMngPT2" VAL_BLK 0xCE49A Kwb_Wu8 255.000000000 SigName 0.00 255.000000000 FORMAT "%13.9" NUMBER 10 /end CHARACTERISTIC
/begin CHARACTERISTIC DSM_EnvDfp_MSMon_Mil_C "Fehlerpfad spezifische Umweltbedingungen fuer Fehlerpfad Dfp_MSMon_Mil_C" VAL_BLK 0xCE4A4 Kwb_Wu8 255.000000000 SigName 0.00 255.000000000 FORMAT "%13.9" NUMBER 10 /end CHARACTERISTIC
/begin CHARACTERISTIC DSM_EnvDfp_MSMon_NetMngPtCan_C "Fehlerpfad spezifische Umweltbedingungen fuer Fehlerpfad Dfp_MSMon_NetMngPtCan" VAL_BLK 0xCE4AE Kwb_Wu8 255.000000000 SigName 0.00 255.000000000 FORMAT "%13.9" NUMBER 10 /end CHARACTERISTIC
/begin CHARACTERISTIC DSM_EnvDfp_MSMon_RailCDPMon_C "Fehlerpfad spezifische Umweltbedingungen fuer Fehlerpfad Dfp_MSMon_RailCDPMon" VAL_BLK 0xCE4B8 Kwb_Wu8 255.000000000 SigName 0.00 255.000000000 FORMAT "%13.9" NUMBER 10 /end CHARACTERISTIC
/begin CHARACTERISTIC DSM_EnvDfp_MSMon_StEGS_C "Fehlerpfad spezifische Umweltbedingungen fuer Fehlerpfad Dfp_MSMon_StEGS" VAL_BLK 0xCE4C2 Kwb_Wu8 255.000000000 SigName 0.00 255.000000000 FORMAT "%13.9" NUMBER 10 /end CHARACTERISTIC
/begin CHARACTERISTIC DSM_EnvDfp_MSMon_SysLamp_C "Fehlerpfad spezifische Umweltbedingungen fuer Fehlerpfad Dfp_MSMon_SysLamp_C" VAL_BLK 0xCE4CC Kwb_Wu8 255.000000000 SigName 0.00 255.000000000 FORMAT "%13.9" NUMBER 10 /end CHARACTERISTIC
/begin CHARACTERISTIC DSM_EnvDfp_MSMon_ZFCClbActv_C "Fehlerpfad spezifische Umweltbedingungen fuer Fehlerpfad Dfp_MSMon_ZFCClbActv" VAL_BLK 0xCE4D6 Kwb_Wu8 255.000000000 SigName 0.00 255.000000000 FORMAT "%13.9" NUMBER 10 /end CHARACTERISTIC
/begin CHARACTERISTIC DSM_EnvDfp_MSMon_qLimErr_C "Fehlerpfad spezifische Umweltbedingungen fuer Fehlerpfad Dfp_MSMon_qLimErr_C" VAL_BLK 0xCE4E0 Kwb_Wu8 255.000000000 SigName 0.00 255.000000000 FORMAT "%13.9" NUMBER 10 /end CHARACTERISTIC
/begin CHARACTERISTIC DSM_EnvDfp_MSMon_trqCoDT_C "Fehlerpfad spezifische Umweltbedingungen fuer Fehlerpfad Dfp_MSMon_trqCoDT_C" VAL_BLK 0xCE4EA Kwb_Wu8 255.000000000 SigName 0.00 255.000000000 FORMAT "%13.9" NUMBER 10 /end CHARACTERISTIC
/begin CHARACTERISTIC DSM_EnvDfp_MSMon_trqCoVeh_C "Fehlerpfad spezifische Umweltbedingungen fuer Fehlerpfad Dfp_MSMon_trqCoVeh_C" VAL_BLK 0xCE4F4 Kwb_Wu8 255.000000000 SigName 0.00 255.000000000 FORMAT "%13.9" NUMBER 10 /end CHARACTERISTIC
/begin CHARACTERISTIC DSM_EnvDfp_MSMon_trqCoVehLim_C "Fehlerpfad spezifische Umweltbedingungen fuer Fehlerpfad Dfp_MSMon_trqCoVehLim_C" VAL_BLK 0xCE4FE Kwb_Wu8 255.000000000 SigName 0.00 255.000000000 FORMAT "%13.9" NUMBER 10 /end CHARACTERISTIC
/begin CHARACTERISTIC DSM_EnvDfp_MSMon_trqDesExt_C "Fehlerpfad spezifische Umweltbedingungen fuer Fehlerpfad Dfp_MSMon_trqDesExt_C" VAL_BLK 0xCE508 Kwb_Wu8 255.000000000 SigName 0.00 255.000000000 FORMAT "%13.9" NUMBER 10 /end CHARACTERISTIC
/begin CHARACTERISTIC DSM_EnvDfp_MSMon_trqDesExtRev_C "Fehlerpfad spezifische Umweltbedingungen fuer Fehlerpfad Dfp_MSMon_trqDesExtRev_C" VAL_BLK 0xCE512 Kwb_Wu8 255.000000000 SigName 0.00 255.000000000 FORMAT "%13.9" NUMBER 10 /end CHARACTERISTIC
/begin CHARACTERISTIC DSM_EnvDfp_MSMon_trqLimErr_C "Fehlerpfad spezifische Umweltbedingungen fuer Fehlerpfad Dfp_MSMon_trqLimErr_C" VAL_BLK 0xCE51C Kwb_Wu8 255.000000000 SigName 0.00 255.000000000 FORMAT "%13.9" NUMBER 10 /end CHARACTERISTIC
/begin CHARACTERISTIC DSM_EnvDfp_MSMon_trqLimErr1_C "Fehlerpfad spezifische Umweltbedingungen fuer Fehlerpfad Dfp_MSMon_trqLimErr1_C" VAL_BLK 0xCE526 Kwb_Wu8 255.000000000 SigName 0.00 255.000000000 FORMAT "%13.9" NUMBER 10 /end CHARACTERISTIC
/begin CHARACTERISTIC DSM_EnvDfp_MSMon_trqLimErr2_C "Fehlerpfad spezifische Umweltbedingungen fuer Fehlerpfad Dfp_MSMon_trqLimErr2_C" VAL_BLK 0xCE530 Kwb_Wu8 255.000000000 SigName 0.00 255.000000000 FORMAT "%13.9" NUMBER 10 /end CHARACTERISTIC
/begin CHARACTERISTIC DSM_EnvDfp_MSMon_trqLimErr3_C "Fehlerpfad spezifische Umweltbedingungen fuer Fehlerpfad Dfp_MSMon_trqLimErr3" VAL_BLK 0xCE53A Kwb_Wu8 255.000000000 SigName 0.00 255.000000000 FORMAT "%13.9" NUMBER 10 /end CHARACTERISTIC
/begin CHARACTERISTIC DSM_EnvDfp_MSMon_trqLimErr4_C "Fehlerpfad spezifische Umweltbedingungen fuer Fehlerpfad Dfp_MSMon_trqLimErr4" VAL_BLK 0xCE544 Kwb_Wu8 255.000000000 SigName 0.00 255.000000000 FORMAT "%13.9" NUMBER 10 /end CHARACTERISTIC
/begin CHARACTERISTIC DSM_EnvDfp_MSidCD_Comm_C "Fehlerpfad spezifische Umweltbedingungen fuer Fehlerpfad Dfp_MSidCD_Comm" VAL_BLK 0xCE54E Kwb_Wu8 255.000000000 SigName 0.00 255.000000000 FORMAT "%13.9" NUMBER 10 /end CHARACTERISTIC
/begin CHARACTERISTIC DSM_EnvDfp_MSidCD_EcuMixed_C "Fehlerpfad spezifische Umweltbedingungen fuer Fehlerpfad Dfp_MSidCD_EcuMixed" VAL_BLK 0xCE558 Kwb_Wu8 255.000000000 SigName 0.00 255.000000000 FORMAT "%13.9" NUMBER 10 /end CHARACTERISTIC
/begin CHARACTERISTIC DSM_EnvDfp_MSidCD_Pin_C "Fehlerpfad spezifische Umweltbedingungen fuer Fehlerpfad Dfp_MSidCD_Pin" VAL_BLK 0xCE562 Kwb_Wu8 255.000000000 SigName 0.00 255.000000000 FORMAT "%13.9" NUMBER 10 /end CHARACTERISTIC
/begin CHARACTERISTIC DSM_EnvDfp_MSidCD_Sel_INI_C "Fehlerpfad spezifische Umweltbedingungen fuer Fehlerpfad Dfp_MSidCD_Sel_INI" VAL_BLK 0xCE56C Kwb_Wu8 255.000000000 SigName 0.00 255.000000000 FORMAT "%13.9" NUMBER 10 /end CHARACTERISTIC
/begin CHARACTERISTIC DSM_EnvDfp_MSidCD_Select_C "Fehlerpfad spezifische Umweltbedingungen fuer Fehlerpfad Dfp_MSidCD_Select" VAL_BLK 0xCE576 Kwb_Wu8 255.000000000 SigName 0.00 255.000000000 FORMAT "%13.9" NUMBER 10 /end CHARACTERISTIC
/begin CHARACTERISTIC DSM_EnvDfp_MSid_SwCmp_C "Fehlerpfad spezifische Umweltbedingungen fuer Fehlerpfad Dfp_MSid_SwCmp" VAL_BLK 0xCE580 Kwb_Wu8 255.000000000 SigName 0.00 255.000000000 FORMAT "%13.9" NUMBER 10 /end CHARACTERISTIC
/begin CHARACTERISTIC DSM_EnvDfp_MSid_regEEPDiff_C "Fehlerpfad spezifische Umweltbedingungen fuer Fehlerpfad Dfp_MSid_regEEPDiff" VAL_BLK 0xCE58A Kwb_Wu8 255.000000000 SigName 0.00 255.000000000 FORMAT "%13.9" NUMBER 10 /end CHARACTERISTIC
/begin CHARACTERISTIC DSM_EnvDfp_MeUnCDNoLoad_C "Fehlerpfad spezifische Umweltbedingungen fuer Fehlerpfad Dfp_MeUnCDNoLoad" VAL_BLK 0xCE594 Kwb_Wu8 255.000000000 SigName 0.00 255.000000000 FORMAT "%13.9" NUMBER 10 /end CHARACTERISTIC
/begin CHARACTERISTIC DSM_EnvDfp_MeUnCDSCBat_C "Fehlerpfad spezifische Umweltbedingungen fuer Fehlerpfad Dfp_MeUnCDSCBat" VAL_BLK 0xCE59E Kwb_Wu8 255.000000000 SigName 0.00 255.000000000 FORMAT "%13.9" NUMBER 10 /end CHARACTERISTIC
/begin CHARACTERISTIC DSM_EnvDfp_MeUnCDSCGnd_C "Fehlerpfad spezifische Umweltbedingungen fuer Fehlerpfad Dfp_MeUnCDSCGnd" VAL_BLK 0xCE5A8 Kwb_Wu8 255.000000000 SigName 0.00 255.000000000 FORMAT "%13.9" NUMBER 10 /end CHARACTERISTIC
/begin CHARACTERISTIC DSM_EnvDfp_MeUnCD_ADC_C "Fehlerpfad spezifische Umweltbedingungen fuer Fehlerpfad Dfp_MeUnCD_ADC" VAL_BLK 0xCE5B2 Kwb_Wu8 255.000000000 SigName 0.00 255.000000000 FORMAT "%13.9" NUMBER 10 /end CHARACTERISTIC
/begin CHARACTERISTIC DSM_EnvDfp_MeUnCD_SigTst_C "Fehlerpfad spezifische Umweltbedingungen fuer Fehlerpfad Dfp_MeUnCD_SigTst" VAL_BLK 0xCE5BC Kwb_Wu8 255.000000000 SigName 0.00 255.000000000 FORMAT "%13.9" NUMBER 10 /end CHARACTERISTIC
/begin CHARACTERISTIC DSM_EnvDfp_Montr_C "Fehlerpfad spezifische Umweltbedingungen fuer Fehlerpfad Dfp_Montr" VAL_BLK 0xCE5C6 Kwb_Wu8 255.000000000 SigName 0.00 255.000000000 FORMAT "%13.9" NUMBER 10 /end CHARACTERISTIC
/begin CHARACTERISTIC DSM_EnvDfp_NetMngDeviceA_C "Fehlerpfad spezifische Umweltbedingungen fuer Fehlerpfad Dfp_NetMngDeviceA" VAL_BLK 0xCE5D0 Kwb_Wu8 255.000000000 SigName 0.00 255.000000000 FORMAT "%13.9" NUMBER 10 /end CHARACTERISTIC
/begin CHARACTERISTIC DSM_EnvDfp_NetMngDeviceB_C "Fehlerpfad spezifische Umweltbedingungen fuer Fehlerpfad Dfp_NetMngDeviceB" VAL_BLK 0xCE5DA Kwb_Wu8 255.000000000 SigName 0.00 255.000000000 FORMAT "%13.9" NUMBER 10 /end CHARACTERISTIC
/begin CHARACTERISTIC DSM_EnvDfp_NetMngDeviceC_C "Fehlerpfad spezifische Umweltbedingungen fuer Fehlerpfad Dfp_NetMngDeviceC" VAL_BLK 0xCE5E4 Kwb_Wu8 255.000000000 SigName 0.00 255.000000000 FORMAT "%13.9" NUMBER 10 /end CHARACTERISTIC
/begin CHARACTERISTIC DSM_EnvDfp_NetMngPrvCan_C "Fehlerpfad spezifische Umweltbedingungen fuer Fehlerpfad Dfp_NetMngPrvCan" VAL_BLK 0xCE5EE Kwb_Wu8 255.000000000 SigName 0.00 255.000000000 FORMAT "%13.9" NUMBER 10 /end CHARACTERISTIC
/begin CHARACTERISTIC DSM_EnvDfp_NetMngPrvCanSlave_C "Fehlerpfad spezifische Umweltbedingungen fuer Fehlerpfad Dfp_NetMngPrvCanSlave" VAL_BLK 0xCE5F8 Kwb_Wu8 255.000000000 SigName 0.00 255.000000000 FORMAT "%13.9" NUMBER 10 /end CHARACTERISTIC
/begin CHARACTERISTIC DSM_EnvDfp_NetMngPtCan_C "Fehlerpfad spezifische Umweltbedingungen fuer Fehlerpfad Dfp_NetMngPtCan" VAL_BLK 0xCE602 Kwb_Wu8 255.000000000 SigName 0.00 255.000000000 FORMAT "%13.9" NUMBER 10 /end CHARACTERISTIC
/begin CHARACTERISTIC DSM_EnvDfp_NetMngPtCanSlave_C "Fehlerpfad spezifische Umweltbedingungen fuer Fehlerpfad Dfp_NetMngPtCanSlave" VAL_BLK 0xCE60C Kwb_Wu8 255.000000000 SigName 0.00 255.000000000 FORMAT "%13.9" NUMBER 10 /end CHARACTERISTIC
/begin CHARACTERISTIC DSM_EnvDfp_OPSCD_Lamp_C "Fehlerpfad spezifische Umweltbedingungen fuer Fehlerpfad Dfp_OPSCD_Lamp" VAL_BLK 0xCE616 Kwb_Wu8 255.000000000 SigName 0.00 255.000000000 FORMAT "%13.9" NUMBER 10 /end CHARACTERISTIC
/begin CHARACTERISTIC DSM_EnvDfp_OPSCD_anain_C "Fehlerpfad spezifische Umweltbedingungen fuer Fehlerpfad Dfp_OPSCD_anain" VAL_BLK 0xCE620 Kwb_Wu8 255.000000000 SigName 0.00 255.000000000 FORMAT "%13.9" NUMBER 10 /end CHARACTERISTIC
/begin CHARACTERISTIC DSM_EnvDfp_OTSCD_C "Fehlerpfad spezifische Umweltbedingungen fuer Fehlerpfad Dfp_OTSCD" VAL_BLK 0xCE62A Kwb_Wu8 255.000000000 SigName 0.00 255.000000000 FORMAT "%13.9" NUMBER 10 /end CHARACTERISTIC
/begin CHARACTERISTIC DSM_EnvDfp_OvRMon_C "Fehlerpfad spezifische Umweltbedingungen fuer Fehlerpfad Dfp_OvRMon" VAL_BLK 0xCE634 Kwb_Wu8 255.000000000 SigName 0.00 255.000000000 FORMAT "%13.9" NUMBER 10 /end CHARACTERISTIC
/begin CHARACTERISTIC DSM_EnvDfp_OvRMonSigA_C "Fehlerpfad spezifische Umweltbedingungen fuer Fehlerpfad Dfp_OvRMonSigA" VAL_BLK 0xCE63E Kwb_Wu8 255.000000000 SigName 0.00 255.000000000 FORMAT "%13.9" NUMBER 10 /end CHARACTERISTIC
/begin CHARACTERISTIC DSM_EnvDfp_OxiCCDTPreB1_C "Fehlerpfad spezifische Umweltbedingungen fuer Fehlerpfad Dfp_OxiCCDTPreB1" VAL_BLK 0xCE648 Kwb_Wu8 255.000000000 SigName 0.00 255.000000000 FORMAT "%13.9" NUMBER 10 /end CHARACTERISTIC
/begin CHARACTERISTIC DSM_EnvDfp_OxiCCDTPreB2_C "Fehlerpfad spezifische Umweltbedingungen fuer Fehlerpfad Dfp_OxiCCDTPreB2" VAL_BLK 0xCE652 Kwb_Wu8 255.000000000 SigName 0.00 255.000000000 FORMAT "%13.9" NUMBER 10 /end CHARACTERISTIC
/begin CHARACTERISTIC DSM_EnvDfp_PCBS_C "Fehlerpfad spezifische Umweltbedingungen fuer Fehlerpfad Dfp_PCBS" VAL_BLK 0xCE65C Kwb_Wu8 255.000000000 SigName 0.00 255.000000000 FORMAT "%13.9" NUMBER 10 /end CHARACTERISTIC
/begin CHARACTERISTIC DSM_EnvDfp_PCR_BalGvnr_C "Fehlerpfad spezifische Umweltbedingungen fuer Fehlerpfad Dfp_PCR_BalGvnr" VAL_BLK 0xCE666 Kwb_Wu8 255.000000000 SigName 0.00 255.000000000 FORMAT "%13.9" NUMBER 10 /end CHARACTERISTIC
/begin CHARACTERISTIC DSM_EnvDfp_PCR_GovDevNeg_C "Fehlerpfad spezifische Umweltbedingungen fuer Fehlerpfad Dfp_PCR_GovDevNeg" VAL_BLK 0xCE670 Kwb_Wu8 255.000000000 SigName 0.00 255.000000000 FORMAT "%13.9" NUMBER 10 /end CHARACTERISTIC
/begin CHARACTERISTIC DSM_EnvDfp_PCR_GovDevPos_C "Fehlerpfad spezifische Umweltbedingungen fuer Fehlerpfad Dfp_PCR_GovDevPos" VAL_BLK 0xCE67A Kwb_Wu8 255.000000000 SigName 0.00 255.000000000 FORMAT "%13.9" NUMBER 10 /end CHARACTERISTIC
/begin CHARACTERISTIC DSM_EnvDfp_PCR_LPGvnrDvtNeg_C "Fehlerpfad spezifische Umweltbedingungen fuer Fehlerpfad Dfp_PCR_LPGvnrDvtNeg" VAL_BLK 0xCE684 Kwb_Wu8 255.000000000 SigName 0.00 255.000000000 FORMAT "%13.9" NUMBER 10 /end CHARACTERISTIC
/begin CHARACTERISTIC DSM_EnvDfp_PCR_LPGvnrDvtPos_C "Fehlerpfad spezifische Umweltbedingungen fuer Fehlerpfad Dfp_PCR_LPGvnrDvtPos" VAL_BLK 0xCE68E Kwb_Wu8 255.000000000 SigName 0.00 255.000000000 FORMAT "%13.9" NUMBER 10 /end CHARACTERISTIC
/begin CHARACTERISTIC DSM_EnvDfp_PCVCDNoLoad_C "Fehlerpfad spezifische Umweltbedingungen fuer Fehlerpfad Dfp_PCVCDNoLoad" VAL_BLK 0xCE698 Kwb_Wu8 255.000000000 SigName 0.00 255.000000000 FORMAT "%13.9" NUMBER 10 /end CHARACTERISTIC
/begin CHARACTERISTIC DSM_EnvDfp_PCVCDSCBat_C "Fehlerpfad spezifische Umweltbedingungen fuer Fehlerpfad Dfp_PCVCDSCBat" VAL_BLK 0xCE6A2 Kwb_Wu8 255.000000000 SigName 0.00 255.000000000 FORMAT "%13.9" NUMBER 10 /end CHARACTERISTIC
/begin CHARACTERISTIC DSM_EnvDfp_PCVCDSCGnd_C "Fehlerpfad spezifische Umweltbedingungen fuer Fehlerpfad Dfp_PCVCDSCGnd" VAL_BLK 0xCE6AC Kwb_Wu8 255.000000000 SigName 0.00 255.000000000 FORMAT "%13.9" NUMBER 10 /end CHARACTERISTIC
/begin CHARACTERISTIC DSM_EnvDfp_PCVCD_ADC_C "Fehlerpfad spezifische Umweltbedingungen fuer Fehlerpfad Dfp_PCVCD_ADC" VAL_BLK 0xCE6B6 Kwb_Wu8 255.000000000 SigName 0.00 255.000000000 FORMAT "%13.9" NUMBER 10 /end CHARACTERISTIC
/begin CHARACTERISTIC DSM_EnvDfp_PCVCD_SigTst_C "Fehlerpfad spezifische Umweltbedingungen fuer Fehlerpfad Dfp_PCVCD_SigTst" VAL_BLK 0xCE6C0 Kwb_Wu8 255.000000000 SigName 0.00 255.000000000 FORMAT "%13.9" NUMBER 10 /end CHARACTERISTIC
/begin CHARACTERISTIC DSM_EnvDfp_PFltAPSPlaus_C "Fehlerpfad spezifische Umweltbedingungen fuer Fehlerpfad Dfp_PFltAPSPlaus" VAL_BLK 0xCE6CA Kwb_Wu8 255.000000000 SigName 0.00 255.000000000 FORMAT "%13.9" NUMBER 10 /end CHARACTERISTIC
/begin CHARACTERISTIC DSM_EnvDfp_PFltAPSensB1_C "Fehlerpfad spezifische Umweltbedingungen fuer Fehlerpfad Dfp_PFltAPSensB1" VAL_BLK 0xCE6D4 Kwb_Wu8 255.000000000 SigName 0.00 255.000000000 FORMAT "%13.9" NUMBER 10 /end CHARACTERISTIC
/begin CHARACTERISTIC DSM_EnvDfp_PFltAPSensB2_C "Fehlerpfad spezifische Umweltbedingungen fuer Fehlerpfad Dfp_PFltAPSensB2" VAL_BLK 0xCE6DE Kwb_Wu8 255.000000000 SigName 0.00 255.000000000 FORMAT "%13.9" NUMBER 10 /end CHARACTERISTIC
/begin CHARACTERISTIC DSM_EnvDfp_PFltBPSPlaus_C "Fehlerpfad spezifische Umweltbedingungen fuer Fehlerpfad Dfp_PFltBPSPlaus" VAL_BLK 0xCE6E8 Kwb_Wu8 255.000000000 SigName 0.00 255.000000000 FORMAT "%13.9" NUMBER 10 /end CHARACTERISTIC
/begin CHARACTERISTIC DSM_EnvDfp_PFltCDPPreB1_C "Fehlerpfad spezifische Umweltbedingungen fuer Fehlerpfad Dfp_PFltCDPPreB1" VAL_BLK 0xCE6F2 Kwb_Wu8 255.000000000 SigName 0.00 255.000000000 FORMAT "%13.9" NUMBER 10 /end CHARACTERISTIC
/begin CHARACTERISTIC DSM_EnvDfp_PFltCDPPreB2_C "Fehlerpfad spezifische Umweltbedingungen fuer Fehlerpfad Dfp_PFltCDPPreB2" VAL_BLK 0xCE6FC Kwb_Wu8 255.000000000 SigName 0.00 255.000000000 FORMAT "%13.9" NUMBER 10 /end CHARACTERISTIC
/begin CHARACTERISTIC DSM_EnvDfp_PFltCDTPreB1_C "Fehlerpfad spezifische Umweltbedingungen fuer Fehlerpfad Dfp_PFltCDTPreB1" VAL_BLK 0xCE706 Kwb_Wu8 255.000000000 SigName 0.00 255.000000000 FORMAT "%13.9" NUMBER 10 /end CHARACTERISTIC
/begin CHARACTERISTIC DSM_EnvDfp_PFltCDTPreB2_C "Fehlerpfad spezifische Umweltbedingungen fuer Fehlerpfad Dfp_PFltCDTPreB2" VAL_BLK 0xCE710 Kwb_Wu8 255.000000000 SigName 0.00 255.000000000 FORMAT "%13.9" NUMBER 10 /end CHARACTERISTIC
/begin CHARACTERISTIC DSM_EnvDfp_PFltCharB1_C "Fehlerpfad spezifische Umweltbedingungen fuer Fehlerpfad Dfp_PFltCharB1" VAL_BLK 0xCE71A Kwb_Wu8 255.000000000 SigName 0.00 255.000000000 FORMAT "%13.9" NUMBER 10 /end CHARACTERISTIC
/begin CHARACTERISTIC DSM_EnvDfp_PFltCharB2_C "Fehlerpfad spezifische Umweltbedingungen fuer Fehlerpfad Dfp_PFltCharB2" VAL_BLK 0xCE724 Kwb_Wu8 255.000000000 SigName 0.00 255.000000000 FORMAT "%13.9" NUMBER 10 /end CHARACTERISTIC
/begin CHARACTERISTIC DSM_EnvDfp_PFltDltOxiPreTwFlw_C "Temperaturabweichungsfehlerpfad vor Oxi Cat Behandlung" VAL_BLK 0xCE72E Kwb_Wu8 255.000000000 SigName 0.00 255.000000000 FORMAT "%13.9" NUMBER 10 /end CHARACTERISTIC
/begin CHARACTERISTIC DSM_EnvDfp_PFltDltPreTwFlw_C "Temperaturabweichungsfehlerpfad vor DPF - Behandlung" VAL_BLK 0xCE738 Kwb_Wu8 255.000000000 SigName 0.00 255.000000000 FORMAT "%13.9" NUMBER 10 /end CHARACTERISTIC
/begin CHARACTERISTIC DSM_EnvDfp_PFltEngPrtB1_C "Fehlerpfad spezifische Umweltbedingungen fuer Fehlerpfad Dfp_PFltEngPrtB1" VAL_BLK 0xCE742 Kwb_Wu8 255.000000000 SigName 0.00 255.000000000 FORMAT "%13.9" NUMBER 10 /end CHARACTERISTIC
/begin CHARACTERISTIC DSM_EnvDfp_PFltEngPrtB2_C "Fehlerpfad spezifische Umweltbedingungen fuer Fehlerpfad Dfp_PFltEngPrtB2" VAL_BLK 0xCE74C Kwb_Wu8 255.000000000 SigName 0.00 255.000000000 FORMAT "%13.9" NUMBER 10 /end CHARACTERISTIC
/begin CHARACTERISTIC DSM_EnvDfp_PFltOvldInhRgnB1_C "Fehlerpfad spezifische Umweltbedingungen fuer Fehlerpfad Dfp_PFltOvldInhRgnB1" VAL_BLK 0xCE756 Kwb_Wu8 255.000000000 SigName 0.00 255.000000000 FORMAT "%13.9" NUMBER 10 /end CHARACTERISTIC
/begin CHARACTERISTIC DSM_EnvDfp_PFltOvldInhRgnB2_C "Fehlerpfad spezifische Umweltbedingungen fuer Fehlerpfad Dfp_PFltOvldInhRgnB2" VAL_BLK 0xCE760 Kwb_Wu8 255.000000000 SigName 0.00 255.000000000 FORMAT "%13.9" NUMBER 10 /end CHARACTERISTIC
/begin CHARACTERISTIC DSM_EnvDfp_PFltOvldTrqLimB1_C "Fehlerpfad spezifische Umweltbedingungen fuer Fehlerpfad Dfp_PFltOvldTrqLimB1" VAL_BLK 0xCE76A Kwb_Wu8 255.000000000 SigName 0.00 255.000000000 FORMAT "%13.9" NUMBER 10 /end CHARACTERISTIC
/begin CHARACTERISTIC DSM_EnvDfp_PFltOvldTrqLimB2_C "Fehlerpfad spezifische Umweltbedingungen fuer Fehlerpfad Dfp_PFltOvldTrqLimB2" VAL_BLK 0xCE774 Kwb_Wu8 255.000000000 SigName 0.00 255.000000000 FORMAT "%13.9" NUMBER 10 /end CHARACTERISTIC
/begin CHARACTERISTIC DSM_EnvDfp_PFltPresDynPlausB1_C "Fehlerpfad spezifische Umweltbedingungen fuer Fehlerpfad Dfp_PFltPresDynPlausB1" VAL_BLK 0xCE77E Kwb_Wu8 255.000000000 SigName 0.00 255.000000000 FORMAT "%13.9" NUMBER 10 /end CHARACTERISTIC
/begin CHARACTERISTIC DSM_EnvDfp_PFltPresDynPlausB2_C "Fehlerpfad spezifische Umweltbedingungen fuer Fehlerpfad Dfp_PFltPresDynPlausB2" VAL_BLK 0xCE788 Kwb_Wu8 255.000000000 SigName 0.00 255.000000000 FORMAT "%13.9" NUMBER 10 /end CHARACTERISTIC
/begin CHARACTERISTIC DSM_EnvDfp_PFltPresPlausB1_C "Fehlerpfad spezifische Umweltbedingungen fuer Fehlerpfad Dfp_PFltPresPlausB1" VAL_BLK 0xCE792 Kwb_Wu8 255.000000000 SigName 0.00 255.000000000 FORMAT "%13.9" NUMBER 10 /end CHARACTERISTIC
/begin CHARACTERISTIC DSM_EnvDfp_PFltPresPlausB2_C "Fehlerpfad spezifische Umweltbedingungen fuer Fehlerpfad Dfp_PFltPresPlausB2" VAL_BLK 0xCE79C Kwb_Wu8 255.000000000 SigName 0.00 255.000000000 FORMAT "%13.9" NUMBER 10 /end CHARACTERISTIC
/begin CHARACTERISTIC DSM_EnvDfp_PFltPresSensB1_C "Fehlerpfad spezifische Umweltbedingungen fuer Fehlerpfad Dfp_PFltPresSensB1" VAL_BLK 0xCE7A6 Kwb_Wu8 255.000000000 SigName 0.00 255.000000000 FORMAT "%13.9" NUMBER 10 /end CHARACTERISTIC
/begin CHARACTERISTIC DSM_EnvDfp_PFltPresSensB2_C "Fehlerpfad spezifische Umweltbedingungen fuer Fehlerpfad Dfp_PFltPresSensB2" VAL_BLK 0xCE7B0 Kwb_Wu8 255.000000000 SigName 0.00 255.000000000 FORMAT "%13.9" NUMBER 10 /end CHARACTERISTIC
/begin CHARACTERISTIC DSM_EnvDfp_PFltPresSensFrz_C "Fehlerpfad spezifische Umweltbedingungen fuer Fehlerpfad Dfp_PFltPresSensFrz" VAL_BLK 0xCE7BA Kwb_Wu8 255.000000000 SigName 0.00 255.000000000 FORMAT "%13.9" NUMBER 10 /end CHARACTERISTIC
/begin CHARACTERISTIC DSM_EnvDfp_PFltPresSensHsLnB1_C "Fehlerpfad spezifische Umweltbedingungen fuer Fehlerpfad Dfp_PFltPresSensHsLnB1" VAL_BLK 0xCE7C4 Kwb_Wu8 255.000000000 SigName 0.00 255.000000000 FORMAT "%13.9" NUMBER 10 /end CHARACTERISTIC
/begin CHARACTERISTIC DSM_EnvDfp_PFltPresSensHsLnB2_C "Fehlerpfad spezifische Umweltbedingungen fuer Fehlerpfad Dfp_PFltPresSensHsLnB2" VAL_BLK 0xCE7CE Kwb_Wu8 255.000000000 SigName 0.00 255.000000000 FORMAT "%13.9" NUMBER 10 /end CHARACTERISTIC
/begin CHARACTERISTIC DSM_EnvDfp_PFltPresSensSotB1_C "Fehlerpfad spezifische Umweltbedingungen fuer Fehlerpfad Dfp_PFltPresSensSotB1" VAL_BLK 0xCE7D8 Kwb_Wu8 255.000000000 SigName 0.00 255.000000000 FORMAT "%13.9" NUMBER 10 /end CHARACTERISTIC
/begin CHARACTERISTIC DSM_EnvDfp_PFltPresSensSotB2_C "Fehlerpfad spezifische Umweltbedingungen fuer Fehlerpfad Dfp_PFltPresSensSotB2" VAL_BLK 0xCE7E2 Kwb_Wu8 255.000000000 SigName 0.00 255.000000000 FORMAT "%13.9" NUMBER 10 /end CHARACTERISTIC
/begin CHARACTERISTIC DSM_EnvDfp_PFltRgnPerm_C "Fehlerpfad spezifische Umweltbedingungen fuer Fehlerpfad Dfp_PFltRgnPerm" VAL_BLK 0xCE7EC Kwb_Wu8 255.000000000 SigName 0.00 255.000000000 FORMAT "%13.9" NUMBER 10 /end CHARACTERISTIC
/begin CHARACTERISTIC DSM_EnvDfp_PFltTempDwnStrmB1_C "Fehlerpfad spezifische Umweltbedingungen fuer Fehlerpfad Dfp_PFltTempDwnStrmB1" VAL_BLK 0xCE7F6 Kwb_Wu8 255.000000000 SigName 0.00 255.000000000 FORMAT "%13.9" NUMBER 10 /end CHARACTERISTIC
/begin CHARACTERISTIC DSM_EnvDfp_PFltTempDwnStrmB2_C "Fehlerpfad spezifische Umweltbedingungen fuer Fehlerpfad Dfp_PFltTempDwnStrmB2" VAL_BLK 0xCE800 Kwb_Wu8 255.000000000 SigName 0.00 255.000000000 FORMAT "%13.9" NUMBER 10 /end CHARACTERISTIC
/begin CHARACTERISTIC DSM_EnvDfp_PFltTempSensB1_C "Fehlerpfad spezifische Umweltbedingungen fuer Fehlerpfad Dfp_PFltTempSensB1" VAL_BLK 0xCE80A Kwb_Wu8 255.000000000 SigName 0.00 255.000000000 FORMAT "%13.9" NUMBER 10 /end CHARACTERISTIC
/begin CHARACTERISTIC DSM_EnvDfp_PFltTempSensB2_C "Fehlerpfad spezifische Umweltbedingungen fuer Fehlerpfad Dfp_PFltTempSensB2" VAL_BLK 0xCE814 Kwb_Wu8 255.000000000 SigName 0.00 255.000000000 FORMAT "%13.9" NUMBER 10 /end CHARACTERISTIC
/begin CHARACTERISTIC DSM_EnvDfp_PFltTempUpStrmB1_C "Fehlerpfad spezifische Umweltbedingungen fuer Fehlerpfad Dfp_PFltTempUpStrmB1" VAL_BLK 0xCE81E Kwb_Wu8 255.000000000 SigName 0.00 255.000000000 FORMAT "%13.9" NUMBER 10 /end CHARACTERISTIC
/begin CHARACTERISTIC DSM_EnvDfp_PFltTempUpStrmB2_C "Fehlerpfad spezifische Umweltbedingungen fuer Fehlerpfad Dfp_PFltTempUpStrmB2" VAL_BLK 0xCE828 Kwb_Wu8 255.000000000 SigName 0.00 255.000000000 FORMAT "%13.9" NUMBER 10 /end CHARACTERISTIC
/begin CHARACTERISTIC DSM_EnvDfp_PFlt_tOxiPreMaxB1_C "Fehlerpfad spezifische Umweltbedingungen fuer Fehlerpfad Dfp_PFlt_tOxiPreMaxB1" VAL_BLK 0xCE832 Kwb_Wu8 255.000000000 SigName 0.00 255.000000000 FORMAT "%13.9" NUMBER 10 /end CHARACTERISTIC
/begin CHARACTERISTIC DSM_EnvDfp_PFlt_tOxiPreMaxB2_C "Fehlerpfad spezifische Umweltbedingungen fuer Fehlerpfad Dfp_PFlt_tOxiPreMaxB2" VAL_BLK 0xCE83C Kwb_Wu8 255.000000000 SigName 0.00 255.000000000 FORMAT "%13.9" NUMBER 10 /end CHARACTERISTIC
/begin CHARACTERISTIC DSM_EnvDfp_PFlt_tOxiPreMxRgnB1_C "Fehlerpfad spezifische Umweltbedingungen fuer Fehlerpfad Dfp_PFlt_tOxiPreMxRgnB1" VAL_BLK 0xCE846 Kwb_Wu8 255.000000000 SigName 0.00 255.000000000 FORMAT "%13.9" NUMBER 10 /end CHARACTERISTIC
/begin CHARACTERISTIC DSM_EnvDfp_PFlt_tOxiPreMxRgnB2_C "Fehlerpfad spezifische Umweltbedingungen fuer Fehlerpfad Dfp_PFlt_tOxiPreMxRgnB2" VAL_BLK 0xCE850 Kwb_Wu8 255.000000000 SigName 0.00 255.000000000 FORMAT "%13.9" NUMBER 10 /end CHARACTERISTIC
/begin CHARACTERISTIC DSM_EnvDfp_PFlt_tPreMaxB1_C "Fehlerpfad spezifische Umweltbedingungen fuer Fehlerpfad Dfp_PFlt_tPreMaxB1" VAL_BLK 0xCE85A Kwb_Wu8 255.000000000 SigName 0.00 255.000000000 FORMAT "%13.9" NUMBER 10 /end CHARACTERISTIC
/begin CHARACTERISTIC DSM_EnvDfp_PFlt_tPreMaxB2_C "Fehlerpfad spezifische Umweltbedingungen fuer Fehlerpfad Dfp_PFlt_tPreMaxB2" VAL_BLK 0xCE864 Kwb_Wu8 255.000000000 SigName 0.00 255.000000000 FORMAT "%13.9" NUMBER 10 /end CHARACTERISTIC
/begin CHARACTERISTIC DSM_EnvDfp_PFlt_tPreMaxRgnB1_C "Fehlerpfad spezifische Umweltbedingungen fuer Fehlerpfad Dfp_PFlt_tPreMaxRgnB1" VAL_BLK 0xCE86E Kwb_Wu8 255.000000000 SigName 0.00 255.000000000 FORMAT "%13.9" NUMBER 10 /end CHARACTERISTIC
/begin CHARACTERISTIC DSM_EnvDfp_PFlt_tPreMaxRgnB2_C "Fehlerpfad spezifische Umweltbedingungen fuer Fehlerpfad Dfp_PFlt_tPreMaxRgnB2" VAL_BLK 0xCE878 Kwb_Wu8 255.000000000 SigName 0.00 255.000000000 FORMAT "%13.9" NUMBER 10 /end CHARACTERISTIC
/begin CHARACTERISTIC DSM_EnvDfp_PFltmSotDiffMaxB1_C "Fehlerpfad spezifische Umweltbedingungen fuer Fehlerpfad Dfp_PFltmSotDiffMaxB1" VAL_BLK 0xCE882 Kwb_Wu8 255.000000000 SigName 0.00 255.000000000 FORMAT "%13.9" NUMBER 10 /end CHARACTERISTIC
/begin CHARACTERISTIC DSM_EnvDfp_PFltmSotDiffMaxB2_C "Fehlerpfad spezifische Umweltbedingungen fuer Fehlerpfad Dfp_PFltmSotDiffMaxB2" VAL_BLK 0xCE88C Kwb_Wu8 255.000000000 SigName 0.00 255.000000000 FORMAT "%13.9" NUMBER 10 /end CHARACTERISTIC
/begin CHARACTERISTIC DSM_EnvDfp_PresPlausDblDef_C "Fehlerpfad spezifische Umweltbedingungen fuer Fehlerpfad Dfp_PresPlausDblDef" VAL_BLK 0xCE896 Kwb_Wu8 255.000000000 SigName 0.00 255.000000000 FORMAT "%13.9" NUMBER 10 /end CHARACTERISTIC
/begin CHARACTERISTIC DSM_EnvDfp_QLTCD_C "Fehlerpfad spezifische Umweltbedingungen fuer Fehlerpfad Dfp_QLTCD" VAL_BLK 0xCE8A0 Kwb_Wu8 255.000000000 SigName 0.00 255.000000000 FORMAT "%13.9" NUMBER 10 /end CHARACTERISTIC
/begin CHARACTERISTIC DSM_EnvDfp_RailCD_C "Fehlerpfad spezifische Umweltbedingungen fuer Fehlerpfad Dfp_RailCD" VAL_BLK 0xCE8AA Kwb_Wu8 255.000000000 SigName 0.00 255.000000000 FORMAT "%13.9" NUMBER 10 /end CHARACTERISTIC
/begin CHARACTERISTIC DSM_EnvDfp_RailCDOfsTst_C "Fehlerpfad spezifische Umweltbedingungen fuer Fehlerpfad Dfp_RailCDOfsTst" VAL_BLK 0xCE8B4 Kwb_Wu8 255.000000000 SigName 0.00 255.000000000 FORMAT "%13.9" NUMBER 10 /end CHARACTERISTIC
/begin CHARACTERISTIC DSM_EnvDfp_RailCD_PMonStrt_C "Fehlerpfad spezifische Umweltbedingungen fuer Fehlerpfad Dfp_RailCD_PMonStrt" VAL_BLK 0xCE8BE Kwb_Wu8 255.000000000 SigName 0.00 255.000000000 FORMAT "%13.9" NUMBER 10 /end CHARACTERISTIC
/begin CHARACTERISTIC DSM_EnvDfp_RailCPC1_C "Fehlerpfad spezifische Umweltbedingungen fuer Fehlerpfad Dfp_RailCPC1" VAL_BLK 0xCE8C8 Kwb_Wu8 255.000000000 SigName 0.00 255.000000000 FORMAT "%13.9" NUMBER 10 /end CHARACTERISTIC
/begin CHARACTERISTIC DSM_EnvDfp_RailCPC3_C "Fehlerpfad spezifische Umweltbedingungen fuer Fehlerpfad Dfp_RailCPC3" VAL_BLK 0xCE8D2 Kwb_Wu8 255.000000000 SigName 0.00 255.000000000 FORMAT "%13.9" NUMBER 10 /end CHARACTERISTIC
/begin CHARACTERISTIC DSM_EnvDfp_RailCPC4_C "Fehlerpfad spezifische Umweltbedingungen fuer Fehlerpfad Dfp_RailCPC4" VAL_BLK 0xCE8DC Kwb_Wu8 255.000000000 SigName 0.00 255.000000000 FORMAT "%13.9" NUMBER 10 /end CHARACTERISTIC
/begin CHARACTERISTIC DSM_EnvDfp_RailCtlModeMeUnDiag_C "Fehlerpfad spezifische Umweltbedingungen fuer Fehlerpfad Dfp_RailCtlModeMeUnDiag" VAL_BLK 0xCE8E6 Kwb_Wu8 255.000000000 SigName 0.00 255.000000000 FORMAT "%13.9" NUMBER 10 /end CHARACTERISTIC
/begin CHARACTERISTIC DSM_EnvDfp_RailCtlModePCVDiag_C "Fehlerpfad spezifische Umweltbedingungen fuer Fehlerpfad Dfp_RailCtlModePCVDiag" VAL_BLK 0xCE8F0 Kwb_Wu8 255.000000000 SigName 0.00 255.000000000 FORMAT "%13.9" NUMBER 10 /end CHARACTERISTIC
/begin CHARACTERISTIC DSM_EnvDfp_RailMeUn0_C "Fehlerpfad spezifische Umweltbedingungen fuer Fehlerpfad Dfp_RailMeUn0" VAL_BLK 0xCE8FA Kwb_Wu8 255.000000000 SigName 0.00 255.000000000 FORMAT "%13.9" NUMBER 10 /end CHARACTERISTIC
/begin CHARACTERISTIC DSM_EnvDfp_RailMeUn1_C "Fehlerpfad spezifische Umweltbedingungen fuer Fehlerpfad Dfp_RailMeUn1" VAL_BLK 0xCE904 Kwb_Wu8 255.000000000 SigName 0.00 255.000000000 FORMAT "%13.9" NUMBER 10 /end CHARACTERISTIC
/begin CHARACTERISTIC DSM_EnvDfp_RailMeUn2_C "Fehlerpfad spezifische Umweltbedingungen fuer Fehlerpfad Dfp_RailMeUn2" VAL_BLK 0xCE90E Kwb_Wu8 255.000000000 SigName 0.00 255.000000000 FORMAT "%13.9" NUMBER 10 /end CHARACTERISTIC
/begin CHARACTERISTIC DSM_EnvDfp_RailMeUn3_C "Fehlerpfad spezifische Umweltbedingungen fuer Fehlerpfad Dfp_RailMeUn3" VAL_BLK 0xCE918 Kwb_Wu8 255.000000000 SigName 0.00 255.000000000 FORMAT "%13.9" NUMBER 10 /end CHARACTERISTIC
/begin CHARACTERISTIC DSM_EnvDfp_RailMeUn4_C "Fehlerpfad spezifische Umweltbedingungen fuer Fehlerpfad Dfp_RailMeUn4" VAL_BLK 0xCE922 Kwb_Wu8 255.000000000 SigName 0.00 255.000000000 FORMAT "%13.9" NUMBER 10 /end CHARACTERISTIC
/begin CHARACTERISTIC DSM_EnvDfp_RailPCV0_C "Fehlerpfad spezifische Umweltbedingungen fuer Fehlerpfad Dfp_RailPCV0" VAL_BLK 0xCE92C Kwb_Wu8 255.000000000 SigName 0.00 255.000000000 FORMAT "%13.9" NUMBER 10 /end CHARACTERISTIC
/begin CHARACTERISTIC DSM_EnvDfp_RailPCV1_C "Fehlerpfad spezifische Umweltbedingungen fuer Fehlerpfad Dfp_RailPCV1" VAL_BLK 0xCE936 Kwb_Wu8 255.000000000 SigName 0.00 255.000000000 FORMAT "%13.9" NUMBER 10 /end CHARACTERISTIC
/begin CHARACTERISTIC DSM_EnvDfp_RailPCV2_C "Fehlerpfad spezifische Umweltbedingungen fuer Fehlerpfad Dfp_RailPCV2" VAL_BLK 0xCE940 Kwb_Wu8 255.000000000 SigName 0.00 255.000000000 FORMAT "%13.9" NUMBER 10 /end CHARACTERISTIC
/begin CHARACTERISTIC DSM_EnvDfp_RailPCV3_C "Fehlerpfad spezifische Umweltbedingungen fuer Fehlerpfad Dfp_RailPCV3" VAL_BLK 0xCE94A Kwb_Wu8 255.000000000 SigName 0.00 255.000000000 FORMAT "%13.9" NUMBER 10 /end CHARACTERISTIC
/begin CHARACTERISTIC DSM_EnvDfp_RailPCV4_C "Fehlerpfad spezifische Umweltbedingungen fuer Fehlerpfad Dfp_RailPCV4" VAL_BLK 0xCE954 Kwb_Wu8 255.000000000 SigName 0.00 255.000000000 FORMAT "%13.9" NUMBER 10 /end CHARACTERISTIC
/begin CHARACTERISTIC DSM_EnvDfp_RailPCV5_C "Fehlerpfad spezifische Umweltbedingungen fuer Fehlerpfad Dfp_RailPCV5" VAL_BLK 0xCE95E Kwb_Wu8 255.000000000 SigName 0.00 255.000000000 FORMAT "%13.9" NUMBER 10 /end CHARACTERISTIC
/begin CHARACTERISTIC DSM_EnvDfp_SOPTst_C "Fehlerpfad spezifische Umweltbedingungen fuer Fehlerpfad Dfp_SOPTst" VAL_BLK 0xCE968 Kwb_Wu8 255.000000000 SigName 0.00 255.000000000 FORMAT "%13.9" NUMBER 10 /end CHARACTERISTIC
/begin CHARACTERISTIC DSM_EnvDfp_SSpMon1_C "Fehlerpfad spezifische Umweltbedingungen fuer Fehlerpfad Dfp_SSpMon1" VAL_BLK 0xCE972 Kwb_Wu8 255.000000000 SigName 0.00 255.000000000 FORMAT "%13.9" NUMBER 10 /end CHARACTERISTIC
/begin CHARACTERISTIC DSM_EnvDfp_SSpMon2_C "Fehlerpfad spezifische Umweltbedingungen fuer Fehlerpfad Dfp_SSpMon2" VAL_BLK 0xCE97C Kwb_Wu8 255.000000000 SigName 0.00 255.000000000 FORMAT "%13.9" NUMBER 10 /end CHARACTERISTIC
/begin CHARACTERISTIC DSM_EnvDfp_SSpMon3_C "Fehlerpfad spezifische Umweltbedingungen fuer Fehlerpfad Dfp_SSpMon3" VAL_BLK 0xCE986 Kwb_Wu8 255.000000000 SigName 0.00 255.000000000 FORMAT "%13.9" NUMBER 10 /end CHARACTERISTIC
/begin CHARACTERISTIC DSM_EnvDfp_SSpMon4_C "Fehlerpfad spezifische Umweltbedingungen fuer Fehlerpfad Dfp_SSpMon4" VAL_BLK 0xCE990 Kwb_Wu8 255.000000000 SigName 0.00 255.000000000 FORMAT "%13.9" NUMBER 10 /end CHARACTERISTIC
/begin CHARACTERISTIC DSM_EnvDfp_SSpMon5_C "Fehlerpfad spezifische Umweltbedingungen fuer Fehlerpfad Dfp_SSpMon5" VAL_BLK 0xCE99A Kwb_Wu8 255.000000000 SigName 0.00 255.000000000 FORMAT "%13.9" NUMBER 10 /end CHARACTERISTIC
/begin CHARACTERISTIC DSM_EnvDfp_SSpMon6_C "Fehlerpfad spezifische Umweltbedingungen fuer Fehlerpfad Dfp_SSpMon6" VAL_BLK 0xCE9A4 Kwb_Wu8 255.000000000 SigName 0.00 255.000000000 FORMAT "%13.9" NUMBER 10 /end CHARACTERISTIC
/begin CHARACTERISTIC DSM_EnvDfp_SWChk_CycSigChkDat_C "Fehlerpfad spezifische Umweltbedingungen fuer Fehlerpfad Dfp_SWChk_CycSigChkDat" VAL_BLK 0xCE9AE Kwb_Wu8 255.000000000 SigName 0.00 255.000000000 FORMAT "%13.9" NUMBER 10 /end CHARACTERISTIC
/begin CHARACTERISTIC DSM_EnvDfp_SWChk_CycSigChkPrg_C "Fehlerpfad spezifische Umweltbedingungen fuer Fehlerpfad Dfp_SWChk_CycSigChkPrg" VAL_BLK 0xCE9B8 Kwb_Wu8 255.000000000 SigName 0.00 255.000000000 FORMAT "%13.9" NUMBER 10 /end CHARACTERISTIC
/begin CHARACTERISTIC DSM_EnvDfp_StSysTrqShutOff_C "Fehlerpfad spezifische Umweltbedingungen fuer Fehlerpfad Dfp_StSysTrqShutOff" VAL_BLK 0xCE9C2 Kwb_Wu8 255.000000000 SigName 0.00 255.000000000 FORMAT "%13.9" NUMBER 10 /end CHARACTERISTIC
/begin CHARACTERISTIC DSM_EnvDfp_StrtCD_Actr_C "Fehlerpfad spezifische Umweltbedingungen fuer Fehlerpfad Dfp_StrtCD_Actr" VAL_BLK 0xCE9CC Kwb_Wu8 255.000000000 SigName 0.00 255.000000000 FORMAT "%13.9" NUMBER 10 /end CHARACTERISTIC
/begin CHARACTERISTIC DSM_EnvDfp_SysLamp_C "Fehlerpfad spezifische Umweltbedingungen fuer Fehlerpfad Dfp_SysLamp" VAL_BLK 0xCE9D6 Kwb_Wu8 255.000000000 SigName 0.00 255.000000000 FORMAT "%13.9" NUMBER 10 /end CHARACTERISTIC
/begin CHARACTERISTIC DSM_EnvDfp_T15CD_C "Fehlerpfad spezifische Umweltbedingungen fuer Fehlerpfad Dfp_T15CD" VAL_BLK 0xCE9E0 Kwb_Wu8 255.000000000 SigName 0.00 255.000000000 FORMAT "%13.9" NUMBER 10 /end CHARACTERISTIC
/begin CHARACTERISTIC DSM_EnvDfp_TGearbx_C "Fehlerpfad spezifische Umweltbedingungen fuer Fehlerpfad Dfp_TGearbx" VAL_BLK 0xCE9EA Kwb_Wu8 255.000000000 SigName 0.00 255.000000000 FORMAT "%13.9" NUMBER 10 /end CHARACTERISTIC
/begin CHARACTERISTIC DSM_EnvDfp_TPUMon_C "Fehlerpfad spezifische Umweltbedingungen fuer Fehlerpfad Dfp_TPUMon" VAL_BLK 0xCE9F4 Kwb_Wu8 255.000000000 SigName 0.00 255.000000000 FORMAT "%13.9" NUMBER 10 /end CHARACTERISTIC
/begin CHARACTERISTIC DSM_EnvDfp_TVACD_AirMon1_C "Fehlerpfad spezifische Umweltbedingungen fuer Fehlerpfad Dfp_TVACD_AirMon1" VAL_BLK 0xCE9FE Kwb_Wu8 255.000000000 SigName 0.00 255.000000000 FORMAT "%13.9" NUMBER 10 /end CHARACTERISTIC
/begin CHARACTERISTIC DSM_EnvDfp_TVACD_AirMon2_C "Fehlerpfad spezifische Umweltbedingungen fuer Fehlerpfad Dfp_TVACD_AirMon2" VAL_BLK 0xCEA08 Kwb_Wu8 255.000000000 SigName 0.00 255.000000000 FORMAT "%13.9" NUMBER 10 /end CHARACTERISTIC
/begin CHARACTERISTIC DSM_EnvDfp_TVACD_Max_C "Fehlerpfad spezifische Umweltbedingungen fuer Fehlerpfad Dfp_TVACD_Max" VAL_BLK 0xCEA12 Kwb_Wu8 255.000000000 SigName 0.00 255.000000000 FORMAT "%13.9" NUMBER 10 /end CHARACTERISTIC
/begin CHARACTERISTIC DSM_EnvDfp_TVACD_Max2_C "Fehlerpfad spezifische Umweltbedingungen fuer Fehlerpfad Dfp_TVACD_Max2" VAL_BLK 0xCEA1C Kwb_Wu8 255.000000000 SigName 0.00 255.000000000 FORMAT "%13.9" NUMBER 10 /end CHARACTERISTIC
/begin CHARACTERISTIC DSM_EnvDfp_TVACD_Min_C "Fehlerpfad spezifische Umweltbedingungen fuer Fehlerpfad Dfp_TVACD_Min" VAL_BLK 0xCEA26 Kwb_Wu8 255.000000000 SigName 0.00 255.000000000 FORMAT "%13.9" NUMBER 10 /end CHARACTERISTIC
/begin CHARACTERISTIC DSM_EnvDfp_TVACD_Min2_C "Fehlerpfad spezifische Umweltbedingungen fuer Fehlerpfad Dfp_TVACD_Min2" VAL_BLK 0xCEA30 Kwb_Wu8 255.000000000 SigName 0.00 255.000000000 FORMAT "%13.9" NUMBER 10 /end CHARACTERISTIC
/begin CHARACTERISTIC DSM_EnvDfp_TVACD_SigNpl_C "Fehlerpfad spezifische Umweltbedingungen fuer Fehlerpfad Dfp_TVACD_SigNpl" VAL_BLK 0xCEA3A Kwb_Wu8 255.000000000 SigName 0.00 255.000000000 FORMAT "%13.9" NUMBER 10 /end CHARACTERISTIC
/begin CHARACTERISTIC DSM_EnvDfp_TVACD_SigNpl2_C "Fehlerpfad spezifische Umweltbedingungen fuer Fehlerpfad Dfp_TVACD_SigNpl2" VAL_BLK 0xCEA44 Kwb_Wu8 255.000000000 SigName 0.00 255.000000000 FORMAT "%13.9" NUMBER 10 /end CHARACTERISTIC
/begin CHARACTERISTIC DSM_EnvDfp_TVACD_TVADia1_C "Fehlerpfad spezifische Umweltbedingungen fuer Fehlerpfad Dfp_TVACD_TVADia1" VAL_BLK 0xCEA4E Kwb_Wu8 255.000000000 SigName 0.00 255.000000000 FORMAT "%13.9" NUMBER 10 /end CHARACTERISTIC
/begin CHARACTERISTIC DSM_EnvDfp_TVACD_TVADia2_C "Fehlerpfad spezifische Umweltbedingungen fuer Fehlerpfad Dfp_TVACD_TVADia2" VAL_BLK 0xCEA58 Kwb_Wu8 255.000000000 SigName 0.00 255.000000000 FORMAT "%13.9" NUMBER 10 /end CHARACTERISTIC
/begin CHARACTERISTIC DSM_EnvDfp_TVACD_TVADia21_C "Fehlerpfad spezifische Umweltbedingungen fuer Fehlerpfad Dfp_TVACD_TVADia21" VAL_BLK 0xCEA62 Kwb_Wu8 255.000000000 SigName 0.00 255.000000000 FORMAT "%13.9" NUMBER 10 /end CHARACTERISTIC
/begin CHARACTERISTIC DSM_EnvDfp_TVACD_TVADia22_C "Fehlerpfad spezifische Umweltbedingungen fuer Fehlerpfad Dfp_TVACD_TVADia22" VAL_BLK 0xCEA6C Kwb_Wu8 255.000000000 SigName 0.00 255.000000000 FORMAT "%13.9" NUMBER 10 /end CHARACTERISTIC
/begin CHARACTERISTIC DSM_EnvDfp_TVACD_TVADia23_C "Fehlerpfad spezifische Umweltbedingungen fuer Fehlerpfad Dfp_TVACD_TVADia23" VAL_BLK 0xCEA76 Kwb_Wu8 255.000000000 SigName 0.00 255.000000000 FORMAT "%13.9" NUMBER 10 /end CHARACTERISTIC
/begin CHARACTERISTIC DSM_EnvDfp_TVACD_TVADia24_C "Fehlerpfad spezifische Umweltbedingungen fuer Fehlerpfad Dfp_TVACD_TVADia24" VAL_BLK 0xCEA80 Kwb_Wu8 255.000000000 SigName 0.00 255.000000000 FORMAT "%13.9" NUMBER 10 /end CHARACTERISTIC
/begin CHARACTERISTIC DSM_EnvDfp_TVACD_TVADia3_C "Fehlerpfad spezifische Umweltbedingungen fuer Fehlerpfad Dfp_TVACD_TVADia3" VAL_BLK 0xCEA8A Kwb_Wu8 255.000000000 SigName 0.00 255.000000000 FORMAT "%13.9" NUMBER 10 /end CHARACTERISTIC
/begin CHARACTERISTIC DSM_EnvDfp_TVACD_TVADia4_C "Fehlerpfad spezifische Umweltbedingungen fuer Fehlerpfad Dfp_TVACD_TVADia4" VAL_BLK 0xCEA94 Kwb_Wu8 255.000000000 SigName 0.00 255.000000000 FORMAT "%13.9" NUMBER 10 /end CHARACTERISTIC
/begin CHARACTERISTIC DSM_EnvDfp_ThrVlvMon_C "Fehlerpfad spezifische Umweltbedingungen fuer Fehlerpfad Dfp_ThrVlvMon" VAL_BLK 0xCEA9E Kwb_Wu8 255.000000000 SigName 0.00 255.000000000 FORMAT "%13.9" NUMBER 10 /end CHARACTERISTIC
/begin CHARACTERISTIC DSM_EnvDfp_VSACD_DiaDet_C "Fehlerpfad spezifische Umweltbedingungen fuer Fehlerpfad Dfp_VSACD_DiaDet" VAL_BLK 0xCEAA8 Kwb_Wu8 255.000000000 SigName 0.00 255.000000000 FORMAT "%13.9" NUMBER 10 /end CHARACTERISTIC
/begin CHARACTERISTIC DSM_EnvDfp_VSACD_DioInDia1_C "Fehlerpfad spezifische Umweltbedingungen fuer Fehlerpfad Dfp_VSACD_DioInDia1" VAL_BLK 0xCEAB2 Kwb_Wu8 255.000000000 SigName 0.00 255.000000000 FORMAT "%13.9" NUMBER 10 /end CHARACTERISTIC
/begin CHARACTERISTIC DSM_EnvDfp_VSACD_DioInDia2_C "Fehlerpfad spezifische Umweltbedingungen fuer Fehlerpfad Dfp_VSACD_DioInDia2" VAL_BLK 0xCEABC Kwb_Wu8 255.000000000 SigName 0.00 255.000000000 FORMAT "%13.9" NUMBER 10 /end CHARACTERISTIC
/begin CHARACTERISTIC DSM_EnvDfp_VSACD_DioInDia3_C "Fehlerpfad spezifische Umweltbedingungen fuer Fehlerpfad Dfp_VSACD_DioInDia3" VAL_BLK 0xCEAC6 Kwb_Wu8 255.000000000 SigName 0.00 255.000000000 FORMAT "%13.9" NUMBER 10 /end CHARACTERISTIC
/begin CHARACTERISTIC DSM_EnvDfp_VSACD_DioInDia4_C "Fehlerpfad spezifische Umweltbedingungen fuer Fehlerpfad Dfp_VSACD_DioInDia4" VAL_BLK 0xCEAD0 Kwb_Wu8 255.000000000 SigName 0.00 255.000000000 FORMAT "%13.9" NUMBER 10 /end CHARACTERISTIC
/begin CHARACTERISTIC DSM_EnvDfp_VSACD_DioInMin_C "Fehlerpfad spezifische Umweltbedingungen fuer Fehlerpfad Dfp_VSACD_DioInMin" VAL_BLK 0xCEADA Kwb_Wu8 255.000000000 SigName 0.00 255.000000000 FORMAT "%13.9" NUMBER 10 /end CHARACTERISTIC
/begin CHARACTERISTIC DSM_EnvDfp_VSACD_Max_C "Fehlerpfad spezifische Umweltbedingungen fuer Fehlerpfad Dfp_VSACD_Max" VAL_BLK 0xCEAE4 Kwb_Wu8 255.000000000 SigName 0.00 255.000000000 FORMAT "%13.9" NUMBER 10 /end CHARACTERISTIC
/begin CHARACTERISTIC DSM_EnvDfp_VSACD_Min_C "Fehlerpfad spezifische Umweltbedingungen fuer Fehlerpfad Dfp_VSACD_Min" VAL_BLK 0xCEAEE Kwb_Wu8 255.000000000 SigName 0.00 255.000000000 FORMAT "%13.9" NUMBER 10 /end CHARACTERISTIC
/begin CHARACTERISTIC DSM_EnvDfp_VSACD_SigNpl_C "Fehlerpfad spezifische Umweltbedingungen fuer Fehlerpfad Dfp_VSACD_SigNpl" VAL_BLK 0xCEAF8 Kwb_Wu8 255.000000000 SigName 0.00 255.000000000 FORMAT "%13.9" NUMBER 10 /end CHARACTERISTIC
/begin CHARACTERISTIC DSM_EnvDfp_VSACD_VSADia1_C "Fehlerpfad spezifische Umweltbedingungen fuer Fehlerpfad Dfp_VSACD_VSADia1" VAL_BLK 0xCEB02 Kwb_Wu8 255.000000000 SigName 0.00 255.000000000 FORMAT "%13.9" NUMBER 10 /end CHARACTERISTIC
/begin CHARACTERISTIC DSM_EnvDfp_VSACD_VSADia2_C "Fehlerpfad spezifische Umweltbedingungen fuer Fehlerpfad Dfp_VSACD_VSADia2" VAL_BLK 0xCEB0C Kwb_Wu8 255.000000000 SigName 0.00 255.000000000 FORMAT "%13.9" NUMBER 10 /end CHARACTERISTIC
/begin CHARACTERISTIC DSM_EnvDfp_VSACD_VSADia3_C "Fehlerpfad spezifische Umweltbedingungen fuer Fehlerpfad Dfp_VSACD_VSADia3" VAL_BLK 0xCEB16 Kwb_Wu8 255.000000000 SigName 0.00 255.000000000 FORMAT "%13.9" NUMBER 10 /end CHARACTERISTIC
/begin CHARACTERISTIC DSM_EnvDfp_VSACD_VSADia4_C "Fehlerpfad spezifische Umweltbedingungen fuer Fehlerpfad Dfp_VSACD_VSADia4" VAL_BLK 0xCEB20 Kwb_Wu8 255.000000000 SigName 0.00 255.000000000 FORMAT "%13.9" NUMBER 10 /end CHARACTERISTIC
/begin CHARACTERISTIC DSM_EnvDfp_VSSCD1_C "Fehlerpfad spezifische Umweltbedingungen fuer Fehlerpfad Dfp_VSSCD1" VAL_BLK 0xCEB2A Kwb_Wu8 255.000000000 SigName 0.00 255.000000000 FORMAT "%13.9" NUMBER 10 /end CHARACTERISTIC
/begin CHARACTERISTIC DSM_EnvDfp_VSSCD2_C "Fehlerpfad spezifische Umweltbedingungen fuer Fehlerpfad Dfp_VSSCD2" VAL_BLK 0xCEB34 Kwb_Wu8 255.000000000 SigName 0.00 255.000000000 FORMAT "%13.9" NUMBER 10 /end CHARACTERISTIC
/begin CHARACTERISTIC DSM_EnvDfp_WdCom_C "Fehlerpfad spezifische Umweltbedingungen fuer Fehlerpfad Dfp_WdCom" VAL_BLK 0xCEB3E Kwb_Wu8 255.000000000 SigName 0.00 255.000000000 FORMAT "%13.9" NUMBER 10 /end CHARACTERISTIC
/begin FUNCTION dsm_auto_env8 ""
 /begin DEF_CHARACTERISTIC DSM_EnvDfp_Layer_TANS_C DSM_EnvDfp_ACCDSwtin_C DSM_EnvDfp_ACC_PlausTrqDes_C DSM_EnvDfp_ACC_trqInr_C DSM_EnvDfp_ACTrq_C DSM_EnvDfp_ADCMon_C DSM_EnvDfp_AFSCDIdlAdjVal_C DSM_EnvDfp_AFSCDLdAdjVal_C DSM_EnvDfp_AFSCDPlAirPerCylDif_C DSM_EnvDfp_AFSCD_AirTempDcyc_C DSM_EnvDfp_AFSCD_AirTempDcyc2_C DSM_EnvDfp_AFSCD_PlOffsDrft_C DSM_EnvDfp_AFSCD_PlOffsDrft2_C DSM_EnvDfp_AFSCD_PlSetyDrft_C DSM_EnvDfp_AFSCD_SRCAirTemp_C DSM_EnvDfp_AFSCD_SRCAirTemp2_C DSM_EnvDfp_AFSCD_SRCBatt_C DSM_EnvDfp_AFSCD_SRCBatt2_C DSM_EnvDfp_AFSCD_SRCCorrAirm_C DSM_EnvDfp_Layer_TUMG_C DSM_EnvDfp_AFSCD_SRCCorrAirm2_C DSM_EnvDfp_AFSCD_SRCRawAirm_C DSM_EnvDfp_Layer_GEN_C DSM_EnvDfp_Layer_BSD_C DSM_EnvDfp_AFSCD_SRCRawAirm2_C DSM_EnvDfp_AFSCD_SRCRefSigPer_C DSM_EnvDfp_AFSCD_SRCRefSigPer2_C DSM_EnvDfp_AOHtCD_C DSM_EnvDfp_AOHtCD_AOHtDia1_C DSM_EnvDfp_AOHtCD_AOHtDia2_C DSM_EnvDfp_AOHtCD_AOHtDia3_C DSM_EnvDfp_APP1_C DSM_EnvDfp_APP2_C DSM_EnvDfp_APPCDCmpd_C DSM_EnvDfp_Layer_QLT_C DSM_EnvDfp_APPSync_C DSM_EnvDfp_Layer_IBS1_C DSM_EnvDfp_Layer_IBS2_C DSM_EnvDfp_Layer_IBS3_C DSM_EnvDfp_Layer_PMBN_C DSM_EnvDfp_Layer_PMBATT_C DSM_EnvDfp_APSCD_C DSM_EnvDfp_ARS_C DSM_EnvDfp_AccPedPlausBrk_C DSM_EnvDfp_AddPCDTnkLvl_C DSM_EnvDfp_AirCtlGvnrDvtRgnMax_C DSM_EnvDfp_AirCtlGvnrDvtRgnMin_C DSM_EnvDfp_AirCtlGvnrDvtRgnMn2_C DSM_EnvDfp_AirCtlGvnrDvtRgnMx2_C DSM_EnvDfp_AirCtlPlateBreak_C DSM_EnvDfp_AirCtlRmpTO_C DSM_EnvDfp_AirCtl_GovNegDev_C DSM_EnvDfp_AirCtl_GovNegDev2_C DSM_EnvDfp_AirCtl_GovPosDev_C DSM_EnvDfp_AirCtl_GovPosDev2_C DSM_EnvDfp_AltCD_C DSM_EnvDfp_BPACD_BPADia1_C DSM_EnvDfp_BPACD_BPADia1v2_C DSM_EnvDfp_BPACD_BPADia2_C DSM_EnvDfp_BPACD_BPADia2v2_C DSM_EnvDfp_BPACD_BPADia3_C DSM_EnvDfp_BPACD_BPADia3v2_C DSM_EnvDfp_BPACD_BPADia4_C DSM_EnvDfp_BPACD_BPADia4v2_C DSM_EnvDfp_BPACD_Max_C DSM_EnvDfp_BPACD_Max2_C DSM_EnvDfp_BPACD_Min_C DSM_EnvDfp_BPACD_Min2_C DSM_EnvDfp_BPACD_SigNpl_C DSM_EnvDfp_BPACD_SigNpl2_C DSM_EnvDfp_BPSCD_C DSM_EnvDfp_BattCD_C DSM_EnvDfp_BrkCD_C DSM_EnvDfp_Layer_PMRUHVERL_C DSM_EnvDfp_Bss_C DSM_EnvDfp_CBACD_C DSM_EnvDfp_CTSCD_C DSM_EnvDfp_Clg_DynTst_C DSM_EnvDfp_Layer_TOENS_C DSM_EnvDfp_Layer_MANHYDR_C DSM_EnvDfp_Layer_MANLUFT_C DSM_EnvDfp_CmbChbMisfire1_C DSM_EnvDfp_CmbChbMisfire2_C DSM_EnvDfp_CmbChbMisfire3_C DSM_EnvDfp_CmbChbMisfire4_C DSM_EnvDfp_CmbChbMisfire5_C DSM_EnvDfp_CmbChbMisfire6_C DSM_EnvDfp_CmbChbMisfire7_C DSM_EnvDfp_CmbChbMisfire8_C DSM_EnvDfp_CmbChbMisfireMul_C DSM_EnvDfp_CoDT_TRQ_Des_C DSM_EnvDfp_CoDT_TRQ_Lead_C DSM_EnvDfp_CoEng_GbxRpmRduc_C DSM_EnvDfp_CoVMDCSh_C DSM_EnvDfp_ConvCD_C DSM_EnvDfp_CrCCDMFL_C DSM_EnvDfp_CrCtl_vCrCtl_C DSM_EnvDfp_EATSCD_C DSM_EnvDfp_EBAFCD_C DSM_EnvDfp_EBFCD_C DSM_EnvDfp_EBTSCD_C DSM_EnvDfp_EBTSCD_OvrTemp_C DSM_EnvDfp_EEPCDVarMng_C DSM_EnvDfp_EGPpCD_C DSM_EnvDfp_EGRCD_Max_C DSM_EnvDfp_EGRCD_Max2_C DSM_EnvDfp_EGRCD_Min_C DSM_EnvDfp_EGRCD_Min2_C DSM_EnvDfp_EGRCD_PWMInDia1_C DSM_EnvDfp_EGRCD_PWMInDia2_C DSM_EnvDfp_EGRCD_PWMInDia21_C DSM_EnvDfp_EGRCD_PWMInDia22_C DSM_EnvDfp_EGRCD_PWMInDia23_C DSM_EnvDfp_EGRCD_PWMInDia24_C DSM_EnvDfp_EGRCD_PWMInDia3_C DSM_EnvDfp_EGRCD_PWMInDia4_C DSM_EnvDfp_EGRCD_SigDia_C DSM_EnvDfp_EGRCD_SigDia2_C DSM_EnvDfp_EGRCD_SigNpl_C DSM_EnvDfp_EGRCD_SigNpl2_C DSM_EnvDfp_EGTOilLvlCrit_C DSM_EnvDfp_EGTOilVscCrit_C DSM_EnvDfp_EGTRgnOilDil_C DSM_EnvDfp_EGTTempGvnrInrB1_C DSM_EnvDfp_EGTTempGvnrInrB2_C DSM_EnvDfp_EGTTempGvnrOutrB1_C DSM_EnvDfp_EGTTempGvnrOutrB2_C DSM_EnvDfp_ETClbETFltInj1_C DSM_EnvDfp_ETClbETFltInj2_C DSM_EnvDfp_ETClbETFltInj3_C DSM_EnvDfp_ETClbETFltInj4_C DSM_EnvDfp_ETClbETFltInj5_C DSM_EnvDfp_ETClbETFltInj6_C DSM_EnvDfp_ETClbETFltInj7_C DSM_EnvDfp_ETClbETFltInj8_C DSM_EnvDfp_ETClbInj1_C DSM_EnvDfp_ETClbInj2_C DSM_EnvDfp_ETClbInj3_C DSM_EnvDfp_ETClbInj4_C DSM_EnvDfp_ETClbInj5_C DSM_EnvDfp_ETClbInj6_C DSM_EnvDfp_ETClbInj7_C DSM_EnvDfp_ETClbInj8_C DSM_EnvDfp_EngMCaS1_C DSM_EnvDfp_EngMCrS1_C DSM_EnvDfp_EngMOfsCaSCrS_C DSM_EnvDfp_EngMntCtlCD_C DSM_EnvDfp_FBCqDvt_C DSM_EnvDfp_FMAErrMod_C DSM_EnvDfp_FMTC_NonMonotonMap_C DSM_EnvDfp_FTSCD_C DSM_EnvDfp_FanCD_C DSM_EnvDfp_FanCD_FanCtlr1_C DSM_EnvDfp_FanCD_FanCtlr2_C DSM_EnvDfp_FanCD_FanCtlr3_C DSM_EnvDfp_FlFCD_C DSM_EnvDfp_FlMngSmkDefect_C DSM_EnvDfp_FlSCDT1_C DSM_EnvDfp_FrmMngANFRADMOMPT_C DSM_EnvDfp_FrmMngASC1_C DSM_EnvDfp_FrmMngASC2_C DSM_EnvDfp_FrmMngASC3_C DSM_EnvDfp_FrmMngASC4_C DSM_EnvDfp_FrmMngBOS_RESET_C DSM_EnvDfp_FrmMngBOS_RESET2_C DSM_EnvDfp_FrmMngDMANFAFS_C DSM_EnvDfp_FrmMngDRMANFSSG_C DSM_EnvDfp_FrmMngEGS1_C DSM_EnvDfp_FrmMngEGS2_C DSM_EnvDfp_FrmMngGEARBX_DATA_C DSM_EnvDfp_FrmMngGEARBX_DATA2_C DSM_EnvDfp_FrmMngHEAT_AC_C DSM_EnvDfp_FrmMngINSTR2_C DSM_EnvDfp_FrmMngINSTR3_C DSM_EnvDfp_FrmMngLENKRADWINKEL_C DSM_EnvDfp_FrmMngMILEAGE_RANGE_C DSM_EnvDfp_FrmMngMSPHISYNC_C DSM_EnvDfp_FrmMngMST4_C DSM_EnvDfp_FrmMngMST5_C DSM_EnvDfp_FrmMngOPCRCTLACC_C DSM_EnvDfp_FrmMngPRGG_CCTR_C DSM_EnvDfp_FrmMngPWRMNG_LOADV_C DSM_EnvDfp_FrmMngParkConsumer_C DSM_EnvDfp_FrmMngRQSTGEFAN_C DSM_EnvDfp_FrmMngSLV4_C DSM_EnvDfp_FrmMngSLV5_C DSM_EnvDfp_FrmMngSSGErr_C DSM_EnvDfp_FrmMngSSGShOff_C DSM_EnvDfp_FrmMngSTAT_ANH_C DSM_EnvDfp_FrmMngSTAT_ARS_C DSM_EnvDfp_FrmMngSTAT_DSC_C DSM_EnvDfp_FrmMngSTAT_EKP_C DSM_EnvDfp_FrmMngSTAT_KOMBI_C DSM_EnvDfp_FrmMngSTAT_SITZ_C DSM_EnvDfp_FrmMngStOBDGbxMilOf_C DSM_EnvDfp_FrmMngStOBDGbxMilOn_C DSM_EnvDfp_FrmMngTEMPRELTIME_C DSM_EnvDfp_FrmMngTERMINAL_C DSM_EnvDfp_FrmMngTIME_DATE_C DSM_EnvDfp_FrmMngTORQUE_DSC_C DSM_EnvDfp_FrmMngTORQUE_GEARBX_C DSM_EnvDfp_FrmMngTrq_ReqACC_C DSM_EnvDfp_FrmMngVEH_MOD_C DSM_EnvDfp_FrmMngVELOCITY_C DSM_EnvDfp_FrmMngWHEEL_SPEED_C DSM_EnvDfp_FrmMngstCurr_C DSM_EnvDfp_FrmMngswtPSPOff_C DSM_EnvDfp_GearbxIncMax_C DSM_EnvDfp_GlwCD_C DSM_EnvDfp_GlwCDGlwCirc1_C DSM_EnvDfp_GlwCDGlwCirc2_C DSM_EnvDfp_GlwCDGlwCirc3_C DSM_EnvDfp_GlwCDGlwCirc4_C DSM_EnvDfp_GlwCDGlwCirc5_C DSM_EnvDfp_GlwCDGlwCirc6_C DSM_EnvDfp_GlwCDGlwCirc7_C DSM_EnvDfp_GlwCDGlwCirc8_C DSM_EnvDfp_GlwCtl_C DSM_EnvDfp_HWEMonCom_C DSM_EnvDfp_HWEMonEEPROM_C DSM_EnvDfp_HWEMonRcyLocked_C DSM_EnvDfp_HWEMonRcySuppressed_C DSM_EnvDfp_HWEMonRcyVisible_C DSM_EnvDfp_HWEMonUMaxSupply_C DSM_EnvDfp_HWEMonUMinSupply_C DSM_EnvDfp_IATSCD_C DSM_EnvDfp_IATSCD_CATS_C DSM_EnvDfp_IATSCD_CATSSec_C DSM_EnvDfp_ImmCtlImmCD_C DSM_EnvDfp_ImmCtlImmEep_C DSM_EnvDfp_ImmCtlMpl_C DSM_EnvDfp_IndSys1_C DSM_EnvDfp_IndSys2_C DSM_EnvDfp_InjCrv_InjLim_C DSM_EnvDfp_InjCtlAdjQnt_C DSM_EnvDfp_InjCtlDrift_C DSM_EnvDfp_InjVCDActrChrg_C DSM_EnvDfp_InjVCDActrEnrg1_C DSM_EnvDfp_InjVCDActrEnrg2_C DSM_EnvDfp_InjVCDActrEnrg3_C DSM_EnvDfp_InjVCDActrEnrg4_C DSM_EnvDfp_InjVCDActrEnrg5_C DSM_EnvDfp_InjVCDActrEnrg6_C DSM_EnvDfp_InjVCDActrEnrg7_C DSM_EnvDfp_InjVCDActrEnrg8_C DSM_EnvDfp_InjVCDActrVolt_C DSM_EnvDfp_InjVCDClsBank1_C DSM_EnvDfp_InjVCDClsBank2_C DSM_EnvDfp_InjVCDMonCab_C DSM_EnvDfp_InjVCDMonSwt_C DSM_EnvDfp_InjVCDShOffDCDC_C DSM_EnvDfp_InjVCDUBuf1_C DSM_EnvDfp_InjVCDUBuf2_C DSM_EnvDfp_InjVCD_CY370Ampl_C DSM_EnvDfp_InjVCD_DrvTime_C DSM_EnvDfp_InjVCD_DrvTimeRcy_C DSM_EnvDfp_InjVCD_TPUErr_C DSM_EnvDfp_InjVlvBnk1A_C DSM_EnvDfp_InjVlvBnk1B_C DSM_EnvDfp_InjVlvBnk2A_C DSM_EnvDfp_InjVlvBnk2B_C DSM_EnvDfp_InjVlvChipA_C DSM_EnvDfp_InjVlvChipB_C DSM_EnvDfp_InjVlvCyl1A_C DSM_EnvDfp_InjVlvCyl1B_C DSM_EnvDfp_InjVlvCyl1C_C DSM_EnvDfp_InjVlvCyl2A_C DSM_EnvDfp_InjVlvCyl2B_C DSM_EnvDfp_InjVlvCyl2C_C DSM_EnvDfp_InjVlvCyl3A_C DSM_EnvDfp_InjVlvCyl3B_C DSM_EnvDfp_InjVlvCyl3C_C DSM_EnvDfp_InjVlvCyl4A_C DSM_EnvDfp_InjVlvCyl4B_C DSM_EnvDfp_InjVlvCyl4C_C DSM_EnvDfp_InjVlvCyl5A_C DSM_EnvDfp_InjVlvCyl5B_C DSM_EnvDfp_InjVlvCyl5C_C DSM_EnvDfp_InjVlvCyl6A_C DSM_EnvDfp_InjVlvCyl6B_C DSM_EnvDfp_InjVlvCyl6C_C DSM_EnvDfp_InjVlvCyl7A_C DSM_EnvDfp_InjVlvCyl7B_C DSM_EnvDfp_InjVlvCyl7C_C DSM_EnvDfp_InjVlvCyl8A_C DSM_EnvDfp_InjVlvCyl8B_C DSM_EnvDfp_InjVlvCyl8C_C DSM_EnvDfp_InjVlvNVC1_C DSM_EnvDfp_InjVlvNVC2_C DSM_EnvDfp_InjVlvNVC3_C DSM_EnvDfp_InjVlvNVC4_C DSM_EnvDfp_InjVlvNVC5_C DSM_EnvDfp_InjVlvNVC6_C DSM_EnvDfp_InjVlvNVC7_C DSM_EnvDfp_InjVlvNVC8_C DSM_EnvDfp_KeyCheck_C DSM_EnvDfp_LIGovECUTransMode_C DSM_EnvDfp_LPACD_Max_C DSM_EnvDfp_LPACD_Min_C DSM_EnvDfp_LPACD_SigNpl_C DSM_EnvDfp_LSUCDCircNernst0B1_C DSM_EnvDfp_LSUCDCircNernst0B2_C DSM_EnvDfp_LSUCDCircPumpCur0B1_C DSM_EnvDfp_LSUCDCircPumpCur0B2_C DSM_EnvDfp_LSUCDCircVirtGnd0B1_C DSM_EnvDfp_LSUCDCircVirtGnd0B2_C DSM_EnvDfp_LSUCDHeater0B1_C DSM_EnvDfp_LSUCDHeater0B2_C DSM_EnvDfp_LSUCDHtCoup0B1_C DSM_EnvDfp_LSUCDHtCoup0B2_C DSM_EnvDfp_LSUCDO20B1_C DSM_EnvDfp_LSUCDO20B2_C DSM_EnvDfp_LSUCDO2Clb0B1_C DSM_EnvDfp_LSUCDO2Clb0B2_C DSM_EnvDfp_LSUCDRiClb0B1_C DSM_EnvDfp_LSUCDRiClb0B2_C DSM_EnvDfp_LSUCDSPI0B1_C DSM_EnvDfp_LSUCDSPI0B2_C DSM_EnvDfp_LSUCDSPIBattLow0B1_C DSM_EnvDfp_LSUCDSPIBattLow0B2_C DSM_EnvDfp_LSUCDWireIP0B1_C DSM_EnvDfp_LSUCDWireIP0B2_C DSM_EnvDfp_LSUCtlRiExc0B1_C DSM_EnvDfp_LSUCtlRiExc0B2_C DSM_EnvDfp_LSUMon1SensB1_C DSM_EnvDfp_LSUMon1SensB2_C DSM_EnvDfp_LSUMon2SensB1_C DSM_EnvDfp_LSUMon2SensB2_C DSM_EnvDfp_MIL_C DSM_EnvDfp_MRlyCD_C DSM_EnvDfp_MSMon_C DSM_EnvDfp_MSMonConsist_C DSM_EnvDfp_MSMonPFlt1_C DSM_EnvDfp_MSMonPFlt2_C DSM_EnvDfp_MSMonPFlt3_C DSM_EnvDfp_MSMonPFlt4_C DSM_EnvDfp_MSMon_ARS_TO_C DSM_EnvDfp_MSMon_AirCtl_C DSM_EnvDfp_MSMon_AirSys0_C DSM_EnvDfp_MSMon_AirSys1_C DSM_EnvDfp_MSMon_AirSys2_C DSM_EnvDfp_MSMon_AirSys3_C DSM_EnvDfp_MSMon_AirSys4_C DSM_EnvDfp_MSMon_AirSys7_C DSM_EnvDfp_MSMon_CanDef_C DSM_EnvDfp_MSMon_CoEng_OffVeh_C DSM_EnvDfp_MSMon_CoEng_Rev1_C DSM_EnvDfp_MSMon_CoEng_Rev2_C DSM_EnvDfp_MSMon_CoEng_RevMS_C DSM_EnvDfp_MSMon_DSC_TO_C DSM_EnvDfp_MSMon_EGS_TO_C DSM_EnvDfp_MSMon_FrmMngCoEng_C DSM_EnvDfp_MSMon_FrmMngPT_C DSM_EnvDfp_MSMon_FrmMngPT2_C DSM_EnvDfp_MSMon_Mil_C DSM_EnvDfp_MSMon_NetMngPtCan_C DSM_EnvDfp_MSMon_RailCDPMon_C DSM_EnvDfp_MSMon_StEGS_C DSM_EnvDfp_MSMon_SysLamp_C DSM_EnvDfp_MSMon_ZFCClbActv_C DSM_EnvDfp_MSMon_qLimErr_C DSM_EnvDfp_MSMon_trqCoDT_C DSM_EnvDfp_MSMon_trqCoVeh_C DSM_EnvDfp_MSMon_trqCoVehLim_C DSM_EnvDfp_MSMon_trqDesExt_C DSM_EnvDfp_MSMon_trqDesExtRev_C DSM_EnvDfp_MSMon_trqLimErr_C DSM_EnvDfp_MSMon_trqLimErr1_C DSM_EnvDfp_MSMon_trqLimErr2_C DSM_EnvDfp_MSMon_trqLimErr3_C DSM_EnvDfp_MSMon_trqLimErr4_C DSM_EnvDfp_MSidCD_Comm_C DSM_EnvDfp_MSidCD_EcuMixed_C DSM_EnvDfp_MSidCD_Pin_C DSM_EnvDfp_MSidCD_Sel_INI_C DSM_EnvDfp_MSidCD_Select_C DSM_EnvDfp_MSid_SwCmp_C DSM_EnvDfp_MSid_regEEPDiff_C DSM_EnvDfp_MeUnCDNoLoad_C DSM_EnvDfp_MeUnCDSCBat_C DSM_EnvDfp_MeUnCDSCGnd_C DSM_EnvDfp_MeUnCD_ADC_C DSM_EnvDfp_MeUnCD_SigTst_C DSM_EnvDfp_Montr_C DSM_EnvDfp_NetMngDeviceA_C DSM_EnvDfp_NetMngDeviceB_C DSM_EnvDfp_NetMngDeviceC_C DSM_EnvDfp_NetMngPrvCan_C DSM_EnvDfp_NetMngPrvCanSlave_C DSM_EnvDfp_NetMngPtCan_C DSM_EnvDfp_NetMngPtCanSlave_C DSM_EnvDfp_OPSCD_Lamp_C DSM_EnvDfp_OPSCD_anain_C DSM_EnvDfp_OTSCD_C DSM_EnvDfp_OvRMon_C DSM_EnvDfp_OvRMonSigA_C DSM_EnvDfp_OxiCCDTPreB1_C DSM_EnvDfp_OxiCCDTPreB2_C DSM_EnvDfp_PCBS_C DSM_EnvDfp_PCR_BalGvnr_C DSM_EnvDfp_PCR_GovDevNeg_C DSM_EnvDfp_PCR_GovDevPos_C DSM_EnvDfp_PCR_LPGvnrDvtNeg_C DSM_EnvDfp_PCR_LPGvnrDvtPos_C DSM_EnvDfp_PCVCDNoLoad_C DSM_EnvDfp_PCVCDSCBat_C DSM_EnvDfp_PCVCDSCGnd_C DSM_EnvDfp_PCVCD_ADC_C DSM_EnvDfp_PCVCD_SigTst_C DSM_EnvDfp_PFltAPSPlaus_C DSM_EnvDfp_PFltAPSensB1_C DSM_EnvDfp_PFltAPSensB2_C DSM_EnvDfp_PFltBPSPlaus_C DSM_EnvDfp_PFltCDPPreB1_C DSM_EnvDfp_PFltCDPPreB2_C DSM_EnvDfp_PFltCDTPreB1_C DSM_EnvDfp_PFltCDTPreB2_C DSM_EnvDfp_PFltCharB1_C DSM_EnvDfp_PFltCharB2_C DSM_EnvDfp_PFltDltOxiPreTwFlw_C DSM_EnvDfp_PFltDltPreTwFlw_C DSM_EnvDfp_PFltEngPrtB1_C DSM_EnvDfp_PFltEngPrtB2_C DSM_EnvDfp_PFltOvldInhRgnB1_C DSM_EnvDfp_PFltOvldInhRgnB2_C DSM_EnvDfp_PFltOvldTrqLimB1_C DSM_EnvDfp_PFltOvldTrqLimB2_C DSM_EnvDfp_PFltPresDynPlausB1_C DSM_EnvDfp_PFltPresDynPlausB2_C DSM_EnvDfp_PFltPresPlausB1_C DSM_EnvDfp_PFltPresPlausB2_C DSM_EnvDfp_PFltPresSensB1_C DSM_EnvDfp_PFltPresSensB2_C DSM_EnvDfp_PFltPresSensFrz_C DSM_EnvDfp_PFltPresSensHsLnB1_C DSM_EnvDfp_PFltPresSensHsLnB2_C DSM_EnvDfp_PFltPresSensSotB1_C DSM_EnvDfp_PFltPresSensSotB2_C DSM_EnvDfp_PFltRgnPerm_C DSM_EnvDfp_PFltTempDwnStrmB1_C DSM_EnvDfp_PFltTempDwnStrmB2_C DSM_EnvDfp_PFltTempSensB1_C DSM_EnvDfp_PFltTempSensB2_C DSM_EnvDfp_PFltTempUpStrmB1_C DSM_EnvDfp_PFltTempUpStrmB2_C DSM_EnvDfp_PFlt_tOxiPreMaxB1_C DSM_EnvDfp_PFlt_tOxiPreMaxB2_C DSM_EnvDfp_PFlt_tOxiPreMxRgnB1_C DSM_EnvDfp_PFlt_tOxiPreMxRgnB2_C DSM_EnvDfp_PFlt_tPreMaxB1_C DSM_EnvDfp_PFlt_tPreMaxB2_C DSM_EnvDfp_PFlt_tPreMaxRgnB1_C DSM_EnvDfp_PFlt_tPreMaxRgnB2_C DSM_EnvDfp_PFltmSotDiffMaxB1_C DSM_EnvDfp_PFltmSotDiffMaxB2_C DSM_EnvDfp_PresPlausDblDef_C DSM_EnvDfp_QLTCD_C DSM_EnvDfp_RailCD_C DSM_EnvDfp_RailCDOfsTst_C DSM_EnvDfp_RailCD_PMonStrt_C DSM_EnvDfp_RailCPC1_C DSM_EnvDfp_RailCPC3_C DSM_EnvDfp_RailCPC4_C DSM_EnvDfp_RailCtlModeMeUnDiag_C DSM_EnvDfp_RailCtlModePCVDiag_C DSM_EnvDfp_RailMeUn0_C DSM_EnvDfp_RailMeUn1_C DSM_EnvDfp_RailMeUn2_C DSM_EnvDfp_RailMeUn3_C DSM_EnvDfp_RailMeUn4_C DSM_EnvDfp_RailPCV0_C DSM_EnvDfp_RailPCV1_C DSM_EnvDfp_RailPCV2_C DSM_EnvDfp_RailPCV3_C DSM_EnvDfp_RailPCV4_C DSM_EnvDfp_RailPCV5_C DSM_EnvDfp_SOPTst_C DSM_EnvDfp_SSpMon1_C DSM_EnvDfp_SSpMon2_C DSM_EnvDfp_SSpMon3_C DSM_EnvDfp_SSpMon4_C DSM_EnvDfp_SSpMon5_C DSM_EnvDfp_SSpMon6_C DSM_EnvDfp_SWChk_CycSigChkDat_C DSM_EnvDfp_SWChk_CycSigChkPrg_C DSM_EnvDfp_StSysTrqShutOff_C DSM_EnvDfp_StrtCD_Actr_C DSM_EnvDfp_SysLamp_C DSM_EnvDfp_T15CD_C DSM_EnvDfp_TGearbx_C DSM_EnvDfp_TPUMon_C DSM_EnvDfp_TVACD_AirMon1_C DSM_EnvDfp_TVACD_AirMon2_C DSM_EnvDfp_TVACD_Max_C DSM_EnvDfp_TVACD_Max2_C DSM_EnvDfp_TVACD_Min_C DSM_EnvDfp_TVACD_Min2_C DSM_EnvDfp_TVACD_SigNpl_C DSM_EnvDfp_TVACD_SigNpl2_C DSM_EnvDfp_TVACD_TVADia1_C DSM_EnvDfp_TVACD_TVADia2_C DSM_EnvDfp_TVACD_TVADia21_C DSM_EnvDfp_TVACD_TVADia22_C DSM_EnvDfp_TVACD_TVADia23_C DSM_EnvDfp_TVACD_TVADia24_C DSM_EnvDfp_TVACD_TVADia3_C DSM_EnvDfp_TVACD_TVADia4_C DSM_EnvDfp_ThrVlvMon_C DSM_EnvDfp_VSACD_DiaDet_C DSM_EnvDfp_VSACD_DioInDia1_C DSM_EnvDfp_VSACD_DioInDia2_C DSM_EnvDfp_VSACD_DioInDia3_C DSM_EnvDfp_VSACD_DioInDia4_C DSM_EnvDfp_VSACD_DioInMin_C DSM_EnvDfp_VSACD_Max_C DSM_EnvDfp_VSACD_Min_C DSM_EnvDfp_VSACD_SigNpl_C DSM_EnvDfp_VSACD_VSADia1_C DSM_EnvDfp_VSACD_VSADia2_C DSM_EnvDfp_VSACD_VSADia3_C DSM_EnvDfp_VSACD_VSADia4_C DSM_EnvDfp_VSSCD1_C DSM_EnvDfp_VSSCD2_C DSM_EnvDfp_WdCom_C /end DEF_CHARACTERISTIC
/end FUNCTION
/begin FUNCTION dsm_auto_fid_scd "" /end FUNCTION
/begin FUNCTION dsm_auto_fid_scd_msg "" /end FUNCTION
/begin COMPU_METHOD SigName "Verbale Umrechnung für Signal Referenz Nummern" TAB_VERB "%6.3" "-" COMPU_TAB_REF SigName /end COMPU_METHOD
/begin COMPU_VTAB SigName "Verbale Umrechnung für Signal Referenz Nummern" TAB_VERB 136 0 "Sig_unused" 4 "CoEng_rTrq__Carb_r_DLen1" 5 "CTSCD_tClntLin__Carb_t_DLen1" 11 "BPSCD_pLin__Carb_p_DLen1" 12 "Eng_nAvrg__Carb_n_DLen2" 13 "VSSCD_vSensVal__Carb_v_DLen1" 15 "AFSCD_tAir_mp__Carb_t_DLen1" 16 "AFSCD_dmAirRawPerTime__Carb_mAirTim_DLen2" 28 "Signals_PID0x1C_C__OneToOne_DLen1" 33 "DSMDur_ctDfctDur1__Carb_l_DLen2" 128 "AFSCD_dmAirPerTime__mAirTim_DLen2" 129 "AFSCD_mAirPerCyl__mAirCyl_DLen2" 130 "AFSCD_mAirPerCyl2__mAirCyl_DLen2" 131 "AFSCD_rAir__dcyc_DLen2" 132 "AFSCD_rAir2__dcyc_DLen2" 133 "AOHtCD_rOut_mp__dcyc_DLen2" 134 "APPCD_rFlt__r_DLen2" 135 "PFlt_pPreCorrB2_mp__p_DLen2" 137 "APPCD_uRawAPP1__u_DLen2" 138 "APPCD_uRawAPP2__u_DLen2" 139 "APSCD_pVal__p_DLen2" 140 "APSCD_uRaw__u_DLen2" 141 "AirCtl_mDesVal__mAirCyl_DLen2" 142 "AltCD_rAltLoad__r_DLen2" 143 "BPACD_rOut__dcyc_DLen2" 144 "BPACD_rOut2__dcyc_DLen2" 145 "BPSCD_pOutVal__p_DLen2" 146 "BPSCD_uRawVal__u_DLen2" 147 "BattCD_u__uBatt_DLen2" 148 "CBACD_stLogicOut_mp__OneToOne_DLen1" 149 "CTSCD_tClnt__t_DLen2" 150 "CTSCD_uRaw__u_DLen2" 151 "CoEng_trq__trq_DLen2" 152 "EBAFCD_stSigOut__OneToOne_DLen1" 153 "EGRCD_rOut__dcyc_DLen2" 154 "EGRCD_rOut2__dcyc_DLen2" 155 "EGT_st__ShftRght0Byte_DLen2" 156 "EngM_stOut__OneToOne_DLen1" 157 "EngM_stSync__OneToOne_DLen1" 158 "Eng_nAvrg__n_DLen2" 159 "FMTC_trqInr__trq_DLen2" 160 "FTSCD_tFuel__t_DLen2" 161 "FTSCD_uRaw__u_DLen2" 162 "FanCD_dcycRaw_mp__dcyc_DLen2" 163 "FlFCD_stFlFltRawVal__OneToOne_DLen1" 164 "FrmMng_nPSP__nPSPSpd_DLen2" 165 "FrmMng_rPSPSetPoint__r_DLen2" 166 "GlwCtl_rPwrOut__OneToOne_DLen1" 167 "GlwCtl_stLampOut__OneToOne_DLen1" 168 "HWEMon_numRecovery__ShftRght0Byte_DLen2" 169 "HWEMon_numRecovery__ShftRght1Byte_DLen2" 170 "HWEMon_recLocLow_mp__ShftRght0Byte_DLen2" 171 "HWEMon_recLocLow_mp__ShftRght1Byte_DLen2" 172 "HWEMon_recLocHigh_mp__ShftRght0Byte_DLen2" 173 "IATSCD_tAir__t_DLen2" 174 "IATSCD_tAirCats__t_DLen2" 175 "IATSCD_tAirCatsSec__t_DLen2" 176 "IATSCD_uRawCats__u_DLen2" 177 "IATSCD_uRawCatsSec__u_DLen2" 178 "Tn_abstell__DezUwQ1_DLen2" 179 "U_gen__UUwQ0p1_DLen2" 180 "HWEMon_numEEPBlockfailed__OneToOne_DLen1" 181 "InjCtl_qCurr__qInjMassCyc_DLen2" 182 "InjCtl_qSetUnBal__qInjMassCyc_DLen2" 183 "LIGov_nSetpoint__n_DLen2" 184 "LIGov_trq__trq_DLen2" 185 "LPACD_rOut__dcyc_DLen2" 186 "AFSCD_tAir1__t_DLen2" 187 "AFSCD_tAir2__t_DLen2" 188 "CoEng_stEng__OneToOne_DLen1" 189 "LSU_rO2Adpt[0]__O2_DLen2" 190 "MeUnCD_dcycOut_mp__dcyc_DLen2" 191 "OPSCD_stSigOut__OneToOne_DLen1" 192 "PFlt_pDiffB2__p_DLen2" 193 "OTSCD_tEngOil__t_DLen2" 194 "OxiCCD_tPreB1__tExhaustgas_DLen2" 195 "OxiCCD_tPreB2__tExhaustgas_DLen2" 196 "OxiCCD_uRawTempPreB1__u_DLen2" 197 "OxiCCD_uRawTempPreB2__u_DLen2" 198 "PCR_pDesVal__p_DLen2" 199 "PCVCD_dcycOut_mp__dcyc_DLen2" 200 "PFltCD_pPreB1__p_DLen2" 201 "PFltCD_pPreB2__p_DLen2" 202 "PFltCD_tPreB1__tExhaustgas_DLen2" 203 "PFltCD_tPreB2__tExhaustgas_DLen2" 204 "PFltCD_uRawPresPreB1__u_DLen2" 205 "PFltCD_uRawPresPreB2__u_DLen2" 206 "PFltCD_uRawTempPreB1__u_DLen2" 207 "PFltCD_uRawTempPreB2__u_DLen2" 208 "PFlt_dvol__volph_DLen2" 209 "PFlt_lSnceRgnu16B1_mp__lenrgnu16PFlt_DLen2" 210 "PFlt_lSnceRgnu16B2_mp__lenrgnu16PFlt_DLen2" 211 "PFlt_mAshOilB1__mSoot_DLen2" 212 "PFlt_mSotB1__mSoot_DLen2" 213 "PFlt_mSotSimB1__mSoot_DLen2" 214 "PFlt_dvolB1__volph_DLen2" 215 "PFlt_dvolB2__volph_DLen2" 216 "PFlt_pDiffB1__p_DLen2" 217 "PFlt_qFlB1_mp__FlConPFlt_DLen2" 218 "PFlt_qFlB2_mp__FlConPFlt_DLen2" 219 "AFSCD_mAirPerCyl1__mAirCyl_DLen2" 221 "PFlt_stLck_mp__OneToOne_DLen1" 222 "PSPCD_dvolOut__FlCon_DLen2" 223 "RailCD_pPeak__pRail_DLen2" 224 "RailCD_uPeakRaw__u_DLen2" 225 "Rail_pSetPoint__pRail_DLen2" 226 "TVACD_rOut__dcyc_DLen2" 227 "TVACD_rOut2__dcyc_DLen2" 228 "VSACD_rOut__dcyc_DLen2" 229 "VSSCD_v__v_DLen2" 230 "VehDa_tiEngOn__timEng_DLen2" 231 "PFlt_pPreCorrB1_mp__p_DLen2" 232 "PFlt_stPresPlaus_mp__OneToOne_DLen1" 233 "PFlt_mAshOilB2__mSoot_DLen2" 234 "EGPpCD_stActrOut__OneToOne_DLen1" 235 "PFlt_mSotSimB2__mSoot_DLen2" 236 "OvRMon_tiTDCAvrg__InjTim_DLen2" 237 "OvRMon_tiOvRMonActive_mp__tims_DLen2" 238 "CoEng_trqInrSet__trq_DLen2" 239 "InjCtl_qSet__qInjMassCyc_DLen2" 240 "Absch_korr__FSwQ0p00153_DLen2" 241 "D_soc__FSwB100_DLen2" 242 "I_batt__IUwQ0p08O200_DLen2" 243 "Oz_oelkm__KmUwQ10_DLen2" 244 "Oz_oelnivkurz__TdUbQ0p5_DLen1" 245 "Oz_oelnivnorm__TdUbQ0p5_DLen1" 246 "Oz_oelnivori__TdUbQ0p5_DLen1" 247 "PFlt_mSotB2__mSoot_DLen2" 248 "Stat_sv_reg1__DezUbQ1_DLen1" 249 "Stat_sv_reg2__DezUbQ1_DLen1" 250 "T2histshort__TdUbQ14p9333_DLen1" 251 "T3histshort__TdUbQ14p9333_DLen1" 252 "T4histshort__TdUbQ14p9333_DLen1" 253 "Toel__TSwQ0p1_DLen2" 254 "T_batt__TSwQ0p1_DLen2" 255 "U_batt__UUwQ0p25em3_DLen2" /end COMPU_VTAB
/begin RECORD_LAYOUT Kwb_Wu8 FNC_VALUES 1 UBYTE COLUMN_DIR DIRECT /end RECORD_LAYOUT
/end MODULE
/end PROJECT
