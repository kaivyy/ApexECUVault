ASAP2_VERSION 1 3
/begin PROJECT P390 "BMW DDE6.2 6-Zylinder VR0.1 15.03.2004 CAN11/12H"
/begin HEADER "" VERSION "VR0.1_6Z_CAN11/12H" PROJECT_NO P390 /end HEADER
/begin MODULE DIM ""
/begin MOD_COMMON "" BYTE_ORDER MSB_FIRST ALIGNMENT_BYTE 1 ALIGNMENT_WORD 2 ALIGNMENT_LONG 4 ALIGNMENT_FLOAT32_IEEE 4 /end MOD_COMMON
/begin MEASUREMENT FrmMng_aDirect "" SWORD Acc 1 100 -32.76800 32.76700 FORMAT "%8.5" ECU_ADDRESS 0x7F8CEA /end MEASUREMENT
/begin MEASUREMENT FrmMng_aSide "acceleration vehicle across DSC" SWORD Acc 1 100 -32.76800 32.76700 FORMAT "%8.5" ECU_ADDRESS 0x7F8CEC /end MEASUREMENT
/begin MEASUREMENT FrmMng_ctACC_TrqAlv "Alive Counter-message DREHMOMENT_ANF_ACC" UBYTE OneToOne 1 100 0.00 255.0 FORMAT "%5.1" ECU_ADDRESS 0x7F888D /end MEASUREMENT
/begin MEASUREMENT FrmMng_ctAnfRadMomPtalv_mp "Alive-Zähler für Botschaft ANF_RADMOM_PT" UBYTE OneToOne 1 100 0.00 255.0 FORMAT "%5.1" ECU_ADDRESS 0x8FF0C8 /end MEASUREMENT
/begin MEASUREMENT FrmMng_ctBOS_RESETalv_mp "alive-counter BOS_RESET" UWORD OneToOne 1 100 0.00 65535.00 FORMAT "%8.2" ECU_ADDRESS 0x8FF0CA /end MEASUREMENT
/begin MEASUREMENT FrmMng_ctDM_ANF_AFSalv_mp "alive-counter DMANFAFS" UBYTE OneToOne 1 100 0.00 255.0 FORMAT "%5.1" ECU_ADDRESS 0x8FF0CC /end MEASUREMENT
/begin MEASUREMENT FrmMng_ctDRMANFSSGalv_mp "alive-counter DRMANFSSG" UBYTE OneToOne 1 100 0.00 255.0 FORMAT "%5.1" ECU_ADDRESS 0x8FF0CD /end MEASUREMENT
/begin MEASUREMENT FrmMng_ctENGINE1alv_mp "Lebenszeichen-Zähler fuer CAN-Botschaft ENGINE1" UBYTE OneToOne 1 100 0.00 255.0 FORMAT "%5.1" ECU_ADDRESS 0x8FF0CE /end MEASUREMENT
/begin MEASUREMENT FrmMng_ctOPCRCTLACCalv_mp "alive-counter OP_CRCTLACC" UBYTE OneToOne 1 100 0.00 255.0 FORMAT "%5.1" ECU_ADDRESS 0x8FF0CF /end MEASUREMENT
/begin MEASUREMENT FrmMng_ctRadMom1alv_mp "Alive Zähler Botschaft RADMOM_PT_1" UWORD OneToOne 1 100 0.00 65535.00 FORMAT "%8.2" ECU_ADDRESS 0x8FF0D0 /end MEASUREMENT
/begin MEASUREMENT FrmMng_ctRadMom2alv_mp "Alive Zähler Botschaft RADMOM_PT_2" UWORD OneToOne 1 100 0.00 65535.00 FORMAT "%8.2" ECU_ADDRESS 0x8FF0D2 /end MEASUREMENT
/begin MEASUREMENT FrmMng_ctrRel "relativ counter" ULONG OneToOne 1 100 0.00 4294967295.00 FORMAT "%13.2" ECU_ADDRESS 0x7F91E4 /end MEASUREMENT
/begin MEASUREMENT FrmMng_ctSTAT_ARSalv_mp "STAT_ARS alivecounter" UBYTE OneToOne 1 100 0.00 255.0 FORMAT "%5.1" ECU_ADDRESS 0x8FF0D4 /end MEASUREMENT
/begin MEASUREMENT FrmMng_ctSTAT_KOMBIalv "Alive Zähler Kombi" UBYTE OneToOne 1 100 0.00 255.0 FORMAT "%5.1" ECU_ADDRESS 0x7F888E /end MEASUREMENT
/begin MEASUREMENT FrmMng_ctTERMINALalv_mp "alive-counter TERMINAL" UBYTE OneToOne 1 100 0.00 255.0 FORMAT "%5.1" ECU_ADDRESS 0x8FF0D5 /end MEASUREMENT
/begin MEASUREMENT FrmMng_ctTORQUE1alv_mp "Lebenszeichen-Zähler fuer CAN-Botschaft TORQUE1" UWORD OneToOne 1 100 0.00 65535.00 FORMAT "%8.2" ECU_ADDRESS 0x8FF0D6 /end MEASUREMENT
/begin MEASUREMENT FrmMng_ctTORQUE2alv_mp "Lebenszeichen-Zähler fuer CAN-Botschaft TORQUE2" UWORD OneToOne 1 100 0.00 65535.00 FORMAT "%8.2" ECU_ADDRESS 0x8FF0D8 /end MEASUREMENT
/begin MEASUREMENT FrmMng_ctTORQUE3alv_mp "Lebenszeichen-Zähler fuer CAN-Botschaft TORQUE3" UWORD OneToOne 1 100 0.00 65535.00 FORMAT "%8.2" ECU_ADDRESS 0x8FF0DA /end MEASUREMENT
/begin MEASUREMENT FrmMng_ctTORQUE_DSCalv_mp "TORQUE_DSC alivecounter" UBYTE OneToOne 1 100 0.00 255.0 FORMAT "%5.1" ECU_ADDRESS 0x8FF0DC /end MEASUREMENT
/begin MEASUREMENT FrmMng_ctTORQUE_GEARBXalv_mp "TORQUE_GEARBX alivecounter" UBYTE OneToOne 1 100 0.00 255.0 FORMAT "%5.1" ECU_ADDRESS 0x8FF0DD /end MEASUREMENT
/begin MEASUREMENT FrmMng_ctVEH_MODalv_mp "alive-counter for VEH_MOD signal" UBYTE OneToOne 1 100 0.00 255.0 FORMAT "%5.1" ECU_ADDRESS 0x8FF0DE /end MEASUREMENT
/begin MEASUREMENT FrmMng_dACC_CkSTrq "Checksumm-message DREHMOMENT_ANF_ACC" UBYTE OneToOne 1 100 0.00 255.0 FORMAT "%5.1" ECU_ADDRESS 0x7F8890 /end MEASUREMENT
/begin MEASUREMENT FrmMng_dAnfRadMomPtcs_mp "Checksum für ANF_RADMOM_PT" UWORD OneToOne 1 100 0.00 65535.00 FORMAT "%8.2" ECU_ADDRESS 0x8FF0E0 /end MEASUREMENT
/begin MEASUREMENT FrmMng_dDM_ANF_AFScs_mp "calculated checksum DMANFAFS" UBYTE OneToOne 1 100 0.00 255.0 FORMAT "%5.1" ECU_ADDRESS 0x8FF0E2 /end MEASUREMENT
/begin MEASUREMENT FrmMng_dDRMANFSSGcs_mp "checksum DRMANFSSG" UBYTE OneToOne 1 100 0.00 255.0 FORMAT "%5.1" ECU_ADDRESS 0x8FF0E3 /end MEASUREMENT
/begin MEASUREMENT FrmMng_dOPCRCTLACCcs_mp "checksum OP_CRCTLACC" UBYTE OneToOne 1 100 0.00 255.0 FORMAT "%5.1" ECU_ADDRESS 0x8FF0E4 /end MEASUREMENT
/begin MEASUREMENT FrmMng_dphiStrg "Rate of change of steering angle recieved over CAN" SWORD AngleGradPerSec 1 100 -1440.154 1440.110 FORMAT "%8.3" ECU_ADDRESS 0x7F8CF0 /end MEASUREMENT
/begin MEASUREMENT FrmMng_dRadMom1cs_mp "Checksumme Botschaft RADMOM_PT_1" UBYTE OneToOne 1 100 0.00 255.0 FORMAT "%5.1" ECU_ADDRESS 0x8FF0E5 /end MEASUREMENT
/begin MEASUREMENT FrmMng_dRadMom2cs_mp "Checksumme Botschaft RADMOM_PT_2" UBYTE OneToOne 1 100 0.00 255.0 FORMAT "%5.1" ECU_ADDRESS 0x8FF0E6 /end MEASUREMENT
/begin MEASUREMENT FrmMng_dSlopeACP "slope of frmmng accelerator pedal value" SWORD SlopeRes1000 1 100 -32.76800 32.76700 FORMAT "%8.5" ECU_ADDRESS 0x7F8CEE /end MEASUREMENT
/begin MEASUREMENT FrmMng_dTERMINALcs_mp "checksum TERMINAL" UBYTE OneToOne 1 100 0.00 255.0 FORMAT "%5.1" ECU_ADDRESS 0x8FF0E7 /end MEASUREMENT
/begin MEASUREMENT FrmMng_dTORQUE1cs_mp "Checksumme der CAN-Botschaft TORQUE1" UWORD OneToOne 1 100 0.00 65535.00 FORMAT "%8.2" ECU_ADDRESS 0x8FF0E8 /end MEASUREMENT
/begin MEASUREMENT FrmMng_dTORQUE2cs_mp "Checksumme der CAN-Botschaft TORQUE2" UWORD OneToOne 1 100 0.00 65535.00 FORMAT "%8.2" ECU_ADDRESS 0x8FF0EA /end MEASUREMENT
/begin MEASUREMENT FrmMng_dTORQUE3cs_mp "Checksumme der CAN-Botschaft TORQUE3" UWORD OneToOne 1 100 0.00 65535.00 FORMAT "%8.2" ECU_ADDRESS 0x8FF0EC /end MEASUREMENT
/begin MEASUREMENT FrmMng_dTORQUE_DSCcs_mp "TORQUE_DSC checksum" UBYTE OneToOne 1 100 0.00 255.0 FORMAT "%5.1" ECU_ADDRESS 0x8FF0EE /end MEASUREMENT
/begin MEASUREMENT FrmMng_dTORQUE_GEARBXcs_mp "TORQUE_GEARBX checksum" UBYTE OneToOne 1 100 0.00 255.0 FORMAT "%5.1" ECU_ADDRESS 0x8FF0EF /end MEASUREMENT
/begin MEASUREMENT FrmMng_dVEH_MODcs_mp "checksum for VEH_MOD signal" UBYTE OneToOne 1 100 0.00 255.0 FORMAT "%5.1" ECU_ADDRESS 0x8FF0F0 /end MEASUREMENT
/begin MEASUREMENT FrmMng_iHiLimCurr "Botschaft für I_SC_MAX_VEH CAN signal" UBYTE i_ub_q10p0 1 100 0.00 2550. FORMAT "%5.0" ECU_ADDRESS 0x7F8891 /end MEASUREMENT
/begin MEASUREMENT FrmMng_iLoLimCurr "Botschaft für I_SC_MIN_VEH CAN signal" UBYTE i_ub_q10p0 1 100 0.00 2550. FORMAT "%5.0" ECU_ADDRESS 0x7F8892 /end MEASUREMENT
/begin MEASUREMENT FrmMng_iZrCurrLim "Botschaft für QC_VEH CAN signal" UBYTE i_ub_q0p001 1 100 0.00 0.2550 FORMAT "%6.4" ECU_ADDRESS 0x7F8893 /end MEASUREMENT
/begin MEASUREMENT FrmMng_lSum "Kilometerstand des Fahrzeugs" ULONG LengthKm 1 100 0.00 4294967295.00 FORMAT "%13.2" ECU_ADDRESS 0x7F91E8 /end MEASUREMENT
/begin MEASUREMENT FrmMng_nBattCls "Botschaft für MAG_BT CAN signal" UBYTE DEZ 1 100 0.00 255.0 FORMAT "%5.1" ECU_ADDRESS 0x7F8894 /end MEASUREMENT
/begin MEASUREMENT FrmMng_nEngRpm1 "Engine rpm threshold 1 to be given to the drag indicator on kombi" UWORD EngN 1 100 0.00 65535.00 FORMAT "%8.2" ECU_ADDRESS 0x7F8CF2 /end MEASUREMENT
/begin MEASUREMENT FrmMng_nEngRpm2 "Engine rpm threshold 2 to be given to the drag indicator on kombi" UWORD EngN 1 100 0.00 65535.00 FORMAT "%8.2" ECU_ADDRESS 0x7F8CF4 /end MEASUREMENT
/begin MEASUREMENT FrmMng_nFan "Lüfterdrehzahl" SWORD FanSpd 1 100 -3000.092 3000.000 FORMAT "%8.3" ECU_ADDRESS 0x7F8CF6 /end MEASUREMENT
/begin MEASUREMENT FrmMng_nLimSSG "Maximum engine speed in phase 2 of the switching process" SWORD EngN 1 100 -32768.00 32767.00 FORMAT "%8.2" ECU_ADDRESS 0x7F8CF8 /end MEASUREMENT
/begin MEASUREMENT FrmMng_nRqStgEFan "Anforderung LüfterDrehzahl" UWORD FanSpd 1 100 0.00 6000.092 FORMAT "%8.3" ECU_ADDRESS 0x7F8CFC /end MEASUREMENT
/begin MEASUREMENT FrmMng_nTSC "take off engine speed" SWORD EngN 1 100 -32768.00 32767.00 FORMAT "%8.2" ECU_ADDRESS 0x7F8D00 /end MEASUREMENT
/begin MEASUREMENT FrmMng_numACFanDes "fanspeed desired by AC" UBYTE OneToOne 1 100 0.00 255.0 FORMAT "%5.1" ECU_ADDRESS 0x7F8895 /end MEASUREMENT
/begin MEASUREMENT FrmMng_numANFRADMOMPTbyte0_mp "Botschaft ANF_RADMOM_PT byteweise" UBYTE OneToOne 1 100 0.00 255.0 FORMAT "%5.1" ECU_ADDRESS 0x8FF0F1 /end MEASUREMENT
/begin MEASUREMENT FrmMng_numANFRADMOMPTbyte1_mp "Botschaft ANF_RADMOM_PT byteweise" UBYTE OneToOne 1 100 0.00 255.0 FORMAT "%5.1" ECU_ADDRESS 0x8FF0F2 /end MEASUREMENT
/begin MEASUREMENT FrmMng_numANFRADMOMPTbyte2_mp "Botschaft ANF_RADMOM_PT byteweise" UBYTE OneToOne 1 100 0.00 255.0 FORMAT "%5.1" ECU_ADDRESS 0x8FF0F3 /end MEASUREMENT
/begin MEASUREMENT FrmMng_numANFRADMOMPTbyte3_mp "Botschaft ANF_RADMOM_PT byteweise" UBYTE OneToOne 1 100 0.00 255.0 FORMAT "%5.1" ECU_ADDRESS 0x8FF0F4 /end MEASUREMENT
/begin MEASUREMENT FrmMng_numANFRADMOMPTbyte4_mp "Botschaft ANF_RADMOM_PT byteweise" UBYTE OneToOne 1 100 0.00 255.0 FORMAT "%5.1" ECU_ADDRESS 0x8FF0F5 /end MEASUREMENT
/begin MEASUREMENT FrmMng_numAnfrageByte0_mp "" UBYTE OneToOne 1 100 0.00 255.0 FORMAT "%5.1" ECU_ADDRESS 0x8FF0F6 /end MEASUREMENT
/begin MEASUREMENT FrmMng_numAnfrageByte1_mp "" UBYTE OneToOne 1 100 0.00 255.0 FORMAT "%5.1" ECU_ADDRESS 0x8FF0F7 /end MEASUREMENT
/begin MEASUREMENT FrmMng_numAnfrageByte2_mp "" UBYTE OneToOne 1 100 0.00 255.0 FORMAT "%5.1" ECU_ADDRESS 0x8FF0F8 /end MEASUREMENT
/begin MEASUREMENT FrmMng_numBOS_MELDUNG2_OILbyte0_mp "" UBYTE OneToOne 1 100 0.00 255.0 FORMAT "%5.1" ECU_ADDRESS 0x8FF0F9 /end MEASUREMENT
/begin MEASUREMENT FrmMng_numBOS_MELDUNG2_OILbyte1_mp "" UBYTE OneToOne 1 100 0.00 255.0 FORMAT "%5.1" ECU_ADDRESS 0x8FF0FA /end MEASUREMENT
/begin MEASUREMENT FrmMng_numBOS_MELDUNG2_OILbyte2_mp "" UBYTE OneToOne 1 100 0.00 255.0 FORMAT "%5.1" ECU_ADDRESS 0x8FF0FB /end MEASUREMENT
/begin MEASUREMENT FrmMng_numBOS_MELDUNG2_OILbyte3_mp "" UBYTE OneToOne 1 100 0.00 255.0 FORMAT "%5.1" ECU_ADDRESS 0x8FF0FC /end MEASUREMENT
/begin MEASUREMENT FrmMng_numBOS_MELDUNG2_OILbyte4_mp "" UBYTE OneToOne 1 100 0.00 255.0 FORMAT "%5.1" ECU_ADDRESS 0x8FF0FD /end MEASUREMENT
/begin MEASUREMENT FrmMng_numBOS_MELDUNG2_OILbyte5_mp "" UBYTE OneToOne 1 100 0.00 255.0 FORMAT "%5.1" ECU_ADDRESS 0x8FF0FE /end MEASUREMENT
/begin MEASUREMENT FrmMng_numBOS_MELDUNG2_OILbyte6_mp "" UBYTE OneToOne 1 100 0.00 255.0 FORMAT "%5.1" ECU_ADDRESS 0x8FF0FF /end MEASUREMENT
/begin MEASUREMENT FrmMng_numBOS_MELDUNG_OILbyte0_mp "" UBYTE OneToOne 1 100 0.00 255.0 FORMAT "%5.1" ECU_ADDRESS 0x8FF100 /end MEASUREMENT
/begin MEASUREMENT FrmMng_numBOS_MELDUNG_OILbyte1_mp "" UBYTE OneToOne 1 100 0.00 255.0 FORMAT "%5.1" ECU_ADDRESS 0x8FF101 /end MEASUREMENT
/begin MEASUREMENT FrmMng_numBOS_MELDUNG_OILbyte2_mp "" UBYTE OneToOne 1 100 0.00 255.0 FORMAT "%5.1" ECU_ADDRESS 0x8FF102 /end MEASUREMENT
/begin MEASUREMENT FrmMng_numBOS_MELDUNG_OILbyte3_mp "" UBYTE OneToOne 1 100 0.00 255.0 FORMAT "%5.1" ECU_ADDRESS 0x8FF103 /end MEASUREMENT
/begin MEASUREMENT FrmMng_numBOS_MELDUNG_OILbyte4_mp "" UBYTE OneToOne 1 100 0.00 255.0 FORMAT "%5.1" ECU_ADDRESS 0x8FF104 /end MEASUREMENT
/begin MEASUREMENT FrmMng_numBOS_MELDUNG_OILbyte5_mp "" UBYTE OneToOne 1 100 0.00 255.0 FORMAT "%5.1" ECU_ADDRESS 0x8FF105 /end MEASUREMENT
/begin MEASUREMENT FrmMng_numBOS_MELDUNG_OILbyte6_mp "" UBYTE OneToOne 1 100 0.00 255.0 FORMAT "%5.1" ECU_ADDRESS 0x8FF106 /end MEASUREMENT
/begin MEASUREMENT FrmMng_numBOS_MELDUNG_OILbyte7_mp "" UBYTE OneToOne 1 100 0.00 255.0 FORMAT "%5.1" ECU_ADDRESS 0x8FF107 /end MEASUREMENT
/begin MEASUREMENT FrmMng_numBOS_PFLTbyte0_mp "" UBYTE OneToOne 1 100 0.00 255.0 FORMAT "%5.1" ECU_ADDRESS 0x8FF108 /end MEASUREMENT
/begin MEASUREMENT FrmMng_numBOS_PFLTbyte1_mp "" UBYTE OneToOne 1 100 0.00 255.0 FORMAT "%5.1" ECU_ADDRESS 0x8FF109 /end MEASUREMENT
/begin MEASUREMENT FrmMng_numBOS_PFLTbyte2_mp "" UBYTE OneToOne 1 100 0.00 255.0 FORMAT "%5.1" ECU_ADDRESS 0x8FF10A /end MEASUREMENT
/begin MEASUREMENT FrmMng_numBOS_PFLTbyte3_mp "" UBYTE OneToOne 1 100 0.00 255.0 FORMAT "%5.1" ECU_ADDRESS 0x8FF10B /end MEASUREMENT
/begin MEASUREMENT FrmMng_numBOS_PFLTbyte4_mp "" UBYTE OneToOne 1 100 0.00 255.0 FORMAT "%5.1" ECU_ADDRESS 0x8FF10C /end MEASUREMENT
/begin MEASUREMENT FrmMng_numBOS_PFLTbyte5_mp "" UBYTE OneToOne 1 100 0.00 255.0 FORMAT "%5.1" ECU_ADDRESS 0x8FF10D /end MEASUREMENT
/begin MEASUREMENT FrmMng_numBOS_PFLTbyte6_mp "" UBYTE OneToOne 1 100 0.00 255.0 FORMAT "%5.1" ECU_ADDRESS 0x8FF10E /end MEASUREMENT
/begin MEASUREMENT FrmMng_numBOS_PFLTbyte7_mp "" UBYTE OneToOne 1 100 0.00 255.0 FORMAT "%5.1" ECU_ADDRESS 0x8FF10F /end MEASUREMENT
/begin MEASUREMENT FrmMng_numBOS_RESETbyte0_mp "BOS_RESET Byte0" UBYTE OneToOne 1 100 0.00 255.0 FORMAT "%5.1" ECU_ADDRESS 0x8FF110 /end MEASUREMENT
/begin MEASUREMENT FrmMng_numBOS_RESETbyte1_mp "BOS_RESET Byte1" UBYTE OneToOne 1 100 0.00 255.0 FORMAT "%5.1" ECU_ADDRESS 0x8FF111 /end MEASUREMENT
/begin MEASUREMENT FrmMng_numBOS_RESETbyte2_mp "BOS_RESET Byte2" UBYTE OneToOne 1 100 0.00 255.0 FORMAT "%5.1" ECU_ADDRESS 0x8FF112 /end MEASUREMENT
/begin MEASUREMENT FrmMng_numBOS_RESETbyte3_mp "BOS_RESET Byte3" UBYTE OneToOne 1 100 0.00 255.0 FORMAT "%5.1" ECU_ADDRESS 0x8FF113 /end MEASUREMENT
/begin MEASUREMENT FrmMng_numBOS_RESETbyte4_mp "BOS_RESET Byte4" UBYTE OneToOne 1 100 0.00 255.0 FORMAT "%5.1" ECU_ADDRESS 0x8FF114 /end MEASUREMENT
/begin MEASUREMENT FrmMng_numBOS_RESETbyte5_mp "BOS_RESET Byte5" UBYTE OneToOne 1 100 0.00 255.0 FORMAT "%5.1" ECU_ADDRESS 0x8FF115 /end MEASUREMENT
/begin MEASUREMENT FrmMng_numBOS_RESETbyte6_mp "BOS_RESET Byte6" UBYTE OneToOne 1 100 0.00 255.0 FORMAT "%5.1" ECU_ADDRESS 0x8FF116 /end MEASUREMENT
/begin MEASUREMENT FrmMng_numBOS_RESETbyte7_mp "BOS_RESET Byte7" UBYTE OneToOne 1 100 0.00 255.0 FORMAT "%5.1" ECU_ADDRESS 0x8FF117 /end MEASUREMENT
/begin MEASUREMENT FrmMng_numBOS_RESET_2byte0_mp "" UBYTE OneToOne 1 100 0.00 255.0 FORMAT "%5.1" ECU_ADDRESS 0x8FF118 /end MEASUREMENT
/begin MEASUREMENT FrmMng_numBOS_RESET_2byte1_mp "" UBYTE OneToOne 1 100 0.00 255.0 FORMAT "%5.1" ECU_ADDRESS 0x8FF119 /end MEASUREMENT
/begin MEASUREMENT FrmMng_numBOS_RESET_2byte2_mp "" UBYTE OneToOne 1 100 0.00 255.0 FORMAT "%5.1" ECU_ADDRESS 0x8FF11A /end MEASUREMENT
/begin MEASUREMENT FrmMng_numBOS_RESET_2byte3_mp "" UBYTE OneToOne 1 100 0.00 255.0 FORMAT "%5.1" ECU_ADDRESS 0x8FF11B /end MEASUREMENT
/begin MEASUREMENT FrmMng_numBOS_RESET_2byte4_mp "" UBYTE OneToOne 1 100 0.00 255.0 FORMAT "%5.1" ECU_ADDRESS 0x8FF11C /end MEASUREMENT
/begin MEASUREMENT FrmMng_numBOS_RESET_2byte5_mp "" UBYTE OneToOne 1 100 0.00 255.0 FORMAT "%5.1" ECU_ADDRESS 0x8FF11D /end MEASUREMENT
/begin MEASUREMENT FrmMng_numBOS_RESET_2byte6_mp "" UBYTE OneToOne 1 100 0.00 255.0 FORMAT "%5.1" ECU_ADDRESS 0x8FF11E /end MEASUREMENT
/begin MEASUREMENT FrmMng_numCCMsgbyte0_mp "Byte 0 Rohwert in der Can Nachricht  der letzten gesendeten Checkcontrol Meldung" UBYTE OneToOne 1 100 0.00 255.0 FORMAT "%5.1" ECU_ADDRESS 0x8FF11F /end MEASUREMENT
/begin MEASUREMENT FrmMng_numCCMsgbyte1_mp "Byte 1 Rohwert in der Can Nachricht  der letzten gesendeten Checkcontrol Meldung" UBYTE OneToOne 1 100 0.00 255.0 FORMAT "%5.1" ECU_ADDRESS 0x8FF120 /end MEASUREMENT
/begin MEASUREMENT FrmMng_numCCMsgbyte2_mp "Byte 2 Rohwert in der Can Nachricht  der letzten gesendeten Checkcontrol Meldung" UBYTE OneToOne 1 100 0.00 255.0 FORMAT "%5.1" ECU_ADDRESS 0x8FF121 /end MEASUREMENT
/begin MEASUREMENT FrmMng_numCCMsgbyte3_mp "Byte 3 Rohwert in der Can Nachricht  der letzten gesendeten Checkcontrol Meldung" UBYTE OneToOne 1 100 0.00 255.0 FORMAT "%5.1" ECU_ADDRESS 0x8FF122 /end MEASUREMENT
/begin MEASUREMENT FrmMng_numCCMsgbyte4_mp "Byte 4 Rohwert in der Can Nachricht  der letzten gesendeten Checkcontrol Meldung" UBYTE OneToOne 1 100 0.00 255.0 FORMAT "%5.1" ECU_ADDRESS 0x8FF123 /end MEASUREMENT
/begin MEASUREMENT FrmMng_numCCMsgbyte5_mp "Byte 5 Rohwert in der Can Nachricht  der letzten gesendeten Checkcontrol Meldung" UBYTE OneToOne 1 100 0.00 255.0 FORMAT "%5.1" ECU_ADDRESS 0x8FF124 /end MEASUREMENT
/begin MEASUREMENT FrmMng_numCCMsgbyte6_mp "Byte 6 Rohwert in der Can Nachricht  der letzten gesendeten Checkcontrol Meldung" UBYTE OneToOne 1 100 0.00 255.0 FORMAT "%5.1" ECU_ADDRESS 0x8FF125 /end MEASUREMENT
/begin MEASUREMENT FrmMng_numCCMsgbyte7_mp "Byte 7 Rohwert in der Can Nachricht  der letzten gesendeten Checkcontrol Meldung" UBYTE OneToOne 1 100 0.00 255.0 FORMAT "%5.1" ECU_ADDRESS 0x8FF126 /end MEASUREMENT
/begin MEASUREMENT FrmMng_numDMANFAFSbyte0_mp "Byte0 of raw messagebyte of DMANFAFS" UBYTE OneToOne 1 100 0.00 255.0 FORMAT "%5.1" ECU_ADDRESS 0x8FF127 /end MEASUREMENT
/begin MEASUREMENT FrmMng_numDMANFAFSbyte1_mp "Byte1 of raw messagebyte of DMANFAFS" UBYTE OneToOne 1 100 0.00 255.0 FORMAT "%5.1" ECU_ADDRESS 0x8FF128 /end MEASUREMENT
/begin MEASUREMENT FrmMng_numDMANFAFSbyte2_mp "Byte2 of raw messagebyte of DMANFAFS" UBYTE OneToOne 1 100 0.00 255.0 FORMAT "%5.1" ECU_ADDRESS 0x8FF129 /end MEASUREMENT
/begin MEASUREMENT FrmMng_numDMANFAFSbyte3_mp "Byte3 of raw messagebyte of DMANFAFS" UBYTE OneToOne 1 100 0.00 255.0 FORMAT "%5.1" ECU_ADDRESS 0x8FF12A /end MEASUREMENT
/begin MEASUREMENT FrmMng_numDMANFAFSbyte4_mp "Byte4 of raw messagebyte of DMANFAFS" UBYTE OneToOne 1 100 0.00 255.0 FORMAT "%5.1" ECU_ADDRESS 0x8FF12B /end MEASUREMENT
/begin MEASUREMENT FrmMng_numDMANFAFSbyte5_mp "Byte5 of raw messagebyte of DMANFAFS" UBYTE OneToOne 1 100 0.00 255.0 FORMAT "%5.1" ECU_ADDRESS 0x8FF12C /end MEASUREMENT
/begin MEASUREMENT FrmMng_numDM_ANF_ACCbyte0_mp "Byte0 of raw messagebyte of DREHMOMENT_ANF_ACC" UBYTE OneToOne 1 100 0.00 255.0 FORMAT "%5.1" ECU_ADDRESS 0x8FF12D /end MEASUREMENT
/begin MEASUREMENT FrmMng_numDM_ANF_ACCbyte1_mp "Byte1 of raw messagebyte of DREHMOMENT_ANF_ACC" UBYTE OneToOne 1 100 0.00 255.0 FORMAT "%5.1" ECU_ADDRESS 0x8FF12E /end MEASUREMENT
/begin MEASUREMENT FrmMng_numDM_ANF_ACCbyte2_mp "Byte2 of raw messagebyte of DREHMOMENT_ANF_ACC" UBYTE OneToOne 1 100 0.00 255.0 FORMAT "%5.1" ECU_ADDRESS 0x8FF12F /end MEASUREMENT
/begin MEASUREMENT FrmMng_numDM_ANF_ACCbyte3_mp "Byte3 of raw messagebyte of DREHMOMENT_ANF_ACC" UBYTE OneToOne 1 100 0.00 255.0 FORMAT "%5.1" ECU_ADDRESS 0x8FF130 /end MEASUREMENT
/begin MEASUREMENT FrmMng_numDM_ANF_ACCbyte4_mp "Byte4 of raw messagebyte of DREHMOMENT_ANF_ACC" UBYTE OneToOne 1 100 0.00 255.0 FORMAT "%5.1" ECU_ADDRESS 0x8FF131 /end MEASUREMENT
/begin MEASUREMENT FrmMng_numDM_ANF_ACCbyte5_mp "Byte5 of raw messagebyte of DREHMOMENT_ANF_ACC" UBYTE OneToOne 1 100 0.00 255.0 FORMAT "%5.1" ECU_ADDRESS 0x8FF132 /end MEASUREMENT
/begin MEASUREMENT FrmMng_numDM_ANF_ACCbyte6_mp "Byte6 of raw messagebyte of DREHMOMENT_ANF_ACC" UBYTE OneToOne 1 100 0.00 255.0 FORMAT "%5.1" ECU_ADDRESS 0x8FF133 /end MEASUREMENT
/begin MEASUREMENT FrmMng_numDM_ANF_ACCbyte7_mp "Byte7 of raw messagebyte of DREHMOMENT_ANF_ACC" UBYTE OneToOne 1 100 0.00 255.0 FORMAT "%5.1" ECU_ADDRESS 0x8FF134 /end MEASUREMENT
/begin MEASUREMENT FrmMng_numDRMANFSSGbyte0_mp "Byte0 of raw messagebyte of DRMANFSSG" UBYTE OneToOne 1 100 0.00 255.0 FORMAT "%5.1" ECU_ADDRESS 0x8FF135 /end MEASUREMENT
/begin MEASUREMENT FrmMng_numDRMANFSSGbyte1_mp "Byte1 of raw messagebyte of DRMANFSSG" UBYTE OneToOne 1 100 0.00 255.0 FORMAT "%5.1" ECU_ADDRESS 0x8FF136 /end MEASUREMENT
/begin MEASUREMENT FrmMng_numDRMANFSSGbyte2_mp "Byte2 of raw messagebyte of DRMANFSSG" UBYTE OneToOne 1 100 0.00 255.0 FORMAT "%5.1" ECU_ADDRESS 0x8FF137 /end MEASUREMENT
/begin MEASUREMENT FrmMng_numDRMANFSSGbyte3_mp "Byte3 of raw messagebyte of DRMANFSSG" UBYTE OneToOne 1 100 0.00 255.0 FORMAT "%5.1" ECU_ADDRESS 0x8FF138 /end MEASUREMENT
/begin MEASUREMENT FrmMng_numDRMANFSSGbyte4_mp "Byte4 of raw messagebyte of DRMANFSSG" UBYTE OneToOne 1 100 0.00 255.0 FORMAT "%5.1" ECU_ADDRESS 0x8FF139 /end MEASUREMENT
/begin MEASUREMENT FrmMng_numDRMANFSSGbyte5_mp "Byte5 of raw messagebyte of DRMANFSSG" UBYTE OneToOne 1 100 0.00 255.0 FORMAT "%5.1" ECU_ADDRESS 0x8FF13A /end MEASUREMENT
/begin MEASUREMENT FrmMng_numDRMANFSSGbyte6_mp "Byte6 of raw messagebyte of DRMANFSSG" UBYTE OneToOne 1 100 0.00 255.0 FORMAT "%5.1" ECU_ADDRESS 0x8FF13B /end MEASUREMENT
/begin MEASUREMENT FrmMng_numDRMANFSSGbyte7_mp "Byte7 of raw messagebyte of DRMANFSSG" UBYTE OneToOne 1 100 0.00 255.0 FORMAT "%5.1" ECU_ADDRESS 0x8FF13C /end MEASUREMENT
/begin MEASUREMENT FrmMng_numELKTR_M_OEL_MESSbyte0_mp "" UBYTE OneToOne 1 100 0.00 255.0 FORMAT "%5.1" ECU_ADDRESS 0x8FF13D /end MEASUREMENT
/begin MEASUREMENT FrmMng_numELKTR_M_OEL_MESSbyte1_mp "" UBYTE OneToOne 1 100 0.00 255.0 FORMAT "%5.1" ECU_ADDRESS 0x8FF13E /end MEASUREMENT
/begin MEASUREMENT FrmMng_numENGINE1byte0_mp "Byte_0 Rohwerte in CAN-Botschaft ENGINE1" UBYTE OneToOne 1 100 0.00 255.0 FORMAT "%5.1" ECU_ADDRESS 0x8FF13F /end MEASUREMENT
/begin MEASUREMENT FrmMng_numENGINE1byte1_mp "Byte_1 Rohwerte in CAN-Botschaft ENGINE1" UBYTE OneToOne 1 100 0.00 255.0 FORMAT "%5.1" ECU_ADDRESS 0x8FF140 /end MEASUREMENT
/begin MEASUREMENT FrmMng_numENGINE1byte2_mp "Byte_2 Rohwerte in CAN-Botschaft ENGINE1" UBYTE OneToOne 1 100 0.00 255.0 FORMAT "%5.1" ECU_ADDRESS 0x8FF141 /end MEASUREMENT
/begin MEASUREMENT FrmMng_numENGINE1byte3_mp "Byte_3 Rohwerte in CAN-Botschaft ENGINE1" UBYTE OneToOne 1 100 0.00 255.0 FORMAT "%5.1" ECU_ADDRESS 0x8FF142 /end MEASUREMENT
/begin MEASUREMENT FrmMng_numENGINE1byte4_mp "Byte_4 Rohwerte in CAN-Botschaft ENGINE1" UBYTE OneToOne 1 100 0.00 255.0 FORMAT "%5.1" ECU_ADDRESS 0x8FF143 /end MEASUREMENT
/begin MEASUREMENT FrmMng_numENGINE1byte5_mp "Byte_5 Rohwerte in CAN-Botschaft ENGINE1" UBYTE OneToOne 1 100 0.00 255.0 FORMAT "%5.1" ECU_ADDRESS 0x8FF144 /end MEASUREMENT
/begin MEASUREMENT FrmMng_numENGINE1byte6_mp "Byte_6 Rohwerte in CAN-Botschaft ENGINE1" UBYTE OneToOne 1 100 0.00 255.0 FORMAT "%5.1" ECU_ADDRESS 0x8FF145 /end MEASUREMENT
/begin MEASUREMENT FrmMng_numENGINE1byte7_mp "Byte_7 Rohwerte in CAN-Botschaft ENGINE1" UBYTE OneToOne 1 100 0.00 255.0 FORMAT "%5.1" ECU_ADDRESS 0x8FF146 /end MEASUREMENT
/begin MEASUREMENT FrmMng_numEngRpmbyte0_mp "Rohwerte von der CAN-Botschaft ENGINE_RPM - Byte0" UBYTE OneToOne 1 100 0.00 255.0 FORMAT "%5.1" ECU_ADDRESS 0x8FF147 /end MEASUREMENT
/begin MEASUREMENT FrmMng_numEngRpmbyte1_mp "Rohwerte von der CAN-Botschaft ENGINE_RPM - Byte1" UBYTE OneToOne 1 100 0.00 255.0 FORMAT "%5.1" ECU_ADDRESS 0x8FF148 /end MEASUREMENT
/begin MEASUREMENT FrmMng_numGEARBX_DATA2byte0_mp "GEARBX_DATA2 Byte0" UBYTE OneToOne 1 100 0.00 255.0 FORMAT "%5.1" ECU_ADDRESS 0x8FF149 /end MEASUREMENT
/begin MEASUREMENT FrmMng_numGEARBX_DATA2byte1_mp "GEARBX_DATA2 Byte1" UBYTE OneToOne 1 100 0.00 255.0 FORMAT "%5.1" ECU_ADDRESS 0x8FF14A /end MEASUREMENT
/begin MEASUREMENT FrmMng_numGEARBX_DATAbyte0_mp "Byte_x raw data in CAN-message" UBYTE OneToOne 1 100 0.00 255.0 FORMAT "%5.1" ECU_ADDRESS 0x8FF14B /end MEASUREMENT
/begin MEASUREMENT FrmMng_numGEARBX_DATAbyte1_mp "Byte_x raw data in CAN-message" UBYTE OneToOne 1 100 0.00 255.0 FORMAT "%5.1" ECU_ADDRESS 0x8FF14C /end MEASUREMENT
/begin MEASUREMENT FrmMng_numGEARBX_DATAbyte2_mp "Byte_x raw data in CAN-message" UBYTE OneToOne 1 100 0.00 255.0 FORMAT "%5.1" ECU_ADDRESS 0x8FF14D /end MEASUREMENT
/begin MEASUREMENT FrmMng_numGEARBX_DATAbyte3_mp "Byte_x raw data in CAN-message" UBYTE OneToOne 1 100 0.00 255.0 FORMAT "%5.1" ECU_ADDRESS 0x8FF14E /end MEASUREMENT
/begin MEASUREMENT FrmMng_numGEARBX_DATAbyte4_mp "Byte_x raw data in CAN-message" UBYTE OneToOne 1 100 0.00 255.0 FORMAT "%5.1" ECU_ADDRESS 0x8FF14F /end MEASUREMENT
/begin MEASUREMENT FrmMng_numGEARBX_DATAbyte5_mp "Byte_x raw data in CAN-message" UBYTE OneToOne 1 100 0.00 255.0 FORMAT "%5.1" ECU_ADDRESS 0x8FF150 /end MEASUREMENT
/begin MEASUREMENT FrmMng_numGEARBX_DATAbyte6_mp "Byte_x raw data in CAN-message" UBYTE OneToOne 1 100 0.00 255.0 FORMAT "%5.1" ECU_ADDRESS 0x8FF151 /end MEASUREMENT
/begin MEASUREMENT FrmMng_numGEARBX_DATAbyte7_mp "Byte_x raw data in CAN-message" UBYTE OneToOne 1 100 0.00 255.0 FORMAT "%5.1" ECU_ADDRESS 0x8FF152 /end MEASUREMENT
/begin MEASUREMENT FrmMng_numHEATCURbyte0_mp "HEATING_CURRENT Byte0" UBYTE OneToOne 1 100 0.00 255.0 FORMAT "%5.1" ECU_ADDRESS 0x8FF153 /end MEASUREMENT
/begin MEASUREMENT FrmMng_numHEATCURbyte1_mp "HEATING_CURRENT Byte1" UBYTE OneToOne 1 100 0.00 255.0 FORMAT "%5.1" ECU_ADDRESS 0x8FF154 /end MEASUREMENT
/begin MEASUREMENT FrmMng_numHEATCURbyte2_mp "HEATING_CURRENT Byte2" UBYTE OneToOne 1 100 0.00 255.0 FORMAT "%5.1" ECU_ADDRESS 0x8FF155 /end MEASUREMENT
/begin MEASUREMENT FrmMng_numHEATCURbyte3_mp "HEATING_CURRENT Byte3" UBYTE OneToOne 1 100 0.00 255.0 FORMAT "%5.1" ECU_ADDRESS 0x8FF156 /end MEASUREMENT
/begin MEASUREMENT FrmMng_numHEATCURbyte4_mp "HEATING_CURRENT Byte3" UBYTE OneToOne 1 100 0.00 255.0 FORMAT "%5.1" ECU_ADDRESS 0x8FF157 /end MEASUREMENT
/begin MEASUREMENT FrmMng_numHEATCURbyte5_mp "HEATING_CURRENT Byte5" UBYTE OneToOne 1 100 0.00 255.0 FORMAT "%5.1" ECU_ADDRESS 0x8FF158 /end MEASUREMENT
/begin MEASUREMENT FrmMng_numHEATCURbyte6_mp "HEATING_CURRENT Byte6" UBYTE OneToOne 1 100 0.00 255.0 FORMAT "%5.1" ECU_ADDRESS 0x8FF159 /end MEASUREMENT
/begin MEASUREMENT FrmMng_numHEAT_ACbyte0_mp "Byte_x raw data in CAN-message" UBYTE OneToOne 1 100 0.00 255.0 FORMAT "%5.1" ECU_ADDRESS 0x8FF15A /end MEASUREMENT
/begin MEASUREMENT FrmMng_numHEAT_ACbyte1_mp "Byte_x raw data in CAN-message" UBYTE OneToOne 1 100 0.00 255.0 FORMAT "%5.1" ECU_ADDRESS 0x8FF15B /end MEASUREMENT
/begin MEASUREMENT FrmMng_numHEAT_ACbyte2_mp "Byte_x raw data in CAN-message" UBYTE OneToOne 1 100 0.00 255.0 FORMAT "%5.1" ECU_ADDRESS 0x8FF15C /end MEASUREMENT
/begin MEASUREMENT FrmMng_numHEAT_ACbyte3_mp "Byte_x raw data in CAN-message" UBYTE OneToOne 1 100 0.00 255.0 FORMAT "%5.1" ECU_ADDRESS 0x8FF15D /end MEASUREMENT
/begin MEASUREMENT FrmMng_numHEAT_ACbyte4_mp "Byte_x raw data in CAN-message" UBYTE OneToOne 1 100 0.00 255.0 FORMAT "%5.1" ECU_ADDRESS 0x8FF15E /end MEASUREMENT
/begin MEASUREMENT FrmMng_numLRADWINKbyte0_mp "Byte0 of raw messagebyte of LRADWINK" UBYTE OneToOne 1 100 0.00 255.0 FORMAT "%5.1" ECU_ADDRESS 0x8FF15F /end MEASUREMENT
/begin MEASUREMENT FrmMng_numLRADWINKbyte1_mp "Byte1 of raw messagebyte of LRADWINK" UBYTE OneToOne 1 100 0.00 255.0 FORMAT "%5.1" ECU_ADDRESS 0x8FF160 /end MEASUREMENT
/begin MEASUREMENT FrmMng_numLRADWINKbyte2_mp "Byte2 of raw messagebyte of LRADWINK" UBYTE OneToOne 1 100 0.00 255.0 FORMAT "%5.1" ECU_ADDRESS 0x8FF161 /end MEASUREMENT
/begin MEASUREMENT FrmMng_numLRADWINKbyte3_mp "Byte3 of raw messagebyte of LRADWINK" UBYTE OneToOne 1 100 0.00 255.0 FORMAT "%5.1" ECU_ADDRESS 0x8FF162 /end MEASUREMENT
/begin MEASUREMENT FrmMng_numLRADWINKbyte4_mp "Byte4 of raw messagebyte of LRADWINK" UBYTE OneToOne 1 100 0.00 255.0 FORMAT "%5.1" ECU_ADDRESS 0x8FF163 /end MEASUREMENT
/begin MEASUREMENT FrmMng_numLRADWINKbyte5_mp "Byte5 of raw messagebyte of LRADWINK" UBYTE OneToOne 1 100 0.00 255.0 FORMAT "%5.1" ECU_ADDRESS 0x8FF164 /end MEASUREMENT
/begin MEASUREMENT FrmMng_numLRADWINKbyte6_mp "Byte6 of raw messagebyte of LRADWINK" UBYTE OneToOne 1 100 0.00 255.0 FORMAT "%5.1" ECU_ADDRESS 0x8FF165 /end MEASUREMENT
/begin MEASUREMENT FrmMng_numMILEAGE_RANGEbyte0_mp "MILEAGE_RANGE Byte0" UBYTE OneToOne 1 100 0.00 255.0 FORMAT "%5.1" ECU_ADDRESS 0x8FF166 /end MEASUREMENT
/begin MEASUREMENT FrmMng_numMILEAGE_RANGEbyte1_mp "MILEAGE_RANGE Byte1" UBYTE OneToOne 1 100 0.00 255.0 FORMAT "%5.1" ECU_ADDRESS 0x8FF167 /end MEASUREMENT
/begin MEASUREMENT FrmMng_numMILEAGE_RANGEbyte2_mp "MILEAGE_RANGE Byte2" UBYTE OneToOne 1 100 0.00 255.0 FORMAT "%5.1" ECU_ADDRESS 0x8FF168 /end MEASUREMENT
/begin MEASUREMENT FrmMng_numMILEAGE_RANGEbyte3_mp "MILEAGE_RANGE Byte3" UBYTE OneToOne 1 100 0.00 255.0 FORMAT "%5.1" ECU_ADDRESS 0x8FF169 /end MEASUREMENT
/begin MEASUREMENT FrmMng_numMILEAGE_RANGEbyte4_mp "MILEAGE_RANGE Byte4" UBYTE OneToOne 1 100 0.00 255.0 FORMAT "%5.1" ECU_ADDRESS 0x8FF16A /end MEASUREMENT
/begin MEASUREMENT FrmMng_numMILEAGE_RANGEbyte5_mp "MILEAGE_RANGE Byte5" UBYTE OneToOne 1 100 0.00 255.0 FORMAT "%5.1" ECU_ADDRESS 0x8FF16B /end MEASUREMENT
/begin MEASUREMENT FrmMng_numMILEAGE_RANGEbyte6_mp "MILEAGE_RANGE Byte6" UBYTE OneToOne 1 100 0.00 255.0 FORMAT "%5.1" ECU_ADDRESS 0x8FF16C /end MEASUREMENT
/begin MEASUREMENT FrmMng_numMILEAGE_RANGEbyte7_mp "MILEAGE_RANGE Byte7" UBYTE OneToOne 1 100 0.00 255.0 FORMAT "%5.1" ECU_ADDRESS 0x8FF16D /end MEASUREMENT
/begin MEASUREMENT FrmMng_numMsgACC_mp "counter for self recognition of ACC" UBYTE OneToOne 1 100 0.00 255.0 FORMAT "%5.1" ECU_ADDRESS 0x8FF16E /end MEASUREMENT
/begin MEASUREMENT FrmMng_numMsgAC_mp "" UBYTE OneToOne 1 100 0.00 255.0 FORMAT "%5.1" ECU_ADDRESS 0x8FF16F /end MEASUREMENT
/begin MEASUREMENT FrmMng_numMsgAFS_mp "Counter for self recognition of AFS" UBYTE OneToOne 1 100 0.00 255.0 FORMAT "%5.1" ECU_ADDRESS 0x8FF170 /end MEASUREMENT
/begin MEASUREMENT FrmMng_numMsgARS_mp "Counter for ARS recognition" UBYTE OneToOne 1 100 0.00 255.0 FORMAT "%5.1" ECU_ADDRESS 0x8FF171 /end MEASUREMENT
/begin MEASUREMENT FrmMng_numMsgDCC_mp "Anzahl Botschaften für Erkennung Empfang DCC-Botschaft" UBYTE OneToOne 1 100 0.00 255.0 FORMAT "%5.1" ECU_ADDRESS 0x8FF172 /end MEASUREMENT
/begin MEASUREMENT FrmMng_numMsgFGR_mp "Counter for self recognition of FGR" UBYTE OneToOne 1 100 0.00 255.0 FORMAT "%5.1" ECU_ADDRESS 0x8FF173 /end MEASUREMENT
/begin MEASUREMENT FrmMng_numOPCRCTLACCbyte0_mp "OP_CRCTLACC Byte0" UBYTE OneToOne 1 100 0.00 255.0 FORMAT "%5.1" ECU_ADDRESS 0x8FF174 /end MEASUREMENT
/begin MEASUREMENT FrmMng_numOPCRCTLACCbyte1_mp "OP_CRCTLACC Byte1" UBYTE OneToOne 1 100 0.00 255.0 FORMAT "%5.1" ECU_ADDRESS 0x8FF175 /end MEASUREMENT
/begin MEASUREMENT FrmMng_numOPCRCTLACCbyte2_mp "OP_CRCTLACC Byte2" UBYTE OneToOne 1 100 0.00 255.0 FORMAT "%5.1" ECU_ADDRESS 0x8FF176 /end MEASUREMENT
/begin MEASUREMENT FrmMng_numOPCRCTLACCbyte3_mp "OP_CRCTLACC Byte3" UBYTE OneToOne 1 100 0.00 255.0 FORMAT "%5.1" ECU_ADDRESS 0x8FF177 /end MEASUREMENT
/begin MEASUREMENT FrmMng_numParkConsumerByte0_mp "ParkConsumer Byte0" UBYTE OneToOne 1 100 0.00 255.0 FORMAT "%5.1" ECU_ADDRESS 0x8FF178 /end MEASUREMENT
/begin MEASUREMENT FrmMng_numParkConsumerByte1_mp "ParkConsumer Byte1" UBYTE OneToOne 1 100 0.00 255.0 FORMAT "%5.1" ECU_ADDRESS 0x8FF179 /end MEASUREMENT
/begin MEASUREMENT FrmMng_numParkConsumerByte2_mp "ParkConsumer Byte2" UBYTE OneToOne 1 100 0.00 255.0 FORMAT "%5.1" ECU_ADDRESS 0x8FF17A /end MEASUREMENT
/begin MEASUREMENT FrmMng_numParkConsumerByte3_mp "ParkConsumer Byte3" UBYTE OneToOne 1 100 0.00 255.0 FORMAT "%5.1" ECU_ADDRESS 0x8FF17B /end MEASUREMENT
/begin MEASUREMENT FrmMng_numPMCTRCOSbyte0_mp "POWERMGMT_CTR_COS Byte0" UBYTE OneToOne 1 100 0.00 255.0 FORMAT "%5.1" ECU_ADDRESS 0x8FF17C /end MEASUREMENT
/begin MEASUREMENT FrmMng_numPMCTRCOSbyte1_mp "POWERMGMT_CTR_COS Byte1" UBYTE OneToOne 1 100 0.00 255.0 FORMAT "%5.1" ECU_ADDRESS 0x8FF17D /end MEASUREMENT
/begin MEASUREMENT FrmMng_numPMCTRCOSbyte2_mp "POWERMGMT_CTR_COS Byte2" UBYTE OneToOne 1 100 0.00 255.0 FORMAT "%5.1" ECU_ADDRESS 0x8FF17E /end MEASUREMENT
/begin MEASUREMENT FrmMng_numPMCTRCOSbyte3_mp "POWERMGMT_CTR_COS Byte3" UBYTE OneToOne 1 100 0.00 255.0 FORMAT "%5.1" ECU_ADDRESS 0x8FF17F /end MEASUREMENT
/begin MEASUREMENT FrmMng_numPMCTRCOSbyte4_mp "POWERMGMT_CTR_COS Byte4" UBYTE OneToOne 1 100 0.00 255.0 FORMAT "%5.1" ECU_ADDRESS 0x8FF180 /end MEASUREMENT
/begin MEASUREMENT FrmMng_numPMCTRCOSbyte5_mp "POWERMGMT_CTR_COS Byte5" UBYTE OneToOne 1 100 0.00 255.0 FORMAT "%5.1" ECU_ADDRESS 0x8FF181 /end MEASUREMENT
/begin MEASUREMENT FrmMng_numPMUBattbyte0_mp "POWERMGNT_BATTERIESPANNUNG Byte0" UBYTE OneToOne 1 100 0.00 255.0 FORMAT "%5.1" ECU_ADDRESS 0x8FF182 /end MEASUREMENT
/begin MEASUREMENT FrmMng_numPMUBattbyte1_mp "POWERMGNT_BATTERIESPANNUNG Byte1" UBYTE OneToOne 1 100 0.00 255.0 FORMAT "%5.1" ECU_ADDRESS 0x8FF183 /end MEASUREMENT
/begin MEASUREMENT FrmMng_numPMUBattbyte2_mp "POWERMGNT_BATTERIESPANNUNG Byte2" UBYTE OneToOne 1 100 0.00 255.0 FORMAT "%5.1" ECU_ADDRESS 0x8FF184 /end MEASUREMENT
/begin MEASUREMENT FrmMng_numPMUBattbyte3_mp "POWERMGNT_BATTERIESPANNUNG Byte3" UBYTE OneToOne 1 100 0.00 255.0 FORMAT "%5.1" ECU_ADDRESS 0x8FF185 /end MEASUREMENT
/begin MEASUREMENT FrmMng_numPMUBattbyte4_mp "POWERMGNT_BATTERIESPANNUNG Byte4" UBYTE OneToOne 1 100 0.00 255.0 FORMAT "%5.1" ECU_ADDRESS 0x8FF186 /end MEASUREMENT
/begin MEASUREMENT FrmMng_numPMUBattbyte5_mp "POWERMGNT_BATTERIESPANNUNG Byte5" UBYTE OneToOne 1 100 0.00 255.0 FORMAT "%5.1" ECU_ADDRESS 0x8FF187 /end MEASUREMENT
/begin MEASUREMENT FrmMng_numPMUBattbyte6_mp "POWERMGNT_BATTERIESPANNUNG Byte6" UBYTE OneToOne 1 100 0.00 255.0 FORMAT "%5.1" ECU_ADDRESS 0x8FF188 /end MEASUREMENT
/begin MEASUREMENT FrmMng_numPMUBattbyte7_mp "POWERMGNT_BATTERIESPANNUNG Byte7" UBYTE OneToOne 1 100 0.00 255.0 FORMAT "%5.1" ECU_ADDRESS 0x8FF189 /end MEASUREMENT
/begin MEASUREMENT FrmMng_numPRGG_CCTRbyte0_mp "Byte0 of raw messagebyte of PRGG_CCTR" UBYTE OneToOne 1 100 0.00 255.0 FORMAT "%5.1" ECU_ADDRESS 0x8FF18A /end MEASUREMENT
/begin MEASUREMENT FrmMng_numPRGG_CCTRbyte1_mp "Byte1 of raw messagebyte of PRGG_CCTR" UBYTE OneToOne 1 100 0.00 255.0 FORMAT "%5.1" ECU_ADDRESS 0x8FF18B /end MEASUREMENT
/begin MEASUREMENT FrmMng_numPRGG_CCTRbyte2_mp "Byte2 of raw messagebyte of PRGG_CCTR" UBYTE OneToOne 1 100 0.00 255.0 FORMAT "%5.1" ECU_ADDRESS 0x8FF18C /end MEASUREMENT
/begin MEASUREMENT FrmMng_numPRGG_CCTRbyte3_mp "Byte3 of raw messagebyte of PRGG_CCTR" UBYTE OneToOne 1 100 0.00 255.0 FORMAT "%5.1" ECU_ADDRESS 0x8FF18D /end MEASUREMENT
/begin MEASUREMENT FrmMng_numPRGG_CCTRbyte4_mp "Byte4 of raw messagebyte of PRGG_CCTR" UBYTE OneToOne 1 100 0.00 255.0 FORMAT "%5.1" ECU_ADDRESS 0x8FF18E /end MEASUREMENT
/begin MEASUREMENT FrmMng_numPWRMNG_LOADVbyte0_mp "" UBYTE OneToOne 1 100 0.00 255.0 FORMAT "%5.1" ECU_ADDRESS 0x8FF18F /end MEASUREMENT
/begin MEASUREMENT FrmMng_numPWRMNG_LOADVbyte1_mp "" UBYTE OneToOne 1 100 0.00 255.0 FORMAT "%5.1" ECU_ADDRESS 0x8FF190 /end MEASUREMENT
/begin MEASUREMENT FrmMng_numPWRMNG_LOADVbyte2_mp "" UBYTE OneToOne 1 100 0.00 255.0 FORMAT "%5.1" ECU_ADDRESS 0x8FF191 /end MEASUREMENT
/begin MEASUREMENT FrmMng_numPWRMNG_LOADVbyte3_mp "" UBYTE OneToOne 1 100 0.00 255.0 FORMAT "%5.1" ECU_ADDRESS 0x8FF192 /end MEASUREMENT
/begin MEASUREMENT FrmMng_numPWRMNG_LOADVbyte4_mp "" UBYTE OneToOne 1 100 0.00 255.0 FORMAT "%5.1" ECU_ADDRESS 0x8FF193 /end MEASUREMENT
/begin MEASUREMENT FrmMng_numPWRMNG_LOADVbyte5_mp "" UBYTE OneToOne 1 100 0.00 255.0 FORMAT "%5.1" ECU_ADDRESS 0x8FF194 /end MEASUREMENT
/begin MEASUREMENT FrmMng_numPWRMNG_LOADVbyte6_mp "" UBYTE OneToOne 1 100 0.00 255.0 FORMAT "%5.1" ECU_ADDRESS 0x8FF195 /end MEASUREMENT
/begin MEASUREMENT FrmMng_numPWRMNG_LOADVbyte7_mp "" UBYTE OneToOne 1 100 0.00 255.0 FORMAT "%5.1" ECU_ADDRESS 0x8FF196 /end MEASUREMENT
/begin MEASUREMENT FrmMng_numRADMOMPT1byte0_mp "Botschaft RADMOM_PT_1 byteweise" UBYTE OneToOne 1 100 0.00 255.0 FORMAT "%5.1" ECU_ADDRESS 0x8FF197 /end MEASUREMENT
/begin MEASUREMENT FrmMng_numRADMOMPT1byte1_mp "Botschaft RADMOM_PT_1 byteweise" UBYTE OneToOne 1 100 0.00 255.0 FORMAT "%5.1" ECU_ADDRESS 0x8FF198 /end MEASUREMENT
/begin MEASUREMENT FrmMng_numRADMOMPT1byte2_mp "Botschaft RADMOM_PT_1 byteweise" UBYTE OneToOne 1 100 0.00 255.0 FORMAT "%5.1" ECU_ADDRESS 0x8FF199 /end MEASUREMENT
/begin MEASUREMENT FrmMng_numRADMOMPT1byte3_mp "Botschaft RADMOM_PT_1 byteweise" UBYTE OneToOne 1 100 0.00 255.0 FORMAT "%5.1" ECU_ADDRESS 0x8FF19A /end MEASUREMENT
/begin MEASUREMENT FrmMng_numRADMOMPT1byte4_mp "Botschaft RADMOM_PT_1 byteweise" UBYTE OneToOne 1 100 0.00 255.0 FORMAT "%5.1" ECU_ADDRESS 0x8FF19B /end MEASUREMENT
/begin MEASUREMENT FrmMng_numRADMOMPT1byte5_mp "Botschaft RADMOM_PT_1 byteweise" UBYTE OneToOne 1 100 0.00 255.0 FORMAT "%5.1" ECU_ADDRESS 0x8FF19C /end MEASUREMENT
/begin MEASUREMENT FrmMng_numRADMOMPT1byte6_mp "Botschaft RADMOM_PT_1 byteweise" UBYTE OneToOne 1 100 0.00 255.0 FORMAT "%5.1" ECU_ADDRESS 0x8FF19D /end MEASUREMENT
/begin MEASUREMENT FrmMng_numRADMOMPT1byte7_mp "Botschaft RADMOM_PT_1 byteweise" UBYTE OneToOne 1 100 0.00 255.0 FORMAT "%5.1" ECU_ADDRESS 0x8FF19E /end MEASUREMENT
/begin MEASUREMENT FrmMng_numRADMOMPT2byte0_mp "Botschaft RADMOM_PT_2 byteweise" UBYTE OneToOne 1 100 0.00 255.0 FORMAT "%5.1" ECU_ADDRESS 0x8FF19F /end MEASUREMENT
/begin MEASUREMENT FrmMng_numRADMOMPT2byte1_mp "Botschaft RADMOM_PT_2 byteweise" UBYTE OneToOne 1 100 0.00 255.0 FORMAT "%5.1" ECU_ADDRESS 0x8FF1A0 /end MEASUREMENT
/begin MEASUREMENT FrmMng_numRADMOMPT2byte2_mp "Botschaft RADMOM_PT_2 byteweise" UBYTE OneToOne 1 100 0.00 255.0 FORMAT "%5.1" ECU_ADDRESS 0x8FF1A1 /end MEASUREMENT
/begin MEASUREMENT FrmMng_numRADMOMPT2byte3_mp "Botschaft RADMOM_PT_2 byteweise" UBYTE OneToOne 1 100 0.00 255.0 FORMAT "%5.1" ECU_ADDRESS 0x8FF1A2 /end MEASUREMENT
/begin MEASUREMENT FrmMng_numRADMOMPT2byte4_mp "Botschaft RADMOM_PT_2 byteweise" UBYTE OneToOne 1 100 0.00 255.0 FORMAT "%5.1" ECU_ADDRESS 0x8FF1A3 /end MEASUREMENT
/begin MEASUREMENT FrmMng_numRADMOMPT2byte5_mp "Botschaft RADMOM_PT_2 byteweise" UBYTE OneToOne 1 100 0.00 255.0 FORMAT "%5.1" ECU_ADDRESS 0x8FF1A4 /end MEASUREMENT
/begin MEASUREMENT FrmMng_numRADMOMPT2byte6_mp "Botschaft RADMOM_PT_2 byteweise" UBYTE OneToOne 1 100 0.00 255.0 FORMAT "%5.1" ECU_ADDRESS 0x8FF1A5 /end MEASUREMENT
/begin MEASUREMENT FrmMng_numRADMOMPT2byte7_mp "Botschaft RADMOM_PT_2 byteweise" UBYTE OneToOne 1 100 0.00 255.0 FORMAT "%5.1" ECU_ADDRESS 0x8FF1A6 /end MEASUREMENT
/begin MEASUREMENT FrmMng_numRPM_STAByte0_mp "" UBYTE OneToOne 1 100 0.00 255.0 FORMAT "%5.1" ECU_ADDRESS 0x8FF1A7 /end MEASUREMENT
/begin MEASUREMENT FrmMng_numRPM_STAByte1_mp "" UBYTE OneToOne 1 100 0.00 255.0 FORMAT "%5.1" ECU_ADDRESS 0x8FF1A8 /end MEASUREMENT
/begin MEASUREMENT FrmMng_numRqStgEFan "Mit Diesem Signal können Steuergeräte eine E-Lüfterstufe anfordern" UBYTE OneToOne 1 100 0.00 255.0 FORMAT "%5.1" ECU_ADDRESS 0x7F8896 /end MEASUREMENT
/begin MEASUREMENT FrmMng_numRQ_STG_EFANbyte0_mp "RQ_STG_EFAN Raw wert byte 0" UBYTE OneToOne 1 100 0.00 255.0 FORMAT "%5.1" ECU_ADDRESS 0x8FF1A9 /end MEASUREMENT
/begin MEASUREMENT FrmMng_numRQ_STG_EFANbyte1_mp "RQ_STG_EFAN Raw wert byte 1" UBYTE OneToOne 1 100 0.00 255.0 FORMAT "%5.1" ECU_ADDRESS 0x8FF1AA /end MEASUREMENT
/begin MEASUREMENT FrmMng_numRQ_STG_EFANbyte2_mp "RQ_STG_EFAN Raw wert byte 2" UBYTE OneToOne 1 100 0.00 255.0 FORMAT "%5.1" ECU_ADDRESS 0x8FF1AB /end MEASUREMENT
/begin MEASUREMENT FrmMng_numSITZGURTbyte0_mp "STAT_SITZBELEGUNG_GURT rohes messagebyte 0" UBYTE OneToOne 1 100 0.00 255.0 FORMAT "%5.1" ECU_ADDRESS 0x8FF1AC /end MEASUREMENT
/begin MEASUREMENT FrmMng_numSITZGURTbyte1_mp "STAT_SITZBELEGUNG_GURT  rohes messagebyte 1" UBYTE OneToOne 1 100 0.00 255.0 FORMAT "%5.1" ECU_ADDRESS 0x8FF1AD /end MEASUREMENT
/begin MEASUREMENT FrmMng_numSITZGURTbyte2_mp "STAT_SITZBELEGUNG_GURT  rohes messagebyte 2" UBYTE OneToOne 1 100 0.00 255.0 FORMAT "%5.1" ECU_ADDRESS 0x8FF1AE /end MEASUREMENT
/begin MEASUREMENT FrmMng_numSITZGURTbyte3_mp "STAT_SITZBELEGUNG_GURT  rohes messagebyte 3" UBYTE OneToOne 1 100 0.00 255.0 FORMAT "%5.1" ECU_ADDRESS 0x8FF1AF /end MEASUREMENT
/begin MEASUREMENT FrmMng_numSITZGURTbyte4_mp "STAT_SITZBELEGUNG_GURT  rohes messagebyte 4" UBYTE OneToOne 1 100 0.00 255.0 FORMAT "%5.1" ECU_ADDRESS 0x8FF1B0 /end MEASUREMENT
/begin MEASUREMENT FrmMng_numSPEED_CLCTRbyte0_mp "SPEED_CLCTR Byte0" UBYTE OneToOne 1 100 0.00 255.0 FORMAT "%5.1" ECU_ADDRESS 0x8FF1B1 /end MEASUREMENT
/begin MEASUREMENT FrmMng_numSPEED_CLCTRbyte1_mp "SPEED_CLCTR Byte1" UBYTE OneToOne 1 100 0.00 255.0 FORMAT "%5.1" ECU_ADDRESS 0x8FF1B2 /end MEASUREMENT
/begin MEASUREMENT FrmMng_numSPEED_CLCTRbyte2_mp "SPEED_CLCTR Byte2" UBYTE OneToOne 1 100 0.00 255.0 FORMAT "%5.1" ECU_ADDRESS 0x8FF1B3 /end MEASUREMENT
/begin MEASUREMENT FrmMng_numSPEED_CLCTRbyte3_mp "SPEED_CLCTR Byte2" UBYTE OneToOne 1 100 0.00 255.0 FORMAT "%5.1" ECU_ADDRESS 0x8FF1B4 /end MEASUREMENT
/begin MEASUREMENT FrmMng_numSPEED_CLCTRbyte4_mp " SPEED_CLCTR Byte4" UBYTE OneToOne 1 100 0.00 255.0 FORMAT "%5.1" ECU_ADDRESS 0x8FF1B5 /end MEASUREMENT
/begin MEASUREMENT FrmMng_numSPEED_CLCTRbyte5_mp "SPEED_CLCTR Byte5" UBYTE OneToOne 1 100 0.00 255.0 FORMAT "%5.1" ECU_ADDRESS 0x8FF1B6 /end MEASUREMENT
/begin MEASUREMENT FrmMng_numSPEED_CLCTRbyte6_mp "SPEED_CLCTR Byte6" UBYTE OneToOne 1 100 0.00 255.0 FORMAT "%5.1" ECU_ADDRESS 0x8FF1B7 /end MEASUREMENT
/begin MEASUREMENT FrmMng_numSPEED_CLCTRbyte7_mp "SPEED_CLCTR Byte7" UBYTE OneToOne 1 100 0.00 255.0 FORMAT "%5.1" ECU_ADDRESS 0x8FF1B8 /end MEASUREMENT
/begin MEASUREMENT FrmMng_numSTAT_ANHbyte0_mp "" UBYTE OneToOne 1 100 0.00 255.0 FORMAT "%5.1" ECU_ADDRESS 0x8FF1B9 /end MEASUREMENT
/begin MEASUREMENT FrmMng_numSTAT_ARSbyte0_mp "Byte_x raw data in CAN-message" UBYTE OneToOne 1 100 0.00 255.0 FORMAT "%5.1" ECU_ADDRESS 0x8FF1BA /end MEASUREMENT
/begin MEASUREMENT FrmMng_numSTAT_ARSbyte1_mp "Byte_x raw data in CAN-message" UBYTE OneToOne 1 100 0.00 255.0 FORMAT "%5.1" ECU_ADDRESS 0x8FF1BB /end MEASUREMENT
/begin MEASUREMENT FrmMng_numSTAT_ARSbyte2_mp "Byte_x raw data in CAN-message" UBYTE OneToOne 1 100 0.00 255.0 FORMAT "%5.1" ECU_ADDRESS 0x8FF1BC /end MEASUREMENT
/begin MEASUREMENT FrmMng_numSTAT_ARSbyte3_mp "Byte_x raw data in CAN-message" UBYTE OneToOne 1 100 0.00 255.0 FORMAT "%5.1" ECU_ADDRESS 0x8FF1BD /end MEASUREMENT
/begin MEASUREMENT FrmMng_numSTAT_ARSbyte4_mp "Byte_x raw data in CAN-message" UBYTE OneToOne 1 100 0.00 255.0 FORMAT "%5.1" ECU_ADDRESS 0x8FF1BE /end MEASUREMENT
/begin MEASUREMENT FrmMng_numSTAT_ARSbyte5_mp "Byte_x raw data in CAN-message" UBYTE OneToOne 1 100 0.00 255.0 FORMAT "%5.1" ECU_ADDRESS 0x8FF1BF /end MEASUREMENT
/begin MEASUREMENT FrmMng_numSTAT_ARSbyte6_mp "Byte_x raw data in CAN-message" UBYTE OneToOne 1 100 0.00 255.0 FORMAT "%5.1" ECU_ADDRESS 0x8FF1C0 /end MEASUREMENT
/begin MEASUREMENT FrmMng_numSTAT_ARSbyte7_mp "Byte_x raw data in CAN-message" UBYTE OneToOne 1 100 0.00 255.0 FORMAT "%5.1" ECU_ADDRESS 0x8FF1C1 /end MEASUREMENT
/begin MEASUREMENT FrmMng_numSTAT_DSCbyte0_mp "Byte_x raw data in CAN-message" UBYTE OneToOne 1 100 0.00 255.0 FORMAT "%5.1" ECU_ADDRESS 0x8FF1C2 /end MEASUREMENT
/begin MEASUREMENT FrmMng_numSTAT_DSCbyte1_mp "Byte_x raw data in CAN-message" UBYTE OneToOne 1 100 0.00 255.0 FORMAT "%5.1" ECU_ADDRESS 0x8FF1C3 /end MEASUREMENT
/begin MEASUREMENT FrmMng_numSTAT_DSCbyte2_mp "Byte_x raw data in CAN-message" UBYTE OneToOne 1 100 0.00 255.0 FORMAT "%5.1" ECU_ADDRESS 0x8FF1C4 /end MEASUREMENT
/begin MEASUREMENT FrmMng_numSTAT_DSCbyte3_mp "Byte_x raw data in CAN-message" UBYTE OneToOne 1 100 0.00 255.0 FORMAT "%5.1" ECU_ADDRESS 0x8FF1C5 /end MEASUREMENT
/begin MEASUREMENT FrmMng_numSTAT_DSCbyte4_mp "Byte_x raw data in CAN-message" UBYTE OneToOne 1 100 0.00 255.0 FORMAT "%5.1" ECU_ADDRESS 0x8FF1C6 /end MEASUREMENT
/begin MEASUREMENT FrmMng_numSTAT_DSCbyte5_mp "Byte_x raw data in CAN-message" UBYTE OneToOne 1 100 0.00 255.0 FORMAT "%5.1" ECU_ADDRESS 0x8FF1C7 /end MEASUREMENT
/begin MEASUREMENT FrmMng_numSTAT_DSCbyte6_mp "Byte_x raw data in CAN-message" UBYTE OneToOne 1 100 0.00 255.0 FORMAT "%5.1" ECU_ADDRESS 0x8FF1C8 /end MEASUREMENT
/begin MEASUREMENT FrmMng_numSTAT_DSCbyte7_mp "Byte_x raw data in CAN-message" UBYTE OneToOne 1 100 0.00 255.0 FORMAT "%5.1" ECU_ADDRESS 0x8FF1C9 /end MEASUREMENT
/begin MEASUREMENT FrmMng_numSTAT_EKPbyte0_mp "STAT_EKP  Byte0" UBYTE OneToOne 1 100 0.00 255.0 FORMAT "%5.1" ECU_ADDRESS 0x8FF1CA /end MEASUREMENT
/begin MEASUREMENT FrmMng_numSTAT_EKPbyte1_mp "STAT_EKP  Byte1" UBYTE OneToOne 1 100 0.00 255.0 FORMAT "%5.1" ECU_ADDRESS 0x8FF1CB /end MEASUREMENT
/begin MEASUREMENT FrmMng_numSTAT_EKPbyte2_mp "STAT_EKP  Byte2" UBYTE OneToOne 1 100 0.00 255.0 FORMAT "%5.1" ECU_ADDRESS 0x8FF1CC /end MEASUREMENT
/begin MEASUREMENT FrmMng_numSTAT_EKPbyte3_mp "STAT_EKP  Byte3" UBYTE OneToOne 1 100 0.00 255.0 FORMAT "%5.1" ECU_ADDRESS 0x8FF1CD /end MEASUREMENT
/begin MEASUREMENT FrmMng_numSTAT_EKPbyte4_mp "STAT_EKP  Byte4" UBYTE OneToOne 1 100 0.00 255.0 FORMAT "%5.1" ECU_ADDRESS 0x8FF1CE /end MEASUREMENT
/begin MEASUREMENT FrmMng_numSTAT_EKPbyte5_mp "STAT_EKP  Byte5" UBYTE OneToOne 1 100 0.00 255.0 FORMAT "%5.1" ECU_ADDRESS 0x8FF1CF /end MEASUREMENT
/begin MEASUREMENT FrmMng_numSTAT_EKPbyte6_mp "STAT_EKP  Byte6" UBYTE OneToOne 1 100 0.00 255.0 FORMAT "%5.1" ECU_ADDRESS 0x8FF1D0 /end MEASUREMENT
/begin MEASUREMENT FrmMng_numSTAT_EKPbyte7_mp "STAT_EKP  Byte7" UBYTE OneToOne 1 100 0.00 255.0 FORMAT "%5.1" ECU_ADDRESS 0x8FF1D1 /end MEASUREMENT
/begin MEASUREMENT FrmMng_numSTAT_KOMBIbyte0_mp "STAT_KOMBI Byte0" UBYTE OneToOne 1 100 0.00 255.0 FORMAT "%5.1" ECU_ADDRESS 0x8FF1D2 /end MEASUREMENT
/begin MEASUREMENT FrmMng_numSTAT_KOMBIbyte1_mp "STAT_KOMBI Byte1" UBYTE OneToOne 1 100 0.00 255.0 FORMAT "%5.1" ECU_ADDRESS 0x8FF1D3 /end MEASUREMENT
/begin MEASUREMENT FrmMng_numSTAT_KOMBIbyte2_mp "STAT_KOMBI Byte2" UBYTE OneToOne 1 100 0.00 255.0 FORMAT "%5.1" ECU_ADDRESS 0x8FF1D4 /end MEASUREMENT
/begin MEASUREMENT FrmMng_numSTAT_KOMBIbyte3_mp "STAT_KOMBI Byte3" UBYTE OneToOne 1 100 0.00 255.0 FORMAT "%5.1" ECU_ADDRESS 0x8FF1D5 /end MEASUREMENT
/begin MEASUREMENT FrmMng_numSTAT_KOMBIbyte4_mp "STAT_KOMBI Byte4" UBYTE OneToOne 1 100 0.00 255.0 FORMAT "%5.1" ECU_ADDRESS 0x8FF1D6 /end MEASUREMENT
/begin MEASUREMENT FrmMng_numSTAT_KOMBIbyte5_mp "STAT_KOMBI Byte5" UBYTE OneToOne 1 100 0.00 255.0 FORMAT "%5.1" ECU_ADDRESS 0x8FF1D7 /end MEASUREMENT
/begin MEASUREMENT FrmMng_numSTAT_KOMBIbyte6_mp "STAT_KOMBI Byte6" UBYTE OneToOne 1 100 0.00 255.0 FORMAT "%5.1" ECU_ADDRESS 0x8FF1D8 /end MEASUREMENT
/begin MEASUREMENT FrmMng_numSTAT_KOMBIbyte7_mp "STAT_KOMBI Byte7" UBYTE OneToOne 1 100 0.00 255.0 FORMAT "%5.1" ECU_ADDRESS 0x8FF1D9 /end MEASUREMENT
/begin MEASUREMENT FrmMng_numTEMPRELTIMEbyte0_mp "TEMPRELTIME Byte0" UBYTE OneToOne 1 100 0.00 255.0 FORMAT "%5.1" ECU_ADDRESS 0x8FF1DA /end MEASUREMENT
/begin MEASUREMENT FrmMng_numTEMPRELTIMEbyte1_mp "TEMPRELTIME Byte1" UBYTE OneToOne 1 100 0.00 255.0 FORMAT "%5.1" ECU_ADDRESS 0x8FF1DB /end MEASUREMENT
/begin MEASUREMENT FrmMng_numTEMPRELTIMEbyte2_mp "TEMPRELTIME Byte2" UBYTE OneToOne 1 100 0.00 255.0 FORMAT "%5.1" ECU_ADDRESS 0x8FF1DC /end MEASUREMENT
/begin MEASUREMENT FrmMng_numTEMPRELTIMEbyte3_mp "TEMPRELTIME Byte3" UBYTE OneToOne 1 100 0.00 255.0 FORMAT "%5.1" ECU_ADDRESS 0x8FF1DD /end MEASUREMENT
/begin MEASUREMENT FrmMng_numTEMPRELTIMEbyte4_mp "TEMPRELTIME Byte4" UBYTE OneToOne 1 100 0.00 255.0 FORMAT "%5.1" ECU_ADDRESS 0x8FF1DE /end MEASUREMENT
/begin MEASUREMENT FrmMng_numTEMPRELTIMEbyte5_mp "TEMPRELTIME Byte5" UBYTE OneToOne 1 100 0.00 255.0 FORMAT "%5.1" ECU_ADDRESS 0x8FF1DF /end MEASUREMENT
/begin MEASUREMENT FrmMng_numTEMPRELTIMEbyte6_mp "TEMPRELTIME Byte6" UBYTE OneToOne 1 100 0.00 255.0 FORMAT "%5.1" ECU_ADDRESS 0x8FF1E0 /end MEASUREMENT
/begin MEASUREMENT FrmMng_numTERMINALbyte0_mp "Byte_x raw data in CAN-message" UBYTE OneToOne 1 100 0.00 255.0 FORMAT "%5.1" ECU_ADDRESS 0x8FF1E1 /end MEASUREMENT
/begin MEASUREMENT FrmMng_numTERMINALbyte1_mp "Byte_x raw data in CAN-message" UBYTE OneToOne 1 100 0.00 255.0 FORMAT "%5.1" ECU_ADDRESS 0x8FF1E2 /end MEASUREMENT
/begin MEASUREMENT FrmMng_numTERMINALbyte2_mp "Byte_x raw data in CAN-message" UBYTE OneToOne 1 100 0.00 255.0 FORMAT "%5.1" ECU_ADDRESS 0x8FF1E3 /end MEASUREMENT
/begin MEASUREMENT FrmMng_numTERMINALbyte3_mp "Byte_x raw data in CAN-message" UBYTE OneToOne 1 100 0.00 255.0 FORMAT "%5.1" ECU_ADDRESS 0x8FF1E4 /end MEASUREMENT
/begin MEASUREMENT FrmMng_numTERMINALbyte4_mp "Byte_x raw data in CAN-message" UBYTE OneToOne 1 100 0.00 255.0 FORMAT "%5.1" ECU_ADDRESS 0x8FF1E5 /end MEASUREMENT
/begin MEASUREMENT FrmMng_numTIME_DATEbyte0_mp "" UBYTE OneToOne 1 100 0.00 255.0 FORMAT "%5.1" ECU_ADDRESS 0x8FF1E6 /end MEASUREMENT
/begin MEASUREMENT FrmMng_numTIME_DATEbyte1_mp "" UBYTE OneToOne 1 100 0.00 255.0 FORMAT "%5.1" ECU_ADDRESS 0x8FF1E7 /end MEASUREMENT
/begin MEASUREMENT FrmMng_numTIME_DATEbyte2_mp "" UBYTE OneToOne 1 100 0.00 255.0 FORMAT "%5.1" ECU_ADDRESS 0x8FF1E8 /end MEASUREMENT
/begin MEASUREMENT FrmMng_numTIME_DATEbyte3_mp "" UBYTE OneToOne 1 100 0.00 255.0 FORMAT "%5.1" ECU_ADDRESS 0x8FF1E9 /end MEASUREMENT
/begin MEASUREMENT FrmMng_numTIME_DATEbyte4_mp "" UBYTE OneToOne 1 100 0.00 255.0 FORMAT "%5.1" ECU_ADDRESS 0x8FF1EA /end MEASUREMENT
/begin MEASUREMENT FrmMng_numTIME_DATEbyte5_mp "" UBYTE OneToOne 1 100 0.00 255.0 FORMAT "%5.1" ECU_ADDRESS 0x8FF1EB /end MEASUREMENT
/begin MEASUREMENT FrmMng_numTIME_DATEbyte6_mp "" UBYTE OneToOne 1 100 0.00 255.0 FORMAT "%5.1" ECU_ADDRESS 0x8FF1EC /end MEASUREMENT
/begin MEASUREMENT FrmMng_numTORQUE1byte0_mp "Byte_0 Rohwerte in CAN-message TORQUE1" UBYTE OneToOne 1 100 0.00 255.0 FORMAT "%5.1" ECU_ADDRESS 0x8FF1ED /end MEASUREMENT
/begin MEASUREMENT FrmMng_numTORQUE1byte1_mp "Byte_1 Rohwerte in CAN-Botschaft TORQUE1" UBYTE OneToOne 1 100 0.00 255.0 FORMAT "%5.1" ECU_ADDRESS 0x8FF1EE /end MEASUREMENT
/begin MEASUREMENT FrmMng_numTORQUE1byte2_mp "Byte_2 Rohwerte in CAN-Botschaft TORQUE1" UBYTE OneToOne 1 100 0.00 255.0 FORMAT "%5.1" ECU_ADDRESS 0x8FF1EF /end MEASUREMENT
/begin MEASUREMENT FrmMng_numTORQUE1byte3_mp "Byte_3 Rohwerte in CAN-Botschaft TORQUE1" UBYTE OneToOne 1 100 0.00 255.0 FORMAT "%5.1" ECU_ADDRESS 0x8FF1F0 /end MEASUREMENT
/begin MEASUREMENT FrmMng_numTORQUE1byte4_mp "Byte_4 Rohwerte in CAN-Botschaft TORQUE1" UBYTE OneToOne 1 100 0.00 255.0 FORMAT "%5.1" ECU_ADDRESS 0x8FF1F1 /end MEASUREMENT
/begin MEASUREMENT FrmMng_numTORQUE1byte5_mp "Byte_5 Rohwerte in CAN-Botschaft TORQUE1" UBYTE OneToOne 1 100 0.00 255.0 FORMAT "%5.1" ECU_ADDRESS 0x8FF1F2 /end MEASUREMENT
/begin MEASUREMENT FrmMng_numTORQUE1byte6_mp "Byte_6 Rohwerte in CAN-Botschaft TORQUE1" UBYTE OneToOne 1 100 0.00 255.0 FORMAT "%5.1" ECU_ADDRESS 0x8FF1F3 /end MEASUREMENT
/begin MEASUREMENT FrmMng_numTORQUE1byte7_mp "Byte_7 Rohwerte in CAN-Botschaft TORQUE1" UBYTE OneToOne 1 100 0.00 255.0 FORMAT "%5.1" ECU_ADDRESS 0x8FF1F4 /end MEASUREMENT
/begin MEASUREMENT FrmMng_numTORQUE2byte0_mp "Byte_0 Rohwerte in CAN-Botschaft TORQUE2" UBYTE OneToOne 1 100 0.00 255.0 FORMAT "%5.1" ECU_ADDRESS 0x8FF1F5 /end MEASUREMENT
/begin MEASUREMENT FrmMng_numTORQUE2byte1_mp "Byte_1 Rohwerte in CAN-Botschaft TORQUE2" UBYTE OneToOne 1 100 0.00 255.0 FORMAT "%5.1" ECU_ADDRESS 0x8FF1F6 /end MEASUREMENT
/begin MEASUREMENT FrmMng_numTORQUE2byte2_mp "Byte_2 Rohwerte in CAN-Botschaft TORQUE2" UBYTE OneToOne 1 100 0.00 255.0 FORMAT "%5.1" ECU_ADDRESS 0x8FF1F7 /end MEASUREMENT
/begin MEASUREMENT FrmMng_numTORQUE2byte3_mp "Byte_3 Rohwerte in CAN-Botschaft TORQUE2" UBYTE OneToOne 1 100 0.00 255.0 FORMAT "%5.1" ECU_ADDRESS 0x8FF1F8 /end MEASUREMENT
/begin MEASUREMENT FrmMng_numTORQUE2byte4_mp "Byte_4 Rohwerte in CAN-Botschaft TORQUE2" UBYTE OneToOne 1 100 0.00 255.0 FORMAT "%5.1" ECU_ADDRESS 0x8FF1F9 /end MEASUREMENT
/begin MEASUREMENT FrmMng_numTORQUE2byte5_mp "Byte_5 Rohwerte in CAN-Botschaft TORQUE2" UBYTE OneToOne 1 100 0.00 255.0 FORMAT "%5.1" ECU_ADDRESS 0x8FF1FA /end MEASUREMENT
/begin MEASUREMENT FrmMng_numTORQUE2byte6_mp "Byte_6 Rohwerte in CAN-Botschaft TORQUE2" UBYTE OneToOne 1 100 0.00 255.0 FORMAT "%5.1" ECU_ADDRESS 0x8FF1FB /end MEASUREMENT
/begin MEASUREMENT FrmMng_numTORQUE2byte7_mp "Byte_7 Rohwerte in CAN-Botschaft TORQUE2" UBYTE OneToOne 1 100 0.00 255.0 FORMAT "%5.1" ECU_ADDRESS 0x8FF1FC /end MEASUREMENT
/begin MEASUREMENT FrmMng_numTORQUE3byte0_mp "Byte_0 Rohwerte in CAN-message TORQUE3" UBYTE OneToOne 1 100 0.00 255.0 FORMAT "%5.1" ECU_ADDRESS 0x8FF1FD /end MEASUREMENT
/begin MEASUREMENT FrmMng_numTORQUE3byte1_mp "Byte_1 Rohwerte in CAN-Botschaft TORQUE3" UBYTE OneToOne 1 100 0.00 255.0 FORMAT "%5.1" ECU_ADDRESS 0x8FF1FE /end MEASUREMENT
/begin MEASUREMENT FrmMng_numTORQUE3byte2_mp "Byte_2 Rohwerte in CAN-Botschaft TORQUE3" UBYTE OneToOne 1 100 0.00 255.0 FORMAT "%5.1" ECU_ADDRESS 0x8FF1FF /end MEASUREMENT
/begin MEASUREMENT FrmMng_numTORQUE3byte3_mp "Byte_3 Rohwerte in CAN-Botschaft TORQUE3" UBYTE OneToOne 1 100 0.00 255.0 FORMAT "%5.1" ECU_ADDRESS 0x8FF200 /end MEASUREMENT
/begin MEASUREMENT FrmMng_numTORQUE3byte4_mp "Byte_4 Rohwerte in CAN-Botschaft TORQUE3" UBYTE OneToOne 1 100 0.00 255.0 FORMAT "%5.1" ECU_ADDRESS 0x8FF201 /end MEASUREMENT
/begin MEASUREMENT FrmMng_numTORQUE3byte5_mp "Byte_5 Rohwerte in CAN-Botschaft TORQUE3" UBYTE OneToOne 1 100 0.00 255.0 FORMAT "%5.1" ECU_ADDRESS 0x8FF202 /end MEASUREMENT
/begin MEASUREMENT FrmMng_numTORQUE3byte6_mp "Byte_6 Rohwerte in CAN-Botschaft TORQUE3" UBYTE OneToOne 1 100 0.00 255.0 FORMAT "%5.1" ECU_ADDRESS 0x8FF203 /end MEASUREMENT
/begin MEASUREMENT FrmMng_numTORQUE3byte7_mp "Byte_7 Rohwerte in CAN-Botschaft TORQUE3" UBYTE OneToOne 1 100 0.00 255.0 FORMAT "%5.1" ECU_ADDRESS 0x8FF204 /end MEASUREMENT
/begin MEASUREMENT FrmMng_numTORQUE_DSCbyte0_mp "Byte_x raw data in CAN-message" UBYTE OneToOne 1 100 0.00 255.0 FORMAT "%5.1" ECU_ADDRESS 0x8FF205 /end MEASUREMENT
/begin MEASUREMENT FrmMng_numTORQUE_DSCbyte1_mp "Byte_x raw data in CAN-message" UBYTE OneToOne 1 100 0.00 255.0 FORMAT "%5.1" ECU_ADDRESS 0x8FF206 /end MEASUREMENT
/begin MEASUREMENT FrmMng_numTORQUE_DSCbyte2_mp "Byte_x raw data in CAN-message" UBYTE OneToOne 1 100 0.00 255.0 FORMAT "%5.1" ECU_ADDRESS 0x8FF207 /end MEASUREMENT
/begin MEASUREMENT FrmMng_numTORQUE_DSCbyte3_mp "Byte_x raw data in CAN-message" UBYTE OneToOne 1 100 0.00 255.0 FORMAT "%5.1" ECU_ADDRESS 0x8FF208 /end MEASUREMENT
/begin MEASUREMENT FrmMng_numTORQUE_DSCbyte4_mp "Byte_x raw data in CAN-message" UBYTE OneToOne 1 100 0.00 255.0 FORMAT "%5.1" ECU_ADDRESS 0x8FF209 /end MEASUREMENT
/begin MEASUREMENT FrmMng_numTORQUE_DSCbyte5_mp "Byte_x raw data in CAN-message" UBYTE OneToOne 1 100 0.00 255.0 FORMAT "%5.1" ECU_ADDRESS 0x8FF20A /end MEASUREMENT
/begin MEASUREMENT FrmMng_numTORQUE_DSCbyte6_mp "Byte_x raw data in CAN-message" UBYTE OneToOne 1 100 0.00 255.0 FORMAT "%5.1" ECU_ADDRESS 0x8FF20B /end MEASUREMENT
/begin MEASUREMENT FrmMng_numTORQUE_DSCbyte7_mp "Byte_x raw data in CAN-message" UBYTE OneToOne 1 100 0.00 255.0 FORMAT "%5.1" ECU_ADDRESS 0x8FF20C /end MEASUREMENT
/begin MEASUREMENT FrmMng_numTORQUE_GEARBXbyte0_mp "Byte_x raw data in CAN-message" UBYTE OneToOne 1 100 0.00 255.0 FORMAT "%5.1" ECU_ADDRESS 0x8FF20D /end MEASUREMENT
/begin MEASUREMENT FrmMng_numTORQUE_GEARBXbyte1_mp "Byte_x raw data in CAN-message" UBYTE OneToOne 1 100 0.00 255.0 FORMAT "%5.1" ECU_ADDRESS 0x8FF20E /end MEASUREMENT
/begin MEASUREMENT FrmMng_numTORQUE_GEARBXbyte2_mp "Byte_x raw data in CAN-message" UBYTE OneToOne 1 100 0.00 255.0 FORMAT "%5.1" ECU_ADDRESS 0x8FF20F /end MEASUREMENT
/begin MEASUREMENT FrmMng_numTORQUE_GEARBXbyte3_mp "Byte_x raw data in CAN-message" UBYTE OneToOne 1 100 0.00 255.0 FORMAT "%5.1" ECU_ADDRESS 0x8FF210 /end MEASUREMENT
/begin MEASUREMENT FrmMng_numTORQUE_GEARBXbyte4_mp "Byte_x raw data in CAN-message" UBYTE OneToOne 1 100 0.00 255.0 FORMAT "%5.1" ECU_ADDRESS 0x8FF211 /end MEASUREMENT
/begin MEASUREMENT FrmMng_numTORQUE_GEARBXbyte5_mp "Byte_x raw data in CAN-message" UBYTE OneToOne 1 100 0.00 255.0 FORMAT "%5.1" ECU_ADDRESS 0x8FF212 /end MEASUREMENT
/begin MEASUREMENT FrmMng_numTORQUE_GEARBXbyte6_mp "Byte_x raw data in CAN-message" UBYTE OneToOne 1 100 0.00 255.0 FORMAT "%5.1" ECU_ADDRESS 0x8FF213 /end MEASUREMENT
/begin MEASUREMENT FrmMng_numTORQUE_GEARBXbyte7_mp "Byte_x raw data in CAN-message" UBYTE OneToOne 1 100 0.00 255.0 FORMAT "%5.1" ECU_ADDRESS 0x8FF214 /end MEASUREMENT
/begin MEASUREMENT FrmMng_numVEH_MODbyte0_mp "VEH_MOD Byte0" UBYTE OneToOne 1 100 0.00 255.0 FORMAT "%5.1" ECU_ADDRESS 0x8FF215 /end MEASUREMENT
/begin MEASUREMENT FrmMng_numVEH_MODbyte1_mp "VEH_MOD Byte1" UBYTE OneToOne 1 100 0.00 255.0 FORMAT "%5.1" ECU_ADDRESS 0x8FF216 /end MEASUREMENT
/begin MEASUREMENT FrmMng_numVELOCITYbyte0_mp "Byte_x raw data in CAN-message" UBYTE OneToOne 1 100 0.00 255.0 FORMAT "%5.1" ECU_ADDRESS 0x8FF217 /end MEASUREMENT
/begin MEASUREMENT FrmMng_numVELOCITYbyte1_mp "Byte_x raw data in CAN-message" UBYTE OneToOne 1 100 0.00 255.0 FORMAT "%5.1" ECU_ADDRESS 0x8FF218 /end MEASUREMENT
/begin MEASUREMENT FrmMng_numVELOCITYbyte2_mp "Byte_x raw data in CAN-message" UBYTE OneToOne 1 100 0.00 255.0 FORMAT "%5.1" ECU_ADDRESS 0x8FF219 /end MEASUREMENT
/begin MEASUREMENT FrmMng_numVELOCITYbyte3_mp "Byte_x raw data in CAN-message" UBYTE OneToOne 1 100 0.00 255.0 FORMAT "%5.1" ECU_ADDRESS 0x8FF21A /end MEASUREMENT
/begin MEASUREMENT FrmMng_numVELOCITYbyte4_mp "Byte_x raw data in CAN-message" UBYTE OneToOne 1 100 0.00 255.0 FORMAT "%5.1" ECU_ADDRESS 0x8FF21B /end MEASUREMENT
/begin MEASUREMENT FrmMng_numVELOCITYbyte5_mp "Byte_x raw data in CAN-message" UBYTE OneToOne 1 100 0.00 255.0 FORMAT "%5.1" ECU_ADDRESS 0x8FF21C /end MEASUREMENT
/begin MEASUREMENT FrmMng_numVELOCITYbyte6_mp "Byte_x raw data in CAN-message" UBYTE OneToOne 1 100 0.00 255.0 FORMAT "%5.1" ECU_ADDRESS 0x8FF21D /end MEASUREMENT
/begin MEASUREMENT FrmMng_numVELOCITYbyte7_mp "Byte_x raw data in CAN-message" UBYTE OneToOne 1 100 0.00 255.0 FORMAT "%5.1" ECU_ADDRESS 0x8FF21E /end MEASUREMENT
/begin MEASUREMENT FrmMng_numWHEEL_SPEEDbyte0_mp "Wheel Speed Rohwerte" UBYTE OneToOne 1 100 0.00 255.0 FORMAT "%5.1" ECU_ADDRESS 0x8FF21F /end MEASUREMENT
/begin MEASUREMENT FrmMng_numWHEEL_SPEEDbyte1_mp "Wheel Speed Rohwerte" UBYTE OneToOne 1 100 0.00 255.0 FORMAT "%5.1" ECU_ADDRESS 0x8FF220 /end MEASUREMENT
/begin MEASUREMENT FrmMng_numWHEEL_SPEEDbyte2_mp "Wheel Speed Rohwerte" UBYTE OneToOne 1 100 0.00 255.0 FORMAT "%5.1" ECU_ADDRESS 0x8FF221 /end MEASUREMENT
/begin MEASUREMENT FrmMng_numWHEEL_SPEEDbyte3_mp "Wheel Speed Rohwerte" UBYTE OneToOne 1 100 0.00 255.0 FORMAT "%5.1" ECU_ADDRESS 0x8FF222 /end MEASUREMENT
/begin MEASUREMENT FrmMng_numWHEEL_SPEEDbyte4_mp "Wheel Speed Rohwerte" UBYTE OneToOne 1 100 0.00 255.0 FORMAT "%5.1" ECU_ADDRESS 0x8FF223 /end MEASUREMENT
/begin MEASUREMENT FrmMng_numWHEEL_SPEEDbyte5_mp "Wheel Speed Rohwerte" UBYTE OneToOne 1 100 0.00 255.0 FORMAT "%5.1" ECU_ADDRESS 0x8FF224 /end MEASUREMENT
/begin MEASUREMENT FrmMng_numWHEEL_SPEEDbyte6_mp "Wheel Speed Rohwerte" UBYTE OneToOne 1 100 0.00 255.0 FORMAT "%5.1" ECU_ADDRESS 0x8FF225 /end MEASUREMENT
/begin MEASUREMENT FrmMng_numWHEEL_SPEEDbyte7_mp "Wheel Speed Rohwerte" UBYTE OneToOne 1 100 0.00 255.0 FORMAT "%5.1" ECU_ADDRESS 0x8FF226 /end MEASUREMENT
/begin MEASUREMENT FrmMng_parkConsumerFunctionID "ID function park consumer" UWORD OneToOne 1 100 0.00 65535.00 FORMAT "%8.2" ECU_ADDRESS 0x7F8D0A /end MEASUREMENT
/begin MEASUREMENT FrmMng_parkConsumerID2 "ID function park consumer" UBYTE OneToOne 1 100 0.00 255.0 FORMAT "%5.1" ECU_ADDRESS 0x7F8897 /end MEASUREMENT
/begin MEASUREMENT FrmMng_pBrkSys "Bremsdruck" UWORD Pres_bar 1 100 0.00 65535.00 FORMAT "%8.2" ECU_ADDRESS 0x7F8D08 /end MEASUREMENT
/begin MEASUREMENT FrmMng_phiStrg "Steering angle recieved over CAN" SWORD AngleGrad 1 100 -1440.154 1440.110 FORMAT "%8.3" ECU_ADDRESS 0x7F8D0C /end MEASUREMENT
/begin MEASUREMENT FrmMng_RadmomPT1RetVal_mp "actvation status of the message RADMOM_PT_1" UBYTE OneToOne 1 100 0.00 255.0 FORMAT "%5.1" ECU_ADDRESS 0x8FF227 /end MEASUREMENT
/begin MEASUREMENT FrmMng_RadmomPT2RetVal_mp "Activation status of the frame RADMOM_PT_2" UBYTE OneToOne 1 100 0.00 255.0 FORMAT "%5.1" ECU_ADDRESS 0x8FF228 /end MEASUREMENT
/begin MEASUREMENT FrmMng_rHtFlowReq "heat flow request" UWORD Prc 1 100 0.00 799.9878 FORMAT "%8.4" ECU_ADDRESS 0x7F8D0E /end MEASUREMENT
/begin MEASUREMENT FrmMng_rTransDT "Triebstrangsübersetzungsverhältnis von CAN" SWORD TransR 1 100 -327.6800 327.6700 FORMAT "%8.4" ECU_ADDRESS 0x7F8D12 /end MEASUREMENT
/begin MEASUREMENT FrmMng_rWaterVlv_mp "measuring point fot CTR_APE_WV" UWORD Prc 1 100 0.00 799.9878 FORMAT "%8.4" ECU_ADDRESS 0x8FF22A /end MEASUREMENT
/begin MEASUREMENT FrmMng_service_index_Byte0_mp "Byte0 of raw messagebyte of logon and logout message" UBYTE OneToOne 1 100 0.00 255.0 FORMAT "%5.1" ECU_ADDRESS 0x8FF22C /end MEASUREMENT
/begin MEASUREMENT FrmMng_service_index_Byte10_mp "Byte10 of raw messagebyte of logon and logout message" UBYTE OneToOne 1 100 0.00 255.0 FORMAT "%5.1" ECU_ADDRESS 0x8FF22D /end MEASUREMENT
/begin MEASUREMENT FrmMng_service_index_Byte11_mp "Byte11 of raw messagebyte of logon and logout message" UBYTE OneToOne 1 100 0.00 255.0 FORMAT "%5.1" ECU_ADDRESS 0x8FF22E /end MEASUREMENT
/begin MEASUREMENT FrmMng_service_index_Byte12_mp "Byte12 of raw messagebyte of logon and logout message" UBYTE OneToOne 1 100 0.00 255.0 FORMAT "%5.1" ECU_ADDRESS 0x8FF22F /end MEASUREMENT
/begin MEASUREMENT FrmMng_service_index_Byte13_mp "Byte13 of raw messagebyte of logon and logout message" UBYTE OneToOne 1 100 0.00 255.0 FORMAT "%5.1" ECU_ADDRESS 0x8FF230 /end MEASUREMENT
/begin MEASUREMENT FrmMng_service_index_Byte14_mp "Byte14 of raw messagebyte of logon and logout message" UBYTE OneToOne 1 100 0.00 255.0 FORMAT "%5.1" ECU_ADDRESS 0x8FF231 /end MEASUREMENT
/begin MEASUREMENT FrmMng_service_index_Byte1_mp "Byte1 of raw messagebyte of logon and logout message" UBYTE OneToOne 1 100 0.00 255.0 FORMAT "%5.1" ECU_ADDRESS 0x8FF232 /end MEASUREMENT
/begin MEASUREMENT FrmMng_service_index_Byte2_mp "Byte2 of raw messagebyte of logon and logout message" UBYTE OneToOne 1 100 0.00 255.0 FORMAT "%5.1" ECU_ADDRESS 0x8FF233 /end MEASUREMENT
/begin MEASUREMENT FrmMng_service_index_Byte3_mp "Byte3 of raw messagebyte of logon and logout message" UBYTE OneToOne 1 100 0.00 255.0 FORMAT "%5.1" ECU_ADDRESS 0x8FF234 /end MEASUREMENT
/begin MEASUREMENT FrmMng_service_index_Byte4_mp "Byte4 of raw messagebyte of logon and logout message" UBYTE OneToOne 1 100 0.00 255.0 FORMAT "%5.1" ECU_ADDRESS 0x8FF235 /end MEASUREMENT
/begin MEASUREMENT FrmMng_service_index_Byte5_mp "Byte5 of raw messagebyte of logon and logout message" UBYTE OneToOne 1 100 0.00 255.0 FORMAT "%5.1" ECU_ADDRESS 0x8FF236 /end MEASUREMENT
/begin MEASUREMENT FrmMng_service_index_Byte6_mp "Byte6 of raw messagebyte of logon and logout message" UBYTE OneToOne 1 100 0.00 255.0 FORMAT "%5.1" ECU_ADDRESS 0x8FF237 /end MEASUREMENT
/begin MEASUREMENT FrmMng_service_index_Byte7_mp "Byte7 of raw messagebyte of logon and logout message" UBYTE OneToOne 1 100 0.00 255.0 FORMAT "%5.1" ECU_ADDRESS 0x8FF238 /end MEASUREMENT
/begin MEASUREMENT FrmMng_service_index_Byte8_mp "Byte8 of raw messagebyte of logon and logout message" UBYTE OneToOne 1 100 0.00 255.0 FORMAT "%5.1" ECU_ADDRESS 0x8FF239 /end MEASUREMENT
/begin MEASUREMENT FrmMng_service_index_Byte9_mp "Byte9 of raw messagebyte of logon and logout message" UBYTE OneToOne 1 100 0.00 255.0 FORMAT "%5.1" ECU_ADDRESS 0x8FF23A /end MEASUREMENT
/begin MEASUREMENT FrmMng_stACCTrqCtl "Message to indicate the torque reduction for ACC" UBYTE OneToOne 1 100 0.00 255.0 FORMAT "%5.1" ECU_ADDRESS 0x7F8898 /end MEASUREMENT
/begin MEASUREMENT FrmMng_stACC_ModDME "Status ACC mode DME-message" UBYTE OneToOne 1 100 0.00 255.0 FORMAT "%5.1" ECU_ADDRESS 0x7F8899 /end MEASUREMENT
/begin MEASUREMENT FrmMng_stACC_PrevOvrRunSwtDem "request prevention over run fuel shutoff-message" UBYTE OneToOne 1 100 0.00 255.0 FORMAT "%5.1" ECU_ADDRESS 0x7F889A /end MEASUREMENT
/begin MEASUREMENT FrmMng_stACC_ShtDwnDME "Status ACC Switch-off system-message" UBYTE OneToOne 1 100 0.00 255.0 FORMAT "%5.1" ECU_ADDRESS 0x7F889B /end MEASUREMENT
/begin MEASUREMENT FrmMng_stACC_TrqDes "Torque target status-message DREHMOMENT_ANF_ACC" UBYTE OneToOne 1 100 0.00 255.0 FORMAT "%5.1" ECU_ADDRESS 0x7F889C /end MEASUREMENT
/begin MEASUREMENT FrmMng_stACmainSwt "Hauptschalter Klimakompressor" UBYTE OneToOne 1 100 0.00 255.0 FORMAT "%5.1" ECU_ADDRESS 0x7F889E /end MEASUREMENT
/begin MEASUREMENT FrmMng_stACnMin "Drehzahlanhebungsanforderung vom Klimakompressor" UBYTE OneToOne 1 100 0.00 255.0 FORMAT "%5.1" ECU_ADDRESS 0x7F889F /end MEASUREMENT
/begin MEASUREMENT FrmMng_stANFRADMOMPTSig "Spiegel ungültiger Signale von ANF_RADMOM_PT" UWORD OneToOne 1 100 0.00 65535.00 FORMAT "%8.2" ECU_ADDRESS 0x7F8D16 /end MEASUREMENT
/begin MEASUREMENT FrmMng_stARS "type of ARS torque-intervention" UBYTE OneToOne 1 100 0.00 255.0 FORMAT "%5.1" ECU_ADDRESS 0x7F88A0 /end MEASUREMENT
/begin MEASUREMENT FrmMng_stARSquit_mp "Bestaetigung ARS-Momenteneingriff" UBYTE OneToOne 1 100 0.00 255.0 FORMAT "%5.1" ECU_ADDRESS 0x8FF23B /end MEASUREMENT
/begin MEASUREMENT FrmMng_stAVAI_BOS_RSTG "unit for availability of removing parts" UBYTE OneToOne 1 100 0.00 255.0 FORMAT "%5.1" ECU_ADDRESS 0x7F88A3 /end MEASUREMENT
/begin MEASUREMENT FrmMng_stBltbDr "Status Gurtschloßkontakt" UBYTE OneToOne 1 100 0.00 255.0 FORMAT "%5.1" ECU_ADDRESS 0x7F88A4 /end MEASUREMENT
/begin MEASUREMENT FrmMng_stBOS_RESETSig "signalerrorstatus-message BOS_RESET" UWORD OneToOne 1 100 0.00 65535.00 FORMAT "%8.2" ECU_ADDRESS 0x7F8D18 /end MEASUREMENT
/begin MEASUREMENT FrmMng_stBOS_RESET_2Sig "" UWORD OneToOne 1 100 0.00 65535.00 FORMAT "%8.2" ECU_ADDRESS 0x7F8D1A /end MEASUREMENT
/begin MEASUREMENT FrmMng_stBrk_mp "Status Bremslicht-Schalter" UBYTE OneToOne 1 100 0.00 255.0 FORMAT "%5.1" ECU_ADDRESS 0x8FF23C /end MEASUREMENT
/begin MEASUREMENT FrmMng_stClCtr "control-status" UBYTE OneToOne 1 100 0.00 255.0 FORMAT "%5.1" ECU_ADDRESS 0x7F88A9 /end MEASUREMENT
/begin MEASUREMENT FrmMng_stCltSSG "Status of Clutch" UBYTE OneToOne 1 100 0.00 255.0 FORMAT "%5.1" ECU_ADDRESS 0x7F88AA /end MEASUREMENT
/begin MEASUREMENT FrmMng_stConv "Kupplungszustand über CAN" UBYTE OneToOne 1 100 0.00 255.0 FORMAT "%5.1" ECU_ADDRESS 0x7F88AB /end MEASUREMENT
/begin MEASUREMENT FrmMng_stCOU_RSTG_BOS_RSTG "counter for removing parts" UBYTE OneToOne 1 100 0.00 255.0 FORMAT "%5.1" ECU_ADDRESS 0x7F88A8 /end MEASUREMENT
/begin MEASUREMENT FrmMng_stCrCtlRaw "state CrCtlRaw" UBYTE OneToOne 1 100 0.00 255.0 FORMAT "%5.1" ECU_ADDRESS 0x7F88AD /end MEASUREMENT
/begin MEASUREMENT FrmMng_stCrCtl_mp "Status FGR" UBYTE OneToOne 1 100 0.00 255.0 FORMAT "%5.1" ECU_ADDRESS 0x8FF23D /end MEASUREMENT
/begin MEASUREMENT FrmMng_stCurrSig_mp "Botschaftsstatus für CODIERUNG_PM Botschaft" UWORD OneToOne 1 100 0.00 65535.00 FORMAT "%8.2" ECU_ADDRESS 0x8FF23E /end MEASUREMENT
/begin MEASUREMENT FrmMng_stCurr_byte0_mp "Rohwert von MAG_BT signal" UBYTE OneToOne 1 100 0.00 255.0 FORMAT "%5.1" ECU_ADDRESS 0x8FF240 /end MEASUREMENT
/begin MEASUREMENT FrmMng_stCurr_byte1_mp "Rohwert von QC_VEH CAN signal" UBYTE OneToOne 1 100 0.00 255.0 FORMAT "%5.1" ECU_ADDRESS 0x8FF241 /end MEASUREMENT
/begin MEASUREMENT FrmMng_stCurr_byte2_mp "Rohwert von I_SC_MAX_VEH signal" UBYTE OneToOne 1 100 0.00 255.0 FORMAT "%5.1" ECU_ADDRESS 0x8FF242 /end MEASUREMENT
/begin MEASUREMENT FrmMng_stCurr_byte3_mp "Rohwert von I_SC_MAX_VEH signal" UBYTE OneToOne 1 100 0.00 255.0 FORMAT "%5.1" ECU_ADDRESS 0x8FF243 /end MEASUREMENT
/begin MEASUREMENT FrmMng_stDateDay "" UBYTE OneToOne 1 100 0.00 255.0 FORMAT "%5.1" ECU_ADDRESS 0x7F88B1 /end MEASUREMENT
/begin MEASUREMENT FrmMng_stDateMon "" UBYTE OneToOne 1 100 0.00 255.0 FORMAT "%5.1" ECU_ADDRESS 0x7F88B2 /end MEASUREMENT
/begin MEASUREMENT FrmMng_stDateSeason "" UBYTE OneToOne 1 100 0.00 255.0 FORMAT "%5.1" ECU_ADDRESS 0x7F88B3 /end MEASUREMENT
/begin MEASUREMENT FrmMng_stDateYr "" UWORD OneToOne 1 100 0.00 65535.00 FORMAT "%8.2" ECU_ADDRESS 0x7F8D22 /end MEASUREMENT
/begin MEASUREMENT FrmMng_stDCC_TrqDes "Radmoment Antriebsstrang Freischaltung" UBYTE OneToOne 1 100 0.00 255.0 FORMAT "%5.1" ECU_ADDRESS 0x7F88AE /end MEASUREMENT
/begin MEASUREMENT FrmMng_stDebValT15CDold_mp "" UBYTE OneToOne 1 100 0.00 255.0 FORMAT "%5.1" ECU_ADDRESS 0x8FF244 /end MEASUREMENT
/begin MEASUREMENT FrmMng_stDecellDSC "state delay DSC" UBYTE OneToOne 1 100 0.00 255.0 FORMAT "%5.1" ECU_ADDRESS 0x7F88B4 /end MEASUREMENT
/begin MEASUREMENT FrmMng_stDM_ANF_AFSSig "signal error status for DREHMOMENT_ANF_AFS" UWORD OneToOne 1 100 0.00 65535.00 FORMAT "%8.2" ECU_ADDRESS 0x7F8D1C /end MEASUREMENT
/begin MEASUREMENT FrmMng_stDREHMOMENT_ANF_ACCSig "signalerrorstatus-message" UWORD OneToOne 1 100 0.00 65535.00 FORMAT "%8.2" ECU_ADDRESS 0x7F8D1E /end MEASUREMENT
/begin MEASUREMENT FrmMng_stDRMANFSSGSig "Status of error signal DREHMOMENT_ANF_SSG" UWORD OneToOne 1 100 0.00 65535.00 FORMAT "%8.2" ECU_ADDRESS 0x7F8D20 /end MEASUREMENT
/begin MEASUREMENT FrmMng_stDrvAssist_mp "Status Fahrerassistenz Antriebsstrang" UBYTE OneToOne 1 100 0.00 255.0 FORMAT "%5.1" ECU_ADDRESS 0x8FF245 /end MEASUREMENT
/begin MEASUREMENT FrmMng_stDSCDef "Status DSC" UBYTE OneToOne 1 100 0.00 255.0 FORMAT "%5.1" ECU_ADDRESS 0x7F88B0 /end MEASUREMENT
/begin MEASUREMENT FrmMng_stDSCquit_mp "Bestaetigung DSC-Momenteneingriff" UBYTE OneToOne 1 100 0.00 255.0 FORMAT "%5.1" ECU_ADDRESS 0x8FF246 /end MEASUREMENT
/begin MEASUREMENT FrmMng_stEng_mp "Status Motorlauf" UBYTE OneToOne 1 100 0.00 255.0 FORMAT "%5.1" ECU_ADDRESS 0x8FF247 /end MEASUREMENT
/begin MEASUREMENT FrmMng_stErrAFS "Error status of AFS received over CAN" UBYTE OneToOne 1 100 0.00 255.0 FORMAT "%5.1" ECU_ADDRESS 0x7F88B5 /end MEASUREMENT
/begin MEASUREMENT FrmMng_stErrStrg "Error status of Steering received over CAN" UBYTE OneToOne 1 100 0.00 255.0 FORMAT "%5.1" ECU_ADDRESS 0x7F88B6 /end MEASUREMENT
/begin MEASUREMENT FrmMng_stExcStateCan_mp "" ULONG OneToOne 1 100 0.00 4294967295.00 FORMAT "%13.2" ECU_ADDRESS 0x8FF248 /end MEASUREMENT
/begin MEASUREMENT FrmMng_stExc_ANFRADMOMPT_mp "Exception State für ANF_RADMOM_PT" UWORD OneToOne 1 100 0.00 65535.00 FORMAT "%8.2" ECU_ADDRESS 0x8FF24C /end MEASUREMENT
/begin MEASUREMENT FrmMng_stExc_BOS_RESET_2_mp "" UWORD OneToOne 1 100 0.00 65535.00 FORMAT "%8.2" ECU_ADDRESS 0x8FF24E /end MEASUREMENT
/begin MEASUREMENT FrmMng_stExc_BOS_RESET_mp "exceptionstate BOS_RESET" UWORD OneToOne 1 100 0.00 65535.00 FORMAT "%8.2" ECU_ADDRESS 0x8FF250 /end MEASUREMENT
/begin MEASUREMENT FrmMng_stExc_DM_ANF_ACC_mp "Exception state von CAN Botschaft (error & freeze)" UWORD OneToOne 1 100 0.00 65535.00 FORMAT "%8.2" ECU_ADDRESS 0x8FF252 /end MEASUREMENT
/begin MEASUREMENT FrmMng_stExc_DM_ANF_AFS_mp "Exception state von CAN Botschaft (error & freeze)" UWORD OneToOne 1 100 0.00 65535.00 FORMAT "%8.2" ECU_ADDRESS 0x8FF254 /end MEASUREMENT
/begin MEASUREMENT FrmMng_stExc_DRMANFSSG_mp "exceptionstate DRMANFSSG" UWORD OneToOne 1 100 0.00 65535.00 FORMAT "%8.2" ECU_ADDRESS 0x8FF256 /end MEASUREMENT
/begin MEASUREMENT FrmMng_stExc_GEARBX_DATA2_mp "exceptionstate GEARBX_DATA2" UWORD OneToOne 1 100 0.00 65535.00 FORMAT "%8.2" ECU_ADDRESS 0x8FF258 /end MEASUREMENT
/begin MEASUREMENT FrmMng_stExc_GEARBX_DATA_mp "exceptionstate of CAN-message ( errors, freeze, ... )" UWORD OneToOne 1 100 0.00 65535.00 FORMAT "%8.2" ECU_ADDRESS 0x8FF25A /end MEASUREMENT
/begin MEASUREMENT FrmMng_stExc_HEAT_AC_mp "exceptionstate of CAN-message ( errors, freeze, ... )" UWORD OneToOne 1 100 0.00 65535.00 FORMAT "%8.2" ECU_ADDRESS 0x8FF25C /end MEASUREMENT
/begin MEASUREMENT FrmMng_stExc_LRADWINK_mp "exceptionstate LENKRADWINKEL" UWORD OneToOne 1 100 0.00 65535.00 FORMAT "%8.2" ECU_ADDRESS 0x8FF25E /end MEASUREMENT
/begin MEASUREMENT FrmMng_stExc_MILEAGE_RANGE_mp "exceptionstate MILEAGE_RANGE" UWORD OneToOne 1 100 0.00 65535.00 FORMAT "%8.2" ECU_ADDRESS 0x8FF260 /end MEASUREMENT
/begin MEASUREMENT FrmMng_stExc_OPCRCTLACC_mp "exceptionstate OP_CRCTLACC" UWORD OneToOne 1 100 0.00 65535.00 FORMAT "%8.2" ECU_ADDRESS 0x8FF262 /end MEASUREMENT
/begin MEASUREMENT FrmMng_stExc_ParkConsumer_mp "exceptionstate ParkConsumer" UWORD OneToOne 1 100 0.00 65535.00 FORMAT "%8.2" ECU_ADDRESS 0x8FF264 /end MEASUREMENT
/begin MEASUREMENT FrmMng_stExc_PRGG_CCTR_mp "exceptionstate PRGG_CCTR" UWORD OneToOne 1 100 0.00 65535.00 FORMAT "%8.2" ECU_ADDRESS 0x8FF266 /end MEASUREMENT
/begin MEASUREMENT FrmMng_stExc_PWRMNG_LOADV_mp "" UWORD OneToOne 1 100 0.00 65535.00 FORMAT "%8.2" ECU_ADDRESS 0x8FF268 /end MEASUREMENT
/begin MEASUREMENT FrmMng_stExc_RQ_STG_EFAN_mp "Exception state von CAN Botschaft (error & freeze)" UWORD OneToOne 1 100 0.00 65535.00 FORMAT "%8.2" ECU_ADDRESS 0x8FF26A /end MEASUREMENT
/begin MEASUREMENT FrmMng_stExc_SERVICE_mp "exceptionstate SERVICE" UWORD OneToOne 1 100 0.00 65535.00 FORMAT "%8.2" ECU_ADDRESS 0x8FF26C /end MEASUREMENT
/begin MEASUREMENT FrmMng_stExc_SITZGURT_mp "Exception State für STAT_SITZBELEGUNG_GURT" UWORD OneToOne 1 100 0.00 65535.00 FORMAT "%8.2" ECU_ADDRESS 0x8FF26E /end MEASUREMENT
/begin MEASUREMENT FrmMng_stExc_STAT_ANH_mp "" UWORD OneToOne 1 100 0.00 65535.00 FORMAT "%8.2" ECU_ADDRESS 0x8FF270 /end MEASUREMENT
/begin MEASUREMENT FrmMng_stExc_STAT_ARS_mp "exceptionstate of CAN-message ( errors, freeze, ... )" UWORD OneToOne 1 100 0.00 65535.00 FORMAT "%8.2" ECU_ADDRESS 0x8FF272 /end MEASUREMENT
/begin MEASUREMENT FrmMng_stExc_STAT_DSC_mp "exceptionstate of CAN-message ( errors, freeze, ... )" UWORD OneToOne 1 100 0.00 65535.00 FORMAT "%8.2" ECU_ADDRESS 0x8FF274 /end MEASUREMENT
/begin MEASUREMENT FrmMng_stExc_STAT_EKP_mp "exceptionstate STAT_EKP" UWORD OneToOne 1 100 0.00 65535.00 FORMAT "%8.2" ECU_ADDRESS 0x8FF276 /end MEASUREMENT
/begin MEASUREMENT FrmMng_stExc_STAT_KOMBI_mp "exceptionstate STAT_KOMB" UWORD OneToOne 1 100 0.00 65535.00 FORMAT "%8.2" ECU_ADDRESS 0x8FF278 /end MEASUREMENT
/begin MEASUREMENT FrmMng_stExc_stCurr_mp "Exception Status von CODIERUNG_PM message" UWORD OneToOne 1 100 0.00 65535.00 FORMAT "%8.2" ECU_ADDRESS 0x8FF27A /end MEASUREMENT
/begin MEASUREMENT FrmMng_stExc_swtPSPOff_mp "Exception Status von CTR_CRASH_SWO_EKP message" UWORD OneToOne 1 100 0.00 65535.00 FORMAT "%8.2" ECU_ADDRESS 0x8FF27C /end MEASUREMENT
/begin MEASUREMENT FrmMng_stExc_TEMPRELTIME_mp "exceptionstate TEMPRELTIME" UWORD OneToOne 1 100 0.00 65535.00 FORMAT "%8.2" ECU_ADDRESS 0x8FF27E /end MEASUREMENT
/begin MEASUREMENT FrmMng_stExc_TERMINAL_mp "exceptionstate of CAN-message ( errors, freeze, ... )" UWORD OneToOne 1 100 0.00 65535.00 FORMAT "%8.2" ECU_ADDRESS 0x8FF280 /end MEASUREMENT
/begin MEASUREMENT FrmMng_stExc_TIME_DATE_mp "" UWORD OneToOne 1 100 0.00 65535.00 FORMAT "%8.2" ECU_ADDRESS 0x8FF282 /end MEASUREMENT
/begin MEASUREMENT FrmMng_stExc_TORQUE_DSC_mp "exceptionstate of CAN-message ( errors, freeze, ... )" UWORD OneToOne 1 100 0.00 65535.00 FORMAT "%8.2" ECU_ADDRESS 0x8FF284 /end MEASUREMENT
/begin MEASUREMENT FrmMng_stExc_TORQUE_GEARBX_mp "exceptionstate of CAN-message ( errors, freeze, ... )" UWORD OneToOne 1 100 0.00 65535.00 FORMAT "%8.2" ECU_ADDRESS 0x8FF286 /end MEASUREMENT
/begin MEASUREMENT FrmMng_stExc_VEH_MOD_mp "exception state for  VEH_MOD" UWORD OneToOne 1 100 0.00 65535.00 FORMAT "%8.2" ECU_ADDRESS 0x8FF288 /end MEASUREMENT
/begin MEASUREMENT FrmMng_stExc_VELOCITY_mp "exceptionstate of CAN-message ( errors, freeze, ... )" UWORD OneToOne 1 100 0.00 65535.00 FORMAT "%8.2" ECU_ADDRESS 0x8FF28A /end MEASUREMENT
/begin MEASUREMENT FrmMng_stExc_WHEEL_SPEED_mp "exceptionstate WHEEL_SPEED" UWORD OneToOne 1 100 0.00 65535.00 FORMAT "%8.2" ECU_ADDRESS 0x8FF28C /end MEASUREMENT
/begin MEASUREMENT FrmMng_stFDC "status of VEH_MOD" UBYTE OneToOne 1 100 0.00 255.0 FORMAT "%5.1" ECU_ADDRESS 0x7F88B7 /end MEASUREMENT
/begin MEASUREMENT FrmMng_stFDC_mp "Measuring point for state of vehicle mode" UBYTE OneToOne 1 100 0.00 255.0 FORMAT "%5.1" ECU_ADDRESS 0x8FF28E /end MEASUREMENT
/begin MEASUREMENT FrmMng_stGbx "Getriebezustand (Schaltung aktiv/inaktiv) über CAN" UBYTE OneToOne 1 100 0.00 255.0 FORMAT "%5.1" ECU_ADDRESS 0x7F88B8 /end MEASUREMENT
/begin MEASUREMENT FrmMng_stGear "Istganginformation vom CAN" UBYTE OneToOne 1 100 0.00 255.0 FORMAT "%5.1" ECU_ADDRESS 0x7F88B9 /end MEASUREMENT
/begin MEASUREMENT FrmMng_stGearbxHtgUpAct_mp "measuring point for evluating ST_SW_WAUP signal" UBYTE OneToOne 1 100 0.00 255.0 FORMAT "%5.1" ECU_ADDRESS 0x8FF28F /end MEASUREMENT
/begin MEASUREMENT FrmMng_stGearbxquit_mp "Bestaetigung EGS-Momenteneingriff" UBYTE OneToOne 1 100 0.00 255.0 FORMAT "%5.1" ECU_ADDRESS 0x8FF290 /end MEASUREMENT
/begin MEASUREMENT FrmMng_stGEARBX_DATA2Sig "signalerrorstatus-message GEARBX_DATA2" UWORD OneToOne 1 100 0.00 65535.00 FORMAT "%8.2" ECU_ADDRESS 0x7F8D24 /end MEASUREMENT
/begin MEASUREMENT FrmMng_stGEARBX_DATASig "state of single signals in CAN-message" UWORD OneToOne 1 100 0.00 65535.00 FORMAT "%8.2" ECU_ADDRESS 0x7F8D26 /end MEASUREMENT
/begin MEASUREMENT FrmMng_stHEAT_ACSig "state of single signals in CAN-message" UWORD OneToOne 1 100 0.00 65535.00 FORMAT "%8.2" ECU_ADDRESS 0x7F8D28 /end MEASUREMENT
/begin MEASUREMENT FrmMng_stHtgUp_mp "status for heating up" UBYTE OneToOne 1 100 0.00 255.0 FORMAT "%5.1" ECU_ADDRESS 0x8FF291 /end MEASUREMENT
/begin MEASUREMENT FrmMng_stId2BosRst "" UBYTE OneToOne 1 100 0.00 255.0 FORMAT "%5.1" ECU_ADDRESS 0x7F88BC /end MEASUREMENT
/begin MEASUREMENT FrmMng_stId2RqStgEFan "dienstenachricht um die Anforderung einer elektrolüfterstufe handelt" UBYTE OneToOne 1 100 0.00 255.0 FORMAT "%5.1" ECU_ADDRESS 0x7F88BD /end MEASUREMENT
/begin MEASUREMENT FrmMng_stID2_BOS_RSTG "unit BOS_RESET" UBYTE OneToOne 1 100 0.00 255.0 FORMAT "%5.1" ECU_ADDRESS 0x7F88BB /end MEASUREMENT
/begin MEASUREMENT FrmMng_stIdFktBosRst "" UWORD OneToOne 1 100 0.00 65535.00 FORMAT "%8.2" ECU_ADDRESS 0x7F8D2E /end MEASUREMENT
/begin MEASUREMENT FrmMng_stIdFnRqStgEFan "Das signal gibt den Anforderer der gewünschten Elektrolüfterstufe an" UBYTE OneToOne 1 100 0.00 255.0 FORMAT "%5.1" ECU_ADDRESS 0x7F88BE /end MEASUREMENT
/begin MEASUREMENT FrmMng_stIdlingSpec "increase idling speed" UBYTE OneToOne 1 100 0.00 255.0 FORMAT "%5.1" ECU_ADDRESS 0x7F88BF /end MEASUREMENT
/begin MEASUREMENT FrmMng_stID_FN_BOS_RSTG "unit for witch part is removed" UWORD OneToOne 1 100 0.00 65535.00 FORMAT "%8.2" ECU_ADDRESS 0x7F8D2C /end MEASUREMENT
/begin MEASUREMENT FrmMng_stInjDu "Status of Drehungleichförmigkeit" UBYTE OneToOne 1 100 0.00 255.0 FORMAT "%5.1" ECU_ADDRESS 0x7F88C0 /end MEASUREMENT
/begin MEASUREMENT FrmMng_stKeyVld "Status Schlüssel gültig" UBYTE OneToOne 1 100 0.00 255.0 FORMAT "%5.1" ECU_ADDRESS 0x7F88C1 /end MEASUREMENT
/begin MEASUREMENT FrmMng_stLENKRADWINKELSig "signal error status for LENKRADWINKEL" UWORD OneToOne 1 100 0.00 65535.00 FORMAT "%8.2" ECU_ADDRESS 0x7F8D30 /end MEASUREMENT
/begin MEASUREMENT FrmMng_stLIGov_mp "Status Low idle speed" UBYTE OneToOne 1 100 0.00 255.0 FORMAT "%5.1" ECU_ADDRESS 0x8FF292 /end MEASUREMENT
/begin MEASUREMENT FrmMng_stMILEAGE_RANGESig "signalerrorstatus-message MILEAGE_RANGE" UWORD OneToOne 1 100 0.00 65535.00 FORMAT "%8.2" ECU_ADDRESS 0x7F8D32 /end MEASUREMENT
/begin MEASUREMENT FrmMng_stnErr_mp "Motordrehzahl-Fehler" UBYTE OneToOne 1 100 0.00 255.0 FORMAT "%5.1" ECU_ADDRESS 0x8FF293 /end MEASUREMENT
/begin MEASUREMENT FrmMng_stOBDGbx_mp "Measuring point for Gear Box status" UBYTE OneToOne 1 100 0.00 255.0 FORMAT "%5.1" ECU_ADDRESS 0x8FF294 /end MEASUREMENT
/begin MEASUREMENT FrmMng_stOPCRCTLACCSig "signalerrorstatus-message OP_CRCTLACC" UWORD OneToOne 1 100 0.00 65535.00 FORMAT "%8.2" ECU_ADDRESS 0x7F8D34 /end MEASUREMENT
/begin MEASUREMENT FrmMng_stOpPubuCctrAcc_mp "state operation push-button cruise-control ACC" UBYTE OneToOne 1 100 0.00 255.0 FORMAT "%5.1" ECU_ADDRESS 0x8FF295 /end MEASUREMENT
/begin MEASUREMENT FrmMng_stOvrRun_mp "Status over-run-fuel-shutoff ST_INFS" UBYTE OneToOne 1 100 0.00 255.0 FORMAT "%5.1" ECU_ADDRESS 0x8FF296 /end MEASUREMENT
/begin MEASUREMENT FrmMng_stParkConsumer "status park consumer power managment" UBYTE OneToOne 1 100 0.00 255.0 FORMAT "%5.1" ECU_ADDRESS 0x7F88C7 /end MEASUREMENT
/begin MEASUREMENT FrmMng_stParkConsumerSig "signalerrorstatus-message Park Consumer" UWORD OneToOne 1 100 0.00 65535.00 FORMAT "%8.2" ECU_ADDRESS 0x7F8D3A /end MEASUREMENT
/begin MEASUREMENT FrmMng_stPHtr "status of Heater Temperature" UBYTE OneToOne 1 100 0.00 255.0 FORMAT "%5.1" ECU_ADDRESS 0x7F88C4 /end MEASUREMENT
/begin MEASUREMENT FrmMng_stpmsv_mp "status pmsv" UBYTE OneToOne 1 100 0.00 255.0 FORMAT "%5.1" ECU_ADDRESS 0x8FF297 /end MEASUREMENT
/begin MEASUREMENT FrmMng_stpmsv_old_mp "status pmsv" UBYTE OneToOne 1 100 0.00 255.0 FORMAT "%5.1" ECU_ADDRESS 0x8FF298 /end MEASUREMENT
/begin MEASUREMENT FrmMng_stPrgIntTimeBosRst "" UBYTE OneToOne 1 100 0.00 255.0 FORMAT "%5.1" ECU_ADDRESS 0x7F88C8 /end MEASUREMENT
/begin MEASUREMENT FrmMng_stPrgIntWayBosRst "" UBYTE OneToOne 1 100 0.00 255.0 FORMAT "%5.1" ECU_ADDRESS 0x7F88C9 /end MEASUREMENT
/begin MEASUREMENT FrmMng_stPWRMNG_LOADVSig "signalerrorstatus-message PWRMNG_LOADV" UWORD OneToOne 1 100 0.00 65535.00 FORMAT "%8.2" ECU_ADDRESS 0x7F8D38 /end MEASUREMENT
/begin MEASUREMENT FrmMng_stRecACC "Status ACC Reconigtion" UBYTE OneToOne 1 100 0.00 255.0 FORMAT "%5.1" ECU_ADDRESS 0x7F88CA /end MEASUREMENT
/begin MEASUREMENT FrmMng_stRecAFS "message on CAN used for self recognition of AFS" UBYTE OneToOne 1 100 0.00 255.0 FORMAT "%5.1" ECU_ADDRESS 0x7F88CB /end MEASUREMENT
/begin MEASUREMENT FrmMng_stRecARS "Status of ARS Recognition received over CAN" UBYTE OneToOne 1 100 0.00 255.0 FORMAT "%5.1" ECU_ADDRESS 0x7F88CC /end MEASUREMENT
/begin MEASUREMENT FrmMng_stRecDCC "Status Erkennung Empfang Radmomentanforderung-Botschaft" UBYTE OneToOne 1 100 0.00 255.0 FORMAT "%5.1" ECU_ADDRESS 0x7F88CD /end MEASUREMENT
/begin MEASUREMENT FrmMng_stRecFDC "automatische Erkennung des CAN-Frame VEH_MOD" UBYTE OneToOne 1 100 0.00 255.0 FORMAT "%5.1" ECU_ADDRESS 0x7F88CE /end MEASUREMENT
/begin MEASUREMENT FrmMng_stRecFGR "Status FGR Reconigtion" UBYTE OneToOne 1 100 0.00 255.0 FORMAT "%5.1" ECU_ADDRESS 0x7F88CF /end MEASUREMENT
/begin MEASUREMENT FrmMng_stRMMI_BOS_RSTG "" SWORD OneToOne 1 100 -32768.00 32767.00 FORMAT "%8.2" ECU_ADDRESS 0x7F8D3E /end MEASUREMENT
/begin MEASUREMENT FrmMng_stRmp_mp "current ramp state overrun shutoff" UBYTE OneToOne 1 100 0.00 255.0 FORMAT "%5.1" ECU_ADDRESS 0x8FF299 /end MEASUREMENT
/begin MEASUREMENT FrmMng_stRQ_STG_EFANSig "signalerrorstatus-message RQ_STG_EFAN" UWORD OneToOne 1 100 0.00 65535.00 FORMAT "%8.2" ECU_ADDRESS 0x7F8D40 /end MEASUREMENT
/begin MEASUREMENT FrmMng_stShpsSSG "Status of SSG selection" UBYTE OneToOne 1 100 0.00 255.0 FORMAT "%5.1" ECU_ADDRESS 0x7F88D2 /end MEASUREMENT
/begin MEASUREMENT FrmMng_stShpsSSGOld "Last value of Status of SSG selection" UBYTE OneToOne 1 100 0.00 255.0 FORMAT "%5.1" ECU_ADDRESS 0x7F88D3 /end MEASUREMENT
/begin MEASUREMENT FrmMng_stShutOffHtgUp_mp "Status der Heizung abgestellt" UBYTE OneToOne 1 100 0.00 255.0 FORMAT "%5.1" ECU_ADDRESS 0x8FF29A /end MEASUREMENT
/begin MEASUREMENT FrmMng_stShutOffSSG "Demand for engine stop in case of error" UBYTE OneToOne 1 100 0.00 255.0 FORMAT "%5.1" ECU_ADDRESS 0x7F88D4 /end MEASUREMENT
/begin MEASUREMENT FrmMng_stSITZGURTSig "Signalstatus der STAT_SITZBELEGUNG_GURT-Botschaft" UWORD OneToOne 1 100 0.00 65535.00 FORMAT "%8.2" ECU_ADDRESS 0x7F8D42 /end MEASUREMENT
/begin MEASUREMENT FrmMng_stSLckAdjVal_mp "Adjustment value for status of steering lock" UBYTE OneToOne 1 100 0.00 255.0 FORMAT "%5.1" ECU_ADDRESS 0x8FF29B /end MEASUREMENT
/begin MEASUREMENT FrmMng_stSLck_mp "Status of steering lock" UBYTE OneToOne 1 100 0.00 255.0 FORMAT "%5.1" ECU_ADDRESS 0x8FF29C /end MEASUREMENT
/begin MEASUREMENT FrmMng_stSTAT_ANHSig "" UWORD OneToOne 1 100 0.00 65535.00 FORMAT "%8.2" ECU_ADDRESS 0x7F8D44 /end MEASUREMENT
/begin MEASUREMENT FrmMng_stSTAT_ARSSig "state of single signals in CAN-message" UWORD OneToOne 1 100 0.00 65535.00 FORMAT "%8.2" ECU_ADDRESS 0x7F8D46 /end MEASUREMENT
/begin MEASUREMENT FrmMng_stSTAT_DSCSig "state of single signals in CAN-message" UWORD OneToOne 1 100 0.00 65535.00 FORMAT "%8.2" ECU_ADDRESS 0x7F8D48 /end MEASUREMENT
/begin MEASUREMENT FrmMng_stSTAT_EKPSig "signalerrorstatus-message STAT_EKP" UWORD OneToOne 1 100 0.00 65535.00 FORMAT "%8.2" ECU_ADDRESS 0x7F8D4A /end MEASUREMENT
/begin MEASUREMENT FrmMng_stSTAT_KOMBISig "signalerrorstatus-message STAT_KOMBI" UWORD OneToOne 1 100 0.00 65535.00 FORMAT "%8.2" ECU_ADDRESS 0x7F8D4C /end MEASUREMENT
/begin MEASUREMENT FrmMng_stStiffParameter "Ansprechdynamik Radmoment Antriebsstrang" UBYTE OneToOne 1 100 0.00 255.0 FORMAT "%5.1" ECU_ADDRESS 0x7F88D5 /end MEASUREMENT
/begin MEASUREMENT FrmMng_stSwClt_mp "status of clutch" UBYTE OneToOne 1 100 0.00 255.0 FORMAT "%5.1" ECU_ADDRESS 0x8FF29D /end MEASUREMENT
/begin MEASUREMENT FrmMng_stSwLevRpm_mp "Status switch level RPM ST_SW_LEV_RPM" UBYTE OneToOne 1 100 0.00 255.0 FORMAT "%5.1" ECU_ADDRESS 0x8FF29E /end MEASUREMENT
/begin MEASUREMENT FrmMng_stT15 "Zustand der Klemme 15 über CAN" UBYTE OneToOne 1 100 0.00 255.0 FORMAT "%5.1" ECU_ADDRESS 0x7F88D6 /end MEASUREMENT
/begin MEASUREMENT FrmMng_stT50 "Zustand Klemme 50 vom CAN" UBYTE OneToOne 1 100 0.00 255.0 FORMAT "%5.1" ECU_ADDRESS 0x7F88D7 /end MEASUREMENT
/begin MEASUREMENT FrmMng_stTEMPRELTIMESig "signalerrorstatus-message TEMPRELTIME" UWORD OneToOne 1 100 0.00 65535.00 FORMAT "%8.2" ECU_ADDRESS 0x7F8D4E /end MEASUREMENT
/begin MEASUREMENT FrmMng_stTERMINALSig "state of single signals in CAN-message" UWORD OneToOne 1 100 0.00 65535.00 FORMAT "%8.2" ECU_ADDRESS 0x7F8D50 /end MEASUREMENT
/begin MEASUREMENT FrmMng_stTgMonthBosRst "" UBYTE OneToOne 1 100 0.00 255.0 FORMAT "%5.1" ECU_ADDRESS 0x7F88DA /end MEASUREMENT
/begin MEASUREMENT FrmMng_stTgYearBosRst "" UBYTE OneToOne 1 100 0.00 255.0 FORMAT "%5.1" ECU_ADDRESS 0x7F88DB /end MEASUREMENT
/begin MEASUREMENT FrmMng_stTIME_DATESig "" UWORD OneToOne 1 100 0.00 65535.00 FORMAT "%8.2" ECU_ADDRESS 0x7F8D52 /end MEASUREMENT
/begin MEASUREMENT FrmMng_stTorqTarAFS "status of required torque from AFS" UBYTE OneToOne 1 100 0.00 255.0 FORMAT "%5.1" ECU_ADDRESS 0x7F88DC /end MEASUREMENT
/begin MEASUREMENT FrmMng_stTORQUE_DSCSig "state of single signals in CAN-message" UWORD OneToOne 1 100 0.00 65535.00 FORMAT "%8.2" ECU_ADDRESS 0x7F8D54 /end MEASUREMENT
/begin MEASUREMENT FrmMng_stTORQUE_GEARBXSig "state of single signals in CAN-message" UWORD OneToOne 1 100 0.00 65535.00 FORMAT "%8.2" ECU_ADDRESS 0x7F8D56 /end MEASUREMENT
/begin MEASUREMENT FrmMng_stTRadio "state TRadio" UBYTE OneToOne 1 100 0.00 255.0 FORMAT "%5.1" ECU_ADDRESS 0x7F88D9 /end MEASUREMENT
/begin MEASUREMENT FrmMng_stTrailer "Anhänger Status" UBYTE OneToOne 1 100 0.00 255.0 FORMAT "%5.1" ECU_ADDRESS 0x7F88DD /end MEASUREMENT
/begin MEASUREMENT FrmMng_stTrqDesDSC "type of DSC torque-intervention" UBYTE OneToOne 1 100 0.00 255.0 FORMAT "%5.1" ECU_ADDRESS 0x7F88DE /end MEASUREMENT
/begin MEASUREMENT FrmMng_stTrqDesGearbx "type of gearbox torque-intervention" UBYTE OneToOne 1 100 0.00 255.0 FORMAT "%5.1" ECU_ADDRESS 0x7F88DF /end MEASUREMENT
/begin MEASUREMENT FrmMng_stTrqDisable_mp "state overrun shut off" SBYTE OneToOne 1 100 -128.0 127.0 FORMAT "%5.1" ECU_ADDRESS 0x8FF29F /end MEASUREMENT
/begin MEASUREMENT FrmMng_stTrqInr_mp "Status Drehmoment aktueller Wert" UBYTE OneToOne 1 100 0.00 255.0 FORMAT "%5.1" ECU_ADDRESS 0x8FF2A0 /end MEASUREMENT
/begin MEASUREMENT FrmMng_stTrqLimGearbx "state of torquelimitation for acceleration from standstill" UBYTE OneToOne 1 100 0.00 255.0 FORMAT "%5.1" ECU_ADDRESS 0x7F88E1 /end MEASUREMENT
/begin MEASUREMENT FrmMng_stTxRequest "" UWORD OneToOne 1 100 0.00 65535.00 FORMAT "%8.2" ECU_ADDRESS 0x7F8D5C /end MEASUREMENT
/begin MEASUREMENT FrmMng_stUnitV "Einheit der angez. Geschwindigkeit" UBYTE OneToOne 1 100 0.00 255.0 FORMAT "%5.1" ECU_ADDRESS 0x7F88E2 /end MEASUREMENT
/begin MEASUREMENT FrmMng_stVCom "status der geschwindigkeitsanzeige combi" UBYTE OneToOne 1 100 0.00 255.0 FORMAT "%5.1" ECU_ADDRESS 0x7F88E3 /end MEASUREMENT
/begin MEASUREMENT FrmMng_stVEH_MODSig "signalerrorstatus-message VEH_MOD" UWORD OneToOne 1 100 0.00 65535.00 FORMAT "%8.2" ECU_ADDRESS 0x7F8D5E /end MEASUREMENT
/begin MEASUREMENT FrmMng_stVELOCITYSig "state of single signals in CAN-message" UWORD OneToOne 1 100 0.00 65535.00 FORMAT "%8.2" ECU_ADDRESS 0x7F8D60 /end MEASUREMENT
/begin MEASUREMENT FrmMng_stWghSeatDr "Klasse Gewicht Sitz Fahrer" UBYTE OneToOne 1 100 0.00 255.0 FORMAT "%5.1" ECU_ADDRESS 0x7F88E4 /end MEASUREMENT
/begin MEASUREMENT FrmMng_stWHEEL_SPEEDSig_mp "Signalfehler der Can Botschaft Wheel Speed" UWORD OneToOne 1 100 0.00 65535.00 FORMAT "%8.2" ECU_ADDRESS 0x8FF2A2 /end MEASUREMENT
/begin MEASUREMENT FrmMng_swtAC_mp "Schalter Klimakompressor" UBYTE OneToOne 1 100 0.00 255.0 FORMAT "%5.1" ECU_ADDRESS 0x6F816C /end MEASUREMENT
/begin MEASUREMENT FrmMng_swtCarType "" UBYTE CarType 1 100 0.00 4.00000000000 FORMAT "%13.11" ECU_ADDRESS 0x7F88E5 /end MEASUREMENT
/begin MEASUREMENT FrmMng_swtPSPOff "Botschaft für CTR_CRASH_SWO_EKP CAN signal" UBYTE OneToOne 1 100 0.00 255.0 FORMAT "%5.1" ECU_ADDRESS 0x7F88E6 /end MEASUREMENT
/begin MEASUREMENT FrmMng_swtPSPOffSig_mp "Botschaftsstatus für CTR_CRASH_SWO_EKP Botschaft" UWORD OneToOne 1 100 0.00 65535.00 FORMAT "%8.2" ECU_ADDRESS 0x8FF2A4 /end MEASUREMENT
/begin MEASUREMENT FrmMng_swtPSPOff_byte0_mp "Rohwert von CTR_CRASH_SWO_EKP signal" UBYTE OneToOne 1 100 0.00 255.0 FORMAT "%5.1" ECU_ADDRESS 0x8FF2A6 /end MEASUREMENT
/begin MEASUREMENT FrmMng_tEngRpm_mp "temperature adjusted to a resolution of  approx. 1 deg C  for engine rpm calculation" SWORD Temp_Cels 1 100 -50.140 899.860 FORMAT "%8.3" ECU_ADDRESS 0x8FF2A8 /end MEASUREMENT
/begin MEASUREMENT FrmMng_tiRecACC_mp "Time elapsed for the self recognition of ACC" UWORD Time_ms 1 100 0.00 655350.0 FORMAT "%8.1" ECU_ADDRESS 0x8FF2AA /end MEASUREMENT
/begin MEASUREMENT FrmMng_tiRecAC_mp "" UWORD Time_ms 1 100 0.00 655350.0 FORMAT "%8.1" ECU_ADDRESS 0x8FF2AC /end MEASUREMENT
/begin MEASUREMENT FrmMng_tiRecAFS_mp "Time elapsed for the self recognition of AFS" UWORD Time_ms 1 100 0.00 655350.0 FORMAT "%8.1" ECU_ADDRESS 0x8FF2AE /end MEASUREMENT
/begin MEASUREMENT FrmMng_tiRecARS_mp "Error Counter for ARS recognition" UBYTE Time_ms 1 100 0.00 2550. FORMAT "%5.0" ECU_ADDRESS 0x8FF2B0 /end MEASUREMENT
/begin MEASUREMENT FrmMng_tiRecDCC_mp "Zeitfenster für Erkennung Empfang Radmomentanforderung-Botschaft" UWORD Time_ms 1 100 0.00 655350.0 FORMAT "%8.1" ECU_ADDRESS 0x8FF2B2 /end MEASUREMENT
/begin MEASUREMENT FrmMng_tiRecFGR_mp "Time elapsed for the self recognition of FGR" UWORD Time_ms 1 100 0.00 655350.0 FORMAT "%8.1" ECU_ADDRESS 0x8FF2B4 /end MEASUREMENT
/begin MEASUREMENT FrmMng_tmrDSMFadeoutANFRADMOMPT_mp "" UWORD OneToOne 1 100 0.00 65535.00 FORMAT "%8.2" ECU_ADDRESS 0x8FF2B6 /end MEASUREMENT
/begin MEASUREMENT FrmMng_tmrDSMFadeoutTERMINAL_mp "Timer for measuring Fadeout of TERMINAL frame" UWORD OneToOne 1 100 0.00 65535.00 FORMAT "%8.2" ECU_ADDRESS 0x8FF2B8 /end MEASUREMENT
/begin MEASUREMENT FrmMng_tmrDSMToTERMINAL_mp "Timer for measuring Timeout of TERMINAL frame" UWORD OneToOne 1 100 0.00 65535.00 FORMAT "%8.2" ECU_ADDRESS 0x8FF2BA /end MEASUREMENT
/begin MEASUREMENT FrmMng_tOil "Öltemperatur" SWORD Temp_Cels 1 100 -50.140 899.860 FORMAT "%8.3" ECU_ADDRESS 0x7F8D6A /end MEASUREMENT
/begin MEASUREMENT FrmMng_torque1RetVal_mp "" UBYTE OneToOne 1 100 0.00 255.0 FORMAT "%5.1" ECU_ADDRESS 0x8FF2BC /end MEASUREMENT
/begin MEASUREMENT FrmMng_torque2RetVal_mp "" UBYTE OneToOne 1 100 0.00 255.0 FORMAT "%5.1" ECU_ADDRESS 0x8FF2BD /end MEASUREMENT
/begin MEASUREMENT FrmMng_torque3RetVal_mp "" UBYTE OneToOne 1 100 0.00 255.0 FORMAT "%5.1" ECU_ADDRESS 0x8FF2BE /end MEASUREMENT
/begin MEASUREMENT FrmMng_trqAC "Aktuelles Klimakompressormoment" SWORD Trq 1 100 -3276.800 3276.700 FORMAT "%8.3" ECU_ADDRESS 0x7F8D6E /end MEASUREMENT
/begin MEASUREMENT FrmMng_trqACC_TrqDes "Torque request-message DREHMOMENT_ANF_ACC" SWORD Trq 1 100 -3276.800 3276.700 FORMAT "%8.3" ECU_ADDRESS 0x7F8D70 /end MEASUREMENT
/begin MEASUREMENT FrmMng_trqACC_TrqDes_mp "Angefordertes ACC-Moment vor Hinzufügung von Gearbx_trqFrc" SWORD Trq 1 100 -3276.800 3276.700 FORMAT "%8.3" ECU_ADDRESS 0x8FF2C0 /end MEASUREMENT
/begin MEASUREMENT FrmMng_trqARSCur "current torque ARS" SWORD TrqPrp 1 100 -6553.600 6553.400 FORMAT "%8.3" ECU_ADDRESS 0x7F8D72 /end MEASUREMENT
/begin MEASUREMENT FrmMng_trqARSDes "desired torque ARS" SWORD TrqPrp 1 100 -6553.600 6553.400 FORMAT "%8.3" ECU_ADDRESS 0x7F8D74 /end MEASUREMENT
/begin MEASUREMENT FrmMng_trqARSInc "Momentenerhöhender Eingriff, Schaltung" SWORD TrqPrp 1 100 -6553.600 6553.400 FORMAT "%8.3" ECU_ADDRESS 0x7F8D76 /end MEASUREMENT
/begin MEASUREMENT FrmMng_trqAvlAFS "Required torque from AFS" SWORD Trq 1 100 -3276.800 3276.700 FORMAT "%8.3" ECU_ADDRESS 0x7F8D78 /end MEASUREMENT
/begin MEASUREMENT FrmMng_trqBefRmp_mp "current inner set torque before overrun shut off" SWORD Trq 1 100 -3276.800 3276.700 FORMAT "%8.3" ECU_ADDRESS 0x8FF2C2 /end MEASUREMENT
/begin MEASUREMENT FrmMng_trqDesDCC "Radmoment Antriebsstrang Soll" SWORD TrqPrp 1 100 -6553.600 6553.400 FORMAT "%8.3" ECU_ADDRESS 0x7F8D82 /end MEASUREMENT
/begin MEASUREMENT FrmMng_trqDes_mp "Driver request torque for CAN [Nm] <SBYTE>" SWORD Trq 1 100 -3276.800 3276.700 FORMAT "%8.3" ECU_ADDRESS 0x8FF2C4 /end MEASUREMENT
/begin MEASUREMENT FrmMng_trqDSCDec "verringernder Momenteneingriff, DSC" SWORD Trq 1 100 -3276.800 3276.700 FORMAT "%8.3" ECU_ADDRESS 0x7F8D7C /end MEASUREMENT
/begin MEASUREMENT FrmMng_trqDSCDes "desired torque DSC" SWORD Trq 1 100 -3276.800 3276.700 FORMAT "%8.3" ECU_ADDRESS 0x7F8D7E /end MEASUREMENT
/begin MEASUREMENT FrmMng_trqDSCDes_mp "Drehmoment Soll DSC vor Hinzufügung von Gearbx_trqFrc" SWORD Trq 1 100 -3276.800 3276.700 FORMAT "%8.3" ECU_ADDRESS 0x8FF2C6 /end MEASUREMENT
/begin MEASUREMENT FrmMng_trqDSCInc "erhöhender Momenteneingriff, DSC" SWORD Trq 1 100 -3276.800 3276.700 FORMAT "%8.3" ECU_ADDRESS 0x7F8D80 /end MEASUREMENT
/begin MEASUREMENT FrmMng_trqFMTCInr_mp "Incremental torque" SWORD Trq 1 100 -3276.800 3276.700 FORMAT "%8.3" ECU_ADDRESS 0x8FF2C8 /end MEASUREMENT
/begin MEASUREMENT FrmMng_trqGbx_mp "Engine torque without MMT" SWORD Trq 1 100 -3276.800 3276.700 FORMAT "%8.3" ECU_ADDRESS 0x8FF2CA /end MEASUREMENT
/begin MEASUREMENT FrmMng_trqGearbxDec "reduzierender Momenteneingriff des Getriebes aus Can" SWORD Trq 1 100 -3276.800 3276.700 FORMAT "%8.3" ECU_ADDRESS 0x7F8D88 /end MEASUREMENT
/begin MEASUREMENT FrmMng_trqGearbxDes "desired torque by gearbox" SWORD Trq 1 100 -3276.800 3276.700 FORMAT "%8.3" ECU_ADDRESS 0x7F8D8A /end MEASUREMENT
/begin MEASUREMENT FrmMng_trqGearbxFrc "Momentenaufnahme des Getriebe" SWORD Trq 1 100 -3276.800 3276.700 FORMAT "%8.3" ECU_ADDRESS 0x7F8D8C /end MEASUREMENT
/begin MEASUREMENT FrmMng_trqGearbxInc "erhöhender Momenteneingriff des Getriebes aus CAN" SWORD Trq 1 100 -3276.800 3276.700 FORMAT "%8.3" ECU_ADDRESS 0x7F8D8E /end MEASUREMENT
/begin MEASUREMENT FrmMng_trqGearbxMax "maximum torque Gearbox" SWORD Trq 1 100 -3276.800 3276.700 FORMAT "%8.3" ECU_ADDRESS 0x7F8D90 /end MEASUREMENT
/begin MEASUREMENT FrmMng_trqGearbxMax_mp "maximum Gear Box torque" SWORD Trq 1 100 -3276.800 3276.700 FORMAT "%8.3" ECU_ADDRESS 0x8FF2CC /end MEASUREMENT
/begin MEASUREMENT FrmMng_trqInr "Increased torque demand though Frame Manager" SWORD Trq 1 100 -3276.800 3276.700 FORMAT "%8.3" ECU_ADDRESS 0x7F8D92 /end MEASUREMENT
/begin MEASUREMENT FrmMng_trqInrGearbxOut_mp "Kurbelwellen-Drehmoment ohne EGS-Engriff" SWORD Trq 1 100 -3276.800 3276.700 FORMAT "%8.3" ECU_ADDRESS 0x8FF2CE /end MEASUREMENT
/begin MEASUREMENT FrmMng_trqInrSet_mp "output torque value" SWORD Trq 1 100 -3276.800 3276.700 FORMAT "%8.3" ECU_ADDRESS 0x8FF2D0 /end MEASUREMENT
/begin MEASUREMENT FrmMng_trqMax_mp "Normiertes und begrenztes maximales Motormoment" SWORD Trq 1 100 -3276.800 3276.700 FORMAT "%8.3" ECU_ADDRESS 0x8FF2D2 /end MEASUREMENT
/begin MEASUREMENT FrmMng_trqMin_mp "Normiertes und begrenztes minimales Motormoment" SWORD Trq 1 100 -3276.800 3276.700 FORMAT "%8.3" ECU_ADDRESS 0x8FF2D4 /end MEASUREMENT
/begin MEASUREMENT FrmMng_trqResPos_mp "torque actual-value spare positive" SWORD Trq 1 100 -3276.800 3276.700 FORMAT "%8.3" ECU_ADDRESS 0x8FF2D6 /end MEASUREMENT
/begin MEASUREMENT FrmMng_trqRmp_mp "current ramp output torque" SWORD Trq 1 100 -3276.800 3276.700 FORMAT "%8.3" ECU_ADDRESS 0x8FF2D8 /end MEASUREMENT
/begin MEASUREMENT FrmMng_trqSet_mp "Torque setpoint value" SWORD Trq 1 100 -3276.800 3276.700 FORMAT "%8.3" ECU_ADDRESS 0x8FF2DA /end MEASUREMENT
/begin MEASUREMENT FrmMng_trqTarAFS "Requested torque from AFS" SWORD Trq 1 100 -3276.800 3276.700 FORMAT "%8.3" ECU_ADDRESS 0x7F8D9A /end MEASUREMENT
/begin MEASUREMENT FrmMng_trqWheelMax_mp "Radmoment Antriebsstrang Maximal" SWORD TrqPrp 1 100 -6553.600 6553.400 FORMAT "%8.3" ECU_ADDRESS 0x8FF2DC /end MEASUREMENT
/begin MEASUREMENT FrmMng_trqWheelMin_mp "Radmoment Antriebsstrang Minimal" SWORD TrqPrp 1 100 -6553.600 6553.400 FORMAT "%8.3" ECU_ADDRESS 0x8FF2DE /end MEASUREMENT
/begin MEASUREMENT FrmMng_trqWheelRmp_mp "Aktuelles Radmoment vor Grip Rampenschalter" SWORD TrqPrp 1 100 -6553.600 6553.400 FORMAT "%8.3" ECU_ADDRESS 0x8FF2E0 /end MEASUREMENT
/begin MEASUREMENT FrmMng_trqWheel_mp "Meßpunkt für Radmoment" SWORD TrqPrp 1 100 -6553.600 6553.400 FORMAT "%8.3" ECU_ADDRESS 0x8FF2E2 /end MEASUREMENT
/begin MEASUREMENT FrmMng_uAltTarget "target voltage alternator" UWORD UC_Volt 1 100 0.00 6553.500 FORMAT "%8.3" ECU_ADDRESS 0x7F8D9C /end MEASUREMENT
/begin MEASUREMENT FrmMng_v "Fahrzeuggeschwindigkeit über CAN" SWORD Vel 1 100 -327.6800 327.6700 FORMAT "%8.4" ECU_ADDRESS 0x7F8D9E /end MEASUREMENT
/begin MEASUREMENT FrmMng_vDirection "" SWORD Vel 1 100 -327.6800 327.6700 FORMAT "%8.4" ECU_ADDRESS 0x7F8DA0 /end MEASUREMENT
/begin MEASUREMENT FrmMng_vDisp "angez. Geschwindigkeit" SWORD Vel 1 100 -327.6800 327.6700 FORMAT "%8.4" ECU_ADDRESS 0x7F8DA2 /end MEASUREMENT
/begin MEASUREMENT FrmMng_volFuelFil "Tankfüllstand" UWORD Fl_Half_L 1 100 0.00 3276.750 FORMAT "%8.3" ECU_ADDRESS 0x7F8DB2 /end MEASUREMENT
/begin MEASUREMENT FrmMng_vWheelLB "Geschwindigkeit des linken hinteren Rades" SWORD Vel 1 100 -327.6800 327.6700 FORMAT "%8.4" ECU_ADDRESS 0x7F8DAA /end MEASUREMENT
/begin MEASUREMENT FrmMng_vWheelLF "Meßpunkt Radgeschwindigkeit links vorne" SWORD Vel 1 100 -327.6800 327.6700 FORMAT "%8.4" ECU_ADDRESS 0x7F8DAC /end MEASUREMENT
/begin MEASUREMENT FrmMng_vWheelRB "Geschwindigkeit des rechten hintern Rades" SWORD Vel 1 100 -327.6800 327.6700 FORMAT "%8.4" ECU_ADDRESS 0x7F8DAE /end MEASUREMENT
/begin MEASUREMENT FrmMng_vWheelRF "Meßpunkt Radgeschwindigkeit rechts vorne" SWORD Vel 1 100 -327.6800 327.6700 FORMAT "%8.4" ECU_ADDRESS 0x7F8DB0 /end MEASUREMENT
/begin MEASUREMENT FTSCD_tFuel "Kraftstofftemperatur" SWORD Temp_Cels 1 100 -50.140 899.860 FORMAT "%8.3" ECU_ADDRESS 0x7F8CD2 /end MEASUREMENT
/begin MEASUREMENT FTSCD_tFuelLin "linearisierter Wert der Kraftstoffstemperatur" SWORD Temp_Cels 1 100 -50.140 899.860 FORMAT "%8.3" ECU_ADDRESS 0x7F8CD4 /end MEASUREMENT
/begin MEASUREMENT FTSCD_uRaw "Spannungsrohwert der Kraftstoffstemperatur" SWORD Volt 1 100 -160156.4 160151.5 FORMAT "%8.1" ECU_ADDRESS 0x7F8CD6 /end MEASUREMENT
/begin MEASUREMENT Gearbx_amAct_mp "Aktueller Integrationswert des Momentenüberschußintegrals" SWORD TrqDT 1 100 -32768.00 32767.00 FORMAT "%8.2" ECU_ADDRESS 0x8FF2E6 /end MEASUREMENT
/begin MEASUREMENT Gearbx_dtrqLimUp_mp "DrehkraftRampe Herauf Steigung" ULONG RmpTrq 1 100 0.00 6553599.99847 FORMAT "%13.5" ECU_ADDRESS 0x8FF2F4 /end MEASUREMENT
/begin MEASUREMENT Gearbx_nMin "LL_Solldrehzahlanforderung durch Getriebe2 Botschaft" SWORD EngN 1 100 -32768.00 32767.00 FORMAT "%8.2" ECU_ADDRESS 0x7F8DB4 /end MEASUREMENT
/begin MEASUREMENT Gearbx_nMinRaw_mp "Low Idel speed Raw value depending on Gear state and FrmMng_nTSC" SWORD EngN 1 100 -32768.00 32767.00 FORMAT "%8.2" ECU_ADDRESS 0x8FF2E4 /end MEASUREMENT
/begin MEASUREMENT Gearbx_numGearDes "erkannter Zielgang" SBYTE OneToOne 1 100 -128.0 127.0 FORMAT "%5.1" ECU_ADDRESS 0x7F88EA /end MEASUREMENT
/begin MEASUREMENT Gearbx_numGearFast "erkannter schneller Getriebegang" SBYTE OneToOne 1 100 -128.0 127.0 FORMAT "%5.1" ECU_ADDRESS 0x7F88EB /end MEASUREMENT
/begin MEASUREMENT Gearbx_rTrans "Getriebeübersetzung" SWORD TransR 1 100 -327.6800 327.6700 FORMAT "%8.4" ECU_ADDRESS 0x7F8DB6 /end MEASUREMENT
/begin MEASUREMENT Gearbx_rTrans1 "gearbxübergangsverhältnis" SWORD TransR 1 100 -327.6800 327.6700 FORMAT "%8.4" ECU_ADDRESS 0x7F8DB8 /end MEASUREMENT
/begin MEASUREMENT Gearbx_rTrans2 "gearbxübergangsverhältnis2" SWORD TransR 1 100 -327.6800 327.6700 FORMAT "%8.4" ECU_ADDRESS 0x7F8DBA /end MEASUREMENT
/begin MEASUREMENT Gearbx_rTrans3 "gearbxübergangsverhältnis3" SWORD TransR 1 100 -327.6800 327.6700 FORMAT "%8.4" ECU_ADDRESS 0x7F8DBC /end MEASUREMENT
/begin MEASUREMENT Gearbx_rTrans4 "gearbxübergangsverhältnis 4" SWORD TransR 1 100 -327.6800 327.6700 FORMAT "%8.4" ECU_ADDRESS 0x7F8DBE /end MEASUREMENT
/begin MEASUREMENT Gearbx_rTrans5 "gearbxübergangsverhältnis 5" SWORD TransR 1 100 -327.6800 327.6700 FORMAT "%8.4" ECU_ADDRESS 0x7F8DC0 /end MEASUREMENT
/begin MEASUREMENT Gearbx_rTrans6 "" SWORD TransR 1 100 -327.6800 327.6700 FORMAT "%8.4" ECU_ADDRESS 0x7F8DC2 /end MEASUREMENT
/begin MEASUREMENT Gearbx_stDemUnplaus "Entprellter Status des Momentenüberschußintegrals" UBYTE OneToOne 1 100 0.00 255.0 FORMAT "%5.1" ECU_ADDRESS 0x7F88EC /end MEASUREMENT
/begin MEASUREMENT Gearbx_stDrvAway_mp "Status der Anfahrmomentbegrenzung" UBYTE OneToOne 1 100 0.00 255.0 FORMAT "%5.1" ECU_ADDRESS 0x8FF2F8 /end MEASUREMENT
/begin MEASUREMENT Gearbx_stGbxIncMax_mp "Status des Momentenüberschußintegrals" UBYTE OneToOne 1 100 0.00 255.0 FORMAT "%5.1" ECU_ADDRESS 0x8FF2E8 /end MEASUREMENT
/begin MEASUREMENT Gearbx_stGear "Ganginformation" SBYTE OneToOne 1 100 -128.0 127.0 FORMAT "%5.1" ECU_ADDRESS 0x7F88ED /end MEASUREMENT
/begin MEASUREMENT Gearbx_stGearBit "" UBYTE OneToOne 1 100 0.00 255.0 FORMAT "%5.1" ECU_ADDRESS 0x7F88EE /end MEASUREMENT
/begin MEASUREMENT Gearbx_stIntv_mp "Status der Defekt- und Heilungsrampe vom Getriebewunschmoment" UBYTE OneToOne 1 100 0.00 255.0 FORMAT "%5.1" ECU_ADDRESS 0x8FF2EC /end MEASUREMENT
/begin MEASUREMENT Gearbx_stStrtMotRls "Anlasserfreigabezustand vom Getriebe" UBYTE OneToOne 1 100 0.00 255.0 FORMAT "%5.1" ECU_ADDRESS 0x7F88EF /end MEASUREMENT
/begin MEASUREMENT Gearbx_swtType "Getriebetyp (0: manuell(MT); 1: automatisch(AT); 2: Schaltautomatisch(AST); 3: StufenlosesGetriebe (CVT); 4:automatic Z-Car)" UBYTE OneToOne 1 100 0.00 3.000 FORMAT "%5.3" ECU_ADDRESS 0x7F88F0 /end MEASUREMENT
/begin MEASUREMENT Gearbx_tOil "Gearbox oil temperature" SWORD Temp_Cels 1 100 -50.140 899.860 FORMAT "%8.3" ECU_ADDRESS 0x7F8DC4 /end MEASUREMENT
/begin MEASUREMENT Gearbx_trqDec "erniedrigender Momenteneingriff vom Getriebe" SWORD Trq 1 100 -500.0000 1000.000 FORMAT "%8.3" ECU_ADDRESS 0x7F8DC6 /end MEASUREMENT
/begin MEASUREMENT Gearbx_trqDecRaw_mp "Ersatzwert für das reduzierende Getriebemoment" SWORD Trq 1 100 -3276.800 3276.700 FORMAT "%8.3" ECU_ADDRESS 0x8FF2EE /end MEASUREMENT
/begin MEASUREMENT Gearbx_trqFrc "aktuelles Verlustmoment Getriebe" SWORD Trq 1 100 -500.0000 1000.000 FORMAT "%8.3" ECU_ADDRESS 0x7F8DC8 /end MEASUREMENT
/begin MEASUREMENT Gearbx_trqInc "erhöhender Momenteneingriff vom Getriebe" SWORD Trq 1 100 -500.0000 1000.000 FORMAT "%8.3" ECU_ADDRESS 0x7F8DCC /end MEASUREMENT
/begin MEASUREMENT Gearbx_trqIncRaw_mp "Ersatzwert für das erhöhende Getriebemoment" SWORD Trq 1 100 -3276.800 3276.700 FORMAT "%8.3" ECU_ADDRESS 0x8FF2F0 /end MEASUREMENT
/begin MEASUREMENT Gearbx_trqInMax "maximales Getriebeeingangsmoment" SWORD Trq 1 100 -500.0000 1000.000 FORMAT "%8.3" ECU_ADDRESS 0x7F8DCA /end MEASUREMENT
/begin MEASUREMENT Gearbx_trqInt_mp "Aktuelles  Integrationsmoment des Momentenüberschußintegrals" SWORD Trq 1 100 -3276.800 3276.700 FORMAT "%8.3" ECU_ADDRESS 0x8FF2EA /end MEASUREMENT
/begin MEASUREMENT Gearbx_trqLimDrvAway_mp "Begrenztes Anfahrmoment" SWORD Trq 1 100 -3276.800 3276.700 FORMAT "%8.3" ECU_ADDRESS 0x8FF2FA /end MEASUREMENT
/begin MEASUREMENT Gearbx_trqMaxCur_mp "maximales Getriebeeingangsmoment aus Kennlinie" SWORD Trq 1 100 -3276.800 3276.700 FORMAT "%8.3" ECU_ADDRESS 0x8FF2FC /end MEASUREMENT
/begin MEASUREMENT GearCD_stPN "Status Getriebe in PN-Stellung" UBYTE OneToOne 1 100 0.00 255.0 FORMAT "%5.1" ECU_ADDRESS 0x7F88E7 /end MEASUREMENT
/begin MEASUREMENT GearCD_stPNCon_mp "Zustand Bedingungen PN-Erkennung" UBYTE OneToOne 1 100 0.00 255.0 FORMAT "%5.1" ECU_ADDRESS 0x8FF2FE /end MEASUREMENT
/begin MEASUREMENT GearCD_stPNRawVal "Rohwert PN_Signal" UBYTE OneToOne 1 100 0.00 255.0 FORMAT "%5.1" ECU_ADDRESS 0x7F88E8 /end MEASUREMENT
/begin MEASUREMENT GearCD_swtPNSig "Schalterstellung PN_signal v. CAN od. HW" UBYTE OneToOne 1 100 0.00 255.0 FORMAT "%5.1" ECU_ADDRESS 0x7F88E9 /end MEASUREMENT
/begin MEASUREMENT GlwCD_BufLev_mp "buffer status" SWORD OneToOne 1 100 -32768.00 32767.00 FORMAT "%8.2" ECU_ADDRESS 0x8FF300 /end MEASUREMENT
/begin MEASUREMENT GlwCD_CtlState_mp "Wert auf Identifier 1 des Glühsteuergerätes" UBYTE OneToOne 1 100 0.00 255.0 FORMAT "%5.1" ECU_ADDRESS 0x8FF302 /end MEASUREMENT
/begin MEASUREMENT GlwCD_ErrBank1_mp "Wert auf Identifier 3 des Glühsteuergeräts" UBYTE OneToOne 1 100 0.00 255.0 FORMAT "%5.1" ECU_ADDRESS 0x8FF303 /end MEASUREMENT
/begin MEASUREMENT GlwCD_ErrPwr_mp "Wert auf Identifier 2 des Glühsteuergeräts" UBYTE OneToOne 1 100 0.00 255.0 FORMAT "%5.1" ECU_ADDRESS 0x8FF304 /end MEASUREMENT
/begin MEASUREMENT GlwCD_OtherReg_mp "Glow controller value" UWORD OneToOne 1 100 0.00 65535.00 FORMAT "%8.2" ECU_ADDRESS 0x8FF306 /end MEASUREMENT
/begin MEASUREMENT GlwCD_Parity_mp "error status" UWORD OneToOne 1 100 0.00 65535.00 FORMAT "%8.2" ECU_ADDRESS 0x8FF308 /end MEASUREMENT
/begin MEASUREMENT GlwCD_pwrGlw "power consumption of the glow-plugs (readback value from glow control unit)" UWORD Pwr_HiRes 1 100 0.00 32767.50 FORMAT "%8.2" ECU_ADDRESS 0x7F8DCE /end MEASUREMENT
/begin MEASUREMENT GlwCD_RawVal_mp "Rohwert für das Glühanforderungsregister des Glühcontrollers" UBYTE OneToOne 1 100 0.00 255.0 FORMAT "%5.1" ECU_ADDRESS 0x6F816D /end MEASUREMENT
/begin MEASUREMENT GlwCD_Reset_mp "communication error" UWORD OneToOne 1 100 0.00 65535.00 FORMAT "%8.2" ECU_ADDRESS 0x8FF30A /end MEASUREMENT
/begin MEASUREMENT GlwCD_stCtl_mp "Steuerstatus des Glühsteuergeraet - Zustandsautomaten (aktueller Gluehzustand bei Gluehen ueber BSD)" UWORD OneToOne 1 100 0.00 65535.00 FORMAT "%8.2" ECU_ADDRESS 0x8FF30C /end MEASUREMENT
/begin MEASUREMENT GlwCD_stState_mp "Status des BSD Gluehschnittstelle - Zustandsautomaten (Verbindungsstatus)" UWORD OneToOne 1 100 0.00 65535.00 FORMAT "%8.2" ECU_ADDRESS 0x8FF30E /end MEASUREMENT
/begin MEASUREMENT GlwCtl_ctPreGlw_mp "Counter for pre-glow without engine start" UBYTE OneToOne 1 100 0.00 255.0 FORMAT "%5.1" ECU_ADDRESS 0x8FF316 /end MEASUREMENT
/begin MEASUREMENT GlwCtl_rLimitRaw_mp "Messpunkt für Rohwert-Limit für Glühanforderung" SWORD OneToOne 1 100 -32768.00 32767.00 FORMAT "%8.2" ECU_ADDRESS 0x8FF310 /end MEASUREMENT
/begin MEASUREMENT GlwCtl_rLimit_mp "Messpunkt für oberes Limit der Glühanforderun" SWORD OneToOne 1 100 -32768.00 32767.00 FORMAT "%8.2" ECU_ADDRESS 0x8FF312 /end MEASUREMENT
/begin MEASUREMENT GlwCtl_rPwrOut "Glühanforderung" UBYTE OneToOne 1 100 0.00 255.0 FORMAT "%5.1" ECU_ADDRESS 0x7F88F1 /end MEASUREMENT
/begin MEASUREMENT GlwCtl_rRaw_mp "Messpunkt für Glühanforderung Rohwert" SWORD OneToOne 1 100 -32768.00 32767.00 FORMAT "%8.2" ECU_ADDRESS 0x8FF314 /end MEASUREMENT
/begin MEASUREMENT GlwCtl_stHdnPreGlwOld_mp "Zustandsbits der Triggerbedingungen vorher" UBYTE OneToOne 1 100 0.00 255.0 FORMAT "%5.1" ECU_ADDRESS 0x8FF317 /end MEASUREMENT
/begin MEASUREMENT GlwCtl_stHdnPreGlwTrg_mp "positive Flankenerkennung der Triggerbedingungen" UBYTE OneToOne 1 100 0.00 255.0 FORMAT "%5.1" ECU_ADDRESS 0x8FF318 /end MEASUREMENT
/begin MEASUREMENT GlwCtl_stHdnPreGlw_mp "Zustandsbits der Triggerbedingungen" UBYTE OneToOne 1 100 0.00 255.0 FORMAT "%5.1" ECU_ADDRESS 0x8FF319 /end MEASUREMENT
/begin MEASUREMENT GlwCtl_stLampCond_mp "Bedingungen für Ansteuerung Glühanzeige" UBYTE OneToOne 1 100 0.00 255.0 FORMAT "%5.1" ECU_ADDRESS 0x8FF31E /end MEASUREMENT
/begin MEASUREMENT GlwCtl_stLampEna "Aktivierungsbedingung Glühanzeige" UBYTE OneToOne 1 100 0.00 255.0 FORMAT "%5.1" ECU_ADDRESS 0x7F88F2 /end MEASUREMENT
/begin MEASUREMENT GlwCtl_stLampOut "Zustand der Glühanzeige" UBYTE OneToOne 1 100 0.00 255.0 FORMAT "%5.1" ECU_ADDRESS 0x7F88F3 /end MEASUREMENT
/begin MEASUREMENT GlwCtl_stLogic "aktueller Zustand der Glühzeitsteuerung" UWORD OneToOne 1 100 0.00 65535.00 FORMAT "%8.2" ECU_ADDRESS 0x7F8DD0 /end MEASUREMENT
/begin MEASUREMENT GlwCtl_stLogicCond_mp "Zustandsbits der Triggerbedingungen" UBYTE OneToOne 1 100 0.00 255.0 FORMAT "%5.1" ECU_ADDRESS 0x8FF31A /end MEASUREMENT
/begin MEASUREMENT GlwCtl_stStrtMFlag_mp "Zustandsflag, altes BN-Glühen aktiv" UBYTE OneToOne 1 100 0.00 255.0 FORMAT "%5.1" ECU_ADDRESS 0x8FF31B /end MEASUREMENT
/begin MEASUREMENT GlwCtl_tClnt "Kühlmitteltemperatur für interne Verwendung der Glühzeitsteuerung" SWORD Temp_Cels 1 100 -50.140 899.860 FORMAT "%8.3" ECU_ADDRESS 0x7F8DD2 /end MEASUREMENT
/begin MEASUREMENT GlwCtl_tiLamp_mp "Einschaltdauer Glühanzeige" SWORD Time_ms 1 100 -327680.0 327670.0 FORMAT "%8.1" ECU_ADDRESS 0x8FF320 /end MEASUREMENT
/begin MEASUREMENT GlwCtl_tiPre_mp "Nachglühzeit" UWORD Time_ms 1 100 0.00 655350.0 FORMAT "%8.1" ECU_ADDRESS 0x8FF31C /end MEASUREMENT
/begin MEASUREMENT HPUn_dvolPmpMaxCor_mp "Wirkungsgrad korrigiertes physikalisches Maximum des Volumenstroms einer Hochdruckpumpe" SWORD Qp_mm3_sec 1 100 -327680.0 327670.0 FORMAT "%8.1" ECU_ADDRESS 0x8FF322 /end MEASUREMENT
/begin MEASUREMENT HPUn_dvolPmpMax_mp "Physikalisches Maximum des Volumenstroms einer Hochdruckpumpe" SWORD Qp_mm3_sec 1 100 -327680.0 327670.0 FORMAT "%8.1" ECU_ADDRESS 0x8FF324 /end MEASUREMENT
/begin MEASUREMENT HPUn_etaPmpFlTemp_mp "Kraftstofftemperaturabhängiger Wirkungsgrad der Hochdruckpumpe" SWORD Eta 1 100 -256.0000 255.9922 FORMAT "%8.4" ECU_ADDRESS 0x8FF326 /end MEASUREMENT
/begin MEASUREMENT HPUn_etaPmpMaxAged_mp "maximaler Wirkungsgrad einer gealterten Hochdruckpumpe" SWORD Eta 1 100 -256.0000 255.9922 FORMAT "%8.4" ECU_ADDRESS 0x8FF328 /end MEASUREMENT
/begin MEASUREMENT HPUn_numInjQntBal "Maximale Anzahl an Einspritzungen aufgrund der Mengenbilanz der Hochdruckpumpe" UBYTE OneToOne 1 100 0.00 255.0 FORMAT "%5.1" ECU_ADDRESS 0x7F88F4 /end MEASUREMENT
/begin MEASUREMENT HPUn_pRailDvtFlt_mp "Gefilterte Raildruck Regelabweichung" SWORD Pres_Rail 1 100 -3276.800 3276.700 FORMAT "%5.3" ECU_ADDRESS 0x8FF330 /end MEASUREMENT
/begin MEASUREMENT HPUn_qBalLim_mp "Begrenzungsmenge auf Grund der Mengenbilanz der Hochdruckpumpe" SWORD InjMassCyc 1 100 -327.6800 327.6700 FORMAT "%8.4" ECU_ADDRESS 0x8FF32A /end MEASUREMENT
/begin MEASUREMENT HPUn_qFlTempLim_mp "Begrenzungsmenge abhängig der Kraftstofftemperatur" SWORD InjMassCyc 1 100 -327.6800 327.6700 FORMAT "%8.4" ECU_ADDRESS 0x8FF32C /end MEASUREMENT
/begin MEASUREMENT HPUn_qLim "Begrenzungsmenge der Hochdruckpumpe" SWORD InjMassCyc 1 100 -327.6800 327.6700 FORMAT "%8.4" ECU_ADDRESS 0x7F8DD4 /end MEASUREMENT
/begin MEASUREMENT HPUn_stNumInjMax_mp "Statusvariable, Mengebilanz der Hochruckpumpe" UBYTE OneToOne 1 100 0.00 255.0 FORMAT "%5.1" ECU_ADDRESS 0x8FF332 /end MEASUREMENT
/begin MEASUREMENT HPUn_stQntBal_mp "Status der Mengenbilanz der Hochdruckpumpe" UBYTE OneToOne 1 100 0.00 255.0 FORMAT "%5.1" ECU_ADDRESS 0x8FF32E /end MEASUREMENT
/begin MEASUREMENT HPUn_trqDes "Momentenanforderung der Hochdruckpumpe" SWORD Trq 1 100 -3276.800 3276.700 FORMAT "%8.3" ECU_ADDRESS 0x7F8DD6 /end MEASUREMENT
/begin MEASUREMENT HWEMon_ctRecovery "Anzahl der während 2 Sekunden aufgetretenen Recoverys" UBYTE OneToOne 1 100 0.00 255.0 FORMAT "%5.1" ECU_ADDRESS 0x7F88F5 /end MEASUREMENT
/begin MEASUREMENT HWEMon_numRecovery "Herkunft des letzten Reset ( >0 = Recovery )" UWORD OneToOne 1 100 0.00 65535.00 FORMAT "%8.2" ECU_ADDRESS 0x7F8DD8 /end MEASUREMENT
/begin MEASUREMENT HWEMon_recLocHigh_mp "HighAdresse recovery location" UWORD OneToOne 1 100 0.00 65535.00 FORMAT "%8.2" ECU_ADDRESS 0x6F816E /end MEASUREMENT
/begin MEASUREMENT HWEMon_recLocLow_mp "LowAdresse recovery location" UWORD OneToOne 1 100 0.00 65535.00 FORMAT "%8.2" ECU_ADDRESS 0x6F8170 /end MEASUREMENT
/begin MEASUREMENT HWEMon_stVoltMon_mp "Latchbetrieb der Überspannungsüberwachung (1 = Latch aktiv)" UBYTE OneToOne 1 100 0.00 255.0 FORMAT "%5.1" ECU_ADDRESS 0x8FF333 /end MEASUREMENT
/begin MEASUREMENT IATSCD_dtAir "Änderungsrate der angesaugten Lufttemperatur" SWORD TempCels_100ms 1 100 -32768.00 32767.00 FORMAT "%8.2" ECU_ADDRESS 0x7F8DDA /end MEASUREMENT
/begin MEASUREMENT IATSCD_dtAirCats "Anderung von IATSCD_tAirCats zwischen den Abtastschritten n und n-1" SWORD TempCels_100ms 1 100 -32768.00 32767.00 FORMAT "%8.2" ECU_ADDRESS 0x7F8DDC /end MEASUREMENT
/begin MEASUREMENT IATSCD_swtSig "Signalquelle Schalter ADC/CAN" UBYTE OneToOne 1 100 0.00 255.0 FORMAT "%5.1" ECU_ADDRESS 0x7F88F6 /end MEASUREMENT
/begin MEASUREMENT IATSCD_swtSigCats "Signalquelle Schalter Ladelufttemperatur über ADC oder CAN" UBYTE OneToOne 1 100 0.00 255.0 FORMAT "%5.1" ECU_ADDRESS 0x7F88F7 /end MEASUREMENT
/begin MEASUREMENT IATSCD_tAir "Ansauglufttemperatur" SWORD Temp_Cels 1 100 -50.140 899.860 FORMAT "%8.3" ECU_ADDRESS 0x7F8DDE /end MEASUREMENT
/begin MEASUREMENT IATSCD_tAirCats "Ladelufttemperatur nach Ladeluftkühler" SWORD Temp_Cels 1 100 -50.140 899.860 FORMAT "%8.3" ECU_ADDRESS 0x7F8DE0 /end MEASUREMENT
/begin MEASUREMENT IATSCD_tAirLin "linearisierter Wert aus HWK vorm Aufruf der Übergangsfunktion" SWORD Temp_Cels 1 100 -50.140 899.860 FORMAT "%8.3" ECU_ADDRESS 0x7F8DE2 /end MEASUREMENT
/begin MEASUREMENT IATSCD_tAirLinCats "Ladelufttemperatur - Linearisierter Wert aus HWK vor Aufruf der Übergangsfunktion" SWORD Temp_Cels 1 100 -50.140 899.860 FORMAT "%8.3" ECU_ADDRESS 0x7F8DE4 /end MEASUREMENT
/begin MEASUREMENT IATSCD_uRaw "Lufttemperatur Spannungsrohwert" SWORD Volt 1 100 -160156.4 160151.5 FORMAT "%8.1" ECU_ADDRESS 0x7F8DE6 /end MEASUREMENT
/begin MEASUREMENT IATSCD_uRawCats "Ladelufttemperatur Spannungsrohwert" SWORD Volt 1 100 -160156.4 160151.5 FORMAT "%8.1" ECU_ADDRESS 0x7F8DE8 /end MEASUREMENT
/begin MEASUREMENT IBSCD_BsdControl_mp "flags to koordinate communication between HT and KT" UBYTE OneToOne 1 100 0.00 255.0 FORMAT "%5.1" ECU_ADDRESS 0x8FF334 /end MEASUREMENT
/begin MEASUREMENT IBSCD_BsdData_mp "data from IBS and to IBS" UBYTE OneToOne 1 100 0.00 255.0 FORMAT "%5.1" ECU_ADDRESS 0x8FF336 /end MEASUREMENT
/begin MEASUREMENT IBSCD_BsdRegAdr_mp "adress of BSD register in IBS" UBYTE OneToOne 1 100 0.00 255.0 FORMAT "%5.1" ECU_ADDRESS 0x8FF337 /end MEASUREMENT
/begin MEASUREMENT IBSCD_stB_ibsactiv_mp "status IBS" UBYTE B_TRUE 1 100 0.00 1.00000000000 FORMAT "%13.11" ECU_ADDRESS 0x8FF335 /end MEASUREMENT
/begin MEASUREMENT IBSCD_stB_ibsdetec_mp "IBS detection status" UBYTE B_TRUE 1 100 0.00 1.00000000000 FORMAT "%13.11" ECU_ADDRESS 0x8FF338 /end MEASUREMENT
/begin MEASUREMENT IgnLck_st "Abschaltanforderungen für Immobilizer/Wegfahrsperre" UBYTE OneToOne 1 100 0.00 255.0 FORMAT "%5.1" ECU_ADDRESS 0x7F88FB /end MEASUREMENT
/begin MEASUREMENT ImmCD_dChangeVal "change value from immobilizer" ULONG OneToOne 1 100 0.00 4294967295.00 FORMAT "%13.2" ECU_ADDRESS 0x7F91EC /end MEASUREMENT
/begin MEASUREMENT ImmCD_dChlg "challange value from immobilizer" UWORD OneToOne 1 100 0.00 65535.00 FORMAT "%8.2" ECU_ADDRESS 0x7F8DFA /end MEASUREMENT
/begin MEASUREMENT ImmCD_stEval "status of communication with immobilizer" UBYTE OneToOne 1 100 0.00 255.0 FORMAT "%5.1" ECU_ADDRESS 0x7F88FC /end MEASUREMENT
/begin MEASUREMENT ImmCtl_dChlg "challange value" UWORD OneToOne 1 100 0.00 65535.00 FORMAT "%8.2" ECU_ADDRESS 0x7F8DFC /end MEASUREMENT
/begin MEASUREMENT ImmCtl_dVal "start value or changing value" ULONG OneToOne 1 100 0.00 4294967295.00 FORMAT "%13.2" ECU_ADDRESS 0x7F91F0 /end MEASUREMENT
/begin MEASUREMENT ImmCtl_stDia "status of control logic" UBYTE OneToOne 1 100 0.00 255.0 FORMAT "%5.1" ECU_ADDRESS 0x7F88FD /end MEASUREMENT
/begin MEASUREMENT ImmCtl_stIniSeq "status initialisation" UBYTE OneToOne 1 100 0.00 255.0 FORMAT "%5.1" ECU_ADDRESS 0x7F88FE /end MEASUREMENT
/begin MEASUREMENT ImmCtl_stLck "Status Wegfahrsperre gesperrt oder freigegeben" UBYTE OneToOne 1 100 0.00 255.0 FORMAT "%5.1" ECU_ADDRESS 0x7F88FF /end MEASUREMENT
/begin MEASUREMENT ImmCtl_stReqRx "request for receive from UART" UBYTE OneToOne 1 100 0.00 255.0 FORMAT "%5.1" ECU_ADDRESS 0x7F8900 /end MEASUREMENT
/begin MEASUREMENT ImmCtl_stWr "reqest for write of value" UBYTE OneToOne 1 100 0.00 255.0 FORMAT "%5.1" ECU_ADDRESS 0x7F8901 /end MEASUREMENT
/begin MEASUREMENT ImmDia_stImmCtl "status from diagnostics to logic" UBYTE OneToOne 1 100 0.00 255.0 FORMAT "%5.1" ECU_ADDRESS 0x7F8902 /end MEASUREMENT
/begin MEASUREMENT ImmEep_ctStrtVal "start value counter from eeprom" UBYTE OneToOne 1 100 0.00 255.0 FORMAT "%5.1" ECU_ADDRESS 0x7F8903 /end MEASUREMENT
/begin MEASUREMENT ImmEep_ctStrtVal_mp "counter start values from eeprom" UBYTE OneToOne 1 100 0.00 255.0 FORMAT "%5.1" ECU_ADDRESS 0x8FF339 /end MEASUREMENT
/begin MEASUREMENT ImmEep_dChangeVal1_mp "change value first storage position" ULONG OneToOne 1 100 0.00 4294967295.00 FORMAT "%13.2" ECU_ADDRESS 0x8FF33C /end MEASUREMENT
/begin MEASUREMENT ImmEep_dChangeVal2_mp "change value second storage position" ULONG OneToOne 1 100 0.00 4294967295.00 FORMAT "%13.2" ECU_ADDRESS 0x8FF340 /end MEASUREMENT
/begin MEASUREMENT ImmEep_dChangeVal3_mp "change value third storage position" ULONG OneToOne 1 100 0.00 4294967295.00 FORMAT "%13.2" ECU_ADDRESS 0x8FF344 /end MEASUREMENT
/begin MEASUREMENT ImmEep_dChangeValEval "change value from eeprom" ULONG OneToOne 1 100 0.00 4294967295.00 FORMAT "%13.2" ECU_ADDRESS 0x7F91F4 /end MEASUREMENT
/begin MEASUREMENT ImmEep_dChangeValEvalLst "change value from eeprom of last driving cycle" ULONG OneToOne 1 100 0.00 4294967295.00 FORMAT "%13.2" ECU_ADDRESS 0x7F91F8 /end MEASUREMENT
/begin MEASUREMENT ImmEep_dChangeValLst1_mp "last change value first storage position" ULONG OneToOne 1 100 0.00 4294967295.00 FORMAT "%13.2" ECU_ADDRESS 0x8FF348 /end MEASUREMENT
/begin MEASUREMENT ImmEep_dChangeValLst2_mp "last change value second storage position" ULONG OneToOne 1 100 0.00 4294967295.00 FORMAT "%13.2" ECU_ADDRESS 0x8FF34C /end MEASUREMENT
/begin MEASUREMENT ImmEep_dChangeValLst3_mp "last change value third storage position" ULONG OneToOne 1 100 0.00 4294967295.00 FORMAT "%13.2" ECU_ADDRESS 0x8FF350 /end MEASUREMENT
/begin MEASUREMENT ImmEep_dChlgEval "challange value from eeprom" UWORD OneToOne 1 100 0.00 65535.00 FORMAT "%8.2" ECU_ADDRESS 0x7F8DFE /end MEASUREMENT
/begin MEASUREMENT ImmEep_dChlg_mp "random number" UWORD OneToOne 1 100 0.00 65535.00 FORMAT "%8.2" ECU_ADDRESS 0x8FF354 /end MEASUREMENT
/begin MEASUREMENT ImmEep_dStrtVal1_mp "start value first storage position" ULONG OneToOne 1 100 0.00 4294967295.00 FORMAT "%13.2" ECU_ADDRESS 0x8FF358 /end MEASUREMENT
/begin MEASUREMENT ImmEep_dStrtVal2_mp "start value second storage position" ULONG OneToOne 1 100 0.00 4294967295.00 FORMAT "%13.2" ECU_ADDRESS 0x8FF35C /end MEASUREMENT
/begin MEASUREMENT ImmEep_dStrtVal3_mp "start value third storage position" ULONG OneToOne 1 100 0.00 4294967295.00 FORMAT "%13.2" ECU_ADDRESS 0x8FF360 /end MEASUREMENT
/begin MEASUREMENT ImmEep_dStrtValEval "start value from eeprom" ULONG OneToOne 1 100 0.00 4294967295.00 FORMAT "%13.2" ECU_ADDRESS 0x7F91FC /end MEASUREMENT
/begin MEASUREMENT ImmEep_stDia "status from eeprom to diagnostics" UBYTE OneToOne 1 100 0.00 255.0 FORMAT "%5.1" ECU_ADDRESS 0x7F8904 /end MEASUREMENT
/begin MEASUREMENT ImmEep_stEvalDia "status from eeprom to diagnostics" UBYTE OneToOne 1 100 0.00 255.0 FORMAT "%5.1" ECU_ADDRESS 0x7F8905 /end MEASUREMENT
/begin MEASUREMENT ImmEep_stMultProgRls "release status for multiple programming" UBYTE OneToOne 1 100 0.00 255.0 FORMAT "%5.1" ECU_ADDRESS 0x7F8906 /end MEASUREMENT
/begin MEASUREMENT ImmEep_stUpdEepAct_mp "element or block that was actually updated in eeprom" UWORD OneToOne 1 100 0.00 65535.00 FORMAT "%8.2" ECU_ADDRESS 0x8FF364 /end MEASUREMENT
/begin MEASUREMENT ImmEep_stWr "status of write back to eeprom" UBYTE OneToOne 1 100 0.00 255.0 FORMAT "%5.1" ECU_ADDRESS 0x7F8907 /end MEASUREMENT
/begin MEASUREMENT IndSys_mAirPerCylLim_mp "Air mass Per Cylinder value" SWORD AirMassPerCyl 1 100 -3276.800 3276.700 FORMAT "%8.3" ECU_ADDRESS 0x8FF366 /end MEASUREMENT
/begin MEASUREMENT IndSys_rVSA "Sollposition für Einlaßkanalabschaltung" SWORD DtyCyc 1 100 -327.6800 327.6700 FORMAT "%8.4" ECU_ADDRESS 0x7F8E00 /end MEASUREMENT
/begin MEASUREMENT IndSys_rVSAATCorr_mp "Lufttemperatur Korrekturwert" SWORD DtyCyc 1 100 -327.6800 327.6700 FORMAT "%8.4" ECU_ADDRESS 0x8FF36A /end MEASUREMENT
/begin MEASUREMENT IndSys_rVSABase_mp "Drallniveausteuerung - Grundwert" SWORD DtyCyc 1 100 -327.6800 327.6700 FORMAT "%8.4" ECU_ADDRESS 0x8FF36C /end MEASUREMENT
/begin MEASUREMENT IndSys_rVSAByp_mp "Bypass-Label, Kopie von IndSys_rVSA" SWORD DtyCyc 1 100 -327.6800 327.6700 FORMAT "%8.4" ECU_ADDRESS 0x8FF36E /end MEASUREMENT
/begin MEASUREMENT IndSys_rVSACorr_mp "korrigierter Wert (vor der Maximalwert-Begrenzung)" SWORD DtyCyc 1 100 -327.6800 327.6700 FORMAT "%8.4" ECU_ADDRESS 0x8FF370 /end MEASUREMENT
/begin MEASUREMENT IndSys_rVSACTCorr_mp "Külmitteltemperatur Korrekturwert" SWORD DtyCyc 1 100 -327.6800 327.6700 FORMAT "%8.4" ECU_ADDRESS 0x8FF372 /end MEASUREMENT
/begin MEASUREMENT IndSys_stPart1_mp "Status Induction system" UBYTE OneToOne 1 100 0.00 255.0 FORMAT "%5.1" ECU_ADDRESS 0x8FF368 /end MEASUREMENT
/begin MEASUREMENT IndSys_stPart2_mp "Status Induction system" UBYTE OneToOne 1 100 0.00 255.0 FORMAT "%5.1" ECU_ADDRESS 0x8FF369 /end MEASUREMENT
/begin MEASUREMENT IndSys_tFld "Temperaturfeld Ansaugtrakt" SWORD Temp_Cels 1 100 -50.140 899.860 FORMAT "%8.3" ARRAY_SIZE 3 ECU_ADDRESS 0x7F92B8 /end MEASUREMENT
/begin MEASUREMENT InjCrv_dpMIDynCor "DT1 gefilterter Atmosphärendruck" SWORD dp_dZ20 1 100 -327680.0 327670.0 FORMAT "%8.1" ECU_ADDRESS 0x7F8E0A /end MEASUREMENT
/begin MEASUREMENT InjCrv_dqSetUnBalFltLim "gefilterter, limitierter Einspritzmengengradient" SWORD InjMassPerSec_20ms 1 100 -16384.00 16383.50 FORMAT "%8.2" ECU_ADDRESS 0x7F8E0C /end MEASUREMENT
/begin MEASUREMENT InjCrv_dqSetUnBal_mp "InjCrv_qSetUnBal DT1 filtered" SWORD InjMassPerSec_20ms 1 100 -16384.00 16383.50 FORMAT "%8.2" ECU_ADDRESS 0x8FF3A0 /end MEASUREMENT
/begin MEASUREMENT InjCrv_facMI1DynCor2_mp "dq correction factor MI SOE customer correction II" SWORD Fact 1 100 -4.000000 3.999878 FORMAT "%8.6" ECU_ADDRESS 0x8FF3A2 /end MEASUREMENT
/begin MEASUREMENT InjCrv_facMI1DynCorSlow2 "factor depending on atmospheric pressure" SWORD Fact 1 100 -4.000000 3.999878 FORMAT "%8.6" ECU_ADDRESS 0x7F8E0E /end MEASUREMENT
/begin MEASUREMENT InjCrv_facMIAPSPhiCor "atmosphärendruckabhängiger Korrekturfaktor für die MI1" SWORD Fact 1 100 -4.000000 3.999878 FORMAT "%8.6" ECU_ADDRESS 0x7F8E10 /end MEASUREMENT
/begin MEASUREMENT InjCrv_facMIAPSPhiCor2 "atmosphärendruckabhängiger Korrekturfaktor -2 für MI1" SWORD Fact 1 100 -4.000000 3.999878 FORMAT "%8.6" ECU_ADDRESS 0x7F8E12 /end MEASUREMENT
/begin MEASUREMENT InjCrv_facMIAPSPhiCorStrt "Korrekturfaktur für Atmosphärendruck im Start" SWORD Fact 1 100 -4.000000 3.999878 FORMAT "%8.6" ECU_ADDRESS 0x7F8E14 /end MEASUREMENT
/begin MEASUREMENT InjCrv_facMIATSPhiCor "ansauglufttemperaturabhängiger Korrekturfaktor für die MI1" SWORD Fact 1 100 -4.000000 3.999878 FORMAT "%8.6" ECU_ADDRESS 0x7F8E16 /end MEASUREMENT
/begin MEASUREMENT InjCrv_facMIATSPhiCor2 "ansauglufttemperaturabhängiger Korrekturfaktor -2 für MI1" SWORD Fact 1 100 -4.000000 3.999878 FORMAT "%8.6" ECU_ADDRESS 0x7F8E18 /end MEASUREMENT
/begin MEASUREMENT InjCrv_facMIATSPhiCorStrt "Korrekturfaktur für Umgebungstemperatur im Start" SWORD Fact 1 100 -4.000000 3.999878 FORMAT "%8.6" ECU_ADDRESS 0x7F8E1A /end MEASUREMENT
/begin MEASUREMENT InjCrv_facMIDynCor "resultierneder Faktor abhängig von Lufttemperatur und Wassertemperatur" SWORD Fact 1 100 -4.000000 3.999878 FORMAT "%8.6" ECU_ADDRESS 0x7F8E1C /end MEASUREMENT
/begin MEASUREMENT InjCrv_facMIETSPhiCor "Gewichtsfaktor für Ansteuerbeginnkorrektur Haupteinspritzung in Abhängigkeit der Motortemperatur" SWORD Fact 1 100 -4.000000 3.999878 FORMAT "%8.6" ECU_ADDRESS 0x7F8E1E /end MEASUREMENT
/begin MEASUREMENT InjCrv_facMIETSPhiCor1 "motortemperaturabhängiger Korrekturfaktor -1 für MI1" SWORD Fact 1 100 -4.000000 3.999878 FORMAT "%8.6" ECU_ADDRESS 0x7F8E20 /end MEASUREMENT
/begin MEASUREMENT InjCrv_facMIETSPhiCor12 """motortemperaturabhängiger Korrekturfaktor für MI1 bei inaktiver PiI2""" SWORD Fact 1 100 -4.000000 3.999878 FORMAT "%8.6" ECU_ADDRESS 0x7F8E22 /end MEASUREMENT
/begin MEASUREMENT InjCrv_facMIETSPhiCor2 "motortemperaturabhängiger Korrekturfaktor -2 für MI1" SWORD Fact 1 100 -4.000000 3.999878 FORMAT "%8.6" ECU_ADDRESS 0x7F8E24 /end MEASUREMENT
/begin MEASUREMENT InjCrv_facMIETSPhiCorStrt "Korrekturfaktur für Motortemperatur im Start" SWORD Fact 1 100 -4.000000 3.999878 FORMAT "%8.6" ECU_ADDRESS 0x7F8E26 /end MEASUREMENT
/begin MEASUREMENT InjCrv_facMIFTSRailCor "Korrekturfaktor für die MI1, abhängig von der kraftstofftemperaturabhängigen Raildruckkorrektur" SWORD Fact 1 100 -4.000000 3.999878 FORMAT "%8.6" ECU_ADDRESS 0x7F8E28 /end MEASUREMENT
/begin MEASUREMENT InjCrv_facMIFTSRailCorStrt "Korrekturfaktor für Kraftstofftemperatur im Start" SWORD Fact 1 100 -4.000000 3.999878 FORMAT "%8.6" ECU_ADDRESS 0x7F8E2A /end MEASUREMENT
/begin MEASUREMENT InjCrv_facMIPDynCor_mp "Korrekturfaktor abhängig vom Raildruck" SWORD Fact 1 100 -4.000000 3.999878 FORMAT "%8.6" ECU_ADDRESS 0x8FF3A4 /end MEASUREMENT
/begin MEASUREMENT InjCrv_MI1RgnVal "Wert für Regenerationsstatus MI1" ULONG EGTSwt 1 100 0.00 262.143999939 FORMAT "%13.9" ECU_ADDRESS 0x7F9200 /end MEASUREMENT
/begin MEASUREMENT InjCrv_numInjDes_mp "gewünschte Anzahl an Einspritzungen pro Arbeitsspiel" UBYTE OneToOne 1 100 0.00 255.0 FORMAT "%5.1" ECU_ADDRESS 0x8FF374 /end MEASUREMENT
/begin MEASUREMENT InjCrv_numInjLim_mp "Erlaubte Anzahl an Einspritzungen" UBYTE OneToOne 1 100 0.00 255.0 FORMAT "%5.1" ECU_ADDRESS 0x8FF375 /end MEASUREMENT
/begin MEASUREMENT InjCrv_numInjMaxSys "Systembedingte maximal erlaubte Anzahl an Einspritzungen" UBYTE OneToOne 1 100 0.00 255.0 FORMAT "%5.1" ECU_ADDRESS 0x7F8908 /end MEASUREMENT
/begin MEASUREMENT InjCrv_phiMI1AddCor "Korrekturwinkel für Ansteuerbeginn MI1 in Abhängigkeit kundenspezifischer Funktionen" SWORD AngleCrS 1 100 -768.0000 767.9766 FORMAT "%8.4" ECU_ADDRESS 0x7F8E74 /end MEASUREMENT
/begin MEASUREMENT InjCrv_phiMI1AddCor2 "kundenspezifischer Korrekturwinkel für die MI bei aktiver PiI2" SWORD AngleCrS 1 100 -768.0000 767.9766 FORMAT "%8.4" ECU_ADDRESS 0x7F8E76 /end MEASUREMENT
/begin MEASUREMENT InjCrv_phiMI1Bas_mp "Grundwert Ansteuerbeginn MI1" SWORD AngleCrS 1 100 -768.0000 767.9766 FORMAT "%8.4" ECU_ADDRESS 0x8FF388 /end MEASUREMENT
/begin MEASUREMENT InjCrv_phiMI1Cor_mp "korrigierter Grundwert Ansteuerbeginn MI1" SWORD AngleCrS 1 100 -768.0000 767.9766 FORMAT "%8.4" ECU_ADDRESS 0x8FF38A /end MEASUREMENT
/begin MEASUREMENT InjCrv_phiMI1Des "gewünschter Bezugswinkel für Beginn der MI1" SWORD AngleCrS 1 100 -768.0000 767.9766 FORMAT "%8.4" ECU_ADDRESS 0x7F8E78 /end MEASUREMENT
/begin MEASUREMENT InjCrv_phiMI1DesByp_mp "Bypass-Label, Kopie von InjCrv_phiMI1Des" SWORD AngleCrS 1 100 -768.0000 767.9766 FORMAT "%8.4" ECU_ADDRESS 0x8FF38C /end MEASUREMENT
/begin MEASUREMENT InjCrv_phiMI1DynCor1_mp "MI SOE customer correction 1" SWORD AngleCrS 1 100 -768.0000 767.9766 FORMAT "%8.4" ECU_ADDRESS 0x8FF3A6 /end MEASUREMENT
/begin MEASUREMENT InjCrv_phiMI1DynCor2Bas_mp "MI SOE customer correction II, base value" SWORD AngleCrS 1 100 -768.0000 767.9766 FORMAT "%8.4" ECU_ADDRESS 0x8FF3A8 /end MEASUREMENT
/begin MEASUREMENT InjCrv_phiMI1DynCor2_mp "MI SOE customer correction II" SWORD AngleCrS 1 100 -768.0000 767.9766 FORMAT "%8.4" ECU_ADDRESS 0x8FF3AA /end MEASUREMENT
/begin MEASUREMENT InjCrv_phiMI1EnvCor "Ansteuerbeginn Korrekturwinkel für MI1" SWORD AngleCrS 1 100 -768.0000 767.9766 FORMAT "%8.4" ECU_ADDRESS 0x7F8E7A /end MEASUREMENT
/begin MEASUREMENT InjCrv_phiMI1EnvCor2 "Ansteuerbeginnkorrekturwert -2 für MI1 (n sync)" SWORD AngleCrS 1 100 -768.0000 767.9766 FORMAT "%8.4" ECU_ADDRESS 0x7F8E7C /end MEASUREMENT
/begin MEASUREMENT InjCrv_phiMI1EnvCorStrt "Winkelkorektur für Haupteinspritzung bei Start" SWORD AngleCrS 1 100 -768.0000 767.9766 FORMAT "%8.4" ECU_ADDRESS 0x7F8E7E /end MEASUREMENT
/begin MEASUREMENT InjCrv_phiMI1Lim_mp "begrenzter Sollwert Ansteuerbeginn MI1" SWORD AngleCrS 1 100 -768.0000 767.9766 FORMAT "%8.4" ECU_ADDRESS 0x8FF38E /end MEASUREMENT
/begin MEASUREMENT InjCrv_phiMI1Max_mp "frühester Ansteuerbeginn der MI1" SWORD AngleCrS 1 100 -768.0000 767.9766 FORMAT "%8.4" ECU_ADDRESS 0x8FF390 /end MEASUREMENT
/begin MEASUREMENT InjCrv_phiMI1Min_mp "Latest SOE of MI1" SWORD AngleCrS 1 100 -768.0000 767.9766 FORMAT "%8.4" ECU_ADDRESS 0x8FF392 /end MEASUREMENT
/begin MEASUREMENT InjCrv_phiMI1Rgn "Regenerationswert für den Ansteuerbeginn der MI1" SWORD AngleCrS 1 100 -768.0000 767.9766 FORMAT "%8.4" ECU_ADDRESS 0x7F8E80 /end MEASUREMENT
/begin MEASUREMENT InjCrv_phiMI1RgnByp_mp "Measure point for Bypass" SWORD AngleCrS 1 100 -768.0000 767.9766 FORMAT "%8.4" ECU_ADDRESS 0x8FF3D2 /end MEASUREMENT
/begin MEASUREMENT InjCrv_phiMI1Rgn_mp "Ansteuerbeginn der MI1 im Regenerationsbetrieb" SWORD AngleCrS 1 100 -768.0000 767.9766 FORMAT "%8.4" ECU_ADDRESS 0x8FF3D4 /end MEASUREMENT
/begin MEASUREMENT InjCrv_phiMI1StrtCor_mp "Korrekturwinkel der HE während des Starts" SWORD AngleCrS 1 100 -768.0000 767.9766 FORMAT "%8.4" ECU_ADDRESS 0x8FF3DA /end MEASUREMENT
/begin MEASUREMENT InjCrv_phiMIAPSCor2_mp "atmosphärendruckabhängiger Korrekturwinkel für den Ansteuerbeginn der MI1 bei aktiver PiI2" SWORD AngleCrS 1 100 -768.0000 767.9766 FORMAT "%8.4" ECU_ADDRESS 0x8FF3B8 /end MEASUREMENT
/begin MEASUREMENT InjCrv_phiMIAPSCorStrt_mp "Correction phase angle value for main injection at the start of engine" SWORD AngleCrS 1 100 -768.0000 767.9766 FORMAT "%8.4" ECU_ADDRESS 0x8FF3BA /end MEASUREMENT
/begin MEASUREMENT InjCrv_phiMIAPSCor_mp "atmosphärendruckabhängiger Korrekturwert für den Ansteuerbeginn der MI1" SWORD AngleCrS 1 100 -768.0000 767.9766 FORMAT "%8.4" ECU_ADDRESS 0x8FF3BC /end MEASUREMENT
/begin MEASUREMENT InjCrv_phiMIAPSDynCor_mp "Korrekturwert für Ansteuerbeginn der Haupteinspritzung" SWORD AngleCrS 1 100 -768.0000 767.9766 FORMAT "%8.4" ECU_ADDRESS 0x8FF3AC /end MEASUREMENT
/begin MEASUREMENT InjCrv_phiMIATSCor2_mp "ansauglufttemperaturabhängiger Korrekturwinkel für den Ansteuerbeginn der MI1 bei aktiver PiI2" SWORD AngleCrS 1 100 -768.0000 767.9766 FORMAT "%8.4" ECU_ADDRESS 0x8FF3BE /end MEASUREMENT
/begin MEASUREMENT InjCrv_phiMIATSCorStrt_mp "ansauglufttemperaturabhängiger Korrekturwert für den Ansteuerbeginn der MI1 im Startzustand" SWORD AngleCrS 1 100 -768.0000 767.9766 FORMAT "%8.4" ECU_ADDRESS 0x8FF3C0 /end MEASUREMENT
/begin MEASUREMENT InjCrv_phiMIATSCor_mp "ansauglufttemperaturabhängiger Korrekturwert für den Ansteuerbeginn der MI1" SWORD AngleCrS 1 100 -768.0000 767.9766 FORMAT "%8.4" ECU_ADDRESS 0x8FF3C2 /end MEASUREMENT
/begin MEASUREMENT InjCrv_phiMIDynCor_mp "Korrekturwert für Ansteuerbeginn der Haupteinspritzung" SWORD AngleCrS 1 100 -768.0000 767.9766 FORMAT "%8.4" ECU_ADDRESS 0x8FF3AE /end MEASUREMENT
/begin MEASUREMENT InjCrv_phiMIETSCor12_mp "kühlmitteltemperaturabhängiger Korrekturwert für den Ansteuerbeginn der MI1" SWORD AngleCrS 1 100 -768.0000 767.9766 FORMAT "%8.4" ECU_ADDRESS 0x8FF3C4 /end MEASUREMENT
/begin MEASUREMENT InjCrv_phiMIETSCor1_mp "motortemperaturabhängiger Korrekturwert -1 für Ansteuerbeginn MI1" SWORD AngleCrS 1 100 -768.0000 767.9766 FORMAT "%8.4" ECU_ADDRESS 0x8FF3C6 /end MEASUREMENT
/begin MEASUREMENT InjCrv_phiMIETSCor2_mp "motortemperaturabhängiger Korrekturwert -2 für Ansteuerbeginn MI1" SWORD AngleCrS 1 100 -768.0000 767.9766 FORMAT "%8.4" ECU_ADDRESS 0x8FF3C8 /end MEASUREMENT
/begin MEASUREMENT InjCrv_phiMIETSCorRgn_mp "Korrekturwinkel für Ansteuerbeginn Haupteinspritzung in Abhängigkeit der Motortemperatur im Regenerationsbetrieb" SWORD AngleCrS 1 100 -768.0000 767.9766 FORMAT "%8.4" ECU_ADDRESS 0x8FF3D6 /end MEASUREMENT
/begin MEASUREMENT InjCrv_phiMIETSCorStrt_mp "correction angle value = f(n, qSetUnBal, ETS)" SWORD AngleCrS 1 100 -768.0000 767.9766 FORMAT "%8.4" ECU_ADDRESS 0x8FF3CA /end MEASUREMENT
/begin MEASUREMENT InjCrv_phiMIETSCor_mp "Korrekturwinkel für Ansteuerbeginn Haupteinspritzung in Abhängigkeit der Motortemperatur" SWORD AngleCrS 1 100 -768.0000 767.9766 FORMAT "%8.4" ECU_ADDRESS 0x8FF3CC /end MEASUREMENT
/begin MEASUREMENT InjCrv_phiMIFTSRailCorStrt_mp "correction angle value = f(n, qSetUnBal, FTS,InjCrv_phiMIFTSRailCor_Max, InjCrv_phiMIFTSRailCor_Min)" SWORD AngleCrS 1 100 -768.0000 767.9766 FORMAT "%8.4" ECU_ADDRESS 0x8FF3CE /end MEASUREMENT
/begin MEASUREMENT InjCrv_phiMIFTSRailCor_mp "Ansteuerbeginnkorrekturfaktor für MI1, abhängig von der kraftstofftemperaturabhängigen Raildruckkorrektur" SWORD AngleCrS 1 100 -768.0000 767.9766 FORMAT "%8.4" ECU_ADDRESS 0x8FF3D0 /end MEASUREMENT
/begin MEASUREMENT InjCrv_phiMIPDynCor_mp "Korrekturwert für Ansteuerbeginn der Haupteinspritzung" SWORD AngleCrS 1 100 -768.0000 767.9766 FORMAT "%8.4" ECU_ADDRESS 0x8FF3B0 /end MEASUREMENT
/begin MEASUREMENT InjCrv_phiPiI1Bas_mp "Winkelkomponente Ansteuerbeginn PiI1Grundwert" SWORD AngleCrS 1 100 -768.0000 767.9766 FORMAT "%8.4" ECU_ADDRESS 0x8FF3DC /end MEASUREMENT
/begin MEASUREMENT InjCrv_phiPiI2AddCor "kundenspezifischer Korrekturwinkel für PiI2" SWORD AngleCrS 1 100 -768.0000 767.9766 FORMAT "%8.4" ECU_ADDRESS 0x7F8E8E /end MEASUREMENT
/begin MEASUREMENT InjCrv_phiPiI2ETSCor_mp "motortemperaturabhängiger Korrekturgrundwert für die Winkelkomponente des Ansteuerbeginns der PiI2" SWORD AngleCrS 1 100 -768.0000 767.9766 FORMAT "%8.4" ECU_ADDRESS 0x8FF41C /end MEASUREMENT
/begin MEASUREMENT InjCrv_phiStrtInjSetPoint "Spritzbeginn-Sollwinkel" SWORD AngleCrS 1 100 -768.0000 767.9766 FORMAT "%8.4" ECU_ADDRESS 0x7F8EAA /end MEASUREMENT
/begin MEASUREMENT InjCrv_PiI1RgnVal_mp "Aktivierungswert für die Freigabe PiI1 über das Abgasnachbehandlungssystem" ULONG EGTSwt 1 100 0.00 262.143999939 FORMAT "%13.9" ECU_ADDRESS 0x8FF430 /end MEASUREMENT
/begin MEASUREMENT InjCrv_PiI2RgnVal_mp "Aktivierungswert für die Freigabe PiI2 über das Abgasnachbehandlungssystem" ULONG EGTSwt 1 100 0.00 262.143999939 FORMAT "%13.9" ECU_ADDRESS 0x8FF3E4 /end MEASUREMENT
/begin MEASUREMENT InjCrv_pMIDynCor_mp "begrenzte Raildruckdifferenz" SWORD Pres_Rail 1 100 -3276.800 3276.700 FORMAT "%5.3" ECU_ADDRESS 0x8FF3B2 /end MEASUREMENT
/begin MEASUREMENT InjCrv_PoI2RgnVal "Aktivierungswert für die Freigabe der PoI2 über das Abgasnachbehandlungssystem" ULONG EGTSwt 1 100 0.00 262.143999939 FORMAT "%13.9" ECU_ADDRESS 0x7F9210 /end MEASUREMENT
/begin MEASUREMENT InjCrv_PoI2RgnValTSync "Aktivierungswert für die Freigabe der PoI2 über das Abgasnachbehandlungssystem (t sync)" ULONG EGTSwt 1 100 0.00 262.143999939 FORMAT "%13.9" ECU_ADDRESS 0x7F9214 /end MEASUREMENT
/begin MEASUREMENT InjCrv_qLmbdCtl "Lambdakontrollmenge" SWORD InjMassCyc 1 100 -327.6800 327.6700 FORMAT "%8.4" ECU_ADDRESS 0x7F8EAC /end MEASUREMENT
/begin MEASUREMENT InjCrv_qMI1Des "Sollmenge Haupteinspritzung" SWORD InjMassInj 1 100 -327.6800 327.6700 FORMAT "%8.4" ECU_ADDRESS 0x7F8EAE /end MEASUREMENT
/begin MEASUREMENT InjCrv_qMI1DesByp_mp "Bypass-Label, Kopie von InjCrv_qMI1Des" SWORD InjMassInj 1 100 -327.6800 327.6700 FORMAT "%8.4" ECU_ADDRESS 0x8FF394 /end MEASUREMENT
/begin MEASUREMENT InjCrv_qMI1Min_mp "Minimale Einspritzmenge der Haupteinspritzung 1" SWORD InjMassInj 1 100 -327.6800 327.6700 FORMAT "%8.4" ECU_ADDRESS 0x8FF396 /end MEASUREMENT
/begin MEASUREMENT InjCrv_qMI1Nrm_mp "Normalmenge der Einspritzung MI1" SWORD InjMassInj 1 100 -327.6800 327.6700 FORMAT "%8.4" ECU_ADDRESS 0x8FF398 /end MEASUREMENT
/begin MEASUREMENT InjCrv_qMI1Rgn "Regenerationswert für die Menge der MI1" SWORD InjMassInj 1 100 -327.6800 327.6700 FORMAT "%8.4" ECU_ADDRESS 0x7F8EB0 /end MEASUREMENT
/begin MEASUREMENT InjCrv_qMI1RgnByp_mp "Measure point for Bypass" SWORD InjMassInj 1 100 -327.6800 327.6700 FORMAT "%8.4" ECU_ADDRESS 0x8FF3D8 /end MEASUREMENT
/begin MEASUREMENT InjCrv_qMI1Set_mp "Sollmenge der Einspritzung MI1" SWORD InjMassInj 1 100 -327.6800 327.6700 FORMAT "%8.4" ECU_ADDRESS 0x8FF39A /end MEASUREMENT
/begin MEASUREMENT InjCrv_qPiI1BasStrt_mp "Einspritzmenge PiI 1 Grundwert im Startzustand" SWORD InjMassInj 1 100 -327.6800 327.6700 FORMAT "%8.4" ECU_ADDRESS 0x8FF3DE /end MEASUREMENT
/begin MEASUREMENT InjCrv_qPiI2AddCor "kundenspezifische Korrekturmenge für PiI2" SWORD InjMassInj 1 100 -327.6800 327.6700 FORMAT "%8.4" ECU_ADDRESS 0x7F8EC0 /end MEASUREMENT
/begin MEASUREMENT InjCrv_qTot "Gesamteinspritzmenge" SWORD InjMassCyc 1 100 -327.6800 327.6700 FORMAT "%8.4" ECU_ADDRESS 0x7F8EDC /end MEASUREMENT
/begin MEASUREMENT InjCrv_stInjCharActVal "Einspritzverlauf aktueller Wert" UBYTE OneToOne 1 100 0.00 255.0 FORMAT "%5.1" ECU_ADDRESS 0x7F8909 /end MEASUREMENT
/begin MEASUREMENT InjCrv_stInjCharDes_mp "Wunscheinspritzverlauf" UBYTE OneToOne 1 100 0.00 255.0 FORMAT "%5.1" ECU_ADDRESS 0x8FF376 /end MEASUREMENT
/begin MEASUREMENT InjCrv_stInjCharPrio "Prioritätenstatus zur Abschaltung der Einspritzung" ULONG OneToOne 1 100 0.00 4294967295.00 FORMAT "%13.2" ECU_ADDRESS 0x7F9218 /end MEASUREMENT
/begin MEASUREMENT InjCrv_stInjCharPrioTSync "Prioritätenstatus zur Abschaltung von Einspritzungen (t sync)" ULONG OneToOne 1 100 0.00 4294967295.00 FORMAT "%13.2" ECU_ADDRESS 0x7F921C /end MEASUREMENT
/begin MEASUREMENT InjCrv_stInjCharSetVal "Einspritzverlauf Sollwert (drehzahlsynchron)" UBYTE OneToOne 1 100 0.00 255.0 FORMAT "%5.1" ECU_ADDRESS 0x7F890A /end MEASUREMENT
/begin MEASUREMENT InjCrv_stInjCharSetValTSync "Einspritzverlauf Sollwert (zeitsynchron)" UBYTE OneToOne 1 100 0.00 255.0 FORMAT "%5.1" ECU_ADDRESS 0x7F890B /end MEASUREMENT
/begin MEASUREMENT InjCrv_stInjCharSetVal_mp "Messpunkt vor dem Ascet Freischnitt" UBYTE OneToOne 1 100 0.00 255.0 FORMAT "%5.1" ECU_ADDRESS 0x8FF377 /end MEASUREMENT
/begin MEASUREMENT InjCrv_stLmbdCtl "Freigabestatus Lambdakontrollmenge" UBYTE OneToOne 1 100 0.00 255.0 FORMAT "%5.1" ECU_ADDRESS 0x7F890C /end MEASUREMENT
/begin MEASUREMENT InjCrv_stPiI2RlsAirP_mp "Freigabezustand der ansaugluftdruckabhängigen Voreinspritzung 2" UBYTE OneToOne 1 100 0.00 255.0 FORMAT "%5.1" ECU_ADDRESS 0x8FF37B /end MEASUREMENT
/begin MEASUREMENT InjCrv_stPiI2RlsAirTBit_mp "Freigabezustand der ansauglufttemperaturabhängigen Voreinspritzung 2" UBYTE OneToOne 1 100 0.00 255.0 FORMAT "%5.1" ECU_ADDRESS 0x8FF37C /end MEASUREMENT
/begin MEASUREMENT InjCrv_stPiI2RlsAirT_mp "status of Piot injection 2 release based on Intake air temperature" UBYTE OneToOne 1 100 0.00 255.0 FORMAT "%5.1" ECU_ADDRESS 0x8FF37D /end MEASUREMENT
/begin MEASUREMENT InjCrv_stPiI2RlsOpRng6Bit_mp "aktueller Betriebspunkt zur Freigabe von Voreinspritzungszuständen" UBYTE OneToOne 1 100 0.00 255.0 FORMAT "%5.1" ECU_ADDRESS 0x8FF382 /end MEASUREMENT
/begin MEASUREMENT InjCrv_stPiI2RlsQRaw_mp "Freigabezustand der rohmengenabhängigen Voreinspritzung 2" UBYTE OneToOne 1 100 0.00 255.0 FORMAT "%5.1" ECU_ADDRESS 0x8FF37E /end MEASUREMENT
/begin MEASUREMENT InjCrv_stPiIRlsCor_mp "Freigabestruktur der Voreinspritzung nach Korrekturen" SWORD OneToOne 1 100 -32768.00 32767.00 FORMAT "%8.2" ECU_ADDRESS 0x8FF384 /end MEASUREMENT
/begin MEASUREMENT InjCrv_stPiIRlsOpRng6_mp "Current operation point for release of pilot injections" UBYTE OneToOne 1 100 0.00 255.0 FORMAT "%5.1" ECU_ADDRESS 0x8FF386 /end MEASUREMENT
/begin MEASUREMENT InjCrv_stPiIRlsOpRng_mp "aktueller Betriebsbereich für die Freigabe der Voreinspritzungen" UBYTE OneToOne 1 100 0.00 255.0 FORMAT "%5.1" ECU_ADDRESS 0x8FF387 /end MEASUREMENT
/begin MEASUREMENT InjCrv_stPiIRlsRaw_mp "Freigabestruktur der Voreinspritzung vor zusätzlichen Korrekturen" SWORD OneToOne 1 100 -32768.00 32767.00 FORMAT "%8.2" ECU_ADDRESS 0x8FF378 /end MEASUREMENT
/begin MEASUREMENT InjCrv_stPiIRlsStructRaw_mp "gewünschte Freigabekombination der Voreinspritzungen" SWORD OneToOne 1 100 -32768.00 32767.00 FORMAT "%8.2" ECU_ADDRESS 0x8FF380 /end MEASUREMENT
/begin MEASUREMENT InjCrv_stPiIRlsStruct_mp "Freigabestruktur der Voreinspritzungen" UBYTE OneToOne 1 100 0.00 255.0 FORMAT "%5.1" ECU_ADDRESS 0x8FF37A /end MEASUREMENT
/begin MEASUREMENT InjCrv_swtPiIDblCorMap "Berechnung der kundenspezifischen und der Umgebungskorrekturen für PiI und MI auf der Basis eines doppelten Kennfeldsatzes" UBYTE OneToOne 1 100 0.00 255.0 FORMAT "%5.1" ECU_ADDRESS 0x7F890E /end MEASUREMENT
/begin MEASUREMENT InjCrv_tEng "selektierte Motortemperatur für das Einspritzsystem" SWORD Temp_Cels 1 100 -50.140 899.860 FORMAT "%8.3" ECU_ADDRESS 0x7F8EDE /end MEASUREMENT
/begin MEASUREMENT InjCrv_tiDQPT1AddCor2_mp "dq PT1 filter const. in MI SOE correction II" ULONG TimeDelay_s 1 100 0.0000010000000 4294.9673 FORMAT "%9.4" ECU_ADDRESS 0x8FF3B4 /end MEASUREMENT
/begin MEASUREMENT InjCrv_tiMI1ET "geschätzte Ansteuerdauer MI1" SWORD InjTime_us 1 100 -32768.00 32767.00 FORMAT "%8.2" ECU_ADDRESS 0x7F8EE0 /end MEASUREMENT
/begin MEASUREMENT InjCrv_tiMI1Rgn "value for regeneration of time comp. SOE MI1" SWORD InjTime_us 1 100 -32768.00 32767.00 FORMAT "%8.2" ECU_ADDRESS 0x7F8EE2 /end MEASUREMENT
/begin MEASUREMENT InjCrv_tiPiI1BasStrt_mp "korrigierter Grundwert Zeitkomponente im Startzustand" SWORD InjTime_us 1 100 -32768.00 32767.00 FORMAT "%8.2" ECU_ADDRESS 0x8FF3E0 /end MEASUREMENT
/begin MEASUREMENT InjCrv_tiPiI1Bas_mp "Zeitkomponente Ansteuerbeginn PiI1Grundwert" SWORD InjTime_us 1 100 -32768.00 32767.00 FORMAT "%8.2" ECU_ADDRESS 0x6F8172 /end MEASUREMENT
/begin MEASUREMENT InjCrv_tiPiI2AddCor "kundenspezifische Korrekturzeit für PiI2" SWORD InjTime_us 1 100 -32768.00 32767.00 FORMAT "%8.2" ECU_ADDRESS 0x7F8EF2 /end MEASUREMENT
/begin MEASUREMENT InjCrv_volMI1Cor_mp "Einspritzvolumen MI1 mit Korrekturwerten" SWORD InjQntInj 1 100 -327.6800 327.6700 FORMAT "%8.4" ECU_ADDRESS 0x8FF39C /end MEASUREMENT
/begin MEASUREMENT InjCrv_volMI1_mp "Einspritzvolumen MI1" SWORD InjQntInj 1 100 -327.6800 327.6700 FORMAT "%8.4" ECU_ADDRESS 0x8FF39E /end MEASUREMENT
/begin FUNCTION frmmng_uic ""
 /begin OUT_MEASUREMENT FrmMng_ctAnfRadMomPtalv_mp FrmMng_ctBOS_RESETalv_mp FrmMng_ctDM_ANF_AFSalv_mp FrmMng_ctDRMANFSSGalv_mp FrmMng_ctENGINE1alv_mp FrmMng_ctOPCRCTLACCalv_mp FrmMng_ctRadMom1alv_mp FrmMng_ctRadMom2alv_mp FrmMng_ctSTAT_ARSalv_mp FrmMng_ctTERMINALalv_mp FrmMng_ctTORQUE1alv_mp FrmMng_ctTORQUE2alv_mp FrmMng_ctTORQUE3alv_mp FrmMng_ctTORQUE_DSCalv_mp FrmMng_ctTORQUE_GEARBXalv_mp FrmMng_ctVEH_MODalv_mp FrmMng_dAnfRadMomPtcs_mp FrmMng_dDM_ANF_AFScs_mp FrmMng_dDRMANFSSGcs_mp FrmMng_dOPCRCTLACCcs_mp FrmMng_dRadMom1cs_mp FrmMng_dRadMom2cs_mp FrmMng_dTERMINALcs_mp FrmMng_dTORQUE1cs_mp FrmMng_dTORQUE2cs_mp FrmMng_dTORQUE3cs_mp FrmMng_dTORQUE_DSCcs_mp FrmMng_dTORQUE_GEARBXcs_mp FrmMng_dVEH_MODcs_mp FrmMng_numANFRADMOMPTbyte0_mp FrmMng_numANFRADMOMPTbyte1_mp FrmMng_numANFRADMOMPTbyte2_mp FrmMng_numANFRADMOMPTbyte3_mp FrmMng_numANFRADMOMPTbyte4_mp FrmMng_numAnfrageByte0_mp FrmMng_numAnfrageByte1_mp FrmMng_numAnfrageByte2_mp FrmMng_numBOS_MELDUNG2_OILbyte0_mp FrmMng_numBOS_MELDUNG2_OILbyte1_mp FrmMng_numBOS_MELDUNG2_OILbyte2_mp FrmMng_numBOS_MELDUNG2_OILbyte3_mp FrmMng_numBOS_MELDUNG2_OILbyte4_mp FrmMng_numBOS_MELDUNG2_OILbyte5_mp FrmMng_numBOS_MELDUNG2_OILbyte6_mp FrmMng_numBOS_MELDUNG_OILbyte0_mp FrmMng_numBOS_MELDUNG_OILbyte1_mp FrmMng_numBOS_MELDUNG_OILbyte2_mp FrmMng_numBOS_MELDUNG_OILbyte3_mp FrmMng_numBOS_MELDUNG_OILbyte4_mp FrmMng_numBOS_MELDUNG_OILbyte5_mp FrmMng_numBOS_MELDUNG_OILbyte6_mp FrmMng_numBOS_MELDUNG_OILbyte7_mp FrmMng_numBOS_PFLTbyte0_mp FrmMng_numBOS_PFLTbyte1_mp FrmMng_numBOS_PFLTbyte2_mp FrmMng_numBOS_PFLTbyte3_mp FrmMng_numBOS_PFLTbyte4_mp FrmMng_numBOS_PFLTbyte5_mp FrmMng_numBOS_PFLTbyte6_mp FrmMng_numBOS_PFLTbyte7_mp FrmMng_numBOS_RESETbyte0_mp FrmMng_numBOS_RESETbyte1_mp FrmMng_numBOS_RESETbyte2_mp FrmMng_numBOS_RESETbyte3_mp FrmMng_numBOS_RESETbyte4_mp FrmMng_numBOS_RESETbyte5_mp FrmMng_numBOS_RESETbyte6_mp FrmMng_numBOS_RESETbyte7_mp FrmMng_numBOS_RESET_2byte0_mp FrmMng_numBOS_RESET_2byte1_mp FrmMng_numBOS_RESET_2byte2_mp FrmMng_numBOS_RESET_2byte3_mp FrmMng_numBOS_RESET_2byte4_mp FrmMng_numBOS_RESET_2byte5_mp FrmMng_numBOS_RESET_2byte6_mp FrmMng_numCCMsgbyte0_mp FrmMng_numCCMsgbyte1_mp FrmMng_numCCMsgbyte2_mp FrmMng_numCCMsgbyte3_mp FrmMng_numCCMsgbyte4_mp FrmMng_numCCMsgbyte5_mp FrmMng_numCCMsgbyte6_mp FrmMng_numCCMsgbyte7_mp FrmMng_numDMANFAFSbyte0_mp FrmMng_numDMANFAFSbyte1_mp FrmMng_numDMANFAFSbyte2_mp FrmMng_numDMANFAFSbyte3_mp FrmMng_numDMANFAFSbyte4_mp FrmMng_numDMANFAFSbyte5_mp FrmMng_numDM_ANF_ACCbyte0_mp FrmMng_numDM_ANF_ACCbyte1_mp FrmMng_numDM_ANF_ACCbyte2_mp FrmMng_numDM_ANF_ACCbyte3_mp FrmMng_numDM_ANF_ACCbyte4_mp FrmMng_numDM_ANF_ACCbyte5_mp FrmMng_numDM_ANF_ACCbyte6_mp FrmMng_numDM_ANF_ACCbyte7_mp FrmMng_numDRMANFSSGbyte0_mp FrmMng_numDRMANFSSGbyte1_mp FrmMng_numDRMANFSSGbyte2_mp FrmMng_numDRMANFSSGbyte3_mp FrmMng_numDRMANFSSGbyte4_mp FrmMng_numDRMANFSSGbyte5_mp FrmMng_numDRMANFSSGbyte6_mp FrmMng_numDRMANFSSGbyte7_mp FrmMng_numELKTR_M_OEL_MESSbyte0_mp FrmMng_numELKTR_M_OEL_MESSbyte1_mp FrmMng_numENGINE1byte0_mp FrmMng_numENGINE1byte1_mp FrmMng_numENGINE1byte2_mp FrmMng_numENGINE1byte3_mp FrmMng_numENGINE1byte4_mp FrmMng_numENGINE1byte5_mp FrmMng_numENGINE1byte6_mp FrmMng_numENGINE1byte7_mp FrmMng_numEngRpmbyte0_mp FrmMng_numEngRpmbyte1_mp FrmMng_numGEARBX_DATA2byte0_mp FrmMng_numGEARBX_DATA2byte1_mp FrmMng_numGEARBX_DATAbyte0_mp FrmMng_numGEARBX_DATAbyte1_mp FrmMng_numGEARBX_DATAbyte2_mp FrmMng_numGEARBX_DATAbyte3_mp FrmMng_numGEARBX_DATAbyte4_mp FrmMng_numGEARBX_DATAbyte5_mp FrmMng_numGEARBX_DATAbyte6_mp FrmMng_numGEARBX_DATAbyte7_mp FrmMng_numHEATCURbyte0_mp FrmMng_numHEATCURbyte1_mp FrmMng_numHEATCURbyte2_mp FrmMng_numHEATCURbyte3_mp FrmMng_numHEATCURbyte4_mp FrmMng_numHEATCURbyte5_mp FrmMng_numHEATCURbyte6_mp FrmMng_numHEAT_ACbyte0_mp FrmMng_numHEAT_ACbyte1_mp FrmMng_numHEAT_ACbyte2_mp FrmMng_numHEAT_ACbyte3_mp FrmMng_numHEAT_ACbyte4_mp FrmMng_numLRADWINKbyte0_mp FrmMng_numLRADWINKbyte1_mp FrmMng_numLRADWINKbyte2_mp FrmMng_numLRADWINKbyte3_mp FrmMng_numLRADWINKbyte4_mp FrmMng_numLRADWINKbyte5_mp FrmMng_numLRADWINKbyte6_mp FrmMng_numMILEAGE_RANGEbyte0_mp FrmMng_numMILEAGE_RANGEbyte1_mp FrmMng_numMILEAGE_RANGEbyte2_mp FrmMng_numMILEAGE_RANGEbyte3_mp FrmMng_numMILEAGE_RANGEbyte4_mp FrmMng_numMILEAGE_RANGEbyte5_mp FrmMng_numMILEAGE_RANGEbyte6_mp FrmMng_numMILEAGE_RANGEbyte7_mp FrmMng_numMsgACC_mp FrmMng_numMsgAC_mp FrmMng_numMsgAFS_mp FrmMng_numMsgARS_mp FrmMng_numMsgDCC_mp FrmMng_numMsgFGR_mp FrmMng_numOPCRCTLACCbyte0_mp FrmMng_numOPCRCTLACCbyte1_mp FrmMng_numOPCRCTLACCbyte2_mp FrmMng_numOPCRCTLACCbyte3_mp FrmMng_numParkConsumerByte0_mp FrmMng_numParkConsumerByte1_mp FrmMng_numParkConsumerByte2_mp FrmMng_numParkConsumerByte3_mp FrmMng_numPMCTRCOSbyte0_mp FrmMng_numPMCTRCOSbyte1_mp FrmMng_numPMCTRCOSbyte2_mp FrmMng_numPMCTRCOSbyte3_mp FrmMng_numPMCTRCOSbyte4_mp FrmMng_numPMCTRCOSbyte5_mp FrmMng_numPMUBattbyte0_mp FrmMng_numPMUBattbyte1_mp FrmMng_numPMUBattbyte2_mp FrmMng_numPMUBattbyte3_mp FrmMng_numPMUBattbyte4_mp FrmMng_numPMUBattbyte5_mp FrmMng_numPMUBattbyte6_mp FrmMng_numPMUBattbyte7_mp FrmMng_numPRGG_CCTRbyte0_mp FrmMng_numPRGG_CCTRbyte1_mp FrmMng_numPRGG_CCTRbyte2_mp FrmMng_numPRGG_CCTRbyte3_mp FrmMng_numPRGG_CCTRbyte4_mp FrmMng_numPWRMNG_LOADVbyte0_mp FrmMng_numPWRMNG_LOADVbyte1_mp FrmMng_numPWRMNG_LOADVbyte2_mp FrmMng_numPWRMNG_LOADVbyte3_mp FrmMng_numPWRMNG_LOADVbyte4_mp FrmMng_numPWRMNG_LOADVbyte5_mp FrmMng_numPWRMNG_LOADVbyte6_mp FrmMng_numPWRMNG_LOADVbyte7_mp FrmMng_numRADMOMPT1byte0_mp FrmMng_numRADMOMPT1byte1_mp FrmMng_numRADMOMPT1byte2_mp FrmMng_numRADMOMPT1byte3_mp FrmMng_numRADMOMPT1byte4_mp FrmMng_numRADMOMPT1byte5_mp FrmMng_numRADMOMPT1byte6_mp FrmMng_numRADMOMPT1byte7_mp FrmMng_numRADMOMPT2byte0_mp FrmMng_numRADMOMPT2byte1_mp FrmMng_numRADMOMPT2byte2_mp FrmMng_numRADMOMPT2byte3_mp FrmMng_numRADMOMPT2byte4_mp FrmMng_numRADMOMPT2byte5_mp FrmMng_numRADMOMPT2byte6_mp FrmMng_numRADMOMPT2byte7_mp FrmMng_numRPM_STAByte0_mp FrmMng_numRPM_STAByte1_mp FrmMng_numRQ_STG_EFANbyte0_mp FrmMng_numRQ_STG_EFANbyte1_mp FrmMng_numRQ_STG_EFANbyte2_mp FrmMng_numSITZGURTbyte0_mp FrmMng_numSITZGURTbyte1_mp FrmMng_numSITZGURTbyte2_mp FrmMng_numSITZGURTbyte3_mp FrmMng_numSITZGURTbyte4_mp FrmMng_numSPEED_CLCTRbyte0_mp FrmMng_numSPEED_CLCTRbyte1_mp FrmMng_numSPEED_CLCTRbyte2_mp FrmMng_numSPEED_CLCTRbyte3_mp FrmMng_numSPEED_CLCTRbyte4_mp FrmMng_numSPEED_CLCTRbyte5_mp FrmMng_numSPEED_CLCTRbyte6_mp FrmMng_numSPEED_CLCTRbyte7_mp FrmMng_numSTAT_ANHbyte0_mp FrmMng_numSTAT_ARSbyte0_mp FrmMng_numSTAT_ARSbyte1_mp FrmMng_numSTAT_ARSbyte2_mp FrmMng_numSTAT_ARSbyte3_mp FrmMng_numSTAT_ARSbyte4_mp FrmMng_numSTAT_ARSbyte5_mp FrmMng_numSTAT_ARSbyte6_mp FrmMng_numSTAT_ARSbyte7_mp FrmMng_numSTAT_DSCbyte0_mp FrmMng_numSTAT_DSCbyte1_mp FrmMng_numSTAT_DSCbyte2_mp FrmMng_numSTAT_DSCbyte3_mp FrmMng_numSTAT_DSCbyte4_mp FrmMng_numSTAT_DSCbyte5_mp FrmMng_numSTAT_DSCbyte6_mp FrmMng_numSTAT_DSCbyte7_mp FrmMng_numSTAT_EKPbyte0_mp FrmMng_numSTAT_EKPbyte1_mp FrmMng_numSTAT_EKPbyte2_mp FrmMng_numSTAT_EKPbyte3_mp FrmMng_numSTAT_EKPbyte4_mp FrmMng_numSTAT_EKPbyte5_mp FrmMng_numSTAT_EKPbyte6_mp FrmMng_numSTAT_EKPbyte7_mp FrmMng_numSTAT_KOMBIbyte0_mp FrmMng_numSTAT_KOMBIbyte1_mp FrmMng_numSTAT_KOMBIbyte2_mp FrmMng_numSTAT_KOMBIbyte3_mp FrmMng_numSTAT_KOMBIbyte4_mp FrmMng_numSTAT_KOMBIbyte5_mp FrmMng_numSTAT_KOMBIbyte6_mp FrmMng_numSTAT_KOMBIbyte7_mp FrmMng_numTEMPRELTIMEbyte0_mp FrmMng_numTEMPRELTIMEbyte1_mp FrmMng_numTEMPRELTIMEbyte2_mp FrmMng_numTEMPRELTIMEbyte3_mp FrmMng_numTEMPRELTIMEbyte4_mp FrmMng_numTEMPRELTIMEbyte5_mp FrmMng_numTEMPRELTIMEbyte6_mp FrmMng_numTERMINALbyte0_mp FrmMng_numTERMINALbyte1_mp FrmMng_numTERMINALbyte2_mp FrmMng_numTERMINALbyte3_mp FrmMng_numTERMINALbyte4_mp FrmMng_numTIME_DATEbyte0_mp FrmMng_numTIME_DATEbyte1_mp FrmMng_numTIME_DATEbyte2_mp FrmMng_numTIME_DATEbyte3_mp FrmMng_numTIME_DATEbyte4_mp FrmMng_numTIME_DATEbyte5_mp FrmMng_numTIME_DATEbyte6_mp FrmMng_numTORQUE1byte0_mp FrmMng_numTORQUE1byte1_mp FrmMng_numTORQUE1byte2_mp FrmMng_numTORQUE1byte3_mp FrmMng_numTORQUE1byte4_mp FrmMng_numTORQUE1byte5_mp FrmMng_numTORQUE1byte6_mp FrmMng_numTORQUE1byte7_mp FrmMng_numTORQUE2byte0_mp FrmMng_numTORQUE2byte1_mp FrmMng_numTORQUE2byte2_mp FrmMng_numTORQUE2byte3_mp FrmMng_numTORQUE2byte4_mp FrmMng_numTORQUE2byte5_mp FrmMng_numTORQUE2byte6_mp FrmMng_numTORQUE2byte7_mp FrmMng_numTORQUE3byte0_mp FrmMng_numTORQUE3byte1_mp FrmMng_numTORQUE3byte2_mp FrmMng_numTORQUE3byte3_mp FrmMng_numTORQUE3byte4_mp FrmMng_numTORQUE3byte5_mp FrmMng_numTORQUE3byte6_mp FrmMng_numTORQUE3byte7_mp FrmMng_numTORQUE_DSCbyte0_mp FrmMng_numTORQUE_DSCbyte1_mp FrmMng_numTORQUE_DSCbyte2_mp FrmMng_numTORQUE_DSCbyte3_mp FrmMng_numTORQUE_DSCbyte4_mp FrmMng_numTORQUE_DSCbyte5_mp FrmMng_numTORQUE_DSCbyte6_mp FrmMng_numTORQUE_DSCbyte7_mp FrmMng_numTORQUE_GEARBXbyte0_mp FrmMng_numTORQUE_GEARBXbyte1_mp FrmMng_numTORQUE_GEARBXbyte2_mp FrmMng_numTORQUE_GEARBXbyte3_mp FrmMng_numTORQUE_GEARBXbyte4_mp FrmMng_numTORQUE_GEARBXbyte5_mp FrmMng_numTORQUE_GEARBXbyte6_mp FrmMng_numTORQUE_GEARBXbyte7_mp FrmMng_numVEH_MODbyte0_mp FrmMng_numVEH_MODbyte1_mp FrmMng_numVELOCITYbyte0_mp FrmMng_numVELOCITYbyte1_mp FrmMng_numVELOCITYbyte2_mp FrmMng_numVELOCITYbyte3_mp FrmMng_numVELOCITYbyte4_mp FrmMng_numVELOCITYbyte5_mp FrmMng_numVELOCITYbyte6_mp FrmMng_numVELOCITYbyte7_mp FrmMng_numWHEEL_SPEEDbyte0_mp FrmMng_numWHEEL_SPEEDbyte1_mp FrmMng_numWHEEL_SPEEDbyte2_mp FrmMng_numWHEEL_SPEEDbyte3_mp FrmMng_numWHEEL_SPEEDbyte4_mp FrmMng_numWHEEL_SPEEDbyte5_mp FrmMng_numWHEEL_SPEEDbyte6_mp FrmMng_numWHEEL_SPEEDbyte7_mp FrmMng_RadmomPT1RetVal_mp FrmMng_RadmomPT2RetVal_mp FrmMng_rWaterVlv_mp FrmMng_service_index_Byte0_mp FrmMng_service_index_Byte10_mp FrmMng_service_index_Byte11_mp FrmMng_service_index_Byte12_mp FrmMng_service_index_Byte13_mp FrmMng_service_index_Byte14_mp FrmMng_service_index_Byte1_mp FrmMng_service_index_Byte2_mp FrmMng_service_index_Byte3_mp FrmMng_service_index_Byte4_mp FrmMng_service_index_Byte5_mp FrmMng_service_index_Byte6_mp FrmMng_service_index_Byte7_mp FrmMng_service_index_Byte8_mp FrmMng_service_index_Byte9_mp FrmMng_stARSquit_mp FrmMng_stBrk_mp FrmMng_stCrCtl_mp FrmMng_stCurrSig_mp FrmMng_stCurr_byte0_mp FrmMng_stCurr_byte1_mp FrmMng_stCurr_byte2_mp FrmMng_stCurr_byte3_mp FrmMng_stDebValT15CDold_mp FrmMng_stDrvAssist_mp FrmMng_stDSCquit_mp FrmMng_stEng_mp FrmMng_stExcStateCan_mp FrmMng_stExc_ANFRADMOMPT_mp FrmMng_stExc_BOS_RESET_2_mp FrmMng_stExc_BOS_RESET_mp FrmMng_stExc_DM_ANF_ACC_mp FrmMng_stExc_DM_ANF_AFS_mp FrmMng_stExc_DRMANFSSG_mp FrmMng_stExc_GEARBX_DATA2_mp FrmMng_stExc_GEARBX_DATA_mp FrmMng_stExc_HEAT_AC_mp FrmMng_stExc_LRADWINK_mp FrmMng_stExc_MILEAGE_RANGE_mp FrmMng_stExc_OPCRCTLACC_mp FrmMng_stExc_ParkConsumer_mp FrmMng_stExc_PRGG_CCTR_mp FrmMng_stExc_PWRMNG_LOADV_mp FrmMng_stExc_RQ_STG_EFAN_mp FrmMng_stExc_SERVICE_mp FrmMng_stExc_SITZGURT_mp FrmMng_stExc_STAT_ANH_mp FrmMng_stExc_STAT_ARS_mp FrmMng_stExc_STAT_DSC_mp FrmMng_stExc_STAT_EKP_mp FrmMng_stExc_STAT_KOMBI_mp FrmMng_stExc_stCurr_mp FrmMng_stExc_swtPSPOff_mp FrmMng_stExc_TEMPRELTIME_mp FrmMng_stExc_TERMINAL_mp FrmMng_stExc_TIME_DATE_mp FrmMng_stExc_TORQUE_DSC_mp FrmMng_stExc_TORQUE_GEARBX_mp FrmMng_stExc_VEH_MOD_mp FrmMng_stExc_VELOCITY_mp FrmMng_stExc_WHEEL_SPEED_mp FrmMng_stFDC_mp FrmMng_stGearbxHtgUpAct_mp FrmMng_stGearbxquit_mp FrmMng_stHtgUp_mp FrmMng_stLIGov_mp FrmMng_stnErr_mp FrmMng_stOBDGbx_mp FrmMng_stOpPubuCctrAcc_mp FrmMng_stOvrRun_mp FrmMng_stpmsv_mp FrmMng_stpmsv_old_mp FrmMng_stRmp_mp FrmMng_stShutOffHtgUp_mp FrmMng_stSLckAdjVal_mp FrmMng_stSLck_mp FrmMng_stSwClt_mp FrmMng_stSwLevRpm_mp FrmMng_stTrqDisable_mp FrmMng_stTrqInr_mp FrmMng_stWHEEL_SPEEDSig_mp FrmMng_swtAC_mp FrmMng_swtPSPOffSig_mp FrmMng_swtPSPOff_byte0_mp FrmMng_tEngRpm_mp FrmMng_tiRecACC_mp FrmMng_tiRecAC_mp FrmMng_tiRecAFS_mp FrmMng_tiRecARS_mp FrmMng_tiRecDCC_mp FrmMng_tiRecFGR_mp FrmMng_tmrDSMFadeoutANFRADMOMPT_mp FrmMng_tmrDSMFadeoutTERMINAL_mp FrmMng_tmrDSMToTERMINAL_mp FrmMng_torque1RetVal_mp FrmMng_torque2RetVal_mp FrmMng_torque3RetVal_mp FrmMng_trqACC_TrqDes_mp FrmMng_trqBefRmp_mp FrmMng_trqDes_mp FrmMng_trqDSCDes_mp FrmMng_trqFMTCInr_mp FrmMng_trqGbx_mp FrmMng_trqGearbxMax_mp FrmMng_trqInrGearbxOut_mp FrmMng_trqInrSet_mp FrmMng_trqMax_mp FrmMng_trqMin_mp FrmMng_trqResPos_mp FrmMng_trqRmp_mp FrmMng_trqSet_mp FrmMng_trqWheelMax_mp FrmMng_trqWheelMin_mp FrmMng_trqWheelRmp_mp FrmMng_trqWheel_mp /end OUT_MEASUREMENT
/end FUNCTION
/begin FUNCTION frmmng_var_msg ""
 /begin OUT_MEASUREMENT FrmMng_aDirect FrmMng_aSide FrmMng_ctACC_TrqAlv FrmMng_ctrRel FrmMng_ctSTAT_KOMBIalv FrmMng_dACC_CkSTrq FrmMng_dphiStrg FrmMng_dSlopeACP FrmMng_iHiLimCurr FrmMng_iLoLimCurr FrmMng_iZrCurrLim FrmMng_lSum FrmMng_nBattCls FrmMng_nEngRpm1 FrmMng_nEngRpm2 FrmMng_nFan FrmMng_nLimSSG FrmMng_nRqStgEFan FrmMng_nTSC FrmMng_numACFanDes FrmMng_numRqStgEFan FrmMng_parkConsumerFunctionID FrmMng_parkConsumerID2 FrmMng_pBrkSys FrmMng_phiStrg FrmMng_rHtFlowReq FrmMng_rTransDT FrmMng_stACCTrqCtl FrmMng_stACC_ModDME FrmMng_stACC_PrevOvrRunSwtDem FrmMng_stACC_ShtDwnDME FrmMng_stACC_TrqDes FrmMng_stACmainSwt FrmMng_stACnMin FrmMng_stANFRADMOMPTSig FrmMng_stARS FrmMng_stAVAI_BOS_RSTG FrmMng_stBltbDr FrmMng_stBOS_RESETSig FrmMng_stBOS_RESET_2Sig FrmMng_stClCtr FrmMng_stCltSSG FrmMng_stConv FrmMng_stCOU_RSTG_BOS_RSTG FrmMng_stCrCtlRaw FrmMng_stDateDay FrmMng_stDateMon FrmMng_stDateSeason FrmMng_stDateYr FrmMng_stDCC_TrqDes FrmMng_stDecellDSC FrmMng_stDM_ANF_AFSSig FrmMng_stDREHMOMENT_ANF_ACCSig FrmMng_stDRMANFSSGSig FrmMng_stDSCDef FrmMng_stErrAFS FrmMng_stErrStrg FrmMng_stFDC FrmMng_stGbx FrmMng_stGear FrmMng_stGEARBX_DATA2Sig FrmMng_stGEARBX_DATASig FrmMng_stHEAT_ACSig FrmMng_stId2BosRst FrmMng_stId2RqStgEFan FrmMng_stID2_BOS_RSTG FrmMng_stIdFktBosRst FrmMng_stIdFnRqStgEFan FrmMng_stIdlingSpec FrmMng_stID_FN_BOS_RSTG FrmMng_stInjDu FrmMng_stKeyVld FrmMng_stLENKRADWINKELSig FrmMng_stMILEAGE_RANGESig FrmMng_stOPCRCTLACCSig FrmMng_stParkConsumer FrmMng_stParkConsumerSig FrmMng_stPHtr FrmMng_stPrgIntTimeBosRst FrmMng_stPrgIntWayBosRst FrmMng_stPWRMNG_LOADVSig FrmMng_stRecACC FrmMng_stRecAFS FrmMng_stRecARS FrmMng_stRecDCC FrmMng_stRecFDC FrmMng_stRecFGR FrmMng_stRMMI_BOS_RSTG FrmMng_stRQ_STG_EFANSig FrmMng_stShpsSSG FrmMng_stShpsSSGOld FrmMng_stShutOffSSG FrmMng_stSITZGURTSig FrmMng_stSTAT_ANHSig FrmMng_stSTAT_ARSSig FrmMng_stSTAT_DSCSig FrmMng_stSTAT_EKPSig FrmMng_stSTAT_KOMBISig FrmMng_stStiffParameter FrmMng_stT15 FrmMng_stT50 FrmMng_stTEMPRELTIMESig FrmMng_stTERMINALSig FrmMng_stTgMonthBosRst FrmMng_stTgYearBosRst FrmMng_stTIME_DATESig FrmMng_stTorqTarAFS FrmMng_stTORQUE_DSCSig FrmMng_stTORQUE_GEARBXSig FrmMng_stTRadio FrmMng_stTrailer FrmMng_stTrqDesDSC FrmMng_stTrqDesGearbx FrmMng_stTrqLimGearbx FrmMng_stTxRequest FrmMng_stUnitV FrmMng_stVCom FrmMng_stVEH_MODSig FrmMng_stVELOCITYSig FrmMng_stWghSeatDr FrmMng_swtCarType FrmMng_swtPSPOff FrmMng_tOil FrmMng_trqAC FrmMng_trqACC_TrqDes FrmMng_trqARSCur FrmMng_trqARSDes FrmMng_trqARSInc FrmMng_trqAvlAFS FrmMng_trqDesDCC FrmMng_trqDSCDec FrmMng_trqDSCDes FrmMng_trqDSCInc FrmMng_trqGearbxDec FrmMng_trqGearbxDes FrmMng_trqGearbxFrc FrmMng_trqGearbxInc FrmMng_trqGearbxMax FrmMng_trqInr FrmMng_trqTarAFS FrmMng_uAltTarget FrmMng_v FrmMng_vDirection FrmMng_vDisp FrmMng_volFuelFil FrmMng_vWheelLB FrmMng_vWheelLF FrmMng_vWheelRB FrmMng_vWheelRF /end OUT_MEASUREMENT
/end FUNCTION
/begin FUNCTION ftscd "Kraftstofftemperatur Komponententreiber" /begin DEF_CHARACTERISTIC /end DEF_CHARACTERISTIC /begin IN_MEASUREMENT FTSCD_uRaw /end IN_MEASUREMENT /end FUNCTION
/begin FUNCTION ftscd_msg "" /begin OUT_MEASUREMENT FTSCD_tFuel FTSCD_tFuelLin FTSCD_uRaw /end OUT_MEASUREMENT /end FUNCTION
/begin FUNCTION gearbx_data "Getriebeinformation" /begin DEF_CHARACTERISTIC /end DEF_CHARACTERISTIC /end FUNCTION
/begin FUNCTION gearbx_data_msg "" /begin OUT_MEASUREMENT Gearbx_tOil /end OUT_MEASUREMENT /end FUNCTION
/begin FUNCTION gearbx_data_uic "" /end FUNCTION
/begin FUNCTION gearbx_geardet "Gangerkennung" /begin DEF_CHARACTERISTIC /end DEF_CHARACTERISTIC /end FUNCTION
/begin FUNCTION gearbx_geardet_uic "" /end FUNCTION
/begin FUNCTION gearbx_getnmin "Berechnung der Leerlaufsolldrehzahlanforderung vom Getriebe" /begin DEF_CHARACTERISTIC /end DEF_CHARACTERISTIC /begin IN_MEASUREMENT FrmMng_nTSC Gearbx_stGear /end IN_MEASUREMENT /end FUNCTION
/begin FUNCTION gearbx_getnmin_uic "" /begin OUT_MEASUREMENT Gearbx_nMinRaw_mp /end OUT_MEASUREMENT /end FUNCTION
/begin FUNCTION gearbx_intvplauschk "Momentenüberschussintegral" /begin DEF_CHARACTERISTIC /end DEF_CHARACTERISTIC /end FUNCTION
/begin FUNCTION gearbx_intvplauschk_msg "" /begin OUT_MEASUREMENT Gearbx_stDemUnplaus /end OUT_MEASUREMENT /end FUNCTION
/begin FUNCTION gearbx_intvplauschk_uic "" /begin OUT_MEASUREMENT Gearbx_amAct_mp Gearbx_stGbxIncMax_mp Gearbx_trqInt_mp /end OUT_MEASUREMENT /end FUNCTION
/begin FUNCTION gearbx_msg ""
 /begin OUT_MEASUREMENT Gearbx_nMin Gearbx_numGearDes Gearbx_numGearFast Gearbx_rTrans Gearbx_rTrans1 Gearbx_rTrans2 Gearbx_rTrans3 Gearbx_rTrans4 Gearbx_rTrans5 Gearbx_rTrans6 Gearbx_stGear Gearbx_stGearBit Gearbx_swtType Gearbx_trqDec Gearbx_trqFrc Gearbx_trqInc Gearbx_trqInMax /end OUT_MEASUREMENT
/end FUNCTION
/begin FUNCTION gearbx_strtmotrls "" /end FUNCTION
/begin FUNCTION gearbx_strtmotrls_msg "" /begin OUT_MEASUREMENT Gearbx_stStrtMotRls /end OUT_MEASUREMENT /end FUNCTION
/begin FUNCTION gearbx_strtmotrls_uic "" /end FUNCTION
/begin FUNCTION gearbx_trqfrc "aktuelles Verlustmoment Getriebe" /end FUNCTION
/begin FUNCTION gearbx_trqfrc_uic "" /end FUNCTION
/begin FUNCTION gearbx_trqintv "Getriebeeingriff auf Motormoment" /begin DEF_CHARACTERISTIC /end DEF_CHARACTERISTIC /begin IN_MEASUREMENT Eng_nAvrg /end IN_MEASUREMENT /end FUNCTION
/begin FUNCTION gearbx_trqintv_uic "" /begin OUT_MEASUREMENT Gearbx_stIntv_mp Gearbx_trqDecRaw_mp Gearbx_trqIncRaw_mp /end OUT_MEASUREMENT /end FUNCTION
/begin FUNCTION gearbx_trqlim "Getriebeschutz" /begin DEF_CHARACTERISTIC /end DEF_CHARACTERISTIC /begin IN_MEASUREMENT Eng_nAvrg VSSCD_v /end IN_MEASUREMENT /end FUNCTION
/begin FUNCTION gearbx_trqlim_uic "" /begin DEF_CHARACTERISTIC /end DEF_CHARACTERISTIC
 /begin OUT_MEASUREMENT Gearbx_dtrqLimUp_mp Gearbx_stDrvAway_mp Gearbx_trqLimDrvAway_mp Gearbx_trqMaxCur_mp /end OUT_MEASUREMENT
/end FUNCTION
/begin FUNCTION gearcd_pn "Getriebe PN-Stellungserkennung" /begin DEF_CHARACTERISTIC /end DEF_CHARACTERISTIC /end FUNCTION
/begin FUNCTION gearcd_pn_msg "" /begin OUT_MEASUREMENT GearCD_stPN GearCD_stPNRawVal GearCD_swtPNSig /end OUT_MEASUREMENT /end FUNCTION
/begin FUNCTION gearcd_pn_uic "" /begin OUT_MEASUREMENT GearCD_stPNCon_mp /end OUT_MEASUREMENT /end FUNCTION
/begin FUNCTION glwcd "Komponententreiber Glühanlage" /begin DEF_CHARACTERISTIC /end DEF_CHARACTERISTIC /end FUNCTION
/begin FUNCTION glwcd_msg "" /begin OUT_MEASUREMENT GlwCD_pwrGlw /end OUT_MEASUREMENT /end FUNCTION
/begin FUNCTION glwcd_uic ""
 /begin OUT_MEASUREMENT GlwCD_BufLev_mp GlwCD_CtlState_mp GlwCD_ErrBank1_mp GlwCD_ErrPwr_mp GlwCD_OtherReg_mp GlwCD_Parity_mp GlwCD_RawVal_mp GlwCD_Reset_mp GlwCD_stCtl_mp GlwCD_stState_mp /end OUT_MEASUREMENT
/end FUNCTION
/begin FUNCTION glwctl_glwun "Steuerung für Glühsteuergerät" /begin DEF_CHARACTERISTIC /end DEF_CHARACTERISTIC
 /begin IN_MEASUREMENT APSCD_pVal CoEng_trqInrCurr Eng_nAvrg GlwCtl_tClnt IATSCD_tAir /end IN_MEASUREMENT
/end FUNCTION
/begin FUNCTION glwctl_glwun_msg "" /begin OUT_MEASUREMENT GlwCtl_rPwrOut /end OUT_MEASUREMENT /end FUNCTION
/begin FUNCTION glwctl_glwun_uic "" /begin OUT_MEASUREMENT GlwCtl_rLimitRaw_mp GlwCtl_rLimit_mp GlwCtl_rRaw_mp /end OUT_MEASUREMENT /end FUNCTION
/begin FUNCTION glwctl_logic "Glühzeitkontrolle" /begin DEF_CHARACTERISTIC /end DEF_CHARACTERISTIC /begin IN_MEASUREMENT GlwCtl_tClnt /end IN_MEASUREMENT /end FUNCTION
/begin FUNCTION glwctl_logic_msg "" /begin OUT_MEASUREMENT GlwCtl_stLampEna GlwCtl_stLogic GlwCtl_tClnt /end OUT_MEASUREMENT /end FUNCTION
/begin FUNCTION glwctl_logic_uic ""
 /begin OUT_MEASUREMENT GlwCtl_ctPreGlw_mp GlwCtl_stHdnPreGlwOld_mp GlwCtl_stHdnPreGlwTrg_mp GlwCtl_stHdnPreGlw_mp GlwCtl_stLogicCond_mp GlwCtl_stStrtMFlag_mp GlwCtl_tiPre_mp /end OUT_MEASUREMENT
/end FUNCTION
/begin FUNCTION glwctl_rly "Steuerung für Glührelais" /begin DEF_CHARACTERISTIC /end DEF_CHARACTERISTIC /begin IN_MEASUREMENT APSCD_pVal BattCD_u GlwCtl_tClnt /end IN_MEASUREMENT /end FUNCTION
/begin FUNCTION glwctl_rly_msg "" /begin OUT_MEASUREMENT GlwCtl_stLampOut /end OUT_MEASUREMENT /end FUNCTION
/begin FUNCTION glwctl_rly_uic "" /begin OUT_MEASUREMENT GlwCtl_stLampCond_mp GlwCtl_tiLamp_mp /end OUT_MEASUREMENT /end FUNCTION
/begin FUNCTION hpun_co "Hochdruckpumpe" /begin DEF_CHARACTERISTIC /end DEF_CHARACTERISTIC /begin IN_MEASUREMENT Eng_nAvrg FlSys_t FTSCD_tFuel /end IN_MEASUREMENT /end FUNCTION
/begin FUNCTION hpun_co_msg "" /begin OUT_MEASUREMENT HPUn_numInjQntBal HPUn_qLim HPUn_trqDes /end OUT_MEASUREMENT /end FUNCTION
/begin FUNCTION hpun_co_uic ""
 /begin OUT_MEASUREMENT HPUn_dvolPmpMaxCor_mp HPUn_dvolPmpMax_mp HPUn_etaPmpFlTemp_mp HPUn_etaPmpMaxAged_mp HPUn_qBalLim_mp HPUn_qFlTempLim_mp HPUn_stQntBal_mp /end OUT_MEASUREMENT
/end FUNCTION
/begin FUNCTION hpun_qntbalinjlim "maximale Anzahl an Einspritzungen aufgrund der Mengenbilanz der Hochdruckpumpe" /begin DEF_CHARACTERISTIC /end DEF_CHARACTERISTIC /end FUNCTION
/begin FUNCTION hpun_qntbalinjlim_uic "" /begin OUT_MEASUREMENT HPUn_pRailDvtFlt_mp HPUn_stNumInjMax_mp /end OUT_MEASUREMENT /end FUNCTION
/begin FUNCTION hwemon "Monitoring of Hardware Encapsulation Functions" /begin DEF_CHARACTERISTIC /end DEF_CHARACTERISTIC /end FUNCTION
/begin FUNCTION hwemon_msg "" /begin OUT_MEASUREMENT HWEMon_ctRecovery HWEMon_numRecovery /end OUT_MEASUREMENT /end FUNCTION
/begin FUNCTION hwemon_uic ""
 /begin OUT_MEASUREMENT HWEMon_recLocHigh_mp HWEMon_recLocLow_mp HWEMon_stVoltMon_mp /end OUT_MEASUREMENT
/end FUNCTION
/begin FUNCTION iatscd "Lufttemperaturfühler Komponententreiber" /begin DEF_CHARACTERISTIC /end DEF_CHARACTERISTIC /begin IN_MEASUREMENT IATSCD_uRaw /end IN_MEASUREMENT /end FUNCTION
/begin FUNCTION iatscd_cats "" /begin DEF_CHARACTERISTIC /end DEF_CHARACTERISTIC /begin IN_MEASUREMENT IATSCD_uRawCats /end IN_MEASUREMENT /end FUNCTION
/begin FUNCTION iatscd_cats_msg ""
 /begin OUT_MEASUREMENT IATSCD_dtAirCats IATSCD_swtSigCats IATSCD_tAirCats IATSCD_tAirLinCats IATSCD_uRawCats /end OUT_MEASUREMENT
/end FUNCTION
/begin FUNCTION iatscd_cats_uic "" /end FUNCTION
/begin FUNCTION iatscd_cats_var_msg "" /end FUNCTION
/begin FUNCTION iatscd_msg ""
 /begin OUT_MEASUREMENT IATSCD_dtAir IATSCD_swtSig IATSCD_tAir IATSCD_tAirLin IATSCD_uRaw /end OUT_MEASUREMENT
/end FUNCTION
/begin FUNCTION iatscd_uic "" /end FUNCTION
/begin FUNCTION iatscd_var_msg "" /end FUNCTION
/begin FUNCTION ibscd "" /begin DEF_CHARACTERISTIC /end DEF_CHARACTERISTIC /end FUNCTION
/begin FUNCTION ibscd_ht "" /begin DEF_CHARACTERISTIC /end DEF_CHARACTERISTIC /end FUNCTION
/begin FUNCTION ibscd_ht_uic "" /begin OUT_MEASUREMENT IBSCD_BsdControl_mp IBSCD_stB_ibsactiv_mp /end OUT_MEASUREMENT /end FUNCTION
/begin FUNCTION ibscd_msg "" /end FUNCTION
/begin FUNCTION ibscd_uic "" /begin OUT_MEASUREMENT IBSCD_BsdData_mp IBSCD_BsdRegAdr_mp IBSCD_stB_ibsdetec_mp /end OUT_MEASUREMENT /end FUNCTION
/begin FUNCTION ignlck "Zündschloss" /end FUNCTION
/begin FUNCTION ignlck_msg "" /begin OUT_MEASUREMENT IgnLck_st /end OUT_MEASUREMENT /end FUNCTION
/begin FUNCTION ignlck_uic "" /end FUNCTION
/begin FUNCTION immcd "Immobilizer component driver" /begin DEF_CHARACTERISTIC /end DEF_CHARACTERISTIC /end FUNCTION
/begin FUNCTION immcd_msg "" /begin OUT_MEASUREMENT ImmCD_dChangeVal ImmCD_dChlg ImmCD_stEval /end OUT_MEASUREMENT /end FUNCTION
/begin FUNCTION immcd_uic "" /end FUNCTION
/begin FUNCTION immctl "Steuerung Wegfahrsperre" /begin DEF_CHARACTERISTIC /end DEF_CHARACTERISTIC /end FUNCTION
/begin FUNCTION immctl_msg ""
 /begin OUT_MEASUREMENT ImmCtl_dChlg ImmCtl_dVal ImmCtl_stDia ImmCtl_stIniSeq ImmCtl_stLck ImmCtl_stReqRx ImmCtl_stWr ImmDia_stImmCtl /end OUT_MEASUREMENT
/end FUNCTION
/begin FUNCTION immctl_uic "" /end FUNCTION
/begin FUNCTION immeep_eval "" /end FUNCTION
/begin FUNCTION immeep_eval_msg ""
 /begin OUT_MEASUREMENT ImmEep_ctStrtVal ImmEep_dChangeValEval ImmEep_dChangeValEvalLst ImmEep_dChlgEval ImmEep_dStrtValEval ImmEep_stDia ImmEep_stEvalDia ImmEep_stMultProgRls ImmEep_stWr /end OUT_MEASUREMENT
/end FUNCTION
/begin FUNCTION immeep_eval_uic ""
 /begin OUT_MEASUREMENT ImmEep_ctStrtVal_mp ImmEep_dChangeVal1_mp ImmEep_dChangeVal2_mp ImmEep_dChangeVal3_mp ImmEep_dChangeValLst1_mp ImmEep_dChangeValLst2_mp ImmEep_dChangeValLst3_mp ImmEep_dChlg_mp ImmEep_dStrtVal1_mp ImmEep_dStrtVal2_mp ImmEep_dStrtVal3_mp ImmEep_stUpdEepAct_mp /end OUT_MEASUREMENT
/end FUNCTION
/begin FUNCTION indsys_bpatdefdet "" /begin DEF_CHARACTERISTIC /end DEF_CHARACTERISTIC /begin IN_MEASUREMENT APSCD_pVal Eng_nAvrg Eng_tEng InjCtl_qSetUnBal /end IN_MEASUREMENT /end FUNCTION
/begin FUNCTION indsys_bpatdefdet_uic ""
 /begin OUT_MEASUREMENT IndSys_mAirPerCylLim_mp IndSys_stPart1_mp IndSys_stPart2_mp /end OUT_MEASUREMENT
/end FUNCTION
/begin FUNCTION indsys_calcswirl "Drallniveausteuerung" /begin DEF_CHARACTERISTIC /end DEF_CHARACTERISTIC /begin IN_MEASUREMENT CTSCD_tClnt Eng_nAvrg IATSCD_tAir InjCtl_qCurr InjCtl_qRaw /end IN_MEASUREMENT /end FUNCTION
/begin FUNCTION indsys_calcswirl_uic "" /begin DEF_CHARACTERISTIC /end DEF_CHARACTERISTIC
 /begin OUT_MEASUREMENT IndSys_rVSAATCorr_mp IndSys_rVSABase_mp IndSys_rVSAByp_mp IndSys_rVSACorr_mp IndSys_rVSACTCorr_mp /end OUT_MEASUREMENT
/end FUNCTION
/begin FUNCTION indsys_msg "" /begin OUT_MEASUREMENT IndSys_rVSA /end OUT_MEASUREMENT /end FUNCTION
/begin FUNCTION indsys_tair_msg "" /begin OUT_MEASUREMENT IndSys_tFld /end OUT_MEASUREMENT /end FUNCTION
/begin FUNCTION indsys_tair_uic "" /end FUNCTION
/begin FUNCTION indsys_uic "" /end FUNCTION
/begin FUNCTION injcrv "Einspritzverlauf" /begin DEF_CHARACTERISTIC /end DEF_CHARACTERISTIC /end FUNCTION
/begin FUNCTION injcrv_co "Spritzbeginn Sollwertbildung" /begin DEF_CHARACTERISTIC /end DEF_CHARACTERISTIC /begin IN_MEASUREMENT Eng_nAvrg InjCtl_qSetUnBal /end IN_MEASUREMENT /end FUNCTION
/begin FUNCTION injcrv_copiirlsaddcor "" /begin DEF_CHARACTERISTIC /end DEF_CHARACTERISTIC /end FUNCTION
/begin FUNCTION injcrv_copiirlsaddcor_uic ""
 /begin OUT_MEASUREMENT InjCrv_stPiI2RlsAirP_mp InjCrv_stPiI2RlsAirTBit_mp InjCrv_stPiI2RlsAirT_mp InjCrv_stPiI2RlsQRaw_mp InjCrv_stPiIRlsStructRaw_mp /end OUT_MEASUREMENT
/end FUNCTION
/begin FUNCTION injcrv_copiirlscor "" /begin DEF_CHARACTERISTIC /end DEF_CHARACTERISTIC /begin IN_MEASUREMENT Eng_nAvrg InjCtl_qSetUnBal /end IN_MEASUREMENT /end FUNCTION
/begin FUNCTION injcrv_copiirlscor_uic ""
 /begin OUT_MEASUREMENT InjCrv_stPiI2RlsOpRng6Bit_mp InjCrv_stPiIRlsCor_mp InjCrv_stPiIRlsOpRng6_mp /end OUT_MEASUREMENT
/end FUNCTION
/begin FUNCTION injcrv_copiirlsoprng "" /begin DEF_CHARACTERISTIC /end DEF_CHARACTERISTIC /begin IN_MEASUREMENT IATSCD_tAir InjCrv_tEng /end IN_MEASUREMENT /end FUNCTION
/begin FUNCTION injcrv_copiirlsoprng_uic "" /begin OUT_MEASUREMENT InjCrv_stPiIRlsOpRng_mp /end OUT_MEASUREMENT /end FUNCTION
/begin FUNCTION injcrv_co_msg ""
 /begin OUT_MEASUREMENT InjCrv_numInjMaxSys InjCrv_PoI2RgnVal InjCrv_PoI2RgnValTSync InjCrv_stInjCharActVal InjCrv_stInjCharPrio InjCrv_stInjCharPrioTSync InjCrv_stInjCharSetVal InjCrv_stInjCharSetValTSync InjCrv_swtPiIDblCorMap InjCrv_tEng /end OUT_MEASUREMENT
/end FUNCTION
/begin FUNCTION injcrv_co_uic "" /begin DEF_CHARACTERISTIC /end DEF_CHARACTERISTIC
 /begin OUT_MEASUREMENT InjCrv_numInjDes_mp InjCrv_numInjLim_mp InjCrv_stInjCharDes_mp InjCrv_stInjCharSetVal_mp InjCrv_stPiIRlsRaw_mp InjCrv_stPiIRlsStruct_mp /end OUT_MEASUREMENT
/end FUNCTION
/begin FUNCTION injcrv_ctlqnt "" /end FUNCTION
/begin FUNCTION injcrv_ctlqnt_msg "" /begin OUT_MEASUREMENT InjCrv_qLmbdCtl InjCrv_qTot InjCrv_stLmbdCtl /end OUT_MEASUREMENT /end FUNCTION
/begin FUNCTION injcrv_ctlqnt_uic "" /end FUNCTION
/begin FUNCTION injcrv_mi "Einspritzverlauf - Haupteinspritzung" /begin DEF_CHARACTERISTIC /end DEF_CHARACTERISTIC /begin IN_MEASUREMENT Eng_nAvrg InjCrv_tEng InjCtl_qSetUnBal /end IN_MEASUREMENT /end FUNCTION
/begin FUNCTION injcrv_mi1phiaddcorslow "Haupteinspritzung - projektspezifische Korrekturen zeitsynchron" /begin DEF_CHARACTERISTIC /end DEF_CHARACTERISTIC /begin IN_MEASUREMENT APSCD_pVal CTSCD_tClnt IATSCD_tAir InjCrv_tEng /end IN_MEASUREMENT /end FUNCTION
/begin FUNCTION injcrv_mi1phiaddcorslow_uic "" /end FUNCTION
/begin FUNCTION injcrv_miaddcor "Haupteinspritzung - projektspezifische Korrekturen" /begin DEF_CHARACTERISTIC /end DEF_CHARACTERISTIC
 /begin IN_MEASUREMENT Eng_nAvrg InjCrv_dpMIDynCor InjCrv_dqSetUnBalFltLim InjCrv_pMIDynCor_mp InjCtl_qSetUnBal /end IN_MEASUREMENT
/end FUNCTION
/begin FUNCTION injcrv_miaddcor_msg ""
 /begin OUT_MEASUREMENT InjCrv_dpMIDynCor InjCrv_dqSetUnBalFltLim InjCrv_facMI1DynCorSlow2 InjCrv_facMIDynCor InjCrv_phiMI1AddCor InjCrv_phiMI1AddCor2 /end OUT_MEASUREMENT
/end FUNCTION
/begin FUNCTION injcrv_miaddcor_uic ""
 /begin OUT_MEASUREMENT InjCrv_dqSetUnBal_mp InjCrv_facMI1DynCor2_mp InjCrv_facMIPDynCor_mp InjCrv_phiMI1DynCor1_mp InjCrv_phiMI1DynCor2Bas_mp InjCrv_phiMI1DynCor2_mp InjCrv_phiMIAPSDynCor_mp InjCrv_phiMIDynCor_mp InjCrv_phiMIPDynCor_mp InjCrv_pMIDynCor_mp InjCrv_tiDQPT1AddCor2_mp /end OUT_MEASUREMENT
/end FUNCTION
/begin FUNCTION injcrv_mienvcor "Haupteinspritzung - Umwelt - Korrekturen" /begin DEF_CHARACTERISTIC /end DEF_CHARACTERISTIC /begin IN_MEASUREMENT Eng_nAvrg InjCtl_qSetUnBal /end IN_MEASUREMENT /end FUNCTION
/begin FUNCTION injcrv_mienvcorrgn "Haupteinspritzung - Umwelt - Korrekturen für den Regenerationsbetrieb" /end FUNCTION
/begin FUNCTION injcrv_mienvcorrgn_msg "" /end FUNCTION
/begin FUNCTION injcrv_mienvcorrgn_uic "" /end FUNCTION
/begin FUNCTION injcrv_mienvcorslow "Korrekturen für die Haupteinspritzung (langsamer Prozess)" /begin DEF_CHARACTERISTIC /end DEF_CHARACTERISTIC /begin IN_MEASUREMENT APSCD_pVal IATSCD_tAir InjCrv_tEng Rail_pSetPointFlTempCor /end IN_MEASUREMENT /end FUNCTION
/begin FUNCTION injcrv_mienvcorslowrgn "Haupteinspritzung - Umwelt - Gewichtungsfaktoren für den Regenerationsbetrieb" /end FUNCTION
/begin FUNCTION injcrv_mienvcorslowrgn_msg "" /end FUNCTION
/begin FUNCTION injcrv_mienvcorslowrgn_uic "" /end FUNCTION
/begin FUNCTION injcrv_mienvcorslow_msg ""
 /begin OUT_MEASUREMENT InjCrv_facMIAPSPhiCor InjCrv_facMIAPSPhiCor2 InjCrv_facMIAPSPhiCorStrt InjCrv_facMIATSPhiCor InjCrv_facMIATSPhiCor2 InjCrv_facMIATSPhiCorStrt InjCrv_facMIETSPhiCor InjCrv_facMIETSPhiCor1 InjCrv_facMIETSPhiCor12 InjCrv_facMIETSPhiCor2 InjCrv_facMIETSPhiCorStrt InjCrv_facMIFTSRailCor InjCrv_facMIFTSRailCorStrt /end OUT_MEASUREMENT
/end FUNCTION
/begin FUNCTION injcrv_mienvcorslow_uic "" /end FUNCTION
/begin FUNCTION injcrv_mienvcor_msg ""
 /begin OUT_MEASUREMENT InjCrv_phiMI1EnvCor InjCrv_phiMI1EnvCor2 InjCrv_phiMI1EnvCorStrt /end OUT_MEASUREMENT
/end FUNCTION
/begin FUNCTION injcrv_mienvcor_uic ""
 /begin OUT_MEASUREMENT InjCrv_phiMIAPSCor2_mp InjCrv_phiMIAPSCorStrt_mp InjCrv_phiMIAPSCor_mp InjCrv_phiMIATSCor2_mp InjCrv_phiMIATSCorStrt_mp InjCrv_phiMIATSCor_mp InjCrv_phiMIETSCor12_mp InjCrv_phiMIETSCor1_mp InjCrv_phiMIETSCor2_mp InjCrv_phiMIETSCorStrt_mp InjCrv_phiMIETSCor_mp InjCrv_phiMIFTSRailCorStrt_mp InjCrv_phiMIFTSRailCor_mp /end OUT_MEASUREMENT
/end FUNCTION
/begin FUNCTION injcrv_mirgn "Haupteinspritzung Regenerationswertberechnung" /begin DEF_CHARACTERISTIC /end DEF_CHARACTERISTIC /begin IN_MEASUREMENT CTSCD_tClnt Eng_nAvrg InjCtl_qSetUnBal /end IN_MEASUREMENT /end FUNCTION
/begin FUNCTION injcrv_mirgnlib "Regeneration function library for MI" /begin DEF_CHARACTERISTIC /end DEF_CHARACTERISTIC /end FUNCTION
/begin FUNCTION injcrv_mirgn_msg "" /begin OUT_MEASUREMENT InjCrv_phiMI1Rgn InjCrv_qMI1Rgn InjCrv_tiMI1Rgn /end OUT_MEASUREMENT /end FUNCTION
/begin FUNCTION injcrv_mirgn_uic "" /begin DEF_CHARACTERISTIC /end DEF_CHARACTERISTIC
 /begin OUT_MEASUREMENT InjCrv_phiMI1RgnByp_mp InjCrv_phiMI1Rgn_mp InjCrv_phiMIETSCorRgn_mp InjCrv_qMI1RgnByp_mp /end OUT_MEASUREMENT
/end FUNCTION
/begin FUNCTION injcrv_mirmtctl_uic "" /end FUNCTION
/begin FUNCTION injcrv_misoergn_msg "" /begin OUT_MEASUREMENT InjCrv_MI1RgnVal InjCrv_phiStrtInjSetPoint /end OUT_MEASUREMENT /end FUNCTION
/begin FUNCTION injcrv_misoergn_uic "" /end FUNCTION
/begin FUNCTION injcrv_mistrt "Berechnung Start der Einspritzung während Start" /begin DEF_CHARACTERISTIC /end DEF_CHARACTERISTIC /begin IN_MEASUREMENT Eng_nAvrg InjCtl_qSetUnBal /end IN_MEASUREMENT /end FUNCTION
/begin FUNCTION injcrv_mistrt_uic "" /begin OUT_MEASUREMENT InjCrv_phiMI1StrtCor_mp /end OUT_MEASUREMENT /end FUNCTION
/begin FUNCTION injcrv_mi_msg "" /begin OUT_MEASUREMENT InjCrv_phiMI1Des InjCrv_qMI1Des InjCrv_tiMI1ET /end OUT_MEASUREMENT /end FUNCTION
/begin FUNCTION injcrv_mi_uic "" /begin DEF_CHARACTERISTIC /end DEF_CHARACTERISTIC
 /begin OUT_MEASUREMENT InjCrv_phiMI1Bas_mp InjCrv_phiMI1Cor_mp InjCrv_phiMI1DesByp_mp InjCrv_phiMI1Lim_mp InjCrv_phiMI1Max_mp InjCrv_phiMI1Min_mp InjCrv_qMI1DesByp_mp InjCrv_qMI1Min_mp InjCrv_qMI1Nrm_mp InjCrv_qMI1Set_mp InjCrv_volMI1Cor_mp InjCrv_volMI1_mp /end OUT_MEASUREMENT
/end FUNCTION
/begin FUNCTION injcrv_pii "Einspritzverlauf - Voreinspritzung" /begin DEF_CHARACTERISTIC /end DEF_CHARACTERISTIC /begin IN_MEASUREMENT Eng_nAvrg InjCtl_qSetUnBal RailCD_pPeak /end IN_MEASUREMENT /begin OUT_MEASUREMENT InjCrv_PiI1RgnVal_mp /end OUT_MEASUREMENT /end FUNCTION
/begin FUNCTION injcrv_pii1soephibas "" /end FUNCTION
/begin FUNCTION injcrv_pii1soephibas_uic "" /begin OUT_MEASUREMENT InjCrv_phiPiI1Bas_mp /end OUT_MEASUREMENT /end FUNCTION
/begin FUNCTION injcrv_pii1soetibas "" /begin DEF_CHARACTERISTIC /end DEF_CHARACTERISTIC /begin IN_MEASUREMENT Eng_nAvrg InjCtl_qSetUnBal /end IN_MEASUREMENT /end FUNCTION
/begin FUNCTION injcrv_pii1soetibas_uic "" /begin OUT_MEASUREMENT InjCrv_tiPiI1Bas_mp /end OUT_MEASUREMENT /end FUNCTION
/begin FUNCTION injcrv_pii1strt "" /begin DEF_CHARACTERISTIC /end DEF_CHARACTERISTIC /begin IN_MEASUREMENT Eng_nAvrg InjCtl_qSetUnBal /end IN_MEASUREMENT /end FUNCTION
/begin FUNCTION injcrv_pii1strt_uic "" /begin OUT_MEASUREMENT InjCrv_qPiI1BasStrt_mp InjCrv_tiPiI1BasStrt_mp /end OUT_MEASUREMENT /end FUNCTION
/begin FUNCTION injcrv_pii2 "Einspritzverlauf - Voreinspritzung 2" /begin DEF_CHARACTERISTIC /end DEF_CHARACTERISTIC /begin IN_MEASUREMENT Eng_nAvrg InjCtl_qSetUnBal RailCD_pPeak /end IN_MEASUREMENT /begin OUT_MEASUREMENT InjCrv_PiI2RgnVal_mp /end OUT_MEASUREMENT /end FUNCTION
/begin FUNCTION injcrv_pii2addcor "PiI2 - projektspezifische Korrektur" /end FUNCTION
/begin FUNCTION injcrv_pii2addcorphi "" /end FUNCTION
/begin FUNCTION injcrv_pii2addcorphi_uic "" /end FUNCTION
/begin FUNCTION injcrv_pii2addcorslow "Gewichtungsfaktor für projektspezifische Korrektur der PiI2" /end FUNCTION
/begin FUNCTION injcrv_pii2addcorslow_msg "" /end FUNCTION
/begin FUNCTION injcrv_pii2addcorslow_uic "" /end FUNCTION
/begin FUNCTION injcrv_pii2addcorti_uic "" /end FUNCTION
/begin FUNCTION injcrv_pii2addcor_msg ""
 /begin OUT_MEASUREMENT InjCrv_phiPiI2AddCor InjCrv_qPiI2AddCor InjCrv_tiPiI2AddCor /end OUT_MEASUREMENT
/end FUNCTION
/begin FUNCTION injcrv_pii2addcor_uic "" /end FUNCTION
/begin FUNCTION injcrv_pii2envcor "Voreinspritzung 2 - Umwelt -Korrekturen" /begin DEF_CHARACTERISTIC /end DEF_CHARACTERISTIC /begin IN_MEASUREMENT Eng_nAvrg InjCtl_qSetUnBal /end IN_MEASUREMENT /end FUNCTION
/begin FUNCTION injcrv_pii2envcorphi "" /end FUNCTION
/begin FUNCTION injcrv_pii2envcorphi_uic "" /begin OUT_MEASUREMENT InjCrv_phiPiI2ETSCor_mp /end OUT_MEASUREMENT /end FUNCTION
/begin FUNCTION injcrv_pii2envcorslow "" /begin DEF_CHARACTERISTIC /end DEF_CHARACTERISTIC /begin IN_MEASUREMENT APSCD_pVal IATSCD_tAir InjCrv_tEng /end IN_MEASUREMENT /end FUNCTION
/begin COMPU_METHOD Acc "Fahrzeugbeschleunigung" RAT_FUNC "%6.5" "m/s^2" COEFFS 0 1000 0 0 0 1 /end COMPU_METHOD
/begin COMPU_METHOD AirMassPerCyl "Luftmasse pro Zylinder" RAT_FUNC "%6.3" "mg/Hub" COEFFS 0 10 0 0 0 1 /end COMPU_METHOD
/begin COMPU_METHOD AngleCrS "Winkel Kurbelwelle" RAT_FUNC "%6.4" "deg CrS" COEFFS 0 42.6666666666667 0 0 0 1 /end COMPU_METHOD
/begin COMPU_METHOD AngleGrad "Winkelanzeige in Grad" RAT_FUNC "%6.4" "Grad" COEFFS 0 22.7531285551763 0 0 0 1 /end COMPU_METHOD
/begin COMPU_METHOD AngleGradPerSec "Winkelanzeige in Grad pro Sekunde" RAT_FUNC "%6.4" "Grad/s" COEFFS 0 22.7531285551763 0 0 0 1 /end COMPU_METHOD
/begin COMPU_METHOD B_TRUE "Umrechnung   ----> FALSE;    TRUE = TRUE" TAB_VERB "%6.3" "-" COMPU_TAB_REF B_TRUE /end COMPU_METHOD
/begin COMPU_VTAB B_TRUE "Umrechnung   ----> FALSE;    TRUE = TRUE" TAB_VERB 2 0 "FALSE" 1 "TRUE" /end COMPU_VTAB
/begin COMPU_METHOD CarType "" TAB_VERB "%6.3" "-" COMPU_TAB_REF CarType /end COMPU_METHOD
/begin COMPU_VTAB CarType "" TAB_VERB 5 0 "E60" 1 "E65" 2 "E90" 3 "E83" 4 "E87" /end COMPU_VTAB
/begin COMPU_METHOD DEZ "K3 Umwandlungen" RAT_FUNC "%6.2" "-" COEFFS 0 1 0 0 0 1 /end COMPU_METHOD
/begin COMPU_METHOD dp_dZ20 " boost pressure per time (dp/dt) every 20ms" RAT_FUNC "%6.1" "hPa/s" COEFFS 0 0.1 0 0 0 1 /end COMPU_METHOD
/begin COMPU_METHOD DtyCyc "Tastverhaeltnis" RAT_FUNC "%6.4" "%" COEFFS 0 100 0 0 0 1 /end COMPU_METHOD
/begin COMPU_METHOD EGTSwt "Umrechnung für EGT Rampenschalter (1 / 1000*2^14 )" RAT_FUNC "%10.9" "-" COEFFS 0 16384000 0 0 0 1 /end COMPU_METHOD
/begin COMPU_METHOD EngN "Motordrehzahl" RAT_FUNC "%6.2" "rpm" COEFFS 0 1 0 0 0 1 /end COMPU_METHOD
/begin COMPU_METHOD Eta "Umrechnugsformel für Wirkungsgradfaktor eta" RAT_FUNC "%6.4" "Nm/(mg/cyc)" COEFFS 0 128 0 0 0 1 /end COMPU_METHOD
/begin COMPU_METHOD Fact "Faktor mit Auflösung 1 / 8192, hauptsächlich für einen Faktorenbereich 0...1 verwendet" RAT_FUNC "%6.5" "-" COEFFS 0 8192 0 0 0 1 /end COMPU_METHOD
/begin COMPU_METHOD FanSpd "(MAXSINT16 / FANSPD_MAX) * phys" RAT_FUNC "%6.3" "1/min" COEFFS 0 10.9223333333333 0 0 0 1 /end COMPU_METHOD
/begin COMPU_METHOD Fl_Half_L "Kraftstoffverbrauchsintegral" RAT_FUNC "%6.4" "l" COEFFS 0 20 0 0 0 1 /end COMPU_METHOD
/begin COMPU_METHOD InjMassCyc "Einspritzmenge pro Zyklus (mg/Zyklus)" RAT_FUNC "%6.4" "mg/cyc" COEFFS 0 100 0 0 0 1 /end COMPU_METHOD
/begin COMPU_METHOD InjMassInj "Einspritzmenge pro Einspritzung (mg/Einspritzung)" RAT_FUNC "%6.4" "mg/inj" COEFFS 0 100 0 0 0 1 /end COMPU_METHOD
/begin COMPU_METHOD InjMassPerSec_20ms "Einspritzmengenänderung pro Sekunde für 20ms-Tasks" RAT_FUNC "%6.3" "mg/hub/s" COEFFS 0 2 0 0 0 1 /end COMPU_METHOD
/begin COMPU_METHOD InjQntInj "Einspritzmenge der einzelnen Einspritzung" RAT_FUNC "%6.4" "mm^3/inj" COEFFS 0 100 0 0 0 1 /end COMPU_METHOD
/begin COMPU_METHOD InjTime_us "Zeit in Microsekunden für das Einspritztiming" RAT_FUNC "%6.2" "us" COEFFS 0 1 0 0 0 1 /end COMPU_METHOD
/begin COMPU_METHOD i_ub_q0p001 "K3 Umwandlungen" RAT_FUNC "%5.4" "A" COEFFS 0 1 0 0 0 0.001 /end COMPU_METHOD
/begin COMPU_METHOD i_ub_q10p0 "K3 Umwandlungen" RAT_FUNC "%5.1" "A" COEFFS 0 1 0 0 0 10 /end COMPU_METHOD
/begin COMPU_METHOD Ki_Trq2TrqT "Integrale Verstärkung Ki (Getriebeausgangsmoment über die Zeit aufintegriert)" RAT_FUNC "%6.4" "Nms" COEFFS 0 171.79869184 0 0 0 1 /end COMPU_METHOD
/begin COMPU_METHOD Ki_Trq2TrqT2 "Integrale Verstärkung Ki (Kupplungsmoment über die Zeit aufintegriert)" RAT_FUNC "%6.4" "Nms" COEFFS 0 429.4967296 0 0 0 1 /end COMPU_METHOD
/begin COMPU_METHOD Ki_us2mA "Umrechnung für PI-(Ent)ladezeitregler" RAT_FUNC "%6.4" "mA/(us*s)" COEFFS 0 429.4967296 0 0 0 1 /end COMPU_METHOD
/begin COMPU_METHOD Ki_Vel2TrqPrp "Integralverstärkung (Fahrgeschwindigkeit zu Vortriebsmoment)" RAT_FUNC "%6.4" "Nm/(km/h)/s" COEFFS 0 214.7483648 0 0 0 1 /end COMPU_METHOD
/begin COMPU_METHOD Ki_VOLTPA2FACT "Integrale Verstärkung (Umrechnung von der Aktorspannung auf Faktor)" RAT_FUNC "%8.7" "1/(V*s)" COEFFS 0 351843.72088832 0 0 0 1 /end COMPU_METHOD
/begin COMPU_METHOD Kp_1 "proportionale Verstärkung Kp (gleiche Einheit/Umrechnungsregel an Ein- und Ausgang; Umrechnung für sint16-Werte)" RAT_FUNC "%6.4" "1/1" COEFFS 0 64 0 0 0 1 /end COMPU_METHOD
/begin COMPU_METHOD Kp_Ampc2Prc "Proportionalverstärkung (Luftmasse zu Prozent)" RAT_FUNC "%8.7" "%/(mg/Hub Luft)" COEFFS 0 536870.912 0 0 0 1 /end COMPU_METHOD
/begin COMPU_METHOD Kp_LmbdRec2InjMass_1 "Proportionale Verstärkung Kp (reziprokes Lambda zu Einspritzmenge)" RAT_FUNC "%6.4" "mg/stroke" COEFFS 0 81.92 0 0 0 1 /end COMPU_METHOD
/begin COMPU_METHOD Kp_LmbdRec2InjMass_2 "Proportionale Verstärkung Kp (reziprokes Lambda zu Einspritzmenge)" RAT_FUNC "%6.4" "mg/stroke" COEFFS 0 81.92 0 0 0 1 /end COMPU_METHOD
/begin COMPU_METHOD Kp_pRail2Q_1 "Proportionale Verstärkung mit Normexponent (Raildruck zu Menge)" RAT_FUNC "%10.3" "mm^3/s/bar" COEFFS 0 81.920000 0 0 0 1 /end COMPU_METHOD
/begin COMPU_METHOD Kp_Pres_fac2hPa "Gain Conversion from Factor to Hpa" RAT_FUNC "%6.5" "hPa" COEFFS 0 4096 0 0 0 1 /end COMPU_METHOD
/begin COMPU_METHOD Kp_Pres_hPa2Prc "Proportionale Verstärkung (Druck Pres_hPa zu Prozent Prc)" RAT_FUNC "%9.8" "%/hPa" COEFFS 0 5368709.12 0 0 0 1 /end COMPU_METHOD
/begin COMPU_METHOD Kp_rpm2Nm_1 "Proportional Verstärkung (Umdrehungen nach Moment), Umrechnung für sint16 Werte" RAT_FUNC "%6.4" "Nm/rpm" COEFFS 0 320 0 0 0 1 /end COMPU_METHOD
/begin COMPU_METHOD Kp_Temp2EGTFact "Umrechnung für die Proportional Verstärkung des PI Reglers im EGT_TempGvnr [1/K]" RAT_FUNC "%7.6" "1/K" COEFFS 0 51200 0 0 0 1 /end COMPU_METHOD
/begin COMPU_METHOD Kp_Temp_Kelv2Dcyc "Proportionalverstärkung (Temperatur zu Tastverhältnis)" RAT_FUNC "%8.7" "%/(K)" COEFFS 0 655360 0 0 0 1 /end COMPU_METHOD
/begin COMPU_METHOD Kp_us2mA "Umrechnung für PI-(Ent)ladezeitregler" RAT_FUNC "%6.5" "mA/us" COEFFS 0 6553.6 0 0 0 1 /end COMPU_METHOD
/begin COMPU_METHOD Kp_Vel2TrqPrp "Proportionalverstärkung (Fahrgeschwindigkeit zu Vortriebsmoment)" RAT_FUNC "%6.5" "Nm/(km/h)" COEFFS 0 3276.8 0 0 0 1 /end COMPU_METHOD
/begin COMPU_METHOD Kp_VOLTPA2FACT "Proportionale Verstärkung (Umrechnung von der Aktorspannung auf den Faktor)" RAT_FUNC "%9.8" "1/V" COEFFS 0 5368709.12 0 0 0 1 /end COMPU_METHOD
/begin COMPU_METHOD Length1 "Abstand in Meter" RAT_FUNC "%6.4" "m" COEFFS 0 128 0 0 0 1 /end COMPU_METHOD
/begin COMPU_METHOD LengthKm "Länge in Kilometer" RAT_FUNC "%6.2" "km" COEFFS 0 1 0 0 0 1 /end COMPU_METHOD
/begin COMPU_METHOD Mil "Verbale Umrechnung für DSM_Class%Mil_C" TAB_VERB "%6.3" "-" COMPU_TAB_REF Mil /end COMPU_METHOD
/begin COMPU_VTAB Mil "Verbale Umrechnung für DSM_Class%Mil_C" TAB_VERB 3 0 "Mil OFF" 1 "Mil ON" 2 "Mil BLINK" /end COMPU_VTAB
/begin COMPU_METHOD Moment_Inertia "Moment of Inertia" RAT_FUNC "%6.4" "kg * m^2" COEFFS 0 100 0 0 0 1 /end COMPU_METHOD
/begin COMPU_METHOD NumPinAdc "verbale Umrechnung für ADC Signale" TAB_VERB "%6.3" "-" COMPU_TAB_REF NumPinAdc /end COMPU_METHOD
/begin COMPU_VTAB NumPinAdc "verbale Umrechnung für ADC Signale" TAB_VERB 47 0 "Water_Temperature_Sensor_182" 1 "Intake_Air_Temperature_Sensor_157" 2 "Charge_Air_Temperature_Sensor_183" 3 "Exhaust_Temperature_Sensor_2_134" 4 "Exhaust_Temperature_Sensor_1_158" 5 "1st_APP_Sensor_252" 6 "2nd_APP_Sensor_239" 7 "ADC_REF" 8 "Boost_Pressure_Sensor_154" 9 "Atmospheric_Pressure_Sensor" 10 "Battery_Voltage_Sensor" 11 "Rail_Pressure_Sensor_156" 12 "Rail_Pressure_Peak_Value_156" 13 "Booster_Voltage_Sensor" 14 "Current_MeUn_Sensor" 15 "Current_PCV_Sensor" 16 "Voltage_Bank_1" 17 "Voltage_Bank_2" 18 "Pressure_Upstream_Particle_Filter_159" 19 "Engine_Oil_Pressure_110" 20 "Temperature_ECU_PCB" 21 "Voltage_Lambda_Ua" 22 "Voltage_Lambda_Ri" 23 "EMCCD_Current_Governor1_124" 24 "EMCCD_Current_Governor2_121" 25 "ADC_DUMMY_A_NOT_USED" 26 "ADC_DUMMY_NOT_USED" 27 "Charge_Actuator_Event_0" 28 "Voltage_Piezo_Actuator_Bank_2_Event_0" 29 "Voltage_Piezo_Actuator_Bank_1_Event_0" 30 "Charge_Actuator_Event_1" 31 "Voltage_Piezo_Actuator_Bank_2_Event_1" 32 "Voltage_Piezo_Actuator_Bank_1_Event_1" 33 "Charge_Actuator_Event_2" 34 "Voltage_Piezo_Actuator_Bank_2_Event_2" 35 "Voltage_Piezo_Actuator_Bank_1_Event_2" 36 "Charge_Actuator_Event_3" 37 "Voltage_Piezo_Actuator_Bank_2_Event_3" 38 "Voltage_Piezo_Actuator_Bank_1_Event_3" 39 "Charge_Actuator_Event_4" 40 "Voltage_Piezo_Actuator_Bank_2_Event_4" 41 "Voltage_Piezo_Actuator_Bank_1_Event_4" 42 "Charge_Actuator_Event_5" 43 "Voltage_Piezo_Actuator_Bank_2_Event_5" 44 "Voltage_Piezo_Actuator_Bank_1_Event_5" 45 "Booster_Voltage_Piezo" 46 "Piezo_Voltage" /end COMPU_VTAB
/begin COMPU_METHOD NumPinDia "Verbale Umrechnung für Diagnose Signale" TAB_VERB "%6.3" "-" COMPU_TAB_REF NumPinDia /end COMPU_METHOD
/begin COMPU_VTAB NumPinDia "Verbale Umrechnung für Diagnose Signale" TAB_VERB 36 0 "CJ945_Diagnostic_Signal" 1 "AC_Compressor_DiaSig" 2 "Fuel_Pump_DiaSig" 3 "Starter_234" 4 "Oil_Pressure_Lamp_Switch_245" 5 "Engine_Bay_Air_Flaps_123" 6 "Glow_Relay_Diagnostic_Signal1" 7 "reserved Glow_Relay_Diagnostic_Signal2" 8 "Ebox_Fan_Actuator_Diagnostic_Signal_219" 9 "Dummy_Actuator_Diagnostic_Signal" 10 "Twostage_TurboLoading_SW_DiaSig" 11 "DIO_OUT_DIAGNOSTIC_DUMMY_NOT_USED" 12 "1st_Pressure_Control_Valve_Diagnostic_Signal_172" 13 "2nd_Pressure_Control_Valve_Diagnostic_Signal_172" 14 "1st_Metering_Unit_Diagnostic_Signal_171" 15 "2nd_Metering_Unit_Diagnostic_Signal_171" 16 "Boost_Pressure_Actuator_Diagnostic_Signal_193" 17 "Boost_Pressure_Actuator_Diagnostic_Signal_193_2" 18 "EGR_Actuator_Diagnostic_Signal_194" 19 "EGR_Actuator_Diagnostic_Signal2" 20 "Variable_Swirl_Actuator_Diagnostic_Signal_195" 21 "Throttle_Valve_Diagnostic_Signal_196" 22 "Throttle_Valve2_Diagnostic_Signal_196" 23 "FAN_240" 24 "Add_On_Heater_244" 25 "EngM_Bearing_Actuator_Diagnostic_Signal_124" 26 "EngM_Bearing_Actuator_Diagnostic_Signal_121" 27 "Low pressure stage BPA_Diagnostic_Signal_117" 28 "Shuttr_Actuator_Diagnostic_Signal_231" 29 "PWM_DIAGNOSTIC_DUMMY_NOT_USED" 30 "1st_Sensor_Supply_Voltage_DiaSig" 31 "2nd_Sensor_Supply_Voltage_DiaSig" 32 "3rd_Sensor_Supply_Voltage_DiaSig" 33 "4th_Sensor_Supply_Voltage_DiaSig" 34 "5th_Sensor_Supply_Voltage_DiaSig" 35 "6th_Sensor_Supply_Voltage_DiaSig" /end COMPU_VTAB
/begin COMPU_METHOD OneToOne "eins zu eins (physikalischer Wert ist gleich dem internen Wert)" RAT_FUNC "%6.2" "-" COEFFS 0 1 0 0 0 1 /end COMPU_METHOD
/begin COMPU_METHOD Prc "Prozent, gleiche interne Auflösung wie Fact, aber Darstellung in Prozent (0...100%)" RAT_FUNC "%6.4" "%" COEFFS 0 81.92 0 0 0 1 /end COMPU_METHOD
/begin COMPU_METHOD Pres_bar "Druck (angezeigt in bar)" RAT_FUNC "%6.2" "bar" COEFFS 0 1 0 0 0 1 /end COMPU_METHOD
/begin COMPU_METHOD Pres_Rail "Raildruck in hPa" RAT_FUNC "%4.3" "bar" COEFFS 0 10.000000 0 0 0 1 /end COMPU_METHOD
/begin COMPU_METHOD Pwr_HiRes "Hochaufloesung der Leistung" RAT_FUNC "%6.3" "W" COEFFS 0 2 0 0 0 1 /end COMPU_METHOD
/begin COMPU_METHOD Qp_mm3_sec "Umrechnung für Volumenstrom" RAT_FUNC "%6.1" "mm3/s" COEFFS 0 0.1 0 0 0 1 /end COMPU_METHOD
/begin COMPU_METHOD RmpTrq "Rampengradient für Motormoment" RAT_FUNC "%6.4" "Nm/s" COEFFS 0 655.36 0 0 0 1 /end COMPU_METHOD
/begin COMPU_METHOD SlopeRes1000 "Umrechnung für Slope: Slopewert mit Verhältnis 0,001" RAT_FUNC "%6.5" "-" COEFFS 0 1000 0 0 0 1 /end COMPU_METHOD
/begin COMPU_METHOD TempCels_100ms "Temperatur Differenz in Grad C/sec (bezgl. 100ms task)" RAT_FUNC "%6.2" "deg C/s" COEFFS 0 1 0 0 0 1 /end COMPU_METHOD
/begin COMPU_METHOD Temp_Cels "Temperatur dargestellt in °C (gleiche interne Darstellung wie Temp_Kelv)" RAT_FUNC "%6.1" "deg C" COEFFS 0 10 2731.4 0 0 1 /end COMPU_METHOD
/begin COMPU_METHOD TimeDelay_s "Zeitkonstante T1 (in s) für PT1, DT1, etc." RAT_FUNC "%9.3" "s" COEFFS 0 0 1 0 0.00023283064365387 0 /end COMPU_METHOD
/begin COMPU_METHOD Time_ms "Zeit in ms für Fehlerentprellung (DSM) und SW-Timer" RAT_FUNC "%6.1" "ms" COEFFS 0 0.1 0 0 0 1 /end COMPU_METHOD
/begin COMPU_METHOD TransR "Übersetzungsverhältnis (Getriebe etc.)" RAT_FUNC "%6.4" "-" COEFFS 0 100 0 0 0 1 /end COMPU_METHOD
/begin COMPU_METHOD Trq "Motormoment" RAT_FUNC "%6.3" "Nm" COEFFS 0 10 0 0 0 1 /end COMPU_METHOD
/begin COMPU_METHOD TrqDT "zeitlich aufintegriertes Kupplungsmoment" RAT_FUNC "%6.2" "Nm*s" COEFFS 0 1 0 0 0 1 /end COMPU_METHOD
/begin COMPU_METHOD TrqPrp "Vortriebsmoment" RAT_FUNC "%6.3" "Nm" COEFFS 0 5 0 0 0 1 /end COMPU_METHOD
/begin COMPU_METHOD UC_Volt "Hardwarekapselung: Kondensatorspannung fuer MCy330" RAT_FUNC "%6.3" "V" COEFFS 0 10 0 0 0 1 /end COMPU_METHOD
/begin COMPU_METHOD Vel "Fahrzeuggeschwindigkeit, gleiche interne Auflösung wie Vel_SI" RAT_FUNC "%6.4" "km/h" COEFFS 0 100 0 0 0 1 /end COMPU_METHOD
/begin COMPU_METHOD Volt "Spannung in V (von ADC)" RAT_FUNC "%6.2" "mV" COEFFS 0 0.2046 0 0 0 1 /end COMPU_METHOD
/end MODULE
/end PROJECT
