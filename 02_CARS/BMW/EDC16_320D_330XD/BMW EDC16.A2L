ASAP2_VERSION 1 3
/begin PROJECT P383 "BMW DDE6.3 8-Zylinder V9E.3 11.10.2004 CAN12H"
/begin HEADER "" VERSION "V9E.3_8Z_CAN12H" PROJECT_NO P383 /end HEADER
/begin MODULE DIM ""
/begin MOD_COMMON "" BYTE_ORDER MSB_FIRST ALIGNMENT_BYTE 1 ALIGNMENT_WORD 2 ALIGNMENT_LONG 4 ALIGNMENT_FLOAT32_IEEE 4 /end MOD_COMMON
/begin CHARACTERISTIC Signals_adFreeApplic1_C "adresse eines frei applizierbaren Signals" VALUE 0xC06CC Kw_Wu32 4294967295.00 OneToOne 0.00 4294967295.00 FORMAT "%13.2" /end CHARACTERISTIC
/begin CHARACTERISTIC Signals_numTypFreeApplic1_C "Datentyp eines frei applizierbaren Signals" VALUE 0xC06D0 Kw_Wu8 5.00000000000 SigDatatyp 0.00 5.00000000000 FORMAT "%13.11" /end CHARACTERISTIC
/begin CHARACTERISTIC Signals_adFreeApplic2_C "adresse eines frei applizierbaren Signals" VALUE 0xC06D4 Kw_Wu32 4294967295.00 OneToOne 0.00 4294967295.00 FORMAT "%13.2" /end CHARACTERISTIC
/begin CHARACTERISTIC Signals_numTypFreeApplic2_C "Datentyp eines frei applizierbaren Signals" VALUE 0xC06D8 Kw_Wu8 5.00000000000 SigDatatyp 0.00 5.00000000000 FORMAT "%13.11" /end CHARACTERISTIC
/begin CHARACTERISTIC Signals_adFreeApplic3_C "adresse eines frei applizierbaren Signals" VALUE 0xC06DC Kw_Wu32 4294967295.00 OneToOne 0.00 4294967295.00 FORMAT "%13.2" /end CHARACTERISTIC
/begin CHARACTERISTIC Signals_numTypFreeApplic3_C "Datentyp eines frei applizierbaren Signals" VALUE 0xC06E0 Kw_Wu8 5.00000000000 SigDatatyp 0.00 5.00000000000 FORMAT "%13.11" /end CHARACTERISTIC
/begin CHARACTERISTIC Rail_DebPCV0MaxDef_C "Fehlerentprellzeit für Überwachung auf positive Regelabweichung" VALUE 0xF6C36 Kw_Wu16 655350.0 Time_ms 0.00 655350.0 FORMAT "%8.1" /end CHARACTERISTIC
/begin CHARACTERISTIC Rail_DebPCV0MaxOk_C "Heilungsentprellzeit für Überwachung auf positive Regelabweichung" VALUE 0xF6C38 Kw_Wu16 655350.0 Time_ms 0.00 655350.0 FORMAT "%8.1" /end CHARACTERISTIC
/begin CHARACTERISTIC Rail_DebPCV1MaxDef_C "Fehlerentprellzeit für positive Regelabweichung kombiniert mit Stellgröße Druckregelventil" VALUE 0xF6C3A Kw_Wu16 655350.0 Time_ms 0.00 655350.0 FORMAT "%8.1" /end CHARACTERISTIC
/begin CHARACTERISTIC Rail_DebPCV1MaxOk_C "Heilungsentprellzeit für positive Regelaweichung kombiniert mit Stellgröße Druckregelventil" VALUE 0xF6C3C Kw_Wu16 655350.0 Time_ms 0.00 655350.0 FORMAT "%8.1" /end CHARACTERISTIC
/begin CHARACTERISTIC Rail_DebPCV2MaxDef_C "Fehlerentprellzeit für negative Regelabweichung kombiniert mit Stellgröße Druckregelventil" VALUE 0xF6C3E Kw_Wu16 655350.0 Time_ms 0.00 655350.0 FORMAT "%8.1" /end CHARACTERISTIC
/begin CHARACTERISTIC Rail_DebPCV2MaxOk_C "Heilungsentprellzeit für negative Regelabweichung kombiniert mit Stellgröße Druckregelventil" VALUE 0xF6C40 Kw_Wu16 655350.0 Time_ms 0.00 655350.0 FORMAT "%8.1" /end CHARACTERISTIC
/begin CHARACTERISTIC Rail_DebPCV3MaxDef_C "Fehlerentprellzeit für minimalen Raildruck" VALUE 0xF6C42 Kw_Wu16 655350.0 Time_ms 0.00 655350.0 FORMAT "%8.1" /end CHARACTERISTIC
/begin CHARACTERISTIC Rail_DebPCV3MaxOk_C "Heilungsentprellzeit für minimalen Raildruck" VALUE 0xF6C44 Kw_Wu16 655350.0 Time_ms 0.00 655350.0 FORMAT "%8.1" /end CHARACTERISTIC
/begin CHARACTERISTIC Rail_DebPCV4MaxDef_C "Fehlerentprellzeit für maximalen Raildruck" VALUE 0xF6C46 Kw_Wu16 655350.0 Time_ms 0.00 655350.0 FORMAT "%8.1" /end CHARACTERISTIC
/begin CHARACTERISTIC Rail_DebPCV4MaxOk_C "Heilungsentprellzeit für maximalen Raildruck" VALUE 0xF6C48 Kw_Wu16 655350.0 Time_ms 0.00 655350.0 FORMAT "%8.1" /end CHARACTERISTIC
/begin CHARACTERISTIC Rail_DebPCV5MaxDef_C "Fehlerentprellzeit für Plausibilisierung Raildruck mit Strom durch das PCV" VALUE 0xF6C4A Kw_Wu16 655350.0 Time_ms 0.00 655350.0 FORMAT "%8.1" /end CHARACTERISTIC
/begin CHARACTERISTIC Rail_DebPCV5MaxOk_C "Heilungsentprellzeit für Plausibilisierung Raildruck mit Strom durch das PCV" VALUE 0xF6C4C Kw_Wu16 655350.0 Time_ms 0.00 655350.0 FORMAT "%8.1" /end CHARACTERISTIC
/begin CHARACTERISTIC Rail_dpSetPointDec_C "maximaler Raildruck-Sollwertabfall pro Sekunde" VALUE 0xF754C Kw_Ws16 26214.000 PresRail_sec -13107.200 13106.800 FORMAT "%5.3" /end CHARACTERISTIC
/begin CHARACTERISTIC Rail_dpSetPointInc_MAP "maximaler Raildruck-Sollwertanstieg pro Sekunde, abhängig von der Motordrehzahl und der Einspritzmenge" MAP 0xF754E Kf_Xs16_Ys16_Ws16 13000.000 PresRail_sec 0.00 13000.000 FORMAT "%5.3" EXTENDED_LIMITS -13107.200 13106.800
 /begin AXIS_DESCR STD_AXIS Eng_nAvrg EngN 12 0.00 6000.000 FORMAT "%8.3" EXTENDED_LIMITS -32768.00 32767.00 DEPOSIT ABSOLUTE /end AXIS_DESCR
 /begin AXIS_DESCR STD_AXIS InjCtl_qSetUnBal InjMassCyc 8 0.00 327.6700 FORMAT "%8.4" EXTENDED_LIMITS -327.6800 327.6700 DEPOSIT ABSOLUTE /end AXIS_DESCR
/end CHARACTERISTIC
/begin CHARACTERISTIC Rail_dtiRgnRmpUp_C "positive Rampensteigung zur Umschaltung auf Regenerationswert Raildrucksollwert" VALUE 0xF7540 Kw_Wu32 65535999.9847 Rmp 0.00 65535999.9847 FORMAT "%13.4" /end CHARACTERISTIC
/begin CHARACTERISTIC Rail_dtiRgnRmpDwn_C "negative Rampensteigung zur Umschaltung auf Regenerationswert Raildrucksollwert" VALUE 0xF7544 Kw_Wu32 65535999.9847 Rmp 0.00 65535999.9847 FORMAT "%13.4" /end CHARACTERISTIC
/begin CHARACTERISTIC Rail_dvolLeak_MAP "Leckage-Kennfled für Druckregelung über Zumesseinheit" MAP 0xF6D9E Kf_Xs16_Ys16_Ws16 150000.0 Qp_mm3_sec 0.00 150000.0 FORMAT "%8.1" EXTENDED_LIMITS -327680.0 327670.0
 /begin AXIS_DESCR STD_AXIS Rail_pSetPoint Pres_Rail 10 0.00 2000.000 FORMAT "%5.3" EXTENDED_LIMITS -3276.800 3276.700 DEPOSIT ABSOLUTE /end AXIS_DESCR
 /begin AXIS_DESCR STD_AXIS FlSys_t Temp_Cels 10 -50.14000 199.8600 FORMAT "%8.4" EXTENDED_LIMITS -3549.940 3003.560 DEPOSIT ABSOLUTE /end AXIS_DESCR
/end CHARACTERISTIC
/begin CHARACTERISTIC Rail_dvolPreCtlBas_MAP "Basisvorsteuerkennfeld für Druckregelung über Zumesseinheit" MAP 0xF6E92 Kf_Xs16_Ys16_Ws16 150000.0 Qp_mm3_sec 0.00 150000.0 FORMAT "%8.1" EXTENDED_LIMITS -327680.0 327670.0
 /begin AXIS_DESCR STD_AXIS Eng_nAvrg EngN 16 0.00 6000.000 FORMAT "%8.3" EXTENDED_LIMITS -32768.00 32767.00 DEPOSIT ABSOLUTE /end AXIS_DESCR
 /begin AXIS_DESCR STD_AXIS Rail_qPreCtlBas_mp InjMassCyc 16 0.00 327.6700 FORMAT "%8.4" EXTENDED_LIMITS -327.6800 327.6700 DEPOSIT ABSOLUTE /end AXIS_DESCR
/end CHARACTERISTIC
/begin CHARACTERISTIC Rail_dvolPreCtlOfs_MAP "Offset Kennlinie des Vorsteuerwerts (Regelung über Zumesseinheit)" MAP 0xF70D6 Kf_Xs16_Ys16_Ws16 150000.0 Qp_mm3_sec 0.00 150000.0 FORMAT "%8.1" EXTENDED_LIMITS -327680.0 327670.0
 /begin AXIS_DESCR STD_AXIS Eng_nAvrg EngN 8 0.00 6000.000 FORMAT "%8.3" EXTENDED_LIMITS -32768.00 32767.00 DEPOSIT ABSOLUTE /end AXIS_DESCR
 /begin AXIS_DESCR STD_AXIS InjCtl_qSetUnBal InjMassCyc 8 0.00 327.6700 FORMAT "%8.4" EXTENDED_LIMITS -327.6800 327.6700 DEPOSIT ABSOLUTE /end AXIS_DESCR
/end CHARACTERISTIC
/begin CHARACTERISTIC Rail_dvolPreCtlPoI1_MAP "Vorsteuerkennfeld abhängig von der Nacheinspritzmenge 1 für die Druckregelung über Zumesseinheit" MAP 0xF717A Kf_Xs16_Ys16_Ws16 150000.0 Qp_mm3_sec 0.00 150000.0 FORMAT "%8.1" EXTENDED_LIMITS -327680.0 327670.0
 /begin AXIS_DESCR STD_AXIS Eng_nAvrg EngN 2 0.00 6000.000 FORMAT "%8.3" EXTENDED_LIMITS -32768.00 32767.00 DEPOSIT ABSOLUTE /end AXIS_DESCR
 /begin AXIS_DESCR STD_AXIS InjCrv_qPoI1Des_mp InjMassInj 4 0.00 327.6700 FORMAT "%8.4" EXTENDED_LIMITS -327.6800 327.6700 DEPOSIT ABSOLUTE /end AXIS_DESCR
/end CHARACTERISTIC
/begin CHARACTERISTIC Rail_dvolPreCtlPoI2_MAP "Vorsteuerkennfeld abhängig von der Nacheinspritzmenge 2 für die Druckregelung über Zumesseinheit" MAP 0xF719A Kf_Xs16_Ys16_Ws16 150000.0 Qp_mm3_sec 0.00 150000.0 FORMAT "%8.1" EXTENDED_LIMITS -327680.0 327670.0
 /begin AXIS_DESCR STD_AXIS Eng_nAvrg EngN 2 0.00 6000.000 FORMAT "%8.3" EXTENDED_LIMITS -32768.00 32767.00 DEPOSIT ABSOLUTE /end AXIS_DESCR
 /begin AXIS_DESCR STD_AXIS InjCrv_qPoI2Des_mp InjMassInj 4 0.00 327.6700 FORMAT "%8.4" EXTENDED_LIMITS -327.6800 327.6700 DEPOSIT ABSOLUTE /end AXIS_DESCR
/end CHARACTERISTIC
/begin CHARACTERISTIC Rail_dvolRedOfsLim_C "Schwelle fuer Kraftstoffmenge  zur Verringerung  des Offsetwertes fuer PCV" VALUE 0xF71C0 Kw_Ws16 655350.0 Qp_mm3_sec -327680.0 327670.0 FORMAT "%8.1" /end CHARACTERISTIC
/begin CHARACTERISTIC Rail_facAPSetPDynCor_CUR "Gewichtungsfaktor, abhängig vom Atmosphärendruck" CURVE 0xF7AE0 Kl_Xs16_Ws16 2.000000 Fact 0.00 2.000000 FORMAT "%8.6" EXTENDED_LIMITS -4.000000 3.999878
 /begin AXIS_DESCR STD_AXIS APSCD_pVal Pres_hPa 6 0.00 3500.000 FORMAT "%8.3" EXTENDED_LIMITS -32768.00 32767.00 DEPOSIT ABSOLUTE /end AXIS_DESCR
/end CHARACTERISTIC
/begin CHARACTERISTIC Rail_facChamWllTempCorr_MAP "Kennfeld zur Bestimmung des BrennraumWand Temperatur Korrekturfaktors" MAP 0xF7AFA Kf_Xs16_Ys16_Ws16 2.000000 Fact 0.00 2.000000 FORMAT "%8.6" EXTENDED_LIMITS -4.000000 3.999878
 /begin AXIS_DESCR STD_AXIS Eng_tEng Temp_Cels 8 -50.14000 199.8600 FORMAT "%8.4" EXTENDED_LIMITS -3549.940 3003.560 DEPOSIT ABSOLUTE /end AXIS_DESCR
 /begin AXIS_DESCR STD_AXIS Layer_tChamWll Temp_Cels 8 -50.14000 899.8600 FORMAT "%8.4" EXTENDED_LIMITS -3549.940 3003.560 DEPOSIT ABSOLUTE /end AXIS_DESCR
/end CHARACTERISTIC
/begin CHARACTERISTIC Rail_facDQSetPDynCor_CUR "Gewichtungsfaktor, abhängig vom Einspritzmengengradient" CURVE 0xF7B9E Kl_Xs16_Ws16 4.000000 Fact -2.000000 2.000000 FORMAT "%8.6" EXTENDED_LIMITS -4.000000 3.999878
 /begin AXIS_DESCR STD_AXIS InjCrv_dqSetUnBalFltLim InjMassPerSec_20ms 6 -16384.00 16383.50 FORMAT "%8.2" DEPOSIT ABSOLUTE /end AXIS_DESCR
/end CHARACTERISTIC
/begin CHARACTERISTIC Rail_facETSetPDynCor_CUR "Gewichtungsfaktor, abhängig von der Motortemperatur" CURVE 0xF7BB8 Kl_Xs16_Ws16 2.000000 Fact 0.00 2.000000 FORMAT "%8.6" EXTENDED_LIMITS -4.000000 3.999878
 /begin AXIS_DESCR STD_AXIS InjCrv_tEng Temp_Cels 6 -50.14000 199.8600 FORMAT "%8.4" EXTENDED_LIMITS -3549.940 3003.560 DEPOSIT ABSOLUTE /end AXIS_DESCR
/end CHARACTERISTIC
/begin CHARACTERISTIC Rail_facIASetPDynCor_CUR "Gewichtungsfaktor durch den Atmosphärendruck für Raildruck-Sollwertkorrektur" CURVE 0xF7BD2 Kl_Xs16_Ws16 2.000000 Fact 0.00 2.000000 FORMAT "%8.6" EXTENDED_LIMITS -4.000000 3.999878
 /begin AXIS_DESCR STD_AXIS IATSCD_tAir Temp_Cels 6 -50.14000 199.8600 FORMAT "%8.4" EXTENDED_LIMITS -3549.940 3003.560 DEPOSIT ABSOLUTE /end AXIS_DESCR
/end CHARACTERISTIC
/begin CHARACTERISTIC Rail_facLeakAged_C "Faktor zur Bestimmung des maximal möglichen Volumenstroms bei einem gealterten System" VALUE 0xF71BA Kw_Ws16 1.000000 Fact 0.00 1.000000 FORMAT "%8.6" EXTENDED_LIMITS -4.000000 3.999878 /end CHARACTERISTIC
/begin CHARACTERISTIC Rail_facSetPointAPSCor_CUR "Gewichtungsfaktor, abhängig vom Atmosphärendruck für die Sollwertkorrektur des Raildrucks" CURVE 0xF8598 Kl_Xs16_Ws16 1.000000 Fact 0.00 1.000000 FORMAT "%8.6" EXTENDED_LIMITS -4.000000 3.999878
 /begin AXIS_DESCR STD_AXIS APSCD_pVal Pres_hPa 8 0.00 3500.000 FORMAT "%8.3" EXTENDED_LIMITS -32768.00 32767.00 DEPOSIT ABSOLUTE /end AXIS_DESCR
/end CHARACTERISTIC
/begin CHARACTERISTIC Rail_facSetPointAPSCStrt_CUR "Gewichtungsfaktor, abhängig vom Atmosphärendruck für die Sollwertkorrektur des Raildrucks beim Start" CURVE 0xF85BA Kl_Xs16_Ws16 1.000000 Fact 0.00 1.000000 FORMAT "%8.6" EXTENDED_LIMITS -4.000000 3.999878
 /begin AXIS_DESCR STD_AXIS APSCD_pVal Pres_hPa 8 0.00 3500.000 FORMAT "%8.3" EXTENDED_LIMITS -32768.00 32767.00 DEPOSIT ABSOLUTE /end AXIS_DESCR
/end CHARACTERISTIC
/begin CHARACTERISTIC Rail_facSetPointATSCor_CUR "Gewichtungsfaktor, abhängig von der Ansauglufttemperatur für die Sollwertkorrektur des Raildrucks" CURVE 0xF85DC Kl_Xs16_Ws16 1.000000 Fact 0.00 1.000000 FORMAT "%8.6" EXTENDED_LIMITS -4.000000 3.999878
 /begin AXIS_DESCR STD_AXIS IATSCD_tAir Temp_Cels 8 -50.14000 199.8600 FORMAT "%8.4" EXTENDED_LIMITS -3549.940 3003.560 DEPOSIT ABSOLUTE /end AXIS_DESCR
/end CHARACTERISTIC
/begin CHARACTERISTIC Rail_facSetPointATSCStrt_CUR "Gewichtungsfaktor, abhängig von der Ansauglufttemperatur für die Sollwertkorrektur des Raildrucks beim Start" CURVE 0xF85FE Kl_Xs16_Ws16 1.000000 Fact 0.00 1.000000 FORMAT "%8.6" EXTENDED_LIMITS -4.000000 3.999878
 /begin AXIS_DESCR STD_AXIS IATSCD_tAir Temp_Cels 8 -50.14000 199.8600 FORMAT "%8.4" EXTENDED_LIMITS -3549.940 3003.560 DEPOSIT ABSOLUTE /end AXIS_DESCR
/end CHARACTERISTIC
/begin CHARACTERISTIC Rail_facSetPointETSCor1_CUR "weighting factor of engine temperature for rail pressure setpoint correction" CURVE 0xF8620 Kl_Xs16_Ws16 1.000000 Fact 0.00 1.000000 FORMAT "%8.6" EXTENDED_LIMITS -4.000000 3.999878
 /begin AXIS_DESCR STD_AXIS InjCrv_tEng Temp_Cels 4 -50.14000 199.8600 FORMAT "%8.4" EXTENDED_LIMITS -3549.940 3003.560 DEPOSIT ABSOLUTE /end AXIS_DESCR
/end CHARACTERISTIC
/begin CHARACTERISTIC Rail_facSetPointETSCor_CUR "Gewichtungsfaktor, abhängig von der Motortemperatur für die Sollwertkorrektur des Raildrucks" CURVE 0xF8632 Kl_Xs16_Ws16 1.000000 Fact 0.00 1.000000 FORMAT "%8.6" EXTENDED_LIMITS -4.000000 3.999878
 /begin AXIS_DESCR STD_AXIS InjCrv_tEng Temp_Cels 8 -50.14000 199.8600 FORMAT "%8.4" EXTENDED_LIMITS -3549.940 3003.560 DEPOSIT ABSOLUTE /end AXIS_DESCR
/end CHARACTERISTIC
/begin CHARACTERISTIC Rail_facSetPointETSCStrt_CUR "weighting factor of engine temperature for rail pressure setpoint correction start" CURVE 0xF8654 Kl_Xs16_Ws16 1.000000 Fact 0.00 1.000000 FORMAT "%8.6" EXTENDED_LIMITS -4.000000 3.999878
 /begin AXIS_DESCR STD_AXIS InjCrv_tEng Temp_Cels 8 -50.14000 199.8600 FORMAT "%8.4" EXTENDED_LIMITS -3549.940 3003.560 DEPOSIT ABSOLUTE /end AXIS_DESCR
/end CHARACTERISTIC
/begin CHARACTERISTIC Rail_facSetPointFTSCor_CUR "Gewichtungsfaktor, abhängig von der Kraftstofftemperatur für Raildruck-Sollwertkorrektur" CURVE 0xF7BEC Kl_Xs16_Ws16 1.000000 Fact 0.00 1.000000 FORMAT "%8.6" EXTENDED_LIMITS -4.000000 3.999878
 /begin AXIS_DESCR STD_AXIS FTSCD_tFuel Temp_Cels 6 -50.14000 199.8600 FORMAT "%8.4" EXTENDED_LIMITS -3549.940 3003.560 DEPOSIT ABSOLUTE /end AXIS_DESCR
/end CHARACTERISTIC
/begin CHARACTERISTIC Rail_pChamWllTempCorr_MAP "Kennfeld zur Bestimmung des Druckes für die Brennraumwandtemperatur korrektur" MAP 0xF7C06 Kf_Xs16_Ys16_Ws16 2000.000 Pres_Rail 0.00 2000.000 FORMAT "%5.3" EXTENDED_LIMITS -3276.800 3276.700
 /begin AXIS_DESCR STD_AXIS Eng_nAvrg EngN 8 0.00 6000.000 FORMAT "%8.3" EXTENDED_LIMITS -32768.00 32767.00 DEPOSIT ABSOLUTE /end AXIS_DESCR
 /begin AXIS_DESCR STD_AXIS InjCtl_qSetUnBal InjMassCyc 8 0.00 327.6700 FORMAT "%8.4" EXTENDED_LIMITS -327.6800 327.6700 DEPOSIT ABSOLUTE /end AXIS_DESCR
/end CHARACTERISTIC
/begin CHARACTERISTIC Rail_pPCVDvtMax_C "maximale positive Soll/Ist Druckdifferenz" VALUE 0xF6C4E Kw_Ws16 3800.000 Pres_Rail -1800.000 2000.000 FORMAT "%5.3" EXTENDED_LIMITS -3276.800 3276.700 /end CHARACTERISTIC
/begin CHARACTERISTIC Rail_pPCVDvtMin_C "maximale negative Soll/Ist Druckdifferenz" VALUE 0xF6C50 Kw_Ws16 3800.000 Pres_Rail -1800.000 2000.000 FORMAT "%5.3" EXTENDED_LIMITS -3276.800 3276.700 /end CHARACTERISTIC
/begin CHARACTERISTIC Rail_pPCVSetMin_C "Minimal zulässiger Solldruck für Raildrucküberwachung" VALUE 0xF6C52 Kw_Ws16 2000.000 Pres_Rail 0.00 2000.000 FORMAT "%5.3" EXTENDED_LIMITS -3276.800 3276.700 /end CHARACTERISTIC
/begin CHARACTERISTIC Rail_pAbsDvtMax_C "Maximaler Betrag der Regelabweichung für Raildrucküberwachung" VALUE 0xF6C54 Kw_Ws16 3800.000 Pres_Rail -1800.000 2000.000 FORMAT "%5.3" EXTENDED_LIMITS -3276.800 3276.700 /end CHARACTERISTIC
/begin CHARACTERISTIC Rail_tiThresMonEna_C "Zeitschwelle für Freigabe der Plausibilisierung des Raildrucks während der Raildrucküberwachung" VALUE 0xF6C56 Kw_Wu16 655350.0 Time_ms 0.00 655350.0 FORMAT "%8.1" /end CHARACTERISTIC
/begin CHARACTERISTIC Rail_qMonEnaMax_C "Maximale Menge für Raildrucküberwachung" VALUE 0xF6C58 Kw_Ws16 327.6700 InjMassCyc 0.00 327.6700 FORMAT "%8.4" EXTENDED_LIMITS -327.6800 327.6700 /end CHARACTERISTIC
/begin CHARACTERISTIC Rail_nMonEnaMin_C "Minimale Drehzahl für Raildrucküberwachung" VALUE 0xF6C5A Kw_Ws16 6000.000 EngN 0.00 6000.000 FORMAT "%8.3" EXTENDED_LIMITS -32768.00 32767.00 /end CHARACTERISTIC
/begin CHARACTERISTIC Rail_nMonEnaMax_C "Maximale Drehzahl für Raildrucküberwachung" VALUE 0xF6C5C Kw_Ws16 6000.000 EngN 0.00 6000.000 FORMAT "%8.3" EXTENDED_LIMITS -32768.00 32767.00 /end CHARACTERISTIC
/begin CHARACTERISTIC Rail_pPCVPeakMax_C "Maximal zulässiger Raildruck" VALUE 0xF6C5E Kw_Ws16 2000.000 Pres_Rail 0.00 2000.000 FORMAT "%5.3" EXTENDED_LIMITS -3276.800 3276.700 /end CHARACTERISTIC
/begin CHARACTERISTIC Rail_stMonPCVRls_C "Generelle Freigabemaske für Überwachungen der Druckregelung über Druckregelventil" VALUE 0xF6C60 Kw_Wu16 65535.00 OneToOne 0.00 65535.00 FORMAT "%8.2" /end CHARACTERISTIC
/begin CHARACTERISTIC Rail_pNIPCVMax_MAP "Obere Grenze für Drucksensorplausibilisierung" MAP 0xF6C62 Kf_Xs16_Ys16_Ws16 2000.000 Pres_Rail 0.00 2000.000 FORMAT "%5.3" EXTENDED_LIMITS -3276.800 3276.700
 /begin AXIS_DESCR STD_AXIS Eng_nAvrg EngN 6 0.00 6000.000 FORMAT "%8.3" EXTENDED_LIMITS -32768.00 32767.00 DEPOSIT ABSOLUTE /end AXIS_DESCR
 /begin AXIS_DESCR STD_AXIS PCVCD_iActVal Curr 8 0.00 5000.000 FORMAT "%8.3" EXTENDED_LIMITS -32768.00 32767.00 DEPOSIT ABSOLUTE /end AXIS_DESCR
/end CHARACTERISTIC
/begin CHARACTERISTIC Rail_pNIPCVMin_MAP "Untere Grenze für Drucksensorplausibilisierung" MAP 0xF6CE2 Kf_Xs16_Ys16_Ws16 2000.000 Pres_Rail 0.00 2000.000 FORMAT "%5.3" EXTENDED_LIMITS -3276.800 3276.700
 /begin AXIS_DESCR STD_AXIS Eng_nAvrg EngN 6 0.00 6000.000 FORMAT "%8.3" EXTENDED_LIMITS -32768.00 32767.00 DEPOSIT ABSOLUTE /end AXIS_DESCR
 /begin AXIS_DESCR STD_AXIS PCVCD_iActVal Curr 8 0.00 5000.000 FORMAT "%8.3" EXTENDED_LIMITS -32768.00 32767.00 DEPOSIT ABSOLUTE /end AXIS_DESCR
/end CHARACTERISTIC
/begin CHARACTERISTIC Rail_pPCVCloseOfs_CUR "Vorsteuer Offset um das Druckregelventil geschlossen zu halten" CURVE 0xF71C2 Kl_Xs16_Ws16 6553.500 Pres_Rail -3276.800 3276.700 FORMAT "%5.3"
 /begin AXIS_DESCR STD_AXIS Rail_pSetPoint Pres_Rail 4 0.00 2000.000 FORMAT "%5.3" EXTENDED_LIMITS -3276.800 3276.700 DEPOSIT ABSOLUTE /end AXIS_DESCR
/end CHARACTERISTIC
/begin CHARACTERISTIC Rail_pPCVDvtMax_CUR "maximale Regelabweichung als Funktion der Drehzahl für die Raildrucküberwachung" CURVE 0xF6D62 Kl_Xs16_Ws16 3800.000 Pres_Rail -1800.000 2000.000 FORMAT "%5.3" EXTENDED_LIMITS -3276.800 3276.700
 /begin AXIS_DESCR STD_AXIS Eng_nAvrg EngN 4 0.00 6000.000 FORMAT "%8.3" EXTENDED_LIMITS -32768.00 32767.00 DEPOSIT ABSOLUTE /end AXIS_DESCR
/end CHARACTERISTIC
/begin CHARACTERISTIC Rail_pPCVPeakMin_CUR "Minimal zulässiger Raildruck als Funktion der Motordrehzahl" CURVE 0xF6D74 Kl_Xs16_Ws16 2000.000 Pres_Rail 0.00 2000.000 FORMAT "%5.3" EXTENDED_LIMITS -3276.800 3276.700
 /begin AXIS_DESCR STD_AXIS Eng_nAvrg EngN 4 0.00 6000.000 FORMAT "%8.3" EXTENDED_LIMITS -32768.00 32767.00 DEPOSIT ABSOLUTE /end AXIS_DESCR
/end CHARACTERISTIC
/begin CHARACTERISTIC Rail_pPCVRedOfs_CUR "Vorsteuerreduzierung für schnelleren Druckabbau über das Druckregelventil" CURVE 0xF71D4 Kl_Xs16_Ws16 6553.500 Pres_Rail -3276.800 3276.700 FORMAT "%5.3"
 /begin AXIS_DESCR STD_AXIS Rail_pSetPoint Pres_Rail 4 0.00 2000.000 FORMAT "%5.3" EXTENDED_LIMITS -3276.800 3276.700 DEPOSIT ABSOLUTE /end AXIS_DESCR
/end CHARACTERISTIC
/begin CHARACTERISTIC Rail_pPCVSetMax_CUR "maximal zulässiger Solldruck für die Raildrucküberwachung" CURVE 0xF6D86 Kl_Xs16_Ws16 2000.000 Pres_Rail 0.00 2000.000 FORMAT "%5.3" EXTENDED_LIMITS -3276.800 3276.700
 /begin AXIS_DESCR STD_AXIS Rail_pSetPoint Pres_Rail 4 0.00 2000.000 FORMAT "%5.3" EXTENDED_LIMITS -3276.800 3276.700 DEPOSIT ABSOLUTE /end AXIS_DESCR
/end CHARACTERISTIC
/begin CHARACTERISTIC Rail_pPeakMinZFC_C "Minimaler Raildruck für die Überwachung bei aktiver ZFC" VALUE 0xF8678 Kw_Ws16 2000.000 Pres_Rail 0.00 2000.000 FORMAT "%5.3" EXTENDED_LIMITS -3276.800 3276.700 /end CHARACTERISTIC
/begin CHARACTERISTIC Rail_pPreCtl_MAP "Vorsteuerkennfeld für die Druckregelung über Druckregelventil" MAP 0xF71E6 Kf_Xs16_Ys16_Ws16 2000.000 Pres_Rail 0.00 2000.000 FORMAT "%5.3" EXTENDED_LIMITS -3276.800 3276.700
 /begin AXIS_DESCR STD_AXIS Eng_nAvrg EngN 8 0.00 6000.000 FORMAT "%8.3" EXTENDED_LIMITS -32768.00 32767.00 DEPOSIT ABSOLUTE /end AXIS_DESCR
 /begin AXIS_DESCR STD_AXIS Rail_pSetPoint Pres_Rail 12 0.00 2000.000 FORMAT "%5.3" EXTENDED_LIMITS -3276.800 3276.700 DEPOSIT ABSOLUTE /end AXIS_DESCR
/end CHARACTERISTIC
/begin CHARACTERISTIC Rail_pRedOfsLim_C "Raildruckschwelle zur Reduzierung des Vorsteueroffsets des Druckregelventils" VALUE 0xF72D2 Kw_Ws16 6553.500 Pres_Rail -3276.800 3276.700 FORMAT "%5.3" /end CHARACTERISTIC
/begin CHARACTERISTIC Rail_pSetPDynCor_MAP "Basiswert der dynamischen Raildruck-Sollwertkorrektur" MAP 0xF7CAA Kf_Xs16_Ys16_Ws16 2000.000 Pres_Rail 0.00 2000.000 FORMAT "%5.3" EXTENDED_LIMITS -3276.800 3276.700
 /begin AXIS_DESCR STD_AXIS Eng_nAvrg EngN 16 0.00 6000.000 FORMAT "%8.3" EXTENDED_LIMITS -32768.00 32767.00 DEPOSIT ABSOLUTE /end AXIS_DESCR
 /begin AXIS_DESCR STD_AXIS InjCtl_qSetUnBal InjMassCyc 8 0.00 327.6700 FORMAT "%8.4" EXTENDED_LIMITS -327.6800 327.6700 DEPOSIT ABSOLUTE /end AXIS_DESCR
/end CHARACTERISTIC
/begin CHARACTERISTIC Rail_pSetPointAPSCor_MAP "atmosphärendruckabhängiger Sollwertkorrektur des Raildrucks" MAP 0xF8044 Kf_Xs16_Ys16_Ws16 2000.000 Pres_Rail 0.00 2000.000 FORMAT "%5.3" EXTENDED_LIMITS -3276.800 3276.700
 /begin AXIS_DESCR STD_AXIS Eng_nAvrg EngN 12 0.00 6000.000 FORMAT "%8.3" EXTENDED_LIMITS -32768.00 32767.00 DEPOSIT ABSOLUTE /end AXIS_DESCR
 /begin AXIS_DESCR STD_AXIS InjCtl_qCurr InjMassCyc 8 0.00 327.6700 FORMAT "%8.4" EXTENDED_LIMITS -327.6800 327.6700 DEPOSIT ABSOLUTE /end AXIS_DESCR
/end CHARACTERISTIC
/begin CHARACTERISTIC Rail_pSetPointAPSCStrt_MAP "atmosphärendruckabhängigen Sollwertkorrektur des Raildrucks beim Start" MAP 0xF8130 Kf_Xs16_Ys16_Ws16 2000.000 Pres_Rail 0.00 2000.000 FORMAT "%5.3" EXTENDED_LIMITS -3276.800 3276.700
 /begin AXIS_DESCR STD_AXIS Eng_nAvrg EngN 8 0.00 6000.000 FORMAT "%8.3" EXTENDED_LIMITS -32768.00 32767.00 DEPOSIT ABSOLUTE /end AXIS_DESCR
 /begin AXIS_DESCR STD_AXIS InjCtl_qCurr InjMassCyc 8 0.00 327.6700 FORMAT "%8.4" EXTENDED_LIMITS -327.6800 327.6700 DEPOSIT ABSOLUTE /end AXIS_DESCR
/end CHARACTERISTIC
/begin CHARACTERISTIC Rail_pSetPointATSCor_MAP "ansauglufttemperaturabhängige Sollwertkorrektur des Raildrucks" MAP 0xF81D4 Kf_Xs16_Ys16_Ws16 2000.000 Pres_Rail 0.00 2000.000 FORMAT "%5.3" EXTENDED_LIMITS -3276.800 3276.700
 /begin AXIS_DESCR STD_AXIS Eng_nAvrg EngN 12 0.00 6000.000 FORMAT "%8.3" EXTENDED_LIMITS -32768.00 32767.00 DEPOSIT ABSOLUTE /end AXIS_DESCR
 /begin AXIS_DESCR STD_AXIS InjCtl_qCurr InjMassCyc 8 0.00 327.6700 FORMAT "%8.4" EXTENDED_LIMITS -327.6800 327.6700 DEPOSIT ABSOLUTE /end AXIS_DESCR
/end CHARACTERISTIC
/begin CHARACTERISTIC Rail_pSetPointATSCStrt_MAP "ansauglufttemperaturabhängige Sollwertkorrektur des Raildrucks beim Start" MAP 0xF82C0 Kf_Xs16_Ys16_Ws16 2000.000 Pres_Rail 0.00 2000.000 FORMAT "%5.3" EXTENDED_LIMITS -3276.800 3276.700
 /begin AXIS_DESCR STD_AXIS Eng_nAvrg EngN 8 0.00 6000.000 FORMAT "%8.3" EXTENDED_LIMITS -32768.00 32767.00 DEPOSIT ABSOLUTE /end AXIS_DESCR
 /begin AXIS_DESCR STD_AXIS InjCtl_qCurr InjMassCyc 8 0.00 327.6700 FORMAT "%8.4" EXTENDED_LIMITS -327.6800 327.6700 DEPOSIT ABSOLUTE /end AXIS_DESCR
/end CHARACTERISTIC
/begin CHARACTERISTIC Rail_pSetPointBaseStrt_MAP "Basiskennfeld für den Raildruck-Sollwert beim Start" MAP 0xF763A Kf_Xs16_Ys16_Ws16 2000.000 Pres_Rail 0.00 2000.000 FORMAT "%5.3" EXTENDED_LIMITS -3276.800 3276.700
 /begin AXIS_DESCR STD_AXIS Eng_nAvrg EngN 16 0.00 6000.000 FORMAT "%8.3" EXTENDED_LIMITS -32768.00 32767.00 DEPOSIT ABSOLUTE /end AXIS_DESCR
 /begin AXIS_DESCR STD_AXIS InjCtl_qCurr InjMassCyc 16 0.00 327.6700 FORMAT "%8.4" EXTENDED_LIMITS -327.6800 327.6700 DEPOSIT ABSOLUTE /end AXIS_DESCR
/end CHARACTERISTIC
/begin CHARACTERISTIC Rail_pSetPointBase_MAP "Basiskennfeld für den Raildruck-Sollwert" MAP 0xF787E Kf_Xs16_Ys16_Ws16 2000.000 Pres_Rail 0.00 2000.000 FORMAT "%5.3" EXTENDED_LIMITS -3276.800 3276.700
 /begin AXIS_DESCR STD_AXIS Eng_nAvrg EngN 16 0.00 6000.000 FORMAT "%8.3" EXTENDED_LIMITS -32768.00 32767.00 DEPOSIT ABSOLUTE /end AXIS_DESCR
 /begin AXIS_DESCR STD_AXIS InjCtl_qCurr InjMassCyc 16 0.00 327.6700 FORMAT "%8.4" EXTENDED_LIMITS -327.6800 327.6700 DEPOSIT ABSOLUTE /end AXIS_DESCR
/end CHARACTERISTIC
/begin CHARACTERISTIC Rail_pSetPointBattMin_CUR "batteriespannungsabhängige Kennlinie für den Raildruck-Sollwert" CURVE 0xF7AC2 Kl_Xs16_Ws16 2000.000 Pres_Rail 0.00 2000.000 FORMAT "%5.3" EXTENDED_LIMITS -3276.800 3276.700
 /begin AXIS_DESCR STD_AXIS BattCD_u Volt_Batt 4 0.00 24007.82 FORMAT "%8.2" EXTENDED_LIMITS -640625.6 640606.1 DEPOSIT ABSOLUTE /end AXIS_DESCR
/end CHARACTERISTIC
/begin CHARACTERISTIC Rail_pSetPointETSCor1_MAP "ETS correction map of rail pressure setpoint as function of engine speed & current injection quantity" MAP 0xF8364 Kf_Xs16_Ys16_Ws16 2000.000 Pres_Rail 0.00 2000.000 FORMAT "%5.3" EXTENDED_LIMITS -3276.800 3276.700
 /begin AXIS_DESCR STD_AXIS Eng_nAvrg EngN 8 0.00 6000.000 FORMAT "%8.3" EXTENDED_LIMITS -32768.00 32767.00 DEPOSIT ABSOLUTE /end AXIS_DESCR
 /begin AXIS_DESCR STD_AXIS InjCtl_qCurr InjMassCyc 8 0.00 327.6700 FORMAT "%8.4" EXTENDED_LIMITS -327.6800 327.6700 DEPOSIT ABSOLUTE /end AXIS_DESCR
/end CHARACTERISTIC
/begin CHARACTERISTIC Rail_pSetPointETSCor_MAP "motortemperaturabhängige Sollwertkorrektur des Raildrucks" MAP 0xF8408 Kf_Xs16_Ys16_Ws16 2000.000 Pres_Rail 0.00 2000.000 FORMAT "%5.3" EXTENDED_LIMITS -3276.800 3276.700
 /begin AXIS_DESCR STD_AXIS Eng_nAvrg EngN 12 0.00 6000.000 FORMAT "%8.3" EXTENDED_LIMITS -32768.00 32767.00 DEPOSIT ABSOLUTE /end AXIS_DESCR
 /begin AXIS_DESCR STD_AXIS InjCtl_qCurr InjMassCyc 8 0.00 327.6700 FORMAT "%8.4" EXTENDED_LIMITS -327.6800 327.6700 DEPOSIT ABSOLUTE /end AXIS_DESCR
/end CHARACTERISTIC
/begin CHARACTERISTIC Rail_pSetPointETSCStrt_MAP "CTS correction map of rail pressure setpoint as function of Eng_nAvrg and InjCtl_qCurr start" MAP 0xF84F4 Kf_Xs16_Ys16_Ws16 2000.000 Pres_Rail 0.00 2000.000 FORMAT "%5.3" EXTENDED_LIMITS -3276.800 3276.700
 /begin AXIS_DESCR STD_AXIS Eng_nAvrg EngN 8 0.00 6000.000 FORMAT "%8.3" EXTENDED_LIMITS -32768.00 32767.00 DEPOSIT ABSOLUTE /end AXIS_DESCR
 /begin AXIS_DESCR STD_AXIS InjCtl_qCurr InjMassCyc 8 0.00 327.6700 FORMAT "%8.4" EXTENDED_LIMITS -327.6800 327.6700 DEPOSIT ABSOLUTE /end AXIS_DESCR
/end CHARACTERISTIC
/begin CHARACTERISTIC Rail_pSetPointFTSCor_MAP "Basiswert der kraftstofftemperaturabhängigen Raildruck-Sollwertkorrektur" MAP 0xF7DDE Kf_Xs16_Ys16_Ws16 2000.000 Pres_Rail 0.00 2000.000 FORMAT "%5.3" EXTENDED_LIMITS -3276.800 3276.700
 /begin AXIS_DESCR STD_AXIS Eng_nAvrg EngN 8 0.00 6000.000 FORMAT "%8.3" EXTENDED_LIMITS -32768.00 32767.00 DEPOSIT ABSOLUTE /end AXIS_DESCR
 /begin AXIS_DESCR STD_AXIS InjCtl_qCurr InjMassCyc 8 0.00 327.6700 FORMAT "%8.4" EXTENDED_LIMITS -327.6800 327.6700 DEPOSIT ABSOLUTE /end AXIS_DESCR
/end CHARACTERISTIC
/begin CHARACTERISTIC Rail_pSetPointInit_C "Initialwert des Raildrucksollwert" VALUE 0xF7AD4 Kw_Ws16 6553.500 Pres_Rail -3276.800 3276.700 FORMAT "%5.3" /end CHARACTERISTIC
/begin CHARACTERISTIC Rail_pSetPointLimNFlTemp_MAP "maximaler Raildrucksollwert, abhängig von der Motordrehzahl und der Kraftstofftemperatur" MAP 0xF7E82 Kf_Xs16_Ys16_Ws16 2000.000 Pres_Rail 0.00 2000.000 FORMAT "%5.3" EXTENDED_LIMITS -3276.800 3276.700
 /begin AXIS_DESCR STD_AXIS Eng_nAvrg EngN 8 0.00 6000.000 FORMAT "%8.3" EXTENDED_LIMITS -32768.00 32767.00 DEPOSIT ABSOLUTE /end AXIS_DESCR
 /begin AXIS_DESCR STD_AXIS FTSCD_tFuel Temp_Cels 8 -50.14000 199.8600 FORMAT "%8.4" EXTENDED_LIMITS -3549.940 3003.560 DEPOSIT ABSOLUTE /end AXIS_DESCR
/end CHARACTERISTIC
/begin CHARACTERISTIC Rail_pSetPointMaxDef_CUR "Kennlinie für den Vorgabewert des maximalen Raildruck Sollwert" CURVE 0xF7F26 Kl_Xs16_Ws16 2000.000 Pres_Rail 0.00 2000.000 FORMAT "%5.3" EXTENDED_LIMITS -3276.800 3276.700
 /begin AXIS_DESCR STD_AXIS Eng_nAvrg EngN 6 0.00 6000.000 FORMAT "%8.3" EXTENDED_LIMITS -32768.00 32767.00 DEPOSIT ABSOLUTE /end AXIS_DESCR
/end CHARACTERISTIC
/begin CHARACTERISTIC Rail_pSetPointMaxDef_MAP "Kennfeld für den Vorgabewert des maximalen Raildruck Sollwert" MAP 0xF7F40 Kf_Xs16_Ys16_Ws16 2000.000 Pres_Rail 0.00 2000.000 FORMAT "%5.3" EXTENDED_LIMITS -3276.800 3276.700
 /begin AXIS_DESCR STD_AXIS Eng_nAvrg EngN 6 0.00 6000.000 FORMAT "%8.3" EXTENDED_LIMITS -32768.00 32767.00 DEPOSIT ABSOLUTE /end AXIS_DESCR
 /begin AXIS_DESCR STD_AXIS FTSCD_tFuel Temp_Cels 5 -50.14000 199.8600 FORMAT "%8.4" EXTENDED_LIMITS -3549.940 3003.560 DEPOSIT ABSOLUTE /end AXIS_DESCR
/end CHARACTERISTIC
/begin CHARACTERISTIC Rail_pSetPointMax_MAP "maximaler Raildruck Sollwert, abhängig von der Motordrehzahl und der Einspritzmenge" MAP 0xF7F96 Kf_Xs16_Ys16_Ws16 2000.000 Pres_Rail 0.00 2000.000 FORMAT "%5.3" EXTENDED_LIMITS -3276.800 3276.700
 /begin AXIS_DESCR STD_AXIS Eng_nAvrg EngN 5 0.00 6000.000 FORMAT "%8.3" EXTENDED_LIMITS -32768.00 32767.00 DEPOSIT ABSOLUTE /end AXIS_DESCR
 /begin AXIS_DESCR STD_AXIS InjCrv_qTot InjMassCyc 6 0.00 327.6700 FORMAT "%8.4" EXTENDED_LIMITS -327.6800 327.6700 DEPOSIT ABSOLUTE /end AXIS_DESCR
/end CHARACTERISTIC
/begin CHARACTERISTIC Rail_pSetPointMinDef_C "minimaler Raildruck-Sollwert im Fehlerfall" VALUE 0xF7FEC Kw_Ws16 2000.000 Pres_Rail 0.00 2000.000 FORMAT "%5.3" EXTENDED_LIMITS -3276.800 3276.700 /end CHARACTERISTIC
/begin CHARACTERISTIC Rail_pSetPointMin_MAP "minimaler Raildruck-Sollwert, abhängig von der Motordrehzahl und der Einspritzmenge" MAP 0xF7FEE Kf_Xs16_Ys16_Ws16 2000.000 Pres_Rail 0.00 2000.000 FORMAT "%5.3" EXTENDED_LIMITS -3276.800 3276.700
 /begin AXIS_DESCR STD_AXIS Eng_nAvrg EngN 5 0.00 6000.000 FORMAT "%8.3" EXTENDED_LIMITS -32768.00 32767.00 DEPOSIT ABSOLUTE /end AXIS_DESCR
 /begin AXIS_DESCR STD_AXIS InjCrv_qTot InjMassCyc 6 0.00 327.6700 FORMAT "%8.4" EXTENDED_LIMITS -327.6800 327.6700 DEPOSIT ABSOLUTE /end AXIS_DESCR
/end CHARACTERISTIC
/begin CHARACTERISTIC Rail_pSetPointRed_C "Offset zur Absenkung des Raildrucksollwert im Systemfehlerfall" VALUE 0xF7AD6 Kw_Ws16 6553.500 Pres_Rail -3276.800 3276.700 FORMAT "%5.3" /end CHARACTERISTIC
/begin CHARACTERISTIC Rail_pSetPointRgn_MAP "Raildrucksollwertberechnungs-KF im Regenerationsmodus" MAP 0xF72FC Kf_Xs16_Ys16_Ws16 2000.000 Pres_Rail 0.00 2000.000 FORMAT "%5.3" EXTENDED_LIMITS -3276.800 3276.700
 /begin AXIS_DESCR STD_AXIS Eng_nAvrg EngN 16 0.00 6000.000 FORMAT "%8.3" EXTENDED_LIMITS -32768.00 32767.00 DEPOSIT ABSOLUTE /end AXIS_DESCR
 /begin AXIS_DESCR STD_AXIS InjCtl_qCurr InjMassCyc 16 0.00 327.6700 FORMAT "%8.4" EXTENDED_LIMITS -327.6800 327.6700 DEPOSIT ABSOLUTE /end AXIS_DESCR
/end CHARACTERISTIC
/begin CHARACTERISTIC Rail_pSetPointRgn_Vector "Bypass-Label, nicht editieren !" VALUE 0xC39BA Kw_Wu8 255.0 OneToOne 0.00 255.0 FORMAT "%5.1" /end CHARACTERISTIC
/begin CHARACTERISTIC Rail_pSetPointRgn_Channel "Bypass-Label, nicht editieren !" VALUE 0xC39BB Kw_Wu8 255.0 OneToOne 0.00 255.0 FORMAT "%5.1" /end CHARACTERISTIC
/begin CHARACTERISTIC Rail_pSetPointZFCMax_C "Maximaler Raildrucksollwert bei aktiver Nullmengenkalibrierung" VALUE 0xF867A Kw_Ws16 2000.000 Pres_Rail 0.00 2000.000 FORMAT "%5.3" EXTENDED_LIMITS -3276.800 3276.700 /end CHARACTERISTIC
/begin CHARACTERISTIC Rail_pSetPointZFCMin_C "Minimaler Raildrucksollwert bei aktiver Nullmengenkalibrierung" VALUE 0xF867C Kw_Ws16 2000.000 Pres_Rail 0.00 2000.000 FORMAT "%5.3" EXTENDED_LIMITS -3276.800 3276.700 /end CHARACTERISTIC
/begin CHARACTERISTIC Rail_pSetPoint_Vector "Bypass-Label für Rail_pSetPoint (Nicht verstellen!)" VALUE 0xC39BC Kw_Wu8 255.0 OneToOne 0.00 255.0 FORMAT "%5.1" /end CHARACTERISTIC
/begin CHARACTERISTIC Rail_pSetPoint_Channel "Bypass-Label für Rail_pSetPoint (Nicht verstellen!)" VALUE 0xC39BD Kw_Wu8 255.0 OneToOne 0.00 255.0 FORMAT "%5.1" /end CHARACTERISTIC
/begin CHARACTERISTIC Rail_qRedOfsLim_C "Schwelle fuer Einspritzmenge zur Verringerung des Offsetwertes fuer PCV" VALUE 0xF72D4 Kw_Ws16 655.3500 InjMassInj -327.6800 327.6700 FORMAT "%8.4" /end CHARACTERISTIC
/begin CHARACTERISTIC Rail_rPeakMinSlpZFC_C "Rampensteigung bei minimalem Raildruck nach Kalibrierung der ZFC" VALUE 0xF867E Kw_Ws16 100.0000 Prc 0.00 100.0000 FORMAT "%8.4" EXTENDED_LIMITS -400.0000 399.9878 /end CHARACTERISTIC
/begin CHARACTERISTIC Rail_rZFCInitDwn_CUR "Faktor für anfänglichen Raildrucksollwert des PT1 FIlters abwärts" CURVE 0xF8680 Kl_Xs16_Ws16 100.0000 Prc 0.00 100.0000 FORMAT "%8.4" EXTENDED_LIMITS -400.0000 399.9878
 /begin AXIS_DESCR STD_AXIS ZFC_pRailSetPoint_mp Pres_Rail 3 0.00 2000.000 FORMAT "%5.3" EXTENDED_LIMITS -3276.800 3276.700 DEPOSIT ABSOLUTE /end AXIS_DESCR
/end CHARACTERISTIC
/begin CHARACTERISTIC Rail_rZFCInitUp_CUR "Faktor für anfänglichen Raildrucksollwert des PT1 Filters (aufwärts)" CURVE 0xF868E Kl_Xs16_Ws16 100.0000 Prc 0.00 100.0000 FORMAT "%8.4" EXTENDED_LIMITS -400.0000 399.9878
 /begin AXIS_DESCR STD_AXIS ZFC_pRailSetPoint_mp Pres_Rail 3 0.00 2000.000 FORMAT "%5.3" EXTENDED_LIMITS -3276.800 3276.700 DEPOSIT ABSOLUTE /end AXIS_DESCR
/end CHARACTERISTIC
/begin CHARACTERISTIC Rail_stPreCtlMeUnSel_C "Schalter-Auswahl für die Vorsteuerung der Zumesseinheit" VALUE 0xF71BC Kw_Wu8 255.0 OneToOne 0.00 255.0 FORMAT "%5.1" /end CHARACTERISTIC
/begin CHARACTERISTIC Rail_stRgnDelMsk_C "Maske für die Deaktivierung der Raildrucksollwerteberechnung im Regenerationsbetrieb" VALUE 0xF7AD8 Kw_Wu32 4294967295.00 OneToOne 0.00 4294967295.00 FORMAT "%13.2" /end CHARACTERISTIC
/begin CHARACTERISTIC Rail_stRgnMsk_C "Bitmaske für Aktivierung  des Raildrucksollwert Regenerationsmodes" VALUE 0xF7548 Kw_Wu32 4294967295.00 OneToOne 0.00 4294967295.00 FORMAT "%13.2" /end CHARACTERISTIC
/begin CHARACTERISTIC Rail_stSetPointSel_C "Schalterauswahl für die Raildruck-Sollwertberechnung" VALUE 0xF7ADC Kw_Wu8 255.0 OneToOne 0.00 255.0 FORMAT "%5.1" /end CHARACTERISTIC
/begin CHARACTERISTIC Rail_swtPreCtlVal_C "Schalterwert, Raildruckregler 1: mit / 0: ohne Vorsteuerung" VALUE 0xF6D98 Kw_Wu8 1.000 OneToOne 0.00 1.000 FORMAT "%5.3" EXTENDED_LIMITS 0.00 255.0 /end CHARACTERISTIC
/begin CHARACTERISTIC Rail_swtPreCtlType_C "Auswahl, Schalterwert aus Datensatz oder EEPROM" VALUE 0xF6D99 Kw_Wu8 0.00 OneToOne 2.000 2.000 FORMAT "%5.3" EXTENDED_LIMITS 0.00 255.0 /end CHARACTERISTIC
/begin CHARACTERISTIC Rail_swtPressVal_C "Umschaltung zwischen Steuern und Regeln anhand Absolut- / Differenzwert des Raildrucks (0: abs., 1: diff.)" VALUE 0xF6D9A Kw_Wu8 1.000 OneToOne 0.00 1.000 FORMAT "%5.3" EXTENDED_LIMITS 0.00 255.0 /end CHARACTERISTIC
/begin CHARACTERISTIC Rail_swtPressType_C "Auswahl, Schalterwert aus Datensatz oder EEPROM" VALUE 0xF6D9B Kw_Wu8 0.00 OneToOne 2.000 2.000 FORMAT "%5.3" EXTENDED_LIMITS 0.00 255.0 /end CHARACTERISTIC
/begin CHARACTERISTIC Rail_swtWindUpVal_C "Schalterwert, Raildruckregler mit eingefrorenem oder rückgerechnetem I-Anteil (0: eingefrohren, 1: rückgerechnet)" VALUE 0xF6D9C Kw_Wu8 1.000 OneToOne 0.00 1.000 FORMAT "%5.3" EXTENDED_LIMITS 0.00 255.0 /end CHARACTERISTIC
/begin CHARACTERISTIC Rail_swtWindUpType_C "Auswahl, Schalterwert aus Datensatz oder EEPROM" VALUE 0xF6D9D Kw_Wu8 0.00 OneToOne 2.000 2.000 FORMAT "%5.3" EXTENDED_LIMITS 0.00 255.0 /end CHARACTERISTIC
/begin CHARACTERISTIC Rail_tiPCVRmpDur_CUR "Laufzeit der Rampe um vom aktuellen Sollwert auf den neuen PCVClose-Wert zu rampen" CURVE 0xF72D6 Kl_Xs16_Ws16 655350.0 Time_ms -327680.0 327670.0 FORMAT "%8.1"
 /begin AXIS_DESCR STD_AXIS Eng_nAvrg EngN 8 0.00 6000.000 FORMAT "%8.3" EXTENDED_LIMITS -32768.00 32767.00 DEPOSIT ABSOLUTE /end AXIS_DESCR
/end CHARACTERISTIC
/begin CHARACTERISTIC Rail_tiPCVRmpToOfs_C "Laufzeit der Rampe um vom reduzierten Offsetwert auf den Offsetwert zu rampen" VALUE 0xF72F8 Kw_Ws16 300.0000 Time_ms 0.00 300.0000 FORMAT "%8.4" EXTENDED_LIMITS -327680.0 327670.0 /end CHARACTERISTIC
/begin CHARACTERISTIC Rail_tiPCVRmpToRedOfs_C "Laufzeit der Rampe um vom Offsetwert auf den reduzierten Offsetwert zu rampen" VALUE 0xF72FA Kw_Ws16 300.0000 Time_ms 0.00 300.0000 FORMAT "%8.4" EXTENDED_LIMITS -327680.0 327670.0 /end CHARACTERISTIC
/begin CHARACTERISTIC Rail_tiSetPointRedMin_C "Raildrucküberwachung - Mindestzeit im Fehlerfall" VALUE 0xF7ADE Kw_Wu16 10000.00 Time_ms 0.00 10000.00 FORMAT "%8.2" EXTENDED_LIMITS 0.00 655350.0 /end CHARACTERISTIC
/begin CHARACTERISTIC Rail_tiZFCDemDel_C "Verzögerungszeit für Umschaltung auf geschlossenes Druckregelventil bei aktiver Lernphase der ZFC" VALUE 0xF869C Kw_Wu16 655350.0 Time_ms 0.00 655350.0 FORMAT "%8.1" /end CHARACTERISTIC
/begin CHARACTERISTIC Rail_tiZFCPT1_C "Parameter für ZFC Raildrucksollwert PT1 filter" VALUE 0xF86A0 Kw_Wu32 1073.7408 TimeDelay_s 0.0010000001 1073.7418 FORMAT "%9.4" EXTENDED_LIMITS 0.0000010000000 4294.9673 /end CHARACTERISTIC
/begin CHARACTERISTIC Rail_volInjVlvCtl_C "Steuervolumen der Injektoren" VALUE 0xF71BE Kw_Ws16 10.00000 InjQntInj 0.00 10.00000 FORMAT "%8.5" EXTENDED_LIMITS -327.6800 327.6700 /end CHARACTERISTIC
/begin CHARACTERISTIC Rtmo_adCallingBegin_cu32 "Beginn des Adressbereiches der aufrufenden Funktion zum Messen der aufgerufenen Funktion" VALUE 0xF8738 Kw_Wu32 4294967295.00 OneToOne 0.00 4294967295.00 FORMAT "%13.2" /end CHARACTERISTIC
/begin CHARACTERISTIC Rtmo_adCallingEnd_cu32 "Ende des Adressbereiches der aufrufenden Funktion zum Messen der aufgerufenen Funktion" VALUE 0xF873C Kw_Wu32 4294967295.00 OneToOne 0.00 4294967295.00 FORMAT "%13.2" /end CHARACTERISTIC
/begin CHARACTERISTIC Rtmo_adStart_cu32 "Startadresse der zu messenden Funktion" VALUE 0xF8740 Kw_Wu32 4294967295.00 OneToOne 0.00 4294967295.00 FORMAT "%13.2" /end CHARACTERISTIC
/begin CHARACTERISTIC Rtmo_stIntOverhead_cu8 "gemessener/vermuteter Interrupt Overhead, als Korrekturfaktor für Laufzeitmessung" VALUE 0xF8744 Kw_Wu8 255.0 OneToOne 0.00 255.0 FORMAT "%5.1" /end CHARACTERISTIC
/begin CHARACTERISTIC Rtmo_stSampleTime_cu8 "Messzykluszeit: 0: keine Messung; 1-253: 100 ms Raster für jeden 1-253 Durchgang; 254: 10/20ms; 255: segment sync." VALUE 0xF8745 Kw_Wu8 255.0 OneToOne 0.00 255.0 FORMAT "%5.1" /end CHARACTERISTIC
/begin CHARACTERISTIC Rtmo_swLoadMode_cu8 "bit 1:Messung ein/aus bit 2: Maximum zurücksetzen" VALUE 0xF8746 Kw_Wu8 255.0 OneToOne 0.00 255.0 FORMAT "%5.1" /end CHARACTERISTIC
/begin CHARACTERISTIC Rtmo_swMode_cu8 "rtmo Konfig: bit0: reset of Min/Max, bit1: function/task, bit2: depend. of Funct/Tasks, bit3: Netto/Brutto" VALUE 0xF8747 Kw_Wu8 13.00 OneToOne 0.00 13.00 FORMAT "%5.2" EXTENDED_LIMITS 0.00 255.0 /end CHARACTERISTIC
/begin CHARACTERISTIC Sig_LimLowDigital_C "Unterer Grenzwert für Stellertests mit digitaler Stellgröße" VALUE 0xC0AE2 Kw_Ws16 65535.00 OneToOne -32768.00 32767.00 FORMAT "%8.2" /end CHARACTERISTIC
/begin CHARACTERISTIC Sig_LimUpDigital_C "Oberer Grenzwert für Stellertests mit digitaler Stellgröße" VALUE 0xC0AE4 Kw_Ws16 65535.00 OneToOne -32768.00 32767.00 FORMAT "%8.2" /end CHARACTERISTIC
/begin CHARACTERISTIC Sig_LimLowFlCon_C "Unterer Grenzwert für Stellertests mit Kraftstoffverbrauch Stellgröße" VALUE 0xC0AE6 Kw_Ws16 655.3500 FlConsum_l_h -327.6800 327.6700 FORMAT "%8.4" /end CHARACTERISTIC
/begin CHARACTERISTIC Sig_LimUpFlCon_C "Oberer Grenzwert für Stellertests mit Kraftstoffverbrauch Stellgröße" VALUE 0xC0AE8 Kw_Ws16 655.3500 FlConsum_l_h -327.6800 327.6700 FORMAT "%8.4" /end CHARACTERISTIC
/begin CHARACTERISTIC Sig_LimLown_C "Unterer Grenzwert für Stellertests mit Drehzahl Stellgröße" VALUE 0xC0AEA Kw_Ws16 65535.00 EngN -32768.00 32767.00 FORMAT "%8.2" /end CHARACTERISTIC
/begin CHARACTERISTIC Sig_LimUpn_C "Oberer Grenzwert für Stellertests mit Drehzahl Stellgröße" VALUE 0xC0AEC Kw_Ws16 65535.00 EngN -32768.00 32767.00 FORMAT "%8.2" /end CHARACTERISTIC
/begin CHARACTERISTIC Sig_LimLowPwm_C "Unterer Grenzwert für Stellertests mit PWM Stellgröße" VALUE 0xC0AEE Kw_Ws16 655.3500 DtyCyc -327.6800 327.6700 FORMAT "%8.4" /end CHARACTERISTIC
/begin CHARACTERISTIC Sig_LimUpPwm_C "Oberer Grenzwert für Stellertests mit PWM Stellgröße" VALUE 0xC0AF0 Kw_Ws16 655.3500 DtyCyc -327.6800 327.6700 FORMAT "%8.4" /end CHARACTERISTIC
/begin CHARACTERISTIC Sig_LimLowtrq_C "lower limit of  AC tester torque test input" VALUE 0xC0AF2 Kw_Ws16 6553.500 Trq -3276.800 3276.700 FORMAT "%8.3" /end CHARACTERISTIC
/begin CHARACTERISTIC Sig_LimUptrq_C "upper limit of  AC tester torque test input" VALUE 0xC0AF4 Kw_Ws16 6553.500 Trq -3276.800 3276.700 FORMAT "%8.3" /end CHARACTERISTIC
/begin CHARACTERISTIC Signals_PID0x1C_C "Info für Generic Scan Tool (OBD-Tester) für welche Vorschrift das Fahrzeug appliziert wurde" VALUE 0xC0AE0 Kw_Wu8 8.00000000000 SigSupLeg 1.00000000000 9.00000000000 FORMAT "%13.11" /end CHARACTERISTIC
/begin CHARACTERISTIC signals_tiTstDemHeal_C "Minimale Zeit ohne Stellertestanforderung nach Verriegelung wegen Zeitüberschreitung." VALUE 0xF8748 Kw_Wu16 655350.0 Time_ms 0.00 655350.0 FORMAT "%8.1" /end CHARACTERISTIC
/begin CHARACTERISTIC signals_tiTstDemMax_C "Maximale zulässige Testzeit für Stellertest über Diagnosetester" VALUE 0xF874A Kw_Wu16 655350.0 Time_ms 0.00 655350.0 FORMAT "%8.1" /end CHARACTERISTIC
/begin CHARACTERISTIC signals_TmrBehaviour_C "Verhalten der Zeitbegrenzung für Stellertest" VALUE 0xF874C Kw_Wu8 255.0 OneToOne 0.00 255.0 FORMAT "%5.1" /end CHARACTERISTIC
/begin CHARACTERISTIC signals_TstDemMaxEngN_C "Maximale Drehzahl für Stellertest über Diagnosetester" VALUE 0xF874E Kw_Ws16 65535.00 EngN -32768.00 32767.00 FORMAT "%8.2" /end CHARACTERISTIC
/begin CHARACTERISTIC signals_TstDemMaxVSSCDV_C "Maximale Geschwindigkeit für Stellertest über Diagnosetester" VALUE 0xF8750 Kw_Ws16 655.3500 Vel -327.6800 327.6700 FORMAT "%8.4" /end CHARACTERISTIC
/begin CHARACTERISTIC SigTst_ACEn_C "Stellertestüberwachung Freigabemaske für Klimaanlage Ausgang" VALUE 0xF8752 Kw_Wu8 7.000 OneToOne 0.00 7.000 FORMAT "%5.3" EXTENDED_LIMITS 0.00 255.0 /end CHARACTERISTIC
/begin CHARACTERISTIC SigTst_AOHtEn_C "Stellertestüberwachung Freigabemaske für Zusatzheizersteller" VALUE 0xF8753 Kw_Wu8 7.000 OneToOne 0.00 7.000 FORMAT "%5.3" EXTENDED_LIMITS 0.00 255.0 /end CHARACTERISTIC
/begin CHARACTERISTIC SigTst_BPAEn_C "Stellertestüberwachung Freigabemaske für Ladedrucksteller" VALUE 0xF8754 Kw_Wu8 7.000 OneToOne 0.00 7.000 FORMAT "%5.3" EXTENDED_LIMITS 0.00 255.0 /end CHARACTERISTIC
/begin CHARACTERISTIC SigTst_BPA2En_C "Stellertestüberwachung Freigabemaske für Ladedrucksteller 2" VALUE 0xF8755 Kw_Wu8 7.000 OneToOne 0.00 7.000 FORMAT "%5.3" EXTENDED_LIMITS 0.00 255.0 /end CHARACTERISTIC
/begin CHARACTERISTIC SigTst_CpBVlvEn_C "Switch to enable tester" VALUE 0xF8756 Kw_Wu8 7.000 OneToOne 0.00 7.000 FORMAT "%5.3" EXTENDED_LIMITS 0.00 255.0 /end CHARACTERISTIC
/begin CHARACTERISTIC SigTst_EBAFEn_C "Stellertestüberwachung Freigabemaske für EBAfCD" VALUE 0xF8757 Kw_Wu8 7.000 OneToOne 0.00 7.000 FORMAT "%5.3" EXTENDED_LIMITS 0.00 255.0 /end CHARACTERISTIC
/begin CHARACTERISTIC SigTst_EBFEn_C "Freigabemaske für Stellertestüberwachung für E-Box Lüfter" VALUE 0xF8758 Kw_Wu8 7.000 OneToOne 0.00 7.000 FORMAT "%5.3" EXTENDED_LIMITS 0.00 255.0 /end CHARACTERISTIC
/begin CHARACTERISTIC SigTst_EGPpEn_C "Tester demand monitoring enable mask for EGPp" VALUE 0xF8759 Kw_Wu8 7.000 OneToOne 0.00 7.000 FORMAT "%5.3" EXTENDED_LIMITS 0.00 255.0 /end CHARACTERISTIC
/begin CHARACTERISTIC SigTst_EGREn_C "Stellertestüberwachung Freigabemaske für Abgasrückführpositionssteller" VALUE 0xF875A Kw_Wu8 7.000 OneToOne 0.00 7.000 FORMAT "%5.3" EXTENDED_LIMITS 0.00 255.0 /end CHARACTERISTIC
/begin CHARACTERISTIC SigTst_EGR2En_C "Stellertestüberwachung Freigabemaske für Abgasrückführpositionssteller 2" VALUE 0xF875B Kw_Wu8 7.000 OneToOne 0.00 7.000 FORMAT "%5.3" EXTENDED_LIMITS 0.00 255.0 /end CHARACTERISTIC
/begin CHARACTERISTIC SigTst_EGRClgBypVlv2En_C "Stellertestüberwachung Freigabemaske für den Kühlerbypass des Abgasrückführungsventils 2" VALUE 0xF875C Kw_Wu8 7.000 OneToOne 0.00 7.000 FORMAT "%5.3" EXTENDED_LIMITS 0.00 255.0 /end CHARACTERISTIC
/begin CHARACTERISTIC SigTst_ETClbCorOffEn_C "Tester Anforderung Überwachungsfreigabemaske für die Ansteuerdauerkorrektur der Nullmengenkalibrierung" VALUE 0xF875D Kw_Wu8 7.000 OneToOne 0.00 7.000 FORMAT "%5.3" EXTENDED_LIMITS 0.00 255.0 /end CHARACTERISTIC
/begin CHARACTERISTIC SigTst_EngMEn_C "Remote-Control für Drehzahl Eng_nAvrg aktivieren" VALUE 0xF875E Kw_Wu8 7.000 OneToOne 0.00 7.000 FORMAT "%5.3" EXTENDED_LIMITS 0.00 255.0 /end CHARACTERISTIC
/begin CHARACTERISTIC SigTst_FANEn_C "Stellertest für Kühlerlüfter" VALUE 0xF875F Kw_Wu8 7.000 OneToOne 0.00 7.000 FORMAT "%5.3" EXTENDED_LIMITS 0.00 255.0 /end CHARACTERISTIC
/begin CHARACTERISTIC SigTst_GLWRLYEn_C "Stellertestüberwachung Freigabemaske für Glüh Relay" VALUE 0xF8760 Kw_Wu8 7.000 OneToOne 0.00 7.000 FORMAT "%5.3" EXTENDED_LIMITS 0.00 255.0 /end CHARACTERISTIC
/begin CHARACTERISTIC SigTst_LPAEn_C "Switch to enable tester" VALUE 0xF8761 Kw_Wu8 7.000 OneToOne 0.00 7.000 FORMAT "%5.3" EXTENDED_LIMITS 0.00 255.0 /end CHARACTERISTIC
/begin CHARACTERISTIC SigTst_LSUCDHt0En_C "Auswahlmake für Überwachungsbedingungen des Lambda Sensor Stellertests" VALUE 0xF8762 Kw_Wu8 7.000 OneToOne 0.00 7.000 FORMAT "%5.3" EXTENDED_LIMITS 0.00 255.0 /end CHARACTERISTIC
/begin CHARACTERISTIC SigTst_MILLAMPEn_C "Stellertestüberwachung Freigabemaske für MIL (OBD-Lampe)" VALUE 0xF8763 Kw_Wu8 7.000 OneToOne 0.00 7.000 FORMAT "%5.3" EXTENDED_LIMITS 0.00 255.0 /end CHARACTERISTIC
/begin CHARACTERISTIC SigTst_MNTCTLEn_C "Tester demand monitoring enable mask for MNTCTL" VALUE 0xF8764 Kw_Wu8 7.000 OneToOne 0.00 7.000 FORMAT "%5.3" EXTENDED_LIMITS 0.00 255.0 /end CHARACTERISTIC
/begin CHARACTERISTIC SigTst_MeUnEn_C "Stellertestüberwachung Freigabemaske für Zumesseinheit" VALUE 0xF8765 Kw_Wu8 7.000 OneToOne 0.00 7.000 FORMAT "%5.3" EXTENDED_LIMITS 0.00 255.0 /end CHARACTERISTIC
/begin CHARACTERISTIC SigTst_PCVEn_C "Stellertestüberwachung Freigabemaske für Druckregelventil" VALUE 0xF8766 Kw_Wu8 7.000 OneToOne 0.00 7.000 FORMAT "%5.3" EXTENDED_LIMITS 0.00 255.0 /end CHARACTERISTIC
/begin CHARACTERISTIC SigTst_PCVAdaptRstEn_C "SignalTest-Anforderung zur Zurückstellung der Adaptionsvariablen" VALUE 0xF8767 Kw_Wu8 7.000 OneToOne 0.00 7.000 FORMAT "%5.3" EXTENDED_LIMITS 0.00 255.0 /end CHARACTERISTIC
/begin CHARACTERISTIC SigTst_PSPEn_C "Stellertestüberwachung Freigabemaske für Vorförderpumpen  Ausgang" VALUE 0xF8768 Kw_Wu8 7.000 OneToOne 0.00 7.000 FORMAT "%5.3" EXTENDED_LIMITS 0.00 255.0 /end CHARACTERISTIC
/begin CHARACTERISTIC SigTst_SYSLAMPEn_C "Stellertestüberwachung Freigabemaske für Systemlampe" VALUE 0xF8769 Kw_Wu8 7.000 OneToOne 0.00 7.000 FORMAT "%5.3" EXTENDED_LIMITS 0.00 255.0 /end CHARACTERISTIC
/begin CHARACTERISTIC SigTst_TVAEn_C "Stellertestüberwachung Freigabemaske für Drosselklappensteller" VALUE 0xF876A Kw_Wu8 7.000 OneToOne 0.00 7.000 FORMAT "%5.3" EXTENDED_LIMITS 0.00 255.0 /end CHARACTERISTIC
/begin CHARACTERISTIC SigTst_TVA2En_C "Stellertestüberwachung Freigabemaske für Drosselklappensteller 2" VALUE 0xF876B Kw_Wu8 7.000 OneToOne 0.00 7.000 FORMAT "%5.3" EXTENDED_LIMITS 0.00 255.0 /end CHARACTERISTIC
/begin CHARACTERISTIC SigTst_VSAEn_C "Stellertestüberwachung Freigabemaske für Drallniveausteller" VALUE 0xF876C Kw_Wu8 7.000 OneToOne 0.00 7.000 FORMAT "%5.3" EXTENDED_LIMITS 0.00 255.0 /end CHARACTERISTIC
/begin CHARACTERISTIC Sig_aiDSMOffset_C "Offset für Umrechnung ecu -> dsm" VALUE 0xC06E4 Kw_Ws16 65535.00 OneToOne -32768.00 32767.00 FORMAT "%8.2" /end CHARACTERISTIC
/begin CHARACTERISTIC Sig_aiDSMScale_C "Skalierung für Umrechnung ecu -> dsm" VALUE 0xC06E6 Kw_Wu16 7.999878 Fact 0.00 7.999878 FORMAT "%8.6" /end CHARACTERISTIC
/begin CHARACTERISTIC Sig_aiCANOffset_C "Offset für Umrechnung ecu -> can" VALUE 0xC06E8 Kw_Ws16 65535.00 OneToOne -32768.00 32767.00 FORMAT "%8.2" /end CHARACTERISTIC
/begin CHARACTERISTIC Sig_aiCANScale_C "Skalierung für Umrechnung ecu -> can" VALUE 0xC06EA Kw_Wu16 7.999878 Fact 0.00 7.999878 FORMAT "%8.6" /end CHARACTERISTIC
/begin CHARACTERISTIC Sig_aiDIAOffset_C "Offset für Umrechnung  ecu -> dia" VALUE 0xC06EC Kw_Ws16 65535.00 OneToOne -32768.00 32767.00 FORMAT "%8.2" /end CHARACTERISTIC
/begin CHARACTERISTIC Sig_aiDIAScale_C "Skalierung für Umrechnung ecu -> dia" VALUE 0xC06EE Kw_Wu16 7.999878 Fact 0.00 7.999878 FORMAT "%8.6" /end CHARACTERISTIC
/begin CHARACTERISTIC Sig_AngCrSDSMOffset_C "Umrechnung des Kurbelwellenwinkels: dsm offset" VALUE 0xC06F0 Kw_Ws16 65535.00 OneToOne -32768.00 32767.00 FORMAT "%8.2" /end CHARACTERISTIC
/begin CHARACTERISTIC Sig_AngCrSDSMScale_C "Umrechnung des Kurbelwellenwinkels: dsm scale factor" VALUE 0xC06F2 Kw_Wu16 7.999878 Fact 0.00 7.999878 FORMAT "%8.6" /end CHARACTERISTIC
/begin CHARACTERISTIC Sig_AngCrSCANOffset_C "Umrechnung des Kurbelwellenwinkels: can Offset" VALUE 0xC06F4 Kw_Ws16 65535.00 OneToOne -32768.00 32767.00 FORMAT "%8.2" /end CHARACTERISTIC
/begin CHARACTERISTIC Sig_AngCrSCANScale_C "Umrechnung Kurbelwellenwinkels: can scale factor" VALUE 0xC06F6 Kw_Wu16 7.999878 Fact 0.00 7.999878 FORMAT "%8.6" /end CHARACTERISTIC
/begin CHARACTERISTIC Sig_AngCrSDIAOffset_C "Umrechnung des Kurbelwellenwinkels: dia offset" VALUE 0xC06F8 Kw_Ws16 65535.00 OneToOne -32768.00 32767.00 FORMAT "%8.2" /end CHARACTERISTIC
/begin CHARACTERISTIC Sig_AngCrSDIAScale_C "Umrechnung des Kurbelwellenwinkels: dia scale factor" VALUE 0xC06FA Kw_Wu16 7.999878 Fact 0.00 7.999878 FORMAT "%8.6" /end CHARACTERISTIC
/begin CHARACTERISTIC Sig_aDSMOffset_C "Offset fuer Umrechung SG->DSM fuer Beschleunigung" VALUE 0xC06FC Kw_Ws16 65535.00 OneToOne -32768.00 32767.00 FORMAT "%8.2" /end CHARACTERISTIC
/begin CHARACTERISTIC Sig_aDSMScale_C "Skalierung Umrechungs Faktor SG->DSM fuer Beschleunigung" VALUE 0xC06FE Kw_Wu16 7.999878 Fact 0.00 7.999878 FORMAT "%8.6" /end CHARACTERISTIC
/begin CHARACTERISTIC Sig_aCANOffset_C "Offset fuer Umrechung SG->CAN fuer Beschleunigung" VALUE 0xC0700 Kw_Ws16 65535.00 OneToOne -32768.00 32767.00 FORMAT "%8.2" /end CHARACTERISTIC
/begin CHARACTERISTIC Sig_aCANScale_C "Skalierung Umrechungs Faktor SG->CAN fuer Beschleunigung" VALUE 0xC0702 Kw_Wu16 7.999878 Fact 0.00 7.999878 FORMAT "%8.6" /end CHARACTERISTIC
/begin CHARACTERISTIC Sig_aDIAOffset_C "Offset fuer Umrechung SG->DIA fuer Beschleunigung" VALUE 0xC0704 Kw_Ws16 65535.00 OneToOne -32768.00 32767.00 FORMAT "%8.2" /end CHARACTERISTIC
/begin CHARACTERISTIC Sig_aDIAScale_C "Skalierung Umrechungs Faktor SG->DIA fuer Beschleunigung" VALUE 0xC0706 Kw_Wu16 7.999878 Fact 0.00 7.999878 FORMAT "%8.6" /end CHARACTERISTIC
/begin CHARACTERISTIC Sig_Carb_dtDSMOffset_C "Signals Offset für Umrechung  Temperaturdifferenz Intern nach DSM mit CARB Normierung" VALUE 0xC0708 Kw_Ws16 65535.00 OneToOne -32768.00 32767.00 FORMAT "%8.2" /end CHARACTERISTIC
/begin CHARACTERISTIC Sig_Carb_dtDSMScale_C "Signals Skalierungsfaktor für Umrechung  Temperaturdifferenz Intern nach DSM mit CARB Normierung" VALUE 0xC070A Kw_Wu16 7.999878 Fact 0.00 7.999878 FORMAT "%8.6" /end CHARACTERISTIC
/begin CHARACTERISTIC Sig_Carb_dtCANOffset_C "Signals Offset für Umrechung  Temperaturdifferenz Intern nach CAN mit CARB Normierung" VALUE 0xC070C Kw_Ws16 65535.00 OneToOne -32768.00 32767.00 FORMAT "%8.2" /end CHARACTERISTIC
/begin CHARACTERISTIC Sig_Carb_dtCANScale_C "Signals Skalierungsfaktor für Umrechung  Temperaturdifferenz Intern nach CAN mit CARB Normierung" VALUE 0xC070E Kw_Wu16 7.999878 Fact 0.00 7.999878 FORMAT "%8.6" /end CHARACTERISTIC
/begin CHARACTERISTIC Sig_Carb_dtDIAOffset_C "Signals Offset für Umrechung  Temperaturdifferenz Intern nach Diagnose mit CARB Normierung" VALUE 0xC0710 Kw_Ws16 65535.00 OneToOne -32768.00 32767.00 FORMAT "%8.2" /end CHARACTERISTIC
/begin CHARACTERISTIC Sig_Carb_dtDIAScale_C "Signals Skalierungsfaktor für Umrechung  Temperaturdifferenz Intern nach Diagnose mit CARB Normierung" VALUE 0xC0712 Kw_Wu16 7.999878 Fact 0.00 7.999878 FORMAT "%8.6" /end CHARACTERISTIC
/begin CHARACTERISTIC Sig_Carb_lDSMOffset_C "Signals Offset für Umrechung  Fahrstrecke Intern nach DSM mit CARB Normierung" VALUE 0xC0714 Kw_Ws16 65535.00 OneToOne -32768.00 32767.00 FORMAT "%8.2" /end CHARACTERISTIC
/begin CHARACTERISTIC Sig_Carb_lDSMScale_C "Signals Skalierungsfaktor für Umrechung  Fahrstrecke Intern nach DSM mit CARB Normierung" VALUE 0xC0716 Kw_Wu16 7.999878 Fact 0.00 7.999878 FORMAT "%8.6" /end CHARACTERISTIC
/begin CHARACTERISTIC Sig_Carb_lCANOffset_C "Signals Offset für Umrechung  Fahrstrecke Intern nach CAN mit CARB Normierung" VALUE 0xC0718 Kw_Ws16 65535.00 OneToOne -32768.00 32767.00 FORMAT "%8.2" /end CHARACTERISTIC
/begin CHARACTERISTIC Sig_Carb_lCANScale_C "Signals Skalierungsfaktor für Umrechung  Fahrstrecke Intern nach CAN mit CARB Normierung" VALUE 0xC071A Kw_Wu16 7.999878 Fact 0.00 7.999878 FORMAT "%8.6" /end CHARACTERISTIC
/begin CHARACTERISTIC Sig_Carb_lDIAOffset_C "Signals Offset für Umrechung  Fahrstrecke Intern nach Diagnoseschnittstelle mit CARB Normierung" VALUE 0xC071C Kw_Ws16 65535.00 OneToOne -32768.00 32767.00 FORMAT "%8.2" /end CHARACTERISTIC
/begin CHARACTERISTIC Sig_Carb_lDIAScale_C "Signals Skalierungsfaktor für Umrechung  Fahrstrecke Intern nach Diagnoseschnittstelle mit CARB Normierung" VALUE 0xC071E Kw_Wu16 7.999878 Fact 0.00 7.999878 FORMAT "%8.6" /end CHARACTERISTIC
/begin CHARACTERISTIC Sig_Carb_mAirTimDSMOffset_C "Offset fuer Umrechung SG->DSM fuer Luftmasse pro Zeit (OBD)" VALUE 0xC0720 Kw_Ws16 65535.00 OneToOne -32768.00 32767.00 FORMAT "%8.2" /end CHARACTERISTIC
/begin CHARACTERISTIC Sig_Carb_mAirTimDSMScale_C "Skalierung Umrechungs Faktor SG->DSM fuer Luftmasse pro Zeit (OBD)" VALUE 0xC0722 Kw_Wu16 7.999878 Fact 0.00 7.999878 FORMAT "%8.6" /end CHARACTERISTIC
/begin CHARACTERISTIC Sig_Carb_mAirTimCANOffset_C "Offset fuer Umrechung SG->CAN fuer Luftmasse pro Zeit (OBD)" VALUE 0xC0724 Kw_Ws16 65535.00 OneToOne -32768.00 32767.00 FORMAT "%8.2" /end CHARACTERISTIC
/begin CHARACTERISTIC Sig_Carb_mAirTimCANScale_C "Skalierung Umrechungs Faktor SG->CAN fuer Luftmasse pro Zeit (OBD)" VALUE 0xC0726 Kw_Wu16 7.999878 Fact 0.00 7.999878 FORMAT "%8.6" /end CHARACTERISTIC
/begin CHARACTERISTIC Sig_Carb_mAirTimDIAOffset_C "Offset fuer Umrechung SG->DIA fuer Luftmasse pro Zeit (OBD)" VALUE 0xC0728 Kw_Ws16 65535.00 OneToOne -32768.00 32767.00 FORMAT "%8.2" /end CHARACTERISTIC
/begin CHARACTERISTIC Sig_Carb_mAirTimDIAScale_C "Skalierung Umrechungs Faktor SG->DIA fuer Luftmasse pro Zeit (OBD)" VALUE 0xC072A Kw_Wu16 7.999878 Fact 0.00 7.999878 FORMAT "%8.6" /end CHARACTERISTIC
/begin CHARACTERISTIC Sig_Carb_nDSMOffset_C "Offset fuer Umrechung SG->DSM fuer Drehzahl (OBD)" VALUE 0xC072C Kw_Ws16 65535.00 OneToOne -32768.00 32767.00 FORMAT "%8.2" /end CHARACTERISTIC
/begin CHARACTERISTIC Sig_Carb_nDSMScale_C "Skalierung Umrechungs Faktor SG->DSM fuer Drehzahl (OBD)" VALUE 0xC072E Kw_Wu16 7.999878 Fact 0.00 7.999878 FORMAT "%8.6" /end CHARACTERISTIC
/begin CHARACTERISTIC Sig_Carb_nCANOffset_C "Offset fuer Umrechung SG->CAN fuer Drehzahl (OBD)" VALUE 0xC0730 Kw_Ws16 65535.00 OneToOne -32768.00 32767.00 FORMAT "%8.2" /end CHARACTERISTIC
/begin CHARACTERISTIC Sig_Carb_nCANScale_C "Skalierung Umrechungs Faktor SG->CAN fuer Drehzahl (OBD)" VALUE 0xC0732 Kw_Wu16 7.999878 Fact 0.00 7.999878 FORMAT "%8.6" /end CHARACTERISTIC
/begin CHARACTERISTIC Sig_Carb_nDIAOffset_C "Offset fuer Umrechung SG->DIA fuer Drehzahl (OBD)" VALUE 0xC0734 Kw_Ws16 65535.00 OneToOne -32768.00 32767.00 FORMAT "%8.2" /end CHARACTERISTIC
/begin CHARACTERISTIC Sig_Carb_nDIAScale_C "Skalierung Umrechungs Faktor SG->DIA fuer Drehzahl (OBD)" VALUE 0xC0736 Kw_Wu16 7.999878 Fact 0.00 7.999878 FORMAT "%8.6" /end CHARACTERISTIC
/begin CHARACTERISTIC Sig_Carb_pDSMOffset_C "Offset fuer Umrechung SG->DSM fuer Druck (OBD)" VALUE 0xC0738 Kw_Ws16 65535.00 OneToOne -32768.00 32767.00 FORMAT "%8.2" /end CHARACTERISTIC
/begin CHARACTERISTIC Sig_Carb_pDSMScale_C "Skalierung Umrechungs Faktor SG->DSM fuer Druck (OBD)" VALUE 0xC073A Kw_Wu16 7.999878 Fact 0.00 7.999878 FORMAT "%8.6" /end CHARACTERISTIC
/begin CHARACTERISTIC Sig_Carb_pCANOffset_C "Offset fuer Umrechung SG->CAN fuer Druck (OBD)" VALUE 0xC073C Kw_Ws16 65535.00 OneToOne -32768.00 32767.00 FORMAT "%8.2" /end CHARACTERISTIC
/begin CHARACTERISTIC Sig_Carb_pCANScale_C "Skalierung Umrechungs Faktor SG->CAN fuer Druck (OBD)" VALUE 0xC073E Kw_Wu16 7.999878 Fact 0.00 7.999878 FORMAT "%8.6" /end CHARACTERISTIC
/begin CHARACTERISTIC Sig_Carb_pDIAOffset_C "Offset fuer Umrechung SG->DIA fuer Druck (OBD)" VALUE 0xC0740 Kw_Ws16 65535.00 OneToOne -32768.00 32767.00 FORMAT "%8.2" /end CHARACTERISTIC
/begin CHARACTERISTIC Sig_Carb_pDIAScale_C "Skalierung Umrechungs Faktor SG->DIA fuer Druck (OBD)" VALUE 0xC0742 Kw_Wu16 7.999878 Fact 0.00 7.999878 FORMAT "%8.6" /end CHARACTERISTIC
/begin CHARACTERISTIC Sig_Carb_rDSMOffset_C "Offset fuer Umrechung SG->DSM fuer Verhältnis (OBD)" VALUE 0xC0744 Kw_Ws16 65535.00 OneToOne -32768.00 32767.00 FORMAT "%8.2" /end CHARACTERISTIC
/begin CHARACTERISTIC Sig_Carb_rDSMScale_C "Skalierung Umrechungs Faktor SG->DSM fuer Verhältnis (OBD)" VALUE 0xC0746 Kw_Wu16 7.999878 Fact 0.00 7.999878 FORMAT "%8.6" /end CHARACTERISTIC
/begin CHARACTERISTIC Sig_Carb_rCANOffset_C "Offset fuer Umrechung SG->CAN fuer Verhältnis (OBD)" VALUE 0xC0748 Kw_Ws16 65535.00 OneToOne -32768.00 32767.00 FORMAT "%8.2" /end CHARACTERISTIC
/begin CHARACTERISTIC Sig_Carb_rCANScale_C "Skalierung Umrechungs Faktor SG->CAN fuer Verhältnis (OBD)" VALUE 0xC074A Kw_Wu16 7.999878 Fact 0.00 7.999878 FORMAT "%8.6" /end CHARACTERISTIC
/begin CHARACTERISTIC Sig_Carb_rDIAOffset_C "Offset fuer Umrechung SG->DIA fuer Verhältnis (OBD)" VALUE 0xC074C Kw_Ws16 65535.00 OneToOne -32768.00 32767.00 FORMAT "%8.2" /end CHARACTERISTIC
/begin CHARACTERISTIC Sig_Carb_rDIAScale_C "Skalierung Umrechungs Faktor SG->DIA fuer Verhältnis (OBD)" VALUE 0xC074E Kw_Wu16 7.999878 Fact 0.00 7.999878 FORMAT "%8.6" /end CHARACTERISTIC
/begin CHARACTERISTIC Sig_Carb_tiDSMOffset_C "Offset fuer Umrechung SG->DSM fuer Zeit (OBD)" VALUE 0xC0750 Kw_Ws16 65535.00 OneToOne -32768.00 32767.00 FORMAT "%8.2" /end CHARACTERISTIC
/begin CHARACTERISTIC Sig_Carb_tiDSMScale_C "Skalierung Umrechungs Faktor SG->DSM fuer Zeit (OBD)" VALUE 0xC0752 Kw_Wu16 7.999878 Fact 0.00 7.999878 FORMAT "%8.6" /end CHARACTERISTIC
/begin CHARACTERISTIC Sig_Carb_tiCANOffset_C "Offset fuer Umrechung SG->CAN fuer Zeit (OBD)" VALUE 0xC0754 Kw_Ws16 65535.00 OneToOne -32768.00 32767.00 FORMAT "%8.2" /end CHARACTERISTIC
/begin CHARACTERISTIC Sig_Carb_tiCANScale_C "Skalierung Umrechungs Faktor SG->CAN fuer Zeit (OBD)" VALUE 0xC0756 Kw_Wu16 7.999878 Fact 0.00 7.999878 FORMAT "%8.6" /end CHARACTERISTIC
/begin CHARACTERISTIC Sig_Carb_tiDIAOffset_C "Offset fuer Umrechung SG->DIA fuer Zeit (OBD)" VALUE 0xC0758 Kw_Ws16 65535.00 OneToOne -32768.00 32767.00 FORMAT "%8.2" /end CHARACTERISTIC
/begin CHARACTERISTIC Sig_Carb_tiDIAScale_C "Skalierung Umrechungs Faktor SG->DIA fuer Zeit (OBD)" VALUE 0xC075A Kw_Wu16 7.999878 Fact 0.00 7.999878 FORMAT "%8.6" /end CHARACTERISTIC
/begin CHARACTERISTIC Sig_Carb_tDSMOffset_C "Offset fuer Umrechung SG->DSM fuer Temperatur (OBD)" VALUE 0xC075C Kw_Ws16 65535.00 OneToOne -32768.00 32767.00 FORMAT "%8.2" /end CHARACTERISTIC
/begin CHARACTERISTIC Sig_Carb_tDSMScale_C "Skalierung Umrechungs Faktor SG->DSM fuer Temperatur (OBD)" VALUE 0xC075E Kw_Wu16 7.999878 Fact 0.00 7.999878 FORMAT "%8.6" /end CHARACTERISTIC
/begin CHARACTERISTIC Sig_Carb_tCANOffset_C "Offset fuer Umrechung SG->CAN fuer Temperatur (OBD)" VALUE 0xC0760 Kw_Ws16 65535.00 OneToOne -32768.00 32767.00 FORMAT "%8.2" /end CHARACTERISTIC
/begin CHARACTERISTIC Sig_Carb_tCANScale_C "Skalierung Umrechungs Faktor SG->CAN fuer Temperatur (OBD)" VALUE 0xC0762 Kw_Wu16 7.999878 Fact 0.00 7.999878 FORMAT "%8.6" /end CHARACTERISTIC
/begin CHARACTERISTIC Sig_Carb_tDIAOffset_C "Offset fuer Umrechung SG->DIA fuer Temperatur (OBD)" VALUE 0xC0764 Kw_Ws16 65535.00 OneToOne -32768.00 32767.00 FORMAT "%8.2" /end CHARACTERISTIC
/begin CHARACTERISTIC Sig_Carb_tDIAScale_C "Skalierung Umrechungs Faktor SG->DIA fuer Temperatur (OBD)" VALUE 0xC0766 Kw_Wu16 7.999878 Fact 0.00 7.999878 FORMAT "%8.6" /end CHARACTERISTIC
/begin CHARACTERISTIC Sig_Carb_vDSMOffset_C "Offset fuer Umrechung SG->DSM fuer Geschwindigkeit (OBD)" VALUE 0xC0768 Kw_Ws16 65535.00 OneToOne -32768.00 32767.00 FORMAT "%8.2" /end CHARACTERISTIC
/begin CHARACTERISTIC Sig_Carb_vDSMScale_C "Skalierung Umrechungs Faktor SG->DSM fuer Geschwindigkeit (OBD)" VALUE 0xC076A Kw_Wu16 7.999878 Fact 0.00 7.999878 FORMAT "%8.6" /end CHARACTERISTIC
/begin CHARACTERISTIC Sig_Carb_vCANOffset_C "Offset fuer Umrechung SG->CAN fuer Geschwindigkeit (OBD)" VALUE 0xC076C Kw_Ws16 65535.00 OneToOne -32768.00 32767.00 FORMAT "%8.2" /end CHARACTERISTIC
/begin CHARACTERISTIC Sig_Carb_vCANScale_C "Skalierung Umrechungs Faktor SG->CAN fuer Geschwindigkeit (OBD)" VALUE 0xC076E Kw_Wu16 7.999878 Fact 0.00 7.999878 FORMAT "%8.6" /end CHARACTERISTIC
/begin CHARACTERISTIC Sig_Carb_vDIAOffset_C "Offset fuer Umrechung SG->DIA fuer Geschwindigkeit (OBD)" VALUE 0xC0770 Kw_Ws16 65535.00 OneToOne -32768.00 32767.00 FORMAT "%8.2" /end CHARACTERISTIC
/begin CHARACTERISTIC Sig_Carb_vDIAScale_C "Skalierung Umrechungs Faktor SG->DIA fuer Geschwindigkeit (OBD)" VALUE 0xC0772 Kw_Wu16 7.999878 Fact 0.00 7.999878 FORMAT "%8.6" /end CHARACTERISTIC
/begin CHARACTERISTIC Sig_dcycDSMOffset_C "Offset Umrechung SG->DSM für Tastverhältnisse" VALUE 0xC0774 Kw_Ws16 65535.00 OneToOne -32768.00 32767.00 FORMAT "%8.2" /end CHARACTERISTIC
/begin CHARACTERISTIC Sig_dcycDSMScale_C "Skalierung Umrechung SG->DSM für Tastverhältnisse" VALUE 0xC0776 Kw_Wu16 7.999878 Fact 0.00 7.999878 FORMAT "%8.6" /end CHARACTERISTIC
/begin CHARACTERISTIC Sig_dcycCANOffset_C "Offset Umrechung SG->CAN für Tastverhältnisse" VALUE 0xC0778 Kw_Ws16 65535.00 OneToOne -32768.00 32767.00 FORMAT "%8.2" /end CHARACTERISTIC
/begin CHARACTERISTIC Sig_dcycCANScale_C "Skalierung Umrechung SG->CAN für Tastverhältnisse" VALUE 0xC077A Kw_Wu16 7.999878 Fact 0.00 7.999878 FORMAT "%8.6" /end CHARACTERISTIC
/begin CHARACTERISTIC Sig_dcycDIAOffset_C "Offset Umrechung SG->Diagnoseschnittstelle für Tastverhältnisse" VALUE 0xC077C Kw_Ws16 65535.00 OneToOne -32768.00 32767.00 FORMAT "%8.2" /end CHARACTERISTIC
/begin CHARACTERISTIC Sig_dcycDIAScale_C "Skalierung Umrechung SG->Diagnoseschnittstelle für Tastverhältnisse" VALUE 0xC077E Kw_Wu16 7.999878 Fact 0.00 7.999878 FORMAT "%8.6" /end CHARACTERISTIC
/begin CHARACTERISTIC Sig_Deffuwb100DSMOffset_C "offset for conversion ecu -> dsm for k3-Conversion: Def_f_uw_b100" VALUE 0xC0780 Kw_Ws16 65535.00 OneToOne -32768.00 32767.00 FORMAT "%8.2" /end CHARACTERISTIC
/begin CHARACTERISTIC Sig_Deffuwb100DSMScale_C "scale factor for conversion ecu -> dsm for k3-Conversion: Def_f_uw_b100" VALUE 0xC0782 Kw_Wu16 7.999878 Fact 0.00 7.999878 FORMAT "%8.6" /end CHARACTERISTIC
/begin CHARACTERISTIC Sig_Deffuwb100CANOffset_C "offset for conversion ecu -> can for k3-Conversion: Def_f_uw_b100" VALUE 0xC0784 Kw_Ws16 65535.00 OneToOne -32768.00 32767.00 FORMAT "%8.2" /end CHARACTERISTIC
/begin CHARACTERISTIC Sig_Deffuwb100CANScale_C "scale factor for conversion ecu -> can for k3-Conversion: Def_f_uw_b100" VALUE 0xC0786 Kw_Wu16 7.999878 Fact 0.00 7.999878 FORMAT "%8.6" /end CHARACTERISTIC
/begin CHARACTERISTIC Sig_Deffuwb100DIAOffset_C "offset for conversion ecu -> dia for k3-Conversion: Def_f_uw_b100" VALUE 0xC0788 Kw_Ws16 65535.00 OneToOne -32768.00 32767.00 FORMAT "%8.2" /end CHARACTERISTIC
/begin CHARACTERISTIC Sig_Deffuwb100DIAScale_C "scale factor for conversion ecu -> dia for k3-Conversion: Def_f_uw_b100" VALUE 0xC078A Kw_Wu16 7.999878 Fact 0.00 7.999878 FORMAT "%8.6" /end CHARACTERISTIC
/begin CHARACTERISTIC Sig_DezUbQ1DSMOffset_C "offset for conversion ecu -> dsm for k3-Conversion: Def_dez_ub_q1" VALUE 0xC078C Kw_Ws16 65535.00 OneToOne -32768.00 32767.00 FORMAT "%8.2" /end CHARACTERISTIC
/begin CHARACTERISTIC Sig_DezUbQ1DSMScale_C "scale factor for conversion ecu -> dsm for k3-Conversion: Def_dez_ub_q1" VALUE 0xC078E Kw_Wu16 7.999878 Fact 0.00 7.999878 FORMAT "%8.6" /end CHARACTERISTIC
/begin CHARACTERISTIC Sig_DezUbQ1CANOffset_C "offset for conversion ecu -> can for k3-Conversion: Def_dez_ub_q1" VALUE 0xC0790 Kw_Ws16 65535.00 OneToOne -32768.00 32767.00 FORMAT "%8.2" /end CHARACTERISTIC
/begin CHARACTERISTIC Sig_DezUbQ1CANScale_C "scale factor for conversion ecu -> can for k3-Conversion: Def_dez_ub_q1" VALUE 0xC0792 Kw_Wu16 7.999878 Fact 0.00 7.999878 FORMAT "%8.6" /end CHARACTERISTIC
/begin CHARACTERISTIC Sig_DezUbQ1DIAOffset_C "offset for conversion ecu -> dia for k3-Conversion: Def_dez_ub_q1" VALUE 0xC0794 Kw_Ws16 65535.00 OneToOne -32768.00 32767.00 FORMAT "%8.2" /end CHARACTERISTIC
/begin CHARACTERISTIC Sig_DezUbQ1DIAScale_C "scale factor for conversion ecu -> dia for k3-Conversion: Def_dez_ub_q1" VALUE 0xC0796 Kw_Wu16 7.999878 Fact 0.00 7.999878 FORMAT "%8.6" /end CHARACTERISTIC
/begin CHARACTERISTIC Sig_DezUwQ1ozDSMOffset_C "Offset für Konvertierung ECU -> DSM" VALUE 0xC0798 Kw_Ws16 65535.00 OneToOne -32768.00 32767.00 FORMAT "%8.2" /end CHARACTERISTIC
/begin CHARACTERISTIC Sig_DezUwQ1ozDSMScale_C "Umrechnungsfaktor für Konvertierung ECU -> DSM" VALUE 0xC079A Kw_Wu16 7.999878 Fact 0.00 7.999878 FORMAT "%8.6" /end CHARACTERISTIC
/begin CHARACTERISTIC Sig_DezUwQ1ozCANOffset_C "Offset für konvertierung ECU --> CAN" VALUE 0xC079C Kw_Ws16 65535.00 OneToOne -32768.00 32767.00 FORMAT "%8.2" /end CHARACTERISTIC
/begin CHARACTERISTIC Sig_DezUwQ1ozCANScale_C "Umrechnungsfaktor für konvertierung ECU -> CAN" VALUE 0xC079E Kw_Wu16 7.999878 Fact 0.00 7.999878 FORMAT "%8.6" /end CHARACTERISTIC
/begin CHARACTERISTIC Sig_DezUwQ1ozDIAOffset_C "Offset für konvertierung ECU -> Dia" VALUE 0xC07A0 Kw_Ws16 65535.00 OneToOne -32768.00 32767.00 FORMAT "%8.2" /end CHARACTERISTIC
/begin CHARACTERISTIC Sig_DezUwQ1ozDIAScale_C "Umrechnungsfaktor für Konvertierung ECU -> Dia" VALUE 0xC07A2 Kw_Wu16 7.999878 Fact 0.00 7.999878 FORMAT "%8.6" /end CHARACTERISTIC
/begin CHARACTERISTIC Sig_DezUwQ1DSMOffset_C "offset for conversion ecu -> dsm for k3-Conversion: Def_dez_uw_q1" VALUE 0xC07A4 Kw_Ws16 65535.00 OneToOne -32768.00 32767.00 FORMAT "%8.2" /end CHARACTERISTIC
/begin CHARACTERISTIC Sig_DezUwQ1DSMScale_C "scale factor for conversion ecu -> dsm for k3-Conversion: Def_dez_uw_q1" VALUE 0xC07A6 Kw_Wu16 7.999878 Fact 0.00 7.999878 FORMAT "%8.6" /end CHARACTERISTIC
/begin CHARACTERISTIC Sig_DezUwQ1CANOffset_C "offset for conversion ecu -> can for k3-Conversion: Def_dez_uw_q1" VALUE 0xC07A8 Kw_Ws16 65535.00 OneToOne -32768.00 32767.00 FORMAT "%8.2" /end CHARACTERISTIC
/begin CHARACTERISTIC Sig_DezUwQ1CANScale_C "scale factor for conversion ecu -> can for k3-Conversion: Def_dez_uw_q1" VALUE 0xC07AA Kw_Wu16 7.999878 Fact 0.00 7.999878 FORMAT "%8.6" /end CHARACTERISTIC
/begin CHARACTERISTIC Sig_DezUwQ1DIAOffset_C "offset for conversion ecu -> dia for k3-Conversion: Def_dez_uw_q1" VALUE 0xC07AC Kw_Ws16 65535.00 OneToOne -32768.00 32767.00 FORMAT "%8.2" /end CHARACTERISTIC
/begin CHARACTERISTIC Sig_DezUwQ1DIAScale_C "scale factor for conversion ecu -> dia for k3-Conversion: Def_dez_uw_q1" VALUE 0xC07AE Kw_Wu16 7.999878 Fact 0.00 7.999878 FORMAT "%8.6" /end CHARACTERISTIC
/begin CHARACTERISTIC Sig_dtDSMOffset_C "offset for conversion ecu -> dsm for temperature conversion: TempDiff_Cels" VALUE 0xC07B0 Kw_Ws16 65535.00 OneToOne -32768.00 32767.00 FORMAT "%8.2" /end CHARACTERISTIC
/begin CHARACTERISTIC Sig_dtDSMScale_C "scale factor for conversion ecu -> dsm for temperature conversion: TempDiff_Cels" VALUE 0xC07B2 Kw_Wu16 7.999878 Fact 0.00 7.999878 FORMAT "%8.6" /end CHARACTERISTIC
/begin CHARACTERISTIC Sig_dtCANOffset_C "offset for conversion ecu -> can for temperature conversion: TempDiff_Cels" VALUE 0xC07B4 Kw_Ws16 65535.00 OneToOne -32768.00 32767.00 FORMAT "%8.2" /end CHARACTERISTIC
/begin CHARACTERISTIC Sig_dtCANScale_C "scale factor for conversion ecu -> can for temperature conversion: TempDiff_Cels" VALUE 0xC07B6 Kw_Wu16 7.999878 Fact 0.00 7.999878 FORMAT "%8.6" /end CHARACTERISTIC
/begin CHARACTERISTIC Sig_dtDIAOffset_C "offset for conversion ecu -> dia for temperature conversion: TempDiff_Cels" VALUE 0xC07B8 Kw_Ws16 65535.00 OneToOne -32768.00 32767.00 FORMAT "%8.2" /end CHARACTERISTIC
/begin CHARACTERISTIC Sig_dtDIAScale_C "scale factor for conversion ecu -> dia for temperature conversion: TempDiff_Cels" VALUE 0xC07BA Kw_Wu16 7.999878 Fact 0.00 7.999878 FORMAT "%8.6" /end CHARACTERISTIC
/begin CHARACTERISTIC Sig_DxsDSMOffset_C "offset for conversion ecu -> dsm for conversion Dxs" VALUE 0xC07BC Kw_Ws16 65535.00 OneToOne -32768.00 32767.00 FORMAT "%8.2" /end CHARACTERISTIC
/begin CHARACTERISTIC Sig_DxsDSMScale_C "scale factor for conversion ecu -> dsm for conversion Dxs" VALUE 0xC07BE Kw_Wu16 7.999878 Fact 0.00 7.999878 FORMAT "%8.6" /end CHARACTERISTIC
/begin CHARACTERISTIC Sig_DxsCANOffset_C "offset for conversion ecu -> can for conversion Dxs" VALUE 0xC07C0 Kw_Ws16 65535.00 OneToOne -32768.00 32767.00 FORMAT "%8.2" /end CHARACTERISTIC
/begin CHARACTERISTIC Sig_DxsCANScale_C "scale factor for conversion ecu -> can for conversion Dxs" VALUE 0xC07C2 Kw_Wu16 7.999878 Fact 0.00 7.999878 FORMAT "%8.6" /end CHARACTERISTIC
/begin CHARACTERISTIC Sig_DxsDIAOffset_C "offset for conversion ecu -> dia for conversion Dxs" VALUE 0xC07C4 Kw_Ws16 65535.00 OneToOne -32768.00 32767.00 FORMAT "%8.2" /end CHARACTERISTIC
/begin CHARACTERISTIC Sig_DxsDIAScale_C "scale factor for conversion ecu -> dia for conversion Dxs" VALUE 0xC07C6 Kw_Wu16 7.999878 Fact 0.00 7.999878 FORMAT "%8.6" /end CHARACTERISTIC
/begin CHARACTERISTIC Sig_EnergyDSMOffset_C "offset for conversion ecu -> dsm for conversion Energy" VALUE 0xC07C8 Kw_Ws16 65535.00 OneToOne -32768.00 32767.00 FORMAT "%8.2" /end CHARACTERISTIC
/begin CHARACTERISTIC Sig_EnergyDSMScale_C "scale factor for conversion ecu -> can for conversion Energy" VALUE 0xC07CA Kw_Wu16 7.999878 Fact 0.00 7.999878 FORMAT "%8.6" /end CHARACTERISTIC
/begin CHARACTERISTIC Sig_EnergyCANOffset_C "offset for conversion ecu -> can for conversion Energy" VALUE 0xC07CC Kw_Ws16 65535.00 OneToOne -32768.00 32767.00 FORMAT "%8.2" /end CHARACTERISTIC
/begin CHARACTERISTIC Sig_EnergyCANScale_C "scale factor for conversion ecu -> can for conversion Energy" VALUE 0xC07CE Kw_Wu16 7.999878 Fact 0.00 7.999878 FORMAT "%8.6" /end CHARACTERISTIC
/begin CHARACTERISTIC Sig_EnergyDIAOffset_C "offset for conversion ecu -> dia for conversion Energy" VALUE 0xC07D0 Kw_Ws16 65535.00 OneToOne -32768.00 32767.00 FORMAT "%8.2" /end CHARACTERISTIC
/begin CHARACTERISTIC Sig_EnergyDIAScale_C "scale factor for conversion ecu -> dia for conversion Energy" VALUE 0xC07D2 Kw_Wu16 7.999878 Fact 0.00 7.999878 FORMAT "%8.6" /end CHARACTERISTIC
/begin CHARACTERISTIC Sig_factDSMOffset_C "Offset Umrechnungsfaktor SG -> DSM fuer Faktoren" VALUE 0xC07D4 Kw_Ws16 65535.00 OneToOne -32768.00 32767.00 FORMAT "%8.2" /end CHARACTERISTIC
/begin CHARACTERISTIC Sig_factDSMScale_C "Skalierung Umrechnungsfaktor SG -> DSM fuer Faktoren" VALUE 0xC07D6 Kw_Wu16 7.999878 Fact 0.00 7.999878 FORMAT "%8.6" /end CHARACTERISTIC
/begin CHARACTERISTIC Sig_factCANOffset_C "Offset fuer Umrechnung SG -> CAN für Faktoren" VALUE 0xC07D8 Kw_Ws16 65535.00 OneToOne -32768.00 32767.00 FORMAT "%8.2" /end CHARACTERISTIC
/begin CHARACTERISTIC Sig_factCANScale_C "Skalierung Umrechnungsfaktor SG -> CAN fuer Faktoren" VALUE 0xC07DA Kw_Wu16 7.999878 Fact 0.00 7.999878 FORMAT "%8.6" /end CHARACTERISTIC
/begin CHARACTERISTIC Sig_factDIAOffset_C "Offset Umrechnungsfaktor SG -> DIA für Faktoren" VALUE 0xC07DC Kw_Ws16 65535.00 OneToOne -32768.00 32767.00 FORMAT "%8.2" /end CHARACTERISTIC
/begin CHARACTERISTIC Sig_factDIAScale_C "Skalierung Umrechnungsfaktor SG -> DIA fuer Faktoren" VALUE 0xC07DE Kw_Wu16 7.999878 Fact 0.00 7.999878 FORMAT "%8.6" /end CHARACTERISTIC
/begin CHARACTERISTIC Sig_fas1DSMOffset_C "Offset fuer Umrechung SG->DSM fuer ein frei applizierbares Signal" VALUE 0xC07E0 Kw_Ws16 65535.00 OneToOne -32768.00 32767.00 FORMAT "%8.2" /end CHARACTERISTIC
/begin CHARACTERISTIC Sig_fas1DSMScale_C "Skalierung Umrechungs Faktor SG->DSM fuer ein frei applizierbares Signal" VALUE 0xC07E2 Kw_Wu16 7.999878 Fact 0.00 7.999878 FORMAT "%8.6" /end CHARACTERISTIC
/begin CHARACTERISTIC Sig_fas1CANOffset_C "Offset fuer Umrechung SG->CAN fuer ein frei applizierbares Signal" VALUE 0xC07E4 Kw_Ws16 65535.00 OneToOne -32768.00 32767.00 FORMAT "%8.2" /end CHARACTERISTIC
/begin CHARACTERISTIC Sig_fas1CANScale_C "Skalierung Umrechungs Faktor SG->CAN fuer ein frei applizierbares Signal" VALUE 0xC07E6 Kw_Wu16 7.999878 Fact 0.00 7.999878 FORMAT "%8.6" /end CHARACTERISTIC
/begin CHARACTERISTIC Sig_fas1DIAOffset_C "Offset fuer Umrechung SG->DIA fuer ein frei applizierbares Signal" VALUE 0xC07E8 Kw_Ws16 65535.00 OneToOne -32768.00 32767.00 FORMAT "%8.2" /end CHARACTERISTIC
/begin CHARACTERISTIC Sig_fas1DIAScale_C "Skalierung Umrechungs Faktor SG->DIA fuer ein frei applizierbares Signal" VALUE 0xC07EA Kw_Wu16 7.999878 Fact 0.00 7.999878 FORMAT "%8.6" /end CHARACTERISTIC
/begin CHARACTERISTIC Sig_fas2DSMOffset_C "Offset fuer Umrechung SG->DSM fuer ein frei applizierbares Signal" VALUE 0xC07EC Kw_Ws16 65535.00 OneToOne -32768.00 32767.00 FORMAT "%8.2" /end CHARACTERISTIC
/begin CHARACTERISTIC Sig_fas2DSMScale_C "Skalierung Umrechungs Faktor SG->DSM fuer ein frei applizierbares Signal" VALUE 0xC07EE Kw_Wu16 7.999878 Fact 0.00 7.999878 FORMAT "%8.6" /end CHARACTERISTIC
/begin CHARACTERISTIC Sig_fas2CANOffset_C "Offset fuer Umrechung SG->CAN fuer ein frei applizierbares Signal" VALUE 0xC07F0 Kw_Ws16 65535.00 OneToOne -32768.00 32767.00 FORMAT "%8.2" /end CHARACTERISTIC
/begin CHARACTERISTIC Sig_fas2CANScale_C "Skalierung Umrechungs Faktor SG->CAN fuer ein frei applizierbares Signal" VALUE 0xC07F2 Kw_Wu16 7.999878 Fact 0.00 7.999878 FORMAT "%8.6" /end CHARACTERISTIC
/begin CHARACTERISTIC Sig_fas2DIAOffset_C "Offset fuer Umrechung SG->DIA fuer ein frei applizierbares Signal" VALUE 0xC07F4 Kw_Ws16 65535.00 OneToOne -32768.00 32767.00 FORMAT "%8.2" /end CHARACTERISTIC
/begin CHARACTERISTIC Sig_fas2DIAScale_C "Skalierung Umrechungs Faktor SG->DIA fuer ein frei applizierbares Signal" VALUE 0xC07F6 Kw_Wu16 7.999878 Fact 0.00 7.999878 FORMAT "%8.6" /end CHARACTERISTIC
/begin CHARACTERISTIC Sig_fas3DSMOffset_C "Offset fuer Umrechung SG->DSM fuer ein frei applizierbares Signal" VALUE 0xC07F8 Kw_Ws16 65535.00 OneToOne -32768.00 32767.00 FORMAT "%8.2" /end CHARACTERISTIC
/begin CHARACTERISTIC Sig_fas3DSMScale_C "Skalierung Umrechungs Faktor SG->DSM fuer ein frei applizierbares Signal" VALUE 0xC07FA Kw_Wu16 7.999878 Fact 0.00 7.999878 FORMAT "%8.6" /end CHARACTERISTIC
/begin CHARACTERISTIC Sig_fas3CANOffset_C "Offset fuer Umrechung SG->CAN fuer ein frei applizierbares Signal" VALUE 0xC07FC Kw_Ws16 65535.00 OneToOne -32768.00 32767.00 FORMAT "%8.2" /end CHARACTERISTIC
/begin CHARACTERISTIC Sig_fas3CANScale_C "Skalierung Umrechungs Faktor SG->CAN fuer ein frei applizierbares Signal" VALUE 0xC07FE Kw_Wu16 7.999878 Fact 0.00 7.999878 FORMAT "%8.6" /end CHARACTERISTIC
/begin CHARACTERISTIC Sig_fas3DIAOffset_C "Offset fuer Umrechung SG->DIA fuer ein frei applizierbares Signal" VALUE 0xC0800 Kw_Ws16 65535.00 OneToOne -32768.00 32767.00 FORMAT "%8.2" /end CHARACTERISTIC
/begin CHARACTERISTIC Sig_fas3DIAScale_C "Skalierung Umrechungs Faktor SG->DIA fuer ein frei applizierbares Signal" VALUE 0xC0802 Kw_Wu16 7.999878 Fact 0.00 7.999878 FORMAT "%8.6" /end CHARACTERISTIC
/begin CHARACTERISTIC Sig_FlConPFltDSMOffset_C "Offset für Umrechnung SG->DSM für Kraftstoffverbrauch (Partikelfilter)" VALUE 0xC0804 Kw_Ws16 65535.00 OneToOne -32768.00 32767.00 FORMAT "%8.2" /end CHARACTERISTIC
/begin CHARACTERISTIC Sig_FlConPFltDSMScale_C "Skalierung Umrechung SG->DSM für Kraftstoffverbrauch (Partikelfilter)" VALUE 0xC0806 Kw_Wu16 7.999878 Fact 0.00 7.999878 FORMAT "%8.6" /end CHARACTERISTIC
/begin CHARACTERISTIC Sig_FlConPFltCANOffset_C "Offset für Umrechnung SG->CAN für Kraftstoffverbrauch (Partikelfilter)" VALUE 0xC0808 Kw_Ws16 65535.00 OneToOne -32768.00 32767.00 FORMAT "%8.2" /end CHARACTERISTIC
/begin CHARACTERISTIC Sig_FlConPFltCANScale_C "Skalierung Umrechung SG->CAN für Kraftstoffverbrauch (Partikelfilter)" VALUE 0xC080A Kw_Wu16 7.999878 Fact 0.00 7.999878 FORMAT "%8.6" /end CHARACTERISTIC
/begin CHARACTERISTIC Sig_FlConPFltDIAOffset_C "Offset für Umrechnung SG->Diagnoseschnittstelle für Kraftstoffverbrauch (Partikelfilter)" VALUE 0xC080C Kw_Ws16 65535.00 OneToOne -32768.00 32767.00 FORMAT "%8.2" /end CHARACTERISTIC
/begin CHARACTERISTIC Sig_FlConPFltDIAScale_C "Skalierung Umrechung SG->Diagnoseschnittstelle für Kraftstoffverbrauch (Partikelfilter)" VALUE 0xC080E Kw_Wu16 7.999878 Fact 0.00 7.999878 FORMAT "%8.6" /end CHARACTERISTIC
/begin CHARACTERISTIC Sig_FlConDSMOffset_C "Offset für Umrechnung ecu -> dsm" VALUE 0xC0810 Kw_Ws16 65535.00 OneToOne -32768.00 32767.00 FORMAT "%8.2" /end CHARACTERISTIC
/begin CHARACTERISTIC Sig_FlConDSMScale_C "Skalierung für Umrechnung ecu -> dsm" VALUE 0xC0812 Kw_Wu16 7.999878 Fact 0.00 7.999878 FORMAT "%8.6" /end CHARACTERISTIC
/begin CHARACTERISTIC Sig_FlConCANOffset_C "Offset für Umrechnung ecu -> can" VALUE 0xC0814 Kw_Ws16 65535.00 OneToOne -32768.00 32767.00 FORMAT "%8.2" /end CHARACTERISTIC
/begin CHARACTERISTIC Sig_FlConCANScale_C "Skalierung für Umrechnung ecu -> can" VALUE 0xC0816 Kw_Wu16 7.999878 Fact 0.00 7.999878 FORMAT "%8.6" /end CHARACTERISTIC
/begin CHARACTERISTIC Sig_FlConDIAOffset_C "Offset für Umrechnung ecu -> dia" VALUE 0xC0818 Kw_Ws16 65535.00 OneToOne -32768.00 32767.00 FORMAT "%8.2" /end CHARACTERISTIC
/begin CHARACTERISTIC Sig_FlConDIAScale_C "Skalierung für Umrechnung ecu -> dia" VALUE 0xC081A Kw_Wu16 7.999878 Fact 0.00 7.999878 FORMAT "%8.6" /end CHARACTERISTIC
/begin CHARACTERISTIC Sig_FlUlQ0p122DSMOffset_C "offset for conversion ecu -> dsm for k3-Conversion: Def_fuel_ul_q0p000122" VALUE 0xC081C Kw_Ws16 65535.00 OneToOne -32768.00 32767.00 FORMAT "%8.2" /end CHARACTERISTIC
/begin CHARACTERISTIC Sig_FlUlQ0p122DSMScale_C "scale factor for conversion ecu -> dsm for k3-Conversion: Def_fuel_ul_q0p000122" VALUE 0xC081E Kw_Wu16 7.999878 Fact 0.00 7.999878 FORMAT "%8.6" /end CHARACTERISTIC
/begin CHARACTERISTIC Sig_FlUlQ0p122CANOffset_C "offset for conversion ecu -> can for k3-Conversion: Def_fuel_ul_q0p000122" VALUE 0xC0820 Kw_Ws16 65535.00 OneToOne -32768.00 32767.00 FORMAT "%8.2" /end CHARACTERISTIC
/begin CHARACTERISTIC Sig_FlUlQ0p122CANScale_C "scale factor for conversion ecu -> can for k3-Conversion: Def_fuel_ul_q0p000122" VALUE 0xC0822 Kw_Wu16 7.999878 Fact 0.00 7.999878 FORMAT "%8.6" /end CHARACTERISTIC
/begin CHARACTERISTIC Sig_FlUlQ0p122DIAOffset_C "offset for conversion ecu -> dia for k3-Conversion: Def_fuel_ul_q0p000122" VALUE 0xC0824 Kw_Ws16 65535.00 OneToOne -32768.00 32767.00 FORMAT "%8.2" /end CHARACTERISTIC
/begin CHARACTERISTIC Sig_FlUlQ0p122DIAScale_C "scale factor for conversion ecu -> dia for k3-Conversion: Def_fuel_ul_q0p000122" VALUE 0xC0826 Kw_Wu16 7.999878 Fact 0.00 7.999878 FORMAT "%8.6" /end CHARACTERISTIC
/begin CHARACTERISTIC Sig_FSwB100DSMOffset_C "offset for conversion ecu -> dsm for k3-Conversion: Def_f_sw_b100" VALUE 0xC0828 Kw_Ws16 65535.00 OneToOne -32768.00 32767.00 FORMAT "%8.2" /end CHARACTERISTIC
/begin CHARACTERISTIC Sig_FSwB100DSMScale_C "scale factor for conversion ecu -> dsm for k3-Conversion: Def_f_sw_b100" VALUE 0xC082A Kw_Wu16 7.999878 Fact 0.00 7.999878 FORMAT "%8.6" /end CHARACTERISTIC
/begin CHARACTERISTIC Sig_FSwB100CANOffset_C "offset for conversion ecu -> can for k3-Conversion: Def_f_sw_b100" VALUE 0xC082C Kw_Ws16 65535.00 OneToOne -32768.00 32767.00 FORMAT "%8.2" /end CHARACTERISTIC
/begin CHARACTERISTIC Sig_FSwB100CANScale_C "scale factor for conversion ecu -> can for k3-Conversion: Def_f_sw_b100" VALUE 0xC082E Kw_Wu16 7.999878 Fact 0.00 7.999878 FORMAT "%8.6" /end CHARACTERISTIC
/begin CHARACTERISTIC Sig_FSwB100DIAOffset_C "offset for conversion ecu -> dia for k3-Conversion: Def_f_sw_b100" VALUE 0xC0830 Kw_Ws16 65535.00 OneToOne -32768.00 32767.00 FORMAT "%8.2" /end CHARACTERISTIC
/begin CHARACTERISTIC Sig_FSwB100DIAScale_C "scale factor for conversion ecu -> dia for k3-Conversion: Def_f_sw_b100" VALUE 0xC0832 Kw_Wu16 7.999878 Fact 0.00 7.999878 FORMAT "%8.6" /end CHARACTERISTIC
/begin CHARACTERISTIC Sig_FSwQ0p00153DSMOffset_C "offset for conversion ecu -> dsm for k3-Conversion: Def_f_sw_q0p00153" VALUE 0xC0834 Kw_Ws16 65535.00 OneToOne -32768.00 32767.00 FORMAT "%8.2" /end CHARACTERISTIC
/begin CHARACTERISTIC Sig_FSwQ0p00153DSMScale_C "scale factor for conversion ecu -> dsm for k3-Conversion: Def_f_sw_q0p00153" VALUE 0xC0836 Kw_Wu16 7.999878 Fact 0.00 7.999878 FORMAT "%8.6" /end CHARACTERISTIC
/begin CHARACTERISTIC Sig_FSwQ0p00153CANOffset_C "offset for conversion ecu -> can for k3-Conversion: Def_f_sw_q0p00153" VALUE 0xC0838 Kw_Ws16 65535.00 OneToOne -32768.00 32767.00 FORMAT "%8.2" /end CHARACTERISTIC
/begin CHARACTERISTIC Sig_FSwQ0p00153CANScale_C "scale factor for conversion ecu -> can for k3-Conversion: Def_f_sw_q0p00153" VALUE 0xC083A Kw_Wu16 7.999878 Fact 0.00 7.999878 FORMAT "%8.6" /end CHARACTERISTIC
/begin CHARACTERISTIC Sig_FSwQ0p00153DIAOffset_C "offset for conversion ecu -> dia for k3-Conversion: Def_f_sw_q0p00153" VALUE 0xC083C Kw_Ws16 65535.00 OneToOne -32768.00 32767.00 FORMAT "%8.2" /end CHARACTERISTIC
/begin CHARACTERISTIC Sig_FSwQ0p00153DIAScale_C "scale factor for conversion ecu -> dia for k3-Conversion: Def_f_sw_q0p00153" VALUE 0xC083E Kw_Wu16 7.999878 Fact 0.00 7.999878 FORMAT "%8.6" /end CHARACTERISTIC
/begin CHARACTERISTIC Sig_InjMassDSMOffset_C "offset for conversion ecu -> dsm" VALUE 0xC0840 Kw_Ws16 65535.00 OneToOne -32768.00 32767.00 FORMAT "%8.2" /end CHARACTERISTIC
/begin CHARACTERISTIC Sig_InjMassDSMScale_C "Scale for conversion ecu -> dsm" VALUE 0xC0842 Kw_Wu16 7.999878 Fact 0.00 7.999878 FORMAT "%8.6" /end CHARACTERISTIC
/begin CHARACTERISTIC Sig_InjMassCANOffset_C "offset for conversion ecu -> can" VALUE 0xC0844 Kw_Ws16 65535.00 OneToOne -32768.00 32767.00 FORMAT "%8.2" /end CHARACTERISTIC
/begin CHARACTERISTIC Sig_InjMassCANScale_C "Scale for conversion ecu -> can" VALUE 0xC0846 Kw_Wu16 7.999878 Fact 0.00 7.999878 FORMAT "%8.6" /end CHARACTERISTIC
/begin CHARACTERISTIC Sig_InjMassDIAOffset_C "offset for conversion ecu -> dia" VALUE 0xC0848 Kw_Ws16 65535.00 OneToOne -32768.00 32767.00 FORMAT "%8.2" /end CHARACTERISTIC
/begin CHARACTERISTIC Sig_InjMassDIAScale_C "Scale for conversion ecu -> dia" VALUE 0xC084A Kw_Wu16 7.999878 Fact 0.00 7.999878 FORMAT "%8.6" /end CHARACTERISTIC
/begin CHARACTERISTIC Sig_InjTimDSMOffset_C "Offset für Umrechnung -> dsm" VALUE 0xC084C Kw_Ws16 65535.00 OneToOne -32768.00 32767.00 FORMAT "%8.2" /end CHARACTERISTIC
/begin CHARACTERISTIC Sig_InjTimDSMScale_C "Skalierung für Umrechnung ecu -> dsm" VALUE 0xC084E Kw_Wu16 7.999878 Fact 0.00 7.999878 FORMAT "%8.6" /end CHARACTERISTIC
/begin CHARACTERISTIC Sig_InjTimCANOffset_C "Offset für Umrechnung ecu -> can" VALUE 0xC0850 Kw_Ws16 65535.00 OneToOne -32768.00 32767.00 FORMAT "%8.2" /end CHARACTERISTIC
/begin CHARACTERISTIC Sig_InjTimCANScale_C "Skalierung für Umrechnung ecu -> can" VALUE 0xC0852 Kw_Wu16 7.999878 Fact 0.00 7.999878 FORMAT "%8.6" /end CHARACTERISTIC
/begin CHARACTERISTIC Sig_InjTimDIAOffset_C "Offset für Umrechnung ecu -> dia" VALUE 0xC0854 Kw_Ws16 65535.00 OneToOne -32768.00 32767.00 FORMAT "%8.2" /end CHARACTERISTIC
/begin CHARACTERISTIC Sig_InjTimDIAScale_C "Skalierung für Umrechnung ecu -> dia" VALUE 0xC0856 Kw_Wu16 7.999878 Fact 0.00 7.999878 FORMAT "%8.6" /end CHARACTERISTIC
/begin CHARACTERISTIC Sig_IUbQ1DSMOffset_C "offset for conversion ecu -> dsm for k3-Conversion: Def_i_ub_q1" VALUE 0xC0858 Kw_Ws16 65535.00 OneToOne -32768.00 32767.00 FORMAT "%8.2" /end CHARACTERISTIC
/begin CHARACTERISTIC Sig_IUbQ1DSMScale_C "scale factor for conversion ecu -> dsm for k3-Conversion: Def_i_ub_q1" VALUE 0xC085A Kw_Wu16 7.999878 Fact 0.00 7.999878 FORMAT "%8.6" /end CHARACTERISTIC
/begin CHARACTERISTIC Sig_IUbQ1CANOffset_C "offset for conversion ecu -> can for k3-Conversion: Def_i_ub_q1" VALUE 0xC085C Kw_Ws16 65535.00 OneToOne -32768.00 32767.00 FORMAT "%8.2" /end CHARACTERISTIC
/begin CHARACTERISTIC Sig_IUbQ1CANScale_C "scale factor for conversion ecu -> can for k3-Conversion: Def_i_ub_q1" VALUE 0xC085E Kw_Wu16 7.999878 Fact 0.00 7.999878 FORMAT "%8.6" /end CHARACTERISTIC
/begin CHARACTERISTIC Sig_IUbQ1DIAOffset_C "offset for conversion ecu -> dia for k3-Conversion: Def_i_ub_q1" VALUE 0xC0860 Kw_Ws16 65535.00 OneToOne -32768.00 32767.00 FORMAT "%8.2" /end CHARACTERISTIC
/begin CHARACTERISTIC Sig_IUbQ1DIAScale_C "scale factor for conversion ecu -> dia for k3-Conversion: Def_i_ub_q1" VALUE 0xC0862 Kw_Wu16 7.999878 Fact 0.00 7.999878 FORMAT "%8.6" /end CHARACTERISTIC
/begin CHARACTERISTIC Sig_IUwQ0p08O200DSMOffset_C "offset for conversion ecu -> dsm for k3-Conversion: Def_i_uw_q0p08_o200" VALUE 0xC0864 Kw_Ws16 65535.00 OneToOne -32768.00 32767.00 FORMAT "%8.2" /end CHARACTERISTIC
/begin CHARACTERISTIC Sig_IUwQ0p08O200DSMScale_C "scale factor for conversion ecu -> dsm for k3-Conversion: Def_i_uw_q0p08_o200" VALUE 0xC0866 Kw_Wu16 7.999878 Fact 0.00 7.999878 FORMAT "%8.6" /end CHARACTERISTIC
/begin CHARACTERISTIC Sig_IUwQ0p08O200CANOffset_C "offset for conversion ecu -> can for k3-Conversion: Def_i_uw_q0p08_o200" VALUE 0xC0868 Kw_Ws16 65535.00 OneToOne -32768.00 32767.00 FORMAT "%8.2" /end CHARACTERISTIC
/begin CHARACTERISTIC Sig_IUwQ0p08O200CANScale_C "scale factor for conversion ecu -> can for k3-Conversion: Def_i_uw_q0p08_o200" VALUE 0xC086A Kw_Wu16 7.999878 Fact 0.00 7.999878 FORMAT "%8.6" /end CHARACTERISTIC
/begin CHARACTERISTIC Sig_IUwQ0p08O200DIAOffset_C "offset for conversion ecu -> dia for k3-Conversion: Def_i_uw_q0p08_o200" VALUE 0xC086C Kw_Ws16 65535.00 OneToOne -32768.00 32767.00 FORMAT "%8.2" /end CHARACTERISTIC
/begin CHARACTERISTIC Sig_IUwQ0p08O200DIAScale_C "scale factor for conversion ecu -> dia for k3-Conversion: Def_i_uw_q0p08_o200" VALUE 0xC086E Kw_Wu16 7.999878 Fact 0.00 7.999878 FORMAT "%8.6" /end CHARACTERISTIC
/begin CHARACTERISTIC Sig_KmSwQ10DSMOffset_C "offset for conversion ecu -> dsm for k3-Conversion: Def_km_sw_q10" VALUE 0xC0870 Kw_Ws16 65535.00 OneToOne -32768.00 32767.00 FORMAT "%8.2" /end CHARACTERISTIC
/begin CHARACTERISTIC Sig_KmSwQ10DSMScale_C "scale factor for conversion ecu -> dsm for k3-Conversion: Def_km_sw_q10" VALUE 0xC0872 Kw_Wu16 7.999878 Fact 0.00 7.999878 FORMAT "%8.6" /end CHARACTERISTIC
/begin CHARACTERISTIC Sig_KmSwQ10CANOffset_C "offset for conversion ecu -> can for k3-Conversion: Def_km_sw_q10" VALUE 0xC0874 Kw_Ws16 65535.00 OneToOne -32768.00 32767.00 FORMAT "%8.2" /end CHARACTERISTIC
/begin CHARACTERISTIC Sig_KmSwQ10CANScale_C "scale factor for conversion ecu -> can for k3-Conversion: Def_km_sw_q10" VALUE 0xC0876 Kw_Wu16 7.999878 Fact 0.00 7.999878 FORMAT "%8.6" /end CHARACTERISTIC
/begin CHARACTERISTIC Sig_KmSwQ10DIAOffset_C "offset for conversion ecu -> dia for k3-Conversion: Def_km_sw_q10" VALUE 0xC0878 Kw_Ws16 65535.00 OneToOne -32768.00 32767.00 FORMAT "%8.2" /end CHARACTERISTIC
/begin CHARACTERISTIC Sig_KmSwQ10DIAScale_C "scale factor for conversion ecu -> dia for k3-Conversion: Def_km_sw_q10" VALUE 0xC087A Kw_Wu16 7.999878 Fact 0.00 7.999878 FORMAT "%8.6" /end CHARACTERISTIC
/begin CHARACTERISTIC Sig_KmUwQ10DSMOffset_C "offset for conversion ecu -> dsm for k3-Conversion: Def_km_uw_q10" VALUE 0xC087C Kw_Ws16 65535.00 OneToOne -32768.00 32767.00 FORMAT "%8.2" /end CHARACTERISTIC
/begin CHARACTERISTIC Sig_KmUwQ10DSMScale_C "scale factor for conversion ecu -> dsm for k3-Conversion: Def_km_uw_q10" VALUE 0xC087E Kw_Wu16 7.999878 Fact 0.00 7.999878 FORMAT "%8.6" /end CHARACTERISTIC
/begin CHARACTERISTIC Sig_KmUwQ10CANOffset_C "offset for conversion ecu -> can for k3-Conversion: Def_km_uw_q10" VALUE 0xC0880 Kw_Ws16 65535.00 OneToOne -32768.00 32767.00 FORMAT "%8.2" /end CHARACTERISTIC
/begin CHARACTERISTIC Sig_KmUwQ10CANScale_C "scale factor for conversion ecu -> can for k3-Conversion: Def_km_uw_q10" VALUE 0xC0882 Kw_Wu16 7.999878 Fact 0.00 7.999878 FORMAT "%8.6" /end CHARACTERISTIC
/begin CHARACTERISTIC Sig_KmUwQ10DIAOffset_C "offset for conversion ecu -> dia for k3-Conversion: Def_km_uw_q10" VALUE 0xC0884 Kw_Ws16 65535.00 OneToOne -32768.00 32767.00 FORMAT "%8.2" /end CHARACTERISTIC
/begin CHARACTERISTIC Sig_KmUwQ10DIAScale_C "scale factor for conversion ecu -> dia for k3-Conversion: Def_km_uw_q10" VALUE 0xC0886 Kw_Wu16 7.999878 Fact 0.00 7.999878 FORMAT "%8.6" /end CHARACTERISTIC
/begin CHARACTERISTIC Sig_LambdaDSMOffset_C "Offset Umrechnung SG -> DSM für Lambda Wert" VALUE 0xC0888 Kw_Ws16 65535.00 OneToOne -32768.00 32767.00 FORMAT "%8.2" /end CHARACTERISTIC
/begin CHARACTERISTIC Sig_LambdaDSMScale_C "Skalierung Umrechnung SG -> DSM für Lambda Wert" VALUE 0xC088A Kw_Wu16 7.999878 Fact 0.00 7.999878 FORMAT "%8.6" /end CHARACTERISTIC
/begin CHARACTERISTIC Sig_LambdaCANOffset_C "Offset Umrechnung SG -> CAN für Lambda Wert" VALUE 0xC088C Kw_Ws16 65535.00 OneToOne -32768.00 32767.00 FORMAT "%8.2" /end CHARACTERISTIC
/begin CHARACTERISTIC Sig_LambdaCANScale_C "Skalierung Umrechnung SG -> CAN für Lambda Wert" VALUE 0xC088E Kw_Wu16 7.999878 Fact 0.00 7.999878 FORMAT "%8.6" /end CHARACTERISTIC
/begin CHARACTERISTIC Sig_LambdaDIAOffset_C "Offset Umrechnung SG -> DIA für Lambda Wert" VALUE 0xC0890 Kw_Ws16 65535.00 OneToOne -32768.00 32767.00 FORMAT "%8.2" /end CHARACTERISTIC
/begin CHARACTERISTIC Sig_LambdaDIAScale_C "Skalierung Umrechnung SG -> DIA für Lambda Wert" VALUE 0xC0892 Kw_Wu16 7.999878 Fact 0.00 7.999878 FORMAT "%8.6" /end CHARACTERISTIC
/begin CHARACTERISTIC Sig_lenPFltDSMOffset_C "Offset für Umrechnung SG->DSM für km-Stand (Partikelfilter)" VALUE 0xC0894 Kw_Ws16 65535.00 OneToOne -32768.00 32767.00 FORMAT "%8.2" /end CHARACTERISTIC
/begin CHARACTERISTIC Sig_lenPFltDSMScale_C "Skalierung Umrechung SG->DSM für km-Stand (Partikelfilter)" VALUE 0xC0896 Kw_Wu16 7.999878 Fact 0.00 7.999878 FORMAT "%8.6" /end CHARACTERISTIC
/begin CHARACTERISTIC Sig_lenPFltCANOffset_C "Offset für Umrechnung SG->CAN für km-Stand (Partikelfilter)" VALUE 0xC0898 Kw_Ws16 65535.00 OneToOne -32768.00 32767.00 FORMAT "%8.2" /end CHARACTERISTIC
/begin CHARACTERISTIC Sig_lenPFltCANScale_C "Skalierung Umrechung SG->CAN für km-Stand (Partikelfilter)" VALUE 0xC089A Kw_Wu16 7.999878 Fact 0.00 7.999878 FORMAT "%8.6" /end CHARACTERISTIC
/begin CHARACTERISTIC Sig_lenPFltDIAOffset_C "Offset für Umrechnung SG->Diagnoseschnittstelle für km-Stand (Partikelfilter)" VALUE 0xC089C Kw_Ws16 65535.00 OneToOne -32768.00 32767.00 FORMAT "%8.2" /end CHARACTERISTIC
/begin CHARACTERISTIC Sig_lenPFltDIAScale_C "Skalierung Umrechung SG->Diagnoseschnittstelle für km-Stand (Partikelfilter)" VALUE 0xC089E Kw_Wu16 7.999878 Fact 0.00 7.999878 FORMAT "%8.6" /end CHARACTERISTIC
/begin CHARACTERISTIC Sig_lenrgnu16PFltDSMOffset_C "Offset Umrechnumg SG->DSM" VALUE 0xC08A0 Kw_Ws16 65535.00 OneToOne -32768.00 32767.00 FORMAT "%8.2" /end CHARACTERISTIC
/begin CHARACTERISTIC Sig_lenrgnu16PFltDSMScale_C "Skalierung Umrechnung SG->DSM" VALUE 0xC08A2 Kw_Wu16 7.999878 Fact 0.00 7.999878 FORMAT "%8.6" /end CHARACTERISTIC
/begin CHARACTERISTIC Sig_lenrgnu16PFltCANOffset_C "Offset Umrechnumg SG->CAN" VALUE 0xC08A4 Kw_Ws16 65535.00 OneToOne -32768.00 32767.00 FORMAT "%8.2" /end CHARACTERISTIC
/begin CHARACTERISTIC Sig_lenrgnu16PFltCANScale_C "Skalierung Umrechnung SG->CAN" VALUE 0xC08A6 Kw_Wu16 7.999878 Fact 0.00 7.999878 FORMAT "%8.6" /end CHARACTERISTIC
/begin CHARACTERISTIC Sig_lenrgnu16PFltDIAOffset_C "Offset Umrechnumg SG->DIA" VALUE 0xC08A8 Kw_Ws16 65535.00 OneToOne -32768.00 32767.00 FORMAT "%8.2" /end CHARACTERISTIC
/begin CHARACTERISTIC Sig_lenrgnu16PFltDIAScale_C "Skalierung Umrechnung SG->DIA" VALUE 0xC08AA Kw_Wu16 7.999878 Fact 0.00 7.999878 FORMAT "%8.6" /end CHARACTERISTIC
/begin CHARACTERISTIC Sig_lenDSMOffset_C "Offset für Umrechnung ecu -> dsm" VALUE 0xC08AC Kw_Ws16 65535.00 OneToOne -32768.00 32767.00 FORMAT "%8.2" /end CHARACTERISTIC
/begin CHARACTERISTIC Sig_lenDSMScale_C "Skalierung für Umrechnung -> dsm" VALUE 0xC08AE Kw_Wu16 7.999878 Fact 0.00 7.999878 FORMAT "%8.6" /end CHARACTERISTIC
/begin CHARACTERISTIC Sig_lenCANOffset_C "Offset für Umrechnung ecu -> can" VALUE 0xC08B0 Kw_Ws16 65535.00 OneToOne -32768.00 32767.00 FORMAT "%8.2" /end CHARACTERISTIC
/begin CHARACTERISTIC Sig_lenCANScale_C "Skalierung für Umrechnung ecu -> can" VALUE 0xC08B2 Kw_Wu16 7.999878 Fact 0.00 7.999878 FORMAT "%8.6" /end CHARACTERISTIC
/begin CHARACTERISTIC Sig_lenDIAOffset_C "Offset für Umrechnung ecu -> dia" VALUE 0xC08B4 Kw_Ws16 65535.00 OneToOne -32768.00 32767.00 FORMAT "%8.2" /end CHARACTERISTIC
/begin CHARACTERISTIC Sig_lenDIAScale_C "Skalierung für Umrechnung ecu -> dia" VALUE 0xC08B6 Kw_Wu16 7.999878 Fact 0.00 7.999878 FORMAT "%8.6" /end CHARACTERISTIC
/begin CHARACTERISTIC Sig_lDSMOffset_C "Offset Umrechnung SG -> DSM" VALUE 0xC08B8 Kw_Ws16 65535.00 OneToOne -32768.00 32767.00 FORMAT "%8.2" /end CHARACTERISTIC
/begin CHARACTERISTIC Sig_lDSMScale_C "Skalierung Umrechnung SG -> DSM" VALUE 0xC08BA Kw_Wu16 7.999878 Fact 0.00 7.999878 FORMAT "%8.6" /end CHARACTERISTIC
/begin CHARACTERISTIC Sig_lCANOffset_C "Offset Umrechnung SG -> CAN" VALUE 0xC08BC Kw_Ws16 65535.00 OneToOne -32768.00 32767.00 FORMAT "%8.2" /end CHARACTERISTIC
/begin CHARACTERISTIC Sig_lCANScale_C "Skalierung Umrechnung SG -> CAN" VALUE 0xC08BE Kw_Wu16 7.999878 Fact 0.00 7.999878 FORMAT "%8.6" /end CHARACTERISTIC
/begin CHARACTERISTIC Sig_lDIAOffset_C "Offset Umrechnung SG -> DIA" VALUE 0xC08C0 Kw_Ws16 65535.00 OneToOne -32768.00 32767.00 FORMAT "%8.2" /end CHARACTERISTIC
/begin CHARACTERISTIC Sig_lDIAScale_C "Skalierung Umrechnung SG -> DIA" VALUE 0xC08C2 Kw_Wu16 7.999878 Fact 0.00 7.999878 FORMAT "%8.6" /end CHARACTERISTIC
/begin CHARACTERISTIC Sig_mAirCylDSMOffset_C "Offset Umrechung SG->DSM für Luftmasse pro Zylinder" VALUE 0xC08C4 Kw_Ws16 65535.00 OneToOne -32768.00 32767.00 FORMAT "%8.2" /end CHARACTERISTIC
/begin CHARACTERISTIC Sig_mAirCylDSMScale_C "Skalierung Umrechung SG->DSM für Luftmasse pro Zylinder" VALUE 0xC08C6 Kw_Wu16 7.999878 Fact 0.00 7.999878 FORMAT "%8.6" /end CHARACTERISTIC
/begin CHARACTERISTIC Sig_mAirCylCANOffset_C "Offset Umrechung SG->CAN für Luftmasse pro Zylinder" VALUE 0xC08C8 Kw_Ws16 65535.00 OneToOne -32768.00 32767.00 FORMAT "%8.2" /end CHARACTERISTIC
/begin CHARACTERISTIC Sig_mAirCylCANScale_C "Skalierung Umrechung SG->CAN für Luftmasse pro Zylinder" VALUE 0xC08CA Kw_Wu16 7.999878 Fact 0.00 7.999878 FORMAT "%8.6" /end CHARACTERISTIC
/begin CHARACTERISTIC Sig_mAirCylDIAOffset_C "Offset Umrechung SG->Diagnoseschnittstelle für Luftmasse pro Zylinder" VALUE 0xC08CC Kw_Ws16 65535.00 OneToOne -32768.00 32767.00 FORMAT "%8.2" /end CHARACTERISTIC
/begin CHARACTERISTIC Sig_mAirCylDIAScale_C "Skalierung Umrechung SG->Diagnoseschnittstelle für Luftmasse pro Zylinder" VALUE 0xC08CE Kw_Wu16 7.999878 Fact 0.00 7.999878 FORMAT "%8.6" /end CHARACTERISTIC
/begin CHARACTERISTIC Sig_mAirTimDSMOffset_C "Offset Umrechung SG->DSM für Luftmasse pro Zeiteinheit" VALUE 0xC08D0 Kw_Ws16 65535.00 OneToOne -32768.00 32767.00 FORMAT "%8.2" /end CHARACTERISTIC
/begin CHARACTERISTIC Sig_mAirTimDSMScale_C "Skalierung Umrechung SG->DSM für Luftmasse pro Zeiteinheit" VALUE 0xC08D2 Kw_Wu16 7.999878 Fact 0.00 7.999878 FORMAT "%8.6" /end CHARACTERISTIC
/begin CHARACTERISTIC Sig_mAirTimCANOffset_C "Offset Umrechung SG->CAN für Luftmasse pro Zeiteinheit" VALUE 0xC08D4 Kw_Ws16 65535.00 OneToOne -32768.00 32767.00 FORMAT "%8.2" /end CHARACTERISTIC
/begin CHARACTERISTIC Sig_mAirTimCANScale_C "Skalierung Umrechung SG->CAN für Luftmasse pro Zeiteinheit" VALUE 0xC08D6 Kw_Wu16 7.999878 Fact 0.00 7.999878 FORMAT "%8.6" /end CHARACTERISTIC
/begin CHARACTERISTIC Sig_mAirTimDIAOffset_C "Offset Umrechung SG->Diagnoseschnittstelle für Luftmasse pro Zeiteinheit" VALUE 0xC08D8 Kw_Ws16 65535.00 OneToOne -32768.00 32767.00 FORMAT "%8.2" /end CHARACTERISTIC
/begin CHARACTERISTIC Sig_mAirTimDIAScale_C "Skalierung Umrechung SG->Diagnoseschnittstelle für Luftmasse pro Zeiteinheit" VALUE 0xC08DA Kw_Wu16 7.999878 Fact 0.00 7.999878 FORMAT "%8.6" /end CHARACTERISTIC
/begin CHARACTERISTIC Sig_mSootTimDSMOffset_C "Offset Umrechnung SG -> DSM für Partikelmassenstrom" VALUE 0xC08DC Kw_Ws16 65535.00 OneToOne -32768.00 32767.00 FORMAT "%8.2" /end CHARACTERISTIC
/begin CHARACTERISTIC Sig_mSootTimDSMScale_C "Skalierung Umrechnung SG -> DSM für Partikelmassenstrom" VALUE 0xC08DE Kw_Wu16 7.999878 Fact 0.00 7.999878 FORMAT "%8.6" /end CHARACTERISTIC
/begin CHARACTERISTIC Sig_mSootTimCANOffset_C "Offset Umrechnung SG -> CAN für Partikelmassenstrom" VALUE 0xC08E0 Kw_Ws16 65535.00 OneToOne -32768.00 32767.00 FORMAT "%8.2" /end CHARACTERISTIC
/begin CHARACTERISTIC Sig_mSootTimCANScale_C "Skalierung Umrechnung SG -> CAN für Partikelmassenstrom" VALUE 0xC08E2 Kw_Wu16 7.999878 Fact 0.00 7.999878 FORMAT "%8.6" /end CHARACTERISTIC
/begin CHARACTERISTIC Sig_mSootTimDIAOffset_C "Offset Umrechnung SG -> Diagnoseschnittstelle für Partikelmassenstrom" VALUE 0xC08E4 Kw_Ws16 65535.00 OneToOne -32768.00 32767.00 FORMAT "%8.2" /end CHARACTERISTIC
/begin CHARACTERISTIC Sig_mSootTimDIAScale_C "Skalierung Umrechnung SG -> Diagnoseschnittstelle für Partikelmassenstrom" VALUE 0xC08E6 Kw_Wu16 7.999878 Fact 0.00 7.999878 FORMAT "%8.6" /end CHARACTERISTIC
/begin CHARACTERISTIC Sig_mSootDSMOffset_C "Offset Umrechung SG->DSM für Masse (Partikelfilter)" VALUE 0xC08E8 Kw_Ws16 65535.00 OneToOne -32768.00 32767.00 FORMAT "%8.2" /end CHARACTERISTIC
/begin CHARACTERISTIC Sig_mSootDSMScale_C "Skalierung Umrechung SG->DSM für Masse (Partikelfilter)" VALUE 0xC08EA Kw_Wu16 7.999878 Fact 0.00 7.999878 FORMAT "%8.6" /end CHARACTERISTIC
/begin CHARACTERISTIC Sig_mSootCANOffset_C "Offset Umrechung SG->CAN für Masse (Partikelfilter)" VALUE 0xC08EC Kw_Ws16 65535.00 OneToOne -32768.00 32767.00 FORMAT "%8.2" /end CHARACTERISTIC
/begin CHARACTERISTIC Sig_mSootCANScale_C "Skalierung Umrechung SG->CAN für Masse (Partikelfilter)" VALUE 0xC08EE Kw_Wu16 7.999878 Fact 0.00 7.999878 FORMAT "%8.6" /end CHARACTERISTIC
/begin CHARACTERISTIC Sig_mSootDIAOffset_C "Offset Umrechung SG->Diagnoseschnittstelle für Masse (Partikelfilter)" VALUE 0xC08F0 Kw_Ws16 65535.00 OneToOne -32768.00 32767.00 FORMAT "%8.2" /end CHARACTERISTIC
/begin CHARACTERISTIC Sig_mSootDIAScale_C "Skalierung Umrechung SG->Diagnoseschnittstelle für Masse (Partikelfilter)" VALUE 0xC08F2 Kw_Wu16 7.999878 Fact 0.00 7.999878 FORMAT "%8.6" /end CHARACTERISTIC
/begin CHARACTERISTIC Sig_nFanSpdDSMOffset_C "offset for conversion ecu -> dsm for fan speed conversion: FanSpd" VALUE 0xC08F4 Kw_Ws16 65535.00 OneToOne -32768.00 32767.00 FORMAT "%8.2" /end CHARACTERISTIC
/begin CHARACTERISTIC Sig_nFanSpdDSMScale_C "scale factor for conversion ecu -> dsm for fan speed conversion: FanSpd" VALUE 0xC08F6 Kw_Wu16 7.999878 Fact 0.00 7.999878 FORMAT "%8.6" /end CHARACTERISTIC
/begin CHARACTERISTIC Sig_nFanSpdCANOffset_C "offset for conversion ecu -> can for fan speed conversion: FanSpd" VALUE 0xC08F8 Kw_Ws16 65535.00 OneToOne -32768.00 32767.00 FORMAT "%8.2" /end CHARACTERISTIC
/begin CHARACTERISTIC Sig_nFanSpdCANScale_C "scale factor for conversion ecu -> can for fan speed conversion: FanSpd" VALUE 0xC08FA Kw_Wu16 7.999878 Fact 0.00 7.999878 FORMAT "%8.6" /end CHARACTERISTIC
/begin CHARACTERISTIC Sig_nFanSpdDIAOffset_C "offset for conversion ecu -> dia for fan speed conversion: FanSpd" VALUE 0xC08FC Kw_Ws16 65535.00 OneToOne -32768.00 32767.00 FORMAT "%8.2" /end CHARACTERISTIC
/begin CHARACTERISTIC Sig_nFanSpdDIAScale_C "scale factor for conversion ecu -> dia for fan speed conversion: FanSpd" VALUE 0xC08FE Kw_Wu16 7.999878 Fact 0.00 7.999878 FORMAT "%8.6" /end CHARACTERISTIC
/begin CHARACTERISTIC Sig_nPSPSpdDSMOffset_C "offset for conversion ecu -> dsm for psp speed cConversion: PSP_Spd" VALUE 0xC0900 Kw_Ws16 65535.00 OneToOne -32768.00 32767.00 FORMAT "%8.2" /end CHARACTERISTIC
/begin CHARACTERISTIC Sig_nPSPSpdDSMScale_C "scale factor for conversion ecu -> dsm for psp speed cConversion: PSP_Spd" VALUE 0xC0902 Kw_Wu16 7.999878 Fact 0.00 7.999878 FORMAT "%8.6" /end CHARACTERISTIC
/begin CHARACTERISTIC Sig_nPSPSpdCANOffset_C "offset for conversion ecu -> can for psp speed cConversion: PSP_Spd" VALUE 0xC0904 Kw_Ws16 65535.00 OneToOne -32768.00 32767.00 FORMAT "%8.2" /end CHARACTERISTIC
/begin CHARACTERISTIC Sig_nPSPSpdCANScale_C "scale factor for conversion ecu -> can for psp speed cConversion: PSP_Spd" VALUE 0xC0906 Kw_Wu16 7.999878 Fact 0.00 7.999878 FORMAT "%8.6" /end CHARACTERISTIC
/begin CHARACTERISTIC Sig_nPSPSpdDIAOffset_C "offset for conversion ecu -> dia for psp speed cConversion: PSP_Spd" VALUE 0xC0908 Kw_Ws16 65535.00 OneToOne -32768.00 32767.00 FORMAT "%8.2" /end CHARACTERISTIC
/begin CHARACTERISTIC Sig_nPSPSpdDIAScale_C "scale factor for conversion ecu -> dia for psp speed cConversion: PSP_Spd" VALUE 0xC090A Kw_Wu16 7.999878 Fact 0.00 7.999878 FORMAT "%8.6" /end CHARACTERISTIC
/begin CHARACTERISTIC Sig_nDSMOffset_C "Offset Umrechung SG->DSM für Drehzahlsignale" VALUE 0xC090C Kw_Ws16 65535.00 OneToOne -32768.00 32767.00 FORMAT "%8.2" /end CHARACTERISTIC
/begin CHARACTERISTIC Sig_nDSMScale_C "Skalierung Umrechung SG->DSM für Drehzahlsignale" VALUE 0xC090E Kw_Wu16 7.999878 Fact 0.00 7.999878 FORMAT "%8.6" /end CHARACTERISTIC
/begin CHARACTERISTIC Sig_nCANOffset_C "Offset Umrechung SG<->CAN für Drehzahlsignale" VALUE 0xC0910 Kw_Ws16 65535.00 OneToOne -32768.00 32767.00 FORMAT "%8.2" /end CHARACTERISTIC
/begin CHARACTERISTIC Sig_nCANScale_C "Skalierung Umrechung SG->CAN für Drehzahlsignale" VALUE 0xC0912 Kw_Wu16 7.999878 Fact 0.00 7.999878 FORMAT "%8.6" /end CHARACTERISTIC
/begin CHARACTERISTIC Sig_nDIAOffset_C "Offset Umrechung SG->DIA für Drehzahlsignale" VALUE 0xC0914 Kw_Ws16 65535.00 OneToOne -32768.00 32767.00 FORMAT "%8.2" /end CHARACTERISTIC
/begin CHARACTERISTIC Sig_nDIAScale_C "Skalierung Umrechung SG->DIA für Drehzahlsignale" VALUE 0xC0916 Kw_Wu16 7.999878 Fact 0.00 7.999878 FORMAT "%8.6" /end CHARACTERISTIC
/begin CHARACTERISTIC Sig_O2DSMOffset_C "Offset Umrechnung SG -> DSM für Sauerstoffkonzentration" VALUE 0xC0918 Kw_Ws16 65535.00 OneToOne -32768.00 32767.00 FORMAT "%8.2" /end CHARACTERISTIC
/begin CHARACTERISTIC Sig_O2DSMScale_C "Skalierung Umrechnung SG -> DSM für Sauerstoffkonzentration" VALUE 0xC091A Kw_Wu16 7.999878 Fact 0.00 7.999878 FORMAT "%8.6" /end CHARACTERISTIC
/begin CHARACTERISTIC Sig_O2CANOffset_C "Offset Umrechnung SG -> CAN für Sauerstoffkonzentration" VALUE 0xC091C Kw_Ws16 65535.00 OneToOne -32768.00 32767.00 FORMAT "%8.2" /end CHARACTERISTIC
/begin CHARACTERISTIC Sig_O2CANScale_C "Skalierung Umrechnung SG -> CAN für Sauerstoffkonzentration" VALUE 0xC091E Kw_Wu16 7.999878 Fact 0.00 7.999878 FORMAT "%8.6" /end CHARACTERISTIC
/begin CHARACTERISTIC Sig_O2DIAOffset_C "Offset Umrechnung SG -> Diagnoseschnittstelle für Sauerstoffkonzentration" VALUE 0xC0920 Kw_Ws16 65535.00 OneToOne -32768.00 32767.00 FORMAT "%8.2" /end CHARACTERISTIC
/begin CHARACTERISTIC Sig_O2DIAScale_C "Skalierung Umrechnung SG -> Diagnoseschnittstelle für Sauerstoffkonzentration" VALUE 0xC0922 Kw_Wu16 7.999878 Fact 0.00 7.999878 FORMAT "%8.6" /end CHARACTERISTIC
/begin CHARACTERISTIC Sig_OneToOneZFCDSMOffset_C "offset for conversion ecu -> dsm, One to one for ZFC" VALUE 0xC0924 Kw_Ws16 65535.00 OneToOne -32768.00 32767.00 FORMAT "%8.2" /end CHARACTERISTIC
/begin CHARACTERISTIC Sig_OneToOneZFCDSMScale_C "scale factor for conversion ecu -> dsm, One to one for ZFC" VALUE 0xC0926 Kw_Wu16 7.999878 Fact 0.00 7.999878 FORMAT "%8.6" /end CHARACTERISTIC
/begin CHARACTERISTIC Sig_OneToOneZFCCANOffset_C "offset for conversion ecu -> can, One to one for ZFC" VALUE 0xC0928 Kw_Ws16 65535.00 OneToOne -32768.00 32767.00 FORMAT "%8.2" /end CHARACTERISTIC
/begin CHARACTERISTIC Sig_OneToOneZFCCANScale_C "scale factor for conversion ecu -> can, One to one for ZFC" VALUE 0xC092A Kw_Wu16 7.999878 Fact 0.00 7.999878 FORMAT "%8.6" /end CHARACTERISTIC
/begin CHARACTERISTIC Sig_OneToOneZFCDIAOffset_C "offset for conversion ecu -> dia, One to one for ZFC" VALUE 0xC092C Kw_Ws16 65535.00 OneToOne -32768.00 32767.00 FORMAT "%8.2" /end CHARACTERISTIC
/begin CHARACTERISTIC Sig_OneToOneZFCDIAScale_C "scale factor for conversion ecu -> dia, One to one for ZFC" VALUE 0xC092E Kw_Wu16 7.999878 Fact 0.00 7.999878 FORMAT "%8.6" /end CHARACTERISTIC
/begin CHARACTERISTIC Sig_OneToOneDSMOffset_C "Offset Umrechung SG->DSM" VALUE 0xC0930 Kw_Ws16 65535.00 OneToOne -32768.00 32767.00 FORMAT "%8.2" /end CHARACTERISTIC
/begin CHARACTERISTIC Sig_OneToOneDSMScale_C "Skalierung Umrechung SG->DSM" VALUE 0xC0932 Kw_Wu16 7.999878 Fact 0.00 7.999878 FORMAT "%8.6" /end CHARACTERISTIC
/begin CHARACTERISTIC Sig_OneToOneCANOffset_C "Offset Umrechung SG->CAN" VALUE 0xC0934 Kw_Ws16 65535.00 OneToOne -32768.00 32767.00 FORMAT "%8.2" /end CHARACTERISTIC
/begin CHARACTERISTIC Sig_OneToOneCANScale_C "Skalierung Umrechung SG->CAN" VALUE 0xC0936 Kw_Wu16 7.999878 Fact 0.00 7.999878 FORMAT "%8.6" /end CHARACTERISTIC
/begin CHARACTERISTIC Sig_OneToOneDIAOffset_C "Offset Umrechung SG->DIA" VALUE 0xC0938 Kw_Ws16 65535.00 OneToOne -32768.00 32767.00 FORMAT "%8.2" /end CHARACTERISTIC
/begin CHARACTERISTIC Sig_OneToOneDIAScale_C "Skalierung Umrechung SG->DIA" VALUE 0xC093A Kw_Wu16 7.999878 Fact 0.00 7.999878 FORMAT "%8.6" /end CHARACTERISTIC
/begin CHARACTERISTIC Sig_OnOffDSMOffset_C "Offset Umrechung SG->DSM für Digitalsignale" VALUE 0xC093C Kw_Ws16 65535.00 OneToOne -32768.00 32767.00 FORMAT "%8.2" /end CHARACTERISTIC
/begin CHARACTERISTIC Sig_OnOffDSMScale_C "Skalierung Umrechung SG->DSM für Digitalsignale" VALUE 0xC093E Kw_Wu16 7.999878 Fact 0.00 7.999878 FORMAT "%8.6" /end CHARACTERISTIC
/begin CHARACTERISTIC Sig_OnOffCANOffset_C "Offset Umrechung SG->CAN für Digitalsignale" VALUE 0xC0940 Kw_Ws16 65535.00 OneToOne -32768.00 32767.00 FORMAT "%8.2" /end CHARACTERISTIC
/begin CHARACTERISTIC Sig_OnOffCANScale_C "Skalierung Umrechung SG->CAN für Digitalsignale" VALUE 0xC0942 Kw_Wu16 7.999878 Fact 0.00 7.999878 FORMAT "%8.6" /end CHARACTERISTIC
/begin CHARACTERISTIC Sig_OnOffDIAOffset_C "Offset Umrechung SG->DIA für Digitalsignale" VALUE 0xC0944 Kw_Ws16 65535.00 OneToOne -32768.00 32767.00 FORMAT "%8.2" /end CHARACTERISTIC
/begin CHARACTERISTIC Sig_OnOffDIAScale_C "Skalierung Umrechung SG->DIA für Digitalsignale" VALUE 0xC0946 Kw_Wu16 7.999878 Fact 0.00 7.999878 FORMAT "%8.6" /end CHARACTERISTIC
/begin CHARACTERISTIC Sig_PermUwB6DSMOffset_C "offset for conversion ecu -> dsm for k3-Conversion: Def_perm_uw_b6" VALUE 0xC0948 Kw_Ws16 65535.00 OneToOne -32768.00 32767.00 FORMAT "%8.2" /end CHARACTERISTIC
/begin CHARACTERISTIC Sig_PermUwB6DSMScale_C "scale factor for conversion ecu -> dsm for k3-Conversion: Def_perm_uw_b6" VALUE 0xC094A Kw_Wu16 7.999878 Fact 0.00 7.999878 FORMAT "%8.6" /end CHARACTERISTIC
/begin CHARACTERISTIC Sig_PermUwB6CANOffset_C "offset for conversion ecu -> can for k3-Conversion: Def_perm_uw_b6" VALUE 0xC094C Kw_Ws16 65535.00 OneToOne -32768.00 32767.00 FORMAT "%8.2" /end CHARACTERISTIC
/begin CHARACTERISTIC Sig_PermUwB6CANScale_C "scale factor for conversion ecu -> can for k3-Conversion: Def_perm_uw_b6" VALUE 0xC094E Kw_Wu16 7.999878 Fact 0.00 7.999878 FORMAT "%8.6" /end CHARACTERISTIC
/begin CHARACTERISTIC Sig_PermUwB6DIAOffset_C "offset for conversion ecu -> dia for k3-Conversion: Def_perm_uw_b6" VALUE 0xC0950 Kw_Ws16 65535.00 OneToOne -32768.00 32767.00 FORMAT "%8.2" /end CHARACTERISTIC
/begin CHARACTERISTIC Sig_PermUwB6DIAScale_C "scale factor for conversion ecu -> dia for k3-Conversion: Def_perm_uw_b6" VALUE 0xC0952 Kw_Wu16 7.999878 Fact 0.00 7.999878 FORMAT "%8.6" /end CHARACTERISTIC
/begin CHARACTERISTIC Sig_pRailDSMOffset_C "offset für Umrechnung ecu -> dsm" VALUE 0xC0954 Kw_Ws16 65535.00 OneToOne -32768.00 32767.00 FORMAT "%8.2" /end CHARACTERISTIC
/begin CHARACTERISTIC Sig_pRailDSMScale_C "Skalierung für Umrechnung ecu -> dsm" VALUE 0xC0956 Kw_Wu16 7.999878 Fact 0.00 7.999878 FORMAT "%8.6" /end CHARACTERISTIC
/begin CHARACTERISTIC Sig_pRailCANOffset_C "Offset für Umrechnung ecu -> can" VALUE 0xC0958 Kw_Ws16 65535.00 OneToOne -32768.00 32767.00 FORMAT "%8.2" /end CHARACTERISTIC
/begin CHARACTERISTIC Sig_pRailCANScale_C "Skalierung für Umrechnung ecu -> can" VALUE 0xC095A Kw_Wu16 7.999878 Fact 0.00 7.999878 FORMAT "%8.6" /end CHARACTERISTIC
/begin CHARACTERISTIC Sig_pRailDIAOffset_C "Offset für Umrechnung ecu -> dia" VALUE 0xC095C Kw_Ws16 65535.00 OneToOne -32768.00 32767.00 FORMAT "%8.2" /end CHARACTERISTIC
/begin CHARACTERISTIC Sig_pRailDIAScale_C "Skalierung für Umrechnung ecu -> dia" VALUE 0xC095E Kw_Wu16 7.999878 Fact 0.00 7.999878 FORMAT "%8.6" /end CHARACTERISTIC
/begin CHARACTERISTIC Sig_pDSMOffset_C "Offset Umrechung SG->DSM für Druck" VALUE 0xC0960 Kw_Ws16 65535.00 OneToOne -32768.00 32767.00 FORMAT "%8.2" /end CHARACTERISTIC
/begin CHARACTERISTIC Sig_pDSMScale_C "Skalierung Umrechung SG->DSM für Druck" VALUE 0xC0962 Kw_Wu16 7.999878 Fact 0.00 7.999878 FORMAT "%8.6" /end CHARACTERISTIC
/begin CHARACTERISTIC Sig_pCANOffset_C "Offset Umrechung SG->CAN für Druck" VALUE 0xC0964 Kw_Ws16 65535.00 OneToOne -32768.00 32767.00 FORMAT "%8.2" /end CHARACTERISTIC
/begin CHARACTERISTIC Sig_pCANScale_C "Skalierung Umrechung SG->CAN für Druck" VALUE 0xC0966 Kw_Wu16 7.999878 Fact 0.00 7.999878 FORMAT "%8.6" /end CHARACTERISTIC
/begin CHARACTERISTIC Sig_pDIAOffset_C "Offset Umrechung SG->Diagnoseschnittstelle für Druck" VALUE 0xC0968 Kw_Ws16 65535.00 OneToOne -32768.00 32767.00 FORMAT "%8.2" /end CHARACTERISTIC
/begin CHARACTERISTIC Sig_pDIAScale_C "Skalierung Umrechung SG->Diagnoseschnittstelle für Druck" VALUE 0xC096A Kw_Wu16 7.999878 Fact 0.00 7.999878 FORMAT "%8.6" /end CHARACTERISTIC
/begin CHARACTERISTIC Sig_qInjMassCycDSMOffset_C "offset for conversion ecu -> dsm for injection quantity per cycle, Conversion: InjMassCyc" VALUE 0xC096C Kw_Ws16 65535.00 OneToOne -32768.00 32767.00 FORMAT "%8.2" /end CHARACTERISTIC
/begin CHARACTERISTIC Sig_qInjMassCycDSMScale_C "scale factor for conversion ecu -> dsm for injection quantity per cycle, Conversion: InjMassCyc" VALUE 0xC096E Kw_Wu16 7.999878 Fact 0.00 7.999878 FORMAT "%8.6" /end CHARACTERISTIC
/begin CHARACTERISTIC Sig_qInjMassCycCANOffset_C "offset for conversion ecu -> can for injection quantity per cycle, Conversion: InjMassCyc" VALUE 0xC0970 Kw_Ws16 65535.00 OneToOne -32768.00 32767.00 FORMAT "%8.2" /end CHARACTERISTIC
/begin CHARACTERISTIC Sig_qInjMassCycCANScale_C "scale factor for conversion ecu -> can for injection quantity per cycle, Conversion: InjMassCyc" VALUE 0xC0972 Kw_Wu16 7.999878 Fact 0.00 7.999878 FORMAT "%8.6" /end CHARACTERISTIC
/begin CHARACTERISTIC Sig_qInjMassCycDIAOffset_C "offset for conversion ecu -> dia for injection quantity per cycle, Conversion: InjMassCyc" VALUE 0xC0974 Kw_Ws16 65535.00 OneToOne -32768.00 32767.00 FORMAT "%8.2" /end CHARACTERISTIC
/begin CHARACTERISTIC Sig_qInjMassCycDIAScale_C "scale factor for conversion ecu -> dia for injection quantity per cycle, Conversion: InjMassCyc" VALUE 0xC0976 Kw_Wu16 7.999878 Fact 0.00 7.999878 FORMAT "%8.6" /end CHARACTERISTIC
/begin CHARACTERISTIC Sig_qInjMassDSMOffset_C "Offset für Umrechnung ecu -> dsm" VALUE 0xC0978 Kw_Ws16 65535.00 OneToOne -32768.00 32767.00 FORMAT "%8.2" /end CHARACTERISTIC
/begin CHARACTERISTIC Sig_qInjMassDSMScale_C "Skalierung für Umrechnung ecu -> dsm" VALUE 0xC097A Kw_Wu16 7.999878 Fact 0.00 7.999878 FORMAT "%8.6" /end CHARACTERISTIC
/begin CHARACTERISTIC Sig_qInjMassCANOffset_C "Offset für Umrechnung ecu -> can" VALUE 0xC097C Kw_Ws16 65535.00 OneToOne -32768.00 32767.00 FORMAT "%8.2" /end CHARACTERISTIC
/begin CHARACTERISTIC Sig_qInjMassCANScale_C "Skalierung für Umrechnung ecu -> can" VALUE 0xC097E Kw_Wu16 7.999878 Fact 0.00 7.999878 FORMAT "%8.6" /end CHARACTERISTIC
/begin CHARACTERISTIC Sig_qInjMassDIAOffset_C "Offset für Umrechnung ecu -> dia" VALUE 0xC0980 Kw_Ws16 65535.00 OneToOne -32768.00 32767.00 FORMAT "%8.2" /end CHARACTERISTIC
/begin CHARACTERISTIC Sig_qInjMassDIAScale_C "Skalierung für Umrechnung ecu -> dia" VALUE 0xC0982 Kw_Wu16 7.999878 Fact 0.00 7.999878 FORMAT "%8.6" /end CHARACTERISTIC
/begin CHARACTERISTIC Sig_qDSMOffset_C "Offset fuer Umrechung SG->DSM fuer Menge" VALUE 0xC0984 Kw_Ws16 65535.00 OneToOne -32768.00 32767.00 FORMAT "%8.2" /end CHARACTERISTIC
/begin CHARACTERISTIC Sig_qDSMScale_C "Skalierung Umrechungs Faktor SG->DSM fuer Menge" VALUE 0xC0986 Kw_Wu16 7.999878 Fact 0.00 7.999878 FORMAT "%8.6" /end CHARACTERISTIC
/begin CHARACTERISTIC Sig_qCANOffset_C "Offset fuer Umrechung SG->CAN fuer Menge" VALUE 0xC0988 Kw_Ws16 65535.00 OneToOne -32768.00 32767.00 FORMAT "%8.2" /end CHARACTERISTIC
/begin CHARACTERISTIC Sig_qCANScale_C "Skalierung Umrechungs Faktor SG->CAN fuer Menge" VALUE 0xC098A Kw_Wu16 7.999878 Fact 0.00 7.999878 FORMAT "%8.6" /end CHARACTERISTIC
/begin CHARACTERISTIC Sig_qDIAOffset_C "Offset fuer Umrechung SG->DIA fuer Menge" VALUE 0xC098C Kw_Ws16 65535.00 OneToOne -32768.00 32767.00 FORMAT "%8.2" /end CHARACTERISTIC
/begin CHARACTERISTIC Sig_qDIAScale_C "Skalierung Umrechungs Faktor SG->DIA fuer Menge" VALUE 0xC098E Kw_Wu16 7.999878 Fact 0.00 7.999878 FORMAT "%8.6" /end CHARACTERISTIC
/begin CHARACTERISTIC Sig_resFlowDSMOffset_C "Offset Umrechung SG->DSM für Strömungswiderstand" VALUE 0xC0990 Kw_Ws16 65535.00 OneToOne -32768.00 32767.00 FORMAT "%8.2" /end CHARACTERISTIC
/begin CHARACTERISTIC Sig_resFlowDSMScale_C "Skalierung Umrechung SG->DSM für Strömungswiderstand" VALUE 0xC0992 Kw_Wu16 7.999878 Fact 0.00 7.999878 FORMAT "%8.6" /end CHARACTERISTIC
/begin CHARACTERISTIC Sig_resFlowCANOffset_C "Offset Umrechung SG->CAN für Strömungswiderstand" VALUE 0xC0994 Kw_Ws16 65535.00 OneToOne -32768.00 32767.00 FORMAT "%8.2" /end CHARACTERISTIC
/begin CHARACTERISTIC Sig_resFlowCANScale_C "Skalierung Umrechung SG->CAN für Strömungswiderstand" VALUE 0xC0996 Kw_Wu16 7.999878 Fact 0.00 7.999878 FORMAT "%8.6" /end CHARACTERISTIC
/begin CHARACTERISTIC Sig_resFlowDIAOffset_C "Offset Umrechung SG->Diagnoseschnittstelle für Strömungswiderstand" VALUE 0xC0998 Kw_Ws16 65535.00 OneToOne -32768.00 32767.00 FORMAT "%8.2" /end CHARACTERISTIC
/begin CHARACTERISTIC Sig_resFlowDIAScale_C "Skalierung Umrechung SG->Diagnoseschnittstelle für Strömungswiderstand" VALUE 0xC099A Kw_Wu16 7.999878 Fact 0.00 7.999878 FORMAT "%8.6" /end CHARACTERISTIC
/begin CHARACTERISTIC Sig_rVnDSMOffset_C "Offset für Umrechnung ecu -> dsm" VALUE 0xC099C Kw_Ws16 65535.00 OneToOne -32768.00 32767.00 FORMAT "%8.2" /end CHARACTERISTIC
/begin CHARACTERISTIC Sig_rVnDSMScale_C "Skalierung für Umrechnung ecu -> dsm" VALUE 0xC099E Kw_Wu16 7.999878 Fact 0.00 7.999878 FORMAT "%8.6" /end CHARACTERISTIC
/begin CHARACTERISTIC Sig_rVnCANOffset_C "Offset für Umrechnung ecu -> can" VALUE 0xC09A0 Kw_Ws16 65535.00 OneToOne -32768.00 32767.00 FORMAT "%8.2" /end CHARACTERISTIC
/begin CHARACTERISTIC Sig_rVnCANScale_C "Skalierung für Umrechnung ecu -> can" VALUE 0xC09A2 Kw_Wu16 7.999878 Fact 0.00 7.999878 FORMAT "%8.6" /end CHARACTERISTIC
/begin CHARACTERISTIC Sig_rVnDIAOffset_C "Offset für Umrechnung ecu -> dia" VALUE 0xC09A4 Kw_Ws16 65535.00 OneToOne -32768.00 32767.00 FORMAT "%8.2" /end CHARACTERISTIC
/begin CHARACTERISTIC Sig_rVnDIAScale_C "Skalierung für Umrechnung ecu -> dia" VALUE 0xC09A6 Kw_Wu16 7.999878 Fact 0.00 7.999878 FORMAT "%8.6" /end CHARACTERISTIC
/begin CHARACTERISTIC Sig_rDSMOffset_C "Offset Umrechung SG->DSM für Verhältnisse" VALUE 0xC09A8 Kw_Ws16 65535.00 OneToOne -32768.00 32767.00 FORMAT "%8.2" /end CHARACTERISTIC
/begin CHARACTERISTIC Sig_rDSMScale_C "Skalierung Umrechung SG->DSM für Verhältnisse" VALUE 0xC09AA Kw_Wu16 7.999878 Fact 0.00 7.999878 FORMAT "%8.6" /end CHARACTERISTIC
/begin CHARACTERISTIC Sig_rCANOffset_C "Offset Umrechung SG->CAN für Verhältnisse" VALUE 0xC09AC Kw_Ws16 65535.00 OneToOne -32768.00 32767.00 FORMAT "%8.2" /end CHARACTERISTIC
/begin CHARACTERISTIC Sig_rCANScale_C "Skalierung Umrechung SG->CAN für Verhältnisse" VALUE 0xC09AE Kw_Wu16 7.999878 Fact 0.00 7.999878 FORMAT "%8.6" /end CHARACTERISTIC
/begin CHARACTERISTIC Sig_rDIAOffset_C "Offset Umrechung SG->Diagnoseschnittstelle für Verhältnisse" VALUE 0xC09B0 Kw_Ws16 65535.00 OneToOne -32768.00 32767.00 FORMAT "%8.2" /end CHARACTERISTIC
/begin CHARACTERISTIC Sig_rDIAScale_C "Skalierung Umrechung SG->Diagnoseschnittstelle für Verhältnisse" VALUE 0xC09B2 Kw_Wu16 7.999878 Fact 0.00 7.999878 FORMAT "%8.6" /end CHARACTERISTIC
/begin CHARACTERISTIC Sig_ShftRght0ByteDSMOffset_C "offset for conversion ecu -> dsm to shift right 0 byte of status value, Conversion: OneToOne" VALUE 0xC09B4 Kw_Ws16 65535.00 OneToOne -32768.00 32767.00 FORMAT "%8.2" /end CHARACTERISTIC
/begin CHARACTERISTIC Sig_ShftRght0ByteDSMScale_C "scale factor for conversion ecu -> dsm to shift right 0 byte of status value, Conversion: OneToOne" VALUE 0xC09B6 Kw_Wu16 7.999878 Fact 0.00 7.999878 FORMAT "%8.6" /end CHARACTERISTIC
/begin CHARACTERISTIC Sig_ShftRght0ByteCANOffset_C "offset for conversion ecu -> can to shift right 0 byte of status value, Conversion: OneToOne" VALUE 0xC09B8 Kw_Ws16 65535.00 OneToOne -32768.00 32767.00 FORMAT "%8.2" /end CHARACTERISTIC
/begin CHARACTERISTIC Sig_ShftRght0ByteCANScale_C "scale factor for conversion ecu -> can to shift right 0 byte of status value, Conversion: OneToOne" VALUE 0xC09BA Kw_Wu16 7.999878 Fact 0.00 7.999878 FORMAT "%8.6" /end CHARACTERISTIC
/begin CHARACTERISTIC Sig_ShftRght0ByteDIAOffset_C "offset for conversion ecu -> dia to shift right 0 byte of status value, Conversion: OneToOne" VALUE 0xC09BC Kw_Ws16 65535.00 OneToOne -32768.00 32767.00 FORMAT "%8.2" /end CHARACTERISTIC
/begin CHARACTERISTIC Sig_ShftRght0ByteDIAScale_C "scale factor for conversion ecu -> dia to shift right 0 byte of status value, Conversion: OneToOne" VALUE 0xC09BE Kw_Wu16 7.999878 Fact 0.00 7.999878 FORMAT "%8.6" /end CHARACTERISTIC
/begin CHARACTERISTIC Sig_ShftRght1ByteDSMOffset_C "offset for conversion ecu -> dsm to shift right 1 byte of status value, Conversion: OneToOne" VALUE 0xC09C0 Kw_Ws16 65535.00 OneToOne -32768.00 32767.00 FORMAT "%8.2" /end CHARACTERISTIC
/begin CHARACTERISTIC Sig_ShftRght1ByteDSMScale_C "scale factor for conversion ecu -> dsm to shift right 1 byte of status value, Conversion: OneToOne" VALUE 0xC09C2 Kw_Wu16 7.999878 Fact 0.00 7.999878 FORMAT "%8.6" /end CHARACTERISTIC
/begin CHARACTERISTIC Sig_ShftRght1ByteCANOffset_C "offset for conversion ecu -> can to shift right 1 byte of status value, Conversion: OneToOne" VALUE 0xC09C4 Kw_Ws16 65535.00 OneToOne -32768.00 32767.00 FORMAT "%8.2" /end CHARACTERISTIC
/begin CHARACTERISTIC Sig_ShftRght1ByteCANScale_C "scale factor for conversion ecu -> can to shift right 1 byte of status value, Conversion: OneToOne" VALUE 0xC09C6 Kw_Wu16 7.999878 Fact 0.00 7.999878 FORMAT "%8.6" /end CHARACTERISTIC
/begin CHARACTERISTIC Sig_ShftRght1ByteDIAOffset_C "offset for conversion ecu -> dia to shift right 1 byte of status value, Conversion: OneToOne" VALUE 0xC09C8 Kw_Ws16 65535.00 OneToOne -32768.00 32767.00 FORMAT "%8.2" /end CHARACTERISTIC
/begin CHARACTERISTIC Sig_ShftRght1ByteDIAScale_C "scale factor for conversion ecu -> dia to shift right 1 byte of status value, Conversion: OneToOne" VALUE 0xC09CA Kw_Wu16 7.999878 Fact 0.00 7.999878 FORMAT "%8.6" /end CHARACTERISTIC
/begin CHARACTERISTIC Sig_ShftRght2ByteDSMOffset_C "offset for conversion ecu -> dsm to shift right 2 byte of status value, Conversion: OneToOne" VALUE 0xC09CC Kw_Ws16 65535.00 OneToOne -32768.00 32767.00 FORMAT "%8.2" /end CHARACTERISTIC
/begin CHARACTERISTIC Sig_ShftRght2ByteDSMScale_C "scale factor for conversion ecu -> dsm to shift right 2 byte of status value, Conversion: OneToOne" VALUE 0xC09CE Kw_Wu16 7.999878 Fact 0.00 7.999878 FORMAT "%8.6" /end CHARACTERISTIC
/begin CHARACTERISTIC Sig_ShftRght2ByteCANOffset_C "offset for conversion ecu -> can to shift right 2 byte of status value, Conversion: OneToOne" VALUE 0xC09D0 Kw_Ws16 65535.00 OneToOne -32768.00 32767.00 FORMAT "%8.2" /end CHARACTERISTIC
/begin CHARACTERISTIC Sig_ShftRght2ByteCANScale_C "scale factor for conversion ecu -> can to shift right 2 byte of status value, Conversion: OneToOne" VALUE 0xC09D2 Kw_Wu16 7.999878 Fact 0.00 7.999878 FORMAT "%8.6" /end CHARACTERISTIC
/begin CHARACTERISTIC Sig_ShftRght2ByteDIAOffset_C "offset for conversion ecu -> dia to shift right 2 byte of status value, Conversion: OneToOne" VALUE 0xC09D4 Kw_Ws16 65535.00 OneToOne -32768.00 32767.00 FORMAT "%8.2" /end CHARACTERISTIC
/begin CHARACTERISTIC Sig_ShftRght2ByteDIAScale_C "scale factor for conversion ecu -> dia to shift right 2 byte of status value, Conversion: OneToOne" VALUE 0xC09D6 Kw_Wu16 7.999878 Fact 0.00 7.999878 FORMAT "%8.6" /end CHARACTERISTIC
/begin CHARACTERISTIC Sig_ShftRght3ByteDSMOffset_C "offset for conversion ecu -> dsm to shift right 3 byte of status value, Conversion: OneToOne" VALUE 0xC09D8 Kw_Ws16 65535.00 OneToOne -32768.00 32767.00 FORMAT "%8.2" /end CHARACTERISTIC
/begin CHARACTERISTIC Sig_ShftRght3ByteDSMScale_C "scale factor for conversion ecu -> dsm to shift right 3 byte of status value, Conversion: OneToOne" VALUE 0xC09DA Kw_Wu16 7.999878 Fact 0.00 7.999878 FORMAT "%8.6" /end CHARACTERISTIC
/begin CHARACTERISTIC Sig_ShftRght3ByteCANOffset_C "offset for conversion ecu -> can to shift right 3 byte of status value, Conversion: OneToOne" VALUE 0xC09DC Kw_Ws16 65535.00 OneToOne -32768.00 32767.00 FORMAT "%8.2" /end CHARACTERISTIC
/begin CHARACTERISTIC Sig_ShftRght3ByteCANScale_C "scale factor for conversion ecu -> can to shift right 3 byte of status value, Conversion: OneToOne" VALUE 0xC09DE Kw_Wu16 7.999878 Fact 0.00 7.999878 FORMAT "%8.6" /end CHARACTERISTIC
/begin CHARACTERISTIC Sig_ShftRght3ByteDIAOffset_C "offset for conversion ecu -> dia to shift right 3 byte of status value, Conversion: OneToOne" VALUE 0xC09E0 Kw_Ws16 65535.00 OneToOne -32768.00 32767.00 FORMAT "%8.2" /end CHARACTERISTIC
/begin CHARACTERISTIC Sig_ShftRght3ByteDIAScale_C "scale factor for conversion ecu -> dia to shift right 3 byte of status value, Conversion: OneToOne" VALUE 0xC09E2 Kw_Wu16 7.999878 Fact 0.00 7.999878 FORMAT "%8.6" /end CHARACTERISTIC
/begin CHARACTERISTIC Sig_TdUbQ0p5DSMOffset_C "offset for conversion ecu -> dsm for k3-Conversion: Def_td_ub_q0p5" VALUE 0xC09E4 Kw_Ws16 65535.00 OneToOne -32768.00 32767.00 FORMAT "%8.2" /end CHARACTERISTIC
/begin CHARACTERISTIC Sig_TdUbQ0p5DSMScale_C "scale factor for conversion ecu -> dsm for k3-Conversion: Def_td_ub_q0p5" VALUE 0xC09E6 Kw_Wu16 7.999878 Fact 0.00 7.999878 FORMAT "%8.6" /end CHARACTERISTIC
/begin CHARACTERISTIC Sig_TdUbQ0p5CANOffset_C "offset for conversion ecu -> can for k3-Conversion: Def_td_ub_q0p5" VALUE 0xC09E8 Kw_Ws16 65535.00 OneToOne -32768.00 32767.00 FORMAT "%8.2" /end CHARACTERISTIC
/begin CHARACTERISTIC Sig_TdUbQ0p5CANScale_C "scale factor for conversion ecu -> can for k3-Conversion: Def_td_ub_q0p5" VALUE 0xC09EA Kw_Wu16 7.999878 Fact 0.00 7.999878 FORMAT "%8.6" /end CHARACTERISTIC
/begin CHARACTERISTIC Sig_TdUbQ0p5DIAOffset_C "offset for conversion ecu -> dia for k3-Conversion: Def_td_ub_q0p5" VALUE 0xC09EC Kw_Ws16 65535.00 OneToOne -32768.00 32767.00 FORMAT "%8.2" /end CHARACTERISTIC
/begin CHARACTERISTIC Sig_TdUbQ0p5DIAScale_C "scale factor for conversion ecu -> dia for k3-Conversion: Def_td_ub_q0p5" VALUE 0xC09EE Kw_Wu16 7.999878 Fact 0.00 7.999878 FORMAT "%8.6" /end CHARACTERISTIC
/begin CHARACTERISTIC Sig_TdUbQ14p9333DSMOffset_C "offset for conversion ecu -> dsm for k3-Conversion: Def_td_ub_q14p9333" VALUE 0xC09F0 Kw_Ws16 65535.00 OneToOne -32768.00 32767.00 FORMAT "%8.2" /end CHARACTERISTIC
/begin CHARACTERISTIC Sig_TdUbQ14p9333DSMScale_C "scale factor for conversion ecu -> dsm for k3-Conversion: Def_td_ub_q14p9333" VALUE 0xC09F2 Kw_Wu16 7.999878 Fact 0.00 7.999878 FORMAT "%8.6" /end CHARACTERISTIC
/begin CHARACTERISTIC Sig_TdUbQ14p9333CANOffset_C "offset for conversion ecu -> can for k3-Conversion: Def_td_ub_q14p9333" VALUE 0xC09F4 Kw_Ws16 65535.00 OneToOne -32768.00 32767.00 FORMAT "%8.2" /end CHARACTERISTIC
/begin CHARACTERISTIC Sig_TdUbQ14p9333CANScale_C "scale factor for conversion ecu -> can for k3-Conversion: Def_td_ub_q14p9333" VALUE 0xC09F6 Kw_Wu16 7.999878 Fact 0.00 7.999878 FORMAT "%8.6" /end CHARACTERISTIC
/begin CHARACTERISTIC Sig_TdUbQ14p9333DIAOffset_C "offset for conversion ecu -> dia for k3-Conversion: Def_td_ub_q14p9333" VALUE 0xC09F8 Kw_Ws16 65535.00 OneToOne -32768.00 32767.00 FORMAT "%8.2" /end CHARACTERISTIC
/begin CHARACTERISTIC Sig_TdUbQ14p9333DIAScale_C "scale factor for conversion ecu -> dia for k3-Conversion: Def_td_ub_q14p9333" VALUE 0xC09FA Kw_Wu16 7.999878 Fact 0.00 7.999878 FORMAT "%8.6" /end CHARACTERISTIC
/begin CHARACTERISTIC Sig_tExhaustgasDSMOffset_C "offset for conversion ecu -> dsm for exhaust gas temperature, Conversion: Temp_Cels" VALUE 0xC09FC Kw_Ws16 65535.00 OneToOne -32768.00 32767.00 FORMAT "%8.2" /end CHARACTERISTIC
/begin CHARACTERISTIC Sig_tExhaustgasDSMScale_C "scale factor for conversion ecu -> dsm for exhaust gas temperature, Conversion: Temp_Cels" VALUE 0xC09FE Kw_Wu16 7.999878 Fact 0.00 7.999878 FORMAT "%8.6" /end CHARACTERISTIC
/begin CHARACTERISTIC Sig_tExhaustgasCANOffset_C "offset for conversion ecu -> can for exhaust gas temperature, Conversion: Temp_Cels" VALUE 0xC0A00 Kw_Ws16 65535.00 OneToOne -32768.00 32767.00 FORMAT "%8.2" /end CHARACTERISTIC
/begin CHARACTERISTIC Sig_tExhaustgasCANScale_C "scale factor for conversion ecu -> can for exhaust gas temperature, Conversion: Temp_Cels" VALUE 0xC0A02 Kw_Wu16 7.999878 Fact 0.00 7.999878 FORMAT "%8.6" /end CHARACTERISTIC
/begin CHARACTERISTIC Sig_tExhaustgasDIAOffset_C "offset for conversion ecu -> dia for exhaust gas temperature, Conversion: Temp_Cels" VALUE 0xC0A04 Kw_Ws16 65535.00 OneToOne -32768.00 32767.00 FORMAT "%8.2" /end CHARACTERISTIC
/begin CHARACTERISTIC Sig_tExhaustgasDIAScale_C "scale factor for conversion ecu -> dia for exhaust gas temperature, Conversion: Temp_Cels" VALUE 0xC0A06 Kw_Wu16 7.999878 Fact 0.00 7.999878 FORMAT "%8.6" /end CHARACTERISTIC
/begin CHARACTERISTIC Sig_timEngDSMOffset_C "Offset für Umrechnung ecu -> dsm" VALUE 0xC0A08 Kw_Ws16 65535.00 OneToOne -32768.00 32767.00 FORMAT "%8.2" /end CHARACTERISTIC
/begin CHARACTERISTIC Sig_timEngDSMScale_C "Skalierung für Umrechnung ecu -> dsm" VALUE 0xC0A0A Kw_Wu16 7.999878 Fact 0.00 7.999878 FORMAT "%8.6" /end CHARACTERISTIC
/begin CHARACTERISTIC Sig_timEngCANOffset_C "Offset für Umrechnung ecu -> can" VALUE 0xC0A0C Kw_Ws16 65535.00 OneToOne -32768.00 32767.00 FORMAT "%8.2" /end CHARACTERISTIC
/begin CHARACTERISTIC Sig_timEngCANScale_C "Skalierung für Umrechnung ecu -> can" VALUE 0xC0A0E Kw_Wu16 7.999878 Fact 0.00 7.999878 FORMAT "%8.6" /end CHARACTERISTIC
/begin CHARACTERISTIC Sig_timEngDIAOffset_C "Offset für Umrechnung ecu -> dia" VALUE 0xC0A10 Kw_Ws16 65535.00 OneToOne -32768.00 32767.00 FORMAT "%8.2" /end CHARACTERISTIC
/begin CHARACTERISTIC Sig_timEngDIAScale_C "Skalierung für Umrechnung ecu -> dia" VALUE 0xC0A12 Kw_Wu16 7.999878 Fact 0.00 7.999878 FORMAT "%8.6" /end CHARACTERISTIC
/begin CHARACTERISTIC Sig_Time_PwmHighDSMOffset_C "Offset für Umrechnung SG -> DSM" VALUE 0xC0A14 Kw_Ws16 65535.00 OneToOne -32768.00 32767.00 FORMAT "%8.2" /end CHARACTERISTIC
/begin CHARACTERISTIC Sig_Time_PwmHighDSMScale_C "Offset für Umrechnung SG -> DSM" VALUE 0xC0A16 Kw_Wu16 7.999878 Fact 0.00 7.999878 FORMAT "%8.6" /end CHARACTERISTIC
/begin CHARACTERISTIC Sig_Time_PwmHighCANOffset_C "Offset für Umrechnung SG -> CAN" VALUE 0xC0A18 Kw_Ws16 65535.00 OneToOne -32768.00 32767.00 FORMAT "%8.2" /end CHARACTERISTIC
/begin CHARACTERISTIC Sig_Time_PwmHighCANScale_C "Skalierung Umrechnungsfaktor SG -> CAN" VALUE 0xC0A1A Kw_Wu16 7.999878 Fact 0.00 7.999878 FORMAT "%8.6" /end CHARACTERISTIC
/begin CHARACTERISTIC Sig_Time_PwmHighDIAOffset_C "Offset für Umrechnung SG -> Diagnoseschnittstelle" VALUE 0xC0A1C Kw_Ws16 65535.00 OneToOne -32768.00 32767.00 FORMAT "%8.2" /end CHARACTERISTIC
/begin CHARACTERISTIC Sig_Time_PwmHighDIAScale_C "Skalierung Umrechnungsfaktor SG -> Diagnoseschnittstelle" VALUE 0xC0A1E Kw_Wu16 7.999878 Fact 0.00 7.999878 FORMAT "%8.6" /end CHARACTERISTIC
/begin CHARACTERISTIC Sig_timsDSMOffset_C "offset for conversion ecu -> dsm" VALUE 0xC0A20 Kw_Ws16 65535.00 OneToOne -32768.00 32767.00 FORMAT "%8.2" /end CHARACTERISTIC
/begin CHARACTERISTIC Sig_timsDSMScale_C "scale factor for conversion from ecu -> dsm" VALUE 0xC0A22 Kw_Wu16 7.999878 Fact 0.00 7.999878 FORMAT "%8.6" /end CHARACTERISTIC
/begin CHARACTERISTIC Sig_timsCANOffset_C "offset for conversion from ecu -> can" VALUE 0xC0A24 Kw_Ws16 65535.00 OneToOne -32768.00 32767.00 FORMAT "%8.2" /end CHARACTERISTIC
/begin CHARACTERISTIC Sig_timsCANScale_C "scale factor for conversion from ecu -> can" VALUE 0xC0A26 Kw_Wu16 7.999878 Fact 0.00 7.999878 FORMAT "%8.6" /end CHARACTERISTIC
/begin CHARACTERISTIC Sig_timsDIAOffset_C "offset for conversion from ecu -> dia" VALUE 0xC0A28 Kw_Ws16 65535.00 OneToOne -32768.00 32767.00 FORMAT "%8.2" /end CHARACTERISTIC
/begin CHARACTERISTIC Sig_timsDIAScale_C "scale factor for conversion from ecu -> dia" VALUE 0xC0A2A Kw_Wu16 7.999878 Fact 0.00 7.999878 FORMAT "%8.6" /end CHARACTERISTIC
/begin CHARACTERISTIC Sig_tiOprgnu16PFltDSMOffset_C "offset for conversion ecu -> dsm for engine operation time since last successful regeneration, Conversion: tiSncergnRes" VALUE 0xC0A2C Kw_Ws16 65535.00 OneToOne -32768.00 32767.00 FORMAT "%8.2" /end CHARACTERISTIC
/begin CHARACTERISTIC Sig_tiOprgnu16PFltDSMScale_C "Skalierung Umrechnung SG->DSM" VALUE 0xC0A2E Kw_Wu16 7.999878 Fact 0.00 7.999878 FORMAT "%8.6" /end CHARACTERISTIC
/begin CHARACTERISTIC Sig_tiOprgnu16PFltCANOffset_C "offset for conversion ecu -> can for engine operation time since last successful regeneration, Conversion: tiSncergnRes" VALUE 0xC0A30 Kw_Ws16 65535.00 OneToOne -32768.00 32767.00 FORMAT "%8.2" /end CHARACTERISTIC
/begin CHARACTERISTIC Sig_tiOprgnu16PFltCANScale_C "Skalierung Umrechnung SG->CAN" VALUE 0xC0A32 Kw_Wu16 7.999878 Fact 0.00 7.999878 FORMAT "%8.6" /end CHARACTERISTIC
/begin CHARACTERISTIC Sig_tiOprgnu16PFltDIAOffset_C "offset for conversion ecu -> dia for engine operation time since last successful regeneration, Conversion: tiSncergnRes" VALUE 0xC0A34 Kw_Ws16 65535.00 OneToOne -32768.00 32767.00 FORMAT "%8.2" /end CHARACTERISTIC
/begin CHARACTERISTIC Sig_tiOprgnu16PFltDIAScale_C "Skalierung Umrechnung SG->DIA" VALUE 0xC0A36 Kw_Wu16 7.999878 Fact 0.00 7.999878 FORMAT "%8.6" /end CHARACTERISTIC
/begin CHARACTERISTIC Sig_tisDcDSMOffset_C "offset for conversion ecu -> dsm for time in s for DSM (delay driving cycle), Conversion: OneToOne" VALUE 0xC0A38 Kw_Ws16 65535.00 OneToOne -32768.00 32767.00 FORMAT "%8.2" /end CHARACTERISTIC
/begin CHARACTERISTIC Sig_tisDcDSMScale_C "scale factor for conversion ecu -> dsm for time in s for DSM (delay driving cycle), Conversion: OneToOne" VALUE 0xC0A3A Kw_Wu16 7.999878 Fact 0.00 7.999878 FORMAT "%8.6" /end CHARACTERISTIC
/begin CHARACTERISTIC Sig_tisDcCANOffset_C "offset for conversion ecu -> can for time in s for DSM (delay driving cycle), Conversion: OneToOne" VALUE 0xC0A3C Kw_Ws16 65535.00 OneToOne -32768.00 32767.00 FORMAT "%8.2" /end CHARACTERISTIC
/begin CHARACTERISTIC Sig_tisDcCANScale_C "scale factor for conversion ecu -> can for time in s for DSM (delay driving cycle), Conversion: OneToOne" VALUE 0xC0A3E Kw_Wu16 7.999878 Fact 0.00 7.999878 FORMAT "%8.6" /end CHARACTERISTIC
/begin CHARACTERISTIC Sig_tisDcDIAOffset_C "offset for conversion ecu -> dia for time in s for DSM (delay driving cycle), Conversion: OneToOne" VALUE 0xC0A40 Kw_Ws16 65535.00 OneToOne -32768.00 32767.00 FORMAT "%8.2" /end CHARACTERISTIC
/begin CHARACTERISTIC Sig_tisDcDIAScale_C "scale factor for conversion ecu -> dia for time in s for DSM (delay driving cycle), Conversion: OneToOne" VALUE 0xC0A42 Kw_Wu16 7.999878 Fact 0.00 7.999878 FORMAT "%8.6" /end CHARACTERISTIC
/begin CHARACTERISTIC Sig_tisDSMOffset_C "offset for conversion from ecu -> dsm" VALUE 0xC0A44 Kw_Ws16 65535.00 OneToOne -32768.00 32767.00 FORMAT "%8.2" /end CHARACTERISTIC
/begin CHARACTERISTIC Sig_tisDSMScale_C " scale factor for conversion from ecu -> dsm" VALUE 0xC0A46 Kw_Wu16 7.999878 Fact 0.00 7.999878 FORMAT "%8.6" /end CHARACTERISTIC
/begin CHARACTERISTIC Sig_tisCANOffset_C "offset for conversion from ecu -> can" VALUE 0xC0A48 Kw_Ws16 65535.00 OneToOne -32768.00 32767.00 FORMAT "%8.2" /end CHARACTERISTIC
/begin CHARACTERISTIC Sig_tisCANScale_C "scale factor for conversion from ecu -> can" VALUE 0xC0A4A Kw_Wu16 7.999878 Fact 0.00 7.999878 FORMAT "%8.6" /end CHARACTERISTIC
/begin CHARACTERISTIC Sig_tisDIAOffset_C "offset for conversion from ecu -> dia" VALUE 0xC0A4C Kw_Ws16 65535.00 OneToOne -32768.00 32767.00 FORMAT "%8.2" /end CHARACTERISTIC
/begin CHARACTERISTIC Sig_tisDIAScale_C "scale factor for conversion from ecu -> dia" VALUE 0xC0A4E Kw_Wu16 7.999878 Fact 0.00 7.999878 FORMAT "%8.6" /end CHARACTERISTIC
/begin CHARACTERISTIC Sig_trqPrpDSMOffset_C "Offset für Umrechnung SG->DSM für Antriebsmoment" VALUE 0xC0A50 Kw_Ws16 65535.00 OneToOne -32768.00 32767.00 FORMAT "%8.2" /end CHARACTERISTIC
/begin CHARACTERISTIC Sig_trqPrpDSMScale_C "Skalierung für Umrechnung SG->DSM für Antriebsmoment" VALUE 0xC0A52 Kw_Wu16 7.999878 Fact 0.00 7.999878 FORMAT "%8.6" /end CHARACTERISTIC
/begin CHARACTERISTIC Sig_trqPrpCANOffset_C "Offset für Umrechnung SG->CAN für Antriebsmoment" VALUE 0xC0A54 Kw_Ws16 65535.00 OneToOne -32768.00 32767.00 FORMAT "%8.2" /end CHARACTERISTIC
/begin CHARACTERISTIC Sig_trqPrpCANScale_C "Skalierung für Umrechnung SG->CAN für Antriebsmoment" VALUE 0xC0A56 Kw_Wu16 7.999878 Fact 0.00 7.999878 FORMAT "%8.6" /end CHARACTERISTIC
/begin CHARACTERISTIC Sig_trqPrpDIAOffset_C "Offset für Umrechnung SG->DIA für Antriebsmoment" VALUE 0xC0A58 Kw_Ws16 65535.00 OneToOne -32768.00 32767.00 FORMAT "%8.2" /end CHARACTERISTIC
/begin CHARACTERISTIC Sig_trqPrpDIAScale_C "Skalierung für Umrechnung SG->DIA für Antriebsmoment" VALUE 0xC0A5A Kw_Wu16 7.999878 Fact 0.00 7.999878 FORMAT "%8.6" /end CHARACTERISTIC
/begin CHARACTERISTIC Sig_trqDSMOffset_C "Offset Umrechung SG->DSM für Drehmoment" VALUE 0xC0A5C Kw_Ws16 65535.00 OneToOne -32768.00 32767.00 FORMAT "%8.2" /end CHARACTERISTIC
/begin CHARACTERISTIC Sig_trqDSMScale_C "Skalierung Umrechung SG->DSM für Drehmoment" VALUE 0xC0A5E Kw_Wu16 7.999878 Fact 0.00 7.999878 FORMAT "%8.6" /end CHARACTERISTIC
/begin CHARACTERISTIC Sig_trqCANOffset_C "Offset Umrechung SG->CAN für Drehmoment" VALUE 0xC0A60 Kw_Ws16 65535.00 OneToOne -32768.00 32767.00 FORMAT "%8.2" /end CHARACTERISTIC
/begin CHARACTERISTIC Sig_trqCANScale_C "Skalierung Umrechung SG->CAN für Drehmoment" VALUE 0xC0A62 Kw_Wu16 7.999878 Fact 0.00 7.999878 FORMAT "%8.6" /end CHARACTERISTIC
/begin CHARACTERISTIC Sig_trqDIAOffset_C "Offset Umrechung SG->Diagnoseschnittstelle für Drehmoment" VALUE 0xC0A64 Kw_Ws16 65535.00 OneToOne -32768.00 32767.00 FORMAT "%8.2" /end CHARACTERISTIC
/begin CHARACTERISTIC Sig_trqDIAScale_C "Skalierung Umrechung SG->Diagnoseschnittstelle für Drehmoment" VALUE 0xC0A66 Kw_Wu16 7.999878 Fact 0.00 7.999878 FORMAT "%8.6" /end CHARACTERISTIC
/begin CHARACTERISTIC Sig_TSwQ0p1DSMOffset_C "offset for conversion ecu -> dsm for k3-Conversion: Def_t_sw_q0p1" VALUE 0xC0A68 Kw_Ws16 65535.00 OneToOne -32768.00 32767.00 FORMAT "%8.2" /end CHARACTERISTIC
/begin CHARACTERISTIC Sig_TSwQ0p1DSMScale_C "scale factor for conversion ecu -> dsm for k3-Conversion: Def_t_sw_q0p1" VALUE 0xC0A6A Kw_Wu16 7.999878 Fact 0.00 7.999878 FORMAT "%8.6" /end CHARACTERISTIC
/begin CHARACTERISTIC Sig_TSwQ0p1CANOffset_C "offset for conversion ecu -> can for k3-Conversion: Def_t_sw_q0p1" VALUE 0xC0A6C Kw_Ws16 65535.00 OneToOne -32768.00 32767.00 FORMAT "%8.2" /end CHARACTERISTIC
/begin CHARACTERISTIC Sig_TSwQ0p1CANScale_C "scale factor for conversion ecu -> can for k3-Conversion: Def_t_sw_q0p1" VALUE 0xC0A6E Kw_Wu16 7.999878 Fact 0.00 7.999878 FORMAT "%8.6" /end CHARACTERISTIC
/begin CHARACTERISTIC Sig_TSwQ0p1DIAOffset_C "offset for conversion ecu -> dia for k3-Conversion: Def_t_sw_q0p1" VALUE 0xC0A70 Kw_Ws16 65535.00 OneToOne -32768.00 32767.00 FORMAT "%8.2" /end CHARACTERISTIC
/begin CHARACTERISTIC Sig_TSwQ0p1DIAScale_C "scale factor for conversion ecu -> dia for k3-Conversion: Def_t_sw_q0p1" VALUE 0xC0A72 Kw_Wu16 7.999878 Fact 0.00 7.999878 FORMAT "%8.6" /end CHARACTERISTIC
/begin CHARACTERISTIC Sig_tDSMOffset_C "Offset Umrechung SG->DSM für Temperatur" VALUE 0xC0A74 Kw_Ws16 65535.00 OneToOne -32768.00 32767.00 FORMAT "%8.2" /end CHARACTERISTIC
/begin CHARACTERISTIC Sig_tDSMScale_C "Skalierung Umrechung SG->DSM für Temperatur" VALUE 0xC0A76 Kw_Wu16 7.999878 Fact 0.00 7.999878 FORMAT "%8.6" /end CHARACTERISTIC
/begin CHARACTERISTIC Sig_tCANOffset_C "Offset Umrechung SG->CAN für Temperatur" VALUE 0xC0A78 Kw_Ws16 65535.00 OneToOne -32768.00 32767.00 FORMAT "%8.2" /end CHARACTERISTIC
/begin CHARACTERISTIC Sig_tCANScale_C "Skalierung Umrechung SG->CAN für Temperatur" VALUE 0xC0A7A Kw_Wu16 7.999878 Fact 0.00 7.999878 FORMAT "%8.6" /end CHARACTERISTIC
/begin CHARACTERISTIC Sig_tDIAOffset_C "Offset Umrechung SG->Diagnoseschnittstelle für Temperatur" VALUE 0xC0A7C Kw_Ws16 65535.00 OneToOne -32768.00 32767.00 FORMAT "%8.2" /end CHARACTERISTIC
/begin CHARACTERISTIC Sig_tDIAScale_C "Skalierung Umrechung SG->Diagnoseschnittstelle für Temperatur" VALUE 0xC0A7E Kw_Wu16 7.999878 Fact 0.00 7.999878 FORMAT "%8.6" /end CHARACTERISTIC
/begin CHARACTERISTIC Sig_uBattDSMOffset_C "Offset fuer Umrechung SG->DSM fuer Batteriespannung" VALUE 0xC0A80 Kw_Ws16 65535.00 OneToOne -32768.00 32767.00 FORMAT "%8.2" /end CHARACTERISTIC
/begin CHARACTERISTIC Sig_uBattDSMScale_C "Skalierung Umrechungs Faktor SG->DSM fuer Batteriespannung" VALUE 0xC0A82 Kw_Wu16 7.999878 Fact 0.00 7.999878 FORMAT "%8.6" /end CHARACTERISTIC
/begin CHARACTERISTIC Sig_uBattCANOffset_C "Offset fuer Umrechung SG->CAN fuer Batteriespannung" VALUE 0xC0A84 Kw_Ws16 65535.00 OneToOne -32768.00 32767.00 FORMAT "%8.2" /end CHARACTERISTIC
/begin CHARACTERISTIC Sig_uBattCANScale_C "Skalierung Umrechungs Faktor SG->CAN fuer Batteriespannung" VALUE 0xC0A86 Kw_Wu16 7.999878 Fact 0.00 7.999878 FORMAT "%8.6" /end CHARACTERISTIC
/begin CHARACTERISTIC Sig_uBattDIAOffset_C "Offset fuer Umrechung SG->DIA fuer Batteriespannung" VALUE 0xC0A88 Kw_Ws16 65535.00 OneToOne -32768.00 32767.00 FORMAT "%8.2" /end CHARACTERISTIC
/begin CHARACTERISTIC Sig_uBattDIAScale_C "Skalierung Umrechungs Faktor SG->DIA fuer Batteriespannung" VALUE 0xC0A8A Kw_Wu16 7.999878 Fact 0.00 7.999878 FORMAT "%8.6" /end CHARACTERISTIC
/begin CHARACTERISTIC Sig_UUwQ0p1DSMOffset_C "offset for conversion ecu -> dsm for k3-Conversion Def_u_uw_q0p1" VALUE 0xC0A8C Kw_Ws16 65535.00 OneToOne -32768.00 32767.00 FORMAT "%8.2" /end CHARACTERISTIC
/begin CHARACTERISTIC Sig_UUwQ0p1DSMScale_C "scale factor for conversion ecu -> dsm for k3-Conversion Def_u_uw_q0p1" VALUE 0xC0A8E Kw_Wu16 7.999878 Fact 0.00 7.999878 FORMAT "%8.6" /end CHARACTERISTIC
/begin CHARACTERISTIC Sig_UUwQ0p1CANOffset_C "offset for conversion ecu -> can for k3-Conversion Def_u_uw_q0p1" VALUE 0xC0A90 Kw_Ws16 65535.00 OneToOne -32768.00 32767.00 FORMAT "%8.2" /end CHARACTERISTIC
/begin CHARACTERISTIC Sig_UUwQ0p1CANScale_C "scale factor for conversion ecu -> can for k3-Conversion Def_u_uw_q0p1" VALUE 0xC0A92 Kw_Wu16 7.999878 Fact 0.00 7.999878 FORMAT "%8.6" /end CHARACTERISTIC
/begin CHARACTERISTIC Sig_UUwQ0p1DIAOffset_C "offset for conversion ecu -> dia for k3-Conversion Def_u_uw_q0p1" VALUE 0xC0A94 Kw_Ws16 65535.00 OneToOne -32768.00 32767.00 FORMAT "%8.2" /end CHARACTERISTIC
/begin CHARACTERISTIC Sig_UUwQ0p1DIAScale_C "scale factor for conversion ecu -> dia for k3-Conversion Def_u_uw_q0p1" VALUE 0xC0A96 Kw_Wu16 7.999878 Fact 0.00 7.999878 FORMAT "%8.6" /end CHARACTERISTIC
/begin CHARACTERISTIC Sig_UUwQ0p25em3DSMOffset_C "offset for conversion ecu -> dsm for k3-Conversion Def_u_uw_q0p25em3_o6" VALUE 0xC0A98 Kw_Ws16 65535.00 OneToOne -32768.00 32767.00 FORMAT "%8.2" /end CHARACTERISTIC
/begin CHARACTERISTIC Sig_UUwQ0p25em3DSMScale_C "scale factor for conversion ecu -> dsm for k3-Conversion Def_u_uw_q0p25em3_o6" VALUE 0xC0A9A Kw_Wu16 7.999878 Fact 0.00 7.999878 FORMAT "%8.6" /end CHARACTERISTIC
/begin CHARACTERISTIC Sig_UUwQ0p25em3CANOffset_C "offset for conversion ecu -> can for k3-Conversion Def_u_uw_q0p25em3_o6" VALUE 0xC0A9C Kw_Ws16 65535.00 OneToOne -32768.00 32767.00 FORMAT "%8.2" /end CHARACTERISTIC
/begin CHARACTERISTIC Sig_UUwQ0p25em3CANScale_C "scale factor for conversion ecu -> can for k3-Conversion Def_u_uw_q0p25em3_o6" VALUE 0xC0A9E Kw_Wu16 7.999878 Fact 0.00 7.999878 FORMAT "%8.6" /end CHARACTERISTIC
/begin CHARACTERISTIC Sig_UUwQ0p25em3DIAOffset_C "offset for conversion ecu -> dia for k3-Conversion Def_u_uw_q0p25em3_o6" VALUE 0xC0AA0 Kw_Ws16 65535.00 OneToOne -32768.00 32767.00 FORMAT "%8.2" /end CHARACTERISTIC
/begin CHARACTERISTIC Sig_UUwQ0p25em3DIAScale_C "scale factor for conversion ecu -> dia for k3-Conversion Def_u_uw_q0p25em3_o6" VALUE 0xC0AA2 Kw_Wu16 7.999878 Fact 0.00 7.999878 FORMAT "%8.6" /end CHARACTERISTIC
/begin CHARACTERISTIC Sig_uDSMOffset_C "Offset Umrechung SG->DSM für Spannung" VALUE 0xC0AA4 Kw_Ws16 65535.00 OneToOne -32768.00 32767.00 FORMAT "%8.2" /end CHARACTERISTIC
/begin CHARACTERISTIC Sig_uDSMScale_C "Skalierung Umrechung SG->DSM für Spannungen" VALUE 0xC0AA6 Kw_Wu16 7.999878 Fact 0.00 7.999878 FORMAT "%8.6" /end CHARACTERISTIC
/begin CHARACTERISTIC Sig_uCANOffset_C "Offset Umrechung SG->CAN für Spannung" VALUE 0xC0AA8 Kw_Ws16 65535.00 OneToOne -32768.00 32767.00 FORMAT "%8.2" /end CHARACTERISTIC
/begin CHARACTERISTIC Sig_uCANScale_C "Skalierung Umrechung SG->CAN für Spannung" VALUE 0xC0AAA Kw_Wu16 7.999878 Fact 0.00 7.999878 FORMAT "%8.6" /end CHARACTERISTIC
/begin CHARACTERISTIC Sig_uDIAOffset_C "Offset Umrechung SG->Diagnoseschnittstelle für Spannung" VALUE 0xC0AAC Kw_Ws16 65535.00 OneToOne -32768.00 32767.00 FORMAT "%8.2" /end CHARACTERISTIC
/begin CHARACTERISTIC Sig_uDIAScale_C "Skalierung Umrechung SG->Diagnoseschnittstelle für Spannung" VALUE 0xC0AAE Kw_Wu16 7.999878 Fact 0.00 7.999878 FORMAT "%8.6" /end CHARACTERISTIC
/begin CHARACTERISTIC Sig_volphDSMOffset_C "Offset für Umrechnung SG->DSM für Kubikmeter pro Stunde" VALUE 0xC0AB0 Kw_Ws16 65535.00 OneToOne -32768.00 32767.00 FORMAT "%8.2" /end CHARACTERISTIC
/begin CHARACTERISTIC Sig_volphDSMScale_C "Skalierung Umrechung SG->DSM für Kubikmeter pro Stunde" VALUE 0xC0AB2 Kw_Wu16 7.999878 Fact 0.00 7.999878 FORMAT "%8.6" /end CHARACTERISTIC
/begin CHARACTERISTIC Sig_volphCANOffset_C "Offset für Umrechnung SG->CAN für Kubikmeter pro Stunde" VALUE 0xC0AB4 Kw_Ws16 65535.00 OneToOne -32768.00 32767.00 FORMAT "%8.2" /end CHARACTERISTIC
/begin CHARACTERISTIC Sig_volphCANScale_C "Skalierung Umrechung SG->CAN für Kubikmeter pro Stunde" VALUE 0xC0AB6 Kw_Wu16 7.999878 Fact 0.00 7.999878 FORMAT "%8.6" /end CHARACTERISTIC
/begin CHARACTERISTIC Sig_volphDIAOffset_C "Offset für Umrechnung SG->Diagnoseschnittstelle für Kubikmeter pro Stunde" VALUE 0xC0AB8 Kw_Ws16 65535.00 OneToOne -32768.00 32767.00 FORMAT "%8.2" /end CHARACTERISTIC
/begin CHARACTERISTIC Sig_volphDIAScale_C "Skalierung Umrechung SG->Diagnoseschnittstelle für Kubikmeter pro Stunde" VALUE 0xC0ABA Kw_Wu16 7.999878 Fact 0.00 7.999878 FORMAT "%8.6" /end CHARACTERISTIC
/begin CHARACTERISTIC Sig_volRailDSMOffset_C "Offset für Umrechnung SG->DSM für Volumen (Rail)" VALUE 0xC0ABC Kw_Ws16 65535.00 OneToOne -32768.00 32767.00 FORMAT "%8.2" /end CHARACTERISTIC
/begin CHARACTERISTIC Sig_volRailDSMScale_C "Skalierung Umrechung SG->DSM für Volumen (Rail)" VALUE 0xC0ABE Kw_Wu16 7.999878 Fact 0.00 7.999878 FORMAT "%8.6" /end CHARACTERISTIC
/begin CHARACTERISTIC Sig_volRailCANOffset_C "Offset für Umrechnung SG->CAN für Volumen (Rail)" VALUE 0xC0AC0 Kw_Ws16 65535.00 OneToOne -32768.00 32767.00 FORMAT "%8.2" /end CHARACTERISTIC
/begin CHARACTERISTIC Sig_volRailCANScale_C "Skalierung Umrechung SG->CAN für Volumen (Rail)" VALUE 0xC0AC2 Kw_Wu16 7.999878 Fact 0.00 7.999878 FORMAT "%8.6" /end CHARACTERISTIC
/begin CHARACTERISTIC Sig_volRailDIAOffset_C "Offset für Umrechnung SG->Diagnoseschnittstelle für Volumen (Rail)" VALUE 0xC0AC4 Kw_Ws16 65535.00 OneToOne -32768.00 32767.00 FORMAT "%8.2" /end CHARACTERISTIC
/begin CHARACTERISTIC Sig_volRailDIAScale_C "Skalierung Umrechung SG->Diagnoseschnittstelle für Volumen (Rail)" VALUE 0xC0AC6 Kw_Wu16 7.999878 Fact 0.00 7.999878 FORMAT "%8.6" /end CHARACTERISTIC
/begin CHARACTERISTIC Sig_volDSMOffset_C "Offset Umrechnung der Volumsmenge SG -> DSM" VALUE 0xC0AC8 Kw_Ws16 65535.00 OneToOne -32768.00 32767.00 FORMAT "%8.2" /end CHARACTERISTIC
/begin CHARACTERISTIC Sig_volDSMScale_C "Skalierung Umrechnung der Volumsmenge SG -> DSM" VALUE 0xC0ACA Kw_Wu16 7.999878 Fact 0.00 7.999878 FORMAT "%8.6" /end CHARACTERISTIC
/begin CHARACTERISTIC Sig_volCANOffset_C "Offset Umrechnung der Volumsmenge SG -> CAN" VALUE 0xC0ACC Kw_Ws16 65535.00 OneToOne -32768.00 32767.00 FORMAT "%8.2" /end CHARACTERISTIC
/begin CHARACTERISTIC Sig_volCANScale_C "Skalierung Umrechnung der Volumsmenge SG -> CAN" VALUE 0xC0ACE Kw_Wu16 7.999878 Fact 0.00 7.999878 FORMAT "%8.6" /end CHARACTERISTIC
/begin CHARACTERISTIC Sig_volDIAOffset_C "Offset Umrechnung der Volumsmenge SG -> DIA" VALUE 0xC0AD0 Kw_Ws16 65535.00 OneToOne -32768.00 32767.00 FORMAT "%8.2" /end CHARACTERISTIC
/begin CHARACTERISTIC Sig_volDIAScale_C "Skalierung Umrechnung der Volumsmenge SG -> DIA" VALUE 0xC0AD2 Kw_Wu16 7.999878 Fact 0.00 7.999878 FORMAT "%8.6" /end CHARACTERISTIC
/begin CHARACTERISTIC Sig_vDSMOffset_C "Offset Umrechung SG->DSM für Fahrgeschwindigkeit" VALUE 0xC0AD4 Kw_Ws16 65535.00 OneToOne -32768.00 32767.00 FORMAT "%8.2" /end CHARACTERISTIC
/begin CHARACTERISTIC Sig_vDSMScale_C "Skalierung Umrechung SG->DSM für Fahrgeschwindigkeit" VALUE 0xC0AD6 Kw_Wu16 7.999878 Fact 0.00 7.999878 FORMAT "%8.6" /end CHARACTERISTIC
/begin CHARACTERISTIC Sig_vCANOffset_C "Offset Umrechung SG->CAN für Fahrgeschwindigkeit" VALUE 0xC0AD8 Kw_Ws16 65535.00 OneToOne -32768.00 32767.00 FORMAT "%8.2" /end CHARACTERISTIC
/begin CHARACTERISTIC Sig_vCANScale_C "Skalierung Umrechung SG->CAN für Fahrgeschwindigkeit" VALUE 0xC0ADA Kw_Wu16 7.999878 Fact 0.00 7.999878 FORMAT "%8.6" /end CHARACTERISTIC
/begin CHARACTERISTIC Sig_vDIAOffset_C "Offset Umrechung SG->Diagnoseschnittstelle für Fahrgeschwindigkeit" VALUE 0xC0ADC Kw_Ws16 65535.00 OneToOne -32768.00 32767.00 FORMAT "%8.2" /end CHARACTERISTIC
/begin CHARACTERISTIC Sig_vDIAScale_C "Skalierung Umrechung SG->Diagnoseschnittstelle für Fahrgeschwindigkeit" VALUE 0xC0ADE Kw_Wu16 7.999878 Fact 0.00 7.999878 FORMAT "%8.6" /end CHARACTERISTIC
/begin CHARACTERISTIC SOPTst_stRcyDem_C "Applizierbares Label, ob Recovery bei fehlerhaftem Abschaltpfadtest ausgelöst werden soll" VALUE 0xF876D Kw_Wu8 1.000 OneToOne 0.00 1.000 FORMAT "%5.3" EXTENDED_LIMITS 0.00 255.0 /end CHARACTERISTIC
/begin CHARACTERISTIC SOPTst_stShOffPathActv_C "aktive Abschaltpfade während der Initialisierung" VALUE 0xF876E Kw_Wu8 255.0 OneToOne 0.00 255.0 FORMAT "%5.1" /end CHARACTERISTIC
/begin CHARACTERISTIC SPMon_swtRstStackMon_C "Schalter zum Rücksetzen der Überwachung des maximal benötigten Stacks (1: Stack Überwachung rückgesetzt, 0: nicht Rückgesetzt)" VALUE 0xF876F Kw_Wu8 1.000 OneToOne 0.00 1.000 FORMAT "%5.3" EXTENDED_LIMITS 0.00 255.0 /end CHARACTERISTIC
/begin MEASUREMENT Rail_dpSetPointInc "maximaler Raildruck-Sollwertanstieg pro Sekunde" SWORD PresRail_sec 1 100 -13107.200 13106.800 FORMAT "%5.3" ECU_ADDRESS 0x7F9280 /end MEASUREMENT
/begin MEASUREMENT Rail_dvolInjVlvCtl_mp "Korrekturwert der Vorsteuerung unter Berücksichtigung der Steuermengen für die Injektoren" SWORD Qp_mm3_sec 1 100 -327680.0 327670.0 FORMAT "%8.1" ECU_ADDRESS 0x6F8310 /end MEASUREMENT
/begin MEASUREMENT Rail_dvolLeak_mp "Leckage des Hochdrucksystems" SWORD Qp_mm3_sec 1 100 -327680.0 327670.0 FORMAT "%8.1" ECU_ADDRESS 0x6F8312 /end MEASUREMENT
/begin MEASUREMENT Rail_dvolPreCtlBas_mp "Basisvorsteuerwert aus Kennfeld für die Druckregelung über Zumesseinheit" SWORD Qp_mm3_sec 1 100 -327680.0 327670.0 FORMAT "%8.1" ECU_ADDRESS 0x6F8314 /end MEASUREMENT
/begin MEASUREMENT Rail_dvolPreCtlInit_mp "Initialisierungswert der Vorsteuerung für die Druckregelung über Zumesseinheit" SWORD Qp_mm3_sec 1 100 -327680.0 327670.0 FORMAT "%8.1" ECU_ADDRESS 0x6F8316 /end MEASUREMENT
/begin MEASUREMENT Rail_dvolPreCtlOfs_mp "Offset aus Kennfeld für die Vorsteuerung der Druckregelung über Zumesseinheit" SWORD Qp_mm3_sec 1 100 -327680.0 327670.0 FORMAT "%8.1" ECU_ADDRESS 0x6F8318 /end MEASUREMENT
/begin MEASUREMENT Rail_dvolPreCtlPoI1_mp "Vorsteuerwert abhängig von der Nacheinspritzmenge 1 für die Druckregelung über Zumesseinheit" SWORD Qp_mm3_sec 1 100 -327680.0 327670.0 FORMAT "%8.1" ECU_ADDRESS 0x6F831A /end MEASUREMENT
/begin MEASUREMENT Rail_dvolPreCtlPoI2_mp "Vorsteuerwert abhängig von der Nacheinspritzmenge 2 für die Druckregelung über Zumesseinheit" SWORD Qp_mm3_sec 1 100 -327680.0 327670.0 FORMAT "%8.1" ECU_ADDRESS 0x6F831C /end MEASUREMENT
/begin MEASUREMENT Rail_facAPSetPDynCor_mp "Gewichtungsfaktor - Atmosphärendruck-abhängiger Korrekturwert" SWORD Fact 1 100 -4.000000 3.999878 FORMAT "%8.6" ECU_ADDRESS 0x8FF41C /end MEASUREMENT
/begin MEASUREMENT Rail_facDQSetPDynCor_mp "Gewichtungsfaktor - Einspritzmengengradient-abhängiger Korrekturwert" SWORD Fact 1 100 -4.000000 3.999878 FORMAT "%8.6" ECU_ADDRESS 0x8FF41E /end MEASUREMENT
/begin MEASUREMENT Rail_facETSetPDynCor_mp "Gewichtungsfaktor - Motortemperatur-anhängiger Korrekturwert" SWORD Fact 1 100 -4.000000 3.999878 FORMAT "%8.6" ECU_ADDRESS 0x8FF420 /end MEASUREMENT
/begin MEASUREMENT Rail_facIASetPDynCor_mp "lufttemperatursollwertabhängiger Korrekturfaktor" SWORD Fact 1 100 -4.000000 3.999878 FORMAT "%8.6" ECU_ADDRESS 0x8FF422 /end MEASUREMENT
/begin MEASUREMENT Rail_facPCVTiRmpVal_mp "aktueller Rampenwert der Rampe bei Umschaltung von Regelung über Druckregelventil auf Regelung über Zumesseinheit" SWORD Fact 1 100 -4.000000 3.999878 FORMAT "%8.6" ECU_ADDRESS 0x8FF3F8 /end MEASUREMENT
/begin MEASUREMENT Rail_facSetPointAPSCor "Gewichtungsfaktor für atmosphärendruckabhängige Sollwertkorrektur des Raildrucks" SWORD Fact 1 100 -4.000000 3.999878 FORMAT "%8.6" ECU_ADDRESS 0x7F9292 /end MEASUREMENT
/begin MEASUREMENT Rail_facSetPointAPSCStrt "Gewichtungsfaktor für atmosphärendruckabhängige Sollwertkorrektur des Raildrucks beim Start" SWORD Fact 1 100 -4.000000 3.999878 FORMAT "%8.6" ECU_ADDRESS 0x7F9290 /end MEASUREMENT
/begin MEASUREMENT Rail_facSetPointATSCor "Gewichtungsfaktor für ansauglufttemperaturabhängige Sollwertkorrektur des Raildrucks" SWORD Fact 1 100 -4.000000 3.999878 FORMAT "%8.6" ECU_ADDRESS 0x7F9296 /end MEASUREMENT
/begin MEASUREMENT Rail_facSetPointATSCStrt "Gewichtungsfaktor für ansauglufttemperaturabhängige Sollwertkorrektur des Raildrucks beim Start" SWORD Fact 1 100 -4.000000 3.999878 FORMAT "%8.6" ECU_ADDRESS 0x7F9294 /end MEASUREMENT
/begin MEASUREMENT Rail_facSetPointETSCor "Gewichtungsfaktor für motortemperaturabhängige Sollwertkorrektur des Raildrucks" SWORD Fact 1 100 -4.000000 3.999878 FORMAT "%8.6" ECU_ADDRESS 0x7F929A /end MEASUREMENT
/begin MEASUREMENT Rail_facSetPointETSCor1 "correction factor of rail pressure setpoint depending on coolant temperature" SWORD Fact 1 100 -4.000000 3.999878 FORMAT "%8.6" ECU_ADDRESS 0x7F929C /end MEASUREMENT
/begin MEASUREMENT Rail_facSetPointETSCStrt "correction factor of rail pressure setpoint depending on engine temperature" SWORD Fact 1 100 -4.000000 3.999878 FORMAT "%8.6" ECU_ADDRESS 0x7F9298 /end MEASUREMENT
/begin MEASUREMENT Rail_facSetPointFTSCor_mp "Gewichtungsfaktor für kraftstofftemperaturabhängige Sollwertkorrektur des Raildruckreglers" SWORD Fact 1 100 -4.000000 3.999878 FORMAT "%8.6" ECU_ADDRESS 0x8FF424 /end MEASUREMENT
/begin MEASUREMENT Rail_facTiRmpVal_mp "aktueller Rampenwert wenn von Offset-Kennlinie auf Reduzierter Offset-Kennlinie und andersherum gerampt wird" SWORD Fact 1 100 -4.000000 3.999878 FORMAT "%8.6" ECU_ADDRESS 0x8FF3FA /end MEASUREMENT
/begin MEASUREMENT Rail_pChamWllTempCorr_mp "Messpunkt für den Druck für die Brennraumwandtemperaturkorrektur" SWORD Pres_Rail 1 100 -3276.800 3276.700 FORMAT "%5.3" ECU_ADDRESS 0x8FF426 /end MEASUREMENT
/begin MEASUREMENT Rail_pNIPCVMax_mp "Ausgang des Kennfelds Rail_pNIPCVMax_MAP" SWORD Pres_Rail 1 100 -3276.800 3276.700 FORMAT "%5.3" ECU_ADDRESS 0x6F82FE /end MEASUREMENT
/begin MEASUREMENT Rail_pNIPCVMin_mp "Ausgang des Kennfelds Rail_pNIPCVMax_MAP" SWORD Pres_Rail 1 100 -3276.800 3276.700 FORMAT "%5.3" ECU_ADDRESS 0x8FF3EC /end MEASUREMENT
/begin MEASUREMENT Rail_pPCVClose_mp "Steuergröße um das Druckregelventil geschlossen zu halten" SWORD Pres_Rail 1 100 -3276.800 3276.700 FORMAT "%5.3" ECU_ADDRESS 0x6F8320 /end MEASUREMENT
/begin MEASUREMENT Rail_pPCVDvtMax_mp "Ausgang der Kennlinie Rail_pPCVDvtMax_CUR" SWORD Pres_Rail 1 100 -3276.800 3276.700 FORMAT "%5.3" ECU_ADDRESS 0x6F8300 /end MEASUREMENT
/begin MEASUREMENT Rail_pPCVOfs_mp "Rampenschalterausgang für die Steuergröße um das Druckregelventil geschlossen zu halten" SWORD Pres_Rail 1 100 -3276.800 3276.700 FORMAT "%5.3" ECU_ADDRESS 0x8FF3FC /end MEASUREMENT
/begin MEASUREMENT Rail_pPCVPeakMin_mp "Ausgang der Kennlinie Rail_pPCVPeakMin_CUR" SWORD Pres_Rail 1 100 -3276.800 3276.700 FORMAT "%5.3" ECU_ADDRESS 0x6F8302 /end MEASUREMENT
/begin MEASUREMENT Rail_pPCVRedOfs_mp "Messpunkt für Vorsteuerreduzierung für schnelleren Druckabbau über das Druckregelventil" SWORD Pres_Rail 1 100 -3276.800 3276.700 FORMAT "%5.3" ECU_ADDRESS 0x8FF3FE /end MEASUREMENT
/begin MEASUREMENT Rail_pPCVSetMax_mp "maximal zulässiger Solldruck für die Raildrucküberwachung" SWORD Pres_Rail 1 100 -3276.800 3276.700 FORMAT "%5.3" ECU_ADDRESS 0x8FF3EE /end MEASUREMENT
/begin MEASUREMENT Rail_pPreCtl_mp "Vorsteuerwert für die Druckregelung über Druckregelventil" SWORD Pres_Rail 1 100 -3276.800 3276.700 FORMAT "%5.3" ECU_ADDRESS 0x6F8322 /end MEASUREMENT
/begin MEASUREMENT Rail_pSetPDynCor_mp "dynamischer, additiver Korrekturwert" SWORD Pres_Rail 1 100 -3276.800 3276.700 FORMAT "%5.3" ECU_ADDRESS 0x8FF428 /end MEASUREMENT
/begin MEASUREMENT Rail_pSetPoint "Raildruck-sollwert" SWORD Pres_Rail 1 100 -3276.800 3276.700 FORMAT "%5.3" ECU_ADDRESS 0x7F92A8 /end MEASUREMENT
/begin MEASUREMENT Rail_pSetPointAddCor "Schnittstelle für Erweiterungen der Korrekturen für den Raildrucksollwert" SWORD Pres_Rail 1 100 -3276.800 3276.700 FORMAT "%5.3" ECU_ADDRESS 0x7F92AA /end MEASUREMENT
/begin MEASUREMENT Rail_pSetPointAPSCor_mp "Raildruck-Korrekturwert, abhängig vom Atmosphärendruck" SWORD Pres_Rail 1 100 -3276.800 3276.700 FORMAT "%5.3" ECU_ADDRESS 0x8FF42C /end MEASUREMENT
/begin MEASUREMENT Rail_pSetPointAPSCStrt_mp "Raildruck-Korrekturwert, abhängig vom Atmosphärendruck beim Start" SWORD Pres_Rail 1 100 -3276.800 3276.700 FORMAT "%5.3" ECU_ADDRESS 0x8FF42E /end MEASUREMENT
/begin MEASUREMENT Rail_pSetPointATSCor_mp "Raildruck-Korrekturwert, abhängig von der Ansauglufttemperatur" SWORD Pres_Rail 1 100 -3276.800 3276.700 FORMAT "%5.3" ECU_ADDRESS 0x8FF430 /end MEASUREMENT
/begin MEASUREMENT Rail_pSetPointATSCStrt_mp "Raildruck-Korrekturwert, abhängig von der Ansauglufttemperatur beim Start" SWORD Pres_Rail 1 100 -3276.800 3276.700 FORMAT "%5.3" ECU_ADDRESS 0x8FF432 /end MEASUREMENT
/begin MEASUREMENT Rail_pSetPointBase_mp "Basissollwert des Raildrucks" SWORD Pres_Rail 1 100 -3276.800 3276.700 FORMAT "%5.3" ECU_ADDRESS 0x8FF408 /end MEASUREMENT
/begin MEASUREMENT Rail_pSetPointBattMin_mp "batteriespannungsabhängig korrigierter Raildruck-Sollwert" SWORD Pres_Rail 1 100 -3276.800 3276.700 FORMAT "%5.3" ECU_ADDRESS 0x8FF40A /end MEASUREMENT
/begin MEASUREMENT Rail_pSetPointCor_mp "korrigierter Raildruck Sollwert, abhängig vom projektspezifischen Eingriff und von Umgebungsbedingungen" SWORD Pres_Rail 1 100 -3276.800 3276.700 FORMAT "%5.3" ECU_ADDRESS 0x8FF40C /end MEASUREMENT
/begin MEASUREMENT Rail_pSetPointDec_mp "maximaler Raildruck-Sollwertabfall pro Schedulesequenz" SWORD Pres_Rail 1 100 -3276.800 3276.700 FORMAT "%5.3" ECU_ADDRESS 0x8FF40E /end MEASUREMENT
/begin MEASUREMENT Rail_pSetPointDynLim_mp "Raildruck Sollwert mir dynamischer Begrenzung" SWORD Pres_Rail 1 100 -3276.800 3276.700 FORMAT "%5.3" ECU_ADDRESS 0x8FF410 /end MEASUREMENT
/begin MEASUREMENT Rail_pSetPointEnvCor "Raildruck-Korrekturwert, abhängig von den Umgebungsbedingungen" SWORD Pres_Rail 1 100 -3276.800 3276.700 FORMAT "%5.3" ECU_ADDRESS 0x7F92AC /end MEASUREMENT
/begin MEASUREMENT Rail_pSetPointEnvCorStrt "Raildruck-Korrekturwert, abhängig von den Umgebungsbedingungen beim Start" SWORD Pres_Rail 1 100 -3276.800 3276.700 FORMAT "%5.3" ECU_ADDRESS 0x7F92AE /end MEASUREMENT
/begin MEASUREMENT Rail_pSetPointETSCor1_mp "correction value of rail pressure setpoint depending on ETS" SWORD Pres_Rail 1 100 -3276.800 3276.700 FORMAT "%5.3" ECU_ADDRESS 0x8FF434 /end MEASUREMENT
/begin MEASUREMENT Rail_pSetPointETSCor_mp "Raildruck-Korrekturwert, abhängig von der Motortemperatur" SWORD Pres_Rail 1 100 -3276.800 3276.700 FORMAT "%5.3" ECU_ADDRESS 0x8FF436 /end MEASUREMENT
/begin MEASUREMENT Rail_pSetPointETSCStrt_mp "correction value of rail pressure setpoint depending on ETS start" SWORD Pres_Rail 1 100 -3276.800 3276.700 FORMAT "%5.3" ECU_ADDRESS 0x8FF438 /end MEASUREMENT
/begin MEASUREMENT Rail_pSetPointFlTempCor "Raildruck-Korrekturwert, abhängig von der Kraftstofftemperatur" SWORD Pres_Rail 1 100 -3276.800 3276.700 FORMAT "%5.3" ECU_ADDRESS 0x7F92B0 /end MEASUREMENT
/begin MEASUREMENT Rail_pSetPointFlTempCor_mp "korrigierter Raildruck Sollwert, abhängig von der Kraftstofftemperatur" SWORD Pres_Rail 1 100 -3276.800 3276.700 FORMAT "%5.3" ECU_ADDRESS 0x8FF412 /end MEASUREMENT
/begin MEASUREMENT Rail_pSetPointFlTempLim "Begrenzter Raildruck-Sollwert unter Berücksichtigung der Kraftstofftemperatur-Korrektur" SWORD Pres_Rail 1 100 -3276.800 3276.700 FORMAT "%5.3" ECU_ADDRESS 0x7F92B2 /end MEASUREMENT
/begin MEASUREMENT Rail_pSetPointFlTempUnlim "unbegrenzter Raildruck-Sollwert unter Berücksichtigung der Kraftstofftemperatur-Korrektur" SWORD Pres_Rail 1 100 -3276.800 3276.700 FORMAT "%5.3" ECU_ADDRESS 0x7F92B4 /end MEASUREMENT
/begin MEASUREMENT Rail_pSetPointInc_mp "maximaler Raildruck-Sollwertanstieg pro Schedulesequenz" SWORD Pres_Rail 1 100 -3276.800 3276.700 FORMAT "%5.3" ECU_ADDRESS 0x8FF414 /end MEASUREMENT
/begin MEASUREMENT Rail_pSetPointLimNFlTemp "maximaler Raildrucksollwert, abhängig von der Kraftstofftemperatur und der Motordrehzahl" SWORD Pres_Rail 1 100 -3276.800 3276.700 FORMAT "%5.3" ECU_ADDRESS 0x7F92B6 /end MEASUREMENT
/begin MEASUREMENT Rail_pSetPointLim_mp "Raildrucksollwert nach Bereichsbegrenzung im Normalbetrieb" SWORD Pres_Rail 1 100 -3276.800 3276.700 FORMAT "%5.3" ECU_ADDRESS 0x8FF416 /end MEASUREMENT
/begin MEASUREMENT Rail_pSetPointMax "maximaler Raildrucksollwert" SWORD Pres_Rail 1 100 -3276.800 3276.700 FORMAT "%5.3" ECU_ADDRESS 0x7F92B8 /end MEASUREMENT
/begin MEASUREMENT Rail_pSetPointMaxDef_mp "maximaler Raildruck-Sollwert im Fehlerfall" SWORD Pres_Rail 1 100 -3276.800 3276.700 FORMAT "%5.3" ECU_ADDRESS 0x8FF42A /end MEASUREMENT
/begin MEASUREMENT Rail_pSetPointMin "minimaler Raildrucksollwert" SWORD Pres_Rail 1 100 -3276.800 3276.700 FORMAT "%5.3" ECU_ADDRESS 0x7F92BA /end MEASUREMENT
/begin MEASUREMENT Rail_pSetPointOut_mp "Raildruck-Sollwert nach Eingriff der Regeneration" SWORD Pres_Rail 1 100 -3276.800 3276.700 FORMAT "%5.3" ECU_ADDRESS 0x8FF418 /end MEASUREMENT
/begin MEASUREMENT Rail_pSetPointRgn "Raildruck-Sollwert im Regenerationsbetrieb" SWORD Pres_Rail 1 100 -3276.800 3276.700 FORMAT "%5.3" ECU_ADDRESS 0x7F92BC /end MEASUREMENT
/begin MEASUREMENT Rail_pSetPointSubst "Externe Anforderung für den Raildruck-Sollwert" SWORD Pres_Rail 1 100 -3276.800 3276.700 FORMAT "%5.3" ECU_ADDRESS 0x7F92BE /end MEASUREMENT
/begin MEASUREMENT Rail_pSetPointZFC_mp "Raildrucksollwert nach Eingriff der Nullmengenkalibrierung" SWORD Pres_Rail 1 100 -3276.800 3276.700 FORMAT "%5.3" ECU_ADDRESS 0x6F8324 /end MEASUREMENT
/begin MEASUREMENT Rail_pZFCInit_mp "anfänglicher ZFC Raildrucksollwert für PT1 Filter" SWORD Pres_Rail 1 100 -3276.800 3276.700 FORMAT "%5.3" ECU_ADDRESS 0x8FF43A /end MEASUREMENT
/begin MEASUREMENT Rail_qPreCtlBas_mp "ausgewählte Einspritzmenge für die Vorsteuerung" SWORD InjMassCyc 1 100 -327.6800 327.6700 FORMAT "%8.4" ECU_ADDRESS 0x6F831E /end MEASUREMENT
/begin MEASUREMENT Rail_RgnVal_mp "Wert für Regenerationsstatus der Raildrucksollwertes" ULONG EGTSwt 1 100 0.00 262.143999939 FORMAT "%13.9" ECU_ADDRESS 0x8FF404 /end MEASUREMENT
/begin MEASUREMENT Rail_SetPointRed_mp "increase minimum time if Fid_RailSetPointRed is active" UBYTE OneToOne 1 100 0.00 255.0 FORMAT "%5.1" ECU_ADDRESS 0x8FF41A /end MEASUREMENT
/begin MEASUREMENT Rail_stCtlType "Status Regelkonzept und verwendetes Regelprinzip" UBYTE OneToOne 1 100 0.00 255.0 FORMAT "%5.1" ECU_ADDRESS 0x7F8A16 /end MEASUREMENT
/begin MEASUREMENT Rail_stPCVMon0_mp "Zustandsbits für Überwachung auf positive Regelabweichung" UBYTE OneToOne 1 100 0.00 255.0 FORMAT "%5.1" ECU_ADDRESS 0x8FF3F0 /end MEASUREMENT
/begin MEASUREMENT Rail_stPCVMon1_mp "Zustandsbits für Überwachung auf positive Regelabweichung kombiniert mit Stellgröße des Druckregelventils" UBYTE OneToOne 1 100 0.00 255.0 FORMAT "%5.1" ECU_ADDRESS 0x8FF3F1 /end MEASUREMENT
/begin MEASUREMENT Rail_stPCVMon2_mp "Zustandsbits für Überwachung auf negative Regelabweichung kombiniert mit Stellgröße des Druckregelventils" UBYTE OneToOne 1 100 0.00 255.0 FORMAT "%5.1" ECU_ADDRESS 0x8FF3F2 /end MEASUREMENT
/begin MEASUREMENT Rail_stPCVMon3_mp "Zustandsbits für Überwachung auf minimalen Raildruck" UBYTE OneToOne 1 100 0.00 255.0 FORMAT "%5.1" ECU_ADDRESS 0x8FF3F3 /end MEASUREMENT
/begin MEASUREMENT Rail_stPCVMon4_mp "Zustandsbits für Überwachung auf maximalen Raildruck" UBYTE OneToOne 1 100 0.00 255.0 FORMAT "%5.1" ECU_ADDRESS 0x8FF3F4 /end MEASUREMENT
/begin MEASUREMENT Rail_stPCVMon5_mp "Zustandsbits für Plausibilisierung des Raildrucks mit dem Strom durch das Druckregelventil" UWORD OneToOne 1 100 0.00 65535.00 FORMAT "%8.2" ECU_ADDRESS 0x8FF3F6 /end MEASUREMENT
/begin MEASUREMENT Rail_stPeakMinZFC_mp "Zustand des Automaten ""Bestimmung der Mindestschwelle des Raildrucks""" UBYTE OneToOne 1 100 0.00 255.0 FORMAT "%5.1" ECU_ADDRESS 0x8FF43C /end MEASUREMENT
/begin MEASUREMENT Rail_stZFCDem_mp "Status für geschlossenes Druckregelventil bei aktiver Lernphase der ZFC" UBYTE OneToOne 1 100 0.00 255.0 FORMAT "%5.1" ECU_ADDRESS 0x8FF400 /end MEASUREMENT
/begin MEASUREMENT Rail_swtPreCtl "Raildruckregler mit / ohne Vorsteuerung" UBYTE OneToOne 1 100 0.00 255.0 FORMAT "%5.1" ECU_ADDRESS 0x7F8A19 /end MEASUREMENT
/begin MEASUREMENT Rail_swtPress "Umschaltung zwischen Steuern und Regeln anhand Absolut/Differenzwert des Raildrucks" UBYTE OneToOne 1 100 0.00 255.0 FORMAT "%5.1" ECU_ADDRESS 0x7F8A1A /end MEASUREMENT
/begin MEASUREMENT Rail_swtWindUp "Raildruckregler mit eingefrorenem oder rückgerechnetem I-Anteil" UBYTE OneToOne 1 100 0.00 255.0 FORMAT "%5.1" ECU_ADDRESS 0x7F8A1B /end MEASUREMENT
/begin MEASUREMENT Rail_tiPCV0Deb_mp "PCV0: Messpunkt fuer laufende Entprellzaehler" UWORD Time_ms 1 100 0.00 655350.0 FORMAT "%8.1" ECU_ADDRESS 0x6F8304 /end MEASUREMENT
/begin MEASUREMENT Rail_tiPCV1Deb_mp "PCV1: Messpunkt fuer laufende Entprellzaehler" UWORD Time_ms 1 100 0.00 655350.0 FORMAT "%8.1" ECU_ADDRESS 0x6F8306 /end MEASUREMENT
/begin MEASUREMENT Rail_tiPCV2Deb_mp "PCV2: Messpunkt fuer laufende Entprellzaehler" UWORD Time_ms 1 100 0.00 655350.0 FORMAT "%8.1" ECU_ADDRESS 0x6F8308 /end MEASUREMENT
/begin MEASUREMENT Rail_tiPCV3Deb_mp "PCV3: Messpunkt fuer laufende Entprellzaehler" UWORD Time_ms 1 100 0.00 655350.0 FORMAT "%8.1" ECU_ADDRESS 0x6F830A /end MEASUREMENT
/begin MEASUREMENT Rail_tiPCV4Deb_mp "PCV4: Messpunkt fuer laufende Entprellzaehler" UWORD Time_ms 1 100 0.00 655350.0 FORMAT "%8.1" ECU_ADDRESS 0x6F830C /end MEASUREMENT
/begin MEASUREMENT Rail_tiPCV5Deb_mp "PCV5: Messpunkt fuer laufende Entprellzaehler" UWORD Time_ms 1 100 0.00 655350.0 FORMAT "%8.1" ECU_ADDRESS 0x6F830E /end MEASUREMENT
/begin MEASUREMENT Rail_tiPCVRmpDur_mp "Laufzeit der Rampe um vom aktuellen Sollwert auf den neuen PCVClose-Wert zu rampen" SWORD Time_ms 1 100 -327680.0 327670.0 FORMAT "%8.1" ECU_ADDRESS 0x8FF402 /end MEASUREMENT
/begin MEASUREMENT Rail_tiThresMonEna "Zeitverzögerung um Plausibilisierung des Raildrucks freizugeben" UWORD Time_ms 1 100 0.00 655350.0 FORMAT "%8.1" ECU_ADDRESS 0x7F92C0 /end MEASUREMENT
/begin MEASUREMENT Rtmo_ctInterrupt_u32 "Anzahl der Unterbrechungen der zu messenden Funktion innerhalb des letzten Messzyklus (keine reentranten Interrupts)" ULONG OneToOne 1 100 0.00 4294967295.00 FORMAT "%13.2" ECU_ADDRESS 0x802940 /end MEASUREMENT
/begin MEASUREMENT Rtmo_ctReentrantSample_u32 "Aufrufanzahl der zu messenden Funktion innerhalb des letzten Messzyklus, wobei Funktion bereits aktiv war (reentranter Aufruf)" ULONG OneToOne 1 100 0.00 4294967295.00 FORMAT "%13.2" ECU_ADDRESS 0x802948 /end MEASUREMENT
/begin MEASUREMENT Rtmo_ctSampleProc_u8 "Zähler wird nach jeder Messwertermittlung inkrementiert" UBYTE OneToOne 1 100 0.00 255.0 FORMAT "%5.1" ECU_ADDRESS 0x80295C /end MEASUREMENT
/begin MEASUREMENT Rtmo_ctSample_u32 "Anzahl der Aufrufe der zu messenden Funktion innerhalb des letzten Messzyklus (keine reentranten Aufrufe)" ULONG OneToOne 1 100 0.00 4294967295.00 FORMAT "%13.2" ECU_ADDRESS 0x802944 /end MEASUREMENT
/begin MEASUREMENT Rtmo_tiAbsMax_u32 "Maximale Laufzeit der zu messenden Funktion seit letztem Rücksetzen (Rtmo_swMinMaxReset_cu8)" ULONG TimeSys_us 1 100 0.00 1228361874.73 FORMAT "%13.2" ECU_ADDRESS 0x80293C /end MEASUREMENT
/begin MEASUREMENT Rtmo_tiAbsMin_u32 "Minimale Laufzeit der zu messenden Funktion seit letztem Rücksetzen (Rtmo_swMinMaxReset_cu8)" ULONG TimeSys_us 1 100 0.00 1228361874.73 FORMAT "%13.2" ECU_ADDRESS 0x802938 /end MEASUREMENT
/begin MEASUREMENT Rtmo_tiAvrg_u32 "durchschnittliche Laufzeit der zu messenden Funktion innerhalb des letzten Messzyklus" ULONG TimeSys_us 1 100 0.00 1228361874.73 FORMAT "%13.2" ECU_ADDRESS 0x80292C /end MEASUREMENT
/begin MEASUREMENT Rtmo_tiLoad_u32 "aktuelle Laufzeit" ULONG RtmoTicksToPercent 1 100 -122736.187473 100.000000000 FORMAT "%13.6" ECU_ADDRESS 0x802958 /end MEASUREMENT
/begin MEASUREMENT Rtmo_tiMaxCallDist_u32 "Maximaler Zeitabstand zwischen zwei Funktions/Task-Aufrufen" ULONG TimeSys_us 1 100 0.00 1228361874.73 FORMAT "%13.2" ECU_ADDRESS 0x802950 /end MEASUREMENT
/begin MEASUREMENT Rtmo_tiMaxLoad_u32 "Maximale Laufzeit" ULONG RtmoTicksToPercent 1 100 -122736.187473 100.000000000 FORMAT "%13.6" ECU_ADDRESS 0x802954 /end MEASUREMENT
/begin MEASUREMENT Rtmo_tiMax_u32 "Maximale Laufzeit der zu messenden Funktion innerhalb des letzten Messzyklus" ULONG TimeSys_us 1 100 0.00 1228361874.73 FORMAT "%13.2" ECU_ADDRESS 0x802934 /end MEASUREMENT
/begin MEASUREMENT Rtmo_tiMinCallDist_u32 "Minimaler Zeitabstand zwischen zwei Funktions/Task-Aufrufen" ULONG TimeSys_us 1 100 0.00 1228361874.73 FORMAT "%13.2" ECU_ADDRESS 0x80294C /end MEASUREMENT
/begin MEASUREMENT Rtmo_tiMin_u32 "Minimale Laufzeit der zu messenden Funktion innerhalb des letzten Messzyklus" ULONG TimeSys_us 1 100 0.00 1228361874.73 FORMAT "%13.2" ECU_ADDRESS 0x802930 /end MEASUREMENT
/begin MEASUREMENT signals_stTestNLim_mp "Meßpunkt für Status Drehzahlbegrenzung von Stellertests" UBYTE OneToOne 1 100 0.00 255.0 FORMAT "%5.1" ECU_ADDRESS 0x8FF454 /end MEASUREMENT
/begin MEASUREMENT signals_stTest_mp "Meßpunkt für Status Stellertest" ULONG OneToOne 1 100 0.00 4294967295.00 FORMAT "%13.2" ECU_ADDRESS 0x8FF458 /end MEASUREMENT
/begin MEASUREMENT signals_tiTstRemain_mp "Meßpunkt für verbleibende Zeit bis zur Abschaltung Stellertest über Zeitgrenze" UWORD Time_ms 1 100 0.00 655350.0 FORMAT "%8.1" ECU_ADDRESS 0x8FF45C /end MEASUREMENT
/begin MEASUREMENT SOPTst_stCyl "Endstufen die sich trotz redundanter Abschaltung aktivieren ließen" UBYTE OneToOne 1 100 0.00 255.0 FORMAT "%5.1" ECU_ADDRESS 0x7F8A1C /end MEASUREMENT
/begin MEASUREMENT SPMon_numFreeErcosekStack_mp "Freier Ercosek Stack (Schleppzeiger im eeprom)" UWORD OneToOne 1 100 0.00 65535.00 FORMAT "%8.2" ECU_ADDRESS 0x6F8328 /end MEASUREMENT
/begin MEASUREMENT SPMon_numFreeUserStack_mp "Meßpunkt für freien Userstackbereich" UWORD OneToOne 1 100 0.00 65535.00 FORMAT "%8.2" ECU_ADDRESS 0x6F832A /end MEASUREMENT
/begin FUNCTION rail_monpcv "Raildruckueberwachung für die Druckregelung ueber Druckregelventil"
 /begin DEF_CHARACTERISTIC Rail_DebPCV0MaxDef_C Rail_DebPCV0MaxOk_C Rail_DebPCV1MaxDef_C Rail_DebPCV1MaxOk_C Rail_DebPCV2MaxDef_C Rail_DebPCV2MaxOk_C Rail_DebPCV3MaxDef_C Rail_DebPCV3MaxOk_C Rail_DebPCV4MaxDef_C Rail_DebPCV4MaxOk_C Rail_DebPCV5MaxDef_C Rail_DebPCV5MaxOk_C Rail_pPCVDvtMax_C Rail_pPCVDvtMin_C Rail_pPCVSetMin_C Rail_pAbsDvtMax_C Rail_tiThresMonEna_C Rail_qMonEnaMax_C Rail_nMonEnaMin_C Rail_nMonEnaMax_C Rail_pPCVPeakMax_C Rail_stMonPCVRls_C Rail_pNIPCVMax_MAP Rail_pNIPCVMin_MAP Rail_pPCVDvtMax_CUR Rail_pPCVPeakMin_CUR Rail_pPCVSetMax_CUR /end DEF_CHARACTERISTIC
 /begin IN_MEASUREMENT Eng_nAvrg PCVCD_iActVal Rail_pSetPoint /end IN_MEASUREMENT
/end FUNCTION
/begin FUNCTION rail_monpcv_msg "" /begin OUT_MEASUREMENT Rail_tiThresMonEna /end OUT_MEASUREMENT /end FUNCTION
/begin FUNCTION rail_monpcv_uic ""
 /begin OUT_MEASUREMENT Rail_pNIPCVMax_mp Rail_pNIPCVMin_mp Rail_pPCVDvtMax_mp Rail_pPCVPeakMin_mp Rail_pPCVSetMax_mp Rail_stPCVMon0_mp Rail_stPCVMon1_mp Rail_stPCVMon2_mp Rail_stPCVMon3_mp Rail_stPCVMon4_mp Rail_stPCVMon5_mp Rail_tiPCV0Deb_mp Rail_tiPCV1Deb_mp Rail_tiPCV2Deb_mp Rail_tiPCV3Deb_mp Rail_tiPCV4Deb_mp Rail_tiPCV5Deb_mp /end OUT_MEASUREMENT
/end FUNCTION
/begin FUNCTION rail_msg "" /end FUNCTION
/begin FUNCTION rail_pgovsetup "Softwareschalter-Konfiguration der Komponente Rail"
 /begin DEF_CHARACTERISTIC Rail_swtPreCtlVal_C Rail_swtPreCtlType_C Rail_swtPressVal_C Rail_swtPressType_C Rail_swtWindUpVal_C Rail_swtWindUpType_C /end DEF_CHARACTERISTIC
/end FUNCTION
/begin FUNCTION rail_pgovsetup_msg "" /begin OUT_MEASUREMENT Rail_stCtlType Rail_swtPreCtl Rail_swtPress Rail_swtWindUp /end OUT_MEASUREMENT /end FUNCTION
/begin FUNCTION rail_pgovsetup_uic "" /end FUNCTION
/begin FUNCTION rail_prectlmeun "Vorsteuerung für die Hochdruckregelung ueber Zumesseinheit"
 /begin DEF_CHARACTERISTIC Rail_dvolLeak_MAP Rail_dvolPreCtlBas_MAP Rail_dvolPreCtlOfs_MAP Rail_dvolPreCtlPoI1_MAP Rail_dvolPreCtlPoI2_MAP Rail_facLeakAged_C Rail_stPreCtlMeUnSel_C Rail_volInjVlvCtl_C /end DEF_CHARACTERISTIC
 /begin IN_MEASUREMENT Eng_nAvrg FlSys_t InjCrv_qPoI1Des_mp InjCrv_qPoI2Des_mp InjCtl_qSetUnBal Rail_pSetPoint Rail_qPreCtlBas_mp /end IN_MEASUREMENT
/end FUNCTION
/begin FUNCTION rail_prectlmeunrmtctl_uic "" /end FUNCTION
/begin FUNCTION rail_prectlmeun_uic ""
 /begin OUT_MEASUREMENT Rail_dvolInjVlvCtl_mp Rail_dvolLeak_mp Rail_dvolPreCtlBas_mp Rail_dvolPreCtlInit_mp Rail_dvolPreCtlOfs_mp Rail_dvolPreCtlPoI1_mp Rail_dvolPreCtlPoI2_mp Rail_qPreCtlBas_mp /end OUT_MEASUREMENT
/end FUNCTION
/begin FUNCTION rail_prectlpcv "Vorsteuerung für die Hochdruckregelung ueber Druckregelventil"
 /begin DEF_CHARACTERISTIC Rail_dvolRedOfsLim_C Rail_pPCVCloseOfs_CUR Rail_pPCVRedOfs_CUR Rail_pPreCtl_MAP Rail_pRedOfsLim_C Rail_qRedOfsLim_C Rail_tiPCVRmpDur_CUR Rail_tiPCVRmpToOfs_C Rail_tiPCVRmpToRedOfs_C /end DEF_CHARACTERISTIC
 /begin IN_MEASUREMENT Eng_nAvrg Rail_pSetPoint /end IN_MEASUREMENT
/end FUNCTION
/begin FUNCTION rail_prectlpcvrmtctl_uic "" /end FUNCTION
/begin FUNCTION rail_prectlpcv_uic ""
 /begin OUT_MEASUREMENT Rail_facPCVTiRmpVal_mp Rail_facTiRmpVal_mp Rail_pPCVClose_mp Rail_pPCVOfs_mp Rail_pPCVRedOfs_mp Rail_pPreCtl_mp Rail_stZFCDem_mp Rail_tiPCVRmpDur_mp /end OUT_MEASUREMENT
/end FUNCTION
/begin FUNCTION rail_rgn "Raildrucksollwert Regenerationswertberechnung" /begin DEF_CHARACTERISTIC Rail_pSetPointRgn_MAP /end DEF_CHARACTERISTIC /begin IN_MEASUREMENT Eng_nAvrg InjCtl_qCurr /end IN_MEASUREMENT /end FUNCTION
/begin FUNCTION rail_rgnlib "Funktionsbibliothek für die Regenerationsumschaltung des Raildrucksollwertes" /begin DEF_CHARACTERISTIC Rail_dtiRgnRmpUp_C Rail_dtiRgnRmpDwn_C Rail_stRgnMsk_C /end DEF_CHARACTERISTIC /end FUNCTION
/begin FUNCTION rail_rgn_msg "" /begin OUT_MEASUREMENT Rail_pSetPointRgn /end OUT_MEASUREMENT /end FUNCTION
/begin FUNCTION rail_rgn_uic "" /begin DEF_CHARACTERISTIC Rail_pSetPointRgn_Vector Rail_pSetPointRgn_Channel /end DEF_CHARACTERISTIC /end FUNCTION
/begin FUNCTION rail_setpoint "Raildruckregler Sollwertberechnung"
 /begin DEF_CHARACTERISTIC Rail_dpSetPointDec_C Rail_dpSetPointInc_MAP Rail_pSetPointBaseStrt_MAP Rail_pSetPointBase_MAP Rail_pSetPointBattMin_CUR Rail_pSetPointInit_C Rail_pSetPointRed_C Rail_stRgnDelMsk_C Rail_stSetPointSel_C Rail_tiSetPointRedMin_C /end DEF_CHARACTERISTIC
 /begin IN_MEASUREMENT BattCD_u Eng_nAvrg InjCtl_qCurr InjCtl_qSetUnBal /end IN_MEASUREMENT
 /begin OUT_MEASUREMENT Rail_RgnVal_mp /end OUT_MEASUREMENT
/end FUNCTION
/begin FUNCTION rail_setpointaddcor "Berechnung projektspezifischer Korrekturen für Raildruck-Sollwert"
 /begin DEF_CHARACTERISTIC Rail_facAPSetPDynCor_CUR Rail_facChamWllTempCorr_MAP Rail_facDQSetPDynCor_CUR Rail_facETSetPDynCor_CUR Rail_facIASetPDynCor_CUR Rail_facSetPointFTSCor_CUR Rail_pChamWllTempCorr_MAP Rail_pSetPDynCor_MAP Rail_pSetPointFTSCor_MAP Rail_pSetPointLimNFlTemp_MAP Rail_pSetPointMaxDef_CUR Rail_pSetPointMaxDef_MAP Rail_pSetPointMax_MAP Rail_pSetPointMinDef_C Rail_pSetPointMin_MAP /end DEF_CHARACTERISTIC
 /begin IN_MEASUREMENT APSCD_pVal Eng_nAvrg Eng_tEng FTSCD_tFuel IATSCD_tAir InjCrv_dqSetUnBalFltLim InjCrv_qTot InjCrv_tEng InjCtl_qCurr InjCtl_qSetUnBal Layer_tChamWll /end IN_MEASUREMENT
/end FUNCTION
/begin FUNCTION rail_setpointaddcorrgn "Berechnung projektspezifischer Korrekturen für Raildruck-Sollwert für den Regenerationsbetrieb" /end FUNCTION
/begin FUNCTION rail_setpointaddcorrgn_msg "" /end FUNCTION
/begin FUNCTION rail_setpointaddcorrgn_uic "" /end FUNCTION
/begin FUNCTION rail_setpointaddcor_msg ""
 /begin OUT_MEASUREMENT Rail_pSetPointAddCor Rail_pSetPointFlTempCor Rail_pSetPointLimNFlTemp Rail_pSetPointMax Rail_pSetPointMin /end OUT_MEASUREMENT
/end FUNCTION
/begin FUNCTION rail_setpointaddcor_uic ""
 /begin OUT_MEASUREMENT Rail_facAPSetPDynCor_mp Rail_facDQSetPDynCor_mp Rail_facETSetPDynCor_mp Rail_facIASetPDynCor_mp Rail_facSetPointFTSCor_mp Rail_pChamWllTempCorr_mp Rail_pSetPDynCor_mp Rail_pSetPointMaxDef_mp /end OUT_MEASUREMENT
/end FUNCTION
/begin FUNCTION rail_setpointenvcor "Berechnung der Korrekturen für Raildruck-Sollwert"
 /begin DEF_CHARACTERISTIC Rail_pSetPointAPSCor_MAP Rail_pSetPointAPSCStrt_MAP Rail_pSetPointATSCor_MAP Rail_pSetPointATSCStrt_MAP Rail_pSetPointETSCor1_MAP Rail_pSetPointETSCor_MAP Rail_pSetPointETSCStrt_MAP /end DEF_CHARACTERISTIC
 /begin IN_MEASUREMENT Eng_nAvrg InjCtl_qCurr /end IN_MEASUREMENT
/end FUNCTION
/begin FUNCTION rail_setpointenvcorrgn "Berechnung der Korrekturen für Raildruck-Sollwert für den Regenerationsbetrieb" /end FUNCTION
/begin FUNCTION rail_setpointenvcorrgn_msg "" /end FUNCTION
/begin FUNCTION rail_setpointenvcorrgn_uic "" /end FUNCTION
/begin FUNCTION rail_setpointenvcorslow "Gewichtungsfaktoren für die Raildruck-Sollwertkorrekturen"
 /begin DEF_CHARACTERISTIC Rail_facSetPointAPSCor_CUR Rail_facSetPointAPSCStrt_CUR Rail_facSetPointATSCor_CUR Rail_facSetPointATSCStrt_CUR Rail_facSetPointETSCor1_CUR Rail_facSetPointETSCor_CUR Rail_facSetPointETSCStrt_CUR /end DEF_CHARACTERISTIC
 /begin IN_MEASUREMENT APSCD_pVal IATSCD_tAir InjCrv_tEng /end IN_MEASUREMENT
/end FUNCTION
/begin FUNCTION rail_setpointenvcorslowrgn "Gewichtungsfaktoren für die Raildruck-Sollwertkorrekturen für den Regenerationsbetrieb" /end FUNCTION
/begin FUNCTION rail_setpointenvcorslowrgn_msg "" /end FUNCTION
/begin FUNCTION rail_setpointenvcorslowrgn_uic "" /end FUNCTION
/begin FUNCTION rail_setpointenvcorslow_msg ""
 /begin OUT_MEASUREMENT Rail_facSetPointAPSCor Rail_facSetPointAPSCStrt Rail_facSetPointATSCor Rail_facSetPointATSCStrt Rail_facSetPointETSCor Rail_facSetPointETSCor1 Rail_facSetPointETSCStrt /end OUT_MEASUREMENT
/end FUNCTION
/begin FUNCTION rail_setpointenvcorslow_uic "" /end FUNCTION
/begin FUNCTION rail_setpointenvcor_msg "" /begin OUT_MEASUREMENT Rail_pSetPointEnvCor Rail_pSetPointEnvCorStrt /end OUT_MEASUREMENT /end FUNCTION
/begin FUNCTION rail_setpointenvcor_uic ""
 /begin OUT_MEASUREMENT Rail_pSetPointAPSCor_mp Rail_pSetPointAPSCStrt_mp Rail_pSetPointATSCor_mp Rail_pSetPointATSCStrt_mp Rail_pSetPointETSCor1_mp Rail_pSetPointETSCor_mp Rail_pSetPointETSCStrt_mp /end OUT_MEASUREMENT
/end FUNCTION
/begin FUNCTION rail_setpointrmtctl_uic "" /end FUNCTION
/begin FUNCTION rail_setpoint_msg ""
 /begin OUT_MEASUREMENT Rail_dpSetPointInc Rail_pSetPoint Rail_pSetPointFlTempLim Rail_pSetPointFlTempUnlim /end OUT_MEASUREMENT
/end FUNCTION
/begin FUNCTION rail_setpoint_uic "" /begin DEF_CHARACTERISTIC Rail_pSetPoint_Vector Rail_pSetPoint_Channel /end DEF_CHARACTERISTIC
 /begin OUT_MEASUREMENT Rail_pSetPointBase_mp Rail_pSetPointBattMin_mp Rail_pSetPointCor_mp Rail_pSetPointDec_mp Rail_pSetPointDynLim_mp Rail_pSetPointFlTempCor_mp Rail_pSetPointInc_mp Rail_pSetPointLim_mp Rail_pSetPointOut_mp Rail_pSetPointZFC_mp Rail_SetPointRed_mp /end OUT_MEASUREMENT
/end FUNCTION
/begin FUNCTION rail_setsubst "" /end FUNCTION
/begin FUNCTION rail_setsubst_msg "" /begin OUT_MEASUREMENT Rail_pSetPointSubst /end OUT_MEASUREMENT /end FUNCTION
/begin FUNCTION rail_setsubst_uic "" /end FUNCTION
/begin FUNCTION rail_zfclib "Funktionsbibliothek für den Eingriff der Nullmengenkallibrierung im Raildruckregler"
 /begin DEF_CHARACTERISTIC Rail_pPeakMinZFC_C Rail_pSetPointZFCMax_C Rail_pSetPointZFCMin_C Rail_rPeakMinSlpZFC_C Rail_rZFCInitDwn_CUR Rail_rZFCInitUp_CUR Rail_tiZFCDemDel_C Rail_tiZFCPT1_C /end DEF_CHARACTERISTIC
 /begin IN_MEASUREMENT ZFC_pRailSetPoint_mp /end IN_MEASUREMENT
/end FUNCTION
/begin FUNCTION rail_zfclib_uic "" /begin OUT_MEASUREMENT Rail_pZFCInit_mp Rail_stPeakMinZFC_mp /end OUT_MEASUREMENT /end FUNCTION
/begin FUNCTION rtmo "run time measurement online"
 /begin DEF_CHARACTERISTIC Rtmo_adCallingBegin_cu32 Rtmo_adCallingEnd_cu32 Rtmo_adStart_cu32 Rtmo_stIntOverhead_cu8 Rtmo_stSampleTime_cu8 Rtmo_swLoadMode_cu8 Rtmo_swMode_cu8 /end DEF_CHARACTERISTIC
/end FUNCTION
/begin FUNCTION rtmo_msg ""
 /begin OUT_MEASUREMENT Rtmo_ctInterrupt_u32 Rtmo_ctReentrantSample_u32 Rtmo_ctSampleProc_u8 Rtmo_ctSample_u32 Rtmo_tiAbsMax_u32 Rtmo_tiAbsMin_u32 Rtmo_tiAvrg_u32 Rtmo_tiLoad_u32 Rtmo_tiMaxCallDist_u32 Rtmo_tiMaxLoad_u32 Rtmo_tiMax_u32 Rtmo_tiMinCallDist_u32 Rtmo_tiMin_u32 /end OUT_MEASUREMENT
/end FUNCTION
/begin FUNCTION sched "" /end FUNCTION
/begin FUNCTION sched_msg "" /end FUNCTION
/begin FUNCTION signals "Bereitstellung von applizierbaren Signalen und ihrer Umrechnung" /begin DEF_CHARACTERISTIC Signals_PID0x1C_C /end DEF_CHARACTERISTIC /end FUNCTION
/begin FUNCTION signals_base "Sakalierungsfaktoren für Umrechnungen und Schnittstellensignale"
 /begin DEF_CHARACTERISTIC Signals_adFreeApplic1_C Signals_numTypFreeApplic1_C Signals_adFreeApplic2_C Signals_numTypFreeApplic2_C Signals_adFreeApplic3_C Signals_numTypFreeApplic3_C Sig_aiDSMOffset_C Sig_aiDSMScale_C Sig_aiCANOffset_C Sig_aiCANScale_C Sig_aiDIAOffset_C Sig_aiDIAScale_C Sig_AngCrSDSMOffset_C Sig_AngCrSDSMScale_C Sig_AngCrSCANOffset_C Sig_AngCrSCANScale_C Sig_AngCrSDIAOffset_C Sig_AngCrSDIAScale_C Sig_aDSMOffset_C Sig_aDSMScale_C Sig_aCANOffset_C Sig_aCANScale_C Sig_aDIAOffset_C Sig_aDIAScale_C Sig_Carb_dtDSMOffset_C Sig_Carb_dtDSMScale_C Sig_Carb_dtCANOffset_C Sig_Carb_dtCANScale_C Sig_Carb_dtDIAOffset_C Sig_Carb_dtDIAScale_C Sig_Carb_lDSMOffset_C Sig_Carb_lDSMScale_C Sig_Carb_lCANOffset_C Sig_Carb_lCANScale_C Sig_Carb_lDIAOffset_C Sig_Carb_lDIAScale_C Sig_Carb_mAirTimDSMOffset_C Sig_Carb_mAirTimDSMScale_C Sig_Carb_mAirTimCANOffset_C Sig_Carb_mAirTimCANScale_C Sig_Carb_mAirTimDIAOffset_C Sig_Carb_mAirTimDIAScale_C Sig_Carb_nDSMOffset_C Sig_Carb_nDSMScale_C Sig_Carb_nCANOffset_C Sig_Carb_nCANScale_C Sig_Carb_nDIAOffset_C Sig_Carb_nDIAScale_C Sig_Carb_pDSMOffset_C Sig_Carb_pDSMScale_C Sig_Carb_pCANOffset_C Sig_Carb_pCANScale_C Sig_Carb_pDIAOffset_C Sig_Carb_pDIAScale_C Sig_Carb_rDSMOffset_C Sig_Carb_rDSMScale_C Sig_Carb_rCANOffset_C Sig_Carb_rCANScale_C Sig_Carb_rDIAOffset_C Sig_Carb_rDIAScale_C Sig_Carb_tiDSMOffset_C Sig_Carb_tiDSMScale_C Sig_Carb_tiCANOffset_C Sig_Carb_tiCANScale_C Sig_Carb_tiDIAOffset_C Sig_Carb_tiDIAScale_C Sig_Carb_tDSMOffset_C Sig_Carb_tDSMScale_C Sig_Carb_tCANOffset_C Sig_Carb_tCANScale_C Sig_Carb_tDIAOffset_C Sig_Carb_tDIAScale_C Sig_Carb_vDSMOffset_C Sig_Carb_vDSMScale_C Sig_Carb_vCANOffset_C Sig_Carb_vCANScale_C Sig_Carb_vDIAOffset_C Sig_Carb_vDIAScale_C Sig_dcycDSMOffset_C Sig_dcycDSMScale_C Sig_dcycCANOffset_C Sig_dcycCANScale_C Sig_dcycDIAOffset_C Sig_dcycDIAScale_C Sig_Deffuwb100DSMOffset_C Sig_Deffuwb100DSMScale_C Sig_Deffuwb100CANOffset_C Sig_Deffuwb100CANScale_C Sig_Deffuwb100DIAOffset_C Sig_Deffuwb100DIAScale_C Sig_DezUbQ1DSMOffset_C Sig_DezUbQ1DSMScale_C Sig_DezUbQ1CANOffset_C Sig_DezUbQ1CANScale_C Sig_DezUbQ1DIAOffset_C Sig_DezUbQ1DIAScale_C Sig_DezUwQ1ozDSMOffset_C Sig_DezUwQ1ozDSMScale_C Sig_DezUwQ1ozCANOffset_C Sig_DezUwQ1ozCANScale_C Sig_DezUwQ1ozDIAOffset_C Sig_DezUwQ1ozDIAScale_C Sig_DezUwQ1DSMOffset_C Sig_DezUwQ1DSMScale_C Sig_DezUwQ1CANOffset_C Sig_DezUwQ1CANScale_C Sig_DezUwQ1DIAOffset_C Sig_DezUwQ1DIAScale_C Sig_dtDSMOffset_C Sig_dtDSMScale_C Sig_dtCANOffset_C Sig_dtCANScale_C Sig_dtDIAOffset_C Sig_dtDIAScale_C Sig_DxsDSMOffset_C Sig_DxsDSMScale_C Sig_DxsCANOffset_C Sig_DxsCANScale_C Sig_DxsDIAOffset_C Sig_DxsDIAScale_C Sig_EnergyDSMOffset_C Sig_EnergyDSMScale_C Sig_EnergyCANOffset_C Sig_EnergyCANScale_C Sig_EnergyDIAOffset_C Sig_EnergyDIAScale_C Sig_factDSMOffset_C Sig_factDSMScale_C Sig_factCANOffset_C Sig_factCANScale_C Sig_factDIAOffset_C Sig_factDIAScale_C Sig_fas1DSMOffset_C Sig_fas1DSMScale_C Sig_fas1CANOffset_C Sig_fas1CANScale_C Sig_fas1DIAOffset_C Sig_fas1DIAScale_C Sig_fas2DSMOffset_C Sig_fas2DSMScale_C Sig_fas2CANOffset_C Sig_fas2CANScale_C Sig_fas2DIAOffset_C Sig_fas2DIAScale_C Sig_fas3DSMOffset_C Sig_fas3DSMScale_C Sig_fas3CANOffset_C Sig_fas3CANScale_C Sig_fas3DIAOffset_C Sig_fas3DIAScale_C Sig_FlConPFltDSMOffset_C Sig_FlConPFltDSMScale_C Sig_FlConPFltCANOffset_C Sig_FlConPFltCANScale_C Sig_FlConPFltDIAOffset_C Sig_FlConPFltDIAScale_C Sig_FlConDSMOffset_C Sig_FlConDSMScale_C Sig_FlConCANOffset_C Sig_FlConCANScale_C Sig_FlConDIAOffset_C Sig_FlConDIAScale_C Sig_FlUlQ0p122DSMOffset_C Sig_FlUlQ0p122DSMScale_C Sig_FlUlQ0p122CANOffset_C Sig_FlUlQ0p122CANScale_C Sig_FlUlQ0p122DIAOffset_C Sig_FlUlQ0p122DIAScale_C Sig_FSwB100DSMOffset_C Sig_FSwB100DSMScale_C Sig_FSwB100CANOffset_C Sig_FSwB100CANScale_C Sig_FSwB100DIAOffset_C Sig_FSwB100DIAScale_C Sig_FSwQ0p00153DSMOffset_C Sig_FSwQ0p00153DSMScale_C Sig_FSwQ0p00153CANOffset_C Sig_FSwQ0p00153CANScale_C Sig_FSwQ0p00153DIAOffset_C Sig_FSwQ0p00153DIAScale_C Sig_InjMassDSMOffset_C Sig_InjMassDSMScale_C Sig_InjMassCANOffset_C Sig_InjMassCANScale_C Sig_InjMassDIAOffset_C Sig_InjMassDIAScale_C Sig_InjTimDSMOffset_C Sig_InjTimDSMScale_C Sig_InjTimCANOffset_C Sig_InjTimCANScale_C Sig_InjTimDIAOffset_C Sig_InjTimDIAScale_C Sig_IUbQ1DSMOffset_C Sig_IUbQ1DSMScale_C Sig_IUbQ1CANOffset_C Sig_IUbQ1CANScale_C Sig_IUbQ1DIAOffset_C Sig_IUbQ1DIAScale_C Sig_IUwQ0p08O200DSMOffset_C Sig_IUwQ0p08O200DSMScale_C Sig_IUwQ0p08O200CANOffset_C Sig_IUwQ0p08O200CANScale_C Sig_IUwQ0p08O200DIAOffset_C Sig_IUwQ0p08O200DIAScale_C Sig_KmSwQ10DSMOffset_C Sig_KmSwQ10DSMScale_C Sig_KmSwQ10CANOffset_C Sig_KmSwQ10CANScale_C Sig_KmSwQ10DIAOffset_C Sig_KmSwQ10DIAScale_C Sig_KmUwQ10DSMOffset_C Sig_KmUwQ10DSMScale_C Sig_KmUwQ10CANOffset_C Sig_KmUwQ10CANScale_C Sig_KmUwQ10DIAOffset_C Sig_KmUwQ10DIAScale_C Sig_LambdaDSMOffset_C Sig_LambdaDSMScale_C Sig_LambdaCANOffset_C Sig_LambdaCANScale_C Sig_LambdaDIAOffset_C Sig_LambdaDIAScale_C Sig_lenPFltDSMOffset_C Sig_lenPFltDSMScale_C Sig_lenPFltCANOffset_C Sig_lenPFltCANScale_C Sig_lenPFltDIAOffset_C Sig_lenPFltDIAScale_C Sig_lenrgnu16PFltDSMOffset_C Sig_lenrgnu16PFltDSMScale_C Sig_lenrgnu16PFltCANOffset_C Sig_lenrgnu16PFltCANScale_C Sig_lenrgnu16PFltDIAOffset_C Sig_lenrgnu16PFltDIAScale_C Sig_lenDSMOffset_C Sig_lenDSMScale_C Sig_lenCANOffset_C Sig_lenCANScale_C Sig_lenDIAOffset_C Sig_lenDIAScale_C Sig_lDSMOffset_C Sig_lDSMScale_C Sig_lCANOffset_C Sig_lCANScale_C Sig_lDIAOffset_C Sig_lDIAScale_C Sig_mAirCylDSMOffset_C Sig_mAirCylDSMScale_C Sig_mAirCylCANOffset_C Sig_mAirCylCANScale_C Sig_mAirCylDIAOffset_C Sig_mAirCylDIAScale_C Sig_mAirTimDSMOffset_C Sig_mAirTimDSMScale_C Sig_mAirTimCANOffset_C Sig_mAirTimCANScale_C Sig_mAirTimDIAOffset_C Sig_mAirTimDIAScale_C Sig_mSootTimDSMOffset_C Sig_mSootTimDSMScale_C Sig_mSootTimCANOffset_C Sig_mSootTimCANScale_C Sig_mSootTimDIAOffset_C Sig_mSootTimDIAScale_C Sig_mSootDSMOffset_C Sig_mSootDSMScale_C Sig_mSootCANOffset_C Sig_mSootCANScale_C Sig_mSootDIAOffset_C Sig_mSootDIAScale_C Sig_nFanSpdDSMOffset_C Sig_nFanSpdDSMScale_C Sig_nFanSpdCANOffset_C Sig_nFanSpdCANScale_C Sig_nFanSpdDIAOffset_C Sig_nFanSpdDIAScale_C Sig_nPSPSpdDSMOffset_C Sig_nPSPSpdDSMScale_C Sig_nPSPSpdCANOffset_C Sig_nPSPSpdCANScale_C Sig_nPSPSpdDIAOffset_C Sig_nPSPSpdDIAScale_C Sig_nDSMOffset_C Sig_nDSMScale_C Sig_nCANOffset_C Sig_nCANScale_C Sig_nDIAOffset_C Sig_nDIAScale_C Sig_O2DSMOffset_C Sig_O2DSMScale_C Sig_O2CANOffset_C Sig_O2CANScale_C Sig_O2DIAOffset_C Sig_O2DIAScale_C Sig_OneToOneZFCDSMOffset_C Sig_OneToOneZFCDSMScale_C Sig_OneToOneZFCCANOffset_C Sig_OneToOneZFCCANScale_C Sig_OneToOneZFCDIAOffset_C Sig_OneToOneZFCDIAScale_C Sig_OneToOneDSMOffset_C Sig_OneToOneDSMScale_C Sig_OneToOneCANOffset_C Sig_OneToOneCANScale_C Sig_OneToOneDIAOffset_C Sig_OneToOneDIAScale_C Sig_OnOffDSMOffset_C Sig_OnOffDSMScale_C Sig_OnOffCANOffset_C Sig_OnOffCANScale_C Sig_OnOffDIAOffset_C Sig_OnOffDIAScale_C Sig_PermUwB6DSMOffset_C Sig_PermUwB6DSMScale_C Sig_PermUwB6CANOffset_C Sig_PermUwB6CANScale_C Sig_PermUwB6DIAOffset_C Sig_PermUwB6DIAScale_C Sig_pRailDSMOffset_C Sig_pRailDSMScale_C Sig_pRailCANOffset_C Sig_pRailCANScale_C Sig_pRailDIAOffset_C Sig_pRailDIAScale_C Sig_pDSMOffset_C Sig_pDSMScale_C Sig_pCANOffset_C Sig_pCANScale_C Sig_pDIAOffset_C Sig_pDIAScale_C Sig_qInjMassCycDSMOffset_C Sig_qInjMassCycDSMScale_C Sig_qInjMassCycCANOffset_C Sig_qInjMassCycCANScale_C Sig_qInjMassCycDIAOffset_C Sig_qInjMassCycDIAScale_C Sig_qInjMassDSMOffset_C Sig_qInjMassDSMScale_C Sig_qInjMassCANOffset_C Sig_qInjMassCANScale_C Sig_qInjMassDIAOffset_C Sig_qInjMassDIAScale_C Sig_qDSMOffset_C Sig_qDSMScale_C Sig_qCANOffset_C Sig_qCANScale_C Sig_qDIAOffset_C Sig_qDIAScale_C Sig_resFlowDSMOffset_C Sig_resFlowDSMScale_C Sig_resFlowCANOffset_C Sig_resFlowCANScale_C Sig_resFlowDIAOffset_C Sig_resFlowDIAScale_C Sig_rVnDSMOffset_C Sig_rVnDSMScale_C Sig_rVnCANOffset_C Sig_rVnCANScale_C Sig_rVnDIAOffset_C Sig_rVnDIAScale_C Sig_rDSMOffset_C Sig_rDSMScale_C Sig_rCANOffset_C Sig_rCANScale_C Sig_rDIAOffset_C Sig_rDIAScale_C Sig_ShftRght0ByteDSMOffset_C Sig_ShftRght0ByteDSMScale_C Sig_ShftRght0ByteCANOffset_C Sig_ShftRght0ByteCANScale_C Sig_ShftRght0ByteDIAOffset_C Sig_ShftRght0ByteDIAScale_C Sig_ShftRght1ByteDSMOffset_C Sig_ShftRght1ByteDSMScale_C Sig_ShftRght1ByteCANOffset_C Sig_ShftRght1ByteCANScale_C Sig_ShftRght1ByteDIAOffset_C Sig_ShftRght1ByteDIAScale_C Sig_ShftRght2ByteDSMOffset_C Sig_ShftRght2ByteDSMScale_C Sig_ShftRght2ByteCANOffset_C Sig_ShftRght2ByteCANScale_C Sig_ShftRght2ByteDIAOffset_C Sig_ShftRght2ByteDIAScale_C Sig_ShftRght3ByteDSMOffset_C Sig_ShftRght3ByteDSMScale_C Sig_ShftRght3ByteCANOffset_C Sig_ShftRght3ByteCANScale_C Sig_ShftRght3ByteDIAOffset_C Sig_ShftRght3ByteDIAScale_C Sig_TdUbQ0p5DSMOffset_C Sig_TdUbQ0p5DSMScale_C Sig_TdUbQ0p5CANOffset_C Sig_TdUbQ0p5CANScale_C Sig_TdUbQ0p5DIAOffset_C Sig_TdUbQ0p5DIAScale_C Sig_TdUbQ14p9333DSMOffset_C Sig_TdUbQ14p9333DSMScale_C Sig_TdUbQ14p9333CANOffset_C Sig_TdUbQ14p9333CANScale_C Sig_TdUbQ14p9333DIAOffset_C Sig_TdUbQ14p9333DIAScale_C Sig_tExhaustgasDSMOffset_C Sig_tExhaustgasDSMScale_C Sig_tExhaustgasCANOffset_C Sig_tExhaustgasCANScale_C Sig_tExhaustgasDIAOffset_C Sig_tExhaustgasDIAScale_C Sig_timEngDSMOffset_C Sig_timEngDSMScale_C Sig_timEngCANOffset_C Sig_timEngCANScale_C Sig_timEngDIAOffset_C Sig_timEngDIAScale_C Sig_Time_PwmHighDSMOffset_C Sig_Time_PwmHighDSMScale_C Sig_Time_PwmHighCANOffset_C Sig_Time_PwmHighCANScale_C Sig_Time_PwmHighDIAOffset_C Sig_Time_PwmHighDIAScale_C Sig_timsDSMOffset_C Sig_timsDSMScale_C Sig_timsCANOffset_C Sig_timsCANScale_C Sig_timsDIAOffset_C Sig_timsDIAScale_C Sig_tiOprgnu16PFltDSMOffset_C Sig_tiOprgnu16PFltDSMScale_C Sig_tiOprgnu16PFltCANOffset_C Sig_tiOprgnu16PFltCANScale_C Sig_tiOprgnu16PFltDIAOffset_C Sig_tiOprgnu16PFltDIAScale_C Sig_tisDcDSMOffset_C Sig_tisDcDSMScale_C Sig_tisDcCANOffset_C Sig_tisDcCANScale_C Sig_tisDcDIAOffset_C Sig_tisDcDIAScale_C Sig_tisDSMOffset_C Sig_tisDSMScale_C Sig_tisCANOffset_C Sig_tisCANScale_C Sig_tisDIAOffset_C Sig_tisDIAScale_C Sig_trqPrpDSMOffset_C Sig_trqPrpDSMScale_C Sig_trqPrpCANOffset_C Sig_trqPrpCANScale_C Sig_trqPrpDIAOffset_C Sig_trqPrpDIAScale_C Sig_trqDSMOffset_C Sig_trqDSMScale_C Sig_trqCANOffset_C Sig_trqCANScale_C Sig_trqDIAOffset_C Sig_trqDIAScale_C Sig_TSwQ0p1DSMOffset_C Sig_TSwQ0p1DSMScale_C Sig_TSwQ0p1CANOffset_C Sig_TSwQ0p1CANScale_C Sig_TSwQ0p1DIAOffset_C Sig_TSwQ0p1DIAScale_C Sig_tDSMOffset_C Sig_tDSMScale_C Sig_tCANOffset_C Sig_tCANScale_C Sig_tDIAOffset_C Sig_tDIAScale_C Sig_uBattDSMOffset_C Sig_uBattDSMScale_C Sig_uBattCANOffset_C Sig_uBattCANScale_C Sig_uBattDIAOffset_C Sig_uBattDIAScale_C Sig_UUwQ0p1DSMOffset_C Sig_UUwQ0p1DSMScale_C Sig_UUwQ0p1CANOffset_C Sig_UUwQ0p1CANScale_C Sig_UUwQ0p1DIAOffset_C Sig_UUwQ0p1DIAScale_C Sig_UUwQ0p25em3DSMOffset_C Sig_UUwQ0p25em3DSMScale_C Sig_UUwQ0p25em3CANOffset_C Sig_UUwQ0p25em3CANScale_C Sig_UUwQ0p25em3DIAOffset_C Sig_UUwQ0p25em3DIAScale_C Sig_uDSMOffset_C Sig_uDSMScale_C Sig_uCANOffset_C Sig_uCANScale_C Sig_uDIAOffset_C Sig_uDIAScale_C Sig_volphDSMOffset_C Sig_volphDSMScale_C Sig_volphCANOffset_C Sig_volphCANScale_C Sig_volphDIAOffset_C Sig_volphDIAScale_C Sig_volRailDSMOffset_C Sig_volRailDSMScale_C Sig_volRailCANOffset_C Sig_volRailCANScale_C Sig_volRailDIAOffset_C Sig_volRailDIAScale_C Sig_volDSMOffset_C Sig_volDSMScale_C Sig_volCANOffset_C Sig_volCANScale_C Sig_volDIAOffset_C Sig_volDIAScale_C Sig_vDSMOffset_C Sig_vDSMScale_C Sig_vCANOffset_C Sig_vCANScale_C Sig_vDIAOffset_C Sig_vDIAScale_C /end DEF_CHARACTERISTIC
/end FUNCTION
/begin FUNCTION signals_limits ""
 /begin DEF_CHARACTERISTIC Sig_LimLowDigital_C Sig_LimUpDigital_C Sig_LimLowFlCon_C Sig_LimUpFlCon_C Sig_LimLown_C Sig_LimUpn_C Sig_LimLowPwm_C Sig_LimUpPwm_C Sig_LimLowtrq_C Sig_LimUptrq_C /end DEF_CHARACTERISTIC
/end FUNCTION
/begin FUNCTION signals_model "" /end FUNCTION
/begin FUNCTION signals_mon ""
 /begin DEF_CHARACTERISTIC signals_tiTstDemHeal_C signals_tiTstDemMax_C signals_TmrBehaviour_C signals_TstDemMaxEngN_C signals_TstDemMaxVSSCDV_C /end DEF_CHARACTERISTIC
/end FUNCTION
/begin FUNCTION signals_project "" /end FUNCTION
/begin FUNCTION signals_uic ""
 /begin OUT_MEASUREMENT signals_stTestNLim_mp signals_stTest_mp signals_tiTstRemain_mp /end OUT_MEASUREMENT
/end FUNCTION
/begin FUNCTION sigtst_auto ""
 /begin DEF_CHARACTERISTIC SigTst_ACEn_C SigTst_AOHtEn_C SigTst_BPAEn_C SigTst_BPA2En_C SigTst_CpBVlvEn_C SigTst_EBAFEn_C SigTst_EBFEn_C SigTst_EGPpEn_C SigTst_EGREn_C SigTst_EGR2En_C SigTst_EGRClgBypVlv2En_C SigTst_ETClbCorOffEn_C SigTst_EngMEn_C SigTst_FANEn_C SigTst_GLWRLYEn_C SigTst_LPAEn_C SigTst_LSUCDHt0En_C SigTst_MILLAMPEn_C SigTst_MNTCTLEn_C SigTst_MeUnEn_C SigTst_PCVEn_C SigTst_PCVAdaptRstEn_C SigTst_PSPEn_C SigTst_SYSLAMPEn_C SigTst_TVAEn_C SigTst_TVA2En_C SigTst_VSAEn_C /end DEF_CHARACTERISTIC
/end FUNCTION
/begin FUNCTION soptst "Power-Up-Function test of disabling security pathes" /begin DEF_CHARACTERISTIC SOPTst_stRcyDem_C SOPTst_stShOffPathActv_C /end DEF_CHARACTERISTIC /end FUNCTION
/begin FUNCTION soptst_msg "" /begin OUT_MEASUREMENT SOPTst_stCyl /end OUT_MEASUREMENT /end FUNCTION
/begin FUNCTION spmon "Stack pointer Überwachung" /begin DEF_CHARACTERISTIC SPMon_swtRstStackMon_C /end DEF_CHARACTERISTIC /begin OUT_MEASUREMENT SPMon_numFreeErcosekStack_mp SPMon_numFreeUserStack_mp /end OUT_MEASUREMENT /end FUNCTION
/begin COMPU_METHOD Curr "Strom" RAT_FUNC "%6.2" "mA" COEFFS 0 1 0 0 0 1 /end COMPU_METHOD
/begin COMPU_METHOD DtyCyc "Tastverhaeltnis" RAT_FUNC "%6.4" "%" COEFFS 0 100 0 0 0 1 /end COMPU_METHOD
/begin COMPU_METHOD EGTSwt "Umrechnung für EGT Rampenschalter (1 / 1000*2^14 )" RAT_FUNC "%10.9" "-" COEFFS 0 16384000 0 0 0 1 /end COMPU_METHOD
/begin COMPU_METHOD EngN "Motordrehzahl" RAT_FUNC "%6.2" "rpm" COEFFS 0 1 0 0 0 1 /end COMPU_METHOD
/begin COMPU_METHOD Fact "Faktor mit Auflösung 1 / 8192, hauptsächlich für einen Faktorenbereich 0...1 verwendet" RAT_FUNC "%6.5" "-" COEFFS 0 8192 0 0 0 1 /end COMPU_METHOD
/begin COMPU_METHOD FlConsum_l_h "Kraftstoffverbrauch" RAT_FUNC "%6.4" "l/h" COEFFS 0 100 0 0 0 1 /end COMPU_METHOD
/begin COMPU_METHOD InjMassCyc "Einspritzmenge pro Zyklus (mg/Zyklus)" RAT_FUNC "%6.4" "mg/cyc" COEFFS 0 100 0 0 0 1 /end COMPU_METHOD
/begin COMPU_METHOD InjMassInj "Einspritzmenge pro Einspritzung (mg/Einspritzung)" RAT_FUNC "%6.4" "mg/inj" COEFFS 0 100 0 0 0 1 /end COMPU_METHOD
/begin COMPU_METHOD InjMassPerSec_20ms "Einspritzmengenänderung pro Sekunde für 20ms-Tasks" RAT_FUNC "%6.3" "mg/hub/s" COEFFS 0 2 0 0 0 1 /end COMPU_METHOD
/begin COMPU_METHOD InjQntInj "Einspritzmenge der einzelnen Einspritzung" RAT_FUNC "%6.4" "mm^3/inj" COEFFS 0 100 0 0 0 1 /end COMPU_METHOD
/begin COMPU_METHOD OneToOne "eins zu eins (physikalischer Wert ist gleich dem internen Wert)" RAT_FUNC "%6.2" "-" COEFFS 0 1 0 0 0 1 /end COMPU_METHOD
/begin COMPU_METHOD Prc "Prozent, gleiche interne Auflösung wie Fact, aber Darstellung in Prozent (0...100%)" RAT_FUNC "%6.4" "%" COEFFS 0 81.92 0 0 0 1 /end COMPU_METHOD
/begin COMPU_METHOD PresRail_sec "Raildruckerhöhung/absenkung in hPa/s" RAT_FUNC "%4.3" "bar/s" COEFFS 0 2.500000 0 0 0 1 /end COMPU_METHOD
/begin COMPU_METHOD Pres_hPa "Druck (angezeigt in [hPa])" RAT_FUNC "%6.2" "hPa" COEFFS 0 1 0 0 0 1 /end COMPU_METHOD
/begin COMPU_METHOD Pres_Rail "Raildruck in hPa" RAT_FUNC "%4.3" "bar" COEFFS 0 10.000000 0 0 0 1 /end COMPU_METHOD
/begin COMPU_METHOD Qp_mm3_sec "Umrechnung für Volumenstrom" RAT_FUNC "%6.1" "mm3/s" COEFFS 0 0.1 0 0 0 1 /end COMPU_METHOD
/begin COMPU_METHOD Rmp "einheitenloser Rampengradient (für Library Ramp, etc.)" RAT_FUNC "%6.4" "1/s" COEFFS 0 65.536 0 0 0 1 /end COMPU_METHOD
/begin COMPU_METHOD RtmoTicksToPercent "Rtmo_tiMaxLoad_u32 in Prozent konvertieren" RAT_FUNC "%6.2" "%" COEFFS 0 -34965 3496500 0 0 1 /end COMPU_METHOD
/begin COMPU_METHOD SigDatatyp "verbale Umrechnung für die auswahl eines Datentyps eines frei applizierbaren Signals" TAB_VERB "%6.3" "-" COMPU_TAB_REF SigDatatyp /end COMPU_METHOD
/begin COMPU_VTAB SigDatatyp "verbale Umrechnung für die auswahl eines Datentyps eines frei applizierbaren Signals" TAB_VERB 6 0 "SIG_SINT16" 1 "SIG_UINT16" 2 "SIG_SINT8" 3 "SIG_UINT8 or SIG_BOOL" 4 "SIG_SINT32" 5 "SIG_UINT32" /end COMPU_VTAB
/begin COMPU_METHOD SigSupLeg "verbale umrechung für unterstützte Gesetztesvorschrift (OBD) gemäß SAE J1979" TAB_VERB "%6.3" "-" COMPU_TAB_REF SigSupLeg /end COMPU_METHOD
/begin COMPU_VTAB SigSupLeg "verbale umrechung für unterstützte Gesetztesvorschrift (OBD) gemäß SAE J1979" TAB_VERB 9 1 "OBDII_USA_CARB" 2 "OBD_USA_EPA" 3 "OBD_and_OBDII_USA" 4 "OBDI_USA" 5 "no_use_for_OBD" 6 "EOBD(Europe)" 7 "EOBD and OBD II" 8 "EOBD and OBD" 9 "EOBD, OBD and OBD II" /end COMPU_VTAB
/begin COMPU_METHOD Temp_Cels "Temperatur dargestellt in °C (gleiche interne Darstellung wie Temp_Kelv)" RAT_FUNC "%6.1" "deg C" COEFFS 0 10 2731.4 0 0 1 /end COMPU_METHOD
/begin COMPU_METHOD TimeDelay_s "Zeitkonstante T1 (in s) für PT1, DT1, etc." RAT_FUNC "%9.3" "s" COEFFS 0 0 1 0 0.00023283064365387 0 /end COMPU_METHOD
/begin COMPU_METHOD TimeDelay_s_1 "Zeitkonstante T1 (in s) für PT1, DT1, etc. normiert auf 16 bit" RAT_FUNC "%9.6" "s" COEFFS 0 0 1 0 0.95367431640625 0 /end COMPU_METHOD
/begin COMPU_METHOD TimeSys_us "Zeit in [us] mit Systemzeit-Auflösung" RAT_FUNC "%6.3" "us" COEFFS 0 3.4965 0 0 0 1 /end COMPU_METHOD
/begin COMPU_METHOD Time_ms "Zeit in ms für Fehlerentprellung (DSM) und SW-Timer" RAT_FUNC "%6.1" "ms" COEFFS 0 0.1 0 0 0 1 /end COMPU_METHOD
/begin COMPU_METHOD Trq "Motormoment" RAT_FUNC "%6.3" "Nm" COEFFS 0 10 0 0 0 1 /end COMPU_METHOD
/begin COMPU_METHOD Vel "Fahrzeuggeschwindigkeit, gleiche interne Auflösung wie Vel_SI" RAT_FUNC "%6.4" "km/h" COEFFS 0 100 0 0 0 1 /end COMPU_METHOD
/begin COMPU_METHOD Volt_Batt "Batteriespannung" RAT_FUNC "%6.1" "mV" COEFFS 0 0.05115 0 0 0 1 /end COMPU_METHOD
/begin RECORD_LAYOUT Kf_Xs16_Ys16_Ws16 NO_AXIS_PTS_X 1 SWORD NO_AXIS_PTS_Y 2 SWORD AXIS_PTS_X 3 SWORD INDEX_INCR DIRECT AXIS_PTS_Y 4 SWORD INDEX_INCR DIRECT FNC_VALUES 5 SWORD COLUMN_DIR DIRECT /end RECORD_LAYOUT
/begin RECORD_LAYOUT Kl_Xs16_Ws16 NO_AXIS_PTS_X 1 SWORD AXIS_PTS_X 2 SWORD INDEX_INCR DIRECT FNC_VALUES 3 SWORD COLUMN_DIR DIRECT /end RECORD_LAYOUT
/begin RECORD_LAYOUT Kw_Ws16 FNC_VALUES 1 SWORD COLUMN_DIR DIRECT /end RECORD_LAYOUT
/begin RECORD_LAYOUT Kw_Wu16 FNC_VALUES 1 UWORD COLUMN_DIR DIRECT /end RECORD_LAYOUT
/begin RECORD_LAYOUT Kw_Wu32 FNC_VALUES 1 ULONG COLUMN_DIR DIRECT /end RECORD_LAYOUT
/begin RECORD_LAYOUT Kw_Wu8 FNC_VALUES 1 UBYTE COLUMN_DIR DIRECT /end RECORD_LAYOUT
/end MODULE
/end PROJECT
