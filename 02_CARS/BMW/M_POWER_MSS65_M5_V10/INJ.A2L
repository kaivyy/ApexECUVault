/begin PROJECT MSS65-inj "Generiert am 05.06.02 um 07:53:23"
/begin HEADER "" VERSION "R341" /end HEADER
/begin MODULE _MSS65-inj "Generiert am 05.06.02 um 07:53:23"
/begin MOD_COMMON "" BYTE_ORDER MSB_FIRST /* Default byteorder (Motorola) */ /end MOD_COMMON
/* ------------------ Abschnitt erzeugt aus debug.dat ------------------ */
/begin COMPU_METHOD FORMULA_0000 "FORMULA_0000" RAT_FUNC "%5.0" "-" COEFFS 0 1 0 0 0 1 /end COMPU_METHOD
/begin COMPU_METHOD FORMULA_0001 "FORMULA_0001" RAT_FUNC "%7.0" "-" COEFFS 0 1 0 0 0 1 /end COMPU_METHOD
/* ------------------ Abschnitt erzeugt aus glob.dat ------------------ */
/begin COMPU_METHOD FORMULA_0004 "FORMULA_0004" RAT_FUNC "%8.3" "-" COEFFS 0 16384 0 0 0 1 /end COMPU_METHOD
/begin COMPU_METHOD FORMULA_0005 "FORMULA_0005" RAT_FUNC "%5.0" "mg" COEFFS 0 1 0 0 0 1 /end COMPU_METHOD
/begin COMPU_METHOD FORMULA_0006 "FORMULA_0006" RAT_FUNC "%8.3" "-" COEFFS 0 10000 0 0 0 1 /end COMPU_METHOD
/begin COMPU_METHOD FORMULA_0007 "FORMULA_0007" RAT_FUNC "%7.2" "-" COEFFS 0 10000 0 0 0 1 /end COMPU_METHOD
/begin COMPU_METHOD FORMULA_0008 "FORMULA_0008" RAT_FUNC "%3.0" "-" COEFFS 0 1 0 0 0 1 /end COMPU_METHOD
/begin COMPU_METHOD FORMULA_0009 "FORMULA_0009" RAT_FUNC "%6.1" "mg/asp" COEFFS 0 10 0 0 0 1 /end COMPU_METHOD
/begin COMPU_METHOD FORMULA_0010 "FORMULA_0010" RAT_FUNC "%6.1" "kg/h" COEFFS 0 10 0 0 0 1 /end COMPU_METHOD
/begin COMPU_METHOD FORMULA_0011 "FORMULA_0011" RAT_FUNC "%5.0" "Upm" COEFFS 0 1 0 0 0 1 /end COMPU_METHOD
/begin COMPU_METHOD FORMULA_0016 "FORMULA_0016" RAT_FUNC "%8.3" "bar" COEFFS 0 1000 0 0 0 1 /end COMPU_METHOD
/begin COMPU_METHOD FORMULA_0017 "FORMULA_0017" TAB_VERB "%7.2" "-" COMPU_TAB_REF FORMULA_0017_VTAB /end COMPU_METHOD
/begin COMPU_VTAB FORMULA_0017_VTAB "FORMULA_0017_VTAB" TAB_VERB 15 0 "O.K." 1 "SH_TO_UB" 2 "SH_TO_GND" 4 "OPENLOAD" 8 "UNPLAUSIBEL" 32 "FILTER" 33 "FILTER/SH_TO_UB" 34 "FILTER/SH_TO_GND" 36 "FILTER/OPENLOAD" 40 "FILTER/UNPLAUSIBEL" 96 "FEHLER" 97 "FEHLER/SH_TO_UB" 98 "FEHLER/SH_TO_GND" 100 "FEHLER/OPENLOAD" 104 "FEHLER/UNPLAUSIBEL" /end COMPU_VTAB
/begin COMPU_METHOD FORMULA_0019 "FORMULA_0019" RAT_FUNC "%6.1" "øC" COEFFS 0 10 2732 0 0 1 /end COMPU_METHOD
/begin COMPU_METHOD FORMULA_0020 "FORMULA_0020" RAT_FUNC "%7.2" "%" COEFFS 0 16384 0 0 0 100 /end COMPU_METHOD
/begin COMPU_METHOD FORMULA_0022 "FORMULA_0022" RAT_FUNC "%6.1" "%" COEFFS 0 10 0 0 0 1 /end COMPU_METHOD
/begin COMPU_METHOD FORMULA_0024 "FORMULA_0024" RAT_FUNC "%7.2" "-" COEFFS 0 1 0 0 0 1 /end COMPU_METHOD
/begin COMPU_METHOD FORMULA_0031 "FORMULA_0031" RAT_FUNC "%6.1" "mbar" COEFFS 0 16 0 0 0 1 /end COMPU_METHOD
/begin COMPU_METHOD FORMULA_0035 "FORMULA_0035" RAT_FUNC "%8.3" "-" COEFFS 0 1024 0 0 0 1 /end COMPU_METHOD
/begin COMPU_METHOD FORMULA_0045 "FORMULA_0045" RAT_FUNC "%6.1" "V" COEFFS 0 10 0 0 0 1 /end COMPU_METHOD
/begin COMPU_METHOD FORMULA_0047 "FORMULA_0047" RAT_FUNC "%5.2" "-" COEFFS 0 1 0 0 0 1 /end COMPU_METHOD
/* ------------------ Abschnitt erzeugt aus pctrl.dat ------------------ */
/begin COMPU_METHOD FORMULA_0068 "FORMULA_0068" RAT_FUNC "%3.0" "ms" COEFFS 0 1 0 0 0 10 /end COMPU_METHOD
/* ------------------ Abschnitt erzeugt aus sw_confg.dat ------------------ */
/begin COMPU_METHOD FORMULA_0071 "FORMULA_0071" TAB_VERB "%7.2" "-" COMPU_TAB_REF FORMULA_0071_VTAB /end COMPU_METHOD
/begin COMPU_VTAB FORMULA_0071_VTAB "FORMULA_0071_VTAB" TAB_VERB 5 8192 "S65" 8448 "S65FLACH" 8704 "S65V" 256 "S15" 16384 "S85" DEFAULT_VALUE "undefiniert" /end COMPU_VTAB
/begin COMPU_METHOD FORMULA_0072 "FORMULA_0072" TAB_VERB "%5.2" "-" COMPU_TAB_REF FORMULA_0072_VTAB /end COMPU_METHOD
/begin COMPU_VTAB FORMULA_0072_VTAB "FORMULA_0072_VTAB" TAB_VERB 7 16 "E60" 17 "E63" 18 "E64" 32 "E65" 64 "E85" 128 "E90" 129 "E91" DEFAULT_VALUE "undefiniert" /end COMPU_VTAB
/begin COMPU_METHOD FORMULA_0073 "FORMULA_0073" TAB_VERB "%5.2" "-" COMPU_TAB_REF FORMULA_0073_VTAB /end COMPU_METHOD
/begin COMPU_VTAB FORMULA_0073_VTAB "FORMULA_0073_VTAB" TAB_VERB 2 16 "HS" 64 "SMG" DEFAULT_VALUE "undefiniert" /end COMPU_VTAB
/begin COMPU_METHOD FORMULA_0074 "FORMULA_0074" TAB_VERB "%5.2" "-" COMPU_TAB_REF FORMULA_0074_VTAB /end COMPU_METHOD
/begin COMPU_VTAB FORMULA_0074_VTAB "FORMULA_0074_VTAB" TAB_VERB 5 1 "ECE" 2 "US" 4 "Golfstaaten" 8 "ZA" 16 "JAPAN" DEFAULT_VALUE "undefiniert" /end COMPU_VTAB
/begin COMPU_METHOD FORMULA_0075 "FORMULA_0075" TAB_VERB "%5.2" "-" COMPU_TAB_REF FORMULA_0075_VTAB /end COMPU_METHOD
/begin COMPU_VTAB FORMULA_0075_VTAB "FORMULA_0075_VTAB" TAB_VERB 6 16 "EU3" 17 "EU4" 1 "D4" 32 "LEV" 33 "LEV2" 34 "ULEV" DEFAULT_VALUE "undefiniert" /end COMPU_VTAB
/begin COMPU_METHOD FORMULA_0076 "FORMULA_0076" TAB_VERB "%5.2" "-" COMPU_TAB_REF FORMULA_0076_VTAB /end COMPU_METHOD
/begin COMPU_VTAB FORMULA_0076_VTAB "FORMULA_0076_VTAB" TAB_VERB 3 1 "MIL_OFF" 2 "MIL_FSP" 4 "MIL_ON" DEFAULT_VALUE "undefiniert" /end COMPU_VTAB
/begin COMPU_METHOD FORMULA_0077 "FORMULA_0077" TAB_VERB "%5.2" "-" COMPU_TAB_REF FORMULA_0077_VTAB /end COMPU_METHOD
/begin COMPU_VTAB FORMULA_0077_VTAB "FORMULA_0077_VTAB" TAB_VERB 4 128 "Serienstand" 16 "A-Muster" 32 "B-Muster" 64 "C-Muster" DEFAULT_VALUE "undefiniert" /end COMPU_VTAB
/begin COMPU_METHOD FORMULA_0078 "FORMULA_0078" TAB_VERB "%5.2" "-" COMPU_TAB_REF FORMULA_0078_VTAB /end COMPU_METHOD
/begin COMPU_VTAB FORMULA_0078_VTAB "FORMULA_0078_VTAB" TAB_VERB 2 1 "CAN 11H" 2 "CAN 12H" DEFAULT_VALUE "undefiniert" /end COMPU_VTAB
/begin COMPU_METHOD FORMULA_0079 "FORMULA_0079" TAB_VERB "%5.2" "-" COMPU_TAB_REF FORMULA_0079_VTAB /end COMPU_METHOD
/begin COMPU_VTAB FORMULA_0079_VTAB "FORMULA_0079_VTAB" TAB_VERB 3 0 "Fz-Betrieb" 1 "Pruefstand" 2 "Rolle" /end COMPU_VTAB
/begin COMPU_METHOD FORMULA_0080 "FORMULA_0080" TAB_VERB "%5.2" "-" COMPU_TAB_REF FORMULA_0080_VTAB /end COMPU_METHOD
/begin COMPU_VTAB FORMULA_0080_VTAB "FORMULA_0080_VTAB" TAB_VERB 2 0 "aus RAM" 1 "aus Flash" /end COMPU_VTAB
/begin COMPU_METHOD FORMULA_0087 "FORMULA_0087" RAT_FUNC "%9.4" "-" COEFFS 0 32768 0 0 0 1 /end COMPU_METHOD
/begin COMPU_METHOD FORMULA_0088 "FORMULA_0088" RAT_FUNC "%8.3" "mg/ASP" COEFFS 0 64 0 0 0 1 /end COMPU_METHOD
/begin COMPU_METHOD FORMULA_0089 "FORMULA_0089" RAT_FUNC "%5.0" "mV" COEFFS 0 1024 0 0 0 5000 /end COMPU_METHOD
/* ------------------ Abschnitt erzeugt aus ekp.dat ------------------ */
/begin COMPU_METHOD FORMULA_0099 "FORMULA_0099" TAB_VERB "%5.2" "-" COMPU_TAB_REF FORMULA_0099_VTAB /end COMPU_METHOD
/begin COMPU_VTAB FORMULA_0099_VTAB "FORMULA_0099_VTAB" TAB_VERB 3 0 "EKP aus," 1 "EKP ein" 2 "EKP Druckregelung" /end COMPU_VTAB
/begin COMPU_METHOD FORMULA_0100 "FORMULA_0100" TAB_VERB "%5.2" " " COMPU_TAB_REF FORMULA_0100_VTAB /end COMPU_METHOD
/begin COMPU_VTAB FORMULA_0100_VTAB "FORMULA_0100_VTAB" TAB_VERB 2 0 "EKP Relais" 1 "EKP Druckregelung" /end COMPU_VTAB
/begin COMPU_METHOD FORMULA_0101 "FORMULA_0101" RAT_FUNC "%6.1" "ms" COEFFS 0 625 0 0 0 1 /end COMPU_METHOD
/begin COMPU_METHOD FORMULA_0102 "FORMULA_0102" RAT_FUNC "%7.2" "%" COEFFS 0 -1024 102400 0 0 100 /end COMPU_METHOD
/begin COMPU_METHOD FORMULA_0103 "FORMULA_0103" RAT_FUNC "%7.2" "s" COEFFS 0 100 0 0 0 1 /end COMPU_METHOD
/* ------------------ Abschnitt erzeugt aus hfm.dat ------------------ */
/begin COMPU_METHOD FORMULA_0112 "FORMULA_0112" RAT_FUNC "%5.0" "digit" COEFFS 0 1 0 0 0 1 /end COMPU_METHOD
/begin COMPU_METHOD FORMULA_0113 "FORMULA_0113" RAT_FUNC "%3.0" "z/asp" COEFFS 0 1 0 0 0 1 /end COMPU_METHOD
/begin COMPU_METHOD FORMULA_0115 "FORMULA_0115" RAT_FUNC "%5.2" "s" COEFFS 0 0 2.56 0 1 0 /end COMPU_METHOD
/* ------------------ Abschnitt erzeugt aus ipkdata.dat ------------------ */
/begin COMPU_METHOD FORMULA_0116 "FORMULA_0116" RAT_FUNC "%5.0" " +24hex" COEFFS 0 1 0 0 0 2 /end COMPU_METHOD
/begin COMPU_METHOD FORMULA_0117 "FORMULA_0117" RAT_FUNC "%8.1" "ms" COEFFS 0 1000 0 0 0 1 /end COMPU_METHOD
/* ------------------ Abschnitt erzeugt aus la.dat ------------------ */
/begin COMPU_METHOD FORMULA_0121 "FORMULA_0121" RAT_FUNC "%5.0" "°C" COEFFS 0 1 0 0 0 1 /end COMPU_METHOD
/begin COMPU_METHOD FORMULA_0122 "FORMULA_0122" TAB_VERB "%7.2" "-" COMPU_TAB_REF FORMULA_0122_VTAB /end COMPU_METHOD
/begin COMPU_VTAB FORMULA_0122_VTAB "FORMULA_0122_VTAB" TAB_VERB 3 1 "Sonde verf" 3 "Sonde FETT" 5 "Sonde MAGER" /end COMPU_VTAB
/begin COMPU_METHOD FORMULA_0123 "FORMULA_0123" RAT_FUNC "%9.4" "1/ms" COEFFS 0 16384000 0 0 0 1 /end COMPU_METHOD
/begin COMPU_METHOD FORMULA_0124 "FORMULA_0124" TAB_VERB "%7.2" "-" COMPU_TAB_REF FORMULA_0124_VTAB /end COMPU_METHOD
/begin COMPU_VTAB FORMULA_0124_VTAB "FORMULA_0124_VTAB" TAB_VERB 3 1 "Regler-RESET" 2 "Regler aktiv" 4 "Regler inaktiv" /end COMPU_VTAB
/begin COMPU_METHOD FORMULA_0125 "FORMULA_0125" RAT_FUNC "%7.2" "mg" COEFFS 0 64 0 0 0 1 /end COMPU_METHOD
/begin COMPU_METHOD FORMULA_0126 "FORMULA_0126" RAT_FUNC "%7.2" "ms" COEFFS 0 1000 0 0 0 32 /end COMPU_METHOD
/begin COMPU_METHOD FORMULA_0127 "FORMULA_0127" RAT_FUNC "%7.2" "-" COEFFS 0 256 0 0 0 1 /end COMPU_METHOD
/begin COMPU_METHOD FORMULA_0128 "FORMULA_0128" TAB_VERB "%7.2" "-" COMPU_TAB_REF FORMULA_0128_VTAB /end COMPU_METHOD
/begin COMPU_VTAB FORMULA_0128_VTAB "FORMULA_0128_VTAB" TAB_VERB 5 1 "LAA-RESET" 2 "LAA-AUS" 4 "LAA-F" 8 "LAA-TE-F" 16 "LAA-OFFS" /end COMPU_VTAB
/begin COMPU_METHOD FORMULA_0129 "FORMULA_0129" RAT_FUNC "%8.3" "V" COEFFS 0 1023 0 0 0 5 /end COMPU_METHOD
/begin COMPU_METHOD FORMULA_0130 "FORMULA_0130" RAT_FUNC "%7.2" "%" COEFFS 0 512 0 0 0 100 /end COMPU_METHOD
/begin COMPU_METHOD FORMULA_0131 "FORMULA_0131" RAT_FUNC "%8.3" "-" COEFFS 0 32768 0 0 0 1 /end COMPU_METHOD
/begin COMPU_METHOD FORMULA_0132 "FORMULA_0132" RAT_FUNC "%8.3" "%" COEFFS 0 512 0 0 0 100 /end COMPU_METHOD
/begin COMPU_METHOD FORMULA_0133 "FORMULA_0133" TAB_VERB "%7.2" "-" COMPU_TAB_REF FORMULA_0133_VTAB /end COMPU_METHOD
/begin COMPU_VTAB FORMULA_0133_VTAB "FORMULA_0133_VTAB" TAB_VERB 2 0 "Regler inaktiv" 1 "Regler aktiv" /end COMPU_VTAB
/begin COMPU_METHOD FORMULA_0134 "FORMULA_0134" TAB_VERB "%7.2" "-" COMPU_TAB_REF FORMULA_0134_VTAB /end COMPU_METHOD
/begin COMPU_VTAB FORMULA_0134_VTAB "FORMULA_0134_VTAB" TAB_VERB 2 0 "keine RESET-Anforderung" 1 "LA-RESET-Anforderung" /end COMPU_VTAB
/begin COMPU_METHOD FORMULA_0135 "FORMULA_0135" RAT_FUNC "%7.2" "ms" COEFFS 0 1000 0 0 0 1 /end COMPU_METHOD
/begin COMPU_METHOD FORMULA_0136 "FORMULA_0136" RAT_FUNC "%5.2" "-" COEFFS 0 128 0 0 0 1 /end COMPU_METHOD
/begin COMPU_METHOD FORMULA_0137 "FORMULA_0137" TAB_VERB "%7.2" "-" COMPU_TAB_REF FORMULA_0137_VTAB /end COMPU_METHOD
/begin COMPU_VTAB FORMULA_0137_VTAB "FORMULA_0137_VTAB" TAB_VERB 2 0 "Adaption inaktiv" 1 "Adaption aktiv" /end COMPU_VTAB
/begin COMPU_METHOD FORMULA_0138 "FORMULA_0138" TAB_VERB "%7.2" "-" COMPU_TAB_REF FORMULA_0138_VTAB /end COMPU_METHOD
/begin COMPU_VTAB FORMULA_0138_VTAB "FORMULA_0138_VTAB" TAB_VERB 2 0 "RESET inaktiv" 1 "RESET aktiv" /end COMPU_VTAB
/begin COMPU_METHOD FORMULA_0139 "FORMULA_0139" RAT_FUNC "%5.0" "ms" COEFFS 0 1 0 0 0 1 /end COMPU_METHOD
/* ------------------ Abschnitt erzeugt aus lam_soll.dat ------------------ */
/begin COMPU_METHOD FORMULA_0140 "FORMULA_0140" TAB_VERB "%7.2" "-" COMPU_TAB_REF FORMULA_0140_VTAB /end COMPU_METHOD
/begin COMPU_VTAB FORMULA_0140_VTAB "FORMULA_0140_VTAB" TAB_VERB 23 1 "START" 2 "Normalbetrieb" 4 "KAT-Heizen" 8 "Klopfschutz" 16 "Wandfilm" 32 "KAT-Schutz" 64 "Warmlauf" 128 "Vollast" 256 "BEGR-AKTIV" 257 "START/BEGR" 258 "NORMAL/BEGR" 260 "KATH/BEGR" 264 "Klopfs/BEGR" 272 "WF/BEGR" 288 "KATS/BEGR" 320 "WL/BEGR" 384 "VL/BEGR" 512 "KAT-BEGR" 1024 "WL-BEGR" 768 "KAT-BEGR/BEGR" 772 "KATH/BEGR" 1280 "WL-BEGR/BEGR" 1344 "WL/BEGR" DEFAULT_VALUE "undefiniert" /end COMPU_VTAB
/begin COMPU_METHOD FORMULA_0141 "FORMULA_0141" RAT_FUNC "%5.0" "mg" COEFFS 0 10 0 0 0 1 /end COMPU_METHOD
/begin COMPU_METHOD FORMULA_0142 "FORMULA_0142" RAT_FUNC "%5.0" "ms" COEFFS 0 1000 0 0 0 32 /end COMPU_METHOD
/begin COMPU_METHOD FORMULA_0143 "FORMULA_0143" RAT_FUNC "%8.3" "-" COEFFS 0 8192 0 0 0 1 /end COMPU_METHOD
/begin COMPU_METHOD FORMULA_0144 "FORMULA_0144" RAT_FUNC "%7.2" "mg" COEFFS 0 10 0 0 0 1 /end COMPU_METHOD
/begin COMPU_METHOD FORMULA_0145 "FORMULA_0145" RAT_FUNC "%5.0" "sec" COEFFS 0 1 0 0 0 1 /end COMPU_METHOD
/begin COMPU_METHOD FORMULA_0146 "FORMULA_0146" RAT_FUNC "%6.1" "°C" COEFFS 0 10 0 0 0 1 /end COMPU_METHOD
/begin COMPU_METHOD FORMULA_0147 "FORMULA_0147" RAT_FUNC "%8.3" "1/s" COEFFS 0 16384 0 0 0 1 /end COMPU_METHOD
/begin COMPU_METHOD FORMULA_0148 "FORMULA_0148" RAT_FUNC "%8.3" "-/s" COEFFS 0 16384 0 0 0 1 /end COMPU_METHOD
/begin COMPU_METHOD FORMULA_0149 "FORMULA_0149" RAT_FUNC "%5.0" "sec" COEFFS 0 100 0 0 0 1 /end COMPU_METHOD
/begin COMPU_METHOD FORMULA_0150 "FORMULA_0150" RAT_FUNC "%7.2" "-" COEFFS 0 128 0 0 0 1 /end COMPU_METHOD
/* ------------------ Abschnitt erzeugt aus lavk_obd.dat ------------------ */
/begin COMPU_METHOD FORMULA_0151 "FORMULA_0151" TAB_VERB "%7.2" "-" COMPU_TAB_REF FORMULA_0151_VTAB /end COMPU_METHOD
/begin COMPU_VTAB FORMULA_0151_VTAB "FORMULA_0151_VTAB" TAB_VERB 4 1 "Diag. aktiv" 3 "FETT-Plausi" 5 "MAGER-Plausi" 9 "F/M-Plausi" /end COMPU_VTAB
/begin COMPU_METHOD FORMULA_0152 "FORMULA_0152" RAT_FUNC "%6.1" "s" COEFFS 0 10 0 0 0 1 /end COMPU_METHOD
/begin COMPU_METHOD FORMULA_0153 "FORMULA_0153" TAB_VERB "%7.2" "-" COMPU_TAB_REF FORMULA_0153_VTAB /end COMPU_METHOD
/begin COMPU_VTAB FORMULA_0153_VTAB "FORMULA_0153_VTAB" TAB_VERB 2 0 "OBD-Plausi inaktiv" 1 "OBD-Plausi aktiv" /end COMPU_VTAB
/* ------------------ Abschnitt erzeugt aus lsh_nk.dat ------------------ */
/begin COMPU_METHOD FORMULA_0154 "FORMULA_0154" TAB_VERB "%7.2" "-" COMPU_TAB_REF FORMULA_0154_VTAB /end COMPU_METHOD
/begin COMPU_VTAB FORMULA_0154_VTAB "FORMULA_0154_VTAB" TAB_VERB 2 0 "LSHN inaktiv" 1 "LSHN aktiv" /end COMPU_VTAB
/begin COMPU_METHOD FORMULA_0155 "FORMULA_0155" TAB_VERB "%7.2" "-" COMPU_TAB_REF FORMULA_0155_VTAB /end COMPU_METHOD
/begin COMPU_VTAB FORMULA_0155_VTAB "FORMULA_0155_VTAB" TAB_VERB 2 0 "unter TAUP" 2 "TAUP erreicht" /end COMPU_VTAB
/begin COMPU_METHOD FORMULA_0156 "FORMULA_0156" RAT_FUNC "%5.0" "s" COEFFS 0 1 0 0 0 1 /end COMPU_METHOD
/* ------------------ Abschnitt erzeugt aus mzyl.dat ------------------ */
/begin COMPU_METHOD FORMULA_0157 "FORMULA_0157" RAT_FUNC "%8.1" "mg" COEFFS 0 10 0 0 0 1 /end COMPU_METHOD
/begin COMPU_METHOD FORMULA_0158 "FORMULA_0158" TAB_VERB "%3.0" "-" COMPU_TAB_REF FORMULA_0158_VTAB /end COMPU_METHOD
/begin COMPU_VTAB FORMULA_0158_VTAB "FORMULA_0158_VTAB" TAB_VERB 4 1 "HFM_PSAU" 2 "HFM_RGM" 4 "PSAU_RGM" 8 "AQ_RGM" /end COMPU_VTAB
/begin COMPU_METHOD FORMULA_0159 "FORMULA_0159" TAB_VERB "%5.2" "-" COMPU_TAB_REF FORMULA_0159_VTAB /end COMPU_METHOD
/begin COMPU_VTAB FORMULA_0159_VTAB "FORMULA_0159_VTAB" TAB_VERB 4 1 "HFM_PSAU" 2 "HFM_RGM" 4 "PSAU_RGM" 8 "AQ_RGM" /end COMPU_VTAB
/begin COMPU_METHOD FORMULA_0160 "FORMULA_0160" TAB_VERB "%5.2" "-" COMPU_TAB_REF FORMULA_0160_VTAB /end COMPU_METHOD
/begin COMPU_VTAB FORMULA_0160_VTAB "FORMULA_0160_VTAB" TAB_VERB 4 1 "TAN HFM" 2 "TAN Modell" 4 "TMOT" 8 "TAN+TMOT/2" /end COMPU_VTAB
/begin COMPU_METHOD FORMULA_0161 "FORMULA_0161" RAT_FUNC "%6.1" "J/K*mol" COEFFS 0 10 0 0 0 1 /end COMPU_METHOD
/* ------------------ Abschnitt erzeugt aus nwm.dat ------------------ */
/begin COMPU_METHOD FORMULA_0162 "FORMULA_0162" TAB_VERB "%3.0" "-" COMPU_TAB_REF FORMULA_0162_VTAB /end COMPU_METHOD
/begin COMPU_VTAB FORMULA_0162_VTAB "FORMULA_0162_VTAB" TAB_VERB 13 0 "ZGM" 18 "DME1" 19 "DME2" 22 "AFS" 23 "EKP" 24 "SMG" 33 "ACC" 34 "ALC" 35 "ARS" 37 "GRS" 41 "DSC" 42 "EMF" 57 "EDCK" DEFAULT_VALUE "unbekannt" /end COMPU_VTAB
/begin COMPU_METHOD FORMULA_0163 "FORMULA_0163" TAB_VERB "%3.0" "-" COMPU_TAB_REF FORMULA_0163_VTAB /end COMPU_METHOD
/begin COMPU_VTAB FORMULA_0163_VTAB "FORMULA_0163_VTAB" TAB_VERB 21 1 "Alive" 2 "Ring" 4 "Notlauf" 8 "reserved" 16 "SleepInd" 17 "SleepInd/Alive" 18 "SleepInd/Ring" 20 "SleepInd/Notlauf" 32 "SleepAck" 33 "SleepAck/Alive" 34 "SleepAck/Ring" 36 "SleepAck/Notlauf" 64 "Umlauf" 65 "Umlauf/Alive" 66 "Umlauf/Ring" 68 "Umlauf/Notlauf" 80 "SleepInd" 81 "SleepInd/Alive" 82 "SleepInd/Ring" 84 "SleepInd/Notlauf" 128 "reserved" /end COMPU_VTAB
/begin COMPU_METHOD FORMULA_0164 "FORMULA_0164" TAB_VERB "%3.0" "-" COMPU_TAB_REF FORMULA_0164_VTAB /end COMPU_METHOD
/begin COMPU_VTAB FORMULA_0164_VTAB "FORMULA_0164_VTAB" TAB_VERB 10 0 "Nothing" 1 "Start" 2 "WaitTockenSnd" 3 "WaitRingMsg" 4 "SndSkippedAlive" 5 "WaitLimp" 6 "PrepSleep" 7 "GoSleep" 8 "Sleep" 128 "Repeat" /end COMPU_VTAB
/* ------------------ Abschnitt erzeugt aus pks.dat ------------------ */
/begin COMPU_METHOD FORMULA_0169 "FORMULA_0169" RAT_FUNC "%8.3" "V" COEFFS 0 1024 0 0 0 5 /end COMPU_METHOD
/begin COMPU_METHOD FORMULA_0170 "FORMULA_0170" RAT_FUNC "%8.3" "bar/V" COEFFS 0 5000 0 0 0 1 /end COMPU_METHOD
/begin COMPU_METHOD FORMULA_0171 "FORMULA_0171" RAT_FUNC "%5.2" "s" COEFFS 0 0 1.28 0 1 0 /end COMPU_METHOD
/* ------------------ Abschnitt erzeugt aus pksr.dat ------------------ */
/begin COMPU_METHOD FORMULA_0172 "FORMULA_0172" RAT_FUNC "%6.1" "%" COEFFS 0 1024 0 0 0 100 /end COMPU_METHOD
/begin COMPU_METHOD FORMULA_0173 "FORMULA_0173" RAT_FUNC "%6.1" "l/h" COEFFS 0 8 0 0 0 1 /end COMPU_METHOD
/begin COMPU_METHOD FORMULA_0174 "FORMULA_0174" RAT_FUNC "%5.0" "g/l" COEFFS 0 1 0 0 0 1 /end COMPU_METHOD
/begin COMPU_METHOD FORMULA_0175 "FORMULA_0175" RAT_FUNC "%8.3" "bar (abs)" COEFFS 0 1000 0 0 0 1 /end COMPU_METHOD
/begin COMPU_METHOD FORMULA_0176 "FORMULA_0176" RAT_FUNC "%6.1" "%/bar" COEFFS 0 20.97152 0 0 0 1 /end COMPU_METHOD
/begin COMPU_METHOD FORMULA_0177 "FORMULA_0177" RAT_FUNC "%6.1" "%/(bar*s)" COEFFS 0 6.7109 0 0 0 1 /end COMPU_METHOD
/* ------------------ Abschnitt erzeugt aus psau.dat ------------------ */
/begin COMPU_METHOD FORMULA_0178 "FORMULA_0178" RAT_FUNC "%7.2" "mbar/Segm" COEFFS 0 16 0 0 0 1 /end COMPU_METHOD
/begin COMPU_METHOD FORMULA_0179 "FORMULA_0179" RAT_FUNC "%6.1" "mbar/V" COEFFS 0 80 0 0 0 1 /end COMPU_METHOD
/begin COMPU_METHOD FORMULA_0180 "FORMULA_0180" RAT_FUNC "%5.0" "mbar" COEFFS 0 16 0 0 0 1 /end COMPU_METHOD
/* ------------------ Abschnitt erzeugt aus rf.dat ------------------ */
/begin COMPU_METHOD FORMULA_0183 "FORMULA_0183" RAT_FUNC "%8.3" "dm**3" COEFFS 0 1000 0 0 0 1 /end COMPU_METHOD
/begin COMPU_METHOD FORMULA_0184 "FORMULA_0184" RAT_FUNC "%8.3" "Kg/m**3" COEFFS 0 1000 0 0 0 1 /end COMPU_METHOD
/begin COMPU_METHOD FORMULA_0185 "FORMULA_0185" TAB_VERB "%5.2" "-" COMPU_TAB_REF FORMULA_0185_VTAB /end COMPU_METHOD
/begin COMPU_VTAB FORMULA_0185_VTAB "FORMULA_0185_VTAB" TAB_VERB 3 1 "Konst." 2 "aus Psau" 4 "aus Drrel" /end COMPU_VTAB
/begin COMPU_METHOD FORMULA_0186 "FORMULA_0186" RAT_FUNC "%3.0" "seg" COEFFS 0 1 0 0 0 1 /end COMPU_METHOD
/* ------------------ Abschnitt erzeugt aus rg.dat ------------------ */
/begin COMPU_METHOD FORMULA_0187 "FORMULA_0187" RAT_FUNC "%7.2" "ms" COEFFS 0 100 0 0 0 1 /end COMPU_METHOD
/begin COMPU_METHOD FORMULA_0188 "FORMULA_0188" RAT_FUNC "%6.1" "øKW" COEFFS 0 10 0 0 0 1 /end COMPU_METHOD
/begin COMPU_METHOD FORMULA_0189 "FORMULA_0189" RAT_FUNC "%8.3" "qcm" COEFFS 0 1000 0 0 0 1 /end COMPU_METHOD
/begin COMPU_METHOD FORMULA_0190 "FORMULA_0190" RAT_FUNC "%9.4" "-" COEFFS 0 10000 0 0 0 1 /end COMPU_METHOD
/begin COMPU_METHOD FORMULA_0191 "FORMULA_0191" RAT_FUNC "%6.1" "ccm" COEFFS 0 10 0 0 0 1 /end COMPU_METHOD
/begin COMPU_METHOD FORMULA_0192 "FORMULA_0192" RAT_FUNC "%9.4" "mg/ccm" COEFFS 0 4096 0 0 0 1 /end COMPU_METHOD
/begin COMPU_METHOD FORMULA_0193 "FORMULA_0193" RAT_FUNC "%6.1" "1/x" COEFFS 0 0 10000 0 1 0 /end COMPU_METHOD
/begin COMPU_METHOD FORMULA_0194 "FORMULA_0194" RAT_FUNC "%7.2" "-" COEFFS 0 1000 0 0 0 1 /end COMPU_METHOD
/* ------------------ Abschnitt erzeugt aus te.dat ------------------ */
/begin COMPU_METHOD FORMULA_0200 "FORMULA_0200" TAB_VERB "%7.2" "-" COMPU_TAB_REF FORMULA_0200_VTAB /end COMPU_METHOD
/begin COMPU_VTAB FORMULA_0200_VTAB "FORMULA_0200_VTAB" TAB_VERB 3 1 "TE-Aktiv" 3 "TE-Lernen" 5 "TE-Spuelen" DEFAULT_VALUE "inaktiv" /end COMPU_VTAB
/begin COMPU_METHOD FORMULA_0201 "FORMULA_0201" TAB_VERB "%7.2" "-" COMPU_TAB_REF FORMULA_0201_VTAB /end COMPU_METHOD
/begin COMPU_VTAB FORMULA_0201_VTAB "FORMULA_0201_VTAB" TAB_VERB 2 0 "TE inaktiv" 1 "TE aktiv" /end COMPU_VTAB
/begin COMPU_METHOD FORMULA_0202 "FORMULA_0202" RAT_FUNC "%7.2" "s" COEFFS 0 10 0 0 0 1 /end COMPU_METHOD
/begin COMPU_METHOD FORMULA_0203 "FORMULA_0203" RAT_FUNC "%6.1" "%/s" COEFFS 0 1 0 0 0 1 /end COMPU_METHOD
/begin COMPU_METHOD FORMULA_0204 "FORMULA_0204" RAT_FUNC "%6.1" "Hz" COEFFS 0 0 625 0 1 0 /end COMPU_METHOD
/* ------------------ Abschnitt erzeugt aus ipk_dpr.dat ------------------ */
/begin MEASUREMENT ipk_error "Fehlerzaehler der IPK" UBYTE FORMULA_0008 0 0 0.0 255.0000 ECU_ADDRESS 0x3FB7F8 /begin FUNCTION_LIST Inter_Prozessor_Kommunikation /end FUNCTION_LIST /end MEASUREMENT
/* ------------------ Abschnitt erzeugt aus pctrl.dat ------------------ */
/begin CHARACTERISTIC K_PCTRL_TIMEOUT "Timeout der Prozessorueberwachung" VALUE 0x607EA TKW_VV_VV_UB 100.0 FORMULA_0068 0.0 2550.0000 /begin FUNCTION_LIST PCTRL /end FUNCTION_LIST /end CHARACTERISTIC
/begin MEASUREMENT pctrl_tout "Timeout Zaehler" UBYTE FORMULA_0068 0 0 0.0 2550.0000 ECU_ADDRESS 0x3FBADA /begin FUNCTION_LIST PCTRL /end FUNCTION_LIST /end MEASUREMENT
/begin MEASUREMENT pctrl_ed "PCTRL Diagnose Variable" UWORD FORMULA_0017 0 0 0.0 111.0 ECU_ADDRESS 0x3FBADC /begin FUNCTION_LIST PCTRL /end FUNCTION_LIST BIT_MASK 0x6F /end MEASUREMENT
/* ------------------ Abschnitt erzeugt aus sw_confg.dat ------------------ */
/begin CHARACTERISTIC cfg.motortyp "Konfigurationsparameter: Motortyp" VALUE 0x60C76 TKW_VV_VV_UW 100.0 FORMULA_0071 0.0 65535.0 /begin FUNCTION_LIST SG-Konfiguration /end FUNCTION_LIST FORMAT "%5.2" /end CHARACTERISTIC
/begin CHARACTERISTIC cfg.baureihe "Konfigurationsparameter: Fz Baureihe" VALUE 0x60C78 TKW_VV_VV_UB 100.0 FORMULA_0072 0.0 255.0 /begin FUNCTION_LIST SG-Konfiguration /end FUNCTION_LIST /end CHARACTERISTIC
/begin CHARACTERISTIC cfg.getriebetyp "Konfigurationsparameter: Getriebetyp" VALUE 0x60C79 TKW_VV_VV_UB 100.0 FORMULA_0073 0.0 255.0 /begin FUNCTION_LIST SG-Konfiguration /end FUNCTION_LIST /end CHARACTERISTIC
/begin CHARACTERISTIC cfg.la_variante "Konfigurationsparameter: LA-Variante" VALUE 0x60C7A TKW_VV_VV_UB 100.0 FORMULA_0074 0.0 255.0 /begin FUNCTION_LIST SG-Konfiguration /end FUNCTION_LIST /end CHARACTERISTIC
/begin CHARACTERISTIC cfg.abgas "Konfigurationsparameter: ABGAS-Variante" VALUE 0x60C7B TKW_VV_VV_UB 100.0 FORMULA_0075 0.0 255.0 /begin FUNCTION_LIST SG-Konfiguration /end FUNCTION_LIST /end CHARACTERISTIC
/begin CHARACTERISTIC cfg.diagnose "Konfigurationsparameter: Diagnose" VALUE 0x60C7C TKW_VV_VV_UB 100.0 FORMULA_0076 0.0 255.0 /begin FUNCTION_LIST SG-Konfiguration /end FUNCTION_LIST /end CHARACTERISTIC
/begin CHARACTERISTIC cfg.status "Konfigurationsparameter: SG Status" VALUE 0x60C7D TKW_VV_VV_UB 100.0 FORMULA_0077 0.0 255.0 /begin FUNCTION_LIST SG-Konfiguration /end FUNCTION_LIST /end CHARACTERISTIC
/begin CHARACTERISTIC cfg.canstand "Konfigurationsparameter: CAN Stand" VALUE 0x60C7E TKW_VV_VV_UB 100.0 FORMULA_0078 0.0 255.0 /begin FUNCTION_LIST SG-Konfiguration /end FUNCTION_LIST /end CHARACTERISTIC
/begin CHARACTERISTIC cfg.betriebsmode "Konfigurationsparameter: SG Typ" VALUE 0x60C7F TKW_VV_VV_UB 100.0 FORMULA_0079 0.0 255.0 /begin FUNCTION_LIST SG-Konfiguration /end FUNCTION_LIST /end CHARACTERISTIC
/begin CHARACTERISTIC cfg.appldaten "Konfigurationsparameter: ApplDaten" VALUE 0x60C80 TKW_VV_VV_UB 100.0 FORMULA_0080 0.0 255.0 /begin FUNCTION_LIST SG-Konfiguration /end FUNCTION_LIST /end CHARACTERISTIC
/begin CHARACTERISTIC cfg.peripherie "Konfigurationsparameter: Motorperipherie" VALUE 0x60C81 TKW_VV_VV_UB 100.0 FORMULA_0047 0.0 255.0000 /begin FUNCTION_LIST SG-Konfiguration /end FUNCTION_LIST /end CHARACTERISTIC
/begin MEASUREMENT cfg_boot_st "Bootstaus" ULONG FORMULA_0001 0 0 0.0 2147483647.0000 ECU_ADDRESS 0x3F9810 /begin FUNCTION_LIST SG-Konfiguration /end FUNCTION_LIST /end MEASUREMENT
/begin MEASUREMENT vers_boot "Booterversion" UWORD FORMULA_0000 0 0 0.0 65535.0000 ECU_ADDRESS 0x3F9814 /begin FUNCTION_LIST SG-Konfiguration /end FUNCTION_LIST /end MEASUREMENT
/begin MEASUREMENT vers_boot_index "Booterversionsindex" UWORD FORMULA_0000 0 0 0.0 65535.0000 ECU_ADDRESS 0x3F9816 /begin FUNCTION_LIST SG-Konfiguration /end FUNCTION_LIST /end MEASUREMENT
/* ------------------ Abschnitt erzeugt aus tpu_code.dat ------------------ */
/begin MEASUREMENT tpu_code_status "TPU MicroCode Status." UWORD FORMULA_0000 0 0 0.0 65535.0000 ECU_ADDRESS 0x3FBE6C /begin FUNCTION_LIST TPU /end FUNCTION_LIST /end MEASUREMENT
/* ------------------ Abschnitt erzeugt aus ekp.dat ------------------ */
/begin CHARACTERISTIC K_EKP_CFG "Konfigparameter EKP-Ansteuerung" VALUE 0x60324 TKW_VV_VV_UB 100.0 FORMULA_0100 0.0 2.0 /begin FUNCTION_LIST Kraftstoffpumpe_EKP /end FUNCTION_LIST /end CHARACTERISTIC
/begin CHARACTERISTIC K_EKP_PERIOD "Periodendauer der EKP-PWM" VALUE 0x60326 TKW_VV_VV_UW 100.0 FORMULA_0101 1.0000 100.0000 /begin FUNCTION_LIST Kraftstoffpumpe_EKP /end FUNCTION_LIST FORMAT "%4.1" /end CHARACTERISTIC
/begin CHARACTERISTIC K_EKP_TV_EIN "PWM-Tastverhaeltnis fuer EKP ein" VALUE 0x60328 TKW_VV_VV_UW 100.0 FORMULA_0102 0.0 100.0000 /begin FUNCTION_LIST Kraftstoffpumpe_EKP /end FUNCTION_LIST FORMAT "%5.2" /end CHARACTERISTIC
/begin CHARACTERISTIC K_EKP_TV_AUS "PWM-Tastverhaeltnis fuer EKP aus" VALUE 0x6032A TKW_VV_VV_UW 100.0 FORMULA_0102 0.0 100.0000 /begin FUNCTION_LIST Kraftstoffpumpe_EKP /end FUNCTION_LIST FORMAT "%5.2" /end CHARACTERISTIC
/begin CHARACTERISTIC K_EKP_T_VORLAUF "Vorlaufzeit der EKP bei S_KL15 ein" VALUE 0x6032C TKW_VV_VV_UW 100.0 FORMULA_0103 0.0 655.3500 /begin FUNCTION_LIST Kraftstoffpumpe_EKP /end FUNCTION_LIST FORMAT "%5.2" /end CHARACTERISTIC
/begin MEASUREMENT ekp_st "Status der Kraftstoffpumpen-Ansteuerung" UBYTE FORMULA_0099 0 0 0.0 4.0 ECU_ADDRESS 0x3FB631 /begin FUNCTION_LIST Kraftstoffpumpe_EKP /end FUNCTION_LIST /end MEASUREMENT
/* ------------------ Abschnitt erzeugt aus ipkdata.dat ------------------ */
/begin CHARACTERISTIC K_IPK_INJ_T_SYNC_MAX "Wartezeit INJ auf IGN" VALUE 0x60434 TKW_VV_VV_UL 100.0 FORMULA_0117 0.0 500.0000 /begin FUNCTION_LIST Inter_Prozessor_Kommunikation /end FUNCTION_LIST FORMAT "%4.1" /end CHARACTERISTIC
/begin MEASUREMENT ipk_rec_errorcount "Fehlerzaehler fuer Empfangstelegramme" UBYTE FORMULA_0008 0 0 0.0 255.0000 ECU_ADDRESS 0x3FB854 /begin FUNCTION_LIST Inter_Prozessor_Kommunikation /end FUNCTION_LIST /end MEASUREMENT
/begin MEASUREMENT ipk_rec_errorcode "Fehlerart fuer Empfangstelegramme" UBYTE FORMULA_0008 0 0 0.0 255.0000 ECU_ADDRESS 0x3FB855 /begin FUNCTION_LIST Inter_Prozessor_Kommunikation /end FUNCTION_LIST /end MEASUREMENT
/begin MEASUREMENT ipk_send_errorcount "Fehlerzaehler fuer Sendetelegramme" UBYTE FORMULA_0008 0 0 0.0 255.0000 ECU_ADDRESS 0x3FB856 /begin FUNCTION_LIST Inter_Prozessor_Kommunikation /end FUNCTION_LIST /end MEASUREMENT
/begin MEASUREMENT ipk_send_errorcode "Fehlerart fuer Sendetelegramme" UBYTE FORMULA_0008 0 0 0.0 255.0000 ECU_ADDRESS 0x3FB857 /begin FUNCTION_LIST Inter_Prozessor_Kommunikation /end FUNCTION_LIST /end MEASUREMENT
/begin MEASUREMENT dpr_test_count "" ULONG FORMULA_0001 0 0 0.0 2147483647.0000 ECU_ADDRESS 0x3FB860 /begin FUNCTION_LIST Inter_Prozessor_Kommunikation /end FUNCTION_LIST /end MEASUREMENT
/begin MEASUREMENT dpr_wert "" UBYTE FORMULA_0008 0 0 0.0 255.0000 ECU_ADDRESS 0x3FB864 /begin FUNCTION_LIST Inter_Prozessor_Kommunikation /end FUNCTION_LIST /end MEASUREMENT
/begin MEASUREMENT dpr_test_wrt_cnt "" UBYTE FORMULA_0008 0 0 0.0 255.0000 ECU_ADDRESS 0x3FB865 /begin FUNCTION_LIST Inter_Prozessor_Kommunikation /end FUNCTION_LIST /end MEASUREMENT
/begin MEASUREMENT dpr_fehler_cnt_wr "" UWORD FORMULA_0000 0 0 0.0 65535.0000 ECU_ADDRESS 0x3FB866 /begin FUNCTION_LIST Inter_Prozessor_Kommunikation /end FUNCTION_LIST /end MEASUREMENT
/begin MEASUREMENT dpr_fehler_cnt_rd "" UWORD FORMULA_0000 0 0 0.0 65535.0000 ECU_ADDRESS 0x3FB868 /begin FUNCTION_LIST Inter_Prozessor_Kommunikation /end FUNCTION_LIST /end MEASUREMENT
/begin MEASUREMENT dpr_fehler_ptr_1of20_ "" UWORD FORMULA_0116 0 0 0.0 131070.0000 ECU_ADDRESS 0x3FB86A /begin FUNCTION_LIST Inter_Prozessor_Kommunikation /end FUNCTION_LIST /end MEASUREMENT
/begin MEASUREMENT dpr_fehler_ptr_2of20_ "" UWORD FORMULA_0116 0 0 0.0 131070.0000 ECU_ADDRESS 0x3FB86C /begin FUNCTION_LIST Inter_Prozessor_Kommunikation /end FUNCTION_LIST /end MEASUREMENT
/begin MEASUREMENT dpr_fehler_ptr_3of20_ "" UWORD FORMULA_0116 0 0 0.0 131070.0000 ECU_ADDRESS 0x3FB86E /begin FUNCTION_LIST Inter_Prozessor_Kommunikation /end FUNCTION_LIST /end MEASUREMENT
/begin MEASUREMENT dpr_fehler_ptr_4of20_ "" UWORD FORMULA_0116 0 0 0.0 131070.0000 ECU_ADDRESS 0x3FB870 /begin FUNCTION_LIST Inter_Prozessor_Kommunikation /end FUNCTION_LIST /end MEASUREMENT
/begin MEASUREMENT dpr_fehler_ptr_5of20_ "" UWORD FORMULA_0116 0 0 0.0 131070.0000 ECU_ADDRESS 0x3FB872 /begin FUNCTION_LIST Inter_Prozessor_Kommunikation /end FUNCTION_LIST /end MEASUREMENT
/begin MEASUREMENT dpr_fehler_ptr_6of20_ "" UWORD FORMULA_0116 0 0 0.0 131070.0000 ECU_ADDRESS 0x3FB874 /begin FUNCTION_LIST Inter_Prozessor_Kommunikation /end FUNCTION_LIST /end MEASUREMENT
/begin MEASUREMENT dpr_fehler_ptr_7of20_ "" UWORD FORMULA_0116 0 0 0.0 131070.0000 ECU_ADDRESS 0x3FB876 /begin FUNCTION_LIST Inter_Prozessor_Kommunikation /end FUNCTION_LIST /end MEASUREMENT
/begin MEASUREMENT dpr_fehler_ptr_8of20_ "" UWORD FORMULA_0116 0 0 0.0 131070.0000 ECU_ADDRESS 0x3FB878 /begin FUNCTION_LIST Inter_Prozessor_Kommunikation /end FUNCTION_LIST /end MEASUREMENT
/begin MEASUREMENT dpr_fehler_ptr_9of20_ "" UWORD FORMULA_0116 0 0 0.0 131070.0000 ECU_ADDRESS 0x3FB87A /begin FUNCTION_LIST Inter_Prozessor_Kommunikation /end FUNCTION_LIST /end MEASUREMENT
/begin MEASUREMENT dpr_fehler_ptr_10of20_ "" UWORD FORMULA_0116 0 0 0.0 131070.0000 ECU_ADDRESS 0x3FB87C /begin FUNCTION_LIST Inter_Prozessor_Kommunikation /end FUNCTION_LIST /end MEASUREMENT
/begin MEASUREMENT dpr_fehler_ptr_11of20_ "" UWORD FORMULA_0116 0 0 0.0 131070.0000 ECU_ADDRESS 0x3FB87E /begin FUNCTION_LIST Inter_Prozessor_Kommunikation /end FUNCTION_LIST /end MEASUREMENT
/begin MEASUREMENT dpr_fehler_ptr_12of20_ "" UWORD FORMULA_0116 0 0 0.0 131070.0000 ECU_ADDRESS 0x3FB880 /begin FUNCTION_LIST Inter_Prozessor_Kommunikation /end FUNCTION_LIST /end MEASUREMENT
/begin MEASUREMENT dpr_fehler_ptr_13of20_ "" UWORD FORMULA_0116 0 0 0.0 131070.0000 ECU_ADDRESS 0x3FB882 /begin FUNCTION_LIST Inter_Prozessor_Kommunikation /end FUNCTION_LIST /end MEASUREMENT
/begin MEASUREMENT dpr_fehler_ptr_14of20_ "" UWORD FORMULA_0116 0 0 0.0 131070.0000 ECU_ADDRESS 0x3FB884 /begin FUNCTION_LIST Inter_Prozessor_Kommunikation /end FUNCTION_LIST /end MEASUREMENT
/begin MEASUREMENT dpr_fehler_ptr_15of20_ "" UWORD FORMULA_0116 0 0 0.0 131070.0000 ECU_ADDRESS 0x3FB886 /begin FUNCTION_LIST Inter_Prozessor_Kommunikation /end FUNCTION_LIST /end MEASUREMENT
/begin MEASUREMENT dpr_fehler_ptr_16of20_ "" UWORD FORMULA_0116 0 0 0.0 131070.0000 ECU_ADDRESS 0x3FB888 /begin FUNCTION_LIST Inter_Prozessor_Kommunikation /end FUNCTION_LIST /end MEASUREMENT
/begin MEASUREMENT dpr_fehler_ptr_17of20_ "" UWORD FORMULA_0116 0 0 0.0 131070.0000 ECU_ADDRESS 0x3FB88A /begin FUNCTION_LIST Inter_Prozessor_Kommunikation /end FUNCTION_LIST /end MEASUREMENT
/begin MEASUREMENT dpr_fehler_ptr_18of20_ "" UWORD FORMULA_0116 0 0 0.0 131070.0000 ECU_ADDRESS 0x3FB88C /begin FUNCTION_LIST Inter_Prozessor_Kommunikation /end FUNCTION_LIST /end MEASUREMENT
/begin MEASUREMENT dpr_fehler_ptr_19of20_ "" UWORD FORMULA_0116 0 0 0.0 131070.0000 ECU_ADDRESS 0x3FB88E /begin FUNCTION_LIST Inter_Prozessor_Kommunikation /end FUNCTION_LIST /end MEASUREMENT
/begin MEASUREMENT dpr_fehler_ptr_20of20_ "" UWORD FORMULA_0116 0 0 0.0 131070.0000 ECU_ADDRESS 0x3FB890 /begin FUNCTION_LIST Inter_Prozessor_Kommunikation /end FUNCTION_LIST /end MEASUREMENT
/begin MEASUREMENT dpr_wert_soll "" ULONG FORMULA_0001 0 0 0.0 2147483647.0000 ECU_ADDRESS 0x3FB894 /begin FUNCTION_LIST Inter_Prozessor_Kommunikation /end FUNCTION_LIST /end MEASUREMENT
/begin MEASUREMENT dpr_wert_ist "" ULONG FORMULA_0001 0 0 0.0 2147483647.0000 ECU_ADDRESS 0x3FB898 /begin FUNCTION_LIST Inter_Prozessor_Kommunikation /end FUNCTION_LIST /end MEASUREMENT
/* ------------------ Abschnitt erzeugt aus la.dat ------------------ */
/begin CHARACTERISTIC K_LAVK_VM_REG_MIN "min. Tastverhältnis" VALUE 0x6043C TKW_VV_VV_UW 100.0 FORMULA_0130 0.0 100.0000 /begin FUNCTION_LIST Lambda /end FUNCTION_LIST FORMAT "%5.2" /end CHARACTERISTIC
/begin CHARACTERISTIC K_LAVK_VM_REG_MAX "max. Tastverhältnis" VALUE 0x6043E TKW_VV_VV_UW 100.0 FORMULA_0130 0.0 100.0000 /begin FUNCTION_LIST Lambda /end FUNCTION_LIST FORMAT "%5.2" /end CHARACTERISTIC
/begin CHARACTERISTIC K_LAVK_VM_P "Tastverhältnis P-Anteil" VALUE 0x60440 TKW_VV_VV_UW 100.0 FORMULA_0130 0.0 100.0000 /begin FUNCTION_LIST Lambda /end FUNCTION_LIST FORMAT "%5.2" /end CHARACTERISTIC
/begin CHARACTERISTIC K_LAVK_VM_I "Tastverhältnis I-Anteil" VALUE 0x60442 TKW_VV_VV_UW 100.0 FORMULA_0132 0.0 100.0000 /begin FUNCTION_LIST Lambda /end FUNCTION_LIST FORMAT "%6.3" /end CHARACTERISTIC
/begin CHARACTERISTIC K_LAVK_AD_MIN "MIN-AD-Wert d. Sondensignals" VALUE 0x60444 TKW_VV_VV_UW 100.0 FORMULA_0089 0.0 5000.0000 /begin FUNCTION_LIST Lambda /end FUNCTION_LIST /end CHARACTERISTIC
/begin CHARACTERISTIC K_LAVK_AD_MAX "MAX-AD-Wert d. Sondensignals" VALUE 0x60446 TKW_VV_VV_UW 100.0 FORMULA_0089 0.0 5000.0000 /begin FUNCTION_LIST Lambda /end FUNCTION_LIST /end CHARACTERISTIC
/begin CHARACTERISTIC K_LAVK_GAIN_LAM_SCHW "Umschaltschw. f. Signalverstaerkung" VALUE 0x60448 TKW_VV_VV_UW 100.0 FORMULA_0004 0.0 3.9990 /begin FUNCTION_LIST Lambda /end FUNCTION_LIST FORMAT "%6.3" /end CHARACTERISTIC
/begin CHARACTERISTIC K_LAM_REG_CFG "Freigabe Lambdaregler" VALUE 0x6044A TKW_VV_VV_UW 100.0 FORMULA_0133 0.0 1.0 /begin FUNCTION_LIST Lambda /end FUNCTION_LIST FORMAT "%5.2" /end CHARACTERISTIC
/begin CHARACTERISTIC K_LAM_REG_RESET_CFG "RESET Lambdaregler" VALUE 0x6044C TKW_VV_VV_UW 100.0 FORMULA_0134 0.0 1.0 /begin FUNCTION_LIST Lambda /end FUNCTION_LIST FORMAT "%5.2" /end CHARACTERISTIC
/begin CHARACTERISTIC K_LAM_REG_START_TIME "Verzaegerungszeit nach Startende" VALUE 0x6044E TKW_VV_VV_UW 100.0 FORMULA_0103 0.0 655.3500 /begin FUNCTION_LIST Lambda /end FUNCTION_LIST FORMAT "%5.2" /end CHARACTERISTIC
/begin CHARACTERISTIC K_LAM_REG_TI_IST_MIN "min. SOLL-TI" VALUE 0x60450 TKW_VV_VV_UW 100.0 FORMULA_0135 0.0 65.5350 /begin FUNCTION_LIST Lambda /end FUNCTION_LIST FORMAT "%5.2" /end CHARACTERISTIC
/begin CHARACTERISTIC K_LAM_REG_IST_MW_MIN "min. IST-Lambdawert" VALUE 0x60452 TKW_VV_VV_UW 100.0 FORMULA_0004 0.0 3.9990 /begin FUNCTION_LIST Lambda /end FUNCTION_LIST FORMAT "%6.3" /end CHARACTERISTIC
/begin CHARACTERISTIC K_LAM_REG_IST_MW_MAX "max. IST_Lambdawert" VALUE 0x60454 TKW_VV_VV_UW 100.0 FORMULA_0004 0.0 3.9990 /begin FUNCTION_LIST Lambda /end FUNCTION_LIST FORMAT "%6.3" /end CHARACTERISTIC
/begin CHARACTERISTIC K_LAM_REG_SOLL_MIN "min. SOLL-Lambdawert" VALUE 0x60456 TKW_VV_VV_UW 100.0 FORMULA_0004 0.0 3.9990 /begin FUNCTION_LIST Lambda /end FUNCTION_LIST FORMAT "%6.3" /end CHARACTERISTIC
/begin CHARACTERISTIC K_LAM_REG_SOLL_MAX "max. SOLL_Lambdawert" VALUE 0x60458 TKW_VV_VV_UW 100.0 FORMULA_0004 0.0 3.9990 /begin FUNCTION_LIST Lambda /end FUNCTION_LIST FORMAT "%6.3" /end CHARACTERISTIC
/begin CHARACTERISTIC K_LAM_REG_DELTA_MIN "min. Reglerabweichung" VALUE 0x6045A TKW_VV_VV_SW 100.0 FORMULA_0004 -2.0000 1.9999 /begin FUNCTION_LIST Lambda /end FUNCTION_LIST FORMAT "%6.3" /end CHARACTERISTIC
/begin CHARACTERISTIC K_LAM_REG_DELTA_MAX "max. Reglerabweichung" VALUE 0x6045C TKW_VV_VV_SW 100.0 FORMULA_0004 -2.0000 1.9999 /begin FUNCTION_LIST Lambda /end FUNCTION_LIST FORMAT "%6.3" /end CHARACTERISTIC
/begin CHARACTERISTIC K_LAM_REG_DELTA_STAT_MAX "Regelabweichung f. stationaeren Zustand" VALUE 0x6045E TKW_VV_VV_UW 100.0 FORMULA_0004 0.0 3.9990 /begin FUNCTION_LIST Lambda /end FUNCTION_LIST FORMAT "%6.3" /end CHARACTERISTIC
/begin CHARACTERISTIC K_LAM_REG_F_MIN "Regelabweichung f. stationaeren Zustand" VALUE 0x60460 TKW_VV_VV_UW 100.0 FORMULA_0087 0.0 1.9990 /begin FUNCTION_LIST Lambda /end FUNCTION_LIST FORMAT "%7.4" /end CHARACTERISTIC
/begin CHARACTERISTIC K_LAM_REG_F_MAX "Regelabweichung f. stationaeren Zustand" VALUE 0x60462 TKW_VV_VV_UW 100.0 FORMULA_0087 0.0 1.9990 /begin FUNCTION_LIST Lambda /end FUNCTION_LIST FORMAT "%7.4" /end CHARACTERISTIC
/begin CHARACTERISTIC K_LAM_REG_TV_TU_F "Tuningfaktor Vorhaltezeit" VALUE 0x60464 TKW_VV_VV_UB 100.0 FORMULA_0136 0.0 1.9921 /begin FUNCTION_LIST Lambda /end FUNCTION_LIST /end CHARACTERISTIC
/begin CHARACTERISTIC K_LAM_REG_TN_TU_F "Tuningfaktor Nachstellzeit" VALUE 0x60465 TKW_VV_VV_UB 100.0 FORMULA_0136 0.0 1.9921 /begin FUNCTION_LIST Lambda /end FUNCTION_LIST /end CHARACTERISTIC
/begin CHARACTERISTIC K_LAM_REG_WF_MKS_REL_MAX "max. rel. Eingriff - WF-Modell" VALUE 0x60466 TKW_VV_VV_UW 100.0 FORMULA_0035 0.0 4.0000 /begin FUNCTION_LIST Lambda /end FUNCTION_LIST FORMAT "%6.3" /end CHARACTERISTIC
/begin CHARACTERISTIC K_LAA_CFG "Freigabe Lambdaadaption" VALUE 0x60468 TKW_VV_VV_UW 100.0 FORMULA_0137 0.0 1.0 /begin FUNCTION_LIST Lambda /end FUNCTION_LIST FORMAT "%5.2" /end CHARACTERISTIC
/begin CHARACTERISTIC K_LAA_RESET_CFG "Ruecksetzen d.  Lambdaadaption" VALUE 0x6046A TKW_VV_VV_UW 100.0 FORMULA_0138 0.0 1.0 /begin FUNCTION_LIST Lambda /end FUNCTION_LIST FORMAT "%5.2" /end CHARACTERISTIC
/begin CHARACTERISTIC K_LAA_TMOT_MIN "min. TMOT-Schwelle f. LAA" VALUE 0x6046C TKW_VV_VV_SW 100.0 FORMULA_0019 -50.0000 150.0000 /begin FUNCTION_LIST Lambda /end FUNCTION_LIST FORMAT "%4.1" /end CHARACTERISTIC
/begin CHARACTERISTIC K_LAA_PKS_MAX "max. PKS-Schwelle f. LAA" VALUE 0x6046E TKW_VV_VV_SW 100.0 FORMULA_0016 0.0 10.0000 /begin FUNCTION_LIST Lambda /end FUNCTION_LIST FORMAT "%6.3" /end CHARACTERISTIC
/begin CHARACTERISTIC K_LAA_F_TE_N_MAX "max. Drehzahl f. TE-LAA" VALUE 0x60470 TKW_VV_VV_SW 100.0 FORMULA_0011 0.0 10000.0000 /begin FUNCTION_LIST Lambda /end FUNCTION_LIST /end CHARACTERISTIC
/begin CHARACTERISTIC K_LAA_F_N_MIN "min. Drehzahl f. Faktor-LAA" VALUE 0x60472 TKW_VV_VV_SW 100.0 FORMULA_0011 0.0 10000.0000 /begin FUNCTION_LIST Lambda /end FUNCTION_LIST /end CHARACTERISTIC
/begin CHARACTERISTIC K_LAA_OFFS_N_MAX "max. Drehzahl f. Offset-LAA" VALUE 0x60474 TKW_VV_VV_SW 100.0 FORMULA_0011 0.0 10000.0000 /begin FUNCTION_LIST Lambda /end FUNCTION_LIST /end CHARACTERISTIC
/begin CHARACTERISTIC K_LAA_F_TE_RF_MAX "max. relative Füllung f. TE-LAA" VALUE 0x60476 TKW_VV_VV_SW 100.0 FORMULA_0006 0.0 2.0000 /begin FUNCTION_LIST Lambda /end FUNCTION_LIST FORMAT "%6.3" /end CHARACTERISTIC
/begin CHARACTERISTIC K_LAA_F_RF_MIN "min. relative Füllung f. Faktor-LAA" VALUE 0x60478 TKW_VV_VV_SW 100.0 FORMULA_0006 0.0 2.0000 /begin FUNCTION_LIST Lambda /end FUNCTION_LIST FORMAT "%6.3" /end CHARACTERISTIC
/begin CHARACTERISTIC K_LAA_OFFS_RF_MAX "max. relative Füllung f. Offset-LAA" VALUE 0x6047A TKW_VV_VV_SW 100.0 FORMULA_0006 0.0 2.0000 /begin FUNCTION_LIST Lambda /end FUNCTION_LIST FORMAT "%6.3" /end CHARACTERISTIC
/begin CHARACTERISTIC K_LAA_F_T_ADAPT "Adaptionszeitraum f. F-Adaption" VALUE 0x6047C TKW_VV_VV_UW 100.0 FORMULA_0139 0.0 65535.0000 /begin FUNCTION_LIST Lambda /end FUNCTION_LIST /end CHARACTERISTIC
/begin CHARACTERISTIC K_LAA_F_TE_T_ADAPT "Adaptionszeitraum f. F-TE-Adaption" VALUE 0x6047E TKW_VV_VV_UW 100.0 FORMULA_0139 0.0 65535.0000 /begin FUNCTION_LIST Lambda /end FUNCTION_LIST /end CHARACTERISTIC
/begin CHARACTERISTIC K_LAA_OFFS_T_ADAPT "Adaptionszeitraum f. OFFS-Adaption" VALUE 0x60480 TKW_VV_VV_UW 100.0 FORMULA_0139 0.0 65535.0000 /begin FUNCTION_LIST Lambda /end FUNCTION_LIST /end CHARACTERISTIC
/begin CHARACTERISTIC K_LAA_F_MAX "max. Adaptionsfaktor" VALUE 0x60482 TKW_VV_VV_UW 100.0 FORMULA_0087 0.0 1.9990 /begin FUNCTION_LIST Lambda /end FUNCTION_LIST FORMAT "%7.4" /end CHARACTERISTIC
/begin CHARACTERISTIC K_LAA_F_MIN "min. Adaptionsfaktor" VALUE 0x60484 TKW_VV_VV_UW 100.0 FORMULA_0087 0.0 1.9990 /begin FUNCTION_LIST Lambda /end FUNCTION_LIST FORMAT "%7.4" /end CHARACTERISTIC
/begin CHARACTERISTIC K_LAA_F_TE_MAX "max. TE-Adaptionsfaktor" VALUE 0x60486 TKW_VV_VV_UW 100.0 FORMULA_0087 0.0 1.9990 /begin FUNCTION_LIST Lambda /end FUNCTION_LIST FORMAT "%7.4" /end CHARACTERISTIC
/begin CHARACTERISTIC K_LAA_F_TE_MIN "min. TE-Adaptionsfaktor" VALUE 0x60488 TKW_VV_VV_UW 100.0 FORMULA_0087 0.0 1.9990 /begin FUNCTION_LIST Lambda /end FUNCTION_LIST FORMAT "%7.4" /end CHARACTERISTIC
/begin CHARACTERISTIC K_LAA_OFFS_MAX "max. Offset-Adaption" VALUE 0x6048A TKW_VV_VV_SW 100.0 FORMULA_0088 -512.0000 511.0000 /begin FUNCTION_LIST Lambda /end FUNCTION_LIST FORMAT "%6.3" /end CHARACTERISTIC
/begin CHARACTERISTIC K_LAA_OFFS_MIN "min. Offset-Adaption" VALUE 0x6048C TKW_VV_VV_SW 100.0 FORMULA_0088 -512.0000 511.0000 /begin FUNCTION_LIST Lambda /end FUNCTION_LIST FORMAT "%6.3" /end CHARACTERISTIC
/begin CHARACTERISTIC KL_LAVK_IST_OFFS "Adaptionsoffset der Lambdasonde" CURVE 0x6048E TKL_UW_VV_SW 100.0 FORMULA_0089 -5000.0000 5000.0000 /begin FUNCTION_LIST Lambda /end FUNCTION_LIST /begin AXIS_DESCR STD_AXIS Abgasbank FORMULA_0000 2 1.0000 2.0000 /end AXIS_DESCR /end CHARACTERISTIC
/begin CHARACTERISTIC KL_LAVK_IST_F "Adaptionsfaktor der Lambdasonde" CURVE 0x60498 TKL_UW_VV_UW 100.0 FORMULA_0035 0.0 4.0000 /begin FUNCTION_LIST Lambda /end FUNCTION_LIST /begin AXIS_DESCR STD_AXIS Abgasbank FORMULA_0000 2 1.0000 2.0000 /end AXIS_DESCR FORMAT "%6.3" /end CHARACTERISTIC
/begin CHARACTERISTIC KL_LAM_IST_GAIN8 "IST-Lambda / GAIN8" CURVE 0x604A2 TKL_SW_VV_UW 100.0 FORMULA_0004 0.0 3.9990 /begin FUNCTION_LIST Lambda /end FUNCTION_LIST /begin AXIS_DESCR STD_AXIS lavk_us_korr FORMULA_0089 24 -5000.0000 5000.0000 /end AXIS_DESCR FORMAT "%6.3" /end CHARACTERISTIC
/begin CHARACTERISTIC KL_LAM_IST_GAIN16 "IST-Lambda / GAIN16" CURVE 0x60504 TKL_SW_VV_UW 100.0 FORMULA_0004 0.0 3.9990 /begin FUNCTION_LIST Lambda /end FUNCTION_LIST /begin AXIS_DESCR STD_AXIS lavk_us_korr FORMULA_0089 24 -5000.0000 5000.0000 /end AXIS_DESCR FORMAT "%6.3" /end CHARACTERISTIC
/begin CHARACTERISTIC KL_LAM_REG_K "Reglerverstaerkung" CURVE 0x60566 TKL_SW_VV_SW 100.0 FORMULA_0127 -2.0000 2.0000 /begin FUNCTION_LIST Lambda /end FUNCTION_LIST
 /begin AXIS_DESCR STD_AXIS lam_delta_lim FORMULA_0004 3 -2.0000 1.9999 FORMAT "%6.3" /end AXIS_DESCR
 FORMAT "%5.2" /end CHARACTERISTIC
/begin CHARACTERISTIC KF_LAVK_KORR_F "Sonden-Korrekturfaktor" MAP 0x60574 TKF_SW_SW_UW 100.0 FORMULA_0035 0.0 4.0000 /begin FUNCTION_LIST Lambda /end FUNCTION_LIST
 /begin AXIS_DESCR STD_AXIS lshvk_temp_dif FORMULA_0121 6 -1300.0000 1300.0000 /end AXIS_DESCR
 /begin AXIS_DESCR STD_AXIS pabg FORMULA_0031 6 0.0 2000.0000 FORMAT "%4.1" /end AXIS_DESCR
 FORMAT "%6.3" /end CHARACTERISTIC
/begin MEASUREMENT lam_b1.lshvk_temp_dif "Temper.-Differenz LSH" SWORD FORMULA_0121 0 0 -1300.0000 1300.0000 ECU_ADDRESS 0x3FB8E0 /begin FUNCTION_LIST Lambda /end FUNCTION_LIST /end MEASUREMENT
/begin MEASUREMENT lam_b2.lshvk_temp_dif "Temper.-Differenz LSH" SWORD FORMULA_0121 0 0 -1300.0000 1300.0000 ECU_ADDRESS 0x3FB910 /begin FUNCTION_LIST Lambda /end FUNCTION_LIST /end MEASUREMENT
/begin MEASUREMENT lam_b1.lavk_st "Sonden-Status" UWORD FORMULA_0122 0 0 0.0 65535.0 ECU_ADDRESS 0x3FB8E2 /begin FUNCTION_LIST Lambda /end FUNCTION_LIST BIT_MASK 0x7 /end MEASUREMENT
/begin MEASUREMENT lam_b2.lavk_st "Sonden-Status" UWORD FORMULA_0122 0 0 0.0 65535.0 ECU_ADDRESS 0x3FB912 /begin FUNCTION_LIST Lambda /end FUNCTION_LIST BIT_MASK 0x7 /end MEASUREMENT
/begin MEASUREMENT lam_b1.lavk_ad "AD-Wert d. Sondensignals" UWORD FORMULA_0089 0 0 0.0 5000.0000 ECU_ADDRESS 0x3FB8E4 /begin FUNCTION_LIST Lambda /end FUNCTION_LIST /end MEASUREMENT
/begin MEASUREMENT lam_b2.lavk_ad "AD-Wert d. Sondensignals" UWORD FORMULA_0089 0 0 0.0 5000.0000 ECU_ADDRESS 0x3FB914 /begin FUNCTION_LIST Lambda /end FUNCTION_LIST /end MEASUREMENT
/begin MEASUREMENT lam_b1.lavk_us_korr "korrigierter AD-Wert." SWORD FORMULA_0089 0 0 -5000.0000 5000.0000 ECU_ADDRESS 0x3FB8E6 /begin FUNCTION_LIST Lambda /end FUNCTION_LIST /end MEASUREMENT
/begin MEASUREMENT lam_b2.lavk_us_korr "korrigierter AD-Wert." SWORD FORMULA_0089 0 0 -5000.0000 5000.0000 ECU_ADDRESS 0x3FB916 /begin FUNCTION_LIST Lambda /end FUNCTION_LIST /end MEASUREMENT
/begin MEASUREMENT lam_b1.ist_ad "LAM-IST aus Kennlinie" UWORD FORMULA_0004 0 0 0.0 3.9990 ECU_ADDRESS 0x3FB8E8 /begin FUNCTION_LIST Lambda /end FUNCTION_LIST /end MEASUREMENT
/begin MEASUREMENT lam_b2.ist_ad "LAM-IST aus Kennlinie" UWORD FORMULA_0004 0 0 0.0 3.9990 ECU_ADDRESS 0x3FB918 /begin FUNCTION_LIST Lambda /end FUNCTION_LIST /end MEASUREMENT
/begin MEASUREMENT lam_b1.ist_ers "errechnetes LAM-IST" UWORD FORMULA_0004 0 0 0.0 3.9990 ECU_ADDRESS 0x3FB8EA /begin FUNCTION_LIST Lambda /end FUNCTION_LIST /end MEASUREMENT
/begin MEASUREMENT lam_b2.ist_ers "errechnetes LAM-IST" UWORD FORMULA_0004 0 0 0.0 3.9990 ECU_ADDRESS 0x3FB91A /begin FUNCTION_LIST Lambda /end FUNCTION_LIST /end MEASUREMENT
/begin MEASUREMENT lam_b1.ist_mw_grad "Gradient d. LA-IST-MW" SWORD FORMULA_0123 0 0 -0.0019 0.0019 ECU_ADDRESS 0x3FB8EE /begin FUNCTION_LIST Lambda /end FUNCTION_LIST /end MEASUREMENT
/begin MEASUREMENT lam_b2.ist_mw_grad "Gradient d. LA-IST-MW" SWORD FORMULA_0123 0 0 -0.0019 0.0019 ECU_ADDRESS 0x3FB91E /begin FUNCTION_LIST Lambda /end FUNCTION_LIST /end MEASUREMENT
/begin MEASUREMENT lam_b1.zahn_nr "aktueller KW-Zahn" UWORD FORMULA_0000 0 0 0.0 65535.0000 ECU_ADDRESS 0x3FB8F0 /begin FUNCTION_LIST Lambda /end FUNCTION_LIST /end MEASUREMENT
/begin MEASUREMENT lam_b2.zahn_nr "aktueller KW-Zahn" UWORD FORMULA_0000 0 0 0.0 65535.0000 ECU_ADDRESS 0x3FB920 /begin FUNCTION_LIST Lambda /end FUNCTION_LIST /end MEASUREMENT
/begin MEASUREMENT lam_b1.reg_st "LA-Regler-Status" UWORD FORMULA_0124 0 0 0.0 65535.0 ECU_ADDRESS 0x3FB8F2 /begin FUNCTION_LIST Lambda /end FUNCTION_LIST BIT_MASK 0x7 /end MEASUREMENT
/begin MEASUREMENT lam_b2.reg_st "LA-Regler-Status" UWORD FORMULA_0124 0 0 0.0 65535.0 ECU_ADDRESS 0x3FB922 /begin FUNCTION_LIST Lambda /end FUNCTION_LIST BIT_MASK 0x7 /end MEASUREMENT
/begin MEASUREMENT lam_b1.mks_soll_zyl "gefilterte SOLL-Kraftstoffmasse" UWORD FORMULA_0125 0 0 0.0 1023.9843 ECU_ADDRESS 0x3FB8F4 /begin FUNCTION_LIST Lambda /end FUNCTION_LIST /end MEASUREMENT
/begin MEASUREMENT lam_b2.mks_soll_zyl "gefilterte SOLL-Kraftstoffmasse" UWORD FORMULA_0125 0 0 0.0 1023.9843 ECU_ADDRESS 0x3FB924 /begin FUNCTION_LIST Lambda /end FUNCTION_LIST /end MEASUREMENT
/begin MEASUREMENT lam_b1.reg_tn_roh "Nachstellzeit - roh" UWORD FORMULA_0126 0 0 0.0 2097.1200 ECU_ADDRESS 0x3FB8F6 /begin FUNCTION_LIST Lambda /end FUNCTION_LIST /end MEASUREMENT
/begin MEASUREMENT lam_b2.reg_tn_roh "Nachstellzeit - roh" UWORD FORMULA_0126 0 0 0.0 2097.1200 ECU_ADDRESS 0x3FB926 /begin FUNCTION_LIST Lambda /end FUNCTION_LIST /end MEASUREMENT
/begin MEASUREMENT lam_b1.reg_tn_i "Nachstellzeit - I-Anteil" UWORD FORMULA_0126 0 0 0.0 2097.1200 ECU_ADDRESS 0x3FB8F8 /begin FUNCTION_LIST Lambda /end FUNCTION_LIST /end MEASUREMENT
/begin MEASUREMENT lam_b2.reg_tn_i "Nachstellzeit - I-Anteil" UWORD FORMULA_0126 0 0 0.0 2097.1200 ECU_ADDRESS 0x3FB928 /begin FUNCTION_LIST Lambda /end FUNCTION_LIST /end MEASUREMENT
/begin MEASUREMENT lam_b1.reg_tv_d "Nachstellzeit - D-Anteil" UWORD FORMULA_0126 0 0 0.0 2097.1200 ECU_ADDRESS 0x3FB8FA /begin FUNCTION_LIST Lambda /end FUNCTION_LIST /end MEASUREMENT
/begin MEASUREMENT lam_b2.reg_tv_d "Nachstellzeit - D-Anteil" UWORD FORMULA_0126 0 0 0.0 2097.1200 ECU_ADDRESS 0x3FB92A /begin FUNCTION_LIST Lambda /end FUNCTION_LIST /end MEASUREMENT
/begin MEASUREMENT lam_b1.reg_k "Verstaerkungsfaktor" SWORD FORMULA_0127 0 0 -2.0000 2.0000 ECU_ADDRESS 0x3FB8FC /begin FUNCTION_LIST Lambda /end FUNCTION_LIST /end MEASUREMENT
/begin MEASUREMENT lam_b2.reg_k "Verstaerkungsfaktor" SWORD FORMULA_0127 0 0 -2.0000 2.0000 ECU_ADDRESS 0x3FB92C /begin FUNCTION_LIST Lambda /end FUNCTION_LIST /end MEASUREMENT
/begin MEASUREMENT lam_b1.reg_f "Regeleingriff" UWORD FORMULA_0087 0 0 0.0 1.9990 ECU_ADDRESS 0x3FB8FE /begin FUNCTION_LIST Lambda /end FUNCTION_LIST /end MEASUREMENT
/begin MEASUREMENT lam_b2.reg_f "Regeleingriff" UWORD FORMULA_0087 0 0 0.0 1.9990 ECU_ADDRESS 0x3FB92E /begin FUNCTION_LIST Lambda /end FUNCTION_LIST /end MEASUREMENT
/begin MEASUREMENT lam_b1.ml_delta "absolute Regelabweichung" SWORD FORMULA_0125 0 0 -512.0000 511.9843 ECU_ADDRESS 0x3FB900 /begin FUNCTION_LIST Lambda /end FUNCTION_LIST /end MEASUREMENT
/begin MEASUREMENT lam_b2.ml_delta "absolute Regelabweichung" SWORD FORMULA_0125 0 0 -512.0000 511.9843 ECU_ADDRESS 0x3FB930 /begin FUNCTION_LIST Lambda /end FUNCTION_LIST /end MEASUREMENT
/begin MEASUREMENT lam_b1.laa_st "LA-Adaption-Status" UWORD FORMULA_0128 0 0 0.0 65535.0 ECU_ADDRESS 0x3FB902 /begin FUNCTION_LIST Lambda /end FUNCTION_LIST BIT_MASK 0x1F /end MEASUREMENT
/begin MEASUREMENT lam_b2.laa_st "LA-Adaption-Status" UWORD FORMULA_0128 0 0 0.0 65535.0 ECU_ADDRESS 0x3FB932 /begin FUNCTION_LIST Lambda /end FUNCTION_LIST BIT_MASK 0x1F /end MEASUREMENT
/begin MEASUREMENT lam_b1.laa_ml_offs "Ermittlung Luftmassenoffset" SWORD FORMULA_0088 0 0 -512.0000 511.0000 ECU_ADDRESS 0x3FB904 /begin FUNCTION_LIST Lambda /end FUNCTION_LIST /end MEASUREMENT
/begin MEASUREMENT lam_b2.laa_ml_offs "Ermittlung Luftmassenoffset" SWORD FORMULA_0088 0 0 -512.0000 511.0000 ECU_ADDRESS 0x3FB934 /begin FUNCTION_LIST Lambda /end FUNCTION_LIST /end MEASUREMENT
/begin MEASUREMENT lam_b1.laa_f_ber "Faktor-Lambdaadaption ohne TE" UWORD FORMULA_0087 0 0 0.0 1.9990 ECU_ADDRESS 0x3FB906 /begin FUNCTION_LIST Lambda /end FUNCTION_LIST /end MEASUREMENT
/begin MEASUREMENT lam_b2.laa_f_ber "Faktor-Lambdaadaption ohne TE" UWORD FORMULA_0087 0 0 0.0 1.9990 ECU_ADDRESS 0x3FB936 /begin FUNCTION_LIST Lambda /end FUNCTION_LIST /end MEASUREMENT
/begin MEASUREMENT lam_b1.laa_f_te "TE-Faktor-Lambdaadaption" UWORD FORMULA_0087 0 0 0.0 1.9990 ECU_ADDRESS 0x3FB90A /begin FUNCTION_LIST Lambda /end FUNCTION_LIST /end MEASUREMENT
/begin MEASUREMENT lam_b2.laa_f_te "TE-Faktor-Lambdaadaption" UWORD FORMULA_0087 0 0 0.0 1.9990 ECU_ADDRESS 0x3FB93A /begin FUNCTION_LIST Lambda /end FUNCTION_LIST /end MEASUREMENT
/begin MEASUREMENT lam_b1.laa_ml_f "Ermittlung Luftmassenfaktor" UWORD FORMULA_0087 0 0 0.0 1.9990 ECU_ADDRESS 0x3FB908 /begin FUNCTION_LIST Lambda /end FUNCTION_LIST /end MEASUREMENT
/begin MEASUREMENT lam_b2.laa_ml_f "Ermittlung Luftmassenfaktor" UWORD FORMULA_0087 0 0 0.0 1.9990 ECU_ADDRESS 0x3FB938 /begin FUNCTION_LIST Lambda /end FUNCTION_LIST /end MEASUREMENT
/begin MEASUREMENT lam_b1.laa_ml_f_te "Ermittlung TE-Luftmassenfaktor" UWORD FORMULA_0087 0 0 0.0 1.9990 ECU_ADDRESS 0x3FB90C /begin FUNCTION_LIST Lambda /end FUNCTION_LIST /end MEASUREMENT
/begin MEASUREMENT lam_b2.laa_ml_f_te "Ermittlung TE-Luftmassenfaktor" UWORD FORMULA_0087 0 0 0.0 1.9990 ECU_ADDRESS 0x3FB93C /begin FUNCTION_LIST Lambda /end FUNCTION_LIST /end MEASUREMENT
/begin MEASUREMENT lavk_vm_r_ad "AD-Wert d. virtuellen Masse" UWORD FORMULA_0129 0 0 0.0 5.0000 ECU_ADDRESS 0x3FB940 /begin FUNCTION_LIST Lambda /end FUNCTION_LIST /end MEASUREMENT
/begin MEASUREMENT lavk_vm_soll "SOLL-Wert d. virtuellen Masse" UWORD FORMULA_0129 0 0 0.0 5.0000 ECU_ADDRESS 0x3FB942 /begin FUNCTION_LIST Lambda /end FUNCTION_LIST /end MEASUREMENT
/begin MEASUREMENT lavk_vm_reg "Tastverhältnis f. virtuellen Masse" UWORD FORMULA_0130 0 0 0.0 100.0000 ECU_ADDRESS 0x3FB944 /begin FUNCTION_LIST Lambda /end FUNCTION_LIST /end MEASUREMENT
/begin MEASUREMENT lavk_vm_p "Tastverhältnis f. P-Anteil" UWORD FORMULA_0130 0 0 0.0 100.0000 ECU_ADDRESS 0x3FB946 /begin FUNCTION_LIST Lambda /end FUNCTION_LIST /end MEASUREMENT
/begin MEASUREMENT lavk_vm_i "Tastverhältnis f. I-Anteil" UWORD FORMULA_0130 0 0 0.0 100.0000 ECU_ADDRESS 0x3FB948 /begin FUNCTION_LIST Lambda /end FUNCTION_LIST /end MEASUREMENT
/begin MEASUREMENT lam_ist_1of2_1of6_ "Lambda Istwert" UWORD FORMULA_0004 0 0 0.0 3.9990 ECU_ADDRESS 0x3FB94A /begin FUNCTION_LIST Lambda /end FUNCTION_LIST /end MEASUREMENT
/begin MEASUREMENT lam_ist_1of2_2of6_ "Lambda Istwert" UWORD FORMULA_0004 0 0 0.0 3.9990 ECU_ADDRESS 0x3FB94C /begin FUNCTION_LIST Lambda /end FUNCTION_LIST /end MEASUREMENT
/begin MEASUREMENT lam_ist_1of2_3of6_ "Lambda Istwert" UWORD FORMULA_0004 0 0 0.0 3.9990 ECU_ADDRESS 0x3FB94E /begin FUNCTION_LIST Lambda /end FUNCTION_LIST /end MEASUREMENT
/begin MEASUREMENT lam_ist_1of2_4of6_ "Lambda Istwert" UWORD FORMULA_0004 0 0 0.0 3.9990 ECU_ADDRESS 0x3FB950 /begin FUNCTION_LIST Lambda /end FUNCTION_LIST /end MEASUREMENT
/begin MEASUREMENT lam_ist_1of2_5of6_ "Lambda Istwert" UWORD FORMULA_0004 0 0 0.0 3.9990 ECU_ADDRESS 0x3FB952 /begin FUNCTION_LIST Lambda /end FUNCTION_LIST /end MEASUREMENT
/begin MEASUREMENT lam_ist_1of2_6of6_ "Lambda Istwert" UWORD FORMULA_0004 0 0 0.0 3.9990 ECU_ADDRESS 0x3FB954 /begin FUNCTION_LIST Lambda /end FUNCTION_LIST /end MEASUREMENT
/begin MEASUREMENT lam_ist_2of2_1of6_ "Lambda Istwert" UWORD FORMULA_0004 0 0 0.0 3.9990 ECU_ADDRESS 0x3FB956 /begin FUNCTION_LIST Lambda /end FUNCTION_LIST /end MEASUREMENT
/begin MEASUREMENT lam_ist_2of2_2of6_ "Lambda Istwert" UWORD FORMULA_0004 0 0 0.0 3.9990 ECU_ADDRESS 0x3FB958 /begin FUNCTION_LIST Lambda /end FUNCTION_LIST /end MEASUREMENT
/begin MEASUREMENT lam_ist_2of2_3of6_ "Lambda Istwert" UWORD FORMULA_0004 0 0 0.0 3.9990 ECU_ADDRESS 0x3FB95A /begin FUNCTION_LIST Lambda /end FUNCTION_LIST /end MEASUREMENT
/begin MEASUREMENT lam_ist_2of2_4of6_ "Lambda Istwert" UWORD FORMULA_0004 0 0 0.0 3.9990 ECU_ADDRESS 0x3FB95C /begin FUNCTION_LIST Lambda /end FUNCTION_LIST /end MEASUREMENT
/begin MEASUREMENT lam_ist_2of2_5of6_ "Lambda Istwert" UWORD FORMULA_0004 0 0 0.0 3.9990 ECU_ADDRESS 0x3FB95E /begin FUNCTION_LIST Lambda /end FUNCTION_LIST /end MEASUREMENT
/begin MEASUREMENT lam_ist_2of2_6of6_ "Lambda Istwert" UWORD FORMULA_0004 0 0 0.0 3.9990 ECU_ADDRESS 0x3FB960 /begin FUNCTION_LIST Lambda /end FUNCTION_LIST /end MEASUREMENT
/begin MEASUREMENT wf_mks_rel_1of2_1of6_ "relativer Eingriff WF-Modell" UWORD FORMULA_0035 0 0 0.0 4.0000 ECU_ADDRESS 0x3FB962 /begin FUNCTION_LIST Lambda /end FUNCTION_LIST /end MEASUREMENT
/begin MEASUREMENT wf_mks_rel_1of2_2of6_ "relativer Eingriff WF-Modell" UWORD FORMULA_0035 0 0 0.0 4.0000 ECU_ADDRESS 0x3FB964 /begin FUNCTION_LIST Lambda /end FUNCTION_LIST /end MEASUREMENT
/begin MEASUREMENT wf_mks_rel_1of2_3of6_ "relativer Eingriff WF-Modell" UWORD FORMULA_0035 0 0 0.0 4.0000 ECU_ADDRESS 0x3FB966 /begin FUNCTION_LIST Lambda /end FUNCTION_LIST /end MEASUREMENT
/begin MEASUREMENT wf_mks_rel_1of2_4of6_ "relativer Eingriff WF-Modell" UWORD FORMULA_0035 0 0 0.0 4.0000 ECU_ADDRESS 0x3FB968 /begin FUNCTION_LIST Lambda /end FUNCTION_LIST /end MEASUREMENT
/begin MEASUREMENT wf_mks_rel_1of2_5of6_ "relativer Eingriff WF-Modell" UWORD FORMULA_0035 0 0 0.0 4.0000 ECU_ADDRESS 0x3FB96A /begin FUNCTION_LIST Lambda /end FUNCTION_LIST /end MEASUREMENT
/begin MEASUREMENT wf_mks_rel_1of2_6of6_ "relativer Eingriff WF-Modell" UWORD FORMULA_0035 0 0 0.0 4.0000 ECU_ADDRESS 0x3FB96C /begin FUNCTION_LIST Lambda /end FUNCTION_LIST /end MEASUREMENT
/begin MEASUREMENT wf_mks_rel_2of2_1of6_ "relativer Eingriff WF-Modell" UWORD FORMULA_0035 0 0 0.0 4.0000 ECU_ADDRESS 0x3FB96E /begin FUNCTION_LIST Lambda /end FUNCTION_LIST /end MEASUREMENT
/begin MEASUREMENT wf_mks_rel_2of2_2of6_ "relativer Eingriff WF-Modell" UWORD FORMULA_0035 0 0 0.0 4.0000 ECU_ADDRESS 0x3FB970 /begin FUNCTION_LIST Lambda /end FUNCTION_LIST /end MEASUREMENT
/begin MEASUREMENT wf_mks_rel_2of2_3of6_ "relativer Eingriff WF-Modell" UWORD FORMULA_0035 0 0 0.0 4.0000 ECU_ADDRESS 0x3FB972 /begin FUNCTION_LIST Lambda /end FUNCTION_LIST /end MEASUREMENT
/begin MEASUREMENT wf_mks_rel_2of2_4of6_ "relativer Eingriff WF-Modell" UWORD FORMULA_0035 0 0 0.0 4.0000 ECU_ADDRESS 0x3FB974 /begin FUNCTION_LIST Lambda /end FUNCTION_LIST /end MEASUREMENT
/begin MEASUREMENT wf_mks_rel_2of2_5of6_ "relativer Eingriff WF-Modell" UWORD FORMULA_0035 0 0 0.0 4.0000 ECU_ADDRESS 0x3FB976 /begin FUNCTION_LIST Lambda /end FUNCTION_LIST /end MEASUREMENT
/begin MEASUREMENT wf_mks_rel_2of2_6of6_ "relativer Eingriff WF-Modell" UWORD FORMULA_0035 0 0 0.0 4.0000 ECU_ADDRESS 0x3FB978 /begin FUNCTION_LIST Lambda /end FUNCTION_LIST /end MEASUREMENT
/begin MEASUREMENT lam_ml_delta_rel_1of2_1of3_ "relative Regelabweichung" SWORD FORMULA_0131 0 0 -1.0000 0.9999 ECU_ADDRESS 0x3FB97A /begin FUNCTION_LIST Lambda /end FUNCTION_LIST /end MEASUREMENT
/begin MEASUREMENT lam_ml_delta_rel_1of2_2of3_ "relative Regelabweichung" SWORD FORMULA_0131 0 0 -1.0000 0.9999 ECU_ADDRESS 0x3FB97C /begin FUNCTION_LIST Lambda /end FUNCTION_LIST /end MEASUREMENT
/begin MEASUREMENT lam_ml_delta_rel_1of2_3of3_ "relative Regelabweichung" SWORD FORMULA_0131 0 0 -1.0000 0.9999 ECU_ADDRESS 0x3FB97E /begin FUNCTION_LIST Lambda /end FUNCTION_LIST /end MEASUREMENT
/begin MEASUREMENT lam_ml_delta_rel_2of2_1of3_ "relative Regelabweichung" SWORD FORMULA_0131 0 0 -1.0000 0.9999 ECU_ADDRESS 0x3FB980 /begin FUNCTION_LIST Lambda /end FUNCTION_LIST /end MEASUREMENT
/begin MEASUREMENT lam_ml_delta_rel_2of2_2of3_ "relative Regelabweichung" SWORD FORMULA_0131 0 0 -1.0000 0.9999 ECU_ADDRESS 0x3FB982 /begin FUNCTION_LIST Lambda /end FUNCTION_LIST /end MEASUREMENT
/begin MEASUREMENT lam_ml_delta_rel_2of2_3of3_ "relative Regelabweichung" SWORD FORMULA_0131 0 0 -1.0000 0.9999 ECU_ADDRESS 0x3FB984 /begin FUNCTION_LIST Lambda /end FUNCTION_LIST /end MEASUREMENT
/* ------------------ Abschnitt erzeugt aus lam_soll.dat ------------------ */
/begin CHARACTERISTIC K_LAM_SOLL_OBD_CFG "OBD-Pulsgenerator" VALUE 0x605D6 TKW_VV_VV_UW 100.0 FORMULA_0000 0.0 1.0000 /begin FUNCTION_LIST Lambda /end FUNCTION_LIST /end CHARACTERISTIC
/begin CHARACTERISTIC K_LAM_SOLL_KONV_CFG "KONV-Pulsgenerator" VALUE 0x605D8 TKW_VV_VV_UW 100.0 FORMULA_0000 0.0 1.0000 /begin FUNCTION_LIST Lambda /end FUNCTION_LIST /end CHARACTERISTIC
/begin CHARACTERISTIC K_LAM_SOLL_GRUND "SOLL-Lambda - Normalbetrieb" VALUE 0x605DA TKW_VV_VV_UW 100.0 FORMULA_0004 0.0 3.9990 /begin FUNCTION_LIST Lambda /end FUNCTION_LIST FORMAT "%6.3" /end CHARACTERISTIC
/begin CHARACTERISTIC K_LAM_SOLL_KATH_T_ML_MAX "max. Zeit fuer den Zustand KATH-Heizen" VALUE 0x605DC TKW_VV_VV_UW 100.0 FORMULA_0145 0.0 65535.0000 /begin FUNCTION_LIST Lambda /end FUNCTION_LIST /end CHARACTERISTIC
/begin CHARACTERISTIC K_LAM_SOLL_KATH_SL "SOLL-Lambda - KATH-Heizung plus SL" VALUE 0x605DE TKW_VV_VV_UW 100.0 FORMULA_0004 0.0 3.9990 /begin FUNCTION_LIST Lambda /end FUNCTION_LIST FORMAT "%6.3" /end CHARACTERISTIC
/begin CHARACTERISTIC K_LAM_SOLL_KR "SOLL-Lambda - Klopfschutz" VALUE 0x605E0 TKW_VV_VV_UW 100.0 FORMULA_0004 0.0 3.9990 /begin FUNCTION_LIST Lambda /end FUNCTION_LIST FORMAT "%6.3" /end CHARACTERISTIC
/begin CHARACTERISTIC K_LAM_SOLL_WL_TMOT_MAX "TMOT-Schwelle f. WL-Zustand-Erkennung" VALUE 0x605E2 TKW_VV_VV_SW 100.0 FORMULA_0019 -50.0000 150.0000 /begin FUNCTION_LIST Lambda /end FUNCTION_LIST FORMAT "%4.1" /end CHARACTERISTIC
/begin CHARACTERISTIC K_LAM_SOLL_WL_TMOT_HYS "TMOT-Schwelle f. WL-Zustand-Erkennung" VALUE 0x605E4 TKW_VV_VV_SW 100.0 FORMULA_0146 0.0 1000.0000 /begin FUNCTION_LIST Lambda /end FUNCTION_LIST FORMAT "%4.1" /end CHARACTERISTIC
/begin CHARACTERISTIC K_LAM_SOLL_KATH_DELTA_POS "pos. Aenderungsbegr. in KATH" VALUE 0x605E6 TKW_VV_VV_UW 100.0 FORMULA_0147 0.0 1.9990 /begin FUNCTION_LIST Lambda /end FUNCTION_LIST FORMAT "%6.3" /end CHARACTERISTIC
/begin CHARACTERISTIC K_LAM_SOLL_KATH_DELTA_NEG "neg. Aenderungsbegr. in KATH" VALUE 0x605E8 TKW_VV_VV_SW 100.0 FORMULA_0148 0.0 -2.0000 /begin FUNCTION_LIST Lambda /end FUNCTION_LIST FORMAT "%6.3" /end CHARACTERISTIC
/begin CHARACTERISTIC K_LAM_SOLL_WL_DELTA_POS "pos. Aenderungsbegr. im WL" VALUE 0x605EA TKW_VV_VV_UW 100.0 FORMULA_0147 0.0 1.9990 /begin FUNCTION_LIST Lambda /end FUNCTION_LIST FORMAT "%6.3" /end CHARACTERISTIC
/begin CHARACTERISTIC K_LAM_SOLL_WL_DELTA_NEG "neg. Aenderungsbegr. im WL" VALUE 0x605EC TKW_VV_VV_SW 100.0 FORMULA_0148 0.0 -2.0000 /begin FUNCTION_LIST Lambda /end FUNCTION_LIST FORMAT "%6.3" /end CHARACTERISTIC
/begin CHARACTERISTIC K_LAM_SOLL_FETT_ERK "FETT-Erkennung f. MS_KAT-Adaption" VALUE 0x605EE TKW_VV_VV_UW 100.0 FORMULA_0004 0.0 3.9990 /begin FUNCTION_LIST Lambda /end FUNCTION_LIST FORMAT "%6.3" /end CHARACTERISTIC
/begin CHARACTERISTIC K_LAM_SOLL_MS_KAT_MIN "KAT befuellt mit min. Sauerstoffmasse" VALUE 0x605F0 TKW_VV_VV_SW 100.0 FORMULA_0005 -32768.0000 32767.0000 /begin FUNCTION_LIST Lambda /end FUNCTION_LIST /end CHARACTERISTIC
/begin CHARACTERISTIC K_LAM_SOLL_MS_KAT_MAX "KAT befuellt mit max. Sauerstoffmasse" VALUE 0x605F2 TKW_VV_VV_SW 100.0 FORMULA_0005 -32768.0000 32767.0000 /begin FUNCTION_LIST Lambda /end FUNCTION_LIST /end CHARACTERISTIC
/begin CHARACTERISTIC K_LAM_SOLL_MS_KAT_SOLL_MIN "min. zulaessige Sauerstoffmasse" VALUE 0x605F4 TKW_VV_VV_SW 100.0 FORMULA_0005 -32768.0000 32767.0000 /begin FUNCTION_LIST Lambda /end FUNCTION_LIST /end CHARACTERISTIC
/begin CHARACTERISTIC K_LAM_SOLL_MS_KAT_SOLL_MAX "max. zulaessige Sauerstoffmasse" VALUE 0x605F6 TKW_VV_VV_SW 100.0 FORMULA_0005 -32768.0000 32767.0000 /begin FUNCTION_LIST Lambda /end FUNCTION_LIST /end CHARACTERISTIC
/begin CHARACTERISTIC K_LAM_SOLL_T_SA_MIN "min. Zeit in SA f. Adaption" VALUE 0x605F8 TKW_VV_VV_UW 100.0 FORMULA_0149 0.0 655.3500 /begin FUNCTION_LIST Lambda /end FUNCTION_LIST /end CHARACTERISTIC
/begin CHARACTERISTIC K_LAM_SOLL_T_FETT_MIN "min. Zeit in FETT f. Adaption" VALUE 0x605FA TKW_VV_VV_UW 100.0 FORMULA_0149 0.0 655.3500 /begin FUNCTION_LIST Lambda /end FUNCTION_LIST /end CHARACTERISTIC
/begin CHARACTERISTIC K_LAM_SOLL_ADD_NEG_KONV "Lambdapulshub in Richtung FETT" VALUE 0x605FC TKW_VV_VV_UW 100.0 FORMULA_0004 0.0 3.9990 /begin FUNCTION_LIST Lambda /end FUNCTION_LIST FORMAT "%6.3" /end CHARACTERISTIC
/begin CHARACTERISTIC K_LAM_SOLL_ADD_POS_KONV "Lambdapulshub in Richtung MAGER" VALUE 0x605FE TKW_VV_VV_UW 100.0 FORMULA_0004 0.0 3.9990 /begin FUNCTION_LIST Lambda /end FUNCTION_LIST FORMAT "%6.3" /end CHARACTERISTIC
/begin CHARACTERISTIC K_LAM_SOLL_PULS_TKAT_MIN "min. KAT-Temperatur f. Puls-Freigabe" VALUE 0x60600 TKW_VV_VV_SW 100.0 FORMULA_0019 -50.0000 1250.0000 /begin FUNCTION_LIST Lambda /end FUNCTION_LIST FORMAT "%4.1" /end CHARACTERISTIC
/begin CHARACTERISTIC K_LAM_SOLL_FILT_F "Filterfaktor f. lam_soll_filt" VALUE 0x60602 TKW_VV_VV_UW 100.0 FORMULA_0150 0.0 511.9921 /begin FUNCTION_LIST Lambda /end FUNCTION_LIST FORMAT "%5.2" /end CHARACTERISTIC
/begin CHARACTERISTIC K_LAM_SOLL_O2_ANT "Sauerstoffanteil d. Luft" VALUE 0x60604 TKW_VV_VV_UW 100.0 FORMULA_0150 0.0 511.9921 /begin FUNCTION_LIST Lambda /end FUNCTION_LIST FORMAT "%5.2" /end CHARACTERISTIC
/begin CHARACTERISTIC KL_LAM_SOLL_START "SOLL-Lambda von START -> ML" CURVE 0x60606 TKL_SW_VV_UW 100.0 FORMULA_0004 0.0 3.9990 /begin FUNCTION_LIST Lambda /end FUNCTION_LIST
 /begin AXIS_DESCR STD_AXIS tmot FORMULA_0019 6 -50.0000 150.0000 FORMAT "%4.1" /end AXIS_DESCR
 FORMAT "%6.3" /end CHARACTERISTIC
/begin CHARACTERISTIC KL_LAM_SOLL_KATH_FAC "Korrekturfak. f. Zustand KATH-Heizung ohne SL" CURVE 0x60620 TKL_SW_VV_UW 100.0 FORMULA_0035 0.0 4.0000 /begin FUNCTION_LIST Lambda /end FUNCTION_LIST
 /begin AXIS_DESCR STD_AXIS tmot FORMULA_0019 4 -50.0000 150.0000 FORMAT "%4.1" /end AXIS_DESCR
 FORMAT "%6.3" /end CHARACTERISTIC
/begin CHARACTERISTIC KL_LAM_SOLL_KATS "SOLL-Lambda - KAT-SCHUTZ" CURVE 0x60632 TKL_SW_VV_UW 100.0 FORMULA_0004 0.0 3.9990 /begin FUNCTION_LIST Lambda /end FUNCTION_LIST
 /begin AXIS_DESCR STD_AXIS tabg FORMULA_0019 4 -50.0000 1250.0000 FORMAT "%4.1" /end AXIS_DESCR
 FORMAT "%6.3" /end CHARACTERISTIC
/begin CHARACTERISTIC KL_LAM_SOLL_WL_F "Korrekturfak. f. Zustand Warmlaufbetrieb" CURVE 0x60644 TKL_SW_VV_UW 100.0 FORMULA_0035 0.0 4.0000 /begin FUNCTION_LIST Lambda /end FUNCTION_LIST
 /begin AXIS_DESCR STD_AXIS tmot FORMULA_0019 4 -50.0000 150.0000 FORMAT "%4.1" /end AXIS_DESCR
 FORMAT "%6.3" /end CHARACTERISTIC
/begin CHARACTERISTIC KL_LAM_SOLL_VL "SOLL-Lambda - Vollast" CURVE 0x60656 TKL_SW_VV_UW 100.0 FORMULA_0004 0.0 3.9990 /begin FUNCTION_LIST Lambda /end FUNCTION_LIST /begin AXIS_DESCR STD_AXIS n FORMULA_0011 8 0.0 10000.0000 /end AXIS_DESCR FORMAT "%6.3" /end CHARACTERISTIC
/begin CHARACTERISTIC KL_LAM_SOLL_PULS_PW_OBD "Pulsdauer f. Pulsgenerator OBD" CURVE 0x60678 TKL_UW_VV_UW 100.0 FORMULA_0103 0.0 655.3500 /begin FUNCTION_LIST Lambda /end FUNCTION_LIST /begin AXIS_DESCR STD_AXIS Abgasbank FORMULA_0000 2 1.0000 2.0000 /end AXIS_DESCR FORMAT "%5.2" /end CHARACTERISTIC
/begin CHARACTERISTIC KL_LAM_SOLL_PULS_ADD_OBD "Pulshub f. Pulsgenerator OBD" CURVE 0x60682 TKL_UW_VV_SW 100.0 FORMULA_0004 -2.0000 1.9999 /begin FUNCTION_LIST Lambda /end FUNCTION_LIST /begin AXIS_DESCR STD_AXIS Abgasbank FORMULA_0000 2 1.0000 2.0000 /end AXIS_DESCR FORMAT "%6.3" /end CHARACTERISTIC
/begin CHARACTERISTIC KF_LAM_SOLL_KATH "SOLL-Lambda - KATH-Heizung ohne SL" MAP 0x6068C TKF_SW_SW_UW 100.0 FORMULA_0004 0.0 3.9990 /begin FUNCTION_LIST Lambda /end FUNCTION_LIST /begin AXIS_DESCR STD_AXIS n FORMULA_0011 4 0.0 10000.0000 /end AXIS_DESCR /begin AXIS_DESCR STD_AXIS rf FORMULA_0006 4 0.0 2.0000 FORMAT "%6.3" /end AXIS_DESCR FORMAT "%6.3" /end CHARACTERISTIC
/begin CHARACTERISTIC KF_LAM_SOLL_WL "SOLL-Lambda - Warmlaufbetrieb" MAP 0x606BE TKF_SW_SW_UW 100.0 FORMULA_0004 0.0 3.9990 /begin FUNCTION_LIST Lambda /end FUNCTION_LIST /begin AXIS_DESCR STD_AXIS n FORMULA_0011 4 0.0 10000.0000 /end AXIS_DESCR /begin AXIS_DESCR STD_AXIS rf FORMULA_0006 4 0.0 2.0000 FORMAT "%6.3" /end AXIS_DESCR FORMAT "%6.3" /end CHARACTERISTIC
/begin CHARACTERISTIC KF_LAM_SOLL_TAU1_ABG "Zeitkonstante Abgassystem u. Sonde" MAP 0x606F0 TKF_SW_SW_UW 100.0 FORMULA_0142 0.0 643.1040 /begin FUNCTION_LIST Lambda /end FUNCTION_LIST /begin AXIS_DESCR STD_AXIS n FORMULA_0011 6 0.0 10000.0000 /end AXIS_DESCR /begin AXIS_DESCR STD_AXIS rf FORMULA_0006 4 0.0 2.0000 FORMAT "%6.3" /end AXIS_DESCR /end CHARACTERISTIC
/begin MEASUREMENT lam_w_b1.soll_puls_st "Status-Pulsgenerator" UWORD FORMULA_0024 0 0 0.0 65535.0000 ECU_ADDRESS 0x3FB986 /begin FUNCTION_LIST Lambda /end FUNCTION_LIST /end MEASUREMENT
/begin MEASUREMENT lam_w_b2.soll_puls_st "Status-Pulsgenerator" UWORD FORMULA_0024 0 0 0.0 65535.0000 ECU_ADDRESS 0x3FB9B2 /begin FUNCTION_LIST Lambda /end FUNCTION_LIST /end MEASUREMENT
/begin MEASUREMENT lam_w_b1.soll_st "LAM_SOLL-Status" UWORD FORMULA_0140 0 0 0.0 65535.0 ECU_ADDRESS 0x3FB988 /begin FUNCTION_LIST Lambda /end FUNCTION_LIST BIT_MASK 0x7FF /end MEASUREMENT
/begin MEASUREMENT lam_w_b2.soll_st "LAM_SOLL-Status" UWORD FORMULA_0140 0 0 0.0 65535.0 ECU_ADDRESS 0x3FB9B4 /begin FUNCTION_LIST Lambda /end FUNCTION_LIST BIT_MASK 0x7FF /end MEASUREMENT
/begin MEASUREMENT lam_w_b1.soll_bas "gewuenschtes SOLL-Lambda" UWORD FORMULA_0004 0 0 0.0 3.9990 ECU_ADDRESS 0x3FB98A /begin FUNCTION_LIST Lambda /end FUNCTION_LIST /end MEASUREMENT
/begin MEASUREMENT lam_w_b2.soll_bas "gewuenschtes SOLL-Lambda" UWORD FORMULA_0004 0 0 0.0 3.9990 ECU_ADDRESS 0x3FB9B6 /begin FUNCTION_LIST Lambda /end FUNCTION_LIST /end MEASUREMENT
/begin MEASUREMENT lam_w_b1.soll_bas_lim "aenderungsbegr. SOLL-Lambda" UWORD FORMULA_0004 0 0 0.0 3.9990 ECU_ADDRESS 0x3FB98C /begin FUNCTION_LIST Lambda /end FUNCTION_LIST /end MEASUREMENT
/begin MEASUREMENT lam_w_b2.soll_bas_lim "aenderungsbegr. SOLL-Lambda" UWORD FORMULA_0004 0 0 0.0 3.9990 ECU_ADDRESS 0x3FB9B8 /begin FUNCTION_LIST Lambda /end FUNCTION_LIST /end MEASUREMENT
/begin MEASUREMENT lam_w_b1.soll_bas_diff "lam_soll_bas-lam_soll_bas_lim" SWORD FORMULA_0004 0 0 -2.0000 1.9999 ECU_ADDRESS 0x3FB98E /begin FUNCTION_LIST Lambda /end FUNCTION_LIST /end MEASUREMENT
/begin MEASUREMENT lam_w_b2.soll_bas_diff "lam_soll_bas-lam_soll_bas_lim" SWORD FORMULA_0004 0 0 -2.0000 1.9999 ECU_ADDRESS 0x3FB9BA /begin FUNCTION_LIST Lambda /end FUNCTION_LIST /end MEASUREMENT
/begin MEASUREMENT lam_w_b1.soll_vl_bezug "Bezugswert f. Ermittlung VL-SOLL-Lambda" UWORD FORMULA_0004 0 0 0.0 3.9990 ECU_ADDRESS 0x3FB990 /begin FUNCTION_LIST Lambda /end FUNCTION_LIST /end MEASUREMENT
/begin MEASUREMENT lam_w_b2.soll_vl_bezug "Bezugswert f. Ermittlung VL-SOLL-Lambda" UWORD FORMULA_0004 0 0 0.0 3.9990 ECU_ADDRESS 0x3FB9BC /begin FUNCTION_LIST Lambda /end FUNCTION_LIST /end MEASUREMENT
/begin MEASUREMENT lam_w_b1.soll_delta_pos "pos. Aenderungsbegrenzung" SWORD FORMULA_0004 0 0 -2.0000 1.9999 ECU_ADDRESS 0x3FB992 /begin FUNCTION_LIST Lambda /end FUNCTION_LIST /end MEASUREMENT
/begin MEASUREMENT lam_w_b2.soll_delta_pos "pos. Aenderungsbegrenzung" SWORD FORMULA_0004 0 0 -2.0000 1.9999 ECU_ADDRESS 0x3FB9BE /begin FUNCTION_LIST Lambda /end FUNCTION_LIST /end MEASUREMENT
/begin MEASUREMENT lam_w_b1.soll_delta_neg "neg. Aenderungsbegrenzung" SWORD FORMULA_0004 0 0 -2.0000 1.9999 ECU_ADDRESS 0x3FB994 /begin FUNCTION_LIST Lambda /end FUNCTION_LIST /end MEASUREMENT
/begin MEASUREMENT lam_w_b2.soll_delta_neg "neg. Aenderungsbegrenzung" SWORD FORMULA_0004 0 0 -2.0000 1.9999 ECU_ADDRESS 0x3FB9C0 /begin FUNCTION_LIST Lambda /end FUNCTION_LIST /end MEASUREMENT
/begin MEASUREMENT lam_w_b1.soll_add_konv "Pulshub - Konvertierung" SWORD FORMULA_0004 0 0 -2.0000 1.9999 ECU_ADDRESS 0x3FB996 /begin FUNCTION_LIST Lambda /end FUNCTION_LIST /end MEASUREMENT
/begin MEASUREMENT lam_w_b2.soll_add_konv "Pulshub - Konvertierung" SWORD FORMULA_0004 0 0 -2.0000 1.9999 ECU_ADDRESS 0x3FB9C2 /begin FUNCTION_LIST Lambda /end FUNCTION_LIST /end MEASUREMENT
/begin MEASUREMENT lam_w_b1.soll_ms_kat_delta "zugefuehrte Sauerstoffmasse im KAT/ASP" SWORD FORMULA_0141 0 0 -3276.8000 3276.7000 ECU_ADDRESS 0x3FB998 /begin FUNCTION_LIST Lambda /end FUNCTION_LIST /end MEASUREMENT
/begin MEASUREMENT lam_w_b2.soll_ms_kat_delta "zugefuehrte Sauerstoffmasse im KAT/ASP" SWORD FORMULA_0141 0 0 -3276.8000 3276.7000 ECU_ADDRESS 0x3FB9C4 /begin FUNCTION_LIST Lambda /end FUNCTION_LIST /end MEASUREMENT
/begin MEASUREMENT lam_w_b1.soll_ms_kat_init "Ausgangspunkt f. Sauerstoffmassenintegration im KAT" SWORD FORMULA_0005 0 0 -32768.0000 32767.0000 ECU_ADDRESS 0x3FB99A /begin FUNCTION_LIST Lambda /end FUNCTION_LIST /end MEASUREMENT
/begin MEASUREMENT lam_w_b2.soll_ms_kat_init "Ausgangspunkt f. Sauerstoffmassenintegration im KAT" SWORD FORMULA_0005 0 0 -32768.0000 32767.0000 ECU_ADDRESS 0x3FB9C6 /begin FUNCTION_LIST Lambda /end FUNCTION_LIST /end MEASUREMENT
/begin MEASUREMENT lam_w_b1.soll_pw_cnt_obd "PW-Pulscounter f. Pulsgenerator OBD" UWORD FORMULA_0103 0 0 0.0 655.3500 ECU_ADDRESS 0x3FB99C /begin FUNCTION_LIST Lambda /end FUNCTION_LIST /end MEASUREMENT
/begin MEASUREMENT lam_w_b2.soll_pw_cnt_obd "PW-Pulscounter f. Pulsgenerator OBD" UWORD FORMULA_0103 0 0 0.0 655.3500 ECU_ADDRESS 0x3FB9C8 /begin FUNCTION_LIST Lambda /end FUNCTION_LIST /end MEASUREMENT
/begin MEASUREMENT lam_w_b1.soll_add_obd "Pulshub - OBD" SWORD FORMULA_0004 0 0 -2.0000 1.9999 ECU_ADDRESS 0x3FB99E /begin FUNCTION_LIST Lambda /end FUNCTION_LIST /end MEASUREMENT
/begin MEASUREMENT lam_w_b2.soll_add_obd "Pulshub - OBD" SWORD FORMULA_0004 0 0 -2.0000 1.9999 ECU_ADDRESS 0x3FB9CA /begin FUNCTION_LIST Lambda /end FUNCTION_LIST /end MEASUREMENT
/begin MEASUREMENT lam_w_b1.soll "ausgegebenes SOLL-Lambda" UWORD FORMULA_0004 0 0 0.0 3.9990 ECU_ADDRESS 0x3FB9A0 /begin FUNCTION_LIST Lambda /end FUNCTION_LIST /end MEASUREMENT
/begin MEASUREMENT lam_w_b2.soll "ausgegebenes SOLL-Lambda" UWORD FORMULA_0004 0 0 0.0 3.9990 ECU_ADDRESS 0x3FB9CC /begin FUNCTION_LIST Lambda /end FUNCTION_LIST /end MEASUREMENT
/begin MEASUREMENT lam_w_b1.soll_filt "gefiltertes LAM_SOLL" UWORD FORMULA_0004 0 0 0.0 3.9990 ECU_ADDRESS 0x3FB9A2 /begin FUNCTION_LIST Lambda /end FUNCTION_LIST /end MEASUREMENT
/begin MEASUREMENT lam_w_b2.soll_filt "gefiltertes LAM_SOLL" UWORD FORMULA_0004 0 0 0.0 3.9990 ECU_ADDRESS 0x3FB9CE /begin FUNCTION_LIST Lambda /end FUNCTION_LIST /end MEASUREMENT
/begin MEASUREMENT lam_w_b1.soll_tau1 "TAU1 - SOLL-Filter" UWORD FORMULA_0142 0 0 0.0 2097.0000 ECU_ADDRESS 0x3FB9A4 /begin FUNCTION_LIST Lambda /end FUNCTION_LIST /end MEASUREMENT
/begin MEASUREMENT lam_w_b2.soll_tau1 "TAU1 - SOLL-Filter" UWORD FORMULA_0142 0 0 0.0 2097.0000 ECU_ADDRESS 0x3FB9D0 /begin FUNCTION_LIST Lambda /end FUNCTION_LIST /end MEASUREMENT
/begin MEASUREMENT lam_w_b1.soll_filt_konst "SOLL-Filterkonstante" UWORD FORMULA_0143 0 0 0.0 7.9998 ECU_ADDRESS 0x3FB9A6 /begin FUNCTION_LIST Lambda /end FUNCTION_LIST /end MEASUREMENT
/begin MEASUREMENT lam_w_b2.soll_filt_konst "SOLL-Filterkonstante" UWORD FORMULA_0143 0 0 0.0 7.9998 ECU_ADDRESS 0x3FB9D2 /begin FUNCTION_LIST Lambda /end FUNCTION_LIST /end MEASUREMENT
/begin MEASUREMENT lam_w_b1.ml_zyl_filt "gefilterte zyl. Luftmasse in mg/ASP" SWORD FORMULA_0144 0 0 -3276.7000 3276.7000 ECU_ADDRESS 0x3FB9A8 /begin FUNCTION_LIST Lambda /end FUNCTION_LIST /end MEASUREMENT
/begin MEASUREMENT lam_w_b2.ml_zyl_filt "gefilterte zyl. Luftmasse in mg/ASP" SWORD FORMULA_0144 0 0 -3276.7000 3276.7000 ECU_ADDRESS 0x3FB9D4 /begin FUNCTION_LIST Lambda /end FUNCTION_LIST /end MEASUREMENT
/begin MEASUREMENT lam_soll_verz_1of2_1of6_ "verzoegertes SOLL-Lambda" UWORD FORMULA_0004 0 0 0.0 3.9990 ECU_ADDRESS 0x3FB9DE /begin FUNCTION_LIST Lambda /end FUNCTION_LIST /end MEASUREMENT
/begin MEASUREMENT lam_soll_verz_1of2_2of6_ "verzoegertes SOLL-Lambda" UWORD FORMULA_0004 0 0 0.0 3.9990 ECU_ADDRESS 0x3FB9E0 /begin FUNCTION_LIST Lambda /end FUNCTION_LIST /end MEASUREMENT
/begin MEASUREMENT lam_soll_verz_1of2_3of6_ "verzoegertes SOLL-Lambda" UWORD FORMULA_0004 0 0 0.0 3.9990 ECU_ADDRESS 0x3FB9E2 /begin FUNCTION_LIST Lambda /end FUNCTION_LIST /end MEASUREMENT
/begin MEASUREMENT lam_soll_verz_1of2_4of6_ "verzoegertes SOLL-Lambda" UWORD FORMULA_0004 0 0 0.0 3.9990 ECU_ADDRESS 0x3FB9E4 /begin FUNCTION_LIST Lambda /end FUNCTION_LIST /end MEASUREMENT
/begin MEASUREMENT lam_soll_verz_1of2_5of6_ "verzoegertes SOLL-Lambda" UWORD FORMULA_0004 0 0 0.0 3.9990 ECU_ADDRESS 0x3FB9E6 /begin FUNCTION_LIST Lambda /end FUNCTION_LIST /end MEASUREMENT
/begin MEASUREMENT lam_soll_verz_1of2_6of6_ "verzoegertes SOLL-Lambda" UWORD FORMULA_0004 0 0 0.0 3.9990 ECU_ADDRESS 0x3FB9E8 /begin FUNCTION_LIST Lambda /end FUNCTION_LIST /end MEASUREMENT
/begin MEASUREMENT lam_soll_verz_2of2_1of6_ "verzoegertes SOLL-Lambda" UWORD FORMULA_0004 0 0 0.0 3.9990 ECU_ADDRESS 0x3FB9EA /begin FUNCTION_LIST Lambda /end FUNCTION_LIST /end MEASUREMENT
/begin MEASUREMENT lam_soll_verz_2of2_2of6_ "verzoegertes SOLL-Lambda" UWORD FORMULA_0004 0 0 0.0 3.9990 ECU_ADDRESS 0x3FB9EC /begin FUNCTION_LIST Lambda /end FUNCTION_LIST /end MEASUREMENT
/begin MEASUREMENT lam_soll_verz_2of2_3of6_ "verzoegertes SOLL-Lambda" UWORD FORMULA_0004 0 0 0.0 3.9990 ECU_ADDRESS 0x3FB9EE /begin FUNCTION_LIST Lambda /end FUNCTION_LIST /end MEASUREMENT
/begin MEASUREMENT lam_soll_verz_2of2_4of6_ "verzoegertes SOLL-Lambda" UWORD FORMULA_0004 0 0 0.0 3.9990 ECU_ADDRESS 0x3FB9F0 /begin FUNCTION_LIST Lambda /end FUNCTION_LIST /end MEASUREMENT
/begin MEASUREMENT lam_soll_verz_2of2_5of6_ "verzoegertes SOLL-Lambda" UWORD FORMULA_0004 0 0 0.0 3.9990 ECU_ADDRESS 0x3FB9F2 /begin FUNCTION_LIST Lambda /end FUNCTION_LIST /end MEASUREMENT
/begin MEASUREMENT lam_soll_verz_2of2_6of6_ "verzoegertes SOLL-Lambda" UWORD FORMULA_0004 0 0 0.0 3.9990 ECU_ADDRESS 0x3FB9F4 /begin FUNCTION_LIST Lambda /end FUNCTION_LIST /end MEASUREMENT
/begin MEASUREMENT lam_soll_bz_md "md f. Uebergang TL -> VL" SWORD FORMULA_0022 0 0 0.0 100.0000 ECU_ADDRESS 0x3FB9F6 /begin FUNCTION_LIST Lambda /end FUNCTION_LIST /end MEASUREMENT
/begin MEASUREMENT lam_soll_tau1_abg "Zeitkonstante Abgassystem u. Sonde" UWORD FORMULA_0142 0 0 0.0 643.1040 ECU_ADDRESS 0x3FB9F8 /begin FUNCTION_LIST Lambda /end FUNCTION_LIST /end MEASUREMENT
/begin MEASUREMENT ml_zyl_verz_1of2_1of6_ "verzoegerte zyl. Luftmasse in mg/ASP" SWORD FORMULA_0144 0 0 -3276.7000 3276.7000 ECU_ADDRESS 0x3FB9FA /begin FUNCTION_LIST Lambda /end FUNCTION_LIST /end MEASUREMENT
/begin MEASUREMENT ml_zyl_verz_1of2_2of6_ "verzoegerte zyl. Luftmasse in mg/ASP" SWORD FORMULA_0144 0 0 -3276.7000 3276.7000 ECU_ADDRESS 0x3FB9FC /begin FUNCTION_LIST Lambda /end FUNCTION_LIST /end MEASUREMENT
/begin MEASUREMENT ml_zyl_verz_1of2_3of6_ "verzoegerte zyl. Luftmasse in mg/ASP" SWORD FORMULA_0144 0 0 -3276.7000 3276.7000 ECU_ADDRESS 0x3FB9FE /begin FUNCTION_LIST Lambda /end FUNCTION_LIST /end MEASUREMENT
/begin MEASUREMENT ml_zyl_verz_1of2_4of6_ "verzoegerte zyl. Luftmasse in mg/ASP" SWORD FORMULA_0144 0 0 -3276.7000 3276.7000 ECU_ADDRESS 0x3FBA00 /begin FUNCTION_LIST Lambda /end FUNCTION_LIST /end MEASUREMENT
/begin MEASUREMENT ml_zyl_verz_1of2_5of6_ "verzoegerte zyl. Luftmasse in mg/ASP" SWORD FORMULA_0144 0 0 -3276.7000 3276.7000 ECU_ADDRESS 0x3FBA02 /begin FUNCTION_LIST Lambda /end FUNCTION_LIST /end MEASUREMENT
/begin MEASUREMENT ml_zyl_verz_1of2_6of6_ "verzoegerte zyl. Luftmasse in mg/ASP" SWORD FORMULA_0144 0 0 -3276.7000 3276.7000 ECU_ADDRESS 0x3FBA04 /begin FUNCTION_LIST Lambda /end FUNCTION_LIST /end MEASUREMENT
/begin MEASUREMENT ml_zyl_verz_2of2_1of6_ "verzoegerte zyl. Luftmasse in mg/ASP" SWORD FORMULA_0144 0 0 -3276.7000 3276.7000 ECU_ADDRESS 0x3FBA06 /begin FUNCTION_LIST Lambda /end FUNCTION_LIST /end MEASUREMENT
/begin MEASUREMENT ml_zyl_verz_2of2_2of6_ "verzoegerte zyl. Luftmasse in mg/ASP" SWORD FORMULA_0144 0 0 -3276.7000 3276.7000 ECU_ADDRESS 0x3FBA08 /begin FUNCTION_LIST Lambda /end FUNCTION_LIST /end MEASUREMENT
/begin MEASUREMENT ml_zyl_verz_2of2_3of6_ "verzoegerte zyl. Luftmasse in mg/ASP" SWORD FORMULA_0144 0 0 -3276.7000 3276.7000 ECU_ADDRESS 0x3FBA0A /begin FUNCTION_LIST Lambda /end FUNCTION_LIST /end MEASUREMENT
/begin MEASUREMENT ml_zyl_verz_2of2_4of6_ "verzoegerte zyl. Luftmasse in mg/ASP" SWORD FORMULA_0144 0 0 -3276.7000 3276.7000 ECU_ADDRESS 0x3FBA0C /begin FUNCTION_LIST Lambda /end FUNCTION_LIST /end MEASUREMENT
/begin MEASUREMENT ml_zyl_verz_2of2_5of6_ "verzoegerte zyl. Luftmasse in mg/ASP" SWORD FORMULA_0144 0 0 -3276.7000 3276.7000 ECU_ADDRESS 0x3FBA0E /begin FUNCTION_LIST Lambda /end FUNCTION_LIST /end MEASUREMENT
/begin MEASUREMENT ml_zyl_verz_2of2_6of6_ "verzoegerte zyl. Luftmasse in mg/ASP" SWORD FORMULA_0144 0 0 -3276.7000 3276.7000 ECU_ADDRESS 0x3FBA10 /begin FUNCTION_LIST Lambda /end FUNCTION_LIST /end MEASUREMENT
/begin MEASUREMENT lam_soll_start "SOLL-Lambda von START -> ML" UWORD FORMULA_0004 0 0 0.0 3.9990 ECU_ADDRESS 0x3FBA12 /begin FUNCTION_LIST Lambda /end FUNCTION_LIST /end MEASUREMENT
/begin MEASUREMENT lam_soll_kats_tabg_1of2_ "SOLL-Lambda - KAT-SCHUTZ" UWORD FORMULA_0004 0 0 0.0 3.9990 ECU_ADDRESS 0x3FBA14 /begin FUNCTION_LIST Lambda /end FUNCTION_LIST /end MEASUREMENT
/begin MEASUREMENT lam_soll_kats_tabg_2of2_ "SOLL-Lambda - KAT-SCHUTZ" UWORD FORMULA_0004 0 0 0.0 3.9990 ECU_ADDRESS 0x3FBA16 /begin FUNCTION_LIST Lambda /end FUNCTION_LIST /end MEASUREMENT
/begin MEASUREMENT lam_soll_kath_f "Korrekturfak. f. Zustand KATH-Heizung ohne SL" UWORD FORMULA_0035 0 0 0.0 4.0000 ECU_ADDRESS 0x3FBA18 /begin FUNCTION_LIST Lambda /end FUNCTION_LIST /end MEASUREMENT
/begin MEASUREMENT lam_soll_wf_f "Korrekturfak. f. Zustand Warmlaufbetrieb" UWORD FORMULA_0035 0 0 0.0 4.0000 ECU_ADDRESS 0x3FBA1A /begin FUNCTION_LIST Lambda /end FUNCTION_LIST /end MEASUREMENT
/* ------------------ Abschnitt erzeugt aus lank.dat ------------------ */
/begin CHARACTERISTIC K_LANK_US_TAU "Zeitkonstante NKAT-Signal" VALUE 0x60736 TKW_VV_VV_UB 100.0 FORMULA_0115 0.0101 2.5600 /begin FUNCTION_LIST Lambda-NK /end FUNCTION_LIST /end CHARACTERISTIC
/begin MEASUREMENT lank_us_b1 "NKAT-Sondensignal" UWORD FORMULA_0089 0 0 0.0 1200.0000 ECU_ADDRESS 0x3FBA20 /begin FUNCTION_LIST Lambda-NK /end FUNCTION_LIST /end MEASUREMENT
/begin MEASUREMENT lank_us_b2 "NKAT-Sondensignal" UWORD FORMULA_0089 0 0 0.0 1200.0000 ECU_ADDRESS 0x3FBA22 /begin FUNCTION_LIST Lambda-NK /end FUNCTION_LIST /end MEASUREMENT
/* ------------------ Abschnitt erzeugt aus lavk_obd.dat ------------------ */
/begin CHARACTERISTIC K_LAVK_OBD_PLAU_CFG "Freigabe OBD-Plausibilitaet" VALUE 0x60738 TKW_VV_VV_UW 100.0 FORMULA_0153 0.0 1.0 /begin FUNCTION_LIST LAVK-OBD /end FUNCTION_LIST FORMAT "%5.2" /end CHARACTERISTIC
/begin CHARACTERISTIC K_LAVK_OBD_PLAU_TMOT "min. TMOT-Schwelle f. OBD-PLAUSI" VALUE 0x6073A TKW_VV_VV_SW 100.0 FORMULA_0019 -50.0000 150.0000 /begin FUNCTION_LIST LAVK-OBD /end FUNCTION_LIST FORMAT "%4.1" /end CHARACTERISTIC
/begin CHARACTERISTIC K_LAVK_OBD_PLAU_RF_MAX "max. relative Füllung f. OBD-Plausi" VALUE 0x6073C TKW_VV_VV_SW 100.0 FORMULA_0006 0.0 2.0000 /begin FUNCTION_LIST LAVK-OBD /end FUNCTION_LIST FORMAT "%6.3" /end CHARACTERISTIC
/begin CHARACTERISTIC K_LAVK_OBD_PLAU_RF_MIN "min. relative Füllung f. OBD-Plausi" VALUE 0x6073E TKW_VV_VV_SW 100.0 FORMULA_0006 0.0 2.0000 /begin FUNCTION_LIST LAVK-OBD /end FUNCTION_LIST FORMAT "%6.3" /end CHARACTERISTIC
/begin CHARACTERISTIC K_LAVK_OBD_PLAU_TKAT_MIN "min. KAT-Temperatur f. OBD-Plausi" VALUE 0x60740 TKW_VV_VV_SW 100.0 FORMULA_0019 -50.0000 150.0000 /begin FUNCTION_LIST LAVK-OBD /end FUNCTION_LIST FORMAT "%4.1" /end CHARACTERISTIC
/begin CHARACTERISTIC K_LAVK_OBD_PLAU_TKAT_MAX "min. KAT-Temperatur f. OBD-Plausi" VALUE 0x60742 TKW_VV_VV_SW 100.0 FORMULA_0019 -50.0000 150.0000 /begin FUNCTION_LIST LAVK-OBD /end FUNCTION_LIST FORMAT "%4.1" /end CHARACTERISTIC
/begin CHARACTERISTIC K_LAVK_OBD_PLAU_LANK_MIN "NKAT-Signal FETT-Schwelle f. OBD-Plausi" VALUE 0x60744 TKW_VV_VV_UW 100.0 FORMULA_0089 0.0 1200.0000 /begin FUNCTION_LIST LAVK-OBD /end FUNCTION_LIST /end CHARACTERISTIC
/begin CHARACTERISTIC K_LAVK_OBD_PLAU_LANK_MAX "NKAT-Signal MAGER-Schwelle f. OBD-Plausi" VALUE 0x60746 TKW_VV_VV_UW 100.0 FORMULA_0089 0.0 1200.0000 /begin FUNCTION_LIST LAVK-OBD /end FUNCTION_LIST /end CHARACTERISTIC
/begin CHARACTERISTIC K_LAVK_OBD_PLAU_LAM_FETT "VKAT-Lambda FETT-Schwelle f. OBD-Plausi" VALUE 0x60748 TKW_VV_VV_UW 100.0 FORMULA_0004 0.0 3.9990 /begin FUNCTION_LIST LAVK-OBD /end FUNCTION_LIST FORMAT "%6.3" /end CHARACTERISTIC
/begin CHARACTERISTIC K_LAVK_OBD_PLAU_LAM_MAGER "VKAT-Lambda MAGER-Schwelle f. OBD-Plausi" VALUE 0x6074A TKW_VV_VV_UW 100.0 FORMULA_0004 0.0 3.9990 /begin FUNCTION_LIST LAVK-OBD /end FUNCTION_LIST FORMAT "%6.3" /end CHARACTERISTIC
/begin CHARACTERISTIC K_LAVK_OBD_PLAU_LAM_MIN "VKAT-Lambda MIN-Schwelle f. OBD-Plausi" VALUE 0x6074C TKW_VV_VV_UW 100.0 FORMULA_0004 0.0 3.9990 /begin FUNCTION_LIST LAVK-OBD /end FUNCTION_LIST FORMAT "%6.3" /end CHARACTERISTIC
/begin CHARACTERISTIC K_LAVK_OBD_PLAU_LAM_MAX "VKAT-Lambda MIN-Schwelle f. OBD-Plausi" VALUE 0x6074E TKW_VV_VV_UW 100.0 FORMULA_0004 0.0 3.9990 /begin FUNCTION_LIST LAVK-OBD /end FUNCTION_LIST FORMAT "%6.3" /end CHARACTERISTIC
/begin CHARACTERISTIC K_LAVK_OBD_PLAU_F_CNT "FETT-Plausi Fehlerzaehler" VALUE 0x60750 TKW_VV_VV_UW 100.0 FORMULA_0000 0.0 255.0000 /begin FUNCTION_LIST LAVK-OBD /end FUNCTION_LIST /end CHARACTERISTIC
/begin CHARACTERISTIC K_LAVK_OBD_PLAU_M_CNT "MAGER-Plausi Fehlerzaehler" VALUE 0x60752 TKW_VV_VV_UW 100.0 FORMULA_0000 0.0 255.0000 /begin FUNCTION_LIST LAVK-OBD /end FUNCTION_LIST /end CHARACTERISTIC
/begin CHARACTERISTIC K_LAVK_OBD_PLAU_FM_CNT "F/M-Plausi Fehlerzaehler" VALUE 0x60754 TKW_VV_VV_UW 100.0 FORMULA_0000 0.0 65535.0000 /begin FUNCTION_LIST LAVK-OBD /end FUNCTION_LIST /end CHARACTERISTIC
/begin CHARACTERISTIC K_LAVK_OBD_PLAU_T "Verzoegerungszeit OBD-Plausibilisierung" VALUE 0x60756 TKW_VV_VV_UW 100.0 FORMULA_0152 0.0 6553.5000 /begin FUNCTION_LIST LAVK-OBD /end FUNCTION_LIST FORMAT "%4.1" /end CHARACTERISTIC
/begin MEASUREMENT lavk_obd_plau_st_1of2_ "Status OBD-LAVK-Plausibilisierung" UWORD FORMULA_0151 0 0 0.0 65535.0 ECU_ADDRESS 0x3FBA24 /begin FUNCTION_LIST LAVK-OBD /end FUNCTION_LIST BIT_MASK 0xF /end MEASUREMENT
/begin MEASUREMENT lavk_obd_plau_st_2of2_ "Status OBD-LAVK-Plausibilisierung" UWORD FORMULA_0151 0 0 0.0 65535.0 ECU_ADDRESS 0x3FBA26 /begin FUNCTION_LIST LAVK-OBD /end FUNCTION_LIST BIT_MASK 0xF /end MEASUREMENT
/begin MEASUREMENT lavk_obd_plau_t_1of2_ "Verzoegerungszeit" UWORD FORMULA_0152 0 0 0.0 6553.5000 ECU_ADDRESS 0x3FBA28 /begin FUNCTION_LIST LAVK-OBD /end FUNCTION_LIST /end MEASUREMENT
/begin MEASUREMENT lavk_obd_plau_t_2of2_ "Verzoegerungszeit" UWORD FORMULA_0152 0 0 0.0 6553.5000 ECU_ADDRESS 0x3FBA2A /begin FUNCTION_LIST LAVK-OBD /end FUNCTION_LIST /end MEASUREMENT
/begin MEASUREMENT lavk_obd_plau_f_cnt_1of2_ "Fehlerzaehler FETT-Plausi" UWORD FORMULA_0000 0 0 0.0 65535.0000 ECU_ADDRESS 0x3FBA2C /begin FUNCTION_LIST LAVK-OBD /end FUNCTION_LIST /end MEASUREMENT
/begin MEASUREMENT lavk_obd_plau_f_cnt_2of2_ "Fehlerzaehler FETT-Plausi" UWORD FORMULA_0000 0 0 0.0 65535.0000 ECU_ADDRESS 0x3FBA2E /begin FUNCTION_LIST LAVK-OBD /end FUNCTION_LIST /end MEASUREMENT
/begin MEASUREMENT lavk_obd_plau_m_cnt_1of2_ "Fehlerzaehler MAGER-Plausi" UWORD FORMULA_0000 0 0 0.0 65535.0000 ECU_ADDRESS 0x3FBA30 /begin FUNCTION_LIST LAVK-OBD /end FUNCTION_LIST /end MEASUREMENT
/begin MEASUREMENT lavk_obd_plau_m_cnt_2of2_ "Fehlerzaehler MAGER-Plausi" UWORD FORMULA_0000 0 0 0.0 65535.0000 ECU_ADDRESS 0x3FBA32 /begin FUNCTION_LIST LAVK-OBD /end FUNCTION_LIST /end MEASUREMENT
/begin MEASUREMENT lavk_obd_plau_fm_cnt_1of2_ "Fehlerzaehler F/M-Plausi" UWORD FORMULA_0000 0 0 0.0 65535.0000 ECU_ADDRESS 0x3FBA34 /begin FUNCTION_LIST LAVK-OBD /end FUNCTION_LIST /end MEASUREMENT
/begin MEASUREMENT lavk_obd_plau_fm_cnt_2of2_ "Fehlerzaehler F/M-Plausi" UWORD FORMULA_0000 0 0 0.0 65535.0000 ECU_ADDRESS 0x3FBA36 /begin FUNCTION_LIST LAVK-OBD /end FUNCTION_LIST /end MEASUREMENT
/* ------------------ Abschnitt erzeugt aus lsh_nk.dat ------------------ */
/begin CHARACTERISTIC K_LSHNK_UB_MAX "max. UB-Spannung" VALUE 0x60758 TKW_VV_VV_SW 100.0 FORMULA_0045 0.0 28.0000 /begin FUNCTION_LIST LSHNK /end FUNCTION_LIST FORMAT "%4.1" /end CHARACTERISTIC
/begin CHARACTERISTIC K_LSHNK_RF_HYS "Hysterese f. RF-Schwelle" VALUE 0x6075A TKW_VV_VV_SW 100.0 FORMULA_0006 0.0 2.0000 /begin FUNCTION_LIST LSHNK /end FUNCTION_LIST FORMAT "%6.3" /end CHARACTERISTIC
/begin CHARACTERISTIC K_LSHNK_TKAT_MAX "max. KAT-Temperatur" VALUE 0x6075C TKW_VV_VV_SW 100.0 FORMULA_0019 -50.0000 1250.0000 /begin FUNCTION_LIST LSHNK /end FUNCTION_LIST FORMAT "%4.1" /end CHARACTERISTIC
/begin CHARACTERISTIC K_LSHNK_TAUP "Taupunkttemperatur" VALUE 0x6075E TKW_VV_VV_SW 100.0 FORMULA_0019 -50.0000 1250.0000 /begin FUNCTION_LIST LSHNK /end FUNCTION_LIST FORMAT "%4.1" /end CHARACTERISTIC
/begin CHARACTERISTIC K_LSHNK_MAX "max. Tastverhältnis" VALUE 0x60760 TKW_VV_VV_UW 100.0 FORMULA_0020 0.0 100.0000 /begin FUNCTION_LIST LSHNK /end FUNCTION_LIST FORMAT "%5.2" /end CHARACTERISTIC
/begin CHARACTERISTIC KL_LSHNK_T_EIN "Verzoegerungszeit NKAT" CURVE 0x60762 TKL_SW_VV_UW 100.0 FORMULA_0145 0.0 65535.0000 /begin FUNCTION_LIST LSHNK /end FUNCTION_LIST
 /begin AXIS_DESCR STD_AXIS tmot FORMULA_0019 3 -50.0000 150.0000 FORMAT "%4.1" /end AXIS_DESCR
/end CHARACTERISTIC
/begin CHARACTERISTIC KL_LSHNK_RF_AUS "RF-Schwelle - Ausschaltbedingung" CURVE 0x60770 TKL_SW_VV_SW 100.0 FORMULA_0006 0.0 2.0000 /begin FUNCTION_LIST LSHNK /end FUNCTION_LIST /begin AXIS_DESCR STD_AXIS n FORMULA_0011 5 0.0 10000.0000 /end AXIS_DESCR FORMAT "%6.3" /end CHARACTERISTIC
/begin CHARACTERISTIC KL_LSHNK_TA "Tastverhaeltnis" CURVE 0x60786 TKL_SW_VV_UW 100.0 FORMULA_0020 0.0 100.0000 /begin FUNCTION_LIST LSHNK /end FUNCTION_LIST /begin AXIS_DESCR STD_AXIS ub FORMULA_0045 4 0.0 28.0000 FORMAT "%4.1" /end AXIS_DESCR FORMAT "%5.2" /end CHARACTERISTIC
/begin MEASUREMENT lshnk_ta_b1 "Ansteuertastverhaeltnis NKAT" UWORD FORMULA_0020 0 0 0.0 100.0000 ECU_ADDRESS 0x3FBA3C /begin FUNCTION_LIST LSHNK /end FUNCTION_LIST /end MEASUREMENT
/begin MEASUREMENT lshnk_ta_b2 "Ansteuertastverhaeltnis NKAT" UWORD FORMULA_0020 0 0 0.0 100.0000 ECU_ADDRESS 0x3FBA3E /begin FUNCTION_LIST LSHNK /end FUNCTION_LIST /end MEASUREMENT
/begin MEASUREMENT lshnk_st "NKAT-LSH-Status" UWORD FORMULA_0024 0 0 0.0 65535.0000 ECU_ADDRESS 0x3FBA40 /begin FUNCTION_LIST LSHNK /end FUNCTION_LIST /end MEASUREMENT
/begin MEASUREMENT lshnk_ein "NKAT-LSH-EIN" UWORD FORMULA_0154 0 0 0.0 65535.0 ECU_ADDRESS 0x3FBA40 /begin FUNCTION_LIST LSHNK /end FUNCTION_LIST BIT_MASK 0x1 /end MEASUREMENT
/begin MEASUREMENT lshnk_taup "NKAT-LSH-TAUP" UWORD FORMULA_0155 0 0 0.0 65535.0 ECU_ADDRESS 0x3FBA40 /begin FUNCTION_LIST LSHNK /end FUNCTION_LIST BIT_MASK 0x2 /end MEASUREMENT
/begin MEASUREMENT lshnk_rf_aus "Ausschaltschwelle RF fuer LSHN" SWORD FORMULA_0006 0 0 0.0 2.0000 ECU_ADDRESS 0x3FBA42 /begin FUNCTION_LIST LSHNK /end FUNCTION_LIST /end MEASUREMENT
/begin MEASUREMENT lshnk_t_ein "Verzoegerungszeit nach START" UWORD FORMULA_0156 0 0 0.0 65535.0000 ECU_ADDRESS 0x3FBA44 /begin FUNCTION_LIST LSHNK /end FUNCTION_LIST /end MEASUREMENT
/* ------------------ Abschnitt erzeugt aus mzyl.dat ------------------ */
/begin CHARACTERISTIC K_MZYL_CFG "Schalter fuer Art der Fuellungsberechnung" VALUE 0x60798 TKW_VV_VV_UB 100.0 FORMULA_0159 0.0 255.0 /begin FUNCTION_LIST MZYL /end FUNCTION_LIST /end CHARACTERISTIC
/begin CHARACTERISTIC K_MZYL_T_CFG "TAN fuer Fuellungsber. aus PSAU" VALUE 0x60799 TKW_VV_VV_UB 100.0 FORMULA_0160 0.0 255.0 /begin FUNCTION_LIST MZYL /end FUNCTION_LIST /end CHARACTERISTIC
/begin CHARACTERISTIC K_MZYL_R "Allgemeine Gaskonstante R" VALUE 0x6079A TKW_VV_VV_UW 100.0 FORMULA_0161 0.0 6553.5000 /begin FUNCTION_LIST MZYL /end FUNCTION_LIST FORMAT "%4.1" /end CHARACTERISTIC
/begin MEASUREMENT mzyl_b1.ges_asp "Ges.masse Zyl" SWORD FORMULA_0009 0 0 -500.0000 1500.0000 ECU_ADDRESS 0x3FBA50 /begin FUNCTION_LIST MZYL /end FUNCTION_LIST /end MEASUREMENT
/begin MEASUREMENT mzyl_b2.ges_asp "Ges.masse Zyl" SWORD FORMULA_0009 0 0 -500.0000 1500.0000 ECU_ADDRESS 0x3FBA60 /begin FUNCTION_LIST MZYL /end FUNCTION_LIST /end MEASUREMENT
/begin MEASUREMENT mzyl_b1.rg_asp "Restgasmasse im Zylinder" SWORD FORMULA_0009 0 0 -500.0000 1500.0000 ECU_ADDRESS 0x3FBA52 /begin FUNCTION_LIST MZYL /end FUNCTION_LIST /end MEASUREMENT
/begin MEASUREMENT mzyl_b2.rg_asp "Restgasmasse im Zylinder" SWORD FORMULA_0009 0 0 -500.0000 1500.0000 ECU_ADDRESS 0x3FBA62 /begin FUNCTION_LIST MZYL /end FUNCTION_LIST /end MEASUREMENT
/begin MEASUREMENT mzyl_b1.ml_asp "Masse Luft" SWORD FORMULA_0009 0 0 -500.0000 1500.0000 ECU_ADDRESS 0x3FBA54 /begin FUNCTION_LIST MZYL /end FUNCTION_LIST /end MEASUREMENT
/begin MEASUREMENT mzyl_b2.ml_asp "Masse Luft" SWORD FORMULA_0009 0 0 -500.0000 1500.0000 ECU_ADDRESS 0x3FBA64 /begin FUNCTION_LIST MZYL /end FUNCTION_LIST /end MEASUREMENT
/begin MEASUREMENT mzyl_b1.mldt_psau "Luftmassenstrom aus psau ermittelt" SWORD FORMULA_0010 0 0 -100.0000 1400.0000 ECU_ADDRESS 0x3FBA56 /begin FUNCTION_LIST MZYL /end FUNCTION_LIST /end MEASUREMENT
/begin MEASUREMENT mzyl_b2.mldt_psau "Luftmassenstrom aus psau ermittelt" SWORD FORMULA_0010 0 0 -100.0000 1400.0000 ECU_ADDRESS 0x3FBA66 /begin FUNCTION_LIST MZYL /end FUNCTION_LIST /end MEASUREMENT
/begin MEASUREMENT mzyl_b1.ml_sum_sa "Aufsummierte Luftmassenstr. im ZUST_SA" SLONG FORMULA_0157 0 0 -214748364.8000 214748364.7000 ECU_ADDRESS 0x3FBA58 /begin FUNCTION_LIST MZYL /end FUNCTION_LIST /end MEASUREMENT
/begin MEASUREMENT mzyl_b2.ml_sum_sa "Aufsummierte Luftmassenstr. im ZUST_SA" SLONG FORMULA_0157 0 0 -214748364.8000 214748364.7000 ECU_ADDRESS 0x3FBA68 /begin FUNCTION_LIST MZYL /end FUNCTION_LIST /end MEASUREMENT
/begin MEASUREMENT mzyl_b1.ml_sum_we "Aufsummierte Luftmassenstr. nach SA_WE" SLONG FORMULA_0157 0 0 -214748364.8000 214748364.7000 ECU_ADDRESS 0x3FBA5C /begin FUNCTION_LIST MZYL /end FUNCTION_LIST /end MEASUREMENT
/begin MEASUREMENT mzyl_b2.ml_sum_we "Aufsummierte Luftmassenstr. nach SA_WE" SLONG FORMULA_0157 0 0 -214748364.8000 214748364.7000 ECU_ADDRESS 0x3FBA6C /begin FUNCTION_LIST MZYL /end FUNCTION_LIST /end MEASUREMENT
/begin MEASUREMENT mzyl_st "Status mzyl" UBYTE FORMULA_0158 0 0 0.0 255.0 ECU_ADDRESS 0x3FBA70 /begin FUNCTION_LIST MZYL /end FUNCTION_LIST /end MEASUREMENT
/* ------------------ Abschnitt erzeugt aus nwm.dat ------------------ */
/begin MEASUREMENT Nwm_var_s.state "Status" UBYTE FORMULA_0008 0 0 0.0 255.0000 ECU_ADDRESS 0x3F9EC4 /begin FUNCTION_LIST NWM /end FUNCTION_LIST /end MEASUREMENT
/begin MEASUREMENT Nwm_var_s.flags1 "Flags" UBYTE FORMULA_0008 0 0 0.0 255.0000 ECU_ADDRESS 0x3F9EC5 /begin FUNCTION_LIST NWM /end FUNCTION_LIST /end MEASUREMENT
/begin MEASUREMENT Nwm_var_s.MsgDest "Ring-Destination" UBYTE FORMULA_0162 0 0 0.0 255.0 ECU_ADDRESS 0x3F9EC8 /begin FUNCTION_LIST NWM /end FUNCTION_LIST /end MEASUREMENT
/begin MEASUREMENT Nwm_var_s.MsgTyp "Ring-Typ" UBYTE FORMULA_0163 0 0 0.0 255.0 ECU_ADDRESS 0x3F9EC9 /begin FUNCTION_LIST NWM /end FUNCTION_LIST /end MEASUREMENT
/begin MEASUREMENT Nwm_var_s.MsgUser1 "Ring-User1" UBYTE FORMULA_0008 0 0 0.0 255.0000 ECU_ADDRESS 0x3F9ECA /begin FUNCTION_LIST NWM /end FUNCTION_LIST /end MEASUREMENT
/begin MEASUREMENT Nwm_var_s.MsgUser2 "Ring-User2" UBYTE FORMULA_0008 0 0 0.0 255.0000 ECU_ADDRESS 0x3F9ECB /begin FUNCTION_LIST NWM /end FUNCTION_LIST /end MEASUREMENT
/begin MEASUREMENT Nwm_var_s.timeCounter "Timeout counter" UBYTE FORMULA_0008 0 0 0.0 255.0000 ECU_ADDRESS 0x3F9ED4 /begin FUNCTION_LIST NWM /end FUNCTION_LIST /end MEASUREMENT
/begin MEASUREMENT Nwm_var_s.nwmAction "State of statemachine" UBYTE FORMULA_0164 0 0 0.0 255.0 ECU_ADDRESS 0x3F9ED5 /begin FUNCTION_LIST NWM /end FUNCTION_LIST /end MEASUREMENT
/begin MEASUREMENT Nwm_var_s.successorEcu "Successor ECU" UBYTE FORMULA_0162 0 0 0.0 255.0 ECU_ADDRESS 0x3F9ED6 /begin FUNCTION_LIST NWM /end FUNCTION_LIST /end MEASUREMENT
/begin MEASUREMENT Nwm_var_s.txEcuNumber "Logical sender number" UBYTE FORMULA_0162 0 0 0.0 255.0 ECU_ADDRESS 0x3F9ED7 /begin FUNCTION_LIST NWM /end FUNCTION_LIST /end MEASUREMENT
/begin MEASUREMENT Nwm_var_s.rxTxCounter "counter for rx/tx" UBYTE FORMULA_0008 0 0 0.0 255.0000 ECU_ADDRESS 0x3F9ED8 /begin FUNCTION_LIST NWM /end FUNCTION_LIST /end MEASUREMENT
/begin MEASUREMENT nmEcuNr "ECU-Nummer" UBYTE FORMULA_0008 0 0 0.0 255.0000 ECU_ADDRESS 0x3FB400 /begin FUNCTION_LIST NWM /end FUNCTION_LIST /end MEASUREMENT
/begin MEASUREMENT nmRecvCopyMsgUser_1of6_ "MsgUser" UBYTE FORMULA_0008 0 0 0.0 255.0000 ECU_ADDRESS 0x3FB40C /begin FUNCTION_LIST NWM /end FUNCTION_LIST /end MEASUREMENT
/begin MEASUREMENT nmRecvCopyMsgUser_2of6_ "MsgUser" UBYTE FORMULA_0008 0 0 0.0 255.0000 ECU_ADDRESS 0x3FB40D /begin FUNCTION_LIST NWM /end FUNCTION_LIST /end MEASUREMENT
/begin MEASUREMENT nmRecvCopyMsgUser_3of6_ "MsgUser" UBYTE FORMULA_0008 0 0 0.0 255.0000 ECU_ADDRESS 0x3FB40E /begin FUNCTION_LIST NWM /end FUNCTION_LIST /end MEASUREMENT
/begin MEASUREMENT nmRecvCopyMsgUser_4of6_ "MsgUser" UBYTE FORMULA_0008 0 0 0.0 255.0000 ECU_ADDRESS 0x3FB40F /begin FUNCTION_LIST NWM /end FUNCTION_LIST /end MEASUREMENT
/begin MEASUREMENT nmRecvCopyMsgUser_5of6_ "MsgUser" UBYTE FORMULA_0008 0 0 0.0 255.0000 ECU_ADDRESS 0x3FB410 /begin FUNCTION_LIST NWM /end FUNCTION_LIST /end MEASUREMENT
/begin MEASUREMENT nmRecvCopyMsgUser_6of6_ "MsgUser" UBYTE FORMULA_0008 0 0 0.0 255.0000 ECU_ADDRESS 0x3FB411 /begin FUNCTION_LIST NWM /end FUNCTION_LIST /end MEASUREMENT
/begin MEASUREMENT Weck_Verursacher "Weck-Verursacher" UBYTE FORMULA_0162 0 0 0.0 255.0 ECU_ADDRESS 0x3FB412 /begin FUNCTION_LIST NWM /end FUNCTION_LIST /end MEASUREMENT
/* ------------------ Abschnitt erzeugt aus pks.dat ------------------ */
/begin CHARACTERISTIC K_PKS_STEIGUNG "Steigung Kraftstoffdrucksensor" VALUE 0x607EC TKW_VV_VV_SW 100.0 FORMULA_0170 0.0 5.0000 /begin FUNCTION_LIST PKS /end FUNCTION_LIST FORMAT "%6.3" /end CHARACTERISTIC
/begin CHARACTERISTIC K_PKS_OFFSET "Offset Kraftstoffdrucksensor" VALUE 0x607EE TKW_VV_VV_SW 100.0 FORMULA_0016 0.0 10.0000 /begin FUNCTION_LIST PKS /end FUNCTION_LIST FORMAT "%6.3" /end CHARACTERISTIC
/begin CHARACTERISTIC K_PKS_TAU "Filterkonstante f. Kraftstoffdruck" VALUE 0x607F0 TKW_VV_VV_UB 100.0 FORMULA_0171 0.0051 1.2800 /begin FUNCTION_LIST PKS /end FUNCTION_LIST /end CHARACTERISTIC
/begin CHARACTERISTIC K_PKS_DIAG_MIN "untere Grenze Kraftstoffdruck" VALUE 0x607F2 TKW_VV_VV_SW 100.0 FORMULA_0016 0.0 10.0000 /begin FUNCTION_LIST PKS /end FUNCTION_LIST FORMAT "%6.3" /end CHARACTERISTIC
/begin CHARACTERISTIC K_PKS_DIAG_MAX "obere Grenze Kraftstoffdruck" VALUE 0x607F4 TKW_VV_VV_SW 100.0 FORMULA_0016 0.0 10.0000 /begin FUNCTION_LIST PKS /end FUNCTION_LIST FORMAT "%6.3" /end CHARACTERISTIC
/begin CHARACTERISTIC K_PKS_ERSATZ "Ersatzwert Kraftstoffdruck" VALUE 0x607F6 TKW_VV_VV_SW 100.0 FORMULA_0016 0.0 10.0000 /begin FUNCTION_LIST PKS /end FUNCTION_LIST FORMAT "%6.3" /end CHARACTERISTIC
/begin MEASUREMENT upks "eingelesener Spannungswert des Kraftstoffdrucksignals" SWORD FORMULA_0169 0 0 0.0 0.0488 ECU_ADDRESS 0x3FBADE /begin FUNCTION_LIST PKS /end FUNCTION_LIST /end MEASUREMENT
/begin MEASUREMENT pks_ist_roh "Kraftstoffdruck, absolut, ungefiltert" SWORD FORMULA_0016 0 0 0.0 10.0000 ECU_ADDRESS 0x3FBAE0 /begin FUNCTION_LIST PKS /end FUNCTION_LIST /end MEASUREMENT
/* ------------------ Abschnitt erzeugt aus pksr.dat ------------------ */
/begin CHARACTERISTIC K_PKSR_RHO_KST_20 "Kraftstoffdichte" VALUE 0x607F8 TKW_VV_VV_SW 100.0 FORMULA_0174 0.0 32767.0000 /begin FUNCTION_LIST Kraftstoffdruck /end FUNCTION_LIST /end CHARACTERISTIC
/begin CHARACTERISTIC K_PKSR_PKS_SOLL "Kraftstoff Solldruck" VALUE 0x607FA TKW_VV_VV_SW 100.0 FORMULA_0175 0.0 10.0000 /begin FUNCTION_LIST Kraftstoffdruck /end FUNCTION_LIST FORMAT "%6.3" /end CHARACTERISTIC
/begin CHARACTERISTIC K_PKSR_I_ANTEIL_MIN "I-Anteil Min-Wert" VALUE 0x607FC TKW_VV_VV_SW 100.0 FORMULA_0172 -50.0000 50.0000 /begin FUNCTION_LIST Kraftstoffdruck /end FUNCTION_LIST FORMAT "%4.1" /end CHARACTERISTIC
/begin CHARACTERISTIC K_PKSR_I_ANTEIL_MAX "I-Anteil Max-Wert" VALUE 0x607FE TKW_VV_VV_SW 100.0 FORMULA_0172 -50.0000 50.0000 /begin FUNCTION_LIST Kraftstoffdruck /end FUNCTION_LIST FORMAT "%4.1" /end CHARACTERISTIC
/begin CHARACTERISTIC KL_PKSR_QSSP_PKS "Volumenstrom SSPs über Istdruck (rel.)" CURVE 0x60800 TKL_SW_VV_SW 100.0 FORMULA_0173 0.0 250.0000 /begin FUNCTION_LIST Kraftstoffdruck /end FUNCTION_LIST /begin AXIS_DESCR STD_AXIS pks_rel FORMULA_0016 5 0.0 10.0000 FORMAT "%6.3" /end AXIS_DESCR FORMAT "%4.1" /end CHARACTERISTIC
/begin CHARACTERISTIC KL_PKSR_P_FAKTOR "P-Faktor ueber Druckabweichung" CURVE 0x60816 TKL_SW_VV_UW 100.0 FORMULA_0176 0.0 500.0000 /begin FUNCTION_LIST Kraftstoffdruck /end FUNCTION_LIST /begin AXIS_DESCR STD_AXIS p_diff FORMULA_0016 5 0.0 10.0000 FORMAT "%6.3" /end AXIS_DESCR FORMAT "%4.1" /end CHARACTERISTIC
/begin CHARACTERISTIC KL_PKSR_I_FAKTOR "I-Faktor ueber Druckabweichung" CURVE 0x6082C TKL_SW_VV_UW 100.0 FORMULA_0177 0.0 1000.0000 /begin FUNCTION_LIST Kraftstoffdruck /end FUNCTION_LIST /begin AXIS_DESCR STD_AXIS p_diff FORMULA_0016 5 0.0 10.0000 FORMAT "%6.3" /end AXIS_DESCR FORMAT "%4.1" /end CHARACTERISTIC
/begin CHARACTERISTIC KL_PKSR_UB_FAKTOR "Korrekturfaktor ueber Bordspannung" CURVE 0x60842 TKL_SW_VV_UW 100.0 FORMULA_0150 0.0 10.0000 /begin FUNCTION_LIST Kraftstoffdruck /end FUNCTION_LIST /begin AXIS_DESCR STD_AXIS ub FORMULA_0045 5 0.0 28.0000 FORMAT "%4.1" /end AXIS_DESCR FORMAT "%5.2" /end CHARACTERISTIC
/begin CHARACTERISTIC KF_PKSR_PSOLL_QSOLL_TV "Tastverhaeltnis über Absolut-Solldruck u. Volumenstrom" MAP 0x60858 TKF_SW_SW_SW 100.0 FORMULA_0172 -100.0000 100.0000 /begin FUNCTION_LIST Kraftstoffdruck /end FUNCTION_LIST /begin AXIS_DESCR STD_AXIS pks_soll FORMULA_0016 5 0.0 10.0000 FORMAT "%6.3" /end AXIS_DESCR
 /begin AXIS_DESCR STD_AXIS Volumenstrom FORMULA_0173 8 0.0 250.0000 FORMAT "%4.1" /end AXIS_DESCR
 FORMAT "%4.1" /end CHARACTERISTIC
/begin MEASUREMENT pks_soll "Sollwert Kraftstoffdruck, relativ" SWORD FORMULA_0016 0 0 0.0 10.0000 ECU_ADDRESS 0x3FBAE4 /begin FUNCTION_LIST Kraftstoffdruck /end FUNCTION_LIST /end MEASUREMENT
/begin MEASUREMENT pks_rel "Kraftstoffdruck, relativ" SWORD FORMULA_0016 0 0 0.0 10.0000 ECU_ADDRESS 0x3FBAE6 /begin FUNCTION_LIST Kraftstoffdruck /end FUNCTION_LIST /end MEASUREMENT
/begin MEASUREMENT pksr_tv_ekp "Tastverhaeltnis EKP-Ansteuerung" SWORD FORMULA_0172 0 0 -100.0000 100.0000 ECU_ADDRESS 0x3FBAE8 /begin FUNCTION_LIST Kraftstoffdruck /end FUNCTION_LIST /end MEASUREMENT
/begin MEASUREMENT pksr_q_mot "Volumenstrom Motor" SWORD FORMULA_0173 0 0 0.0 250.0000 ECU_ADDRESS 0x3FBAEA /begin FUNCTION_LIST Kraftstoffdruck /end FUNCTION_LIST /end MEASUREMENT
/begin MEASUREMENT pksr_q_ssp "Volumenstrom Saugstrahlpumpen" SWORD FORMULA_0173 0 0 0.0 250.0000 ECU_ADDRESS 0x3FBAEC /begin FUNCTION_LIST Kraftstoffdruck /end FUNCTION_LIST /end MEASUREMENT
/begin MEASUREMENT pksr_q_ekp "Volumenstrom EKP" SWORD FORMULA_0173 0 0 0.0 250.0000 ECU_ADDRESS 0x3FBAEE /begin FUNCTION_LIST Kraftstoffdruck /end FUNCTION_LIST /end MEASUREMENT
/begin MEASUREMENT pksr_p_anteil "P-Anteil Kraftstoffdruckregler" SWORD FORMULA_0172 0 0 -100.0000 100.0000 ECU_ADDRESS 0x3FBAF0 /begin FUNCTION_LIST Kraftstoffdruck /end FUNCTION_LIST /end MEASUREMENT
/begin MEASUREMENT pksr_i_anteil "I-Anteil Kraftstoffdruckregler" SWORD FORMULA_0172 0 0 -100.0000 100.0000 ECU_ADDRESS 0x3FBAF2 /begin FUNCTION_LIST Kraftstoffdruck /end FUNCTION_LIST /end MEASUREMENT
/begin MEASUREMENT pksr_s_anteil "Steuer-Anteil Kraftstoffdruckregler" SWORD FORMULA_0172 0 0 -100.0000 100.0000 ECU_ADDRESS 0x3FBAF8 /begin FUNCTION_LIST Kraftstoffdruck /end FUNCTION_LIST /end MEASUREMENT
/* ------------------ Abschnitt erzeugt aus psau.dat ------------------ */
/begin CHARACTERISTIC K_PSAU_STEIGUNG "Steigung des Drucksensors" VALUE 0x608C4 TKW_VV_VV_UW 100.0 FORMULA_0179 0.0 2000.0000 /begin FUNCTION_LIST PSAU /end FUNCTION_LIST FORMAT "%4.1" /end CHARACTERISTIC
/begin CHARACTERISTIC K_PSAU_OFFSET "Offset des Drucksensors" VALUE 0x608C6 TKW_VV_VV_SW 100.0 FORMULA_0031 -1000.0000 2000.0000 /begin FUNCTION_LIST PSAU /end FUNCTION_LIST FORMAT "%4.1" /end CHARACTERISTIC
/begin CHARACTERISTIC K_PSAU_DIAG_MAX "MAX PSAU fuer Diagnose " VALUE 0x608C8 TKW_VV_VV_SW 100.0 FORMULA_0031 0.0 1200.0000 /begin FUNCTION_LIST PSAU /end FUNCTION_LIST FORMAT "%4.1" /end CHARACTERISTIC
/begin CHARACTERISTIC K_PSAU_DIAG_MIN "MIN Saugrohrdruch fuer Diagnose " VALUE 0x608CA TKW_VV_VV_SW 100.0 FORMULA_0031 -625.0000 2000.0000 /begin FUNCTION_LIST PSAU /end FUNCTION_LIST FORMAT "%4.1" /end CHARACTERISTIC
/begin CHARACTERISTIC K_PSAU_ERSATZ "Ersatzwert Umgebungsdruck" VALUE 0x608CC TKW_VV_VV_SW 100.0 FORMULA_0180 0.0 2000.0000 /begin FUNCTION_LIST PSAU /end FUNCTION_LIST /end CHARACTERISTIC
/begin CHARACTERISTIC K_PSAU_ADAPT_MAX "Maximaler Adaptionswert fuer PSAUx" VALUE 0x608CE TKW_VV_VV_SW 100.0 FORMULA_0031 0.0 200.0000 /begin FUNCTION_LIST PSAU /end FUNCTION_LIST FORMAT "%4.1" /end CHARACTERISTIC
/begin CHARACTERISTIC K_PSAU_ADAPT_MIN "Minimaler Adaptionswert fuer PSAUx" VALUE 0x608D0 TKW_VV_VV_SW 100.0 FORMULA_0031 -200.0000 0.0 /begin FUNCTION_LIST PSAU /end FUNCTION_LIST FORMAT "%4.1" /end CHARACTERISTIC
/begin CHARACTERISTIC K_PSAU_TAU "Filterkonstante PSAU nur im Zeitraster, nicht im Segment" VALUE 0x608D2 TKW_VV_VV_UB 100.0 FORMULA_0115 0.0101 2.5600 /begin FUNCTION_LIST PSAU /end FUNCTION_LIST /end CHARACTERISTIC
/begin CHARACTERISTIC K_PSAU_MZYL_A_1of2_ "Zahnzaehler fuer Beginn der Mittelwertsbild. Zylindergesfuellung" VALUE 0x608D4 TKW_VV_VV_UB 100.0 FORMULA_0113 0.0 119.0000 /begin FUNCTION_LIST PSAU /end FUNCTION_LIST /end CHARACTERISTIC
/begin CHARACTERISTIC K_PSAU_MZYL_A_2of2_ "Zahnzaehler fuer Beginn der Mittelwertsbild. Zylindergesfuellung" VALUE 0x608D5 TKW_VV_VV_UB 100.0 FORMULA_0113 0.0 119.0000 /begin FUNCTION_LIST PSAU /end FUNCTION_LIST /end CHARACTERISTIC
/begin CHARACTERISTIC K_PSAU_MZYL_E_1of2_ "Zahnzaehler fuer Ende der Mittelwertsbild. Zylindergesfuellung" VALUE 0x608D8 TKW_VV_VV_UB 100.0 FORMULA_0113 0.0 119.0000 /begin FUNCTION_LIST PSAU /end FUNCTION_LIST /end CHARACTERISTIC
/begin CHARACTERISTIC K_PSAU_MZYL_E_2of2_ "Zahnzaehler fuer Ende der Mittelwertsbild. Zylindergesfuellung" VALUE 0x608D9 TKW_VV_VV_UB 100.0 FORMULA_0113 0.0 119.0000 /begin FUNCTION_LIST PSAU /end FUNCTION_LIST /end CHARACTERISTIC
/begin CHARACTERISTIC K_PSAU_MRG_A_1of2_ "Zahnzaehler fuer Beginn der Mittelwertsbild. Restgasfuellung" VALUE 0x608DC TKW_VV_VV_UB 100.0 FORMULA_0113 0.0 119.0000 /begin FUNCTION_LIST PSAU /end FUNCTION_LIST /end CHARACTERISTIC
/begin CHARACTERISTIC K_PSAU_MRG_A_2of2_ "Zahnzaehler fuer Beginn der Mittelwertsbild. Restgasfuellung" VALUE 0x608DD TKW_VV_VV_UB 100.0 FORMULA_0113 0.0 119.0000 /begin FUNCTION_LIST PSAU /end FUNCTION_LIST /end CHARACTERISTIC
/begin CHARACTERISTIC K_PSAU_MRG_E_1of2_ "Zahnzaehler fuer Ende der Mittelwertsbild. Restgasfuellung" VALUE 0x608E0 TKW_VV_VV_UB 100.0 FORMULA_0113 0.0 119.0000 /begin FUNCTION_LIST PSAU /end FUNCTION_LIST /end CHARACTERISTIC
/begin CHARACTERISTIC K_PSAU_MRG_E_2of2_ "Zahnzaehler fuer Ende der Mittelwertsbild. Restgasfuellung" VALUE 0x608E1 TKW_VV_VV_UB 100.0 FORMULA_0113 0.0 119.0000 /begin FUNCTION_LIST PSAU /end FUNCTION_LIST /end CHARACTERISTIC
/begin CHARACTERISTIC KL_PSAU_ZAHN_OFFSET "Zahn Offset zur Ermittelung des Messfensterns" CURVE 0x608E2 TKL_SW_VV_SW 100.0 FORMULA_0024 0.0 120.0000 /begin FUNCTION_LIST PSAU /end FUNCTION_LIST /begin AXIS_DESCR STD_AXIS n FORMULA_0011 10 0.0 10000.0000 /end AXIS_DESCR FORMAT "%5.2" /end CHARACTERISTIC
/begin CHARACTERISTIC KL_PSAU_MZYL_DASP "Dynamikvorhalt fuer psau_mzyl" CURVE 0x6090C TKL_SW_VV_UW 100.0 FORMULA_0035 0.0 6.0000 /begin FUNCTION_LIST PSAU /end FUNCTION_LIST
 /begin AXIS_DESCR STD_AXIS psau FORMULA_0031 7 -1000.0000 1000.0000 FORMAT "%4.1" /end AXIS_DESCR
 FORMAT "%6.3" /end CHARACTERISTIC
/begin CHARACTERISTIC KL_PSAU_WF_DASP "Dynamikvorhalt fuer psau_wf" CURVE 0x6092A TKL_SW_VV_UW 100.0 FORMULA_0035 0.0 6.0000 /begin FUNCTION_LIST PSAU /end FUNCTION_LIST
 /begin AXIS_DESCR STD_AXIS psau FORMULA_0031 7 -1000.0000 1000.0000 FORMAT "%4.1" /end AXIS_DESCR
 FORMAT "%6.3" /end CHARACTERISTIC
/begin MEASUREMENT psau_b1.ad "Eingelesener Spannungswert fuer Saugrohrdruck" SWORD FORMULA_0112 0 0 0.0 1023.0000 ECU_ADDRESS 0x3FBAFA /begin FUNCTION_LIST PSAU /end FUNCTION_LIST /end MEASUREMENT
/begin MEASUREMENT psau_b2.ad "Eingelesener Spannungswert fuer Saugrohrdruck" SWORD FORMULA_0112 0 0 0.0 1023.0000 ECU_ADDRESS 0x3FBBA0 /begin FUNCTION_LIST PSAU /end FUNCTION_LIST /end MEASUREMENT
/begin MEASUREMENT psau_b1.phy "Physikalischer Wert ohne Diagnose und ohne Filter fuer Saugrohrdruck" SWORD FORMULA_0031 0 0 0.0 2000.0000 ECU_ADDRESS 0x3FBAFC /begin FUNCTION_LIST PSAU /end FUNCTION_LIST /end MEASUREMENT
/begin MEASUREMENT psau_b2.phy "Physikalischer Wert ohne Diagnose und ohne Filter fuer Saugrohrdruck" SWORD FORMULA_0031 0 0 0.0 2000.0000 ECU_ADDRESS 0x3FBBA2 /begin FUNCTION_LIST PSAU /end FUNCTION_LIST /end MEASUREMENT
/begin MEASUREMENT psau_b1.roh "Physikalischer Wert mit Diagnose jedoch ohne Filter fuer Saugrohrdruck" SWORD FORMULA_0031 0 0 0.0 2000.0000 ECU_ADDRESS 0x3FBAFE /begin FUNCTION_LIST PSAU /end FUNCTION_LIST /end MEASUREMENT
/begin MEASUREMENT psau_b2.roh "Physikalischer Wert mit Diagnose jedoch ohne Filter fuer Saugrohrdruck" SWORD FORMULA_0031 0 0 0.0 2000.0000 ECU_ADDRESS 0x3FBBA4 /begin FUNCTION_LIST PSAU /end FUNCTION_LIST /end MEASUREMENT
/begin MEASUREMENT psau_rel1_b1 "relativer Saugrohrdruck Bank" SWORD FORMULA_0020 0 0 0.0 120.0000 ECU_ADDRESS 0x3FBB00 /begin FUNCTION_LIST PSAU /end FUNCTION_LIST /end MEASUREMENT
/begin MEASUREMENT psau_rel1_b2 "relativer Saugrohrdruck Bank" SWORD FORMULA_0020 0 0 0.0 120.0000 ECU_ADDRESS 0x3FBBA6 /begin FUNCTION_LIST PSAU /end FUNCTION_LIST /end MEASUREMENT
/begin MEASUREMENT psau_b1.ed "Eigendiagnose psau" UWORD FORMULA_0017 0 0 0.0 111.0 ECU_ADDRESS 0x3FBB02 /begin FUNCTION_LIST PSAU /end FUNCTION_LIST BIT_MASK 0x6F /end MEASUREMENT
/begin MEASUREMENT psau_b2.ed "Eigendiagnose psau" UWORD FORMULA_0017 0 0 0.0 111.0 ECU_ADDRESS 0x3FBBA8 /begin FUNCTION_LIST PSAU /end FUNCTION_LIST BIT_MASK 0x6F /end MEASUREMENT
/begin MEASUREMENT psau_b1.trig_seg "Samples per Segment" UBYTE FORMULA_0047 0 0 0.0 255.0000 ECU_ADDRESS 0x3FBB16 /begin FUNCTION_LIST PSAU /end FUNCTION_LIST /end MEASUREMENT
/begin MEASUREMENT psau_b2.trig_seg "Samples per Segment" UBYTE FORMULA_0047 0 0 0.0 255.0000 ECU_ADDRESS 0x3FBBBC /begin FUNCTION_LIST PSAU /end FUNCTION_LIST /end MEASUREMENT
/begin MEASUREMENT psau_b1.adapt "Adaptionswert zum PUMG, (pumg-psau)" SWORD FORMULA_0031 0 0 -200.0000 200.0000 ECU_ADDRESS 0x3FBB04 /begin FUNCTION_LIST PSAU /end FUNCTION_LIST /end MEASUREMENT
/begin MEASUREMENT psau_b2.adapt "Adaptionswert zum PUMG, (pumg-psau)" SWORD FORMULA_0031 0 0 -200.0000 200.0000 ECU_ADDRESS 0x3FBBAA /begin FUNCTION_LIST PSAU /end FUNCTION_LIST /end MEASUREMENT
/begin MEASUREMENT psau_b1.asp "Mittelwert ueber Arbeitsspiel" SWORD FORMULA_0031 0 0 0.0 2000.0000 ECU_ADDRESS 0x3FBB06 /begin FUNCTION_LIST PSAU /end FUNCTION_LIST /end MEASUREMENT
/begin MEASUREMENT psau_b2.asp "Mittelwert ueber Arbeitsspiel" SWORD FORMULA_0031 0 0 0.0 2000.0000 ECU_ADDRESS 0x3FBBAC /begin FUNCTION_LIST PSAU /end FUNCTION_LIST /end MEASUREMENT
/begin MEASUREMENT psau_b1.mzyl "Mittelwert fuer die Gesamtfuellungsermittelung" SWORD FORMULA_0031 0 0 0.0 2000.0000 ECU_ADDRESS 0x3FBB08 /begin FUNCTION_LIST PSAU /end FUNCTION_LIST /end MEASUREMENT
/begin MEASUREMENT psau_b2.mzyl "Mittelwert fuer die Gesamtfuellungsermittelung" SWORD FORMULA_0031 0 0 0.0 2000.0000 ECU_ADDRESS 0x3FBBAE /begin FUNCTION_LIST PSAU /end FUNCTION_LIST /end MEASUREMENT
/begin MEASUREMENT psau_b1.mrg "Mittelwert fuer die Restgasmodellberechnung" SWORD FORMULA_0031 0 0 0.0 2000.0000 ECU_ADDRESS 0x3FBB0A /begin FUNCTION_LIST PSAU /end FUNCTION_LIST /end MEASUREMENT
/begin MEASUREMENT psau_b2.mrg "Mittelwert fuer die Restgasmodellberechnung" SWORD FORMULA_0031 0 0 0.0 2000.0000 ECU_ADDRESS 0x3FBBB0 /begin FUNCTION_LIST PSAU /end FUNCTION_LIST /end MEASUREMENT
/begin MEASUREMENT ml_psau_b1 "Luftmassenstrom aus psau, kein globales ml" SWORD FORMULA_0010 0 0 -100.0000 1400.0000 ECU_ADDRESS 0x3FBB0C /begin FUNCTION_LIST PSAU /end FUNCTION_LIST /end MEASUREMENT
/begin MEASUREMENT ml_psau_b2 "Luftmassenstrom aus psau, kein globales ml" SWORD FORMULA_0010 0 0 -100.0000 1400.0000 ECU_ADDRESS 0x3FBBB2 /begin FUNCTION_LIST PSAU /end FUNCTION_LIST /end MEASUREMENT
/begin MEASUREMENT rf_psau_b1 "relative Fuellung aus psau, kein globales rf" SWORD FORMULA_0006 0 0 0.0 2.0000 ECU_ADDRESS 0x3FBB0E /begin FUNCTION_LIST PSAU /end FUNCTION_LIST /end MEASUREMENT
/begin MEASUREMENT rf_psau_b2 "relative Fuellung aus psau, kein globales rf" SWORD FORMULA_0006 0 0 0.0 2.0000 ECU_ADDRESS 0x3FBBB4 /begin FUNCTION_LIST PSAU /end FUNCTION_LIST /end MEASUREMENT
/begin MEASUREMENT psau_b1.dasp "Mittelwertsgradient vom Saugrohrdruck" SWORD FORMULA_0178 0 0 -2000.0000 2000.0000 ECU_ADDRESS 0x3FBB10 /begin FUNCTION_LIST PSAU /end FUNCTION_LIST /end MEASUREMENT
/begin MEASUREMENT psau_b2.dasp "Mittelwertsgradient vom Saugrohrdruck" SWORD FORMULA_0178 0 0 -2000.0000 2000.0000 ECU_ADDRESS 0x3FBBB6 /begin FUNCTION_LIST PSAU /end FUNCTION_LIST /end MEASUREMENT
/begin MEASUREMENT psau_b1.wf "Mittelwert fuer die Wandfilmmodellberechnung" SWORD FORMULA_0031 0 0 0.0 2000.0000 ECU_ADDRESS 0x3FBB12 /begin FUNCTION_LIST PSAU /end FUNCTION_LIST /end MEASUREMENT
/begin MEASUREMENT psau_b2.wf "Mittelwert fuer die Wandfilmmodellberechnung" SWORD FORMULA_0031 0 0 0.0 2000.0000 ECU_ADDRESS 0x3FBBB8 /begin FUNCTION_LIST PSAU /end FUNCTION_LIST /end MEASUREMENT
/begin MEASUREMENT psau_zahn_offset "Zahnoffset fuer die Mittelwertbildung" SWORD FORMULA_0000 0 0 0.0 20.0000 ECU_ADDRESS 0x3FBC46 /begin FUNCTION_LIST PSAU /end FUNCTION_LIST /end MEASUREMENT
/* ------------------ Abschnitt erzeugt aus rf.dat ------------------ */
/begin CHARACTERISTIC K_RF_HUBVOLUMEN "Hubvolumen " VALUE 0x60954 TKW_VV_VV_UW 100.0 FORMULA_0183 1.0000 9.0000 /begin FUNCTION_LIST RF /end FUNCTION_LIST FORMAT "%6.3" /end CHARACTERISTIC
/begin CHARACTERISTIC K_RF_LUFTDICHTE "Luftdichte" VALUE 0x60956 TKW_VV_VV_UW 100.0 FORMULA_0184 0.1000 1.8000 /begin FUNCTION_LIST RF /end FUNCTION_LIST FORMAT "%6.3" /end CHARACTERISTIC
/begin CHARACTERISTIC K_RF_START "Start rf " VALUE 0x60958 TKW_VV_VV_SW 100.0 FORMULA_0006 0.0 2.0000 /begin FUNCTION_LIST RF /end FUNCTION_LIST FORMAT "%6.3" /end CHARACTERISTIC
/begin CHARACTERISTIC K_RF_START_CFG "RF Start Konfiguration" VALUE 0x6095A TKW_VV_VV_UB 100.0 FORMULA_0185 0.0 255.0 /begin FUNCTION_LIST RF /end FUNCTION_LIST /end CHARACTERISTIC
/begin CHARACTERISTIC K_RF_ST_LL_RAMP "Dauer der RF Rampe von START nach LL" VALUE 0x6095B TKW_VV_VV_UB 100.0 FORMULA_0186 0.0 100.0000 /begin FUNCTION_LIST RF /end FUNCTION_LIST /end CHARACTERISTIC
/begin MEASUREMENT rf_aq_b1 "rf aus aq bestimmt" SWORD FORMULA_0006 0 0 0.0 2.0000 ECU_ADDRESS 0x3FBC56 /begin FUNCTION_LIST RF /end FUNCTION_LIST /end MEASUREMENT
/begin MEASUREMENT rf_aq_b2 "rf aus aq bestimmt" SWORD FORMULA_0006 0 0 0.0 2.0000 ECU_ADDRESS 0x3FBC58 /begin FUNCTION_LIST RF /end FUNCTION_LIST /end MEASUREMENT
/begin MEASUREMENT rf_ist_roh_aq_b1 "rf Summe dk und lls" SWORD FORMULA_0006 0 0 0.0 2.0000 ECU_ADDRESS 0x3FBC5A /begin FUNCTION_LIST RF /end FUNCTION_LIST /end MEASUREMENT
/begin MEASUREMENT rf_ist_roh_aq_b2 "rf Summe dk und lls" SWORD FORMULA_0006 0 0 0.0 2.0000 ECU_ADDRESS 0x3FBC5C /begin FUNCTION_LIST RF /end FUNCTION_LIST /end MEASUREMENT
/begin MEASUREMENT ml_aq_b1 "ml aus rf_aq" SWORD FORMULA_0010 0 0 -100.0000 1400.0000 ECU_ADDRESS 0x3FBC5E /begin FUNCTION_LIST RF /end FUNCTION_LIST /end MEASUREMENT
/begin MEASUREMENT ml_aq_b2 "ml aus rf_aq" SWORD FORMULA_0010 0 0 -100.0000 1400.0000 ECU_ADDRESS 0x3FBC60 /begin FUNCTION_LIST RF /end FUNCTION_LIST /end MEASUREMENT
/begin MEASUREMENT rf_mzyl_ml_aq_b1 "mzyl_ml aus aq" SWORD FORMULA_0009 0 0 -500.0000 1500.0000 ECU_ADDRESS 0x3FBC62 /begin FUNCTION_LIST RF /end FUNCTION_LIST /end MEASUREMENT
/begin MEASUREMENT rf_mzyl_ml_aq_b2 "mzyl_ml aus aq" SWORD FORMULA_0009 0 0 -500.0000 1500.0000 ECU_ADDRESS 0x3FBC64 /begin FUNCTION_LIST RF /end FUNCTION_LIST /end MEASUREMENT
/* ------------------ Abschnitt erzeugt aus rg.dat ------------------ */
/begin CHARACTERISTIC K_RG_V_EPS "Verdichtungsverhaeltniss" VALUE 0x6095C TKW_VV_VV_UW 100.0 FORMULA_0193 5.0000 18.0000 /begin FUNCTION_LIST RG /end FUNCTION_LIST FORMAT "%4.1" /end CHARACTERISTIC
/begin CHARACTERISTIC K_RG_M_MIN "MIN-Begrenzung Restgasmasse im Zylinder" VALUE 0x6095E TKW_VV_VV_SW 100.0 FORMULA_0009 -500.0000 1500.0000 /begin FUNCTION_LIST RG /end FUNCTION_LIST FORMAT "%4.1" /end CHARACTERISTIC
/begin CHARACTERISTIC K_RG_M_MAX "MAX-Begrenzung Restgasmasse im Zylinder" VALUE 0x60960 TKW_VV_VV_SW 100.0 FORMULA_0009 -500.0000 1500.0000 /begin FUNCTION_LIST RG /end FUNCTION_LIST FORMAT "%4.1" /end CHARACTERISTIC
/begin CHARACTERISTIC KL_RG_UES_A_MEAN "Auslassventilquerschnitt waehrend der Ueberschneidung" CURVE 0x60962 TKL_SW_VV_UW 100.0 FORMULA_0189 0.0 15.0000 /begin FUNCTION_LIST RG /end FUNCTION_LIST /begin AXIS_DESCR STD_AXIS van_xd FORMULA_0188 12 0.0 160.0000 FORMAT "%4.1" /end AXIS_DESCR FORMAT "%6.3" /end CHARACTERISTIC
/begin CHARACTERISTIC KL_RG_V_HUB_F "Faktor fuer Abgasmasse im Totvolumen" CURVE 0x60994 TKL_SW_VV_SW 100.0 FORMULA_0190 0.0 2.0000 /begin FUNCTION_LIST RG /end FUNCTION_LIST /begin AXIS_DESCR STD_AXIS van_eo FORMULA_0188 11 0.0 160.0000 FORMAT "%4.1" /end AXIS_DESCR FORMAT "%7.4" /end CHARACTERISTIC
/begin CHARACTERISTIC KL_RG_PHI_MEAN "Durchflussbeiwert" CURVE 0x609C2 TKL_SW_VV_SW 100.0 FORMULA_0190 -0.0001 1.0000 /begin FUNCTION_LIST RG /end FUNCTION_LIST
 /begin AXIS_DESCR STD_AXIS pzyl_pabg_Verhaeltniss FORMULA_0194 10 0.0 2.0000 FORMAT "%5.2" /end AXIS_DESCR
 FORMAT "%7.4" /end CHARACTERISTIC
/begin CHARACTERISTIC KF_RG_STAT "Saugrohrdruckdelta" MAP 0x609EC TKF_SW_SW_SW 100.0 FORMULA_0007 -0.1000 0.5000 /begin FUNCTION_LIST RG /end FUNCTION_LIST /begin AXIS_DESCR STD_AXIS n FORMULA_0011 16 0.0 10000.0000 /end AXIS_DESCR /begin AXIS_DESCR STD_AXIS dr_rel FORMULA_0020 12 0.0 199.9938 FORMAT "%5.2" /end AXIS_DESCR FORMAT "%5.2" /end CHARACTERISTIC
/begin MEASUREMENT rg_b1.m_mod "Restgasmasse Moduliert" SWORD FORMULA_0009 0 0 -500.0000 1500.0000 ECU_ADDRESS 0x3FBC6C /begin FUNCTION_LIST RG /end FUNCTION_LIST /end MEASUREMENT
/begin MEASUREMENT rg_b2.m_mod "Restgasmasse Moduliert" SWORD FORMULA_0009 0 0 -500.0000 1500.0000 ECU_ADDRESS 0x3FBC88 /begin FUNCTION_LIST RG /end FUNCTION_LIST /end MEASUREMENT
/begin MEASUREMENT rg_b1.m_tot "Restgasmasse im Totvolumen" SWORD FORMULA_0009 0 0 -500.0000 1500.0000 ECU_ADDRESS 0x3FBC6E /begin FUNCTION_LIST RG /end FUNCTION_LIST /end MEASUREMENT
/begin MEASUREMENT rg_b2.m_tot "Restgasmasse im Totvolumen" SWORD FORMULA_0009 0 0 -500.0000 1500.0000 ECU_ADDRESS 0x3FBC8A /begin FUNCTION_LIST RG /end FUNCTION_LIST /end MEASUREMENT
/begin MEASUREMENT rg_b1.m_av "Restgasmasse ueber Auslaß nach Einlaß oeffnen" SWORD FORMULA_0009 0 0 -500.0000 1500.0000 ECU_ADDRESS 0x3FBC70 /begin FUNCTION_LIST RG /end FUNCTION_LIST /end MEASUREMENT
/begin MEASUREMENT rg_b2.m_av "Restgasmasse ueber Auslaß nach Einlaß oeffnen" SWORD FORMULA_0009 0 0 -500.0000 1500.0000 ECU_ADDRESS 0x3FBC8C /begin FUNCTION_LIST RG /end FUNCTION_LIST /end MEASUREMENT
/begin MEASUREMENT rg_b1.t_ues_av "Ueberschneidungszeit vom Auslassventil" UWORD FORMULA_0187 0 0 0.0 40.0000 ECU_ADDRESS 0x3FBC72 /begin FUNCTION_LIST RG /end FUNCTION_LIST /end MEASUREMENT
/begin MEASUREMENT rg_b2.t_ues_av "Ueberschneidungszeit vom Auslassventil" UWORD FORMULA_0187 0 0 0.0 40.0000 ECU_ADDRESS 0x3FBC8E /begin FUNCTION_LIST RG /end FUNCTION_LIST /end MEASUREMENT
/begin MEASUREMENT rg_b1.w_ues_av "Ueberschneidungswinkel vom Auslassventil" SWORD FORMULA_0188 0 0 50.0000 160.0000 ECU_ADDRESS 0x3FBC74 /begin FUNCTION_LIST RG /end FUNCTION_LIST /end MEASUREMENT
/begin MEASUREMENT rg_b2.w_ues_av "Ueberschneidungswinkel vom Auslassventil" SWORD FORMULA_0188 0 0 50.0000 160.0000 ECU_ADDRESS 0x3FBC90 /begin FUNCTION_LIST RG /end FUNCTION_LIST /end MEASUREMENT
/begin MEASUREMENT rg_b1.a_mean_ues "Auslassventilquerschnitt waehrend der Ueberschneidung" UWORD FORMULA_0189 0 0 0.0 15.0000 ECU_ADDRESS 0x3FBC76 /begin FUNCTION_LIST RG /end FUNCTION_LIST /end MEASUREMENT
/begin MEASUREMENT rg_b2.a_mean_ues "Auslassventilquerschnitt waehrend der Ueberschneidung" UWORD FORMULA_0189 0 0 0.0 15.0000 ECU_ADDRESS 0x3FBC92 /begin FUNCTION_LIST RG /end FUNCTION_LIST /end MEASUREMENT
/begin MEASUREMENT rg_b1.phi_av_mean "Durchflussbeiwert fuer das Auslassventil" SWORD FORMULA_0190 0 0 -0.0001 1.0000 ECU_ADDRESS 0x3FBC78 /begin FUNCTION_LIST RG /end FUNCTION_LIST /end MEASUREMENT
/begin MEASUREMENT rg_b2.phi_av_mean "Durchflussbeiwert fuer das Auslassventil" SWORD FORMULA_0190 0 0 -0.0001 1.0000 ECU_ADDRESS 0x3FBC94 /begin FUNCTION_LIST RG /end FUNCTION_LIST /end MEASUREMENT
/begin MEASUREMENT rg_b1.gas_zustand "Faktor der den Gaszustand beschreibt" UWORD FORMULA_0000 0 0 0.0 65535.0000 ECU_ADDRESS 0x3FBC7A /begin FUNCTION_LIST RG /end FUNCTION_LIST /end MEASUREMENT
/begin MEASUREMENT rg_b2.gas_zustand "Faktor der den Gaszustand beschreibt" UWORD FORMULA_0000 0 0 0.0 65535.0000 ECU_ADDRESS 0x3FBC96 /begin FUNCTION_LIST RG /end FUNCTION_LIST /end MEASUREMENT
/begin MEASUREMENT rg_b1.van_eo "Winkel Einlass offnet" SWORD FORMULA_0188 0 0 50.0000 160.0000 ECU_ADDRESS 0x3FBC7C /begin FUNCTION_LIST RG /end FUNCTION_LIST /end MEASUREMENT
/begin MEASUREMENT rg_b2.van_eo "Winkel Einlass offnet" SWORD FORMULA_0188 0 0 50.0000 160.0000 ECU_ADDRESS 0x3FBC98 /begin FUNCTION_LIST RG /end FUNCTION_LIST /end MEASUREMENT
/begin MEASUREMENT rg_b1.zyl_vol_tot "Totvolumen bei Einlass schliessen" SWORD FORMULA_0191 0 0 0.0 3000.0000 ECU_ADDRESS 0x3FBC7E /begin FUNCTION_LIST RG /end FUNCTION_LIST /end MEASUREMENT
/begin MEASUREMENT rg_b2.zyl_vol_tot "Totvolumen bei Einlass schliessen" SWORD FORMULA_0191 0 0 0.0 3000.0000 ECU_ADDRESS 0x3FBC9A /begin FUNCTION_LIST RG /end FUNCTION_LIST /end MEASUREMENT
/begin MEASUREMENT rg_b1.rho "Dichte vom Abgas" SWORD FORMULA_0192 0 0 -8.0000 7.9997 ECU_ADDRESS 0x3FBC80 /begin FUNCTION_LIST RG /end FUNCTION_LIST /end MEASUREMENT
/begin MEASUREMENT rg_b2.rho "Dichte vom Abgas" SWORD FORMULA_0192 0 0 -8.0000 7.9997 ECU_ADDRESS 0x3FBC9C /begin FUNCTION_LIST RG /end FUNCTION_LIST /end MEASUREMENT
/begin MEASUREMENT rg_b1.mdt_av "Restgasmassenstrom" SWORD FORMULA_0010 0 0 -100.0000 1400.0000 ECU_ADDRESS 0x3FBC82 /begin FUNCTION_LIST RG /end FUNCTION_LIST /end MEASUREMENT
/begin MEASUREMENT rg_b2.mdt_av "Restgasmassenstrom" SWORD FORMULA_0010 0 0 -100.0000 1400.0000 ECU_ADDRESS 0x3FBC9E /begin FUNCTION_LIST RG /end FUNCTION_LIST /end MEASUREMENT
/begin MEASUREMENT rg_b1.x_stat "Statsiche Restgasmasse aus Kennfeld" SWORD FORMULA_0007 0 0 -0.1000 0.5000 ECU_ADDRESS 0x3FBC84 /begin FUNCTION_LIST RG /end FUNCTION_LIST /end MEASUREMENT
/begin MEASUREMENT rg_b2.x_stat "Statsiche Restgasmasse aus Kennfeld" SWORD FORMULA_0007 0 0 -0.1000 0.5000 ECU_ADDRESS 0x3FBCA0 /begin FUNCTION_LIST RG /end FUNCTION_LIST /end MEASUREMENT
/begin MEASUREMENT rg_b1.x_delta "Differenz zwischen Stat. Restgmasse und Modell" SWORD FORMULA_0007 0 0 -0.1000 0.5000 ECU_ADDRESS 0x3FBC86 /begin FUNCTION_LIST RG /end FUNCTION_LIST /end MEASUREMENT
/begin MEASUREMENT rg_b2.x_delta "Differenz zwischen Stat. Restgmasse und Modell" SWORD FORMULA_0007 0 0 -0.1000 0.5000 ECU_ADDRESS 0x3FBCA2 /begin FUNCTION_LIST RG /end FUNCTION_LIST /end MEASUREMENT
/* ------------------ Abschnitt erzeugt aus schalter_inj.dat ------------------ */
/begin MEASUREMENT schalter_st_inj_old_1of2_ "schalter_st_inj_old" UWORD FORMULA_0024 0 0 0.0 65535.0000 ECU_ADDRESS 0x3FBCF8 /begin FUNCTION_LIST Schalter /end FUNCTION_LIST /end MEASUREMENT
/begin MEASUREMENT schalter_st_inj_old_2of2_ "schalter_st_inj_old" UWORD FORMULA_0024 0 0 0.0 65535.0000 ECU_ADDRESS 0x3FBCFA /begin FUNCTION_LIST Schalter /end FUNCTION_LIST /end MEASUREMENT
/begin MEASUREMENT schalter_kl15_ad_inj "Eingelesener Spannungswert Klemme 15" SWORD FORMULA_0112 0 0 0.0 1023.0000 ECU_ADDRESS 0x3FBCFC /begin FUNCTION_LIST Schalter /end FUNCTION_LIST /end MEASUREMENT
/begin MEASUREMENT schalter_getr_ad "Eingelesener Spannungswert vom Getriebeschalter" SWORD FORMULA_0112 0 0 0.0 1023.0000 ECU_ADDRESS 0x3FBCFE /begin FUNCTION_LIST Schalter /end FUNCTION_LIST /end MEASUREMENT
/begin MEASUREMENT schalter_sport_ad "Eingelesener Spannungswert vom Sporttaster" SWORD FORMULA_0112 0 0 0.0 1023.0000 ECU_ADDRESS 0x3FBD00 /begin FUNCTION_LIST Schalter /end FUNCTION_LIST /end MEASUREMENT
/* ------------------ Abschnitt erzeugt aus te.dat ------------------ */
/begin CHARACTERISTIC K_TE_CFG "Freigabe Tankentlueftung" VALUE 0x60C82 TKW_VV_VV_UW 100.0 FORMULA_0201 0.0 1.0 /begin FUNCTION_LIST TE /end FUNCTION_LIST FORMAT "%5.2" /end CHARACTERISTIC
/begin CHARACTERISTIC K_TE_TMOT_MIN "min. TMOT f. TE-Freigabe" VALUE 0x60C84 TKW_VV_VV_SW 100.0 FORMULA_0019 -50.0000 150.0000 /begin FUNCTION_LIST TE /end FUNCTION_LIST FORMAT "%4.1" /end CHARACTERISTIC
/begin CHARACTERISTIC K_TE_LAM_REG_F_DELTA_MAX "max. relativer LA-Eingriff" VALUE 0x60C86 TKW_VV_VV_UW 100.0 FORMULA_0087 0.0 1.9990 /begin FUNCTION_LIST TE /end FUNCTION_LIST FORMAT "%7.4" /end CHARACTERISTIC
/begin CHARACTERISTIC K_TE_T_LERN "Dauer TE-LERN-Phase" VALUE 0x60C88 TKW_VV_VV_UW 100.0 FORMULA_0202 0.0 655.0000 /begin FUNCTION_LIST TE /end FUNCTION_LIST FORMAT "%5.2" /end CHARACTERISTIC
/begin CHARACTERISTIC K_TE_T_SPUEL "Dauer TE-SPUEL-Phase" VALUE 0x60C8A TKW_VV_VV_UW 100.0 FORMULA_0202 0.0 655.0000 /begin FUNCTION_LIST TE /end FUNCTION_LIST FORMAT "%5.2" /end CHARACTERISTIC
/begin CHARACTERISTIC K_TE_TV_MIN "min. TE_TV" VALUE 0x60C8C TKW_VV_VV_UW 100.0 FORMULA_0022 0.0 100.0000 /begin FUNCTION_LIST TE /end FUNCTION_LIST FORMAT "%4.1" /end CHARACTERISTIC
/begin CHARACTERISTIC K_TE_TV_MAX "max. TE_TV" VALUE 0x60C8E TKW_VV_VV_UW 100.0 FORMULA_0022 0.0 100.0000 /begin FUNCTION_LIST TE /end FUNCTION_LIST FORMAT "%4.1" /end CHARACTERISTIC
/begin CHARACTERISTIC K_TE_TV_GRAD_POS "pos. Aenderungsbegrenzung" VALUE 0x60C90 TKW_VV_VV_UW 100.0 FORMULA_0203 0.0 100.0000 /begin FUNCTION_LIST TE /end FUNCTION_LIST FORMAT "%4.1" /end CHARACTERISTIC
/begin CHARACTERISTIC K_TE_TV_GRAD_NEG "neg. Aenderungsbegrenzung" VALUE 0x60C92 TKW_VV_VV_UW 100.0 FORMULA_0203 0.0 100.0000 /begin FUNCTION_LIST TE /end FUNCTION_LIST FORMAT "%4.1" /end CHARACTERISTIC
/begin CHARACTERISTIC K_TE_FREQ "TE-Ansteuerfrequenz" VALUE 0x60C94 TKW_VV_VV_UW 100.0 FORMULA_0204 104.1667 19.5312 /begin FUNCTION_LIST TE /end FUNCTION_LIST FORMAT "%4.1" /end CHARACTERISTIC
/begin CHARACTERISTIC KF_TE_TV_VORST "TE-Vorsteuertastverhaeltnis" MAP 0x60C96 TKF_SW_SW_UW 100.0 FORMULA_0022 0.0 100.0000 /begin FUNCTION_LIST TE /end FUNCTION_LIST /begin AXIS_DESCR STD_AXIS n FORMULA_0011 6 0.0 10000.0000 /end AXIS_DESCR /begin AXIS_DESCR STD_AXIS rf FORMULA_0006 6 0.0 2.0000 FORMAT "%6.3" /end AXIS_DESCR FORMAT "%4.1" /end CHARACTERISTIC
/begin MEASUREMENT te_st "TE-Status" UWORD FORMULA_0200 0 0 0.0 65535.0 ECU_ADDRESS 0x3FBD12 /begin FUNCTION_LIST TE /end FUNCTION_LIST BIT_MASK 0x7 /end MEASUREMENT
/begin MEASUREMENT te_tv "TE-Tastverhaeltnis" UWORD FORMULA_0022 0 0 0.0 100.0000 ECU_ADDRESS 0x3FBD14 /begin FUNCTION_LIST TE /end FUNCTION_LIST /end MEASUREMENT
/begin MEASUREMENT te_tv_vorst "TE-Vorsteuer-Tastverhaeltnis" UWORD FORMULA_0022 0 0 0.0 100.0000 ECU_ADDRESS 0x3FBD16 /begin FUNCTION_LIST TE /end FUNCTION_LIST /end MEASUREMENT
/begin MEASUREMENT te_tv_min "TE-min. Tastverhaeltnis" UWORD FORMULA_0022 0 0 0.0 100.0000 ECU_ADDRESS 0x3FBD18 /begin FUNCTION_LIST TE /end FUNCTION_LIST /end MEASUREMENT
/begin MEASUREMENT te_t_count "TE-100ms-Counter" UWORD FORMULA_0152 0 0 0.0 655.0000 ECU_ADDRESS 0x3FBD1A /begin FUNCTION_LIST TE /end FUNCTION_LIST /end MEASUREMENT
/begin MEASUREMENT te_t_lern "LERN-Zeit" UWORD FORMULA_0152 0 0 0.0 655.0000 ECU_ADDRESS 0x3FBD1C /begin FUNCTION_LIST TE /end FUNCTION_LIST /end MEASUREMENT
/begin MEASUREMENT te_t_spuel "SPUEL-Zeit" UWORD FORMULA_0152 0 0 0.0 655.0000 ECU_ADDRESS 0x3FBD1E /begin FUNCTION_LIST TE /end FUNCTION_LIST /end MEASUREMENT
/begin FUNCTION Inter_Prozessor_Kommunikation "Inter_Prozessor_Kommunikation" /end FUNCTION
/begin FUNCTION Kraftstoffdruck "Kraftstoffdruck" /end FUNCTION
/begin FUNCTION Kraftstoffpumpe_EKP "Kraftstoffpumpe_EKP" /end FUNCTION
/begin FUNCTION LAVK-OBD "LAVK-OBD" /end FUNCTION
/begin FUNCTION LSHNK "LSHNK" /end FUNCTION
/begin FUNCTION Lambda "Lambda" /end FUNCTION
/begin FUNCTION Lambda-NK "Lambda-NK" /end FUNCTION
/begin FUNCTION MZYL "MZYL" /end FUNCTION
/begin FUNCTION NWM "NWM" /end FUNCTION
/begin FUNCTION PCTRL "PCTRL" /end FUNCTION
/begin FUNCTION PKS "PKS" /end FUNCTION
/begin FUNCTION PSAU "PSAU" /end FUNCTION
/begin FUNCTION RF "RF" /end FUNCTION
/begin FUNCTION RG "RG" /end FUNCTION
/begin FUNCTION SG-Konfiguration "SG-Konfiguration" /end FUNCTION
/begin FUNCTION Schalter "Schalter" /end FUNCTION
/begin FUNCTION TE "TE" /end FUNCTION
/begin FUNCTION TPU "TPU" /end FUNCTION
/begin RECORD_LAYOUT TKW_VV_VV_UB FNC_VALUES 1 UBYTE COLUMN_DIR DIRECT /end RECORD_LAYOUT
/begin RECORD_LAYOUT TKW_VV_VV_UW FNC_VALUES 1 UWORD COLUMN_DIR DIRECT /end RECORD_LAYOUT
/begin RECORD_LAYOUT TKW_VV_VV_SW FNC_VALUES 1 SWORD COLUMN_DIR DIRECT /end RECORD_LAYOUT
/begin RECORD_LAYOUT TKW_VV_VV_UL FNC_VALUES 1 ULONG COLUMN_DIR DIRECT /end RECORD_LAYOUT
/begin RECORD_LAYOUT TKL_UW_VV_UW NO_AXIS_PTS_X 1 UBYTE RESERVED 2 BYTE AXIS_PTS_X 3 UWORD INDEX_INCR DIRECT FNC_VALUES 4 UWORD COLUMN_DIR DIRECT /end RECORD_LAYOUT
/begin RECORD_LAYOUT TKL_UW_VV_SW NO_AXIS_PTS_X 1 UBYTE RESERVED 2 BYTE AXIS_PTS_X 3 UWORD INDEX_INCR DIRECT FNC_VALUES 4 SWORD COLUMN_DIR DIRECT /end RECORD_LAYOUT
/begin RECORD_LAYOUT TKL_SW_VV_UW NO_AXIS_PTS_X 1 UBYTE RESERVED 2 BYTE AXIS_PTS_X 3 SWORD INDEX_INCR DIRECT FNC_VALUES 4 UWORD COLUMN_DIR DIRECT /end RECORD_LAYOUT
/begin RECORD_LAYOUT TKL_SW_VV_SW NO_AXIS_PTS_X 1 UBYTE RESERVED 2 BYTE AXIS_PTS_X 3 SWORD INDEX_INCR DIRECT FNC_VALUES 4 SWORD COLUMN_DIR DIRECT /end RECORD_LAYOUT
/begin RECORD_LAYOUT TKF_SW_SW_UW NO_AXIS_PTS_X 1 UBYTE NO_AXIS_PTS_Y 2 UBYTE AXIS_PTS_X 3 SWORD INDEX_INCR DIRECT AXIS_PTS_Y 4 SWORD INDEX_INCR DIRECT FNC_VALUES 5 UWORD COLUMN_DIR DIRECT /end RECORD_LAYOUT
/begin RECORD_LAYOUT TKF_SW_SW_SW NO_AXIS_PTS_X 1 UBYTE NO_AXIS_PTS_Y 2 UBYTE AXIS_PTS_X 3 SWORD INDEX_INCR DIRECT AXIS_PTS_Y 4 SWORD INDEX_INCR DIRECT FNC_VALUES 5 SWORD COLUMN_DIR DIRECT /end RECORD_LAYOUT
/end MODULE
/end PROJECT
