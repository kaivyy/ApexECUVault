ASAP2_VERSION 1 41
/begin PROJECT MSD85 "Spray Guided DI-System with Piezo Injectors for 8-Cylinder"
/begin HEADER "_default_HeaderComment" PROJECT_NO _91 /end HEADER
/begin MODULE _default_ModuleName "_default_ModuleLongIdentifier"
/begin MOD_COMMON "_default_ModCommonComment" DEPOSIT ABSOLUTE BYTE_ORDER MSB_LAST ALIGNMENT_BYTE 1 ALIGNMENT_WORD 2 ALIGNMENT_LONG 2 ALIGNMENT_FLOAT32_IEEE 2 ALIGNMENT_FLOAT64_IEEE 4 /end MOD_COMMON
/begin MEASUREMENT ctr_err_dyn_nr "Number of failure stored in dynamic memory (2nd layer)" UBYTE _CNV_A_R_LINEAR_____0_CM 1 100. 0. 255. DISPLAY_IDENTIFIER CTR_ERR_DYN_NR ECU_ADDRESS 0xd00080cc FORMAT "%3.0" /end MEASUREMENT
/begin CHARACTERISTIC c_ctr_max_wup_cyc "Initialization value for the warm-up cycle of diagnostics" VALUE 0xa0804ebb _REC_VAL_20_u1 255. _CNV_A_R_LINEAR_____0_CM 0. 255. DISPLAY_IDENTIFIER C_CTR_MAX_WUP_CYC FORMAT "%3.0" /end CHARACTERISTIC
/begin CHARACTERISTIC lc_err_fmy_clr "Boolean to clear failure memory when set to 1" VALUE 0xa0804ede _REC_VAL_20_u1 1. _CNV_A_R_LINEAR_____0_CM 0. 1. DISPLAY_IDENTIFIER LC_ERR_FMY_CLR FORMAT "%1.0" /end CHARACTERISTIC
/begin MEASUREMENT tbl_frf[0].envd_obd[0] "Freeze frame FRF_OBD: environmental data (fixed by law)" UBYTE _CNV_A_R_LINEAR_____0_CM 1 100. 0. 255. DISPLAY_IDENTIFIER ENVD_OBD_1_0 ECU_ADDRESS 0xd0009c70 FORMAT "%3.0" /end MEASUREMENT
/begin MEASUREMENT tbl_frf[0].envd_obd[1] "Freeze frame FRF_OBD: environmental data (fixed by law)" UBYTE _CNV_A_R_LINEAR_____0_CM 1 100. 0. 255. DISPLAY_IDENTIFIER ENVD_OBD_2_0 ECU_ADDRESS 0xd0009c71 FORMAT "%3.0" /end MEASUREMENT
/begin MEASUREMENT tbl_frf[0].envd_obd[2] "Freeze frame FRF_OBD: environmental data (fixed by law)" UBYTE _CNV_A_R_LINEAR_____0_CM 1 100. 0. 255. DISPLAY_IDENTIFIER ENVD_OBD_3_0 ECU_ADDRESS 0xd0009c72 FORMAT "%3.0" /end MEASUREMENT
/begin MEASUREMENT tbl_frf[0].envd_obd[3] "Freeze frame FRF_OBD: environmental data (fixed by law)" UBYTE _CNV_A_R_LINEAR_____0_CM 1 100. 0. 255. DISPLAY_IDENTIFIER ENVD_OBD_4_0 ECU_ADDRESS 0xd0009c73 FORMAT "%3.0" /end MEASUREMENT
/begin MEASUREMENT tbl_frf[0].envd_obd[4] "Freeze frame FRF_OBD: environmental data (fixed by law)" UBYTE _CNV_A_R_LINEAR_____0_CM 1 100. 0. 255. DISPLAY_IDENTIFIER ENVD_OBD_5_0 ECU_ADDRESS 0xd0009c74 FORMAT "%3.0" /end MEASUREMENT
/begin MEASUREMENT tbl_frf[0].envd_obd[5] "Freeze frame FRF_OBD: environmental data (fixed by law)" UBYTE _CNV_A_R_LINEAR_____0_CM 1 100. 0. 255. DISPLAY_IDENTIFIER ENVD_OBD_6_0 ECU_ADDRESS 0xd0009c75 FORMAT "%3.0" /end MEASUREMENT
/begin MEASUREMENT tbl_frf[0].envd_obd[6] "Freeze frame FRF_OBD: environmental data (fixed by law)" UBYTE _CNV_A_R_LINEAR_____0_CM 1 100. 0. 255. DISPLAY_IDENTIFIER ENVD_OBD_7_0 ECU_ADDRESS 0xd0009c76 FORMAT "%3.0" /end MEASUREMENT
/begin MEASUREMENT tbl_frf[0].envd_obd[7] "Freeze frame FRF_OBD: environmental data (fixed by law)" UBYTE _CNV_A_R_LINEAR_____0_CM 1 100. 0. 255. DISPLAY_IDENTIFIER ENVD_OBD_8_0 ECU_ADDRESS 0xd0009c77 FORMAT "%3.0" /end MEASUREMENT
/begin MEASUREMENT tbl_frf[0].envd_obd[8] "Freeze frame FRF_OBD: environmental data (fixed by law)" UBYTE _CNV_A_R_LINEAR_____0_CM 1 100. 0. 255. DISPLAY_IDENTIFIER ENVD_OBD_9_0 ECU_ADDRESS 0xd0009c78 FORMAT "%3.0" /end MEASUREMENT
/begin MEASUREMENT tbl_frf[0].envd_obd[9] "Freeze frame FRF_OBD: environmental data (fixed by law)" UBYTE _CNV_A_R_LINEAR_____0_CM 1 100. 0. 255. DISPLAY_IDENTIFIER ENVD_OBD_10_0 ECU_ADDRESS 0xd0009c79 FORMAT "%3.0" /end MEASUREMENT
/begin MEASUREMENT tbl_frf[0].envd_obd[10] "Freeze frame FRF_OBD: environmental data (fixed by law)" UBYTE _CNV_A_R_LINEAR_____0_CM 1 100. 0. 255. DISPLAY_IDENTIFIER ENVD_OBD_11_0 ECU_ADDRESS 0xd0009c7a FORMAT "%3.0" /end MEASUREMENT
/begin MEASUREMENT tbl_frf[0].envd_obd[11] "Freeze frame FRF_OBD: environmental data (fixed by law)" UBYTE _CNV_A_R_LINEAR_____0_CM 1 100. 0. 255. DISPLAY_IDENTIFIER ENVD_OBD_12_0 ECU_ADDRESS 0xd0009c7b FORMAT "%3.0" /end MEASUREMENT
/begin MEASUREMENT tbl_frf[0].envd_obd[12] "Freeze frame FRF_OBD: environmental data (fixed by law)" UBYTE _CNV_A_R_LINEAR_____0_CM 1 100. 0. 255. DISPLAY_IDENTIFIER ENVD_OBD_13_0 ECU_ADDRESS 0xd0009c7c FORMAT "%3.0" /end MEASUREMENT
/begin MEASUREMENT tbl_frf[0].envd_obd[13] "Freeze frame FRF_OBD: environmental data (fixed by law)" UBYTE _CNV_A_R_LINEAR_____0_CM 1 100. 0. 255. DISPLAY_IDENTIFIER ENVD_OBD_14_0 ECU_ADDRESS 0xd0009c7d FORMAT "%3.0" /end MEASUREMENT
/begin MEASUREMENT tbl_frf[0].envd_obd[14] "Freeze frame FRF_OBD: environmental data (fixed by law)" UBYTE _CNV_A_R_LINEAR_____0_CM 1 100. 0. 255. DISPLAY_IDENTIFIER ENVD_OBD_15_0 ECU_ADDRESS 0xd0009c7e FORMAT "%3.0" /end MEASUREMENT
/begin MEASUREMENT tbl_frf[0].envd_obd[15] "Freeze frame FRF_OBD: environmental data (fixed by law)" UBYTE _CNV_A_R_LINEAR_____0_CM 1 100. 0. 255. DISPLAY_IDENTIFIER ENVD_OBD_16_0 ECU_ADDRESS 0xd0009c7f FORMAT "%3.0" /end MEASUREMENT
/begin MEASUREMENT tbl_frf[0].envd_obd[16] "Freeze frame FRF_OBD: environmental data (fixed by law)" UBYTE _CNV_A_R_LINEAR_____0_CM 1 100. 0. 255. DISPLAY_IDENTIFIER ENVD_OBD_17_0 ECU_ADDRESS 0xd0009c80 FORMAT "%3.0" /end MEASUREMENT
/begin MEASUREMENT tbl_frf[0].envd_obd[17] "Freeze frame FRF_OBD: environmental data (fixed by law)" UBYTE _CNV_A_R_LINEAR_____0_CM 1 100. 0. 255. DISPLAY_IDENTIFIER ENVD_OBD_18_0 ECU_ADDRESS 0xd0009c81 FORMAT "%3.0" /end MEASUREMENT
/begin MEASUREMENT tbl_frf[0].envd_obd[18] "Freeze frame FRF_OBD: environmental data (fixed by law)" UBYTE _CNV_A_R_LINEAR_____0_CM 1 100. 0. 255. DISPLAY_IDENTIFIER ENVD_OBD_19_0 ECU_ADDRESS 0xd0009c82 FORMAT "%3.0" /end MEASUREMENT
/begin MEASUREMENT tbl_frf[0].envd_obd[19] "Freeze frame FRF_OBD: environmental data (fixed by law)" UBYTE _CNV_A_R_LINEAR_____0_CM 1 100. 0. 255. DISPLAY_IDENTIFIER ENVD_OBD_20_0 ECU_ADDRESS 0xd0009c83 FORMAT "%3.0" /end MEASUREMENT
/begin MEASUREMENT tbl_frf[0].envd_obd[20] "Freeze frame FRF_OBD: environmental data (fixed by law)" UBYTE _CNV_A_R_LINEAR_____0_CM 1 100. 0. 255. DISPLAY_IDENTIFIER ENVD_OBD_21_0 ECU_ADDRESS 0xd0009c84 FORMAT "%3.0" /end MEASUREMENT
/begin MEASUREMENT tbl_frf[0].envd_obd[21] "Freeze frame FRF_OBD: environmental data (fixed by law)" UBYTE _CNV_A_R_LINEAR_____0_CM 1 100. 0. 255. DISPLAY_IDENTIFIER ENVD_OBD_22_0 ECU_ADDRESS 0xd0009c85 FORMAT "%3.0" /end MEASUREMENT
/begin MEASUREMENT tbl_frf[0].envd_obd[22] "Freeze frame FRF_OBD: environmental data (fixed by law)" UBYTE _CNV_A_R_LINEAR_____0_CM 1 100. 0. 255. DISPLAY_IDENTIFIER ENVD_OBD_23_0 ECU_ADDRESS 0xd0009c86 FORMAT "%3.0" /end MEASUREMENT
/begin MEASUREMENT tbl_frf[0].envd_obd[23] "Freeze frame FRF_OBD: environmental data (fixed by law)" UBYTE _CNV_A_R_LINEAR_____0_CM 1 100. 0. 255. DISPLAY_IDENTIFIER ENVD_OBD_24_0 ECU_ADDRESS 0xd0009c87 FORMAT "%3.0" /end MEASUREMENT
/begin MEASUREMENT tbl_frf[0].envd_obd[24] "Freeze frame FRF_OBD: environmental data (fixed by law)" UBYTE _CNV_A_R_LINEAR_____0_CM 1 100. 0. 255. DISPLAY_IDENTIFIER ENVD_OBD_25_0 ECU_ADDRESS 0xd0009c88 FORMAT "%3.0" /end MEASUREMENT
/begin MEASUREMENT tbl_frf[0].envd_obd[25] "Freeze frame FRF_OBD: environmental data (fixed by law)" UBYTE _CNV_A_R_LINEAR_____0_CM 1 100. 0. 255. DISPLAY_IDENTIFIER ENVD_OBD_26_0 ECU_ADDRESS 0xd0009c89 FORMAT "%3.0" /end MEASUREMENT
/begin MEASUREMENT tbl_frf[0].envd_obd[26] "Freeze frame FRF_OBD: environmental data (fixed by law)" UBYTE _CNV_A_R_LINEAR_____0_CM 1 100. 0. 255. DISPLAY_IDENTIFIER ENVD_OBD_27_0 ECU_ADDRESS 0xd0009c8a FORMAT "%3.0" /end MEASUREMENT
/begin MEASUREMENT tbl_frf[0].envd_obd[27] "Freeze frame FRF_OBD: environmental data (fixed by law)" UBYTE _CNV_A_R_LINEAR_____0_CM 1 100. 0. 255. DISPLAY_IDENTIFIER ENVD_OBD_28_0 ECU_ADDRESS 0xd0009c8b FORMAT "%3.0" /end MEASUREMENT
/begin MEASUREMENT tbl_frf[0].envd_obd[28] "Freeze frame FRF_OBD: environmental data (fixed by law)" UBYTE _CNV_A_R_LINEAR_____0_CM 1 100. 0. 255. DISPLAY_IDENTIFIER ENVD_OBD_29_0 ECU_ADDRESS 0xd0009c8c FORMAT "%3.0" /end MEASUREMENT
/begin MEASUREMENT tbl_frf[0].envd_obd[29] "Freeze frame FRF_OBD: environmental data (fixed by law)" UBYTE _CNV_A_R_LINEAR_____0_CM 1 100. 0. 255. DISPLAY_IDENTIFIER ENVD_OBD_30_0 ECU_ADDRESS 0xd0009c8d FORMAT "%3.0" /end MEASUREMENT
/begin MEASUREMENT tbl_frf[0].envd_obd[30] "Freeze frame FRF_OBD: environmental data (fixed by law)" UBYTE _CNV_A_R_LINEAR_____0_CM 1 100. 0. 255. DISPLAY_IDENTIFIER ENVD_OBD_31_0 ECU_ADDRESS 0xd0009c8e FORMAT "%3.0" /end MEASUREMENT
/begin MEASUREMENT tbl_frf[0].envd_obd[31] "Freeze frame FRF_OBD: environmental data (fixed by law)" UBYTE _CNV_A_R_LINEAR_____0_CM 1 100. 0. 255. DISPLAY_IDENTIFIER ENVD_OBD_32_0 ECU_ADDRESS 0xd0009c8f FORMAT "%3.0" /end MEASUREMENT
/begin MEASUREMENT tbl_frf[0].envd_obd[32] "Freeze frame FRF_OBD: environmental data (fixed by law)" UBYTE _CNV_A_R_LINEAR_____0_CM 1 100. 0. 255. DISPLAY_IDENTIFIER ENVD_OBD_33_0 ECU_ADDRESS 0xd0009c90 FORMAT "%3.0" /end MEASUREMENT
/begin MEASUREMENT tbl_frf[0].envd_obd[33] "Freeze frame FRF_OBD: environmental data (fixed by law)" UBYTE _CNV_A_R_LINEAR_____0_CM 1 100. 0. 255. DISPLAY_IDENTIFIER ENVD_OBD_34_0 ECU_ADDRESS 0xd0009c91 FORMAT "%3.0" /end MEASUREMENT
/begin MEASUREMENT tbl_frf[0].envd_obd[34] "Freeze frame FRF_OBD: environmental data (fixed by law)" UBYTE _CNV_A_R_LINEAR_____0_CM 1 100. 0. 255. DISPLAY_IDENTIFIER ENVD_OBD[34] ECU_ADDRESS 0xd0009c92 FORMAT "%3.0" /end MEASUREMENT
/begin MEASUREMENT tbl_frf[0].envd_obd[35] "Freeze frame FRF_OBD: environmental data (fixed by law)" UBYTE _CNV_A_R_LINEAR_____0_CM 1 100. 0. 255. DISPLAY_IDENTIFIER ENVD_OBD[35] ECU_ADDRESS 0xd0009c93 FORMAT "%3.0" /end MEASUREMENT
/begin MEASUREMENT tbl_frf[0].envd_obd[36] "Freeze frame FRF_OBD: environmental data (fixed by law)" UBYTE _CNV_A_R_LINEAR_____0_CM 1 100. 0. 255. DISPLAY_IDENTIFIER ENVD_OBD[36] ECU_ADDRESS 0xd0009c94 FORMAT "%3.0" /end MEASUREMENT
/begin MEASUREMENT tbl_frf[0].envd_obd[37] "Freeze frame FRF_OBD: environmental data (fixed by law)" UBYTE _CNV_A_R_LINEAR_____0_CM 1 100. 0. 255. DISPLAY_IDENTIFIER ENVD_OBD[37] ECU_ADDRESS 0xd0009c95 FORMAT "%3.0" /end MEASUREMENT
/begin MEASUREMENT tbl_frf[0].envd_cus_cmn[0] "Freeze frame FRF_CUS_CMN: environmental data common to all failure (not fixed by law)" UBYTE _CNV_A_R_LINEAR_____0_CM 1 100. 0. 255. DISPLAY_IDENTIFIER ENVD_CUS_CMN_1_0 ECU_ADDRESS 0xd0009c96 FORMAT "%3.0" /end MEASUREMENT
/begin MEASUREMENT tbl_frf[0].envd_cus_set_cmn[0][0] "Freeze frame FRF_CUS_SET_CMN: environmental data common to all failure (not fixed by law) stored in set" UBYTE _CNV_A_R_LINEAR_____0_CM 1 100. 0. 255. DISPLAY_IDENTIFIER ENVD_CUS_SET_CMN_1_1_0 ECU_ADDRESS 0xd0009c98 FORMAT "%3.0" /end MEASUREMENT
/begin MEASUREMENT tbl_frf[0].envd_cus_set_cmn[0][1] "Freeze frame FRF_CUS_SET_CMN: environmental data common to all failure (not fixed by law) stored in set" UBYTE _CNV_A_R_LINEAR_____0_CM 1 100. 0. 255. DISPLAY_IDENTIFIER ENVD_CUS_SET_CMN_2_1_0 ECU_ADDRESS 0xd0009c99 FORMAT "%3.0" /end MEASUREMENT
/begin MEASUREMENT tbl_frf[0].envd_cus_set_cmn[0][2] "Freeze frame FRF_CUS_SET_CMN: environmental data common to all failure (not fixed by law) stored in set" UBYTE _CNV_A_R_LINEAR_____0_CM 1 100. 0. 255. DISPLAY_IDENTIFIER ENVD_CUS_SET_CMN_3_1_0 ECU_ADDRESS 0xd0009c9a FORMAT "%3.0" /end MEASUREMENT
/begin MEASUREMENT tbl_frf[0].envd_cus_set_cmn[0][3] "Freeze frame FRF_CUS_SET_CMN: environmental data common to all failure (not fixed by law) stored in set" UBYTE _CNV_A_R_LINEAR_____0_CM 1 100. 0. 255. DISPLAY_IDENTIFIER ENVD_CUS_SET_CMN_0_3_ ECU_ADDRESS 0xd0009c9b FORMAT "%3.0" /end MEASUREMENT
/begin MEASUREMENT tbl_frf[0].envd_cus_set_cmn[0][4] "Freeze frame FRF_CUS_SET_CMN: environmental data common to all failure (not fixed by law) stored in set" UBYTE _CNV_A_R_LINEAR_____0_CM 1 100. 0. 255. DISPLAY_IDENTIFIER ENVD_CUS_SET_CMN_0_4_ ECU_ADDRESS 0xd0009c9c FORMAT "%3.0" /end MEASUREMENT
/begin MEASUREMENT tbl_frf[0].envd_cus_set_cmn[0][5] "Freeze frame FRF_CUS_SET_CMN: environmental data common to all failure (not fixed by law) stored in set" UBYTE _CNV_A_R_LINEAR_____0_CM 1 100. 0. 255. DISPLAY_IDENTIFIER ENVD_CUS_SET_CMN_0_5_ ECU_ADDRESS 0xd0009c9d FORMAT "%3.0" /end MEASUREMENT
/begin MEASUREMENT tbl_frf[0].envd_cus_set_cmn[0][6] "Freeze frame FRF_CUS_SET_CMN: environmental data common to all failure (not fixed by law) stored in set" UBYTE _CNV_A_R_LINEAR_____0_CM 1 100. 0. 255. DISPLAY_IDENTIFIER ENVD_CUS_SET_CMN_0_6_ ECU_ADDRESS 0xd0009c9e FORMAT "%3.0" /end MEASUREMENT
/begin MEASUREMENT tbl_frf[0].envd_cus_set_cmn[0][7] "Freeze frame FRF_CUS_SET_CMN: environmental data common to all failure (not fixed by law) stored in set" UBYTE _CNV_A_R_LINEAR_____0_CM 1 100. 0. 255. DISPLAY_IDENTIFIER ENVD_CUS_SET_CMN_0_7_ ECU_ADDRESS 0xd0009c9f FORMAT "%3.0" /end MEASUREMENT
/begin MEASUREMENT tbl_frf[0].envd_cus_set_cmn[0][8] "Freeze frame FRF_CUS_SET_CMN: environmental data common to all failure (not fixed by law) stored in set" UBYTE _CNV_A_R_LINEAR_____0_CM 1 100. 0. 255. DISPLAY_IDENTIFIER ENVD_CUS_SET_CMN_0_8_ ECU_ADDRESS 0xd0009ca0 FORMAT "%3.0" /end MEASUREMENT
/begin MEASUREMENT tbl_frf[0].envd_cus_set_cmn[0][9] "Freeze frame FRF_CUS_SET_CMN: environmental data common to all failure (not fixed by law) stored in set" UBYTE _CNV_A_R_LINEAR_____0_CM 1 100. 0. 255. DISPLAY_IDENTIFIER ENVD_CUS_SET_CMN_0_9_ ECU_ADDRESS 0xd0009ca1 FORMAT "%3.0" /end MEASUREMENT
/begin MEASUREMENT tbl_frf[0].envd_cus_set_cmn[1][0] "Freeze frame FRF_CUS_SET_CMN: environmental data common to all failure (not fixed by law) stored in set" UBYTE _CNV_A_R_LINEAR_____0_CM 1 100. 0. 255. DISPLAY_IDENTIFIER ENVD_CUS_SET_CMN_1_2_0 ECU_ADDRESS 0xd0009ca2 FORMAT "%3.0" /end MEASUREMENT
/begin MEASUREMENT tbl_frf[0].envd_cus_set_cmn[1][1] "Freeze frame FRF_CUS_SET_CMN: environmental data common to all failure (not fixed by law) stored in set" UBYTE _CNV_A_R_LINEAR_____0_CM 1 100. 0. 255. DISPLAY_IDENTIFIER ENVD_CUS_SET_CMN_2_2_0 ECU_ADDRESS 0xd0009ca3 FORMAT "%3.0" /end MEASUREMENT
/begin MEASUREMENT tbl_frf[0].envd_cus_set_cmn[1][2] "Freeze frame FRF_CUS_SET_CMN: environmental data common to all failure (not fixed by law) stored in set" UBYTE _CNV_A_R_LINEAR_____0_CM 1 100. 0. 255. DISPLAY_IDENTIFIER ENVD_CUS_SET_CMN_3_2_0 ECU_ADDRESS 0xd0009ca4 FORMAT "%3.0" /end MEASUREMENT
/begin MEASUREMENT tbl_frf[0].envd_cus_set_cmn[1][3] "Freeze frame FRF_CUS_SET_CMN: environmental data common to all failure (not fixed by law) stored in set" UBYTE _CNV_A_R_LINEAR_____0_CM 1 100. 0. 255. DISPLAY_IDENTIFIER ENVD_CUS_SET_CMN_1_3_ ECU_ADDRESS 0xd0009ca5 FORMAT "%3.0" /end MEASUREMENT
/begin MEASUREMENT tbl_frf[0].envd_cus_set_cmn[1][4] "Freeze frame FRF_CUS_SET_CMN: environmental data common to all failure (not fixed by law) stored in set" UBYTE _CNV_A_R_LINEAR_____0_CM 1 100. 0. 255. DISPLAY_IDENTIFIER ENVD_CUS_SET_CMN_1_4_ ECU_ADDRESS 0xd0009ca6 FORMAT "%3.0" /end MEASUREMENT
/begin MEASUREMENT tbl_frf[0].envd_cus_set_cmn[1][5] "Freeze frame FRF_CUS_SET_CMN: environmental data common to all failure (not fixed by law) stored in set" UBYTE _CNV_A_R_LINEAR_____0_CM 1 100. 0. 255. DISPLAY_IDENTIFIER ENVD_CUS_SET_CMN_1_5_ ECU_ADDRESS 0xd0009ca7 FORMAT "%3.0" /end MEASUREMENT
/begin MEASUREMENT tbl_frf[0].envd_cus_set_cmn[1][6] "Freeze frame FRF_CUS_SET_CMN: environmental data common to all failure (not fixed by law) stored in set" UBYTE _CNV_A_R_LINEAR_____0_CM 1 100. 0. 255. DISPLAY_IDENTIFIER ENVD_CUS_SET_CMN_1_6_ ECU_ADDRESS 0xd0009ca8 FORMAT "%3.0" /end MEASUREMENT
/begin MEASUREMENT tbl_frf[0].envd_cus_set_cmn[1][7] "Freeze frame FRF_CUS_SET_CMN: environmental data common to all failure (not fixed by law) stored in set" UBYTE _CNV_A_R_LINEAR_____0_CM 1 100. 0. 255. DISPLAY_IDENTIFIER ENVD_CUS_SET_CMN_1_7_ ECU_ADDRESS 0xd0009ca9 FORMAT "%3.0" /end MEASUREMENT
/begin MEASUREMENT tbl_frf[0].envd_cus_set_cmn[1][8] "Freeze frame FRF_CUS_SET_CMN: environmental data common to all failure (not fixed by law) stored in set" UBYTE _CNV_A_R_LINEAR_____0_CM 1 100. 0. 255. DISPLAY_IDENTIFIER ENVD_CUS_SET_CMN_1_8_ ECU_ADDRESS 0xd0009caa FORMAT "%3.0" /end MEASUREMENT
/begin MEASUREMENT tbl_frf[0].envd_cus_set_cmn[1][9] "Freeze frame FRF_CUS_SET_CMN: environmental data common to all failure (not fixed by law) stored in set" UBYTE _CNV_A_R_LINEAR_____0_CM 1 100. 0. 255. DISPLAY_IDENTIFIER ENVD_CUS_SET_CMN_1_9_ ECU_ADDRESS 0xd0009cab FORMAT "%3.0" /end MEASUREMENT
/begin MEASUREMENT tbl_frf[0].envd_cus_set_cmn[2][0] "Freeze frame FRF_CUS_SET_CMN: environmental data common to all failure (not fixed by law) stored in set" UBYTE _CNV_A_R_LINEAR_____0_CM 1 100. 0. 255. DISPLAY_IDENTIFIER ENVD_CUS_SET_CMN_1_3_0 ECU_ADDRESS 0xd0009cac FORMAT "%3.0" /end MEASUREMENT
/begin MEASUREMENT tbl_frf[0].envd_cus_set_cmn[2][1] "Freeze frame FRF_CUS_SET_CMN: environmental data common to all failure (not fixed by law) stored in set" UBYTE _CNV_A_R_LINEAR_____0_CM 1 100. 0. 255. DISPLAY_IDENTIFIER ENVD_CUS_SET_CMN_2_3_0 ECU_ADDRESS 0xd0009cad FORMAT "%3.0" /end MEASUREMENT
/begin MEASUREMENT tbl_frf[0].envd_cus_set_cmn[2][2] "Freeze frame FRF_CUS_SET_CMN: environmental data common to all failure (not fixed by law) stored in set" UBYTE _CNV_A_R_LINEAR_____0_CM 1 100. 0. 255. DISPLAY_IDENTIFIER ENVD_CUS_SET_CMN_3_3_0 ECU_ADDRESS 0xd0009cae FORMAT "%3.0" /end MEASUREMENT
/begin MEASUREMENT tbl_frf[0].envd_cus_set_cmn[2][3] "Freeze frame FRF_CUS_SET_CMN: environmental data common to all failure (not fixed by law) stored in set" UBYTE _CNV_A_R_LINEAR_____0_CM 1 100. 0. 255. DISPLAY_IDENTIFIER ENVD_CUS_SET_CMN_2_3_ ECU_ADDRESS 0xd0009caf FORMAT "%3.0" /end MEASUREMENT
/begin MEASUREMENT tbl_frf[0].envd_cus_set_cmn[2][4] "Freeze frame FRF_CUS_SET_CMN: environmental data common to all failure (not fixed by law) stored in set" UBYTE _CNV_A_R_LINEAR_____0_CM 1 100. 0. 255. DISPLAY_IDENTIFIER ENVD_CUS_SET_CMN_2_4_ ECU_ADDRESS 0xd0009cb0 FORMAT "%3.0" /end MEASUREMENT
/begin MEASUREMENT tbl_frf[0].envd_cus_set_cmn[2][5] "Freeze frame FRF_CUS_SET_CMN: environmental data common to all failure (not fixed by law) stored in set" UBYTE _CNV_A_R_LINEAR_____0_CM 1 100. 0. 255. DISPLAY_IDENTIFIER ENVD_CUS_SET_CMN_2_5_ ECU_ADDRESS 0xd0009cb1 FORMAT "%3.0" /end MEASUREMENT
/begin MEASUREMENT tbl_frf[0].envd_cus_set_cmn[2][6] "Freeze frame FRF_CUS_SET_CMN: environmental data common to all failure (not fixed by law) stored in set" UBYTE _CNV_A_R_LINEAR_____0_CM 1 100. 0. 255. DISPLAY_IDENTIFIER ENVD_CUS_SET_CMN_2_6_ ECU_ADDRESS 0xd0009cb2 FORMAT "%3.0" /end MEASUREMENT
/begin MEASUREMENT tbl_frf[0].envd_cus_set_cmn[2][7] "Freeze frame FRF_CUS_SET_CMN: environmental data common to all failure (not fixed by law) stored in set" UBYTE _CNV_A_R_LINEAR_____0_CM 1 100. 0. 255. DISPLAY_IDENTIFIER ENVD_CUS_SET_CMN_2_7_ ECU_ADDRESS 0xd0009cb3 FORMAT "%3.0" /end MEASUREMENT
/begin MEASUREMENT tbl_frf[0].envd_cus_set_cmn[2][8] "Freeze frame FRF_CUS_SET_CMN: environmental data common to all failure (not fixed by law) stored in set" UBYTE _CNV_A_R_LINEAR_____0_CM 1 100. 0. 255. DISPLAY_IDENTIFIER ENVD_CUS_SET_CMN_2_8_ ECU_ADDRESS 0xd0009cb4 FORMAT "%3.0" /end MEASUREMENT
/begin MEASUREMENT tbl_frf[0].envd_cus_set_cmn[2][9] "Freeze frame FRF_CUS_SET_CMN: environmental data common to all failure (not fixed by law) stored in set" UBYTE _CNV_A_R_LINEAR_____0_CM 1 100. 0. 255. DISPLAY_IDENTIFIER ENVD_CUS_SET_CMN_2_9_ ECU_ADDRESS 0xd0009cb5 FORMAT "%3.0" /end MEASUREMENT
/begin MEASUREMENT tbl_frf[0].envd_cus_set_spc[0][0] "Freeze frame FRF_CUS_SET_SPC: environmental data specific to each failure (not fixed by law) stored in set" UBYTE _CNV_A_R_LINEAR_____0_CM 1 100. 0. 255. DISPLAY_IDENTIFIER ENVD_CUS_SET_SPC_1_1_0 ECU_ADDRESS 0xd0009cb8 FORMAT "%3.0" /end MEASUREMENT
/begin MEASUREMENT tbl_frf[0].envd_cus_set_spc[0][1] "Freeze frame FRF_CUS_SET_SPC: environmental data specific to each failure (not fixed by law) stored in set" UBYTE _CNV_A_R_LINEAR_____0_CM 1 100. 0. 255. DISPLAY_IDENTIFIER ENVD_CUS_SET_SPC_2_1_0 ECU_ADDRESS 0xd0009cb9 FORMAT "%3.0" /end MEASUREMENT
/begin MEASUREMENT tbl_frf[0].envd_cus_set_spc[0][2] "Freeze frame FRF_CUS_SET_SPC: environmental data specific to each failure (not fixed by law) stored in set" UBYTE _CNV_A_R_LINEAR_____0_CM 1 100. 0. 255. DISPLAY_IDENTIFIER ENVD_CUS_SET_SPC_3_1_0 ECU_ADDRESS 0xd0009cba FORMAT "%3.0" /end MEASUREMENT
/begin MEASUREMENT tbl_frf[0].envd_cus_set_spc[0][3] "Freeze frame FRF_CUS_SET_SPC: environmental data specific to each failure (not fixed by law) stored in set" UBYTE _CNV_A_R_LINEAR_____0_CM 1 100. 0. 255. DISPLAY_IDENTIFIER ENVD_CUS_SET_SPC_4_1_0 ECU_ADDRESS 0xd0009cbb FORMAT "%3.0" /end MEASUREMENT
/begin MEASUREMENT tbl_frf[0].envd_cus_set_spc[1][0] "Freeze frame FRF_CUS_SET_SPC: environmental data specific to each failure (not fixed by law) stored in set" UBYTE _CNV_A_R_LINEAR_____0_CM 1 100. 0. 255. DISPLAY_IDENTIFIER ENVD_CUS_SET_SPC_1_2_0 ECU_ADDRESS 0xd0009cbc FORMAT "%3.0" /end MEASUREMENT
/begin MEASUREMENT tbl_frf[0].envd_cus_set_spc[1][1] "Freeze frame FRF_CUS_SET_SPC: environmental data specific to each failure (not fixed by law) stored in set" UBYTE _CNV_A_R_LINEAR_____0_CM 1 100. 0. 255. DISPLAY_IDENTIFIER ENVD_CUS_SET_SPC_2_2_0 ECU_ADDRESS 0xd0009cbd FORMAT "%3.0" /end MEASUREMENT
/begin MEASUREMENT tbl_frf[0].envd_cus_set_spc[1][2] "Freeze frame FRF_CUS_SET_SPC: environmental data specific to each failure (not fixed by law) stored in set" UBYTE _CNV_A_R_LINEAR_____0_CM 1 100. 0. 255. DISPLAY_IDENTIFIER ENVD_CUS_SET_SPC_3_2_0 ECU_ADDRESS 0xd0009cbe FORMAT "%3.0" /end MEASUREMENT
/begin MEASUREMENT tbl_frf[0].envd_cus_set_spc[1][3] "Freeze frame FRF_CUS_SET_SPC: environmental data specific to each failure (not fixed by law) stored in set" UBYTE _CNV_A_R_LINEAR_____0_CM 1 100. 0. 255. DISPLAY_IDENTIFIER ENVD_CUS_SET_SPC_4_2_0 ECU_ADDRESS 0xd0009cbf FORMAT "%3.0" /end MEASUREMENT
/begin MEASUREMENT tbl_frf[0].envd_cus_set_spc[2][0] "Freeze frame FRF_CUS_SET_SPC: environmental data specific to each failure (not fixed by law) stored in set" UBYTE _CNV_A_R_LINEAR_____0_CM 1 100. 0. 255. DISPLAY_IDENTIFIER ENVD_CUS_SET_SPC_1_3_0 ECU_ADDRESS 0xd0009cc0 FORMAT "%3.0" /end MEASUREMENT
/begin MEASUREMENT tbl_frf[0].envd_cus_set_spc[2][1] "Freeze frame FRF_CUS_SET_SPC: environmental data specific to each failure (not fixed by law) stored in set" UBYTE _CNV_A_R_LINEAR_____0_CM 1 100. 0. 255. DISPLAY_IDENTIFIER ENVD_CUS_SET_SPC_2_3_0 ECU_ADDRESS 0xd0009cc1 FORMAT "%3.0" /end MEASUREMENT
/begin MEASUREMENT tbl_frf[0].envd_cus_set_spc[2][2] "Freeze frame FRF_CUS_SET_SPC: environmental data specific to each failure (not fixed by law) stored in set" UBYTE _CNV_A_R_LINEAR_____0_CM 1 100. 0. 255. DISPLAY_IDENTIFIER ENVD_CUS_SET_SPC_3_3_0 ECU_ADDRESS 0xd0009cc2 FORMAT "%3.0" /end MEASUREMENT
/begin MEASUREMENT tbl_frf[0].envd_cus_set_spc[2][3] "Freeze frame FRF_CUS_SET_SPC: environmental data specific to each failure (not fixed by law) stored in set" UBYTE _CNV_A_R_LINEAR_____0_CM 1 100. 0. 255. DISPLAY_IDENTIFIER ENVD_CUS_SET_SPC_4_3_0 ECU_ADDRESS 0xd0009cc3 FORMAT "%3.0" /end MEASUREMENT
/begin MEASUREMENT tbl_frf[1].envd_obd[0] "Freeze frame FRF_OBD: environmental data (fixed by law)" UBYTE _CNV_A_R_LINEAR_____0_CM 1 100. 0. 255. DISPLAY_IDENTIFIER ENVD_OBD_1_1 ECU_ADDRESS 0xd0009cc8 FORMAT "%3.0" /end MEASUREMENT
/begin MEASUREMENT tbl_frf[1].envd_obd[1] "Freeze frame FRF_OBD: environmental data (fixed by law)" UBYTE _CNV_A_R_LINEAR_____0_CM 1 100. 0. 255. DISPLAY_IDENTIFIER ENVD_OBD_2_1 ECU_ADDRESS 0xd0009cc9 FORMAT "%3.0" /end MEASUREMENT
/begin MEASUREMENT tbl_frf[1].envd_obd[2] "Freeze frame FRF_OBD: environmental data (fixed by law)" UBYTE _CNV_A_R_LINEAR_____0_CM 1 100. 0. 255. DISPLAY_IDENTIFIER ENVD_OBD_3_1 ECU_ADDRESS 0xd0009cca FORMAT "%3.0" /end MEASUREMENT
/begin MEASUREMENT tbl_frf[1].envd_obd[3] "Freeze frame FRF_OBD: environmental data (fixed by law)" UBYTE _CNV_A_R_LINEAR_____0_CM 1 100. 0. 255. DISPLAY_IDENTIFIER ENVD_OBD_4_1 ECU_ADDRESS 0xd0009ccb FORMAT "%3.0" /end MEASUREMENT
/begin MEASUREMENT tbl_frf[1].envd_obd[4] "Freeze frame FRF_OBD: environmental data (fixed by law)" UBYTE _CNV_A_R_LINEAR_____0_CM 1 100. 0. 255. DISPLAY_IDENTIFIER ENVD_OBD_5_1 ECU_ADDRESS 0xd0009ccc FORMAT "%3.0" /end MEASUREMENT
/begin MEASUREMENT tbl_frf[1].envd_obd[5] "Freeze frame FRF_OBD: environmental data (fixed by law)" UBYTE _CNV_A_R_LINEAR_____0_CM 1 100. 0. 255. DISPLAY_IDENTIFIER ENVD_OBD_6_1 ECU_ADDRESS 0xd0009ccd FORMAT "%3.0" /end MEASUREMENT
/begin MEASUREMENT tbl_frf[1].envd_obd[6] "Freeze frame FRF_OBD: environmental data (fixed by law)" UBYTE _CNV_A_R_LINEAR_____0_CM 1 100. 0. 255. DISPLAY_IDENTIFIER ENVD_OBD_7_1 ECU_ADDRESS 0xd0009cce FORMAT "%3.0" /end MEASUREMENT
/begin MEASUREMENT tbl_frf[1].envd_obd[7] "Freeze frame FRF_OBD: environmental data (fixed by law)" UBYTE _CNV_A_R_LINEAR_____0_CM 1 100. 0. 255. DISPLAY_IDENTIFIER ENVD_OBD_8_1 ECU_ADDRESS 0xd0009ccf FORMAT "%3.0" /end MEASUREMENT
/begin MEASUREMENT tbl_frf[1].envd_obd[8] "Freeze frame FRF_OBD: environmental data (fixed by law)" UBYTE _CNV_A_R_LINEAR_____0_CM 1 100. 0. 255. DISPLAY_IDENTIFIER ENVD_OBD_9_1 ECU_ADDRESS 0xd0009cd0 FORMAT "%3.0" /end MEASUREMENT
/begin MEASUREMENT tbl_frf[1].envd_obd[9] "Freeze frame FRF_OBD: environmental data (fixed by law)" UBYTE _CNV_A_R_LINEAR_____0_CM 1 100. 0. 255. DISPLAY_IDENTIFIER ENVD_OBD_10_1 ECU_ADDRESS 0xd0009cd1 FORMAT "%3.0" /end MEASUREMENT
/begin MEASUREMENT tbl_frf[1].envd_obd[10] "Freeze frame FRF_OBD: environmental data (fixed by law)" UBYTE _CNV_A_R_LINEAR_____0_CM 1 100. 0. 255. DISPLAY_IDENTIFIER ENVD_OBD_11_1 ECU_ADDRESS 0xd0009cd2 FORMAT "%3.0" /end MEASUREMENT
/begin MEASUREMENT tbl_frf[1].envd_obd[11] "Freeze frame FRF_OBD: environmental data (fixed by law)" UBYTE _CNV_A_R_LINEAR_____0_CM 1 100. 0. 255. DISPLAY_IDENTIFIER ENVD_OBD_12_1 ECU_ADDRESS 0xd0009cd3 FORMAT "%3.0" /end MEASUREMENT
/begin MEASUREMENT tbl_frf[1].envd_obd[12] "Freeze frame FRF_OBD: environmental data (fixed by law)" UBYTE _CNV_A_R_LINEAR_____0_CM 1 100. 0. 255. DISPLAY_IDENTIFIER ENVD_OBD_13_1 ECU_ADDRESS 0xd0009cd4 FORMAT "%3.0" /end MEASUREMENT
/begin MEASUREMENT tbl_frf[1].envd_obd[13] "Freeze frame FRF_OBD: environmental data (fixed by law)" UBYTE _CNV_A_R_LINEAR_____0_CM 1 100. 0. 255. DISPLAY_IDENTIFIER ENVD_OBD_14_1 ECU_ADDRESS 0xd0009cd5 FORMAT "%3.0" /end MEASUREMENT
/begin MEASUREMENT tbl_frf[1].envd_obd[14] "Freeze frame FRF_OBD: environmental data (fixed by law)" UBYTE _CNV_A_R_LINEAR_____0_CM 1 100. 0. 255. DISPLAY_IDENTIFIER ENVD_OBD_15_1 ECU_ADDRESS 0xd0009cd6 FORMAT "%3.0" /end MEASUREMENT
/begin MEASUREMENT tbl_frf[1].envd_obd[15] "Freeze frame FRF_OBD: environmental data (fixed by law)" UBYTE _CNV_A_R_LINEAR_____0_CM 1 100. 0. 255. DISPLAY_IDENTIFIER ENVD_OBD_16_1 ECU_ADDRESS 0xd0009cd7 FORMAT "%3.0" /end MEASUREMENT
/begin MEASUREMENT tbl_frf[1].envd_obd[16] "Freeze frame FRF_OBD: environmental data (fixed by law)" UBYTE _CNV_A_R_LINEAR_____0_CM 1 100. 0. 255. DISPLAY_IDENTIFIER ENVD_OBD_17_1 ECU_ADDRESS 0xd0009cd8 FORMAT "%3.0" /end MEASUREMENT
/begin MEASUREMENT tbl_frf[1].envd_obd[17] "Freeze frame FRF_OBD: environmental data (fixed by law)" UBYTE _CNV_A_R_LINEAR_____0_CM 1 100. 0. 255. DISPLAY_IDENTIFIER ENVD_OBD_18_1 ECU_ADDRESS 0xd0009cd9 FORMAT "%3.0" /end MEASUREMENT
/begin MEASUREMENT tbl_frf[1].envd_obd[18] "Freeze frame FRF_OBD: environmental data (fixed by law)" UBYTE _CNV_A_R_LINEAR_____0_CM 1 100. 0. 255. DISPLAY_IDENTIFIER ENVD_OBD_19_1 ECU_ADDRESS 0xd0009cda FORMAT "%3.0" /end MEASUREMENT
/begin MEASUREMENT tbl_frf[1].envd_obd[19] "Freeze frame FRF_OBD: environmental data (fixed by law)" UBYTE _CNV_A_R_LINEAR_____0_CM 1 100. 0. 255. DISPLAY_IDENTIFIER ENVD_OBD_20_1 ECU_ADDRESS 0xd0009cdb FORMAT "%3.0" /end MEASUREMENT
/begin MEASUREMENT tbl_frf[1].envd_obd[20] "Freeze frame FRF_OBD: environmental data (fixed by law)" UBYTE _CNV_A_R_LINEAR_____0_CM 1 100. 0. 255. DISPLAY_IDENTIFIER ENVD_OBD_21_1 ECU_ADDRESS 0xd0009cdc FORMAT "%3.0" /end MEASUREMENT
/begin MEASUREMENT tbl_frf[1].envd_obd[21] "Freeze frame FRF_OBD: environmental data (fixed by law)" UBYTE _CNV_A_R_LINEAR_____0_CM 1 100. 0. 255. DISPLAY_IDENTIFIER ENVD_OBD_22_1 ECU_ADDRESS 0xd0009cdd FORMAT "%3.0" /end MEASUREMENT
/begin MEASUREMENT tbl_frf[1].envd_obd[22] "Freeze frame FRF_OBD: environmental data (fixed by law)" UBYTE _CNV_A_R_LINEAR_____0_CM 1 100. 0. 255. DISPLAY_IDENTIFIER ENVD_OBD_23_1 ECU_ADDRESS 0xd0009cde FORMAT "%3.0" /end MEASUREMENT
/begin MEASUREMENT tbl_frf[1].envd_obd[23] "Freeze frame FRF_OBD: environmental data (fixed by law)" UBYTE _CNV_A_R_LINEAR_____0_CM 1 100. 0. 255. DISPLAY_IDENTIFIER ENVD_OBD_24_1 ECU_ADDRESS 0xd0009cdf FORMAT "%3.0" /end MEASUREMENT
/begin MEASUREMENT tbl_frf[1].envd_obd[24] "Freeze frame FRF_OBD: environmental data (fixed by law)" UBYTE _CNV_A_R_LINEAR_____0_CM 1 100. 0. 255. DISPLAY_IDENTIFIER ENVD_OBD_25_1 ECU_ADDRESS 0xd0009ce0 FORMAT "%3.0" /end MEASUREMENT
/begin MEASUREMENT tbl_frf[1].envd_obd[25] "Freeze frame FRF_OBD: environmental data (fixed by law)" UBYTE _CNV_A_R_LINEAR_____0_CM 1 100. 0. 255. DISPLAY_IDENTIFIER ENVD_OBD_26_1 ECU_ADDRESS 0xd0009ce1 FORMAT "%3.0" /end MEASUREMENT
/begin MEASUREMENT tbl_frf[1].envd_obd[26] "Freeze frame FRF_OBD: environmental data (fixed by law)" UBYTE _CNV_A_R_LINEAR_____0_CM 1 100. 0. 255. DISPLAY_IDENTIFIER ENVD_OBD_27_1 ECU_ADDRESS 0xd0009ce2 FORMAT "%3.0" /end MEASUREMENT
/begin MEASUREMENT tbl_frf[1].envd_obd[27] "Freeze frame FRF_OBD: environmental data (fixed by law)" UBYTE _CNV_A_R_LINEAR_____0_CM 1 100. 0. 255. DISPLAY_IDENTIFIER ENVD_OBD_28_1 ECU_ADDRESS 0xd0009ce3 FORMAT "%3.0" /end MEASUREMENT
/begin MEASUREMENT tbl_frf[1].envd_obd[28] "Freeze frame FRF_OBD: environmental data (fixed by law)" UBYTE _CNV_A_R_LINEAR_____0_CM 1 100. 0. 255. DISPLAY_IDENTIFIER ENVD_OBD_29_1 ECU_ADDRESS 0xd0009ce4 FORMAT "%3.0" /end MEASUREMENT
/begin MEASUREMENT tbl_frf[1].envd_obd[29] "Freeze frame FRF_OBD: environmental data (fixed by law)" UBYTE _CNV_A_R_LINEAR_____0_CM 1 100. 0. 255. DISPLAY_IDENTIFIER ENVD_OBD_30_1 ECU_ADDRESS 0xd0009ce5 FORMAT "%3.0" /end MEASUREMENT
/begin MEASUREMENT tbl_frf[1].envd_obd[30] "Freeze frame FRF_OBD: environmental data (fixed by law)" UBYTE _CNV_A_R_LINEAR_____0_CM 1 100. 0. 255. DISPLAY_IDENTIFIER ENVD_OBD_31_1 ECU_ADDRESS 0xd0009ce6 FORMAT "%3.0" /end MEASUREMENT
/begin MEASUREMENT tbl_frf[1].envd_obd[31] "Freeze frame FRF_OBD: environmental data (fixed by law)" UBYTE _CNV_A_R_LINEAR_____0_CM 1 100. 0. 255. DISPLAY_IDENTIFIER ENVD_OBD_32_1 ECU_ADDRESS 0xd0009ce7 FORMAT "%3.0" /end MEASUREMENT
/begin MEASUREMENT tbl_frf[1].envd_obd[32] "Freeze frame FRF_OBD: environmental data (fixed by law)" UBYTE _CNV_A_R_LINEAR_____0_CM 1 100. 0. 255. DISPLAY_IDENTIFIER ENVD_OBD_33_1 ECU_ADDRESS 0xd0009ce8 FORMAT "%3.0" /end MEASUREMENT
/begin MEASUREMENT tbl_frf[1].envd_obd[33] "Freeze frame FRF_OBD: environmental data (fixed by law)" UBYTE _CNV_A_R_LINEAR_____0_CM 1 100. 0. 255. DISPLAY_IDENTIFIER ENVD_OBD_34_1 ECU_ADDRESS 0xd0009ce9 FORMAT "%3.0" /end MEASUREMENT
/begin MEASUREMENT tbl_frf[1].envd_obd[34] "Freeze frame FRF_OBD: environmental data (fixed by law)" UBYTE _CNV_A_R_LINEAR_____0_CM 1 100. 0. 255. DISPLAY_IDENTIFIER ENVD_OBD[34] ECU_ADDRESS 0xd0009cea FORMAT "%3.0" /end MEASUREMENT
/begin MEASUREMENT tbl_frf[1].envd_obd[35] "Freeze frame FRF_OBD: environmental data (fixed by law)" UBYTE _CNV_A_R_LINEAR_____0_CM 1 100. 0. 255. DISPLAY_IDENTIFIER ENVD_OBD[35] ECU_ADDRESS 0xd0009ceb FORMAT "%3.0" /end MEASUREMENT
/begin MEASUREMENT tbl_frf[1].envd_obd[36] "Freeze frame FRF_OBD: environmental data (fixed by law)" UBYTE _CNV_A_R_LINEAR_____0_CM 1 100. 0. 255. DISPLAY_IDENTIFIER ENVD_OBD[36] ECU_ADDRESS 0xd0009cec FORMAT "%3.0" /end MEASUREMENT
/begin MEASUREMENT tbl_frf[1].envd_obd[37] "Freeze frame FRF_OBD: environmental data (fixed by law)" UBYTE _CNV_A_R_LINEAR_____0_CM 1 100. 0. 255. DISPLAY_IDENTIFIER ENVD_OBD[37] ECU_ADDRESS 0xd0009ced FORMAT "%3.0" /end MEASUREMENT
/begin MEASUREMENT tbl_frf[1].envd_cus_cmn[0] "Freeze frame FRF_CUS_CMN: environmental data common to all failure (not fixed by law)" UBYTE _CNV_A_R_LINEAR_____0_CM 1 100. 0. 255. DISPLAY_IDENTIFIER ENVD_CUS_CMN_1_1 ECU_ADDRESS 0xd0009cee FORMAT "%3.0" /end MEASUREMENT
/begin MEASUREMENT tbl_frf[1].envd_cus_set_cmn[0][0] "Freeze frame FRF_CUS_SET_CMN: environmental data common to all failure (not fixed by law) stored in set" UBYTE _CNV_A_R_LINEAR_____0_CM 1 100. 0. 255. DISPLAY_IDENTIFIER ENVD_CUS_SET_CMN_1_1_1 ECU_ADDRESS 0xd0009cf0 FORMAT "%3.0" /end MEASUREMENT
/begin MEASUREMENT tbl_frf[1].envd_cus_set_cmn[0][1] "Freeze frame FRF_CUS_SET_CMN: environmental data common to all failure (not fixed by law) stored in set" UBYTE _CNV_A_R_LINEAR_____0_CM 1 100. 0. 255. DISPLAY_IDENTIFIER ENVD_CUS_SET_CMN_2_1_1 ECU_ADDRESS 0xd0009cf1 FORMAT "%3.0" /end MEASUREMENT
/begin MEASUREMENT tbl_frf[1].envd_cus_set_cmn[0][2] "Freeze frame FRF_CUS_SET_CMN: environmental data common to all failure (not fixed by law) stored in set" UBYTE _CNV_A_R_LINEAR_____0_CM 1 100. 0. 255. DISPLAY_IDENTIFIER ENVD_CUS_SET_CMN_3_1_1 ECU_ADDRESS 0xd0009cf2 FORMAT "%3.0" /end MEASUREMENT
/begin MEASUREMENT tbl_frf[1].envd_cus_set_cmn[0][3] "Freeze frame FRF_CUS_SET_CMN: environmental data common to all failure (not fixed by law) stored in set" UBYTE _CNV_A_R_LINEAR_____0_CM 1 100. 0. 255. DISPLAY_IDENTIFIER ENVD_CUS_SET_CMN_0_3_ ECU_ADDRESS 0xd0009cf3 FORMAT "%3.0" /end MEASUREMENT
/begin MEASUREMENT tbl_frf[1].envd_cus_set_cmn[0][4] "Freeze frame FRF_CUS_SET_CMN: environmental data common to all failure (not fixed by law) stored in set" UBYTE _CNV_A_R_LINEAR_____0_CM 1 100. 0. 255. DISPLAY_IDENTIFIER ENVD_CUS_SET_CMN_0_4_ ECU_ADDRESS 0xd0009cf4 FORMAT "%3.0" /end MEASUREMENT
/begin MEASUREMENT tbl_frf[1].envd_cus_set_cmn[0][5] "Freeze frame FRF_CUS_SET_CMN: environmental data common to all failure (not fixed by law) stored in set" UBYTE _CNV_A_R_LINEAR_____0_CM 1 100. 0. 255. DISPLAY_IDENTIFIER ENVD_CUS_SET_CMN_0_5_ ECU_ADDRESS 0xd0009cf5 FORMAT "%3.0" /end MEASUREMENT
/begin MEASUREMENT tbl_frf[1].envd_cus_set_cmn[0][6] "Freeze frame FRF_CUS_SET_CMN: environmental data common to all failure (not fixed by law) stored in set" UBYTE _CNV_A_R_LINEAR_____0_CM 1 100. 0. 255. DISPLAY_IDENTIFIER ENVD_CUS_SET_CMN_0_6_ ECU_ADDRESS 0xd0009cf6 FORMAT "%3.0" /end MEASUREMENT
/begin MEASUREMENT tbl_frf[1].envd_cus_set_cmn[0][7] "Freeze frame FRF_CUS_SET_CMN: environmental data common to all failure (not fixed by law) stored in set" UBYTE _CNV_A_R_LINEAR_____0_CM 1 100. 0. 255. DISPLAY_IDENTIFIER ENVD_CUS_SET_CMN_0_7_ ECU_ADDRESS 0xd0009cf7 FORMAT "%3.0" /end MEASUREMENT
/begin MEASUREMENT tbl_frf[1].envd_cus_set_cmn[0][8] "Freeze frame FRF_CUS_SET_CMN: environmental data common to all failure (not fixed by law) stored in set" UBYTE _CNV_A_R_LINEAR_____0_CM 1 100. 0. 255. DISPLAY_IDENTIFIER ENVD_CUS_SET_CMN_0_8_ ECU_ADDRESS 0xd0009cf8 FORMAT "%3.0" /end MEASUREMENT
/begin MEASUREMENT tbl_frf[1].envd_cus_set_cmn[0][9] "Freeze frame FRF_CUS_SET_CMN: environmental data common to all failure (not fixed by law) stored in set" UBYTE _CNV_A_R_LINEAR_____0_CM 1 100. 0. 255. DISPLAY_IDENTIFIER ENVD_CUS_SET_CMN_0_9_ ECU_ADDRESS 0xd0009cf9 FORMAT "%3.0" /end MEASUREMENT
/begin MEASUREMENT tbl_frf[1].envd_cus_set_cmn[1][0] "Freeze frame FRF_CUS_SET_CMN: environmental data common to all failure (not fixed by law) stored in set" UBYTE _CNV_A_R_LINEAR_____0_CM 1 100. 0. 255. DISPLAY_IDENTIFIER ENVD_CUS_SET_CMN_1_0_ ECU_ADDRESS 0xd0009cfa FORMAT "%3.0" /end MEASUREMENT
/begin MEASUREMENT tbl_frf[1].envd_cus_set_cmn[1][1] "Freeze frame FRF_CUS_SET_CMN: environmental data common to all failure (not fixed by law) stored in set" UBYTE _CNV_A_R_LINEAR_____0_CM 1 100. 0. 255. DISPLAY_IDENTIFIER ENVD_CUS_SET_CMN_1_1_ ECU_ADDRESS 0xd0009cfb FORMAT "%3.0" /end MEASUREMENT
/begin MEASUREMENT tbl_frf[1].envd_cus_set_cmn[1][2] "Freeze frame FRF_CUS_SET_CMN: environmental data common to all failure (not fixed by law) stored in set" UBYTE _CNV_A_R_LINEAR_____0_CM 1 100. 0. 255. DISPLAY_IDENTIFIER ENVD_CUS_SET_CMN_1_2_ ECU_ADDRESS 0xd0009cfc FORMAT "%3.0" /end MEASUREMENT
/begin MEASUREMENT tbl_frf[1].envd_cus_set_cmn[1][3] "Freeze frame FRF_CUS_SET_CMN: environmental data common to all failure (not fixed by law) stored in set" UBYTE _CNV_A_R_LINEAR_____0_CM 1 100. 0. 255. DISPLAY_IDENTIFIER ENVD_CUS_SET_CMN_1_3_ ECU_ADDRESS 0xd0009cfd FORMAT "%3.0" /end MEASUREMENT
/begin MEASUREMENT tbl_frf[1].envd_cus_set_cmn[1][4] "Freeze frame FRF_CUS_SET_CMN: environmental data common to all failure (not fixed by law) stored in set" UBYTE _CNV_A_R_LINEAR_____0_CM 1 100. 0. 255. DISPLAY_IDENTIFIER ENVD_CUS_SET_CMN_1_4_ ECU_ADDRESS 0xd0009cfe FORMAT "%3.0" /end MEASUREMENT
/begin MEASUREMENT tbl_frf[1].envd_cus_set_cmn[1][5] "Freeze frame FRF_CUS_SET_CMN: environmental data common to all failure (not fixed by law) stored in set" UBYTE _CNV_A_R_LINEAR_____0_CM 1 100. 0. 255. DISPLAY_IDENTIFIER ENVD_CUS_SET_CMN_1_5_ ECU_ADDRESS 0xd0009cff FORMAT "%3.0" /end MEASUREMENT
/begin MEASUREMENT tbl_frf[1].envd_cus_set_cmn[1][6] "Freeze frame FRF_CUS_SET_CMN: environmental data common to all failure (not fixed by law) stored in set" UBYTE _CNV_A_R_LINEAR_____0_CM 1 100. 0. 255. DISPLAY_IDENTIFIER ENVD_CUS_SET_CMN_1_6_ ECU_ADDRESS 0xd0009d00 FORMAT "%3.0" /end MEASUREMENT
/begin MEASUREMENT tbl_frf[1].envd_cus_set_cmn[1][7] "Freeze frame FRF_CUS_SET_CMN: environmental data common to all failure (not fixed by law) stored in set" UBYTE _CNV_A_R_LINEAR_____0_CM 1 100. 0. 255. DISPLAY_IDENTIFIER ENVD_CUS_SET_CMN_1_7_ ECU_ADDRESS 0xd0009d01 FORMAT "%3.0" /end MEASUREMENT
/begin MEASUREMENT tbl_frf[1].envd_cus_set_cmn[1][8] "Freeze frame FRF_CUS_SET_CMN: environmental data common to all failure (not fixed by law) stored in set" UBYTE _CNV_A_R_LINEAR_____0_CM 1 100. 0. 255. DISPLAY_IDENTIFIER ENVD_CUS_SET_CMN_1_8_ ECU_ADDRESS 0xd0009d02 FORMAT "%3.0" /end MEASUREMENT
/begin MEASUREMENT tbl_frf[1].envd_cus_set_cmn[1][9] "Freeze frame FRF_CUS_SET_CMN: environmental data common to all failure (not fixed by law) stored in set" UBYTE _CNV_A_R_LINEAR_____0_CM 1 100. 0. 255. DISPLAY_IDENTIFIER ENVD_CUS_SET_CMN_1_9_ ECU_ADDRESS 0xd0009d03 FORMAT "%3.0" /end MEASUREMENT
/begin MEASUREMENT tbl_frf[1].envd_cus_set_cmn[2][0] "Freeze frame FRF_CUS_SET_CMN: environmental data common to all failure (not fixed by law) stored in set" UBYTE _CNV_A_R_LINEAR_____0_CM 1 100. 0. 255. DISPLAY_IDENTIFIER ENVD_CUS_SET_CMN_2_0_ ECU_ADDRESS 0xd0009d04 FORMAT "%3.0" /end MEASUREMENT
/begin MEASUREMENT tbl_frf[1].envd_cus_set_cmn[2][1] "Freeze frame FRF_CUS_SET_CMN: environmental data common to all failure (not fixed by law) stored in set" UBYTE _CNV_A_R_LINEAR_____0_CM 1 100. 0. 255. DISPLAY_IDENTIFIER ENVD_CUS_SET_CMN_2_1_ ECU_ADDRESS 0xd0009d05 FORMAT "%3.0" /end MEASUREMENT
/begin MEASUREMENT tbl_frf[1].envd_cus_set_cmn[2][2] "Freeze frame FRF_CUS_SET_CMN: environmental data common to all failure (not fixed by law) stored in set" UBYTE _CNV_A_R_LINEAR_____0_CM 1 100. 0. 255. DISPLAY_IDENTIFIER ENVD_CUS_SET_CMN_2_2_ ECU_ADDRESS 0xd0009d06 FORMAT "%3.0" /end MEASUREMENT
/begin MEASUREMENT tbl_frf[1].envd_cus_set_cmn[2][3] "Freeze frame FRF_CUS_SET_CMN: environmental data common to all failure (not fixed by law) stored in set" UBYTE _CNV_A_R_LINEAR_____0_CM 1 100. 0. 255. DISPLAY_IDENTIFIER ENVD_CUS_SET_CMN_2_3_ ECU_ADDRESS 0xd0009d07 FORMAT "%3.0" /end MEASUREMENT
/begin MEASUREMENT tbl_frf[1].envd_cus_set_cmn[2][4] "Freeze frame FRF_CUS_SET_CMN: environmental data common to all failure (not fixed by law) stored in set" UBYTE _CNV_A_R_LINEAR_____0_CM 1 100. 0. 255. DISPLAY_IDENTIFIER ENVD_CUS_SET_CMN_2_4_ ECU_ADDRESS 0xd0009d08 FORMAT "%3.0" /end MEASUREMENT
/begin MEASUREMENT tbl_frf[1].envd_cus_set_cmn[2][5] "Freeze frame FRF_CUS_SET_CMN: environmental data common to all failure (not fixed by law) stored in set" UBYTE _CNV_A_R_LINEAR_____0_CM 1 100. 0. 255. DISPLAY_IDENTIFIER ENVD_CUS_SET_CMN_2_5_ ECU_ADDRESS 0xd0009d09 FORMAT "%3.0" /end MEASUREMENT
/begin MEASUREMENT tbl_frf[1].envd_cus_set_cmn[2][6] "Freeze frame FRF_CUS_SET_CMN: environmental data common to all failure (not fixed by law) stored in set" UBYTE _CNV_A_R_LINEAR_____0_CM 1 100. 0. 255. DISPLAY_IDENTIFIER ENVD_CUS_SET_CMN_2_6_ ECU_ADDRESS 0xd0009d0a FORMAT "%3.0" /end MEASUREMENT
/begin MEASUREMENT tbl_frf[1].envd_cus_set_cmn[2][7] "Freeze frame FRF_CUS_SET_CMN: environmental data common to all failure (not fixed by law) stored in set" UBYTE _CNV_A_R_LINEAR_____0_CM 1 100. 0. 255. DISPLAY_IDENTIFIER ENVD_CUS_SET_CMN_2_7_ ECU_ADDRESS 0xd0009d0b FORMAT "%3.0" /end MEASUREMENT
/begin MEASUREMENT tbl_frf[1].envd_cus_set_cmn[2][8] "Freeze frame FRF_CUS_SET_CMN: environmental data common to all failure (not fixed by law) stored in set" UBYTE _CNV_A_R_LINEAR_____0_CM 1 100. 0. 255. DISPLAY_IDENTIFIER ENVD_CUS_SET_CMN_2_8_ ECU_ADDRESS 0xd0009d0c FORMAT "%3.0" /end MEASUREMENT
/begin MEASUREMENT tbl_frf[1].envd_cus_set_cmn[2][9] "Freeze frame FRF_CUS_SET_CMN: environmental data common to all failure (not fixed by law) stored in set" UBYTE _CNV_A_R_LINEAR_____0_CM 1 100. 0. 255. DISPLAY_IDENTIFIER ENVD_CUS_SET_CMN_2_9_ ECU_ADDRESS 0xd0009d0d FORMAT "%3.0" /end MEASUREMENT
/begin MEASUREMENT tbl_frf[1].envd_cus_set_spc[0][0] "Freeze frame FRF_CUS_SET_SPC: environmental data specific to each failure (not fixed by law) stored in set" UBYTE _CNV_A_R_LINEAR_____0_CM 1 100. 0. 255. DISPLAY_IDENTIFIER ENVD_CUS_SET_SPC_1_1_1 ECU_ADDRESS 0xd0009d10 FORMAT "%3.0" /end MEASUREMENT
/begin MEASUREMENT tbl_frf[1].envd_cus_set_spc[0][1] "Freeze frame FRF_CUS_SET_SPC: environmental data specific to each failure (not fixed by law) stored in set" UBYTE _CNV_A_R_LINEAR_____0_CM 1 100. 0. 255. DISPLAY_IDENTIFIER ENVD_CUS_SET_SPC_2_1_1 ECU_ADDRESS 0xd0009d11 FORMAT "%3.0" /end MEASUREMENT
/begin MEASUREMENT tbl_frf[1].envd_cus_set_spc[0][2] "Freeze frame FRF_CUS_SET_SPC: environmental data specific to each failure (not fixed by law) stored in set" UBYTE _CNV_A_R_LINEAR_____0_CM 1 100. 0. 255. DISPLAY_IDENTIFIER ENVD_CUS_SET_SPC_3_1_1 ECU_ADDRESS 0xd0009d12 FORMAT "%3.0" /end MEASUREMENT
/begin MEASUREMENT tbl_frf[1].envd_cus_set_spc[0][3] "Freeze frame FRF_CUS_SET_SPC: environmental data specific to each failure (not fixed by law) stored in set" UBYTE _CNV_A_R_LINEAR_____0_CM 1 100. 0. 255. DISPLAY_IDENTIFIER ENVD_CUS_SET_SPC_4_1_1 ECU_ADDRESS 0xd0009d13 FORMAT "%3.0" /end MEASUREMENT
/begin MEASUREMENT tbl_frf[1].envd_cus_set_spc[1][0] "Freeze frame FRF_CUS_SET_SPC: environmental data specific to each failure (not fixed by law) stored in set" UBYTE _CNV_A_R_LINEAR_____0_CM 1 100. 0. 255. DISPLAY_IDENTIFIER ENVD_CUS_SET_SPC_1_0_ ECU_ADDRESS 0xd0009d14 FORMAT "%3.0" /end MEASUREMENT
/begin MEASUREMENT tbl_frf[1].envd_cus_set_spc[1][1] "Freeze frame FRF_CUS_SET_SPC: environmental data specific to each failure (not fixed by law) stored in set" UBYTE _CNV_A_R_LINEAR_____0_CM 1 100. 0. 255. DISPLAY_IDENTIFIER ENVD_CUS_SET_SPC_1_1_ ECU_ADDRESS 0xd0009d15 FORMAT "%3.0" /end MEASUREMENT
/begin MEASUREMENT tbl_frf[1].envd_cus_set_spc[1][2] "Freeze frame FRF_CUS_SET_SPC: environmental data specific to each failure (not fixed by law) stored in set" UBYTE _CNV_A_R_LINEAR_____0_CM 1 100. 0. 255. DISPLAY_IDENTIFIER ENVD_CUS_SET_SPC_1_2_ ECU_ADDRESS 0xd0009d16 FORMAT "%3.0" /end MEASUREMENT
/begin MEASUREMENT tbl_frf[1].envd_cus_set_spc[1][3] "Freeze frame FRF_CUS_SET_SPC: environmental data specific to each failure (not fixed by law) stored in set" UBYTE _CNV_A_R_LINEAR_____0_CM 1 100. 0. 255. DISPLAY_IDENTIFIER ENVD_CUS_SET_SPC_1_3_ ECU_ADDRESS 0xd0009d17 FORMAT "%3.0" /end MEASUREMENT
/begin MEASUREMENT tbl_frf[1].envd_cus_set_spc[2][0] "Freeze frame FRF_CUS_SET_SPC: environmental data specific to each failure (not fixed by law) stored in set" UBYTE _CNV_A_R_LINEAR_____0_CM 1 100. 0. 255. DISPLAY_IDENTIFIER ENVD_CUS_SET_SPC_2_0_ ECU_ADDRESS 0xd0009d18 FORMAT "%3.0" /end MEASUREMENT
/begin MEASUREMENT tbl_frf[1].envd_cus_set_spc[2][1] "Freeze frame FRF_CUS_SET_SPC: environmental data specific to each failure (not fixed by law) stored in set" UBYTE _CNV_A_R_LINEAR_____0_CM 1 100. 0. 255. DISPLAY_IDENTIFIER ENVD_CUS_SET_SPC_2_1_ ECU_ADDRESS 0xd0009d19 FORMAT "%3.0" /end MEASUREMENT
/begin MEASUREMENT tbl_frf[1].envd_cus_set_spc[2][2] "Freeze frame FRF_CUS_SET_SPC: environmental data specific to each failure (not fixed by law) stored in set" UBYTE _CNV_A_R_LINEAR_____0_CM 1 100. 0. 255. DISPLAY_IDENTIFIER ENVD_CUS_SET_SPC_2_2_ ECU_ADDRESS 0xd0009d1a FORMAT "%3.0" /end MEASUREMENT
/begin MEASUREMENT tbl_frf[1].envd_cus_set_spc[2][3] "Freeze frame FRF_CUS_SET_SPC: environmental data specific to each failure (not fixed by law) stored in set" UBYTE _CNV_A_R_LINEAR_____0_CM 1 100. 0. 255. DISPLAY_IDENTIFIER ENVD_CUS_SET_SPC_2_3_ ECU_ADDRESS 0xd0009d1b FORMAT "%3.0" /end MEASUREMENT
/begin MEASUREMENT tbl_frf[2].envd_obd[0] "Freeze frame FRF_OBD: environmental data (fixed by law)" UBYTE _CNV_A_R_LINEAR_____0_CM 1 100. 0. 255. DISPLAY_IDENTIFIER ENVD_OBD_1_2 ECU_ADDRESS 0xd0009d20 FORMAT "%3.0" /end MEASUREMENT
/begin MEASUREMENT tbl_frf[2].envd_obd[1] "Freeze frame FRF_OBD: environmental data (fixed by law)" UBYTE _CNV_A_R_LINEAR_____0_CM 1 100. 0. 255. DISPLAY_IDENTIFIER ENVD_OBD_2_2 ECU_ADDRESS 0xd0009d21 FORMAT "%3.0" /end MEASUREMENT
/begin MEASUREMENT tbl_frf[2].envd_obd[2] "Freeze frame FRF_OBD: environmental data (fixed by law)" UBYTE _CNV_A_R_LINEAR_____0_CM 1 100. 0. 255. DISPLAY_IDENTIFIER ENVD_OBD_3_2 ECU_ADDRESS 0xd0009d22 FORMAT "%3.0" /end MEASUREMENT
/begin MEASUREMENT tbl_frf[2].envd_obd[3] "Freeze frame FRF_OBD: environmental data (fixed by law)" UBYTE _CNV_A_R_LINEAR_____0_CM 1 100. 0. 255. DISPLAY_IDENTIFIER ENVD_OBD_4_2 ECU_ADDRESS 0xd0009d23 FORMAT "%3.0" /end MEASUREMENT
/begin MEASUREMENT tbl_frf[2].envd_obd[4] "Freeze frame FRF_OBD: environmental data (fixed by law)" UBYTE _CNV_A_R_LINEAR_____0_CM 1 100. 0. 255. DISPLAY_IDENTIFIER ENVD_OBD_5_2 ECU_ADDRESS 0xd0009d24 FORMAT "%3.0" /end MEASUREMENT
/begin MEASUREMENT tbl_frf[2].envd_obd[5] "Freeze frame FRF_OBD: environmental data (fixed by law)" UBYTE _CNV_A_R_LINEAR_____0_CM 1 100. 0. 255. DISPLAY_IDENTIFIER ENVD_OBD_6_2 ECU_ADDRESS 0xd0009d25 FORMAT "%3.0" /end MEASUREMENT
/begin MEASUREMENT tbl_frf[2].envd_obd[6] "Freeze frame FRF_OBD: environmental data (fixed by law)" UBYTE _CNV_A_R_LINEAR_____0_CM 1 100. 0. 255. DISPLAY_IDENTIFIER ENVD_OBD_7_2 ECU_ADDRESS 0xd0009d26 FORMAT "%3.0" /end MEASUREMENT
/begin MEASUREMENT tbl_frf[2].envd_obd[7] "Freeze frame FRF_OBD: environmental data (fixed by law)" UBYTE _CNV_A_R_LINEAR_____0_CM 1 100. 0. 255. DISPLAY_IDENTIFIER ENVD_OBD_8_2 ECU_ADDRESS 0xd0009d27 FORMAT "%3.0" /end MEASUREMENT
/begin MEASUREMENT tbl_frf[2].envd_obd[8] "Freeze frame FRF_OBD: environmental data (fixed by law)" UBYTE _CNV_A_R_LINEAR_____0_CM 1 100. 0. 255. DISPLAY_IDENTIFIER ENVD_OBD_9_2 ECU_ADDRESS 0xd0009d28 FORMAT "%3.0" /end MEASUREMENT
/begin MEASUREMENT tbl_frf[2].envd_obd[9] "Freeze frame FRF_OBD: environmental data (fixed by law)" UBYTE _CNV_A_R_LINEAR_____0_CM 1 100. 0. 255. DISPLAY_IDENTIFIER ENVD_OBD_10_2 ECU_ADDRESS 0xd0009d29 FORMAT "%3.0" /end MEASUREMENT
/begin MEASUREMENT tbl_frf[2].envd_obd[10] "Freeze frame FRF_OBD: environmental data (fixed by law)" UBYTE _CNV_A_R_LINEAR_____0_CM 1 100. 0. 255. DISPLAY_IDENTIFIER ENVD_OBD_11_2 ECU_ADDRESS 0xd0009d2a FORMAT "%3.0" /end MEASUREMENT
/begin MEASUREMENT tbl_frf[2].envd_obd[11] "Freeze frame FRF_OBD: environmental data (fixed by law)" UBYTE _CNV_A_R_LINEAR_____0_CM 1 100. 0. 255. DISPLAY_IDENTIFIER ENVD_OBD_12_2 ECU_ADDRESS 0xd0009d2b FORMAT "%3.0" /end MEASUREMENT
/begin MEASUREMENT tbl_frf[2].envd_obd[12] "Freeze frame FRF_OBD: environmental data (fixed by law)" UBYTE _CNV_A_R_LINEAR_____0_CM 1 100. 0. 255. DISPLAY_IDENTIFIER ENVD_OBD_13_2 ECU_ADDRESS 0xd0009d2c FORMAT "%3.0" /end MEASUREMENT
/begin MEASUREMENT tbl_frf[2].envd_obd[13] "Freeze frame FRF_OBD: environmental data (fixed by law)" UBYTE _CNV_A_R_LINEAR_____0_CM 1 100. 0. 255. DISPLAY_IDENTIFIER ENVD_OBD_14_2 ECU_ADDRESS 0xd0009d2d FORMAT "%3.0" /end MEASUREMENT
/begin MEASUREMENT tbl_frf[2].envd_obd[14] "Freeze frame FRF_OBD: environmental data (fixed by law)" UBYTE _CNV_A_R_LINEAR_____0_CM 1 100. 0. 255. DISPLAY_IDENTIFIER ENVD_OBD_15_2 ECU_ADDRESS 0xd0009d2e FORMAT "%3.0" /end MEASUREMENT
/begin MEASUREMENT tbl_frf[2].envd_obd[15] "Freeze frame FRF_OBD: environmental data (fixed by law)" UBYTE _CNV_A_R_LINEAR_____0_CM 1 100. 0. 255. DISPLAY_IDENTIFIER ENVD_OBD_16_2 ECU_ADDRESS 0xd0009d2f FORMAT "%3.0" /end MEASUREMENT
/begin MEASUREMENT tbl_frf[2].envd_obd[16] "Freeze frame FRF_OBD: environmental data (fixed by law)" UBYTE _CNV_A_R_LINEAR_____0_CM 1 100. 0. 255. DISPLAY_IDENTIFIER ENVD_OBD_17_2 ECU_ADDRESS 0xd0009d30 FORMAT "%3.0" /end MEASUREMENT
/begin MEASUREMENT tbl_frf[2].envd_obd[17] "Freeze frame FRF_OBD: environmental data (fixed by law)" UBYTE _CNV_A_R_LINEAR_____0_CM 1 100. 0. 255. DISPLAY_IDENTIFIER ENVD_OBD_18_2 ECU_ADDRESS 0xd0009d31 FORMAT "%3.0" /end MEASUREMENT
/begin MEASUREMENT tbl_frf[2].envd_obd[18] "Freeze frame FRF_OBD: environmental data (fixed by law)" UBYTE _CNV_A_R_LINEAR_____0_CM 1 100. 0. 255. DISPLAY_IDENTIFIER ENVD_OBD_19_2 ECU_ADDRESS 0xd0009d32 FORMAT "%3.0" /end MEASUREMENT
/begin MEASUREMENT tbl_frf[2].envd_obd[19] "Freeze frame FRF_OBD: environmental data (fixed by law)" UBYTE _CNV_A_R_LINEAR_____0_CM 1 100. 0. 255. DISPLAY_IDENTIFIER ENVD_OBD_20_2 ECU_ADDRESS 0xd0009d33 FORMAT "%3.0" /end MEASUREMENT
/begin MEASUREMENT tbl_frf[2].envd_obd[20] "Freeze frame FRF_OBD: environmental data (fixed by law)" UBYTE _CNV_A_R_LINEAR_____0_CM 1 100. 0. 255. DISPLAY_IDENTIFIER ENVD_OBD_21_2 ECU_ADDRESS 0xd0009d34 FORMAT "%3.0" /end MEASUREMENT
/begin MEASUREMENT tbl_frf[2].envd_obd[21] "Freeze frame FRF_OBD: environmental data (fixed by law)" UBYTE _CNV_A_R_LINEAR_____0_CM 1 100. 0. 255. DISPLAY_IDENTIFIER ENVD_OBD_22_2 ECU_ADDRESS 0xd0009d35 FORMAT "%3.0" /end MEASUREMENT
/begin MEASUREMENT tbl_frf[2].envd_obd[22] "Freeze frame FRF_OBD: environmental data (fixed by law)" UBYTE _CNV_A_R_LINEAR_____0_CM 1 100. 0. 255. DISPLAY_IDENTIFIER ENVD_OBD_23_2 ECU_ADDRESS 0xd0009d36 FORMAT "%3.0" /end MEASUREMENT
/begin MEASUREMENT tbl_frf[2].envd_obd[23] "Freeze frame FRF_OBD: environmental data (fixed by law)" UBYTE _CNV_A_R_LINEAR_____0_CM 1 100. 0. 255. DISPLAY_IDENTIFIER ENVD_OBD_24_2 ECU_ADDRESS 0xd0009d37 FORMAT "%3.0" /end MEASUREMENT
/begin MEASUREMENT tbl_frf[2].envd_obd[24] "Freeze frame FRF_OBD: environmental data (fixed by law)" UBYTE _CNV_A_R_LINEAR_____0_CM 1 100. 0. 255. DISPLAY_IDENTIFIER ENVD_OBD_25_2 ECU_ADDRESS 0xd0009d38 FORMAT "%3.0" /end MEASUREMENT
/begin MEASUREMENT tbl_frf[2].envd_obd[25] "Freeze frame FRF_OBD: environmental data (fixed by law)" UBYTE _CNV_A_R_LINEAR_____0_CM 1 100. 0. 255. DISPLAY_IDENTIFIER ENVD_OBD_26_2 ECU_ADDRESS 0xd0009d39 FORMAT "%3.0" /end MEASUREMENT
/begin MEASUREMENT tbl_frf[2].envd_obd[26] "Freeze frame FRF_OBD: environmental data (fixed by law)" UBYTE _CNV_A_R_LINEAR_____0_CM 1 100. 0. 255. DISPLAY_IDENTIFIER ENVD_OBD_27_2 ECU_ADDRESS 0xd0009d3a FORMAT "%3.0" /end MEASUREMENT
/begin MEASUREMENT tbl_frf[2].envd_obd[27] "Freeze frame FRF_OBD: environmental data (fixed by law)" UBYTE _CNV_A_R_LINEAR_____0_CM 1 100. 0. 255. DISPLAY_IDENTIFIER ENVD_OBD_28_2 ECU_ADDRESS 0xd0009d3b FORMAT "%3.0" /end MEASUREMENT
/begin MEASUREMENT tbl_frf[2].envd_obd[28] "Freeze frame FRF_OBD: environmental data (fixed by law)" UBYTE _CNV_A_R_LINEAR_____0_CM 1 100. 0. 255. DISPLAY_IDENTIFIER ENVD_OBD_29_2 ECU_ADDRESS 0xd0009d3c FORMAT "%3.0" /end MEASUREMENT
/begin MEASUREMENT tbl_frf[2].envd_obd[29] "Freeze frame FRF_OBD: environmental data (fixed by law)" UBYTE _CNV_A_R_LINEAR_____0_CM 1 100. 0. 255. DISPLAY_IDENTIFIER ENVD_OBD_30_2 ECU_ADDRESS 0xd0009d3d FORMAT "%3.0" /end MEASUREMENT
/begin MEASUREMENT tbl_frf[2].envd_obd[30] "Freeze frame FRF_OBD: environmental data (fixed by law)" UBYTE _CNV_A_R_LINEAR_____0_CM 1 100. 0. 255. DISPLAY_IDENTIFIER ENVD_OBD_31_2 ECU_ADDRESS 0xd0009d3e FORMAT "%3.0" /end MEASUREMENT
/begin MEASUREMENT tbl_frf[2].envd_obd[31] "Freeze frame FRF_OBD: environmental data (fixed by law)" UBYTE _CNV_A_R_LINEAR_____0_CM 1 100. 0. 255. DISPLAY_IDENTIFIER ENVD_OBD_32_2 ECU_ADDRESS 0xd0009d3f FORMAT "%3.0" /end MEASUREMENT
/begin MEASUREMENT tbl_frf[2].envd_obd[32] "Freeze frame FRF_OBD: environmental data (fixed by law)" UBYTE _CNV_A_R_LINEAR_____0_CM 1 100. 0. 255. DISPLAY_IDENTIFIER ENVD_OBD_33_2 ECU_ADDRESS 0xd0009d40 FORMAT "%3.0" /end MEASUREMENT
/begin MEASUREMENT tbl_frf[2].envd_obd[33] "Freeze frame FRF_OBD: environmental data (fixed by law)" UBYTE _CNV_A_R_LINEAR_____0_CM 1 100. 0. 255. DISPLAY_IDENTIFIER ENVD_OBD_34_2 ECU_ADDRESS 0xd0009d41 FORMAT "%3.0" /end MEASUREMENT
/begin MEASUREMENT tbl_frf[2].envd_obd[34] "Freeze frame FRF_OBD: environmental data (fixed by law)" UBYTE _CNV_A_R_LINEAR_____0_CM 1 100. 0. 255. DISPLAY_IDENTIFIER ENVD_OBD[34] ECU_ADDRESS 0xd0009d42 FORMAT "%3.0" /end MEASUREMENT
/begin MEASUREMENT tbl_frf[2].envd_obd[35] "Freeze frame FRF_OBD: environmental data (fixed by law)" UBYTE _CNV_A_R_LINEAR_____0_CM 1 100. 0. 255. DISPLAY_IDENTIFIER ENVD_OBD[35] ECU_ADDRESS 0xd0009d43 FORMAT "%3.0" /end MEASUREMENT
/begin MEASUREMENT tbl_frf[2].envd_obd[36] "Freeze frame FRF_OBD: environmental data (fixed by law)" UBYTE _CNV_A_R_LINEAR_____0_CM 1 100. 0. 255. DISPLAY_IDENTIFIER ENVD_OBD[36] ECU_ADDRESS 0xd0009d44 FORMAT "%3.0" /end MEASUREMENT
/begin MEASUREMENT tbl_frf[2].envd_obd[37] "Freeze frame FRF_OBD: environmental data (fixed by law)" UBYTE _CNV_A_R_LINEAR_____0_CM 1 100. 0. 255. DISPLAY_IDENTIFIER ENVD_OBD[37] ECU_ADDRESS 0xd0009d45 FORMAT "%3.0" /end MEASUREMENT
/begin MEASUREMENT tbl_frf[2].envd_cus_cmn[0] "Freeze frame FRF_CUS_CMN: environmental data common to all failure (not fixed by law)" UBYTE _CNV_A_R_LINEAR_____0_CM 1 100. 0. 255. DISPLAY_IDENTIFIER ENVD_CUS_CMN_1_2 ECU_ADDRESS 0xd0009d46 FORMAT "%3.0" /end MEASUREMENT
/begin MEASUREMENT tbl_frf[2].envd_cus_set_cmn[0][0] "Freeze frame FRF_CUS_SET_CMN: environmental data common to all failure (not fixed by law) stored in set" UBYTE _CNV_A_R_LINEAR_____0_CM 1 100. 0. 255. DISPLAY_IDENTIFIER ENVD_CUS_SET_CMN_1_1_2 ECU_ADDRESS 0xd0009d48 FORMAT "%3.0" /end MEASUREMENT
/begin MEASUREMENT tbl_frf[2].envd_cus_set_cmn[0][1] "Freeze frame FRF_CUS_SET_CMN: environmental data common to all failure (not fixed by law) stored in set" UBYTE _CNV_A_R_LINEAR_____0_CM 1 100. 0. 255. DISPLAY_IDENTIFIER ENVD_CUS_SET_CMN_2_1_2 ECU_ADDRESS 0xd0009d49 FORMAT "%3.0" /end MEASUREMENT
/begin MEASUREMENT tbl_frf[2].envd_cus_set_cmn[0][2] "Freeze frame FRF_CUS_SET_CMN: environmental data common to all failure (not fixed by law) stored in set" UBYTE _CNV_A_R_LINEAR_____0_CM 1 100. 0. 255. DISPLAY_IDENTIFIER ENVD_CUS_SET_CMN_3_1_2 ECU_ADDRESS 0xd0009d4a FORMAT "%3.0" /end MEASUREMENT
/begin MEASUREMENT tbl_frf[2].envd_cus_set_cmn[0][3] "Freeze frame FRF_CUS_SET_CMN: environmental data common to all failure (not fixed by law) stored in set" UBYTE _CNV_A_R_LINEAR_____0_CM 1 100. 0. 255. DISPLAY_IDENTIFIER ENVD_CUS_SET_CMN_0_3_ ECU_ADDRESS 0xd0009d4b FORMAT "%3.0" /end MEASUREMENT
/begin MEASUREMENT tbl_frf[2].envd_cus_set_cmn[0][4] "Freeze frame FRF_CUS_SET_CMN: environmental data common to all failure (not fixed by law) stored in set" UBYTE _CNV_A_R_LINEAR_____0_CM 1 100. 0. 255. DISPLAY_IDENTIFIER ENVD_CUS_SET_CMN_0_4_ ECU_ADDRESS 0xd0009d4c FORMAT "%3.0" /end MEASUREMENT
/begin MEASUREMENT tbl_frf[2].envd_cus_set_cmn[0][5] "Freeze frame FRF_CUS_SET_CMN: environmental data common to all failure (not fixed by law) stored in set" UBYTE _CNV_A_R_LINEAR_____0_CM 1 100. 0. 255. DISPLAY_IDENTIFIER ENVD_CUS_SET_CMN_0_5_ ECU_ADDRESS 0xd0009d4d FORMAT "%3.0" /end MEASUREMENT
/begin MEASUREMENT tbl_frf[2].envd_cus_set_cmn[0][6] "Freeze frame FRF_CUS_SET_CMN: environmental data common to all failure (not fixed by law) stored in set" UBYTE _CNV_A_R_LINEAR_____0_CM 1 100. 0. 255. DISPLAY_IDENTIFIER ENVD_CUS_SET_CMN_0_6_ ECU_ADDRESS 0xd0009d4e FORMAT "%3.0" /end MEASUREMENT
/begin MEASUREMENT tbl_frf[2].envd_cus_set_cmn[0][7] "Freeze frame FRF_CUS_SET_CMN: environmental data common to all failure (not fixed by law) stored in set" UBYTE _CNV_A_R_LINEAR_____0_CM 1 100. 0. 255. DISPLAY_IDENTIFIER ENVD_CUS_SET_CMN_0_7_ ECU_ADDRESS 0xd0009d4f FORMAT "%3.0" /end MEASUREMENT
/begin MEASUREMENT tbl_frf[2].envd_cus_set_cmn[0][8] "Freeze frame FRF_CUS_SET_CMN: environmental data common to all failure (not fixed by law) stored in set" UBYTE _CNV_A_R_LINEAR_____0_CM 1 100. 0. 255. DISPLAY_IDENTIFIER ENVD_CUS_SET_CMN_0_8_ ECU_ADDRESS 0xd0009d50 FORMAT "%3.0" /end MEASUREMENT
/begin MEASUREMENT tbl_frf[2].envd_cus_set_cmn[0][9] "Freeze frame FRF_CUS_SET_CMN: environmental data common to all failure (not fixed by law) stored in set" UBYTE _CNV_A_R_LINEAR_____0_CM 1 100. 0. 255. DISPLAY_IDENTIFIER ENVD_CUS_SET_CMN_0_9_ ECU_ADDRESS 0xd0009d51 FORMAT "%3.0" /end MEASUREMENT
/begin MEASUREMENT tbl_frf[2].envd_cus_set_cmn[1][0] "Freeze frame FRF_CUS_SET_CMN: environmental data common to all failure (not fixed by law) stored in set" UBYTE _CNV_A_R_LINEAR_____0_CM 1 100. 0. 255. DISPLAY_IDENTIFIER ENVD_CUS_SET_CMN_1_2_2 ECU_ADDRESS 0xd0009d52 FORMAT "%3.0" /end MEASUREMENT
/begin MEASUREMENT tbl_frf[2].envd_cus_set_cmn[1][1] "Freeze frame FRF_CUS_SET_CMN: environmental data common to all failure (not fixed by law) stored in set" UBYTE _CNV_A_R_LINEAR_____0_CM 1 100. 0. 255. DISPLAY_IDENTIFIER ENVD_CUS_SET_CMN_2_2_2 ECU_ADDRESS 0xd0009d53 FORMAT "%3.0" /end MEASUREMENT
/begin MEASUREMENT tbl_frf[2].envd_cus_set_cmn[1][2] "Freeze frame FRF_CUS_SET_CMN: environmental data common to all failure (not fixed by law) stored in set" UBYTE _CNV_A_R_LINEAR_____0_CM 1 100. 0. 255. DISPLAY_IDENTIFIER ENVD_CUS_SET_CMN_3_2_2 ECU_ADDRESS 0xd0009d54 FORMAT "%3.0" /end MEASUREMENT
/begin MEASUREMENT tbl_frf[2].envd_cus_set_cmn[1][3] "Freeze frame FRF_CUS_SET_CMN: environmental data common to all failure (not fixed by law) stored in set" UBYTE _CNV_A_R_LINEAR_____0_CM 1 100. 0. 255. DISPLAY_IDENTIFIER ENVD_CUS_SET_CMN_1_3_ ECU_ADDRESS 0xd0009d55 FORMAT "%3.0" /end MEASUREMENT
/begin MEASUREMENT tbl_frf[2].envd_cus_set_cmn[1][4] "Freeze frame FRF_CUS_SET_CMN: environmental data common to all failure (not fixed by law) stored in set" UBYTE _CNV_A_R_LINEAR_____0_CM 1 100. 0. 255. DISPLAY_IDENTIFIER ENVD_CUS_SET_CMN_1_4_ ECU_ADDRESS 0xd0009d56 FORMAT "%3.0" /end MEASUREMENT
/begin MEASUREMENT tbl_frf[2].envd_cus_set_cmn[1][5] "Freeze frame FRF_CUS_SET_CMN: environmental data common to all failure (not fixed by law) stored in set" UBYTE _CNV_A_R_LINEAR_____0_CM 1 100. 0. 255. DISPLAY_IDENTIFIER ENVD_CUS_SET_CMN_1_5_ ECU_ADDRESS 0xd0009d57 FORMAT "%3.0" /end MEASUREMENT
/begin MEASUREMENT tbl_frf[2].envd_cus_set_cmn[1][6] "Freeze frame FRF_CUS_SET_CMN: environmental data common to all failure (not fixed by law) stored in set" UBYTE _CNV_A_R_LINEAR_____0_CM 1 100. 0. 255. DISPLAY_IDENTIFIER ENVD_CUS_SET_CMN_1_6_ ECU_ADDRESS 0xd0009d58 FORMAT "%3.0" /end MEASUREMENT
/begin MEASUREMENT tbl_frf[2].envd_cus_set_cmn[1][7] "Freeze frame FRF_CUS_SET_CMN: environmental data common to all failure (not fixed by law) stored in set" UBYTE _CNV_A_R_LINEAR_____0_CM 1 100. 0. 255. DISPLAY_IDENTIFIER ENVD_CUS_SET_CMN_1_7_ ECU_ADDRESS 0xd0009d59 FORMAT "%3.0" /end MEASUREMENT
/begin MEASUREMENT tbl_frf[2].envd_cus_set_cmn[1][8] "Freeze frame FRF_CUS_SET_CMN: environmental data common to all failure (not fixed by law) stored in set" UBYTE _CNV_A_R_LINEAR_____0_CM 1 100. 0. 255. DISPLAY_IDENTIFIER ENVD_CUS_SET_CMN_1_8_ ECU_ADDRESS 0xd0009d5a FORMAT "%3.0" /end MEASUREMENT
/begin MEASUREMENT tbl_frf[2].envd_cus_set_cmn[1][9] "Freeze frame FRF_CUS_SET_CMN: environmental data common to all failure (not fixed by law) stored in set" UBYTE _CNV_A_R_LINEAR_____0_CM 1 100. 0. 255. DISPLAY_IDENTIFIER ENVD_CUS_SET_CMN_1_9_ ECU_ADDRESS 0xd0009d5b FORMAT "%3.0" /end MEASUREMENT
/begin MEASUREMENT tbl_frf[2].envd_cus_set_cmn[2][0] "Freeze frame FRF_CUS_SET_CMN: environmental data common to all failure (not fixed by law) stored in set" UBYTE _CNV_A_R_LINEAR_____0_CM 1 100. 0. 255. DISPLAY_IDENTIFIER ENVD_CUS_SET_CMN_1_3_2 ECU_ADDRESS 0xd0009d5c FORMAT "%3.0" /end MEASUREMENT
/begin MEASUREMENT tbl_frf[2].envd_cus_set_cmn[2][1] "Freeze frame FRF_CUS_SET_CMN: environmental data common to all failure (not fixed by law) stored in set" UBYTE _CNV_A_R_LINEAR_____0_CM 1 100. 0. 255. DISPLAY_IDENTIFIER ENVD_CUS_SET_CMN_2_3_2 ECU_ADDRESS 0xd0009d5d FORMAT "%3.0" /end MEASUREMENT
/begin MEASUREMENT tbl_frf[2].envd_cus_set_cmn[2][2] "Freeze frame FRF_CUS_SET_CMN: environmental data common to all failure (not fixed by law) stored in set" UBYTE _CNV_A_R_LINEAR_____0_CM 1 100. 0. 255. DISPLAY_IDENTIFIER ENVD_CUS_SET_CMN_3_3_2 ECU_ADDRESS 0xd0009d5e FORMAT "%3.0" /end MEASUREMENT
/begin MEASUREMENT tbl_frf[2].envd_cus_set_cmn[2][3] "Freeze frame FRF_CUS_SET_CMN: environmental data common to all failure (not fixed by law) stored in set" UBYTE _CNV_A_R_LINEAR_____0_CM 1 100. 0. 255. DISPLAY_IDENTIFIER ENVD_CUS_SET_CMN_2_3_ ECU_ADDRESS 0xd0009d5f FORMAT "%3.0" /end MEASUREMENT
/begin MEASUREMENT tbl_frf[2].envd_cus_set_cmn[2][4] "Freeze frame FRF_CUS_SET_CMN: environmental data common to all failure (not fixed by law) stored in set" UBYTE _CNV_A_R_LINEAR_____0_CM 1 100. 0. 255. DISPLAY_IDENTIFIER ENVD_CUS_SET_CMN_2_4_ ECU_ADDRESS 0xd0009d60 FORMAT "%3.0" /end MEASUREMENT
/begin MEASUREMENT tbl_frf[2].envd_cus_set_cmn[2][5] "Freeze frame FRF_CUS_SET_CMN: environmental data common to all failure (not fixed by law) stored in set" UBYTE _CNV_A_R_LINEAR_____0_CM 1 100. 0. 255. DISPLAY_IDENTIFIER ENVD_CUS_SET_CMN_2_5_ ECU_ADDRESS 0xd0009d61 FORMAT "%3.0" /end MEASUREMENT
/begin MEASUREMENT tbl_frf[2].envd_cus_set_cmn[2][6] "Freeze frame FRF_CUS_SET_CMN: environmental data common to all failure (not fixed by law) stored in set" UBYTE _CNV_A_R_LINEAR_____0_CM 1 100. 0. 255. DISPLAY_IDENTIFIER ENVD_CUS_SET_CMN_2_6_ ECU_ADDRESS 0xd0009d62 FORMAT "%3.0" /end MEASUREMENT
/begin MEASUREMENT tbl_frf[2].envd_cus_set_cmn[2][7] "Freeze frame FRF_CUS_SET_CMN: environmental data common to all failure (not fixed by law) stored in set" UBYTE _CNV_A_R_LINEAR_____0_CM 1 100. 0. 255. DISPLAY_IDENTIFIER ENVD_CUS_SET_CMN_2_7_ ECU_ADDRESS 0xd0009d63 FORMAT "%3.0" /end MEASUREMENT
/begin MEASUREMENT tbl_frf[2].envd_cus_set_cmn[2][8] "Freeze frame FRF_CUS_SET_CMN: environmental data common to all failure (not fixed by law) stored in set" UBYTE _CNV_A_R_LINEAR_____0_CM 1 100. 0. 255. DISPLAY_IDENTIFIER ENVD_CUS_SET_CMN_2_8_ ECU_ADDRESS 0xd0009d64 FORMAT "%3.0" /end MEASUREMENT
/begin MEASUREMENT tbl_frf[2].envd_cus_set_cmn[2][9] "Freeze frame FRF_CUS_SET_CMN: environmental data common to all failure (not fixed by law) stored in set" UBYTE _CNV_A_R_LINEAR_____0_CM 1 100. 0. 255. DISPLAY_IDENTIFIER ENVD_CUS_SET_CMN_2_9_ ECU_ADDRESS 0xd0009d65 FORMAT "%3.0" /end MEASUREMENT
/begin MEASUREMENT tbl_frf[2].envd_cus_set_spc[0][0] "Freeze frame FRF_CUS_SET_SPC: environmental data specific to each failure (not fixed by law) stored in set" UBYTE _CNV_A_R_LINEAR_____0_CM 1 100. 0. 255. DISPLAY_IDENTIFIER ENVD_CUS_SET_SPC_1_1_2 ECU_ADDRESS 0xd0009d68 FORMAT "%3.0" /end MEASUREMENT
/begin MEASUREMENT tbl_frf[2].envd_cus_set_spc[0][1] "Freeze frame FRF_CUS_SET_SPC: environmental data specific to each failure (not fixed by law) stored in set" UBYTE _CNV_A_R_LINEAR_____0_CM 1 100. 0. 255. DISPLAY_IDENTIFIER ENVD_CUS_SET_SPC_2_1_2 ECU_ADDRESS 0xd0009d69 FORMAT "%3.0" /end MEASUREMENT
/begin MEASUREMENT tbl_frf[2].envd_cus_set_spc[0][2] "Freeze frame FRF_CUS_SET_SPC: environmental data specific to each failure (not fixed by law) stored in set" UBYTE _CNV_A_R_LINEAR_____0_CM 1 100. 0. 255. DISPLAY_IDENTIFIER ENVD_CUS_SET_SPC_3_1_2 ECU_ADDRESS 0xd0009d6a FORMAT "%3.0" /end MEASUREMENT
/begin MEASUREMENT tbl_frf[2].envd_cus_set_spc[0][3] "Freeze frame FRF_CUS_SET_SPC: environmental data specific to each failure (not fixed by law) stored in set" UBYTE _CNV_A_R_LINEAR_____0_CM 1 100. 0. 255. DISPLAY_IDENTIFIER ENVD_CUS_SET_SPC_4_1_2 ECU_ADDRESS 0xd0009d6b FORMAT "%3.0" /end MEASUREMENT
/begin MEASUREMENT tbl_frf[2].envd_cus_set_spc[1][0] "Freeze frame FRF_CUS_SET_SPC: environmental data specific to each failure (not fixed by law) stored in set" UBYTE _CNV_A_R_LINEAR_____0_CM 1 100. 0. 255. DISPLAY_IDENTIFIER ENVD_CUS_SET_SPC_1_2_2 ECU_ADDRESS 0xd0009d6c FORMAT "%3.0" /end MEASUREMENT
/begin MEASUREMENT tbl_frf[2].envd_cus_set_spc[1][1] "Freeze frame FRF_CUS_SET_SPC: environmental data specific to each failure (not fixed by law) stored in set" UBYTE _CNV_A_R_LINEAR_____0_CM 1 100. 0. 255. DISPLAY_IDENTIFIER ENVD_CUS_SET_SPC_2_2_2 ECU_ADDRESS 0xd0009d6d FORMAT "%3.0" /end MEASUREMENT
/begin MEASUREMENT tbl_frf[2].envd_cus_set_spc[1][2] "Freeze frame FRF_CUS_SET_SPC: environmental data specific to each failure (not fixed by law) stored in set" UBYTE _CNV_A_R_LINEAR_____0_CM 1 100. 0. 255. DISPLAY_IDENTIFIER ENVD_CUS_SET_SPC_3_2_2 ECU_ADDRESS 0xd0009d6e FORMAT "%3.0" /end MEASUREMENT
/begin MEASUREMENT tbl_frf[2].envd_cus_set_spc[1][3] "Freeze frame FRF_CUS_SET_SPC: environmental data specific to each failure (not fixed by law) stored in set" UBYTE _CNV_A_R_LINEAR_____0_CM 1 100. 0. 255. DISPLAY_IDENTIFIER ENVD_CUS_SET_SPC_4_2_2 ECU_ADDRESS 0xd0009d6f FORMAT "%3.0" /end MEASUREMENT
/begin MEASUREMENT tbl_frf[2].envd_cus_set_spc[2][0] "Freeze frame FRF_CUS_SET_SPC: environmental data specific to each failure (not fixed by law) stored in set" UBYTE _CNV_A_R_LINEAR_____0_CM 1 100. 0. 255. DISPLAY_IDENTIFIER ENVD_CUS_SET_SPC_1_3_2 ECU_ADDRESS 0xd0009d70 FORMAT "%3.0" /end MEASUREMENT
/begin MEASUREMENT tbl_frf[2].envd_cus_set_spc[2][1] "Freeze frame FRF_CUS_SET_SPC: environmental data specific to each failure (not fixed by law) stored in set" UBYTE _CNV_A_R_LINEAR_____0_CM 1 100. 0. 255. DISPLAY_IDENTIFIER ENVD_CUS_SET_SPC_2_3_2 ECU_ADDRESS 0xd0009d71 FORMAT "%3.0" /end MEASUREMENT
/begin MEASUREMENT tbl_frf[2].envd_cus_set_spc[2][2] "Freeze frame FRF_CUS_SET_SPC: environmental data specific to each failure (not fixed by law) stored in set" UBYTE _CNV_A_R_LINEAR_____0_CM 1 100. 0. 255. DISPLAY_IDENTIFIER ENVD_CUS_SET_SPC_3_3_2 ECU_ADDRESS 0xd0009d72 FORMAT "%3.0" /end MEASUREMENT
/begin MEASUREMENT tbl_frf[2].envd_cus_set_spc[2][3] "Freeze frame FRF_CUS_SET_SPC: environmental data specific to each failure (not fixed by law) stored in set" UBYTE _CNV_A_R_LINEAR_____0_CM 1 100. 0. 255. DISPLAY_IDENTIFIER ENVD_CUS_SET_SPC_4_3_2 ECU_ADDRESS 0xd0009d73 FORMAT "%3.0" /end MEASUREMENT
/begin MEASUREMENT tbl_frf[3].envd_obd[0] "Freeze frame FRF_OBD: environmental data (fixed by law)" UBYTE _CNV_A_R_LINEAR_____0_CM 1 100. 0. 255. DISPLAY_IDENTIFIER ENVD_OBD_1_3 ECU_ADDRESS 0xd0009d78 FORMAT "%3.0" /end MEASUREMENT
/begin MEASUREMENT tbl_frf[3].envd_obd[1] "Freeze frame FRF_OBD: environmental data (fixed by law)" UBYTE _CNV_A_R_LINEAR_____0_CM 1 100. 0. 255. DISPLAY_IDENTIFIER ENVD_OBD_2_3 ECU_ADDRESS 0xd0009d79 FORMAT "%3.0" /end MEASUREMENT
/begin MEASUREMENT tbl_frf[3].envd_obd[2] "Freeze frame FRF_OBD: environmental data (fixed by law)" UBYTE _CNV_A_R_LINEAR_____0_CM 1 100. 0. 255. DISPLAY_IDENTIFIER ENVD_OBD_3_3 ECU_ADDRESS 0xd0009d7a FORMAT "%3.0" /end MEASUREMENT
/begin MEASUREMENT tbl_frf[3].envd_obd[3] "Freeze frame FRF_OBD: environmental data (fixed by law)" UBYTE _CNV_A_R_LINEAR_____0_CM 1 100. 0. 255. DISPLAY_IDENTIFIER ENVD_OBD_4_3 ECU_ADDRESS 0xd0009d7b FORMAT "%3.0" /end MEASUREMENT
/begin MEASUREMENT tbl_frf[3].envd_obd[4] "Freeze frame FRF_OBD: environmental data (fixed by law)" UBYTE _CNV_A_R_LINEAR_____0_CM 1 100. 0. 255. DISPLAY_IDENTIFIER ENVD_OBD_5_3 ECU_ADDRESS 0xd0009d7c FORMAT "%3.0" /end MEASUREMENT
/begin MEASUREMENT tbl_frf[3].envd_obd[5] "Freeze frame FRF_OBD: environmental data (fixed by law)" UBYTE _CNV_A_R_LINEAR_____0_CM 1 100. 0. 255. DISPLAY_IDENTIFIER ENVD_OBD_6_3 ECU_ADDRESS 0xd0009d7d FORMAT "%3.0" /end MEASUREMENT
/begin MEASUREMENT tbl_frf[3].envd_obd[6] "Freeze frame FRF_OBD: environmental data (fixed by law)" UBYTE _CNV_A_R_LINEAR_____0_CM 1 100. 0. 255. DISPLAY_IDENTIFIER ENVD_OBD_7_3 ECU_ADDRESS 0xd0009d7e FORMAT "%3.0" /end MEASUREMENT
/begin MEASUREMENT tbl_frf[3].envd_obd[7] "Freeze frame FRF_OBD: environmental data (fixed by law)" UBYTE _CNV_A_R_LINEAR_____0_CM 1 100. 0. 255. DISPLAY_IDENTIFIER ENVD_OBD_8_3 ECU_ADDRESS 0xd0009d7f FORMAT "%3.0" /end MEASUREMENT
/begin MEASUREMENT tbl_frf[3].envd_obd[8] "Freeze frame FRF_OBD: environmental data (fixed by law)" UBYTE _CNV_A_R_LINEAR_____0_CM 1 100. 0. 255. DISPLAY_IDENTIFIER ENVD_OBD_9_3 ECU_ADDRESS 0xd0009d80 FORMAT "%3.0" /end MEASUREMENT
/begin MEASUREMENT tbl_frf[3].envd_obd[9] "Freeze frame FRF_OBD: environmental data (fixed by law)" UBYTE _CNV_A_R_LINEAR_____0_CM 1 100. 0. 255. DISPLAY_IDENTIFIER ENVD_OBD_10_3 ECU_ADDRESS 0xd0009d81 FORMAT "%3.0" /end MEASUREMENT
/begin MEASUREMENT tbl_frf[3].envd_obd[10] "Freeze frame FRF_OBD: environmental data (fixed by law)" UBYTE _CNV_A_R_LINEAR_____0_CM 1 100. 0. 255. DISPLAY_IDENTIFIER ENVD_OBD_11_3 ECU_ADDRESS 0xd0009d82 FORMAT "%3.0" /end MEASUREMENT
/begin MEASUREMENT tbl_frf[3].envd_obd[11] "Freeze frame FRF_OBD: environmental data (fixed by law)" UBYTE _CNV_A_R_LINEAR_____0_CM 1 100. 0. 255. DISPLAY_IDENTIFIER ENVD_OBD_12_3 ECU_ADDRESS 0xd0009d83 FORMAT "%3.0" /end MEASUREMENT
/begin MEASUREMENT tbl_frf[3].envd_obd[12] "Freeze frame FRF_OBD: environmental data (fixed by law)" UBYTE _CNV_A_R_LINEAR_____0_CM 1 100. 0. 255. DISPLAY_IDENTIFIER ENVD_OBD_13_3 ECU_ADDRESS 0xd0009d84 FORMAT "%3.0" /end MEASUREMENT
/begin MEASUREMENT tbl_frf[3].envd_obd[13] "Freeze frame FRF_OBD: environmental data (fixed by law)" UBYTE _CNV_A_R_LINEAR_____0_CM 1 100. 0. 255. DISPLAY_IDENTIFIER ENVD_OBD_14_3 ECU_ADDRESS 0xd0009d85 FORMAT "%3.0" /end MEASUREMENT
/begin MEASUREMENT tbl_frf[3].envd_obd[14] "Freeze frame FRF_OBD: environmental data (fixed by law)" UBYTE _CNV_A_R_LINEAR_____0_CM 1 100. 0. 255. DISPLAY_IDENTIFIER ENVD_OBD_15_3 ECU_ADDRESS 0xd0009d86 FORMAT "%3.0" /end MEASUREMENT
/begin MEASUREMENT tbl_frf[3].envd_obd[15] "Freeze frame FRF_OBD: environmental data (fixed by law)" UBYTE _CNV_A_R_LINEAR_____0_CM 1 100. 0. 255. DISPLAY_IDENTIFIER ENVD_OBD_16_3 ECU_ADDRESS 0xd0009d87 FORMAT "%3.0" /end MEASUREMENT
/begin MEASUREMENT tbl_frf[3].envd_obd[16] "Freeze frame FRF_OBD: environmental data (fixed by law)" UBYTE _CNV_A_R_LINEAR_____0_CM 1 100. 0. 255. DISPLAY_IDENTIFIER ENVD_OBD_17_3 ECU_ADDRESS 0xd0009d88 FORMAT "%3.0" /end MEASUREMENT
/begin MEASUREMENT tbl_frf[3].envd_obd[17] "Freeze frame FRF_OBD: environmental data (fixed by law)" UBYTE _CNV_A_R_LINEAR_____0_CM 1 100. 0. 255. DISPLAY_IDENTIFIER ENVD_OBD_18_3 ECU_ADDRESS 0xd0009d89 FORMAT "%3.0" /end MEASUREMENT
/begin MEASUREMENT tbl_frf[3].envd_obd[18] "Freeze frame FRF_OBD: environmental data (fixed by law)" UBYTE _CNV_A_R_LINEAR_____0_CM 1 100. 0. 255. DISPLAY_IDENTIFIER ENVD_OBD_19_3 ECU_ADDRESS 0xd0009d8a FORMAT "%3.0" /end MEASUREMENT
/begin MEASUREMENT tbl_frf[3].envd_obd[19] "Freeze frame FRF_OBD: environmental data (fixed by law)" UBYTE _CNV_A_R_LINEAR_____0_CM 1 100. 0. 255. DISPLAY_IDENTIFIER ENVD_OBD_20_3 ECU_ADDRESS 0xd0009d8b FORMAT "%3.0" /end MEASUREMENT
/begin MEASUREMENT tbl_frf[3].envd_obd[20] "Freeze frame FRF_OBD: environmental data (fixed by law)" UBYTE _CNV_A_R_LINEAR_____0_CM 1 100. 0. 255. DISPLAY_IDENTIFIER ENVD_OBD_21_3 ECU_ADDRESS 0xd0009d8c FORMAT "%3.0" /end MEASUREMENT
/begin MEASUREMENT tbl_frf[3].envd_obd[21] "Freeze frame FRF_OBD: environmental data (fixed by law)" UBYTE _CNV_A_R_LINEAR_____0_CM 1 100. 0. 255. DISPLAY_IDENTIFIER ENVD_OBD_22_3 ECU_ADDRESS 0xd0009d8d FORMAT "%3.0" /end MEASUREMENT
/begin MEASUREMENT tbl_frf[3].envd_obd[22] "Freeze frame FRF_OBD: environmental data (fixed by law)" UBYTE _CNV_A_R_LINEAR_____0_CM 1 100. 0. 255. DISPLAY_IDENTIFIER ENVD_OBD_23_3 ECU_ADDRESS 0xd0009d8e FORMAT "%3.0" /end MEASUREMENT
/begin MEASUREMENT tbl_frf[3].envd_obd[23] "Freeze frame FRF_OBD: environmental data (fixed by law)" UBYTE _CNV_A_R_LINEAR_____0_CM 1 100. 0. 255. DISPLAY_IDENTIFIER ENVD_OBD_24_3 ECU_ADDRESS 0xd0009d8f FORMAT "%3.0" /end MEASUREMENT
/begin MEASUREMENT tbl_frf[3].envd_obd[24] "Freeze frame FRF_OBD: environmental data (fixed by law)" UBYTE _CNV_A_R_LINEAR_____0_CM 1 100. 0. 255. DISPLAY_IDENTIFIER ENVD_OBD_25_3 ECU_ADDRESS 0xd0009d90 FORMAT "%3.0" /end MEASUREMENT
/begin MEASUREMENT tbl_frf[3].envd_obd[25] "Freeze frame FRF_OBD: environmental data (fixed by law)" UBYTE _CNV_A_R_LINEAR_____0_CM 1 100. 0. 255. DISPLAY_IDENTIFIER ENVD_OBD_26_3 ECU_ADDRESS 0xd0009d91 FORMAT "%3.0" /end MEASUREMENT
/begin MEASUREMENT tbl_frf[3].envd_obd[26] "Freeze frame FRF_OBD: environmental data (fixed by law)" UBYTE _CNV_A_R_LINEAR_____0_CM 1 100. 0. 255. DISPLAY_IDENTIFIER ENVD_OBD_27_3 ECU_ADDRESS 0xd0009d92 FORMAT "%3.0" /end MEASUREMENT
/begin MEASUREMENT tbl_frf[3].envd_obd[27] "Freeze frame FRF_OBD: environmental data (fixed by law)" UBYTE _CNV_A_R_LINEAR_____0_CM 1 100. 0. 255. DISPLAY_IDENTIFIER ENVD_OBD_28_3 ECU_ADDRESS 0xd0009d93 FORMAT "%3.0" /end MEASUREMENT
/begin MEASUREMENT tbl_frf[3].envd_obd[28] "Freeze frame FRF_OBD: environmental data (fixed by law)" UBYTE _CNV_A_R_LINEAR_____0_CM 1 100. 0. 255. DISPLAY_IDENTIFIER ENVD_OBD_29_3 ECU_ADDRESS 0xd0009d94 FORMAT "%3.0" /end MEASUREMENT
/begin MEASUREMENT tbl_frf[3].envd_obd[29] "Freeze frame FRF_OBD: environmental data (fixed by law)" UBYTE _CNV_A_R_LINEAR_____0_CM 1 100. 0. 255. DISPLAY_IDENTIFIER ENVD_OBD_30_3 ECU_ADDRESS 0xd0009d95 FORMAT "%3.0" /end MEASUREMENT
/begin MEASUREMENT tbl_frf[3].envd_obd[30] "Freeze frame FRF_OBD: environmental data (fixed by law)" UBYTE _CNV_A_R_LINEAR_____0_CM 1 100. 0. 255. DISPLAY_IDENTIFIER ENVD_OBD_31_3 ECU_ADDRESS 0xd0009d96 FORMAT "%3.0" /end MEASUREMENT
/begin MEASUREMENT tbl_frf[3].envd_obd[31] "Freeze frame FRF_OBD: environmental data (fixed by law)" UBYTE _CNV_A_R_LINEAR_____0_CM 1 100. 0. 255. DISPLAY_IDENTIFIER ENVD_OBD_32_3 ECU_ADDRESS 0xd0009d97 FORMAT "%3.0" /end MEASUREMENT
/begin MEASUREMENT tbl_frf[3].envd_obd[32] "Freeze frame FRF_OBD: environmental data (fixed by law)" UBYTE _CNV_A_R_LINEAR_____0_CM 1 100. 0. 255. DISPLAY_IDENTIFIER ENVD_OBD_33_3 ECU_ADDRESS 0xd0009d98 FORMAT "%3.0" /end MEASUREMENT
/begin MEASUREMENT tbl_frf[3].envd_obd[33] "Freeze frame FRF_OBD: environmental data (fixed by law)" UBYTE _CNV_A_R_LINEAR_____0_CM 1 100. 0. 255. DISPLAY_IDENTIFIER ENVD_OBD_34_3 ECU_ADDRESS 0xd0009d99 FORMAT "%3.0" /end MEASUREMENT
/begin MEASUREMENT tbl_frf[3].envd_obd[34] "Freeze frame FRF_OBD: environmental data (fixed by law)" UBYTE _CNV_A_R_LINEAR_____0_CM 1 100. 0. 255. DISPLAY_IDENTIFIER ENVD_OBD[34] ECU_ADDRESS 0xd0009d9a FORMAT "%3.0" /end MEASUREMENT
/begin MEASUREMENT tbl_frf[3].envd_obd[35] "Freeze frame FRF_OBD: environmental data (fixed by law)" UBYTE _CNV_A_R_LINEAR_____0_CM 1 100. 0. 255. DISPLAY_IDENTIFIER ENVD_OBD[35] ECU_ADDRESS 0xd0009d9b FORMAT "%3.0" /end MEASUREMENT
/begin MEASUREMENT tbl_frf[3].envd_obd[36] "Freeze frame FRF_OBD: environmental data (fixed by law)" UBYTE _CNV_A_R_LINEAR_____0_CM 1 100. 0. 255. DISPLAY_IDENTIFIER ENVD_OBD[36] ECU_ADDRESS 0xd0009d9c FORMAT "%3.0" /end MEASUREMENT
/begin MEASUREMENT tbl_frf[3].envd_obd[37] "Freeze frame FRF_OBD: environmental data (fixed by law)" UBYTE _CNV_A_R_LINEAR_____0_CM 1 100. 0. 255. DISPLAY_IDENTIFIER ENVD_OBD[37] ECU_ADDRESS 0xd0009d9d FORMAT "%3.0" /end MEASUREMENT
/begin MEASUREMENT tbl_frf[3].envd_cus_cmn[0] "Freeze frame FRF_CUS_CMN: environmental data common to all failure (not fixed by law)" UBYTE _CNV_A_R_LINEAR_____0_CM 1 100. 0. 255. DISPLAY_IDENTIFIER ENVD_CUS_CMN_1_3 ECU_ADDRESS 0xd0009d9e FORMAT "%3.0" /end MEASUREMENT
/begin MEASUREMENT tbl_frf[3].envd_cus_set_cmn[0][0] "Freeze frame FRF_CUS_SET_CMN: environmental data common to all failure (not fixed by law) stored in set" UBYTE _CNV_A_R_LINEAR_____0_CM 1 100. 0. 255. DISPLAY_IDENTIFIER ENVD_CUS_SET_CMN_1_1_3 ECU_ADDRESS 0xd0009da0 FORMAT "%3.0" /end MEASUREMENT
/begin MEASUREMENT tbl_frf[3].envd_cus_set_cmn[0][1] "Freeze frame FRF_CUS_SET_CMN: environmental data common to all failure (not fixed by law) stored in set" UBYTE _CNV_A_R_LINEAR_____0_CM 1 100. 0. 255. DISPLAY_IDENTIFIER ENVD_CUS_SET_CMN_2_1_3 ECU_ADDRESS 0xd0009da1 FORMAT "%3.0" /end MEASUREMENT
/begin MEASUREMENT tbl_frf[3].envd_cus_set_cmn[0][2] "Freeze frame FRF_CUS_SET_CMN: environmental data common to all failure (not fixed by law) stored in set" UBYTE _CNV_A_R_LINEAR_____0_CM 1 100. 0. 255. DISPLAY_IDENTIFIER ENVD_CUS_SET_CMN_3_1_3 ECU_ADDRESS 0xd0009da2 FORMAT "%3.0" /end MEASUREMENT
/begin MEASUREMENT tbl_frf[3].envd_cus_set_cmn[0][3] "Freeze frame FRF_CUS_SET_CMN: environmental data common to all failure (not fixed by law) stored in set" UBYTE _CNV_A_R_LINEAR_____0_CM 1 100. 0. 255. DISPLAY_IDENTIFIER ENVD_CUS_SET_CMN_0_3_ ECU_ADDRESS 0xd0009da3 FORMAT "%3.0" /end MEASUREMENT
/begin MEASUREMENT tbl_frf[3].envd_cus_set_cmn[0][4] "Freeze frame FRF_CUS_SET_CMN: environmental data common to all failure (not fixed by law) stored in set" UBYTE _CNV_A_R_LINEAR_____0_CM 1 100. 0. 255. DISPLAY_IDENTIFIER ENVD_CUS_SET_CMN_0_4_ ECU_ADDRESS 0xd0009da4 FORMAT "%3.0" /end MEASUREMENT
/begin MEASUREMENT tbl_frf[3].envd_cus_set_cmn[0][5] "Freeze frame FRF_CUS_SET_CMN: environmental data common to all failure (not fixed by law) stored in set" UBYTE _CNV_A_R_LINEAR_____0_CM 1 100. 0. 255. DISPLAY_IDENTIFIER ENVD_CUS_SET_CMN_0_5_ ECU_ADDRESS 0xd0009da5 FORMAT "%3.0" /end MEASUREMENT
/begin MEASUREMENT tbl_frf[3].envd_cus_set_cmn[0][6] "Freeze frame FRF_CUS_SET_CMN: environmental data common to all failure (not fixed by law) stored in set" UBYTE _CNV_A_R_LINEAR_____0_CM 1 100. 0. 255. DISPLAY_IDENTIFIER ENVD_CUS_SET_CMN_0_6_ ECU_ADDRESS 0xd0009da6 FORMAT "%3.0" /end MEASUREMENT
/begin MEASUREMENT tbl_frf[3].envd_cus_set_cmn[0][7] "Freeze frame FRF_CUS_SET_CMN: environmental data common to all failure (not fixed by law) stored in set" UBYTE _CNV_A_R_LINEAR_____0_CM 1 100. 0. 255. DISPLAY_IDENTIFIER ENVD_CUS_SET_CMN_0_7_ ECU_ADDRESS 0xd0009da7 FORMAT "%3.0" /end MEASUREMENT
/begin MEASUREMENT tbl_frf[3].envd_cus_set_cmn[0][8] "Freeze frame FRF_CUS_SET_CMN: environmental data common to all failure (not fixed by law) stored in set" UBYTE _CNV_A_R_LINEAR_____0_CM 1 100. 0. 255. DISPLAY_IDENTIFIER ENVD_CUS_SET_CMN_0_8_ ECU_ADDRESS 0xd0009da8 FORMAT "%3.0" /end MEASUREMENT
/begin MEASUREMENT tbl_frf[3].envd_cus_set_cmn[0][9] "Freeze frame FRF_CUS_SET_CMN: environmental data common to all failure (not fixed by law) stored in set" UBYTE _CNV_A_R_LINEAR_____0_CM 1 100. 0. 255. DISPLAY_IDENTIFIER ENVD_CUS_SET_CMN_0_9_ ECU_ADDRESS 0xd0009da9 FORMAT "%3.0" /end MEASUREMENT
/begin MEASUREMENT tbl_frf[3].envd_cus_set_cmn[1][0] "Freeze frame FRF_CUS_SET_CMN: environmental data common to all failure (not fixed by law) stored in set" UBYTE _CNV_A_R_LINEAR_____0_CM 1 100. 0. 255. DISPLAY_IDENTIFIER ENVD_CUS_SET_CMN_1_2_3 ECU_ADDRESS 0xd0009daa FORMAT "%3.0" /end MEASUREMENT
/begin MEASUREMENT tbl_frf[3].envd_cus_set_cmn[1][1] "Freeze frame FRF_CUS_SET_CMN: environmental data common to all failure (not fixed by law) stored in set" UBYTE _CNV_A_R_LINEAR_____0_CM 1 100. 0. 255. DISPLAY_IDENTIFIER ENVD_CUS_SET_CMN_2_2_3 ECU_ADDRESS 0xd0009dab FORMAT "%3.0" /end MEASUREMENT
/begin MEASUREMENT tbl_frf[3].envd_cus_set_cmn[1][2] "Freeze frame FRF_CUS_SET_CMN: environmental data common to all failure (not fixed by law) stored in set" UBYTE _CNV_A_R_LINEAR_____0_CM 1 100. 0. 255. DISPLAY_IDENTIFIER ENVD_CUS_SET_CMN_3_2_3 ECU_ADDRESS 0xd0009dac FORMAT "%3.0" /end MEASUREMENT
/begin MEASUREMENT tbl_frf[3].envd_cus_set_cmn[1][3] "Freeze frame FRF_CUS_SET_CMN: environmental data common to all failure (not fixed by law) stored in set" UBYTE _CNV_A_R_LINEAR_____0_CM 1 100. 0. 255. DISPLAY_IDENTIFIER ENVD_CUS_SET_CMN_1_3_ ECU_ADDRESS 0xd0009dad FORMAT "%3.0" /end MEASUREMENT
/begin MEASUREMENT tbl_frf[3].envd_cus_set_cmn[1][4] "Freeze frame FRF_CUS_SET_CMN: environmental data common to all failure (not fixed by law) stored in set" UBYTE _CNV_A_R_LINEAR_____0_CM 1 100. 0. 255. DISPLAY_IDENTIFIER ENVD_CUS_SET_CMN_1_4_ ECU_ADDRESS 0xd0009dae FORMAT "%3.0" /end MEASUREMENT
/begin MEASUREMENT tbl_frf[3].envd_cus_set_cmn[1][5] "Freeze frame FRF_CUS_SET_CMN: environmental data common to all failure (not fixed by law) stored in set" UBYTE _CNV_A_R_LINEAR_____0_CM 1 100. 0. 255. DISPLAY_IDENTIFIER ENVD_CUS_SET_CMN_1_5_ ECU_ADDRESS 0xd0009daf FORMAT "%3.0" /end MEASUREMENT
/begin MEASUREMENT tbl_frf[3].envd_cus_set_cmn[1][6] "Freeze frame FRF_CUS_SET_CMN: environmental data common to all failure (not fixed by law) stored in set" UBYTE _CNV_A_R_LINEAR_____0_CM 1 100. 0. 255. DISPLAY_IDENTIFIER ENVD_CUS_SET_CMN_1_6_ ECU_ADDRESS 0xd0009db0 FORMAT "%3.0" /end MEASUREMENT
/begin MEASUREMENT tbl_frf[3].envd_cus_set_cmn[1][7] "Freeze frame FRF_CUS_SET_CMN: environmental data common to all failure (not fixed by law) stored in set" UBYTE _CNV_A_R_LINEAR_____0_CM 1 100. 0. 255. DISPLAY_IDENTIFIER ENVD_CUS_SET_CMN_1_7_ ECU_ADDRESS 0xd0009db1 FORMAT "%3.0" /end MEASUREMENT
/begin MEASUREMENT tbl_frf[3].envd_cus_set_cmn[1][8] "Freeze frame FRF_CUS_SET_CMN: environmental data common to all failure (not fixed by law) stored in set" UBYTE _CNV_A_R_LINEAR_____0_CM 1 100. 0. 255. DISPLAY_IDENTIFIER ENVD_CUS_SET_CMN_1_8_ ECU_ADDRESS 0xd0009db2 FORMAT "%3.0" /end MEASUREMENT
/begin MEASUREMENT tbl_frf[3].envd_cus_set_cmn[1][9] "Freeze frame FRF_CUS_SET_CMN: environmental data common to all failure (not fixed by law) stored in set" UBYTE _CNV_A_R_LINEAR_____0_CM 1 100. 0. 255. DISPLAY_IDENTIFIER ENVD_CUS_SET_CMN_1_9_ ECU_ADDRESS 0xd0009db3 FORMAT "%3.0" /end MEASUREMENT
/begin MEASUREMENT tbl_frf[3].envd_cus_set_cmn[2][0] "Freeze frame FRF_CUS_SET_CMN: environmental data common to all failure (not fixed by law) stored in set" UBYTE _CNV_A_R_LINEAR_____0_CM 1 100. 0. 255. DISPLAY_IDENTIFIER ENVD_CUS_SET_CMN_1_3_3 ECU_ADDRESS 0xd0009db4 FORMAT "%3.0" /end MEASUREMENT
/begin MEASUREMENT tbl_frf[3].envd_cus_set_cmn[2][1] "Freeze frame FRF_CUS_SET_CMN: environmental data common to all failure (not fixed by law) stored in set" UBYTE _CNV_A_R_LINEAR_____0_CM 1 100. 0. 255. DISPLAY_IDENTIFIER ENVD_CUS_SET_CMN_2_3_3 ECU_ADDRESS 0xd0009db5 FORMAT "%3.0" /end MEASUREMENT
/begin MEASUREMENT tbl_frf[3].envd_cus_set_cmn[2][2] "Freeze frame FRF_CUS_SET_CMN: environmental data common to all failure (not fixed by law) stored in set" UBYTE _CNV_A_R_LINEAR_____0_CM 1 100. 0. 255. DISPLAY_IDENTIFIER ENVD_CUS_SET_CMN_3_3_3 ECU_ADDRESS 0xd0009db6 FORMAT "%3.0" /end MEASUREMENT
/begin MEASUREMENT tbl_frf[3].envd_cus_set_cmn[2][3] "Freeze frame FRF_CUS_SET_CMN: environmental data common to all failure (not fixed by law) stored in set" UBYTE _CNV_A_R_LINEAR_____0_CM 1 100. 0. 255. DISPLAY_IDENTIFIER ENVD_CUS_SET_CMN_2_3_ ECU_ADDRESS 0xd0009db7 FORMAT "%3.0" /end MEASUREMENT
/begin MEASUREMENT tbl_frf[3].envd_cus_set_cmn[2][4] "Freeze frame FRF_CUS_SET_CMN: environmental data common to all failure (not fixed by law) stored in set" UBYTE _CNV_A_R_LINEAR_____0_CM 1 100. 0. 255. DISPLAY_IDENTIFIER ENVD_CUS_SET_CMN_2_4_ ECU_ADDRESS 0xd0009db8 FORMAT "%3.0" /end MEASUREMENT
/begin MEASUREMENT tbl_frf[3].envd_cus_set_cmn[2][5] "Freeze frame FRF_CUS_SET_CMN: environmental data common to all failure (not fixed by law) stored in set" UBYTE _CNV_A_R_LINEAR_____0_CM 1 100. 0. 255. DISPLAY_IDENTIFIER ENVD_CUS_SET_CMN_2_5_ ECU_ADDRESS 0xd0009db9 FORMAT "%3.0" /end MEASUREMENT
/begin MEASUREMENT tbl_frf[3].envd_cus_set_cmn[2][6] "Freeze frame FRF_CUS_SET_CMN: environmental data common to all failure (not fixed by law) stored in set" UBYTE _CNV_A_R_LINEAR_____0_CM 1 100. 0. 255. DISPLAY_IDENTIFIER ENVD_CUS_SET_CMN_2_6_ ECU_ADDRESS 0xd0009dba FORMAT "%3.0" /end MEASUREMENT
/begin MEASUREMENT tbl_frf[3].envd_cus_set_cmn[2][7] "Freeze frame FRF_CUS_SET_CMN: environmental data common to all failure (not fixed by law) stored in set" UBYTE _CNV_A_R_LINEAR_____0_CM 1 100. 0. 255. DISPLAY_IDENTIFIER ENVD_CUS_SET_CMN_2_7_ ECU_ADDRESS 0xd0009dbb FORMAT "%3.0" /end MEASUREMENT
/begin MEASUREMENT tbl_frf[3].envd_cus_set_cmn[2][8] "Freeze frame FRF_CUS_SET_CMN: environmental data common to all failure (not fixed by law) stored in set" UBYTE _CNV_A_R_LINEAR_____0_CM 1 100. 0. 255. DISPLAY_IDENTIFIER ENVD_CUS_SET_CMN_2_8_ ECU_ADDRESS 0xd0009dbc FORMAT "%3.0" /end MEASUREMENT
/begin MEASUREMENT tbl_frf[3].envd_cus_set_cmn[2][9] "Freeze frame FRF_CUS_SET_CMN: environmental data common to all failure (not fixed by law) stored in set" UBYTE _CNV_A_R_LINEAR_____0_CM 1 100. 0. 255. DISPLAY_IDENTIFIER ENVD_CUS_SET_CMN_2_9_ ECU_ADDRESS 0xd0009dbd FORMAT "%3.0" /end MEASUREMENT
/begin MEASUREMENT tbl_frf[3].envd_cus_set_spc[0][0] "Freeze frame FRF_CUS_SET_SPC: environmental data specific to each failure (not fixed by law) stored in set" UBYTE _CNV_A_R_LINEAR_____0_CM 1 100. 0. 255. DISPLAY_IDENTIFIER ENVD_CUS_SET_SPC_1_1_3 ECU_ADDRESS 0xd0009dc0 FORMAT "%3.0" /end MEASUREMENT
/begin MEASUREMENT tbl_frf[3].envd_cus_set_spc[0][1] "Freeze frame FRF_CUS_SET_SPC: environmental data specific to each failure (not fixed by law) stored in set" UBYTE _CNV_A_R_LINEAR_____0_CM 1 100. 0. 255. DISPLAY_IDENTIFIER ENVD_CUS_SET_SPC_2_1_3 ECU_ADDRESS 0xd0009dc1 FORMAT "%3.0" /end MEASUREMENT
/begin MEASUREMENT tbl_frf[3].envd_cus_set_spc[0][2] "Freeze frame FRF_CUS_SET_SPC: environmental data specific to each failure (not fixed by law) stored in set" UBYTE _CNV_A_R_LINEAR_____0_CM 1 100. 0. 255. DISPLAY_IDENTIFIER ENVD_CUS_SET_SPC_3_1_3 ECU_ADDRESS 0xd0009dc2 FORMAT "%3.0" /end MEASUREMENT
/begin MEASUREMENT tbl_frf[3].envd_cus_set_spc[0][3] "Freeze frame FRF_CUS_SET_SPC: environmental data specific to each failure (not fixed by law) stored in set" UBYTE _CNV_A_R_LINEAR_____0_CM 1 100. 0. 255. DISPLAY_IDENTIFIER ENVD_CUS_SET_SPC_4_1_3 ECU_ADDRESS 0xd0009dc3 FORMAT "%3.0" /end MEASUREMENT
/begin MEASUREMENT tbl_frf[3].envd_cus_set_spc[1][0] "Freeze frame FRF_CUS_SET_SPC: environmental data specific to each failure (not fixed by law) stored in set" UBYTE _CNV_A_R_LINEAR_____0_CM 1 100. 0. 255. DISPLAY_IDENTIFIER ENVD_CUS_SET_SPC_1_2_3 ECU_ADDRESS 0xd0009dc4 FORMAT "%3.0" /end MEASUREMENT
/begin MEASUREMENT tbl_frf[3].envd_cus_set_spc[1][1] "Freeze frame FRF_CUS_SET_SPC: environmental data specific to each failure (not fixed by law) stored in set" UBYTE _CNV_A_R_LINEAR_____0_CM 1 100. 0. 255. DISPLAY_IDENTIFIER ENVD_CUS_SET_SPC_2_2_3 ECU_ADDRESS 0xd0009dc5 FORMAT "%3.0" /end MEASUREMENT
/begin MEASUREMENT tbl_frf[3].envd_cus_set_spc[1][2] "Freeze frame FRF_CUS_SET_SPC: environmental data specific to each failure (not fixed by law) stored in set" UBYTE _CNV_A_R_LINEAR_____0_CM 1 100. 0. 255. DISPLAY_IDENTIFIER ENVD_CUS_SET_SPC_3_2_3 ECU_ADDRESS 0xd0009dc6 FORMAT "%3.0" /end MEASUREMENT
/begin MEASUREMENT tbl_frf[3].envd_cus_set_spc[1][3] "Freeze frame FRF_CUS_SET_SPC: environmental data specific to each failure (not fixed by law) stored in set" UBYTE _CNV_A_R_LINEAR_____0_CM 1 100. 0. 255. DISPLAY_IDENTIFIER ENVD_CUS_SET_SPC_4_2_3 ECU_ADDRESS 0xd0009dc7 FORMAT "%3.0" /end MEASUREMENT
/begin MEASUREMENT tbl_frf[3].envd_cus_set_spc[2][0] "Freeze frame FRF_CUS_SET_SPC: environmental data specific to each failure (not fixed by law) stored in set" UBYTE _CNV_A_R_LINEAR_____0_CM 1 100. 0. 255. DISPLAY_IDENTIFIER ENVD_CUS_SET_SPC_1_3_3 ECU_ADDRESS 0xd0009dc8 FORMAT "%3.0" /end MEASUREMENT
/begin MEASUREMENT tbl_frf[3].envd_cus_set_spc[2][1] "Freeze frame FRF_CUS_SET_SPC: environmental data specific to each failure (not fixed by law) stored in set" UBYTE _CNV_A_R_LINEAR_____0_CM 1 100. 0. 255. DISPLAY_IDENTIFIER ENVD_CUS_SET_SPC_2_3_3 ECU_ADDRESS 0xd0009dc9 FORMAT "%3.0" /end MEASUREMENT
/begin MEASUREMENT tbl_frf[3].envd_cus_set_spc[2][2] "Freeze frame FRF_CUS_SET_SPC: environmental data specific to each failure (not fixed by law) stored in set" UBYTE _CNV_A_R_LINEAR_____0_CM 1 100. 0. 255. DISPLAY_IDENTIFIER ENVD_CUS_SET_SPC_3_3_3 ECU_ADDRESS 0xd0009dca FORMAT "%3.0" /end MEASUREMENT
/begin MEASUREMENT tbl_frf[3].envd_cus_set_spc[2][3] "Freeze frame FRF_CUS_SET_SPC: environmental data specific to each failure (not fixed by law) stored in set" UBYTE _CNV_A_R_LINEAR_____0_CM 1 100. 0. 255. DISPLAY_IDENTIFIER ENVD_CUS_SET_SPC_4_3_3 ECU_ADDRESS 0xd0009dcb FORMAT "%3.0" /end MEASUREMENT
/begin MEASUREMENT tbl_frf[4].envd_obd[0] "Freeze frame FRF_OBD: environmental data (fixed by law)" UBYTE _CNV_A_R_LINEAR_____0_CM 1 100. 0. 255. DISPLAY_IDENTIFIER ENVD_OBD_1_4 ECU_ADDRESS 0xd0009dd0 FORMAT "%3.0" /end MEASUREMENT
/begin MEASUREMENT tbl_frf[4].envd_obd[1] "Freeze frame FRF_OBD: environmental data (fixed by law)" UBYTE _CNV_A_R_LINEAR_____0_CM 1 100. 0. 255. DISPLAY_IDENTIFIER ENVD_OBD_2_4 ECU_ADDRESS 0xd0009dd1 FORMAT "%3.0" /end MEASUREMENT
/begin MEASUREMENT tbl_frf[4].envd_obd[2] "Freeze frame FRF_OBD: environmental data (fixed by law)" UBYTE _CNV_A_R_LINEAR_____0_CM 1 100. 0. 255. DISPLAY_IDENTIFIER ENVD_OBD_3_4 ECU_ADDRESS 0xd0009dd2 FORMAT "%3.0" /end MEASUREMENT
/begin MEASUREMENT tbl_frf[4].envd_obd[3] "Freeze frame FRF_OBD: environmental data (fixed by law)" UBYTE _CNV_A_R_LINEAR_____0_CM 1 100. 0. 255. DISPLAY_IDENTIFIER ENVD_OBD_4_4 ECU_ADDRESS 0xd0009dd3 FORMAT "%3.0" /end MEASUREMENT
/begin MEASUREMENT tbl_frf[4].envd_obd[4] "Freeze frame FRF_OBD: environmental data (fixed by law)" UBYTE _CNV_A_R_LINEAR_____0_CM 1 100. 0. 255. DISPLAY_IDENTIFIER ENVD_OBD_5_4 ECU_ADDRESS 0xd0009dd4 FORMAT "%3.0" /end MEASUREMENT
/begin MEASUREMENT tbl_frf[4].envd_obd[5] "Freeze frame FRF_OBD: environmental data (fixed by law)" UBYTE _CNV_A_R_LINEAR_____0_CM 1 100. 0. 255. DISPLAY_IDENTIFIER ENVD_OBD_6_4 ECU_ADDRESS 0xd0009dd5 FORMAT "%3.0" /end MEASUREMENT
/begin MEASUREMENT tbl_frf[4].envd_obd[6] "Freeze frame FRF_OBD: environmental data (fixed by law)" UBYTE _CNV_A_R_LINEAR_____0_CM 1 100. 0. 255. DISPLAY_IDENTIFIER ENVD_OBD_7_4 ECU_ADDRESS 0xd0009dd6 FORMAT "%3.0" /end MEASUREMENT
/begin MEASUREMENT tbl_frf[4].envd_obd[7] "Freeze frame FRF_OBD: environmental data (fixed by law)" UBYTE _CNV_A_R_LINEAR_____0_CM 1 100. 0. 255. DISPLAY_IDENTIFIER ENVD_OBD_8_4 ECU_ADDRESS 0xd0009dd7 FORMAT "%3.0" /end MEASUREMENT
/begin MEASUREMENT tbl_frf[4].envd_obd[8] "Freeze frame FRF_OBD: environmental data (fixed by law)" UBYTE _CNV_A_R_LINEAR_____0_CM 1 100. 0. 255. DISPLAY_IDENTIFIER ENVD_OBD_9_4 ECU_ADDRESS 0xd0009dd8 FORMAT "%3.0" /end MEASUREMENT
/begin MEASUREMENT tbl_frf[4].envd_obd[9] "Freeze frame FRF_OBD: environmental data (fixed by law)" UBYTE _CNV_A_R_LINEAR_____0_CM 1 100. 0. 255. DISPLAY_IDENTIFIER ENVD_OBD_10_4 ECU_ADDRESS 0xd0009dd9 FORMAT "%3.0" /end MEASUREMENT
/begin MEASUREMENT tbl_frf[4].envd_obd[10] "Freeze frame FRF_OBD: environmental data (fixed by law)" UBYTE _CNV_A_R_LINEAR_____0_CM 1 100. 0. 255. DISPLAY_IDENTIFIER ENVD_OBD_11_4 ECU_ADDRESS 0xd0009dda FORMAT "%3.0" /end MEASUREMENT
/begin MEASUREMENT tbl_frf[4].envd_obd[11] "Freeze frame FRF_OBD: environmental data (fixed by law)" UBYTE _CNV_A_R_LINEAR_____0_CM 1 100. 0. 255. DISPLAY_IDENTIFIER ENVD_OBD_12_4 ECU_ADDRESS 0xd0009ddb FORMAT "%3.0" /end MEASUREMENT
/begin MEASUREMENT tbl_frf[4].envd_obd[12] "Freeze frame FRF_OBD: environmental data (fixed by law)" UBYTE _CNV_A_R_LINEAR_____0_CM 1 100. 0. 255. DISPLAY_IDENTIFIER ENVD_OBD_13_4 ECU_ADDRESS 0xd0009ddc FORMAT "%3.0" /end MEASUREMENT
/begin MEASUREMENT tbl_frf[4].envd_obd[13] "Freeze frame FRF_OBD: environmental data (fixed by law)" UBYTE _CNV_A_R_LINEAR_____0_CM 1 100. 0. 255. DISPLAY_IDENTIFIER ENVD_OBD_14_4 ECU_ADDRESS 0xd0009ddd FORMAT "%3.0" /end MEASUREMENT
/begin MEASUREMENT tbl_frf[4].envd_obd[14] "Freeze frame FRF_OBD: environmental data (fixed by law)" UBYTE _CNV_A_R_LINEAR_____0_CM 1 100. 0. 255. DISPLAY_IDENTIFIER ENVD_OBD_15_4 ECU_ADDRESS 0xd0009dde FORMAT "%3.0" /end MEASUREMENT
/begin MEASUREMENT tbl_frf[4].envd_obd[15] "Freeze frame FRF_OBD: environmental data (fixed by law)" UBYTE _CNV_A_R_LINEAR_____0_CM 1 100. 0. 255. DISPLAY_IDENTIFIER ENVD_OBD_16_4 ECU_ADDRESS 0xd0009ddf FORMAT "%3.0" /end MEASUREMENT
/begin MEASUREMENT tbl_frf[4].envd_obd[16] "Freeze frame FRF_OBD: environmental data (fixed by law)" UBYTE _CNV_A_R_LINEAR_____0_CM 1 100. 0. 255. DISPLAY_IDENTIFIER ENVD_OBD_17_4 ECU_ADDRESS 0xd0009de0 FORMAT "%3.0" /end MEASUREMENT
/begin MEASUREMENT tbl_frf[4].envd_obd[17] "Freeze frame FRF_OBD: environmental data (fixed by law)" UBYTE _CNV_A_R_LINEAR_____0_CM 1 100. 0. 255. DISPLAY_IDENTIFIER ENVD_OBD_18_4 ECU_ADDRESS 0xd0009de1 FORMAT "%3.0" /end MEASUREMENT
/begin MEASUREMENT tbl_frf[4].envd_obd[18] "Freeze frame FRF_OBD: environmental data (fixed by law)" UBYTE _CNV_A_R_LINEAR_____0_CM 1 100. 0. 255. DISPLAY_IDENTIFIER ENVD_OBD_19_4 ECU_ADDRESS 0xd0009de2 FORMAT "%3.0" /end MEASUREMENT
/begin MEASUREMENT tbl_frf[4].envd_obd[19] "Freeze frame FRF_OBD: environmental data (fixed by law)" UBYTE _CNV_A_R_LINEAR_____0_CM 1 100. 0. 255. DISPLAY_IDENTIFIER ENVD_OBD_20_4 ECU_ADDRESS 0xd0009de3 FORMAT "%3.0" /end MEASUREMENT
/begin MEASUREMENT tbl_frf[4].envd_obd[20] "Freeze frame FRF_OBD: environmental data (fixed by law)" UBYTE _CNV_A_R_LINEAR_____0_CM 1 100. 0. 255. DISPLAY_IDENTIFIER ENVD_OBD_21_4 ECU_ADDRESS 0xd0009de4 FORMAT "%3.0" /end MEASUREMENT
/begin MEASUREMENT tbl_frf[4].envd_obd[21] "Freeze frame FRF_OBD: environmental data (fixed by law)" UBYTE _CNV_A_R_LINEAR_____0_CM 1 100. 0. 255. DISPLAY_IDENTIFIER ENVD_OBD_22_4 ECU_ADDRESS 0xd0009de5 FORMAT "%3.0" /end MEASUREMENT
/begin MEASUREMENT tbl_frf[4].envd_obd[22] "Freeze frame FRF_OBD: environmental data (fixed by law)" UBYTE _CNV_A_R_LINEAR_____0_CM 1 100. 0. 255. DISPLAY_IDENTIFIER ENVD_OBD_23_4 ECU_ADDRESS 0xd0009de6 FORMAT "%3.0" /end MEASUREMENT
/begin MEASUREMENT tbl_frf[4].envd_obd[23] "Freeze frame FRF_OBD: environmental data (fixed by law)" UBYTE _CNV_A_R_LINEAR_____0_CM 1 100. 0. 255. DISPLAY_IDENTIFIER ENVD_OBD_24_4 ECU_ADDRESS 0xd0009de7 FORMAT "%3.0" /end MEASUREMENT
/begin MEASUREMENT tbl_frf[4].envd_obd[24] "Freeze frame FRF_OBD: environmental data (fixed by law)" UBYTE _CNV_A_R_LINEAR_____0_CM 1 100. 0. 255. DISPLAY_IDENTIFIER ENVD_OBD_25_4 ECU_ADDRESS 0xd0009de8 FORMAT "%3.0" /end MEASUREMENT
/begin MEASUREMENT tbl_frf[4].envd_obd[25] "Freeze frame FRF_OBD: environmental data (fixed by law)" UBYTE _CNV_A_R_LINEAR_____0_CM 1 100. 0. 255. DISPLAY_IDENTIFIER ENVD_OBD_26_4 ECU_ADDRESS 0xd0009de9 FORMAT "%3.0" /end MEASUREMENT
/begin MEASUREMENT tbl_frf[4].envd_obd[26] "Freeze frame FRF_OBD: environmental data (fixed by law)" UBYTE _CNV_A_R_LINEAR_____0_CM 1 100. 0. 255. DISPLAY_IDENTIFIER ENVD_OBD_27_4 ECU_ADDRESS 0xd0009dea FORMAT "%3.0" /end MEASUREMENT
/begin MEASUREMENT tbl_frf[4].envd_obd[27] "Freeze frame FRF_OBD: environmental data (fixed by law)" UBYTE _CNV_A_R_LINEAR_____0_CM 1 100. 0. 255. DISPLAY_IDENTIFIER ENVD_OBD_28_4 ECU_ADDRESS 0xd0009deb FORMAT "%3.0" /end MEASUREMENT
/begin MEASUREMENT tbl_frf[4].envd_obd[28] "Freeze frame FRF_OBD: environmental data (fixed by law)" UBYTE _CNV_A_R_LINEAR_____0_CM 1 100. 0. 255. DISPLAY_IDENTIFIER ENVD_OBD_29_4 ECU_ADDRESS 0xd0009dec FORMAT "%3.0" /end MEASUREMENT
/begin MEASUREMENT tbl_frf[4].envd_obd[29] "Freeze frame FRF_OBD: environmental data (fixed by law)" UBYTE _CNV_A_R_LINEAR_____0_CM 1 100. 0. 255. DISPLAY_IDENTIFIER ENVD_OBD_30_4 ECU_ADDRESS 0xd0009ded FORMAT "%3.0" /end MEASUREMENT
/begin MEASUREMENT tbl_frf[4].envd_obd[30] "Freeze frame FRF_OBD: environmental data (fixed by law)" UBYTE _CNV_A_R_LINEAR_____0_CM 1 100. 0. 255. DISPLAY_IDENTIFIER ENVD_OBD_31_4 ECU_ADDRESS 0xd0009dee FORMAT "%3.0" /end MEASUREMENT
/begin MEASUREMENT tbl_frf[4].envd_obd[31] "Freeze frame FRF_OBD: environmental data (fixed by law)" UBYTE _CNV_A_R_LINEAR_____0_CM 1 100. 0. 255. DISPLAY_IDENTIFIER ENVD_OBD_32_4 ECU_ADDRESS 0xd0009def FORMAT "%3.0" /end MEASUREMENT
/begin MEASUREMENT tbl_frf[4].envd_obd[32] "Freeze frame FRF_OBD: environmental data (fixed by law)" UBYTE _CNV_A_R_LINEAR_____0_CM 1 100. 0. 255. DISPLAY_IDENTIFIER ENVD_OBD_33_4 ECU_ADDRESS 0xd0009df0 FORMAT "%3.0" /end MEASUREMENT
/begin MEASUREMENT tbl_frf[4].envd_obd[33] "Freeze frame FRF_OBD: environmental data (fixed by law)" UBYTE _CNV_A_R_LINEAR_____0_CM 1 100. 0. 255. DISPLAY_IDENTIFIER ENVD_OBD_34_4 ECU_ADDRESS 0xd0009df1 FORMAT "%3.0" /end MEASUREMENT
/begin MEASUREMENT tbl_frf[4].envd_obd[34] "Freeze frame FRF_OBD: environmental data (fixed by law)" UBYTE _CNV_A_R_LINEAR_____0_CM 1 100. 0. 255. DISPLAY_IDENTIFIER ENVD_OBD[34] ECU_ADDRESS 0xd0009df2 FORMAT "%3.0" /end MEASUREMENT
/begin MEASUREMENT tbl_frf[4].envd_obd[35] "Freeze frame FRF_OBD: environmental data (fixed by law)" UBYTE _CNV_A_R_LINEAR_____0_CM 1 100. 0. 255. DISPLAY_IDENTIFIER ENVD_OBD[35] ECU_ADDRESS 0xd0009df3 FORMAT "%3.0" /end MEASUREMENT
/begin MEASUREMENT tbl_frf[4].envd_obd[36] "Freeze frame FRF_OBD: environmental data (fixed by law)" UBYTE _CNV_A_R_LINEAR_____0_CM 1 100. 0. 255. DISPLAY_IDENTIFIER ENVD_OBD[36] ECU_ADDRESS 0xd0009df4 FORMAT "%3.0" /end MEASUREMENT
/begin MEASUREMENT tbl_frf[4].envd_obd[37] "Freeze frame FRF_OBD: environmental data (fixed by law)" UBYTE _CNV_A_R_LINEAR_____0_CM 1 100. 0. 255. DISPLAY_IDENTIFIER ENVD_OBD[37] ECU_ADDRESS 0xd0009df5 FORMAT "%3.0" /end MEASUREMENT
/begin MEASUREMENT tbl_frf[4].envd_cus_cmn[0] "Freeze frame FRF_CUS_CMN: environmental data common to all failure (not fixed by law)" UBYTE _CNV_A_R_LINEAR_____0_CM 1 100. 0. 255. DISPLAY_IDENTIFIER ENVD_CUS_CMN_1_4 ECU_ADDRESS 0xd0009df6 FORMAT "%3.0" /end MEASUREMENT
/begin MEASUREMENT tbl_frf[4].envd_cus_set_cmn[0][0] "Freeze frame FRF_CUS_SET_CMN: environmental data common to all failure (not fixed by law) stored in set" UBYTE _CNV_A_R_LINEAR_____0_CM 1 100. 0. 255. DISPLAY_IDENTIFIER ENVD_CUS_SET_CMN_1_1_4 ECU_ADDRESS 0xd0009df8 FORMAT "%3.0" /end MEASUREMENT
/begin MEASUREMENT tbl_frf[4].envd_cus_set_cmn[0][1] "Freeze frame FRF_CUS_SET_CMN: environmental data common to all failure (not fixed by law) stored in set" UBYTE _CNV_A_R_LINEAR_____0_CM 1 100. 0. 255. DISPLAY_IDENTIFIER ENVD_CUS_SET_CMN_2_1_4 ECU_ADDRESS 0xd0009df9 FORMAT "%3.0" /end MEASUREMENT
/begin MEASUREMENT tbl_frf[4].envd_cus_set_cmn[0][2] "Freeze frame FRF_CUS_SET_CMN: environmental data common to all failure (not fixed by law) stored in set" UBYTE _CNV_A_R_LINEAR_____0_CM 1 100. 0. 255. DISPLAY_IDENTIFIER ENVD_CUS_SET_CMN_3_1_4 ECU_ADDRESS 0xd0009dfa FORMAT "%3.0" /end MEASUREMENT
/begin MEASUREMENT tbl_frf[4].envd_cus_set_cmn[0][3] "Freeze frame FRF_CUS_SET_CMN: environmental data common to all failure (not fixed by law) stored in set" UBYTE _CNV_A_R_LINEAR_____0_CM 1 100. 0. 255. DISPLAY_IDENTIFIER ENVD_CUS_SET_CMN_0_3_ ECU_ADDRESS 0xd0009dfb FORMAT "%3.0" /end MEASUREMENT
/begin MEASUREMENT tbl_frf[4].envd_cus_set_cmn[0][4] "Freeze frame FRF_CUS_SET_CMN: environmental data common to all failure (not fixed by law) stored in set" UBYTE _CNV_A_R_LINEAR_____0_CM 1 100. 0. 255. DISPLAY_IDENTIFIER ENVD_CUS_SET_CMN_0_4_ ECU_ADDRESS 0xd0009dfc FORMAT "%3.0" /end MEASUREMENT
/begin MEASUREMENT tbl_frf[4].envd_cus_set_cmn[0][5] "Freeze frame FRF_CUS_SET_CMN: environmental data common to all failure (not fixed by law) stored in set" UBYTE _CNV_A_R_LINEAR_____0_CM 1 100. 0. 255. DISPLAY_IDENTIFIER ENVD_CUS_SET_CMN_0_5_ ECU_ADDRESS 0xd0009dfd FORMAT "%3.0" /end MEASUREMENT
/begin MEASUREMENT tbl_frf[4].envd_cus_set_cmn[0][6] "Freeze frame FRF_CUS_SET_CMN: environmental data common to all failure (not fixed by law) stored in set" UBYTE _CNV_A_R_LINEAR_____0_CM 1 100. 0. 255. DISPLAY_IDENTIFIER ENVD_CUS_SET_CMN_0_6_ ECU_ADDRESS 0xd0009dfe FORMAT "%3.0" /end MEASUREMENT
/begin MEASUREMENT tbl_frf[4].envd_cus_set_cmn[0][7] "Freeze frame FRF_CUS_SET_CMN: environmental data common to all failure (not fixed by law) stored in set" UBYTE _CNV_A_R_LINEAR_____0_CM 1 100. 0. 255. DISPLAY_IDENTIFIER ENVD_CUS_SET_CMN_0_7_ ECU_ADDRESS 0xd0009dff FORMAT "%3.0" /end MEASUREMENT
/begin MEASUREMENT tbl_frf[4].envd_cus_set_cmn[0][8] "Freeze frame FRF_CUS_SET_CMN: environmental data common to all failure (not fixed by law) stored in set" UBYTE _CNV_A_R_LINEAR_____0_CM 1 100. 0. 255. DISPLAY_IDENTIFIER ENVD_CUS_SET_CMN_0_8_ ECU_ADDRESS 0xd0009e00 FORMAT "%3.0" /end MEASUREMENT
/begin MEASUREMENT tbl_frf[4].envd_cus_set_cmn[0][9] "Freeze frame FRF_CUS_SET_CMN: environmental data common to all failure (not fixed by law) stored in set" UBYTE _CNV_A_R_LINEAR_____0_CM 1 100. 0. 255. DISPLAY_IDENTIFIER ENVD_CUS_SET_CMN_0_9_ ECU_ADDRESS 0xd0009e01 FORMAT "%3.0" /end MEASUREMENT
/begin MEASUREMENT tbl_frf[4].envd_cus_set_cmn[1][0] "Freeze frame FRF_CUS_SET_CMN: environmental data common to all failure (not fixed by law) stored in set" UBYTE _CNV_A_R_LINEAR_____0_CM 1 100. 0. 255. DISPLAY_IDENTIFIER ENVD_CUS_SET_CMN_1_2_4 ECU_ADDRESS 0xd0009e02 FORMAT "%3.0" /end MEASUREMENT
/begin MEASUREMENT tbl_frf[4].envd_cus_set_cmn[1][1] "Freeze frame FRF_CUS_SET_CMN: environmental data common to all failure (not fixed by law) stored in set" UBYTE _CNV_A_R_LINEAR_____0_CM 1 100. 0. 255. DISPLAY_IDENTIFIER ENVD_CUS_SET_CMN_2_2_4 ECU_ADDRESS 0xd0009e03 FORMAT "%3.0" /end MEASUREMENT
/begin MEASUREMENT tbl_frf[4].envd_cus_set_cmn[1][2] "Freeze frame FRF_CUS_SET_CMN: environmental data common to all failure (not fixed by law) stored in set" UBYTE _CNV_A_R_LINEAR_____0_CM 1 100. 0. 255. DISPLAY_IDENTIFIER ENVD_CUS_SET_CMN_3_2_4 ECU_ADDRESS 0xd0009e04 FORMAT "%3.0" /end MEASUREMENT
/begin MEASUREMENT tbl_frf[4].envd_cus_set_cmn[1][3] "Freeze frame FRF_CUS_SET_CMN: environmental data common to all failure (not fixed by law) stored in set" UBYTE _CNV_A_R_LINEAR_____0_CM 1 100. 0. 255. DISPLAY_IDENTIFIER ENVD_CUS_SET_CMN_1_3_ ECU_ADDRESS 0xd0009e05 FORMAT "%3.0" /end MEASUREMENT
/begin MEASUREMENT tbl_frf[4].envd_cus_set_cmn[1][4] "Freeze frame FRF_CUS_SET_CMN: environmental data common to all failure (not fixed by law) stored in set" UBYTE _CNV_A_R_LINEAR_____0_CM 1 100. 0. 255. DISPLAY_IDENTIFIER ENVD_CUS_SET_CMN_1_4_ ECU_ADDRESS 0xd0009e06 FORMAT "%3.0" /end MEASUREMENT
/begin MEASUREMENT tbl_frf[4].envd_cus_set_cmn[1][5] "Freeze frame FRF_CUS_SET_CMN: environmental data common to all failure (not fixed by law) stored in set" UBYTE _CNV_A_R_LINEAR_____0_CM 1 100. 0. 255. DISPLAY_IDENTIFIER ENVD_CUS_SET_CMN_1_5_ ECU_ADDRESS 0xd0009e07 FORMAT "%3.0" /end MEASUREMENT
/begin MEASUREMENT tbl_frf[4].envd_cus_set_cmn[1][6] "Freeze frame FRF_CUS_SET_CMN: environmental data common to all failure (not fixed by law) stored in set" UBYTE _CNV_A_R_LINEAR_____0_CM 1 100. 0. 255. DISPLAY_IDENTIFIER ENVD_CUS_SET_CMN_1_6_ ECU_ADDRESS 0xd0009e08 FORMAT "%3.0" /end MEASUREMENT
/begin MEASUREMENT tbl_frf[4].envd_cus_set_cmn[1][7] "Freeze frame FRF_CUS_SET_CMN: environmental data common to all failure (not fixed by law) stored in set" UBYTE _CNV_A_R_LINEAR_____0_CM 1 100. 0. 255. DISPLAY_IDENTIFIER ENVD_CUS_SET_CMN_1_7_ ECU_ADDRESS 0xd0009e09 FORMAT "%3.0" /end MEASUREMENT
/begin MEASUREMENT tbl_frf[4].envd_cus_set_cmn[1][8] "Freeze frame FRF_CUS_SET_CMN: environmental data common to all failure (not fixed by law) stored in set" UBYTE _CNV_A_R_LINEAR_____0_CM 1 100. 0. 255. DISPLAY_IDENTIFIER ENVD_CUS_SET_CMN_1_8_ ECU_ADDRESS 0xd0009e0a FORMAT "%3.0" /end MEASUREMENT
/begin MEASUREMENT tbl_frf[4].envd_cus_set_cmn[1][9] "Freeze frame FRF_CUS_SET_CMN: environmental data common to all failure (not fixed by law) stored in set" UBYTE _CNV_A_R_LINEAR_____0_CM 1 100. 0. 255. DISPLAY_IDENTIFIER ENVD_CUS_SET_CMN_1_9_ ECU_ADDRESS 0xd0009e0b FORMAT "%3.0" /end MEASUREMENT
/begin MEASUREMENT tbl_frf[4].envd_cus_set_cmn[2][0] "Freeze frame FRF_CUS_SET_CMN: environmental data common to all failure (not fixed by law) stored in set" UBYTE _CNV_A_R_LINEAR_____0_CM 1 100. 0. 255. DISPLAY_IDENTIFIER ENVD_CUS_SET_CMN_1_3_4 ECU_ADDRESS 0xd0009e0c FORMAT "%3.0" /end MEASUREMENT
/begin MEASUREMENT tbl_frf[4].envd_cus_set_cmn[2][1] "Freeze frame FRF_CUS_SET_CMN: environmental data common to all failure (not fixed by law) stored in set" UBYTE _CNV_A_R_LINEAR_____0_CM 1 100. 0. 255. DISPLAY_IDENTIFIER ENVD_CUS_SET_CMN_2_3_4 ECU_ADDRESS 0xd0009e0d FORMAT "%3.0" /end MEASUREMENT
/begin MEASUREMENT tbl_frf[4].envd_cus_set_cmn[2][2] "Freeze frame FRF_CUS_SET_CMN: environmental data common to all failure (not fixed by law) stored in set" UBYTE _CNV_A_R_LINEAR_____0_CM 1 100. 0. 255. DISPLAY_IDENTIFIER ENVD_CUS_SET_CMN_3_3_4 ECU_ADDRESS 0xd0009e0e FORMAT "%3.0" /end MEASUREMENT
/begin MEASUREMENT tbl_frf[4].envd_cus_set_cmn[2][3] "Freeze frame FRF_CUS_SET_CMN: environmental data common to all failure (not fixed by law) stored in set" UBYTE _CNV_A_R_LINEAR_____0_CM 1 100. 0. 255. DISPLAY_IDENTIFIER ENVD_CUS_SET_CMN_2_3_ ECU_ADDRESS 0xd0009e0f FORMAT "%3.0" /end MEASUREMENT
/begin MEASUREMENT tbl_frf[4].envd_cus_set_cmn[2][4] "Freeze frame FRF_CUS_SET_CMN: environmental data common to all failure (not fixed by law) stored in set" UBYTE _CNV_A_R_LINEAR_____0_CM 1 100. 0. 255. DISPLAY_IDENTIFIER ENVD_CUS_SET_CMN_2_4_ ECU_ADDRESS 0xd0009e10 FORMAT "%3.0" /end MEASUREMENT
/begin MEASUREMENT tbl_frf[4].envd_cus_set_cmn[2][5] "Freeze frame FRF_CUS_SET_CMN: environmental data common to all failure (not fixed by law) stored in set" UBYTE _CNV_A_R_LINEAR_____0_CM 1 100. 0. 255. DISPLAY_IDENTIFIER ENVD_CUS_SET_CMN_2_5_ ECU_ADDRESS 0xd0009e11 FORMAT "%3.0" /end MEASUREMENT
/begin MEASUREMENT tbl_frf[4].envd_cus_set_cmn[2][6] "Freeze frame FRF_CUS_SET_CMN: environmental data common to all failure (not fixed by law) stored in set" UBYTE _CNV_A_R_LINEAR_____0_CM 1 100. 0. 255. DISPLAY_IDENTIFIER ENVD_CUS_SET_CMN_2_6_ ECU_ADDRESS 0xd0009e12 FORMAT "%3.0" /end MEASUREMENT
/begin MEASUREMENT tbl_frf[4].envd_cus_set_cmn[2][7] "Freeze frame FRF_CUS_SET_CMN: environmental data common to all failure (not fixed by law) stored in set" UBYTE _CNV_A_R_LINEAR_____0_CM 1 100. 0. 255. DISPLAY_IDENTIFIER ENVD_CUS_SET_CMN_2_7_ ECU_ADDRESS 0xd0009e13 FORMAT "%3.0" /end MEASUREMENT
/begin MEASUREMENT tbl_frf[4].envd_cus_set_cmn[2][8] "Freeze frame FRF_CUS_SET_CMN: environmental data common to all failure (not fixed by law) stored in set" UBYTE _CNV_A_R_LINEAR_____0_CM 1 100. 0. 255. DISPLAY_IDENTIFIER ENVD_CUS_SET_CMN_2_8_ ECU_ADDRESS 0xd0009e14 FORMAT "%3.0" /end MEASUREMENT
/begin MEASUREMENT tbl_frf[4].envd_cus_set_cmn[2][9] "Freeze frame FRF_CUS_SET_CMN: environmental data common to all failure (not fixed by law) stored in set" UBYTE _CNV_A_R_LINEAR_____0_CM 1 100. 0. 255. DISPLAY_IDENTIFIER ENVD_CUS_SET_CMN_2_9_ ECU_ADDRESS 0xd0009e15 FORMAT "%3.0" /end MEASUREMENT
/begin MEASUREMENT tbl_frf[4].envd_cus_set_spc[0][0] "Freeze frame FRF_CUS_SET_SPC: environmental data specific to each failure (not fixed by law) stored in set" UBYTE _CNV_A_R_LINEAR_____0_CM 1 100. 0. 255. DISPLAY_IDENTIFIER ENVD_CUS_SET_SPC_1_1_4 ECU_ADDRESS 0xd0009e18 FORMAT "%3.0" /end MEASUREMENT
/begin MEASUREMENT tbl_frf[4].envd_cus_set_spc[0][1] "Freeze frame FRF_CUS_SET_SPC: environmental data specific to each failure (not fixed by law) stored in set" UBYTE _CNV_A_R_LINEAR_____0_CM 1 100. 0. 255. DISPLAY_IDENTIFIER ENVD_CUS_SET_SPC_2_1_4 ECU_ADDRESS 0xd0009e19 FORMAT "%3.0" /end MEASUREMENT
/begin MEASUREMENT tbl_frf[4].envd_cus_set_spc[0][2] "Freeze frame FRF_CUS_SET_SPC: environmental data specific to each failure (not fixed by law) stored in set" UBYTE _CNV_A_R_LINEAR_____0_CM 1 100. 0. 255. DISPLAY_IDENTIFIER ENVD_CUS_SET_SPC_3_1_4 ECU_ADDRESS 0xd0009e1a FORMAT "%3.0" /end MEASUREMENT
/begin MEASUREMENT tbl_frf[4].envd_cus_set_spc[0][3] "Freeze frame FRF_CUS_SET_SPC: environmental data specific to each failure (not fixed by law) stored in set" UBYTE _CNV_A_R_LINEAR_____0_CM 1 100. 0. 255. DISPLAY_IDENTIFIER ENVD_CUS_SET_SPC_4_1_4 ECU_ADDRESS 0xd0009e1b FORMAT "%3.0" /end MEASUREMENT
/begin MEASUREMENT tbl_frf[4].envd_cus_set_spc[1][0] "Freeze frame FRF_CUS_SET_SPC: environmental data specific to each failure (not fixed by law) stored in set" UBYTE _CNV_A_R_LINEAR_____0_CM 1 100. 0. 255. DISPLAY_IDENTIFIER ENVD_CUS_SET_SPC_1_2_4 ECU_ADDRESS 0xd0009e1c FORMAT "%3.0" /end MEASUREMENT
/begin MEASUREMENT tbl_frf[4].envd_cus_set_spc[1][1] "Freeze frame FRF_CUS_SET_SPC: environmental data specific to each failure (not fixed by law) stored in set" UBYTE _CNV_A_R_LINEAR_____0_CM 1 100. 0. 255. DISPLAY_IDENTIFIER ENVD_CUS_SET_SPC_2_2_4 ECU_ADDRESS 0xd0009e1d FORMAT "%3.0" /end MEASUREMENT
/begin MEASUREMENT tbl_frf[4].envd_cus_set_spc[1][2] "Freeze frame FRF_CUS_SET_SPC: environmental data specific to each failure (not fixed by law) stored in set" UBYTE _CNV_A_R_LINEAR_____0_CM 1 100. 0. 255. DISPLAY_IDENTIFIER ENVD_CUS_SET_SPC_3_2_4 ECU_ADDRESS 0xd0009e1e FORMAT "%3.0" /end MEASUREMENT
/begin MEASUREMENT tbl_frf[4].envd_cus_set_spc[1][3] "Freeze frame FRF_CUS_SET_SPC: environmental data specific to each failure (not fixed by law) stored in set" UBYTE _CNV_A_R_LINEAR_____0_CM 1 100. 0. 255. DISPLAY_IDENTIFIER ENVD_CUS_SET_SPC_4_2_4 ECU_ADDRESS 0xd0009e1f FORMAT "%3.0" /end MEASUREMENT
/begin MEASUREMENT tbl_frf[4].envd_cus_set_spc[2][0] "Freeze frame FRF_CUS_SET_SPC: environmental data specific to each failure (not fixed by law) stored in set" UBYTE _CNV_A_R_LINEAR_____0_CM 1 100. 0. 255. DISPLAY_IDENTIFIER ENVD_CUS_SET_SPC_1_3_4 ECU_ADDRESS 0xd0009e20 FORMAT "%3.0" /end MEASUREMENT
/begin MEASUREMENT tbl_frf[4].envd_cus_set_spc[2][1] "Freeze frame FRF_CUS_SET_SPC: environmental data specific to each failure (not fixed by law) stored in set" UBYTE _CNV_A_R_LINEAR_____0_CM 1 100. 0. 255. DISPLAY_IDENTIFIER ENVD_CUS_SET_SPC_2_3_4 ECU_ADDRESS 0xd0009e21 FORMAT "%3.0" /end MEASUREMENT
/begin MEASUREMENT tbl_frf[4].envd_cus_set_spc[2][2] "Freeze frame FRF_CUS_SET_SPC: environmental data specific to each failure (not fixed by law) stored in set" UBYTE _CNV_A_R_LINEAR_____0_CM 1 100. 0. 255. DISPLAY_IDENTIFIER ENVD_CUS_SET_SPC_3_3_4 ECU_ADDRESS 0xd0009e22 FORMAT "%3.0" /end MEASUREMENT
/begin MEASUREMENT tbl_frf[4].envd_cus_set_spc[2][3] "Freeze frame FRF_CUS_SET_SPC: environmental data specific to each failure (not fixed by law) stored in set" UBYTE _CNV_A_R_LINEAR_____0_CM 1 100. 0. 255. DISPLAY_IDENTIFIER ENVD_CUS_SET_SPC_4_3_4 ECU_ADDRESS 0xd0009e23 FORMAT "%3.0" /end MEASUREMENT
/begin MEASUREMENT tbl_frf[5].envd_obd[0] "Freeze frame FRF_OBD: environmental data (fixed by law)" UBYTE _CNV_A_R_LINEAR_____0_CM 1 100. 0. 255. DISPLAY_IDENTIFIER ENVD_OBD_1_5 ECU_ADDRESS 0xd0009e28 FORMAT "%3.0" /end MEASUREMENT
/begin MEASUREMENT tbl_frf[5].envd_obd[1] "Freeze frame FRF_OBD: environmental data (fixed by law)" UBYTE _CNV_A_R_LINEAR_____0_CM 1 100. 0. 255. DISPLAY_IDENTIFIER ENVD_OBD_2_5 ECU_ADDRESS 0xd0009e29 FORMAT "%3.0" /end MEASUREMENT
/begin MEASUREMENT tbl_frf[5].envd_obd[2] "Freeze frame FRF_OBD: environmental data (fixed by law)" UBYTE _CNV_A_R_LINEAR_____0_CM 1 100. 0. 255. DISPLAY_IDENTIFIER ENVD_OBD_3_5 ECU_ADDRESS 0xd0009e2a FORMAT "%3.0" /end MEASUREMENT
/begin MEASUREMENT tbl_frf[5].envd_obd[3] "Freeze frame FRF_OBD: environmental data (fixed by law)" UBYTE _CNV_A_R_LINEAR_____0_CM 1 100. 0. 255. DISPLAY_IDENTIFIER ENVD_OBD_4_5 ECU_ADDRESS 0xd0009e2b FORMAT "%3.0" /end MEASUREMENT
/begin MEASUREMENT tbl_frf[5].envd_obd[4] "Freeze frame FRF_OBD: environmental data (fixed by law)" UBYTE _CNV_A_R_LINEAR_____0_CM 1 100. 0. 255. DISPLAY_IDENTIFIER ENVD_OBD_5_5 ECU_ADDRESS 0xd0009e2c FORMAT "%3.0" /end MEASUREMENT
/begin MEASUREMENT tbl_frf[5].envd_obd[5] "Freeze frame FRF_OBD: environmental data (fixed by law)" UBYTE _CNV_A_R_LINEAR_____0_CM 1 100. 0. 255. DISPLAY_IDENTIFIER ENVD_OBD_6_5 ECU_ADDRESS 0xd0009e2d FORMAT "%3.0" /end MEASUREMENT
/begin MEASUREMENT tbl_frf[5].envd_obd[6] "Freeze frame FRF_OBD: environmental data (fixed by law)" UBYTE _CNV_A_R_LINEAR_____0_CM 1 100. 0. 255. DISPLAY_IDENTIFIER ENVD_OBD_7_5 ECU_ADDRESS 0xd0009e2e FORMAT "%3.0" /end MEASUREMENT
/begin MEASUREMENT tbl_frf[5].envd_obd[7] "Freeze frame FRF_OBD: environmental data (fixed by law)" UBYTE _CNV_A_R_LINEAR_____0_CM 1 100. 0. 255. DISPLAY_IDENTIFIER ENVD_OBD_8_5 ECU_ADDRESS 0xd0009e2f FORMAT "%3.0" /end MEASUREMENT
/begin MEASUREMENT dist_km_envd "Calculated KM counter (1Km resolution)" ULONG _CNV_A_R_LINEAR_____52_CM 1 100. 0. 16777215. DISPLAY_IDENTIFIER DIST_KM ECU_ADDRESS 0xd000ad7c FORMAT "%8.0" /end MEASUREMENT
/begin MEASUREMENT state_ready_obd_1 "Readiness code completion status 1" UBYTE _CNV_A_R_LINEAR_____0_CM 1 100. 0. 255. DISPLAY_IDENTIFIER STATE_READY_OBD_1 ECU_ADDRESS 0xd0008138 FORMAT "%3.0" /end MEASUREMENT
/begin MEASUREMENT state_ready_obd_2 "Readiness code completion status 2" UBYTE _CNV_A_R_LINEAR_____0_CM 1 100. 0. 255. DISPLAY_IDENTIFIER STATE_READY_OBD_2 ECU_ADDRESS 0xd0008139 FORMAT "%3.0" /end MEASUREMENT
/begin MEASUREMENT state_ready_obd_3 "Readiness code completion status 3" UBYTE _CNV_A_R_LINEAR_____0_CM 1 100. 0. 255. DISPLAY_IDENTIFIER STATE_READY_OBD_3 ECU_ADDRESS 0xd000813a FORMAT "%3.0" /end MEASUREMENT
/begin MEASUREMENT fmy_scdn_equ_fsd_1.n_min_scdn_equ "minimal engine speed of similar conditions window (2nd)" UWORD _CNV_A_R_LINEAR_____14_CM 1 100. 0. 8160. DISPLAY_IDENTIFIER N_MIN_SCDN_EQU_FSD_1 ECU_ADDRESS 0xd0006754 FORMAT "%4.0" /end MEASUREMENT
/begin MEASUREMENT fmy_scdn_equ_fsd_1.n_max_scdn_equ "maximal engine speed of similar conditions window (2nd)" UWORD _CNV_A_R_LINEAR_____14_CM 1 100. 0. 8160. DISPLAY_IDENTIFIER N_MAX_SCDN_EQU_FSD_1 ECU_ADDRESS 0xd0006756 FORMAT "%4.0" /end MEASUREMENT
/begin MEASUREMENT fmy_scdn_equ_fsd_1.ctr_scdn_equ_dc "Counter of non-occurence of similar condition" UBYTE _CNV_A_R_LINEAR_____0_CM 1 100. 0. 255. DISPLAY_IDENTIFIER CTR_SCDN_EQU_DC_FSD_1 ECU_ADDRESS 0xd0006758 FORMAT "%3.0" /end MEASUREMENT
/begin MEASUREMENT fmy_scdn_equ_fsd_1.state_scdn "see specification for description." UBYTE _CNV_A_R_LINEAR_____0_CM 1 100. 0. 63. DISPLAY_IDENTIFIER STATE_SCDN_FSD_1 ECU_ADDRESS 0xd0006759 FORMAT "%3.0" /end MEASUREMENT
/begin MEASUREMENT fmy_scdn_equ_fsd_1.load_min_scdn_equ "minimal load of similar conditions window (2nd)" UBYTE _CNV_A_R_LINEAR_____5_CM 1 100. 0. 99.609375 DISPLAY_IDENTIFIER LOAD_MIN_SCDN_EQU_FSD_1 ECU_ADDRESS 0xd000675a FORMAT "%9.6" /end MEASUREMENT
/begin MEASUREMENT fmy_scdn_equ_fsd_1.load_max_scdn_equ "maximal load of similar conditions window (2nd)" UBYTE _CNV_A_R_LINEAR_____5_CM 1 100. 0. 99.609375 DISPLAY_IDENTIFIER LOAD_MAX_SCDN_EQU_FSD_1 ECU_ADDRESS 0xd000675b FORMAT "%9.6" /end MEASUREMENT
/begin MEASUREMENT fmy_scdn_equ_fsd_1.ctr_scdn_equ "Number of times N/LOAD is within SCDN window" UWORD _CNV_A_R_LINEAR_____0_CM 1 100. 0. 65535. DISPLAY_IDENTIFIER CTR_SCDN_EQU_FSD_1 ECU_ADDRESS 0xd000675c FORMAT "%5.0" /end MEASUREMENT
/begin MEASUREMENT fmy_scdn_equ_fsd_1.ctr_scdn_sum "Number of times the diagnosis conditions are set" UWORD _CNV_A_R_LINEAR_____0_CM 1 100. 0. 65535. DISPLAY_IDENTIFIER CTR_SCDN_SUM_FSD_1 ECU_ADDRESS 0xd000675e FORMAT "%5.0" /end MEASUREMENT
/begin MEASUREMENT fmy_scdn_equ_fsd_1.lv_wup_scdn_equ "Warm-up status for similar conditions for OBDII continuous error XX" UBYTE _CNV_S_2_RANGE__0___1_CM 1 100. 0. 1. DISPLAY_IDENTIFIER LV_WUP_SCDN_EQU_FSD_1 ECU_ADDRESS 0xd0006760 /end MEASUREMENT
/begin MEASUREMENT fmy_scdn_equ_fsd_2.n_min_scdn_equ "minimal engine speed of similar conditions window (2nd)" UWORD _CNV_A_R_LINEAR_____14_CM 1 100. 0. 8160. DISPLAY_IDENTIFIER N_MIN_SCDN_EQU_FSD_2 ECU_ADDRESS 0xd0006764 FORMAT "%4.0" /end MEASUREMENT
/begin MEASUREMENT fmy_scdn_equ_fsd_2.n_max_scdn_equ "maximal engine speed of similar conditions window (2nd)" UWORD _CNV_A_R_LINEAR_____14_CM 1 100. 0. 8160. DISPLAY_IDENTIFIER N_MAX_SCDN_EQU_FSD_2 ECU_ADDRESS 0xd0006766 FORMAT "%4.0" /end MEASUREMENT
/begin MEASUREMENT fmy_scdn_equ_fsd_2.ctr_scdn_equ_dc "Counter of non-occurence of similar condition" UBYTE _CNV_A_R_LINEAR_____0_CM 1 100. 0. 255. DISPLAY_IDENTIFIER CTR_SCDN_EQU_DC_FSD_2 ECU_ADDRESS 0xd0006768 FORMAT "%3.0" /end MEASUREMENT
/begin MEASUREMENT fmy_scdn_equ_fsd_2.state_scdn "see specification for description." UBYTE _CNV_A_R_LINEAR_____0_CM 1 100. 0. 63. DISPLAY_IDENTIFIER STATE_SCDN_FSD_2 ECU_ADDRESS 0xd0006769 FORMAT "%3.0" /end MEASUREMENT
/begin MEASUREMENT fmy_scdn_equ_fsd_2.load_min_scdn_equ "minimal load of similar conditions window (2nd)" UBYTE _CNV_A_R_LINEAR_____5_CM 1 100. 0. 99.609375 DISPLAY_IDENTIFIER LOAD_MIN_SCDN_EQU_FSD_2 ECU_ADDRESS 0xd000676a FORMAT "%9.6" /end MEASUREMENT
/begin MEASUREMENT fmy_scdn_equ_fsd_2.load_max_scdn_equ "maximal load of similar conditions window (2nd)" UBYTE _CNV_A_R_LINEAR_____5_CM 1 100. 0. 99.609375 DISPLAY_IDENTIFIER LOAD_MAX_SCDN_EQU_FSD_2 ECU_ADDRESS 0xd000676b FORMAT "%9.6" /end MEASUREMENT
/begin MEASUREMENT fmy_scdn_equ_fsd_2.ctr_scdn_equ "Number of times N/LOAD is within SCDN window" UWORD _CNV_A_R_LINEAR_____0_CM 1 100. 0. 65535. DISPLAY_IDENTIFIER CTR_SCDN_EQU_FSD_2 ECU_ADDRESS 0xd000676c FORMAT "%5.0" /end MEASUREMENT
/begin MEASUREMENT fmy_scdn_equ_fsd_2.ctr_scdn_sum "Number of times the diagnosis conditions are set" UWORD _CNV_A_R_LINEAR_____0_CM 1 100. 0. 65535. DISPLAY_IDENTIFIER CTR_SCDN_SUM_FSD_2 ECU_ADDRESS 0xd000676e FORMAT "%5.0" /end MEASUREMENT
/begin MEASUREMENT fmy_scdn_equ_fsd_2.lv_wup_scdn_equ "Warm-up status for similar conditions for OBDII continuous error XX" UBYTE _CNV_S_2_RANGE__0___1_CM 1 100. 0. 1. DISPLAY_IDENTIFIER LV_WUP_SCDN_EQU_FSD_2 ECU_ADDRESS 0xd0006770 /end MEASUREMENT
/begin MEASUREMENT fmy_scdn_equ_fsd_lam_lim_1.n_min_scdn_equ "minimal engine speed of similar conditions window (2nd)" UWORD _CNV_A_R_LINEAR_____14_CM 1 100. 0. 8160. DISPLAY_IDENTIFIER N_MIN_SCDN_EQU_FSD_LAM_LIM_1 ECU_ADDRESS 0xd0006774 FORMAT "%4.0" /end MEASUREMENT
/begin MEASUREMENT fmy_scdn_equ_fsd_lam_lim_1.n_max_scdn_equ "maximal engine speed of similar conditions window (2nd)" UWORD _CNV_A_R_LINEAR_____14_CM 1 100. 0. 8160. DISPLAY_IDENTIFIER N_MAX_SCDN_EQU_FSD_LAM_LIM_1 ECU_ADDRESS 0xd0006776 FORMAT "%4.0" /end MEASUREMENT
/begin MEASUREMENT fmy_scdn_equ_fsd_lam_lim_1.ctr_scdn_equ_dc "Counter of non-occurence of similar condition" UBYTE _CNV_A_R_LINEAR_____0_CM 1 100. 0. 255. DISPLAY_IDENTIFIER CTR_SCDN_EQU_DC_FSD_LAM_LIM_1 ECU_ADDRESS 0xd0006778 FORMAT "%3.0" /end MEASUREMENT
/begin MEASUREMENT fmy_scdn_equ_fsd_lam_lim_1.state_scdn "see specification for description." UBYTE _CNV_A_R_LINEAR_____0_CM 1 100. 0. 63. DISPLAY_IDENTIFIER STATE_SCDN_FSD_LAM_LIM_1 ECU_ADDRESS 0xd0006779 FORMAT "%3.0" /end MEASUREMENT
/begin MEASUREMENT fmy_scdn_equ_fsd_lam_lim_1.load_min_scdn_equ "minimal load of similar conditions window (2nd)" UBYTE _CNV_A_R_LINEAR_____5_CM 1 100. 0. 99.609375 DISPLAY_IDENTIFIER LOAD_MIN_SCDN_EQU_FSD_LAM_LIM_1 ECU_ADDRESS 0xd000677a FORMAT "%9.6" /end MEASUREMENT
/begin MEASUREMENT fmy_scdn_equ_fsd_lam_lim_1.load_max_scdn_equ "maximal load of similar conditions window (2nd)" UBYTE _CNV_A_R_LINEAR_____5_CM 1 100. 0. 99.609375 DISPLAY_IDENTIFIER LOAD_MAX_SCDN_EQU_FSD_LAM_LIM_1 ECU_ADDRESS 0xd000677b FORMAT "%9.6" /end MEASUREMENT
/begin MEASUREMENT fmy_scdn_equ_fsd_lam_lim_1.ctr_scdn_equ "Number of times N/LOAD is within SCDN window" UWORD _CNV_A_R_LINEAR_____0_CM 1 100. 0. 65535. DISPLAY_IDENTIFIER CTR_SCDN_EQU_FSD_LAM_LIM_1 ECU_ADDRESS 0xd000677c FORMAT "%5.0" /end MEASUREMENT
/begin MEASUREMENT fmy_scdn_equ_fsd_lam_lim_1.ctr_scdn_sum "Number of times the diagnosis conditions are set" UWORD _CNV_A_R_LINEAR_____0_CM 1 100. 0. 65535. DISPLAY_IDENTIFIER CTR_SCDN_SUM_FSD_LAM_LIM_1 ECU_ADDRESS 0xd000677e FORMAT "%5.0" /end MEASUREMENT
/begin MEASUREMENT fmy_scdn_equ_fsd_lam_lim_1.lv_wup_scdn_equ "Warm-up status for similar conditions for OBDII continuous error XX" UBYTE _CNV_S_2_RANGE__0___1_CM 1 100. 0. 1. DISPLAY_IDENTIFIER LV_WUP_SCDN_EQU_FSD_LAM_LIM_1 ECU_ADDRESS 0xd0006780 /end MEASUREMENT
/begin MEASUREMENT fmy_scdn_equ_fsd_lam_lim_2.n_min_scdn_equ "minimal engine speed of similar conditions window (2nd)" UWORD _CNV_A_R_LINEAR_____14_CM 1 100. 0. 8160. DISPLAY_IDENTIFIER N_MIN_SCDN_EQU_FSD_LAM_LIM_2 ECU_ADDRESS 0xd0006784 FORMAT "%4.0" /end MEASUREMENT
/begin MEASUREMENT fmy_scdn_equ_fsd_lam_lim_2.n_max_scdn_equ "maximal engine speed of similar conditions window (2nd)" UWORD _CNV_A_R_LINEAR_____14_CM 1 100. 0. 8160. DISPLAY_IDENTIFIER N_MAX_SCDN_EQU_FSD_LAM_LIM_2 ECU_ADDRESS 0xd0006786 FORMAT "%4.0" /end MEASUREMENT
/begin MEASUREMENT fmy_scdn_equ_fsd_lam_lim_2.ctr_scdn_equ_dc "Counter of non-occurence of similar condition" UBYTE _CNV_A_R_LINEAR_____0_CM 1 100. 0. 255. DISPLAY_IDENTIFIER CTR_SCDN_EQU_DC_FSD_LAM_LIM_2 ECU_ADDRESS 0xd0006788 FORMAT "%3.0" /end MEASUREMENT
/begin MEASUREMENT fmy_scdn_equ_fsd_lam_lim_2.state_scdn "see specification for description." UBYTE _CNV_A_R_LINEAR_____0_CM 1 100. 0. 63. DISPLAY_IDENTIFIER STATE_SCDN_FSD_LAM_LIM_2 ECU_ADDRESS 0xd0006789 FORMAT "%3.0" /end MEASUREMENT
/begin MEASUREMENT fmy_scdn_equ_fsd_lam_lim_2.load_min_scdn_equ "minimal load of similar conditions window (2nd)" UBYTE _CNV_A_R_LINEAR_____5_CM 1 100. 0. 99.609375 DISPLAY_IDENTIFIER LOAD_MIN_SCDN_EQU_FSD_LAM_LIM_2 ECU_ADDRESS 0xd000678a FORMAT "%9.6" /end MEASUREMENT
/begin MEASUREMENT fmy_scdn_equ_fsd_lam_lim_2.load_max_scdn_equ "maximal load of similar conditions window (2nd)" UBYTE _CNV_A_R_LINEAR_____5_CM 1 100. 0. 99.609375 DISPLAY_IDENTIFIER LOAD_MAX_SCDN_EQU_FSD_LAM_LIM_2 ECU_ADDRESS 0xd000678b FORMAT "%9.6" /end MEASUREMENT
/begin MEASUREMENT fmy_scdn_equ_fsd_lam_lim_2.ctr_scdn_equ "Number of times N/LOAD is within SCDN window" UWORD _CNV_A_R_LINEAR_____0_CM 1 100. 0. 65535. DISPLAY_IDENTIFIER CTR_SCDN_EQU_FSD_LAM_LIM_2 ECU_ADDRESS 0xd000678c FORMAT "%5.0" /end MEASUREMENT
/begin MEASUREMENT fmy_scdn_equ_fsd_lam_lim_2.ctr_scdn_sum "Number of times the diagnosis conditions are set" UWORD _CNV_A_R_LINEAR_____0_CM 1 100. 0. 65535. DISPLAY_IDENTIFIER CTR_SCDN_SUM_FSD_LAM_LIM_2 ECU_ADDRESS 0xd000678e FORMAT "%5.0" /end MEASUREMENT
/begin MEASUREMENT fmy_scdn_equ_fsd_lam_lim_2.lv_wup_scdn_equ "Warm-up status for similar conditions for OBDII continuous error XX" UBYTE _CNV_S_2_RANGE__0___1_CM 1 100. 0. 1. DISPLAY_IDENTIFIER LV_WUP_SCDN_EQU_FSD_LAM_LIM_2 ECU_ADDRESS 0xd0006790 /end MEASUREMENT
/begin MEASUREMENT fmy_scdn_equ_mis_0.n_min_scdn_equ "minimal engine speed of similar conditions window (2nd)" UWORD _CNV_A_R_LINEAR_____14_CM 1 100. 0. 8160. DISPLAY_IDENTIFIER N_MIN_SCDN_EQU_MIS_0 ECU_ADDRESS 0xd0006794 FORMAT "%4.0" /end MEASUREMENT
/begin MEASUREMENT fmy_scdn_equ_mis_0.n_max_scdn_equ "maximal engine speed of similar conditions window (2nd)" UWORD _CNV_A_R_LINEAR_____14_CM 1 100. 0. 8160. DISPLAY_IDENTIFIER N_MAX_SCDN_EQU_MIS_0 ECU_ADDRESS 0xd0006796 FORMAT "%4.0" /end MEASUREMENT
/begin MEASUREMENT fmy_scdn_equ_mis_0.ctr_scdn_equ_dc "Counter of non-occurence of similar condition" UBYTE _CNV_A_R_LINEAR_____0_CM 1 100. 0. 255. DISPLAY_IDENTIFIER CTR_SCDN_EQU_DC_MIS_0 ECU_ADDRESS 0xd0006798 FORMAT "%3.0" /end MEASUREMENT
/begin MEASUREMENT fmy_scdn_equ_mis_0.state_scdn "see specification for description." UBYTE _CNV_A_R_LINEAR_____0_CM 1 100. 0. 63. DISPLAY_IDENTIFIER STATE_SCDN_MIS_0 ECU_ADDRESS 0xd0006799 FORMAT "%3.0" /end MEASUREMENT
/begin MEASUREMENT fmy_scdn_equ_mis_0.load_min_scdn_equ "minimal load of similar conditions window (2nd)" UBYTE _CNV_A_R_LINEAR_____5_CM 1 100. 0. 99.609375 DISPLAY_IDENTIFIER LOAD_MIN_SCDN_EQU_MIS_0 ECU_ADDRESS 0xd000679a FORMAT "%9.6" /end MEASUREMENT
/begin MEASUREMENT fmy_scdn_equ_mis_0.load_max_scdn_equ "maximal load of similar conditions window (2nd)" UBYTE _CNV_A_R_LINEAR_____5_CM 1 100. 0. 99.609375 DISPLAY_IDENTIFIER LOAD_MAX_SCDN_EQU_MIS_0 ECU_ADDRESS 0xd000679b FORMAT "%9.6" /end MEASUREMENT
/begin MEASUREMENT fmy_scdn_equ_mis_0.ctr_scdn_equ "Number of times N/LOAD is within SCDN window" UWORD _CNV_A_R_LINEAR_____0_CM 1 100. 0. 65535. DISPLAY_IDENTIFIER CTR_SCDN_EQU_MIS_0 ECU_ADDRESS 0xd000679c FORMAT "%5.0" /end MEASUREMENT
/begin MEASUREMENT fmy_scdn_equ_mis_0.ctr_scdn_sum "Number of times the diagnosis conditions are set" UWORD _CNV_A_R_LINEAR_____0_CM 1 100. 0. 65535. DISPLAY_IDENTIFIER CTR_SCDN_SUM_MIS_0 ECU_ADDRESS 0xd000679e FORMAT "%5.0" /end MEASUREMENT
/begin MEASUREMENT fmy_scdn_equ_mis_0.lv_wup_scdn_equ "Warm-up status for similar conditions for OBDII continuous error XX" UBYTE _CNV_S_2_RANGE__0___1_CM 1 100. 0. 1. DISPLAY_IDENTIFIER LV_WUP_SCDN_EQU_MIS_0 ECU_ADDRESS 0xd00067a0 /end MEASUREMENT
/begin MEASUREMENT fmy_scdn_equ_mis_1.n_min_scdn_equ "minimal engine speed of similar conditions window (2nd)" UWORD _CNV_A_R_LINEAR_____14_CM 1 100. 0. 8160. DISPLAY_IDENTIFIER N_MIN_SCDN_EQU_MIS_1 ECU_ADDRESS 0xd00067a4 FORMAT "%4.0" /end MEASUREMENT
/begin MEASUREMENT fmy_scdn_equ_mis_1.n_max_scdn_equ "maximal engine speed of similar conditions window (2nd)" UWORD _CNV_A_R_LINEAR_____14_CM 1 100. 0. 8160. DISPLAY_IDENTIFIER N_MAX_SCDN_EQU_MIS_1 ECU_ADDRESS 0xd00067a6 FORMAT "%4.0" /end MEASUREMENT
/begin MEASUREMENT fmy_scdn_equ_mis_1.ctr_scdn_equ_dc "Counter of non-occurence of similar condition" UBYTE _CNV_A_R_LINEAR_____0_CM 1 100. 0. 255. DISPLAY_IDENTIFIER CTR_SCDN_EQU_DC_MIS_1 ECU_ADDRESS 0xd00067a8 FORMAT "%3.0" /end MEASUREMENT
/begin MEASUREMENT fmy_scdn_equ_mis_1.state_scdn "see specification for description." UBYTE _CNV_A_R_LINEAR_____0_CM 1 100. 0. 63. DISPLAY_IDENTIFIER STATE_SCDN_MIS_1 ECU_ADDRESS 0xd00067a9 FORMAT "%3.0" /end MEASUREMENT
/begin MEASUREMENT fmy_scdn_equ_mis_1.load_min_scdn_equ "minimal load of similar conditions window (2nd)" UBYTE _CNV_A_R_LINEAR_____5_CM 1 100. 0. 99.609375 DISPLAY_IDENTIFIER LOAD_MIN_SCDN_EQU_MIS_1 ECU_ADDRESS 0xd00067aa FORMAT "%9.6" /end MEASUREMENT
/begin MEASUREMENT fmy_scdn_equ_mis_1.load_max_scdn_equ "maximal load of similar conditions window (2nd)" UBYTE _CNV_A_R_LINEAR_____5_CM 1 100. 0. 99.609375 DISPLAY_IDENTIFIER LOAD_MAX_SCDN_EQU_MIS_1 ECU_ADDRESS 0xd00067ab FORMAT "%9.6" /end MEASUREMENT
/begin MEASUREMENT fmy_scdn_equ_mis_1.ctr_scdn_equ "Number of times N/LOAD is within SCDN window" UWORD _CNV_A_R_LINEAR_____0_CM 1 100. 0. 65535. DISPLAY_IDENTIFIER CTR_SCDN_EQU_MIS_1 ECU_ADDRESS 0xd00067ac FORMAT "%5.0" /end MEASUREMENT
/begin MEASUREMENT fmy_scdn_equ_mis_1.ctr_scdn_sum "Number of times the diagnosis conditions are set" UWORD _CNV_A_R_LINEAR_____0_CM 1 100. 0. 65535. DISPLAY_IDENTIFIER CTR_SCDN_SUM_MIS_1 ECU_ADDRESS 0xd00067ae FORMAT "%5.0" /end MEASUREMENT
/begin MEASUREMENT fmy_scdn_equ_mis_1.lv_wup_scdn_equ "Warm-up status for similar conditions for OBDII continuous error XX" UBYTE _CNV_S_2_RANGE__0___1_CM 1 100. 0. 1. DISPLAY_IDENTIFIER LV_WUP_SCDN_EQU_MIS_1 ECU_ADDRESS 0xd00067b0 /end MEASUREMENT
/begin MEASUREMENT fmy_scdn_equ_mis_2.n_min_scdn_equ "minimal engine speed of similar conditions window (2nd)" UWORD _CNV_A_R_LINEAR_____14_CM 1 100. 0. 8160. DISPLAY_IDENTIFIER N_MIN_SCDN_EQU_MIS_2 ECU_ADDRESS 0xd00067b4 FORMAT "%4.0" /end MEASUREMENT
/begin MEASUREMENT fmy_scdn_equ_mis_2.n_max_scdn_equ "maximal engine speed of similar conditions window (2nd)" UWORD _CNV_A_R_LINEAR_____14_CM 1 100. 0. 8160. DISPLAY_IDENTIFIER N_MAX_SCDN_EQU_MIS_2 ECU_ADDRESS 0xd00067b6 FORMAT "%4.0" /end MEASUREMENT
/begin MEASUREMENT fmy_scdn_equ_mis_2.ctr_scdn_equ_dc "Counter of non-occurence of similar condition" UBYTE _CNV_A_R_LINEAR_____0_CM 1 100. 0. 255. DISPLAY_IDENTIFIER CTR_SCDN_EQU_DC_MIS_2 ECU_ADDRESS 0xd00067b8 FORMAT "%3.0" /end MEASUREMENT
/begin MEASUREMENT fmy_scdn_equ_mis_2.state_scdn "see specification for description." UBYTE _CNV_A_R_LINEAR_____0_CM 1 100. 0. 63. DISPLAY_IDENTIFIER STATE_SCDN_MIS_2 ECU_ADDRESS 0xd00067b9 FORMAT "%3.0" /end MEASUREMENT
/begin MEASUREMENT fmy_scdn_equ_mis_2.load_min_scdn_equ "minimal load of similar conditions window (2nd)" UBYTE _CNV_A_R_LINEAR_____5_CM 1 100. 0. 99.609375 DISPLAY_IDENTIFIER LOAD_MIN_SCDN_EQU_MIS_2 ECU_ADDRESS 0xd00067ba FORMAT "%9.6" /end MEASUREMENT
/begin MEASUREMENT fmy_scdn_equ_mis_2.load_max_scdn_equ "maximal load of similar conditions window (2nd)" UBYTE _CNV_A_R_LINEAR_____5_CM 1 100. 0. 99.609375 DISPLAY_IDENTIFIER LOAD_MAX_SCDN_EQU_MIS_2 ECU_ADDRESS 0xd00067bb FORMAT "%9.6" /end MEASUREMENT
/begin MEASUREMENT fmy_scdn_equ_mis_2.ctr_scdn_equ "Number of times N/LOAD is within SCDN window" UWORD _CNV_A_R_LINEAR_____0_CM 1 100. 0. 65535. DISPLAY_IDENTIFIER CTR_SCDN_EQU_MIS_2 ECU_ADDRESS 0xd00067bc FORMAT "%5.0" /end MEASUREMENT
/begin MEASUREMENT fmy_scdn_equ_mis_2.ctr_scdn_sum "Number of times the diagnosis conditions are set" UWORD _CNV_A_R_LINEAR_____0_CM 1 100. 0. 65535. DISPLAY_IDENTIFIER CTR_SCDN_SUM_MIS_2 ECU_ADDRESS 0xd00067be FORMAT "%5.0" /end MEASUREMENT
/begin MEASUREMENT fmy_scdn_equ_mis_2.lv_wup_scdn_equ "Warm-up status for similar conditions for OBDII continuous error XX" UBYTE _CNV_S_2_RANGE__0___1_CM 1 100. 0. 1. DISPLAY_IDENTIFIER LV_WUP_SCDN_EQU_MIS_2 ECU_ADDRESS 0xd00067c0 /end MEASUREMENT
/begin MEASUREMENT fmy_scdn_equ_mis_3.n_min_scdn_equ "minimal engine speed of similar conditions window (2nd)" UWORD _CNV_A_R_LINEAR_____14_CM 1 100. 0. 8160. DISPLAY_IDENTIFIER N_MIN_SCDN_EQU_MIS_3 ECU_ADDRESS 0xd00067c4 FORMAT "%4.0" /end MEASUREMENT
/begin MEASUREMENT fmy_scdn_equ_mis_3.n_max_scdn_equ "maximal engine speed of similar conditions window (2nd)" UWORD _CNV_A_R_LINEAR_____14_CM 1 100. 0. 8160. DISPLAY_IDENTIFIER N_MAX_SCDN_EQU_MIS_3 ECU_ADDRESS 0xd00067c6 FORMAT "%4.0" /end MEASUREMENT
/begin MEASUREMENT fmy_scdn_equ_mis_3.ctr_scdn_equ_dc "Counter of non-occurence of similar condition" UBYTE _CNV_A_R_LINEAR_____0_CM 1 100. 0. 255. DISPLAY_IDENTIFIER CTR_SCDN_EQU_DC_MIS_3 ECU_ADDRESS 0xd00067c8 FORMAT "%3.0" /end MEASUREMENT
/begin MEASUREMENT fmy_scdn_equ_mis_3.state_scdn "see specification for description." UBYTE _CNV_A_R_LINEAR_____0_CM 1 100. 0. 63. DISPLAY_IDENTIFIER STATE_SCDN_MIS_3 ECU_ADDRESS 0xd00067c9 FORMAT "%3.0" /end MEASUREMENT
/begin MEASUREMENT fmy_scdn_equ_mis_3.load_min_scdn_equ "minimal load of similar conditions window (2nd)" UBYTE _CNV_A_R_LINEAR_____5_CM 1 100. 0. 99.609375 DISPLAY_IDENTIFIER LOAD_MIN_SCDN_EQU_MIS_3 ECU_ADDRESS 0xd00067ca FORMAT "%9.6" /end MEASUREMENT
/begin MEASUREMENT fmy_scdn_equ_mis_3.load_max_scdn_equ "maximal load of similar conditions window (2nd)" UBYTE _CNV_A_R_LINEAR_____5_CM 1 100. 0. 99.609375 DISPLAY_IDENTIFIER LOAD_MAX_SCDN_EQU_MIS_3 ECU_ADDRESS 0xd00067cb FORMAT "%9.6" /end MEASUREMENT
/begin MEASUREMENT fmy_scdn_equ_mis_3.ctr_scdn_equ "Number of times N/LOAD is within SCDN window" UWORD _CNV_A_R_LINEAR_____0_CM 1 100. 0. 65535. DISPLAY_IDENTIFIER CTR_SCDN_EQU_MIS_3 ECU_ADDRESS 0xd00067cc FORMAT "%5.0" /end MEASUREMENT
/begin MEASUREMENT fmy_scdn_equ_mis_3.ctr_scdn_sum "Number of times the diagnosis conditions are set" UWORD _CNV_A_R_LINEAR_____0_CM 1 100. 0. 65535. DISPLAY_IDENTIFIER CTR_SCDN_SUM_MIS_3 ECU_ADDRESS 0xd00067ce FORMAT "%5.0" /end MEASUREMENT
/begin MEASUREMENT fmy_scdn_equ_mis_3.lv_wup_scdn_equ "Warm-up status for similar conditions for OBDII continuous error XX" UBYTE _CNV_S_2_RANGE__0___1_CM 1 100. 0. 1. DISPLAY_IDENTIFIER LV_WUP_SCDN_EQU_MIS_3 ECU_ADDRESS 0xd00067d0 /end MEASUREMENT
/begin MEASUREMENT fmy_scdn_equ_mis_4.n_min_scdn_equ "minimal engine speed of similar conditions window (2nd)" UWORD _CNV_A_R_LINEAR_____14_CM 1 100. 0. 8160. DISPLAY_IDENTIFIER N_MIN_SCDN_EQU_MIS_4 ECU_ADDRESS 0xd00067d4 FORMAT "%4.0" /end MEASUREMENT
/begin MEASUREMENT fmy_scdn_equ_mis_4.n_max_scdn_equ "maximal engine speed of similar conditions window (2nd)" UWORD _CNV_A_R_LINEAR_____14_CM 1 100. 0. 8160. DISPLAY_IDENTIFIER N_MAX_SCDN_EQU_MIS_4 ECU_ADDRESS 0xd00067d6 FORMAT "%4.0" /end MEASUREMENT
/begin MEASUREMENT fmy_scdn_equ_mis_4.ctr_scdn_equ_dc "Counter of non-occurence of similar condition" UBYTE _CNV_A_R_LINEAR_____0_CM 1 100. 0. 255. DISPLAY_IDENTIFIER CTR_SCDN_EQU_DC_MIS_4 ECU_ADDRESS 0xd00067d8 FORMAT "%3.0" /end MEASUREMENT
/begin MEASUREMENT fmy_scdn_equ_mis_4.state_scdn "see specification for description." UBYTE _CNV_A_R_LINEAR_____0_CM 1 100. 0. 63. DISPLAY_IDENTIFIER STATE_SCDN_MIS_4 ECU_ADDRESS 0xd00067d9 FORMAT "%3.0" /end MEASUREMENT
/begin MEASUREMENT fmy_scdn_equ_mis_4.load_min_scdn_equ "minimal load of similar conditions window (2nd)" UBYTE _CNV_A_R_LINEAR_____5_CM 1 100. 0. 99.609375 DISPLAY_IDENTIFIER LOAD_MIN_SCDN_EQU_MIS_4 ECU_ADDRESS 0xd00067da FORMAT "%9.6" /end MEASUREMENT
/begin MEASUREMENT fmy_scdn_equ_mis_4.load_max_scdn_equ "maximal load of similar conditions window (2nd)" UBYTE _CNV_A_R_LINEAR_____5_CM 1 100. 0. 99.609375 DISPLAY_IDENTIFIER LOAD_MAX_SCDN_EQU_MIS_4 ECU_ADDRESS 0xd00067db FORMAT "%9.6" /end MEASUREMENT
/begin MEASUREMENT fmy_scdn_equ_mis_4.ctr_scdn_equ "Number of times N/LOAD is within SCDN window" UWORD _CNV_A_R_LINEAR_____0_CM 1 100. 0. 65535. DISPLAY_IDENTIFIER CTR_SCDN_EQU_MIS_4 ECU_ADDRESS 0xd00067dc FORMAT "%5.0" /end MEASUREMENT
/begin MEASUREMENT fmy_scdn_equ_mis_4.ctr_scdn_sum "Number of times the diagnosis conditions are set" UWORD _CNV_A_R_LINEAR_____0_CM 1 100. 0. 65535. DISPLAY_IDENTIFIER CTR_SCDN_SUM_MIS_4 ECU_ADDRESS 0xd00067de FORMAT "%5.0" /end MEASUREMENT
/begin MEASUREMENT fmy_scdn_equ_mis_4.lv_wup_scdn_equ "Warm-up status for similar conditions for OBDII continuous error XX" UBYTE _CNV_S_2_RANGE__0___1_CM 1 100. 0. 1. DISPLAY_IDENTIFIER LV_WUP_SCDN_EQU_MIS_4 ECU_ADDRESS 0xd00067e0 /end MEASUREMENT
/begin MEASUREMENT fmy_scdn_equ_mis_5.n_min_scdn_equ "minimal engine speed of similar conditions window (2nd)" UWORD _CNV_A_R_LINEAR_____14_CM 1 100. 0. 8160. DISPLAY_IDENTIFIER N_MIN_SCDN_EQU_MIS_5 ECU_ADDRESS 0xd00067e4 FORMAT "%4.0" /end MEASUREMENT
/begin MEASUREMENT fmy_scdn_equ_mis_5.n_max_scdn_equ "maximal engine speed of similar conditions window (2nd)" UWORD _CNV_A_R_LINEAR_____14_CM 1 100. 0. 8160. DISPLAY_IDENTIFIER N_MAX_SCDN_EQU_MIS_5 ECU_ADDRESS 0xd00067e6 FORMAT "%4.0" /end MEASUREMENT
/begin MEASUREMENT fmy_scdn_equ_mis_5.ctr_scdn_equ_dc "Counter of non-occurence of similar condition" UBYTE _CNV_A_R_LINEAR_____0_CM 1 100. 0. 255. DISPLAY_IDENTIFIER CTR_SCDN_EQU_DC_MIS_5 ECU_ADDRESS 0xd00067e8 FORMAT "%3.0" /end MEASUREMENT
/begin MEASUREMENT fmy_scdn_equ_mis_5.state_scdn "see specification for description." UBYTE _CNV_A_R_LINEAR_____0_CM 1 100. 0. 63. DISPLAY_IDENTIFIER STATE_SCDN_MIS_5 ECU_ADDRESS 0xd00067e9 FORMAT "%3.0" /end MEASUREMENT
/begin MEASUREMENT fmy_scdn_equ_mis_5.load_min_scdn_equ "minimal load of similar conditions window (2nd)" UBYTE _CNV_A_R_LINEAR_____5_CM 1 100. 0. 99.609375 DISPLAY_IDENTIFIER LOAD_MIN_SCDN_EQU_MIS_5 ECU_ADDRESS 0xd00067ea FORMAT "%9.6" /end MEASUREMENT
/begin MEASUREMENT fmy_scdn_equ_mis_5.load_max_scdn_equ "maximal load of similar conditions window (2nd)" UBYTE _CNV_A_R_LINEAR_____5_CM 1 100. 0. 99.609375 DISPLAY_IDENTIFIER LOAD_MAX_SCDN_EQU_MIS_5 ECU_ADDRESS 0xd00067eb FORMAT "%9.6" /end MEASUREMENT
/begin MEASUREMENT fmy_scdn_equ_mis_5.ctr_scdn_equ "Number of times N/LOAD is within SCDN window" UWORD _CNV_A_R_LINEAR_____0_CM 1 100. 0. 65535. DISPLAY_IDENTIFIER CTR_SCDN_EQU_MIS_5 ECU_ADDRESS 0xd00067ec FORMAT "%5.0" /end MEASUREMENT
/begin MEASUREMENT fmy_scdn_equ_mis_5.ctr_scdn_sum "Number of times the diagnosis conditions are set" UWORD _CNV_A_R_LINEAR_____0_CM 1 100. 0. 65535. DISPLAY_IDENTIFIER CTR_SCDN_SUM_MIS_5 ECU_ADDRESS 0xd00067ee FORMAT "%5.0" /end MEASUREMENT
/begin MEASUREMENT fmy_scdn_equ_mis_5.lv_wup_scdn_equ "Warm-up status for similar conditions for OBDII continuous error XX" UBYTE _CNV_S_2_RANGE__0___1_CM 1 100. 0. 1. DISPLAY_IDENTIFIER LV_WUP_SCDN_EQU_MIS_5 ECU_ADDRESS 0xd00067f0 /end MEASUREMENT
/begin MEASUREMENT fmy_scdn_equ_mis_6.n_min_scdn_equ "minimal engine speed of similar conditions window (2nd)" UWORD _CNV_A_R_LINEAR_____14_CM 1 100. 0. 8160. DISPLAY_IDENTIFIER N_MIN_SCDN_EQU_MIS_6 ECU_ADDRESS 0xd00067f4 FORMAT "%4.0" /end MEASUREMENT
/begin MEASUREMENT fmy_scdn_equ_mis_6.n_max_scdn_equ "maximal engine speed of similar conditions window (2nd)" UWORD _CNV_A_R_LINEAR_____14_CM 1 100. 0. 8160. DISPLAY_IDENTIFIER N_MAX_SCDN_EQU_MIS_6 ECU_ADDRESS 0xd00067f6 FORMAT "%4.0" /end MEASUREMENT
/begin MEASUREMENT fmy_scdn_equ_mis_6.ctr_scdn_equ_dc "Counter of non-occurence of similar condition" UBYTE _CNV_A_R_LINEAR_____0_CM 1 100. 0. 255. DISPLAY_IDENTIFIER CTR_SCDN_EQU_DC_MIS_6 ECU_ADDRESS 0xd00067f8 FORMAT "%3.0" /end MEASUREMENT
/begin MEASUREMENT fmy_scdn_equ_mis_6.state_scdn "see specification for description." UBYTE _CNV_A_R_LINEAR_____0_CM 1 100. 0. 63. DISPLAY_IDENTIFIER STATE_SCDN_MIS_6 ECU_ADDRESS 0xd00067f9 FORMAT "%3.0" /end MEASUREMENT
/begin MEASUREMENT fmy_scdn_equ_mis_6.load_min_scdn_equ "minimal load of similar conditions window (2nd)" UBYTE _CNV_A_R_LINEAR_____5_CM 1 100. 0. 99.609375 DISPLAY_IDENTIFIER LOAD_MIN_SCDN_EQU_MIS_6 ECU_ADDRESS 0xd00067fa FORMAT "%9.6" /end MEASUREMENT
/begin MEASUREMENT fmy_scdn_equ_mis_6.load_max_scdn_equ "maximal load of similar conditions window (2nd)" UBYTE _CNV_A_R_LINEAR_____5_CM 1 100. 0. 99.609375 DISPLAY_IDENTIFIER LOAD_MAX_SCDN_EQU_MIS_6 ECU_ADDRESS 0xd00067fb FORMAT "%9.6" /end MEASUREMENT
/begin MEASUREMENT fmy_scdn_equ_mis_6.ctr_scdn_equ "Number of times N/LOAD is within SCDN window" UWORD _CNV_A_R_LINEAR_____0_CM 1 100. 0. 65535. DISPLAY_IDENTIFIER CTR_SCDN_EQU_MIS_6 ECU_ADDRESS 0xd00067fc FORMAT "%5.0" /end MEASUREMENT
/begin MEASUREMENT fmy_scdn_equ_mis_6.ctr_scdn_sum "Number of times the diagnosis conditions are set" UWORD _CNV_A_R_LINEAR_____0_CM 1 100. 0. 65535. DISPLAY_IDENTIFIER CTR_SCDN_SUM_MIS_6 ECU_ADDRESS 0xd00067fe FORMAT "%5.0" /end MEASUREMENT
/begin MEASUREMENT fmy_scdn_equ_mis_6.lv_wup_scdn_equ "Warm-up status for similar conditions for OBDII continuous error XX" UBYTE _CNV_S_2_RANGE__0___1_CM 1 100. 0. 1. DISPLAY_IDENTIFIER LV_WUP_SCDN_EQU_MIS_6 ECU_ADDRESS 0xd0006800 /end MEASUREMENT
/begin MEASUREMENT fmy_scdn_equ_mis_7.n_min_scdn_equ "minimal engine speed of similar conditions window (2nd)" UWORD _CNV_A_R_LINEAR_____14_CM 1 100. 0. 8160. DISPLAY_IDENTIFIER N_MIN_SCDN_EQU_MIS_7 ECU_ADDRESS 0xd0006804 FORMAT "%4.0" /end MEASUREMENT
/begin MEASUREMENT fmy_scdn_equ_mis_7.n_max_scdn_equ "maximal engine speed of similar conditions window (2nd)" UWORD _CNV_A_R_LINEAR_____14_CM 1 100. 0. 8160. DISPLAY_IDENTIFIER N_MAX_SCDN_EQU_MIS_7 ECU_ADDRESS 0xd0006806 FORMAT "%4.0" /end MEASUREMENT
/begin MEASUREMENT fmy_scdn_equ_mis_7.ctr_scdn_equ_dc "Counter of non-occurence of similar condition" UBYTE _CNV_A_R_LINEAR_____0_CM 1 100. 0. 255. DISPLAY_IDENTIFIER CTR_SCDN_EQU_DC_MIS_7 ECU_ADDRESS 0xd0006808 FORMAT "%3.0" /end MEASUREMENT
/begin MEASUREMENT fmy_scdn_equ_mis_7.state_scdn "see specification for description." UBYTE _CNV_A_R_LINEAR_____0_CM 1 100. 0. 63. DISPLAY_IDENTIFIER STATE_SCDN_MIS_7 ECU_ADDRESS 0xd0006809 FORMAT "%3.0" /end MEASUREMENT
/begin MEASUREMENT fmy_scdn_equ_mis_7.load_min_scdn_equ "minimal load of similar conditions window (2nd)" UBYTE _CNV_A_R_LINEAR_____5_CM 1 100. 0. 99.609375 DISPLAY_IDENTIFIER LOAD_MIN_SCDN_EQU_MIS_7 ECU_ADDRESS 0xd000680a FORMAT "%9.6" /end MEASUREMENT
/begin MEASUREMENT fmy_scdn_equ_mis_7.load_max_scdn_equ "maximal load of similar conditions window (2nd)" UBYTE _CNV_A_R_LINEAR_____5_CM 1 100. 0. 99.609375 DISPLAY_IDENTIFIER LOAD_MAX_SCDN_EQU_MIS_7 ECU_ADDRESS 0xd000680b FORMAT "%9.6" /end MEASUREMENT
/begin MEASUREMENT fmy_scdn_equ_mis_7.ctr_scdn_equ "Number of times N/LOAD is within SCDN window" UWORD _CNV_A_R_LINEAR_____0_CM 1 100. 0. 65535. DISPLAY_IDENTIFIER CTR_SCDN_EQU_MIS_7 ECU_ADDRESS 0xd000680c FORMAT "%5.0" /end MEASUREMENT
/begin MEASUREMENT fmy_scdn_equ_mis_7.ctr_scdn_sum "Number of times the diagnosis conditions are set" UWORD _CNV_A_R_LINEAR_____0_CM 1 100. 0. 65535. DISPLAY_IDENTIFIER CTR_SCDN_SUM_MIS_7 ECU_ADDRESS 0xd000680e FORMAT "%5.0" /end MEASUREMENT
/begin MEASUREMENT fmy_scdn_equ_mis_7.lv_wup_scdn_equ "Warm-up status for similar conditions for OBDII continuous error XX" UBYTE _CNV_S_2_RANGE__0___1_CM 1 100. 0. 1. DISPLAY_IDENTIFIER LV_WUP_SCDN_EQU_MIS_7 ECU_ADDRESS 0xd0006810 /end MEASUREMENT
/begin MEASUREMENT load_scdn "Calculated load" UBYTE _CNV_A_R_LINEAR_____5_CM 1 100. 0. 99.609375 DISPLAY_IDENTIFIER LOAD_SCDN ECU_ADDRESS 0xd0007590 FORMAT "%9.6" /end MEASUREMENT
/begin CHARACTERISTIC fmy_id_pbk_iv_4.dtc "DTC table declaration for the diagnosis instance XX" MAP 0xa0804268 _REC_MAP_20_u2_u2_u2 65535. _CNV_A_R_LINEAR_____0_CM 0. 65535. DISPLAY_IDENTIFIER ID_ERR_DTC_PBK_IV_4 FORMAT "%5.0"
 /begin AXIS_DESCR COM_AXIS errm_online_dummy _CNV_S_2_ERRM_DTC_R_477_CM 1 0. 1. AXIS_PTS_REF ldp_nr_1_id_err_dtc /end AXIS_DESCR
 /begin AXIS_DESCR COM_AXIS errm_online_dummy _CNV_S_6_ERRM_DTC_R_478_CM 6 0. 5. AXIS_PTS_REF ldp_nr_2_id_err_dtc /end AXIS_DESCR
/end CHARACTERISTIC
/begin AXIS_PTS ldp_nr_1_id_err_dtc "" 0xa0802916 errm_online_dummy _REC_AXS_20_u2 1. _CNV_S_2_ERRM_DTC_R_477_CM 1 0. 1. /end AXIS_PTS
/begin AXIS_PTS ldp_nr_2_id_err_dtc "" 0xa080291c errm_online_dummy _REC_AXS_20_u2 5. _CNV_S_6_ERRM_DTC_R_478_CM 6 0. 5. /end AXIS_PTS
/begin MEASUREMENT fmy_ram_dyn[0].diag_inst "Index of diagnosis instance XX" UWORD _CNV_S_471_ERRM_RANGE_474_CM 1 100. 0. 470. DISPLAY_IDENTIFIER DIAG_INST[0] ECU_ADDRESS 0xd000931a /end MEASUREMENT
/begin MEASUREMENT fmy_ram_dyn[0].err_info_dyn.lv_err_mkd "Marked failure status flag" UWORD _CNV_S_2_RANGE__0___1_CM 1 100. 0. 1. DISPLAY_IDENTIFIER LV_ERR_MKD[0] ECU_ADDRESS 0xd000931c BIT_MASK 0x20 /end MEASUREMENT
/begin MEASUREMENT fmy_ram_dyn[0].err_info_dyn.lv_dc_max "Flag for the MIL state (on or off) related to the failure" UWORD _CNV_S_2_RANGE__0___1_CM 1 100. 0. 1. DISPLAY_IDENTIFIER LV_DC_MAX[0] ECU_ADDRESS 0xd000931c BIT_MASK 0x40 /end MEASUREMENT
/begin MEASUREMENT fmy_ram_dyn[0].err_info_dyn.lv_err_disa "Disapeared failure status flag" UWORD _CNV_S_2_RANGE__0___1_CM 1 100. 0. 1. DISPLAY_IDENTIFIER LV_ERR_DISA[0] ECU_ADDRESS 0xd000931c BIT_MASK 0x80 /end MEASUREMENT
/begin MEASUREMENT fmy_ram_dyn[0].err_info_dyn.lv_err_cfm "Confirmed failure status flag" UWORD _CNV_S_2_RANGE__0___1_CM 1 100. 0. 1. DISPLAY_IDENTIFIER LV_ERR_CFM[0] ECU_ADDRESS 0xd000931c BIT_MASK 0x100 /end MEASUREMENT
/begin MEASUREMENT fmy_ram_dyn[0].err_info_dyn.lv_err_tmp "Temporary failure status flag" UWORD _CNV_S_2_RANGE__0___1_CM 1 100. 0. 1. DISPLAY_IDENTIFIER LV_ERR_TMP[0] ECU_ADDRESS 0xd000931c BIT_MASK 0x200 /end MEASUREMENT
/begin MEASUREMENT fmy_ram_dyn[0].err_info_dyn.lv_err_dc "Failure present status for this driving cycle" UWORD _CNV_S_2_RANGE__0___1_CM 1 100. 0. 1. DISPLAY_IDENTIFIER LV_ERR_DC[0] ECU_ADDRESS 0xd000931c BIT_MASK 0x400 /end MEASUREMENT
/begin MEASUREMENT fmy_ram_dyn[0].err_info_dyn.lv_err_pnd "Pending failure status flag" UWORD _CNV_S_2_RANGE__0___1_CM 1 100. 0. 1. DISPLAY_IDENTIFIER LV_ERR_PND[0] ECU_ADDRESS 0xd000931c BIT_MASK 0x800 /end MEASUREMENT
/begin MEASUREMENT fmy_ram_dyn[0].ctr_wup_cyc "Counter for warm-up cycle" UBYTE _CNV_A_R_LINEAR_____0_CM 1 100. 0. 255. DISPLAY_IDENTIFIER CTR_WUP_CYC[0] ECU_ADDRESS 0xd000931e FORMAT "%3.0" /end MEASUREMENT
/begin MEASUREMENT fmy_ram_dyn[0].ctr_frc "Frequency counter : number of occurrence of present failure" UBYTE _CNV_A_R_LINEAR_____0_CM 1 100. 0. 255. DISPLAY_IDENTIFIER CTR_FRC[0] ECU_ADDRESS 0xd000931f FORMAT "%3.0" /end MEASUREMENT
/begin MEASUREMENT fmy_ram_dyn[0].ctr_dc "Counter for driving cycle" UBYTE _CNV_A_R_LINEAR_____0_CM 1 100. 0. 255. DISPLAY_IDENTIFIER CTR_DC[0] ECU_ADDRESS 0xd0009320 FORMAT "%3.0" /end MEASUREMENT
/begin MEASUREMENT fmy_ram_dyn[0].idx_frf "" UBYTE _CNV_A_R_LINEAR_____0_CM 1 100. 0. 255. DISPLAY_IDENTIFIER IDX_FRF[0] ECU_ADDRESS 0xd0009321 FORMAT "%3.0" /end MEASUREMENT
/begin MEASUREMENT fmy_ram_dyn[1].diag_inst "Index of diagnosis instance XX" UWORD _CNV_S_471_ERRM_RANGE_474_CM 1 100. 0. 470. DISPLAY_IDENTIFIER DIAG_INST[1] ECU_ADDRESS 0xd000932a /end MEASUREMENT
/begin MEASUREMENT fmy_ram_dyn[1].err_info_dyn.lv_err_mkd "Marked failure status flag" UWORD _CNV_S_2_RANGE__0___1_CM 1 100. 0. 1. DISPLAY_IDENTIFIER LV_ERR_MKD[1] ECU_ADDRESS 0xd000932c BIT_MASK 0x20 /end MEASUREMENT
/begin MEASUREMENT fmy_ram_dyn[1].err_info_dyn.lv_dc_max "Flag for the MIL state (on or off) related to the failure" UWORD _CNV_S_2_RANGE__0___1_CM 1 100. 0. 1. DISPLAY_IDENTIFIER LV_DC_MAX[1] ECU_ADDRESS 0xd000932c BIT_MASK 0x40 /end MEASUREMENT
/begin MEASUREMENT fmy_ram_dyn[1].err_info_dyn.lv_err_disa "Disapeared failure status flag" UWORD _CNV_S_2_RANGE__0___1_CM 1 100. 0. 1. DISPLAY_IDENTIFIER LV_ERR_DISA[1] ECU_ADDRESS 0xd000932c BIT_MASK 0x80 /end MEASUREMENT
/begin MEASUREMENT fmy_ram_dyn[1].err_info_dyn.lv_err_cfm "Confirmed failure status flag" UWORD _CNV_S_2_RANGE__0___1_CM 1 100. 0. 1. DISPLAY_IDENTIFIER LV_ERR_CFM[1] ECU_ADDRESS 0xd000932c BIT_MASK 0x100 /end MEASUREMENT
/begin MEASUREMENT fmy_ram_dyn[1].err_info_dyn.lv_err_tmp "Temporary failure status flag" UWORD _CNV_S_2_RANGE__0___1_CM 1 100. 0. 1. DISPLAY_IDENTIFIER LV_ERR_TMP[1] ECU_ADDRESS 0xd000932c BIT_MASK 0x200 /end MEASUREMENT
/begin MEASUREMENT fmy_ram_dyn[1].err_info_dyn.lv_err_dc "Failure present status for this driving cycle" UWORD _CNV_S_2_RANGE__0___1_CM 1 100. 0. 1. DISPLAY_IDENTIFIER LV_ERR_DC[1] ECU_ADDRESS 0xd000932c BIT_MASK 0x400 /end MEASUREMENT
/begin MEASUREMENT fmy_ram_dyn[1].err_info_dyn.lv_err_pnd "Pending failure status flag" UWORD _CNV_S_2_RANGE__0___1_CM 1 100. 0. 1. DISPLAY_IDENTIFIER LV_ERR_PND[1] ECU_ADDRESS 0xd000932c BIT_MASK 0x800 /end MEASUREMENT
/begin MEASUREMENT fmy_ram_dyn[1].ctr_wup_cyc "Counter for warm-up cycle" UBYTE _CNV_A_R_LINEAR_____0_CM 1 100. 0. 255. DISPLAY_IDENTIFIER CTR_WUP_CYC[1] ECU_ADDRESS 0xd000932e FORMAT "%3.0" /end MEASUREMENT
/begin MEASUREMENT fmy_ram_dyn[1].ctr_frc "Frequency counter : number of occurrence of present failure" UBYTE _CNV_A_R_LINEAR_____0_CM 1 100. 0. 255. DISPLAY_IDENTIFIER CTR_FRC[1] ECU_ADDRESS 0xd000932f FORMAT "%3.0" /end MEASUREMENT
/begin MEASUREMENT fmy_ram_dyn[1].ctr_dc "Counter for driving cycle" UBYTE _CNV_A_R_LINEAR_____0_CM 1 100. 0. 255. DISPLAY_IDENTIFIER CTR_DC[1] ECU_ADDRESS 0xd0009330 FORMAT "%3.0" /end MEASUREMENT
/begin MEASUREMENT fmy_ram_dyn[1].idx_frf "" UBYTE _CNV_A_R_LINEAR_____0_CM 1 100. 0. 255. DISPLAY_IDENTIFIER IDX_FRF[1] ECU_ADDRESS 0xd0009331 FORMAT "%3.0" /end MEASUREMENT
/begin MEASUREMENT fmy_ram_dyn[2].diag_inst "Index of diagnosis instance XX" UWORD _CNV_S_471_ERRM_RANGE_474_CM 1 100. 0. 470. DISPLAY_IDENTIFIER DIAG_INST[2] ECU_ADDRESS 0xd000933a /end MEASUREMENT
/begin MEASUREMENT fmy_ram_dyn[2].err_info_dyn.lv_err_mkd "Marked failure status flag" UWORD _CNV_S_2_RANGE__0___1_CM 1 100. 0. 1. DISPLAY_IDENTIFIER LV_ERR_MKD[2] ECU_ADDRESS 0xd000933c BIT_MASK 0x20 /end MEASUREMENT
/begin MEASUREMENT fmy_ram_dyn[2].err_info_dyn.lv_dc_max "Flag for the MIL state (on or off) related to the failure" UWORD _CNV_S_2_RANGE__0___1_CM 1 100. 0. 1. DISPLAY_IDENTIFIER LV_DC_MAX[2] ECU_ADDRESS 0xd000933c BIT_MASK 0x40 /end MEASUREMENT
/begin MEASUREMENT fmy_ram_dyn[2].err_info_dyn.lv_err_disa "Disapeared failure status flag" UWORD _CNV_S_2_RANGE__0___1_CM 1 100. 0. 1. DISPLAY_IDENTIFIER LV_ERR_DISA[2] ECU_ADDRESS 0xd000933c BIT_MASK 0x80 /end MEASUREMENT
/begin MEASUREMENT fmy_ram_dyn[2].err_info_dyn.lv_err_cfm "Confirmed failure status flag" UWORD _CNV_S_2_RANGE__0___1_CM 1 100. 0. 1. DISPLAY_IDENTIFIER LV_ERR_CFM[2] ECU_ADDRESS 0xd000933c BIT_MASK 0x100 /end MEASUREMENT
/begin MEASUREMENT fmy_ram_dyn[2].err_info_dyn.lv_err_tmp "Temporary failure status flag" UWORD _CNV_S_2_RANGE__0___1_CM 1 100. 0. 1. DISPLAY_IDENTIFIER LV_ERR_TMP[2] ECU_ADDRESS 0xd000933c BIT_MASK 0x200 /end MEASUREMENT
/begin MEASUREMENT fmy_ram_dyn[2].err_info_dyn.lv_err_dc "Failure present status for this driving cycle" UWORD _CNV_S_2_RANGE__0___1_CM 1 100. 0. 1. DISPLAY_IDENTIFIER LV_ERR_DC[2] ECU_ADDRESS 0xd000933c BIT_MASK 0x400 /end MEASUREMENT
/begin MEASUREMENT fmy_ram_dyn[2].err_info_dyn.lv_err_pnd "Pending failure status flag" UWORD _CNV_S_2_RANGE__0___1_CM 1 100. 0. 1. DISPLAY_IDENTIFIER LV_ERR_PND[2] ECU_ADDRESS 0xd000933c BIT_MASK 0x800 /end MEASUREMENT
/begin MEASUREMENT fmy_ram_dyn[2].ctr_wup_cyc "Counter for warm-up cycle" UBYTE _CNV_A_R_LINEAR_____0_CM 1 100. 0. 255. DISPLAY_IDENTIFIER CTR_WUP_CYC[2] ECU_ADDRESS 0xd000933e FORMAT "%3.0" /end MEASUREMENT
/begin MEASUREMENT fmy_ram_dyn[2].ctr_frc "Frequency counter : number of occurrence of present failure" UBYTE _CNV_A_R_LINEAR_____0_CM 1 100. 0. 255. DISPLAY_IDENTIFIER CTR_FRC[2] ECU_ADDRESS 0xd000933f FORMAT "%3.0" /end MEASUREMENT
/begin MEASUREMENT fmy_ram_dyn[2].ctr_dc "Counter for driving cycle" UBYTE _CNV_A_R_LINEAR_____0_CM 1 100. 0. 255. DISPLAY_IDENTIFIER CTR_DC[2] ECU_ADDRESS 0xd0009340 FORMAT "%3.0" /end MEASUREMENT
/begin MEASUREMENT fmy_ram_dyn[2].idx_frf "" UBYTE _CNV_A_R_LINEAR_____0_CM 1 100. 0. 255. DISPLAY_IDENTIFIER IDX_FRF[2] ECU_ADDRESS 0xd0009341 FORMAT "%3.0" /end MEASUREMENT
/begin MEASUREMENT fmy_ram_dyn[3].diag_inst "Index of diagnosis instance XX" UWORD _CNV_S_471_ERRM_RANGE_474_CM 1 100. 0. 470. DISPLAY_IDENTIFIER DIAG_INST[3] ECU_ADDRESS 0xd000934a /end MEASUREMENT
/begin MEASUREMENT fmy_ram_dyn[3].err_info_dyn.lv_err_mkd "Marked failure status flag" UWORD _CNV_S_2_RANGE__0___1_CM 1 100. 0. 1. DISPLAY_IDENTIFIER LV_ERR_MKD[3] ECU_ADDRESS 0xd000934c BIT_MASK 0x20 /end MEASUREMENT
/begin MEASUREMENT fmy_ram_dyn[3].err_info_dyn.lv_dc_max "Flag for the MIL state (on or off) related to the failure" UWORD _CNV_S_2_RANGE__0___1_CM 1 100. 0. 1. DISPLAY_IDENTIFIER LV_DC_MAX[3] ECU_ADDRESS 0xd000934c BIT_MASK 0x40 /end MEASUREMENT
/begin MEASUREMENT fmy_ram_dyn[3].err_info_dyn.lv_err_disa "Disapeared failure status flag" UWORD _CNV_S_2_RANGE__0___1_CM 1 100. 0. 1. DISPLAY_IDENTIFIER LV_ERR_DISA[3] ECU_ADDRESS 0xd000934c BIT_MASK 0x80 /end MEASUREMENT
/begin MEASUREMENT fmy_ram_dyn[3].err_info_dyn.lv_err_cfm "Confirmed failure status flag" UWORD _CNV_S_2_RANGE__0___1_CM 1 100. 0. 1. DISPLAY_IDENTIFIER LV_ERR_CFM[3] ECU_ADDRESS 0xd000934c BIT_MASK 0x100 /end MEASUREMENT
/begin MEASUREMENT fmy_ram_dyn[3].err_info_dyn.lv_err_tmp "Temporary failure status flag" UWORD _CNV_S_2_RANGE__0___1_CM 1 100. 0. 1. DISPLAY_IDENTIFIER LV_ERR_TMP[3] ECU_ADDRESS 0xd000934c BIT_MASK 0x200 /end MEASUREMENT
/begin MEASUREMENT fmy_ram_dyn[3].err_info_dyn.lv_err_dc "Failure present status for this driving cycle" UWORD _CNV_S_2_RANGE__0___1_CM 1 100. 0. 1. DISPLAY_IDENTIFIER LV_ERR_DC[3] ECU_ADDRESS 0xd000934c BIT_MASK 0x400 /end MEASUREMENT
/begin MEASUREMENT fmy_ram_dyn[3].err_info_dyn.lv_err_pnd "Pending failure status flag" UWORD _CNV_S_2_RANGE__0___1_CM 1 100. 0. 1. DISPLAY_IDENTIFIER LV_ERR_PND[3] ECU_ADDRESS 0xd000934c BIT_MASK 0x800 /end MEASUREMENT
/begin MEASUREMENT fmy_ram_dyn[3].ctr_wup_cyc "Counter for warm-up cycle" UBYTE _CNV_A_R_LINEAR_____0_CM 1 100. 0. 255. DISPLAY_IDENTIFIER CTR_WUP_CYC[3] ECU_ADDRESS 0xd000934e FORMAT "%3.0" /end MEASUREMENT
/begin MEASUREMENT fmy_ram_dyn[3].ctr_frc "Frequency counter : number of occurrence of present failure" UBYTE _CNV_A_R_LINEAR_____0_CM 1 100. 0. 255. DISPLAY_IDENTIFIER CTR_FRC[3] ECU_ADDRESS 0xd000934f FORMAT "%3.0" /end MEASUREMENT
/begin MEASUREMENT fmy_ram_dyn[3].ctr_dc "Counter for driving cycle" UBYTE _CNV_A_R_LINEAR_____0_CM 1 100. 0. 255. DISPLAY_IDENTIFIER CTR_DC[3] ECU_ADDRESS 0xd0009350 FORMAT "%3.0" /end MEASUREMENT
/begin MEASUREMENT fmy_ram_dyn[3].idx_frf "" UBYTE _CNV_A_R_LINEAR_____0_CM 1 100. 0. 255. DISPLAY_IDENTIFIER IDX_FRF[3] ECU_ADDRESS 0xd0009351 FORMAT "%3.0" /end MEASUREMENT
/begin MEASUREMENT fmy_ram_dyn[4].diag_inst "Index of diagnosis instance XX" UWORD _CNV_S_471_ERRM_RANGE_474_CM 1 100. 0. 470. DISPLAY_IDENTIFIER DIAG_INST[4] ECU_ADDRESS 0xd000935a /end MEASUREMENT
/begin MEASUREMENT fmy_ram_dyn[4].err_info_dyn.lv_err_mkd "Marked failure status flag" UWORD _CNV_S_2_RANGE__0___1_CM 1 100. 0. 1. DISPLAY_IDENTIFIER LV_ERR_MKD[4] ECU_ADDRESS 0xd000935c BIT_MASK 0x20 /end MEASUREMENT
/begin MEASUREMENT fmy_ram_dyn[4].err_info_dyn.lv_dc_max "Flag for the MIL state (on or off) related to the failure" UWORD _CNV_S_2_RANGE__0___1_CM 1 100. 0. 1. DISPLAY_IDENTIFIER LV_DC_MAX[4] ECU_ADDRESS 0xd000935c BIT_MASK 0x40 /end MEASUREMENT
/begin MEASUREMENT fmy_ram_dyn[4].err_info_dyn.lv_err_disa "Disapeared failure status flag" UWORD _CNV_S_2_RANGE__0___1_CM 1 100. 0. 1. DISPLAY_IDENTIFIER LV_ERR_DISA[4] ECU_ADDRESS 0xd000935c BIT_MASK 0x80 /end MEASUREMENT
/begin MEASUREMENT fmy_ram_dyn[4].err_info_dyn.lv_err_cfm "Confirmed failure status flag" UWORD _CNV_S_2_RANGE__0___1_CM 1 100. 0. 1. DISPLAY_IDENTIFIER LV_ERR_CFM[4] ECU_ADDRESS 0xd000935c BIT_MASK 0x100 /end MEASUREMENT
/begin MEASUREMENT fmy_ram_dyn[4].err_info_dyn.lv_err_tmp "Temporary failure status flag" UWORD _CNV_S_2_RANGE__0___1_CM 1 100. 0. 1. DISPLAY_IDENTIFIER LV_ERR_TMP[4] ECU_ADDRESS 0xd000935c BIT_MASK 0x200 /end MEASUREMENT
/begin MEASUREMENT fmy_ram_dyn[4].err_info_dyn.lv_err_dc "Failure present status for this driving cycle" UWORD _CNV_S_2_RANGE__0___1_CM 1 100. 0. 1. DISPLAY_IDENTIFIER LV_ERR_DC[4] ECU_ADDRESS 0xd000935c BIT_MASK 0x400 /end MEASUREMENT
/begin MEASUREMENT fmy_ram_dyn[4].err_info_dyn.lv_err_pnd "Pending failure status flag" UWORD _CNV_S_2_RANGE__0___1_CM 1 100. 0. 1. DISPLAY_IDENTIFIER LV_ERR_PND[4] ECU_ADDRESS 0xd000935c BIT_MASK 0x800 /end MEASUREMENT
/begin MEASUREMENT fmy_ram_dyn[4].ctr_wup_cyc "Counter for warm-up cycle" UBYTE _CNV_A_R_LINEAR_____0_CM 1 100. 0. 255. DISPLAY_IDENTIFIER CTR_WUP_CYC[4] ECU_ADDRESS 0xd000935e FORMAT "%3.0" /end MEASUREMENT
/begin MEASUREMENT fmy_ram_dyn[4].ctr_frc "Frequency counter : number of occurrence of present failure" UBYTE _CNV_A_R_LINEAR_____0_CM 1 100. 0. 255. DISPLAY_IDENTIFIER CTR_FRC[4] ECU_ADDRESS 0xd000935f FORMAT "%3.0" /end MEASUREMENT
/begin MEASUREMENT fmy_ram_dyn[4].ctr_dc "Counter for driving cycle" UBYTE _CNV_A_R_LINEAR_____0_CM 1 100. 0. 255. DISPLAY_IDENTIFIER CTR_DC[4] ECU_ADDRESS 0xd0009360 FORMAT "%3.0" /end MEASUREMENT
/begin MEASUREMENT fmy_ram_dyn[4].idx_frf "" UBYTE _CNV_A_R_LINEAR_____0_CM 1 100. 0. 255. DISPLAY_IDENTIFIER IDX_FRF[4] ECU_ADDRESS 0xd0009361 FORMAT "%3.0" /end MEASUREMENT
/begin MEASUREMENT fmy_ram_dyn[5].diag_inst "Index of diagnosis instance XX" UWORD _CNV_S_471_ERRM_RANGE_474_CM 1 100. 0. 470. DISPLAY_IDENTIFIER DIAG_INST[5] ECU_ADDRESS 0xd000936a /end MEASUREMENT
/begin MEASUREMENT fmy_ram_dyn[5].err_info_dyn.lv_err_mkd "Marked failure status flag" UWORD _CNV_S_2_RANGE__0___1_CM 1 100. 0. 1. DISPLAY_IDENTIFIER LV_ERR_MKD[5] ECU_ADDRESS 0xd000936c BIT_MASK 0x20 /end MEASUREMENT
/begin MEASUREMENT fmy_ram_dyn[5].err_info_dyn.lv_dc_max "Flag for the MIL state (on or off) related to the failure" UWORD _CNV_S_2_RANGE__0___1_CM 1 100. 0. 1. DISPLAY_IDENTIFIER LV_DC_MAX[5] ECU_ADDRESS 0xd000936c BIT_MASK 0x40 /end MEASUREMENT
/begin MEASUREMENT fmy_ram_dyn[5].err_info_dyn.lv_err_disa "Disapeared failure status flag" UWORD _CNV_S_2_RANGE__0___1_CM 1 100. 0. 1. DISPLAY_IDENTIFIER LV_ERR_DISA[5] ECU_ADDRESS 0xd000936c BIT_MASK 0x80 /end MEASUREMENT
/begin MEASUREMENT fmy_ram_dyn[5].err_info_dyn.lv_err_cfm "Confirmed failure status flag" UWORD _CNV_S_2_RANGE__0___1_CM 1 100. 0. 1. DISPLAY_IDENTIFIER LV_ERR_CFM[5] ECU_ADDRESS 0xd000936c BIT_MASK 0x100 /end MEASUREMENT
/begin MEASUREMENT fmy_ram_dyn[5].err_info_dyn.lv_err_tmp "Temporary failure status flag" UWORD _CNV_S_2_RANGE__0___1_CM 1 100. 0. 1. DISPLAY_IDENTIFIER LV_ERR_TMP[5] ECU_ADDRESS 0xd000936c BIT_MASK 0x200 /end MEASUREMENT
/begin MEASUREMENT fmy_ram_dyn[5].err_info_dyn.lv_err_dc "Failure present status for this driving cycle" UWORD _CNV_S_2_RANGE__0___1_CM 1 100. 0. 1. DISPLAY_IDENTIFIER LV_ERR_DC[5] ECU_ADDRESS 0xd000936c BIT_MASK 0x400 /end MEASUREMENT
/begin MEASUREMENT fmy_ram_dyn[5].err_info_dyn.lv_err_pnd "Pending failure status flag" UWORD _CNV_S_2_RANGE__0___1_CM 1 100. 0. 1. DISPLAY_IDENTIFIER LV_ERR_PND[5] ECU_ADDRESS 0xd000936c BIT_MASK 0x800 /end MEASUREMENT
/begin MEASUREMENT fmy_ram_dyn[5].ctr_wup_cyc "Counter for warm-up cycle" UBYTE _CNV_A_R_LINEAR_____0_CM 1 100. 0. 255. DISPLAY_IDENTIFIER CTR_WUP_CYC[5] ECU_ADDRESS 0xd000936e FORMAT "%3.0" /end MEASUREMENT
/begin MEASUREMENT fmy_ram_dyn[5].ctr_frc "Frequency counter : number of occurrence of present failure" UBYTE _CNV_A_R_LINEAR_____0_CM 1 100. 0. 255. DISPLAY_IDENTIFIER CTR_FRC[5] ECU_ADDRESS 0xd000936f FORMAT "%3.0" /end MEASUREMENT
/begin MEASUREMENT fmy_ram_dyn[5].ctr_dc "Counter for driving cycle" UBYTE _CNV_A_R_LINEAR_____0_CM 1 100. 0. 255. DISPLAY_IDENTIFIER CTR_DC[5] ECU_ADDRESS 0xd0009370 FORMAT "%3.0" /end MEASUREMENT
/begin MEASUREMENT fmy_ram_dyn[5].idx_frf "" UBYTE _CNV_A_R_LINEAR_____0_CM 1 100. 0. 255. DISPLAY_IDENTIFIER IDX_FRF[5] ECU_ADDRESS 0xd0009371 FORMAT "%3.0" /end MEASUREMENT
/begin MEASUREMENT fmy_ram_dyn[6].diag_inst "Index of diagnosis instance XX" UWORD _CNV_S_471_ERRM_RANGE_474_CM 1 100. 0. 470. DISPLAY_IDENTIFIER DIAG_INST[6] ECU_ADDRESS 0xd000937a /end MEASUREMENT
/begin MEASUREMENT fmy_ram_dyn[6].err_info_dyn.lv_err_mkd "Marked failure status flag" UWORD _CNV_S_2_RANGE__0___1_CM 1 100. 0. 1. DISPLAY_IDENTIFIER LV_ERR_MKD[6] ECU_ADDRESS 0xd000937c BIT_MASK 0x20 /end MEASUREMENT
/begin MEASUREMENT fmy_ram_dyn[6].err_info_dyn.lv_dc_max "Flag for the MIL state (on or off) related to the failure" UWORD _CNV_S_2_RANGE__0___1_CM 1 100. 0. 1. DISPLAY_IDENTIFIER LV_DC_MAX[6] ECU_ADDRESS 0xd000937c BIT_MASK 0x40 /end MEASUREMENT
/begin MEASUREMENT fmy_ram_dyn[6].err_info_dyn.lv_err_disa "Disapeared failure status flag" UWORD _CNV_S_2_RANGE__0___1_CM 1 100. 0. 1. DISPLAY_IDENTIFIER LV_ERR_DISA[6] ECU_ADDRESS 0xd000937c BIT_MASK 0x80 /end MEASUREMENT
/begin MEASUREMENT fmy_ram_dyn[6].err_info_dyn.lv_err_cfm "Confirmed failure status flag" UWORD _CNV_S_2_RANGE__0___1_CM 1 100. 0. 1. DISPLAY_IDENTIFIER LV_ERR_CFM[6] ECU_ADDRESS 0xd000937c BIT_MASK 0x100 /end MEASUREMENT
/begin MEASUREMENT fmy_ram_dyn[6].err_info_dyn.lv_err_tmp "Temporary failure status flag" UWORD _CNV_S_2_RANGE__0___1_CM 1 100. 0. 1. DISPLAY_IDENTIFIER LV_ERR_TMP[6] ECU_ADDRESS 0xd000937c BIT_MASK 0x200 /end MEASUREMENT
/begin MEASUREMENT fmy_ram_dyn[6].err_info_dyn.lv_err_dc "Failure present status for this driving cycle" UWORD _CNV_S_2_RANGE__0___1_CM 1 100. 0. 1. DISPLAY_IDENTIFIER LV_ERR_DC[6] ECU_ADDRESS 0xd000937c BIT_MASK 0x400 /end MEASUREMENT
/begin MEASUREMENT fmy_ram_dyn[6].err_info_dyn.lv_err_pnd "Pending failure status flag" UWORD _CNV_S_2_RANGE__0___1_CM 1 100. 0. 1. DISPLAY_IDENTIFIER LV_ERR_PND[6] ECU_ADDRESS 0xd000937c BIT_MASK 0x800 /end MEASUREMENT
/begin MEASUREMENT fmy_ram_dyn[6].ctr_wup_cyc "Counter for warm-up cycle" UBYTE _CNV_A_R_LINEAR_____0_CM 1 100. 0. 255. DISPLAY_IDENTIFIER CTR_WUP_CYC[6] ECU_ADDRESS 0xd000937e FORMAT "%3.0" /end MEASUREMENT
/begin MEASUREMENT fmy_ram_dyn[6].ctr_frc "Frequency counter : number of occurrence of present failure" UBYTE _CNV_A_R_LINEAR_____0_CM 1 100. 0. 255. DISPLAY_IDENTIFIER CTR_FRC[6] ECU_ADDRESS 0xd000937f FORMAT "%3.0" /end MEASUREMENT
/begin MEASUREMENT fmy_ram_dyn[6].ctr_dc "Counter for driving cycle" UBYTE _CNV_A_R_LINEAR_____0_CM 1 100. 0. 255. DISPLAY_IDENTIFIER CTR_DC[6] ECU_ADDRESS 0xd0009380 FORMAT "%3.0" /end MEASUREMENT
/begin MEASUREMENT fmy_ram_dyn[6].idx_frf "" UBYTE _CNV_A_R_LINEAR_____0_CM 1 100. 0. 255. DISPLAY_IDENTIFIER IDX_FRF[6] ECU_ADDRESS 0xd0009381 FORMAT "%3.0" /end MEASUREMENT
/begin MEASUREMENT fmy_ram_dyn[7].diag_inst "Index of diagnosis instance XX" UWORD _CNV_S_471_ERRM_RANGE_474_CM 1 100. 0. 470. DISPLAY_IDENTIFIER DIAG_INST[7] ECU_ADDRESS 0xd000938a /end MEASUREMENT
/begin MEASUREMENT fmy_ram_dyn[7].err_info_dyn.lv_err_mkd "Marked failure status flag" UWORD _CNV_S_2_RANGE__0___1_CM 1 100. 0. 1. DISPLAY_IDENTIFIER LV_ERR_MKD[7] ECU_ADDRESS 0xd000938c BIT_MASK 0x20 /end MEASUREMENT
/begin MEASUREMENT fmy_ram_dyn[7].err_info_dyn.lv_dc_max "Flag for the MIL state (on or off) related to the failure" UWORD _CNV_S_2_RANGE__0___1_CM 1 100. 0. 1. DISPLAY_IDENTIFIER LV_DC_MAX[7] ECU_ADDRESS 0xd000938c BIT_MASK 0x40 /end MEASUREMENT
/begin MEASUREMENT fmy_ram_dyn[7].err_info_dyn.lv_err_disa "Disapeared failure status flag" UWORD _CNV_S_2_RANGE__0___1_CM 1 100. 0. 1. DISPLAY_IDENTIFIER LV_ERR_DISA[7] ECU_ADDRESS 0xd000938c BIT_MASK 0x80 /end MEASUREMENT
/begin MEASUREMENT fmy_ram_dyn[7].err_info_dyn.lv_err_cfm "Confirmed failure status flag" UWORD _CNV_S_2_RANGE__0___1_CM 1 100. 0. 1. DISPLAY_IDENTIFIER LV_ERR_CFM[7] ECU_ADDRESS 0xd000938c BIT_MASK 0x100 /end MEASUREMENT
/begin MEASUREMENT fmy_ram_dyn[7].err_info_dyn.lv_err_tmp "Temporary failure status flag" UWORD _CNV_S_2_RANGE__0___1_CM 1 100. 0. 1. DISPLAY_IDENTIFIER LV_ERR_TMP[7] ECU_ADDRESS 0xd000938c BIT_MASK 0x200 /end MEASUREMENT
/begin MEASUREMENT fmy_ram_dyn[7].err_info_dyn.lv_err_dc "Failure present status for this driving cycle" UWORD _CNV_S_2_RANGE__0___1_CM 1 100. 0. 1. DISPLAY_IDENTIFIER LV_ERR_DC[7] ECU_ADDRESS 0xd000938c BIT_MASK 0x400 /end MEASUREMENT
/begin MEASUREMENT fmy_ram_dyn[7].err_info_dyn.lv_err_pnd "Pending failure status flag" UWORD _CNV_S_2_RANGE__0___1_CM 1 100. 0. 1. DISPLAY_IDENTIFIER LV_ERR_PND[7] ECU_ADDRESS 0xd000938c BIT_MASK 0x800 /end MEASUREMENT
/begin MEASUREMENT fmy_ram_dyn[7].ctr_wup_cyc "Counter for warm-up cycle" UBYTE _CNV_A_R_LINEAR_____0_CM 1 100. 0. 255. DISPLAY_IDENTIFIER CTR_WUP_CYC[7] ECU_ADDRESS 0xd000938e FORMAT "%3.0" /end MEASUREMENT
/begin MEASUREMENT fmy_ram_dyn[7].ctr_frc "Frequency counter : number of occurrence of present failure" UBYTE _CNV_A_R_LINEAR_____0_CM 1 100. 0. 255. DISPLAY_IDENTIFIER CTR_FRC[7] ECU_ADDRESS 0xd000938f FORMAT "%3.0" /end MEASUREMENT
/begin MEASUREMENT fmy_ram_dyn[7].ctr_dc "Counter for driving cycle" UBYTE _CNV_A_R_LINEAR_____0_CM 1 100. 0. 255. DISPLAY_IDENTIFIER CTR_DC[7] ECU_ADDRESS 0xd0009390 FORMAT "%3.0" /end MEASUREMENT
/begin MEASUREMENT fmy_ram_dyn[7].idx_frf "" UBYTE _CNV_A_R_LINEAR_____0_CM 1 100. 0. 255. DISPLAY_IDENTIFIER IDX_FRF[7] ECU_ADDRESS 0xd0009391 FORMAT "%3.0" /end MEASUREMENT
/begin MEASUREMENT fmy_ram_dyn[8].diag_inst "Index of diagnosis instance XX" UWORD _CNV_S_471_ERRM_RANGE_474_CM 1 100. 0. 470. DISPLAY_IDENTIFIER DIAG_INST[8] ECU_ADDRESS 0xd000939a /end MEASUREMENT
/begin MEASUREMENT fmy_ram_dyn[8].err_info_dyn.lv_err_mkd "Marked failure status flag" UWORD _CNV_S_2_RANGE__0___1_CM 1 100. 0. 1. DISPLAY_IDENTIFIER LV_ERR_MKD[8] ECU_ADDRESS 0xd000939c BIT_MASK 0x20 /end MEASUREMENT
/begin MEASUREMENT fmy_ram_dyn[8].err_info_dyn.lv_dc_max "Flag for the MIL state (on or off) related to the failure" UWORD _CNV_S_2_RANGE__0___1_CM 1 100. 0. 1. DISPLAY_IDENTIFIER LV_DC_MAX[8] ECU_ADDRESS 0xd000939c BIT_MASK 0x40 /end MEASUREMENT
/begin MEASUREMENT fmy_ram_dyn[8].err_info_dyn.lv_err_disa "Disapeared failure status flag" UWORD _CNV_S_2_RANGE__0___1_CM 1 100. 0. 1. DISPLAY_IDENTIFIER LV_ERR_DISA[8] ECU_ADDRESS 0xd000939c BIT_MASK 0x80 /end MEASUREMENT
/begin MEASUREMENT fmy_ram_dyn[8].err_info_dyn.lv_err_cfm "Confirmed failure status flag" UWORD _CNV_S_2_RANGE__0___1_CM 1 100. 0. 1. DISPLAY_IDENTIFIER LV_ERR_CFM[8] ECU_ADDRESS 0xd000939c BIT_MASK 0x100 /end MEASUREMENT
/begin MEASUREMENT fmy_ram_dyn[8].err_info_dyn.lv_err_tmp "Temporary failure status flag" UWORD _CNV_S_2_RANGE__0___1_CM 1 100. 0. 1. DISPLAY_IDENTIFIER LV_ERR_TMP[8] ECU_ADDRESS 0xd000939c BIT_MASK 0x200 /end MEASUREMENT
/begin MEASUREMENT fmy_ram_dyn[8].err_info_dyn.lv_err_dc "Failure present status for this driving cycle" UWORD _CNV_S_2_RANGE__0___1_CM 1 100. 0. 1. DISPLAY_IDENTIFIER LV_ERR_DC[8] ECU_ADDRESS 0xd000939c BIT_MASK 0x400 /end MEASUREMENT
/begin MEASUREMENT fmy_ram_dyn[8].err_info_dyn.lv_err_pnd "Pending failure status flag" UWORD _CNV_S_2_RANGE__0___1_CM 1 100. 0. 1. DISPLAY_IDENTIFIER LV_ERR_PND[8] ECU_ADDRESS 0xd000939c BIT_MASK 0x800 /end MEASUREMENT
/begin MEASUREMENT fmy_ram_dyn[8].ctr_wup_cyc "Counter for warm-up cycle" UBYTE _CNV_A_R_LINEAR_____0_CM 1 100. 0. 255. DISPLAY_IDENTIFIER CTR_WUP_CYC[8] ECU_ADDRESS 0xd000939e FORMAT "%3.0" /end MEASUREMENT
/begin MEASUREMENT fmy_ram_dyn[8].ctr_frc "Frequency counter : number of occurrence of present failure" UBYTE _CNV_A_R_LINEAR_____0_CM 1 100. 0. 255. DISPLAY_IDENTIFIER CTR_FRC[8] ECU_ADDRESS 0xd000939f FORMAT "%3.0" /end MEASUREMENT
/begin MEASUREMENT fmy_ram_dyn[8].ctr_dc "Counter for driving cycle" UBYTE _CNV_A_R_LINEAR_____0_CM 1 100. 0. 255. DISPLAY_IDENTIFIER CTR_DC[8] ECU_ADDRESS 0xd00093a0 FORMAT "%3.0" /end MEASUREMENT
/begin MEASUREMENT fmy_ram_dyn[8].idx_frf "" UBYTE _CNV_A_R_LINEAR_____0_CM 1 100. 0. 255. DISPLAY_IDENTIFIER IDX_FRF[8] ECU_ADDRESS 0xd00093a1 FORMAT "%3.0" /end MEASUREMENT
/begin MEASUREMENT fmy_ram_dyn[9].diag_inst "Index of diagnosis instance XX" UWORD _CNV_S_471_ERRM_RANGE_474_CM 1 100. 0. 470. DISPLAY_IDENTIFIER DIAG_INST[9] ECU_ADDRESS 0xd00093aa /end MEASUREMENT
/begin MEASUREMENT fmy_ram_dyn[9].err_info_dyn.lv_err_mkd "Marked failure status flag" UWORD _CNV_S_2_RANGE__0___1_CM 1 100. 0. 1. DISPLAY_IDENTIFIER LV_ERR_MKD[9] ECU_ADDRESS 0xd00093ac BIT_MASK 0x20 /end MEASUREMENT
/begin MEASUREMENT fmy_ram_dyn[9].err_info_dyn.lv_dc_max "Flag for the MIL state (on or off) related to the failure" UWORD _CNV_S_2_RANGE__0___1_CM 1 100. 0. 1. DISPLAY_IDENTIFIER LV_DC_MAX[9] ECU_ADDRESS 0xd00093ac BIT_MASK 0x40 /end MEASUREMENT
/begin MEASUREMENT fmy_ram_dyn[9].err_info_dyn.lv_err_disa "Disapeared failure status flag" UWORD _CNV_S_2_RANGE__0___1_CM 1 100. 0. 1. DISPLAY_IDENTIFIER LV_ERR_DISA[9] ECU_ADDRESS 0xd00093ac BIT_MASK 0x80 /end MEASUREMENT
/begin MEASUREMENT fmy_ram_dyn[9].err_info_dyn.lv_err_cfm "Confirmed failure status flag" UWORD _CNV_S_2_RANGE__0___1_CM 1 100. 0. 1. DISPLAY_IDENTIFIER LV_ERR_CFM[9] ECU_ADDRESS 0xd00093ac BIT_MASK 0x100 /end MEASUREMENT
/begin MEASUREMENT fmy_ram_dyn[9].err_info_dyn.lv_err_tmp "Temporary failure status flag" UWORD _CNV_S_2_RANGE__0___1_CM 1 100. 0. 1. DISPLAY_IDENTIFIER LV_ERR_TMP[9] ECU_ADDRESS 0xd00093ac BIT_MASK 0x200 /end MEASUREMENT
/begin MEASUREMENT fmy_ram_dyn[9].err_info_dyn.lv_err_dc "Failure present status for this driving cycle" UWORD _CNV_S_2_RANGE__0___1_CM 1 100. 0. 1. DISPLAY_IDENTIFIER LV_ERR_DC[9] ECU_ADDRESS 0xd00093ac BIT_MASK 0x400 /end MEASUREMENT
/begin MEASUREMENT fmy_ram_dyn[9].err_info_dyn.lv_err_pnd "Pending failure status flag" UWORD _CNV_S_2_RANGE__0___1_CM 1 100. 0. 1. DISPLAY_IDENTIFIER LV_ERR_PND[9] ECU_ADDRESS 0xd00093ac BIT_MASK 0x800 /end MEASUREMENT
/begin MEASUREMENT fmy_ram_dyn[9].ctr_wup_cyc "Counter for warm-up cycle" UBYTE _CNV_A_R_LINEAR_____0_CM 1 100. 0. 255. DISPLAY_IDENTIFIER CTR_WUP_CYC[9] ECU_ADDRESS 0xd00093ae FORMAT "%3.0" /end MEASUREMENT
/begin MEASUREMENT fmy_ram_dyn[9].ctr_frc "Frequency counter : number of occurrence of present failure" UBYTE _CNV_A_R_LINEAR_____0_CM 1 100. 0. 255. DISPLAY_IDENTIFIER CTR_FRC[9] ECU_ADDRESS 0xd00093af FORMAT "%3.0" /end MEASUREMENT
/begin MEASUREMENT fmy_ram_dyn[9].ctr_dc "Counter for driving cycle" UBYTE _CNV_A_R_LINEAR_____0_CM 1 100. 0. 255. DISPLAY_IDENTIFIER CTR_DC[9] ECU_ADDRESS 0xd00093b0 FORMAT "%3.0" /end MEASUREMENT
/begin MEASUREMENT fmy_ram_dyn[9].idx_frf "" UBYTE _CNV_A_R_LINEAR_____0_CM 1 100. 0. 255. DISPLAY_IDENTIFIER IDX_FRF[9] ECU_ADDRESS 0xd00093b1 FORMAT "%3.0" /end MEASUREMENT
/begin COMPU_METHOD _CNV_A_R_LINEAR_____0_CM "" RAT_FUNC "%6.3" "-" COEFFS 0 1. 0. 0 0 1 /end COMPU_METHOD
/begin COMPU_METHOD _CNV_S_2_RANGE__0___1_CM "" TAB_VERB "%6.3" "-" COMPU_TAB_REF _CNV_S_2_RANGE__0___1 /end COMPU_METHOD
/begin COMPU_VTAB _CNV_S_2_RANGE__0___1 "" TAB_VERB 2 0 "0" 1 "1" /end COMPU_VTAB
/begin COMPU_METHOD _CNV_A_R_LINEAR_____5_CM "" RAT_FUNC "%6.3" "%" COEFFS 0 2.56 0. 0 0 1 /end COMPU_METHOD
/begin COMPU_METHOD _CNV_A_R_LINEAR_____14_CM "" RAT_FUNC "%6.3" "rpm" COEFFS 0 1. 0. 0 0 1 /end COMPU_METHOD
/begin COMPU_METHOD _CNV_A_R_LINEAR_____52_CM "" RAT_FUNC "%6.3" "km" COEFFS 0 1. 0. 0 0 1 /end COMPU_METHOD
/begin COMPU_METHOD _CNV_S_471_ERRM_RANGE_474_CM "" TAB_VERB "%6.3" "" COMPU_TAB_REF _CNV_S_471_ERRM_RANGE_474 /end COMPU_METHOD
/begin COMPU_VTAB _CNV_S_471_ERRM_RANGE_474 "" TAB_VERB 471 0 "NO_ERROR" 1 "IMOB_0" 2 "IMOB_1" 3 "IMOB_2" 4 "IMOB_3" 5 "TCO_EL" 6 "TCO_GRD" 7 "TCO_STUCK" 8 "TCO_STUCK_RNG" 9 "TCO_PLAUS" 10 "TCO_2_EL" 11 "TCO_2_GRD" 12 "TCO_2_PLAUS" 13 "ECT_EL" 14 "ECF_EL_1" 15 "ECF_EL_2" 16 "ECFPWM_FB_1" 17 "ECFPWM_FB_2" 18 "TH" 19 "FTL_MIN" 20 "TIA_EL_1" 21 "TIA_EL_2" 22 "TIA_THR_EL_1" 23 "TIA_THR_EL_2" 24 "AMP" 25 "AMP_PLAUS" 26 "MAF" 27 "EL_CPS" 28 "SLV_IVVT_IN_1" 29 "SLV_IVVT_IN_2" 30 "SLV_IVVT_EX_1" 31 "SLV_IVVT_EX_2" 32 "ECU_CKS" 33 "VS" 34 "KNKS_1" 35 "KNKS_2" 36 "KNKS_3" 37 "KNKS_4" 38 "RFP_DR_1" 39 "RFP_DR_2" 40 "WG_1_DR" 41 "WG_2_DR" 42 "PUT_EL_1" 43 "PUT_EL_2" 44 "IGC_SCP_0" 45 "IGC_SCP_1" 46 "IGC_SCP_2" 47 "IGC_SCP_3" 48 "IGC_SCP_4" 49 "IGC_SCP_5" 50 "IGC_SCP_6" 51 "IGC_SCP_7" 52 "IGC_SCG_0" 53 "IGC_SCG_1" 54 "IGC_SCG_2" 55 "IGC_SCG_3" 56 "IGC_SCG_4" 57 "IGC_SCG_5" 58 "IGC_SCG_6" 59 "IGC_SCG_7" 60 "IGC_OL_0" 61 "IGC_OL_1" 62 "IGC_OL_2" 63 "IGC_OL_3" 64 "IGC_OL_4" 65 "IGC_OL_5" 66 "IGC_OL_6" 67 "IGC_OL_7" 68 "DUR_IGC_MPL" 69 "V_REF_1" 70 "V_REF_2" 71 "PVS_1" 72 "PVS_2" 73 "PVS_RATIO" 74 "PVS_DOUBLE" 75 "PVS_BLS_NOT_PLAUS" 76 "MTC_CTL_1" 77 "GEN" 78 "GEN_DIAG" 79 "ALTER_BN" 80 "ALTER_BN_BAT" 81 "T_ES" 82 "MAP_DIP_PLAUS" 83 "TOIL_LEVEL" 84 "ALTER_BN_RGN" 85 "PER_CAM_IN_1" 86 "PER_CAM_EX_1" 87 "SYN_CAM_IN_1" 88 "SYN_CAM_EX_1" 89 "REF_CRK_CAM_IN_1" 90 "REF_CRK_CAM_EX_1" 91 "PER_CAM_IN_2" 92 "PER_CAM_EX_2" 93 "SYN_CAM_IN_2" 94 "SYN_CAM_EX_2" 95 "REF_CRK_CAM_IN_2" 96 "REF_CRK_CAM_EX_2" 97 "CRK_TOOTH" 98 "CRK_TOOTH_PER" 99 "CRK_SYN" 100 "CRK_PLAUS" 101 "PLAUS_CAM_IN_1" 102 "PLAUS_CAM_EX_1" 103 "SYN_CRK_CAM_IN_1" 104 "SYN_CRK_CAM_EX_1" 105 "TOOTH_OFF_IN_1" 106 "TOOTH_OFF_EX_1" 107 "PLAUS_CAM_IN_2" 108 "PLAUS_CAM_EX_2" 109 "SYN_CRK_CAM_IN_2" 110 "SYN_CRK_CAM_EX_2" 111 "TOOTH_OFF_IN_2" 112 "TOOTH_OFF_EX_2" 113 "CAN_BOFF" 114 "RLY_MAIN" 115 "RLY_MAIN_DLY" 116 "RLY_ACCOUT" 117 "ISC" 118 "ISC_CST" 119 "IM_BLS_PLAUS" 120 "IM_BTS_PLAUS" 121 "MSW_TOG" 122 "MSW_2" 123 "MSW_3" 124 "MIS_0" 125 "MIS_1" 126 "MIS_2" 127 "MIS_3" 128 "MIS_4" 129 "MIS_5" 130 "MIS_6" 131 "MIS_7" 132 "MIS_MPL" 133 "MIS_FTL_L" 134 "EF" 135 "TECU" 136 "EBOX_CFA" 137 "ECU_RAM" 138 "TQI_LIM" 139 "DMTLS" 140 "DMTL_PUMP" 141 "DMTLM" 142 "ROUGH_LEAK" 143 "SMALL_LEAK" 144 "CHK_FUC" 145 "SOF" 146 "SOF_REQ" 147 "RLY_CRCV_HEAT" 148 "RLY_ST" 149 "BSD" 150 "POIL_SWI" 151 "TOUT_EFP_CAN" 152 "DIAGCPS" 153 "DCC" 154 "LDM" 155 "DMTLH" 156 "CS" 157 "SPI_MPS" 158 "SPI_KNK" 159 "SENS_POIL" 160 "POIL_DR" 161 "BN_TQ_DCC" 162 "BN_TQ_PSTE_2" 163 "BN_TQ_PSTE_3" 164 "BN_ARS" 165 "BN_CAS" 166 "BN_TQ_TCS" 167 "BN_VS_TCS" 168 "BN_TCS" 169 "BN_TQ_ETCU" 170 "BN_ETCU" 171 "BN_ETCU_2" 172 "BN_ETCU_3" 173 "BN_ETCU_DISP" 174 "BN_TQ_AMT" 175 "BN_ACC" 176 "BN_T_ICL" 177 "BN_VEH_MOD" 178 "BN_KM_ICL" 179 "BN_ICL" 180 "BN_POW_VB" 181 "BN_POW_GEN" 182 "BN_MSW" 183 "BN_ANG_PSTE" 184 "BN_GEAR_REV" 185 "BN_LTG_HDLP_L" 186 "BN_LDM" 187 "BN_TRL" 188 "BN_HIV" 189 "BN_T_CLK" 190 "BN_EFP_CRASH" 191 "BN_CDN_DOOR" 192 "BN_REQ_PBR" 193 "BN_PBR" 194 "BN_EFP" 195 "LOAD_TPS_PLAUS" 196 "EGY_MIN" 197 "LOCAN_BOFF" 198 "CWP_PLAUS" 199 "CWP_INT_OFF" 200 "CWP_PWR" 201 "CWP_COM_PLAUS" 202 "QOIL_SENS" 203 "BAT_SENS" 204 "BAT_SENS_IT" 205 "BAT_SENS_IT_EL" 206 "ECU_NVMY" 207 "GS" 208 "PLAUS_IGK_BN" 209 "TQ_REQ_CAN" 210 "MAP_SENS_1" 211 "MAP_SENS_2" 212 "DTC_TRM" 213 "MEC_IVVT_IN_1" 214 "MEC_IVVT_IN_2" 215 "MEC_IVVT_EX" 216 "TOUT_NOX_SENS_1" 217 "TOUT_NOX_SENS_2" 218 "VVL_ROT" 219 "RLY_VVL" 220 "NOX_SENS_1" 221 "NS_OBD_1_1" 222 "NS_OBD_1_2" 223 "OVL_ECU_VVL" 224 "DR_SC_VVL" 225 "CRIT_OVL_ECU_VVL" 226 "NOX_SENS_2" 227 "CUR_H_VVL" 228 "TEG_PCAT_DOWN" 229 "T_SEG_ER" 230 "SEG_AD_ER" 231 "VS_PLAUS" 232 "FTL_OBD" 233 "FTL_LE_CAN" 234 "FTL_RI_CAN" 235 "TIA_PLAUS" 236 "TAM_CAN" 237 "TAM_PLAUS" 238 "MAP_SHIFT_1" 239 "MAP_SHIFT_2" 240 "CAT_DIAG_1" 241 "CAT_DIAG_2" 242 "CAT_DIAG_AFL_1" 243 "CAT_DIAG_AFL_2" 244 "SCG_LS_DOWN_1" 245 "SCP_LS_DOWN_1" 246 "OC_LS_DOWN_1" 247 "PUC_LS_DOWN_1" 248 "FL_LS_DOWN_1" 249 "LSL_UP_IF_1" 250 "EL_LSL_UP_1" 251 "LSH_UP_1" 252 "LSH_DOWN_1" 253 "VLS_DOWN_DIF_1" 254 "LSH_LSL_UP_1" 255 "AIR_LSL_UP_1" 256 "PUE_LS_DOWN_1" 257 "SWT_LS_DOWN_1" 258 "OBD_LSH_DOWN_1" 259 "DYN_VLD_LS_UP_1" 260 "PUC_VLD_LS_UP_1" 261 "OBD_VLD_LSH_UP_1" 262 "CHK_LS_DOWN_1" 263 "SHIFT_AFL_LSL_UP_1" 264 "SHIFT_AFR_LSL_UP_1" 265 "OC_LSL_UP_1" 266 "DELTA_I_LAM_1" 267 "OFS_LSL_UP_1" 268 "TTIP_MES_LSH_UP_1" 269 "CTL_LSL_UP_1" 270 "CHG_LS_DOWN" 271 "SCG_LS_DOWN_2" 272 "SCP_LS_DOWN_2" 273 "OC_LS_DOWN_2" 274 "PUC_LS_DOWN_2" 275 "FL_LS_DOWN_2" 276 "LSL_UP_IF_2" 277 "EL_LSL_UP_2" 278 "LSH_UP_2" 279 "LSH_DOWN_2" 280 "VLS_DOWN_DIF_2" 281 "LSH_LSL_UP_2" 282 "AIR_LSL_UP_2" 283 "PUE_LS_DOWN_2" 284 "SWT_LS_DOWN_2" 285 "OBD_LSH_DOWN_2" 286 "DYN_VLD_LS_UP_2" 287 "PUC_VLD_LS_UP_2" 288 "OBD_VLD_LSH_UP_2" 289 "CHK_LS_DOWN_2" 290 "SHIFT_AFL_LSL_UP_2" 291 "SHIFT_AFR_LSL_UP_2" 292 "OC_LSL_UP_2" 293 "DELTA_I_LAM_2" 294 "OFS_LSL_UP_2" 295 "TTIP_MES_LSH_UP_2" 296 "CTL_LSL_UP_2" 297 "CHG_LS_UP" 298 "ALTER_COM" 299 "CWP_COM" 300 "QOIL_COM" 301 "SENS_BAT_SMT_COM" 302 "ECRASPWM_FB" 303 "ECRAS_EL" 304 "ECRAS_UP_FB" 305 "ECRAS_DOWN_FB" 306 "WARM_RST" 307 "ACR_AD" 308 "SENS_ACR" 309 "ACR_CTL" 310 "ACR_DR" 311 "VAR_COD" 312 "VEH_POW_VAR" 313 "FUP_MFP_PLAUS" 314 "H_PRS_SYS" 315 "FUP_0" 316 "FUP_1" 317 "VCV_FPC_0" 318 "FUP_EFP" 319 "EFPPWM_PLAUS" 320 "L_PRS_SYS" 321 "VCV_FPC_1" 322 "FSD_1" 323 "FSD_2" 324 "FSD_LAM_LIM_1" 325 "FSD_LAM_LIM_2" 326 "FSD_H_RNG_1" 327 "FSD_H_RNG_2" 328 "CYL_BAL_LAM_0" 329 "CYL_BAL_LAM_1" 330 "CYL_BAL_LAM_2" 331 "CYL_BAL_LAM_3" 332 "CYL_BAL_LAM_4" 333 "CYL_BAL_LAM_5" 334 "CYL_BAL_LAM_6" 335 "CYL_BAL_LAM_7" 336 "CYL_BAL_ER_0" 337 "CYL_BAL_ER_1" 338 "CYL_BAL_ER_2" 339 "CYL_BAL_ER_3" 340 "CYL_BAL_ER_4" 341 "CYL_BAL_ER_5" 342 "CYL_BAL_ER_6" 343 "CYL_BAL_ER_7" 344 "MON_3" 345 "MAF_FRQ_RNG_0" 346 "MAF_FRQ_GRD_0" 347 "MAF_FRQ_EL_0" 348 "MAF_FRQ_RNG_1" 349 "MAF_FRQ_GRD_1" 350 "MAF_FRQ_EL_1" 351 "TPS_1_1" 352 "TPS_1_2" 353 "TPS_2_1" 354 "TPS_2_2" 355 "TPS_MAF_1_1" 356 "TPS_MAF_1_2" 357 "TPS_MAF_2_1" 358 "TPS_MAF_2_2" 359 "TPS_RATIO_1" 360 "TPS_RATIO_2" 361 "TPS_AD_1" 362 "TPS_AD_2" 363 "ETC_PWM_1" 364 "ETC_PWM_2" 365 "ETC_CTL_1" 366 "ETC_CTL_2" 367 "TPS_AD_SPR_1" 368 "TPS_AD_SPR_2" 369 "ETC_DR_1" 370 "ETC_DR_2" 371 "TPS_ST_CHK_1" 372 "TPS_ST_CHK_2" 373 "COM_1_TQ_LOSS_CORD" 374 "COM_1_SWI_GEAR" 375 "COM_1_VEH_MOD" 376 "COM_1_BRAKE_TCS" 377 "COM_1_TQ_DRIV_ASI" 378 "COM_1_TQ_TCS" 379 "COM_1_TQB_TCS" 380 "COM_1_WHEEL_TCS" 381 "COM_1_REQ_TQDW" 382 "COM_1_TQ_PSTE" 383 "COM_1_ANG_PSTE" 384 "COM_1_AC_TRV" 385 "COM_1_AC_LGT" 386 "COM_1_TQ_ARS" 387 "COM_1_ARS" 388 "COM_1_VS" 389 "COM_1_TCS" 390 "COM_1_BOFF" 391 "COM_2_EFP_CRASH" 392 "COM_2_GB" 393 "COM_2_ETCU" 394 "COM_2_TQ_ETCU" 395 "COM_2_STATE_VEH" 396 "COM_2_CAS_2" 397 "COM_2_ACC" 398 "COM_2_KM_ICL" 399 "COM_2_T_ICL" 400 "COM_2_TAM_ICL" 401 "COM_2_T_CLK" 402 "COM_2_BOFF" 403 "COM_2_T_ABSL_ICL" 404 "COM_2_CAS" 405 "COM_2_ETCU_DISP" 406 "COM_2_POW_OFF" 407 "COM_2_ABS_ICL" 408 "COM_2_TRL" 409 "COM_2_HIV" 410 "COM_2_ICL" 411 "COM_2_GEAR_REV" 412 "COM_2_CDN_DOOR" 413 "COM_3_BOFF" 414 "COM_3_EFP" 415 "COM_3_TQ_ETCU" 416 "COM_3_ETCU" 417 "COM_3_ETCU_DISP" 418 "COM_3_ETCU_OBD" 419 "COM_3_GB" 420 "TEG_SENS_1" 421 "TEG_SENS_2" 422 "AMP_PLAUS_CUS" 423 "TCHA_PRS_LOW" 424 "TCHA_LEAK" 425 "TCHA_PRS_DIF" 426 "TCHA_PRS_HIGH" 427 "PUT_PLAUS" 428 "MAP_PLAUS" 429 "TQ_CST" 430 "GEN_EL" 431 "GEN_MEC" 432 "GEN_H_TEMP" 433 "GEN_TYP_NOT_PLAUS" 434 "GEN_MSG_LOST" 435 "GEN_CLC_V_NOT_PLAUS" 436 "GEN_H_TEMP_CLC" 437 "GEN_CTL_NOT_PLAUS" 438 "SLV_IVVT_IN" 439 "SLV_IVVT_EX" 440 "CONV_MON_1" 441 "N_32_MON_1" 442 "PVS_MON_1" 443 "TQ_DIF_ISC_MON_1" 444 "TQ_REQ_MON_1" 445 "TQ_EXT_MON_1" 446 "TQI_AV_MON_1" 447 "TQI_N_MAX_MON_1" 448 "MFF_MON_1" 449 "CRU_INH_MON_1" 450 "SWI_AFS_MON" 451 "IV_0" 452 "IV_1" 453 "IV_2" 454 "IV_3" 455 "IV_4" 456 "IV_5" 457 "IV_6" 458 "IV_7" 459 "IV_SC_0" 460 "IV_SC_1" 461 "IV_SC_2" 462 "IV_SC_3" 463 "IV_SC_4" 464 "IV_SC_5" 465 "IV_SC_6" 466 "IV_SC_7" 467 "PBK_IV_1" 468 "PBK_IV_2" 469 "PBK_IV_3" 470 "PBK_IV_4" /end COMPU_VTAB
/begin COMPU_METHOD _CNV_S_2_ERRM_DTC_R_477_CM "" TAB_VERB "%6.3" "-" COMPU_TAB_REF _CNV_S_2_ERRM_DTC_R_477 /end COMPU_METHOD
/begin COMPU_VTAB _CNV_S_2_ERRM_DTC_R_477 "" TAB_VERB 2 0 "OBD" 1 "CUS" /end COMPU_VTAB
/begin COMPU_METHOD _CNV_S_6_ERRM_DTC_R_478_CM "" TAB_VERB "%6.3" "-" COMPU_TAB_REF _CNV_S_6_ERRM_DTC_R_478 /end COMPU_METHOD
/begin COMPU_VTAB _CNV_S_6_ERRM_DTC_R_478 "" TAB_VERB 6 0 "SYM0" 1 "SYM1" 2 "SYM2" 3 "SYM3" 4 "GLOBAL" 5 "DTC" /end COMPU_VTAB
/begin RECORD_LAYOUT _REC_VAL_20_u1 FNC_VALUES 1 UBYTE COLUMN_DIR DIRECT /end RECORD_LAYOUT
/begin RECORD_LAYOUT _REC_AXS_20_u2 NO_AXIS_PTS_X 1 UWORD AXIS_PTS_X 2 UWORD INDEX_INCR DIRECT /end RECORD_LAYOUT
/begin RECORD_LAYOUT _REC_MAP_20_u2_u2_u2 FNC_VALUES 1 UWORD COLUMN_DIR DIRECT /end RECORD_LAYOUT
/begin FUNCTION ERRM_DTC_Management "DTC_Management"
 /begin DEF_CHARACTERISTIC fmy_id_pbk_iv_4.dtc ldp_nr_1_id_err_dtc ldp_nr_2_id_err_dtc /end DEF_CHARACTERISTIC
/end FUNCTION
/begin FUNCTION ERRM_Similar_Conditions_Appl_Inc "Similar_Conditions_Appl_Inc"
 /begin OUT_MEASUREMENT fmy_scdn_equ_fsd_1.n_min_scdn_equ fmy_scdn_equ_fsd_1.n_max_scdn_equ fmy_scdn_equ_fsd_1.ctr_scdn_equ_dc fmy_scdn_equ_fsd_1.state_scdn fmy_scdn_equ_fsd_1.load_min_scdn_equ fmy_scdn_equ_fsd_1.load_max_scdn_equ fmy_scdn_equ_fsd_1.ctr_scdn_equ fmy_scdn_equ_fsd_1.ctr_scdn_sum fmy_scdn_equ_fsd_1.lv_wup_scdn_equ fmy_scdn_equ_fsd_2.n_min_scdn_equ fmy_scdn_equ_fsd_2.n_max_scdn_equ fmy_scdn_equ_fsd_2.ctr_scdn_equ_dc fmy_scdn_equ_fsd_2.state_scdn fmy_scdn_equ_fsd_2.load_min_scdn_equ fmy_scdn_equ_fsd_2.load_max_scdn_equ fmy_scdn_equ_fsd_2.ctr_scdn_equ fmy_scdn_equ_fsd_2.ctr_scdn_sum fmy_scdn_equ_fsd_2.lv_wup_scdn_equ fmy_scdn_equ_fsd_lam_lim_1.n_min_scdn_equ fmy_scdn_equ_fsd_lam_lim_1.n_max_scdn_equ fmy_scdn_equ_fsd_lam_lim_1.ctr_scdn_equ_dc fmy_scdn_equ_fsd_lam_lim_1.state_scdn fmy_scdn_equ_fsd_lam_lim_1.load_min_scdn_equ fmy_scdn_equ_fsd_lam_lim_1.load_max_scdn_equ fmy_scdn_equ_fsd_lam_lim_1.ctr_scdn_equ fmy_scdn_equ_fsd_lam_lim_1.ctr_scdn_sum fmy_scdn_equ_fsd_lam_lim_1.lv_wup_scdn_equ fmy_scdn_equ_fsd_lam_lim_2.n_min_scdn_equ fmy_scdn_equ_fsd_lam_lim_2.n_max_scdn_equ fmy_scdn_equ_fsd_lam_lim_2.ctr_scdn_equ_dc fmy_scdn_equ_fsd_lam_lim_2.state_scdn fmy_scdn_equ_fsd_lam_lim_2.load_min_scdn_equ fmy_scdn_equ_fsd_lam_lim_2.load_max_scdn_equ fmy_scdn_equ_fsd_lam_lim_2.ctr_scdn_equ fmy_scdn_equ_fsd_lam_lim_2.ctr_scdn_sum fmy_scdn_equ_fsd_lam_lim_2.lv_wup_scdn_equ fmy_scdn_equ_mis_0.n_min_scdn_equ fmy_scdn_equ_mis_0.n_max_scdn_equ fmy_scdn_equ_mis_0.ctr_scdn_equ_dc fmy_scdn_equ_mis_0.state_scdn fmy_scdn_equ_mis_0.load_min_scdn_equ fmy_scdn_equ_mis_0.load_max_scdn_equ fmy_scdn_equ_mis_0.ctr_scdn_equ fmy_scdn_equ_mis_0.ctr_scdn_sum fmy_scdn_equ_mis_0.lv_wup_scdn_equ fmy_scdn_equ_mis_1.n_min_scdn_equ fmy_scdn_equ_mis_1.n_max_scdn_equ fmy_scdn_equ_mis_1.ctr_scdn_equ_dc fmy_scdn_equ_mis_1.state_scdn fmy_scdn_equ_mis_1.load_min_scdn_equ fmy_scdn_equ_mis_1.load_max_scdn_equ fmy_scdn_equ_mis_1.ctr_scdn_equ fmy_scdn_equ_mis_1.ctr_scdn_sum fmy_scdn_equ_mis_1.lv_wup_scdn_equ fmy_scdn_equ_mis_2.n_min_scdn_equ fmy_scdn_equ_mis_2.n_max_scdn_equ fmy_scdn_equ_mis_2.ctr_scdn_equ_dc fmy_scdn_equ_mis_2.state_scdn fmy_scdn_equ_mis_2.load_min_scdn_equ fmy_scdn_equ_mis_2.load_max_scdn_equ fmy_scdn_equ_mis_2.ctr_scdn_equ fmy_scdn_equ_mis_2.ctr_scdn_sum fmy_scdn_equ_mis_2.lv_wup_scdn_equ fmy_scdn_equ_mis_3.n_min_scdn_equ fmy_scdn_equ_mis_3.n_max_scdn_equ fmy_scdn_equ_mis_3.ctr_scdn_equ_dc fmy_scdn_equ_mis_3.state_scdn fmy_scdn_equ_mis_3.load_min_scdn_equ fmy_scdn_equ_mis_3.load_max_scdn_equ fmy_scdn_equ_mis_3.ctr_scdn_equ fmy_scdn_equ_mis_3.ctr_scdn_sum fmy_scdn_equ_mis_3.lv_wup_scdn_equ fmy_scdn_equ_mis_4.n_min_scdn_equ fmy_scdn_equ_mis_4.n_max_scdn_equ fmy_scdn_equ_mis_4.ctr_scdn_equ_dc fmy_scdn_equ_mis_4.state_scdn fmy_scdn_equ_mis_4.load_min_scdn_equ fmy_scdn_equ_mis_4.load_max_scdn_equ fmy_scdn_equ_mis_4.ctr_scdn_equ fmy_scdn_equ_mis_4.ctr_scdn_sum fmy_scdn_equ_mis_4.lv_wup_scdn_equ fmy_scdn_equ_mis_5.n_min_scdn_equ fmy_scdn_equ_mis_5.n_max_scdn_equ fmy_scdn_equ_mis_5.ctr_scdn_equ_dc fmy_scdn_equ_mis_5.state_scdn fmy_scdn_equ_mis_5.load_min_scdn_equ fmy_scdn_equ_mis_5.load_max_scdn_equ fmy_scdn_equ_mis_5.ctr_scdn_equ fmy_scdn_equ_mis_5.ctr_scdn_sum fmy_scdn_equ_mis_5.lv_wup_scdn_equ fmy_scdn_equ_mis_6.n_min_scdn_equ fmy_scdn_equ_mis_6.n_max_scdn_equ fmy_scdn_equ_mis_6.ctr_scdn_equ_dc fmy_scdn_equ_mis_6.state_scdn fmy_scdn_equ_mis_6.load_min_scdn_equ fmy_scdn_equ_mis_6.load_max_scdn_equ fmy_scdn_equ_mis_6.ctr_scdn_equ fmy_scdn_equ_mis_6.ctr_scdn_sum fmy_scdn_equ_mis_6.lv_wup_scdn_equ fmy_scdn_equ_mis_7.n_min_scdn_equ fmy_scdn_equ_mis_7.n_max_scdn_equ fmy_scdn_equ_mis_7.ctr_scdn_equ_dc fmy_scdn_equ_mis_7.state_scdn fmy_scdn_equ_mis_7.load_min_scdn_equ fmy_scdn_equ_mis_7.load_max_scdn_equ fmy_scdn_equ_mis_7.ctr_scdn_equ fmy_scdn_equ_mis_7.ctr_scdn_sum fmy_scdn_equ_mis_7.lv_wup_scdn_equ load_scdn /end OUT_MEASUREMENT
/end FUNCTION
/begin FUNCTION ERRM_Environmental_data_Appl_Inc "Environmental_Data_Appl_Inc" /begin OUT_MEASUREMENT dist_km_envd /end OUT_MEASUREMENT /end FUNCTION
/begin FUNCTION ERRM_Dyn_Error_Management "Dyn_Error_Management_Core" /begin DEF_CHARACTERISTIC c_ctr_max_wup_cyc lc_err_fmy_clr /end DEF_CHARACTERISTIC
 /begin OUT_MEASUREMENT ctr_err_dyn_nr fmy_ram_dyn[0].diag_inst fmy_ram_dyn[0].err_info_dyn.lv_err_mkd fmy_ram_dyn[0].err_info_dyn.lv_dc_max fmy_ram_dyn[0].err_info_dyn.lv_err_disa fmy_ram_dyn[0].err_info_dyn.lv_err_cfm fmy_ram_dyn[0].err_info_dyn.lv_err_tmp fmy_ram_dyn[0].err_info_dyn.lv_err_dc fmy_ram_dyn[0].err_info_dyn.lv_err_pnd fmy_ram_dyn[0].ctr_wup_cyc fmy_ram_dyn[0].ctr_frc fmy_ram_dyn[0].ctr_dc fmy_ram_dyn[0].idx_frf fmy_ram_dyn[1].diag_inst fmy_ram_dyn[1].err_info_dyn.lv_err_mkd fmy_ram_dyn[1].err_info_dyn.lv_dc_max fmy_ram_dyn[1].err_info_dyn.lv_err_disa fmy_ram_dyn[1].err_info_dyn.lv_err_cfm fmy_ram_dyn[1].err_info_dyn.lv_err_tmp fmy_ram_dyn[1].err_info_dyn.lv_err_dc fmy_ram_dyn[1].err_info_dyn.lv_err_pnd fmy_ram_dyn[1].ctr_wup_cyc fmy_ram_dyn[1].ctr_frc fmy_ram_dyn[1].ctr_dc fmy_ram_dyn[1].idx_frf fmy_ram_dyn[2].diag_inst fmy_ram_dyn[2].err_info_dyn.lv_err_mkd fmy_ram_dyn[2].err_info_dyn.lv_dc_max fmy_ram_dyn[2].err_info_dyn.lv_err_disa fmy_ram_dyn[2].err_info_dyn.lv_err_cfm fmy_ram_dyn[2].err_info_dyn.lv_err_tmp fmy_ram_dyn[2].err_info_dyn.lv_err_dc fmy_ram_dyn[2].err_info_dyn.lv_err_pnd fmy_ram_dyn[2].ctr_wup_cyc fmy_ram_dyn[2].ctr_frc fmy_ram_dyn[2].ctr_dc fmy_ram_dyn[2].idx_frf fmy_ram_dyn[3].diag_inst fmy_ram_dyn[3].err_info_dyn.lv_err_mkd fmy_ram_dyn[3].err_info_dyn.lv_dc_max fmy_ram_dyn[3].err_info_dyn.lv_err_disa fmy_ram_dyn[3].err_info_dyn.lv_err_cfm fmy_ram_dyn[3].err_info_dyn.lv_err_tmp fmy_ram_dyn[3].err_info_dyn.lv_err_dc fmy_ram_dyn[3].err_info_dyn.lv_err_pnd fmy_ram_dyn[3].ctr_wup_cyc fmy_ram_dyn[3].ctr_frc fmy_ram_dyn[3].ctr_dc fmy_ram_dyn[3].idx_frf fmy_ram_dyn[4].diag_inst fmy_ram_dyn[4].err_info_dyn.lv_err_mkd fmy_ram_dyn[4].err_info_dyn.lv_dc_max fmy_ram_dyn[4].err_info_dyn.lv_err_disa fmy_ram_dyn[4].err_info_dyn.lv_err_cfm fmy_ram_dyn[4].err_info_dyn.lv_err_tmp fmy_ram_dyn[4].err_info_dyn.lv_err_dc fmy_ram_dyn[4].err_info_dyn.lv_err_pnd fmy_ram_dyn[4].ctr_wup_cyc fmy_ram_dyn[4].ctr_frc fmy_ram_dyn[4].ctr_dc fmy_ram_dyn[4].idx_frf fmy_ram_dyn[5].diag_inst fmy_ram_dyn[5].err_info_dyn.lv_err_mkd fmy_ram_dyn[5].err_info_dyn.lv_dc_max fmy_ram_dyn[5].err_info_dyn.lv_err_disa fmy_ram_dyn[5].err_info_dyn.lv_err_cfm fmy_ram_dyn[5].err_info_dyn.lv_err_tmp fmy_ram_dyn[5].err_info_dyn.lv_err_dc fmy_ram_dyn[5].err_info_dyn.lv_err_pnd fmy_ram_dyn[5].ctr_wup_cyc fmy_ram_dyn[5].ctr_frc fmy_ram_dyn[5].ctr_dc fmy_ram_dyn[5].idx_frf fmy_ram_dyn[6].diag_inst fmy_ram_dyn[6].err_info_dyn.lv_err_mkd fmy_ram_dyn[6].err_info_dyn.lv_dc_max fmy_ram_dyn[6].err_info_dyn.lv_err_disa fmy_ram_dyn[6].err_info_dyn.lv_err_cfm fmy_ram_dyn[6].err_info_dyn.lv_err_tmp fmy_ram_dyn[6].err_info_dyn.lv_err_dc fmy_ram_dyn[6].err_info_dyn.lv_err_pnd fmy_ram_dyn[6].ctr_wup_cyc fmy_ram_dyn[6].ctr_frc fmy_ram_dyn[6].ctr_dc fmy_ram_dyn[6].idx_frf fmy_ram_dyn[7].diag_inst fmy_ram_dyn[7].err_info_dyn.lv_err_mkd fmy_ram_dyn[7].err_info_dyn.lv_dc_max fmy_ram_dyn[7].err_info_dyn.lv_err_disa fmy_ram_dyn[7].err_info_dyn.lv_err_cfm fmy_ram_dyn[7].err_info_dyn.lv_err_tmp fmy_ram_dyn[7].err_info_dyn.lv_err_dc fmy_ram_dyn[7].err_info_dyn.lv_err_pnd fmy_ram_dyn[7].ctr_wup_cyc fmy_ram_dyn[7].ctr_frc fmy_ram_dyn[7].ctr_dc fmy_ram_dyn[7].idx_frf fmy_ram_dyn[8].diag_inst fmy_ram_dyn[8].err_info_dyn.lv_err_mkd fmy_ram_dyn[8].err_info_dyn.lv_dc_max fmy_ram_dyn[8].err_info_dyn.lv_err_disa fmy_ram_dyn[8].err_info_dyn.lv_err_cfm fmy_ram_dyn[8].err_info_dyn.lv_err_tmp fmy_ram_dyn[8].err_info_dyn.lv_err_dc fmy_ram_dyn[8].err_info_dyn.lv_err_pnd fmy_ram_dyn[8].ctr_wup_cyc fmy_ram_dyn[8].ctr_frc fmy_ram_dyn[8].ctr_dc fmy_ram_dyn[8].idx_frf fmy_ram_dyn[9].diag_inst fmy_ram_dyn[9].err_info_dyn.lv_err_mkd fmy_ram_dyn[9].err_info_dyn.lv_dc_max fmy_ram_dyn[9].err_info_dyn.lv_err_disa fmy_ram_dyn[9].err_info_dyn.lv_err_cfm fmy_ram_dyn[9].err_info_dyn.lv_err_tmp fmy_ram_dyn[9].err_info_dyn.lv_err_dc fmy_ram_dyn[9].err_info_dyn.lv_err_pnd fmy_ram_dyn[9].ctr_wup_cyc fmy_ram_dyn[9].ctr_frc fmy_ram_dyn[9].ctr_dc fmy_ram_dyn[9].idx_frf /end OUT_MEASUREMENT
/end FUNCTION
/begin FUNCTION ERRM_Readiness_Codes "Readiness_Codes" /begin OUT_MEASUREMENT state_ready_obd_1 state_ready_obd_2 state_ready_obd_3 /end OUT_MEASUREMENT /end FUNCTION
/begin FUNCTION ERRM_Environmental_data "Environmental_Data"
 /begin OUT_MEASUREMENT tbl_frf[0].envd_obd[0] tbl_frf[0].envd_obd[1] tbl_frf[0].envd_obd[2] tbl_frf[0].envd_obd[3] tbl_frf[0].envd_obd[4] tbl_frf[0].envd_obd[5] tbl_frf[0].envd_obd[6] tbl_frf[0].envd_obd[7] tbl_frf[0].envd_obd[8] tbl_frf[0].envd_obd[9] tbl_frf[0].envd_obd[10] tbl_frf[0].envd_obd[11] tbl_frf[0].envd_obd[12] tbl_frf[0].envd_obd[13] tbl_frf[0].envd_obd[14] tbl_frf[0].envd_obd[15] tbl_frf[0].envd_obd[16] tbl_frf[0].envd_obd[17] tbl_frf[0].envd_obd[18] tbl_frf[0].envd_obd[19] tbl_frf[0].envd_obd[20] tbl_frf[0].envd_obd[21] tbl_frf[0].envd_obd[22] tbl_frf[0].envd_obd[23] tbl_frf[0].envd_obd[24] tbl_frf[0].envd_obd[25] tbl_frf[0].envd_obd[26] tbl_frf[0].envd_obd[27] tbl_frf[0].envd_obd[28] tbl_frf[0].envd_obd[29] tbl_frf[0].envd_obd[30] tbl_frf[0].envd_obd[31] tbl_frf[0].envd_obd[32] tbl_frf[0].envd_obd[33] tbl_frf[0].envd_obd[34] tbl_frf[0].envd_obd[35] tbl_frf[0].envd_obd[36] tbl_frf[0].envd_obd[37] tbl_frf[0].envd_cus_cmn[0] tbl_frf[0].envd_cus_set_cmn[0][0] tbl_frf[0].envd_cus_set_cmn[0][1] tbl_frf[0].envd_cus_set_cmn[0][2] tbl_frf[0].envd_cus_set_cmn[0][3] tbl_frf[0].envd_cus_set_cmn[0][4] tbl_frf[0].envd_cus_set_cmn[0][5] tbl_frf[0].envd_cus_set_cmn[0][6] tbl_frf[0].envd_cus_set_cmn[0][7] tbl_frf[0].envd_cus_set_cmn[0][8] tbl_frf[0].envd_cus_set_cmn[0][9] tbl_frf[0].envd_cus_set_cmn[1][0] tbl_frf[0].envd_cus_set_cmn[1][1] tbl_frf[0].envd_cus_set_cmn[1][2] tbl_frf[0].envd_cus_set_cmn[1][3] tbl_frf[0].envd_cus_set_cmn[1][4] tbl_frf[0].envd_cus_set_cmn[1][5] tbl_frf[0].envd_cus_set_cmn[1][6] tbl_frf[0].envd_cus_set_cmn[1][7] tbl_frf[0].envd_cus_set_cmn[1][8] tbl_frf[0].envd_cus_set_cmn[1][9] tbl_frf[0].envd_cus_set_cmn[2][0] tbl_frf[0].envd_cus_set_cmn[2][1] tbl_frf[0].envd_cus_set_cmn[2][2] tbl_frf[0].envd_cus_set_cmn[2][3] tbl_frf[0].envd_cus_set_cmn[2][4] tbl_frf[0].envd_cus_set_cmn[2][5] tbl_frf[0].envd_cus_set_cmn[2][6] tbl_frf[0].envd_cus_set_cmn[2][7] tbl_frf[0].envd_cus_set_cmn[2][8] tbl_frf[0].envd_cus_set_cmn[2][9] tbl_frf[0].envd_cus_set_spc[0][0] tbl_frf[0].envd_cus_set_spc[0][1] tbl_frf[0].envd_cus_set_spc[0][2] tbl_frf[0].envd_cus_set_spc[0][3] tbl_frf[0].envd_cus_set_spc[1][0] tbl_frf[0].envd_cus_set_spc[1][1] tbl_frf[0].envd_cus_set_spc[1][2] tbl_frf[0].envd_cus_set_spc[1][3] tbl_frf[0].envd_cus_set_spc[2][0] tbl_frf[0].envd_cus_set_spc[2][1] tbl_frf[0].envd_cus_set_spc[2][2] tbl_frf[0].envd_cus_set_spc[2][3] tbl_frf[1].envd_obd[0] tbl_frf[1].envd_obd[1] tbl_frf[1].envd_obd[2] tbl_frf[1].envd_obd[3] tbl_frf[1].envd_obd[4] tbl_frf[1].envd_obd[5] tbl_frf[1].envd_obd[6] tbl_frf[1].envd_obd[7] tbl_frf[1].envd_obd[8] tbl_frf[1].envd_obd[9] tbl_frf[1].envd_obd[10] tbl_frf[1].envd_obd[11] tbl_frf[1].envd_obd[12] tbl_frf[1].envd_obd[13] tbl_frf[1].envd_obd[14] tbl_frf[1].envd_obd[15] tbl_frf[1].envd_obd[16] tbl_frf[1].envd_obd[17] tbl_frf[1].envd_obd[18] tbl_frf[1].envd_obd[19] tbl_frf[1].envd_obd[20] tbl_frf[1].envd_obd[21] tbl_frf[1].envd_obd[22] tbl_frf[1].envd_obd[23] tbl_frf[1].envd_obd[24] tbl_frf[1].envd_obd[25] tbl_frf[1].envd_obd[26] tbl_frf[1].envd_obd[27] tbl_frf[1].envd_obd[28] tbl_frf[1].envd_obd[29] tbl_frf[1].envd_obd[30] tbl_frf[1].envd_obd[31] tbl_frf[1].envd_obd[32] tbl_frf[1].envd_obd[33] tbl_frf[1].envd_obd[34] tbl_frf[1].envd_obd[35] tbl_frf[1].envd_obd[36] tbl_frf[1].envd_obd[37] tbl_frf[1].envd_cus_cmn[0] tbl_frf[1].envd_cus_set_cmn[0][0] tbl_frf[1].envd_cus_set_cmn[0][1] tbl_frf[1].envd_cus_set_cmn[0][2] tbl_frf[1].envd_cus_set_cmn[0][3] tbl_frf[1].envd_cus_set_cmn[0][4] tbl_frf[1].envd_cus_set_cmn[0][5] tbl_frf[1].envd_cus_set_cmn[0][6] tbl_frf[1].envd_cus_set_cmn[0][7] tbl_frf[1].envd_cus_set_cmn[0][8] tbl_frf[1].envd_cus_set_cmn[0][9] tbl_frf[1].envd_cus_set_cmn[1][0] tbl_frf[1].envd_cus_set_cmn[1][1] tbl_frf[1].envd_cus_set_cmn[1][2] tbl_frf[1].envd_cus_set_cmn[1][3] tbl_frf[1].envd_cus_set_cmn[1][4] tbl_frf[1].envd_cus_set_cmn[1][5] tbl_frf[1].envd_cus_set_cmn[1][6] tbl_frf[1].envd_cus_set_cmn[1][7] tbl_frf[1].envd_cus_set_cmn[1][8] tbl_frf[1].envd_cus_set_cmn[1][9] tbl_frf[1].envd_cus_set_cmn[2][0] tbl_frf[1].envd_cus_set_cmn[2][1] tbl_frf[1].envd_cus_set_cmn[2][2] tbl_frf[1].envd_cus_set_cmn[2][3] tbl_frf[1].envd_cus_set_cmn[2][4] tbl_frf[1].envd_cus_set_cmn[2][5] tbl_frf[1].envd_cus_set_cmn[2][6] tbl_frf[1].envd_cus_set_cmn[2][7] tbl_frf[1].envd_cus_set_cmn[2][8] tbl_frf[1].envd_cus_set_cmn[2][9] tbl_frf[1].envd_cus_set_spc[0][0] tbl_frf[1].envd_cus_set_spc[0][1] tbl_frf[1].envd_cus_set_spc[0][2] tbl_frf[1].envd_cus_set_spc[0][3] tbl_frf[1].envd_cus_set_spc[1][0] tbl_frf[1].envd_cus_set_spc[1][1] tbl_frf[1].envd_cus_set_spc[1][2] tbl_frf[1].envd_cus_set_spc[1][3] tbl_frf[1].envd_cus_set_spc[2][0] tbl_frf[1].envd_cus_set_spc[2][1] tbl_frf[1].envd_cus_set_spc[2][2] tbl_frf[1].envd_cus_set_spc[2][3] tbl_frf[2].envd_obd[0] tbl_frf[2].envd_obd[1] tbl_frf[2].envd_obd[2] tbl_frf[2].envd_obd[3] tbl_frf[2].envd_obd[4] tbl_frf[2].envd_obd[5] tbl_frf[2].envd_obd[6] tbl_frf[2].envd_obd[7] tbl_frf[2].envd_obd[8] tbl_frf[2].envd_obd[9] tbl_frf[2].envd_obd[10] tbl_frf[2].envd_obd[11] tbl_frf[2].envd_obd[12] tbl_frf[2].envd_obd[13] tbl_frf[2].envd_obd[14] tbl_frf[2].envd_obd[15] tbl_frf[2].envd_obd[16] tbl_frf[2].envd_obd[17] tbl_frf[2].envd_obd[18] tbl_frf[2].envd_obd[19] tbl_frf[2].envd_obd[20] tbl_frf[2].envd_obd[21] tbl_frf[2].envd_obd[22] tbl_frf[2].envd_obd[23] tbl_frf[2].envd_obd[24] tbl_frf[2].envd_obd[25] tbl_frf[2].envd_obd[26] tbl_frf[2].envd_obd[27] tbl_frf[2].envd_obd[28] tbl_frf[2].envd_obd[29] tbl_frf[2].envd_obd[30] tbl_frf[2].envd_obd[31] tbl_frf[2].envd_obd[32] tbl_frf[2].envd_obd[33] tbl_frf[2].envd_obd[34] tbl_frf[2].envd_obd[35] tbl_frf[2].envd_obd[36] tbl_frf[2].envd_obd[37] tbl_frf[2].envd_cus_cmn[0] tbl_frf[2].envd_cus_set_cmn[0][0] tbl_frf[2].envd_cus_set_cmn[0][1] tbl_frf[2].envd_cus_set_cmn[0][2] tbl_frf[2].envd_cus_set_cmn[0][3] tbl_frf[2].envd_cus_set_cmn[0][4] tbl_frf[2].envd_cus_set_cmn[0][5] tbl_frf[2].envd_cus_set_cmn[0][6] tbl_frf[2].envd_cus_set_cmn[0][7] tbl_frf[2].envd_cus_set_cmn[0][8] tbl_frf[2].envd_cus_set_cmn[0][9] tbl_frf[2].envd_cus_set_cmn[1][0] tbl_frf[2].envd_cus_set_cmn[1][1] tbl_frf[2].envd_cus_set_cmn[1][2] tbl_frf[2].envd_cus_set_cmn[1][3] tbl_frf[2].envd_cus_set_cmn[1][4] tbl_frf[2].envd_cus_set_cmn[1][5] tbl_frf[2].envd_cus_set_cmn[1][6] tbl_frf[2].envd_cus_set_cmn[1][7] tbl_frf[2].envd_cus_set_cmn[1][8] tbl_frf[2].envd_cus_set_cmn[1][9] tbl_frf[2].envd_cus_set_cmn[2][0] tbl_frf[2].envd_cus_set_cmn[2][1] tbl_frf[2].envd_cus_set_cmn[2][2] tbl_frf[2].envd_cus_set_cmn[2][3] tbl_frf[2].envd_cus_set_cmn[2][4] tbl_frf[2].envd_cus_set_cmn[2][5] tbl_frf[2].envd_cus_set_cmn[2][6] tbl_frf[2].envd_cus_set_cmn[2][7] tbl_frf[2].envd_cus_set_cmn[2][8] tbl_frf[2].envd_cus_set_cmn[2][9] tbl_frf[2].envd_cus_set_spc[0][0] tbl_frf[2].envd_cus_set_spc[0][1] tbl_frf[2].envd_cus_set_spc[0][2] tbl_frf[2].envd_cus_set_spc[0][3] tbl_frf[2].envd_cus_set_spc[1][0] tbl_frf[2].envd_cus_set_spc[1][1] tbl_frf[2].envd_cus_set_spc[1][2] tbl_frf[2].envd_cus_set_spc[1][3] tbl_frf[2].envd_cus_set_spc[2][0] tbl_frf[2].envd_cus_set_spc[2][1] tbl_frf[2].envd_cus_set_spc[2][2] tbl_frf[2].envd_cus_set_spc[2][3] tbl_frf[3].envd_obd[0] tbl_frf[3].envd_obd[1] tbl_frf[3].envd_obd[2] tbl_frf[3].envd_obd[3] tbl_frf[3].envd_obd[4] tbl_frf[3].envd_obd[5] tbl_frf[3].envd_obd[6] tbl_frf[3].envd_obd[7] tbl_frf[3].envd_obd[8] tbl_frf[3].envd_obd[9] tbl_frf[3].envd_obd[10] tbl_frf[3].envd_obd[11] tbl_frf[3].envd_obd[12] tbl_frf[3].envd_obd[13] tbl_frf[3].envd_obd[14] tbl_frf[3].envd_obd[15] tbl_frf[3].envd_obd[16] tbl_frf[3].envd_obd[17] tbl_frf[3].envd_obd[18] tbl_frf[3].envd_obd[19] tbl_frf[3].envd_obd[20] tbl_frf[3].envd_obd[21] tbl_frf[3].envd_obd[22] tbl_frf[3].envd_obd[23] tbl_frf[3].envd_obd[24] tbl_frf[3].envd_obd[25] tbl_frf[3].envd_obd[26] tbl_frf[3].envd_obd[27] tbl_frf[3].envd_obd[28] tbl_frf[3].envd_obd[29] tbl_frf[3].envd_obd[30] tbl_frf[3].envd_obd[31] tbl_frf[3].envd_obd[32] tbl_frf[3].envd_obd[33] tbl_frf[3].envd_obd[34] tbl_frf[3].envd_obd[35] tbl_frf[3].envd_obd[36] tbl_frf[3].envd_obd[37] tbl_frf[3].envd_cus_cmn[0] tbl_frf[3].envd_cus_set_cmn[0][0] tbl_frf[3].envd_cus_set_cmn[0][1] tbl_frf[3].envd_cus_set_cmn[0][2] tbl_frf[3].envd_cus_set_cmn[0][3] tbl_frf[3].envd_cus_set_cmn[0][4] tbl_frf[3].envd_cus_set_cmn[0][5] tbl_frf[3].envd_cus_set_cmn[0][6] tbl_frf[3].envd_cus_set_cmn[0][7] tbl_frf[3].envd_cus_set_cmn[0][8] tbl_frf[3].envd_cus_set_cmn[0][9] tbl_frf[3].envd_cus_set_cmn[1][0] tbl_frf[3].envd_cus_set_cmn[1][1] tbl_frf[3].envd_cus_set_cmn[1][2] tbl_frf[3].envd_cus_set_cmn[1][3] tbl_frf[3].envd_cus_set_cmn[1][4] tbl_frf[3].envd_cus_set_cmn[1][5] tbl_frf[3].envd_cus_set_cmn[1][6] tbl_frf[3].envd_cus_set_cmn[1][7] tbl_frf[3].envd_cus_set_cmn[1][8] tbl_frf[3].envd_cus_set_cmn[1][9] tbl_frf[3].envd_cus_set_cmn[2][0] tbl_frf[3].envd_cus_set_cmn[2][1] tbl_frf[3].envd_cus_set_cmn[2][2] tbl_frf[3].envd_cus_set_cmn[2][3] tbl_frf[3].envd_cus_set_cmn[2][4] tbl_frf[3].envd_cus_set_cmn[2][5] tbl_frf[3].envd_cus_set_cmn[2][6] tbl_frf[3].envd_cus_set_cmn[2][7] tbl_frf[3].envd_cus_set_cmn[2][8] tbl_frf[3].envd_cus_set_cmn[2][9] tbl_frf[3].envd_cus_set_spc[0][0] tbl_frf[3].envd_cus_set_spc[0][1] tbl_frf[3].envd_cus_set_spc[0][2] tbl_frf[3].envd_cus_set_spc[0][3] tbl_frf[3].envd_cus_set_spc[1][0] tbl_frf[3].envd_cus_set_spc[1][1] tbl_frf[3].envd_cus_set_spc[1][2] tbl_frf[3].envd_cus_set_spc[1][3] tbl_frf[3].envd_cus_set_spc[2][0] tbl_frf[3].envd_cus_set_spc[2][1] tbl_frf[3].envd_cus_set_spc[2][2] tbl_frf[3].envd_cus_set_spc[2][3] tbl_frf[4].envd_obd[0] tbl_frf[4].envd_obd[1] tbl_frf[4].envd_obd[2] tbl_frf[4].envd_obd[3] tbl_frf[4].envd_obd[4] tbl_frf[4].envd_obd[5] tbl_frf[4].envd_obd[6] tbl_frf[4].envd_obd[7] tbl_frf[4].envd_obd[8] tbl_frf[4].envd_obd[9] tbl_frf[4].envd_obd[10] tbl_frf[4].envd_obd[11] tbl_frf[4].envd_obd[12] tbl_frf[4].envd_obd[13] tbl_frf[4].envd_obd[14] tbl_frf[4].envd_obd[15] tbl_frf[4].envd_obd[16] tbl_frf[4].envd_obd[17] tbl_frf[4].envd_obd[18] tbl_frf[4].envd_obd[19] tbl_frf[4].envd_obd[20] tbl_frf[4].envd_obd[21] tbl_frf[4].envd_obd[22] tbl_frf[4].envd_obd[23] tbl_frf[4].envd_obd[24] tbl_frf[4].envd_obd[25] tbl_frf[4].envd_obd[26] tbl_frf[4].envd_obd[27] tbl_frf[4].envd_obd[28] tbl_frf[4].envd_obd[29] tbl_frf[4].envd_obd[30] tbl_frf[4].envd_obd[31] tbl_frf[4].envd_obd[32] tbl_frf[4].envd_obd[33] tbl_frf[4].envd_obd[34] tbl_frf[4].envd_obd[35] tbl_frf[4].envd_obd[36] tbl_frf[4].envd_obd[37] tbl_frf[4].envd_cus_cmn[0] tbl_frf[4].envd_cus_set_cmn[0][0] tbl_frf[4].envd_cus_set_cmn[0][1] tbl_frf[4].envd_cus_set_cmn[0][2] tbl_frf[4].envd_cus_set_cmn[0][3] tbl_frf[4].envd_cus_set_cmn[0][4] tbl_frf[4].envd_cus_set_cmn[0][5] tbl_frf[4].envd_cus_set_cmn[0][6] tbl_frf[4].envd_cus_set_cmn[0][7] tbl_frf[4].envd_cus_set_cmn[0][8] tbl_frf[4].envd_cus_set_cmn[0][9] tbl_frf[4].envd_cus_set_cmn[1][0] tbl_frf[4].envd_cus_set_cmn[1][1] tbl_frf[4].envd_cus_set_cmn[1][2] tbl_frf[4].envd_cus_set_cmn[1][3] tbl_frf[4].envd_cus_set_cmn[1][4] tbl_frf[4].envd_cus_set_cmn[1][5] tbl_frf[4].envd_cus_set_cmn[1][6] tbl_frf[4].envd_cus_set_cmn[1][7] tbl_frf[4].envd_cus_set_cmn[1][8] tbl_frf[4].envd_cus_set_cmn[1][9] tbl_frf[4].envd_cus_set_cmn[2][0] tbl_frf[4].envd_cus_set_cmn[2][1] tbl_frf[4].envd_cus_set_cmn[2][2] tbl_frf[4].envd_cus_set_cmn[2][3] tbl_frf[4].envd_cus_set_cmn[2][4] tbl_frf[4].envd_cus_set_cmn[2][5] tbl_frf[4].envd_cus_set_cmn[2][6] tbl_frf[4].envd_cus_set_cmn[2][7] tbl_frf[4].envd_cus_set_cmn[2][8] tbl_frf[4].envd_cus_set_cmn[2][9] tbl_frf[4].envd_cus_set_spc[0][0] tbl_frf[4].envd_cus_set_spc[0][1] tbl_frf[4].envd_cus_set_spc[0][2] tbl_frf[4].envd_cus_set_spc[0][3] tbl_frf[4].envd_cus_set_spc[1][0] tbl_frf[4].envd_cus_set_spc[1][1] tbl_frf[4].envd_cus_set_spc[1][2] tbl_frf[4].envd_cus_set_spc[1][3] tbl_frf[4].envd_cus_set_spc[2][0] tbl_frf[4].envd_cus_set_spc[2][1] tbl_frf[4].envd_cus_set_spc[2][2] tbl_frf[4].envd_cus_set_spc[2][3] tbl_frf[5].envd_obd[0] tbl_frf[5].envd_obd[1] tbl_frf[5].envd_obd[2] tbl_frf[5].envd_obd[3] tbl_frf[5].envd_obd[4] tbl_frf[5].envd_obd[5] tbl_frf[5].envd_obd[6] tbl_frf[5].envd_obd[7] /end OUT_MEASUREMENT
/end FUNCTION
/end MODULE
/end PROJECT
