ASAP2_VERSION 1 41
/begin PROJECT MSD70 "Spray Guided DI-System with Piezo Injectors for 6-Cylinder"
/begin HEADER "_default_HeaderComment" PROJECT_NO _0B /end HEADER
/begin MODULE _default_ModuleName "_default_ModuleLongIdentifier"
/begin MOD_COMMON "_default_ModCommonComment" DEPOSIT ABSOLUTE BYTE_ORDER MSB_LAST ALIGNMENT_BYTE 1 ALIGNMENT_WORD 2 ALIGNMENT_LONG 2 ALIGNMENT_FLOAT32_IEEE 2 ALIGNMENT_FLOAT64_IEEE 4 /end MOD_COMMON
/begin MEASUREMENT envd_0_conv_mon "Environmental data 0 for general monitoring error" UBYTE _CNV_A_R_LINEAR_____0_CM 1 100. 0. 255. DISPLAY_IDENTIFIER ENVD_0_CONV_MON ECU_ADDRESS 0xd0002d1d FORMAT "%3.0" /end MEASUREMENT
/begin MEASUREMENT envd_1_conv_mon "Environmental data 0 for general monitoring error" UBYTE _CNV_A_R_LINEAR_____0_CM 1 100. 0. 255. DISPLAY_IDENTIFIER ENVD_1_CONV_MON ECU_ADDRESS 0xd0002d26 FORMAT "%3.0" /end MEASUREMENT
/begin MEASUREMENT envd_2_conv_mon "Environmental data 0 for general monitoring error" UBYTE _CNV_A_R_LINEAR_____0_CM 1 100. 0. 255. DISPLAY_IDENTIFIER ENVD_2_CONV_MON ECU_ADDRESS 0xd0002d2f FORMAT "%3.0" /end MEASUREMENT
/begin MEASUREMENT envd_3_conv_mon "Environmental data 0 for general monitoring error" UBYTE _CNV_A_R_LINEAR_____0_CM 1 100. 0. 255. DISPLAY_IDENTIFIER ENVD_3_CONV_MON ECU_ADDRESS 0xd0002d38 FORMAT "%3.0" /end MEASUREMENT
/begin MEASUREMENT envd_0_n_32_mon "Environmental data 0 for general monitoring error" UBYTE _CNV_A_R_LINEAR_____0_CM 1 100. 0. 255. DISPLAY_IDENTIFIER ENVD_0_N_32_MON ECU_ADDRESS 0xd0002d20 FORMAT "%3.0" /end MEASUREMENT
/begin MEASUREMENT envd_1_n_32_mon "Environmental data 0 for general monitoring error" UBYTE _CNV_A_R_LINEAR_____0_CM 1 100. 0. 255. DISPLAY_IDENTIFIER ENVD_1_N_32_MON ECU_ADDRESS 0xd0002d29 FORMAT "%3.0" /end MEASUREMENT
/begin MEASUREMENT envd_2_n_32_mon "Environmental data 0 for general monitoring error" UBYTE _CNV_A_R_LINEAR_____0_CM 1 100. 0. 255. DISPLAY_IDENTIFIER ENVD_2_N_32_MON ECU_ADDRESS 0xd0002d32 FORMAT "%3.0" /end MEASUREMENT
/begin MEASUREMENT envd_3_n_32_mon "Environmental data 0 for general monitoring error" UBYTE _CNV_A_R_LINEAR_____0_CM 1 100. 0. 255. DISPLAY_IDENTIFIER ENVD_3_N_32_MON ECU_ADDRESS 0xd0002d3b FORMAT "%3.0" /end MEASUREMENT
/begin MEASUREMENT envd_3_pvs_mon "Environmental data 0 for general monitoring error" UBYTE _CNV_A_R_LINEAR_____0_CM 1 100. 0. 255. DISPLAY_IDENTIFIER ENVD_3_PVS_MON ECU_ADDRESS 0xd0002d3c FORMAT "%3.0" /end MEASUREMENT
/begin MEASUREMENT envd_2_pvs_mon "Environmental data 0 for general monitoring error" UBYTE _CNV_A_R_LINEAR_____0_CM 1 100. 0. 255. DISPLAY_IDENTIFIER ENVD_2_PVS_MON ECU_ADDRESS 0xd0002d33 FORMAT "%3.0" /end MEASUREMENT
/begin MEASUREMENT envd_1_pvs_mon "Environmental data 0 for general monitoring error" UBYTE _CNV_A_R_LINEAR_____0_CM 1 100. 0. 255. DISPLAY_IDENTIFIER ENVD_1_PVS_MON ECU_ADDRESS 0xd0002d2a FORMAT "%3.0" /end MEASUREMENT
/begin MEASUREMENT envd_0_pvs_mon "Environmental data 0 for general monitoring error" UBYTE _CNV_A_R_LINEAR_____0_CM 1 100. 0. 255. DISPLAY_IDENTIFIER ENVD_0_PVS_MON ECU_ADDRESS 0xd0002d21 FORMAT "%3.0" /end MEASUREMENT
/begin MEASUREMENT envd_0_cru_mon "Environmental data 0 for general monitoring error" UBYTE _CNV_A_R_LINEAR_____0_CM 1 100. 0. 255. DISPLAY_IDENTIFIER ENVD_0_CRU_MON ECU_ADDRESS 0xd0002d1e FORMAT "%3.0" /end MEASUREMENT
/begin MEASUREMENT envd_1_cru_mon "Environmental data 0 for general monitoring error" UBYTE _CNV_A_R_LINEAR_____0_CM 1 100. 0. 255. DISPLAY_IDENTIFIER ENVD_1_CRU_MON ECU_ADDRESS 0xd0002d27 FORMAT "%3.0" /end MEASUREMENT
/begin MEASUREMENT envd_2_cru_mon "Environmental data 0 for general monitoring error" UBYTE _CNV_A_R_LINEAR_____0_CM 1 100. 0. 255. DISPLAY_IDENTIFIER ENVD_2_CRU_MON ECU_ADDRESS 0xd0002d30 FORMAT "%3.0" /end MEASUREMENT
/begin MEASUREMENT envd_3_cru_mon "Environmental data 0 for general monitoring error" UBYTE _CNV_A_R_LINEAR_____0_CM 1 100. 0. 255. DISPLAY_IDENTIFIER ENVD_3_CRU_MON ECU_ADDRESS 0xd0002d39 FORMAT "%3.0" /end MEASUREMENT
/begin MEASUREMENT envd_3_tqi_av_mon "Environmental data 0 for general monitoring error" UBYTE _CNV_A_R_LINEAR_____0_CM 1 100. 0. 255. DISPLAY_IDENTIFIER ENVD_3_TQI_AV_MON ECU_ADDRESS 0xd0002d40 FORMAT "%3.0" /end MEASUREMENT
/begin MEASUREMENT envd_2_tqi_av_mon "Environmental data 0 for general monitoring error" UBYTE _CNV_A_R_LINEAR_____0_CM 1 100. 0. 255. DISPLAY_IDENTIFIER ENVD_2_TQI_AV_MON ECU_ADDRESS 0xd0002d37 FORMAT "%3.0" /end MEASUREMENT
/begin MEASUREMENT envd_1_tqi_av_mon "Environmental data 0 for general monitoring error" UBYTE _CNV_A_R_LINEAR_____0_CM 1 100. 0. 255. DISPLAY_IDENTIFIER ENVD_1_TQI_AV_MON ECU_ADDRESS 0xd0002d2e FORMAT "%3.0" /end MEASUREMENT
/begin MEASUREMENT envd_0_tqi_av_mon "Environmental data 0 for general monitoring error" UBYTE _CNV_A_R_LINEAR_____0_CM 1 100. 0. 255. DISPLAY_IDENTIFIER ENVD_0_TQI_AV_MON ECU_ADDRESS 0xd0002d25 FORMAT "%3.0" /end MEASUREMENT
/begin MEASUREMENT envd_0_mff_mon "Environmental data 0 for general monitoring error" UBYTE _CNV_A_R_LINEAR_____0_CM 1 100. 0. 255. DISPLAY_IDENTIFIER ENVD_0_MFF_MON ECU_ADDRESS 0xd0002d1f FORMAT "%3.0" /end MEASUREMENT
/begin MEASUREMENT envd_1_mff_mon "Environmental data 0 for general monitoring error" UBYTE _CNV_A_R_LINEAR_____0_CM 1 100. 0. 255. DISPLAY_IDENTIFIER ENVD_1_MFF_MON ECU_ADDRESS 0xd0002d28 FORMAT "%3.0" /end MEASUREMENT
/begin MEASUREMENT envd_2_mff_mon "Environmental data 0 for general monitoring error" UBYTE _CNV_A_R_LINEAR_____0_CM 1 100. 0. 255. DISPLAY_IDENTIFIER ENVD_2_MFF_MON ECU_ADDRESS 0xd0002d31 FORMAT "%3.0" /end MEASUREMENT
/begin MEASUREMENT envd_3_mff_mon "Environmental data 0 for general monitoring error" UBYTE _CNV_A_R_LINEAR_____0_CM 1 100. 0. 255. DISPLAY_IDENTIFIER ENVD_3_MFF_MON ECU_ADDRESS 0xd0002d3a FORMAT "%3.0" /end MEASUREMENT
/begin MEASUREMENT envd_3_tq_dif_isc_mon "Environmental data 0 for general monitoring error" UBYTE _CNV_A_R_LINEAR_____0_CM 1 100. 0. 255. DISPLAY_IDENTIFIER ENVD_3_TQ_DIF_ISC_MON ECU_ADDRESS 0xd0002d3d FORMAT "%3.0" /end MEASUREMENT
/begin MEASUREMENT envd_2_tq_dif_isc_mon "Environmental data 0 for general monitoring error" UBYTE _CNV_A_R_LINEAR_____0_CM 1 100. 0. 255. DISPLAY_IDENTIFIER ENVD_2_TQ_DIF_ISC_MON ECU_ADDRESS 0xd0002d34 FORMAT "%3.0" /end MEASUREMENT
/begin MEASUREMENT envd_1_tq_dif_isc_mon "Environmental data 0 for general monitoring error" UBYTE _CNV_A_R_LINEAR_____0_CM 1 100. 0. 255. DISPLAY_IDENTIFIER ENVD_1_TQ_DIF_ISC_MON ECU_ADDRESS 0xd0002d2b FORMAT "%3.0" /end MEASUREMENT
/begin MEASUREMENT envd_0_tq_dif_isc_mon "Environmental data 0 for general monitoring error" UBYTE _CNV_A_R_LINEAR_____0_CM 1 100. 0. 255. DISPLAY_IDENTIFIER ENVD_0_TQ_DIF_ISC_MON ECU_ADDRESS 0xd0002d22 FORMAT "%3.0" /end MEASUREMENT
/begin MEASUREMENT envd_0_tq_req_mon "Environmental data 0 for general monitoring error" UBYTE _CNV_A_R_LINEAR_____0_CM 1 100. 0. 255. DISPLAY_IDENTIFIER ENVD_0_TQ_REQ_MON ECU_ADDRESS 0xd0002d24 FORMAT "%3.0" /end MEASUREMENT
/begin MEASUREMENT envd_1_tq_req_mon "Environmental data 0 for general monitoring error" UBYTE _CNV_A_R_LINEAR_____0_CM 1 100. 0. 255. DISPLAY_IDENTIFIER ENVD_1_TQ_REQ_MON ECU_ADDRESS 0xd0002d2d FORMAT "%3.0" /end MEASUREMENT
/begin MEASUREMENT envd_2_tq_req_mon "Environmental data 0 for general monitoring error" UBYTE _CNV_A_R_LINEAR_____0_CM 1 100. 0. 255. DISPLAY_IDENTIFIER ENVD_2_TQ_REQ_MON ECU_ADDRESS 0xd0002d36 FORMAT "%3.0" /end MEASUREMENT
/begin MEASUREMENT envd_3_tq_req_mon "Environmental data 0 for general monitoring error" UBYTE _CNV_A_R_LINEAR_____0_CM 1 100. 0. 255. DISPLAY_IDENTIFIER ENVD_3_TQ_REQ_MON ECU_ADDRESS 0xd0002d3f FORMAT "%3.0" /end MEASUREMENT
/begin MEASUREMENT envd_3_tq_ext_mon "Environmental data 0 for general monitoring error" UBYTE _CNV_A_R_LINEAR_____0_CM 1 100. 0. 255. DISPLAY_IDENTIFIER ENVD_3_TQ_EXT_MON ECU_ADDRESS 0xd0002d3e FORMAT "%3.0" /end MEASUREMENT
/begin MEASUREMENT envd_2_tq_ext_mon "Environmental data 0 for general monitoring error" UBYTE _CNV_A_R_LINEAR_____0_CM 1 100. 0. 255. DISPLAY_IDENTIFIER ENVD_2_TQ_EXT_MON ECU_ADDRESS 0xd0002d35 FORMAT "%3.0" /end MEASUREMENT
/begin MEASUREMENT envd_0_tq_ext_mon "Environmental data 0 for general monitoring error" UBYTE _CNV_A_R_LINEAR_____0_CM 1 100. 0. 255. DISPLAY_IDENTIFIER ENVD_0_TQ_EXT_MON ECU_ADDRESS 0xd0002d23 FORMAT "%3.0" /end MEASUREMENT
/begin MEASUREMENT envd_1_tq_ext_mon "Environmental data 0 for general monitoring error" UBYTE _CNV_A_R_LINEAR_____0_CM 1 100. 0. 255. DISPLAY_IDENTIFIER ENVD_1_TQ_EXT_MON ECU_ADDRESS 0xd0002d2c FORMAT "%3.0" /end MEASUREMENT
/begin MEASUREMENT envd_0_tqi_n_max_mon "Environmental data 0 for N_LIM monitoring error (stored in reset resistant memory area)" UBYTE _CNV_A_R_LINEAR_____0_CM 1 100. 0. 255. DISPLAY_IDENTIFIER ENVD_0_TQI_N_MAX_MON ECU_ADDRESS 0xd0001884 FORMAT "%3.0" /end MEASUREMENT
/begin MEASUREMENT envd_1_tqi_n_max_mon "Environmental data 0 for N_LIM monitoring error (stored in reset resistant memory area)" UBYTE _CNV_A_R_LINEAR_____0_CM 1 100. 0. 255. DISPLAY_IDENTIFIER ENVD_1_TQI_N_MAX_MON ECU_ADDRESS 0xd0001885 FORMAT "%3.0" /end MEASUREMENT
/begin MEASUREMENT envd_2_tqi_n_max_mon "Environmental data 0 for N_LIM monitoring error (stored in reset resistant memory area)" UBYTE _CNV_A_R_LINEAR_____0_CM 1 100. 0. 255. DISPLAY_IDENTIFIER ENVD_2_TQI_N_MAX_MON ECU_ADDRESS 0xd0001886 FORMAT "%3.0" /end MEASUREMENT
/begin MEASUREMENT envd_3_tqi_n_max_mon "Environmental data 0 for N_LIM monitoring error (stored in reset resistant memory area)" UBYTE _CNV_A_R_LINEAR_____0_CM 1 100. 0. 255. DISPLAY_IDENTIFIER ENVD_3_TQI_N_MAX_MON ECU_ADDRESS 0xd0001887 FORMAT "%3.0" /end MEASUREMENT
/begin MEASUREMENT lv_err_mff_mon "Logical variable for error in mass fuel flow signal" UBYTE _CNV_S_2_RANGE__0___1_CM 1 100. 0. 1. DISPLAY_IDENTIFIER LV_ERR_MFF_MON ECU_ADDRESS 0xd0002d6b BIT_MASK 0x1 /end MEASUREMENT
/begin MEASUREMENT lv_err_plaus_lamb_dif_mon "Present failure for LAMB_DIF plausibility diagnosis" UBYTE _CNV_S_2_RANGE__0___1_CM 1 100. 0. 1. DISPLAY_IDENTIFIER LV_ERR_PLAUS_LAMB_DIF_MON ECU_ADDRESS 0xc0001542 BIT_MASK 0x1 /end MEASUREMENT
/begin MEASUREMENT lv_swi_afs_mff_mon "Flag for switching to AFS mode" UBYTE _CNV_S_2_RANGE__0___1_CM 1 100. 0. 1. DISPLAY_IDENTIFIER LV_SWI_AFS_MFF_MON ECU_ADDRESS 0xd0002d99 BIT_MASK 0x1 /end MEASUREMENT
/begin MEASUREMENT abc_swi_afs_mff_mon "Anti bounce counter for request to AFS" UBYTE _CNV_A_R_LINEAR_____0_CM 1 100. 0. 255. DISPLAY_IDENTIFIER ABC_SWI_AFS_MFF_MON ECU_ADDRESS 0xc00014de FORMAT "%3.0" /end MEASUREMENT
/begin MEASUREMENT abc_mff_afs_mon "Anti bounce counter for fault in MFF signal (AFS mode)" UBYTE _CNV_A_R_LINEAR_____0_CM 1 100. 0. 255. DISPLAY_IDENTIFIER ABC_MFF_AFS_MON ECU_ADDRESS 0xc00014d7 FORMAT "%3.0" /end MEASUREMENT
/begin MEASUREMENT abc_mff_not_afs_mon "Anti bounce for fault in MFF signal (not AFS mode)" UBYTE _CNV_A_R_LINEAR_____0_CM 1 100. 0. 255. DISPLAY_IDENTIFIER ABC_MFF_NOT_AFS_MON ECU_ADDRESS 0xc00014d8 FORMAT "%3.0" /end MEASUREMENT
/begin CHARACTERISTIC c_abc_inc_mff_afs_mon "Anti bounce counter increment in case of MFF error (AFS-mode)" VALUE 0xa1000fd6 _REC_VAL_20_u1 255. _CNV_A_R_LINEAR_____0_CM 0. 255. DISPLAY_IDENTIFIER C_ABC_INC_MFF_AFS_MON FORMAT "%3.0" /end CHARACTERISTIC
/begin CHARACTERISTIC c_abc_max_mff_afs_mon "Value at which MFF error is recognized. when reached (AFS-mode)" VALUE 0xa1000ff2 _REC_VAL_20_u1 254. _CNV_A_R_LINEAR_____0_CM 1. 255. DISPLAY_IDENTIFIER C_ABC_MAX_MFF_AFS_MON FORMAT "%3.0" /end CHARACTERISTIC
/begin CHARACTERISTIC c_abc_inc_mff_not_afs_mon "Anti bounce counter increment in case of MFF error (not AFS-mode)" VALUE 0xa1000fd7 _REC_VAL_20_u1 255. _CNV_A_R_LINEAR_____0_CM 0. 255. DISPLAY_IDENTIFIER C_ABC_INC_MFF_NOT_AFS_MON FORMAT "%3.0" /end CHARACTERISTIC
/begin CHARACTERISTIC c_abc_max_mff_not_afs_mon "Value at which MFF error is recognised. when reached (not AFS-mode)" VALUE 0xa1000ff3 _REC_VAL_20_u1 254. _CNV_A_R_LINEAR_____0_CM 1. 255. DISPLAY_IDENTIFIER C_ABC_MAX_MFF_NOT_AFS_MON FORMAT "%3.0" /end CHARACTERISTIC
/begin CHARACTERISTIC c_abc_inc_swi_afs_mff_mon "Anti bounce counter increment for request to AFS (MFF error)" VALUE 0xa1000fde _REC_VAL_20_u1 255. _CNV_A_R_LINEAR_____0_CM 0. 255. DISPLAY_IDENTIFIER C_ABC_INC_SWI_AFS_MFF_MON FORMAT "%3.0" /end CHARACTERISTIC
/begin CHARACTERISTIC c_abc_max_swi_afs_mff_mon "Value at which OPM will be switched to AFS at MFF error" VALUE 0xa1000ffa _REC_VAL_20_u1 254. _CNV_A_R_LINEAR_____0_CM 1. 255. DISPLAY_IDENTIFIER C_ABC_MAX_SWI_AFS_MFF_MON FORMAT "%3.0" /end CHARACTERISTIC
/begin CHARACTERISTIC c_lamb_dif_sum_max_mon "Maximum accumulator threshold for flagging LAMB_DIF unplausibility" VALUE 0xa100101e _REC_VAL_20_u2 31.9990234375 _CNV_A_R_LINEAR_____122_CM 0. 31.9990234375 DISPLAY_IDENTIFIER C_LAMB_DIF_SUM_MAX_MON FORMAT "%7.4" /end CHARACTERISTIC
/begin AXIS_PTS ldp_n_32_mon_ip_lamb_dif_mon "" 0xa1000848 n_32_mon _REC_AXS_20_u1 8160. _CNV_A_R_LINEAR_____9_CM 4 0. 8160. FORMAT "%4.0" /end AXIS_PTS
/begin AXIS_PTS ldp_tqi_sp_mon_ip_lamb_dif_mon "" 0xa1000958 tqi_sp_mon _REC_AXS_20_u1 510. _CNV_A_R_LINEAR_____280_CM 4 0. 510. FORMAT "%3.0" /end AXIS_PTS
/begin CHARACTERISTIC ip_lamb_dif_thd_mon "map for allowed LAMB_DIF threshold" MAP 0xa1000ce0 _REC_MAP_20_u2_u1_u1 31.9990234375 _CNV_A_R_LINEAR_____122_CM 0. 31.9990234375 DISPLAY_IDENTIFIER IP_LAMB_DIF_THD_MON FORMAT "%7.4"
 /begin AXIS_DESCR COM_AXIS n_32_mon _CNV_A_R_LINEAR_____9_CM 4 0. 8160. FORMAT "%4.0" AXIS_PTS_REF ldp_n_32_mon_ip_lamb_dif_mon /end AXIS_DESCR
 /begin AXIS_DESCR COM_AXIS tqi_sp_mon _CNV_A_R_LINEAR_____280_CM 4 0. 510. FORMAT "%3.0" AXIS_PTS_REF ldp_tqi_sp_mon_ip_lamb_dif_mon /end AXIS_DESCR
/end CHARACTERISTIC
/begin MEASUREMENT lv_swi_afs_mon "flag for switching to HOM_AFS due to faults in non-HOM_AFS" UBYTE _CNV_S_2_RANGE__0___1_CM 1 100. 0. 1. DISPLAY_IDENTIFIER LV_SWI_AFS_MON ECU_ADDRESS 0xd0002d9a BIT_MASK 0x1 /end MEASUREMENT
/begin MEASUREMENT mff_tq_mon "torque relevant mass fuel flow" UWORD _CNV_A_R_LINEAR_____108_CM 1 100. 0. 1389. DISPLAY_IDENTIFIER MFF_TQ_MON ECU_ADDRESS 0xd00024fe FORMAT "%7.2" /end MEASUREMENT
/begin MEASUREMENT mff_lamb_mon "lambda relevant mass fuel flow" UWORD _CNV_A_R_LINEAR_____108_CM 1 100. 0. 1389. DISPLAY_IDENTIFIER MFF_LAMB_MON ECU_ADDRESS 0xd00024fa FORMAT "%7.2" /end MEASUREMENT
/begin MEASUREMENT mff_lamb_ref_mon "lambda relevant mass fuel flow for stoichometric conditions" UWORD _CNV_A_R_LINEAR_____108_CM 1 100. 0. 1389. DISPLAY_IDENTIFIER MFF_LAMB_REF_MON ECU_ADDRESS 0xd00024fc FORMAT "%7.2" /end MEASUREMENT
/begin MEASUREMENT mff_iv_1_mon "mass fuel flow, first pulse" UWORD _CNV_A_R_LINEAR_____108_CM 1 100. 0. 1389. DISPLAY_IDENTIFIER MFF_IV_1_MON ECU_ADDRESS 0xc0001470 FORMAT "%7.2" /end MEASUREMENT
/begin MEASUREMENT mff_iv_2_mon "mass fuel flow, second pulse" UWORD _CNV_A_R_LINEAR_____108_CM 1 100. 0. 1389. DISPLAY_IDENTIFIER MFF_IV_2_MON ECU_ADDRESS 0xc0001472 FORMAT "%7.2" /end MEASUREMENT
/begin MEASUREMENT mff_iv_post_mon "mass fuel flow, post pulse" UWORD _CNV_A_R_LINEAR_____108_CM 1 100. 0. 1389. DISPLAY_IDENTIFIER MFF_IV_POST_MON ECU_ADDRESS 0xc0001474 FORMAT "%7.2" /end MEASUREMENT
/begin MEASUREMENT egy_level_iv_2_mon "energy at injector for second pulse" UWORD _CNV_A_R_INJR_LINEA_478_CM 1 100. 0. 255. DISPLAY_IDENTIFIER EGY_LEVEL_IV_2_MON ECU_ADDRESS 0xc000145e FORMAT "%7.3" /end MEASUREMENT
/begin MEASUREMENT egy_level_iv_post_mon "energy at injector for post pulse" UWORD _CNV_A_R_INJR_LINEA_478_CM 1 100. 0. 255. DISPLAY_IDENTIFIER EGY_LEVEL_IV_POST_MON ECU_ADDRESS 0xc0001462 FORMAT "%7.3" /end MEASUREMENT
/begin MEASUREMENT egy_level_iv_1_mon "energy at injector for first pulse" UWORD _CNV_A_R_INJR_LINEA_478_CM 1 100. 0. 255. DISPLAY_IDENTIFIER EGY_LEVEL_IV_1_MON ECU_ADDRESS 0xc000145c FORMAT "%7.3" /end MEASUREMENT
/begin MEASUREMENT egy_level_iv_bal_mv_mon "mean value of energy corrections due to cyl. balancing" SWORD _CNV_A_R_LINEAR_____110_CM 1 100. -50. 49.9984741210938 DISPLAY_IDENTIFIER EGY_LEVEL_IV_BAL_MV_MON ECU_ADDRESS 0xc0001460 FORMAT "%7.3" /end MEASUREMENT
/begin MEASUREMENT ti_add_mv_mon "mean value of additive corrections" SWORD _CNV_A_R_LINEAR_____401_CM 1 100. -32768. 32767. DISPLAY_IDENTIFIER TI_ADD_MV_MON ECU_ADDRESS 0xc0001480 FORMAT "%6.0" /end MEASUREMENT
/begin MEASUREMENT ti_iv_1_cor_mon "standardized injection time for first pulse" UWORD _CNV_A_R_LINEAR_____233_CM 1 100. 0. 65.535 DISPLAY_IDENTIFIER TI_IV_1_COR_MON ECU_ADDRESS 0xc0001482 /end MEASUREMENT
/begin MEASUREMENT ti_iv_2_cor_mon "standardized injection time for second pulse" UWORD _CNV_A_R_LINEAR_____233_CM 1 100. 0. 65.535 DISPLAY_IDENTIFIER TI_IV_2_COR_MON ECU_ADDRESS 0xc0001484 /end MEASUREMENT
/begin MEASUREMENT ti_iv_post_cor_mon "standardized injection time for post pulse" UWORD _CNV_A_R_LINEAR_____233_CM 1 100. 0. 65.535 DISPLAY_IDENTIFIER TI_IV_POST_COR_MON ECU_ADDRESS 0xc0001486 /end MEASUREMENT
/begin MEASUREMENT fac_ti_mv_mon "mean value of multiplicative corrections" UWORD _CNV_A_R_LINEAR_____8_CM 1 100. 0. 1.99996948242188 DISPLAY_IDENTIFIER FAC_TI_MV_MON ECU_ADDRESS 0xc000146a FORMAT "%7.5" /end MEASUREMENT
/begin CHARACTERISTIC c_thd_high_egy_level_mon "treshold for determination of high energy level" VALUE 0xa1001058 _REC_VAL_20_u2 255. _CNV_A_R_INJR_LINEA_478_CM 0. 255. DISPLAY_IDENTIFIER C_THD_HIGH_EGY_LEVEL_MON FORMAT "%7.3" /end CHARACTERISTIC
/begin CHARACTERISTIC c_thd_min_egy_level_mon "treshold for determination of low energy level" VALUE 0xa1001062 _REC_VAL_20_u2 255. _CNV_A_R_INJR_LINEA_478_CM 0. 255. DISPLAY_IDENTIFIER C_THD_MIN_EGY_LEVEL_MON FORMAT "%7.3" /end CHARACTERISTIC
/begin CHARACTERISTIC c_thd_mff_ad_fac_max_mon "treshold for offset from lambda adaptation" VALUE 0xa100105e _REC_VAL_20_s2 99.99847412109381 _CNV_A_R_LINEAR_____841_CM -50. 49.9984741210938 DISPLAY_IDENTIFIER C_THD_MFF_AD_FAC_MAX_MON FORMAT "%8.3" /end CHARACTERISTIC
/begin CHARACTERISTIC c_thd_mff_ad_add_max_mon "treshold for offset from lamba adaptation" VALUE 0xa100105c _REC_VAL_20_s2 1389. _CNV_A_R_LINEAR_____202_CM -694.510597390707 694.4894026092931 DISPLAY_IDENTIFIER C_THD_MFF_AD_ADD_MAX_MON FORMAT "%7.2" /end CHARACTERISTIC
/begin AXIS_PTS ldp_egy_level_ip_egy_cor_mon "" 0xa1000764 egy_level_iv_bal_mv_mon _REC_AXS_20_u2 99.99847412 _CNV_A_R_LINEAR_____159_CM 8 -50. 49.99847412 FORMAT "%7.3" /end AXIS_PTS
/begin CHARACTERISTIC ip_fac_ti_prs_mon "injection inlet ratio through valve due to pressure drop" CURVE 0xa1000b68 _REC_CUR_20_u2_u2 15.999755859375 _CNV_A_R_LINEAR_____115_CM 0. 15.999755859375 DISPLAY_IDENTIFIER IP_FAC_TI_PRS_MON FORMAT "%7.4"
 /begin AXIS_DESCR COM_AXIS online_dummy _CNV_A_R_ECM2_LINEA_842_CM 12 0. 347776. FORMAT "%6.0" AXIS_PTS_REF ldp_prs_dec_inj_mon /end AXIS_DESCR
/end CHARACTERISTIC
/begin CHARACTERISTIC ip_fac_ti_tfpa_mon "factor for correction of fuel injection due to the valve temperature" CURVE 0xa1000b80 _REC_CUR_20_u2_u1 1.99975 _CNV_A_R_LINEAR_____115_CM 0. 1.99975 DISPLAY_IDENTIFIER IP_FAC_TI_TFPA_MON FORMAT "%7.4"
 /begin AXIS_DESCR COM_AXIS tfpa _CNV_A_R_LINEAR_____16_CM 12 -48. 142.5 FORMAT "%6.2" AXIS_PTS_REF ldp_tfpa_ip_fac_ti_tfpa_mon /end AXIS_DESCR
/end CHARACTERISTIC
/begin CHARACTERISTIC ip_fac_ti_tfu_mon "factor for correction of fuel injection due to the fuel temperature" CURVE 0xa1000b98 _REC_CUR_20_u2_u1 1.99975 _CNV_A_R_LINEAR_____115_CM 0. 1.99975 DISPLAY_IDENTIFIER IP_FAC_TI_TFU_MON FORMAT "%7.4"
 /begin AXIS_DESCR COM_AXIS tfu _CNV_A_R_LINEAR_____16_CM 12 -48. 142.5 FORMAT "%6.2" AXIS_PTS_REF ldp_tfu_ip_fac_ti_tfu_mon /end AXIS_DESCR
/end CHARACTERISTIC
/begin AXIS_PTS ldp_tfu_ip_fac_ti_tfu_mon "" 0xa10008f0 tfu _REC_AXS_20_u1 190.5 _CNV_A_R_LINEAR_____16_CM 12 -48. 142.5 FORMAT "%6.2" /end AXIS_PTS
/begin CHARACTERISTIC ip_mff_ti_stnd_egy_h_mon "inverse standad injector characteristic at high energy level" CURVE 0xa1000d00 _REC_CUR_20_u2_u2 1389. _CNV_A_R_LINEAR_____108_CM 0. 1389. DISPLAY_IDENTIFIER IP_MFF_TI_STND_EGY_H_MON FORMAT "%7.2"
 /begin AXIS_DESCR COM_AXIS online_dummy _CNV_A_R_LINEAR_____233_CM 16 0. 65.535 AXIS_PTS_REF ldp_ti_ip_mff_stnd_egy_h_mon /end AXIS_DESCR
/end CHARACTERISTIC
/begin CHARACTERISTIC ip_mff_ti_stnd_egy_l_mon "inverse standad injector characteristic at low energy level" CURVE 0xa1000d20 _REC_CUR_20_u2_u2 1389. _CNV_A_R_LINEAR_____108_CM 0. 1389. DISPLAY_IDENTIFIER IP_MFF_TI_STND_EGY_L_MON FORMAT "%7.2"
 /begin AXIS_DESCR COM_AXIS online_dummy _CNV_A_R_LINEAR_____233_CM 16 0. 65.535 AXIS_PTS_REF ldp_ti_ip_mff_stnd_egy_l_mon /end AXIS_DESCR
/end CHARACTERISTIC
/begin AXIS_PTS ldp_ti_ip_mff_stnd_egy_l_mon "" 0xa1000924 online_dummy _REC_AXS_20_u2 65.535 _CNV_A_R_LINEAR_____233_CM 16 0. 65.535 /end AXIS_PTS
/begin CHARACTERISTIC ip_egy_iv_cor_mon "additive energy correction from PWM  percentage" CURVE 0xa1000a48 _REC_CUR_20_u1_u2 255. _CNV_A_R_ECM2_LINEA_843_CM -128. 127. DISPLAY_IDENTIFIER IP_EGY_IV_COR_MON FORMAT "%7.3"
 /begin AXIS_DESCR COM_AXIS egy_level_iv_bal_mv_mon _CNV_A_R_LINEAR_____159_CM 8 -50. 49.99847412 FORMAT "%7.3" AXIS_PTS_REF ldp_egy_level_ip_egy_cor_mon /end AXIS_DESCR
/end CHARACTERISTIC
/begin AXIS_PTS ldp_ti_ip_mff_stnd_egy_h_mon "" 0xa1000900 online_dummy _REC_AXS_20_u2 65.535 _CNV_A_R_LINEAR_____233_CM 16 0. 65.535 /end AXIS_PTS
/begin AXIS_PTS ldp_n_egy_step_inj_add_mon "" 0xa1000884 n _REC_AXS_20_u2 8160. _CNV_A_R_LINEAR_____13_CM 8 0. 8160. FORMAT "%4.0" /end AXIS_PTS
/begin AXIS_PTS ldp_mff_sp_egy_step_inj_add_mon "" 0xa1000820 mff_sp_mv _REC_AXS_20_u2 1389. _CNV_A_R_LINEAR_____108_CM 8 0. 1389. FORMAT "%7.2" /end AXIS_PTS
/begin CHARACTERISTIC ip_egy_step_inj_add_cor_mon "additive energy correction depending on switching frequeqncy and timing" MAP 0xa1000a50 _REC_MAP_20_u2_u2_u2 99.99847412 _CNV_A_R_LINEAR_____159_CM -50. 49.99847412 DISPLAY_IDENTIFIER IP_EGY_STEP_INJ_ADD_COR_MON FORMAT "%7.3"
 /begin AXIS_DESCR COM_AXIS n _CNV_A_R_LINEAR_____13_CM 8 0. 8160. FORMAT "%4.0" AXIS_PTS_REF ldp_n_egy_step_inj_add_mon /end AXIS_DESCR
 /begin AXIS_DESCR COM_AXIS mff_sp_mv _CNV_A_R_LINEAR_____108_CM 8 0. 1389. FORMAT "%7.2" AXIS_PTS_REF ldp_mff_sp_egy_step_inj_add_mon /end AXIS_DESCR
/end CHARACTERISTIC
/begin AXIS_PTS ldp_tfpa_ip_fac_ti_tfpa_mon "" 0xa10008e0 tfpa _REC_AXS_20_u1 190.5 _CNV_A_R_LINEAR_____16_CM 12 -48. 142.5 FORMAT "%6.2" /end AXIS_PTS
/begin AXIS_PTS ldp_crk_dif_iga_soi_post_mon "" 0xa1000710 online_dummy _REC_AXS_20_u2 2880. _CNV_A_R_ECM2_LINEA_844_CM 6 -1440. 1440. FORMAT "%7.1" /end AXIS_PTS
/begin CHARACTERISTIC ip_fac_cor_mff_post_mon "Factor for correction of valve temperature influence on injection" MAP 0xa1000b10 _REC_MAP_20_u1_u2_u2 1.9921875 _CNV_A_R_LINEAR_____100_CM 0. 1.9921875 DISPLAY_IDENTIFIER IP_FAC_COR_MFF_POST_MON FORMAT "%8.6"
 /begin AXIS_DESCR COM_AXIS online_dummy _CNV_A_R_LINEAR_____168_CM 6 0. 720. FORMAT "%7.3" AXIS_PTS_REF ldp_crk_soi_post_mon /end AXIS_DESCR
 /begin AXIS_DESCR COM_AXIS online_dummy _CNV_A_R_ECM2_LINEA_844_CM 6 -1440. 1440. FORMAT "%7.1" AXIS_PTS_REF ldp_crk_dif_iga_soi_post_mon /end AXIS_DESCR
/end CHARACTERISTIC
/begin CHARACTERISTIC ip_prs_inc_cmp_mon "influence of the varying pressure increase inside the cylinder" MAP 0xa1000d48 _REC_MAP_20_u2_u2_u2 31.99951171875 _CNV_A_R_LINEAR_____243_CM 0. 31.99951171875 DISPLAY_IDENTIFIER IP_PRS_INC_CMP_MON FORMAT "%9.6"
 /begin AXIS_DESCR COM_AXIS online_dummy _CNV_A_R_LINEAR_____168_CM 12 0. 720. FORMAT "%7.3" AXIS_PTS_REF ldp_eoi_ip_prs_inc_cmp_mon /end AXIS_DESCR
 /begin AXIS_DESCR COM_AXIS online_dummy _CNV_A_R_LINEAR_____168_CM 16 0. 720. FORMAT "%7.3" AXIS_PTS_REF ldp_crk_inj_ip_prs_inc_cmp_mon /end AXIS_DESCR
/end CHARACTERISTIC
/begin AXIS_PTS ldp_crk_soi_post_mon "" 0xa1000744 online_dummy _REC_AXS_20_u2 720. _CNV_A_R_LINEAR_____168_CM 6 0. 720. FORMAT "%7.3" /end AXIS_PTS
/begin AXIS_PTS ldp_crk_inj_ip_prs_inc_cmp_mon "" 0xa1000720 online_dummy _REC_AXS_20_u2 720. _CNV_A_R_LINEAR_____168_CM 16 0. 720. FORMAT "%7.3" /end AXIS_PTS
/begin AXIS_PTS ldp_eoi_ip_prs_inc_cmp_mon "" 0xa1000778 online_dummy _REC_AXS_20_u2 720. _CNV_A_R_LINEAR_____168_CM 12 0. 720. FORMAT "%7.3" /end AXIS_PTS
/begin AXIS_PTS ldp_prs_dec_inj_mon "" 0xa10008a4 online_dummy _REC_AXS_20_u2 347776. _CNV_A_R_ECM2_LINEA_842_CM 12 0. 347776. FORMAT "%6.0" /end AXIS_PTS
/begin MEASUREMENT prs_dif_iv_1_mon "pressure difference at injector for first pulse" UWORD _CNV_A_R_ECM2_LINEA_842_CM 1 100. 0. 347776. DISPLAY_IDENTIFIER PRS_DIF_IV_1_MON ECU_ADDRESS 0xc000147a FORMAT "%6.0" /end MEASUREMENT
/begin MEASUREMENT prs_dif_iv_2_mon "pressure difference at injector for second pulse" UWORD _CNV_A_R_ECM2_LINEA_842_CM 1 100. 0. 347776. DISPLAY_IDENTIFIER PRS_DIF_IV_2_MON ECU_ADDRESS 0xc000147c FORMAT "%6.0" /end MEASUREMENT
/begin MEASUREMENT prs_dif_iv_post_mon "pressure difference at injector for post pulse" UWORD _CNV_A_R_ECM2_LINEA_842_CM 1 100. 0. 347776. DISPLAY_IDENTIFIER PRS_DIF_IV_POST_MON ECU_ADDRESS 0xc000147e FORMAT "%6.0" /end MEASUREMENT
/begin MEASUREMENT union_instance_kwp_ddli.obd_tco "" UBYTE _CNV_A_R_LINEAR_____25_CM 1 100. -40. 215. DISPLAY_IDENTIFIER OBD_TCO ECU_ADDRESS 0xc00029ac FORMAT "%3.0" /end MEASUREMENT
/begin MEASUREMENT union_instance_kwp_ddli.obd_lam_cor[0] "" UBYTE _CNV_A_R_LINEAR_____845_CM 1 100. -100. 99.21875 DISPLAY_IDENTIFIER OBD_LAM_COR[1] ECU_ADDRESS 0xc00029ac FORMAT "%10.5" /end MEASUREMENT
/begin MEASUREMENT union_instance_kwp_ddli.obd_lam_cor[1] "" UBYTE _CNV_A_R_LINEAR_____845_CM 1 100. -100. 99.21875 DISPLAY_IDENTIFIER OBD_LAM_COR[2] ECU_ADDRESS 0xc00029ad FORMAT "%10.5" /end MEASUREMENT
/begin MEASUREMENT union_instance_kwp_ddli.obd_lam_ad[0] "" UBYTE _CNV_A_R_LINEAR_____845_CM 1 100. -100. 99.21875 DISPLAY_IDENTIFIER OBD_LAM_AD[1] ECU_ADDRESS 0xc00029ac FORMAT "%10.5" /end MEASUREMENT
/begin MEASUREMENT union_instance_kwp_ddli.obd_lam_ad[1] "" UBYTE _CNV_A_R_LINEAR_____845_CM 1 100. -100. 99.21875 DISPLAY_IDENTIFIER OBD_LAM_AD[2] ECU_ADDRESS 0xc00029ad FORMAT "%10.5" /end MEASUREMENT
/begin MEASUREMENT union_instance_kwp_ddli.obd_fup "" UBYTE _CNV_A_R_LINEAR_____846_CM 1 100. 0. 765. DISPLAY_IDENTIFIER OBD_FUP ECU_ADDRESS 0xc00029ac FORMAT "%4.0" /end MEASUREMENT
/begin MEASUREMENT union_instance_kwp_ddli.obd_map "" UBYTE _CNV_A_R_LINEAR_____847_CM 1 100. 0. 255. DISPLAY_IDENTIFIER OBD_MAP ECU_ADDRESS 0xc00029ac FORMAT "%3.0" /end MEASUREMENT
/begin MEASUREMENT union_instance_kwp_ddli.obd_n "" UWORD _CNV_A_R_LINEAR_____848_CM 1 100. 0. 8160. DISPLAY_IDENTIFIER OBD_N ECU_ADDRESS 0xc00029ac FORMAT "%6.1" /end MEASUREMENT
/begin MEASUREMENT union_instance_kwp_ddli.obd_iga_igc "" UBYTE _CNV_A_R_LINEAR_____849_CM 1 100. -64. 63.5 DISPLAY_IDENTIFIER OBD_IGA_IGC ECU_ADDRESS 0xc00029ac FORMAT "%4.0" /end MEASUREMENT
/begin MEASUREMENT union_instance_kwp_ddli.obd_tia "" UBYTE _CNV_A_R_LINEAR_____25_CM 1 100. -40. 215. DISPLAY_IDENTIFIER OBD_TIA ECU_ADDRESS 0xc00029ac FORMAT "%3.0" /end MEASUREMENT
/begin MEASUREMENT union_instance_kwp_ddli.obd_maf "" UWORD _CNV_A_R_LINEAR_____850_CM 1 100. 0. 655.35 DISPLAY_IDENTIFIER OBD_MAF ECU_ADDRESS 0xc00029ac FORMAT "%10.3" /end MEASUREMENT
/begin MEASUREMENT union_instance_kwp_ddli.lamb_kwp[0] "" UBYTE _CNV_A_R_LINEAR_____851_CM 1 100. 0. 0.24902344 DISPLAY_IDENTIFIER LAMB_KWP[1] ECU_ADDRESS 0xc00029ac FORMAT "%10.6" /end MEASUREMENT
/begin MEASUREMENT union_instance_kwp_ddli.lamb_kwp[1] "" UBYTE _CNV_A_R_LINEAR_____851_CM 1 100. 0. 0.24902344 DISPLAY_IDENTIFIER LAMB_KWP[2] ECU_ADDRESS 0xc00029ad FORMAT "%10.6" /end MEASUREMENT
/begin MEASUREMENT union_instance_kwp_ddli.n_max_scdn_mis_32_kwp "" UBYTE _CNV_A_R_LINEAR_____9_CM 1 100. 0. 8160. DISPLAY_IDENTIFIER N_MAX_SCDN_MIS_32_KWP ECU_ADDRESS 0xc00029ac FORMAT "%4.0" /end MEASUREMENT
/begin MEASUREMENT union_instance_kwp_ddli.n_min_scdn_mis_32_kwp "" UBYTE _CNV_A_R_LINEAR_____9_CM 1 100. 0. 8160. DISPLAY_IDENTIFIER N_MIN_SCDN_MIS_32_KWP ECU_ADDRESS 0xc00029ac FORMAT "%4.0" /end MEASUREMENT
/begin MEASUREMENT union_instance_kwp_ddli.r_it_ls_down_kwp_h[0] "" UBYTE _CNV_A_R_LINEAR_____852_CM 1 100. 0. 65280. DISPLAY_IDENTIFIER R_IT_LS_DOWN_KWP_H[1] ECU_ADDRESS 0xc00029ac FORMAT "%9.2" /end MEASUREMENT
/begin MEASUREMENT union_instance_kwp_ddli.r_it_ls_down_kwp_h[1] "" UBYTE _CNV_A_R_LINEAR_____852_CM 1 100. 0. 65280. DISPLAY_IDENTIFIER R_IT_LS_DOWN_KWP_H[2] ECU_ADDRESS 0xc00029ad FORMAT "%9.2" /end MEASUREMENT
/begin MEASUREMENT union_instance_kwp_ddli.r_it_ls_down_kwp_l[0] "" UBYTE _CNV_A_R_LINEAR_____853_CM 1 100. 0. 255. DISPLAY_IDENTIFIER R_IT_LS_DOWN_KWP_L[1] ECU_ADDRESS 0xc00029ac FORMAT "%9.2" /end MEASUREMENT
/begin MEASUREMENT union_instance_kwp_ddli.r_it_ls_down_kwp_l[1] "" UBYTE _CNV_A_R_LINEAR_____853_CM 1 100. 0. 255. DISPLAY_IDENTIFIER R_IT_LS_DOWN_KWP_L[2] ECU_ADDRESS 0xc00029ad FORMAT "%9.2" /end MEASUREMENT
/begin MEASUREMENT union_instance_kwp_ddli.r_it_ls_up_kwp_h[0] "" UBYTE _CNV_A_R_LINEAR_____854_CM 1 100. 0. 16320. DISPLAY_IDENTIFIER R_IT_LS_UP_KWP_H[1] ECU_ADDRESS 0xc00029ac FORMAT "%9.2" /end MEASUREMENT
/begin MEASUREMENT union_instance_kwp_ddli.r_it_ls_up_kwp_h[1] "" UBYTE _CNV_A_R_LINEAR_____854_CM 1 100. 0. 16320. DISPLAY_IDENTIFIER R_IT_LS_UP_KWP_H[2] ECU_ADDRESS 0xc00029ad FORMAT "%9.2" /end MEASUREMENT
/begin MEASUREMENT union_instance_kwp_ddli.r_it_ls_up_kwp_l[0] "" UBYTE _CNV_A_R_LINEAR_____855_CM 1 100. 0. 63.75 DISPLAY_IDENTIFIER R_IT_LS_UP_KWP_L[1] ECU_ADDRESS 0xc00029ac FORMAT "%9.2" /end MEASUREMENT
/begin MEASUREMENT union_instance_kwp_ddli.r_it_ls_up_kwp_l[1] "" UBYTE _CNV_A_R_LINEAR_____855_CM 1 100. 0. 63.75 DISPLAY_IDENTIFIER R_IT_LS_UP_KWP_L[2] ECU_ADDRESS 0xc00029ad FORMAT "%9.2" /end MEASUREMENT
/begin MEASUREMENT union_instance_kwp_ddli.t_es_kwp "" UBYTE _CNV_A_R_LINEAR_____856_CM 1 100. 0. 1020. DISPLAY_IDENTIFIER T_ES_KWP ECU_ADDRESS 0xc00029ac FORMAT "%5.0" /end MEASUREMENT
/begin MEASUREMENT union_instance_kwp_ddli.tps_ad_step_kwp "" UBYTE _CNV_A_R_LINEAR_____0_CM 1 100. 0. 255. DISPLAY_IDENTIFIER TPS_AD_STEP_KWP ECU_ADDRESS 0xc00029ac FORMAT "%3.0" /end MEASUREMENT
/begin MEASUREMENT union_instance_kwp_ddli.v_amp_kwp "" UBYTE _CNV_A_R_LINEAR_____195_CM 1 100. 0. 4.98046875 DISPLAY_IDENTIFIER V_AMP_KWP ECU_ADDRESS 0xc00029ac FORMAT "%4.2" /end MEASUREMENT
/begin MEASUREMENT union_instance_kwp_ddli.v_dmtl_kwp "" UBYTE _CNV_A_R_LINEAR_____195_CM 1 100. 0. 4.98046875 DISPLAY_IDENTIFIER V_DMTL_KWP ECU_ADDRESS 0xc00029ac FORMAT "%4.2" /end MEASUREMENT
/begin MEASUREMENT union_instance_kwp_ddli.vls_down_kwp[0] "" UBYTE _CNV_A_R_LINEAR_____195_CM 1 100. 0. 4.98046875 DISPLAY_IDENTIFIER VLS_DOWN_KWP[1] ECU_ADDRESS 0xc00029ac FORMAT "%4.2" /end MEASUREMENT
/begin MEASUREMENT union_instance_kwp_ddli.vls_down_kwp[1] "" UBYTE _CNV_A_R_LINEAR_____195_CM 1 100. 0. 4.98046875 DISPLAY_IDENTIFIER VLS_DOWN_KWP[2] ECU_ADDRESS 0xc00029ad FORMAT "%4.2" /end MEASUREMENT
/begin MEASUREMENT union_instance_kwp_ddli.vls_up_kwp[0] "" UBYTE _CNV_A_R_LINEAR_____195_CM 1 100. 0. 4.98046875 DISPLAY_IDENTIFIER VLS_UP_KWP[1] ECU_ADDRESS 0xc00029ac FORMAT "%4.2" /end MEASUREMENT
/begin MEASUREMENT union_instance_kwp_ddli.vls_up_kwp[1] "" UBYTE _CNV_A_R_LINEAR_____195_CM 1 100. 0. 4.98046875 DISPLAY_IDENTIFIER VLS_UP_KWP[2] ECU_ADDRESS 0xc00029ad FORMAT "%4.2" /end MEASUREMENT
/begin MEASUREMENT union_instance_kwp_ddli.v_pvs_1_kwp "" UBYTE _CNV_A_R_LINEAR_____195_CM 1 100. 0. 4.98046875 DISPLAY_IDENTIFIER V_PVS_1_KWP ECU_ADDRESS 0xc00029ac FORMAT "%4.2" /end MEASUREMENT
/begin MEASUREMENT union_instance_kwp_ddli.v_pvs_2_kwp "" UBYTE _CNV_A_R_LINEAR_____195_CM 1 100. 0. 4.98046875 DISPLAY_IDENTIFIER V_PVS_2_KWP ECU_ADDRESS 0xc00029ac FORMAT "%4.2" /end MEASUREMENT
/begin MEASUREMENT union_instance_kwp_ddli.v_sof_swi_kwp "" UBYTE _CNV_A_R_LINEAR_____195_CM 1 100. 0. 4.98046875 DISPLAY_IDENTIFIER V_SOF_SWI_KWP ECU_ADDRESS 0xc00029ac FORMAT "%4.2" /end MEASUREMENT
/begin MEASUREMENT union_instance_kwp_ddli.v_tco_2_kwp "" UBYTE _CNV_A_R_LINEAR_____195_CM 1 100. 0. 4.98046875 DISPLAY_IDENTIFIER V_TCO_2_KWP ECU_ADDRESS 0xc00029ac FORMAT "%4.2" /end MEASUREMENT
/begin MEASUREMENT union_instance_kwp_ddli.v_tco_kwp "" UBYTE _CNV_A_R_LINEAR_____195_CM 1 100. 0. 4.98046875 DISPLAY_IDENTIFIER V_TCO_KWP ECU_ADDRESS 0xc00029ac FORMAT "%4.2" /end MEASUREMENT
/begin MEASUREMENT union_instance_kwp_ddli.v_tecu_kwp "" UBYTE _CNV_A_R_LINEAR_____195_CM 1 100. 0. 4.98046875 DISPLAY_IDENTIFIER V_TECU_KWP ECU_ADDRESS 0xc00029ac FORMAT "%4.2" /end MEASUREMENT
/begin MEASUREMENT union_instance_kwp_ddli.v_tps_1_kwp "" UBYTE _CNV_A_R_LINEAR_____195_CM 1 100. 0. 4.98046875 DISPLAY_IDENTIFIER V_TPS_1_KWP ECU_ADDRESS 0xc00029ac FORMAT "%4.2" /end MEASUREMENT
/begin MEASUREMENT union_instance_kwp_ddli.v_tps_2_kwp "" UBYTE _CNV_A_R_LINEAR_____195_CM 1 100. 0. 4.98046875 DISPLAY_IDENTIFIER V_TPS_2_KWP ECU_ADDRESS 0xc00029ac FORMAT "%4.2" /end MEASUREMENT
/begin MEASUREMENT union_instance_kwp_ddli.vb_bas_kwp "" UBYTE _CNV_A_R_LINEAR_____195_CM 1 100. 0. 4.98046875 DISPLAY_IDENTIFIER VB_BAS_KWP ECU_ADDRESS 0xc00029ac FORMAT "%4.2" /end MEASUREMENT
/begin MEASUREMENT union_instance_kwp_ddli.vcc_pvs_1_kwp "" UBYTE _CNV_A_R_LINEAR_____857_CM 1 100. 0. 9.960938000000001 DISPLAY_IDENTIFIER VCC_PVS_1_KWP ECU_ADDRESS 0xc00029ac /end MEASUREMENT
/begin MEASUREMENT union_instance_kwp_ddli.vcc_pvs_2_kwp "" UBYTE _CNV_A_R_LINEAR_____857_CM 1 100. 0. 9.960938000000001 DISPLAY_IDENTIFIER VCC_PVS_2_KWP ECU_ADDRESS 0xc00029ac /end MEASUREMENT
/begin MEASUREMENT union_instance_kwp_ddli.vls_dif_lam_adj_kwp[0] "" SBYTE _CNV_A_R_LINEAR_____858_CM 1 100. -0.625 0.6201100000000001 DISPLAY_IDENTIFIER VLS_DIF_LAM_ADJ_KWP[1] ECU_ADDRESS 0xc00029ac FORMAT "%7.6" /end MEASUREMENT
/begin MEASUREMENT union_instance_kwp_ddli.vls_dif_lam_adj_kwp[1] "" SBYTE _CNV_A_R_LINEAR_____858_CM 1 100. -0.625 0.6201100000000001 DISPLAY_IDENTIFIER VLS_DIF_LAM_ADJ_KWP[2] ECU_ADDRESS 0xc00029ad FORMAT "%7.6" /end MEASUREMENT
/begin MEASUREMENT union_instance_kwp_ddli.vls_ofs_lsl_kwp[0] "" SBYTE _CNV_A_R_LINEAR_____858_CM 1 100. -0.625 0.6201100000000001 DISPLAY_IDENTIFIER VLS_OFS_LSL_KWP[1] ECU_ADDRESS 0xc00029ac FORMAT "%7.6" /end MEASUREMENT
/begin MEASUREMENT union_instance_kwp_ddli.vls_ofs_lsl_kwp[1] "" SBYTE _CNV_A_R_LINEAR_____858_CM 1 100. -0.625 0.6201100000000001 DISPLAY_IDENTIFIER VLS_OFS_LSL_KWP[2] ECU_ADDRESS 0xc00029ad FORMAT "%7.6" /end MEASUREMENT
/begin MEASUREMENT union_instance_kwp_ddli.cur_dmtl_ref_leak_kwp "" UBYTE _CNV_A_R_LINEAR_____859_CM 1 100. 0. 49.80468 DISPLAY_IDENTIFIER CUR_DMTL_REF_LEAK_KWP ECU_ADDRESS 0xc00029ac FORMAT "%7.6" /end MEASUREMENT
/begin MEASUREMENT union_instance_kwp_ddli.cur_dmtl_rough_leak_min_kwp "" UBYTE _CNV_A_R_LINEAR_____859_CM 1 100. 0. 49.80468 DISPLAY_IDENTIFIER CUR_DMTL_ROUGH_LEAK_MIN_KWP ECU_ADDRESS 0xc00029ac FORMAT "%7.6" /end MEASUREMENT
/begin MEASUREMENT union_instance_kwp_ddli.cur_dmtl_cor_fil_kwp "" UBYTE _CNV_A_R_LINEAR_____859_CM 1 100. 0. 49.80468 DISPLAY_IDENTIFIER CUR_DMTL_COR_FIL_KWP ECU_ADDRESS 0xc00029ac FORMAT "%7.6" /end MEASUREMENT
/begin MEASUREMENT union_instance_kwp_ddli.v_igk_bas_kwp "" UBYTE _CNV_A_R_LINEAR_____195_CM 1 100. 0. 4.98046875 DISPLAY_IDENTIFIER V_IGK_BAS_KWP ECU_ADDRESS 0xc00029ac FORMAT "%4.2" /end MEASUREMENT
/begin MEASUREMENT union_instance_kwp_ddli.obd_t_ast "Time since engine start SAE J1979" UWORD _CNV_A_R_LINEAR_____35_CM 1 100. 0. 65535. DISPLAY_IDENTIFIER OBD_T_AST ECU_ADDRESS 0xc00029ac FORMAT "%5.0" /end MEASUREMENT
/begin MEASUREMENT union_instance_kwp_ddli.obd_amp "Barometric pressure SAE J1979" UBYTE _CNV_A_R_LINEAR_____847_CM 1 100. 0. 255. DISPLAY_IDENTIFIER OBD_AMP ECU_ADDRESS 0xc00029ac FORMAT "%3.0" /end MEASUREMENT
/begin MEASUREMENT union_instance_kwp_ddli.obd_vb "Control module voltage SAE J1979" UWORD _CNV_A_R_LINEAR_____860_CM 1 100. 0. 65.535 DISPLAY_IDENTIFIER OBD_VB ECU_ADDRESS 0xc00029ac /end MEASUREMENT
/begin MEASUREMENT union_instance_kwp_ddli.obd_lamb_sp "Commanded equivalence ratio SAE J1979" UWORD _CNV_A_R_LINEAR_____8_CM 1 100. 0. 1.99996948242188 DISPLAY_IDENTIFIER OBD_LAMB_SP ECU_ADDRESS 0xc00029ac FORMAT "%7.5" /end MEASUREMENT
/begin MEASUREMENT union_instance_kwp_ddli.obd_tam "Ambient air temperature SAE J1979" UBYTE _CNV_A_R_LINEAR_____25_CM 1 100. -40. 215. DISPLAY_IDENTIFIER OBD_TAM ECU_ADDRESS 0xc00029ac FORMAT "%3.0" /end MEASUREMENT
/begin MEASUREMENT union_instance_kwp_ddli.n_sae_byte_kwp "Ambient air temperature SAE J1979" UBYTE _CNV_A_R_LINEAR_____861_CM 1 100. 0. 16320. DISPLAY_IDENTIFIER N_SAE_BYTE_KWP ECU_ADDRESS 0xc00029ac FORMAT "%8.2" /end MEASUREMENT
/begin MEASUREMENT union_instance_kwp_ddli.v_alter_sp_kwp "setpoint alternator 1 voltage converted for KWP" UBYTE _CNV_A_R_LINEAR_____440_CM 1 100. 0. 25.5 DISPLAY_IDENTIFIER V_ALTER_SP_KWP ECU_ADDRESS 0xc00029ac FORMAT "%4.1" /end MEASUREMENT
/begin MEASUREMENT union_instance_kwp_ddli.fac_mv_diag_dyn_lsl_up_kwp "Mean value of normalised single sensor signal amplitude converted for KWP" UBYTE _CNV_A_R_LINEAR_____862_CM 1 100. 0. 1.02 DISPLAY_IDENTIFIER FAC_MV_DIAG_DYN_LSL_UP_KWP ECU_ADDRESS 0xc00029ac FORMAT "%4.2" /end MEASUREMENT
/begin MEASUREMENT union_instance_kwp_ddli.poil_kwp "Oilpressure converted for KWP" UBYTE _CNV_A_R_LINEAR_____863_CM 1 100. 0. 8160. DISPLAY_IDENTIFIER POIL_KWP ECU_ADDRESS 0xc00029ac FORMAT "%4.0" /end MEASUREMENT
/begin COMPU_METHOD _CNV_A_R_LINEAR_____0_CM "" RAT_FUNC "%6.3" "-" COEFFS 0 1. 0. 0 0 1 /end COMPU_METHOD
/begin COMPU_METHOD _CNV_S_2_RANGE__0___1_CM "" TAB_VERB "%6.3" "-" COMPU_TAB_REF _CNV_S_2_RANGE__0___1 /end COMPU_METHOD
/begin COMPU_VTAB _CNV_S_2_RANGE__0___1 "" TAB_VERB 2 0 "0" 1 "1" /end COMPU_VTAB
/begin COMPU_METHOD _CNV_A_R_LINEAR_____8_CM "" RAT_FUNC "%6.3" "-" COEFFS 0 32767.99999999992 0. 0 0 1 /end COMPU_METHOD
/begin COMPU_METHOD _CNV_A_R_LINEAR_____9_CM "" RAT_FUNC "%6.3" "rpm" COEFFS 0 3.125e-002 0. 0 0 1 /end COMPU_METHOD
/begin COMPU_METHOD _CNV_A_R_LINEAR_____13_CM "" RAT_FUNC "%6.3" "rpm" COEFFS 0 1. 0. 0 0 1 /end COMPU_METHOD
/begin COMPU_METHOD _CNV_A_R_LINEAR_____16_CM "" RAT_FUNC "%6.3" "°C" COEFFS 0 1.333333333333333 64. 0 0 1 /end COMPU_METHOD
/begin COMPU_METHOD _CNV_A_R_LINEAR_____25_CM "" RAT_FUNC "%6.3" "°C" COEFFS 0 1. 40. 0 0 1 /end COMPU_METHOD
/begin COMPU_METHOD _CNV_A_R_LINEAR_____35_CM "" RAT_FUNC "%6.3" "s" COEFFS 0 1. 0. 0 0 1 /end COMPU_METHOD
/begin COMPU_METHOD _CNV_A_R_LINEAR_____100_CM "" RAT_FUNC "%6.3" "-" COEFFS 0 128. 0. 0 0 1 /end COMPU_METHOD
/begin COMPU_METHOD _CNV_A_R_LINEAR_____108_CM "" RAT_FUNC "%6.3" "mg/stk" COEFFS 0 47.18142548596112 0. 0 0 1 /end COMPU_METHOD
/begin COMPU_METHOD _CNV_A_R_LINEAR_____110_CM "" RAT_FUNC "%6.3" "%" COEFFS 0 655.3599999999997 -1.455191522836685e-011 0 0 1 /end COMPU_METHOD
/begin COMPU_METHOD _CNV_A_R_LINEAR_____115_CM "" RAT_FUNC "%6.3" "-" COEFFS 0 4096. 0. 0 0 1 /end COMPU_METHOD
/begin COMPU_METHOD _CNV_A_R_LINEAR_____122_CM "" RAT_FUNC "%6.3" "-" COEFFS 0 1024. 0. 0 0 1 /end COMPU_METHOD
/begin COMPU_METHOD _CNV_A_R_LINEAR_____159_CM "" RAT_FUNC "%6.3" "%" COEFFS 0 655.3600000071681 32768.00000035841 0 0 1 /end COMPU_METHOD
/begin COMPU_METHOD _CNV_A_R_LINEAR_____168_CM "" RAT_FUNC "%6.3" "°CRK" COEFFS 0 2.666666666666667 0. 0 0 1 /end COMPU_METHOD
/begin COMPU_METHOD _CNV_A_R_LINEAR_____195_CM "" RAT_FUNC "%6.3" "V" COEFFS 0 51.2 0. 0 0 1 /end COMPU_METHOD
/begin COMPU_METHOD _CNV_A_R_LINEAR_____202_CM "" RAT_FUNC "%6.3" "mg/stk" COEFFS 0 47.18142548596112 -1.455191522836685e-011 0 0 1 /end COMPU_METHOD
/begin COMPU_METHOD _CNV_A_R_LINEAR_____233_CM "" RAT_FUNC "%6.3" "ms" COEFFS 0 1000. 0. 0 0 1 /end COMPU_METHOD
/begin COMPU_METHOD _CNV_A_R_LINEAR_____243_CM "" RAT_FUNC "%6.3" "-" COEFFS 0 2048. 0. 0 0 1 /end COMPU_METHOD
/begin COMPU_METHOD _CNV_A_R_LINEAR_____280_CM "" RAT_FUNC "%6.3" "Nm" COEFFS 0 0.5 0. 0 0 1 /end COMPU_METHOD
/begin COMPU_METHOD _CNV_A_R_LINEAR_____401_CM "" RAT_FUNC "%6.3" "µs" COEFFS 0 1. 0. 0 0 1 /end COMPU_METHOD
/begin COMPU_METHOD _CNV_A_R_LINEAR_____440_CM "" RAT_FUNC "%6.3" "V" COEFFS 0 10. 0. 0 0 1 /end COMPU_METHOD
/begin COMPU_METHOD _CNV_A_R_INJR_LINEA_478_CM "" RAT_FUNC "%6.3" "mJ" COEFFS 0 257. 0. 0 0 1 /end COMPU_METHOD
/begin COMPU_METHOD _CNV_A_R_LINEAR_____841_CM "" RAT_FUNC "%6.3" "-" COEFFS 0 655.3599999999997 -1.455191522836685e-011 0 0 1 /end COMPU_METHOD
/begin COMPU_METHOD _CNV_A_R_ECM2_LINEA_842_CM "" RAT_FUNC "%6.3" "mJ" COEFFS 0 0.1884402603974972 0. 0 0 1 /end COMPU_METHOD
/begin COMPU_METHOD _CNV_A_R_ECM2_LINEA_843_CM "" RAT_FUNC "%6.3" "mJ" COEFFS 0 1. 128. 0 0 1 /end COMPU_METHOD
/begin COMPU_METHOD _CNV_A_R_ECM2_LINEA_844_CM "" RAT_FUNC "%6.3" "°CRK" COEFFS 0 2.666666666666667 3840. 0 0 1 /end COMPU_METHOD
/begin COMPU_METHOD _CNV_A_R_LINEAR_____845_CM "" RAT_FUNC "%6.3" "%" COEFFS 0 1.28 128. 0 0 1 /end COMPU_METHOD
/begin COMPU_METHOD _CNV_A_R_LINEAR_____846_CM "" RAT_FUNC "%6.3" "kPa" COEFFS 0 0.3333333333333333 0. 0 0 1 /end COMPU_METHOD
/begin COMPU_METHOD _CNV_A_R_LINEAR_____847_CM "" RAT_FUNC "%6.3" "kPa" COEFFS 0 1. 0. 0 0 1 /end COMPU_METHOD
/begin COMPU_METHOD _CNV_A_R_LINEAR_____848_CM "" RAT_FUNC "%6.3" "rpm" COEFFS 0 4. 0. 0 0 1 /end COMPU_METHOD
/begin COMPU_METHOD _CNV_A_R_LINEAR_____849_CM "" RAT_FUNC "%6.3" "°CRK" COEFFS 0 2. 128. 0 0 1 /end COMPU_METHOD
/begin COMPU_METHOD _CNV_A_R_LINEAR_____850_CM "" RAT_FUNC "%6.3" "g/s" COEFFS 0 100. 0. 0 0 1 /end COMPU_METHOD
/begin COMPU_METHOD _CNV_A_R_LINEAR_____851_CM "" RAT_FUNC "%6.3" "-" COEFFS 0 1023.999989719843 0. 0 0 1 /end COMPU_METHOD
/begin COMPU_METHOD _CNV_A_R_LINEAR_____852_CM "" RAT_FUNC "%6.3" "ohm" COEFFS 0 3.90625e-003 0. 0 0 1 /end COMPU_METHOD
/begin COMPU_METHOD _CNV_A_R_LINEAR_____853_CM "" RAT_FUNC "%6.3" "ohm" COEFFS 0 1. 0. 0 0 1 /end COMPU_METHOD
/begin COMPU_METHOD _CNV_A_R_LINEAR_____854_CM "" RAT_FUNC "%6.3" "ohm" COEFFS 0 1.5625e-002 0. 0 0 1 /end COMPU_METHOD
/begin COMPU_METHOD _CNV_A_R_LINEAR_____855_CM "" RAT_FUNC "%6.3" "ohm" COEFFS 0 4. 0. 0 0 1 /end COMPU_METHOD
/begin COMPU_METHOD _CNV_A_R_LINEAR_____856_CM "" RAT_FUNC "%6.3" "min" COEFFS 0 0.25 0. 0 0 1 /end COMPU_METHOD
/begin COMPU_METHOD _CNV_A_R_LINEAR_____857_CM "" RAT_FUNC "%6.3" "V" COEFFS 0 25.59999871498046 0. 0 0 1 /end COMPU_METHOD
/begin COMPU_METHOD _CNV_A_R_LINEAR_____858_CM "" RAT_FUNC "%6.3" "V" COEFFS 0 204.8011822248637 7.388905397931467e-004 0 0 1 /end COMPU_METHOD
/begin COMPU_METHOD _CNV_A_R_LINEAR_____859_CM "" RAT_FUNC "%6.3" "mA" COEFFS 0 5.120000771011881 0. 0 0 1 /end COMPU_METHOD
/begin COMPU_METHOD _CNV_A_R_LINEAR_____860_CM "" RAT_FUNC "%6.3" "V" COEFFS 0 1000. 0. 0 0 1 /end COMPU_METHOD
/begin COMPU_METHOD _CNV_A_R_LINEAR_____861_CM "" RAT_FUNC "%6.3" "rpm" COEFFS 0 1.5625e-002 0. 0 0 1 /end COMPU_METHOD
/begin COMPU_METHOD _CNV_A_R_LINEAR_____862_CM "" RAT_FUNC "%6.3" "-" COEFFS 0 250. 0. 0 0 1 /end COMPU_METHOD
/begin COMPU_METHOD _CNV_A_R_LINEAR_____863_CM "" RAT_FUNC "%6.3" "" COEFFS 0 3.125e-002 0. 0 0 1 /end COMPU_METHOD
/begin RECORD_LAYOUT _REC_VAL_20_u1 FNC_VALUES 1 UBYTE COLUMN_DIR DIRECT /end RECORD_LAYOUT
/begin RECORD_LAYOUT _REC_VAL_20_u2 FNC_VALUES 1 UWORD COLUMN_DIR DIRECT /end RECORD_LAYOUT
/begin RECORD_LAYOUT _REC_AXS_20_u1 NO_AXIS_PTS_X 1 UBYTE AXIS_PTS_X 2 UBYTE INDEX_INCR DIRECT /end RECORD_LAYOUT
/begin RECORD_LAYOUT _REC_MAP_20_u2_u1_u1 FNC_VALUES 1 UWORD COLUMN_DIR DIRECT /end RECORD_LAYOUT
/begin RECORD_LAYOUT _REC_VAL_20_s2 FNC_VALUES 1 SWORD COLUMN_DIR DIRECT /end RECORD_LAYOUT
/begin RECORD_LAYOUT _REC_AXS_20_u2 NO_AXIS_PTS_X 1 UWORD AXIS_PTS_X 2 UWORD INDEX_INCR DIRECT /end RECORD_LAYOUT
/begin RECORD_LAYOUT _REC_CUR_20_u2_u1 FNC_VALUES 1 UWORD COLUMN_DIR DIRECT /end RECORD_LAYOUT
/begin RECORD_LAYOUT _REC_CUR_20_u2_u2 FNC_VALUES 1 UWORD COLUMN_DIR DIRECT /end RECORD_LAYOUT
/begin RECORD_LAYOUT _REC_CUR_20_u1_u2 FNC_VALUES 1 UBYTE COLUMN_DIR DIRECT /end RECORD_LAYOUT
/begin RECORD_LAYOUT _REC_MAP_20_u2_u2_u2 FNC_VALUES 1 UWORD COLUMN_DIR DIRECT /end RECORD_LAYOUT
/begin RECORD_LAYOUT _REC_MAP_20_u1_u2_u2 FNC_VALUES 1 UBYTE COLUMN_DIR DIRECT /end RECORD_LAYOUT
/begin FUNCTION ECM2_Actual_fuel_mass_flow "Actual_fuel_mass_flow"
 /begin DEF_CHARACTERISTIC c_thd_high_egy_level_mon c_thd_min_egy_level_mon c_thd_mff_ad_fac_max_mon c_thd_mff_ad_add_max_mon ldp_egy_level_ip_egy_cor_mon ip_fac_ti_prs_mon ip_fac_ti_tfpa_mon ip_fac_ti_tfu_mon ldp_tfu_ip_fac_ti_tfu_mon ip_mff_ti_stnd_egy_h_mon ip_mff_ti_stnd_egy_l_mon ldp_ti_ip_mff_stnd_egy_l_mon ip_egy_iv_cor_mon ldp_ti_ip_mff_stnd_egy_h_mon ldp_n_egy_step_inj_add_mon ldp_mff_sp_egy_step_inj_add_mon ip_egy_step_inj_add_cor_mon ldp_tfpa_ip_fac_ti_tfpa_mon ldp_crk_dif_iga_soi_post_mon ip_fac_cor_mff_post_mon ip_prs_inc_cmp_mon ldp_crk_soi_post_mon ldp_crk_inj_ip_prs_inc_cmp_mon ldp_eoi_ip_prs_inc_cmp_mon ldp_prs_dec_inj_mon /end DEF_CHARACTERISTIC
 /begin OUT_MEASUREMENT mff_tq_mon mff_lamb_mon mff_lamb_ref_mon mff_iv_1_mon mff_iv_2_mon mff_iv_post_mon egy_level_iv_2_mon egy_level_iv_post_mon egy_level_iv_1_mon egy_level_iv_bal_mv_mon ti_add_mv_mon ti_iv_1_cor_mon ti_iv_2_cor_mon ti_iv_post_cor_mon fac_ti_mv_mon prs_dif_iv_1_mon prs_dif_iv_2_mon prs_dif_iv_post_mon /end OUT_MEASUREMENT
/end FUNCTION
/begin FUNCTION ECM2_Cmb_mode_switch_requests "Cmb_mode_switch_requests" /begin OUT_MEASUREMENT lv_swi_afs_mon /end OUT_MEASUREMENT /end FUNCTION
/begin FUNCTION ECM2_Mon_of_mass_fuel_flow "Mon_of_mass_fuel_flow"
 /begin DEF_CHARACTERISTIC c_abc_inc_mff_afs_mon c_abc_max_mff_afs_mon c_abc_inc_mff_not_afs_mon c_abc_max_mff_not_afs_mon c_abc_inc_swi_afs_mff_mon c_abc_max_swi_afs_mff_mon c_lamb_dif_sum_max_mon ldp_n_32_mon_ip_lamb_dif_mon ldp_tqi_sp_mon_ip_lamb_dif_mon ip_lamb_dif_thd_mon /end DEF_CHARACTERISTIC
 /begin OUT_MEASUREMENT lv_err_mff_mon lv_err_plaus_lamb_dif_mon lv_swi_afs_mff_mon abc_swi_afs_mff_mon abc_mff_afs_mon abc_mff_not_afs_mon /end OUT_MEASUREMENT
/end FUNCTION
/begin FUNCTION ECM2_Err_mem_mng_process_mon_AI "Err_mem_mng_process_mon_AI"
 /begin OUT_MEASUREMENT envd_0_conv_mon envd_1_conv_mon envd_2_conv_mon envd_3_conv_mon envd_0_n_32_mon envd_1_n_32_mon envd_2_n_32_mon envd_3_n_32_mon envd_3_pvs_mon envd_2_pvs_mon envd_1_pvs_mon envd_0_pvs_mon envd_0_cru_mon envd_1_cru_mon envd_2_cru_mon envd_3_cru_mon envd_3_tqi_av_mon envd_2_tqi_av_mon envd_1_tqi_av_mon envd_0_tqi_av_mon envd_0_mff_mon envd_1_mff_mon envd_2_mff_mon envd_3_mff_mon envd_3_tq_dif_isc_mon envd_2_tq_dif_isc_mon envd_1_tq_dif_isc_mon envd_0_tq_dif_isc_mon envd_0_tq_req_mon envd_1_tq_req_mon envd_2_tq_req_mon envd_3_tq_req_mon envd_3_tq_ext_mon envd_2_tq_ext_mon envd_0_tq_ext_mon envd_1_tq_ext_mon envd_0_tqi_n_max_mon envd_1_tqi_n_max_mon envd_2_tqi_n_max_mon envd_3_tqi_n_max_mon /end OUT_MEASUREMENT
/end FUNCTION
/begin FUNCTION KWP_DDLI ""
 /begin OUT_MEASUREMENT union_instance_kwp_ddli.obd_tco union_instance_kwp_ddli.obd_lam_cor[0] union_instance_kwp_ddli.obd_lam_cor[1] union_instance_kwp_ddli.obd_lam_ad[0] union_instance_kwp_ddli.obd_lam_ad[1] union_instance_kwp_ddli.obd_fup union_instance_kwp_ddli.obd_map union_instance_kwp_ddli.obd_n union_instance_kwp_ddli.obd_iga_igc union_instance_kwp_ddli.obd_tia union_instance_kwp_ddli.obd_maf union_instance_kwp_ddli.lamb_kwp[0] union_instance_kwp_ddli.lamb_kwp[1] union_instance_kwp_ddli.n_max_scdn_mis_32_kwp union_instance_kwp_ddli.n_min_scdn_mis_32_kwp union_instance_kwp_ddli.r_it_ls_down_kwp_h[0] union_instance_kwp_ddli.r_it_ls_down_kwp_h[1] union_instance_kwp_ddli.r_it_ls_down_kwp_l[0] union_instance_kwp_ddli.r_it_ls_down_kwp_l[1] union_instance_kwp_ddli.r_it_ls_up_kwp_h[0] union_instance_kwp_ddli.r_it_ls_up_kwp_h[1] union_instance_kwp_ddli.r_it_ls_up_kwp_l[0] union_instance_kwp_ddli.r_it_ls_up_kwp_l[1] union_instance_kwp_ddli.t_es_kwp union_instance_kwp_ddli.tps_ad_step_kwp union_instance_kwp_ddli.v_amp_kwp union_instance_kwp_ddli.v_dmtl_kwp union_instance_kwp_ddli.vls_down_kwp[0] union_instance_kwp_ddli.vls_down_kwp[1] union_instance_kwp_ddli.vls_up_kwp[0] union_instance_kwp_ddli.vls_up_kwp[1] union_instance_kwp_ddli.v_pvs_1_kwp union_instance_kwp_ddli.v_pvs_2_kwp union_instance_kwp_ddli.v_sof_swi_kwp union_instance_kwp_ddli.v_tco_2_kwp union_instance_kwp_ddli.v_tco_kwp union_instance_kwp_ddli.v_tecu_kwp union_instance_kwp_ddli.v_tps_1_kwp union_instance_kwp_ddli.v_tps_2_kwp union_instance_kwp_ddli.vb_bas_kwp union_instance_kwp_ddli.vcc_pvs_1_kwp union_instance_kwp_ddli.vcc_pvs_2_kwp union_instance_kwp_ddli.vls_dif_lam_adj_kwp[0] union_instance_kwp_ddli.vls_dif_lam_adj_kwp[1] union_instance_kwp_ddli.vls_ofs_lsl_kwp[0] union_instance_kwp_ddli.vls_ofs_lsl_kwp[1] union_instance_kwp_ddli.cur_dmtl_ref_leak_kwp union_instance_kwp_ddli.cur_dmtl_rough_leak_min_kwp union_instance_kwp_ddli.cur_dmtl_cor_fil_kwp union_instance_kwp_ddli.v_igk_bas_kwp union_instance_kwp_ddli.obd_t_ast union_instance_kwp_ddli.obd_amp union_instance_kwp_ddli.obd_vb union_instance_kwp_ddli.obd_lamb_sp union_instance_kwp_ddli.obd_tam union_instance_kwp_ddli.n_sae_byte_kwp union_instance_kwp_ddli.v_alter_sp_kwp union_instance_kwp_ddli.fac_mv_diag_dyn_lsl_up_kwp union_instance_kwp_ddli.poil_kwp /end OUT_MEASUREMENT
/end FUNCTION
/end MODULE
/end PROJECT
