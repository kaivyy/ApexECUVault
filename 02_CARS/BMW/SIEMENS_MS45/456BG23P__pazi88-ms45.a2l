ASAP2_VERSION 1 31
/begin PROJECT MS45 "BMW Motorsteuerung R6"
/begin HEADER "_default_HeaderComment" PROJECT_NO _56 /end HEADER
/begin MODULE _default_ModuleName "_default_ModuleLongIdentifier"
/begin MOD_COMMON "_default_ModCommonComment" DEPOSIT ABSOLUTE BYTE_ORDER MSB_FIRST ALIGNMENT_BYTE 1 ALIGNMENT_WORD 2 ALIGNMENT_LONG 4 ALIGNMENT_FLOAT32_IEEE 4 ALIGNMENT_FLOAT64_IEEE 8 /end MOD_COMMON
/begin MEASUREMENT cyl_ad_struct[0].bf.lv_ad_cyl_lam_act "LV conditions for cylinder individual mixture Adaptation, 1 = fulfilled" ULONG _CNV_S_2_RANGE______0_CM 1 100. 0. 1. DISPLAY_IDENTIFIER LV_AD_CYL_LAM_ACT_1 ECU_ADDRESS 0x3fc1dc BYTE_ORDER MSB_LAST BIT_MASK 0x80000000 /end MEASUREMENT
/begin MEASUREMENT cyl_ad_struct[0].vls_cyc_ratio_mv "average duration of lambda-oscillation" UBYTE _CNV_A_R_LINEAR_____157_CM 1 100. 0. 1.984375 DISPLAY_IDENTIFIER VLS_CYC_RATIO_MV_1 ECU_ADDRESS 0x3fc1e6 FORMAT "%4.2" /end MEASUREMENT
/begin MEASUREMENT cyl_ad_struct[1].bf.lv_ad_cyl_lam_act "LV conditions for cylinder individual mixture Adaptation, 1 = fulfilled" ULONG _CNV_S_2_RANGE______0_CM 1 100. 0. 1. DISPLAY_IDENTIFIER LV_AD_CYL_LAM_ACT_2 ECU_ADDRESS 0x3fc1e8 BYTE_ORDER MSB_LAST BIT_MASK 0x80000000 /end MEASUREMENT
/begin MEASUREMENT cyl_ad_struct[1].vls_cyc_ratio_mv "average duration of lambda-oscillation" UBYTE _CNV_A_R_LINEAR_____157_CM 1 100. 0. 1.984375 DISPLAY_IDENTIFIER VLS_CYC_RATIO_MV_2 ECU_ADDRESS 0x3fc1f2 FORMAT "%4.2" /end MEASUREMENT
/begin CHARACTERISTIC c_vls_min_cyl_lam "lower limit of admissible sensor voltage range" VALUE 0x0093a _REC_VAL_20_u1 1.275 _CNV_A_R_LINEAR_____158_CM 0. 1.275 DISPLAY_IDENTIFIER C_VLS_MIN_CYL_LAM FORMAT "%5.3" /end CHARACTERISTIC
/begin CHARACTERISTIC c_vls_max_cyl_lam "upper limit of admissible sensor voltage range" VALUE 0x00939 _REC_VAL_20_u1 1.275 _CNV_A_R_LINEAR_____158_CM 0. 1.275 DISPLAY_IDENTIFIER C_VLS_MAX_CYL_LAM FORMAT "%5.3" /end CHARACTERISTIC
/begin CHARACTERISTIC c_vls_dif_max_cyl_lam "max. admissible voltage deviation of a cylinder within 720°CRK" VALUE 0x00938 _REC_VAL_20_u1 1.275 _CNV_A_R_LINEAR_____158_CM 0. 1.275 DISPLAY_IDENTIFIER C_VLS_DIF_MAX_CYL_LAM FORMAT "%5.3" /end CHARACTERISTIC
/begin CHARACTERISTIC c_ti_min_cyl_lam "min. limit injection correction, control mode" VALUE 0x0192a _REC_VAL_20_u2 99.99847412 _CNV_A_R_LINEAR_____159_CM -50. 49.99847412 DISPLAY_IDENTIFIER C_TI_MIN_CYL_LAM FORMAT "%7.3" /end CHARACTERISTIC
/begin CHARACTERISTIC c_ti_max_cyl_lam "max. limit injection correction, control mode" VALUE 0x01926 _REC_VAL_20_u2 99.99847412 _CNV_A_R_LINEAR_____159_CM -50. 49.99847412 DISPLAY_IDENTIFIER C_TI_MAX_CYL_LAM FORMAT "%7.3" /end CHARACTERISTIC
/begin CHARACTERISTIC c_ti_cyl_lam_dec "step to reduce the controller injection correction" VALUE 0x01922 _REC_VAL_20_u2 50. _CNV_A_R_LINEAR_____160_CM 0. 50. DISPLAY_IDENTIFIER C_TI_CYL_LAM_DEC /end CHARACTERISTIC
/begin CHARACTERISTIC c_ti_ad_min_cyl_lam "min. limit injection correction, Adaptation mode" VALUE 0x01918 _REC_VAL_20_u2 99.99847412 _CNV_A_R_LINEAR_____159_CM -50. 49.99847412 DISPLAY_IDENTIFIER C_TI_AD_MIN_CYL_LAM FORMAT "%7.3" /end CHARACTERISTIC
/begin CHARACTERISTIC c_ti_ad_max_cyl_lam "max. limit injection correction, Adaptation mode" VALUE 0x01916 _REC_VAL_20_u2 99.99847412 _CNV_A_R_LINEAR_____159_CM -50. 49.99847412 DISPLAY_IDENTIFIER C_TI_AD_MAX_CYL_LAM FORMAT "%7.3" /end CHARACTERISTIC
/begin CHARACTERISTIC c_mff_add_cp_max_cyl_lam_ad "max. fuel amount from canister purge function" VALUE 0x016c0 _REC_VAL_20_u2 1389. _CNV_A_R_LINEAR_____106_CM 0. 1389. DISPLAY_IDENTIFIER C_MFF_ADD_CP_MAX_CYL_LAM_AD FORMAT "%7.2" /end CHARACTERISTIC
/begin MEASUREMENT crk_cyl_lam[0] "read-out position of the cylinder individual sensor signal, referred to ignition TDC" UBYTE _CNV_A_R_LINEAR_____161_CM 1 100. 0. 720. DISPLAY_IDENTIFIER CRK_CYL_LAM_0 ECU_ADDRESS 0x3fdfed FORMAT "%4.0" /end MEASUREMENT
/begin MEASUREMENT crk_cyl_lam[1] "read-out position of the cylinder individual sensor signal, referred to ignition TDC" UBYTE _CNV_A_R_LINEAR_____161_CM 1 100. 0. 720. DISPLAY_IDENTIFIER CRK_CYL_LAM_1 ECU_ADDRESS 0x3fdfee FORMAT "%4.0" /end MEASUREMENT
/begin MEASUREMENT crk_cyl_lam[2] "read-out position of the cylinder individual sensor signal, referred to ignition TDC" UBYTE _CNV_A_R_LINEAR_____161_CM 1 100. 0. 720. DISPLAY_IDENTIFIER CRK_CYL_LAM_2 ECU_ADDRESS 0x3fdfef FORMAT "%4.0" /end MEASUREMENT
/begin MEASUREMENT crk_cyl_lam[3] "read-out position of the cylinder individual sensor signal, referred to ignition TDC" UBYTE _CNV_A_R_LINEAR_____161_CM 1 100. 0. 720. DISPLAY_IDENTIFIER CRK_CYL_LAM_3 ECU_ADDRESS 0x3fdff0 FORMAT "%4.0" /end MEASUREMENT
/begin MEASUREMENT crk_cyl_lam[4] "read-out position of the cylinder individual sensor signal, referred to ignition TDC" UBYTE _CNV_A_R_LINEAR_____161_CM 1 100. 0. 720. DISPLAY_IDENTIFIER CRK_CYL_LAM_4 ECU_ADDRESS 0x3fdff1 FORMAT "%4.0" /end MEASUREMENT
/begin MEASUREMENT crk_cyl_lam[5] "read-out position of the cylinder individual sensor signal, referred to ignition TDC" UBYTE _CNV_A_R_LINEAR_____161_CM 1 100. 0. 720. DISPLAY_IDENTIFIER CRK_CYL_LAM_5 ECU_ADDRESS 0x3fdff2 FORMAT "%4.0" /end MEASUREMENT
/begin MEASUREMENT vls_dly[0] "cylinder individual oxygen sensor voltage at CRK_CYK_LAM_x" UBYTE _CNV_A_R_LINEAR_____158_CM 1 100. 0. 1.275 DISPLAY_IDENTIFIER VLS_DLY_0 ECU_ADDRESS 0x3fdfe7 FORMAT "%5.3" /end MEASUREMENT
/begin MEASUREMENT vls_dly[1] "cylinder individual oxygen sensor voltage at CRK_CYK_LAM_x" UBYTE _CNV_A_R_LINEAR_____158_CM 1 100. 0. 1.275 DISPLAY_IDENTIFIER VLS_DLY_1 ECU_ADDRESS 0x3fdfe8 FORMAT "%5.3" /end MEASUREMENT
/begin MEASUREMENT vls_dly[2] "cylinder individual oxygen sensor voltage at CRK_CYK_LAM_x" UBYTE _CNV_A_R_LINEAR_____158_CM 1 100. 0. 1.275 DISPLAY_IDENTIFIER VLS_DLY_2 ECU_ADDRESS 0x3fdfe9 FORMAT "%5.3" /end MEASUREMENT
/begin MEASUREMENT vls_dly[3] "cylinder individual oxygen sensor voltage at CRK_CYK_LAM_x" UBYTE _CNV_A_R_LINEAR_____158_CM 1 100. 0. 1.275 DISPLAY_IDENTIFIER VLS_DLY_3 ECU_ADDRESS 0x3fdfea FORMAT "%5.3" /end MEASUREMENT
/begin MEASUREMENT vls_dly[4] "cylinder individual oxygen sensor voltage at CRK_CYK_LAM_x" UBYTE _CNV_A_R_LINEAR_____158_CM 1 100. 0. 1.275 DISPLAY_IDENTIFIER VLS_DLY_4 ECU_ADDRESS 0x3fdfeb FORMAT "%5.3" /end MEASUREMENT
/begin MEASUREMENT vls_dly[5] "cylinder individual oxygen sensor voltage at CRK_CYK_LAM_x" UBYTE _CNV_A_R_LINEAR_____158_CM 1 100. 0. 1.275 DISPLAY_IDENTIFIER VLS_DLY_5 ECU_ADDRESS 0x3fdfec FORMAT "%5.3" /end MEASUREMENT
/begin MEASUREMENT vls_dif_val[0] "normalized voltage deviation of a cylinder" SWORD _CNV_A_R_LINEAR_____162_CM 1 100. -0.6375 0.6375 DISPLAY_IDENTIFIER VLS_DIF_VAL_0 ECU_ADDRESS 0x3fd09a BYTE_ORDER MSB_LAST FORMAT "%7.5" /end MEASUREMENT
/begin MEASUREMENT vls_dif_val[1] "normalized voltage deviation of a cylinder" SWORD _CNV_A_R_LINEAR_____162_CM 1 100. -0.6375 0.6375 DISPLAY_IDENTIFIER VLS_DIF_VAL_1 ECU_ADDRESS 0x3fd09c BYTE_ORDER MSB_LAST FORMAT "%7.5" /end MEASUREMENT
/begin MEASUREMENT vls_dif_val[2] "normalized voltage deviation of a cylinder" SWORD _CNV_A_R_LINEAR_____162_CM 1 100. -0.6375 0.6375 DISPLAY_IDENTIFIER VLS_DIF_VAL_2 ECU_ADDRESS 0x3fd09e BYTE_ORDER MSB_LAST FORMAT "%7.5" /end MEASUREMENT
/begin MEASUREMENT vls_dif_val[3] "normalized voltage deviation of a cylinder" SWORD _CNV_A_R_LINEAR_____162_CM 1 100. -0.6375 0.6375 DISPLAY_IDENTIFIER VLS_DIF_VAL_3 ECU_ADDRESS 0x3fd0a0 BYTE_ORDER MSB_LAST FORMAT "%7.5" /end MEASUREMENT
/begin MEASUREMENT vls_dif_val[4] "normalized voltage deviation of a cylinder" SWORD _CNV_A_R_LINEAR_____162_CM 1 100. -0.6375 0.6375 DISPLAY_IDENTIFIER VLS_DIF_VAL_4 ECU_ADDRESS 0x3fd0a2 BYTE_ORDER MSB_LAST FORMAT "%7.5" /end MEASUREMENT
/begin MEASUREMENT vls_dif_val[5] "normalized voltage deviation of a cylinder" SWORD _CNV_A_R_LINEAR_____162_CM 1 100. -0.6375 0.6375 DISPLAY_IDENTIFIER VLS_DIF_VAL_5 ECU_ADDRESS 0x3fd0a4 BYTE_ORDER MSB_LAST FORMAT "%7.5" /end MEASUREMENT
/begin MEASUREMENT ti_cyl_lam[0] "cylinder individual mixture control" UWORD _CNV_A_R_LINEAR_____159_CM 1 100. -50. 49.99847412 DISPLAY_IDENTIFIER TI_CYL_LAM_0 ECU_ADDRESS 0x3fd076 BYTE_ORDER MSB_LAST FORMAT "%7.3" /end MEASUREMENT
/begin MEASUREMENT ti_cyl_lam[1] "cylinder individual mixture control" UWORD _CNV_A_R_LINEAR_____159_CM 1 100. -50. 49.99847412 DISPLAY_IDENTIFIER TI_CYL_LAM_1 ECU_ADDRESS 0x3fd078 BYTE_ORDER MSB_LAST FORMAT "%7.3" /end MEASUREMENT
/begin MEASUREMENT ti_cyl_lam[2] "cylinder individual mixture control" UWORD _CNV_A_R_LINEAR_____159_CM 1 100. -50. 49.99847412 DISPLAY_IDENTIFIER TI_CYL_LAM_2 ECU_ADDRESS 0x3fd07a BYTE_ORDER MSB_LAST FORMAT "%7.3" /end MEASUREMENT
/begin MEASUREMENT ti_cyl_lam[3] "cylinder individual mixture control" UWORD _CNV_A_R_LINEAR_____159_CM 1 100. -50. 49.99847412 DISPLAY_IDENTIFIER TI_CYL_LAM_3 ECU_ADDRESS 0x3fd07c BYTE_ORDER MSB_LAST FORMAT "%7.3" /end MEASUREMENT
/begin MEASUREMENT ti_cyl_lam[4] "cylinder individual mixture control" UWORD _CNV_A_R_LINEAR_____159_CM 1 100. -50. 49.99847412 DISPLAY_IDENTIFIER TI_CYL_LAM_4 ECU_ADDRESS 0x3fd07e BYTE_ORDER MSB_LAST FORMAT "%7.3" /end MEASUREMENT
/begin MEASUREMENT ti_cyl_lam[5] "cylinder individual mixture control" UWORD _CNV_A_R_LINEAR_____159_CM 1 100. -50. 49.99847412 DISPLAY_IDENTIFIER TI_CYL_LAM_5 ECU_ADDRESS 0x3fd080 BYTE_ORDER MSB_LAST FORMAT "%7.3" /end MEASUREMENT
/begin MEASUREMENT ti_ad_cyl_lam[0] "cylinder individual mixture Adaptation" UWORD _CNV_A_R_LINEAR_____159_CM 1 100. -50. 49.99847412 DISPLAY_IDENTIFIER TI_AD_CYL_LAM_0 ECU_ADDRESS 0x3fd082 BYTE_ORDER MSB_LAST FORMAT "%7.3" /end MEASUREMENT
/begin MEASUREMENT ti_ad_cyl_lam[1] "cylinder individual mixture Adaptation" UWORD _CNV_A_R_LINEAR_____159_CM 1 100. -50. 49.99847412 DISPLAY_IDENTIFIER TI_AD_CYL_LAM_1 ECU_ADDRESS 0x3fd084 BYTE_ORDER MSB_LAST FORMAT "%7.3" /end MEASUREMENT
/begin MEASUREMENT ti_ad_cyl_lam[2] "cylinder individual mixture Adaptation" UWORD _CNV_A_R_LINEAR_____159_CM 1 100. -50. 49.99847412 DISPLAY_IDENTIFIER TI_AD_CYL_LAM_2 ECU_ADDRESS 0x3fd086 BYTE_ORDER MSB_LAST FORMAT "%7.3" /end MEASUREMENT
/begin MEASUREMENT ti_ad_cyl_lam[3] "cylinder individual mixture Adaptation" UWORD _CNV_A_R_LINEAR_____159_CM 1 100. -50. 49.99847412 DISPLAY_IDENTIFIER TI_AD_CYL_LAM_3 ECU_ADDRESS 0x3fd088 BYTE_ORDER MSB_LAST FORMAT "%7.3" /end MEASUREMENT
/begin MEASUREMENT ti_ad_cyl_lam[4] "cylinder individual mixture Adaptation" UWORD _CNV_A_R_LINEAR_____159_CM 1 100. -50. 49.99847412 DISPLAY_IDENTIFIER TI_AD_CYL_LAM_4 ECU_ADDRESS 0x3fd08a BYTE_ORDER MSB_LAST FORMAT "%7.3" /end MEASUREMENT
/begin MEASUREMENT ti_ad_cyl_lam[5] "cylinder individual mixture Adaptation" UWORD _CNV_A_R_LINEAR_____159_CM 1 100. -50. 49.99847412 DISPLAY_IDENTIFIER TI_AD_CYL_LAM_5 ECU_ADDRESS 0x3fd08c BYTE_ORDER MSB_LAST FORMAT "%7.3" /end MEASUREMENT
/begin CHARACTERISTIC ip_fac_frq_1_cyl_lam "map for considering slower lambda-sensors" CURVE 0x00ae7 _REC_CUR_20_u1_u1 1.99220002 _CNV_A_R_LINEAR_____39_CM 0. 1.99220002 DISPLAY_IDENTIFIER IP_FAC_FRQ_1_CYL_LAM FORMAT "%5.3"
 /begin AXIS_DESCR COM_AXIS cyl_ad_struct[0].vls_cyc_ratio_mv _CNV_A_R_LINEAR_____157_CM 6 0. 1.984375 FORMAT "%4.2" AXIS_PTS_REF ldp_vls_cyc_ratio_mv_1_ip_fac /end AXIS_DESCR
/end CHARACTERISTIC
/begin CHARACTERISTIC ip_fac_frq_2_cyl_lam "map for considering slower lambda-sensors" CURVE 0x00aed _REC_CUR_20_u1_u1 1.99220002 _CNV_A_R_LINEAR_____39_CM 0. 1.99220002 DISPLAY_IDENTIFIER IP_FAC_FRQ_2_CYL_LAM FORMAT "%5.3"
 /begin AXIS_DESCR COM_AXIS cyl_ad_struct[1].vls_cyc_ratio_mv _CNV_A_R_LINEAR_____157_CM 6 0. 1.984375 FORMAT "%4.2" AXIS_PTS_REF ldp_vls_cyc_ratio_mv_2_ip_fac /end AXIS_DESCR
/end CHARACTERISTIC
/begin CHARACTERISTIC ip_fac_maf_1_cyl_lam "load dependant factor for slower lambda-sensors" CURVE 0x00b30 _REC_CUR_20_u1_u2 1.99220002 _CNV_A_R_LINEAR_____39_CM 0. 1.99220002 DISPLAY_IDENTIFIER IP_FAC_MAF_1_CYL_LAM FORMAT "%5.3"
 /begin AXIS_DESCR COM_AXIS maf_kgh _CNV_A_R_LINEAR_____113_CM 6 0. 2047.96875 FORMAT "%7.2" AXIS_PTS_REF ldp_maf_kgh_ip_fac_maf_1_cyl /end AXIS_DESCR
/end CHARACTERISTIC
/begin CHARACTERISTIC ip_fac_maf_2_cyl_lam "load dependant factor for slower lambda-sensors" CURVE 0x00b36 _REC_CUR_20_u1_u2 1.99220002 _CNV_A_R_LINEAR_____39_CM 0. 1.99220002 DISPLAY_IDENTIFIER IP_FAC_MAF_2_CYL_LAM FORMAT "%5.3"
 /begin AXIS_DESCR COM_AXIS maf_kgh _CNV_A_R_LINEAR_____113_CM 6 0. 2047.96875 FORMAT "%7.2" AXIS_PTS_REF ldp_maf_kgh_ip_fac_maf_2_cyl /end AXIS_DESCR
/end CHARACTERISTIC
/begin CHARACTERISTIC ip_vls_dif_val "standardization between voltage value and mixture value" MAP 0x07a97 _REC_MAP_20_u1_u2_u2 0.99610001 _CNV_A_R_LINEAR_____29_CM 0. 0.99610001 DISPLAY_IDENTIFIER IP_VLS_DIF_VAL FORMAT "%5.3"
 /begin AXIS_DESCR COM_AXIS maf _CNV_A_R_LINEAR_____106_CM 8 0. 1389. FORMAT "%7.2" AXIS_PTS_REF ldp_maf_ip_vls_dif_val /end AXIS_DESCR
 /begin AXIS_DESCR COM_AXIS n _CNV_A_R_LINEAR_____11_CM 8 0. 8160. FORMAT "%4.0" AXIS_PTS_REF ldpm_n_1_cybl /end AXIS_DESCR
/end CHARACTERISTIC
/begin CHARACTERISTIC ip_maf_min_cyl_lam_ad "lower load threshold Adaptation mode" CURVE 0x00ccb _REC_CUR_20_u1_u2 1389. _CNV_A_R_LINEAR_____27_CM 0. 1389. DISPLAY_IDENTIFIER IP_MAF_MIN_CYL_LAM_AD FORMAT "%4.0"
 /begin AXIS_DESCR COM_AXIS n _CNV_A_R_LINEAR_____11_CM 6 0. 8160. FORMAT "%4.0" AXIS_PTS_REF ldpm_n_2_cybl /end AXIS_DESCR
/end CHARACTERISTIC
/begin CHARACTERISTIC ip_maf_max_cyl_lam_ad "upper load threshold Adaptation mode" CURVE 0x00ca5 _REC_CUR_20_u1_u2 1389. _CNV_A_R_LINEAR_____27_CM 0. 1389. DISPLAY_IDENTIFIER IP_MAF_MAX_CYL_LAM_AD FORMAT "%4.0"
 /begin AXIS_DESCR COM_AXIS n _CNV_A_R_LINEAR_____11_CM 6 0. 8160. FORMAT "%4.0" AXIS_PTS_REF ldpm_n_2_cybl /end AXIS_DESCR
/end CHARACTERISTIC
/begin CHARACTERISTIC ip_ti_ad_cyl "mixture correction value Adaptation mode" CURVE 0x0f3de _REC_CUR_20_u2_u2 99.99847412 _CNV_A_R_LINEAR_____159_CM -50. 49.99847412 DISPLAY_IDENTIFIER IP_TI_AD_CYL FORMAT "%7.3"
 /begin AXIS_DESCR COM_AXIS online_dummy _CNV_A_R_LINEAR_____163_CM 8 -0.6375 0.6375 FORMAT "%7.5" AXIS_PTS_REF ldp_vls_dif_val_ip_ti_ad_cyl /end AXIS_DESCR
/end CHARACTERISTIC
/begin CHARACTERISTIC ip_dly_cyl_lam_1 "delay of read time for lambda-sonsor voltage, referred to exhast valve opens, cylinder bank 1" MAP 0x09a62 _REC_MAP_20_u2_u2_u2 720. _CNV_A_R_LINEAR_____82_CM 0. 720. DISPLAY_IDENTIFIER IP_DLY_CYL_LAM_1 FORMAT "%6.2"
 /begin AXIS_DESCR COM_AXIS maf _CNV_A_R_LINEAR_____106_CM 8 0. 1389. FORMAT "%7.2" AXIS_PTS_REF ldp_maf_ip_dly_cyl_lam /end AXIS_DESCR
 /begin AXIS_DESCR COM_AXIS n _CNV_A_R_LINEAR_____11_CM 8 0. 8160. FORMAT "%4.0" AXIS_PTS_REF ldpm_n_1_cybl /end AXIS_DESCR
/end CHARACTERISTIC
/begin CHARACTERISTIC ip_dly_cyl_lam_2 "delay of read time for lambda-sonsor voltage, referred to exhast valve opens, cylinder bank 2" MAP 0x09ae2 _REC_MAP_20_u2_u2_u2 720. _CNV_A_R_LINEAR_____82_CM 0. 720. DISPLAY_IDENTIFIER IP_DLY_CYL_LAM_2 FORMAT "%6.2"
 /begin AXIS_DESCR COM_AXIS maf _CNV_A_R_LINEAR_____106_CM 8 0. 1389. FORMAT "%7.2" AXIS_PTS_REF ldp_maf_ip_dly_cyl_lam /end AXIS_DESCR
 /begin AXIS_DESCR COM_AXIS n _CNV_A_R_LINEAR_____11_CM 8 0. 8160. FORMAT "%4.0" AXIS_PTS_REF ldpm_n_1_cybl /end AXIS_DESCR
/end CHARACTERISTIC
/begin CHARACTERISTIC ip_ti_cyl "mixture correction value control mode" CURVE 0x0f58e _REC_CUR_20_u2_u2 99.99847412 _CNV_A_R_LINEAR_____159_CM -50. 49.99847412 DISPLAY_IDENTIFIER IP_TI_CYL FORMAT "%7.3"
 /begin AXIS_DESCR COM_AXIS online_dummy _CNV_A_R_LINEAR_____163_CM 6 -0.6375 0.6375 FORMAT "%7.5" AXIS_PTS_REF ldp_vls_dif_val_ip_ti_cyl /end AXIS_DESCR
/end CHARACTERISTIC
/begin CHARACTERISTIC ip_fac_vls_dif_lamb "voltage deviation factor for lambda not 1" CURVE 0x01ade _REC_CUR_20_u2_u2 255.996094 _CNV_A_R_LINEAR_____123_CM 0. 255.996094 DISPLAY_IDENTIFIER IP_FAC_VLS_DIF_LAMB FORMAT "%7.3"
 /begin AXIS_DESCR COM_AXIS lamb_sp _CNV_A_R_LINEAR_____164_CM 4 0. 31.99902344 FORMAT "%7.4" AXIS_PTS_REF ldp_lamb_sp_ip_fac_vls_dif_lamb /end AXIS_DESCR
/end CHARACTERISTIC
/begin AXIS_PTS ldp_vls_cyc_ratio_mv_1_ip_fac "" 0x01278 cyl_ad_struct[0].vls_cyc_ratio_mv _REC_AXS_20_u1 1.984375 _CNV_A_R_LINEAR_____157_CM 6 0. 1.984375 DISPLAY_IDENTIFIER LDP_VLS_CYC_RATIO_MV_1_IP_FAC FORMAT "%4.2" /end AXIS_PTS
/begin AXIS_PTS ldp_vls_cyc_ratio_mv_2_ip_fac "" 0x0127f cyl_ad_struct[1].vls_cyc_ratio_mv _REC_AXS_20_u1 1.984375 _CNV_A_R_LINEAR_____157_CM 6 0. 1.984375 DISPLAY_IDENTIFIER LDP_VLS_CYC_RATIO_MV_2_IP_FAC FORMAT "%4.2" /end AXIS_PTS
/begin AXIS_PTS ldp_maf_kgh_ip_fac_maf_1_cyl "" 0x10d4a maf_kgh _REC_AXS_20_u2 2047.96875 _CNV_A_R_LINEAR_____113_CM 6 0. 2047.96875 DISPLAY_IDENTIFIER LDP_MAF_KGH_IP_FAC_MAF_1_CYL FORMAT "%7.2" /end AXIS_PTS
/begin AXIS_PTS ldp_maf_kgh_ip_fac_maf_2_cyl "" 0x10d58 maf_kgh _REC_AXS_20_u2 2047.96875 _CNV_A_R_LINEAR_____113_CM 6 0. 2047.96875 DISPLAY_IDENTIFIER LDP_MAF_KGH_IP_FAC_MAF_2_CYL FORMAT "%7.2" /end AXIS_PTS
/begin AXIS_PTS ldpm_n_1_cybl "" 0x1189c n _REC_AXS_20_u2 8160. _CNV_A_R_LINEAR_____11_CM 8 0. 8160. DISPLAY_IDENTIFIER LDPM_N_1_CYBL FORMAT "%4.0" /end AXIS_PTS
/begin AXIS_PTS ldpm_n_2_cybl "" 0x118e2 n _REC_AXS_20_u2 8160. _CNV_A_R_LINEAR_____11_CM 6 0. 8160. DISPLAY_IDENTIFIER LDPM_N_2_CYBL FORMAT "%4.0" /end AXIS_PTS
/begin AXIS_PTS ldp_maf_ip_dly_cyl_lam "" 0x10c76 maf _REC_AXS_20_u2 1389. _CNV_A_R_LINEAR_____106_CM 8 0. 1389. DISPLAY_IDENTIFIER LDP_MAF_IP_DLY_CYL_LAM FORMAT "%7.2" /end AXIS_PTS
/begin AXIS_PTS ldp_maf_ip_vls_dif_val "" 0x10cb2 maf _REC_AXS_20_u2 1389. _CNV_A_R_LINEAR_____106_CM 8 0. 1389. DISPLAY_IDENTIFIER LDP_MAF_IP_VLS_DIF_VAL FORMAT "%7.2" /end AXIS_PTS
/begin AXIS_PTS ldp_vls_dif_val_ip_ti_ad_cyl "" 0x114f2 online_dummy _REC_AXS_20_u2 1.275 _CNV_A_R_LINEAR_____163_CM 8 -0.6375 0.6375 DISPLAY_IDENTIFIER LDP_VLS_DIF_VAL_IP_TI_AD_CYL FORMAT "%7.5" /end AXIS_PTS
/begin AXIS_PTS ldp_vls_dif_val_ip_ti_cyl "" 0x11504 online_dummy _REC_AXS_20_u2 1.275 _CNV_A_R_LINEAR_____163_CM 6 -0.6375 0.6375 DISPLAY_IDENTIFIER LDP_VLS_DIF_VAL_IP_TI_CYL FORMAT "%7.5" /end AXIS_PTS
/begin AXIS_PTS ldp_lamb_sp_ip_fac_vls_dif_lamb "" 0x10b7e lamb_sp _REC_AXS_20_u2 31.99902344 _CNV_A_R_LINEAR_____164_CM 4 0. 31.99902344 DISPLAY_IDENTIFIER LDP_LAMB_SP_IP_FAC_VLS_DIF_LAMB FORMAT "%7.4" /end AXIS_PTS
/begin MEASUREMENT lam_bank_1.lam_puc.bf.lv_act_int_puc "state of enrichment function for pre and main cat balancing" ULONG _CNV_S_2_RANGE______0_CM 1 100. 0. 1. DISPLAY_IDENTIFIER LV_ACT_INT_PUC_1 ECU_ADDRESS 0x3fc2a8 BYTE_ORDER MSB_LAST BIT_MASK 0x80000000 /end MEASUREMENT
/begin MEASUREMENT lam_bank_1.lam_puc.bf.lv_pcat_purge_puc "state of enrichment function for pre cat balancing after PUC phase" ULONG _CNV_S_2_RANGE______0_CM 1 100. 0. 1. DISPLAY_IDENTIFIER LV_PCAT_PURGE_PUC_1 ECU_ADDRESS 0x3fc2a8 BYTE_ORDER MSB_LAST BIT_MASK 0x40000000 /end MEASUREMENT
/begin MEASUREMENT lam_bank_1.lam_puc.bf.lv_pcat_purge_sa "state of enrichment function for pre cat balancing after SA phase" ULONG _CNV_S_2_RANGE______0_CM 1 100. 0. 1. DISPLAY_IDENTIFIER LV_PCAT_PURGE_SA_1 ECU_ADDRESS 0x3fc2a8 BYTE_ORDER MSB_LAST BIT_MASK 0x20000000 /end MEASUREMENT
/begin MEASUREMENT lam_bank_1.lam_puc.bf.lv_pcat_purge_hst "state of enrichment function for pre cat balancing after HST phase" ULONG _CNV_S_2_RANGE______0_CM 1 100. 0. 1. DISPLAY_IDENTIFIER LV_PCAT_PURGE_HST_1 ECU_ADDRESS 0x3fc2a8 BYTE_ORDER MSB_LAST BIT_MASK 0x10000000 /end MEASUREMENT
/begin MEASUREMENT lam_bank_1.lam_puc.bf.lv_pcat_purge_ch "state of enrichment function for pre cat balancing after CH phase" ULONG _CNV_S_2_RANGE______0_CM 1 100. 0. 1. DISPLAY_IDENTIFIER LV_PCAT_PURGE_CH_1 ECU_ADDRESS 0x3fc2a8 BYTE_ORDER MSB_LAST BIT_MASK 0x8000000 /end MEASUREMENT
/begin MEASUREMENT lam_bank_1.lam_puc.bf.lv_main_cat_purge "state of enrichment function for main cat balancing" ULONG _CNV_S_2_RANGE______0_CM 1 100. 0. 1. DISPLAY_IDENTIFIER LV_MAIN_CAT_PURGE_1 ECU_ADDRESS 0x3fc2a8 BYTE_ORDER MSB_LAST BIT_MASK 0x4000000 /end MEASUREMENT
/begin MEASUREMENT lam_bank_1.lam_puc.bf.lv_vls_down_puc_act_max "Logical indicating that downstream sensor signal is/was below calibration limit" ULONG _CNV_S_2_RANGE______0_CM 1 100. 0. 1. DISPLAY_IDENTIFIER LV_VLS_DOWN_PUC_ACT_MAX_1 ECU_ADDRESS 0x3fc2a8 BYTE_ORDER MSB_LAST BIT_MASK 0x2000000 /end MEASUREMENT
/begin MEASUREMENT lam_bank_1.lam_puc.bf.lv_down_ramp_act "flag indicating that down ramping from lambda setpoint shift to zero is active" ULONG _CNV_S_2_RANGE______0_CM 1 100. 0. 1. DISPLAY_IDENTIFIER LV_DOWN_RAMP_ACT_1 ECU_ADDRESS 0x3fc2a8 BYTE_ORDER MSB_LAST BIT_MASK 0x1000000 /end MEASUREMENT
/begin MEASUREMENT lam_bank_1.lam_puc.bf.lv_puc_trig "trigger bit for cat purge after PUC (needed if transition to LV_PUC = 0 but other conditions are not yet fulfilled)" ULONG _CNV_S_2_RANGE______0_CM 1 100. 0. 1. DISPLAY_IDENTIFIER LV_PUC_TRIG_1 ECU_ADDRESS 0x3fc2a8 BYTE_ORDER MSB_LAST BIT_MASK 0x800000 /end MEASUREMENT
/begin MEASUREMENT lam_bank_1.lam_puc.maf_int_act_puc "value of the mass air flow integral for the function deactivation" ULONG _CNV_A_R_LINEAR_____303_CM 1 100. 0. 1820.398 DISPLAY_IDENTIFIER MAF_INT_ACT_PUC_1 ECU_ADDRESS 0x3fc2ac BYTE_ORDER MSB_LAST FORMAT "%12.7" /end MEASUREMENT
/begin MEASUREMENT lam_bank_1.lam_puc.maf_int_cat_load "Measurment of the purge amount of the pre catalyst" ULONG _CNV_A_R_LINEAR_____303_CM 1 100. 0. 1820.398 DISPLAY_IDENTIFIER MAF_INT_CAT_LOAD_1 ECU_ADDRESS 0x3fc2b0 BYTE_ORDER MSB_LAST FORMAT "%12.7" /end MEASUREMENT
/begin MEASUREMENT lam_bank_1.lam_puc.maf_int_cat_load_main "Measurment of the purge amount of the main catalyst" ULONG _CNV_A_R_LINEAR_____303_CM 1 100. 0. 1820.398 DISPLAY_IDENTIFIER MAF_INT_CAT_LOAD_MAIN_1 ECU_ADDRESS 0x3fc2b4 BYTE_ORDER MSB_LAST FORMAT "%12.7" /end MEASUREMENT
/begin MEASUREMENT lam_bank_1.lam_puc.maf_int_purge_rest "Estimated rest integral for catalyst purge" ULONG _CNV_A_R_LINEAR_____303_CM 1 100. 0. 1820.398 DISPLAY_IDENTIFIER MAF_INT_PURGE_REST_1 ECU_ADDRESS 0x3fc2b8 BYTE_ORDER MSB_LAST FORMAT "%12.7" /end MEASUREMENT
/begin MEASUREMENT lam_bank_1.lam_puc.maf_int_sample_step "MAF integral to be added/ subtracted each sample step" ULONG _CNV_A_R_LINEAR_____303_CM 1 100. 0. 1820.398 DISPLAY_IDENTIFIER MAF_INT_SAMPLE_STEP_1 ECU_ADDRESS 0x3fc2bc BYTE_ORDER MSB_LAST FORMAT "%12.7" /end MEASUREMENT
/begin MEASUREMENT lam_bank_1.lam_puc.maf_int_tot_purge "total MAF integral for pre and main cat purge" ULONG _CNV_A_R_LINEAR_____303_CM 1 100. 0. 1820.398 DISPLAY_IDENTIFIER MAF_INT_TOT_PURGE_1 ECU_ADDRESS 0x3fc2c0 BYTE_ORDER MSB_LAST FORMAT "%12.7" /end MEASUREMENT
/begin MEASUREMENT lam_bank_1.lam_puc.fac_add_pcat_main_cat_puc "additional weighting factor for IP_FAC_PCAT_MAIN_CAT_PUC" UBYTE _CNV_A_R_LINEAR_____127_CM 1 100. 0. 3.984375 DISPLAY_IDENTIFIER FAC_ADD_PCAT_MAIN_CAT_PUC_1 ECU_ADDRESS 0x3fc2c4 FORMAT "%4.2" /end MEASUREMENT
/begin MEASUREMENT lam_bank_1.lam_puc.quo_maf_int_purge "quotient: current MAF rest integral / total MAF integral" UBYTE _CNV_A_R_LINEAR_____50_CM 1 100. 0. 0.996094 DISPLAY_IDENTIFIER QUO_MAF_INT_PURGE_1 ECU_ADDRESS 0x3fc2c5 FORMAT "%5.3" /end MEASUREMENT
/begin MEASUREMENT lam_bank_1.lam_puc.delta_lamb_sp_puc "Lambda controller setpoint shift" UBYTE _CNV_A_R_LINEAR_____304_CM 1 100. 0. 0.125 DISPLAY_IDENTIFIER DELTA_LAMB_SP_PUC_1 ECU_ADDRESS 0x3fc2c6 FORMAT "%5.3" /end MEASUREMENT
/begin MEASUREMENT lam_bank_2.lam_puc.bf.lv_act_int_puc "state of enrichment function for pre and main cat balancing" ULONG _CNV_S_2_RANGE______0_CM 1 100. 0. 1. DISPLAY_IDENTIFIER LV_ACT_INT_PUC_2 ECU_ADDRESS 0x3fc60c BYTE_ORDER MSB_LAST BIT_MASK 0x80000000 /end MEASUREMENT
/begin MEASUREMENT lam_bank_2.lam_puc.bf.lv_pcat_purge_puc "state of enrichment function for pre cat balancing after PUC phase" ULONG _CNV_S_2_RANGE______0_CM 1 100. 0. 1. DISPLAY_IDENTIFIER LV_PCAT_PURGE_PUC_2 ECU_ADDRESS 0x3fc60c BYTE_ORDER MSB_LAST BIT_MASK 0x40000000 /end MEASUREMENT
/begin MEASUREMENT lam_bank_2.lam_puc.bf.lv_pcat_purge_sa "state of enrichment function for pre cat balancing after SA phase" ULONG _CNV_S_2_RANGE______0_CM 1 100. 0. 1. DISPLAY_IDENTIFIER LV_PCAT_PURGE_SA_2 ECU_ADDRESS 0x3fc60c BYTE_ORDER MSB_LAST BIT_MASK 0x20000000 /end MEASUREMENT
/begin MEASUREMENT lam_bank_2.lam_puc.bf.lv_pcat_purge_hst "state of enrichment function for pre cat balancing after HST phase" ULONG _CNV_S_2_RANGE______0_CM 1 100. 0. 1. DISPLAY_IDENTIFIER LV_PCAT_PURGE_HST_2 ECU_ADDRESS 0x3fc60c BYTE_ORDER MSB_LAST BIT_MASK 0x10000000 /end MEASUREMENT
/begin MEASUREMENT lam_bank_2.lam_puc.bf.lv_pcat_purge_ch "state of enrichment function for pre cat balancing after CH phase" ULONG _CNV_S_2_RANGE______0_CM 1 100. 0. 1. DISPLAY_IDENTIFIER LV_PCAT_PURGE_CH_2 ECU_ADDRESS 0x3fc60c BYTE_ORDER MSB_LAST BIT_MASK 0x8000000 /end MEASUREMENT
/begin MEASUREMENT lam_bank_2.lam_puc.bf.lv_main_cat_purge "state of enrichment function for main cat balancing" ULONG _CNV_S_2_RANGE______0_CM 1 100. 0. 1. DISPLAY_IDENTIFIER LV_MAIN_CAT_PURGE_2 ECU_ADDRESS 0x3fc60c BYTE_ORDER MSB_LAST BIT_MASK 0x4000000 /end MEASUREMENT
/begin MEASUREMENT lam_bank_2.lam_puc.bf.lv_vls_down_puc_act_max "Logical indicating that downstream sensor signal is/was below calibration limit" ULONG _CNV_S_2_RANGE______0_CM 1 100. 0. 1. DISPLAY_IDENTIFIER LV_VLS_DOWN_PUC_ACT_MAX_2 ECU_ADDRESS 0x3fc60c BYTE_ORDER MSB_LAST BIT_MASK 0x2000000 /end MEASUREMENT
/begin MEASUREMENT lam_bank_2.lam_puc.bf.lv_down_ramp_act "flag indicating that down ramping from lambda setpoint shift to zero is active" ULONG _CNV_S_2_RANGE______0_CM 1 100. 0. 1. DISPLAY_IDENTIFIER LV_DOWN_RAMP_ACT_2 ECU_ADDRESS 0x3fc60c BYTE_ORDER MSB_LAST BIT_MASK 0x1000000 /end MEASUREMENT
/begin MEASUREMENT lam_bank_2.lam_puc.bf.lv_puc_trig "trigger bit for cat purge after PUC (needed if transition to LV_PUC = 0 but other conditions are not yet fulfilled)" ULONG _CNV_S_2_RANGE______0_CM 1 100. 0. 1. DISPLAY_IDENTIFIER LV_PUC_TRIG_2 ECU_ADDRESS 0x3fc60c BYTE_ORDER MSB_LAST BIT_MASK 0x800000 /end MEASUREMENT
/begin MEASUREMENT lam_bank_2.lam_puc.maf_int_act_puc "value of the mass air flow integral for the function deactivation" ULONG _CNV_A_R_LINEAR_____303_CM 1 100. 0. 1820.398 DISPLAY_IDENTIFIER MAF_INT_ACT_PUC_2 ECU_ADDRESS 0x3fc610 BYTE_ORDER MSB_LAST FORMAT "%12.7" /end MEASUREMENT
/begin MEASUREMENT lam_bank_2.lam_puc.maf_int_cat_load "Measurment of the purge amount of the pre catalyst" ULONG _CNV_A_R_LINEAR_____303_CM 1 100. 0. 1820.398 DISPLAY_IDENTIFIER MAF_INT_CAT_LOAD_2 ECU_ADDRESS 0x3fc614 BYTE_ORDER MSB_LAST FORMAT "%12.7" /end MEASUREMENT
/begin MEASUREMENT lam_bank_2.lam_puc.maf_int_cat_load_main "Measurment of the purge amount of the main catalyst" ULONG _CNV_A_R_LINEAR_____303_CM 1 100. 0. 1820.398 DISPLAY_IDENTIFIER MAF_INT_CAT_LOAD_MAIN_2 ECU_ADDRESS 0x3fc618 BYTE_ORDER MSB_LAST FORMAT "%12.7" /end MEASUREMENT
/begin MEASUREMENT lam_bank_2.lam_puc.maf_int_purge_rest "Estimated rest integral for catalyst purge" ULONG _CNV_A_R_LINEAR_____303_CM 1 100. 0. 1820.398 DISPLAY_IDENTIFIER MAF_INT_PURGE_REST_2 ECU_ADDRESS 0x3fc61c BYTE_ORDER MSB_LAST FORMAT "%12.7" /end MEASUREMENT
/begin MEASUREMENT lam_bank_2.lam_puc.maf_int_sample_step "MAF integral to be added/ subtracted each sample step" ULONG _CNV_A_R_LINEAR_____303_CM 1 100. 0. 1820.398 DISPLAY_IDENTIFIER MAF_INT_SAMPLE_STEP_2 ECU_ADDRESS 0x3fc620 BYTE_ORDER MSB_LAST FORMAT "%12.7" /end MEASUREMENT
/begin MEASUREMENT lam_bank_2.lam_puc.maf_int_tot_purge "total MAF integral for pre and main cat purge" ULONG _CNV_A_R_LINEAR_____303_CM 1 100. 0. 1820.398 DISPLAY_IDENTIFIER MAF_INT_TOT_PURGE_2 ECU_ADDRESS 0x3fc624 BYTE_ORDER MSB_LAST FORMAT "%12.7" /end MEASUREMENT
/begin MEASUREMENT lam_bank_2.lam_puc.fac_add_pcat_main_cat_puc "additional weighting factor for IP_FAC_PCAT_MAIN_CAT_PUC" UBYTE _CNV_A_R_LINEAR_____127_CM 1 100. 0. 3.984375 DISPLAY_IDENTIFIER FAC_ADD_PCAT_MAIN_CAT_PUC_2 ECU_ADDRESS 0x3fc628 FORMAT "%4.2" /end MEASUREMENT
/begin MEASUREMENT lam_bank_2.lam_puc.quo_maf_int_purge "quotient: current MAF rest integral / total MAF integral" UBYTE _CNV_A_R_LINEAR_____50_CM 1 100. 0. 0.996094 DISPLAY_IDENTIFIER QUO_MAF_INT_PURGE_2 ECU_ADDRESS 0x3fc629 FORMAT "%5.3" /end MEASUREMENT
/begin MEASUREMENT lam_bank_2.lam_puc.delta_lamb_sp_puc "Lambda controller setpoint shift" UBYTE _CNV_A_R_LINEAR_____304_CM 1 100. 0. 0.125 DISPLAY_IDENTIFIER DELTA_LAMB_SP_PUC_2 ECU_ADDRESS 0x3fc62a FORMAT "%5.3" /end MEASUREMENT
/begin MEASUREMENT maf_int_puc "integral of mass air flow while active PUC" UWORD _CNV_A_R_LINEAR_____271_CM 1 100. 0. 1820.398 DISPLAY_IDENTIFIER MAF_INT_PUC ECU_ADDRESS 0x3fd0aa BYTE_ORDER MSB_LAST FORMAT "%7.2" /end MEASUREMENT
/begin CHARACTERISTIC c_vls_down_puc_act_max "max. VLS_DOWN threshold for deactivation " VALUE 0x01a1c _REC_VAL_20_u2 4.99511719 _CNV_A_R_LINEAR_____3_CM 0. 4.99511719 DISPLAY_IDENTIFIER C_VLS_DOWN_PUC_ACT_MAX FORMAT "%5.3" /end CHARACTERISTIC
/begin CHARACTERISTIC c_maf_int_puc_min "minimum MAF_INT threshold for cat purge activation after PUC phase" VALUE 0x01678 _REC_VAL_20_u2 1820.398 _CNV_A_R_LINEAR_____271_CM 0. 1820.398 DISPLAY_IDENTIFIER C_MAF_INT_PUC_MIN FORMAT "%7.2" /end CHARACTERISTIC
/begin CHARACTERISTIC c_maf_int_pcat_purge_sa "initial value for mass air flow integral for pre cat purge after SA phase" VALUE 0x01672 _REC_VAL_20_u2 1820.398 _CNV_A_R_LINEAR_____271_CM 0. 1820.398 DISPLAY_IDENTIFIER C_MAF_INT_PCAT_PURGE_SA FORMAT "%7.2" /end CHARACTERISTIC
/begin CHARACTERISTIC c_maf_int_pcat_purge_hst "initial value for mass air flow integral for pre cat purge after HST phase" VALUE 0x01670 _REC_VAL_20_u2 1820.398 _CNV_A_R_LINEAR_____271_CM 0. 1820.398 DISPLAY_IDENTIFIER C_MAF_INT_PCAT_PURGE_HST FORMAT "%7.2" /end CHARACTERISTIC
/begin CHARACTERISTIC c_maf_int_pcat_purge_ch "initial value for mass air flow integral for pre cat purge after CH phase" VALUE 0x0166e _REC_VAL_20_u2 1820.398 _CNV_A_R_LINEAR_____271_CM 0. 1820.398 DISPLAY_IDENTIFIER C_MAF_INT_PCAT_PURGE_CH FORMAT "%7.2" /end CHARACTERISTIC
/begin CHARACTERISTIC c_fac_add_pcat_main_cat_puc_sa "additional weighting factor for IP_FAC_PCAT_MAIN_CAT_PUC for main cat purge after SA" VALUE 0x006c0 _REC_VAL_20_u1 3.984375 _CNV_A_R_LINEAR_____127_CM 0. 3.984375 DISPLAY_IDENTIFIER C_FAC_ADD_PCAT_MAIN_CAT_PUC_SA FORMAT "%4.2" /end CHARACTERISTIC
/begin CHARACTERISTIC c_fac_add_pcat_main_cat_puc_hst "additional weighting factor for IP_FAC_PCAT_MAIN_CAT_PUC for main cat purge after HST" VALUE 0x006bf _REC_VAL_20_u1 3.984375 _CNV_A_R_LINEAR_____127_CM 0. 3.984375 DISPLAY_IDENTIFIER C_FAC_ADD_PCAT_MAIN_CAT_PUC_HST FORMAT "%4.2" /end CHARACTERISTIC
/begin CHARACTERISTIC c_fac_add_pcat_main_cat_puc_ch "additional weighting factor for IP_FAC_PCAT_MAIN_CAT_PUC for main cat purge after CH" VALUE 0x006be _REC_VAL_20_u1 3.984375 _CNV_A_R_LINEAR_____127_CM 0. 3.984375 DISPLAY_IDENTIFIER C_FAC_ADD_PCAT_MAIN_CAT_PUC_CH FORMAT "%4.2" /end CHARACTERISTIC
/begin CHARACTERISTIC c_delta_lamb_sp_puc_inc "limitation for DELTA_LAMB_SP_PUC increase" VALUE 0x0067e _REC_VAL_20_u1 0.125 _CNV_A_R_LINEAR_____304_CM 0. 0.125 DISPLAY_IDENTIFIER C_DELTA_LAMB_SP_PUC_INC FORMAT "%5.3" /end CHARACTERISTIC
/begin CHARACTERISTIC c_delta_lamb_sp_puc_dec "limitation for DELTA_LAMB_SP_PUC decrease" VALUE 0x0067d _REC_VAL_20_u1 0.125 _CNV_A_R_LINEAR_____304_CM 0. 0.125 DISPLAY_IDENTIFIER C_DELTA_LAMB_SP_PUC_DEC FORMAT "%5.3" /end CHARACTERISTIC
/begin CHARACTERISTIC ip_delta_lamb_sp_puc "basic value for lambda controller set point shift" MAP 0x04a4e _REC_MAP_20_u1_u2_u1 0.125 _CNV_A_R_LINEAR_____304_CM 0. 0.125 DISPLAY_IDENTIFIER IP_DELTA_LAMB_SP_PUC FORMAT "%5.3"
 /begin AXIS_DESCR COM_AXIS maf_cyl _CNV_A_R_LINEAR_____113_CM 6 0. 2047.96875 FORMAT "%7.2" AXIS_PTS_REF ldp_maf_cyl /end AXIS_DESCR
 /begin AXIS_DESCR COM_AXIS lam_bank_1.lam_puc.quo_maf_int_purge _CNV_A_R_LINEAR_____50_CM 8 0. 0.996094 FORMAT "%5.3" AXIS_PTS_REF ldp_quo_maf_int_purge /end AXIS_DESCR
/end CHARACTERISTIC
/begin CHARACTERISTIC ip_maf_int_act_puc "initial value for mass air flow integral for pre cat purge after PUC phase" CURVE 0x0c662 _REC_CUR_20_u2_u2 1820.398 _CNV_A_R_LINEAR_____271_CM 0. 1820.398 DISPLAY_IDENTIFIER IP_MAF_INT_ACT_PUC FORMAT "%7.2"
 /begin AXIS_DESCR COM_AXIS maf_int_puc _CNV_A_R_LINEAR_____271_CM 6 0. 1820.398 FORMAT "%7.2" AXIS_PTS_REF ldp_maf_int_puc /end AXIS_DESCR
/end CHARACTERISTIC
/begin CHARACTERISTIC ip_fac_cat_eff_puc "weighting factor for the lambda shift depending on the result of the catalyst diagnosis" MAP 0x04d6e _REC_MAP_20_u1_u2_u1 0.9960940000000002 _CNV_A_R_LINEAR_____50_CM 0. 0.996094 DISPLAY_IDENTIFIER IP_FAC_CAT_EFF_PUC FORMAT "%5.3"
 /begin AXIS_DESCR COM_AXIS online_dummy _CNV_A_R_LINEAR_____302_CM 6 -33. 990.984375 FORMAT "%6.2" AXIS_PTS_REF ldp_temp_pcat /end AXIS_DESCR
 /begin AXIS_DESCR COM_AXIS online_dummy _CNV_A_R_LINEAR_____157_CM 6 0. 1.984375 FORMAT "%4.2" AXIS_PTS_REF ldpm_cat_diag /end AXIS_DESCR
/end CHARACTERISTIC
/begin CHARACTERISTIC ip_fac_pcat_main_cat_puc "basic value for lambda controller set point shift" MAP 0x050be _REC_MAP_20_u1_u2_u1 3.984375 _CNV_A_R_LINEAR_____127_CM 0. 3.984375 DISPLAY_IDENTIFIER IP_FAC_PCAT_MAIN_CAT_PUC FORMAT "%4.2"
 /begin AXIS_DESCR COM_AXIS online_dummy _CNV_A_R_LINEAR_____302_CM 6 -33. 990.984375 FORMAT "%6.2" AXIS_PTS_REF ldp_temp_main_cat /end AXIS_DESCR
 /begin AXIS_DESCR COM_AXIS online_dummy _CNV_A_R_LINEAR_____157_CM 6 0. 1.984375 FORMAT "%4.2" AXIS_PTS_REF ldpm_cat_diag /end AXIS_DESCR
/end CHARACTERISTIC
/begin CHARACTERISTIC c_maf_int_act_puc_max "upper limit for MAF_INT_ACT_PUC_i" VALUE 0x01654 _REC_VAL_20_u2 1820.398 _CNV_A_R_LINEAR_____271_CM 0. 1820.398 DISPLAY_IDENTIFIER C_MAF_INT_ACT_PUC_MAX FORMAT "%7.2" /end CHARACTERISTIC
/begin AXIS_PTS ldp_maf_int_puc "" 0x10c68 maf_int_puc _REC_AXS_20_u2 1820.398 _CNV_A_R_LINEAR_____271_CM 6 0. 1820.398 DISPLAY_IDENTIFIER LDP_MAF_INT_PUC FORMAT "%7.2" /end AXIS_PTS
/begin AXIS_PTS ldp_temp_main_cat "" 0x111fc online_dummy _REC_AXS_20_u2 1023.984375 _CNV_A_R_LINEAR_____302_CM 6 -33. 990.984375 DISPLAY_IDENTIFIER LDP_TEMP_MAIN_CAT FORMAT "%6.2" /end AXIS_PTS
/begin AXIS_PTS ldp_maf_cyl "" 0x10bea maf_cyl _REC_AXS_20_u2 2047.96875 _CNV_A_R_LINEAR_____113_CM 6 0. 2047.96875 DISPLAY_IDENTIFIER LDP_MAF_CYL FORMAT "%7.2" /end AXIS_PTS
/begin AXIS_PTS ldp_quo_maf_int_purge "" 0x07d3a lam_bank_1.lam_puc.quo_maf_int_purge _REC_AXS_20_u1 0.9960940000000002 _CNV_A_R_LINEAR_____50_CM 8 0. 0.996094 DISPLAY_IDENTIFIER LDP_QUO_MAF_INT_PURGE FORMAT "%5.3" /end AXIS_PTS
/begin AXIS_PTS ldpm_cat_diag "" 0x012c8 online_dummy _REC_AXS_20_u1 1.984375 _CNV_A_R_LINEAR_____157_CM 6 0. 1.984375 DISPLAY_IDENTIFIER LDPM_CAT_DIAG FORMAT "%4.2" /end AXIS_PTS
/begin AXIS_PTS ldp_temp_pcat "" 0x1120a online_dummy _REC_AXS_20_u2 1023.984375 _CNV_A_R_LINEAR_____302_CM 6 -33. 990.984375 DISPLAY_IDENTIFIER LDP_TEMP_PCAT FORMAT "%6.2" /end AXIS_PTS
/begin CHARACTERISTIC c_tco_thd_hst "temperature threshold for hot start" VALUE 0x008aa _REC_VAL_20_u1 190.5 _CNV_A_R_LINEAR_____12_CM -48. 142.5 DISPLAY_IDENTIFIER C_TCO_THD_HST FORMAT "%5.1" /end CHARACTERISTIC
/begin CHARACTERISTIC c_quo_maf_int_puc_afl "calibration MAF integral quotient for the that LV_ACT_INT_PUC_AFL_i is active" VALUE 0x007b7 _REC_VAL_20_u1 0.99610001 _CNV_A_R_LINEAR_____29_CM 0. 0.99610001 DISPLAY_IDENTIFIER C_QUO_MAF_INT_PUC_AFL FORMAT "%5.3" /end CHARACTERISTIC
/begin MEASUREMENT teg_1.gas_up_struct.teg_stat_eng_up "Exhaust temp. pre-control pre catalyst" UWORD _CNV_A_R_LINEAR_____262_CM 1 100. -48. 1459.3 DISPLAY_IDENTIFIER TEG_STAT_ENG_UP_1 ECU_ADDRESS 0x3fc900 BYTE_ORDER MSB_LAST FORMAT "%7.2" /end MEASUREMENT
/begin MEASUREMENT teg_1.gas_up_struct.teg_cor_eff_iga_up "Temp. correction power loss by ignition angle difference" UWORD _CNV_A_R_LINEAR_____414_CM 1 100. 0. 983.025 DISPLAY_IDENTIFIER TEG_COR_EFF_IGA_UP_1 ECU_ADDRESS 0x3fc906 BYTE_ORDER MSB_LAST FORMAT "%6.2" /end MEASUREMENT
/begin MEASUREMENT teg_1.gas_up_struct.teg_stat_bas_up "Exhaust temp. based on load level pre-control pre catalyst" UWORD _CNV_A_R_LINEAR_____262_CM 1 100. -48. 1459.3 DISPLAY_IDENTIFIER TEG_STAT_BAS_UP_1 ECU_ADDRESS 0x3fc904 BYTE_ORDER MSB_LAST FORMAT "%7.2" /end MEASUREMENT
/begin MEASUREMENT teg_1.gas_up_struct.eff_iga_av_teg_cor "Reference ignition angle for   temperature" UWORD _CNV_A_R_LINEAR_____21_CM 1 100. 0. 1.99996948 DISPLAY_IDENTIFIER EFF_IGA_AV_TEG_COR_1 ECU_ADDRESS 0x3fc90e BYTE_ORDER MSB_LAST FORMAT "%7.5" /end MEASUREMENT
/begin MEASUREMENT teg_1.gas_up_struct.fac_scc_teg "Multipicative Single cylinder shut off correction" UWORD _CNV_A_R_LINEAR_____37_CM 1 100. 0. 0.99998474 DISPLAY_IDENTIFIER FAC_SCC_TEG_1 ECU_ADDRESS 0x3fc90a BYTE_ORDER MSB_LAST FORMAT "%7.5" /end MEASUREMENT
/begin MEASUREMENT teg_1.gas_up_struct.fac_cor_lamb_sp_teg_up "Lambda set -point correction" UWORD _CNV_A_R_LINEAR_____21_CM 1 100. 0. 1.99996948 DISPLAY_IDENTIFIER FAC_COR_LAMB_SP_TEG_UP_1 ECU_ADDRESS 0x3fc90c BYTE_ORDER MSB_LAST FORMAT "%7.5" /end MEASUREMENT
/begin MEASUREMENT teg_1.gas_up_struct.teg_stat_up "Pre control exhaust temperature  pre catalyst" UWORD _CNV_A_R_LINEAR_____262_CM 1 100. -48. 1459.3 DISPLAY_IDENTIFIER TEG_STAT_UP_1 ECU_ADDRESS 0x3fc910 BYTE_ORDER MSB_LAST FORMAT "%7.2" /end MEASUREMENT
/begin MEASUREMENT teg_1.gas_up_struct.teg_cat_up_mdl_bas "Model of exhaust temperature pre catalyst" UWORD _CNV_A_R_LINEAR_____262_CM 1 100. -48. 1459.3 DISPLAY_IDENTIFIER TEG_CAT_UP_MDL_1_BAS ECU_ADDRESS 0x3fc91a BYTE_ORDER MSB_LAST FORMAT "%7.2" /end MEASUREMENT
/begin MEASUREMENT teg_1.gas_up_struct.teg_dif_up "Difference between steady to model temperature pre catalyst" UWORD _CNV_A_R_LINEAR_____415_CM 1 100. -1507.328 1507.282 DISPLAY_IDENTIFIER TEG_DIF_UP_1 ECU_ADDRESS 0x3fc91c BYTE_ORDER MSB_LAST FORMAT "%8.2" /end MEASUREMENT
/begin MEASUREMENT teg_1.gas_up_struct.teg_cat_up_mdl_stop "Model of exhaust temperature pre catalyst" UWORD _CNV_A_R_LINEAR_____262_CM 1 100. -48. 1459.3 DISPLAY_IDENTIFIER TEG_CAT_UP_MDL_STOP_1 ECU_ADDRESS 0x3fc934 BYTE_ORDER MSB_LAST FORMAT "%7.2" /end MEASUREMENT
/begin MEASUREMENT teg_1.gas_up_struct.crlc_teg_grad_up "Exhaust Temperature gradient" UWORD _CNV_A_R_LINEAR_____345_CM 1 100. 0. 7.99987793 DISPLAY_IDENTIFIER CRLC_TEG_GRAD_UP_1 ECU_ADDRESS 0x3fc91e BYTE_ORDER MSB_LAST FORMAT "%6.4" /end MEASUREMENT
/begin MEASUREMENT teg_1.gas_up_struct.crlc_teg_level_up "Exhaust temperature level" UWORD _CNV_A_R_LINEAR_____345_CM 1 100. 0. 7.99987793 DISPLAY_IDENTIFIER CRLC_TEG_LEVEL_UP_1 ECU_ADDRESS 0x3fc920 BYTE_ORDER MSB_LAST FORMAT "%6.4" /end MEASUREMENT
/begin MEASUREMENT teg_1.gas_up_struct.crlc_teg_up "Entire correlation constant of TEG dynamic change limitation" UWORD _CNV_A_R_LINEAR_____37_CM 1 100. 0. 0.99998474 DISPLAY_IDENTIFIER CRLC_TEG_UP_1 ECU_ADDRESS 0x3fc924 BYTE_ORDER MSB_LAST FORMAT "%7.5" /end MEASUREMENT
/begin MEASUREMENT teg_1.gas_up_struct.crlc_teg_toil_tco_up "Corelation constant received at TCO TOIL calculation" UWORD _CNV_A_R_LINEAR_____37_CM 1 100. 0. 0.99998474 DISPLAY_IDENTIFIER CRLC_TEG_TOIL_TCO_UP_1 ECU_ADDRESS 0x3fc926 BYTE_ORDER MSB_LAST FORMAT "%7.5" /end MEASUREMENT
/begin MEASUREMENT teg_1.gas_up_struct.crlc_teg_egy_up "Corelation constant received at energy calculation" UWORD _CNV_A_R_LINEAR_____345_CM 1 100. 0. 7.99987793 DISPLAY_IDENTIFIER CRLC_TEG_EGY_UP_1 ECU_ADDRESS 0x3fc928 BYTE_ORDER MSB_LAST FORMAT "%6.4" /end MEASUREMENT
/begin MEASUREMENT teg_1.gas_up_struct.egy_teg_end_sp_up "Energy setpoint  for Temperature Model beginning from start" ULONG _CNV_A_R_LINEAR_____416_CM 1 100. 0. 7456.426 DISPLAY_IDENTIFIER EGY_TEG_END_SP_UP_1 ECU_ADDRESS 0x3fc92c BYTE_ORDER MSB_LAST FORMAT "%12.7" /end MEASUREMENT
/begin MEASUREMENT teg_1.gas_up_struct.egy_teg_end_av_up "Actual value Energy for Temperature Model beginning from start" ULONG _CNV_A_R_LINEAR_____416_CM 1 100. 0. 7456.426 DISPLAY_IDENTIFIER EGY_TEG_END_AV_UP_1 ECU_ADDRESS 0x3fc930 BYTE_ORDER MSB_LAST FORMAT "%12.7" /end MEASUREMENT
/begin MEASUREMENT teg_1.gas_up_struct.lv_teg_ast_up "Temperature model after start condition" UBYTE _CNV_S_2_RANGE______5_CM 1 100. 0. 1. DISPLAY_IDENTIFIER LV_TEG_AST_UP_1 ECU_ADDRESS 0x3fc92a /end MEASUREMENT
/begin MEASUREMENT teg_1.gas_up_struct.crlc_teg_bas_up "Entire correlation constant of TEG dynamic change limitation" UWORD _CNV_A_R_LINEAR_____37_CM 1 100. 0. 0.99998474 DISPLAY_IDENTIFIER CRLC_TEG_BAS_UP_1 ECU_ADDRESS 0x3fc922 BYTE_ORDER MSB_LAST FORMAT "%7.5" /end MEASUREMENT
/begin MEASUREMENT teg_1.gas_up_struct.teg_add_egr_up "EGR influence temperature" UWORD _CNV_A_R_LINEAR_____417_CM 1 100. -491.52 491.505 DISPLAY_IDENTIFIER TEG_ADD_EGR_UP_1 ECU_ADDRESS 0x3fc902 BYTE_ORDER MSB_LAST FORMAT "%7.2" /end MEASUREMENT
/begin MEASUREMENT teg_1.gas_up_struct.teg_cor_veh_up "Entire vehicle influences correction" SWORD _CNV_A_R_LINEAR_____418_CM 1 100. -491.519999999553 491.5 DISPLAY_IDENTIFIER TEG_COR_VEH_UP_1 ECU_ADDRESS 0x3fc912 BYTE_ORDER MSB_LAST FORMAT "%7.2" /end MEASUREMENT
/begin MEASUREMENT teg_1.gas_up_struct.teg_cor_tco_ex_up "Cooling temperature outlet correction" SWORD _CNV_A_R_LINEAR_____419_CM 1 100. -202. 202. DISPLAY_IDENTIFIER TEG_COR_TCO_EX_UP_1 ECU_ADDRESS 0x3fc916 BYTE_ORDER MSB_LAST FORMAT "%7.3" /end MEASUREMENT
/begin MEASUREMENT teg_1.gas_up_struct.fac_cor_vs_teg_up "Vehicle speed correction" SWORD _CNV_A_R_LINEAR_____265_CM 1 100. -2. 1.999938965 DISPLAY_IDENTIFIER FAC_COR_VS_TEG_UP_1 ECU_ADDRESS 0x3fc914 BYTE_ORDER MSB_LAST FORMAT "%8.4" /end MEASUREMENT
/begin MEASUREMENT teg_1.gas_up_struct.teg_scc_tco_up "Additive single cyl. shut off temp. correction" UBYTE _CNV_A_R_LINEAR_____12_CM 1 100. -48. 142.5 DISPLAY_IDENTIFIER TEG_SCC_TCO_UP_1 ECU_ADDRESS 0x3fc908 FORMAT "%5.1" /end MEASUREMENT
/begin MEASUREMENT teg_1.gas_up_struct.vs_cor_ecf_teg_up "Electric cooling fan correction" UBYTE _CNV_A_R_LINEAR_____23_CM 1 100. 0. 255. DISPLAY_IDENTIFIER VS_COR_ECF_TEG_UP_1 ECU_ADDRESS 0x3fc918 FORMAT "%3.0" /end MEASUREMENT
/begin MEASUREMENT teg_1.gas_up_struct.vs_cor_teg_up "VS temperature correction" UBYTE _CNV_A_R_LINEAR_____23_CM 1 100. 0. 255. DISPLAY_IDENTIFIER VS_COR_TEG_UP_1 ECU_ADDRESS 0x3fc919 FORMAT "%3.0" /end MEASUREMENT
/begin MEASUREMENT teg_1.gas_down_struct.teg_stat_eng_down "Exhaust temp. pre-control pre catalyst" UWORD _CNV_A_R_LINEAR_____262_CM 1 100. -48. 1459.3 DISPLAY_IDENTIFIER TEG_STAT_ENG_DOWN_1 ECU_ADDRESS 0x3fc93c BYTE_ORDER MSB_LAST FORMAT "%7.2" /end MEASUREMENT
/begin MEASUREMENT teg_1.gas_down_struct.teg_stat_bas_down "Exhaust temp. based on load level pre-control pre catalyst" UWORD _CNV_A_R_LINEAR_____262_CM 1 100. -48. 1459.3 DISPLAY_IDENTIFIER TEG_STAT_BAS_DOWN_1 ECU_ADDRESS 0x3fc93e BYTE_ORDER MSB_LAST FORMAT "%7.2" /end MEASUREMENT
/begin MEASUREMENT teg_1.gas_down_struct.fac_cor_lamb_sp_teg_down "Lambda set -point correction" UWORD _CNV_A_R_LINEAR_____21_CM 1 100. 0. 1.99996948 DISPLAY_IDENTIFIER FAC_COR_LAMB_SP_TEG_DOWN_1 ECU_ADDRESS 0x3fc942 BYTE_ORDER MSB_LAST FORMAT "%7.5" /end MEASUREMENT
/begin MEASUREMENT teg_1.gas_down_struct.teg_stat_down "Pre control exhaust temperature  pre catalyst" UWORD _CNV_A_R_LINEAR_____262_CM 1 100. -48. 1459.3 DISPLAY_IDENTIFIER TEG_STAT_DOWN_1 ECU_ADDRESS 0x3fc946 BYTE_ORDER MSB_LAST FORMAT "%7.2" /end MEASUREMENT
/begin MEASUREMENT teg_1.gas_down_struct.teg_cat_down_mdl_bas "Model of exhaust temperature pre catalyst" UWORD _CNV_A_R_LINEAR_____262_CM 1 100. -48. 1459.3 DISPLAY_IDENTIFIER TEG_CAT_DOWN_MDL_1_BAS ECU_ADDRESS 0x3fc950 BYTE_ORDER MSB_LAST FORMAT "%7.2" /end MEASUREMENT
/begin MEASUREMENT teg_1.gas_down_struct.teg_dif_down "Difference between steady to model temperature pre catalyst" UWORD _CNV_A_R_LINEAR_____415_CM 1 100. -1507.328 1507.282 DISPLAY_IDENTIFIER TEG_DIF_DOWN_1 ECU_ADDRESS 0x3fc952 BYTE_ORDER MSB_LAST FORMAT "%8.2" /end MEASUREMENT
/begin MEASUREMENT teg_1.gas_down_struct.teg_cat_down_mdl_stop "Model of exhaust temperature pre catalyst" UWORD _CNV_A_R_LINEAR_____262_CM 1 100. -48. 1459.3 DISPLAY_IDENTIFIER TEG_CAT_DOWN_MDL_STOP_1 ECU_ADDRESS 0x3fc96c BYTE_ORDER MSB_LAST FORMAT "%7.2" /end MEASUREMENT
/begin MEASUREMENT teg_1.gas_down_struct.crlc_teg_grad_down "Exhaust Temperature gradient" UWORD _CNV_A_R_LINEAR_____345_CM 1 100. 0. 7.99987793 DISPLAY_IDENTIFIER CRLC_TEG_GRAD_DOWN_1 ECU_ADDRESS 0x3fc954 BYTE_ORDER MSB_LAST FORMAT "%6.4" /end MEASUREMENT
/begin MEASUREMENT teg_1.gas_down_struct.crlc_teg_level_down "Exhaust temperature level" UWORD _CNV_A_R_LINEAR_____345_CM 1 100. 0. 7.99987793 DISPLAY_IDENTIFIER CRLC_TEG_LEVEL_DOWN_1 ECU_ADDRESS 0x3fc956 BYTE_ORDER MSB_LAST FORMAT "%6.4" /end MEASUREMENT
/begin MEASUREMENT teg_1.gas_down_struct.crlc_teg_down "Entire correlation constant of TEG dynamic change limitation" UWORD _CNV_A_R_LINEAR_____37_CM 1 100. 0. 0.99998474 DISPLAY_IDENTIFIER CRLC_TEG_DOWN_1 ECU_ADDRESS 0x3fc95a BYTE_ORDER MSB_LAST FORMAT "%7.5" /end MEASUREMENT
/begin MEASUREMENT teg_1.gas_down_struct.crlc_teg_toil_tco_down "Corelation constant received at TCO TOIL calculation" UWORD _CNV_A_R_LINEAR_____37_CM 1 100. 0. 0.99998474 DISPLAY_IDENTIFIER CRLC_TEG_TOIL_TCO_DOWN_1 ECU_ADDRESS 0x3fc95c BYTE_ORDER MSB_LAST FORMAT "%7.5" /end MEASUREMENT
/begin MEASUREMENT teg_1.gas_down_struct.crlc_teg_egy_down "Corelation constant received at energy calculation" UWORD _CNV_A_R_LINEAR_____345_CM 1 100. 0. 7.99987793 DISPLAY_IDENTIFIER CRLC_TEG_EGY_DOWN_1 ECU_ADDRESS 0x3fc95e BYTE_ORDER MSB_LAST FORMAT "%6.4" /end MEASUREMENT
/begin MEASUREMENT teg_1.gas_down_struct.egy_teg_end_sp_down "Energy setpoint  for Temperature Model beginning from start" ULONG _CNV_A_R_LINEAR_____416_CM 1 100. 0. 7456.426 DISPLAY_IDENTIFIER EGY_TEG_END_SP_DOWN_1 ECU_ADDRESS 0x3fc964 BYTE_ORDER MSB_LAST FORMAT "%12.7" /end MEASUREMENT
/begin MEASUREMENT teg_1.gas_down_struct.egy_teg_end_av_down "Actual value Energy for Temperature Model beginning from start" ULONG _CNV_A_R_LINEAR_____416_CM 1 100. 0. 7456.426 DISPLAY_IDENTIFIER EGY_TEG_END_AV_DOWN_1 ECU_ADDRESS 0x3fc968 BYTE_ORDER MSB_LAST FORMAT "%12.7" /end MEASUREMENT
/begin MEASUREMENT teg_1.gas_down_struct.lv_teg_ast_down "Temperature model after start condition" UBYTE _CNV_S_2_RANGE______5_CM 1 100. 0. 1. DISPLAY_IDENTIFIER LV_TEG_AST_DOWN_1 ECU_ADDRESS 0x3fc960 /end MEASUREMENT
/begin MEASUREMENT teg_1.gas_down_struct.crlc_teg_bas_down "Entire correlation constant of TEG dynamic change limitation" UWORD _CNV_A_R_LINEAR_____37_CM 1 100. 0. 0.99998474 DISPLAY_IDENTIFIER CRLC_TEG_BAS_DOWN_1 ECU_ADDRESS 0x3fc958 BYTE_ORDER MSB_LAST FORMAT "%7.5" /end MEASUREMENT
/begin MEASUREMENT teg_1.gas_down_struct.teg_cor_eff_iga_down "Temp. correction power loss by ignition angle difference" UWORD _CNV_A_R_LINEAR_____414_CM 1 100. 0. 983.025 DISPLAY_IDENTIFIER TEG_COR_EFF_IGA_DOWN_1 ECU_ADDRESS 0x3fc940 BYTE_ORDER MSB_LAST FORMAT "%6.2" /end MEASUREMENT
/begin MEASUREMENT teg_1.gas_down_struct.teg_scc_tco_down "Additive Single cylinder shut off temp. correction" UBYTE _CNV_A_R_LINEAR_____12_CM 1 100. -48. 142.5 DISPLAY_IDENTIFIER TEG_SCC_TCO_DOWN_1 ECU_ADDRESS 0x3fc944 FORMAT "%5.1" /end MEASUREMENT
/begin MEASUREMENT teg_1.gas_down_struct.teg_cor_veh_down "Entire vehicle influences correction" SWORD _CNV_A_R_LINEAR_____418_CM 1 100. -491.519999999553 491.5 DISPLAY_IDENTIFIER TEG_COR_VEH_DOWN_1 ECU_ADDRESS 0x3fc948 BYTE_ORDER MSB_LAST FORMAT "%7.2" /end MEASUREMENT
/begin MEASUREMENT teg_1.gas_down_struct.fac_cor_vs_teg_down "Vehicle speed correction" SWORD _CNV_A_R_LINEAR_____265_CM 1 100. -2. 1.999938965 DISPLAY_IDENTIFIER FAC_COR_VS_TEG_DOWN_1 ECU_ADDRESS 0x3fc94a BYTE_ORDER MSB_LAST FORMAT "%8.4" /end MEASUREMENT
/begin MEASUREMENT teg_1.gas_down_struct.teg_cor_tco_ex_down "Cooling temperature outlet correction" SWORD _CNV_A_R_LINEAR_____419_CM 1 100. -202. 202. DISPLAY_IDENTIFIER TEG_COR_TCO_EX_DOWN_1 ECU_ADDRESS 0x3fc94c BYTE_ORDER MSB_LAST FORMAT "%7.3" /end MEASUREMENT
/begin MEASUREMENT teg_1.gas_down_struct.vs_cor_ecf_teg_down "Vehicle speed correction ecf" UBYTE _CNV_A_R_LINEAR_____23_CM 1 100. 0. 255. DISPLAY_IDENTIFIER VS_COR_ECF_TEG_DOWN_1 ECU_ADDRESS 0x3fc94e FORMAT "%3.0" /end MEASUREMENT
/begin MEASUREMENT teg_1.gas_down_struct.vs_cor_teg_down "Vehicle speed correction" UBYTE _CNV_A_R_LINEAR_____23_CM 1 100. 0. 255. DISPLAY_IDENTIFIER VS_COR_TEG_DOWN_1 ECU_ADDRESS 0x3fc94f FORMAT "%3.0" /end MEASUREMENT
/begin MEASUREMENT teg_1.wall_up_struct.teg_wall_stat_bas_up "Exhaust temp. based on load level pre-control pre catalyst" UWORD _CNV_A_R_LINEAR_____262_CM 1 100. -48. 1459.3 DISPLAY_IDENTIFIER TEG_WALL_STAT_BAS_UP_1 ECU_ADDRESS 0x3fc976 BYTE_ORDER MSB_LAST FORMAT "%7.2" /end MEASUREMENT
/begin MEASUREMENT teg_1.wall_up_struct.fac_scc_teg_wall "Multipicative Single cylinder shut off correction" UWORD _CNV_A_R_LINEAR_____37_CM 1 100. 0. 0.99998474 DISPLAY_IDENTIFIER FAC_SCC_TEG_WALL_1 ECU_ADDRESS 0x3fc97c BYTE_ORDER MSB_LAST FORMAT "%7.5" /end MEASUREMENT
/begin MEASUREMENT teg_1.wall_up_struct.fac_cor_lamb_sp_teg_wall_up "Lambda set -point correction" UWORD _CNV_A_R_LINEAR_____21_CM 1 100. 0. 1.99996948 DISPLAY_IDENTIFIER FAC_COR_LAMB_SP_TEG_WALL_UP_1 ECU_ADDRESS 0x3fc97e BYTE_ORDER MSB_LAST FORMAT "%7.5" /end MEASUREMENT
/begin MEASUREMENT teg_1.wall_up_struct.teg_wall_stat_up "Pre control exhaust temperature  pre catalyst" UWORD _CNV_A_R_LINEAR_____262_CM 1 100. -48. 1459.3 DISPLAY_IDENTIFIER TEG_WALL_STAT_UP_1 ECU_ADDRESS 0x3fc980 BYTE_ORDER MSB_LAST FORMAT "%7.2" /end MEASUREMENT
/begin MEASUREMENT teg_1.wall_up_struct.teg_wall_cat_up_mdl "Model of exhaust temperature pre catalyst" UWORD _CNV_A_R_LINEAR_____262_CM 1 100. -48. 1459.3 DISPLAY_IDENTIFIER TEG_WALL_CAT_UP_MDL_1 ECU_ADDRESS 0x3fc98a BYTE_ORDER MSB_LAST FORMAT "%7.2" /end MEASUREMENT
/begin MEASUREMENT teg_1.wall_up_struct.teg_wall_dif_up "Difference between steady to model temperature pre catalyst" UWORD _CNV_A_R_LINEAR_____415_CM 1 100. -1507.328 1507.282 DISPLAY_IDENTIFIER TEG_WALL_DIF_UP_1 ECU_ADDRESS 0x3fc98c BYTE_ORDER MSB_LAST FORMAT "%8.2" /end MEASUREMENT
/begin MEASUREMENT teg_1.wall_up_struct.teg_wall_cat_up_mdl_stop "Model of exhaust temperature pre catalyst" UWORD _CNV_A_R_LINEAR_____262_CM 1 100. -48. 1459.3 DISPLAY_IDENTIFIER TEG_WALL_CAT_UP_MDL_STOP_1 ECU_ADDRESS 0x3fc9a0 BYTE_ORDER MSB_LAST FORMAT "%7.2" /end MEASUREMENT
/begin MEASUREMENT teg_1.wall_up_struct.crlc_teg_wall_up "Entire correlation constant of TEG_WALL dynamic change limitation" UWORD _CNV_A_R_LINEAR_____37_CM 1 100. 0. 0.99998474 DISPLAY_IDENTIFIER CRLC_TEG_WALL_UP_1 ECU_ADDRESS 0x3fc990 BYTE_ORDER MSB_LAST FORMAT "%7.5" /end MEASUREMENT
/begin MEASUREMENT teg_1.wall_up_struct.crlc_teg_wall_toil_tco_up "Corelation constant received at TCO TOIL calculation" UWORD _CNV_A_R_LINEAR_____37_CM 1 100. 0. 0.99998474 DISPLAY_IDENTIFIER CRLC_TEG_WALL_TOIL_TCO_UP_1 ECU_ADDRESS 0x3fc992 BYTE_ORDER MSB_LAST FORMAT "%7.5" /end MEASUREMENT
/begin MEASUREMENT teg_1.wall_up_struct.crlc_teg_wall_egy_up "Corelation constant received at energy calculation" UWORD _CNV_A_R_LINEAR_____37_CM 1 100. 0. 0.99998474 DISPLAY_IDENTIFIER CRLC_TEG_WALL_EGY_UP_1 ECU_ADDRESS 0x3fc994 BYTE_ORDER MSB_LAST FORMAT "%7.5" /end MEASUREMENT
/begin MEASUREMENT teg_1.wall_up_struct.egy_teg_wall_end_sp_up "Energy setpoint  for Temperature Model beginning from start" ULONG _CNV_A_R_LINEAR_____416_CM 1 100. 0. 7456.426 DISPLAY_IDENTIFIER EGY_TEG_WALL_END_SP_UP_1 ECU_ADDRESS 0x3fc998 BYTE_ORDER MSB_LAST FORMAT "%12.7" /end MEASUREMENT
/begin MEASUREMENT teg_1.wall_up_struct.egy_teg_wall_end_av_up "Actual value Energy for Temperature Model beginning from start" ULONG _CNV_A_R_LINEAR_____416_CM 1 100. 0. 7456.426 DISPLAY_IDENTIFIER EGY_TEG_WALL_END_AV_UP_1 ECU_ADDRESS 0x3fc99c BYTE_ORDER MSB_LAST FORMAT "%12.7" /end MEASUREMENT
/begin MEASUREMENT teg_1.wall_up_struct.crlc_teg_wall_bas_up "Entire correlation constant of TEG_WALL dynamic change limitation" UWORD _CNV_A_R_LINEAR_____37_CM 1 100. 0. 0.99998474 DISPLAY_IDENTIFIER CRLC_TEG_WALL_BAS_UP_1 ECU_ADDRESS 0x3fc98e BYTE_ORDER MSB_LAST FORMAT "%7.5" /end MEASUREMENT
/begin MEASUREMENT teg_1.wall_up_struct.teg_wall_stat_eng_up "" UWORD _CNV_A_R_LINEAR_____262_CM 1 100. -48. 1459.3 DISPLAY_IDENTIFIER TEG_WALL_STAT_ENG_UP_1 ECU_ADDRESS 0x3fc974 BYTE_ORDER MSB_LAST FORMAT "%7.2" /end MEASUREMENT
/begin MEASUREMENT teg_1.wall_up_struct.teg_wall_cor_eff_iga_up "Temp. correction power loss by ignition angle difference" UWORD _CNV_A_R_LINEAR_____414_CM 1 100. 0. 983.025 DISPLAY_IDENTIFIER TEG_WALL_COR_EFF_IGA_UP_1 ECU_ADDRESS 0x3fc978 BYTE_ORDER MSB_LAST FORMAT "%6.2" /end MEASUREMENT
/begin MEASUREMENT teg_1.wall_up_struct.teg_wall_scc_tco_up "Additive Single cylinder shut off temp. correction" UBYTE _CNV_A_R_LINEAR_____12_CM 1 100. -48. 142.5 DISPLAY_IDENTIFIER TEG_WALL_SCC_TCO_UP_1 ECU_ADDRESS 0x3fc97a FORMAT "%5.1" /end MEASUREMENT
/begin MEASUREMENT teg_1.wall_up_struct.teg_wall_cor_veh_up "Entire vehicle influences correction" SWORD _CNV_A_R_LINEAR_____418_CM 1 100. -491.519999999553 491.5 DISPLAY_IDENTIFIER TEG_WALL_COR_VEH_UP_1 ECU_ADDRESS 0x3fc982 BYTE_ORDER MSB_LAST FORMAT "%7.2" /end MEASUREMENT
/begin MEASUREMENT teg_1.wall_up_struct.fac_cor_vs_teg_wall_up "Vehicle speed correction" SWORD _CNV_A_R_LINEAR_____265_CM 1 100. -2. 1.999938965 DISPLAY_IDENTIFIER FAC_COR_VS_TEG_WALL_UP_1 ECU_ADDRESS 0x3fc984 BYTE_ORDER MSB_LAST FORMAT "%8.4" /end MEASUREMENT
/begin MEASUREMENT teg_1.wall_up_struct.teg_wall_cor_tco_ex_up "Cooling temperature outlet correction" SWORD _CNV_A_R_LINEAR_____419_CM 1 100. -202. 202. DISPLAY_IDENTIFIER TEG_WALL_COR_TCO_EX_UP_1 ECU_ADDRESS 0x3fc986 BYTE_ORDER MSB_LAST FORMAT "%7.3" /end MEASUREMENT
/begin MEASUREMENT teg_1.wall_up_struct.vs_cor_ecf_teg_wall_up "Vehicle speed correction ecf" UBYTE _CNV_A_R_LINEAR_____23_CM 1 100. 0. 255. DISPLAY_IDENTIFIER VS_COR_ECF_TEG_WALL_UP_1 ECU_ADDRESS 0x3fc988 FORMAT "%3.0" /end MEASUREMENT
/begin MEASUREMENT teg_1.wall_up_struct.vs_cor_teg_wall_up "Vehicle speed correction" UBYTE _CNV_A_R_LINEAR_____23_CM 1 100. 0. 255. DISPLAY_IDENTIFIER VS_COR_TEG_WALL_UP_1 ECU_ADDRESS 0x3fc989 FORMAT "%3.0" /end MEASUREMENT
/begin MEASUREMENT teg_1.wall_down_struct.teg_wall_stat_eng_down "Exhaust temp. pre-control pre catalyst" UWORD _CNV_A_R_LINEAR_____262_CM 1 100. -48. 1459.3 DISPLAY_IDENTIFIER TEG_WALL_STAT_ENG_DOWN_1 ECU_ADDRESS 0x3fc9a8 BYTE_ORDER MSB_LAST FORMAT "%7.2" /end MEASUREMENT
/begin MEASUREMENT teg_1.wall_down_struct.teg_wall_stat_bas_down "Exhaust temp. based on load level pre-control pre catalyst" UWORD _CNV_A_R_LINEAR_____262_CM 1 100. -48. 1459.3 DISPLAY_IDENTIFIER TEG_WALL_STAT_BAS_DOWN_1 ECU_ADDRESS 0x3fc9aa BYTE_ORDER MSB_LAST FORMAT "%7.2" /end MEASUREMENT
/begin MEASUREMENT teg_1.wall_down_struct.fac_cor_lamb_sp_teg_wall_down "Lambda set -point correction" UWORD _CNV_A_R_LINEAR_____21_CM 1 100. 0. 1.99996948 DISPLAY_IDENTIFIER FAC_COR_LAMB_SP_TEG_WALL_DOWN_1 ECU_ADDRESS 0x3fc9ae BYTE_ORDER MSB_LAST FORMAT "%7.5" /end MEASUREMENT
/begin MEASUREMENT teg_1.wall_down_struct.teg_wall_stat_down "Pre control exhaust temperature  pre catalyst" UWORD _CNV_A_R_LINEAR_____262_CM 1 100. -48. 1459.3 DISPLAY_IDENTIFIER TEG_WALL_STAT_DOWN_1 ECU_ADDRESS 0x3fc9b2 BYTE_ORDER MSB_LAST FORMAT "%7.2" /end MEASUREMENT
/begin MEASUREMENT teg_1.wall_down_struct.teg_wall_cat_down_mdl "Model of exhaust temperature pre catalyst" UWORD _CNV_A_R_LINEAR_____262_CM 1 100. -48. 1459.3 DISPLAY_IDENTIFIER TEG_WALL_CAT_DOWN_MDL_1 ECU_ADDRESS 0x3fc9bc BYTE_ORDER MSB_LAST FORMAT "%7.2" /end MEASUREMENT
/begin MEASUREMENT teg_1.wall_down_struct.teg_wall_dif_down "Difference between steady to model temperature pre catalyst" UWORD _CNV_A_R_LINEAR_____415_CM 1 100. -1507.328 1507.282 DISPLAY_IDENTIFIER TEG_WALL_DIF_DOWN_1 ECU_ADDRESS 0x3fc9be BYTE_ORDER MSB_LAST FORMAT "%8.2" /end MEASUREMENT
/begin MEASUREMENT teg_1.wall_down_struct.teg_wall_cat_down_mdl_stop "Model of exhaust temperature pre catalyst" UWORD _CNV_A_R_LINEAR_____262_CM 1 100. -48. 1459.3 DISPLAY_IDENTIFIER TEG_WALL_CAT_DOWN_MDL_STOP_1 ECU_ADDRESS 0x3fc9d0 BYTE_ORDER MSB_LAST FORMAT "%7.2" /end MEASUREMENT
/begin MEASUREMENT teg_1.wall_down_struct.crlc_teg_wall_down "Entire correlation constant of TEG_WALL dynamic change limitation" UWORD _CNV_A_R_LINEAR_____37_CM 1 100. 0. 0.99998474 DISPLAY_IDENTIFIER CRLC_TEG_WALL_DOWN_1 ECU_ADDRESS 0x3fc9c2 BYTE_ORDER MSB_LAST FORMAT "%7.5" /end MEASUREMENT
/begin MEASUREMENT teg_1.wall_down_struct.crlc_teg_wall_toil_tco_down "Corelation constant received at TCO TOIL calculation" UWORD _CNV_A_R_LINEAR_____37_CM 1 100. 0. 0.99998474 DISPLAY_IDENTIFIER CRLC_TEG_WALL_TOIL_TCO_DOWN_1 ECU_ADDRESS 0x3fc9c4 BYTE_ORDER MSB_LAST FORMAT "%7.5" /end MEASUREMENT
/begin MEASUREMENT teg_1.wall_down_struct.crlc_teg_wall_egy_down "Corelation constant received at energy calculation" UWORD _CNV_A_R_LINEAR_____37_CM 1 100. 0. 0.99998474 DISPLAY_IDENTIFIER CRLC_TEG_WALL_EGY_DOWN_1 ECU_ADDRESS 0x3fc9c6 BYTE_ORDER MSB_LAST FORMAT "%7.5" /end MEASUREMENT
/begin MEASUREMENT teg_1.wall_down_struct.egy_teg_wall_end_sp_down "Energy setpoint  for Temperature Model beginning from start" ULONG _CNV_A_R_LINEAR_____416_CM 1 100. 0. 7456.426 DISPLAY_IDENTIFIER EGY_TEG_WALL_END_SP_DOWN_1 ECU_ADDRESS 0x3fc9c8 BYTE_ORDER MSB_LAST FORMAT "%12.7" /end MEASUREMENT
/begin MEASUREMENT teg_1.wall_down_struct.egy_teg_wall_end_av_down "Actual value Energy for Temperature Model beginning from start" ULONG _CNV_A_R_LINEAR_____416_CM 1 100. 0. 7456.426 DISPLAY_IDENTIFIER EGY_TEG_WALL_END_AV_DOWN_1 ECU_ADDRESS 0x3fc9cc BYTE_ORDER MSB_LAST FORMAT "%12.7" /end MEASUREMENT
/begin MEASUREMENT teg_1.wall_down_struct.crlc_teg_wall_bas_down "" UWORD _CNV_A_R_LINEAR_____37_CM 1 100. 0. 0.99998474 DISPLAY_IDENTIFIER CRLC_TEG_WALL_BAS_DOWN_1 ECU_ADDRESS 0x3fc9c0 BYTE_ORDER MSB_LAST FORMAT "%7.5" /end MEASUREMENT
/begin MEASUREMENT teg_1.wall_down_struct.teg_wall_cor_eff_iga_down "Temp. correction power loss by ignition angle difference" UWORD _CNV_A_R_LINEAR_____414_CM 1 100. 0. 983.025 DISPLAY_IDENTIFIER TEG_WALL_COR_EFF_IGA_DOWN_1 ECU_ADDRESS 0x3fc9ac BYTE_ORDER MSB_LAST FORMAT "%6.2" /end MEASUREMENT
/begin MEASUREMENT teg_1.wall_down_struct.teg_wall_scc_tco_down "Additive Single cylinder shut off temp. correction" UBYTE _CNV_A_R_LINEAR_____12_CM 1 100. -48. 142.5 DISPLAY_IDENTIFIER TEG_WALL_SCC_TCO_DOWN_1 ECU_ADDRESS 0x3fc9b0 FORMAT "%5.1" /end MEASUREMENT
/begin MEASUREMENT teg_1.wall_down_struct.teg_wall_cor_veh_down "Entire vehicle influences correction" SWORD _CNV_A_R_LINEAR_____418_CM 1 100. -491.519999999553 491.5 DISPLAY_IDENTIFIER TEG_WALL_COR_VEH_DOWN_1 ECU_ADDRESS 0x3fc9b4 BYTE_ORDER MSB_LAST FORMAT "%7.2" /end MEASUREMENT
/begin MEASUREMENT teg_1.wall_down_struct.fac_cor_vs_teg_wall_down "Vehicle speed correction" SWORD _CNV_A_R_LINEAR_____265_CM 1 100. -2. 1.999938965 DISPLAY_IDENTIFIER FAC_COR_VS_TEG_WALL_DOWN_1 ECU_ADDRESS 0x3fc9b6 BYTE_ORDER MSB_LAST FORMAT "%8.4" /end MEASUREMENT
/begin MEASUREMENT teg_1.wall_down_struct.teg_wall_cor_tco_ex_down "Cooling temperature outlet correction" SWORD _CNV_A_R_LINEAR_____419_CM 1 100. -202. 202. DISPLAY_IDENTIFIER TEG_WALL_COR_TCO_EX_DOWN_1 ECU_ADDRESS 0x3fc9b8 BYTE_ORDER MSB_LAST FORMAT "%7.3" /end MEASUREMENT
/begin MEASUREMENT teg_1.wall_down_struct.vs_cor_ecf_teg_wall_down "Vehicle speed correction ecf" UBYTE _CNV_A_R_LINEAR_____23_CM 1 100. 0. 255. DISPLAY_IDENTIFIER VS_COR_ECF_TEG_WALL_DOWN_1 ECU_ADDRESS 0x3fc9ba FORMAT "%3.0" /end MEASUREMENT
/begin MEASUREMENT teg_1.wall_down_struct.vs_cor_teg_wall_down "Vehicle speed correction" UBYTE _CNV_A_R_LINEAR_____23_CM 1 100. 0. 255. DISPLAY_IDENTIFIER VS_COR_TEG_WALL_DOWN_1 ECU_ADDRESS 0x3fc9bb FORMAT "%3.0" /end MEASUREMENT
/begin MEASUREMENT teg_1.dew_point_struct.lv_teg_min_thd "dew point has been reached" UBYTE _CNV_S_2_RANGE______0_CM 1 100. 0. 1. DISPLAY_IDENTIFIER LV_TEG_MIN_THD_1 ECU_ADDRESS 0x3fc9d8 /end MEASUREMENT
/begin MEASUREMENT teg_1.dew_point_struct.lv_teg_cat_down_min_thd "dew point has been reached bat and pre/post cat. specific" UBYTE _CNV_S_2_RANGE______0_CM 1 100. 0. 1. DISPLAY_IDENTIFIER LV_TEG_CAT_DOWN_MIN_THD_1 ECU_ADDRESS 0x3fc9da /end MEASUREMENT
/begin MEASUREMENT teg_1.dew_point_struct.lv_teg_cat_up_min_thd "dew point has been reached bat and pre/post cat. specific" UBYTE _CNV_S_2_RANGE______0_CM 1 100. 0. 1. DISPLAY_IDENTIFIER LV_TEG_CAT_UP_MIN_THD_1 ECU_ADDRESS 0x3fc9d9 /end MEASUREMENT
/begin MEASUREMENT teg_2.gas_up_struct.teg_stat_eng_up "Exhaust temp. pre-control pre catalyst" UWORD _CNV_A_R_LINEAR_____262_CM 1 100. -48. 1459.3 DISPLAY_IDENTIFIER TEG_STAT_ENG_UP_2 ECU_ADDRESS 0x3fc9f4 BYTE_ORDER MSB_LAST FORMAT "%7.2" /end MEASUREMENT
/begin MEASUREMENT teg_2.gas_up_struct.teg_cor_eff_iga_up "Temp. correction power loss by ignition angle difference" UWORD _CNV_A_R_LINEAR_____414_CM 1 100. 0. 983.025 DISPLAY_IDENTIFIER TEG_COR_EFF_IGA_UP_2 ECU_ADDRESS 0x3fc9fa BYTE_ORDER MSB_LAST FORMAT "%6.2" /end MEASUREMENT
/begin MEASUREMENT teg_2.gas_up_struct.teg_stat_bas_up "Exhaust temp. based on load level pre-control pre catalyst" UWORD _CNV_A_R_LINEAR_____262_CM 1 100. -48. 1459.3 DISPLAY_IDENTIFIER TEG_STAT_BAS_UP_2 ECU_ADDRESS 0x3fc9f8 BYTE_ORDER MSB_LAST FORMAT "%7.2" /end MEASUREMENT
/begin MEASUREMENT teg_2.gas_up_struct.eff_iga_av_teg_cor "Reference ignition angle for   temperature" UWORD _CNV_A_R_LINEAR_____21_CM 1 100. 0. 1.99996948 DISPLAY_IDENTIFIER EFF_IGA_AV_TEG_COR_2 ECU_ADDRESS 0x3fca02 BYTE_ORDER MSB_LAST FORMAT "%7.5" /end MEASUREMENT
/begin MEASUREMENT teg_2.gas_up_struct.fac_scc_teg "Multipicative Single cylinder shut off correction" UWORD _CNV_A_R_LINEAR_____37_CM 1 100. 0. 0.99998474 DISPLAY_IDENTIFIER FAC_SCC_TEG_2 ECU_ADDRESS 0x3fc9fe BYTE_ORDER MSB_LAST FORMAT "%7.5" /end MEASUREMENT
/begin MEASUREMENT teg_2.gas_up_struct.fac_cor_lamb_sp_teg_up "Lambda set -point correction" UWORD _CNV_A_R_LINEAR_____21_CM 1 100. 0. 1.99996948 DISPLAY_IDENTIFIER FAC_COR_LAMB_SP_TEG_UP_2 ECU_ADDRESS 0x3fca00 BYTE_ORDER MSB_LAST FORMAT "%7.5" /end MEASUREMENT
/begin MEASUREMENT teg_2.gas_up_struct.teg_stat_up "Pre control exhaust temperature  pre catalyst" UWORD _CNV_A_R_LINEAR_____262_CM 1 100. -48. 1459.3 DISPLAY_IDENTIFIER TEG_STAT_UP_2 ECU_ADDRESS 0x3fca04 BYTE_ORDER MSB_LAST FORMAT "%7.2" /end MEASUREMENT
/begin MEASUREMENT teg_2.gas_up_struct.teg_cat_up_mdl_bas "Model of exhaust temperature pre catalyst" UWORD _CNV_A_R_LINEAR_____262_CM 1 100. -48. 1459.3 DISPLAY_IDENTIFIER TEG_CAT_UP_MDL_2_BAS ECU_ADDRESS 0x3fca0e BYTE_ORDER MSB_LAST FORMAT "%7.2" /end MEASUREMENT
/begin MEASUREMENT teg_2.gas_up_struct.teg_dif_up "Difference between steady to model temperature pre catalyst" UWORD _CNV_A_R_LINEAR_____415_CM 1 100. -1507.328 1507.282 DISPLAY_IDENTIFIER TEG_DIF_UP_2 ECU_ADDRESS 0x3fca10 BYTE_ORDER MSB_LAST FORMAT "%8.2" /end MEASUREMENT
/begin MEASUREMENT teg_2.gas_up_struct.teg_cat_up_mdl_stop "Model of exhaust temperature pre catalyst" UWORD _CNV_A_R_LINEAR_____262_CM 1 100. -48. 1459.3 DISPLAY_IDENTIFIER TEG_CAT_UP_MDL_STOP_2 ECU_ADDRESS 0x3fca28 BYTE_ORDER MSB_LAST FORMAT "%7.2" /end MEASUREMENT
/begin MEASUREMENT teg_2.gas_up_struct.crlc_teg_grad_up "Exhaust Temperature gradient" UWORD _CNV_A_R_LINEAR_____345_CM 1 100. 0. 7.99987793 DISPLAY_IDENTIFIER CRLC_TEG_GRAD_UP_2 ECU_ADDRESS 0x3fca12 BYTE_ORDER MSB_LAST FORMAT "%6.4" /end MEASUREMENT
/begin MEASUREMENT teg_2.gas_up_struct.crlc_teg_level_up "Exhaust temperature level" UWORD _CNV_A_R_LINEAR_____345_CM 1 100. 0. 7.99987793 DISPLAY_IDENTIFIER CRLC_TEG_LEVEL_UP_2 ECU_ADDRESS 0x3fca14 BYTE_ORDER MSB_LAST FORMAT "%6.4" /end MEASUREMENT
/begin MEASUREMENT teg_2.gas_up_struct.crlc_teg_up "Entire correlation constant of TEG dynamic change limitation" UWORD _CNV_A_R_LINEAR_____37_CM 1 100. 0. 0.99998474 DISPLAY_IDENTIFIER CRLC_TEG_UP_2 ECU_ADDRESS 0x3fca18 BYTE_ORDER MSB_LAST FORMAT "%7.5" /end MEASUREMENT
/begin MEASUREMENT teg_2.gas_up_struct.crlc_teg_toil_tco_up "Corelation constant received at TCO TOIL calculation" UWORD _CNV_A_R_LINEAR_____37_CM 1 100. 0. 0.99998474 DISPLAY_IDENTIFIER CRLC_TEG_TOIL_TCO_UP_2 ECU_ADDRESS 0x3fca1a BYTE_ORDER MSB_LAST FORMAT "%7.5" /end MEASUREMENT
/begin MEASUREMENT teg_2.gas_up_struct.crlc_teg_egy_up "Corelation constant received at energy calculation" UWORD _CNV_A_R_LINEAR_____345_CM 1 100. 0. 7.99987793 DISPLAY_IDENTIFIER CRLC_TEG_EGY_UP_2 ECU_ADDRESS 0x3fca1c BYTE_ORDER MSB_LAST FORMAT "%6.4" /end MEASUREMENT
/begin MEASUREMENT teg_2.gas_up_struct.egy_teg_end_sp_up "Energy setpoint  for Temperature Model beginning from start" ULONG _CNV_A_R_LINEAR_____416_CM 1 100. 0. 7456.426 DISPLAY_IDENTIFIER EGY_TEG_END_SP_UP_2 ECU_ADDRESS 0x3fca20 BYTE_ORDER MSB_LAST FORMAT "%12.7" /end MEASUREMENT
/begin MEASUREMENT teg_2.gas_up_struct.egy_teg_end_av_up "Actual value Energy for Temperature Model beginning from start" ULONG _CNV_A_R_LINEAR_____416_CM 1 100. 0. 7456.426 DISPLAY_IDENTIFIER EGY_TEG_END_AV_UP_2 ECU_ADDRESS 0x3fca24 BYTE_ORDER MSB_LAST FORMAT "%12.7" /end MEASUREMENT
/begin MEASUREMENT teg_2.gas_up_struct.lv_teg_ast_up "Temperature model after start condition" UBYTE _CNV_S_2_RANGE______5_CM 1 100. 0. 1. DISPLAY_IDENTIFIER LV_TEG_AST_UP_2 ECU_ADDRESS 0x3fca1e /end MEASUREMENT
/begin MEASUREMENT teg_2.gas_up_struct.crlc_teg_bas_up "Entire correlation constant of TEG dynamic change limitation" UWORD _CNV_A_R_LINEAR_____37_CM 1 100. 0. 0.99998474 DISPLAY_IDENTIFIER CRLC_TEG_BAS_UP_2 ECU_ADDRESS 0x3fca16 BYTE_ORDER MSB_LAST FORMAT "%7.5" /end MEASUREMENT
/begin MEASUREMENT teg_2.gas_up_struct.teg_add_egr_up "EGR influence temperature" UWORD _CNV_A_R_LINEAR_____417_CM 1 100. -491.52 491.505 DISPLAY_IDENTIFIER TEG_ADD_EGR_UP_2 ECU_ADDRESS 0x3fc9f6 BYTE_ORDER MSB_LAST FORMAT "%7.2" /end MEASUREMENT
/begin MEASUREMENT teg_2.gas_up_struct.teg_cor_veh_up "Entire vehicle influences correction" SWORD _CNV_A_R_LINEAR_____418_CM 1 100. -491.519999999553 491.5 DISPLAY_IDENTIFIER TEG_COR_VEH_UP_2 ECU_ADDRESS 0x3fca06 BYTE_ORDER MSB_LAST FORMAT "%7.2" /end MEASUREMENT
/begin MEASUREMENT teg_2.gas_up_struct.teg_cor_tco_ex_up "Cooling temperature outlet correction" SWORD _CNV_A_R_LINEAR_____419_CM 1 100. -202. 202. DISPLAY_IDENTIFIER TEG_COR_TCO_EX_UP_2 ECU_ADDRESS 0x3fca0a BYTE_ORDER MSB_LAST FORMAT "%7.3" /end MEASUREMENT
/begin MEASUREMENT teg_2.gas_up_struct.fac_cor_vs_teg_up "Vehicle speed correction" SWORD _CNV_A_R_LINEAR_____265_CM 1 100. -2. 1.999938965 DISPLAY_IDENTIFIER FAC_COR_VS_TEG_UP_2 ECU_ADDRESS 0x3fca08 BYTE_ORDER MSB_LAST FORMAT "%8.4" /end MEASUREMENT
/begin MEASUREMENT teg_2.gas_up_struct.teg_scc_tco_up "Additive single cyl. shut off temp. correction" UBYTE _CNV_A_R_LINEAR_____12_CM 1 100. -48. 142.5 DISPLAY_IDENTIFIER TEG_SCC_TCO_UP_2 ECU_ADDRESS 0x3fc9fc FORMAT "%5.1" /end MEASUREMENT
/begin MEASUREMENT teg_2.gas_up_struct.vs_cor_ecf_teg_up "Electric cooling fan correction" UBYTE _CNV_A_R_LINEAR_____23_CM 1 100. 0. 255. DISPLAY_IDENTIFIER VS_COR_ECF_TEG_UP_2 ECU_ADDRESS 0x3fca0c FORMAT "%3.0" /end MEASUREMENT
/begin MEASUREMENT teg_2.gas_up_struct.vs_cor_teg_up "VS temperature correction" UBYTE _CNV_A_R_LINEAR_____23_CM 1 100. 0. 255. DISPLAY_IDENTIFIER VS_COR_TEG_UP_2 ECU_ADDRESS 0x3fca0d FORMAT "%3.0" /end MEASUREMENT
/begin MEASUREMENT teg_2.gas_down_struct.teg_stat_eng_down "Exhaust temp. pre-control pre catalyst" UWORD _CNV_A_R_LINEAR_____262_CM 1 100. -48. 1459.3 DISPLAY_IDENTIFIER TEG_STAT_ENG_DOWN_2 ECU_ADDRESS 0x3fca30 BYTE_ORDER MSB_LAST FORMAT "%7.2" /end MEASUREMENT
/begin MEASUREMENT teg_2.gas_down_struct.teg_stat_bas_down "Exhaust temp. based on load level pre-control pre catalyst" UWORD _CNV_A_R_LINEAR_____262_CM 1 100. -48. 1459.3 DISPLAY_IDENTIFIER TEG_STAT_BAS_DOWN_2 ECU_ADDRESS 0x3fca32 BYTE_ORDER MSB_LAST FORMAT "%7.2" /end MEASUREMENT
/begin MEASUREMENT teg_2.gas_down_struct.fac_cor_lamb_sp_teg_down "Lambda set -point correction" UWORD _CNV_A_R_LINEAR_____21_CM 1 100. 0. 1.99996948 DISPLAY_IDENTIFIER FAC_COR_LAMB_SP_TEG_DOWN_2 ECU_ADDRESS 0x3fca36 BYTE_ORDER MSB_LAST FORMAT "%7.5" /end MEASUREMENT
/begin MEASUREMENT teg_2.gas_down_struct.teg_stat_down "Pre control exhaust temperature  pre catalyst" UWORD _CNV_A_R_LINEAR_____262_CM 1 100. -48. 1459.3 DISPLAY_IDENTIFIER TEG_STAT_DOWN_2 ECU_ADDRESS 0x3fca3a BYTE_ORDER MSB_LAST FORMAT "%7.2" /end MEASUREMENT
/begin MEASUREMENT teg_2.gas_down_struct.teg_cat_down_mdl_bas "Model of exhaust temperature pre catalyst" UWORD _CNV_A_R_LINEAR_____262_CM 1 100. -48. 1459.3 DISPLAY_IDENTIFIER TEG_CAT_DOWN_MDL_2_BAS ECU_ADDRESS 0x3fca44 BYTE_ORDER MSB_LAST FORMAT "%7.2" /end MEASUREMENT
/begin MEASUREMENT teg_2.gas_down_struct.teg_dif_down "Difference between steady to model temperature pre catalyst" UWORD _CNV_A_R_LINEAR_____415_CM 1 100. -1507.328 1507.282 DISPLAY_IDENTIFIER TEG_DIF_DOWN_2 ECU_ADDRESS 0x3fca46 BYTE_ORDER MSB_LAST FORMAT "%8.2" /end MEASUREMENT
/begin MEASUREMENT teg_2.gas_down_struct.teg_cat_down_mdl_stop "Model of exhaust temperature pre catalyst" UWORD _CNV_A_R_LINEAR_____262_CM 1 100. -48. 1459.3 DISPLAY_IDENTIFIER TEG_CAT_DOWN_MDL_STOP_2 ECU_ADDRESS 0x3fca60 BYTE_ORDER MSB_LAST FORMAT "%7.2" /end MEASUREMENT
/begin MEASUREMENT teg_2.gas_down_struct.crlc_teg_grad_down "Exhaust Temperature gradient" UWORD _CNV_A_R_LINEAR_____345_CM 1 100. 0. 7.99987793 DISPLAY_IDENTIFIER CRLC_TEG_GRAD_DOWN_2 ECU_ADDRESS 0x3fca48 BYTE_ORDER MSB_LAST FORMAT "%6.4" /end MEASUREMENT
/begin MEASUREMENT teg_2.gas_down_struct.crlc_teg_level_down "Exhaust temperature level" UWORD _CNV_A_R_LINEAR_____345_CM 1 100. 0. 7.99987793 DISPLAY_IDENTIFIER CRLC_TEG_LEVEL_DOWN_2 ECU_ADDRESS 0x3fca4a BYTE_ORDER MSB_LAST FORMAT "%6.4" /end MEASUREMENT
/begin MEASUREMENT teg_2.gas_down_struct.crlc_teg_down "Entire correlation constant of TEG dynamic change limitation" UWORD _CNV_A_R_LINEAR_____37_CM 1 100. 0. 0.99998474 DISPLAY_IDENTIFIER CRLC_TEG_DOWN_2 ECU_ADDRESS 0x3fca4e BYTE_ORDER MSB_LAST FORMAT "%7.5" /end MEASUREMENT
/begin MEASUREMENT teg_2.gas_down_struct.crlc_teg_toil_tco_down "Corelation constant received at TCO TOIL calculation" UWORD _CNV_A_R_LINEAR_____37_CM 1 100. 0. 0.99998474 DISPLAY_IDENTIFIER CRLC_TEG_TOIL_TCO_DOWN_2 ECU_ADDRESS 0x3fca50 BYTE_ORDER MSB_LAST FORMAT "%7.5" /end MEASUREMENT
/begin MEASUREMENT teg_2.gas_down_struct.crlc_teg_egy_down "Corelation constant received at energy calculation" UWORD _CNV_A_R_LINEAR_____345_CM 1 100. 0. 7.99987793 DISPLAY_IDENTIFIER CRLC_TEG_EGY_DOWN_2 ECU_ADDRESS 0x3fca52 BYTE_ORDER MSB_LAST FORMAT "%6.4" /end MEASUREMENT
/begin MEASUREMENT teg_2.gas_down_struct.egy_teg_end_sp_down "Energy setpoint  for Temperature Model beginning from start" ULONG _CNV_A_R_LINEAR_____416_CM 1 100. 0. 7456.426 DISPLAY_IDENTIFIER EGY_TEG_END_SP_DOWN_2 ECU_ADDRESS 0x3fca58 BYTE_ORDER MSB_LAST FORMAT "%12.7" /end MEASUREMENT
/begin MEASUREMENT teg_2.gas_down_struct.egy_teg_end_av_down "Actual value Energy for Temperature Model beginning from start" ULONG _CNV_A_R_LINEAR_____416_CM 1 100. 0. 7456.426 DISPLAY_IDENTIFIER EGY_TEG_END_AV_DOWN_2 ECU_ADDRESS 0x3fca5c BYTE_ORDER MSB_LAST FORMAT "%12.7" /end MEASUREMENT
/begin MEASUREMENT teg_2.gas_down_struct.lv_teg_ast_down "Temperature model after start condition" UBYTE _CNV_S_2_RANGE______5_CM 1 100. 0. 1. DISPLAY_IDENTIFIER LV_TEG_AST_DOWN_2 ECU_ADDRESS 0x3fca54 /end MEASUREMENT
/begin MEASUREMENT teg_2.gas_down_struct.crlc_teg_bas_down "Entire correlation constant of TEG dynamic change limitation" UWORD _CNV_A_R_LINEAR_____37_CM 1 100. 0. 0.99998474 DISPLAY_IDENTIFIER CRLC_TEG_BAS_DOWN_2 ECU_ADDRESS 0x3fca4c BYTE_ORDER MSB_LAST FORMAT "%7.5" /end MEASUREMENT
/begin MEASUREMENT teg_2.gas_down_struct.teg_cor_eff_iga_down "Temp. correction power loss by ignition angle difference" UWORD _CNV_A_R_LINEAR_____414_CM 1 100. 0. 983.025 DISPLAY_IDENTIFIER TEG_COR_EFF_IGA_DOWN_2 ECU_ADDRESS 0x3fca34 BYTE_ORDER MSB_LAST FORMAT "%6.2" /end MEASUREMENT
/begin MEASUREMENT teg_2.gas_down_struct.teg_scc_tco_down "Additive Single cylinder shut off temp. correction" UBYTE _CNV_A_R_LINEAR_____12_CM 1 100. -48. 142.5 DISPLAY_IDENTIFIER TEG_SCC_TCO_DOWN_2 ECU_ADDRESS 0x3fca38 FORMAT "%5.1" /end MEASUREMENT
/begin MEASUREMENT teg_2.gas_down_struct.teg_cor_veh_down "Entire vehicle influences correction" SWORD _CNV_A_R_LINEAR_____418_CM 1 100. -491.519999999553 491.5 DISPLAY_IDENTIFIER TEG_COR_VEH_DOWN_2 ECU_ADDRESS 0x3fca3c BYTE_ORDER MSB_LAST FORMAT "%7.2" /end MEASUREMENT
/begin MEASUREMENT teg_2.gas_down_struct.fac_cor_vs_teg_down "Vehicle speed correction" SWORD _CNV_A_R_LINEAR_____265_CM 1 100. -2. 1.999938965 DISPLAY_IDENTIFIER FAC_COR_VS_TEG_DOWN_2 ECU_ADDRESS 0x3fca3e BYTE_ORDER MSB_LAST FORMAT "%8.4" /end MEASUREMENT
/begin MEASUREMENT teg_2.gas_down_struct.teg_cor_tco_ex_down "Cooling temperature outlet correction" SWORD _CNV_A_R_LINEAR_____419_CM 1 100. -202. 202. DISPLAY_IDENTIFIER TEG_COR_TCO_EX_DOWN_2 ECU_ADDRESS 0x3fca40 BYTE_ORDER MSB_LAST FORMAT "%7.3" /end MEASUREMENT
/begin MEASUREMENT teg_2.gas_down_struct.vs_cor_ecf_teg_down "Vehicle speed correction ecf" UBYTE _CNV_A_R_LINEAR_____23_CM 1 100. 0. 255. DISPLAY_IDENTIFIER VS_COR_ECF_TEG_DOWN_2 ECU_ADDRESS 0x3fca42 FORMAT "%3.0" /end MEASUREMENT
/begin MEASUREMENT teg_2.gas_down_struct.vs_cor_teg_down "Vehicle speed correction" UBYTE _CNV_A_R_LINEAR_____23_CM 1 100. 0. 255. DISPLAY_IDENTIFIER VS_COR_TEG_DOWN_2 ECU_ADDRESS 0x3fca43 FORMAT "%3.0" /end MEASUREMENT
/begin MEASUREMENT teg_2.wall_up_struct.teg_wall_stat_bas_up "Exhaust temp. based on load level pre-control pre catalyst" UWORD _CNV_A_R_LINEAR_____262_CM 1 100. -48. 1459.3 DISPLAY_IDENTIFIER TEG_WALL_STAT_BAS_UP_2 ECU_ADDRESS 0x3fca6a BYTE_ORDER MSB_LAST FORMAT "%7.2" /end MEASUREMENT
/begin MEASUREMENT teg_2.wall_up_struct.fac_scc_teg_wall "Multipicative Single cylinder shut off correction" UWORD _CNV_A_R_LINEAR_____37_CM 1 100. 0. 0.99998474 DISPLAY_IDENTIFIER FAC_SCC_TEG_WALL_2 ECU_ADDRESS 0x3fca70 BYTE_ORDER MSB_LAST FORMAT "%7.5" /end MEASUREMENT
/begin MEASUREMENT teg_2.wall_up_struct.fac_cor_lamb_sp_teg_wall_up "Lambda set -point correction" UWORD _CNV_A_R_LINEAR_____21_CM 1 100. 0. 1.99996948 DISPLAY_IDENTIFIER FAC_COR_LAMB_SP_TEG_WALL_UP_2 ECU_ADDRESS 0x3fca72 BYTE_ORDER MSB_LAST FORMAT "%7.5" /end MEASUREMENT
/begin MEASUREMENT teg_2.wall_up_struct.teg_wall_stat_up "Pre control exhaust temperature  pre catalyst" UWORD _CNV_A_R_LINEAR_____262_CM 1 100. -48. 1459.3 DISPLAY_IDENTIFIER TEG_WALL_STAT_UP_2 ECU_ADDRESS 0x3fca74 BYTE_ORDER MSB_LAST FORMAT "%7.2" /end MEASUREMENT
/begin MEASUREMENT teg_2.wall_up_struct.teg_wall_cat_up_mdl "Model of exhaust temperature pre catalyst" UWORD _CNV_A_R_LINEAR_____262_CM 1 100. -48. 1459.3 DISPLAY_IDENTIFIER TEG_WALL_CAT_UP_MDL_2 ECU_ADDRESS 0x3fca7e BYTE_ORDER MSB_LAST FORMAT "%7.2" /end MEASUREMENT
/begin MEASUREMENT teg_2.wall_up_struct.teg_wall_dif_up "Difference between steady to model temperature pre catalyst" UWORD _CNV_A_R_LINEAR_____415_CM 1 100. -1507.328 1507.282 DISPLAY_IDENTIFIER TEG_WALL_DIF_UP_2 ECU_ADDRESS 0x3fca80 BYTE_ORDER MSB_LAST FORMAT "%8.2" /end MEASUREMENT
/begin MEASUREMENT teg_2.wall_up_struct.teg_wall_cat_up_mdl_stop "Model of exhaust temperature pre catalyst" UWORD _CNV_A_R_LINEAR_____262_CM 1 100. -48. 1459.3 DISPLAY_IDENTIFIER TEG_WALL_CAT_UP_MDL_STOP_2 ECU_ADDRESS 0x3fca94 BYTE_ORDER MSB_LAST FORMAT "%7.2" /end MEASUREMENT
/begin MEASUREMENT teg_2.wall_up_struct.crlc_teg_wall_up "Entire correlation constant of TEG_WALL dynamic change limitation" UWORD _CNV_A_R_LINEAR_____37_CM 1 100. 0. 0.99998474 DISPLAY_IDENTIFIER CRLC_TEG_WALL_UP_2 ECU_ADDRESS 0x3fca84 BYTE_ORDER MSB_LAST FORMAT "%7.5" /end MEASUREMENT
/begin MEASUREMENT teg_2.wall_up_struct.crlc_teg_wall_toil_tco_up "Corelation constant received at TCO TOIL calculation" UWORD _CNV_A_R_LINEAR_____37_CM 1 100. 0. 0.99998474 DISPLAY_IDENTIFIER CRLC_TEG_WALL_TOIL_TCO_UP_2 ECU_ADDRESS 0x3fca86 BYTE_ORDER MSB_LAST FORMAT "%7.5" /end MEASUREMENT
/begin MEASUREMENT teg_2.wall_up_struct.crlc_teg_wall_egy_up "Corelation constant received at energy calculation" UWORD _CNV_A_R_LINEAR_____37_CM 1 100. 0. 0.99998474 DISPLAY_IDENTIFIER CRLC_TEG_WALL_EGY_UP_2 ECU_ADDRESS 0x3fca88 BYTE_ORDER MSB_LAST FORMAT "%7.5" /end MEASUREMENT
/begin MEASUREMENT teg_2.wall_up_struct.egy_teg_wall_end_sp_up "Energy setpoint  for Temperature Model beginning from start" ULONG _CNV_A_R_LINEAR_____416_CM 1 100. 0. 7456.426 DISPLAY_IDENTIFIER EGY_TEG_WALL_END_SP_UP_2 ECU_ADDRESS 0x3fca8c BYTE_ORDER MSB_LAST FORMAT "%12.7" /end MEASUREMENT
/begin MEASUREMENT teg_2.wall_up_struct.egy_teg_wall_end_av_up "Actual value Energy for Temperature Model beginning from start" ULONG _CNV_A_R_LINEAR_____416_CM 1 100. 0. 7456.426 DISPLAY_IDENTIFIER EGY_TEG_WALL_END_AV_UP_2 ECU_ADDRESS 0x3fca90 BYTE_ORDER MSB_LAST FORMAT "%12.7" /end MEASUREMENT
/begin MEASUREMENT teg_2.wall_up_struct.crlc_teg_wall_bas_up "Entire correlation constant of TEG_WALL dynamic change limitation" UWORD _CNV_A_R_LINEAR_____37_CM 1 100. 0. 0.99998474 DISPLAY_IDENTIFIER CRLC_TEG_WALL_BAS_UP_2 ECU_ADDRESS 0x3fca82 BYTE_ORDER MSB_LAST FORMAT "%7.5" /end MEASUREMENT
/begin MEASUREMENT teg_2.wall_up_struct.teg_wall_stat_eng_up "" UWORD _CNV_A_R_LINEAR_____262_CM 1 100. -48. 1459.3 DISPLAY_IDENTIFIER TEG_WALL_STAT_ENG_UP_2 ECU_ADDRESS 0x3fca68 BYTE_ORDER MSB_LAST FORMAT "%7.2" /end MEASUREMENT
/begin MEASUREMENT teg_2.wall_up_struct.teg_wall_cor_eff_iga_up "Temp. correction power loss by ignition angle difference" UWORD _CNV_A_R_LINEAR_____414_CM 1 100. 0. 983.025 DISPLAY_IDENTIFIER TEG_WALL_COR_EFF_IGA_UP_2 ECU_ADDRESS 0x3fca6c BYTE_ORDER MSB_LAST FORMAT "%6.2" /end MEASUREMENT
/begin MEASUREMENT teg_2.wall_up_struct.teg_wall_scc_tco_up "Additive Single cylinder shut off temp. correction" UBYTE _CNV_A_R_LINEAR_____12_CM 1 100. -48. 142.5 DISPLAY_IDENTIFIER TEG_WALL_SCC_TCO_UP_2 ECU_ADDRESS 0x3fca6e FORMAT "%5.1" /end MEASUREMENT
/begin MEASUREMENT teg_2.wall_up_struct.teg_wall_cor_veh_up "Entire vehicle influences correction" SWORD _CNV_A_R_LINEAR_____418_CM 1 100. -491.519999999553 491.5 DISPLAY_IDENTIFIER TEG_WALL_COR_VEH_UP_2 ECU_ADDRESS 0x3fca76 BYTE_ORDER MSB_LAST FORMAT "%7.2" /end MEASUREMENT
/begin MEASUREMENT teg_2.wall_up_struct.fac_cor_vs_teg_wall_up "Vehicle speed correction" SWORD _CNV_A_R_LINEAR_____265_CM 1 100. -2. 1.999938965 DISPLAY_IDENTIFIER FAC_COR_VS_TEG_WALL_UP_2 ECU_ADDRESS 0x3fca78 BYTE_ORDER MSB_LAST FORMAT "%8.4" /end MEASUREMENT
/begin MEASUREMENT teg_2.wall_up_struct.teg_wall_cor_tco_ex_up "Cooling temperature outlet correction" SWORD _CNV_A_R_LINEAR_____419_CM 1 100. -202. 202. DISPLAY_IDENTIFIER TEG_WALL_COR_TCO_EX_UP_2 ECU_ADDRESS 0x3fca7a BYTE_ORDER MSB_LAST FORMAT "%7.3" /end MEASUREMENT
/begin MEASUREMENT teg_2.wall_up_struct.vs_cor_ecf_teg_wall_up "Vehicle speed correction ecf" UBYTE _CNV_A_R_LINEAR_____23_CM 1 100. 0. 255. DISPLAY_IDENTIFIER VS_COR_ECF_TEG_WALL_UP_2 ECU_ADDRESS 0x3fca7c FORMAT "%3.0" /end MEASUREMENT
/begin MEASUREMENT teg_2.wall_up_struct.vs_cor_teg_wall_up "Vehicle speed correction" UBYTE _CNV_A_R_LINEAR_____23_CM 1 100. 0. 255. DISPLAY_IDENTIFIER VS_COR_TEG_WALL_UP_2 ECU_ADDRESS 0x3fca7d FORMAT "%3.0" /end MEASUREMENT
/begin MEASUREMENT teg_2.wall_down_struct.teg_wall_stat_eng_down "Exhaust temp. pre-control pre catalyst" UWORD _CNV_A_R_LINEAR_____262_CM 1 100. -48. 1459.3 DISPLAY_IDENTIFIER TEG_WALL_STAT_ENG_DOWN_2 ECU_ADDRESS 0x3fca9c BYTE_ORDER MSB_LAST FORMAT "%7.2" /end MEASUREMENT
/begin MEASUREMENT teg_2.wall_down_struct.teg_wall_stat_bas_down "Exhaust temp. based on load level pre-control pre catalyst" UWORD _CNV_A_R_LINEAR_____262_CM 1 100. -48. 1459.3 DISPLAY_IDENTIFIER TEG_WALL_STAT_BAS_DOWN_2 ECU_ADDRESS 0x3fca9e BYTE_ORDER MSB_LAST FORMAT "%7.2" /end MEASUREMENT
/begin MEASUREMENT teg_2.wall_down_struct.fac_cor_lamb_sp_teg_wall_down "Lambda set -point correction" UWORD _CNV_A_R_LINEAR_____21_CM 1 100. 0. 1.99996948 DISPLAY_IDENTIFIER FAC_COR_LAMB_SP_TEG_WALL_DOWN_2 ECU_ADDRESS 0x3fcaa2 BYTE_ORDER MSB_LAST FORMAT "%7.5" /end MEASUREMENT
/begin MEASUREMENT teg_2.wall_down_struct.teg_wall_stat_down "Pre control exhaust temperature  pre catalyst" UWORD _CNV_A_R_LINEAR_____262_CM 1 100. -48. 1459.3 DISPLAY_IDENTIFIER TEG_WALL_STAT_DOWN_2 ECU_ADDRESS 0x3fcaa6 BYTE_ORDER MSB_LAST FORMAT "%7.2" /end MEASUREMENT
/begin MEASUREMENT teg_2.wall_down_struct.teg_wall_cat_down_mdl "Model of exhaust temperature pre catalyst" UWORD _CNV_A_R_LINEAR_____262_CM 1 100. -48. 1459.3 DISPLAY_IDENTIFIER TEG_WALL_CAT_DOWN_MDL_2 ECU_ADDRESS 0x3fcab0 BYTE_ORDER MSB_LAST FORMAT "%7.2" /end MEASUREMENT
/begin MEASUREMENT teg_2.wall_down_struct.teg_wall_dif_down "Difference between steady to model temperature pre catalyst" UWORD _CNV_A_R_LINEAR_____415_CM 1 100. -1507.328 1507.282 DISPLAY_IDENTIFIER TEG_WALL_DIF_DOWN_2 ECU_ADDRESS 0x3fcab2 BYTE_ORDER MSB_LAST FORMAT "%8.2" /end MEASUREMENT
/begin MEASUREMENT teg_2.wall_down_struct.teg_wall_cat_down_mdl_stop "Model of exhaust temperature pre catalyst" UWORD _CNV_A_R_LINEAR_____262_CM 1 100. -48. 1459.3 DISPLAY_IDENTIFIER TEG_WALL_CAT_DOWN_MDL_STOP_2 ECU_ADDRESS 0x3fcac4 BYTE_ORDER MSB_LAST FORMAT "%7.2" /end MEASUREMENT
/begin MEASUREMENT teg_2.wall_down_struct.crlc_teg_wall_down "Entire correlation constant of TEG_WALL dynamic change limitation" UWORD _CNV_A_R_LINEAR_____37_CM 1 100. 0. 0.99998474 DISPLAY_IDENTIFIER CRLC_TEG_WALL_DOWN_2 ECU_ADDRESS 0x3fcab6 BYTE_ORDER MSB_LAST FORMAT "%7.5" /end MEASUREMENT
/begin MEASUREMENT teg_2.wall_down_struct.crlc_teg_wall_toil_tco_down "Corelation constant received at TCO TOIL calculation" UWORD _CNV_A_R_LINEAR_____37_CM 1 100. 0. 0.99998474 DISPLAY_IDENTIFIER CRLC_TEG_WALL_TOIL_TCO_DOWN_2 ECU_ADDRESS 0x3fcab8 BYTE_ORDER MSB_LAST FORMAT "%7.5" /end MEASUREMENT
/begin MEASUREMENT teg_2.wall_down_struct.crlc_teg_wall_egy_down "Corelation constant received at energy calculation" UWORD _CNV_A_R_LINEAR_____37_CM 1 100. 0. 0.99998474 DISPLAY_IDENTIFIER CRLC_TEG_WALL_EGY_DOWN_2 ECU_ADDRESS 0x3fcaba BYTE_ORDER MSB_LAST FORMAT "%7.5" /end MEASUREMENT
/begin MEASUREMENT teg_2.wall_down_struct.egy_teg_wall_end_sp_down "Energy setpoint  for Temperature Model beginning from start" ULONG _CNV_A_R_LINEAR_____416_CM 1 100. 0. 7456.426 DISPLAY_IDENTIFIER EGY_TEG_WALL_END_SP_DOWN_2 ECU_ADDRESS 0x3fcabc BYTE_ORDER MSB_LAST FORMAT "%12.7" /end MEASUREMENT
/begin MEASUREMENT teg_2.wall_down_struct.egy_teg_wall_end_av_down "Actual value Energy for Temperature Model beginning from start" ULONG _CNV_A_R_LINEAR_____416_CM 1 100. 0. 7456.426 DISPLAY_IDENTIFIER EGY_TEG_WALL_END_AV_DOWN_2 ECU_ADDRESS 0x3fcac0 BYTE_ORDER MSB_LAST FORMAT "%12.7" /end MEASUREMENT
/begin MEASUREMENT teg_2.wall_down_struct.crlc_teg_wall_bas_down "" UWORD _CNV_A_R_LINEAR_____37_CM 1 100. 0. 0.99998474 DISPLAY_IDENTIFIER CRLC_TEG_WALL_BAS_DOWN_2 ECU_ADDRESS 0x3fcab4 BYTE_ORDER MSB_LAST FORMAT "%7.5" /end MEASUREMENT
/begin MEASUREMENT teg_2.wall_down_struct.teg_wall_cor_eff_iga_down "Temp. correction power loss by ignition angle difference" UWORD _CNV_A_R_LINEAR_____414_CM 1 100. 0. 983.025 DISPLAY_IDENTIFIER TEG_WALL_COR_EFF_IGA_DOWN_2 ECU_ADDRESS 0x3fcaa0 BYTE_ORDER MSB_LAST FORMAT "%6.2" /end MEASUREMENT
/begin MEASUREMENT teg_2.wall_down_struct.teg_wall_scc_tco_down "Additive Single cylinder shut off temp. correction" UBYTE _CNV_A_R_LINEAR_____12_CM 1 100. -48. 142.5 DISPLAY_IDENTIFIER TEG_WALL_SCC_TCO_DOWN_2 ECU_ADDRESS 0x3fcaa4 FORMAT "%5.1" /end MEASUREMENT
/begin MEASUREMENT teg_2.wall_down_struct.teg_wall_cor_veh_down "Entire vehicle influences correction" SWORD _CNV_A_R_LINEAR_____418_CM 1 100. -491.519999999553 491.5 DISPLAY_IDENTIFIER TEG_WALL_COR_VEH_DOWN_2 ECU_ADDRESS 0x3fcaa8 BYTE_ORDER MSB_LAST FORMAT "%7.2" /end MEASUREMENT
/begin MEASUREMENT teg_2.wall_down_struct.fac_cor_vs_teg_wall_down "Vehicle speed correction" SWORD _CNV_A_R_LINEAR_____265_CM 1 100. -2. 1.999938965 DISPLAY_IDENTIFIER FAC_COR_VS_TEG_WALL_DOWN_2 ECU_ADDRESS 0x3fcaaa BYTE_ORDER MSB_LAST FORMAT "%8.4" /end MEASUREMENT
/begin MEASUREMENT teg_2.wall_down_struct.teg_wall_cor_tco_ex_down "Cooling temperature outlet correction" SWORD _CNV_A_R_LINEAR_____419_CM 1 100. -202. 202. DISPLAY_IDENTIFIER TEG_WALL_COR_TCO_EX_DOWN_2 ECU_ADDRESS 0x3fcaac BYTE_ORDER MSB_LAST FORMAT "%7.3" /end MEASUREMENT
/begin MEASUREMENT teg_2.wall_down_struct.vs_cor_ecf_teg_wall_down "Vehicle speed correction ecf" UBYTE _CNV_A_R_LINEAR_____23_CM 1 100. 0. 255. DISPLAY_IDENTIFIER VS_COR_ECF_TEG_WALL_DOWN_2 ECU_ADDRESS 0x3fcaae FORMAT "%3.0" /end MEASUREMENT
/begin MEASUREMENT teg_2.wall_down_struct.vs_cor_teg_wall_down "Vehicle speed correction" UBYTE _CNV_A_R_LINEAR_____23_CM 1 100. 0. 255. DISPLAY_IDENTIFIER VS_COR_TEG_WALL_DOWN_2 ECU_ADDRESS 0x3fcaaf FORMAT "%3.0" /end MEASUREMENT
/begin MEASUREMENT teg_2.dew_point_struct.lv_teg_min_thd "dew point has been reached" UBYTE _CNV_S_2_RANGE______0_CM 1 100. 0. 1. DISPLAY_IDENTIFIER LV_TEG_MIN_THD_2 ECU_ADDRESS 0x3fcacc /end MEASUREMENT
/begin MEASUREMENT teg_2.dew_point_struct.lv_teg_cat_down_min_thd "dew point has been reached bat and pre/post cat. specific" UBYTE _CNV_S_2_RANGE______0_CM 1 100. 0. 1. DISPLAY_IDENTIFIER LV_TEG_CAT_DOWN_MIN_THD_2 ECU_ADDRESS 0x3fcace /end MEASUREMENT
/begin MEASUREMENT teg_2.dew_point_struct.lv_teg_cat_up_min_thd "dew point has been reached bat and pre/post cat. specific" UBYTE _CNV_S_2_RANGE______0_CM 1 100. 0. 1. DISPLAY_IDENTIFIER LV_TEG_CAT_UP_MIN_THD_2 ECU_ADDRESS 0x3fcacd /end MEASUREMENT
/begin MEASUREMENT teg_cor_vo_up "Valve overlap temp. correction" SWORD _CNV_A_R_LINEAR_____418_CM 1 100. -491.519999999553 491.5 DISPLAY_IDENTIFIER TEG_COR_VO_UP ECU_ADDRESS 0x3fd2b0 BYTE_ORDER MSB_LAST FORMAT "%7.2" /end MEASUREMENT
/begin MEASUREMENT temp_toil_dif "Oil temperature  difference" SWORD _CNV_A_R_LINEAR_____420_CM 1 100. -202. 202. DISPLAY_IDENTIFIER TEMP_TOIL_DIF ECU_ADDRESS 0x3fd2b8 BYTE_ORDER MSB_LAST FORMAT "%8.3" /end MEASUREMENT
/begin MEASUREMENT temp_tco_ex_dif "Coolant outlet temperature difference" SWORD _CNV_A_R_LINEAR_____421_CM 1 100. -202. 202. DISPLAY_IDENTIFIER TEMP_TCO_EX_DIF ECU_ADDRESS 0x3fd2be BYTE_ORDER MSB_LAST FORMAT "%6.1" /end MEASUREMENT
/begin MEASUREMENT crlc_teg_toil_dif_up "Correlation constant by TOIL_DIF" UWORD _CNV_A_R_LINEAR_____345_CM 1 100. 0. 7.99987793 DISPLAY_IDENTIFIER CRLC_TEG_TOIL_DIF_UP ECU_ADDRESS 0x3fd2c2 BYTE_ORDER MSB_LAST FORMAT "%6.4" /end MEASUREMENT
/begin MEASUREMENT crlc_teg_tco_dif_up "Correlation constant by TCO_DIF" UWORD _CNV_A_R_LINEAR_____345_CM 1 100. 0. 7.99987793 DISPLAY_IDENTIFIER CRLC_TEG_TCO_DIF_UP ECU_ADDRESS 0x3fd2c4 BYTE_ORDER MSB_LAST FORMAT "%6.4" /end MEASUREMENT
/begin MEASUREMENT crlc_teg_toil_dif_down "Correlation constant by TOIL_DIF post cat." UWORD _CNV_A_R_LINEAR_____345_CM 1 100. 0. 7.99987793 DISPLAY_IDENTIFIER CRLC_TEG_TOIL_DIF_DOWN ECU_ADDRESS 0x3fd2d0 BYTE_ORDER MSB_LAST FORMAT "%6.4" /end MEASUREMENT
/begin MEASUREMENT crlc_teg_tco_dif_down "Correlation constant by TCO_DIF post cat." UWORD _CNV_A_R_LINEAR_____345_CM 1 100. 0. 7.99987793 DISPLAY_IDENTIFIER CRLC_TEG_TCO_DIF_DOWN ECU_ADDRESS 0x3fd2d2 BYTE_ORDER MSB_LAST FORMAT "%6.4" /end MEASUREMENT
/begin MEASUREMENT crlc_teg_wall_toil_dif_up "Correlation constant by TOIL_DIF" UWORD _CNV_A_R_LINEAR_____345_CM 1 100. 0. 7.99987793 DISPLAY_IDENTIFIER CRLC_TEG_WALL_TOIL_DIF_UP ECU_ADDRESS 0x3fd2dc BYTE_ORDER MSB_LAST FORMAT "%6.4" /end MEASUREMENT
/begin MEASUREMENT crlc_teg_wall_tco_dif_up "Correlation constant by TCO_DIF" UWORD _CNV_A_R_LINEAR_____345_CM 1 100. 0. 7.99987793 DISPLAY_IDENTIFIER CRLC_TEG_WALL_TCO_DIF_UP ECU_ADDRESS 0x3fd2de BYTE_ORDER MSB_LAST FORMAT "%6.4" /end MEASUREMENT
/begin MEASUREMENT teg_wall_cor_vo_down "Valve overlap temp. correction " SWORD _CNV_A_R_LINEAR_____418_CM 1 100. -491.519999999553 491.5 DISPLAY_IDENTIFIER TEG_WALL_COR_VO_DOWN ECU_ADDRESS 0x3fd2e0 BYTE_ORDER MSB_LAST FORMAT "%7.2" /end MEASUREMENT
/begin MEASUREMENT teg_stat_max "Maximum avalible steady state exhaust gas temperature for Nox-Cat. desulfation" UWORD _CNV_A_R_LINEAR_____7_CM 1 100. 0. 2047. DISPLAY_IDENTIFIER TEG_STAT_MAX ECU_ADDRESS 0x3fd2ec BYTE_ORDER MSB_LAST FORMAT "%7.2" /end MEASUREMENT
/begin CHARACTERISTIC ip_temp_sp_toil "Reference engine oil temperature" MAP 0x0759f _REC_MAP_20_u1_u2_u2 200. _CNV_A_R_LINEAR_____15_CM -40. 160. DISPLAY_IDENTIFIER IP_TEMP_SP_TOIL FORMAT "%3.0"
 /begin AXIS_DESCR COM_AXIS maf_teg _CNV_A_R_LINEAR_____106_CM 8 0. 1389. FORMAT "%7.2" AXIS_PTS_REF ldpm_maf_teg__teg_stat /end AXIS_DESCR
 /begin AXIS_DESCR COM_AXIS n_teg _CNV_A_R_LINEAR_____11_CM 8 0. 8160. FORMAT "%4.0" AXIS_PTS_REF ldpm_n_teg__teg_stat /end AXIS_DESCR
/end CHARACTERISTIC
/begin CHARACTERISTIC ip_fac_cor_lamb_sp_up "Lambda influences correction" CURVE 0x0aaa6 _REC_CUR_20_u2_u2 1.99996948 _CNV_A_R_LINEAR_____21_CM 0. 1.99996948 DISPLAY_IDENTIFIER IP_FAC_COR_LAMB_SP_UP FORMAT "%7.5"
 /begin AXIS_DESCR COM_AXIS teg_1.appl_inc_struct.lamb_sp_teg _CNV_A_R_LINEAR_____164_CM 16 0. 31.99902344 FORMAT "%7.4" AXIS_PTS_REF ldpm_lamb_sp_teg__fac_cor /end AXIS_DESCR
/end CHARACTERISTIC
/begin CHARACTERISTIC ip_fac_scc_teg "Single cylinder shut off influence of exhaust temperature " CURVE 0x0af9a _REC_CUR_20_u2_u1 0.99998474 _CNV_A_R_LINEAR_____37_CM 0. 0.99998474 DISPLAY_IDENTIFIER IP_FAC_SCC_TEG FORMAT "%7.5"
 /begin AXIS_DESCR COM_AXIS teg_1.appl_inc_struct.nr_cyl_scc_teg _CNV_A_R_LINEAR_____388_CM 14 0. 13. FORMAT "%4.1" AXIS_PTS_REF ldpm_nr_cyl_scc_teg__fac_scc /end AXIS_DESCR
/end CHARACTERISTIC
/begin CHARACTERISTIC ip_fac_toil_vs "Vs influence of oil temeperature" CURVE 0x0b326 _REC_CUR_20_u2_u1 1.99996948 _CNV_A_R_LINEAR_____21_CM 0. 1.99996948 DISPLAY_IDENTIFIER IP_FAC_TOIL_VS FORMAT "%7.5"
 /begin AXIS_DESCR COM_AXIS vs _CNV_A_R_LINEAR_____23_CM 6 0. 255. FORMAT "%3.0" AXIS_PTS_REF ldpm_vs__fac_cor_vs_teg /end AXIS_DESCR
/end CHARACTERISTIC
/begin CHARACTERISTIC ip_temp_sp_tco_ex "Reference TCO_EX temperature" MAP 0x0755f _REC_MAP_20_u1_u2_u2 190.5 _CNV_A_R_LINEAR_____12_CM -48. 142.5 DISPLAY_IDENTIFIER IP_TEMP_SP_TCO_EX FORMAT "%5.1"
 /begin AXIS_DESCR COM_AXIS maf_teg _CNV_A_R_LINEAR_____106_CM 8 0. 1389. FORMAT "%7.2" AXIS_PTS_REF ldpm_maf_teg__teg_stat /end AXIS_DESCR
 /begin AXIS_DESCR COM_AXIS n_teg _CNV_A_R_LINEAR_____11_CM 8 0. 8160. FORMAT "%4.0" AXIS_PTS_REF ldpm_n_teg__teg_stat /end AXIS_DESCR
/end CHARACTERISTIC
/begin CHARACTERISTIC ip_teg_stat_up_1 "Basic pre control engine temperature" MAP 0x0eef6 _REC_MAP_20_u2_u2_u2 1507.3 _CNV_A_R_LINEAR_____262_CM -48. 1459.3 DISPLAY_IDENTIFIER IP_TEG_STAT_UP_1 FORMAT "%7.2"
 /begin AXIS_DESCR COM_AXIS maf_teg _CNV_A_R_LINEAR_____106_CM 8 0. 1389. FORMAT "%7.2" AXIS_PTS_REF ldpm_maf_teg__teg_stat /end AXIS_DESCR
 /begin AXIS_DESCR COM_AXIS n_teg _CNV_A_R_LINEAR_____11_CM 8 0. 8160. FORMAT "%4.0" AXIS_PTS_REF ldpm_n_teg__teg_stat /end AXIS_DESCR
/end CHARACTERISTIC
/begin CHARACTERISTIC ip_teg_wall_stat_up_1 "Basic pre control engine temperature " MAP 0x0f2be _REC_MAP_20_u2_u2_u2 1507.3 _CNV_A_R_LINEAR_____262_CM -48. 1459.3 DISPLAY_IDENTIFIER IP_TEG_WALL_STAT_UP_1 FORMAT "%7.2"
 /begin AXIS_DESCR COM_AXIS maf_teg _CNV_A_R_LINEAR_____106_CM 8 0. 1389. FORMAT "%7.2" AXIS_PTS_REF ldpm_maf_teg__teg_stat /end AXIS_DESCR
 /begin AXIS_DESCR COM_AXIS n_teg _CNV_A_R_LINEAR_____11_CM 8 0. 8160. FORMAT "%4.0" AXIS_PTS_REF ldpm_n_teg__teg_stat /end AXIS_DESCR
/end CHARACTERISTIC
/begin CHARACTERISTIC ip_fac_teg_wall_cor_lamb_sp_up "Lambda influences correction depending on load engine" MAP 0x0b19e _REC_MAP_20_u2_u2_u2 1.99996948 _CNV_A_R_LINEAR_____21_CM 0. 1.99996948 DISPLAY_IDENTIFIER IP_FAC_TEG_WALL_COR_LAMB_SP_UP FORMAT "%7.5"
 /begin AXIS_DESCR COM_AXIS maf_teg _CNV_A_R_LINEAR_____106_CM 8 0. 1389. FORMAT "%7.2" AXIS_PTS_REF ldpm_maf_teg__teg_stat /end AXIS_DESCR
 /begin AXIS_DESCR COM_AXIS n_teg _CNV_A_R_LINEAR_____11_CM 8 0. 8160. FORMAT "%4.0" AXIS_PTS_REF ldpm_n_teg__teg_stat /end AXIS_DESCR
/end CHARACTERISTIC
/begin CHARACTERISTIC ip_teg_add_egr "EGR influence Temperature" MAP 0x0ec12 _REC_MAP_20_u2_u2_u2 983.025 _CNV_A_R_LINEAR_____417_CM -491.52 491.505 DISPLAY_IDENTIFIER IP_TEG_ADD_EGR FORMAT "%7.2"
 /begin AXIS_DESCR COM_AXIS online_dummy _CNV_A_R_LINEAR_____262_CM 6 -48. 1459.3 FORMAT "%7.2" AXIS_PTS_REF ldpm_teg_stat_eng_pre /end AXIS_DESCR
 /begin AXIS_DESCR COM_AXIS egr_ratio _CNV_A_R_LINEAR_____9_CM 6 0. 99.99847412 AXIS_PTS_REF ldpm_egr_ratio__teg /end AXIS_DESCR
/end CHARACTERISTIC
/begin CHARACTERISTIC ip_teg_wall_add_egr "EGR influence Temperature" MAP 0x0eff6 _REC_MAP_20_u2_u2_u2 983.025 _CNV_A_R_LINEAR_____417_CM -491.52 491.505 DISPLAY_IDENTIFIER IP_TEG_WALL_ADD_EGR FORMAT "%7.2"
 /begin AXIS_DESCR COM_AXIS online_dummy _CNV_A_R_LINEAR_____262_CM 6 -48. 1459.3 FORMAT "%7.2" AXIS_PTS_REF ldpm_teg_stat_eng_pre /end AXIS_DESCR
 /begin AXIS_DESCR COM_AXIS egr_ratio _CNV_A_R_LINEAR_____9_CM 6 0. 99.99847412 AXIS_PTS_REF ldpm_egr_ratio__teg /end AXIS_DESCR
/end CHARACTERISTIC
/begin CHARACTERISTIC ip_fac_cor_lamb_sp_wall_up "Lambda influences correction" CURVE 0x0aac6 _REC_CUR_20_u2_u2 1.99996948 _CNV_A_R_LINEAR_____21_CM 0. 1.99996948 DISPLAY_IDENTIFIER IP_FAC_COR_LAMB_SP_WALL_UP FORMAT "%7.5"
 /begin AXIS_DESCR COM_AXIS teg_1.appl_inc_struct.lamb_sp_teg _CNV_A_R_LINEAR_____164_CM 16 0. 31.99902344 FORMAT "%7.4" AXIS_PTS_REF ldpm_lamb_sp_teg__fac_cor /end AXIS_DESCR
/end CHARACTERISTIC
/begin CHARACTERISTIC ip_crlc_teg_dec_puc_up_1 "Map of correlation constant by fuel cut off" CURVE 0x08ef0 _REC_CUR_20_u2_u2 0.99998474 _CNV_A_R_LINEAR_____37_CM 0. 0.99998474 DISPLAY_IDENTIFIER IP_CRLC_TEG_DEC_PUC_UP_1 FORMAT "%7.5"
 /begin AXIS_DESCR COM_AXIS online_dummy _CNV_A_R_LINEAR_____271_CM 8 0. 1820.398 FORMAT "%7.2" AXIS_PTS_REF ldpm_maf_int_puc__crlc_teg /end AXIS_DESCR
/end CHARACTERISTIC
/begin CHARACTERISTIC ip_crlc_teg_wall_dec_puc_up_1 "Map of correlation constant by fuel cut off" CURVE 0x09570 _REC_CUR_20_u2_u2 0.99998474 _CNV_A_R_LINEAR_____37_CM 0. 0.99998474 DISPLAY_IDENTIFIER IP_CRLC_TEG_WALL_DEC_PUC_UP_1 FORMAT "%7.5"
 /begin AXIS_DESCR COM_AXIS online_dummy _CNV_A_R_LINEAR_____271_CM 8 0. 1820.398 FORMAT "%7.2" AXIS_PTS_REF ldpm_maf_int_puc__crlc_teg /end AXIS_DESCR
/end CHARACTERISTIC
/begin CHARACTERISTIC ip_crlc_teg_inc_up_1 "Map of correlation constant by heating" MAP 0x09210 _REC_MAP_20_u2_u2_u2 0.99998474 _CNV_A_R_LINEAR_____37_CM 0. 0.99998474 DISPLAY_IDENTIFIER IP_CRLC_TEG_INC_UP_1 FORMAT "%7.5"
 /begin AXIS_DESCR COM_AXIS online_dummy _CNV_A_R_LINEAR_____262_CM 12 -48. 1459.3 FORMAT "%7.2" AXIS_PTS_REF ldpm_teg_stat__crlc_inc /end AXIS_DESCR
 /begin AXIS_DESCR COM_AXIS n_teg _CNV_A_R_LINEAR_____11_CM 8 0. 8160. FORMAT "%4.0" AXIS_PTS_REF ldpm_n_teg__crlc_teg /end AXIS_DESCR
/end CHARACTERISTIC
/begin CHARACTERISTIC ip_crlc_teg_wall_inc_up_1 "Map of correlation constant by heating" MAP 0x09890 _REC_MAP_20_u2_u2_u2 0.99998474 _CNV_A_R_LINEAR_____37_CM 0. 0.99998474 DISPLAY_IDENTIFIER IP_CRLC_TEG_WALL_INC_UP_1 FORMAT "%7.5"
 /begin AXIS_DESCR COM_AXIS online_dummy _CNV_A_R_LINEAR_____262_CM 12 -48. 1459.3 FORMAT "%7.2" AXIS_PTS_REF ldpm_teg_wall_stat__crlc_inc /end AXIS_DESCR
 /begin AXIS_DESCR COM_AXIS n_teg _CNV_A_R_LINEAR_____11_CM 8 0. 8160. FORMAT "%4.0" AXIS_PTS_REF ldpm_n_teg__crlc_teg /end AXIS_DESCR
/end CHARACTERISTIC
/begin CHARACTERISTIC ip_crlc_teg_dec_up_1 "Map of correlation constant by cooling" MAP 0x08f10 _REC_MAP_20_u2_u2_u2 0.99998474 _CNV_A_R_LINEAR_____37_CM 0. 0.99998474 DISPLAY_IDENTIFIER IP_CRLC_TEG_DEC_UP_1 FORMAT "%7.5"
 /begin AXIS_DESCR COM_AXIS online_dummy _CNV_A_R_LINEAR_____262_CM 12 -48. 1459.3 FORMAT "%7.2" AXIS_PTS_REF ldpm_teg_stat__crlc_dec /end AXIS_DESCR
 /begin AXIS_DESCR COM_AXIS n_teg _CNV_A_R_LINEAR_____11_CM 8 0. 8160. FORMAT "%4.0" AXIS_PTS_REF ldpm_n_teg__crlc_teg /end AXIS_DESCR
/end CHARACTERISTIC
/begin CHARACTERISTIC ip_crlc_teg_wall_dec_up_1 "Map of correlation constant by cooling" MAP 0x09590 _REC_MAP_20_u2_u2_u2 0.99998474 _CNV_A_R_LINEAR_____37_CM 0. 0.99998474 DISPLAY_IDENTIFIER IP_CRLC_TEG_WALL_DEC_UP_1 FORMAT "%7.5"
 /begin AXIS_DESCR COM_AXIS online_dummy _CNV_A_R_LINEAR_____262_CM 12 -48. 1459.3 FORMAT "%7.2" AXIS_PTS_REF ldpm_teg_wall_stat__crlc_dec /end AXIS_DESCR
 /begin AXIS_DESCR COM_AXIS n_teg _CNV_A_R_LINEAR_____11_CM 8 0. 8160. FORMAT "%4.0" AXIS_PTS_REF ldpm_n_teg__crlc_teg /end AXIS_DESCR
/end CHARACTERISTIC
/begin CHARACTERISTIC ip_teg_stat_down_1 "Basic pre control engine temperature " MAP 0x0edf6 _REC_MAP_20_u2_u2_u2 1507.3 _CNV_A_R_LINEAR_____262_CM -48. 1459.3 DISPLAY_IDENTIFIER IP_TEG_STAT_DOWN_1 FORMAT "%7.2"
 /begin AXIS_DESCR COM_AXIS maf_teg _CNV_A_R_LINEAR_____106_CM 8 0. 1389. FORMAT "%7.2" AXIS_PTS_REF ldpm_maf_teg__teg_stat /end AXIS_DESCR
 /begin AXIS_DESCR COM_AXIS n_teg _CNV_A_R_LINEAR_____11_CM 8 0. 8160. FORMAT "%4.0" AXIS_PTS_REF ldpm_n_teg__teg_stat /end AXIS_DESCR
/end CHARACTERISTIC
/begin CHARACTERISTIC ip_teg_wall_stat_down_1 "Basic pre control engine temperature " MAP 0x0f1be _REC_MAP_20_u2_u2_u2 1507.3 _CNV_A_R_LINEAR_____262_CM -48. 1459.3 DISPLAY_IDENTIFIER IP_TEG_WALL_STAT_DOWN_1 FORMAT "%7.2"
 /begin AXIS_DESCR COM_AXIS maf_teg _CNV_A_R_LINEAR_____106_CM 8 0. 1389. FORMAT "%7.2" AXIS_PTS_REF ldpm_maf_teg__teg_stat /end AXIS_DESCR
 /begin AXIS_DESCR COM_AXIS n_teg _CNV_A_R_LINEAR_____11_CM 8 0. 8160. FORMAT "%4.0" AXIS_PTS_REF ldpm_n_teg__teg_stat /end AXIS_DESCR
/end CHARACTERISTIC
/begin CHARACTERISTIC ip_crlc_teg_toil_dif_down "Map of correlation constant depending on TOIL difference post cat" CURVE 0x093b0 _REC_CUR_20_u2_u2 7.99987793 _CNV_A_R_LINEAR_____345_CM 0. 7.99987793 DISPLAY_IDENTIFIER IP_CRLC_TEG_TOIL_DIF_DOWN FORMAT "%6.4"
 /begin AXIS_DESCR COM_AXIS temp_toil_dif _CNV_A_R_LINEAR_____422_CM 8 -202. 202. FORMAT "%6.1" AXIS_PTS_REF ldpm_temp_toil_dif__crlc_teg /end AXIS_DESCR
/end CHARACTERISTIC
/begin CHARACTERISTIC ip_crlc_teg_wall_toil_dif_down "Map of correlation constant depending on TOIL difference post cat" CURVE 0x09a30 _REC_CUR_20_u2_u2 7.99987793 _CNV_A_R_LINEAR_____345_CM 0. 7.99987793 DISPLAY_IDENTIFIER IP_CRLC_TEG_WALL_TOIL_DIF_DOWN FORMAT "%6.4"
 /begin AXIS_DESCR COM_AXIS temp_toil_dif _CNV_A_R_LINEAR_____422_CM 8 -202. 202. FORMAT "%6.1" AXIS_PTS_REF ldpm_temp_toil_dif__crlc_teg /end AXIS_DESCR
/end CHARACTERISTIC
/begin CHARACTERISTIC ip_crlc_teg_tco_dif_down "Map of correlation constant depending on TCO difference post cat" CURVE 0x09390 _REC_CUR_20_u2_u2 7.99987793 _CNV_A_R_LINEAR_____345_CM 0. 7.99987793 DISPLAY_IDENTIFIER IP_CRLC_TEG_TCO_DIF_DOWN FORMAT "%6.4"
 /begin AXIS_DESCR COM_AXIS temp_tco_dif _CNV_A_R_LINEAR_____423_CM 8 -202. 202. FORMAT "%6.1" AXIS_PTS_REF ldpm_temp_tco_dif__crlc_teg /end AXIS_DESCR
/end CHARACTERISTIC
/begin CHARACTERISTIC ip_crlc_teg_wall_tco_dif_down "Map of correlation constant depending on TCO difference post cat" CURVE 0x09a10 _REC_CUR_20_u2_u2 7.99987793 _CNV_A_R_LINEAR_____345_CM 0. 7.99987793 DISPLAY_IDENTIFIER IP_CRLC_TEG_WALL_TCO_DIF_DOWN FORMAT "%6.4"
 /begin AXIS_DESCR COM_AXIS temp_tco_dif _CNV_A_R_LINEAR_____423_CM 8 -202. 202. FORMAT "%6.1" AXIS_PTS_REF ldpm_temp_tco_dif__crlc_teg /end AXIS_DESCR
/end CHARACTERISTIC
/begin CHARACTERISTIC ip_crlc_teg_dec_puc_down_1 "Map of correlation constant by fuel cut off post cat." CURVE 0x08ed0 _REC_CUR_20_u2_u2 0.99998474 _CNV_A_R_LINEAR_____37_CM 0. 0.99998474 DISPLAY_IDENTIFIER IP_CRLC_TEG_DEC_PUC_DOWN_1 FORMAT "%7.5"
 /begin AXIS_DESCR COM_AXIS online_dummy _CNV_A_R_LINEAR_____271_CM 8 0. 1820.398 FORMAT "%7.2" AXIS_PTS_REF ldpm_maf_int_puc__crlc_teg /end AXIS_DESCR
/end CHARACTERISTIC
/begin CHARACTERISTIC ip_crlc_teg_wall_dec_puc_down_1 "Map of correlation constant by fuel cut off post cat." CURVE 0x09550 _REC_CUR_20_u2_u2 0.99998474 _CNV_A_R_LINEAR_____37_CM 0. 0.99998474 DISPLAY_IDENTIFIER IP_CRLC_TEG_WALL_DEC_PUC_DOWN_1 FORMAT "%7.5"
 /begin AXIS_DESCR COM_AXIS online_dummy _CNV_A_R_LINEAR_____271_CM 8 0. 1820.398 FORMAT "%7.2" AXIS_PTS_REF ldpm_maf_int_puc__crlc_teg /end AXIS_DESCR
/end CHARACTERISTIC
/begin CHARACTERISTIC ip_crlc_teg_dec_down_1 "Map of correlation constant by cooling post cat." MAP 0x08d50 _REC_MAP_20_u2_u2_u2 0.99998474 _CNV_A_R_LINEAR_____37_CM 0. 0.99998474 DISPLAY_IDENTIFIER IP_CRLC_TEG_DEC_DOWN_1 FORMAT "%7.5"
 /begin AXIS_DESCR COM_AXIS online_dummy _CNV_A_R_LINEAR_____262_CM 12 -48. 1459.3 FORMAT "%7.2" AXIS_PTS_REF ldpm_teg_stat__crlc_dec /end AXIS_DESCR
 /begin AXIS_DESCR COM_AXIS n_teg _CNV_A_R_LINEAR_____11_CM 8 0. 8160. FORMAT "%4.0" AXIS_PTS_REF ldpm_n_teg__crlc_teg /end AXIS_DESCR
/end CHARACTERISTIC
/begin CHARACTERISTIC ip_crlc_teg_wall_dec_down_1 "Map of correlation constant by cooling post cat." MAP 0x093d0 _REC_MAP_20_u2_u2_u2 0.99998474 _CNV_A_R_LINEAR_____37_CM 0. 0.99998474 DISPLAY_IDENTIFIER IP_CRLC_TEG_WALL_DEC_DOWN_1 FORMAT "%7.5"
 /begin AXIS_DESCR COM_AXIS online_dummy _CNV_A_R_LINEAR_____262_CM 12 -48. 1459.3 FORMAT "%7.2" AXIS_PTS_REF ldpm_teg_wall_stat__crlc_dec /end AXIS_DESCR
 /begin AXIS_DESCR COM_AXIS n_teg _CNV_A_R_LINEAR_____11_CM 8 0. 8160. FORMAT "%4.0" AXIS_PTS_REF ldpm_n_teg__crlc_teg /end AXIS_DESCR
/end CHARACTERISTIC
/begin CHARACTERISTIC ip_crlc_teg_inc_down_1 "Map of correlation constant by heating post cat." MAP 0x09090 _REC_MAP_20_u2_u2_u2 0.99998474 _CNV_A_R_LINEAR_____37_CM 0. 0.99998474 DISPLAY_IDENTIFIER IP_CRLC_TEG_INC_DOWN_1 FORMAT "%7.5"
 /begin AXIS_DESCR COM_AXIS online_dummy _CNV_A_R_LINEAR_____262_CM 12 -48. 1459.3 FORMAT "%7.2" AXIS_PTS_REF ldpm_teg_stat__crlc_inc /end AXIS_DESCR
 /begin AXIS_DESCR COM_AXIS n_teg _CNV_A_R_LINEAR_____11_CM 8 0. 8160. FORMAT "%4.0" AXIS_PTS_REF ldpm_n_teg__crlc_teg /end AXIS_DESCR
/end CHARACTERISTIC
/begin CHARACTERISTIC ip_crlc_teg_wall_inc_down_1 "Map of correlation constant by heating post cat." MAP 0x09710 _REC_MAP_20_u2_u2_u2 0.99998474 _CNV_A_R_LINEAR_____37_CM 0. 0.99998474 DISPLAY_IDENTIFIER IP_CRLC_TEG_WALL_INC_DOWN_1 FORMAT "%7.5"
 /begin AXIS_DESCR COM_AXIS online_dummy _CNV_A_R_LINEAR_____262_CM 12 -48. 1459.3 FORMAT "%7.2" AXIS_PTS_REF ldpm_teg_wall_stat__crlc_inc /end AXIS_DESCR
 /begin AXIS_DESCR COM_AXIS n_teg _CNV_A_R_LINEAR_____11_CM 8 0. 8160. FORMAT "%4.0" AXIS_PTS_REF ldpm_n_teg__crlc_teg /end AXIS_DESCR
/end CHARACTERISTIC
/begin CHARACTERISTIC c_tam_ref "Reference ambient temperature" VALUE 0x00852 _REC_VAL_20_u1 190.5 _CNV_A_R_LINEAR_____12_CM -48. 142.5 DISPLAY_IDENTIFIER C_TAM_REF FORMAT "%5.1" /end CHARACTERISTIC
/begin CHARACTERISTIC c_maf_int_teg_st_up "Correlation constant at start" VALUE 0x01680 _REC_VAL_20_u2 1820.398 _CNV_A_R_LINEAR_____271_CM 0. 1820.398 DISPLAY_IDENTIFIER C_MAF_INT_TEG_ST_UP FORMAT "%7.2" /end CHARACTERISTIC
/begin CHARACTERISTIC c_crlc_teg_st_up "Correlation constant at start" VALUE 0x014ea _REC_VAL_20_u2 0.999755 _CNV_A_R_LINEAR_____124_CM 0. 0.999755 DISPLAY_IDENTIFIER C_CRLC_TEG_ST_UP FORMAT "%7.5" /end CHARACTERISTIC
/begin CHARACTERISTIC c_egy_teg_end_sp_up_1 "Threshold of energy setpoint after start" VALUE 0x0154a _REC_VAL_20_u2 9.83 _CNV_A_R_LINEAR_____424_CM 0. 9.83 DISPLAY_IDENTIFIER C_EGY_TEG_END_SP_UP_1 FORMAT "%6.4" /end CHARACTERISTIC
/begin CHARACTERISTIC c_egy_teg_end_sp_up_2 "Threshold of energy setpoint after start" VALUE 0x0154c _REC_VAL_20_u2 9.83 _CNV_A_R_LINEAR_____424_CM 0. 9.83 DISPLAY_IDENTIFIER C_EGY_TEG_END_SP_UP_2 FORMAT "%6.4" /end CHARACTERISTIC
/begin CHARACTERISTIC c_teg_wall_st_off "Temperature until temperature start  detection" VALUE 0x018f8 _REC_VAL_20_u2 1507.3 _CNV_A_R_LINEAR_____262_CM -48. 1459.3 DISPLAY_IDENTIFIER C_TEG_WALL_ST_OFF FORMAT "%7.2" /end CHARACTERISTIC
/begin CHARACTERISTIC c_crlc_teg_wall_st_end_up "Correlation constant at start" VALUE 0x014f0 _REC_VAL_20_u2 0.999755 _CNV_A_R_LINEAR_____124_CM 0. 0.999755 DISPLAY_IDENTIFIER C_CRLC_TEG_WALL_ST_END_UP FORMAT "%7.5" /end CHARACTERISTIC
/begin CHARACTERISTIC c_crlc_teg_wall_st_up "Correlation constant at start" VALUE 0x014f2 _REC_VAL_20_u2 0.999755 _CNV_A_R_LINEAR_____124_CM 0. 0.999755 DISPLAY_IDENTIFIER C_CRLC_TEG_WALL_ST_UP FORMAT "%7.5" /end CHARACTERISTIC
/begin CHARACTERISTIC c_egy_teg_wall_end_sp_up "Threshold of energy setpoint after start" VALUE 0x01550 _REC_VAL_20_u2 9.83 _CNV_A_R_LINEAR_____424_CM 0. 9.83 DISPLAY_IDENTIFIER C_EGY_TEG_WALL_END_SP_UP FORMAT "%6.4" /end CHARACTERISTIC
/begin CHARACTERISTIC c_fac_cor_vo_teg_down "Valve overlap correction depending on load engine post cat" VALUE 0x0156c _REC_VAL_20_u2 1.99996948 _CNV_A_R_LINEAR_____21_CM 0. 1.99996948 DISPLAY_IDENTIFIER C_FAC_COR_VO_TEG_DOWN FORMAT "%7.5" /end CHARACTERISTIC
/begin CHARACTERISTIC c_fac_cor_vo_teg_wall_down "Valve overlap correction depending on load engine post cat" VALUE 0x0156e _REC_VAL_20_u2 1.99996948 _CNV_A_R_LINEAR_____21_CM 0. 1.99996948 DISPLAY_IDENTIFIER C_FAC_COR_VO_TEG_WALL_DOWN FORMAT "%7.5" /end CHARACTERISTIC
/begin CHARACTERISTIC c_fac_cor_lamb_sp_teg_down "Lambda influences correction depending on load engine post cat." VALUE 0x01564 _REC_VAL_20_u2 1.99996948 _CNV_A_R_LINEAR_____21_CM 0. 1.99996948 DISPLAY_IDENTIFIER C_FAC_COR_LAMB_SP_TEG_DOWN FORMAT "%7.5" /end CHARACTERISTIC
/begin CHARACTERISTIC c_fac_cor_lamb_sp_teg_wall_down "Lambda influences correction depending on load engine post cat." VALUE 0x01566 _REC_VAL_20_u2 1.99996948 _CNV_A_R_LINEAR_____21_CM 0. 1.99996948 DISPLAY_IDENTIFIER C_FAC_COR_LAMB_SP_TEG_WALL_DOWN FORMAT "%7.5" /end CHARACTERISTIC
/begin CHARACTERISTIC c_fac_cor_saf_teg_down "Secondary air influences correction post cat" VALUE 0x01568 _REC_VAL_20_u2 1.99996948 _CNV_A_R_LINEAR_____21_CM 0. 1.99996948 DISPLAY_IDENTIFIER C_FAC_COR_SAF_TEG_DOWN FORMAT "%7.5" /end CHARACTERISTIC
/begin CHARACTERISTIC c_fac_cor_saf_teg_wall_down "SAF influences correction depending on load engine post cat." VALUE 0x0156a _REC_VAL_20_u2 1.99996948 _CNV_A_R_LINEAR_____21_CM 0. 1.99996948 DISPLAY_IDENTIFIER C_FAC_COR_SAF_TEG_WALL_DOWN FORMAT "%7.5" /end CHARACTERISTIC
/begin CHARACTERISTIC c_fac_vs_teg_down "Vehicle speed correction depending on load Engine post cat" VALUE 0x015b6 _REC_VAL_20_u2 1.99996948 _CNV_A_R_LINEAR_____21_CM 0. 1.99996948 DISPLAY_IDENTIFIER C_FAC_VS_TEG_DOWN FORMAT "%7.5" /end CHARACTERISTIC
/begin CHARACTERISTIC c_fac_vs_teg_wall_down "Vehicle speed correction depending on load Engine post cat" VALUE 0x015b8 _REC_VAL_20_u2 1.99996948 _CNV_A_R_LINEAR_____21_CM 0. 1.99996948 DISPLAY_IDENTIFIER C_FAC_VS_TEG_WALL_DOWN FORMAT "%7.5" /end CHARACTERISTIC
/begin CHARACTERISTIC c_crlc_teg_wall_st_end_down "Correlation constant at start" VALUE 0x014ee _REC_VAL_20_u2 0.999755 _CNV_A_R_LINEAR_____124_CM 0. 0.999755 DISPLAY_IDENTIFIER C_CRLC_TEG_WALL_ST_END_DOWN FORMAT "%7.5" /end CHARACTERISTIC
/begin CHARACTERISTIC c_maf_int_teg_st_down "Threshold of mass air post cat." VALUE 0x0167e _REC_VAL_20_u2 1820.398 _CNV_A_R_LINEAR_____271_CM 0. 1820.398 DISPLAY_IDENTIFIER C_MAF_INT_TEG_ST_DOWN FORMAT "%7.2" /end CHARACTERISTIC
/begin CHARACTERISTIC c_maf_int_teg_wall_st_down "Threshold of mass air" VALUE 0x01682 _REC_VAL_20_u2 1820.398 _CNV_A_R_LINEAR_____271_CM 0. 1820.398 DISPLAY_IDENTIFIER C_MAF_INT_TEG_WALL_ST_DOWN FORMAT "%7.2" /end CHARACTERISTIC
/begin CHARACTERISTIC c_crlc_teg_st_down "Correlation constant at start post cat." VALUE 0x014e4 _REC_VAL_20_u2 0.999755 _CNV_A_R_LINEAR_____124_CM 0. 0.999755 DISPLAY_IDENTIFIER C_CRLC_TEG_ST_DOWN FORMAT "%7.5" /end CHARACTERISTIC
/begin CHARACTERISTIC c_crlc_teg_wall_st_down "Correlation constant at start" VALUE 0x014ec _REC_VAL_20_u2 0.999755 _CNV_A_R_LINEAR_____124_CM 0. 0.999755 DISPLAY_IDENTIFIER C_CRLC_TEG_WALL_ST_DOWN FORMAT "%7.5" /end CHARACTERISTIC
/begin CHARACTERISTIC c_egy_teg_end_sp_down_1 "Threshold of energy setpoint after start post cat." VALUE 0x01546 _REC_VAL_20_u2 9.83 _CNV_A_R_LINEAR_____424_CM 0. 9.83 DISPLAY_IDENTIFIER C_EGY_TEG_END_SP_DOWN_1 FORMAT "%6.4" /end CHARACTERISTIC
/begin CHARACTERISTIC c_egy_teg_end_sp_down_2 "Threshold of energy setpoint after start post cat." VALUE 0x01548 _REC_VAL_20_u2 9.83 _CNV_A_R_LINEAR_____424_CM 0. 9.83 DISPLAY_IDENTIFIER C_EGY_TEG_END_SP_DOWN_2 FORMAT "%6.4" /end CHARACTERISTIC
/begin CHARACTERISTIC c_egy_teg_wall_end_sp_down "Threshold of energy setpoint after start" VALUE 0x0154e _REC_VAL_20_u2 9.83 _CNV_A_R_LINEAR_____424_CM 0. 9.83 DISPLAY_IDENTIFIER C_EGY_TEG_WALL_END_SP_DOWN FORMAT "%6.4" /end CHARACTERISTIC
/begin MEASUREMENT pow_dif_max "Maximum power loss for active Nox desulfation" UWORD _CNV_A_R_LINEAR_____425_CM 1 100. 0. 434.0555 DISPLAY_IDENTIFIER POW_DIF_MAX ECU_ADDRESS 0x3fd2c6 BYTE_ORDER MSB_LAST FORMAT "%7.3" /end MEASUREMENT
/begin MEASUREMENT tam_dew "Ambient temperature for the end of dew point module" UBYTE _CNV_A_R_LINEAR_____12_CM 1 100. -48. 142.5 DISPLAY_IDENTIFIER TAM_DEW ECU_ADDRESS 0x3fe127 FORMAT "%5.1" /end MEASUREMENT
/begin MEASUREMENT t_es_dew "Engine shut-off duration" UWORD _CNV_A_R_LINEAR_____97_CM 1 100. 0. 65535. DISPLAY_IDENTIFIER T_ES_DEW ECU_ADDRESS 0x3fd2ee BYTE_ORDER MSB_LAST FORMAT "%5.0" /end MEASUREMENT
/begin MEASUREMENT egy_dew_stop_up "Additional amount of heat if dew point has not been reached" ULONG _CNV_A_R_LINEAR_____416_CM 1 100. 0. 7456.426 DISPLAY_IDENTIFIER EGY_DEW_STOP_UP ECU_ADDRESS 0x3fcad8 BYTE_ORDER MSB_LAST FORMAT "%12.7" /end MEASUREMENT
/begin MEASUREMENT egy_dew_stop_down "Additional amount of heat if dew point has not been reached" ULONG _CNV_A_R_LINEAR_____416_CM 1 100. 0. 7456.426 DISPLAY_IDENTIFIER EGY_DEW_STOP_DOWN ECU_ADDRESS 0x3fcadc BYTE_ORDER MSB_LAST FORMAT "%12.7" /end MEASUREMENT
/begin MEASUREMENT egy_dew_end_down "Total amount of energy until end of dew point" ULONG _CNV_A_R_LINEAR_____416_CM 1 100. 0. 7456.426 DISPLAY_IDENTIFIER EGY_DEW_END_DOWN ECU_ADDRESS 0x3fcae4 BYTE_ORDER MSB_LAST FORMAT "%12.7" /end MEASUREMENT
/begin MEASUREMENT egy_dew_end_up "Total amount of energy until end of dew point" ULONG _CNV_A_R_LINEAR_____416_CM 1 100. 0. 7456.426 DISPLAY_IDENTIFIER EGY_DEW_END_UP ECU_ADDRESS 0x3fcae0 BYTE_ORDER MSB_LAST FORMAT "%12.7" /end MEASUREMENT
/begin MEASUREMENT egy_dew_up "Energy which is converted in the exhaust gas until reaching the dew point" ULONG _CNV_A_R_LINEAR_____416_CM 1 100. 0. 7456.426 DISPLAY_IDENTIFIER EGY_DEW_UP ECU_ADDRESS 0x3fcae8 BYTE_ORDER MSB_LAST FORMAT "%12.7" /end MEASUREMENT
/begin MEASUREMENT egy_dew_down "Energy which is converted in the exhaust gas until reaching the dew point" ULONG _CNV_A_R_LINEAR_____416_CM 1 100. 0. 7456.426 DISPLAY_IDENTIFIER EGY_DEW_DOWN ECU_ADDRESS 0x3fcaec BYTE_ORDER MSB_LAST FORMAT "%12.7" /end MEASUREMENT
/begin CHARACTERISTIC c_fac_lamb_teg_stat_max "temperature influence by lambda adjustments" VALUE 0x01578 _REC_VAL_20_u2 3.999939 _CNV_A_R_LINEAR_____309_CM 0. 3.999939 DISPLAY_IDENTIFIER C_FAC_LAMB_TEG_STAT_MAX FORMAT "%7.5" /end CHARACTERISTIC
/begin CHARACTERISTIC c_delta_tia "Differential temperature to Intake air temperature" VALUE 0x0067f _REC_VAL_20_u1 190.5 _CNV_A_R_LINEAR_____12_CM -48. 142.5 DISPLAY_IDENTIFIER C_DELTA_TIA FORMAT "%5.1" /end CHARACTERISTIC
/begin CHARACTERISTIC c_t_es_dew_min "Minimum shut-off time for end of dew point calculation" VALUE 0x01840 _REC_VAL_20_u2 65535. _CNV_A_R_LINEAR_____97_CM 0. 65535. DISPLAY_IDENTIFIER C_T_ES_DEW_MIN FORMAT "%5.0" /end CHARACTERISTIC
/begin CHARACTERISTIC c_t_es_dew_max "Maximum shut-off time for end of dew point calculation" VALUE 0x0183e _REC_VAL_20_u2 65535. _CNV_A_R_LINEAR_____97_CM 0. 65535. DISPLAY_IDENTIFIER C_T_ES_DEW_MAX FORMAT "%5.0" /end CHARACTERISTIC
/begin CHARACTERISTIC ip_fac_cor_vo_up "Valve overlap correction" CURVE 0x0ab46 _REC_CUR_20_u2_u2 4. _CNV_A_R_LINEAR_____264_CM -2. 2. DISPLAY_IDENTIFIER IP_FAC_COR_VO_UP FORMAT "%8.5"
 /begin AXIS_DESCR COM_AXIS vo_dif_teg _CNV_A_R_LINEAR_____426_CM 6 -95.625 95.625 FORMAT "%5.1" AXIS_PTS_REF ldpm_vo_dif_teg__teg_stat /end AXIS_DESCR
/end CHARACTERISTIC
/begin CHARACTERISTIC ip_fac_cor_vo_wall_up "Valve overlap correction" CURVE 0x0ab52 _REC_CUR_20_u2_u2 4. _CNV_A_R_LINEAR_____264_CM -2. 2. DISPLAY_IDENTIFIER IP_FAC_COR_VO_WALL_UP FORMAT "%8.5"
 /begin AXIS_DESCR COM_AXIS vo_dif_teg _CNV_A_R_LINEAR_____426_CM 6 -95.625 95.625 FORMAT "%5.1" AXIS_PTS_REF ldpm_vo_dif_teg__teg_stat /end AXIS_DESCR
/end CHARACTERISTIC
/begin CHARACTERISTIC ip_fac_cor_saf_wall "SAF_KGH correktion" CURVE 0x0aaf2 _REC_CUR_20_u2_u2 1.99996948 _CNV_A_R_LINEAR_____21_CM 0. 1.99996948 DISPLAY_IDENTIFIER IP_FAC_COR_SAF_WALL FORMAT "%7.5"
 /begin AXIS_DESCR COM_AXIS saf_kgh _CNV_A_R_LINEAR_____47_CM 6 0. 1023.984375 FORMAT "%7.2" AXIS_PTS_REF ldpm_saf_kgh__fac_cor_saf /end AXIS_DESCR
/end CHARACTERISTIC
/begin CHARACTERISTIC ip_fac_scc_teg_wall "Single cylinder shut off influence of exhaust temperature " CURVE 0x0afb6 _REC_CUR_20_u2_u1 0.99998474 _CNV_A_R_LINEAR_____37_CM 0. 0.99998474 DISPLAY_IDENTIFIER IP_FAC_SCC_TEG_WALL FORMAT "%7.5"
 /begin AXIS_DESCR COM_AXIS teg_1.appl_inc_struct.nr_cyl_scc_teg _CNV_A_R_LINEAR_____388_CM 14 0. 13. FORMAT "%4.1" AXIS_PTS_REF ldpm_nr_cyl_scc_teg__fac_scc /end AXIS_DESCR
/end CHARACTERISTIC
/begin CHARACTERISTIC ip_crlc_teg_tco_dif_up "Map of correlation constant depending on TCO difference" CURVE 0x093a0 _REC_CUR_20_u2_u2 7.99987793 _CNV_A_R_LINEAR_____345_CM 0. 7.99987793 DISPLAY_IDENTIFIER IP_CRLC_TEG_TCO_DIF_UP FORMAT "%6.4"
 /begin AXIS_DESCR COM_AXIS temp_tco_dif _CNV_A_R_LINEAR_____423_CM 8 -202. 202. FORMAT "%6.1" AXIS_PTS_REF ldpm_temp_tco_dif__crlc_teg /end AXIS_DESCR
/end CHARACTERISTIC
/begin CHARACTERISTIC ip_crlc_teg_toil_dif_up "Map of correlation constant depending on TOIL difference" CURVE 0x093c0 _REC_CUR_20_u2_u2 7.99987793 _CNV_A_R_LINEAR_____345_CM 0. 7.99987793 DISPLAY_IDENTIFIER IP_CRLC_TEG_TOIL_DIF_UP FORMAT "%6.4"
 /begin AXIS_DESCR COM_AXIS temp_toil_dif _CNV_A_R_LINEAR_____422_CM 8 -202. 202. FORMAT "%6.1" AXIS_PTS_REF ldpm_temp_toil_dif__crlc_teg /end AXIS_DESCR
/end CHARACTERISTIC
/begin CHARACTERISTIC c_crlc_teg_st_end_down "Correlation constant at start post cat." VALUE 0x014e6 _REC_VAL_20_u2 7.99987793 _CNV_A_R_LINEAR_____345_CM 0. 7.99987793 DISPLAY_IDENTIFIER C_CRLC_TEG_ST_END_DOWN FORMAT "%6.4" /end CHARACTERISTIC
/begin CHARACTERISTIC c_crlc_teg_st_end_up "Correlation constant at start post cat." VALUE 0x014e8 _REC_VAL_20_u2 7.99987793 _CNV_A_R_LINEAR_____345_CM 0. 7.99987793 DISPLAY_IDENTIFIER C_CRLC_TEG_ST_END_UP FORMAT "%6.4" /end CHARACTERISTIC
/begin CHARACTERISTIC ip_crlc_teg_wall_toil_dif_up "Map of correlation constant depending on TOIL difference" CURVE 0x09a40 _REC_CUR_20_u2_u2 7.99987793 _CNV_A_R_LINEAR_____345_CM 0. 7.99987793 DISPLAY_IDENTIFIER IP_CRLC_TEG_WALL_TOIL_DIF_UP FORMAT "%6.4"
 /begin AXIS_DESCR COM_AXIS temp_toil_dif _CNV_A_R_LINEAR_____422_CM 8 -202. 202. FORMAT "%6.1" AXIS_PTS_REF ldpm_temp_toil_dif__crlc_teg /end AXIS_DESCR
/end CHARACTERISTIC
/begin CHARACTERISTIC c_tco_st "Temperature threshold for coolant at start" VALUE 0x00897 _REC_VAL_20_u1 190.5 _CNV_A_R_LINEAR_____12_CM -48. 142.5 DISPLAY_IDENTIFIER C_TCO_ST FORMAT "%5.1" /end CHARACTERISTIC
/begin CHARACTERISTIC c_tco_es_dew "TCO differential threshold for long engine shut-off times" VALUE 0x00868 _REC_VAL_20_u1 190.5 _CNV_A_R_LINEAR_____13_CM 0. 190.5 DISPLAY_IDENTIFIER C_TCO_ES_DEW FORMAT "%5.1" /end CHARACTERISTIC
/begin CHARACTERISTIC c_t_es_dif_dew "Minimum differential time for engine shut-off time" VALUE 0x01846 _REC_VAL_20_u2 65535. _CNV_A_R_LINEAR_____97_CM 0. 65535. DISPLAY_IDENTIFIER C_T_ES_DIF_DEW FORMAT "%5.0" /end CHARACTERISTIC
/begin CHARACTERISTIC c_fac_egy_dew_stop "Weighting factor on restart" VALUE 0x006c7 _REC_VAL_20_u1 0.99610001 _CNV_A_R_LINEAR_____29_CM 0. 0.99610001 DISPLAY_IDENTIFIER C_FAC_EGY_DEW_STOP FORMAT "%5.3" /end CHARACTERISTIC
/begin CHARACTERISTIC ip_crlc_teg_wall_tco_dif_up "Map of correlation constant depending on TCO difference" CURVE 0x09a20 _REC_CUR_20_u2_u2 7.99987793 _CNV_A_R_LINEAR_____345_CM 0. 7.99987793 DISPLAY_IDENTIFIER IP_CRLC_TEG_WALL_TCO_DIF_UP FORMAT "%6.4"
 /begin AXIS_DESCR COM_AXIS temp_tco_dif _CNV_A_R_LINEAR_____423_CM 8 -202. 202. FORMAT "%6.1" AXIS_PTS_REF ldpm_temp_tco_dif__crlc_teg /end AXIS_DESCR
/end CHARACTERISTIC
/begin CHARACTERISTIC ip_egy_dew_end_st_up "Pre-catalyst amount of heat depending on start temperature and manifold wall temperature" MAP 0x0a7de _REC_MAP_20_u2_u1_u2 7456.426000000001 _CNV_A_R_LINEAR_____427_CM 0. 7456.426 DISPLAY_IDENTIFIER IP_EGY_DEW_END_ST_UP FORMAT "%6.1"
 /begin AXIS_DESCR COM_AXIS tco_st _CNV_A_R_LINEAR_____12_CM 8 -48. 142.5 FORMAT "%5.1" AXIS_PTS_REF ldpm_tco_st__dew /end AXIS_DESCR
 /begin AXIS_DESCR COM_AXIS online_dummy _CNV_A_R_LINEAR_____262_CM 8 -48. 1459.3 FORMAT "%7.2" AXIS_PTS_REF ldpm_teg_wall_cat_up_mdl_1 /end AXIS_DESCR
/end CHARACTERISTIC
/begin CHARACTERISTIC ip_egy_dew_end_st_down "Post-catalyst amount of heat depending on start temperature and manifold wall temperature" MAP 0x0a75e _REC_MAP_20_u2_u1_u2 7456.426000000001 _CNV_A_R_LINEAR_____427_CM 0. 7456.426 DISPLAY_IDENTIFIER IP_EGY_DEW_END_ST_DOWN FORMAT "%6.1"
 /begin AXIS_DESCR COM_AXIS tco_st _CNV_A_R_LINEAR_____12_CM 8 -48. 142.5 FORMAT "%5.1" AXIS_PTS_REF ldpm_tco_st__dew /end AXIS_DESCR
 /begin AXIS_DESCR COM_AXIS online_dummy _CNV_A_R_LINEAR_____262_CM 8 -48. 1459.3 FORMAT "%7.2" AXIS_PTS_REF ldpm_teg_wall_cat_down_mdl_1 /end AXIS_DESCR
/end CHARACTERISTIC
/begin CHARACTERISTIC lc_puc_teg_ena "logical constant for PUC_TEG" VALUE 0x00f69 _REC_VAL_20_u1 1. _CNV_A_R_LINEAR_____1_CM 0. 1. DISPLAY_IDENTIFIER LC_PUC_TEG_ENA FORMAT "%2.0" /end CHARACTERISTIC
/begin MEASUREMENT crlc_teg_wall_tco_dif_down "Correlation constant by TOIL_DIF" UWORD _CNV_A_R_LINEAR_____345_CM 1 100. 0. 7.99987793 DISPLAY_IDENTIFIER CRLC_TEG_WALL_TCO_DIF_DOWN ECU_ADDRESS 0x3fd2ea BYTE_ORDER MSB_LAST FORMAT "%6.4" /end MEASUREMENT
/begin MEASUREMENT crlc_teg_wall_toil_dif_down "Correlation constant by TOIL_DIF" UWORD _CNV_A_R_LINEAR_____345_CM 1 100. 0. 7.99987793 DISPLAY_IDENTIFIER CRLC_TEG_WALL_TOIL_DIF_DOWN ECU_ADDRESS 0x3fd2e8 BYTE_ORDER MSB_LAST FORMAT "%6.4" /end MEASUREMENT
/begin CHARACTERISTIC ip_fac_vs_teg_stat_max "temperature influence by the vehicle speed" CURVE 0x00c0e _REC_CUR_20_u1_u1 3.984375 _CNV_A_R_LINEAR_____127_CM 0. 3.984375 DISPLAY_IDENTIFIER IP_FAC_VS_TEG_STAT_MAX FORMAT "%4.2"
 /begin AXIS_DESCR COM_AXIS vs _CNV_A_R_LINEAR_____23_CM 6 0. 255. FORMAT "%3.0" AXIS_PTS_REF ldp_vs__fac_vs_teg /end AXIS_DESCR
/end CHARACTERISTIC
/begin CHARACTERISTIC ip_add_teg_iga "temperature influence by ignition angle adjustments" CURVE 0x08af4 _REC_CUR_20_u2_u2 2047. _CNV_A_R_LINEAR_____7_CM 0. 2047. DISPLAY_IDENTIFIER IP_ADD_TEG_IGA FORMAT "%7.2"
 /begin AXIS_DESCR COM_AXIS pow_dif_max _CNV_A_R_LINEAR_____425_CM 6 0. 434.0555 FORMAT "%7.3" AXIS_PTS_REF ldp_pow_dif_max__add_teg_iga /end AXIS_DESCR
/end CHARACTERISTIC
/begin CHARACTERISTIC ip_teg_cor_vo_up "Valve overlap correction depending on load engine" MAP 0x0ece6 _REC_MAP_20_u2_u2_u2 983.025 _CNV_A_R_LINEAR_____417_CM -491.52 491.505 DISPLAY_IDENTIFIER IP_TEG_COR_VO_UP FORMAT "%7.2"
 /begin AXIS_DESCR COM_AXIS maf_teg _CNV_A_R_LINEAR_____106_CM 8 0. 1389. FORMAT "%7.2" AXIS_PTS_REF ldpm_maf_teg__teg_stat /end AXIS_DESCR
 /begin AXIS_DESCR COM_AXIS n_teg _CNV_A_R_LINEAR_____11_CM 8 0. 8160. FORMAT "%4.0" AXIS_PTS_REF ldpm_n_teg__teg_stat /end AXIS_DESCR
/end CHARACTERISTIC
/begin MEASUREMENT vo_dif_teg "Difference of valve overlap for temperature influence" UWORD _CNV_A_R_LINEAR_____426_CM 1 100. -95.625 95.625 DISPLAY_IDENTIFIER VO_DIF_TEG ECU_ADDRESS 0x3fd2f0 BYTE_ORDER MSB_LAST FORMAT "%5.1" /end MEASUREMENT
/begin CHARACTERISTIC ip_eff_iga_av_teg_cor "Basic pre control engine temperature" MAP 0x09c1e _REC_MAP_20_u2_u2_u2 4. _CNV_A_R_LINEAR_____264_CM -2. 2. DISPLAY_IDENTIFIER IP_EFF_IGA_AV_TEG_COR FORMAT "%8.5"
 /begin AXIS_DESCR COM_AXIS maf_teg _CNV_A_R_LINEAR_____106_CM 8 0. 1389. FORMAT "%7.2" AXIS_PTS_REF ldpm_maf_teg__teg_stat /end AXIS_DESCR
 /begin AXIS_DESCR COM_AXIS n_teg _CNV_A_R_LINEAR_____11_CM 8 0. 8160. FORMAT "%4.0" AXIS_PTS_REF ldpm_n_teg__teg_stat /end AXIS_DESCR
/end CHARACTERISTIC
/begin CHARACTERISTIC ip_teg_cor_eff_iga_up "Power loss influences by IGA temperature correction depending on load engine" MAP 0x0ec66 _REC_MAP_20_u2_u2_u2 983.025 _CNV_A_R_LINEAR_____414_CM 0. 983.025 DISPLAY_IDENTIFIER IP_TEG_COR_EFF_IGA_UP FORMAT "%6.2"
 /begin AXIS_DESCR COM_AXIS maf_teg _CNV_A_R_LINEAR_____106_CM 8 0. 1389. FORMAT "%7.2" AXIS_PTS_REF ldpm_maf_teg__teg_stat /end AXIS_DESCR
 /begin AXIS_DESCR COM_AXIS n_teg _CNV_A_R_LINEAR_____11_CM 8 0. 8160. FORMAT "%4.0" AXIS_PTS_REF ldpm_n_teg__teg_stat /end AXIS_DESCR
/end CHARACTERISTIC
/begin CHARACTERISTIC ip_temp_sp_tco "Reference engine TCO temperature" MAP 0x0751f _REC_MAP_20_u1_u2_u2 190.5 _CNV_A_R_LINEAR_____12_CM -48. 142.5 DISPLAY_IDENTIFIER IP_TEMP_SP_TCO FORMAT "%5.1"
 /begin AXIS_DESCR COM_AXIS maf_teg _CNV_A_R_LINEAR_____106_CM 8 0. 1389. FORMAT "%7.2" AXIS_PTS_REF ldpm_maf_teg__teg_stat /end AXIS_DESCR
 /begin AXIS_DESCR COM_AXIS n_teg _CNV_A_R_LINEAR_____11_CM 8 0. 8160. FORMAT "%4.0" AXIS_PTS_REF ldpm_n_teg__teg_stat /end AXIS_DESCR
/end CHARACTERISTIC
/begin CHARACTERISTIC ip_fac_cor_eff_iga_up "influences by IGA temperature correction" CURVE 0x0aa86 _REC_CUR_20_u2_u2 1.99996948 _CNV_A_R_LINEAR_____21_CM 0. 1.99996948 DISPLAY_IDENTIFIER IP_FAC_COR_EFF_IGA_UP FORMAT "%7.5"
 /begin AXIS_DESCR COM_AXIS online_dummy _CNV_A_R_LINEAR_____21_CM 8 0. 1.99996948 FORMAT "%7.5" AXIS_PTS_REF ldpm_eff_iga_av_teg_cor /end AXIS_DESCR
/end CHARACTERISTIC
/begin CHARACTERISTIC c_fac_ref_tco_up "Reference correction TCO" VALUE 0x006d5 _REC_VAL_20_u1 1.99220002 _CNV_A_R_LINEAR_____39_CM 0. 1.99220002 DISPLAY_IDENTIFIER C_FAC_REF_TCO_UP FORMAT "%5.3" /end CHARACTERISTIC
/begin CHARACTERISTIC c_fac_ref_scc_tco_up "Reference correction TCO for SCC" VALUE 0x006d1 _REC_VAL_20_u1 1.99220002 _CNV_A_R_LINEAR_____39_CM 0. 1.99220002 DISPLAY_IDENTIFIER C_FAC_REF_SCC_TCO_UP FORMAT "%5.3" /end CHARACTERISTIC
/begin CHARACTERISTIC c_fac_tco_ex_teg_up_1 "Temperature TEMP_TCO_EX_DIF correction" VALUE 0x0158a _REC_VAL_20_u2 1.99996948 _CNV_A_R_LINEAR_____21_CM 0. 1.99996948 DISPLAY_IDENTIFIER C_FAC_TCO_EX_TEG_UP_1 FORMAT "%7.5" /end CHARACTERISTIC
/begin CHARACTERISTIC c_fac_tco_ex_teg_up_2 "Temperature TEMP_TCO_EX_DIF correction" VALUE 0x0158c _REC_VAL_20_u2 1.99996948 _CNV_A_R_LINEAR_____21_CM 0. 1.99996948 DISPLAY_IDENTIFIER C_FAC_TCO_EX_TEG_UP_2 FORMAT "%7.5" /end CHARACTERISTIC
/begin CHARACTERISTIC ip_fac_teg_stop_down "Factor for engine off duration time" MAP 0x0b0de _REC_MAP_20_u2_u1_u2 7.99987793 _CNV_A_R_LINEAR_____345_CM 0. 7.99987793 DISPLAY_IDENTIFIER IP_FAC_TEG_STOP_DOWN FORMAT "%6.4"
 /begin AXIS_DESCR COM_AXIS tam_dew _CNV_A_R_LINEAR_____12_CM 6 -48. 142.5 FORMAT "%5.1" AXIS_PTS_REF ldpm_tam_dew__fac_teg /end AXIS_DESCR
 /begin AXIS_DESCR COM_AXIS t_es_dew _CNV_A_R_LINEAR_____97_CM 8 0. 65535. FORMAT "%5.0" AXIS_PTS_REF ldpm_t_es_dew__fac_teg /end AXIS_DESCR
/end CHARACTERISTIC
/begin CHARACTERISTIC c_teg_st_on_up "Duct temperature threshold after start " VALUE 0x018ee _REC_VAL_20_u2 1507.3 _CNV_A_R_LINEAR_____262_CM -48. 1459.3 DISPLAY_IDENTIFIER C_TEG_ST_ON_UP FORMAT "%7.2" /end CHARACTERISTIC
/begin CHARACTERISTIC c_teg_st_on_down "Duct temperature threshold after start " VALUE 0x018ec _REC_VAL_20_u2 1507.3 _CNV_A_R_LINEAR_____262_CM -48. 1459.3 DISPLAY_IDENTIFIER C_TEG_ST_ON_DOWN FORMAT "%7.2" /end CHARACTERISTIC
/begin CHARACTERISTIC c_teg_egy_sp_end "Temperature threshold of energy setpoint after start" VALUE 0x018e6 _REC_VAL_20_u2 1507.3 _CNV_A_R_LINEAR_____262_CM -48. 1459.3 DISPLAY_IDENTIFIER C_TEG_EGY_SP_END FORMAT "%7.2" /end CHARACTERISTIC
/begin CHARACTERISTIC c_maf_int_teg_wall_st_up "Threshold of mass air" VALUE 0x01684 _REC_VAL_20_u2 1820.398 _CNV_A_R_LINEAR_____271_CM 0. 1820.398 DISPLAY_IDENTIFIER C_MAF_INT_TEG_WALL_ST_UP FORMAT "%7.2" /end CHARACTERISTIC
/begin MEASUREMENT teg_cor_vo_down "Valve overlap temp. correction " SWORD _CNV_A_R_LINEAR_____418_CM 1 100. -491.519999999553 491.5 DISPLAY_IDENTIFIER TEG_COR_VO_DOWN ECU_ADDRESS 0x3fd2c8 BYTE_ORDER MSB_LAST FORMAT "%7.2" /end MEASUREMENT
/begin CHARACTERISTIC c_fac_cor_eff_iga_teg_down "EFF_ IGA temperature correction depending on load engine" VALUE 0x01560 _REC_VAL_20_u2 1.99996948 _CNV_A_R_LINEAR_____21_CM 0. 1.99996948 DISPLAY_IDENTIFIER C_FAC_COR_EFF_IGA_TEG_DOWN FORMAT "%7.5" /end CHARACTERISTIC
/begin CHARACTERISTIC c_fac_ref_scc_tco_down "Reference correction TCO for SCC" VALUE 0x006d0 _REC_VAL_20_u1 1.99220002 _CNV_A_R_LINEAR_____39_CM 0. 1.99220002 DISPLAY_IDENTIFIER C_FAC_REF_SCC_TCO_DOWN FORMAT "%5.3" /end CHARACTERISTIC
/begin CHARACTERISTIC c_fac_tco_ex_teg_down_1 "TCO outlet correction post cat" VALUE 0x01586 _REC_VAL_20_u2 1.99996948 _CNV_A_R_LINEAR_____21_CM 0. 1.99996948 DISPLAY_IDENTIFIER C_FAC_TCO_EX_TEG_DOWN_1 FORMAT "%7.5" /end CHARACTERISTIC
/begin CHARACTERISTIC c_fac_tco_ex_teg_down_2 "TCO outlet correction post cat" VALUE 0x01588 _REC_VAL_20_u2 1.99996948 _CNV_A_R_LINEAR_____21_CM 0. 1.99996948 DISPLAY_IDENTIFIER C_FAC_TCO_EX_TEG_DOWN_2 FORMAT "%7.5" /end CHARACTERISTIC
/begin MEASUREMENT teg_wall_cor_tco_up "TCO temp. correction" SWORD _CNV_A_R_LINEAR_____421_CM 1 100. -202. 202. DISPLAY_IDENTIFIER TEG_WALL_COR_TCO_UP ECU_ADDRESS 0x3fd2d6 BYTE_ORDER MSB_LAST FORMAT "%6.1" /end MEASUREMENT
/begin CHARACTERISTIC ip_teg_wall_cor_eff_iga_up "Power loss influences by IGA temperature correction depending on load engine" MAP 0x0f03e _REC_MAP_20_u2_u2_u2 983.025 _CNV_A_R_LINEAR_____414_CM 0. 983.025 DISPLAY_IDENTIFIER IP_TEG_WALL_COR_EFF_IGA_UP FORMAT "%6.2"
 /begin AXIS_DESCR COM_AXIS maf_teg _CNV_A_R_LINEAR_____106_CM 8 0. 1389. FORMAT "%7.2" AXIS_PTS_REF ldpm_maf_teg__teg_stat /end AXIS_DESCR
 /begin AXIS_DESCR COM_AXIS n_teg _CNV_A_R_LINEAR_____11_CM 8 0. 8160. FORMAT "%4.0" AXIS_PTS_REF ldpm_n_teg__teg_stat /end AXIS_DESCR
/end CHARACTERISTIC
/begin CHARACTERISTIC ip_fac_cor_eff_iga_wall_up "Power loss influences by IGA temperature correction" CURVE 0x0aa96 _REC_CUR_20_u2_u2 1.99996948 _CNV_A_R_LINEAR_____21_CM 0. 1.99996948 DISPLAY_IDENTIFIER IP_FAC_COR_EFF_IGA_WALL_UP FORMAT "%7.5"
 /begin AXIS_DESCR COM_AXIS online_dummy _CNV_A_R_LINEAR_____21_CM 8 0. 1.99996948 FORMAT "%7.5" AXIS_PTS_REF ldpm_eff_iga_av_teg_cor /end AXIS_DESCR
/end CHARACTERISTIC
/begin CHARACTERISTIC c_fac_ref_tco_down "Reference correction TCO" VALUE 0x006d4 _REC_VAL_20_u1 1.99220002 _CNV_A_R_LINEAR_____39_CM 0. 1.99220002 DISPLAY_IDENTIFIER C_FAC_REF_TCO_DOWN FORMAT "%5.3" /end CHARACTERISTIC
/begin CHARACTERISTIC ip_teg_wall_cor_vo_up "Valve overlap correction depending on load engine" MAP 0x0f0be _REC_MAP_20_u2_u2_u2 983.025 _CNV_A_R_LINEAR_____417_CM -491.52 491.505 DISPLAY_IDENTIFIER IP_TEG_WALL_COR_VO_UP FORMAT "%7.2"
 /begin AXIS_DESCR COM_AXIS maf_teg _CNV_A_R_LINEAR_____106_CM 8 0. 1389. FORMAT "%7.2" AXIS_PTS_REF ldpm_maf_teg__teg_stat /end AXIS_DESCR
 /begin AXIS_DESCR COM_AXIS n_teg _CNV_A_R_LINEAR_____11_CM 8 0. 8160. FORMAT "%4.0" AXIS_PTS_REF ldpm_n_teg__teg_stat /end AXIS_DESCR
/end CHARACTERISTIC
/begin CHARACTERISTIC ip_teg_wall_cor_vs_up "Vehicle speed correction depending on load Engine" MAP 0x0f13e _REC_MAP_20_u2_u2_u2 983.025 _CNV_A_R_LINEAR_____417_CM -491.52 491.505 DISPLAY_IDENTIFIER IP_TEG_WALL_COR_VS_UP FORMAT "%7.2"
 /begin AXIS_DESCR COM_AXIS maf_teg _CNV_A_R_LINEAR_____106_CM 8 0. 1389. FORMAT "%7.2" AXIS_PTS_REF ldpm_maf_teg__vs_teg /end AXIS_DESCR
 /begin AXIS_DESCR COM_AXIS n_teg _CNV_A_R_LINEAR_____11_CM 8 0. 8160. FORMAT "%4.0" AXIS_PTS_REF ldpm_n_teg__vs_teg /end AXIS_DESCR
/end CHARACTERISTIC
/begin CHARACTERISTIC c_fac_tco_ex_teg_wall_up_2 "TCO_EX correction" VALUE 0x01594 _REC_VAL_20_u2 1.99996948 _CNV_A_R_LINEAR_____21_CM 0. 1.99996948 DISPLAY_IDENTIFIER C_FAC_TCO_EX_TEG_WALL_UP_2 FORMAT "%7.5" /end CHARACTERISTIC
/begin CHARACTERISTIC ip_fac_teg_wall_stop_up "Factor for engine off duration time" MAP 0x0b27e _REC_MAP_20_u2_u1_u2 7.99987793 _CNV_A_R_LINEAR_____345_CM 0. 7.99987793 DISPLAY_IDENTIFIER IP_FAC_TEG_WALL_STOP_UP FORMAT "%6.4"
 /begin AXIS_DESCR COM_AXIS tam_dew _CNV_A_R_LINEAR_____12_CM 6 -48. 142.5 FORMAT "%5.1" AXIS_PTS_REF ldpm_tam_dew__fac_teg /end AXIS_DESCR
 /begin AXIS_DESCR COM_AXIS t_es_dew _CNV_A_R_LINEAR_____97_CM 8 0. 65535. FORMAT "%5.0" AXIS_PTS_REF ldpm_t_es_dew__fac_teg /end AXIS_DESCR
/end CHARACTERISTIC
/begin CHARACTERISTIC c_teg_wall_egy_sp_end "Temperature threshold of energy setpoint after start" VALUE 0x018f2 _REC_VAL_20_u2 1507.3 _CNV_A_R_LINEAR_____262_CM -48. 1459.3 DISPLAY_IDENTIFIER C_TEG_WALL_EGY_SP_END FORMAT "%7.2" /end CHARACTERISTIC
/begin MEASUREMENT teg_wall_cor_vo_up "Valve overlap temp. correction" SWORD _CNV_A_R_LINEAR_____418_CM 1 100. -491.519999999553 491.5 DISPLAY_IDENTIFIER TEG_WALL_COR_VO_UP ECU_ADDRESS 0x3fd2d4 BYTE_ORDER MSB_LAST FORMAT "%7.2" /end MEASUREMENT
/begin MEASUREMENT teg_wall_cor_tco_down "TCO temp. correction" SWORD _CNV_A_R_LINEAR_____421_CM 1 100. -202. 202. DISPLAY_IDENTIFIER TEG_WALL_COR_TCO_DOWN ECU_ADDRESS 0x3fd2e2 BYTE_ORDER MSB_LAST FORMAT "%6.1" /end MEASUREMENT
/begin CHARACTERISTIC c_fac_cor_eff_iga_teg_wall_down "Power loss influences by IGA temperature correction depending on load engine" VALUE 0x01562 _REC_VAL_20_u2 1.99996948 _CNV_A_R_LINEAR_____21_CM 0. 1.99996948 DISPLAY_IDENTIFIER C_FAC_COR_EFF_IGA_TEG_WALL_DOWN FORMAT "%7.5" /end CHARACTERISTIC
/begin CHARACTERISTIC c_fac_ref_scc_tco_wall_up "Referenz TCO correction for SCC" VALUE 0x006d3 _REC_VAL_20_u1 1.99220002 _CNV_A_R_LINEAR_____39_CM 0. 1.99220002 DISPLAY_IDENTIFIER C_FAC_REF_SCC_TCO_WALL_UP FORMAT "%5.3" /end CHARACTERISTIC
/begin CHARACTERISTIC c_fac_ref_scc_tco_wall_down "Referenz TCO correction for SCC" VALUE 0x006d2 _REC_VAL_20_u1 1.99220002 _CNV_A_R_LINEAR_____39_CM 0. 1.99220002 DISPLAY_IDENTIFIER C_FAC_REF_SCC_TCO_WALL_DOWN FORMAT "%5.3" /end CHARACTERISTIC
/begin CHARACTERISTIC c_fac_ref_tco_wall_up "Referenz TCO correction" VALUE 0x006d7 _REC_VAL_20_u1 1.99220002 _CNV_A_R_LINEAR_____39_CM 0. 1.99220002 DISPLAY_IDENTIFIER C_FAC_REF_TCO_WALL_UP FORMAT "%5.3" /end CHARACTERISTIC
/begin CHARACTERISTIC c_fac_ref_tco_wall_down "Referenz TCO correction" VALUE 0x006d6 _REC_VAL_20_u1 1.99220002 _CNV_A_R_LINEAR_____39_CM 0. 1.99220002 DISPLAY_IDENTIFIER C_FAC_REF_TCO_WALL_DOWN FORMAT "%5.3" /end CHARACTERISTIC
/begin CHARACTERISTIC c_teg_wall_red "Reference temperature, by_reduced temperature" VALUE 0x018f6 _REC_VAL_20_u2 1507.3 _CNV_A_R_LINEAR_____262_CM -48. 1459.3 DISPLAY_IDENTIFIER C_TEG_WALL_RED FORMAT "%7.2" /end CHARACTERISTIC
/begin CHARACTERISTIC c_teg_wall_dew_st "Reference temperature, condensation on start" VALUE 0x018f0 _REC_VAL_20_u2 1507.3 _CNV_A_R_LINEAR_____262_CM -48. 1459.3 DISPLAY_IDENTIFIER C_TEG_WALL_DEW_ST FORMAT "%7.2" /end CHARACTERISTIC
/begin CHARACTERISTIC c_teg_wall_hys "Reference temperature, by reduced temperature" VALUE 0x018f4 _REC_VAL_20_u2 188.39 _CNV_A_R_LINEAR_____428_CM 0. 188.39 DISPLAY_IDENTIFIER C_TEG_WALL_HYS FORMAT "%6.2" /end CHARACTERISTIC
/begin CHARACTERISTIC c_teg_dif_grad_min "temperature range limit" VALUE 0x018e2 _REC_VAL_20_u2 1507.3 _CNV_A_R_LINEAR_____429_CM 0. 1507.3 DISPLAY_IDENTIFIER C_TEG_DIF_GRAD_MIN FORMAT "%7.3" /end CHARACTERISTIC
/begin CHARACTERISTIC c_teg_dif_level_min "temperature range limit" VALUE 0x018e4 _REC_VAL_20_u2 1507.3 _CNV_A_R_LINEAR_____429_CM 0. 1507.3 DISPLAY_IDENTIFIER C_TEG_DIF_LEVEL_MIN FORMAT "%7.3" /end CHARACTERISTIC
/begin CHARACTERISTIC c_fac_tco_ex_teg_wall_up_1 "TCO_EX correction" VALUE 0x01592 _REC_VAL_20_u2 1.99996948 _CNV_A_R_LINEAR_____21_CM 0. 1.99996948 DISPLAY_IDENTIFIER C_FAC_TCO_EX_TEG_WALL_UP_1 FORMAT "%7.5" /end CHARACTERISTIC
/begin CHARACTERISTIC c_fac_tco_ex_teg_wall_down_1 "TCO_EX correction" VALUE 0x0158e _REC_VAL_20_u2 1.99996948 _CNV_A_R_LINEAR_____21_CM 0. 1.99996948 DISPLAY_IDENTIFIER C_FAC_TCO_EX_TEG_WALL_DOWN_1 FORMAT "%7.5" /end CHARACTERISTIC
/begin CHARACTERISTIC c_fac_tco_ex_teg_wall_down_2 "TCO_EX correction" VALUE 0x01590 _REC_VAL_20_u2 1.99996948 _CNV_A_R_LINEAR_____21_CM 0. 1.99996948 DISPLAY_IDENTIFIER C_FAC_TCO_EX_TEG_WALL_DOWN_2 FORMAT "%7.5" /end CHARACTERISTIC
/begin MEASUREMENT temp_tco_dif "Coolant  temperature  difference" SWORD _CNV_A_R_LINEAR_____421_CM 1 100. -202. 202. DISPLAY_IDENTIFIER TEMP_TCO_DIF ECU_ADDRESS 0x3fd2ba BYTE_ORDER MSB_LAST FORMAT "%6.1" /end MEASUREMENT
/begin MEASUREMENT teg_cor_tco_up "TCO temperature  correction" SWORD _CNV_A_R_LINEAR_____421_CM 1 100. -202. 202. DISPLAY_IDENTIFIER TEG_COR_TCO_UP ECU_ADDRESS 0x3fd2b2 BYTE_ORDER MSB_LAST FORMAT "%6.1" /end MEASUREMENT
/begin MEASUREMENT teg_cor_tco_down "TCO temperature  correction" SWORD _CNV_A_R_LINEAR_____421_CM 1 100. -202. 202. DISPLAY_IDENTIFIER TEG_COR_TCO_DOWN ECU_ADDRESS 0x3fd2ca BYTE_ORDER MSB_LAST FORMAT "%6.1" /end MEASUREMENT
/begin MEASUREMENT teg_cor_vs_down "Vehicle speed correction depending on load engine" SWORD _CNV_A_R_LINEAR_____418_CM 1 100. -491.519999999553 491.5 DISPLAY_IDENTIFIER TEG_COR_VS_DOWN ECU_ADDRESS 0x3fd2ce BYTE_ORDER MSB_LAST FORMAT "%7.2" /end MEASUREMENT
/begin MEASUREMENT teg_cor_vs_up "Vehicle speed correction depending on load engine" SWORD _CNV_A_R_LINEAR_____418_CM 1 100. -491.519999999553 491.5 DISPLAY_IDENTIFIER TEG_COR_VS_UP ECU_ADDRESS 0x3fd2bc BYTE_ORDER MSB_LAST FORMAT "%7.2" /end MEASUREMENT
/begin MEASUREMENT teg_wall_cor_vs_down "Vehicle speed correction depending on load engine" SWORD _CNV_A_R_LINEAR_____418_CM 1 100. -491.519999999553 491.5 DISPLAY_IDENTIFIER TEG_WALL_COR_VS_DOWN ECU_ADDRESS 0x3fd2e6 BYTE_ORDER MSB_LAST FORMAT "%7.2" /end MEASUREMENT
/begin MEASUREMENT teg_wall_cor_vs_up "Vehicle speed correction depending on load engine" SWORD _CNV_A_R_LINEAR_____418_CM 1 100. -491.519999999553 491.5 DISPLAY_IDENTIFIER TEG_WALL_COR_VS_UP ECU_ADDRESS 0x3fd2da BYTE_ORDER MSB_LAST FORMAT "%7.2" /end MEASUREMENT
/begin CHARACTERISTIC ip_teg_stat_up_2 "Basic pre control engine temperature" MAP 0x0ef76 _REC_MAP_20_u2_u2_u2 1507.3 _CNV_A_R_LINEAR_____262_CM -48. 1459.3 DISPLAY_IDENTIFIER IP_TEG_STAT_UP_2 FORMAT "%7.2"
 /begin AXIS_DESCR COM_AXIS maf_teg _CNV_A_R_LINEAR_____106_CM 8 0. 1389. FORMAT "%7.2" AXIS_PTS_REF ldpm_maf_teg__teg_stat /end AXIS_DESCR
 /begin AXIS_DESCR COM_AXIS n_teg _CNV_A_R_LINEAR_____11_CM 8 0. 8160. FORMAT "%4.0" AXIS_PTS_REF ldpm_n_teg__teg_stat /end AXIS_DESCR
/end CHARACTERISTIC
/begin CHARACTERISTIC ip_teg_wall_stat_up_2 "Basic pre control engine temperature " MAP 0x0f33e _REC_MAP_20_u2_u2_u2 1507.3 _CNV_A_R_LINEAR_____262_CM -48. 1459.3 DISPLAY_IDENTIFIER IP_TEG_WALL_STAT_UP_2 FORMAT "%7.2"
 /begin AXIS_DESCR COM_AXIS maf_teg _CNV_A_R_LINEAR_____106_CM 8 0. 1389. FORMAT "%7.2" AXIS_PTS_REF ldpm_maf_teg__teg_stat /end AXIS_DESCR
 /begin AXIS_DESCR COM_AXIS n_teg _CNV_A_R_LINEAR_____11_CM 8 0. 8160. FORMAT "%4.0" AXIS_PTS_REF ldpm_n_teg__teg_stat /end AXIS_DESCR
/end CHARACTERISTIC
/begin CHARACTERISTIC ip_crlc_teg_dec_puc_up_2 "Map of correlation constant by fuel cut off" CURVE 0x08f00 _REC_CUR_20_u2_u2 0.99998474 _CNV_A_R_LINEAR_____37_CM 0. 0.99998474 DISPLAY_IDENTIFIER IP_CRLC_TEG_DEC_PUC_UP_2 FORMAT "%7.5"
 /begin AXIS_DESCR COM_AXIS online_dummy _CNV_A_R_LINEAR_____271_CM 8 0. 1820.398 FORMAT "%7.2" AXIS_PTS_REF ldpm_maf_int_puc__crlc_teg /end AXIS_DESCR
/end CHARACTERISTIC
/begin CHARACTERISTIC ip_crlc_teg_wall_dec_puc_up_2 "Map of correlation constant by fuel cut off" CURVE 0x09580 _REC_CUR_20_u2_u2 0.99998474 _CNV_A_R_LINEAR_____37_CM 0. 0.99998474 DISPLAY_IDENTIFIER IP_CRLC_TEG_WALL_DEC_PUC_UP_2 FORMAT "%7.5"
 /begin AXIS_DESCR COM_AXIS online_dummy _CNV_A_R_LINEAR_____271_CM 8 0. 1820.398 FORMAT "%7.2" AXIS_PTS_REF ldpm_maf_int_puc__crlc_teg /end AXIS_DESCR
/end CHARACTERISTIC
/begin CHARACTERISTIC ip_crlc_teg_inc_up_2 "Map of correlation constant by heating" MAP 0x092d0 _REC_MAP_20_u2_u2_u2 0.99998474 _CNV_A_R_LINEAR_____37_CM 0. 0.99998474 DISPLAY_IDENTIFIER IP_CRLC_TEG_INC_UP_2 FORMAT "%7.5"
 /begin AXIS_DESCR COM_AXIS online_dummy _CNV_A_R_LINEAR_____262_CM 12 -48. 1459.3 FORMAT "%7.2" AXIS_PTS_REF ldpm_teg_stat__crlc_inc /end AXIS_DESCR
 /begin AXIS_DESCR COM_AXIS n_teg _CNV_A_R_LINEAR_____11_CM 8 0. 8160. FORMAT "%4.0" AXIS_PTS_REF ldpm_n_teg__crlc_teg /end AXIS_DESCR
/end CHARACTERISTIC
/begin CHARACTERISTIC ip_crlc_teg_wall_inc_up_2 "Map of correlation constant by heating" MAP 0x09950 _REC_MAP_20_u2_u2_u2 0.99998474 _CNV_A_R_LINEAR_____37_CM 0. 0.99998474 DISPLAY_IDENTIFIER IP_CRLC_TEG_WALL_INC_UP_2 FORMAT "%7.5"
 /begin AXIS_DESCR COM_AXIS online_dummy _CNV_A_R_LINEAR_____262_CM 12 -48. 1459.3 FORMAT "%7.2" AXIS_PTS_REF ldpm_teg_wall_stat__crlc_inc /end AXIS_DESCR
 /begin AXIS_DESCR COM_AXIS n_teg _CNV_A_R_LINEAR_____11_CM 8 0. 8160. FORMAT "%4.0" AXIS_PTS_REF ldpm_n_teg__crlc_teg /end AXIS_DESCR
/end CHARACTERISTIC
/begin CHARACTERISTIC ip_crlc_teg_dec_up_2 "Map of correlation constant by cooling" MAP 0x08fd0 _REC_MAP_20_u2_u2_u2 0.99998474 _CNV_A_R_LINEAR_____37_CM 0. 0.99998474 DISPLAY_IDENTIFIER IP_CRLC_TEG_DEC_UP_2 FORMAT "%7.5"
 /begin AXIS_DESCR COM_AXIS online_dummy _CNV_A_R_LINEAR_____262_CM 12 -48. 1459.3 FORMAT "%7.2" AXIS_PTS_REF ldpm_teg_stat__crlc_dec /end AXIS_DESCR
 /begin AXIS_DESCR COM_AXIS n_teg _CNV_A_R_LINEAR_____11_CM 8 0. 8160. FORMAT "%4.0" AXIS_PTS_REF ldpm_n_teg__crlc_teg /end AXIS_DESCR
/end CHARACTERISTIC
/begin CHARACTERISTIC ip_crlc_teg_wall_dec_up_2 "Map of correlation constant by cooling" MAP 0x09650 _REC_MAP_20_u2_u2_u2 0.99998474 _CNV_A_R_LINEAR_____37_CM 0. 0.99998474 DISPLAY_IDENTIFIER IP_CRLC_TEG_WALL_DEC_UP_2 FORMAT "%7.5"
 /begin AXIS_DESCR COM_AXIS online_dummy _CNV_A_R_LINEAR_____262_CM 12 -48. 1459.3 FORMAT "%7.2" AXIS_PTS_REF ldpm_teg_wall_stat__crlc_dec /end AXIS_DESCR
 /begin AXIS_DESCR COM_AXIS n_teg _CNV_A_R_LINEAR_____11_CM 8 0. 8160. FORMAT "%4.0" AXIS_PTS_REF ldpm_n_teg__crlc_teg /end AXIS_DESCR
/end CHARACTERISTIC
/begin CHARACTERISTIC ip_teg_stat_down_2 "Basic pre control engine temperature " MAP 0x0ee76 _REC_MAP_20_u2_u2_u2 1507.3 _CNV_A_R_LINEAR_____262_CM -48. 1459.3 DISPLAY_IDENTIFIER IP_TEG_STAT_DOWN_2 FORMAT "%7.2"
 /begin AXIS_DESCR COM_AXIS maf_teg _CNV_A_R_LINEAR_____106_CM 8 0. 1389. FORMAT "%7.2" AXIS_PTS_REF ldpm_maf_teg__teg_stat /end AXIS_DESCR
 /begin AXIS_DESCR COM_AXIS n_teg _CNV_A_R_LINEAR_____11_CM 8 0. 8160. FORMAT "%4.0" AXIS_PTS_REF ldpm_n_teg__teg_stat /end AXIS_DESCR
/end CHARACTERISTIC
/begin CHARACTERISTIC ip_teg_wall_stat_down_2 "Basic pre control engine temperature " MAP 0x0f23e _REC_MAP_20_u2_u2_u2 1507.3 _CNV_A_R_LINEAR_____262_CM -48. 1459.3 DISPLAY_IDENTIFIER IP_TEG_WALL_STAT_DOWN_2 FORMAT "%7.2"
 /begin AXIS_DESCR COM_AXIS maf_teg _CNV_A_R_LINEAR_____106_CM 8 0. 1389. FORMAT "%7.2" AXIS_PTS_REF ldpm_maf_teg__teg_stat /end AXIS_DESCR
 /begin AXIS_DESCR COM_AXIS n_teg _CNV_A_R_LINEAR_____11_CM 8 0. 8160. FORMAT "%4.0" AXIS_PTS_REF ldpm_n_teg__teg_stat /end AXIS_DESCR
/end CHARACTERISTIC
/begin CHARACTERISTIC ip_crlc_teg_dec_puc_down_2 "Map of correlation constant by fuel cut off post cat." CURVE 0x08ee0 _REC_CUR_20_u2_u2 0.99998474 _CNV_A_R_LINEAR_____37_CM 0. 0.99998474 DISPLAY_IDENTIFIER IP_CRLC_TEG_DEC_PUC_DOWN_2 FORMAT "%7.5"
 /begin AXIS_DESCR COM_AXIS online_dummy _CNV_A_R_LINEAR_____271_CM 8 0. 1820.398 FORMAT "%7.2" AXIS_PTS_REF ldpm_maf_int_puc__crlc_teg /end AXIS_DESCR
/end CHARACTERISTIC
/begin CHARACTERISTIC ip_crlc_teg_wall_dec_puc_down_2 "Map of correlation constant by fuel cut off post cat." CURVE 0x09560 _REC_CUR_20_u2_u2 0.99998474 _CNV_A_R_LINEAR_____37_CM 0. 0.99998474 DISPLAY_IDENTIFIER IP_CRLC_TEG_WALL_DEC_PUC_DOWN_2 FORMAT "%7.5"
 /begin AXIS_DESCR COM_AXIS online_dummy _CNV_A_R_LINEAR_____271_CM 8 0. 1820.398 FORMAT "%7.2" AXIS_PTS_REF ldpm_maf_int_puc__crlc_teg /end AXIS_DESCR
/end CHARACTERISTIC
/begin CHARACTERISTIC ip_crlc_teg_dec_down_2 "Map of correlation constant by cooling post cat." MAP 0x08e10 _REC_MAP_20_u2_u2_u2 0.99998474 _CNV_A_R_LINEAR_____37_CM 0. 0.99998474 DISPLAY_IDENTIFIER IP_CRLC_TEG_DEC_DOWN_2 FORMAT "%7.5"
 /begin AXIS_DESCR COM_AXIS online_dummy _CNV_A_R_LINEAR_____262_CM 12 -48. 1459.3 FORMAT "%7.2" AXIS_PTS_REF ldpm_teg_stat__crlc_dec /end AXIS_DESCR
 /begin AXIS_DESCR COM_AXIS n_teg _CNV_A_R_LINEAR_____11_CM 8 0. 8160. FORMAT "%4.0" AXIS_PTS_REF ldpm_n_teg__crlc_teg /end AXIS_DESCR
/end CHARACTERISTIC
/begin CHARACTERISTIC ip_crlc_teg_wall_dec_down_2 "Map of correlation constant by cooling post cat." MAP 0x09490 _REC_MAP_20_u2_u2_u2 0.99998474 _CNV_A_R_LINEAR_____37_CM 0. 0.99998474 DISPLAY_IDENTIFIER IP_CRLC_TEG_WALL_DEC_DOWN_2 FORMAT "%7.5"
 /begin AXIS_DESCR COM_AXIS online_dummy _CNV_A_R_LINEAR_____262_CM 12 -48. 1459.3 FORMAT "%7.2" AXIS_PTS_REF ldpm_teg_wall_stat__crlc_dec /end AXIS_DESCR
 /begin AXIS_DESCR COM_AXIS n_teg _CNV_A_R_LINEAR_____11_CM 8 0. 8160. FORMAT "%4.0" AXIS_PTS_REF ldpm_n_teg__crlc_teg /end AXIS_DESCR
/end CHARACTERISTIC
/begin CHARACTERISTIC ip_crlc_teg_inc_down_2 "Map of correlation constant by heating post cat." MAP 0x09150 _REC_MAP_20_u2_u2_u2 0.99998474 _CNV_A_R_LINEAR_____37_CM 0. 0.99998474 DISPLAY_IDENTIFIER IP_CRLC_TEG_INC_DOWN_2 FORMAT "%7.5"
 /begin AXIS_DESCR COM_AXIS online_dummy _CNV_A_R_LINEAR_____262_CM 12 -48. 1459.3 FORMAT "%7.2" AXIS_PTS_REF ldpm_teg_stat__crlc_inc /end AXIS_DESCR
 /begin AXIS_DESCR COM_AXIS n_teg _CNV_A_R_LINEAR_____11_CM 8 0. 8160. FORMAT "%4.0" AXIS_PTS_REF ldpm_n_teg__crlc_teg /end AXIS_DESCR
/end CHARACTERISTIC
/begin CHARACTERISTIC ip_crlc_teg_wall_inc_down_2 "Map of correlation constant by heating post cat." MAP 0x097d0 _REC_MAP_20_u2_u2_u2 0.99998474 _CNV_A_R_LINEAR_____37_CM 0. 0.99998474 DISPLAY_IDENTIFIER IP_CRLC_TEG_WALL_INC_DOWN_2 FORMAT "%7.5"
 /begin AXIS_DESCR COM_AXIS online_dummy _CNV_A_R_LINEAR_____262_CM 12 -48. 1459.3 FORMAT "%7.2" AXIS_PTS_REF ldpm_teg_wall_stat__crlc_inc /end AXIS_DESCR
 /begin AXIS_DESCR COM_AXIS n_teg _CNV_A_R_LINEAR_____11_CM 8 0. 8160. FORMAT "%4.0" AXIS_PTS_REF ldpm_n_teg__crlc_teg /end AXIS_DESCR
/end CHARACTERISTIC
/begin CHARACTERISTIC ip_fac_teg_stop_up "Factor for engine off duration time" MAP 0x0b13e _REC_MAP_20_u2_u1_u2 7.99987793 _CNV_A_R_LINEAR_____345_CM 0. 7.99987793 DISPLAY_IDENTIFIER IP_FAC_TEG_STOP_UP FORMAT "%6.4"
 /begin AXIS_DESCR COM_AXIS tam_dew _CNV_A_R_LINEAR_____12_CM 6 -48. 142.5 FORMAT "%5.1" AXIS_PTS_REF ldpm_tam_dew__fac_teg /end AXIS_DESCR
 /begin AXIS_DESCR COM_AXIS t_es_dew _CNV_A_R_LINEAR_____97_CM 8 0. 65535. FORMAT "%5.0" AXIS_PTS_REF ldpm_t_es_dew__fac_teg /end AXIS_DESCR
/end CHARACTERISTIC
/begin CHARACTERISTIC ip_fac_teg_wall_stop_down "Factor for engine off duration time" MAP 0x0b21e _REC_MAP_20_u2_u1_u2 7.99987793 _CNV_A_R_LINEAR_____345_CM 0. 7.99987793 DISPLAY_IDENTIFIER IP_FAC_TEG_WALL_STOP_DOWN FORMAT "%6.4"
 /begin AXIS_DESCR COM_AXIS tam_dew _CNV_A_R_LINEAR_____12_CM 6 -48. 142.5 FORMAT "%5.1" AXIS_PTS_REF ldpm_tam_dew__fac_teg /end AXIS_DESCR
 /begin AXIS_DESCR COM_AXIS t_es_dew _CNV_A_R_LINEAR_____97_CM 8 0. 65535. FORMAT "%5.0" AXIS_PTS_REF ldpm_t_es_dew__fac_teg /end AXIS_DESCR
/end CHARACTERISTIC
/begin AXIS_PTS ldpm_teg_stat_eng_pre "" 0x11bb4 online_dummy _REC_AXS_20_u2 1507.3 _CNV_A_R_LINEAR_____262_CM 6 -48. 1459.3 DISPLAY_IDENTIFIER LDPM_TEG_STAT_ENG_PRE FORMAT "%7.2" /end AXIS_PTS
/begin AXIS_PTS ldpm_egr_ratio__teg "" 0x11636 egr_ratio _REC_AXS_20_u2 99.99847412 _CNV_A_R_LINEAR_____9_CM 6 0. 99.99847412 DISPLAY_IDENTIFIER LDPM_EGR_RATIO__TEG /end AXIS_PTS
/begin AXIS_PTS ldpm_temp_toil_dif__fac_temp "" 0x11c5a temp_toil_dif _REC_AXS_20_u2 404. _CNV_A_R_LINEAR_____422_CM 6 -202. 202. DISPLAY_IDENTIFIER LDPM_TEMP_TOIL_DIF__FAC_TEMP FORMAT "%6.1" /end AXIS_PTS
/begin AXIS_PTS ldpm_lamb_sp_teg__fac_cor "" 0x11680 teg_1.appl_inc_struct.lamb_sp_teg _REC_AXS_20_u2 31.99902344 _CNV_A_R_LINEAR_____164_CM 16 0. 31.99902344 DISPLAY_IDENTIFIER LDPM_LAMB_SP_TEG__FAC_COR FORMAT "%7.4" /end AXIS_PTS
/begin AXIS_PTS ldpm_nr_cyl_scc_teg__fac_scc "" 0x0815c teg_1.appl_inc_struct.nr_cyl_scc_teg _REC_AXS_20_u1 13. _CNV_A_R_LINEAR_____388_CM 14 0. 13. DISPLAY_IDENTIFIER LDPM_NR_CYL_SCC_TEG__FAC_SCC FORMAT "%4.1" /end AXIS_PTS
/begin AXIS_PTS ldpm_ecfpwm_ecf__fac_cor "" 0x012dd ecfpwm_ecf _REC_AXS_20_u1 99.609375 _CNV_A_R_LINEAR_____10_CM 6 0. 99.609375 DISPLAY_IDENTIFIER LDPM_ECFPWM_ECF__FAC_COR FORMAT "%4.1" /end AXIS_PTS
/begin AXIS_PTS ldpm_tam_dew__fac_teg "" 0x013a8 tam_dew _REC_AXS_20_u1 190.5 _CNV_A_R_LINEAR_____12_CM 6 -48. 142.5 DISPLAY_IDENTIFIER LDPM_TAM_DEW__FAC_TEG FORMAT "%5.1" /end AXIS_PTS
/begin AXIS_PTS ldpm_t_es_dew__fac_teg "" 0x11b24 t_es_dew _REC_AXS_20_u2 65535. _CNV_A_R_LINEAR_____97_CM 8 0. 65535. DISPLAY_IDENTIFIER LDPM_T_ES_DEW__FAC_TEG FORMAT "%5.0" /end AXIS_PTS
/begin AXIS_PTS ldpm_temp_toil_dif__crlc_teg "" 0x11c48 temp_toil_dif _REC_AXS_20_u2 404. _CNV_A_R_LINEAR_____422_CM 8 -202. 202. DISPLAY_IDENTIFIER LDPM_TEMP_TOIL_DIF__CRLC_TEG FORMAT "%6.1" /end AXIS_PTS
/begin AXIS_PTS ldpm_temp_tco_dif__crlc_teg "" 0x11c36 temp_tco_dif _REC_AXS_20_u2 404. _CNV_A_R_LINEAR_____423_CM 8 -202. 202. DISPLAY_IDENTIFIER LDPM_TEMP_TCO_DIF__CRLC_TEG FORMAT "%6.1" /end AXIS_PTS
/begin AXIS_PTS ldpm_maf_int_puc__crlc_teg "" 0x11774 online_dummy _REC_AXS_20_u2 1820.398 _CNV_A_R_LINEAR_____271_CM 8 0. 1820.398 DISPLAY_IDENTIFIER LDPM_MAF_INT_PUC__CRLC_TEG FORMAT "%7.2" /end AXIS_PTS
/begin AXIS_PTS ldpm_n_teg__vs_teg "" 0x11a40 n_teg _REC_AXS_20_u2 8160. _CNV_A_R_LINEAR_____11_CM 8 0. 8160. DISPLAY_IDENTIFIER LDPM_N_TEG__VS_TEG FORMAT "%4.0" /end AXIS_PTS
/begin AXIS_PTS ldpm_tco_st__dew "" 0x08253 tco_st _REC_AXS_20_u1 190.5 _CNV_A_R_LINEAR_____12_CM 8 -48. 142.5 DISPLAY_IDENTIFIER LDPM_TCO_ST__DEW FORMAT "%5.1" /end AXIS_PTS
/begin AXIS_PTS ldpm_teg_wall_cat_up_mdl_1 "" 0x11bd4 online_dummy _REC_AXS_20_u2 1507.3 _CNV_A_R_LINEAR_____262_CM 8 -48. 1459.3 DISPLAY_IDENTIFIER LDPM_TEG_WALL_CAT_UP_MDL_1 FORMAT "%7.2" /end AXIS_PTS
/begin AXIS_PTS ldpm_teg_wall_cat_down_mdl_1 "" 0x11bc2 online_dummy _REC_AXS_20_u2 1507.3 _CNV_A_R_LINEAR_____262_CM 8 -48. 1459.3 DISPLAY_IDENTIFIER LDPM_TEG_WALL_CAT_DOWN_MDL_1 FORMAT "%7.2" /end AXIS_PTS
/begin AXIS_PTS ldp_vs__fac_vs_teg "" 0x01286 vs _REC_AXS_20_u1 255. _CNV_A_R_LINEAR_____23_CM 6 0. 255. DISPLAY_IDENTIFIER LDP_VS__FAC_VS_TEG FORMAT "%3.0" /end AXIS_PTS
/begin AXIS_PTS ldp_pow_dif_max__add_teg_iga "" 0x11072 pow_dif_max _REC_AXS_20_u2 434.0555000000001 _CNV_A_R_LINEAR_____425_CM 6 0. 434.0555 DISPLAY_IDENTIFIER LDP_POW_DIF_MAX__ADD_TEG_IGA FORMAT "%7.3" /end AXIS_PTS
/begin AXIS_PTS ldpm_vo_dif_teg__teg_stat "" 0x11cc6 vo_dif_teg _REC_AXS_20_u2 191.25 _CNV_A_R_LINEAR_____426_CM 6 -95.625 95.625 DISPLAY_IDENTIFIER LDPM_VO_DIF_TEG__TEG_STAT FORMAT "%5.1" /end AXIS_PTS
/begin AXIS_PTS ldpm_eff_iga_av_teg_cor "" 0x1161a online_dummy _REC_AXS_20_u2 1.99996948 _CNV_A_R_LINEAR_____21_CM 8 0. 1.99996948 DISPLAY_IDENTIFIER LDPM_EFF_IGA_AV_TEG_COR FORMAT "%7.5" /end AXIS_PTS
/begin AXIS_PTS ldpm_teg_stat__crlc_dec "" 0x11b80 online_dummy _REC_AXS_20_u2 1507.3 _CNV_A_R_LINEAR_____262_CM 12 -48. 1459.3 DISPLAY_IDENTIFIER LDPM_TEG_STAT__CRLC_DEC FORMAT "%7.2" /end AXIS_PTS
/begin AXIS_PTS ldpm_teg_wall_stat__crlc_dec "" 0x11be6 online_dummy _REC_AXS_20_u2 1507.3 _CNV_A_R_LINEAR_____262_CM 12 -48. 1459.3 DISPLAY_IDENTIFIER LDPM_TEG_WALL_STAT__CRLC_DEC FORMAT "%7.2" /end AXIS_PTS
/begin AXIS_PTS ldpm_teg_stat__crlc_inc "" 0x11b9a online_dummy _REC_AXS_20_u2 1507.3 _CNV_A_R_LINEAR_____262_CM 12 -48. 1459.3 DISPLAY_IDENTIFIER LDPM_TEG_STAT__CRLC_INC FORMAT "%7.2" /end AXIS_PTS
/begin AXIS_PTS ldpm_teg_wall_stat__crlc_inc "" 0x11c00 online_dummy _REC_AXS_20_u2 1507.3 _CNV_A_R_LINEAR_____262_CM 12 -48. 1459.3 DISPLAY_IDENTIFIER LDPM_TEG_WALL_STAT__CRLC_INC FORMAT "%7.2" /end AXIS_PTS
/begin CHARACTERISTIC ip_fac_temp_toil_dif_up "Reference Oil temperature correction" CURVE 0x0b2ea _REC_CUR_20_u2_u2 1.99996948 _CNV_A_R_LINEAR_____21_CM 0. 1.99996948 DISPLAY_IDENTIFIER IP_FAC_TEMP_TOIL_DIF_UP FORMAT "%7.5"
 /begin AXIS_DESCR COM_AXIS temp_toil_dif _CNV_A_R_LINEAR_____422_CM 6 -202. 202. FORMAT "%6.1" AXIS_PTS_REF ldpm_temp_toil_dif__fac_temp /end AXIS_DESCR
/end CHARACTERISTIC
/begin AXIS_PTS ldpm_maf_teg__vs_teg "" 0x11800 maf_teg _REC_AXS_20_u2 1389. _CNV_A_R_LINEAR_____106_CM 8 0. 1389. DISPLAY_IDENTIFIER LDPM_MAF_TEG__VS_TEG FORMAT "%7.2" /end AXIS_PTS
/begin CHARACTERISTIC ip_teg_cor_vs_up "Vehicle speed correction depending on load Engine" MAP 0x0ed66 _REC_MAP_20_u2_u2_u2 983.025 _CNV_A_R_LINEAR_____417_CM -491.52 491.505 DISPLAY_IDENTIFIER IP_TEG_COR_VS_UP FORMAT "%7.2"
 /begin AXIS_DESCR COM_AXIS maf_teg _CNV_A_R_LINEAR_____106_CM 8 0. 1389. FORMAT "%7.2" AXIS_PTS_REF ldpm_maf_teg__vs_teg /end AXIS_DESCR
 /begin AXIS_DESCR COM_AXIS n_teg _CNV_A_R_LINEAR_____11_CM 8 0. 8160. FORMAT "%4.0" AXIS_PTS_REF ldpm_n_teg__vs_teg /end AXIS_DESCR
/end CHARACTERISTIC
/begin AXIS_PTS ldpm_vs__fac_cor_vs_teg_ecf "" 0x0142a vs _REC_AXS_20_u1 255. _CNV_A_R_LINEAR_____23_CM 6 0. 255. DISPLAY_IDENTIFIER LDPM_VS__FAC_COR_VS_TEG_ECF FORMAT "%3.0" /end AXIS_PTS
/begin CHARACTERISTIC ip_vs_ecf_teg_up_2 "Electric cooling fan correction" CURVE 0x00ec2 _REC_CUR_20_u1_u1 255. _CNV_A_R_LINEAR_____23_CM 0. 255. DISPLAY_IDENTIFIER IP_VS_ECF_TEG_UP_2 FORMAT "%3.0"
 /begin AXIS_DESCR COM_AXIS ecfpwm_ecf _CNV_A_R_LINEAR_____10_CM 6 0. 99.609375 FORMAT "%4.1" AXIS_PTS_REF ldpm_ecfpwm_ecf__fac_cor /end AXIS_DESCR
/end CHARACTERISTIC
/begin CHARACTERISTIC ip_fac_tco_ex_vs "VS influence of TCO_EX temperature" CURVE 0x0b052 _REC_CUR_20_u2_u1 7.99987793 _CNV_A_R_LINEAR_____430_CM -4. 3.99987793 DISPLAY_IDENTIFIER IP_FAC_TCO_EX_VS FORMAT "%6.4"
 /begin AXIS_DESCR COM_AXIS teg_1.gas_up_struct.vs_cor_teg_up _CNV_A_R_LINEAR_____23_CM 6 0. 255. FORMAT "%3.0" AXIS_PTS_REF ldp_vs_cor_teg_up_1__fac_cor /end AXIS_DESCR
/end CHARACTERISTIC
/begin MEASUREMENT fac_cor_toil_dif_teg_up "TOIL difference correction" UWORD _CNV_A_R_LINEAR_____21_CM 1 100. 0. 1.99996948 DISPLAY_IDENTIFIER FAC_COR_TOIL_DIF_TEG_UP ECU_ADDRESS 0x3fd2b6 BYTE_ORDER MSB_LAST FORMAT "%7.5" /end MEASUREMENT
/begin MEASUREMENT fac_cor_toil_dif_teg_down "Lambda setpoint correction" UWORD _CNV_A_R_LINEAR_____21_CM 1 100. 0. 1.99996948 DISPLAY_IDENTIFIER FAC_COR_TOIL_DIF_TEG_DOWN ECU_ADDRESS 0x3fd2cc BYTE_ORDER MSB_LAST FORMAT "%7.5" /end MEASUREMENT
/begin AXIS_PTS ldpm_vs_cor_teg__fac_cor "" 0x01431 online_dummy _REC_AXS_20_u1 255. _CNV_A_R_LINEAR_____23_CM 6 0. 255. DISPLAY_IDENTIFIER LDPM_VS_COR_TEG__FAC_COR FORMAT "%3.0" /end AXIS_PTS
/begin CHARACTERISTIC ip_fac_cor_tco_ex_vs_up "VS correction of TCO_EX venicle influence" CURVE 0x0ab0a _REC_CUR_20_u2_u1 0.9998700000000002 _CNV_A_R_LINEAR_____431_CM 0. 0.99987 DISPLAY_IDENTIFIER IP_FAC_COR_TCO_EX_VS_UP FORMAT "%8.6"
 /begin AXIS_DESCR COM_AXIS online_dummy _CNV_A_R_LINEAR_____23_CM 6 0. 255. FORMAT "%3.0" AXIS_PTS_REF ldpm_vs_cor_teg__fac_cor /end AXIS_DESCR
/end CHARACTERISTIC
/begin CHARACTERISTIC ip_fac_cor_tco_ex_vs_down "VS correction TCO_EX down" CURVE 0x0aafe _REC_CUR_20_u2_u1 0.9998700000000002 _CNV_A_R_LINEAR_____431_CM 0. 0.99987 DISPLAY_IDENTIFIER IP_FAC_COR_TCO_EX_VS_DOWN FORMAT "%8.6"
 /begin AXIS_DESCR COM_AXIS online_dummy _CNV_A_R_LINEAR_____23_CM 6 0. 255. FORMAT "%3.0" AXIS_PTS_REF ldpm_vs_cor_teg__fac_cor /end AXIS_DESCR
/end CHARACTERISTIC
/begin CHARACTERISTIC ip_vs_ecf_teg_up_1 "Electric cooling fan correction" CURVE 0x00ebc _REC_CUR_20_u1_u1 255. _CNV_A_R_LINEAR_____23_CM 0. 255. DISPLAY_IDENTIFIER IP_VS_ECF_TEG_UP_1 FORMAT "%3.0"
 /begin AXIS_DESCR COM_AXIS ecfpwm_ecf _CNV_A_R_LINEAR_____10_CM 6 0. 99.609375 FORMAT "%4.1" AXIS_PTS_REF ldpm_ecfpwm_ecf__fac_cor /end AXIS_DESCR
/end CHARACTERISTIC
/begin CHARACTERISTIC ip_vs_ecf_teg_down_2 "VS correction TCO_EX down" CURVE 0x00eb6 _REC_CUR_20_u1_u1 255. _CNV_A_R_LINEAR_____23_CM 0. 255. DISPLAY_IDENTIFIER IP_VS_ECF_TEG_DOWN_2 FORMAT "%3.0"
 /begin AXIS_DESCR COM_AXIS ecfpwm_ecf _CNV_A_R_LINEAR_____10_CM 6 0. 99.609375 FORMAT "%4.1" AXIS_PTS_REF ldpm_ecfpwm_ecf__fac_cor /end AXIS_DESCR
/end CHARACTERISTIC
/begin CHARACTERISTIC ip_fac_temp_toil_dif_wall_up "Reference Oil temperature correction" CURVE 0x0b302 _REC_CUR_20_u2_u2 1.99996948 _CNV_A_R_LINEAR_____21_CM 0. 1.99996948 DISPLAY_IDENTIFIER IP_FAC_TEMP_TOIL_DIF_WALL_UP FORMAT "%7.5"
 /begin AXIS_DESCR COM_AXIS temp_toil_dif _CNV_A_R_LINEAR_____422_CM 6 -202. 202. FORMAT "%6.1" AXIS_PTS_REF ldpm_temp_toil_dif__fac_temp /end AXIS_DESCR
/end CHARACTERISTIC
/begin CHARACTERISTIC ip_fac_cor_ecf_vs_teg "Vehicle speed correction" CURVE 0x0aa6e _REC_CUR_20_u2_u1 4. _CNV_A_R_LINEAR_____264_CM -2. 2. DISPLAY_IDENTIFIER IP_FAC_COR_ECF_VS_TEG FORMAT "%8.5"
 /begin AXIS_DESCR COM_AXIS vs _CNV_A_R_LINEAR_____23_CM 6 0. 255. FORMAT "%3.0" AXIS_PTS_REF ldpm_vs__fac_cor_vs_teg_ecf /end AXIS_DESCR
/end CHARACTERISTIC
/begin CHARACTERISTIC ip_fac_cor_ecf_vs_teg_wall "Vehicle speed correction" CURVE 0x0aa7a _REC_CUR_20_u2_u1 4. _CNV_A_R_LINEAR_____264_CM -2. 2. DISPLAY_IDENTIFIER IP_FAC_COR_ECF_VS_TEG_WALL FORMAT "%8.5"
 /begin AXIS_DESCR COM_AXIS vs _CNV_A_R_LINEAR_____23_CM 6 0. 255. FORMAT "%3.0" AXIS_PTS_REF ldpm_vs__fac_cor_vs_teg_ecf /end AXIS_DESCR
/end CHARACTERISTIC
/begin CHARACTERISTIC ip_vs_ecf_teg_down_1 "VS correction TCO_EX down" CURVE 0x00eb0 _REC_CUR_20_u1_u1 255. _CNV_A_R_LINEAR_____23_CM 0. 255. DISPLAY_IDENTIFIER IP_VS_ECF_TEG_DOWN_1 FORMAT "%3.0"
 /begin AXIS_DESCR COM_AXIS ecfpwm_ecf _CNV_A_R_LINEAR_____10_CM 6 0. 99.609375 FORMAT "%4.1" AXIS_PTS_REF ldpm_ecfpwm_ecf__fac_cor /end AXIS_DESCR
/end CHARACTERISTIC
/begin CHARACTERISTIC ip_vs_ecf_teg_wall_up_2 "VS correction TCO_EX down" CURVE 0x00eda _REC_CUR_20_u1_u1 255. _CNV_A_R_LINEAR_____23_CM 0. 255. DISPLAY_IDENTIFIER IP_VS_ECF_TEG_WALL_UP_2 FORMAT "%3.0"
 /begin AXIS_DESCR COM_AXIS ecfpwm_ecf _CNV_A_R_LINEAR_____10_CM 6 0. 99.609375 FORMAT "%4.1" AXIS_PTS_REF ldpm_ecfpwm_ecf__fac_cor /end AXIS_DESCR
/end CHARACTERISTIC
/begin MEASUREMENT fac_cor_toil_dif_teg_wall_up "TOIL difference correction" UWORD _CNV_A_R_LINEAR_____21_CM 1 100. 0. 1.99996948 DISPLAY_IDENTIFIER FAC_COR_TOIL_DIF_TEG_WALL_UP ECU_ADDRESS 0x3fd2d8 BYTE_ORDER MSB_LAST FORMAT "%7.5" /end MEASUREMENT
/begin MEASUREMENT fac_cor_toil_dif_teg_wall_down "TOIL difference correction" UWORD _CNV_A_R_LINEAR_____21_CM 1 100. 0. 1.99996948 DISPLAY_IDENTIFIER FAC_COR_TOIL_DIF_TEG_WALL_DOWN ECU_ADDRESS 0x3fd2e4 BYTE_ORDER MSB_LAST FORMAT "%7.5" /end MEASUREMENT
/begin CHARACTERISTIC ip_fac_temp_toil_dif_down "Reference Oil temperature correction" CURVE 0x0b2de _REC_CUR_20_u2_u2 1.99996948 _CNV_A_R_LINEAR_____21_CM 0. 1.99996948 DISPLAY_IDENTIFIER IP_FAC_TEMP_TOIL_DIF_DOWN FORMAT "%7.5"
 /begin AXIS_DESCR COM_AXIS temp_toil_dif _CNV_A_R_LINEAR_____422_CM 6 -202. 202. FORMAT "%6.1" AXIS_PTS_REF ldpm_temp_toil_dif__fac_temp /end AXIS_DESCR
/end CHARACTERISTIC
/begin CHARACTERISTIC ip_fac_temp_toil_dif_wall_down "Reference Oil temperature correction" CURVE 0x0b2f6 _REC_CUR_20_u2_u2 1.99996948 _CNV_A_R_LINEAR_____21_CM 0. 1.99996948 DISPLAY_IDENTIFIER IP_FAC_TEMP_TOIL_DIF_WALL_DOWN FORMAT "%7.5"
 /begin AXIS_DESCR COM_AXIS temp_toil_dif _CNV_A_R_LINEAR_____422_CM 6 -202. 202. FORMAT "%6.1" AXIS_PTS_REF ldpm_temp_toil_dif__fac_temp /end AXIS_DESCR
/end CHARACTERISTIC
/begin CHARACTERISTIC ip_vs_ecf_teg_wall_up_1 "VS correction TCO_EX down" CURVE 0x00ed4 _REC_CUR_20_u1_u1 255. _CNV_A_R_LINEAR_____23_CM 0. 255. DISPLAY_IDENTIFIER IP_VS_ECF_TEG_WALL_UP_1 FORMAT "%3.0"
 /begin AXIS_DESCR COM_AXIS ecfpwm_ecf _CNV_A_R_LINEAR_____10_CM 6 0. 99.609375 FORMAT "%4.1" AXIS_PTS_REF ldpm_ecfpwm_ecf__fac_cor /end AXIS_DESCR
/end CHARACTERISTIC
/begin CHARACTERISTIC ip_vs_ecf_teg_wall_down_1 "VS correction TCO_EX down" CURVE 0x00ec8 _REC_CUR_20_u1_u1 255. _CNV_A_R_LINEAR_____23_CM 0. 255. DISPLAY_IDENTIFIER IP_VS_ECF_TEG_WALL_DOWN_1 FORMAT "%3.0"
 /begin AXIS_DESCR COM_AXIS ecfpwm_ecf _CNV_A_R_LINEAR_____10_CM 6 0. 99.609375 FORMAT "%4.1" AXIS_PTS_REF ldpm_ecfpwm_ecf__fac_cor /end AXIS_DESCR
/end CHARACTERISTIC
/begin CHARACTERISTIC ip_vs_ecf_teg_wall_down_2 "VS correction TCO_EX down" CURVE 0x00ece _REC_CUR_20_u1_u1 255. _CNV_A_R_LINEAR_____23_CM 0. 255. DISPLAY_IDENTIFIER IP_VS_ECF_TEG_WALL_DOWN_2 FORMAT "%3.0"
 /begin AXIS_DESCR COM_AXIS ecfpwm_ecf _CNV_A_R_LINEAR_____10_CM 6 0. 99.609375 FORMAT "%4.1" AXIS_PTS_REF ldpm_ecfpwm_ecf__fac_cor /end AXIS_DESCR
/end CHARACTERISTIC
/begin CHARACTERISTIC c_crlc_dif_teg_level "Correlation constant max. difference one step of Level calculation" VALUE 0x014cc _REC_VAL_20_u2 0.99998474 _CNV_A_R_LINEAR_____37_CM 0. 0.99998474 DISPLAY_IDENTIFIER C_CRLC_DIF_TEG_LEVEL FORMAT "%7.5" /end CHARACTERISTIC
/begin CHARACTERISTIC c_crlc_dif_teg_grad "Correlation constant max. difference one step of grad calculation" VALUE 0x014ca _REC_VAL_20_u2 0.99998474 _CNV_A_R_LINEAR_____37_CM 0. 0.99998474 DISPLAY_IDENTIFIER C_CRLC_DIF_TEG_GRAD FORMAT "%7.5" /end CHARACTERISTIC
/begin CHARACTERISTIC ip_fac_cor_vs_teg_up_1 "Vehicle speed correction" CURVE 0x0ab76 _REC_CUR_20_u2_u1 4. _CNV_A_R_LINEAR_____264_CM -2. 2. DISPLAY_IDENTIFIER IP_FAC_COR_VS_TEG_UP_1 FORMAT "%8.5"
 /begin AXIS_DESCR COM_AXIS online_dummy _CNV_A_R_LINEAR_____23_CM 6 0. 255. FORMAT "%3.0" AXIS_PTS_REF ldpm_vs_cor_teg__fac_cor /end AXIS_DESCR
/end CHARACTERISTIC
/begin CHARACTERISTIC ip_fac_cor_vs_teg_up_2 "Vehicle speed correction" CURVE 0x0ab82 _REC_CUR_20_u2_u1 4. _CNV_A_R_LINEAR_____264_CM -2. 2. DISPLAY_IDENTIFIER IP_FAC_COR_VS_TEG_UP_2 FORMAT "%8.5"
 /begin AXIS_DESCR COM_AXIS online_dummy _CNV_A_R_LINEAR_____23_CM 6 0. 255. FORMAT "%3.0" AXIS_PTS_REF ldpm_vs_cor_teg__fac_cor /end AXIS_DESCR
/end CHARACTERISTIC
/begin CHARACTERISTIC ip_fac_cor_vs_teg_down_1 "VS correction TCO_EX down" CURVE 0x0ab5e _REC_CUR_20_u2_u1 4. _CNV_A_R_LINEAR_____264_CM -2. 2. DISPLAY_IDENTIFIER IP_FAC_COR_VS_TEG_DOWN_1 FORMAT "%8.5"
 /begin AXIS_DESCR COM_AXIS online_dummy _CNV_A_R_LINEAR_____23_CM 6 0. 255. FORMAT "%3.0" AXIS_PTS_REF ldpm_vs_cor_teg__fac_cor /end AXIS_DESCR
/end CHARACTERISTIC
/begin CHARACTERISTIC ip_fac_cor_vs_teg_down_2 "VS correction TCO_EX down" CURVE 0x0ab6a _REC_CUR_20_u2_u1 4. _CNV_A_R_LINEAR_____264_CM -2. 2. DISPLAY_IDENTIFIER IP_FAC_COR_VS_TEG_DOWN_2 FORMAT "%8.5"
 /begin AXIS_DESCR COM_AXIS online_dummy _CNV_A_R_LINEAR_____23_CM 6 0. 255. FORMAT "%3.0" AXIS_PTS_REF ldpm_vs_cor_teg__fac_cor /end AXIS_DESCR
/end CHARACTERISTIC
/begin CHARACTERISTIC ip_fac_cor_vs_teg_wall_up_1 "VS correction TCO_EX down" CURVE 0x0aba6 _REC_CUR_20_u2_u1 4. _CNV_A_R_LINEAR_____264_CM -2. 2. DISPLAY_IDENTIFIER IP_FAC_COR_VS_TEG_WALL_UP_1 FORMAT "%8.5"
 /begin AXIS_DESCR COM_AXIS online_dummy _CNV_A_R_LINEAR_____23_CM 6 0. 255. FORMAT "%3.0" AXIS_PTS_REF ldpm_vs_cor_teg__fac_cor /end AXIS_DESCR
/end CHARACTERISTIC
/begin CHARACTERISTIC ip_fac_cor_vs_teg_wall_up_2 "VS correction TCO_EX down" CURVE 0x0abb2 _REC_CUR_20_u2_u1 4. _CNV_A_R_LINEAR_____264_CM -2. 2. DISPLAY_IDENTIFIER IP_FAC_COR_VS_TEG_WALL_UP_2 FORMAT "%8.5"
 /begin AXIS_DESCR COM_AXIS online_dummy _CNV_A_R_LINEAR_____23_CM 6 0. 255. FORMAT "%3.0" AXIS_PTS_REF ldpm_vs_cor_teg__fac_cor /end AXIS_DESCR
/end CHARACTERISTIC
/begin CHARACTERISTIC ip_fac_cor_vs_teg_wall_down_1 "VS correction TCO_EX down" CURVE 0x0ab8e _REC_CUR_20_u2_u1 4. _CNV_A_R_LINEAR_____264_CM -2. 2. DISPLAY_IDENTIFIER IP_FAC_COR_VS_TEG_WALL_DOWN_1 FORMAT "%8.5"
 /begin AXIS_DESCR COM_AXIS online_dummy _CNV_A_R_LINEAR_____23_CM 6 0. 255. FORMAT "%3.0" AXIS_PTS_REF ldpm_vs_cor_teg__fac_cor /end AXIS_DESCR
/end CHARACTERISTIC
/begin CHARACTERISTIC ip_fac_cor_vs_teg_wall_down_2 "VS correction TCO_EX down" CURVE 0x0ab9a _REC_CUR_20_u2_u1 4. _CNV_A_R_LINEAR_____264_CM -2. 2. DISPLAY_IDENTIFIER IP_FAC_COR_VS_TEG_WALL_DOWN_2 FORMAT "%8.5"
 /begin AXIS_DESCR COM_AXIS online_dummy _CNV_A_R_LINEAR_____23_CM 6 0. 255. FORMAT "%3.0" AXIS_PTS_REF ldpm_vs_cor_teg__fac_cor /end AXIS_DESCR
/end CHARACTERISTIC
/begin AXIS_PTS ldp_vs_cor_teg_up_1__fac_cor "" 0x01293 teg_1.gas_up_struct.vs_cor_teg_up _REC_AXS_20_u1 255. _CNV_A_R_LINEAR_____23_CM 6 0. 255. DISPLAY_IDENTIFIER LDP_VS_COR_TEG_UP_1__FAC_COR FORMAT "%3.0" /end AXIS_PTS
/begin AXIS_PTS ldpm_vs__fac_cor_vs_teg "" 0x01423 vs _REC_AXS_20_u1 255. _CNV_A_R_LINEAR_____23_CM 6 0. 255. DISPLAY_IDENTIFIER LDPM_VS__FAC_COR_VS_TEG FORMAT "%3.0" /end AXIS_PTS
/begin CHARACTERISTIC c_toil_teg_grad_min_up "Minimum condition of  Oil temperature for TEG gradient" VALUE 0x008f1 _REC_VAL_20_u1 200. _CNV_A_R_LINEAR_____15_CM -40. 160. DISPLAY_IDENTIFIER C_TOIL_TEG_GRAD_MIN_UP FORMAT "%3.0" /end CHARACTERISTIC
/begin CHARACTERISTIC c_toil_teg_grad_min_down "Minimum condition of  Oil temperature for TEG gradient" VALUE 0x008f0 _REC_VAL_20_u1 200. _CNV_A_R_LINEAR_____15_CM -40. 160. DISPLAY_IDENTIFIER C_TOIL_TEG_GRAD_MIN_DOWN FORMAT "%3.0" /end CHARACTERISTIC
/begin CHARACTERISTIC c_toil_teg_level_min_up "Minimum condition of Oil temperature for TEG level" VALUE 0x008f3 _REC_VAL_20_u1 200. _CNV_A_R_LINEAR_____15_CM -40. 160. DISPLAY_IDENTIFIER C_TOIL_TEG_LEVEL_MIN_UP FORMAT "%3.0" /end CHARACTERISTIC
/begin CHARACTERISTIC c_toil_teg_level_min_down "Minimum condition of Oil temperature for TEG level" VALUE 0x008f2 _REC_VAL_20_u1 200. _CNV_A_R_LINEAR_____15_CM -40. 160. DISPLAY_IDENTIFIER C_TOIL_TEG_LEVEL_MIN_DOWN FORMAT "%3.0" /end CHARACTERISTIC
/begin CHARACTERISTIC ip_fac_teg_cor_lamb_sp_up "Lambda influences correction depending on load engine" MAP 0x0b05e _REC_MAP_20_u2_u2_u2 1.99996948 _CNV_A_R_LINEAR_____21_CM 0. 1.99996948 DISPLAY_IDENTIFIER IP_FAC_TEG_COR_LAMB_SP_UP FORMAT "%7.5"
 /begin AXIS_DESCR COM_AXIS maf_teg _CNV_A_R_LINEAR_____106_CM 8 0. 1389. FORMAT "%7.2" AXIS_PTS_REF ldpm_maf_teg__teg_stat /end AXIS_DESCR
 /begin AXIS_DESCR COM_AXIS n_teg _CNV_A_R_LINEAR_____11_CM 8 0. 8160. FORMAT "%4.0" AXIS_PTS_REF ldpm_n_teg__teg_stat /end AXIS_DESCR
/end CHARACTERISTIC
/begin AXIS_PTS ldpm_maf_teg__teg_stat "" 0x117ee maf_teg _REC_AXS_20_u2 1389. _CNV_A_R_LINEAR_____106_CM 8 0. 1389. DISPLAY_IDENTIFIER LDPM_MAF_TEG__TEG_STAT FORMAT "%7.2" /end AXIS_PTS
/begin AXIS_PTS ldpm_n_teg__teg_stat "" 0x11a2e n_teg _REC_AXS_20_u2 8160. _CNV_A_R_LINEAR_____11_CM 8 0. 8160. DISPLAY_IDENTIFIER LDPM_N_TEG__TEG_STAT FORMAT "%4.0" /end AXIS_PTS
/begin CHARACTERISTIC ip_fac_cor_saf "SAF_KGH correktion" CURVE 0x0aae6 _REC_CUR_20_u2_u2 1.99996948 _CNV_A_R_LINEAR_____21_CM 0. 1.99996948 DISPLAY_IDENTIFIER IP_FAC_COR_SAF FORMAT "%7.5"
 /begin AXIS_DESCR COM_AXIS saf_kgh _CNV_A_R_LINEAR_____47_CM 6 0. 1023.984375 FORMAT "%7.2" AXIS_PTS_REF ldpm_saf_kgh__fac_cor_saf /end AXIS_DESCR
/end CHARACTERISTIC
/begin AXIS_PTS ldpm_saf_kgh__fac_cor_saf "" 0x11ace saf_kgh _REC_AXS_20_u2 1023.984375 _CNV_A_R_LINEAR_____47_CM 6 0. 1023.984375 DISPLAY_IDENTIFIER LDPM_SAF_KGH__FAC_COR_SAF FORMAT "%7.2" /end AXIS_PTS
/begin CHARACTERISTIC ip_eff_iga_add_tco_teg "TCO correction" CURVE 0x09c12 _REC_CUR_20_u2_u1 1.99996948 _CNV_A_R_LINEAR_____393_CM -1. 0.99996948 DISPLAY_IDENTIFIER IP_EFF_IGA_ADD_TCO_TEG FORMAT "%8.5"
 /begin AXIS_DESCR COM_AXIS tco _CNV_A_R_LINEAR_____12_CM 6 -48. 142.5 FORMAT "%5.1" AXIS_PTS_REF ldpm_tco__tco_eff_iga_teg /end AXIS_DESCR
/end CHARACTERISTIC
/begin AXIS_PTS ldpm_tco__fac_cor_tco_teg "" 0x013c7 tco _REC_AXS_20_u1 190.5 _CNV_A_R_LINEAR_____12_CM 6 -48. 142.5 DISPLAY_IDENTIFIER LDPM_TCO__FAC_COR_TCO_TEG FORMAT "%5.1" /end AXIS_PTS
/begin AXIS_PTS ldpm_tco__tco_eff_iga_teg "" 0x013da tco _REC_AXS_20_u1 190.5 _CNV_A_R_LINEAR_____12_CM 6 -48. 142.5 DISPLAY_IDENTIFIER LDPM_TCO__TCO_EFF_IGA_TEG FORMAT "%5.1" /end AXIS_PTS
/begin MEASUREMENT tam_ref_teg "Reference ambient temperature for TEG model" UWORD _CNV_A_R_LINEAR_____262_CM 1 100. -48. 1459.3 DISPLAY_IDENTIFIER TAM_REF_TEG ECU_ADDRESS 0x3fd2c0 BYTE_ORDER MSB_LAST FORMAT "%7.2" /end MEASUREMENT
/begin AXIS_PTS ldpm_n_teg__crlc_teg "" 0x11a1c n_teg _REC_AXS_20_u2 8160. _CNV_A_R_LINEAR_____11_CM 8 0. 8160. DISPLAY_IDENTIFIER LDPM_N_TEG__CRLC_TEG FORMAT "%4.0" /end AXIS_PTS
/begin CHARACTERISTIC c_crlc_teg_grad_min "Min range limit of level calculation" VALUE 0x014e2 _REC_VAL_20_u2 0.999755 _CNV_A_R_LINEAR_____124_CM 0. 0.999755 DISPLAY_IDENTIFIER C_CRLC_TEG_GRAD_MIN FORMAT "%7.5" /end CHARACTERISTIC
/begin CHARACTERISTIC c_fac_level_grad "Scaling factor" VALUE 0x006ce _REC_VAL_20_u1 1. _CNV_A_R_LINEAR_____1_CM 1. 2. DISPLAY_IDENTIFIER C_FAC_LEVEL_GRAD FORMAT "%2.0" /end CHARACTERISTIC
/begin MEASUREMENT fac_cor_tco_teg_up "Correction TCO for temperature influence" UWORD _CNV_A_R_LINEAR_____21_CM 1 100. 0. 1.99996948 DISPLAY_IDENTIFIER FAC_COR_TCO_TEG_UP ECU_ADDRESS 0x3fd2b4 BYTE_ORDER MSB_LAST FORMAT "%7.5" /end MEASUREMENT
/begin MEASUREMENT fac_cor_tco_teg_wall_up "Correction TCO for temperature influence" UWORD _CNV_A_R_LINEAR_____21_CM 1 100. 0. 1.99996948 DISPLAY_IDENTIFIER FAC_COR_TCO_TEG_WALL_UP ECU_ADDRESS 0x3fd2f2 BYTE_ORDER MSB_LAST FORMAT "%7.5" /end MEASUREMENT
/begin CHARACTERISTIC ip_fac_cor_tco_teg_up "TCO correction" CURVE 0x0ab22 _REC_CUR_20_u2_u1 1.99996948 _CNV_A_R_LINEAR_____21_CM 0. 1.99996948 DISPLAY_IDENTIFIER IP_FAC_COR_TCO_TEG_UP FORMAT "%7.5"
 /begin AXIS_DESCR COM_AXIS tco _CNV_A_R_LINEAR_____12_CM 6 -48. 142.5 FORMAT "%5.1" AXIS_PTS_REF ldpm_tco__fac_cor_tco_teg /end AXIS_DESCR
/end CHARACTERISTIC
/begin CHARACTERISTIC ip_fac_cor_tco_teg_wall_up "TCO correction" CURVE 0x0ab3a _REC_CUR_20_u2_u1 1.99996948 _CNV_A_R_LINEAR_____21_CM 0. 1.99996948 DISPLAY_IDENTIFIER IP_FAC_COR_TCO_TEG_WALL_UP FORMAT "%7.5"
 /begin AXIS_DESCR COM_AXIS tco _CNV_A_R_LINEAR_____12_CM 6 -48. 142.5 FORMAT "%5.1" AXIS_PTS_REF ldpm_tco__fac_cor_tco_teg /end AXIS_DESCR
/end CHARACTERISTIC
/begin MEASUREMENT fac_cor_tco_teg_down "Correction TCO for temperature influence" UWORD _CNV_A_R_LINEAR_____21_CM 1 100. 0. 1.99996948 DISPLAY_IDENTIFIER FAC_COR_TCO_TEG_DOWN ECU_ADDRESS 0x3fd2f4 BYTE_ORDER MSB_LAST FORMAT "%7.5" /end MEASUREMENT
/begin MEASUREMENT fac_cor_tco_teg_wall_down "Correction TCO for temperature influence" UWORD _CNV_A_R_LINEAR_____21_CM 1 100. 0. 1.99996948 DISPLAY_IDENTIFIER FAC_COR_TCO_TEG_WALL_DOWN ECU_ADDRESS 0x3fd2f6 BYTE_ORDER MSB_LAST FORMAT "%7.5" /end MEASUREMENT
/begin CHARACTERISTIC ip_fac_cor_tco_teg_down "TCO correction" CURVE 0x0ab16 _REC_CUR_20_u2_u1 1.99996948 _CNV_A_R_LINEAR_____21_CM 0. 1.99996948 DISPLAY_IDENTIFIER IP_FAC_COR_TCO_TEG_DOWN FORMAT "%7.5"
 /begin AXIS_DESCR COM_AXIS tco _CNV_A_R_LINEAR_____12_CM 6 -48. 142.5 FORMAT "%5.1" AXIS_PTS_REF ldpm_tco__fac_cor_tco_teg /end AXIS_DESCR
/end CHARACTERISTIC
/begin CHARACTERISTIC ip_fac_cor_tco_teg_wall_down "TCO correction" CURVE 0x0ab2e _REC_CUR_20_u2_u1 1.99996948 _CNV_A_R_LINEAR_____21_CM 0. 1.99996948 DISPLAY_IDENTIFIER IP_FAC_COR_TCO_TEG_WALL_DOWN FORMAT "%7.5"
 /begin AXIS_DESCR COM_AXIS tco _CNV_A_R_LINEAR_____12_CM 6 -48. 142.5 FORMAT "%5.1" AXIS_PTS_REF ldpm_tco__fac_cor_tco_teg /end AXIS_DESCR
/end CHARACTERISTIC
/begin MEASUREMENT mff_add_reac_cyl[0] "Reactivation enrichment" UWORD _CNV_A_R_LINEAR_____106_CM 1 100. 0. 1389. DISPLAY_IDENTIFIER MFF_ADD_REAC_CYL_0 ECU_ADDRESS 0x3fd4fe BYTE_ORDER MSB_LAST FORMAT "%7.2" /end MEASUREMENT
/begin MEASUREMENT mff_add_reac_cyl[1] "Reactivation enrichment" UWORD _CNV_A_R_LINEAR_____106_CM 1 100. 0. 1389. DISPLAY_IDENTIFIER MFF_ADD_REAC_CYL_1 ECU_ADDRESS 0x3fd500 BYTE_ORDER MSB_LAST FORMAT "%7.2" /end MEASUREMENT
/begin MEASUREMENT mff_add_reac_cyl[2] "Reactivation enrichment" UWORD _CNV_A_R_LINEAR_____106_CM 1 100. 0. 1389. DISPLAY_IDENTIFIER MFF_ADD_REAC_CYL_2 ECU_ADDRESS 0x3fd502 BYTE_ORDER MSB_LAST FORMAT "%7.2" /end MEASUREMENT
/begin MEASUREMENT mff_add_reac_cyl[3] "Reactivation enrichment" UWORD _CNV_A_R_LINEAR_____106_CM 1 100. 0. 1389. DISPLAY_IDENTIFIER MFF_ADD_REAC_CYL_3 ECU_ADDRESS 0x3fd504 BYTE_ORDER MSB_LAST FORMAT "%7.2" /end MEASUREMENT
/begin MEASUREMENT mff_add_reac_cyl[4] "Reactivation enrichment" UWORD _CNV_A_R_LINEAR_____106_CM 1 100. 0. 1389. DISPLAY_IDENTIFIER MFF_ADD_REAC_CYL_4 ECU_ADDRESS 0x3fd506 BYTE_ORDER MSB_LAST FORMAT "%7.2" /end MEASUREMENT
/begin MEASUREMENT mff_add_reac_cyl[5] "Reactivation enrichment" UWORD _CNV_A_R_LINEAR_____106_CM 1 100. 0. 1389. DISPLAY_IDENTIFIER MFF_ADD_REAC_CYL_5 ECU_ADDRESS 0x3fd508 BYTE_ORDER MSB_LAST FORMAT "%7.2" /end MEASUREMENT
/begin MEASUREMENT mff_dif_wf[0] "wall film degradation" SLONG _CNV_A_R_LINEAR_____106_CM 1 100. -1389. 0. DISPLAY_IDENTIFIER MFF_DIF_WF_0 ECU_ADDRESS 0x3fcc8c BYTE_ORDER MSB_LAST FORMAT "%9.2" /end MEASUREMENT
/begin MEASUREMENT mff_dif_wf[1] "wall film degradation" SLONG _CNV_A_R_LINEAR_____106_CM 1 100. -1389. 0. DISPLAY_IDENTIFIER MFF_DIF_WF_1 ECU_ADDRESS 0x3fcc90 BYTE_ORDER MSB_LAST FORMAT "%9.2" /end MEASUREMENT
/begin MEASUREMENT mff_dif_wf[2] "wall film degradation" SLONG _CNV_A_R_LINEAR_____106_CM 1 100. -1389. 0. DISPLAY_IDENTIFIER MFF_DIF_WF_2 ECU_ADDRESS 0x3fcc94 BYTE_ORDER MSB_LAST FORMAT "%9.2" /end MEASUREMENT
/begin MEASUREMENT mff_dif_wf[3] "wall film degradation" SLONG _CNV_A_R_LINEAR_____106_CM 1 100. -1389. 0. DISPLAY_IDENTIFIER MFF_DIF_WF_3 ECU_ADDRESS 0x3fcc98 BYTE_ORDER MSB_LAST FORMAT "%9.2" /end MEASUREMENT
/begin MEASUREMENT mff_dif_wf[4] "wall film degradation" SLONG _CNV_A_R_LINEAR_____106_CM 1 100. -1389. 0. DISPLAY_IDENTIFIER MFF_DIF_WF_4 ECU_ADDRESS 0x3fcc9c BYTE_ORDER MSB_LAST FORMAT "%9.2" /end MEASUREMENT
/begin MEASUREMENT mff_dif_wf[5] "wall film degradation" SLONG _CNV_A_R_LINEAR_____106_CM 1 100. -1389. 0. DISPLAY_IDENTIFIER MFF_DIF_WF_5 ECU_ADDRESS 0x3fcca0 BYTE_ORDER MSB_LAST FORMAT "%9.2" /end MEASUREMENT
/begin MEASUREMENT fac_ti_reac[0] "Value of Table ID_FAC_TI_RIS__CYCNR" UBYTE _CNV_A_R_LINEAR_____39_CM 1 100. 0. 1.99220002 DISPLAY_IDENTIFIER FAC_TI_REAC_0 ECU_ADDRESS 0x3fe361 FORMAT "%5.3" /end MEASUREMENT
/begin MEASUREMENT fac_ti_reac[1] "Value of Table ID_FAC_TI_RIS__CYCNR" UBYTE _CNV_A_R_LINEAR_____39_CM 1 100. 0. 1.99220002 DISPLAY_IDENTIFIER FAC_TI_REAC_1 ECU_ADDRESS 0x3fe362 FORMAT "%5.3" /end MEASUREMENT
/begin MEASUREMENT fac_ti_reac[2] "Value of Table ID_FAC_TI_RIS__CYCNR" UBYTE _CNV_A_R_LINEAR_____39_CM 1 100. 0. 1.99220002 DISPLAY_IDENTIFIER FAC_TI_REAC_2 ECU_ADDRESS 0x3fe363 FORMAT "%5.3" /end MEASUREMENT
/begin MEASUREMENT fac_ti_reac[3] "Value of Table ID_FAC_TI_RIS__CYCNR" UBYTE _CNV_A_R_LINEAR_____39_CM 1 100. 0. 1.99220002 DISPLAY_IDENTIFIER FAC_TI_REAC_3 ECU_ADDRESS 0x3fe364 FORMAT "%5.3" /end MEASUREMENT
/begin MEASUREMENT fac_ti_reac[4] "Value of Table ID_FAC_TI_RIS__CYCNR" UBYTE _CNV_A_R_LINEAR_____39_CM 1 100. 0. 1.99220002 DISPLAY_IDENTIFIER FAC_TI_REAC_4 ECU_ADDRESS 0x3fe365 FORMAT "%5.3" /end MEASUREMENT
/begin MEASUREMENT fac_ti_reac[5] "Value of Table ID_FAC_TI_RIS__CYCNR" UBYTE _CNV_A_R_LINEAR_____39_CM 1 100. 0. 1.99220002 DISPLAY_IDENTIFIER FAC_TI_REAC_5 ECU_ADDRESS 0x3fe366 FORMAT "%5.3" /end MEASUREMENT
/begin CHARACTERISTIC id_fac_mff_tco_neg_wf "Wall film factor, begin of fuel cutoff" CURVE 0x009a2 _REC_CUR_20_u1_u1 0.4980468800000001 _CNV_A_R_LINEAR_____445_CM 0. 0.49804688 DISPLAY_IDENTIFIER ID_FAC_MFF_TCO_NEG_WF FORMAT "%5.3"
 /begin AXIS_DESCR COM_AXIS tco _CNV_A_R_LINEAR_____12_CM 8 -48. 142.5 FORMAT "%5.1" AXIS_PTS_REF ldpm_tco__reac /end AXIS_DESCR
/end CHARACTERISTIC
/begin CHARACTERISTIC id_fac_mff_tco_pos_wf "Wall film factor, begin of fuel cutoff" CURVE 0x009aa _REC_CUR_20_u1_u1 0.4980468800000001 _CNV_A_R_LINEAR_____445_CM 0. 0.49804688 DISPLAY_IDENTIFIER ID_FAC_MFF_TCO_POS_WF FORMAT "%5.3"
 /begin AXIS_DESCR COM_AXIS tco _CNV_A_R_LINEAR_____12_CM 8 -48. 142.5 FORMAT "%5.1" AXIS_PTS_REF ldpm_tco__reac /end AXIS_DESCR
/end CHARACTERISTIC
/begin CHARACTERISTIC ip_fac_mff_map_wf "MAP dependant factor" CURVE 0x00b48 _REC_CUR_20_u1_u2 0.99610001 _CNV_A_R_LINEAR_____29_CM 0. 0.99610001 DISPLAY_IDENTIFIER IP_FAC_MFF_MAP_WF FORMAT "%5.3"
 /begin AXIS_DESCR COM_AXIS map _CNV_A_R_LINEAR_____49_CM 4 0. 5434. FORMAT "%7.2" AXIS_PTS_REF ldp_map__fac_mff_map_wf /end AXIS_DESCR
/end CHARACTERISTIC
/begin CHARACTERISTIC id_fac_ti_ris "Reactivation correction, soft reactivation" CURVE 0x03d37 _REC_CUR_20_u1_u1 1.99220002 _CNV_A_R_LINEAR_____39_CM 0. 1.99220002 DISPLAY_IDENTIFIER ID_FAC_TI_RIS FORMAT "%5.3"
 /begin AXIS_DESCR COM_AXIS online_dummy _CNV_A_R_LINEAR_____1_CM 16 1. 16. FORMAT "%2.0" AXIS_PTS_REF ldpm_cycnr_reac__reac /end AXIS_DESCR
/end CHARACTERISTIC
/begin CHARACTERISTIC id_fac_ti_rpl "Reactivation correction, hard reactivation" CURVE 0x03d47 _REC_CUR_20_u1_u1 1.99220002 _CNV_A_R_LINEAR_____39_CM 0. 1.99220002 DISPLAY_IDENTIFIER ID_FAC_TI_RPL FORMAT "%5.3"
 /begin AXIS_DESCR COM_AXIS online_dummy _CNV_A_R_LINEAR_____1_CM 16 1. 16. FORMAT "%2.0" AXIS_PTS_REF ldpm_cycnr_reac__reac /end AXIS_DESCR
/end CHARACTERISTIC
/begin CHARACTERISTIC id_mff_inc_wf "Wall-film degradation" CURVE 0x08604 _REC_CUR_20_u2_u1 1389. _CNV_A_R_LINEAR_____106_CM 0. 1389. DISPLAY_IDENTIFIER ID_MFF_INC_WF FORMAT "%7.2"
 /begin AXIS_DESCR COM_AXIS n_32 _CNV_A_R_LINEAR_____16_CM 8 0. 8160. FORMAT "%4.0" AXIS_PTS_REF ldpm_n_32__reac /end AXIS_DESCR
/end CHARACTERISTIC
/begin CHARACTERISTIC id_mff_dec_wf "Wall-film build-up" CURVE 0x085f4 _REC_CUR_20_u2_u1 1389. _CNV_A_R_LINEAR_____106_CM 0. 1389. DISPLAY_IDENTIFIER ID_MFF_DEC_WF FORMAT "%7.2"
 /begin AXIS_DESCR COM_AXIS n_32 _CNV_A_R_LINEAR_____16_CM 8 0. 8160. FORMAT "%4.0" AXIS_PTS_REF ldpm_n_32__reac /end AXIS_DESCR
/end CHARACTERISTIC
/begin AXIS_PTS ldpm_tco__reac "" 0x081f0 tco _REC_AXS_20_u1 190.5 _CNV_A_R_LINEAR_____12_CM 8 -48. 142.5 DISPLAY_IDENTIFIER LDPM_TCO__REAC FORMAT "%5.1" /end AXIS_PTS
/begin AXIS_PTS ldp_map__fac_mff_map_wf "" 0x10dca map _REC_AXS_20_u2 5434. _CNV_A_R_LINEAR_____49_CM 4 0. 5434. DISPLAY_IDENTIFIER LDP_MAP__FAC_MFF_MAP_WF FORMAT "%7.2" /end AXIS_PTS
/begin AXIS_PTS ldpm_n_32__reac "" 0x08092 n_32 _REC_AXS_20_u1 8160. _CNV_A_R_LINEAR_____16_CM 8 0. 8160. DISPLAY_IDENTIFIER LDPM_N_32__REAC FORMAT "%4.0" /end AXIS_PTS
/begin AXIS_PTS ldpm_cycnr_reac__reac "" 0x07f08 online_dummy _REC_AXS_20_u1 15. _CNV_A_R_LINEAR_____1_CM 16 1. 16. DISPLAY_IDENTIFIER LDPM_CYCNR_REAC__REAC FORMAT "%2.0" /end AXIS_PTS
/begin COMPU_METHOD _CNV_S_2_RANGE______0_CM "" TAB_VERB "%6.3" "[-]" COMPU_TAB_REF _CNV_S_2_RANGE______0 /end COMPU_METHOD
/begin COMPU_VTAB _CNV_S_2_RANGE______0 "" TAB_VERB 2 0 "0" 1 "1" /end COMPU_VTAB
/begin COMPU_METHOD _CNV_A_R_LINEAR_____1_CM "" RAT_FUNC "%6.3" "-" COEFFS 0 1. 0. 0 0 1 /end COMPU_METHOD
/begin COMPU_METHOD _CNV_A_R_LINEAR_____3_CM "" RAT_FUNC "%6.3" "V" COEFFS 0 204.7999998974999 0. 0 0 1 /end COMPU_METHOD
/begin COMPU_METHOD _CNV_S_2_RANGE______5_CM "" TAB_VERB "%6.3" "-" COMPU_TAB_REF _CNV_S_2_RANGE______5 /end COMPU_METHOD
/begin COMPU_VTAB _CNV_S_2_RANGE______5 "" TAB_VERB 2 0 "0" 1 "1" /end COMPU_VTAB
/begin COMPU_METHOD _CNV_A_R_LINEAR_____7_CM "" RAT_FUNC "%6.3" "°C" COEFFS 0 16. 0. 0 0 1 /end COMPU_METHOD
/begin COMPU_METHOD _CNV_A_R_LINEAR_____9_CM "" RAT_FUNC "%6.3" "%" COEFFS 0 655.3600000071681 0. 0 0 1 /end COMPU_METHOD
/begin COMPU_METHOD _CNV_A_R_LINEAR_____10_CM "" RAT_FUNC "%6.3" "%" COEFFS 0 2.56 0. 0 0 1 /end COMPU_METHOD
/begin COMPU_METHOD _CNV_A_R_LINEAR_____11_CM "" RAT_FUNC "%6.3" "rpm" COEFFS 0 1. 0. 0 0 1 /end COMPU_METHOD
/begin COMPU_METHOD _CNV_A_R_LINEAR_____12_CM "" RAT_FUNC "%6.3" "°C" COEFFS 0 1.333333333333333 64. 0 0 1 /end COMPU_METHOD
/begin COMPU_METHOD _CNV_A_R_LINEAR_____13_CM "" RAT_FUNC "%6.3" "°C" COEFFS 0 1.333333333333333 0. 0 0 1 /end COMPU_METHOD
/begin COMPU_METHOD _CNV_A_R_LINEAR_____15_CM "" RAT_FUNC "%6.3" "°C" COEFFS 0 1. 40. 0 0 1 /end COMPU_METHOD
/begin COMPU_METHOD _CNV_A_R_LINEAR_____16_CM "" RAT_FUNC "%6.3" "rpm" COEFFS 0 3.125e-002 0. 0 0 1 /end COMPU_METHOD
/begin COMPU_METHOD _CNV_A_R_LINEAR_____21_CM "" RAT_FUNC "%6.3" "-" COEFFS 0 32768.00003968061 0. 0 0 1 /end COMPU_METHOD
/begin COMPU_METHOD _CNV_A_R_LINEAR_____23_CM "" RAT_FUNC "%6.3" "km/h" COEFFS 0 1. 0. 0 0 1 /end COMPU_METHOD
/begin COMPU_METHOD _CNV_A_R_LINEAR_____27_CM "" RAT_FUNC "%6.3" "mg/stk" COEFFS 0 0.183585313174946 0. 0 0 1 /end COMPU_METHOD
/begin COMPU_METHOD _CNV_A_R_LINEAR_____29_CM "" RAT_FUNC "%6.3" "-" COEFFS 0 255.9983911655618 0. 0 0 1 /end COMPU_METHOD
/begin COMPU_METHOD _CNV_A_R_LINEAR_____37_CM "" RAT_FUNC "%6.3" "-" COEFFS 0 65536.00007936121 0. 0 0 1 /end COMPU_METHOD
/begin COMPU_METHOD _CNV_A_R_LINEAR_____39_CM "" RAT_FUNC "%6.3" "-" COEFFS 0 127.9991955827809 0. 0 0 1 /end COMPU_METHOD
/begin COMPU_METHOD _CNV_A_R_LINEAR_____47_CM "" RAT_FUNC "%6.3" "kg/h" COEFFS 0 64. 0. 0 0 1 /end COMPU_METHOD
/begin COMPU_METHOD _CNV_A_R_LINEAR_____49_CM "" RAT_FUNC "%6.3" "hPa" COEFFS 0 12.06017666543982 0. 0 0 1 /end COMPU_METHOD
/begin COMPU_METHOD _CNV_A_R_LINEAR_____50_CM "" RAT_FUNC "%6.3" "[-]" COEFFS 0 255.9999357490357 0. 0 0 1 /end COMPU_METHOD
/begin COMPU_METHOD _CNV_A_R_LINEAR_____82_CM "" RAT_FUNC "%6.3" "°CRK" COEFFS 0 2.666666666666667 0. 0 0 1 /end COMPU_METHOD
/begin COMPU_METHOD _CNV_A_R_LINEAR_____97_CM "" RAT_FUNC "%6.3" "min" COEFFS 0 1. 0. 0 0 1 /end COMPU_METHOD
/begin COMPU_METHOD _CNV_A_R_LINEAR_____106_CM "" RAT_FUNC "%6.3" "mg/stk" COEFFS 0 47.18142548596112 0. 0 0 1 /end COMPU_METHOD
/begin COMPU_METHOD _CNV_A_R_LINEAR_____113_CM "" RAT_FUNC "%6.3" "kg/h" COEFFS 0 32. 0. 0 0 1 /end COMPU_METHOD
/begin COMPU_METHOD _CNV_A_R_LINEAR_____123_CM "" RAT_FUNC "%6.3" "-" COEFFS 0 255.9999997499962 0. 0 0 1 /end COMPU_METHOD
/begin COMPU_METHOD _CNV_A_R_LINEAR_____124_CM "" RAT_FUNC "%6.3" "-" COEFFS 0 65551.06000970239 0. 0 0 1 /end COMPU_METHOD
/begin COMPU_METHOD _CNV_A_R_LINEAR_____127_CM "" RAT_FUNC "%6.3" "[-]" COEFFS 0 64. 0. 0 0 1 /end COMPU_METHOD
/begin COMPU_METHOD _CNV_A_R_LINEAR_____157_CM "" RAT_FUNC "%6.3" "-" COEFFS 0 64. 0. 0 0 1 /end COMPU_METHOD
/begin COMPU_METHOD _CNV_A_R_LINEAR_____158_CM "" RAT_FUNC "%6.3" "V" COEFFS 0 200. 0. 0 0 1 /end COMPU_METHOD
/begin COMPU_METHOD _CNV_A_R_LINEAR_____159_CM "" RAT_FUNC "%6.3" "%" COEFFS 0 655.3600000071681 32768.00000035841 0 0 1 /end COMPU_METHOD
/begin COMPU_METHOD _CNV_A_R_LINEAR_____160_CM "" RAT_FUNC "%6.3" "%" COEFFS 0 655.34 0. 0 0 1 /end COMPU_METHOD
/begin COMPU_METHOD _CNV_A_R_LINEAR_____161_CM "" RAT_FUNC "%6.3" "°CRK" COEFFS 0 0.1666666666666667 0. 0 0 1 /end COMPU_METHOD
/begin COMPU_METHOD _CNV_A_R_LINEAR_____162_CM "" RAT_FUNC "%6.3" "V" COEFFS 0 51400. -0.500000000003638 0 0 1 /end COMPU_METHOD
/begin COMPU_METHOD _CNV_A_R_LINEAR_____163_CM "" RAT_FUNC "%6.3" "V" COEFFS 0 51400. 32767.5 0 0 1 /end COMPU_METHOD
/begin COMPU_METHOD _CNV_A_R_LINEAR_____164_CM "" RAT_FUNC "%6.3" "-" COEFFS 0 1023.999999919998 0. 0 0 1 /end COMPU_METHOD
/begin COMPU_METHOD _CNV_A_R_LINEAR_____262_CM "" RAT_FUNC "%6.3" "°C" COEFFS 0 43.47840509520334 2086.96344456976 0 0 1 /end COMPU_METHOD
/begin COMPU_METHOD _CNV_A_R_LINEAR_____264_CM "" RAT_FUNC "%6.3" "-" COEFFS 0 16383.75 32767.5 0 0 1 /end COMPU_METHOD
/begin COMPU_METHOD _CNV_A_R_LINEAR_____265_CM "" RAT_FUNC "%6.3" "-" COEFFS 0 16383.99999935999 -1.280019205296412e-006 0 0 1 /end COMPU_METHOD
/begin COMPU_METHOD _CNV_A_R_LINEAR_____271_CM "" RAT_FUNC "%6.3" "g" COEFFS 0 36.00036915004301 0. 0 0 1 /end COMPU_METHOD
/begin COMPU_METHOD _CNV_A_R_LINEAR_____302_CM "" RAT_FUNC "%6.3" "°C" COEFFS 0 64. 2112. 0 0 1 /end COMPU_METHOD
/begin COMPU_METHOD _CNV_A_R_LINEAR_____303_CM "" RAT_FUNC "%6.3" "g" COEFFS 0 4608.117565499413 0. 0 0 1 /end COMPU_METHOD
/begin COMPU_METHOD _CNV_A_R_LINEAR_____304_CM "" RAT_FUNC "%6.3" "-" COEFFS 0 1024. 0. 0 0 1 /end COMPU_METHOD
/begin COMPU_METHOD _CNV_A_R_LINEAR_____309_CM "" RAT_FUNC "%6.3" "-" COEFFS 0 16383.99985599781 0. 0 0 1 /end COMPU_METHOD
/begin COMPU_METHOD _CNV_A_R_LINEAR_____345_CM "" RAT_FUNC "%6.3" "-" COEFFS 0 8191.999999679995 0. 0 0 1 /end COMPU_METHOD
/begin COMPU_METHOD _CNV_A_R_LINEAR_____388_CM "" RAT_FUNC "%6.3" "-" COEFFS 0 2. 0. 0 0 1 /end COMPU_METHOD
/begin COMPU_METHOD _CNV_A_R_LINEAR_____393_CM "" RAT_FUNC "%6.3" "-" COEFFS 0 32768.00003968061 32768.00003968061 0 0 1 /end COMPU_METHOD
/begin COMPU_METHOD _CNV_A_R_LINEAR_____414_CM "" RAT_FUNC "%6.3" "°C" COEFFS 0 66.66666666666667 0. 0 0 1 /end COMPU_METHOD
/begin COMPU_METHOD _CNV_A_R_LINEAR_____415_CM "" RAT_FUNC "%6.3" "°C" COEFFS 0 21.73913043478261 32768. 0 0 1 /end COMPU_METHOD
/begin COMPU_METHOD _CNV_A_R_LINEAR_____416_CM "" RAT_FUNC "%6.3" "kJ" COEFFS 0 576008.8405624894 0. 0 0 1 /end COMPU_METHOD
/begin COMPU_METHOD _CNV_A_R_LINEAR_____417_CM "" RAT_FUNC "%6.3" "°C" COEFFS 0 66.66666666666667 32768. 0 0 1 /end COMPU_METHOD
/begin COMPU_METHOD _CNV_A_R_LINEAR_____418_CM "" RAT_FUNC "%6.3" "°C" COEFFS 0 66.6670057577972 0.1666700426794705 0 0 1 /end COMPU_METHOD
/begin COMPU_METHOD _CNV_A_R_LINEAR_____419_CM "" RAT_FUNC "%6.3" "°C" COEFFS 0 85.33168316831683 0. 0 0 1 /end COMPU_METHOD
/begin COMPU_METHOD _CNV_A_R_LINEAR_____420_CM "" RAT_FUNC "%6.3" "°C" COEFFS 0 1.262376237623762 0. 0 0 1 /end COMPU_METHOD
/begin COMPU_METHOD _CNV_A_R_LINEAR_____421_CM "" RAT_FUNC "%6.3" "°C" COEFFS 0 1.331683168316832 0. 0 0 1 /end COMPU_METHOD
/begin COMPU_METHOD _CNV_A_R_LINEAR_____422_CM "" RAT_FUNC "%6.3" "°C" COEFFS 0 1.262376237623762 255. 0 0 1 /end COMPU_METHOD
/begin COMPU_METHOD _CNV_A_R_LINEAR_____423_CM "" RAT_FUNC "%6.3" "°C" COEFFS 0 1.331683168316832 269. 0 0 1 /end COMPU_METHOD
/begin COMPU_METHOD _CNV_A_R_LINEAR_____424_CM "" RAT_FUNC "%6.3" "kJ/K" COEFFS 0 6666.836215666328 0. 0 0 1 /end COMPU_METHOD
/begin COMPU_METHOD _CNV_A_R_LINEAR_____425_CM "" RAT_FUNC "%6.3" "KW" COEFFS 0 149.2228528379436 0. 0 0 1 /end COMPU_METHOD
/begin COMPU_METHOD _CNV_A_R_LINEAR_____426_CM "" RAT_FUNC "%6.3" "°CRK" COEFFS 0 2.666666666666667 255. 0 0 1 /end COMPU_METHOD
/begin COMPU_METHOD _CNV_A_R_LINEAR_____427_CM "" RAT_FUNC "%6.3" "kJ" COEFFS 0 8.789063285815482 0. 0 0 1 /end COMPU_METHOD
/begin COMPU_METHOD _CNV_A_R_LINEAR_____428_CM "" RAT_FUNC "%6.3" "°C" COEFFS 0 43.47895323530973 0. 0 0 1 /end COMPU_METHOD
/begin COMPU_METHOD _CNV_A_R_LINEAR_____429_CM "" RAT_FUNC "%6.3" "°C" COEFFS 0 43.47840509520334 0. 0 0 1 /end COMPU_METHOD
/begin COMPU_METHOD _CNV_A_R_LINEAR_____430_CM "" RAT_FUNC "%6.3" "-" COEFFS 0 8191.999999679995 32767.99999871998 0 0 1 /end COMPU_METHOD
/begin COMPU_METHOD _CNV_A_R_LINEAR_____431_CM "" RAT_FUNC "%6.3" "-" COEFFS 0 8192.064968445899 0. 0 0 1 /end COMPU_METHOD
/begin COMPU_METHOD _CNV_A_R_LINEAR_____445_CM "" RAT_FUNC "%6.3" "-" COEFFS 0 511.9999948599216 0. 0 0 1 /end COMPU_METHOD
/begin RECORD_LAYOUT _REC_VAL_20_u1 FNC_VALUES 1 UBYTE COLUMN_DIR DIRECT /end RECORD_LAYOUT
/begin RECORD_LAYOUT _REC_VAL_20_u2 FNC_VALUES 1 UWORD COLUMN_DIR DIRECT /end RECORD_LAYOUT
/begin RECORD_LAYOUT _REC_CUR_20_u2_u1 FNC_VALUES 1 UWORD COLUMN_DIR DIRECT /end RECORD_LAYOUT
/begin RECORD_LAYOUT _REC_AXS_20_u1 NO_AXIS_PTS_X 1 UBYTE AXIS_PTS_X 2 UBYTE INDEX_INCR DIRECT /end RECORD_LAYOUT
/begin RECORD_LAYOUT _REC_CUR_20_u1_u1 FNC_VALUES 1 UBYTE COLUMN_DIR DIRECT /end RECORD_LAYOUT
/begin RECORD_LAYOUT _REC_AXS_20_u2 NO_AXIS_PTS_X 1 UWORD AXIS_PTS_X 2 UWORD INDEX_INCR DIRECT /end RECORD_LAYOUT
/begin RECORD_LAYOUT _REC_CUR_20_u1_u2 FNC_VALUES 1 UBYTE COLUMN_DIR DIRECT /end RECORD_LAYOUT
/begin RECORD_LAYOUT _REC_CUR_20_u2_u2 FNC_VALUES 1 UWORD COLUMN_DIR DIRECT /end RECORD_LAYOUT
/begin RECORD_LAYOUT _REC_MAP_20_u2_u1_u2 FNC_VALUES 1 UWORD COLUMN_DIR DIRECT /end RECORD_LAYOUT
/begin RECORD_LAYOUT _REC_MAP_20_u1_u2_u2 FNC_VALUES 1 UBYTE COLUMN_DIR DIRECT /end RECORD_LAYOUT
/begin RECORD_LAYOUT _REC_MAP_20_u2_u2_u2 FNC_VALUES 1 UWORD COLUMN_DIR DIRECT /end RECORD_LAYOUT
/begin RECORD_LAYOUT _REC_MAP_20_u1_u2_u1 FNC_VALUES 1 UBYTE COLUMN_DIR DIRECT /end RECORD_LAYOUT
/begin FUNCTION INJ_Exhaust_Gas_temperature_mode "_Exhaust Gas temperature model"
 /begin DEF_CHARACTERISTIC ip_temp_sp_toil ip_fac_cor_lamb_sp_up ip_fac_scc_teg ip_fac_toil_vs ip_temp_sp_tco_ex ip_teg_stat_up_1 ip_teg_wall_stat_up_1 ip_fac_teg_wall_cor_lamb_sp_up ip_teg_add_egr ip_teg_wall_add_egr ip_fac_cor_lamb_sp_wall_up ip_crlc_teg_dec_puc_up_1 ip_crlc_teg_wall_dec_puc_up_1 ip_crlc_teg_inc_up_1 ip_crlc_teg_wall_inc_up_1 ip_crlc_teg_dec_up_1 ip_crlc_teg_wall_dec_up_1 ip_teg_stat_down_1 ip_teg_wall_stat_down_1 ip_crlc_teg_toil_dif_down ip_crlc_teg_wall_toil_dif_down ip_crlc_teg_tco_dif_down ip_crlc_teg_wall_tco_dif_down ip_crlc_teg_dec_puc_down_1 ip_crlc_teg_wall_dec_puc_down_1 ip_crlc_teg_dec_down_1 ip_crlc_teg_wall_dec_down_1 ip_crlc_teg_inc_down_1 ip_crlc_teg_wall_inc_down_1 c_tam_ref c_maf_int_teg_st_up c_crlc_teg_st_up c_egy_teg_end_sp_up_1 c_egy_teg_end_sp_up_2 c_teg_wall_st_off c_crlc_teg_wall_st_end_up c_crlc_teg_wall_st_up c_egy_teg_wall_end_sp_up c_fac_cor_vo_teg_down c_fac_cor_vo_teg_wall_down c_fac_cor_lamb_sp_teg_down c_fac_cor_lamb_sp_teg_wall_down c_fac_cor_saf_teg_down c_fac_cor_saf_teg_wall_down c_fac_vs_teg_down c_fac_vs_teg_wall_down c_crlc_teg_wall_st_end_down c_maf_int_teg_st_down c_maf_int_teg_wall_st_down c_crlc_teg_st_down c_crlc_teg_wall_st_down c_egy_teg_end_sp_down_1 c_egy_teg_end_sp_down_2 c_egy_teg_wall_end_sp_down c_fac_lamb_teg_stat_max ip_fac_cor_vo_up ip_fac_cor_vo_wall_up ip_fac_cor_saf_wall ip_fac_scc_teg_wall ip_crlc_teg_tco_dif_up ip_crlc_teg_toil_dif_up c_crlc_teg_st_end_down c_crlc_teg_st_end_up ip_crlc_teg_wall_toil_dif_up ip_crlc_teg_wall_tco_dif_up lc_puc_teg_ena ip_fac_vs_teg_stat_max ip_add_teg_iga ip_teg_cor_vo_up ip_eff_iga_av_teg_cor ip_teg_cor_eff_iga_up ip_temp_sp_tco ip_fac_cor_eff_iga_up c_fac_ref_tco_up c_fac_ref_scc_tco_up c_fac_tco_ex_teg_up_1 c_fac_tco_ex_teg_up_2 ip_fac_teg_stop_down c_teg_st_on_up c_teg_st_on_down c_teg_egy_sp_end c_maf_int_teg_wall_st_up c_fac_cor_eff_iga_teg_down c_fac_ref_scc_tco_down c_fac_tco_ex_teg_down_1 c_fac_tco_ex_teg_down_2 ip_teg_wall_cor_eff_iga_up ip_fac_cor_eff_iga_wall_up c_fac_ref_tco_down ip_teg_wall_cor_vo_up ip_teg_wall_cor_vs_up c_fac_tco_ex_teg_wall_up_2 ip_fac_teg_wall_stop_up c_teg_wall_egy_sp_end c_fac_cor_eff_iga_teg_wall_down c_fac_ref_scc_tco_wall_up c_fac_ref_scc_tco_wall_down c_fac_ref_tco_wall_up c_fac_ref_tco_wall_down c_teg_dif_grad_min c_teg_dif_level_min c_fac_tco_ex_teg_wall_up_1 c_fac_tco_ex_teg_wall_down_1 c_fac_tco_ex_teg_wall_down_2 ip_teg_stat_up_2 ip_teg_wall_stat_up_2 ip_crlc_teg_dec_puc_up_2 ip_crlc_teg_wall_dec_puc_up_2 ip_crlc_teg_inc_up_2 ip_crlc_teg_wall_inc_up_2 ip_crlc_teg_dec_up_2 ip_crlc_teg_wall_dec_up_2 ip_teg_stat_down_2 ip_teg_wall_stat_down_2 ip_crlc_teg_dec_puc_down_2 ip_crlc_teg_wall_dec_puc_down_2 ip_crlc_teg_dec_down_2 ip_crlc_teg_wall_dec_down_2 ip_crlc_teg_inc_down_2 ip_crlc_teg_wall_inc_down_2 ip_fac_teg_stop_up ip_fac_teg_wall_stop_down ip_fac_temp_toil_dif_up ip_teg_cor_vs_up ip_vs_ecf_teg_up_2 ip_fac_tco_ex_vs ip_fac_cor_tco_ex_vs_up ip_fac_cor_tco_ex_vs_down ip_vs_ecf_teg_up_1 ip_vs_ecf_teg_down_2 ip_fac_temp_toil_dif_wall_up ip_fac_cor_ecf_vs_teg ip_fac_cor_ecf_vs_teg_wall ip_vs_ecf_teg_down_1 ip_vs_ecf_teg_wall_up_2 ip_fac_temp_toil_dif_down ip_fac_temp_toil_dif_wall_down ip_vs_ecf_teg_wall_up_1 ip_vs_ecf_teg_wall_down_1 ip_vs_ecf_teg_wall_down_2 c_crlc_dif_teg_level c_crlc_dif_teg_grad ip_fac_cor_vs_teg_up_1 ip_fac_cor_vs_teg_up_2 ip_fac_cor_vs_teg_down_1 ip_fac_cor_vs_teg_down_2 ip_fac_cor_vs_teg_wall_up_1 ip_fac_cor_vs_teg_wall_up_2 ip_fac_cor_vs_teg_wall_down_1 ip_fac_cor_vs_teg_wall_down_2 c_toil_teg_grad_min_up c_toil_teg_grad_min_down c_toil_teg_level_min_up c_toil_teg_level_min_down ip_fac_teg_cor_lamb_sp_up ip_fac_cor_saf ip_eff_iga_add_tco_teg c_crlc_teg_grad_min c_fac_level_grad ip_fac_cor_tco_teg_up ip_fac_cor_tco_teg_wall_up ip_fac_cor_tco_teg_down ip_fac_cor_tco_teg_wall_down /end DEF_CHARACTERISTIC
 /begin OUT_MEASUREMENT teg_1.gas_up_struct.teg_stat_eng_up teg_1.gas_up_struct.teg_cor_eff_iga_up teg_1.gas_up_struct.teg_stat_bas_up teg_1.gas_up_struct.eff_iga_av_teg_cor teg_1.gas_up_struct.fac_scc_teg teg_1.gas_up_struct.fac_cor_lamb_sp_teg_up teg_1.gas_up_struct.teg_stat_up teg_1.gas_up_struct.teg_cat_up_mdl_bas teg_1.gas_up_struct.teg_dif_up teg_1.gas_up_struct.teg_cat_up_mdl_stop teg_1.gas_up_struct.crlc_teg_grad_up teg_1.gas_up_struct.crlc_teg_level_up teg_1.gas_up_struct.crlc_teg_up teg_1.gas_up_struct.crlc_teg_toil_tco_up teg_1.gas_up_struct.crlc_teg_egy_up teg_1.gas_up_struct.egy_teg_end_sp_up teg_1.gas_up_struct.egy_teg_end_av_up teg_1.gas_up_struct.lv_teg_ast_up teg_1.gas_up_struct.crlc_teg_bas_up teg_1.gas_up_struct.teg_add_egr_up teg_1.gas_up_struct.teg_cor_veh_up teg_1.gas_up_struct.teg_cor_tco_ex_up teg_1.gas_up_struct.fac_cor_vs_teg_up teg_1.gas_up_struct.teg_scc_tco_up teg_1.gas_up_struct.vs_cor_ecf_teg_up teg_1.gas_up_struct.vs_cor_teg_up teg_1.gas_down_struct.teg_stat_eng_down teg_1.gas_down_struct.teg_stat_bas_down teg_1.gas_down_struct.fac_cor_lamb_sp_teg_down teg_1.gas_down_struct.teg_stat_down teg_1.gas_down_struct.teg_cat_down_mdl_bas teg_1.gas_down_struct.teg_dif_down teg_1.gas_down_struct.teg_cat_down_mdl_stop teg_1.gas_down_struct.crlc_teg_grad_down teg_1.gas_down_struct.crlc_teg_level_down teg_1.gas_down_struct.crlc_teg_down teg_1.gas_down_struct.crlc_teg_toil_tco_down teg_1.gas_down_struct.crlc_teg_egy_down teg_1.gas_down_struct.egy_teg_end_sp_down teg_1.gas_down_struct.egy_teg_end_av_down teg_1.gas_down_struct.lv_teg_ast_down teg_1.gas_down_struct.crlc_teg_bas_down teg_1.gas_down_struct.teg_cor_eff_iga_down teg_1.gas_down_struct.teg_scc_tco_down teg_1.gas_down_struct.teg_cor_veh_down teg_1.gas_down_struct.fac_cor_vs_teg_down teg_1.gas_down_struct.teg_cor_tco_ex_down teg_1.gas_down_struct.vs_cor_ecf_teg_down teg_1.gas_down_struct.vs_cor_teg_down teg_1.wall_up_struct.teg_wall_stat_bas_up teg_1.wall_up_struct.fac_scc_teg_wall teg_1.wall_up_struct.fac_cor_lamb_sp_teg_wall_up teg_1.wall_up_struct.teg_wall_stat_up teg_1.wall_up_struct.teg_wall_cat_up_mdl teg_1.wall_up_struct.teg_wall_dif_up teg_1.wall_up_struct.teg_wall_cat_up_mdl_stop teg_1.wall_up_struct.crlc_teg_wall_up teg_1.wall_up_struct.crlc_teg_wall_toil_tco_up teg_1.wall_up_struct.crlc_teg_wall_egy_up teg_1.wall_up_struct.egy_teg_wall_end_sp_up teg_1.wall_up_struct.egy_teg_wall_end_av_up teg_1.wall_up_struct.crlc_teg_wall_bas_up teg_1.wall_up_struct.teg_wall_stat_eng_up teg_1.wall_up_struct.teg_wall_cor_eff_iga_up teg_1.wall_up_struct.teg_wall_scc_tco_up teg_1.wall_up_struct.teg_wall_cor_veh_up teg_1.wall_up_struct.fac_cor_vs_teg_wall_up teg_1.wall_up_struct.teg_wall_cor_tco_ex_up teg_1.wall_up_struct.vs_cor_ecf_teg_wall_up teg_1.wall_up_struct.vs_cor_teg_wall_up teg_1.wall_down_struct.teg_wall_stat_eng_down teg_1.wall_down_struct.teg_wall_stat_bas_down teg_1.wall_down_struct.fac_cor_lamb_sp_teg_wall_down teg_1.wall_down_struct.teg_wall_stat_down teg_1.wall_down_struct.teg_wall_cat_down_mdl teg_1.wall_down_struct.teg_wall_dif_down teg_1.wall_down_struct.teg_wall_cat_down_mdl_stop teg_1.wall_down_struct.crlc_teg_wall_down teg_1.wall_down_struct.crlc_teg_wall_toil_tco_down teg_1.wall_down_struct.crlc_teg_wall_egy_down teg_1.wall_down_struct.egy_teg_wall_end_sp_down teg_1.wall_down_struct.egy_teg_wall_end_av_down teg_1.wall_down_struct.crlc_teg_wall_bas_down teg_1.wall_down_struct.teg_wall_cor_eff_iga_down teg_1.wall_down_struct.teg_wall_scc_tco_down teg_1.wall_down_struct.teg_wall_cor_veh_down teg_1.wall_down_struct.fac_cor_vs_teg_wall_down teg_1.wall_down_struct.teg_wall_cor_tco_ex_down teg_1.wall_down_struct.vs_cor_ecf_teg_wall_down teg_1.wall_down_struct.vs_cor_teg_wall_down teg_2.gas_up_struct.teg_stat_eng_up teg_2.gas_up_struct.teg_cor_eff_iga_up teg_2.gas_up_struct.teg_stat_bas_up teg_2.gas_up_struct.eff_iga_av_teg_cor teg_2.gas_up_struct.fac_scc_teg teg_2.gas_up_struct.fac_cor_lamb_sp_teg_up teg_2.gas_up_struct.teg_stat_up teg_2.gas_up_struct.teg_cat_up_mdl_bas teg_2.gas_up_struct.teg_dif_up teg_2.gas_up_struct.teg_cat_up_mdl_stop teg_2.gas_up_struct.crlc_teg_grad_up teg_2.gas_up_struct.crlc_teg_level_up teg_2.gas_up_struct.crlc_teg_up teg_2.gas_up_struct.crlc_teg_toil_tco_up teg_2.gas_up_struct.crlc_teg_egy_up teg_2.gas_up_struct.egy_teg_end_sp_up teg_2.gas_up_struct.egy_teg_end_av_up teg_2.gas_up_struct.lv_teg_ast_up teg_2.gas_up_struct.crlc_teg_bas_up teg_2.gas_up_struct.teg_add_egr_up teg_2.gas_up_struct.teg_cor_veh_up teg_2.gas_up_struct.teg_cor_tco_ex_up teg_2.gas_up_struct.fac_cor_vs_teg_up teg_2.gas_up_struct.teg_scc_tco_up teg_2.gas_up_struct.vs_cor_ecf_teg_up teg_2.gas_up_struct.vs_cor_teg_up teg_2.gas_down_struct.teg_stat_eng_down teg_2.gas_down_struct.teg_stat_bas_down teg_2.gas_down_struct.fac_cor_lamb_sp_teg_down teg_2.gas_down_struct.teg_stat_down teg_2.gas_down_struct.teg_cat_down_mdl_bas teg_2.gas_down_struct.teg_dif_down teg_2.gas_down_struct.teg_cat_down_mdl_stop teg_2.gas_down_struct.crlc_teg_grad_down teg_2.gas_down_struct.crlc_teg_level_down teg_2.gas_down_struct.crlc_teg_down teg_2.gas_down_struct.crlc_teg_toil_tco_down teg_2.gas_down_struct.crlc_teg_egy_down teg_2.gas_down_struct.egy_teg_end_sp_down teg_2.gas_down_struct.egy_teg_end_av_down teg_2.gas_down_struct.lv_teg_ast_down teg_2.gas_down_struct.crlc_teg_bas_down teg_2.gas_down_struct.teg_cor_eff_iga_down teg_2.gas_down_struct.teg_scc_tco_down teg_2.gas_down_struct.teg_cor_veh_down teg_2.gas_down_struct.fac_cor_vs_teg_down teg_2.gas_down_struct.teg_cor_tco_ex_down teg_2.gas_down_struct.vs_cor_ecf_teg_down teg_2.gas_down_struct.vs_cor_teg_down teg_2.wall_up_struct.teg_wall_stat_bas_up teg_2.wall_up_struct.fac_scc_teg_wall teg_2.wall_up_struct.fac_cor_lamb_sp_teg_wall_up teg_2.wall_up_struct.teg_wall_stat_up teg_2.wall_up_struct.teg_wall_cat_up_mdl teg_2.wall_up_struct.teg_wall_dif_up teg_2.wall_up_struct.teg_wall_cat_up_mdl_stop teg_2.wall_up_struct.crlc_teg_wall_up teg_2.wall_up_struct.crlc_teg_wall_toil_tco_up teg_2.wall_up_struct.crlc_teg_wall_egy_up teg_2.wall_up_struct.egy_teg_wall_end_sp_up teg_2.wall_up_struct.egy_teg_wall_end_av_up teg_2.wall_up_struct.crlc_teg_wall_bas_up teg_2.wall_up_struct.teg_wall_stat_eng_up teg_2.wall_up_struct.teg_wall_cor_eff_iga_up teg_2.wall_up_struct.teg_wall_scc_tco_up teg_2.wall_up_struct.teg_wall_cor_veh_up teg_2.wall_up_struct.fac_cor_vs_teg_wall_up teg_2.wall_up_struct.teg_wall_cor_tco_ex_up teg_2.wall_up_struct.vs_cor_ecf_teg_wall_up teg_2.wall_up_struct.vs_cor_teg_wall_up teg_2.wall_down_struct.teg_wall_stat_eng_down teg_2.wall_down_struct.teg_wall_stat_bas_down teg_2.wall_down_struct.fac_cor_lamb_sp_teg_wall_down teg_2.wall_down_struct.teg_wall_stat_down teg_2.wall_down_struct.teg_wall_cat_down_mdl teg_2.wall_down_struct.teg_wall_dif_down teg_2.wall_down_struct.teg_wall_cat_down_mdl_stop teg_2.wall_down_struct.crlc_teg_wall_down teg_2.wall_down_struct.crlc_teg_wall_toil_tco_down teg_2.wall_down_struct.crlc_teg_wall_egy_down teg_2.wall_down_struct.egy_teg_wall_end_sp_down teg_2.wall_down_struct.egy_teg_wall_end_av_down teg_2.wall_down_struct.crlc_teg_wall_bas_down teg_2.wall_down_struct.teg_wall_cor_eff_iga_down teg_2.wall_down_struct.teg_wall_scc_tco_down teg_2.wall_down_struct.teg_wall_cor_veh_down teg_2.wall_down_struct.fac_cor_vs_teg_wall_down teg_2.wall_down_struct.teg_wall_cor_tco_ex_down teg_2.wall_down_struct.vs_cor_ecf_teg_wall_down teg_2.wall_down_struct.vs_cor_teg_wall_down teg_cor_vo_up temp_toil_dif temp_tco_ex_dif crlc_teg_toil_dif_up crlc_teg_tco_dif_up crlc_teg_toil_dif_down crlc_teg_tco_dif_down crlc_teg_wall_toil_dif_up crlc_teg_wall_tco_dif_up teg_wall_cor_vo_down teg_stat_max pow_dif_max crlc_teg_wall_tco_dif_down crlc_teg_wall_toil_dif_down vo_dif_teg teg_cor_vo_down teg_wall_cor_tco_up teg_wall_cor_vo_up teg_wall_cor_tco_down temp_tco_dif teg_cor_tco_up teg_cor_tco_down teg_cor_vs_down teg_cor_vs_up teg_wall_cor_vs_down teg_wall_cor_vs_up fac_cor_toil_dif_teg_up fac_cor_toil_dif_teg_down fac_cor_toil_dif_teg_wall_up fac_cor_toil_dif_teg_wall_down fac_cor_tco_teg_up fac_cor_tco_teg_wall_up fac_cor_tco_teg_down fac_cor_tco_teg_wall_down /end OUT_MEASUREMENT
/end FUNCTION
/begin FUNCTION INJ_Detection_of_dew_point "_Detection of dew point"
 /begin DEF_CHARACTERISTIC c_delta_tia c_t_es_dew_min c_t_es_dew_max c_tco_st c_tco_es_dew c_t_es_dif_dew c_fac_egy_dew_stop ip_egy_dew_end_st_up ip_egy_dew_end_st_down c_teg_wall_red c_teg_wall_dew_st c_teg_wall_hys /end DEF_CHARACTERISTIC
 /begin OUT_MEASUREMENT teg_1.dew_point_struct.lv_teg_min_thd teg_1.dew_point_struct.lv_teg_cat_down_min_thd teg_1.dew_point_struct.lv_teg_cat_up_min_thd teg_2.dew_point_struct.lv_teg_min_thd teg_2.dew_point_struct.lv_teg_cat_down_min_thd teg_2.dew_point_struct.lv_teg_cat_up_min_thd tam_dew t_es_dew egy_dew_stop_up egy_dew_stop_down egy_dew_end_down egy_dew_end_up egy_dew_up egy_dew_down tam_ref_teg /end OUT_MEASUREMENT
/end FUNCTION
/begin FUNCTION INJ_Cylinder_selective_mixture_c "_Cylinder-selective mixture control and Adaptation function"
 /begin DEF_CHARACTERISTIC c_vls_min_cyl_lam c_vls_max_cyl_lam c_vls_dif_max_cyl_lam c_ti_min_cyl_lam c_ti_max_cyl_lam c_ti_cyl_lam_dec c_ti_ad_min_cyl_lam c_ti_ad_max_cyl_lam c_mff_add_cp_max_cyl_lam_ad ip_fac_frq_1_cyl_lam ip_fac_frq_2_cyl_lam ip_fac_maf_1_cyl_lam ip_fac_maf_2_cyl_lam ip_vls_dif_val ip_maf_min_cyl_lam_ad ip_maf_max_cyl_lam_ad ip_ti_ad_cyl ip_dly_cyl_lam_1 ip_dly_cyl_lam_2 ip_ti_cyl ip_fac_vls_dif_lamb /end DEF_CHARACTERISTIC
 /begin OUT_MEASUREMENT cyl_ad_struct[0].bf.lv_ad_cyl_lam_act cyl_ad_struct[0].vls_cyc_ratio_mv cyl_ad_struct[1].bf.lv_ad_cyl_lam_act cyl_ad_struct[1].vls_cyc_ratio_mv crk_cyl_lam[0] crk_cyl_lam[1] crk_cyl_lam[2] crk_cyl_lam[3] crk_cyl_lam[4] crk_cyl_lam[5] vls_dly[0] vls_dly[1] vls_dly[2] vls_dly[3] vls_dly[4] vls_dly[5] vls_dif_val[0] vls_dif_val[1] vls_dif_val[2] vls_dif_val[3] vls_dif_val[4] vls_dif_val[5] ti_cyl_lam[0] ti_cyl_lam[1] ti_cyl_lam[2] ti_cyl_lam[3] ti_cyl_lam[4] ti_cyl_lam[5] ti_ad_cyl_lam[0] ti_ad_cyl_lam[1] ti_ad_cyl_lam[2] ti_ad_cyl_lam[3] ti_ad_cyl_lam[4] ti_ad_cyl_lam[5] /end OUT_MEASUREMENT
/end FUNCTION
/begin FUNCTION INJ_Injection_at_restart_fuel_fe "_Injection at restart fuel feed"
 /begin DEF_CHARACTERISTIC id_fac_mff_tco_neg_wf id_fac_mff_tco_pos_wf ip_fac_mff_map_wf id_fac_ti_ris id_fac_ti_rpl id_mff_inc_wf id_mff_dec_wf /end DEF_CHARACTERISTIC
 /begin OUT_MEASUREMENT mff_add_reac_cyl[0] mff_add_reac_cyl[1] mff_add_reac_cyl[2] mff_add_reac_cyl[3] mff_add_reac_cyl[4] mff_add_reac_cyl[5] mff_dif_wf[0] mff_dif_wf[1] mff_dif_wf[2] mff_dif_wf[3] mff_dif_wf[4] mff_dif_wf[5] fac_ti_reac[0] fac_ti_reac[1] fac_ti_reac[2] fac_ti_reac[3] fac_ti_reac[4] fac_ti_reac[5] /end OUT_MEASUREMENT
/end FUNCTION
/begin FUNCTION INJ_Catalyst_enrichment_function "_Catalyst enrichment function"
 /begin DEF_CHARACTERISTIC c_vls_down_puc_act_max c_maf_int_puc_min c_maf_int_pcat_purge_sa c_maf_int_pcat_purge_hst c_maf_int_pcat_purge_ch c_fac_add_pcat_main_cat_puc_sa c_fac_add_pcat_main_cat_puc_hst c_fac_add_pcat_main_cat_puc_ch c_delta_lamb_sp_puc_inc c_delta_lamb_sp_puc_dec ip_delta_lamb_sp_puc ip_maf_int_act_puc ip_fac_cat_eff_puc ip_fac_pcat_main_cat_puc c_maf_int_act_puc_max c_tco_thd_hst c_quo_maf_int_puc_afl /end DEF_CHARACTERISTIC
 /begin OUT_MEASUREMENT lam_bank_1.lam_puc.bf.lv_act_int_puc lam_bank_1.lam_puc.bf.lv_pcat_purge_puc lam_bank_1.lam_puc.bf.lv_pcat_purge_sa lam_bank_1.lam_puc.bf.lv_pcat_purge_hst lam_bank_1.lam_puc.bf.lv_pcat_purge_ch lam_bank_1.lam_puc.bf.lv_main_cat_purge lam_bank_1.lam_puc.bf.lv_vls_down_puc_act_max lam_bank_1.lam_puc.bf.lv_down_ramp_act lam_bank_1.lam_puc.bf.lv_puc_trig lam_bank_1.lam_puc.maf_int_act_puc lam_bank_1.lam_puc.maf_int_cat_load lam_bank_1.lam_puc.maf_int_cat_load_main lam_bank_1.lam_puc.maf_int_purge_rest lam_bank_1.lam_puc.maf_int_sample_step lam_bank_1.lam_puc.maf_int_tot_purge lam_bank_1.lam_puc.fac_add_pcat_main_cat_puc lam_bank_1.lam_puc.quo_maf_int_purge lam_bank_1.lam_puc.delta_lamb_sp_puc lam_bank_2.lam_puc.bf.lv_act_int_puc lam_bank_2.lam_puc.bf.lv_pcat_purge_puc lam_bank_2.lam_puc.bf.lv_pcat_purge_sa lam_bank_2.lam_puc.bf.lv_pcat_purge_hst lam_bank_2.lam_puc.bf.lv_pcat_purge_ch lam_bank_2.lam_puc.bf.lv_main_cat_purge lam_bank_2.lam_puc.bf.lv_vls_down_puc_act_max lam_bank_2.lam_puc.bf.lv_down_ramp_act lam_bank_2.lam_puc.bf.lv_puc_trig lam_bank_2.lam_puc.maf_int_act_puc lam_bank_2.lam_puc.maf_int_cat_load lam_bank_2.lam_puc.maf_int_cat_load_main lam_bank_2.lam_puc.maf_int_purge_rest lam_bank_2.lam_puc.maf_int_sample_step lam_bank_2.lam_puc.maf_int_tot_purge lam_bank_2.lam_puc.fac_add_pcat_main_cat_puc lam_bank_2.lam_puc.quo_maf_int_purge lam_bank_2.lam_puc.delta_lamb_sp_puc maf_int_puc /end OUT_MEASUREMENT
/end FUNCTION
/end MODULE
/end PROJECT
