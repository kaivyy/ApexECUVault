ASAP2_VERSION 1 4
/begin PROJECT P_558 "EDC17_CP02"
/begin HEADER "" VERSION "V1C1" PROJECT_NO P_558 /end HEADER
/begin MODULE DIM ""
/begin MOD_COMMON "" BYTE_ORDER MSB_LAST ALIGNMENT_BYTE 1 ALIGNMENT_WORD 2 ALIGNMENT_LONG 4 ALIGNMENT_FLOAT32_IEEE 4 /end MOD_COMMON
/begin CHARACTERISTIC Air_dpGradLimPCACDs_C "Verhältnisgrenze von dem Anstieg und Ausfall des linearisierten Ladeluftkühlerdrucks" VALUE 0x8006FFD4 Kw_Ws16 4900.000 PreshPa_10ms 100.0000 5000.000 FORMAT "%8.3" EXTENDED_LIMITS -3276800. 3276700. /end CHARACTERISTIC
/begin CHARACTERISTIC Air_nLimPCACDs_C "Motordrehzahlgrenze für die Plausibilitätsprüfung von CACDsP" VALUE 0x8006FFD6 Kw_Ws16 6000.000 EngN 0.00 6000.000 FORMAT "%8.3" EXTENDED_LIMITS -16384.00 16383.50 /end CHARACTERISTIC
/begin CHARACTERISTIC Air_ParCACDsDT1.T1_C "/" VALUE 0x8004B43C Kw_Ws32 4294.9672940 TimeDelay_s 0.000002000000001 4294.9672960 FORMAT "%12.7" /end CHARACTERISTIC
/begin CHARACTERISTIC Air_ParCACDsDT1.Kd_C "/" VALUE 0x8004B440 Kw_Ws32 65535.9999847 Kd -32768.0000000 32767.9999847 FORMAT "%13.7" /end CHARACTERISTIC
/begin CHARACTERISTIC Air_pDiffLimPCACDs_C "Differenzgrenze des Ladeluftkühlerdrucks und des Atmosphärendrucks für Plausibilitätsfehler." VALUE 0x8006FFD8 Kw_Ws16 3500.000 Pres_hPa 0.00 3500.000 FORMAT "%8.3" EXTENDED_LIMITS -32768.00 32767.00 /end CHARACTERISTIC
/begin CHARACTERISTIC Air_pTransfPCACDs_CUR "Kennlinie zum Umwandlung der erfassten Spannung in den erfassten Druck." CURVE 0x8006FF64 Cur_Xs16Ws16 3500.000 Pres_hPa 0.00 3500.000 FORMAT "%8.3" EXTENDED_LIMITS -32768.00 32767.00
 /begin AXIS_DESCR STD_AXIS Air_uRawPCACDs Volt 25 0.00 5000.000 FORMAT "%8.3" EXTENDED_LIMITS -6553.600 6553.400 DEPOSIT ABSOLUTE /end AXIS_DESCR
/end CHARACTERISTIC
/begin CHARACTERISTIC Air_RmpSlpPCACDs.Pos_C "/" VALUE 0x8004B444 Kw_Ws32 32767949.9817 RmpPres_hPa 50.0030517578 32767999.9847 FORMAT "%13.4" EXTENDED_LIMITS -32768000.0000 32767999.9847 /end CHARACTERISTIC
/begin CHARACTERISTIC Air_RmpSlpPCACDs.Neg_C "/" VALUE 0x8004B448 Kw_Ws32 32767949.9817 RmpPres_hPa 50.0030517578 32767999.9847 FORMAT "%13.4" EXTENDED_LIMITS -32768000.0000 32767999.9847 /end CHARACTERISTIC
/begin CHARACTERISTIC Air_RmpSlpTCACDs.Pos_C "/" VALUE 0x8004B4C4 Kw_Ws32 3276798.99750 RmpTemp 1.00097656250 3276799.99847 FORMAT "%13.5" EXTENDED_LIMITS -3276800.00000 3276799.99847 /end CHARACTERISTIC
/begin CHARACTERISTIC Air_RmpSlpTCACDs.Neg_C "/" VALUE 0x8004B4C8 Kw_Ws32 3276798.99750 RmpTemp 1.00097656250 3276799.99847 FORMAT "%13.5" EXTENDED_LIMITS -3276800.00000 3276799.99847 /end CHARACTERISTIC
/begin CHARACTERISTIC Air_SRCPCACDs.uMin_C "/" VALUE 0x8006FFCA Kw_Ws16 5200.000 Volt 0.00 5200.000 FORMAT "%8.3" EXTENDED_LIMITS -6553.600 6553.400 /end CHARACTERISTIC
/begin CHARACTERISTIC Air_SRCPCACDs.uMax_C "/" VALUE 0x8006FFCC Kw_Ws16 5200.000 Volt 0.00 5200.000 FORMAT "%8.3" EXTENDED_LIMITS -6553.600 6553.400 /end CHARACTERISTIC
/begin CHARACTERISTIC Air_SRCTCACDs.uMin_C "/" VALUE 0x8004B458 Kw_Ws16 5200.000 Volt 0.00 5200.000 FORMAT "%8.3" EXTENDED_LIMITS -6553.600 6553.400 /end CHARACTERISTIC
/begin CHARACTERISTIC Air_SRCTCACDs.uMax_C "/" VALUE 0x8004B45A Kw_Ws16 5200.000 Volt 0.00 5200.000 FORMAT "%8.3" EXTENDED_LIMITS -6553.600 6553.400 /end CHARACTERISTIC
/begin CHARACTERISTIC Air_swtSensPresPCACDs_C "Sensorschalter für den Drucksensor des Ladeluftkühlers." VALUE 0x8004B44C Val_Wu8 1.000 OneToOne 0.00 1.000 FORMAT "%5.3" EXTENDED_LIMITS 0.00 255.0 /end CHARACTERISTIC
/begin CHARACTERISTIC Air_swtSensPresTCACDs_C "Schalter zur Anzeige von dem Vorhandensein oder Nichtvorhandensein des Sensors" VALUE 0x8004B4CC Val_Wu8 1.000 OneToOne 0.00 1.000 FORMAT "%5.3" EXTENDED_LIMITS 0.00 255.0 /end CHARACTERISTIC
/begin CHARACTERISTIC Air_swtSigPCACDs_C "Schalter zur Auswahl der Drucksignalquelle" VALUE 0x8006FFCE Val_Wu8 255.0 OneToOne 0.00 255.0 FORMAT "%5.1" /end CHARACTERISTIC
/begin CHARACTERISTIC Air_swtSigTCACDs_C "Schalter zur Auswahl der Signalquelle" VALUE 0x8004B45C Val_Wu8 255.0 OneToOne 0.00 255.0 FORMAT "%5.1" /end CHARACTERISTIC
/begin CHARACTERISTIC Air_tDflOffsTCACDs_C "Der zur Berechnung des Modellwerts zu addierenden Offsetwert" VALUE 0x8004B4D8 Kw_Ws16 250.0000 Temp_Cels -50.14000 199.8600 FORMAT "%8.4" EXTENDED_LIMITS -3549.940 3003.560 /end CHARACTERISTIC
/begin CHARACTERISTIC Air_tiLPFiltPT1TCACDs_C "Zeitkonstante für PT1-Filter" VALUE 0x8004B4D0 Val_Ws32 4294.9672940 TimeDelay_s 0.000002000000001 4294.9672960 FORMAT "%12.7" /end CHARACTERISTIC
/begin CHARACTERISTIC Air_tiPT1T1PCACDs_C "PT1-Filterzeitkonstante zur Filterung der ADC-Spannung." VALUE 0x8006FFD0 Kw_Ws32 4294.9672940 TimeDelay_s 0.000002000000001 4294.9672960 FORMAT "%12.7" /end CHARACTERISTIC
/begin CHARACTERISTIC Air_tiPT1T1SigPCACDs_C "PT1-Filterzeitkonstante zur Filterung des erfassten Druckwerts." VALUE 0x8004B450 Val_Ws32 4294.9672940 TimeDelay_s 0.000002000000001 4294.9672960 FORMAT "%12.7" /end CHARACTERISTIC
/begin CHARACTERISTIC Air_TransStageParPCACDs.Dfl_C "/" VALUE 0x8004B454 Kw_Ws16 3500.000 Pres_hPa 0.00 3500.000 FORMAT "%8.3" EXTENDED_LIMITS -32768.00 32767.00 /end CHARACTERISTIC
/begin CHARACTERISTIC Air_TransStageParPCACDs.stSensId_C "/" VALUE 0x8004B456 Kw_Wu8 255.0 OneToOne 0.00 255.0 FORMAT "%5.1" /end CHARACTERISTIC
/begin CHARACTERISTIC Air_TransStgTCACDs.Dfl_C "/" VALUE 0x8004B4D4 Kw_Ws16 250.0000 Temp_Cels -50.14000 199.8600 FORMAT "%8.4" EXTENDED_LIMITS -3549.940 3003.560 /end CHARACTERISTIC
/begin CHARACTERISTIC Air_TransStgTCACDs.stSensId_C "/" VALUE 0x8004B4D6 Kw_Wu8 255.0 OneToOne 0.00 255.0 FORMAT "%5.1" /end CHARACTERISTIC
/begin CHARACTERISTIC Air_tTransfTCACDs_CUR "Kennlinie zur Umwandlung der Eingangsspannung in die Temperatur" CURVE 0x8004B45E Cur_Xs16Ws16 250.0000 Temp_Cels -50.04000 199.9600 FORMAT "%8.4" EXTENDED_LIMITS -3549.940 3003.560
 /begin AXIS_DESCR STD_AXIS Air_uRawTCACDs Volt 25 0.00 5200.000 FORMAT "%8.3" EXTENDED_LIMITS -6553.600 6553.400 DEPOSIT ABSOLUTE /end AXIS_DESCR
/end CHARACTERISTIC
/begin CHARACTERISTIC Calwup_swtWakeupEnaCpl_C "" VALUE 0x8006FFDA Val_Wu8 255.0 OneToOne 0.00 255.0 FORMAT "%5.1" /end CHARACTERISTIC
/begin CHARACTERISTIC Calwup_swtWakeupEna_C "" VALUE 0x8006FFDB Val_Wu8 255.0 OneToOne 0.00 255.0 FORMAT "%5.1" /end CHARACTERISTIC
/begin CHARACTERISTIC CByVlv_DigOut.tiBtwTstSCB_C "/" VALUE 0x8004B4DA Kw_Ws16 655350.0 Time_ms -327680.0 327670.0 FORMAT "%8.1" /end CHARACTERISTIC
/begin CHARACTERISTIC CByVlv_DigOut.tiBtwTstOT_C "/" VALUE 0x8004B4DC Kw_Ws16 655.3500 Time_s -327.6800 327.6700 FORMAT "%8.4" /end CHARACTERISTIC
/begin CHARACTERISTIC CByVlv_DigOut.numTstMax_C "/" VALUE 0x8004B4DE Kw_Wu16 65535.00 OneToOne 0.00 65535.00 FORMAT "%8.2" /end CHARACTERISTIC
/begin CHARACTERISTIC CByVlv_stPsDiaDisbl_C "Maske zur Auswahl der Sperrbedingungen von der Diagnose" VALUE 0x8004B4E0 Val_Wu8 255.0 OneToOne 0.00 255.0 FORMAT "%5.1" /end CHARACTERISTIC
/begin CHARACTERISTIC CByVlv_stPsDisbl_C "Maske zur Auswahl der Sperrbedingungen von der Endstufe" VALUE 0x8004B4E1 Val_Wu8 255.0 OneToOne 0.00 255.0 FORMAT "%5.1" /end CHARACTERISTIC
/begin CHARACTERISTIC CcpAcquisitionConfig "" VAL_BLK 0x8006FFDC ValA_Wu8 255.0 OneToOne 0.00 255.0 FORMAT "%5.1" READ_ONLY NUMBER 2 /end CHARACTERISTIC
/begin CHARACTERISTIC CEngDsT_dtMinDynTst_C "" VALUE 0x8004B56C Val_Ws16 6553.500 TempDiff_Kelv -3276.800 3276.700 FORMAT "%8.3" /end CHARACTERISTIC
/begin CHARACTERISTIC CEngDsT_nMinEnaDynTst_C "" VALUE 0x8004B56E Val_Ws16 6000.000 EngN 0.00 6000.000 FORMAT "%8.3" EXTENDED_LIMITS -16384.00 16383.50 /end CHARACTERISTIC
/begin CHARACTERISTIC CEngDsT_qMinEnaDynTst_C "" VALUE 0x8004B570 Val_Ws16 327.6700 InjMass 0.00 327.6700 FORMAT "%8.4" EXTENDED_LIMITS -327.6800 327.6700 /end CHARACTERISTIC
/begin CHARACTERISTIC CEngDsT_Rmp1.Pos_C "/" VALUE 0x8004B550 Kw_Ws32 3276798.99750 RmpTemp 1.00097656250 3276799.99847 FORMAT "%13.5" EXTENDED_LIMITS -3276800.00000 3276799.99847 /end CHARACTERISTIC
/begin CHARACTERISTIC CEngDsT_Rmp1.Neg_C "/" VALUE 0x8004B554 Kw_Ws32 3276798.99750 RmpTemp 1.00097656250 3276799.99847 FORMAT "%13.5" EXTENDED_LIMITS -3276800.00000 3276799.99847 /end CHARACTERISTIC
/begin CHARACTERISTIC CEngDsT_Rmp2.Pos_C "/" VALUE 0x8004B558 Kw_Ws32 3276798.99750 RmpTemp 1.00097656250 3276799.99847 FORMAT "%13.5" EXTENDED_LIMITS -3276800.00000 3276799.99847 /end CHARACTERISTIC
/begin CHARACTERISTIC CEngDsT_Rmp2.Neg_C "/" VALUE 0x8004B55C Kw_Ws32 3276798.99750 RmpTemp 1.00097656250 3276799.99847 FORMAT "%13.5" EXTENDED_LIMITS -3276800.00000 3276799.99847 /end CHARACTERISTIC
/begin CHARACTERISTIC CEngDsT_SRC.uMin_C "/" VALUE 0x8004B4E2 Kw_Ws16 5200.000 Volt 0.00 5200.000 FORMAT "%8.3" EXTENDED_LIMITS -6553.600 6553.400 /end CHARACTERISTIC
/begin CHARACTERISTIC CEngDsT_SRC.uMax_C "/" VALUE 0x8004B4E4 Kw_Ws16 5200.000 Volt 0.00 5200.000 FORMAT "%8.3" EXTENDED_LIMITS -6553.600 6553.400 /end CHARACTERISTIC
/begin CHARACTERISTIC CEngDsT_stSensID_C "" VALUE 0x8004B560 Kw_Wu8 255.0 OneToOne 0.00 255.0 FORMAT "%5.1" /end CHARACTERISTIC
/begin CHARACTERISTIC CEngDsT_swtSensPres_C "" VALUE 0x8004B4E6 Val_Wu8 1.000 OneToOne 0.00 1.000 FORMAT "%5.3" EXTENDED_LIMITS 0.00 255.0 /end CHARACTERISTIC
/begin CHARACTERISTIC CEngDsT_swtSig_C "" VALUE 0x8004B4E7 Val_Wu8 255.0 OneToOne 0.00 255.0 FORMAT "%5.1" /end CHARACTERISTIC
/begin CHARACTERISTIC CEngDsT_tDflCold_C "" VALUE 0x8004B562 Kw_Ws16 250.0000 Temp_Cels -50.04000 199.9600 FORMAT "%8.4" EXTENDED_LIMITS -3549.940 3003.560 /end CHARACTERISTIC
/begin CHARACTERISTIC CEngDsT_tDflWarm_C "" VALUE 0x8004B564 Kw_Ws16 250.0000 Temp_Cels -50.04000 199.9600 FORMAT "%8.4" EXTENDED_LIMITS -3549.940 3003.560 /end CHARACTERISTIC
/begin CHARACTERISTIC CEngDsT_tiMaxDynTst_CUR "" CURVE 0x8004B572 Cur_Xs16Ws16 167769.6 Time_DynTst -83886.08 83883.52 FORMAT "%8.2"
 /begin AXIS_DESCR STD_AXIS CEngDsT_tStrt Temp_Cels 10 -50.14000 149.8600 FORMAT "%8.4" EXTENDED_LIMITS -3549.940 3003.560 DEPOSIT ABSOLUTE /end AXIS_DESCR
/end CHARACTERISTIC
/begin CHARACTERISTIC CEngDsT_tiPT1T1_C "" VALUE 0x8004B568 Val_Ws32 4294.9672940 TimeDelay_s 0.000002000000001 4294.9672960 FORMAT "%12.7" /end CHARACTERISTIC
/begin CHARACTERISTIC CEngDsT_tMinDynTst_C "" VALUE 0x8004B59C Val_Ws16 200.0000 Temp_Cels -50.14000 149.8600 FORMAT "%8.4" EXTENDED_LIMITS -3549.940 3003.560 /end CHARACTERISTIC
/begin CHARACTERISTIC CEngDsT_tTransf_CUR "" CURVE 0x8004B4E8 Cur_Xs16Ws16 250.0000 Temp_Cels -50.04000 199.9600 FORMAT "%8.4" EXTENDED_LIMITS -3549.940 3003.560
 /begin AXIS_DESCR STD_AXIS CEngDsT_uRaw Volt 25 0.00 5200.000 FORMAT "%8.3" EXTENDED_LIMITS -6553.600 6553.400 DEPOSIT ABSOLUTE /end AXIS_DESCR
/end CHARACTERISTIC
/begin CHARACTERISTIC CEngUsT_RmpSlp.Pos_C "/" VALUE 0x8004B608 Kw_Ws32 3276799.99847 RmpTemp 0.00 3276799.99847 FORMAT "%13.5" EXTENDED_LIMITS -3276800.00000 3276799.99847 /end CHARACTERISTIC
/begin CHARACTERISTIC CEngUsT_RmpSlp.Neg_C "/" VALUE 0x8004B60C Kw_Ws32 3276799.99847 RmpTemp 0.00 3276799.99847 FORMAT "%13.5" EXTENDED_LIMITS -3276800.00000 3276799.99847 /end CHARACTERISTIC
/begin CHARACTERISTIC CEngUsT_SRC.uMin_C "/" VALUE 0x8004B59E Val_Ws16 250.0000 Volt 0.00 250.0000 FORMAT "%8.4" EXTENDED_LIMITS -6553.600 6553.400 /end CHARACTERISTIC
/begin CHARACTERISTIC CEngUsT_SRC.uMax_C "/" VALUE 0x8004B5A0 Val_Ws16 600.0000 Volt 4200.000 4800.000 FORMAT "%8.3" EXTENDED_LIMITS -6553.600 6553.400 /end CHARACTERISTIC
/begin CHARACTERISTIC CEngUsT_TransStagePar.Dfl_C "/" VALUE 0x8004B610 Kw_Ws16 250.0000 Temp_Cels -50.04000 199.9600 FORMAT "%8.4" EXTENDED_LIMITS -3549.940 3003.560 /end CHARACTERISTIC
/begin CHARACTERISTIC CEngUsT_TransStagePar.stSensId_C "/" VALUE 0x8004B612 Kw_Wu8 255.0 OneToOne 0.00 255.0 FORMAT "%5.1" /end CHARACTERISTIC
/begin CHARACTERISTIC CEngUsT_tTransf_CUR "" CURVE 0x8004B5A2 Cur_Xs16Ws16 225.0000 Temp_Cels -45.04000 179.9600 FORMAT "%8.4" EXTENDED_LIMITS -3549.940 3003.560
 /begin AXIS_DESCR STD_AXIS CEngUsT_uRaw Volt 25 0.00 4800.000 FORMAT "%8.3" EXTENDED_LIMITS -6553.600 6553.400 DEPOSIT ABSOLUTE /end AXIS_DESCR
/end CHARACTERISTIC
/begin CHARACTERISTIC Clth_Deb.tiHiLo_C "/" VALUE 0x8004B66E Kw_Ws16 655350.0 TimeDeb -327680.0 327670.0 FORMAT "%8.1" /end CHARACTERISTIC
/begin CHARACTERISTIC Clth_Deb.tiLoHi_C "/" VALUE 0x8004B670 Kw_Ws16 655350.0 TimeDeb -327680.0 327670.0 FORMAT "%8.1" /end CHARACTERISTIC
/begin CHARACTERISTIC Clth_nNoGearShftDet_C "Motordrehzahlschwelle zur Erkennung der Gangänderung" VALUE 0x8004B678 Val_Ws16 6000.000 EngN 0.00 6000.000 FORMAT "%8.3" EXTENDED_LIMITS -16384.00 16383.50 /end CHARACTERISTIC
/begin CHARACTERISTIC Clth_stDflVal_C "Vorgabewert des Kupplungssignals im Fehlerfall" VALUE 0x8004B67A Val_Wu8 255.0 OneToOne 0.00 255.0 FORMAT "%5.1" /end CHARACTERISTIC
/begin CHARACTERISTIC Clth_stOpn_C "Bitmaske zur Erkennung von dem offenen Kupplungsstatus" VALUE 0x8004B672 Val_Wu8 255.0 OneToOne 0.00 255.0 FORMAT "%5.1" /end CHARACTERISTIC
/begin CHARACTERISTIC Clth_stSlipClsd_C "Bitmaske zur Erkennung des Schlupfs bei geschlossener Kupplung" VALUE 0x8004B673 Val_Wu8 255.0 OneToOne 0.00 255.0 FORMAT "%5.1" /end CHARACTERISTIC
/begin CHARACTERISTIC Clth_stSlipOpn_C "Bitmaske zur Erkennung des Schlupfs bei offener Kupplung" VALUE 0x8004B674 Val_Wu8 255.0 OneToOne 0.00 255.0 FORMAT "%5.1" /end CHARACTERISTIC
/begin CHARACTERISTIC Clth_stSlip_C "Bitmaske zur Erkennung von dem Vorhandensein eines Schlupfs in der Kupplung" VALUE 0x8004B675 Val_Wu8 255.0 OneToOne 0.00 255.0 FORMAT "%5.1" /end CHARACTERISTIC
/begin CHARACTERISTIC Clth_swtSig_C "Schalter zur Auswahl der Kupplungssignalquelle" VALUE 0x8004B676 Val_Wu8 255.0 OneToOne 0.00 255.0 FORMAT "%5.1" /end CHARACTERISTIC
/begin CHARACTERISTIC Clth_tiGearShft_C "Zeit zur Erkennung eines Gangwechsels" VALUE 0x8004B67C Val_Ws16 327570.0 Time_ms 0.00 327570.0 FORMAT "%8.1" EXTENDED_LIMITS -327680.0 327670.0 /end CHARACTERISTIC
/begin CHARACTERISTIC Clth_vNoGearShftDet_C "Fahrgeschwindigkeitsschwelle zur Erkennung der Gangänderung" VALUE 0x8004B67E Val_Ws16 300.0000 Vel 0.00 300.0000 FORMAT "%8.4" EXTENDED_LIMITS -327.6800 327.6700 /end CHARACTERISTIC
/begin CHARACTERISTIC CmbChb_ctEngRevPerBlk_C "Blockgroesse (UpM) f. Ausbl./Test/Ausw.verz." VALUE 0x8004B680 Val_Ws16 65535.00 OneToOne -32768.00 32767.00 FORMAT "%8.2" /end CHARACTERISTIC
/begin CHARACTERISTIC CmbChb_ctMisfMax_C "maximale Anzahl von Aussetzern pro Test" VALUE 0x8004B682 Val_Ws16 65535.00 OneToOne -32768.00 32767.00 FORMAT "%8.2" /end CHARACTERISTIC
/begin CHARACTERISTIC CmbChb_ctMisfTempSel_C "Auszulesende Motortemperatur aus dem Motortemperaturenfeld" VALUE 0x8004B692 Val_Wu8 2.00000000000 EngTempFldSel 0.00 2.00000000000 FORMAT "%13.11" /end CHARACTERISTIC
/begin CHARACTERISTIC CmbChb_ctSegTDC1_C "Offset für internen Segmentzähler in Aussetzererkennung" VALUE 0x8004B684 Val_Ws16 24.00000 OneToOne 0.00 24.00000 FORMAT "%8.5" EXTENDED_LIMITS -32768.00 32767.00 /end CHARACTERISTIC
/begin CHARACTERISTIC CmbChb_nEngThresHi_C "maximale Drehzahl fuer Ueberwachung" VALUE 0x8004B694 Val_Ws16 6000.000 EngN1 0.00 6000.000 FORMAT "%8.3" EXTENDED_LIMITS -16384.00 16383.50 /end CHARACTERISTIC
/begin CHARACTERISTIC CmbChb_nEngThresLo_C "minimale Drehzahl fuer Ueberwachung" VALUE 0x8004B696 Val_Ws16 6000.000 EngN1 0.00 6000.000 FORMAT "%8.3" EXTENDED_LIMITS -16384.00 16383.50 /end CHARACTERISTIC
/begin CHARACTERISTIC CmbChb_numBlk_C "Blockanzahl fuer Test" VALUE 0x8004B686 Val_Ws16 65535.00 OneToOne -32768.00 32767.00 FORMAT "%8.2" /end CHARACTERISTIC
/begin CHARACTERISTIC CmbChb_phiSegLngth_CA "Segmentlänge für gerade und ungerade Segmente" VAL_BLK 0x8004B688 ValA_Ws16 113.9976 AngleCrS 5.998718 119.9963 FORMAT "%8.4" EXTENDED_LIMITS -720.0220 720.0000 NUMBER 2 /end CHARACTERISTIC
/begin CHARACTERISTIC CmbChb_phiSegPosOfs_CA "Segmentoffset für Berechnung Segment-Endposition" VAL_BLK 0x8004B68C ValA_Ws16 119.9963 AngleCrS 0.00 119.9963 FORMAT "%8.4" EXTENDED_LIMITS -720.0220 720.0000 NUMBER 2 /end CHARACTERISTIC
/begin CHARACTERISTIC CmbChb_qSetThresHi_C "obere Mengenschwelle für Aktivierung Aussetzererkennung" VALUE 0x8004B698 Val_Ws16 655.3500 InjMass -327.6800 327.6700 FORMAT "%8.4" /end CHARACTERISTIC
/begin CHARACTERISTIC CmbChb_qSetThresLo_C "untere Mengenschwelle für Aktivierung Aussetzererkennung" VALUE 0x8004B69A Val_Ws16 655.3500 InjMass -327.6800 327.6700 FORMAT "%8.4" /end CHARACTERISTIC
/begin CHARACTERISTIC CmbChb_rSpdIncrMin_C "Verhältnis minimaler zu durchschnittlicher Drehzahlanstieg" VALUE 0x8004B690 Val_Ws16 799.9878 Prc -400.0000 399.9878 FORMAT "%8.4" /end CHARACTERISTIC
/begin CHARACTERISTIC CmbChb_stClth_C "Schalter: Aktivierung der Aussetzererkennung abhängig vom Kupplungszustand" VALUE 0x8004B69C Val_Wu8 3.000 default 0.00 3.000 FORMAT "%5.3" EXTENDED_LIMITS 0.00 255.0 /end CHARACTERISTIC
/begin CHARACTERISTIC CmbChb_tEngThresLo_C "minimale Motortemperatur für Aktivierung Aussetzererkennung" VALUE 0x8004B69E Val_Ws16 3003.700 Temp_Cels -0.1400000 3003.560 FORMAT "%8.3" EXTENDED_LIMITS -3549.940 3003.560 /end CHARACTERISTIC
/begin CHARACTERISTIC CmbChb_tiDebClthChng_C "Entprellzeit für die Zustandsänderung des Kupplungssignals" VALUE 0x8004B6A0 Val_Ws16 655350.0 Time_ms -327680.0 327670.0 FORMAT "%8.1" /end CHARACTERISTIC
/begin CHARACTERISTIC CmbChb_tiDelStrt_C "Startausblendezeit für Aussetzererkennung" VALUE 0x8004B6A2 Val_Ws16 655350.0 Time_ms -327680.0 327670.0 FORMAT "%8.1" /end CHARACTERISTIC
/begin CHARACTERISTIC CmbChb_vThresHi_C "maximale Geschwindigkeit fuer Ueberwachung" VALUE 0x8004B6A4 Val_Ws16 327.6700 Vel 0.00 327.6700 FORMAT "%8.4" EXTENDED_LIMITS -327.6800 327.6700 /end CHARACTERISTIC
/begin CHARACTERISTIC CnvSet_eta0_C "Umrechnungswirkungsgrad während Start" VALUE 0x8004B6A6 Val_Ws16 100.0000 Eta3 0.00 100.0000 FORMAT "%8.4" EXTENDED_LIMITS -256.0000 255.9922 /end CHARACTERISTIC
/begin CHARACTERISTIC CoEng_AftRunShOff_C "" VALUE 0x8004B6AC Val_Wu32 4294967295.00 OneToOne 0.00 4294967295.00 FORMAT "%13.2" /end CHARACTERISTIC
/begin CHARACTERISTIC CoEng_nThresCranking_C "" VALUE 0x8004B6B4 Val_Ws16 32767.50 EngN -16384.00 16383.50 FORMAT "%8.2" /end CHARACTERISTIC
/begin CHARACTERISTIC CoEng_nThresNrml2Strt_C "Motordrehzahlschwelle für Zustandsübergang von NORMAL nach START" VALUE 0x8004B6B6 Val_Ws16 8000.000 EngN 0.00 8000.000 FORMAT "%8.3" EXTENDED_LIMITS -16384.00 16383.50 /end CHARACTERISTIC
/begin CHARACTERISTIC CoEng_stShOffAftRun_C "Abschaltanforderungen im Nachlauf" VALUE 0x8004B6B8 Val_Wu32 4294967295.00 OneToOne 0.00 4294967295.00 FORMAT "%13.2" /end CHARACTERISTIC
/begin CHARACTERISTIC CoEng_stShutOffInit_C "" VALUE 0x8004B6B0 Val_Wu32 4294967295.00 OneToOne 0.00 4294967295.00 FORMAT "%13.2" /end CHARACTERISTIC
/begin CHARACTERISTIC CoEng_tiNrml2Strt_C "Entprellzeit für Zustandsübergang von NORMAL nach START" VALUE 0x8004B6BC Val_Ws16 655350.0 Time_ms -327680.0 327670.0 FORMAT "%8.1" /end CHARACTERISTIC
/begin CHARACTERISTIC CoEng_tiPwrStgDiaRdy_C "Verzoegerungszeit, um im Nachlauf abgeschaltete Steller zu diagnostizieren" VALUE 0x8004B6BE Val_Ws16 655350.0 Time_ms -327680.0 327670.0 FORMAT "%8.1" /end CHARACTERISTIC
/begin CHARACTERISTIC CoEng_tiTstMax_C "Maximale Zeit zwischen zwei Testanforderungen" VALUE 0x8006FFDE Val_Wu16 655350.0 Time_ms 0.00 655350.0 FORMAT "%8.1" /end CHARACTERISTIC
/begin CHARACTERISTIC CoEOM_Prio2_CA "Priorität zur Gewichtung der Betriebsartenwünsche" VAL_BLK 0x80070700 ValA_Wu8 1.000 OneToOne 0.00 1.000 FORMAT "%5.3" EXTENDED_LIMITS 0.00 255.0 NUMBER 9 /end CHARACTERISTIC
/begin CHARACTERISTIC CoEOM_stDSCHEDPrio_C "" VALUE 0x80070709 Val_Wu8 15.00 OneToOne 0.00 15.00 FORMAT "%5.2" EXTENDED_LIMITS 0.00 255.0 /end CHARACTERISTIC
/begin CHARACTERISTIC CoEOM_stNxtOpMode_CA "Matrix mit Bitmasken der Betriebsarten, die von der aktuellen Betriebsart aus direkt aktiviert werden können." MAP 0x8006FFE0 Kf_Xs16_Ys16_Ws16 65535.00 OneToOne -32768.00 32767.00 FORMAT "%8.2"
 /begin AXIS_DESCR STD_AXIS CoEOM_numOpModeAct_mp OneToOne 16 0.00 255.0 FORMAT "%5.1" DEPOSIT ABSOLUTE /end AXIS_DESCR
 /begin AXIS_DESCR STD_AXIS CoEOM_numStageAct_mp OneToOne 11 0.00 255.0 FORMAT "%5.1" DEPOSIT ABSOLUTE /end AXIS_DESCR
/end CHARACTERISTIC
/begin CHARACTERISTIC CoEOM_stNxtStage_CA "Matrix mit Bitmasken der Stufen, die von der aktuelle Betriebsart aus direkt aktiviert werden können" MAP 0x8007017A Kf_Xs16_Ys16_Ws16 65535.00 OneToOne -32768.00 32767.00 FORMAT "%8.2"
 /begin AXIS_DESCR STD_AXIS CoEOM_numOpModeAct_mp OneToOne 16 0.00 255.0 FORMAT "%5.1" DEPOSIT ABSOLUTE /end AXIS_DESCR
 /begin AXIS_DESCR STD_AXIS CoEOM_numStageAct_mp OneToOne 11 0.00 255.0 FORMAT "%5.1" DEPOSIT ABSOLUTE /end AXIS_DESCR
/end CHARACTERISTIC
/begin CHARACTERISTIC CoEOM_stOpModeDes_C "Label zur direkten Vorgabe der Betriebsart" VALUE 0x80070314 Kw_Wu32 4294967295.00 OneToOne 0.00 4294967295.00 FORMAT "%13.2" /end CHARACTERISTIC
/begin CHARACTERISTIC CoEOM_stOpModeDL_CA "Matrix mit Betriebsarten zum Beenden der aktuellen Betriebsart bei einem Deadlock" MAP 0x80070318 Kf_Xs16_Ys16_Ws16 65535.00 OneToOne -32768.00 32767.00 FORMAT "%8.2"
 /begin AXIS_DESCR STD_AXIS CoEOM_numOpModeAct_mp OneToOne 16 0.00 255.0 FORMAT "%5.1" DEPOSIT ABSOLUTE /end AXIS_DESCR
 /begin AXIS_DESCR STD_AXIS CoEOM_numStageAct_mp OneToOne 11 0.00 255.0 FORMAT "%5.1" DEPOSIT ABSOLUTE /end AXIS_DESCR
/end CHARACTERISTIC
/begin CHARACTERISTIC CoEOM_stOpModeMax_C "Bitmaske zum Verbieten von Betriebsarten" VALUE 0x800704B4 Kw_Wu32 65535.0000000 OneToOne 0.00 65535.0000000 FORMAT "%13.7" EXTENDED_LIMITS 0.00 4294967295.00 /end CHARACTERISTIC
/begin CHARACTERISTIC CoEOM_stOpMode_C "Basis-Betriebsartenwunsch, wenn keine andere Betriebsart gewünscht wird" VALUE 0x8007070C Kw_Wu32 4294967295.00 OneToOne 0.00 4294967295.00 FORMAT "%13.2" /end CHARACTERISTIC
/begin CHARACTERISTIC CoEOM_tiRmpMax_C "" VALUE 0x800704B8 Kw_Ws16 16.323985348 TimeCoEOMRmp 0.060014652015 16.384000000 FORMAT "%12.9" EXTENDED_LIMITS 0.0020000610370 65.536000000 /end CHARACTERISTIC
/begin CHARACTERISTIC CoEOM_tiRmpMin_C "Minimale Rampenlaufzeit" VALUE 0x800704BA Kw_Ws16 16.323985348 TimeCoEOMRmp 0.060014652015 16.384000000 FORMAT "%12.9" EXTENDED_LIMITS 0.0020000610370 65.536000000 /end CHARACTERISTIC
/begin CHARACTERISTIC CoEOM_tiRmp_CA "Matrix mit Rampenlaufzeiten für die unterschiedlichen Betriebsartenumschaltungen" MAP 0x800704BC Kf_Xs16_Ys16_Ws16 65.533999939 TimeCoEOMRmp 0.0020000610370 65.536000000 FORMAT "%12.9"
 /begin AXIS_DESCR STD_AXIS CoEOM_numOpModeAct_mp OneToOne 16 0.00 255.0 FORMAT "%5.1" DEPOSIT ABSOLUTE /end AXIS_DESCR
 /begin AXIS_DESCR STD_AXIS CoEOM_numOpModeOld_mp OneToOne 16 0.00 255.0 FORMAT "%5.1" DEPOSIT ABSOLUTE /end AXIS_DESCR
/end CHARACTERISTIC
/begin CHARACTERISTIC CoESS_DelEngSetP.tiHiLo_C "/" VALUE 0x80070710 Kw_Ws16 655350.0 TimeDeb -327680.0 327670.0 FORMAT "%8.1" /end CHARACTERISTIC
/begin CHARACTERISTIC CoESS_DelEngSetP.tiLoHi_C "/" VALUE 0x80070712 Kw_Ws16 655350.0 TimeDeb -327680.0 327670.0 FORMAT "%8.1" /end CHARACTERISTIC
/begin CHARACTERISTIC CoESS_DelVltgBattRstP.tiHiLo_C "/" VALUE 0x80070714 Kw_Ws16 655350.0 TimeDeb -327680.0 327670.0 FORMAT "%8.1" /end CHARACTERISTIC
/begin CHARACTERISTIC CoESS_DelVltgBattRstP.tiLoHi_C "/" VALUE 0x80070716 Kw_Ws16 655350.0 TimeDeb -327680.0 327670.0 FORMAT "%8.1" /end CHARACTERISTIC
/begin CHARACTERISTIC CoESS_DelVltgBattSetP.tiHiLo_C "/" VALUE 0x80070718 Kw_Ws16 655350.0 TimeDeb -327680.0 327670.0 FORMAT "%8.1" /end CHARACTERISTIC
/begin CHARACTERISTIC CoESS_DelVltgBattSetP.tiLoHi_C "/" VALUE 0x8007071A Kw_Ws16 655350.0 TimeDeb -327680.0 327670.0 FORMAT "%8.1" /end CHARACTERISTIC
/begin CHARACTERISTIC CoESS_nIdlBattThres_C "Drehzahlschwellwert für Setzbedingung" VALUE 0x8007071C Kw_Ws16 32767.50 EngN -16384.00 16383.50 FORMAT "%8.2" /end CHARACTERISTIC
/begin CHARACTERISTIC CoESS_nMax_C "Drehzahlbegrenzung vom elektrischen Bordnetz" VALUE 0x8007071E Kw_Ws16 32767.50 EngN -16384.00 16383.50 FORMAT "%8.2" /end CHARACTERISTIC
/begin CHARACTERISTIC CoESS_nMinBatt_C "Sollwert der Leerlaufdrehzahl bei Unterspannung" VALUE 0x80070720 Kw_Ws16 32767.50 EngN -16384.00 16383.50 FORMAT "%8.2" /end CHARACTERISTIC
/begin CHARACTERISTIC CoESS_nMinThres_C "Basisschwellwert für Setzbedingung" VALUE 0x80070722 Kw_Ws16 32767.50 EngN -16384.00 16383.50 FORMAT "%8.2" /end CHARACTERISTIC
/begin CHARACTERISTIC CoESS_stEngStop_C "Start-Stop: Motorstop freigegeben" VALUE 0x80070724 Kw_Wu8 255.0 OneToOne 0.00 255.0 FORMAT "%5.1" /end CHARACTERISTIC
/begin CHARACTERISTIC CoESS_stEngStrt_C "Start-Stop: Motorstart freigegeben" VALUE 0x80070725 Kw_Wu8 255.0 OneToOne 0.00 255.0 FORMAT "%5.1" /end CHARACTERISTIC
/begin CHARACTERISTIC CoESS_uIdlBattThresRst_C "Batteriespannungsschwellwert für Rücksetzbedingung" VALUE 0x80070726 Kw_Ws16 1310700. Volt_Batt -655360.0 655340.0 FORMAT "%8.1" /end CHARACTERISTIC
/begin CHARACTERISTIC CoESS_uIdlBattThresSet_C "Batteriespannungschwellwert für Setzbedingung" VALUE 0x80070728 Kw_Ws16 1310700. Volt_Batt -655360.0 655340.0 FORMAT "%8.1" /end CHARACTERISTIC
/begin CHARACTERISTIC CoESS_vMinThres_C "Geschwindigkeitsschwellwert für Setzbedingung" VALUE 0x8007072A Kw_Ws16 655.3500 Vel -327.6800 327.6700 FORMAT "%8.4" /end CHARACTERISTIC
/begin CHARACTERISTIC CoETM_facAftRun2_C "Prozentwert zum Ermitteln des Aktualisierungszeitpunktes der Nachlaufzeit" VALUE 0x8007072C Kw_Ws16 7.999878 Fact -4.000000 3.999878 FORMAT "%8.6" /end CHARACTERISTIC
/begin CHARACTERISTIC CoETM_facClgAftRun_CUR "" CURVE 0x8007072E Kl_Xs16_Ws16 7.999878 Fact -4.000000 3.999878 FORMAT "%8.6"
 /begin AXIS_DESCR STD_AXIS CoETM_tiClgAftRun_mp Time_s 3 -327.6800 327.6700 FORMAT "%8.4" DEPOSIT ABSOLUTE /end AXIS_DESCR
/end CHARACTERISTIC
/begin CHARACTERISTIC CoETM_qInjCurrMax_MAP "Umschaltkennfeld für Thermostatansteuerung Split Cooling" MAP 0x800707FE Map_Xs16Ys16Ws16 327.6700 InjMass 0.00 327.6700 FORMAT "%8.4" EXTENDED_LIMITS -327.6800 327.6700
 /begin AXIS_DESCR STD_AXIS Epm_nEng EngN 8 -16384.00 16383.50 FORMAT "%8.2" DEPOSIT ABSOLUTE /end AXIS_DESCR
 /begin AXIS_DESCR STD_AXIS TS_tClntEngIn Temp_Cels 8 -3549.940 3003.560 FORMAT "%8.3" DEPOSIT ABSOLUTE /end AXIS_DESCR
/end CHARACTERISTIC
/begin CHARACTERISTIC CoETM_rClgAftRun_MAP "" MAP 0x8007073C Kf_Xs16_Ys16_Ws16 799.9878 Prc -400.0000 399.9878 FORMAT "%8.4"
 /begin AXIS_DESCR STD_AXIS CoETM_tClntEngOut_mp Temp_Cels 3 -3549.940 3003.560 FORMAT "%8.3" DEPOSIT ABSOLUTE /end AXIS_DESCR
 /begin AXIS_DESCR STD_AXIS GlbDa_tEnv Temp_Cels 3 -3549.940 3003.560 FORMAT "%8.3" DEPOSIT ABSOLUTE /end AXIS_DESCR
/end CHARACTERISTIC
/begin CHARACTERISTIC CoETM_rClgDemFan_CUR "Kühlanforderung an Lüfter" CURVE 0x800707C4 Kl_Xs16_Ws16 799.9878 Prc -400.0000 399.9878 FORMAT "%8.4"
 /begin AXIS_DESCR STD_AXIS CoETM_rClgDemLim_mp Prc 5 -400.0000 399.9878 FORMAT "%8.4" DEPOSIT ABSOLUTE /end AXIS_DESCR
/end CHARACTERISTIC
/begin CHARACTERISTIC CoETM_rClgDemMax_C "Maximalwert der Kühlleistungsanforderung" VALUE 0x8007075E Kw_Ws16 799.9878 Prc -400.0000 399.9878 FORMAT "%8.4" /end CHARACTERISTIC
/begin CHARACTERISTIC CoETM_rClgDemMin_C "Minimalwert der Kühlleistungsanfoderung" VALUE 0x80070760 Kw_Ws16 799.9878 Prc -400.0000 399.9878 FORMAT "%8.4" /end CHARACTERISTIC
/begin CHARACTERISTIC CoETM_rClgDemT_CUR "Ansteuerung des elektrischen Thermostats" CURVE 0x800707DA Kl_Xs16_Ws16 799.9878 Prc -400.0000 399.9878 FORMAT "%8.4"
 /begin AXIS_DESCR STD_AXIS CoETM_rClgDemLim_mp Prc 5 -400.0000 399.9878 FORMAT "%8.4" DEPOSIT ABSOLUTE /end AXIS_DESCR
/end CHARACTERISTIC
/begin CHARACTERISTIC CoETM_rClgIntLimP.Min_C "/" VALUE 0x80070762 Kw_Ws16 799.9878 Prc -400.0000 399.9878 FORMAT "%8.4" /end CHARACTERISTIC
/begin CHARACTERISTIC CoETM_rClgIntLimP.Max_C "/" VALUE 0x80070764 Kw_Ws16 799.9878 Prc -400.0000 399.9878 FORMAT "%8.4" /end CHARACTERISTIC
/begin CHARACTERISTIC CoETM_rClgKi_CUR "Multiplikator für Integration von ETM_rClgDem" CURVE 0x80070766 Kl_Xs16_Ws16 799.9878 Prc -400.0000 399.9878 FORMAT "%8.4"
 /begin AXIS_DESCR STD_AXIS CoETM_tDvt_mp TempDiff_Kelv 3 -3276.800 3276.700 FORMAT "%8.3" DEPOSIT ABSOLUTE /end AXIS_DESCR
/end CHARACTERISTIC
/begin CHARACTERISTIC CoETM_rClgKp_CUR "Multiplikator für Integration von ETM_rClgDem" CURVE 0x800707F0 Kl_Xs16_Ws16 799.9878 Prc -400.0000 399.9878 FORMAT "%8.4"
 /begin AXIS_DESCR STD_AXIS CoETM_tDvt_mp TempDiff_Kelv 3 -3276.800 3276.700 FORMAT "%8.3" DEPOSIT ABSOLUTE /end AXIS_DESCR
/end CHARACTERISTIC
/begin CHARACTERISTIC CoETM_rCThmstOff_C "Vorgaberohwert für Nichtbestromung Thermostat" VALUE 0x800708A2 Val_Ws16 1.220703 Prc 0.00 1.220703 FORMAT "%8.6" EXTENDED_LIMITS -400.0000 399.9878 /end CHARACTERISTIC
/begin CHARACTERISTIC CoETM_rCThmstOn_C "" VALUE 0x800708A4 Val_Ws16 100.0000 Prc 0.00 100.0000 FORMAT "%8.4" EXTENDED_LIMITS -400.0000 399.9878 /end CHARACTERISTIC
/begin CHARACTERISTIC CoETM_rHtFlowReqHi_C "Obere Schwelle für Hysterese Heizanforderung über CAN" VALUE 0x800708A6 Val_Ws16 100.0000 Prc 0.00 100.0000 FORMAT "%8.4" EXTENDED_LIMITS -400.0000 399.9878 /end CHARACTERISTIC
/begin CHARACTERISTIC CoETM_rHtFlowReqLo_C "Untere Schwelle für Hysterese Heizanforderung über CAN" VALUE 0x800708A8 Val_Ws16 100.0000 Prc 0.00 100.0000 FORMAT "%8.4" EXTENDED_LIMITS -400.0000 399.9878 /end CHARACTERISTIC
/begin CHARACTERISTIC CoETM_tDvtMax_C "Maximale Abweichung, I-part" VALUE 0x80070774 Kw_Ws16 6553.500 TempDiff_Kelv -3276.800 3276.700 FORMAT "%8.3" /end CHARACTERISTIC
/begin CHARACTERISTIC CoETM_tDvtMin_C "Minimale Abweichung, I-part" VALUE 0x80070776 Kw_Ws16 6553.500 TempDiff_Kelv -3276.800 3276.700 FORMAT "%8.3" /end CHARACTERISTIC
/begin CHARACTERISTIC CoETM_tEngDiffMin_C "Minimale Temperaturdiffenz zwischen Kurbelgehäuse und Zylinderkopf" VALUE 0x800708AA Val_Ws16 150.0000 TempDiff_Kelv -50.00000 100.0000 FORMAT "%8.4" EXTENDED_LIMITS -3276.800 3276.700 /end CHARACTERISTIC
/begin CHARACTERISTIC CoETM_tEngOutMin_C "Minimal benötigte Temperatur am Kurbelgehäuse" VALUE 0x800708AC Val_Ws16 150.0000 Temp_Cels -50.04000 99.96000 FORMAT "%8.4" EXTENDED_LIMITS -3549.940 3003.560 /end CHARACTERISTIC
/begin CHARACTERISTIC CoETM_tEngOutSubsOff_C "Ersatzwert" VALUE 0x80070778 Kw_Ws16 6553.500 Temp_Cels -3549.940 3003.560 FORMAT "%8.3" /end CHARACTERISTIC
/begin CHARACTERISTIC CoETM_tiClgAftRun2_MAP "Bestimmung der 2. Nachlaufzeit" MAP 0x8007077A Kf_Xs16_Ys16_Ws16 655.3500 Time_s -327.6800 327.6700 FORMAT "%8.4"
 /begin AXIS_DESCR STD_AXIS CoETM_tEngOutOff_mp Temp_Cels 3 -3549.940 3003.560 FORMAT "%8.3" DEPOSIT ABSOLUTE /end AXIS_DESCR
 /begin AXIS_DESCR STD_AXIS GlbDa_tEnv Temp_Cels 3 -3549.940 3003.560 FORMAT "%8.3" DEPOSIT ABSOLUTE /end AXIS_DESCR
/end CHARACTERISTIC
/begin CHARACTERISTIC CoETM_tiClgAftRun_MAP "Bestimmung der Nachlaufzeit" MAP 0x8007079C Kf_Xs16_Ys16_Ws16 655.3500 Time_s -327.6800 327.6700 FORMAT "%8.4"
 /begin AXIS_DESCR STD_AXIS CoETM_tEngOutOff_mp Temp_Cels 3 -3549.940 3003.560 FORMAT "%8.3" DEPOSIT ABSOLUTE /end AXIS_DESCR
 /begin AXIS_DESCR STD_AXIS GlbDa_tEnv Temp_Cels 3 -3549.940 3003.560 FORMAT "%8.3" DEPOSIT ABSOLUTE /end AXIS_DESCR
/end CHARACTERISTIC
/begin CHARACTERISTIC CoETM_tiClgIntegT1_C "Zeitkonstante für die Integration" VALUE 0x800707C0 Kw_Ws32 4294.9672940 TimeDelay_s 0.000002000000001 4294.9672960 FORMAT "%12.7" /end CHARACTERISTIC
/begin CHARACTERISTIC CoETS_nTrqRatMin_C "Drehzahlschwelle ab der die aktuelle Last bestimmt wird" VALUE 0x800708AE Val_Ws16 600.0000 EngN 0.00 600.0000 FORMAT "%8.4" EXTENDED_LIMITS -16384.00 16383.50 /end CHARACTERISTIC
/begin CHARACTERISTIC CoETS_trqSetMax_C "" VALUE 0x8004B6A8 Val_Ws16 400.0000 Trq 0.00 400.0000 FORMAT "%8.4" EXTENDED_LIMITS -3276.800 3276.700 /end CHARACTERISTIC
/begin AXIS_PTS CoME_calEngSpeed_AXIS "" 0x800708F0 Epm_nEng GSst_Xs16 32767.50 EngN 4 -16384.00 16383.50 FORMAT "%8.2" DEPOSIT ABSOLUTE /end AXIS_PTS
/begin CHARACTERISTIC CoME_drPedHi_C "Gradient des Fahrpedalmaximalwerts (oberer Hysteresewert)" VALUE 0x800708B6 Kw_Ws16 39999.39 PrcPerSec -20000.00 19999.39 FORMAT "%8.2" /end CHARACTERISTIC
/begin CHARACTERISTIC CoME_drPedLo_C "Gradient des Fahrpedalmaximalwerts (unterer Hysteresewert)" VALUE 0x800708B8 Kw_Ws16 39999.39 PrcPerSec -20000.00 19999.39 FORMAT "%8.2" /end CHARACTERISTIC
/begin CHARACTERISTIC CoME_nEng1Hi_C "Minimale Motordrehzahl (oberer Hysteresewert - 1)" VALUE 0x800708BA Kw_Ws16 32767.50 EngN -16384.00 16383.50 FORMAT "%8.2" /end CHARACTERISTIC
/begin CHARACTERISTIC CoME_nEng1Lo_C "Minimale Motordrehzahl (unterer Hysteresewert - 1)" VALUE 0x800708BC Kw_Ws16 32767.50 EngN -16384.00 16383.50 FORMAT "%8.2" /end CHARACTERISTIC
/begin CHARACTERISTIC CoME_nEng2Hi_C "Minimale Motordrehzahl (oberer Hysteresewert - 2)" VALUE 0x800708BE Kw_Ws16 32767.50 EngN -16384.00 16383.50 FORMAT "%8.2" /end CHARACTERISTIC
/begin CHARACTERISTIC CoME_nEng2Lo_C "Minimale Motordrehzahl (unterer Hysteresewert - 2)" VALUE 0x800708C0 Kw_Ws16 32767.50 EngN -16384.00 16383.50 FORMAT "%8.2" /end CHARACTERISTIC
/begin CHARACTERISTIC CoME_numTraGearMax_C "Minimale Gangnummer" VALUE 0x800708C2 Kw_Wu8 255.0 OneToOne 0.00 255.0 FORMAT "%5.1" /end CHARACTERISTIC
/begin CHARACTERISTIC CoME_pEnv1Hi_C "Minimaler Umgebungsdruck (oberer Hysteresewert - 1)" VALUE 0x800708C4 Kw_Ws16 36268.00 Pres_hPa -32768.00 3500.00 FORMAT "%8.2" EXTENDED_LIMITS -32768.00 32767.00 /end CHARACTERISTIC
/begin CHARACTERISTIC CoME_pEnv1Lo_C "Minimaler Umgebungsdruck (unterer Hysteresewert - 1)" VALUE 0x800708C6 Kw_Ws16 36268.00 Pres_hPa -32768.00 3500.00 FORMAT "%8.2" EXTENDED_LIMITS -32768.00 32767.00 /end CHARACTERISTIC
/begin CHARACTERISTIC CoME_pEnv2Hi_C "Minimaler Umgebungsdruck (oberer Hysteresewert - 2)" VALUE 0x800708C8 Kw_Ws16 36268.00 Pres_hPa -32768.00 3500.00 FORMAT "%8.2" EXTENDED_LIMITS -32768.00 32767.00 /end CHARACTERISTIC
/begin CHARACTERISTIC CoME_pEnv2Lo_C "Minimaler Umgebungsdruck (unterer Hysteresewert - 2)" VALUE 0x800708CA Kw_Ws16 36268.00 Pres_hPa -32768.00 3500.00 FORMAT "%8.2" EXTENDED_LIMITS -32768.00 32767.00 /end CHARACTERISTIC
/begin CHARACTERISTIC CoME_rPedHi_C "Fahrpedalmaximalwert (oberer Hysteresewert)" VALUE 0x800708CC Kw_Ws16 799.9878 Prc -400.0000 399.9878 FORMAT "%8.4" /end CHARACTERISTIC
/begin CHARACTERISTIC CoME_rPedLo_C "Fahrpedalmaximalwert (unterer Hysteresewert)" VALUE 0x800708CE Kw_Ws16 799.9878 Prc -400.0000 399.9878 FORMAT "%8.4" /end CHARACTERISTIC
/begin CHARACTERISTIC CoME_stAlt_CW "Status: Generatorabschaltbedingungen" VALUE 0x800708D0 Kw_Wu8 255.0 OneToOne 0.00 255.0 FORMAT "%5.1" /end CHARACTERISTIC
/begin CHARACTERISTIC CoME_stEEM_C "Status: Elektrisches Energie Management" VALUE 0x800708FA Kw_Wu8 255.0 OneToOne 0.00 255.0 FORMAT "%5.1" /end CHARACTERISTIC
/begin CHARACTERISTIC CoME_stFan_CW "Status: Lüfterabschaltbedingungen" VALUE 0x800708D1 Kw_Wu8 255.0 OneToOne 0.00 255.0 FORMAT "%5.1" /end CHARACTERISTIC
/begin CHARACTERISTIC CoME_tEnvAir1Hi_C "" VALUE 0x800708D2 Kw_Ws16 6553.500 Temp_Cels -3549.940 3003.560 FORMAT "%8.3" /end CHARACTERISTIC
/begin CHARACTERISTIC CoME_tEnvAir1Lo_C "" VALUE 0x800708D4 Kw_Ws16 6553.500 Temp_Cels -3549.940 3003.560 FORMAT "%8.3" /end CHARACTERISTIC
/begin CHARACTERISTIC CoME_tEnvAir2Hi_C "" VALUE 0x800708D6 Kw_Ws16 6553.500 Temp_Cels -3549.940 3003.560 FORMAT "%8.3" /end CHARACTERISTIC
/begin CHARACTERISTIC CoME_tEnvAir2Lo_C "" VALUE 0x800708D8 Kw_Ws16 6553.500 Temp_Cels -3549.940 3003.560 FORMAT "%8.3" /end CHARACTERISTIC
/begin CHARACTERISTIC CoME_tiBattVltgOff_C "Minimale Abschaltzeit wegen niedriger Batteriespannung" VALUE 0x800708FC Kw_Ws16 655.3500 Time_s -327.6800 327.6700 FORMAT "%8.4" /end CHARACTERISTIC
/begin CHARACTERISTIC CoME_tiDrvOn_C "Mindesteinschaltzeit nach Abschaltung wegen Anfahren oder Beschleunigung" VALUE 0x800708FE Kw_Ws16 655.3500 Time_s -327.6800 327.6700 FORMAT "%8.4" /end CHARACTERISTIC
/begin CHARACTERISTIC CoME_tiMaxOffAcc_CUR "Maximale Abschaltzeit bei Beschleunigung" CURVE 0x80070900 Gkl_Ws16 655350.0 Time_ms -327680.0 327670.0 FORMAT "%8.1"
 /begin AXIS_DESCR COM_AXIS Epm_nEng EngN 4 -16384.00 16383.50 FORMAT "%8.2" AXIS_PTS_REF CoME_calEngSpeed_AXIS /end AXIS_DESCR
/end CHARACTERISTIC
/begin CHARACTERISTIC CoME_tiMaxOffDrvOff_CUR "Maximale Abschaltzeit bei Anfahren" CURVE 0x80070908 Gkl_Ws16 655350.0 Time_ms -327680.0 327670.0 FORMAT "%8.1"
 /begin AXIS_DESCR COM_AXIS Epm_nEng EngN 4 -16384.00 16383.50 FORMAT "%8.2" AXIS_PTS_REF CoME_calEngSpeed_AXIS /end AXIS_DESCR
/end CHARACTERISTIC
/begin CHARACTERISTIC CoME_tiMinOffAcc_CUR "Minimale Abschaltzeit bei Beschleunigung" CURVE 0x80070910 Gkl_Ws16 655350.0 Time_ms -327680.0 327670.0 FORMAT "%8.1"
 /begin AXIS_DESCR COM_AXIS Epm_nEng EngN 4 -16384.00 16383.50 FORMAT "%8.2" AXIS_PTS_REF CoME_calEngSpeed_AXIS /end AXIS_DESCR
/end CHARACTERISTIC
/begin CHARACTERISTIC CoME_tiMinOffDrvOff_CUR "Minimale Abschaltzeit bei Anfahren" CURVE 0x80070918 Gkl_Ws16 655350.0 Time_ms -327680.0 327670.0 FORMAT "%8.1"
 /begin AXIS_DESCR COM_AXIS Epm_nEng EngN 4 -16384.00 16383.50 FORMAT "%8.2" AXIS_PTS_REF CoME_calEngSpeed_AXIS /end AXIS_DESCR
/end CHARACTERISTIC
/begin CHARACTERISTIC CoME_tiOffStrtAC_C "Entprellzeit nach Motorstart" VALUE 0x80070920 Kw_Ws16 655.3500 Time_s -327.6800 327.6700 FORMAT "%8.4" /end CHARACTERISTIC
/begin CHARACTERISTIC CoME_tiOffStrtAlt_C "Entprellzeit nach Motorstart" VALUE 0x80070922 Kw_Ws16 655.3500 Time_s -327.6800 327.6700 FORMAT "%8.4" /end CHARACTERISTIC
/begin CHARACTERISTIC CoME_tiOffStrtWaHt_C "Entprellzeit nach Motorstart" VALUE 0x80070924 Kw_Ws16 655.3500 Time_s -327.6800 327.6700 FORMAT "%8.4" /end CHARACTERISTIC
/begin CHARACTERISTIC CoME_trqAcc_C "Zulässiges Verbrauchsmoment für Klima bei Beschleunigung" VALUE 0x800708DA Kw_Ws16 6553.500 Trq -3276.800 3276.700 FORMAT "%8.3" /end CHARACTERISTIC
/begin CHARACTERISTIC CoME_trqACMax_C "Basiswert für zulässiges Klimakompressormoment" VALUE 0x800708DC Kw_Ws16 6553.500 Trq -3276.800 3276.700 FORMAT "%8.3" /end CHARACTERISTIC
/begin CHARACTERISTIC CoME_trqBattVltg_C "Zulässiges Verbrauchsmoment für Klima bei niedriger Batteriespannung" VALUE 0x800708DE Kw_Ws16 6553.500 Trq -3276.800 3276.700 FORMAT "%8.3" /end CHARACTERISTIC
/begin CHARACTERISTIC CoME_trqDrvOff_C "Zulässiges Verbrauchsmoment für Klima bei Anfahren" VALUE 0x800708E0 Kw_Ws16 6553.500 Trq -3276.800 3276.700 FORMAT "%8.3" /end CHARACTERISTIC
/begin CHARACTERISTIC CoME_trqStrt_C "Zulässiges Verbrauchsmoment für Klima bei Motorstart" VALUE 0x800708E2 Kw_Ws16 6553.500 Trq -3276.800 3276.700 FORMAT "%8.3" /end CHARACTERISTIC
/begin CHARACTERISTIC CoME_uBattMinHi_C "Minimale Batteriespannung (oberer Hysteresewert)" VALUE 0x800708E4 Kw_Ws16 1310700. Volt_Batt -655360.0 655340.0 FORMAT "%8.1" /end CHARACTERISTIC
/begin CHARACTERISTIC CoME_uBattMinLo_C "Minimale Batteriespannung (unterer Hysteresewert)" VALUE 0x800708E6 Kw_Ws16 1310700. Volt_Batt -655360.0 655340.0 FORMAT "%8.1" /end CHARACTERISTIC
/begin CHARACTERISTIC CoME_vX1Hi_C "Minimale Fahrzeuggeschwindigkeit (oberer Hysteresewert - 1)" VALUE 0x800708E8 Kw_Ws16 655.3500 Vel -327.6800 327.6700 FORMAT "%8.4" /end CHARACTERISTIC
/begin CHARACTERISTIC CoME_vX1Lo_C "Minimale Fahrzeuggeschwindigkeit (unterer Hysteresewert - 1)" VALUE 0x800708EA Kw_Ws16 655.3500 Vel -327.6800 327.6700 FORMAT "%8.4" /end CHARACTERISTIC
/begin CHARACTERISTIC CoME_vX2Hi_C "Minimale Fahrzeuggeschwindigkeit (oberer Hysteresewert - 2)" VALUE 0x800708EC Kw_Ws16 655.3500 Vel -327.6800 327.6700 FORMAT "%8.4" /end CHARACTERISTIC
/begin CHARACTERISTIC CoME_vX2Lo_C "Minimale Fahrzeuggeschwindigkeit (unterer Hysteresewert - 2)" VALUE 0x800708EE Kw_Ws16 655.3500 Vel -327.6800 327.6700 FORMAT "%8.4" /end CHARACTERISTIC
/begin CHARACTERISTIC Conv_BrkDebP.tiHiLo_C "---/" VALUE 0x80070A78 Kw_Ws16 655350.0 TimeDeb -327680.0 327670.0 FORMAT "%8.1" /end CHARACTERISTIC
/begin CHARACTERISTIC Conv_BrkDebP.tiLoHi_C "---/" VALUE 0x80070A7A Kw_Ws16 655350.0 TimeDeb -327680.0 327670.0 FORMAT "%8.1" /end CHARACTERISTIC
/begin CHARACTERISTIC Conv_facClthClsd_GCUR "Öltemperaturabhängiger Faktor für Kupplung geschlossen" CURVE 0x80070A7C Gkl_Ws16 0.006553500 TrqToNSqr -0.003276800 0.003276700 FORMAT "%11.9"
 /begin AXIS_DESCR COM_AXIS Conv_tOilBuf_mp Temp_Cels 10 -3549.940 3003.560 FORMAT "%8.3" AXIS_PTS_REF Conv_tPntDST_Axis /end AXIS_DESCR
/end CHARACTERISTIC
/begin CHARACTERISTIC Conv_facClthOpnd_GCUR "Öltemperaturabhängiger Faktor für Kupplung geöffnet" CURVE 0x80070A90 Gkl_Ws16 0.006553500 TrqToNSqr -0.003276800 0.003276700 FORMAT "%11.9"
 /begin AXIS_DESCR COM_AXIS Conv_tOilBuf_mp Temp_Cels 10 -3549.940 3003.560 FORMAT "%8.3" AXIS_PTS_REF Conv_tPntDST_Axis /end AXIS_DESCR
/end CHARACTERISTIC
/begin CHARACTERISTIC Conv_facDepNTrbnNStat_CUR "Faktor abhängig von der Turbinendrehzahl und der stationären Drehzahl" CURVE 0x80070928 Cur_Xs16Ws16 7.999878 Fact -4.000000 3.999878 FORMAT "%8.6"
 /begin AXIS_DESCR STD_AXIS Conv_rNTrbnNStat_mp TransR 6 -327.6800 327.6700 FORMAT "%8.4" DEPOSIT ABSOLUTE /end AXIS_DESCR
/end CHARACTERISTIC
/begin CHARACTERISTIC Conv_facDfl_C "Faktor für Ölpumpe" VALUE 0x80070AA4 Val_Ws16 0.006553500 TrqToNSqr -0.003276800 0.003276700 FORMAT "%11.9" /end CHARACTERISTIC
/begin CHARACTERISTIC Conv_facGnTrqHiInc_C "Kalibrierungsfaktor für große Momentenerhöhung" VALUE 0x80070942 Kw_Ws16 511.9922 Fact1 -256.0000 255.9922 FORMAT "%8.4" /end CHARACTERISTIC
/begin CHARACTERISTIC Conv_facGnTrqResv_C "Verstärkungsfaktor zur Berechnung der Momentenreserve" VALUE 0x80070944 Kw_Ws16 7.999878 Fact -4.000000 3.999878 FORMAT "%8.6" /end CHARACTERISTIC
/begin CHARACTERISTIC Conv_facNTrbnCorr_C "Korrekturfaktor für die Turbinendrehzahl" VALUE 0x80070946 Kw_Ws16 7.999878 Fact -4.000000 3.999878 FORMAT "%8.6" /end CHARACTERISTIC
/begin CHARACTERISTIC Conv_facVelErr_C "Kalibrierungsfaktor für Geschwindigkeitsfehler" VALUE 0x80070948 Kw_Ws16 7.999878 Fact -4.000000 3.999878 FORMAT "%8.6" /end CHARACTERISTIC
/begin CHARACTERISTIC Conv_facVelNoErr_C "Kalibrierungsfaktor für kein Geschwindigkeitsfehler" VALUE 0x8007094A Kw_Ws16 7.999878 Fact -4.000000 3.999878 FORMAT "%8.6" /end CHARACTERISTIC
/begin CHARACTERISTIC Conv_LvrOffDebP.tiHiLo_C "---/" VALUE 0x8007094C Kw_Ws16 655350.0 TimeDeb -327680.0 327670.0 FORMAT "%8.1" /end CHARACTERISTIC
/begin CHARACTERISTIC Conv_LvrOffDebP.tiLoHi_C "---/" VALUE 0x8007094E Kw_Ws16 655350.0 TimeDeb -327680.0 327670.0 FORMAT "%8.1" /end CHARACTERISTIC
/begin CHARACTERISTIC Conv_LvrPosOffDebP.tiHiLo_C "---/" VALUE 0x80070950 Kw_Ws16 655350.0 TimeDeb -327680.0 327670.0 FORMAT "%8.1" /end CHARACTERISTIC
/begin CHARACTERISTIC Conv_LvrPosOffDebP.tiLoHi_C "---/" VALUE 0x80070952 Kw_Ws16 655350.0 TimeDeb -327680.0 327670.0 FORMAT "%8.1" /end CHARACTERISTIC
/begin CHARACTERISTIC Conv_nTrbnLoLim_C "untere Begrenzung Turbinendrehzahl" VALUE 0x80070954 Kw_Ws16 32767.50 EngN -16384.00 16383.50 FORMAT "%8.2" /end CHARACTERISTIC
/begin CHARACTERISTIC Conv_nTrbnMinCorrVal_C "minimaler Korrekturfaktor für die Turbinendrehzahl" VALUE 0x80070956 Kw_Ws16 32767.50 EngN -16384.00 16383.50 FORMAT "%8.2" /end CHARACTERISTIC
/begin CHARACTERISTIC Conv_nTrbn_C "Turbinendrehzahl" VALUE 0x80070958 Kw_Ws16 32767.50 EngN -16384.00 16383.50 FORMAT "%8.2" /end CHARACTERISTIC
/begin CHARACTERISTIC Conv_rTrq_C "Parameter für Wandlerübersetzungsverhältnis" VALUE 0x80070B64 Kw_Ws16 654.0000 TransR -327.0000 327.0000 FORMAT "%8.4" EXTENDED_LIMITS -327.6800 327.6700 /end CHARACTERISTIC
/begin CHARACTERISTIC Conv_tiDfl_C "Initialzeitwert" VALUE 0x80070AA6 Val_Ws16 655350.0 TimeDeb -327680.0 327670.0 FORMAT "%8.1" /end CHARACTERISTIC
/begin CHARACTERISTIC Conv_tiDwnRglPT1_C "Zeitkonstante für Abregelung der Momentenlast des Wandlers" VALUE 0x8007095C Kw_Ws32 4294.9672940 TimeDelay_s 0.000002000000001 4294.9672960 FORMAT "%12.7" /end CHARACTERISTIC
/begin CHARACTERISTIC Conv_tiRevLvrOff_GCUR "Entprellzeit Temperatur kein Rückwärtsgang" CURVE 0x80070AA8 Gkl_Ws16 655350.0 TimeDeb -327680.0 327670.0 FORMAT "%8.1"
 /begin AXIS_DESCR COM_AXIS Conv_tOilBuf_mp Temp_Cels 10 -3549.940 3003.560 FORMAT "%8.3" AXIS_PTS_REF Conv_tPntDST_Axis /end AXIS_DESCR
/end CHARACTERISTIC
/begin CHARACTERISTIC Conv_tiRevLvrOn_GCUR "Entprellzeit Temperatur Rückwärtsgang" CURVE 0x80070ABC Gkl_Ws16 655350.0 TimeDeb -327680.0 327670.0 FORMAT "%8.1"
 /begin AXIS_DESCR COM_AXIS Conv_tOilBuf_mp Temp_Cels 10 -3549.940 3003.560 FORMAT "%8.3" AXIS_PTS_REF Conv_tPntDST_Axis /end AXIS_DESCR
/end CHARACTERISTIC
/begin CHARACTERISTIC Conv_tiRTraGearPT1_C "Filterzeitkonstante für die Turbinendrehzahl" VALUE 0x80070960 Kw_Ws32 4294.9672940 TimeDelay_s 0.000002000000001 4294.9672960 FORMAT "%12.7" /end CHARACTERISTIC
/begin CHARACTERISTIC Conv_tiTempDepLvrOff_GCUR "Entprellzeit Temperatur kein Gang eingelegt" CURVE 0x80070AD0 Gkl_Ws16 655350.0 TimeDeb -327680.0 327670.0 FORMAT "%8.1"
 /begin AXIS_DESCR COM_AXIS Conv_tOilBuf_mp Temp_Cels 10 -3549.940 3003.560 FORMAT "%8.3" AXIS_PTS_REF Conv_tPntDST_Axis /end AXIS_DESCR
/end CHARACTERISTIC
/begin CHARACTERISTIC Conv_tiTempDepLvrOn_GCUR "Entprellzeit Temperatur Gang eingelegt" CURVE 0x80070AE4 Gkl_Ws16 655350.0 TimeDeb -327680.0 327670.0 FORMAT "%8.1"
 /begin AXIS_DESCR COM_AXIS Conv_tOilBuf_mp Temp_Cels 10 -3549.940 3003.560 FORMAT "%8.3" AXIS_PTS_REF Conv_tPntDST_Axis /end AXIS_DESCR
/end CHARACTERISTIC
/begin CHARACTERISTIC Conv_tiTrqLdPT1_C "Filterzeitkonstante für die Momentenlast" VALUE 0x80070964 Kw_Ws32 4294.9672940 TimeDelay_s 0.000002000000001 4294.9672960 FORMAT "%12.7" /end CHARACTERISTIC
/begin CHARACTERISTIC Conv_tiTrqResvPT1_C "Filterzeitkonstante für die Momentenreserve" VALUE 0x80070968 Kw_Ws32 4294.9672940 TimeDelay_s 0.000002000000001 4294.9672960 FORMAT "%12.7" /end CHARACTERISTIC
/begin CHARACTERISTIC Conv_tiUpRglPT1_C "Zeitkonstante für die Abregelung der Momentenlast des Wandlers" VALUE 0x8007096C Kw_Ws32 4294.9672940 TimeDelay_s 0.000002000000001 4294.9672960 FORMAT "%12.7" /end CHARACTERISTIC
/begin AXIS_PTS Conv_tPntDST_Axis "Temperaturverteilung Wandler" 0x80070AF8 Conv_tOilBuf_mp GSst_Xs16 6553.500 Temp_Cels 10 -3549.940 3003.560 FORMAT "%8.3" DEPOSIT ABSOLUTE /end AXIS_PTS
/begin CHARACTERISTIC Conv_trqDfl_C "Parameter Lastmoment" VALUE 0x80070B0E Val_Ws16 6553.500 Trq -3276.800 3276.700 FORMAT "%8.3" /end CHARACTERISTIC
/begin CHARACTERISTIC Conv_trqLdActv_CW "Codeword zum Aktivieren des Wandlers" VALUE 0x80070B10 Val_Wu8 255.0 OneToOne 0.00 255.0 FORMAT "%5.1" /end CHARACTERISTIC
/begin CHARACTERISTIC Conv_trqLdGnFacHysDec_C "Offset für die Senkung der Momentenlast" VALUE 0x80070970 Kw_Ws16 6553.500 Trq -3276.800 3276.700 FORMAT "%8.3" /end CHARACTERISTIC
/begin CHARACTERISTIC Conv_trqLdLvrPosNeutr_GCUR "Lastmoment für Leerlauf" CURVE 0x80070B12 Gkl_Ws16 6553.500 Trq -3276.800 3276.700 FORMAT "%8.3"
 /begin AXIS_DESCR COM_AXIS Conv_tOilBuf_mp Temp_Cels 10 -3549.940 3003.560 FORMAT "%8.3" AXIS_PTS_REF Conv_tPntDST_Axis /end AXIS_DESCR
/end CHARACTERISTIC
/begin CHARACTERISTIC Conv_trqLdMaxLim_MAP "Begrenzung der Momentenlast vom CAN" MAP 0x80070972 Map_Xs16Ys16Ws16 6553.500 Trq -3276.800 3276.700 FORMAT "%8.3"
 /begin AXIS_DESCR STD_AXIS GlbDa_vXFlt Vel 10 -327.6800 327.6700 FORMAT "%8.4" DEPOSIT ABSOLUTE /end AXIS_DESCR
 /begin AXIS_DESCR STD_AXIS TS_tClntEngOut Temp_Cels 10 -3549.940 3003.560 FORMAT "%8.3" DEPOSIT ABSOLUTE /end AXIS_DESCR
/end CHARACTERISTIC
/begin CHARACTERISTIC Conv_trqLdReplCan_C "Ersetzen der Momentenlast im Falle eines Fehles" VALUE 0x80070A66 Kw_Ws16 6553.500 Trq -3276.800 3276.700 FORMAT "%8.3" /end CHARACTERISTIC
/begin CHARACTERISTIC Conv_trqLdRevLvrPos_GCUR "Lastmoment für Rückwärtsgang" CURVE 0x80070B26 Gkl_Ws16 6553.500 Trq -3276.800 3276.700 FORMAT "%8.3"
 /begin AXIS_DESCR COM_AXIS Conv_tOilBuf_mp Temp_Cels 10 -3549.940 3003.560 FORMAT "%8.3" AXIS_PTS_REF Conv_tPntDST_Axis /end AXIS_DESCR
/end CHARACTERISTIC
/begin CHARACTERISTIC Conv_trqLdTempDepLim_GCUR "Temperaturabhängiger Wert zur Begrenzung des Lastmomentes" CURVE 0x80070B3A Gkl_Ws16 6553.500 Trq -3276.800 3276.700 FORMAT "%8.3"
 /begin AXIS_DESCR COM_AXIS Conv_tOilBuf_mp Temp_Cels 10 -3549.940 3003.560 FORMAT "%8.3" AXIS_PTS_REF Conv_tPntDST_Axis /end AXIS_DESCR
/end CHARACTERISTIC
/begin CHARACTERISTIC Conv_trqLd_CW "Codeword für Lastmoment-Berechnung" VALUE 0x80070B4E Val_Wu8 255.0 OneToOne 0.00 255.0 FORMAT "%5.1" /end CHARACTERISTIC
/begin CHARACTERISTIC Conv_TrqResvDebP.tiHiLo_C "/" VALUE 0x80070A68 Kw_Ws16 655350.0 TimeDeb -327680.0 327670.0 FORMAT "%8.1" /end CHARACTERISTIC
/begin CHARACTERISTIC Conv_TrqResvDebP.tiLoHi_C "/" VALUE 0x80070A6A Kw_Ws16 655350.0 TimeDeb -327680.0 327670.0 FORMAT "%8.1" /end CHARACTERISTIC
/begin CHARACTERISTIC Conv_trqResvLoLim_C "minimaler Wert der Momentenreserve" VALUE 0x80070A6C Kw_Ws16 6553.500 Trq -3276.800 3276.700 FORMAT "%8.3" /end CHARACTERISTIC
/begin CHARACTERISTIC Conv_trqResvMinLim_C "Begrenzung der Momentenreserve" VALUE 0x80070A6E Kw_Ws16 6553.500 Trq -3276.800 3276.700 FORMAT "%8.3" /end CHARACTERISTIC
/begin CHARACTERISTIC Conv_trqResvNeutrLvrPos_C "minimaler Wert der Momentenreserve wenn die Wählhebelposition neutral" VALUE 0x80070A70 Kw_Ws16 6553.500 Trq -3276.800 3276.700 FORMAT "%8.3" /end CHARACTERISTIC
/begin CHARACTERISTIC Conv_trqResvPreFlt_C "vorgefilterter Wert der Momentenlast für zusätzliche Momentenreserve" VALUE 0x80070A72 Kw_Ws16 6553.500 Trq -3276.800 3276.700 FORMAT "%8.3" /end CHARACTERISTIC
/begin CHARACTERISTIC Conv_trqResvRepl_C "Ersetzen der Momentenreserve" VALUE 0x80070A74 Kw_Ws16 6553.500 Trq -3276.800 3276.700 FORMAT "%8.3" /end CHARACTERISTIC
/begin CHARACTERISTIC Conv_trqResvTempDep_GCUR "Temperaturabhängiges Reservemoment" CURVE 0x80070B50 Gkl_Ws16 6553.500 Trq -3276.800 3276.700 FORMAT "%8.3"
 /begin AXIS_DESCR COM_AXIS Conv_tOilBuf_mp Temp_Cels 10 -3549.940 3003.560 FORMAT "%8.3" AXIS_PTS_REF Conv_tPntDST_Axis /end AXIS_DESCR
/end CHARACTERISTIC
/begin CHARACTERISTIC Conv_trqStatSqLvrPosNeutr_C "Pumpenmoment wenn Wählhebelposition neutral" VALUE 0x80070A76 Kw_Ws16 6553.500 Trq -3276.800 3276.700 FORMAT "%8.3" /end CHARACTERISTIC
/begin CHARACTERISTIC CoPT_dtrqCurrCorP.Pos_C "Rampenparameter für einen Reduzierenden Vorhaltmomenteingriff des Getriebes (Raildruckpfad)./" VALUE 0x80070B68 Kw_Ws32 3276799.99847 RmpTrq 0.00 3276799.99847 FORMAT "%13.5" EXTENDED_LIMITS -3276800.00000 3276799.99847 /end CHARACTERISTIC
/begin CHARACTERISTIC CoPT_dtrqCurrCorP.Neg_C "Rampenparameter für einen Reduzierenden Vorhaltmomenteingriff des Getriebes (Raildruckpfad)./" VALUE 0x80070B6C Kw_Ws32 3276799.99847 RmpTrq 0.00 3276799.99847 FORMAT "%13.5" EXTENDED_LIMITS -3276800.00000 3276799.99847 /end CHARACTERISTIC
/begin CHARACTERISTIC CoPT_dtrqLeadCorP.Pos_C "/" VALUE 0x80070B70 Kw_Ws32 3276799.99847 RmpTrq 0.00 3276799.99847 FORMAT "%13.5" EXTENDED_LIMITS -3276800.00000 3276799.99847 /end CHARACTERISTIC
/begin CHARACTERISTIC CoPT_dtrqLeadCorP.Neg_C "/" VALUE 0x80070B74 Kw_Ws32 3276799.99847 RmpTrq 0.00 3276799.99847 FORMAT "%13.5" EXTENDED_LIMITS -3276800.00000 3276799.99847 /end CHARACTERISTIC
/begin CHARACTERISTIC CoPT_tiDebCurr_C "Entprellzeit für einen Reduzierenden Vorhaltmomenteingriff des Getriebes (Raildruckpfad)." VALUE 0x80070B78 Kw_Ws32 4294967295.00 TimeDT -2147483648.00 2147483647.00 FORMAT "%13.2" /end CHARACTERISTIC
/begin CHARACTERISTIC CoPT_tiDebLead_C "Entprellzeit für einen Reduzierenden Vorhaltmomenteingriff des Getriebes." VALUE 0x80070B7C Kw_Ws32 4294967295.00 TimeDT -2147483648.00 2147483647.00 FORMAT "%13.2" /end CHARACTERISTIC
/begin CHARACTERISTIC CoTemp_rClgDes_CUR "" CURVE 0x8004B6C0 Cur_Xs16Ws16 2000.000 Prc -1000.000 1000.000 FORMAT "%8.3" EXTENDED_LIMITS -400.0000 399.9878
 /begin AXIS_DESCR STD_AXIS EngDa_tEng Temp_Cels 5 19.96000 139.9600 FORMAT "%8.4" EXTENDED_LIMITS -3549.940 3003.560 DEPOSIT ABSOLUTE /end AXIS_DESCR
/end CHARACTERISTIC
/begin CHARACTERISTIC CoTemp_tEngClntAftRunDes_C "" VALUE 0x8004B6D6 Val_Ws16 6553.500 Temp_Cels -3549.940 3003.560 FORMAT "%8.3" /end CHARACTERISTIC
/begin CHARACTERISTIC CoTemp_tEngClntIniDes_C "" VALUE 0x8004B6D8 Val_Ws16 120.0000 Temp_Cels 19.96000 139.9600 FORMAT "%8.4" EXTENDED_LIMITS -3549.940 3003.560 /end CHARACTERISTIC
/begin CHARACTERISTIC CoTemp_tEngDesBaseNTrq_MAP "" MAP 0x8004B6DA Map_Xs16Ys16Ws16 120.0000 Temp_Cels 19.96000 139.9600 FORMAT "%8.4" EXTENDED_LIMITS -3549.940 3003.560
 /begin AXIS_DESCR STD_AXIS Epm_nEng EngN 10 -16384.00 16383.50 FORMAT "%8.2" DEPOSIT ABSOLUTE /end AXIS_DESCR
 /begin AXIS_DESCR STD_AXIS PthSet_trqInrSet Trq 10 -3276.800 3276.700 FORMAT "%8.3" DEPOSIT ABSOLUTE /end AXIS_DESCR
/end CHARACTERISTIC
/begin CHARACTERISTIC CoTemp_tEngDesBaseTempVel_MAP "" MAP 0x8004B7CE Map_Xs16Ys16Ws16 120.0000 Temp_Cels 19.96000 139.9600 FORMAT "%8.4" EXTENDED_LIMITS -3549.940 3003.560
 /begin AXIS_DESCR STD_AXIS EnvT_t Temp_Cels 6 -3549.940 3003.560 FORMAT "%8.3" DEPOSIT ABSOLUTE /end AXIS_DESCR
 /begin AXIS_DESCR STD_AXIS VehV_v Vel 8 -327.6800 327.6700 FORMAT "%8.4" DEPOSIT ABSOLUTE /end AXIS_DESCR
/end CHARACTERISTIC
/begin CHARACTERISTIC CoTS_tClntEngOutDes_C "" VALUE 0x80070B84 Val_Ws16 6553.500 Temp_Cels -3549.940 3003.560 FORMAT "%8.3" /end CHARACTERISTIC
/begin CHARACTERISTIC CoTS_tClntStopThres_C "" VALUE 0x80070B80 Kw_Ws16 6553.500 Temp_Cels -3549.940 3003.560 FORMAT "%8.3" /end CHARACTERISTIC
/begin CHARACTERISTIC CoTS_tiPT1Neg_C "" VALUE 0x80070B88 Val_Ws32 4294.9672940 TimeDelay_s 0.000002000000001 4294.9672960 FORMAT "%12.7" /end CHARACTERISTIC
/begin CHARACTERISTIC CoTS_tiPT1Pos_C "" VALUE 0x80070B8C Val_Ws32 4294.9672940 TimeDelay_s 0.000002000000001 4294.9672960 FORMAT "%12.7" /end CHARACTERISTIC
/begin CHARACTERISTIC CoVeh_trqLim_CUR "Systemfehlerbegrenzungskennlinie (Radmoment)" CURVE 0x80070B90 Kl_Xs16_Ws16 104856.0 TrqPrp -52428.80 52427.20 FORMAT "%8.2"
 /begin AXIS_DESCR STD_AXIS Epm_nEng EngN 7 -16384.00 16383.50 FORMAT "%8.2" DEPOSIT ABSOLUTE /end AXIS_DESCR
/end CHARACTERISTIC
/begin CHARACTERISTIC CoVMD_swtCCSelVal_C "Schalter für Auswahl Cruise Control (CrCtl, ACCI)" VALUE 0x80070BBC Kw_Wu8 255.0 OneToOne 0.00 255.0 FORMAT "%5.1" /end CHARACTERISTIC
/begin CHARACTERISTIC CoVMD_trqThresCrCtlL_C "Untere Schwelle für CrCtl Status" VALUE 0x80070BC8 Kw_Ws32 429496729.500 TrqPrpHigh -214748364.800 214748364.700 FORMAT "%13.3" /end CHARACTERISTIC
/begin CHARACTERISTIC CoVMD_trqThresCrCtlR_C "Obere Schwelle für CrCtl Status" VALUE 0x80070BCC Kw_Ws32 429496729.500 TrqPrpHigh -214748364.800 214748364.700 FORMAT "%13.3" /end CHARACTERISTIC
/begin CHARACTERISTIC CoVMD_trqThresCtOffLo_C "Untere Schwelle für Schubabschalteverbot" VALUE 0x80070BC0 Kw_Ws32 429496729.500 TrqPrpHigh -214748364.800 214748364.700 FORMAT "%13.3" /end CHARACTERISTIC
/begin CHARACTERISTIC CoVMD_trqThresCtOffUp_C "Obere Schwelle für Schubabschalteverbot" VALUE 0x80070BC4 Kw_Ws32 429496729.500 TrqPrpHigh -214748364.800 214748364.700 FORMAT "%13.3" /end CHARACTERISTIC
/begin CHARACTERISTIC CoVMD_trqThresLLimL_C "Untere Schwelle für LLim Status" VALUE 0x80070BD0 Kw_Ws32 429496729.500 TrqPrpHigh -214748364.800 214748364.700 FORMAT "%13.3" /end CHARACTERISTIC
/begin CHARACTERISTIC CoVMD_trqThresLLimR_C "Obere Schwelle für LLim Status" VALUE 0x80070BD4 Kw_Ws32 429496729.500 TrqPrpHigh -214748364.800 214748364.700 FORMAT "%13.3" /end CHARACTERISTIC
/begin CHARACTERISTIC CoVM_dtrqLeadCorP.Pos_C "/" VALUE 0x80070BB0 Kw_Ws32 3276799.99847 RmpTrq 0.00 3276799.99847 FORMAT "%13.5" EXTENDED_LIMITS -3276800.00000 3276799.99847 /end CHARACTERISTIC
/begin CHARACTERISTIC CoVM_dtrqLeadCorP.Neg_C "/" VALUE 0x80070BB4 Kw_Ws32 3276799.99847 RmpTrq 0.00 3276799.99847 FORMAT "%13.5" EXTENDED_LIMITS -3276800.00000 3276799.99847 /end CHARACTERISTIC
/begin CHARACTERISTIC CoVM_TrqRedMaxP.tiHiLo_C "/" VALUE 0x80070BB8 Kw_Ws16 655350.0 TimeDeb -327680.0 327670.0 FORMAT "%8.1" /end CHARACTERISTIC
/begin CHARACTERISTIC CoVM_TrqRedMaxP.tiLoHi_C "/" VALUE 0x80070BBA Kw_Ws16 655350.0 TimeDeb -327680.0 327670.0 FORMAT "%8.1" /end CHARACTERISTIC
/begin CHARACTERISTIC CoVOM_stEngStopOrd_C "Sollwert für Motorstopp" VALUE 0x80070BD8 Kw_Wu8 255.0 OneToOne 0.00 255.0 FORMAT "%5.1" /end CHARACTERISTIC
/begin CHARACTERISTIC CoVOM_stEngStrtOrd_C "Sollwert für Motorstart" VALUE 0x80070BD9 Kw_Wu8 255.0 OneToOne 0.00 255.0 FORMAT "%5.1" /end CHARACTERISTIC
/begin CHARACTERISTIC CrCtl_AccH_C "Aktionsmaske, um das Beschleunigungssignal zu halten" VALUE 0x80070D82 Kw_Wu16 65535.00 OneToOne 0.00 65535.00 FORMAT "%8.2" /end CHARACTERISTIC
/begin CHARACTERISTIC CrCtl_AccN_C "Aktionsmaske für negative Flanke des Beschleunigungssignal" VALUE 0x80070D84 Kw_Wu16 65535.00 OneToOne 0.00 65535.00 FORMAT "%8.2" /end CHARACTERISTIC
/begin CHARACTERISTIC CrCtl_AccP_C "Aktionsmaske für positive Flanke des Beschleunigungssignals" VALUE 0x80070D86 Kw_Wu16 65535.00 OneToOne 0.00 65535.00 FORMAT "%8.2" /end CHARACTERISTIC
/begin CHARACTERISTIC CrCtl_aConst_CUR "Beschleunigungskennlinie im Zustand ""Cruise""" CURVE 0x80070BE8 Kl_Xs16_Ws16 65.53500 Acc -32.76800 32.76700 FORMAT "%8.5"
 /begin AXIS_DESCR STD_AXIS CrCtl_vDif Vel 8 -327.6800 327.6700 FORMAT "%8.4" DEPOSIT ABSOLUTE /end AXIS_DESCR
/end CHARACTERISTIC
/begin CHARACTERISTIC CrCtl_aDesResAbo_MAP "Beschleunigungskennfeld im Modus ""Resume from Above""" MAP 0x80070C0A Kf_Xs16_Ys16_Ws16 65.53500 Acc -32.76800 32.76700 FORMAT "%8.5"
 /begin AXIS_DESCR STD_AXIS GlbDa_vXFlt Vel 8 -327.6800 327.6700 FORMAT "%8.4" DEPOSIT ABSOLUTE /end AXIS_DESCR
 /begin AXIS_DESCR STD_AXIS CrCtl_vDif Vel 6 -327.6800 327.6700 FORMAT "%8.4" DEPOSIT ABSOLUTE /end AXIS_DESCR
/end CHARACTERISTIC
/begin CHARACTERISTIC CrCtl_aDesResBel_MAP "Beschleunigungskennfeld im Modus ""Resume from Below""" MAP 0x80070C8A Kf_Xs16_Ys16_Ws16 65.53500 Acc -32.76800 32.76700 FORMAT "%8.5"
 /begin AXIS_DESCR STD_AXIS GlbDa_vXFlt Vel 8 -327.6800 327.6700 FORMAT "%8.4" DEPOSIT ABSOLUTE /end AXIS_DESCR
 /begin AXIS_DESCR STD_AXIS CrCtl_vDif Vel 6 -327.6800 327.6700 FORMAT "%8.4" DEPOSIT ABSOLUTE /end AXIS_DESCR
/end CHARACTERISTIC
/begin CHARACTERISTIC CrCtl_AlwdGear_C "Maske für erlaubte Gänge" VALUE 0x80070D18 Kw_Wu32 4294967295.00 OneToOne 0.00 4294967295.00 FORMAT "%13.2" /end CHARACTERISTIC
/begin CHARACTERISTIC CrCtl_aMaxShOff_C "Maximal erlaubte Beschleunigung der Fahrgeschwindigkeitsregelung" VALUE 0x80070D1C Kw_Ws16 65.53500 Acc -32.76800 32.76700 FORMAT "%8.5" /end CHARACTERISTIC
/begin CHARACTERISTIC CrCtl_aMax_C "Maximal zulässige Beschleunigung für Fahrgeschwindigkeitsregelung" VALUE 0x80070D0A Kw_Ws16 65.53500 Acc -32.76800 32.76700 FORMAT "%8.5" /end CHARACTERISTIC
/begin CHARACTERISTIC CrCtl_aMinShOff_C "Maximal erlaubte Verzögerung der Fahrgeschwindigkeitsregelung" VALUE 0x80070D1E Kw_Ws16 65.53500 Acc -32.76800 32.76700 FORMAT "%8.5" /end CHARACTERISTIC
/begin CHARACTERISTIC CrCtl_aMinSVA_C "Minimale Beschleunigung für die initialisierung SVA" VALUE 0x80070D5C Kw_Ws16 65.53500 Acc -32.76800 32.76700 FORMAT "%8.5" /end CHARACTERISTIC
/begin CHARACTERISTIC CrCtl_aMin_C "Minimal zulässige Beschleunigung für Fahrgeschwindigkeitsregelung" VALUE 0x80070D0C Kw_Ws16 65.53500 Acc -32.76800 32.76700 FORMAT "%8.5" /end CHARACTERISTIC
/begin CHARACTERISTIC CrCtl_aTipDifPrpMax_C "Obere Schwelle für Beschleunigungsbegrenzung" VALUE 0x80070D5E Kw_Ws16 65.53500 Acc -32.76800 32.76700 FORMAT "%8.5" /end CHARACTERISTIC
/begin CHARACTERISTIC CrCtl_aTipDifPrpMin_C "Untere Schwelle für Beschleunigungsbegrenzung" VALUE 0x80070D60 Kw_Ws16 65.53500 Acc -32.76800 32.76700 FORMAT "%8.5" /end CHARACTERISTIC
/begin CHARACTERISTIC CrCtl_ClrVelDesMsk_C "" VALUE 0x80070D20 Kw_Wu32 4294967295.00 OneToOne 0.00 4294967295.00 FORMAT "%13.2" /end CHARACTERISTIC
/begin CHARACTERISTIC CrCtl_DecH_C "Aktionsmaske, um das Verzögerunssignal zu halten" VALUE 0x80070D88 Kw_Wu16 65535.00 OneToOne 0.00 65535.00 FORMAT "%8.2" /end CHARACTERISTIC
/begin CHARACTERISTIC CrCtl_DecN_C "Aktionsmaske für negative Flanke des Verzögerungssignals" VALUE 0x80070D8A Kw_Wu16 65535.00 OneToOne 0.00 65535.00 FORMAT "%8.2" /end CHARACTERISTIC
/begin CHARACTERISTIC CrCtl_DecP_C "Aktionsmaske für positive Flanke des Verzögerungssignals" VALUE 0x80070D8C Kw_Wu16 65535.00 OneToOne 0.00 65535.00 FORMAT "%8.2" /end CHARACTERISTIC
/begin CHARACTERISTIC CrCtl_facSVANgv_C "Bedingungsfaktor für den Abgleich der Geschwindigkeit zu negativer Beschleunigung" VALUE 0x80070D62 Kw_Ws16 511.9922 Fact1 -256.0000 255.9922 FORMAT "%8.4" /end CHARACTERISTIC
/begin CHARACTERISTIC CrCtl_facSVAPsv_C "Bedingungsfaktor für den Abgleich der Geschwindigkeit zu positiver Beschleunigung" VALUE 0x80070D64 Kw_Ws16 511.9922 Fact1 -256.0000 255.9922 FORMAT "%8.4" /end CHARACTERISTIC
/begin CHARACTERISTIC CrCtl_FastShDwn_C "Maske zum schnellen Abschalten der Fahrgeschwindigkeitsregelung" VALUE 0x80070D24 Kw_Wu32 4294967295.00 OneToOne 0.00 4294967295.00 FORMAT "%13.2" /end CHARACTERISTIC
/begin CHARACTERISTIC CrCtl_IrrevShOff_C "Maske zum irreversiblen Abschalten der Fahrgeschwindigkeitsregelung" VALUE 0x80070D28 Kw_Wu32 4294967295.00 OneToOne 0.00 4294967295.00 FORMAT "%13.2" /end CHARACTERISTIC
/begin CHARACTERISTIC CrCtl_MdlShDown_C "" VALUE 0x80070D2C Kw_Wu32 4294967295.00 OneToOne 0.00 4294967295.00 FORMAT "%13.2" /end CHARACTERISTIC
/begin CHARACTERISTIC CrCtl_nMaxDif_C "Differenz zur maximalen Motordrehzahl zum Abschalten des CrCtl" VALUE 0x80070D30 Kw_Ws16 32767.50 EngN -16384.00 16383.50 FORMAT "%8.2" /end CHARACTERISTIC
/begin CHARACTERISTIC CrCtl_nMin_C "minimale Motordrehzahl zum Betrieb der Fahrgeschwindigkeitsregelung" VALUE 0x80070D32 Kw_Ws16 32767.50 EngN -16384.00 16383.50 FORMAT "%8.2" /end CHARACTERISTIC
/begin CHARACTERISTIC CrCtl_ResP_C "Aktionsmaske für positive Flanke des ""Resume"" Signals" VALUE 0x80070D8E Kw_Wu16 65535.00 OneToOne 0.00 65535.00 FORMAT "%8.2" /end CHARACTERISTIC
/begin CHARACTERISTIC CrCtl_ResVCrCTDesMsk_C "" VALUE 0x80070D34 Kw_Wu32 4294967295.00 OneToOne 0.00 4294967295.00 FORMAT "%13.2" /end CHARACTERISTIC
/begin CHARACTERISTIC CrCtl_SetP_C "Aktionsmaske für positive Flanke des ""Set"" Signals" VALUE 0x80070D90 Kw_Wu16 65535.00 OneToOne 0.00 65535.00 FORMAT "%8.2" /end CHARACTERISTIC
/begin CHARACTERISTIC CrCtl_stStM_C "Statuswort für Kodierung der Merkmale der Fahrgeschwindigkeitsregelung (Codeword)" VALUE 0x80070D66 Kw_Wu8 255.0 OneToOne 0.00 255.0 FORMAT "%5.1" /end CHARACTERISTIC
/begin CHARACTERISTIC CrCtl_stSVA_C "Maske, über welche der Zustand SVA freigegeben wird" VALUE 0x80070D68 Kw_Wu16 65535.00 OneToOne 0.00 65535.00 FORMAT "%8.2" /end CHARACTERISTIC
/begin CHARACTERISTIC CrCtl_tiAccMax_C "Entprellzeit für die maximale erlaubte Beschleunigung der Fahrgeschwindigkeitsregelung" VALUE 0x80070D38 Kw_Ws16 655.3500 Time_s -327.6800 327.6700 FORMAT "%8.4" /end CHARACTERISTIC
/begin CHARACTERISTIC CrCtl_tiAccMin_C "Entprellzeit für die minimale erlaubte Beschleunigung der Fahrgeschwindigkeitsregelung" VALUE 0x80070D3A Kw_Ws16 655.3500 Time_s -327.6800 327.6700 FORMAT "%8.4" /end CHARACTERISTIC
/begin CHARACTERISTIC CrCtl_tiAccReqMdl_C "Mittlere Abschaltzeit der Fahrgeschwindigkeitsregelung" VALUE 0x80070D3C Kw_Ws16 655350.0 Time_ms -327680.0 327670.0 FORMAT "%8.1" /end CHARACTERISTIC
/begin CHARACTERISTIC CrCtl_tiAccReqSlw_C "Lange Abschaltzeit der Fahrgeschwindigkeitsregelung" VALUE 0x80070D3E Kw_Ws16 655350.0 Time_ms -327680.0 327670.0 FORMAT "%8.1" /end CHARACTERISTIC
/begin CHARACTERISTIC CrCtl_tiDifFil_C "Steigungsbegrenzung für CrCtl_tiDifFil" VALUE 0x80070D0E Kw_Ws16 655350.0 Time_ms -327680.0 327670.0 FORMAT "%8.1" /end CHARACTERISTIC
/begin CHARACTERISTIC CrCtl_tiFdyActv_C "Entprellzeit für Abschaltung bei Eingriff eines Fahrdynamiksystems" VALUE 0x80070D40 Kw_Ws16 655.3500 Time_s -327.6800 327.6700 FORMAT "%8.4" /end CHARACTERISTIC
/begin CHARACTERISTIC CrCtl_tiFilAcc_C "Filterzeit für Modus ""Acceleration"" / ""Deceleration""" VALUE 0x80070D10 Kw_Ws16 655350.0 Time_ms -327680.0 327670.0 FORMAT "%8.1" /end CHARACTERISTIC
/begin CHARACTERISTIC CrCtl_tiFilCruise_C "Filterzeit für Modus ""Cruise""" VALUE 0x80070D12 Kw_Ws16 655350.0 Time_ms -327680.0 327670.0 FORMAT "%8.1" /end CHARACTERISTIC
/begin CHARACTERISTIC CrCtl_tiFilRes_C "Filterzeit für Modus ""Resume""" VALUE 0x80070D14 Kw_Ws16 655350.0 Time_ms -327680.0 327670.0 FORMAT "%8.1" /end CHARACTERISTIC
/begin CHARACTERISTIC CrCtl_tiMoF_C "Entprellzeit für Abschaltung durch Überwachung" VALUE 0x80070D42 Kw_Ws16 655.3500 Time_s -327.6800 327.6700 FORMAT "%8.4" /end CHARACTERISTIC
/begin CHARACTERISTIC CrCtl_tiOvrrd_C "Entprellzeit für Abschaltung durch langes Überreiten" VALUE 0x80070D44 Kw_Ws16 655.3500 Time_s -327.6800 327.6700 FORMAT "%8.4" /end CHARACTERISTIC
/begin CHARACTERISTIC CrCtl_tiVelMax_C "Entprellzeit für Abschaltung durch deutliche Überschreitung der Zielgeschwindigkeit" VALUE 0x80070D46 Kw_Ws16 655.3500 Time_s -327.6800 327.6700 FORMAT "%8.4" /end CHARACTERISTIC
/begin CHARACTERISTIC CrCtl_tiVelMin_C "Entprellzeit für Abschaltung durch deutliche Unterschreitung der Zielgeschwindigkeit" VALUE 0x80070D48 Kw_Ws16 655.3500 Time_s -327.6800 327.6700 FORMAT "%8.4" /end CHARACTERISTIC
/begin CHARACTERISTIC CrCtl_uShOff_C "Entprellzeit für Abschaltung durch niedrige Batteriespannung" VALUE 0x80070D4A Kw_Ws16 1310700. Volt_Batt -655360.0 655340.0 FORMAT "%8.1" /end CHARACTERISTIC
/begin CHARACTERISTIC CrCtl_vActvMax_C "Maximale Fahrzeuggeschwindigkeit für Aktivierung der Fahrgeschwindigkeitsregelung" VALUE 0x80070D4C Kw_Ws16 655.3500 Vel -327.6800 327.6700 FORMAT "%8.4" /end CHARACTERISTIC
/begin CHARACTERISTIC CrCtl_vActvMin_C "Minimale Fahrzeuggeschwindigkeit für Aktivierung der Fahrgeschwindigkeitsregelung" VALUE 0x80070D4E Kw_Ws16 655.3500 Vel -327.6800 327.6700 FORMAT "%8.4" /end CHARACTERISTIC
/begin CHARACTERISTIC CrCtl_vCrCtlMax_C "Maximale Fahrzeuggeschwindigkeit für Betrieb der Fahrgeschwindigkeitsregelung" VALUE 0x80070D50 Kw_Ws16 655.3500 Vel -327.6800 327.6700 FORMAT "%8.4" /end CHARACTERISTIC
/begin CHARACTERISTIC CrCtl_vCrCtlMin_C "Minimale Fahrzeuggeschwindigkeit für Betrieb der Fahrgeschwindigkeitsregelung" VALUE 0x80070D52 Kw_Ws16 655.3500 Vel -327.6800 327.6700 FORMAT "%8.4" /end CHARACTERISTIC
/begin CHARACTERISTIC CrCtl_vDesMax_C "Maximale Fahrgeschwindigkeit der Fahrgeschwindigkeitsregelung" VALUE 0x80070D6A Kw_Ws16 655.3500 Vel -327.6800 327.6700 FORMAT "%8.4" /end CHARACTERISTIC
/begin CHARACTERISTIC CrCtl_vDesMin_C "Minimale Fahrgeschwindigkeit der Fahrgeschwindigkeitsregelung" VALUE 0x80070D6C Kw_Ws16 655.3500 Vel -327.6800 327.6700 FORMAT "%8.4" /end CHARACTERISTIC
/begin CHARACTERISTIC CrCtl_vDiffCruiseMax_C "Obere Begrenzung für automatische Wiedergabe" VALUE 0x80070D6E Kw_Ws16 655.3500 Vel -327.6800 327.6700 FORMAT "%8.4" /end CHARACTERISTIC
/begin CHARACTERISTIC CrCtl_vDiffCruiseMin_C "Untere Begrenzung für automatische Wiedergabe" VALUE 0x80070D70 Kw_Ws16 655.3500 Vel -327.6800 327.6700 FORMAT "%8.4" /end CHARACTERISTIC
/begin CHARACTERISTIC CrCtl_vDifMax_C "maximale Abweichung der Istgeschwindigkeit zur Sollgeschwindigkeit nach oben" VALUE 0x80070D54 Kw_Ws16 655.3500 Vel -327.6800 327.6700 FORMAT "%8.4" /end CHARACTERISTIC
/begin CHARACTERISTIC CrCtl_vDifMin_C "maximale Abweichung der Istgeschwindigkeit zur Sollgeschwindigkeit nach unten" VALUE 0x80070D56 Kw_Ws16 655.3500 Vel -327.6800 327.6700 FORMAT "%8.4" /end CHARACTERISTIC
/begin CHARACTERISTIC CrCtl_vDifOvrrd_C "Geschwindigkeitsabweichung notwendig für Abschaltung durch langes Überreiten" VALUE 0x80070D58 Kw_Ws16 655.3500 Vel -327.6800 327.6700 FORMAT "%8.4" /end CHARACTERISTIC
/begin CHARACTERISTIC CrCtl_vDifSVAMax_C "Maximale Abweichungsgeschwindigkeit für SVA" VALUE 0x80070D72 Kw_Ws16 655.3500 Vel -327.6800 327.6700 FORMAT "%8.4" /end CHARACTERISTIC
/begin CHARACTERISTIC CrCtl_vTipCruMax_C "Begrenzung zum Unterscheiden zwischen Tip-Up und Set" VALUE 0x80070D74 Kw_Ws16 655.3500 Vel -327.6800 327.6700 FORMAT "%8.4" /end CHARACTERISTIC
/begin CHARACTERISTIC CrCtl_vTipCruMin_C "Begrenzung zum Unterscheiden zwischen Tip-Down und Set" VALUE 0x80070D76 Kw_Ws16 655.3500 Vel -327.6800 327.6700 FORMAT "%8.4" /end CHARACTERISTIC
/begin CHARACTERISTIC CrCtl_vTipMaxLim_C "Maximale Begrenzungen bei maximaler Beschleunigung" VALUE 0x80070D78 Kw_Ws16 655.3500 Vel -327.6800 327.6700 FORMAT "%8.4" /end CHARACTERISTIC
/begin CHARACTERISTIC CrCtl_vTipMax_C "" VALUE 0x80070D7A Kw_Ws16 655.3500 Vel -327.6800 327.6700 FORMAT "%8.4" /end CHARACTERISTIC
/begin CHARACTERISTIC CrCtl_vTipMinLim_C "Maximale Schwelle bei minimaler Beschleunigung" VALUE 0x80070D7C Kw_Ws16 655.3500 Vel -327.6800 327.6700 FORMAT "%8.4" /end CHARACTERISTIC
/begin CHARACTERISTIC CrCtl_vTipMin_C "Maximale Delta Geschwindigkeit beim Tip-Down" VALUE 0x80070D7E Kw_Ws16 655.3500 Vel -327.6800 327.6700 FORMAT "%8.4" /end CHARACTERISTIC
/begin CHARACTERISTIC CrCtl_vTip_C "Delta Geschwindigkeitswert für obere Schwelle" VALUE 0x80070D80 Kw_Ws16 655.3500 Vel -327.6800 327.6700 FORMAT "%8.4" /end CHARACTERISTIC
/begin CHARACTERISTIC CThmst_Pwm.tiPer_C "/" VALUE 0x8004B614 Kw_Ws16 9.900000 Period 0.1000000 10.00000 FORMAT "%8.5" EXTENDED_LIMITS -3276.800 3276.700 /end CHARACTERISTIC
/begin CHARACTERISTIC CThmst_Pwm.stLvl_C "/" VALUE 0x8004B616 Kw_Wu8 1.000 OneToOne 0.00 1.000 FORMAT "%5.3" EXTENDED_LIMITS 0.00 255.0 /end CHARACTERISTIC
/begin CHARACTERISTIC CThmst_Pwm.rMaxDty_C "/" VALUE 0x8004B618 Kw_Ws16 100.0000 DtyCyc 0.00 100.0000 FORMAT "%8.4" EXTENDED_LIMITS -327.6800 327.6700 /end CHARACTERISTIC
/begin CHARACTERISTIC CThmst_Pwm.rPerUn_C "/" VALUE 0x8004B61A Kw_Ws16 6553.500 Period -3276.800 3276.700 FORMAT "%8.3" /end CHARACTERISTIC
/begin CHARACTERISTIC CThmst_Pwm.tiPh_C "/" VALUE 0x8004B61C Val_Ws16 65535.00 OneToOne -32768.00 32767.00 FORMAT "%8.2" /end CHARACTERISTIC
/begin CHARACTERISTIC CThmst_PwmOut.rMin_C "/" VALUE 0x8004B61E Kw_Ws16 100.0000 DtyCyc 0.00 100.0000 FORMAT "%8.4" EXTENDED_LIMITS -327.6800 327.6700 /end CHARACTERISTIC
/begin CHARACTERISTIC CThmst_PwmOut.rMax_C "/" VALUE 0x8004B620 Kw_Ws16 100.0000 DtyCyc 0.00 100.0000 FORMAT "%8.4" EXTENDED_LIMITS -327.6800 327.6700 /end CHARACTERISTIC
/begin CHARACTERISTIC CThmst_PwmOut.tiBtwTstSCB_C "/" VALUE 0x8004B622 Kw_Ws16 1000.000 Time_ms 0.00 1000.000 FORMAT "%8.3" EXTENDED_LIMITS -327680.0 327670.0 /end CHARACTERISTIC
/begin CHARACTERISTIC CThmst_PwmOut.tiBtwTstOT_C "/" VALUE 0x8004B624 Kw_Ws16 327.6700 Time_s 0.00 327.6700 FORMAT "%8.4" EXTENDED_LIMITS -327.6800 327.6700 /end CHARACTERISTIC
/begin CHARACTERISTIC CThmst_PwmOut.numTstMax_C "/" VALUE 0x8004B626 Kw_Wu16 65535.00 OneToOne 0.00 65535.00 FORMAT "%8.2" /end CHARACTERISTIC
/begin CHARACTERISTIC CThmst_PwmOut.swtBattCor_C "/" VALUE 0x8004B628 Kw_Wu8 1.000 OneToOne 0.00 1.000 FORMAT "%5.3" EXTENDED_LIMITS 0.00 255.0 /end CHARACTERISTIC
/begin CHARACTERISTIC CThmst_PwmOut.swtPsInv_C "/" VALUE 0x8004B629 Kw_Wu8 255.0 OneToOne 0.00 255.0 FORMAT "%5.1" /end CHARACTERISTIC
/begin CHARACTERISTIC CThmst_rCnv_CUR "" CURVE 0x8004B62A Cur_Xs16Ws16 100.0000 DtyCyc 0.00 100.0000 FORMAT "%8.4" EXTENDED_LIMITS -327.6800 327.6700
 /begin AXIS_DESCR STD_AXIS CThmst_r Prc 16 -400.0000 399.9878 FORMAT "%8.4" DEPOSIT ABSOLUTE /end AXIS_DESCR
/end CHARACTERISTIC
/begin CHARACTERISTIC CThmst_stPwrStgDiaDis_C "" VALUE 0x8004B66C Val_Wu8 255.0 OneToOne 0.00 255.0 FORMAT "%5.1" /end CHARACTERISTIC
/begin CHARACTERISTIC CThmst_stPwrStgDis_C "" VALUE 0x8004B66D Val_Wu8 255.0 OneToOne 0.00 255.0 FORMAT "%5.1" /end CHARACTERISTIC
/begin CHARACTERISTIC CtT_dtElWaHt_CA "Temperaturerhöhung der elektrischen Zusatzwasserheizer" VAL_BLK 0x80070D94 ValA_Ws16 1.599976 Temp_Kelv_Sec_CtT_Mon -0.8000000 0.7999756 FORMAT "%9.7" NUMBER 3 /end CHARACTERISTIC
/begin CHARACTERISTIC CtT_dtEnv_CUR "Temperaturabfall bezogen auf die Temperaturdifferenz über den Kühler" CURVE 0x80070D9A Cur_Xs16Ws16 1.599976 Temp_Kelv_Sec_CtT_Mon -0.8000000 0.7999756 FORMAT "%9.7"
 /begin AXIS_DESCR STD_AXIS CtT_tDiffRadiator Temp_Cels 15 -3549.940 3003.560 FORMAT "%8.3" DEPOSIT ABSOLUTE /end AXIS_DESCR
/end CHARACTERISTIC
/begin CHARACTERISTIC CtT_dtFlWaHt_C "Temperaturerhöhung des treibstoffbetriebenen Zusatzwasserheizers" VALUE 0x80070DD8 Val_Ws16 1.599976 Temp_Kelv_Sec_CtT_Mon -0.8000000 0.7999756 FORMAT "%9.7" /end CHARACTERISTIC
/begin CHARACTERISTIC CtT_dtPwrIncr_CUR "Temperaturerhöhung bezogen auf das innere Moment" CURVE 0x80070DF0 Cur_Xs16Ws16 1.599976 Temp_Kelv_Sec_CtT_Mon -0.8000000 0.7999756 FORMAT "%9.7"
 /begin AXIS_DESCR STD_AXIS CtT_pwrIncrEngPT1 Pwr2 5 -617662.2 617643.4 FORMAT "%8.1" DEPOSIT ABSOLUTE /end AXIS_DESCR
/end CHARACTERISTIC
/begin CHARACTERISTIC CtT_nThres_C "Minimale Drehzahlschwelle" VALUE 0x80070DDA Val_Wu16 32767.50 EngN 0.00 32767.50 FORMAT "%8.2" /end CHARACTERISTIC
/begin CHARACTERISTIC CtT_swtAirMod_CW "Auswahlschalter Umgebungslufttemperatur" VALUE 0x80070DDC Val_Ws8 255.0 OneToOne -128.0 127.0 FORMAT "%5.1" /end CHARACTERISTIC
/begin CHARACTERISTIC CtT_swtFdbkMod_CW "Auswahlschalter Kühlmitteltemperatur" VALUE 0x80070DDD Val_Ws8 255.0 OneToOne -128.0 127.0 FORMAT "%5.1" /end CHARACTERISTIC
/begin CHARACTERISTIC CtT_tClntLo_C "Minimale Kühlmitteltemperaturschwelle zur Fehlererkennung" VALUE 0x80070DDE Val_Ws16 6553.500 Temp_Cels -3549.940 3003.560 FORMAT "%8.3" /end CHARACTERISTIC
/begin CHARACTERISTIC CtT_tClntMod_C "Minimale Kühlmitteltemperaturschwelle zur Freigabe der Fehlererkennung" VALUE 0x80070DE0 Val_Ws16 6553.500 Temp_Cels -3549.940 3003.560 FORMAT "%8.3" /end CHARACTERISTIC
/begin CHARACTERISTIC CtT_tiPT1_C "Zeitkonstante zur Glättung des inneren Momentes" VALUE 0x80070E08 Val_Ws32 4294.9672940 TimeDelay_s 0.000002000000001 4294.9672960 FORMAT "%12.7" /end CHARACTERISTIC
/begin CHARACTERISTIC CtT_tiTst_C "Maximal zulässige Dauer der Thermostatdiagnose nach Motorstart." VALUE 0x80070DE4 Val_Ws32 42949672.9500 Time_s -21474836.4800 21474836.4700 FORMAT "%13.4" /end CHARACTERISTIC
/begin CHARACTERISTIC CtT_tThresHi_C "Maximal zulässige Motorstarttemperatur" VALUE 0x80070DE8 Val_Ws16 6553.500 Temp_Cels -3549.940 3003.560 FORMAT "%8.3" /end CHARACTERISTIC
/begin CHARACTERISTIC CtT_tThresLo_C "Minimal zulässige Kühlmitteltemperatur" VALUE 0x80070DEA Val_Ws16 6553.500 Temp_Cels -3549.940 3003.560 FORMAT "%8.3" /end CHARACTERISTIC
/begin CHARACTERISTIC CtT_vThres_C "Minimale Fahrzeuggeschwindigkeitsschwelle" VALUE 0x80070DEC Val_Ws16 655.3500 Vel -327.6800 327.6700 FORMAT "%8.4" /end CHARACTERISTIC
/begin CHARACTERISTIC FrmMng_trqClthTSCDec_C "" VALUE 0x800708B0 Kw_Ws16 6553.500 Trq -3276.800 3276.700 FORMAT "%8.3" /end CHARACTERISTIC
/begin CHARACTERISTIC FrmMng_trqClthTSCInc_C "" VALUE 0x800708B2 Kw_Ws16 6553.500 Trq -3276.800 3276.700 FORMAT "%8.3" /end CHARACTERISTIC
/begin CHARACTERISTIC FrmMng_trqClthTSCPrt_C "" VALUE 0x800708B4 Kw_Ws16 6553.500 Trq -3276.800 3276.700 FORMAT "%8.3" /end CHARACTERISTIC
/begin CHARACTERISTIC SSE_numEngStart2StopMax_C "Maximal erlaubte Anzahl Startabbrüche" VALUE 0x80070BDA Kw_Wu8 255.0 OneToOne 0.00 255.0 FORMAT "%5.1" /end CHARACTERISTIC
/begin CHARACTERISTIC SSE_tiEngStopASTDebPos_C "Entprellzeit Motorstopp bei Automatikgetriebe" VALUE 0x80070BDC Kw_Ws16 655350.0 TimeDeb -327680.0 327670.0 FORMAT "%8.1" /end CHARACTERISTIC
/begin CHARACTERISTIC SSE_tiEngStopMTDebPos_C "Entprellzeit Motorstopp bei Handschaltgetriebe" VALUE 0x80070BDE Kw_Ws16 655350.0 TimeDeb -327680.0 327670.0 FORMAT "%8.1" /end CHARACTERISTIC
/begin CHARACTERISTIC SSE_tiEngStrtAbortion1DebPos_C "Entprellzeit Startabbruchbedingung1" VALUE 0x80070BE0 Kw_Ws16 655350.0 TimeDeb -327680.0 327670.0 FORMAT "%8.1" /end CHARACTERISTIC
/begin CHARACTERISTIC SSE_tiEngStrtAbortion2DebPos_C "Entprellzeit Startabbruchbedingung2" VALUE 0x80070BE2 Kw_Ws16 655350.0 TimeDeb -327680.0 327670.0 FORMAT "%8.1" /end CHARACTERISTIC
/begin CHARACTERISTIC SSE_vXMaxSinceStrtMin_C "Schwelle der maximalen Fahrgeschwindigkeit nach dem Start" VALUE 0x80070BE4 Kw_Ws16 655.3500 Vel -327.6800 327.6700 FORMAT "%8.4" /end CHARACTERISTIC
/begin CHARACTERISTIC SSE_vXMinEngStop_C "Schwelle der minimalen Fahrgeschwindigkeit für Motorstopp" VALUE 0x80070BE6 Kw_Ws16 655.3500 Vel -327.6800 327.6700 FORMAT "%8.4" /end CHARACTERISTIC
/begin MEASUREMENT Air_dpFltCACDs "" SWORD PreshPa_sec 1 100 -32768.00 32767.00 FORMAT "%8.2" ECU_ADDRESS 0xD0006BBC /end MEASUREMENT
/begin MEASUREMENT Air_dtTCACDs "Änderungsgeschwindigkeit des Temperaturwerts." SWORD TempCels_100ms 1 100 -32768.00 32767.00 FORMAT "%8.2" ECU_ADDRESS 0xD0006BBE /end MEASUREMENT
/begin MEASUREMENT Air_pCACDs "PT1-gefilterter Wert des Drucks nach dem Ladeluftkühler" SWORD Pres_hPa 1 100 -32768.00 3500.00 FORMAT "%8.2" ECU_ADDRESS 0xD0006BC2 /end MEASUREMENT
/begin MEASUREMENT Air_pSensPCACDs "Erfasster Wert des Drucks nach dem Ladeluftkühler" SWORD Pres_hPa 1 100 -32768.00 3500.00 FORMAT "%8.2" ECU_ADDRESS 0xD0006BCC /end MEASUREMENT
/begin MEASUREMENT Air_pUnFltPCACDs "Ungefilterter Wert des Drucks nach dem Ladeluftkühler" SWORD Pres_hPa 1 100 -32768.00 3500.00 FORMAT "%8.2" ECU_ADDRESS 0xD0006BCE /end MEASUREMENT
/begin MEASUREMENT Air_tCACDs "Temperatur nach dem Ladeluftkühler" SWORD Temp_Cels 1 100 -3549.940 3003.560 FORMAT "%8.3" ECU_ADDRESS 0xD0006BDC /end MEASUREMENT
/begin MEASUREMENT Air_tSensTCACDs "Erfasster Wert der Lufttemperatur nach dem Ladeluftkühler" SWORD Temp_Cels 1 100 -3549.940 3003.560 FORMAT "%8.3" ECU_ADDRESS 0xD0006BE4 /end MEASUREMENT
/begin MEASUREMENT Air_uRawPCACDs "Spannungsrohwert aus ADC" SWORD Volt 1 100 -6553.600 6553.400 FORMAT "%8.3" ECU_ADDRESS 0xD0006BE8 /end MEASUREMENT
/begin MEASUREMENT Air_uRawTCACDs "Der aus ADC für CACDsT erfasste Rohspannungswert" SWORD Volt 1 100 -6553.600 6553.400 FORMAT "%8.3" ECU_ADDRESS 0xD0006BEA /end MEASUREMENT
/begin MEASUREMENT CByVlv_st "Status der Kompressor bypass ventil" UBYTE OneToOne 1 100 0.00 255.0 FORMAT "%5.1" ECU_ADDRESS 0xD0008F22 /end MEASUREMENT
/begin MEASUREMENT CByVlv_stPs "Digitalausgang des Stellers nach Diagnose" UBYTE OneToOne 1 100 0.00 255.0 FORMAT "%5.1" ECU_ADDRESS 0xD0008F23 /end MEASUREMENT
/begin MEASUREMENT CEngDsT_dt "" SWORD TempCels_100ms 1 100 -32768.00 32767.00 FORMAT "%8.2" ECU_ADDRESS 0xD0006C14 /end MEASUREMENT
/begin MEASUREMENT CEngDsT_dtDynTst_mp "" SWORD TempDiff_Kelv 1 100 -3276.800 3276.700 FORMAT "%8.3" ECU_ADDRESS 0xC0000580 /end MEASUREMENT
/begin MEASUREMENT CEngDsT_stErrIni "" UBYTE OneToOne 1 100 0.00 255.0 FORMAT "%5.1" ECU_ADDRESS 0xD0008F24 /end MEASUREMENT
/begin MEASUREMENT CEngDsT_t "" SWORD Temp_Cels 1 100 -3549.940 3003.560 FORMAT "%8.3" ECU_ADDRESS 0xD000694A /end MEASUREMENT
/begin MEASUREMENT CEngDsT_tEndDynTst_mp "" SWORD Temp_Cels 1 100 -3549.940 3003.560 FORMAT "%8.3" ECU_ADDRESS 0xC0000582 /end MEASUREMENT
/begin MEASUREMENT CEngDsT_tiDynTst_mp "" SLONG Time_s 1 100 -21474836.4800 21474836.4700 FORMAT "%13.4" ECU_ADDRESS 0xC0000584 /end MEASUREMENT
/begin MEASUREMENT CEngDsT_tiMaxDynTst "" SLONG Time_s 1 100 -21474836.4800 21474836.4700 FORMAT "%13.4" ECU_ADDRESS 0xD00042D4 /end MEASUREMENT
/begin MEASUREMENT CEngDsT_tSens "" SWORD Temp_Cels 1 100 -3549.940 3003.560 FORMAT "%8.3" ECU_ADDRESS 0xD0006C16 /end MEASUREMENT
/begin MEASUREMENT CEngDsT_tStrt "" SWORD Temp_Cels 1 100 -3549.940 3003.560 FORMAT "%8.3" ECU_ADDRESS 0xD0006C18 /end MEASUREMENT
/begin MEASUREMENT CEngDsT_t_mp "" SWORD Temp_Cels 1 100 -3549.940 3003.560 FORMAT "%8.3" ECU_ADDRESS 0xC000057E /end MEASUREMENT
/begin MEASUREMENT CEngDsT_uRaw "" SWORD Volt 1 100 -6553.600 6553.400 FORMAT "%8.3" ECU_ADDRESS 0xD0006C1A /end MEASUREMENT
/begin MEASUREMENT CEngUsT_t "" SWORD Temp_Cels 1 100 -3549.940 3003.560 FORMAT "%8.3" ECU_ADDRESS 0xD0006C1C /end MEASUREMENT
/begin MEASUREMENT CEngUsT_tSens "" SWORD Temp_Cels 1 100 -3549.940 3003.560 FORMAT "%8.3" ECU_ADDRESS 0xD0006C1E /end MEASUREMENT
/begin MEASUREMENT CEngUsT_uRaw "" SWORD Volt 1 100 -6553.600 6553.400 FORMAT "%8.3" ECU_ADDRESS 0xD0006C20 /end MEASUREMENT
/begin MEASUREMENT Clth_st "Kupplungsstatusinformation" UBYTE OneToOne 1 100 0.00 255.0 FORMAT "%5.1" ECU_ADDRESS 0xD0008F25 /end MEASUREMENT
/begin MEASUREMENT Clth_stIntDebVal "Interner entprellter Kupplungssensorwert" UBYTE OneToOne 1 100 0.00 255.0 FORMAT "%5.1" ECU_ADDRESS 0xD0008F26 /end MEASUREMENT
/begin MEASUREMENT Clth_stLastGear "Gang aus letztem Zyklus" UBYTE OneToOne 1 100 0.00 255.0 FORMAT "%5.1" ECU_ADDRESS 0xD0008F27 /end MEASUREMENT
/begin MEASUREMENT Clth_stOldGear "Letzter gültiger Gang" UBYTE OneToOne 1 100 0.00 255.0 FORMAT "%5.1" ECU_ADDRESS 0xD0008F28 /end MEASUREMENT
/begin MEASUREMENT Clth_stOpnMark "Kupplungszustandsmarker: Kupplung ist offen" UBYTE OneToOne 1 100 0.00 255.0 FORMAT "%5.1" ECU_ADDRESS 0xD0008F29 /end MEASUREMENT
/begin MEASUREMENT Clth_stRaw "Rohkupplungssignal" UBYTE OneToOne 1 100 0.00 255.0 FORMAT "%5.1" ECU_ADDRESS 0xD0008F2A /end MEASUREMENT
/begin MEASUREMENT CmbChb_ctEngRevLogBuf1_mp "Meßpunkt für die Anzahl bewerteten Motorumdrehungen der Kurbelwelle des Puffer1" UWORD OneToOne 1 100 0.00 65535.00 FORMAT "%8.2" ECU_ADDRESS 0xC0000588 /end MEASUREMENT
/begin MEASUREMENT CmbChb_ctEngRevLogBuf2_mp "Meßpunkt für die Anzahl bewerteten Motorumdrehungen der Kurbelwelle des Puffer2" UWORD OneToOne 1 100 0.00 65535.00 FORMAT "%8.2" ECU_ADDRESS 0xC000058A /end MEASUREMENT
/begin MEASUREMENT CmbChb_ctEngRevLogMem_mp "Kurbelwellen-Umdrehungszähler" UWORD OneToOne 1 100 0.00 65535.00 FORMAT "%8.2" ECU_ADDRESS 0xC000058C /end MEASUREMENT
/begin MEASUREMENT CmbChb_ctEngRevPerBlk_mp "Meßpunkt für die Anzahl der Blockgroesse für die bewerteten Motorumdrehungen der Kurbelwelle" UWORD OneToOne 1 100 0.00 65535.00 FORMAT "%8.2" ECU_ADDRESS 0xC000058E /end MEASUREMENT
/begin MEASUREMENT CmbChb_ctMifBuf1_mp "Meßpunkt für die Erkennung der Fehlzündungen der einzelnen Zylinder, Puffer1" SWORD OneToOne 1 100 -32768.00 32767.00 FORMAT "%8.2" ARRAY_SIZE 7 ECU_ADDRESS 0xC0000590 /end MEASUREMENT
/begin MEASUREMENT CmbChb_ctMifBuf2_mp "Meßpunkt für die Erkennung der Fehlzündungen der einzelnen Zylinder, Puffer2" SWORD OneToOne 1 100 -32768.00 32767.00 FORMAT "%8.2" ARRAY_SIZE 7 ECU_ADDRESS 0xC000059E /end MEASUREMENT
/begin MEASUREMENT CmbChb_ctMifMem_mp "Meßpunkt für die Erkennung der Fehlzündungen der einzelnen Zylinder, Logging Speicher" SWORD OneToOne 1 100 -32768.00 32767.00 FORMAT "%8.2" ARRAY_SIZE 7 ECU_ADDRESS 0xC00005AC /end MEASUREMENT
/begin MEASUREMENT CmbChb_nMisf "Drehzahlsignal für OBD-Zündaussetzererkennung" SWORD EngN1 1 100 -16384.00 16383.50 FORMAT "%8.2" ECU_ADDRESS 0xD0006C2C /end MEASUREMENT
/begin MEASUREMENT CmbChb_nSegEven_mp "Summe der Drehzahl fuer jede gerade Segmentnummer (von zwei Umdrehungen)" SLONG EngN1 1 100 -1073741824.00 1073741823.50 FORMAT "%13.2" ECU_ADDRESS 0xC00005BC /end MEASUREMENT
/begin MEASUREMENT CmbChb_nSegOdd_mp "Summe der Drehzahl fuer jede ungerade Segmentnummer (von zwei Umdrehungen)" SLONG EngN1 1 100 -1073741824.00 1073741823.50 FORMAT "%13.2" ECU_ADDRESS 0xC00005C0 /end MEASUREMENT
/begin MEASUREMENT CmbChb_nSpdIncrCurr_mp "aktueller Drehzahlanstieg" SWORD EngN1 1 100 -16384.00 16383.50 FORMAT "%8.2" ECU_ADDRESS 0xC00005C4 /end MEASUREMENT
/begin MEASUREMENT CmbChb_nSpdIncrMin_mp "minimaler Drehzahlanstieg pro Zylinder" SWORD EngN1 1 100 -16384.00 16383.50 FORMAT "%8.2" ECU_ADDRESS 0xC00005C6 /end MEASUREMENT
/begin MEASUREMENT CmbChb_st "Status der Fehlzündungserkennung" UBYTE OneToOne 1 100 0.00 255.0 FORMAT "%5.1" ECU_ADDRESS 0xD0008F2B /end MEASUREMENT
/begin MEASUREMENT CmbChb_stDelMisf "Verschiebung Segmentsystem für Aussetzererkennung" SBYTE OneToOne 1 100 -128.0 127.0 FORMAT "%5.1" ECU_ADDRESS 0xD0008EF0 /end MEASUREMENT
/begin MEASUREMENT CnvLead_qCurr "Einspritzmenge Curr-Pfad" SWORD InjMass 1 100 -327.6800 327.6700 FORMAT "%8.4" ECU_ADDRESS 0xD0006C2E /end MEASUREMENT
/begin MEASUREMENT CnvLead_qRaw "Einspritzmenge Raw-Pfad" SWORD InjMass 1 100 -327.6800 327.6700 FORMAT "%8.4" ECU_ADDRESS 0xD0006C30 /end MEASUREMENT
/begin MEASUREMENT CnvSet_etaCurr "aktueller Umrechnungswirkungsgrad" SWORD Eta3 1 100 -256.0000 255.9922 FORMAT "%8.4" ECU_ADDRESS 0xD0006C32 /end MEASUREMENT
/begin MEASUREMENT CnvSet_qSet "Soll-Einspritzmenge" SWORD InjMass 1 100 -327.6800 327.6700 FORMAT "%8.4" ECU_ADDRESS 0xD0006C34 /end MEASUREMENT
/begin MEASUREMENT CnvSet_qSetOpt_mp "Soll-Einspritzmenge ohne Korrekturen" SWORD InjMass 1 100 -327.6800 327.6700 FORMAT "%8.4" ECU_ADDRESS 0xC00005C8 /end MEASUREMENT
/begin MEASUREMENT CnvSet_qStrt "Start-Einspritzmenge" SWORD InjMass 1 100 -327.6800 327.6700 FORMAT "%8.4" ECU_ADDRESS 0xD0006C36 /end MEASUREMENT
/begin MEASUREMENT CoAS_stEGRVlv "" ULONG OneToOne 1 100 0.00 4294967295.00 FORMAT "%13.2" ECU_ADDRESS 0xD0004414 /end MEASUREMENT
/begin MEASUREMENT CoAS_stThrVlv "" ULONG OneToOne 1 100 0.00 4294967295.00 FORMAT "%13.2" ECU_ADDRESS 0xD0004418 /end MEASUREMENT
/begin MEASUREMENT CoAS_stTrbCh "Status Ladedruck-Steller" ULONG OneToOne 1 100 0.00 4294967295.00 FORMAT "%13.2" ECU_ADDRESS 0xD000441C /end MEASUREMENT
/begin MEASUREMENT CoCTM_trqMaxAC "" SWORD Trq 1 100 -3276.800 3276.700 FORMAT "%8.3" ECU_ADDRESS 0xD0006C38 /end MEASUREMENT
/begin MEASUREMENT CoEng_st "aktueller Motorzustand" UBYTE OneToOne 1 100 0.00 255.0 FORMAT "%5.1" ECU_ADDRESS 0xD0008EED /end MEASUREMENT
/begin MEASUREMENT CoEng_stAftRun "nachlauf-interner Nachlauf-Zustand" UBYTE OneToOne 1 100 0.00 255.0 FORMAT "%5.1" ECU_ADDRESS 0xD0008F4E /end MEASUREMENT
/begin MEASUREMENT CoEng_stAftRunPath "Abschaltpfade aufgrund Motorzustand Nachlauf" ULONG OneToOne 1 100 0.00 4294967295.00 FORMAT "%13.2" ECU_ADDRESS 0xD00044D4 /end MEASUREMENT
/begin MEASUREMENT CoEng_stDiaReq "Diagnoseschnittstelle" UBYTE OneToOne 1 100 0.00 255.0 FORMAT "%5.1" ECU_ADDRESS 0xD0008F4F /end MEASUREMENT
/begin MEASUREMENT CoEng_stEng "aktueller Motorzustand (Legacy-Interface)" UBYTE OneToOne 1 100 0.00 255.0 FORMAT "%5.1" ECU_ADDRESS 0xD0008F50 /end MEASUREMENT
/begin MEASUREMENT CoEng_stEngOld "Motorstatus vor aktuellem Status (Legacy-Interface)" UBYTE OneToOne 1 100 0.00 255.0 FORMAT "%5.1" ECU_ADDRESS 0xD0008F51 /end MEASUREMENT
/begin MEASUREMENT CoEng_stIRevShutOff "irreversible Abschaltursachen (nach Maskierung)" ULONG OneToOne 1 100 0.00 4294967295.00 FORMAT "%13.2" ECU_ADDRESS 0xD00044D8 /end MEASUREMENT
/begin MEASUREMENT CoEng_stOld "Motorstatus vor aktuellem Status" UBYTE OneToOne 1 100 0.00 255.0 FORMAT "%5.1" ECU_ADDRESS 0xD0008F52 /end MEASUREMENT
/begin MEASUREMENT CoEng_stRevShutOff "reversible Abschaltursachen (nach Maskierung)" ULONG OneToOne 1 100 0.00 4294967295.00 FORMAT "%13.2" ECU_ADDRESS 0xD00044DC /end MEASUREMENT
/begin MEASUREMENT CoEng_stShutOff "Typ der wirksamen Abschaltursache (0: Nachlauf; 1: reversibel; 2: irreversibel)" UBYTE OneToOne 1 100 0.00 255.0 FORMAT "%5.1" ECU_ADDRESS 0xD0008F53 /end MEASUREMENT
/begin MEASUREMENT CoEng_stShutOffPath "aktive Abstellpfade resultierend aus aktiven reversiblen, irreversiblen und Nachlauf-Abstellpfaden" ULONG OneToOne 1 100 0.00 4294967295.00 FORMAT "%13.2" ECU_ADDRESS 0xD00044E0 /end MEASUREMENT
/begin MEASUREMENT CoEng_stTst "Zustand des Motortestkoordinators (= aktiver Testmodus)" UBYTE OneToOne 1 100 0.00 255.0 FORMAT "%5.1" ECU_ADDRESS 0xD0008F54 /end MEASUREMENT
/begin MEASUREMENT CoEng_tiAfterrun "Zeit seit Erreichen des Motorzustands Nachlauf (COENG_STOPPING & COENG_FINISH)" ULONG Time_ms 1 100 0.00 42949672950.0 FORMAT "%13.1" ECU_ADDRESS 0xD00044E4 /end MEASUREMENT
/begin MEASUREMENT CoEng_tiAfterrunRed "Zeit seit Erreichen des Motorzustands Nachlauf (COENG_STOPPING & COENG_FINISH) mit reduzierter Auflösung als KL/KF Eingang" SWORD TimeRed 1 100 -5242.880 5242.720 FORMAT "%8.3" ECU_ADDRESS 0xD0006C68 /end MEASUREMENT
/begin MEASUREMENT CoEng_tiNormal "Zeit seit Erreichen Zustand COENG_RUNNING" ULONG Time_ms 1 100 0.00 42949672950.0 FORMAT "%13.1" ECU_ADDRESS 0xD00044E8 /end MEASUREMENT
/begin MEASUREMENT CoEng_tiNormalRed "Zeit seit Erreichen Motorzustand COENG_RUNNING, mit reduzierter Auflösung als KL/KF Eingang" SWORD TimeRed 1 100 -5242.880 5242.720 FORMAT "%8.3" ECU_ADDRESS 0xD0006C6A /end MEASUREMENT
/begin MEASUREMENT CoEng_tiStandby "" ULONG Time_ms 1 100 0.00 42949672950.0 FORMAT "%13.1" ECU_ADDRESS 0xD00044EC /end MEASUREMENT
/begin MEASUREMENT CoEng_tiStandbyRed "" SWORD TimeRed 1 100 -5242.880 5242.720 FORMAT "%8.3" ECU_ADDRESS 0xD0006C6C /end MEASUREMENT
/begin MEASUREMENT CoEng_tiStart "Zeit seit Erreichen Motorzustand (COENG_READY & COENG_CRANKING)" ULONG Time_ms 1 100 0.00 42949672950.0 FORMAT "%13.1" ECU_ADDRESS 0xD00044F0 /end MEASUREMENT
/begin MEASUREMENT CoEng_tiStartRed "Zeit seit Erreichen Motorzustand (COENG_READY & COENG_CRANKING), mit reduzierter Auflösung als KL/KF Eingang" SWORD TimeRed 1 100 -5242.880 5242.720 FORMAT "%8.3" ECU_ADDRESS 0xD0006C6E /end MEASUREMENT
/begin MEASUREMENT CoEOM_facRmpVal "Zentraler Rampenwert für die Betriebsartenumschaltung" SWORD CoEOMSwt_S16 1 100 -2.000000 1.999939 FORMAT "%8.6" ECU_ADDRESS 0xD0006C3A /end MEASUREMENT
/begin MEASUREMENT CoEOM_numOpModeAct "Nummer der aktuellen Betriebsart" UBYTE OneToOne 1 100 0.00 255.0 FORMAT "%5.1" ECU_ADDRESS 0xD0008F2D /end MEASUREMENT
/begin MEASUREMENT CoEOM_numOpModeAct_mp "" UBYTE OneToOne 1 100 0.00 255.0 FORMAT "%5.1" ECU_ADDRESS 0xC00005CA /end MEASUREMENT
/begin MEASUREMENT CoEOM_numOpModeOld "Nummer der letzten Betriebsart" UBYTE OneToOne 1 100 0.00 255.0 FORMAT "%5.1" ECU_ADDRESS 0xD0008F30 /end MEASUREMENT
/begin MEASUREMENT CoEOM_numOpModeOld_mp "" UBYTE OneToOne 1 100 0.00 255.0 FORMAT "%5.1" ECU_ADDRESS 0xC00005CB /end MEASUREMENT
/begin MEASUREMENT CoEOM_numStageAct "Nummer der aktuellen Stufe" UBYTE OneToOne 1 100 0.00 255.0 FORMAT "%5.1" ECU_ADDRESS 0xD0008F33 /end MEASUREMENT
/begin MEASUREMENT CoEOM_numStageAct_mp "" UBYTE OneToOne 1 100 0.00 255.0 FORMAT "%5.1" ECU_ADDRESS 0xC00005CC /end MEASUREMENT
/begin MEASUREMENT CoEOM_stDeadlck "Status ob ein Deadlock während der Betriebsarten-Auswahl aufgetreten ist" UBYTE OneToOne 1 100 0.00 255.0 FORMAT "%5.1" ECU_ADDRESS 0xD0008F36 /end MEASUREMENT
/begin MEASUREMENT CoEOM_stDSCHEDDem "" UWORD OneToOne 1 100 0.00 65535.00 FORMAT "%8.2" ECU_ADDRESS 0xD0007610 /end MEASUREMENT
/begin MEASUREMENT CoEOM_stEndOpMode "Anforderung an die Komponenten, die aktuelle Betriebsart zu beenden" UBYTE OneToOne 1 100 0.00 255.0 FORMAT "%5.1" ECU_ADDRESS 0xD0008F39 /end MEASUREMENT
/begin MEASUREMENT CoEOM_stNxtOpMode "Bitmaske der Betriebsarten, die von der aktuellen Betriebsart direkt aktiviert werden können" UWORD OneToOne 1 100 0.00 65535.00 FORMAT "%8.2" ECU_ADDRESS 0xD0007612 /end MEASUREMENT
/begin MEASUREMENT CoEOM_stNxtStage "Bitmaske der Stufen, die von der aktuellen Betriebsart aus direkt aktiviert werden können." UWORD OneToOne 1 100 0.00 65535.00 FORMAT "%8.2" ECU_ADDRESS 0xD0007618 /end MEASUREMENT
/begin MEASUREMENT CoEOM_stOpModeAct "Aktuelle Betriebsart" ULONG OneToOne 1 100 0.00 4294967295.00 FORMAT "%13.2" ECU_ADDRESS 0xD0004420 /end MEASUREMENT
/begin MEASUREMENT CoEOM_stOpModeActTSync "Aktuelle Betriebsart (zeitsychron)" ULONG OneToOne 1 100 0.00 4294967295.00 FORMAT "%13.2" ECU_ADDRESS 0xD000442C /end MEASUREMENT
/begin MEASUREMENT CoEOM_stOpModeDem "Ausgewählter Betriebsartenwunsch bei einem Deadlock" ULONG OneToOne 1 100 0.00 4294967295.00 FORMAT "%13.2" ECU_ADDRESS 0xD0004438 /end MEASUREMENT
/begin MEASUREMENT CoEOM_stOpModeDes "Durch den Betriebsartenkoordinator ausgewählte Betriebsart" ULONG OneToOne 1 100 0.00 4294967295.00 FORMAT "%13.2" ECU_ADDRESS 0xD0004444 /end MEASUREMENT
/begin MEASUREMENT CoEOM_stOpModeItm "Array mit den eingesammelten Betriebsartenwünschen" ULONG OneToOne 1 100 0.00 4294967295.00 FORMAT "%13.2" ARRAY_SIZE 3 ECU_ADDRESS 0xD0004468 /end MEASUREMENT
/begin MEASUREMENT CoEOM_stOpModeLck "Lockbit zum Synchronisieren" ULONG OneToOne 1 100 0.00 4294967295.00 FORMAT "%13.2" ECU_ADDRESS 0xD0008F3C /end MEASUREMENT
/begin MEASUREMENT CoEOM_stOpModeLckTSync "Statusbit zur Synchronisation zwischen zeit- und Winkelsynchronen Tasks" UBYTE OneToOne 1 100 0.00 255.0 FORMAT "%5.1" ECU_ADDRESS 0xD0008F3F /end MEASUREMENT
/begin MEASUREMENT CoEOM_stOpModeOld "Letzte Betriebsart" ULONG OneToOne 1 100 0.00 4294967295.00 FORMAT "%13.2" ECU_ADDRESS 0xD0004474 /end MEASUREMENT
/begin MEASUREMENT CoEOM_stOpModeOldTSync "Letzte Betriebsart (zeitsynchron)" ULONG OneToOne 1 100 0.00 4294967295.00 FORMAT "%13.2" ECU_ADDRESS 0xD0004480 /end MEASUREMENT
/begin MEASUREMENT CoEOM_stOpModePos "Bitmaske der möglichen Betriebsarten für den DSM-Scheduler" UWORD OneToOne 1 100 0.00 65535.00 FORMAT "%8.2" ECU_ADDRESS 0xD000761E /end MEASUREMENT
/begin MEASUREMENT CoEOM_stOpModePrio2 "Priorität_2 der ausgewählten Betriebsart" UBYTE OneToOne 1 100 0.00 255.0 FORMAT "%5.1" ECU_ADDRESS 0xD0008F42 /end MEASUREMENT
/begin MEASUREMENT CoEOM_stOpModeSort "Array mit den sortierten Betriebsartenwünschen" ULONG OneToOne 1 100 0.00 4294967295.00 FORMAT "%13.2" ARRAY_SIZE 2 ECU_ADDRESS 0xD000449C /end MEASUREMENT
/begin MEASUREMENT CoEOM_stRisePrio "Status welches Element von CoEOM_stOpModeItm[] auf das höchstwertige Element kopiert wurde" UBYTE OneToOne 1 100 0.00 255.0 FORMAT "%5.1" ECU_ADDRESS 0xD0008F45 /end MEASUREMENT
/begin MEASUREMENT CoEOM_stTiRmpDem "Status welche Komponenten eine Rampenzeit mit dem Betriebsartenwunsch senden." ULONG OneToOne 1 100 0.00 4294967295.00 FORMAT "%13.2" ECU_ADDRESS 0xD00044A4 /end MEASUREMENT
/begin MEASUREMENT CoEOM_stTransActv "Status ob eine Betriebsartenumschaltung aktiv ist" UBYTE OneToOne 1 100 0.00 255.0 FORMAT "%5.1" ECU_ADDRESS 0xD0009229 /end MEASUREMENT
/begin MEASUREMENT CoEOM_tiOpModeChng "Zeit seit letztem Betriebsartenwechsel" ULONG Time_s 1 100 0.00 42949672.9500 FORMAT "%13.4" ECU_ADDRESS 0xD00044B0 /end MEASUREMENT
/begin MEASUREMENT CoEOM_tiOpModeChngTSync "Zeit seit der letzten Betriebsartenumschaltung (zeitsynchron)" ULONG Time_s 1 100 0.00 42949672.9500 FORMAT "%13.4" ECU_ADDRESS 0xD00044BC /end MEASUREMENT
/begin MEASUREMENT CoEOM_tiRmpDem "Array mit den eingesammelten Rampen-Laufzeiten" SWORD TimeCoEOMRmp 1 100 0.0020000610370 65.536000000 FORMAT "%12.9" ARRAY_SIZE 2 ECU_ADDRESS 0xD0006C48 /end MEASUREMENT
/begin MEASUREMENT CoEOM_tiRmpSlp "Rampenlaufzeit" ULONG TimeCoEOMRmp 1 100 0.000000015258789 65.536000000000001 FORMAT "%19.16" ECU_ADDRESS 0xD00044C8 /end MEASUREMENT
/begin MEASUREMENT CoESS_stAlt "Abschaltforderung an den Generator vom Koordinator für mechanische Energie" UBYTE OneToOne 1 100 0.00 255.0 FORMAT "%5.1" ECU_ADDRESS 0xD0008F48 /end MEASUREMENT
/begin MEASUREMENT CoESS_stEngSet_mp "Setzbedingung vom Motorstatus" UBYTE OneToOne 1 100 0.00 255.0 FORMAT "%5.1" ECU_ADDRESS 0xC00005CD /end MEASUREMENT
/begin MEASUREMENT CoESS_stNBattRst_mp "Rücksetzbedingung von der Motordrehzahl" UBYTE OneToOne 1 100 0.00 255.0 FORMAT "%5.1" ECU_ADDRESS 0xC00005CE /end MEASUREMENT
/begin MEASUREMENT CoESS_stNBattSet_mp "Setzbedingung von der Motordrehzahl" UBYTE OneToOne 1 100 0.00 255.0 FORMAT "%5.1" ECU_ADDRESS 0xC00005CF /end MEASUREMENT
/begin MEASUREMENT CoESS_stVltgBattRst_mp "Rücksetzbedingung von der Batteriespannung" UBYTE OneToOne 1 100 0.00 255.0 FORMAT "%5.1" ECU_ADDRESS 0xC00005D0 /end MEASUREMENT
/begin MEASUREMENT CoESS_stVltgBattSet_mp "Setzbedingung von der Batteriespannung" UBYTE OneToOne 1 100 0.00 255.0 FORMAT "%5.1" ECU_ADDRESS 0xC00005D1 /end MEASUREMENT
/begin MEASUREMENT CoETM_qInjCurrMax_mp "Ausgang des Kennfeldes CoETM_qInjCurrMax_MAP" SWORD InjMass 1 100 -327.6800 327.6700 FORMAT "%8.4" ECU_ADDRESS 0xC00005E6 /end MEASUREMENT
/begin MEASUREMENT CoETM_rClgDemLim_mp "" SWORD Prc 1 100 -400.0000 399.9878 FORMAT "%8.4" ECU_ADDRESS 0xC00005D2 /end MEASUREMENT
/begin MEASUREMENT CoETM_rClgIntegLim_mp "Begrenzter Wert I-Anteil von ETM_rClgDem" SWORD Prc 1 100 -400.0000 399.9878 FORMAT "%8.4" ECU_ADDRESS 0xC00005D4 /end MEASUREMENT
/begin MEASUREMENT CoETM_rClgProp_mp "P-Anteil von ETM_rClgDem" SWORD Prc 1 100 -400.0000 399.9878 FORMAT "%8.4" ECU_ADDRESS 0xC00005D6 /end MEASUREMENT
/begin MEASUREMENT CoETM_stAftRun_mp "" UBYTE OneToOne 1 100 0.00 255.0 FORMAT "%5.1" ECU_ADDRESS 0xC00005D8 /end MEASUREMENT
/begin MEASUREMENT CoETM_stClgDem1 "Statusbit für Cananforderung Heizung ein" UBYTE OneToOne 1 100 0.00 255.0 FORMAT "%5.1" ECU_ADDRESS 0xD0008F49 /end MEASUREMENT
/begin MEASUREMENT CoETM_stClgDem2 "Status für Temperatur Kurbelgehäuse grösser Applikationswert" UBYTE OneToOne 1 100 0.00 255.0 FORMAT "%5.1" ECU_ADDRESS 0xD0008F4A /end MEASUREMENT
/begin MEASUREMENT CoETM_stClgDem3 "Status für Temperaturdifferenz Kurbelgehäuse und Zylinderkopf grösser Applikationswert" UBYTE OneToOne 1 100 0.00 255.0 FORMAT "%5.1" ECU_ADDRESS 0xD0008F4B /end MEASUREMENT
/begin MEASUREMENT CoETM_stClgDem4 "Status für Abfrage Kennfeld aus Epm_nEng und TS_tClntEngIn grösser InjCtl_qCurr" UBYTE OneToOne 1 100 0.00 255.0 FORMAT "%5.1" ECU_ADDRESS 0xD0008F4C /end MEASUREMENT
/begin MEASUREMENT CoETM_tClntEngOut_mp "" SWORD Temp_Cels 1 100 -3549.940 3003.560 FORMAT "%8.3" ECU_ADDRESS 0xC00005DA /end MEASUREMENT
/begin MEASUREMENT CoETM_tDvt_mp "Regelabweichung: Temperatur" SWORD TempDiff_Kelv 1 100 -3276.800 3276.700 FORMAT "%8.3" ECU_ADDRESS 0xC00005DC /end MEASUREMENT
/begin MEASUREMENT CoETM_tEngDiff_mp "Temperaturdifferenz zwischen Zylinderkopf und Kurbelgehäuse" SWORD TempDiff_Kelv 1 100 -3276.800 3276.700 FORMAT "%8.3" ECU_ADDRESS 0xC00005E8 /end MEASUREMENT
/begin MEASUREMENT CoETM_tEngOutOff_mp "Kühlmitteltemperatur am Motoraustritt nach Anhalten des Motors" SWORD Temp_Cels 1 100 -3549.940 3003.560 FORMAT "%8.3" ECU_ADDRESS 0xC00005DE /end MEASUREMENT
/begin MEASUREMENT CoETM_tiClgAftRun2_mp "Aktualisierte Nachlaufzeit" SWORD Time_s 1 100 -327.6800 327.6700 FORMAT "%8.4" ECU_ADDRESS 0xC00005E0 /end MEASUREMENT
/begin MEASUREMENT CoETM_tiClgAftRunMax2_mp "Dauer bis zur Aktualisierung des Nachlaufs" SWORD Time_s 1 100 -327.6800 327.6700 FORMAT "%8.4" ECU_ADDRESS 0xC00005E2 /end MEASUREMENT
/begin MEASUREMENT CoETM_tiClgAftRun_mp "Nachlaufzeit" SWORD Time_s 1 100 -327.6800 327.6700 FORMAT "%8.4" ECU_ADDRESS 0xC00005E4 /end MEASUREMENT
/begin MEASUREMENT CoETS_rTrq "Verhältnis aktuelles Moment zu Maximalmoment" SWORD Prc 1 100 -400.0000 399.9878 FORMAT "%8.4" ECU_ADDRESS 0xD0006C4C /end MEASUREMENT
/begin MEASUREMENT CoETS_stCurrLim "Statuswörter niedrigste Begrenzungen" UWORD OneToOne 1 100 0.00 65535.00 FORMAT "%8.2" ECU_ADDRESS 0xD0007624 /end MEASUREMENT
/begin MEASUREMENT CoETS_stCurrLimActive "Statusword zur Markierung der wirksamen niedrigsten Begrenzungsmomente" UWORD OneToOne 1 100 0.00 65535.00 FORMAT "%8.2" ECU_ADDRESS 0xD0007626 /end MEASUREMENT
/begin MEASUREMENT CoETS_stSetTrqActv "" UBYTE OneToOne 1 100 0.00 255.0 FORMAT "%5.1" ECU_ADDRESS 0xD0008F4D /end MEASUREMENT
/begin MEASUREMENT CoETS_stSetTrqAlw_mp "" UBYTE OneToOne 1 100 0.00 255.0 FORMAT "%5.1" ECU_ADDRESS 0xC00005EC /end MEASUREMENT
/begin MEASUREMENT CoETS_trqInrCurr "aktuelles inneres Moment" SWORD Trq 1 100 -3276.800 3276.700 FORMAT "%8.3" ECU_ADDRESS 0xD0006C4E /end MEASUREMENT
/begin MEASUREMENT CoETS_trqInrCurrFast "inneres Moment Wunschwert (schneller Pfad) erzeugt aus CoPT_trqCurr" SWORD Trq 1 100 -3276.800 3276.700 FORMAT "%8.3" ECU_ADDRESS 0xD0006C50 /end MEASUREMENT
/begin MEASUREMENT CoETS_trqInrCurrLim "aktuell kleinstes Begrenzungsmoment (inneres Motormoment)" SWORD Trq 1 100 -3276.800 3276.700 FORMAT "%8.3" ECU_ADDRESS 0xD0006C52 /end MEASUREMENT
/begin MEASUREMENT CoETS_trqInrLead "This is SW-VARIABLE" SWORD Trq 1 100 -3276.800 3276.700 FORMAT "%8.3" ECU_ADDRESS 0xD0006C54 /end MEASUREMENT
/begin MEASUREMENT CoETS_trqInrLeadFast "This is SW-VARIABLE" SWORD Trq 1 100 -3276.800 3276.700 FORMAT "%8.3" ECU_ADDRESS 0xD0006C56 /end MEASUREMENT
/begin MEASUREMENT CoETS_trqInrLim "Begrenzungsmoment (als inneres Motormoment)" SWORD Trq 1 100 -3276.800 3276.700 FORMAT "%8.3" ECU_ADDRESS 0xD0006C58 /end MEASUREMENT
/begin MEASUREMENT CoETS_trqInrLimSet "" SWORD Trq 1 100 -3276.800 3276.700 FORMAT "%8.3" ECU_ADDRESS 0xD0006C5A /end MEASUREMENT
/begin MEASUREMENT CoETS_trqInrLtd "inneres Moment Sollwert nach Begrenzung, vor Eingriff ASD-Störungsregler" SWORD Trq 1 100 -3276.800 3276.700 FORMAT "%8.3" ECU_ADDRESS 0xD0006C5C /end MEASUREMENT
/begin MEASUREMENT CoETS_trqInrSetSlow "This is SW-VARIABLE" SWORD Trq 1 100 -3276.800 3276.700 FORMAT "%8.3" ECU_ADDRESS 0xD0006C5E /end MEASUREMENT
/begin MEASUREMENT CoETS_trqInrTraIntv "" SWORD Trq 1 100 -3276.800 3276.700 FORMAT "%8.3" ECU_ADDRESS 0xD0006C60 /end MEASUREMENT
/begin MEASUREMENT CoETS_trqInrVehLimMin_mp "koordinierten Begrenzungsmomentes" SWORD Trq 1 100 -3276.800 3276.700 FORMAT "%8.3" ECU_ADDRESS 0xC00005EA /end MEASUREMENT
/begin MEASUREMENT CoETS_trqSetDiag "" SWORD Trq 1 100 -3276.800 3276.700 FORMAT "%8.3" ECU_ADDRESS 0xD0006C62 /end MEASUREMENT
/begin MEASUREMENT CoETS_trqSet_mp "" SWORD OneToOne 1 100 -32768.00 32767.00 FORMAT "%8.2" ECU_ADDRESS 0xC00005EE /end MEASUREMENT
/begin MEASUREMENT CoETS_trqUnFltLtd "" SWORD Trq 1 100 -3276.800 3276.700 FORMAT "%8.3" ECU_ADDRESS 0xD0006C64 /end MEASUREMENT
/begin MEASUREMENT CoETS_trqUnFltLtdSet "" SWORD Trq 1 100 -3276.800 3276.700 FORMAT "%8.3" ECU_ADDRESS 0xD0006C66 /end MEASUREMENT
/begin MEASUREMENT CoME_nMax "Maximaldrehzahlbegrenzung der Nebenaggregate" SWORD EngN 1 100 -16384.00 16383.50 FORMAT "%8.2" ECU_ADDRESS 0xD0006C70 /end MEASUREMENT
/begin MEASUREMENT CoME_nMin "Minimale Leerlaufdrehzahlforderung der Nebenaggregate" SWORD EngN 1 100 -16384.00 16383.50 FORMAT "%8.2" ECU_ADDRESS 0xD0006C72 /end MEASUREMENT
/begin MEASUREMENT CoME_stAccMax_mp "Klimakompressor Status: Maximale Ausschaltzeit im Beschleunigungsfall" UBYTE OneToOne 1 100 0.00 255.0 FORMAT "%5.1" ECU_ADDRESS 0xC00005F4 /end MEASUREMENT
/begin MEASUREMENT CoME_stAccMin_mp "Klimakompressorstatus: Mindestausschaltzeit im Beschleunigungsfall" UBYTE OneToOne 1 100 0.00 255.0 FORMAT "%5.1" ECU_ADDRESS 0xC00005F5 /end MEASUREMENT
/begin MEASUREMENT CoME_stAccTmr_mp "Status: Beschleunigung nach Zeitsteuerung" UBYTE OneToOne 1 100 0.00 255.0 FORMAT "%5.1" ECU_ADDRESS 0xC00005F6 /end MEASUREMENT
/begin MEASUREMENT CoME_stAcc_mp "Status: Beschleunigung" UBYTE OneToOne 1 100 0.00 255.0 FORMAT "%5.1" ECU_ADDRESS 0xC00005F0 /end MEASUREMENT
/begin MEASUREMENT CoME_stBattVltgTmr_mp "Status: Niedrige Batteriespannung nach Zeitsteuerung" UBYTE OneToOne 1 100 0.00 255.0 FORMAT "%5.1" ECU_ADDRESS 0xC00005F7 /end MEASUREMENT
/begin MEASUREMENT CoME_stBattVltg_mp "status: Niedrige Batteriespannung" UBYTE OneToOne 1 100 0.00 255.0 FORMAT "%5.1" ECU_ADDRESS 0xC00005F1 /end MEASUREMENT
/begin MEASUREMENT CoME_stDrvOffMax_mp "Klimakompressorstatus: Maximale Ausschaltzeit nach Anfahren" UBYTE OneToOne 1 100 0.00 255.0 FORMAT "%5.1" ECU_ADDRESS 0xC00005F8 /end MEASUREMENT
/begin MEASUREMENT CoME_stDrvOffMin_mp "Klimakompressorstatus: Mindestausschaltzeit nach Anfahren" UBYTE OneToOne 1 100 0.00 255.0 FORMAT "%5.1" ECU_ADDRESS 0xC00005F9 /end MEASUREMENT
/begin MEASUREMENT CoME_stDrvOffTmr_mp "Status: Anfahren nach Zeitsteuerung" UBYTE OneToOne 1 100 0.00 255.0 FORMAT "%5.1" ECU_ADDRESS 0xC00005FA /end MEASUREMENT
/begin MEASUREMENT CoME_stDrvOff_mp "Status: Anfahren" UBYTE OneToOne 1 100 0.00 255.0 FORMAT "%5.1" ECU_ADDRESS 0xC00005F2 /end MEASUREMENT
/begin MEASUREMENT CoME_stDrvTmr "Klimakompressorstatus: Mindesteinschaltdauer nach Abschaltung wegen Anfahren oder Beschleunigung" UBYTE OneToOne 1 100 0.00 255.0 FORMAT "%5.1" ECU_ADDRESS 0xD0008F55 /end MEASUREMENT
/begin MEASUREMENT CoME_stNSetP "Status: Art der Leerlaufdrehzahlerhöhung" UBYTE OneToOne 1 100 0.00 255.0 FORMAT "%5.1" ECU_ADDRESS 0xD0008F56 /end MEASUREMENT
/begin MEASUREMENT CoME_stOffAcc "Klimakompressorstatus: Rücksetzbedingung für Abschaltzeit bei Beschleunigung" UBYTE OneToOne 1 100 0.00 255.0 FORMAT "%5.1" ECU_ADDRESS 0xD0008F57 /end MEASUREMENT
/begin MEASUREMENT CoME_stOffDrvOff "Klimakompressorstatus: Rücksetzbedingung für Abschaltzeit bei Anfahren" UBYTE OneToOne 1 100 0.00 255.0 FORMAT "%5.1" ECU_ADDRESS 0xD0008F58 /end MEASUREMENT
/begin MEASUREMENT CoME_stStrtTmrAC_mp "Status: Motorstart nach Zeitsteuerung" UBYTE OneToOne 1 100 0.00 255.0 FORMAT "%5.1" ECU_ADDRESS 0xC00005FB /end MEASUREMENT
/begin MEASUREMENT CoME_stStrt_mp "Status: Start" UBYTE OneToOne 1 100 0.00 255.0 FORMAT "%5.1" ECU_ADDRESS 0xC00005F3 /end MEASUREMENT
/begin MEASUREMENT CoME_tiMaxOffAcc "Maximale Abschaltzeit bei Beschleunigung" SWORD Time_ms 1 100 -327680.0 327670.0 FORMAT "%8.1" ECU_ADDRESS 0xD0006C74 /end MEASUREMENT
/begin MEASUREMENT CoME_tiMaxOffDrvOff "Maximale Abschaltzeit bei Anfahren" SWORD Time_ms 1 100 -327680.0 327670.0 FORMAT "%8.1" ECU_ADDRESS 0xD0006C76 /end MEASUREMENT
/begin MEASUREMENT CoME_tiMinOffAcc "Minimale Abschaltzeit bei Beschleunigung" SWORD Time_ms 1 100 -327680.0 327670.0 FORMAT "%8.1" ECU_ADDRESS 0xD0006C78 /end MEASUREMENT
/begin MEASUREMENT CoME_tiMinOffDrvOff "Minimale Abschaltzeit bei Anfahren" SWORD Time_ms 1 100 -327680.0 327670.0 FORMAT "%8.1" ECU_ADDRESS 0xD0006C7A /end MEASUREMENT
/begin MEASUREMENT CoME_trqDesComp "Momentenforderung des mechanischen Koordinators" SWORD Trq 1 100 -3276.800 3276.700 FORMAT "%8.3" ECU_ADDRESS 0xD0006C7C /end MEASUREMENT
/begin MEASUREMENT CoME_trqResv "Reservemomentenforderung des mechanischen Koordinators" SWORD Trq 1 100 -3276.800 3276.700 FORMAT "%8.3" ECU_ADDRESS 0xD0006C7E /end MEASUREMENT
/begin MEASUREMENT Conv_bCalc "" UBYTE OneToOne 1 100 0.00 255.0 FORMAT "%5.1" ECU_ADDRESS 0xD0008FB2 /end MEASUREMENT
/begin MEASUREMENT Conv_bCalcActv_mp "Flag für Berechnung aktiv" UBYTE OneToOne 1 100 0.00 255.0 FORMAT "%5.1" ECU_ADDRESS 0xC00005FC /end MEASUREMENT
/begin MEASUREMENT Conv_bConvActv "Flag für Wandler aktiv/inaktiv" UBYTE OneToOne 1 100 0.00 255.0 FORMAT "%5.1" ECU_ADDRESS 0xD0008FB3 /end MEASUREMENT
/begin MEASUREMENT Conv_bGearOff "Flag für Lastmoment" UBYTE OneToOne 1 100 0.00 255.0 FORMAT "%5.1" ECU_ADDRESS 0xD0008FB4 /end MEASUREMENT
/begin MEASUREMENT Conv_bRevLvrPos "Flag für Zustand Rückwärtsgang" UBYTE OneToOne 1 100 0.00 255.0 FORMAT "%5.1" ECU_ADDRESS 0xD0008FB5 /end MEASUREMENT
/begin MEASUREMENT Conv_bTrbnSpdCan "Flag für Turbinendrehzahl über CAN" UBYTE OneToOne 1 100 0.00 255.0 FORMAT "%5.1" ECU_ADDRESS 0xD0008FB6 /end MEASUREMENT
/begin MEASUREMENT Conv_bTrqLdCan "Flag für Lastmoment über CAN" UBYTE OneToOne 1 100 0.00 255.0 FORMAT "%5.1" ECU_ADDRESS 0xD0008FB7 /end MEASUREMENT
/begin MEASUREMENT Conv_bTrqLdFlt "Flag für gefiltertes Lastmoment" UBYTE OneToOne 1 100 0.00 255.0 FORMAT "%5.1" ECU_ADDRESS 0xD0008FB8 /end MEASUREMENT
/begin MEASUREMENT Conv_bTrqResv "Flag für ""Building"" Momentenreserve" UBYTE OneToOne 1 100 0.00 255.0 FORMAT "%5.1" ECU_ADDRESS 0xD0008FB9 /end MEASUREMENT
/begin MEASUREMENT Conv_bTrqResvBrkEnd "Flag für Lastreserve nach Bremsen" UBYTE OneToOne 1 100 0.00 255.0 FORMAT "%5.1" ECU_ADDRESS 0xD0008FBA /end MEASUREMENT
/begin MEASUREMENT Conv_bTrqResvLvrOff "Flag für Lastreserve im Leerlauf" UBYTE OneToOne 1 100 0.00 255.0 FORMAT "%5.1" ECU_ADDRESS 0xD0008FBB /end MEASUREMENT
/begin MEASUREMENT Conv_facDepNTrbnNStat_mp "Faktor für die Umrechnung von Turbinendrehzahl auf stationäre Drehzahl" SWORD Fact 1 100 -4.000000 3.999878 FORMAT "%8.6" ECU_ADDRESS 0xC00005FE /end MEASUREMENT
/begin MEASUREMENT Conv_facOilTempDepTrqPmp "Öltemperatur abhängiger Faktor" SWORD TrqToNSqr 1 100 -0.003276800 0.003276700 FORMAT "%11.9" ECU_ADDRESS 0xD0006D3C /end MEASUREMENT
/begin MEASUREMENT Conv_nTrbn "Turbinendrehzahl" SWORD EngN 1 100 -16384.00 16383.50 FORMAT "%8.2" ECU_ADDRESS 0xD0006D3E /end MEASUREMENT
/begin MEASUREMENT Conv_nTrbnCorrVal_mp "Wert für die Korrektur der Turbinendrehzahl" SWORD EngN 1 100 -16384.00 16383.50 FORMAT "%8.2" ECU_ADDRESS 0xC0000600 /end MEASUREMENT
/begin MEASUREMENT Conv_nTrbnDiff_mp "Turbinendrehzahldifferenz" SWORD EngN 1 100 -16384.00 16383.50 FORMAT "%8.2" ECU_ADDRESS 0xC0000602 /end MEASUREMENT
/begin MEASUREMENT Conv_nTrbnExp_mp "erwartete Turbinendrehzahl" SWORD EngN 1 100 -16384.00 16383.50 FORMAT "%8.2" ECU_ADDRESS 0xC0000604 /end MEASUREMENT
/begin MEASUREMENT Conv_nTrbnMod "modellierte Turbinendrehzahl" SWORD EngN 1 100 -16384.00 16383.50 FORMAT "%8.2" ECU_ADDRESS 0xD0006D40 /end MEASUREMENT
/begin MEASUREMENT Conv_nTrbnOld "alte Turbinendrehzahl" SWORD EngN 1 100 -16384.00 16383.50 FORMAT "%8.2" ECU_ADDRESS 0xD0006D42 /end MEASUREMENT
/begin MEASUREMENT Conv_rNTrbnNStat_mp "Verhältnis Turbinendrehzahl stationären Drehzahl" SWORD TransR 1 100 -327.6800 327.6700 FORMAT "%8.4" ECU_ADDRESS 0xC000061C /end MEASUREMENT
/begin MEASUREMENT Conv_rTrq "Wandlerübersetzungsverhältnis" SWORD TransR 1 100 -327.6800 327.6700 FORMAT "%8.4" ECU_ADDRESS 0xD0006D44 /end MEASUREMENT
/begin MEASUREMENT Conv_tiTempDepLvrDebNeg "Entprellzeit Temperatur kein Gang" SLONG TimeDeb 1 100 -21474836480.0 21474836470.0 FORMAT "%13.1" ECU_ADDRESS 0xD0006D46 /end MEASUREMENT
/begin MEASUREMENT Conv_tiTempDepLvrDebPos "Entprellzeit Temperatur Gang eingelegt" SLONG TimeDeb 1 100 -21474836480.0 21474836470.0 FORMAT "%13.1" ECU_ADDRESS 0xD0006D48 /end MEASUREMENT
/begin MEASUREMENT Conv_tiTempDepRevLvrDebNeg "Entprellzeit Temperatur kein Rückwärtsgang" SLONG TimeDeb 1 100 -21474836480.0 21474836470.0 FORMAT "%13.1" ECU_ADDRESS 0xD0006D4A /end MEASUREMENT
/begin MEASUREMENT Conv_tiTempDepRevLvrDebPos "Entprellzeit Temperatur Rückwärtsgang" SLONG TimeDeb 1 100 -21474836480.0 21474836470.0 FORMAT "%13.1" ECU_ADDRESS 0xD0006D4C /end MEASUREMENT
/begin MEASUREMENT Conv_tOilBuf_mp "Puffer für Öltemperatur" SWORD Temp_Cels 1 100 -3549.940 3003.560 FORMAT "%8.3" ECU_ADDRESS 0xC000061E /end MEASUREMENT
/begin MEASUREMENT Conv_trqLd "Momentenlast vom Wandler" SWORD Trq 1 100 -3276.800 3276.700 FORMAT "%8.3" ECU_ADDRESS 0xD0006D4E /end MEASUREMENT
/begin MEASUREMENT Conv_trqLdBefLim_mp "Momentenlast vor Momentenbegrenzung" SWORD Trq 1 100 -3276.800 3276.700 FORMAT "%8.3" ECU_ADDRESS 0xC0000606 /end MEASUREMENT
/begin MEASUREMENT Conv_trqLdDiff_mp "Momentenlastdifferenz" SWORD Trq 1 100 -3276.800 3276.700 FORMAT "%8.3" ECU_ADDRESS 0xC0000608 /end MEASUREMENT
/begin MEASUREMENT Conv_trqLdFlt "gefilterte Momentenlast" SWORD Trq 1 100 -3276.800 3276.700 FORMAT "%8.3" ECU_ADDRESS 0xD0006D50 /end MEASUREMENT
/begin MEASUREMENT Conv_trqLdFltRslt_mp "gefilterte Momentenlast zur Berechnung der Momentenreserve" SWORD Trq 1 100 -3276.800 3276.700 FORMAT "%8.3" ECU_ADDRESS 0xC000060A /end MEASUREMENT
/begin MEASUREMENT Conv_trqLdLvrPosNeutr "Lastmoment für kein Gang eingelegt" SWORD Trq 1 100 -3276.800 3276.700 FORMAT "%8.3" ECU_ADDRESS 0xD0006D52 /end MEASUREMENT
/begin MEASUREMENT Conv_trqLdMaxLim_mp "aktuelle Begrenzung für Momentenlast vom CAN" SWORD Trq 1 100 -3276.800 3276.700 FORMAT "%8.3" ECU_ADDRESS 0xC000060C /end MEASUREMENT
/begin MEASUREMENT Conv_trqLdMod "modellierte Berechnung der Momentenlast" SWORD Trq 1 100 -3276.800 3276.700 FORMAT "%8.3" ECU_ADDRESS 0xD0006D54 /end MEASUREMENT
/begin MEASUREMENT Conv_trqLdOfs_mp "Offset der Momentenlast" SWORD Trq 1 100 -3276.800 3276.700 FORMAT "%8.3" ECU_ADDRESS 0xC000060E /end MEASUREMENT
/begin MEASUREMENT Conv_trqLdPreFlt "vorgefilterte Momentenlast" SWORD Trq 1 100 -3276.800 3276.700 FORMAT "%8.3" ECU_ADDRESS 0xD0006D56 /end MEASUREMENT
/begin MEASUREMENT Conv_trqLdResvAdd_mp "zusätzliche Momentenreserve für eingelegten Gang" SWORD Trq 1 100 -3276.800 3276.700 FORMAT "%8.3" ECU_ADDRESS 0xC0000610 /end MEASUREMENT
/begin MEASUREMENT Conv_trqLdResvFlt_mp "gefilterte zusätzliche Momentenreserve" SWORD Trq 1 100 -3276.800 3276.700 FORMAT "%8.3" ECU_ADDRESS 0xC0000612 /end MEASUREMENT
/begin MEASUREMENT Conv_trqLdRevLvrPos "Lastmoment für Gang eingelegt" SWORD Trq 1 100 -3276.800 3276.700 FORMAT "%8.3" ECU_ADDRESS 0xD0006D58 /end MEASUREMENT
/begin MEASUREMENT Conv_trqLdTempDepLim "Temperaturabhängiger Wert für Begrenzung Lastmoment" SWORD Trq 1 100 -3276.800 3276.700 FORMAT "%8.3" ECU_ADDRESS 0xD0006D5A /end MEASUREMENT
/begin MEASUREMENT Conv_trqLdTrqResvTotBuf_mp "Momentenlastpuffer für die Summe von Momentenlast und Momentenreserve" SWORD Trq 1 100 -3276.800 3276.700 FORMAT "%8.3" ECU_ADDRESS 0xC0000614 /end MEASUREMENT
/begin MEASUREMENT Conv_trqPmpBuf_mp "Pumpenmoment" SWORD Trq 1 100 -3276.800 3276.700 FORMAT "%8.3" ECU_ADDRESS 0xC0000616 /end MEASUREMENT
/begin MEASUREMENT Conv_trqResv "Momentenreserve vom Wandler" SWORD Trq 1 100 -3276.800 3276.700 FORMAT "%8.3" ECU_ADDRESS 0xD0006D5C /end MEASUREMENT
/begin MEASUREMENT Conv_trqResvHiInc_mp "Faktor für zusätzliche Momentenreserve" SWORD Trq 1 100 -3276.800 3276.700 FORMAT "%8.3" ECU_ADDRESS 0xC0000618 /end MEASUREMENT
/begin MEASUREMENT Conv_trqResvTempDep "Temperaturabhängiges Reservemoment" SWORD Trq 1 100 -3276.800 3276.700 FORMAT "%8.3" ECU_ADDRESS 0xD0006D5E /end MEASUREMENT
/begin MEASUREMENT Conv_trqStatSqBuf_mp "Puffer für Pumpenmoment" SWORD Trq 1 100 -3276.800 3276.700 FORMAT "%8.3" ECU_ADDRESS 0xC000061A /end MEASUREMENT
/begin MEASUREMENT CoPT_rClgDes "Gesamtkühlanforderung des Antriebsstrangs an den Lüfter" SWORD Prc 1 100 -400.0000 399.9878 FORMAT "%8.4" ECU_ADDRESS 0xD0006C94 /end MEASUREMENT
/begin MEASUREMENT CoPT_stIARls "Zündwinkelfreigabe durch erhöhenden bzw. reduzierenden Getriebeeingriff" UBYTE OneToOne 1 100 0.00 255.0 FORMAT "%5.1" ECU_ADDRESS 0xD0008F5A /end MEASUREMENT
/begin MEASUREMENT CoPT_tClntDes "Kühlmittelsolltemperatur des Antriebsstrangs" SWORD Temp_Cels 1 100 -3549.940 3003.560 FORMAT "%8.3" ECU_ADDRESS 0xD0006C96 /end MEASUREMENT
/begin MEASUREMENT CoPT_trqCurr "Vorhaltmomentenauftrag (Raildruckregelung) an Momentensteller (Kupplungsmoment)" SWORD Trq 1 100 -3276.800 3276.700 FORMAT "%8.3" ECU_ADDRESS 0xD0006C9A /end MEASUREMENT
/begin MEASUREMENT CoPT_trqCurrDecMin_mp "Vorhaltmoment (Raildruckregelung) nach Koordination des Reduzierenden Getriebeeingriffs (Kupplungsmoment)" SWORD Trq 1 100 -3276.800 3276.700 FORMAT "%8.3" ECU_ADDRESS 0xC0000626 /end MEASUREMENT
/begin MEASUREMENT CoPT_trqDCSClth "MSR-Momenteneingriff (Kupplungsmoment)" SWORD Trq 1 100 -3276.800 3276.700 FORMAT "%8.3" ECU_ADDRESS 0xD0006C9E /end MEASUREMENT
/begin MEASUREMENT CoPT_trqDes "Summenmomentenauftrag an Momentensteller (Kupplungsmoment)" SWORD Trq 1 100 -3276.800 3276.700 FORMAT "%8.3" ECU_ADDRESS 0xD0006CA0 /end MEASUREMENT
/begin MEASUREMENT CoPT_trqDesClth_mp "Sollmomentenauftrag an Antriebsstrang (Kupplungsmoment)" SWORD Trq 1 100 -3276.800 3276.700 FORMAT "%8.3" ECU_ADDRESS 0xC0000620 /end MEASUREMENT
/begin MEASUREMENT CoPT_trqDesDecMin_mp "Sollmoment nach Koordination mir reduzierendem Getriebeeingriff (Kupplungsmoment)" SWORD Trq 1 100 -3276.800 3276.700 FORMAT "%8.3" ECU_ADDRESS 0xC0000622 /end MEASUREMENT
/begin MEASUREMENT CoPT_trqDesIncMax_mp "Sollmoment nach Koordination mir erhöhendem Getriebeeingriff (Kupplungsmoment)" SWORD Trq 1 100 -3276.800 3276.700 FORMAT "%8.3" ECU_ADDRESS 0xC0000624 /end MEASUREMENT
/begin MEASUREMENT CoPT_trqDesTCSClth "ASR-Sollmomenteneingriff (Kupplungsmoment)" SWORD Trq 1 100 -3276.800 3276.700 FORMAT "%8.3" ECU_ADDRESS 0xD0006CA6 /end MEASUREMENT
/begin MEASUREMENT CoPT_trqLead "Vorhaltmomentenauftrag an Momentensteller (Kupplungsmoment)" SWORD Trq 1 100 -3276.800 3276.700 FORMAT "%8.3" ECU_ADDRESS 0xD0006CA8 /end MEASUREMENT
/begin MEASUREMENT CoPT_trqLeadClth_mp "Vorhaltvortiebsmoment (clutch torque)" SWORD Trq 1 100 -3276.800 3276.700 FORMAT "%8.3" ECU_ADDRESS 0xC0000628 /end MEASUREMENT
/begin MEASUREMENT CoPT_trqLeadDecMin_mp "Vorhaltmoment nach Koordination des reduzierenden Getriebeeingriffs (Kupplungsmoment)" SWORD Trq 1 100 -3276.800 3276.700 FORMAT "%8.3" ECU_ADDRESS 0xC000062A /end MEASUREMENT
/begin MEASUREMENT CoPT_trqLeadIncMax_mp "Vorhaltmoment nach Koordination des reduzierenden Getriebeeingriffs (Kupplungsmoment)" SWORD Trq 1 100 -3276.800 3276.700 FORMAT "%8.3" ECU_ADDRESS 0xC000062C /end MEASUREMENT
/begin MEASUREMENT CoPT_trqLeadPOp "Vorhaltmomen an Momentensteller zur Auswahl der BDE-Betriebsart (Kupplungsmoment)" SWORD Trq 1 100 -3276.800 3276.700 FORMAT "%8.3" ECU_ADDRESS 0xD0006CAC /end MEASUREMENT
/begin MEASUREMENT CoPT_trqLeadTCSClth "ASR-Vorhaltmomenteneingriff (Kupplungsmoment)" SWORD Trq 1 100 -3276.800 3276.700 FORMAT "%8.3" ECU_ADDRESS 0xD0006CB0 /end MEASUREMENT
/begin MEASUREMENT CoPT_trqPTPrt "Antriebsstrangschutzmoment (Kupplungsmoment)" SWORD Trq 1 100 -3276.800 3276.700 FORMAT "%8.3" ECU_ADDRESS 0xD0006CB2 /end MEASUREMENT
/begin MEASUREMENT CoPT_trqTraDes "Sollmoment ohne Getriebeeingriff (Kupplungsmoment)" SWORD Trq 1 100 -3276.800 3276.700 FORMAT "%8.3" ECU_ADDRESS 0xD0006CB8 /end MEASUREMENT
/begin MEASUREMENT CoTemp_rClgDes "" SWORD Prc 1 100 -400.0000 399.9878 FORMAT "%8.4" ECU_ADDRESS 0xD0006CC2 /end MEASUREMENT
/begin MEASUREMENT CoTemp_tEngDes "" SWORD Temp_Cels 1 100 -3549.940 3003.560 FORMAT "%8.3" ECU_ADDRESS 0xD0006CC4 /end MEASUREMENT
/begin MEASUREMENT CoTS_rClgDem "" SWORD Prc 1 100 -400.0000 399.9878 FORMAT "%8.4" ECU_ADDRESS 0xD0006CBA /end MEASUREMENT
/begin MEASUREMENT CoTS_stWaHt "" UBYTE OneToOne 1 100 0.00 255.0 FORMAT "%5.1" ECU_ADDRESS 0xD0008F5E /end MEASUREMENT
/begin MEASUREMENT CoTS_tClntDesFlt "" SWORD Temp_Cels 1 100 -3549.940 3003.560 FORMAT "%8.3" ECU_ADDRESS 0xD0006CBC /end MEASUREMENT
/begin MEASUREMENT CoTS_tClntEngOutDes "" SWORD Temp_Cels 1 100 -3549.940 3003.560 FORMAT "%8.3" ECU_ADDRESS 0xD0006CBE /end MEASUREMENT
/begin MEASUREMENT CoTS_trqMaxAC "" UBYTE OneToOne 1 100 0.00 255.0 FORMAT "%5.1" ECU_ADDRESS 0xD0006CC0 /end MEASUREMENT
/begin MEASUREMENT CoVeh_nMaxSysErr "Maximaldrehzahlbegrenzung bei Systemfehler" SWORD EngN 1 100 -16384.00 16383.50 FORMAT "%8.2" ECU_ADDRESS 0xD0006CCE /end MEASUREMENT
/begin MEASUREMENT CoVeh_nMinSysErr "Minimaldrehzahlbegrenzung bei Systemfehler" SWORD EngN 1 100 -16384.00 16383.50 FORMAT "%8.2" ECU_ADDRESS 0xD0006CD0 /end MEASUREMENT
/begin MEASUREMENT CoVeh_rClgDes "Gewünschter relativer Luftmassenstrom" SWORD Prc 1 100 -400.0000 399.9878 FORMAT "%8.4" ECU_ADDRESS 0xD0006CD2 /end MEASUREMENT
/begin MEASUREMENT CoVeh_stAlt "Status: Generator einschalten" UBYTE OneToOne 1 100 0.00 255.0 FORMAT "%5.1" ECU_ADDRESS 0xD0008F64 /end MEASUREMENT
/begin MEASUREMENT CoVeh_stEngStopEna "Motorstopp ist erlaubt (wichtig für VW)" UBYTE OneToOne 1 100 0.00 255.0 FORMAT "%5.1" ECU_ADDRESS 0xD0008F65 /end MEASUREMENT
/begin MEASUREMENT CoVeh_stEngStopOrd "Anforderung zum Motorstopp aus SSE" UBYTE OneToOne 1 100 0.00 255.0 FORMAT "%5.1" ECU_ADDRESS 0xD0008F66 /end MEASUREMENT
/begin MEASUREMENT CoVeh_stEngStrtOrd "Anforderung zum Motorstart aus SSE" UBYTE OneToOne 1 100 0.00 255.0 FORMAT "%5.1" ECU_ADDRESS 0xD0008F67 /end MEASUREMENT
/begin MEASUREMENT CoVeh_stFan "Status: Lüfter einschalten" UBYTE OneToOne 1 100 0.00 255.0 FORMAT "%5.1" ECU_ADDRESS 0xD0008F68 /end MEASUREMENT
/begin MEASUREMENT CoVeh_stLimSysErr "Status Momentendurchgriff Systemfehlerbegrenzung" UBYTE OneToOne 1 100 0.00 255.0 FORMAT "%5.1" ECU_ADDRESS 0xD0008F6B /end MEASUREMENT
/begin MEASUREMENT CoVeh_stNSetPSysErr "Statuswort das Umsetzung der Systemfehlerdrehzahlanforderungen definiert" UBYTE OneToOne 1 100 0.00 255.0 FORMAT "%5.1" ECU_ADDRESS 0xD0008F6C /end MEASUREMENT
/begin MEASUREMENT CoVeh_stSSE "Zustand des SSE-Zustandsautomaten" UBYTE OneToOne 1 100 0.00 255.0 FORMAT "%5.1" ECU_ADDRESS 0xD0008F6D /end MEASUREMENT
/begin MEASUREMENT CoVeh_stSSEEngStop "Motor gestoppt durch SSE-Funktion" UBYTE OneToOne 1 100 0.00 255.0 FORMAT "%5.1" ECU_ADDRESS 0xD0008F6E /end MEASUREMENT
/begin MEASUREMENT CoVeh_stWaHt "Status: Kühlwasserzuheizer einschalten" UBYTE OneToOne 1 100 0.00 255.0 FORMAT "%5.1" ECU_ADDRESS 0xD0008F6F /end MEASUREMENT
/begin MEASUREMENT CoVeh_tClntDes "Gewünschte Kühlmitteltemperatur" SWORD Temp_Cels 1 100 -3549.940 3003.560 FORMAT "%8.3" ECU_ADDRESS 0xD0006CD4 /end MEASUREMENT
/begin MEASUREMENT CoVeh_trqAcs "Momentenforderung der Nebenaggregate" SWORD Trq 1 100 -3276.800 3276.700 FORMAT "%8.3" ECU_ADDRESS 0xD0006CD6 /end MEASUREMENT
/begin MEASUREMENT CoVeh_trqDes "Sollmomentenauftrag an den Antrieb (Getriebeausgangsmoment)" SLONG TrqPrpHigh 1 100 -214748364.800 214748364.700 FORMAT "%13.3" ECU_ADDRESS 0xD00042EC /end MEASUREMENT
/begin MEASUREMENT CoVeh_trqLead "Vorhaltmomentenauftrag an den Antriebsstrang (Getriebeausgangsmoment)" SLONG TrqPrpHigh 1 100 -214748364.800 214748364.700 FORMAT "%13.3" ECU_ADDRESS 0xD00042F0 /end MEASUREMENT
/begin MEASUREMENT CoVeh_trqLim_mp "Systemfehlerbgrenzungsmoment (Radmoment)" SLONG TrqPrpHigh 1 100 -214748364.800 214748364.700 FORMAT "%13.3" ECU_ADDRESS 0xC0000630 /end MEASUREMENT
/begin MEASUREMENT CoVeh_trqMaxAC "Maximal zulässiges Verbrauchsmoment für den Kolimakompressor" SWORD Trq 1 100 -3276.800 3276.700 FORMAT "%8.3" ECU_ADDRESS 0xD0006CDA /end MEASUREMENT
/begin MEASUREMENT CoVeh_trqPrpLimErr "Systemfehlerbgrenzungsmoment (Getriebeausgangsmoment)" SLONG TrqPrpHigh 1 100 -214748364.800 214748364.700 FORMAT "%13.3" ECU_ADDRESS 0xD00042F4 /end MEASUREMENT
/begin MEASUREMENT CoVMD_aReqCrCtl_mp "Beschleunigungsanforderung der CrCtl" SWORD Acc 1 100 -32.76800 32.76700 FORMAT "%8.5" ECU_ADDRESS 0xC0000634 /end MEASUREMENT
/begin MEASUREMENT CoVMD_facCompAcsCrCtl "Faktor Nebenaggregatekompensation durch CrCtl" SWORD Fact 1 100 -4.000000 3.999878 FORMAT "%8.6" ECU_ADDRESS 0xD0006CC6 /end MEASUREMENT
/begin MEASUREMENT CoVMD_facCompAcsLLim "Faktor Nebenaggregatekompensation durch LLim" SWORD Fact 1 100 -4.000000 3.999878 FORMAT "%8.6" ECU_ADDRESS 0xD0006CC8 /end MEASUREMENT
/begin MEASUREMENT CoVMD_stCtOffPhdCrCtl "Status Schubabschalteverbot durch Cruise Control" UBYTE OneToOne 1 100 0.00 255.0 FORMAT "%5.1" ECU_ADDRESS 0xD0008F5F /end MEASUREMENT
/begin MEASUREMENT CoVMD_stCtOffPhdLLim "Status Schubabschalteverbot durch Longitudinalbegrenzer (LLim)" UBYTE OneToOne 1 100 0.00 255.0 FORMAT "%5.1" ECU_ADDRESS 0xD0008F60 /end MEASUREMENT
/begin MEASUREMENT CoVMD_stReqCrCtl "Koordinierter Status der Beschleunigungsanforderung" UBYTE OneToOne 1 100 0.00 255.0 FORMAT "%5.1" ECU_ADDRESS 0xD0008F61 /end MEASUREMENT
/begin MEASUREMENT CoVMD_swtCCSel "Schalter für Auswahl Cruise Control (CrCtl, ACCI)" UBYTE OneToOne 1 100 0.00 255.0 FORMAT "%5.1" ECU_ADDRESS 0xD0008F62 /end MEASUREMENT
/begin MEASUREMENT CoVMD_trqCrCtl "Vortriebsmoment der CrCtl" SLONG TrqPrpHigh 1 100 -214748364.800 214748364.700 FORMAT "%13.3" ECU_ADDRESS 0xD00042D8 /end MEASUREMENT
/begin MEASUREMENT CoVMD_trqCrCtl_mp "---" SLONG TrqPrpHigh 1 100 -214748364.800 214748364.700 FORMAT "%13.3" ECU_ADDRESS 0xC0000638 /end MEASUREMENT
/begin MEASUREMENT CoVMD_trqLLim "Vortriebsmoment des Longitudinalbegrenzers (LLim)" SLONG TrqPrpHigh 1 100 -214748364.800 214748364.700 FORMAT "%13.3" ECU_ADDRESS 0xD00042DC /end MEASUREMENT
/begin MEASUREMENT CoVMD_trqLLim_mp "---" SLONG TrqPrpHigh 1 100 -214748364.800 214748364.700 FORMAT "%13.3" ECU_ADDRESS 0xC000063C /end MEASUREMENT
/begin MEASUREMENT CoVM_stIARls "Zündwinkelfreigabe durch ESP-Eingriffe" UBYTE OneToOne 1 100 0.00 255.0 FORMAT "%5.1" ECU_ADDRESS 0xD0008F63 /end MEASUREMENT
/begin MEASUREMENT CoVM_trqDes "Vortriebssollmoment nach Koordination mit ESP-Eingriffen (Radmoment)" SLONG TrqPrpHigh 1 100 -214748364.800 214748364.700 FORMAT "%13.3" ECU_ADDRESS 0xD00042E0 /end MEASUREMENT
/begin MEASUREMENT CoVM_trqDesIncMax_mp "Vortriebssollmoment nach Koordination mit erhöhendem ESP-Eingriff (Radmoment)" SLONG TrqPrpHigh 1 100 -214748364.800 214748364.700 FORMAT "%13.3" ECU_ADDRESS 0xC0000640 /end MEASUREMENT
/begin MEASUREMENT CoVM_trqLead "Vortriebsvorhaltmoment nach Koordination mit ESP-Eingriffen (Radmoment)" SLONG TrqPrpHigh 1 100 -214748364.800 214748364.700 FORMAT "%13.3" ECU_ADDRESS 0xD00042E4 /end MEASUREMENT
/begin MEASUREMENT CoVM_trqLeadIncMax_mp "Vortriebsvorhaltmoment nach Koordination mit Koordination mit erhöhendem ESP-Eingriff (Radmoment)" SLONG TrqPrpHigh 1 100 -214748364.800 214748364.700 FORMAT "%13.3" ECU_ADDRESS 0xC0000644 /end MEASUREMENT
/begin MEASUREMENT CoVM_trqLeadPOp "Vorhaltmoment zur Auswahl der BDE-Betriebsart nach Koordination mit erhöhendem ESP-Eingriff (Radmoment)" SLONG TrqPrpHigh 1 100 -214748364.800 214748364.700 FORMAT "%13.3" ECU_ADDRESS 0xD00042E8 /end MEASUREMENT
/begin MEASUREMENT CoVOM_modeEngReq_mp "Messpunkt: Anforderung des Motormodus" UBYTE OneToOne 1 100 0.00 255.0 FORMAT "%5.1" ECU_ADDRESS 0xC0000648 /end MEASUREMENT
/begin MEASUREMENT CoVOM_stClPressed0_mp "Messpunkt: Status Kupplung nicht betätigt (zwischen 0% und 10%)" SBYTE OneToOne 1 100 -128.0 127.0 FORMAT "%5.1" ECU_ADDRESS 0xC0000649 /end MEASUREMENT
/begin MEASUREMENT CoVOM_stClPressed10_mp "Messpunkt: Status Kupplung zu 10% betätigt" SBYTE OneToOne 1 100 -128.0 127.0 FORMAT "%5.1" ECU_ADDRESS 0xC000064A /end MEASUREMENT
/begin MEASUREMENT CoVOM_stClPressed90_mp "Messpunkt: Status Kupplung zu 90% betätigt" SBYTE OneToOne 1 100 -128.0 127.0 FORMAT "%5.1" ECU_ADDRESS 0xC000064B /end MEASUREMENT
/begin MEASUREMENT CoVOM_stEngOff_mp "Messpunkt: Status Motor steht (aus)" SBYTE OneToOne 1 100 -128.0 127.0 FORMAT "%5.1" ECU_ADDRESS 0xC000064C /end MEASUREMENT
/begin MEASUREMENT CoVOM_stEngRun_mp "Messpunkt: Status Motor läuft (an)" SBYTE OneToOne 1 100 -128.0 127.0 FORMAT "%5.1" ECU_ADDRESS 0xC000064D /end MEASUREMENT
/begin MEASUREMENT CoVOM_stStopCondAST_mp "Messpunkt: Status Stopp Bedingung AST" UBYTE OneToOne 1 100 0.00 255.0 FORMAT "%5.1" ECU_ADDRESS 0xC000064E /end MEASUREMENT
/begin MEASUREMENT CoVOM_stStopCondMT_mp "Messpunkt: Status Stopp Bedingung MT" UBYTE OneToOne 1 100 0.00 255.0 FORMAT "%5.1" ECU_ADDRESS 0xC000064F /end MEASUREMENT
/begin MEASUREMENT CoVOM_stStopCond_mp "Messpunkt: Status Stopp Bedingung" UBYTE OneToOne 1 100 0.00 255.0 FORMAT "%5.1" ECU_ADDRESS 0xC0000650 /end MEASUREMENT
/begin MEASUREMENT CoVOM_stStrtCondAST_mp "Messpunkt: Status Start Bedingung AST" UBYTE OneToOne 1 100 0.00 255.0 FORMAT "%5.1" ECU_ADDRESS 0xC0000651 /end MEASUREMENT
/begin MEASUREMENT CoVOM_stStrtCondMT_mp "Messpunkt: Status Start Bedingung MT" UBYTE OneToOne 1 100 0.00 255.0 FORMAT "%5.1" ECU_ADDRESS 0xC0000652 /end MEASUREMENT
/begin MEASUREMENT CrCtl_aReq "Beschleunigungsanforderung des Fahrgeschwindigkeitsreglers" SWORD Acc 1 100 -32.76800 32.76700 FORMAT "%8.5" ECU_ADDRESS 0xD0006D60 /end MEASUREMENT
/begin MEASUREMENT CrCtl_aReqFil "Beschleunigungsanforderung des Fahrgeschwindigkeitsreglers (gefiltert)" SWORD Acc 1 100 -32.76800 32.76700 FORMAT "%8.5" ECU_ADDRESS 0xD0006D62 /end MEASUREMENT
/begin MEASUREMENT CrCtl_aReqLim "Beschleunigungsanforderung des Fahrgeschwindigkeitsreglers (begrenzt)" SWORD Acc 1 100 -32.76800 32.76700 FORMAT "%8.5" ECU_ADDRESS 0xD0006D64 /end MEASUREMENT
/begin MEASUREMENT CrCtl_aReqRaw_mp "Beschleunigungsanforderung des Fahrgeschwindigkeitsreglers (Rohwert)" SWORD Acc 1 100 -32.76800 32.76700 FORMAT "%8.5" ECU_ADDRESS 0xC0000656 /end MEASUREMENT
/begin MEASUREMENT CrCtl_aShOffRmp "Abschaltrampensteigung des Fahrgeschwindigkeitsreglers" SWORD Acc 1 100 -32.76800 32.76700 FORMAT "%8.5" ECU_ADDRESS 0xD0006D68 /end MEASUREMENT
/begin MEASUREMENT CrCtl_aSVA "Fahrzeugbeschleunigung bei Start der Setzwertkorrektur" SWORD Acc 1 100 -32.76800 32.76700 FORMAT "%8.5" ECU_ADDRESS 0xD0006D66 /end MEASUREMENT
/begin MEASUREMENT CrCtl_st "Zustand der Fahrgeschwindigkeitsregelung" UBYTE OneToOne 1 100 0.00 255.0 FORMAT "%5.1" ECU_ADDRESS 0xD0008FBF /end MEASUREMENT
/begin MEASUREMENT CrCtl_stBttnold "Wert von CrCtl_stBttn vom letzten Rechenzyklus" UWORD OneToOne 1 100 0.00 65535.00 FORMAT "%8.2" ECU_ADDRESS 0xD0007652 /end MEASUREMENT
/begin MEASUREMENT CrCtl_stClrVelDes "Anforderung Löschen der Zielgeschwindigkeit" UBYTE OneToOne 1 100 0.00 255.0 FORMAT "%5.1" ECU_ADDRESS 0xD0008FC0 /end MEASUREMENT
/begin MEASUREMENT CrCtl_stCrCtlOld "letzter Zustand des Fahrgeschwindigkeitsreglers" UBYTE OneToOne 1 100 0.00 255.0 FORMAT "%5.1" ECU_ADDRESS 0xD0008FC1 /end MEASUREMENT
/begin MEASUREMENT CrCtl_stPtd "Fahrgeschwindigkeitsregler ist aktiv oder im Zustand ""Stand-BY""" UBYTE OneToOne 1 100 0.00 255.0 FORMAT "%5.1" ECU_ADDRESS 0xD0008FC2 /end MEASUREMENT
/begin MEASUREMENT CrCtl_stReq "Fahrgeschwindigkeitsregler ist aktiv" UBYTE OneToOne 1 100 0.00 255.0 FORMAT "%5.1" ECU_ADDRESS 0xD0008FC3 /end MEASUREMENT
/begin MEASUREMENT CrCtl_stShOff "Abschaltstatus für Fahrgeschwindigkeitsregler" UBYTE OneToOne 1 100 0.00 255.0 FORMAT "%5.1" ECU_ADDRESS 0xD0008FC7 /end MEASUREMENT
/begin MEASUREMENT CrCtl_stShOffCon_mp "Statuswort für Abschaltbedingungen Fahrgeschwindigkeitsregler" ULONG OneToOne 1 100 0.00 4294967295.00 FORMAT "%13.2" ECU_ADDRESS 0xC000065C /end MEASUREMENT
/begin MEASUREMENT CrCtl_stStTrans "Zustandsübergangsanforderung an den Zustandsautomaten des Fahrgeschwindigkeitsreglers" UWORD OneToOne 1 100 0.00 65535.00 FORMAT "%8.2" ECU_ADDRESS 0xD0007654 /end MEASUREMENT
/begin MEASUREMENT CrCtl_stSVAActv "Setzwertkorrektur aktiv" UBYTE OneToOne 1 100 0.00 255.0 FORMAT "%5.1" ECU_ADDRESS 0xD0008FC4 /end MEASUREMENT
/begin MEASUREMENT CrCtl_stSVANgv "negative Setzwertkorrektur aktiv" UBYTE OneToOne 1 100 0.00 255.0 FORMAT "%5.1" ECU_ADDRESS 0xD0008FC5 /end MEASUREMENT
/begin MEASUREMENT CrCtl_stSVAPsv "positive Setzwertkorrektur activ" UBYTE OneToOne 1 100 0.00 255.0 FORMAT "%5.1" ECU_ADDRESS 0xD0008FC6 /end MEASUREMENT
/begin MEASUREMENT CrCtl_tiDifFil "Filterzeit von CrCtl_aReqFil_PT1, geglättet" SWORD Time_ms 1 100 -327680.0 327670.0 FORMAT "%8.1" ECU_ADDRESS 0xD0006D6A /end MEASUREMENT
/begin MEASUREMENT CrCtl_tiFilTmp_mp "Filterzeit von CrCtl_aReqFil_PT1" SWORD Time_ms 1 100 -327680.0 327670.0 FORMAT "%8.1" ECU_ADDRESS 0xC0000658 /end MEASUREMENT
/begin MEASUREMENT CrCtl_tiShOff "Zeit für Herunterrampen der Fahrgeschwindigkeitsregleranforderung" SWORD Time_ms 1 100 -327680.0 327670.0 FORMAT "%8.1" ECU_ADDRESS 0xD0006D6C /end MEASUREMENT
/begin MEASUREMENT CrCtl_vDes "Wunschgeschwindigkeit der Fahrgeschwindigkeitsregelung" SWORD Vel 1 100 -327.6800 327.6700 FORMAT "%8.4" ECU_ADDRESS 0xD0006D6E /end MEASUREMENT
/begin MEASUREMENT CrCtl_vDesIni "Geschwindigkeit bei Eintritt in den ""Tip State""" SWORD Vel 1 100 -327.6800 327.6700 FORMAT "%8.4" ECU_ADDRESS 0xD0006D70 /end MEASUREMENT
/begin MEASUREMENT CrCtl_vDif "Regelabweichung des Fahrgeschwindigkeitsreglers" SWORD Vel 1 100 -327.6800 327.6700 FORMAT "%8.4" ECU_ADDRESS 0xD0006D72 /end MEASUREMENT
/begin MEASUREMENT CrCtl_vTipMax "Maximale delta- Geschwindigkeit bei Tip-Up" SWORD Vel 1 100 -327.6800 327.6700 FORMAT "%8.4" ECU_ADDRESS 0xD0006D74 /end MEASUREMENT
/begin MEASUREMENT CrCtl_vTipMaxIni "obere Geschwindigkeitsgrenze bei Tip-Up" SWORD Vel 1 100 -327.6800 327.6700 FORMAT "%8.4" ECU_ADDRESS 0xD0006D76 /end MEASUREMENT
/begin MEASUREMENT CrCtl_vTipMin "Maximale delta- Geschwindigkeit bei at Tip-Down" SWORD Vel 1 100 -327.6800 327.6700 FORMAT "%8.4" ECU_ADDRESS 0xD0006D78 /end MEASUREMENT
/begin MEASUREMENT CrCtl_vTipMinIni "untere Geschwindigkeitsgrenze bei Tip-Down" SWORD Vel 1 100 -327.6800 327.6700 FORMAT "%8.4" ECU_ADDRESS 0xD0006D7A /end MEASUREMENT
/begin MEASUREMENT CrCtl_vXLim_mp "begrenzte Geschwindigkeit für Setzwert" SWORD Vel 1 100 -327.6800 327.6700 FORMAT "%8.4" ECU_ADDRESS 0xC0000660 /end MEASUREMENT
/begin MEASUREMENT CrCUI_stBttn "" UWORD OneToOne 1 100 0.00 65535.00 FORMAT "%8.2" ECU_ADDRESS 0xD000764C /end MEASUREMENT
/begin MEASUREMENT CrCUI_stErr "" UBYTE OneToOne 1 100 0.00 255.0 FORMAT "%5.1" ECU_ADDRESS 0xD0008FBD /end MEASUREMENT
/begin MEASUREMENT CrCUI_stNoBtnActv "" UBYTE OneToOne 1 100 0.00 255.0 FORMAT "%5.1" ECU_ADDRESS 0xD0008FBE /end MEASUREMENT
/begin MEASUREMENT CThmst_r "Kühlmittelthermostatkontrollsignal" SWORD Prc 1 100 -400.0000 399.9878 FORMAT "%8.4" ECU_ADDRESS 0xD0006C28 /end MEASUREMENT
/begin MEASUREMENT CThmst_rCnv_mp "" SWORD DtyCyc 1 100 -327.6800 327.6700 FORMAT "%8.4" ECU_ADDRESS 0xC0000662 /end MEASUREMENT
/begin MEASUREMENT CThmst_rPs "" SWORD DtyCyc 1 100 -327.6800 327.6700 FORMAT "%8.4" ECU_ADDRESS 0xD0006C2A /end MEASUREMENT
/begin MEASUREMENT CTM_nMin "" SWORD EngN 1 100 -16384.00 16383.50 FORMAT "%8.2" ECU_ADDRESS 0xD0006C22 /end MEASUREMENT
/begin MEASUREMENT CTM_trqDes "" SWORD Trq 1 100 -3276.800 3276.700 FORMAT "%8.3" ECU_ADDRESS 0xD0006C24 /end MEASUREMENT
/begin MEASUREMENT CTM_trqResv "" SWORD Trq 1 100 -3276.800 3276.700 FORMAT "%8.3" ECU_ADDRESS 0xD0006C26 /end MEASUREMENT
/begin MEASUREMENT CtT_bResetModell_ER "" UBYTE Trq 1 100 0.00 25.50 FORMAT "%5.2" ECU_ADDRESS 0xD0008FC8 /end MEASUREMENT
/begin MEASUREMENT CtT_DSMReturn_mp "DSM Rückgabewert" ULONG OneToOne 1 100 0.00 4294967295.00 FORMAT "%13.2" ECU_ADDRESS 0xC0000664 /end MEASUREMENT
/begin MEASUREMENT CtT_dtDec_mp "Gesammter Kühlmitteltemperaturabfall" SWORD Temp_Kelv_Sec_CtT_Mon 1 100 -0.8000000 0.7999756 FORMAT "%9.7" ECU_ADDRESS 0xC0000668 /end MEASUREMENT
/begin MEASUREMENT CtT_dtGradient_mp "Resultierender Kühlmitteltemperaturgradient" SWORD Temp_Kelv_Sec_CtT_Mon 1 100 -0.8000000 0.7999756 FORMAT "%9.7" ECU_ADDRESS 0xC000066A /end MEASUREMENT
/begin MEASUREMENT CtT_dtIncrEng_mp "Temperaturerhöhung durch den Motor" SWORD Temp_Kelv_Sec_CtT_Mon 1 100 -0.8000000 0.7999756 FORMAT "%9.7" ECU_ADDRESS 0xC000066C /end MEASUREMENT
/begin MEASUREMENT CtT_dtIncrWaHt_mp "Temperaturerhöhung durch alle Zusatzwasserheizer" SWORD Temp_Kelv_Sec_CtT_Mon 1 100 -0.8000000 0.7999756 FORMAT "%9.7" ECU_ADDRESS 0xC000066E /end MEASUREMENT
/begin MEASUREMENT CtT_dtInc_mp "Gesammte Kühlmitteltemperaturerhöhung" SWORD Temp_Kelv_Sec_CtT_Mon 1 100 -0.8000000 0.7999756 FORMAT "%9.7" ECU_ADDRESS 0xC0000670 /end MEASUREMENT
/begin MEASUREMENT CtT_pwrIncrEngPT1 "" SWORD Pwr2 1 100 -617662.2 617643.4 FORMAT "%8.1" ECU_ADDRESS 0xD0006D7C /end MEASUREMENT
/begin MEASUREMENT CtT_stAbrtDiag "Bedingung zum Abbruch der Diagnose" UBYTE OneToOne 1 100 0.00 255.0 FORMAT "%5.1" ECU_ADDRESS 0xD0008FC9 /end MEASUREMENT
/begin MEASUREMENT CtT_stClntToLow_mp "Abbruchbedingung Kühlmittel zu kalt" SBYTE OneToOne 1 100 -128.0 127.0 FORMAT "%5.1" ECU_ADDRESS 0xC0000672 /end MEASUREMENT
/begin MEASUREMENT CtT_stDSMBlocked_mp "Abbruchbedingung DSM blockiert" SBYTE OneToOne 1 100 -128.0 127.0 FORMAT "%5.1" ECU_ADDRESS 0xC0000673 /end MEASUREMENT
/begin MEASUREMENT CtT_stDSMFlt_mp "Ergebnis der Fehlerprüfung für DSM-Report" ULONG OneToOne 1 100 0.00 4294967295.00 FORMAT "%13.2" ECU_ADDRESS 0xC0000674 /end MEASUREMENT
/begin MEASUREMENT CtT_stDSMRet "" ULONG OneToOne 1 100 0.00 4294967295.00 FORMAT "%13.2" ECU_ADDRESS 0xD0004504 /end MEASUREMENT
/begin MEASUREMENT CtT_stHealCond "" UBYTE OneToOne 1 100 0.00 255.0 FORMAT "%5.1" ECU_ADDRESS 0xD0008FCA /end MEASUREMENT
/begin MEASUREMENT CtT_stInitClntToHigh_mp "Abbruchbedingung Starttemperatur bei Initialisierung zu hoch" SBYTE OneToOne 1 100 -128.0 127.0 FORMAT "%5.1" ECU_ADDRESS 0xC0000678 /end MEASUREMENT
/begin MEASUREMENT CtT_stModCalcEna_mp "Freigabebedingung für Temperaturmodell und Fehlerauswertung" SBYTE OneToOne 1 100 -128.0 127.0 FORMAT "%5.1" ECU_ADDRESS 0xC0000679 /end MEASUREMENT
/begin MEASUREMENT CtT_stTimeOut_mp "Abbruchbedingung Zeit abgelaufen." SBYTE OneToOne 1 100 -128.0 127.0 FORMAT "%5.1" ECU_ADDRESS 0xC000067A /end MEASUREMENT
/begin MEASUREMENT CtT_tClntEngMod "Modellierte Kühlmitteltemperatur" SWORD Temp_Cels 1 100 -3549.940 3003.560 FORMAT "%8.3" ECU_ADDRESS 0xD0006D7E /end MEASUREMENT
/begin MEASUREMENT CtT_tClntEngMod_Int "Integral aller Temperaturerhöhungen und -abfälle" SLONG Temp_Kelv_Sec_CtT_Mon 1 100 -52428.8000000 52428.7999756 FORMAT "%13.7" ECU_ADDRESS 0xD0004300 /end MEASUREMENT
/begin MEASUREMENT CtT_tClntIncr_mp "Messpunkt gesammte Kühlmitteltemperaturerhöhung" SLONG Temp_Kelv_Sec_CtT_Mon 1 100 -52428.8000000 52428.7999756 FORMAT "%13.7" ECU_ADDRESS 0xC000067C /end MEASUREMENT
/begin MEASUREMENT CtT_tDiffRadiator "Temperaturdifferenz zwischen der Kühlmittel- und Umgebungslufttemperatur" SWORD Temp_Cels 1 100 -3549.940 3003.560 FORMAT "%8.3" ECU_ADDRESS 0xD0006D80 /end MEASUREMENT
/begin MEASUREMENT ESS_nMax "Drehzahlbegrenzung vom elektrischen Bordnetz" SWORD EngN 1 100 -16384.00 16383.50 FORMAT "%8.2" ECU_ADDRESS 0xD0006DC6 /end MEASUREMENT
/begin MEASUREMENT ESS_nMin "Leerlaufdrehzahlforderung" SWORD EngN 1 100 -16384.00 16383.50 FORMAT "%8.2" ECU_ADDRESS 0xD0006DC8 /end MEASUREMENT
/begin MEASUREMENT ESS_stEngStopEna "Start-Stop: Motorstopp freigegeben" UBYTE OneToOne 1 100 0.00 255.0 FORMAT "%5.1" ECU_ADDRESS 0xD0008FDD /end MEASUREMENT
/begin MEASUREMENT ESS_stEngStrtEna "Start-Stop: Motorstart freigegeben" UBYTE OneToOne 1 100 0.00 255.0 FORMAT "%5.1" ECU_ADDRESS 0xD0008FDE /end MEASUREMENT
/begin MEASUREMENT ESS_trqDesAcs "Momentenforderung des elektrischen Bordnetzes" SWORD Trq 1 100 -3276.800 3276.700 FORMAT "%8.3" ECU_ADDRESS 0xD0006DCC /end MEASUREMENT
/begin MEASUREMENT ESS_trqResvAcs "Momentenvorhaltforderung des elektrischen Bordnetzes" SWORD Trq 1 100 -3276.800 3276.700 FORMAT "%8.3" ECU_ADDRESS 0xD0006DCE /end MEASUREMENT
/begin MEASUREMENT ETM_rClgDem "Notwendiger Kühlbedarf durch Motorlüfter" SWORD Prc 1 100 -400.0000 399.9878 FORMAT "%8.4" ECU_ADDRESS 0xD0006E1C /end MEASUREMENT
/begin MEASUREMENT ETM_rCtT "Ansteuerungssignal für Kennfeldthermostat" SWORD Prc 1 100 -400.0000 399.9878 FORMAT "%8.4" ECU_ADDRESS 0xD0006E1E /end MEASUREMENT
/begin MEASUREMENT FrmMng_nTrbn "" SWORD EngN 1 100 -16384.00 16383.50 FORMAT "%8.2" ECU_ADDRESS 0xD0006F2E /end MEASUREMENT
/begin MEASUREMENT FrmMng_nTSCInc "" SWORD EngN 1 100 -16384.00 16383.50 FORMAT "%8.2" ECU_ADDRESS 0xD0006F2A /end MEASUREMENT
/begin MEASUREMENT FrmMng_nTSCTrgt "" SWORD EngN 1 100 -16384.00 16383.50 FORMAT "%8.2" ECU_ADDRESS 0xD0006F2C /end MEASUREMENT
/begin MEASUREMENT FrmMng_numGear "" UBYTE OneToOne 1 100 0.00 255.0 FORMAT "%5.1" ECU_ADDRESS 0xD0009019 /end MEASUREMENT
/begin MEASUREMENT FrmMng_numGearLever "" UBYTE OneToOne 1 100 0.00 255.0 FORMAT "%5.1" ECU_ADDRESS 0xD000901A /end MEASUREMENT
/begin MEASUREMENT FrmMng_numGearTrgt "" UBYTE OneToOne 1 100 0.00 255.0 FORMAT "%5.1" ECU_ADDRESS 0xD000901B /end MEASUREMENT
/begin MEASUREMENT FrmMng_rClgDem "" SWORD Prc 1 100 -400.0000 399.9878 FORMAT "%8.4" ECU_ADDRESS 0xD0006F30 /end MEASUREMENT
/begin MEASUREMENT FrmMng_rTraConv "" SWORD TransR 1 100 -327.6800 327.6700 FORMAT "%8.4" ECU_ADDRESS 0xD0006F32 /end MEASUREMENT
/begin MEASUREMENT FrmMng_rTraTSC "" SWORD TransR 1 100 -327.6800 327.6700 FORMAT "%8.4" ECU_ADDRESS 0xD0006F34 /end MEASUREMENT
/begin MEASUREMENT FrmMng_stLowRng "" UBYTE OneToOne 1 100 0.00 255.0 FORMAT "%5.1" ECU_ADDRESS 0xD000901C /end MEASUREMENT
/begin MEASUREMENT FrmMng_stRevGear "" UBYTE OneToOne 1 100 0.00 255.0 FORMAT "%5.1" ECU_ADDRESS 0xD000901D /end MEASUREMENT
/begin MEASUREMENT FrmMng_tClntDes "" SWORD Temp_Cels 1 100 -3549.940 3003.560 FORMAT "%8.3" ECU_ADDRESS 0xD0006F36 /end MEASUREMENT
/begin MEASUREMENT FrmMng_tiTSCInc "" SWORD Time_s 1 100 -327.6800 327.6700 FORMAT "%8.4" ECU_ADDRESS 0xD0006F3C /end MEASUREMENT
/begin MEASUREMENT FrmMng_tOilConv "" SWORD Temp_Cels 1 100 -3549.940 3003.560 FORMAT "%8.3" ECU_ADDRESS 0xD0006F38 /end MEASUREMENT
/begin MEASUREMENT FrmMng_trqClthTSCDec "" SWORD Trq 1 100 -3276.800 3276.700 FORMAT "%8.3" ECU_ADDRESS 0xD0006F3E /end MEASUREMENT
/begin MEASUREMENT FrmMng_trqClthTSCInc "" SWORD Trq 1 100 -3276.800 3276.700 FORMAT "%8.3" ECU_ADDRESS 0xD0006F40 /end MEASUREMENT
/begin MEASUREMENT FrmMng_trqClthTSCPrt "" SWORD Trq 1 100 -3276.800 3276.700 FORMAT "%8.3" ECU_ADDRESS 0xD0006F42 /end MEASUREMENT
/begin MEASUREMENT FrmMng_trqConvLoss "" SWORD Trq 1 100 -3276.800 3276.700 FORMAT "%8.3" ECU_ADDRESS 0xD0006F44 /end MEASUREMENT
/begin MEASUREMENT NMng_stFadeOut "" UBYTE OneToOne 1 100 0.00 255.0 FORMAT "%5.1" ECU_ADDRESS 0xD00090EA /end MEASUREMENT
/begin MEASUREMENT PT_stConvGrip "Kraftschlußzustand Kupplung" UBYTE OneToOne 1 100 0.00 255.0 FORMAT "%5.1" ECU_ADDRESS 0xD0009134 /end MEASUREMENT
/begin MEASUREMENT PT_stIARls "Zündwinkelfreigabe durch Getriebeeingriffe incl. Getriebeschutz" UBYTE OneToOne 1 100 0.00 255.0 FORMAT "%5.1" ECU_ADDRESS 0xD0009138 /end MEASUREMENT
/begin MEASUREMENT PT_stTraIntv "Status Momentendurchgriff Getriebeeingriffe" UBYTE OneToOne 1 100 0.00 255.0 FORMAT "%5.1" ECU_ADDRESS 0xD000913A /end MEASUREMENT
/begin MEASUREMENT SSE_bEngOpPassed "SSE ""Engine operation""-Zustand durchlaufen" UBYTE OneToOne 1 100 0.00 255.0 FORMAT "%5.1" ECU_ADDRESS 0xD0009156 /end MEASUREMENT
/begin MEASUREMENT SSE_numEngStart2Stop "Zähler der Startabbrüche" UBYTE OneToOne 1 100 0.00 255.0 FORMAT "%5.1" ECU_ADDRESS 0xD0009157 /end MEASUREMENT
/begin MEASUREMENT SSE_stStrtAbortCond1_mp "Messpunkt: Status Start Abbruchbedingung 1" UBYTE OneToOne 1 100 0.00 255.0 FORMAT "%5.1" ECU_ADDRESS 0xC0000653 /end MEASUREMENT
/begin MEASUREMENT SSE_stStrtAbortCond2_mp "Messpunkt: Status Start Abbruchbedingung 2" UBYTE OneToOne 1 100 0.00 255.0 FORMAT "%5.1" ECU_ADDRESS 0xC0000654 /end MEASUREMENT
/begin MEASUREMENT SSE_vXMaxSinceStart "Maximale Fahrgeschwindigkeit nach dem Start" UBYTE Vel 1 100 0.00 2.550 FORMAT "%5.3" ECU_ADDRESS 0xD0007502 /end MEASUREMENT
/begin MEASUREMENT TS_nMax "" SWORD EngN 1 100 -16384.00 16383.50 FORMAT "%8.2" ECU_ADDRESS 0xD000755C /end MEASUREMENT
/begin MEASUREMENT TS_nMin "" SWORD EngN 1 100 -16384.00 16383.50 FORMAT "%8.2" ECU_ADDRESS 0xD000755E /end MEASUREMENT
/begin MEASUREMENT TS_stEngStopEna "" UBYTE OneToOne 1 100 0.00 255.0 FORMAT "%5.1" ECU_ADDRESS 0xD0009182 /end MEASUREMENT
/begin MEASUREMENT TS_stEngStrtEna "" UBYTE OneToOne 1 100 0.00 255.0 FORMAT "%5.1" ECU_ADDRESS 0xD0009183 /end MEASUREMENT
/begin MEASUREMENT TS_trqDesAcs "" SWORD Trq 1 100 -3276.800 3276.700 FORMAT "%8.3" ECU_ADDRESS 0xD0007568 /end MEASUREMENT
/begin MEASUREMENT TS_trqResvAcs "" SWORD Trq 1 100 -3276.800 3276.700 FORMAT "%8.3" ECU_ADDRESS 0xD000756A /end MEASUREMENT
/begin MEASUREMENT VehMot_facCompAcs "Koordinierter Faktor der Nebenaggregatekompensation" SWORD Fact 1 100 -4.000000 3.999878 FORMAT "%8.6" ECU_ADDRESS 0xD00075EA /end MEASUREMENT
/begin MEASUREMENT VehMot_nMax "Maximaldrehzahlanforderung von VehMot" SWORD EngN 1 100 -16384.00 16383.50 FORMAT "%8.2" ECU_ADDRESS 0xD00075EE /end MEASUREMENT
/begin MEASUREMENT VehMot_nMaxAcs "Maximaldrehzahlanforderung der Nebenaggregate innerhalb VehMot" SWORD EngN 1 100 -16384.00 16383.50 FORMAT "%8.2" ECU_ADDRESS 0xD00075F0 /end MEASUREMENT
/begin MEASUREMENT VehMot_nMin "Minimaldrehzahlanforderung von VehMot" SWORD EngN 1 100 -16384.00 16383.50 FORMAT "%8.2" ECU_ADDRESS 0xD00075F2 /end MEASUREMENT
/begin MEASUREMENT VehMot_nMinAcs "Minimaldrehzahlanforderung der Nebenaggregate innerhalb VehMot" SWORD EngN 1 100 -16384.00 16383.50 FORMAT "%8.2" ECU_ADDRESS 0xD00075F4 /end MEASUREMENT
/begin MEASUREMENT VehMot_stCtOffPhd "Status Schubabschalteverbot durch Fahrerassistenzfunktionen" UBYTE OneToOne 1 100 0.00 255.0 FORMAT "%5.1" ECU_ADDRESS 0xD0009197 /end MEASUREMENT
/begin MEASUREMENT VehMot_stIARls "Zündwinkelfreigabe von Fahrzeugbewegungsanforderungen." UBYTE OneToOne 1 100 0.00 255.0 FORMAT "%5.1" ECU_ADDRESS 0xD0009198 /end MEASUREMENT
/begin MEASUREMENT VehMot_stNSetP "Statuswort das Umsetzung der Drehzahlanforderungen von VehMot definiert" UBYTE OneToOne 1 100 0.00 255.0 FORMAT "%5.1" ECU_ADDRESS 0xD000919A /end MEASUREMENT
/begin MEASUREMENT VehMot_stPrpCrCtl "Status CrCtl-Anforderung übersteigt Fahrerwunsch" UBYTE OneToOne 1 100 0.00 255.0 FORMAT "%5.1" ECU_ADDRESS 0xD000919C /end MEASUREMENT
/begin MEASUREMENT VehMot_stPrpLLim "Status Longitudinalbegrenzer (LLim) beeinflusst Vortriebsmoment" UBYTE OneToOne 1 100 0.00 255.0 FORMAT "%5.1" ECU_ADDRESS 0xD000919D /end MEASUREMENT
/begin MEASUREMENT VehMot_stStabIntv "Status Momentendurchgriff ESP-Eingriffe" UBYTE OneToOne 1 100 0.00 255.0 FORMAT "%5.1" ECU_ADDRESS 0xD000919F /end MEASUREMENT
/begin MEASUREMENT VehMot_trqDesAcs "Benötigtes Moment der Nebenaggregate innerhalb Vehicle Motion" SWORD Trq 1 100 -3276.800 3276.700 FORMAT "%8.3" ECU_ADDRESS 0xD00075FC /end MEASUREMENT
/begin MEASUREMENT VehMot_trqResvAcs "Gewünschre Momentenreserve der Nebenaggregate innerhalb Vehicle Motion" SWORD Trq 1 100 -3276.800 3276.700 FORMAT "%8.3" ECU_ADDRESS 0xD00075FE /end MEASUREMENT
/begin MEASUREMENT VMD_nMax "Maximal erlaubte Drehzahl nach Koordination mit Fahrerassistenzfunktionen" SWORD EngN 1 100 -16384.00 16383.50 FORMAT "%8.2" ECU_ADDRESS 0xD00075B4 /end MEASUREMENT
/begin MEASUREMENT VMD_nMin "Minimal erlaubte Drehzahl nach Koordination mit Fahrerassistenzfunktionen" SWORD EngN 1 100 -16384.00 16383.50 FORMAT "%8.2" ECU_ADDRESS 0xD00075B6 /end MEASUREMENT
/begin MEASUREMENT VMD_stNSetP "Status Drehzahlbegrenzung nach Koordination mit Fahrerassistenzfunktionen" UBYTE OneToOne 1 100 0.00 255.0 FORMAT "%5.1" ECU_ADDRESS 0xD000918D /end MEASUREMENT
/begin MEASUREMENT VMD_trqDes "Vortriebsmoment nach Koordination mit Fahrerassistenzfunktionen" SLONG TrqPrpHigh 1 100 -214748364.800 214748364.700 FORMAT "%13.3" ECU_ADDRESS 0xD00043C8 /end MEASUREMENT
/begin MEASUREMENT VMD_trqLead "Vortriebsvorhaltemoment nach Koordination mit" SLONG TrqPrpHigh 1 100 -214748364.800 214748364.700 FORMAT "%13.3" ECU_ADDRESS 0xD00043CC /end MEASUREMENT
/begin MEASUREMENT VMD_trqLeadPOp "Vortriebsvorhaltemoment, erhöhend, für GDI-Betriebsmodus" SLONG TrqPrpHigh 1 100 -214748364.800 214748364.700 FORMAT "%13.3" ECU_ADDRESS 0xD00043D0 /end MEASUREMENT
/begin FUNCTION cacdsp_dd ""
 /begin DEF_CHARACTERISTIC Air_pTransfPCACDs_CUR Air_SRCPCACDs.uMin_C Air_SRCPCACDs.uMax_C Air_swtSigPCACDs_C /end DEF_CHARACTERISTIC
 /begin OUT_MEASUREMENT Air_pSensPCACDs Air_uRawPCACDs /end OUT_MEASUREMENT
/end FUNCTION
/begin FUNCTION cacdsp_ddvar "" /begin DEF_CHARACTERISTIC Air_tiPT1T1PCACDs_C /end DEF_CHARACTERISTIC /begin IN_MEASUREMENT EpmCrS_numSeg EpmSyn_stCrSPos /end IN_MEASUREMENT /end FUNCTION
/begin FUNCTION CACDsP_VD ""
 /begin DEF_CHARACTERISTIC Air_ParCACDsDT1.T1_C Air_ParCACDsDT1.Kd_C Air_RmpSlpPCACDs.Pos_C Air_RmpSlpPCACDs.Neg_C Air_swtSensPresPCACDs_C Air_tiPT1T1SigPCACDs_C Air_TransStageParPCACDs.Dfl_C Air_TransStageParPCACDs.stSensId_C /end DEF_CHARACTERISTIC
 /begin OUT_MEASUREMENT Air_dpFltCACDs Air_pCACDs Air_pUnFltPCACDs /end OUT_MEASUREMENT
/end FUNCTION
/begin FUNCTION cacdsp_vdvar ""
 /begin DEF_CHARACTERISTIC Air_dpGradLimPCACDs_C Air_nLimPCACDs_C Air_pDiffLimPCACDs_C /end DEF_CHARACTERISTIC
 /begin IN_MEASUREMENT EnvP_pSens Epm_nEng /end IN_MEASUREMENT
/end FUNCTION
/begin FUNCTION CACDsT_DD ""
 /begin DEF_CHARACTERISTIC Air_SRCTCACDs.uMin_C Air_SRCTCACDs.uMax_C Air_swtSigTCACDs_C Air_tTransfTCACDs_CUR /end DEF_CHARACTERISTIC
 /begin OUT_MEASUREMENT Air_tSensTCACDs Air_uRawTCACDs /end OUT_MEASUREMENT
/end FUNCTION
/begin FUNCTION CACDsT_VD ""
 /begin DEF_CHARACTERISTIC Air_RmpSlpTCACDs.Pos_C Air_RmpSlpTCACDs.Neg_C Air_swtSensPresTCACDs_C Air_tiLPFiltPT1TCACDs_C Air_TransStgTCACDs.Dfl_C Air_TransStgTCACDs.stSensId_C /end DEF_CHARACTERISTIC
 /begin OUT_MEASUREMENT Air_dtTCACDs Air_tCACDs /end OUT_MEASUREMENT
/end FUNCTION
/begin FUNCTION CACDsT_VDVar "" /begin DEF_CHARACTERISTIC Air_tDflOffsTCACDs_C /end DEF_CHARACTERISTIC /begin IN_MEASUREMENT EnvT_t /end IN_MEASUREMENT /end FUNCTION
/begin FUNCTION CalWup "" /end FUNCTION
/begin FUNCTION calwup_swt "" /begin DEF_CHARACTERISTIC Calwup_swtWakeupEnaCpl_C Calwup_swtWakeupEna_C /end DEF_CHARACTERISTIC /end FUNCTION
/begin FUNCTION Can "" /end FUNCTION
/begin FUNCTION can_auto "" /end FUNCTION
/begin FUNCTION CB ""
 /begin SUB_FUNCTION CBMain CBSrv CBTarget CBOS CBReprog CBTProt CBFlash CBFPrt CBUAcc CBUtil /end SUB_FUNCTION
/end FUNCTION
/begin FUNCTION CBBasic "" /end FUNCTION
/begin FUNCTION CBBMW "" /end FUNCTION
/begin FUNCTION CBDC "" /end FUNCTION
/begin FUNCTION CBFlash "" /end FUNCTION
/begin FUNCTION CBFPrt "" /end FUNCTION
/begin FUNCTION CBMain "" /end FUNCTION
/begin FUNCTION CBOS "" /end FUNCTION
/begin FUNCTION CBPSA "" /end FUNCTION
/begin FUNCTION CBReprog "" /end FUNCTION
/begin FUNCTION CBSrv "" /begin SUB_FUNCTION CBBasic CBBMW CBDC CBPSA CBVW /end SUB_FUNCTION /end FUNCTION
/begin FUNCTION CBTarget "" /end FUNCTION
/begin FUNCTION CBTProt "" /end FUNCTION
/begin FUNCTION CBUAcc "" /end FUNCTION
/begin FUNCTION CBUtil "" /end FUNCTION
/begin FUNCTION CBVW "" /end FUNCTION
/begin FUNCTION CByVlv_DD ""
 /begin DEF_CHARACTERISTIC CByVlv_DigOut.tiBtwTstSCB_C CByVlv_DigOut.tiBtwTstOT_C CByVlv_DigOut.numTstMax_C CByVlv_stPsDiaDisbl_C CByVlv_stPsDisbl_C /end DEF_CHARACTERISTIC
 /begin IN_MEASUREMENT DevLib_stPwrStgEnaCond /end IN_MEASUREMENT
 /begin OUT_MEASUREMENT CByVlv_st CByVlv_stPs /end OUT_MEASUREMENT
/end FUNCTION
/begin FUNCTION ccp_auto "" /begin DEF_CHARACTERISTIC CcpAcquisitionConfig /end DEF_CHARACTERISTIC /end FUNCTION
/begin FUNCTION CEngDsT_DD ""
 /begin DEF_CHARACTERISTIC CEngDsT_SRC.uMin_C CEngDsT_SRC.uMax_C CEngDsT_swtSensPres_C CEngDsT_swtSig_C CEngDsT_tTransf_CUR /end DEF_CHARACTERISTIC
 /begin OUT_MEASUREMENT CEngDsT_stErrIni CEngDsT_tSens CEngDsT_uRaw /end OUT_MEASUREMENT
/end FUNCTION
/begin FUNCTION CEngDsT_VD ""
 /begin DEF_CHARACTERISTIC CEngDsT_Rmp1.Pos_C CEngDsT_Rmp1.Neg_C CEngDsT_Rmp2.Pos_C CEngDsT_Rmp2.Neg_C CEngDsT_stSensID_C CEngDsT_tDflCold_C CEngDsT_tDflWarm_C CEngDsT_tiPT1T1_C /end DEF_CHARACTERISTIC
 /begin IN_MEASUREMENT CoEng_st /end IN_MEASUREMENT
 /begin OUT_MEASUREMENT CEngDsT_dt CEngDsT_t /end OUT_MEASUREMENT
 /begin LOC_MEASUREMENT CEngDsT_t_mp /end LOC_MEASUREMENT
/end FUNCTION
/begin FUNCTION CEngDsT_VDDynTst ""
 /begin DEF_CHARACTERISTIC CEngDsT_dtMinDynTst_C CEngDsT_nMinEnaDynTst_C CEngDsT_qMinEnaDynTst_C CEngDsT_tiMaxDynTst_CUR CEngDsT_tMinDynTst_C /end DEF_CHARACTERISTIC
 /begin IN_MEASUREMENT Epm_nEng InjCtl_qSetUnBal /end IN_MEASUREMENT
 /begin OUT_MEASUREMENT CEngDsT_dtDynTst_mp CEngDsT_tEndDynTst_mp CEngDsT_tiDynTst_mp CEngDsT_tiMaxDynTst CEngDsT_tStrt /end OUT_MEASUREMENT
/end FUNCTION
/begin FUNCTION CEngUsT_DD "" /begin DEF_CHARACTERISTIC CEngUsT_SRC.uMin_C CEngUsT_SRC.uMax_C CEngUsT_tTransf_CUR /end DEF_CHARACTERISTIC /begin OUT_MEASUREMENT CEngUsT_tSens CEngUsT_uRaw /end OUT_MEASUREMENT /end FUNCTION
/begin FUNCTION CEngUsT_VD ""
 /begin DEF_CHARACTERISTIC CEngUsT_RmpSlp.Pos_C CEngUsT_RmpSlp.Neg_C CEngUsT_TransStagePar.Dfl_C CEngUsT_TransStagePar.stSensId_C /end DEF_CHARACTERISTIC
 /begin OUT_MEASUREMENT CEngUsT_t /end OUT_MEASUREMENT
/end FUNCTION
/begin FUNCTION Cj125 "" /end FUNCTION
/begin FUNCTION Cj230 "" /end FUNCTION
/begin FUNCTION Cj945 "" /end FUNCTION
/begin FUNCTION Clth_DD ""
 /begin DEF_CHARACTERISTIC Clth_Deb.tiHiLo_C Clth_Deb.tiLoHi_C Clth_stOpn_C Clth_stSlipClsd_C Clth_stSlipOpn_C Clth_stSlip_C Clth_swtSig_C /end DEF_CHARACTERISTIC
/end FUNCTION
/begin FUNCTION Clth_VD ""
 /begin DEF_CHARACTERISTIC Clth_nNoGearShftDet_C Clth_stDflVal_C Clth_tiGearShft_C Clth_vNoGearShftDet_C /end DEF_CHARACTERISTIC
 /begin IN_MEASUREMENT Com_stClth Epm_nEng PT_numTraGear SyC_stSub VehV_v /end IN_MEASUREMENT
 /begin OUT_MEASUREMENT Clth_st /end OUT_MEASUREMENT
 /begin LOC_MEASUREMENT Clth_stIntDebVal Clth_stLastGear Clth_stOldGear Clth_stOpnMark Clth_stRaw /end LOC_MEASUREMENT
/end FUNCTION
/begin FUNCTION CmbChb_Misfire ""
 /begin DEF_CHARACTERISTIC CmbChb_ctEngRevPerBlk_C CmbChb_ctMisfMax_C CmbChb_ctSegTDC1_C CmbChb_numBlk_C CmbChb_phiSegLngth_CA CmbChb_phiSegPosOfs_CA CmbChb_rSpdIncrMin_C /end DEF_CHARACTERISTIC
 /begin IN_MEASUREMENT CmbChb_st EpmCrS_numSeg EpmSyn_phiInt Epm_nEngCurr Epm_numCyl /end IN_MEASUREMENT
 /begin OUT_MEASUREMENT CmbChb_nMisf CmbChb_stDelMisf /end OUT_MEASUREMENT
 /begin LOC_MEASUREMENT CmbChb_ctEngRevLogBuf1_mp CmbChb_ctEngRevLogBuf2_mp CmbChb_ctEngRevLogMem_mp CmbChb_ctEngRevPerBlk_mp CmbChb_ctMifBuf1_mp CmbChb_ctMifBuf2_mp CmbChb_ctMifMem_mp CmbChb_nSegEven_mp CmbChb_nSegOdd_mp CmbChb_nSpdIncrCurr_mp CmbChb_nSpdIncrMin_mp /end LOC_MEASUREMENT
/end FUNCTION
/begin FUNCTION CmbChb_MisfireEn ""
 /begin DEF_CHARACTERISTIC CmbChb_ctMisfTempSel_C CmbChb_nEngThresHi_C CmbChb_nEngThresLo_C CmbChb_qSetThresHi_C CmbChb_qSetThresLo_C CmbChb_stClth_C CmbChb_tEngThresLo_C CmbChb_tiDebClthChng_C CmbChb_tiDelStrt_C CmbChb_vThresHi_C /end DEF_CHARACTERISTIC
 /begin IN_MEASUREMENT Clth_st CoEng_stEng CoEng_tiNormal EngDa_tFld Epm_nEng InjCtl_qSetUnBal VehV_v /end IN_MEASUREMENT
 /begin OUT_MEASUREMENT CmbChb_st /end OUT_MEASUREMENT
/end FUNCTION
/begin FUNCTION CnvLead_Trq2Q "" /begin IN_MEASUREMENT CnvSet_etaCurr PthLead_trqInrCurr PthLead_trqInrLead /end IN_MEASUREMENT /begin OUT_MEASUREMENT CnvLead_qCurr CnvLead_qRaw /end OUT_MEASUREMENT /end FUNCTION
/begin FUNCTION CnvSet_Trq2Q "" /begin DEF_CHARACTERISTIC CnvSet_eta0_C /end DEF_CHARACTERISTIC /begin IN_MEASUREMENT PhyMod_facEtaCor PthSet_trqInrSet StSys_trqStrt /end IN_MEASUREMENT /begin OUT_MEASUREMENT CnvSet_etaCurr CnvSet_qSet CnvSet_qStrt /end OUT_MEASUREMENT /begin LOC_MEASUREMENT CnvSet_qSetOpt_mp /end LOC_MEASUREMENT /end FUNCTION
/begin FUNCTION coas_rlscmpn "" /begin OUT_MEASUREMENT CoAS_stEGRVlv CoAS_stThrVlv CoAS_stTrbCh /end OUT_MEASUREMENT /end FUNCTION
/begin FUNCTION coctm_demand "" /begin IN_MEASUREMENT AC_trqDes AC_trqResv /end IN_MEASUREMENT /begin OUT_MEASUREMENT CTM_nMin CTM_trqDes CTM_trqResv /end OUT_MEASUREMENT /end FUNCTION
/begin FUNCTION coctm_shutoff "" /begin IN_MEASUREMENT CoTS_trqMaxAC /end IN_MEASUREMENT /begin OUT_MEASUREMENT CoCTM_trqMaxAC /end OUT_MEASUREMENT /end FUNCTION
/begin FUNCTION CoEng_Mon "" /begin DEF_CHARACTERISTIC CoEng_AftRunShOff_C CoEng_stShutOffInit_C /end DEF_CHARACTERISTIC /begin IN_MEASUREMENT CoEng_st /end IN_MEASUREMENT /begin OUT_MEASUREMENT CoEng_stShutOffPath /end OUT_MEASUREMENT /end FUNCTION
/begin FUNCTION CoEng_MonAdap ""
 /begin OUT_MEASUREMENT CoEng_stDiaReq CoEng_stIRevShutOff CoEng_stRevShutOff CoEng_stShutOff /end OUT_MEASUREMENT
/end FUNCTION
/begin FUNCTION CoEng_StEng ""
 /begin DEF_CHARACTERISTIC CoEng_nThresCranking_C CoEng_nThresNrml2Strt_C CoEng_stShOffAftRun_C CoEng_tiNrml2Strt_C CoEng_tiPwrStgDiaRdy_C /end DEF_CHARACTERISTIC
 /begin IN_MEASUREMENT Epm_nEng StSys_stStrt /end IN_MEASUREMENT
 /begin OUT_MEASUREMENT CoEng_st CoEng_stAftRun CoEng_stAftRunPath CoEng_stEng CoEng_stEngOld CoEng_stOld CoEng_tiAfterrun CoEng_tiAfterrunRed CoEng_tiNormal CoEng_tiNormalRed CoEng_tiStandby CoEng_tiStandbyRed CoEng_tiStart CoEng_tiStartRed /end OUT_MEASUREMENT
/end FUNCTION
/begin FUNCTION coeng_tstco "" /begin DEF_CHARACTERISTIC CoEng_tiTstMax_C /end DEF_CHARACTERISTIC /begin OUT_MEASUREMENT CoEng_stTst /end OUT_MEASUREMENT /end FUNCTION
/begin FUNCTION coeom_co ""
 /begin DEF_CHARACTERISTIC CoEOM_stNxtOpMode_CA CoEOM_stNxtStage_CA CoEOM_stOpModeDes_C CoEOM_stOpModeDL_CA CoEOM_stOpModeMax_C /end DEF_CHARACTERISTIC
 /begin IN_MEASUREMENT CoEOM_numOpModeAct CoEOM_numOpModeAct_mp CoEOM_numStageAct CoEOM_numStageAct_mp CoEOM_stOpModeActTSync CoEOM_stOpModeItm /end IN_MEASUREMENT
 /begin OUT_MEASUREMENT CoEOM_stDeadlck CoEOM_stEndOpMode CoEOM_stNxtOpMode CoEOM_stNxtStage CoEOM_stOpModeDem CoEOM_stOpModeDes CoEOM_stOpModePos CoEOM_stOpModePrio2 CoEOM_stOpModeSort /end OUT_MEASUREMENT
/end FUNCTION
/begin FUNCTION coeom_lib "" /end FUNCTION
/begin FUNCTION coeom_swtnsync ""
 /begin IN_MEASUREMENT CoEOM_stOpModeActTSync CoEOM_stOpModeLckTSync CoEOM_stOpModeOldTSync CoEOM_tiOpModeChngTSync CoEOM_tiRmpSlp /end IN_MEASUREMENT
 /begin OUT_MEASUREMENT CoEOM_facRmpVal CoEOM_stOpModeAct CoEOM_stOpModeLck CoEOM_stOpModeOld CoEOM_tiOpModeChng /end OUT_MEASUREMENT
/end FUNCTION
/begin FUNCTION coeom_swttsync "" /begin DEF_CHARACTERISTIC CoEOM_tiRmpMax_C CoEOM_tiRmpMin_C CoEOM_tiRmp_CA /end DEF_CHARACTERISTIC /begin REF_CHARACTERISTIC CoEOM_stOpModeDes_C /end REF_CHARACTERISTIC
 /begin IN_MEASUREMENT CoEng_stEng CoEOM_facRmpVal CoEOM_stDeadlck CoEOM_stEndOpMode CoEOM_stOpModeDes CoEOM_stOpModePrio2 CoEOM_stTiRmpDem CoEOM_tiRmpDem /end IN_MEASUREMENT
 /begin OUT_MEASUREMENT CoEOM_numOpModeAct CoEOM_numOpModeOld CoEOM_numStageAct CoEOM_stOpModeActTSync CoEOM_stOpModeLckTSync CoEOM_stOpModeOldTSync CoEOM_stTransActv CoEOM_tiOpModeChngTSync CoEOM_tiRmpSlp /end OUT_MEASUREMENT
 /begin LOC_MEASUREMENT CoEOM_numOpModeAct_mp CoEOM_numOpModeOld_mp CoEOM_numStageAct_mp /end LOC_MEASUREMENT
/end FUNCTION
/begin FUNCTION coeom_trans "" /begin DEF_CHARACTERISTIC CoEOM_Prio2_CA CoEOM_stDSCHEDPrio_C CoEOM_stOpMode_C /end DEF_CHARACTERISTIC /begin IN_MEASUREMENT CoEOM_stOpModePrio2 PthSet_stOvrRunCoord /end IN_MEASUREMENT
 /begin OUT_MEASUREMENT CoEOM_stDSCHEDDem CoEOM_stOpModeItm CoEOM_stRisePrio CoEOM_stTiRmpDem CoEOM_tiRmpDem /end OUT_MEASUREMENT
/end FUNCTION
/begin FUNCTION coess_dem ""
 /begin DEF_CHARACTERISTIC CoESS_DelEngSetP.tiHiLo_C CoESS_DelEngSetP.tiLoHi_C CoESS_DelVltgBattRstP.tiHiLo_C CoESS_DelVltgBattRstP.tiLoHi_C CoESS_DelVltgBattSetP.tiHiLo_C CoESS_DelVltgBattSetP.tiLoHi_C CoESS_nIdlBattThres_C CoESS_nMax_C CoESS_nMinBatt_C CoESS_nMinThres_C CoESS_stEngStop_C CoESS_stEngStrt_C CoESS_uIdlBattThresRst_C CoESS_uIdlBattThresSet_C CoESS_vMinThres_C /end DEF_CHARACTERISTIC
 /begin IN_MEASUREMENT Alt_trqDes Alt_trqResv CoEng_st Epm_nEng ESS_uBatt GlbDa_vX HLSDem_nSetPLo PT_stGrip /end IN_MEASUREMENT
 /begin OUT_MEASUREMENT ESS_nMax ESS_nMin ESS_stEngStopEna ESS_stEngStrtEna ESS_trqDesAcs ESS_trqResvAcs /end OUT_MEASUREMENT
 /begin LOC_MEASUREMENT CoESS_stEngSet_mp CoESS_stNBattRst_mp CoESS_stNBattSet_mp CoESS_stVltgBattRst_mp CoESS_stVltgBattSet_mp /end LOC_MEASUREMENT
/end FUNCTION
/begin FUNCTION coess_ord "" /begin IN_MEASUREMENT CoVeh_stAlt /end IN_MEASUREMENT /begin OUT_MEASUREMENT CoESS_stAlt /end OUT_MEASUREMENT /end FUNCTION
/begin FUNCTION coetm_clgdem ""
 /begin DEF_CHARACTERISTIC CoETM_facAftRun2_C CoETM_facClgAftRun_CUR CoETM_rClgAftRun_MAP CoETM_rClgDemMax_C CoETM_rClgDemMin_C CoETM_rClgIntLimP.Min_C CoETM_rClgIntLimP.Max_C CoETM_rClgKi_CUR CoETM_tDvtMax_C CoETM_tDvtMin_C CoETM_tEngOutSubsOff_C CoETM_tiClgAftRun2_MAP CoETM_tiClgAftRun_MAP CoETM_tiClgIntegT1_C /end DEF_CHARACTERISTIC
 /begin IN_MEASUREMENT CoEng_st CoTS_tClntEngOutDes GlbDa_tEnv TS_tClntEngOut /end IN_MEASUREMENT
 /begin OUT_MEASUREMENT CoETM_rClgDemLim_mp CoETM_rClgIntegLim_mp CoETM_rClgProp_mp CoETM_stAftRun_mp CoETM_tClntEngOut_mp CoETM_tDvt_mp CoETM_tEngOutOff_mp CoETM_tiClgAftRun2_mp CoETM_tiClgAftRunMax2_mp CoETM_tiClgAftRun_mp ETM_rClgDem ETM_rCtT /end OUT_MEASUREMENT
/end FUNCTION
/begin FUNCTION coetm_clgdem_inl "" /begin DEF_CHARACTERISTIC CoETM_rClgDemFan_CUR CoETM_rClgDemT_CUR CoETM_rClgKp_CUR /end DEF_CHARACTERISTIC /begin IN_MEASUREMENT CoETM_rClgDemLim_mp CoETM_tDvt_mp /end IN_MEASUREMENT /end FUNCTION
/begin FUNCTION coetm_clgdem_var1 ""
 /begin DEF_CHARACTERISTIC CoETM_qInjCurrMax_MAP CoETM_rCThmstOff_C CoETM_rCThmstOn_C CoETM_rHtFlowReqHi_C CoETM_rHtFlowReqLo_C CoETM_tEngDiffMin_C CoETM_tEngOutMin_C /end DEF_CHARACTERISTIC
 /begin IN_MEASUREMENT Epm_nEng TS_tClntEngIn /end IN_MEASUREMENT
 /begin LOC_MEASUREMENT CoETM_qInjCurrMax_mp CoETM_stClgDem1 CoETM_stClgDem2 CoETM_stClgDem3 CoETM_stClgDem4 CoETM_tEngDiff_mp /end LOC_MEASUREMENT
/end FUNCTION
/begin FUNCTION coets_sttrqlimcalc "" /begin DEF_CHARACTERISTIC CoETS_nTrqRatMin_C /end DEF_CHARACTERISTIC
 /begin IN_MEASUREMENT ActMod_trqInr CoETS_trqInrLimSet CoETS_trqInrSetSlow EngDem_facAdj EngDem_trqInrLim EngDem_trqLimErr EngPrt_trqLim EngPrt_trqLimMech EngPrt_trqLimOvhtPrv EngReq_trqInrLimInj EngReq_trqInrLimSmk Epm_nEng GlbDa_stVehLimMin GlbDa_trqVehLimMin RngMod_trqMin /end IN_MEASUREMENT
 /begin OUT_MEASUREMENT CoETS_rTrq CoETS_stCurrLim CoETS_stCurrLimActive CoETS_trqInrCurrLim CoETS_trqInrVehLimMin_mp /end OUT_MEASUREMENT
/end FUNCTION
/begin FUNCTION CoETS_TrqCalc "" /begin DEF_CHARACTERISTIC CoETS_trqSetMax_C /end DEF_CHARACTERISTIC
 /begin IN_MEASUREMENT CoPT_trqCurrEng CoPT_trqDCSClth CoPT_trqDesCompEng CoPT_trqDesEng CoPT_trqLeadEng CoPT_trqPTPrt CoPT_trqResvCnstEng EngDem_trqInrLim EngDem_trqInrLimLead RngMod_trqClthMin SpdGov_st SpdGov_trqFlt SpdGov_trqInrLimSet /end IN_MEASUREMENT
 /begin OUT_MEASUREMENT CoETS_stSetTrqActv CoETS_trqInrCurr CoETS_trqInrCurrFast CoETS_trqInrLead CoETS_trqInrLeadFast CoETS_trqInrLim CoETS_trqInrLimSet CoETS_trqInrLtd CoETS_trqInrSetSlow CoETS_trqInrTraIntv CoETS_trqSetDiag CoETS_trqUnFltLtd CoETS_trqUnFltLtdSet /end OUT_MEASUREMENT
 /begin LOC_MEASUREMENT CoETS_stSetTrqAlw_mp CoETS_trqSet_mp /end LOC_MEASUREMENT
/end FUNCTION
/begin FUNCTION comcil ""
 /begin DEF_CHARACTERISTIC FrmMng_trqClthTSCDec_C FrmMng_trqClthTSCInc_C FrmMng_trqClthTSCPrt_C /end DEF_CHARACTERISTIC
 /begin OUT_MEASUREMENT FrmMng_nTrbn FrmMng_nTSCInc FrmMng_nTSCTrgt FrmMng_numGear FrmMng_numGearLever FrmMng_numGearTrgt FrmMng_rClgDem FrmMng_rTraConv FrmMng_rTraTSC FrmMng_stLowRng FrmMng_stRevGear FrmMng_tClntDes FrmMng_tiTSCInc FrmMng_tOilConv FrmMng_trqClthTSCDec FrmMng_trqClthTSCInc FrmMng_trqClthTSCPrt FrmMng_trqConvLoss NMng_stFadeOut /end OUT_MEASUREMENT
 /begin SUB_FUNCTION comcil AircECU_co AircECU_Can DsplECU_co DsplECU_Can BrkECU_co BrkECU_Can EngECU_co EngECU_Can GbxECU_co GbxECU_Can Misc_co Misc_Can /end SUB_FUNCTION
/end FUNCTION
/begin FUNCTION comcil_can100ms "" /end FUNCTION
/begin FUNCTION comcil_can10ms "" /end FUNCTION
/begin FUNCTION comcil_can20ms "" /end FUNCTION
/begin FUNCTION comcil_caninit "" /end FUNCTION
/begin FUNCTION come_demcoord ""
 /begin IN_MEASUREMENT ESS_nMax ESS_nMin ESS_trqDesAcs ESS_trqResvAcs PT_trqLosComp PT_trqResv TS_nMax TS_nMin TS_nMinAC TS_trqDesAcs TS_trqResvAcs VehMot_nMaxAcs VehMot_nMinAcs VehMot_trqDesAcs VehMot_trqResvAcs /end IN_MEASUREMENT
 /begin OUT_MEASUREMENT CoME_nMax CoME_nMin CoME_stNSetP CoME_trqDesComp CoME_trqResv CoVeh_trqAcs /end OUT_MEASUREMENT
/end FUNCTION
/begin FUNCTION come_shutoff ""
 /begin DEF_CHARACTERISTIC CoME_drPedHi_C CoME_drPedLo_C CoME_nEng1Hi_C CoME_nEng1Lo_C CoME_nEng2Hi_C CoME_nEng2Lo_C CoME_numTraGearMax_C CoME_pEnv1Hi_C CoME_pEnv1Lo_C CoME_pEnv2Hi_C CoME_pEnv2Lo_C CoME_rPedHi_C CoME_rPedLo_C CoME_stAlt_CW CoME_stFan_CW CoME_tEnvAir1Hi_C CoME_tEnvAir1Lo_C CoME_tEnvAir2Hi_C CoME_tEnvAir2Lo_C CoME_trqAcc_C CoME_trqACMax_C CoME_trqBattVltg_C CoME_trqDrvOff_C CoME_trqStrt_C CoME_uBattMinHi_C CoME_uBattMinLo_C CoME_vX1Hi_C CoME_vX1Lo_C CoME_vX2Hi_C CoME_vX2Lo_C /end DEF_CHARACTERISTIC
 /begin IN_MEASUREMENT CoEng_st Epm_nEng ESS_uBatt GlbDa_pEnv GlbDa_tEnv GlbDa_vX PT_numTraGear VehMot_drAccPedUnFlt VehMot_rAccPedFlt /end IN_MEASUREMENT
 /begin OUT_MEASUREMENT CoME_stAcc_mp CoME_stBattVltg_mp CoME_stDrvOff_mp CoME_stStrt_mp CoVeh_stAlt CoVeh_stFan CoVeh_stWaHt CoVeh_trqMaxAC /end OUT_MEASUREMENT
/end FUNCTION
/begin FUNCTION come_shutoff_inl ""
 /begin DEF_CHARACTERISTIC CoME_calEngSpeed_AXIS CoME_stEEM_C CoME_tiBattVltgOff_C CoME_tiDrvOn_C CoME_tiMaxOffAcc_CUR CoME_tiMaxOffDrvOff_CUR CoME_tiMinOffAcc_CUR CoME_tiMinOffDrvOff_CUR CoME_tiOffStrtAC_C CoME_tiOffStrtAlt_C CoME_tiOffStrtWaHt_C /end DEF_CHARACTERISTIC
 /begin IN_MEASUREMENT Epm_nEng /end IN_MEASUREMENT
 /begin OUT_MEASUREMENT CoME_stAccMax_mp CoME_stAccMin_mp CoME_stAccTmr_mp CoME_stBattVltgTmr_mp CoME_stDrvOffMax_mp CoME_stDrvOffMin_mp CoME_stDrvOffTmr_mp CoME_stDrvTmr CoME_stOffAcc CoME_stOffDrvOff CoME_stStrtTmrAC_mp CoME_tiMaxOffAcc CoME_tiMaxOffDrvOff CoME_tiMinOffAcc CoME_tiMinOffDrvOff /end OUT_MEASUREMENT
/end FUNCTION
/begin FUNCTION conv_gripintrlck "" /begin IN_MEASUREMENT Gbx_stConvClth /end IN_MEASUREMENT /begin OUT_MEASUREMENT PT_stConvGrip /end OUT_MEASUREMENT /end FUNCTION
/begin FUNCTION conv_ldcalc ""
 /begin DEF_CHARACTERISTIC Conv_facDepNTrbnNStat_CUR Conv_facGnTrqHiInc_C Conv_facGnTrqResv_C Conv_facNTrbnCorr_C Conv_facVelErr_C Conv_facVelNoErr_C Conv_LvrOffDebP.tiHiLo_C Conv_LvrOffDebP.tiLoHi_C Conv_LvrPosOffDebP.tiHiLo_C Conv_LvrPosOffDebP.tiLoHi_C Conv_nTrbnLoLim_C Conv_nTrbnMinCorrVal_C Conv_nTrbn_C Conv_tiDwnRglPT1_C Conv_tiRTraGearPT1_C Conv_tiTrqLdPT1_C Conv_tiTrqResvPT1_C Conv_tiUpRglPT1_C Conv_trqLdGnFacHysDec_C Conv_trqLdMaxLim_MAP Conv_trqLdReplCan_C Conv_TrqResvDebP.tiHiLo_C Conv_TrqResvDebP.tiLoHi_C Conv_trqResvLoLim_C Conv_trqResvMinLim_C Conv_trqResvNeutrLvrPos_C Conv_trqResvPreFlt_C Conv_trqResvRepl_C Conv_trqStatSqLvrPosNeutr_C /end DEF_CHARACTERISTIC
 /begin IN_MEASUREMENT Conv_bCalc Conv_bConvActv Conv_bGearOff Conv_bTrbnSpdCan Conv_bTrqLdCan Conv_bTrqLdFlt Conv_bTrqResvBrkEnd Conv_bTrqResvLvrOff Conv_facOilTempDepTrqPmp Conv_tiTempDepLvrDebNeg Conv_tiTempDepLvrDebPos Conv_tiTempDepRevLvrDebNeg Conv_tiTempDepRevLvrDebPos Conv_trqLdLvrPosNeutr Conv_trqLdRevLvrPos Conv_trqLdTempDepLim Conv_trqResvTempDep Gbx_nTrbn Gbx_trqConvLos GlbDa_lWhlCirc GlbDa_vXFlt LiGov_nStat PT_numTraGear PT_rTraGear PT_stConvGrip PT_stTraGrip PT_stTraRevGear PT_stTraType TS_tClntEngOut VehMot_rTrqDfftl VehMot_stBrkPed /end IN_MEASUREMENT
 /begin OUT_MEASUREMENT Conv_bRevLvrPos Conv_bTrqResv Conv_nTrbn Conv_nTrbnMod Conv_nTrbnOld Conv_rNTrbnNStat_mp Conv_trqLd Conv_trqLdFlt Conv_trqLdMod Conv_trqLdPreFlt Conv_trqResv /end OUT_MEASUREMENT
 /begin LOC_MEASUREMENT Conv_bCalcActv_mp Conv_facDepNTrbnNStat_mp Conv_nTrbnCorrVal_mp Conv_nTrbnDiff_mp Conv_nTrbnExp_mp Conv_trqLdBefLim_mp Conv_trqLdDiff_mp Conv_trqLdFltRslt_mp Conv_trqLdMaxLim_mp Conv_trqLdOfs_mp Conv_trqLdResvAdd_mp Conv_trqLdResvFlt_mp Conv_trqLdTrqResvTotBuf_mp Conv_trqPmpBuf_mp Conv_trqResvHiInc_mp Conv_trqStatSqBuf_mp /end LOC_MEASUREMENT
/end FUNCTION
/begin FUNCTION conv_lddata ""
 /begin DEF_CHARACTERISTIC Conv_BrkDebP.tiHiLo_C Conv_BrkDebP.tiLoHi_C Conv_facClthClsd_GCUR Conv_facClthOpnd_GCUR Conv_facDfl_C Conv_tiDfl_C Conv_tiRevLvrOff_GCUR Conv_tiRevLvrOn_GCUR Conv_tiTempDepLvrOff_GCUR Conv_tiTempDepLvrOn_GCUR Conv_tPntDST_Axis Conv_trqDfl_C Conv_trqLdActv_CW Conv_trqLdLvrPosNeutr_GCUR Conv_trqLdRevLvrPos_GCUR Conv_trqLdTempDepLim_GCUR Conv_trqLd_CW Conv_trqResvTempDep_GCUR /end DEF_CHARACTERISTIC
 /begin IN_MEASUREMENT Gbx_tOilConv TS_tClntEngOut VehMot_stBrkPed /end IN_MEASUREMENT
 /begin OUT_MEASUREMENT Conv_bCalc Conv_bConvActv Conv_bGearOff Conv_bTrbnSpdCan Conv_bTrqLdCan Conv_bTrqLdFlt Conv_bTrqResvBrkEnd Conv_bTrqResvLvrOff Conv_facOilTempDepTrqPmp Conv_tiTempDepLvrDebNeg Conv_tiTempDepLvrDebPos Conv_tiTempDepRevLvrDebNeg Conv_tiTempDepRevLvrDebPos Conv_trqLdLvrPosNeutr Conv_trqLdRevLvrPos Conv_trqLdTempDepLim Conv_trqResvTempDep /end OUT_MEASUREMENT
 /begin LOC_MEASUREMENT Conv_tOilBuf_mp /end LOC_MEASUREMENT
/end FUNCTION
/begin FUNCTION conv_trqrat "" /begin DEF_CHARACTERISTIC Conv_rTrq_C /end DEF_CHARACTERISTIC /begin OUT_MEASUREMENT Conv_rTrq /end OUT_MEASUREMENT /end FUNCTION
/begin FUNCTION copt_thermdem "" /begin IN_MEASUREMENT CoTemp_rClgDes CoTemp_tEngDes Tra_rClgDem Tra_tClntDes /end IN_MEASUREMENT /begin OUT_MEASUREMENT CoPT_rClgDes CoPT_tClntDes /end OUT_MEASUREMENT /end FUNCTION
/begin FUNCTION copt_trqdescoord ""
 /begin IN_MEASUREMENT ActMod_trqClthWoDstC CoVeh_trqDes PT_rTrq PT_trqLos PT_trqTraPrt RngMod_trqClthBs Tra_trqDesMax Tra_trqDesMin VehMot_trqDCS VehMot_trqDesTCS VehMot_trqPrtDfftl /end IN_MEASUREMENT
 /begin OUT_MEASUREMENT CoPT_stIARls CoPT_trqDCSClth CoPT_trqDes CoPT_trqDesTCSClth CoPT_trqPTPrt CoPT_trqTraDes PT_stIARls PT_stTraIntv /end OUT_MEASUREMENT
 /begin LOC_MEASUREMENT CoPT_trqDesClth_mp CoPT_trqDesDecMin_mp CoPT_trqDesIncMax_mp /end LOC_MEASUREMENT
/end FUNCTION
/begin FUNCTION copt_trqleadcoord ""
 /begin DEF_CHARACTERISTIC CoPT_dtrqCurrCorP.Pos_C CoPT_dtrqCurrCorP.Neg_C CoPT_dtrqLeadCorP.Pos_C CoPT_dtrqLeadCorP.Neg_C CoPT_tiDebCurr_C CoPT_tiDebLead_C /end DEF_CHARACTERISTIC
 /begin IN_MEASUREMENT CoVeh_trqLead PT_rTrq PT_trqLos PT_trqTraPrt Tra_trqLeadMax Tra_trqLeadMin VehMot_trqDCS VehMot_trqLeadPOp VehMot_trqLeadTCS VehMot_trqPrtDfftl /end IN_MEASUREMENT
 /begin OUT_MEASUREMENT CoPT_trqCurr CoPT_trqLead CoPT_trqLeadPOp CoPT_trqLeadTCSClth /end OUT_MEASUREMENT
 /begin LOC_MEASUREMENT CoPT_trqCurrDecMin_mp CoPT_trqLeadClth_mp CoPT_trqLeadDecMin_mp CoPT_trqLeadIncMax_mp /end LOC_MEASUREMENT
/end FUNCTION
/begin FUNCTION Core "" /begin SUB_FUNCTION HWE EOS CSW Srv Core_Env /end SUB_FUNCTION /end FUNCTION
/begin FUNCTION Core_Env "" /end FUNCTION
/begin FUNCTION CoTemp_DmAirDesVal "" /begin DEF_CHARACTERISTIC CoTemp_rClgDes_CUR /end DEF_CHARACTERISTIC /begin IN_MEASUREMENT EngDa_tEng /end IN_MEASUREMENT /begin OUT_MEASUREMENT CoTemp_rClgDes /end OUT_MEASUREMENT /end FUNCTION
/begin FUNCTION CoTemp_TEngDesVal ""
 /begin DEF_CHARACTERISTIC CoTemp_tEngClntAftRunDes_C CoTemp_tEngClntIniDes_C CoTemp_tEngDesBaseNTrq_MAP CoTemp_tEngDesBaseTempVel_MAP /end DEF_CHARACTERISTIC
 /begin IN_MEASUREMENT EnvT_t Epm_nEng PthSet_trqInrSet SyC_stSub VehV_v /end IN_MEASUREMENT
 /begin OUT_MEASUREMENT CoTemp_tEngDes /end OUT_MEASUREMENT
/end FUNCTION
/begin FUNCTION cote_thermdem "" /begin OUT_MEASUREMENT CoVeh_rClgDes CoVeh_tClntDes /end OUT_MEASUREMENT /end FUNCTION
/begin FUNCTION cots_enasse "" /begin DEF_CHARACTERISTIC CoTS_tClntStopThres_C /end DEF_CHARACTERISTIC /begin IN_MEASUREMENT TS_tClntEngOut /end IN_MEASUREMENT /begin OUT_MEASUREMENT TS_stEngStopEna TS_stEngStrtEna /end OUT_MEASUREMENT /end FUNCTION
/begin FUNCTION cots_mechdem "" /begin IN_MEASUREMENT CTM_nMin CTM_trqDes CTM_trqResv Fans_trqCons WaHt_nMin /end IN_MEASUREMENT /begin OUT_MEASUREMENT TS_nMax TS_nMin TS_trqDesAcs TS_trqResvAcs /end OUT_MEASUREMENT /end FUNCTION
/begin FUNCTION cots_shutoffacs "" /begin IN_MEASUREMENT CoVeh_stWaHt CoVeh_trqMaxAC /end IN_MEASUREMENT /begin OUT_MEASUREMENT CoTS_stWaHt CoTS_trqMaxAC /end OUT_MEASUREMENT /end FUNCTION
/begin FUNCTION cots_thermdem "" /begin DEF_CHARACTERISTIC CoTS_tClntEngOutDes_C CoTS_tiPT1Neg_C CoTS_tiPT1Pos_C /end DEF_CHARACTERISTIC /begin IN_MEASUREMENT CoVeh_rClgDes CoVeh_tClntDes /end IN_MEASUREMENT /begin OUT_MEASUREMENT CoTS_rClgDem CoTS_tClntEngOutDes /end OUT_MEASUREMENT /begin LOC_MEASUREMENT CoTS_tClntDesFlt /end LOC_MEASUREMENT /end FUNCTION
/begin FUNCTION coveh_calctrqprplimerr "" /begin DEF_CHARACTERISTIC CoVeh_trqLim_CUR /end DEF_CHARACTERISTIC /begin IN_MEASUREMENT Epm_nEng VehMot_rTrqDfftl /end IN_MEASUREMENT /begin OUT_MEASUREMENT CoVeh_trqPrpLimErr /end OUT_MEASUREMENT /begin LOC_MEASUREMENT CoVeh_trqLim_mp /end LOC_MEASUREMENT /end FUNCTION
/begin FUNCTION coveh_spdcoord "" /begin IN_MEASUREMENT VehMot_nMax VehMot_nMin VehMot_stNSetP /end IN_MEASUREMENT /begin OUT_MEASUREMENT CoVeh_nMaxSysErr CoVeh_nMinSysErr CoVeh_stNSetPSysErr /end OUT_MEASUREMENT /end FUNCTION
/begin FUNCTION coveh_trqdescoord "" /begin IN_MEASUREMENT CoVeh_trqPrpLimErr VehMot_trqDes /end IN_MEASUREMENT /begin OUT_MEASUREMENT CoVeh_stLimSysErr CoVeh_trqDes /end OUT_MEASUREMENT /end FUNCTION
/begin FUNCTION coveh_trqleadcoord "" /begin IN_MEASUREMENT CoVeh_trqPrpLimErr VehMot_trqLead /end IN_MEASUREMENT /begin OUT_MEASUREMENT CoVeh_trqLead /end OUT_MEASUREMENT /end FUNCTION
/begin FUNCTION covmd_spdcoord "" /begin IN_MEASUREMENT AccPed_nMax AccPed_nMin AccPed_stNSetP /end IN_MEASUREMENT /begin OUT_MEASUREMENT VMD_nMax VMD_nMin VMD_stNSetP /end OUT_MEASUREMENT /end FUNCTION
/begin FUNCTION covmd_trqcalc ""
 /begin DEF_CHARACTERISTIC CoVMD_swtCCSelVal_C CoVMD_trqThresCtOffLo_C CoVMD_trqThresCtOffUp_C /end DEF_CHARACTERISTIC
 /begin IN_MEASUREMENT ACCI_aReq ACCI_stReq CrCtl_aReq CrCtl_stReq LLim_aReq LLim_stReq MoFDrAs_stPtdMsg PT_swtMstShft PT_trqSpdGovLtd PT_trqWhlMaxEng PT_trqWhlMinEng PT_trqWhlMinWoCtOff VehMot_a2trq VehMot_stAccPedOvrRun VehMot_trqDrag VehMot_trqThresComp /end IN_MEASUREMENT
 /begin OUT_MEASUREMENT CoVMD_aReqCrCtl_mp CoVMD_facCompAcsCrCtl CoVMD_facCompAcsLLim CoVMD_stCtOffPhdCrCtl CoVMD_stCtOffPhdLLim CoVMD_stReqCrCtl CoVMD_swtCCSel CoVMD_trqCrCtl CoVMD_trqCrCtl_mp CoVMD_trqLLim CoVMD_trqLLim_mp /end OUT_MEASUREMENT
/end FUNCTION
/begin FUNCTION covmd_trqdescoord ""
 /begin DEF_CHARACTERISTIC CoVMD_trqThresCrCtlL_C CoVMD_trqThresCrCtlR_C CoVMD_trqThresLLimL_C CoVMD_trqThresLLimR_C /end DEF_CHARACTERISTIC
 /begin IN_MEASUREMENT AccPed_facCompAcs AccPed_trqDes CoVMD_facCompAcsCrCtl CoVMD_facCompAcsLLim CoVMD_stCtOffPhdCrCtl CoVMD_stCtOffPhdLLim CoVMD_stReqCrCtl CoVMD_trqCrCtl CoVMD_trqLLim LLim_stReq /end IN_MEASUREMENT
 /begin OUT_MEASUREMENT VehMot_facCompAcs VehMot_stCtOffPhd VehMot_stPrpCrCtl VehMot_stPrpLLim VMD_trqDes /end OUT_MEASUREMENT
/end FUNCTION
/begin FUNCTION covmd_trqleadcoord "" /begin IN_MEASUREMENT AccPed_trqLead CoVMD_trqCrCtl CoVMD_trqLLim /end IN_MEASUREMENT /begin OUT_MEASUREMENT VMD_trqLead VMD_trqLeadPOp /end OUT_MEASUREMENT /end FUNCTION
/begin FUNCTION covm_iarlscoord "" /begin IN_MEASUREMENT CoVM_stIARls Prp_stIARls /end IN_MEASUREMENT /begin OUT_MEASUREMENT VehMot_stIARls /end OUT_MEASUREMENT /end FUNCTION
/begin FUNCTION covm_spdcoord "" /begin IN_MEASUREMENT Strg_nMax Strg_nMin VMD_nMax VMD_nMin VMD_stNSetP /end IN_MEASUREMENT
 /begin OUT_MEASUREMENT VehMot_nMax VehMot_nMaxAcs VehMot_nMin VehMot_nMinAcs VehMot_stNSetP /end OUT_MEASUREMENT
/end FUNCTION
/begin FUNCTION covm_trqacscoord "" /begin IN_MEASUREMENT Strg_trqDes Strg_trqResv /end IN_MEASUREMENT /begin OUT_MEASUREMENT VehMot_trqDesAcs VehMot_trqResvAcs /end OUT_MEASUREMENT /end FUNCTION
/begin FUNCTION covm_trqdescoord ""
 /begin IN_MEASUREMENT PT_trqWhlBs PT_trqWhlWoDstC VMD_trqDes VMSI_trqDesMax VMSI_trqMin /end IN_MEASUREMENT
 /begin OUT_MEASUREMENT CoVM_stIARls CoVM_trqDes VehMot_stStabIntv /end OUT_MEASUREMENT
 /begin LOC_MEASUREMENT CoVM_trqDesIncMax_mp /end LOC_MEASUREMENT
/end FUNCTION
/begin FUNCTION covm_trqleadcoord ""
 /begin DEF_CHARACTERISTIC CoVM_dtrqLeadCorP.Pos_C CoVM_dtrqLeadCorP.Neg_C CoVM_TrqRedMaxP.tiHiLo_C CoVM_TrqRedMaxP.tiLoHi_C /end DEF_CHARACTERISTIC
 /begin IN_MEASUREMENT VMD_trqLead VMD_trqLeadPOp VMSI_trqLeadMax VMSI_trqMin /end IN_MEASUREMENT
 /begin OUT_MEASUREMENT CoVM_trqLead CoVM_trqLeadPOp /end OUT_MEASUREMENT
 /begin LOC_MEASUREMENT CoVM_trqLeadIncMax_mp /end LOC_MEASUREMENT
/end FUNCTION
/begin FUNCTION covom_sse ""
 /begin DEF_CHARACTERISTIC CoVOM_stEngStopOrd_C CoVOM_stEngStrtOrd_C SSE_numEngStart2StopMax_C SSE_tiEngStopASTDebPos_C SSE_tiEngStopMTDebPos_C SSE_tiEngStrtAbortion1DebPos_C SSE_tiEngStrtAbortion2DebPos_C SSE_vXMaxSinceStrtMin_C SSE_vXMinEngStop_C /end DEF_CHARACTERISTIC
 /begin IN_MEASUREMENT CoEng_stEng CoVeh_stIgnLckTerm15 ESS_stEngStopEna ESS_stEngStrtEna GlbDa_vX PT_stConvGrip PT_stEngStopEna PT_stEngStrtEna PT_stTraGrip PT_stTraType SSEUI_stStopStrtEna TS_stEngStopEna TS_stEngStrtEna VehMot_rAccPedFlt VehMot_stBrkPed /end IN_MEASUREMENT
 /begin OUT_MEASUREMENT CoVeh_stEngStopEna CoVeh_stEngStopOrd CoVeh_stEngStrtOrd CoVeh_stSSE CoVeh_stSSEEngStop /end OUT_MEASUREMENT
 /begin LOC_MEASUREMENT CoVOM_modeEngReq_mp CoVOM_stClPressed0_mp CoVOM_stClPressed10_mp CoVOM_stClPressed90_mp CoVOM_stEngOff_mp CoVOM_stEngRun_mp CoVOM_stStopCondAST_mp CoVOM_stStopCondMT_mp CoVOM_stStopCond_mp CoVOM_stStrtCondAST_mp CoVOM_stStrtCondMT_mp SSE_bEngOpPassed SSE_numEngStart2Stop SSE_stStrtAbortCond1_mp SSE_stStrtAbortCond2_mp SSE_vXMaxSinceStart /end LOC_MEASUREMENT
/end FUNCTION
/begin FUNCTION Cpu "" /end FUNCTION
/begin FUNCTION crctl_governor ""
 /begin DEF_CHARACTERISTIC CrCtl_aConst_CUR CrCtl_aDesResAbo_MAP CrCtl_aDesResBel_MAP CrCtl_aMax_C CrCtl_aMin_C CrCtl_tiDifFil_C CrCtl_tiFilAcc_C CrCtl_tiFilCruise_C CrCtl_tiFilRes_C /end DEF_CHARACTERISTIC
 /begin IN_MEASUREMENT CrCtl_st CrCtl_tiShOff CrCtl_vDes GlbDa_vXFlt VehMot_aPrpCurr VehMot_aPrpMin /end IN_MEASUREMENT
 /begin OUT_MEASUREMENT CrCtl_aReq CrCtl_aReqFil CrCtl_aReqLim CrCtl_aReqRaw_mp CrCtl_aShOffRmp CrCtl_stCrCtlOld CrCtl_stPtd CrCtl_stReq CrCtl_tiDifFil CrCtl_tiFilTmp_mp CrCtl_vDif /end OUT_MEASUREMENT
/end FUNCTION
/begin FUNCTION crctl_shoff ""
 /begin DEF_CHARACTERISTIC CrCtl_AlwdGear_C CrCtl_aMaxShOff_C CrCtl_aMinShOff_C CrCtl_ClrVelDesMsk_C CrCtl_FastShDwn_C CrCtl_IrrevShOff_C CrCtl_MdlShDown_C CrCtl_nMaxDif_C CrCtl_nMin_C CrCtl_ResVCrCTDesMsk_C CrCtl_tiAccMax_C CrCtl_tiAccMin_C CrCtl_tiAccReqMdl_C CrCtl_tiAccReqSlw_C CrCtl_tiFdyActv_C CrCtl_tiMoF_C CrCtl_tiOvrrd_C CrCtl_tiVelMax_C CrCtl_tiVelMin_C CrCtl_uShOff_C CrCtl_vActvMax_C CrCtl_vActvMin_C CrCtl_vCrCtlMax_C CrCtl_vCrCtlMin_C CrCtl_vDifMax_C CrCtl_vDifMin_C CrCtl_vDifOvrrd_C /end DEF_CHARACTERISTIC
 /begin IN_MEASUREMENT CoVMD_swtCCSel CrCtl_st CrCtl_stReq CrCtl_vDes CrCUI_stBttn CrCUI_stErr EngPrt_nMax Epm_nEng ESS_uBatt GlbDa_aXFlt GlbDa_stTrqDem GlbDa_vXFlt MoFDrAs_stCCtlPtdMsg PT_numTraGear PT_stConvGrip PT_stTraShftOp PT_stTraType VehMot_stBrkPed VehMot_stPrpCrCtl /end IN_MEASUREMENT
 /begin OUT_MEASUREMENT CrCtl_stClrVelDes CrCtl_stShOff CrCtl_stShOffCon_mp CrCtl_tiShOff /end OUT_MEASUREMENT
/end FUNCTION
/begin FUNCTION crctl_stm ""
 /begin DEF_CHARACTERISTIC CrCtl_aMinSVA_C CrCtl_aTipDifPrpMax_C CrCtl_aTipDifPrpMin_C CrCtl_facSVANgv_C CrCtl_facSVAPsv_C CrCtl_stStM_C CrCtl_stSVA_C CrCtl_vDesMax_C CrCtl_vDesMin_C CrCtl_vDiffCruiseMax_C CrCtl_vDiffCruiseMin_C CrCtl_vDifSVAMax_C CrCtl_vTipCruMax_C CrCtl_vTipCruMin_C CrCtl_vTipMaxLim_C CrCtl_vTipMax_C CrCtl_vTipMinLim_C CrCtl_vTipMin_C CrCtl_vTip_C /end DEF_CHARACTERISTIC
 /begin IN_MEASUREMENT CrCtl_aReq CrCtl_stClrVelDes CrCtl_stShOff CrCtl_stStTrans CrCUI_stNoBtnActv GlbDa_aXFlt GlbDa_vXFlt VehMot_aPrpMax VehMot_aPrpMin /end IN_MEASUREMENT
 /begin OUT_MEASUREMENT CrCtl_aSVA CrCtl_st CrCtl_stSVAActv CrCtl_stSVANgv CrCtl_stSVAPsv CrCtl_vDes CrCtl_vDesIni CrCtl_vTipMax CrCtl_vTipMaxIni CrCtl_vTipMin CrCtl_vTipMinIni CrCtl_vXLim_mp /end OUT_MEASUREMENT
/end FUNCTION
/begin FUNCTION crctl_sttrans ""
 /begin DEF_CHARACTERISTIC CrCtl_AccH_C CrCtl_AccN_C CrCtl_AccP_C CrCtl_DecH_C CrCtl_DecN_C CrCtl_DecP_C CrCtl_ResP_C CrCtl_SetP_C /end DEF_CHARACTERISTIC
 /begin IN_MEASUREMENT CrCUI_stBttn /end IN_MEASUREMENT
 /begin OUT_MEASUREMENT CrCtl_stStTrans /end OUT_MEASUREMENT
 /begin LOC_MEASUREMENT CrCtl_stBttnold /end LOC_MEASUREMENT
/end FUNCTION
/begin FUNCTION crcui_getui "" /begin IN_MEASUREMENT CrC_stErr CrC_stKey /end IN_MEASUREMENT /begin OUT_MEASUREMENT CrCUI_stBttn CrCUI_stErr CrCUI_stNoBtnActv /end OUT_MEASUREMENT /end FUNCTION
/begin FUNCTION CrntCtl_VDSet "" /end FUNCTION
/begin FUNCTION CSW "" /begin SUB_FUNCTION Byp CalWup Distab Dme Eec Xcp /end SUB_FUNCTION /end FUNCTION
/begin FUNCTION CThmst_dd ""
 /begin DEF_CHARACTERISTIC CThmst_Pwm.tiPer_C CThmst_Pwm.stLvl_C CThmst_Pwm.rMaxDty_C CThmst_Pwm.rPerUn_C CThmst_Pwm.tiPh_C CThmst_PwmOut.rMin_C CThmst_PwmOut.rMax_C CThmst_PwmOut.tiBtwTstSCB_C CThmst_PwmOut.tiBtwTstOT_C CThmst_PwmOut.numTstMax_C CThmst_PwmOut.swtBattCor_C CThmst_PwmOut.swtPsInv_C CThmst_rCnv_CUR CThmst_stPwrStgDiaDis_C CThmst_stPwrStgDis_C /end DEF_CHARACTERISTIC
 /begin IN_MEASUREMENT BattU_facCor CThmst_r DevLib_stPwrStgEnaCond /end IN_MEASUREMENT
 /begin OUT_MEASUREMENT CThmst_rPs /end OUT_MEASUREMENT
 /begin LOC_MEASUREMENT CThmst_rCnv_mp /end LOC_MEASUREMENT
/end FUNCTION
/begin FUNCTION cttctl_demand "" /begin IN_MEASUREMENT ETM_rCtT /end IN_MEASUREMENT /begin OUT_MEASUREMENT CThmst_r /end OUT_MEASUREMENT /end FUNCTION
/begin FUNCTION ctt_mon ""
 /begin DEF_CHARACTERISTIC CtT_dtElWaHt_CA CtT_dtEnv_CUR CtT_dtFlWaHt_C CtT_nThres_C CtT_swtAirMod_CW CtT_swtFdbkMod_CW CtT_tClntLo_C CtT_tClntMod_C CtT_tiTst_C CtT_tThresHi_C CtT_tThresLo_C CtT_vThres_C /end DEF_CHARACTERISTIC
 /begin IN_MEASUREMENT Epm_nEng GlbDa_tEnv GlbDa_tEnvMod GlbDa_vX TSDa_tClntIniVal TS_tClntEngOut WaHtEl_st WaHtFl_st /end IN_MEASUREMENT
 /begin OUT_MEASUREMENT CtT_tClntEngMod /end OUT_MEASUREMENT
 /begin LOC_MEASUREMENT CtT_DSMReturn_mp CtT_dtDec_mp CtT_dtGradient_mp CtT_dtIncrEng_mp CtT_dtIncrWaHt_mp CtT_dtInc_mp CtT_stAbrtDiag CtT_stClntToLow_mp CtT_stDSMBlocked_mp CtT_stDSMFlt_mp CtT_stDSMRet CtT_stHealCond CtT_stInitClntToHigh_mp CtT_stModCalcEna_mp CtT_stTimeOut_mp CtT_tClntEngMod_Int CtT_tClntIncr_mp CtT_tDiffRadiator /end LOC_MEASUREMENT
/end FUNCTION
/begin FUNCTION ctt_mon_inl "" /begin DEF_CHARACTERISTIC CtT_dtPwrIncr_CUR CtT_tiPT1_C /end DEF_CHARACTERISTIC /begin IN_MEASUREMENT PhyMod_pwrClntEntry /end IN_MEASUREMENT /begin LOC_MEASUREMENT CtT_bResetModell_ER CtT_pwrIncrEngPT1 /end LOC_MEASUREMENT /end FUNCTION
/begin COMPU_METHOD Acc "" RAT_FUNC "%6.5" "m/s^2" COEFFS 0 1000 0 0 0 1 /end COMPU_METHOD
/begin COMPU_METHOD AngleCrS "" RAT_FUNC "%6.4" "deg CrS" COEFFS 0 45.5097222222222 0 0 0 1 /end COMPU_METHOD
/begin COMPU_METHOD CoEOMSwt_S16 "" RAT_FUNC "%7.6" "-" COEFFS 0 16384 0 0 0 1 /end COMPU_METHOD
/begin COMPU_METHOD COEOM_PCRCTLAUTLPTRQNUMMAP_SY_Compu "" TAB_NOINTP "%6.3" "-" COMPU_TAB_REF COEOM_PCRCTLAUTLPTRQNUMMAP_SY_Compu /end COMPU_METHOD
/begin COMPU_TAB COEOM_PCRCTLAUTLPTRQNUMMAP_SY_Compu "" TAB_NOINTP 8 0 0 1 1 2 2 3 3 4 4 5 5 6 6 7 7 /end COMPU_TAB
/begin COMPU_METHOD COEOM_PCRCTLLPQNTNUMMAP_SY_Compu "" TAB_NOINTP "%6.3" "-" COMPU_TAB_REF COEOM_PCRCTLLPQNTNUMMAP_SY_Compu /end COMPU_METHOD
/begin COMPU_TAB COEOM_PCRCTLLPQNTNUMMAP_SY_Compu "" TAB_NOINTP 8 0 0 1 1 2 2 3 3 4 4 5 5 6 6 7 7 /end COMPU_TAB
/begin COMPU_METHOD COEOM_PCRCTLLPTRQNUMMAP_SY_Compu "" TAB_NOINTP "%6.3" "-" COMPU_TAB_REF COEOM_PCRCTLLPTRQNUMMAP_SY_Compu /end COMPU_METHOD
/begin COMPU_TAB COEOM_PCRCTLLPTRQNUMMAP_SY_Compu "" TAB_NOINTP 8 0 0 1 1 2 2 3 3 4 4 5 5 6 6 7 7 /end COMPU_TAB
/begin COMPU_METHOD COEOM_PCRQNTNUMMAP_SY_Compu "" TAB_NOINTP "%6.3" "-" COMPU_TAB_REF COEOM_PCRQNTNUMMAP_SY_Compu /end COMPU_METHOD
/begin COMPU_TAB COEOM_PCRQNTNUMMAP_SY_Compu "" TAB_NOINTP 8 0 0 1 1 2 2 3 3 4 4 5 5 6 6 7 7 /end COMPU_TAB
/begin COMPU_METHOD COEOM_PCRTRQNUMMAP_SY_Compu "" TAB_NOINTP "%6.3" "-" COMPU_TAB_REF COEOM_PCRTRQNUMMAP_SY_Compu /end COMPU_METHOD
/begin COMPU_TAB COEOM_PCRTRQNUMMAP_SY_Compu "" TAB_NOINTP 8 0 0 1 1 2 2 3 3 4 4 5 5 6 6 7 7 /end COMPU_TAB
/begin COMPU_METHOD COEOM_TYP_SY_Compu "" TAB_VERB "%6.3" "-" COMPU_TAB_REF COEOM_TYP_SY_Compu /end COMPU_METHOD
/begin COMPU_VTAB COEOM_TYP_SY_Compu "" TAB_VERB 2 1 "HESRV_SNGLFLW" 2 "HESRV_TWFLW" /end COMPU_VTAB
/begin COMPU_METHOD COEOM_VSWCTLQNTNUMMAP_SY_Compu "" TAB_NOINTP "%6.3" "-" COMPU_TAB_REF COEOM_VSWCTLQNTNUMMAP_SY_Compu /end COMPU_METHOD
/begin COMPU_TAB COEOM_VSWCTLQNTNUMMAP_SY_Compu "" TAB_NOINTP 8 0 0 1 1 2 2 3 3 4 4 5 5 6 6 7 7 /end COMPU_TAB
/begin COMPU_METHOD COEOM_VSWCTLTRQNUMMAP_SY_Compu "" TAB_NOINTP "%6.3" "-" COMPU_TAB_REF COEOM_VSWCTLTRQNUMMAP_SY_Compu /end COMPU_METHOD
/begin COMPU_TAB COEOM_VSWCTLTRQNUMMAP_SY_Compu "" TAB_NOINTP 8 0 0 1 1 2 2 3 3 4 4 5 5 6 6 7 7 /end COMPU_TAB
/begin COMPU_METHOD CppFacCylVol "" RAT_FUNC "%7.6" "-" COEFFS 0 32768 0 0 0 1 /end COMPU_METHOD
/begin COMPU_METHOD DtyCyc "" RAT_FUNC "%6.4" "%" COEFFS 0 100 0 0 0 1 /end COMPU_METHOD
/begin COMPU_METHOD EngN "" RAT_FUNC "%6.3" "rpm" COEFFS 0 2 0 0 0 1 /end COMPU_METHOD
/begin COMPU_METHOD EngN1 "" RAT_FUNC "%6.3" "rpm" COEFFS 0 2 0 0 0 1 /end COMPU_METHOD
/begin COMPU_METHOD EngTempFldSel "" TAB_VERB "%6.3" "-" COMPU_TAB_REF EngTempFldSel /end COMPU_METHOD
/begin COMPU_VTAB EngTempFldSel "" TAB_VERB 3 0 "Coolant_Temperature" 1 "Oil_Temperature" 2 "EngDa_tEng" /end COMPU_VTAB
/begin COMPU_METHOD Eta3 "" RAT_FUNC "%6.4" "Nm/(mg/hub)" COEFFS 0 128 0 0 0 1 /end COMPU_METHOD
/begin COMPU_METHOD Fact "" RAT_FUNC "%6.5" "-" COEFFS 0 8192 0 0 0 1 /end COMPU_METHOD
/begin COMPU_METHOD Fact1 "" RAT_FUNC "%6.4" "-" COEFFS 0 128 0 0 0 1 /end COMPU_METHOD
/begin COMPU_METHOD InjMass "" RAT_FUNC "%6.4" "mg/hub" COEFFS 0 100 0 0 0 1 /end COMPU_METHOD
/begin COMPU_METHOD Kd "" RAT_FUNC "%7.6" "1/1" COEFFS 0 65536 0 0 0 1 /end COMPU_METHOD
/begin COMPU_METHOD OneToOne "" RAT_FUNC "%6.2" "-" COEFFS 0 1 0 0 0 1 /end COMPU_METHOD
/begin COMPU_METHOD Period "" RAT_FUNC "%6.3" "ms" COEFFS 0 10 0 0 0 1 /end COMPU_METHOD
/begin COMPU_METHOD Prc "" RAT_FUNC "%6.4" "%" COEFFS 0 81.92 0 0 0 1 /end COMPU_METHOD
/begin COMPU_METHOD PrcPerSec "" RAT_FUNC "%6.3" "%/s" COEFFS 0 1.6384 0 0 0 1 /end COMPU_METHOD
/begin COMPU_METHOD PreshPa_10ms "" RAT_FUNC "%6.0" "hPa/s" COEFFS 0 0.01 0 0 0 1 /end COMPU_METHOD
/begin COMPU_METHOD PreshPa_sec "" RAT_FUNC "%6.2" "hPa/s" COEFFS 0 1 0 0 0 1 /end COMPU_METHOD
/begin COMPU_METHOD Pres_hPa "" RAT_FUNC "%6.2" "hPa" COEFFS 0 1 0 0 0 1 /end COMPU_METHOD
/begin COMPU_METHOD Pwr2 "" RAT_FUNC "%6.1" "W" COEFFS 0 0.0530516476972949 0 0 0 1 /end COMPU_METHOD
/begin COMPU_METHOD RmpPres_hPa "" RAT_FUNC "%6.4" "hPa/s" COEFFS 0 65.536 0 0 0 1 /end COMPU_METHOD
/begin COMPU_METHOD RmpTemp "" RAT_FUNC "%6.4" "K/s" COEFFS 0 655.36 0 0 0 1 /end COMPU_METHOD
/begin COMPU_METHOD RmpTrq "" RAT_FUNC "%6.4" "Nm/s" COEFFS 0 655.36 0 0 0 1 /end COMPU_METHOD
/begin COMPU_METHOD TempCels_100ms "" RAT_FUNC "%6.2" "deg C/s" COEFFS 0 1 0 0 0 1 /end COMPU_METHOD
/begin COMPU_METHOD TempDiff_Kelv "" RAT_FUNC "%6.3" "K" COEFFS 0 10 0 0 0 1 /end COMPU_METHOD
/begin COMPU_METHOD Temp_Cels "" RAT_FUNC "%6.1" "deg C" COEFFS 0 10 2731.4 0 0 1 /end COMPU_METHOD
/begin COMPU_METHOD Temp_Kelv_Sec_CtT_Mon "" RAT_FUNC "%7.6" "deg C/s" COEFFS 0 40960 0 0 0 1 /end COMPU_METHOD
/begin COMPU_METHOD TimeCoEOMRmp "" RAT_FUNC "%6.3" "s" COEFFS 0 0 1 0 0.0152587890625 0 /end COMPU_METHOD
/begin COMPU_METHOD TimeDeb "" RAT_FUNC "%6.1" "ms" COEFFS 0 0.1 0 0 0 1 /end COMPU_METHOD
/begin COMPU_METHOD TimeDelay_s "" RAT_FUNC "%12.4" "s" COEFFS 0 0 1 0 0.00023283064365387 0 /end COMPU_METHOD
/begin COMPU_METHOD TimeDT "" RAT_FUNC "%6.2" "us" COEFFS 0 1 0 0 0 1 /end COMPU_METHOD
/begin COMPU_METHOD TimeRed "" RAT_FUNC "%6.3" "s" COEFFS 0 6.25 0 0 0 1 /end COMPU_METHOD
/begin COMPU_METHOD Time_DynTst "" RAT_FUNC "%6.2" "s" COEFFS 0 0.390625 0 0 0 1 /end COMPU_METHOD
/begin COMPU_METHOD Time_ms "" RAT_FUNC "%6.1" "ms" COEFFS 0 0.1 0 0 0 1 /end COMPU_METHOD
/begin COMPU_METHOD Time_s "" RAT_FUNC "%6.4" "s" COEFFS 0 100 0 0 0 1 /end COMPU_METHOD
/begin COMPU_METHOD TransR "" RAT_FUNC "%6.4" "-" COEFFS 0 100 0 0 0 1 /end COMPU_METHOD
/begin COMPU_METHOD Trq "" RAT_FUNC "%6.3" "Nm" COEFFS 0 10 0 0 0 1 /end COMPU_METHOD
/begin COMPU_METHOD TrqPrp "" RAT_FUNC "%6.2" "Nm" COEFFS 0 0.625 0 0 0 1 /end COMPU_METHOD
/begin COMPU_METHOD TrqPrpHigh "" RAT_FUNC "%6.3" "Nm" COEFFS 0 10 0 0 0 1 /end COMPU_METHOD
/begin COMPU_METHOD TrqToNSqr "" RAT_FUNC "%10.9" "-" COEFFS 0 10000000 0 0 0 1 /end COMPU_METHOD
/begin COMPU_METHOD Vel "" RAT_FUNC "%6.4" "km/h" COEFFS 0 100 0 0 0 1 /end COMPU_METHOD
/begin COMPU_METHOD Volt "" RAT_FUNC "%6.3" "mV" COEFFS 0 5 0 0 0 1 /end COMPU_METHOD
/begin COMPU_METHOD Volt_Batt "" RAT_FUNC "%6.1" "mV" COEFFS 0 0.05 0 0 0 1 /end COMPU_METHOD
/begin COMPU_METHOD default "" RAT_FUNC "%6.2" "-" COEFFS 0 1 0 0 0 1 /end COMPU_METHOD
/begin RECORD_LAYOUT Cur_Xs16Ws16 NO_AXIS_PTS_X 1 SWORD AXIS_PTS_X 2 SWORD INDEX_INCR DIRECT FNC_VALUES 3 SWORD COLUMN_DIR DIRECT /end RECORD_LAYOUT
/begin RECORD_LAYOUT Gkl_Ws16 FNC_VALUES 1 SWORD COLUMN_DIR DIRECT /end RECORD_LAYOUT
/begin RECORD_LAYOUT GSst_Xs16 NO_AXIS_PTS_X 1 SWORD AXIS_PTS_X 2 SWORD INDEX_INCR DIRECT /end RECORD_LAYOUT
/begin RECORD_LAYOUT Kf_Xs16_Ys16_Ws16 NO_AXIS_PTS_X 1 SWORD NO_AXIS_PTS_Y 2 SWORD AXIS_PTS_X 3 SWORD INDEX_INCR DIRECT AXIS_PTS_Y 4 SWORD INDEX_INCR DIRECT FNC_VALUES 5 SWORD COLUMN_DIR DIRECT /end RECORD_LAYOUT
/begin RECORD_LAYOUT Kl_Xs16_Ws16 NO_AXIS_PTS_X 1 SWORD AXIS_PTS_X 2 SWORD INDEX_INCR DIRECT FNC_VALUES 3 SWORD COLUMN_DIR DIRECT /end RECORD_LAYOUT
/begin RECORD_LAYOUT Kw_Ws16 FNC_VALUES 1 SWORD COLUMN_DIR DIRECT /end RECORD_LAYOUT
/begin RECORD_LAYOUT Kw_Ws32 FNC_VALUES 1 SLONG COLUMN_DIR DIRECT /end RECORD_LAYOUT
/begin RECORD_LAYOUT Kw_Wu16 FNC_VALUES 1 UWORD COLUMN_DIR DIRECT /end RECORD_LAYOUT
/begin RECORD_LAYOUT Kw_Wu32 FNC_VALUES 1 ULONG COLUMN_DIR DIRECT /end RECORD_LAYOUT
/begin RECORD_LAYOUT Kw_Wu8 FNC_VALUES 1 UBYTE COLUMN_DIR DIRECT /end RECORD_LAYOUT
/begin RECORD_LAYOUT Map_Xs16Ys16Ws16 NO_AXIS_PTS_X 1 SWORD NO_AXIS_PTS_Y 2 SWORD AXIS_PTS_X 3 SWORD INDEX_INCR DIRECT AXIS_PTS_Y 4 SWORD INDEX_INCR DIRECT FNC_VALUES 5 SWORD COLUMN_DIR DIRECT /end RECORD_LAYOUT
/begin RECORD_LAYOUT ValA_Ws16 FNC_VALUES 1 SWORD COLUMN_DIR DIRECT /end RECORD_LAYOUT
/begin RECORD_LAYOUT ValA_Wu8 FNC_VALUES 1 UBYTE COLUMN_DIR DIRECT /end RECORD_LAYOUT
/begin RECORD_LAYOUT Val_Ws16 FNC_VALUES 1 SWORD COLUMN_DIR DIRECT /end RECORD_LAYOUT
/begin RECORD_LAYOUT Val_Ws32 FNC_VALUES 1 SLONG COLUMN_DIR DIRECT /end RECORD_LAYOUT
/begin RECORD_LAYOUT Val_Ws8 FNC_VALUES 1 SBYTE COLUMN_DIR DIRECT /end RECORD_LAYOUT
/begin RECORD_LAYOUT Val_Wu16 FNC_VALUES 1 UWORD COLUMN_DIR DIRECT /end RECORD_LAYOUT
/begin RECORD_LAYOUT Val_Wu32 FNC_VALUES 1 ULONG COLUMN_DIR DIRECT /end RECORD_LAYOUT
/begin RECORD_LAYOUT Val_Wu8 FNC_VALUES 1 UBYTE COLUMN_DIR DIRECT /end RECORD_LAYOUT
/end MODULE
/end PROJECT
