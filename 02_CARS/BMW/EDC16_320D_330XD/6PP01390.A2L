ASAP2_VERSION 1 3
/begin PROJECT P390 "BMW DDE6.2 6-Zylinder VP0.1 11.11.2003 CAN12H"
/begin HEADER "" VERSION "VP01_6Z_CAN12H" PROJECT_NO P390 /end HEADER
/begin MODULE DIM ""
/begin MOD_COMMON "" BYTE_ORDER MSB_FIRST ALIGNMENT_BYTE 1 ALIGNMENT_WORD 2 ALIGNMENT_LONG 4 ALIGNMENT_FLOAT32_IEEE 4 /end MOD_COMMON
/begin CHARACTERISTIC PFlt_t1DT1Pres_C "Totzeit für Druckdifferenz DT1 filter" VALUE 0xE80E4 Kw_Wu32 4294.9673 TimeDelay_s 0.0000010000000 4294.9673 FORMAT "%9.4" /end CHARACTERISTIC
/begin CHARACTERISTIC PFlt_kdDT1Pres_C "kd für Druckdifferenz DT1 Filter" VALUE 0xE80E8 Kw_Ws32 32767.9999847 Kd 0.00 32767.9999847 FORMAT "%13.7" EXTENDED_LIMITS -32768.0000000 32767.9999847 /end CHARACTERISTIC
/begin CHARACTERISTIC PFlt_t1DT1Sim_C "Totzeit für q_inj DT1 Filter" VALUE 0xE80EC Kw_Wu32 4294.9673 TimeDelay_s 0.0000010000000 4294.9673 FORMAT "%9.4" /end CHARACTERISTIC
/begin CHARACTERISTIC PFlt_kdDT1Sim_C "kd für q_inj DT1 Filter" VALUE 0xE80F0 Kw_Ws32 32767.9999847 Kd 0.00 32767.9999847 FORMAT "%13.7" EXTENDED_LIMITS -32768.0000000 32767.9999847 /end CHARACTERISTIC
/begin CHARACTERISTIC PFlt_cpExhGs_C "Spezifische Wärmekapazität des Abgases" VALUE 0xE8CA4 Kw_Wu16 2000.000 Thr_Cpty_ExhGs 0.00 2000.000 FORMAT "%8.3" EXTENDED_LIMITS 0.00 655350.0 /end CHARACTERISTIC
/begin CHARACTERISTIC PFlt_CPFlt_C "Wärmekapazität des Partikelfilters" VALUE 0xE8CA6 Kw_Wu16 32900.00 Thr_Cpty 100.0000 33000.00 FORMAT "%8.2" EXTENDED_LIMITS 0.00 65535.00 /end CHARACTERISTIC
/begin CHARACTERISTIC PFlt_ctEngPrtRgn_C "Threshold for engine protection regeneration count" VALUE 0xE8B44 Kw_Wu16 65535.00 OneToOne 0.00 65535.00 FORMAT "%8.2" /end CHARACTERISTIC
/begin CHARACTERISTIC PFlt_ddvolHsLnPlausNeg_C "Negativer Schwellwert Volumenstromänderung zur Dynamikplausibilisierung" VALUE 0xE8B46 Kw_Ws16 1500.000 CubMtrPerHrPerSec -1500.000 0.00 FORMAT "%8.3" EXTENDED_LIMITS -3276.800 3276.700 /end CHARACTERISTIC
/begin CHARACTERISTIC PFlt_ddvolHsLnPlausPos_C "Positiver Schwellwert Volumenstromänderung zur Dynamikplausibilisierung" VALUE 0xE8B48 Kw_Ws16 1500.000 CubMtrPerHrPerSec 0.00 1500.000 FORMAT "%8.3" EXTENDED_LIMITS -3276.800 3276.700 /end CHARACTERISTIC
/begin CHARACTERISTIC PFlt_ddvolHsLnSot_C "Schwellwert Volumenstromänderung zur Schlauchleitungsüberwachung" VALUE 0xE8B4A Kw_Ws16 3000.000 CubMtrPerHrPerSec -1500.000 1500.000 FORMAT "%8.3" EXTENDED_LIMITS -3276.800 3276.700 /end CHARACTERISTIC
/begin CHARACTERISTIC PFlt_dmNOxEngBas_MAP "Emissionskennfeld NOx-Massenstrom" MAP 0xE80F4 Kf_Xs16_Ys16_Ws16 100.0000 dmSoot_mg_p_s 0.00 100.0000 FORMAT "%8.4" EXTENDED_LIMITS -327.6800 327.6700
 /begin AXIS_DESCR STD_AXIS Eng_nAvrg EngN 8 40.00000 6000.000 FORMAT "%8.3" EXTENDED_LIMITS -32768.00 32767.00 DEPOSIT ABSOLUTE /end AXIS_DESCR
 /begin AXIS_DESCR STD_AXIS InjCtl_qSetUnBal InjMassCyc 8 0.00 327.6700 FORMAT "%8.4" EXTENDED_LIMITS -327.6800 327.6700 DEPOSIT ABSOLUTE /end AXIS_DESCR
/end CHARACTERISTIC
/begin CHARACTERISTIC PFlt_dmSotSimBas_MAP "statische Partikelemission f(q,n)" MAP 0xE8198 Kf_Xs16_Ys16_Ws16 100.0000 dmSoot_mg_p_s 0.00 100.0000 FORMAT "%8.4" EXTENDED_LIMITS -327.6800 327.6700
 /begin AXIS_DESCR STD_AXIS Eng_nAvrg EngN 9 40.00000 6000.000 FORMAT "%8.3" EXTENDED_LIMITS -32768.00 32767.00 DEPOSIT ABSOLUTE /end AXIS_DESCR
 /begin AXIS_DESCR STD_AXIS InjCtl_qSetUnBal InjMassCyc 8 0.00 327.6700 FORMAT "%8.4" EXTENDED_LIMITS -327.6800 327.6700 DEPOSIT ABSOLUTE /end AXIS_DESCR
/end CHARACTERISTIC
/begin CHARACTERISTIC PFlt_dmSotSimDyn_CUR "dynamischer Anteil der Partikelemission = f(dq/dt)" CURVE 0xE824E Kl_Xs16_Ws16 100.0000 dmSoot_mg_p_s 0.00 100.0000 FORMAT "%8.4" EXTENDED_LIMITS -327.6800 327.6700
 /begin AXIS_DESCR STD_AXIS PFlt_dqSetUnBal_mp InjMass 8 -327.6800 327.6700 FORMAT "%8.4" DEPOSIT ABSOLUTE /end AXIS_DESCR
/end CHARACTERISTIC
/begin CHARACTERISTIC PFlt_dmSotSimEGRoff_MAP "Emissionsgrundkennfeld Partikelmassenstrom stationär bei abgeschalteter Abgasrückführung" MAP 0xE8270 Kf_Xs16_Ys16_Ws16 100.0000 dmSoot_mg_p_s 0.00 100.0000 FORMAT "%8.4" EXTENDED_LIMITS -327.6800 327.6700
 /begin AXIS_DESCR STD_AXIS Eng_nAvrg EngN 8 40.00000 6000.000 FORMAT "%8.3" EXTENDED_LIMITS -32768.00 32767.00 DEPOSIT ABSOLUTE /end AXIS_DESCR
 /begin AXIS_DESCR STD_AXIS InjCtl_qSetUnBal InjMassCyc 8 0.00 327.6700 FORMAT "%8.4" EXTENDED_LIMITS -327.6800 327.6700 DEPOSIT ABSOLUTE /end AXIS_DESCR
/end CHARACTERISTIC
/begin CHARACTERISTIC PFlt_dmSotSimRgnBas_CUR "Basiswert für regenerierte Partikelmasse = f(m_Soot)" CURVE 0xE8314 Kl_Xs16_Ws16 100.0000 dmSoot_mg_p_s 0.00 100.0000 FORMAT "%8.4" EXTENDED_LIMITS -327.6800 327.6700
 /begin AXIS_DESCR STD_AXIS PFlt_mSotSim mSoot_g 8 0.00 300.0000 FORMAT "%8.4" EXTENDED_LIMITS -327.6800 327.6700 DEPOSIT ABSOLUTE /end AXIS_DESCR
/end CHARACTERISTIC
/begin CHARACTERISTIC PFlt_dpDiffMax_C "Schwelle für Druckdifferenzänderung über der auf Simulation geschaltet wird" VALUE 0xE8336 Kw_Ws16 65535.00 Pres_hPa -32768.00 32767.00 FORMAT "%8.2" /end CHARACTERISTIC
/begin CHARACTERISTIC PFlt_dvolCharMonMin_C "Mindestvolumenstrom für Überwachung des Strömungswiderstandes" VALUE 0xE8B4C Kw_Ws16 100.0000 CubMtrPerHr 0.00 100.0000 FORMAT "%8.4" EXTENDED_LIMITS -3276.800 3276.700 /end CHARACTERISTIC
/begin CHARACTERISTIC PFlt_dvolMeasMin_C "Schwelle für Abgasstrom unter der auf Simulation geschaltet wird" VALUE 0xE8338 Kw_Ws16 3000.000 CubMtrPerHr 0.00 3000.000 FORMAT "%8.3" EXTENDED_LIMITS -3276.800 3276.700 /end CHARACTERISTIC
/begin CHARACTERISTIC PFlt_dvol_Vector "#SSD Konfigurationslabel für Bypass" VALUE 0xC2E0A Kw_Wu8 255.0 OneToOne 0.00 255.0 FORMAT "%5.1" /end CHARACTERISTIC
/begin CHARACTERISTIC PFlt_dvol_Channel "#SSD Konfigurationslabels für Bypass" VALUE 0xC2E0B Kw_Wu8 255.0 OneToOne 0.00 255.0 FORMAT "%5.1" /end CHARACTERISTIC
/begin CHARACTERISTIC PFlt_facBlwBy_C "Thermischer Austauschfaktor für Abgas im Filter" VALUE 0xE8CA8 Kw_Ws16 1.000000 Fact 0.00 1.000000 FORMAT "%8.6" EXTENDED_LIMITS -4.000000 3.999878 /end CHARACTERISTIC
/begin CHARACTERISTIC PFlt_facCnvCat_CUR "Faktor Temperaturabhängigkeit der Konvertierung von NO zu NO2 des Oxidationskatalysators" CURVE 0xE833A Kl_Xs16_Ws16 1.000000 Fact 0.00 1.000000 FORMAT "%8.6" EXTENDED_LIMITS -4.000000 3.999878
 /begin AXIS_DESCR STD_AXIS PFlt_tOxiPre Temp_Cels 8 -50.1400 899.8600 FORMAT "%8.4" EXTENDED_LIMITS -3549.940 3003.560 DEPOSIT ABSOLUTE /end AXIS_DESCR
/end CHARACTERISTIC
/begin CHARACTERISTIC PFlt_facDpn_MAP "Kennfeld für Bestimmung der Wärmeverlustfaktor nach Abgastemperatursensor" MAP 0xE8CAA Kf_Xs16_Ys16_Ws16 1.000000 Fact 0.00 1.000000 FORMAT "%8.6" EXTENDED_LIMITS -4.000000 3.999878
 /begin AXIS_DESCR STD_AXIS IATSCD_tAir Temp_Cels 8 -50.14000 199.8600 FORMAT "%8.4" EXTENDED_LIMITS -3549.940 3003.560 DEPOSIT ABSOLUTE /end AXIS_DESCR
 /begin AXIS_DESCR STD_AXIS VSSCD_v Vel 8 0.00 300.0000 FORMAT "%8.4" EXTENDED_LIMITS -327.6800 327.6700 DEPOSIT ABSOLUTE /end AXIS_DESCR
/end CHARACTERISTIC
/begin CHARACTERISTIC PFlt_facDynVisc_CUR "Kennlinie zur Berücksichtigung der dynamischen Viskosität" CURVE 0xE835C Kl_Xs16_Ws16 1.000000 Fact 0.00 1.000000 FORMAT "%8.6" EXTENDED_LIMITS -4.000000 3.999878
 /begin AXIS_DESCR STD_AXIS PFlt_tSurf Temp_Cels 8 -50.1400 899.8600 FORMAT "%8.4" EXTENDED_LIMITS -3549.940 3003.560 DEPOSIT ABSOLUTE /end AXIS_DESCR
/end CHARACTERISTIC
/begin CHARACTERISTIC PFlt_facEGR_CUR "Influence of temperature on regenerated AirCtl correction mass" CURVE 0xE837E Kl_Xs16_Ws16 1.000000 Fact 0.00 1.000000 FORMAT "%8.6" EXTENDED_LIMITS -4.000000 3.999878
 /begin AXIS_DESCR STD_AXIS PFlt_facDesCor_mp Fact 8 0.00 10.00000 FORMAT "%8.5" EXTENDED_LIMITS -4.000000 3.999878 DEPOSIT ABSOLUTE /end AXIS_DESCR
/end CHARACTERISTIC
/begin CHARACTERISTIC PFlt_facHtTransNoLin_CUR "Nichtlinearitätsfaktor in der Wärmeübertragung im Filter" CURVE 0xE8D4E Kl_Xs16_Ws16 1.000000 Fact 0.00 1.000000 FORMAT "%8.6" EXTENDED_LIMITS -4.000000 3.999878
 /begin AXIS_DESCR STD_AXIS PFlt_tDiffCorr_mp TempDiff_Cels 8 500.0000 1000.000 FORMAT "%8.3" EXTENDED_LIMITS -3276.800 3276.700 DEPOSIT ABSOLUTE /end AXIS_DESCR
/end CHARACTERISTIC
/begin CHARACTERISTIC PFlt_facMflO2SimRgn_CUR "Kennlinie für den Einfluß des Oxygenmassenstromes auf Regeneration" CURVE 0xE83A0 Kl_Xs16_Ws16 1.000000 Fact 0.00 1.000000 FORMAT "%8.6" EXTENDED_LIMITS -4.000000 3.999878
 /begin AXIS_DESCR STD_AXIS PFlt_dmO2Aprx AirMassPerTime 8 0.00 3276.700 FORMAT "%8.3" EXTENDED_LIMITS -3276.800 3276.700 DEPOSIT ABSOLUTE /end AXIS_DESCR
/end CHARACTERISTIC
/begin CHARACTERISTIC PFlt_facMltCor_CUR "Kennlinie zur Berücksichtigung der Additivaschenkorrektur" CURVE 0xE83C2 Kl_Xs16_Ws16 1.000000 Fact 0.00 1.000000 FORMAT "%8.6" EXTENDED_LIMITS -4.000000 3.999878
 /begin AXIS_DESCR STD_AXIS PFlt_mAsh_mp mSoot_g 8 0.00 300.0000 FORMAT "%8.4" EXTENDED_LIMITS -327.6800 327.6700 DEPOSIT ABSOLUTE /end AXIS_DESCR
/end CHARACTERISTIC
/begin CHARACTERISTIC PFlt_facNO2dVol_CUR "Influence of temperature to regenerated PFlt_dVol" CURVE 0xE83E4 Kl_Xs16_Ws16 1.000000 Fact 0.00 1.000000 FORMAT "%8.6" EXTENDED_LIMITS -4.000000 3.999878
 /begin AXIS_DESCR STD_AXIS PFlt_dvol CubMtrPerHr 8 0.00 3000.000 FORMAT "%8.3" EXTENDED_LIMITS -3276.800 3276.700 DEPOSIT ABSOLUTE /end AXIS_DESCR
/end CHARACTERISTIC
/begin CHARACTERISTIC PFlt_facNO2Sot_C "stöchiometrisches NO2/Ruß-Verhältnis" VALUE 0xE8406 Kw_Ws16 20.00000 Fact1 0.00 20.00000 FORMAT "%8.5" EXTENDED_LIMITS -256.0000 255.9922 /end CHARACTERISTIC
/begin CHARACTERISTIC PFlt_facSotSimRgnCRT_CUR "Faktor für Beladungsabhängigkeit CRT-Effekt" CURVE 0xE8408 Kl_Xs16_Ws16 1.000000 Fact 0.00 1.000000 FORMAT "%8.6" EXTENDED_LIMITS -4.000000 3.999878
 /begin AXIS_DESCR STD_AXIS PFlt_mSotSim mSoot_g 8 0.00 300.0000 FORMAT "%8.4" EXTENDED_LIMITS -327.6800 327.6700 DEPOSIT ABSOLUTE /end AXIS_DESCR
/end CHARACTERISTIC
/begin CHARACTERISTIC PFlt_facTempCRT_CUR "Faktor für Temperaturabhängigkeit CRT-Effekt" CURVE 0xE842A Kl_Xs16_Ws16 1.000000 Fact 0.00 1.000000 FORMAT "%8.6" EXTENDED_LIMITS -4.000000 3.999878
 /begin AXIS_DESCR STD_AXIS PFlt_tSurf Temp_Cels 8 -50.1400 899.8600 FORMAT "%8.4" EXTENDED_LIMITS -3549.940 3003.560 DEPOSIT ABSOLUTE /end AXIS_DESCR
/end CHARACTERISTIC
/begin CHARACTERISTIC PFlt_facTempSimRgn_CUR "Einfluß der Temperatur auf regenerierte Partikelmasse" CURVE 0xE844C Kl_Xs16_Ws16 1.000000 Fact 0.00 1.000000 FORMAT "%8.6" EXTENDED_LIMITS -4.000000 3.999878
 /begin AXIS_DESCR STD_AXIS PFlt_tSurf Temp_Cels 8 -50.140 899.860 FORMAT "%8.3" EXTENDED_LIMITS -3549.940 3003.560 DEPOSIT ABSOLUTE /end AXIS_DESCR
/end CHARACTERISTIC
/begin CHARACTERISTIC PFlt_KdDT1TempCor_C "Sprunghöhe des DT1-Filters der Wärmeübergangssim. im Filter" VALUE 0xE8D70 Kw_Ws32 100.000000000 Kd -50.0000000000 50.0000000000 FORMAT "%13.10" EXTENDED_LIMITS -32768.0000000 32767.9999847 /end CHARACTERISTIC
/begin CHARACTERISTIC PFlt_kiITempMod_C "Verstärkungsfaktor Integrator Temperaturmodell" VALUE 0xE8D74 Kw_Ws32 999999.999767 Ki -500000.000000 499999.999767 FORMAT "%13.6" /end CHARACTERISTIC
/begin CHARACTERISTIC PFlt_mAshAdi_CUR "Kennlinie zur Umrechnung des Additivvolumens in Additivaschenmasse" CURVE 0xE846E Kl_Xs16_Ws16 300.0000 mSoot_g 0.00 300.0000 FORMAT "%8.4" EXTENDED_LIMITS -327.6800 327.6700
 /begin AXIS_DESCR STD_AXIS PFlt_volAddTot_mp volAdd_ml2 6 0.00 3277.000 FORMAT "%8.3" EXTENDED_LIMITS -32768.00 32767.00 DEPOSIT ABSOLUTE /end AXIS_DESCR
/end CHARACTERISTIC
/begin CHARACTERISTIC PFlt_mAshOil_CUR "Kennlinie zur Umrechnung des verbrauchten Kraftstoffes in Ölaschenmasse" CURVE 0xE8488 Kl_Xs16_Ws16 300.0000 mSoot_g 0.00 300.0000 FORMAT "%8.4" EXTENDED_LIMITS -327.6800 327.6700
 /begin AXIS_DESCR STD_AXIS PFlt_qFlTot Fl_2 6 0.00 330.0000 FORMAT "%8.4" EXTENDED_LIMITS -327680.0 327670.0 DEPOSIT ABSOLUTE /end AXIS_DESCR
/end CHARACTERISTIC
/begin CHARACTERISTIC PFlt_mSotAdjMax_C "Maximum value of the particle mass which can be set via diagnosis" VALUE 0xE84A2 Kw_Ws16 300.0000 mSoot_g 0.00 300.0000 FORMAT "%8.4" EXTENDED_LIMITS -327.6800 327.6700 /end CHARACTERISTIC
/begin CHARACTERISTIC PFlt_mSotDiff_C "Threshold value for difference between simulated and measured value of soot mass" VALUE 0xE8B4E Kw_Ws16 300.0000 mSoot_g 0.00 300.0000 FORMAT "%8.4" EXTENDED_LIMITS -327.6800 327.6700 /end CHARACTERISTIC
/begin CHARACTERISTIC PFlt_mSotMeas_MAP "Umrechnung Strömungswiderstand Partikelmasse" MAP 0xE84A4 Kf_Xs16_Ys16_Ws16 300.0000 mSoot_g 0.00 300.0000 FORMAT "%8.4" EXTENDED_LIMITS -327.6800 327.6700
 /begin AXIS_DESCR STD_AXIS PFlt_resFlowFlt Res_hPaHrPerCM 16 0.00 25.00000 FORMAT "%8.5" EXTENDED_LIMITS -32.76800 32.76700 DEPOSIT ABSOLUTE /end AXIS_DESCR
 /begin AXIS_DESCR STD_AXIS PFlt_dvolMassFlt_mp CubMtrPerHr 16 0.00 3000.000 FORMAT "%8.3" EXTENDED_LIMITS -3276.800 3276.700 DEPOSIT ABSOLUTE /end AXIS_DESCR
/end CHARACTERISTIC
/begin CHARACTERISTIC PFlt_mSotSimMax_C "Maximum value for a simulated particle mass" VALUE 0xE86E8 Kw_Ws16 300.0000 mSoot_g 0.00 300.0000 FORMAT "%8.4" EXTENDED_LIMITS -327.6800 327.6700 /end CHARACTERISTIC
/begin CHARACTERISTIC PFlt_mSotSubs_C "Ersatzwert für Partikelmasse im Fall von Eeprom lese Fehler" VALUE 0xE86EA Kw_Ws16 300.0000 mSoot_g 0.00 300.0000 FORMAT "%8.4" EXTENDED_LIMITS -327.6800 327.6700 /end CHARACTERISTIC
/begin CHARACTERISTIC PFlt_mSot_Vector "Konfigurationslabel für Bypass" VALUE 0xC2E0C Kw_Wu8 255.0 OneToOne 0.00 255.0 FORMAT "%5.1" /end CHARACTERISTIC
/begin CHARACTERISTIC PFlt_mSot_Channel "Konfigurationslabels für Bypass" VALUE 0xC2E0D Kw_Wu8 255.0 OneToOne 0.00 255.0 FORMAT "%5.1" /end CHARACTERISTIC
/begin CHARACTERISTIC PFlt_nAvrgMinMax_CA "Matrix zur Bestimmung der Bereichsgrenzen für die gefilterte mittlere Drehzahl" MAP 0xE7BAC Kf_Xs16_Ys16_Ws16 5960.000 EngN 40.00000 6000.000 FORMAT "%8.3" EXTENDED_LIMITS -32768.00 32767.00
 /begin AXIS_DESCR STD_AXIS PFlt_RngIdx_X_mp OneToOne 11 0.00 10.00 FORMAT "%5.2" EXTENDED_LIMITS 0.00 255.0 DEPOSIT ABSOLUTE /end AXIS_DESCR
 /begin AXIS_DESCR STD_AXIS PFlt_RngIdx_Y_mp OneToOne 2 0.00 1.000 FORMAT "%5.3" EXTENDED_LIMITS 0.00 255.0 DEPOSIT ABSOLUTE /end AXIS_DESCR
/end CHARACTERISTIC
/begin CHARACTERISTIC PFlt_nTempChkTrg_C "Drehzahlschwelle zur Triggerung Zeitfenster Temperaturplausibilisierung" VALUE 0xE8B50 Kw_Ws16 1500.000 EngN 500.0000 2000.000 FORMAT "%8.3" EXTENDED_LIMITS -32768.00 32767.00 /end CHARACTERISTIC
/begin CHARACTERISTIC PFlt_numCntBck_C "Backstep value of the counter for IATSCD minimum search" VALUE 0xE8B52 Kw_Wu16 65535.00 OneToOne 0.00 65535.00 FORMAT "%8.2" /end CHARACTERISTIC
/begin CHARACTERISTIC PFlt_numCntMax_C "Maximum counter value for IATSCD minimum search" VALUE 0xE8B54 Kw_Wu16 65535.00 OneToOne 0.00 65535.00 FORMAT "%8.2" /end CHARACTERISTIC
/begin CHARACTERISTIC PFlt_numEngPrtActvMsk_C "Engine protection activation mask based on regeneration action" VALUE 0xE8B56 Kw_Wu8 255.0 OneToOne 0.00 255.0 FORMAT "%5.1" /end CHARACTERISTIC
/begin CHARACTERISTIC PFlt_numLSU_C "Array - Index für die Lambdasensor Konfiguration" VALUE 0xE80DE Kw_Wu8 16.00 OneToOne 0.00 16.00 FORMAT "%5.2" EXTENDED_LIMITS 0.00 255.0 /end CHARACTERISTIC
/begin CHARACTERISTIC PFlt_numPFltMon_C "Zeiger für Motortemperaturfeld" VALUE 0xE8B57 Kw_Wu8 2.00000000000 EngTempFldSel 0.00 2.00000000000 FORMAT "%13.11" /end CHARACTERISTIC
/begin CHARACTERISTIC PFlt_numPOpAir_C "Zeiger auf das Motortemperaturfeld" VALUE 0xE7BF6 Kw_Wu8 2.00000000000 IndSysTempFldSel 0.00 2.00000000000 FORMAT "%13.11" /end CHARACTERISTIC
/begin CHARACTERISTIC PFlt_numPOpClnt_C "Zeiger auf das Temperaturfeld des Ansaugsystems" VALUE 0xE7BF7 Kw_Wu8 2.00000000000 EngTempFldSel 0.00 2.00000000000 FORMAT "%13.11" /end CHARACTERISTIC
/begin CHARACTERISTIC PFlt_numTimeStpPlausSens_C "Anzahl Zeitschritte für numerische Differentiation der Sensorsignale" VALUE 0xE8B58 Kw_Wu8 9.000 OneToOne 1.000 10.00 FORMAT "%5.2" EXTENDED_LIMITS 0.00 255.0 /end CHARACTERISTIC
/begin CHARACTERISTIC PFlt_pBPAndAPTolcMax_C "Toleranzband für Ladedrucksensor und Atmosphärendrucksensor" VALUE 0xE8B5A Kw_Wu16 65535.00 Pres_hPa 0.00 65535.00 FORMAT "%8.2" /end CHARACTERISTIC
/begin CHARACTERISTIC PFlt_pDfl_C "Vorgabewert Absolutdruck vor Partikelfilter" VALUE 0xE8BEC Kw_Ws16 65535.00 Pres_hPa -32768.00 32767.00 FORMAT "%8.2" /end CHARACTERISTIC
/begin CHARACTERISTIC PFlt_pDiffCharMonMin_C "Mindestdifferenzdruck für Überwachung des Strömungswiderstandes" VALUE 0xE8B5C Kw_Ws16 4500.000 Pres_hPa -1000.000 3500.000 FORMAT "%8.3" EXTENDED_LIMITS -32768.00 32767.00 /end CHARACTERISTIC
/begin CHARACTERISTIC PFlt_pDiffDfl_MAP "Interpolating the value if the Pressure sensor is Defective" MAP 0xE8BEE Kf_Xs16_Ys16_Ws16 3500.000 Pres_hPa 0.00 3500.000 FORMAT "%8.3" EXTENDED_LIMITS -32768.00 32767.00
 /begin AXIS_DESCR STD_AXIS Eng_nAvrg EngN 8 40.00000 6000.000 FORMAT "%8.3" EXTENDED_LIMITS -32768.00 32767.00 DEPOSIT ABSOLUTE /end AXIS_DESCR
 /begin AXIS_DESCR STD_AXIS InjCtl_qSetUnBal InjMassCyc 8 0.00 327.6700 FORMAT "%8.4" EXTENDED_LIMITS -327.6800 327.6700 DEPOSIT ABSOLUTE /end AXIS_DESCR
/end CHARACTERISTIC
/begin CHARACTERISTIC PFlt_pDiffHsLnNeg_C "Untere Schwelle Differenzdruck zur Schlauchleitungsüberwachung" VALUE 0xE8B5E Kw_Ws16 3277.0000 Pres_hPa 223.0000 3500.0000 FORMAT "%8.4" EXTENDED_LIMITS -32768.00 32767.00 /end CHARACTERISTIC
/begin CHARACTERISTIC PFlt_pDiffMax1_C "" VALUE 0xE8B60 Kw_Ws16 3277.0000 Pres_hPa 223.0000 3500.0000 FORMAT "%8.4" EXTENDED_LIMITS -32768.00 32767.00 /end CHARACTERISTIC
/begin CHARACTERISTIC PFlt_pDiffMax_C "Obere Schwelle SRC Differenzdruck" VALUE 0xE8B62 Kw_Ws16 3277.0000 Pres_hPa 223.0000 3500.0000 FORMAT "%8.4" EXTENDED_LIMITS -32768.00 32767.00 /end CHARACTERISTIC
/begin CHARACTERISTIC PFlt_pDiffMin_C "Untere Schwelle SRC Differenzdruck" VALUE 0xE8B64 Kw_Ws16 3277.0000 Pres_hPa 223.0000 3500.0000 FORMAT "%8.4" EXTENDED_LIMITS -32768.00 32767.00 /end CHARACTERISTIC
/begin CHARACTERISTIC PFlt_dpDiffUp_C "Rampensteigung bei Aufreten eines Systemfehlers" VALUE 0xE8C94 Kw_Wu32 65535999.9847 RmpPres_hPa 0.00 65535999.9847 FORMAT "%13.4" /end CHARACTERISTIC
/begin CHARACTERISTIC PFlt_dpDiffDwn_C "Rampensteigung bei Wegfall des Systemfehlers" VALUE 0xE8C98 Kw_Wu32 65535999.9847 RmpPres_hPa 0.00 65535999.9847 FORMAT "%13.4" /end CHARACTERISTIC
/begin CHARACTERISTIC PFlt_pDiffTolcMax_C "Toleranzband Differenzdrucksensor" VALUE 0xE8B66 Kw_Ws16 3277.0000 Pres_hPa 223.0000 3500.0000 FORMAT "%8.4" EXTENDED_LIMITS -32768.00 32767.00 /end CHARACTERISTIC
/begin CHARACTERISTIC PFlt_pMinNrmCldStrt_C "Mindestumgebungsdruck für normalen Kaltstart" VALUE 0xE8B68 Kw_Ws16 2700.000 Pres_hPa 800.0000 3500.000 FORMAT "%8.3" EXTENDED_LIMITS -32768.00 32767.00 /end CHARACTERISTIC
/begin CHARACTERISTIC PFlt_pPreAndBPTolcMax_C "Toleranzband für Ladedrucksensor und absolut Drucksensor" VALUE 0xE8B6A Kw_Ws16 65535.00 Pres_hPa -32768.00 32767.00 FORMAT "%8.2" /end CHARACTERISTIC
/begin CHARACTERISTIC PFlt_pPreTolcMax_C "Toleranzband Absolutdrucksensor" VALUE 0xE8B6C Kw_Ws16 3277.0000 Pres_hPa 223.0000 3500.0000 FORMAT "%8.4" EXTENDED_LIMITS -32768.00 32767.00 /end CHARACTERISTIC
/begin CHARACTERISTIC PFlt_qSetUnBalRng10Max_GCUR "Maximalwert Einspritzmassensollwert Bereich 10" CURVE 0xE7BF8 Gkl_Ws16 327.6700 InjMass 0.00 327.6700 FORMAT "%8.4" EXTENDED_LIMITS -327.6800 327.6700
 /begin AXIS_DESCR COM_AXIS PFlt_nAvrgFlt_mp EngN 8 40.00000 6000.000 FORMAT "%8.3" EXTENDED_LIMITS -32768.00 32767.00 AXIS_PTS_REF PFlt_qSetUnBal_AXIS /end AXIS_DESCR
/end CHARACTERISTIC
/begin CHARACTERISTIC PFlt_qSetUnBalRng10Min_GCUR "Minimalwert Einspritzmassensollwert Bereich 10" CURVE 0xE7C08 Gkl_Ws16 327.6700 InjMass 0.00 327.6700 FORMAT "%8.4" EXTENDED_LIMITS -327.6800 327.6700
 /begin AXIS_DESCR COM_AXIS PFlt_nAvrgFlt_mp EngN 8 40.00000 6000.000 FORMAT "%8.3" EXTENDED_LIMITS -32768.00 32767.00 AXIS_PTS_REF PFlt_qSetUnBal_AXIS /end AXIS_DESCR
/end CHARACTERISTIC
/begin CHARACTERISTIC PFlt_qSetUnBalRng1Max_GCUR "Maximalwert Einspritzmassensollwert Bereich 1" CURVE 0xE7C18 Gkl_Ws16 327.6700 InjMass 0.00 327.6700 FORMAT "%8.4" EXTENDED_LIMITS -327.6800 327.6700
 /begin AXIS_DESCR COM_AXIS PFlt_nAvrgFlt_mp EngN 8 40.00000 6000.000 FORMAT "%8.3" EXTENDED_LIMITS -32768.00 32767.00 AXIS_PTS_REF PFlt_qSetUnBal_AXIS /end AXIS_DESCR
/end CHARACTERISTIC
/begin CHARACTERISTIC PFlt_qSetUnBalRng1Min_GCUR "Minimalwert Einspritzmassensollwert Bereich 1" CURVE 0xE7C28 Gkl_Ws16 327.6700 InjMass 0.00 327.6700 FORMAT "%8.4" EXTENDED_LIMITS -327.6800 327.6700
 /begin AXIS_DESCR COM_AXIS PFlt_nAvrgFlt_mp EngN 8 40.00000 6000.000 FORMAT "%8.3" EXTENDED_LIMITS -32768.00 32767.00 AXIS_PTS_REF PFlt_qSetUnBal_AXIS /end AXIS_DESCR
/end CHARACTERISTIC
/begin CHARACTERISTIC PFlt_qSetUnBalRng2Max_GCUR "Maximalwert Einspritzmassensollwert Bereich 2" CURVE 0xE7C38 Gkl_Ws16 327.6700 InjMass 0.00 327.6700 FORMAT "%8.4" EXTENDED_LIMITS -327.6800 327.6700
 /begin AXIS_DESCR COM_AXIS PFlt_nAvrgFlt_mp EngN 8 40.00000 6000.000 FORMAT "%8.3" EXTENDED_LIMITS -32768.00 32767.00 AXIS_PTS_REF PFlt_qSetUnBal_AXIS /end AXIS_DESCR
/end CHARACTERISTIC
/begin CHARACTERISTIC PFlt_qSetUnBalRng2Min_GCUR "Minimalwert Einspritzmassensollwert Bereich 2" CURVE 0xE7C48 Gkl_Ws16 327.6700 InjMass 0.00 327.6700 FORMAT "%8.4" EXTENDED_LIMITS -327.6800 327.6700
 /begin AXIS_DESCR COM_AXIS PFlt_nAvrgFlt_mp EngN 8 40.00000 6000.000 FORMAT "%8.3" EXTENDED_LIMITS -32768.00 32767.00 AXIS_PTS_REF PFlt_qSetUnBal_AXIS /end AXIS_DESCR
/end CHARACTERISTIC
/begin CHARACTERISTIC PFlt_qSetUnBalRng3Max_GCUR "Maximalwert Einspritzmassensollwert Bereich 3" CURVE 0xE7C58 Gkl_Ws16 327.6700 InjMass 0.00 327.6700 FORMAT "%8.4" EXTENDED_LIMITS -327.6800 327.6700
 /begin AXIS_DESCR COM_AXIS PFlt_nAvrgFlt_mp EngN 8 40.00000 6000.000 FORMAT "%8.3" EXTENDED_LIMITS -32768.00 32767.00 AXIS_PTS_REF PFlt_qSetUnBal_AXIS /end AXIS_DESCR
/end CHARACTERISTIC
/begin CHARACTERISTIC PFlt_qSetUnBalRng3Min_GCUR "Minimalwert Einspritzmassensollwert Bereich 3" CURVE 0xE7C68 Gkl_Ws16 327.6700 InjMass 0.00 327.6700 FORMAT "%8.4" EXTENDED_LIMITS -327.6800 327.6700
 /begin AXIS_DESCR COM_AXIS PFlt_nAvrgFlt_mp EngN 8 40.00000 6000.000 FORMAT "%8.3" EXTENDED_LIMITS -32768.00 32767.00 AXIS_PTS_REF PFlt_qSetUnBal_AXIS /end AXIS_DESCR
/end CHARACTERISTIC
/begin CHARACTERISTIC PFlt_qSetUnBalRng4Max_GCUR "Maximalwert Einspritzmassensollwert Bereich 4" CURVE 0xE7C78 Gkl_Ws16 327.6700 InjMass 0.00 327.6700 FORMAT "%8.4" EXTENDED_LIMITS -327.6800 327.6700
 /begin AXIS_DESCR COM_AXIS PFlt_nAvrgFlt_mp EngN 8 40.00000 6000.000 FORMAT "%8.3" EXTENDED_LIMITS -32768.00 32767.00 AXIS_PTS_REF PFlt_qSetUnBal_AXIS /end AXIS_DESCR
/end CHARACTERISTIC
/begin CHARACTERISTIC PFlt_qSetUnBalRng4Min_GCUR "Minimalwert Einspritzmassensollwert Bereich 4" CURVE 0xE7C88 Gkl_Ws16 327.6700 InjMass 0.00 327.6700 FORMAT "%8.4" EXTENDED_LIMITS -327.6800 327.6700
 /begin AXIS_DESCR COM_AXIS PFlt_nAvrgFlt_mp EngN 8 40.00000 6000.000 FORMAT "%8.3" EXTENDED_LIMITS -32768.00 32767.00 AXIS_PTS_REF PFlt_qSetUnBal_AXIS /end AXIS_DESCR
/end CHARACTERISTIC
/begin CHARACTERISTIC PFlt_qSetUnBalRng5Max_GCUR "Maximalwert Einspritzmassensollwert Bereich 5" CURVE 0xE7C98 Gkl_Ws16 327.6700 InjMass 0.00 327.6700 FORMAT "%8.4" EXTENDED_LIMITS -327.6800 327.6700
 /begin AXIS_DESCR COM_AXIS PFlt_nAvrgFlt_mp EngN 8 40.00000 6000.000 FORMAT "%8.3" EXTENDED_LIMITS -32768.00 32767.00 AXIS_PTS_REF PFlt_qSetUnBal_AXIS /end AXIS_DESCR
/end CHARACTERISTIC
/begin CHARACTERISTIC PFlt_qSetUnBalRng5Min_GCUR "Minimalwert Einspritzmassensollwert Bereich 5" CURVE 0xE7CA8 Gkl_Ws16 327.6700 InjMass 0.00 327.6700 FORMAT "%8.4" EXTENDED_LIMITS -327.6800 327.6700
 /begin AXIS_DESCR COM_AXIS PFlt_nAvrgFlt_mp EngN 8 40.00000 6000.000 FORMAT "%8.3" EXTENDED_LIMITS -32768.00 32767.00 AXIS_PTS_REF PFlt_qSetUnBal_AXIS /end AXIS_DESCR
/end CHARACTERISTIC
/begin CHARACTERISTIC PFlt_qSetUnBalRng6Max_GCUR "Maximalwert Einspritzmassensollwert Bereich 6" CURVE 0xE7CB8 Gkl_Ws16 327.6700 InjMass 0.00 327.6700 FORMAT "%8.4" EXTENDED_LIMITS -327.6800 327.6700
 /begin AXIS_DESCR COM_AXIS PFlt_nAvrgFlt_mp EngN 8 40.00000 6000.000 FORMAT "%8.3" EXTENDED_LIMITS -32768.00 32767.00 AXIS_PTS_REF PFlt_qSetUnBal_AXIS /end AXIS_DESCR
/end CHARACTERISTIC
/begin CHARACTERISTIC PFlt_qSetUnBalRng6Min_GCUR "Minimalwert Einspritzmassensollwert Bereich 6" CURVE 0xE7CC8 Gkl_Ws16 327.6700 InjMass 0.00 327.6700 FORMAT "%8.4" EXTENDED_LIMITS -327.6800 327.6700
 /begin AXIS_DESCR COM_AXIS PFlt_nAvrgFlt_mp EngN 8 40.00000 6000.000 FORMAT "%8.3" EXTENDED_LIMITS -32768.00 32767.00 AXIS_PTS_REF PFlt_qSetUnBal_AXIS /end AXIS_DESCR
/end CHARACTERISTIC
/begin CHARACTERISTIC PFlt_qSetUnBalRng7Max_GCUR "Maximalwert Einspritzmassensollwert Bereich 7" CURVE 0xE7CD8 Gkl_Ws16 327.6700 InjMass 0.00 327.6700 FORMAT "%8.4" EXTENDED_LIMITS -327.6800 327.6700
 /begin AXIS_DESCR COM_AXIS PFlt_nAvrgFlt_mp EngN 8 40.00000 6000.000 FORMAT "%8.3" EXTENDED_LIMITS -32768.00 32767.00 AXIS_PTS_REF PFlt_qSetUnBal_AXIS /end AXIS_DESCR
/end CHARACTERISTIC
/begin CHARACTERISTIC PFlt_qSetUnBalRng7Min_GCUR "Minimalwert Einspritzmassensollwert Bereich 7" CURVE 0xE7CE8 Gkl_Ws16 327.6700 InjMass 0.00 327.6700 FORMAT "%8.4" EXTENDED_LIMITS -327.6800 327.6700
 /begin AXIS_DESCR COM_AXIS PFlt_nAvrgFlt_mp EngN 8 40.00000 6000.000 FORMAT "%8.3" EXTENDED_LIMITS -32768.00 32767.00 AXIS_PTS_REF PFlt_qSetUnBal_AXIS /end AXIS_DESCR
/end CHARACTERISTIC
/begin CHARACTERISTIC PFlt_qSetUnBalRng8Max_GCUR "Maximalwert Einspritzmassensollwert Bereich 8" CURVE 0xE7CF8 Gkl_Ws16 327.6700 InjMass 0.00 327.6700 FORMAT "%8.4" EXTENDED_LIMITS -327.6800 327.6700
 /begin AXIS_DESCR COM_AXIS PFlt_nAvrgFlt_mp EngN 8 40.00000 6000.000 FORMAT "%8.3" EXTENDED_LIMITS -32768.00 32767.00 AXIS_PTS_REF PFlt_qSetUnBal_AXIS /end AXIS_DESCR
/end CHARACTERISTIC
/begin CHARACTERISTIC PFlt_qSetUnBalRng8Min_GCUR "Minimalwert Einspritzmassensollwert Bereich 8" CURVE 0xE7D08 Gkl_Ws16 327.6700 InjMass 0.00 327.6700 FORMAT "%8.4" EXTENDED_LIMITS -327.6800 327.6700
 /begin AXIS_DESCR COM_AXIS PFlt_nAvrgFlt_mp EngN 8 40.00000 6000.000 FORMAT "%8.3" EXTENDED_LIMITS -32768.00 32767.00 AXIS_PTS_REF PFlt_qSetUnBal_AXIS /end AXIS_DESCR
/end CHARACTERISTIC
/begin CHARACTERISTIC PFlt_qSetUnBalRng9Max_GCUR "Maximalwert Einspritzmassensollwert Bereich 9" CURVE 0xE7D18 Gkl_Ws16 327.6700 InjMass 0.00 327.6700 FORMAT "%8.4" EXTENDED_LIMITS -327.6800 327.6700
 /begin AXIS_DESCR COM_AXIS PFlt_nAvrgFlt_mp EngN 8 40.00000 6000.000 FORMAT "%8.3" EXTENDED_LIMITS -32768.00 32767.00 AXIS_PTS_REF PFlt_qSetUnBal_AXIS /end AXIS_DESCR
/end CHARACTERISTIC
/begin CHARACTERISTIC PFlt_qSetUnBalRng9Min_GCUR "Minimalwert Einspritzmassensollwert Bereich 9" CURVE 0xE7D28 Gkl_Ws16 327.6700 InjMass 0.00 327.6700 FORMAT "%8.4" EXTENDED_LIMITS -327.6800 327.6700
 /begin AXIS_DESCR COM_AXIS PFlt_nAvrgFlt_mp EngN 8 40.00000 6000.000 FORMAT "%8.3" EXTENDED_LIMITS -32768.00 32767.00 AXIS_PTS_REF PFlt_qSetUnBal_AXIS /end AXIS_DESCR
/end CHARACTERISTIC
/begin CHARACTERISTIC PFlt_qSetUnBalRngSpoMax_GCUR "Maximalwert Einspritzmassensollwert Bereich Spontane Regeneration" CURVE 0xE7D38 Gkl_Ws16 327.6700 InjMass 0.00 327.6700 FORMAT "%8.4" EXTENDED_LIMITS -327.6800 327.6700
 /begin AXIS_DESCR COM_AXIS PFlt_nAvrgFlt_mp EngN 8 40.00000 6000.000 FORMAT "%8.3" EXTENDED_LIMITS -32768.00 32767.00 AXIS_PTS_REF PFlt_qSetUnBal_AXIS /end AXIS_DESCR
/end CHARACTERISTIC
/begin CHARACTERISTIC PFlt_qSetUnBalRngSpoMin_GCUR "Minimalwert Einspritzmassensollwert Bereich Spontane Regeneration" CURVE 0xE7D48 Gkl_Ws16 327.6700 InjMass 0.00 327.6700 FORMAT "%8.4" EXTENDED_LIMITS -327.6800 327.6700
 /begin AXIS_DESCR COM_AXIS PFlt_nAvrgFlt_mp EngN 8 40.00000 6000.000 FORMAT "%8.3" EXTENDED_LIMITS -32768.00 32767.00 AXIS_PTS_REF PFlt_qSetUnBal_AXIS /end AXIS_DESCR
/end CHARACTERISTIC
/begin AXIS_PTS PFlt_qSetUnBal_AXIS "Breakpoints for the group curves which calculate the unbalanced fuel quantity thresholds" 0xE7D58 PFlt_nAvrgFlt_mp GSst_Xs16 5960.000 EngN 8 40.00000 6000.000 FORMAT "%8.3" EXTENDED_LIMITS -32768.00 32767.00 DEPOSIT ABSOLUTE /end AXIS_PTS
/begin CHARACTERISTIC PFlt_rAccPedMinMax_CA "Matrix zur Bestimmung der Bereichsgrenzen für das gefilterte Pedalwertgebersignal" MAP 0xE7D6A Kf_Xs16_Ys16_Ws16 100.0000 Prc 0.00 100.0000 FORMAT "%8.4" EXTENDED_LIMITS -400.0000 399.9878
 /begin AXIS_DESCR STD_AXIS PFlt_RngIdx_X_mp OneToOne 11 0.00 10.00 FORMAT "%5.2" EXTENDED_LIMITS 0.00 255.0 DEPOSIT ABSOLUTE /end AXIS_DESCR
 /begin AXIS_DESCR STD_AXIS PFlt_RngIdx_Y_mp OneToOne 2 0.00 1.000 FORMAT "%5.3" EXTENDED_LIMITS 0.00 255.0 DEPOSIT ABSOLUTE /end AXIS_DESCR
/end CHARACTERISTIC
/begin CHARACTERISTIC PFlt_rEGRSimMax_C "obere Grenze für Abschalterkennung ARF" VALUE 0xE86EC Kw_Ws16 300.0000 Prc -100.0000 200.0000 FORMAT "%8.4" EXTENDED_LIMITS -400.0000 399.9878 /end CHARACTERISTIC
/begin CHARACTERISTIC PFlt_rEGRSimMin_C "untere Grenze für Abschalterkennung ARF" VALUE 0xE86EE Kw_Ws16 300.0000 Prc -100.0000 200.0000 FORMAT "%8.4" EXTENDED_LIMITS -400.0000 399.9878 /end CHARACTERISTIC
/begin CHARACTERISTIC PFlt_rEngPrtRgnMax_C "Threshold value for ratio of task time and last regeneration time" VALUE 0xE8B6E Kw_Ws16 799.9878 Prc -400.0000 399.9878 FORMAT "%8.4" /end CHARACTERISTIC
/begin CHARACTERISTIC PFlt_resFlowAdiOfs_MAP "Kennfeld Strömungswiderstandoffset durch Additiv" MAP 0xE86F0 Kf_Xs16_Ys16_Ws16 25.00000 Res_hPaHrPerCM 0.00 25.00000 FORMAT "%8.5" EXTENDED_LIMITS -32.76800 32.76700
 /begin AXIS_DESCR STD_AXIS PFlt_dvol CubMtrPerHr 8 0.00 3000.000 FORMAT "%8.3" EXTENDED_LIMITS -3276.800 3276.700 DEPOSIT ABSOLUTE /end AXIS_DESCR
 /begin AXIS_DESCR STD_AXIS PFlt_mAshAdi_mp mSoot_g 8 0.00 300.0000 FORMAT "%8.4" EXTENDED_LIMITS -327.6800 327.6700 DEPOSIT ABSOLUTE /end AXIS_DESCR
/end CHARACTERISTIC
/begin CHARACTERISTIC PFlt_resFlowMax_C "Obere Schwelle SRC Strömungswiderstand" VALUE 0xE8B70 Kw_Ws16 25.00000 Res_hPaHrPerCM 0.00 25.00000 FORMAT "%8.5" EXTENDED_LIMITS -32.76800 32.76700 /end CHARACTERISTIC
/begin CHARACTERISTIC PFlt_resFlowMeasInv_MAP "Inverse Strömungswiderstandskennfeld" MAP 0xE8794 Kf_Xs16_Ys16_Ws16 25.00000 Res_hPaHrPerCM 0.00 25.00000 FORMAT "%8.5" EXTENDED_LIMITS -32.76800 32.76700
 /begin AXIS_DESCR STD_AXIS PFlt_mSotCrv_mp mSoot_g 16 0.00 300.0000 FORMAT "%8.4" EXTENDED_LIMITS -327.6800 327.6700 DEPOSIT ABSOLUTE /end AXIS_DESCR
 /begin AXIS_DESCR STD_AXIS PFlt_dvolMassFlt_mp CubMtrPerHr 16 0.00 3000.000 FORMAT "%8.3" EXTENDED_LIMITS -3276.800 3276.700 DEPOSIT ABSOLUTE /end AXIS_DESCR
/end CHARACTERISTIC
/begin CHARACTERISTIC PFlt_resFlowMin_C "Untere Schwelle SRC Strömungswiderstand" VALUE 0xE8B72 Kw_Ws16 25.00000 Res_hPaHrPerCM 0.00 25.00000 FORMAT "%8.5" EXTENDED_LIMITS -32.76800 32.76700 /end CHARACTERISTIC
/begin CHARACTERISTIC PFlt_resFlowOilOfs_MAP "Kennfeld Strömungswiderstandoffset durch Ölasche" MAP 0xE89D8 Kf_Xs16_Ys16_Ws16 25.00000 Res_hPaHrPerCM 0.00 25.00000 FORMAT "%8.5" EXTENDED_LIMITS -32.76800 32.76700
 /begin AXIS_DESCR STD_AXIS PFlt_dvol CubMtrPerHr 8 0.00 3000.000 FORMAT "%8.3" EXTENDED_LIMITS -3276.800 3276.700 DEPOSIT ABSOLUTE /end AXIS_DESCR
 /begin AXIS_DESCR STD_AXIS PFlt_mAshOil mSoot_g 8 0.00 300.0000 FORMAT "%8.4" EXTENDED_LIMITS -327.6800 327.6700 DEPOSIT ABSOLUTE /end AXIS_DESCR
/end CHARACTERISTIC
/begin CHARACTERISTIC PFlt_resFlowTolcDynPlaus_C "Faktor für Festlegung Toleranzschwelle dynamische Drucküberwachung" VALUE 0xE8B74 Kw_Ws16 25.00000 Res_hPaHrPerCM 0.00 25.00000 FORMAT "%8.5" EXTENDED_LIMITS -32.76800 32.76700 /end CHARACTERISTIC
/begin CHARACTERISTIC PFlt_resFlow_MAP "Strömungswiderstand als Funktion von Abgasvolumsstrom und Differenzdruck" MAP 0xE8A7C Kf_Xs16_Ys16_Ws16 25.00000 Res_hPaHrPerCM 0.00 25.00000 FORMAT "%8.5" EXTENDED_LIMITS -32.76800 32.76700
 /begin AXIS_DESCR STD_AXIS PFlt_dvol CubMtrPerHr 8 0.00 3000.000 FORMAT "%8.3" EXTENDED_LIMITS -3276.800 3276.700 DEPOSIT ABSOLUTE /end AXIS_DESCR
 /begin AXIS_DESCR STD_AXIS PFlt_pDiff Pres_hPa 8 0.00 5000.000 FORMAT "%8.3" EXTENDED_LIMITS -32768.00 32767.00 DEPOSIT ABSOLUTE /end AXIS_DESCR
/end CHARACTERISTIC
/begin CHARACTERISTIC PFlt_resFlow_Vector "#SSD Konfigurationslabel für Bypass" VALUE 0xC2E0E Kw_Wu8 255.0 OneToOne 0.00 255.0 FORMAT "%5.1" /end CHARACTERISTIC
/begin CHARACTERISTIC PFlt_resFlow_Channel "#SSD Konfigurationslabels für Bypass" VALUE 0xC2E0F Kw_Wu8 255.0 OneToOne 0.00 255.0 FORMAT "%5.1" /end CHARACTERISTIC
/begin CHARACTERISTIC PFlt_stCfgTempSens_C "Bitleiste zur Auswahl der Abgastemperatursensoren" VALUE 0xE8B76 Kw_Wu8 255.0 OneToOne 0.00 255.0 FORMAT "%5.1" /end CHARACTERISTIC
/begin CHARACTERISTIC PFlt_stEngPOp_Vector "#SSD Konfigurationslabel für Bypass" VALUE 0xC2E08 Kw_Wu8 255.0 OneToOne 0.00 255.0 FORMAT "%5.1" /end CHARACTERISTIC
/begin CHARACTERISTIC PFlt_stEngPOp_Channel "#SSD Konfigurationslabel für Bypass" VALUE 0xC2E09 Kw_Wu8 255.0 OneToOne 0.00 255.0 FORMAT "%5.1" /end CHARACTERISTIC
/begin CHARACTERISTIC PFlt_stGearDebValMax_C "Maximaler Gang für Entprellfunktion" VALUE 0xE7DB4 Kw_Ws8 7.000 OneToOne -1.000 6.000 FORMAT "%5.3" EXTENDED_LIMITS -128.0 127.0 /end CHARACTERISTIC
/begin CHARACTERISTIC PFlt_stGearDebValMin_C "Minimaler Gang der Entprellfunktion" VALUE 0xE7DB5 Kw_Ws8 7.000 OneToOne -1.000 6.000 FORMAT "%5.3" EXTENDED_LIMITS -128.0 127.0 /end CHARACTERISTIC
/begin CHARACTERISTIC PFlt_stGearMinMax_CA "Matrix zur Bestimmung der Bereichsgrenzen für den eingelegten Gang" MAP 0xE7DB6 Kf_Xs16_Ys16_Ws16 7.000000 OneToOne -1.000000 6.000000 FORMAT "%8.6" EXTENDED_LIMITS -32768.00 32767.00
 /begin AXIS_DESCR STD_AXIS PFlt_RngIdx_X_mp OneToOne 11 0.00 10.00 FORMAT "%5.2" EXTENDED_LIMITS 0.00 255.0 DEPOSIT ABSOLUTE /end AXIS_DESCR
 /begin AXIS_DESCR STD_AXIS PFlt_RngIdx_Y_mp OneToOne 2 0.00 1.000 FORMAT "%5.3" EXTENDED_LIMITS 0.00 255.0 DEPOSIT ABSOLUTE /end AXIS_DESCR
/end CHARACTERISTIC
/begin CHARACTERISTIC PFlt_stResFlowPT1RgnMsk_C "Mask für Bestimmung Regenerationsrelevante Zustand" VALUE 0xE8B20 Kw_Wu32 4294967295.00 OneToOne 0.00 4294967295.00 FORMAT "%13.2" /end CHARACTERISTIC
/begin CHARACTERISTIC PFlt_stRgnMsk1_C "Masking for EGT_CmpSt function" VALUE 0xE8D78 Kw_Wu32 2147483647.00 OneToOne 0.00 2147483647.00 FORMAT "%13.2" EXTENDED_LIMITS 0.00 4294967295.00 /end CHARACTERISTIC
/begin CHARACTERISTIC PFlt_stRgnMsk2_C "Masking for EGT_CmpSt function" VALUE 0xE8D7C Kw_Wu32 2147483647.00 OneToOne 0.00 2147483647.00 FORMAT "%13.2" EXTENDED_LIMITS 0.00 4294967295.00 /end CHARACTERISTIC
/begin CHARACTERISTIC PFlt_stSimRgnMsk_C "Maske zur Deaktivierung der Partikelmassen-Berechnung in definierten Regenerationszuständen" VALUE 0xE8B24 Kw_Wu32 4294967295.00 OneToOne 0.00 4294967295.00 FORMAT "%13.2" /end CHARACTERISTIC
/begin CHARACTERISTIC PFlt_swtASModOn_C "Schalter für Luftmassenstromsignal (HFM oder ASMod)" VALUE 0xE80DF Kw_Wu8 1.000 OneToOne 0.00 1.000 FORMAT "%5.3" EXTENDED_LIMITS 0.00 255.0 /end CHARACTERISTIC
/begin CHARACTERISTIC PFlt_swtBrkRng_CA "Array zur Bestimmung der Bereichswerte für das entprellte Bremssignal" VAL_BLK 0xE7E00 Kwb_Wu8 2.000 OneToOne 0.00 2.000 FORMAT "%5.3" EXTENDED_LIMITS 0.00 255.0 NUMBER 11 /end CHARACTERISTIC
/begin CHARACTERISTIC PFlt_swtClthRng_CA "Array zur Bestimmung der Bereichswerte für das entprellte Kupplungssignal" VAL_BLK 0xE7E0B Kwb_Wu8 2.000 OneToOne 0.00 2.000 FORMAT "%5.3" EXTENDED_LIMITS 0.00 255.0 NUMBER 11 /end CHARACTERISTIC
/begin CHARACTERISTIC PFlt_swtEngPrtWrEEPROM_C "Switch to enable regeneration protection counters to be written into EEPROM" VALUE 0xE8B77 Kw_Wu8 1.000 OneToOne 0.00 1.000 FORMAT "%5.3" EXTENDED_LIMITS 0.00 255.0 /end CHARACTERISTIC
/begin CHARACTERISTIC PFlt_swtEnvTempSens_C "Schalter Umgebungstemperatursensorfühler appliziert" VALUE 0xE8B78 Kw_Wu8 1.000 OneToOne 0.00 1.000 FORMAT "%5.3" EXTENDED_LIMITS 0.00 255.0 /end CHARACTERISTIC
/begin CHARACTERISTIC PFlt_swtFacDpn_C "Switch value for consideration of dissipation" VALUE 0xE8D80 Kw_Wu8 1.000 OneToOne 0.00 1.000 FORMAT "%5.3" EXTENDED_LIMITS 0.00 255.0 /end CHARACTERISTIC
/begin CHARACTERISTIC PFlt_swtLmbdAprx_C "Mess- oder Simulationssignal für Lambda-Messung" VALUE 0xE80E0 Kw_Wu8 1.000 OneToOne 0.00 1.000 FORMAT "%5.3" EXTENDED_LIMITS 0.00 255.0 /end CHARACTERISTIC
/begin CHARACTERISTIC PFlt_swtMonCharMin_C "Schalter Auswahl Überwachung Strömungswiderstand" VALUE 0xE8B79 Kw_Wu8 1.000 OneToOne 0.00 1.000 FORMAT "%5.3" EXTENDED_LIMITS 0.00 255.0 /end CHARACTERISTIC
/begin CHARACTERISTIC PFlt_swtPDiffOfsOn_C "Schalter zur Berücksichtigung des Differenzdruckoffsets" VALUE 0xE8C9C Kw_Wu8 1.000 OneToOne 0.00 1.000 FORMAT "%5.3" EXTENDED_LIMITS 0.00 255.0 /end CHARACTERISTIC
/begin CHARACTERISTIC PFlt_swtPresSensCfg_C "Auswahlwert für Sensorkonfiguration" VALUE 0xE8C9D Kw_Wu8 2.000 OneToOne 0.00 2.000 FORMAT "%5.3" EXTENDED_LIMITS 0.00 255.0 /end CHARACTERISTIC
/begin CHARACTERISTIC PFlt_swtSensEvalSel_C "SW-Schalter Strömungswdst aus Division oder Kennfeld" VALUE 0xE8B28 Kw_Wu8 1.000 OneToOne 0.00 1.000 FORMAT "%5.3" EXTENDED_LIMITS 0.00 255.0 /end CHARACTERISTIC
/begin CHARACTERISTIC PFlt_swtSimInitOn_C "Switch for initializing of particle soot mass integrator" VALUE 0xE8B29 Kw_Wu8 1.000 OneToOne 0.00 1.000 FORMAT "%5.3" EXTENDED_LIMITS 0.00 255.0 /end CHARACTERISTIC
/begin CHARACTERISTIC PFlt_swtSvcSensChng_C "Switch for resetting the EEPROM values at differential pressure sensor replacement" VALUE 0xE8B7A Kw_Wu8 255.0 OneToOne 0.00 255.0 FORMAT "%5.1" /end CHARACTERISTIC
/begin CHARACTERISTIC PFlt_swtSvcTmrRst_C "Switch for resetting the EEPROM timer values at control unit replacement" VALUE 0xE8B7B Kw_Wu8 255.0 OneToOne 0.00 255.0 FORMAT "%5.1" /end CHARACTERISTIC
/begin CHARACTERISTIC PFlt_swtTempModOff_C "Schalter zur Abschaltung des Partikelfiltertemperaturmodells" VALUE 0xE8D81 Kw_Wu8 1.000 OneToOne 0.00 1.000 FORMAT "%5.3" EXTENDED_LIMITS 0.00 255.0 /end CHARACTERISTIC
/begin CHARACTERISTIC PFlt_tAirMinMax_CA "Matrix zur Bestimmung der Bereichsgrenzen für die Ansauglufttemperatur" MAP 0xE7E16 Kf_Xs16_Ys16_Ws16 250.0000 Temp_Cels -50.14000 199.8600 FORMAT "%8.4" EXTENDED_LIMITS -3549.940 3003.560
 /begin AXIS_DESCR STD_AXIS PFlt_RngIdx_X_mp OneToOne 11 0.00 10.00 FORMAT "%5.2" EXTENDED_LIMITS 0.00 255.0 DEPOSIT ABSOLUTE /end AXIS_DESCR
 /begin AXIS_DESCR STD_AXIS PFlt_RngIdx_Y_mp OneToOne 2 0.00 1.000 FORMAT "%5.3" EXTENDED_LIMITS 0.00 255.0 DEPOSIT ABSOLUTE /end AXIS_DESCR
/end CHARACTERISTIC
/begin CHARACTERISTIC PFlt_tCldStrtDfl_C "Obere Temperaturschwelle für Kaltstarterkennung" VALUE 0xE8B7C Kw_Ws16 950.0000 Temp_Cels -50.14000 899.8600 FORMAT "%8.4" EXTENDED_LIMITS -3549.940 3003.560 /end CHARACTERISTIC
/begin CHARACTERISTIC PFlt_tClntMinMax_CA "Matrix zur Bestimmung der Bereichsgrenzen für die gefilterte Temperatur der Kühlflüssigkeit" MAP 0xE7E60 Kf_Xs16_Ys16_Ws16 250.0000 Temp_Cels -50.14000 199.8600 FORMAT "%8.4" EXTENDED_LIMITS -3549.940 3003.560
 /begin AXIS_DESCR STD_AXIS PFlt_RngIdx_X_mp OneToOne 11 0.00 10.00 FORMAT "%5.2" EXTENDED_LIMITS 0.00 255.0 DEPOSIT ABSOLUTE /end AXIS_DESCR
 /begin AXIS_DESCR STD_AXIS PFlt_RngIdx_Y_mp OneToOne 2 0.00 1.000 FORMAT "%5.3" EXTENDED_LIMITS 0.00 255.0 DEPOSIT ABSOLUTE /end AXIS_DESCR
/end CHARACTERISTIC
/begin CHARACTERISTIC PFlt_tDiffCldMax_C "Maximal erlaubte Abweichung Temperatursensoren bei Kaltstart" VALUE 0xE8B7E Kw_Ws16 250.2000 TempDiff_Cels -50.10000 200.1000 FORMAT "%8.4" EXTENDED_LIMITS -3276.800 3276.700 /end CHARACTERISTIC
/begin CHARACTERISTIC PFlt_tDiffTolcMax_C "Maximal erlaubte Toleranzabweichung Temperaturplausibilisierung" VALUE 0xE8B80 Kw_Ws16 250.2000 TempDiff_Cels -50.10000 200.1000 FORMAT "%8.4" EXTENDED_LIMITS -3276.800 3276.700 /end CHARACTERISTIC
/begin CHARACTERISTIC PFlt_tDwnStrmTolcMax_C "Maximal zulässige Toleranz bei Plausibilisierung des zweiten Abgastemperatursensors" VALUE 0xE8B82 Kw_Ws16 250.2000 TempDiff_Cels -50.10000 200.1000 FORMAT "%8.4" EXTENDED_LIMITS -3276.800 3276.700 /end CHARACTERISTIC
/begin CHARACTERISTIC PFlt_tEGMax_C "Obere Schwelle SRC Temperatursensoren" VALUE 0xE8B84 Kw_Ws16 950.0000 Temp_Cels -50.14000 899.8600 FORMAT "%8.4" EXTENDED_LIMITS -3549.940 3003.560 /end CHARACTERISTIC
/begin CHARACTERISTIC PFlt_tEGMin_C "Untere Schwelle SRC Temperatursensoren" VALUE 0xE8B86 Kw_Ws16 950.0000 Temp_Cels -50.14000 899.8600 FORMAT "%8.4" EXTENDED_LIMITS -3549.940 3003.560 /end CHARACTERISTIC
/begin CHARACTERISTIC PFlt_tExhGsStyRgn1_MAP "static soot emission" MAP 0xE8D82 Kf_Xs16_Ys16_Ws16 700.0000 TempDiff_Cels 100.0000 800.0000 FORMAT "%8.4" EXTENDED_LIMITS -3276.800 3276.700
 /begin AXIS_DESCR STD_AXIS Eng_nAvrg EngN 8 40.00000 6000.000 FORMAT "%8.3" EXTENDED_LIMITS -32768.00 32767.00 DEPOSIT ABSOLUTE /end AXIS_DESCR
 /begin AXIS_DESCR STD_AXIS InjCtl_qSetUnBal InjMassCyc 8 0.00 327.6700 FORMAT "%8.4" EXTENDED_LIMITS -327.6800 327.6700 DEPOSIT ABSOLUTE /end AXIS_DESCR
/end CHARACTERISTIC
/begin CHARACTERISTIC PFlt_tExhGsStyRgn2_MAP "static soot emission" MAP 0xE8E26 Kf_Xs16_Ys16_Ws16 700.0000 TempDiff_Cels 100.0000 800.0000 FORMAT "%8.4" EXTENDED_LIMITS -3276.800 3276.700
 /begin AXIS_DESCR STD_AXIS Eng_nAvrg EngN 8 40.00000 6000.000 FORMAT "%8.3" EXTENDED_LIMITS -32768.00 32767.00 DEPOSIT ABSOLUTE /end AXIS_DESCR
 /begin AXIS_DESCR STD_AXIS InjCtl_qSetUnBal InjMassCyc 8 0.00 327.6700 FORMAT "%8.4" EXTENDED_LIMITS -327.6800 327.6700 DEPOSIT ABSOLUTE /end AXIS_DESCR
/end CHARACTERISTIC
/begin CHARACTERISTIC PFlt_tExhGsSty_MAP "Kennfeld für Stationärtemperaturen" MAP 0xE8ECA Kf_Xs16_Ys16_Ws16 950.0000 Temp_Cels -50.1400 899.8600 FORMAT "%8.4" EXTENDED_LIMITS -3549.940 3003.560
 /begin AXIS_DESCR STD_AXIS Eng_nAvrg EngN 8 40.00000 6000.000 FORMAT "%8.3" EXTENDED_LIMITS -32768.00 32767.00 DEPOSIT ABSOLUTE /end AXIS_DESCR
 /begin AXIS_DESCR STD_AXIS InjCtl_qSetUnBal InjMassCyc 8 0.00 327.6700 FORMAT "%8.4" EXTENDED_LIMITS -327.6800 327.6700 DEPOSIT ABSOLUTE /end AXIS_DESCR
/end CHARACTERISTIC
/begin CHARACTERISTIC PFlt_tFrzMin_C "Minimale Temperatur, unter der vor einem Einfrieren des Drucksensors gewarnt wird" VALUE 0xE8B88 Kw_Ws16 950.0000 Temp_Cels -50.14000 899.8600 FORMAT "%8.4" EXTENDED_LIMITS -3549.940 3003.560 /end CHARACTERISTIC
/begin CHARACTERISTIC PFlt_tiAccPedPT1_C "Filterzeitkonst. für Pedalwertgeber PT1 Filter" VALUE 0xE7EAC Kw_Wu32 4294.9673 TimeDelay_s 0.0000010000000 4294.9673 FORMAT "%9.4" /end CHARACTERISTIC
/begin CHARACTERISTIC PFlt_tiBattCDPT1_C "Zeitkonstante für Batteriespannung" VALUE 0xE7EB0 Kw_Wu32 4294.9673 TimeDelay_s 0.0000010000000 4294.9673 FORMAT "%9.4" /end CHARACTERISTIC
/begin CHARACTERISTIC PFlt_tiChkTempPlausMax_CUR "Kennlinie zur Bestimmung des maximalen Zeitfensters zur Durchführung der Temp.-Plausibilisierung" CURVE 0xE8B8A Kl_Xs16_Ws16 5.000000 Time_s 0.00 5.000000 FORMAT "%8.6" EXTENDED_LIMITS -327.6800 327.6700
 /begin AXIS_DESCR STD_AXIS BattCD_u Volt_Batt 8 0.00 5004.888 FORMAT "%8.3" EXTENDED_LIMITS -640625.6 640606.1 DEPOSIT ABSOLUTE /end AXIS_DESCR
/end CHARACTERISTIC
/begin CHARACTERISTIC PFlt_tiDebBrkOff_C "Entprellzeit Bremse aus" VALUE 0xE7EB4 Kw_Wu16 3000.000 TimeDeb 0.00 3000.000 FORMAT "%8.3" EXTENDED_LIMITS 0.00 655350.0 /end CHARACTERISTIC
/begin CHARACTERISTIC PFlt_tiDebBrkOn_C "Entprellzeit Bremse an" VALUE 0xE7EB6 Kw_Wu16 3000.000 TimeDeb 0.00 3000.000 FORMAT "%8.3" EXTENDED_LIMITS 0.00 655350.0 /end CHARACTERISTIC
/begin CHARACTERISTIC PFlt_DebCharMaxDef_C "Entprellzeit setzen Strömungswiderstand SRC high" VALUE 0xE8BAC Kw_Wu16 1000.000 Time_ms 0.00 1000.000 FORMAT "%8.3" EXTENDED_LIMITS 0.00 655350.0 /end CHARACTERISTIC
/begin CHARACTERISTIC PFlt_DebCharMaxOk_C "Entprellzeit heilen Strömungswiderstand SRC high" VALUE 0xE8BAE Kw_Wu16 1000.000 Time_ms 0.00 1000.000 FORMAT "%8.3" EXTENDED_LIMITS 0.00 655350.0 /end CHARACTERISTIC
/begin CHARACTERISTIC PFlt_DebCharMinDef_C "Entprellzeit setzen Strömungswiderstand SRC low" VALUE 0xE8BB0 Kw_Wu16 1000.000 Time_ms 0.00 1000.000 FORMAT "%8.3" EXTENDED_LIMITS 0.00 655350.0 /end CHARACTERISTIC
/begin CHARACTERISTIC PFlt_DebCharMinOk_C "Entprellzeit heilen Strömungswiderstand SRC low" VALUE 0xE8BB2 Kw_Wu16 1000.000 Time_ms 0.00 1000.000 FORMAT "%8.3" EXTENDED_LIMITS 0.00 655350.0 /end CHARACTERISTIC
/begin CHARACTERISTIC PFlt_tiDebConvOff_C "Entprellzeit Kupplung aus" VALUE 0xE7EB8 Kw_Wu16 3000.000 TimeDeb 0.00 3000.000 FORMAT "%8.3" EXTENDED_LIMITS 0.00 655350.0 /end CHARACTERISTIC
/begin CHARACTERISTIC PFlt_tiDebConvOn_C "Entprellzeit Kupplung an" VALUE 0xE7EBA Kw_Wu16 3000.000 TimeDeb 0.00 3000.000 FORMAT "%8.3" EXTENDED_LIMITS 0.00 655350.0 /end CHARACTERISTIC
/begin CHARACTERISTIC PFlt_DebEngPrtMaxDef_C "Entprellzeit setzen Motorschutz-Fehler" VALUE 0xE8BB4 Kw_Wu16 1000.000 Time_ms 0.00 1000.000 FORMAT "%8.3" EXTENDED_LIMITS 0.00 655350.0 /end CHARACTERISTIC
/begin CHARACTERISTIC PFlt_DebEngPrtMaxOk_C "Entprellzeit heilen Motorschutz-Fehler" VALUE 0xE8BB6 Kw_Wu16 1000.000 Time_ms 0.00 1000.000 FORMAT "%8.3" EXTENDED_LIMITS 0.00 655350.0 /end CHARACTERISTIC
/begin CHARACTERISTIC PFlt_tiDebGearOff_C "Entprellungszeit für die Freigabe des Gangsignales" VALUE 0xE7EBC Kw_Wu16 3000.000 TimeDeb 0.00 3000.000 FORMAT "%8.3" EXTENDED_LIMITS 0.00 655350.0 /end CHARACTERISTIC
/begin CHARACTERISTIC PFlt_tiDebGearOn_C "Entprellungszeit für Setzen des Gangsignals" VALUE 0xE7EBE Kw_Wu16 3000.000 TimeDeb 0.00 3000.000 FORMAT "%8.3" EXTENDED_LIMITS 0.00 655350.0 /end CHARACTERISTIC
/begin CHARACTERISTIC PFlt_DebmSotMaxDef_C "Debouncing time for defect recognition of unsuccessful regeneration" VALUE 0xE8BB8 Kw_Wu16 20000.00 Time_ms 0.00 20000.00 FORMAT "%8.2" EXTENDED_LIMITS 0.00 655350.0 /end CHARACTERISTIC
/begin CHARACTERISTIC PFlt_DebmSotMaxOk_C "Debouncing time for error healing of unsuccessful regeneration" VALUE 0xE8BBA Kw_Wu16 20000.00 Time_ms 0.00 20000.00 FORMAT "%8.2" EXTENDED_LIMITS 0.00 655350.0 /end CHARACTERISTIC
/begin CHARACTERISTIC PFlt_DebPDiffDynPlausDef_C "Entprellzeit setzen dynamischer Fehler Differenzdruck" VALUE 0xE8BBC Kw_Wu16 1000.000 Time_ms 0.00 1000.000 FORMAT "%8.3" EXTENDED_LIMITS 0.00 655350.0 /end CHARACTERISTIC
/begin CHARACTERISTIC PFlt_DebPDiffDynPlausOk_C "Entprellzeit heilen dynamischer Fehler Differenzdruck" VALUE 0xE8BBE Kw_Wu16 1000.000 Time_ms 0.00 1000.000 FORMAT "%8.3" EXTENDED_LIMITS 0.00 655350.0 /end CHARACTERISTIC
/begin CHARACTERISTIC PFlt_DebHsLnPlausDef_C "Entprellzeit setzen Plausibilisierungsfehler Schlauchleitung" VALUE 0xE8BC0 Kw_Wu16 1000.000 Time_ms 0.00 1000.000 FORMAT "%8.3" EXTENDED_LIMITS 0.00 655350.0 /end CHARACTERISTIC
/begin CHARACTERISTIC PFlt_DebHsLnPlausOk_C "Entprellzeit heilen Plausibilisierungsfehler Schlauchleitung" VALUE 0xE8BC2 Kw_Wu16 1000.000 Time_ms 0.00 1000.000 FORMAT "%8.3" EXTENDED_LIMITS 0.00 655350.0 /end CHARACTERISTIC
/begin CHARACTERISTIC PFlt_DebPDiffMaxDef_C "Entprellzeit setzen Drucksensoren SRC high" VALUE 0xE8BC4 Kw_Wu16 1000.000 Time_ms 0.00 1000.000 FORMAT "%8.3" EXTENDED_LIMITS 0.00 655350.0 /end CHARACTERISTIC
/begin CHARACTERISTIC PFlt_DebPDiffMaxOk_C "Entprellzeit heilen Drucksensoren SRC high" VALUE 0xE8BC6 Kw_Wu16 1000.000 Time_ms 0.00 1000.000 FORMAT "%8.3" EXTENDED_LIMITS 0.00 655350.0 /end CHARACTERISTIC
/begin CHARACTERISTIC PFlt_DebPDiffMinDef_C "Entprellzeit setzen Drucksensoren SRC low" VALUE 0xE8BC8 Kw_Wu16 1000.000 Time_ms 0.00 1000.000 FORMAT "%8.3" EXTENDED_LIMITS 0.00 655350.0 /end CHARACTERISTIC
/begin CHARACTERISTIC PFlt_DebPDiffMinOk_C "Entprellzeit heilen Drucksensoren SRC low" VALUE 0xE8BCA Kw_Wu16 1000.000 Time_ms 0.00 1000.000 FORMAT "%8.3" EXTENDED_LIMITS 0.00 655350.0 /end CHARACTERISTIC
/begin CHARACTERISTIC PFlt_DebSotPlausDef_C "Entprellzeit setzen Plausibilisierungsfehler Versottung" VALUE 0xE8BCC Kw_Wu16 1000.000 Time_ms 0.00 1000.000 FORMAT "%8.3" EXTENDED_LIMITS 0.00 655350.0 /end CHARACTERISTIC
/begin CHARACTERISTIC PFlt_DebSotPlausOk_C "Entprellzeit heilen Plausibilisierungsfehler Versottung" VALUE 0xE8BCE Kw_Wu16 1000.000 Time_ms 0.00 1000.000 FORMAT "%8.3" EXTENDED_LIMITS 0.00 655350.0 /end CHARACTERISTIC
/begin CHARACTERISTIC PFlt_DebRgnPermMaxDef_C "Entprellzeit setzen permanente Regeneration" VALUE 0xE8BD0 Kw_Wu16 1000.000 Time_ms 0.00 1000.000 FORMAT "%8.3" EXTENDED_LIMITS 0.00 655350.0 /end CHARACTERISTIC
/begin CHARACTERISTIC PFlt_DebRgnPermMaxOk_C "Entprellzeit heilen permanente Regeneration" VALUE 0xE8BD2 Kw_Wu16 1000.000 Time_ms 0.00 1000.000 FORMAT "%8.3" EXTENDED_LIMITS 0.00 655350.0 /end CHARACTERISTIC
/begin CHARACTERISTIC PFlt_tiDebSimOff_C "Entprellzeit Umschaltung Simulation/Messung" VALUE 0xE8B2A Kw_Wu16 20.00000 TimeDeb 0.00 20.00000 FORMAT "%8.5" EXTENDED_LIMITS 0.00 655350.0 /end CHARACTERISTIC
/begin CHARACTERISTIC PFlt_tiDebSimOn_C "Entprellzeit Umschaltung Messung/ Simulation" VALUE 0xE8B2C Kw_Wu16 20.00000 TimeDeb 0.00 20.00000 FORMAT "%8.5" EXTENDED_LIMITS 0.00 655350.0 /end CHARACTERISTIC
/begin CHARACTERISTIC PFlt_DebTEGMaxDef_C "Entprellzeit setzen Temperatursensoren SRC high" VALUE 0xE8BD4 Kw_Wu16 1000.000 Time_ms 0.00 1000.000 FORMAT "%8.3" EXTENDED_LIMITS 0.00 655350.0 /end CHARACTERISTIC
/begin CHARACTERISTIC PFlt_DebTEGMaxOk_C "Entprellzeit heilen Temperatursensoren SRC high" VALUE 0xE8BD6 Kw_Wu16 1000.000 Time_ms 0.00 1000.000 FORMAT "%8.3" EXTENDED_LIMITS 0.00 655350.0 /end CHARACTERISTIC
/begin CHARACTERISTIC PFlt_DebTEGMinDef_C "Entprellzeit setzen Temperatursensoren SRC low" VALUE 0xE8BD8 Kw_Wu16 1000.000 Time_ms 0.00 1000.000 FORMAT "%8.3" EXTENDED_LIMITS 0.00 655350.0 /end CHARACTERISTIC
/begin CHARACTERISTIC PFlt_DebTEGMinOk_C "Entprellzeit heilen Temperatursensoren SRC low" VALUE 0xE8BDA Kw_Wu16 1000.000 Time_ms 0.00 1000.000 FORMAT "%8.3" EXTENDED_LIMITS 0.00 655350.0 /end CHARACTERISTIC
/begin CHARACTERISTIC PFlt_tiDelOfsCalc_C "Verzögerungszeit zur Berechnung des Differenzdrucksensoroffsets im Motornachlauf" VALUE 0xE8BDC Kw_Wu16 99.30000 Time_s 0.7000000 100.0000 FORMAT "%8.4" EXTENDED_LIMITS 0.00 655.3500 /end CHARACTERISTIC
/begin CHARACTERISTIC PFlt_tiEngSpdPT1_C "Filterzeitkonst. für Eng_nAvrg PT1 filter" VALUE 0xE7EC0 Kw_Wu32 4294.9673 TimeDelay_s 0.0000010000000 4294.9673 FORMAT "%9.4" /end CHARACTERISTIC
/begin CHARACTERISTIC PFlt_tiExhGsDel_CUR "Abgasstromverzögerung" CURVE 0xE8F6E Kl_Xs16_Ws16 10.010579 TimeDelay_s 0.0010000001 10.011579 FORMAT "%9.6" EXTENDED_LIMITS 0.13107600 4294.9673
 /begin AXIS_DESCR STD_AXIS PFlt_dmEG AirMassPerTime 8 -1000.000 1000.000 FORMAT "%8.3" EXTENDED_LIMITS -3276.800 3276.700 DEPOSIT ABSOLUTE /end AXIS_DESCR
/end CHARACTERISTIC
/begin CHARACTERISTIC PFlt_tiHtTransDT1_CUR "Wärmeübertragungszeit" CURVE 0xE8F90 Kl_Xs16_Ws16 2147.4826 TimeDelay_s 0.0010000001 2147.4836 FORMAT "%9.4" EXTENDED_LIMITS 0.13107600 4294.9673
 /begin AXIS_DESCR STD_AXIS PFlt_dmEG AirMassPerTime 8 -1000.000 1000.000 FORMAT "%8.3" EXTENDED_LIMITS -3276.800 3276.700 DEPOSIT ABSOLUTE /end AXIS_DESCR
/end CHARACTERISTIC
/begin CHARACTERISTIC PFlt_tiInjMsPT1_C "Filterzeitkonst. für InjCtl_qSet PT1 filter" VALUE 0xE7EC4 Kw_Wu32 4294.9673 TimeDelay_s 0.0000010000000 4294.9673 FORMAT "%9.4" /end CHARACTERISTIC
/begin CHARACTERISTIC PFlt_tiLckChkTempPlaus_C "Verriegelungszeit Temperatursensorplausibilisierung nach kurzem Motorlauf" VALUE 0xE8BDE Kw_Wu16 50.00000 Time_s 50.00000 100.0000 FORMAT "%8.4" EXTENDED_LIMITS 0.00 655.3500 /end CHARACTERISTIC
/begin CHARACTERISTIC PFlt_tIncrDwnStrm_C "Korrekturwert Erwärmung zweite Abgastemperatur zur Überwachung" VALUE 0xE8BE0 Kw_Ws16 300.0000 TempDiff_Cels 0.00 300.0000 FORMAT "%8.4" EXTENDED_LIMITS -3276.800 3276.700 /end CHARACTERISTIC
/begin CHARACTERISTIC PFlt_tIncrUpStrm_C "Korrekturwert Erwärmung erste Abgastemperatur zur Überwachung" VALUE 0xE8BE2 Kw_Ws16 300.0000 TempDiff_Cels 0.00 300.0000 FORMAT "%8.4" EXTENDED_LIMITS -3276.800 3276.700 /end CHARACTERISTIC
/begin CHARACTERISTIC PFlt_tiPPrePT1_C "Filterzeitkonstante für gefilterten Absolutdruck vor Partikelfilter" VALUE 0xE8CA0 Kw_Wu32 99.582970 TimeDelay_s 0.29999073 99.882960 FORMAT "%9.5" EXTENDED_LIMITS 0.0000010000000 4294.9673 /end CHARACTERISTIC
/begin CHARACTERISTIC PFlt_tiFltHsLnPT1_C "Filterzeitkonstante Signalfilterung für Schlauchleitungsüberwachung" VALUE 0xE8BE4 Kw_Wu32 4294.9673 TimeDelay_s 0.0000010000000 4294.9673 FORMAT "%9.4" /end CHARACTERISTIC
/begin CHARACTERISTIC PFlt_tiResFlowPT1_C "Zeitkonstante für Strömungswiderstand" VALUE 0xE8B30 Kw_Wu32 4294.9673 TimeDelay_s 0.0000010000000 4294.9673 FORMAT "%9.4" /end CHARACTERISTIC
/begin CHARACTERISTIC PFlt_tiResFlowRgnPT1_C "Zeitkonstant des PT1-Filters für den Stömungswiederstand in Regenerationsbetrieb" VALUE 0xE8B34 Kw_Wu32 4294.9673 TimeDelay_s 0.0000010000000 4294.9673 FORMAT "%9.4" /end CHARACTERISTIC
/begin CHARACTERISTIC PFlt_tiSpdVehPT1_C "Filterzeitkonst. für VSSCD_v PT1 filter" VALUE 0xE7EC8 Kw_Wu32 4294.9673 TimeDelay_s 0.0000010000000 4294.9673 FORMAT "%9.4" /end CHARACTERISTIC
/begin CHARACTERISTIC PFlt_tiTempClntPT1_C "Filterzeitkonst. für CTSCD_tClntPT1 filter" VALUE 0xE7ECC Kw_Wu32 4294.9673 TimeDelay_s 0.0000010000000 4294.9673 FORMAT "%9.4" /end CHARACTERISTIC
/begin CHARACTERISTIC PFlt_tiTempOxiPrePT1_C "Filterzeitkonst. für OxiCCD_tPre  PT1 filter" VALUE 0xE7ED0 Kw_Wu32 4294.9673 TimeDelay_s 0.0000010000000 4294.9673 FORMAT "%9.4" /end CHARACTERISTIC
/begin CHARACTERISTIC PFlt_tiTempPrePT1_C "Filterzeitkonst. für PFlt_tPre PT1 filter" VALUE 0xE7ED4 Kw_Wu32 4294.9673 TimeDelay_s 0.0000010000000 4294.9673 FORMAT "%9.4" /end CHARACTERISTIC
/begin CHARACTERISTIC PFlt_tiVolFlowPT1_C "Zeitkonstant des PT1-Filers für Abgasvolumenstom" VALUE 0xE8B38 Kw_Wu32 4294.9673 TimeDelay_s 0.0000010000000 4294.9673 FORMAT "%9.4" /end CHARACTERISTIC
/begin CHARACTERISTIC PFlt_tiVolFlowRgnPT1_C "Zeitkonstant des PT1-Filers für Abgasvolumenstom in Regeneration" VALUE 0xE8B3C Kw_Wu32 4294.9673 TimeDelay_s 0.0000010000000 4294.9673 FORMAT "%9.4" /end CHARACTERISTIC
/begin CHARACTERISTIC PFlt_tOxiPreOffMinMax_CA "Matrix zur Bestimmung der Bereichsgrenzen für die gefilterte Abgastemperatur vor Oxidationskatalysator bei inaktivem Bereich" MAP 0xE7ED8 Kf_Xs16_Ys16_Ws16 950.000 Temp_Cels -50.140 899.860 FORMAT "%8.3" EXTENDED_LIMITS -3549.940 3003.560
 /begin AXIS_DESCR STD_AXIS PFlt_RngIdx_X_mp OneToOne 11 0.00 10.00 FORMAT "%5.2" EXTENDED_LIMITS 0.00 255.0 DEPOSIT ABSOLUTE /end AXIS_DESCR
 /begin AXIS_DESCR STD_AXIS PFlt_RngIdx_Y_mp OneToOne 2 0.00 1.000 FORMAT "%5.3" EXTENDED_LIMITS 0.00 255.0 DEPOSIT ABSOLUTE /end AXIS_DESCR
/end CHARACTERISTIC
/begin CHARACTERISTIC PFlt_tOxiPreOnMinMax_CA "Matrix zur Bestimmung der Bereichsgrenzen für die gefilterte Abgastemperatur vor Oxidationskatalysator bei aktivem Bereich" MAP 0xE7F22 Kf_Xs16_Ys16_Ws16 950.000 Temp_Cels -50.140 899.860 FORMAT "%8.3" EXTENDED_LIMITS -3549.940 3003.560
 /begin AXIS_DESCR STD_AXIS PFlt_RngIdx_X_mp OneToOne 11 0.00 10.00 FORMAT "%5.2" EXTENDED_LIMITS 0.00 255.0 DEPOSIT ABSOLUTE /end AXIS_DESCR
 /begin AXIS_DESCR STD_AXIS PFlt_RngIdx_Y_mp OneToOne 2 0.00 1.000 FORMAT "%5.3" EXTENDED_LIMITS 0.00 255.0 DEPOSIT ABSOLUTE /end AXIS_DESCR
/end CHARACTERISTIC
/begin CHARACTERISTIC PFlt_tiOxiPreStyPT1_C " Zeitkonstant des PT1-Gliedes für stationäre Abgastemperatur vor dem Oxi-Kat" VALUE 0xE8FB4 Kw_Wu32 4294.9673 TimeDelay_s 0.0000010000000 4294.9673 FORMAT "%9.4" /end CHARACTERISTIC
/begin CHARACTERISTIC PFlt_tPreOffMinMax_CA "Matrix zur Bestimmung der Bereichsgrenzen für die gefilterte Abgastemperatur vor Partikelfilter bei inaktivem Bereich" MAP 0xE7F6C Kf_Xs16_Ys16_Ws16 950.000 Temp_Cels -50.140 899.860 FORMAT "%8.3" EXTENDED_LIMITS -3549.940 3003.560
 /begin AXIS_DESCR STD_AXIS PFlt_RngIdx_X_mp OneToOne 11 0.00 10.00 FORMAT "%5.2" EXTENDED_LIMITS 0.00 255.0 DEPOSIT ABSOLUTE /end AXIS_DESCR
 /begin AXIS_DESCR STD_AXIS PFlt_RngIdx_Y_mp OneToOne 2 0.00 1.000 FORMAT "%5.3" EXTENDED_LIMITS 0.00 255.0 DEPOSIT ABSOLUTE /end AXIS_DESCR
/end CHARACTERISTIC
/begin CHARACTERISTIC PFlt_tPreOnMinMax_CA "Matrix zur Bestimmung der Bereichsgrenzen für die gefilterte Abgastemperatur vor Partikelfilter bei aktivem Bereich" MAP 0xE7FB6 Kf_Xs16_Ys16_Ws16 950.000 Temp_Cels -50.140 899.860 FORMAT "%8.3" EXTENDED_LIMITS -3549.940 3003.560
 /begin AXIS_DESCR STD_AXIS PFlt_RngIdx_X_mp OneToOne 11 0.00 10.00 FORMAT "%5.2" EXTENDED_LIMITS 0.00 255.0 DEPOSIT ABSOLUTE /end AXIS_DESCR
 /begin AXIS_DESCR STD_AXIS PFlt_RngIdx_Y_mp OneToOne 2 0.00 1.000 FORMAT "%5.3" EXTENDED_LIMITS 0.00 255.0 DEPOSIT ABSOLUTE /end AXIS_DESCR
/end CHARACTERISTIC
/begin CHARACTERISTIC PFlt_tiFltTempPT1_C "Filterzeitkonstante für Oberflächentemperatursimulation" VALUE 0xE8FB8 Kw_Wu32 4294.9673 TimeDelay_s 0.0000010000000 4294.9673 FORMAT "%9.4" /end CHARACTERISTIC
/begin CHARACTERISTIC PFlt_tiPreStyPT1_C "Zeitkonstant des PT1-Gliedes für stationäre Abgastemperatur vor dem Partikelfilter" VALUE 0xE8FBC Kw_Wu32 4294.9673 TimeDelay_s 0.0000010000000 4294.9673 FORMAT "%9.4" /end CHARACTERISTIC
/begin CHARACTERISTIC PFlt_tRefSty_C "Referenztemperatur für das Festlegen des Abgastemperaturenkennfeldes" VALUE 0xE8FC0 Kw_Ws16 250.0000 Temp_Cels -50.1400 199.8600 FORMAT "%8.4" EXTENDED_LIMITS -3549.940 3003.560 /end CHARACTERISTIC
/begin CHARACTERISTIC PFlt_tUpStrmTolcMax_C "Maximal zulässige Toleranz bei Plausibilisierung des ersten Abgastemperatursensors" VALUE 0xE8BE8 Kw_Ws16 250.2000 TempDiff_Cels -50.10000 200.1000 FORMAT "%8.4" EXTENDED_LIMITS -3276.800 3276.700 /end CHARACTERISTIC
/begin CHARACTERISTIC PFlt_uBattMinMax_CA "Matrix zur Bestimmung der Bereichsgrenzen für das gefilterte Batteriespannungssignal" MAP 0xE8000 Kf_Xs16_Ys16_Ws16 28602.15 Volt_Batt 0.00 28602.15 FORMAT "%8.2" EXTENDED_LIMITS -640625.6 640606.1
 /begin AXIS_DESCR STD_AXIS PFlt_RngIdx_X_mp OneToOne 11 0.00 10.00 FORMAT "%5.2" EXTENDED_LIMITS 0.00 255.0 DEPOSIT ABSOLUTE /end AXIS_DESCR
 /begin AXIS_DESCR STD_AXIS PFlt_RngIdx_Y_mp OneToOne 2 0.00 1.000 FORMAT "%5.3" EXTENDED_LIMITS 0.00 255.0 DEPOSIT ABSOLUTE /end AXIS_DESCR
/end CHARACTERISTIC
/begin CHARACTERISTIC PFlt_volPFlt_C "Volumen des Partikel Filters" VALUE 0xE8B40 Kw_Wu16 99.99000 Vol 0.01000000 100.0000 FORMAT "%8.4" EXTENDED_LIMITS 0.00 655.3500 /end CHARACTERISTIC
/begin CHARACTERISTIC PFlt_vVehMinMax_CA "Matrix zur Bestimmung der Bereichsgrenzen für die gefilterte Fahrgeschwindigkeit" MAP 0xE804A Kf_Xs16_Ys16_Ws16 300.0000 Vel 0.00 300.0000 FORMAT "%8.4" EXTENDED_LIMITS -327.6800 327.6700
 /begin AXIS_DESCR STD_AXIS PFlt_RngIdx_X_mp OneToOne 11 0.00 10.00 FORMAT "%5.2" EXTENDED_LIMITS 0.00 255.0 DEPOSIT ABSOLUTE /end AXIS_DESCR
 /begin AXIS_DESCR STD_AXIS PFlt_RngIdx_Y_mp OneToOne 2 0.00 1.000 FORMAT "%5.3" EXTENDED_LIMITS 0.00 255.0 DEPOSIT ABSOLUTE /end AXIS_DESCR
/end CHARACTERISTIC
/begin CHARACTERISTIC PFlt_vVehUnFltMinMax_CA "Matrix (min/max Grenzen)für ungefilterte Fahrgeschwindigkeit" MAP 0xE8094 Kf_Xs16_Ys16_Ws16 300.0000 Vel 0.00 300.0000 FORMAT "%8.4" EXTENDED_LIMITS -327.6800 327.6700
 /begin AXIS_DESCR STD_AXIS PFlt_RngIdxPrj_X_mp OneToOne 11 0.00 10.00 FORMAT "%5.2" EXTENDED_LIMITS 0.00 255.0 DEPOSIT ABSOLUTE /end AXIS_DESCR
 /begin AXIS_DESCR STD_AXIS PFlt_RngIdxPrj_Y_mp OneToOne 2 0.00 1.000 FORMAT "%5.3" EXTENDED_LIMITS 0.00 255.0 DEPOSIT ABSOLUTE /end AXIS_DESCR
/end CHARACTERISTIC
/begin CHARACTERISTIC PrpCtl_SpdLim4IKi_C "Regler I-Anteil 4. Gang" VALUE 0xE9300 Kw_Wu32 19999999.9953 Ki_Vel2TrqPrp 0.00 19999999.9953 FORMAT "%13.4" /end CHARACTERISTIC
/begin CHARACTERISTIC PrpCtl_SpdLim4IKiPos_C "Regler I-Anteil für positive Großsignale 4. Gang" VALUE 0xE9304 Kw_Wu32 19999999.9953 Ki_Vel2TrqPrp 0.00 19999999.9953 FORMAT "%13.4" /end CHARACTERISTIC
/begin CHARACTERISTIC PrpCtl_SpdLim4IKiNeg_C "Regler I-Anteil für negative Großsignale 4. Gang" VALUE 0xE9308 Kw_Wu32 19999999.9953 Ki_Vel2TrqPrp 0.00 19999999.9953 FORMAT "%13.4" /end CHARACTERISTIC
/begin CHARACTERISTIC PrpCtl_vSpdLim4IWinPos_C "obere Fenstergrenze für I-Anteil Kleinsignale 4.Gang" VALUE 0xE930C Kw_Ws16 300.0000 Vel 0.00 300.0000 FORMAT "%8.4" EXTENDED_LIMITS -327.6800 327.6700 /end CHARACTERISTIC
/begin CHARACTERISTIC PrpCtl_vSpdLim4IWinNeg_C "untere Fenstergrenze für I-Anteil Kleinsignale 4.Gang" VALUE 0xE930E Kw_Ws16 300.0000 Vel -300.0000 0.00 FORMAT "%8.4" EXTENDED_LIMITS -327.6800 327.6700 /end CHARACTERISTIC
/begin CHARACTERISTIC PrpCtl_SpdLim4PKp_C "Regler P-Anteil 4. Gang" VALUE 0xE9310 Kw_Wu32 1310719.99969 Kp_Vel2TrqPrp 0.00 1310719.99969 FORMAT "%13.5" /end CHARACTERISTIC
/begin CHARACTERISTIC PrpCtl_SpdLim4PKpPos_C "Regler P-Anteil für positive Großsignale 4. Gang" VALUE 0xE9314 Kw_Wu32 1310719.99969 Kp_Vel2TrqPrp 0.00 1310719.99969 FORMAT "%13.5" /end CHARACTERISTIC
/begin CHARACTERISTIC PrpCtl_SpdLim4PKpNeg_C "Regler P-Anteil für negative Großsignale 4. Gang" VALUE 0xE9318 Kw_Wu32 1310719.99969 Kp_Vel2TrqPrp 0.00 1310719.99969 FORMAT "%13.5" /end CHARACTERISTIC
/begin CHARACTERISTIC PrpCtl_vSpdLim4PWinPos_C "obere Fenstergrenze für P-Anteil Kleinsignale 4.Gang" VALUE 0xE931C Kw_Ws16 300.0000 Vel 0.00 300.0000 FORMAT "%8.4" EXTENDED_LIMITS -327.6800 327.6700 /end CHARACTERISTIC
/begin CHARACTERISTIC PrpCtl_vSpdLim4PWinNeg_C "untere Fenstergrenze für P-Anteil Kleinsignale 4.Gang" VALUE 0xE931E Kw_Ws16 300.0000 Vel -300.0000 0.00 FORMAT "%8.4" EXTENDED_LIMITS -327.6800 327.6700 /end CHARACTERISTIC
/begin CHARACTERISTIC PrpCtl_SpdLim5IKi_C "Regler I-Anteil 5. Gang" VALUE 0xE9320 Kw_Wu32 19999999.9953 Ki_Vel2TrqPrp 0.00 19999999.9953 FORMAT "%13.4" /end CHARACTERISTIC
/begin CHARACTERISTIC PrpCtl_SpdLim5IKiPos_C "Regler I-Anteil für positive Großsignale 5. Gang" VALUE 0xE9324 Kw_Wu32 19999999.9953 Ki_Vel2TrqPrp 0.00 19999999.9953 FORMAT "%13.4" /end CHARACTERISTIC
/begin CHARACTERISTIC PrpCtl_SpdLim5IKiNeg_C "Regler I-Anteil für negative Großsignale 5. Gang" VALUE 0xE9328 Kw_Wu32 19999999.9953 Ki_Vel2TrqPrp 0.00 19999999.9953 FORMAT "%13.4" /end CHARACTERISTIC
/begin CHARACTERISTIC PrpCtl_vSpdLim5IWinPos_C "obere Fenstergrenze für I-Anteil Kleinsignale 5.Gang" VALUE 0xE932C Kw_Ws16 300.0000 Vel 0.00 300.0000 FORMAT "%8.4" EXTENDED_LIMITS -327.6800 327.6700 /end CHARACTERISTIC
/begin CHARACTERISTIC PrpCtl_vSpdLim5IWinNeg_C "untere Fenstergrenze für I-Anteil Kleinsignale 5.Gang" VALUE 0xE932E Kw_Ws16 300.0000 Vel -300.0000 0.00 FORMAT "%8.4" EXTENDED_LIMITS -327.6800 327.6700 /end CHARACTERISTIC
/begin CHARACTERISTIC PrpCtl_SpdLim5PKp_C "Regler P-Anteil 5. Gang" VALUE 0xE9330 Kw_Wu32 1310719.99969 Kp_Vel2TrqPrp 0.00 1310719.99969 FORMAT "%13.5" /end CHARACTERISTIC
/begin CHARACTERISTIC PrpCtl_SpdLim5PKpPos_C "Regler P-Anteil für positive Großsignale 5. Gang" VALUE 0xE9334 Kw_Wu32 1310719.99969 Kp_Vel2TrqPrp 0.00 1310719.99969 FORMAT "%13.5" /end CHARACTERISTIC
/begin CHARACTERISTIC PrpCtl_SpdLim5PKpNeg_C "Regler P-Anteil für negative Großsignale 5. Gang" VALUE 0xE9338 Kw_Wu32 1310719.99969 Kp_Vel2TrqPrp 0.00 1310719.99969 FORMAT "%13.5" /end CHARACTERISTIC
/begin CHARACTERISTIC PrpCtl_vSpdLim5PWinPos_C "obere Fenstergrenze für P-Anteil Kleinsignale 5.Gang" VALUE 0xE933C Kw_Ws16 300.0000 Vel 0.00 300.0000 FORMAT "%8.4" EXTENDED_LIMITS -327.6800 327.6700 /end CHARACTERISTIC
/begin CHARACTERISTIC PrpCtl_vSpdLim5PWinNeg_C "untere Fenstergrenze für P-Anteil Kleinsignale 5.Gang" VALUE 0xE933E Kw_Ws16 300.0000 Vel -300.0000 0.00 FORMAT "%8.4" EXTENDED_LIMITS -327.6800 327.6700 /end CHARACTERISTIC
/begin CHARACTERISTIC PrpCtl_tiSpdLimPT1_C "Zeitkonstante PT1-Glied" VALUE 0xE9340 Kw_Wu32 4294.9673 TimeDelay_s 0.0000010000000 4294.9673 FORMAT "%9.4" /end CHARACTERISTIC
/begin CHARACTERISTIC PrpCtl_swtSpdLimVal_C "Datensatzwert für PrpCtl_swtSpdLim für Activierung (1) oder Deaktivierung (0) der Geschwindigkeitsbegrenzung" VALUE 0xE9344 Kw_Wu8 1.000 OneToOne 0.00 1.000 FORMAT "%5.3" EXTENDED_LIMITS 0.00 255.0 /end CHARACTERISTIC
/begin CHARACTERISTIC PrpCtl_swtSpdLimType_C "Auswahlschalter für PrpCtl_swtSpdLim bei Ini: E2PROM(1) oder PrpCtl_swtSpdLimVal_C(2)" VALUE 0xE9345 Kw_Wu8 1.000 OneToOne 1.000 2.000 FORMAT "%5.3" EXTENDED_LIMITS 0.00 255.0 /end CHARACTERISTIC
/begin CHARACTERISTIC PrpCtl_vSpdLimMax_C "Fahrzeughöchstgeschwindigkeit" VALUE 0xE9346 Kw_Ws16 300.0000 Vel 0.00 300.0000 FORMAT "%8.4" EXTENDED_LIMITS -327.6800 327.6700 /end CHARACTERISTIC
/begin CHARACTERISTIC PrpCtl_vSpdLimThreshFree_C "Schwellwert Sollwertnachführung frei laufend" VALUE 0xE9348 Kw_Ws16 300.0000 Vel 0.00 300.0000 FORMAT "%8.4" EXTENDED_LIMITS -327.6800 327.6700 /end CHARACTERISTIC
/begin CHARACTERISTIC PrpCtl_vSpdLimThreshOff_C "Schwellwert Sollwertnachführung ausgeschalten" VALUE 0xE934A Kw_Ws16 300.0000 Vel 0.00 300.0000 FORMAT "%8.4" EXTENDED_LIMITS -327.6800 327.6700 /end CHARACTERISTIC
/begin CHARACTERISTIC PrpCtl_vSpdLimThreshOn_C "Schwellwert Sollwertnachführung eingeschalten" VALUE 0xE934C Kw_Ws16 300.0000 Vel 0.00 300.0000 FORMAT "%8.4" EXTENDED_LIMITS -327.6800 327.6700 /end CHARACTERISTIC
/begin CHARACTERISTIC Prp_rEng_MAP "inverses Fahrverhaltenkennfeld für konventionelle Triebstrangsteuerung" MAP 0xE9068 Kf_Xs16_Ys16_Ws16 799.9878 Prc -400.0000 399.9878 FORMAT "%8.4"
 /begin AXIS_DESCR STD_AXIS Eng_nAvrg EngN 16 -32768.00 32767.00 FORMAT "%8.2" DEPOSIT ABSOLUTE /end AXIS_DESCR
 /begin AXIS_DESCR STD_AXIS Prp_trqEng Trq 16 -3276.800 3276.700 FORMAT "%8.3" DEPOSIT ABSOLUTE /end AXIS_DESCR
/end CHARACTERISTIC
/begin CHARACTERISTIC Prp_rPrp_MAP "inverses Fahrverhaltenkennfeld für Mastershift" MAP 0xE92AC Kf_Xs16_Ys16_Ws16 799.9878 Prc -400.0000 399.9878 FORMAT "%8.4"
 /begin AXIS_DESCR STD_AXIS VSSCD_v Vel 1 -327.6800 327.6700 FORMAT "%8.4" DEPOSIT ABSOLUTE /end AXIS_DESCR
 /begin AXIS_DESCR STD_AXIS Prp_trqPrp TrqPrp 1 -6553.600 6553.400 FORMAT "%8.3" DEPOSIT ABSOLUTE /end AXIS_DESCR
/end CHARACTERISTIC
/begin CHARACTERISTIC Prp_trqThresEng_CUR "Schwellwert-Kennlinie zur Unterscheidung zwischen Zug- und Schubbetrieb" CURVE 0xE92B6 Kl_Xs16_Ws16 300.0000 TrqPrp 0.00 300.0000 FORMAT "%8.4" EXTENDED_LIMITS -6553.600 6553.400
 /begin AXIS_DESCR STD_AXIS Eng_nAvrg EngN 16 0.00 6000.000 FORMAT "%8.3" EXTENDED_LIMITS -32768.00 32767.00 DEPOSIT ABSOLUTE /end AXIS_DESCR
/end CHARACTERISTIC
/begin CHARACTERISTIC Prp_trqThresPrp_CUR "Schwellwert-Kennlinie zur Unterscheidung zwischen Zug- und Schubbetrieb" CURVE 0xE92F8 Kl_Xs16_Ws16 300.0000 TrqPrp 0.00 300.0000 FORMAT "%8.4" EXTENDED_LIMITS -6553.600 6553.400
 /begin AXIS_DESCR STD_AXIS VSSCD_v Vel 1 0.00 300.0000 FORMAT "%8.4" EXTENDED_LIMITS -327.6800 327.6700 DEPOSIT ABSOLUTE /end AXIS_DESCR
/end CHARACTERISTIC
/begin CHARACTERISTIC PSPCD_dvolBase_CUR "Curve to calculate the fuel quantity consumption based on the Engine Speed" CURVE 0xE9350 Kl_Xs16_Ws16 100.0000 FlConsum_l_h 0.00 100.0000 FORMAT "%8.4" EXTENDED_LIMITS -327.6800 327.6700
 /begin AXIS_DESCR STD_AXIS Eng_nAvrg EngN 16 0.00 6000.000 FORMAT "%8.3" EXTENDED_LIMITS -32768.00 32767.00 DEPOSIT ABSOLUTE /end AXIS_DESCR
/end CHARACTERISTIC
/begin CHARACTERISTIC PSPCD_dvolMax_C "Maximum limit of fuel consumption quantity" VALUE 0xE9392 Kw_Ws16 100.0000 FlConsum_l_h 0.00 100.0000 FORMAT "%8.4" EXTENDED_LIMITS -327.6800 327.6700 /end CHARACTERISTIC
/begin CHARACTERISTIC PSPCD_dvolMin_C "Minimum limit of the  fuel consumption quantity" VALUE 0xE9394 Kw_Ws16 100.0000 FlConsum_l_h 0.00 100.0000 FORMAT "%8.4" EXTENDED_LIMITS -327.6800 327.6700 /end CHARACTERISTIC
/begin CHARACTERISTIC PSPCD_dvolOut1_C "output fuel quantity incase of T15 changes from FALSE to TRUE" VALUE 0xE9396 Kw_Ws16 100.0000 FlConsum_l_h 0.00 100.0000 FORMAT "%8.4" EXTENDED_LIMITS -327.6800 327.6700 /end CHARACTERISTIC
/begin CHARACTERISTIC PSPCD_dvolTempLim_MAP "Map for limiting value of fuel depending on engine speed and fuel temperature" MAP 0xE9398 Kf_Xs16_Ys16_Ws16 100.0000 FlConsum_l_h 0.00 100.0000 FORMAT "%8.4" EXTENDED_LIMITS -327.6800 327.6700
 /begin AXIS_DESCR STD_AXIS Eng_nAvrg EngN 6 40.00000 6000.000 FORMAT "%8.3" EXTENDED_LIMITS -32768.00 32767.00 DEPOSIT ABSOLUTE /end AXIS_DESCR
 /begin AXIS_DESCR STD_AXIS FTSCD_tFuel Temp_Cels 6 -50.14000 199.8600 FORMAT "%8.4" EXTENDED_LIMITS -3549.940 3003.560 DEPOSIT ABSOLUTE /end AXIS_DESCR
/end CHARACTERISTIC
/begin CHARACTERISTIC PSPCD_facFTSCor_CUR "Curve to calculate the factor based on the Fuel temperature" CURVE 0xE93FC Kl_Xs16_Ws16 50.00000 Fact1 0.00 50.00000 FORMAT "%8.5" EXTENDED_LIMITS -256.0000 255.9922
 /begin AXIS_DESCR STD_AXIS FTSCD_tFuel Temp_Cels 8 -50.14000 199.8600 FORMAT "%8.4" EXTENDED_LIMITS -3549.940 3003.560 DEPOSIT ABSOLUTE /end AXIS_DESCR
/end CHARACTERISTIC
/begin CHARACTERISTIC PSPCD_nLim_C "Threshold value for engine speed" VALUE 0xE941E Kw_Ws16 5960.000 EngN 40.00000 6000.000 FORMAT "%8.3" EXTENDED_LIMITS -32768.00 32767.00 /end CHARACTERISTIC
/begin CHARACTERISTIC PSPCD_tiT15Delay_CUR "curve for calculation of time till which timer should run from the coolant temperature" CURVE 0xE9420 Kl_Xs16_Ws16 10000.00 Time_ms 0.00 10000.00 FORMAT "%8.2" EXTENDED_LIMITS -327680.0 327670.0
 /begin AXIS_DESCR STD_AXIS CTSCD_tClnt Temp_Cels 16 -50.14000 199.8600 FORMAT "%8.4" EXTENDED_LIMITS -3549.940 3003.560 DEPOSIT ABSOLUTE /end AXIS_DESCR
/end CHARACTERISTIC
/begin CHARACTERISTIC QLTCD_stCntErr_C "" VALUE 0xE9462 Kw_Wu8 255.0 OneToOne 0.00 255.0 FORMAT "%5.1" /end CHARACTERISTIC
/begin CHARACTERISTIC QLTCD_tiDebDefect_C "" VALUE 0xE9464 Kw_Wu16 655350.0 Time_ms 0.00 655350.0 FORMAT "%8.1" /end CHARACTERISTIC
/begin CHARACTERISTIC QLTCD_tiDebOk_C "" VALUE 0xE9466 Kw_Wu16 655350.0 Time_ms 0.00 655350.0 FORMAT "%8.1" /end CHARACTERISTIC
/begin CHARACTERISTIC QLTCD_tiOutput_C "" VALUE 0xE9468 Kw_Wu16 1980.000 Time_ms 20.00000 2000.000 FORMAT "%8.3" EXTENDED_LIMITS 0.00 655350.0 /end CHARACTERISTIC
/begin CHARACTERISTIC QLTCD_tiReset_C "" VALUE 0xE946A Kw_Wu16 1980.000 Time_ms 20.00000 2000.000 FORMAT "%8.3" EXTENDED_LIMITS 0.00 655350.0 /end CHARACTERISTIC
/begin CHARACTERISTIC QLTCD_tiWaitDetection_C "" VALUE 0xE946C Kw_Wu16 655350.0 Time_ms 0.00 655350.0 FORMAT "%8.1" /end CHARACTERISTIC
/begin CHARACTERISTIC RailCD_uSRCMin_C "#SSD SRC-Minimum Vorgabewert" VALUE 0xEB694 Kw_Ws16 5200.391 Volt 0.00 5200.391 FORMAT "%8.3" EXTENDED_LIMITS -160156.4 160151.5 /end CHARACTERISTIC
/begin CHARACTERISTIC RailCD_uSRCMax_C "#SSD SRC-Maximum Vorgabewert" VALUE 0xEB696 Kw_Ws16 5200.391 Volt 0.00 5200.391 FORMAT "%8.3" EXTENDED_LIMITS -160156.4 160151.5 /end CHARACTERISTIC
/begin CHARACTERISTIC RailCD_pLin_CUR "#SSD Linearisierungskennlinie für Kraftstoffdrucksensor" CURVE 0xEB698 Kl_Xs16_Ws16 2000.000 Pres_Rail 0.00 2000.000 FORMAT "%5.3" EXTENDED_LIMITS -3276.800 3276.700
 /begin AXIS_DESCR STD_AXIS RailCD_uPeakRaw Volt 4 0.00 5200.391 FORMAT "%8.3" EXTENDED_LIMITS -160156.4 160151.5 DEPOSIT ABSOLUTE /end AXIS_DESCR
/end CHARACTERISTIC
/begin CHARACTERISTIC RailCD_DebSRCHighDef_C "#SSD Kraftstoffdruck Fehlerentprellzeit SRC-High" VALUE 0xEB6AA Kw_Wu16 655350.0 Time_ms 0.00 655350.0 FORMAT "%8.1" /end CHARACTERISTIC
/begin CHARACTERISTIC RailCD_DebSRCHighOk_C "#SSD Kraftstoffdruck Heilungsentprellzeit SRC-High" VALUE 0xEB6AC Kw_Wu16 655350.0 Time_ms 0.00 655350.0 FORMAT "%8.1" /end CHARACTERISTIC
/begin CHARACTERISTIC RailCD_DebSRCLowDef_C "#SSD Kraftstoffdruck Fehlerentprellzeit SRC-Low" VALUE 0xEB6AE Kw_Wu16 655350.0 Time_ms 0.00 655350.0 FORMAT "%8.1" /end CHARACTERISTIC
/begin CHARACTERISTIC RailCD_DebSRCLowOk_C "#SSD Kraftstoffdruck Heilungsentprellzeit SRC-Low" VALUE 0xEB6B0 Kw_Wu16 655350.0 Time_ms 0.00 655350.0 FORMAT "%8.1" /end CHARACTERISTIC
/begin CHARACTERISTIC RailCD_nStrtLim_C "start phase speed  threshold" VALUE 0xEB710 Kw_Ws16 6000.000 EngN 0.00 6000.000 FORMAT "%8.3" EXTENDED_LIMITS -32768.00 32767.00 /end CHARACTERISTIC
/begin CHARACTERISTIC RAILCD_numAdc2_C "#SSD application parameter for Exhaust Temperature Sensor 1" VALUE 0xEB6B2 Kw_Wu8 44.0000000000 NumPinAdc 0.00 44.0000000000 FORMAT "%13.10" /end CHARACTERISTIC
/begin CHARACTERISTIC RAILCD_numAdc_C "#SSD application parameter for Rail pressure Sensor" VALUE 0xEB6B3 Kw_Wu8 44.0000000000 NumPinAdc 0.00 44.0000000000 FORMAT "%13.10" /end CHARACTERISTIC
/begin CHARACTERISTIC RailCD_pFltWinNeg_CUR "Raildruckabfall, ab welchem auf Großsignalparameter umgeschaltet wird" CURVE 0xEB6B4 Kl_Xs16_Ws16 6553.500 Pres_Rail -3276.800 3276.700 FORMAT "%5.3"
 /begin AXIS_DESCR STD_AXIS InjCtl_qSetUnBal InjMassCyc 10 -327.6800 327.6700 FORMAT "%8.4" DEPOSIT ABSOLUTE /end AXIS_DESCR
/end CHARACTERISTIC
/begin CHARACTERISTIC RailCD_pStrtLim_C "start phase Pressure threshold" VALUE 0xEB712 Kw_Ws16 2000.000 Pres_Rail 0.00 2000.000 FORMAT "%5.3" EXTENDED_LIMITS -3276.800 3276.700 /end CHARACTERISTIC
/begin CHARACTERISTIC RailCD_stRPSFlt_C "Funktionsweise der Raildruck-Spitzenwertermittlung im 10ms Raster" VALUE 0xEB6DE Kw_Wu8 1.000 OneToOne 0.00 1.000 FORMAT "%5.3" EXTENDED_LIMITS 0.00 255.0 /end CHARACTERISTIC
/begin CHARACTERISTIC RailCD_swtOfsTst_C "#SSD Schalter für Freigabe des Offset-Tests für den Raildrucksensor im Start oder Nachlauf" VALUE 0xEB6EC Kw_Wu8 3.000 OneToOne 0.00 3.000 FORMAT "%5.3" EXTENDED_LIMITS 0.00 255.0 /end CHARACTERISTIC
/begin CHARACTERISTIC RailCD_tiEvalDel_C "#SSD Verzögerungszeit zur Auswertung des Überwachungsergebnisses beim Offset-Tests für den Raildrucksensor" VALUE 0xEB6EE Kw_Wu16 655350.0 Time_ms 0.00 655350.0 FORMAT "%8.1" /end CHARACTERISTIC
/begin CHARACTERISTIC RailCD_tiFlt1PT1_C "PT1 Filterparameter für steigenden Raildruck" VALUE 0xEB6E0 Kw_Wu32 4294.9673 TimeDelay_s 0.0000010000000 4294.9673 FORMAT "%9.4" /end CHARACTERISTIC
/begin CHARACTERISTIC RailCD_tiFlt2PT1_C "PT1 Filterparameter für fallenden Raildruck (Kleinsignalverhalten)" VALUE 0xEB6E4 Kw_Wu32 4294.9673 TimeDelay_s 0.0000010000000 4294.9673 FORMAT "%9.4" /end CHARACTERISTIC
/begin CHARACTERISTIC RailCD_tiFlt3PT1_C "PT1 Filterparameter für stark fallenden Raildruck (Großsignalverhalten)" VALUE 0xEB6E8 Kw_Wu32 4294.9673 TimeDelay_s 0.0000010000000 4294.9673 FORMAT "%9.4" /end CHARACTERISTIC
/begin CHARACTERISTIC RailCD_tiOfsTstAftRun_C "#SSD Überwachungszeitraum des Offset-Tests für den Raildrucksensor im Nachlauf" VALUE 0xEB6F0 Kw_Wu16 655350.0 Time_ms 0.00 655350.0 FORMAT "%8.1" /end CHARACTERISTIC
/begin CHARACTERISTIC RailCD_tiOfsTstDel_CUR "Verzögerungszeit für Offset-Ueberwachung des Raildrucksensors" CURVE 0xEB6F2 Kl_Xs16_Ws16 5242.720 TimeRed 0.00 5242.720 FORMAT "%8.3" EXTENDED_LIMITS -5242.880 5242.720
 /begin AXIS_DESCR STD_AXIS RailCD_pPeak Pres_Rail 2 0.00 2000.000 FORMAT "%5.3" EXTENDED_LIMITS -3276.800 3276.700 DEPOSIT ABSOLUTE /end AXIS_DESCR
/end CHARACTERISTIC
/begin CHARACTERISTIC RailCD_tiOfsTstStrt_C "#SSD Überwachungszeitraum des Offset-Tests für den Raildrucksensor im Start" VALUE 0xEB6FC Kw_Wu16 655350.0 Time_ms 0.00 655350.0 FORMAT "%8.1" /end CHARACTERISTIC
/begin CHARACTERISTIC RailCD_tiPMonStrtLim_C "time duration  for error monitoring" VALUE 0xEB714 Kw_Wu32 10000.0000000 Time_ms 0.00 10000.0000000 FORMAT "%13.7" EXTENDED_LIMITS 0.00 42949672950.0 /end CHARACTERISTIC
/begin CHARACTERISTIC RailCD_tiStrErrDel_C "Timeout zur Speicherung des Überwachungsergebnisses beim Offset-Tests für den Raildrucksensor" VALUE 0xEB6FE Kw_Wu16 655350.0 Time_ms 0.00 655350.0 FORMAT "%8.1" /end CHARACTERISTIC
/begin CHARACTERISTIC RailCD_tOfsTstAftRun_C "Systemtemperaturschwelle zur Freigabe der Offset-Überwachung des Raildrucksensors im Nachlauf" VALUE 0xEB700 Kw_Ws16 250.0000 Temp_Cels -50.14000 199.8600 FORMAT "%8.4" EXTENDED_LIMITS -3549.940 3003.560 /end CHARACTERISTIC
/begin CHARACTERISTIC RailCD_tOfsTstDec_C "Wassertemperaturdifferenz 'Abkühlung' zur Freigabe der Offset-Überwachung des Raildrucksensors im Start" VALUE 0xEB702 Kw_Ws16 100.0000 TempDiff_Cels 0.00 100.0000 FORMAT "%8.4" EXTENDED_LIMITS -3276.800 3276.700 /end CHARACTERISTIC
/begin CHARACTERISTIC RailCD_tOfsTstInc_C "Wassertemperaturdifferenz 'Erwärmung' zur Freigabe der Offset-Überwachung des Raildrucksensors im Start" VALUE 0xEB704 Kw_Ws16 100.0000 TempDiff_Cels -100.0000 0.00 FORMAT "%8.4" EXTENDED_LIMITS -3276.800 3276.700 /end CHARACTERISTIC
/begin CHARACTERISTIC RailCD_tOfsTstStrt_C "Systemtemperaturschwelle zur Freigabe der Offset-Überwachung des Raildrucksensors im Start" VALUE 0xEB706 Kw_Ws16 250.0000 Temp_Cels -50.14000 199.8600 FORMAT "%8.4" EXTENDED_LIMITS -3549.940 3003.560 /end CHARACTERISTIC
/begin CHARACTERISTIC RailCD_uOfsAftRunMax_C "obere Offsetschwelle der Offset-Überwachung des Raildrucksensors im Nachlauf" VALUE 0xEB708 Kw_Ws16 5200.391 Volt 0.00 5200.391 FORMAT "%8.3" EXTENDED_LIMITS -160156.4 160151.5 /end CHARACTERISTIC
/begin CHARACTERISTIC RailCD_uOfsAftRunMin_C "untere Offsetschwelle der Offset-Überwachung des Raildrucksensors im Nachlauf" VALUE 0xEB70A Kw_Ws16 5200.391 Volt 0.00 5200.391 FORMAT "%8.3" EXTENDED_LIMITS -160156.4 160151.5 /end CHARACTERISTIC
/begin CHARACTERISTIC RailCD_uOfsStrtMax_C "obere Offsetschwelle der Offset-Überwachung des Raildrucksensors im Start" VALUE 0xEB70C Kw_Ws16 5200.391 Volt 0.00 5200.391 FORMAT "%8.3" EXTENDED_LIMITS -160156.4 160151.5 /end CHARACTERISTIC
/begin CHARACTERISTIC RailCD_uOfsStrtMin_C "untere Offsetschwelle der Offset-Überwachung des Raildrucksensors im Start" VALUE 0xEB70E Kw_Ws16 5200.391 Volt 0.00 5200.391 FORMAT "%8.3" EXTENDED_LIMITS -160156.4 160151.5 /end CHARACTERISTIC
/begin CHARACTERISTIC Rail_DebMeUn0MaxDef_C "#SSD Fehlerentprellzeit für Überwachung auf positive Regelabweichung" VALUE 0xE9966 Kw_Wu16 655350.0 Time_ms 0.00 655350.0 FORMAT "%8.1" /end CHARACTERISTIC
/begin CHARACTERISTIC Rail_DebMeUn0MaxOk_C "#SSD Heilungsentprellzeit für Überwachung auf positive Regelabweichung" VALUE 0xE9968 Kw_Wu16 655350.0 Time_ms 0.00 655350.0 FORMAT "%8.1" /end CHARACTERISTIC
/begin CHARACTERISTIC Rail_DebMeUn1MaxDef_C "#SSD Fehlerentprellzeit für Überwachung auf positive Regelabweichung und Sollwert des Volumenstroms durch die Zumesseinheit" VALUE 0xE996A Kw_Wu16 655350.0 Time_ms 0.00 655350.0 FORMAT "%8.1" /end CHARACTERISTIC
/begin CHARACTERISTIC Rail_DebMeUn1MaxOk_C "#SSD Heilungsentprellzeit für Überwachung auf positive Regelabweichung und Sollwert des Volumenstroms durch die Zumesseinheit" VALUE 0xE996C Kw_Wu16 655350.0 Time_ms 0.00 655350.0 FORMAT "%8.1" /end CHARACTERISTIC
/begin CHARACTERISTIC Rail_DebMeUn2MaxDef_C "#SSD Fehlerentprellzeit für negative Regelabweichung bei Nullförderung" VALUE 0xE996E Kw_Wu16 655350.0 Time_ms 0.00 655350.0 FORMAT "%8.1" /end CHARACTERISTIC
/begin CHARACTERISTIC Rail_DebMeUn2MaxOk_C "#SSD Heilungsentprellzeit für negative Regelabweichung bei Nullförderung" VALUE 0xE9970 Kw_Wu16 655350.0 Time_ms 0.00 655350.0 FORMAT "%8.1" /end CHARACTERISTIC
/begin CHARACTERISTIC Rail_DebMeUn3MaxDef_C "#SSD Fehlerentprellzeit für minimalen Raildruck" VALUE 0xE9972 Kw_Wu16 655350.0 Time_ms 0.00 655350.0 FORMAT "%8.1" /end CHARACTERISTIC
/begin CHARACTERISTIC Rail_DebMeUn3MaxOk_C "#SSD Heilungsentprellzeit für minimalen Raildruck" VALUE 0xE9974 Kw_Wu16 655350.0 Time_ms 0.00 655350.0 FORMAT "%8.1" /end CHARACTERISTIC
/begin CHARACTERISTIC Rail_DebMeUn4MaxDef_C "#SSD Fehlerentprellzeit für maximalen Raildruck" VALUE 0xE9976 Kw_Wu16 655350.0 Time_ms 0.00 655350.0 FORMAT "%8.1" /end CHARACTERISTIC
/begin CHARACTERISTIC Rail_DebMeUn4MaxOk_C "#SSD Heilungsentprellzeit für maximalen Raildruck" VALUE 0xE9978 Kw_Wu16 655350.0 Time_ms 0.00 655350.0 FORMAT "%8.1" /end CHARACTERISTIC
/begin CHARACTERISTIC Rail_DebPCV0MaxDef_C "#SSD Fehlerentprellzeit für Überwachung auf positive Regelabweichung" VALUE 0xE99C0 Kw_Wu16 655350.0 Time_ms 0.00 655350.0 FORMAT "%8.1" /end CHARACTERISTIC
/begin CHARACTERISTIC Rail_DebPCV0MaxOk_C "#SSD Heilungsentprellzeit für Überwachung auf positive Regelabweichung" VALUE 0xE99C2 Kw_Wu16 655350.0 Time_ms 0.00 655350.0 FORMAT "%8.1" /end CHARACTERISTIC
/begin CHARACTERISTIC Rail_DebPCV1MaxDef_C "#SSD Fehlerentprellzeit für positive Regelabweichung kombiniert mit Stellgröße Druckregelventil" VALUE 0xE99C4 Kw_Wu16 655350.0 Time_ms 0.00 655350.0 FORMAT "%8.1" /end CHARACTERISTIC
/begin CHARACTERISTIC Rail_DebPCV1MaxOk_C "#SSD Heilungsentprellzeit für positive Regelaweichung kombiniert mit Stellgröße Druckregelventil" VALUE 0xE99C6 Kw_Wu16 655350.0 Time_ms 0.00 655350.0 FORMAT "%8.1" /end CHARACTERISTIC
/begin CHARACTERISTIC Rail_DebPCV2MaxDef_C "#SSD Fehlerentprellzeit für negative Regelabweichung kombiniert mit Stellgröße Druckregelventil" VALUE 0xE99C8 Kw_Wu16 655350.0 Time_ms 0.00 655350.0 FORMAT "%8.1" /end CHARACTERISTIC
/begin CHARACTERISTIC Rail_DebPCV2MaxOk_C "#SSD Heilungsentprellzeit für negative Regelabweichung kombiniert mit Stellgröße Druckregelventil" VALUE 0xE99CA Kw_Wu16 655350.0 Time_ms 0.00 655350.0 FORMAT "%8.1" /end CHARACTERISTIC
/begin CHARACTERISTIC Rail_DebPCV3MaxDef_C "#SSD Fehlerentprellzeit für minimalen Raildruck" VALUE 0xE99CC Kw_Wu16 655350.0 Time_ms 0.00 655350.0 FORMAT "%8.1" /end CHARACTERISTIC
/begin CHARACTERISTIC Rail_DebPCV3MaxOk_C "#SSD Heilungsentprellzeit für minimalen Raildruck" VALUE 0xE99CE Kw_Wu16 655350.0 Time_ms 0.00 655350.0 FORMAT "%8.1" /end CHARACTERISTIC
/begin CHARACTERISTIC Rail_DebPCV4MaxDef_C "#SSD Fehlerentprellzeit für maximalen Raildruck" VALUE 0xE99D0 Kw_Wu16 655350.0 Time_ms 0.00 655350.0 FORMAT "%8.1" /end CHARACTERISTIC
/begin CHARACTERISTIC Rail_DebPCV4MaxOk_C "#SSD Heilungsentprellzeit für maximalen Raildruck" VALUE 0xE99D2 Kw_Wu16 655350.0 Time_ms 0.00 655350.0 FORMAT "%8.1" /end CHARACTERISTIC
/begin CHARACTERISTIC Rail_DebPCV5MaxDef_C "#SSD Fehlerentprellzeit für Plausibilisierung Raildruck mit Strom durch das PCV" VALUE 0xE99D4 Kw_Wu16 655350.0 Time_ms 0.00 655350.0 FORMAT "%8.1" /end CHARACTERISTIC
/begin CHARACTERISTIC Rail_DebPCV5MaxOk_C "#SSD Heilungsentprellzeit für Plausibilisierung Raildruck mit Strom durch das PCV" VALUE 0xE99D6 Kw_Wu16 655350.0 Time_ms 0.00 655350.0 FORMAT "%8.1" /end CHARACTERISTIC
/begin CHARACTERISTIC Rail_dvolMeUnCtlInitI_CUR "Kennlinie zur Initialisierung des I-Anteils als Funktion der Systemtemperatur" CURVE 0xE97FA Kl_Xs16_Ws16 150000.0 Qp_mm3_sec 0.00 150000.0 FORMAT "%8.1" EXTENDED_LIMITS -327680.0 327670.0
 /begin AXIS_DESCR STD_AXIS FlSys_t Temp_Cels 3 -50.14000 199.8600 FORMAT "%8.4" EXTENDED_LIMITS -3549.940 3003.560 DEPOSIT ABSOLUTE /end AXIS_DESCR
/end CHARACTERISTIC
/begin CHARACTERISTIC Rail_dvolMeUnCtlLoLim_C "#SSD untere Stellwertbegrenzung" VALUE 0xE94B4 Kw_Ws16 655350.0 Qp_mm3_sec -327680.0 327670.0 FORMAT "%8.1" /end CHARACTERISTIC
/begin CHARACTERISTIC Rail_dvolMeUnCtlUpLim_CUR "#SSD obere Stellwertbegrenzung" CURVE 0xE94B6 Kl_Xs16_Ws16 655350.0 Qp_mm3_sec -327680.0 327670.0 FORMAT "%8.1"
 /begin AXIS_DESCR STD_AXIS Eng_nAvrg EngN 11 0.00 6000.000 FORMAT "%8.3" EXTENDED_LIMITS -32768.00 32767.00 DEPOSIT ABSOLUTE /end AXIS_DESCR
/end CHARACTERISTIC
/begin CHARACTERISTIC Rail_dvolMeUnSet_Vector "#SSD Bypass-Label für Rail_dvolMeUnSet (Nicht verstellen!)" VALUE 0xC2E10 Kw_Wu8 255.0 OneToOne 0.00 255.0 FORMAT "%5.1" /end CHARACTERISTIC
/begin CHARACTERISTIC Rail_dvolMeUnSet_Channel "#SSD Bypass-Label für Rail_dvolMeUnSet, nicht editieren!" VALUE 0xC2E11 Kw_Wu8 255.0 OneToOne 0.00 255.0 FORMAT "%5.1" /end CHARACTERISTIC
/begin CHARACTERISTIC Rail_dvolOff_C "#SSD Volumenstrom beim Abstellen des Systems (Nullförderung)" VALUE 0xE9484 Kw_Ws16 655350.0 Qp_mm3_sec -327680.0 327670.0 FORMAT "%8.1" /end CHARACTERISTIC
/begin CHARACTERISTIC Rail_dvolPreCtlCor_Vector "#SSD Bypass Label, nicht ändern!" VALUE 0xC2E12 Kw_Wu8 255.0 OneToOne 0.00 255.0 FORMAT "%5.1" /end CHARACTERISTIC
/begin CHARACTERISTIC Rail_dvolPreCtlCor_Channel "#SSD Bypass Label, nicht ändern!" VALUE 0xC2E13 Kw_Wu8 255.0 OneToOne 0.00 255.0 FORMAT "%5.1" /end CHARACTERISTIC
/begin CHARACTERISTIC Rail_dvolStrt_C "#SSD Volumenstrom während der Startphase (2-Stellerkonzept)" VALUE 0xE9486 Kw_Ws16 655350.0 Qp_mm3_sec -327680.0 327670.0 FORMAT "%8.1" /end CHARACTERISTIC
/begin CHARACTERISTIC Rail_facOvrMeUnNegIncr_C "#SSD Multiplikativer Faktor zur Erhöhung der I-Verstärkung für negative Großsignale bei Überdruck (Druckregelung über MeUn)" VALUE 0xE94EC Kw_Ws16 255.9922 Fact1 0.00 255.9922 FORMAT "%8.4" EXTENDED_LIMITS -256.0000 255.9922 /end CHARACTERISTIC
/begin CHARACTERISTIC Rail_facOvrPCVNegIncr_C "#SSD Multiplikativer Faktor zur Erhöhung der I-Verstärkung für negative Großsignale bei Überdruck (Druckregelung über PCV)" VALUE 0xE9684 Kw_Ws16 255.9922 Fact1 0.00 255.9922 FORMAT "%8.4" EXTENDED_LIMITS -256.0000 255.9922 /end CHARACTERISTIC
/begin CHARACTERISTIC Rail_MeUnCtlDKd_CUR "D-Verstärkung der Druckregelung über Zumesseinheit" CURVE 0xE94EE Kl_Xs16_Ws16 500.0000 Kd_pRail2Q_1 0.00 500.0000 FORMAT "%12.4" EXTENDED_LIMITS -800.0000 799.9756
 /begin AXIS_DESCR STD_AXIS Eng_nAvrg EngN 3 0.00 6000.000 FORMAT "%8.3" EXTENDED_LIMITS -32768.00 32767.00 DEPOSIT ABSOLUTE /end AXIS_DESCR
/end CHARACTERISTIC
/begin CHARACTERISTIC Rail_MeUnCtlIKiNeg_CUR "I-Verstärkung für negative Großsignale für die Druckregelung über Zumesseinheit" CURVE 0xE94FC Kl_Xs16_Ws16 2000.015 Ki_pRail2Q_1 0.00 2000.015 FORMAT "%11.3" EXTENDED_LIMITS -3051.758 3051.665
 /begin AXIS_DESCR STD_AXIS Eng_nAvrg EngN 13 0.00 6000.000 FORMAT "%8.3" EXTENDED_LIMITS -32768.00 32767.00 DEPOSIT ABSOLUTE /end AXIS_DESCR
/end CHARACTERISTIC
/begin CHARACTERISTIC Rail_MeUnCtlIKiPos_CUR "I-Verstärkung für positive Großsignale für die Druckregelung über Zumesseinheit" CURVE 0xE9532 Kl_Xs16_Ws16 2000.015 Ki_pRail2Q_1 0.00 2000.015 FORMAT "%11.3" EXTENDED_LIMITS -3051.758 3051.665
 /begin AXIS_DESCR STD_AXIS Eng_nAvrg EngN 13 0.00 6000.000 FORMAT "%8.3" EXTENDED_LIMITS -32768.00 32767.00 DEPOSIT ABSOLUTE /end AXIS_DESCR
/end CHARACTERISTIC
/begin CHARACTERISTIC Rail_MeUnCtlIKi_CUR "I-Verstärkung für Kleinsignale für die Druckregelung über Zumesseinheit" CURVE 0xE9568 Kl_Xs16_Ws16 2000.015 Ki_pRail2Q_1 0.00 2000.015 FORMAT "%11.3" EXTENDED_LIMITS -3051.758 3051.665
 /begin AXIS_DESCR STD_AXIS Eng_nAvrg EngN 13 0.00 6000.000 FORMAT "%8.3" EXTENDED_LIMITS -32768.00 32767.00 DEPOSIT ABSOLUTE /end AXIS_DESCR
/end CHARACTERISTIC
/begin CHARACTERISTIC Rail_MeUnCtlPKpNeg_CUR "P-Verstärkung für negative Großsignale für die Druckregelung über Zumesseinheit" CURVE 0xE959E Kl_Xs16_Ws16 200.0000 Kp_pRail2Q_1 0.00 200.0000 FORMAT "%12.4" EXTENDED_LIMITS -400.0000 399.9878
 /begin AXIS_DESCR STD_AXIS Eng_nAvrg EngN 13 0.00 6000.000 FORMAT "%8.3" EXTENDED_LIMITS -32768.00 32767.00 DEPOSIT ABSOLUTE /end AXIS_DESCR
/end CHARACTERISTIC
/begin CHARACTERISTIC Rail_MeUnCtlPKpPos_CUR "P-Verstärkung für positive Großsignale für die Druckregelung über Zumesseinheit" CURVE 0xE95D4 Kl_Xs16_Ws16 200.0000 Kp_pRail2Q_1 0.00 200.0000 FORMAT "%12.4" EXTENDED_LIMITS -400.0000 399.9878
 /begin AXIS_DESCR STD_AXIS Eng_nAvrg EngN 13 0.00 6000.000 FORMAT "%8.3" EXTENDED_LIMITS -32768.00 32767.00 DEPOSIT ABSOLUTE /end AXIS_DESCR
/end CHARACTERISTIC
/begin CHARACTERISTIC Rail_MeUnCtlPKp_CUR "P-Verstärkung für Kleinsignale für die Druckregelung über Zumesseinheit" CURVE 0xE960A Kl_Xs16_Ws16 200.0000 Kp_pRail2Q_1 0.00 200.0000 FORMAT "%12.4" EXTENDED_LIMITS -400.0000 399.9878
 /begin AXIS_DESCR STD_AXIS Eng_nAvrg EngN 13 0.00 6000.000 FORMAT "%8.3" EXTENDED_LIMITS -32768.00 32767.00 DEPOSIT ABSOLUTE /end AXIS_DESCR
/end CHARACTERISTIC
/begin CHARACTERISTIC Rail_dvolMeUnSetMin_C "#SSD minimal zulässiger Volumenstrom durch Zumesseinheit für Raildrucküberwachung" VALUE 0xE997A Kw_Ws16 50000.00 Qp_mm3_sec 0.00 50000.00 FORMAT "%8.2" EXTENDED_LIMITS -327680.0 327670.0 /end CHARACTERISTIC
/begin CHARACTERISTIC Rail_pMeUnPeakMax_C "#SSD Maximal zulässiger Raildruck" VALUE 0xE997C Kw_Ws16 2000.000 Pres_Rail 0.00 2000.000 FORMAT "%5.3" EXTENDED_LIMITS -3276.800 3276.700 /end CHARACTERISTIC
/begin CHARACTERISTIC Rail_pMeUnDvtMax_C "#SSD Maximal zulässige Regelabweichung für Raildrucküberwachung" VALUE 0xE997E Kw_Ws16 2000.000 Pres_Rail 0.00 2000.000 FORMAT "%5.3" EXTENDED_LIMITS -3276.800 3276.700 /end CHARACTERISTIC
/begin CHARACTERISTIC Rail_qMeUnLoIdle_C "#SSD Mengenschwelle zur Erkennung der Schubbedingung bei der Raildrucküberwachung" VALUE 0xE9980 Kw_Ws16 327.6700 InjMassCyc 0.00 327.6700 FORMAT "%8.4" EXTENDED_LIMITS -327.6800 327.6700 /end CHARACTERISTIC
/begin CHARACTERISTIC Rail_stMonMeUnRls_C "#SSD Generelle Freigabemaske für Überwachungen der Druckregelung über Zumesseinheit" VALUE 0xE9982 Kw_Wu16 65535.00 OneToOne 0.00 65535.00 FORMAT "%8.2" /end CHARACTERISTIC
/begin CHARACTERISTIC Rail_tMeUnLoIdle_C "#SSD Systemtemperaturschwelle für die Raildrucküberwachung" VALUE 0xE9984 Kw_Ws16 250.0000 Temp_Cels -50.14000 199.8600 FORMAT "%8.4" EXTENDED_LIMITS -3549.940 3003.560 /end CHARACTERISTIC
/begin CHARACTERISTIC Rail_nCloseCtl_C "Drehzahlschwelle für Wechsel zwischen gesteuertem und geregeltem Betrieb" VALUE 0xE946E Kw_Ws16 65535.00 EngN -32768.00 32767.00 FORMAT "%8.2" /end CHARACTERISTIC
/begin CHARACTERISTIC Rail_nMeUnFrzI_C "Drehzahlschwelle zum Einfrieren des I-Anteils für den Druckregler über Zumesseinheit" VALUE 0xE9808 Kw_Ws16 65535.00 EngN -32768.00 32767.00 FORMAT "%8.2" /end CHARACTERISTIC
/begin CHARACTERISTIC Rail_nThresStrt_C "#SSD Drehzahlschwelle zum Verlassen des Startzustandes der Zustandssteuerung" VALUE 0xE9470 Kw_Ws16 65535.00 EngN -32768.00 32767.00 FORMAT "%8.2" /end CHARACTERISTIC
/begin CHARACTERISTIC Rail_numRevDel_C "#SSD Anzahl der Motorumdrehungen um von Steuern auf Regeln umzuschalten" VALUE 0xE9488 Kw_Wu16 65535.00 OneToOne 0.00 65535.00 FORMAT "%8.2" /end CHARACTERISTIC
/begin CHARACTERISTIC Rail_numRevPlaus_C "#SSD Anzahl der Motorumdrehungen um von Vorregelung auf Regelung umzuschalten" VALUE 0xE9472 Kw_Wu16 65535.00 OneToOne 0.00 65535.00 FORMAT "%8.2" /end CHARACTERISTIC
/begin CHARACTERISTIC Rail_pCloseCtl_C "Absolutdruckschwelle zum Umschaltung in den Regelbetrieb" VALUE 0xE9474 Kw_Ws16 6553.500 Pres_Rail -3276.800 3276.700 FORMAT "%5.3" /end CHARACTERISTIC
/begin CHARACTERISTIC Rail_PCVCtlDKd_CUR "D-Verstärkung der Druckregelung über Druckregelventil" CURVE 0xE9686 Kl_Xs16_Ws16 50.00000 Kd_1 0.00 50.00000 FORMAT "%8.5" EXTENDED_LIMITS -64.00000 63.99805
 /begin AXIS_DESCR STD_AXIS Eng_nAvrg EngN 3 0.00 6000.000 FORMAT "%8.3" EXTENDED_LIMITS -32768.00 32767.00 DEPOSIT ABSOLUTE /end AXIS_DESCR
/end CHARACTERISTIC
/begin CHARACTERISTIC Rail_PCVCtlIKiNeg_CUR "I-Verstärkung für negative Großsignale für die Druckregelung über Druckregelventil" CURVE 0xE9694 Kl_Xs16_Ws16 249.9968 Ki_1 0.00 249.9968 FORMAT "%8.4" EXTENDED_LIMITS -488.2812 488.2663
 /begin AXIS_DESCR STD_AXIS Eng_nAvrg EngN 13 0.00 6000.000 FORMAT "%8.3" EXTENDED_LIMITS -32768.00 32767.00 DEPOSIT ABSOLUTE /end AXIS_DESCR
/end CHARACTERISTIC
/begin CHARACTERISTIC Rail_PCVCtlIKiPos_CUR "I-Verstärkung für positive Großsignale für die Druckregelung über Druckregelventil" CURVE 0xE96CA Kl_Xs16_Ws16 249.9968 Ki_1 0.00 249.9968 FORMAT "%8.4" EXTENDED_LIMITS -488.2812 488.2663
 /begin AXIS_DESCR STD_AXIS Eng_nAvrg EngN 13 0.00 6000.000 FORMAT "%8.3" EXTENDED_LIMITS -32768.00 32767.00 DEPOSIT ABSOLUTE /end AXIS_DESCR
/end CHARACTERISTIC
/begin CHARACTERISTIC Rail_PCVCtlIKi_CUR "I-Verstärkung für Kleinsignale für die Druckregelung über Druckregelventil" CURVE 0xE9700 Kl_Xs16_Ws16 249.9968 Ki_1 0.00 249.9968 FORMAT "%8.4" EXTENDED_LIMITS -488.2812 488.2663
 /begin AXIS_DESCR STD_AXIS Eng_nAvrg EngN 13 0.00 6000.000 FORMAT "%8.3" EXTENDED_LIMITS -32768.00 32767.00 DEPOSIT ABSOLUTE /end AXIS_DESCR
/end CHARACTERISTIC
/begin CHARACTERISTIC Rail_PCVCtlPKpNeg_CUR "P-Verstärkung für negative Großsignale für die Druckregelung über Druckregelventil" CURVE 0xE9736 Kl_Xs16_Ws16 300.0000 Kp_1 0.00 300.0000 FORMAT "%8.4" EXTENDED_LIMITS -512.0000 511.9844
 /begin AXIS_DESCR STD_AXIS Eng_nAvrg EngN 13 0.00 6000.000 FORMAT "%8.3" EXTENDED_LIMITS -32768.00 32767.00 DEPOSIT ABSOLUTE /end AXIS_DESCR
/end CHARACTERISTIC
/begin CHARACTERISTIC Rail_PCVCtlPKpPos_CUR "P-Verstärkung für positive Großsignale für die Druckregelung über Druckregelventil" CURVE 0xE976C Kl_Xs16_Ws16 300.0000 Kp_1 0.00 300.0000 FORMAT "%8.4" EXTENDED_LIMITS -512.0000 511.9844
 /begin AXIS_DESCR STD_AXIS Eng_nAvrg EngN 13 0.00 6000.000 FORMAT "%8.3" EXTENDED_LIMITS -32768.00 32767.00 DEPOSIT ABSOLUTE /end AXIS_DESCR
/end CHARACTERISTIC
/begin CHARACTERISTIC Rail_PCVCtlPKp_CUR "P-Verstärkung für Kleinsignale für die Druckregelung über Druckregelventil" CURVE 0xE97A2 Kl_Xs16_Ws16 300.0000 Kp_1 0.00 300.0000 FORMAT "%8.4" EXTENDED_LIMITS -512.0000 511.9844
 /begin AXIS_DESCR STD_AXIS Eng_nAvrg EngN 13 0.00 6000.000 FORMAT "%8.3" EXTENDED_LIMITS -32768.00 32767.00 DEPOSIT ABSOLUTE /end AXIS_DESCR
/end CHARACTERISTIC
/begin CHARACTERISTIC Rail_pPCVDvtMax_C "#SSD maximale positive Soll/Ist Druckdifferenz" VALUE 0xE99D8 Kw_Ws16 3800.000 Pres_Rail -1800.000 2000.000 FORMAT "%5.3" EXTENDED_LIMITS -3276.800 3276.700 /end CHARACTERISTIC
/begin CHARACTERISTIC Rail_pPCVSetMax_C "#SSD Maximal zulässiger Solldruck für Raildrucküberwachung" VALUE 0xE99DA Kw_Ws16 2000.000 Pres_Rail 0.00 2000.000 FORMAT "%5.3" EXTENDED_LIMITS -3276.800 3276.700 /end CHARACTERISTIC
/begin CHARACTERISTIC Rail_pPCVDvtMin_C "#SSD maximale negative Soll/Ist Druckdifferenz" VALUE 0xE99DC Kw_Ws16 3800.000 Pres_Rail -1800.000 2000.000 FORMAT "%5.3" EXTENDED_LIMITS -3276.800 3276.700 /end CHARACTERISTIC
/begin CHARACTERISTIC Rail_pPCVSetMin_C "#SSD Minimal zulässiger Solldruck für Raildrucküberwachung" VALUE 0xE99DE Kw_Ws16 2000.000 Pres_Rail 0.00 2000.000 FORMAT "%5.3" EXTENDED_LIMITS -3276.800 3276.700 /end CHARACTERISTIC
/begin CHARACTERISTIC Rail_pAbsDvtMax_C "#SSD Maximaler Betrag der Regelabweichung für Raildrucküberwachung" VALUE 0xE99E0 Kw_Ws16 3800.000 Pres_Rail -1800.000 2000.000 FORMAT "%5.3" EXTENDED_LIMITS -3276.800 3276.700 /end CHARACTERISTIC
/begin CHARACTERISTIC Rail_tiThresMonEna_C "#SSD Zeitschwelle für Freigabe der Plausibilisierung des Raildrucks während der Raildrucküberwachung" VALUE 0xE99E2 Kw_Wu16 655350.0 Time_ms 0.00 655350.0 FORMAT "%8.1" /end CHARACTERISTIC
/begin CHARACTERISTIC Rail_qMonEnaMax_C "#SSD Maximale Menge für Raildrucküberwachung" VALUE 0xE99E4 Kw_Ws16 327.6700 InjMassCyc 0.00 327.6700 FORMAT "%8.4" EXTENDED_LIMITS -327.6800 327.6700 /end CHARACTERISTIC
/begin CHARACTERISTIC Rail_nMonEnaMin_C "#SSD Minimale Drehzahl für Raildrucküberwachung" VALUE 0xE99E6 Kw_Ws16 6000.000 EngN 0.00 6000.000 FORMAT "%8.3" EXTENDED_LIMITS -32768.00 32767.00 /end CHARACTERISTIC
/begin CHARACTERISTIC Rail_nMonEnaMax_C "#SSD Maximale Drehzahl für Raildrucküberwachung" VALUE 0xE99E8 Kw_Ws16 6000.000 EngN 0.00 6000.000 FORMAT "%8.3" EXTENDED_LIMITS -32768.00 32767.00 /end CHARACTERISTIC
/begin CHARACTERISTIC Rail_pPCVPeakMax_C "#SSD Maximal zulässiger Raildruck" VALUE 0xE99EA Kw_Ws16 2000.000 Pres_Rail 0.00 2000.000 FORMAT "%5.3" EXTENDED_LIMITS -3276.800 3276.700 /end CHARACTERISTIC
/begin CHARACTERISTIC Rail_stMonPCVRls_C "#SSD Generelle Freigabemaske für Überwachungen der Druckregelung über Druckregelventil" VALUE 0xE99EC Kw_Wu16 65535.00 OneToOne 0.00 65535.00 FORMAT "%8.2" /end CHARACTERISTIC
/begin CHARACTERISTIC Rail_pDiffCloseCtl_C "Differenzdruckschwelle zum Umschalten in den Regelbetrieb" VALUE 0xE9476 Kw_Ws16 6553.500 Pres_Rail -3276.800 3276.700 FORMAT "%5.3" /end CHARACTERISTIC
/begin CHARACTERISTIC Rail_pDvtFltMin_C "minimale absolute Regelabweichung als eingangssignal des DT1-Gliedes" VALUE 0xE980A Kw_Ws16 6553.500 Pres_Rail -3276.800 3276.700 FORMAT "%5.3" /end CHARACTERISTIC
/begin CHARACTERISTIC Rail_pMeUnCtlIWinNeg_C "untere Kleinsignalgrenze für den I-Anteil des Druckreglers über Zumesseinheit" VALUE 0xE9640 Kw_Ws16 6553.500 Pres_Rail -3276.800 3276.700 FORMAT "%5.3" /end CHARACTERISTIC
/begin CHARACTERISTIC Rail_pMeUnCtlIWinPos_C "obere Kleinsignalgrenze für den I-Anteil des Druckreglers über Zumesseinheit" VALUE 0xE9642 Kw_Ws16 6553.500 Pres_Rail -3276.800 3276.700 FORMAT "%5.3" /end CHARACTERISTIC
/begin CHARACTERISTIC Rail_pMeUnCtlPWinNeg_C "untere Kleinsignalgrenze für den P-Anteil des Druckreglers über Zumesseinheit" VALUE 0xE9644 Kw_Ws16 6553.500 Pres_Rail -3276.800 3276.700 FORMAT "%5.3" /end CHARACTERISTIC
/begin CHARACTERISTIC Rail_pMeUnCtlPWinPos_C "obere Kleinsignalgrenze für den P-Anteil des Druckreglers über Zumesseinheit" VALUE 0xE9646 Kw_Ws16 6553.500 Pres_Rail -3276.800 3276.700 FORMAT "%5.3" /end CHARACTERISTIC
/begin CHARACTERISTIC Rail_pMeUnDvtMax_CUR "#SSD Maximal zulässige Regelabweichung für Raildrucküberwachung als Funktion der Drehzahl" CURVE 0xE9986 Kl_Xs16_Ws16 3800.000 Pres_Rail -1800.000 2000.000 FORMAT "%5.3" EXTENDED_LIMITS -3276.800 3276.700
 /begin AXIS_DESCR STD_AXIS Eng_nAvrg EngN 4 0.00 6000.000 FORMAT "%8.3" EXTENDED_LIMITS -32768.00 32767.00 DEPOSIT ABSOLUTE /end AXIS_DESCR
/end CHARACTERISTIC
/begin CHARACTERISTIC Rail_pMeUnDvtMin_CUR "#SSD Minimal zulässige Regelabweichung für Raildrucküberwachung als Funktion der Drehzahl" CURVE 0xE9998 Kl_Xs16_Ws16 3800.000 Pres_Rail -1800.000 2000.000 FORMAT "%5.3" EXTENDED_LIMITS -3276.800 3276.700
 /begin AXIS_DESCR STD_AXIS Eng_nAvrg EngN 4 0.00 6000.000 FORMAT "%8.3" EXTENDED_LIMITS -32768.00 32767.00 DEPOSIT ABSOLUTE /end AXIS_DESCR
/end CHARACTERISTIC
/begin CHARACTERISTIC Rail_pMeUnPeakMin_CUR "#SSD Minimal zulässiger Raildruck als Funktion der Motordrehzahl" CURVE 0xE99AA Kl_Xs16_Ws16 2000.000 Pres_Rail 0.00 2000.000 FORMAT "%5.3" EXTENDED_LIMITS -3276.800 3276.700
 /begin AXIS_DESCR STD_AXIS Eng_nAvrg EngN 5 0.00 6000.000 FORMAT "%8.3" EXTENDED_LIMITS -32768.00 32767.00 DEPOSIT ABSOLUTE /end AXIS_DESCR
/end CHARACTERISTIC
/begin CHARACTERISTIC Rail_pNIPCVMax_MAP "#SSD Obere Grenze für Drucksensorplausibilisierung" MAP 0xE99EE Kf_Xs16_Ys16_Ws16 2000.000 Pres_Rail 0.00 2000.000 FORMAT "%5.3" EXTENDED_LIMITS -3276.800 3276.700
 /begin AXIS_DESCR STD_AXIS Eng_nAvrg EngN 6 0.00 6000.000 FORMAT "%8.3" EXTENDED_LIMITS -32768.00 32767.00 DEPOSIT ABSOLUTE /end AXIS_DESCR
 /begin AXIS_DESCR STD_AXIS PCVCD_iActVal Curr 8 0.00 5000.000 FORMAT "%8.3" EXTENDED_LIMITS -32768.00 32767.00 DEPOSIT ABSOLUTE /end AXIS_DESCR
/end CHARACTERISTIC
/begin CHARACTERISTIC Rail_pNIPCVMin_MAP "#SSD Untere Grenze für Drucksensorplausibilisierung" MAP 0xE9A6E Kf_Xs16_Ys16_Ws16 2000.000 Pres_Rail 0.00 2000.000 FORMAT "%5.3" EXTENDED_LIMITS -3276.800 3276.700
 /begin AXIS_DESCR STD_AXIS Eng_nAvrg EngN 6 0.00 6000.000 FORMAT "%8.3" EXTENDED_LIMITS -32768.00 32767.00 DEPOSIT ABSOLUTE /end AXIS_DESCR
 /begin AXIS_DESCR STD_AXIS PCVCD_iActVal Curr 8 0.00 5000.000 FORMAT "%8.3" EXTENDED_LIMITS -32768.00 32767.00 DEPOSIT ABSOLUTE /end AXIS_DESCR
/end CHARACTERISTIC
/begin CHARACTERISTIC Rail_pOpnCtl_C "Absolutdruckschwelle zum Umschaltung in den Steuerbetrieb" VALUE 0xE9478 Kw_Ws16 6553.500 Pres_Rail -3276.800 3276.700 FORMAT "%5.3" /end CHARACTERISTIC
/begin CHARACTERISTIC Rail_pOvrMeUnThresHigh_C "#SSD Obere Hystereseschwelle für Überdruckerkennung MeUn" VALUE 0xE9648 Kw_Ws16 2000.000 Pres_Rail 0.00 2000.000 FORMAT "%5.3" EXTENDED_LIMITS -3276.800 3276.700 /end CHARACTERISTIC
/begin CHARACTERISTIC Rail_pOvrMeUnThresLow_C "#SSD Untere Hystereseschwelle für Überdruckerkennung MeUn" VALUE 0xE964A Kw_Ws16 2000.000 Pres_Rail 0.00 2000.000 FORMAT "%5.3" EXTENDED_LIMITS -3276.800 3276.700 /end CHARACTERISTIC
/begin CHARACTERISTIC Rail_pOvrPCVThresHigh_C "#SSD Obere Hystereseschwelle für Überdruckerkennung PCV" VALUE 0xE97D8 Kw_Ws16 2000.000 Pres_Rail 0.00 2000.000 FORMAT "%5.3" EXTENDED_LIMITS -3276.800 3276.700 /end CHARACTERISTIC
/begin CHARACTERISTIC Rail_pOvrPCVThresLow_C "#SSD Untere Hystereseschwelle für Überdruckerkennung PCV" VALUE 0xE97DA Kw_Ws16 2000.000 Pres_Rail 0.00 2000.000 FORMAT "%5.3" EXTENDED_LIMITS -3276.800 3276.700 /end CHARACTERISTIC
/begin CHARACTERISTIC Rail_pPCVCtlIWinNeg_C "untere Kleinsignalgrenze für den I-Anteil des Druckreglers über Druckregelventil" VALUE 0xE97DC Kw_Ws16 6553.500 Pres_Rail -3276.800 3276.700 FORMAT "%5.3" /end CHARACTERISTIC
/begin CHARACTERISTIC Rail_pPCVCtlIWinPos_C "obere Kleinsignalgrenze für den I-Anteil des Druckreglers über Druckregelventil" VALUE 0xE97DE Kw_Ws16 6553.500 Pres_Rail -3276.800 3276.700 FORMAT "%5.3" /end CHARACTERISTIC
/begin CHARACTERISTIC Rail_pPCVCtlLoLimStrt_C "#SSD untere Stellwertbegrenzung des Raildruckreglers über Druckregelventil während der Startphase" VALUE 0xE94E4 Kw_Ws16 6553.500 Pres_Rail -3276.800 3276.700 FORMAT "%5.3" /end CHARACTERISTIC
/begin CHARACTERISTIC Rail_pPCVCtlLoLim_C "#SSD untere Stellwertbegrenzung des Raildruckreglers über Druckregelventil" VALUE 0xE94E6 Kw_Ws16 6553.500 Pres_Rail -3276.800 3276.700 FORMAT "%5.3" /end CHARACTERISTIC
/begin CHARACTERISTIC Rail_pPCVCtlPWinNeg_C "untere Kleinsignalgrenze für den P-Anteil des Druckreglers über Druckregelventil" VALUE 0xE97E0 Kw_Ws16 6553.500 Pres_Rail -3276.800 3276.700 FORMAT "%5.3" /end CHARACTERISTIC
/begin CHARACTERISTIC Rail_pPCVCtlPWinPos_C "obere Kleinsignalgrenze für den P-Anteil des Druckreglers über Druckregelventil" VALUE 0xE97E2 Kw_Ws16 6553.500 Pres_Rail -3276.800 3276.700 FORMAT "%5.3" /end CHARACTERISTIC
/begin CHARACTERISTIC Rail_pPCVCtlUpLimStrt_C "obere Stellwertbegrenzung des Raildruckreglers über Druckregelventil während der Startphase" VALUE 0xE94E8 Kw_Ws16 6553.500 Pres_Rail -3276.800 3276.700 FORMAT "%5.3" /end CHARACTERISTIC
/begin CHARACTERISTIC Rail_pPCVCtlUpLim_C "#SSD obere Stellwertbegrenzung des Raildruckreglers über Druckregelventil" VALUE 0xE94EA Kw_Ws16 6553.500 Pres_Rail -3276.800 3276.700 FORMAT "%5.3" /end CHARACTERISTIC
/begin CHARACTERISTIC Rail_pPCVDvtMax_CUR "#SSD maximale Regelabweichung als Funktion der Drehzahl für die Raildrucküberwachung" CURVE 0xE9AEE Kl_Xs16_Ws16 3800.000 Pres_Rail -1800.000 2000.000 FORMAT "%5.3" EXTENDED_LIMITS -3276.800 3276.700
 /begin AXIS_DESCR STD_AXIS Eng_nAvrg EngN 4 0.00 6000.000 FORMAT "%8.3" EXTENDED_LIMITS -32768.00 32767.00 DEPOSIT ABSOLUTE /end AXIS_DESCR
/end CHARACTERISTIC
/begin CHARACTERISTIC Rail_pPCVInitI_MAP "Kennfeld für Initialisierungswert I-Anteil des PCV-Druckreglers, beim Umschalten von Zumesseinheit auf Druckregelventil" MAP 0xE980E Kf_Xs16_Ys16_Ws16 2000.000 Pres_Rail 0.00 2000.000 FORMAT "%5.3" EXTENDED_LIMITS -3276.800 3276.700
 /begin AXIS_DESCR STD_AXIS Eng_nAvrg EngN 8 0.00 6000.000 FORMAT "%8.3" EXTENDED_LIMITS -32768.00 32767.00 DEPOSIT ABSOLUTE /end AXIS_DESCR
 /begin AXIS_DESCR STD_AXIS Rail_pSetPoint Pres_Rail 12 0.00 2000.000 FORMAT "%5.3" EXTENDED_LIMITS -3276.800 3276.700 DEPOSIT ABSOLUTE /end AXIS_DESCR
/end CHARACTERISTIC
/begin CHARACTERISTIC Rail_pPCVPeakMin_CUR "#SSD Minimal zulässiger Raildruck als Funktion der Motordrehzahl" CURVE 0xE9B00 Kl_Xs16_Ws16 2000.000 Pres_Rail 0.00 2000.000 FORMAT "%5.3" EXTENDED_LIMITS -3276.800 3276.700
 /begin AXIS_DESCR STD_AXIS Eng_nAvrg EngN 4 0.00 6000.000 FORMAT "%8.3" EXTENDED_LIMITS -32768.00 32767.00 DEPOSIT ABSOLUTE /end AXIS_DESCR
/end CHARACTERISTIC
/begin CHARACTERISTIC Rail_pPCVSet_Vector "#SSD Bypass-Label für Rail_pPCVSet (Nicht verstellen!)" VALUE 0xC2E14 Kw_Wu8 255.0 OneToOne 0.00 255.0 FORMAT "%5.1" /end CHARACTERISTIC
/begin CHARACTERISTIC Rail_pPCVSet_Channel "#SSD Bypass-Label, nicht editieren !" VALUE 0xC2E15 Kw_Wu8 255.0 OneToOne 0.00 255.0 FORMAT "%5.1" /end CHARACTERISTIC
/begin CHARACTERISTIC Rail_pPreCtlCor_Vector "#SSD Bypass Label, nicht ändern!" VALUE 0xC2E16 Kw_Wu8 255.0 OneToOne 0.00 255.0 FORMAT "%5.1" /end CHARACTERISTIC
/begin CHARACTERISTIC Rail_pPreCtlCor_Channel "#SSD Bypass Label, nicht ändern!" VALUE 0xC2E17 Kw_Wu8 255.0 OneToOne 0.00 255.0 FORMAT "%5.1" /end CHARACTERISTIC
/begin CHARACTERISTIC Rail_pSetMin_C "#SSD minimaler Druck als Stellwertvorgabe" VALUE 0xE948A Kw_Ws16 6553.500 Pres_Rail -3276.800 3276.700 FORMAT "%5.3" /end CHARACTERISTIC
/begin CHARACTERISTIC Rail_qMeUnCtlType_CUR "Kennlinie zur mengenabhängigen Umschaltung auf Druckregelung über Zumesseinheit (Rail_swtConInv_C beachten!)" CURVE 0xE98FC Kl_Xs16_Ws16 327.6700 InjMassCyc 0.00 327.6700 FORMAT "%8.4" EXTENDED_LIMITS -327.6800 327.6700
 /begin AXIS_DESCR STD_AXIS Eng_nAvrg EngN 8 0.00 6000.000 FORMAT "%8.3" EXTENDED_LIMITS -32768.00 32767.00 DEPOSIT ABSOLUTE /end AXIS_DESCR
/end CHARACTERISTIC
/begin CHARACTERISTIC Rail_qPCVCtlType_CUR "Kennlinie zur mengenabhängigen Umschaltung auf Druckregelung über Druckregelventil (Rail_swtConInv_C beachten!)" CURVE 0xE991E Kl_Xs16_Ws16 327.6700 InjMassCyc 0.00 327.6700 FORMAT "%8.4" EXTENDED_LIMITS -327.6800 327.6700
 /begin AXIS_DESCR STD_AXIS Eng_nAvrg EngN 8 0.00 6000.000 FORMAT "%8.3" EXTENDED_LIMITS -32768.00 32767.00 DEPOSIT ABSOLUTE /end AXIS_DESCR
/end CHARACTERISTIC
/begin CHARACTERISTIC Rail_stCtlLoopSel_C "Schalterauswahl fuer die Raildruckregelung" VALUE 0xE948C Kw_Wu8 255.0 OneToOne 0.00 255.0 FORMAT "%5.1" /end CHARACTERISTIC
/begin CHARACTERISTIC Rail_swtCtlModeAdjVal_C "Abgleichersatzwert für Hochdruckregelungs-Modus MeUn/PCV" VALUE 0xE947A Kw_Wu8 2.000 OneToOne 0.00 2.000 FORMAT "%5.3" EXTENDED_LIMITS 0.00 255.0 /end CHARACTERISTIC
/begin CHARACTERISTIC Rail_swtPCVInitI_C "Auswahl, PCV-Reglerinitialisierung mit Vorsteuerwert oder mit Sollwert" VALUE 0xE98FA Kw_Wu8 255.0 OneToOne 0.00 255.0 FORMAT "%5.1" /end CHARACTERISTIC
/begin CHARACTERISTIC Rail_swtPreCtlVal_C "Schalterwert, Raildruckregler mit / ohne Vorsteuerung" VALUE 0xE9B12 Kw_Wu8 1.000 OneToOne 0.00 1.000 FORMAT "%5.3" EXTENDED_LIMITS 0.00 255.0 /end CHARACTERISTIC
/begin CHARACTERISTIC Rail_swtPreCtlType_C "Auswahl, Schalterwert aus Datensatz oder EEPROM" VALUE 0xE9B13 Kw_Wu8 0.00 OneToOne 2.000 2.000 FORMAT "%5.3" EXTENDED_LIMITS 0.00 255.0 /end CHARACTERISTIC
/begin CHARACTERISTIC Rail_swtPressVal_C "Schalterwert, Umschaltung zwischen Steuern und Regeln anhand Absolut- / Differenzwert des Raildrucks" VALUE 0xE9B14 Kw_Wu8 1.000 OneToOne 0.00 1.000 FORMAT "%5.3" EXTENDED_LIMITS 0.00 255.0 /end CHARACTERISTIC
/begin CHARACTERISTIC Rail_swtPressType_C "Auswahl, Schalterwert aus Datensatz oder EEPROM" VALUE 0xE9B15 Kw_Wu8 0.00 OneToOne 2.000 2.000 FORMAT "%5.3" EXTENDED_LIMITS 0.00 255.0 /end CHARACTERISTIC
/begin CHARACTERISTIC Rail_swtWindUpVal_C "Schalterwert, Raildruckregler mit eingefrorenem oder rückgerechnetem I-Anteil" VALUE 0xE9B16 Kw_Wu8 1.000 OneToOne 0.00 1.000 FORMAT "%5.3" EXTENDED_LIMITS 0.00 255.0 /end CHARACTERISTIC
/begin CHARACTERISTIC Rail_swtWindUpType_C "Auswahl, Schalterwert aus Datensatz oder EEPROM" VALUE 0xE9B17 Kw_Wu8 0.00 OneToOne 2.000 2.000 FORMAT "%5.3" EXTENDED_LIMITS 0.00 255.0 /end CHARACTERISTIC
/begin CHARACTERISTIC Rail_tiDebDefMeUnDiag_C "Fehlerentprellzeit fuer Fehlerpfad Dfp_RailCtlModeMeUnDiag" VALUE 0xE947C Kw_Wu16 655350.0 Time_ms 0.00 655350.0 FORMAT "%8.1" /end CHARACTERISTIC
/begin CHARACTERISTIC Rail_tiDebOkMeUnDiag_C "Heilungsentprellzeit fuer Fehlerpfad Dfp_RailCtlModeMeUnDiag" VALUE 0xE947E Kw_Wu16 655350.0 Time_ms 0.00 655350.0 FORMAT "%8.1" /end CHARACTERISTIC
/begin CHARACTERISTIC Rail_tiDebDefPCVDiag_C "Fehlerentprellzeit fuer Fehlerpfad Dfp_RailCtlModePCVDiag" VALUE 0xE9480 Kw_Wu16 655350.0 Time_ms 0.00 655350.0 FORMAT "%8.1" /end CHARACTERISTIC
/begin CHARACTERISTIC Rail_tiDebOkPCVDiag_C "Heilungsentprellzeit fuer Fehlerpfad Dfp_RailCtlModePCVDiag" VALUE 0xE9482 Kw_Wu16 655350.0 Time_ms 0.00 655350.0 FORMAT "%8.1" /end CHARACTERISTIC
/begin CHARACTERISTIC Rail_tiDeflate_C "#SSD Maximale Zeit für die Entlüftung des Niederdruckkreises" VALUE 0xE948E Kw_Wu16 655350.0 Time_ms 0.00 655350.0 FORMAT "%8.1" /end CHARACTERISTIC
/begin CHARACTERISTIC Rail_tiFrzIDel_C "Verzögerungszeit zum Einfrieren des I-Anteils für den Druckregler über Zumesseinheit" VALUE 0xE980C Kw_Wu16 1000.000 Time_ms 0.00 1000.000 FORMAT "%8.3" EXTENDED_LIMITS 0.00 655350.0 /end CHARACTERISTIC
/begin CHARACTERISTIC Rail_tiMeUnCtlDT1_CUR "Zeitkonstante des DT1-Gliedes (Druckregelung über Zumesseinheit)" CURVE 0xE964C Kl_Xs16_Ws16 16.776216 TimeDelay_s_2 0.0010000129 16.777216 FORMAT "%9.6" EXTENDED_LIMITS 0.00051201563 16.777216
 /begin AXIS_DESCR STD_AXIS Eng_nAvrg EngN 5 0.00 6000.000 FORMAT "%8.3" EXTENDED_LIMITS -32768.00 32767.00 DEPOSIT ABSOLUTE /end AXIS_DESCR
/end CHARACTERISTIC
/begin CHARACTERISTIC Rail_tiMeUnCtlPT1_CUR "Zeitkonstante des PT1-Filters (Druckregelung über Zumesseinheit)" CURVE 0xE9662 Kl_Xs16_Ws16 16.776216 TimeDelay_s_2 0.0010000129 16.777216 FORMAT "%9.6" EXTENDED_LIMITS 0.00051201563 16.777216
 /begin AXIS_DESCR STD_AXIS Eng_nAvrg EngN 8 0.00 6000.000 FORMAT "%8.3" EXTENDED_LIMITS -32768.00 32767.00 DEPOSIT ABSOLUTE /end AXIS_DESCR
/end CHARACTERISTIC
/begin CHARACTERISTIC Rail_tiMeUnCtlTypeDel_C "Zeitverzögerung im Schubbetrieb bis zur Umschaltung auf Druckregelung über Zumesseinheit" VALUE 0xE9940 Kw_Wu16 655350.0 Time_ms 0.00 655350.0 FORMAT "%8.1" /end CHARACTERISTIC
/begin CHARACTERISTIC Rail_tiMeUnRmpDur_CUR "Laufzeit der Rampe um das Fördervolumen der Zumesseinheit vom aktuellen Sollwert auf die Maximalförderung zu rampen" CURVE 0xE9490 Kl_Xs16_Ws16 655350.0 Time_ms -327680.0 327670.0 FORMAT "%8.1"
 /begin AXIS_DESCR STD_AXIS Eng_nAvrg EngN 8 0.00 6000.000 FORMAT "%8.3" EXTENDED_LIMITS -32768.00 32767.00 DEPOSIT ABSOLUTE /end AXIS_DESCR
/end CHARACTERISTIC
/begin CHARACTERISTIC Rail_tiPCVCtlDT1_CUR "Zeitkonstante des DT1-Gliedes für die Druckregelung über Druckregelventil" CURVE 0xE97E4 Kl_Xs16_Ws16 16.776216 TimeDelay_s_2 0.0010000129 16.777216 FORMAT "%9.6" EXTENDED_LIMITS 0.00051201563 16.777216
 /begin AXIS_DESCR STD_AXIS Eng_nAvrg EngN 5 0.00 6000.000 FORMAT "%8.3" EXTENDED_LIMITS -32768.00 32767.00 DEPOSIT ABSOLUTE /end AXIS_DESCR
/end CHARACTERISTIC
/begin CHARACTERISTIC Rail_tiSwtCtlTypeDel_C "Verzögerungszeit bis zur Freigabe der Umschaltung des Regelprinzips" VALUE 0xE9942 Kw_Wu16 655350.0 Time_ms 0.00 655350.0 FORMAT "%8.1" /end CHARACTERISTIC
/begin CHARACTERISTIC Rail_tiSwtToMeUnCtl_C "Verzögerungszeit bis zum Umschalten auf Druckregelung über Zumesseinheit" VALUE 0xE94B2 Kw_Wu16 655350.0 Time_ms 0.00 655350.0 FORMAT "%8.1" /end CHARACTERISTIC
/begin CHARACTERISTIC Rail_tMeUnCtlType_CUR "Kennlinie zur temperaturabhängigen Umschaltung auf Druckregelung über Zumesseinheit" CURVE 0xE9944 Kl_Xs16_Ws16 250.0000 Temp_Cels -50.14000 199.8600 FORMAT "%8.4" EXTENDED_LIMITS -3549.940 3003.560
 /begin AXIS_DESCR STD_AXIS Eng_nAvrg EngN 3 0.00 6000.000 FORMAT "%8.3" EXTENDED_LIMITS -32768.00 32767.00 DEPOSIT ABSOLUTE /end AXIS_DESCR
/end CHARACTERISTIC
/begin CHARACTERISTIC Rail_tOvrRunThres_C "Systemtemperaturschwelle zur Umschaltung auf Druckregelung über Zumesseinheit bei Schubbetrieb" VALUE 0xE9952 Kw_Ws16 250.0000 Temp_Cels -50.14000 199.8600 FORMAT "%8.4" EXTENDED_LIMITS -3549.940 3003.560 /end CHARACTERISTIC
/begin CHARACTERISTIC Rail_tPCVCtlType_CUR "Kennlinie zur temperaturabhängigen Umschaltung auf Druckregelung über Druckregelventil" CURVE 0xE9954 Kl_Xs16_Ws16 250.0000 Temp_Cels -50.14000 199.8600 FORMAT "%8.4" EXTENDED_LIMITS -3549.940 3003.560
 /begin AXIS_DESCR STD_AXIS Eng_nAvrg EngN 3 0.00 6000.000 FORMAT "%8.3" EXTENDED_LIMITS -32768.00 32767.00 DEPOSIT ABSOLUTE /end AXIS_DESCR
/end CHARACTERISTIC
/begin CHARACTERISTIC Rail_tSwtCtlTypeHi_C "Obere Hystereseschwelle der Systemtemperatur bis zur Freigabe der Umschaltung des Regelprinzips" VALUE 0xE9962 Kw_Ws16 250.0000 Temp_Cels -50.14000 199.8600 FORMAT "%8.4" EXTENDED_LIMITS -3549.940 3003.560 /end CHARACTERISTIC
/begin CHARACTERISTIC Rail_tSwtCtlTypeLo_C "Untere Hystereseschwelle der Systemtemperatur bis zur Freigabe der Umschaltung des Regelprinzips" VALUE 0xE9964 Kw_Ws16 250.0000 Temp_Cels -50.14000 199.8600 FORMAT "%8.4" EXTENDED_LIMITS -3549.940 3003.560 /end CHARACTERISTIC
/begin MEASUREMENT PFlt_ctEngPrtRgnOld_mp "engine protection regeneration count read from EEPROM" UWORD OneToOne 1 100 0.00 65535.00 FORMAT "%8.2" ECU_ADDRESS 0x8FFB50 /end MEASUREMENT
/begin MEASUREMENT PFlt_ctEngPrtRgn_mp "engine protection regeneration counter" UWORD OneToOne 1 100 0.00 65535.00 FORMAT "%8.2" ECU_ADDRESS 0x8FFB52 /end MEASUREMENT
/begin MEASUREMENT PFlt_ddvolFlt_mp "Änderung Abgasvolumenstrom" SWORD CubMtrPerHrPerSec 1 100 -3276.800 3276.700 FORMAT "%8.3" ECU_ADDRESS 0x8FFB54 /end MEASUREMENT
/begin MEASUREMENT PFlt_dmEG "Abgasmassenstrom" SWORD AirMassPerTime 1 100 -3276.800 3276.700 FORMAT "%8.3" ECU_ADDRESS 0x7F8F84 /end MEASUREMENT
/begin MEASUREMENT PFlt_dmNO2Tot_mp "insgesamt zur Verfügung stehender NO2-Massenstrom" SWORD dmSoot_mg_p_s 1 100 -327.6800 327.6700 FORMAT "%8.4" ECU_ADDRESS 0x8FFB2C /end MEASUREMENT
/begin MEASUREMENT PFlt_dmNOxRaw_mp "simulierte NOx-Basisemission" SWORD dmSoot_mg_p_s 1 100 -327.6800 327.6700 FORMAT "%8.4" ECU_ADDRESS 0x8FFB2E /end MEASUREMENT
/begin MEASUREMENT PFlt_dmO2Aprx "geschätzter Sauerstoffmassenstrom vor dem Partikelfilter" SWORD AirMassPerTime 1 100 -3276.800 3276.700 FORMAT "%8.3" ECU_ADDRESS 0x7F8F86 /end MEASUREMENT
/begin MEASUREMENT PFlt_dmSotSimDyn_mp "Dynamischer Anteil für produzierte Rußmasse = f(dq)" SWORD dmSoot_mg_p_s 1 100 -327.6800 327.6700 FORMAT "%8.4" ECU_ADDRESS 0x8FFB30 /end MEASUREMENT
/begin MEASUREMENT PFlt_dmSotSimEmi_mp "generierte Partikelmasse" SWORD dmSoot_mg_p_s 1 100 -327.6800 327.6700 FORMAT "%8.4" ECU_ADDRESS 0x6F8164 /end MEASUREMENT
/begin MEASUREMENT PFlt_dmSotSimRgnCRT_mp "abgebauter Partikelmassenstrom in Simulation durch CRT" SWORD dmSoot_mg_p_s 1 100 -327.6800 327.6700 FORMAT "%8.4" ECU_ADDRESS 0x6F8166 /end MEASUREMENT
/begin MEASUREMENT PFlt_dmSotSimRgnThr_mp "abgebauter Partikelmassenstrom in Simulation durch thermische Regeneration" SWORD dmSoot_mg_p_s 1 100 -327.6800 327.6700 FORMAT "%8.4" ECU_ADDRESS 0x6F8168 /end MEASUREMENT
/begin MEASUREMENT PFlt_dmSotSimRgn_mp "regenerierte Partikelmasse" SWORD dmSoot_mg_p_s 1 100 -327.6800 327.6700 FORMAT "%8.4" ECU_ADDRESS 0x6F816A /end MEASUREMENT
/begin MEASUREMENT PFlt_dmSotSimSty_mp "stationärer Partikelmassenstrom in Simulation" SWORD dmSoot_mg_p_s 1 100 -327.6800 327.6700 FORMAT "%8.4" ECU_ADDRESS 0x8FFB32 /end MEASUREMENT
/begin MEASUREMENT PFlt_dmSotSim_mp "gesamt produzierte Partikelmasse" SWORD dmSoot_mg_p_s 1 100 -327.6800 327.6700 FORMAT "%8.4" ECU_ADDRESS 0x8FFB34 /end MEASUREMENT
/begin MEASUREMENT PFlt_dpDiffFlt_mp "Änderung Druckdifferenz" SWORD hPaPerSec 1 100 -3276.800 3276.700 FORMAT "%8.3" ECU_ADDRESS 0x8FFB56 /end MEASUREMENT
/begin MEASUREMENT PFlt_dpDiffNegDef_mp "Untere Schwelle Änderung Differenzdrucksignal" SWORD hPaPerSec 1 100 -3276.800 3276.700 FORMAT "%8.3" ECU_ADDRESS 0x8FFB58 /end MEASUREMENT
/begin MEASUREMENT PFlt_dpDiffPosDef_mp "Obere Schwelle Änderung Differenzdrucksignal" SWORD hPaPerSec 1 100 -3276.800 3276.700 FORMAT "%8.3" ECU_ADDRESS 0x8FFB5A /end MEASUREMENT
/begin MEASUREMENT PFlt_dpDiff_mp "PFlt_pDiff DT1 gefiltert" SWORD Pres_hPa 1 100 -32768.00 32767.00 FORMAT "%8.2" ECU_ADDRESS 0x8FFB36 /end MEASUREMENT
/begin MEASUREMENT PFlt_dqSetUnBal_mp "DT1-gefilterte Einspritzmasse" SWORD InjMass 1 100 -327.6800 327.6700 FORMAT "%8.4" ECU_ADDRESS 0x8FFB38 /end MEASUREMENT
/begin MEASUREMENT PFlt_dvol "berechneter Abgasvolumenstrom im Partikelfilter" SWORD CubMtrPerHr 1 100 -3276.800 3276.700 FORMAT "%8.3" ECU_ADDRESS 0x7F8F88 /end MEASUREMENT
/begin MEASUREMENT PFlt_dvolFlt_mp "gefilterter Abgasvolumenstrom" SWORD CubMtrPerHr 1 100 -3276.800 3276.700 FORMAT "%8.3" ECU_ADDRESS 0x8FFB5C /end MEASUREMENT
/begin MEASUREMENT PFlt_dvolMassFlt_mp "gefillterter Abgasvolumenstrom" SWORD CubMtrPerHr 1 100 -3276.800 3276.700 FORMAT "%8.3" ECU_ADDRESS 0x8FFB3A /end MEASUREMENT
/begin MEASUREMENT PFlt_facDesCor_mp "Mass Ratio after correction" SWORD Fact 1 100 -4.000000 3.999878 FORMAT "%8.6" ECU_ADDRESS 0x8FFB3C /end MEASUREMENT
/begin MEASUREMENT PFlt_facDpn_mp "Wärmeverlustfaktor nach Temperatursensor" SWORD Fact 1 100 -4.000000 3.999878 FORMAT "%8.6" ECU_ADDRESS 0x8FFB82 /end MEASUREMENT
/begin MEASUREMENT PFlt_facMltCor_mp "Korrekturfaktor Additivasche" SWORD Fact 1 100 -4.000000 3.999878 FORMAT "%8.6" ECU_ADDRESS 0x6F816C /end MEASUREMENT
/begin MEASUREMENT PFlt_mAshAdi_mp "Additivaschenmasse" SWORD mSoot_g 1 100 -327.6800 327.6700 FORMAT "%8.4" ECU_ADDRESS 0x8FFB3E /end MEASUREMENT
/begin MEASUREMENT PFlt_mAshOil "particle filter Oil ash mass" SWORD mSoot_g 1 100 -327.6800 327.6700 FORMAT "%8.4" ECU_ADDRESS 0x7F8F90 /end MEASUREMENT
/begin MEASUREMENT PFlt_mAsh_mp "Aschen-Masse" SWORD mSoot_g 1 100 -327.6800 327.6700 FORMAT "%8.4" ECU_ADDRESS 0x8FFB40 /end MEASUREMENT
/begin MEASUREMENT PFlt_mSot "Rußmasse im Partikelfilter" SWORD mSoot_g 1 100 -327.6800 327.6700 FORMAT "%8.4" ECU_ADDRESS 0x7F8F92 /end MEASUREMENT
/begin MEASUREMENT PFlt_mSotCrv_mp "Partikelmasse zur Berücksichtung des Korrekturfaktors" SWORD mSoot_g 1 100 -327.6800 327.6700 FORMAT "%8.4" ECU_ADDRESS 0x8FFB42 /end MEASUREMENT
/begin MEASUREMENT PFlt_mSotEEPROM_mp "EEPROM wert für in DPF gespeicherte Partikelmasse" SWORD mSoot_g 1 100 -327.6800 327.6700 FORMAT "%8.4" ECU_ADDRESS 0x8FFB44 /end MEASUREMENT
/begin MEASUREMENT PFlt_mSotMeas "uncorrected soot mass of physical model" SWORD mSoot_g 1 100 -327.6800 327.6700 FORMAT "%8.4" ECU_ADDRESS 0x7F8F94 /end MEASUREMENT
/begin MEASUREMENT PFlt_mSotMeasRaw_mp "Strömungswdst. in Partikelmasse umgerechnet" SWORD mSoot_g 1 100 -327.6800 327.6700 FORMAT "%8.4" ECU_ADDRESS 0x6F816E /end MEASUREMENT
/begin MEASUREMENT PFlt_mSotSim "Simulierte Rußmasse im Partikel Filter" SWORD mSoot_g 1 100 -327.6800 327.6700 FORMAT "%8.4" ECU_ADDRESS 0x7F8F96 /end MEASUREMENT
/begin MEASUREMENT PFlt_nAvrgFlt_mp "Eng_nAvrg PT1 gefiltert" SWORD EngN 1 100 -32768.00 32767.00 FORMAT "%8.2" ECU_ADDRESS 0x8FFAEE /end MEASUREMENT
/begin MEASUREMENT PFlt_pDiff "Differenzdruck über Partikelfilter" SWORD Pres_hPa 1 100 -32768.00 32767.00 FORMAT "%8.2" ECU_ADDRESS 0x7F8F9C /end MEASUREMENT
/begin MEASUREMENT PFlt_pDiffDfl_mp "Ersatzwert für PFlt_pDiff" SWORD Pres_hPa 1 100 -32768.00 32767.00 FORMAT "%8.2" ECU_ADDRESS 0x8FFB80 /end MEASUREMENT
/begin MEASUREMENT PFlt_pDiffFlt_mp "gefilterte Druckdifferenz über Partikelfilter" SWORD Pres_hPa 1 100 -32768.00 32767.00 FORMAT "%8.2" ECU_ADDRESS 0x8FFB5E /end MEASUREMENT
/begin MEASUREMENT PFlt_pDiffOfsValActMid_mp "Im Nachlauf gemittelter offset des Differenzdrucks[hpa]" SWORD Pres_hPa 1 100 -32768.00 32767.00 FORMAT "%8.2" ECU_ADDRESS 0x8FFB60 /end MEASUREMENT
/begin MEASUREMENT PFlt_pDiffOfsValAct_mp "Aktueller Offset des Differenzdrucks über Partikelfilter" SWORD Pres_hPa 1 100 -32768.00 32767.00 FORMAT "%8.2" ECU_ADDRESS 0x8FFB62 /end MEASUREMENT
/begin MEASUREMENT PFlt_pDiffOfsValOld_mp "Bisheriger Offset des Differenzdrucks über Partikelfilter" SWORD Pres_hPa 1 100 -32768.00 32767.00 FORMAT "%8.2" ECU_ADDRESS 0x8FFB64 /end MEASUREMENT
/begin MEASUREMENT PFlt_pDiffRaw "Unkorrigierter Differenzdruck über Partikelfilter" SWORD Pres_hPa 1 100 -32768.00 32767.00 FORMAT "%8.2" ECU_ADDRESS 0x7F8F9E /end MEASUREMENT
/begin MEASUREMENT PFlt_pMid "Absolutdruck im Partikelfilter" SWORD Pres_hPa 1 100 -32768.00 32767.00 FORMAT "%8.2" ECU_ADDRESS 0x7F8FA0 /end MEASUREMENT
/begin MEASUREMENT PFlt_pPre "Druck vor Partikelfilter" SWORD Pres_hPa 1 100 -32768.00 32767.00 FORMAT "%8.2" ECU_ADDRESS 0x7F8FA2 /end MEASUREMENT
/begin MEASUREMENT PFlt_pPreFlt "gefilterter Absolutdruck vor Partikelfilter" SWORD Pres_hPa 1 100 -32768.00 32767.00 FORMAT "%8.2" ECU_ADDRESS 0x7F8FA4 /end MEASUREMENT
/begin MEASUREMENT PFlt_qPoI1Des_mp "Gewünschte Einspritzmenge für Nacheinspritzung 1" SWORD InjMassInj 1 100 -327.6800 327.6700 FORMAT "%8.4" ECU_ADDRESS 0x8FFB84 /end MEASUREMENT
/begin MEASUREMENT PFlt_qPoI2NonEff "Nicht effektive PoI2-Einspritzmenge mg/zycl" SWORD InjMassCyc 1 100 -327.6800 327.6700 FORMAT "%8.4" ECU_ADDRESS 0x7F8FAA /end MEASUREMENT
/begin MEASUREMENT PFlt_qSetUnBalFlt_mp "gefilterter Wert der Einspritzmenge" SWORD InjMass 1 100 -327.6800 327.6700 FORMAT "%8.4" ECU_ADDRESS 0x8FFAF0 /end MEASUREMENT
/begin MEASUREMENT PFlt_rAccPedFlt_mp "gefiltertes Pedalwertgebersignal" SWORD Prc 1 100 -400.0000 399.9878 FORMAT "%8.4" ECU_ADDRESS 0x8FFAF2 /end MEASUREMENT
/begin MEASUREMENT PFlt_rEngPrtRgn_mp "engine protection regeneration ratio of task time and last regeneration time" SWORD Prc 1 100 -400.0000 399.9878 FORMAT "%8.4" ECU_ADDRESS 0x8FFB66 /end MEASUREMENT
/begin MEASUREMENT PFlt_resFlow "Strömungswiderstand" SWORD Res_hPaHrPerCM 1 100 -32.76800 32.76700 FORMAT "%8.5" ECU_ADDRESS 0x7F8FB0 /end MEASUREMENT
/begin MEASUREMENT PFlt_resFlowAdiOfs_mp "Strömungswiderstandoffset durch Additivasche" SWORD Res_hPaHrPerCM 1 100 -32.76800 32.76700 FORMAT "%8.5" ECU_ADDRESS 0x8FFB46 /end MEASUREMENT
/begin MEASUREMENT PFlt_resFlowFlt "gefilterter Strömungswiderstand" SWORD Res_hPaHrPerCM 1 100 -32.76800 32.76700 FORMAT "%8.5" ECU_ADDRESS 0x7F8FB2 /end MEASUREMENT
/begin MEASUREMENT PFlt_resFlowOfs "Strömungswiderstandoffset" SWORD Res_hPaHrPerCM 1 100 -32.76800 32.76700 FORMAT "%8.5" ECU_ADDRESS 0x7F8FB4 /end MEASUREMENT
/begin MEASUREMENT PFlt_resFlowOilOfs_mp "Strömungswiderstandoffset durch Additivasche" SWORD Res_hPaHrPerCM 1 100 -32.76800 32.76700 FORMAT "%8.5" ECU_ADDRESS 0x8FFB48 /end MEASUREMENT
/begin MEASUREMENT PFlt_resFlowRaw_mp "Strömungswiderstand Rohwert" SWORD Res_hPaHrPerCM 1 100 -32.76800 32.76700 FORMAT "%8.5" ECU_ADDRESS 0x6F8170 /end MEASUREMENT
/begin MEASUREMENT PFlt_rLmbd "Lambdawert" SWORD lambda 1 100 -32.76800 32.76700 FORMAT "%8.5" ECU_ADDRESS 0x7F8FAC /end MEASUREMENT
/begin MEASUREMENT PFlt_rLmbdAprx_mp "Lambda berechnet aus q_inj und dm_air" SWORD lambda 1 100 -32.76800 32.76700 FORMAT "%8.5" ECU_ADDRESS 0x8FFB2A /end MEASUREMENT
/begin MEASUREMENT PFlt_RngIdxPrj_X_mp "Input to matrix to determine range limits for the filtered vehicle speed" UBYTE OneToOne 1 100 0.00 255.0 FORMAT "%5.1" ECU_ADDRESS 0x8FFB24 /end MEASUREMENT
/begin MEASUREMENT PFlt_RngIdxPrj_Y_mp "Input to matrix to determine range limits for the filtered vehicle speed" UBYTE OneToOne 1 100 0.00 255.0 FORMAT "%5.1" ECU_ADDRESS 0x8FFB25 /end MEASUREMENT
/begin MEASUREMENT PFlt_RngIdx_X_mp "Range Index for coloumn nos of matrices" UBYTE OneToOne 1 100 0.00 255.0 FORMAT "%5.1" ECU_ADDRESS 0x8FFAF4 /end MEASUREMENT
/begin MEASUREMENT PFlt_RngIdx_Y_mp "Range Index for row nos of matrices" UBYTE OneToOne 1 100 0.00 255.0 FORMAT "%5.1" ECU_ADDRESS 0x8FFAF5 /end MEASUREMENT
/begin MEASUREMENT PFlt_rSot "Asschemasse im Filter pro Filtervolumen" SWORD Soot_gPerLtr 1 100 -327.6800 327.6700 FORMAT "%8.4" ECU_ADDRESS 0x7F8FAE /end MEASUREMENT
/begin MEASUREMENT PFlt_stAftRunDelDem "Nachlaufverzögerung für Partikelfiltermonitor" UBYTE OneToOne 1 100 0.00 255.0 FORMAT "%5.1" ECU_ADDRESS 0x7F894E /end MEASUREMENT
/begin MEASUREMENT PFlt_stBrkDeb_mp "Entprelltes Bremssignal" UBYTE OneToOne 1 100 0.00 255.0 FORMAT "%5.1" ECU_ADDRESS 0x8FFAF6 /end MEASUREMENT
/begin MEASUREMENT PFlt_stClthDeb_mp "Entprelltes Kupplungssignal" UBYTE OneToOne 1 100 0.00 255.0 FORMAT "%5.1" ECU_ADDRESS 0x8FFAF7 /end MEASUREMENT
/begin MEASUREMENT PFlt_stEngPOp "Motorbetriebspunkt" UBYTE OneToOne 1 100 0.00 255.0 FORMAT "%5.1" ECU_ADDRESS 0x7F8952 /end MEASUREMENT
/begin MEASUREMENT PFlt_stEngPOp10_mp "Motorbetriebspunkt berechnet in Check Range 10" UBYTE OneToOne 1 100 0.00 255.0 FORMAT "%5.1" ECU_ADDRESS 0x8FFAF8 /end MEASUREMENT
/begin MEASUREMENT PFlt_stEngPOp1_mp "Motorbetriebspunkt berechnet in Check Range 1" UBYTE OneToOne 1 100 0.00 255.0 FORMAT "%5.1" ECU_ADDRESS 0x8FFAF9 /end MEASUREMENT
/begin MEASUREMENT PFlt_stEngPOp2_mp "Motorbetriebspunkt berechnet in Check Range 2" UBYTE OneToOne 1 100 0.00 255.0 FORMAT "%5.1" ECU_ADDRESS 0x8FFAFA /end MEASUREMENT
/begin MEASUREMENT PFlt_stEngPOp3_mp "Motorbetriebspunkt berechnet in Check Range 3" UBYTE OneToOne 1 100 0.00 255.0 FORMAT "%5.1" ECU_ADDRESS 0x8FFAFB /end MEASUREMENT
/begin MEASUREMENT PFlt_stEngPOp4_mp "Motorbetriebspunkt berechnet in Check Range 4" UBYTE OneToOne 1 100 0.00 255.0 FORMAT "%5.1" ECU_ADDRESS 0x8FFAFC /end MEASUREMENT
/begin MEASUREMENT PFlt_stEngPOp5_mp "Motorbetriebspunkt berechnet in Check Range 5" UBYTE OneToOne 1 100 0.00 255.0 FORMAT "%5.1" ECU_ADDRESS 0x8FFAFD /end MEASUREMENT
/begin MEASUREMENT PFlt_stEngPOp6_mp "Motorbetriebspunkt berechnet in Check Range 6" UBYTE OneToOne 1 100 0.00 255.0 FORMAT "%5.1" ECU_ADDRESS 0x8FFAFE /end MEASUREMENT
/begin MEASUREMENT PFlt_stEngPOp7_mp "Motorbetriebspunkt berechnet in Check Range 7" UBYTE OneToOne 1 100 0.00 255.0 FORMAT "%5.1" ECU_ADDRESS 0x8FFAFF /end MEASUREMENT
/begin MEASUREMENT PFlt_stEngPOp8_mp "Motorbetriebspunkt berechnet in Check Range 8" UBYTE OneToOne 1 100 0.00 255.0 FORMAT "%5.1" ECU_ADDRESS 0x8FFB00 /end MEASUREMENT
/begin MEASUREMENT PFlt_stEngPOp9_mp "Motorbetriebspunkt berechnet in Check Range 9" UBYTE OneToOne 1 100 0.00 255.0 FORMAT "%5.1" ECU_ADDRESS 0x8FFB01 /end MEASUREMENT
/begin MEASUREMENT PFlt_stEngPOpPrj "Projektspezifischer Ausgabewert für Betriebszustandsberechnung" UWORD OneToOne 1 100 0.00 65535.00 FORMAT "%8.2" ECU_ADDRESS 0x7F8FB8 /end MEASUREMENT
/begin MEASUREMENT PFlt_stEngPOpSpo_mp "Statuswert Betriebspunkt ""Spontante Regeneration""" UBYTE OneToOne 1 100 0.00 255.0 FORMAT "%5.1" ECU_ADDRESS 0x8FFB02 /end MEASUREMENT
/begin MEASUREMENT PFlt_stEngPrtRgn_mp "Status of engine protection regeneration" UWORD OneToOne 1 100 0.00 65535.00 FORMAT "%8.2" ECU_ADDRESS 0x8FFB68 /end MEASUREMENT
/begin MEASUREMENT PFlt_stGearDeb_mp "Entprelltes Gangsignal" SBYTE OneToOne 1 100 -128.0 127.0 FORMAT "%5.1" ECU_ADDRESS 0x8FFB03 /end MEASUREMENT
/begin MEASUREMENT PFlt_stLckTempPlaus_mp "Verriegelungsstatus Plausibilisierung Temperatursensoren" UBYTE OneToOne 1 100 0.00 255.0 FORMAT "%5.1" ECU_ADDRESS 0x8FFB6A /end MEASUREMENT
/begin MEASUREMENT PFlt_stLckTmr_mp "Verriegelung Timer Temperaturplausibilisierung" UBYTE OneToOne 1 100 0.00 255.0 FORMAT "%5.1" ECU_ADDRESS 0x8FFB6B /end MEASUREMENT
/begin MEASUREMENT PFlt_stPresDiffPlaus_mp "Zustand Plausibilisierung Differenzdrucksignal" UBYTE OneToOne 1 100 0.00 255.0 FORMAT "%5.1" ECU_ADDRESS 0x8FFB6C /end MEASUREMENT
/begin MEASUREMENT PFlt_stResFlowHi_mp "Obere Schwelle Resflow-SRC überschritten" UBYTE OneToOne 1 100 0.00 255.0 FORMAT "%5.1" ECU_ADDRESS 0x8FFB6D /end MEASUREMENT
/begin MEASUREMENT PFlt_stResFlowLo_mp "Untere Schwelle ResFlow-SRC unterschritten" UBYTE OneToOne 1 100 0.00 255.0 FORMAT "%5.1" ECU_ADDRESS 0x8FFB6E /end MEASUREMENT
/begin MEASUREMENT PFlt_stRgnRlsOff_mp "Filter is no longer regeneratable" UBYTE OneToOne 1 100 0.00 255.0 FORMAT "%5.1" ECU_ADDRESS 0x8FFB6F /end MEASUREMENT
/begin MEASUREMENT PFlt_stRlsmSotCtl_mp "Status of engine protection regeneration for release of soot control" UBYTE OneToOne 1 100 0.00 255.0 FORMAT "%5.1" ECU_ADDRESS 0x8FFB70 /end MEASUREMENT
/begin MEASUREMENT PFlt_stRng10_mp "Statuswort Bereich 10" UWORD OneToOne 1 100 0.00 65535.00 FORMAT "%8.2" ECU_ADDRESS 0x8FFB04 /end MEASUREMENT
/begin MEASUREMENT PFlt_stRng1_mp "Statuswort Bereich 1" UWORD OneToOne 1 100 0.00 65535.00 FORMAT "%8.2" ECU_ADDRESS 0x8FFB06 /end MEASUREMENT
/begin MEASUREMENT PFlt_stRng2_mp "Statuswort Bereich 2" UWORD OneToOne 1 100 0.00 65535.00 FORMAT "%8.2" ECU_ADDRESS 0x8FFB08 /end MEASUREMENT
/begin MEASUREMENT PFlt_stRng3_mp "Statuswort Bereich 3" UWORD OneToOne 1 100 0.00 65535.00 FORMAT "%8.2" ECU_ADDRESS 0x8FFB0A /end MEASUREMENT
/begin MEASUREMENT PFlt_stRng4_mp "Statuswort Bereich 4" UWORD OneToOne 1 100 0.00 65535.00 FORMAT "%8.2" ECU_ADDRESS 0x8FFB0C /end MEASUREMENT
/begin MEASUREMENT PFlt_stRng5_mp "Statuswort Bereich 5" UWORD OneToOne 1 100 0.00 65535.00 FORMAT "%8.2" ECU_ADDRESS 0x8FFB0E /end MEASUREMENT
/begin MEASUREMENT PFlt_stRng6_mp "Statuswort Bereich 6" UWORD OneToOne 1 100 0.00 65535.00 FORMAT "%8.2" ECU_ADDRESS 0x8FFB10 /end MEASUREMENT
/begin MEASUREMENT PFlt_stRng7_mp "Statuswort Bereich 7" UWORD OneToOne 1 100 0.00 65535.00 FORMAT "%8.2" ECU_ADDRESS 0x8FFB12 /end MEASUREMENT
/begin MEASUREMENT PFlt_stRng8_mp "Statuswort Bereich 8" UWORD OneToOne 1 100 0.00 65535.00 FORMAT "%8.2" ECU_ADDRESS 0x8FFB14 /end MEASUREMENT
/begin MEASUREMENT PFlt_stRng9_mp "Statuswort Bereich 9" UWORD OneToOne 1 100 0.00 65535.00 FORMAT "%8.2" ECU_ADDRESS 0x8FFB16 /end MEASUREMENT
/begin MEASUREMENT PFlt_stRngSpo_mp "Statuswort Bereich ""Spontane Regeneration""" UWORD OneToOne 1 100 0.00 65535.00 FORMAT "%8.2" ECU_ADDRESS 0x8FFB18 /end MEASUREMENT
/begin MEASUREMENT PFlt_stSimOn "Statusbit Simulation aktiv" UBYTE OneToOne 1 100 0.00 255.0 FORMAT "%5.1" ECU_ADDRESS 0x7F8955 /end MEASUREMENT
/begin MEASUREMENT PFlt_stSimOn_mp "Statuswort Simulation aktiv" UBYTE OneToOne 1 100 0.00 255.0 FORMAT "%5.1" ECU_ADDRESS 0x8FFB4A /end MEASUREMENT
/begin MEASUREMENT PFlt_stTempPlausDone_mp "Statusbit Plausibilisierung Temperatursensoren durchgeführt" UBYTE OneToOne 1 100 0.00 255.0 FORMAT "%5.1" ECU_ADDRESS 0x8FFB71 /end MEASUREMENT
/begin MEASUREMENT PFlt_tClntFlt_mp "CTSCD_tClnt PT1 gefiltert" SWORD Temp_Cels 1 100 -50.140 899.860 FORMAT "%8.3" ECU_ADDRESS 0x8FFB1A /end MEASUREMENT
/begin MEASUREMENT PFlt_tDiffCorr_mp "Temperaturabweichung durch instationären Betrieb" SWORD TempDiff_Cels 1 100 -3276.800 3276.700 FORMAT "%8.3" ECU_ADDRESS 0x8FFB86 /end MEASUREMENT
/begin MEASUREMENT PFlt_tDwnStrm_mp "Zweite Abgastemperatur zur Überwachung" SWORD Temp_Cels 1 100 -50.140 899.860 FORMAT "%8.3" ECU_ADDRESS 0x8FFB72 /end MEASUREMENT
/begin MEASUREMENT PFlt_tExhGsStyRgn1_mp "PFlt_tExhGsStyRgn1_MAP" SWORD TempDiff_Cels 1 100 -3276.800 3276.700 FORMAT "%8.3" ECU_ADDRESS 0x8FFB88 /end MEASUREMENT
/begin MEASUREMENT PFlt_tExhGsStyRgn2_mp "Static soot emission" SWORD TempDiff_Cels 1 100 -3276.800 3276.700 FORMAT "%8.3" ECU_ADDRESS 0x8FFB8A /end MEASUREMENT
/begin MEASUREMENT PFlt_tHtTransCor_mp "Temperaturkorrekturwert Wärmeübergang" SWORD TempDiff_Cels 1 100 -3276.800 3276.700 FORMAT "%8.3" ECU_ADDRESS 0x8FFB8C /end MEASUREMENT
/begin MEASUREMENT PFlt_tIATLoLvl_mp "niedrigster Wert der Ansauglufttemperatur" SWORD Temp_Cels 1 100 -50.140 899.860 FORMAT "%8.3" ECU_ADDRESS 0x8FFB74 /end MEASUREMENT
/begin MEASUREMENT PFlt_tiChkTmpPlaus_mp "Abgelaufene Zeit nach Motorstopp, wenn die EEPROM-Zähler noch nicht abgelaufen ist." UWORD Time_s 1 100 0.00 655.3500 FORMAT "%8.4" ECU_ADDRESS 0x8FFB76 /end MEASUREMENT
/begin MEASUREMENT PFlt_tiExhGsDel_mp "Verzögerungszeit Abgas" SWORD TimeDelay_s 1 100 0.13107600 4294.9673 FORMAT "%9.4" ECU_ADDRESS 0x8FFB8E /end MEASUREMENT
/begin MEASUREMENT PFlt_tiHtTransDT1_mp "Wärmeübergangszeit" SWORD TimeDelay_s 1 100 0.13107600 4294.9673 FORMAT "%9.4" ECU_ADDRESS 0x8FFB90 /end MEASUREMENT
/begin MEASUREMENT PFlt_tiOpOld_mp "Time since engine on read from EEPROM since engine protection became active" ULONG TimeEngOn 1 100 0.00 4294967295.00 FORMAT "%13.2" ECU_ADDRESS 0x8FFB78 /end MEASUREMENT
/begin MEASUREMENT PFlt_tOxiPre "Temperatur vor Oxidationskatalysator" SWORD Temp_Cels 1 100 -50.140 899.860 FORMAT "%8.3" ECU_ADDRESS 0x7F8FBA /end MEASUREMENT
/begin MEASUREMENT PFlt_tOxiPreFlt_mp "OxiCCD_tPre PT1 gefiltert" SWORD Temp_Cels 1 100 -50.140 899.860 FORMAT "%8.3" ECU_ADDRESS 0x8FFB1C /end MEASUREMENT
/begin MEASUREMENT PFlt_tOxiPreRaw_mp "Kennfeldberechnete Temperatur vor dem Oxi-Kat" SWORD Temp_Cels 1 100 -50.140 899.860 FORMAT "%8.3" ECU_ADDRESS 0x8FFB92 /end MEASUREMENT
/begin MEASUREMENT PFlt_tOxiPreSty "Stationäre Temperatur vor Oxidationskatalysator" SWORD Temp_Cels 1 100 -50.140 899.860 FORMAT "%8.3" ECU_ADDRESS 0x7F8FBC /end MEASUREMENT
/begin MEASUREMENT PFlt_tPFltMon_mp "Motortemperatur aus Kennfeld" SWORD Temp_Cels 1 100 -50.140 899.860 FORMAT "%8.3" ECU_ADDRESS 0x8FFB7C /end MEASUREMENT
/begin MEASUREMENT PFlt_tPOpAir_mp "Ansauglufttemperatur aus Kennfeld" SWORD Temp_Cels 1 100 -50.140 899.860 FORMAT "%8.3" ECU_ADDRESS 0x8FFB1E /end MEASUREMENT
/begin MEASUREMENT PFlt_tPOpClnt_mp "Kühlflüssigkeitstemperatur aus Kennfeld" SWORD Temp_Cels 1 100 -50.140 899.860 FORMAT "%8.3" ECU_ADDRESS 0x8FFB20 /end MEASUREMENT
/begin MEASUREMENT PFlt_tPre "Abgastemp. vor Partikelfilter" SWORD Temp_Cels 1 100 -50.140 899.860 FORMAT "%8.3" ECU_ADDRESS 0x7F8FC0 /end MEASUREMENT
/begin MEASUREMENT PFlt_tPreCorr_mp "Korrigiertes Temperatursignal vor Partikelfilter" SWORD Temp_Cels 1 100 -50.140 899.860 FORMAT "%8.3" ECU_ADDRESS 0x8FFB94 /end MEASUREMENT
/begin MEASUREMENT PFlt_tPreFlt_mp "PFlt_tPre PT1 gefiltert" SWORD Temp_Cels 1 100 -50.140 899.860 FORMAT "%8.3" ECU_ADDRESS 0x6F8160 /end MEASUREMENT
/begin MEASUREMENT PFlt_tPreRaw_mp "Kennfeldberechnete Temperatur vor dem Partikelfilter" SWORD Temp_Cels 1 100 -50.140 899.860 FORMAT "%8.3" ECU_ADDRESS 0x8FFB96 /end MEASUREMENT
/begin MEASUREMENT PFlt_tPreSty "Stationäre Temperatur vor Partikelfilter" SWORD Temp_Cels 1 100 -50.140 899.860 FORMAT "%8.3" ECU_ADDRESS 0x7F8FC2 /end MEASUREMENT
/begin MEASUREMENT PFlt_tPstSim "Simulierte Temperatur nach Partikelfilter" SWORD Temp_Cels 1 100 -50.140 899.860 FORMAT "%8.3" ECU_ADDRESS 0x7F8FC4 /end MEASUREMENT
/begin MEASUREMENT PFlt_tSurf "Oberflächen Temperatur vom Partikel Filter" SWORD Temp_Cels 1 100 -50.140 899.860 FORMAT "%8.3" ECU_ADDRESS 0x7F8FC6 /end MEASUREMENT
/begin MEASUREMENT PFlt_tSurfSim_mp "modellierte Partikelfilteroberflächentemperatur" SWORD Temp_Cels 1 100 -50.140 899.860 FORMAT "%8.3" ECU_ADDRESS 0x8FFB98 /end MEASUREMENT
/begin MEASUREMENT PFlt_tTotCor_mp "Additiver Temperaturkorrekturwert" SWORD TempDiff_Cels 1 100 -3276.800 3276.700 FORMAT "%8.3" ECU_ADDRESS 0x8FFB9A /end MEASUREMENT
/begin MEASUREMENT PFlt_tUpStrm_mp "Erste Abgastemperatur zur Überwachung" SWORD Temp_Cels 1 100 -50.140 899.860 FORMAT "%8.3" ECU_ADDRESS 0x8FFB7E /end MEASUREMENT
/begin MEASUREMENT PFlt_uBattCDFlt_mp "gefilterte Batteriespannung" SWORD Volt_Batt 1 100 -640625.6 640606.1 FORMAT "%8.1" ECU_ADDRESS 0x8FFB22 /end MEASUREMENT
/begin MEASUREMENT PFlt_volAddTot_mp "Gesamt eingespritzte Additivvolumen (grob Auflösung)" SWORD volAdd_ml2 1 100 -32768.00 32767.00 FORMAT "%8.2" ECU_ADDRESS 0x8FFB4C /end MEASUREMENT
/begin MEASUREMENT PFlt_vVehFlt_mp "VSSCD_v PT1 gefiltert" SWORD Vel 1 100 -327.6800 327.6700 FORMAT "%8.4" ECU_ADDRESS 0x6F8162 /end MEASUREMENT
/begin MEASUREMENT PFlt_vVehUnFltMax_mp "Maximum value of unfiltered vehicle speed" SWORD Vel 1 100 -327.6800 327.6700 FORMAT "%8.4" ECU_ADDRESS 0x8FFB26 /end MEASUREMENT
/begin MEASUREMENT PFlt_vVehUnFltMin_mp "Minimum Grenzen für ungefilterte Fahrgeschwindigkeit" SWORD Vel 1 100 -327.6800 327.6700 FORMAT "%8.4" ECU_ADDRESS 0x8FFB28 /end MEASUREMENT
/begin MEASUREMENT PrpBrk_trqDes "Vortriebsmomentwunsch der Längsbewegung" SWORD TrqPrp 1 100 -6553.600 6553.400 FORMAT "%8.3" ECU_ADDRESS 0x7F8FCC /end MEASUREMENT
/begin MEASUREMENT PrpBrk_trqLead "Vorhaltmoment der Längsbewegung" SWORD TrqPrp 1 100 -6553.600 6553.400 FORMAT "%8.3" ECU_ADDRESS 0x7F8FCE /end MEASUREMENT
/begin MEASUREMENT PrpCtl_stSPTrack_mp "Status Sollwertnachführung" UBYTE OneToOne 1 100 0.00 255.0 FORMAT "%5.1" ECU_ADDRESS 0x8FFBA8 /end MEASUREMENT
/begin MEASUREMENT PrpCtl_swtSpdLim "SW-Schalter Aktivierung Geschwindigkeitsbegrenzung (0: deaktiviert, 1 aktiviert)" UBYTE OneToOne 1 100 0.00 255.0 FORMAT "%5.1" ECU_ADDRESS 0x7F8959 /end MEASUREMENT
/begin MEASUREMENT PrpCtl_trqI_mp "Status I-Anteil" SLONG TrqPrp 1 100 -429496729.600 429496729.400 FORMAT "%13.3" ECU_ADDRESS 0x8FFBAC /end MEASUREMENT
/begin MEASUREMENT PrpCtl_trqP_mp "Status PI-Anteil" SWORD TrqPrp 1 100 -6553.600 6553.400 FORMAT "%8.3" ECU_ADDRESS 0x8FFBB0 /end MEASUREMENT
/begin MEASUREMENT PrpCtl_trqSpdLim "begrenztes Moment für Höchstgeschwindigkeitsbegrenzung" SWORD TrqPrp 1 100 -6553.600 6553.400 FORMAT "%8.3" ECU_ADDRESS 0x7F8FD0 /end MEASUREMENT
/begin MEASUREMENT PrpCtl_vCurrTrack_mp "nachgeführter Geschwindigkeitssollwert" SWORD Vel 1 100 -327.6800 327.6700 FORMAT "%8.4" ECU_ADDRESS 0x8FFBB2 /end MEASUREMENT
/begin MEASUREMENT Prp_rAPP "verknüpfte Fahrpedalstellung PWG und virtuelles PWG" SWORD Prc 1 100 -400.0000 399.9878 FORMAT "%8.4" ECU_ADDRESS 0x7F8FD2 /end MEASUREMENT
/begin MEASUREMENT Prp_rVirtAPP "virtuelle Fahrpedalstellung bei FGR oder HGB" SWORD Prc 1 100 -400.0000 399.9878 FORMAT "%8.4" ECU_ADDRESS 0x7F8FD4 /end MEASUREMENT
/begin MEASUREMENT Prp_rVirtEngPrp_mp "Virtuelle Fahrpedalstellung aus inversem Fahrverhaltenkennfeld" SWORD Prc 1 100 -400.0000 399.9878 FORMAT "%8.4" ECU_ADDRESS 0x8FFB9E /end MEASUREMENT
/begin MEASUREMENT Prp_rVirtOvrRun_mp "Virtuelle Fahrpedalstellung aus der inversen Schubkennlinie" SWORD Prc 1 100 -400.0000 399.9878 FORMAT "%8.4" ECU_ADDRESS 0x8FFBA0 /end MEASUREMENT
/begin MEASUREMENT Prp_stPrpSel "ACC or FGR present" UBYTE OneToOne 1 100 0.00 255.0 FORMAT "%5.1" ECU_ADDRESS 0x7F895A /end MEASUREMENT
/begin MEASUREMENT Prp_stTrqTypePrp "Indikator ob Verlustmomentenkompensation applikativ deaktiviert ist" UBYTE OneToOne 1 100 0.00 255.0 FORMAT "%5.1" ECU_ADDRESS 0x7F895B /end MEASUREMENT
/begin MEASUREMENT Prp_stVirtApp "virtuellle PWG-Stellung überschreibt die gemessene" UBYTE OneToOne 1 100 0.00 255.0 FORMAT "%5.1" ECU_ADDRESS 0x7F895C /end MEASUREMENT
/begin MEASUREMENT Prp_trqEng "unnoetige message" SWORD Trq 1 100 -3276.800 3276.700 FORMAT "%8.3" ECU_ADDRESS 0x7F8FD8 /end MEASUREMENT
/begin MEASUREMENT Prp_trqEngPrp_mp "Meßpunkt der Auswahl zwischen Prp_trqEng oder Prp_trqPrp" SWORD TrqPrp 1 100 -6553.600 6553.400 FORMAT "%8.3" ECU_ADDRESS 0x8FFBA2 /end MEASUREMENT
/begin MEASUREMENT Prp_trqLead "Vorhaltmoment des Vortriebs" SWORD TrqPrp 1 100 -6553.600 6553.400 FORMAT "%8.3" ECU_ADDRESS 0x7F8FDA /end MEASUREMENT
/begin MEASUREMENT Prp_trqPrp "Vortriebsmoment" SWORD TrqPrp 1 100 -6553.600 6553.400 FORMAT "%8.3" ECU_ADDRESS 0x7F8FDC /end MEASUREMENT
/begin MEASUREMENT Prp_trqRaw "Vortriebsmomentwunsch vor Führungsformer" SWORD TrqPrp 1 100 -6553.600 6553.400 FORMAT "%8.3" ECU_ADDRESS 0x7F8FDE /end MEASUREMENT
/begin MEASUREMENT Prp_trqRawLim "Grenzwert des Vortriebsmomentenrohwertes" SWORD TrqPrp 1 100 -6553.600 6553.400 FORMAT "%8.3" ECU_ADDRESS 0x7F8FE0 /end MEASUREMENT
/begin MEASUREMENT Prp_trqThresPrp_mp "Drehmomentenschwelle zur Unterscheidung zwischen Zug- und Schubbetrieb" SWORD TrqPrp 1 100 -6553.600 6553.400 FORMAT "%8.3" ECU_ADDRESS 0x8FFBA4 /end MEASUREMENT
/begin MEASUREMENT PSPCD_dvol1_mp "limiting value of fuel depending on engine speed  and fuel temperature" SWORD FlConsum_l_h 1 100 -327.6800 327.6700 FORMAT "%8.4" ECU_ADDRESS 0x8FFBB4 /end MEASUREMENT
/begin MEASUREMENT PSPCD_dvol2_mp "Output value after correction based on fuel temperature" SWORD FlConsum_l_h 1 100 -327.6800 327.6700 FORMAT "%8.4" ECU_ADDRESS 0x8FFBB6 /end MEASUREMENT
/begin MEASUREMENT PSPCD_dvolOut "Output fuel consumption quantity from PSPCD" SWORD FlConsum_l_h 1 100 -327.6800 327.6700 FORMAT "%8.4" ECU_ADDRESS 0x7F8FCA /end MEASUREMENT
/begin MEASUREMENT PSPCD_dvolOut0_mp "limiting output fuel volume" SWORD FlConsum_l_h 1 100 -327.6800 327.6700 FORMAT "%8.4" ECU_ADDRESS 0x8FFBB8 /end MEASUREMENT
/begin MEASUREMENT PSPCD_dvolOut1_mp "Fuel quantity value depending on timer" SWORD FlConsum_l_h 1 100 -327.6800 327.6700 FORMAT "%8.4" ECU_ADDRESS 0x8FFBBA /end MEASUREMENT
/begin MEASUREMENT PSPCD_dvolOut2_mp "Output fuel quantity depending on the Engine speed" SWORD FlConsum_l_h 1 100 -327.6800 327.6700 FORMAT "%8.4" ECU_ADDRESS 0x8FFBBC /end MEASUREMENT
/begin MEASUREMENT PSPCD_dvolOut3_mp "Pre Supply Pump output value" SWORD FlConsum_l_h 1 100 -327.6800 327.6700 FORMAT "%8.4" ECU_ADDRESS 0x8FFBBE /end MEASUREMENT
/begin MEASUREMENT PSPCD_stLogic_mp "Status of Engine,T15" UBYTE OneToOne 1 100 0.00 255.0 FORMAT "%5.1" ECU_ADDRESS 0x8FFBC0 /end MEASUREMENT
/begin MEASUREMENT PSPCD_tiT15Delay_mp "Time till which timer should run" SWORD Time_ms 1 100 -327680.0 327670.0 FORMAT "%8.1" ECU_ADDRESS 0x8FFBC2 /end MEASUREMENT
/begin MEASUREMENT QLTCD_B_ozfbsd_mp "" UBYTE B_TRUE 1 100 0.00 1.00000000000 FORMAT "%13.11" ECU_ADDRESS 0x8FFBC4 /end MEASUREMENT
/begin MEASUREMENT QLTCD_CommErr_mp "" UBYTE OneToOne 1 100 0.00 255.0 FORMAT "%5.1" ECU_ADDRESS 0x8FFBC5 /end MEASUREMENT
/begin MEASUREMENT QLTCD_oznivr "" UBYTE DEZ 1 100 0.00 255.0 FORMAT "%5.1" ECU_ADDRESS 0x7F8973 /end MEASUREMENT
/begin MEASUREMENT QLTCD_ozpermr_w "" UWORD DEZ 1 100 0.00 65535.00 FORMAT "%8.2" ECU_ADDRESS 0x7F8FFA /end MEASUREMENT
/begin MEASUREMENT QLTCD_ozstatus "" UBYTE DEZ 1 100 0.00 255.0 FORMAT "%5.1" ECU_ADDRESS 0x7F8974 /end MEASUREMENT
/begin MEASUREMENT QLTCD_oztempr "" UBYTE DEZ 1 100 0.00 255.0 FORMAT "%5.1" ECU_ADDRESS 0x7F8975 /end MEASUREMENT
/begin MEASUREMENT QLTCD_oz_permh_r_mp "" UBYTE OneToOne 1 100 0.00 255.0 FORMAT "%5.1" ECU_ADDRESS 0x8FFBC6 /end MEASUREMENT
/begin MEASUREMENT QLTCD_oz_perml_r_mp "" UBYTE OneToOne 1 100 0.00 255.0 FORMAT "%5.1" ECU_ADDRESS 0x8FFBC7 /end MEASUREMENT
/begin MEASUREMENT QLTCD_State_Handler_mp "" UWORD OneToOne 1 100 0.00 65535.00 FORMAT "%8.2" ECU_ADDRESS 0x8FFBC8 /end MEASUREMENT
/begin MEASUREMENT QLTCD_State_mp "" UWORD OneToOne 1 100 0.00 65535.00 FORMAT "%8.2" ECU_ADDRESS 0x8FFBCA /end MEASUREMENT
/begin MEASUREMENT QLTCD_stComQLTActiv "" UBYTE DEZ 1 100 0.00 255.0 FORMAT "%5.1" ECU_ADDRESS 0x7F8976 /end MEASUREMENT
/begin MEASUREMENT QLTCD_stTBss_Active_mp "" UBYTE B_TRUE 1 100 0.00 1.00000000000 FORMAT "%13.11" ECU_ADDRESS 0x8FFBCC /end MEASUREMENT
/begin MEASUREMENT QLTCD_SwitchState_mp "" UWORD OneToOne 1 100 0.00 65535.00 FORMAT "%8.2" ECU_ADDRESS 0x8FFBCE /end MEASUREMENT
/begin MEASUREMENT RailCD_ctPMonStrt_mp "counter for error monitoring" ULONG Time_ms 1 100 0.00 42949672950.0 FORMAT "%13.1" ECU_ADDRESS 0x8FFCC0 /end MEASUREMENT
/begin MEASUREMENT RailCD_pAct_mp "aktueller Kraftstoffdruck" SWORD Pres_Rail 1 100 -3276.800 3276.700 FORMAT "%5.3" ECU_ADDRESS 0x6F818A /end MEASUREMENT
/begin MEASUREMENT RailCD_pFltWinNeg_mp "Raildruckabfall, ab welchem auf Großsignalparameter umgeschaltet wird" SWORD Pres_Rail 1 100 -3276.800 3276.700 FORMAT "%5.3" ECU_ADDRESS 0x8FFCB0 /end MEASUREMENT
/begin MEASUREMENT RailCD_pLin_mp "linearisierter Wert des Kraftstoffdrucksensors" SWORD Pres_Rail 1 100 -3276.800 3276.700 FORMAT "%5.3" ECU_ADDRESS 0x8FFCB2 /end MEASUREMENT
/begin MEASUREMENT RailCD_pPeak "maximaler Raildruck der letzten 10ms" SWORD Pres_Rail 1 100 -3276.800 3276.700 FORMAT "%5.3" ECU_ADDRESS 0x7F8FFE /end MEASUREMENT
/begin MEASUREMENT RailCD_stEngStrtMov_mp "Motorbewegung bei Offset-Überwachung des Raildrucksensors festgestellt" UBYTE OneToOne 1 100 0.00 255.0 FORMAT "%5.1" ECU_ADDRESS 0x8FFCB8 /end MEASUREMENT
/begin MEASUREMENT RailCD_stMon_mp "Überwachungsstatus des Spannungsoffsets des Raildrucksensors" UBYTE OneToOne 1 100 0.00 255.0 FORMAT "%5.1" ECU_ADDRESS 0x8FFCB9 /end MEASUREMENT
/begin MEASUREMENT RailCD_stOfsTstMon "aktueller Zustand der Offset-Überwachung für den Raildrucksensor" UBYTE OneToOne 1 100 0.00 255.0 FORMAT "%5.1" ECU_ADDRESS 0x7F8977 /end MEASUREMENT
/begin MEASUREMENT RailCD_tClntLstCyc_mp "Wassertemperatur vom letzten Fahrzyklus für die Offset-Überwachung des Raildrucksensors" SWORD Temp_Cels 1 100 -50.140 899.860 FORMAT "%8.3" ECU_ADDRESS 0x8FFCBA /end MEASUREMENT
/begin MEASUREMENT RailCD_tiFltPT1_mp "momentane Filterzeit für PT1 Filter" ULONG TimeDelay_s 1 100 0.0000010000000 4294.9673 FORMAT "%9.4" ECU_ADDRESS 0x8FFCB4 /end MEASUREMENT
/begin MEASUREMENT RailCD_tiOfsTstDel_mp "Verzögerungszeit = f(RailCD_pPeak) für Offset-Test des Raildrucksensors im Nachlauf" SWORD TimeRed 1 100 -5242.880 5242.720 FORMAT "%8.3" ECU_ADDRESS 0x8FFCBC /end MEASUREMENT
/begin MEASUREMENT RailCD_uOfsAftRun "Spannungswert des Raildrucksensors während aktiver Überwachung im Nachlauf" SWORD Volt 1 100 -160156.4 160151.5 FORMAT "%8.1" ECU_ADDRESS 0x7F9000 /end MEASUREMENT
/begin MEASUREMENT RailCD_uOfsStrt "Spannungswert des Raildrucksensors während aktiver Überwachung in der Startphase" SWORD Volt 1 100 -160156.4 160151.5 FORMAT "%8.1" ECU_ADDRESS 0x7F9006 /end MEASUREMENT
/begin MEASUREMENT RailCD_uPeakRaw "Rohwert des Raildrucks" SWORD Volt 1 100 -160156.4 160151.5 FORMAT "%8.1" ECU_ADDRESS 0x7F900C /end MEASUREMENT
/begin MEASUREMENT Rail_dvolEstAged "geschätzer Volumenstrom eines gealterten Systems" SWORD Qp_mm3_sec 1 100 -327680.0 327670.0 FORMAT "%8.1" ECU_ADDRESS 0x7F9010 /end MEASUREMENT
/begin MEASUREMENT Rail_dvolMeUnCtlDT1_mp "DT1-Anteil des Druckreglers über Zumesseinheit" SWORD Qp_mm3_sec 1 100 -327680.0 327670.0 FORMAT "%8.1" ECU_ADDRESS 0x8FFC1C /end MEASUREMENT
/begin MEASUREMENT Rail_dvolMeUnCtlI_mp "I-Anteil des Druckreglers über Zumesseinheit" SWORD Qp_mm3_sec 1 100 -327680.0 327670.0 FORMAT "%8.1" ECU_ADDRESS 0x8FFC1E /end MEASUREMENT
/begin MEASUREMENT Rail_dvolMeUnCtlP_mp "P-Anteil des Druckreglers über Zumesseinheit" SWORD Qp_mm3_sec 1 100 -327680.0 327670.0 FORMAT "%8.1" ECU_ADDRESS 0x8FFC20 /end MEASUREMENT
/begin MEASUREMENT Rail_dvolMeUnCtlUpLim "obere Stellwertbegrenzung für Druckregelung über Zumesseinheit" SWORD Qp_mm3_sec 1 100 -327680.0 327670.0 FORMAT "%8.1" ECU_ADDRESS 0x7F9012 /end MEASUREMENT
/begin MEASUREMENT Rail_dvolMeUnSet "Sollwert (Volumenstrom) von der Raildruckregelung" SWORD Qp_mm3_sec 1 100 -327680.0 327670.0 FORMAT "%8.1" ECU_ADDRESS 0x7F9014 /end MEASUREMENT
/begin MEASUREMENT Rail_dvolPreCtlCor "Botschaft für Bypasseingriff" SWORD Qp_mm3_sec 1 100 -327680.0 327670.0 FORMAT "%8.1" ECU_ADDRESS 0x7F9016 /end MEASUREMENT
/begin MEASUREMENT Rail_facMeUnTiRmpVal_mp "aktueller Rampenwert der Rampe bei Umschaltung von Regelung über Zumesseinheit auf Regelung über Druckregelventil" SWORD Fact 1 100 -4.000000 3.999878 FORMAT "%8.6" ECU_ADDRESS 0x8FFBD0 /end MEASUREMENT
/begin MEASUREMENT Rail_MeUnCtlDKd_mp "D-Verstärkung der Druckregelung über Zumesseinheit" SLONG Kd_pRail2Q 1 100 -3276800.00000 3276799.99847 FORMAT "%16.5" ECU_ADDRESS 0x8FFBD8 /end MEASUREMENT
/begin MEASUREMENT Rail_MeUnCtlIKiNeg_mp "I-Verstärkung für negative Großsignale für die Druckregelung über Zumesseinheit" ULONG Ki_pRail2Q 1 100 0.00 99999999.9767 FORMAT "%16.4" ECU_ADDRESS 0x8FFBDC /end MEASUREMENT
/begin MEASUREMENT Rail_MeUnCtlIKiPos_mp "I-Verstärkung für positive Großsignale für die Druckregelung über Zumesseinheit" ULONG Ki_pRail2Q 1 100 0.00 99999999.9767 FORMAT "%16.4" ECU_ADDRESS 0x8FFBE0 /end MEASUREMENT
/begin MEASUREMENT Rail_MeUnCtlIKi_mp "I-Verstärkung für Kleinsignale für die Druckregelung über Zumesseinheit" ULONG Ki_pRail2Q 1 100 0.00 99999999.9767 FORMAT "%16.4" ECU_ADDRESS 0x8FFBE4 /end MEASUREMENT
/begin MEASUREMENT Rail_MeUnCtlPKpNeg_mp "P-Verstärkung für negative Großsignale für die Druckregelung über Zumesseinheit" SLONG Kp_pRail2Q 1 100 -3276800.00000 3276799.99847 FORMAT "%16.5" ECU_ADDRESS 0x8FFBE8 /end MEASUREMENT
/begin MEASUREMENT Rail_MeUnCtlPKpPos_mp "P-Verstärkung für positive Großsignale für die Druckregelung über Zumesseinheit" SLONG Kp_pRail2Q 1 100 -3276800.00000 3276799.99847 FORMAT "%16.5" ECU_ADDRESS 0x8FFBEC /end MEASUREMENT
/begin MEASUREMENT Rail_MeUnCtlPKp_mp "P-Verstärkung für Kleinsignale für die Druckregelung über Zumesseinheit" SLONG Kp_pRail2Q 1 100 -3276800.00000 3276799.99847 FORMAT "%16.5" ECU_ADDRESS 0x8FFBF0 /end MEASUREMENT
/begin MEASUREMENT Rail_PCVCtlDKd_mp "D-Verstärkung der Druckregelung über Druckregelventil" SLONG Kd 1 100 -32768.0000000 32767.9999847 FORMAT "%13.7" ECU_ADDRESS 0x8FFBFC /end MEASUREMENT
/begin MEASUREMENT Rail_PCVCtlIKiNeg_mp "I-Verstärkung für negative Großsignale für die Druckregelung über Druckregelventil" ULONG Ki 1 100 0.00 999999.999767 FORMAT "%13.6" ECU_ADDRESS 0x8FFC00 /end MEASUREMENT
/begin MEASUREMENT Rail_PCVCtlIKiPos_mp "I-Verstärkung für positive Großsignale für die Druckregelung über Druckregelventil" ULONG Ki 1 100 0.00 999999.999767 FORMAT "%13.6" ECU_ADDRESS 0x8FFC04 /end MEASUREMENT
/begin MEASUREMENT Rail_PCVCtlIKi_mp "I-Verstärkung für Kleinsignale für die Druckregelung über Druckregelventil" ULONG Ki 1 100 0.00 999999.999767 FORMAT "%13.6" ECU_ADDRESS 0x8FFC08 /end MEASUREMENT
/begin MEASUREMENT Rail_PCVCtlPKpNeg_mp "P-Verstärkung für negative Großsignale für die Druckregelung über Druckregelventil" SLONG Kp 1 100 -32768.0000000 32767.9999847 FORMAT "%13.7" ECU_ADDRESS 0x8FFC0C /end MEASUREMENT
/begin MEASUREMENT Rail_PCVCtlPKpPos_mp "P-Verstärkung für positive Großsignale für die Druckregelung über Druckregelventil" SLONG Kp 1 100 -32768.0000000 32767.9999847 FORMAT "%13.7" ECU_ADDRESS 0x8FFC10 /end MEASUREMENT
/begin MEASUREMENT Rail_PCVCtlPKp_mp "P-Verstärkung für Kleinsignale für die Druckregelung über Druckregelventil" SLONG Kp 1 100 -32768.0000000 32767.9999847 FORMAT "%13.7" ECU_ADDRESS 0x8FFC14 /end MEASUREMENT
/begin MEASUREMENT Rail_pDvt "Raildruckregler-Regelabweichung" SWORD Pres_Rail 1 100 -3276.800 3276.700 FORMAT "%5.3" ECU_ADDRESS 0x7F9026 /end MEASUREMENT
/begin MEASUREMENT Rail_pDvtFltLim_mp "gefilterte Regelabweichung des Raildrucks" SWORD Pres_Rail 1 100 -3276.800 3276.700 FORMAT "%5.3" ECU_ADDRESS 0x8FFC22 /end MEASUREMENT
/begin MEASUREMENT Rail_pMeUnDvtMax_mp "Ausgang der Kennlinie Rail_pMeUnDvtMax_CUR" SWORD Pres_Rail 1 100 -3276.800 3276.700 FORMAT "%5.3" ECU_ADDRESS 0x8FFC3C /end MEASUREMENT
/begin MEASUREMENT Rail_pMeUnDvtMin_mp "Ausgang der Kennlinie Rail_pMeUnDvtMin_CUR" SWORD Pres_Rail 1 100 -3276.800 3276.700 FORMAT "%5.3" ECU_ADDRESS 0x8FFC3E /end MEASUREMENT
/begin MEASUREMENT Rail_pMeUnPeakMin_mp "Ausgang der Kennlinie Rail_pMeUnPeakMin_CUR" SWORD Pres_Rail 1 100 -3276.800 3276.700 FORMAT "%5.3" ECU_ADDRESS 0x8FFC40 /end MEASUREMENT
/begin MEASUREMENT Rail_pNIPCVMax_mp "Ausgang des Kennfelds Rail_pNIPCVMax_MAP" SWORD Pres_Rail 1 100 -3276.800 3276.700 FORMAT "%5.3" ECU_ADDRESS 0x8FFC48 /end MEASUREMENT
/begin MEASUREMENT Rail_pNIPCVMin_mp "Ausgang des Kennfelds Rail_pNIPCVMax_MAP" SWORD Pres_Rail 1 100 -3276.800 3276.700 FORMAT "%5.3" ECU_ADDRESS 0x8FFC4A /end MEASUREMENT
/begin MEASUREMENT Rail_pPCVCtlDT1_mp "DT1-Anteil des Druckreglers über Druckregelventil" SWORD Pres_Rail 1 100 -3276.800 3276.700 FORMAT "%5.3" ECU_ADDRESS 0x8FFC26 /end MEASUREMENT
/begin MEASUREMENT Rail_pPCVCtlI_mp "I-Anteil des Druckreglers über Druckregelventil" SWORD Pres_Rail 1 100 -3276.800 3276.700 FORMAT "%5.3" ECU_ADDRESS 0x8FFC28 /end MEASUREMENT
/begin MEASUREMENT Rail_pPCVCtlLoLim_mp "untere Stellwertbegrenzung des Raildruckreglers über Druckregelventil" SWORD Pres_Rail 1 100 -3276.800 3276.700 FORMAT "%5.3" ECU_ADDRESS 0x8FFBD4 /end MEASUREMENT
/begin MEASUREMENT Rail_pPCVCtlPILim_mp "DT1-Anteil des Druckreglers über Druckregelventil (begrenzt)" SWORD Pres_Rail 1 100 -3276.800 3276.700 FORMAT "%5.3" ECU_ADDRESS 0x8FFC2A /end MEASUREMENT
/begin MEASUREMENT Rail_pPCVCtlP_mp "P-Anteil des Druckreglers über Druckregelventil" SWORD Pres_Rail 1 100 -3276.800 3276.700 FORMAT "%5.3" ECU_ADDRESS 0x8FFC2C /end MEASUREMENT
/begin MEASUREMENT Rail_pPCVCtlUpLim_mp "obere Stellwertbegrenzung des Raildruckreglers über Druckregelventil" SWORD Pres_Rail 1 100 -3276.800 3276.700 FORMAT "%5.3" ECU_ADDRESS 0x8FFBD6 /end MEASUREMENT
/begin MEASUREMENT Rail_pPCVDvtMax_mp "Ausgang der Kennlinie Rail_pPCVDvtMax_CUR" SWORD Pres_Rail 1 100 -3276.800 3276.700 FORMAT "%5.3" ECU_ADDRESS 0x8FFC4C /end MEASUREMENT
/begin MEASUREMENT Rail_pPCVInitI_mp "Initialisierung I-Anteil des Druckreglers über Druckregelventil, beim Umschalten von Zumesseinheit auf Druckregelventil" SWORD Pres_Rail 1 100 -3276.800 3276.700 FORMAT "%5.3" ECU_ADDRESS 0x8FFC2E /end MEASUREMENT
/begin MEASUREMENT Rail_pPCVPeakMin_mp "Ausgang der Kennlinie Rail_pPCVPeakMin_CUR" SWORD Pres_Rail 1 100 -3276.800 3276.700 FORMAT "%5.3" ECU_ADDRESS 0x8FFC4E /end MEASUREMENT
/begin MEASUREMENT Rail_pPCVSet "Stellwertvorgabe für das Druckregelventil" SWORD Pres_Rail 1 100 -3276.800 3276.700 FORMAT "%5.3" ECU_ADDRESS 0x7F9028 /end MEASUREMENT
/begin MEASUREMENT Rail_pPeakFlt_mp "PT1-gefilterter Raildruck für die Druckregelung über Zumesseinheit" SWORD Pres_Rail 1 100 -3276.800 3276.700 FORMAT "%5.3" ECU_ADDRESS 0x8FFC24 /end MEASUREMENT
/begin MEASUREMENT Rail_pPreCtlCor "Botschaft für Bypasseingriff" SWORD Pres_Rail 1 100 -3276.800 3276.700 FORMAT "%5.3" ECU_ADDRESS 0x7F902A /end MEASUREMENT
/begin MEASUREMENT Rail_pWindUp_mp "rückgerechneter I-Anteil wenn Stellerbegrenzung erreicht ist" SWORD Pres_Rail 1 100 -3276.800 3276.700 FORMAT "%5.3" ECU_ADDRESS 0x8FFC30 /end MEASUREMENT
/begin MEASUREMENT Rail_qMeUnCtlType_mp "mengenabhängige Hystereseschwelle zur Umschaltung auf Druckregelung über Zumesseinheit" SWORD InjMassCyc 1 100 -327.6800 327.6700 FORMAT "%8.4" ECU_ADDRESS 0x8FFC32 /end MEASUREMENT
/begin MEASUREMENT Rail_qPCVCtlType_mp "mengenabhängige Hystereseschwelle zur Umschaltung auf Druckregelung über Druckregelventil" SWORD InjMassCyc 1 100 -327.6800 327.6700 FORMAT "%8.4" ECU_ADDRESS 0x8FFC34 /end MEASUREMENT
/begin MEASUREMENT Rail_stCtlLoop "Zustand der Steuerung Raildruckregler" UBYTE OneToOne 1 100 0.00 255.0 FORMAT "%5.1" ECU_ADDRESS 0x7F8978 /end MEASUREMENT
/begin MEASUREMENT Rail_stCtlType "Status Regelkonzept und verwendetes Regelprinzip" UBYTE OneToOne 1 100 0.00 255.0 FORMAT "%5.1" ECU_ADDRESS 0x7F8979 /end MEASUREMENT
/begin MEASUREMENT Rail_stMeUnMon0_mp "Zustandsbits für Überwachung auf positive Regelabweichung" UBYTE OneToOne 1 100 0.00 255.0 FORMAT "%5.1" ECU_ADDRESS 0x8FFC42 /end MEASUREMENT
/begin MEASUREMENT Rail_stMeUnMon1_mp "Zustandsbits für Überwachung auf positive Regelabweichung und Sollwert des Volumenstroms durch die Zumesseinheit" UBYTE OneToOne 1 100 0.00 255.0 FORMAT "%5.1" ECU_ADDRESS 0x8FFC43 /end MEASUREMENT
/begin MEASUREMENT Rail_stMeUnMon2_mp "Zustandsbits für Überwachung auf negative Regelabweichung bei Nullförderung" UBYTE OneToOne 1 100 0.00 255.0 FORMAT "%5.1" ECU_ADDRESS 0x8FFC44 /end MEASUREMENT
/begin MEASUREMENT Rail_stMeUnMon3_mp "Zustandsbits für Überwachung auf minimalen Raildruck" UBYTE OneToOne 1 100 0.00 255.0 FORMAT "%5.1" ECU_ADDRESS 0x8FFC45 /end MEASUREMENT
/begin MEASUREMENT Rail_stMeUnMon4_mp "Zustandsbits für Überwachung auf maximalen Raildruck" UBYTE OneToOne 1 100 0.00 255.0 FORMAT "%5.1" ECU_ADDRESS 0x8FFC46 /end MEASUREMENT
/begin MEASUREMENT Rail_stPCVMon0_mp "Zustandsbits für Überwachung auf positive Regelabweichung" UBYTE OneToOne 1 100 0.00 255.0 FORMAT "%5.1" ECU_ADDRESS 0x8FFC50 /end MEASUREMENT
/begin MEASUREMENT Rail_stPCVMon1_mp "Zustandsbits für Überwachung auf positive Regelabweichung kombiniert mit Stellgröße des Druckregelventils" UBYTE OneToOne 1 100 0.00 255.0 FORMAT "%5.1" ECU_ADDRESS 0x8FFC51 /end MEASUREMENT
/begin MEASUREMENT Rail_stPCVMon2_mp "Zustandsbits für Überwachung auf negative Regelabweichung kombiniert mit Stellgröße des Druckregelventils" UBYTE OneToOne 1 100 0.00 255.0 FORMAT "%5.1" ECU_ADDRESS 0x8FFC52 /end MEASUREMENT
/begin MEASUREMENT Rail_stPCVMon3_mp "Zustandsbits für Überwachung auf minimalen Raildruck" UBYTE OneToOne 1 100 0.00 255.0 FORMAT "%5.1" ECU_ADDRESS 0x8FFC53 /end MEASUREMENT
/begin MEASUREMENT Rail_stPCVMon4_mp "Zustandsbits für Überwachung auf maximalen Raildruck" UBYTE OneToOne 1 100 0.00 255.0 FORMAT "%5.1" ECU_ADDRESS 0x8FFC54 /end MEASUREMENT
/begin MEASUREMENT Rail_stPCVMon5_mp "Zustandsbits für Plausibilisierung des Raildrucks mit dem Strom durch das Druckregelventil" UWORD OneToOne 1 100 0.00 65535.00 FORMAT "%8.2" ECU_ADDRESS 0x8FFC56 /end MEASUREMENT
/begin MEASUREMENT Rail_stShOffTstAck "Quittierung für Nachlauftestanforderung" UBYTE OneToOne 1 100 0.00 255.0 FORMAT "%5.1" ECU_ADDRESS 0x7F897A /end MEASUREMENT
/begin MEASUREMENT Rail_stSwtCon_mp "Status der Umschaltbedingungen für das Regelprinzip" UBYTE OneToOne 1 100 0.00 255.0 FORMAT "%5.1" ECU_ADDRESS 0x8FFC36 /end MEASUREMENT
/begin MEASUREMENT Rail_swtPreCtl "Raildruckregler mit / ohne Vorsteuerung" UBYTE OneToOne 1 100 0.00 255.0 FORMAT "%5.1" ECU_ADDRESS 0x7F897B /end MEASUREMENT
/begin MEASUREMENT Rail_swtPress "Umschaltung zwischen Steuern und Regeln anhand Absolut/Differenzwert des Raildrucks" UBYTE OneToOne 1 100 0.00 255.0 FORMAT "%5.1" ECU_ADDRESS 0x7F897C /end MEASUREMENT
/begin MEASUREMENT Rail_swtWindUp "Raildruckregler mit eingefrorenem oder rückgerechnetem I-Anteil" UBYTE OneToOne 1 100 0.00 255.0 FORMAT "%5.1" ECU_ADDRESS 0x7F897D /end MEASUREMENT
/begin MEASUREMENT Rail_tiMeUn0Deb_mp "MeUn0: Messpunkt fuer laufende Entprellzaehler" UWORD Time_ms 1 100 0.00 655350.0 FORMAT "%8.1" ECU_ADDRESS 0x6F8172 /end MEASUREMENT
/begin MEASUREMENT Rail_tiMeUn1Deb_mp "MeUn1: Messpunkt fuer laufende Entprellzaehler" UWORD Time_ms 1 100 0.00 655350.0 FORMAT "%8.1" ECU_ADDRESS 0x6F8174 /end MEASUREMENT
/begin MEASUREMENT Rail_tiMeUn2Deb_mp "MeUn2: Messpunkt fuer laufende Entprellzaehler" UWORD Time_ms 1 100 0.00 655350.0 FORMAT "%8.1" ECU_ADDRESS 0x6F8176 /end MEASUREMENT
/begin MEASUREMENT Rail_tiMeUn3Deb_mp "MeUn3: Messpunkt fuer laufende Entprellzaehler" UWORD Time_ms 1 100 0.00 655350.0 FORMAT "%8.1" ECU_ADDRESS 0x6F8178 /end MEASUREMENT
/begin MEASUREMENT Rail_tiMeUn4Deb_mp "MeUn4: Messpunkt fuer laufende Entprellzaehler" UWORD Time_ms 1 100 0.00 655350.0 FORMAT "%8.1" ECU_ADDRESS 0x6F817A /end MEASUREMENT
/begin MEASUREMENT Rail_tiMeUnCtlDT1_mp "Zeitkonstante des DT1-Gliedes für die Druckregelung über Zumesseinheit" ULONG TimeDelay_s 1 100 0.0000010000000 4294.9673 FORMAT "%9.4" ECU_ADDRESS 0x8FFBF4 /end MEASUREMENT
/begin MEASUREMENT Rail_tiMeUnCtlPT1_mp "Zeitkonstante des PT1-Filters für die Druckregelung über Zumesseinheit" ULONG TimeDelay_s 1 100 0.0000010000000 4294.9673 FORMAT "%9.4" ECU_ADDRESS 0x8FFBF8 /end MEASUREMENT
/begin MEASUREMENT Rail_tiMeUnRmpDur_mp "Laufzeit der Rampe um das Fördervolumen der Zumesseinheit vom aktuellen Sollwert auf die Maximalförderung zu rampen" SWORD InjTime_us 1 100 -32768.00 32767.00 FORMAT "%8.2" ECU_ADDRESS 0x8FFBD2 /end MEASUREMENT
/begin MEASUREMENT Rail_tiPCV0Deb_mp "PCV0: Messpunkt fuer laufende Entprellzaehler" UWORD Time_ms 1 100 0.00 655350.0 FORMAT "%8.1" ECU_ADDRESS 0x6F817C /end MEASUREMENT
/begin MEASUREMENT Rail_tiPCV1Deb_mp "PCV1: Messpunkt fuer laufende Entprellzaehler" UWORD Time_ms 1 100 0.00 655350.0 FORMAT "%8.1" ECU_ADDRESS 0x6F817E /end MEASUREMENT
/begin MEASUREMENT Rail_tiPCV2Deb_mp "PCV2: Messpunkt fuer laufende Entprellzaehler" UWORD Time_ms 1 100 0.00 655350.0 FORMAT "%8.1" ECU_ADDRESS 0x6F8180 /end MEASUREMENT
/begin MEASUREMENT Rail_tiPCV3Deb_mp "PCV3: Messpunkt fuer laufende Entprellzaehler" UWORD Time_ms 1 100 0.00 655350.0 FORMAT "%8.1" ECU_ADDRESS 0x6F8182 /end MEASUREMENT
/begin MEASUREMENT Rail_tiPCV4Deb_mp "PCV4: Messpunkt fuer laufende Entprellzaehler" UWORD Time_ms 1 100 0.00 655350.0 FORMAT "%8.1" ECU_ADDRESS 0x6F8184 /end MEASUREMENT
/begin MEASUREMENT Rail_tiPCV5Deb_mp "PCV5: Messpunkt fuer laufende Entprellzaehler" UWORD Time_ms 1 100 0.00 655350.0 FORMAT "%8.1" ECU_ADDRESS 0x6F8186 /end MEASUREMENT
/begin MEASUREMENT Rail_tiPCVCtlDT1_mp "Zeitkonstante des DT1-Gliedes für die Druckregelung über Druckregelventil" ULONG TimeDelay_s 1 100 0.0000010000000 4294.9673 FORMAT "%9.4" ECU_ADDRESS 0x8FFC18 /end MEASUREMENT
/begin MEASUREMENT Rail_tiThresMonEna "Zeitverzögerung um Plausibilisierung des Raildrucks freizugeben" UWORD Time_ms 1 100 0.00 655350.0 FORMAT "%8.1" ECU_ADDRESS 0x7F9044 /end MEASUREMENT
/begin MEASUREMENT Rail_tMeUnCtlType_mp "temperaturabhängige Hystereseschwelle zur Umschaltung auf Druckregelung über Zumesseinheit" SWORD Temp_Cels 1 100 -50.140 899.860 FORMAT "%8.3" ECU_ADDRESS 0x8FFC38 /end MEASUREMENT
/begin MEASUREMENT Rail_tPCVCtlType_mp "temperaturabhängige Hystereseschwelle zur Umschaltung auf Druckregelung über Druckregelventil" SWORD Temp_Cels 1 100 -50.140 899.860 FORMAT "%8.3" ECU_ADDRESS 0x8FFC3A /end MEASUREMENT
/begin FUNCTION pflt_engpopcalc "Betriebszustandsberechnung für Partikelfilter"
 /begin DEF_CHARACTERISTIC PFlt_nAvrgMinMax_CA PFlt_numPOpAir_C PFlt_numPOpClnt_C PFlt_qSetUnBalRng10Max_GCUR PFlt_qSetUnBalRng10Min_GCUR PFlt_qSetUnBalRng1Max_GCUR PFlt_qSetUnBalRng1Min_GCUR PFlt_qSetUnBalRng2Max_GCUR PFlt_qSetUnBalRng2Min_GCUR PFlt_qSetUnBalRng3Max_GCUR PFlt_qSetUnBalRng3Min_GCUR PFlt_qSetUnBalRng4Max_GCUR PFlt_qSetUnBalRng4Min_GCUR PFlt_qSetUnBalRng5Max_GCUR PFlt_qSetUnBalRng5Min_GCUR PFlt_qSetUnBalRng6Max_GCUR PFlt_qSetUnBalRng6Min_GCUR PFlt_qSetUnBalRng7Max_GCUR PFlt_qSetUnBalRng7Min_GCUR PFlt_qSetUnBalRng8Max_GCUR PFlt_qSetUnBalRng8Min_GCUR PFlt_qSetUnBalRng9Max_GCUR PFlt_qSetUnBalRng9Min_GCUR PFlt_qSetUnBalRngSpoMax_GCUR PFlt_qSetUnBalRngSpoMin_GCUR PFlt_qSetUnBal_AXIS PFlt_rAccPedMinMax_CA PFlt_stGearDebValMax_C PFlt_stGearDebValMin_C PFlt_stGearMinMax_CA PFlt_swtBrkRng_CA PFlt_swtClthRng_CA PFlt_tAirMinMax_CA PFlt_tClntMinMax_CA PFlt_tiAccPedPT1_C PFlt_tiBattCDPT1_C PFlt_tiDebBrkOff_C PFlt_tiDebBrkOn_C PFlt_tiDebConvOff_C PFlt_tiDebConvOn_C PFlt_tiDebGearOff_C PFlt_tiDebGearOn_C PFlt_tiEngSpdPT1_C PFlt_tiInjMsPT1_C PFlt_tiSpdVehPT1_C PFlt_tiTempClntPT1_C PFlt_tiTempOxiPrePT1_C PFlt_tiTempPrePT1_C PFlt_tOxiPreOffMinMax_CA PFlt_tOxiPreOnMinMax_CA PFlt_tPreOffMinMax_CA PFlt_tPreOnMinMax_CA PFlt_uBattMinMax_CA PFlt_vVehMinMax_CA /end DEF_CHARACTERISTIC
 /begin IN_MEASUREMENT PFlt_nAvrgFlt_mp PFlt_RngIdx_X_mp PFlt_RngIdx_Y_mp /end IN_MEASUREMENT
/end FUNCTION
/begin FUNCTION pflt_engpopcalc_msg "" /begin OUT_MEASUREMENT PFlt_stEngPOp /end OUT_MEASUREMENT /end FUNCTION
/begin FUNCTION pflt_engpopcalc_uic "" /begin DEF_CHARACTERISTIC PFlt_stEngPOp_Vector PFlt_stEngPOp_Channel /end DEF_CHARACTERISTIC
 /begin OUT_MEASUREMENT PFlt_nAvrgFlt_mp PFlt_qSetUnBalFlt_mp PFlt_rAccPedFlt_mp PFlt_RngIdx_X_mp PFlt_RngIdx_Y_mp PFlt_stBrkDeb_mp PFlt_stClthDeb_mp PFlt_stEngPOp10_mp PFlt_stEngPOp1_mp PFlt_stEngPOp2_mp PFlt_stEngPOp3_mp PFlt_stEngPOp4_mp PFlt_stEngPOp5_mp PFlt_stEngPOp6_mp PFlt_stEngPOp7_mp PFlt_stEngPOp8_mp PFlt_stEngPOp9_mp PFlt_stEngPOpSpo_mp PFlt_stGearDeb_mp PFlt_stRng10_mp PFlt_stRng1_mp PFlt_stRng2_mp PFlt_stRng3_mp PFlt_stRng4_mp PFlt_stRng5_mp PFlt_stRng6_mp PFlt_stRng7_mp PFlt_stRng8_mp PFlt_stRng9_mp PFlt_stRngSpo_mp PFlt_tClntFlt_mp PFlt_tOxiPreFlt_mp PFlt_tPOpAir_mp PFlt_tPOpClnt_mp PFlt_tPreFlt_mp PFlt_uBattCDFlt_mp PFlt_vVehFlt_mp /end OUT_MEASUREMENT
/end FUNCTION
/begin FUNCTION pflt_engpopprj "Erweiterung für Betriebszustandsberechnung" /begin DEF_CHARACTERISTIC PFlt_vVehUnFltMinMax_CA /end DEF_CHARACTERISTIC /begin IN_MEASUREMENT PFlt_RngIdxPrj_X_mp PFlt_RngIdxPrj_Y_mp /end IN_MEASUREMENT /end FUNCTION
/begin FUNCTION pflt_engpopprj_msg "" /begin OUT_MEASUREMENT PFlt_stEngPOpPrj /end OUT_MEASUREMENT /end FUNCTION
/begin FUNCTION pflt_engpopprj_uic ""
 /begin OUT_MEASUREMENT PFlt_RngIdxPrj_X_mp PFlt_RngIdxPrj_Y_mp PFlt_vVehUnFltMax_mp PFlt_vVehUnFltMin_mp /end OUT_MEASUREMENT
/end FUNCTION
/begin FUNCTION pflt_exhgsppty "dvol + Lambda" /begin DEF_CHARACTERISTIC PFlt_numLSU_C PFlt_swtASModOn_C PFlt_swtLmbdAprx_C /end DEF_CHARACTERISTIC /end FUNCTION
/begin FUNCTION pflt_exhgsppty_msg ""
 /begin OUT_MEASUREMENT PFlt_dmEG PFlt_dmO2Aprx PFlt_dvol PFlt_qPoI2NonEff PFlt_rLmbd /end OUT_MEASUREMENT
/end FUNCTION
/begin FUNCTION pflt_exhgsppty_uic "" /begin DEF_CHARACTERISTIC PFlt_dvol_Vector PFlt_dvol_Channel /end DEF_CHARACTERISTIC /begin OUT_MEASUREMENT PFlt_rLmbdAprx_mp /end OUT_MEASUREMENT /end FUNCTION
/begin FUNCTION pflt_masscalc "Berechnung der Rußmasse im Partikefilter"
 /begin DEF_CHARACTERISTIC PFlt_t1DT1Pres_C PFlt_kdDT1Pres_C PFlt_t1DT1Sim_C PFlt_kdDT1Sim_C PFlt_dmNOxEngBas_MAP PFlt_dmSotSimBas_MAP PFlt_dmSotSimDyn_CUR PFlt_dmSotSimEGRoff_MAP PFlt_dmSotSimRgnBas_CUR PFlt_dpDiffMax_C PFlt_dvolMeasMin_C PFlt_facCnvCat_CUR PFlt_facDynVisc_CUR PFlt_facEGR_CUR PFlt_facMflO2SimRgn_CUR PFlt_facMltCor_CUR PFlt_facNO2dVol_CUR PFlt_facNO2Sot_C PFlt_facSotSimRgnCRT_CUR PFlt_facTempCRT_CUR PFlt_facTempSimRgn_CUR PFlt_mAshAdi_CUR PFlt_mAshOil_CUR PFlt_mSotAdjMax_C PFlt_mSotMeas_MAP PFlt_mSotSimMax_C PFlt_mSotSubs_C PFlt_rEGRSimMax_C PFlt_rEGRSimMin_C PFlt_resFlowAdiOfs_MAP PFlt_resFlowMeasInv_MAP PFlt_resFlowOilOfs_MAP PFlt_resFlow_MAP PFlt_stResFlowPT1RgnMsk_C PFlt_stSimRgnMsk_C PFlt_swtSensEvalSel_C PFlt_swtSimInitOn_C PFlt_tiDebSimOff_C PFlt_tiDebSimOn_C PFlt_tiResFlowPT1_C PFlt_tiResFlowRgnPT1_C PFlt_tiVolFlowPT1_C PFlt_tiVolFlowRgnPT1_C PFlt_volPFlt_C /end DEF_CHARACTERISTIC
 /begin IN_MEASUREMENT Eng_nAvrg InjCtl_qSetUnBal PFlt_dmO2Aprx PFlt_dqSetUnBal_mp PFlt_dvol PFlt_dvolMassFlt_mp PFlt_facDesCor_mp PFlt_mAshAdi_mp PFlt_mAshOil PFlt_mAsh_mp PFlt_mSotCrv_mp PFlt_mSotSim PFlt_pDiff PFlt_qFlTot PFlt_resFlowFlt PFlt_tOxiPre PFlt_tSurf PFlt_volAddTot_mp /end IN_MEASUREMENT
/end FUNCTION
/begin FUNCTION pflt_masscalc_msg ""
 /begin OUT_MEASUREMENT PFlt_mAshOil PFlt_mSot PFlt_mSotMeas PFlt_mSotSim PFlt_resFlow PFlt_resFlowFlt PFlt_resFlowOfs PFlt_rSot PFlt_stSimOn /end OUT_MEASUREMENT
/end FUNCTION
/begin FUNCTION pflt_masscalc_uic ""
 /begin DEF_CHARACTERISTIC PFlt_mSot_Vector PFlt_mSot_Channel PFlt_resFlow_Vector PFlt_resFlow_Channel /end DEF_CHARACTERISTIC
 /begin OUT_MEASUREMENT PFlt_dmNO2Tot_mp PFlt_dmNOxRaw_mp PFlt_dmSotSimDyn_mp PFlt_dmSotSimEmi_mp PFlt_dmSotSimRgnCRT_mp PFlt_dmSotSimRgnThr_mp PFlt_dmSotSimRgn_mp PFlt_dmSotSimSty_mp PFlt_dmSotSim_mp PFlt_dpDiff_mp PFlt_dqSetUnBal_mp PFlt_dvolMassFlt_mp PFlt_facDesCor_mp PFlt_facMltCor_mp PFlt_mAshAdi_mp PFlt_mAsh_mp PFlt_mSotCrv_mp PFlt_mSotEEPROM_mp PFlt_mSotMeasRaw_mp PFlt_resFlowAdiOfs_mp PFlt_resFlowOilOfs_mp PFlt_resFlowRaw_mp PFlt_stSimOn_mp PFlt_volAddTot_mp /end OUT_MEASUREMENT
/end FUNCTION
/begin FUNCTION pflt_monitor "Überwachung des Partikelfilters"
 /begin DEF_CHARACTERISTIC PFlt_ctEngPrtRgn_C PFlt_ddvolHsLnPlausNeg_C PFlt_ddvolHsLnPlausPos_C PFlt_ddvolHsLnSot_C PFlt_dvolCharMonMin_C PFlt_mSotDiff_C PFlt_nTempChkTrg_C PFlt_numCntBck_C PFlt_numCntMax_C PFlt_numEngPrtActvMsk_C PFlt_numPFltMon_C PFlt_numTimeStpPlausSens_C PFlt_pBPAndAPTolcMax_C PFlt_pDiffCharMonMin_C PFlt_pDiffHsLnNeg_C PFlt_pDiffMax1_C PFlt_pDiffMax_C PFlt_pDiffMin_C PFlt_pDiffTolcMax_C PFlt_pMinNrmCldStrt_C PFlt_pPreAndBPTolcMax_C PFlt_pPreTolcMax_C PFlt_rEngPrtRgnMax_C PFlt_resFlowMax_C PFlt_resFlowMin_C PFlt_resFlowTolcDynPlaus_C PFlt_stCfgTempSens_C PFlt_swtEngPrtWrEEPROM_C PFlt_swtEnvTempSens_C PFlt_swtMonCharMin_C PFlt_swtSvcSensChng_C PFlt_swtSvcTmrRst_C PFlt_tCldStrtDfl_C PFlt_tDiffCldMax_C PFlt_tDiffTolcMax_C PFlt_tDwnStrmTolcMax_C PFlt_tEGMax_C PFlt_tEGMin_C PFlt_tFrzMin_C PFlt_tiChkTempPlausMax_CUR PFlt_DebCharMaxDef_C PFlt_DebCharMaxOk_C PFlt_DebCharMinDef_C PFlt_DebCharMinOk_C PFlt_DebEngPrtMaxDef_C PFlt_DebEngPrtMaxOk_C PFlt_DebmSotMaxDef_C PFlt_DebmSotMaxOk_C PFlt_DebPDiffDynPlausDef_C PFlt_DebPDiffDynPlausOk_C PFlt_DebHsLnPlausDef_C PFlt_DebHsLnPlausOk_C PFlt_DebPDiffMaxDef_C PFlt_DebPDiffMaxOk_C PFlt_DebPDiffMinDef_C PFlt_DebPDiffMinOk_C PFlt_DebSotPlausDef_C PFlt_DebSotPlausOk_C PFlt_DebRgnPermMaxDef_C PFlt_DebRgnPermMaxOk_C PFlt_DebTEGMaxDef_C PFlt_DebTEGMaxOk_C PFlt_DebTEGMinDef_C PFlt_DebTEGMinOk_C PFlt_tiDelOfsCalc_C PFlt_tiLckChkTempPlaus_C PFlt_tIncrDwnStrm_C PFlt_tIncrUpStrm_C PFlt_tiFltHsLnPT1_C PFlt_tUpStrmTolcMax_C /end DEF_CHARACTERISTIC
 /begin IN_MEASUREMENT BattCD_u /end IN_MEASUREMENT
/end FUNCTION
/begin FUNCTION pflt_monitor_msg "" /begin OUT_MEASUREMENT PFlt_stAftRunDelDem /end OUT_MEASUREMENT /end FUNCTION
/begin FUNCTION pflt_monitor_uic ""
 /begin OUT_MEASUREMENT PFlt_ctEngPrtRgnOld_mp PFlt_ctEngPrtRgn_mp PFlt_ddvolFlt_mp PFlt_dpDiffFlt_mp PFlt_dpDiffNegDef_mp PFlt_dpDiffPosDef_mp PFlt_dvolFlt_mp PFlt_pDiffFlt_mp PFlt_pDiffOfsValActMid_mp PFlt_pDiffOfsValAct_mp PFlt_pDiffOfsValOld_mp PFlt_rEngPrtRgn_mp PFlt_stEngPrtRgn_mp PFlt_stLckTempPlaus_mp PFlt_stLckTmr_mp PFlt_stPresDiffPlaus_mp PFlt_stResFlowHi_mp PFlt_stResFlowLo_mp PFlt_stRgnRlsOff_mp PFlt_stRlsmSotCtl_mp PFlt_stTempPlausDone_mp PFlt_tDwnStrm_mp PFlt_tIATLoLvl_mp PFlt_tiChkTmpPlaus_mp PFlt_tiOpOld_mp PFlt_tPFltMon_mp PFlt_tUpStrm_mp /end OUT_MEASUREMENT
/end FUNCTION
/begin FUNCTION pflt_sensadapt "Sensor Adaption"
 /begin DEF_CHARACTERISTIC PFlt_pDfl_C PFlt_pDiffDfl_MAP PFlt_dpDiffUp_C PFlt_dpDiffDwn_C PFlt_swtPDiffOfsOn_C PFlt_swtPresSensCfg_C PFlt_tiPPrePT1_C /end DEF_CHARACTERISTIC
 /begin IN_MEASUREMENT Eng_nAvrg InjCtl_qSetUnBal /end IN_MEASUREMENT
/end FUNCTION
/begin FUNCTION pflt_sensadapt_msg ""
 /begin OUT_MEASUREMENT PFlt_pDiff PFlt_pDiffRaw PFlt_pMid PFlt_pPre PFlt_pPreFlt PFlt_tOxiPre PFlt_tPre /end OUT_MEASUREMENT
/end FUNCTION
/begin FUNCTION pflt_sensadapt_uic "" /begin OUT_MEASUREMENT PFlt_pDiffDfl_mp /end OUT_MEASUREMENT /end FUNCTION
/begin FUNCTION pflt_tempmod "Partikelfiltertemperaturmodell"
 /begin DEF_CHARACTERISTIC PFlt_cpExhGs_C PFlt_CPFlt_C PFlt_facBlwBy_C PFlt_facDpn_MAP PFlt_facHtTransNoLin_CUR PFlt_KdDT1TempCor_C PFlt_kiITempMod_C PFlt_stRgnMsk1_C PFlt_stRgnMsk2_C PFlt_swtFacDpn_C PFlt_swtTempModOff_C PFlt_tExhGsStyRgn1_MAP PFlt_tExhGsStyRgn2_MAP PFlt_tExhGsSty_MAP PFlt_tiExhGsDel_CUR PFlt_tiHtTransDT1_CUR PFlt_tiOxiPreStyPT1_C PFlt_tiFltTempPT1_C PFlt_tiPreStyPT1_C PFlt_tRefSty_C /end DEF_CHARACTERISTIC
 /begin IN_MEASUREMENT Eng_nAvrg IATSCD_tAir InjCtl_qSetUnBal PFlt_dmEG PFlt_tDiffCorr_mp VSSCD_v /end IN_MEASUREMENT
/end FUNCTION
/begin FUNCTION pflt_tempmod_msg "" /begin OUT_MEASUREMENT PFlt_tOxiPreSty PFlt_tPreSty PFlt_tPstSim PFlt_tSurf /end OUT_MEASUREMENT /end FUNCTION
/begin FUNCTION pflt_tempmod_uic ""
 /begin OUT_MEASUREMENT PFlt_facDpn_mp PFlt_qPoI1Des_mp PFlt_tDiffCorr_mp PFlt_tExhGsStyRgn1_mp PFlt_tExhGsStyRgn2_mp PFlt_tHtTransCor_mp PFlt_tiExhGsDel_mp PFlt_tiHtTransDT1_mp PFlt_tOxiPreRaw_mp PFlt_tPreCorr_mp PFlt_tPreRaw_mp PFlt_tSurfSim_mp PFlt_tTotCor_mp /end OUT_MEASUREMENT
/end FUNCTION
/begin FUNCTION prpbrk_msg "" /begin OUT_MEASUREMENT PrpBrk_trqDes PrpBrk_trqLead /end OUT_MEASUREMENT /end FUNCTION
/begin FUNCTION prpctl "Vortriebsregelung"
 /begin DEF_CHARACTERISTIC PrpCtl_SpdLim4IKi_C PrpCtl_SpdLim4IKiPos_C PrpCtl_SpdLim4IKiNeg_C PrpCtl_vSpdLim4IWinPos_C PrpCtl_vSpdLim4IWinNeg_C PrpCtl_SpdLim4PKp_C PrpCtl_SpdLim4PKpPos_C PrpCtl_SpdLim4PKpNeg_C PrpCtl_vSpdLim4PWinPos_C PrpCtl_vSpdLim4PWinNeg_C PrpCtl_SpdLim5IKi_C PrpCtl_SpdLim5IKiPos_C PrpCtl_SpdLim5IKiNeg_C PrpCtl_vSpdLim5IWinPos_C PrpCtl_vSpdLim5IWinNeg_C PrpCtl_SpdLim5PKp_C PrpCtl_SpdLim5PKpPos_C PrpCtl_SpdLim5PKpNeg_C PrpCtl_vSpdLim5PWinPos_C PrpCtl_vSpdLim5PWinNeg_C PrpCtl_tiSpdLimPT1_C PrpCtl_swtSpdLimVal_C PrpCtl_swtSpdLimType_C PrpCtl_vSpdLimMax_C PrpCtl_vSpdLimThreshFree_C PrpCtl_vSpdLimThreshOff_C PrpCtl_vSpdLimThreshOn_C /end DEF_CHARACTERISTIC
/end FUNCTION
/begin FUNCTION prpctl_msg "" /begin OUT_MEASUREMENT PrpCtl_swtSpdLim PrpCtl_trqSpdLim /end OUT_MEASUREMENT /end FUNCTION
/begin FUNCTION prpctl_uic ""
 /begin OUT_MEASUREMENT PrpCtl_stSPTrack_mp PrpCtl_trqI_mp PrpCtl_trqP_mp PrpCtl_vCurrTrack_mp /end OUT_MEASUREMENT
/end FUNCTION
/begin FUNCTION prp_cocrctlprpctl "" /end FUNCTION
/begin FUNCTION prp_cocrctlprpctl_msg "" /end FUNCTION
/begin FUNCTION prp_cocrctlprpctl_uic "" /end FUNCTION
/begin FUNCTION prp_demsel "Anforderungs-Auswahl" /end FUNCTION
/begin FUNCTION prp_demsel_msg "" /begin OUT_MEASUREMENT Prp_stPrpSel Prp_trqLead Prp_trqRaw /end OUT_MEASUREMENT /end FUNCTION
/begin FUNCTION prp_demsel_uic "" /end FUNCTION
/begin FUNCTION prp_virtapp "virtuelle Fahrpedalstellung"
 /begin DEF_CHARACTERISTIC Prp_rEng_MAP Prp_rPrp_MAP Prp_trqThresEng_CUR Prp_trqThresPrp_CUR /end DEF_CHARACTERISTIC
 /begin IN_MEASUREMENT Eng_nAvrg Prp_trqEng Prp_trqPrp VSSCD_v /end IN_MEASUREMENT
/end FUNCTION
/begin FUNCTION prp_virtapp_msg ""
 /begin OUT_MEASUREMENT Prp_rAPP Prp_rVirtAPP Prp_stTrqTypePrp Prp_stVirtApp Prp_trqEng Prp_trqPrp Prp_trqRawLim /end OUT_MEASUREMENT
/end FUNCTION
/begin FUNCTION prp_virtapp_uic ""
 /begin OUT_MEASUREMENT Prp_rVirtEngPrp_mp Prp_rVirtOvrRun_mp Prp_trqEngPrp_mp Prp_trqThresPrp_mp /end OUT_MEASUREMENT
/end FUNCTION
/begin FUNCTION pspcd "Komponententreiber Vorförderpumpe"
 /begin DEF_CHARACTERISTIC PSPCD_dvolBase_CUR PSPCD_dvolMax_C PSPCD_dvolMin_C PSPCD_dvolOut1_C PSPCD_dvolTempLim_MAP PSPCD_facFTSCor_CUR PSPCD_nLim_C PSPCD_tiT15Delay_CUR /end DEF_CHARACTERISTIC
 /begin IN_MEASUREMENT CTSCD_tClnt Eng_nAvrg FTSCD_tFuel /end IN_MEASUREMENT
/end FUNCTION
/begin FUNCTION pspcd_msg "" /begin OUT_MEASUREMENT PSPCD_dvolOut /end OUT_MEASUREMENT /end FUNCTION
/begin FUNCTION pspcd_uic ""
 /begin OUT_MEASUREMENT PSPCD_dvol1_mp PSPCD_dvol2_mp PSPCD_dvolOut0_mp PSPCD_dvolOut1_mp PSPCD_dvolOut2_mp PSPCD_dvolOut3_mp PSPCD_stLogic_mp PSPCD_tiT15Delay_mp /end OUT_MEASUREMENT
/end FUNCTION
/begin FUNCTION qltcd ""
 /begin DEF_CHARACTERISTIC QLTCD_stCntErr_C QLTCD_tiDebDefect_C QLTCD_tiDebOk_C QLTCD_tiOutput_C QLTCD_tiReset_C QLTCD_tiWaitDetection_C /end DEF_CHARACTERISTIC
/end FUNCTION
/begin FUNCTION qltcd_msg ""
 /begin OUT_MEASUREMENT QLTCD_oznivr QLTCD_ozpermr_w QLTCD_ozstatus QLTCD_oztempr QLTCD_stComQLTActiv /end OUT_MEASUREMENT
/end FUNCTION
/begin FUNCTION qltcd_uic ""
 /begin OUT_MEASUREMENT QLTCD_B_ozfbsd_mp QLTCD_CommErr_mp QLTCD_oz_permh_r_mp QLTCD_oz_perml_r_mp QLTCD_State_Handler_mp QLTCD_State_mp QLTCD_stTBss_Active_mp QLTCD_SwitchState_mp /end OUT_MEASUREMENT
/end FUNCTION
/begin FUNCTION railcd_co "Komponententreiber Rail"
 /begin DEF_CHARACTERISTIC RailCD_uSRCMin_C RailCD_uSRCMax_C RailCD_pLin_CUR RailCD_DebSRCHighDef_C RailCD_DebSRCHighOk_C RailCD_DebSRCLowDef_C RailCD_DebSRCLowOk_C RAILCD_numAdc2_C RAILCD_numAdc_C RailCD_pFltWinNeg_CUR RailCD_stRPSFlt_C RailCD_tiFlt1PT1_C RailCD_tiFlt2PT1_C RailCD_tiFlt3PT1_C /end DEF_CHARACTERISTIC
 /begin IN_MEASUREMENT InjCtl_qSetUnBal RailCD_uPeakRaw /end IN_MEASUREMENT
/end FUNCTION
/begin FUNCTION railcd_co_msg "" /begin OUT_MEASUREMENT RailCD_pPeak RailCD_uPeakRaw /end OUT_MEASUREMENT /end FUNCTION
/begin FUNCTION railcd_co_uic ""
 /begin OUT_MEASUREMENT RailCD_pAct_mp RailCD_pFltWinNeg_mp RailCD_pLin_mp RailCD_tiFltPT1_mp /end OUT_MEASUREMENT
/end FUNCTION
/begin FUNCTION railcd_offstst "RPS Offset Überwachung"
 /begin DEF_CHARACTERISTIC RailCD_swtOfsTst_C RailCD_tiEvalDel_C RailCD_tiOfsTstAftRun_C RailCD_tiOfsTstDel_CUR RailCD_tiOfsTstStrt_C RailCD_tiStrErrDel_C RailCD_tOfsTstAftRun_C RailCD_tOfsTstDec_C RailCD_tOfsTstInc_C RailCD_tOfsTstStrt_C RailCD_uOfsAftRunMax_C RailCD_uOfsAftRunMin_C RailCD_uOfsStrtMax_C RailCD_uOfsStrtMin_C /end DEF_CHARACTERISTIC
 /begin IN_MEASUREMENT RailCD_pPeak /end IN_MEASUREMENT
/end FUNCTION
/begin FUNCTION railcd_offstst_msg "" /begin OUT_MEASUREMENT RailCD_stOfsTstMon RailCD_uOfsAftRun RailCD_uOfsStrt /end OUT_MEASUREMENT /end FUNCTION
/begin FUNCTION railcd_offstst_uic ""
 /begin OUT_MEASUREMENT RailCD_stEngStrtMov_mp RailCD_stMon_mp RailCD_tClntLstCyc_mp RailCD_tiOfsTstDel_mp /end OUT_MEASUREMENT
/end FUNCTION
/begin FUNCTION railcd_pmonstrt "Start phase rail pressure monitoring" /begin DEF_CHARACTERISTIC RailCD_nStrtLim_C RailCD_pStrtLim_C RailCD_tiPMonStrtLim_C /end DEF_CHARACTERISTIC /end FUNCTION
/begin FUNCTION railcd_pmonstrt_uic "" /begin OUT_MEASUREMENT RailCD_ctPMonStrt_mp /end OUT_MEASUREMENT /end FUNCTION
/begin FUNCTION rail_adcget_uic "" /end FUNCTION
/begin FUNCTION rail_ctlloop "Raildruckregler Regelkreis"
 /begin DEF_CHARACTERISTIC Rail_nCloseCtl_C Rail_nThresStrt_C Rail_numRevPlaus_C Rail_pCloseCtl_C Rail_pDiffCloseCtl_C Rail_pOpnCtl_C Rail_swtCtlModeAdjVal_C Rail_tiDebDefMeUnDiag_C Rail_tiDebOkMeUnDiag_C Rail_tiDebDefPCVDiag_C Rail_tiDebOkPCVDiag_C /end DEF_CHARACTERISTIC
/end FUNCTION
/begin FUNCTION rail_ctllooplib ""
 /begin DEF_CHARACTERISTIC Rail_dvolOff_C Rail_dvolStrt_C Rail_numRevDel_C Rail_pSetMin_C Rail_stCtlLoopSel_C Rail_tiDeflate_C Rail_tiMeUnRmpDur_CUR Rail_tiSwtToMeUnCtl_C /end DEF_CHARACTERISTIC
 /begin IN_MEASUREMENT Eng_nAvrg /end IN_MEASUREMENT
/end FUNCTION
/begin FUNCTION rail_ctllooplib_uic "" /begin OUT_MEASUREMENT Rail_facMeUnTiRmpVal_mp Rail_tiMeUnRmpDur_mp /end OUT_MEASUREMENT /end FUNCTION
/begin FUNCTION rail_ctllooplimmeun "Begrenzungen für die Druckregelung ueber Zumesseinheit" /begin DEF_CHARACTERISTIC Rail_dvolMeUnCtlLoLim_C Rail_dvolMeUnCtlUpLim_CUR /end DEF_CHARACTERISTIC /begin IN_MEASUREMENT Eng_nAvrg /end IN_MEASUREMENT /end FUNCTION
/begin FUNCTION rail_ctllooplimmeun_uic "" /end FUNCTION
/begin FUNCTION rail_ctllooplimpcv "Begrenzungen für die Druckregelung ueber Druckregelventil"
 /begin DEF_CHARACTERISTIC Rail_pPCVCtlLoLimStrt_C Rail_pPCVCtlLoLim_C Rail_pPCVCtlUpLimStrt_C Rail_pPCVCtlUpLim_C /end DEF_CHARACTERISTIC
/end FUNCTION
/begin FUNCTION rail_ctllooplimpcv_uic "" /begin OUT_MEASUREMENT Rail_pPCVCtlLoLim_mp Rail_pPCVCtlUpLim_mp /end OUT_MEASUREMENT /end FUNCTION
/begin FUNCTION rail_ctlloopmeun_msg "" /begin OUT_MEASUREMENT Rail_dvolMeUnSet /end OUT_MEASUREMENT /end FUNCTION
/begin FUNCTION rail_ctlloopparameun "Parameter für die Druckregelung ueber Zumesseinheit"
 /begin DEF_CHARACTERISTIC Rail_facOvrMeUnNegIncr_C Rail_MeUnCtlDKd_CUR Rail_MeUnCtlIKiNeg_CUR Rail_MeUnCtlIKiPos_CUR Rail_MeUnCtlIKi_CUR Rail_MeUnCtlPKpNeg_CUR Rail_MeUnCtlPKpPos_CUR Rail_MeUnCtlPKp_CUR Rail_pMeUnCtlIWinNeg_C Rail_pMeUnCtlIWinPos_C Rail_pMeUnCtlPWinNeg_C Rail_pMeUnCtlPWinPos_C Rail_pOvrMeUnThresHigh_C Rail_pOvrMeUnThresLow_C Rail_tiMeUnCtlDT1_CUR Rail_tiMeUnCtlPT1_CUR /end DEF_CHARACTERISTIC
 /begin IN_MEASUREMENT Eng_nAvrg /end IN_MEASUREMENT
/end FUNCTION
/begin FUNCTION rail_ctlloopparameun_uic ""
 /begin OUT_MEASUREMENT Rail_MeUnCtlDKd_mp Rail_MeUnCtlIKiNeg_mp Rail_MeUnCtlIKiPos_mp Rail_MeUnCtlIKi_mp Rail_MeUnCtlPKpNeg_mp Rail_MeUnCtlPKpPos_mp Rail_MeUnCtlPKp_mp Rail_tiMeUnCtlDT1_mp Rail_tiMeUnCtlPT1_mp /end OUT_MEASUREMENT
/end FUNCTION
/begin FUNCTION rail_ctlloopparapcv "Parameter für die Druckregelung ueber Druckregelventil"
 /begin DEF_CHARACTERISTIC Rail_facOvrPCVNegIncr_C Rail_PCVCtlDKd_CUR Rail_PCVCtlIKiNeg_CUR Rail_PCVCtlIKiPos_CUR Rail_PCVCtlIKi_CUR Rail_PCVCtlPKpNeg_CUR Rail_PCVCtlPKpPos_CUR Rail_PCVCtlPKp_CUR Rail_pOvrPCVThresHigh_C Rail_pOvrPCVThresLow_C Rail_pPCVCtlIWinNeg_C Rail_pPCVCtlIWinPos_C Rail_pPCVCtlPWinNeg_C Rail_pPCVCtlPWinPos_C Rail_tiPCVCtlDT1_CUR /end DEF_CHARACTERISTIC
 /begin IN_MEASUREMENT Eng_nAvrg /end IN_MEASUREMENT
/end FUNCTION
/begin FUNCTION rail_ctlloopparapcv_uic ""
 /begin OUT_MEASUREMENT Rail_PCVCtlDKd_mp Rail_PCVCtlIKiNeg_mp Rail_PCVCtlIKiPos_mp Rail_PCVCtlIKi_mp Rail_PCVCtlPKpNeg_mp Rail_PCVCtlPKpPos_mp Rail_PCVCtlPKp_mp Rail_tiPCVCtlDT1_mp /end OUT_MEASUREMENT
/end FUNCTION
/begin FUNCTION rail_ctllooppcv_msg "" /begin OUT_MEASUREMENT Rail_pPCVSet /end OUT_MEASUREMENT /end FUNCTION
/begin FUNCTION rail_ctlloop_msg ""
 /begin OUT_MEASUREMENT Rail_dvolEstAged Rail_dvolMeUnCtlUpLim Rail_dvolPreCtlCor Rail_pDvt Rail_pPreCtlCor Rail_stCtlLoop Rail_stShOffTstAck /end OUT_MEASUREMENT
/end FUNCTION
/begin FUNCTION rail_ctlloop_uic ""
 /begin DEF_CHARACTERISTIC Rail_dvolMeUnSet_Vector Rail_dvolMeUnSet_Channel Rail_dvolPreCtlCor_Vector Rail_dvolPreCtlCor_Channel Rail_pPCVSet_Vector Rail_pPCVSet_Channel Rail_pPreCtlCor_Vector Rail_pPreCtlCor_Channel /end DEF_CHARACTERISTIC
/end FUNCTION
/begin FUNCTION rail_ctlmeun ""
 /begin DEF_CHARACTERISTIC Rail_dvolMeUnCtlInitI_CUR Rail_nMeUnFrzI_C Rail_pDvtFltMin_C Rail_tiFrzIDel_C /end DEF_CHARACTERISTIC
 /begin IN_MEASUREMENT FlSys_t /end IN_MEASUREMENT
/end FUNCTION
/begin FUNCTION rail_ctlmeun_uic ""
 /begin OUT_MEASUREMENT Rail_dvolMeUnCtlDT1_mp Rail_dvolMeUnCtlI_mp Rail_dvolMeUnCtlP_mp Rail_pDvtFltLim_mp Rail_pPeakFlt_mp /end OUT_MEASUREMENT
/end FUNCTION
/begin FUNCTION rail_ctlpcv "" /begin DEF_CHARACTERISTIC Rail_pPCVInitI_MAP Rail_swtPCVInitI_C /end DEF_CHARACTERISTIC /begin IN_MEASUREMENT Eng_nAvrg Rail_pSetPoint /end IN_MEASUREMENT /end FUNCTION
/begin FUNCTION rail_ctlpcv_uic ""
 /begin OUT_MEASUREMENT Rail_pPCVCtlDT1_mp Rail_pPCVCtlI_mp Rail_pPCVCtlPILim_mp Rail_pPCVCtlP_mp Rail_pPCVInitI_mp Rail_pWindUp_mp /end OUT_MEASUREMENT
/end FUNCTION
/begin FUNCTION rail_ctltypeswt "Umschaltbedingungen für das 2-Reglerkonzept"
 /begin DEF_CHARACTERISTIC Rail_qMeUnCtlType_CUR Rail_qPCVCtlType_CUR Rail_tiMeUnCtlTypeDel_C Rail_tiSwtCtlTypeDel_C Rail_tMeUnCtlType_CUR Rail_tOvrRunThres_C Rail_tPCVCtlType_CUR Rail_tSwtCtlTypeHi_C Rail_tSwtCtlTypeLo_C /end DEF_CHARACTERISTIC
 /begin IN_MEASUREMENT Eng_nAvrg /end IN_MEASUREMENT
/end FUNCTION
/begin FUNCTION rail_ctltypeswt_uic ""
 /begin OUT_MEASUREMENT Rail_qMeUnCtlType_mp Rail_qPCVCtlType_mp Rail_stSwtCon_mp Rail_tMeUnCtlType_mp Rail_tPCVCtlType_mp /end OUT_MEASUREMENT
/end FUNCTION
/begin FUNCTION rail_igovcalc "" /end FUNCTION
/begin FUNCTION rail_igovcalc_uic "" /end FUNCTION
/begin FUNCTION rail_monmeun "Raildruckueberwachung für die Druckregelung ueber Zumesseinheit"
 /begin DEF_CHARACTERISTIC Rail_DebMeUn0MaxDef_C Rail_DebMeUn0MaxOk_C Rail_DebMeUn1MaxDef_C Rail_DebMeUn1MaxOk_C Rail_DebMeUn2MaxDef_C Rail_DebMeUn2MaxOk_C Rail_DebMeUn3MaxDef_C Rail_DebMeUn3MaxOk_C Rail_DebMeUn4MaxDef_C Rail_DebMeUn4MaxOk_C Rail_dvolMeUnSetMin_C Rail_pMeUnPeakMax_C Rail_pMeUnDvtMax_C Rail_qMeUnLoIdle_C Rail_stMonMeUnRls_C Rail_tMeUnLoIdle_C Rail_pMeUnDvtMax_CUR Rail_pMeUnDvtMin_CUR Rail_pMeUnPeakMin_CUR /end DEF_CHARACTERISTIC
 /begin IN_MEASUREMENT Eng_nAvrg /end IN_MEASUREMENT
/end FUNCTION
/begin FUNCTION rail_monmeun_msg "" /end FUNCTION
/begin FUNCTION rail_monmeun_uic ""
 /begin OUT_MEASUREMENT Rail_pMeUnDvtMax_mp Rail_pMeUnDvtMin_mp Rail_pMeUnPeakMin_mp Rail_stMeUnMon0_mp Rail_stMeUnMon1_mp Rail_stMeUnMon2_mp Rail_stMeUnMon3_mp Rail_stMeUnMon4_mp Rail_tiMeUn0Deb_mp Rail_tiMeUn1Deb_mp Rail_tiMeUn2Deb_mp Rail_tiMeUn3Deb_mp Rail_tiMeUn4Deb_mp /end OUT_MEASUREMENT
/end FUNCTION
/begin FUNCTION rail_monpcv "Raildruckueberwachung für die Druckregelung ueber Druckregelventil"
 /begin DEF_CHARACTERISTIC Rail_DebPCV0MaxDef_C Rail_DebPCV0MaxOk_C Rail_DebPCV1MaxDef_C Rail_DebPCV1MaxOk_C Rail_DebPCV2MaxDef_C Rail_DebPCV2MaxOk_C Rail_DebPCV3MaxDef_C Rail_DebPCV3MaxOk_C Rail_DebPCV4MaxDef_C Rail_DebPCV4MaxOk_C Rail_DebPCV5MaxDef_C Rail_DebPCV5MaxOk_C Rail_pPCVDvtMax_C Rail_pPCVSetMax_C Rail_pPCVDvtMin_C Rail_pPCVSetMin_C Rail_pAbsDvtMax_C Rail_tiThresMonEna_C Rail_qMonEnaMax_C Rail_nMonEnaMin_C Rail_nMonEnaMax_C Rail_pPCVPeakMax_C Rail_stMonPCVRls_C Rail_pNIPCVMax_MAP Rail_pNIPCVMin_MAP Rail_pPCVDvtMax_CUR Rail_pPCVPeakMin_CUR /end DEF_CHARACTERISTIC
 /begin IN_MEASUREMENT Eng_nAvrg PCVCD_iActVal /end IN_MEASUREMENT
/end FUNCTION
/begin FUNCTION rail_monpcv_msg "" /begin OUT_MEASUREMENT Rail_tiThresMonEna /end OUT_MEASUREMENT /end FUNCTION
/begin FUNCTION rail_monpcv_uic ""
 /begin OUT_MEASUREMENT Rail_pNIPCVMax_mp Rail_pNIPCVMin_mp Rail_pPCVDvtMax_mp Rail_pPCVPeakMin_mp Rail_stPCVMon0_mp Rail_stPCVMon1_mp Rail_stPCVMon2_mp Rail_stPCVMon3_mp Rail_stPCVMon4_mp Rail_stPCVMon5_mp Rail_tiPCV0Deb_mp Rail_tiPCV1Deb_mp Rail_tiPCV2Deb_mp Rail_tiPCV3Deb_mp Rail_tiPCV4Deb_mp Rail_tiPCV5Deb_mp /end OUT_MEASUREMENT
/end FUNCTION
/begin FUNCTION rail_msg "" /end FUNCTION
/begin FUNCTION rail_pgovsetup "Softwareschalter-Konfiguration der Komponente Rail"
 /begin DEF_CHARACTERISTIC Rail_swtPreCtlVal_C Rail_swtPreCtlType_C Rail_swtPressVal_C Rail_swtPressType_C Rail_swtWindUpVal_C Rail_swtWindUpType_C /end DEF_CHARACTERISTIC
/end FUNCTION
/begin FUNCTION rail_pgovsetup_msg "" /begin OUT_MEASUREMENT Rail_stCtlType Rail_swtPreCtl Rail_swtPress Rail_swtWindUp /end OUT_MEASUREMENT /end FUNCTION
/begin FUNCTION rail_pgovsetup_uic "" /end FUNCTION
/begin COMPU_METHOD AirMassPerTime "Luftmasse pro Zeit" RAT_FUNC "%6.3" "Kg/h" COEFFS 0 10 0 0 0 1 /end COMPU_METHOD
/begin COMPU_METHOD B_TRUE "Umrechnung   ----> FALSE;    TRUE = TRUE" TAB_VERB "%6.3" "-" COMPU_TAB_REF B_TRUE /end COMPU_METHOD
/begin COMPU_VTAB B_TRUE "Umrechnung   ----> FALSE;    TRUE = TRUE" TAB_VERB 2 0 "FALSE" 1 "TRUE" /end COMPU_VTAB
/begin COMPU_METHOD CubMtrPerHr "Volumsstrom in m^3/h" RAT_FUNC "%6.3" "m^3/h" COEFFS 0 10 0 0 0 1 /end COMPU_METHOD
/begin COMPU_METHOD CubMtrPerHrPerSec "Volumenstromdifferenz pro Sekunde" RAT_FUNC "%6.3" "m^3/h/s" COEFFS 0 10 0 0 0 1 /end COMPU_METHOD
/begin COMPU_METHOD Curr "Strom" RAT_FUNC "%6.2" "mA" COEFFS 0 1 0 0 0 1 /end COMPU_METHOD
/begin COMPU_METHOD DEZ "K3 Umwandlungen" RAT_FUNC "%6.2" "-" COEFFS 0 1 0 0 0 1 /end COMPU_METHOD
/begin COMPU_METHOD dmSoot_mg_p_s "differenzielle Rußmasse mg/s" RAT_FUNC "%6.4" "mg/s" COEFFS 0 100 0 0 0 1 /end COMPU_METHOD
/begin COMPU_METHOD EngN "Motordrehzahl" RAT_FUNC "%6.2" "rpm" COEFFS 0 1 0 0 0 1 /end COMPU_METHOD
/begin COMPU_METHOD EngTempFldSel "Verbale Umrechnung für Auswahl aus dem Motortemperatur-Feld Eng_tFld" TAB_VERB "%6.3" "-" COMPU_TAB_REF EngTempFldSel /end COMPU_METHOD
/begin COMPU_VTAB EngTempFldSel "Verbale Umrechnung für Auswahl aus dem Motortemperatur-Feld Eng_tFld" TAB_VERB 3 0 "Coolant_Temperature" 1 "Oil_Temperature" 2 "Eng_tEng" /end COMPU_VTAB
/begin COMPU_METHOD Fact "Faktor mit Auflösung 1 / 8192, hauptsächlich für einen Faktorenbereich 0...1 verwendet" RAT_FUNC "%6.5" "-" COEFFS 0 8192 0 0 0 1 /end COMPU_METHOD
/begin COMPU_METHOD Fact1 "Faktor mit Auflösung 0,01 (100 mal höherer Bereich als Fact)" RAT_FUNC "%6.4" "-" COEFFS 0 128 0 0 0 1 /end COMPU_METHOD
/begin COMPU_METHOD FlConsum_l_h "Kraftstoffverbrauch" RAT_FUNC "%6.4" "l/h" COEFFS 0 100 0 0 0 1 /end COMPU_METHOD
/begin COMPU_METHOD Fl_2 "Umrechnung for getting 16 bit  total fuel consumption" RAT_FUNC "%6.1" "l" COEFFS 0 0.1 0 0 0 1 /end COMPU_METHOD
/begin COMPU_METHOD hPaPerSec "Differenzdruck pro Sekunde" RAT_FUNC "%6.3" "hPa/s" COEFFS 0 10 0 0 0 1 /end COMPU_METHOD
/begin COMPU_METHOD IndSysTempFldSel "Auswahl für Lufttemperaturfeld" TAB_VERB "%6.3" "-" COMPU_TAB_REF IndSysTempFldSel /end COMPU_METHOD
/begin COMPU_VTAB IndSysTempFldSel "Auswahl für Lufttemperaturfeld" TAB_VERB 3 0 "IATSCD_tAir" 1 "AFSCD_tAir" 2 "EATSCD_tAir" /end COMPU_VTAB
/begin COMPU_METHOD InjMass "Einspritzmenge" RAT_FUNC "%6.4" "mg/hub" COEFFS 0 100 0 0 0 1 /end COMPU_METHOD
/begin COMPU_METHOD InjMassCyc "Einspritzmenge pro Zyklus (mg/Zyklus)" RAT_FUNC "%6.4" "mg/cyc" COEFFS 0 100 0 0 0 1 /end COMPU_METHOD
/begin COMPU_METHOD InjMassInj "Einspritzmenge pro Einspritzung (mg/Einspritzung)" RAT_FUNC "%6.4" "mg/inj" COEFFS 0 100 0 0 0 1 /end COMPU_METHOD
/begin COMPU_METHOD InjTime_us "Zeit in Microsekunden für das Einspritztiming" RAT_FUNC "%6.2" "us" COEFFS 0 1 0 0 0 1 /end COMPU_METHOD
/begin COMPU_METHOD Kd "Differentialverstärkung Kd (gleiche Einheit/Umrechnungsformel an Ein- und Ausgang)" RAT_FUNC "%7.6" "1/1" COEFFS 0 65536 0 0 0 1 /end COMPU_METHOD
/begin COMPU_METHOD Kd_1 "Differentialverstärkung Kd (gleiche Einheit/Umrechnungsregel an Ein- und Ausgang; Umrechnung für sint16-Werte)" RAT_FUNC "%6.4" "1/1" COEFFS 0 512 0 0 0 1 /end COMPU_METHOD
/begin COMPU_METHOD Kd_pRail2Q "Differentialverstärkung (Raildruck zu Menge)" RAT_FUNC "%11.4" "mm^3/s/bar" COEFFS 0 655.360000 0 0 0 1 /end COMPU_METHOD
/begin COMPU_METHOD Kd_pRail2Q_1 "Differentialverstärkung mit Normexponent (Raildruck zu Menge)" RAT_FUNC "%10.3" "mm^3/s/bar" COEFFS 0 40.960000 0 0 0 1 /end COMPU_METHOD
/begin COMPU_METHOD Ki "Integrale Verstärkung Ki (gleiche Einheit/Umrechnungsregel an Ein- und Ausgang)" RAT_FUNC "%6.5" "1/s" COEFFS 0 4294.967296 0 0 0 1 /end COMPU_METHOD
/begin COMPU_METHOD Ki_1 "Integrale Verstärkung Ki (gleiche Einheit/Umrechnungsregel an Ein- und Ausgang; Umrechnung für sint16-Werte)" RAT_FUNC "%6.4" "1/s" COEFFS 0 67.108864 0 0 0 1 /end COMPU_METHOD
/begin COMPU_METHOD Ki_pRail2Q "Integralverstärkung (Raildruck zu Menge)" RAT_FUNC "%10.3" "mm^3/s^2/bar" COEFFS 0 42.949673 0 0 0 1 /end COMPU_METHOD
/begin COMPU_METHOD Ki_pRail2Q_1 "Intgralverstärkung mit Normexponent (Raildruck zu Menge)" RAT_FUNC "%10.3" "mm^3/s^2/bar" COEFFS 0 10.737418 0 0 0 1 /end COMPU_METHOD
/begin COMPU_METHOD Ki_Vel2TrqPrp "Integralverstärkung (Fahrgeschwindigkeit zu Vortriebsmoment)" RAT_FUNC "%6.4" "Nm/(km/h)/s" COEFFS 0 214.7483648 0 0 0 1 /end COMPU_METHOD
/begin COMPU_METHOD Kp "proportionale Verstärkung Kp (gleiche Einheit/Umrechnungsregel an Ein- und Ausgang)" RAT_FUNC "%7.6" "1/1" COEFFS 0 65536 0 0 0 1 /end COMPU_METHOD
/begin COMPU_METHOD Kp_1 "proportionale Verstärkung Kp (gleiche Einheit/Umrechnungsregel an Ein- und Ausgang; Umrechnung für sint16-Werte)" RAT_FUNC "%6.4" "1/1" COEFFS 0 64 0 0 0 1 /end COMPU_METHOD
/begin COMPU_METHOD Kp_pRail2Q "Proportionale Verstärkung Kp (Raildruck zu Menge)" RAT_FUNC "%11.4" "mm^3/s/bar" COEFFS 0 655.360000 0 0 0 1 /end COMPU_METHOD
/begin COMPU_METHOD Kp_pRail2Q_1 "Proportionale Verstärkung mit Normexponent (Raildruck zu Menge)" RAT_FUNC "%10.3" "mm^3/s/bar" COEFFS 0 81.920000 0 0 0 1 /end COMPU_METHOD
/begin COMPU_METHOD Kp_Vel2TrqPrp "Proportionalverstärkung (Fahrgeschwindigkeit zu Vortriebsmoment)" RAT_FUNC "%6.5" "Nm/(km/h)" COEFFS 0 3276.8 0 0 0 1 /end COMPU_METHOD
/begin COMPU_METHOD lambda "Lambda" RAT_FUNC "%6.5" "-" COEFFS 0 1000 0 0 0 1 /end COMPU_METHOD
/begin COMPU_METHOD mSoot_g "Rußmasse [g]" RAT_FUNC "%6.4" "g" COEFFS 0 100 0 0 0 1 /end COMPU_METHOD
/begin COMPU_METHOD NumPinAdc "verbale Umrechnung für ADC Signale" TAB_VERB "%6.3" "-" COMPU_TAB_REF NumPinAdc /end COMPU_METHOD
/begin COMPU_VTAB NumPinAdc "verbale Umrechnung für ADC Signale" TAB_VERB 45 0 "Water_Temperature_Sensor_182" 1 "Intake_Air_Temperature_Sensor_157" 2 "Charge_Air_Temperature_Sensor_183" 3 "Exhaust_Temperature_Sensor_2_134" 4 "Exhaust_Temperature_Sensor_1_158" 5 "1st_APP_Sensor_252" 6 "2nd_APP_Sensor_239" 7 "ADC_REF" 8 "Boost_Pressure_Sensor_154" 9 "Atmospheric_Pressure_Sensor" 10 "Battery_Voltage_Sensor" 11 "Rail_Pressure_Sensor_156" 12 "Rail_Pressure_Peak_Value_156" 13 "Booster_Voltage_Sensor" 14 "Current_MeUn_Sensor" 15 "Current_PCV_Sensor" 16 "Voltage_Bank_1" 17 "Voltage_Bank_2" 18 "Pressure_Upstream_Particle_Filter_159" 19 "Engine_Oil_Pressure_110" 20 "Temperature_ECU_PCB" 21 "Voltage_Lambda_Ua" 22 "Voltage_Lambda_Ri" 23 "ADC_DUMMY_A_NOT_USED" 24 "ADC_DUMMY_NOT_USED" 25 "Charge_Actuator_Event_0" 26 "Voltage_Piezo_Actuator_Bank_2_Event_0" 27 "Voltage_Piezo_Actuator_Bank_1_Event_0" 28 "Charge_Actuator_Event_1" 29 "Voltage_Piezo_Actuator_Bank_2_Event_1" 30 "Voltage_Piezo_Actuator_Bank_1_Event_1" 31 "Charge_Actuator_Event_2" 32 "Voltage_Piezo_Actuator_Bank_2_Event_2" 33 "Voltage_Piezo_Actuator_Bank_1_Event_2" 34 "Charge_Actuator_Event_3" 35 "Voltage_Piezo_Actuator_Bank_2_Event_3" 36 "Voltage_Piezo_Actuator_Bank_1_Event_3" 37 "Charge_Actuator_Event_4" 38 "Voltage_Piezo_Actuator_Bank_2_Event_4" 39 "Voltage_Piezo_Actuator_Bank_1_Event_4" 40 "Charge_Actuator_Event_5" 41 "Voltage_Piezo_Actuator_Bank_2_Event_5" 42 "Voltage_Piezo_Actuator_Bank_1_Event_5" 43 "Booster_Voltage_Piezo" 44 "Piezo_Voltage" /end COMPU_VTAB
/begin COMPU_METHOD OneToOne "eins zu eins (physikalischer Wert ist gleich dem internen Wert)" RAT_FUNC "%6.2" "-" COEFFS 0 1 0 0 0 1 /end COMPU_METHOD
/begin COMPU_METHOD Prc "Prozent, gleiche interne Auflösung wie Fact, aber Darstellung in Prozent (0...100%)" RAT_FUNC "%6.4" "%" COEFFS 0 81.92 0 0 0 1 /end COMPU_METHOD
/begin COMPU_METHOD Pres_hPa "Druck (angezeigt in [hPa])" RAT_FUNC "%6.2" "hPa" COEFFS 0 1 0 0 0 1 /end COMPU_METHOD
/begin COMPU_METHOD Pres_Rail "Raildruck in hPa" RAT_FUNC "%4.3" "bar" COEFFS 0 10.000000 0 0 0 1 /end COMPU_METHOD
/begin COMPU_METHOD Qp_mm3_sec "Umrechnung für Volumenstrom" RAT_FUNC "%6.1" "mm3/s" COEFFS 0 0.1 0 0 0 1 /end COMPU_METHOD
/begin COMPU_METHOD Res_hPaHrPerCM "Strömungswiderstand [hPa h/m3]" RAT_FUNC "%6.5" "hPa/(m^3/h)" COEFFS 0 1000 0 0 0 1 /end COMPU_METHOD
/begin COMPU_METHOD RmpPres_hPa "Rampengradient für Druck angezeigt in [hPa/s]" RAT_FUNC "%6.4" "hPa/s" COEFFS 0 65.536 0 0 0 1 /end COMPU_METHOD
/begin COMPU_METHOD Soot_gPerLtr "Partikelmasse pro Filtervolumen" RAT_FUNC "%6.4" "g/l" COEFFS 0 100 0 0 0 1 /end COMPU_METHOD
/begin COMPU_METHOD TempDiff_Cels "difference/offset temperature displayed in degree celcius" RAT_FUNC "%6.3" "deg C" COEFFS 0 10 0 0 0 1 /end COMPU_METHOD
/begin COMPU_METHOD Temp_Cels "Temperatur dargestellt in °C (gleiche interne Darstellung wie Temp_Kelv)" RAT_FUNC "%6.1" "deg C" COEFFS 0 10 2731.4 0 0 1 /end COMPU_METHOD
/begin COMPU_METHOD Temp_Kelv "Temperatur dargestellt in Kelvin" RAT_FUNC "%6.3" "deg C" COEFFS 0 10 0 0 0 1 /end COMPU_METHOD
/begin COMPU_METHOD Thr_Cpty "Wärmekapazität" RAT_FUNC "%6.2" "J/K" COEFFS 0 1 0 0 0 1 /end COMPU_METHOD
/begin COMPU_METHOD Thr_Cpty_ExhGs "Wärmekapazität des Abgases" RAT_FUNC "%6.2" "J/kgK" COEFFS 0 0.1 0 0 0 1 /end COMPU_METHOD
/begin COMPU_METHOD TimeADCFilt "Zeit, spezielle Aufloesung für ADCFilt" RAT_FUNC "%6.4" "ms" COEFFS 0 256.016385048643 0 0 0 1 /end COMPU_METHOD
/begin COMPU_METHOD TimeDeb "Entprellzeit in Millisekunden für Libraryfunktion Debounce" RAT_FUNC "%6.1" "ms" COEFFS 0 0.1 0 0 0 1 /end COMPU_METHOD
/begin COMPU_METHOD TimeDelay_s "Zeitkonstante T1 (in s) für PT1, DT1, etc." RAT_FUNC "%9.3" "s" COEFFS 0 0 1 0 0.00023283064365387 0 /end COMPU_METHOD
/begin COMPU_METHOD TimeDelay_s_2 "Zeitkonstante T1 (in s) für PT1, DT1, etc. normiert auf 16 bit" RAT_FUNC "%9.4" "s" COEFFS 0 0 1 0 0.0596046447753906 0 /end COMPU_METHOD
/begin COMPU_METHOD TimeEngOn "Motorbetriebszeit in Sekunden" RAT_FUNC "%6.2" "s" COEFFS 0 1 0 0 0 1 /end COMPU_METHOD
/begin COMPU_METHOD TimeRed "Zeit in Sekunden mit reduzierter Auflösung für Ein/Ausgänge von KL/KF (sint16)" RAT_FUNC "%6.3" "s" COEFFS 0 6.25 0 0 0 1 /end COMPU_METHOD
/begin COMPU_METHOD Time_ms "Zeit in ms für Fehlerentprellung (DSM) und SW-Timer" RAT_FUNC "%6.1" "ms" COEFFS 0 0.1 0 0 0 1 /end COMPU_METHOD
/begin COMPU_METHOD Time_s "Zeit in s für Fehlerentprellung (DSM) und SW-Timer" RAT_FUNC "%6.4" "s" COEFFS 0 100 0 0 0 1 /end COMPU_METHOD
/begin COMPU_METHOD Trq "Motormoment" RAT_FUNC "%6.3" "Nm" COEFFS 0 10 0 0 0 1 /end COMPU_METHOD
/begin COMPU_METHOD TrqPrp "Vortriebsmoment" RAT_FUNC "%6.3" "Nm" COEFFS 0 5 0 0 0 1 /end COMPU_METHOD
/begin COMPU_METHOD Vel "Fahrzeuggeschwindigkeit, gleiche interne Auflösung wie Vel_SI" RAT_FUNC "%6.4" "km/h" COEFFS 0 100 0 0 0 1 /end COMPU_METHOD
/begin COMPU_METHOD Vol "Volumen" RAT_FUNC "%6.4" "l" COEFFS 0 100 0 0 0 1 /end COMPU_METHOD
/begin COMPU_METHOD volAdd_ml2 "Umrechnung mit 1ml Auflösung für Additivmenge in AddPmp_AddMet" RAT_FUNC "%6.2" "ml" COEFFS 0 1 0 0 0 1 /end COMPU_METHOD
/begin COMPU_METHOD Volt "Spannung in V (von ADC)" RAT_FUNC "%6.2" "mV" COEFFS 0 0.2046 0 0 0 1 /end COMPU_METHOD
/begin COMPU_METHOD Volt_Batt "Batteriespannung" RAT_FUNC "%6.1" "mV" COEFFS 0 0.05115 0 0 0 1 /end COMPU_METHOD
/begin RECORD_LAYOUT Gkl_Ws16 FNC_VALUES 1 SWORD COLUMN_DIR DIRECT /end RECORD_LAYOUT
/begin RECORD_LAYOUT GSst_Xs16 NO_AXIS_PTS_X 1 SWORD AXIS_PTS_X 2 SWORD INDEX_INCR DIRECT /end RECORD_LAYOUT
/begin RECORD_LAYOUT Kf_Xs16_Ys16_Ws16 NO_AXIS_PTS_X 1 SWORD NO_AXIS_PTS_Y 2 SWORD AXIS_PTS_X 3 SWORD INDEX_INCR DIRECT AXIS_PTS_Y 4 SWORD INDEX_INCR DIRECT FNC_VALUES 5 SWORD COLUMN_DIR DIRECT /end RECORD_LAYOUT
/begin RECORD_LAYOUT Kl_Xs16_Ws16 NO_AXIS_PTS_X 1 SWORD AXIS_PTS_X 2 SWORD INDEX_INCR DIRECT FNC_VALUES 3 SWORD COLUMN_DIR DIRECT /end RECORD_LAYOUT
/begin RECORD_LAYOUT Kwb_Wu8 FNC_VALUES 1 UBYTE COLUMN_DIR DIRECT /end RECORD_LAYOUT
/begin RECORD_LAYOUT Kw_Ws16 FNC_VALUES 1 SWORD COLUMN_DIR DIRECT /end RECORD_LAYOUT
/begin RECORD_LAYOUT Kw_Ws32 FNC_VALUES 1 SLONG COLUMN_DIR DIRECT /end RECORD_LAYOUT
/begin RECORD_LAYOUT Kw_Ws8 FNC_VALUES 1 SBYTE COLUMN_DIR DIRECT /end RECORD_LAYOUT
/begin RECORD_LAYOUT Kw_Wu16 FNC_VALUES 1 UWORD COLUMN_DIR DIRECT /end RECORD_LAYOUT
/begin RECORD_LAYOUT Kw_Wu32 FNC_VALUES 1 ULONG COLUMN_DIR DIRECT /end RECORD_LAYOUT
/begin RECORD_LAYOUT Kw_Wu8 FNC_VALUES 1 UBYTE COLUMN_DIR DIRECT /end RECORD_LAYOUT
/end MODULE
/end PROJECT
