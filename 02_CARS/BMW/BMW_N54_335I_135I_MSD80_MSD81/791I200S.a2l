ASAP2_VERSION 1 41
/begin PROJECT MSD85 "Spray Guided DI-System with Piezo Injectors for 8-Cylinder"
/begin HEADER "_default_HeaderComment" PROJECT_NO _91 /end HEADER
/begin MODULE _default_ModuleName "_default_ModuleLongIdentifier"
/begin MOD_COMMON "_default_ModCommonComment" DEPOSIT ABSOLUTE BYTE_ORDER MSB_LAST ALIGNMENT_BYTE 1 ALIGNMENT_WORD 2 ALIGNMENT_LONG 2 ALIGNMENT_FLOAT32_IEEE 2 ALIGNMENT_FLOAT64_IEEE 4 /end MOD_COMMON
/begin MEASUREMENT Atl_bank_20ms "Selektive Bankberechnung im 20ms Raster" UBYTE _CNV_R_R_Def_dez_sl_551_CM 1 100. 0. 255. DISPLAY_IDENTIFIER ATL_BANK_20MS ECU_ADDRESS 0xd000ca63 FORMAT "%3.0" /end MEASUREMENT
/begin MEASUREMENT Atlr "Stellgroesse aus ATL-Regler" UWORD _CNV_R_R_Def_f_uw_b_555_CM 1 100. 0. 99.9984 DISPLAY_IDENTIFIER ATLR ECU_ADDRESS 0xd000ca52 FORMAT "%8.3" /end MEASUREMENT
/begin MEASUREMENT Atlr_i "Stellgroesse aus ATL-Regler" UWORD _CNV_R_R_Def_f_uw_b_555_CM 1 100. 0. 99.9984 DISPLAY_IDENTIFIER ATLR_I ECU_ADDRESS 0xd000ca54 FORMAT "%8.3" ARRAY_SIZE 2 MATRIX_DIM 2 1 1 /end MEASUREMENT
/begin MEASUREMENT Atlr_mx "Obergrenze Stellgroesse aus ATL-Regler" UWORD _CNV_R_R_Def_f_uw_b_555_CM 1 100. 0. 99.9984 DISPLAY_IDENTIFIER ATLR_MX ECU_ADDRESS 0xd000ca8c FORMAT "%8.3" /end MEASUREMENT
/begin MEASUREMENT Atlr_oad "Wastegateansteuerung ohne Adaption" UWORD _CNV_R_R_Def_f_uw_b_555_CM 1 100. 0. 99.9984 DISPLAY_IDENTIFIER ATLR_OAD ECU_ADDRESS 0xd000d6bc FORMAT "%8.3" /end MEASUREMENT
/begin MEASUREMENT Atlr_vb_i "Stellgroesse aus ATL-Regler - vor Limitierung" SWORD _CNV_R_R_Def_rel_sw_562_CM 1 100. -100. 99.9969 DISPLAY_IDENTIFIER ATLR_VB_I ECU_ADDRESS 0xd000ca88 FORMAT "%8.3" ARRAY_SIZE 2 MATRIX_DIM 2 1 1 /end MEASUREMENT
/begin MEASUREMENT Atlrd_i "Stellgroesse - D Anteil" SWORD _CNV_R_R_Def_rel_sw_562_CM 1 100. -100. 99.9969 DISPLAY_IDENTIFIER ATLRD_I ECU_ADDRESS 0xd000ca84 FORMAT "%8.3" ARRAY_SIZE 2 MATRIX_DIM 2 1 1 /end MEASUREMENT
/begin MEASUREMENT Atlri_i "Stellgroesse - I Anteil" SWORD _CNV_R_R_Def_rel_sw_562_CM 1 100. -100. 99.9969 DISPLAY_IDENTIFIER ATLRI_I ECU_ADDRESS 0xd000ca5c FORMAT "%8.3" ARRAY_SIZE 2 MATRIX_DIM 2 1 1 /end MEASUREMENT
/begin MEASUREMENT Atlri_tmp_i "Stellgroesse - I-Anteil, temp" SWORD _CNV_R_R_Def_rel_sw_562_CM 1 100. -100. 99.9969 DISPLAY_IDENTIFIER ATLRI_TMP_I ECU_ADDRESS 0xd000ca58 FORMAT "%8.3" ARRAY_SIZE 2 MATRIX_DIM 2 1 1 /end MEASUREMENT
/begin MEASUREMENT Atlrp_i "Stellgroesse - P Anteil" SWORD _CNV_R_R_Def_rel_sw_562_CM 1 100. -100. 99.9969 DISPLAY_IDENTIFIER ATLRP_I ECU_ADDRESS 0xd000ca7c FORMAT "%8.3" ARRAY_SIZE 2 MATRIX_DIM 2 1 1 /end MEASUREMENT
/begin MEASUREMENT Atlrpi_i "Stellgroesse - Summe P und I Anteil" SWORD _CNV_R_R_Def_rel_sw_562_CM 1 100. -100. 99.9969 DISPLAY_IDENTIFIER ATLRPI_I ECU_ADDRESS 0xd000ca80 FORMAT "%8.3" ARRAY_SIZE 2 MATRIX_DIM 2 1 1 /end MEASUREMENT
/begin MEASUREMENT Atlstat_bank "Bankzeiger" UBYTE _CNV_R_R_Def_dez_sl_551_CM 1 100. 0. 1. DISPLAY_IDENTIFIER ATLSTAT_BANK ECU_ADDRESS 0xd000cb60 FORMAT "%3.0" /end MEASUREMENT
/begin MEASUREMENT Atlvst "Stellgroesse Anteil durch Vorsteuerung" UWORD _CNV_R_R_Def_f_uw_b_555_CM 1 100. 0. 99.9984 DISPLAY_IDENTIFIER ATLVST ECU_ADDRESS 0xd000ca60 FORMAT "%8.3" /end MEASUREMENT
/begin MEASUREMENT Atlvst_basis "Stellgroesse Anteil durch Vorsteuerung - Basisgroesse" UWORD _CNV_R_R_Def_f_uw_b_555_CM 1 100. 0. 99.9984 DISPLAY_IDENTIFIER ATLVST_BASIS ECU_ADDRESS 0xd000ca68 FORMAT "%8.3" /end MEASUREMENT
/begin MEASUREMENT Atlvst_dyn "Dynamic der Stellgroesse - Anteil durch Vorsteuerung" SWORD _CNV_R_R_Def_rel_sw_562_CM 1 100. -100. 99.9969 DISPLAY_IDENTIFIER ATLVST_DYN ECU_ADDRESS 0xd000ca6e FORMAT "%8.3" /end MEASUREMENT
/begin MEASUREMENT Atlvst_f "Fuer Vorsteuerungs Dynamikerkennun - Wert gefilteret" UWORD _CNV_R_R_Def_f_uw_b_555_CM 1 100. 0. 99.9984 DISPLAY_IDENTIFIER ATLVST_F ECU_ADDRESS 0xd000ca6c FORMAT "%8.3" /end MEASUREMENT
/begin MEASUREMENT Atlvst_gdueb "Stellgroesse Anteil durch Vorsteuerung - n. Ueberblender" UWORD _CNV_R_R_Def_f_uw_b_555_CM 1 100. 0. 99.9984 DISPLAY_IDENTIFIER ATLVST_GDUEB ECU_ADDRESS 0xd000ca64 FORMAT "%8.3" /end MEASUREMENT
/begin MEASUREMENT Atlvst_ndyn "Offset auf Vorsteuerung bei Drehzahldynamik" UWORD _CNV_R_R_Def_f_uw_b_555_CM 1 100. 0. 99.9984 DISPLAY_IDENTIFIER ATLVST_NDYN ECU_ADDRESS 0xd000ca78 FORMAT "%8.3" /end MEASUREMENT
/begin MEASUREMENT Atlvst_pdyn "Offset auf Vorsteuerung bei Sollladedruckdynamik" UWORD _CNV_R_R_Def_f_uw_b_555_CM 1 100. 0. 99.9984 DISPLAY_IDENTIFIER ATLVST_PDYN ECU_ADDRESS 0xd000ca7a FORMAT "%8.3" /end MEASUREMENT
/begin MEASUREMENT Atlvst_tl "Stellgroesse Anteil durch Vorsteuerung - f. Teillastbetrieb" UWORD _CNV_R_R_Def_f_uw_b_555_CM 1 100. 0. 99.9984 DISPLAY_IDENTIFIER ATLVST_TL ECU_ADDRESS 0xd000ca66 FORMAT "%8.3" /end MEASUREMENT
/begin MEASUREMENT Atlvst_tmp_k "Stellgroesse Anteil durch Vorsteuerung -  nach Korrektur" UWORD _CNV_R_R_Def_f_uw_b_555_CM 1 100. 0. 99.9984 DISPLAY_IDENTIFIER ATLVST_TMP_K ECU_ADDRESS 0xd000ca6a FORMAT "%8.3" /end MEASUREMENT
/begin MEASUREMENT Atlwgfeder "zus. Groesse zur WG-Ansteuerung wegen WG-Feder" UWORD _CNV_R_R_Def_f_uw_b_555_CM 1 100. 0. 99.9984 DISPLAY_IDENTIFIER ATLWGFEDER ECU_ADDRESS 0xd000ca72 FORMAT "%8.3" /end MEASUREMENT
/begin MEASUREMENT B_atlri_init_i "Reset I-Anteil vom Regler" UBYTE _CNV_S_2_Def_bit_ub_563_CM 1 100. 0. 1. DISPLAY_IDENTIFIER B_ATLRI_INIT_I ECU_ADDRESS 0xd000ca50 ARRAY_SIZE 2 BIT_MASK 0x1 MATRIX_DIM 2 1 1 /end MEASUREMENT
/begin MEASUREMENT Chk16_ibs "Checksumme Parameter aus IBS" UWORD _CNV_R_R_Def_dez_sl_551_CM 1 100. 0. 65535. DISPLAY_IDENTIFIER CHK16_IBS ECU_ADDRESS 0xc0000a5a FORMAT "%5.0" /end MEASUREMENT
/begin MEASUREMENT Chkpara "Checksumme Parameter intern" UWORD _CNV_R_R_Def_dez_sl_551_CM 1 100. 0. 65535. DISPLAY_IDENTIFIER CHKPARA ECU_ADDRESS 0xc0000a5c FORMAT "%5.0" /end MEASUREMENT
/begin MEASUREMENT Comcontrol "Kontrolle Diagnose Modul DIBS" UBYTE _CNV_R_R_Def_dez_sl_551_CM 1 100. 0. 255. DISPLAY_IDENTIFIER COMCONTROL ECU_ADDRESS 0xc0000962 FORMAT "%3.0" /end MEASUREMENT
/begin MEASUREMENT Count_out_1 "Zähelr 1" UWORD _CNV_R_R_Def_dez_sl_551_CM 1 100. 0. 65535. DISPLAY_IDENTIFIER COUNT_OUT_1 ECU_ADDRESS 0xc0000c2e FORMAT "%5.0" /end MEASUREMENT
/begin MEASUREMENT Count_out_2 "Zähler 2" UWORD _CNV_R_R_Def_dez_sl_551_CM 1 100. 0. 65535. DISPLAY_IDENTIFIER COUNT_OUT_2 ECU_ADDRESS 0xc0000c30 FORMAT "%5.0" /end MEASUREMENT
/begin MEASUREMENT Count_out_3 "Zähler 3" UWORD _CNV_R_R_Def_dez_sl_551_CM 1 100. 0. 65535. DISPLAY_IDENTIFIER COUNT_OUT_3 ECU_ADDRESS 0xc0000c32 FORMAT "%5.0" /end MEASUREMENT
/begin MEASUREMENT Count_out_4 "Zähler 4" UWORD _CNV_R_R_Def_dez_sl_551_CM 1 100. 0. 65535. DISPLAY_IDENTIFIER COUNT_OUT_4 ECU_ADDRESS 0xc0000c34 FORMAT "%5.0" /end MEASUREMENT
/begin MEASUREMENT Count_out_5 "Zähler 5" UWORD _CNV_R_R_Def_dez_sl_551_CM 1 100. 0. 65535. DISPLAY_IDENTIFIER COUNT_OUT_5 ECU_ADDRESS 0xc0000c36 FORMAT "%5.0" /end MEASUREMENT
/begin MEASUREMENT Count_out_6 "Zähler 6" UWORD _CNV_R_R_Def_dez_sl_551_CM 1 100. 0. 65535. DISPLAY_IDENTIFIER COUNT_OUT_6 ECU_ADDRESS 0xc0000c38 FORMAT "%5.0" /end MEASUREMENT
/begin MEASUREMENT Count_out_7 "Zähler 7" UWORD _CNV_R_R_Def_dez_sl_551_CM 1 100. 0. 65535. DISPLAY_IDENTIFIER COUNT_OUT_7 ECU_ADDRESS 0xc0000c3a FORMAT "%5.0" /end MEASUREMENT
/begin MEASUREMENT Dpllk "Druckabfall ueber Laderluftkuehler" UWORD _CNV_R_R_Def_p_sw_q_576_CM 1 100. 0. 2559.9609 DISPLAY_IDENTIFIER DPLLK ECU_ADDRESS 0xd000cb20 FORMAT "%7.2" /end MEASUREMENT
/begin MEASUREMENT Dsoc_igrmax "Obere iGR-DSOC-Grenze" SWORD _CNV_R_R_Def_f_sw_b_570_CM 1 100. -100. 99.9969 DISPLAY_IDENTIFIER DSOC_IGRMAX ECU_ADDRESS 0xc0000ba2 FORMAT "%8.3" /end MEASUREMENT
/begin MEASUREMENT Dsoc_igrmin "Untere iGR-DSOC-Grenze" SWORD _CNV_R_R_Def_f_sw_b_570_CM 1 100. -100. 99.9969 DISPLAY_IDENTIFIER DSOC_IGRMIN ECU_ADDRESS 0xc0000ba6 FORMAT "%8.3" /end MEASUREMENT
/begin MEASUREMENT Dsoc_msaav1 "Obere MSA Abschaltverhinderer Grenze" SWORD _CNV_R_R_Def_f_sw_b_570_CM 1 100. -100. 99.9969 DISPLAY_IDENTIFIER DSOC_MSAAV1 ECU_ADDRESS 0xc0000ba8 FORMAT "%8.3" /end MEASUREMENT
/begin MEASUREMENT Dsoc_msaav2 "Untere MSA Abschaltverhinderer Grenze" SWORD _CNV_R_R_Def_f_sw_b_570_CM 1 100. -100. 99.9969 DISPLAY_IDENTIFIER DSOC_MSAAV2 ECU_ADDRESS 0xc0000baa FORMAT "%8.3" /end MEASUREMENT
/begin MEASUREMENT Dsoc_msaea1 "MSA CC-Meldung Grenze" SWORD _CNV_R_R_Def_f_sw_b_570_CM 1 100. -100. 99.9969 DISPLAY_IDENTIFIER DSOC_MSAEA1 ECU_ADDRESS 0xc0000bac FORMAT "%8.3" /end MEASUREMENT
/begin MEASUREMENT Dsoc_msaea2 "Untere MSA Einschaltaufvorderer Grenze" SWORD _CNV_R_R_Def_f_sw_b_570_CM 1 100. -100. 99.9969 DISPLAY_IDENTIFIER DSOC_MSAEA2 ECU_ADDRESS 0xc0000bae FORMAT "%8.3" /end MEASUREMENT
/begin MEASUREMENT Ebsd_adr "EBSD Adresse im IBS" UBYTE _CNV_R_R_Def_dez_sl_551_CM 1 100. 0. 255. DISPLAY_IDENTIFIER EBSD_ADR ECU_ADDRESS 0xc0000a4f FORMAT "%3.0" /end MEASUREMENT
/begin MEASUREMENT Ebsd_errdir "EBSD Übertragungsrichtung bei Fehler" UBYTE _CNV_R_R_Def_dez_sl_551_CM 1 100. 0. 255. DISPLAY_IDENTIFIER EBSD_ERRDIR ECU_ADDRESS 0xc0000a50 FORMAT "%3.0" /end MEASUREMENT
/begin MEASUREMENT Ebsd_errep "EBSD Fehler repeat timer" UBYTE _CNV_R_R_Def_dez_sl_551_CM 1 100. 0. 255. DISPLAY_IDENTIFIER EBSD_ERREP ECU_ADDRESS 0xc0000a52 FORMAT "%3.0" /end MEASUREMENT
/begin MEASUREMENT Ebsd_errin "EBSD Index bei Fehler" UBYTE _CNV_R_R_Def_dez_sl_551_CM 1 100. 0. 255. DISPLAY_IDENTIFIER EBSD_ERRIN ECU_ADDRESS 0xc0000a51 FORMAT "%3.0" /end MEASUREMENT
/begin MEASUREMENT Ebsd_nbyt "Länge EBSD Variable" UBYTE _CNV_R_R_Def_dez_sl_551_CM 1 100. 0. 255. DISPLAY_IDENTIFIER EBSD_NBYT ECU_ADDRESS 0xc0000a4d FORMAT "%3.0" /end MEASUREMENT
/begin MEASUREMENT Ebsd_timo "EBSD Fehler timeout counter" UBYTE _CNV_R_R_Def_dez_sl_551_CM 1 100. 0. 255. DISPLAY_IDENTIFIER EBSD_TIMO ECU_ADDRESS 0xc0000a53 FORMAT "%3.0" /end MEASUREMENT
/begin MEASUREMENT Ebsd_varin "Index EBSD Variable" UBYTE _CNV_R_R_Def_dez_sl_551_CM 1 100. 0. 255. DISPLAY_IDENTIFIER EBSD_VARIN ECU_ADDRESS 0xc0000a4c FORMAT "%3.0" /end MEASUREMENT
/begin MEASUREMENT Eco_jobstat1 "Testerstatus" UBYTE _CNV_R_R_Def_dez_sl_551_CM 1 100. 0. 255. DISPLAY_IDENTIFIER ECO_JOBSTAT1 ECU_ADDRESS 0xc0000968 FORMAT "%3.0" /end MEASUREMENT
/begin MEASUREMENT Eco_jobstat2 "Testerstatus" UBYTE _CNV_R_R_Def_dez_sl_551_CM 1 100. 0. 255. DISPLAY_IDENTIFIER ECO_JOBSTAT2 ECU_ADDRESS 0xc0000969 FORMAT "%3.0" /end MEASUREMENT
/begin MEASUREMENT Eco_result1 "Ruhestrom Messbereich 1" UWORD _CNV_R_R_Def_i_uw_q_610_CM 1 100. 0. 81.9187 DISPLAY_IDENTIFIER ECO_RESULT1 ECU_ADDRESS 0xc0000966 FORMAT "%9.4" /end MEASUREMENT
/begin MEASUREMENT F_atldyn "Überspülfaktor" UBYTE _CNV_R_R_Def_f_ub_b_553_CM 1 100. 0. 0.996 DISPLAY_IDENTIFIER F_ATLDYN ECU_ADDRESS 0xd000cb2e /end MEASUREMENT
/begin MEASUREMENT F_atldyn_grd "Überspülfaktor gradientenbegrenzt" UBYTE _CNV_R_R_Def_f_ub_b_553_CM 1 100. 0. 0.996 DISPLAY_IDENTIFIER F_ATLDYN_GRD ECU_ADDRESS 0xd000cb61 /end MEASUREMENT
/begin MEASUREMENT F_dps2dpms_turb "Umrechnung Delta Moment auf Delta Druck" SWORD _CNV_R_R_Def_f_sw_b_591_CM 1 100. -4. 3.9998 DISPLAY_IDENTIFIER F_DPS2DPMS_TURB ECU_ADDRESS 0xd000d6a2 FORMAT "%9.4" /end MEASUREMENT
/begin MEASUREMENT F_pldpu "Faktor Ladedruck zu Umgebungsdruck" UWORD _CNV_R_R_Def_f_sw_b_616_CM 1 100. 0. 3.9999 DISPLAY_IDENTIFIER F_PLDPU ECU_ADDRESS 0xd000cb22 FORMAT "%14.5" /end MEASUREMENT
/begin MEASUREMENT F_pldpu_i "Faktor Ladedruck zu Umgebungsdruck" UWORD _CNV_R_R_Def_f_sw_b_616_CM 1 100. 0. 3.9999 DISPLAY_IDENTIFIER F_PLDPU_I ECU_ADDRESS 0xd000cb3c FORMAT "%14.5" ARRAY_SIZE 2 MATRIX_DIM 2 1 1 /end MEASUREMENT
/begin MEASUREMENT F_pldsvld_f "Soll Aufladungsfaktor - Ladedruck Sollwert zu Druck vor Verdichter" UWORD _CNV_R_R_Def_f_sw_b_616_CM 1 100. 0. 3.9999 DISPLAY_IDENTIFIER F_PLDSVLD_F ECU_ADDRESS 0xd000cb24 FORMAT "%14.5" /end MEASUREMENT
/begin MEASUREMENT F_pvld "Druck vor Lader normiert" UWORD _CNV_R_R_Def_f_uw_b_590_CM 1 100. 0. 1.9999 DISPLAY_IDENTIFIER F_PVLD ECU_ADDRESS 0xd000cb58 FORMAT "%14.5" /end MEASUREMENT
/begin MEASUREMENT F_pwstgdse "Faktor Druckbeaufschlagung Wastegatedose in Abh. vom Drucksteuerventil" UWORD _CNV_R_R_Def_f_uw_b_571_CM 1 100. 0. 0.9999847412109381 DISPLAY_IDENTIFIER F_PWSTGDSE ECU_ADDRESS 0xd000d6cc FORMAT "%14.5" /end MEASUREMENT
/begin MEASUREMENT F_tnzyl "Faktor Abgastemperatur" UWORD _CNV_R_R_Def_f_uw_b_572_CM 1 100. 0. 7.9998 DISPLAY_IDENTIFIER F_TNZYL ECU_ADDRESS 0xd000d6be FORMAT "%9.4" /end MEASUREMENT
/begin MEASUREMENT F_vakinv_tabg "Faktor Abgaskrümmervolumen" SWORD _CNV_R_R_Def_f_sw_b_616_CM 1 100. -2. 1.9999 DISPLAY_IDENTIFIER F_VAKINV_TABG ECU_ADDRESS 0xd000d6a4 FORMAT "%14.5" /end MEASUREMENT
/begin MEASUREMENT Fak_ttansel "Ansaugluftfaktor E-Lüfterstrom" UWORD _CNV_R_R_Def_f_uw_b_626_CM 1 100. 0. 511.9921 DISPLAY_IDENTIFIER FAK_TTANSEL ECU_ADDRESS 0xc00008ce FORMAT "%8.3" /end MEASUREMENT
/begin MEASUREMENT Fak_tubel "Faktor Lüfterstrom aus Geschwindigkeit" UWORD _CNV_R_R_Def_f_uw_b_626_CM 1 100. 0. 511.9921 DISPLAY_IDENTIFIER FAK_TUBEL ECU_ADDRESS 0xc00008d0 FORMAT "%8.3" /end MEASUREMENT
/begin MEASUREMENT Freezcont "Test BSD Control " UBYTE _CNV_R_R_Def_dez_sl_551_CM 1 100. 0. 255. DISPLAY_IDENTIFIER FREEZCONT ECU_ADDRESS 0xc000097a FORMAT "%3.0" /end MEASUREMENT
/begin MEASUREMENT Fsclctr "Hilfszaehler IBS Fehler loeschen" UBYTE _CNV_R_R_Def_dez_sl_551_CM 1 100. 0. 255. DISPLAY_IDENTIFIER FSCLCTR ECU_ADDRESS 0xc0000a55 FORMAT "%3.0" /end MEASUREMENT
/begin MEASUREMENT Gen_dfvorhs "DF-Signal Vorhersage" UBYTE _CNV_R_R_Def_f_ub_b_586_CM 1 100. 0. 99.60930000000001 DISPLAY_IDENTIFIER GEN_DFVORHS ECU_ADDRESS 0xc00008e4 FORMAT "%5.2" /end MEASUREMENT
/begin MEASUREMENT Gen_dfvorhsnofil "DF-Signal Vorhersage ungefiltert" UBYTE _CNV_R_R_Def_f_ub_b_586_CM 1 100. 0. 99.60930000000001 DISPLAY_IDENTIFIER GEN_DFVORHSNOFIL ECU_ADDRESS 0xc00008e8 FORMAT "%5.2" /end MEASUREMENT
/begin MEASUREMENT I_batt "Batteriestrom von IBS gemessen" UWORD _CNV_R_R_Def_i_uw_q_634_CM 1 100. -200. 5042.8 DISPLAY_IDENTIFIER I_BATT ECU_ADDRESS 0xc000097e FORMAT "%8.3" /end MEASUREMENT
/begin MEASUREMENT I_craweng "Strombedarf Motor" SWORD _CNV_R_R_Def_i_sw_q_635_CM 1 100. -10. 254. DISPLAY_IDENTIFIER I_CRAWENG ECU_ADDRESS 0xc00008cc FORMAT "%8.3" /end MEASUREMENT
/begin MEASUREMENT I_elu_vvt "Strom E-Lüfter und VVT-System" UWORD _CNV_R_R_Def_i_uw_q_637_CM 1 100. 0. 4095.9375 DISPLAY_IDENTIFIER I_ELU_VVT ECU_ADDRESS 0xc00008d2 FORMAT "%8.3" /end MEASUREMENT
/begin MEASUREMENT I_eluefter "E-Lüfter Stromaufnahme" UWORD _CNV_R_R_Def_i_uw_q_637_CM 1 100. 0. 4095.9375 DISPLAY_IDENTIFIER I_ELUEFTER ECU_ADDRESS 0xc00008d4 FORMAT "%8.3" /end MEASUREMENT
/begin MEASUREMENT I_elupwm "Lüfterstrom ohne Temperatur- und Geschwindigkeitseinfluss" UWORD _CNV_R_R_Def_i_uw_q_637_CM 1 100. 0. 64. DISPLAY_IDENTIFIER I_ELUPWM ECU_ADDRESS 0xc00008d6 FORMAT "%8.3" /end MEASUREMENT
/begin MEASUREMENT I_eluvfzg "Lüfterstrom ohne Geschwindigkeitseinfluss" UWORD _CNV_R_R_Def_i_uw_q_637_CM 1 100. 0. 128. DISPLAY_IDENTIFIER I_ELUVFZG ECU_ADDRESS 0xc00008d8 FORMAT "%8.3" /end MEASUREMENT
/begin MEASUREMENT I_erripol1 "Ergebnis inverse Interpolation1" UBYTE _CNV_R_R_Def_i_uw_q_630_CM 1 100. 0. 31.875 DISPLAY_IDENTIFIER I_ERRIPOL1 ECU_ADDRESS 0xc00008e9 /end MEASUREMENT
/begin MEASUREMENT I_erripol2 "Ergebnis inverse Interpolation2" UBYTE _CNV_R_R_Def_i_uw_q_630_CM 1 100. 0. 31.875 DISPLAY_IDENTIFIER I_ERRIPOL2 ECU_ADDRESS 0xc00008ea /end MEASUREMENT
/begin MEASUREMENT I_erripol3 "Ergebnis inverse Interpolation3" UBYTE _CNV_R_R_Def_i_uw_q_630_CM 1 100. 0. 31.875 DISPLAY_IDENTIFIER I_ERRIPOL3 ECU_ADDRESS 0xc00008eb /end MEASUREMENT
/begin MEASUREMENT I_gle "Glühstrom" UWORD _CNV_R_R_Def_i_uw_q_637_CM 1 100. 0. 4095.9375 DISPLAY_IDENTIFIER I_GLE ECU_ADDRESS 0xc00008da FORMAT "%8.3" /end MEASUREMENT
/begin MEASUREMENT I_sls "berechnete Groesse Strombedarf Sekundärluftpumpe" UWORD _CNV_R_R_Def_i_uw_q_637_CM 1 100. 0. 255. DISPLAY_IDENTIFIER I_SLS ECU_ADDRESS 0xc00008dc FORMAT "%8.3" /end MEASUREMENT
/begin MEASUREMENT I_soc0 "Strom bei Ruhespannungsmessung" SWORD _CNV_R_R_Def_i_sw_q_640_CM 1 100. -655.36 655.34 DISPLAY_IDENTIFIER I_SOC0 ECU_ADDRESS 0xc000098e FORMAT "%8.3" /end MEASUREMENT
/begin MEASUREMENT I_tnstart "Batteriestrom im Start" UWORD _CNV_R_R_Def_i_uw_q_642_CM 1 100. 0. 1310.7 DISPLAY_IDENTIFIER I_TNSTART ECU_ADDRESS 0xc00009a8 FORMAT "%8.3" /end MEASUREMENT
/begin MEASUREMENT I_vorstart "Batteriestrom vor Start" UWORD _CNV_R_R_Def_i_uw_q_643_CM 1 100. -200. 1110.7 DISPLAY_IDENTIFIER I_VORSTART ECU_ADDRESS 0xc00009a6 FORMAT "%7.2" /end MEASUREMENT
/begin MEASUREMENT Ib_chk16 "Checksumme EBSD Übertragung aus IBS" UWORD _CNV_R_R_Def_dez_sl_551_CM 1 100. 0. 65535. DISPLAY_IDENTIFIER IB_CHK16 ECU_ADDRESS 0xc0000a58 FORMAT "%5.0" /end MEASUREMENT
/begin MEASUREMENT Ib_parlen "Länge IBS Parameterliste" UBYTE _CNV_R_R_Def_dez_sl_551_CM 1 100. 0. 255. DISPLAY_IDENTIFIER IB_PARLEN ECU_ADDRESS 0xc000096d FORMAT "%3.0" /end MEASUREMENT
/begin MEASUREMENT Ibhwversi "IBS Hardware Version" UBYTE _CNV_R_R_Def_dez_sl_551_CM 1 100. 0. 255. DISPLAY_IDENTIFIER IBHWVERSI ECU_ADDRESS 0xc000096c FORMAT "%3.0" /end MEASUREMENT
/begin MEASUREMENT Ibs1_errstat "" UWORD _CNV_R_R_Def_dez_sl_551_CM 1 100. 0. 65535. DISPLAY_IDENTIFIER IBS1_ERRSTAT ECU_ADDRESS 0xc0000940 FORMAT "%5.0" /end MEASUREMENT
/begin MEASUREMENT Ibs2_errstat "" UWORD _CNV_R_R_Def_dez_sl_551_CM 1 100. 0. 65535. DISPLAY_IDENTIFIER IBS2_ERRSTAT ECU_ADDRESS 0xc0000942 FORMAT "%5.0" /end MEASUREMENT
/begin MEASUREMENT Ibs3_errstat "" UWORD _CNV_R_R_Def_dez_sl_551_CM 1 100. 0. 65535. DISPLAY_IDENTIFIER IBS3_ERRSTAT ECU_ADDRESS 0xc0000944 FORMAT "%5.0" /end MEASUREMENT
/begin MEASUREMENT Ibs_ecos "Status Statemachine Ecos" UBYTE _CNV_R_R_Def_dez_sl_551_CM 1 100. 0. 255. DISPLAY_IDENTIFIER IBS_ECOS ECU_ADDRESS 0xc0000961 FORMAT "%3.0" /end MEASUREMENT
/begin MEASUREMENT Ibs_errors "Fehler Reg. aus IBS gelesen" UBYTE _CNV_R_R_Def_dez_sl_551_CM 1 100. 0. 255. DISPLAY_IDENTIFIER IBS_ERRORS ECU_ADDRESS 0xc000095c FORMAT "%3.0" /end MEASUREMENT
/begin MEASUREMENT Ibs_msgind "Index auf EBSD Botschaft" UBYTE _CNV_R_R_Def_dez_sl_551_CM 1 100. 0. 255. DISPLAY_IDENTIFIER IBS_MSGIND ECU_ADDRESS 0xc000095d FORMAT "%3.0" /end MEASUREMENT
/begin MEASUREMENT Ibs_msgsta "EBSD Fehler Status" UBYTE _CNV_R_R_Def_dez_sl_551_CM 1 100. 0. 255. DISPLAY_IDENTIFIER IBS_MSGSTA ECU_ADDRESS 0xc000095e FORMAT "%3.0" /end MEASUREMENT
/begin MEASUREMENT Ibs_reg5 "IBS Register 5 Var.not used: now St_ibsreg5" UBYTE _CNV_R_R_Def_dez_sl_551_CM 1 100. 0. 255. DISPLAY_IDENTIFIER IBS_REG5 ECU_ADDRESS 0xc000095b FORMAT "%3.0" /end MEASUREMENT
/begin MEASUREMENT Ibs_start "Status Statemachine Startup Kommunikation" UBYTE _CNV_R_R_Def_dez_sl_551_CM 1 100. 0. 255. DISPLAY_IDENTIFIER IBS_START ECU_ADDRESS 0xc0000960 FORMAT "%3.0" /end MEASUREMENT
/begin MEASUREMENT Ibsbclctri "IBS Fehlerzähler" UBYTE _CNV_R_R_Def_dez_sl_551_CM 1 100. 0. 255. DISPLAY_IDENTIFIER IBSBCLCTRI ECU_ADDRESS 0xc000096f FORMAT "%3.0" /end MEASUREMENT
/begin MEASUREMENT Ibsborctr "IBS Fehlerzähler" UWORD _CNV_R_R_Def_dez_sl_551_CM 1 100. 0. 65535. DISPLAY_IDENTIFIER IBSBORCTR ECU_ADDRESS 0xc0000982 FORMAT "%5.0" /end MEASUREMENT
/begin MEASUREMENT Ibsderrs1 "Fehlerzähler IBS BSD Kommunikation" UBYTE _CNV_R_R_Def_dez_sl_551_CM 1 100. 0. 255. DISPLAY_IDENTIFIER IBSDERRS1 ECU_ADDRESS 0xc00045f4 FORMAT "%3.0" /end MEASUREMENT
/begin MEASUREMENT Ibsderrs2 "Fehlerzähler IBS EBSD Kommunikation" UWORD _CNV_R_R_Def_dez_sl_551_CM 1 100. 0. 65535. DISPLAY_IDENTIFIER IBSDERRS2 ECU_ADDRESS 0xc00045f2 FORMAT "%5.0" /end MEASUREMENT
/begin MEASUREMENT Ibsdncsctr "IBS Fehlerzähler download checksum" UBYTE _CNV_R_R_Def_dez_sl_551_CM 1 100. 0. 255. DISPLAY_IDENTIFIER IBSDNCSCTR ECU_ADDRESS 0xc0000973 FORMAT "%3.0" /end MEASUREMENT
/begin MEASUREMENT Ibseromctr "IBS Fehlerzähler" UBYTE _CNV_R_R_Def_dez_sl_551_CM 1 100. 0. 255. DISPLAY_IDENTIFIER IBSEROMCTR ECU_ADDRESS 0xc0000970 FORMAT "%3.0" /end MEASUREMENT
/begin MEASUREMENT Ibsiicctri "IBS Fehlerzähler" UBYTE _CNV_R_R_Def_dez_sl_551_CM 1 100. 0. 255. DISPLAY_IDENTIFIER IBSIICCTRI ECU_ADDRESS 0xc000096e FORMAT "%3.0" /end MEASUREMENT
/begin MEASUREMENT Ibslvdctr "IBS Fehlerzähler" UWORD _CNV_R_R_Def_dez_sl_551_CM 1 100. 0. 65535. DISPLAY_IDENTIFIER IBSLVDCTR ECU_ADDRESS 0xc000097c FORMAT "%5.0" /end MEASUREMENT
/begin MEASUREMENT Ibsporctr "IBS Fehlerzähler power on" UWORD _CNV_R_R_Def_dez_sl_551_CM 1 100. 0. 65535. DISPLAY_IDENTIFIER IBSPORCTR ECU_ADDRESS 0xc0000986 FORMAT "%5.0" /end MEASUREMENT
/begin MEASUREMENT Ibspreco2 "Vorteiler /10 fuer Ibsderrs2" UBYTE _CNV_R_R_Def_dez_sl_551_CM 1 100. 0. 255. DISPLAY_IDENTIFIER IBSPRECO2 ECU_ADDRESS 0xc00045f5 FORMAT "%3.0" /end MEASUREMENT
/begin MEASUREMENT Ibspromctr "IBS Fehlerzähler" UBYTE _CNV_R_R_Def_dez_sl_551_CM 1 100. 0. 255. DISPLAY_IDENTIFIER IBSPROMCTR ECU_ADDRESS 0xc0000972 FORMAT "%3.0" /end MEASUREMENT
/begin MEASUREMENT Ibsptyctr "IBS Fehlerzähler BSD parity" UWORD _CNV_R_R_Def_dez_sl_551_CM 1 100. 0. 65535. DISPLAY_IDENTIFIER IBSPTYCTR ECU_ADDRESS 0xc0000988 FORMAT "%5.0" /end MEASUREMENT
/begin MEASUREMENT Ibsramctr "IBS Fehlerzähler" UBYTE _CNV_R_R_Def_dez_sl_551_CM 1 100. 0. 255. DISPLAY_IDENTIFIER IBSRAMCTR ECU_ADDRESS 0xc0000971 FORMAT "%3.0" /end MEASUREMENT
/begin MEASUREMENT Ibswbase "IBS Software Baseline" UBYTE _CNV_R_R_Def_dez_sl_551_CM 1 100. 0. 255. DISPLAY_IDENTIFIER IBSWBASE ECU_ADDRESS 0xc000096a FORMAT "%3.0" /end MEASUREMENT
/begin MEASUREMENT Ibswchang "IBS Software Änderungs Status" UBYTE _CNV_R_R_Def_dez_sl_551_CM 1 100. 0. 255. DISPLAY_IDENTIFIER IBSWCHANG ECU_ADDRESS 0xc000096b FORMAT "%3.0" /end MEASUREMENT
/begin MEASUREMENT Ibswdtctr "IBS Fehlerzähler watchdog" UWORD _CNV_R_R_Def_dez_sl_551_CM 1 100. 0. 65535. DISPLAY_IDENTIFIER IBSWDTCTR ECU_ADDRESS 0xc0000984 FORMAT "%5.0" /end MEASUREMENT
/begin MEASUREMENT Ierr_vorhs "Vorhergesagter Erregerstrom bei LL Anhebung" UBYTE _CNV_R_R_Def_i_uw_q_630_CM 1 100. 0. 31.875 DISPLAY_IDENTIFIER IERR_VORHS ECU_ADDRESS 0xc00008ec /end MEASUREMENT
/begin MEASUREMENT Igr_inforeset "Zähler, wie oft Infospeicher zurückgesetzt wurde" UBYTE _CNV_R_R_Def_dez_sl_551_CM 1 100. 0. 255. DISPLAY_IDENTIFIER IGR_INFORESET ECU_ADDRESS 0xd000d8b8 FORMAT "%3.0" /end MEASUREMENT
/begin MEASUREMENT Igrinfo "Infospeicher iGR" UBYTE _CNV_R_R_Def_dez_sl_551_CM 1 100. 0. 255. DISPLAY_IDENTIFIER IGRINFO ECU_ADDRESS 0xc00046f4 FORMAT "%3.0" ARRAY_SIZE 30 MATRIX_DIM 30 1 1 /end MEASUREMENT
/begin MEASUREMENT Kt_ibsstatus "Status BSD Statemachine" UBYTE _CNV_R_R_Def_dez_sl_551_CM 1 100. 0. 255. DISPLAY_IDENTIFIER KT_IBSSTATUS ECU_ADDRESS 0xc000095f FORMAT "%3.0" /end MEASUREMENT
/begin MEASUREMENT Ktib_chk16 "Checksumme EBSD Übertragung intern" UWORD _CNV_R_R_Def_dez_sl_551_CM 1 100. 0. 65535. DISPLAY_IDENTIFIER KTIB_CHK16 ECU_ADDRESS 0xc0000a56 FORMAT "%5.0" /end MEASUREMENT
/begin MEASUREMENT Ktupcsctr "kt_ibs Fehlerzähler EBSD Checksumme" UWORD _CNV_R_R_Def_dez_sl_551_CM 1 100. 0. 65535. DISPLAY_IDENTIFIER KTUPCSCTR ECU_ADDRESS 0xc00009b8 FORMAT "%5.0" /end MEASUREMENT
/begin MEASUREMENT Lemcnt_reset "Zwischengröße Setzen LEMINFO auf Defaultwert" UWORD _CNV_R_R_Def_dez_sl_551_CM 1 100. 0. 65535. DISPLAY_IDENTIFIER LEMCNT_RESET ECU_ADDRESS 0xd000d8bc FORMAT "%5.0" /end MEASUREMENT
/begin MEASUREMENT Leminfo "Infospeicher für LEM" UBYTE _CNV_R_R_Def_dez_sl_551_CM 1 100. 0. 255. DISPLAY_IDENTIFIER LEMINFO ECU_ADDRESS 0xc0004714 FORMAT "%3.0" ARRAY_SIZE 40 MATRIX_DIM 40 1 1 /end MEASUREMENT
/begin MEASUREMENT Md_entlsoll3 "" SWORD _CNV_R_R_Def_m_sw_q_554_CM 1 100. -3276.8 3276.7 DISPLAY_IDENTIFIER MD_ENTLSOLL3 ECU_ADDRESS 0xc0000db4 FORMAT "%7.2" /end MEASUREMENT
/begin MEASUREMENT Mk_ausy "Kraftstoffmassenstrom" UWORD _CNV_R_R_Def_ms_uw__594_CM 1 100. 0. 2047.9687 DISPLAY_IDENTIFIER MK_AUSY ECU_ADDRESS 0xd000d6b0 FORMAT "%8.3" /end MEASUREMENT
/begin MEASUREMENT Msak_diff "Delta Massenstrom Abgaskrümmer" SWORD _CNV_R_R_Def_ms_uw__594_CM 1 100. -1024. 1023.9687 DISPLAY_IDENTIFIER MSAK_DIFF ECU_ADDRESS 0xd000d6a6 FORMAT "%8.3" /end MEASUREMENT
/begin MEASUREMENT Mslui_nv "Massenstrom aufsummiert - Wert abgespeichert" UWORD _CNV_R_R_Def_lm_uw__654_CM 1 100. 0. 29.1266 DISPLAY_IDENTIFIER MSLUI_NV ECU_ADDRESS 0xc000402e FORMAT "%9.4" /end MEASUREMENT
/begin MEASUREMENT Mssolatl_k "Sollmassenstrom korrigiert fuer Ladedruckregelung" UWORD _CNV_R_R_Def_ms_uw__594_CM 1 100. 0. 2047.9687 DISPLAY_IDENTIFIER MSSOLATL_K ECU_ADDRESS 0xd000cb26 FORMAT "%8.3" /end MEASUREMENT
/begin MEASUREMENT Msturb "Turbinenmassenstrom" UWORD _CNV_R_R_Def_ms_uw__594_CM 1 100. 0. 2047.9687 DISPLAY_IDENTIFIER MSTURB ECU_ADDRESS 0xd000d6c0 FORMAT "%8.3" /end MEASUREMENT
/begin MEASUREMENT Msturb_diff "Delta Turbinenmassenstrom" SWORD _CNV_R_R_Def_f_sw_b_570_CM 1 100. -100. 99.9969 DISPLAY_IDENTIFIER MSTURB_DIFF ECU_ADDRESS 0xd000d6b8 FORMAT "%8.3" /end MEASUREMENT
/begin MEASUREMENT Msturb_diff_tseg "Turbinenmassenstromänderung pro Segment" SWORD _CNV_R_R_Def_f_sw_b_616_CM 1 100. -2. 1.9999 DISPLAY_IDENTIFIER MSTURB_DIFF_TSEG ECU_ADDRESS 0xd000d6a8 FORMAT "%14.5" /end MEASUREMENT
/begin MEASUREMENT Msturbdiff_tgkor "Delta Turbinenmassenstrom temperaturkorrigiert" SWORD _CNV_R_R_Def_f_sw_b_570_CM 1 100. -100. 99.9969 DISPLAY_IDENTIFIER MSTURBDIFF_TGKOR ECU_ADDRESS 0xd000d6c8 FORMAT "%8.3" /end MEASUREMENT
/begin MEASUREMENT Msturbdiff_ukor "Delta Turbinenmassenstrom unkorrigiert" SWORD _CNV_R_R_Def_f_sw_p_557_CM 1 100. -8192. 8191.75 DISPLAY_IDENTIFIER MSTURBDIFF_UKOR ECU_ADDRESS 0xd000d6ca FORMAT "%7.2" /end MEASUREMENT
/begin MEASUREMENT Msturbine "" UWORD _CNV_R_R_Def_ms_uw__594_CM 1 100. 0. 2047.9687 DISPLAY_IDENTIFIER MSTURBINE ECU_ADDRESS 0xd000d6c2 FORMAT "%8.3" /end MEASUREMENT
/begin MEASUREMENT Msvld "Massenstrom v. Verdichter" UWORD _CNV_R_R_Def_ms_uw__594_CM 1 100. 0. 2047.9687 DISPLAY_IDENTIFIER MSVLD ECU_ADDRESS 0xd000cb28 FORMAT "%8.3" /end MEASUREMENT
/begin MEASUREMENT Msvld_dyn "Massenstrom v. Verdichter - dynamisch" SWORD _CNV_R_R_Def_ms_uw__594_CM 1 100. -1024. 1023.9687 DISPLAY_IDENTIFIER MSVLD_DYN ECU_ADDRESS 0xd000cb0a FORMAT "%8.3" /end MEASUREMENT
/begin MEASUREMENT Msvld_dyn_i "Massenstrom v. Verdichter - dynamisch" SWORD _CNV_R_R_Def_ms_uw__594_CM 1 100. -1024. 1023.9687 DISPLAY_IDENTIFIER MSVLD_DYN_I ECU_ADDRESS 0xd000cb34 FORMAT "%8.3" ARRAY_SIZE 2 MATRIX_DIM 2 1 1 /end MEASUREMENT
/begin MEASUREMENT Msvld_i "Massenstrom v. Verdichter" UWORD _CNV_R_R_Def_ms_uw__594_CM 1 100. 0. 2047.9687 DISPLAY_IDENTIFIER MSVLD_I ECU_ADDRESS 0xd000cb30 FORMAT "%8.3" ARRAY_SIZE 2 MATRIX_DIM 2 1 1 /end MEASUREMENT
/begin MEASUREMENT Mswg "" UWORD _CNV_R_R_Def_ms_uw__594_CM 1 100. 0. 2047.9687 DISPLAY_IDENTIFIER MSWG ECU_ADDRESS 0xd000d6c4 FORMAT "%8.3" /end MEASUREMENT
/begin MEASUREMENT N_genll "Drehzahl Generator bei LL Anhebung" SWORD _CNV_R_R_Def_n_sw_q_595_CM 1 100. -32768. 32767. DISPLAY_IDENTIFIER N_GENLL ECU_ADDRESS 0xc00008e6 FORMAT "%5.0" /end MEASUREMENT
/begin MEASUREMENT N_idlgspec "Anforderung LL-Anhebung" UBYTE _CNV_R_R_Def_dez_sl_551_CM 1 100. 0. 255. DISPLAY_IDENTIFIER N_IDLGSPEC ECU_ADDRESS 0xc00008e5 FORMAT "%3.0" /end MEASUREMENT
/begin MEASUREMENT Nkw_dyn "Dynamikerkennung der Motordrehzahl" SWORD _CNV_R_R_Def_n_sw_q_595_CM 1 100. -32768. 32767. DISPLAY_IDENTIFIER NKW_DYN ECU_ADDRESS 0xd000cb0c FORMAT "%5.0" /end MEASUREMENT
/begin MEASUREMENT Nkw_dyn2 "Dynamikerkennung fuer Motordrehzahl" SWORD _CNV_R_R_Def_n_sw_q_595_CM 1 100. -32768. 32767. DISPLAY_IDENTIFIER NKW_DYN2 ECU_ADDRESS 0xd000ca74 FORMAT "%5.0" /end MEASUREMENT
/begin MEASUREMENT Pak "Abgaskrümmerdruck" UWORD _CNV_R_R_Def_p_sw_q_576_CM 1 100. 0. 2559.9609 DISPLAY_IDENTIFIER PAK ECU_ADDRESS 0xd000d694 FORMAT "%8.3" /end MEASUREMENT
/begin MEASUREMENT Pak_diff "Delta Abgaskrümmerdruck" SWORD _CNV_R_R_Def_p_sw_q_576_CM 1 100. -1280. 1279.9609 DISPLAY_IDENTIFIER PAK_DIFF ECU_ADDRESS 0xd000d6aa FORMAT "%7.2" /end MEASUREMENT
/begin MEASUREMENT Pak_diff_2 "Delta Abgaskrümmerdruck (bei alternativer Stabilisierung)" SWORD _CNV_R_R_Def_p_sw_q_576_CM 1 100. -1280. 1279.9609 DISPLAY_IDENTIFIER PAK_DIFF_2 ECU_ADDRESS 0xd000d6ac FORMAT "%7.2" /end MEASUREMENT
/begin MEASUREMENT Pak_diff_tseg "Delta Abgaskrümmerdruck pro Segment" SWORD _CNV_R_R_Def_p_sw_q_576_CM 1 100. -1280. 1279.9609 DISPLAY_IDENTIFIER PAK_DIFF_TSEG ECU_ADDRESS 0xd000d6ae FORMAT "%7.2" /end MEASUREMENT
/begin MEASUREMENT Pak_i "Abgaskrümmerdruck" UWORD _CNV_R_R_Def_p_sw_q_576_CM 1 100. 0. 2559.9609 DISPLAY_IDENTIFIER PAK_I ECU_ADDRESS 0xd000d69e FORMAT "%8.3" ARRAY_SIZE 2 MATRIX_DIM 2 1 1 /end MEASUREMENT
/begin MEASUREMENT Pakpn "Normierter Abgaskrümmerdruck" UWORD _CNV_R_R_Def_f_sw_b_616_CM 1 100. 0. 3.9999 DISPLAY_IDENTIFIER PAKPN ECU_ADDRESS 0xd000d696 FORMAT "%14.5" /end MEASUREMENT
/begin MEASUREMENT Pakps "Verhältnis Abgaskrümmer- zu Saugrohrdruck" UWORD _CNV_R_R_Def_f_uw_b_590_CM 1 100. 0. 1.9999 DISPLAY_IDENTIFIER PAKPS ECU_ADDRESS 0xd000d698 FORMAT "%14.5" /end MEASUREMENT
/begin MEASUREMENT Pkat "Druck vor Kat" UWORD _CNV_R_R_Def_p_sw_q_576_CM 1 100. 0. 2559.9609 DISPLAY_IDENTIFIER PKAT ECU_ADDRESS 0xd000d6b4 FORMAT "%7.2" /end MEASUREMENT
/begin MEASUREMENT Pkat_rel "Relativer Druck vor Kat" UWORD _CNV_R_R_Def_p_sw_q_576_CM 1 100. 0. 2559.9609 DISPLAY_IDENTIFIER PKAT_REL ECU_ADDRESS 0xd000d6b6 FORMAT "%7.2" /end MEASUREMENT
/begin MEASUREMENT Pld_dgrd_i "Gradient der Regeldifferenz" SWORD _CNV_R_R_Def_p_sw_q_680_CM 1 100. -2560. 2559.9218 DISPLAY_IDENTIFIER PLD_DGRD_I ECU_ADDRESS 0xd000cbc4 FORMAT "%7.2" ARRAY_SIZE 2 MATRIX_DIM 2 1 1 /end MEASUREMENT
/begin MEASUREMENT Pld_diff "Regeldifferenz" SWORD _CNV_R_R_Def_p_sw_q_680_CM 1 100. -2560. 2559.9218 DISPLAY_IDENTIFIER PLD_DIFF ECU_ADDRESS 0xd000cb0e FORMAT "%7.2" /end MEASUREMENT
/begin MEASUREMENT Pld_diff_dyn_i "Regelabweichung - Dynamik" SWORD _CNV_R_R_Def_p_sw_q_680_CM 1 100. -2560. 2559.9218 DISPLAY_IDENTIFIER PLD_DIFF_DYN_I ECU_ADDRESS 0xd000cb44 FORMAT "%7.2" ARRAY_SIZE 2 MATRIX_DIM 2 1 1 /end MEASUREMENT
/begin MEASUREMENT Pld_diff_fil "Regeldifferenz mit gef. Ladedruck" SWORD _CNV_R_R_Def_p_sw_q_680_CM 1 100. -2560. 2559.9218 DISPLAY_IDENTIFIER PLD_DIFF_FIL ECU_ADDRESS 0xd000cb10 FORMAT "%7.2" /end MEASUREMENT
/begin MEASUREMENT Pld_diff_fil_i "Regeldifferenz mit gef. Ladedruck" SWORD _CNV_R_R_Def_p_sw_q_680_CM 1 100. -2560. 2559.9218 DISPLAY_IDENTIFIER PLD_DIFF_FIL_I ECU_ADDRESS 0xd000cb48 FORMAT "%7.2" ARRAY_SIZE 2 MATRIX_DIM 2 1 1 /end MEASUREMENT
/begin MEASUREMENT Pld_diff_grd "Gradient der Regeldifferenz normiert" SWORD _CNV_R_R_Def_p_sw_q_680_CM 1 100. -2560. 2559.9218 DISPLAY_IDENTIFIER PLD_DIFF_GRD ECU_ADDRESS 0xd000cb12 FORMAT "%7.2" /end MEASUREMENT
/begin MEASUREMENT Pld_diff_grd_i "Gradient der Regeldifferenz normiert" SWORD _CNV_R_R_Def_p_sw_q_680_CM 1 100. -2560. 2559.9218 DISPLAY_IDENTIFIER PLD_DIFF_GRD_I ECU_ADDRESS 0xd000cb4c FORMAT "%7.2" ARRAY_SIZE 2 MATRIX_DIM 2 1 1 /end MEASUREMENT
/begin MEASUREMENT Pld_diff_i "Regeldifferenz" SWORD _CNV_R_R_Def_p_sw_q_680_CM 1 100. -2560. 2559.9218 DISPLAY_IDENTIFIER PLD_DIFF_I ECU_ADDRESS 0xd000cb40 FORMAT "%7.2" ARRAY_SIZE 2 MATRIX_DIM 2 1 1 /end MEASUREMENT
/begin MEASUREMENT Pldr_soll "Ladedruck - Sollwert für Regler" UWORD _CNV_R_R_Def_p_sw_q_576_CM 1 100. 0. 2559.9609 DISPLAY_IDENTIFIER PLDR_SOLL ECU_ADDRESS 0xd000cb2a FORMAT "%7.2" /end MEASUREMENT
/begin MEASUREMENT Pldrsoll_dyn "Ladedruck - dyn. Sollwert für Regler" SWORD _CNV_R_R_Def_p_sw_q_576_CM 1 100. -1280. 1279.9609 DISPLAY_IDENTIFIER PLDRSOLL_DYN ECU_ADDRESS 0xd000cb14 FORMAT "%7.2" /end MEASUREMENT
/begin MEASUREMENT Pldrsoll_dyn2 "Dynamikerkennung fuer Sollladedruck" SWORD _CNV_R_R_Def_p_sw_q_576_CM 1 100. -1280. 1279.9609 DISPLAY_IDENTIFIER PLDRSOLL_DYN2 ECU_ADDRESS 0xd000ca76 FORMAT "%7.2" /end MEASUREMENT
/begin MEASUREMENT Pr_igr_dn "Prioritaet iGR Spannungsrampe negativ" UBYTE _CNV_R_R_Def_dez_sl_551_CM 1 100. 0. 255. DISPLAY_IDENTIFIER PR_IGR_DN ECU_ADDRESS 0xc0000bdd FORMAT "%3.0" /end MEASUREMENT
/begin MEASUREMENT Pr_igr_dp "Prioritaet iGR Spannungsrampe positiv" UBYTE _CNV_R_R_Def_dez_sl_551_CM 1 100. 0. 255. DISPLAY_IDENTIFIER PR_IGR_DP ECU_ADDRESS 0xc0000bde FORMAT "%3.0" /end MEASUREMENT
/begin MEASUREMENT Pr_igr_soll "Prioritaet iGR Sollspannungsanforderung" UBYTE _CNV_R_R_Def_dez_sl_551_CM 1 100. 0. 255. DISPLAY_IDENTIFIER PR_IGR_SOLL ECU_ADDRESS 0xc0000bdf FORMAT "%3.0" /end MEASUREMENT
/begin MEASUREMENT Pr_md_entlsoll3 "" UBYTE _CNV_R_R_Def_dez_sl_551_CM 1 100. 0. 255. DISPLAY_IDENTIFIER PR_MD_ENTLSOLL3 ECU_ADDRESS 0xc0000db6 FORMAT "%3.0" /end MEASUREMENT
/begin MEASUREMENT Prat_turb "Delta Turbinenmassenstrom unkorrigiert" UWORD _CNV_R_R_Def_f_sw_b_616_CM 1 100. 0. 3.9999 DISPLAY_IDENTIFIER PRAT_TURB ECU_ADDRESS 0xd000d6c6 FORMAT "%14.5" /end MEASUREMENT
/begin MEASUREMENT Pspak "Verhältnis Saugrohrdruck- zu Abgaskrümmerdruck" UWORD _CNV_R_R_Def_f_uw_b_590_CM 1 100. 0. 1.9999 DISPLAY_IDENTIFIER PSPAK ECU_ADDRESS 0xd000d69a FORMAT "%14.5" /end MEASUREMENT
/begin MEASUREMENT Pspn "Normierter Saugrohrdruck" UWORD _CNV_R_R_Def_f_sw_b_616_CM 1 100. 0. 3.9999 DISPLAY_IDENTIFIER PSPN ECU_ADDRESS 0xd000d69c FORMAT "%14.5" /end MEASUREMENT
/begin MEASUREMENT Pturb "Korrigierter Turbinendurchfluss" UWORD _CNV_R_R_Def_p_sw_q_576_CM 1 100. 0. 2559.9609 DISPLAY_IDENTIFIER PTURB ECU_ADDRESS 0xd000d6ce FORMAT "%7.2" /end MEASUREMENT
/begin MEASUREMENT Pvdkds_dyn "Ladedruck dyn. Istwert" SWORD _CNV_R_R_Def_p_sw_q_576_CM 1 100. -1280. 1279.9609 DISPLAY_IDENTIFIER PVDKDS_DYN ECU_ADDRESS 0xd000cb16 FORMAT "%7.2" /end MEASUREMENT
/begin MEASUREMENT Pvdkds_dyn_i "Ladedruck dyn. Istwert" SWORD _CNV_R_R_Def_p_sw_q_576_CM 1 100. -1280. 1279.9609 DISPLAY_IDENTIFIER PVDKDS_DYN_I ECU_ADDRESS 0xd000cb38 FORMAT "%7.2" ARRAY_SIZE 2 MATRIX_DIM 2 1 1 /end MEASUREMENT
/begin MEASUREMENT Pvld "Druck vor Verdichter" UWORD _CNV_R_R_Def_p_sw_q_576_CM 1 100. 3.91e-002 2559.9609 DISPLAY_IDENTIFIER PVLD ECU_ADDRESS 0xd000cb2c FORMAT "%7.2" /end MEASUREMENT
/begin MEASUREMENT Pwg "" UWORD _CNV_R_R_Def_p_sw_q_576_CM 1 100. 0. 2559.9609 DISPLAY_IDENTIFIER PWG ECU_ADDRESS 0xd000d6d0 FORMAT "%7.2" /end MEASUREMENT
/begin MEASUREMENT Pwstgdse "Modell Druck in der Wastegatedose" UWORD _CNV_R_R_Def_p_sw_q_576_CM 1 100. 0. 2559.9609 DISPLAY_IDENTIFIER PWSTGDSE ECU_ADDRESS 0xd000d6d2 FORMAT "%7.2" /end MEASUREMENT
/begin MEASUREMENT Pwstgtpu "Verhältnis Wastegatedosendruck / Umgebungsdruck" UWORD _CNV_R_R_Def_f_sw_b_616_CM 1 100. 0. 3.9999 DISPLAY_IDENTIFIER PWSTGTPU ECU_ADDRESS 0xd000d6d4 FORMAT "%14.5" /end MEASUREMENT
/begin MEASUREMENT Qelad "Delta Batterieentladung" UWORD _CNV_R_R_Def_ql_uw__577_CM 1 100. 0. 1192.7502 DISPLAY_IDENTIFIER QELAD ECU_ADDRESS 0xc000098c FORMAT "%8.3" /end MEASUREMENT
/begin MEASUREMENT Qelad_ges "Entladung aus PMINFO1_1" UWORD _CNV_R_R_Def_ql_uw__597_CM 1 100. 0. 19087.864 DISPLAY_IDENTIFIER QELAD_GES ECU_ADDRESS 0xc0000ba4 FORMAT "%7.2" /end MEASUREMENT
/begin MEASUREMENT Qelad_igrhi "IGR-Info Entladung bei iGR-High" UWORD _CNV_R_R_Def_ql_uw__597_CM 1 100. 0. 19087.864 DISPLAY_IDENTIFIER QELAD_IGRHI ECU_ADDRESS 0xc0007a70 FORMAT "%7.2" /end MEASUREMENT
/begin MEASUREMENT Qeladhi_start "IGR-Info Startwert iGR-High" UWORD _CNV_R_R_Def_ql_uw__597_CM 1 100. 0. 19087.864 DISPLAY_IDENTIFIER QELADHI_START ECU_ADDRESS 0xc0000bf2 FORMAT "%7.2" /end MEASUREMENT
/begin MEASUREMENT Qeladmed_start "IGR-Info Startwert iGR-Medium" UWORD _CNV_R_R_Def_ql_uw__597_CM 1 100. 0. 19087.864 DISPLAY_IDENTIFIER QELADMED_START ECU_ADDRESS 0xc0000bf4 FORMAT "%7.2" /end MEASUREMENT
/begin MEASUREMENT Qeladsoc0 "Entladung bei Ruhespannungsmessung" UWORD _CNV_R_R_Def_ql_uw__577_CM 1 100. 0. 1192.7502 DISPLAY_IDENTIFIER QELADSOC0 ECU_ADDRESS 0xc00009a0 FORMAT "%8.3" /end MEASUREMENT
/begin MEASUREMENT Qlad "Delta Batterieladung" UWORD _CNV_R_R_Def_ql_uw__577_CM 1 100. 0. 1192.7502 DISPLAY_IDENTIFIER QLAD ECU_ADDRESS 0xc000098a FORMAT "%8.3" /end MEASUREMENT
/begin MEASUREMENT Qlad_ges "Ladung aus PMINFO1" UWORD _CNV_R_R_Def_ql_uw__597_CM 1 100. 0. 19087.864 DISPLAY_IDENTIFIER QLAD_GES ECU_ADDRESS 0xc0000bf6 FORMAT "%7.2" /end MEASUREMENT
/begin MEASUREMENT Qlad_igrlow "IGR-Info Ladung bei iGR-Low" UWORD _CNV_R_R_Def_ql_uw__597_CM 1 100. 0. 19087.864 DISPLAY_IDENTIFIER QLAD_IGRLOW ECU_ADDRESS 0xc0000bf0 FORMAT "%7.2" /end MEASUREMENT
/begin MEASUREMENT Qladlow_int "IGR-InfoIntegrator Ladung iGR-Low" ULONG _CNV_R_R_Def_dez_sl_551_CM 1 100. 0. 4294967295. DISPLAY_IDENTIFIER QLADLOW_INT ECU_ADDRESS 0xc0000bec FORMAT "%7.0" /end MEASUREMENT
/begin MEASUREMENT Qladmed_start "IGR-Info Startwert iGR-Medium" UWORD _CNV_R_R_Def_ql_uw__597_CM 1 100. 0. 19087.864 DISPLAY_IDENTIFIER QLADMED_START ECU_ADDRESS 0xc0000bf8 FORMAT "%7.2" /end MEASUREMENT
/begin MEASUREMENT Qladsoc0 "Ladung bei Ruhespannungsmessung" UWORD _CNV_R_R_Def_ql_uw__577_CM 1 100. 0. 1192.7502 DISPLAY_IDENTIFIER QLADSOC0 ECU_ADDRESS 0xc000099e FORMAT "%8.3" /end MEASUREMENT
/begin MEASUREMENT Qv_nstartval "Anzahl Messwertepaare fuer QV- Algorithmus" UBYTE _CNV_R_R_Def_dez_sl_551_CM 1 100. 0. 255. DISPLAY_IDENTIFIER QV_NSTARTVAL ECU_ADDRESS 0xc0000977 FORMAT "%3.0" /end MEASUREMENT
/begin MEASUREMENT Qv_td "Relativ Stunden aus IBS" UWORD _CNV_R_R_Def_th_uw__699_CM 1 100. 0. 65535. DISPLAY_IDENTIFIER QV_TD ECU_ADDRESS 0xc00009be FORMAT "%5.0" /end MEASUREMENT
/begin MEASUREMENT Qvary_i "Startauswertung Messwertarray Strom" UWORD _CNV_R_R_Def_i_uw_q_642_CM 1 100. 0. 1310.7 DISPLAY_IDENTIFIER QVARY_I ECU_ADDRESS 0xc00009c0 FORMAT "%8.3" ARRAY_SIZE 32 MATRIX_DIM 32 1 1 /end MEASUREMENT
/begin MEASUREMENT Qvary_u "Startauswertung Messwertarray Spannung" UWORD _CNV_R_R_Def_u_uw_q_700_CM 1 100. 6. 22.3837 DISPLAY_IDENTIFIER QVARY_U ECU_ADDRESS 0xc0000a00 FORMAT "%9.4" ARRAY_SIZE 32 MATRIX_DIM 32 1 1 /end MEASUREMENT
/begin MEASUREMENT R5cyctim "Timer f. zyklisches Senden IBS Reg. 5" UBYTE _CNV_R_R_Def_dez_sl_551_CM 1 100. 0. 255. DISPLAY_IDENTIFIER R5CYCTIM ECU_ADDRESS 0xc0000a54 FORMAT "%3.0" /end MEASUREMENT
/begin MEASUREMENT Snibs "Seriennummer" ULONG _CNV_R_R_Def_dez_sl_551_CM 1 100. 0. 4294967295. DISPLAY_IDENTIFIER SNIBS ECU_ADDRESS 0xc0000a44 FORMAT "%7.0" /end MEASUREMENT
/begin MEASUREMENT St_atlreg_intern "Statuswort f. ATL-Regler" UBYTE _CNV_R_R_Def_dez_sl_551_CM 1 100. 0. 255. DISPLAY_IDENTIFIER ST_ATLREG_INTERN ECU_ADDRESS 0xd000ca62 FORMAT "%3.0" /end MEASUREMENT
/begin MEASUREMENT St_atlreg_intern.B_atl_20ms "Bankselektives Berechnung im 20ms Raster" UBYTE _CNV_S_2_Def_bit_ub_563_CM 1 100. 0. 1. DISPLAY_IDENTIFIER B_ATL_20MS ECU_ADDRESS 0xd000ca62 BIT_MASK 0x2 /end MEASUREMENT
/begin MEASUREMENT St_atlreg_intern.B_atlvst_f "Vorsteuerungs Verhalten gedämpft" UBYTE _CNV_S_2_Def_bit_ub_563_CM 1 100. 0. 1. DISPLAY_IDENTIFIER B_ATLVST_F ECU_ADDRESS 0xd000ca62 BIT_MASK 0x1 /end MEASUREMENT
/begin MEASUREMENT St_atlstat "Statuswort" UBYTE _CNV_R_R_Def_dez_sl_551_CM 1 100. 0. 255. DISPLAY_IDENTIFIER ST_ATLSTAT ECU_ADDRESS 0xd000cb08 FORMAT "%3.0" /end MEASUREMENT
/begin MEASUREMENT St_atlstat.B_atl_bereit "Ladedrucksystem bereit zur Aufladung" UBYTE _CNV_S_2_Def_bit_ub_563_CM 1 100. 0. 1. DISPLAY_IDENTIFIER B_ATL_BEREIT ECU_ADDRESS 0xd000cb08 BIT_MASK 0x2 /end MEASUREMENT
/begin MEASUREMENT St_atlstat.B_atldyn "Überspuelphase gültig" UBYTE _CNV_S_2_Def_bit_ub_563_CM 1 100. 0. 1. DISPLAY_IDENTIFIER B_ATLDYN ECU_ADDRESS 0xd000cb08 BIT_MASK 0x20 /end MEASUREMENT
/begin MEASUREMENT St_atlstat.B_atlr "Regler Wastegate aktiv" UBYTE _CNV_S_2_Def_bit_ub_563_CM 1 100. 0. 1. DISPLAY_IDENTIFIER B_ATLR ECU_ADDRESS 0xd000cb08 BIT_MASK 0x1 /end MEASUREMENT
/begin MEASUREMENT St_atlstat.B_tvld_mod "Modellwert Tvld verfügbar" UBYTE _CNV_S_2_Def_bit_ub_563_CM 1 100. 0. 1. DISPLAY_IDENTIFIER B_TVLD_MOD ECU_ADDRESS 0xd000cb08 BIT_MASK 0x10 /end MEASUREMENT
/begin MEASUREMENT St_atlstat.B_ulvdyn "Umluftventil aktiv f. schnellen Ladedruckabbau" UBYTE _CNV_S_2_Def_bit_ub_563_CM 1 100. 0. 1. DISPLAY_IDENTIFIER B_ULVDYN ECU_ADDRESS 0xd000cb08 BIT_MASK 0x4 /end MEASUREMENT
/begin MEASUREMENT St_atlstat.B_vlschalt "Volllast-Schaltung erkannt" UBYTE _CNV_S_2_Def_bit_ub_563_CM 1 100. 0. 1. DISPLAY_IDENTIFIER B_VLSCHALT ECU_ADDRESS 0xd000cb08 BIT_MASK 0x8 /end MEASUREMENT
/begin MEASUREMENT St_atlstat_intern "Statuswort" UBYTE _CNV_R_R_Def_dez_sl_551_CM 1 100. 0. 255. DISPLAY_IDENTIFIER ST_ATLSTAT_INTERN ECU_ADDRESS 0xd000cb09 FORMAT "%3.0" /end MEASUREMENT
/begin MEASUREMENT St_atlstat_intern.B_atldyn_akt "Bedingung Überspülen aktiviert" UBYTE _CNV_S_2_Def_bit_ub_563_CM 1 100. 0. 1. DISPLAY_IDENTIFIER B_ATLDYN_AKT ECU_ADDRESS 0xd000cb09 BIT_MASK 0x4 /end MEASUREMENT
/begin MEASUREMENT St_atlstat_intern.B_init_tmod "Initialisierung modellierte lastabhängige Temperatur - aktiv" UBYTE _CNV_S_2_Def_bit_ub_563_CM 1 100. 0. 1. DISPLAY_IDENTIFIER B_INIT_TMOD ECU_ADDRESS 0xd000cb09 BIT_MASK 0x1 /end MEASUREMENT
/begin MEASUREMENT St_atlstat_intern.B_ldr_dyn "Laderdynamik erkannt" UBYTE _CNV_S_2_Def_bit_ub_563_CM 1 100. 0. 1. DISPLAY_IDENTIFIER B_LDR_DYN ECU_ADDRESS 0xd000cb09 BIT_MASK 0x2 /end MEASUREMENT
/begin MEASUREMENT St_bgllgen0 "Statuswort" UBYTE _CNV_R_R_Def_dez_sl_551_CM 1 100. 0. 255. DISPLAY_IDENTIFIER ST_BGLLGEN0 ECU_ADDRESS 0xd000d83c FORMAT "%3.0" /end MEASUREMENT
/begin MEASUREMENT St_bgllgen0.B_hysllrah "Hysterese LL Anhebung" UBYTE _CNV_S_2_Def_bit_ub_563_CM 1 100. 0. 1. DISPLAY_IDENTIFIER B_HYSLLRAH ECU_ADDRESS 0xd000d83c BIT_MASK 0x1 /end MEASUREMENT
/begin MEASUREMENT St_co2mng "Statuswort" UBYTE _CNV_R_R_Def_dez_sl_551_CM 1 100. 0. 255. DISPLAY_IDENTIFIER ST_CO2MNG ECU_ADDRESS 0xc0000ba0 FORMAT "%3.0" /end MEASUREMENT
/begin MEASUREMENT St_co2mng.B_co2_igroff "IGR verhindert" UBYTE _CNV_S_2_Def_bit_ub_563_CM 1 100. 0. 1. DISPLAY_IDENTIFIER B_CO2_IGROFF ECU_ADDRESS 0xc0000ba0 BIT_MASK 0x80 /end MEASUREMENT
/begin MEASUREMENT St_co2mng.B_co2_msaoff "MSA verhindert" UBYTE _CNV_S_2_Def_bit_ub_563_CM 1 100. 0. 1. DISPLAY_IDENTIFIER B_CO2_MSAOFF ECU_ADDRESS 0xc0000ba0 BIT_MASK 0x40 /end MEASUREMENT
/begin MEASUREMENT St_co2mng.B_igrhigh "IGR-High angefordert" UBYTE _CNV_S_2_Def_bit_ub_563_CM 1 100. 0. 1. DISPLAY_IDENTIFIER B_IGRHIGH ECU_ADDRESS 0xc0000ba0 BIT_MASK 0x1 /end MEASUREMENT
/begin MEASUREMENT St_co2mng.B_igrmed "IGR-Medium angefordert" UBYTE _CNV_S_2_Def_bit_ub_563_CM 1 100. 0. 1. DISPLAY_IDENTIFIER B_IGRMED ECU_ADDRESS 0xc0000ba0 BIT_MASK 0x2 /end MEASUREMENT
/begin MEASUREMENT St_co2mng.B_zykl_igrh "Zyklisierungsgrenze iGR-High erreicht" UBYTE _CNV_S_2_Def_bit_ub_563_CM 1 100. 0. 1. DISPLAY_IDENTIFIER B_ZYKL_IGRH ECU_ADDRESS 0xc0000ba0 BIT_MASK 0x20 /end MEASUREMENT
/begin MEASUREMENT St_co2mng.B_zykl_igrm "Zyklisierungsgrenze iGR-Med erreicht" UBYTE _CNV_S_2_Def_bit_ub_563_CM 1 100. 0. 1. DISPLAY_IDENTIFIER B_ZYKL_IGRM ECU_ADDRESS 0xc0000ba0 BIT_MASK 0x10 /end MEASUREMENT
/begin MEASUREMENT St_co2mng.B_zykl_msaoff "Zyklisierungsgrenze MSA erreicht" UBYTE _CNV_S_2_Def_bit_ub_563_CM 1 100. 0. 1. DISPLAY_IDENTIFIER B_ZYKL_MSAOFF ECU_ADDRESS 0xc0000ba0 BIT_MASK 0x8 /end MEASUREMENT
/begin MEASUREMENT St_co2mng_1 "Statuswort" UBYTE _CNV_R_R_Def_dez_sl_551_CM 1 100. 0. 255. DISPLAY_IDENTIFIER ST_CO2MNG_1 ECU_ADDRESS 0xc0000ba1 FORMAT "%3.0" /end MEASUREMENT
/begin MEASUREMENT St_co2mng_1.B_co2_av "Abschaltverhinderer MSA" UBYTE _CNV_S_2_Def_bit_ub_563_CM 1 100. 0. 1. DISPLAY_IDENTIFIER B_CO2_AV ECU_ADDRESS 0xc0000ba1 BIT_MASK 0x1 /end MEASUREMENT
/begin MEASUREMENT St_co2mng_1.B_co2_ea "Einschaltaufforderer MSA" UBYTE _CNV_S_2_Def_bit_ub_563_CM 1 100. 0. 1. DISPLAY_IDENTIFIER B_CO2_EA ECU_ADDRESS 0xc0000ba1 BIT_MASK 0x2 /end MEASUREMENT
/begin MEASUREMENT St_co2mng_1.B_co2_eacc "CC-Meldung Einschaltaufforderer MSA" UBYTE _CNV_S_2_Def_bit_ub_563_CM 1 100. 0. 1. DISPLAY_IDENTIFIER B_CO2_EACC ECU_ADDRESS 0xc0000ba1 BIT_MASK 0x4 /end MEASUREMENT
/begin MEASUREMENT St_co2mng_1.B_igr_dsoc "iGR-Mindest-DSOC erreicht" UBYTE _CNV_S_2_Def_bit_ub_563_CM 1 100. 0. 1. DISPLAY_IDENTIFIER B_IGR_DSOC ECU_ADDRESS 0xc0000ba1 BIT_MASK 0x8 /end MEASUREMENT
/begin MEASUREMENT St_co2mng_1.B_igrhigh_en "IGR-High möglich" UBYTE _CNV_S_2_Def_bit_ub_563_CM 1 100. 0. 1. DISPLAY_IDENTIFIER B_IGRHIGH_EN ECU_ADDRESS 0xc0000ba1 BIT_MASK 0x10 /end MEASUREMENT
/begin MEASUREMENT St_co2mng_1.B_igrmed_en "IGR-Medium möglich" UBYTE _CNV_S_2_Def_bit_ub_563_CM 1 100. 0. 1. DISPLAY_IDENTIFIER B_IGRMED_EN ECU_ADDRESS 0xc0000ba1 BIT_MASK 0x20 /end MEASUREMENT
/begin MEASUREMENT St_dibs0 "Statuswort" UBYTE _CNV_R_R_Def_dez_sl_551_CM 1 100. 0. 255. DISPLAY_IDENTIFIER ST_DIBS0 ECU_ADDRESS 0xc00045f0 FORMAT "%3.0" /end MEASUREMENT
/begin MEASUREMENT St_dibs0.B_dibloc1 "Signal nv lave loc zur Flankenerkennung" UBYTE _CNV_S_2_Def_bit_ub_563_CM 1 100. 0. 1. DISPLAY_IDENTIFIER B_DIBLOC1 ECU_ADDRESS 0xc00045f0 BIT_MASK 0x1 /end MEASUREMENT
/begin MEASUREMENT St_dibs0.B_dibloc2 "Signal nv lave loc zur Flankenerkennung" UBYTE _CNV_S_2_Def_bit_ub_563_CM 1 100. 0. 1. DISPLAY_IDENTIFIER B_DIBLOC2 ECU_ADDRESS 0xc00045f0 BIT_MASK 0x2 /end MEASUREMENT
/begin MEASUREMENT St_dibs1 "Statuswort" UBYTE _CNV_R_R_Def_dez_sl_551_CM 1 100. 0. 255. DISPLAY_IDENTIFIER ST_DIBS1 ECU_ADDRESS 0xd000d848 FORMAT "%3.0" /end MEASUREMENT
/begin MEASUREMENT St_dibs1.B_ifbsak "BSD Kommunikation zum IBS gestoert" UBYTE _CNV_S_2_Def_bit_ub_563_CM 1 100. 0. 1. DISPLAY_IDENTIFIER B_IFBSAK ECU_ADDRESS 0xd000d848 BIT_MASK 0x4 /end MEASUREMENT
/begin MEASUREMENT St_dibs1.B_ifebsak "Fehler erweiterte BSD Kommunikation zum IBS" UBYTE _CNV_S_2_Def_bit_ub_563_CM 1 100. 0. 1. DISPLAY_IDENTIFIER B_IFEBSAK ECU_ADDRESS 0xd000d848 BIT_MASK 0x8 /end MEASUREMENT
/begin MEASUREMENT St_dibs1.B_ifuplak "Fehler IBS Version unplausibel" UBYTE _CNV_S_2_Def_bit_ub_563_CM 1 100. 0. 1. DISPLAY_IDENTIFIER B_IFUPLAK ECU_ADDRESS 0xd000d848 BIT_MASK 0x10 /end MEASUREMENT
/begin MEASUREMENT St_dibs2 "Statuswort" UBYTE _CNV_R_R_Def_dez_sl_551_CM 1 100. 0. 255. DISPLAY_IDENTIFIER ST_DIBS2 ECU_ADDRESS 0xd000d849 FORMAT "%3.0" /end MEASUREMENT
/begin MEASUREMENT St_dibs2.B_ifisak "IBS Stromfehler" UBYTE _CNV_S_2_Def_bit_ub_563_CM 1 100. 0. 1. DISPLAY_IDENTIFIER B_IFISAK ECU_ADDRESS 0xd000d849 BIT_MASK 0x1 /end MEASUREMENT
/begin MEASUREMENT St_dibs2.B_ifsysak "Statuswort" UBYTE _CNV_S_2_Def_bit_ub_563_CM 1 100. 0. 1. DISPLAY_IDENTIFIER B_IFSYSAK ECU_ADDRESS 0xd000d849 BIT_MASK 0x20 /end MEASUREMENT
/begin MEASUREMENT St_dibs2.B_iftempak "IBS Temperaturfehler" UBYTE _CNV_S_2_Def_bit_ub_563_CM 1 100. 0. 1. DISPLAY_IDENTIFIER B_IFTEMPAK ECU_ADDRESS 0xd000d849 BIT_MASK 0x4 /end MEASUREMENT
/begin MEASUREMENT St_dibs2.B_ifusak "IBS Spannungsfehler" UBYTE _CNV_S_2_Def_bit_ub_563_CM 1 100. 0. 1. DISPLAY_IDENTIFIER B_IFUSAK ECU_ADDRESS 0xd000d849 BIT_MASK 0x2 /end MEASUREMENT
/begin MEASUREMENT St_dibs2.B_ifwugdak "IBS KL15 Masseschluss" UBYTE _CNV_S_2_Def_bit_ub_563_CM 1 100. 0. 1. DISPLAY_IDENTIFIER B_IFWUGDAK ECU_ADDRESS 0xd000d849 BIT_MASK 0x8 /end MEASUREMENT
/begin MEASUREMENT St_dibs2.B_ifwuplak "Statuswort" UBYTE _CNV_S_2_Def_bit_ub_563_CM 1 100. 0. 1. DISPLAY_IDENTIFIER B_IFWUPLAK ECU_ADDRESS 0xd000d849 BIT_MASK 0x10 /end MEASUREMENT
/begin MEASUREMENT St_ecostat2 "Ecos Statusbyte 2" UBYTE _CNV_R_R_Def_dez_sl_551_CM 1 100. 0. 255. DISPLAY_IDENTIFIER ST_ECOSTAT2 ECU_ADDRESS 0xc00045fc FORMAT "%3.0" /end MEASUREMENT
/begin MEASUREMENT St_ecostat2.B_ecobusy "Ecos Ruhestrommessung busy" UBYTE _CNV_S_2_Def_bit_ub_563_CM 1 100. 0. 1. DISPLAY_IDENTIFIER B_ECOBUSY ECU_ADDRESS 0xc00045fc BIT_MASK 0x1 /end MEASUREMENT
/begin MEASUREMENT St_elmot1 "Statuswort" UBYTE _CNV_R_R_Def_dez_sl_551_CM 1 100. 0. 255. DISPLAY_IDENTIFIER ST_ELMOT1 ECU_ADDRESS 0xc0000db0 FORMAT "%3.0" /end MEASUREMENT
/begin MEASUREMENT St_elmot1.B_hp1_ntod "Statuswort" UBYTE _CNV_S_2_Def_bit_ub_563_CM 1 100. 0. 1. DISPLAY_IDENTIFIER B_HP1_NTOD ECU_ADDRESS 0xc0000db0 BIT_MASK 0x40 /end MEASUREMENT
/begin MEASUREMENT St_elmot1.B_hp1_vtod "Statuswort" UBYTE _CNV_S_2_Def_bit_ub_563_CM 1 100. 0. 1. DISPLAY_IDENTIFIER B_HP1_VTOD ECU_ADDRESS 0xc0000db0 BIT_MASK 0x20 /end MEASUREMENT
/begin MEASUREMENT St_elmot1.B_np0_nkw "Statuswort" UBYTE _CNV_S_2_Def_bit_ub_563_CM 1 100. 0. 1. DISPLAY_IDENTIFIER B_NP0_NKW ECU_ADDRESS 0xc0000db0 BIT_MASK 0x8 /end MEASUREMENT
/begin MEASUREMENT St_elmot1.B_np0_rf "Statuswort" UBYTE _CNV_S_2_Def_bit_ub_563_CM 1 100. 0. 1. DISPLAY_IDENTIFIER B_NP0_RF ECU_ADDRESS 0xc0000db0 BIT_MASK 0x1 /end MEASUREMENT
/begin MEASUREMENT St_elmot1.B_np0_v "Statuswort" UBYTE _CNV_S_2_Def_bit_ub_563_CM 1 100. 0. 1. DISPLAY_IDENTIFIER B_NP0_V ECU_ADDRESS 0xc0000db0 BIT_MASK 0x2 /end MEASUREMENT
/begin MEASUREMENT St_elmot1.B_up_absafs "Statuswort" UBYTE _CNV_S_2_Def_bit_ub_563_CM 1 100. 0. 1. DISPLAY_IDENTIFIER B_UP_ABSAFS ECU_ADDRESS 0xc0000db0 BIT_MASK 0x80 /end MEASUREMENT
/begin MEASUREMENT St_elmot2 "Statuswort" UBYTE _CNV_R_R_Def_dez_sl_551_CM 1 100. 0. 255. DISPLAY_IDENTIFIER ST_ELMOT2 ECU_ADDRESS 0xc0000db1 FORMAT "%3.0" /end MEASUREMENT
/begin MEASUREMENT St_elmot2.B_hp2_ntod "Statuswort" UBYTE _CNV_S_2_Def_bit_ub_563_CM 1 100. 0. 1. DISPLAY_IDENTIFIER B_HP2_NTOD ECU_ADDRESS 0xc0000db1 BIT_MASK 0x2 /end MEASUREMENT
/begin MEASUREMENT St_elmot2.B_hp2_vtod "Statuswort" UBYTE _CNV_S_2_Def_bit_ub_563_CM 1 100. 0. 1. DISPLAY_IDENTIFIER B_HP2_VTOD ECU_ADDRESS 0xc0000db1 BIT_MASK 0x1 /end MEASUREMENT
/begin MEASUREMENT St_elmot2.B_nzgofsum "Statuswort" UBYTE _CNV_S_2_Def_bit_ub_563_CM 1 100. 0. 1. DISPLAY_IDENTIFIER B_NZGOFSUM ECU_ADDRESS 0xc0000db1 BIT_MASK 0x20 /end MEASUREMENT
/begin MEASUREMENT St_elmot2.B_up_gangi0 "Statuswort" UBYTE _CNV_S_2_Def_bit_ub_563_CM 1 100. 0. 1. DISPLAY_IDENTIFIER B_UP_GANGI0 ECU_ADDRESS 0xc0000db1 BIT_MASK 0x80 /end MEASUREMENT
/begin MEASUREMENT St_elmot2.B_up_rf4 "Statuswort" UBYTE _CNV_S_2_Def_bit_ub_563_CM 1 100. 0. 1. DISPLAY_IDENTIFIER B_UP_RF4 ECU_ADDRESS 0xc0000db1 BIT_MASK 0x10 /end MEASUREMENT
/begin MEASUREMENT St_elmot2.B_up_rfntod "Statuswort" UBYTE _CNV_S_2_Def_bit_ub_563_CM 1 100. 0. 1. DISPLAY_IDENTIFIER B_UP_RFNTOD ECU_ADDRESS 0xc0000db1 BIT_MASK 0x8 /end MEASUREMENT
/begin MEASUREMENT St_elmot2.B_up_rfvtod "Statuswort" UBYTE _CNV_S_2_Def_bit_ub_563_CM 1 100. 0. 1. DISPLAY_IDENTIFIER B_UP_RFVTOD ECU_ADDRESS 0xc0000db1 BIT_MASK 0x4 /end MEASUREMENT
/begin MEASUREMENT St_elmotentl "Statuswort" UBYTE _CNV_R_R_Def_dez_sl_551_CM 1 100. 0. 255. DISPLAY_IDENTIFIER ST_ELMOTENTL ECU_ADDRESS 0xc0000db2 FORMAT "%3.0" /end MEASUREMENT
/begin MEASUREMENT St_elmotentl.B_nzgof1 "Statuswort" UBYTE _CNV_S_2_Def_bit_ub_563_CM 1 100. 0. 1. DISPLAY_IDENTIFIER B_NZGOF1 ECU_ADDRESS 0xc0000db2 BIT_MASK 0x20 /end MEASUREMENT
/begin MEASUREMENT St_elmotentl.B_nzgof2 "Statuswort" UBYTE _CNV_S_2_Def_bit_ub_563_CM 1 100. 0. 1. DISPLAY_IDENTIFIER B_NZGOF2 ECU_ADDRESS 0xc0000db2 BIT_MASK 0x40 /end MEASUREMENT
/begin MEASUREMENT St_elmotentl.B_nzgof3 "Statuswort" UBYTE _CNV_S_2_Def_bit_ub_563_CM 1 100. 0. 1. DISPLAY_IDENTIFIER B_NZGOF3 ECU_ADDRESS 0xc0000db2 BIT_MASK 0x80 /end MEASUREMENT
/begin MEASUREMENT St_elmotentl.B_prio "Statuswort" UBYTE _CNV_S_2_Def_bit_ub_563_CM 1 100. 0. 1. DISPLAY_IDENTIFIER B_PRIO ECU_ADDRESS 0xc0000db2 BIT_MASK 0x8 /end MEASUREMENT
/begin MEASUREMENT St_elmotentl.B_priovdelay "Statuswort" UBYTE _CNV_S_2_Def_bit_ub_563_CM 1 100. 0. 1. DISPLAY_IDENTIFIER B_PRIOVDELAY ECU_ADDRESS 0xc0000db2 BIT_MASK 0x10 /end MEASUREMENT
/begin MEASUREMENT St_elmottime "Statuswort" UBYTE _CNV_R_R_Def_dez_sl_551_CM 1 100. 0. 255. DISPLAY_IDENTIFIER ST_ELMOTTIME ECU_ADDRESS 0xc0000db3 FORMAT "%3.0" /end MEASUREMENT
/begin MEASUREMENT St_elmottime.B_inold_1 "Statuswort" UBYTE _CNV_S_2_Def_bit_ub_563_CM 1 100. 0. 1. DISPLAY_IDENTIFIER B_INOLD_1 ECU_ADDRESS 0xc0000db3 BIT_MASK 0x2 /end MEASUREMENT
/begin MEASUREMENT St_elmottime.B_inold_2 "Statuswort" UBYTE _CNV_S_2_Def_bit_ub_563_CM 1 100. 0. 1. DISPLAY_IDENTIFIER B_INOLD_2 ECU_ADDRESS 0xc0000db3 BIT_MASK 0x4 /end MEASUREMENT
/begin MEASUREMENT St_elmottime.B_inold_3 "Statuswort" UBYTE _CNV_S_2_Def_bit_ub_563_CM 1 100. 0. 1. DISPLAY_IDENTIFIER B_INOLD_3 ECU_ADDRESS 0xc0000db3 BIT_MASK 0x8 /end MEASUREMENT
/begin MEASUREMENT St_elmottime.B_inold_4 "Statuswort" UBYTE _CNV_S_2_Def_bit_ub_563_CM 1 100. 0. 1. DISPLAY_IDENTIFIER B_INOLD_4 ECU_ADDRESS 0xc0000db3 BIT_MASK 0x10 /end MEASUREMENT
/begin MEASUREMENT St_elmottime.B_inold_5 "Statuswort" UBYTE _CNV_S_2_Def_bit_ub_563_CM 1 100. 0. 1. DISPLAY_IDENTIFIER B_INOLD_5 ECU_ADDRESS 0xc0000db3 BIT_MASK 0x20 /end MEASUREMENT
/begin MEASUREMENT St_elmottime.B_inold_6 "Statuswort" UBYTE _CNV_S_2_Def_bit_ub_563_CM 1 100. 0. 1. DISPLAY_IDENTIFIER B_INOLD_6 ECU_ADDRESS 0xc0000db3 BIT_MASK 0x40 /end MEASUREMENT
/begin MEASUREMENT St_elnotafu "Statuswort" UBYTE _CNV_R_R_Def_dez_sl_551_CM 1 100. 0. 255. DISPLAY_IDENTIFIER ST_ELNOTAFU ECU_ADDRESS 0xd000d9a4 FORMAT "%3.0" /end MEASUREMENT
/begin MEASUREMENT St_elnotafu.B_notafu2 "Statuswort" UBYTE _CNV_S_2_Def_bit_ub_563_CM 1 100. 0. 1. DISPLAY_IDENTIFIER B_NOTAFU2 ECU_ADDRESS 0xd000d9a4 BIT_MASK 0x1 /end MEASUREMENT
/begin MEASUREMENT St_entlast_loc "" UBYTE _CNV_R_R_Def_dez_sl_551_CM 1 100. 0. 255. DISPLAY_IDENTIFIER ST_ENTLAST_LOC ECU_ADDRESS 0xc0000db7 FORMAT "%3.0" /end MEASUREMENT
/begin MEASUREMENT St_ibebsd1 "Statuswort ibebsd1" UBYTE _CNV_R_R_Def_dez_sl_551_CM 1 100. 0. 255. DISPLAY_IDENTIFIER ST_IBEBSD1 ECU_ADDRESS 0xc0000963 FORMAT "%3.0" /end MEASUREMENT
/begin MEASUREMENT St_ibebsd1.B_eb_busy "Bedingung EBSD Übertragungsrichtung schreiben" UBYTE _CNV_S_2_Def_bit_ub_563_CM 1 100. 0. 1. DISPLAY_IDENTIFIER B_EB_BUSY ECU_ADDRESS 0xc0000963 BIT_MASK 0x8 /end MEASUREMENT
/begin MEASUREMENT St_ibebsd1.B_eb_errdir "Bedingung EBSD Übertragungsrichtung schreiben" UBYTE _CNV_S_2_Def_bit_ub_563_CM 1 100. 0. 1. DISPLAY_IDENTIFIER B_EB_ERRDIR ECU_ADDRESS 0xc0000963 BIT_MASK 0x10 /end MEASUREMENT
/begin MEASUREMENT St_ibebsd1.B_eb_txok "Bedingung EBSD Übertragungsrichtung schreiben" UBYTE _CNV_S_2_Def_bit_ub_563_CM 1 100. 0. 1. DISPLAY_IDENTIFIER B_EB_TXOK ECU_ADDRESS 0xc0000963 BIT_MASK 0x4 /end MEASUREMENT
/begin MEASUREMENT St_ibebsd1.B_ibs_msgrdy "Bedingung EBSD Botschaft von IBS empfangen" UBYTE _CNV_S_2_Def_bit_ub_563_CM 1 100. 0. 1. DISPLAY_IDENTIFIER B_IBS_MSGRDY ECU_ADDRESS 0xc0000963 BIT_MASK 0x1 /end MEASUREMENT
/begin MEASUREMENT St_ibebsd1.B_ibs_msgwri "Bedingung EBSD Übertragungsrichtung schreiben" UBYTE _CNV_S_2_Def_bit_ub_563_CM 1 100. 0. 1. DISPLAY_IDENTIFIER B_IBS_MSGWRI ECU_ADDRESS 0xc0000963 BIT_MASK 0x2 /end MEASUREMENT
/begin MEASUREMENT St_ibmix "Statuswort ibmix" UBYTE _CNV_R_R_Def_dez_sl_551_CM 1 100. 0. 255. DISPLAY_IDENTIFIER ST_IBMIX ECU_ADDRESS 0xc0000965 FORMAT "%3.0" /end MEASUREMENT
/begin MEASUREMENT St_ibmix.B_ibrhilo "toggle Bit Register0/ 1 hi- od. lo byte" UBYTE _CNV_S_2_Def_bit_ub_563_CM 1 100. 0. 1. DISPLAY_IDENTIFIER B_IBRHILO ECU_ADDRESS 0xc0000965 BIT_MASK 0x1 /end MEASUREMENT
/begin MEASUREMENT St_ibmix.B_ibttog "global toggle bit" UBYTE _CNV_S_2_Def_bit_ub_563_CM 1 100. 0. 1. DISPLAY_IDENTIFIER B_IBTTOG ECU_ADDRESS 0xc0000965 BIT_MASK 0x2 /end MEASUREMENT
/begin MEASUREMENT St_ibserr "Statuswort ibserr" UBYTE _CNV_R_R_Def_dez_sl_551_CM 1 100. 0. 255. DISPLAY_IDENTIFIER ST_IBSERR ECU_ADDRESS 0xc0000964 FORMAT "%3.0" /end MEASUREMENT
/begin MEASUREMENT St_ibserr.B_ibfbsd "Bedingung BSD Fehler" UBYTE _CNV_S_2_Def_bit_ub_563_CM 1 100. 0. 1. DISPLAY_IDENTIFIER B_IBFBSD ECU_ADDRESS 0xc0000964 BIT_MASK 0x1 /end MEASUREMENT
/begin MEASUREMENT St_ibserr.B_ibfebsd "Bedingung EBSD Fehler" UBYTE _CNV_S_2_Def_bit_ub_563_CM 1 100. 0. 1. DISPLAY_IDENTIFIER B_IBFEBSD ECU_ADDRESS 0xc0000964 BIT_MASK 0x2 /end MEASUREMENT
/begin MEASUREMENT St_ibserr.B_ibunplau "Bedingung IBS Version unplausibel" UBYTE _CNV_S_2_Def_bit_ub_563_CM 1 100. 0. 1. DISPLAY_IDENTIFIER B_IBUNPLAU ECU_ADDRESS 0xc0000964 BIT_MASK 0x4 /end MEASUREMENT
/begin MEASUREMENT St_ibsreg4 "Statuswort ibsreg4" UBYTE _CNV_R_R_Def_dez_sl_551_CM 1 100. 0. 255. DISPLAY_IDENTIFIER ST_IBSREG4 ECU_ADDRESS 0xc0000959 FORMAT "%3.0" /end MEASUREMENT
/begin MEASUREMENT St_ibsreg4.B_ibspwf "Bedingung IBS powerfail erkannt" UBYTE _CNV_S_2_Def_bit_ub_563_CM 1 100. 0. 1. DISPLAY_IDENTIFIER B_IBSPWF ECU_ADDRESS 0xc0000959 BIT_MASK 0x10 /end MEASUREMENT
/begin MEASUREMENT St_ibsreg4.B_startfgk "Bedingung Startfähigkeit gefährdet" UBYTE _CNV_S_2_Def_bit_ub_563_CM 1 100. 0. 1. DISPLAY_IDENTIFIER B_STARTFGK ECU_ADDRESS 0xc0000959 BIT_MASK 0x1 /end MEASUREMENT
/begin MEASUREMENT St_ibsreg4.B_strtaw "Bedingung Startauswertung gerechnet" UBYTE _CNV_S_2_Def_bit_ub_563_CM 1 100. 0. 1. DISPLAY_IDENTIFIER B_STRTAW ECU_ADDRESS 0xc0000959 BIT_MASK 0x2 /end MEASUREMENT
/begin MEASUREMENT St_ibsreg4.B_tiefset "Bedingung Tiefentladung" UBYTE _CNV_S_2_Def_bit_ub_563_CM 1 100. 0. 1. DISPLAY_IDENTIFIER B_TIEFSET ECU_ADDRESS 0xc0000959 BIT_MASK 0x20 /end MEASUREMENT
/begin MEASUREMENT St_ibsreg5 "Statuswort ibsreg5" UBYTE _CNV_R_R_Def_dez_sl_551_CM 1 100. 0. 255. DISPLAY_IDENTIFIER ST_IBSREG5 ECU_ADDRESS 0xc000095a FORMAT "%3.0" /end MEASUREMENT
/begin MEASUREMENT St_ibsreg5.B_fsclr "Bedingung IBS interne Fehler loeschen" UBYTE _CNV_S_2_Def_bit_ub_563_CM 1 100. 0. 1. DISPLAY_IDENTIFIER B_FSCLR ECU_ADDRESS 0xc000095a BIT_MASK 0x8 /end MEASUREMENT
/begin MEASUREMENT St_igr1 "Statuswort" UBYTE _CNV_R_R_Def_dez_sl_551_CM 1 100. 0. 255. DISPLAY_IDENTIFIER ST_IGR1 ECU_ADDRESS 0xc0000bdc FORMAT "%3.0" /end MEASUREMENT
/begin MEASUREMENT St_igr1.B_igrlow "Bedingung iGR LOW" UBYTE _CNV_S_2_Def_bit_ub_563_CM 1 100. 0. 1. DISPLAY_IDENTIFIER B_IGRLOW ECU_ADDRESS 0xc0000bdc BIT_MASK 0x1 /end MEASUREMENT
/begin MEASUREMENT St_igr1.B_regelakt "Bedingung Batteriestromregelung aktiv" UBYTE _CNV_S_2_Def_bit_ub_563_CM 1 100. 0. 1. DISPLAY_IDENTIFIER B_REGELAKT ECU_ADDRESS 0xc0000bdc BIT_MASK 0x2 /end MEASUREMENT
/begin MEASUREMENT St_igr_a0old "Altes Statusbyte [0]" UBYTE _CNV_R_R_Def_dez_sl_551_CM 1 100. 0. 255. DISPLAY_IDENTIFIER ST_IGR_A0OLD ECU_ADDRESS 0xc0007a74 FORMAT "%3.0" /end MEASUREMENT
/begin MEASUREMENT St_igrdiag1 "Statuswort" UBYTE _CNV_R_R_Def_dez_sl_551_CM 1 100. 0. 255. DISPLAY_IDENTIFIER ST_IGRDIAG1 ECU_ADDRESS 0xc0007a6c FORMAT "%3.0" /end MEASUREMENT
/begin MEASUREMENT St_igrdiag1.B_igr_tbatt "Bedingung Batterietemperatur erfuellt" UBYTE _CNV_S_2_Def_bit_ub_563_CM 1 100. 0. 1. DISPLAY_IDENTIFIER B_IGR_TBATT ECU_ADDRESS 0xc0007a6c BIT_MASK 0x1 /end MEASUREMENT
/begin MEASUREMENT St_igrdiag1.B_igr_tsaison "Bedingung Saisontemperatur erfuellt" UBYTE _CNV_S_2_Def_bit_ub_563_CM 1 100. 0. 1. DISPLAY_IDENTIFIER B_IGR_TSAISON ECU_ADDRESS 0xc0007a6c BIT_MASK 0x2 /end MEASUREMENT
/begin MEASUREMENT St_igrdiag1.B_igrdiag_off1 "Ende Diagnose" UBYTE _CNV_S_2_Def_bit_ub_563_CM 1 100. 0. 1. DISPLAY_IDENTIFIER B_IGRDIAG_OFF1 ECU_ADDRESS 0xc0007a6c BIT_MASK 0x8 /end MEASUREMENT
/begin MEASUREMENT St_igrdiag1.B_igrdiag_on1 "Start Diagnose" UBYTE _CNV_S_2_Def_bit_ub_563_CM 1 100. 0. 1. DISPLAY_IDENTIFIER B_IGRDIAG_ON1 ECU_ADDRESS 0xc0007a6c BIT_MASK 0x4 /end MEASUREMENT
/begin MEASUREMENT St_igrdiag_a0 "Statuswort" UBYTE _CNV_R_R_Def_dez_sl_551_CM 1 100. 0. 255. DISPLAY_IDENTIFIER ST_IGRDIAG_A0 ECU_ADDRESS 0xc0007a6d FORMAT "%3.0" /end MEASUREMENT
/begin MEASUREMENT St_igrdiag_a0.B_igra0_0 "Statusbit" UBYTE _CNV_S_2_Def_bit_ub_563_CM 1 100. 0. 1. DISPLAY_IDENTIFIER B_IGRA0_0 ECU_ADDRESS 0xc0007a6d BIT_MASK 0x1 /end MEASUREMENT
/begin MEASUREMENT St_igrdiag_a0.B_igra0_1 "Statusbit" UBYTE _CNV_S_2_Def_bit_ub_563_CM 1 100. 0. 1. DISPLAY_IDENTIFIER B_IGRA0_1 ECU_ADDRESS 0xc0007a6d BIT_MASK 0x2 /end MEASUREMENT
/begin MEASUREMENT St_igrdiag_a0.B_igra0_2 "Statusbit" UBYTE _CNV_S_2_Def_bit_ub_563_CM 1 100. 0. 1. DISPLAY_IDENTIFIER B_IGRA0_2 ECU_ADDRESS 0xc0007a6d BIT_MASK 0x4 /end MEASUREMENT
/begin MEASUREMENT St_igrdiag_a0.B_igra0_3 "Statusbit" UBYTE _CNV_S_2_Def_bit_ub_563_CM 1 100. 0. 1. DISPLAY_IDENTIFIER B_IGRA0_3 ECU_ADDRESS 0xc0007a6d BIT_MASK 0x8 /end MEASUREMENT
/begin MEASUREMENT St_igrdiag_a0.B_igra0_4 "Statusbit" UBYTE _CNV_S_2_Def_bit_ub_563_CM 1 100. 0. 1. DISPLAY_IDENTIFIER B_IGRA0_4 ECU_ADDRESS 0xc0007a6d BIT_MASK 0x10 /end MEASUREMENT
/begin MEASUREMENT St_igrdiag_a0.B_igra0_5 "Statusbit" UBYTE _CNV_S_2_Def_bit_ub_563_CM 1 100. 0. 1. DISPLAY_IDENTIFIER B_IGRA0_5 ECU_ADDRESS 0xc0007a6d BIT_MASK 0x20 /end MEASUREMENT
/begin MEASUREMENT St_igrdiag_a0.B_igra0_6 "Statusbit" UBYTE _CNV_S_2_Def_bit_ub_563_CM 1 100. 0. 1. DISPLAY_IDENTIFIER B_IGRA0_6 ECU_ADDRESS 0xc0007a6d BIT_MASK 0x40 /end MEASUREMENT
/begin MEASUREMENT St_igrdiag_a0.B_igra0_7 "Statusbit" UBYTE _CNV_S_2_Def_bit_ub_563_CM 1 100. 0. 1. DISPLAY_IDENTIFIER B_IGRA0_7 ECU_ADDRESS 0xc0007a6d BIT_MASK 0x80 /end MEASUREMENT
/begin MEASUREMENT St_igrdiag_b0 "Statuswort" UBYTE _CNV_R_R_Def_dez_sl_551_CM 1 100. 0. 255. DISPLAY_IDENTIFIER ST_IGRDIAG_B0 ECU_ADDRESS 0xc0007a6e FORMAT "%3.0" /end MEASUREMENT
/begin MEASUREMENT St_igrdiag_b0.B_igrb0_0 "Statusbit" UBYTE _CNV_S_2_Def_bit_ub_563_CM 1 100. 0. 1. DISPLAY_IDENTIFIER B_IGRB0_0 ECU_ADDRESS 0xc0007a6e BIT_MASK 0x1 /end MEASUREMENT
/begin MEASUREMENT St_igrdiag_b0.B_igrb0_1 "Statusbit" UBYTE _CNV_S_2_Def_bit_ub_563_CM 1 100. 0. 1. DISPLAY_IDENTIFIER B_IGRB0_1 ECU_ADDRESS 0xc0007a6e BIT_MASK 0x2 /end MEASUREMENT
/begin MEASUREMENT St_igrdiag_b0.B_igrb0_2 "Statusbit" UBYTE _CNV_S_2_Def_bit_ub_563_CM 1 100. 0. 1. DISPLAY_IDENTIFIER B_IGRB0_2 ECU_ADDRESS 0xc0007a6e BIT_MASK 0x4 /end MEASUREMENT
/begin MEASUREMENT St_igrdiag_b0.B_igrb0_3 "Statusbit" UBYTE _CNV_S_2_Def_bit_ub_563_CM 1 100. 0. 1. DISPLAY_IDENTIFIER B_IGRB0_3 ECU_ADDRESS 0xc0007a6e BIT_MASK 0x8 /end MEASUREMENT
/begin MEASUREMENT St_igrdiag_b0.B_igrb0_4 "Statusbit" UBYTE _CNV_S_2_Def_bit_ub_563_CM 1 100. 0. 1. DISPLAY_IDENTIFIER B_IGRB0_4 ECU_ADDRESS 0xc0007a6e BIT_MASK 0x10 /end MEASUREMENT
/begin MEASUREMENT St_igrdiag_b0.B_igrb0_5 "Statusbit" UBYTE _CNV_S_2_Def_bit_ub_563_CM 1 100. 0. 1. DISPLAY_IDENTIFIER B_IGRB0_5 ECU_ADDRESS 0xc0007a6e BIT_MASK 0x20 /end MEASUREMENT
/begin MEASUREMENT St_igrdiag_b0.B_igrb0_6 "Statusbit" UBYTE _CNV_S_2_Def_bit_ub_563_CM 1 100. 0. 1. DISPLAY_IDENTIFIER B_IGRB0_6 ECU_ADDRESS 0xc0007a6e BIT_MASK 0x40 /end MEASUREMENT
/begin MEASUREMENT St_igrdiag_c0 "Statuswort" UBYTE _CNV_R_R_Def_dez_sl_551_CM 1 100. 0. 255. DISPLAY_IDENTIFIER ST_IGRDIAG_C0 ECU_ADDRESS 0xc0007a6f FORMAT "%3.0" /end MEASUREMENT
/begin MEASUREMENT St_igrdiag_c0.B_igrc0_0 "Statusbit" UBYTE _CNV_S_2_Def_bit_ub_563_CM 1 100. 0. 1. DISPLAY_IDENTIFIER B_IGRC0_0 ECU_ADDRESS 0xc0007a6f BIT_MASK 0x1 /end MEASUREMENT
/begin MEASUREMENT St_igrdiag_c0.B_igrc0_1 "Statusbit" UBYTE _CNV_S_2_Def_bit_ub_563_CM 1 100. 0. 1. DISPLAY_IDENTIFIER B_IGRC0_1 ECU_ADDRESS 0xc0007a6f BIT_MASK 0x2 /end MEASUREMENT
/begin MEASUREMENT St_igrdiag_c0.B_igrc0_2 "Statusbit" UBYTE _CNV_S_2_Def_bit_ub_563_CM 1 100. 0. 1. DISPLAY_IDENTIFIER B_IGRC0_2 ECU_ADDRESS 0xc0007a6f BIT_MASK 0x4 /end MEASUREMENT
/begin MEASUREMENT St_igrdiag_c0.B_igrc0_3 "Statusbit" UBYTE _CNV_S_2_Def_bit_ub_563_CM 1 100. 0. 1. DISPLAY_IDENTIFIER B_IGRC0_3 ECU_ADDRESS 0xc0007a6f BIT_MASK 0x8 /end MEASUREMENT
/begin MEASUREMENT St_igrdiag_c0.B_igrc0_4 "Statusbit" UBYTE _CNV_S_2_Def_bit_ub_563_CM 1 100. 0. 1. DISPLAY_IDENTIFIER B_IGRC0_4 ECU_ADDRESS 0xc0007a6f BIT_MASK 0x10 /end MEASUREMENT
/begin MEASUREMENT St_igrdiag_c0.B_igrc0_5 "Statusbit" UBYTE _CNV_S_2_Def_bit_ub_563_CM 1 100. 0. 1. DISPLAY_IDENTIFIER B_IGRC0_5 ECU_ADDRESS 0xc0007a6f BIT_MASK 0x20 /end MEASUREMENT
/begin MEASUREMENT St_igroutnv "Statuswort" UBYTE _CNV_R_R_Def_dez_sl_551_CM 1 100. 0. 255. DISPLAY_IDENTIFIER ST_IGROUTNV ECU_ADDRESS 0xc00046f0 FORMAT "%3.0" /end MEASUREMENT
/begin MEASUREMENT St_igroutnv.B_cdigronr "Codierung iGR" UBYTE _CNV_S_2_Def_bit_ub_563_CM 1 100. 0. 1. DISPLAY_IDENTIFIER B_CDIGRONR ECU_ADDRESS 0xc00046f0 BIT_MASK 0x1 /end MEASUREMENT
/begin MEASUREMENT St_igroutnv.B_cdxenonr "Codierung Xenon" UBYTE _CNV_S_2_Def_bit_ub_563_CM 1 100. 0. 1. DISPLAY_IDENTIFIER B_CDXENONR ECU_ADDRESS 0xc00046f0 BIT_MASK 0x2 /end MEASUREMENT
/begin MEASUREMENT St_igrsbcalc "Statuswort" UBYTE _CNV_R_R_Def_dez_sl_551_CM 1 100. 0. 255. DISPLAY_IDENTIFIER ST_IGRSBCALC ECU_ADDRESS 0xc0000c28 FORMAT "%3.0" /end MEASUREMENT
/begin MEASUREMENT St_igrsbcalc.B_igr_mot "Bedingung Motor für iGR-Low erfuellt" UBYTE _CNV_S_2_Def_bit_ub_563_CM 1 100. 0. 1. DISPLAY_IDENTIFIER B_IGR_MOT ECU_ADDRESS 0xc0000c28 BIT_MASK 0x4 /end MEASUREMENT
/begin MEASUREMENT St_igrsbcalc.B_igrlow_en "Bedingung iGR-Low Applikation freigeschalten" UBYTE _CNV_S_2_Def_bit_ub_563_CM 1 100. 0. 1. DISPLAY_IDENTIFIER B_IGRLOW_EN ECU_ADDRESS 0xc0000c28 BIT_MASK 0x8 /end MEASUREMENT
/begin MEASUREMENT St_igrsbcalc.B_igrlow_on "Bedingung iGR Low codiert und frei" UBYTE _CNV_S_2_Def_bit_ub_563_CM 1 100. 0. 1. DISPLAY_IDENTIFIER B_IGRLOW_ON ECU_ADDRESS 0xc0000c28 BIT_MASK 0x2 /end MEASUREMENT
/begin MEASUREMENT St_igrsbcalc.B_sa_igr "Lokales Schubbit für iGR-Low" UBYTE _CNV_S_2_Def_bit_ub_563_CM 1 100. 0. 1. DISPLAY_IDENTIFIER B_SA_IGR ECU_ADDRESS 0xc0000c28 BIT_MASK 0x1 /end MEASUREMENT
/begin MEASUREMENT St_lemdiag0 "Statuswort" UBYTE _CNV_R_R_Def_dez_sl_551_CM 1 100. 0. 255. DISPLAY_IDENTIFIER ST_LEMDIAG0 ECU_ADDRESS 0xc0000c2c FORMAT "%3.0" /end MEASUREMENT
/begin MEASUREMENT St_lemdiag0.B_lemdiagup "Bedingung Statistik rechnen" UBYTE _CNV_S_2_Def_bit_ub_563_CM 1 100. 0. 1. DISPLAY_IDENTIFIER B_LEMDIAGUP ECU_ADDRESS 0xc0000c2c BIT_MASK 0x1 /end MEASUREMENT
/begin MEASUREMENT St_lemdiag0.B_lemstatset "Bedingung Statistik updaten" UBYTE _CNV_S_2_Def_bit_ub_563_CM 1 100. 0. 1. DISPLAY_IDENTIFIER B_LEMSTATSET ECU_ADDRESS 0xc0000c2c BIT_MASK 0x2 /end MEASUREMENT
/begin MEASUREMENT St_lemdiag1 "Statuswort" UBYTE _CNV_R_R_Def_dez_sl_551_CM 1 100. 0. 255. DISPLAY_IDENTIFIER ST_LEMDIAG1 ECU_ADDRESS 0xc0007a78 FORMAT "%3.0" /end MEASUREMENT
/begin MEASUREMENT St_lemdiag1.B_entlsichvoll "Entlastung aus sicherheitsgründen" UBYTE _CNV_S_2_Def_bit_ub_563_CM 1 100. 0. 1. DISPLAY_IDENTIFIER B_ENTLSICHVOLL ECU_ADDRESS 0xc0007a78 BIT_MASK 0x1 /end MEASUREMENT
/begin MEASUREMENT St_lemdiag1.B_entlsichvollup "Entlastung voll" UBYTE _CNV_S_2_Def_bit_ub_563_CM 1 100. 0. 1. DISPLAY_IDENTIFIER B_ENTLSICHVOLLUP ECU_ADDRESS 0xc0007a78 BIT_MASK 0x10 /end MEASUREMENT
/begin MEASUREMENT St_lemdiag1.B_lemstatset2 "Bedingung Statistik updaten" UBYTE _CNV_S_2_Def_bit_ub_563_CM 1 100. 0. 1. DISPLAY_IDENTIFIER B_LEMSTATSET2 ECU_ADDRESS 0xc0007a78 BIT_MASK 0x20 /end MEASUREMENT
/begin MEASUREMENT St_lemdiag1.B_mdsichegf "Entlastung aus Sicherheitsgründen Zeit Zähler in Infospeicher und rücksetzen" UBYTE _CNV_S_2_Def_bit_ub_563_CM 1 100. 0. 1. DISPLAY_IDENTIFIER B_MDSICHEGF ECU_ADDRESS 0xc0007a78 BIT_MASK 0x8 /end MEASUREMENT
/begin MEASUREMENT St_lemdiag1.B_pr_mdmod "Entlastung aus funktionalen Gründen" UBYTE _CNV_S_2_Def_bit_ub_563_CM 1 100. 0. 1. DISPLAY_IDENTIFIER B_PR_MDMOD ECU_ADDRESS 0xc0007a78 BIT_MASK 0x4 /end MEASUREMENT
/begin MEASUREMENT St_lemdiag1.B_pr_mdsich "Prio der entlastung aus sicherheitsgründen" UBYTE _CNV_S_2_Def_bit_ub_563_CM 1 100. 0. 1. DISPLAY_IDENTIFIER B_PR_MDSICH ECU_ADDRESS 0xc0007a78 BIT_MASK 0x2 /end MEASUREMENT
/begin MEASUREMENT St_sleep "Statuswort Einschlafverhalten" UBYTE _CNV_R_R_Def_dez_sl_551_CM 1 100. 0. 255. DISPLAY_IDENTIFIER ST_SLEEP ECU_ADDRESS 0xc0000958 FORMAT "%3.0" /end MEASUREMENT
/begin MEASUREMENT St_sleep.B_sleepwait "Signal Verzoegerung Sleep Indication" UBYTE _CNV_S_2_Def_bit_ub_563_CM 1 100. 0. 1. DISPLAY_IDENTIFIER B_SLEEPWAIT ECU_ADDRESS 0xc0000958 BIT_MASK 0x1 /end MEASUREMENT
/begin MEASUREMENT Stat_entl "" UBYTE _CNV_R_R_Def_dez_sl_551_CM 1 100. 0. 255. DISPLAY_IDENTIFIER STAT_ENTL ECU_ADDRESS 0xc0000db8 FORMAT "%3.0" /end MEASUREMENT
/begin MEASUREMENT Stat_quali_1 "Häufigkeit Spannungsqualität A" UBYTE _CNV_R_R_Def_dez_sl_551_CM 1 100. 0. 255. DISPLAY_IDENTIFIER STAT_QUALI_1 ECU_ADDRESS 0xc0007a90 FORMAT "%3.0" /end MEASUREMENT
/begin MEASUREMENT Stat_quali_2 "Häufigkeit Spannungsqualität B" UBYTE _CNV_R_R_Def_dez_sl_551_CM 1 100. 0. 255. DISPLAY_IDENTIFIER STAT_QUALI_2 ECU_ADDRESS 0xc0007a91 FORMAT "%3.0" /end MEASUREMENT
/begin MEASUREMENT Stat_quali_3 "Häufigkeit Spannungsqualität C" UBYTE _CNV_R_R_Def_dez_sl_551_CM 1 100. 0. 255. DISPLAY_IDENTIFIER STAT_QUALI_3 ECU_ADDRESS 0xc0007a92 FORMAT "%3.0" /end MEASUREMENT
/begin MEASUREMENT Stat_ubattsoll_h "Häufigkeit Batterieladung Stufe H" UBYTE _CNV_R_R_Def_dez_sl_551_CM 1 100. 0. 255. DISPLAY_IDENTIFIER STAT_UBATTSOLL_H ECU_ADDRESS 0xc0007a93 FORMAT "%3.0" /end MEASUREMENT
/begin MEASUREMENT Stat_ubattsoll_l "Häufigkeit Batterieladung Stufe L" UBYTE _CNV_R_R_Def_dez_sl_551_CM 1 100. 0. 255. DISPLAY_IDENTIFIER STAT_UBATTSOLL_L ECU_ADDRESS 0xc0007a94 FORMAT "%3.0" /end MEASUREMENT
/begin MEASUREMENT T1histiruh "Ruhestromhistogramm Klasse 1" UWORD _CNV_R_R_Def_dez_sl_551_CM 1 100. 0. 65535. DISPLAY_IDENTIFIER T1HISTIRUH ECU_ADDRESS 0xc00009aa FORMAT "%5.0" /end MEASUREMENT
/begin MEASUREMENT T2histiruh "Ruhestromhistogramm Klasse 2" UWORD _CNV_R_R_Def_dez_sl_551_CM 1 100. 0. 65535. DISPLAY_IDENTIFIER T2HISTIRUH ECU_ADDRESS 0xc00009ac FORMAT "%5.0" /end MEASUREMENT
/begin MEASUREMENT T3histiruh "Ruhestromhistogramm Klasse 3" UWORD _CNV_R_R_Def_dez_sl_551_CM 1 100. 0. 65535. DISPLAY_IDENTIFIER T3HISTIRUH ECU_ADDRESS 0xc00009ae FORMAT "%5.0" /end MEASUREMENT
/begin MEASUREMENT T4histiruh "Ruhestromhistogramm Klasse 4" UWORD _CNV_R_R_Def_dez_sl_551_CM 1 100. 0. 65535. DISPLAY_IDENTIFIER T4HISTIRUH ECU_ADDRESS 0xc00009b0 FORMAT "%5.0" /end MEASUREMENT
/begin MEASUREMENT T_batt_ibs "Batterietemperatur" SWORD _CNV_R_R_Def_t_sw_q_578_CM 1 100. -3276.8 3276.7 DISPLAY_IDENTIFIER T_BATT_IBS ECU_ADDRESS 0xc00009b2 FORMAT "%6.1" /end MEASUREMENT
/begin MEASUREMENT T_batt_max "Maximale Batt. Temperatur bei Stillstand" SWORD _CNV_R_R_Def_t_sw_q_578_CM 1 100. -3276.8 3276.7 DISPLAY_IDENTIFIER T_BATT_MAX ECU_ADDRESS 0xc00009b4 FORMAT "%6.1" /end MEASUREMENT
/begin MEASUREMENT T_batt_min "Minimale Batt. Temperatur bei Stillstand" SWORD _CNV_R_R_Def_t_sw_q_578_CM 1 100. -3276.8 3276.7 DISPLAY_IDENTIFIER T_BATT_MIN ECU_ADDRESS 0xc00009b6 FORMAT "%6.1" /end MEASUREMENT
/begin MEASUREMENT T_battgradi "Batterietemperatur Gradient" SWORD _CNV_R_R_Def_t_sw_q_578_CM 1 100. -3276.8 3276.7 DISPLAY_IDENTIFIER T_BATTGRADI ECU_ADDRESS 0xc00009bc FORMAT "%6.1" /end MEASUREMENT
/begin MEASUREMENT T_battsoc0 "Batterietemperatur bei Ruhespannungsmessung" SWORD _CNV_R_R_Def_t_sw_q_578_CM 1 100. -3276.8 3276.7 DISPLAY_IDENTIFIER T_BATTSOC0 ECU_ADDRESS 0xc0000990 FORMAT "%6.1" /end MEASUREMENT
/begin MEASUREMENT T_battsoci "T_battsoc0, Rohwert aus IBS" UBYTE _CNV_R_R_Def_dez_sl_551_CM 1 100. 0. 255. DISPLAY_IDENTIFIER T_BATTSOCI ECU_ADDRESS 0xc0000974 FORMAT "%3.0" /end MEASUREMENT
/begin MEASUREMENT T_battsta "Batterietemperatur beim Start" SWORD _CNV_R_R_Def_t_sw_q_578_CM 1 100. -3276.8 3276.7 DISPLAY_IDENTIFIER T_BATTSTA ECU_ADDRESS 0xc00009ba FORMAT "%6.1" /end MEASUREMENT
/begin MEASUREMENT T_count_dibs1 "" UBYTE _CNV_R_R_Def_ql_ub__573_CM 1 100. 0. 255. DISPLAY_IDENTIFIER T_COUNT_DIBS1 ECU_ADDRESS 0xc0000946 /end MEASUREMENT
/begin MEASUREMENT T_count_dibs2 "" UBYTE _CNV_R_R_Def_ql_ub__573_CM 1 100. 0. 255. DISPLAY_IDENTIFIER T_COUNT_DIBS2 ECU_ADDRESS 0xc0000947 /end MEASUREMENT
/begin MEASUREMENT T_count_dibs3 "" UBYTE _CNV_R_R_Def_dez_sl_551_CM 1 100. 0. 255. DISPLAY_IDENTIFIER T_COUNT_DIBS3 ECU_ADDRESS 0xc0000948 FORMAT "%3.0" /end MEASUREMENT
/begin MEASUREMENT T_count_dibs4 "" UBYTE _CNV_R_R_Def_dez_sl_551_CM 1 100. 0. 255. DISPLAY_IDENTIFIER T_COUNT_DIBS4 ECU_ADDRESS 0xc0000949 FORMAT "%3.0" /end MEASUREMENT
/begin MEASUREMENT T_entlfunk "Zeit entlastung aus funktionalen Gründen" UBYTE _CNV_R_R_Def_td_ub__710_CM 1 100. 0. 1275. DISPLAY_IDENTIFIER T_ENTLFUNK ECU_ADDRESS 0xc0007a95 FORMAT "%4.1" /end MEASUREMENT
/begin MEASUREMENT T_entlsich "Zeit Entlastung aus Sicherheitsgründen" UBYTE _CNV_R_R_Def_td_ub__710_CM 1 100. 0. 1275. DISPLAY_IDENTIFIER T_ENTLSICH ECU_ADDRESS 0xc0007a96 FORMAT "%4.1" /end MEASUREMENT
/begin MEASUREMENT T_ierrllred "Zeit Dynamikbegrenzung LLSägen" UBYTE _CNV_R_R_Def_td_ub__710_CM 1 100. 0. 1275. DISPLAY_IDENTIFIER T_IERRLLRED ECU_ADDRESS 0xc0007a97 FORMAT "%4.1" /end MEASUREMENT
/begin MEASUREMENT T_ierrtred "Zeit stat. Begrenzung für Übertemperaturschutz" UBYTE _CNV_R_R_Def_td_ub__710_CM 1 100. 0. 1275. DISPLAY_IDENTIFIER T_IERRTRED ECU_ADDRESS 0xc0007a98 FORMAT "%4.1" /end MEASUREMENT
/begin MEASUREMENT T_igrdiagon "Zähler Diagnose aktiv" UWORD _CNV_R_R_Def_dez_sl_551_CM 1 100. 0. 65535. DISPLAY_IDENTIFIER T_IGRDIAGON ECU_ADDRESS 0xc0007a72 FORMAT "%5.0" /end MEASUREMENT
/begin MEASUREMENT T_igrh_antakt "iGR-Info High-Anteil" UWORD _CNV_R_R_Def_f_uw_b_571_CM 1 100. 0. 0.9999847412109381 DISPLAY_IDENTIFIER T_IGRH_ANTAKT ECU_ADDRESS 0xc0000bfa FORMAT "%14.5" /end MEASUREMENT
/begin MEASUREMENT T_igrhigh "iGR-Info High-Zeit" UWORD _CNV_R_R_Def_td_ub__574_CM 1 100. 0. 6553.5 DISPLAY_IDENTIFIER T_IGRHIGH ECU_ADDRESS 0xc0000bfc FORMAT "%6.1" /end MEASUREMENT
/begin MEASUREMENT T_igrl_antakt "iGR-Info Low-Anteil" UWORD _CNV_R_R_Def_f_uw_b_571_CM 1 100. 0. 0.9999847412109381 DISPLAY_IDENTIFIER T_IGRL_ANTAKT ECU_ADDRESS 0xc0000bfe FORMAT "%14.5" /end MEASUREMENT
/begin MEASUREMENT T_igrlow "iGR-Info Low-Zeit" UWORD _CNV_R_R_Def_td_ub__574_CM 1 100. 0. 6553.5 DISPLAY_IDENTIFIER T_IGRLOW ECU_ADDRESS 0xc0000c00 FORMAT "%6.1" /end MEASUREMENT
/begin MEASUREMENT T_igrm_antakt "iGR-Info Med-Anteil" UWORD _CNV_R_R_Def_f_uw_b_571_CM 1 100. 0. 0.9999847412109381 DISPLAY_IDENTIFIER T_IGRM_ANTAKT ECU_ADDRESS 0xc0000c02 FORMAT "%14.5" /end MEASUREMENT
/begin MEASUREMENT T_igrmed "iGR-Info Med-Zeit" UWORD _CNV_R_R_Def_td_ub__574_CM 1 100. 0. 6553.5 DISPLAY_IDENTIFIER T_IGRMED ECU_ADDRESS 0xc0000c04 FORMAT "%6.1" /end MEASUREMENT
/begin MEASUREMENT T_relibs "IBS Relativzeit" ULONG _CNV_R_R_Def_dez_sl_551_CM 1 100. 0. 4294967295. DISPLAY_IDENTIFIER T_RELIBS ECU_ADDRESS 0xc0000a48 FORMAT "%7.0" /end MEASUREMENT
/begin MEASUREMENT Tabg2tabg_wzinv "" UWORD _CNV_R_R_Def_f_uw_b_716_CM 1 100. 0. 0.499992370605469 DISPLAY_IDENTIFIER TABG2TABG_WZINV ECU_ADDRESS 0xd000d6d6 FORMAT "%14.6" /end MEASUREMENT
/begin MEASUREMENT Tabg_dif "Differenz Abgastemperatur - Last < der stationären Last" SWORD _CNV_R_R_Def_t_sw_q_578_CM 1 100. -3276.8 3276.7 DISPLAY_IDENTIFIER TABG_DIF ECU_ADDRESS 0xd000cb50 FORMAT "%6.1" /end MEASUREMENT
/begin MEASUREMENT Tabg_mw "Mittelwert Abgastemperatur" SWORD _CNV_R_R_Def_t_sw_q_578_CM 1 100. -3276.8 3276.7 DISPLAY_IDENTIFIER TABG_MW ECU_ADDRESS 0xd000d6ba FORMAT "%6.1" /end MEASUREMENT
/begin MEASUREMENT Tbatt_maxi "T_batt_max, Rohwert aus IBS" UBYTE _CNV_R_R_Def_dez_sl_551_CM 1 100. 0. 255. DISPLAY_IDENTIFIER TBATT_MAXI ECU_ADDRESS 0xc0000975 FORMAT "%3.0" /end MEASUREMENT
/begin MEASUREMENT Tbatt_mini "T_batt_min, Rohwert aus IBS" UBYTE _CNV_R_R_Def_dez_sl_551_CM 1 100. 0. 255. DISPLAY_IDENTIFIER TBATT_MINI ECU_ADDRESS 0xc0000976 FORMAT "%3.0" /end MEASUREMENT
/begin MEASUREMENT Tbgrd_ibs "Batterietemperatur Gradient letzte Stunde, von Sensor" SBYTE _CNV_R_R_Def_dez_sl_551_CM 1 100. -128. 127. DISPLAY_IDENTIFIER TBGRD_IBS ECU_ADDRESS 0xc0000979 FORMAT "%3.0" /end MEASUREMENT
/begin MEASUREMENT Tbsta_ibs "Batterietemperatur beim Start, Rohwert vom IBS " UBYTE _CNV_R_R_Def_dez_sl_551_CM 1 100. 0. 255. DISPLAY_IDENTIFIER TBSTA_IBS ECU_ADDRESS 0xc0000978 FORMAT "%3.0" /end MEASUREMENT
/begin MEASUREMENT Timecount_0 "" UWORD _CNV_R_R_Def_td_ub__574_CM 1 100. 0. 6553.5 DISPLAY_IDENTIFIER TIMECOUNT_0 ECU_ADDRESS 0xc0000dba FORMAT "%6.1" /end MEASUREMENT
/begin MEASUREMENT Timecount_1 "" UWORD _CNV_R_R_Def_td_ub__574_CM 1 100. 0. 6553.5 DISPLAY_IDENTIFIER TIMECOUNT_1 ECU_ADDRESS 0xc0000dbc FORMAT "%6.1" /end MEASUREMENT
/begin MEASUREMENT Timecount_2 "" UWORD _CNV_R_R_Def_td_ub__574_CM 1 100. 0. 6553.5 DISPLAY_IDENTIFIER TIMECOUNT_2 ECU_ADDRESS 0xc0000dbe FORMAT "%6.1" /end MEASUREMENT
/begin MEASUREMENT Timecount_3 "" UWORD _CNV_R_R_Def_td_ub__574_CM 1 100. 0. 6553.5 DISPLAY_IDENTIFIER TIMECOUNT_3 ECU_ADDRESS 0xc0000dc0 FORMAT "%6.1" /end MEASUREMENT
/begin MEASUREMENT Timecount_4 "" UBYTE _CNV_R_R_Def_dez_sl_551_CM 1 100. 0. 255. DISPLAY_IDENTIFIER TIMECOUNT_4 ECU_ADDRESS 0xc0000dc2 FORMAT "%3.0" /end MEASUREMENT
/begin MEASUREMENT Timecount_5 "" UBYTE _CNV_R_R_Def_dez_sl_551_CM 1 100. 0. 255. DISPLAY_IDENTIFIER TIMECOUNT_5 ECU_ADDRESS 0xc0000dc3 FORMAT "%3.0" /end MEASUREMENT
/begin MEASUREMENT Timecount_6 "" UBYTE _CNV_R_R_Def_dez_sl_551_CM 1 100. 0. 255. DISPLAY_IDENTIFIER TIMECOUNT_6 ECU_ADDRESS 0xc0000dc4 FORMAT "%3.0" /end MEASUREMENT
/begin MEASUREMENT Tm_entlfunk "mtl Dauer Generatorbegrenzung funktional" UBYTE _CNV_R_R_Def_td_ub__710_CM 1 100. 0. 1275. DISPLAY_IDENTIFIER TM_ENTLFUNK ECU_ADDRESS 0xc0007a99 FORMAT "%4.1" /end MEASUREMENT
/begin MEASUREMENT Tm_entlsich "mtl Dauer Generatorbegrenzung Sicherheit" UBYTE _CNV_R_R_Def_td_ub__710_CM 1 100. 0. 1275. DISPLAY_IDENTIFIER TM_ENTLSICH ECU_ADDRESS 0xc0007a9a FORMAT "%4.1" /end MEASUREMENT
/begin MEASUREMENT Tm_ierrllred "mtl Dauer Generatorbegrenzung LL-Sägen" UBYTE _CNV_R_R_Def_td_ub__710_CM 1 100. 0. 1275. DISPLAY_IDENTIFIER TM_IERRLLRED ECU_ADDRESS 0xc0007a9b FORMAT "%4.1" /end MEASUREMENT
/begin MEASUREMENT Tm_ierrtred "mtl Dauer Generatorbegrenzung Übertemperatur" UBYTE _CNV_R_R_Def_td_ub__710_CM 1 100. 0. 1275. DISPLAY_IDENTIFIER TM_IERRTRED ECU_ADDRESS 0xc0007a9c FORMAT "%4.1" /end MEASUREMENT
/begin MEASUREMENT Tmotraum "Motorraumtemperatur modelliert" SWORD _CNV_R_R_Def_t_sw_q_578_CM 1 100. -3276.8 3276.7 DISPLAY_IDENTIFIER TMOTRAUM ECU_ADDRESS 0xd000cb18 FORMAT "%6.1" /end MEASUREMENT
/begin MEASUREMENT Tmotraum_l "Delta Motorraumtemperatur - Aufheizen durch Lasteinfluss" SWORD _CNV_R_R_Def_t_sw_q_578_CM 1 100. -3276.8 3276.7 DISPLAY_IDENTIFIER TMOTRAUM_L ECU_ADDRESS 0xc000402c FORMAT "%6.1" /end MEASUREMENT
/begin MEASUREMENT Tmotraum_ol "Motorraumtemperatur - modelliert - ohne Lasteinfluss" SWORD _CNV_R_R_Def_t_sw_q_578_CM 1 100. -3276.8 3276.7 DISPLAY_IDENTIFIER TMOTRAUM_OL ECU_ADDRESS 0xd000cb52 FORMAT "%6.1" /end MEASUREMENT
/begin MEASUREMENT Tmotrauml_ini "Delta Motorraumtemperatur - Initialwert" SWORD _CNV_R_R_Def_t_sw_q_578_CM 1 100. -3276.8 3276.7 DISPLAY_IDENTIFIER TMOTRAUML_INI ECU_ADDRESS 0xd000cb54 FORMAT "%6.1" /end MEASUREMENT
/begin MEASUREMENT Tn_abstellatl "Abstellzeit in Minuten - f. Modellierung der Motorraumtemperatur" UWORD _CNV_R_R_Def_tn_uw__664_CM 1 100. 0. 65535. DISPLAY_IDENTIFIER TN_ABSTELLATL ECU_ADDRESS 0xc0004030 FORMAT "%7.2" /end MEASUREMENT
/begin MEASUREMENT Tn_abstellatl_old "Offset auf die Abstellzeit - Merkmal fuer vorhergehnender Fahrzyklus" UWORD _CNV_R_R_Def_tn_uw__664_CM 1 100. 0. 65535. DISPLAY_IDENTIFIER TN_ABSTELLATL_OLD ECU_ADDRESS 0xd000cb5a FORMAT "%7.2" /end MEASUREMENT
/begin MEASUREMENT Tseg_sec "Segmentzeit" UWORD _CNV_R_R_Def_f_uw_b_719_CM 1 100. 0. 0.124998092651367 DISPLAY_IDENTIFIER TSEG_SEC ECU_ADDRESS 0xd000d6b2 FORMAT "%14.6" /end MEASUREMENT
/begin MEASUREMENT Tvld_mod "Temperatur vor Lader - modelliert" SWORD _CNV_R_R_Def_t_sw_q_578_CM 1 100. -3276.8 3276.7 DISPLAY_IDENTIFIER TVLD_MOD ECU_ADDRESS 0xd000cb56 FORMAT "%6.1" /end MEASUREMENT
/begin MEASUREMENT Tvldr "Temperatur vor Lader - Modell oder Sensorwert" SWORD _CNV_R_R_Def_t_sw_q_578_CM 1 100. -3276.8 3276.7 DISPLAY_IDENTIFIER TVLDR ECU_ADDRESS 0xd000cb1a FORMAT "%6.1" /end MEASUREMENT
/begin MEASUREMENT Tvulv "ULV Ansteuerung" UWORD _CNV_R_R_Def_f_uw_b_555_CM 1 100. 0. 99.9984 DISPLAY_IDENTIFIER TVULV ECU_ADDRESS 0xd000cc14 FORMAT "%8.3" /end MEASUREMENT
/begin MEASUREMENT Tvulvpump "Ansteuerung ULV Offset bei Pumpeingriffen" UWORD _CNV_R_R_Def_f_uw_b_555_CM 1 100. 0. 99.9984 DISPLAY_IDENTIFIER TVULVPUMP ECU_ADDRESS 0xd000cc16 FORMAT "%8.3" /end MEASUREMENT
/begin MEASUREMENT Tvulvpump23 "Pumpeingriff durch Ansteuerung ULV - adaptiver Wert" UWORD _CNV_R_R_Def_f_uw_b_555_CM 1 100. 0. 99.9984 DISPLAY_IDENTIFIER TVULVPUMP23 ECU_ADDRESS 0xc0004040 FORMAT "%8.3" /end MEASUREMENT
/begin MEASUREMENT U1soc0 "Ruhespannung 1" UWORD _CNV_R_R_Def_u_uw_q_700_CM 1 100. 6. 22.3837 DISPLAY_IDENTIFIER U1SOC0 ECU_ADDRESS 0xc0000992 FORMAT "%9.4" /end MEASUREMENT
/begin MEASUREMENT U1soc0_q "Ruhespannung 1 f. qvc" UWORD _CNV_R_R_Def_u_uw_q_700_CM 1 100. 6. 22.3837 DISPLAY_IDENTIFIER U1SOC0_Q ECU_ADDRESS 0xc0000998 FORMAT "%9.4" /end MEASUREMENT
/begin MEASUREMENT U2soc0 "Ruhespannung 2" UWORD _CNV_R_R_Def_u_uw_q_700_CM 1 100. 6. 22.3837 DISPLAY_IDENTIFIER U2SOC0 ECU_ADDRESS 0xc0000994 FORMAT "%9.4" /end MEASUREMENT
/begin MEASUREMENT U2soc0_q "Ruhespannung 2 f. qvc" UWORD _CNV_R_R_Def_u_uw_q_700_CM 1 100. 6. 22.3837 DISPLAY_IDENTIFIER U2SOC0_Q ECU_ADDRESS 0xc000099a FORMAT "%9.4" /end MEASUREMENT
/begin MEASUREMENT U3soc0 "Ruhespannung 3" UWORD _CNV_R_R_Def_u_uw_q_700_CM 1 100. 6. 22.3837 DISPLAY_IDENTIFIER U3SOC0 ECU_ADDRESS 0xc0000996 FORMAT "%9.4" /end MEASUREMENT
/begin MEASUREMENT U3soc0_q "Ruhespannung 3 f. qvc" UWORD _CNV_R_R_Def_u_uw_q_700_CM 1 100. 6. 22.3837 DISPLAY_IDENTIFIER U3SOC0_Q ECU_ADDRESS 0xc000099c FORMAT "%9.4" /end MEASUREMENT
/begin MEASUREMENT U_batt "Batteriespannung von IBS gemessen" UWORD _CNV_R_R_Def_u_uw_q_700_CM 1 100. 6. 22.3837 DISPLAY_IDENTIFIER U_BATT ECU_ADDRESS 0xc0000980 FORMAT "%9.4" /end MEASUREMENT
/begin MEASUREMENT U_igr_dn "iGR Spannungsrampe negativ" UBYTE _CNV_R_R_Def_u_ub_b_721_CM 1 100. 0. 0.498 DISPLAY_IDENTIFIER U_IGR_DN ECU_ADDRESS 0xc0000be0 FORMAT "%7.4" /end MEASUREMENT
/begin MEASUREMENT U_igr_dp "iGR Spannungsrampe positiv" UBYTE _CNV_R_R_Def_u_ub_b_721_CM 1 100. 0. 0.498 DISPLAY_IDENTIFIER U_IGR_DP ECU_ADDRESS 0xc0000be1 FORMAT "%7.4" /end MEASUREMENT
/begin MEASUREMENT U_igr_soll "Spannungsanforderung iGR" UBYTE _CNV_R_R_Def_u_ub_q_631_CM 1 100. 0. 25.5 DISPLAY_IDENTIFIER U_IGR_SOLL ECU_ADDRESS 0xc0000be2 FORMAT "%5.2" /end MEASUREMENT
/begin MEASUREMENT U_igrmedhi "Regler-Spannungsvorgabe (ungefiltert) " UBYTE _CNV_R_R_Def_u_ub_q_631_CM 1 100. 0. 25.5 DISPLAY_IDENTIFIER U_IGRMEDHI ECU_ADDRESS 0xc0000be3 FORMAT "%5.2" /end MEASUREMENT
/begin MEASUREMENT U_tnstart "Spannung im Start" UWORD _CNV_R_R_Def_u_uw_q_700_CM 1 100. 6. 22.3837 DISPLAY_IDENTIFIER U_TNSTART ECU_ADDRESS 0xc00009a4 FORMAT "%9.4" /end MEASUREMENT
/begin MEASUREMENT U_vorstart "Spannung vor Start" UWORD _CNV_R_R_Def_u_uw_q_700_CM 1 100. 6. 22.3837 DISPLAY_IDENTIFIER U_VORSTART ECU_ADDRESS 0xc00009a2 FORMAT "%9.4" /end MEASUREMENT
/begin MEASUREMENT Ulvr "Umluftventil - Stellgroesse" UWORD _CNV_R_R_Def_f_uw_b_555_CM 1 100. 0. 99.9984 DISPLAY_IDENTIFIER ULVR ECU_ADDRESS 0xd000cc24 FORMAT "%8.3" /end MEASUREMENT
/begin MEASUREMENT Ulvvst "Vorsteuerung Umluftventil" UWORD _CNV_R_R_Def_f_uw_b_555_CM 1 100. 0. 99.9984 DISPLAY_IDENTIFIER ULVVST ECU_ADDRESS 0xd000cc26 FORMAT "%8.3" /end MEASUREMENT
/begin MEASUREMENT Unind "EBSD Puffer Index" UBYTE _CNV_R_R_Def_dez_sl_551_CM 1 100. 0. 255. DISPLAY_IDENTIFIER UNIND ECU_ADDRESS 0xc0000a4e FORMAT "%3.0" /end MEASUREMENT
/begin MEASUREMENT Vsllk "Volumenstrom ueber Ladeluftkühler" UWORD _CNV_R_R_Def_vs_uw__735_CM 1 100. 0. 1279.9804 DISPLAY_IDENTIFIER VSLLK ECU_ADDRESS 0xd000cb5c FORMAT "%7.2" /end MEASUREMENT
/begin MEASUREMENT Vsvld "Volumenstrom vor Verdichter" UWORD _CNV_R_R_Def_vs_uw__735_CM 1 100. 0. 1279.9804 DISPLAY_IDENTIFIER VSVLD ECU_ADDRESS 0xd000cb5e FORMAT "%7.2" /end MEASUREMENT
/begin MEASUREMENT Vvt_ib1_2 "Gesamtstrom VVT Bank1 bzw 4Zyl. und Bank2" UWORD _CNV_R_R_Def_i_uw_q_637_CM 1 100. 0. 4095.9375 DISPLAY_IDENTIFIER VVT_IB1_2 ECU_ADDRESS 0xc00008de FORMAT "%8.3" /end MEASUREMENT
/begin MEASUREMENT Vvt_iges "Strombedarf des gesamten VVT-Systems" UWORD _CNV_R_R_Def_i_uw_q_637_CM 1 100. 0. 192. DISPLAY_IDENTIFIER VVT_IGES ECU_ADDRESS 0xc00008e0 FORMAT "%8.3" /end MEASUREMENT
/begin MEASUREMENT Wgpos_atlvst "Wastegate Position modelliert" UWORD _CNV_R_R_Def_f_uw_b_555_CM 1 100. 0. 99.9984 DISPLAY_IDENTIFIER WGPOS_ATLVST ECU_ADDRESS 0xd000ca70 FORMAT "%8.3" /end MEASUREMENT
/begin MEASUREMENT Wgpos_ausy "" UWORD _CNV_R_R_Def_f_uw_b_555_CM 1 100. 0. 99.9984 DISPLAY_IDENTIFIER WGPOS_AUSY ECU_ADDRESS 0xd000d6d8 FORMAT "%8.3" /end MEASUREMENT
/begin MEASUREMENT Wstg_s "Modell Druckstangenweg der Wastegatebetätigung" UWORD _CNV_R_R_Def_f_uw_b_555_CM 1 100. 0. 99.9984 DISPLAY_IDENTIFIER WSTG_S ECU_ADDRESS 0xd000d6da FORMAT "%8.3" /end MEASUREMENT
/begin MEASUREMENT Wstg_s_vf "Modell Druckstangenweg der Wastegatebetätigung vor Filter" UWORD _CNV_R_R_Def_f_uw_b_555_CM 1 100. 0. 99.9984 DISPLAY_IDENTIFIER WSTG_S_VF ECU_ADDRESS 0xd000d6dc FORMAT "%8.3" /end MEASUREMENT
/begin MEASUREMENT Zbibs "Zusbaunummer" ULONG _CNV_R_R_Def_dez_sl_551_CM 1 100. 0. 4294967295. DISPLAY_IDENTIFIER ZBIBS ECU_ADDRESS 0xc0000a40 FORMAT "%7.0" /end MEASUREMENT
/begin MEASUREMENT Zr_entlfunk "Häufigkeit Generatorbegrenzung funktional" UWORD _CNV_R_R_Def_dez_sl_551_CM 1 100. 0. 65535. DISPLAY_IDENTIFIER ZR_ENTLFUNK ECU_ADDRESS 0xc0007a7a FORMAT "%5.0" /end MEASUREMENT
/begin MEASUREMENT Zr_entlfunknix "Häufigkeit Generatorbegrenzung funktional 0%" UWORD _CNV_R_R_Def_dez_sl_551_CM 1 100. 0. 65535. DISPLAY_IDENTIFIER ZR_ENTLFUNKNIX ECU_ADDRESS 0xc0007a7c FORMAT "%5.0" /end MEASUREMENT
/begin MEASUREMENT Zr_entlfunkteil "Häufigkeit Generatorbegrenzung funktional eingeschränkt PMBATTMNG" UWORD _CNV_R_R_Def_dez_sl_551_CM 1 100. 0. 65535. DISPLAY_IDENTIFIER ZR_ENTLFUNKTEIL ECU_ADDRESS 0xc0007a7e FORMAT "%5.0" /end MEASUREMENT
/begin MEASUREMENT Zr_entlfunkvoll "Häufigkeit Generatorbegrenzung funktional 100%" UWORD _CNV_R_R_Def_dez_sl_551_CM 1 100. 0. 65535. DISPLAY_IDENTIFIER ZR_ENTLFUNKVOLL ECU_ADDRESS 0xc0007a80 FORMAT "%5.0" /end MEASUREMENT
/begin MEASUREMENT Zr_entlsich "Häufigkeit Generatorbegrenzung Sicherheit" UWORD _CNV_R_R_Def_dez_sl_551_CM 1 100. 0. 65535. DISPLAY_IDENTIFIER ZR_ENTLSICH ECU_ADDRESS 0xc0007a82 FORMAT "%5.0" /end MEASUREMENT
/begin MEASUREMENT Zr_entlsichvoll "Häufigkeit Generatorbegrenzung Sicherheit 100%" UWORD _CNV_R_R_Def_dez_sl_551_CM 1 100. 0. 65535. DISPLAY_IDENTIFIER ZR_ENTLSICHVOLL ECU_ADDRESS 0xc0007a84 FORMAT "%5.0" /end MEASUREMENT
/begin MEASUREMENT Zr_ierrllred "Häufigkeit Generatorbegrenzung LL-Sägen" UBYTE _CNV_R_R_Def_dez_sl_551_CM 1 100. 0. 255. DISPLAY_IDENTIFIER ZR_IERRLLRED ECU_ADDRESS 0xc0007a9d FORMAT "%3.0" /end MEASUREMENT
/begin MEASUREMENT Zr_ierrtred "Häufigkeit Generatorbegrenzung Übertemperatur" UBYTE _CNV_R_R_Def_dez_sl_551_CM 1 100. 0. 255. DISPLAY_IDENTIFIER ZR_IERRTRED ECU_ADDRESS 0xc0007a9e FORMAT "%3.0" /end MEASUREMENT
/begin MEASUREMENT Zr_igr_low "iGR-Info Anzahl Schubphasen" UWORD _CNV_R_R_Def_dez_sl_551_CM 1 100. 0. 65535. DISPLAY_IDENTIFIER ZR_IGR_LOW ECU_ADDRESS 0xc0000c06 FORMAT "%5.0" /end MEASUREMENT
/begin MEASUREMENT Zr_quali_1 "Zwischenvar Häufigkeit Spannungsqualität A" UWORD _CNV_R_R_Def_dez_sl_551_CM 1 100. 0. 65535. DISPLAY_IDENTIFIER ZR_QUALI_1 ECU_ADDRESS 0xc0007a86 FORMAT "%5.0" /end MEASUREMENT
/begin MEASUREMENT Zr_quali_2 "Zwischenvar Häufigkeit Spannungsqualität B" UWORD _CNV_R_R_Def_dez_sl_551_CM 1 100. 0. 65535. DISPLAY_IDENTIFIER ZR_QUALI_2 ECU_ADDRESS 0xc0007a88 FORMAT "%5.0" /end MEASUREMENT
/begin MEASUREMENT Zr_quali_3 "Zwischenvar Häufigkeit Spannungsqualität C" UWORD _CNV_R_R_Def_dez_sl_551_CM 1 100. 0. 65535. DISPLAY_IDENTIFIER ZR_QUALI_3 ECU_ADDRESS 0xc0007a8a FORMAT "%5.0" /end MEASUREMENT
/begin MEASUREMENT Zr_ubattsoll_h "Häufigkeit Batterieladung Stufe H" UWORD _CNV_R_R_Def_dez_sl_551_CM 1 100. 0. 65535. DISPLAY_IDENTIFIER ZR_UBATTSOLL_H ECU_ADDRESS 0xc0007a8c FORMAT "%5.0" /end MEASUREMENT
/begin MEASUREMENT Zr_ubattsoll_l "Häufigkeit Batterieladung Stufe L" UWORD _CNV_R_R_Def_dez_sl_551_CM 1 100. 0. 65535. DISPLAY_IDENTIFIER ZR_UBATTSOLL_L ECU_ADDRESS 0xc0007a8e FORMAT "%5.0" /end MEASUREMENT
/begin MEASUREMENT Zr_ustat_1 "Häufigkeit Spannungsbereich A" UWORD _CNV_R_R_Def_dez_sl_551_CM 1 100. 0. 65535. DISPLAY_IDENTIFIER ZR_USTAT_1 ECU_ADDRESS 0xc0000c3c FORMAT "%5.0" /end MEASUREMENT
/begin MEASUREMENT Zr_ustat_2 "Häufigkeit Spannungsbereich B" UWORD _CNV_R_R_Def_dez_sl_551_CM 1 100. 0. 65535. DISPLAY_IDENTIFIER ZR_USTAT_2 ECU_ADDRESS 0xc0000c3e FORMAT "%5.0" /end MEASUREMENT
/begin MEASUREMENT Zr_ustat_3 "Häufigkeit Spannungsbereich C" UWORD _CNV_R_R_Def_dez_sl_551_CM 1 100. 0. 65535. DISPLAY_IDENTIFIER ZR_USTAT_3 ECU_ADDRESS 0xc0000c40 FORMAT "%5.0" /end MEASUREMENT
/begin MEASUREMENT Zr_ustat_4 "Häufigkeit Spannungsbereich D" UWORD _CNV_R_R_Def_dez_sl_551_CM 1 100. 0. 65535. DISPLAY_IDENTIFIER ZR_USTAT_4 ECU_ADDRESS 0xc0000c42 FORMAT "%5.0" /end MEASUREMENT
/begin MEASUREMENT Zr_ustat_5 "Häufigkeit Spannungsbereich E" UWORD _CNV_R_R_Def_dez_sl_551_CM 1 100. 0. 65535. DISPLAY_IDENTIFIER ZR_USTAT_5 ECU_ADDRESS 0xc0000c44 FORMAT "%5.0" /end MEASUREMENT
/begin MEASUREMENT Zr_ustat_6 "Häufigkeit Spannungsbereich F" UWORD _CNV_R_R_Def_dez_sl_551_CM 1 100. 0. 65535. DISPLAY_IDENTIFIER ZR_USTAT_6 ECU_ADDRESS 0xc0000c46 FORMAT "%5.0" /end MEASUREMENT
/begin MEASUREMENT Zr_ustat_7 "Häufigkeit Spannungsbereich G" UWORD _CNV_R_R_Def_dez_sl_551_CM 1 100. 0. 65535. DISPLAY_IDENTIFIER ZR_USTAT_7 ECU_ADDRESS 0xc0000c48 FORMAT "%5.0" /end MEASUREMENT
/begin MEASUREMENT Zw_mw1 "Zündwinkel Mittelwert Bank1" SWORD _CNV_R_R_Def_zw_sw__604_CM 1 100. -3276.8 3276.7 DISPLAY_IDENTIFIER ZW_MW1 ECU_ADDRESS 0xd000cb1c FORMAT "%6.1" /end MEASUREMENT
/begin MEASUREMENT Zw_mw2 "Zündwinkel Mittelwert Bank2" SWORD _CNV_R_R_Def_zw_sw__604_CM 1 100. -3276.8 3276.7 DISPLAY_IDENTIFIER ZW_MW2 ECU_ADDRESS 0xd000cb1e FORMAT "%6.1" /end MEASUREMENT
/begin CHARACTERISTIC CW_MS_AK_MAN "Auswahl zufließender Massenstrom" VALUE 0xa082009a _REC_VAL_20_u1 2. _CNV_R_R_Def_dez_sl_551_CM 0. 2. FORMAT "%3.0" /end CHARACTERISTIC
/begin CHARACTERISTIC CW_MS_TURB_MAN "Auswahl Turbinenmassenstrom" VALUE 0xa082010e _REC_VAL_20_u1 2. _CNV_R_R_Def_dez_sl_551_CM 0. 2. FORMAT "%3.0" /end CHARACTERISTIC
/begin CHARACTERISTIC CW_TVLD "Codewort - Bestimmung Temperatur vor Lader" VALUE 0xa08182a0 _REC_VAL_20_u1 3. _CNV_R_R_Def_dez_sl_551_CM 0. 3. FORMAT "%3.0" /end CHARACTERISTIC
/begin CHARACTERISTIC KF_ATLVST "ATL-Regler - Vorsteuerung" MAP 0xa08178a4 _REC_MAP_52_UBYTE_u2_u2_u2 99.9984 _CNV_R_R_Def_f_uw_b_555_CM 0. 99.9984
 /begin AXIS_DESCR STD_AXIS F_pldsvld_f _CNV_R_R_Def_f_sw_b_616_CM 20 0. 3.9999 FORMAT "%14.5" /end AXIS_DESCR
 /begin AXIS_DESCR STD_AXIS Mssolatl_k _CNV_R_R_Def_ms_uw__594_CM 16 0. 2047.9687 /end AXIS_DESCR
/end CHARACTERISTIC
/begin CHARACTERISTIC KF_ATLVSTPDYN "Offset auf Vorsteuerung bei Sollladedruckdynamik" MAP 0xa0817db4 _REC_MAP_52_UBYTE_u2_s2_s2 99.9984 _CNV_R_R_Def_f_uw_b_555_CM 0. 99.9984
 /begin AXIS_DESCR STD_AXIS Nkw _CNV_R_R_Def_n_sw_q_595_CM 6 -32768. 32767. FORMAT "%5.0" /end AXIS_DESCR
 /begin AXIS_DESCR STD_AXIS Pldrsoll_dyn2 _CNV_R_R_Def_p_sw_q_576_CM 8 -1280. 1279.9609 FORMAT "%5.2" /end AXIS_DESCR
/end CHARACTERISTIC
/begin CHARACTERISTIC KF_ATLVST_GD "ATL-Regler - Vorsteuerung - gedrosselter Betrieb" MAP 0xa0817800 _REC_MAP_52_UBYTE_u2_s2_s2 99.9984 _CNV_R_R_Def_f_uw_b_555_CM 0. 99.9984
 /begin AXIS_DESCR STD_AXIS Rf_soll _CNV_R_R_Def_rf_sw__598_CM 8 -327.68 327.67 FORMAT "%7.4" /end AXIS_DESCR
 /begin AXIS_DESCR STD_AXIS Nkw _CNV_R_R_Def_n_sw_q_595_CM 8 -32768. 32767. FORMAT "%5.0" /end AXIS_DESCR
/end CHARACTERISTIC
/begin CHARACTERISTIC KF_ATLVST_NKW "ATL-Regler - Vorsteuerung ohne Hoeheneinfluss" MAP 0xa0817b70 _REC_MAP_52_UBYTE_u2_u2_s2 99.9984 _CNV_R_R_Def_f_uw_b_555_CM 0. 99.9984
 /begin AXIS_DESCR STD_AXIS F_pldsvld_f _CNV_R_R_Def_f_sw_b_616_CM 16 0. 3.9999 FORMAT "%14.5" /end AXIS_DESCR
 /begin AXIS_DESCR STD_AXIS Nkw _CNV_R_R_Def_n_sw_q_595_CM 16 -32768. 32767. FORMAT "%5.0" /end AXIS_DESCR
/end CHARACTERISTIC
/begin CHARACTERISTIC KF_AUSY_TURB "Durchflusskennlinie Turbine" MAP 0xa0820288 _REC_MAP_52_UBYTE_u2_u2_u2 0.9999847412109381 _CNV_R_R_Def_f_uw_b_571_CM 0. 0.9999847412109381 FORMAT "%14.5"
 /begin AXIS_DESCR STD_AXIS Prat_turb _CNV_R_R_Def_f_sw_b_616_CM 16 0. 3.9999 FORMAT "%14.5" /end AXIS_DESCR
 /begin AXIS_DESCR STD_AXIS Wstg_s _CNV_R_R_Def_f_uw_b_555_CM 12 0. 99.9984 /end AXIS_DESCR
/end CHARACTERISTIC
/begin CHARACTERISTIC KF_AUSY_TURB_DIFF "Ableitung der Durchflusskennlinie Turbine" MAP 0xa0820444 _REC_MAP_52_UBYTE_s2_u2_u2 3.9999 _CNV_R_R_Def_f_sw_b_616_CM -2. 1.9999 FORMAT "%14.5"
 /begin AXIS_DESCR STD_AXIS Prat_turb _CNV_R_R_Def_f_sw_b_616_CM 8 0. 3.9999 FORMAT "%14.5" /end AXIS_DESCR
 /begin AXIS_DESCR STD_AXIS Wstg_s _CNV_R_R_Def_f_uw_b_555_CM 8 0. 99.9984 /end AXIS_DESCR
/end CHARACTERISTIC
/begin CHARACTERISTIC KF_ELUPWM39 "Strom E-Lüfter über pwm und ub" MAP 0xa0822238 _REC_MAP_52_UBYTE_u2_u1_u2 64. _CNV_R_R_Def_i_uw_q_637_CM 0. 64.
 /begin AXIS_DESCR STD_AXIS L_pwmout _CNV_R_R_Def_f_ub_b_586_CM 8 0. 99.60930000000001 FORMAT "%5.2" /end AXIS_DESCR
 /begin AXIS_DESCR STD_AXIS NO_INPUT_QUANTITY _CNV_R_R_Def_v_uw_q_726_CM 8 0. 360. FORMAT "%5.0" /end AXIS_DESCR
/end CHARACTERISTIC
/begin CHARACTERISTIC KF_ELUPWM60 "Strom E-Lüfter über pwm und ub" MAP 0xa082219c _REC_MAP_52_UBYTE_u2_u1_u2 64. _CNV_R_R_Def_i_uw_q_637_CM 0. 64.
 /begin AXIS_DESCR STD_AXIS L_pwmout _CNV_R_R_Def_f_ub_b_586_CM 8 0. 99.60930000000001 FORMAT "%5.2" /end AXIS_DESCR
 /begin AXIS_DESCR STD_AXIS NO_INPUT_QUANTITY _CNV_R_R_Def_v_uw_q_726_CM 8 0. 360. FORMAT "%5.0" /end AXIS_DESCR
/end CHARACTERISTIC
/begin CHARACTERISTIC KF_FATLDYN "Überspülfaktor  statischer Betrieb" MAP 0xa081856c _REC_MAP_52_u1_s2_s2 0.996 _CNV_R_R_Def_f_ub_b_553_CM 0. 0.996
 /begin AXIS_DESCR STD_AXIS Nkw _CNV_R_R_Def_n_sw_q_595_CM 8 -32768. 32767. FORMAT "%5.0" /end AXIS_DESCR
 /begin AXIS_DESCR STD_AXIS Rfv_vns _CNV_R_R_Def_rf_sw__598_CM 8 -327.68 327.67 FORMAT "%7.4" /end AXIS_DESCR
/end CHARACTERISTIC
/begin CHARACTERISTIC KF_FATLRD "Faktor D-Anteil - Gradient d. Regelabweichung" MAP 0xa08180dc _REC_MAP_52_UBYTE_s2_s2_s2 99.83843999999999 _CNV_R_R_Def_f_sw_b_623_CM -64. 63.998
 /begin AXIS_DESCR STD_AXIS Pld_diff_i _CNV_R_R_Def_p_sw_q_680_CM 14 -2560. 2559.9218 FORMAT "%5.2" /end AXIS_DESCR
 /begin AXIS_DESCR STD_AXIS Pld_diff_grd_i _CNV_R_R_Def_p_sw_q_680_CM 14 -2560. 2559.9218 FORMAT "%5.2" /end AXIS_DESCR
/end CHARACTERISTIC
/begin CHARACTERISTIC KF_FATLR_I "Verstaerkung Regeldifferenz - I Anteil" MAP 0xa0817f88 _REC_MAP_52_UBYTE_u2_s2_s2 0.9999 _CNV_R_R_Def_f_uw_b_571_CM 0. 0.9999 FORMAT "%14.5"
 /begin AXIS_DESCR STD_AXIS Nkw _CNV_R_R_Def_n_sw_q_595_CM 12 -32768. 32767. FORMAT "%5.0" /end AXIS_DESCR
 /begin AXIS_DESCR STD_AXIS Pld_diff_fil_i _CNV_R_R_Def_p_sw_q_680_CM 12 -2560. 2559.9218 FORMAT "%5.2" /end AXIS_DESCR
/end CHARACTERISTIC
/begin CHARACTERISTIC KF_FATLR_P "Faktor Verstaerkung der Vorsteuergroesse" MAP 0xa0817e34 _REC_MAP_52_UBYTE_s2_s2_s2 63.999 _CNV_R_R_Def_f_sw_b_556_CM -32. 31.999 FORMAT "%7.4"
 /begin AXIS_DESCR STD_AXIS Nkw _CNV_R_R_Def_n_sw_q_595_CM 12 -32768. 32767. FORMAT "%5.0" /end AXIS_DESCR
 /begin AXIS_DESCR STD_AXIS Pld_diff_dyn_i _CNV_R_R_Def_p_sw_q_680_CM 12 -2560. 2559.9218 FORMAT "%5.2" /end AXIS_DESCR
/end CHARACTERISTIC
/begin CHARACTERISTIC KF_FPWSTGDSE "Kennfeld Faktor Druckbeaufschlagung Wastegatedose in Abh. der Drucksteuerventilansteuerung" MAP 0xa08201e4 _REC_MAP_52_UBYTE_u2_u2_u2 0.9999847412109381 _CNV_R_R_Def_f_uw_b_571_CM 0. 0.9999847412109381 FORMAT "%14.5"
 /begin AXIS_DESCR STD_AXIS NO_INPUT_QUANTITY _CNV_R_R_Def_p_sw_q_576_CM 8 0. 2559.9609 FORMAT "%5.2" /end AXIS_DESCR
 /begin AXIS_DESCR STD_AXIS Atlr_oad _CNV_R_R_Def_f_uw_b_555_CM 8 0. 99.9984 /end AXIS_DESCR
/end CHARACTERISTIC
/begin CHARACTERISTIC KF_FTMOTRAUM "Motorraumtemperatur Einfluss durch die Abstellzeit" MAP 0xa08185d0 _REC_MAP_52_u1_u2_u2 0.996 _CNV_R_R_Def_f_ub_b_553_CM 0. 0.996
 /begin AXIS_DESCR STD_AXIS Tn_abstellatl _CNV_R_R_Def_tn_uw__664_CM 8 0. 65535. FORMAT "%5.2" /end AXIS_DESCR
 /begin AXIS_DESCR STD_AXIS Mslui _CNV_R_R_Def_lm_uw__654_CM 8 0. 29.1266 FORMAT "%7.4" /end AXIS_DESCR
/end CHARACTERISTIC
/begin CHARACTERISTIC KF_FULVPUMP "Wichtung  Pumpeingiff durch ULV" MAP 0xa081893c _REC_MAP_52_u1_u2_u2 0.996 _CNV_R_R_Def_f_ub_b_553_CM 0. 0.996
 /begin AXIS_DESCR STD_AXIS Pldr_soll _CNV_R_R_Def_p_sw_q_576_CM 6 0. 2559.9609 FORMAT "%5.2" /end AXIS_DESCR
 /begin AXIS_DESCR STD_AXIS Mssolatl_k _CNV_R_R_Def_ms_uw__594_CM 6 0. 2047.9687 /end AXIS_DESCR
/end CHARACTERISTIC
/begin CHARACTERISTIC KF_FULVUES "Faktor bei Druckueberschwinger" MAP 0xa0818a20 _REC_MAP_52_UBYTE_u2_u2_u2 1.9999 _CNV_R_R_Def_f_uw_b_590_CM 0. 1.9999 FORMAT "%14.5"
 /begin AXIS_DESCR STD_AXIS Pvdkds _CNV_R_R_Def_p_sw_q_576_CM 8 0. 2559.9609 FORMAT "%5.2" /end AXIS_DESCR
 /begin AXIS_DESCR STD_AXIS Mszyl _CNV_R_R_Def_ms_uw__594_CM 8 0. 2047.9687 /end AXIS_DESCR
/end CHARACTERISTIC
/begin CHARACTERISTIC KF_PRIO_4 "" MAP 0xa0825b10 _REC_MAP_52_u1_s2_u2 99.45 _CNV_R_R_Def_dez_sl_551_CM 0. 255. FORMAT "%3.0"
 /begin AXIS_DESCR STD_AXIS Tmot _CNV_R_R_Def_t_sw_q_579_CM 8 -327.68 327.67 FORMAT "%5.2" /end AXIS_DESCR
 /begin AXIS_DESCR STD_AXIS Pu _CNV_R_R_Def_p_sw_q_576_CM 8 0. 2559.9609 FORMAT "%5.2" /end AXIS_DESCR
/end CHARACTERISTIC
/begin CHARACTERISTIC KF_PRIO_HOLD "" MAP 0xa0825aac _REC_MAP_52_u1_s2_u2 99.45 _CNV_R_R_Def_dez_sl_551_CM 0. 255. FORMAT "%3.0"
 /begin AXIS_DESCR STD_AXIS Tmot _CNV_R_R_Def_t_sw_q_579_CM 8 -327.68 327.67 FORMAT "%5.2" /end AXIS_DESCR
 /begin AXIS_DESCR STD_AXIS Pu _CNV_R_R_Def_p_sw_q_576_CM 8 0. 2559.9609 FORMAT "%5.2" /end AXIS_DESCR
/end CHARACTERISTIC
/begin CHARACTERISTIC KF_PRIO_NO "" MAP 0xa0825b74 _REC_MAP_52_u1_s2_u2 99.45 _CNV_R_R_Def_dez_sl_551_CM 0. 255. FORMAT "%3.0"
 /begin AXIS_DESCR STD_AXIS Tmot _CNV_R_R_Def_t_sw_q_579_CM 8 -327.68 327.67 FORMAT "%5.2" /end AXIS_DESCR
 /begin AXIS_DESCR STD_AXIS Pu _CNV_R_R_Def_p_sw_q_576_CM 8 0. 2559.9609 FORMAT "%5.2" /end AXIS_DESCR
/end CHARACTERISTIC
/begin CHARACTERISTIC KF_PRIO_UP "" MAP 0xa08259e4 _REC_MAP_52_u1_s2_u2 99.45 _CNV_R_R_Def_dez_sl_551_CM 0. 255. FORMAT "%3.0"
 /begin AXIS_DESCR STD_AXIS Tmot _CNV_R_R_Def_t_sw_q_579_CM 8 -327.68 327.67 FORMAT "%5.2" /end AXIS_DESCR
 /begin AXIS_DESCR STD_AXIS Pu _CNV_R_R_Def_p_sw_q_576_CM 8 0. 2559.9609 FORMAT "%5.2" /end AXIS_DESCR
/end CHARACTERISTIC
/begin CHARACTERISTIC KF_RF_AFU "" MAP 0xa0825a48 _REC_MAP_52_u1_s2_u2 99.45 _CNV_R_R_Def_dez_sl_551_CM 0. 255. FORMAT "%3.0"
 /begin AXIS_DESCR STD_AXIS Tmot _CNV_R_R_Def_t_sw_q_579_CM 8 -327.68 327.67 FORMAT "%5.2" /end AXIS_DESCR
 /begin AXIS_DESCR STD_AXIS Pu _CNV_R_R_Def_p_sw_q_576_CM 8 0. 2559.9609 FORMAT "%5.2" /end AXIS_DESCR
/end CHARACTERISTIC
/begin CHARACTERISTIC KF_ULVUES "Offset bei Druckueberschwinger" MAP 0xa081897c _REC_MAP_52_UBYTE_u2_s2_s2 99.9984 _CNV_R_R_Def_f_uw_b_555_CM 0. 99.9984
 /begin AXIS_DESCR STD_AXIS Pld_diff_fil _CNV_R_R_Def_p_sw_q_680_CM 8 -2560. 2559.9218 FORMAT "%5.2" /end AXIS_DESCR
 /begin AXIS_DESCR STD_AXIS Pld_diff_grd _CNV_R_R_Def_p_sw_q_680_CM 8 -2560. 2559.9218 FORMAT "%5.2" /end AXIS_DESCR
/end CHARACTERISTIC
/begin CHARACTERISTIC KF_ULVVST "ULV - Regler - Vorsteuerung" MAP 0xa0818af8 _REC_MAP_52_UBYTE_u2_u2_u2 99.9984 _CNV_R_R_Def_f_uw_b_555_CM 0. 99.9984
 /begin AXIS_DESCR STD_AXIS F_pldsvld_f _CNV_R_R_Def_f_sw_b_616_CM 16 0. 3.9999 FORMAT "%14.5" /end AXIS_DESCR
 /begin AXIS_DESCR STD_AXIS Mssolatl_k _CNV_R_R_Def_ms_uw__594_CM 12 0. 2047.9687 /end AXIS_DESCR
/end CHARACTERISTIC
/begin CHARACTERISTIC KF_ULVVST_K "ULV - Vorsteuerung - Offset" MAP 0xa0818cb4 _REC_MAP_52_UBYTE_s2_u2_u2 99.99844999999999 _CNV_R_R_Def_rel_sw_562_CM -100. 99.9969
 /begin AXIS_DESCR STD_AXIS F_pldsvld_f _CNV_R_R_Def_f_sw_b_616_CM 16 0. 3.9999 FORMAT "%14.5" /end AXIS_DESCR
 /begin AXIS_DESCR STD_AXIS Mssolatl_k _CNV_R_R_Def_ms_uw__594_CM 12 0. 2047.9687 /end AXIS_DESCR
/end CHARACTERISTIC
/begin CHARACTERISTIC KF_WGPOS "Wastegate Position - Modell" MAP 0xa0817598 _REC_MAP_52_UBYTE_u2_u2_u2 99.9984 _CNV_R_R_Def_f_uw_b_555_CM 0. 99.9984
 /begin AXIS_DESCR STD_AXIS NO_INPUT_QUANTITY _CNV_R_R_Def_ms_uw__594_CM 14 0. 2047.9687 /end AXIS_DESCR
 /begin AXIS_DESCR STD_AXIS NO_INPUT_QUANTITY _CNV_R_R_Def_f_uw_b_555_CM 10 0. 99.9984 /end AXIS_DESCR
/end CHARACTERISTIC
/begin CHARACTERISTIC KF_WSTG_S "Kennfeld Modell Druckstangenweg der Wastegate-betätigung" MAP 0xa08204e8 _REC_MAP_52_UBYTE_u2_u2_u2 99.9984 _CNV_R_R_Def_f_uw_b_555_CM 0. 99.9984
 /begin AXIS_DESCR STD_AXIS Pwstgtpu _CNV_R_R_Def_f_sw_b_616_CM 8 0. 3.9999 FORMAT "%14.5" /end AXIS_DESCR
 /begin AXIS_DESCR STD_AXIS Prat_turb _CNV_R_R_Def_f_sw_b_616_CM 8 0. 3.9999 FORMAT "%14.5" /end AXIS_DESCR
/end CHARACTERISTIC
/begin CHARACTERISTIC KL_ATLRI_MN "Min. Limit I Anteil" CURVE 0xa08177bc _REC_CUR_TKL_UW_VV__s2_s2 99.99844999999999 _CNV_R_R_Def_rel_sw_562_CM -100. 99.9969
 /begin AXIS_DESCR STD_AXIS Nkw _CNV_R_R_Def_n_sw_q_595_CM 4 -32768. 32767. FORMAT "%5.0" /end AXIS_DESCR
/end CHARACTERISTIC
/begin CHARACTERISTIC KL_ATLRI_MX "Max. Limit I Anteil" CURVE 0xa08177d0 _REC_CUR_TKL_UW_VV__s2_s2 99.99844999999999 _CNV_R_R_Def_rel_sw_562_CM -100. 99.9969
 /begin AXIS_DESCR STD_AXIS Nkw _CNV_R_R_Def_n_sw_q_595_CM 4 -32768. 32767. FORMAT "%5.0" /end AXIS_DESCR
/end CHARACTERISTIC
/begin CHARACTERISTIC KL_ATLR_MX "Max. Limit fuer ATL-Stellwert" CURVE 0xa08177e4 _REC_CUR_TKL_UW_VV__u2_s2 99.9984 _CNV_R_R_Def_f_uw_b_555_CM 0. 99.9984
 /begin AXIS_DESCR STD_AXIS Nkw _CNV_R_R_Def_n_sw_q_595_CM 6 -32768. 32767. FORMAT "%5.0" /end AXIS_DESCR
/end CHARACTERISTIC
/begin CHARACTERISTIC KL_ATLVSTNDYN "Offset auf Vorsteuerung bei Drehzahldynamik" CURVE 0xa0817764 _REC_CUR_TKL_UW_VV__u2_s2 99.9984 _CNV_R_R_Def_f_uw_b_555_CM 0. 99.9984
 /begin AXIS_DESCR STD_AXIS Nkw_dyn2 _CNV_R_R_Def_n_sw_q_595_CM 6 -32768. 32767. FORMAT "%5.0" /end AXIS_DESCR
/end CHARACTERISTIC
/begin CHARACTERISTIC KL_ATLVST_UEB "Ueberblendfaktor bei Start der Ladedruckregelung " CURVE 0xa0817780 _REC_CUR_TKL_UW_VV__u1_u2 0.996 _CNV_R_R_Def_f_ub_b_553_CM 0. 0.996
 /begin AXIS_DESCR STD_AXIS F_psspu _CNV_R_R_Def_f_sw_b_616_CM 6 0. 3.9999 FORMAT "%14.5" /end AXIS_DESCR
/end CHARACTERISTIC
/begin CHARACTERISTIC KL_ATLVST_VLS "Vorsteuerwert bei Volllastschaltung" CURVE 0xa0817718 _REC_CUR_TKL_UW_VV__u2_s2 99.9984 _CNV_R_R_Def_f_uw_b_555_CM 0. 99.9984
 /begin AXIS_DESCR STD_AXIS Nkw _CNV_R_R_Def_n_sw_q_595_CM 6 -32768. 32767. FORMAT "%5.0" /end AXIS_DESCR
/end CHARACTERISTIC
/begin CHARACTERISTIC KL_AUSY_KAT "Druckverlust Kat über Durchfluss" CURVE 0xa0820114 _REC_CUR_TKL_UW_VV__u2_u2 102.398436 _CNV_R_R_Def_p_sw_q_576_CM 0. 2559.9609 FORMAT "%5.2"
 /begin AXIS_DESCR STD_AXIS NO_INPUT_QUANTITY _CNV_R_R_Def_ms_uw__594_CM 8 0. 2047.9687 /end AXIS_DESCR
/end CHARACTERISTIC
/begin CHARACTERISTIC KL_AUSY_KAT_N "Druckverlust Kat über Drehzahl" CURVE 0xa0820138 _REC_CUR_TKL_UW_VV__u2_s2 102.398436 _CNV_R_R_Def_p_sw_q_576_CM 0. 2559.9609 FORMAT "%5.2"
 /begin AXIS_DESCR STD_AXIS Nkw _CNV_R_R_Def_n_sw_q_595_CM 8 -32768. 32767. FORMAT "%5.0" /end AXIS_DESCR
/end CHARACTERISTIC
/begin CHARACTERISTIC KL_AUSY_TURB "" CURVE 0xa08201a0 _REC_CUR_TKL_UW_VV__u2_u2 0.9999847412109381 _CNV_R_R_Def_f_uw_b_571_CM 0. 0.9999847412109381 FORMAT "%14.5"
 /begin AXIS_DESCR STD_AXIS Prat_turb _CNV_R_R_Def_f_sw_b_616_CM 16 0. 3.9999 FORMAT "%14.5" /end AXIS_DESCR
/end CHARACTERISTIC
/begin CHARACTERISTIC KL_BATTMNG "nicht verwendet 1" CURVE 0xa0824fac _REC_CUR_TKL_UW_VV__S4_S4 0. _CNV_R_R_Def_dez_sl_551_CM -3.e+038 3.e+038 FORMAT "%14.7"
 /begin AXIS_DESCR STD_AXIS NO_INPUT_QUANTITY _CNV_R_R_Def_dez_sl_551_CM 8 -1000000000000. 10000000000000. FORMAT "%14.7" /end AXIS_DESCR
/end CHARACTERISTIC
/begin CHARACTERISTIC KL_DPLLK "Druckverlust ueber Ladeluftkuehler" CURVE 0xa0818510 _REC_CUR_TKL_UW_VV__u2_u2 102.398436 _CNV_R_R_Def_p_sw_q_576_CM 0. 2559.9609 FORMAT "%5.2"
 /begin AXIS_DESCR STD_AXIS Vsllk _CNV_R_R_Def_vs_uw__735_CM 8 0. 1279.9804 FORMAT "%5.2" /end AXIS_DESCR
/end CHARACTERISTIC
/begin CHARACTERISTIC KL_ELSLS "Kennlinie E-Lüfter Strom" CURVE 0xa0822178 _REC_CUR_TKL_UW_VV__u2_u2 99.45 _CNV_R_R_Def_i_uw_q_637_CM 0. 255.
 /begin AXIS_DESCR STD_AXIS Ub _CNV_R_R_Def_u_sb_q_583_CM 3 0. 6173.397 FORMAT "%4.1" /end AXIS_DESCR
/end CHARACTERISTIC
/begin CHARACTERISTIC KL_ELTEMP39 "Temperaturfaktor Elüfter" CURVE 0xa08220e8 _REC_CUR_TKL_UW_VV__u2_s2 102.39842 _CNV_R_R_Def_f_uw_b_626_CM 0. 511.9921
 /begin AXIS_DESCR STD_AXIS Tans _CNV_R_R_Def_t_sw_q_578_CM 6 -3276.8 3276.7 FORMAT "%4.1" /end AXIS_DESCR
/end CHARACTERISTIC
/begin CHARACTERISTIC KL_ELTEMP60 "Temperaturfaktor Elüfter" CURVE 0xa082215c _REC_CUR_TKL_UW_VV__u2_s2 102.39842 _CNV_R_R_Def_f_uw_b_626_CM 0. 511.9921
 /begin AXIS_DESCR STD_AXIS Tans _CNV_R_R_Def_t_sw_q_578_CM 6 -3276.8 3276.7 FORMAT "%4.1" /end AXIS_DESCR
/end CHARACTERISTIC
/begin CHARACTERISTIC KL_ELUB39 "" CURVE 0xa0822144 _REC_CUR_TKL_UW_VV__u2_u2 102.39842 _CNV_R_R_Def_f_uw_b_626_CM 0. 511.9921
 /begin AXIS_DESCR STD_AXIS Ub _CNV_R_R_Def_u_sb_q_583_CM 5 0. 6173.397 FORMAT "%4.1" /end AXIS_DESCR
/end CHARACTERISTIC
/begin CHARACTERISTIC KL_ELUB60 "" CURVE 0xa0822104 _REC_CUR_TKL_UW_VV__u2_u2 102.39842 _CNV_R_R_Def_f_uw_b_626_CM 0. 511.9921
 /begin AXIS_DESCR STD_AXIS Ub _CNV_R_R_Def_u_sb_q_583_CM 5 0. 6173.397 FORMAT "%4.1" /end AXIS_DESCR
/end CHARACTERISTIC
/begin CHARACTERISTIC KL_FATLDYN "Überspülfaktor " CURVE 0xa08184dc _REC_CUR_TKL_UW_VV__u1_s2 0.996 _CNV_R_R_Def_f_ub_b_553_CM 0. 0.996
 /begin AXIS_DESCR STD_AXIS NO_INPUT_QUANTITY _CNV_R_R_Def_p_sw_q_680_CM 4 -2560. 2559.9218 FORMAT "%5.2" /end AXIS_DESCR
/end CHARACTERISTIC
/begin CHARACTERISTIC KL_FATLRD_N "Faktor D-Anteil" CURVE 0xa0817794 _REC_CUR_TKL_UW_VV__u1_s2 1.9921 _CNV_R_R_Def_f_ub_b_613_CM 0. 1.9921
 /begin AXIS_DESCR STD_AXIS Nkw _CNV_R_R_Def_n_sw_q_595_CM 12 -32768. 32767. FORMAT "%5.0" /end AXIS_DESCR
/end CHARACTERISTIC
/begin CHARACTERISTIC KL_FGRPLD "Faktor f. Grundladedruck" CURVE 0xa0818458 _REC_CUR_TKL_UW_VV__u2_s2 1.9999 _CNV_R_R_Def_f_uw_b_590_CM 0. 1.9999 FORMAT "%14.5"
 /begin AXIS_DESCR STD_AXIS Nkw _CNV_R_R_Def_n_sw_q_595_CM 8 -32768. 32767. FORMAT "%5.0" /end AXIS_DESCR
/end CHARACTERISTIC
/begin CHARACTERISTIC KL_FKMSSOLATL "Filterkonstante fuer korr. Sollmassenstrom" CURVE 0xa08182d8 _REC_CUR_TKL_UW_VV__u2_u2 0.9999847412109381 _CNV_R_R_Def_f_uw_b_571_CM 0. 0.9999847412109381 FORMAT "%14.5"
 /begin AXIS_DESCR STD_AXIS NO_INPUT_QUANTITY _CNV_R_R_Def_ms_uw__594_CM 8 0. 2047.9687 /end AXIS_DESCR
/end CHARACTERISTIC
/begin CHARACTERISTIC KL_FKPLDSVLD "Filterkonstante f. Solldruck-Verhältnis" CURVE 0xa0818378 _REC_CUR_TKL_UW_VV__u2_u2 0.9999847412109381 _CNV_R_R_Def_f_uw_b_571_CM 0. 0.9999847412109381 FORMAT "%14.5"
 /begin AXIS_DESCR STD_AXIS Mssolatl_k _CNV_R_R_Def_ms_uw__594_CM 8 0. 2047.9687 /end AXIS_DESCR
/end CHARACTERISTIC
/begin CHARACTERISTIC KL_FKTMOTRAUM "Verzoegerung Luftstrom im Motorraum" CURVE 0xa08184cc _REC_CUR_TKL_UW_VV__u1_u2 0.996 _CNV_R_R_Def_f_ub_b_553_CM 0. 0.996
 /begin AXIS_DESCR STD_AXIS V _CNV_R_R_Def_v_uw_q_726_CM 4 0. 360. FORMAT "%5.0" /end AXIS_DESCR
/end CHARACTERISTIC
/begin CHARACTERISTIC KL_FKWGPOS "Filterkontsante f. Wastegateposition" CURVE 0xa082018c _REC_CUR_TKL_UW_VV__u2_u2 0.9999847412109381 _CNV_R_R_Def_f_uw_b_571_CM 0. 0.9999847412109381 FORMAT "%14.5"
 /begin AXIS_DESCR STD_AXIS Wgpos_ausy _CNV_R_R_Def_f_uw_b_555_CM 4 0. 99.9984 /end AXIS_DESCR
/end CHARACTERISTIC
/begin CHARACTERISTIC KL_FSEG_DPLD "Faktor Korrekturfaktor durch Segment-Einfluß" CURVE 0xa0818534 _REC_CUR_TKL_UW_VV__u1_s2 1.9921 _CNV_R_R_Def_f_ub_b_613_CM 0. 1.9921
 /begin AXIS_DESCR STD_AXIS Nkw _CNV_R_R_Def_n_sw_q_595_CM 8 -32768. 32767. FORMAT "%5.0" /end AXIS_DESCR
/end CHARACTERISTIC
/begin CHARACTERISTIC KL_FTABGD "Gewichtung Lastabhängige Temperatur" CURVE 0xa08183cc _REC_CUR_TKL_UW_VV__u2_s2 0.9999847412109381 _CNV_R_R_Def_f_uw_b_571_CM 0. 0.9999847412109381 FORMAT "%14.5"
 /begin AXIS_DESCR STD_AXIS Tabg_dif _CNV_R_R_Def_t_sw_q_578_CM 6 -3276.8 3276.7 FORMAT "%4.1" /end AXIS_DESCR
/end CHARACTERISTIC
/begin CHARACTERISTIC KL_FTABGD_I "Gewichtung Lastabhängige Temperatur - f. Initalisierung" CURVE 0xa081847c _REC_CUR_TKL_UW_VV__u2_u2 0.9999847412109381 _CNV_R_R_Def_f_uw_b_571_CM 0. 0.9999847412109381 FORMAT "%14.5"
 /begin AXIS_DESCR STD_AXIS Tn_abstellatl _CNV_R_R_Def_tn_uw__664_CM 6 0. 65535. FORMAT "%5.2" /end AXIS_DESCR
/end CHARACTERISTIC
/begin CHARACTERISTIC KL_FTMOTRAUM "Ueberblendfaktor f. modellierte Motorraumtemperatur" CURVE 0xa081843c _REC_CUR_TKL_UW_VV__u1_u2 0.996 _CNV_R_R_Def_f_ub_b_553_CM 0. 0.996
 /begin AXIS_DESCR STD_AXIS V _CNV_R_R_Def_v_uw_q_726_CM 8 0. 360. FORMAT "%5.0" /end AXIS_DESCR
/end CHARACTERISTIC
/begin CHARACTERISTIC KL_FTMOTRAUM_I "Einfluss der Abstelzeit auf lastabhängige Anteil der Motorraumtemperatur" CURVE 0xa0818348 _REC_CUR_TKL_UW_VV__u2_u2 0.9999847412109381 _CNV_R_R_Def_f_uw_b_571_CM 0. 0.9999847412109381 FORMAT "%14.5"
 /begin AXIS_DESCR STD_AXIS Tn_abstellatl _CNV_R_R_Def_tn_uw__664_CM 4 0. 65535. FORMAT "%5.2" /end AXIS_DESCR
/end CHARACTERISTIC
/begin CHARACTERISTIC KL_FTNABSTELL "Faktor Abstellzeit f. Motorraumtemperaturmod. - aus vorherg. Fahrzyklus" CURVE 0xa08183b8 _REC_CUR_TKL_UW_VV__u2_u2 0.9999847412109381 _CNV_R_R_Def_f_uw_b_571_CM 0. 0.9999847412109381 FORMAT "%14.5"
 /begin AXIS_DESCR STD_AXIS Mslui_nv _CNV_R_R_Def_lm_uw__654_CM 4 0. 29.1266 FORMAT "%7.4" /end AXIS_DESCR
/end CHARACTERISTIC
/begin CHARACTERISTIC KL_FTVLD "Ueberblendfaktor f. modelliert Temperatur vor Lader" CURVE 0xa08182fc _REC_CUR_TKL_UW_VV__u1_u2 0.996 _CNV_R_R_Def_f_ub_b_553_CM 0. 0.996 /begin AXIS_DESCR STD_AXIS Msdk _CNV_R_R_Def_ms_uw__594_CM 8 0. 2047.9687 /end AXIS_DESCR /end CHARACTERISTIC
/begin CHARACTERISTIC KL_FTVLD_SQR "Temperatur vor Lader korrigiert" CURVE 0xa08184ec _REC_CUR_TKL_UW_VV__u2_s2 1.9999 _CNV_R_R_Def_f_uw_b_590_CM 0. 1.9999 FORMAT "%14.5"
 /begin AXIS_DESCR STD_AXIS Tvldr _CNV_R_R_Def_t_sw_q_578_CM 8 -3276.8 3276.7 FORMAT "%4.1" /end AXIS_DESCR
/end CHARACTERISTIC
/begin CHARACTERISTIC KL_IABGLMOT "Abgleichstrom Motor" CURVE 0xa0822130 _REC_CUR_TKL_UW_VV__u1_u2 7.9687 _CNV_R_R_Def_f_ub_b_694_CM 0. 7.9687 FORMAT "%5.2"
 /begin AXIS_DESCR STD_AXIS Ub _CNV_R_R_Def_u_sb_q_583_CM 5 0. 6173.397 FORMAT "%4.1" /end AXIS_DESCR
/end CHARACTERISTIC
/begin CHARACTERISTIC KL_IABGLNL "Abgleichstrom Kl. 15" CURVE 0xa0822188 _REC_CUR_TKL_UW_VV__u1_u2 7.9687 _CNV_R_R_Def_f_ub_b_694_CM 0. 7.9687 FORMAT "%5.2"
 /begin AXIS_DESCR STD_AXIS Ub _CNV_R_R_Def_u_sb_q_583_CM 5 0. 6173.397 FORMAT "%4.1" /end AXIS_DESCR
/end CHARACTERISTIC
/begin CHARACTERISTIC KL_IABGLST "Abgleichstrom Start" CURVE 0xa082211c _REC_CUR_TKL_UW_VV__u1_u2 7.9687 _CNV_R_R_Def_f_ub_b_694_CM 0. 7.9687 FORMAT "%5.2"
 /begin AXIS_DESCR STD_AXIS Ub _CNV_R_R_Def_u_sb_q_583_CM 5 0. 6173.397 FORMAT "%4.1" /end AXIS_DESCR
/end CHARACTERISTIC
/begin CHARACTERISTIC KL_IGRDFGEN_MN "Minimale Generatorauslastung fuer iGR-Regler" CURVE 0xa0824efc _REC_CUR_TKL_UW_VV__u1_s2 99.60930000000001 _CNV_R_R_Def_f_ub_b_586_CM 0. 99.60930000000001 FORMAT "%5.2"
 /begin AXIS_DESCR STD_AXIS Nkw _CNV_R_R_Def_n_sw_q_595_CM 3 -32768. 32767. FORMAT "%5.0" /end AXIS_DESCR
/end CHARACTERISTIC
/begin CHARACTERISTIC KL_IGRDSOC_MX "obere Ladungsgrenze IGR" CURVE 0xa0824eb0 _REC_CUR_TKL_UW_VV__s2_s2 99.99844999999999 _CNV_R_R_Def_f_sw_b_570_CM -100. 99.9969
 /begin AXIS_DESCR STD_AXIS T_batt _CNV_R_R_Def_t_sw_q_578_CM 2 -3276.8 3276.7 FORMAT "%4.1" /end AXIS_DESCR
/end CHARACTERISTIC
/begin CHARACTERISTIC KL_IKTMOTRAUM "Integratorkonstante f. Modellierung d.Motorraumtemp. - aufheizen d. Last" CURVE 0xa0818318 _REC_CUR_TKL_UW_VV__u2_u2 0.9999847412109381 _CNV_R_R_Def_f_uw_b_571_CM 0. 0.9999847412109381 FORMAT "%14.5"
 /begin AXIS_DESCR STD_AXIS V _CNV_R_R_Def_v_uw_q_726_CM 6 0. 360. FORMAT "%5.0" /end AXIS_DESCR
/end CHARACTERISTIC
/begin CHARACTERISTIC KL_INVBATTMNG "nicht verwendet 2" CURVE 0xa0824ff0 _REC_CUR_TKL_UW_VV__S4_S4 0. _CNV_R_R_Def_dez_sl_551_CM -3.e+038 3.e+038 FORMAT "%14.7"
 /begin AXIS_DESCR STD_AXIS NO_INPUT_QUANTITY _CNV_R_R_Def_dez_sl_551_CM 8 -1000000000000. 10000000000000. FORMAT "%14.7" /end AXIS_DESCR
/end CHARACTERISTIC
/begin CHARACTERISTIC KL_INVLOG "nicht verwendet 3" CURVE 0xa0824f68 _REC_CUR_TKL_UW_VV__S4_S4 0. _CNV_R_R_Def_dez_sl_551_CM -3.e+038 3.e+038 FORMAT "%14.7"
 /begin AXIS_DESCR STD_AXIS NO_INPUT_QUANTITY _CNV_R_R_Def_dez_sl_551_CM 8 -1000000000000. 10000000000000. FORMAT "%14.7" /end AXIS_DESCR
/end CHARACTERISTIC
/begin CHARACTERISTIC KL_LOG "nicht verwendet 4" CURVE 0xa0825034 _REC_CUR_TKL_UW_VV__S4_S4 0. _CNV_R_R_Def_dez_sl_551_CM -3.e+038 3.e+038 FORMAT "%14.7"
 /begin AXIS_DESCR STD_AXIS NO_INPUT_QUANTITY _CNV_R_R_Def_dez_sl_551_CM 8 -1000000000000. 10000000000000. FORMAT "%14.7" /end AXIS_DESCR
/end CHARACTERISTIC
/begin CHARACTERISTIC KL_PAKOFFS_SPUEL "Offset Abgaskrümmerdruck im Spülbereich" CURVE 0xa08200e8 _REC_CUR_TKL_UW_VV__s2_s2 102.396872 _CNV_R_R_Def_p_sw_q_576_CM 0. 1279.9609 FORMAT "%5.2"
 /begin AXIS_DESCR STD_AXIS Nkw _CNV_R_R_Def_n_sw_q_595_CM 8 -32768. 32767. FORMAT "%5.0" /end AXIS_DESCR
/end CHARACTERISTIC
/begin CHARACTERISTIC KL_PAKOFFS_UK "Offset Abgaskrümmerdruck im unterkritischen Bereich" CURVE 0xa08200a0 _REC_CUR_TKL_UW_VV__s2_s2 102.396872 _CNV_R_R_Def_p_sw_q_576_CM 0. 1279.9609 FORMAT "%5.2"
 /begin AXIS_DESCR STD_AXIS Nkw _CNV_R_R_Def_n_sw_q_595_CM 8 -32768. 32767. FORMAT "%5.0" /end AXIS_DESCR
/end CHARACTERISTIC
/begin CHARACTERISTIC KL_PGRD_PRD "Schwelle für dyn. Umluftbetrieb" CURVE 0xa08183e8 _REC_CUR_TKL_UW_VV__s2_u2 102.396872 _CNV_R_R_Def_p_sw_q_680_CM 0. 2559.9218 FORMAT "%5.2"
 /begin AXIS_DESCR STD_AXIS Pldr_soll _CNV_R_R_Def_p_sw_q_576_CM 4 0. 2559.9609 FORMAT "%5.2" /end AXIS_DESCR
/end CHARACTERISTIC
/begin CHARACTERISTIC KL_PLDPU_VLS "Min. Aufladungsfaktor für Erkennung einer Volllast-Schaltung" CURVE 0xa081839c _REC_CUR_TKL_UW_VV__u2_s2 3.9999 _CNV_R_R_Def_f_sw_b_616_CM 0. 3.9999 FORMAT "%14.5"
 /begin AXIS_DESCR STD_AXIS Nkw _CNV_R_R_Def_n_sw_q_595_CM 6 -32768. 32767. FORMAT "%5.0" /end AXIS_DESCR
/end CHARACTERISTIC
/begin CHARACTERISTIC KL_PUPVLD "Differenzdruck Pu - Pvld" CURVE 0xa08183fc _REC_CUR_TKL_UW_VV__u2_u2 102.398436 _CNV_R_R_Def_p_sw_q_576_CM 0. 2559.9609 FORMAT "%5.2"
 /begin AXIS_DESCR STD_AXIS Vsvld _CNV_R_R_Def_vs_uw__735_CM 8 0. 1279.9804 FORMAT "%5.2" /end AXIS_DESCR
/end CHARACTERISTIC
/begin CHARACTERISTIC KL_PWGGRD_VLS "Min. neg. Pedalwert-Gradient f. Erkennung einer Volllast-Schaltung" CURVE 0xa0818420 _REC_CUR_TKL_UW_VV__s2_s2 0. _CNV_R_R_Def_pwggrd_682_CM -20000. 19999.3896
 /begin AXIS_DESCR STD_AXIS Nkw _CNV_R_R_Def_n_sw_q_595_CM 6 -32768. 32767. FORMAT "%5.0" /end AXIS_DESCR
/end CHARACTERISTIC
/begin CHARACTERISTIC KL_PWG_VLS "Min. Pedalwinkel f. Erkennung einer Volllast-Schaltung" CURVE 0xa0818550 _REC_CUR_TKL_UW_VV__s2_s2 95.99852999999999 _CNV_R_R_Def_wdk_sw_683_CM -800. 799.9755 FORMAT "%5.2"
 /begin AXIS_DESCR STD_AXIS Nkw _CNV_R_R_Def_n_sw_q_595_CM 6 -32768. 32767. FORMAT "%5.0" /end AXIS_DESCR
/end CHARACTERISTIC
/begin CHARACTERISTIC KL_QUALI "nicht verwendet 5" CURVE 0xa0825078 _REC_CUR_TKL_UW_VV__S4_S4 0. _CNV_R_R_Def_dez_sl_551_CM -3.e+038 3.e+038 FORMAT "%14.7"
 /begin AXIS_DESCR STD_AXIS NO_INPUT_QUANTITY _CNV_R_R_Def_dez_sl_551_CM 8 -1000000000000. 10000000000000. FORMAT "%14.7" /end AXIS_DESCR
/end CHARACTERISTIC
/begin CHARACTERISTIC KL_QUALILOG "nicht verwendet 6" CURVE 0xa0824f24 _REC_CUR_TKL_UW_VV__S4_S4 0. _CNV_R_R_Def_dez_sl_551_CM -3.e+038 3.e+038 FORMAT "%14.7"
 /begin AXIS_DESCR STD_AXIS NO_INPUT_QUANTITY _CNV_R_R_Def_dez_sl_551_CM 8 -1000000000000. 10000000000000. FORMAT "%14.7" /end AXIS_DESCR
/end CHARACTERISTIC
/begin CHARACTERISTIC KL_TABG2TABG_WZINV "Wurzel Abgastemperatur" CURVE 0xa0820168 _REC_CUR_TKL_UW_VV__u2_u2 0.4999847412109378 _CNV_R_R_Def_f_uw_b_716_CM 7.62939453125e-006 0.499992370605469 FORMAT "%14.6"
 /begin AXIS_DESCR STD_AXIS NO_INPUT_QUANTITY _CNV_R_R_Def_tkelvi_751_CM 8 0. 6553.5 FORMAT "%4.1" /end AXIS_DESCR
/end CHARACTERISTIC
/begin CHARACTERISTIC KL_TABG_STAT "Abgastemperatur - statisch" CURVE 0xa0818498 _REC_CUR_TKL_UW_VV__s2_u2 131.07 _CNV_R_R_Def_t_sw_q_578_CM -3276.8 3276.7 FORMAT "%4.1"
 /begin AXIS_DESCR STD_AXIS V _CNV_R_R_Def_v_uw_q_726_CM 8 0. 360. FORMAT "%5.0" /end AXIS_DESCR
/end CHARACTERISTIC
/begin CHARACTERISTIC KL_TDATLDYNON "Max. Dauer der Ueberspuelphase" CURVE 0xa081835c _REC_CUR_TKL_UW_VV__u2_u2 98.30250000000001 _CNV_R_R_Def_td_uw__673_CM 0. 655.35 FORMAT "%5.2"
 /begin AXIS_DESCR STD_AXIS NO_INPUT_QUANTITY _CNV_R_R_Def_zw_sw__604_CM 6 0. 6553.5 FORMAT "%4.1" /end AXIS_DESCR
/end CHARACTERISTIC
/begin CHARACTERISTIC KL_TDATLD_MX "Max. Dauer des Überspülens - gültig f. USA-Applikation" CURVE 0xa0818334 _REC_CUR_TKL_UW_VV__u2_s2 98.30250000000001 _CNV_R_R_Def_td_uw__673_CM 0. 655.35 FORMAT "%5.2"
 /begin AXIS_DESCR STD_AXIS Nkw _CNV_R_R_Def_n_sw_q_595_CM 4 -32768. 32767. FORMAT "%5.0" /end AXIS_DESCR
/end CHARACTERISTIC
/begin CHARACTERISTIC KL_TDATLD_ON "Dauer des Überspülens nach erreichen des Sollwertes - gültig f. USA-Applikation" CURVE 0xa08184bc _REC_CUR_TKL_UW_VV__u1_s2 2.55 _CNV_R_R_Def_td_uw__673_CM 0. 2.55 FORMAT "%5.2"
 /begin AXIS_DESCR STD_AXIS Nkw _CNV_R_R_Def_n_sw_q_595_CM 4 -32768. 32767. FORMAT "%5.0" /end AXIS_DESCR
/end CHARACTERISTIC
/begin CHARACTERISTIC KL_TDATLVST_F "Dauer der Vorsteuerungdaempfung bei Uebergang in aufgelad. Betrieb" CURVE 0xa0817750 _REC_CUR_TKL_UW_VV__u2_s2 98.30250000000001 _CNV_R_R_Def_td_uw__673_CM 0. 655.35 FORMAT "%5.2"
 /begin AXIS_DESCR STD_AXIS Nkw _CNV_R_R_Def_n_sw_q_595_CM 4 -32768. 32767. FORMAT "%5.0" /end AXIS_DESCR
/end CHARACTERISTIC
/begin CHARACTERISTIC KL_TSEG "Bestimmung aktuelle Segmentzeit" CURVE 0xa08200c4 _REC_CUR_TKL_UW_VV__u2_s2 0.124998092651367 _CNV_R_R_Def_f_uw_b_719_CM 0. 0.124998092651367 FORMAT "%14.6"
 /begin AXIS_DESCR STD_AXIS Nkw _CNV_R_R_Def_n_sw_q_595_CM 8 -32768. 32767. FORMAT "%5.0" /end AXIS_DESCR
/end CHARACTERISTIC
/begin CHARACTERISTIC KL_TVULV_DN "Ansteuerung ULV - schliessende Richtung" CURVE 0xa08188f4 _REC_CUR_TKL_UW_VV__u2_u2 99.9984 _CNV_R_R_Def_f_uw_b_555_CM 0. 99.9984 /begin AXIS_DESCR STD_AXIS Ulvr _CNV_R_R_Def_f_uw_b_555_CM 8 0. 99.9984 /end AXIS_DESCR /end CHARACTERISTIC
/begin CHARACTERISTIC KL_TVULV_UP "Ansteuerung ULV - oeffnende Richtung" CURVE 0xa0818918 _REC_CUR_TKL_UW_VV__u2_u2 99.9984 _CNV_R_R_Def_f_uw_b_555_CM 0. 99.9984 /begin AXIS_DESCR STD_AXIS Ulvr _CNV_R_R_Def_f_uw_b_555_CM 8 0. 99.9984 /end AXIS_DESCR /end CHARACTERISTIC
/begin CHARACTERISTIC KL_ULVDYN "ULV - Ansteuerung bei Lastdynamik" CURVE 0xa08188d0 _REC_CUR_TKL_UW_VV__u2_u2 99.9984 _CNV_R_R_Def_f_uw_b_555_CM 0. 99.9984
 /begin AXIS_DESCR STD_AXIS Mssolatl_k _CNV_R_R_Def_ms_uw__594_CM 8 0. 2047.9687 /end AXIS_DESCR
/end CHARACTERISTIC
/begin CHARACTERISTIC KL_ULVVST_P "ULV - Vorsteuerung - Druckkorrektur" CURVE 0xa0818ae4 _REC_CUR_TKL_UW_VV__u1_u2 1.9921 _CNV_R_R_Def_f_ub_b_613_CM 0. 1.9921
 /begin AXIS_DESCR STD_AXIS Pu _CNV_R_R_Def_p_sw_q_576_CM 6 0. 2559.9609 FORMAT "%5.2" /end AXIS_DESCR
/end CHARACTERISTIC
/begin CHARACTERISTIC KL_ULVVST_T "ULV - Vortseuerung - Temperaturkorrektur" CURVE 0xa0818ac8 _REC_CUR_TKL_UW_VV__u1_s2 1.9921 _CNV_R_R_Def_f_ub_b_613_CM 0. 1.9921
 /begin AXIS_DESCR STD_AXIS Tvldr _CNV_R_R_Def_t_sw_q_578_CM 8 -3276.8 3276.7 FORMAT "%4.1" /end AXIS_DESCR
/end CHARACTERISTIC
/begin CHARACTERISTIC KL_VLPRIO41 "" CURVE 0xa08259b4 _REC_CUR_TKL_UW_VV__u1_s2 99.45 _CNV_R_R_Def_dez_sl_551_CM 0. 255. FORMAT "%3.0"
 /begin AXIS_DESCR STD_AXIS Tmot _CNV_R_R_Def_t_sw_q_579_CM 4 -327.68 327.67 FORMAT "%5.2" /end AXIS_DESCR
/end CHARACTERISTIC
/begin CHARACTERISTIC KL_VLPRIO42 "" CURVE 0xa08259c4 _REC_CUR_TKL_UW_VV__u1_s2 99.45 _CNV_R_R_Def_dez_sl_551_CM 0. 255. FORMAT "%3.0"
 /begin AXIS_DESCR STD_AXIS Tmot _CNV_R_R_Def_t_sw_q_579_CM 4 -327.68 327.67 FORMAT "%5.2" /end AXIS_DESCR
/end CHARACTERISTIC
/begin CHARACTERISTIC KL_VLPRIO43 "" CURVE 0xa08259d4 _REC_CUR_TKL_UW_VV__u1_s2 99.45 _CNV_R_R_Def_dez_sl_551_CM 0. 255. FORMAT "%3.0"
 /begin AXIS_DESCR STD_AXIS Tmot _CNV_R_R_Def_t_sw_q_579_CM 4 -327.68 327.67 FORMAT "%5.2" /end AXIS_DESCR
/end CHARACTERISTIC
/begin CHARACTERISTIC KL_WGFEDER "zus. Groesse zur WG-Ansteuerung wegen WG-Feder" CURVE 0xa0817574 _REC_CUR_TKL_UW_VV__u2_u2 99.9984 _CNV_R_R_Def_f_uw_b_555_CM 0. 99.9984
 /begin AXIS_DESCR STD_AXIS NO_INPUT_QUANTITY _CNV_R_R_Def_f_uw_b_555_CM 8 0. 99.9984 /end AXIS_DESCR
/end CHARACTERISTIC
/begin CHARACTERISTIC KL_ZKATLVST "Zeitkonstante f. transiente Vorsteuerung" CURVE 0xa0817734 _REC_CUR_TKL_UW_VV__u2_s2 655.35 _CNV_R_R_Def_zk10ms_715_CM 1.e-002 655.36 FORMAT "%7.4"
 /begin AXIS_DESCR STD_AXIS Nkw _CNV_R_R_Def_n_sw_q_595_CM 6 -32768. 32767. FORMAT "%5.0" /end AXIS_DESCR
/end CHARACTERISTIC
/begin CHARACTERISTIC K_ANZAHL_TURBOS "Anzahl Turbolader" VALUE 0xa0820162 _REC_VAL_20_u1 2. _CNV_R_R_Def_dez_sl_551_CM 0. 2. FORMAT "%3.0" /end CHARACTERISTIC
/begin CHARACTERISTIC K_ANZNKWDYN "Anzahl der Delta-Nkw-Werte ueber die fuer Nkw_dyn2 gemittelt werden soll" VALUE 0xa08176e9 _REC_VAL_20_u1 31. _CNV_R_R_Def_dez_sl_551_CM 1. 32. FORMAT "%3.0" /end CHARACTERISTIC
/begin CHARACTERISTIC K_ANZPLDDDYN "Anzahl der Werte d. Regelabweichung ueber die fuer Pld_diff_dyn gemittelt werden soll" VALUE 0xa08182c4 _REC_VAL_20_u1 7. _CNV_R_R_Def_dez_sl_551_CM 1. 8. FORMAT "%3.0" /end CHARACTERISTIC
/begin CHARACTERISTIC K_ANZPLDDGRD "Anzahl der Werte d. Regelabweichunggrad. ueber die fuer Pld_diff_grd gemittelt werden soll" VALUE 0xa08182c5 _REC_VAL_20_u1 7. _CNV_R_R_Def_dez_sl_551_CM 1. 8. FORMAT "%3.0" /end CHARACTERISTIC
/begin CHARACTERISTIC K_ANZPLDSDYN "Anzahl der Delta-Pldr_soll-Werte ueber die fuer Pldrsoll_dyn2 gemittelt werden soll" VALUE 0xa08176ea _REC_VAL_20_u1 7. _CNV_R_R_Def_dez_sl_551_CM 1. 8. FORMAT "%3.0" /end CHARACTERISTIC
/begin CHARACTERISTIC K_APPCO2M2L "Manuelle Vorgabe Battm2l" VALUE 0xa0824e94 _REC_VAL_20_s2 99.99844999999999 _CNV_R_R_Def_f_sw_b_570_CM -100. 99.9969 /end CHARACTERISTIC
/begin CHARACTERISTIC K_ATLRIMX_SCH "I-Anteil Schwelle f. ATL" VALUE 0xa08176f0 _REC_VAL_20_u2 99.9984 _CNV_R_R_Def_f_uw_b_555_CM 0. 99.9984 /end CHARACTERISTIC
/begin CHARACTERISTIC K_ATLR_D "Stellwert D Anteil" VALUE 0xa0817710 _REC_VAL_20_s2 99.99844999999999 _CNV_R_R_Def_rel_sw_562_CM -100. 99.9969 /end CHARACTERISTIC
/begin CHARACTERISTIC K_ATLR_I "Stellwert I Anteil " VALUE 0xa08176fc _REC_VAL_20_s2 99.99844999999999 _CNV_R_R_Def_rel_sw_562_CM -100. 99.9969 /end CHARACTERISTIC
/begin CHARACTERISTIC K_ATLR_MN "Max. Limit fuer ATL-Stellwert" VALUE 0xa0817714 _REC_VAL_20_u2 99.9984 _CNV_R_R_Def_f_uw_b_555_CM 0. 99.9984 /end CHARACTERISTIC
/begin CHARACTERISTIC K_ATLR_MX "Max. Limit fuer ATL-Stellwert" VALUE 0xa0817716 _REC_VAL_20_u2 99.9984 _CNV_R_R_Def_f_uw_b_555_CM 0. 99.9984 /end CHARACTERISTIC
/begin CHARACTERISTIC K_ATLR_P "Stellwert P Anteil " VALUE 0xa08176fa _REC_VAL_20_s2 99.99844999999999 _CNV_R_R_Def_rel_sw_562_CM -100. 99.9969 /end CHARACTERISTIC
/begin CHARACTERISTIC K_ATLVST "ATL-Regler - Vorsteuerung manuell" VALUE 0xa08176f2 _REC_VAL_20_u2 99.9984 _CNV_R_R_Def_f_uw_b_555_CM 0. 99.9984 /end CHARACTERISTIC
/begin CHARACTERISTIC K_ATLVST_DYN "Schwelle Vorsteuerung-Dynamik" VALUE 0xa08176f8 _REC_VAL_20_s2 99.99844999999999 _CNV_R_R_Def_rel_sw_562_CM -100. 99.9969 /end CHARACTERISTIC
/begin CHARACTERISTIC K_ATLVST_KH "ATL-Regler - Vorsteuerung fuer Katheizen" VALUE 0xa08176f4 _REC_VAL_20_u2 99.9984 _CNV_R_R_Def_f_uw_b_555_CM 0. 99.9984 /end CHARACTERISTIC
/begin CHARACTERISTIC K_ATLVST_MN "Min. Obergrenze der Vorsteuerung" VALUE 0xa0817700 _REC_VAL_20_s2 99.99844999999999 _CNV_R_R_Def_rel_sw_562_CM -100. 99.9969 /end CHARACTERISTIC
/begin CHARACTERISTIC K_ATLVST_MX "Max. Untergrenze der Vorsteuerung" VALUE 0xa08176fe _REC_VAL_20_s2 99.99844999999999 _CNV_R_R_Def_rel_sw_562_CM -100. 99.9969 /end CHARACTERISTIC
/begin CHARACTERISTIC K_BANK20MS_ATL "Drehzahlschwelle bankselektive Berechnung im 20ms Raster" VALUE 0xa08176ec _REC_VAL_20_s2 0. _CNV_R_R_Def_n_sw_q_595_CM -32768. 32767. FORMAT "%5.0" /end CHARACTERISTIC
/begin CHARACTERISTIC K_BANK20MS_ATLHYS "Hysterese f. Drehzahlschwelle bankselektive Berechnung im 20ms Raster" VALUE 0xa08176ee _REC_VAL_20_s2 0. _CNV_R_R_Def_n_sw_q_595_CM -32768. 32767. FORMAT "%5.0" /end CHARACTERISTIC
/begin CHARACTERISTIC K_BZE_IMAX "Testwert BZE obere Stromschwelle Auswertung" VALUE 0xa082473d _REC_VAL_20_u1 99.45 _CNV_R_R_Def_i_ub_q_758_CM 0. 255. FORMAT "%5.2" /end CHARACTERISTIC
/begin CHARACTERISTIC K_BZE_IMIN "Testwert BZE untere Stromschwelle Auswertung" VALUE 0xa082473e _REC_VAL_20_u1 99.45 _CNV_R_R_Def_i_ub_q_758_CM 0. 255. FORMAT "%5.2" /end CHARACTERISTIC
/begin CHARACTERISTIC K_BZE_ISTRIG "Testwert BZE Start Stromschwelle" VALUE 0xa082473c _REC_VAL_20_u1 99.45 _CNV_R_R_Def_i_ub_q_758_CM 0. 255. FORMAT "%5.2" /end CHARACTERISTIC
/begin CHARACTERISTIC K_BZE_TSMPL "Testwert BZE Samplingrate" VALUE 0xa082473f _REC_VAL_20_u1 99.45 _CNV_R_R_Def_dez_ub_759_CM 0. 255. FORMAT "%3.0" /end CHARACTERISTIC
/begin CHARACTERISTIC K_C02MSA_OFF "Test Deaktivierung MSA" VALUE 0xa0824ea2 _REC_VAL_20_u1 1. _CNV_R_R_Def_dez_sl_551_CM 0. 1. FORMAT "%3.0" /end CHARACTERISTIC
/begin CHARACTERISTIC K_CRENGOF "" VALUE 0xa08220e0 _REC_VAL_20_u2 81.91875 _CNV_R_R_Def_i_uw_q_637_CM 0. 4095.9375 /end CHARACTERISTIC
/begin CHARACTERISTIC K_CRVVTNOT "Wert vvt_iges bei vvt_es Fehlersignal" VALUE 0xa08220e2 _REC_VAL_20_u2 81.91875 _CNV_R_R_Def_i_uw_q_637_CM 0. 4095.9375 /end CHARACTERISTIC
/begin CHARACTERISTIC K_CRVVTOF "" VALUE 0xa08220e4 _REC_VAL_20_u2 81.91875 _CNV_R_R_Def_i_uw_q_637_CM 0. 4095.9375 /end CHARACTERISTIC
/begin CHARACTERISTIC K_DFRUTYP "DF-Rückschaltungstyp für LLR-Anhebung" VALUE 0xa08222d4 _REC_VAL_20_u1 99.45 _CNV_R_R_Def_dez_sl_551_CM 0. 255. FORMAT "%3.0" /end CHARACTERISTIC
/begin CHARACTERISTIC K_DI1000DT "IBS Parameter" VALUE 0xa0824716 _REC_VAL_20_u1 12.75 _CNV_R_R_Def_td_ub__609_CM 0. 12.75 FORMAT "%5.2" /end CHARACTERISTIC
/begin CHARACTERISTIC K_DI1000STG "IBS Parameter" VALUE 0xa0824714 _REC_VAL_20_u1 20.4 _CNV_R_R_Def_i_uw_q_639_CM 0. 20.4 FORMAT "%5.2" /end CHARACTERISTIC
/begin CHARACTERISTIC K_DI1000TGRZ "IBS Parameter" VALUE 0xa082470b _REC_VAL_20_u1 99.45 _CNV_R_R_Def_td_ub__611_CM 0. 255. FORMAT "%5.2" /end CHARACTERISTIC
/begin CHARACTERISTIC K_DI200DT "IBS Parameter" VALUE 0xa0824715 _REC_VAL_20_u1 12.75 _CNV_R_R_Def_td_ub__609_CM 0. 12.75 FORMAT "%5.2" /end CHARACTERISTIC
/begin CHARACTERISTIC K_DI200STG "IBS Parameter" VALUE 0xa0824713 _REC_VAL_20_u1 5.1 _CNV_R_R_Def_i_sw_q_640_CM 0. 5.1 FORMAT "%5.2" /end CHARACTERISTIC
/begin CHARACTERISTIC K_DIHIGHGRZ "IBS Parameter" VALUE 0xa082470f _REC_VAL_20_u1 20.4 _CNV_R_R_Def_i_uw_q_639_CM 0. 20.4 FORMAT "%5.2" /end CHARACTERISTIC
/begin CHARACTERISTIC K_DILOWGRZ "IBS Parameter" VALUE 0xa082470e _REC_VAL_20_u1 5.1 _CNV_R_R_Def_i_sw_q_640_CM 0. 5.1 FORMAT "%5.2" /end CHARACTERISTIC
/begin CHARACTERISTIC K_DIPL5 "IBS Parameter" VALUE 0xa0824719 _REC_VAL_20_u1 99.45 _CNV_R_R_Def_dez_sl_551_CM 0. 255. FORMAT "%3.0" /end CHARACTERISTIC
/begin CHARACTERISTIC K_DIPL6 "IBS Parameter" VALUE 0xa082471a _REC_VAL_20_u1 99.45 _CNV_R_R_Def_dez_sl_551_CM 0. 255. FORMAT "%3.0" /end CHARACTERISTIC
/begin CHARACTERISTIC K_DIPL7 "IBS Parameter" VALUE 0xa082471b _REC_VAL_20_u1 99.45 _CNV_R_R_Def_dez_sl_551_CM 0. 255. FORMAT "%3.0" /end CHARACTERISTIC
/begin CHARACTERISTIC K_DIPL8 "IBS Parameter" VALUE 0xa082471c _REC_VAL_20_u1 99.45 _CNV_R_R_Def_dez_sl_551_CM 0. 255. FORMAT "%3.0" /end CHARACTERISTIC
/begin CHARACTERISTIC K_DKL15FIL "IBS Parameter" VALUE 0xa0824711 _REC_VAL_20_u1 1.5937 _CNV_R_R_Def_td_ub__761_CM 0. 1.5937 FORMAT "%7.4" /end CHARACTERISTIC
/begin CHARACTERISTIC K_DRFS_DYN "Schwelle Füllungsgradient f. Laderdynamik" VALUE 0xa08182a2 _REC_VAL_20_s2 98.30250000000001 _CNV_R_R_Def_rf_sw__598_CM -327.68 327.67 FORMAT "%7.4" /end CHARACTERISTIC
/begin CHARACTERISTIC K_DRFS_DYNR "Schwelle Füllungsgradient f. Laderdynamik - Rücksetzen" VALUE 0xa08182a4 _REC_VAL_20_s2 98.30250000000001 _CNV_R_R_Def_rf_sw__598_CM -327.68 327.67 FORMAT "%7.4" /end CHARACTERISTIC
/begin CHARACTERISTIC K_DSOCABSAV1 "Obere MSA Abschaltverhinderer Grenze" VALUE 0xa0824e96 _REC_VAL_20_s2 99.99844999999999 _CNV_R_R_Def_f_sw_b_570_CM -100. 99.9969 /end CHARACTERISTIC
/begin CHARACTERISTIC K_DSOCABSAV2 "Untere MSA Abschaltverhinderer Grenze" VALUE 0xa0824e98 _REC_VAL_20_s2 99.99844999999999 _CNV_R_R_Def_f_sw_b_570_CM -100. 99.9969 /end CHARACTERISTIC
/begin CHARACTERISTIC K_DSOCABSEA1 "MSA CC-Meldung Grenze" VALUE 0xa0824e9a _REC_VAL_20_s2 99.99844999999999 _CNV_R_R_Def_f_sw_b_570_CM -100. 99.9969 /end CHARACTERISTIC
/begin CHARACTERISTIC K_DSOCABSEA2 "Untere MSA Einschaltaufvorderer Grenze" VALUE 0xa0824e9c _REC_VAL_20_s2 99.99844999999999 _CNV_R_R_Def_f_sw_b_570_CM -100. 99.9969 /end CHARACTERISTIC
/begin CHARACTERISTIC K_DTMAXGRZI "IBS Parameter" VALUE 0xa082470d _REC_VAL_20_u1 99.45 _CNV_R_R_Def_td_ub__611_CM 0. 255. FORMAT "%5.2" /end CHARACTERISTIC
/begin CHARACTERISTIC K_DUIGRZ "IBS Parameter" VALUE 0xa082470c _REC_VAL_20_u1 5.1 _CNV_R_R_Def_i_sw_q_640_CM 0. 5.1 FORMAT "%5.2" /end CHARACTERISTIC
/begin CHARACTERISTIC K_DUMINTGRZ "IBS Parameter" VALUE 0xa0824710 _REC_VAL_20_u1 12.75 _CNV_R_R_Def_td_ub__609_CM 0. 12.75 FORMAT "%5.2" /end CHARACTERISTIC
/begin CHARACTERISTIC K_DUREFMAX "IBS Parameter" VALUE 0xa0824712 _REC_VAL_20_u1 4.998 _CNV_R_R_Def_u_ub_q_762_CM 0. 4.998 FORMAT "%7.4" /end CHARACTERISTIC
/begin CHARACTERISTIC K_DUREFMINI "IBS Parameter" VALUE 0xa082471d _REC_VAL_20_u1 4.998 _CNV_R_R_Def_u_ub_q_762_CM 0. 4.998 FORMAT "%7.4" /end CHARACTERISTIC
/begin CHARACTERISTIC K_ECOMAXI "Testwert Max. Ruhestromschwelle Ecos" VALUE 0xa0824738 _REC_VAL_20_u1 99.45 _CNV_R_R_Def_i_ub_q_608_CM 0. 255. /end CHARACTERISTIC
/begin CHARACTERISTIC K_ECOMSB "Testwert Ecos Messtartbedingung" VALUE 0xa0824739 _REC_VAL_20_u1 99.45 _CNV_R_R_Def_td_ub__609_CM 0. 255. FORMAT "%5.2" /end CHARACTERISTIC
/begin CHARACTERISTIC K_ECOMZ "Testwert Ecos Dauer Mittelwertmessung" VALUE 0xa082473a _REC_VAL_20_u1 99.45 _CNV_R_R_Def_td_ub__609_CM 0. 255. FORMAT "%5.2" /end CHARACTERISTIC
/begin CHARACTERISTIC K_ECOTIMO "Testwert Ecos Messung Timeout" VALUE 0xa082473b _REC_VAL_20_u1 99.45 _CNV_R_R_Def_td_ub__611_CM 0. 255. FORMAT "%5.2" /end CHARACTERISTIC
/begin CHARACTERISTIC K_ENABSDIBS "kt_ibs enable Kommunikation" VALUE 0xa0824730 _REC_VAL_20_u1 99.45 _CNV_R_R_Def_dez_sl_551_CM 0. 255. FORMAT "%3.0" /end CHARACTERISTIC
/begin CHARACTERISTIC K_ENISOC0 "IBS Parameter" VALUE 0xa08246fc _REC_VAL_20_u1 5.1 _CNV_R_R_Def_i_sw_q_640_CM 0. 5.1 FORMAT "%5.2" /end CHARACTERISTIC
/begin CHARACTERISTIC K_ENUSOC0 "IBS Parameter" VALUE 0xa08246fd _REC_VAL_20_u1 16.32 _CNV_R_R_Def_u_ub_q_763_CM 6. 22.32 FORMAT "%5.2" /end CHARACTERISTIC
/begin CHARACTERISTIC K_ERREPEAT "EBSD Fehler repeat" VALUE 0xa0824732 _REC_VAL_20_u1 99.45 _CNV_R_R_Def_dez_sl_551_CM 0. 255. FORMAT "%3.0" /end CHARACTERISTIC
/begin CHARACTERISTIC K_FATLDGRD "Gradient für Überspülfaktor" VALUE 0xa08182c6 _REC_VAL_20_u1 0.996 _CNV_R_R_Def_f_ub_b_553_CM 0. 0.996 /end CHARACTERISTIC
/begin CHARACTERISTIC K_FATLR_I "Verstaerkungsfaktor I Anteil - manueller Wert" VALUE 0xa0817706 _REC_VAL_20_u2 0.9999 _CNV_R_R_Def_f_uw_b_571_CM 0. 0.9999 FORMAT "%14.5" /end CHARACTERISTIC
/begin CHARACTERISTIC K_FKNKW_DYN "Filterkonstante f. Motordrehzahl-Dynamik" VALUE 0xa08182b8 _REC_VAL_20_u2 0.9999847412109381 _CNV_R_R_Def_f_uw_b_571_CM 0. 0.9999847412109381 FORMAT "%14.5" /end CHARACTERISTIC
/begin CHARACTERISTIC K_FKTVLD "Verzoegerung Massenstrom" VALUE 0xa08182c7 _REC_VAL_20_u1 0.996 _CNV_R_R_Def_f_ub_b_553_CM 0. 0.996 /end CHARACTERISTIC
/begin CHARACTERISTIC K_FKTVULVP "Filterkonstante f. Abschwaechung des Pumpeingriffes" VALUE 0xa08188c4 _REC_VAL_20_u2 0.9999847412109381 _CNV_R_R_Def_f_uw_b_571_CM 0. 0.9999847412109381 FORMAT "%14.5" /end CHARACTERISTIC
/begin CHARACTERISTIC K_GENDFVORHS "Zeitkonstante Filterung DF Vorhersage" VALUE 0xa08222d5 _REC_VAL_20_u1 0.996 _CNV_R_R_Def_f_ub_b_553_CM 0. 0.996 /end CHARACTERISTIC
/begin CHARACTERISTIC K_IABGLMOT "Konstante Abgleichstrom Motor" VALUE 0xa08220d8 _REC_VAL_20_s2 65.535 _CNV_R_R_Def_i_sw_q_641_CM -32.768 32.767 /end CHARACTERISTIC
/begin CHARACTERISTIC K_IABGLNL "Konstante Abgleichstrom Kl. 15" VALUE 0xa08220da _REC_VAL_20_s2 65.535 _CNV_R_R_Def_i_sw_q_641_CM -32.768 32.767 /end CHARACTERISTIC
/begin CHARACTERISTIC K_IABGLST "Konstante Abgleichstrom Start" VALUE 0xa08220dc _REC_VAL_20_s2 65.535 _CNV_R_R_Def_i_sw_q_641_CM -32.768 32.767 /end CHARACTERISTIC
/begin CHARACTERISTIC K_IBSTSTERR "Fehler Testlabel" VALUE 0xa0824734 _REC_VAL_20_u1 99.45 _CNV_R_R_Def_dez_sl_551_CM 0. 255. FORMAT "%3.0" /end CHARACTERISTIC
/begin CHARACTERISTIC K_IBSVERSION "Liste der kompatiblen IBS SW- Versionen" VAL_BLK 0xa0824720 _REC_VAL_2_u1 99.45 _CNV_R_R_Def_dez_sl_551_CM 0. 255. FORMAT "%3.0" NUMBER 16 /end CHARACTERISTIC
/begin CHARACTERISTIC K_IBTEMPMAXI "IBS Parameter" VALUE 0xa082471e _REC_VAL_20_u1 99.45 _CNV_R_R_Def_dez_sl_551_CM 0. 255. FORMAT "%3.0" /end CHARACTERISTIC
/begin CHARACTERISTIC K_IBTEMPMINI "IBS Parameter" VALUE 0xa082471f _REC_VAL_20_u1 99.45 _CNV_R_R_Def_dez_sl_551_CM 0. 255. FORMAT "%3.0" /end CHARACTERISTIC
/begin CHARACTERISTIC K_IBUNPLADEL "Verzögerung bei IBS SW unplausibel" VALUE 0xa0824733 _REC_VAL_20_u1 99.45 _CNV_R_R_Def_dez_sl_551_CM 0. 255. FORMAT "%3.0" /end CHARACTERISTIC
/begin CHARACTERISTIC K_IGENLLRANH "Generatorstromabstand für LL-Anhebung" VALUE 0xa08222d6 _REC_VAL_20_u1 99.06 _CNV_R_R_Def_ql_ub__573_CM 0. 254. /end CHARACTERISTIC
/begin CHARACTERISTIC K_IGRBS "Auswahl Bedingung Schubbit" VALUE 0xa0824f1e _REC_VAL_20_u1 10. _CNV_R_R_Def_dez_sl_551_CM 0. 10. FORMAT "%3.0" /end CHARACTERISTIC
/begin CHARACTERISTIC K_IGRCD_EN "Manuelle Freischaltung iGR" VALUE 0xa0824ea3 _REC_VAL_20_u1 1. _CNV_R_R_Def_dez_sl_551_CM 0. 1. FORMAT "%3.0" /end CHARACTERISTIC
/begin CHARACTERISTIC K_IGRDFGEN_MX "Maximalschwelle DF fuer Batteriestromregelung Generatorstromerhöhung" VALUE 0xa0824eee _REC_VAL_20_u1 99.60930000000001 _CNV_R_R_Def_f_ub_b_586_CM 0. 99.60930000000001 FORMAT "%5.2" /end CHARACTERISTIC
/begin CHARACTERISTIC K_IGRDIAGT_MN "Mindestmesszeit Motor an" VALUE 0xa0824f0c _REC_VAL_20_u2 0. _CNV_R_R_Def_dez_sl_551_CM 0. 65535. FORMAT "%5.0" /end CHARACTERISTIC
/begin CHARACTERISTIC K_IGRDIAG_T1 "Batterietemperaturschwelle" VALUE 0xa0824f08 _REC_VAL_20_s2 131.07 _CNV_R_R_Def_t_sw_q_578_CM -3276.8 3276.7 FORMAT "%4.1" /end CHARACTERISTIC
/begin CHARACTERISTIC K_IGRDIAG_T2 "Saisontemperaturschwelle" VALUE 0xa0824f0a _REC_VAL_20_s2 131.07 _CNV_R_R_Def_t_sw_q_578_CM -3276.8 3276.7 FORMAT "%4.1" /end CHARACTERISTIC
/begin CHARACTERISTIC K_IGRDIAG_TMN "Mindestmesszeit Medium bzw. High" VALUE 0xa0824f0e _REC_VAL_20_u1 99.45 _CNV_R_R_Def_dez_sl_551_CM 0. 255. FORMAT "%3.0" /end CHARACTERISTIC
/begin CHARACTERISTIC K_IGRDIAG_TST "Schrittweite für High/Med-Ago-Zähler" VALUE 0xa0824f0f _REC_VAL_20_u1 99.45 _CNV_R_R_Def_dez_sl_551_CM 0. 255. FORMAT "%3.0" /end CHARACTERISTIC
/begin CHARACTERISTIC K_IGRDSOC_MSA "Ladungsabstand zwischen MSA und IGR" VALUE 0xa0824e9e _REC_VAL_20_s2 99.99844999999999 _CNV_R_R_Def_f_sw_b_570_CM -100. 99.9969 /end CHARACTERISTIC
/begin CHARACTERISTIC K_IGRDSOC_OS "DSoC Abstand für untere iGR-Grenze" VALUE 0xa0824ea0 _REC_VAL_20_s2 99.99844999999999 _CNV_R_R_Def_f_sw_b_570_CM -100. 99.9969 /end CHARACTERISTIC
/begin CHARACTERISTIC K_IGRHIGHEN "Freischaltung High" VALUE 0xa0824ea4 _REC_VAL_20_u1 1. _CNV_R_R_Def_dez_sl_551_CM 0. 1. FORMAT "%3.0" /end CHARACTERISTIC
/begin CHARACTERISTIC K_IGRH_ZYKL "Max-Zahl Vollzyklen mit High" VALUE 0xa0824ea5 _REC_VAL_20_u1 102. _CNV_R_R_Def_td_ub__710_CM 0. 1275. FORMAT "%4.1" /end CHARACTERISTIC
/begin CHARACTERISTIC K_IGRINF_TDFH "TOD Info DF iGR-High" VALUE 0xa0824f10 _REC_VAL_20_u1 25.5 _CNV_R_R_Def_td_ub__574_CM 0. 25.5 FORMAT "%4.1" /end CHARACTERISTIC
/begin CHARACTERISTIC K_IGRINF_TDFL "TOD Info DF iGR-Low" VALUE 0xa0824f11 _REC_VAL_20_u1 25.5 _CNV_R_R_Def_td_ub__574_CM 0. 25.5 FORMAT "%4.1" /end CHARACTERISTIC
/begin CHARACTERISTIC K_IGRINF_TDFM "TOD Info DF iGR-Med" VALUE 0xa0824f12 _REC_VAL_20_u1 25.5 _CNV_R_R_Def_td_ub__574_CM 0. 25.5 FORMAT "%4.1" /end CHARACTERISTIC
/begin CHARACTERISTIC K_IGRINF_TSB "TOD Info BSA" VALUE 0xa0824f13 _REC_VAL_20_u1 25.5 _CNV_R_R_Def_td_ub__574_CM 0. 25.5 FORMAT "%4.1" /end CHARACTERISTIC
/begin CHARACTERISTIC K_IGRLOW_EN "App iGR-Low Applikation freigeschalten" VALUE 0xa0824f1f _REC_VAL_20_u1 1. _CNV_R_R_Def_dez_sl_551_CM 0. 1. FORMAT "%3.0" /end CHARACTERISTIC
/begin CHARACTERISTIC K_IGRMEDEN "Freischaltung Med" VALUE 0xa0824ea6 _REC_VAL_20_u1 1. _CNV_R_R_Def_dez_sl_551_CM 0. 1. FORMAT "%3.0" /end CHARACTERISTIC
/begin CHARACTERISTIC K_IGRM_ZYKL "Max-Zahl Vollzyklen mit Med" VALUE 0xa0824ea7 _REC_VAL_20_u1 102. _CNV_R_R_Def_td_ub__710_CM 0. 1275. FORMAT "%4.1" /end CHARACTERISTIC
/begin CHARACTERISTIC K_IGRNL "Nachlauf iGR Rekuperationsanforderung" VALUE 0xa0824eef _REC_VAL_20_u1 25.5 _CNV_R_R_Def_td_ub__574_CM 0. 25.5 FORMAT "%4.1" /end CHARACTERISTIC
/begin CHARACTERISTIC K_IGRUMAX "Maximalwert Spannungsanforderung iGR" VALUE 0xa0824ef0 _REC_VAL_20_u1 25.5 _CNV_R_R_Def_u_ub_q_631_CM 0. 25.5 FORMAT "%5.2" /end CHARACTERISTIC
/begin CHARACTERISTIC K_IGRUMINMAX "Maximale Spannungsanhebung im IGR-Regler" VALUE 0xa0824ef1 _REC_VAL_20_u1 25.5 _CNV_R_R_Def_u_ub_q_631_CM 0. 25.5 FORMAT "%5.2" /end CHARACTERISTIC
/begin CHARACTERISTIC K_IGRUMN "Minimalwert Spannungsanforderung iGR" VALUE 0xa0824ef2 _REC_VAL_20_u1 25.5 _CNV_R_R_Def_u_ub_q_631_CM 0. 25.5 FORMAT "%5.2" /end CHARACTERISTIC
/begin CHARACTERISTIC K_IGRUMN2 "Angehobene IGR-Mindestspannung" VALUE 0xa0824ef3 _REC_VAL_20_u1 25.5 _CNV_R_R_Def_u_ub_q_631_CM 0. 25.5 FORMAT "%5.2" /end CHARACTERISTIC
/begin CHARACTERISTIC K_IGR_ANT "Gewichtung neue zu alten Werten" VALUE 0xa0824f14 _REC_VAL_20_u1 0.996 _CNV_R_R_Def_f_ub_b_553_CM 0. 0.996 /end CHARACTERISTIC
/begin CHARACTERISTIC K_IGR_DI1 "Schwellwert Abweichung fuer Reglerzeittakt 1" VALUE 0xa0824ee8 _REC_VAL_20_u2 104.856 _CNV_R_R_Def_i_uw_q_642_CM 0. 1310.7 /end CHARACTERISTIC
/begin CHARACTERISTIC K_IGR_DI1DT "Reglerzeittakt 1" VALUE 0xa0824ef4 _REC_VAL_20_u1 25.5 _CNV_R_R_Def_td_ub__574_CM 0. 25.5 FORMAT "%4.1" /end CHARACTERISTIC
/begin CHARACTERISTIC K_IGR_DI2 "Schwellwert Abweichung fuer Reglerzeittakt 2" VALUE 0xa0824eea _REC_VAL_20_u2 104.856 _CNV_R_R_Def_i_uw_q_642_CM 0. 1310.7 /end CHARACTERISTIC
/begin CHARACTERISTIC K_IGR_DI2DT "Reglerzeittakt 2" VALUE 0xa0824ef5 _REC_VAL_20_u1 25.5 _CNV_R_R_Def_td_ub__574_CM 0. 25.5 FORMAT "%4.1" /end CHARACTERISTIC
/begin CHARACTERISTIC K_IGR_ENTPR "Entprellzeit iGR Rekuperationsanforderung" VALUE 0xa0824ef6 _REC_VAL_20_u1 25.5 _CNV_R_R_Def_td_ub__574_CM 0. 25.5 FORMAT "%4.1" /end CHARACTERISTIC
/begin CHARACTERISTIC K_IGR_IHIGH "Sollwert Batteriestrom fuer iGR High (Fahrerpotentialunabhängig)" VALUE 0xa0824ee2 _REC_VAL_20_s2 104.856 _CNV_R_R_Def_i_sw_q_640_CM -655.36 655.34 /end CHARACTERISTIC
/begin CHARACTERISTIC K_IGR_IHIGH2 "Reduzierter Entladestrom High" VALUE 0xa0824ee4 _REC_VAL_20_s2 104.856 _CNV_R_R_Def_i_sw_q_640_CM -655.36 655.34 /end CHARACTERISTIC
/begin CHARACTERISTIC K_IGR_IMED "Sollwert Batteriestrom fuer iGR Medium (Fahrerpotentialunabhängig)" VALUE 0xa0824ee6 _REC_VAL_20_s2 104.856 _CNV_R_R_Def_i_sw_q_640_CM -655.36 655.34 /end CHARACTERISTIC
/begin CHARACTERISTIC K_IGR_MANRAMP "Max U-Delta fuer Aktivierung der Regelung" VALUE 0xa0824ef7 _REC_VAL_20_u1 25.5 _CNV_R_R_Def_u_ub_q_631_CM 0. 25.5 FORMAT "%5.2" /end CHARACTERISTIC
/begin CHARACTERISTIC K_IGR_NKWMN "Mindestmotordrehzahl iGR-Low" VALUE 0xa0824f18 _REC_VAL_20_s2 0. _CNV_R_R_Def_n_sw_q_595_CM -32768. 32767. FORMAT "%5.0" /end CHARACTERISTIC
/begin CHARACTERISTIC K_IGR_OSDI1 "Toleranzschwelle Berechnung Regelzeittakt" VALUE 0xa0824eec _REC_VAL_20_u2 104.856 _CNV_R_R_Def_i_uw_q_642_CM 0. 1310.7 /end CHARACTERISTIC
/begin CHARACTERISTIC K_IGR_TMOTMN "Mindestmotortemperatur iGR-Low" VALUE 0xa0824f1a _REC_VAL_20_s2 98.30250000000001 _CNV_R_R_Def_t_sw_q_579_CM -327.68 327.67 FORMAT "%5.2" /end CHARACTERISTIC
/begin CHARACTERISTIC K_IGR_UDN "Maximale Spannungsrampe iGR (negativ)" VALUE 0xa0824edc _REC_VAL_20_u1 0.498 _CNV_R_R_Def_u_ub_b_721_CM 0. 0.498 FORMAT "%7.4" /end CHARACTERISTIC
/begin CHARACTERISTIC K_IGR_UDP "Maximale Spannungsrampe iGR (positiv)" VALUE 0xa0824edd _REC_VAL_20_u1 0.498 _CNV_R_R_Def_u_ub_b_721_CM 0. 0.498 FORMAT "%7.4" /end CHARACTERISTIC
/begin CHARACTERISTIC K_IGR_UOS "Stoerabstand zu dynamischen BN- Spannungsgrenzen" VALUE 0xa0824ef8 _REC_VAL_20_u1 25.5 _CNV_R_R_Def_u_ub_q_631_CM 0. 25.5 FORMAT "%5.2" /end CHARACTERISTIC
/begin CHARACTERISTIC K_IGR_VMIN "Mindestgeschwindigkeit für  iGR-Low" VALUE 0xa0824f1c _REC_VAL_20_u2 0. _CNV_R_R_Def_v_uw_q_726_CM 0. 65535. FORMAT "%5.0" /end CHARACTERISTIC
/begin CHARACTERISTIC K_IKEINESA "Konstante Strom wenn keine SA" VALUE 0xa08220de _REC_VAL_20_s2 65.535 _CNV_R_R_Def_i_sw_q_641_CM -32.768 32.767 /end CHARACTERISTIC
/begin CHARACTERISTIC K_INFORESET "Resetschalter für gesamtes Array" VALUE 0xa0824f15 _REC_VAL_20_u1 1. _CNV_R_R_Def_dez_sl_551_CM 0. 1. FORMAT "%3.0" /end CHARACTERISTIC
/begin CHARACTERISTIC K_INSPRESET "Defaultwert, Leminfospeicher wird gesetzt falls B_pwf kommt" VALUE 0xa08250c0 _REC_VAL_20_u1 99.45 _CNV_R_R_Def_dez_sl_551_CM 0. 255. FORMAT "%3.0" /end CHARACTERISTIC
/begin CHARACTERISTIC K_ISLEEPGRZ "IBS Parameter" VALUE 0xa082470a _REC_VAL_20_u1 5.1 _CNV_R_R_Def_i_sw_q_640_CM 0. 5.1 FORMAT "%5.2" /end CHARACTERISTIC
/begin CHARACTERISTIC K_ISTARTTRIG "IBS Parameter" VALUE 0xa0824701 _REC_VAL_20_u1 104.448 _CNV_R_R_Def_i_ub_q_758_CM 0. 1305.6 FORMAT "%5.2" /end CHARACTERISTIC
/begin CHARACTERISTIC K_LEMDELAY "Ausblendung Startimpuls" VALUE 0xa08250c1 _REC_VAL_20_u1 25.5 _CNV_R_R_Def_td_ub__574_CM 0. 25.5 FORMAT "%4.1" /end CHARACTERISTIC
/begin CHARACTERISTIC K_LEMDIAGU1 "Spannungsgrenze 1" VALUE 0xa08250c2 _REC_VAL_20_u1 25.5 _CNV_R_R_Def_u_ub_q_631_CM 0. 25.5 FORMAT "%5.2" /end CHARACTERISTIC
/begin CHARACTERISTIC K_LEMDIAGU2 "Spannungsgrenze 2" VALUE 0xa08250c3 _REC_VAL_20_u1 25.5 _CNV_R_R_Def_u_ub_q_631_CM 0. 25.5 FORMAT "%5.2" /end CHARACTERISTIC
/begin CHARACTERISTIC K_LEMDIAGU3 "Spannungsgrenze 3" VALUE 0xa08250c4 _REC_VAL_20_u1 25.5 _CNV_R_R_Def_u_ub_q_631_CM 0. 25.5 FORMAT "%5.2" /end CHARACTERISTIC
/begin CHARACTERISTIC K_LEMDIAGU4 "Spannungsgrenze 4" VALUE 0xa08250c5 _REC_VAL_20_u1 25.5 _CNV_R_R_Def_u_ub_q_631_CM 0. 25.5 FORMAT "%5.2" /end CHARACTERISTIC
/begin CHARACTERISTIC K_LEMDIAGU5 "Spannungsgrenze 5" VALUE 0xa08250c6 _REC_VAL_20_u1 25.5 _CNV_R_R_Def_u_ub_q_631_CM 0. 25.5 FORMAT "%5.2" /end CHARACTERISTIC
/begin CHARACTERISTIC K_LEMDIAGU6 "Spannungsgrenze 6" VALUE 0xa08250c7 _REC_VAL_20_u1 25.5 _CNV_R_R_Def_u_ub_q_631_CM 0. 25.5 FORMAT "%5.2" /end CHARACTERISTIC
/begin CHARACTERISTIC K_LEMDIAGU7 "Spannungsgrenze 7" VALUE 0xa08250c8 _REC_VAL_20_u1 25.5 _CNV_R_R_Def_u_ub_q_631_CM 0. 25.5 FORMAT "%5.2" /end CHARACTERISTIC
/begin CHARACTERISTIC K_LEMRESET "Rücksetzen des Infospeichers bzw setzen auf Defaultwert K_INSPRESET" VALUE 0xa08250c9 _REC_VAL_20_u1 99.45 _CNV_R_R_Def_dez_sl_551_CM 0. 255. FORMAT "%3.0" /end CHARACTERISTIC
/begin CHARACTERISTIC K_LLRABS_DF "DF-Schwelle für LL-Absenkung" VALUE 0xa08222d7 _REC_VAL_20_u1 99.60930000000001 _CNV_R_R_Def_f_ub_b_586_CM 0. 99.60930000000001 FORMAT "%5.2" /end CHARACTERISTIC
/begin CHARACTERISTIC K_LLRANH_DF "DF-Schwelle für LL-Anhebung" VALUE 0xa08222d8 _REC_VAL_20_u1 99.60930000000001 _CNV_R_R_Def_f_ub_b_586_CM 0. 99.60930000000001 FORMAT "%5.2" /end CHARACTERISTIC
/begin CHARACTERISTIC K_MD_ELMOTENTL "" VALUE 0xa0825990 _REC_VAL_20_s2 131.07 _CNV_R_R_Def_m_sw_q_554_CM -3276.8 3276.7 FORMAT "%5.2" /end CHARACTERISTIC
/begin CHARACTERISTIC K_MSA_ZYKL "Max-Zahl Vollzyklen mit MSA" VALUE 0xa0824ea8 _REC_VAL_20_u1 102. _CNV_R_R_Def_td_ub__710_CM 0. 1275. FORMAT "%4.1" /end CHARACTERISTIC
/begin CHARACTERISTIC K_MSKIBSDFP "Bitmaske Generator Fehler-> DFP" VALUE 0xa0822305 _REC_VAL_20_u1 99.45 _CNV_R_R_Def_dez_sl_551_CM 0. 255. FORMAT "%3.0" /end CHARACTERISTIC
/begin CHARACTERISTIC K_MSKIBSDFP2 "" VALUE 0xa0822306 _REC_VAL_20_u1 99.45 _CNV_R_R_Def_dez_sl_551_CM 0. 255. FORMAT "%3.0" /end CHARACTERISTIC
/begin CHARACTERISTIC K_MSKIBSDIAG "Test AK disable Diagnose" VALUE 0xa0822307 _REC_VAL_20_u1 99.45 _CNV_R_R_Def_dez_sl_551_CM 0. 255. FORMAT "%3.0" /end CHARACTERISTIC
/begin CHARACTERISTIC K_MSKIBSERR "" VALUE 0xa0822308 _REC_VAL_20_u1 99.45 _CNV_R_R_Def_dez_sl_551_CM 0. 255. FORMAT "%3.0" /end CHARACTERISTIC
/begin CHARACTERISTIC K_MSKIBSERR2 "" VALUE 0xa0822309 _REC_VAL_20_u1 99.45 _CNV_R_R_Def_dez_sl_551_CM 0. 255. FORMAT "%3.0" /end CHARACTERISTIC
/begin CHARACTERISTIC K_NKWD_MN "Bereich Drehzahl-Dynamik unterer Schwellwert" VALUE 0xa0817708 _REC_VAL_20_s2 0. _CNV_R_R_Def_n_sw_q_595_CM -32768. 32767. FORMAT "%5.0" /end CHARACTERISTIC
/begin CHARACTERISTIC K_NKWD_MX "Bereich Drehzahl-Dynamik oberer Schwellwert" VALUE 0xa081770a _REC_VAL_20_s2 0. _CNV_R_R_Def_n_sw_q_595_CM -32768. 32767. FORMAT "%5.0" /end CHARACTERISTIC
/begin CHARACTERISTIC K_NKWMAX_HS "" VALUE 0xa0825992 _REC_VAL_20_s2 0. _CNV_R_R_Def_n_sw_q_595_CM -32768. 32767. FORMAT "%5.0" /end CHARACTERISTIC
/begin CHARACTERISTIC K_NKWMIN_HY "" VALUE 0xa0825994 _REC_VAL_20_s2 0. _CNV_R_R_Def_n_sw_q_595_CM -32768. 32767. FORMAT "%5.0" /end CHARACTERISTIC
/begin CHARACTERISTIC K_NKWUESP_MX "Max. Drehzahl f. Aktivierung der Ueberspuelphase" VALUE 0xa08182a6 _REC_VAL_20_s2 0. _CNV_R_R_Def_n_sw_q_595_CM -32768. 32767. FORMAT "%5.0" /end CHARACTERISTIC
/begin CHARACTERISTIC K_NTWBGLLGEN "Notlaufwert Leerlaufanhebung bei Generatorfehler" VALUE 0xa08222d9 _REC_VAL_20_u1 1. _CNV_R_R_Def_dez_sl_551_CM 0. 1. FORMAT "%3.0" /end CHARACTERISTIC
/begin CHARACTERISTIC K_PAK_MAN "Manueller Abgaskrümmerdruck" VALUE 0xa0820094 _REC_VAL_20_u2 102.398436 _CNV_R_R_Def_p_sw_q_576_CM 0. 2559.9609 FORMAT "%5.2" /end CHARACTERISTIC
/begin CHARACTERISTIC K_PAK_MX "Maximalwert Abgaskrümmerdruck" VALUE 0xa0820096 _REC_VAL_20_u2 102.398436 _CNV_R_R_Def_p_sw_q_576_CM 0. 2559.9609 FORMAT "%5.2" /end CHARACTERISTIC
/begin CHARACTERISTIC K_PGRD_PRD "Prädiktionsintervall" VALUE 0xa08182c8 _REC_VAL_20_u1 99.45 _CNV_R_R_Def_dez_sl_551_CM 0. 255. FORMAT "%3.0" /end CHARACTERISTIC
/begin CHARACTERISTIC K_PKAT_MAN "Manuelle Abgasgegendruck" VALUE 0xa082010c _REC_VAL_20_u2 102.398436 _CNV_R_R_Def_p_sw_q_576_CM 0. 2559.9609 /end CHARACTERISTIC
/begin CHARACTERISTIC K_PLDDUESP_MN "Min. Regeldifferenz f.  Aktivierung der Ueberspuelphase" VALUE 0xa08182a8 _REC_VAL_20_s2 102.398436 _CNV_R_R_Def_p_sw_q_680_CM -2560. 2559.9218 FORMAT "%5.2" /end CHARACTERISTIC
/begin CHARACTERISTIC K_PLDDUESP_MX "Max. Regeldifferenz f.  Aktivierung der Ueberspuelphase" VALUE 0xa08182aa _REC_VAL_20_s2 102.398436 _CNV_R_R_Def_p_sw_q_680_CM -2560. 2559.9218 FORMAT "%5.2" /end CHARACTERISTIC
/begin CHARACTERISTIC K_PLDRSOLL_MN "Min. Sollladedruckdynamik f. Aktivierung Ueberspuelung" VALUE 0xa08182ac _REC_VAL_20_s2 102.398436 _CNV_R_R_Def_p_sw_q_576_CM -1280. 1279.9609 FORMAT "%5.2" /end CHARACTERISTIC
/begin CHARACTERISTIC K_PLDSATLR "Obergrenze Sollladedruckdynamik f. Ueberdrehzahlschutz" VALUE 0xa0817712 _REC_VAL_20_s2 102.398436 _CNV_R_R_Def_p_sw_q_576_CM -1280. 1279.9609 FORMAT "%5.2" /end CHARACTERISTIC
/begin CHARACTERISTIC K_PLDSD_MN "Bereich Sollladedruck-Dynamik unterer Schwellwert" VALUE 0xa081770c _REC_VAL_20_s2 102.398436 _CNV_R_R_Def_p_sw_q_576_CM -1280. 1279.9609 FORMAT "%5.2" /end CHARACTERISTIC
/begin CHARACTERISTIC K_PLDSD_MX "Bereich Sollladedruck-Dynamik oberer Schwellwert" VALUE 0xa081770e _REC_VAL_20_s2 102.398436 _CNV_R_R_Def_p_sw_q_576_CM -1280. 1279.9609 FORMAT "%5.2" /end CHARACTERISTIC
/begin CHARACTERISTIC K_PLDVST_MN "Min. Obergrenze der Vorsteuerung" VALUE 0xa0817704 _REC_VAL_20_s2 102.398436 _CNV_R_R_Def_p_sw_q_680_CM -2560. 2559.9218 FORMAT "%5.2" /end CHARACTERISTIC
/begin CHARACTERISTIC K_PLDVST_MX "Max. Untergrenze der Vorsteuerung" VALUE 0xa0817702 _REC_VAL_20_s2 102.398436 _CNV_R_R_Def_p_sw_q_680_CM -2560. 2559.9218 FORMAT "%5.2" /end CHARACTERISTIC
/begin CHARACTERISTIC K_PRELLDFAH "Prellzeit für LLR-Anhebung" VALUE 0xa08222da _REC_VAL_20_u1 25.5 _CNV_R_R_Def_td_ub__574_CM 0. 25.5 FORMAT "%4.1" /end CHARACTERISTIC
/begin CHARACTERISTIC K_PRELLDFRF "Prellzeit für LLR-Absenkung" VALUE 0xa08222db _REC_VAL_20_u1 25.5 _CNV_R_R_Def_td_ub__574_CM 0. 25.5 FORMAT "%4.1" /end CHARACTERISTIC
/begin CHARACTERISTIC K_PR_ELMOTENTL "" VALUE 0xa08259b2 _REC_VAL_20_u1 99.45 _CNV_R_R_Def_dez_sl_551_CM 0. 255. FORMAT "%3.0" /end CHARACTERISTIC
/begin CHARACTERISTIC K_PR_IGRDN "Prioritaet iGR Spannungsrampe negativ" VALUE 0xa0824ede _REC_VAL_20_u1 99.45 _CNV_R_R_Def_dez_sl_551_CM 0. 255. FORMAT "%3.0" /end CHARACTERISTIC
/begin CHARACTERISTIC K_PR_IGRDP "Prioritaet iGR Spannungsrampe positiv" VALUE 0xa0824edf _REC_VAL_20_u1 99.45 _CNV_R_R_Def_dez_sl_551_CM 0. 255. FORMAT "%3.0" /end CHARACTERISTIC
/begin CHARACTERISTIC K_PR_IGRLOW "Prioritaet iGR- LOW" VALUE 0xa0824ee0 _REC_VAL_20_u1 99.45 _CNV_R_R_Def_dez_sl_551_CM 0. 255. FORMAT "%3.0" /end CHARACTERISTIC
/begin CHARACTERISTIC K_PR_IGRMH "Prioritaet iGR Medium und High" VALUE 0xa0824ee1 _REC_VAL_20_u1 99.45 _CNV_R_R_Def_dez_sl_551_CM 0. 255. FORMAT "%3.0" /end CHARACTERISTIC
/begin CHARACTERISTIC K_PWG_AFU "" VALUE 0xa0825996 _REC_VAL_20_s2 103.996815 _CNV_R_R_Def_wdk_sw_683_CM 0. 799.9755 FORMAT "%5.2" /end CHARACTERISTIC
/begin CHARACTERISTIC K_PWG_VLS "Min. Pedalwert f. Volllast-Erkennung" VALUE 0xa08182ae _REC_VAL_20_s2 95.99852999999999 _CNV_R_R_Def_wdk_sw_683_CM -800. 799.9755 FORMAT "%5.2" /end CHARACTERISTIC
/begin CHARACTERISTIC K_QUALI_1 "Spannungsqualität Grenzwert 1" VALUE 0xa08250ba _REC_VAL_20_u2 0. _CNV_R_R_Def_dez_sl_551_CM 0. 65535. FORMAT "%5.0" /end CHARACTERISTIC
/begin CHARACTERISTIC K_QUALI_2 "Spannungsqualität Grenzwert 2" VALUE 0xa08250bc _REC_VAL_20_u2 0. _CNV_R_R_Def_dez_sl_551_CM 0. 65535. FORMAT "%5.0" /end CHARACTERISTIC
/begin CHARACTERISTIC K_QUALI_3 "Spannungsqualität Grenzwert 3" VALUE 0xa08250be _REC_VAL_20_u2 0. _CNV_R_R_Def_dez_sl_551_CM 0. 65535. FORMAT "%5.0" /end CHARACTERISTIC
/begin CHARACTERISTIC K_SLEEPWAIT "Verzögerung sleep indication" VALUE 0xa0824737 _REC_VAL_20_u1 99.45 _CNV_R_R_Def_dez_sl_551_CM 0. 255. FORMAT "%3.0" /end CHARACTERISTIC
/begin CHARACTERISTIC K_S_CLERRIBS "IBS Fehlerlöschen schaltbar" VALUE 0xa0824735 _REC_VAL_20_u1 99.45 _CNV_R_R_Def_dez_sl_551_CM 0. 255. FORMAT "%3.0" /end CHARACTERISTIC
/begin CHARACTERISTIC K_T1SCHWELLE "IBS Parameter" VALUE 0xa0824707 _REC_VAL_20_u1 10.2 _CNV_R_R_Def_i_ub_q_770_CM 0. 10.2 FORMAT "%5.2" /end CHARACTERISTIC
/begin CHARACTERISTIC K_T1SOC0 "IBS Parameter" VALUE 0xa08246fe _REC_VAL_20_u1 0. _CNV_R_R_Def_td_ub__771_CM 0. 65280. FORMAT "%5.2" /end CHARACTERISTIC
/begin CHARACTERISTIC K_T2SCHWELLE "IBS Parameter" VALUE 0xa0824708 _REC_VAL_20_u1 10.2 _CNV_R_R_Def_i_ub_q_770_CM 0. 10.2 FORMAT "%5.2" /end CHARACTERISTIC
/begin CHARACTERISTIC K_T2SOC0 "IBS Parameter" VALUE 0xa08246ff _REC_VAL_20_u1 0. _CNV_R_R_Def_td_ub__771_CM 0. 65280. FORMAT "%5.2" /end CHARACTERISTIC
/begin CHARACTERISTIC K_T3SCHWELLE "IBS Parameter" VALUE 0xa0824709 _REC_VAL_20_u1 10.2 _CNV_R_R_Def_i_ub_q_770_CM 0. 10.2 FORMAT "%5.2" /end CHARACTERISTIC
/begin CHARACTERISTIC K_T3SOC0 "IBS Parameter" VALUE 0xa0824700 _REC_VAL_20_u1 0. _CNV_R_R_Def_td_ub__771_CM 0. 65280. FORMAT "%5.2" /end CHARACTERISTIC
/begin CHARACTERISTIC K_TABGD_MN "Min.Temperaturdifferenz - Last < stationären Last" VALUE 0xa08182b0 _REC_VAL_20_s2 131.07 _CNV_R_R_Def_t_sw_q_578_CM -3276.8 3276.7 FORMAT "%4.1" /end CHARACTERISTIC
/begin CHARACTERISTIC K_TABGD_MX "Temperaturschwelle - Last > stationären Last" VALUE 0xa08182b2 _REC_VAL_20_s2 131.07 _CNV_R_R_Def_t_sw_q_578_CM -3276.8 3276.7 FORMAT "%4.1" /end CHARACTERISTIC
/begin CHARACTERISTIC K_TABG_MAN "Manuelle Abgastemperatur" VALUE 0xa082015c _REC_VAL_20_u2 131.07 _CNV_R_R_Def_tkelvi_751_CM 0. 6553.5 FORMAT "%4.1" /end CHARACTERISTIC
/begin CHARACTERISTIC K_TDATLDYNAKT "Verzoegerungszeit f. Reaktivierung von B_atldyn" VALUE 0xa08182c9 _REC_VAL_20_u1 2.55 _CNV_R_R_Def_td_uw__673_CM 0. 2.55 FORMAT "%5.2" /end CHARACTERISTIC
/begin CHARACTERISTIC K_TDKUPP_VLS "Max. Reaktionszeit des Kupplungssignals bei Volllast-Schaltung" VALUE 0xa08182ca _REC_VAL_20_u1 2.55 _CNV_R_R_Def_td_uw__673_CM 0. 2.55 FORMAT "%5.2" /end CHARACTERISTIC
/begin CHARACTERISTIC K_TDPWGNULL_VLS "Delay, Pwg = 0 für Vollastschaltung" VALUE 0xa08182cb _REC_VAL_20_u1 2.55 _CNV_R_R_Def_td_uw__673_CM 0. 2.55 FORMAT "%5.2" /end CHARACTERISTIC
/begin CHARACTERISTIC K_TDPWG_VLS "Delay, Pwg für Vollastschaltung" VALUE 0xa08182cc _REC_VAL_20_u1 2.55 _CNV_R_R_Def_td_uw__673_CM 0. 2.55 FORMAT "%5.2" /end CHARACTERISTIC
/begin CHARACTERISTIC K_TDSA_VLS "Max. Reaktionszeit f. aktive Schubabschaltung" VALUE 0xa08182cd _REC_VAL_20_u1 2.55 _CNV_R_R_Def_td_uw__673_CM 0. 2.55 FORMAT "%5.2" /end CHARACTERISTIC
/begin CHARACTERISTIC K_TDULVDYN "Verzögerung f. ULV aktiv bei schnellen Druckabbau" VALUE 0xa08182ce _REC_VAL_20_u1 2.55 _CNV_R_R_Def_td_uw__673_CM 0. 2.55 FORMAT "%5.2" /end CHARACTERISTIC
/begin CHARACTERISTIC K_TDULVDYNR "Dauer f. aktives ULV bei Druckabbau" VALUE 0xa08182cf _REC_VAL_20_u1 2.55 _CNV_R_R_Def_td_uw__673_CM 0. 2.55 FORMAT "%5.2" /end CHARACTERISTIC
/begin CHARACTERISTIC K_TDULVDY_STE "Verzögerung nach Startende f. Druckdynamik Bereitschaft" VALUE 0xa08182d0 _REC_VAL_20_u1 2.55 _CNV_R_R_Def_td_uw__673_CM 0. 2.55 FORMAT "%5.2" /end CHARACTERISTIC
/begin CHARACTERISTIC K_TDVLS_RES "Max. Zeit einer erkannten Volllast-Schaltung" VALUE 0xa08182d1 _REC_VAL_20_u1 2.55 _CNV_R_R_Def_td_uw__673_CM 0. 2.55 FORMAT "%5.2" /end CHARACTERISTIC
/begin CHARACTERISTIC K_TDWGAUF "Verzoegertes oeffnen der Wastegates im Fehlerfall" VALUE 0xa08182ba _REC_VAL_20_u2 98.30250000000001 _CNV_R_R_Def_td_uw__673_CM 0. 655.35 FORMAT "%5.2" /end CHARACTERISTIC
/begin CHARACTERISTIC K_TDZWATLD_OFF "Minimale Dauer des ZW-Spätziehens" VALUE 0xa08182d2 _REC_VAL_20_u1 2.55 _CNV_R_R_Def_td_uw__673_CM 0. 2.55 FORMAT "%5.2" /end CHARACTERISTIC
/begin CHARACTERISTIC K_TD_DELAY1 "" VALUE 0xa082599c _REC_VAL_20_u2 131.07 _CNV_R_R_Def_td_ub__574_CM 0. 6553.5 FORMAT "%4.1" /end CHARACTERISTIC
/begin CHARACTERISTIC K_TD_DELAY2 "" VALUE 0xa082599e _REC_VAL_20_u2 131.07 _CNV_R_R_Def_td_ub__574_CM 0. 6553.5 FORMAT "%4.1" /end CHARACTERISTIC
/begin CHARACTERISTIC K_TD_DELAY3 "" VALUE 0xa08259a0 _REC_VAL_20_u2 131.07 _CNV_R_R_Def_td_ub__574_CM 0. 6553.5 FORMAT "%4.1" /end CHARACTERISTIC
/begin CHARACTERISTIC K_TD_DOWN "" VALUE 0xa08259a2 _REC_VAL_20_u2 131.07 _CNV_R_R_Def_td_ub__574_CM 0. 6553.5 FORMAT "%4.1" /end CHARACTERISTIC
/begin CHARACTERISTIC K_TD_GEAR "" VALUE 0xa08259a4 _REC_VAL_20_u2 0. _CNV_R_R_Def_td_ub__611_CM 0. 65535. FORMAT "%5.0" /end CHARACTERISTIC
/begin CHARACTERISTIC K_TD_HOLD "" VALUE 0xa08259a6 _REC_VAL_20_u2 131.07 _CNV_R_R_Def_td_ub__574_CM 0. 6553.5 FORMAT "%4.1" /end CHARACTERISTIC
/begin CHARACTERISTIC K_TD_HOLDNO "" VALUE 0xa08259a8 _REC_VAL_20_u2 131.07 _CNV_R_R_Def_td_ub__574_CM 0. 6553.5 FORMAT "%4.1" /end CHARACTERISTIC
/begin CHARACTERISTIC K_TD_UP "" VALUE 0xa08259aa _REC_VAL_20_u2 131.07 _CNV_R_R_Def_td_ub__574_CM 0. 6553.5 FORMAT "%4.1" /end CHARACTERISTIC
/begin CHARACTERISTIC K_TMOTUESP_MN "Min. Motortemperatur f. Aktivierung der Ueberspuelphase" VALUE 0xa08182b4 _REC_VAL_20_s2 98.30250000000001 _CNV_R_R_Def_t_sw_q_579_CM -327.68 327.67 FORMAT "%5.2" /end CHARACTERISTIC
/begin CHARACTERISTIC K_TMPCOM_DIV "IBS Parameter" VALUE 0xa0824718 _REC_VAL_20_u1 99.45 _CNV_R_R_Def_dez_sl_551_CM 0. 255. FORMAT "%3.0" /end CHARACTERISTIC
/begin CHARACTERISTIC K_TMPCOM_MUL "IBS Parameter" VALUE 0xa0824717 _REC_VAL_20_u1 99.45 _CNV_R_R_Def_dez_sl_551_CM 0. 255. FORMAT "%3.0" /end CHARACTERISTIC
/begin CHARACTERISTIC K_TNUSTART "IBS Parameter" VALUE 0xa0824702 _REC_VAL_20_u1 3.1875 _CNV_R_R_Def_td_ub__773_CM 0. 3.1875 FORMAT "%5.2" /end CHARACTERISTIC
/begin CHARACTERISTIC K_TNUSTARTFL "IBS Parameter" VALUE 0xa0824703 _REC_VAL_20_u1 0.51 _CNV_R_R_Def_td_ub__774_CM 1.e-002 0.52 /end CHARACTERISTIC
/begin CHARACTERISTIC K_TODPRIO0 "" VALUE 0xa08259ac _REC_VAL_20_u2 131.07 _CNV_R_R_Def_td_ub__574_CM 0. 6553.5 FORMAT "%4.1" /end CHARACTERISTIC
/begin CHARACTERISTIC K_TPT1TICO "IBS Parameter" VALUE 0xa0824740 _REC_VAL_20_u2 98.30250000000001 _CNV_R_R_Def_td_ub__609_CM 0. 3276.75 FORMAT "%5.2" /end CHARACTERISTIC
/begin CHARACTERISTIC K_TSLEEPRUH "IBS Parameter" VALUE 0xa0824706 _REC_VAL_20_u1 81.60000000000001 _CNV_R_R_Def_td_ub__775_CM 0. 4080. FORMAT "%5.2" /end CHARACTERISTIC
/begin CHARACTERISTIC K_TSTECOS "kt_ibs enable Kommunikation" VALUE 0xa0824731 _REC_VAL_20_u1 99.45 _CNV_R_R_Def_dez_sl_551_CM 0. 255. FORMAT "%3.0" /end CHARACTERISTIC
/begin CHARACTERISTIC K_TVLD "Tempertur vor Lader - manuell" VALUE 0xa08182b6 _REC_VAL_20_s2 131.07 _CNV_R_R_Def_t_sw_q_578_CM -3276.8 3276.7 FORMAT "%4.1" /end CHARACTERISTIC
/begin CHARACTERISTIC K_TVULV "ULV Ansteuerung - manuell" VALUE 0xa08188c6 _REC_VAL_20_u2 99.9984 _CNV_R_R_Def_f_uw_b_555_CM 0. 99.9984 /end CHARACTERISTIC
/begin CHARACTERISTIC K_TVULVPUMP1 "Max. zus. ULV Tastverhaeltnis bei Pumpen" VALUE 0xa08188c8 _REC_VAL_20_u2 99.9984 _CNV_R_R_Def_f_uw_b_555_CM 0. 99.9984 /end CHARACTERISTIC
/begin CHARACTERISTIC K_TVULVPUMP2 "Max. zus. ULV Tastverhaeltnis bei Pumpen" VALUE 0xa08188ca _REC_VAL_20_u2 99.9984 _CNV_R_R_Def_f_uw_b_555_CM 0. 99.9984 /end CHARACTERISTIC
/begin CHARACTERISTIC K_TVULVPUMP3 "Minderung Pumpeingriff " VALUE 0xa08188cc _REC_VAL_20_u2 99.9984 _CNV_R_R_Def_f_uw_b_555_CM 0. 99.9984 /end CHARACTERISTIC
/begin CHARACTERISTIC K_T_CLERRIBS "IBS Fehlerlöschen Signaldauer" VALUE 0xa0824736 _REC_VAL_20_u1 99.45 _CNV_R_R_Def_dez_sl_551_CM 0. 255. FORMAT "%3.0" /end CHARACTERISTIC
/begin CHARACTERISTIC K_T_UTIEFSET "IBS Parameter" VALUE 0xa0824705 _REC_VAL_20_u1 99.45 _CNV_R_R_Def_td_ub__611_CM 0. 255. FORMAT "%5.2" /end CHARACTERISTIC
/begin CHARACTERISTIC K_UTIEFAPP "IBS Parameter" VALUE 0xa0824704 _REC_VAL_20_u1 16.32 _CNV_R_R_Def_u_ub_q_763_CM 6. 22.32 FORMAT "%5.2" /end CHARACTERISTIC
/begin CHARACTERISTIC K_VAK_INV "" VALUE 0xa0820098 _REC_VAL_20_u2 7.9998 _CNV_R_R_Def_f_uw_b_572_CM 0. 7.9998 FORMAT "%7.4" /end CHARACTERISTIC
/begin CHARACTERISTIC K_VMAX_HY "Fz-Geschwindigkeit" VALUE 0xa08259ae _REC_VAL_20_u2 0. _CNV_R_R_Def_v_uw_q_726_CM 0. 65535. FORMAT "%5.0" /end CHARACTERISTIC
/begin CHARACTERISTIC K_VMIN_HY "Fz-Geschwindigkeit" VALUE 0xa08259b0 _REC_VAL_20_u2 0. _CNV_R_R_Def_v_uw_q_726_CM 0. 65535. FORMAT "%5.0" /end CHARACTERISTIC
/begin CHARACTERISTIC K_WAFS "" VALUE 0xa0825998 _REC_VAL_20_s2 131.07 _CNV_R_R_Def_w_sw_q_779_CM -3276.8 3276.7 FORMAT "%5.2" /end CHARACTERISTIC
/begin CHARACTERISTIC K_WDAFS "" VALUE 0xa082599a _REC_VAL_20_s2 131.07 _CNV_R_R_Def_w_sw_q_779_CM -3276.8 3276.7 FORMAT "%5.2" /end CHARACTERISTIC
/begin CHARACTERISTIC K_ZKATLVSTDYN "Zeitkonstante f. Erkennung Vorsteuerung-Dynamik" VALUE 0xa08176f6 _REC_VAL_20_u2 655.35 _CNV_R_R_Def_zk10ms_715_CM 1.e-002 655.36 FORMAT "%7.4" /end CHARACTERISTIC
/begin CHARACTERISTIC K_ZKMSVLD_DYN "Zeitkonstante für Massenstrom v. Verdichter" VALUE 0xa08182bc _REC_VAL_20_u2 65.52499999999999 _CNV_R_R_Def_td_uw__663_CM 1.e-002 65.535 /end CHARACTERISTIC
/begin CHARACTERISTIC K_ZKPLDR_DYN "Zeitkonstante für dyn. Ladedrucksollwert" VALUE 0xa08182be _REC_VAL_20_u2 65.52499999999999 _CNV_R_R_Def_td_uw__663_CM 1.e-002 65.535 /end CHARACTERISTIC
/begin CHARACTERISTIC K_ZKPVDK_DYN "Zeitkonstante für Ladedruckistwert" VALUE 0xa08182c0 _REC_VAL_20_u2 65.52499999999999 _CNV_R_R_Def_td_uw__663_CM 1.e-002 65.535 /end CHARACTERISTIC
/begin CHARACTERISTIC K_ZK_TABGAUSYT "Filterkonstante Abgastemperatur" VALUE 0xa082015e _REC_VAL_20_u2 0.9999847412109381 _CNV_R_R_Def_f_uw_b_571_CM 0. 0.9999847412109381 FORMAT "%14.5" /end CHARACTERISTIC
/begin CHARACTERISTIC K_ZK_WSTGS "Filterkonstante für Wastegatebetätigungsweg" VALUE 0xa0820160 _REC_VAL_20_u2 0.9999847412109381 _CNV_R_R_Def_f_uw_b_571_CM 0. 0.9999847412109381 FORMAT "%14.5" /end CHARACTERISTIC
/begin CHARACTERISTIC K_ZUE2BANK "Zuordnung Zündung zu Bank" VAL_BLK 0xa0818634 _REC_VAL_2_u1 1. _CNV_R_R_Def_dez_sl_551_CM 1. 2. FORMAT "%3.0" NUMBER 8 /end CHARACTERISTIC
/begin CHARACTERISTIC K_ZWATLD_MN "Min. Delta ZW-Spätziehung für zeitlich begrenztes Überspülen" VALUE 0xa08182c2 _REC_VAL_20_u2 131.07 _CNV_R_R_Def_zw_sw__604_CM 0. 6553.5 FORMAT "%4.1" /end CHARACTERISTIC
/begin CHARACTERISTIC S_APPCO2IGRON "Manuelles Überschreiben iGR-Verhinderer" VALUE 0xa0824ea9 _REC_VAL_20_u1 1. _CNV_R_R_Def_dez_sl_551_CM 0. 1. FORMAT "%3.0" /end CHARACTERISTIC
/begin CHARACTERISTIC S_APPCO2M2L "Manuelles Setzen Battm2l" VALUE 0xa0824eaa _REC_VAL_20_u1 1. _CNV_R_R_Def_dez_sl_551_CM 0. 1. FORMAT "%3.0" /end CHARACTERISTIC
/begin CHARACTERISTIC S_APPCO2MSA "Testschalter MSA aktiv" VALUE 0xa0824eab _REC_VAL_20_u1 1. _CNV_R_R_Def_dez_sl_551_CM 0. 1. FORMAT "%3.0" /end CHARACTERISTIC
/begin CHARACTERISTIC S_ATLDYN_ON "Überspuelphase manuell aktivieren" VALUE 0xa08182d3 _REC_VAL_20_u1 1. _CNV_R_R_Def_dez_sl_551_CM 0. 1. FORMAT "%3.0" /end CHARACTERISTIC
/begin CHARACTERISTIC S_ATLDYN_US "Schalter zeitl. begrenztes Überspülen - gültig für die USA Applikation" VALUE 0xa08182d4 _REC_VAL_20_u1 1. _CNV_R_R_Def_dez_sl_551_CM 0. 1. FORMAT "%3.0" /end CHARACTERISTIC
/begin CHARACTERISTIC S_ATLRD_MAN "D Anteil manuell bestimmt" VALUE 0xa08176e7 _REC_VAL_20_u1 1. _CNV_R_R_Def_dez_sl_551_CM 0. 1. FORMAT "%3.0" /end CHARACTERISTIC
/begin CHARACTERISTIC S_ATLRI_INI "I Anteil zuruecksetzen" VALUE 0xa08176e6 _REC_VAL_20_u1 1. _CNV_R_R_Def_dez_sl_551_CM 0. 1. FORMAT "%3.0" /end CHARACTERISTIC
/begin CHARACTERISTIC S_ATLRI_MAN "I Anteil manuell bestimmt" VALUE 0xa08176e4 _REC_VAL_20_u1 1. _CNV_R_R_Def_dez_sl_551_CM 0. 1. FORMAT "%3.0" /end CHARACTERISTIC
/begin CHARACTERISTIC S_ATLRP_MAN "P Anteil manuell bestimmt" VALUE 0xa08176e3 _REC_VAL_20_u1 1. _CNV_R_R_Def_dez_sl_551_CM 0. 1. FORMAT "%3.0" /end CHARACTERISTIC
/begin CHARACTERISTIC S_ATLVST_MAN "Vorsteuerung manuell einstellbar" VALUE 0xa08176e2 _REC_VAL_20_u1 1. _CNV_R_R_Def_dez_sl_551_CM 0. 1. FORMAT "%3.0" /end CHARACTERISTIC
/begin CHARACTERISTIC S_ATLVST_NKW "Ladedruck Vorsteuerung ohne Hoeheneinfluss" VALUE 0xa08176e8 _REC_VAL_20_u1 1. _CNV_R_R_Def_dez_sl_551_CM 0. 1. FORMAT "%3.0" /end CHARACTERISTIC
/begin CHARACTERISTIC S_AUSY_KAT "Auswahl Druck vor Kat" VALUE 0xa082010f _REC_VAL_20_u1 1. _CNV_R_R_Def_dez_sl_551_CM 0. 1. FORMAT "%3.0" /end CHARACTERISTIC
/begin CHARACTERISTIC S_BSDKOORD "" VALUE 0xa0822304 _REC_VAL_20_u1 1. _CNV_R_R_Def_dez_sl_551_CM 0. 1. FORMAT "%3.0" /end CHARACTERISTIC
/begin CHARACTERISTIC S_ELMOTENTL "" VALUE 0xa08259b3 _REC_VAL_20_u1 1. _CNV_R_R_Def_dez_sl_551_CM 0. 1. FORMAT "%3.0" /end CHARACTERISTIC
/begin CHARACTERISTIC S_FATLRI_MAN "Verstaerkung I Anteil manuell bestimmt" VALUE 0xa08176e5 _REC_VAL_20_u1 1. _CNV_R_R_Def_dez_sl_551_CM 0. 1. FORMAT "%3.0" /end CHARACTERISTIC
/begin CHARACTERISTIC S_HFM_VG2 "Lage des Diagnose-HFM bei Verdichtergruppe 2" VALUE 0xa08182a1 _REC_VAL_20_u1 1. _CNV_R_R_Def_dez_sl_551_CM 0. 1. FORMAT "%3.0" /end CHARACTERISTIC
/begin CHARACTERISTIC S_IGRCD_MAN "Manuelle Freischaltung iGR" VALUE 0xa0824eac _REC_VAL_20_u1 1. _CNV_R_R_Def_dez_sl_551_CM 0. 1. FORMAT "%3.0" /end CHARACTERISTIC
/begin CHARACTERISTIC S_IGRLOW_MAN "Manuelles Freischalten von iGR Low" VALUE 0xa0824f20 _REC_VAL_20_u1 1. _CNV_R_R_Def_dez_sl_551_CM 0. 1. FORMAT "%3.0" /end CHARACTERISTIC
/begin CHARACTERISTIC S_IGRPF_EN "Beruecksichtigung Partikelfilterregeneration => M+H Deaktiviert" VALUE 0xa0824ef9 _REC_VAL_20_u1 1. _CNV_R_R_Def_dez_sl_551_CM 0. 1. FORMAT "%3.0" /end CHARACTERISTIC
/begin CHARACTERISTIC S_MSHFMVLD "Umschaltung auf gemessenen Massenstrom" VALUE 0xa08182d5 _REC_VAL_20_u1 1. _CNV_R_R_Def_dez_sl_551_CM 0. 1. FORMAT "%3.0" /end CHARACTERISTIC
/begin CHARACTERISTIC S_PAK_MAN "Schalter Vorgabe manueller Abgaskrümmerdruck" VALUE 0xa082009b _REC_VAL_20_u1 1. _CNV_R_R_Def_dez_sl_551_CM 0. 1. FORMAT "%3.0" /end CHARACTERISTIC
/begin CHARACTERISTIC S_PKAT_MAN "Auswahl manuelle Druck vor Kat" VALUE 0xa0820110 _REC_VAL_20_u1 1. _CNV_R_R_Def_dez_sl_551_CM 0. 1. FORMAT "%3.0" /end CHARACTERISTIC
/begin CHARACTERISTIC S_PLDDGRD_MW "Gradient der Regelabweichung über Mittelwert-Bildung" VALUE 0xa08182d6 _REC_VAL_20_u1 1. _CNV_R_R_Def_dez_sl_551_CM 0. 1. FORMAT "%3.0" /end CHARACTERISTIC
/begin CHARACTERISTIC S_PSIST_AUSYAK "Schalter Auswahl Saugrohrdrucdk" VALUE 0xa082009c _REC_VAL_20_u1 1. _CNV_R_R_Def_dez_sl_551_CM 0. 1. FORMAT "%3.0" /end CHARACTERISTIC
/begin CHARACTERISTIC S_PUEB_WSTG "Schalter Wastegateansteuerung mit Ladedruck (Üeberdruck)" VALUE 0xa0820163 _REC_VAL_20_u1 1. _CNV_R_R_Def_dez_sl_551_CM 0. 1. FORMAT "%3.0" /end CHARACTERISTIC
/begin CHARACTERISTIC S_TABG_MAN "Schalter manuelle Abgastemperatur" VALUE 0xa0820164 _REC_VAL_20_u1 1. _CNV_R_R_Def_dez_sl_551_CM 0. 1. FORMAT "%3.0" /end CHARACTERISTIC
/begin CHARACTERISTIC S_TVULV_MAN "ULV  Ansteuerung - manuell" VALUE 0xa08188ce _REC_VAL_20_u1 1. _CNV_R_R_Def_dez_sl_551_CM 0. 1. FORMAT "%3.0" /end CHARACTERISTIC
/begin CHARACTERISTIC S_ULVVST_OFF "ULV Vorsteuerung ausschalten" VALUE 0xa0818ac4 _REC_VAL_20_u1 1. _CNV_R_R_Def_dez_sl_551_CM 0. 1. FORMAT "%3.0" /end CHARACTERISTIC
/begin CHARACTERISTIC S_WGPOS_MSZYL "Bestimmung Wastegate-Position ueber Ist-Massenstrom" VALUE 0xa0820165 _REC_VAL_20_u1 1. _CNV_R_R_Def_dez_sl_551_CM 0. 1. FORMAT "%3.0" /end CHARACTERISTIC
/begin COMPU_METHOD _CNV_R_R_Def_dez_sl_551_CM "Def_dez_sl_q1" RAT_FUNC "%6.3" "-" COEFFS 0. 1. 0. 0. 0. 1. /end COMPU_METHOD
/begin COMPU_METHOD _CNV_R_R_Def_f_ub_b_553_CM "Def_f_ub_b1" RAT_FUNC "%6.3" "-" COEFFS 0. 256. 0. 0. 0. 1. /end COMPU_METHOD
/begin COMPU_METHOD _CNV_R_R_Def_m_sw_q_554_CM "Def_m_sw_q0p1" RAT_FUNC "%6.3" "Nm" COEFFS 0. 10. 0. 0. 0. 1. /end COMPU_METHOD
/begin COMPU_METHOD _CNV_R_R_Def_f_uw_b_555_CM "Def_f_uw_b100" RAT_FUNC "%6.3" "%" COEFFS 0. 65536. 0. 0. 0. 100. /end COMPU_METHOD
/begin COMPU_METHOD _CNV_R_R_Def_f_sw_b_556_CM "Def_f_sw_b32" RAT_FUNC "%6.3" "-" COEFFS 0. 32768. 0. 0. 0. 32. /end COMPU_METHOD
/begin COMPU_METHOD _CNV_R_R_Def_f_sw_p_557_CM "Def_f_sw_p0q25" RAT_FUNC "%6.3" "" COEFFS 0. 4. 0. 0. 0. 1. /end COMPU_METHOD
/begin COMPU_METHOD _CNV_R_R_Def_rel_sw_562_CM "Def_rel_sw_b100" RAT_FUNC "%6.3" "%" COEFFS 0. 32768. 0. 0. 0. 100. /end COMPU_METHOD
/begin COMPU_METHOD _CNV_S_2_Def_bit_ub_563_CM "Def_bit_ub_0" TAB_VERB "%6.3" "-" COMPU_TAB_REF _CNV_S_2_Def_bit_ub_563 /end COMPU_METHOD
/begin COMPU_VTAB _CNV_S_2_Def_bit_ub_563 "Def_bit_ub_0" TAB_VERB 2 0 "FALSE" 1 "TRUE" /end COMPU_VTAB
/begin COMPU_METHOD _CNV_R_R_Def_f_sw_b_570_CM "Def_f_sw_b100" RAT_FUNC "%6.3" "-" COEFFS 0. 32768. 0. 0. 0. 100. /end COMPU_METHOD
/begin COMPU_METHOD _CNV_R_R_Def_f_uw_b_571_CM "Def_f_uw_b1" RAT_FUNC "%6.3" "-" COEFFS 0. 65536. 0. 0. 0. 1. /end COMPU_METHOD
/begin COMPU_METHOD _CNV_R_R_Def_f_uw_b_572_CM "Def_f_uw_b8" RAT_FUNC "%6.3" "-" COEFFS 0. 65536. 0. 0. 0. 8. /end COMPU_METHOD
/begin COMPU_METHOD _CNV_R_R_Def_ql_ub__573_CM "Def_ql_ub_q1" RAT_FUNC "%6.3" "" COEFFS 0. 1. 0. 0. 0. 1. /end COMPU_METHOD
/begin COMPU_METHOD _CNV_R_R_Def_td_ub__574_CM "Def_td_ub_q0p1" RAT_FUNC "%6.3" "s" COEFFS 0. 10. 0. 0. 0. 1. /end COMPU_METHOD
/begin COMPU_METHOD _CNV_R_R_Def_p_sw_q_576_CM "Def_p_sw_q0p039" RAT_FUNC "%6.3" "hPa" COEFFS 0. 256. 0. 0. 0. 10. /end COMPU_METHOD
/begin COMPU_METHOD _CNV_R_R_Def_ql_uw__577_CM "Def_ql_uw_q0p0182" RAT_FUNC "%6.3" "Ah" COEFFS 0. 989. 0. 0. 0. 18. /end COMPU_METHOD
/begin COMPU_METHOD _CNV_R_R_Def_t_sw_q_578_CM "Def_t_sw_q0p1" RAT_FUNC "%6.3" "°C" COEFFS 0. 10. 0. 0. 0. 1. /end COMPU_METHOD
/begin COMPU_METHOD _CNV_R_R_Def_t_sw_q_579_CM "Def_t_sw_q0p01" RAT_FUNC "%6.3" "°C" COEFFS 0. 100. 0. 0. 0. 1. /end COMPU_METHOD
/begin COMPU_METHOD _CNV_R_R_Def_u_sb_q_583_CM "Def_u_sb_q0p0942" RAT_FUNC "%6.3" "V" COEFFS 0. 1. 0. 0. 0. 9.420000000000001e-002 /end COMPU_METHOD
/begin COMPU_METHOD _CNV_R_R_Def_f_ub_b_586_CM "Def_f_ub_b100" RAT_FUNC "%6.3" "%" COEFFS 0. 256. 0. 0. 0. 100. /end COMPU_METHOD
/begin COMPU_METHOD _CNV_R_R_Def_f_uw_b_590_CM "Def_f_uw_b2" RAT_FUNC "%6.3" "-" COEFFS 0. 65536. 0. 0. 0. 2. /end COMPU_METHOD
/begin COMPU_METHOD _CNV_R_R_Def_f_sw_b_591_CM "Def_f_sw_b4" RAT_FUNC "%6.3" "-" COEFFS 0. 32768. 0. 0. 0. 4. /end COMPU_METHOD
/begin COMPU_METHOD _CNV_R_R_Def_ms_uw__594_CM "Def_ms_uw_q0p03125" RAT_FUNC "%6.3" "kg/h" COEFFS 0. 32. 0. 0. 0. 1. /end COMPU_METHOD
/begin COMPU_METHOD _CNV_R_R_Def_n_sw_q_595_CM "Def_n_sw_q1p0" RAT_FUNC "%6.3" "Upm" COEFFS 0. 1. 0. 0. 0. 1. /end COMPU_METHOD
/begin COMPU_METHOD _CNV_R_R_Def_ql_uw__597_CM "Def_ql_uw_q0p29127" RAT_FUNC "%6.3" "" COEFFS 0. 103. 0. 0. 0. 30. /end COMPU_METHOD
/begin COMPU_METHOD _CNV_R_R_Def_rf_sw__598_CM "Def_rf_sw_q0p01" RAT_FUNC "%6.3" "%" COEFFS 0. 100. 0. 0. 0. 1. /end COMPU_METHOD
/begin COMPU_METHOD _CNV_R_R_Def_zw_sw__604_CM "Def_zw_sw_q0p1" RAT_FUNC "%6.3" "°" COEFFS 0. 10. 0. 0. 0. 1. /end COMPU_METHOD
/begin COMPU_METHOD _CNV_R_R_Def_i_ub_q_608_CM "Def_i_ub_q0p00125" RAT_FUNC "%6.3" "" COEFFS 0. 800. 0. 0. 0. 1. /end COMPU_METHOD
/begin COMPU_METHOD _CNV_R_R_Def_td_ub__609_CM "Def_td_ub_q0p05" RAT_FUNC "%6.3" "s" COEFFS 0. 20. 0. 0. 0. 1. /end COMPU_METHOD
/begin COMPU_METHOD _CNV_R_R_Def_i_uw_q_610_CM "Def_i_uw_q0p00125" RAT_FUNC "%6.3" "A" COEFFS 0. 800. 0. 0. 0. 1. /end COMPU_METHOD
/begin COMPU_METHOD _CNV_R_R_Def_td_ub__611_CM "Def_td_ub_q1" RAT_FUNC "%6.3" "s" COEFFS 0. 1. 0. 0. 0. 1. /end COMPU_METHOD
/begin COMPU_METHOD _CNV_R_R_Def_f_ub_b_613_CM "Def_f_ub_b2" RAT_FUNC "%6.3" "-" COEFFS 0. 256. 0. 0. 0. 2. /end COMPU_METHOD
/begin COMPU_METHOD _CNV_R_R_Def_f_sw_b_616_CM "Def_f_sw_b2" RAT_FUNC "%6.3" "-" COEFFS 0. 65536. 0. 0. 0. 4. /end COMPU_METHOD
/begin COMPU_METHOD _CNV_R_R_Def_f_sw_b_623_CM "Def_f_sw_b64" RAT_FUNC "%6.3" "-" COEFFS 0. 32768. 0. 0. 0. 64. /end COMPU_METHOD
/begin COMPU_METHOD _CNV_R_R_Def_f_uw_b_626_CM "Def_f_uw_b512" RAT_FUNC "%6.3" "-" COEFFS 0. 65536. 0. 0. 0. 512. /end COMPU_METHOD
/begin COMPU_METHOD _CNV_R_R_Def_i_uw_q_630_CM "Def_i_uw_q0p125" RAT_FUNC "%6.3" "A" COEFFS 0. 8. 0. 0. 0. 1. /end COMPU_METHOD
/begin COMPU_METHOD _CNV_R_R_Def_u_ub_q_631_CM "Def_u_ub_q0p1" RAT_FUNC "%6.3" "V" COEFFS 0. 10. 0. 0. 0. 1. /end COMPU_METHOD
/begin COMPU_METHOD _CNV_R_R_Def_i_uw_q_634_CM "Def_i_uw_q0p08_o200" RAT_FUNC "%6.3" "" COEFFS 0. 25. 5000. 0. 0. 2. /end COMPU_METHOD
/begin COMPU_METHOD _CNV_R_R_Def_i_sw_q_635_CM "Def_i_sw_q1" RAT_FUNC "%6.3" "A" COEFFS 0. 1. 0. 0. 0. 1. /end COMPU_METHOD
/begin COMPU_METHOD _CNV_R_R_Def_i_uw_q_637_CM "Def_i_uw_q0p0635" RAT_FUNC "%6.3" "A" COEFFS 0. 65536. 0. 0. 0. 4096. /end COMPU_METHOD
/begin COMPU_METHOD _CNV_R_R_Def_i_uw_q_639_CM "Def_i_uw_q0p08" RAT_FUNC "%6.3" "A" COEFFS 0. 25. 0. 0. 0. 2. /end COMPU_METHOD
/begin COMPU_METHOD _CNV_R_R_Def_i_sw_q_640_CM "Def_i_sw_q0p02" RAT_FUNC "%6.3" "A" COEFFS 0. 50. 0. 0. 0. 1. /end COMPU_METHOD
/begin COMPU_METHOD _CNV_R_R_Def_i_sw_q_641_CM "Def_i_sw_q0p001" RAT_FUNC "%6.3" "A" COEFFS 0. 1000. 0. 0. 0. 1. /end COMPU_METHOD
/begin COMPU_METHOD _CNV_R_R_Def_i_uw_q_642_CM "Def_i_uw_q0p02" RAT_FUNC "%6.3" "A" COEFFS 0. 1. 0. 0. 0. 2.e-002 /end COMPU_METHOD
/begin COMPU_METHOD _CNV_R_R_Def_i_uw_q_643_CM "Def_i_uw_q0p02_o200" RAT_FUNC "%6.3" "A" COEFFS 0. 50. 10000. 0. 0. 1. /end COMPU_METHOD
/begin COMPU_METHOD _CNV_R_R_Def_lm_uw__654_CM "Def_lm_uw_q0p000444" RAT_FUNC "%6.3" "kg" COEFFS 0. 2250. 0. 0. 0. 1. /end COMPU_METHOD
/begin COMPU_METHOD _CNV_R_R_Def_td_uw__663_CM "Def_td_uw_q0p001" RAT_FUNC "%6.3" "ms" COEFFS 0. 1000. 0. 0. 0. 1. /end COMPU_METHOD
/begin COMPU_METHOD _CNV_R_R_Def_tn_uw__664_CM "Def_tn_uw_q1" RAT_FUNC "%6.3" "min" COEFFS 0. 1. 0. 0. 0. 1. /end COMPU_METHOD
/begin COMPU_METHOD _CNV_R_R_Def_td_uw__673_CM "Def_td_uw_q0p01" RAT_FUNC "%6.3" "s" COEFFS 0. 100. 0. 0. 0. 1. /end COMPU_METHOD
/begin COMPU_METHOD _CNV_R_R_Def_p_sw_q_680_CM "Def_p_sw_q0p078" RAT_FUNC "%6.3" "hPa" COEFFS 0. 256. 0. 0. 0. 20. /end COMPU_METHOD
/begin COMPU_METHOD _CNV_R_R_Def_pwggrd_682_CM "Def_pwggrd_sw_b2500" RAT_FUNC "%6.3" "%/s" COEFFS 0. 4096. 0. 0. 0. 2500. /end COMPU_METHOD
/begin COMPU_METHOD _CNV_R_R_Def_wdk_sw_683_CM "Def_wdk_sw_q0p0244" RAT_FUNC "%6.3" "%" COEFFS 0. 4096. 0. 0. 0. 100. /end COMPU_METHOD
/begin COMPU_METHOD _CNV_R_R_Def_f_ub_b_694_CM "Def_f_ub_b8" RAT_FUNC "%6.3" "-" COEFFS 0. 256. 0. 0. 0. 8. /end COMPU_METHOD
/begin COMPU_METHOD _CNV_R_R_Def_th_uw__699_CM "Def_th_uw_q1" RAT_FUNC "%6.3" "h" COEFFS 0. 1. 0. 0. 0. 1. /end COMPU_METHOD
/begin COMPU_METHOD _CNV_R_R_Def_u_uw_q_700_CM "Def_u_uw_q0p25em3_o6" RAT_FUNC "%6.3" "" COEFFS 0. -4000. 24000. 0. 0. -1. /end COMPU_METHOD
/begin COMPU_METHOD _CNV_R_R_Def_td_ub__710_CM "Def_td_ub_b1280" RAT_FUNC "%6.3" "ms" COEFFS 0. 1. 0. 0. 0. 5. /end COMPU_METHOD
/begin COMPU_METHOD _CNV_R_R_Def_zk10ms_715_CM "Def_zk10ms_uw_b655p36" RAT_FUNC "%6.3" "s" COEFFS 0. 0. 655.36 0. 1. 0. /end COMPU_METHOD
/begin COMPU_METHOD _CNV_R_R_Def_f_uw_b_716_CM "Def_f_uw_b0p5" RAT_FUNC "%6.3" "-" COEFFS 0. 65536. 0. 0. 0. 0.5 /end COMPU_METHOD
/begin COMPU_METHOD _CNV_R_R_Def_f_uw_b_719_CM "Def_f_uw_b0p125" RAT_FUNC "%6.3" "-" COEFFS 0. 65536. 0. 0. 0. 0.125 /end COMPU_METHOD
/begin COMPU_METHOD _CNV_R_R_Def_u_ub_b_721_CM "Def_u_ub_b0p5" RAT_FUNC "%6.3" "V" COEFFS 0. 256. 0. 0. 0. 0.5 /end COMPU_METHOD
/begin COMPU_METHOD _CNV_R_R_Def_v_uw_q_726_CM "Def_v_uw_q1p0" RAT_FUNC "%6.3" "km/h" COEFFS 0. 1. 0. 0. 0. 1. /end COMPU_METHOD
/begin COMPU_METHOD _CNV_R_R_Def_vs_uw__735_CM "Def_vs_uw_b1280" RAT_FUNC "%6.3" "m^3/h" COEFFS 0. 65536. 0. 0. 0. 1280. /end COMPU_METHOD
/begin COMPU_METHOD _CNV_R_R_Def_tkelvi_751_CM "Def_tkelvin_uw_q0p1" RAT_FUNC "%6.3" "K" COEFFS 0. 10. 0. 0. 0. 1. /end COMPU_METHOD
/begin COMPU_METHOD _CNV_R_R_Def_i_ub_q_758_CM "Def_i_ub_q5p12" RAT_FUNC "%6.3" "" COEFFS 0. 25. 0. 0. 0. 128. /end COMPU_METHOD
/begin COMPU_METHOD _CNV_R_R_Def_dez_ub_759_CM "Def_dez_ub_q2" RAT_FUNC "%6.3" "-" COEFFS 0. 1. 0. 0. 0. 2. /end COMPU_METHOD
/begin COMPU_METHOD _CNV_R_R_Def_td_ub__761_CM "Def_td_ub_q0p00625" RAT_FUNC "%6.3" "s" COEFFS 0. 160. 0. 0. 0. 1. /end COMPU_METHOD
/begin COMPU_METHOD _CNV_R_R_Def_u_ub_q_762_CM "Def_u_ub_q0p0196" RAT_FUNC "%6.3" "V" COEFFS 0. 1. 0. 0. 0. 1.96e-002 /end COMPU_METHOD
/begin COMPU_METHOD _CNV_R_R_Def_u_ub_q_763_CM "Def_u_ub_q0p064_o6" RAT_FUNC "%6.3" "V" COEFFS 0. -125. 750. 0. 0. -8. /end COMPU_METHOD
/begin COMPU_METHOD _CNV_R_R_Def_i_ub_q_770_CM "Def_i_ub_q0p04" RAT_FUNC "%6.3" "A" COEFFS 0. 25. 0. 0. 0. 1. /end COMPU_METHOD
/begin COMPU_METHOD _CNV_R_R_Def_td_ub__771_CM "Def_td_ub_q256" RAT_FUNC "%6.3" "s" COEFFS 0. 1. 0. 0. 0. 256. /end COMPU_METHOD
/begin COMPU_METHOD _CNV_R_R_Def_td_ub__773_CM "Def_td_ub_q0p0125" RAT_FUNC "%6.3" "s" COEFFS 0. 80. 0. 0. 0. 1. /end COMPU_METHOD
/begin COMPU_METHOD _CNV_R_R_Def_td_ub__774_CM "Def_td_ub_q0p002_o01" RAT_FUNC "%6.3" "s" COEFFS 0. -1. 1.e-002 0. 0. -2.e-003 /end COMPU_METHOD
/begin COMPU_METHOD _CNV_R_R_Def_td_ub__775_CM "Def_td_ub_q16" RAT_FUNC "%6.3" "s" COEFFS 0. 1. 0. 0. 0. 16. /end COMPU_METHOD
/begin COMPU_METHOD _CNV_R_R_Def_w_sw_q_779_CM "Def_w_sw_q0p1" RAT_FUNC "%6.3" "øKW" COEFFS 0. 10. 0. 0. 0. 1. /end COMPU_METHOD
/begin RECORD_LAYOUT _REC_VAL_20_u1 FNC_VALUES 1 UBYTE COLUMN_DIR DIRECT /end RECORD_LAYOUT
/begin RECORD_LAYOUT _REC_VAL_20_u2 FNC_VALUES 1 UWORD COLUMN_DIR DIRECT /end RECORD_LAYOUT
/begin RECORD_LAYOUT _REC_VAL_20_s2 FNC_VALUES 1 SWORD COLUMN_DIR DIRECT /end RECORD_LAYOUT
/begin RECORD_LAYOUT _REC_MAP_52_u1_s2_s2 NO_AXIS_PTS_X 1 UBYTE NO_AXIS_PTS_Y 2 UBYTE AXIS_PTS_X 3 SWORD INDEX_INCR DIRECT AXIS_PTS_Y 4 SWORD INDEX_INCR DIRECT FNC_VALUES 5 UBYTE COLUMN_DIR DIRECT /end RECORD_LAYOUT
/begin RECORD_LAYOUT _REC_MAP_52_UBYTE_u2_s2_s2 NO_AXIS_PTS_X 1 UBYTE NO_AXIS_PTS_Y 2 UBYTE AXIS_PTS_X 3 SWORD INDEX_INCR DIRECT AXIS_PTS_Y 4 SWORD INDEX_INCR DIRECT FNC_VALUES 5 UWORD COLUMN_DIR DIRECT /end RECORD_LAYOUT
/begin RECORD_LAYOUT _REC_MAP_52_UBYTE_s2_s2_s2 NO_AXIS_PTS_X 1 UBYTE NO_AXIS_PTS_Y 2 UBYTE AXIS_PTS_X 3 SWORD INDEX_INCR DIRECT AXIS_PTS_Y 4 SWORD INDEX_INCR DIRECT FNC_VALUES 5 SWORD COLUMN_DIR DIRECT /end RECORD_LAYOUT
/begin RECORD_LAYOUT _REC_MAP_52_UBYTE_u2_u2_u2 NO_AXIS_PTS_X 1 UBYTE NO_AXIS_PTS_Y 2 UBYTE AXIS_PTS_X 3 UWORD INDEX_INCR DIRECT AXIS_PTS_Y 4 UWORD INDEX_INCR DIRECT FNC_VALUES 5 UWORD COLUMN_DIR DIRECT /end RECORD_LAYOUT
/begin RECORD_LAYOUT _REC_MAP_52_UBYTE_u2_u2_s2 NO_AXIS_PTS_X 1 UBYTE NO_AXIS_PTS_Y 2 UBYTE AXIS_PTS_X 3 UWORD INDEX_INCR DIRECT AXIS_PTS_Y 4 SWORD INDEX_INCR DIRECT FNC_VALUES 5 UWORD COLUMN_DIR DIRECT /end RECORD_LAYOUT
/begin RECORD_LAYOUT _REC_MAP_52_UBYTE_s2_u2_u2 NO_AXIS_PTS_X 1 UBYTE NO_AXIS_PTS_Y 2 UBYTE AXIS_PTS_X 3 UWORD INDEX_INCR DIRECT AXIS_PTS_Y 4 UWORD INDEX_INCR DIRECT FNC_VALUES 5 SWORD COLUMN_DIR DIRECT /end RECORD_LAYOUT
/begin RECORD_LAYOUT _REC_MAP_52_UBYTE_u2_u1_u2 NO_AXIS_PTS_X 1 UBYTE NO_AXIS_PTS_Y 2 UBYTE AXIS_PTS_X 3 UBYTE INDEX_INCR DIRECT AXIS_PTS_Y 4 UWORD INDEX_INCR DIRECT FNC_VALUES 5 UWORD COLUMN_DIR DIRECT /end RECORD_LAYOUT
/begin RECORD_LAYOUT _REC_MAP_52_u1_s2_u2 NO_AXIS_PTS_X 1 UBYTE NO_AXIS_PTS_Y 2 UBYTE AXIS_PTS_X 3 SWORD INDEX_INCR DIRECT AXIS_PTS_Y 4 UWORD INDEX_INCR DIRECT FNC_VALUES 5 UBYTE COLUMN_DIR DIRECT /end RECORD_LAYOUT
/begin RECORD_LAYOUT _REC_MAP_52_u1_u2_u2 NO_AXIS_PTS_X 1 UBYTE NO_AXIS_PTS_Y 2 UBYTE AXIS_PTS_X 3 UWORD INDEX_INCR DIRECT AXIS_PTS_Y 4 UWORD INDEX_INCR DIRECT FNC_VALUES 5 UBYTE COLUMN_DIR DIRECT /end RECORD_LAYOUT
/begin RECORD_LAYOUT _REC_CUR_TKL_UW_VV__u2_u2 NO_AXIS_PTS_X 1 UBYTE RESERVED 2 BYTE AXIS_PTS_X 3 UWORD INDEX_INCR DIRECT FNC_VALUES 4 UWORD COLUMN_DIR DIRECT /end RECORD_LAYOUT
/begin RECORD_LAYOUT _REC_CUR_TKL_UW_VV__u2_s2 NO_AXIS_PTS_X 1 UBYTE RESERVED 2 BYTE AXIS_PTS_X 3 SWORD INDEX_INCR DIRECT FNC_VALUES 4 UWORD COLUMN_DIR DIRECT /end RECORD_LAYOUT
/begin RECORD_LAYOUT _REC_CUR_TKL_UW_VV__u1_s2 NO_AXIS_PTS_X 1 UBYTE RESERVED 2 BYTE AXIS_PTS_X 3 SWORD INDEX_INCR DIRECT FNC_VALUES 4 UBYTE COLUMN_DIR DIRECT /end RECORD_LAYOUT
/begin RECORD_LAYOUT _REC_CUR_TKL_UW_VV__s2_s2 NO_AXIS_PTS_X 1 UBYTE RESERVED 2 BYTE AXIS_PTS_X 3 SWORD INDEX_INCR DIRECT FNC_VALUES 4 SWORD COLUMN_DIR DIRECT /end RECORD_LAYOUT
/begin RECORD_LAYOUT _REC_CUR_TKL_UW_VV__u1_u2 NO_AXIS_PTS_X 1 UBYTE RESERVED 2 BYTE AXIS_PTS_X 3 UWORD INDEX_INCR DIRECT FNC_VALUES 4 UBYTE COLUMN_DIR DIRECT /end RECORD_LAYOUT
/begin RECORD_LAYOUT _REC_CUR_TKL_UW_VV__s2_u2 NO_AXIS_PTS_X 1 UBYTE RESERVED 2 BYTE AXIS_PTS_X 3 UWORD INDEX_INCR DIRECT FNC_VALUES 4 SWORD COLUMN_DIR DIRECT /end RECORD_LAYOUT
/begin RECORD_LAYOUT _REC_CUR_TKL_UW_VV__S4_S4 NO_AXIS_PTS_X 1 UBYTE RESERVED 2 BYTE AXIS_PTS_X 3 FLOAT32_IEEE INDEX_INCR DIRECT FNC_VALUES 4 FLOAT32_IEEE COLUMN_DIR DIRECT /end RECORD_LAYOUT
/begin RECORD_LAYOUT _REC_VAL_2_u1 FNC_VALUES 1 UBYTE COLUMN_DIR DIRECT /end RECORD_LAYOUT
/begin FUNCTION ATLREG ""
 /begin DEF_CHARACTERISTIC KF_ATLVST KF_ATLVSTPDYN KF_ATLVST_GD KF_ATLVST_NKW KF_FATLRD KF_FATLR_I KF_FATLR_P KF_WGPOS KL_ATLRI_MN KL_ATLRI_MX KL_ATLR_MX KL_ATLVSTNDYN KL_ATLVST_UEB KL_ATLVST_VLS KL_FATLRD_N KL_TDATLVST_F KL_WGFEDER KL_ZKATLVST K_ANZNKWDYN K_ANZPLDSDYN K_ATLRIMX_SCH K_ATLR_D K_ATLR_I K_ATLR_MN K_ATLR_MX K_ATLR_P K_ATLVST K_ATLVST_DYN K_ATLVST_KH K_ATLVST_MN K_ATLVST_MX K_BANK20MS_ATL K_BANK20MS_ATLHYS K_FATLR_I K_NKWD_MN K_NKWD_MX K_PLDSATLR K_PLDSD_MN K_PLDSD_MX K_PLDVST_MN K_PLDVST_MX K_ZKATLVSTDYN S_ATLRD_MAN S_ATLRI_INI S_ATLRI_MAN S_ATLRP_MAN S_ATLVST_MAN S_ATLVST_NKW S_FATLRI_MAN /end DEF_CHARACTERISTIC
 /begin OUT_MEASUREMENT Atl_bank_20ms Atlr Atlr_i Atlr_mx Atlr_vb_i Atlrd_i Atlri_i Atlri_tmp_i Atlrp_i Atlrpi_i Atlvst Atlvst_basis Atlvst_dyn Atlvst_f Atlvst_gdueb Atlvst_ndyn Atlvst_pdyn Atlvst_tl Atlvst_tmp_k Atlwgfeder B_atlri_init_i Nkw_dyn2 Pldrsoll_dyn2 St_atlreg_intern St_atlreg_intern.B_atl_20ms St_atlreg_intern.B_atlvst_f Wgpos_atlvst /end OUT_MEASUREMENT
 /begin IN_MEASUREMENT F_atlad_i F_pldsvld_f F_psspu Mssol Mssolatl_k Nkw Nkw_dyn Pld_diff_dyn_i Pld_diff_fil_i Pld_diff_grd_i Pld_diff_i Pldr_soll Pldrsoll_dyn Rf_soll St_atldiag_10ms St_atldiag_10ms.B_atl_err St_atldiag_10ms.B_atllekfast St_atldiag_10ms.B_atlr_errmn St_atldiag_10ms.B_atlr_errmx St_atldiag_10ms.B_beratllek St_atlstat St_atlstat.B_atl_bereit St_atlstat.B_atldyn St_atlstat.B_atlr St_atlstat.B_tvld_mod St_atlstat.B_ulvdyn St_atlstat.B_vlschalt St_bgkuppl1 St_bgkuppl1.B_ll St_khaktiv St_khaktiv.B_khaktiv_h St_khaktiv.B_khaktiv_s /end IN_MEASUREMENT
/end FUNCTION
/begin FUNCTION ATLSTAT ""
 /begin DEF_CHARACTERISTIC CW_TVLD KF_FATLDYN KF_FTMOTRAUM KL_DPLLK KL_FATLDYN KL_FGRPLD KL_FKMSSOLATL KL_FKPLDSVLD KL_FKTMOTRAUM KL_FSEG_DPLD KL_FTABGD KL_FTABGD_I KL_FTMOTRAUM KL_FTMOTRAUM_I KL_FTNABSTELL KL_FTVLD KL_FTVLD_SQR KL_IKTMOTRAUM KL_PGRD_PRD KL_PLDPU_VLS KL_PUPVLD KL_PWGGRD_VLS KL_PWG_VLS KL_TABG_STAT KL_TDATLDYNON KL_TDATLD_MX KL_TDATLD_ON K_ANZPLDDDYN K_ANZPLDDGRD K_DRFS_DYN K_DRFS_DYNR K_FATLDGRD K_FKNKW_DYN K_FKTVLD K_NKWUESP_MX K_PGRD_PRD K_PLDDUESP_MN K_PLDDUESP_MX K_PLDRSOLL_MN K_PWG_VLS K_TABGD_MN K_TABGD_MX K_TDATLDYNAKT K_TDKUPP_VLS K_TDPWGNULL_VLS K_TDPWG_VLS K_TDSA_VLS K_TDULVDYN K_TDULVDYNR K_TDULVDY_STE K_TDVLS_RES K_TDWGAUF K_TDZWATLD_OFF K_TMOTUESP_MN K_TVLD K_ZKMSVLD_DYN K_ZKPLDR_DYN K_ZKPVDK_DYN K_ZUE2BANK K_ZWATLD_MN S_ATLDYN_ON S_ATLDYN_US S_HFM_VG2 S_MSHFMVLD S_PLDDGRD_MW /end DEF_CHARACTERISTIC
 /begin OUT_MEASUREMENT Atlstat_bank Dpllk F_atldyn F_atldyn_grd F_pldpu F_pldpu_i F_pldsvld_f F_pvld Mslui_nv Mssolatl_k Msvld Msvld_dyn Msvld_dyn_i Msvld_i Nkw_dyn Pld_dgrd_i Pld_diff Pld_diff_dyn_i Pld_diff_fil Pld_diff_fil_i Pld_diff_grd Pld_diff_grd_i Pld_diff_i Pldr_soll Pldrsoll_dyn Pvdkds_dyn Pvdkds_dyn_i Pvld St_atlstat St_atlstat.B_atl_bereit St_atlstat.B_atldyn St_atlstat.B_atlr St_atlstat.B_tvld_mod St_atlstat.B_ulvdyn St_atlstat.B_vlschalt St_atlstat_intern St_atlstat_intern.B_atldyn_akt St_atlstat_intern.B_init_tmod St_atlstat_intern.B_ldr_dyn Tabg_dif Tmotraum Tmotraum_l Tmotraum_ol Tmotrauml_ini Tn_abstellatl Tn_abstellatl_old Tvld_mod Tvldr Vsllk Vsvld Zw_mw1 Zw_mw2 /end OUT_MEASUREMENT
 /begin IN_MEASUREMENT Ba_subist Ba_subsoll Drf_soll F_pspld_soll F_uesp_aus Msdk Mshfm_f_i Mssol Mszyl_i Nkw Pld_soll Psmxatl Pu Pvdkdsf_i Pwg_grad Rfv_vns St_atldiag_10ms St_atldiag_10ms.B_atl_err St_atldiag_10ms.B_atllekfast St_atldiag_10ms.B_atlr_errmn St_atldiag_10ms.B_atlr_errmx St_atldiag_10ms.B_beratllek St_atlstat.B_atl_bereit St_atlstat.B_atldyn St_atlstat.B_atlr St_atlstat.B_tvld_mod St_atlstat.B_ulvdyn St_atlstat.B_vlschalt St_bgkuppl St_bgkuppl.B_kupp St_bgkuppl.B_kupp1 St_bgkuppl.B_kupp2 St_bgkuppl.B_kupp_ext St_bgkuppl.B_kupp_mod St_bgkuppl1 St_bgkuppl1.B_ll St_pwf St_pwf.B_pwf St_start St_start.B_jumpstart St_start.B_sta St_start.B_start St_start.B_startende St_start.B_wst St_varkat St_varkat.B_varkat Tabg_mw Tans Tmot Var_at Zwstat_vt /end IN_MEASUREMENT
/end FUNCTION
/begin FUNCTION ULVOUT ""
 /begin DEF_CHARACTERISTIC KF_FULVPUMP KF_FULVUES KF_ULVUES KL_TVULV_DN KL_TVULV_UP KL_ULVDYN K_FKTVULVP K_TVULV K_TVULVPUMP1 K_TVULVPUMP2 K_TVULVPUMP3 S_TVULV_MAN /end DEF_CHARACTERISTIC
 /begin OUT_MEASUREMENT Tvulv Tvulvpump Tvulvpump23 /end OUT_MEASUREMENT
 /begin IN_MEASUREMENT Mssolatl_k Mszyl Pld_diff_fil Pld_diff_grd Pldr_soll Pvdkds St_atlpump St_atlpump.B_atlpump1 St_atlpump.B_atlpump2 St_atlpump.B_beratlpump St_atlstat St_atlstat.B_atl_bereit St_atlstat.B_atldyn St_atlstat.B_atlr St_atlstat.B_tvld_mod St_atlstat.B_ulvdyn St_atlstat.B_vlschalt St_pwf St_pwf.B_pwf Ulvr /end IN_MEASUREMENT
/end FUNCTION
/begin FUNCTION ULVREG "" /begin DEF_CHARACTERISTIC KF_ULVVST KF_ULVVST_K KL_ULVVST_P KL_ULVVST_T S_ULVVST_OFF /end DEF_CHARACTERISTIC /begin OUT_MEASUREMENT Ulvr Ulvvst /end OUT_MEASUREMENT /begin IN_MEASUREMENT F_pldsvld_f Mssolatl_k Pu Tvldr /end IN_MEASUREMENT /end FUNCTION
/begin FUNCTION ausy_51_12_1_ "" /begin SUB_FUNCTION AUSY_AK AUSY_KAT AUSY_TURB /end SUB_FUNCTION /end FUNCTION
/begin FUNCTION AUSY_AK ""
 /begin DEF_CHARACTERISTIC CW_MS_AK_MAN KL_PAKOFFS_SPUEL KL_PAKOFFS_UK KL_TSEG K_PAK_MAN K_PAK_MX K_VAK_INV S_PAK_MAN S_PSIST_AUSYAK /end DEF_CHARACTERISTIC
 /begin OUT_MEASUREMENT F_dps2dpms_turb F_vakinv_tabg Mk_ausy Msak_diff Msturb_diff_tseg Pak Pak_diff Pak_diff_2 Pak_diff_tseg Pak_i Pakpn Pakps Pspak Pspn Tseg_sec /end OUT_MEASUREMENT
 /begin IN_MEASUREMENT Mk_soll_h Mshfm_f Mslam Msturb Msturb_diff Mszyl Nkw Pkat Ps Pu Tabg_mw /end IN_MEASUREMENT
/end FUNCTION
/begin FUNCTION AUSY_KAT ""
 /begin DEF_CHARACTERISTIC CW_MS_TURB_MAN KL_AUSY_KAT KL_AUSY_KAT_N K_PKAT_MAN S_AUSY_KAT S_PKAT_MAN /end DEF_CHARACTERISTIC
 /begin OUT_MEASUREMENT Pkat Pkat_rel /end OUT_MEASUREMENT
 /begin IN_MEASUREMENT Mshfm_f Mslam Msturb Nkw Pu /end IN_MEASUREMENT
/end FUNCTION
/begin FUNCTION AUSY_TURB ""
 /begin DEF_CHARACTERISTIC KF_AUSY_TURB KF_AUSY_TURB_DIFF KF_FPWSTGDSE KF_WSTG_S KL_AUSY_TURB KL_FKWGPOS KL_TABG2TABG_WZINV K_ANZAHL_TURBOS K_TABG_MAN K_ZK_TABGAUSYT K_ZK_WSTGS S_PUEB_WSTG S_TABG_MAN S_WGPOS_MSZYL /end DEF_CHARACTERISTIC
 /begin OUT_MEASUREMENT Atlr_oad F_pwstgdse F_tnzyl Msturb Msturb_diff Msturbdiff_tgkor Msturbdiff_ukor Msturbine Mswg Prat_turb Pturb Pwg Pwstgdse Pwstgtpu Tabg2tabg_wzinv Tabg_mw Wgpos_ausy Wstg_s Wstg_s_vf /end OUT_MEASUREMENT
 /begin IN_MEASUREMENT Atlr_zwkor F_atlad Mssol Mszyl Pak Pkat Pu Pvdkds Tabg_bank1 Tabg_bank2 /end IN_MEASUREMENT
/end FUNCTION
/begin FUNCTION pm_30_62_ ""
 /begin SUB_FUNCTION BGCRENG BGLLGEN CO2MNG DIBS ELMOTENTL IGR IGRDIAG IGRSBCALC KT_IBS LEMDIAG LLPMCTRL PMBATTMNG PMBATTREGEN PMDIAG PMPRSVCALC PMSOCCALC PMSOCFIT PMSOCKOR PMSOCSTART PMSPGW PMUBNKOR PMUKOMP PMVERBENTL PMVERBMNG PM_SERVICES QVC QVCH2O QVCQUALI /end SUB_FUNCTION
/end FUNCTION
/begin FUNCTION BGCRENG ""
 /begin DEF_CHARACTERISTIC KF_ELUPWM39 KF_ELUPWM60 KL_ELSLS KL_ELTEMP39 KL_ELTEMP60 KL_ELUB39 KL_ELUB60 KL_IABGLMOT KL_IABGLNL KL_IABGLST K_CRENGOF K_CRVVTNOT K_CRVVTOF K_IABGLMOT K_IABGLNL K_IABGLST K_IKEINESA /end DEF_CHARACTERISTIC
 /begin OUT_MEASUREMENT Fak_ttansel Fak_tubel I_craweng I_elu_vvt I_eluefter I_elupwm I_eluvfzg I_gle I_sls Vvt_ib1_2 Vvt_iges /end OUT_MEASUREMENT
 /begin IN_MEASUREMENT L_pwmout Tans Ub V /end IN_MEASUREMENT
/end FUNCTION
/begin FUNCTION BGLLGEN ""
 /begin DEF_CHARACTERISTIC K_DFRUTYP K_GENDFVORHS K_IGENLLRANH K_LLRABS_DF K_LLRANH_DF K_NTWBGLLGEN K_PRELLDFAH K_PRELLDFRF /end DEF_CHARACTERISTIC
 /begin REF_CHARACTERISTIC K_NSUBU /end REF_CHARACTERISTIC
 /begin OUT_MEASUREMENT Gen_dfvorhs Gen_dfvorhsnofil I_erripol1 I_erripol2 I_erripol3 Ierr_vorhs N_genll N_idlgspec St_bgllgen0 St_bgllgen0.B_hysllrah /end OUT_MEASUREMENT
 /begin IN_MEASUREMENT Dffgen Dfpropval Gen_awnumm Gen_uebsetz I_gen St_bgkuppl1 St_bgkuppl1.B_ll Tchip_diff1 Tchip_diff2 Ub /end IN_MEASUREMENT
/end FUNCTION
/begin FUNCTION CO2MNG ""
 /begin DEF_CHARACTERISTIC KL_IGRDSOC_MX K_APPCO2M2L K_C02MSA_OFF K_DSOCABSAV1 K_DSOCABSAV2 K_DSOCABSEA1 K_DSOCABSEA2 K_IGRCD_EN K_IGRDSOC_MSA K_IGRDSOC_OS K_IGRHIGHEN K_IGRH_ZYKL K_IGRMEDEN K_IGRM_ZYKL K_MSA_ZYKL S_APPCO2IGRON S_APPCO2M2L S_APPCO2MSA S_IGRCD_MAN /end DEF_CHARACTERISTIC
 /begin OUT_MEASUREMENT Dsoc_igrmax Dsoc_igrmin Dsoc_msaav1 Dsoc_msaav2 Dsoc_msaea1 Dsoc_msaea2 Qelad_ges St_co2mng St_co2mng.B_co2_igroff St_co2mng.B_co2_msaoff St_co2mng.B_igrhigh St_co2mng.B_igrmed St_co2mng.B_zykl_igrh St_co2mng.B_zykl_igrm St_co2mng.B_zykl_msaoff St_co2mng_1 St_co2mng_1.B_co2_av St_co2mng_1.B_co2_ea St_co2mng_1.B_co2_eacc St_co2mng_1.B_igr_dsoc St_co2mng_1.B_igrhigh_en St_co2mng_1.B_igrmed_en /end OUT_MEASUREMENT
 /begin IN_MEASUREMENT Batt_m2l C_battnenn D_soc Pminfo1 T_batt /end IN_MEASUREMENT
/end FUNCTION
/begin FUNCTION DIBS ""
 /begin DEF_CHARACTERISTIC K_MSKIBSDFP K_MSKIBSDFP2 K_MSKIBSDIAG K_MSKIBSERR K_MSKIBSERR2 S_BSDKOORD /end DEF_CHARACTERISTIC
 /begin OUT_MEASUREMENT Ibs1_errstat Ibs2_errstat Ibs3_errstat Ibsderrs1 Ibsderrs2 Ibspreco2 St_dibs0 St_dibs0.B_dibloc1 St_dibs0.B_dibloc2 St_dibs1 St_dibs1.B_ifbsak St_dibs1.B_ifebsak St_dibs1.B_ifuplak St_dibs2 St_dibs2.B_ifisak St_dibs2.B_ifsysak St_dibs2.B_iftempak St_dibs2.B_ifusak St_dibs2.B_ifwugdak St_dibs2.B_ifwuplak T_count_dibs1 T_count_dibs2 T_count_dibs3 T_count_dibs4 /end OUT_MEASUREMENT
 /begin IN_MEASUREMENT Comcontrol Ibs_errors St_ibserr St_ibserr.B_ibfbsd St_ibserr.B_ibfebsd St_ibserr.B_ibunplau /end IN_MEASUREMENT
/end FUNCTION
/begin FUNCTION ELMOTENTL ""
 /begin DEF_CHARACTERISTIC KF_PRIO_4 KF_PRIO_HOLD KF_PRIO_NO KF_PRIO_UP KF_RF_AFU KL_VLPRIO41 KL_VLPRIO42 KL_VLPRIO43 K_MD_ELMOTENTL K_NKWMAX_HS K_NKWMIN_HY K_PR_ELMOTENTL K_PWG_AFU K_TD_DELAY1 K_TD_DELAY2 K_TD_DELAY3 K_TD_DOWN K_TD_GEAR K_TD_HOLD K_TD_HOLDNO K_TD_UP K_TODPRIO0 K_VMAX_HY K_VMIN_HY K_WAFS K_WDAFS S_ELMOTENTL /end DEF_CHARACTERISTIC
 /begin OUT_MEASUREMENT Md_entlsoll3 Pr_md_entlsoll3 St_elmot1 St_elmot1.B_hp1_ntod St_elmot1.B_hp1_vtod St_elmot1.B_np0_nkw St_elmot1.B_np0_rf St_elmot1.B_np0_v St_elmot1.B_up_absafs St_elmot2 St_elmot2.B_hp2_ntod St_elmot2.B_hp2_vtod St_elmot2.B_nzgofsum St_elmot2.B_up_gangi0 St_elmot2.B_up_rf4 St_elmot2.B_up_rfntod St_elmot2.B_up_rfvtod St_elmotentl St_elmotentl.B_nzgof1 St_elmotentl.B_nzgof2 St_elmotentl.B_nzgof3 St_elmotentl.B_prio St_elmotentl.B_priovdelay St_elmottime St_elmottime.B_inold_1 St_elmottime.B_inold_2 St_elmottime.B_inold_3 St_elmottime.B_inold_4 St_elmottime.B_inold_5 St_elmottime.B_inold_6 St_elnotafu St_elnotafu.B_notafu2 St_entlast_loc Stat_entl Timecount_0 Timecount_1 Timecount_2 Timecount_3 Timecount_4 Timecount_5 Timecount_6 /end OUT_MEASUREMENT
 /begin IN_MEASUREMENT Gangi Nkw Pu Pwg_ist Rf St_pmbattmng0 St_pmbattmng0.B_batt_entl St_pmbattmng0.B_bt_timer St_pmbattmng0.B_btmaxfrei St_pmbattmng0.B_btpau St_pmbattmng0.B_dly_tbi St_pmbattmng0.B_ibsok St_pmbattmng0.B_inibumg St_start St_start.B_jumpstart St_start.B_sta St_start.B_start St_start.B_startende St_start.B_wst Tmot V /end IN_MEASUREMENT
/end FUNCTION
/begin FUNCTION IGR ""
 /begin DEF_CHARACTERISTIC KL_IGRDFGEN_MN K_IGRDFGEN_MX K_IGRNL K_IGRUMAX K_IGRUMINMAX K_IGRUMN K_IGRUMN2 K_IGR_DI1 K_IGR_DI1DT K_IGR_DI2 K_IGR_DI2DT K_IGR_ENTPR K_IGR_IHIGH K_IGR_IHIGH2 K_IGR_IMED K_IGR_MANRAMP K_IGR_OSDI1 K_IGR_UDN K_IGR_UDP K_IGR_UOS K_PR_IGRDN K_PR_IGRDP K_PR_IGRLOW K_PR_IGRMH S_IGRPF_EN /end DEF_CHARACTERISTIC
 /begin OUT_MEASUREMENT Pr_igr_dn Pr_igr_dp Pr_igr_soll St_igr1 St_igr1.B_igrlow St_igr1.B_regelakt St_igroutnv St_igroutnv.B_cdigronr St_igroutnv.B_cdxenonr U_igr_dn U_igr_dp U_igr_soll U_igrmedhi /end OUT_MEASUREMENT
 /begin IN_MEASUREMENT D_soc Dffgen Dsoc_igrmax I_batt Nkw Pr_soll St_co2mng St_co2mng.B_co2_igroff St_co2mng.B_co2_msaoff St_co2mng.B_igrhigh St_co2mng.B_igrmed St_co2mng.B_zykl_igrh St_co2mng.B_zykl_igrm St_co2mng.B_zykl_msaoff St_igrinnv St_igrinnv.B_cdigronw St_igrinnv.B_cdxenonw St_igrinnv.B_diagigr St_igrsbcalc St_igrsbcalc.B_igr_mot St_igrsbcalc.B_igrlow_en St_igrsbcalc.B_igrlow_on St_igrsbcalc.B_sa_igr St_mkwchn St_mkwchn.B_kwdreht U_bn_soll U_max U_min U_ziel /end IN_MEASUREMENT
/end FUNCTION
/begin FUNCTION IGRDIAG ""
 /begin DEF_CHARACTERISTIC K_IGRDIAGT_MN K_IGRDIAG_T1 K_IGRDIAG_T2 K_IGRDIAG_TMN K_IGRDIAG_TST K_IGRINF_TDFH K_IGRINF_TDFL K_IGRINF_TDFM K_IGRINF_TSB K_IGR_ANT K_INFORESET /end DEF_CHARACTERISTIC
 /begin REF_CHARACTERISTIC K_PR_IGRLOW K_PR_IGRMH /end REF_CHARACTERISTIC
 /begin OUT_MEASUREMENT Igr_inforeset Igrinfo Qelad_igrhi Qeladhi_start Qeladmed_start Qlad_ges Qlad_igrlow Qladlow_int Qladmed_start St_igr_a0old St_igrdiag1 St_igrdiag1.B_igr_tbatt St_igrdiag1.B_igr_tsaison St_igrdiag1.B_igrdiag_off1 St_igrdiag1.B_igrdiag_on1 St_igrdiag_a0 St_igrdiag_a0.B_igra0_0 St_igrdiag_a0.B_igra0_1 St_igrdiag_a0.B_igra0_2 St_igrdiag_a0.B_igra0_3 St_igrdiag_a0.B_igra0_4 St_igrdiag_a0.B_igra0_5 St_igrdiag_a0.B_igra0_6 St_igrdiag_a0.B_igra0_7 St_igrdiag_b0 St_igrdiag_b0.B_igrb0_0 St_igrdiag_b0.B_igrb0_1 St_igrdiag_b0.B_igrb0_2 St_igrdiag_b0.B_igrb0_3 St_igrdiag_b0.B_igrb0_4 St_igrdiag_b0.B_igrb0_5 St_igrdiag_b0.B_igrb0_6 St_igrdiag_c0 St_igrdiag_c0.B_igrc0_0 St_igrdiag_c0.B_igrc0_1 St_igrdiag_c0.B_igrc0_2 St_igrdiag_c0.B_igrc0_3 St_igrdiag_c0.B_igrc0_4 St_igrdiag_c0.B_igrc0_5 T_igrdiagon T_igrh_antakt T_igrhigh T_igrl_antakt T_igrlow T_igrm_antakt T_igrmed Zr_igr_low /end OUT_MEASUREMENT
 /begin IN_MEASUREMENT Bsztemp I_batt Pminfo1 Pr_bn_soll Pr_soll Qelad_ges St_co2mng St_co2mng.B_co2_igroff St_co2mng.B_co2_msaoff St_co2mng.B_igrhigh St_co2mng.B_igrmed St_co2mng.B_zykl_igrh St_co2mng.B_zykl_igrm St_co2mng.B_zykl_msaoff St_co2mng_1 St_co2mng_1.B_co2_av St_co2mng_1.B_co2_ea St_co2mng_1.B_co2_eacc St_co2mng_1.B_igr_dsoc St_co2mng_1.B_igrhigh_en St_co2mng_1.B_igrmed_en St_igr1 St_igr1.B_igrlow St_igr1.B_regelakt St_igrinnv St_igrinnv.B_cdigronw St_igrinnv.B_cdxenonw St_igrinnv.B_diagigr St_igroutnv St_igroutnv.B_cdigronr St_igroutnv.B_cdxenonr St_igrsbcalc St_igrsbcalc.B_igr_mot St_igrsbcalc.B_igrlow_en St_igrsbcalc.B_igrlow_on St_igrsbcalc.B_sa_igr St_kl15 St_kl15.B_kl15_ep St_kl15.B_kl15_vorab St_mkwchn St_mkwchn.B_kwdreht St_pmbattregen St_pmbattregen.B_battregen St_pmbattregen.B_battregini St_pmvbmng0 St_pmvbmng0.B_geblakt St_pmvbmng0.B_ilichtakt St_pmvbmng0.B_lichtakt St_pmvbmng0.B_slpakt St_pmvbmng0.B_wischerakt St_pwf St_pwf.B_pwf St_start St_start.B_jumpstart St_start.B_sta St_start.B_start St_start.B_startende St_start.B_wst T_batt T_saison Td_regen Zr_regen /end IN_MEASUREMENT
/end FUNCTION
/begin FUNCTION IGRSBCALC ""
 /begin DEF_CHARACTERISTIC K_IGRBS K_IGRLOW_EN K_IGR_NKWMN K_IGR_TMOTMN K_IGR_VMIN S_IGRLOW_MAN /end DEF_CHARACTERISTIC
 /begin OUT_MEASUREMENT St_igrsbcalc St_igrsbcalc.B_igr_mot St_igrsbcalc.B_igrlow_en St_igrsbcalc.B_igrlow_on St_igrsbcalc.B_sa_igr /end OUT_MEASUREMENT
 /begin IN_MEASUREMENT Nkw St_bls St_bls.B_bls St_igrinnv St_igrinnv.B_cdigronw St_igrinnv.B_cdxenonw St_igrinnv.B_diagigr St_sawe St_sawe.B_sa St_sawe.B_sae St_sawe.B_safast Tmot V /end IN_MEASUREMENT
/end FUNCTION
/begin FUNCTION KT_IBS ""
 /begin DEF_CHARACTERISTIC K_BZE_IMAX K_BZE_IMIN K_BZE_ISTRIG K_BZE_TSMPL K_DI1000DT K_DI1000STG K_DI1000TGRZ K_DI200DT K_DI200STG K_DIHIGHGRZ K_DILOWGRZ K_DIPL5 K_DIPL6 K_DIPL7 K_DIPL8 K_DKL15FIL K_DTMAXGRZI K_DUIGRZ K_DUMINTGRZ K_DUREFMAX K_DUREFMINI K_ECOMAXI K_ECOMSB K_ECOMZ K_ECOTIMO K_ENABSDIBS K_ENISOC0 K_ENUSOC0 K_ERREPEAT K_IBSTSTERR K_IBSVERSION K_IBTEMPMAXI K_IBTEMPMINI K_IBUNPLADEL K_ISLEEPGRZ K_ISTARTTRIG K_SLEEPWAIT K_S_CLERRIBS K_T1SCHWELLE K_T1SOC0 K_T2SCHWELLE K_T2SOC0 K_T3SCHWELLE K_T3SOC0 K_TMPCOM_DIV K_TMPCOM_MUL K_TNUSTART K_TNUSTARTFL K_TPT1TICO K_TSLEEPRUH K_TSTECOS K_T_CLERRIBS K_T_UTIEFSET K_UTIEFAPP /end DEF_CHARACTERISTIC
 /begin OUT_MEASUREMENT Chk16_ibs Chkpara Comcontrol Ebsd_adr Ebsd_errdir Ebsd_errep Ebsd_errin Ebsd_nbyt Ebsd_timo Ebsd_varin Eco_jobstat1 Eco_jobstat2 Eco_result1 Freezcont Fsclctr I_batt I_soc0 I_tnstart I_vorstart Ib_chk16 Ib_parlen Ibhwversi Ibs_ecos Ibs_errors Ibs_msgind Ibs_msgsta Ibs_reg5 Ibs_start Ibsbclctri Ibsborctr Ibsdncsctr Ibseromctr Ibsiicctri Ibslvdctr Ibsporctr Ibspromctr Ibsptyctr Ibsramctr Ibswbase Ibswchang Ibswdtctr Kt_ibsstatus Ktib_chk16 Ktupcsctr Qelad Qeladsoc0 Qlad Qladsoc0 Qv_nstartval Qv_td Qvary_i Qvary_u R5cyctim Snibs St_ecostat2 St_ecostat2.B_ecobusy St_ibebsd1 St_ibebsd1.B_eb_busy St_ibebsd1.B_eb_errdir St_ibebsd1.B_eb_txok St_ibebsd1.B_ibs_msgrdy St_ibebsd1.B_ibs_msgwri St_ibmix St_ibmix.B_ibrhilo St_ibmix.B_ibttog St_ibserr St_ibserr.B_ibfbsd St_ibserr.B_ibfebsd St_ibserr.B_ibunplau St_ibsreg4 St_ibsreg4.B_ibspwf St_ibsreg4.B_startfgk St_ibsreg4.B_strtaw St_ibsreg4.B_tiefset St_ibsreg5 St_ibsreg5.B_fsclr St_sleep St_sleep.B_sleepwait T1histiruh T2histiruh T3histiruh T4histiruh T_batt_ibs T_batt_max T_batt_min T_battgradi T_battsoc0 T_battsoci T_battsta T_relibs Tbatt_maxi Tbatt_mini Tbgrd_ibs Tbsta_ibs U1soc0 U1soc0_q U2soc0 U2soc0_q U3soc0 U3soc0_q U_batt U_tnstart U_vorstart Unind Zbibs /end OUT_MEASUREMENT
 /begin IN_MEASUREMENT St_kl15 St_kl15.B_kl15_ep St_kl15.B_kl15_vorab St_mkwchn St_mkwchn.B_kwdreht Tumg /end IN_MEASUREMENT
/end FUNCTION
/begin FUNCTION LEMDIAG ""
 /begin DEF_CHARACTERISTIC KL_BATTMNG KL_INVBATTMNG KL_INVLOG KL_LOG KL_QUALI KL_QUALILOG K_INSPRESET K_LEMDELAY K_LEMDIAGU1 K_LEMDIAGU2 K_LEMDIAGU3 K_LEMDIAGU4 K_LEMDIAGU5 K_LEMDIAGU6 K_LEMDIAGU7 K_LEMRESET K_QUALI_1 K_QUALI_2 K_QUALI_3 /end DEF_CHARACTERISTIC
 /begin REF_CHARACTERISTIC K_PR_MDFUNK K_PR_MDSICH K_PR_UBNQH K_PR_UDBMN_H K_PR_UDBMN_M K_PR_USBMN_H K_PR_USBMN_L /end REF_CHARACTERISTIC
 /begin OUT_MEASUREMENT Count_out_1 Count_out_2 Count_out_3 Count_out_4 Count_out_5 Count_out_6 Count_out_7 Lemcnt_reset Leminfo St_lemdiag0 St_lemdiag0.B_lemdiagup St_lemdiag0.B_lemstatset St_lemdiag1 St_lemdiag1.B_entlsichvoll St_lemdiag1.B_entlsichvollup St_lemdiag1.B_lemstatset2 St_lemdiag1.B_mdsichegf St_lemdiag1.B_pr_mdmod St_lemdiag1.B_pr_mdsich Stat_quali_1 Stat_quali_2 Stat_quali_3 Stat_ubattsoll_h Stat_ubattsoll_l T_entlfunk T_entlsich T_ierrllred T_ierrtred Tm_entlfunk Tm_entlsich Tm_ierrllred Tm_ierrtred Zr_entlfunk Zr_entlfunknix Zr_entlfunkteil Zr_entlfunkvoll Zr_entlsich Zr_entlsichvoll Zr_ierrllred Zr_ierrtred Zr_quali_1 Zr_quali_2 Zr_quali_3 Zr_ubattsoll_h Zr_ubattsoll_l Zr_ustat_1 Zr_ustat_2 Zr_ustat_3 Zr_ustat_4 Zr_ustat_5 Zr_ustat_6 Zr_ustat_7 /end OUT_MEASUREMENT
 /begin IN_MEASUREMENT Pr_bn_soll Pr_dsc_mn Pr_grenz_ist Pr_ierrllred Pr_ierrtred Pr_md_entlsoll1 Pr_md_entlsoll3 Pr_stabatt_mn Quali_spg St_mkwchn St_mkwchn.B_kwdreht St_pwf St_pwf.B_pwf St_start St_start.B_jumpstart St_start.B_sta St_start.B_start St_start.B_startende St_start.B_wst Ub /end IN_MEASUREMENT
/end FUNCTION
/end MODULE
/end PROJECT
