ASAP2_VERSION 1 41
/begin PROJECT MSD85 "Spray Guided DI-System with Piezo Injectors for 8-Cylinder"
/begin HEADER "_default_HeaderComment" PROJECT_NO _91 /end HEADER
/begin MODULE _default_ModuleName "_default_ModuleLongIdentifier"
/begin MOD_COMMON "_default_ModCommonComment" DEPOSIT ABSOLUTE BYTE_ORDER MSB_LAST ALIGNMENT_BYTE 1 ALIGNMENT_WORD 2 ALIGNMENT_LONG 2 ALIGNMENT_FLOAT32_IEEE 2 ALIGNMENT_FLOAT64_IEEE 4 /end MOD_COMMON
/begin MEASUREMENT Bosbtvfbk "Rest-Verfügbarkeit Motoröl in Prozent" UBYTE _CNV_R_R_Def_dez_sl_551_CM 1 100. 0. 255. DISPLAY_IDENTIFIER BOSBTVFBK ECU_ADDRESS 0xc00040fa FORMAT "%3.0" /end MEASUREMENT
/begin MEASUREMENT Bosconf "Aktive CBS-Komponente" ULONG _CNV_R_R_Def_dez_sl_551_CM 1 100. 0. 4294967295. DISPLAY_IDENTIFIER BOSCONF ECU_ADDRESS 0xc0007934 FORMAT "%7.0" /end MEASUREMENT
/begin MEASUREMENT Bosfxid2 "Zieltermin_Monat_BOS_Rückstellung_2" UWORD _CNV_R_R_Def_dez_sl_551_CM 1 100. 0. 65535. DISPLAY_IDENTIFIER BOSFXID2 ECU_ADDRESS 0xc00040f8 FORMAT "%5.0" /end MEASUREMENT
/begin MEASUREMENT Bosid2 "Zieltermin_Monat_BOS_Rückstellung_2" UBYTE _CNV_R_R_Def_dez_sl_551_CM 1 100. 0. 255. DISPLAY_IDENTIFIER BOSID2 ECU_ADDRESS 0xc00040fb FORMAT "%3.0" /end MEASUREMENT
/begin MEASUREMENT Bosjziel "Zieltermin_Monat_BOS_Rückstellung_2" UBYTE _CNV_R_R_Def_dez_sl_551_CM 1 100. 0. 255. DISPLAY_IDENTIFIER BOSJZIEL ECU_ADDRESS 0xc00040fc FORMAT "%3.0" /end MEASUREMENT
/begin MEASUREMENT Bosmanip "Manipulationsbyte" UBYTE _CNV_R_R_Def_dez_sl_551_CM 1 100. 0. 255. DISPLAY_IDENTIFIER BOSMANIP ECU_ADDRESS 0xc000793a FORMAT "%3.0" /end MEASUREMENT
/begin MEASUREMENT Bosmziel "Zieltermin_Monat_BOS_Meldung_2" UBYTE _CNV_R_R_Def_dez_sl_551_CM 1 100. 0. 255. DISPLAY_IDENTIFIER BOSMZIEL ECU_ADDRESS 0xc00040fd FORMAT "%3.0" /end MEASUREMENT
/begin MEASUREMENT Bosprog2 "Prognose_Intervall_Zeit_BOS_Meldung_2" UBYTE _CNV_R_R_Def_dez_sl_551_CM 1 100. 0. 255. DISPLAY_IDENTIFIER BOSPROG2 ECU_ADDRESS 0xc00040fe FORMAT "%3.0" /end MEASUREMENT
/begin MEASUREMENT Bosres "Zieltermin_Monat_BOS_Rückstellung_2" UBYTE _CNV_R_R_Def_dez_sl_551_CM 1 100. 0. 255. DISPLAY_IDENTIFIER BOSRES ECU_ADDRESS 0xc00040ff FORMAT "%3.0" /end MEASUREMENT
/begin MEASUREMENT Bosrlsm "Ausgabewert Restlaufstrecke Motoröl" SWORD _CNV_R_R_Def_dez_sl_551_CM 1 100. -32768. 32767. DISPLAY_IDENTIFIER BOSRLSM ECU_ADDRESS 0xc00040f2 FORMAT "%5.0" /end MEASUREMENT
/begin MEASUREMENT Bosrw2 "Prognose_Intervall_Weg_BOS_Meldung_2" UBYTE _CNV_R_R_Def_km_ub__428_CM 1 100. 0. 255000. DISPLAY_IDENTIFIER BOSRW2 ECU_ADDRESS 0xc0004100 FORMAT "%3.0" /end MEASUREMENT
/begin MEASUREMENT Bosstate "Einheit der BOS-Info (km)" UBYTE _CNV_R_R_Def_dez_sl_551_CM 1 100. 0. 255. DISPLAY_IDENTIFIER BOSSTATE ECU_ADDRESS 0xc000793b FORMAT "%3.0" /end MEASUREMENT
/begin MEASUREMENT Bostoken "Ampel für die Belegung der CBS-Schnittstelle" UBYTE _CNV_R_R_Def_dez_sl_551_CM 1 100. 0. 255. DISPLAY_IDENTIFIER BOSTOKEN ECU_ADDRESS 0xc000793c FORMAT "%3.0" /end MEASUREMENT
/begin MEASUREMENT Dexwkor_ist "Ist-Excenterwinkeländerung" UWORD _CNV_R_R_Def_exwink_585_CM 1 100. 0. 180. DISPLAY_IDENTIFIER DEXWKOR_IST ECU_ADDRESS 0xd000e6cc FORMAT "%7.2" /end MEASUREMENT
/begin MEASUREMENT Dexwkor_soll "Soll-Excenterwinkeländerung" UWORD _CNV_R_R_Def_exwink_585_CM 1 100. 0. 180. DISPLAY_IDENTIFIER DEXWKOR_SOLL ECU_ADDRESS 0xd000e6ce FORMAT "%7.2" /end MEASUREMENT
/begin MEASUREMENT Dhubra "Einlassventilhubrampe fuer Uebergang UGD-GD" UWORD _CNV_R_R_Def_hub_uw_589_CM 1 100. 0. 65.535 DISPLAY_IDENTIFIER DHUBRA ECU_ADDRESS 0xd000e69c FORMAT "%8.3" /end MEASUREMENT
/begin MEASUREMENT Dhubtm "Huboffset" SWORD _CNV_R_R_Def_hub_uw_589_CM 1 100. -32.768 32.767 DISPLAY_IDENTIFIER DHUBTM ECU_ADDRESS 0xd000e696 FORMAT "%8.3" /end MEASUREMENT
/begin MEASUREMENT Dnwoto_mn "" UWORD _CNV_R_R_Def_spr_sw_561_CM 1 100. 0. 6553.5 DISPLAY_IDENTIFIER DNWOTO_MN ECU_ADDRESS 0xd000e48c FORMAT "%7.2" ARRAY_SIZE 4 MATRIX_DIM 4 1 1 /end MEASUREMENT
/begin MEASUREMENT Dnwoto_mx "" UWORD _CNV_R_R_Def_spr_sw_561_CM 1 100. 0. 6553.5 DISPLAY_IDENTIFIER DNWOTO_MX ECU_ADDRESS 0xd000e494 FORMAT "%7.2" ARRAY_SIZE 4 MATRIX_DIM 4 1 1 /end MEASUREMENT
/begin MEASUREMENT Dpsfak "-" UBYTE _CNV_R_R_Def_f_ub_b_553_CM 1 100. 0. 0.996 DISPLAY_IDENTIFIER DPSFAK ECU_ADDRESS 0xd000e500 /end MEASUREMENT
/begin MEASUREMENT Dpsfak_1 "-" UBYTE _CNV_R_R_Def_f_ub_b_553_CM 1 100. 0. 0.996 DISPLAY_IDENTIFIER DPSFAK_1 ECU_ADDRESS 0xd000e55c /end MEASUREMENT
/begin MEASUREMENT Dpsfak_2 "-" UBYTE _CNV_R_R_Def_f_ub_b_553_CM 1 100. 0. 0.996 DISPLAY_IDENTIFIER DPSFAK_2 ECU_ADDRESS 0xd000e55d /end MEASUREMENT
/begin MEASUREMENT Dpssol "Soll-Differenzdruck Saugrohr (Mittelwert)" SWORD _CNV_R_R_Def_p_sw_q_576_CM 1 100. -1280. 1279.9609 DISPLAY_IDENTIFIER DPSSOL ECU_ADDRESS 0xd000e524 FORMAT "%7.2" /end MEASUREMENT
/begin MEASUREMENT Dpssol_i "Soll-Differenzdruck Saugrohr" SWORD _CNV_R_R_Def_p_sw_q_576_CM 1 100. -1280. 1279.9609 DISPLAY_IDENTIFIER DPSSOL_I ECU_ADDRESS 0xd000e520 FORMAT "%7.2" ARRAY_SIZE 2 MATRIX_DIM 2 1 1 /end MEASUREMENT
/begin MEASUREMENT Dpssolfilt "Soll-Differenzdruck gefiltert" SWORD _CNV_R_R_Def_p_sw_q_576_CM 1 100. -1280. 1279.9609 DISPLAY_IDENTIFIER DPSSOLFILT ECU_ADDRESS 0xd000e528 FORMAT "%7.2" /end MEASUREMENT
/begin MEASUREMENT Dpssolfilt_i "Soll-Differenzdruck gefiltert" SWORD _CNV_R_R_Def_p_sw_q_576_CM 1 100. -1280. 1279.9609 DISPLAY_IDENTIFIER DPSSOLFILT_I ECU_ADDRESS 0xd000e52a FORMAT "%7.2" ARRAY_SIZE 2 MATRIX_DIM 2 1 1 /end MEASUREMENT
/begin MEASUREMENT Dpssolgd "Soll-Differenzdruck gedrosselt" SWORD _CNV_R_R_Def_p_sw_q_576_CM 1 100. -1280. 1279.9609 DISPLAY_IDENTIFIER DPSSOLGD ECU_ADDRESS 0xd000e540 FORMAT "%7.2" /end MEASUREMENT
/begin MEASUREMENT Dpssolgd_i "Soll-Differenzdruck gedrosselt" SWORD _CNV_R_R_Def_p_sw_q_576_CM 1 100. -1280. 1279.9609 DISPLAY_IDENTIFIER DPSSOLGD_I ECU_ADDRESS 0xd000e542 FORMAT "%7.2" ARRAY_SIZE 2 MATRIX_DIM 2 1 1 /end MEASUREMENT
/begin MEASUREMENT Dpssolps_i "" SWORD _CNV_R_R_Def_p_sw_q_576_CM 1 100. -1280. 1279.9609 DISPLAY_IDENTIFIER DPSSOLPS_I ECU_ADDRESS 0xd000e626 FORMAT "%7.2" ARRAY_SIZE 2 MATRIX_DIM 2 1 1 /end MEASUREMENT
/begin MEASUREMENT Dpsvvtte "Differenzdruck Saugrohr bei TE" SWORD _CNV_R_R_Def_p_sw_q_576_CM 1 100. -1280. 1279.9609 DISPLAY_IDENTIFIER DPSVVTTE ECU_ADDRESS 0xd000e546 FORMAT "%7.2" /end MEASUREMENT
/begin MEASUREMENT Drf_spuel_f_i "Rf Anteil ueberspuel (gefiltert)" SWORD _CNV_R_R_Def_rf_sw__598_CM 1 100. -327.68 327.67 DISPLAY_IDENTIFIER DRF_SPUEL_F_I ECU_ADDRESS 0xd000e5d0 FORMAT "%9.4" ARRAY_SIZE 2 MATRIX_DIM 2 1 1 /end MEASUREMENT
/begin MEASUREMENT Drf_uk_f_i "Rf Anteil unkritisch (gefiltert)" SWORD _CNV_R_R_Def_rf_sw__598_CM 1 100. -327.68 327.67 DISPLAY_IDENTIFIER DRF_UK_F_I ECU_ADDRESS 0xd000e5d4 FORMAT "%9.4" ARRAY_SIZE 2 MATRIX_DIM 2 1 1 /end MEASUREMENT
/begin MEASUREMENT Drft_i "" SWORD _CNV_R_R_Def_rf_sw__598_CM 1 100. -327.68 327.67 DISPLAY_IDENTIFIER DRFT_I ECU_ADDRESS 0xd000e58e FORMAT "%9.4" ARRAY_SIZE 2 MATRIX_DIM 2 1 1 /end MEASUREMENT
/begin MEASUREMENT Drft_uk_i "" SWORD _CNV_R_R_Def_rf_sw__598_CM 1 100. -327.68 327.67 DISPLAY_IDENTIFIER DRFT_UK_I ECU_ADDRESS 0xd000e59e FORMAT "%9.4" ARRAY_SIZE 2 MATRIX_DIM 2 1 1 /end MEASUREMENT
/begin MEASUREMENT Dvse_spr "" SWORD _CNV_R_R_Def_spr_sw_561_CM 1 100. -3276.8 3276.7 DISPLAY_IDENTIFIER DVSE_SPR ECU_ADDRESS 0xd000e6b6 FORMAT "%7.2" /end MEASUREMENT
/begin MEASUREMENT Exwdifll "Excenterwinkelabweichung Exwink_ist - Exwink_soll" SWORD _CNV_R_R_Def_exwink_585_CM 1 100. -720. 180. DISPLAY_IDENTIFIER EXWDIFLL ECU_ADDRESS 0xd000e6c6 FORMAT "%7.2" /end MEASUREMENT
/begin MEASUREMENT Exwdifll_alt "Excenterwinkelabweichung Exwink_ist - Exwink_soll" SWORD _CNV_R_R_Def_exwink_585_CM 1 100. -720. 180. DISPLAY_IDENTIFIER EXWDIFLL_ALT ECU_ADDRESS 0xd000e6c8 FORMAT "%7.2" /end MEASUREMENT
/begin MEASUREMENT Exwink2_soll "Sollwert Exzenterwellenwinkel Bank 2" UWORD _CNV_R_R_Def_exwink_585_CM 1 100. 0. 180. DISPLAY_IDENTIFIER EXWINK2_SOLL ECU_ADDRESS 0xd000e68c FORMAT "%7.2" /end MEASUREMENT
/begin MEASUREMENT Exwink_nokor "Sollwert Exzenterwellenwinkel vor Hubkorrektur" UWORD _CNV_R_R_Def_exwink_585_CM 1 100. 0. 180. DISPLAY_IDENTIFIER EXWINK_NOKOR ECU_ADDRESS 0xd000e6a6 FORMAT "%7.2" /end MEASUREMENT
/begin MEASUREMENT Exwink_soll "Sollwert Exzenterwellenwinkel" UWORD _CNV_R_R_Def_exwink_585_CM 1 100. 0. 180. DISPLAY_IDENTIFIER EXWINK_SOLL ECU_ADDRESS 0xd000e68a FORMAT "%7.2" /end MEASUREMENT
/begin MEASUREMENT Exwinkmx "Excenterwinkelbegrenzung über Drehzahl" UWORD _CNV_R_R_Def_exwink_585_CM 1 100. 0. 180. DISPLAY_IDENTIFIER EXWINKMX ECU_ADDRESS 0xd000e6d0 FORMAT "%7.2" /end MEASUREMENT
/begin MEASUREMENT Exwinkmx_vz "Excenterwinkelbegrenzung über Drehzahl (Schleppzeiger)" UWORD _CNV_R_R_Def_exwink_585_CM 1 100. 0. 180. DISPLAY_IDENTIFIER EXWINKMX_VZ ECU_ADDRESS 0xd000e6d2 FORMAT "%7.2" /end MEASUREMENT
/begin MEASUREMENT Exwkor_ll "Excenterwinkel zur Hubkorrektur" SWORD _CNV_R_R_Def_exwink_585_CM 1 100. -720. 180. DISPLAY_IDENTIFIER EXWKOR_LL ECU_ADDRESS 0xd000e6a2 FORMAT "%7.2" /end MEASUREMENT
/begin MEASUREMENT F_dpsdkm_i "Faktor Ueberblendung DK-Modelle" UWORD _CNV_R_R_Def_f_uw_b_590_CM 1 100. 0. 1.9999 DISPLAY_IDENTIFIER F_DPSDKM_I ECU_ADDRESS 0xd000e636 FORMAT "%14.5" ARRAY_SIZE 2 MATRIX_DIM 2 1 1 /end MEASUREMENT
/begin MEASUREMENT F_exwkor_ll "Faktor aus Lernroutine für Hubkorrektur" UWORD _CNV_R_R_Def_f_uw_b_590_CM 1 100. 0. 1.9999 DISPLAY_IDENTIFIER F_EXWKOR_LL ECU_ADDRESS 0xd000e6ca FORMAT "%14.5" /end MEASUREMENT
/begin MEASUREMENT F_hubdpsfak "Kennlinie Überblendung Fhubvnsi abhängig von Dpsfak" UBYTE _CNV_R_R_Def_f_ub_b_553_CM 1 100. 0. 0.996 DISPLAY_IDENTIFIER F_HUBDPSFAK ECU_ADDRESS 0xd000e6a5 /end MEASUREMENT
/begin MEASUREMENT F_hubnst "Kennlinie Überblendung Fhubvnsi abhängig von Tn_start_10" UBYTE _CNV_R_R_Def_f_ub_b_553_CM 1 100. 0. 0.996 DISPLAY_IDENTIFIER F_HUBNST ECU_ADDRESS 0xd000e6a4 /end MEASUREMENT
/begin MEASUREMENT F_int_pssolber_i "" UWORD _CNV_R_R_Def_f_uw_b_588_CM 1 100. 0. 31.9995 DISPLAY_IDENTIFIER F_INT_PSSOLBER_I ECU_ADDRESS 0xd000e5ae FORMAT "%9.4" ARRAY_SIZE 2 MATRIX_DIM 2 1 1 /end MEASUREMENT
/begin MEASUREMENT F_mssdyn_kor_i "" UWORD _CNV_R_R_Def_f_uw_b_572_CM 1 100. 0. 7.9998 DISPLAY_IDENTIFIER F_MSSDYN_KOR_I ECU_ADDRESS 0xd000e63a FORMAT "%9.4" ARRAY_SIZE 2 MATRIX_DIM 2 1 1 /end MEASUREMENT
/begin MEASUREMENT F_pspld_soll "Soll Druckverhältnis an DK" UWORD _CNV_R_R_Def_f_uw_b_590_CM 1 100. 0. 1.9999 DISPLAY_IDENTIFIER F_PSPLD_SOLL ECU_ADDRESS 0xd000e6f0 FORMAT "%14.5" /end MEASUREMENT
/begin MEASUREMENT F_pspld_ueb "Ueberblendfaktor aus dem Dynamikbereich" UBYTE _CNV_R_R_Def_f_ub_b_553_CM 1 100. 0. 0.996 DISPLAY_IDENTIFIER F_PSPLD_UEB ECU_ADDRESS 0xd000e6f6 /end MEASUREMENT
/begin MEASUREMENT F_pssolber_i "" UWORD _CNV_R_R_Def_f_uw_b_571_CM 1 100. 0. 0.9999 DISPLAY_IDENTIFIER F_PSSOLBER_I ECU_ADDRESS 0xd000e5b2 FORMAT "%14.5" ARRAY_SIZE 2 MATRIX_DIM 2 1 1 /end MEASUREMENT
/begin MEASUREMENT F_psspu "Soll-Druckverhältnis im SR" UWORD _CNV_R_R_Def_f_sw_b_616_CM 1 100. 0. 3.9999 DISPLAY_IDENTIFIER F_PSSPU ECU_ADDRESS 0xd000e6f2 FORMAT "%14.5" /end MEASUREMENT
/begin MEASUREMENT F_pvdkpnvns "Korrekturfaktor vns" UWORD _CNV_R_R_Def_f_uw_b_590_CM 1 100. 0. 1.9999 DISPLAY_IDENTIFIER F_PVDKPNVNS ECU_ADDRESS 0xd000e570 FORMAT "%14.5" /end MEASUREMENT
/begin MEASUREMENT F_pvdkpnvns_i "Korrekturfaktor vns" UWORD _CNV_R_R_Def_f_uw_b_590_CM 1 100. 0. 1.9999 DISPLAY_IDENTIFIER F_PVDKPNVNS_I ECU_ADDRESS 0xd000e56c FORMAT "%14.5" ARRAY_SIZE 2 MATRIX_DIM 2 1 1 /end MEASUREMENT
/begin MEASUREMENT F_tpkor_vns "Korrekturfaktor Hoehe und Temperatur fuer Vanos (gemittelt)" UWORD _CNV_R_R_Def_f_sw_b_616_CM 1 100. 0. 3.9999 DISPLAY_IDENTIFIER F_TPKOR_VNS ECU_ADDRESS 0xd000e54c FORMAT "%14.5" /end MEASUREMENT
/begin MEASUREMENT F_tpkor_vns_i "Korrekturfaktor Hoehe und Temperatur fuer Vanos (Bankweise)" UWORD _CNV_R_R_Def_f_sw_b_616_CM 1 100. 0. 3.9999 DISPLAY_IDENTIFIER F_TPKOR_VNS_I ECU_ADDRESS 0xd000e548 FORMAT "%14.5" ARRAY_SIZE 2 MATRIX_DIM 2 1 1 /end MEASUREMENT
/begin MEASUREMENT F_transvl_bas_i "" UWORD _CNV_R_R_Def_f_uw_b_571_CM 1 100. 0. 0.9999 DISPLAY_IDENTIFIER F_TRANSVL_BAS_I ECU_ADDRESS 0xd000e612 FORMAT "%14.5" ARRAY_SIZE 2 MATRIX_DIM 2 1 1 /end MEASUREMENT
/begin MEASUREMENT F_transvl_i "" UWORD _CNV_R_R_Def_f_uw_b_571_CM 1 100. 0. 0.9999 DISPLAY_IDENTIFIER F_TRANSVL_I ECU_ADDRESS 0xd000e60e FORMAT "%14.5" ARRAY_SIZE 2 MATRIX_DIM 2 1 1 /end MEASUREMENT
/begin MEASUREMENT Fhubvnsf "Vanoskorrekturfaktor vor Filter" UWORD _CNV_R_R_Def_f_uw_b_590_CM 1 100. 0. 1.9999 DISPLAY_IDENTIFIER FHUBVNSF ECU_ADDRESS 0xd000e6c0 FORMAT "%14.5" /end MEASUREMENT
/begin MEASUREMENT Fhubvnsi "Vanoskorrekturfaktor Istwert" UWORD _CNV_R_R_Def_f_uw_b_590_CM 1 100. 0. 1.9999 DISPLAY_IDENTIFIER FHUBVNSI ECU_ADDRESS 0xd000e6a0 FORMAT "%14.5" /end MEASUREMENT
/begin MEASUREMENT Fhubvnss "Vanoskorrekturfaktor Sollwert" UWORD _CNV_R_R_Def_f_uw_b_590_CM 1 100. 0. 1.9999 DISPLAY_IDENTIFIER FHUBVNSS ECU_ADDRESS 0xd000e6c2 FORMAT "%14.5" /end MEASUREMENT
/begin MEASUREMENT Fsp_rep_return "Returnwert Test ed_report()" UWORD _CNV_R_R_Def_dez_sl_551_CM 1 100. 0. 65535. DISPLAY_IDENTIFIER FSP_REP_RETURN ECU_ADDRESS 0xc00006b4 FORMAT "%5.0" /end MEASUREMENT
/begin MEASUREMENT Fsp_rep_return.F_rep_aktuell "Bedingung Fehler Einlassvanos im FSP" UWORD _CNV_S_2_Def_bit_ub_563_CM 1 100. 0. 1. DISPLAY_IDENTIFIER F_REP_AKTUELL ECU_ADDRESS 0xc00006b4 BIT_MASK 0x800 /end MEASUREMENT
/begin MEASUREMENT Fsp_rep_return.F_rep_bed_diag "Bedingung Fehler Einlassvanos im FSP" UWORD _CNV_S_2_Def_bit_ub_563_CM 1 100. 0. 1. DISPLAY_IDENTIFIER F_REP_BED_DIAG ECU_ADDRESS 0xc00006b4 BIT_MASK 0x400 /end MEASUREMENT
/begin MEASUREMENT Fsp_rep_return.F_rep_gespeichert "Bedingung Fehler Einlassvanos im FSP" UWORD _CNV_S_2_Def_bit_ub_563_CM 1 100. 0. 1. DISPLAY_IDENTIFIER F_REP_GESPEICHERT ECU_ADDRESS 0xc00006b4 BIT_MASK 0x200 /end MEASUREMENT
/begin MEASUREMENT Fsp_rep_return.F_rep_im_filter "Bedingung Fehler Einlassvanos im FSP" UWORD _CNV_S_2_Def_bit_ub_563_CM 1 100. 0. 1. DISPLAY_IDENTIFIER F_REP_IM_FILTER ECU_ADDRESS 0xc00006b4 BIT_MASK 0x20 /end MEASUREMENT
/begin MEASUREMENT Fsp_rep_return.F_rep_mil_an "Bedingung Fehler Einlassvanos im FSP" UWORD _CNV_S_2_Def_bit_ub_563_CM 1 100. 0. 1. DISPLAY_IDENTIFIER F_REP_MIL_AN ECU_ADDRESS 0xc00006b4 BIT_MASK 0x10 /end MEASUREMENT
/begin MEASUREMENT Fsp_rep_return.F_rep_momentan_vorhanden "Bedingung Fehler Einlassvanos im FSP" UWORD _CNV_S_2_Def_bit_ub_563_CM 1 100. 0. 1. DISPLAY_IDENTIFIER F_REP_MOMENTAN_VORHANDEN ECU_ADDRESS 0xc00006b4 BIT_MASK 0x40 /end MEASUREMENT
/begin MEASUREMENT Fsp_rep_return.F_rep_readyneeflag "Bedingung Fehler Einlassvanos im FSP" UWORD _CNV_S_2_Def_neg_bi_628_CM 1 100. 0. 1. DISPLAY_IDENTIFIER F_REP_READYNEEFLAG ECU_ADDRESS 0xc00006b4 BIT_MASK 0x100 /end MEASUREMENT
/begin MEASUREMENT Fsp_rep_return.F_rep_zyklusflag "Bedingung Fehler Einlassvanos im FSP" UWORD _CNV_S_2_Def_neg_bi_628_CM 1 100. 0. 1. DISPLAY_IDENTIFIER F_REP_ZYKLUSFLAG ECU_ADDRESS 0xc00006b4 BIT_MASK 0x80 /end MEASUREMENT
/begin MEASUREMENT Fsp_rep_return.Fa_rep_Wert_zu_gross "Bedingung Nockenwellenendstufe angesteuert" UWORD _CNV_S_2_Def_bit_ub_563_CM 1 100. 0. 1. DISPLAY_IDENTIFIER FA_REP_WERT_ZU_GROSS ECU_ADDRESS 0xc00006b4 BIT_MASK 0x1 /end MEASUREMENT
/begin MEASUREMENT Fsp_rep_return.Fa_rep_Wert_zu_klein "Bedingung nwe unterschritten (hysteresebehaftet)" UWORD _CNV_S_2_Def_bit_ub_563_CM 1 100. 0. 1. DISPLAY_IDENTIFIER FA_REP_WERT_ZU_KLEIN ECU_ADDRESS 0xc00006b4 BIT_MASK 0x2 /end MEASUREMENT
/begin MEASUREMENT Fsp_rep_return.Fa_rep_kein_Signal "Bedingung Einlassventilhub herunterfahren" UWORD _CNV_S_2_Def_bit_ub_563_CM 1 100. 0. 1. DISPLAY_IDENTIFIER FA_REP_KEIN_SIGNAL ECU_ADDRESS 0xc00006b4 BIT_MASK 0x4 /end MEASUREMENT
/begin MEASUREMENT Fsp_rep_return.Fa_rep_unplausibel "Bedingung Einlassventilhubvorsteuerung im Start" UWORD _CNV_S_2_Def_bit_ub_563_CM 1 100. 0. 1. DISPLAY_IDENTIFIER FA_REP_UNPLAUSIBEL ECU_ADDRESS 0xc00006b4 BIT_MASK 0x8 /end MEASUREMENT
/begin MEASUREMENT Fsp_rep_test_hs "Handshake Test ed_report()" UBYTE _CNV_R_R_Def_dez_sl_551_CM 1 100. 0. 255. DISPLAY_IDENTIFIER FSP_REP_TEST_HS ECU_ADDRESS 0xc00006b1 FORMAT "%3.0" /end MEASUREMENT
/begin MEASUREMENT Fsp_stat_return "Returnwert Test ed_status()" UWORD _CNV_R_R_Def_dez_sl_551_CM 1 100. 0. 65535. DISPLAY_IDENTIFIER FSP_STAT_RETURN ECU_ADDRESS 0xc00006b2 FORMAT "%5.0" /end MEASUREMENT
/begin MEASUREMENT Fsp_stat_return.F_stat_aktuell "Status Fehler wir momentan erkannt - unentprellt" UWORD _CNV_S_2_Def_bit_ub_563_CM 1 100. 0. 1. DISPLAY_IDENTIFIER F_STAT_AKTUELL ECU_ADDRESS 0xc00006b2 BIT_MASK 0x800 /end MEASUREMENT
/begin MEASUREMENT Fsp_stat_return.F_stat_bed_diag "Status Diagnose ist aktiv" UWORD _CNV_S_2_Def_bit_ub_563_CM 1 100. 0. 1. DISPLAY_IDENTIFIER F_STAT_BED_DIAG ECU_ADDRESS 0xc00006b2 BIT_MASK 0x400 /end MEASUREMENT
/begin MEASUREMENT Fsp_stat_return.F_stat_gespeichert "Status Fehler ist im Fehlerspeicher" UWORD _CNV_S_2_Def_bit_ub_563_CM 1 100. 0. 1. DISPLAY_IDENTIFIER F_STAT_GESPEICHERT ECU_ADDRESS 0xc00006b2 BIT_MASK 0x200 /end MEASUREMENT
/begin MEASUREMENT Fsp_stat_return.F_stat_im_filter "Status Fehler ist in der Filterung" UWORD _CNV_S_2_Def_bit_ub_563_CM 1 100. 0. 1. DISPLAY_IDENTIFIER F_STAT_IM_FILTER ECU_ADDRESS 0xc00006b2 BIT_MASK 0x20 /end MEASUREMENT
/begin MEASUREMENT Fsp_stat_return.F_stat_mil_an "Status MIL ist an" UWORD _CNV_S_2_Def_bit_ub_563_CM 1 100. 0. 1. DISPLAY_IDENTIFIER F_STAT_MIL_AN ECU_ADDRESS 0xc00006b2 BIT_MASK 0x10 /end MEASUREMENT
/begin MEASUREMENT Fsp_stat_return.F_stat_momentan_vorhanden "Status Fehler ist entprellt im Fehlerspeicher" UWORD _CNV_S_2_Def_bit_ub_563_CM 1 100. 0. 1. DISPLAY_IDENTIFIER F_STAT_MOMENTAN_VORHANDEN ECU_ADDRESS 0xc00006b2 BIT_MASK 0x40 /end MEASUREMENT
/begin MEASUREMENT Fsp_stat_return.F_stat_readyneeflag "Status Readyness ist erfüllt" UWORD _CNV_S_2_Def_neg_bi_628_CM 1 100. 0. 1. DISPLAY_IDENTIFIER F_STAT_READYNEEFLAG ECU_ADDRESS 0xc00006b2 BIT_MASK 0x100 /end MEASUREMENT
/begin MEASUREMENT Fsp_stat_return.F_stat_zyklusflag "Status Zyklus ist abgeleufen" UWORD _CNV_S_2_Def_neg_bi_628_CM 1 100. 0. 1. DISPLAY_IDENTIFIER F_STAT_ZYKLUSFLAG ECU_ADDRESS 0xc00006b2 BIT_MASK 0x80 /end MEASUREMENT
/begin MEASUREMENT Fsp_stat_return.Fa_stat_Wert_zu_gross "Fehlerart Signal zu gross" UWORD _CNV_S_2_Def_bit_ub_563_CM 1 100. 0. 1. DISPLAY_IDENTIFIER FA_STAT_WERT_ZU_GROSS ECU_ADDRESS 0xc00006b2 BIT_MASK 0x1 /end MEASUREMENT
/begin MEASUREMENT Fsp_stat_return.Fa_stat_Wert_zu_klein "Fehlerart Signal zu klein" UWORD _CNV_S_2_Def_bit_ub_563_CM 1 100. 0. 1. DISPLAY_IDENTIFIER FA_STAT_WERT_ZU_KLEIN ECU_ADDRESS 0xc00006b2 BIT_MASK 0x2 /end MEASUREMENT
/begin MEASUREMENT Fsp_stat_return.Fa_stat_kein_Signal "Fehlerart kein Signal" UWORD _CNV_S_2_Def_bit_ub_563_CM 1 100. 0. 1. DISPLAY_IDENTIFIER FA_STAT_KEIN_SIGNAL ECU_ADDRESS 0xc00006b2 BIT_MASK 0x4 /end MEASUREMENT
/begin MEASUREMENT Fsp_stat_return.Fa_stat_unplausibel "Fehlerart Signal unplausibel" UWORD _CNV_S_2_Def_bit_ub_563_CM 1 100. 0. 1. DISPLAY_IDENTIFIER FA_STAT_UNPLAUSIBEL ECU_ADDRESS 0xc00006b2 BIT_MASK 0x8 /end MEASUREMENT
/begin MEASUREMENT Fsp_stat_test_hs "Handshake Test ed_status()" UBYTE _CNV_R_R_Def_dez_sl_551_CM 1 100. 0. 255. DISPLAY_IDENTIFIER FSP_STAT_TEST_HS ECU_ADDRESS 0xc00006b0 FORMAT "%3.0" /end MEASUREMENT
/begin MEASUREMENT Fupsrf_kor_i "Faktor systembezogene Umrechung Druck auf Füllung, GD/UG" UWORD _CNV_R_R_Def_f_uw_b_629_CM 1 100. 0. 0.2999 DISPLAY_IDENTIFIER FUPSRF_KOR_I ECU_ADDRESS 0xd000e558 FORMAT "%14.6" ARRAY_SIZE 2 MATRIX_DIM 2 1 1 /end MEASUREMENT
/begin MEASUREMENT Hubev2_ist "Istwert Einlassventilhub, BANK2" UWORD _CNV_R_R_Def_hub_uw_589_CM 1 100. 0. 65.535 DISPLAY_IDENTIFIER HUBEV2_IST ECU_ADDRESS 0xd000e694 FORMAT "%8.3" /end MEASUREMENT
/begin MEASUREMENT Hubev_ist "Istwert Einlassventilhub" UWORD _CNV_R_R_Def_hub_uw_589_CM 1 100. 0. 65.535 DISPLAY_IDENTIFIER HUBEV_IST ECU_ADDRESS 0xd000e692 FORMAT "%8.3" /end MEASUREMENT
/begin MEASUREMENT Hubev_soll "Sollwert Einlassventilhub gefiltert" UWORD _CNV_R_R_Def_hub_uw_589_CM 1 100. 0. 65.535 DISPLAY_IDENTIFIER HUBEV_SOLL ECU_ADDRESS 0xd000e68e FORMAT "%8.3" /end MEASUREMENT
/begin MEASUREMENT Hubev_soll_b "Sollwert Einlassventilhub bei Momentenstellung ueber Hub" UWORD _CNV_R_R_Def_hub_uw_589_CM 1 100. 0. 65.535 DISPLAY_IDENTIFIER HUBEV_SOLL_B ECU_ADDRESS 0xd000e69e FORMAT "%8.3" /end MEASUREMENT
/begin MEASUREMENT Hubev_soll_kf "Sollwert Einlassventilhub aus Hubkennfeldern" UWORD _CNV_R_R_Def_hub_uw_589_CM 1 100. 0. 65.535 DISPLAY_IDENTIFIER HUBEV_SOLL_KF ECU_ADDRESS 0xd000e698 FORMAT "%8.3" /end MEASUREMENT
/begin MEASUREMENT Hubev_soll_vh "Sollwert Einlassventilhub bei B_gdvhub" UWORD _CNV_R_R_Def_hub_uw_589_CM 1 100. 0. 65.535 DISPLAY_IDENTIFIER HUBEV_SOLL_VH ECU_ADDRESS 0xd000e6a8 FORMAT "%8.3" /end MEASUREMENT
/begin MEASUREMENT Hubev_vh "Vollasthub" UWORD _CNV_R_R_Def_hub_uw_589_CM 1 100. 0. 65.535 DISPLAY_IDENTIFIER HUBEV_VH ECU_ADDRESS 0xd000e69a FORMAT "%8.3" /end MEASUREMENT
/begin MEASUREMENT Hubevkor_soll "Sollwert Einlassventilhub temperaturkorriegiert" UWORD _CNV_R_R_Def_hub_uw_589_CM 1 100. 0. 65.535 DISPLAY_IDENTIFIER HUBEVKOR_SOLL ECU_ADDRESS 0xd000e690 FORMAT "%8.3" /end MEASUREMENT
/begin MEASUREMENT Id_bosmg "Kennung für BOS-Meldung = Ölservice-Info" UWORD _CNV_R_R_Def_dez_sl_551_CM 1 100. 0. 65535. DISPLAY_IDENTIFIER ID_BOSMG ECU_ADDRESS 0xc0007938 FORMAT "%5.0" /end MEASUREMENT
/begin MEASUREMENT Id_bosmgt "Kennung für BOS-Meldung vom Tester" UBYTE _CNV_R_R_Def_dez_sl_551_CM 1 100. 0. 255. DISPLAY_IDENTIFIER ID_BOSMGT ECU_ADDRESS 0xc000793d FORMAT "%3.0" /end MEASUREMENT
/begin MEASUREMENT Id_bosmsg "Kennung für BOS-Meldung vom Kombi" UBYTE _CNV_R_R_Def_dez_sl_551_CM 1 100. 0. 255. DISPLAY_IDENTIFIER ID_BOSMSG ECU_ADDRESS 0xc000793e FORMAT "%3.0" /end MEASUREMENT
/begin MEASUREMENT Id_bosrtak "Acknowledge für den Empfang der CBS-Anforderungen" UBYTE _CNV_R_R_Def_dez_sl_551_CM 1 100. 0. 255. DISPLAY_IDENTIFIER ID_BOSRTAK ECU_ADDRESS 0xc000792e FORMAT "%3.0" /end MEASUREMENT
/begin MEASUREMENT Kf_mszsvnst_aus "Wichtung" UBYTE _CNV_R_R_Def_f_ub_b_553_CM 1 100. 0. 0.996 DISPLAY_IDENTIFIER KF_MSZSVNST_AUS ECU_ADDRESS 0xd000e55e /end MEASUREMENT
/begin MEASUREMENT Kfdps_aus "Soll-Differenzdruck Vvt" SWORD _CNV_R_R_Def_p_sw_q_576_CM 1 100. -1280. 1279.9609 DISPLAY_IDENTIFIER KFDPS_AUS ECU_ADDRESS 0xd000e53e FORMAT "%7.2" /end MEASUREMENT
/begin MEASUREMENT Kffl_ausi "" UWORD _CNV_R_R_Def_flae_u_646_CM 1 100. 0. 1048.56 DISPLAY_IDENTIFIER KFFL_AUSI ECU_ADDRESS 0xd000e6ba FORMAT "%7.2" /end MEASUREMENT
/begin MEASUREMENT Kffl_ausn "" UWORD _CNV_R_R_Def_flae_u_646_CM 1 100. 0. 1048.56 DISPLAY_IDENTIFIER KFFL_AUSN ECU_ADDRESS 0xd000e6b8 FORMAT "%7.2" /end MEASUREMENT
/begin MEASUREMENT Kl_gdvnsfil_aus "Zeitkonstante Filterung Rfv_vns_dk" UWORD _CNV_R_R_Def_f_uw_b_555_CM 1 100. 0. 99.9984 DISPLAY_IDENTIFIER KL_GDVNSFIL_AUS ECU_ADDRESS 0xd000e5ce FORMAT "%8.3" /end MEASUREMENT
/begin MEASUREMENT Klafaus_i "Ausgang Ausflusskennlinie" UWORD _CNV_R_R_Def_f_uw_b_571_CM 1 100. 0. 0.9999 DISPLAY_IDENTIFIER KLAFAUS_I ECU_ADDRESS 0xd000e632 FORMAT "%14.5" ARRAY_SIZE 2 MATRIX_DIM 2 1 1 /end MEASUREMENT
/begin MEASUREMENT Ls_bank_20ms "Selektive Bankberechnung im 20ms Raster" UBYTE _CNV_R_R_Def_dez_sl_551_CM 1 100. 0. 255. DISPLAY_IDENTIFIER LS_BANK_20MS ECU_ADDRESS 0xd000e4ff FORMAT "%3.0" /end MEASUREMENT
/begin MEASUREMENT Msn_pspvdk_smx_i "" UWORD _CNV_R_R_Def_ms_uw__594_CM 1 100. 0. 2047.9687 DISPLAY_IDENTIFIER MSN_PSPVDK_SMX_I ECU_ADDRESS 0xd000e62a FORMAT "%8.3" ARRAY_SIZE 2 MATRIX_DIM 2 1 1 /end MEASUREMENT
/begin MEASUREMENT Msnsol "höhenkorrigierter Soll-Luftmassenstrom" UWORD _CNV_R_R_Def_ms_uw__594_CM 1 100. 0. 2047.9687 DISPLAY_IDENTIFIER MSNSOL ECU_ADDRESS 0xd000e5cc FORMAT "%8.3" /end MEASUREMENT
/begin MEASUREMENT Msnsolps "höhenkorrigierter Soll-Luftmassenstrom mit Massenstromabgleich" UWORD _CNV_R_R_Def_ms_uw__594_CM 1 100. 0. 2047.9687 DISPLAY_IDENTIFIER MSNSOLPS ECU_ADDRESS 0xd000e526 FORMAT "%8.3" /end MEASUREMENT
/begin MEASUREMENT Msnwdk_soll_i "normierter Luftmassenstrom fuer Sollwinkelbestimmung DK" UWORD _CNV_R_R_Def_ms_uw__655_CM 1 100. 0. 8191.875 DISPLAY_IDENTIFIER MSNWDK_SOLL_I ECU_ADDRESS 0xd000e64e FORMAT "%7.2" ARRAY_SIZE 2 MATRIX_DIM 2 1 1 /end MEASUREMENT
/begin MEASUREMENT Mssol "Soll-Luftmassenstrom" UWORD _CNV_R_R_Def_ms_uw__594_CM 1 100. 0. 2047.9687 DISPLAY_IDENTIFIER MSSOL ECU_ADDRESS 0xd000e532 FORMAT "%8.3" /end MEASUREMENT
/begin MEASUREMENT Mssol_i "Soll-Luftmassenstrom" UWORD _CNV_R_R_Def_ms_uw__594_CM 1 100. 0. 2047.9687 DISPLAY_IDENTIFIER MSSOL_I ECU_ADDRESS 0xd000e52e FORMAT "%8.3" ARRAY_SIZE 2 MATRIX_DIM 2 1 1 /end MEASUREMENT
/begin MEASUREMENT Mssol_mr_i "Soll-Luftmassenstrom mit Massenstromabgleich" UWORD _CNV_R_R_Def_ms_uw__594_CM 1 100. 0. 2047.9687 DISPLAY_IDENTIFIER MSSOL_MR_I ECU_ADDRESS 0xd000e5c8 FORMAT "%8.3" ARRAY_SIZE 2 MATRIX_DIM 2 1 1 /end MEASUREMENT
/begin MEASUREMENT Mssoldk_dyn_i "" SWORD _CNV_R_R_Def_ms_uw__594_CM 1 100. -1024. 1023.9687 DISPLAY_IDENTIFIER MSSOLDK_DYN_I ECU_ADDRESS 0xd000e63e FORMAT "%8.3" ARRAY_SIZE 2 MATRIX_DIM 2 1 1 /end MEASUREMENT
/begin MEASUREMENT Mssoldk_i "Solluftmassenstrom inkl. Adaption und Tankentlueftung" UWORD _CNV_R_R_Def_ms_uw__594_CM 1 100. 0. 2047.9687 DISPLAY_IDENTIFIER MSSOLDK_I ECU_ADDRESS 0xd000e646 FORMAT "%8.3" ARRAY_SIZE 2 MATRIX_DIM 2 1 1 /end MEASUREMENT
/begin MEASUREMENT Mssoldk_kor_i "Solluftmassenstrom inkl. Adaption und Tankentlueftung, korr." UWORD _CNV_R_R_Def_ms_uw__594_CM 1 100. 0. 2047.9687 DISPLAY_IDENTIFIER MSSOLDK_KOR_I ECU_ADDRESS 0xd000e64a FORMAT "%8.3" ARRAY_SIZE 2 MATRIX_DIM 2 1 1 /end MEASUREMENT
/begin MEASUREMENT Mssoldkdyn_roh_i "" SWORD _CNV_R_R_Def_ms_uw__594_CM 1 100. -1024. 1023.9687 DISPLAY_IDENTIFIER MSSOLDKDYN_ROH_I ECU_ADDRESS 0xd000e642 FORMAT "%8.3" ARRAY_SIZE 2 MATRIX_DIM 2 1 1 /end MEASUREMENT
/begin MEASUREMENT Nw_posi "Nockenwellenposition" UWORD _CNV_R_R_Def_spr_sw_561_CM 1 100. 0. 6553.5 DISPLAY_IDENTIFIER NW_POSI ECU_ADDRESS 0xd000e4b0 FORMAT "%7.2" ARRAY_SIZE 4 MATRIX_DIM 4 1 1 /end MEASUREMENT
/begin MEASUREMENT Oz_bsz "Betriebstundenzähler (in sek)" ULONG _CNV_R_R_Def_td_ul__665_CM 1 100. 0. 4294967295. DISPLAY_IDENTIFIER OZ_BSZ ECU_ADDRESS 0xc00040c6 FORMAT "%7.0" /end MEASUREMENT
/begin MEASUREMENT Oz_cttagini "Tag beim Ölwechsel" SWORD _CNV_R_R_Def_dez_sl_551_CM 1 100. -32768. 32767. DISPLAY_IDENTIFIER OZ_CTTAGINI ECU_ADDRESS 0xc00040d6 FORMAT "%5.0" /end MEASUREMENT
/begin MEASUREMENT Oz_deabzug "Abzug durch Dieseleintrag" UWORD _CNV_R_R_Def_km_sw__68_CM 1 100. 0. 655350. DISPLAY_IDENTIFIER OZ_DEABZUG ECU_ADDRESS 0xc0007910 FORMAT "%5.0" /end MEASUREMENT
/begin MEASUREMENT Oz_dkvb "Kraftstoffverbrauch innerhalb der letzten Sekunde" UWORD _CNV_R_R_Def_dez_sl_551_CM 1 100. 0. 65535. DISPLAY_IDENTIFIER OZ_DKVB ECU_ADDRESS 0xc0007912 FORMAT "%5.0" /end MEASUREMENT
/begin MEASUREMENT Oz_dkvbrest "Rest bei der Aufsummierung Kraftstoffverbrauch" UWORD _CNV_R_R_Def_dez_sl_551_CM 1 100. 0. 65535. DISPLAY_IDENTIFIER OZ_DKVBREST ECU_ADDRESS 0xc0007914 FORMAT "%5.0" /end MEASUREMENT
/begin MEASUREMENT Oz_intprog "Prognose_Intervall_Zeit_BOS_Meldung_2" UBYTE _CNV_R_R_Def_dez_sl_551_CM 1 100. 0. 255. DISPLAY_IDENTIFIER OZ_INTPROG ECU_ADDRESS 0xc0007900 FORMAT "%3.0" /end MEASUREMENT
/begin MEASUREMENT Oz_kmlow "Kilometerstand letzter Ölwechsel" SWORD _CNV_R_R_Def_km_sw__68_CM 1 100. -327680. 327670. DISPLAY_IDENTIFIER OZ_KMLOW ECU_ADDRESS 0xc00040e6 FORMAT "%6.1" /end MEASUREMENT
/begin MEASUREMENT Oz_kmstrw0 "Kilometerstand bei Restweg = Null" UWORD _CNV_R_R_Def_km_sw__68_CM 1 100. 0. 655350. DISPLAY_IDENTIFIER OZ_KMSTRW0 ECU_ADDRESS 0xc00040da FORMAT "%5.0" /end MEASUREMENT
/begin MEASUREMENT Oz_kvbalt "Kraftstoffverbrauch um einen Abtastwert verzögert" UWORD _CNV_R_R_Def_dez_sl_551_CM 1 100. 0. 65535. DISPLAY_IDENTIFIER OZ_KVBALT ECU_ADDRESS 0xc0007916 FORMAT "%5.0" /end MEASUREMENT
/begin MEASUREMENT Oz_kvbdiff "Delta Kraftstoffverbrauch der letzten 10 km" ULONG _CNV_R_R_Def_fuel_u_668_CM 1 100. 0. 100. DISPLAY_IDENTIFIER OZ_KVBDIFF ECU_ADDRESS 0xc0007904 FORMAT "%11.4" /end MEASUREMENT
/begin MEASUREMENT Oz_kvbmw "Mittelwert Kraftstoffverbrauch" ULONG _CNV_R_R_Def_fuel_u_668_CM 1 100. 0. 100. DISPLAY_IDENTIFIER OZ_KVBMW ECU_ADDRESS 0xc00040ca FORMAT "%11.4" /end MEASUREMENT
/begin MEASUREMENT Oz_kvbmwtmp "Mittelwert Kraftstoffverbrauch auf 16bit reduziert" UWORD _CNV_R_R_Def_f_uw_b_617_CM 1 100. 0. 63.999 DISPLAY_IDENTIFIER OZ_KVBMWTMP ECU_ADDRESS 0xc0007918 FORMAT "%9.4" /end MEASUREMENT
/begin MEASUREMENT Oz_kvbmx "Gesammte Kraftstoffmenge + Bonus" UWORD _CNV_R_R_Def_dez_sl_551_CM 1 100. 0. 65535. DISPLAY_IDENTIFIER OZ_KVBMX ECU_ADDRESS 0xc000791a FORMAT "%5.0" /end MEASUREMENT
/begin MEASUREMENT Oz_kvbog "zugeteilte Bonuskraftstoffmenge" UWORD _CNV_R_R_Def_dez_sl_551_CM 1 100. 0. 65535. DISPLAY_IDENTIFIER OZ_KVBOG ECU_ADDRESS 0xc00040dc FORMAT "%5.0" /end MEASUREMENT
/begin MEASUREMENT Oz_kvbsm "Verbrauchte Kraftstoffmenge" ULONG _CNV_R_R_Def_fuel_u_668_CM 1 100. 0. 10000. DISPLAY_IDENTIFIER OZ_KVBSM ECU_ADDRESS 0xc0007908 FORMAT "%11.4" /end MEASUREMENT
/begin MEASUREMENT Oz_kvbsm_ul "Aufsummierte Kraftstoffmenge" ULONG _CNV_R_R_Def_fuel_u_668_CM 1 100. 0. 255000. DISPLAY_IDENTIFIER OZ_KVBSM_UL ECU_ADDRESS 0xc00040ce FORMAT "%11.4" /end MEASUREMENT
/begin MEASUREMENT Oz_kvbtmp2 "Tmp für die CBS RW-Berechnung" UWORD _CNV_R_R_Def_km_sw__68_CM 1 100. 0. 655350. DISPLAY_IDENTIFIER OZ_KVBTMP2 ECU_ADDRESS 0xc000791c FORMAT "%5.0" /end MEASUREMENT
/begin MEASUREMENT Oz_lf1t "Länderfaktor 1" UBYTE _CNV_R_R_Def_lf_ub__670_CM 1 100. 0. 2.55 DISPLAY_IDENTIFIER OZ_LF1T ECU_ADDRESS 0xc00040de FORMAT "%5.2" /end MEASUREMENT
/begin MEASUREMENT Oz_lf2t "Länderfaktor 2" UBYTE _CNV_R_R_Def_lf_ub__670_CM 1 100. 0. 2.55 DISPLAY_IDENTIFIER OZ_LF2T ECU_ADDRESS 0xc00040df FORMAT "%5.2" /end MEASUREMENT
/begin MEASUREMENT Oz_litges "Gesamtverbrauch für Ölwechsel" UWORD _CNV_R_R_Def_dez_sl_551_CM 1 100. 0. 65535. DISPLAY_IDENTIFIER OZ_LITGES ECU_ADDRESS 0xc000791e FORMAT "%5.0" /end MEASUREMENT
/begin MEASUREMENT Oz_manip "Öl-CBS manipuliert" UBYTE _CNV_R_R_Def_dez_sl_551_CM 1 100. 0. 255. DISPLAY_IDENTIFIER OZ_MANIP ECU_ADDRESS 0xc000793f FORMAT "%3.0" /end MEASUREMENT
/begin MEASUREMENT Oz_manipt "Manipulation" UBYTE _CNV_R_R_Def_dez_sl_551_CM 1 100. 0. 255. DISPLAY_IDENTIFIER OZ_MANIPT ECU_ADDRESS 0xc00040eb FORMAT "%3.0" /end MEASUREMENT
/begin MEASUREMENT Oz_nivlanglit "LangMw in Liter" UBYTE _CNV_R_R_Def_niv_ub_671_CM 1 100. 0. 25.5 DISPLAY_IDENTIFIER OZ_NIVLANGLIT ECU_ADDRESS 0xc0007924 FORMAT "%5.2" /end MEASUREMENT
/begin MEASUREMENT Oz_nivlangt "Langmittelwert für den Tester" UBYTE _CNV_R_R_Def_niv_ub_667_CM 1 100. 0. 74.70699999999999 DISPLAY_IDENTIFIER OZ_NIVLANGT ECU_ADDRESS 0xc00040e0 FORMAT "%5.2" /end MEASUREMENT
/begin MEASUREMENT Oz_nivnfm "Nachfüllmenge" UBYTE _CNV_R_R_Def_niv_ub_672_CM 1 100. 0. 7.9687 DISPLAY_IDENTIFIER OZ_NIVNFM ECU_ADDRESS 0xc0007901 FORMAT "%5.2" /end MEASUREMENT
/begin MEASUREMENT Oz_oelkm "Ölkilometer" UWORD _CNV_R_R_Def_km_sw__68_CM 1 100. 0. 655350. DISPLAY_IDENTIFIER OZ_OELKM ECU_ADDRESS 0xc00040e8 FORMAT "%5.0" /end MEASUREMENT
/begin MEASUREMENT Oz_oelzeit "Öl-Alter in Monate" UWORD _CNV_R_R_Def_dez_sl_551_CM 1 100. 0. 65535. DISPLAY_IDENTIFIER OZ_OELZEIT ECU_ADDRESS 0xc00078fa FORMAT "%5.0" /end MEASUREMENT
/begin MEASUREMENT Oz_oelzeitt "Öl-Alter in Tage" UWORD _CNV_R_R_Def_dez_sl_551_CM 1 100. 0. 1000. DISPLAY_IDENTIFIER OZ_OELZEITT ECU_ADDRESS 0xc00078fc FORMAT "%5.0" /end MEASUREMENT
/begin MEASUREMENT Oz_reset "Zieltermin_Monat_BOS_Rückstellung_2" UBYTE _CNV_R_R_Def_dez_sl_551_CM 1 100. 0. 255. DISPLAY_IDENTIFIER OZ_RESET ECU_ADDRESS 0xc0007940 FORMAT "%3.0" /end MEASUREMENT
/begin MEASUREMENT Oz_russkalt "Russ kalt" UWORD _CNV_R_R_Def_russ_u_675_CM 1 100. 0. 655.35 DISPLAY_IDENTIFIER OZ_RUSSKALT ECU_ADDRESS 0xc0007920 FORMAT "%8.3" /end MEASUREMENT
/begin MEASUREMENT Oz_russsum "Russsumme im Öl" ULONG _CNV_R_R_Def_dez_sl_551_CM 1 100. 0. 9000000. DISPLAY_IDENTIFIER OZ_RUSSSUM ECU_ADDRESS 0xc00040d2 FORMAT "%7.0" /end MEASUREMENT
/begin MEASUREMENT Oz_russwarm "Russ warm" UWORD _CNV_R_R_Def_russ_u_675_CM 1 100. 0. 655.35 DISPLAY_IDENTIFIER OZ_RUSSWARM ECU_ADDRESS 0xc0007922 FORMAT "%8.3" /end MEASUREMENT
/begin MEASUREMENT Oz_rwanz "anzuzeigender Restweg" SWORD _CNV_R_R_Def_km_sw__68_CM 1 100. -327680. 327670. DISPLAY_IDENTIFIER OZ_RWANZ ECU_ADDRESS 0xc00040d8 FORMAT "%6.1" /end MEASUREMENT
/begin MEASUREMENT Oz_rwbsz "Restweg aus der Betriebstundenberechnung" SWORD _CNV_R_R_Def_km_sw__68_CM 1 100. -327680. 327670. DISPLAY_IDENTIFIER OZ_RWBSZ ECU_ADDRESS 0xc00078f0 FORMAT "%6.1" /end MEASUREMENT
/begin MEASUREMENT Oz_rwde "Restweg laut Dieseleintrag" SWORD _CNV_R_R_Def_km_sw__68_CM 1 100. -327680. 327670. DISPLAY_IDENTIFIER OZ_RWDE ECU_ADDRESS 0xc000790c FORMAT "%6.1" /end MEASUREMENT
/begin MEASUREMENT Oz_rwkvb "Restweg aus dem Kraftstoffverbrauch" SWORD _CNV_R_R_Def_km_sw__68_CM 1 100. -327680. 327670. DISPLAY_IDENTIFIER OZ_RWKVB ECU_ADDRESS 0xc00078f2 FORMAT "%6.1" /end MEASUREMENT
/begin MEASUREMENT Oz_rwout "Restweg Ausgabe CBS-Öl" SWORD _CNV_R_R_Def_km_sw__68_CM 1 100. -327680. 327670. DISPLAY_IDENTIFIER OZ_RWOUT ECU_ADDRESS 0xc00040f4 FORMAT "%6.1" /end MEASUREMENT
/begin MEASUREMENT Oz_rwp "Zwischengröße Restwegberechnung" SWORD _CNV_R_R_Def_km_sw__68_CM 1 100. -327680. 327670. DISPLAY_IDENTIFIER OZ_RWP ECU_ADDRESS 0xc000790e FORMAT "%6.1" /end MEASUREMENT
/begin MEASUREMENT Oz_rwpeil "Resweg im Sensorfehlerfall" SWORD _CNV_R_R_Def_km_sw__68_CM 1 100. -327680. 327670. DISPLAY_IDENTIFIER OZ_RWPEIL ECU_ADDRESS 0xc00040f6 FORMAT "%6.1" /end MEASUREMENT
/begin MEASUREMENT Oz_rwprog "Prognose_Intervall_Weg_BOS_Meldung_2" UWORD _CNV_R_R_Def_km_sw__68_CM 1 100. 0. 655350. DISPLAY_IDENTIFIER OZ_RWPROG ECU_ADDRESS 0xc00078fe FORMAT "%5.0" /end MEASUREMENT
/begin MEASUREMENT Oz_rwprout "RW-Prognose ausgebe CBS-Öl" UBYTE _CNV_R_R_Def_km_ub__428_CM 1 100. 0. 255000. DISPLAY_IDENTIFIER OZ_RWPROUT ECU_ADDRESS 0xc0004101 FORMAT "%3.0" /end MEASUREMENT
/begin MEASUREMENT Oz_rwprueck "Neue CBS Prognose zu übernehmen" UBYTE _CNV_R_R_Def_km_ub__428_CM 1 100. 0. 255000. DISPLAY_IDENTIFIER OZ_RWPRUECK ECU_ADDRESS 0xc00040ec FORMAT "%3.0" /end MEASUREMENT
/begin MEASUREMENT Oz_rwrueck "Neuer CBS Restweg zu übernehmen" SWORD _CNV_R_R_Def_km_sw__68_CM 1 100. -327680. 327670. DISPLAY_IDENTIFIER OZ_RWRUECK ECU_ADDRESS 0xc000792c FORMAT "%6.1" /end MEASUREMENT
/begin MEASUREMENT Oz_rwruss "Restweg aus der Russberechnung" SWORD _CNV_R_R_Def_km_sw__68_CM 1 100. -327680. 327670. DISPLAY_IDENTIFIER OZ_RWRUSS ECU_ADDRESS 0xc00078f4 FORMAT "%6.1" /end MEASUREMENT
/begin MEASUREMENT Oz_rwzeit "Restweg laut Zeitverlauf" SWORD _CNV_R_R_Def_km_sw__68_CM 1 100. -327680. 327670. DISPLAY_IDENTIFIER OZ_RWZEIT ECU_ADDRESS 0xc00078f6 FORMAT "%6.1" /end MEASUREMENT
/begin MEASUREMENT Oz_servcnt "Anzuzeigender Zähler für durchgeführten Ölservice" UBYTE _CNV_R_R_Def_dez_sl_551_CM 1 100. 0. 255. DISPLAY_IDENTIFIER OZ_SERVCNT ECU_ADDRESS 0xc0004102 FORMAT "%3.0" /end MEASUREMENT
/begin MEASUREMENT Oz_svcntchg "geänderter Servicezähler" UBYTE _CNV_R_R_Def_dez_sl_551_CM 1 100. 0. 255. DISPLAY_IDENTIFIER OZ_SVCNTCHG ECU_ADDRESS 0xc000792f FORMAT "%3.0" /end MEASUREMENT
/begin MEASUREMENT Oz_vfanz "anzuzeigende Verfügbarkeit" UBYTE _CNV_R_R_Def_lf_ub__670_CM 1 100. 0. 2.55 DISPLAY_IDENTIFIER OZ_VFANZ ECU_ADDRESS 0xc0007902 FORMAT "%5.2" /end MEASUREMENT
/begin MEASUREMENT Oz_vfbdmew "Verfügbarkeit aus Kombi bei DME-Wechsel" SBYTE _CNV_R_R_Def_dez_sl_551_CM 1 100. -128. 127. DISPLAY_IDENTIFIER OZ_VFBDMEW ECU_ADDRESS 0xc00040ea FORMAT "%3.0" /end MEASUREMENT
/begin MEASUREMENT Oz_vfbsz "Verfügbarkeit aus der Betriebstundenzählerberechnung" UBYTE _CNV_R_R_Def_lf_ub__670_CM 1 100. 0. 2.55 DISPLAY_IDENTIFIER OZ_VFBSZ ECU_ADDRESS 0xc0007925 FORMAT "%5.2" /end MEASUREMENT
/begin MEASUREMENT Oz_vfkvb "Verfügbarkeit aus Kraftstoffverbrauch" UBYTE _CNV_R_R_Def_lf_ub__670_CM 1 100. 0. 2.55 DISPLAY_IDENTIFIER OZ_VFKVB ECU_ADDRESS 0xc0007926 FORMAT "%5.2" /end MEASUREMENT
/begin MEASUREMENT Oz_vfout "Verfügbarkeit CBS-Öl" UBYTE _CNV_R_R_Def_dez_sl_551_CM 1 100. 0. 255. DISPLAY_IDENTIFIER OZ_VFOUT ECU_ADDRESS 0xc0004103 FORMAT "%3.0" /end MEASUREMENT
/begin MEASUREMENT Oz_vfruss "Verfügbarkeit aus der Russberechnung" UBYTE _CNV_R_R_Def_lf_ub__670_CM 1 100. 0. 2.55 DISPLAY_IDENTIFIER OZ_VFRUSS ECU_ADDRESS 0xc0007927 FORMAT "%5.2" /end MEASUREMENT
/begin MEASUREMENT Oz_vfzeit "Verfügbarkeit aus Zeit" UBYTE _CNV_R_R_Def_lf_ub__670_CM 1 100. 0. 2.55 DISPLAY_IDENTIFIER OZ_VFZEIT ECU_ADDRESS 0xc0007928 FORMAT "%5.2" /end MEASUREMENT
/begin MEASUREMENT Oz_zieljahr "Jahr für den nächsten Ölwechsel" UBYTE _CNV_R_R_Def_dez_sl_551_CM 1 100. 0. 255. DISPLAY_IDENTIFIER OZ_ZIELJAHR ECU_ADDRESS 0xc00040e1 FORMAT "%3.0" /end MEASUREMENT
/begin MEASUREMENT Oz_zielmon "Monat für den nächsten Ölwechsel" UBYTE _CNV_R_R_Def_dez_sl_551_CM 1 100. 0. 255. DISPLAY_IDENTIFIER OZ_ZIELMON ECU_ADDRESS 0xc00040e2 FORMAT "%3.0" /end MEASUREMENT
/begin MEASUREMENT Oz_zjahrout "Zieltermin Jahr CBS-Öl" UBYTE _CNV_R_R_Def_dez_sl_551_CM 1 100. 0. 255. DISPLAY_IDENTIFIER OZ_ZJAHROUT ECU_ADDRESS 0xc0004104 FORMAT "%3.0" /end MEASUREMENT
/begin MEASUREMENT Oz_zjbdmew "Neues Ziel-Jahr zu übernehmen" UBYTE _CNV_R_R_Def_dez_sl_551_CM 1 100. 0. 255. DISPLAY_IDENTIFIER OZ_ZJBDMEW ECU_ADDRESS 0xc0007930 FORMAT "%3.0" /end MEASUREMENT
/begin MEASUREMENT Oz_zmbdmew "Neuer Ziel-Monat zu übernehmen" UBYTE _CNV_R_R_Def_dez_sl_551_CM 1 100. 0. 255. DISPLAY_IDENTIFIER OZ_ZMBDMEW ECU_ADDRESS 0xc0007931 FORMAT "%3.0" /end MEASUREMENT
/begin MEASUREMENT Oz_zmonout "Zieltermin Jahr CBS-Öl" UBYTE _CNV_R_R_Def_dez_sl_551_CM 1 100. 0. 255. DISPLAY_IDENTIFIER OZ_ZMONOUT ECU_ADDRESS 0xc0004105 FORMAT "%3.0" /end MEASUREMENT
/begin MEASUREMENT Pakps_soll_i "" UWORD _CNV_R_R_Def_f_uw_b_590_CM 1 100. 0. 1.9999 DISPLAY_IDENTIFIER PAKPS_SOLL_I ECU_ADDRESS 0xd000e5b6 FORMAT "%14.5" ARRAY_SIZE 2 MATRIX_DIM 2 1 1 /end MEASUREMENT
/begin MEASUREMENT Pirg_kor_i "Partialdruck Restgas internes AGR, GD/UG" UWORD _CNV_R_R_Def_p_sw_q_576_CM 1 100. 0. 2559.9609 DISPLAY_IDENTIFIER PIRG_KOR_I ECU_ADDRESS 0xd000e554 FORMAT "%7.2" ARRAY_SIZE 2 MATRIX_DIM 2 1 1 /end MEASUREMENT
/begin MEASUREMENT Pld_soll "Soll -Ladedruck" UWORD _CNV_R_R_Def_p_sw_q_576_CM 1 100. 0. 2559.9609 DISPLAY_IDENTIFIER PLD_SOLL ECU_ADDRESS 0xd000e6f4 FORMAT "%7.2" /end MEASUREMENT
/begin MEASUREMENT Ps_mx_ext_i "max. zulaessiger Saugrohrdruck" UWORD _CNV_R_R_Def_p_sw_q_576_CM 1 100. 0. 2559.9609 DISPLAY_IDENTIFIER PS_MX_EXT_I ECU_ADDRESS 0xd000e562 FORMAT "%7.2" ARRAY_SIZE 2 MATRIX_DIM 2 1 1 /end MEASUREMENT
/begin MEASUREMENT Ps_soll_gd_i "Soll-Saugrohrdruck, Gedrosselt" UWORD _CNV_R_R_Def_p_sw_q_576_CM 1 100. 0. 2559.9609 DISPLAY_IDENTIFIER PS_SOLL_GD_I ECU_ADDRESS 0xd000e572 FORMAT "%7.2" ARRAY_SIZE 2 MATRIX_DIM 2 1 1 /end MEASUREMENT
/begin MEASUREMENT Ps_sollgd_lin_i "Soll-Saugrohrdruck, Linear" UWORD _CNV_R_R_Def_p_sw_q_576_CM 1 100. 0. 2559.9609 DISPLAY_IDENTIFIER PS_SOLLGD_LIN_I ECU_ADDRESS 0xd000e576 FORMAT "%7.2" ARRAY_SIZE 2 MATRIX_DIM 2 1 1 /end MEASUREMENT
/begin MEASUREMENT Ps_sollgd_nl2_i "" UWORD _CNV_R_R_Def_p_sw_q_576_CM 1 100. 0. 2559.9609 DISPLAY_IDENTIFIER PS_SOLLGD_NL2_I ECU_ADDRESS 0xd000e5a6 FORMAT "%7.2" ARRAY_SIZE 2 MATRIX_DIM 2 1 1 /end MEASUREMENT
/begin MEASUREMENT Ps_sollgd_nl_i "Soll-Saugrohrdruck, Non-Linear" UWORD _CNV_R_R_Def_p_sw_q_576_CM 1 100. 0. 2559.9609 DISPLAY_IDENTIFIER PS_SOLLGD_NL_I ECU_ADDRESS 0xd000e57a FORMAT "%7.2" ARRAY_SIZE 2 MATRIX_DIM 2 1 1 /end MEASUREMENT
/begin MEASUREMENT Psoll_nlbas_i "" UWORD _CNV_R_R_Def_p_sw_q_576_CM 1 100. 0. 2559.9609 DISPLAY_IDENTIFIER PSOLL_NLBAS_I ECU_ADDRESS 0xd000e5aa FORMAT "%7.2" ARRAY_SIZE 2 MATRIX_DIM 2 1 1 /end MEASUREMENT
/begin MEASUREMENT Pspvdk_soll "Faktor Umgebung zu Saugrohrdruck (Mittelwert)" UWORD _CNV_R_R_Def_f_sw_b_616_CM 1 100. 0. 3.9999 DISPLAY_IDENTIFIER PSPVDK_SOLL ECU_ADDRESS 0xd000e51a FORMAT "%14.5" /end MEASUREMENT
/begin MEASUREMENT Pspvdk_soll_i "Faktor Umgebung zu Saugrohrdruck" UWORD _CNV_R_R_Def_f_sw_b_616_CM 1 100. 0. 3.9999 DISPLAY_IDENTIFIER PSPVDK_SOLL_I ECU_ADDRESS 0xd000e516 FORMAT "%14.5" ARRAY_SIZE 2 MATRIX_DIM 2 1 1 /end MEASUREMENT
/begin MEASUREMENT Pspvdk_soll_ur_i "Faktor Umgebung zu Saugrohrdruck, Unbegrenzt" UWORD _CNV_R_R_Def_f_sw_b_616_CM 1 100. 0. 3.9999 DISPLAY_IDENTIFIER PSPVDK_SOLL_UR_I ECU_ADDRESS 0xd000e51c FORMAT "%14.5" ARRAY_SIZE 2 MATRIX_DIM 2 1 1 /end MEASUREMENT
/begin MEASUREMENT Pssol "Soll-Saugrohrdruck (Mittelwert)" UWORD _CNV_R_R_Def_p_sw_q_576_CM 1 100. 0. 2559.9609 DISPLAY_IDENTIFIER PSSOL ECU_ADDRESS 0xd000e538 FORMAT "%7.2" /end MEASUREMENT
/begin MEASUREMENT Pssol_i "Soll-Saugrohrdruck" UWORD _CNV_R_R_Def_p_sw_q_576_CM 1 100. 0. 2559.9609 DISPLAY_IDENTIFIER PSSOL_I ECU_ADDRESS 0xd000e534 FORMAT "%7.2" ARRAY_SIZE 2 MATRIX_DIM 2 1 1 /end MEASUREMENT
/begin MEASUREMENT Pssol_pspvdk_smx_i "" UWORD _CNV_R_R_Def_p_sw_q_576_CM 1 100. 0. 2559.9609 DISPLAY_IDENTIFIER PSSOL_PSPVDK_SMX_I ECU_ADDRESS 0xd000e622 FORMAT "%7.2" ARRAY_SIZE 2 MATRIX_DIM 2 1 1 /end MEASUREMENT
/begin MEASUREMENT Pssoll_g_i "" UWORD _CNV_R_R_Def_p_sw_q_576_CM 1 100. 0. 2559.9609 DISPLAY_IDENTIFIER PSSOLL_G_I ECU_ADDRESS 0xd000e582 FORMAT "%7.2" ARRAY_SIZE 2 MATRIX_DIM 2 1 1 /end MEASUREMENT
/begin MEASUREMENT Pssoll_offs_diff_i "" SWORD _CNV_R_R_Def_p_sw_q_576_CM 1 100. -1280. 1279.9609 DISPLAY_IDENTIFIER PSSOLL_OFFS_DIFF_I ECU_ADDRESS 0xd000e58a FORMAT "%7.2" ARRAY_SIZE 2 MATRIX_DIM 2 1 1 /end MEASUREMENT
/begin MEASUREMENT Pssoll_offs_i "" SWORD _CNV_R_R_Def_p_sw_q_576_CM 1 100. -1280. 1279.9609 DISPLAY_IDENTIFIER PSSOLL_OFFS_I ECU_ADDRESS 0xd000e586 FORMAT "%7.2" ARRAY_SIZE 2 MATRIX_DIM 2 1 1 /end MEASUREMENT
/begin MEASUREMENT Pste_mx "max. zulaessiger Saugrohrdruck durch TE" UWORD _CNV_R_R_Def_p_sw_q_576_CM 1 100. 0. 2559.9609 DISPLAY_IDENTIFIER PSTE_MX ECU_ADDRESS 0xd000e560 FORMAT "%7.2" /end MEASUREMENT
/begin MEASUREMENT Pvdkdsf "Druck vor Drosselklappe gefiltert (gemittelt)" UWORD _CNV_R_R_Def_p_sw_q_576_CM 1 100. 0. 2559.9609 DISPLAY_IDENTIFIER PVDKDSF ECU_ADDRESS 0xd000e552 FORMAT "%7.2" /end MEASUREMENT
/begin MEASUREMENT Pvdkdsf_i "Druck vor Drosselklappe gefiltert (Bankweise)" UWORD _CNV_R_R_Def_p_sw_q_576_CM 1 100. 0. 2559.9609 DISPLAY_IDENTIFIER PVDKDSF_I ECU_ADDRESS 0xd000e54e FORMAT "%7.2" ARRAY_SIZE 2 MATRIX_DIM 2 1 1 /end MEASUREMENT
/begin MEASUREMENT Rf_f_vns "relative Füllung DK, gefiltert" SWORD _CNV_R_R_Def_rf_sw__598_CM 1 100. -327.68 327.67 DISPLAY_IDENTIFIER RF_F_VNS ECU_ADDRESS 0xd000e5ba FORMAT "%9.4" /end MEASUREMENT
/begin MEASUREMENT Rf_fvns_k "relative Füllung Vanos, korr" SWORD _CNV_R_R_Def_rf_sw__598_CM 1 100. -327.68 327.67 DISPLAY_IDENTIFIER RF_FVNS_K ECU_ADDRESS 0xd000e5be FORMAT "%9.4" /end MEASUREMENT
/begin MEASUREMENT Rf_fvns_tkor "relative Füllung Vanos, temp. korr" SWORD _CNV_R_R_Def_rf_sw__598_CM 1 100. -327.68 327.67 DISPLAY_IDENTIFIER RF_FVNS_TKOR ECU_ADDRESS 0xd000e5bc FORMAT "%9.4" /end MEASUREMENT
/begin MEASUREMENT Rf_max_ext "max. zulaessiges Rf begrenzt durch AGR und TE (gemittelt)" SWORD _CNV_R_R_Def_rf_sw__598_CM 1 100. -327.68 327.67 DISPLAY_IDENTIFIER RF_MAX_EXT ECU_ADDRESS 0xd000e514 FORMAT "%9.4" /end MEASUREMENT
/begin MEASUREMENT Rf_max_ext_i "max. zulaessiges Rf begrenzt durch AGR und TE" SWORD _CNV_R_R_Def_rf_sw__598_CM 1 100. -327.68 327.67 DISPLAY_IDENTIFIER RF_MAX_EXT_I ECU_ADDRESS 0xd000e510 FORMAT "%9.4" ARRAY_SIZE 2 MATRIX_DIM 2 1 1 /end MEASUREMENT
/begin MEASUREMENT Rf_soll_g_i "" SWORD _CNV_R_R_Def_rf_sw__598_CM 1 100. -327.68 327.67 DISPLAY_IDENTIFIER RF_SOLL_G_I ECU_ADDRESS 0xd000e5a2 FORMAT "%9.4" ARRAY_SIZE 2 MATRIX_DIM 2 1 1 /end MEASUREMENT
/begin MEASUREMENT Rft_i "" SWORD _CNV_R_R_Def_rf_sw__598_CM 1 100. -327.68 327.67 DISPLAY_IDENTIFIER RFT_I ECU_ADDRESS 0xd000e592 FORMAT "%9.4" ARRAY_SIZE 2 MATRIX_DIM 2 1 1 /end MEASUREMENT
/begin MEASUREMENT Rft_lin_i "" SWORD _CNV_R_R_Def_rf_sw__598_CM 1 100. -327.68 327.67 DISPLAY_IDENTIFIER RFT_LIN_I ECU_ADDRESS 0xd000e596 FORMAT "%9.4" ARRAY_SIZE 2 MATRIX_DIM 2 1 1 /end MEASUREMENT
/begin MEASUREMENT Rft_nl_i "" SWORD _CNV_R_R_Def_rf_sw__598_CM 1 100. -327.68 327.67 DISPLAY_IDENTIFIER RFT_NL_I ECU_ADDRESS 0xd000e59a FORMAT "%9.4" ARRAY_SIZE 2 MATRIX_DIM 2 1 1 /end MEASUREMENT
/begin MEASUREMENT Rfv_fvns_mem "Speichervar für Rfv_vnsdk_gew-Filterung" SLONG _CNV_R_R_Def_dez_sl_551_CM 1 100. -2147483648. 2147483647. DISPLAY_IDENTIFIER RFV_FVNS_MEM ECU_ADDRESS 0xd000e5dc FORMAT "%7.0" /end MEASUREMENT
/begin MEASUREMENT Rfv_hub "relative Füllung für Vvt" SWORD _CNV_R_R_Def_rf_sw__598_CM 1 100. -327.68 327.67 DISPLAY_IDENTIFIER RFV_HUB ECU_ADDRESS 0xd000e53a FORMAT "%9.4" /end MEASUREMENT
/begin MEASUREMENT Rfv_min "minimale relative Luftfüllung VNS- druck- und temperaturkorrigiert" SWORD _CNV_R_R_Def_rf_sw__598_CM 1 100. -327.68 327.67 DISPLAY_IDENTIFIER RFV_MIN ECU_ADDRESS 0xd000e50c FORMAT "%9.4" /end MEASUREMENT
/begin MEASUREMENT Rfv_mpr "relative Füllung für Vvt (Mittelwert über beide Bänke)" SWORD _CNV_R_R_Def_rf_sw__598_CM 1 100. -327.68 327.67 DISPLAY_IDENTIFIER RFV_MPR ECU_ADDRESS 0xd000e5c6 FORMAT "%9.4" /end MEASUREMENT
/begin MEASUREMENT Rfv_mpr_i "relative Füllung für Vvt" SWORD _CNV_R_R_Def_rf_sw__598_CM 1 100. -327.68 327.67 DISPLAY_IDENTIFIER RFV_MPR_I ECU_ADDRESS 0xd000e5c2 FORMAT "%9.4" ARRAY_SIZE 2 MATRIX_DIM 2 1 1 /end MEASUREMENT
/begin MEASUREMENT Rfv_mxdk_i "" SWORD _CNV_R_R_Def_rf_sw__598_CM 1 100. -327.68 327.67 DISPLAY_IDENTIFIER RFV_MXDK_I ECU_ADDRESS 0xd000e616 FORMAT "%9.4" ARRAY_SIZE 2 MATRIX_DIM 2 1 1 /end MEASUREMENT
/begin MEASUREMENT Rfv_pspvdk_smx_i "" SWORD _CNV_R_R_Def_rf_sw__598_CM 1 100. -327.68 327.67 DISPLAY_IDENTIFIER RFV_PSPVDK_SMX_I ECU_ADDRESS 0xd000e61a FORMAT "%9.4" ARRAY_SIZE 2 MATRIX_DIM 2 1 1 /end MEASUREMENT
/begin MEASUREMENT Rfv_soll "relative Luftfüllung - druck- und temperaturkorrigiert" SWORD _CNV_R_R_Def_rf_sw__598_CM 1 100. -327.68 327.67 DISPLAY_IDENTIFIER RFV_SOLL ECU_ADDRESS 0xd000e506 FORMAT "%9.4" /end MEASUREMENT
/begin MEASUREMENT Rfv_soll_dk "relative Luftfüllung DK-Pfad - druck- und temperaturkorrigiert (gemittelt)" SWORD _CNV_R_R_Def_rf_sw__598_CM 1 100. -327.68 327.67 DISPLAY_IDENTIFIER RFV_SOLL_DK ECU_ADDRESS 0xd000e566 FORMAT "%9.4" /end MEASUREMENT
/begin MEASUREMENT Rfv_soll_dk_i "relative Luftfüllung DK-Pfad - druck- und temperaturkorrigiert (Bankweise)" SWORD _CNV_R_R_Def_rf_sw__598_CM 1 100. -327.68 327.67 DISPLAY_IDENTIFIER RFV_SOLL_DK_I ECU_ADDRESS 0xd000e568 FORMAT "%9.4" ARRAY_SIZE 2 MATRIX_DIM 2 1 1 /end MEASUREMENT
/begin MEASUREMENT Rfv_soll_h_i "relative Luftfüllung homogen - druck- und temperaturkorrigiert" SWORD _CNV_R_R_Def_rf_sw__598_CM 1 100. -327.68 327.67 DISPLAY_IDENTIFIER RFV_SOLL_H_I ECU_ADDRESS 0xd000e508 FORMAT "%9.4" ARRAY_SIZE 2 MATRIX_DIM 2 1 1 /end MEASUREMENT
/begin MEASUREMENT Rfv_soll_i "relative Luftfüllung - druck- und temperaturkorrigiert" SWORD _CNV_R_R_Def_rf_sw__598_CM 1 100. -327.68 327.67 DISPLAY_IDENTIFIER RFV_SOLL_I ECU_ADDRESS 0xd000e502 FORMAT "%9.4" ARRAY_SIZE 2 MATRIX_DIM 2 1 1 /end MEASUREMENT
/begin MEASUREMENT Rfv_solldk_i "" SWORD _CNV_R_R_Def_rf_sw__598_CM 1 100. -327.68 327.67 DISPLAY_IDENTIFIER RFV_SOLLDK_I ECU_ADDRESS 0xd000e61e FORMAT "%9.4" ARRAY_SIZE 2 MATRIX_DIM 2 1 1 /end MEASUREMENT
/begin MEASUREMENT Rfv_vns "relative Füllung für Vanos" SWORD _CNV_R_R_Def_rf_sw__598_CM 1 100. -327.68 327.67 DISPLAY_IDENTIFIER RFV_VNS ECU_ADDRESS 0xd000e53c FORMAT "%9.4" /end MEASUREMENT
/begin MEASUREMENT Rfv_vns_dk "relative Füllung für Dk gedrosselt" SWORD _CNV_R_R_Def_rf_sw__598_CM 1 100. -327.68 327.67 DISPLAY_IDENTIFIER RFV_VNS_DK ECU_ADDRESS 0xd000e57e FORMAT "%9.4" /end MEASUREMENT
/begin MEASUREMENT Rfv_vns_roh "relative Luftfüllung VNS- ohne Dashkorrektur" SWORD _CNV_R_R_Def_rf_sw__598_CM 1 100. -327.68 327.67 DISPLAY_IDENTIFIER RFV_VNS_ROH ECU_ADDRESS 0xd000e50e FORMAT "%9.4" /end MEASUREMENT
/begin MEASUREMENT Rfv_vnsdk_mem "Speichervar für Rfv_vnsdk_gew-Filterung" SLONG _CNV_R_R_Def_dez_sl_551_CM 1 100. -2147483648. 2147483647. DISPLAY_IDENTIFIER RFV_VNSDK_MEM ECU_ADDRESS 0xd000e5d8 FORMAT "%7.0" /end MEASUREMENT
/begin MEASUREMENT Rfv_vnsdk_roh "relative Füllung für Vvt" SWORD _CNV_R_R_Def_rf_sw__598_CM 1 100. -327.68 327.67 DISPLAY_IDENTIFIER RFV_VNSDK_ROH ECU_ADDRESS 0xd000e5c0 FORMAT "%9.4" /end MEASUREMENT
/begin MEASUREMENT Rfv_vnsdk_ubeg "relative Füllung für Vanos, unbegrenzt" SWORD _CNV_R_R_Def_rf_sw__598_CM 1 100. -327.68 327.67 DISPLAY_IDENTIFIER RFV_VNSDK_UBEG ECU_ADDRESS 0xd000e580 FORMAT "%9.4" /end MEASUREMENT
/begin MEASUREMENT St_bls_global "Statuswort f. Laststeuerung" UBYTE _CNV_R_R_Def_dez_sl_551_CM 1 100. 0. 255. DISPLAY_IDENTIFIER ST_BLS_GLOBAL ECU_ADDRESS 0xd000e4fe FORMAT "%3.0" /end MEASUREMENT
/begin MEASUREMENT St_bls_global.B_ls_20ms "Bankselektives Berechnung im 20ms Raster" UBYTE _CNV_S_2_Def_bit_ub_563_CM 1 100. 0. 1. DISPLAY_IDENTIFIER B_LS_20MS ECU_ADDRESS 0xd000e4fe BIT_MASK 0x1 /end MEASUREMENT
/begin MEASUREMENT St_blshub "Statuswort BLSHUB" UBYTE _CNV_R_R_Def_dez_sl_551_CM 1 100. 0. 255. DISPLAY_IDENTIFIER ST_BLSHUB ECU_ADDRESS 0xd000e688 FORMAT "%3.0" /end MEASUREMENT
/begin MEASUREMENT St_blshub.B_fhubvnsi_ini "Bedingung Initialisierung B_fhubvnsi_ini" UBYTE _CNV_S_2_Def_bit_ub_563_CM 1 100. 0. 1. DISPLAY_IDENTIFIER B_FHUBVNSI_INI ECU_ADDRESS 0xd000e688 BIT_MASK 0x80 /end MEASUREMENT
/begin MEASUREMENT St_blshub.B_hubst "Bedingung Einlassventilhubvorsteuerung im Start" UBYTE _CNV_S_2_Def_bit_ub_563_CM 1 100. 0. 1. DISPLAY_IDENTIFIER B_HUBST ECU_ADDRESS 0xd000e688 BIT_MASK 0x8 /end MEASUREMENT
/begin MEASUREMENT St_blshub.B_llk "Bedingung nwe unterschritten (hysteresebehaftet)" UBYTE _CNV_S_2_Def_bit_ub_563_CM 1 100. 0. 1. DISPLAY_IDENTIFIER B_LLK ECU_ADDRESS 0xd000e688 BIT_MASK 0x2 /end MEASUREMENT
/begin MEASUREMENT St_blshub.B_nwe "Bedingung Nockenwellenendstufe angesteuert" UBYTE _CNV_S_2_Def_bit_ub_563_CM 1 100. 0. 1. DISPLAY_IDENTIFIER B_NWE ECU_ADDRESS 0xd000e688 BIT_MASK 0x1 /end MEASUREMENT
/begin MEASUREMENT St_blshub.B_vns_spron "Bedingung Berechnung Fhubvnsi mit Sollspreizungen" UBYTE _CNV_S_2_Def_bit_ub_563_CM 1 100. 0. 1. DISPLAY_IDENTIFIER B_VNS_SPRON ECU_ADDRESS 0xd000e688 BIT_MASK 0x40 /end MEASUREMENT
/begin MEASUREMENT St_blshub.B_vsean_loc "Bedingung EVANOS im Anschlag beim letzten Abstellen" UBYTE _CNV_S_2_Def_bit_ub_563_CM 1 100. 0. 1. DISPLAY_IDENTIFIER B_VSEAN_LOC ECU_ADDRESS 0xd000e688 BIT_MASK 0x20 /end MEASUREMENT
/begin MEASUREMENT St_blshub.B_vvtclose "Bedingung Einlassventilhub herunterfahren" UBYTE _CNV_S_2_Def_bit_ub_563_CM 1 100. 0. 1. DISPLAY_IDENTIFIER B_VVTCLOSE ECU_ADDRESS 0xd000e688 BIT_MASK 0x4 /end MEASUREMENT
/begin MEASUREMENT St_blshub2 "Statuswort BLSHUB 2" UBYTE _CNV_R_R_Def_dez_sl_551_CM 1 100. 0. 255. DISPLAY_IDENTIFIER ST_BLSHUB2 ECU_ADDRESS 0xd000e689 FORMAT "%3.0" /end MEASUREMENT
/begin MEASUREMENT St_blshub2.B_hkll "Bedingung Hubkorrektur wird gestartet" UBYTE _CNV_S_2_Def_bit_ub_563_CM 1 100. 0. 1. DISPLAY_IDENTIFIER B_HKLL ECU_ADDRESS 0xd000e689 BIT_MASK 0x4 /end MEASUREMENT
/begin MEASUREMENT St_blshub2.B_hkll_edge1 "-" UBYTE _CNV_S_2_Def_bit_ub_563_CM 1 100. 0. 1. DISPLAY_IDENTIFIER B_HKLL_EDGE1 ECU_ADDRESS 0xd000e689 BIT_MASK 0x10 /end MEASUREMENT
/begin MEASUREMENT St_blshub2.B_hkll_edge2 "-" UBYTE _CNV_S_2_Def_bit_ub_563_CM 1 100. 0. 1. DISPLAY_IDENTIFIER B_HKLL_EDGE2 ECU_ADDRESS 0xd000e689 BIT_MASK 0x20 /end MEASUREMENT
/begin MEASUREMENT St_blshub2.B_hkll_edge3 "-" UBYTE _CNV_S_2_Def_bit_ub_563_CM 1 100. 0. 1. DISPLAY_IDENTIFIER B_HKLL_EDGE3 ECU_ADDRESS 0xd000e689 BIT_MASK 0x40 /end MEASUREMENT
/begin MEASUREMENT St_blshub2.B_hkll_pre "Bedingung Hubkorrektur wird angefordert" UBYTE _CNV_S_2_Def_bit_ub_563_CM 1 100. 0. 1. DISPLAY_IDENTIFIER B_HKLL_PRE ECU_ADDRESS 0xd000e689 BIT_MASK 0x1 /end MEASUREMENT
/begin MEASUREMENT St_blshub2.B_hkll_vz "Bedingung Verstellung nach Hubkorrektur abwarten" UBYTE _CNV_S_2_Def_bit_ub_563_CM 1 100. 0. 1. DISPLAY_IDENTIFIER B_HKLL_VZ ECU_ADDRESS 0xd000e689 BIT_MASK 0x2 /end MEASUREMENT
/begin MEASUREMENT St_blshub2.B_hubsolldif "Bedingung Sollhub bewegt sich" UBYTE _CNV_S_2_Def_bit_ub_563_CM 1 100. 0. 1. DISPLAY_IDENTIFIER B_HUBSOLLDIF ECU_ADDRESS 0xd000e689 BIT_MASK 0x8 /end MEASUREMENT
/begin MEASUREMENT St_blstd "Status BLS Teildrosselung" UBYTE _CNV_R_R_Def_dez_sl_551_CM 1 100. 0. 255. DISPLAY_IDENTIFIER ST_BLSTD ECU_ADDRESS 0xd000e4fd FORMAT "%3.0" /end MEASUREMENT
/begin MEASUREMENT St_blstd.B_lltd "Status BLS Teildrosselung" UBYTE _CNV_S_2_Def_bit_ub_563_CM 1 100. 0. 1. DISPLAY_IDENTIFIER B_LLTD ECU_ADDRESS 0xd000e4fd BIT_MASK 0x1 /end MEASUREMENT
/begin MEASUREMENT St_blstd.B_lltd_old "Status BLS Teildrosselung" UBYTE _CNV_S_2_Def_bit_ub_563_CM 1 100. 0. 1. DISPLAY_IDENTIFIER B_LLTD_OLD ECU_ADDRESS 0xd000e4fd BIT_MASK 0x4 /end MEASUREMENT
/begin MEASUREMENT St_blstd.B_lltd_vz "Status BLS Teildrosselung" UBYTE _CNV_S_2_Def_bit_ub_563_CM 1 100. 0. 1. DISPLAY_IDENTIFIER B_LLTD_VZ ECU_ADDRESS 0xd000e4fd BIT_MASK 0x2 /end MEASUREMENT
/begin MEASUREMENT St_blstd.B_pssolnl_akt "Status BLS Teildrosselung" UBYTE _CNV_S_2_Def_bit_ub_563_CM 1 100. 0. 1. DISPLAY_IDENTIFIER B_PSSOLNL_AKT ECU_ADDRESS 0xd000e4fd BIT_MASK 0x10 /end MEASUREMENT
/begin MEASUREMENT St_cbsoz_nv0 "Statuswort" UBYTE _CNV_R_R_Def_dez_sl_551_CM 1 100. 0. 255. DISPLAY_IDENTIFIER ST_CBSOZ_NV0 ECU_ADDRESS 0xc00040c4 FORMAT "%3.0" /end MEASUREMENT
/begin MEASUREMENT St_cbsoz_nv0.B_ozcntini "Tageberechnung initialisiert" UBYTE _CNV_S_2_Def_bit_ub_563_CM 1 100. 0. 1. DISPLAY_IDENTIFIER B_OZCNTINI ECU_ADDRESS 0xc00040c4 BIT_MASK 0x4 /end MEASUREMENT
/begin MEASUREMENT St_cbsoz_nv0.B_ozini "Basis CBS-Initialisierung nach Daten-Verlust" UBYTE _CNV_S_2_Def_bit_ub_563_CM 1 100. 0. 1. DISPLAY_IDENTIFIER B_OZINI ECU_ADDRESS 0xc00040c4 BIT_MASK 0x2 /end MEASUREMENT
/begin MEASUREMENT St_cbsoz_nv0.B_rwanz0 "Bedingung für Restweganzeige = Null" UBYTE _CNV_S_2_Def_bit_ub_563_CM 1 100. 0. 1. DISPLAY_IDENTIFIER B_RWANZ0 ECU_ADDRESS 0xc00040c4 BIT_MASK 0x1 /end MEASUREMENT
/begin MEASUREMENT St_cbsozin0 "Statuswort" UBYTE _CNV_R_R_Def_dez_sl_551_CM 1 100. 0. 255. DISPLAY_IDENTIFIER ST_CBSOZIN0 ECU_ADDRESS 0xd000cf7c FORMAT "%3.0" /end MEASUREMENT
/begin MEASUREMENT St_cbsozin0.B_oelwech "Bedingung Ölwechsel erfolgt" UBYTE _CNV_S_2_Def_bit_ub_563_CM 1 100. 0. 1. DISPLAY_IDENTIFIER B_OELWECH ECU_ADDRESS 0xd000cf7c BIT_MASK 0x1 /end MEASUREMENT
/begin MEASUREMENT St_cbsozin0.B_ozmanip "CBS-Daten manipuliert" UBYTE _CNV_S_2_Def_bit_ub_563_CM 1 100. 0. 1. DISPLAY_IDENTIFIER B_OZMANIP ECU_ADDRESS 0xd000cf7c BIT_MASK 0x80 /end MEASUREMENT
/begin MEASUREMENT St_cbsozin0.B_ozvfchg "Bedingung für geänderte Verfügbarkeit" UBYTE _CNV_S_2_Def_bit_ub_563_CM 1 100. 0. 1. DISPLAY_IDENTIFIER B_OZVFCHG ECU_ADDRESS 0xd000cf7c BIT_MASK 0x2 /end MEASUREMENT
/begin MEASUREMENT St_cbsozin0.B_ozvfchgc "Bedingung für geänderte Verfügbarkeit vom Kombi über Restweg" UBYTE _CNV_S_2_Def_bit_ub_563_CM 1 100. 0. 1. DISPLAY_IDENTIFIER B_OZVFCHGC ECU_ADDRESS 0xd000cf7c BIT_MASK 0x20 /end MEASUREMENT
/begin MEASUREMENT St_cbsozin0.B_ozvfchgcc "Bedingung für geänderte Verfügbarkeit vom Kombi" UBYTE _CNV_S_2_Def_bit_ub_563_CM 1 100. 0. 1. DISPLAY_IDENTIFIER B_OZVFCHGCC ECU_ADDRESS 0xd000cf7c BIT_MASK 0x40 /end MEASUREMENT
/begin MEASUREMENT St_cbsozin0.B_ozvfchgt "Änderung der Verfügbarkeit vom Tester" UBYTE _CNV_S_2_Def_bit_ub_563_CM 1 100. 0. 1. DISPLAY_IDENTIFIER B_OZVFCHGT ECU_ADDRESS 0xd000cf7c BIT_MASK 0x8 /end MEASUREMENT
/begin MEASUREMENT St_cbsozin0.B_ozzeitdmew "Neuer Zieltermin zu übernehmen" UBYTE _CNV_S_2_Def_bit_ub_563_CM 1 100. 0. 1. DISPLAY_IDENTIFIER B_OZZEITDMEW ECU_ADDRESS 0xd000cf7c BIT_MASK 0x10 /end MEASUREMENT
/begin MEASUREMENT St_cbsozin0.B_svcntchg "Bedingung für über Tester geänderten Servicezähler" UBYTE _CNV_S_2_Def_bit_ub_563_CM 1 100. 0. 1. DISPLAY_IDENTIFIER B_SVCNTCHG ECU_ADDRESS 0xd000cf7c BIT_MASK 0x4 /end MEASUREMENT
/begin MEASUREMENT St_cbsozin1 "Statuswort" UBYTE _CNV_R_R_Def_dez_sl_551_CM 1 100. 0. 255. DISPLAY_IDENTIFIER ST_CBSOZIN1 ECU_ADDRESS 0xd000cf7d FORMAT "%3.0" /end MEASUREMENT
/begin MEASUREMENT St_cbsozin1.B_ozreset "BOS Reset (Ölwechsel)" UBYTE _CNV_S_2_Def_bit_ub_563_CM 1 100. 0. 1. DISPLAY_IDENTIFIER B_OZRESET ECU_ADDRESS 0xd000cf7d BIT_MASK 0x4 /end MEASUREMENT
/begin MEASUREMENT St_cbsozin1.B_ozresetcan "Reset BOS vom Kombi (CAN)" UBYTE _CNV_S_2_Def_bit_ub_563_CM 1 100. 0. 1. DISPLAY_IDENTIFIER B_OZRESETCAN ECU_ADDRESS 0xd000cf7d BIT_MASK 0x2 /end MEASUREMENT
/begin MEASUREMENT St_cbsozin1.B_ozresett "Reset vom Tester" UBYTE _CNV_S_2_Def_bit_ub_563_CM 1 100. 0. 1. DISPLAY_IDENTIFIER B_OZRESETT ECU_ADDRESS 0xd000cf7d BIT_MASK 0x1 /end MEASUREMENT
/begin MEASUREMENT St_cbsozin_nv0 "Statuswort" UBYTE _CNV_R_R_Def_dez_sl_551_CM 1 100. 0. 255. DISPLAY_IDENTIFIER ST_CBSOZIN_NV0 ECU_ADDRESS 0xc00040e4 FORMAT "%3.0" /end MEASUREMENT
/begin MEASUREMENT St_cbsozin_nv0.B_dmeini "Bedingung für neue noch nicht initialisierte DME" UBYTE _CNV_S_2_Def_bit_ub_563_CM 1 100. 0. 1. DISPLAY_IDENTIFIER B_DMEINI ECU_ADDRESS 0xc00040e4 BIT_MASK 0x1 /end MEASUREMENT
/begin MEASUREMENT St_cbsozin_nv0.B_dmewech "Bedingung für getauschte DME zur Aktualisierung der BOS-Werte" UBYTE _CNV_S_2_Def_bit_ub_563_CM 1 100. 0. 1. DISPLAY_IDENTIFIER B_DMEWECH ECU_ADDRESS 0xc00040e4 BIT_MASK 0x2 /end MEASUREMENT
/begin MEASUREMENT St_cbsozin_nv0.B_factoryres "CBS Factory-Reset angefordert" UBYTE _CNV_S_2_Def_bit_ub_563_CM 1 100. 0. 1. DISPLAY_IDENTIFIER B_FACTORYRES ECU_ADDRESS 0xc00040e4 BIT_MASK 0x4 /end MEASUREMENT
/begin MEASUREMENT St_cbsozout0 "Statuswort" UBYTE _CNV_R_R_Def_dez_sl_551_CM 1 100. 0. 255. DISPLAY_IDENTIFIER ST_CBSOZOUT0 ECU_ADDRESS 0xd000cf80 FORMAT "%3.0" /end MEASUREMENT
/begin MEASUREMENT St_cbsozout0.B_bosmsgc "Bedingung für Absetzen einer BOS-Meldung" UBYTE _CNV_S_2_Def_bit_ub_563_CM 1 100. 0. 1. DISPLAY_IDENTIFIER B_BOSMSGC ECU_ADDRESS 0xd000cf80 BIT_MASK 0x1 /end MEASUREMENT
/begin MEASUREMENT St_cbsozout0.B_ozbosanf "Anforderung Daten Senden vom Tester" UBYTE _CNV_S_2_Def_bit_ub_563_CM 1 100. 0. 1. DISPLAY_IDENTIFIER B_OZBOSANF ECU_ADDRESS 0xd000cf80 BIT_MASK 0x8 /end MEASUREMENT
/begin MEASUREMENT St_cbsozout0.B_ozbosneu "Neue BOS-Daten zu schicken" UBYTE _CNV_S_2_Def_bit_ub_563_CM 1 100. 0. 1. DISPLAY_IDENTIFIER B_OZBOSNEU ECU_ADDRESS 0xd000cf80 BIT_MASK 0x4 /end MEASUREMENT
/begin MEASUREMENT St_cbsozout0.B_ozbossend "Senden der CBS-Daten erforderlich" UBYTE _CNV_S_2_Def_bit_ub_563_CM 1 100. 0. 1. DISPLAY_IDENTIFIER B_OZBOSSEND ECU_ADDRESS 0xd000cf80 BIT_MASK 0x2 /end MEASUREMENT
/begin MEASUREMENT St_cbsozout0.B_ozneubos "Geänderte BOS-Daten " UBYTE _CNV_S_2_Def_bit_ub_563_CM 1 100. 0. 1. DISPLAY_IDENTIFIER B_OZNEUBOS ECU_ADDRESS 0xd000cf80 BIT_MASK 0x10 /end MEASUREMENT
/begin MEASUREMENT St_cbsozout_nv0 "Statuswort" UBYTE _CNV_R_R_Def_dez_sl_551_CM 1 100. 0. 255. DISPLAY_IDENTIFIER ST_CBSOZOUT_NV0 ECU_ADDRESS 0xc00040f0 FORMAT "%3.0" /end MEASUREMENT
/begin MEASUREMENT St_cbsozout_nv0.B_ozkl15 "Merker für Einschalten Kl. 15" UBYTE _CNV_S_2_Def_bit_ub_563_CM 1 100. 0. 1. DISPLAY_IDENTIFIER B_OZKL15 ECU_ADDRESS 0xc00040f0 BIT_MASK 0x1 /end MEASUREMENT
/begin MEASUREMENT St_cbsozout_nv0.B_ozpeilerr "Fehlerfall, die Prognose wird angezeigt" UBYTE _CNV_S_2_Def_bit_ub_563_CM 1 100. 0. 1. DISPLAY_IDENTIFIER B_OZPEILERR ECU_ADDRESS 0xc00040f0 BIT_MASK 0x2 /end MEASUREMENT
/begin MEASUREMENT St_deavns "Statuswort DEAVANOS" UBYTE _CNV_R_R_Def_dez_sl_551_CM 1 100. 0. 255. DISPLAY_IDENTIFIER ST_DEAVNS ECU_ADDRESS 0xc0007b64 FORMAT "%3.0" /end MEASUREMENT
/begin MEASUREMENT St_deavns.B_an2wmn "Fehler Anschlagadaption Auslass Bank 2" UBYTE _CNV_S_2_Def_bit_ub_563_CM 1 100. 0. 1. DISPLAY_IDENTIFIER B_AN2WMN ECU_ADDRESS 0xc0007b64 BIT_MASK 0x80 /end MEASUREMENT
/begin MEASUREMENT St_deavns.B_an2wpnp "Fehler Lagereglerüberwachung Auslass Bank 2" UBYTE _CNV_S_2_Def_bit_ub_563_CM 1 100. 0. 1. DISPLAY_IDENTIFIER B_AN2WPNP ECU_ADDRESS 0xc0007b64 BIT_MASK 0x8 /end MEASUREMENT
/begin MEASUREMENT St_deavns.B_anwmn "Fehler Anschlagadaption Auslass Bank 1" UBYTE _CNV_S_2_Def_bit_ub_563_CM 1 100. 0. 1. DISPLAY_IDENTIFIER B_ANWMN ECU_ADDRESS 0xc0007b64 BIT_MASK 0x20 /end MEASUREMENT
/begin MEASUREMENT St_deavns.B_anwpnp "Fehler Lagereglerüberwachung Auslass Bank 1" UBYTE _CNV_S_2_Def_bit_ub_563_CM 1 100. 0. 1. DISPLAY_IDENTIFIER B_ANWPNP ECU_ADDRESS 0xc0007b64 BIT_MASK 0x2 /end MEASUREMENT
/begin MEASUREMENT St_deavns.B_en2wmn "Fehler Anschlagadaption Einlass Bank 2" UBYTE _CNV_S_2_Def_bit_ub_563_CM 1 100. 0. 1. DISPLAY_IDENTIFIER B_EN2WMN ECU_ADDRESS 0xc0007b64 BIT_MASK 0x40 /end MEASUREMENT
/begin MEASUREMENT St_deavns.B_en2wpnp "Fehler Lagereglerüberwachung Einlass Bank 2" UBYTE _CNV_S_2_Def_bit_ub_563_CM 1 100. 0. 1. DISPLAY_IDENTIFIER B_EN2WPNP ECU_ADDRESS 0xc0007b64 BIT_MASK 0x4 /end MEASUREMENT
/begin MEASUREMENT St_deavns.B_enwmn "Fehler Anschlagadaption Einlass Bank 1" UBYTE _CNV_S_2_Def_bit_ub_563_CM 1 100. 0. 1. DISPLAY_IDENTIFIER B_ENWMN ECU_ADDRESS 0xc0007b64 BIT_MASK 0x10 /end MEASUREMENT
/begin MEASUREMENT St_deavns.B_enwpnp "Fehler Lagereglerüberwachung Einlass Bank 1" UBYTE _CNV_S_2_Def_bit_ub_563_CM 1 100. 0. 1. DISPLAY_IDENTIFIER B_ENWPNP ECU_ADDRESS 0xc0007b64 BIT_MASK 0x1 /end MEASUREMENT
/begin MEASUREMENT St_deavns2 "Statuswort DEAVANOS2" UBYTE _CNV_R_R_Def_dez_sl_551_CM 1 100. 0. 255. DISPLAY_IDENTIFIER ST_DEAVNS2 ECU_ADDRESS 0xc00049a8 FORMAT "%3.0" /end MEASUREMENT
/begin MEASUREMENT St_deavns2.B_an2woto "Bedingung Vanos Auslass Bank2 One-Tooth-Off" UBYTE _CNV_S_2_Def_bit_ub_563_CM 1 100. 0. 1. DISPLAY_IDENTIFIER B_AN2WOTO ECU_ADDRESS 0xc00049a8 BIT_MASK 0x80 /end MEASUREMENT
/begin MEASUREMENT St_deavns2.B_anwoto "Bedingung Vanos Auslass Bank1 One-Tooth-Off" UBYTE _CNV_S_2_Def_bit_ub_563_CM 1 100. 0. 1. DISPLAY_IDENTIFIER B_ANWOTO ECU_ADDRESS 0xc00049a8 BIT_MASK 0x20 /end MEASUREMENT
/begin MEASUREMENT St_deavns2.B_en2woto "Bedingung Vanos Einlass Bank2 One-Tooth-Off" UBYTE _CNV_S_2_Def_bit_ub_563_CM 1 100. 0. 1. DISPLAY_IDENTIFIER B_EN2WOTO ECU_ADDRESS 0xc00049a8 BIT_MASK 0x40 /end MEASUREMENT
/begin MEASUREMENT St_deavns2.B_enwoto "Bedingung Vanos Einlass Bank1 One-Tooth-Off" UBYTE _CNV_S_2_Def_bit_ub_563_CM 1 100. 0. 1. DISPLAY_IDENTIFIER B_ENWOTO ECU_ADDRESS 0xc00049a8 BIT_MASK 0x10 /end MEASUREMENT
/begin MEASUREMENT St_deavns2.B_vsa_an "Bedingung Vanos Auslass Bank1 im Anschlag" UBYTE _CNV_S_2_Def_bit_ub_563_CM 1 100. 0. 1. DISPLAY_IDENTIFIER B_VSA_AN ECU_ADDRESS 0xc00049a8 BIT_MASK 0x2 /end MEASUREMENT
/begin MEASUREMENT St_deavns2.B_vsa_an2 "Bedingung Vanos Auslass Bank2 im Anschlag" UBYTE _CNV_S_2_Def_bit_ub_563_CM 1 100. 0. 1. DISPLAY_IDENTIFIER B_VSA_AN2 ECU_ADDRESS 0xc00049a8 BIT_MASK 0x8 /end MEASUREMENT
/begin MEASUREMENT St_deavns2.B_vse_an "Bedingung Vanos Einlass Bank1 im Anschlag" UBYTE _CNV_S_2_Def_bit_ub_563_CM 1 100. 0. 1. DISPLAY_IDENTIFIER B_VSE_AN ECU_ADDRESS 0xc00049a8 BIT_MASK 0x1 /end MEASUREMENT
/begin MEASUREMENT St_deavns2.B_vse_an2 "Bedingung Vanos Einlass Bank2 im Anschlag" UBYTE _CNV_S_2_Def_bit_ub_563_CM 1 100. 0. 1. DISPLAY_IDENTIFIER B_VSE_AN2 ECU_ADDRESS 0xc00049a8 BIT_MASK 0x4 /end MEASUREMENT
/begin MEASUREMENT St_deavns3 "Statuswort DEAVANOS3" UBYTE _CNV_R_R_Def_dez_sl_551_CM 1 100. 0. 255. DISPLAY_IDENTIFIER ST_DEAVNS3 ECU_ADDRESS 0xd000e47d FORMAT "%3.0" /end MEASUREMENT
/begin MEASUREMENT St_deavns3.B_an2wmn_dis "Bedingung Anschlagadaptionsfehler Auslass Bank 2 gesperrt" UBYTE _CNV_S_2_Def_bit_ub_563_CM 1 100. 0. 1. DISPLAY_IDENTIFIER B_AN2WMN_DIS ECU_ADDRESS 0xd000e47d BIT_MASK 0x80 /end MEASUREMENT
/begin MEASUREMENT St_deavns3.B_an2wpnp_dis "Bedingung Lagereglerüberwachung Auslass Bank 2 gesperrt" UBYTE _CNV_S_2_Def_bit_ub_563_CM 1 100. 0. 1. DISPLAY_IDENTIFIER B_AN2WPNP_DIS ECU_ADDRESS 0xd000e47d BIT_MASK 0x8 /end MEASUREMENT
/begin MEASUREMENT St_deavns3.B_anwmn_dis "Bedingung Anschlagadaptionsfehler Auslass Bank 1 gesperrt" UBYTE _CNV_S_2_Def_bit_ub_563_CM 1 100. 0. 1. DISPLAY_IDENTIFIER B_ANWMN_DIS ECU_ADDRESS 0xd000e47d BIT_MASK 0x20 /end MEASUREMENT
/begin MEASUREMENT St_deavns3.B_anwpnp_dis "Bedingung Lagereglerüberwachung Auslass Bank 1 gesperrt" UBYTE _CNV_S_2_Def_bit_ub_563_CM 1 100. 0. 1. DISPLAY_IDENTIFIER B_ANWPNP_DIS ECU_ADDRESS 0xd000e47d BIT_MASK 0x2 /end MEASUREMENT
/begin MEASUREMENT St_deavns3.B_en2wmn_dis "Bedingung Anschlagadaptionsfehler Einlass Bank 2 gesperrt" UBYTE _CNV_S_2_Def_bit_ub_563_CM 1 100. 0. 1. DISPLAY_IDENTIFIER B_EN2WMN_DIS ECU_ADDRESS 0xd000e47d BIT_MASK 0x40 /end MEASUREMENT
/begin MEASUREMENT St_deavns3.B_en2wpnp_dis "Bedingung Lagereglerüberwachung Einlass Bank 2 gesperrt" UBYTE _CNV_S_2_Def_bit_ub_563_CM 1 100. 0. 1. DISPLAY_IDENTIFIER B_EN2WPNP_DIS ECU_ADDRESS 0xd000e47d BIT_MASK 0x4 /end MEASUREMENT
/begin MEASUREMENT St_deavns3.B_enwmn_dis "Bedingung Anschlagadaptionsfehler Einlass Bank 1 gesperrt" UBYTE _CNV_S_2_Def_bit_ub_563_CM 1 100. 0. 1. DISPLAY_IDENTIFIER B_ENWMN_DIS ECU_ADDRESS 0xd000e47d BIT_MASK 0x10 /end MEASUREMENT
/begin MEASUREMENT St_deavns3.B_enwpnp_dis "Bedingung Lagereglerüberwachung Einlass Bank 1 gesperrt" UBYTE _CNV_S_2_Def_bit_ub_563_CM 1 100. 0. 1. DISPLAY_IDENTIFIER B_ENWPNP_DIS ECU_ADDRESS 0xd000e47d BIT_MASK 0x1 /end MEASUREMENT
/begin MEASUREMENT St_deavns4 "Statuswort DEAVANOS4" UBYTE _CNV_R_R_Def_dez_sl_551_CM 1 100. 0. 255. DISPLAY_IDENTIFIER ST_DEAVNS4 ECU_ADDRESS 0xd000e47e FORMAT "%3.0" /end MEASUREMENT
/begin MEASUREMENT St_deavns4.B_an2woto_dis "Bedingung One-Tooth-Off-Diagnose Auslass Bank 2 gesperrt" UBYTE _CNV_S_2_Def_bit_ub_563_CM 1 100. 0. 1. DISPLAY_IDENTIFIER B_AN2WOTO_DIS ECU_ADDRESS 0xd000e47e BIT_MASK 0x8 /end MEASUREMENT
/begin MEASUREMENT St_deavns4.B_anwoto_dis "Bedingung One-Tooth-Off-Diagnose Auslass Bank 1 gesperrt" UBYTE _CNV_S_2_Def_bit_ub_563_CM 1 100. 0. 1. DISPLAY_IDENTIFIER B_ANWOTO_DIS ECU_ADDRESS 0xd000e47e BIT_MASK 0x2 /end MEASUREMENT
/begin MEASUREMENT St_deavns4.B_en2woto_dis "Bedingung One-Tooth-Off-Diagnose Einlass Bank 2 gesperrt" UBYTE _CNV_S_2_Def_bit_ub_563_CM 1 100. 0. 1. DISPLAY_IDENTIFIER B_EN2WOTO_DIS ECU_ADDRESS 0xd000e47e BIT_MASK 0x4 /end MEASUREMENT
/begin MEASUREMENT St_deavns4.B_enwoto_dis "Bedingung One-Tooth-Off-Diagnose Einlass Bank 1 gesperrt" UBYTE _CNV_S_2_Def_bit_ub_563_CM 1 100. 0. 1. DISPLAY_IDENTIFIER B_ENWOTO_DIS ECU_ADDRESS 0xd000e47e BIT_MASK 0x1 /end MEASUREMENT
/begin MEASUREMENT St_deavns5 "Statuswort DEAVANOS5" UBYTE _CNV_R_R_Def_dez_sl_551_CM 1 100. 0. 255. DISPLAY_IDENTIFIER ST_DEAVNS5 ECU_ADDRESS 0xd000e47f FORMAT "%3.0" /end MEASUREMENT
/begin MEASUREMENT St_deavns5.B_an2wmn_rbmc "Bedingung Anschlagadaptionsüberwachung Auslass Bank 2 RBM completed" UBYTE _CNV_S_2_Def_bit_ub_563_CM 1 100. 0. 1. DISPLAY_IDENTIFIER B_AN2WMN_RBMC ECU_ADDRESS 0xd000e47f BIT_MASK 0x80 /end MEASUREMENT
/begin MEASUREMENT St_deavns5.B_an2wpnp_rbmc "Bedingung Lagereglerüberwachung Auslass Bank 2 RBM completed" UBYTE _CNV_S_2_Def_bit_ub_563_CM 1 100. 0. 1. DISPLAY_IDENTIFIER B_AN2WPNP_RBMC ECU_ADDRESS 0xd000e47f BIT_MASK 0x8 /end MEASUREMENT
/begin MEASUREMENT St_deavns5.B_anwmn_rbmc "Bedingung Anschlagadaptionsüberwachung Auslass Bank 1 RBM completed" UBYTE _CNV_S_2_Def_bit_ub_563_CM 1 100. 0. 1. DISPLAY_IDENTIFIER B_ANWMN_RBMC ECU_ADDRESS 0xd000e47f BIT_MASK 0x20 /end MEASUREMENT
/begin MEASUREMENT St_deavns5.B_anwpnp_rbmc "Bedingung Lagereglerüberwachung Auslass Bank 1 RBM completed" UBYTE _CNV_S_2_Def_bit_ub_563_CM 1 100. 0. 1. DISPLAY_IDENTIFIER B_ANWPNP_RBMC ECU_ADDRESS 0xd000e47f BIT_MASK 0x2 /end MEASUREMENT
/begin MEASUREMENT St_deavns5.B_en2wmn_rbmc "Bedingung Anschlagadaptionsüberwachung Einlass Bank 2 RBM completed" UBYTE _CNV_S_2_Def_bit_ub_563_CM 1 100. 0. 1. DISPLAY_IDENTIFIER B_EN2WMN_RBMC ECU_ADDRESS 0xd000e47f BIT_MASK 0x40 /end MEASUREMENT
/begin MEASUREMENT St_deavns5.B_en2wpnp_rbmc "Bedingung Lagereglerüberwachung Einlass Bank 2 RBM completed" UBYTE _CNV_S_2_Def_bit_ub_563_CM 1 100. 0. 1. DISPLAY_IDENTIFIER B_EN2WPNP_RBMC ECU_ADDRESS 0xd000e47f BIT_MASK 0x4 /end MEASUREMENT
/begin MEASUREMENT St_deavns5.B_enwmn_rbmc "Bedingung Anschlagadaptionsüberwachung Einlass Bank 1 RBM completed" UBYTE _CNV_S_2_Def_bit_ub_563_CM 1 100. 0. 1. DISPLAY_IDENTIFIER B_ENWMN_RBMC ECU_ADDRESS 0xd000e47f BIT_MASK 0x10 /end MEASUREMENT
/begin MEASUREMENT St_deavns5.B_enwpnp_rbmc "Bedingung Lagereglerüberwachung Einlass Bank 1 RBM completed" UBYTE _CNV_S_2_Def_bit_ub_563_CM 1 100. 0. 1. DISPLAY_IDENTIFIER B_ENWPNP_RBMC ECU_ADDRESS 0xd000e47f BIT_MASK 0x1 /end MEASUREMENT
/begin MEASUREMENT St_deavns6 "Statuswort DEAVANOS6" UBYTE _CNV_R_R_Def_dez_sl_551_CM 1 100. 0. 255. DISPLAY_IDENTIFIER ST_DEAVNS6 ECU_ADDRESS 0xd000e480 FORMAT "%3.0" /end MEASUREMENT
/begin MEASUREMENT St_deavns6.B_an2wmn_rbmd "Bedingung Anschlagadaptionsüberwachung Auslass Bank 2 RBM disabled" UBYTE _CNV_S_2_Def_bit_ub_563_CM 1 100. 0. 1. DISPLAY_IDENTIFIER B_AN2WMN_RBMD ECU_ADDRESS 0xd000e480 BIT_MASK 0x80 /end MEASUREMENT
/begin MEASUREMENT St_deavns6.B_an2wpnp_rbmd "Bedingung Lagereglerüberwachung Auslass Bank 2 RBM disabled" UBYTE _CNV_S_2_Def_bit_ub_563_CM 1 100. 0. 1. DISPLAY_IDENTIFIER B_AN2WPNP_RBMD ECU_ADDRESS 0xd000e480 BIT_MASK 0x8 /end MEASUREMENT
/begin MEASUREMENT St_deavns6.B_anwmn_rbmd "Bedingung Anschlagadaptionsüberwachung Auslass Bank 1 RBM disabled" UBYTE _CNV_S_2_Def_bit_ub_563_CM 1 100. 0. 1. DISPLAY_IDENTIFIER B_ANWMN_RBMD ECU_ADDRESS 0xd000e480 BIT_MASK 0x20 /end MEASUREMENT
/begin MEASUREMENT St_deavns6.B_anwpnp_rbmd "Bedingung Lagereglerüberwachung Auslass Bank 1 RBM disabled" UBYTE _CNV_S_2_Def_bit_ub_563_CM 1 100. 0. 1. DISPLAY_IDENTIFIER B_ANWPNP_RBMD ECU_ADDRESS 0xd000e480 BIT_MASK 0x2 /end MEASUREMENT
/begin MEASUREMENT St_deavns6.B_en2wmn_rbmd "Bedingung Anschlagadaptionsüberwachung Einlass Bank 2 RBM disabled" UBYTE _CNV_S_2_Def_bit_ub_563_CM 1 100. 0. 1. DISPLAY_IDENTIFIER B_EN2WMN_RBMD ECU_ADDRESS 0xd000e480 BIT_MASK 0x40 /end MEASUREMENT
/begin MEASUREMENT St_deavns6.B_en2wpnp_rbmd "Bedingung Lagereglerüberwachung Einlass Bank 2 RBM disabled" UBYTE _CNV_S_2_Def_bit_ub_563_CM 1 100. 0. 1. DISPLAY_IDENTIFIER B_EN2WPNP_RBMD ECU_ADDRESS 0xd000e480 BIT_MASK 0x4 /end MEASUREMENT
/begin MEASUREMENT St_deavns6.B_enwmn_rbmd "Bedingung Anschlagadaptionsüberwachung Einlass Bank 1 RBM disabled" UBYTE _CNV_S_2_Def_bit_ub_563_CM 1 100. 0. 1. DISPLAY_IDENTIFIER B_ENWMN_RBMD ECU_ADDRESS 0xd000e480 BIT_MASK 0x10 /end MEASUREMENT
/begin MEASUREMENT St_deavns6.B_enwpnp_rbmd "Bedingung Lagereglerüberwachung Einlass Bank 1 RBM disabled" UBYTE _CNV_S_2_Def_bit_ub_563_CM 1 100. 0. 1. DISPLAY_IDENTIFIER B_ENWPNP_RBMD ECU_ADDRESS 0xd000e480 BIT_MASK 0x1 /end MEASUREMENT
/begin MEASUREMENT St_deavns7 "Statuswort DEAVANOS6" UBYTE _CNV_R_R_Def_dez_sl_551_CM 1 100. 0. 255. DISPLAY_IDENTIFIER ST_DEAVNS7 ECU_ADDRESS 0xc00049a9 FORMAT "%3.0" /end MEASUREMENT
/begin MEASUREMENT St_deavns7.B_an2woto_err "Bedingung One-Tooth-Off-Diagnose Auslass Bank 2 im FSP" UBYTE _CNV_S_2_Def_bit_ub_563_CM 1 100. 0. 1. DISPLAY_IDENTIFIER B_AN2WOTO_ERR ECU_ADDRESS 0xc00049a9 BIT_MASK 0x8 /end MEASUREMENT
/begin MEASUREMENT St_deavns7.B_anwoto_err "Bedingung One-Tooth-Off-Diagnose Auslass Bank 1 im FSP" UBYTE _CNV_S_2_Def_bit_ub_563_CM 1 100. 0. 1. DISPLAY_IDENTIFIER B_ANWOTO_ERR ECU_ADDRESS 0xc00049a9 BIT_MASK 0x2 /end MEASUREMENT
/begin MEASUREMENT St_deavns7.B_en2woto_err "Bedingung One-Tooth-Off-Diagnose Einlass Bank 2 im FSP" UBYTE _CNV_S_2_Def_bit_ub_563_CM 1 100. 0. 1. DISPLAY_IDENTIFIER B_EN2WOTO_ERR ECU_ADDRESS 0xc00049a9 BIT_MASK 0x4 /end MEASUREMENT
/begin MEASUREMENT St_deavns7.B_enwoto_err "Bedingung One-Tooth-Off-Diagnose Einlass Bank 1 im FSP" UBYTE _CNV_S_2_Def_bit_ub_563_CM 1 100. 0. 1. DISPLAY_IDENTIFIER B_ENWOTO_ERR ECU_ADDRESS 0xc00049a9 BIT_MASK 0x1 /end MEASUREMENT
/begin MEASUREMENT St_deavns8 "Statuswort DEAVANOS6" UBYTE _CNV_R_R_Def_dez_sl_551_CM 1 100. 0. 255. DISPLAY_IDENTIFIER ST_DEAVNS8 ECU_ADDRESS 0xc00049aa FORMAT "%3.0" /end MEASUREMENT
/begin MEASUREMENT St_deavns8.B_an2wmn_dis_nv "Statuswort DEAVANOS6" UBYTE _CNV_S_2_Def_bit_ub_563_CM 1 100. 0. 1. DISPLAY_IDENTIFIER B_AN2WMN_DIS_NV ECU_ADDRESS 0xc00049aa BIT_MASK 0x8 /end MEASUREMENT
/begin MEASUREMENT St_deavns8.B_an2woto_dis_nv "Statuswort DEAVANOS6" UBYTE _CNV_S_2_Def_bit_ub_563_CM 1 100. 0. 1. DISPLAY_IDENTIFIER B_AN2WOTO_DIS_NV ECU_ADDRESS 0xc00049aa BIT_MASK 0x80 /end MEASUREMENT
/begin MEASUREMENT St_deavns8.B_anwmn_dis_nv "Statuswort DEAVANOS6" UBYTE _CNV_S_2_Def_bit_ub_563_CM 1 100. 0. 1. DISPLAY_IDENTIFIER B_ANWMN_DIS_NV ECU_ADDRESS 0xc00049aa BIT_MASK 0x2 /end MEASUREMENT
/begin MEASUREMENT St_deavns8.B_anwoto_dis_nv "Statuswort DEAVANOS6" UBYTE _CNV_S_2_Def_bit_ub_563_CM 1 100. 0. 1. DISPLAY_IDENTIFIER B_ANWOTO_DIS_NV ECU_ADDRESS 0xc00049aa BIT_MASK 0x20 /end MEASUREMENT
/begin MEASUREMENT St_deavns8.B_en2wmn_dis_nv "Statuswort DEAVANOS6" UBYTE _CNV_S_2_Def_bit_ub_563_CM 1 100. 0. 1. DISPLAY_IDENTIFIER B_EN2WMN_DIS_NV ECU_ADDRESS 0xc00049aa BIT_MASK 0x4 /end MEASUREMENT
/begin MEASUREMENT St_deavns8.B_en2woto_dis_nv "Statuswort DEAVANOS6" UBYTE _CNV_S_2_Def_bit_ub_563_CM 1 100. 0. 1. DISPLAY_IDENTIFIER B_EN2WOTO_DIS_NV ECU_ADDRESS 0xc00049aa BIT_MASK 0x40 /end MEASUREMENT
/begin MEASUREMENT St_deavns8.B_enwmn_dis_nv "Statuswort DEAVANOS6" UBYTE _CNV_S_2_Def_bit_ub_563_CM 1 100. 0. 1. DISPLAY_IDENTIFIER B_ENWMN_DIS_NV ECU_ADDRESS 0xc00049aa BIT_MASK 0x1 /end MEASUREMENT
/begin MEASUREMENT St_deavns8.B_enwoto_dis_nv "Statuswort DEAVANOS6" UBYTE _CNV_S_2_Def_bit_ub_563_CM 1 100. 0. 1. DISPLAY_IDENTIFIER B_ENWOTO_DIS_NV ECU_ADDRESS 0xc00049aa BIT_MASK 0x10 /end MEASUREMENT
/begin MEASUREMENT St_eavnskt "" UBYTE _CNV_R_R_Def_dez_sl_551_CM 1 100. 0. 255. DISPLAY_IDENTIFIER ST_EAVNSKT ECU_ADDRESS 0xd000e4a4 FORMAT "%3.0" /end MEASUREMENT
/begin MEASUREMENT St_eavnskt.B_vsa2_err "" UBYTE _CNV_S_2_Def_bit_ub_563_CM 1 100. 0. 1. DISPLAY_IDENTIFIER B_VSA2_ERR ECU_ADDRESS 0xd000e4a4 BIT_MASK 0x8 /end MEASUREMENT
/begin MEASUREMENT St_eavnskt.B_vsa_err "" UBYTE _CNV_S_2_Def_bit_ub_563_CM 1 100. 0. 1. DISPLAY_IDENTIFIER B_VSA_ERR ECU_ADDRESS 0xd000e4a4 BIT_MASK 0x2 /end MEASUREMENT
/begin MEASUREMENT St_eavnskt.B_vse2_err "" UBYTE _CNV_S_2_Def_bit_ub_563_CM 1 100. 0. 1. DISPLAY_IDENTIFIER B_VSE2_ERR ECU_ADDRESS 0xd000e4a4 BIT_MASK 0x4 /end MEASUREMENT
/begin MEASUREMENT St_eavnskt.B_vse_err "" UBYTE _CNV_S_2_Def_bit_ub_563_CM 1 100. 0. 1. DISPLAY_IDENTIFIER B_VSE_ERR ECU_ADDRESS 0xd000e4a4 BIT_MASK 0x1 /end MEASUREMENT
/begin MEASUREMENT St_fe "Status Fe" UBYTE _CNV_R_R_Def_dez_sl_551_CM 1 100. 0. 255. DISPLAY_IDENTIFIER ST_FE ECU_ADDRESS 0xd000e4fc FORMAT "%3.0" /end MEASUREMENT
/begin MEASUREMENT St_fe.B_tvdpsrfvw "Fehler bei Fuellungerfassung" UBYTE _CNV_S_2_Def_bit_ub_563_CM 1 100. 0. 1. DISPLAY_IDENTIFIER B_TVDPSRFVW ECU_ADDRESS 0xd000e4fc BIT_MASK 0x1 /end MEASUREMENT
/begin MEASUREMENT St_vns_poel "Statuswort DEAVANOS" UBYTE _CNV_R_R_Def_dez_sl_551_CM 1 100. 0. 255. DISPLAY_IDENTIFIER ST_VNS_POEL ECU_ADDRESS 0xd000e47c FORMAT "%3.0" /end MEASUREMENT
/begin MEASUREMENT St_vns_poel.B_poel_vns "Statuswort DEAVANOS" UBYTE _CNV_S_2_Def_bit_ub_563_CM 1 100. 0. 1. DISPLAY_IDENTIFIER B_POEL_VNS ECU_ADDRESS 0xd000e47c BIT_MASK 0x1 /end MEASUREMENT
/begin MEASUREMENT St_vns_tvp "Statuswort DEAVANOS" UBYTE _CNV_R_R_Def_dez_sl_551_CM 1 100. 0. 255. DISPLAY_IDENTIFIER ST_VNS_TVP ECU_ADDRESS 0xd000e388 FORMAT "%3.0" /end MEASUREMENT
/begin MEASUREMENT St_vns_tvp.B_vsa2tvp "TV-Puls aktiv Auslass Bank 2" UBYTE _CNV_S_2_Def_bit_ub_563_CM 1 100. 0. 1. DISPLAY_IDENTIFIER B_VSA2TVP ECU_ADDRESS 0xd000e388 BIT_MASK 0x8 /end MEASUREMENT
/begin MEASUREMENT St_vns_tvp.B_vsa2tvp_sperr "TV-Puls gesperrt Auslass Bank 2" UBYTE _CNV_S_2_Def_bit_ub_563_CM 1 100. 0. 1. DISPLAY_IDENTIFIER B_VSA2TVP_SPERR ECU_ADDRESS 0xd000e388 BIT_MASK 0x80 /end MEASUREMENT
/begin MEASUREMENT St_vns_tvp.B_vsatvp "TV-Puls aktiv Auslass Bank 1" UBYTE _CNV_S_2_Def_bit_ub_563_CM 1 100. 0. 1. DISPLAY_IDENTIFIER B_VSATVP ECU_ADDRESS 0xd000e388 BIT_MASK 0x2 /end MEASUREMENT
/begin MEASUREMENT St_vns_tvp.B_vsatvp_sperr "TV-Puls gesperrt Auslass Bank 1" UBYTE _CNV_S_2_Def_bit_ub_563_CM 1 100. 0. 1. DISPLAY_IDENTIFIER B_VSATVP_SPERR ECU_ADDRESS 0xd000e388 BIT_MASK 0x20 /end MEASUREMENT
/begin MEASUREMENT St_vns_tvp.B_vse2tvp "TV-Puls aktiv  Einlass Bank 2" UBYTE _CNV_S_2_Def_bit_ub_563_CM 1 100. 0. 1. DISPLAY_IDENTIFIER B_VSE2TVP ECU_ADDRESS 0xd000e388 BIT_MASK 0x4 /end MEASUREMENT
/begin MEASUREMENT St_vns_tvp.B_vse2tvp_sperr "TV-Puls gesperrt Einlass Bank 2" UBYTE _CNV_S_2_Def_bit_ub_563_CM 1 100. 0. 1. DISPLAY_IDENTIFIER B_VSE2TVP_SPERR ECU_ADDRESS 0xd000e388 BIT_MASK 0x40 /end MEASUREMENT
/begin MEASUREMENT St_vns_tvp.B_vsetvp "TV-Puls aktiv Einlass Bank 1" UBYTE _CNV_S_2_Def_bit_ub_563_CM 1 100. 0. 1. DISPLAY_IDENTIFIER B_VSETVP ECU_ADDRESS 0xd000e388 BIT_MASK 0x1 /end MEASUREMENT
/begin MEASUREMENT St_vns_tvp.B_vsetvp_sperr "TV-Puls gesperrt Einlass Bank 1" UBYTE _CNV_S_2_Def_bit_ub_563_CM 1 100. 0. 1. DISPLAY_IDENTIFIER B_VSETVP_SPERR ECU_ADDRESS 0xd000e388 BIT_MASK 0x10 /end MEASUREMENT
/begin MEASUREMENT St_vsa "Nockenwellenflanke Auslasssspreizung > 720° KW" UBYTE _CNV_R_R_Def_dez_sl_551_CM 1 100. 0. 255. DISPLAY_IDENTIFIER ST_VSA ECU_ADDRESS 0xc00049ce FORMAT "%3.0" /end MEASUREMENT
/begin MEASUREMENT St_vsa.B_npos1dyn "Nockenwellenflanke Auslasssspreizung > 720° KW" UBYTE _CNV_S_2_Def_bit_ub_563_CM 1 100. 0. 1. DISPLAY_IDENTIFIER B_NPOS1DYN ECU_ADDRESS 0xc00049ce BIT_MASK 0x80 /end MEASUREMENT
/begin MEASUREMENT St_vsa.B_vsaadnok "Anschlagadaption Auslassvanos nach Powerfail nicht erfolgt" UBYTE _CNV_S_2_Def_bit_ub_563_CM 1 100. 0. 1. DISPLAY_IDENTIFIER B_VSAADNOK ECU_ADDRESS 0xc00049ce BIT_MASK 0x10 /end MEASUREMENT
/begin MEASUREMENT St_vsa.B_vsaadok "Anschlagadaptionstimer Auslassvanos > K_VNS_ADEND" UBYTE _CNV_S_2_Def_bit_ub_563_CM 1 100. 0. 1. DISPLAY_IDENTIFIER B_VSAADOK ECU_ADDRESS 0xc00049ce BIT_MASK 0x40 /end MEASUREMENT
/begin MEASUREMENT St_vsa.B_vsaadp "Status Anschlagadaption Auslassspreizung variable NWS" UBYTE _CNV_S_2_Def_bit_ub_563_CM 1 100. 0. 1. DISPLAY_IDENTIFIER B_VSAADP ECU_ADDRESS 0xc00049ce BIT_MASK 0x1 /end MEASUREMENT
/begin MEASUREMENT St_vsa.B_vsadyn "Dynamikbegrenzung Auslassnockenwelle aktiv" UBYTE _CNV_S_2_Def_bit_ub_563_CM 1 100. 0. 1. DISPLAY_IDENTIFIER B_VSADYN ECU_ADDRESS 0xc00049ce BIT_MASK 0x8 /end MEASUREMENT
/begin MEASUREMENT St_vsa.B_vsaflan "Nockenwellenflanke Auslassspreizung variable NWS" UBYTE _CNV_S_2_Def_bit_ub_563_CM 1 100. 0. 1. DISPLAY_IDENTIFIER B_VSAFLAN ECU_ADDRESS 0xc00049ce BIT_MASK 0x20 /end MEASUREMENT
/begin MEASUREMENT St_vsa.B_vsanwerr "Fehler Auslassnockenwellenposition in der HW-Schale" UBYTE _CNV_S_2_Def_bit_ub_563_CM 1 100. 0. 1. DISPLAY_IDENTIFIER B_VSANWERR ECU_ADDRESS 0xc00049ce BIT_MASK 0x2 /end MEASUREMENT
/begin MEASUREMENT St_vsa.B_vsaspran "Istspreizung Auslassnockenwelle wird begrenzt" UBYTE _CNV_S_2_Def_bit_ub_563_CM 1 100. 0. 1. DISPLAY_IDENTIFIER B_VSASPRAN ECU_ADDRESS 0xc00049ce BIT_MASK 0x4 /end MEASUREMENT
/begin MEASUREMENT St_vsa2 "Nockenwellenflanke Auslasssspreizung Bank 2 > 720° KW" UBYTE _CNV_R_R_Def_dez_sl_551_CM 1 100. 0. 255. DISPLAY_IDENTIFIER ST_VSA2 ECU_ADDRESS 0xc00049cf FORMAT "%3.0" /end MEASUREMENT
/begin MEASUREMENT St_vsa2.B_npos3dyn "Nockenwellenflanke Auslasssspreizung Bank 2 > 720° KW" UBYTE _CNV_S_2_Def_bit_ub_563_CM 1 100. 0. 1. DISPLAY_IDENTIFIER B_NPOS3DYN ECU_ADDRESS 0xc00049cf BIT_MASK 0x80 /end MEASUREMENT
/begin MEASUREMENT St_vsa2.B_vsa2adnok "Anschlagadaption Auslassvanos Bank 2 nach Powerfail nicht erfolgt" UBYTE _CNV_S_2_Def_bit_ub_563_CM 1 100. 0. 1. DISPLAY_IDENTIFIER B_VSA2ADNOK ECU_ADDRESS 0xc00049cf BIT_MASK 0x10 /end MEASUREMENT
/begin MEASUREMENT St_vsa2.B_vsa2adok "Anschlagadaptionstimer Auslassvanos Bank 2 > K_VNS_ADEND" UBYTE _CNV_S_2_Def_bit_ub_563_CM 1 100. 0. 1. DISPLAY_IDENTIFIER B_VSA2ADOK ECU_ADDRESS 0xc00049cf BIT_MASK 0x40 /end MEASUREMENT
/begin MEASUREMENT St_vsa2.B_vsa2adp "Status Anschlagadaption Auslassspreizung variable NWS Bank 2" UBYTE _CNV_S_2_Def_bit_ub_563_CM 1 100. 0. 1. DISPLAY_IDENTIFIER B_VSA2ADP ECU_ADDRESS 0xc00049cf BIT_MASK 0x1 /end MEASUREMENT
/begin MEASUREMENT St_vsa2.B_vsa2dyn "Dynamikbegrenzung Auslassnockenwelle Bank 2 aktiv" UBYTE _CNV_S_2_Def_bit_ub_563_CM 1 100. 0. 1. DISPLAY_IDENTIFIER B_VSA2DYN ECU_ADDRESS 0xc00049cf BIT_MASK 0x8 /end MEASUREMENT
/begin MEASUREMENT St_vsa2.B_vsa2flan "Nockenwellenflanke Auslassspreizung variable NWS Bank 2" UBYTE _CNV_S_2_Def_bit_ub_563_CM 1 100. 0. 1. DISPLAY_IDENTIFIER B_VSA2FLAN ECU_ADDRESS 0xc00049cf BIT_MASK 0x20 /end MEASUREMENT
/begin MEASUREMENT St_vsa2.B_vsa2nwerr "Fehler Auslassnockenwellenposition in der HW-Schale Bank 2" UBYTE _CNV_S_2_Def_bit_ub_563_CM 1 100. 0. 1. DISPLAY_IDENTIFIER B_VSA2NWERR ECU_ADDRESS 0xc00049cf BIT_MASK 0x2 /end MEASUREMENT
/begin MEASUREMENT St_vsa2.B_vsa2spran "Istspreizung Auslassnockenwelle Bank 2 wird begrenzt" UBYTE _CNV_S_2_Def_bit_ub_563_CM 1 100. 0. 1. DISPLAY_IDENTIFIER B_VSA2SPRAN ECU_ADDRESS 0xc00049cf BIT_MASK 0x4 /end MEASUREMENT
/begin MEASUREMENT St_vse "Statuswort Einlassvanos" UBYTE _CNV_R_R_Def_dez_sl_551_CM 1 100. 0. 255. DISPLAY_IDENTIFIER ST_VSE ECU_ADDRESS 0xc00049cc FORMAT "%3.0" /end MEASUREMENT
/begin MEASUREMENT St_vse.B_npos0dyn "Nockenwellenflanke Einlasssspreizung > 720° KW" UBYTE _CNV_S_2_Def_bit_ub_563_CM 1 100. 0. 1. DISPLAY_IDENTIFIER B_NPOS0DYN ECU_ADDRESS 0xc00049cc BIT_MASK 0x80 /end MEASUREMENT
/begin MEASUREMENT St_vse.B_vseadnok "Anschlagadaption Einlassvanos nach Powerfail nicht erfolgt" UBYTE _CNV_S_2_Def_bit_ub_563_CM 1 100. 0. 1. DISPLAY_IDENTIFIER B_VSEADNOK ECU_ADDRESS 0xc00049cc BIT_MASK 0x10 /end MEASUREMENT
/begin MEASUREMENT St_vse.B_vseadok "Anschlagadaptionstimer Einlassvanos > K_VNS_ADEND" UBYTE _CNV_S_2_Def_bit_ub_563_CM 1 100. 0. 1. DISPLAY_IDENTIFIER B_VSEADOK ECU_ADDRESS 0xc00049cc BIT_MASK 0x40 /end MEASUREMENT
/begin MEASUREMENT St_vse.B_vseadp "Status Anschlagadaption Einlassspreizung variable NWS" UBYTE _CNV_S_2_Def_bit_ub_563_CM 1 100. 0. 1. DISPLAY_IDENTIFIER B_VSEADP ECU_ADDRESS 0xc00049cc BIT_MASK 0x1 /end MEASUREMENT
/begin MEASUREMENT St_vse.B_vsedyn "Dynamikbegrenzung Einlassnockenwelle aktiv" UBYTE _CNV_S_2_Def_bit_ub_563_CM 1 100. 0. 1. DISPLAY_IDENTIFIER B_VSEDYN ECU_ADDRESS 0xc00049cc BIT_MASK 0x8 /end MEASUREMENT
/begin MEASUREMENT St_vse.B_vseflan "Nockenwellenflanke Einlassspreizung variable NWS" UBYTE _CNV_S_2_Def_bit_ub_563_CM 1 100. 0. 1. DISPLAY_IDENTIFIER B_VSEFLAN ECU_ADDRESS 0xc00049cc BIT_MASK 0x20 /end MEASUREMENT
/begin MEASUREMENT St_vse.B_vsenwerr "Fehler Einlassnockenwellenposition in der HW-Schale" UBYTE _CNV_S_2_Def_bit_ub_563_CM 1 100. 0. 1. DISPLAY_IDENTIFIER B_VSENWERR ECU_ADDRESS 0xc00049cc BIT_MASK 0x2 /end MEASUREMENT
/begin MEASUREMENT St_vse.B_vsespran "Istspreizung Einlassnockenwelle wird begrenzt" UBYTE _CNV_S_2_Def_bit_ub_563_CM 1 100. 0. 1. DISPLAY_IDENTIFIER B_VSESPRAN ECU_ADDRESS 0xc00049cc BIT_MASK 0x4 /end MEASUREMENT
/begin MEASUREMENT St_vse2 "Nockenwellenflanke Einlasssspreizung Bank 2 > 720° KW" UBYTE _CNV_R_R_Def_dez_sl_551_CM 1 100. 0. 255. DISPLAY_IDENTIFIER ST_VSE2 ECU_ADDRESS 0xc00049cd FORMAT "%3.0" /end MEASUREMENT
/begin MEASUREMENT St_vse2.B_npos2dyn "Nockenwellenflanke Einlasssspreizung Bank 2 > 720° KW" UBYTE _CNV_S_2_Def_bit_ub_563_CM 1 100. 0. 1. DISPLAY_IDENTIFIER B_NPOS2DYN ECU_ADDRESS 0xc00049cd BIT_MASK 0x80 /end MEASUREMENT
/begin MEASUREMENT St_vse2.B_vse2adnok "Anschlagadaption Einlassvanos Bank 2 nach Powerfail nicht erfolgt" UBYTE _CNV_S_2_Def_bit_ub_563_CM 1 100. 0. 1. DISPLAY_IDENTIFIER B_VSE2ADNOK ECU_ADDRESS 0xc00049cd BIT_MASK 0x10 /end MEASUREMENT
/begin MEASUREMENT St_vse2.B_vse2adok "Anschlagadaptionstimer Einlassvanos Bank 2 > K_VNS_ADEND" UBYTE _CNV_S_2_Def_bit_ub_563_CM 1 100. 0. 1. DISPLAY_IDENTIFIER B_VSE2ADOK ECU_ADDRESS 0xc00049cd BIT_MASK 0x40 /end MEASUREMENT
/begin MEASUREMENT St_vse2.B_vse2adp "Status Anschlagadaption Einlassspreizung variable NWS Bank 2" UBYTE _CNV_S_2_Def_bit_ub_563_CM 1 100. 0. 1. DISPLAY_IDENTIFIER B_VSE2ADP ECU_ADDRESS 0xc00049cd BIT_MASK 0x1 /end MEASUREMENT
/begin MEASUREMENT St_vse2.B_vse2dyn "Dynamikbegrenzung Einlassnockenwelle Bank 2 aktiv" UBYTE _CNV_S_2_Def_bit_ub_563_CM 1 100. 0. 1. DISPLAY_IDENTIFIER B_VSE2DYN ECU_ADDRESS 0xc00049cd BIT_MASK 0x8 /end MEASUREMENT
/begin MEASUREMENT St_vse2.B_vse2flan "Nockenwellenflanke Einlassspreizung variable NWS Bank 2" UBYTE _CNV_S_2_Def_bit_ub_563_CM 1 100. 0. 1. DISPLAY_IDENTIFIER B_VSE2FLAN ECU_ADDRESS 0xc00049cd BIT_MASK 0x20 /end MEASUREMENT
/begin MEASUREMENT St_vse2.B_vse2nwerr "Fehler Einlassnockenwellenposition in der HW-Schale Bank 2" UBYTE _CNV_S_2_Def_bit_ub_563_CM 1 100. 0. 1. DISPLAY_IDENTIFIER B_VSE2NWERR ECU_ADDRESS 0xc00049cd BIT_MASK 0x2 /end MEASUREMENT
/begin MEASUREMENT St_vse2.B_vse2spran "Istspreizung Einlassnockenwelle Bank 2 wird begrenzt" UBYTE _CNV_S_2_Def_bit_ub_563_CM 1 100. 0. 1. DISPLAY_IDENTIFIER B_VSE2SPRAN ECU_ADDRESS 0xc00049cd BIT_MASK 0x4 /end MEASUREMENT
/begin MEASUREMENT T_systemvns "Zeitstempel für Vanos" ULONG _CNV_R_R_Def_td_ul__665_CM 1 100. 0. 4294967295. DISPLAY_IDENTIFIER T_SYSTEMVNS ECU_ADDRESS 0xd000e4c8 FORMAT "%7.0" /end MEASUREMENT
/begin MEASUREMENT T_zkvnsi "Zeitkonstante fuer 10ms Filterzyklus" UWORD _CNV_R_R_Def_zk10ms_715_CM 1 100. 1.e-002 655.36 DISPLAY_IDENTIFIER T_ZKVNSI ECU_ADDRESS 0xd000e6c4 FORMAT "%9.4" /end MEASUREMENT
/begin MEASUREMENT Toel_oz "ozbg.dat" SWORD _CNV_R_R_Def_t_sw_q_578_CM 1 100. -3276.8 3276.7 DISPLAY_IDENTIFIER TOEL_OZ ECU_ADDRESS 0xc00078f8 FORMAT "%6.1" /end MEASUREMENT
/begin MEASUREMENT Twdk_i "Zeitkonstante Drosseklappesollwertfilter" UWORD _CNV_R_R_Def_zk10ms_715_CM 1 100. 1.e-002 655.36 DISPLAY_IDENTIFIER TWDK_I ECU_ADDRESS 0xd000e62e FORMAT "%9.4" ARRAY_SIZE 2 MATRIX_DIM 2 1 1 /end MEASUREMENT
/begin MEASUREMENT Vns_fpwm "Ansteuerfrequenz VNS-Magnetventil" UBYTE _CNV_R_R_Def_freq_u_728_CM 1 100. 10. 255. DISPLAY_IDENTIFIER VNS_FPWM ECU_ADDRESS 0xd000e390 FORMAT "%3.0" ARRAY_SIZE 4 MATRIX_DIM 4 1 1 /end MEASUREMENT
/begin MEASUREMENT Vns_oto_adp "" UWORD _CNV_R_R_Def_spr_sw_561_CM 1 100. 0. 6553.5 DISPLAY_IDENTIFIER VNS_OTO_ADP ECU_ADDRESS 0xc00049ac FORMAT "%7.2" ARRAY_SIZE 4 MATRIX_DIM 4 1 1 /end MEASUREMENT
/begin MEASUREMENT Vns_p_sum "" UWORD _CNV_R_R_Def_dez_sl_551_CM 1 100. 0. 65535. DISPLAY_IDENTIFIER VNS_P_SUM ECU_ADDRESS 0xc00049a0 FORMAT "%5.0" ARRAY_SIZE 4 MATRIX_DIM 4 1 1 /end MEASUREMENT
/begin MEASUREMENT Vns_tv_cnt "Counter TV-Puls Einlass Bank 1" UWORD _CNV_R_R_Def_dez_sl_551_CM 1 100. 0. 65535. DISPLAY_IDENTIFIER VNS_TV_CNT ECU_ADDRESS 0xd000e39c FORMAT "%5.0" ARRAY_SIZE 4 MATRIX_DIM 4 1 1 /end MEASUREMENT
/begin MEASUREMENT Vns_tv_p_slow "zusätzlicher P-Anteil bei langanhaltender Regelabweichung" UWORD _CNV_R_R_Def_rel_uw_729_CM 1 100. -100. 99.9969 DISPLAY_IDENTIFIER VNS_TV_P_SLOW ECU_ADDRESS 0xd000e3a4 FORMAT "%8.3" ARRAY_SIZE 4 MATRIX_DIM 4 1 1 /end MEASUREMENT
/begin MEASUREMENT Vns_tv_puls "Spueltastverhaeltnis Einlassspreizung Bank 1" UWORD _CNV_R_R_Def_rf_sw__598_CM 1 100. 0. 655.35 DISPLAY_IDENTIFIER VNS_TV_PULS ECU_ADDRESS 0xd000e394 FORMAT "%7.2" ARRAY_SIZE 4 MATRIX_DIM 4 1 1 /end MEASUREMENT
/begin MEASUREMENT Vns_tvpz "Counter TV-Puls im Fahrzyklus ausgegeben" UBYTE _CNV_R_R_Def_dez_sl_551_CM 1 100. 0. 255. DISPLAY_IDENTIFIER VNS_TVPZ ECU_ADDRESS 0xd000e38c FORMAT "%3.0" ARRAY_SIZE 4 MATRIX_DIM 4 1 1 /end MEASUREMENT
/begin MEASUREMENT Vns_tvpz_sum "" UWORD _CNV_R_R_Def_dez_sl_551_CM 1 100. 0. 65535. DISPLAY_IDENTIFIER VNS_TVPZ_SUM ECU_ADDRESS 0xc0004998 FORMAT "%5.0" ARRAY_SIZE 4 MATRIX_DIM 4 1 1 /end MEASUREMENT
/begin MEASUREMENT Vnscnt "Fehlerzähler Vanosistposition ausserhalb Fenster" UBYTE _CNV_R_R_Def_dez_sl_551_CM 1 100. 0. 255. DISPLAY_IDENTIFIER VNSCNT ECU_ADDRESS 0xd000e482 FORMAT "%3.0" ARRAY_SIZE 4 MATRIX_DIM 4 1 1 /end MEASUREMENT
/begin MEASUREMENT Vnscnt_nio "Fehlerzähler RBM completed für Reglerüberwachung" UBYTE _CNV_R_R_Def_dez_sl_551_CM 1 100. 0. 255. DISPLAY_IDENTIFIER VNSCNT_NIO ECU_ADDRESS 0xd000e486 FORMAT "%3.0" ARRAY_SIZE 4 MATRIX_DIM 4 1 1 /end MEASUREMENT
/begin MEASUREMENT Vnsfaktmot "ausgegebenes variables NWS Tastverhaeltnis Tmot-abhaengig" UBYTE _CNV_R_R_Def_f_ub_b_613_CM 1 100. 0. 1.9921 DISPLAY_IDENTIFIER VNSFAKTMOT ECU_ADDRESS 0xd000e38a /end MEASUREMENT
/begin MEASUREMENT Vnsfaktvub "ausgegebenes variables NWS Tastverhaeltnis ub-abhaengig" UBYTE _CNV_R_R_Def_f_ub_b_613_CM 1 100. 0. 1.9921 DISPLAY_IDENTIFIER VNSFAKTVUB ECU_ADDRESS 0xd000e389 /end MEASUREMENT
/begin MEASUREMENT Vol_verh_a "Volumen Verhältnis Auslaß" SWORD _CNV_R_R_Def_f_sw_b_616_CM 1 100. -2. 1.9999 DISPLAY_IDENTIFIER VOL_VERH_A ECU_ADDRESS 0xd000e6be FORMAT "%14.5" /end MEASUREMENT
/begin MEASUREMENT Vol_verh_e "Volumen Verhältnis Einlaß" UWORD _CNV_R_R_Def_f_sw_b_616_CM 1 100. 0. 3.9999 DISPLAY_IDENTIFIER VOL_VERH_E ECU_ADDRESS 0xd000e6bc FORMAT "%14.5" /end MEASUREMENT
/begin MEASUREMENT Vsa2_adp "Adaptionswert Anschlag Auslassspreizung variable NWS Bank 2" UWORD _CNV_R_R_Def_spr_sw_561_CM 1 100. 0. 6553.5 DISPLAY_IDENTIFIER VSA2_ADP ECU_ADDRESS 0xc00049ca FORMAT "%7.2" /end MEASUREMENT
/begin MEASUREMENT Vsa2_adp_fl "Flankenindividuelle Adaption Auslassspreizung variable NWS" SBYTE _CNV_R_R_Def_spr_sb_731_CM 1 100. -6.4 6.35 DISPLAY_IDENTIFIER VSA2_ADP_FL ECU_ADDRESS 0xc00049c0 FORMAT "%5.2" ARRAY_SIZE 4 MATRIX_DIM 4 1 1 /end MEASUREMENT
/begin MEASUREMENT Vsa2_spri "Istwert Auslassspreizung variable NWS Bank 2" UWORD _CNV_R_R_Def_spr_sw_561_CM 1 100. 0. 6553.5 DISPLAY_IDENTIFIER VSA2_SPRI ECU_ADDRESS 0xd000e4ac FORMAT "%7.2" /end MEASUREMENT
/begin MEASUREMENT Vsa2_sprs "Sollwert Auslassspreizung variable NWS Bank 2" UWORD _CNV_R_R_Def_spr_sw_561_CM 1 100. 0. 6553.5 DISPLAY_IDENTIFIER VSA2_SPRS ECU_ADDRESS 0xd000e384 FORMAT "%7.2" /end MEASUREMENT
/begin MEASUREMENT Vsa2_tv "Tastverhaeltnis Auslassspreizung variable NWS Bank 2" UWORD _CNV_R_R_Def_rf_sw__598_CM 1 100. 0. 655.35 DISPLAY_IDENTIFIER VSA2_TV ECU_ADDRESS 0xd000e386 FORMAT "%7.2" /end MEASUREMENT
/begin MEASUREMENT Vsa2_tv_i "Reglerausgang I-Regler Auslassspreizung variable NWS Bank 2" UWORD _CNV_R_R_Def_rel_uw_729_CM 1 100. -100. 99.9969 DISPLAY_IDENTIFIER VSA2_TV_I ECU_ADDRESS 0xd000e3c8 FORMAT "%8.3" /end MEASUREMENT
/begin MEASUREMENT Vsa2_tv_p "Reglerausgang P-Regler Auslassspreizung variable NWS Bank 2" UWORD _CNV_R_R_Def_rel_uw_729_CM 1 100. -100. 99.9969 DISPLAY_IDENTIFIER VSA2_TV_P ECU_ADDRESS 0xd000e3ca FORMAT "%8.3" /end MEASUREMENT
/begin MEASUREMENT Vsa2_vg "Verstellgeschwindigkeit Auslassspreizung variable NWS Bank 2" SWORD _CNV_R_R_Def_vg_sw__732_CM 1 100. -25600. 25599.2187 DISPLAY_IDENTIFIER VSA2_VG ECU_ADDRESS 0xd000e4c4 FORMAT "%7.2" /end MEASUREMENT
/begin MEASUREMENT Vsa2dwnwkl "Regeldifferenz Auslassspreizung Bank 2" UWORD _CNV_R_R_Def_spr_uw_733_CM 1 100. -3276.8 3276.7 DISPLAY_IDENTIFIER VSA2DWNWKL ECU_ADDRESS 0xd000e3c4 FORMAT "%7.2" /end MEASUREMENT
/begin MEASUREMENT Vsa2dwnwv "Regeldifferenz voheriger Rechenschritt Auslassspreizung Bank 2" UWORD _CNV_R_R_Def_spr_uw_733_CM 1 100. -3276.8 3276.7 DISPLAY_IDENTIFIER VSA2DWNWV ECU_ADDRESS 0xd000e3c6 FORMAT "%7.2" /end MEASUREMENT
/begin MEASUREMENT Vsa2spris "geschaetzter Istwert Auslassspreizung variable NWS Bank 2" UWORD _CNV_R_R_Def_spr_sw_561_CM 1 100. 0. 6553.5 DISPLAY_IDENTIFIER VSA2SPRIS ECU_ADDRESS 0xd000e4c6 FORMAT "%7.2" /end MEASUREMENT
/begin MEASUREMENT Vsa_adp "Adaptionswert Anschlag Auslassspreizung variable NWS" UWORD _CNV_R_R_Def_spr_sw_561_CM 1 100. 0. 6553.5 DISPLAY_IDENTIFIER VSA_ADP ECU_ADDRESS 0xc00049c6 FORMAT "%7.2" /end MEASUREMENT
/begin MEASUREMENT Vsa_adp_fl "Flankenindividuelle Adaption Auslassspreizung variable NWS" SBYTE _CNV_R_R_Def_spr_sb_731_CM 1 100. -6.4 6.35 DISPLAY_IDENTIFIER VSA_ADP_FL ECU_ADDRESS 0xc00049bc FORMAT "%5.2" ARRAY_SIZE 4 MATRIX_DIM 4 1 1 /end MEASUREMENT
/begin MEASUREMENT Vsa_spr "" UWORD _CNV_R_R_Def_spr_sw_561_CM 1 100. 0. 6553.5 DISPLAY_IDENTIFIER VSA_SPR ECU_ADDRESS 0xd000e6b2 FORMAT "%7.2" /end MEASUREMENT
/begin MEASUREMENT Vsa_spri "Istwert Auslassspreizung variable NWS" UWORD _CNV_R_R_Def_spr_sw_561_CM 1 100. 0. 6553.5 DISPLAY_IDENTIFIER VSA_SPRI ECU_ADDRESS 0xd000e4aa FORMAT "%7.2" /end MEASUREMENT
/begin MEASUREMENT Vsa_spris "" UWORD _CNV_R_R_Def_spr_sw_561_CM 1 100. 0. 6553.5 DISPLAY_IDENTIFIER VSA_SPRIS ECU_ADDRESS 0xd000e6b0 FORMAT "%7.2" /end MEASUREMENT
/begin MEASUREMENT Vsa_sprs "Sollwert Auslassspreizung variable NWS" UWORD _CNV_R_R_Def_spr_sw_561_CM 1 100. 0. 6553.5 DISPLAY_IDENTIFIER VSA_SPRS ECU_ADDRESS 0xd000e37c FORMAT "%7.2" /end MEASUREMENT
/begin MEASUREMENT Vsa_tv "Tastverhaeltnis Auslassspreizung variable NWS" UWORD _CNV_R_R_Def_rf_sw__598_CM 1 100. 0. 655.35 DISPLAY_IDENTIFIER VSA_TV ECU_ADDRESS 0xd000e37e FORMAT "%7.2" /end MEASUREMENT
/begin MEASUREMENT Vsa_tv_i "Reglerausgang I-Regler Auslassspreizung variable NWS" UWORD _CNV_R_R_Def_rel_uw_729_CM 1 100. -100. 99.9969 DISPLAY_IDENTIFIER VSA_TV_I ECU_ADDRESS 0xd000e3c0 FORMAT "%8.3" /end MEASUREMENT
/begin MEASUREMENT Vsa_tv_p "Reglerausgang P-Regler Auslassspreizung variable NWS" UWORD _CNV_R_R_Def_rel_uw_729_CM 1 100. -100. 99.9969 DISPLAY_IDENTIFIER VSA_TV_P ECU_ADDRESS 0xd000e3c2 FORMAT "%8.3" /end MEASUREMENT
/begin MEASUREMENT Vsa_vg "Verstellgeschwindigkeit Auslassspreizung variable NWS" SWORD _CNV_R_R_Def_vg_sw__732_CM 1 100. -25600. 25599.2187 DISPLAY_IDENTIFIER VSA_VG ECU_ADDRESS 0xd000e4c0 FORMAT "%7.2" /end MEASUREMENT
/begin MEASUREMENT Vsadwnwkl "Regeldifferenz Auslassspreizung Bank 1" UWORD _CNV_R_R_Def_spr_uw_733_CM 1 100. -3276.8 3276.7 DISPLAY_IDENTIFIER VSADWNWKL ECU_ADDRESS 0xd000e3bc FORMAT "%7.2" /end MEASUREMENT
/begin MEASUREMENT Vsadwnwv "Regeldifferenz voheriger Rechenschritt Auslassspreizung Bank 1" UWORD _CNV_R_R_Def_spr_uw_733_CM 1 100. -3276.8 3276.7 DISPLAY_IDENTIFIER VSADWNWV ECU_ADDRESS 0xd000e3be FORMAT "%7.2" /end MEASUREMENT
/begin MEASUREMENT Vsaspris "geschaetzter Istwert Auslassspreizung variable NWS" UWORD _CNV_R_R_Def_spr_sw_561_CM 1 100. 0. 6553.5 DISPLAY_IDENTIFIER VSASPRIS ECU_ADDRESS 0xd000e4c2 FORMAT "%7.2" /end MEASUREMENT
/begin MEASUREMENT Vsasprn "" UWORD _CNV_R_R_Def_spr_sw_561_CM 1 100. 0. 6553.5 DISPLAY_IDENTIFIER VSASPRN ECU_ADDRESS 0xd000e6ac FORMAT "%7.2" /end MEASUREMENT
/begin MEASUREMENT Vse2_adp "Adaptionswert Anschlag Einlassspreizung variable NWS Bank 2" UWORD _CNV_R_R_Def_spr_sw_561_CM 1 100. 0. 6553.5 DISPLAY_IDENTIFIER VSE2_ADP ECU_ADDRESS 0xc00049c8 FORMAT "%7.2" /end MEASUREMENT
/begin MEASUREMENT Vse2_adp_fl "Flankenindividuelle Adaption Einlassspreizung variable NWS" SBYTE _CNV_R_R_Def_spr_sb_731_CM 1 100. -6.4 6.35 DISPLAY_IDENTIFIER VSE2_ADP_FL ECU_ADDRESS 0xc00049b8 FORMAT "%5.2" ARRAY_SIZE 4 MATRIX_DIM 4 1 1 /end MEASUREMENT
/begin MEASUREMENT Vse2_spri "Istwert Einlassspreizung variable NWS Bank 2" UWORD _CNV_R_R_Def_spr_sw_561_CM 1 100. 0. 6553.5 DISPLAY_IDENTIFIER VSE2_SPRI ECU_ADDRESS 0xd000e4a8 FORMAT "%7.2" /end MEASUREMENT
/begin MEASUREMENT Vse2_sprs "Sollwert Einlassspreizung variable NWS Bank 2" UWORD _CNV_R_R_Def_spr_sw_561_CM 1 100. 0. 6553.5 DISPLAY_IDENTIFIER VSE2_SPRS ECU_ADDRESS 0xd000e380 FORMAT "%7.2" /end MEASUREMENT
/begin MEASUREMENT Vse2_tv "Tastverhaeltnis Einlassspreizung variable NWS Bank 2" UWORD _CNV_R_R_Def_rf_sw__598_CM 1 100. 0. 655.35 DISPLAY_IDENTIFIER VSE2_TV ECU_ADDRESS 0xd000e382 FORMAT "%7.2" /end MEASUREMENT
/begin MEASUREMENT Vse2_tv_i "Reglerausgang I-Regler Einlassspreizung variable NWS Bank 2" UWORD _CNV_R_R_Def_rel_uw_729_CM 1 100. -100. 99.9969 DISPLAY_IDENTIFIER VSE2_TV_I ECU_ADDRESS 0xd000e3b8 FORMAT "%8.3" /end MEASUREMENT
/begin MEASUREMENT Vse2_tv_p "Reglerausgang P-Regler Einlassspreizung variable NWS Bank 2" UWORD _CNV_R_R_Def_rel_uw_729_CM 1 100. -100. 99.9969 DISPLAY_IDENTIFIER VSE2_TV_P ECU_ADDRESS 0xd000e3ba FORMAT "%8.3" /end MEASUREMENT
/begin MEASUREMENT Vse2_vg "Verstellgeschwindigkeit Einlassspreizung variable NWS Bank 2" SWORD _CNV_R_R_Def_vg_sw__732_CM 1 100. -25600. 25599.2187 DISPLAY_IDENTIFIER VSE2_VG ECU_ADDRESS 0xd000e4bc FORMAT "%7.2" /end MEASUREMENT
/begin MEASUREMENT Vse2dwnwkl "Regeldifferenz Einlassspreizung Bank 2" UWORD _CNV_R_R_Def_spr_uw_733_CM 1 100. -3276.8 3276.7 DISPLAY_IDENTIFIER VSE2DWNWKL ECU_ADDRESS 0xd000e3b4 FORMAT "%7.2" /end MEASUREMENT
/begin MEASUREMENT Vse2dwnwv "Regeldifferenz voheriger Rechenschritt Einlassspreizung Bank 2" UWORD _CNV_R_R_Def_spr_uw_733_CM 1 100. -3276.8 3276.7 DISPLAY_IDENTIFIER VSE2DWNWV ECU_ADDRESS 0xd000e3b6 FORMAT "%7.2" /end MEASUREMENT
/begin MEASUREMENT Vse2spris "geschaetzter Istwert Einlassspreizung variable NWS Bank 2" UWORD _CNV_R_R_Def_spr_sw_561_CM 1 100. 0. 6553.5 DISPLAY_IDENTIFIER VSE2SPRIS ECU_ADDRESS 0xd000e4be FORMAT "%7.2" /end MEASUREMENT
/begin MEASUREMENT Vse_adp "Adaptionswert Anschlag Einlassspreizung variable NWS" UWORD _CNV_R_R_Def_spr_sw_561_CM 1 100. 0. 6553.5 DISPLAY_IDENTIFIER VSE_ADP ECU_ADDRESS 0xc00049c4 FORMAT "%7.2" /end MEASUREMENT
/begin MEASUREMENT Vse_adp_fl "Flankenindividuelle Adaption Einlassspreizung variable NWS" SBYTE _CNV_R_R_Def_spr_sb_731_CM 1 100. -6.4 6.35 DISPLAY_IDENTIFIER VSE_ADP_FL ECU_ADDRESS 0xc00049b4 FORMAT "%5.2" ARRAY_SIZE 4 MATRIX_DIM 4 1 1 /end MEASUREMENT
/begin MEASUREMENT Vse_spr "" UWORD _CNV_R_R_Def_spr_sw_561_CM 1 100. 0. 6553.5 DISPLAY_IDENTIFIER VSE_SPR ECU_ADDRESS 0xd000e6b4 FORMAT "%7.2" /end MEASUREMENT
/begin MEASUREMENT Vse_spri "Istwert Einlassspreizung variable NWS" UWORD _CNV_R_R_Def_spr_sw_561_CM 1 100. 0. 6553.5 DISPLAY_IDENTIFIER VSE_SPRI ECU_ADDRESS 0xd000e4a6 FORMAT "%7.2" /end MEASUREMENT
/begin MEASUREMENT Vse_spris "" UWORD _CNV_R_R_Def_spr_sw_561_CM 1 100. 0. 6553.5 DISPLAY_IDENTIFIER VSE_SPRIS ECU_ADDRESS 0xd000e6ae FORMAT "%7.2" /end MEASUREMENT
/begin MEASUREMENT Vse_sprs "Sollwert Einlassspreizung variable NWS" UWORD _CNV_R_R_Def_spr_sw_561_CM 1 100. 0. 6553.5 DISPLAY_IDENTIFIER VSE_SPRS ECU_ADDRESS 0xd000e378 FORMAT "%7.2" /end MEASUREMENT
/begin MEASUREMENT Vse_tv "Tastverhaeltnis Einlassspreizung variable NWS" UWORD _CNV_R_R_Def_rf_sw__598_CM 1 100. 0. 655.35 DISPLAY_IDENTIFIER VSE_TV ECU_ADDRESS 0xd000e37a FORMAT "%7.2" /end MEASUREMENT
/begin MEASUREMENT Vse_tv_i "Reglerausgang I-Regler Einlassspreizung Bank 1" UWORD _CNV_R_R_Def_rel_uw_729_CM 1 100. -100. 99.9969 DISPLAY_IDENTIFIER VSE_TV_I ECU_ADDRESS 0xd000e3b0 FORMAT "%8.3" /end MEASUREMENT
/begin MEASUREMENT Vse_tv_p "Reglerausgang P-Regler Einlassspreizung Bank 1" UWORD _CNV_R_R_Def_rel_uw_729_CM 1 100. -100. 99.9969 DISPLAY_IDENTIFIER VSE_TV_P ECU_ADDRESS 0xd000e3b2 FORMAT "%8.3" /end MEASUREMENT
/begin MEASUREMENT Vse_vg "Verstellgeschwindigkeit Einlassspreizung variable NWS" SWORD _CNV_R_R_Def_vg_sw__732_CM 1 100. -25600. 25599.2187 DISPLAY_IDENTIFIER VSE_VG ECU_ADDRESS 0xd000e4b8 FORMAT "%7.2" /end MEASUREMENT
/begin MEASUREMENT Vsedwnwkl "Regeldifferenz Einlassspreizung Bank 1" UWORD _CNV_R_R_Def_spr_uw_733_CM 1 100. -3276.8 3276.7 DISPLAY_IDENTIFIER VSEDWNWKL ECU_ADDRESS 0xd000e3ac FORMAT "%7.2" /end MEASUREMENT
/begin MEASUREMENT Vsedwnwv "Regeldifferenz voheriger Rechenschritt Einlassspreizung Bank 1" UWORD _CNV_R_R_Def_spr_uw_733_CM 1 100. -3276.8 3276.7 DISPLAY_IDENTIFIER VSEDWNWV ECU_ADDRESS 0xd000e3ae FORMAT "%7.2" /end MEASUREMENT
/begin MEASUREMENT Vsespris "geschaetzter Istwert Einlassspreizung variable NWS" UWORD _CNV_R_R_Def_spr_sw_561_CM 1 100. 0. 6553.5 DISPLAY_IDENTIFIER VSESPRIS ECU_ADDRESS 0xd000e4ba FORMAT "%7.2" /end MEASUREMENT
/begin MEASUREMENT Vsesprn "" UWORD _CNV_R_R_Def_spr_sw_561_CM 1 100. 0. 6553.5 DISPLAY_IDENTIFIER VSESPRN ECU_ADDRESS 0xd000e6aa FORMAT "%7.2" /end MEASUREMENT
/begin MEASUREMENT Wdk_soll "Sollwert DK-Winkel, bezogen auf unteren Anschlag gefiltert" UWORD _CNV_R_R_Def_wdk_sw_683_CM 1 100. 0. 1599.9755 DISPLAY_IDENTIFIER WDK_SOLL ECU_ADDRESS 0xd000e600 FORMAT "%7.2" /end MEASUREMENT
/begin MEASUREMENT Wdk_soll_gd_i "Sollwert DK-Winkel, bezogen auf unteren Anschlag GD" UWORD _CNV_R_R_Def_wdk_sw_683_CM 1 100. 0. 1599.9755 DISPLAY_IDENTIFIER WDK_SOLL_GD_I ECU_ADDRESS 0xd000e65a FORMAT "%7.2" ARRAY_SIZE 2 MATRIX_DIM 2 1 1 /end MEASUREMENT
/begin MEASUREMENT Wdk_soll_i "Sollwert DK-Winkel, bezogen auf unteren Anschlag gefiltert" UWORD _CNV_R_R_Def_wdk_sw_683_CM 1 100. 0. 1599.9755 DISPLAY_IDENTIFIER WDK_SOLL_I ECU_ADDRESS 0xc0000e50 FORMAT "%7.2" ARRAY_SIZE 2 MATRIX_DIM 2 1 1 /end MEASUREMENT
/begin MEASUREMENT Wdk_soll_transvl_i "" UWORD _CNV_R_R_Def_wdk_sw_683_CM 1 100. 0. 1599.9755 DISPLAY_IDENTIFIER WDK_SOLL_TRANSVL_I ECU_ADDRESS 0xd000e662 FORMAT "%7.2" ARRAY_SIZE 2 MATRIX_DIM 2 1 1 /end MEASUREMENT
/begin MEASUREMENT Wdk_soll_trvlbas_i "" UWORD _CNV_R_R_Def_wdk_sw_683_CM 1 100. 0. 1599.9755 DISPLAY_IDENTIFIER WDK_SOLL_TRVLBAS_I ECU_ADDRESS 0xd000e60a FORMAT "%7.2" ARRAY_SIZE 2 MATRIX_DIM 2 1 1 /end MEASUREMENT
/begin MEASUREMENT Wdk_soll_uebl_i "Sollwert DK-Winkel übergeblendet GD-UGD" UWORD _CNV_R_R_Def_wdk_sw_683_CM 1 100. 0. 1599.9755 DISPLAY_IDENTIFIER WDK_SOLL_UEBL_I ECU_ADDRESS 0xd000e606 FORMAT "%7.2" ARRAY_SIZE 2 MATRIX_DIM 2 1 1 /end MEASUREMENT
/begin MEASUREMENT Wdk_soll_uf_i "Sollwert DK-Winkel, bezogen auf unteren Anschlag vor Filter" UWORD _CNV_R_R_Def_wdk_sw_683_CM 1 100. 0. 1599.9755 DISPLAY_IDENTIFIER WDK_SOLL_UF_I ECU_ADDRESS 0xd000e602 FORMAT "%7.2" ARRAY_SIZE 2 MATRIX_DIM 2 1 1 /end MEASUREMENT
/begin MEASUREMENT Wdk_soll_ug_i "Sollwert DK-Winkel, bezogen auf unteren Anschlag UGD" UWORD _CNV_R_R_Def_wdk_sw_683_CM 1 100. 0. 1599.9755 DISPLAY_IDENTIFIER WDK_SOLL_UG_I ECU_ADDRESS 0xd000e656 FORMAT "%7.2" ARRAY_SIZE 2 MATRIX_DIM 2 1 1 /end MEASUREMENT
/begin MEASUREMENT Wdk_soll_uverz_i "Sollwert DK-Winkel, unverzögert" UWORD _CNV_R_R_Def_wdk_sw_683_CM 1 100. 0. 1599.9755 DISPLAY_IDENTIFIER WDK_SOLL_UVERZ_I ECU_ADDRESS 0xd000e652 FORMAT "%7.2" ARRAY_SIZE 2 MATRIX_DIM 2 1 1 /end MEASUREMENT
/begin MEASUREMENT Wdk_som "Sollwert DK-Winkel bei KL15 aus" UWORD _CNV_R_R_Def_wdk_sw_683_CM 1 100. 0. 1599.9755 DISPLAY_IDENTIFIER WDK_SOM ECU_ADDRESS 0xd000e65e FORMAT "%7.2" /end MEASUREMENT
/begin MEASUREMENT Wdks_vl "Sollwert DK-Winkel bei Volllast" UWORD _CNV_R_R_Def_wdk_sw_683_CM 1 100. 0. 1599.9755 DISPLAY_IDENTIFIER WDKS_VL ECU_ADDRESS 0xd000e660 FORMAT "%7.2" /end MEASUREMENT
/begin MEASUREMENT Zrbosmld "anzuzeigender Zähler für durchgeführten Ölservice" UBYTE _CNV_R_R_Def_dez_sl_551_CM 1 100. 0. 255. DISPLAY_IDENTIFIER ZRBOSMLD ECU_ADDRESS 0xc0004106 FORMAT "%3.0" /end MEASUREMENT
/begin CHARACTERISTIC CW_DEAVANOS "Codewort Vanosdiagnose" VALUE 0xa0831b04 _REC_VAL_20_u1 99.45 _CNV_R_R_Def_dez_sl_551_CM 0. 255. FORMAT "%3.0" /end CHARACTERISTIC
/begin CHARACTERISTIC CW_DKAPP "Codewort Applikation ohne Drehmomentfunktion" VALUE 0xa0831f02 _REC_VAL_20_u1 99.45 _CNV_R_R_Def_dez_sl_551_CM 0. 255. FORMAT "%3.0" /end CHARACTERISTIC
/begin CHARACTERISTIC CW_EAVNSKT "Codewort Konfiguration EAVNSKT" VALUE 0xa0831b5c _REC_VAL_20_u1 99.45 _CNV_R_R_Def_dez_sl_551_CM 0. 255. FORMAT "%3.0" /end CHARACTERISTIC
/begin CHARACTERISTIC CW_HUBAPP "Codewort Applikation ohne Drehmomentfunktion" VALUE 0xa083289c _REC_VAL_20_u1 2. _CNV_R_R_Def_dez_sl_551_CM 0. 2. FORMAT "%3.0" /end CHARACTERISTIC
/begin CHARACTERISTIC CW_RFVNS "Umschaltung Rfv_soll_vns <- Rfv_soll/Rfv_soll_k(Bit0), Rfv_soll_dk <- Rfv_soll/Rfv_soll_h(Bit1)" VALUE 0xa0831bac _REC_VAL_20_u1 99.45 _CNV_R_R_Def_dez_sl_551_CM 0. 255. FORMAT "%3.0" /end CHARACTERISTIC
/begin CHARACTERISTIC CW_TVP "Codewort Aktivierung TV-Puls bei VNS-Fehler" VALUE 0xa082ec47 _REC_VAL_20_u1 99.45 _CNV_R_R_Def_dez_sl_551_CM 0. 255. FORMAT "%3.0" /end CHARACTERISTIC
/begin CHARACTERISTIC CW_VNSABST "Verhinderung der Verriegelung durch Abstand vom Anschlag" VALUE 0xa082ec46 _REC_VAL_20_u1 99.45 _CNV_R_R_Def_dez_sl_551_CM 0. 255. FORMAT "%3.0" /end CHARACTERISTIC
/begin CHARACTERISTIC CW_VNSDYN "Verhinderung der Verriegelung durch adapt. Druckvorsteuerung" VALUE 0xa082ec45 _REC_VAL_20_u1 99.45 _CNV_R_R_Def_dez_sl_551_CM 0. 255. FORMAT "%3.0" /end CHARACTERISTIC
/begin CHARACTERISTIC KF_ANFLVNS "Wichtung Flächenanteil" MAP 0xa0832e08 _REC_MAP_52_UBYTE_u2_s2_s2 3.9999 _CNV_R_R_Def_f_sw_b_616_CM 0. 3.9999 FORMAT "%14.5"
 /begin AXIS_DESCR STD_AXIS Nkw _CNV_R_R_Def_n_sw_q_595_CM 12 -32768. 32767. FORMAT "%5.0" /end AXIS_DESCR
 /begin AXIS_DESCR STD_AXIS Rfv_soll _CNV_R_R_Def_rf_sw__598_CM 12 -327.68 327.67 FORMAT "%7.4" /end AXIS_DESCR
/end CHARACTERISTIC
/begin CHARACTERISTIC KF_ASVNS "Wichtung AS-Volumen" MAP 0xa0832f5c _REC_MAP_52_UBYTE_s2_s2_s2 7.999800000000001 _CNV_R_R_Def_f_sw_b_591_CM -4. 3.9998 FORMAT "%7.4"
 /begin AXIS_DESCR STD_AXIS Nkw _CNV_R_R_Def_n_sw_q_595_CM 6 -32768. 32767. FORMAT "%5.0" /end AXIS_DESCR
 /begin AXIS_DESCR STD_AXIS Rfv_soll _CNV_R_R_Def_rf_sw__598_CM 6 -327.68 327.67 FORMAT "%7.4" /end AXIS_DESCR
/end CHARACTERISTIC
/begin CHARACTERISTIC KF_DKST "Kennfeld Drosselklappensollwinkel" MAP 0xa08321b0 _REC_MAP_52_UBYTE_u2_s2_s2 95.99852999999999 _CNV_R_R_Def_wdk_sw_683_CM 0. 1599.9755 FORMAT "%5.2"
 /begin AXIS_DESCR STD_AXIS Nkw _CNV_R_R_Def_n_sw_q_595_CM 10 -32768. 32767. FORMAT "%5.0" /end AXIS_DESCR
 /begin AXIS_DESCR STD_AXIS Tmot _CNV_R_R_Def_t_sw_q_579_CM 10 -327.68 327.67 FORMAT "%5.2" /end AXIS_DESCR
/end CHARACTERISTIC
/begin CHARACTERISTIC KF_DPS "Diffdruck Vvt" MAP 0xa0831e28 _REC_MAP_52_UBYTE_s2_s2_s2 102.398436 _CNV_R_R_Def_p_sw_q_576_CM -1280. 1279.9609 FORMAT "%5.2"
 /begin AXIS_DESCR STD_AXIS Nkw _CNV_R_R_Def_n_sw_q_595_CM 8 -32768. 32767. FORMAT "%5.0" /end AXIS_DESCR
 /begin AXIS_DESCR STD_AXIS Rfv_soll _CNV_R_R_Def_rf_sw__598_CM 8 -327.68 327.67 FORMAT "%7.4" /end AXIS_DESCR
/end CHARACTERISTIC
/begin CHARACTERISTIC KF_ESVNS "Wichtung ES-Volumen" MAP 0xa0832fc0 _REC_MAP_52_UBYTE_u2_s2_s2 3.9999 _CNV_R_R_Def_f_sw_b_616_CM 0. 3.9999 FORMAT "%14.5"
 /begin AXIS_DESCR STD_AXIS Nkw _CNV_R_R_Def_n_sw_q_595_CM 6 -32768. 32767. FORMAT "%5.0" /end AXIS_DESCR
 /begin AXIS_DESCR STD_AXIS Rfv_soll _CNV_R_R_Def_rf_sw__598_CM 6 -327.68 327.67 FORMAT "%7.4" /end AXIS_DESCR
/end CHARACTERISTIC
/begin CHARACTERISTIC KF_FHUB_NST "Überblendung Fhubvnsi" MAP 0xa08330c8 _REC_MAP_52_u1_s2_u2 0.996 _CNV_R_R_Def_f_ub_b_553_CM 0. 0.996
 /begin AXIS_DESCR STD_AXIS Tmot_start _CNV_R_R_Def_t_sw_q_579_CM 6 -327.68 327.67 FORMAT "%5.2" /end AXIS_DESCR
 /begin AXIS_DESCR STD_AXIS Tn_start_10 _CNV_R_R_Def_td_uw__673_CM 6 0. 655.35 FORMAT "%5.2" /end AXIS_DESCR
/end CHARACTERISTIC
/begin CHARACTERISTIC KF_FLAEAN "Kennfeld konstante Ansaugfläche" MAP 0xa0832bc4 _REC_MAP_52_UBYTE_u2_u2_u2 104.856 _CNV_R_R_Def_flae_u_646_CM 0. 1048.56 FORMAT "%5.2"
 /begin AXIS_DESCR STD_AXIS Hubev_soll_kf _CNV_R_R_Def_hub_uw_589_CM 16 0. 65.535 /end AXIS_DESCR
 /begin AXIS_DESCR STD_AXIS Vse_sprn _CNV_R_R_Def_spr_sw_561_CM 16 0. 6553.5 FORMAT "%5.2" /end AXIS_DESCR
/end CHARACTERISTIC
/begin CHARACTERISTIC KF_FTRANSVL "" MAP 0xa08322a4 _REC_MAP_52_UBYTE_u2_s2_u2 0.9999 _CNV_R_R_Def_f_uw_b_571_CM 0. 0.9999 FORMAT "%14.5"
 /begin AXIS_DESCR STD_AXIS Nkw _CNV_R_R_Def_n_sw_q_595_CM 8 -32768. 32767. FORMAT "%5.0" /end AXIS_DESCR
 /begin AXIS_DESCR STD_AXIS NO_INPUT_QUANTITY _CNV_R_R_Def_f_uw_b_571_CM 8 0. 0.9999 FORMAT "%14.5" /end AXIS_DESCR
/end CHARACTERISTIC
/begin CHARACTERISTIC KF_HUBE "Sollwert Einlassventilhub UGD" MAP 0xa08323f4 _REC_MAP_52_UBYTE_u2_s2_s2 12. _CNV_R_R_Def_hub_uw_589_CM 0. 12.
 /begin AXIS_DESCR STD_AXIS Nkw _CNV_R_R_Def_n_sw_q_595_CM 20 -32768. 32767. FORMAT "%5.0" /end AXIS_DESCR
 /begin AXIS_DESCR STD_AXIS Rfv_hub _CNV_R_R_Def_rf_sw__598_CM 20 -327.68 327.67 FORMAT "%7.4" /end AXIS_DESCR
/end CHARACTERISTIC
/begin CHARACTERISTIC KF_HUBELL "Sollwert Einlassventilhub im Leerlauf" MAP 0xa0832768 _REC_MAP_52_UBYTE_u2_u2_s2 12. _CNV_R_R_Def_hub_uw_589_CM 0. 12.
 /begin AXIS_DESCR STD_AXIS Msnsolps _CNV_R_R_Def_ms_uw__594_CM 21 0. 2047.9687 /end AXIS_DESCR
 /begin AXIS_DESCR STD_AXIS Nkw _CNV_R_R_Def_n_sw_q_595_CM 6 -32768. 32767. FORMAT "%5.0" /end AXIS_DESCR
/end CHARACTERISTIC
/begin CHARACTERISTIC KF_HUBEST "Sollwert Einlassventilhub im Start" MAP 0xa0832a7c _REC_MAP_52_UBYTE_u2_s2_s2 12. _CNV_R_R_Def_hub_uw_589_CM 0. 12.
 /begin AXIS_DESCR STD_AXIS Nkw _CNV_R_R_Def_n_sw_q_595_CM 8 -32768. 32767. FORMAT "%5.0" /end AXIS_DESCR
 /begin AXIS_DESCR STD_AXIS Rfv_soll _CNV_R_R_Def_rf_sw__598_CM 8 -327.68 327.67 FORMAT "%7.4" /end AXIS_DESCR
/end CHARACTERISTIC
/begin CHARACTERISTIC KF_HUBESTM "Sollwert Einlassventilhub im Start (Abh. von Tmot_start)" MAP 0xa0832b20 _REC_MAP_52_UBYTE_u2_s2_s2 12. _CNV_R_R_Def_hub_uw_589_CM 0. 12.
 /begin AXIS_DESCR STD_AXIS Nkw _CNV_R_R_Def_n_sw_q_595_CM 8 -32768. 32767. FORMAT "%5.0" /end AXIS_DESCR
 /begin AXIS_DESCR STD_AXIS Tmot_start _CNV_R_R_Def_t_sw_q_579_CM 8 -327.68 327.67 FORMAT "%5.2" /end AXIS_DESCR
/end CHARACTERISTIC
/begin CHARACTERISTIC KF_MSSDYN_KOR "" MAP 0xa0832348 _REC_MAP_52_UBYTE_u2_s2_u2 3.9999 _CNV_R_R_Def_f_sw_b_616_CM 0. 3.9999 FORMAT "%14.5"
 /begin AXIS_DESCR STD_AXIS Nkw _CNV_R_R_Def_n_sw_q_595_CM 6 -32768. 32767. FORMAT "%5.0" /end AXIS_DESCR
 /begin AXIS_DESCR STD_AXIS Pspvdk_soll _CNV_R_R_Def_f_sw_b_616_CM 6 0. 3.9999 FORMAT "%14.5" /end AXIS_DESCR
/end CHARACTERISTIC
/begin CHARACTERISTIC KF_MSZSVNST "Wichtungsfaktor" MAP 0xa0831ecc _REC_MAP_52_u1_s2_s2 0.996 _CNV_R_R_Def_f_ub_b_553_CM 0. 0.996
 /begin AXIS_DESCR STD_AXIS Nkw _CNV_R_R_Def_n_sw_q_595_CM 4 -32768. 32767. FORMAT "%5.0" /end AXIS_DESCR
 /begin AXIS_DESCR STD_AXIS Rfv_soll _CNV_R_R_Def_rf_sw__598_CM 4 -327.68 327.67 FORMAT "%7.4" /end AXIS_DESCR
/end CHARACTERISTIC
/begin CHARACTERISTIC KF_NKW_TN "Zeit / Drehzahl anpassung" MAP 0xa081ad50 _REC_MAP_52_u1_s2_u2 2.55 _CNV_R_R_Def_lf_ub__670_CM 0. 2.55 FORMAT "%5.2"
 /begin AXIS_DESCR STD_AXIS Nkw _CNV_R_R_Def_n_sw_q_595_CM 4 -32768. 32767. FORMAT "%5.0" /end AXIS_DESCR
 /begin AXIS_DESCR STD_AXIS NO_INPUT_QUANTITY _CNV_R_R_Def_td_uw__673_CM 4 0. 655.35 FORMAT "%5.2" /end AXIS_DESCR
/end CHARACTERISTIC
/begin CHARACTERISTIC KF_PSPLD_DYN "Soll-Druckverh. im Turbobetrieb" MAP 0xa0833520 _REC_MAP_52_UBYTE_u2_s2_u2 1.9999 _CNV_R_R_Def_f_uw_b_590_CM 0. 1.9999 FORMAT "%14.5"
 /begin AXIS_DESCR STD_AXIS Nkw _CNV_R_R_Def_n_sw_q_595_CM 6 -32768. 32767. FORMAT "%5.0" /end AXIS_DESCR
 /begin AXIS_DESCR STD_AXIS F_psspu _CNV_R_R_Def_f_sw_b_616_CM 6 0. 3.9999 FORMAT "%14.5" /end AXIS_DESCR
/end CHARACTERISTIC
/begin CHARACTERISTIC KF_PSPLD_ECO "Soll-Druckverh. im Normalbetrieb" MAP 0xa0833584 _REC_MAP_52_UBYTE_u2_s2_u2 1.9999 _CNV_R_R_Def_f_uw_b_590_CM 0. 1.9999 FORMAT "%14.5"
 /begin AXIS_DESCR STD_AXIS Nkw _CNV_R_R_Def_n_sw_q_595_CM 6 -32768. 32767. FORMAT "%5.0" /end AXIS_DESCR
 /begin AXIS_DESCR STD_AXIS F_psspu _CNV_R_R_Def_f_sw_b_616_CM 6 0. 3.9999 FORMAT "%14.5" /end AXIS_DESCR
/end CHARACTERISTIC
/begin CHARACTERISTIC KF_RUSS_KALT "Russkennfeld kalt" MAP 0xa081ad74 _REC_MAP_52_UBYTE_u2_s2_s2 98.30250000000001 _CNV_R_R_Def_russ_u_675_CM 0. 655.35
 /begin AXIS_DESCR STD_AXIS Nkw _CNV_R_R_Def_n_sw_q_595_CM 12 -32768. 32767. FORMAT "%5.0" /end AXIS_DESCR
 /begin AXIS_DESCR STD_AXIS NO_INPUT_QUANTITY _CNV_R_R_Def_m_sw_q_554_CM 12 -3276.8 3276.7 FORMAT "%5.2" /end AXIS_DESCR
/end CHARACTERISTIC
/begin CHARACTERISTIC KF_RUSS_WARM "Russkennfeld warm" MAP 0xa081aec8 _REC_MAP_52_UBYTE_u2_s2_s2 98.30250000000001 _CNV_R_R_Def_russ_u_675_CM 0. 655.35
 /begin AXIS_DESCR STD_AXIS Nkw _CNV_R_R_Def_n_sw_q_595_CM 12 -32768. 32767. FORMAT "%5.0" /end AXIS_DESCR
 /begin AXIS_DESCR STD_AXIS NO_INPUT_QUANTITY _CNV_R_R_Def_m_sw_q_554_CM 12 -3276.8 3276.7 FORMAT "%5.2" /end AXIS_DESCR
/end CHARACTERISTIC
/begin CHARACTERISTIC KF_SRKOR_SPUEL "" MAP 0xa0831d3c _REC_MAP_52_UBYTE_s2_u2_u2 1.9999 _CNV_R_R_Def_f_uw_b_590_CM -1. 0.9999 FORMAT "%14.5" /begin AXIS_DESCR STD_AXIS Pak _CNV_R_R_Def_p_sw_q_576_CM 3 0. 2559.9609 /end AXIS_DESCR
 /begin AXIS_DESCR STD_AXIS Pssol _CNV_R_R_Def_p_sw_q_576_CM 8 0. 2559.9609 FORMAT "%5.2" /end AXIS_DESCR
/end CHARACTERISTIC
/begin CHARACTERISTIC KF_VNSDYNKOR "" MAP 0xa0831d84 _REC_MAP_52_UBYTE_s2_s2_s2 98.30250000000001 _CNV_R_R_Def_rf_sw__598_CM -327.68 327.67 FORMAT "%7.4"
 /begin AXIS_DESCR STD_AXIS Rf_fvns_k _CNV_R_R_Def_rf_sw__598_CM 8 -327.68 327.67 FORMAT "%7.4" /end AXIS_DESCR
 /begin AXIS_DESCR STD_AXIS Nkw _CNV_R_R_Def_n_sw_q_595_CM 8 -32768. 32767. FORMAT "%5.0" /end AXIS_DESCR
/end CHARACTERISTIC
/begin CHARACTERISTIC KF_WDKDPS "Kennfeld Drosselklappensollwinkel" MAP 0xa0832024 _REC_MAP_52_UBYTE_u2_u2_u2 95.99852999999999 _CNV_R_R_Def_wdk_sw_683_CM 0. 1599.9755 FORMAT "%5.2"
 /begin AXIS_DESCR STD_AXIS NO_INPUT_QUANTITY _CNV_R_R_Def_ms_uw__594_CM 21 0. 2047.9687 /end AXIS_DESCR
 /begin AXIS_DESCR STD_AXIS NO_INPUT_QUANTITY _CNV_R_R_Def_f_sw_b_616_CM 8 0. 3.9999 FORMAT "%14.5" /end AXIS_DESCR
/end CHARACTERISTIC
/begin CHARACTERISTIC KF_ZKVNSI "" MAP 0xa0833024 _REC_MAP_52_UBYTE_u2_s2_s2 655.35 _CNV_R_R_Def_zk10ms_715_CM 1.e-002 655.36 FORMAT "%7.4"
 /begin AXIS_DESCR STD_AXIS Dvse_spr _CNV_R_R_Def_spr_sw_561_CM 8 -3276.8 3276.7 FORMAT "%5.2" /end AXIS_DESCR
 /begin AXIS_DESCR STD_AXIS Nkw _CNV_R_R_Def_n_sw_q_595_CM 8 -32768. 32767. FORMAT "%5.0" /end AXIS_DESCR
/end CHARACTERISTIC
/begin CHARACTERISTIC KL_DHUBTM "Huboffset temperaturabhängig " CURVE 0xa0832a38 _REC_CUR_TKL_UW_VV__s2_s2 65.535 _CNV_R_R_Def_hub_uw_589_CM -32.768 32.767
 /begin AXIS_DESCR STD_AXIS Tmot _CNV_R_R_Def_t_sw_q_579_CM 6 -327.68 327.67 FORMAT "%5.2" /end AXIS_DESCR
/end CHARACTERISTIC
/begin CHARACTERISTIC KL_DKVL "Vollast-Kennlinie fuer Drosselklappensollwinkel" CURVE 0xa0831f1c _REC_CUR_TKL_UW_VV__u2_s2 95.99852999999999 _CNV_R_R_Def_wdk_sw_683_CM 0. 1599.9755 FORMAT "%5.2"
 /begin AXIS_DESCR STD_AXIS Nkw _CNV_R_R_Def_n_sw_q_595_CM 8 -32768. 32767. FORMAT "%5.0" /end AXIS_DESCR
/end CHARACTERISTIC
/begin CHARACTERISTIC KL_DNWELLK "" CURVE 0xa0832a68 _REC_CUR_TKL_UW_VV__s2_u2 0. _CNV_R_R_Def_n_sw_q_595_CM -32768. 32767. FORMAT "%5.0"
 /begin AXIS_DESCR STD_AXIS Tn_start_10 _CNV_R_R_Def_td_uw__673_CM 4 0. 655.35 FORMAT "%5.2" /end AXIS_DESCR
/end CHARACTERISTIC
/begin CHARACTERISTIC KL_DPSDKM "Ueberblendung zwischen Ansteuerung DK" CURVE 0xa0831fc0 _REC_CUR_TKL_UW_VV__u2_u2 1.9999 _CNV_R_R_Def_f_uw_b_590_CM 0. 1.9999 FORMAT "%14.5"
 /begin AXIS_DESCR STD_AXIS Pspvdk_soll _CNV_R_R_Def_f_sw_b_616_CM 6 0. 3.9999 FORMAT "%14.5" /end AXIS_DESCR
/end CHARACTERISTIC
/begin CHARACTERISTIC KL_EXWHKLL "Korrekturexzenterwinkel für Hubkorrektur im LL" CURVE 0xa0832904 _REC_CUR_TKL_UW_VV__s2_s2 99. _CNV_R_R_Def_exwink_585_CM -720. 180. FORMAT "%5.2"
 /begin AXIS_DESCR STD_AXIS Exwdifll _CNV_R_R_Def_exwink_585_CM 4 -720. 180. FORMAT "%5.2" /end AXIS_DESCR
/end CHARACTERISTIC
/begin CHARACTERISTIC KL_EXWMX_N "Begrenzung Exzenterwinkel drehzahlabhängig" CURVE 0xa0832918 _REC_CUR_TKL_UW_VV__u2_s2 100.8 _CNV_R_R_Def_exwink_585_CM 0. 180. FORMAT "%5.2"
 /begin AXIS_DESCR STD_AXIS Nkw _CNV_R_R_Def_n_sw_q_595_CM 6 -32768. 32767. FORMAT "%5.0" /end AXIS_DESCR
/end CHARACTERISTIC
/begin CHARACTERISTIC KL_E_FUNKTION "Approximation der E-Funktion" CURVE 0xa081714c _REC_CUR_TKL_UW_VV__S4_S4 0. _CNV_R_R_Def_dez_sl_551_CM -1000000000000. 10000000000000. FORMAT "%14.7"
 /begin AXIS_DESCR STD_AXIS NO_INPUT_QUANTITY _CNV_R_R_Def_dez_sl_551_CM 13 -1000000000000. 10000000000000. FORMAT "%14.7" /end AXIS_DESCR
/end CHARACTERISTIC
/begin CHARACTERISTIC KL_FHTMOT "Wichtungsfaktor Sollwert Einlassventilhub ueber Tmot" CURVE 0xa0832a24 _REC_CUR_TKL_UW_VV__u1_s2 0.996 _CNV_R_R_Def_f_ub_b_553_CM 0. 0.996
 /begin AXIS_DESCR STD_AXIS Tmot _CNV_R_R_Def_t_sw_q_579_CM 6 -327.68 327.67 FORMAT "%5.2" /end AXIS_DESCR
/end CHARACTERISTIC
/begin CHARACTERISTIC KL_FHUB_DPSFAK "Kennlinie Überblendung Fhubvnsi von Dpsfak" CURVE 0xa08329ec _REC_CUR_TKL_UW_VV__u1_u1 0.996 _CNV_R_R_Def_f_ub_b_553_CM 0. 0.996 /begin AXIS_DESCR STD_AXIS Dpsfak _CNV_R_R_Def_f_ub_b_553_CM 4 0. 0.996 /end AXIS_DESCR /end CHARACTERISTIC
/begin CHARACTERISTIC KL_FHUB_ST "" CURVE 0xa08329d0 _REC_CUR_TKL_UW_VV__u2_s2 1.9999 _CNV_R_R_Def_f_uw_b_590_CM 0. 1.9999 FORMAT "%14.5"
 /begin AXIS_DESCR STD_AXIS Tmot_start _CNV_R_R_Def_t_sw_q_579_CM 6 -327.68 327.67 FORMAT "%5.2" /end AXIS_DESCR
/end CHARACTERISTIC
/begin CHARACTERISTIC KL_FPWDKAPP "DK-Winkel abh. von Fahrpedal, nur fuer Applikation" CURVE 0xa0831f40 _REC_CUR_TKL_UW_VV__u2_s2 95.99852999999999 _CNV_R_R_Def_wdk_sw_683_CM 0. 1599.9755 FORMAT "%5.2"
 /begin AXIS_DESCR STD_AXIS Pwg_ist _CNV_R_R_Def_wdk_sw_683_CM 4 -800. 799.9755 FORMAT "%5.2" /end AXIS_DESCR
/end CHARACTERISTIC
/begin CHARACTERISTIC KL_FUPSRF_TRANS "Fupsrf, GD (vereinfachte N.N.)" CURVE 0xa0831c34 _REC_CUR_TKL_UW_VV__u2_s2 0.2999 _CNV_R_R_Def_f_uw_b_629_CM 0. 0.2999 FORMAT "%14.6"
 /begin AXIS_DESCR STD_AXIS Nkw _CNV_R_R_Def_n_sw_q_595_CM 8 -32768. 32767. FORMAT "%5.0" /end AXIS_DESCR
/end CHARACTERISTIC
/begin CHARACTERISTIC KL_GDVNSFIL "Zeitkonstante Filterung Rfv_vns_dk" CURVE 0xa0831bec _REC_CUR_TKL_UW_VV__u2_s2 99.9984 _CNV_R_R_Def_f_uw_b_555_CM 0. 99.9984
 /begin AXIS_DESCR STD_AXIS Rfv_soll _CNV_R_R_Def_rf_sw__598_CM 8 -327.68 327.67 FORMAT "%7.4" /end AXIS_DESCR
/end CHARACTERISTIC
/begin CHARACTERISTIC KL_HUBAPP "Sollwert Einlassventilhub fuer Applikation ueber Wped" CURVE 0xa0832988 _REC_CUR_TKL_UW_VV__u2_s2 12. _CNV_R_R_Def_hub_uw_589_CM 0. 12.
 /begin AXIS_DESCR STD_AXIS Pwg_ist _CNV_R_R_Def_wdk_sw_683_CM 4 -800. 799.9755 FORMAT "%5.2" /end AXIS_DESCR
/end CHARACTERISTIC
/begin CHARACTERISTIC KL_HUBEVL "Sollwert Einlassventilhub bei Vollast" CURVE 0xa08323b0 _REC_CUR_TKL_UW_VV__u2_s2 12. _CNV_R_R_Def_hub_uw_589_CM 0. 12.
 /begin AXIS_DESCR STD_AXIS Nkw _CNV_R_R_Def_n_sw_q_595_CM 16 -32768. 32767. FORMAT "%5.0" /end AXIS_DESCR
/end CHARACTERISTIC
/begin CHARACTERISTIC KL_HUBEX "Kennlinie Huberverstellung -> Exzenterwellenwinkel" CURVE 0xa083299c _REC_CUR_TKL_UW_VV__u2_u2 100.78768 _CNV_R_R_Def_exwink_585_CM 0. 179.978 FORMAT "%5.2" /begin AXIS_DESCR STD_AXIS Hubev_ist _CNV_R_R_Def_hub_uw_589_CM 12 0. 12. /end AXIS_DESCR /end CHARACTERISTIC
/begin CHARACTERISTIC KL_HUBV "Sollwert Einlassventilhub bei B_gdvhub" CURVE 0xa0832934 _REC_CUR_TKL_UW_VV__u2_s2 12. _CNV_R_R_Def_hub_uw_589_CM 0. 12.
 /begin AXIS_DESCR STD_AXIS Nkw _CNV_R_R_Def_n_sw_q_595_CM 8 -32768. 32767. FORMAT "%5.0" /end AXIS_DESCR
/end CHARACTERISTIC
/begin CHARACTERISTIC KL_INVTANSIG "Approximation inverse tansig-Funktion" CURVE 0xa081720c _REC_CUR_TKL_UW_VV__S4_S4 0. _CNV_R_R_Def_dez_sl_551_CM -1000000000000. 0. FORMAT "%14.7"
 /begin AXIS_DESCR STD_AXIS NO_INPUT_QUANTITY _CNV_R_R_Def_dez_sl_551_CM 10 -1000000000000. 0. FORMAT "%14.7" /end AXIS_DESCR
/end CHARACTERISTIC
/begin CHARACTERISTIC KL_KMST_FAK "Kilometerfaktor" CURVE 0xa081acf4 _REC_CUR_TKL_UW_VV__u1_u2 2.55 _CNV_R_R_Def_lf_ub__670_CM 0. 2.55 FORMAT "%5.2"
 /begin AXIS_DESCR STD_AXIS Km_st _CNV_R_R_Def_km_sw__68_CM 6 0. 655350. FORMAT "%5.0" /end AXIS_DESCR
/end CHARACTERISTIC
/begin CHARACTERISTIC KL_MSNLG "Leckluft DK geschlossen, Tmot" CURVE 0xa0831ef0 _REC_CUR_TKL_UW_VV__u2_s2 81.91875 _CNV_R_R_Def_ms_uw__655_CM 0. 8191.875 FORMAT "%5.2"
 /begin AXIS_DESCR STD_AXIS Tmot _CNV_R_R_Def_t_sw_q_579_CM 4 -327.68 327.67 FORMAT "%5.2" /end AXIS_DESCR
/end CHARACTERISTIC
/begin CHARACTERISTIC KL_MSSDYN_KOR "" CURVE 0xa0832000 _REC_CUR_TKL_UW_VV__u2_s2 1.9999 _CNV_R_R_Def_f_uw_b_590_CM 0. 1.9999 FORMAT "%14.5"
 /begin AXIS_DESCR STD_AXIS NO_INPUT_QUANTITY _CNV_R_R_Def_p_sw_q_576_CM 8 -1280. 1279.9609 FORMAT "%5.2" /end AXIS_DESCR
/end CHARACTERISTIC
/begin CHARACTERISTIC KL_OZBEFKL "Befüllkennlinie" CURVE 0xa081aca0 _REC_CUR_TKL_UW_VV__u1_u1 25.5 _CNV_R_R_Def_niv_ub_671_CM 0. 25.5 FORMAT "%5.2"
 /begin AXIS_DESCR STD_AXIS Oz_nivlangt _CNV_R_R_Def_niv_ub_667_CM 6 0. 74.70699999999999 FORMAT "%5.2" /end AXIS_DESCR
/end CHARACTERISTIC
/begin CHARACTERISTIC KL_OZTKKVB "Temperaturkompensation Kraftstoffverbrauch" CURVE 0xa081ad3c _REC_CUR_TKL_UW_VV__u1_s2 7.9687 _CNV_R_R_Def_f_ub_b_694_CM 0. 7.9687 FORMAT "%5.2"
 /begin AXIS_DESCR STD_AXIS Toel_oz _CNV_R_R_Def_t_sw_q_578_CM 6 -3276.8 3276.7 FORMAT "%4.1" /end AXIS_DESCR
/end CHARACTERISTIC
/begin CHARACTERISTIC KL_OZVERDFAK "Verdünnungsfaktor von Dieseleintrag" CURVE 0xa081ad24 _REC_CUR_TKL_UW_VV__u2_u2 0.9999847412109381 _CNV_R_R_Def_f_uw_b_571_CM 0. 0.9999847412109381 FORMAT "%14.5"
 /begin AXIS_DESCR STD_AXIS NO_INPUT_QUANTITY _CNV_R_R_Def_f_uw_b_571_CM 5 0. 0.9999 FORMAT "%14.5" /end AXIS_DESCR
/end CHARACTERISTIC
/begin CHARACTERISTIC KL_PIRG_TRANS "Pirg, GD (vereinfachte N.N.)" CURVE 0xa0831c10 _REC_CUR_TKL_UW_VV__u2_s2 102.398436 _CNV_R_R_Def_p_sw_q_576_CM 0. 2559.9609 FORMAT "%5.2"
 /begin AXIS_DESCR STD_AXIS Nkw _CNV_R_R_Def_n_sw_q_595_CM 8 -32768. 32767. FORMAT "%5.0" /end AXIS_DESCR
/end CHARACTERISTIC
/begin CHARACTERISTIC KL_PSRF_GRD "" CURVE 0xa0831d08 _REC_CUR_TKL_UW_VV__u2_u2 31.99950000000001 _CNV_R_R_Def_f_uw_b_588_CM 0. 31.9995 FORMAT "%7.4"
 /begin AXIS_DESCR STD_AXIS NO_INPUT_QUANTITY _CNV_R_R_Def_f_uw_b_571_CM 12 0. 0.9999 FORMAT "%14.5" /end AXIS_DESCR
/end CHARACTERISTIC
/begin CHARACTERISTIC KL_RANWI "Kennlinie Regler I-Anteil Auslassspreizung variable NWS" CURVE 0xa082edf0 _REC_CUR_TKL_UW_VV__u2_u2 99.99844999999999 _CNV_R_R_Def_rel_uw_729_CM -100. 99.9969
 /begin AXIS_DESCR STD_AXIS Vsadwnwkl _CNV_R_R_Def_spr_uw_733_CM 16 -3276.8 3276.7 FORMAT "%5.2" /end AXIS_DESCR
/end CHARACTERISTIC
/begin CHARACTERISTIC KL_RANWP "Kennlinie Regler P-Anteil Auslassspreizung variable NWS" CURVE 0xa082edac _REC_CUR_TKL_UW_VV__u2_u2 99.99844999999999 _CNV_R_R_Def_rel_uw_729_CM -100. 99.9969
 /begin AXIS_DESCR STD_AXIS Vsadwnwkl _CNV_R_R_Def_spr_uw_733_CM 16 -3276.8 3276.7 FORMAT "%5.2" /end AXIS_DESCR
/end CHARACTERISTIC
/begin CHARACTERISTIC KL_RENWI "Kennlinie Regler I-Anteil Einlassspreizung variable NWS" CURVE 0xa082ed68 _REC_CUR_TKL_UW_VV__u2_u2 99.99844999999999 _CNV_R_R_Def_rel_uw_729_CM -100. 99.9969
 /begin AXIS_DESCR STD_AXIS Vsedwnwkl _CNV_R_R_Def_spr_uw_733_CM 16 -3276.8 3276.7 FORMAT "%5.2" /end AXIS_DESCR
/end CHARACTERISTIC
/begin CHARACTERISTIC KL_RENWP "Kennlinie Regler P-Anteil Einlassspreizung variable NWS" CURVE 0xa082ed24 _REC_CUR_TKL_UW_VV__u2_u2 99.99844999999999 _CNV_R_R_Def_rel_uw_729_CM -100. 99.9969
 /begin AXIS_DESCR STD_AXIS Vsedwnwkl _CNV_R_R_Def_spr_uw_733_CM 16 -3276.8 3276.7 FORMAT "%5.2" /end AXIS_DESCR
/end CHARACTERISTIC
/begin CHARACTERISTIC KL_RFTNLMX "" CURVE 0xa0831c9c _REC_CUR_TKL_UW_VV__s2_s2 98.30250000000001 _CNV_R_R_Def_rf_sw__598_CM -327.68 327.67 FORMAT "%7.4"
 /begin AXIS_DESCR STD_AXIS Nkw _CNV_R_R_Def_n_sw_q_595_CM 10 -32768. 32767. FORMAT "%5.0" /end AXIS_DESCR
/end CHARACTERISTIC
/begin CHARACTERISTIC KL_SRKOR_SPUEL "" CURVE 0xa0831cdc _REC_CUR_TKL_UW_VV__u2_u2 15.9997 _CNV_R_R_Def_f_uw_b_559_CM 0. 15.9997 FORMAT "%7.4"
 /begin AXIS_DESCR STD_AXIS NO_INPUT_QUANTITY _CNV_R_R_Def_f_uw_b_590_CM 10 0. 1.9999 FORMAT "%14.5" /end AXIS_DESCR
/end CHARACTERISTIC
/begin CHARACTERISTIC KL_TANSIG "Approximation tansig-Funktion" CURVE 0xa08171b8 _REC_CUR_TKL_UW_VV__S4_S4 0. _CNV_R_R_Def_dez_sl_551_CM -1000000000000. 0. FORMAT "%14.7"
 /begin AXIS_DESCR STD_AXIS NO_INPUT_QUANTITY _CNV_R_R_Def_dez_sl_551_CM 10 -1000000000000. 0. FORMAT "%14.7" /end AXIS_DESCR
/end CHARACTERISTIC
/begin CHARACTERISTIC KL_TDFPSPLD "Zeit f. Ueberblendung" CURVE 0xa083350c _REC_CUR_TKL_UW_VV__u2_s2 65.52499999999999 _CNV_R_R_Def_td_uw__663_CM 1.e-002 65.535
 /begin AXIS_DESCR STD_AXIS Nkw _CNV_R_R_Def_n_sw_q_595_CM 4 -32768. 32767. FORMAT "%5.0" /end AXIS_DESCR
/end CHARACTERISTIC
/begin CHARACTERISTIC KL_TEMP_FAK "Temperaturanpassung" CURVE 0xa081ad08 _REC_CUR_TKL_UW_VV__u2_s2 7.9998 _CNV_R_R_Def_f_uw_b_572_CM 0. 7.9998 FORMAT "%7.4"
 /begin AXIS_DESCR STD_AXIS Tmot _CNV_R_R_Def_t_sw_q_579_CM 6 -327.68 327.67 FORMAT "%5.2" /end AXIS_DESCR
/end CHARACTERISTIC
/begin CHARACTERISTIC KL_TVP_A "Sollwertvorgabe für TV-Puls Auslass" CURVE 0xa082ee58 _REC_CUR_TKL_UW_VV__s2_u2 98.30250000000001 _CNV_R_R_Def_rf_sw__598_CM -327.68 327.67
 /begin AXIS_DESCR STD_AXIS Vns_tv_cnt _CNV_R_R_Def_dez_sl_551_CM 8 0. 65535. FORMAT "%5.0" /end AXIS_DESCR
/end CHARACTERISTIC
/begin CHARACTERISTIC KL_TVP_E "Sollwertvorgabe für TV-Puls Einlass" CURVE 0xa082ee34 _REC_CUR_TKL_UW_VV__s2_u2 98.30250000000001 _CNV_R_R_Def_rf_sw__598_CM -327.68 327.67
 /begin AXIS_DESCR STD_AXIS Vns_tv_cnt _CNV_R_R_Def_dez_sl_551_CM 8 0. 65535. FORMAT "%5.0" /end AXIS_DESCR
/end CHARACTERISTIC
/begin CHARACTERISTIC KL_TWDKNVN "Zeitkonstante Filter Drosselklappensollwert, UG" CURVE 0xa0831f9c _REC_CUR_TKL_UW_VV__u2_s2 655.35 _CNV_R_R_Def_zk10ms_715_CM 1.e-002 655.36 FORMAT "%7.4"
 /begin AXIS_DESCR STD_AXIS Nkw _CNV_R_R_Def_n_sw_q_595_CM 8 -32768. 32767. FORMAT "%5.0" /end AXIS_DESCR
/end CHARACTERISTIC
/begin CHARACTERISTIC KL_TWDKNVP "Zeitkonstante Filter Drosselklappensollwert, UG" CURVE 0xa0831f78 _REC_CUR_TKL_UW_VV__u2_s2 655.35 _CNV_R_R_Def_zk10ms_715_CM 1.e-002 655.36 FORMAT "%7.4"
 /begin AXIS_DESCR STD_AXIS Nkw _CNV_R_R_Def_n_sw_q_595_CM 8 -32768. 32767. FORMAT "%5.0" /end AXIS_DESCR
/end CHARACTERISTIC
/begin CHARACTERISTIC KL_TWDKSV "Zeitkonstante Filter Drosselklappensollwert, GD/TG" CURVE 0xa0831f54 _REC_CUR_TKL_UW_VV__u2_u2 655.35 _CNV_R_R_Def_zk10ms_715_CM 1.e-002 655.36 FORMAT "%7.4"
 /begin AXIS_DESCR STD_AXIS NO_INPUT_QUANTITY _CNV_R_R_Def_f_sw_b_616_CM 8 0. 3.9999 FORMAT "%14.5" /end AXIS_DESCR
/end CHARACTERISTIC
/begin CHARACTERISTIC KL_VNSD_TOEL "Kennlinie Toel-Schwelle für Diagnose" CURVE 0xa0831b40 _REC_CUR_TKL_UW_VV__s2_s2 131.07 _CNV_R_R_Def_t_sw_q_578_CM -3276.8 3276.7 FORMAT "%4.1"
 /begin AXIS_DESCR STD_AXIS Nkw _CNV_R_R_Def_n_sw_q_595_CM 6 -32768. 32767. FORMAT "%5.0" /end AXIS_DESCR
/end CHARACTERISTIC
/begin CHARACTERISTIC KL_VNSTMOT "Korrekturkennlinie P-Anteil" CURVE 0xa082ecc8 _REC_CUR_TKL_UW_VV__u1_s2 1.9921 _CNV_R_R_Def_f_ub_b_613_CM 0. 1.9921
 /begin AXIS_DESCR STD_AXIS Tmot _CNV_R_R_Def_t_sw_q_579_CM 6 -327.68 327.67 FORMAT "%5.2" /end AXIS_DESCR
/end CHARACTERISTIC
/begin CHARACTERISTIC KL_VNSTVUB "Kennlinie ub-AbhaEngigkeit TastverhaEltnis variable NWS" CURVE 0xa082ecb4 _REC_CUR_TKL_UW_VV__u1_u2 1.9921 _CNV_R_R_Def_f_ub_b_613_CM 0. 1.9921
 /begin AXIS_DESCR STD_AXIS Ub _CNV_R_R_Def_u_sb_q_583_CM 6 0. 6173.397 FORMAT "%4.1" /end AXIS_DESCR
/end CHARACTERISTIC
/begin CHARACTERISTIC KL_VSAFPWM "Ansteuerfrequenz VNS-Magnetventil Auslass" CURVE 0xa082ee8c _REC_CUR_TKL_UW_VV__u1_s2 100.45 _CNV_R_R_Def_freq_u_728_CM 10. 255. FORMAT "%3.0"
 /begin AXIS_DESCR STD_AXIS Tmot _CNV_R_R_Def_t_sw_q_579_CM 4 -327.68 327.67 FORMAT "%5.2" /end AXIS_DESCR
/end CHARACTERISTIC
/begin CHARACTERISTIC KL_VSA_ITMOT "Initialisierung I-Regler (Tmot) Auslaß" CURVE 0xa082ed00 _REC_CUR_TKL_UW_VV__u2_s2 99.99844999999999 _CNV_R_R_Def_rel_uw_729_CM -100. 99.9969
 /begin AXIS_DESCR STD_AXIS Tmot _CNV_R_R_Def_t_sw_q_579_CM 8 -327.68 327.67 FORMAT "%5.2" /end AXIS_DESCR
/end CHARACTERISTIC
/begin CHARACTERISTIC KL_VSEFPWM "Ansteuerfrequenz VNS-Magnetventil Einlass" CURVE 0xa082ee7c _REC_CUR_TKL_UW_VV__u1_s2 100.45 _CNV_R_R_Def_freq_u_728_CM 10. 255. FORMAT "%3.0"
 /begin AXIS_DESCR STD_AXIS Tmot _CNV_R_R_Def_t_sw_q_579_CM 4 -327.68 327.67 FORMAT "%5.2" /end AXIS_DESCR
/end CHARACTERISTIC
/begin CHARACTERISTIC KL_VSE_ITMOT "Initialisierung I-Regler (Tmot) Einlaß" CURVE 0xa082ecdc _REC_CUR_TKL_UW_VV__u2_s2 99.99844999999999 _CNV_R_R_Def_rel_uw_729_CM -100. 99.9969
 /begin AXIS_DESCR STD_AXIS Tmot _CNV_R_R_Def_t_sw_q_579_CM 8 -327.68 327.67 FORMAT "%5.2" /end AXIS_DESCR
/end CHARACTERISTIC
/begin CHARACTERISTIC KL_VVTCLOSE "Sollwert Einlassventilhub fuer zufahren im Nachlauf" CURVE 0xa0832958 _REC_CUR_TKL_UW_VV__u2_s2 100.78768 _CNV_R_R_Def_exwink_585_CM 0. 179.978 FORMAT "%5.2"
 /begin AXIS_DESCR STD_AXIS Nkw _CNV_R_R_Def_n_sw_q_595_CM 5 -32768. 32767. FORMAT "%5.0" /end AXIS_DESCR
/end CHARACTERISTIC
/begin CHARACTERISTIC KL_VVTCLOSE_AT "Sollwert Einlassventilhub fuer zufahren im Nachlauf (ATG)" CURVE 0xa0832970 _REC_CUR_TKL_UW_VV__u2_s2 100.78768 _CNV_R_R_Def_exwink_585_CM 0. 179.978 FORMAT "%5.2"
 /begin AXIS_DESCR STD_AXIS Nkw _CNV_R_R_Def_n_sw_q_595_CM 5 -32768. 32767. FORMAT "%5.0" /end AXIS_DESCR
/end CHARACTERISTIC
/begin CHARACTERISTIC KL_WDKSNLN "Drosselklappenwinkel bei KL15 aus" CURVE 0xa0831fdc _REC_CUR_TKL_UW_VV__u2_s2 95.99852999999999 _CNV_R_R_Def_wdk_sw_683_CM 0. 1599.9755 FORMAT "%5.2"
 /begin AXIS_DESCR STD_AXIS Nkw _CNV_R_R_Def_n_sw_q_595_CM 8 -32768. 32767. FORMAT "%5.0" /end AXIS_DESCR
/end CHARACTERISTIC
/begin CHARACTERISTIC KL_WKRM_FAK "zylinderindividueller Zündwinkelspätverstellungsfaktor" CURVE 0xa081accc _REC_CUR_TKL_UW_VV__u1_s2 1.9921 _CNV_R_R_Def_f_ub_b_613_CM 0. 1.9921
 /begin AXIS_DESCR STD_AXIS Dzw_mkr _CNV_R_R_Def_zw_sw__604_CM 12 -50. 60. FORMAT "%4.1" /end AXIS_DESCR
/end CHARACTERISTIC
/begin CHARACTERISTIC KL_ZKPVDKDS "Zeitkonstante f. Druck vor DK" CURVE 0xa0831c58 _REC_CUR_TKL_UW_VV__u1_s2 2.55 _CNV_R_R_Def_zk10ms_754_CM 1.e-002 2.56 FORMAT "%4.1"
 /begin AXIS_DESCR STD_AXIS Nkw _CNV_R_R_Def_n_sw_q_595_CM 8 -32768. 32767. FORMAT "%5.0" /end AXIS_DESCR
/end CHARACTERISTIC
/begin CHARACTERISTIC KL_ZKVNSI_LL "Huboffset temperaturabhängig " CURVE 0xa0832a54 _REC_CUR_TKL_UW_VV__u2_s2 655.35 _CNV_R_R_Def_zk10ms_715_CM 1.e-002 655.36 FORMAT "%7.4"
 /begin AXIS_DESCR STD_AXIS Tmot _CNV_R_R_Def_t_sw_q_579_CM 4 -327.68 327.67 FORMAT "%5.2" /end AXIS_DESCR
/end CHARACTERISTIC
/begin CHARACTERISTIC KL_ZK_DRFSPUEL "Zeitkonstante f. Drf_spuel" CURVE 0xa0831c74 _REC_CUR_TKL_UW_VV__u2_s2 6553.5 _CNV_R_R_Def_zk100m_739_CM 0.1 6553.6 FORMAT "%4.1"
 /begin AXIS_DESCR STD_AXIS Nkw _CNV_R_R_Def_n_sw_q_595_CM 4 -32768. 32767. FORMAT "%5.0" /end AXIS_DESCR
/end CHARACTERISTIC
/begin CHARACTERISTIC KL_ZK_DRFUK "Zeitkonstante f. Drf_uk" CURVE 0xa0831c88 _REC_CUR_TKL_UW_VV__u2_s2 6553.5 _CNV_R_R_Def_zk100m_739_CM 0.1 6553.6 FORMAT "%4.1"
 /begin AXIS_DESCR STD_AXIS Nkw _CNV_R_R_Def_n_sw_q_595_CM 4 -32768. 32767. FORMAT "%5.0" /end AXIS_DESCR
/end CHARACTERISTIC
/begin CHARACTERISTIC KL_ZK_VNSDYNKOR "Zeitkonstante f. VNSDYNKOR" CURVE 0xa0831cc8 _REC_CUR_TKL_UW_VV__u2_s2 0.9999 _CNV_R_R_Def_f_uw_b_571_CM 0. 0.9999 FORMAT "%14.5"
 /begin AXIS_DESCR STD_AXIS Nkw _CNV_R_R_Def_n_sw_q_595_CM 4 -32768. 32767. FORMAT "%5.0" /end AXIS_DESCR
/end CHARACTERISTIC
/begin CHARACTERISTIC KL_ZYLN "normiertes Zylindervolumen ueber Kurbelwellenwinkel" CURVE 0xa08329f8 _REC_CUR_TKL_UW_VV__u2_u2 0.9999 _CNV_R_R_Def_f_uw_b_571_CM 0. 0.9999 FORMAT "%14.5"
 /begin AXIS_DESCR STD_AXIS Vse_spris _CNV_R_R_Def_spr_sw_561_CM 10 0. 6553.5 FORMAT "%5.2" /end AXIS_DESCR
/end CHARACTERISTIC
/begin CHARACTERISTIC K_ASP2_ADPWF "Adaptionswert Anschlag Auslassspreizung bei Powerfail Bank 2" VALUE 0xa082ecb0 _REC_VAL_20_u2 131.07 _CNV_R_R_Def_spr_sw_561_CM 0. 6553.5 FORMAT "%5.2" /end CHARACTERISTIC
/begin CHARACTERISTIC K_ASP_ADPWF "Adaptionswert Anschlag Auslassspreizung bei Powerfail" VALUE 0xa082ecae _REC_VAL_20_u2 131.07 _CNV_R_R_Def_spr_sw_561_CM 0. 6553.5 FORMAT "%5.2" /end CHARACTERISTIC
/begin CHARACTERISTIC K_ASP_ADTV "Adaptionstastverhaeltnis Auslassspreizung variable NWS" VALUE 0xa082ec41 _REC_VAL_20_u1 99.45 _CNV_R_R_Def_dez_sl_551_CM 0. 255. FORMAT "%3.0" /end CHARACTERISTIC
/begin CHARACTERISTIC K_ASP_BA "Betriebsartenwahlschalter Auslassspreizung variable NWS" VALUE 0xa082ecaa _REC_VAL_20_u1 99.45 _CNV_R_R_Def_dez_sl_551_CM 0. 255. FORMAT "%3.0" /end CHARACTERISTIC
/begin CHARACTERISTIC K_ASP_TVHB "ausgegebenes Tastverhaeltnis bei Handbetrieb fuer Auslassspreizung variable NWS" VALUE 0xa082ec42 _REC_VAL_20_u1 99.45 _CNV_R_R_Def_dez_sl_551_CM 0. 255. FORMAT "%3.0" /end CHARACTERISTIC
/begin CHARACTERISTIC K_ASP_WNWS "Sollspreizung bei Handbetrieb fuer Auslassspreizung variable NWS" VALUE 0xa082ecac _REC_VAL_20_u2 131.07 _CNV_R_R_Def_spr_sw_561_CM 0. 6553.5 FORMAT "%5.2" /end CHARACTERISTIC
/begin CHARACTERISTIC K_AVZUNASPR "" VALUE 0xa08328a4 _REC_VAL_20_u2 131.07 _CNV_R_R_Def_spr_sw_561_CM 0. 6553.5 FORMAT "%5.2" /end CHARACTERISTIC
/begin CHARACTERISTIC K_BANK20MS_LS "Drehzahlschwelle bankselektive Berechnung im 20ms Raster" VALUE 0xa0831bcc _REC_VAL_20_s2 0. _CNV_R_R_Def_n_sw_q_595_CM -32768. 32767. FORMAT "%5.0" /end CHARACTERISTIC
/begin CHARACTERISTIC K_BANK20MS_LSHYS "Hysterese f. Drehzahlschwelle bankselektive Berechnung im 20ms Raster" VALUE 0xa0831bce _REC_VAL_20_s2 0. _CNV_R_R_Def_n_sw_q_595_CM -32768. 32767. FORMAT "%5.0" /end CHARACTERISTIC
/begin CHARACTERISTIC K_CW_CBS "Konfiguration CBS Teilnehmer" VALUE 0xa081b020 _REC_VAL_20_u4 0. _CNV_R_R_Def_dez_sl_551_CM 0. 4294967295. FORMAT "%7.0" /end CHARACTERISTIC
/begin CHARACTERISTIC K_CW_CBSOZ "Codeword OZ 1" VALUE 0xa081ac9c _REC_VAL_20_u2 0. _CNV_R_R_Def_dez_sl_551_CM 0. 65535. FORMAT "%5.0" /end CHARACTERISTIC
/begin CHARACTERISTIC K_DHUBDKNOTL "Rampensteigung Einlassventilhub zufahren bei DK-Notlauf" VALUE 0xa08328da _REC_VAL_20_s2 98.30400000000002 _CNV_R_R_Def_dhub10_760_CM -3276.8 0. /end CHARACTERISTIC
/begin CHARACTERISTIC K_DHUBMD "Rampensteigung Einlassventilhub zufahren" VALUE 0xa08328dc _REC_VAL_20_s2 98.30400000000002 _CNV_R_R_Def_dhub10_760_CM -3276.8 0. /end CHARACTERISTIC
/begin CHARACTERISTIC K_DHUBMX "Maximalwert Einlassventilhubrampe" VALUE 0xa08323ac _REC_VAL_20_u2 12. _CNV_R_R_Def_hub_uw_589_CM 0. 12. /end CHARACTERISTIC
/begin CHARACTERISTIC K_DHUBVH "Rampensteigung Einlassventilhub auffahren im Start" VALUE 0xa08328d4 _REC_VAL_20_s2 98.30099999999999 _CNV_R_R_Def_dhub10_760_CM 0. 3276.7 /end CHARACTERISTIC
/begin CHARACTERISTIC K_DHUBVHN1 "1. Rampensteigung Einlassventilhub auffahren bei B_gdvhub" VALUE 0xa08328d6 _REC_VAL_20_s2 98.30099999999999 _CNV_R_R_Def_dhub10_760_CM 0. 3276.7 /end CHARACTERISTIC
/begin CHARACTERISTIC K_DHUBVHN2 "2. Rampensteigung Einlassventilhub auffahren bei B_gdvhub" VALUE 0xa08328d8 _REC_VAL_20_s2 98.30099999999999 _CNV_R_R_Def_dhub10_760_CM 0. 3276.7 /end CHARACTERISTIC
/begin CHARACTERISTIC K_DNWE "-" VALUE 0xa08328c4 _REC_VAL_20_s2 0. _CNV_R_R_Def_n_sw_q_595_CM -32768. 10000. FORMAT "%5.0" /end CHARACTERISTIC
/begin CHARACTERISTIC K_DPLLMX "Maximales Druckverhaeltnis im LL gedrosselt" VALUE 0xa0831be0 _REC_VAL_20_u2 3.9999 _CNV_R_R_Def_f_sw_b_616_CM 0. 3.9999 FORMAT "%14.5" /end CHARACTERISTIC
/begin CHARACTERISTIC K_DPSGRENDK "Grenze fuer Teilgedrosseltbetrieb" VALUE 0xa0831f18 _REC_VAL_20_s2 102.398436 _CNV_R_R_Def_p_sw_q_576_CM -1280. 1279.9609 FORMAT "%5.2" /end CHARACTERISTIC
/begin CHARACTERISTIC K_DPSSOLAPPL "Vorgabe Dpssol als Applikationswert" VALUE 0xa0831bde _REC_VAL_20_s2 102.398436 _CNV_R_R_Def_p_sw_q_576_CM -1280. 1279.9609 FORMAT "%5.2" /end CHARACTERISTIC
/begin CHARACTERISTIC K_DPSSOL_MN "Minimal Dpssol" VALUE 0xa0831bdc _REC_VAL_20_s2 102.398436 _CNV_R_R_Def_p_sw_q_576_CM -1280. 1279.9609 FORMAT "%5.2" /end CHARACTERISTIC
/begin CHARACTERISTIC K_DPS_DTEV "-" VALUE 0xa0831be6 _REC_VAL_20_s2 102.398436 _CNV_R_R_Def_p_sw_q_576_CM -1280. 1279.9609 FORMAT "%5.2" /end CHARACTERISTIC
/begin CHARACTERISTIC K_DP_TE "min. Sollunterdruck im Saugrohr fuer TE" VALUE 0xa0831bd2 _REC_VAL_20_u2 102.398436 _CNV_R_R_Def_p_sw_q_576_CM 0. 2559.9609 FORMAT "%5.2" /end CHARACTERISTIC
/begin CHARACTERISTIC K_DRFVMXDKMN "" VALUE 0xa0831f1a _REC_VAL_20_s2 98.30250000000001 _CNV_R_R_Def_rf_sw__598_CM -327.68 327.67 FORMAT "%7.4" /end CHARACTERISTIC
/begin CHARACTERISTIC K_DSPRZG_AN "Offset Anschlagposition nach Kl15 aus" VAL_BLK 0xa0831b2c _REC_VAL_2_u2 131.07 _CNV_R_R_Def_spr_sw_561_CM 0. 6553.5 FORMAT "%5.2" NUMBER 4 /end CHARACTERISTIC
/begin CHARACTERISTIC K_DVNS_IREGOFF1 "Abstand zum Anschlag bei dem der I-Anteil nicht gerechnet wird" VAL_BLK 0xa082ec90 _REC_VAL_2_u2 131.07 _CNV_R_R_Def_spr_sw_561_CM 0. 6553.5 FORMAT "%5.2" NUMBER 4 /end CHARACTERISTIC
/begin CHARACTERISTIC K_DVNS_IREGOFF2 "Abstand zum Anschlag bei dem der I-Anteil nicht gerechnet wird" VAL_BLK 0xa082ec98 _REC_VAL_2_u2 131.07 _CNV_R_R_Def_spr_sw_561_CM 0. 6553.5 FORMAT "%5.2" NUMBER 4 /end CHARACTERISTIC
/begin CHARACTERISTIC K_ESP2_ADPWF "Adaptionswert Anschlag Einlassspreizung bei Powerfail Bank 2" VALUE 0xa082ec4c _REC_VAL_20_u2 131.07 _CNV_R_R_Def_spr_sw_561_CM 0. 6553.5 FORMAT "%5.2" /end CHARACTERISTIC
/begin CHARACTERISTIC K_ESP_ADPWF "Adaptionswert Anschlag Einlassspreizung bei Powerfail" VALUE 0xa082ec4a _REC_VAL_20_u2 131.07 _CNV_R_R_Def_spr_sw_561_CM 0. 6553.5 FORMAT "%5.2" /end CHARACTERISTIC
/begin CHARACTERISTIC K_ESP_ADTV "Adaptionstastverhaeltnis Einlassspreizung variable NWS" VALUE 0xa082ec3f _REC_VAL_20_u1 99.45 _CNV_R_R_Def_dez_sl_551_CM 0. 255. FORMAT "%3.0" /end CHARACTERISTIC
/begin CHARACTERISTIC K_ESP_BA "Betriebsartenwahlschalter Einlassspreizung variable NWS" VALUE 0xa082ec3e _REC_VAL_20_u1 99.45 _CNV_R_R_Def_dez_sl_551_CM 0. 255. FORMAT "%3.0" /end CHARACTERISTIC
/begin CHARACTERISTIC K_ESP_TVHB "ausgegebenes Tastverhaeltnis bei Handbetrieb fuer Einlassspreizung variable NWS" VALUE 0xa082ec40 _REC_VAL_20_u1 99.45 _CNV_R_R_Def_dez_sl_551_CM 0. 255. FORMAT "%3.0" /end CHARACTERISTIC
/begin CHARACTERISTIC K_ESP_WNWS "Sollspreizung bei Handbetrieb fuer Einlassspreizung variable NWS" VALUE 0xa082ec48 _REC_VAL_20_u2 131.07 _CNV_R_R_Def_spr_sw_561_CM 0. 6553.5 FORMAT "%5.2" /end CHARACTERISTIC
/begin CHARACTERISTIC K_EXWDIFLL_MN "Excenterwinkeldifferenz zur Aktivierung der Hubkorrektur" VALUE 0xa08328e4 _REC_VAL_20_s2 99. _CNV_R_R_Def_exwink_585_CM -720. 180. FORMAT "%5.2" /end CHARACTERISTIC
/begin CHARACTERISTIC K_EXWDIFLL_MX "Excenterwinkeldifferenz zur Aktivierung der Hubkorrektur" VALUE 0xa08328e6 _REC_VAL_20_s2 99. _CNV_R_R_Def_exwink_585_CM -720. 180. FORMAT "%5.2" /end CHARACTERISTIC
/begin CHARACTERISTIC K_EXWIST_DIF "Ist-Excenterwinkeländerungsschwelle zur Deaktivierung der Hubkorrektur" VALUE 0xa08328ee _REC_VAL_20_u2 100.8 _CNV_R_R_Def_exwink_585_CM 0. 180. FORMAT "%5.2" /end CHARACTERISTIC
/begin CHARACTERISTIC K_EXWKOR_MN "Minimaler Excenter-Korrekturwinkel" VALUE 0xa08328fe _REC_VAL_20_s2 99. _CNV_R_R_Def_exwink_585_CM -720. 180. FORMAT "%5.2" /end CHARACTERISTIC
/begin CHARACTERISTIC K_EXWKOR_MX "Maximaler Excenter-Korrekturwinkel" VALUE 0xa0832900 _REC_VAL_20_s2 99. _CNV_R_R_Def_exwink_585_CM -720. 180. FORMAT "%5.2" /end CHARACTERISTIC
/begin CHARACTERISTIC K_EXWSOLL_DIF "Soll-Excenterwinkeländerungsschwelle zur Deaktivierung der Lernadaption zur Hubkorrektur" VALUE 0xa08328f0 _REC_VAL_20_u2 100.8 _CNV_R_R_Def_exwink_585_CM 0. 180. FORMAT "%5.2" /end CHARACTERISTIC
/begin CHARACTERISTIC K_EXWTLHK_MX "Maximaler Excenterwinkel zur Aktivierung der Hubkorrektur" VALUE 0xa08328ec _REC_VAL_20_u2 100.8 _CNV_R_R_Def_exwink_585_CM 0. 180. FORMAT "%5.2" /end CHARACTERISTIC
/begin CHARACTERISTIC K_FEXWHKLL_DEK "Änderung des Faktor der Lernadaption bei zu grosser Hubverstellung" VALUE 0xa08328f6 _REC_VAL_20_u2 1.9999 _CNV_R_R_Def_f_uw_b_590_CM 0. 1.9999 FORMAT "%14.5" /end CHARACTERISTIC
/begin CHARACTERISTIC K_FEXWHKLL_INK "Änderung des Faktor der Lernadaption bei zu geringer Hubverstellung" VALUE 0xa08328f8 _REC_VAL_20_u2 1.9999 _CNV_R_R_Def_f_uw_b_590_CM 0. 1.9999 FORMAT "%14.5" /end CHARACTERISTIC
/begin CHARACTERISTIC K_FEXWKOR_MN "Minimaler Faktor der Lernadaption" VALUE 0xa08328fa _REC_VAL_20_u2 1.9999 _CNV_R_R_Def_f_uw_b_590_CM 0. 1.9999 FORMAT "%14.5" /end CHARACTERISTIC
/begin CHARACTERISTIC K_FEXWKOR_MX "Maximaler Faktor der Lernadaption" VALUE 0xa08328fc _REC_VAL_20_u2 1.9999 _CNV_R_R_Def_f_uw_b_590_CM 0. 1.9999 FORMAT "%14.5" /end CHARACTERISTIC
/begin CHARACTERISTIC K_FHUBVNSMN "Minimalwert Vanoskorrekturfaktor" VALUE 0xa08328b8 _REC_VAL_20_u2 1.9999 _CNV_R_R_Def_f_uw_b_590_CM 0. 1.9999 FORMAT "%14.5" /end CHARACTERISTIC
/begin CHARACTERISTIC K_FHUBVNSMX "Maximalwert Vanoskorrekturfaktor" VALUE 0xa08328ba _REC_VAL_20_u2 1.9999 _CNV_R_R_Def_f_uw_b_590_CM 0. 1.9999 FORMAT "%14.5" /end CHARACTERISTIC
/begin CHARACTERISTIC K_FHUBVNS_HD "" VALUE 0xa08328a0 _REC_VAL_20_u1 1. _CNV_R_R_Def_dez_sl_551_CM 0. 1. FORMAT "%3.0" /end CHARACTERISTIC
/begin CHARACTERISTIC K_FHUB_NMX "-" VALUE 0xa08328c6 _REC_VAL_20_s2 0. _CNV_R_R_Def_n_sw_q_595_CM -32768. 32767. FORMAT "%5.0" /end CHARACTERISTIC
/begin CHARACTERISTIC K_FHUB_VSAMN "" VALUE 0xa08328b0 _REC_VAL_20_u2 131.07 _CNV_R_R_Def_spr_sw_561_CM 0. 6553.5 FORMAT "%5.2" /end CHARACTERISTIC
/begin CHARACTERISTIC K_FHUB_VSAMX "" VALUE 0xa08328b2 _REC_VAL_20_u2 131.07 _CNV_R_R_Def_spr_sw_561_CM 0. 6553.5 FORMAT "%5.2" /end CHARACTERISTIC
/begin CHARACTERISTIC K_FHUB_VSEMN "" VALUE 0xa08328b4 _REC_VAL_20_u2 131.07 _CNV_R_R_Def_spr_sw_561_CM 0. 6553.5 FORMAT "%5.2" /end CHARACTERISTIC
/begin CHARACTERISTIC K_FHUB_VSEMX "" VALUE 0xa08328b6 _REC_VAL_20_u2 131.07 _CNV_R_R_Def_spr_sw_561_CM 0. 6553.5 FORMAT "%5.2" /end CHARACTERISTIC
/begin CHARACTERISTIC K_FPSSOLHUB_MN "" VALUE 0xa0831bd6 _REC_VAL_20_u2 0.9999 _CNV_R_R_Def_f_uw_b_571_CM 0. 0.9999 FORMAT "%14.5" /end CHARACTERISTIC
/begin CHARACTERISTIC K_FPWM_ANS "Ansteuerfrequenz VNS-Magnetventil im Endanschlag" VALUE 0xa082ec3d _REC_VAL_20_u1 100.45 _CNV_R_R_Def_freq_u_728_CM 10. 255. FORMAT "%3.0" /end CHARACTERISTIC
/begin CHARACTERISTIC K_FPWM_STAND "Ansteuerfrequenz VNS-Magnetventil bei stehendem Motor" VALUE 0xa082ec3c _REC_VAL_20_u1 100.45 _CNV_R_R_Def_freq_u_728_CM 10. 255. FORMAT "%3.0" /end CHARACTERISTIC
/begin CHARACTERISTIC K_FSP_ERRMASK "Fehlermaske ed_report()" VALUE 0xa0818e72 _REC_VAL_20_u1 99.45 _CNV_R_R_Def_dez_sl_551_CM 0. 255. FORMAT "%3.0" /end CHARACTERISTIC
/begin CHARACTERISTIC K_FSP_ORT "Fehlerort Test FSP-Schnittstelle" VALUE 0xa0818e74 _REC_VAL_20_u2 0. _CNV_R_R_Def_dez_sl_551_CM 0. 65535. FORMAT "%5.0" /end CHARACTERISTIC
/begin CHARACTERISTIC K_HUBAPP "Applikationswert Einlassventilhub" VALUE 0xa08328be _REC_VAL_20_u2 12. _CNV_R_R_Def_hub_uw_589_CM 0. 12. /end CHARACTERISTIC
/begin CHARACTERISTIC K_HUBSGNL "Sollwert Einlassventilhub fuer Beginn Steuergeraetenachlauf" VALUE 0xa08328c2 _REC_VAL_20_u2 12. _CNV_R_R_Def_hub_uw_589_CM 0. 12. /end CHARACTERISTIC
/begin CHARACTERISTIC K_HUBV_NOTL "" VALUE 0xa08328c0 _REC_VAL_20_u2 12. _CNV_R_R_Def_hub_uw_589_CM 0. 12. /end CHARACTERISTIC
/begin CHARACTERISTIC K_IVVTHKLL_MX "Stromschwelle zur Deaktivierung der Hubkorrektur" VALUE 0xa08328e8 _REC_VAL_20_s2 81.91875 _CNV_R_R_Def_i_sw_q_764_CM -2048. 2047.9375 /end CHARACTERISTIC
/begin CHARACTERISTIC K_MAT_DKVL "Zuordnung VL-Wdk abhängig von Ba_ist" VAL_BLK 0xa0831f08 _REC_VAL_2_u1 1. _CNV_R_R_Def_dez_sl_551_CM 0. 1. FORMAT "%3.0" NUMBER 8 /end CHARACTERISTIC
/begin CHARACTERISTIC K_MAT_DPS "Zuordnung Eingang Ba-Umschaltung zu Betriebsart" VAL_BLK 0xa0831bb8 _REC_VAL_2_u1 99.45 _CNV_R_R_Def_dez_sl_551_CM 0. 255. FORMAT "%3.0" NUMBER 8 /end CHARACTERISTIC
/begin CHARACTERISTIC K_MAT_DPSFAK "Zuordnung Eingang Ba-Umschaltung zu Betriebsart" VAL_BLK 0xa0831bc0 _REC_VAL_2_u1 99.45 _CNV_R_R_Def_dez_sl_551_CM 0. 255. FORMAT "%3.0" NUMBER 8 /end CHARACTERISTIC
/begin CHARACTERISTIC K_MAT_RFVVNS "Zuordnung Eingang Ba-Umschaltung zu Betriebsart" VAL_BLK 0xa0831bb0 _REC_VAL_2_u1 99.45 _CNV_R_R_Def_dez_sl_551_CM 0. 255. FORMAT "%3.0" NUMBER 8 /end CHARACTERISTIC
/begin CHARACTERISTIC K_MAX_PSSOLBER "" VALUE 0xa0831be8 _REC_VAL_20_s2 102.398436 _CNV_R_R_Def_p_sw_q_576_CM -1280. 1279.9609 FORMAT "%5.2" /end CHARACTERISTIC
/begin CHARACTERISTIC K_NKWHKLL_MN "Drehzahlschwelle zur Deaktivierung der Hubkorrektur" VALUE 0xa08328e2 _REC_VAL_20_s2 0. _CNV_R_R_Def_n_sw_q_595_CM -32768. 32767. FORMAT "%5.0" /end CHARACTERISTIC
/begin CHARACTERISTIC K_NKWHKLL_MX "Drehzahlschwelle zur Deaktivierung der Hubkorrektur" VALUE 0xa08328e0 _REC_VAL_20_s2 0. _CNV_R_R_Def_n_sw_q_595_CM -32768. 32767. FORMAT "%5.0" /end CHARACTERISTIC
/begin CHARACTERISTIC K_NMOTVNSAD "Drehrahl, unterhalb der die Adaption verboten ist" VALUE 0xa082ec64 _REC_VAL_20_s2 0. _CNV_R_R_Def_n_sw_q_595_CM 0. 32767. FORMAT "%5.0" /end CHARACTERISTIC
/begin CHARACTERISTIC K_NVNSAN "Drehzahlschwelle Anschlagserkennung" VALUE 0xa0831b34 _REC_VAL_20_s2 0. _CNV_R_R_Def_n_sw_q_595_CM -32768. 32767. FORMAT "%5.0" /end CHARACTERISTIC
/begin CHARACTERISTIC K_NWA2FLANKE "Individuelle Flankenkorrektur Auslass Bank2" VAL_BLK 0xa0831b94 _REC_VAL_2_u2 131.07 _CNV_R_R_Def_spr_sw_561_CM 0. 6553.5 FORMAT "%5.2" NUMBER 4 /end CHARACTERISTIC
/begin CHARACTERISTIC K_NWADPOTO_DMX "Delta auf Anschlagsadaption für One-Tooth-Off Erkennung" VAL_BLK 0xa0831b24 _REC_VAL_2_u2 131.07 _CNV_R_R_Def_spr_sw_561_CM 0. 6553.5 FORMAT "%5.2" NUMBER 4 /end CHARACTERISTIC
/begin CHARACTERISTIC K_NWADP_MN "Minimalwert Anschlagadaption" VAL_BLK 0xa0831b14 _REC_VAL_2_u2 131.07 _CNV_R_R_Def_spr_sw_561_CM 0. 6553.5 FORMAT "%5.2" NUMBER 4 /end CHARACTERISTIC
/begin CHARACTERISTIC K_NWADP_MX "Maximalwert Anschlagadaption" VAL_BLK 0xa0831b1c _REC_VAL_2_u2 131.07 _CNV_R_R_Def_spr_sw_561_CM 0. 6553.5 FORMAT "%5.2" NUMBER 4 /end CHARACTERISTIC
/begin CHARACTERISTIC K_NWAFLANKE "Individuelle Flankenkorrektur Auslass Bank1" VAL_BLK 0xa0831b8c _REC_VAL_2_u2 131.07 _CNV_R_R_Def_spr_sw_561_CM 0. 6553.5 FORMAT "%5.2" NUMBER 4 /end CHARACTERISTIC
/begin CHARACTERISTIC K_NWE2FLANKE "Individuelle Flankenkorrektur Einlass Bank2" VAL_BLK 0xa0831b84 _REC_VAL_2_u2 131.07 _CNV_R_R_Def_spr_sw_561_CM 0. 6553.5 FORMAT "%5.2" NUMBER 4 /end CHARACTERISTIC
/begin CHARACTERISTIC K_NWEFLANKE "Individuelle Flankenkorrektur Einlass Bank1" VAL_BLK 0xa0831b7c _REC_VAL_2_u2 131.07 _CNV_R_R_Def_spr_sw_561_CM 0. 6553.5 FORMAT "%5.2" NUMBER 4 /end CHARACTERISTIC
/begin CHARACTERISTIC K_NWSEGOFFS "Vanos Segmentoffset zur Flankenidentifikation" VAL_BLK 0xa0831b74 _REC_VAL_2_u2 131.07 _CNV_R_R_Def_spr_sw_561_CM 0. 6553.5 FORMAT "%5.2" NUMBER 4 /end CHARACTERISTIC
/begin CHARACTERISTIC K_NW_MIN "minimale Nockenwellenposition Rohwert" VAL_BLK 0xa0831b9c _REC_VAL_2_u2 131.07 _CNV_R_R_Def_spr_sw_561_CM 0. 6553.5 FORMAT "%5.2" NUMBER 4 /end CHARACTERISTIC
/begin CHARACTERISTIC K_OELREST "Faktor für Restrusssumme im Öl nach Ölwechsel" VALUE 0xa081acc2 _REC_VAL_20_u1 0.8 _CNV_R_R_Def_lf_ub__670_CM 0. 0.8 FORMAT "%5.2" /end CHARACTERISTIC
/begin CHARACTERISTIC K_OFFHUB_VNSAN "Offset auf Starthub wenn EVANOS nicht im Anschlag" VALUE 0xa08328bc _REC_VAL_20_u2 12. _CNV_R_R_Def_hub_uw_589_CM 0. 12. /end CHARACTERISTIC
/begin CHARACTERISTIC K_OZANFANZ "BOS-Startanzeigewert Restlaufstrecke" VALUE 0xa081acb4 _REC_VAL_20_u2 0. _CNV_R_R_Def_km_sw__68_CM 0. 655350. FORMAT "%5.0" /end CHARACTERISTIC
/begin CHARACTERISTIC K_OZBZKMSTK1 "Bezugsintervall" VALUE 0xa081b01e _REC_VAL_20_u1 0. _CNV_R_R_Def_km_ub__428_CM 0. 255000. FORMAT "%3.0" /end CHARACTERISTIC
/begin CHARACTERISTIC K_OZDAEMPF "Dänmpfung für die Mittelwert Kraftstoffverbrauch-Berechnung" VALUE 0xa081acc3 _REC_VAL_20_u1 0.249 _CNV_R_R_Def_f_ub_b_765_CM 0. 0.249 FORMAT "%7.4" /end CHARACTERISTIC
/begin CHARACTERISTIC K_OZKMMAXK11 "Maximalintervall" VALUE 0xa081acb6 _REC_VAL_20_u2 0. _CNV_R_R_Def_km_sw__68_CM 0. 655350. FORMAT "%5.0" /end CHARACTERISTIC
/begin CHARACTERISTIC K_OZKMUPL "Für die Kontrolle der Km_st-Plausibilität" VALUE 0xa081b01c _REC_VAL_20_u2 0. _CNV_R_R_Def_km_sw__68_CM 0. 655350. FORMAT "%5.0" /end CHARACTERISTIC
/begin CHARACTERISTIC K_OZKVB96 "Typprüfkraftstoffverbrauch" VALUE 0xa081acc4 _REC_VAL_20_u1 31.875 _CNV_R_R_Def_f_ub_b_612_CM 0. 31.875 FORMAT "%5.2" /end CHARACTERISTIC
/begin CHARACTERISTIC K_OZKVB96A "Typprüfkraftstoffverbrauch Automatikgetriebe" VALUE 0xa081acc5 _REC_VAL_20_u1 31.875 _CNV_R_R_Def_f_ub_b_612_CM 0. 31.875 FORMAT "%5.2" /end CHARACTERISTIC
/begin CHARACTERISTIC K_OZKVBMXK18 "maximal zulässige Gesamtkraftstoffbonusmenge" VALUE 0xa081acb8 _REC_VAL_20_u2 0. _CNV_R_R_Def_dez_sl_551_CM 0. 65535. FORMAT "%5.0" /end CHARACTERISTIC
/begin CHARACTERISTIC K_OZKVBOK16 "Kraftstoffbonusmenge in [l] je 0,5l Ölnachfüllung" VALUE 0xa081acba _REC_VAL_20_u2 0. _CNV_R_R_Def_dez_sl_551_CM 0. 65535. FORMAT "%5.0" /end CHARACTERISTIC
/begin CHARACTERISTIC K_OZLF1 "Länderfaktor 1 Festwert" VALUE 0xa081acc6 _REC_VAL_20_u1 2.55 _CNV_R_R_Def_lf_ub__670_CM 0. 2.55 FORMAT "%5.2" /end CHARACTERISTIC
/begin CHARACTERISTIC K_OZLF2 "Länderfaktor 2 Festwert" VALUE 0xa081acc7 _REC_VAL_20_u1 2.55 _CNV_R_R_Def_lf_ub__670_CM 0. 2.55 FORMAT "%5.2" /end CHARACTERISTIC
/begin CHARACTERISTIC K_OZMAXBS "Max Betriebstunden für das Ölwechsel" VALUE 0xa081acc8 _REC_VAL_20_u1 102. _CNV_R_R_Def_th_ub__766_CM 0. 2550. FORMAT "%3.0" /end CHARACTERISTIC
/begin CHARACTERISTIC K_OZMNKMBO "Wegstrecke ab der eine Bonuszuteilung erfolgt" VALUE 0xa081acbc _REC_VAL_20_u2 0. _CNV_R_R_Def_km_sw__68_CM 0. 655350. FORMAT "%5.0" /end CHARACTERISTIC
/begin CHARACTERISTIC K_OZMXOHK15 "Max Tage für den Ölservice" VALUE 0xa081acbe _REC_VAL_20_u2 99.90000000000001 _CNV_R_R_Def_dez_sl_551_CM 1. 1000. FORMAT "%5.0" /end CHARACTERISTIC
/begin CHARACTERISTIC K_OZOELMEN "Ölmenge für den Dieseleintrag" VALUE 0xa081acc9 _REC_VAL_20_u1 25.5 _CNV_R_R_Def_niv_ub_671_CM 0. 25.5 FORMAT "%5.2" /end CHARACTERISTIC
/begin CHARACTERISTIC K_OZRUSSMX "max Russsumme im Öl" VALUE 0xa081acae _REC_VAL_20_u4 0. _CNV_R_R_Def_dez_sl_551_CM 1. 9000000. FORMAT "%7.0" /end CHARACTERISTIC
/begin CHARACTERISTIC K_OZTAGCTERR "Wert für unplausibel Tagezähler" VALUE 0xa081acc0 _REC_VAL_20_u2 0. _CNV_R_R_Def_dez_sl_551_CM 0. 65535. FORMAT "%5.0" /end CHARACTERISTIC
/begin CHARACTERISTIC K_OZUEBERTEMP "Schwelle für die Ölsübertemperatur-Kontrolle" VALUE 0xa081acb2 _REC_VAL_20_s2 131.07 _CNV_R_R_Def_t_sw_q_578_CM -3276.8 3276.7 FORMAT "%4.1" /end CHARACTERISTIC
/begin CHARACTERISTIC K_OZUTFAK "Faktor für den Kraftstoffverbrauch bei Übertemperatur" VALUE 0xa081acca _REC_VAL_20_u1 99.45 _CNV_R_R_Def_dez_sl_551_CM 0. 255. FORMAT "%3.0" /end CHARACTERISTIC
/begin CHARACTERISTIC K_OZZEITFAKT "Bereich der gesamten Laufstrecke wo die Berechnung des Zeit-RW Beainfluss hat" VALUE 0xa081ac9e _REC_VAL_20_u1 0.996 _CNV_R_R_Def_f_ub_b_553_CM 0. 0.996 /end CHARACTERISTIC
/begin CHARACTERISTIC K_OZZEITINT "Zeitintervall für Ölwechsel in Monate (CBS4)" VALUE 0xa081accb _REC_VAL_20_u1 99.06 _CNV_R_R_Def_dez_sl_551_CM 1. 255. FORMAT "%3.0" /end CHARACTERISTIC
/begin CHARACTERISTIC K_OZZYKCBS "Zeitabstand fürs zyklisch Senden der CBS-Nachricht" VALUE 0xa081b024 _REC_VAL_20_u1 99.45 _CNV_R_R_Def_dez_sl_551_CM 0. 255. FORMAT "%3.0" /end CHARACTERISTIC
/begin CHARACTERISTIC K_PAKPSNL_MIN "" VALUE 0xa0831bda _REC_VAL_20_u2 0.9999 _CNV_R_R_Def_f_uw_b_571_CM 0. 0.9999 FORMAT "%14.5" /end CHARACTERISTIC
/begin CHARACTERISTIC K_PLD_SOLL "Soll-Ladedruck manuell" VALUE 0xa0833508 _REC_VAL_20_u2 102.398436 _CNV_R_R_Def_p_sw_q_576_CM 0. 2559.9609 FORMAT "%5.2" /end CHARACTERISTIC
/begin CHARACTERISTIC K_PSPVDK_SOLMAX "Maxwert Pspvdk_soll" VALUE 0xa0831ba4 _REC_VAL_20_u2 3.9999 _CNV_R_R_Def_f_sw_b_616_CM 0. 3.9999 FORMAT "%14.5" /end CHARACTERISTIC
/begin CHARACTERISTIC K_PSPVDK_SOLMAXGD "Maxwert Pspvdk_soll gedrosselt" VALUE 0xa0831ba8 _REC_VAL_20_u2 3.9999 _CNV_R_R_Def_f_sw_b_616_CM 0. 3.9999 FORMAT "%14.5" /end CHARACTERISTIC
/begin CHARACTERISTIC K_PSPVDK_SOLMAXUG "Maxwert Pspvdk_soll ungedrosselt" VALUE 0xa0831ba6 _REC_VAL_20_u2 3.9999 _CNV_R_R_Def_f_sw_b_616_CM 0. 3.9999 FORMAT "%14.5" /end CHARACTERISTIC
/begin CHARACTERISTIC K_PSPVDK_SOLMIN "Maxwert Pspvdk_soll" VALUE 0xa0831be4 _REC_VAL_20_u2 3.9999 _CNV_R_R_Def_f_sw_b_616_CM 0. 3.9999 FORMAT "%14.5" /end CHARACTERISTIC
/begin CHARACTERISTIC K_PVDKDS_PSMX "Korrekturfaktor max. zul. Saugrohrdruck" VALUE 0xa0831bd0 _REC_VAL_20_u2 1.9999 _CNV_R_R_Def_f_uw_b_590_CM 0. 1.9999 FORMAT "%14.5" /end CHARACTERISTIC
/begin CHARACTERISTIC K_PVDKPNRFV_MX "" VALUE 0xa0831bd8 _REC_VAL_20_u2 3.9999 _CNV_R_R_Def_f_sw_b_616_CM 0. 3.9999 FORMAT "%14.5" /end CHARACTERISTIC
/begin CHARACTERISTIC K_RXWP_SLOW "zusätzlicher P-Anteil bei lang anhaltender Regelabweichung" VALUE 0xa082eca4 _REC_VAL_20_u2 3.9999 _CNV_R_R_Def_f_sw_b_616_CM 0. 3.9999 FORMAT "%14.5" /end CHARACTERISTIC
/begin CHARACTERISTIC K_SPRZG_AN "Position der Anschlagspreizung" VAL_BLK 0xa0831b60 _REC_VAL_2_u2 131.07 _CNV_R_R_Def_spr_sw_561_CM 0. 6553.5 FORMAT "%5.2" NUMBER 4 /end CHARACTERISTIC
/begin CHARACTERISTIC K_SPRZG_VB "Verstellbereich Vanos" VAL_BLK 0xa082ec24 _REC_VAL_2_u2 131.07 _CNV_R_R_Def_spr_sw_561_CM 0. 6553.5 FORMAT "%5.2" NUMBER 4 /end CHARACTERISTIC
/begin CHARACTERISTIC K_TDHKNACHL "Dauer für Hubkorrektur im Nachlauf aktiv" VALUE 0xa08328ce _REC_VAL_20_u2 98.30250000000001 _CNV_R_R_Def_td_uw__673_CM 0. 655.35 FORMAT "%5.2" /end CHARACTERISTIC
/begin CHARACTERISTIC K_TDHUBVHN1 "Dauer 1. Einlassventilhubrampe" VALUE 0xa08328c8 _REC_VAL_20_u2 98.30250000000001 _CNV_R_R_Def_td_uw__673_CM 0. 655.35 FORMAT "%5.2" /end CHARACTERISTIC
/begin CHARACTERISTIC K_TD_SPRON "" VALUE 0xa08328cc _REC_VAL_20_u2 98.30250000000001 _CNV_R_R_Def_td_uw__673_CM 0. 655.35 FORMAT "%5.2" /end CHARACTERISTIC
/begin CHARACTERISTIC K_TD_SPRONMX "" VALUE 0xa08328ca _REC_VAL_20_u2 98.30250000000001 _CNV_R_R_Def_td_uw__673_CM 0. 655.35 FORMAT "%5.2" /end CHARACTERISTIC
/begin CHARACTERISTIC K_TEXWMX "Dauer für Einfrieren der drehzahlabhängigen Excenterwinkelbegrenzung (Schleppzeiger)" VALUE 0xa08328d0 _REC_VAL_20_u2 0. _CNV_R_R_Def_td_ub__710_CM 0. 327675. FORMAT "%4.1" /end CHARACTERISTIC
/begin CHARACTERISTIC K_TFWDKSOM "Filterkonstant fuer Drosselklappesollwert KL15 Aus" VALUE 0xa0831f14 _REC_VAL_20_u2 655.35 _CNV_R_R_Def_zk10ms_715_CM 1.e-002 655.36 FORMAT "%7.4" /end CHARACTERISTIC
/begin CHARACTERISTIC K_THKLL_MX "Dauer, die eine Hubkorrektur kontinuierlich angefordert sein muss, um ausgeführt zu werden" VALUE 0xa08328f2 _REC_VAL_20_u2 0. _CNV_R_R_Def_td_ub__710_CM 0. 327675. FORMAT "%4.1" /end CHARACTERISTIC
/begin CHARACTERISTIC K_THKLL_VZ "Wartezeit nach freigegebener Hubkorrektur, um die Verstellung zu erkennen" VALUE 0xa08328f4 _REC_VAL_20_u2 0. _CNV_R_R_Def_td_ub__710_CM 0. 327675. FORMAT "%4.1" /end CHARACTERISTIC
/begin CHARACTERISTIC K_TMOTHKLL_MN "Temperaturschwelle zur Deaktivierung der Hubkorrektur" VALUE 0xa08328ea _REC_VAL_20_s2 98.30250000000001 _CNV_R_R_Def_t_sw_q_579_CM -327.68 327.67 FORMAT "%5.2" /end CHARACTERISTIC
/begin CHARACTERISTIC K_TMSTHUBSTM "Temperaturschwelle Hub im Start Tmot_start abhängig" VALUE 0xa08328de _REC_VAL_20_s2 98.30250000000001 _CNV_R_R_Def_t_sw_q_579_CM -327.68 327.67 FORMAT "%5.2" /end CHARACTERISTIC
/begin CHARACTERISTIC K_TVNSAN "" VALUE 0xa0831b36 _REC_VAL_20_u2 98.30250000000001 _CNV_R_R_Def_td_uw__673_CM 0. 655.35 FORMAT "%5.2" /end CHARACTERISTIC
/begin CHARACTERISTIC K_TVPSLOW_ERRCNT "Schwelle Fehlerzähler zur Aktivierung zusätzlicher P-Anteil" VAL_BLK 0xa082ec30 _REC_VAL_2_u1 99.45 _CNV_R_R_Def_dez_sl_551_CM 0. 255. FORMAT "%3.0" NUMBER 4 /end CHARACTERISTIC
/begin CHARACTERISTIC K_TVPSLOW_TMOT "Tmot-Schwelle zur Aktivierung zusätzlicher P-Anteil" VALUE 0xa082eca2 _REC_VAL_20_s2 98.30250000000001 _CNV_R_R_Def_t_sw_q_579_CM -327.68 327.67 FORMAT "%5.2" /end CHARACTERISTIC
/begin CHARACTERISTIC K_TVP_ANZMX "Zählerschwelle zur Deaktivierung TV-Puls" VAL_BLK 0xa082ec38 _REC_VAL_2_u1 99.45 _CNV_R_R_Def_dez_sl_551_CM 0. 255. FORMAT "%3.0" NUMBER 4 /end CHARACTERISTIC
/begin CHARACTERISTIC K_TVP_ERRCNT "Schwelle Fehlerzähler zur Aktivierung TV-Puls" VAL_BLK 0xa082ec2c _REC_VAL_2_u1 99.45 _CNV_R_R_Def_dez_sl_551_CM 0. 255. FORMAT "%3.0" NUMBER 4 /end CHARACTERISTIC
/begin CHARACTERISTIC K_TVP_SPERR "Sperrzeit zur wiederholten Aktivierung TV-Puls" VALUE 0xa082eca6 _REC_VAL_20_u2 98.30250000000001 _CNV_R_R_Def_td_uw__673_CM 0. 655.35 FORMAT "%5.2" /end CHARACTERISTIC
/begin CHARACTERISTIC K_TVP_TMOT "Tmot-Schwelle zur Aktivierung TV-Puls" VALUE 0xa082eca0 _REC_VAL_20_s2 98.30250000000001 _CNV_R_R_Def_t_sw_q_579_CM -327.68 327.67 FORMAT "%5.2" /end CHARACTERISTIC
/begin CHARACTERISTIC K_TVP_TMX "Maximale Länge TV-Puls" VALUE 0xa082eca8 _REC_VAL_20_u2 0. _CNV_R_R_Def_dez_sl_551_CM 0. 65535. FORMAT "%5.0" /end CHARACTERISTIC
/begin CHARACTERISTIC K_TVVTCLOSE "Zeitdauer fuer Hub herunterfahren" VALUE 0xa08328d2 _REC_VAL_20_u2 98.30250000000001 _CNV_R_R_Def_td_uw__673_CM 0. 655.35 FORMAT "%5.2" /end CHARACTERISTIC
/begin CHARACTERISTIC K_TVWDKS "Verzörgerungszeit Drosseklappesollwert" VALUE 0xa0831f16 _REC_VAL_20_u2 5.e-002 _CNV_R_R_Def_td_uw__673_CM 0. 5.e-002 FORMAT "%5.2" /end CHARACTERISTIC
/begin CHARACTERISTIC K_TWDKVST "Filterkonstant fuer Drosselklappesollwert waehrend Start" VALUE 0xa0831f12 _REC_VAL_20_u2 655.35 _CNV_R_R_Def_zk10ms_715_CM 1.e-002 655.36 FORMAT "%7.4" /end CHARACTERISTIC
/begin CHARACTERISTIC K_VNSADPEXT_OFF "Offset auf Anschlagsadaption von extern" VAL_BLK 0xa0831b68 _REC_VAL_2_s2 131.07 _CNV_R_R_Def_spr_sw_561_CM -3276.8 3276.7 FORMAT "%5.2" NUMBER 4 /end CHARACTERISTIC
/begin CHARACTERISTIC K_VNSKRITLOC "Fangbereich des Verriegelungspins" VALUE 0xa082ec44 _REC_VAL_20_u1 25.5 _CNV_R_R_Def_spr_sw_561_CM 0. 25.5 FORMAT "%5.2" /end CHARACTERISTIC
/begin CHARACTERISTIC K_VNSNMOTAN "Drehzahl, unterhalb der die Einheiten Verriegeln koennen (Fliehkraefte zu klein)" VALUE 0xa082ec66 _REC_VAL_20_s2 0. _CNV_R_R_Def_n_sw_q_595_CM -32768. 32767. FORMAT "%5.0" /end CHARACTERISTIC
/begin CHARACTERISTIC K_VNSRTVIMN "" VAL_BLK 0xa082ec74 _REC_VAL_2_u2 99.99844999999999 _CNV_R_R_Def_rel_uw_729_CM -100. 99.9969 NUMBER 4 /end CHARACTERISTIC
/begin CHARACTERISTIC K_VNSRTVIMX1 "" VAL_BLK 0xa082ec7c _REC_VAL_2_u2 99.99844999999999 _CNV_R_R_Def_rel_uw_729_CM -100. 99.9969 NUMBER 4 /end CHARACTERISTIC
/begin CHARACTERISTIC K_VNSRTVIMX2 "" VAL_BLK 0xa082ec84 _REC_VAL_2_u2 99.99844999999999 _CNV_R_R_Def_rel_uw_729_CM -100. 99.9969 NUMBER 4 /end CHARACTERISTIC
/begin CHARACTERISTIC K_VNSRTVMN "Reglerbegrenzung Tastverhaeltnis min" VAL_BLK 0xa082ec50 _REC_VAL_2_s2 99.99844999999999 _CNV_R_R_Def_rel_sw_778_CM -100. 99.9969 NUMBER 4 /end CHARACTERISTIC
/begin CHARACTERISTIC K_VNSRTVMX "Reglerbegrenzung Tastverhaeltnis max" VAL_BLK 0xa082ec58 _REC_VAL_2_s2 99.99844999999999 _CNV_R_R_Def_rel_sw_778_CM -100. 99.9969 NUMBER 4 /end CHARACTERISTIC
/begin CHARACTERISTIC K_VNSTVIABDY "Ablschlag vom I-Regleranteil fuer adapt. Druckvorsteuerung" VALUE 0xa082ec6c _REC_VAL_20_u2 99.99844999999999 _CNV_R_R_Def_rel_uw_729_CM -100. 99.9969 /end CHARACTERISTIC
/begin CHARACTERISTIC K_VNS_ADEND "Zeit, in der die Adaption abgeschlossen sein sollte" VALUE 0xa082ec62 _REC_VAL_20_u2 98.30250000000001 _CNV_R_R_Def_td_uw__673_CM 0. 655.35 FORMAT "%5.2" /end CHARACTERISTIC
/begin CHARACTERISTIC K_VNS_ADT "Zeit, bei der die NWn sicher mit ad_tv den Anschlag erreichen" VALUE 0xa082ec60 _REC_VAL_20_u2 98.30250000000001 _CNV_R_R_Def_td_uw__673_CM 0. 655.35 FORMAT "%5.2" /end CHARACTERISTIC
/begin CHARACTERISTIC K_VNS_ANAB "Abstand vom Anschlag" VALUE 0xa082ec43 _REC_VAL_20_u1 25.5 _CNV_R_R_Def_spr_sw_561_CM 0. 25.5 FORMAT "%5.2" /end CHARACTERISTIC
/begin CHARACTERISTIC K_VNS_DELTMX "maximale Regelabweichung" VAL_BLK 0xa0831b0c _REC_VAL_2_u2 131.07 _CNV_R_R_Def_spr_sw_561_CM 0. 6553.5 FORMAT "%5.2" NUMBER 4 /end CHARACTERISTIC
/begin CHARACTERISTIC K_VNS_DELTMX_IREG "Maximal zulässige Regelabweichung für Abschaltung I-Anteil in Anschlagsnähe" VALUE 0xa082ec8c _REC_VAL_20_u2 131.07 _CNV_R_R_Def_spr_uw_733_CM -3276.8 3276.7 FORMAT "%5.2" /end CHARACTERISTIC
/begin CHARACTERISTIC K_VNS_DYN "Aenderungsbegrenzung des TV (Druckanstiegsgeschwindigkeitsbegrenzung)" VALUE 0xa082ec6e _REC_VAL_20_u2 98.30250000000001 _CNV_R_R_Def_rf_sw__598_CM 0. 655.35 FORMAT "%5.2" /end CHARACTERISTIC
/begin CHARACTERISTIC K_VNS_ERRCNT "Fehlerschwelle Istposition ausserhalb" VALUE 0xa0831b05 _REC_VAL_20_u1 99.45 _CNV_R_R_Def_dez_sl_551_CM 0. 255. FORMAT "%3.0" /end CHARACTERISTIC
/begin CHARACTERISTIC K_VNS_ERRCNT1 "Erweiterte Fehlerschwelle Istposition ausserhalb" VALUE 0xa0831b06 _REC_VAL_20_u1 99.45 _CNV_R_R_Def_dez_sl_551_CM 0. 255. FORMAT "%3.0" /end CHARACTERISTIC
/begin CHARACTERISTIC K_VNS_ERR_NKW "Drehzahlschwelle erweiterte Fehlerschwelle" VALUE 0xa0831b3c _REC_VAL_20_s2 0. _CNV_R_R_Def_n_sw_q_595_CM -32768. 32767. FORMAT "%5.0" /end CHARACTERISTIC
/begin CHARACTERISTIC K_VNS_ERR_TMOT "Tmotschwelle erweiterte Fehlerschwelle" VALUE 0xa0831b3e _REC_VAL_20_s2 98.30250000000001 _CNV_R_R_Def_t_sw_q_579_CM -327.68 327.67 FORMAT "%5.2" /end CHARACTERISTIC
/begin CHARACTERISTIC K_VNS_NMVSTOP "Drehzahl, unterhalb der bei Kl15 aus Magnetventil des Einlaß mit max. TV angesteuert wird" VALUE 0xa082ec68 _REC_VAL_20_s2 0. _CNV_R_R_Def_n_sw_q_595_CM -32768. 32767. FORMAT "%5.0" /end CHARACTERISTIC
/begin CHARACTERISTIC K_VNS_TMN "minimale Temperaturschwelle für Diagnose VANOS" VALUE 0xa0831b08 _REC_VAL_20_s2 98.30250000000001 _CNV_R_R_Def_t_sw_q_579_CM -327.68 327.67 FORMAT "%5.2" /end CHARACTERISTIC
/begin CHARACTERISTIC K_VNS_TMVSTOP "Zeit, für die bei Kl15 aus Magnetventil des Einlaß mit max. TV angesteuert wird" VALUE 0xa082ec6a _REC_VAL_20_u2 98.30250000000001 _CNV_R_R_Def_td_uw__673_CM 0. 655.35 FORMAT "%5.2" /end CHARACTERISTIC
/begin CHARACTERISTIC K_VNS_TMX "maximale Temperaturschwelle für Diagnose VANOS" VALUE 0xa0831b0a _REC_VAL_20_s2 98.30250000000001 _CNV_R_R_Def_t_sw_q_579_CM -327.68 327.67 FORMAT "%5.2" /end CHARACTERISTIC
/begin CHARACTERISTIC K_VNS_TPOEL "" VALUE 0xa0831b38 _REC_VAL_20_u2 98.30250000000001 _CNV_R_R_Def_td_uw__673_CM 0. 655.35 FORMAT "%5.2" /end CHARACTERISTIC
/begin CHARACTERISTIC K_VNS_TPOEL2 "" VALUE 0xa0831b3a _REC_VAL_20_u2 98.30250000000001 _CNV_R_R_Def_td_uw__673_CM 0. 655.35 FORMAT "%5.2" /end CHARACTERISTIC
/begin CHARACTERISTIC K_VNS_TVINKW "" VALUE 0xa082ec72 _REC_VAL_20_s2 0. _CNV_R_R_Def_n_sw_q_595_CM -32768. 32767. FORMAT "%5.0" /end CHARACTERISTIC
/begin CHARACTERISTIC K_VNS_TVITMOT "" VALUE 0xa082ec70 _REC_VAL_20_s2 98.30250000000001 _CNV_R_R_Def_t_sw_q_579_CM -327.68 327.67 FORMAT "%5.2" /end CHARACTERISTIC
/begin CHARACTERISTIC K_VSASPRON_DIFF "" VALUE 0xa08328aa _REC_VAL_20_u2 131.07 _CNV_R_R_Def_spr_sw_561_CM 0. 6553.5 FORMAT "%5.2" /end CHARACTERISTIC
/begin CHARACTERISTIC K_VSASPRON_MOV "" VALUE 0xa08328ae _REC_VAL_20_u2 131.07 _CNV_R_R_Def_spr_sw_561_CM 0. 6553.5 FORMAT "%5.2" /end CHARACTERISTIC
/begin CHARACTERISTIC K_VSEDIFF_MXLL "" VALUE 0xa08328a6 _REC_VAL_20_s2 131.07 _CNV_R_R_Def_spr_sw_561_CM -3276.8 3276.7 FORMAT "%5.2" /end CHARACTERISTIC
/begin CHARACTERISTIC K_VSESPRON_DIFF "" VALUE 0xa08328a8 _REC_VAL_20_u2 131.07 _CNV_R_R_Def_spr_sw_561_CM 0. 6553.5 FORMAT "%5.2" /end CHARACTERISTIC
/begin CHARACTERISTIC K_VSESPRON_MOV "" VALUE 0xa08328ac _REC_VAL_20_u2 131.07 _CNV_R_R_Def_spr_sw_561_CM 0. 6553.5 FORMAT "%5.2" /end CHARACTERISTIC
/begin CHARACTERISTIC K_WDKSAPP "Drosselklappensollwert für Applikationszwecke" VALUE 0xa0831f10 _REC_VAL_20_u2 95.99852999999999 _CNV_R_R_Def_wdk_sw_683_CM 0. 1599.9755 FORMAT "%5.2" /end CHARACTERISTIC
/begin CHARACTERISTIC K_ZK_PSSOLHUB "Zeitkonstante fuer 10ms Filterzyklus" VALUE 0xa0831bd4 _REC_VAL_20_u2 655.35 _CNV_R_R_Def_zk10ms_715_CM 1.e-002 655.36 FORMAT "%7.4" /end CHARACTERISTIC
/begin CHARACTERISTIC K_ZTDDPS "Filterkonstante Soll-Differenzdruck Saugrohr" VALUE 0xa0831be2 _REC_VAL_20_u2 99.9984 _CNV_R_R_Def_f_uw_b_555_CM 0. 99.9984 /end CHARACTERISTIC
/begin CHARACTERISTIC S_DPSSOLAPPL "Schalter Vorgabe Dpssol als Applikationswert" VALUE 0xa0831bab _REC_VAL_20_u1 99.45 _CNV_R_R_Def_dez_sl_551_CM 0. 255. FORMAT "%3.0" /end CHARACTERISTIC
/begin CHARACTERISTIC S_DPSTDO "gesetzt Dpssolfilt = Dps" VALUE 0xa0831bc8 _REC_VAL_20_u1 99.45 _CNV_R_R_Def_dez_sl_551_CM 0. 255. FORMAT "%3.0" /end CHARACTERISTIC
/begin CHARACTERISTIC S_FHUBVNS_HD "" VALUE 0xa083289f _REC_VAL_20_u1 1. _CNV_R_R_Def_dez_sl_551_CM 0. 1. FORMAT "%3.0" /end CHARACTERISTIC
/begin CHARACTERISTIC S_FSP_REP_TEST "Schalter Test ed_report()" VALUE 0xa0818e71 _REC_VAL_20_u1 99.45 _CNV_R_R_Def_dez_sl_551_CM 0. 255. FORMAT "%3.0" /end CHARACTERISTIC
/begin CHARACTERISTIC S_FSP_STAT_TEST "Schalter Test ed_status()" VALUE 0xa0818e70 _REC_VAL_20_u1 99.45 _CNV_R_R_Def_dez_sl_551_CM 0. 255. FORMAT "%3.0" /end CHARACTERISTIC
/begin CHARACTERISTIC S_HKLL_TL "Schalter um die Hubkorrektur auch in der Teillast durchzuführen" VALUE 0xa08328a1 _REC_VAL_20_u1 1. _CNV_R_R_Def_dez_sl_551_CM 0. 1. FORMAT "%3.0" /end CHARACTERISTIC
/begin CHARACTERISTIC S_HKLL_ZKOR "Schalter um die Hubkorrektur auch bei zylinderselektiver Hubkorrektur zu aktivieren" VALUE 0xa08328a2 _REC_VAL_20_u1 1. _CNV_R_R_Def_dez_sl_551_CM 0. 1. FORMAT "%3.0" /end CHARACTERISTIC
/begin CHARACTERISTIC S_HUBEVSIM "Schalter Simulation Ventilhub Hubev_ist gleich Hubev_soll" VALUE 0xa083289e _REC_VAL_20_u1 1. _CNV_R_R_Def_dez_sl_551_CM 0. 1. FORMAT "%3.0" /end CHARACTERISTIC
/begin CHARACTERISTIC S_HUBST "Schalter fuer Einlassventilhubvorsteuerung im Start" VALUE 0xa083289d _REC_VAL_20_u1 1. _CNV_R_R_Def_dez_sl_551_CM 0. 1. FORMAT "%3.0" /end CHARACTERISTIC
/begin CHARACTERISTIC S_PLDSOLL_APP "Ladedruck über Applikation" VALUE 0xa083350a _REC_VAL_20_u1 1. _CNV_R_R_Def_dez_sl_551_CM 0. 1. FORMAT "%3.0" /end CHARACTERISTIC
/begin CHARACTERISTIC S_PSPVDK_SOL "Freigabe Berechnung Pspvdk_soll" VALUE 0xa0831bc9 _REC_VAL_20_u1 99.45 _CNV_R_R_Def_dez_sl_551_CM 0. 255. FORMAT "%3.0" /end CHARACTERISTIC
/begin CHARACTERISTIC S_PSR_SGAPP "Schalter zum Auswählen ob Mssol(S=0) oder Mshfm_f in Berechnung Mssoldk eingehen soll" VALUE 0xa0831f05 _REC_VAL_20_u1 1. _CNV_R_R_Def_dez_sl_551_CM 0. 1. FORMAT "%3.0" /end CHARACTERISTIC
/begin CHARACTERISTIC S_PSSOLNL_KOR "" VALUE 0xa0831bad _REC_VAL_20_u1 99.45 _CNV_R_R_Def_dez_sl_551_CM 0. 255. FORMAT "%3.0" /end CHARACTERISTIC
/begin CHARACTERISTIC S_PSSOLNL_KOR2 "" VALUE 0xa0831baa _REC_VAL_20_u1 99.45 _CNV_R_R_Def_dez_sl_551_CM 0. 255. FORMAT "%3.0" /end CHARACTERISTIC
/begin CHARACTERISTIC S_PSSOL_UBEG "" VALUE 0xa0831bca _REC_VAL_20_u1 99.45 _CNV_R_R_Def_dez_sl_551_CM 0. 255. FORMAT "%3.0" /end CHARACTERISTIC
/begin CHARACTERISTIC S_RFMAXWAHL "Schalter zur Auswahl maximales Rf für Vorsteuerung" VALUE 0xa0831f06 _REC_VAL_20_u1 1. _CNV_R_R_Def_dez_sl_551_CM 0. 1. FORMAT "%3.0" /end CHARACTERISTIC
/begin CHARACTERISTIC S_TVP_TRIG "Applikationsschalter zur Aktivierung TV-Puls" VAL_BLK 0xa082ec34 _REC_VAL_2_u1 99.45 _CNV_R_R_Def_dez_sl_551_CM 0. 255. FORMAT "%3.0" NUMBER 4 /end CHARACTERISTIC
/begin CHARACTERISTIC S_VNSIWS "Schalter fuer Istwertschaetzer" VALUE 0xa0831b70 _REC_VAL_20_u1 99.45 _CNV_R_R_Def_dez_sl_551_CM 0. 255. FORMAT "%3.0" /end CHARACTERISTIC
/begin CHARACTERISTIC S_WDKSGD_OFF "Schalter zum Ausschalten Einfluss B_gd bei Wdk_soll im Start über Kennfeld" VALUE 0xa0831f04 _REC_VAL_20_u1 1. _CNV_R_R_Def_dez_sl_551_CM 0. 1. FORMAT "%3.0" /end CHARACTERISTIC
/begin CHARACTERISTIC S_WDK_START "Schalter, Wdk_soll im Start über Kennfeld" VALUE 0xa0831f03 _REC_VAL_20_u1 2. _CNV_R_R_Def_dez_sl_551_CM 0. 2. FORMAT "%3.0" /end CHARACTERISTIC
/begin COMPU_METHOD _CNV_R_R_Def_km_sw__68_CM "Def_km_sw_q10" RAT_FUNC "%6.3" "km" COEFFS 0. 1. 0. 0. 0. 10. /end COMPU_METHOD
/begin COMPU_METHOD _CNV_R_R_Def_km_ub__428_CM "Def_km_ub_q1000" RAT_FUNC "%6.3" "km" COEFFS 0. 1. 0. 0. 0. 1000. /end COMPU_METHOD
/begin COMPU_METHOD _CNV_R_R_Def_dez_sl_551_CM "Def_dez_sl_q1" RAT_FUNC "%6.3" "-" COEFFS 0. 1. 0. 0. 0. 1. /end COMPU_METHOD
/begin COMPU_METHOD _CNV_R_R_Def_f_ub_b_553_CM "Def_f_ub_b1" RAT_FUNC "%6.3" "-" COEFFS 0. 256. 0. 0. 0. 1. /end COMPU_METHOD
/begin COMPU_METHOD _CNV_R_R_Def_m_sw_q_554_CM "Def_m_sw_q0p1" RAT_FUNC "%6.3" "Nm" COEFFS 0. 10. 0. 0. 0. 1. /end COMPU_METHOD
/begin COMPU_METHOD _CNV_R_R_Def_f_uw_b_555_CM "Def_f_uw_b100" RAT_FUNC "%6.3" "%" COEFFS 0. 65536. 0. 0. 0. 100. /end COMPU_METHOD
/begin COMPU_METHOD _CNV_R_R_Def_f_uw_b_559_CM "Def_f_uw_b16" RAT_FUNC "%6.3" "-" COEFFS 0. 65536. 0. 0. 0. 16. /end COMPU_METHOD
/begin COMPU_METHOD _CNV_R_R_Def_spr_sw_561_CM "Def_spr_sw_q0p1" RAT_FUNC "%6.3" "° KW" COEFFS 0. 10. 0. 0. 0. 1. /end COMPU_METHOD
/begin COMPU_METHOD _CNV_S_2_Def_bit_ub_563_CM "Def_bit_ub_0" TAB_VERB "%6.3" "-" COMPU_TAB_REF _CNV_S_2_Def_bit_ub_563 /end COMPU_METHOD
/begin COMPU_VTAB _CNV_S_2_Def_bit_ub_563 "Def_bit_ub_0" TAB_VERB 2 0 "FALSE" 1 "TRUE" /end COMPU_VTAB
/begin COMPU_METHOD _CNV_R_R_Def_f_uw_b_571_CM "Def_f_uw_b1" RAT_FUNC "%6.3" "-" COEFFS 0. 65536. 0. 0. 0. 1. /end COMPU_METHOD
/begin COMPU_METHOD _CNV_R_R_Def_f_uw_b_572_CM "Def_f_uw_b8" RAT_FUNC "%6.3" "-" COEFFS 0. 65536. 0. 0. 0. 8. /end COMPU_METHOD
/begin COMPU_METHOD _CNV_R_R_Def_p_sw_q_576_CM "Def_p_sw_q0p039" RAT_FUNC "%6.3" "hPa" COEFFS 0. 256. 0. 0. 0. 10. /end COMPU_METHOD
/begin COMPU_METHOD _CNV_R_R_Def_t_sw_q_578_CM "Def_t_sw_q0p1" RAT_FUNC "%6.3" "°C" COEFFS 0. 10. 0. 0. 0. 1. /end COMPU_METHOD
/begin COMPU_METHOD _CNV_R_R_Def_t_sw_q_579_CM "Def_t_sw_q0p01" RAT_FUNC "%6.3" "°C" COEFFS 0. 100. 0. 0. 0. 1. /end COMPU_METHOD
/begin COMPU_METHOD _CNV_R_R_Def_u_sb_q_583_CM "Def_u_sb_q0p0942" RAT_FUNC "%6.3" "V" COEFFS 0. 1. 0. 0. 0. 9.420000000000001e-002 /end COMPU_METHOD
/begin COMPU_METHOD _CNV_R_R_Def_exwink_585_CM "Def_exwink_uw_q0p022" RAT_FUNC "%6.3" "°" COEFFS 0. 8192. 0. 0. 0. 180. /end COMPU_METHOD
/begin COMPU_METHOD _CNV_R_R_Def_f_uw_b_588_CM "Def_f_uw_b32" RAT_FUNC "%6.3" "-" COEFFS 0. 65536. 0. 0. 0. 32. /end COMPU_METHOD
/begin COMPU_METHOD _CNV_R_R_Def_hub_uw_589_CM "Def_hub_uw_q0p001" RAT_FUNC "%6.3" "mm" COEFFS 0. 1000. 0. 0. 0. 1. /end COMPU_METHOD
/begin COMPU_METHOD _CNV_R_R_Def_f_uw_b_590_CM "Def_f_uw_b2" RAT_FUNC "%6.3" "-" COEFFS 0. 65536. 0. 0. 0. 2. /end COMPU_METHOD
/begin COMPU_METHOD _CNV_R_R_Def_f_sw_b_591_CM "Def_f_sw_b4" RAT_FUNC "%6.3" "-" COEFFS 0. 32768. 0. 0. 0. 4. /end COMPU_METHOD
/begin COMPU_METHOD _CNV_R_R_Def_ms_uw__594_CM "Def_ms_uw_q0p03125" RAT_FUNC "%6.3" "kg/h" COEFFS 0. 32. 0. 0. 0. 1. /end COMPU_METHOD
/begin COMPU_METHOD _CNV_R_R_Def_n_sw_q_595_CM "Def_n_sw_q1p0" RAT_FUNC "%6.3" "Upm" COEFFS 0. 1. 0. 0. 0. 1. /end COMPU_METHOD
/begin COMPU_METHOD _CNV_R_R_Def_rf_sw__598_CM "Def_rf_sw_q0p01" RAT_FUNC "%6.3" "%" COEFFS 0. 100. 0. 0. 0. 1. /end COMPU_METHOD
/begin COMPU_METHOD _CNV_R_R_Def_zw_sw__604_CM "Def_zw_sw_q0p1" RAT_FUNC "%6.3" "°" COEFFS 0. 10. 0. 0. 0. 1. /end COMPU_METHOD
/begin COMPU_METHOD _CNV_R_R_Def_f_ub_b_612_CM "Def_f_ub_b32" RAT_FUNC "%6.3" "-" COEFFS 0. 256. 0. 0. 0. 32. /end COMPU_METHOD
/begin COMPU_METHOD _CNV_R_R_Def_f_ub_b_613_CM "Def_f_ub_b2" RAT_FUNC "%6.3" "-" COEFFS 0. 256. 0. 0. 0. 2. /end COMPU_METHOD
/begin COMPU_METHOD _CNV_R_R_Def_f_sw_b_616_CM "Def_f_sw_b2" RAT_FUNC "%6.3" "-" COEFFS 0. 65536. 0. 0. 0. 4. /end COMPU_METHOD
/begin COMPU_METHOD _CNV_R_R_Def_f_uw_b_617_CM "Def_f_uw_b64" RAT_FUNC "%6.3" "-" COEFFS 0. 65536. 0. 0. 0. 64. /end COMPU_METHOD
/begin COMPU_METHOD _CNV_S_2_Def_neg_bi_628_CM "Def_neg_bit_uw_8" TAB_VERB "%6.3" "-" COMPU_TAB_REF _CNV_S_2_Def_neg_bi_628 /end COMPU_METHOD
/begin COMPU_VTAB _CNV_S_2_Def_neg_bi_628 "Def_neg_bit_uw_8" TAB_VERB 2 0 "TRUE" 1 "FALSE" /end COMPU_VTAB
/begin COMPU_METHOD _CNV_R_R_Def_f_uw_b_629_CM "Def_f_uw_b0p3" RAT_FUNC "%6.3" "%/hPa" COEFFS 0. 65536. 0. 0. 0. 0.3 /end COMPU_METHOD
/begin COMPU_METHOD _CNV_R_R_Def_flae_u_646_CM "Def_flae_uw_q0p016" RAT_FUNC "%6.3" "mm*KW°" COEFFS 0. 1. 0. 0. 0. 1.6e-002 /end COMPU_METHOD
/begin COMPU_METHOD _CNV_R_R_Def_ms_uw__655_CM "Def_ms_uw_b8192" RAT_FUNC "%6.3" "kg/h" COEFFS 0. 8. 0. 0. 0. 1. /end COMPU_METHOD
/begin COMPU_METHOD _CNV_R_R_Def_td_uw__663_CM "Def_td_uw_q0p001" RAT_FUNC "%6.3" "ms" COEFFS 0. 1000. 0. 0. 0. 1. /end COMPU_METHOD
/begin COMPU_METHOD _CNV_R_R_Def_td_ul__665_CM "Def_td_ul_q1" RAT_FUNC "%6.3" "ms" COEFFS 0. 1. 0. 0. 0. 1. /end COMPU_METHOD
/begin COMPU_METHOD _CNV_R_R_Def_niv_ub_667_CM "Def_niv_ub_b75" RAT_FUNC "%6.3" "" COEFFS 0. 256. 0. 0. 0. 75. /end COMPU_METHOD
/begin COMPU_METHOD _CNV_R_R_Def_fuel_u_668_CM "Def_fuel_ul_q0p000122" RAT_FUNC "%6.3" "" COEFFS 0. 8192. 0. 0. 0. 1. /end COMPU_METHOD
/begin COMPU_METHOD _CNV_R_R_Def_lf_ub__670_CM "Def_lf_ub_q0p01" RAT_FUNC "%6.3" "-" COEFFS 0. 100. 0. 0. 0. 1. /end COMPU_METHOD
/begin COMPU_METHOD _CNV_R_R_Def_niv_ub_671_CM "Def_niv_ub_q0p1" RAT_FUNC "%6.3" "l" COEFFS 0. 10. 0. 0. 0. 1. /end COMPU_METHOD
/begin COMPU_METHOD _CNV_R_R_Def_niv_ub_672_CM "Def_niv_ub_b8" RAT_FUNC "%6.3" "" COEFFS 0. 256. 0. 0. 0. 8. /end COMPU_METHOD
/begin COMPU_METHOD _CNV_R_R_Def_td_uw__673_CM "Def_td_uw_q0p01" RAT_FUNC "%6.3" "s" COEFFS 0. 100. 0. 0. 0. 1. /end COMPU_METHOD
/begin COMPU_METHOD _CNV_R_R_Def_russ_u_675_CM "Def_russ_uw_q0p01" RAT_FUNC "%6.3" "mg" COEFFS 0. 100. 0. 0. 0. 1. /end COMPU_METHOD
/begin COMPU_METHOD _CNV_R_R_Def_wdk_sw_683_CM "Def_wdk_sw_q0p0244" RAT_FUNC "%6.3" "%" COEFFS 0. 4096. 0. 0. 0. 100. /end COMPU_METHOD
/begin COMPU_METHOD _CNV_R_R_Def_f_ub_b_694_CM "Def_f_ub_b8" RAT_FUNC "%6.3" "-" COEFFS 0. 256. 0. 0. 0. 8. /end COMPU_METHOD
/begin COMPU_METHOD _CNV_R_R_Def_td_ub__710_CM "Def_td_ub_b1280" RAT_FUNC "%6.3" "ms" COEFFS 0. 1. 0. 0. 0. 5. /end COMPU_METHOD
/begin COMPU_METHOD _CNV_R_R_Def_zk10ms_715_CM "Def_zk10ms_uw_b655p36" RAT_FUNC "%6.3" "s" COEFFS 0. 0. 655.36 0. 1. 0. /end COMPU_METHOD
/begin COMPU_METHOD _CNV_R_R_Def_freq_u_728_CM "Def_freq_ub_q1" RAT_FUNC "%6.3" "Hz" COEFFS 0. 1. 0. 0. 0. 1. /end COMPU_METHOD
/begin COMPU_METHOD _CNV_R_R_Def_rel_uw_729_CM "Def_rel_uw_q0p01" RAT_FUNC "%6.3" "%" COEFFS 0. 327.68 32768. 0. 0. 1. /end COMPU_METHOD
/begin COMPU_METHOD _CNV_R_R_Def_spr_sb_731_CM "Def_spr_sb_q0p05" RAT_FUNC "%6.3" "° KW" COEFFS 0. 20. 0. 0. 0. 1. /end COMPU_METHOD
/begin COMPU_METHOD _CNV_R_R_Def_vg_sw__732_CM "Def_vg_sw_q0p781" RAT_FUNC "%6.3" "° KW/s" COEFFS 0. 1.28 0. 0. 0. 1. /end COMPU_METHOD
/begin COMPU_METHOD _CNV_R_R_Def_spr_uw_733_CM "Def_spr_uw_q0p01" RAT_FUNC "%6.3" "° KW" COEFFS 0. 10. 32768. 0. 0. 1. /end COMPU_METHOD
/begin COMPU_METHOD _CNV_R_R_Def_zk100m_739_CM "Def_zk100ms_uw_b6553p6" RAT_FUNC "%6.3" "s" COEFFS 0. 0. 6553.6 0. 1. 0. /end COMPU_METHOD
/begin COMPU_METHOD _CNV_R_R_Def_zk10ms_754_CM "Def_zk10ms_ub_b2p56" RAT_FUNC "%6.3" "s" COEFFS 0. 0. 2.56 0. 1. 0. /end COMPU_METHOD
/begin COMPU_METHOD _CNV_R_R_Def_dhub10_760_CM "Def_dhub10ms_sw_q0p1" RAT_FUNC "%6.3" "mm/s" COEFFS 0. 10. 0. 0. 0. 1. /end COMPU_METHOD
/begin COMPU_METHOD _CNV_R_R_Def_i_sw_q_764_CM "Def_i_sw_q0p0625" RAT_FUNC "%6.3" "A" COEFFS 0. 1000. 0. 0. 0. 62.5 /end COMPU_METHOD
/begin COMPU_METHOD _CNV_R_R_Def_f_ub_b_765_CM "Def_f_ub_b0p25" RAT_FUNC "%6.3" "-" COEFFS 0. 256. 0. 0. 0. 0.25 /end COMPU_METHOD
/begin COMPU_METHOD _CNV_R_R_Def_th_ub__766_CM "Def_th_ub_q10" RAT_FUNC "%6.3" "h" COEFFS 0. 1. 0. 0. 0. 10. /end COMPU_METHOD
/begin COMPU_METHOD _CNV_R_R_Def_rel_sw_778_CM "Def_rel_sw_q0p003" RAT_FUNC "%6.3" "%" COEFFS 0. 327.68 0. 0. 0. 1. /end COMPU_METHOD
/begin RECORD_LAYOUT _REC_VAL_20_u1 FNC_VALUES 1 UBYTE COLUMN_DIR DIRECT /end RECORD_LAYOUT
/begin RECORD_LAYOUT _REC_VAL_20_u2 FNC_VALUES 1 UWORD COLUMN_DIR DIRECT /end RECORD_LAYOUT
/begin RECORD_LAYOUT _REC_VAL_20_s2 FNC_VALUES 1 SWORD COLUMN_DIR DIRECT /end RECORD_LAYOUT
/begin RECORD_LAYOUT _REC_VAL_20_u4 FNC_VALUES 1 ULONG COLUMN_DIR DIRECT /end RECORD_LAYOUT
/begin RECORD_LAYOUT _REC_MAP_52_u1_s2_s2 NO_AXIS_PTS_X 1 UBYTE NO_AXIS_PTS_Y 2 UBYTE AXIS_PTS_X 3 SWORD INDEX_INCR DIRECT AXIS_PTS_Y 4 SWORD INDEX_INCR DIRECT FNC_VALUES 5 UBYTE COLUMN_DIR DIRECT /end RECORD_LAYOUT
/begin RECORD_LAYOUT _REC_MAP_52_UBYTE_u2_s2_u2 NO_AXIS_PTS_X 1 UBYTE NO_AXIS_PTS_Y 2 UBYTE AXIS_PTS_X 3 SWORD INDEX_INCR DIRECT AXIS_PTS_Y 4 UWORD INDEX_INCR DIRECT FNC_VALUES 5 UWORD COLUMN_DIR DIRECT /end RECORD_LAYOUT
/begin RECORD_LAYOUT _REC_MAP_52_UBYTE_u2_s2_s2 NO_AXIS_PTS_X 1 UBYTE NO_AXIS_PTS_Y 2 UBYTE AXIS_PTS_X 3 SWORD INDEX_INCR DIRECT AXIS_PTS_Y 4 SWORD INDEX_INCR DIRECT FNC_VALUES 5 UWORD COLUMN_DIR DIRECT /end RECORD_LAYOUT
/begin RECORD_LAYOUT _REC_MAP_52_UBYTE_s2_s2_s2 NO_AXIS_PTS_X 1 UBYTE NO_AXIS_PTS_Y 2 UBYTE AXIS_PTS_X 3 SWORD INDEX_INCR DIRECT AXIS_PTS_Y 4 SWORD INDEX_INCR DIRECT FNC_VALUES 5 SWORD COLUMN_DIR DIRECT /end RECORD_LAYOUT
/begin RECORD_LAYOUT _REC_MAP_52_UBYTE_u2_u2_u2 NO_AXIS_PTS_X 1 UBYTE NO_AXIS_PTS_Y 2 UBYTE AXIS_PTS_X 3 UWORD INDEX_INCR DIRECT AXIS_PTS_Y 4 UWORD INDEX_INCR DIRECT FNC_VALUES 5 UWORD COLUMN_DIR DIRECT /end RECORD_LAYOUT
/begin RECORD_LAYOUT _REC_MAP_52_UBYTE_u2_u2_s2 NO_AXIS_PTS_X 1 UBYTE NO_AXIS_PTS_Y 2 UBYTE AXIS_PTS_X 3 UWORD INDEX_INCR DIRECT AXIS_PTS_Y 4 SWORD INDEX_INCR DIRECT FNC_VALUES 5 UWORD COLUMN_DIR DIRECT /end RECORD_LAYOUT
/begin RECORD_LAYOUT _REC_MAP_52_UBYTE_s2_u2_u2 NO_AXIS_PTS_X 1 UBYTE NO_AXIS_PTS_Y 2 UBYTE AXIS_PTS_X 3 UWORD INDEX_INCR DIRECT AXIS_PTS_Y 4 UWORD INDEX_INCR DIRECT FNC_VALUES 5 SWORD COLUMN_DIR DIRECT /end RECORD_LAYOUT
/begin RECORD_LAYOUT _REC_MAP_52_u1_s2_u2 NO_AXIS_PTS_X 1 UBYTE NO_AXIS_PTS_Y 2 UBYTE AXIS_PTS_X 3 SWORD INDEX_INCR DIRECT AXIS_PTS_Y 4 UWORD INDEX_INCR DIRECT FNC_VALUES 5 UBYTE COLUMN_DIR DIRECT /end RECORD_LAYOUT
/begin RECORD_LAYOUT _REC_CUR_TKL_UW_VV__u2_u2 NO_AXIS_PTS_X 1 UBYTE RESERVED 2 BYTE AXIS_PTS_X 3 UWORD INDEX_INCR DIRECT FNC_VALUES 4 UWORD COLUMN_DIR DIRECT /end RECORD_LAYOUT
/begin RECORD_LAYOUT _REC_CUR_TKL_UW_VV__u2_s2 NO_AXIS_PTS_X 1 UBYTE RESERVED 2 BYTE AXIS_PTS_X 3 SWORD INDEX_INCR DIRECT FNC_VALUES 4 UWORD COLUMN_DIR DIRECT /end RECORD_LAYOUT
/begin RECORD_LAYOUT _REC_CUR_TKL_UW_VV__u1_s2 NO_AXIS_PTS_X 1 UBYTE RESERVED 2 BYTE AXIS_PTS_X 3 SWORD INDEX_INCR DIRECT FNC_VALUES 4 UBYTE COLUMN_DIR DIRECT /end RECORD_LAYOUT
/begin RECORD_LAYOUT _REC_CUR_TKL_UW_VV__s2_s2 NO_AXIS_PTS_X 1 UBYTE RESERVED 2 BYTE AXIS_PTS_X 3 SWORD INDEX_INCR DIRECT FNC_VALUES 4 SWORD COLUMN_DIR DIRECT /end RECORD_LAYOUT
/begin RECORD_LAYOUT _REC_CUR_TKL_UW_VV__u1_u2 NO_AXIS_PTS_X 1 UBYTE RESERVED 2 BYTE AXIS_PTS_X 3 UWORD INDEX_INCR DIRECT FNC_VALUES 4 UBYTE COLUMN_DIR DIRECT /end RECORD_LAYOUT
/begin RECORD_LAYOUT _REC_CUR_TKL_UW_VV__s2_u2 NO_AXIS_PTS_X 1 UBYTE RESERVED 2 BYTE AXIS_PTS_X 3 UWORD INDEX_INCR DIRECT FNC_VALUES 4 SWORD COLUMN_DIR DIRECT /end RECORD_LAYOUT
/begin RECORD_LAYOUT _REC_CUR_TKL_UW_VV__u1_u1 NO_AXIS_PTS_X 1 UBYTE RESERVED 2 BYTE AXIS_PTS_X 3 UBYTE INDEX_INCR DIRECT FNC_VALUES 4 UBYTE COLUMN_DIR DIRECT /end RECORD_LAYOUT
/begin RECORD_LAYOUT _REC_CUR_TKL_UW_VV__S4_S4 NO_AXIS_PTS_X 1 UBYTE RESERVED 2 BYTE AXIS_PTS_X 3 FLOAT32_IEEE INDEX_INCR DIRECT FNC_VALUES 4 FLOAT32_IEEE COLUMN_DIR DIRECT /end RECORD_LAYOUT
/begin RECORD_LAYOUT _REC_VAL_2_u1 FNC_VALUES 1 UBYTE COLUMN_DIR DIRECT /end RECORD_LAYOUT
/begin RECORD_LAYOUT _REC_VAL_2_s2 FNC_VALUES 1 SWORD COLUMN_DIR DIRECT /end RECORD_LAYOUT
/begin RECORD_LAYOUT _REC_VAL_2_u2 FNC_VALUES 1 UWORD COLUMN_DIR DIRECT /end RECORD_LAYOUT
/begin FUNCTION BLS ""
 /begin DEF_CHARACTERISTIC CW_RFVNS KF_DPS KF_MSZSVNST KF_SRKOR_SPUEL KF_VNSDYNKOR KL_FUPSRF_TRANS KL_GDVNSFIL KL_PIRG_TRANS KL_PSRF_GRD KL_RFTNLMX KL_SRKOR_SPUEL KL_ZKPVDKDS KL_ZK_DRFSPUEL KL_ZK_DRFUK KL_ZK_VNSDYNKOR K_BANK20MS_LS K_BANK20MS_LSHYS K_DPLLMX K_DPSSOLAPPL K_DPSSOL_MN K_DPS_DTEV K_DP_TE K_FPSSOLHUB_MN K_MAT_DPS K_MAT_DPSFAK K_MAT_RFVVNS K_MAX_PSSOLBER K_PAKPSNL_MIN K_PSPVDK_SOLMAX K_PSPVDK_SOLMAXGD K_PSPVDK_SOLMAXUG K_PSPVDK_SOLMIN K_PVDKDS_PSMX K_PVDKPNRFV_MX K_ZK_PSSOLHUB K_ZTDDPS S_DPSSOLAPPL S_DPSTDO S_PSPVDK_SOL S_PSSOLNL_KOR S_PSSOLNL_KOR2 S_PSSOL_UBEG /end DEF_CHARACTERISTIC
 /begin REF_CHARACTERISTIC CW_EISY_TURBO S_MSZYL_3MOD /end REF_CHARACTERISTIC
 /begin OUT_MEASUREMENT Dpsfak Dpsfak_1 Dpsfak_2 Dpssol Dpssol_i Dpssolfilt Dpssolfilt_i Dpssolgd Dpssolgd_i Dpsvvtte Drf_spuel_f_i Drf_uk_f_i Drft_i Drft_uk_i F_int_pssolber_i F_pssolber_i F_pvdkpnvns F_pvdkpnvns_i F_tpkor_vns F_tpkor_vns_i Fupsrf_kor_i Kf_mszsvnst_aus Kfdps_aus Kl_gdvnsfil_aus Ls_bank_20ms Msnsol Msnsolps Mssol Mssol_i Mssol_mr_i Pakps_soll_i Pirg_kor_i Ps_mx_ext_i Ps_soll_gd_i Ps_sollgd_lin_i Ps_sollgd_nl2_i Ps_sollgd_nl_i Psoll_nlbas_i Pspvdk_soll Pspvdk_soll_i Pspvdk_soll_ur_i Pssol Pssol_i Pssoll_g_i Pssoll_offs_diff_i Pssoll_offs_i Pste_mx Pvdkdsf Pvdkdsf_i Rf_f_vns Rf_fvns_k Rf_fvns_tkor Rf_max_ext Rf_max_ext_i Rf_soll_g_i Rft_i Rft_lin_i Rft_nl_i Rfv_fvns_mem Rfv_hub Rfv_min Rfv_mpr Rfv_mpr_i Rfv_soll Rfv_soll_dk Rfv_soll_dk_i Rfv_soll_h_i Rfv_soll_i Rfv_vns Rfv_vns_dk Rfv_vns_roh Rfv_vnsdk_mem Rfv_vnsdk_roh Rfv_vnsdk_ubeg St_bls_global St_bls_global.B_ls_20ms St_blstd St_blstd.B_lltd St_blstd.B_lltd_old St_blstd.B_lltd_vz St_blstd.B_pssolnl_akt St_fe St_fe.B_tvdpsrfvw /end OUT_MEASUREMENT
 /begin IN_MEASUREMENT Ba_ist Ba_soll Drf_spuel_i Drf_uk_i Drf_zylvol_i Drfnorm_spuel_i Eisydk_korfak_f_i Eisydk_koroff_f_i F_evmod F_pvdkpn_i F_rfvkor_dash F_tzylkor F_tzylkor_i F_umsrfn Fho Fupsrf_i Nkw Pak_i Pakps_offs_i Pirg_abgd_i Pu Pvdkds_i Rf Rf_min Rf_soll Rf_soll_h St_bgkuppl1 St_bgkuppl1.B_ll St_start St_start.B_jumpstart St_start.B_sta St_start.B_start St_start.B_startende St_start.B_wst /end IN_MEASUREMENT
/end FUNCTION
/begin FUNCTION BLSATL ""
 /begin DEF_CHARACTERISTIC KF_PSPLD_DYN KF_PSPLD_ECO KL_TDFPSPLD K_PLD_SOLL S_PLDSOLL_APP /end DEF_CHARACTERISTIC
 /begin OUT_MEASUREMENT F_pspld_soll F_pspld_ueb F_psspu Pld_soll /end OUT_MEASUREMENT
 /begin IN_MEASUREMENT Nkw Pssol_i Pu St_atlob_intern St_atlob_intern.B_atlob_akt St_atlob_intern.B_atlob_end /end IN_MEASUREMENT
/end FUNCTION
/begin FUNCTION BLSDK ""
 /begin DEF_CHARACTERISTIC CW_DKAPP KF_DKST KF_FTRANSVL KF_MSSDYN_KOR KF_WDKDPS KL_DKVL KL_DPSDKM KL_FPWDKAPP KL_MSNLG KL_MSSDYN_KOR KL_TWDKNVN KL_TWDKNVP KL_TWDKSV KL_WDKSNLN K_DPSGRENDK K_DRFVMXDKMN K_MAT_DKVL K_TFWDKSOM K_TVWDKS K_TWDKVST K_WDKSAPP S_PSR_SGAPP S_RFMAXWAHL S_WDKSGD_OFF S_WDK_START /end DEF_CHARACTERISTIC
 /begin REF_CHARACTERISTIC CW_EISY_TURBO K_PSPVDK_SOLMAXGD /end REF_CHARACTERISTIC
 /begin OUT_MEASUREMENT Dpssolps_i F_dpsdkm_i F_mssdyn_kor_i F_transvl_bas_i F_transvl_i Klafaus_i Msn_pspvdk_smx_i Msnwdk_soll_i Mssoldk_dyn_i Mssoldk_i Mssoldk_kor_i Mssoldkdyn_roh_i Pssol_pspvdk_smx_i Rfv_mxdk_i Rfv_pspvdk_smx_i Rfv_solldk_i Twdk_i Wdk_soll Wdk_soll_gd_i Wdk_soll_i Wdk_soll_transvl_i Wdk_soll_trvlbas_i Wdk_soll_uebl_i Wdk_soll_uf_i Wdk_soll_ug_i Wdk_soll_uverz_i Wdk_som Wdks_vl /end OUT_MEASUREMENT
 /begin IN_MEASUREMENT Dpsfak Dpssol_i Drf_soll Eisydk_korfak_f_i Eisydk_koroff_f_i F_dms2dps_i F_t_pvdkpn_i F_tvdkho_i F_umsrfn Fupsrf_kor_i Ls_bank_20ms Msbkv Mshfm_f_i Mssol_i Nkw Pirg_kor_i Ps_i Pspvdk_soll_i Pspvdk_soll_ur_i Pssol_i Pvdkds_f_i Pwg_ist Rf_max_ext_i Rf_vl St_bls_global St_bls_global.B_ls_20ms St_dps St_dps.B_dpsadp St_dps.B_gd St_dps.B_gdst St_dps.B_gdvhub St_kl15 St_kl15.B_kl15_ep St_kl15.B_kl15_vorab St_motzustd St_motzustd.B_ll_roh St_motzustd.B_vl St_start St_start.B_jumpstart St_start.B_sta St_start.B_start St_start.B_startende St_start.B_wst Tmot /end IN_MEASUREMENT
/end FUNCTION
/begin FUNCTION BLSHUB ""
 /begin DEF_CHARACTERISTIC CW_HUBAPP KF_ANFLVNS KF_ASVNS KF_ESVNS KF_FHUB_NST KF_FLAEAN KF_HUBE KF_HUBELL KF_HUBEST KF_HUBESTM KF_ZKVNSI KL_DHUBTM KL_DNWELLK KL_EXWHKLL KL_EXWMX_N KL_FHTMOT KL_FHUB_DPSFAK KL_FHUB_ST KL_HUBAPP KL_HUBEVL KL_HUBEX KL_HUBV KL_VVTCLOSE KL_VVTCLOSE_AT KL_ZKVNSI_LL KL_ZYLN K_AVZUNASPR K_DHUBDKNOTL K_DHUBMD K_DHUBMX K_DHUBVH K_DHUBVHN1 K_DHUBVHN2 K_DNWE K_EXWDIFLL_MN K_EXWDIFLL_MX K_EXWIST_DIF K_EXWKOR_MN K_EXWKOR_MX K_EXWSOLL_DIF K_EXWTLHK_MX K_FEXWHKLL_DEK K_FEXWHKLL_INK K_FEXWKOR_MN K_FEXWKOR_MX K_FHUBVNSMN K_FHUBVNSMX K_FHUBVNS_HD K_FHUB_NMX K_FHUB_VSAMN K_FHUB_VSAMX K_FHUB_VSEMN K_FHUB_VSEMX K_HUBAPP K_HUBSGNL K_HUBV_NOTL K_IVVTHKLL_MX K_NKWHKLL_MN K_NKWHKLL_MX K_OFFHUB_VNSAN K_TDHKNACHL K_TDHUBVHN1 K_TD_SPRON K_TD_SPRONMX K_TEXWMX K_THKLL_MX K_THKLL_VZ K_TMOTHKLL_MN K_TMSTHUBSTM K_TVVTCLOSE K_VSASPRON_DIFF K_VSASPRON_MOV K_VSEDIFF_MXLL K_VSESPRON_DIFF K_VSESPRON_MOV S_FHUBVNS_HD S_HKLL_TL S_HKLL_ZKOR S_HUBEVSIM S_HUBST /end DEF_CHARACTERISTIC
 /begin OUT_MEASUREMENT Dexwkor_ist Dexwkor_soll Dhubra Dhubtm Dvse_spr Exwdifll Exwdifll_alt Exwink2_soll Exwink_nokor Exwink_soll Exwinkmx Exwinkmx_vz Exwkor_ll F_exwkor_ll F_hubdpsfak F_hubnst Fhubvnsf Fhubvnsi Fhubvnss Hubev2_ist Hubev_ist Hubev_soll Hubev_soll_b Hubev_soll_kf Hubev_soll_vh Hubev_vh Hubevkor_soll Kffl_ausi Kffl_ausn St_blshub St_blshub.B_fhubvnsi_ini St_blshub.B_hubst St_blshub.B_llk St_blshub.B_nwe St_blshub.B_vns_spron St_blshub.B_vsean_loc St_blshub.B_vvtclose St_blshub2 St_blshub2.B_hkll St_blshub2.B_hkll_edge1 St_blshub2.B_hkll_edge2 St_blshub2.B_hkll_edge3 St_blshub2.B_hkll_pre St_blshub2.B_hkll_vz St_blshub2.B_hubsolldif T_zkvnsi Vol_verh_a Vol_verh_e Vsa_spr Vsa_spris Vsasprn Vse_spr Vse_spris Vsesprn /end OUT_MEASUREMENT
 /begin IN_MEASUREMENT Dpsfak Nkw Pwg_ist St_bgkuppl1 St_bgkuppl1.B_ll St_dps St_dps.B_dpsadp St_dps.B_gd St_dps.B_gdst St_dps.B_gdvhub St_kl15 St_kl15.B_kl15_ep St_kl15.B_kl15_vorab St_mkwchn St_mkwchn.B_kwdreht St_motzustd St_motzustd.B_ll_roh St_motzustd.B_vl St_restg St_restg.B_ff_nvsaad St_restg.B_ff_nvsead St_restg.B_nvsaad St_restg.B_nvsead St_start St_start.B_jumpstart St_start.B_sta St_start.B_start St_start.B_startende St_start.B_wst Tmot Var_at Vsa_spri Vsa_sprn Vse_spri Vse_sprn /end IN_MEASUREMENT
/end FUNCTION
/begin FUNCTION cbsoz_30_01_ "" /begin SUB_FUNCTION CBSOZ CBSOZIN CBSOZOUT /end SUB_FUNCTION /end FUNCTION
/begin FUNCTION CBSOZ ""
 /begin DEF_CHARACTERISTIC KF_NKW_TN KF_RUSS_KALT KF_RUSS_WARM KL_KMST_FAK KL_OZBEFKL KL_OZTKKVB KL_OZVERDFAK KL_TEMP_FAK KL_WKRM_FAK K_CW_CBSOZ K_OELREST K_OZANFANZ K_OZDAEMPF K_OZKMMAXK11 K_OZKVB96 K_OZKVB96A K_OZKVBMXK18 K_OZKVBOK16 K_OZLF1 K_OZLF2 K_OZMAXBS K_OZMNKMBO K_OZMXOHK15 K_OZOELMEN K_OZRUSSMX K_OZTAGCTERR K_OZUEBERTEMP K_OZUTFAK K_OZZEITFAKT K_OZZEITINT /end DEF_CHARACTERISTIC
 /begin REF_CHARACTERISTIC K_OZBZKMSTK1 K_OZKMUPL /end REF_CHARACTERISTIC
 /begin OUT_MEASUREMENT Oz_bsz Oz_cttagini Oz_deabzug Oz_dkvb Oz_dkvbrest Oz_intprog Oz_kmstrw0 Oz_kvbalt Oz_kvbdiff Oz_kvbmw Oz_kvbmwtmp Oz_kvbmx Oz_kvbog Oz_kvbsm Oz_kvbsm_ul Oz_kvbtmp2 Oz_lf1t Oz_lf2t Oz_litges Oz_nivlanglit Oz_nivlangt Oz_nivnfm Oz_oelzeit Oz_oelzeitt Oz_russkalt Oz_russsum Oz_russwarm Oz_rwanz Oz_rwbsz Oz_rwde Oz_rwkvb Oz_rwp Oz_rwprog Oz_rwruss Oz_rwzeit Oz_vfanz Oz_vfbsz Oz_vfkvb Oz_vfruss Oz_vfzeit Oz_zieljahr Oz_zielmon St_cbsoz_nv0 St_cbsoz_nv0.B_ozcntini St_cbsoz_nv0.B_ozini St_cbsoz_nv0.B_rwanz0 Toel_oz /end OUT_MEASUREMENT
 /begin IN_MEASUREMENT Nkw Oz_oelkm Oz_rwprueck Oz_vfbdmew Oz_zjbdmew Oz_zmbdmew St_cbsozin0 St_cbsozin0.B_oelwech St_cbsozin0.B_ozmanip St_cbsozin0.B_ozvfchg St_cbsozin0.B_ozvfchgc St_cbsozin0.B_ozvfchgcc St_cbsozin0.B_ozvfchgt St_cbsozin0.B_ozzeitdmew St_cbsozin0.B_svcntchg St_cbsozin_nv0 St_cbsozin_nv0.B_dmeini St_cbsozin_nv0.B_dmewech St_cbsozin_nv0.B_factoryres St_kl15 St_kl15.B_kl15_ep St_kl15.B_kl15_vorab St_mkwchn St_mkwchn.B_kwdreht Tmot Tn_start_10 /end IN_MEASUREMENT
/end FUNCTION
/begin FUNCTION CBSOZIN "" /begin DEF_CHARACTERISTIC K_OZBZKMSTK1 K_OZKMUPL /end DEF_CHARACTERISTIC /begin REF_CHARACTERISTIC K_CW_CBSOZ K_OZZEITFAKT /end REF_CHARACTERISTIC
 /begin OUT_MEASUREMENT Id_bosrtak Oz_kmlow Oz_manipt Oz_oelkm Oz_rwprueck Oz_rwrueck Oz_svcntchg Oz_vfbdmew Oz_zjbdmew Oz_zmbdmew St_cbsozin0 St_cbsozin0.B_oelwech St_cbsozin0.B_ozmanip St_cbsozin0.B_ozvfchg St_cbsozin0.B_ozvfchgc St_cbsozin0.B_ozvfchgcc St_cbsozin0.B_ozvfchgt St_cbsozin0.B_ozzeitdmew St_cbsozin0.B_svcntchg St_cbsozin1 St_cbsozin1.B_ozreset St_cbsozin1.B_ozresetcan St_cbsozin1.B_ozresett St_cbsozin_nv0 St_cbsozin_nv0.B_dmeini St_cbsozin_nv0.B_dmewech St_cbsozin_nv0.B_factoryres /end OUT_MEASUREMENT
 /begin IN_MEASUREMENT Km_st Oz_lf1t /end IN_MEASUREMENT
/end FUNCTION
/begin FUNCTION CBSOZOUT "" /begin DEF_CHARACTERISTIC K_CW_CBS K_OZZYKCBS /end DEF_CHARACTERISTIC /begin REF_CHARACTERISTIC K_CW_CBSOZ K_OZKMUPL /end REF_CHARACTERISTIC
 /begin OUT_MEASUREMENT Bosbtvfbk Bosconf Bosfxid2 Bosid2 Bosjziel Bosmanip Bosmziel Bosprog2 Bosres Bosrlsm Bosrw2 Bosstate Bostoken Id_bosmg Id_bosmgt Id_bosmsg Oz_manip Oz_reset Oz_rwout Oz_rwpeil Oz_rwprout Oz_servcnt Oz_vfout Oz_zjahrout Oz_zmonout St_cbsozout0 St_cbsozout0.B_bosmsgc St_cbsozout0.B_ozbosanf St_cbsozout0.B_ozbosneu St_cbsozout0.B_ozbossend St_cbsozout0.B_ozneubos St_cbsozout_nv0 St_cbsozout_nv0.B_ozkl15 St_cbsozout_nv0.B_ozpeilerr Zrbosmld /end OUT_MEASUREMENT
 /begin IN_MEASUREMENT Km_st Oz_intprog Oz_manipt Oz_rwanz Oz_rwprog Oz_svcntchg Oz_vfanz Oz_zieljahr Oz_zielmon St_cbsozin0 St_cbsozin0.B_oelwech St_cbsozin0.B_ozmanip St_cbsozin0.B_ozvfchg St_cbsozin0.B_ozvfchgc St_cbsozin0.B_ozvfchgcc St_cbsozin0.B_ozvfchgt St_cbsozin0.B_ozzeitdmew St_cbsozin0.B_svcntchg St_cbsozin_nv0 St_cbsozin_nv0.B_dmeini St_cbsozin_nv0.B_dmewech St_cbsozin_nv0.B_factoryres /end IN_MEASUREMENT
/end FUNCTION
/begin FUNCTION common_30_69_ "" /begin SUB_FUNCTION LOLIMOT MLP SERVICES /end SUB_FUNCTION /end FUNCTION
/begin FUNCTION LOLIMOT "" /begin DEF_CHARACTERISTIC KL_E_FUNKTION /end DEF_CHARACTERISTIC /end FUNCTION
/begin FUNCTION MLP "" /begin DEF_CHARACTERISTIC KL_INVTANSIG KL_TANSIG /end DEF_CHARACTERISTIC /end FUNCTION
/begin FUNCTION SERVICES "" /begin DEF_CHARACTERISTIC K_FSP_ERRMASK K_FSP_ORT S_FSP_REP_TEST S_FSP_STAT_TEST /end DEF_CHARACTERISTIC
 /begin OUT_MEASUREMENT Fsp_rep_return Fsp_rep_return.F_rep_aktuell Fsp_rep_return.F_rep_bed_diag Fsp_rep_return.F_rep_gespeichert Fsp_rep_return.F_rep_im_filter Fsp_rep_return.F_rep_mil_an Fsp_rep_return.F_rep_momentan_vorhanden Fsp_rep_return.F_rep_readyneeflag Fsp_rep_return.F_rep_zyklusflag Fsp_rep_return.Fa_rep_Wert_zu_gross Fsp_rep_return.Fa_rep_Wert_zu_klein Fsp_rep_return.Fa_rep_kein_Signal Fsp_rep_return.Fa_rep_unplausibel Fsp_rep_test_hs Fsp_stat_return Fsp_stat_return.F_stat_aktuell Fsp_stat_return.F_stat_bed_diag Fsp_stat_return.F_stat_gespeichert Fsp_stat_return.F_stat_im_filter Fsp_stat_return.F_stat_mil_an Fsp_stat_return.F_stat_momentan_vorhanden Fsp_stat_return.F_stat_readyneeflag Fsp_stat_return.F_stat_zyklusflag Fsp_stat_return.Fa_stat_Wert_zu_gross Fsp_stat_return.Fa_stat_Wert_zu_klein Fsp_stat_return.Fa_stat_kein_Signal Fsp_stat_return.Fa_stat_unplausibel Fsp_stat_test_hs /end OUT_MEASUREMENT
/end FUNCTION
/begin FUNCTION vns_30_45_ "" /begin SUB_FUNCTION DEAVANOS EAVANOS EAVNSKT RESTGAS /end SUB_FUNCTION /end FUNCTION
/begin FUNCTION DEAVANOS ""
 /begin DEF_CHARACTERISTIC CW_DEAVANOS KL_VNSD_TOEL K_DSPRZG_AN K_NVNSAN K_NWADPOTO_DMX K_NWADP_MN K_NWADP_MX K_TVNSAN K_VNS_DELTMX K_VNS_ERRCNT K_VNS_ERRCNT1 K_VNS_ERR_NKW K_VNS_ERR_TMOT K_VNS_TMN K_VNS_TMX K_VNS_TPOEL K_VNS_TPOEL2 /end DEF_CHARACTERISTIC
 /begin REF_CHARACTERISTIC K_SPRZG_AN K_SPRZG_VB /end REF_CHARACTERISTIC
 /begin OUT_MEASUREMENT Dnwoto_mn Dnwoto_mx St_deavns St_deavns.B_an2wmn St_deavns.B_an2wpnp St_deavns.B_anwmn St_deavns.B_anwpnp St_deavns.B_en2wmn St_deavns.B_en2wpnp St_deavns.B_enwmn St_deavns.B_enwpnp St_deavns2 St_deavns2.B_an2woto St_deavns2.B_anwoto St_deavns2.B_en2woto St_deavns2.B_enwoto St_deavns2.B_vsa_an St_deavns2.B_vsa_an2 St_deavns2.B_vse_an St_deavns2.B_vse_an2 St_deavns3 St_deavns3.B_an2wmn_dis St_deavns3.B_an2wpnp_dis St_deavns3.B_anwmn_dis St_deavns3.B_anwpnp_dis St_deavns3.B_en2wmn_dis St_deavns3.B_en2wpnp_dis St_deavns3.B_enwmn_dis St_deavns3.B_enwpnp_dis St_deavns4 St_deavns4.B_an2woto_dis St_deavns4.B_anwoto_dis St_deavns4.B_en2woto_dis St_deavns4.B_enwoto_dis St_deavns5 St_deavns5.B_an2wmn_rbmc St_deavns5.B_an2wpnp_rbmc St_deavns5.B_anwmn_rbmc St_deavns5.B_anwpnp_rbmc St_deavns5.B_en2wmn_rbmc St_deavns5.B_en2wpnp_rbmc St_deavns5.B_enwmn_rbmc St_deavns5.B_enwpnp_rbmc St_deavns6 St_deavns6.B_an2wmn_rbmd St_deavns6.B_an2wpnp_rbmd St_deavns6.B_anwmn_rbmd St_deavns6.B_anwpnp_rbmd St_deavns6.B_en2wmn_rbmd St_deavns6.B_en2wpnp_rbmd St_deavns6.B_enwmn_rbmd St_deavns6.B_enwpnp_rbmd St_deavns7 St_deavns7.B_an2woto_err St_deavns7.B_anwoto_err St_deavns7.B_en2woto_err St_deavns7.B_enwoto_err St_deavns8 St_deavns8.B_an2wmn_dis_nv St_deavns8.B_an2woto_dis_nv St_deavns8.B_anwmn_dis_nv St_deavns8.B_anwoto_dis_nv St_deavns8.B_en2wmn_dis_nv St_deavns8.B_en2woto_dis_nv St_deavns8.B_enwmn_dis_nv St_deavns8.B_enwoto_dis_nv St_vns_poel St_vns_poel.B_poel_vns Vns_oto_adp Vnscnt Vnscnt_nio /end OUT_MEASUREMENT
 /begin IN_MEASUREMENT Nkw St_deavns2.B_an2woto St_deavns2.B_anwoto St_deavns2.B_en2woto St_deavns2.B_enwoto St_deavns2.B_vsa_an St_deavns2.B_vsa_an2 St_deavns2.B_vse_an St_deavns2.B_vse_an2 St_mkwchn St_mkwchn.B_kwdreht St_pwf St_pwf.B_pwf St_start St_start.B_jumpstart St_start.B_sta St_start.B_start St_start.B_startende St_start.B_wst St_vsa St_vsa.B_npos1dyn St_vsa.B_vsaadnok St_vsa.B_vsaadok St_vsa.B_vsaadp St_vsa.B_vsadyn St_vsa.B_vsaflan St_vsa.B_vsanwerr St_vsa.B_vsaspran St_vse St_vse.B_npos0dyn St_vse.B_vseadnok St_vse.B_vseadok St_vse.B_vseadp St_vse.B_vsedyn St_vse.B_vseflan St_vse.B_vsenwerr St_vse.B_vsespran Tmot Toel /end IN_MEASUREMENT
/end FUNCTION
/begin FUNCTION EAVANOS ""
 /begin DEF_CHARACTERISTIC CW_TVP CW_VNSABST CW_VNSDYN KL_RANWI KL_RANWP KL_RENWI KL_RENWP KL_TVP_A KL_TVP_E KL_VNSTMOT KL_VNSTVUB KL_VSAFPWM KL_VSA_ITMOT KL_VSEFPWM KL_VSE_ITMOT K_ASP2_ADPWF K_ASP_ADPWF K_ASP_ADTV K_ASP_BA K_ASP_TVHB K_ASP_WNWS K_DVNS_IREGOFF1 K_DVNS_IREGOFF2 K_ESP2_ADPWF K_ESP_ADPWF K_ESP_ADTV K_ESP_BA K_ESP_TVHB K_ESP_WNWS K_FPWM_ANS K_FPWM_STAND K_NMOTVNSAD K_RXWP_SLOW K_SPRZG_VB K_TVPSLOW_ERRCNT K_TVPSLOW_TMOT K_TVP_ANZMX K_TVP_ERRCNT K_TVP_SPERR K_TVP_TMOT K_TVP_TMX K_VNSKRITLOC K_VNSNMOTAN K_VNSRTVIMN K_VNSRTVIMX1 K_VNSRTVIMX2 K_VNSRTVMN K_VNSRTVMX K_VNSTVIABDY K_VNS_ADEND K_VNS_ADT K_VNS_ANAB K_VNS_DELTMX_IREG K_VNS_DYN K_VNS_NMVSTOP K_VNS_TMVSTOP K_VNS_TVINKW K_VNS_TVITMOT S_TVP_TRIG /end DEF_CHARACTERISTIC
 /begin REF_CHARACTERISTIC CW_EAVNSKT K_SPRZG_AN K_VNSADPEXT_OFF /end REF_CHARACTERISTIC
 /begin OUT_MEASUREMENT St_vns_tvp St_vns_tvp.B_vsa2tvp St_vns_tvp.B_vsa2tvp_sperr St_vns_tvp.B_vsatvp St_vns_tvp.B_vsatvp_sperr St_vns_tvp.B_vse2tvp St_vns_tvp.B_vse2tvp_sperr St_vns_tvp.B_vsetvp St_vns_tvp.B_vsetvp_sperr Vns_fpwm Vns_p_sum Vns_tv_cnt Vns_tv_p_slow Vns_tv_puls Vns_tvpz Vns_tvpz_sum Vnsfaktmot Vnsfaktvub Vsa2_sprs Vsa2_tv Vsa2_tv_i Vsa2_tv_p Vsa2dwnwkl Vsa2dwnwv Vsa_sprs Vsa_tv Vsa_tv_i Vsa_tv_p Vsadwnwkl Vsadwnwv Vse2_sprs Vse2_tv Vse2_tv_i Vse2_tv_p Vse2dwnwkl Vse2dwnwv Vse_sprs Vse_tv Vse_tv_i Vse_tv_p Vsedwnwkl Vsedwnwv /end OUT_MEASUREMENT
 /begin IN_MEASUREMENT Aspr Espr Nkw Nkw_zahn St_eavnskt St_eavnskt.B_vsa2_err St_eavnskt.B_vsa_err St_eavnskt.B_vse2_err St_eavnskt.B_vse_err St_kl15 St_kl15.B_kl15_ep St_kl15.B_kl15_vorab St_mkwchn St_mkwchn.B_kwdreht St_pwf St_pwf.B_pwf St_restg St_restg.B_ff_nvsaad St_restg.B_ff_nvsead St_restg.B_nvsaad St_restg.B_nvsead St_start St_start.B_jumpstart St_start.B_sta St_start.B_start St_start.B_startende St_start.B_wst Tmot Ub Vnscnt /end IN_MEASUREMENT
/end FUNCTION
/begin FUNCTION EAVNSKT ""
 /begin DEF_CHARACTERISTIC CW_EAVNSKT K_NWA2FLANKE K_NWAFLANKE K_NWE2FLANKE K_NWEFLANKE K_NWSEGOFFS K_NW_MIN K_SPRZG_AN K_VNSADPEXT_OFF S_VNSIWS /end DEF_CHARACTERISTIC
 /begin REF_CHARACTERISTIC CW_DEAVANOS /end REF_CHARACTERISTIC
 /begin OUT_MEASUREMENT Nw_posi St_eavnskt St_eavnskt.B_vsa2_err St_eavnskt.B_vsa_err St_eavnskt.B_vse2_err St_eavnskt.B_vse_err St_vsa St_vsa.B_npos1dyn St_vsa.B_vsaadnok St_vsa.B_vsaadok St_vsa.B_vsaadp St_vsa.B_vsadyn St_vsa.B_vsaflan St_vsa.B_vsanwerr St_vsa.B_vsaspran St_vsa2 St_vsa2.B_npos3dyn St_vsa2.B_vsa2adnok St_vsa2.B_vsa2adok St_vsa2.B_vsa2adp St_vsa2.B_vsa2dyn St_vsa2.B_vsa2flan St_vsa2.B_vsa2nwerr St_vsa2.B_vsa2spran St_vse St_vse.B_npos0dyn St_vse.B_vseadnok St_vse.B_vseadok St_vse.B_vseadp St_vse.B_vsedyn St_vse.B_vseflan St_vse.B_vsenwerr St_vse.B_vsespran St_vse2 St_vse2.B_npos2dyn St_vse2.B_vse2adnok St_vse2.B_vse2adok St_vse2.B_vse2adp St_vse2.B_vse2dyn St_vse2.B_vse2flan St_vse2.B_vse2nwerr St_vse2.B_vse2spran T_systemvns Vsa2_adp Vsa2_adp_fl Vsa2_spri Vsa2_vg Vsa2spris Vsa_adp Vsa_adp_fl Vsa_spri Vsa_vg Vsaspris Vse2_adp Vse2_adp_fl Vse2_spri Vse2_vg Vse2spris Vse_adp Vse_adp_fl Vse_spri Vse_vg Vsespris /end OUT_MEASUREMENT
 /begin IN_MEASUREMENT St_deavns6 St_deavns6.B_an2wmn_rbmd St_deavns6.B_an2wpnp_rbmd St_deavns6.B_anwmn_rbmd St_deavns6.B_anwpnp_rbmd St_deavns6.B_en2wmn_rbmd St_deavns6.B_en2wpnp_rbmd St_deavns6.B_enwmn_rbmd St_deavns6.B_enwpnp_rbmd /end IN_MEASUREMENT
/end FUNCTION
/end MODULE
/end PROJECT
