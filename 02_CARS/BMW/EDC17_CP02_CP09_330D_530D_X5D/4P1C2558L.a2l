/* MODASAP17: (V1.1.1 - 24.05.2005) Datei /home/mtm2wi/LetzeInt/P558_1C2.a2l bearbeitet: 30.05.2005 15:25:40 by system solaris*/
/* Erstellt von DAMOS++ V3.7-1 Win2000 */
ASAP2_VERSION 1 4
/begin PROJECT P_558 "EDC17_CP02"
/begin HEADER "" VERSION "V1C1" PROJECT_NO P_558 /end HEADER
/begin MODULE DIM ""
/begin MOD_PAR "EDC17_CP02" VERSION "V1C1" CUSTOMER_NO "11" USER "" PHONE_NO "" CPU_TYPE "TriCore" ECU "EDC17_CP02"
 /begin MEMORY_SEGMENT Pst80004000 "" RESERVED FLASH INTERN 0x80004000 0xBF74 -1 -1 -1 -1 -1 /begin IF_DATA ASAP1B_KWP2000 ADDRESS_MAPPING 0x80004000 0x4000 0xBF74 /end IF_DATA /end MEMORY_SEGMENT
 /begin MEMORY_SEGMENT Pst8000FF74 "" RESERVED FLASH INTERN 0x8000FF74 0x8C -1 -1 -1 -1 -1 /begin IF_DATA ASAP1B_KWP2000 ADDRESS_MAPPING 0x8000FF74 0xFF74 0x8C /end IF_DATA /end MEMORY_SEGMENT
 /begin MEMORY_SEGMENT Pst80080000 "" CODE FLASH INTERN 0x80080000 0xF7E78 -1 -1 -1 -1 -1 /begin IF_DATA ASAP1B_KWP2000 ADDRESS_MAPPING 0x80080000 0x80000 0xF7E78 /end IF_DATA
  /begin IF_DATA XCP
   /begin SEGMENT 0 0x01 0x00 0x00 0x00 /begin CHECKSUM XCP_ADD_12 MAX_BLOCK_SIZE 0xFFFFFFFF /end CHECKSUM
    /begin PAGE 0x00 ECU_ACCESS_WITH_XCP_ONLY XCP_READ_ACCESS_WITH_ECU_ONLY XCP_WRITE_ACCESS_NOT_ALLOWED /end PAGE
   /end SEGMENT
  /end IF_DATA
 /end MEMORY_SEGMENT
 /begin MEMORY_SEGMENT Pst80177E78 "" RESERVED FLASH INTERN 0x80177E78 0x8C -1 -1 -1 -1 -1 /begin IF_DATA ASAP1B_KWP2000 ADDRESS_MAPPING 0x80177E78 0x177E78 0x8C /end IF_DATA /end MEMORY_SEGMENT
 /begin MEMORY_SEGMENT Pst80020000 "" CODE FLASH INTERN 0x80020000 0x1FF74 -1 -1 -1 -1 -1 /begin IF_DATA ASAP1B_KWP2000 ADDRESS_MAPPING 0x80020000 0x20000 0x1FF74 /end IF_DATA
  /begin IF_DATA XCP
   /begin SEGMENT 1 0x01 0x00 0x00 0x00 /begin CHECKSUM XCP_ADD_12 MAX_BLOCK_SIZE 0xFFFFFFFF /end CHECKSUM
    /begin PAGE 0x00 ECU_ACCESS_WITH_XCP_ONLY XCP_READ_ACCESS_WITH_ECU_ONLY XCP_WRITE_ACCESS_NOT_ALLOWED /end PAGE
   /end SEGMENT
  /end IF_DATA
 /end MEMORY_SEGMENT
 /begin MEMORY_SEGMENT Pst8003FF74 "" RESERVED FLASH INTERN 0x8003FF74 0x8C -1 -1 -1 -1 -1 /begin IF_DATA ASAP1B_KWP2000 ADDRESS_MAPPING 0x8003FF74 0x3FF74 0x8C /end IF_DATA /end MEMORY_SEGMENT
 /begin MEMORY_SEGMENT Pst8007FE78 "" RESERVED FLASH INTERN 0x8007FE78 0x8C -1 -1 -1 -1 -1 /begin IF_DATA ASAP1B_KWP2000 ADDRESS_MAPPING 0x8007FE78 0x7FE78 0x8C /end IF_DATA /end MEMORY_SEGMENT
 /begin MEMORY_SEGMENT Pst80018000 "" RESERVED FLASH INTERN 0x80018000 0x7E74 -1 -1 -1 -1 -1 /begin IF_DATA ASAP1B_KWP2000 ADDRESS_MAPPING 0x80018000 0x18000 0x7E74 /end IF_DATA /end MEMORY_SEGMENT
 /begin MEMORY_SEGMENT Pst8001FE74 "" RESERVED FLASH INTERN 0x8001FE74 0x18C -1 -1 -1 -1 -1 /begin IF_DATA ASAP1B_KWP2000 ADDRESS_MAPPING 0x8001FE74 0x1FE74 0x18C /end IF_DATA /end MEMORY_SEGMENT
 /begin MEMORY_SEGMENT Pst80014000 "" RESERVED FLASH INTERN 0x80014000 0x3E74 -1 -1 -1 -1 -1 /begin IF_DATA ASAP1B_KWP2000 ADDRESS_MAPPING 0x80014000 0x14000 0x3E74 /end IF_DATA /end MEMORY_SEGMENT
 /begin MEMORY_SEGMENT Pst80017E74 "" RESERVED FLASH INTERN 0x80017E74 0x18C -1 -1 -1 -1 -1 /begin IF_DATA ASAP1B_KWP2000 ADDRESS_MAPPING 0x80017E74 0x17E74 0x18C /end IF_DATA /end MEMORY_SEGMENT
 /begin MEMORY_SEGMENT Pst80010000 "" RESERVED FLASH INTERN 0x80010000 0x4000 -1 -1 -1 -1 -1 /begin IF_DATA ASAP1B_KWP2000 ADDRESS_MAPPING 0x80010000 0x10000 0x4000 /end IF_DATA /end MEMORY_SEGMENT
 /begin MEMORY_SEGMENT Dst80040000 "" DATA FLASH INTERN 0x80040000 0x3FE78 -1 -1 -1 -1 -1 /begin IF_DATA ASAP1B_KWP2000 ADDRESS_MAPPING 0x80040000 0x40000 0x3FE78 /end IF_DATA
  /begin IF_DATA XCP
   /begin SEGMENT 2 0x02 0x00 0x00 0x00 /begin CHECKSUM XCP_ADD_12 MAX_BLOCK_SIZE 0xFFFFFFFF /end CHECKSUM
    /begin PAGE 0x00 ECU_ACCESS_DONT_CARE XCP_READ_ACCESS_DONT_CARE XCP_WRITE_ACCESS_NOT_ALLOWED /end PAGE
    /begin PAGE 0x01 ECU_ACCESS_DONT_CARE XCP_READ_ACCESS_DONT_CARE XCP_WRITE_ACCESS_WITH_ECU_ONLY /end PAGE
   /end SEGMENT
  /end IF_DATA
 /end MEMORY_SEGMENT
 /begin MEMORY_SEGMENT RamC0000000 "" VARIABLES RAM INTERN 0xC0000000 0x2000 -1 -1 -1 -1 -1 /begin IF_DATA ASAP1B_KWP2000 ADDRESS_MAPPING 0xC0000000 0x400000 0x2000 /end IF_DATA
  /begin IF_DATA XCP
   /begin SEGMENT 3 0x00 0x00 0x00 0x00 /end SEGMENT
  /end IF_DATA
 /end MEMORY_SEGMENT
 /begin MEMORY_SEGMENT RamD0000000 "" VARIABLES RAM INTERN 0xD0000000 0xE000 -1 -1 -1 -1 -1 /begin IF_DATA ASAP1B_KWP2000 ADDRESS_MAPPING 0xD0000000 0x500000 0xE000 /end IF_DATA
  /begin IF_DATA XCP
   /begin SEGMENT 4 0x00 0x00 0x00 0x00 /end SEGMENT
  /end IF_DATA
 /end MEMORY_SEGMENT
 /begin MEMORY_SEGMENT RamD4000000 "" VARIABLES RAM INTERN 0xD4000000 0x4000 -1 -1 -1 -1 -1 /begin IF_DATA ASAP1B_KWP2000 ADDRESS_MAPPING 0xD4000000 0x600000 0x4000 /end IF_DATA
  /begin IF_DATA XCP
   /begin SEGMENT 5 0x00 0x00 0x00 0x00 /end SEGMENT
  /end IF_DATA
 /end MEMORY_SEGMENT
 /begin MEMORY_SEGMENT RamF0060000 "" VARIABLES RAM INTERN 0xF0060000 0x3000 -1 -1 -1 -1 -1 /begin IF_DATA ASAP1B_KWP2000 ADDRESS_MAPPING 0xF0060000 0x660000 0x3000 /end IF_DATA
  /begin IF_DATA XCP
   /begin SEGMENT 6 0x00 0x00 0x00 0x00 /end SEGMENT
  /end IF_DATA
 /end MEMORY_SEGMENT
 /begin MEMORY_SEGMENT RamF0050000 "" VARIABLES RAM INTERN 0xF0050000 0x2000 -1 -1 -1 -1 -1 /begin IF_DATA ASAP1B_KWP2000 ADDRESS_MAPPING 0xF0050000 0x650000 0x2000 /end IF_DATA
  /begin IF_DATA XCP
   /begin SEGMENT 7 0x00 0x00 0x00 0x00 /end SEGMENT
  /end IF_DATA
 /end MEMORY_SEGMENT
 SYSTEM_CONSTANT "ACCD_PANALIN_CUR_X" "8"
 SYSTEM_CONSTANT "EXTERNAL HEXFILE POST TREATMENT NAME" "seed.dll"
 SYSTEM_CONSTANT "EXTERNAL HEXFILE POST TREATMENT PARAMETER" "BLK_START=0x80018000"
 SYSTEM_CONSTANT "ACCD_PPRESLIN_CUR_X" "8"
 SYSTEM_CONSTANT "ACCPED_TRQENG_MAP_X" "16"
 SYSTEM_CONSTANT "ACCPED_TRQENG_MAP_Y" "16"
 SYSTEM_CONSTANT "ACCPED_TRQPRP_MAP_X" "16"
 SYSTEM_CONSTANT "ACCPED_TRQPRP_MAP_Y" "16"
 SYSTEM_CONSTANT "ACC_NORM_FAC" "2777777.77777778"
 SYSTEM_CONSTANT "ACC_RES" "0.001"
 SYSTEM_CONSTANT "ACC_ZERO" "0"
 SYSTEM_CONSTANT "AC_GEAR" "8"
 SYSTEM_CONSTANT "AC_NOGEAR" "2"
 SYSTEM_CONSTANT "ADC_RES" "1023"
 SYSTEM_CONSTANT "ADC_RESOLUTION_BITS" "12"
 SYSTEM_CONSTANT "ADDHTR_CONST" "360"
 SYSTEM_CONSTANT "AFSCD_DMAIRSUBSVAL_MAP_X" "16"
 SYSTEM_CONSTANT "AFSCD_DMAIRSUBSVAL_MAP_Y" "16"
 SYSTEM_CONSTANT "AFSCD_DMLIN_CUR_X" "32"
 SYSTEM_CONSTANT "AFSCD_PLSCOR_MAP_X" "16"
 SYSTEM_CONSTANT "AFSCD_PLSCOR_MAP_Y" "16"
 SYSTEM_CONSTANT "AFSCD_QAIRMTHRSRCHIACTV_CUR_X" "25"
 SYSTEM_CONSTANT "AFSCD_TLIN_CUR_X" "25"
 SYSTEM_CONSTANT "AFS_MAIRCONV" "66666"
 SYSTEM_CONSTANT "AG_CRS_REV_SY" "16383.5"
 SYSTEM_CONSTANT "AIRCTL_ADD" "0"
 SYSTEM_CONSTANT "AIRCTL_AIRTEMPCORBAS_MAP_X" "16"
 SYSTEM_CONSTANT "AIRCTL_AIRTEMPCORBAS_MAP_Y" "16"
 SYSTEM_CONSTANT "AIRCTL_APSCOR_CUR_X" "25"
 SYSTEM_CONSTANT "AIRCTL_DKDNEGEOM_CUR_X" "8"
 SYSTEM_CONSTANT "AIRCTL_DKDNEG_CUR_X" "8"
 SYSTEM_CONSTANT "AIRCTL_DKDPOSEOM_CUR_X" "8"
 SYSTEM_CONSTANT "AIRCTL_DKDPOS_CUR_X" "12"
 SYSTEM_CONSTANT "AIRCTL_DNSURGEHIGH_CUR_X" "5"
 SYSTEM_CONSTANT "AIRCTL_DNSURGELOW_CUR_X" "5"
 SYSTEM_CONSTANT "AIRCTL_FACAIRTEMPCOR2_CUR_X" "16"
 SYSTEM_CONSTANT "AIRCTL_FACCTSCOR_CUR_X" "10"
 SYSTEM_CONSTANT "AIRCTL_FACIATSCOR_CUR_X" "10"
 SYSTEM_CONSTANT "AIRCTL_FACIATSPAR_CUR_X" "25"
 SYSTEM_CONSTANT "AIRCTL_FACNQPAR_MAP_X" "16"
 SYSTEM_CONSTANT "AIRCTL_FACNQPAR_MAP_Y" "16"
 SYSTEM_CONSTANT "AIRCTL_MAIRTEMPCORBAS2QNT_MAP_Y" "16"
 SYSTEM_CONSTANT "AIRCTL_MAIRTEMPCORBAS2TRQ_MAP_Y" "16"
 SYSTEM_CONSTANT "AIRCTL_MAIRTEMPCORBAS2_MAP_X" "16"
 SYSTEM_CONSTANT "AIRCTL_MDESBASDEFQNT_MAP_Y" "16"
 SYSTEM_CONSTANT "AIRCTL_MDESBASDEFTRQ_MAP_Y" "16"
 SYSTEM_CONSTANT "AIRCTL_MDESBASDEF_MAP_X" "16"
 SYSTEM_CONSTANT "AIRCTL_MDESBASHIALTDDEFQNT_MAP_Y" "16"
 SYSTEM_CONSTANT "AIRCTL_MDESBASHIALTDDEFTRQ_MAP_Y" "16"
 SYSTEM_CONSTANT "AIRCTL_MDESBASHIALTDDEF_MAP_X" "16"
 SYSTEM_CONSTANT "AIRCTL_MDESBAS_MAP_X" "16"
 SYSTEM_CONSTANT "AIRCTL_MDESBAS_MAP_Y" "16"
 SYSTEM_CONSTANT "AIRCTL_MDESGEAREOMQNT_MAP_Y" "4"
 SYSTEM_CONSTANT "AIRCTL_MDESGEAREOMTRQ_MAP_Y" "4"
 SYSTEM_CONSTANT "AIRCTL_MDESGEARQNT_MAP_Y" "4"
 SYSTEM_CONSTANT "AIRCTL_MDESGEARTRQ_MAP_Y" "4"
 SYSTEM_CONSTANT "AIRCTL_MDESGEAR_MAP_X" "4"
 SYSTEM_CONSTANT "AIRCTL_MDESSTRGCORREOM_MAP_X" "4"
 SYSTEM_CONSTANT "AIRCTL_MDESSTRGCORREOM_MAP_Y" "4"
 SYSTEM_CONSTANT "AIRCTL_MDESSTRGCORR_MAP_X" "4"
 SYSTEM_CONSTANT "AIRCTL_MDESSTRGCORR_MAP_Y" "4"
 SYSTEM_CONSTANT "AIRCTL_MMAXDVT_MAP_X" "14"
 SYSTEM_CONSTANT "AIRCTL_MMAXDVT_MAP_Y" "16"
 SYSTEM_CONSTANT "AIRCTL_MNQCTSCOR_MAP_X" "16"
 SYSTEM_CONSTANT "AIRCTL_MNQCTSCOR_MAP_Y" "16"
 SYSTEM_CONSTANT "AIRCTL_MUL" "1"
 SYSTEM_CONSTANT "AIRCTL_NQIATSCOR_MAP_X" "16"
 SYSTEM_CONSTANT "AIRCTL_NQIATSCOR_MAP_Y" "16"
 SYSTEM_CONSTANT "AIRCTL_NUMSTPRIOMON" "27"
 SYSTEM_CONSTANT "AIRCTL_QHI_CUR_X" "16"
 SYSTEM_CONSTANT "AIRCTL_QLO_CUR_X" "16"
 SYSTEM_CONSTANT "AIRCTL_QSURGEHIGH_CUR_X" "5"
 SYSTEM_CONSTANT "AIRCTL_QSURGELOW_CUR_X" "5"
 SYSTEM_CONSTANT "AIRCTL_RAT2PRC" "8192"
 SYSTEM_CONSTANT "AIRCTL_REGR_MAP_X" "8"
 SYSTEM_CONSTANT "AIRCTL_REGR_MAP_Y" "8"
 SYSTEM_CONSTANT "AIRCTL_RSURGEHIGH_MAP_X" "6"
 SYSTEM_CONSTANT "AIRCTL_RSURGEHIGH_MAP_Y" "4"
 SYSTEM_CONSTANT "AIRCTL_RSURGEOFS_CUR_X" "5"
 SYSTEM_CONSTANT "AIRCTL_RTVA_MAP_X" "2"
 SYSTEM_CONSTANT "AIRCTL_RTVA_MAP_Y" "2"
 SYSTEM_CONSTANT "AIRCTL_SWTAIRTEMPCOR_TYPE" "0"
 SYSTEM_CONSTANT "AIRCTL_SWTAIRTEMPCOR_VAL" "0"
 SYSTEM_CONSTANT "AIRCTL_SWTAPSCOR_TYPE" "0"
 SYSTEM_CONSTANT "AIRCTL_SWTAPSCOR_VAL" "0"
 SYSTEM_CONSTANT "AIRCTL_SWTGOV_TYPE" "2"
 SYSTEM_CONSTANT "AIRCTL_SWTGOV_VAL" "1"
 SYSTEM_CONSTANT "AIRCTL_SWTGVNR_TYPE" "2"
 SYSTEM_CONSTANT "AIRCTL_SWTGVNR_VAL" "1"
 SYSTEM_CONSTANT "AIRCTL_SWTIATSCOR_TYPE" "0"
 SYSTEM_CONSTANT "AIRCTL_SWTIATSCOR_VAL" "0"
 SYSTEM_CONSTANT "AIRCTL_SWTTRM_TYPE" "0"
 SYSTEM_CONSTANT "AIRCTL_SWTTRM_VAL" "0"
 SYSTEM_CONSTANT "AIRCTL_TICLDSTRT_CUR_X" "8"
 SYSTEM_CONSTANT "AIRFLRAT_RES" "0.005"
 SYSTEM_CONSTANT "AIRFLRAT_RES_REV" "200"
 SYSTEM_CONSTANT "AIRMASS_MAX" "5000"
 SYSTEM_CONSTANT "AIRMASS_MIN" "-5000"
 SYSTEM_CONSTANT "AIRMASS_ONE" "1"
 SYSTEM_CONSTANT "AIRMASS_ZERO" "0"
 SYSTEM_CONSTANT "AIRSYSSWT_RES" "6.103515625e-008"
 SYSTEM_CONSTANT "AIRSYSSWT_RES_S16" "6.103515625e-005"
 SYSTEM_CONSTANT "AIRSYS_CTFLD_NUM" "3"
 SYSTEM_CONSTANT "AIRSYS_RMPTIME_MIN" "1e-008"
 SYSTEM_CONSTANT "AIRSYS_RMP_MAX" "1"
 SYSTEM_CONSTANT "AIRSYS_RMP_MAX_S16" "1"
 SYSTEM_CONSTANT "AIRSYS_RMP_MIN" "0"
 SYSTEM_CONSTANT "AIRSYS_SWT_FACT" "16384000"
 SYSTEM_CONSTANT "AIRSYS_SWT_FACT_S16" "16384"
 SYSTEM_CONSTANT "AIRSYS_SWT_NRM_EXP" "14"
 SYSTEM_CONSTANT "AIR_KG_GM" "10"
 SYSTEM_CONSTANT "AIR_MASS_NORM" "66666"
 SYSTEM_CONSTANT "AMPC_NULL" "0"
 SYSTEM_CONSTANT "AMPC_RES" "0.1"
 SYSTEM_CONSTANT "AMPC_RES_FL" "0.1"
 SYSTEM_CONSTANT "AMPC_RES_REV" "10"
 SYSTEM_CONSTANT "AMPC_ZERO" "0"
 SYSTEM_CONSTANT "AMPT_NULL" "0"
 SYSTEM_CONSTANT "AMPT_RES" "0.1"
 SYSTEM_CONSTANT "AMPT_RES_FL" "0.1"
 SYSTEM_CONSTANT "AMPT_RES_REV" "10"
 SYSTEM_CONSTANT "AMPT_ZERO" "0"
 SYSTEM_CONSTANT "AM_RES" "0.01"
 SYSTEM_CONSTANT "AM_RES_2" "0.1"
 SYSTEM_CONSTANT "AM_RES_FL" "0.01"
 SYSTEM_CONSTANT "ANGLE_CPP_RES" "46601.9555555555"
 SYSTEM_CONSTANT "ANGLE_DER1" "16"
 SYSTEM_CONSTANT "ANGLE_DER1_ZERO" "0"
 SYSTEM_CONSTANT "ANGLE_DER2" "8"
 SYSTEM_CONSTANT "ANGLE_DER2_ZERO" "0"
 SYSTEM_CONSTANT "ANGLE_INDEX_CPP_RES" "1"
 SYSTEM_CONSTANT "ANGLE_RES" "45.5097222222222"
 SYSTEM_CONSTANT "ANGLE_RES_1" "32"
 SYSTEM_CONSTANT "ANGLE_RES_FL" "45.5097222222222"
 SYSTEM_CONSTANT "ANGLE_STWHL_RES" "0.03125"
 SYSTEM_CONSTANT "ANGLE_STWHL_RES_REV" "32"
 SYSTEM_CONSTANT "ANGLE_ZERO" "0"
 SYSTEM_CONSTANT "AOHT_TAIRUPLI_CUR_X" "25"
 SYSTEM_CONSTANT "APPCD_DUSYNC_CUR_X" "2"
 SYSTEM_CONSTANT "APPCD_RLINAPP1_CUR_X" "2"
 SYSTEM_CONSTANT "APPCD_RLINAPP2_CUR_X" "2"
 SYSTEM_CONSTANT "APPCD_RLINAPP_CUR_X" "2"
 SYSTEM_CONSTANT "APPLY" "4"
 SYSTEM_CONSTANT "APSCD_PCOR_MAP_X" "16"
 SYSTEM_CONSTANT "APSCD_PCOR_MAP_Y" "16"
 SYSTEM_CONSTANT "APSCD_PLIN_CUR_X" "25"
 SYSTEM_CONSTANT "AREA_CM2_MAX" "50"
 SYSTEM_CONSTANT "AREA_CM2_RES" "0.001"
 SYSTEM_CONSTANT "AREA_CM2_RES_FL" "0.001"
 SYSTEM_CONSTANT "AREA_CM2_RES_REV" "1000"
 SYSTEM_CONSTANT "AREA_CM2_ZERO" "0"
 SYSTEM_CONSTANT "ASDDC_BITMASK_AND" "1"
 SYSTEM_CONSTANT "ASDDC_BITMASK_NAND" "2"
 SYSTEM_CONSTANT "ASDDC_BITMASK_NOR" "3"
 SYSTEM_CONSTANT "ASDDC_BITMASK_OR" "0"
 SYSTEM_CONSTANT "ASDDC_CONDBITS" "2"
 SYSTEM_CONSTANT "ASDDC_CONDFALSE" "0"
 SYSTEM_CONSTANT "ASDDC_CONDMASK" "3"
 SYSTEM_CONSTANT "ASDDC_CONDTRUE" "3"
 SYSTEM_CONSTANT "ASDDC_COND_CONV1" "8"
 SYSTEM_CONSTANT "ASDDC_COND_CONV2" "16"
 SYSTEM_CONSTANT "ASDDC_COND_CONV3" "32"
 SYSTEM_CONSTANT "ASDDC_COND_CONV4" "64"
 SYSTEM_CONSTANT "ASDDC_COND_EXTINT" "1"
 SYSTEM_CONSTANT "ASDDC_COND_GEARSWITCH" "128"
 SYSTEM_CONSTANT "ASDDC_COND_GRIP" "4"
 SYSTEM_CONSTANT "ASDDC_COND_GRIPRAW" "2"
 SYSTEM_CONSTANT "ASDDC_FDT1PARAMMAP_KD_MAP_X" "16"
 SYSTEM_CONSTANT "ASDDC_FDT1PARAMMAP_KD_MAP_Y" "5"
 SYSTEM_CONSTANT "ASDDC_FDT1PARAMMAP_T1_MAP_X" "16"
 SYSTEM_CONSTANT "ASDDC_FDT1PARAMMAP_T1_MAP_Y" "5"
 SYSTEM_CONSTANT "ASDDC_GRIP_MAP_X" "16"
 SYSTEM_CONSTANT "ASDDC_GRIP_MAP_Y" "5"
 SYSTEM_CONSTANT "ASDDC_MAXNUMBEROFSTATES" "8"
 SYSTEM_CONSTANT "ASDDC_NOTUSECLUPS" "0"
 SYSTEM_CONSTANT "ASDDC_NUMBEROFSTATES" "5"
 SYSTEM_CONSTANT "ASDDC_STATE0" "1"
 SYSTEM_CONSTANT "ASDDC_STATE1" "2"
 SYSTEM_CONSTANT "ASDDC_STATE2" "4"
 SYSTEM_CONSTANT "ASDDC_STATE3" "8"
 SYSTEM_CONSTANT "ASDDC_STATE4" "16"
 SYSTEM_CONSTANT "ASDDC_STATE5" "32"
 SYSTEM_CONSTANT "ASDDC_USECLUPS" "1"
 SYSTEM_CONSTANT "ASDRF_BITMASK_AND" "1"
 SYSTEM_CONSTANT "ASDRF_BITMASK_NAND" "2"
 SYSTEM_CONSTANT "ASDRF_BITMASK_NOR" "3"
 SYSTEM_CONSTANT "ASDRF_BITMASK_OR" "0"
 SYSTEM_CONSTANT "ASDRF_CONDBITS" "2"
 SYSTEM_CONSTANT "ASDRF_CONDFALSE" "0"
 SYSTEM_CONSTANT "ASDRF_CONDMASK" "3"
 SYSTEM_CONSTANT "ASDRF_CONDTRUE" "3"
 SYSTEM_CONSTANT "ASDRF_COND_CONV1" "4"
 SYSTEM_CONSTANT "ASDRF_COND_CONV2" "8"
 SYSTEM_CONSTANT "ASDRF_COND_CONV3" "16"
 SYSTEM_CONSTANT "ASDRF_COND_CONV4" "32"
 SYSTEM_CONSTANT "ASDRF_COND_EXTINT" "1"
 SYSTEM_CONSTANT "ASDRF_COND_GRIP" "2"
 SYSTEM_CONSTANT "ASDRF_DECFIX" "2"
 SYSTEM_CONSTANT "ASDRF_DECFLOAT" "1"
 SYSTEM_CONSTANT "ASDRF_DECINACTIV" "0"
 SYSTEM_CONSTANT "ASDRF_DTRQINRLTDLIM_CUR_X" "5"
 SYSTEM_CONSTANT "ASDRF_INPHIGH" "1"
 SYSTEM_CONSTANT "ASDRF_INPLOW" "-1"
 SYSTEM_CONSTANT "ASDRF_INPSTEADY" "0"
 SYSTEM_CONSTANT "ASDRF_LIMIT_HIGH" "1"
 SYSTEM_CONSTANT "ASDRF_LIMIT_LOW" "0"
 SYSTEM_CONSTANT "ASDRF_MAXNUMBEROFSTATES" "8"
 SYSTEM_CONSTANT "ASDRF_NUMBEROFSTATES" "5"
 SYSTEM_CONSTANT "ASDRF_PARABLEPARAMCUR_COEFA_CUR_X" "16"
 SYSTEM_CONSTANT "ASDRF_PARABLEPARAMCUR_COEFB_CUR_X" "16"
 SYSTEM_CONSTANT "ASDRF_PRIOSTATE_UNDEF" "65535"
 SYSTEM_CONSTANT "ASDRF_STATE0" "1"
 SYSTEM_CONSTANT "ASDRF_STATE1" "2"
 SYSTEM_CONSTANT "ASDRF_STATE2" "4"
 SYSTEM_CONSTANT "ASDRF_STATE3" "8"
 SYSTEM_CONSTANT "ASDRF_STATE4" "16"
 SYSTEM_CONSTANT "ASDRF_STINIT_PDT1" "2"
 SYSTEM_CONSTANT "ASDRF_STINIT_PT1" "1"
 SYSTEM_CONSTANT "ASDRF_STLADNEG_ABOVE" "32"
 SYSTEM_CONSTANT "ASDRF_STLADNEG_ALLBIT" "240"
 SYSTEM_CONSTANT "ASDRF_STLADNEG_BELOW" "16"
 SYSTEM_CONSTANT "ASDRF_STLADNEG_INACTIVE" "64"
 SYSTEM_CONSTANT "ASDRF_STLADNEG_LIMIT" "48"
 SYSTEM_CONSTANT "ASDRF_STLADPOS_ABOVE" "2"
 SYSTEM_CONSTANT "ASDRF_STLADPOS_ALLBIT" "15"
 SYSTEM_CONSTANT "ASDRF_STLADPOS_BELOW" "1"
 SYSTEM_CONSTANT "ASDRF_STLADPOS_INACTIVE" "4"
 SYSTEM_CONSTANT "ASDRF_STLADPOS_LIMIT" "3"
 SYSTEM_CONSTANT "ASDRF_SWT_PT1" "0"
 SYSTEM_CONSTANT "ASDRF_TORQUE_ABSOLUT" "0"
 SYSTEM_CONSTANT "ASDRF_TORQUE_ADAPT" "1"
 SYSTEM_CONSTANT "ASDRF_TRQLOSNEG_CUR_X" "16"
 SYSTEM_CONSTANT "ASDRF_TRQLOSPOS_CUR_X" "16"
 SYSTEM_CONSTANT "ASDRF_XDT1PARAMCUR_KD_CUR_X" "16"
 SYSTEM_CONSTANT "ASDRF_XDT1PARAMCUR_T1_CUR_X" "16"
 SYSTEM_CONSTANT "ASD_TIME_DT_RES_FL" "1e-006"
 SYSTEM_CONSTANT "ASHMPT_RES" "0.01"
 SYSTEM_CONSTANT "ASMOD_ACCURACY_FACT1" "1000"
 SYSTEM_CONSTANT "ASMOD_ACCURACY_FACT2" "10"
 SYSTEM_CONSTANT "ASMOD_AREFFEGR_CUR_X" "12"
 SYSTEM_CONSTANT "ASMOD_AREFFTVA_CUR_X" "10"
 SYSTEM_CONSTANT "ASMOD_CNDHT_RES" "122070.3125"
 SYSTEM_CONSTANT "ASMOD_CT_PIPE" "3"
 SYSTEM_CONSTANT "ASMOD_CT_PIPESLW" "4"
 SYSTEM_CONSTANT "ASMOD_CT_PIPESLW_MAX" "4"
 SYSTEM_CONSTANT "ASMOD_CT_PIPE_MAX" "4"
 SYSTEM_CONSTANT "ASMOD_DELAY_ARRSIZE" "16"
 SYSTEM_CONSTANT "ASMOD_DMAIRCONV" "360"
 SYSTEM_CONSTANT "ASMOD_DMFUELBURNED_RES" "6896.55172413793"
 SYSTEM_CONSTANT "ASMOD_DMFUEL_RES" "66666.6666666667"
 SYSTEM_CONSTANT "ASMOD_DMIND_RES" "100"
 SYSTEM_CONSTANT "ASMOD_DMO2_RES" "10000"
 SYSTEM_CONSTANT "ASMOD_DVOLPFLTEG_RES" "347.826086956522"
 SYSTEM_CONSTANT "ASMOD_ENGN_VOLEFF" "1000"
 SYSTEM_CONSTANT "ASMOD_ETAEGRCLG_MAP_X" "6"
 SYSTEM_CONSTANT "ASMOD_ETAEGRCLG_MAP_Y" "3"
 SYSTEM_CONSTANT "ASMOD_ETATRBN_CUR_X" "8"
 SYSTEM_CONSTANT "ASMOD_EXHMASS_MAX" "500"
 SYSTEM_CONSTANT "ASMOD_EXHMASS_MIN" "0"
 SYSTEM_CONSTANT "ASMOD_FACAMCOR_RES" "122.0703125"
 SYSTEM_CONSTANT "ASMOD_FACINTMNFTEMPMSFLWCOR_MAP_X" "8"
 SYSTEM_CONSTANT "ASMOD_FACINTMNFTEMPMSFLWCOR_MAP_Y" "8"
 SYSTEM_CONSTANT "ASMOD_FACPRESLSEGRCLG_CUR_X" "3"
 SYSTEM_CONSTANT "ASMOD_FACRSTOICH" "14.5"
 SYSTEM_CONSTANT "ASMOD_FACSQR" "100"
 SYSTEM_CONSTANT "ASMOD_FACTOR1" "0.472336"
 SYSTEM_CONSTANT "ASMOD_FACTOR2" "0.47172"
 SYSTEM_CONSTANT "ASMOD_FACTOR3" "0.52828"
 SYSTEM_CONSTANT "ASMOD_FACVOLEFF" "1000"
 SYSTEM_CONSTANT "ASMOD_FACVOLEFF_MAP_X" "10"
 SYSTEM_CONSTANT "ASMOD_FACVOLEFF_MAP_Y" "10"
 SYSTEM_CONSTANT "ASMOD_FACVSACORVOLEFF_MAP_X" "4"
 SYSTEM_CONSTANT "ASMOD_FACVSACORVOLEFF_MAP_Y" "4"
 SYSTEM_CONSTANT "ASMOD_FAC_AIRMASSPERTIME" "3.6"
 SYSTEM_CONSTANT "ASMOD_FAC_AREA" "10000"
 SYSTEM_CONSTANT "ASMOD_FAC_DENS" "0.348432055749129"
 SYSTEM_CONSTANT "ASMOD_FAC_PRC" "100"
 SYSTEM_CONSTANT "ASMOD_FAC_PRES" "100"
 SYSTEM_CONSTANT "ASMOD_FAC_PSI" "36"
 SYSTEM_CONSTANT "ASMOD_FlAIREXHGS_RES" "10"
 SYSTEM_CONSTANT "ASMOD_HENG_RES" "348"
 SYSTEM_CONSTANT "ASMOD_IMPT2AMPT" "10"
 SYSTEM_CONSTANT "ASMOD_INDVOL_MAX" "50"
 SYSTEM_CONSTANT "ASMOD_INDVOL_MIN" "0"
 SYSTEM_CONSTANT "ASMOD_LAMBDAREC1" "3.35671375"
 SYSTEM_CONSTANT "ASMOD_MAIRCONV" "66666"
 SYSTEM_CONSTANT "ASMOD_MASS_NORM" "287.356321839081"
 SYSTEM_CONSTANT "ASMOD_MINDAIR" "445.44"
 SYSTEM_CONSTANT "ASMOD_NDELAY_RES" "1875000"
 SYSTEM_CONSTANT "ASMOD_NTRBCHRED_MAP_X" "16"
 SYSTEM_CONSTANT "ASMOD_NTRBCHRED_MAP_Y" "16"
 SYSTEM_CONSTANT "ASMOD_ONE_R32" "1"
 SYSTEM_CONSTANT "ASMOD_PINIT_MAX" "1100"
 SYSTEM_CONSTANT "ASMOD_PINIT_MIN" "900"
 SYSTEM_CONSTANT "ASMOD_QLMBD" "100"
 SYSTEM_CONSTANT "ASMOD_QSWTOUTOBSVRMAX_CUR_X" "8"
 SYSTEM_CONSTANT "ASMOD_QSWTOUTOBSVRMIN_CUR_X" "8"
 SYSTEM_CONSTANT "ASMOD_RASHEXHGS_RES" "10000"
 SYSTEM_CONSTANT "ASMOD_RBPALIN_CUR_X" "6"
 SYSTEM_CONSTANT "ASMOD_REGRLIN_CUR_X" "6"
 SYSTEM_CONSTANT "ASMOD_REGR_MAX" "1"
 SYSTEM_CONSTANT "ASMOD_REGR_MIN" "0"
 SYSTEM_CONSTANT "ASMOD_RFUELBURNED_RES" "100"
 SYSTEM_CONSTANT "ASMOD_RHOFL" "1"
 SYSTEM_CONSTANT "ASMOD_RLMBDREC" "1450"
 SYSTEM_CONSTANT "ASMOD_RNOXEXHGS_RES" "10000000"
 SYSTEM_CONSTANT "ASMOD_RO2EXHGS_RES" "10000"
 SYSTEM_CONSTANT "ASMOD_RSOTEXHGS_RES" "10000"
 SYSTEM_CONSTANT "ASMOD_RSOXEXHGS_RES" "100000"
 SYSTEM_CONSTANT "ASMOD_RTEMPDIFFTRBNADBT_CUR_X" "8"
 SYSTEM_CONSTANT "ASMOD_R_STOICH" "1450"
 SYSTEM_CONSTANT "ASMOD_SEC2HUNDREDHRS_RES" "36000000"
 SYSTEM_CONSTANT "ASMOD_TEMP1" "1000"
 SYSTEM_CONSTANT "ASMOD_TEMPKS" "12.8"
 SYSTEM_CONSTANT "ASMOD_TIDT1_MAX" "5"
 SYSTEM_CONSTANT "ASMOD_TIDT1_MIN" "0.05"
 SYSTEM_CONSTANT "ASMOD_TINDAIRREF_MAP_X" "10"
 SYSTEM_CONSTANT "ASMOD_TINDAIRREF_MAP_Y" "10"
 SYSTEM_CONSTANT "ASMOD_TINIT_MAX" "90"
 SYSTEM_CONSTANT "ASMOD_TINIT_MIN" "-30"
 SYSTEM_CONSTANT "ASMOD_TIPT1_MAX" "5"
 SYSTEM_CONSTANT "ASMOD_TIPT1_MIN" "0.05"
 SYSTEM_CONSTANT "ASMOD_VOL_NORM" "666.666666666667"
 SYSTEM_CONSTANT "ASMOD_VSCDYN_RES" "12207.03125"
 SYSTEM_CONSTANT "ASMOD_VSCKIN_RES" "1000"
 SYSTEM_CONSTANT "ASTINTVENG_NO" "0"
 SYSTEM_CONSTANT "ASTINTVENG_SY" "0"
 SYSTEM_CONSTANT "AVPT_RES" "0.1"
 SYSTEM_CONSTANT "BANK1" "0"
 SYSTEM_CONSTANT "BANK1_SY" "0"
 SYSTEM_CONSTANT "BANK2" "1"
 SYSTEM_CONSTANT "BANK2_SY" "1"
 SYSTEM_CONSTANT "BATTCD_ULIN_CUR_X" "25"
 SYSTEM_CONSTANT "BATTU_VOLT_MIN" "0"
 SYSTEM_CONSTANT "BATTU_ZERO_VOLT" "0"
 SYSTEM_CONSTANT "BPACD_DCYCCONV_CUR_X" "25"
 SYSTEM_CONSTANT "BPSCD_PLIN_CUR_X" "25"
 SYSTEM_CONSTANT "BRKPED_ACTV" "3"
 SYSTEM_CONSTANT "BRKPED_INACTV" "0"
 SYSTEM_CONSTANT "BRKPED_PSBLACTV" "1"
 SYSTEM_CONSTANT "BRKP_PRESS_DFL" "0"
 SYSTEM_CONSTANT "CALORIFIC_VALUE" "42.5"
 SYSTEM_CONSTANT "CALORY_RES" "1"
 SYSTEM_CONSTANT "CALORY_RES_REV" "1"
 SYSTEM_CONSTANT "CASCD_FACPLAUSHIGH_CUR_X" "12"
 SYSTEM_CONSTANT "CASCD_FACPLAUSLOW_CUR_X" "12"
 SYSTEM_CONSTANT "CAS_FAC_ADAP_SY" "1000"
 SYSTEM_CONSTANT "CAS_FAC_PLAUS_SY" "1000"
 SYSTEM_CONSTANT "CAS_MAX" "3"
 SYSTEM_CONSTANT "CHG_PA_RES" "1"
 SYSTEM_CONSTANT "CHG_PA_ZERO" "0"
 SYSTEM_CONSTANT "CLG_TIMAXDYNTST_CUR_X" "10"
 SYSTEM_CONSTANT "CMBCHB_CONST" "1000"
 SYSTEM_CONSTANT "CMBCHB_CT_ZERO" "0"
 SYSTEM_CONSTANT "CMBCHB_DISABLED" "0"
 SYSTEM_CONSTANT "CMBCHB_DIS_MISF_REC" "0"
 SYSTEM_CONSTANT "CMBCHB_DN_ZERO" "0"
 SYSTEM_CONSTANT "CMBCHB_ENABLED" "3"
 SYSTEM_CONSTANT "CMBCHB_EN_MISF_REC" "1"
 SYSTEM_CONSTANT "CMBCHB_MISF_NR_DFCS" "6"
 SYSTEM_CONSTANT "CMBCHB_NOT_PRESSED" "2"
 SYSTEM_CONSTANT "CMBCHB_ONERPM_SY" "1"
 SYSTEM_CONSTANT "CMBCHB_PHIMAX_SY" "720"
 SYSTEM_CONSTANT "CMBCHB_PRESSED" "1"
 SYSTEM_CONSTANT "CMBTYP_DS" "0"
 SYSTEM_CONSTANT "CMBTYP_GS" "1"
 SYSTEM_CONSTANT "CMBTYP_SY" "0"
 SYSTEM_CONSTANT "CnvAngleByNToInjTime" "18311.1056855983"
 SYSTEM_CONSTANT "COEFFA_MAX" "159.9951171875"
 SYSTEM_CONSTANT "COEFFA_MIN" "0"
 SYSTEM_CONSTANT "COEFFA_RES" "0.0048828125"
 SYSTEM_CONSTANT "COENG_STSHOFFIMMO" "7"
 SYSTEM_CONSTANT "COEOMSWT_RES" "6.103515625e-008"
 SYSTEM_CONSTANT "COEOMSWT_RES_S16" "6.103515625e-005"
 SYSTEM_CONSTANT "COEOM_AIRCTLQNTNUMMAP_SY" "1"
 SYSTEM_CONSTANT "COEOM_AIRCTLTRQNUMMAP_SY" "0"
 SYSTEM_CONSTANT "COEOM_EGRCLGQNTNUMMAP_SY" "2"
 SYSTEM_CONSTANT "COEOM_EGRCLGTRQNUMMAP_SY" "2"
 SYSTEM_CONSTANT "COEOM_INJCRVMI1NUMMAP_SY" "2"
 SYSTEM_CONSTANT "COEOM_INJCRVPII1NUMMAP_SY" "2"
 SYSTEM_CONSTANT "COEOM_INJCRVPII2NUMMAP_SY" "2"
 SYSTEM_CONSTANT "COEOM_INJCRVPII3NUMMAP_SY" "2"
 SYSTEM_CONSTANT "COEOM_INJCRVPOI1NUMMAP_SY" "2"
 SYSTEM_CONSTANT "COEOM_INJCRVPOI2NUMMAP_SY" "2"
 SYSTEM_CONSTANT "COEOM_MAX_OPMODE_BP" "15"
 SYSTEM_CONSTANT "COEOM_MAX_STAGE_NUM" "11"
 SYSTEM_CONSTANT "COEOM_NUM_MAX_OPMODE" "16"
 SYSTEM_CONSTANT "COEOM_NUM_MAX_STAGE" "11"
 SYSTEM_CONSTANT "COEOM_NUM_OPMODE_MAX" "16"
 SYSTEM_CONSTANT "COEOM_NUM_OPMODE_REQ" "8"
 SYSTEM_CONSTANT "COEOM_OPMODE_MAX_BP" "15"
 SYSTEM_CONSTANT "COEOM_OPMODE_REQ_NUM" "2"
 SYSTEM_CONSTANT "COEOM_PCRCTLAUTLPQNTNUMMAP_SY" "1"
 SYSTEM_CONSTANT "COEOM_PCRCTLAUTLPTRQNUMMAP_SY" "0"
 SYSTEM_CONSTANT "COEOM_PCRCTLLPQNTNUMMAP_SY" "1"
 SYSTEM_CONSTANT "COEOM_PCRCTLLPTRQNUMMAP_SY" "0"
 SYSTEM_CONSTANT "COEOM_PCRQNTNUMMAP_SY" "1"
 SYSTEM_CONSTANT "COEOM_PCRTRQNUMMAP_SY" "0"
 SYSTEM_CONSTANT "COEOM_RAILNUMMAP_SY" "2"
 SYSTEM_CONSTANT "COEOM_RMP_MAX" "1"
 SYSTEM_CONSTANT "COEOM_RMP_MAX_S16" "1"
 SYSTEM_CONSTANT "COEOM_RMP_MIN" "0"
 SYSTEM_CONSTANT "COEOM_SWT_FACT" "16384000"
 SYSTEM_CONSTANT "COEOM_SWT_FACT_S16" "16384"
 SYSTEM_CONSTANT "COEOM_SWT_NRM_EXP" "14"
 SYSTEM_CONSTANT "COEOM_TRANS_ARRAY_SIZE" "9"
 SYSTEM_CONSTANT "COEOM_TRANS_INL1" "0"
 SYSTEM_CONSTANT "COEOM_TRANS_INL2" "0"
 SYSTEM_CONSTANT "COEOM_TRANS_INL3" "0"
 SYSTEM_CONSTANT "COEOM_TRANS_INL4" "1"
 SYSTEM_CONSTANT "COEOM_TRANS_INL5" "0"
 SYSTEM_CONSTANT "COEOM_TRANS_INL6" "0"
 SYSTEM_CONSTANT "COEOM_TRANS_INL7" "0"
 SYSTEM_CONSTANT "COEOM_TRANS_INL8" "0"
 SYSTEM_CONSTANT "COEOM_TYP_SY" "1"
 SYSTEM_CONSTANT "COEOM_VSWCTLQNTNUMMAP_SY" "1"
 SYSTEM_CONSTANT "COEOM_VSWCTLTRQNUMMAP_SY" "0"
 SYSTEM_CONSTANT "COMPACCPED_OFF" "0"
 SYSTEM_CONSTANT "COMPACCPED_ON" "1"
 SYSTEM_CONSTANT "COMPACCPED_SY" "0"
 SYSTEM_CONSTANT "COM_STCLTH_ENG" "2"
 SYSTEM_CONSTANT "CONV_CALC_BP" "7"
 SYSTEM_CONSTANT "CONV_CONVACTV_BP" "0"
 SYSTEM_CONSTANT "CONV_GEAROFF_BP" "3"
 SYSTEM_CONSTANT "CONV_HR2SEC" "36"
 SYSTEM_CONSTANT "CONV_KD_16_TO_KD_32" "2.00006103701895"
 SYSTEM_CONSTANT "CONV_NTRBNCAN_BP" "1"
 SYSTEM_CONSTANT "CONV_T1_16_TO_1_T1_32" "28146638.6776064"
 SYSTEM_CONSTANT "CONV_TOIL_BP" "2"
 SYSTEM_CONSTANT "CONV_TRQLDCAN_BP" "0"
 SYSTEM_CONSTANT "CONV_TRQLDFLT_BP" "4"
 SYSTEM_CONSTANT "CONV_TRQRESVBRKEND_BP" "6"
 SYSTEM_CONSTANT "CONV_TRQRESVLVROFF_BP" "5"
 SYSTEM_CONSTANT "COPT_STNSETP_ACS_FLT" "0"
 SYSTEM_CONSTANT "COPT_STNSETP_ACS_TIPIN" "2"
 SYSTEM_CONSTANT "COPT_STNSETP_ACS_UNFLT" "1"
 SYSTEM_CONSTANT "COPT_STNSETP_SYSERR_FLT" "0"
 SYSTEM_CONSTANT "COPT_STNSETP_SYSERR_TIPIN" "2"
 SYSTEM_CONSTANT "COPT_STNSETP_SYSERR_UNFLT" "1"
 SYSTEM_CONSTANT "COPT_STNSETP_TRA_FLT" "0"
 SYSTEM_CONSTANT "COPT_STNSETP_TRA_TIPIN" "2"
 SYSTEM_CONSTANT "COPT_STNSETP_TRA_UNFLT" "1"
 SYSTEM_CONSTANT "COPT_TRADEC_BP" "2"
 SYSTEM_CONSTANT "COPT_TRAINC_BP" "1"
 SYSTEM_CONSTANT "COPT_TRAPRT_BP" "0"
 SYSTEM_CONSTANT "COTEMP_RCLGDES_CUR_X" "5"
 SYSTEM_CONSTANT "COTEMP_TENGDESBASENTRQ_MAP_X" "10"
 SYSTEM_CONSTANT "COTEMP_TENGDESBASENTRQ_MAP_Y" "10"
 SYSTEM_CONSTANT "COTEMP_TENGDESBASETEMPVEL_MAP_X" "6"
 SYSTEM_CONSTANT "COTEMP_TENGDESBASETEMPVEL_MAP_Y" "8"
 SYSTEM_CONSTANT "COTS_TEMP_ZERO" "0"
 SYSTEM_CONSTANT "COVEH_TRQLIM_CUR_X" "25"
 SYSTEM_CONSTANT "COVMD_ACCI" "2"
 SYSTEM_CONSTANT "COVMD_CRCTL" "1"
 SYSTEM_CONSTANT "CPPFEAT_FACT" "1256.637061436"
 SYSTEM_CONSTANT "CPP_ANGLE1_POSTTDC" "-150"
 SYSTEM_CONSTANT "CPP_ANGLE2_POSTTDC" "-5"
 SYSTEM_CONSTANT "CPP_ANGLE_MAX" "-179"
 SYSTEM_CONSTANT "CPP_ANGLE_MIN" "180"
 SYSTEM_CONSTANT "CPP_ANGLE_ZERO" "0"
 SYSTEM_CONSTANT "CPP_FACT" "1024"
 SYSTEM_CONSTANT "CPP_FACT1" "16"
 SYSTEM_CONSTANT "CPP_FACT1_EXP" "4"
 SYSTEM_CONSTANT "CPP_FACT_EXP" "10"
 SYSTEM_CONSTANT "CPP_FAC_VOL_CYL_RES" "3.0517578125e-005"
 SYSTEM_CONSTANT "CPP_FAC_VOL_CYL_RES_REV" "32768"
 SYSTEM_CONSTANT "CPP_HTRLSRATE_ANGLE_OFS" "175"
 SYSTEM_CONSTANT "CPP_HTRLS_ANGLE_OFS" "174"
 SYSTEM_CONSTANT "CPP_HT_RLS_OFS" "-6"
 SYSTEM_CONSTANT "CPP_HT_RLS_RATE_FLT_OFS" "-5"
 SYSTEM_CONSTANT "CPP_HT_RLS_RATE_FLT_ORD_MAX" "4"
 SYSTEM_CONSTANT "CPP_HT_RLS_RATE_OFS" "-1"
 SYSTEM_CONSTANT "CPP_MAX_FLT_ORD" "32"
 SYSTEM_CONSTANT "CPP_NUMCYLMAX_SY" "6"
 SYSTEM_CONSTANT "CPP_OFS_FACT_RES" "0.00390625"
 SYSTEM_CONSTANT "CPP_OFS_FACT_RES_REV" "256"
 SYSTEM_CONSTANT "CPP_PRESCALC_CUR_SIZE" "33"
 SYSTEM_CONSTANT "CPP_PRESCALC_EXP" "5"
 SYSTEM_CONSTANT "CPP_PRESCALC_EXP1" "7"
 SYSTEM_CONSTANT "CRCTL_ASHOFFRMP_SY" "0.002"
 SYSTEM_CONSTANT "CRCTL_DVACCG3_CUR_X" "5"
 SYSTEM_CONSTANT "CRCTL_DVACCG4_CUR_X" "5"
 SYSTEM_CONSTANT "CRCTL_DVACCG5_CUR_X" "5"
 SYSTEM_CONSTANT "CRCTL_DVACCG6_CUR_X" "5"
 SYSTEM_CONSTANT "CRCTL_DVDECLG3_CUR_X" "5"
 SYSTEM_CONSTANT "CRCTL_DVDECLG4_CUR_X" "5"
 SYSTEM_CONSTANT "CRCTL_DVDECLG5_CUR_X" "5"
 SYSTEM_CONSTANT "CRCTL_DVDECLG6_CUR_X" "5"
 SYSTEM_CONSTANT "CRCTL_DVRESABVG3_MAP_X" "2"
 SYSTEM_CONSTANT "CRCTL_DVRESABVG3_MAP_Y" "2"
 SYSTEM_CONSTANT "CRCTL_DVRESABVG4_MAP_X" "2"
 SYSTEM_CONSTANT "CRCTL_DVRESABVG4_MAP_Y" "2"
 SYSTEM_CONSTANT "CRCTL_DVRESABVG5_MAP_X" "2"
 SYSTEM_CONSTANT "CRCTL_DVRESABVG5_MAP_Y" "2"
 SYSTEM_CONSTANT "CRCTL_DVRESABVG6_MAP_X" "2"
 SYSTEM_CONSTANT "CRCTL_DVRESABVG6_MAP_Y" "2"
 SYSTEM_CONSTANT "CRCTL_DVRESBLWG3_MAP_X" "2"
 SYSTEM_CONSTANT "CRCTL_DVRESBLWG3_MAP_Y" "2"
 SYSTEM_CONSTANT "CRCTL_DVRESBLWG4_MAP_X" "2"
 SYSTEM_CONSTANT "CRCTL_DVRESBLWG4_MAP_Y" "2"
 SYSTEM_CONSTANT "CRCTL_DVRESBLWG5_MAP_X" "2"
 SYSTEM_CONSTANT "CRCTL_DVRESBLWG5_MAP_Y" "2"
 SYSTEM_CONSTANT "CRCTL_DVRESBLWG6_MAP_X" "2"
 SYSTEM_CONSTANT "CRCTL_DVRESBLWG6_MAP_Y" "2"
 SYSTEM_CONSTANT "CRCTL_IDXNOSHOFF_SY" "0"
 SYSTEM_CONSTANT "CRCTL_IDXSHOFFIRVRS_SY" "12"
 SYSTEM_CONSTANT "CRCTL_IDXSHOFFRVRS_SY" "6"
 SYSTEM_CONSTANT "CRCTL_STPTD_SY" "60"
 SYSTEM_CONSTANT "CRCTL_TRANS_ACC2CRUISE_MSK" "8"
 SYSTEM_CONSTANT "CRCTL_TRANS_CONT2ACC_MSK" "6"
 SYSTEM_CONSTANT "CRCTL_TRANS_CONT2DEC_MSK" "7"
 SYSTEM_CONSTANT "CRCTL_TRANS_CONTR2SET_MSK" "12"
 SYSTEM_CONSTANT "CRCTL_TRANS_CRUISE2TIPDOWN_MSK" "5"
 SYSTEM_CONSTANT "CRCTL_TRANS_CRUISE2TIPUP_MSK" "4"
 SYSTEM_CONSTANT "CRCTL_TRANS_DEC2CRUISE_MSK" "9"
 SYSTEM_CONSTANT "CRCTL_TRANS_OFF2ACC_MSK" "2"
 SYSTEM_CONSTANT "CRCTL_TRANS_OFF2CRUISE_MSK" "1"
 SYSTEM_CONSTANT "CRCTL_TRANS_OFF2DEC_MSK" "3"
 SYSTEM_CONSTANT "CRCTL_TRANS_OFF2RESUME_MSK" "0"
 SYSTEM_CONSTANT "CRCTL_TRANS_TIPDOWN2CRUISE_MSK" "11"
 SYSTEM_CONSTANT "CRCTL_TRANS_TIPUP2SET_MSK" "10"
 SYSTEM_CONSTANT "CRCUI_BPACC_MSK" "5"
 SYSTEM_CONSTANT "CRCUI_BPCNCL_MSK" "1"
 SYSTEM_CONSTANT "CRCUI_BPDEC_MSK" "6"
 SYSTEM_CONSTANT "CRCUI_BPMINUS_MSK" "4"
 SYSTEM_CONSTANT "CRCUI_BPMNSWT_MSK" "0"
 SYSTEM_CONSTANT "CRCUI_BPPLUS_MSK" "3"
 SYSTEM_CONSTANT "CRCUI_BPRES_MSK" "7"
 SYSTEM_CONSTANT "CRCUI_BPSET_MSK" "2"
 SYSTEM_CONSTANT "CRSCD_FACGAPPLAUSHIGH_CUR_X" "10"
 SYSTEM_CONSTANT "CRSCD_FACGAPPLAUSLOW_CUR_X" "10"
 SYSTEM_CONSTANT "CRSCD_FACINCPLAUSHIGH_CUR_X" "10"
 SYSTEM_CONSTANT "CRSCD_FACINCPLAUSLOW_CUR_X" "10"
 SYSTEM_CONSTANT "CRSCD_PHIINCCOR_CUR_X" "12"
 SYSTEM_CONSTANT "CRS_TO_CAS" "2"
 SYSTEM_CONSTANT "CTL_NEG" "3"
 SYSTEM_CONSTANT "CTL_POS" "2"
 SYSTEM_CONSTANT "CTL_ZFC" "6"
 SYSTEM_CONSTANT "CTSCD_TLIN_CUR_X" "25"
 SYSTEM_CONSTANT "CURR_A_RES" "0.01"
 SYSTEM_CONSTANT "CURR_PA_MAX" "30000"
 SYSTEM_CONSTANT "CURR_PA_MIN" "-30000"
 SYSTEM_CONSTANT "CURR_PA_ZERO" "0"
 SYSTEM_CONSTANT "CURR_RES" "1"
 SYSTEM_CONSTANT "CURR_RMP_RES_SY" "6553.6"
 SYSTEM_CONSTANT "CYLFLTPRM_REC_NRM_EXP" "15"
 SYSTEM_CONSTANT "CYLFLTPRM_REC_RES" "32767"
 SYSTEM_CONSTANT "CYLHTRLSRATE_NRM_EXP" "6"
 SYSTEM_CONSTANT "CYLHTRLSRATE_RES" "0.015625"
 SYSTEM_CONSTANT "CYLHTRLSRATE_RES_REV" "64"
 SYSTEM_CONSTANT "CYLHTRLS_NRM_EXP" "2"
 SYSTEM_CONSTANT "CYLHTRLS_RES" "0.25"
 SYSTEM_CONSTANT "CYLHTRLS_RES_REV" "4"
 SYSTEM_CONSTANT "CYLINDER_VOLUME_RES" "1e-006"
 SYSTEM_CONSTANT "CYLK1_RES" "0.0078125"
 SYSTEM_CONSTANT "CYLK1_RES_REV" "128"
 SYSTEM_CONSTANT "CYLK2_REC_NRM_EXP" "14"
 SYSTEM_CONSTANT "CYLK2_REC_RES" "16384"
 SYSTEM_CONSTANT "CYLPRESVOLT_RES" "0.805860805860806"
 SYSTEM_CONSTANT "CYLPRES_HTRLSRATE_CONV" "200"
 SYSTEM_CONSTANT "CYLPRES_K2_HTRLSRATE_CONV" "3276800"
 SYSTEM_CONSTANT "CYLPRES_RES" "0.01"
 SYSTEM_CONSTANT "CYLPRES_RES_REV" "100"
 SYSTEM_CONSTANT "CYL_FAC_NORM" "33333"
 SYSTEM_CONSTANT "CYL_MAX" "6"
 SYSTEM_CONSTANT "DCSOVRDSDFFTLPRT_SY" "0"
 SYSTEM_CONSTANT "DCSOVRDSENGPRT_SY" "0"
 SYSTEM_CONSTANT "DCSOVRDSTRAPRT_SY" "0"
 SYSTEM_CONSTANT "DCSOVRDSTSCDEC_SY" "0"
 SYSTEM_CONSTANT "DCS_OVRDS_DFFTLPRT" "1"
 SYSTEM_CONSTANT "DCS_OVRDS_ENGPRT" "1"
 SYSTEM_CONSTANT "DCS_OVRDS_TRAPRT" "1"
 SYSTEM_CONSTANT "DCS_OVRDS_TSCDEC" "1"
 SYSTEM_CONSTANT "DDVOL_RES" "10"
 SYSTEM_CONSTANT "DELAY" "5"
 SYSTEM_CONSTANT "DELTA_PRES_FAC" "250000"
 SYSTEM_CONSTANT "DELTA_P_PER_TIME_NBR" "5"
 SYSTEM_CONSTANT "DEVLIB_4WINDIA_TYP_CTLLN" "0"
 SYSTEM_CONSTANT "DEVLIB_4WINDIA_TYP_DIGIN" "1"
 SYSTEM_CONSTANT "DEVLIB_4WINDIA_TYP_EXT" "2"
 SYSTEM_CONSTANT "DEVLIB_4WINDIA_TYP_NONE" "3"
 SYSTEM_CONSTANT "DEWDET_WTHRESLSUAXISPNT0_MAP_X" "10"
 SYSTEM_CONSTANT "DEWDET_WTHRESLSUAXISPNT0_MAP_Y" "10"
 SYSTEM_CONSTANT "DEWDET_WTHRESLSUAXISPNT1_MAP_X" "10"
 SYSTEM_CONSTANT "DEWDET_WTHRESLSUAXISPNT1_MAP_Y" "10"
 SYSTEM_CONSTANT "DEWDET_WTHRESLSUAXISPNT2_MAP_X" "10"
 SYSTEM_CONSTANT "DEWDET_WTHRESLSUAXISPNT2_MAP_Y" "10"
 SYSTEM_CONSTANT "DEWDET_WTHRESLSUAXISPNT3_MAP_X" "10"
 SYSTEM_CONSTANT "DEWDET_WTHRESLSUAXISPNT3_MAP_Y" "10"
 SYSTEM_CONSTANT "DFFTLPRTOVRDSTSCINC_SY" "1"
 SYSTEM_CONSTANT "DFFTLPRT_ACTV" "1"
 SYSTEM_CONSTANT "DFFTLPRT_INACTV" "0"
 SYSTEM_CONSTANT "DFFTLPRT_OVRDS_DCS" "0"
 SYSTEM_CONSTANT "DFFTLPRT_OVRDS_TSCINC" "1"
 SYSTEM_CONSTANT "DIFFIO_STCFG_SUBSVALPRTTRQ_BP" "0"
 SYSTEM_CONSTANT "DIFFIO_STCFG_SUBSVALTRQRAT_BP" "1"
 SYSTEM_CONSTANT "DIUMPR_NUM_GROUPS_SY" "8"
 SYSTEM_CONSTANT "DIV_INJTIME_US" "2"
 SYSTEM_CONSTANT "DM_NOX2SOOT" "15"
 SYSTEM_CONSTANT "DM_NOX_100" "100"
 SYSTEM_CONSTANT "DM_NOX_RES" "0.15"
 SYSTEM_CONSTANT "DM_NOX_RES_100" "15"
 SYSTEM_CONSTANT "DM_NOX_RES_REV" "6.66666666666667"
 SYSTEM_CONSTANT "DM_OILASH_RES" "0.01"
 SYSTEM_CONSTANT "DM_OILASH_RES_REV" "100"
 SYSTEM_CONSTANT "DM_SOOT_MAX" "327"
 SYSTEM_CONSTANT "DM_SOOT_MIN" "0"
 SYSTEM_CONSTANT "DM_SOOT_RES" "0.01"
 SYSTEM_CONSTANT "DM_SOOT_RES_REV" "100"
 SYSTEM_CONSTANT "DN_DZFINE_RES" "0.5"
 SYSTEM_CONSTANT "DPDIFFTMP_RES" "100"
 SYSTEM_CONSTANT "DPDIFF_RES" "0.1"
 SYSTEM_CONSTANT "DPRES_RES" "1"
 SYSTEM_CONSTANT "DSCHED_SIZE_FUNCT_TAB" "7"
 SYSTEM_CONSTANT "DSCHED_SIZE_SLEEP_TAB" "5"
 SYSTEM_CONSTANT "DSCHED_SIZE_WTT_TAB" "5"
 SYSTEM_CONSTANT "DSMRDY_SIZE_LST_AC" "10"
 SYSTEM_CONSTANT "DSMRDY_SIZE_LST_Cat" "10"
 SYSTEM_CONSTANT "DSMRDY_SIZE_LST_ComprCmpnt" "40"
 SYSTEM_CONSTANT "DSMRDY_SIZE_LST_EGR" "25"
 SYSTEM_CONSTANT "DSMRDY_SIZE_LST_EvpSys" "10"
 SYSTEM_CONSTANT "DSMRDY_SIZE_LST_FlSys" "20"
 SYSTEM_CONSTANT "DSMRDY_SIZE_LST_HtCat" "10"
 SYSTEM_CONSTANT "DSMRDY_SIZE_LST_Misf" "10"
 SYSTEM_CONSTANT "DSMRDY_SIZE_LST_O2Sens" "10"
 SYSTEM_CONSTANT "DSMRDY_SIZE_LST_O2SensHt" "10"
 SYSTEM_CONSTANT "DSMRDY_SIZE_LST_SecAirSys" "10"
 SYSTEM_CONSTANT "DT1INITI_ZERO_SY" "0"
 SYSTEM_CONSTANT "DT1INITO_ZERO_SY" "0"
 SYSTEM_CONSTANT "DTRQ_MAX" "2000"
 SYSTEM_CONSTANT "DTRQ_MIN" "-2000"
 SYSTEM_CONSTANT "DTRQ_RES" "0.1"
 SYSTEM_CONSTANT "DTRQ_ZERO" "0"
 SYSTEM_CONSTANT "DTR_FACT_EXP" "13"
 SYSTEM_CONSTANT "DTR_FACT_RES" "0"
 SYSTEM_CONSTANT "DTR_FACT_RES_REV" "8192"
 SYSTEM_CONSTANT "DTY_CYC_10" "10"
 SYSTEM_CONSTANT "DTY_CYC_100" "100"
 SYSTEM_CONSTANT "DTY_CYC_150" "1.5"
 SYSTEM_CONSTANT "DTY_CYC_25" "25"
 SYSTEM_CONSTANT "DTY_CYC_33" "33.33"
 SYSTEM_CONSTANT "DTY_CYC_5" "5"
 SYSTEM_CONSTANT "DTY_CYC_FAC" "1.95503421309873"
 SYSTEM_CONSTANT "DTY_CYC_MAX" "100"
 SYSTEM_CONSTANT "DTY_CYC_MIN" "0"
 SYSTEM_CONSTANT "DTY_CYC_RES" "0.01"
 SYSTEM_CONSTANT "DTY_CYC_RES_REV" "100"
 SYSTEM_CONSTANT "DVOL_MAX" "3000"
 SYSTEM_CONSTANT "DVOL_MIN" "0"
 SYSTEM_CONSTANT "DVOL_RES" "0.1"
 SYSTEM_CONSTANT "DVOL_RES_FL" "0.1"
 SYSTEM_CONSTANT "DVOL_RES_INV" "10"
 SYSTEM_CONSTANT "DX_WAIT" "2"
 SYSTEM_CONSTANT "DYN_TST_TIME_FACT" "256"
 SYSTEM_CONSTANT "D_FLCONS_RES" "0.01"
 SYSTEM_CONSTANT "EATSCD_TLIN_CUR_X" "25"
 SYSTEM_CONSTANT "ECUOFF_TMR_SY" "1"
 SYSTEM_CONSTANT "EGRCD_DCYCEGR_MAP_X" "16"
 SYSTEM_CONSTANT "EGRCD_DCYCEGR_MAP_Y" "16"
 SYSTEM_CONSTANT "EGRCLG_CLGOFF_CUR_X" "25"
 SYSTEM_CONSTANT "EGRCLG_CLGON_CUR_X" "25"
 SYSTEM_CONSTANT "EGRCLG_NUMSTPRIOMON" "3"
 SYSTEM_CONSTANT "EGRVLVHP" "0"
 SYSTEM_CONSTANT "EGRVLVHPLPCOMBO" "1"
 SYSTEM_CONSTANT "EGRVLVTYPE" "0"
 SYSTEM_CONSTANT "EGTFACT_RES" "0.001"
 SYSTEM_CONSTANT "EGTSWT_FACT" "16384000"
 SYSTEM_CONSTANT "EGTSWT_FACT_S16" "16384"
 SYSTEM_CONSTANT "EGTSWT_NRM_EXP" "14"
 SYSTEM_CONSTANT "EGTSWT_RES" "6.103515625e-008"
 SYSTEM_CONSTANT "EGTSWT_RES_S16" "6.103515625e-005"
 SYSTEM_CONSTANT "EGT_FACT" "0"
 SYSTEM_CONSTANT "EGT_FACTMAX" "1"
 SYSTEM_CONSTANT "EGT_LIMMAX" "1"
 SYSTEM_CONSTANT "EGT_LIMMIN" "-1"
 SYSTEM_CONSTANT "EGT_NUMRGNSTG" "2"
 SYSTEM_CONSTANT "EGT_STATE" "1"
 SYSTEM_CONSTANT "EGT_SWTRGN_VAL" "0"
 SYSTEM_CONSTANT "EGT_SWT_DISABLED" "0"
 SYSTEM_CONSTANT "EGT_SWT_ENABLED" "1"
 SYSTEM_CONSTANT "EGT_ZERO" "0"
 SYSTEM_CONSTANT "EISDEM_NSETPOINTINIT_CUR_X" "25"
 SYSTEM_CONSTANT "EISDEM_TIPT1_CUR_X" "25"
 SYSTEM_CONSTANT "EISDEM_TRQINITI_CUR_X" "25"
 SYSTEM_CONSTANT "EISGOV_TIPT1TRQFLT_CUR_X" "25"
 SYSTEM_CONSTANT "EMDMP_NUM_PS" "1"
 SYSTEM_CONSTANT "ENERGY_RES" "1"
 SYSTEM_CONSTANT "ENGDA_CTFLD_NUM" "3"
 SYSTEM_CONSTANT "ENGDA_TFLD_TCLNT_POS" "0"
 SYSTEM_CONSTANT "ENGDA_TFLD_TENG_POS" "2"
 SYSTEM_CONSTANT "ENGDA_TFLD_TOIL_POS" "1"
 SYSTEM_CONSTANT "ENGDEM_RMP_ACTV_BP" "1"
 SYSTEM_CONSTANT "ENGDEM_RMP_POS_BP" "0"
 SYSTEM_CONSTANT "ENGDEM_TRQLIMERR_CUR_X" "25"
 SYSTEM_CONSTANT "ENGICO_COMFORT_MSK" "1"
 SYSTEM_CONSTANT "ENGM_NUMCYL_10" "10"
 SYSTEM_CONSTANT "ENGM_NUMCYL_3" "3"
 SYSTEM_CONSTANT "ENGM_NUMCYL_4" "4"
 SYSTEM_CONSTANT "ENGM_NUMCYL_5" "5"
 SYSTEM_CONSTANT "ENGM_NUMCYL_6" "6"
 SYSTEM_CONSTANT "ENGM_NUMCYL_8" "8"
 SYSTEM_CONSTANT "ENGM_SWTNUMCYL_TYPE" "0"
 SYSTEM_CONSTANT "ENGM_SWTNUMCYL_VAL" "6"
 SYSTEM_CONSTANT "ENGPRT_FACOVHTPRVCT_CUR_X" "25"
 SYSTEM_CONSTANT "ENGPRT_FACOVHTPRVFT_CUR_X" "10"
 SYSTEM_CONSTANT "ENGPRT_FACOVHTPRVOT_CUR_X" "25"
 SYSTEM_CONSTANT "ENGPRT_MON_OVRSPD_BP" "0"
 SYSTEM_CONSTANT "ENGPRT_OVRDS_DCS" "0"
 SYSTEM_CONSTANT "ENGPRT_QLIM_CUR_X" "25"
 SYSTEM_CONSTANT "ENGPRT_QOVHTPRVNRNG_MAP_X" "8"
 SYSTEM_CONSTANT "ENGPRT_QOVHTPRVNRNG_MAP_Y" "8"
 SYSTEM_CONSTANT "ENGPRT_QOVHTPRVVRNG_MAP_X" "16"
 SYSTEM_CONSTANT "ENGPRT_QOVHTPRVVRNG_MAP_Y" "16"
 SYSTEM_CONSTANT "ENGPRT_TRQLIM_CUR_X" "25"
 SYSTEM_CONSTANT "ENGPRT_TRQNLIMSPR_CUR_X" "25"
 SYSTEM_CONSTANT "ENGPRT_TRQNLIM_CUR_X" "25"
 SYSTEM_CONSTANT "ENGSPDLIMSTRT_SY" "0"
 SYSTEM_CONSTANT "ENGTRQPTD_40MS_MSK" "3"
 SYSTEM_CONSTANT "ENG_CTFLD_NUM" "3"
 SYSTEM_CONSTANT "ENG_DN_DT_RES" "0.5"
 SYSTEM_CONSTANT "ENG_DP_DT_RES" "0.5"
 SYSTEM_CONSTANT "ENG_N_HIRES" "0.03125"
 SYSTEM_CONSTANT "ENG_N_HIRES_EXP" "5"
 SYSTEM_CONSTANT "ENG_N_IDL_RES" "10"
 SYSTEM_CONSTANT "ENG_N_L_RES" "40"
 SYSTEM_CONSTANT "ENG_N_MAX" "6000"
 SYSTEM_CONSTANT "ENG_N_MIN" "40"
 SYSTEM_CONSTANT "ENG_N_RES" "0.5"
 SYSTEM_CONSTANT "ENG_N_RES1" "0.5"
 SYSTEM_CONSTANT "ENG_N_RES_FL" "0.5"
 SYSTEM_CONSTANT "ENG_N_RES_REV" "2"
 SYSTEM_CONSTANT "ENG_N_ZERO" "0"
 SYSTEM_CONSTANT "ENG_START" "1"
 SYSTEM_CONSTANT "ENG_STOP" "2"
 SYSTEM_CONSTANT "ENG_UNCHANGED" "0"
 SYSTEM_CONSTANT "ENRGPERMASS_RES" "0.1"
 SYSTEM_CONSTANT "EPMBCA_FAC_TSTINJ_SY" "1000"
 SYSTEM_CONSTANT "EPMCAS_DETECTBOTHEDGES" "2"
 SYSTEM_CONSTANT "EPMCAS_DETECTFALLINGEDGES" "0"
 SYSTEM_CONSTANT "EPMCAS_DETECTRISINGEDGES" "1"
 SYSTEM_CONSTANT "EPMCAS_I1_SY" "0"
 SYSTEM_CONSTANT "EPMCAS_NUMSEG" "10"
 SYSTEM_CONSTANT "EPMCAS_NUMSEGLEN" "10"
 SYSTEM_CONSTANT "EPMCAS_SEGCOR_SY" "0"
 SYSTEM_CONSTANT "EPMCRS_NUMTHRESH" "4"
 SYSTEM_CONSTANT "EPMCRS_NUMVAL" "4"
 SYSTEM_CONSTANT "EPMHCRS_NUMINC" "60"
 SYSTEM_CONSTANT "EPMHCRS_PHIINCR" "6"
 SYSTEM_CONSTANT "EPMHCRS_SWTCODEDGAP_SY" "0"
 SYSTEM_CONSTANT "EPMHCRS_SWTIAP_SY" "0"
 SYSTEM_CONSTANT "EPMHCRS_SWTIAS_SY" "0"
 SYSTEM_CONSTANT "EPMRRS_NUMPER" "10"
 SYSTEM_CONSTANT "EPMRRS_SY" "1"
 SYSTEM_CONSTANT "EPMRRS_TISWOFFDLY" "1000000"
 SYSTEM_CONSTANT "EPMRRS_TITOOTHPERTOL" "1000"
 SYSTEM_CONSTANT "EPMRRS_TITRNOFFDLY" "100000"
 SYSTEM_CONSTANT "EPMRRS_TOOTHCRITCOND" "7"
 SYSTEM_CONSTANT "EPMRRS_VMIN" "20"
 SYSTEM_CONSTANT "EPMSEQ_AUTO_CALC_SY" "-300"
 SYSTEM_CONSTANT "EPMSEQ_NO_S_1_SY" "-400"
 SYSTEM_CONSTANT "EPM_NMAX_SY" "10000"
 SYSTEM_CONSTANT "EPM_NMIN_SY" "20"
 SYSTEM_CONSTANT "EPM_NUMCRSREVWCY_SY" "2"
 SYSTEM_CONSTANT "EPM_NUMCYLMAX" "6"
 SYSTEM_CONSTANT "EPM_NZERO_SY" "0"
 SYSTEM_CONSTANT "EPM_N_HIRES" "0.03125"
 SYSTEM_CONSTANT "EPM_N_HIRES_EXP" "5"
 SYSTEM_CONSTANT "EPM_N_IDL_RES" "10"
 SYSTEM_CONSTANT "EPM_N_L_RES" "40"
 SYSTEM_CONSTANT "EPM_N_MAX" "6000"
 SYSTEM_CONSTANT "EPM_N_MIN" "40"
 SYSTEM_CONSTANT "EPM_N_RES" "0.5"
 SYSTEM_CONSTANT "EPM_N_RES_FL" "0.5"
 SYSTEM_CONSTANT "EPM_N_RES_INV" "2"
 SYSTEM_CONSTANT "EPM_N_RES_REV" "2"
 SYSTEM_CONSTANT "EPM_N_ZERO" "0"
 SYSTEM_CONSTANT "EPM_PHICRSREV_SY" "360"
 SYSTEM_CONSTANT "EPM_PHIMAX" "720"
 SYSTEM_CONSTANT "EPM_PHIMAX_SY" "32767"
 SYSTEM_CONSTANT "EPM_TI_SHORTINT" "2500"
 SYSTEM_CONSTANT "EQUALINIT" "255"
 SYSTEM_CONSTANT "ERRVAL_S16" "32767"
 SYSTEM_CONSTANT "ERRVAL_S32" "2147483647"
 SYSTEM_CONSTANT "ERRVAL_S8" "127"
 SYSTEM_CONSTANT "ERRVAL_U16" "65535"
 SYSTEM_CONSTANT "ERRVAL_U32" "4294967295"
 SYSTEM_CONSTANT "ERRVAL_U8" "255"
 SYSTEM_CONSTANT "ESC_NUMTHRESH_SY" "3"
 SYSTEM_CONSTANT "ESC_STACKSIZE" "10"
 SYSTEM_CONSTANT "ETA1_EXP" "7"
 SYSTEM_CONSTANT "ETA1_RES" "0.0078125"
 SYSTEM_CONSTANT "ETA1_RES_REV" "128"
 SYSTEM_CONSTANT "ETA2_EXP" "7"
 SYSTEM_CONSTANT "ETA2_RES" "0.0078125"
 SYSTEM_CONSTANT "ETA2_RES_REV" "128"
 SYSTEM_CONSTANT "ETA_CORR_FACT_ONE" "1"
 SYSTEM_CONSTANT "ETA_COR_FACT_ONE" "1"
 SYSTEM_CONSTANT "ETA_EXP" "7"
 SYSTEM_CONSTANT "ETA_RES" "0.0078125"
 SYSTEM_CONSTANT "ETA_RES_REV" "128"
 SYSTEM_CONSTANT "ETA_THM_ENG_ONE" "1"
 SYSTEM_CONSTANT "ETCLB_NUM_RAILP_CLB_PNT" "2"
 SYSTEM_CONSTANT "ETCLB_SWTCORACTV_TYPE" "2"
 SYSTEM_CONSTANT "ETCLB_SWTCORACTV_VAL" "1"
 SYSTEM_CONSTANT "ETCTLGOV_P0Q001_LIMMAX" "1"
 SYSTEM_CONSTANT "ETCTLGOV_P0Q001_LIMMIN" "-1"
 SYSTEM_CONSTANT "ETCTLGOV_P0Q001_RES" "0.001"
 SYSTEM_CONSTANT "ETCTLGOV_P0Q001_RES_INV" "1000"
 SYSTEM_CONSTANT "ETCTLGOV_P0Q001_ZERO" "0"
 SYSTEM_CONSTANT "ETCTL_ACTV_BP" "0"
 SYSTEM_CONSTANT "ETCTL_NUMOPMODEMSK_SY" "2"
 SYSTEM_CONSTANT "ETCTL_SLOPENEG" "0"
 SYSTEM_CONSTANT "ETCTL_STMSKINR_CA_X" "2"
 SYSTEM_CONSTANT "ETCTL_STMSKOUTR_CA_X" "2"
 SYSTEM_CONSTANT "ETS_DPF_SY" "2"
 SYSTEM_CONSTANT "ETS_HOM_SY" "2"
 SYSTEM_CONSTANT "ETS_INJMI" "3"
 SYSTEM_CONSTANT "ETS_INJNUM_SY" "6"
 SYSTEM_CONSTANT "ETS_INJPII1" "2"
 SYSTEM_CONSTANT "ETS_INJPII2" "1"
 SYSTEM_CONSTANT "ETS_INJPII3" "0"
 SYSTEM_CONSTANT "ETS_INJPOI1" "4"
 SYSTEM_CONSTANT "ETS_INJPOI2" "5"
 SYSTEM_CONSTANT "ETS_LEAN_0" "10"
 SYSTEM_CONSTANT "ETS_LEAN_1" "11"
 SYSTEM_CONSTANT "ETS_LEAN_2" "12"
 SYSTEM_CONSTANT "ETS_LEAN_SY" "1"
 SYSTEM_CONSTANT "ETS_NSC_0" "50"
 SYSTEM_CONSTANT "ETS_NSC_1" "51"
 SYSTEM_CONSTANT "ETS_NSC_2" "52"
 SYSTEM_CONSTANT "ETS_NSC_SY" "1"
 SYSTEM_CONSTANT "ETS_NUMINPMSK_SY" "7"
 SYSTEM_CONSTANT "ETS_PFLT1_0" "20"
 SYSTEM_CONSTANT "ETS_PFLT1_1" "21"
 SYSTEM_CONSTANT "ETS_PFLT1_2" "22"
 SYSTEM_CONSTANT "ETS_PFLT1_SY" "1"
 SYSTEM_CONSTANT "ETS_PFLT2_0" "30"
 SYSTEM_CONSTANT "ETS_PFLT2_1" "31"
 SYSTEM_CONSTANT "ETS_PFLT2_2" "32"
 SYSTEM_CONSTANT "ETS_PFLT2_SY" "1"
 SYSTEM_CONSTANT "ETS_PHC_0" "40"
 SYSTEM_CONSTANT "ETS_PHC_1" "41"
 SYSTEM_CONSTANT "ETS_PHC_2" "42"
 SYSTEM_CONSTANT "ETS_PHC_SY" "2"
 SYSTEM_CONSTANT "ETS_SOX_0" "60"
 SYSTEM_CONSTANT "ETS_SOX_1" "61"
 SYSTEM_CONSTANT "ETS_SOX_2" "62"
 SYSTEM_CONSTANT "ETS_SOX_SY" "1"
 SYSTEM_CONSTANT "EVEN_SEGMENT" "0"
 SYSTEM_CONSTANT "EXHPRES_CT_SENSORS" "8"
 SYSTEM_CONSTANT "EXHTEMP_CT_SENSORS" "8"
 SYSTEM_CONSTANT "FACT100_RES" "0.01"
 SYSTEM_CONSTANT "FACT100_RES_REV" "100"
 SYSTEM_CONSTANT "FACT10_EXP" "10"
 SYSTEM_CONSTANT "FACT10_RES" "1e-010"
 SYSTEM_CONSTANT "FACT16_EXP" "16"
 SYSTEM_CONSTANT "FACT16_RES_REV" "65536"
 SYSTEM_CONSTANT "FACT1_EXP" "7"
 SYSTEM_CONSTANT "FACT1_ONE" "1"
 SYSTEM_CONSTANT "FACT1_ONE_RES" "0.1"
 SYSTEM_CONSTANT "FACT1_ONE_RES_REV" "10"
 SYSTEM_CONSTANT "FACT1_RES" "0.0078125"
 SYSTEM_CONSTANT "FACT1_RES_REV" "128"
 SYSTEM_CONSTANT "FACT256_RES" "0.00390625"
 SYSTEM_CONSTANT "FACT256_RES_REV" "256"
 SYSTEM_CONSTANT "FACT26_EXP" "26"
 SYSTEM_CONSTANT "FACT26_RES" "1.49011611938477e-008"
 SYSTEM_CONSTANT "FACT26_RES_REV" "67108864"
 SYSTEM_CONSTANT "FACT4_MAX" "1500"
 SYSTEM_CONSTANT "FACT4_MIN" "0"
 SYSTEM_CONSTANT "FACT4_ONE" "1"
 SYSTEM_CONSTANT "FACT4_RES" "0.05"
 SYSTEM_CONSTANT "FACT4_RES_REV" "20"
 SYSTEM_CONSTANT "FACT7_RES" "1e-007"
 SYSTEM_CONSTANT "FACT7_RES_REV" "10000000"
 SYSTEM_CONSTANT "FACT8_EXP" "8"
 SYSTEM_CONSTANT "FACT8_RES" "1e-008"
 SYSTEM_CONSTANT "FACT8_RES_REV" "100000000"
 SYSTEM_CONSTANT "FACTGOVILMBDRESREV_SY" "64"
 SYSTEM_CONSTANT "FACTGOVIT3RESREV_SY" "512"
 SYSTEM_CONSTANT "FACTGOVPLMBDRESREV_SY" "128"
 SYSTEM_CONSTANT "FACTGOVPT3RESREV_SY" "256"
 SYSTEM_CONSTANT "FACTM_EXP" "4"
 SYSTEM_CONSTANT "FACTM_RES" "0"
 SYSTEM_CONSTANT "FACTM_RES_REV" "16"
 SYSTEM_CONSTANT "FACTM_ZERO" "0"
 SYSTEM_CONSTANT "FACTOR_100" "100"
 SYSTEM_CONSTANT "FACTPIINT_SY" "2147"
 SYSTEM_CONSTANT "FACTPIPROP_SY" "32768"
 SYSTEM_CONSTANT "FACT_BIP_RES" "4096"
 SYSTEM_CONSTANT "FACT_EGT_RES" "0.001"
 SYSTEM_CONSTANT "FACT_EGT_RES_REV" "1000"
 SYSTEM_CONSTANT "FACT_ETCTL_ONE" "1"
 SYSTEM_CONSTANT "FACT_LAMBDAREC1" "100"
 SYSTEM_CONSTANT "FACT_LAMBDAREC2" "1000000"
 SYSTEM_CONSTANT "FACT_MASSOILASH_TO_VOLOILASH" "10"
 SYSTEM_CONSTANT "FACT_MAX" "1.2"
 SYSTEM_CONSTANT "FACT_MIN" "0.8333"
 SYSTEM_CONSTANT "FACT_NRM_EXP" "13"
 SYSTEM_CONSTANT "FACT_NRM_EXP_LOW" "10"
 SYSTEM_CONSTANT "FACT_ONE" "1"
 SYSTEM_CONSTANT "FACT_POI2POI1_MAX" "1"
 SYSTEM_CONSTANT "FACT_POI2POI1_MIN" "0"
 SYSTEM_CONSTANT "FACT_RES" "0.0001220703125"
 SYSTEM_CONSTANT "FACT_RES_LOW" "0.0009765625"
 SYSTEM_CONSTANT "FACT_RES_REV" "8192"
 SYSTEM_CONSTANT "FACT_RES_REV_LOW" "1024"
 SYSTEM_CONSTANT "FACT_TEMP" "-2731.4"
 SYSTEM_CONSTANT "FACT_TWO_SY" "2"
 SYSTEM_CONSTANT "FACT_ZERO" "0"
 SYSTEM_CONSTANT "FAC_AG_CRS_HI_RESO" "128"
 SYSTEM_CONSTANT "FAC_DERIVATIVE" "500000"
 SYSTEM_CONSTANT "FAC_MASSINJ_TO_QNTINJ" "10000"
 SYSTEM_CONSTANT "FAC_PLAUS" "16"
 SYSTEM_CONSTANT "FAC_PRECTL_CTLINJ" "240000"
 SYSTEM_CONSTANT "FAC_PRES2TRQ_REV" "500"
 SYSTEM_CONSTANT "FAC_QNTADJ_TO_QNTINJ_0" "1000"
 SYSTEM_CONSTANT "FAC_QNTADJ_TO_QNTINJ_1" "1500"
 SYSTEM_CONSTANT "FAC_QNTADJ_TO_QNTINJ_2" "2500"
 SYSTEM_CONSTANT "FAC_QNTADJ_TO_QNTINJ_3" "5000"
 SYSTEM_CONSTANT "FAC_QNTADJ_TO_QNTINJ_RES" "100"
 SYSTEM_CONSTANT "FAC_T_INC_PER_DUR_HI_RESO" "256"
 SYSTEM_CONSTANT "FAC_USEC_TO_RPM" "60000000"
 SYSTEM_CONSTANT "FANCTL_DCYCCALC_CUR_X" "25"
 SYSTEM_CONSTANT "FANSPD_MAX" "3000"
 SYSTEM_CONSTANT "FAN_CTLAFTRUN_BP" "1"
 SYSTEM_CONSTANT "FAN_TPER_MAX_SY" "100"
 SYSTEM_CONSTANT "FAN_TPER_MIN_SY" "10"
 SYSTEM_CONSTANT "FBC_BPfacINV_RES" "546.116666666667"
 SYSTEM_CONSTANT "FBC_BPfac_MAX" "30"
 SYSTEM_CONSTANT "FBC_BPfac_MIN" "-30"
 SYSTEM_CONSTANT "FBC_BPfac_RES" "0.00183111056855983"
 SYSTEM_CONSTANT "FBC_CTPHCOMP_MAX" "4"
 SYSTEM_CONSTANT "FBC_CTPHCOMP_MIN" "0"
 SYSTEM_CONSTANT "FBC_CTSEGOFFSET" "2"
 SYSTEM_CONSTANT "FBC_CTTDCOFFSET" "1"
 SYSTEM_CONSTANT "FBC_DBPFAC1DEN1" "1.3611"
 SYSTEM_CONSTANT "FBC_DBPFAC1DEN2" "0.9245"
 SYSTEM_CONSTANT "FBC_DBPFAC2DEN1" "0.000944"
 SYSTEM_CONSTANT "FBC_DBPFAC2DEN2" "0.9245"
 SYSTEM_CONSTANT "FBC_DBPFAC3DEN1" "0"
 SYSTEM_CONSTANT "FBC_DBPFAC3DEN2" "0"
 SYSTEM_CONSTANT "FBC_DBPFAC4DEN1" "0"
 SYSTEM_CONSTANT "FBC_DBPFAC4DEN2" "0"
 SYSTEM_CONSTANT "FBC_DBPFAC5DEN1" "0"
 SYSTEM_CONSTANT "FBC_DBPFAC5DEN2" "0"
 SYSTEM_CONSTANT "FBC_DSYN" "1"
 SYSTEM_CONSTANT "FBC_DXS_FL" "4000000"
 SYSTEM_CONSTANT "FBC_FIOMAX_SY" "8"
 SYSTEM_CONSTANT "FBC_NUMAASEGMAX_SY" "4"
 SYSTEM_CONSTANT "FBC_NUMCYL03_AA0" "0.0681483474"
 SYSTEM_CONSTANT "FBC_NUMCYL03_AA1" "0.131652498"
 SYSTEM_CONSTANT "FBC_NUMCYL03_AA2" "0.186184748"
 SYSTEM_CONSTANT "FBC_NUMCYL03_AA3" "0.228028815"
 SYSTEM_CONSTANT "FBC_NUMCYL03_AA4" "0.186184748"
 SYSTEM_CONSTANT "FBC_NUMCYL03_AA5" "0.131652498"
 SYSTEM_CONSTANT "FBC_NUMCYL03_AA6" "0.0681483474"
 SYSTEM_CONSTANT "FBC_NUMCYL03_AA7" "0"
 SYSTEM_CONSTANT "FBC_NUMCYL03_AA8" "0"
 SYSTEM_CONSTANT "FBC_NUMCYL03_AAORD" "6"
 SYSTEM_CONSTANT "FBC_NUMCYL03_NUMAASEG" "4"
 SYSTEM_CONSTANT "FBC_NUMCYL03_TSM0" "3.5"
 SYSTEM_CONSTANT "FBC_NUMCYL03_TSM1" "-2.5"
 SYSTEM_CONSTANT "FBC_NUMCYL04_AA0" "0.0155861364"
 SYSTEM_CONSTANT "FBC_NUMCYL04_AA1" "0.0571060835"
 SYSTEM_CONSTANT "FBC_NUMCYL04_AA2" "0.125906618"
 SYSTEM_CONSTANT "FBC_NUMCYL04_AA3" "0.191080679"
 SYSTEM_CONSTANT "FBC_NUMCYL04_AA4" "0.220640963"
 SYSTEM_CONSTANT "FBC_NUMCYL04_AA5" "0.191080679"
 SYSTEM_CONSTANT "FBC_NUMCYL04_AA6" "0.125906618"
 SYSTEM_CONSTANT "FBC_NUMCYL04_AA7" "0.0571060835"
 SYSTEM_CONSTANT "FBC_NUMCYL04_AA8" "0.0155861364"
 SYSTEM_CONSTANT "FBC_NUMCYL04_AAORD" "8"
 SYSTEM_CONSTANT "FBC_NUMCYL04_NUMAASEG" "3"
 SYSTEM_CONSTANT "FBC_NUMCYL04_TSM0" "4.5"
 SYSTEM_CONSTANT "FBC_NUMCYL04_TSM1" "-3.5"
 SYSTEM_CONSTANT "FBC_NUMCYL05_AA0" "0.0143161042"
 SYSTEM_CONSTANT "FBC_NUMCYL05_AA1" "0.0541633501"
 SYSTEM_CONSTANT "FBC_NUMCYL05_AA2" "0.125118189"
 SYSTEM_CONSTANT "FBC_NUMCYL05_AA3" "0.193597643"
 SYSTEM_CONSTANT "FBC_NUMCYL05_AA4" "0.225609425"
 SYSTEM_CONSTANT "FBC_NUMCYL05_AA5" "0.193597643"
 SYSTEM_CONSTANT "FBC_NUMCYL05_AA6" "0.125118189"
 SYSTEM_CONSTANT "FBC_NUMCYL05_AA7" "0.0541633501"
 SYSTEM_CONSTANT "FBC_NUMCYL05_AA8" "0.0143161042"
 SYSTEM_CONSTANT "FBC_NUMCYL05_AAORD" "8"
 SYSTEM_CONSTANT "FBC_NUMCYL05_NUMAASEG" "3"
 SYSTEM_CONSTANT "FBC_NUMCYL05_TSM0" "5.5"
 SYSTEM_CONSTANT "FBC_NUMCYL05_TSM1" "-4.5"
 SYSTEM_CONSTANT "FBC_NUMCYL06_AA0" "0.0744924388"
 SYSTEM_CONSTANT "FBC_NUMCYL06_AA1" "0.249256558"
 SYSTEM_CONSTANT "FBC_NUMCYL06_AA2" "0.352502005"
 SYSTEM_CONSTANT "FBC_NUMCYL06_AA3" "0.249256558"
 SYSTEM_CONSTANT "FBC_NUMCYL06_AA4" "0.0744924388"
 SYSTEM_CONSTANT "FBC_NUMCYL06_AA5" "0"
 SYSTEM_CONSTANT "FBC_NUMCYL06_AA6" "0"
 SYSTEM_CONSTANT "FBC_NUMCYL06_AA7" "0"
 SYSTEM_CONSTANT "FBC_NUMCYL06_AA8" "0"
 SYSTEM_CONSTANT "FBC_NUMCYL06_AAORD" "4"
 SYSTEM_CONSTANT "FBC_NUMCYL06_NUMAASEG" "2"
 SYSTEM_CONSTANT "FBC_NUMCYL06_TSM0" "6.5"
 SYSTEM_CONSTANT "FBC_NUMCYL06_TSM1" "-5.5"
 SYSTEM_CONSTANT "FBC_NUMCYL08_AA0" "0.0155861364"
 SYSTEM_CONSTANT "FBC_NUMCYL08_AA1" "0.0571060835"
 SYSTEM_CONSTANT "FBC_NUMCYL08_AA2" "0.125906618"
 SYSTEM_CONSTANT "FBC_NUMCYL08_AA3" "0.191080679"
 SYSTEM_CONSTANT "FBC_NUMCYL08_AA4" "0.220640963"
 SYSTEM_CONSTANT "FBC_NUMCYL08_AA5" "0.191080679"
 SYSTEM_CONSTANT "FBC_NUMCYL08_AA6" "0.125906618"
 SYSTEM_CONSTANT "FBC_NUMCYL08_AA7" "0.0571060835"
 SYSTEM_CONSTANT "FBC_NUMCYL08_AA8" "0.0155861364"
 SYSTEM_CONSTANT "FBC_NUMCYL08_AAORD" "8"
 SYSTEM_CONSTANT "FBC_NUMCYL08_NUMAASEG" "3"
 SYSTEM_CONSTANT "FBC_NUMCYL08_TSM0" "8.5"
 SYSTEM_CONSTANT "FBC_NUMCYL08_TSM1" "-7.5"
 SYSTEM_CONSTANT "FBC_NUMCYL10_AA0" "0.0750601575"
 SYSTEM_CONSTANT "FBC_NUMCYL10_AA1" "0.248923997"
 SYSTEM_CONSTANT "FBC_NUMCYL10_AA2" "0.352031692"
 SYSTEM_CONSTANT "FBC_NUMCYL10_AA3" "0.248923997"
 SYSTEM_CONSTANT "FBC_NUMCYL10_AA4" "0.0750601575"
 SYSTEM_CONSTANT "FBC_NUMCYL10_AA5" "0"
 SYSTEM_CONSTANT "FBC_NUMCYL10_AA6" "0"
 SYSTEM_CONSTANT "FBC_NUMCYL10_AA7" "0"
 SYSTEM_CONSTANT "FBC_NUMCYL10_AA8" "0"
 SYSTEM_CONSTANT "FBC_NUMCYL10_AAORD" "4"
 SYSTEM_CONSTANT "FBC_NUMCYL10_NUMAASEG" "2"
 SYSTEM_CONSTANT "FBC_NUMCYL10_TSM0" "10.5"
 SYSTEM_CONSTANT "FBC_NUMCYL10_TSM1" "-9.5"
 SYSTEM_CONSTANT "FBC_NUMSEG" "2"
 SYSTEM_CONSTANT "FBC_QLIM_CUR_X" "4"
 SYSTEM_CONSTANT "FLCONS1_RES" "0.01"
 SYSTEM_CONSTANT "FLCONS1_RES_INV" "100"
 SYSTEM_CONSTANT "FLCONS2_RES" "1"
 SYSTEM_CONSTANT "FLCONS2_RES_1" "0.001"
 SYSTEM_CONSTANT "FLCONS_LPS_RES" "0.0001"
 SYSTEM_CONSTANT "FLDETREFUEL_HALF_L" "0.5"
 SYSTEM_CONSTANT "FLMNG_FULLLDRGLIKI_CUR_X" "7"
 SYSTEM_CONSTANT "FLMNG_FULLLDRGLPKP_CUR_X" "7"
 SYSTEM_CONSTANT "FLMNG_R_STOICH" "14.5"
 SYSTEM_CONSTANT "FLMNG_SMK_NORM" "689.655172413793"
 SYSTEM_CONSTANT "FLMNG_TIFULLLDRGLDEL_CUR_X" "10"
 SYSTEM_CONSTANT "FLSYS_FTS_EXISTS" "1"
 SYSTEM_CONSTANT "FLSYS_FTS_NONE" "0"
 SYSTEM_CONSTANT "FLSYS_RHOFL_CUR_X" "2"
 SYSTEM_CONSTANT "FLSYS_SWTTEMPSENSCFG_TYPE" "2"
 SYSTEM_CONSTANT "FLSYS_SWTTEMPSENSCFG_VAL" "0"
 SYSTEM_CONSTANT "FL_2_RES" "10"
 SYSTEM_CONSTANT "FL_Half_L_MAX" "300"
 SYSTEM_CONSTANT "FL_Half_L_MIN" "0"
 SYSTEM_CONSTANT "FL_L_MAX" "320"
 SYSTEM_CONSTANT "FL_L_MIN" "0"
 SYSTEM_CONSTANT "FL_L_RES" "0.01"
 SYSTEM_CONSTANT "FL_L_RES_INV" "100"
 SYSTEM_CONSTANT "FL_RES" "0.5"
 SYSTEM_CONSTANT "FL_RES_INV" "2"
 SYSTEM_CONSTANT "FL_VOL_MAX" "65.5"
 SYSTEM_CONSTANT "FL_VOL_MIN" "0"
 SYSTEM_CONSTANT "FL_VOL_RES" "0.001"
 SYSTEM_CONSTANT "FL_VOL_RES_INV" "1000"
 SYSTEM_CONSTANT "FMA_DT1_RES" "4294.967296"
 SYSTEM_CONSTANT "FMA_N_2_PSI" "33554.432"
 SYSTEM_CONSTANT "FMA_QADAPINI_X_AXIS" "8"
 SYSTEM_CONSTANT "FMA_QADAPINI_Y_AXIS" "8"
 SYSTEM_CONSTANT "FMA_Q_2_PSI" "67108.864"
 SYSTEM_CONSTANT "FTSCD_TLIN_CUR_X" "25"
 SYSTEM_CONSTANT "FUELT_FTS_NONE" "0"
 SYSTEM_CONSTANT "FUELT_TEMP_CTS" "1"
 SYSTEM_CONSTANT "FUELT_TEMP_DFL" "2"
 SYSTEM_CONSTANT "FUELT_TEMP_FTS" "0"
 SYSTEM_CONSTANT "GCVOLT_RES" "1023"
 SYSTEM_CONSTANT "GCVOLT_VOLT_BATT_REV" "409.2"
 SYSTEM_CONSTANT "GEARBX_NUMGEAR_MAX" "6"
 SYSTEM_CONSTANT "GEARBX_NUMGEAR_MIN" "-1"
 SYSTEM_CONSTANT "GEARBX_TRQMAXGEAR1_CUR_X" "15"
 SYSTEM_CONSTANT "GEARBX_TRQMAXGEAR2_CUR_X" "15"
 SYSTEM_CONSTANT "GEARBX_TRQMAXGEAR3_CUR_X" "15"
 SYSTEM_CONSTANT "GEARBX_TRQMAXGEAR4_CUR_X" "15"
 SYSTEM_CONSTANT "GEARBX_TRQMAXGEAR5_CUR_X" "15"
 SYSTEM_CONSTANT "GEARBX_TRQMAXGEAR6_CUR_X" "15"
 SYSTEM_CONSTANT "GEARBX_TRQMAXGEARR_CUR_X" "15"
 SYSTEM_CONSTANT "GEARBX_TYPE_MT" "0"
 SYSTEM_CONSTANT "GLBDA_STIARLSVEHDIFFTLPRT_BP" "1"
 SYSTEM_CONSTANT "GLBDA_STIARLSVEHSTABINTV_BP" "0"
 SYSTEM_CONSTANT "GLBDA_STIARLSVEHTRAINTV_BP" "3"
 SYSTEM_CONSTANT "GLBDA_STIARLSVEHTRASHFTINTV_BP" "2"
 SYSTEM_CONSTANT "GLBDA_STIARLSVEH_MSK" "11"
 SYSTEM_CONSTANT "GLBDA_STLIMMINDFL" "0"
 SYSTEM_CONSTANT "GLBDA_STTRQDEMDFL" "0"
 SYSTEM_CONSTANT "GLBDA_STTRQDEMDRVDEM_MSK" "384"
 SYSTEM_CONSTANT "GLBDA_STTRQDEM_ACCPED_BP" "8"
 SYSTEM_CONSTANT "GLBDA_STTRQDEM_ACCPED_MSK" "256"
 SYSTEM_CONSTANT "GLBDA_STTRQDEM_CRCTL" "1"
 SYSTEM_CONSTANT "GLBDA_STTRQDEM_CRCTL_BP" "7"
 SYSTEM_CONSTANT "GLBDA_STTRQDEM_CRCTL_MSK" "128"
 SYSTEM_CONSTANT "GLBDA_STTRQDEM_DCS" "3"
 SYSTEM_CONSTANT "GLBDA_STTRQDEM_DCS_BP" "5"
 SYSTEM_CONSTANT "GLBDA_STTRQDEM_DCS_MSK" "32"
 SYSTEM_CONSTANT "GLBDA_STTRQDEM_LLIM_BP" "6"
 SYSTEM_CONSTANT "GLBDA_STTRQDEM_LLIM_MSK" "64"
 SYSTEM_CONSTANT "GLBDA_STTRQDEM_NODEM_BP" "10"
 SYSTEM_CONSTANT "GLBDA_STTRQDEM_NODEM_MSK" "1024"
 SYSTEM_CONSTANT "GLBDA_STTRQDEM_SPDGOV_BP" "9"
 SYSTEM_CONSTANT "GLBDA_STTRQDEM_SPDGOV_MSK" "512"
 SYSTEM_CONSTANT "GLBDA_STTRQDEM_TCS" "4"
 SYSTEM_CONSTANT "GLBDA_STTRQDEM_TCS_BP" "4"
 SYSTEM_CONSTANT "GLBDA_STTRQDEM_TCS_MSK" "16"
 SYSTEM_CONSTANT "GLBDA_STTRQDEM_TRADEC_BP" "2"
 SYSTEM_CONSTANT "GLBDA_STTRQDEM_TRADEC_MSK" "4"
 SYSTEM_CONSTANT "GLBDA_STTRQDEM_TRAINC_BP" "1"
 SYSTEM_CONSTANT "GLBDA_STTRQDEM_TRAINC_MSK" "2"
 SYSTEM_CONSTANT "GLBDA_STTRQDEM_TRAPRT_BP" "0"
 SYSTEM_CONSTANT "GLBDA_STTRQDEM_TRAPRT_MSK" "1"
 SYSTEM_CONSTANT "GLBDA_STTRQDEM_VMLIM_BP" "3"
 SYSTEM_CONSTANT "GLBDA_STTRQDEM_VMLIM_MSK" "8"
 SYSTEM_CONSTANT "GLBDA_TRQDEM_COVEH_BP" "2"
 SYSTEM_CONSTANT "GLBDA_TRQDEM_COVEH_MSK" "4"
 SYSTEM_CONSTANT "GLBDA_TRQDEM_PT_BP" "1"
 SYSTEM_CONSTANT "GLBDA_TRQDEM_PT_MSK" "2"
 SYSTEM_CONSTANT "GLBDA_TRQDEM_VEHMOT_BP" "0"
 SYSTEM_CONSTANT "GLBDA_TRQDEM_VEHMOT_MSK" "1"
 SYSTEM_CONSTANT "GLWCTL_BATTCORR" "2"
 SYSTEM_CONSTANT "GLWCTL_BATTCORR_MSG" "3"
 SYSTEM_CONSTANT "GLWCTL_FACT_TIME" "10"
 SYSTEM_CONSTANT "GLWCTL_GSK3" "1"
 SYSTEM_CONSTANT "GLWCTL_PREGLWDURCALC_AIRPRESS" "1"
 SYSTEM_CONSTANT "GLWCTL_PREGLWDURCALC_UBATT" "0"
 SYSTEM_CONSTANT "GLWCTL_QPOST_CUR_X" "25"
 SYSTEM_CONSTANT "GLWCTL_RLIMITCLNT_CUR_X" "8"
 SYSTEM_CONSTANT "GLWCTL_RLIMITNM_MAP_X" "6"
 SYSTEM_CONSTANT "GLWCTL_RLIMITNM_MAP_Y" "8"
 SYSTEM_CONSTANT "GLWCTL_RPWRCLNT_CUR_X" "8"
 SYSTEM_CONSTANT "GLWCTL_RPWRNM_MAP_X" "8"
 SYSTEM_CONSTANT "GLWCTL_RPWRNM_MAP_Y" "8"
 SYSTEM_CONSTANT "GLWCTL_RPWRPAIR_CUR_X" "8"
 SYSTEM_CONSTANT "GLWCTL_RPWRTAIR_CUR_X" "8"
 SYSTEM_CONSTANT "GLWCTL_RSTART_CUR_X" "2"
 SYSTEM_CONSTANT "GLWCTL_STINTR1_MAP_X" "16"
 SYSTEM_CONSTANT "GLWCTL_STINTR1_MAP_Y" "16"
 SYSTEM_CONSTANT "GLWCTL_STINTR2_MAP_X" "16"
 SYSTEM_CONSTANT "GLWCTL_STINTR2_MAP_Y" "16"
 SYSTEM_CONSTANT "GLWCTL_STRLYCTL_MAP_X" "16"
 SYSTEM_CONSTANT "GLWCTL_STRLYCTL_MAP_Y" "16"
 SYSTEM_CONSTANT "GLWCTL_SWTPREGLWDURCALC_TYPE" "2"
 SYSTEM_CONSTANT "GLWCTL_SWTPREGLWDURCALC_VAL" "0"
 SYSTEM_CONSTANT "GLWCTL_TILAMPBASE_CUR_X" "8"
 SYSTEM_CONSTANT "GLWCTL_TILAMPPAIR_CUR_X" "4"
 SYSTEM_CONSTANT "GLWCTL_TILAMPUBATT_CUR_X" "4"
 SYSTEM_CONSTANT "GLWCTL_TIPOST_MAP_X" "16"
 SYSTEM_CONSTANT "GLWCTL_TIPOST_MAP_Y" "16"
 SYSTEM_CONSTANT "GLWCTL_TIPRE1_MAP_X" "16"
 SYSTEM_CONSTANT "GLWCTL_TIPRE1_MAP_Y" "16"
 SYSTEM_CONSTANT "GLWCTL_TIPRE2_MAP_X" "16"
 SYSTEM_CONSTANT "GLWCTL_TIPRE2_MAP_Y" "16"
 SYSTEM_CONSTANT "GLWCTL_TIPRE_CUR_X" "8"
 SYSTEM_CONSTANT "GLWCTL_UGLWPLGRAW" "11000"
 SYSTEM_CONSTANT "GLWCTL_UVOLTBATTGLWPLGRAW" "11000"
 SYSTEM_CONSTANT "GLWPLG_FACQNT" "9.84615384615385"
 SYSTEM_CONSTANT "GLWPLG_NUM_MAX" "8"
 SYSTEM_CONSTANT "GLWPLG_NUM_PLGS" "6"
 SYSTEM_CONSTANT "GLWPLG_PWRPERLSB" "13"
 SYSTEM_CONSTANT "GLWPLG_PWRQNT" "128"
 SYSTEM_CONSTANT "GLWPLG_PWRZERO" "0"
 SYSTEM_CONSTANT "GSHDEM_TRQMAX_MAP_X" "16"
 SYSTEM_CONSTANT "GSHDEM_TRQMAX_MAP_Y" "16"
 SYSTEM_CONSTANT "GSSYS_TYPAIRCTL_SY" "1"
 SYSTEM_CONSTANT "GSSYS_TYPAIRFLW_SY" "1"
 SYSTEM_CONSTANT "GSSYS_TYPAIRSYS_SY" "1"
 SYSTEM_CONSTANT "GSSYS_TYPEAIRFLW_SY" "1"
 SYSTEM_CONSTANT "GSSYS_TYPEEXHFLW_SY" "1"
 SYSTEM_CONSTANT "GSSYS_TYPEGRCLG_SY" "1"
 SYSTEM_CONSTANT "GSSYS_TYPEGR_SY" "1"
 SYSTEM_CONSTANT "GSSYS_TYPENG_SY" "1"
 SYSTEM_CONSTANT "GSSYS_TYPEXHMNF_SY" "1"
 SYSTEM_CONSTANT "GSSYS_TYPINDVOL_SY" "1"
 SYSTEM_CONSTANT "GSSYS_TYPINTMNFLP_SY" "1"
 SYSTEM_CONSTANT "GSSYS_TYPINTMNF_SY" "1"
 SYSTEM_CONSTANT "GSSYS_TYPNSC_SY" "1"
 SYSTEM_CONSTANT "GSSYS_TYPOXIC_SY" "1"
 SYSTEM_CONSTANT "GSSYS_TYPPCR_SY" "1"
 SYSTEM_CONSTANT "GSSYS_TYPPFLT_SY" "1"
 SYSTEM_CONSTANT "GSSYS_TYPTRBCHR_SY" "1"
 SYSTEM_CONSTANT "GSSYS_TYPVSWCTL_SY" "1"
 SYSTEM_CONSTANT "GVRN" "1"
 SYSTEM_CONSTANT "HEAT_CAPACITY_RES" "0.1"
 SYSTEM_CONSTANT "HESRV_AIRSYSCALCLOCB1" "0"
 SYSTEM_CONSTANT "HESRV_AIRSYSCALCLOCB2" "0"
 SYSTEM_CONSTANT "HESRV_COSWTAVG" "0"
 SYSTEM_CONSTANT "HESRV_COSWTAVG_SY" "0"
 SYSTEM_CONSTANT "HESRV_COSWTMAX" "2"
 SYSTEM_CONSTANT "HESRV_COSWTMAX_SY" "2"
 SYSTEM_CONSTANT "HESRV_COSWTMIN" "1"
 SYSTEM_CONSTANT "HESRV_COSWTMIN_SY" "1"
 SYSTEM_CONSTANT "HESRV_COSWTSUM" "3"
 SYSTEM_CONSTANT "HESRV_COSWTSUM_SY" "3"
 SYSTEM_CONSTANT "HESRV_EGSYSCALCLOCB1" "0"
 SYSTEM_CONSTANT "HESRV_EGSYSCALCLOCB2" "0"
 SYSTEM_CONSTANT "HESRV_ENASCNDFLW_SY" "1"
 SYSTEM_CONSTANT "HESRV_HETYP_SY" "255"
 SYSTEM_CONSTANT "HESRV_LOCAL" "255"
 SYSTEM_CONSTANT "HESRV_MASTER" "0"
 SYSTEM_CONSTANT "HESRV_MASTERSLAVE" "1"
 SYSTEM_CONSTANT "HESRV_ONEBOX" "255"
 SYSTEM_CONSTANT "HESRV_SLAVE" "1"
 SYSTEM_CONSTANT "HESRV_SNGLFLW" "1"
 SYSTEM_CONSTANT "HESRV_TWFLW" "2"
 SYSTEM_CONSTANT "HIGH_PREGLOW_NORM" "250"
 SYSTEM_CONSTANT "HLSDEMFIRSTROUND" "1"
 SYSTEM_CONSTANT "HLSDEM_COLD" "17"
 SYSTEM_CONSTANT "HLSDEM_NOGRIP" "16"
 SYSTEM_CONSTANT "HLSDEM_NSETPHI_MAP_X" "8"
 SYSTEM_CONSTANT "HLSDEM_NSETPHI_MAP_Y" "8"
 SYSTEM_CONSTANT "HLSDEM_NSETPLOINI_CUR_X" "25"
 SYSTEM_CONSTANT "HLSDEM_SETPFLT_ACS" "1"
 SYSTEM_CONSTANT "HLSDEM_SETPFLT_OTHER" "32767"
 SYSTEM_CONSTANT "HLSDEM_SETPFLT_SYSERR" "3"
 SYSTEM_CONSTANT "HLSDEM_SETPFLT_TRA" "2"
 SYSTEM_CONSTANT "HLSDEM_STSETPFLT_FLT" "2"
 SYSTEM_CONSTANT "HLSDEM_STSETPFLT_RAMP" "32767"
 SYSTEM_CONSTANT "HLSDEM_STSETPFLT_TIPIN" "1"
 SYSTEM_CONSTANT "HLSDEM_STSETPFLT_UNFLT" "3"
 SYSTEM_CONSTANT "HLSDEM_TRQREQSTRT_CUR_X" "25"
 SYSTEM_CONSTANT "HLSDEM_UNDERBRAKING" "18"
 SYSTEM_CONSTANT "HPUN_2PI_REV" "9.54929658551309"
 SYSTEM_CONSTANT "HPUN_DVOLPMPAGED_CUR_X" "12"
 SYSTEM_CONSTANT "HPUN_ETAPMPFLTEMP_CUR_X" "6"
 SYSTEM_CONSTANT "HPUN_ETAPMPMAXAGED_CUR_X" "6"
 SYSTEM_CONSTANT "HPUN_QBALLIM_CUR_X" "8"
 SYSTEM_CONSTANT "HPUN_QFLTEMPLIM_MAP_X" "16"
 SYSTEM_CONSTANT "HPUN_QFLTEMPLIM_MAP_Y" "16"
 SYSTEM_CONSTANT "HPUN_VOL2DVOL_RES" "12000"
 SYSTEM_CONSTANT "HR2SEC" "3600"
 SYSTEM_CONSTANT "I15031_SIZE_SUPP_PIDS" "20"
 SYSTEM_CONSTANT "IATSCD_TLIN_CUR_X" "25"
 SYSTEM_CONSTANT "IDEAL_GAS_CONSTANT" "287.5"
 SYSTEM_CONSTANT "IDEAL_GAS_CONSTANT_FL" "287"
 SYSTEM_CONSTANT "IDEAL_GAS_CONSTANT_INT" "2875"
 SYSTEM_CONSTANT "IMPT_RES" "0.01"
 SYSTEM_CONSTANT "IMPT_RES_REV" "100"
 SYSTEM_CONSTANT "INACTIV" "4"
 SYSTEM_CONSTANT "INIT" "1"
 SYSTEM_CONSTANT "INJCRV_FACMI1APSSOECORRGN_AXIS" "12"
 SYSTEM_CONSTANT "INJCRV_FACMI1ATSSOECORRGN_AXIS" "12"
 SYSTEM_CONSTANT "INJCRV_FACMI1ETSSOECORRGN_AXIS" "12"
 SYSTEM_CONSTANT "INJCRV_FACMI1RMPVAL_GCUR_X" "11"
 SYSTEM_CONSTANT "INJCRV_FACMI1SOERMPVAL_CUR_X" "2"
 SYSTEM_CONSTANT "INJCRV_FACMIAPSPHICOR_AXIS" "12"
 SYSTEM_CONSTANT "INJCRV_FACMIAPSPHICOR_CUR_X" "8"
 SYSTEM_CONSTANT "INJCRV_FACMIATSPHICOR_AXIS" "12"
 SYSTEM_CONSTANT "INJCRV_FACMIATSPHICOR_CUR_X" "8"
 SYSTEM_CONSTANT "INJCRV_FACMIETSPHICOR_AXIS" "12"
 SYSTEM_CONSTANT "INJCRV_FACMIETSPHICOR_CUR_X" "8"
 SYSTEM_CONSTANT "INJCRV_FACMIFTSRAILCOR_CUR_X" "8"
 SYSTEM_CONSTANT "INJCRV_FACMIPFLTPHICOR_CUR_X" "12"
 SYSTEM_CONSTANT "INJCRV_FACPII1APSQCORRGN_AXIS" "12"
 SYSTEM_CONSTANT "INJCRV_FACPII1APSQCOR_AXIS" "12"
 SYSTEM_CONSTANT "INJCRV_FACPII1APSSOECORRGN_AXIS" "12"
 SYSTEM_CONSTANT "INJCRV_FACPII1APSSOECOR_AXIS" "12"
 SYSTEM_CONSTANT "INJCRV_FACPII1ATSQCORRGN_AXIS" "12"
 SYSTEM_CONSTANT "INJCRV_FACPII1ATSQCOR_AXIS" "12"
 SYSTEM_CONSTANT "INJCRV_FACPII1ATSSOECORRGN_AXIS" "12"
 SYSTEM_CONSTANT "INJCRV_FACPII1ATSSOECOR_AXIS" "12"
 SYSTEM_CONSTANT "INJCRV_FACPII1ETSQCORRGN_AXIS" "12"
 SYSTEM_CONSTANT "INJCRV_FACPII1ETSQCOR_AXIS" "12"
 SYSTEM_CONSTANT "INJCRV_FACPII1ETSSOECORRGN_AXIS" "12"
 SYSTEM_CONSTANT "INJCRV_FACPII1ETSSOECOR_AXIS" "12"
 SYSTEM_CONSTANT "INJCRV_FACPII1QNTMIN_CUR_X" "8"
 SYSTEM_CONSTANT "INJCRV_FACPII1QNTRMPVAL_CUR_X" "2"
 SYSTEM_CONSTANT "INJCRV_FACPII1RMPVAL_GCUR_X" "11"
 SYSTEM_CONSTANT "INJCRV_FACPII1SOERMPVAL_CUR_X" "2"
 SYSTEM_CONSTANT "INJCRV_FACPII2APSQCORRGN_AXIS" "12"
 SYSTEM_CONSTANT "INJCRV_FACPII2APSQCOR_CUR_X" "12"
 SYSTEM_CONSTANT "INJCRV_FACPII2APSSOECORRGN_AXIS" "12"
 SYSTEM_CONSTANT "INJCRV_FACPII2APSSOECOR_CUR_X" "12"
 SYSTEM_CONSTANT "INJCRV_FACPII2ATSQCORRGN_AXIS" "12"
 SYSTEM_CONSTANT "INJCRV_FACPII2ATSQCOR_CUR_X" "12"
 SYSTEM_CONSTANT "INJCRV_FACPII2ATSSOECORRGN_AXIS" "12"
 SYSTEM_CONSTANT "INJCRV_FACPII2ATSSOECOR_CUR_X" "12"
 SYSTEM_CONSTANT "INJCRV_FACPII2ETSQCORRGN_AXIS" "12"
 SYSTEM_CONSTANT "INJCRV_FACPII2ETSQCOR_CUR_X" "12"
 SYSTEM_CONSTANT "INJCRV_FACPII2ETSSOECORRGN_AXIS" "12"
 SYSTEM_CONSTANT "INJCRV_FACPII2ETSSOECOR_CUR_X" "12"
 SYSTEM_CONSTANT "INJCRV_FACPII2QNTMIN_CUR_X" "8"
 SYSTEM_CONSTANT "INJCRV_FACPII2RMPVAL_GCUR_X" "11"
 SYSTEM_CONSTANT "INJCRV_FACPII3APSQCOR_CUR_X" "8"
 SYSTEM_CONSTANT "INJCRV_FACPII3ATSQCOR_CUR_X" "8"
 SYSTEM_CONSTANT "INJCRV_FACPII3ETSQCOR_CUR_X" "8"
 SYSTEM_CONSTANT "INJCRV_FACPII3ETSSOECOR_CUR_X" "8"
 SYSTEM_CONSTANT "INJCRV_FACPII3QNTMIN_CUR_X" "8"
 SYSTEM_CONSTANT "INJCRV_FACPIIAPSQCOR2_CUR_X" "8"
 SYSTEM_CONSTANT "INJCRV_FACPIIAPSQCOR_CUR_X" "8"
 SYSTEM_CONSTANT "INJCRV_FACPIIATSQCOR2_CUR_X" "8"
 SYSTEM_CONSTANT "INJCRV_FACPIIATSQCOR_CUR_X" "8"
 SYSTEM_CONSTANT "INJCRV_FACPIIETSQCOR2_CUR_X" "8"
 SYSTEM_CONSTANT "INJCRV_FACPIIETSQCOR_CUR_X" "8"
 SYSTEM_CONSTANT "INJCRV_FACPIIETSSOECOR_CUR_X" "8"
 SYSTEM_CONSTANT "INJCRV_FACPOI1APSQCOR_CUR_X" "6"
 SYSTEM_CONSTANT "INJCRV_FACPOI1CATPHICOR_CUR_X" "6"
 SYSTEM_CONSTANT "INJCRV_FACPOI1CATQCOR_CUR_X" "6"
 SYSTEM_CONSTANT "INJCRV_FACPOI1ETSPHICOR_CUR_X" "2"
 SYSTEM_CONSTANT "INJCRV_FACPOI1ETSQCOR_CUR_X" "2"
 SYSTEM_CONSTANT "INJCRV_FACPOI1QNTRMPVAL_CUR_X" "2"
 SYSTEM_CONSTANT "INJCRV_FACPOI1RMPVAL_GCUR_X" "11"
 SYSTEM_CONSTANT "INJCRV_FACPOI1SOERMPVAL_CUR_X" "2"
 SYSTEM_CONSTANT "INJCRV_FACPOI2ANGRMPVAL_CUR_X" "12"
 SYSTEM_CONSTANT "INJCRV_FACPOI2APSQCORRGN_AXIS" "12"
 SYSTEM_CONSTANT "INJCRV_FACPOI2APSQCOR_CUR_X" "6"
 SYSTEM_CONSTANT "INJCRV_FACPOI2APSSOECORRGN_AXIS" "12"
 SYSTEM_CONSTANT "INJCRV_FACPOI2APSSOECOR_CUR_X" "6"
 SYSTEM_CONSTANT "INJCRV_FACPOI2ATSQCORRGN_AXIS" "12"
 SYSTEM_CONSTANT "INJCRV_FACPOI2ATSQCOR_CUR_X" "6"
 SYSTEM_CONSTANT "INJCRV_FACPOI2ATSSOECORRGN_AXIS" "12"
 SYSTEM_CONSTANT "INJCRV_FACPOI2ATSSOECOR_CUR_X" "6"
 SYSTEM_CONSTANT "INJCRV_FACPOI2EFFRGN_CUR_X" "12"
 SYSTEM_CONSTANT "INJCRV_FACPOI2EFFRGN_MAP_X" "16"
 SYSTEM_CONSTANT "INJCRV_FACPOI2EFFRGN_MAP_Y" "16"
 SYSTEM_CONSTANT "INJCRV_FACPOI2EFF_MAP_X" "8"
 SYSTEM_CONSTANT "INJCRV_FACPOI2EFF_MAP_Y" "8"
 SYSTEM_CONSTANT "INJCRV_FACPOI2ETSQCORRGN_AXIS" "12"
 SYSTEM_CONSTANT "INJCRV_FACPOI2ETSQCOR_CUR_X" "6"
 SYSTEM_CONSTANT "INJCRV_FACPOI2ETSSOECORRGN_AXIS" "12"
 SYSTEM_CONSTANT "INJCRV_FACPOI2ETSSOECOR_CUR_X" "6"
 SYSTEM_CONSTANT "INJCRV_FACPOI2QNTRMPVAL_CUR_X" "2"
 SYSTEM_CONSTANT "INJCRV_FACPOI2RMPVAL_GCUR_X" "11"
 SYSTEM_CONSTANT "INJCRV_FACPOI2SOERMPVAL_CUR_X" "2"
 SYSTEM_CONSTANT "INJCRV_FACPOI2TIRMPVAL_CUR_X" "12"
 SYSTEM_CONSTANT "INJCRV_FACPOPPOI2ETSCOR_CUR_X" "6"
 SYSTEM_CONSTANT "INJCRV_NUMINJRTMLIM_CUR_X" "8"
 SYSTEM_CONSTANT "INJCRV_PHIDYNOFS_CUR_X" "8"
 SYSTEM_CONSTANT "INJCRV_PHIMI1APSCORRGNX_AXIS" "16"
 SYSTEM_CONSTANT "INJCRV_PHIMI1APSCORRGNY_AXIS" "16"
 SYSTEM_CONSTANT "INJCRV_PHIMI1ATSCORRGNX_AXIS" "16"
 SYSTEM_CONSTANT "INJCRV_PHIMI1ATSCORRGNY_AXIS" "16"
 SYSTEM_CONSTANT "INJCRV_PHIMI1BAS1_MAP_X" "10"
 SYSTEM_CONSTANT "INJCRV_PHIMI1BAS1_MAP_Y" "10"
 SYSTEM_CONSTANT "INJCRV_PHIMI1BAS2_MAP_X" "10"
 SYSTEM_CONSTANT "INJCRV_PHIMI1BAS2_MAP_Y" "10"
 SYSTEM_CONSTANT "INJCRV_PHIMI1BAS3_MAP_X" "10"
 SYSTEM_CONSTANT "INJCRV_PHIMI1BAS3_MAP_Y" "10"
 SYSTEM_CONSTANT "INJCRV_PHIMI1BAS4_MAP_X" "2"
 SYSTEM_CONSTANT "INJCRV_PHIMI1BAS4_MAP_Y" "2"
 SYSTEM_CONSTANT "INJCRV_PHIMI1BAS5_MAP_X" "2"
 SYSTEM_CONSTANT "INJCRV_PHIMI1BAS5_MAP_Y" "2"
 SYSTEM_CONSTANT "INJCRV_PHIMI1BASRGN1X_AXIS" "16"
 SYSTEM_CONSTANT "INJCRV_PHIMI1BASRGN1Y_AXIS" "16"
 SYSTEM_CONSTANT "INJCRV_PHIMI1BASRGN2X_AXIS" "16"
 SYSTEM_CONSTANT "INJCRV_PHIMI1BASRGN2Y_AXIS" "16"
 SYSTEM_CONSTANT "INJCRV_PHIMI1BASRGN3X_AXIS" "16"
 SYSTEM_CONSTANT "INJCRV_PHIMI1BASRGN3Y_AXIS" "16"
 SYSTEM_CONSTANT "INJCRV_PHIMI1ETSCORRGNX_AXIS" "16"
 SYSTEM_CONSTANT "INJCRV_PHIMI1ETSCORRGNY_AXIS" "16"
 SYSTEM_CONSTANT "INJCRV_PHIMI1MAX_MAP_X" "16"
 SYSTEM_CONSTANT "INJCRV_PHIMI1MAX_MAP_Y" "10"
 SYSTEM_CONSTANT "INJCRV_PHIMI1MAX_X_AXIS" "16"
 SYSTEM_CONSTANT "INJCRV_PHIMI1MAX_Y_AXIS" "10"
 SYSTEM_CONSTANT "INJCRV_PHIMIAPSCOR_MAP_X" "12"
 SYSTEM_CONSTANT "INJCRV_PHIMIAPSCOR_MAP_Y" "8"
 SYSTEM_CONSTANT "INJCRV_PHIMIAPSCOR_X_AXIS" "12"
 SYSTEM_CONSTANT "INJCRV_PHIMIAPSCOR_Y_AXIS" "8"
 SYSTEM_CONSTANT "INJCRV_PHIMIATSCOR_MAP_X" "12"
 SYSTEM_CONSTANT "INJCRV_PHIMIATSCOR_MAP_Y" "8"
 SYSTEM_CONSTANT "INJCRV_PHIMIATSCOR_X_AXIS" "12"
 SYSTEM_CONSTANT "INJCRV_PHIMIATSCOR_Y_AXIS" "8"
 SYSTEM_CONSTANT "INJCRV_PHIMIETSCOR_MAP_X" "12"
 SYSTEM_CONSTANT "INJCRV_PHIMIETSCOR_MAP_Y" "8"
 SYSTEM_CONSTANT "INJCRV_PHIMIETSCOR_X_AXIS" "12"
 SYSTEM_CONSTANT "INJCRV_PHIMIETSCOR_Y_AXIS" "8"
 SYSTEM_CONSTANT "INJCRV_PHIMIFTSRAILCOR_MAP_X" "12"
 SYSTEM_CONSTANT "INJCRV_PHIMIFTSRAILCOR_MAP_Y" "8"
 SYSTEM_CONSTANT "INJCRV_PHIMIPFLTCOR_MAP_X" "16"
 SYSTEM_CONSTANT "INJCRV_PHIMIPFLTCOR_MAP_Y" "16"
 SYSTEM_CONSTANT "INJCRV_PHIPII1APSCOR1_MAP_X" "16"
 SYSTEM_CONSTANT "INJCRV_PHIPII1APSCOR1_MAP_Y" "8"
 SYSTEM_CONSTANT "INJCRV_PHIPII1APSCOR2_MAP_X" "16"
 SYSTEM_CONSTANT "INJCRV_PHIPII1APSCOR2_MAP_Y" "8"
 SYSTEM_CONSTANT "INJCRV_PHIPII1ATSCOR1_MAP_X" "16"
 SYSTEM_CONSTANT "INJCRV_PHIPII1ATSCOR1_MAP_Y" "8"
 SYSTEM_CONSTANT "INJCRV_PHIPII1ATSCOR2_MAP_X" "16"
 SYSTEM_CONSTANT "INJCRV_PHIPII1ATSCOR2_MAP_Y" "8"
 SYSTEM_CONSTANT "INJCRV_PHIPII1BAS1_MAP_X" "10"
 SYSTEM_CONSTANT "INJCRV_PHIPII1BAS1_MAP_Y" "10"
 SYSTEM_CONSTANT "INJCRV_PHIPII1BAS2_MAP_X" "10"
 SYSTEM_CONSTANT "INJCRV_PHIPII1BAS2_MAP_Y" "10"
 SYSTEM_CONSTANT "INJCRV_PHIPII1BAS3_MAP_X" "10"
 SYSTEM_CONSTANT "INJCRV_PHIPII1BAS3_MAP_Y" "10"
 SYSTEM_CONSTANT "INJCRV_PHIPII1ETSCOR1_MAP_X" "16"
 SYSTEM_CONSTANT "INJCRV_PHIPII1ETSCOR1_MAP_Y" "8"
 SYSTEM_CONSTANT "INJCRV_PHIPII1ETSCOR2_MAP_X" "16"
 SYSTEM_CONSTANT "INJCRV_PHIPII1ETSCOR2_MAP_Y" "8"
 SYSTEM_CONSTANT "INJCRV_PHIPII1ETSCOR_MAP_X" "16"
 SYSTEM_CONSTANT "INJCRV_PHIPII1ETSCOR_MAP_Y" "8"
 SYSTEM_CONSTANT "INJCRV_PHIPII2APSCOR_MAP_X" "16"
 SYSTEM_CONSTANT "INJCRV_PHIPII2APSCOR_MAP_Y" "8"
 SYSTEM_CONSTANT "INJCRV_PHIPII2ATSCOR_MAP_X" "16"
 SYSTEM_CONSTANT "INJCRV_PHIPII2ATSCOR_MAP_Y" "8"
 SYSTEM_CONSTANT "INJCRV_PHIPII2BAS_MAP_X" "10"
 SYSTEM_CONSTANT "INJCRV_PHIPII2BAS_MAP_Y" "10"
 SYSTEM_CONSTANT "INJCRV_PHIPII2ETSCOR_MAP_X" "16"
 SYSTEM_CONSTANT "INJCRV_PHIPII2ETSCOR_MAP_Y" "8"
 SYSTEM_CONSTANT "INJCRV_PHIPII3BAS1_MAP_X" "10"
 SYSTEM_CONSTANT "INJCRV_PHIPII3BAS1_MAP_Y" "10"
 SYSTEM_CONSTANT "INJCRV_PHIPII3BAS2_MAP_X" "10"
 SYSTEM_CONSTANT "INJCRV_PHIPII3BAS2_MAP_Y" "10"
 SYSTEM_CONSTANT "INJCRV_PHIPII3ETSCOR_MAP_X" "16"
 SYSTEM_CONSTANT "INJCRV_PHIPII3ETSCOR_MAP_Y" "8"
 SYSTEM_CONSTANT "INJCRV_PHIPII3ETS_MAP_X" "10"
 SYSTEM_CONSTANT "INJCRV_PHIPII3ETS_MAP_Y" "10"
 SYSTEM_CONSTANT "INJCRV_PHIPOI1BASRGNX_AXIS" "16"
 SYSTEM_CONSTANT "INJCRV_PHIPOI1BASRGNY_AXIS" "16"
 SYSTEM_CONSTANT "INJCRV_PHIPOI1BAS_MAP_X" "2"
 SYSTEM_CONSTANT "INJCRV_PHIPOI1BAS_MAP_Y" "2"
 SYSTEM_CONSTANT "INJCRV_PHIPOI1CATCOR_MAP_X" "6"
 SYSTEM_CONSTANT "INJCRV_PHIPOI1CATCOR_MAP_Y" "6"
 SYSTEM_CONSTANT "INJCRV_PHIPOI1ETSCOR_MAP_X" "2"
 SYSTEM_CONSTANT "INJCRV_PHIPOI1ETSCOR_MAP_Y" "2"
 SYSTEM_CONSTANT "INJCRV_PHIPOI1MAX_MAP_X" "8"
 SYSTEM_CONSTANT "INJCRV_PHIPOI1MAX_MAP_Y" "8"
 SYSTEM_CONSTANT "INJCRV_PHIPOI2APSCORRGNX_AXIS" "16"
 SYSTEM_CONSTANT "INJCRV_PHIPOI2APSCORRGNY_AXIS" "16"
 SYSTEM_CONSTANT "INJCRV_PHIPOI2APSCOR_MAP_X" "16"
 SYSTEM_CONSTANT "INJCRV_PHIPOI2APSCOR_MAP_Y" "8"
 SYSTEM_CONSTANT "INJCRV_PHIPOI2ATSCORRGNX_AXIS" "16"
 SYSTEM_CONSTANT "INJCRV_PHIPOI2ATSCORRGNY_AXIS" "16"
 SYSTEM_CONSTANT "INJCRV_PHIPOI2ATSCOR_MAP_X" "16"
 SYSTEM_CONSTANT "INJCRV_PHIPOI2ATSCOR_MAP_Y" "8"
 SYSTEM_CONSTANT "INJCRV_PHIPOI2BASRGNX_AXIS" "16"
 SYSTEM_CONSTANT "INJCRV_PHIPOI2BASRGNY_AXIS" "16"
 SYSTEM_CONSTANT "INJCRV_PHIPOI2BAS_MAP_X" "10"
 SYSTEM_CONSTANT "INJCRV_PHIPOI2BAS_MAP_Y" "10"
 SYSTEM_CONSTANT "INJCRV_PHIPOI2ETSCORRGNX_AXIS" "16"
 SYSTEM_CONSTANT "INJCRV_PHIPOI2ETSCORRGNY_AXIS" "16"
 SYSTEM_CONSTANT "INJCRV_PHIPOI2ETSCOR_MAP_X" "16"
 SYSTEM_CONSTANT "INJCRV_PHIPOI2ETSCOR_MAP_Y" "8"
 SYSTEM_CONSTANT "INJCRV_PHIPOI2MAXRGN_MAP_X" "16"
 SYSTEM_CONSTANT "INJCRV_PHIPOI2MAXRGN_MAP_Y" "16"
 SYSTEM_CONSTANT "INJCRV_PHIPOI2MINOILDIL_CUR_X" "6"
 SYSTEM_CONSTANT "INJCRV_PHIPOI2REPLNRM_MAP_X" "16"
 SYSTEM_CONSTANT "INJCRV_PHIPOI2REPLNRM_MAP_Y" "16"
 SYSTEM_CONSTANT "INJCRV_PIIDBLCORMAP_OFF" "0"
 SYSTEM_CONSTANT "INJCRV_PIIDBLCORMAP_ON" "1"
 SYSTEM_CONSTANT "INJCRV_PIONOFF_OFF" "255"
 SYSTEM_CONSTANT "INJCRV_PIONOFF_ON" "0"
 SYSTEM_CONSTANT "INJCRV_POPPII1BAS_MAP_X" "16"
 SYSTEM_CONSTANT "INJCRV_POPPII1BAS_MAP_Y" "10"
 SYSTEM_CONSTANT "INJCRV_POPPII2BAS_MAP_X" "16"
 SYSTEM_CONSTANT "INJCRV_POPPII2BAS_MAP_Y" "10"
 SYSTEM_CONSTANT "INJCRV_POPPIIAIRCOR_CUR_X" "8"
 SYSTEM_CONSTANT "INJCRV_POPPIICTSCOR_CUR_X" "8"
 SYSTEM_CONSTANT "INJCRV_POPPOI1BAS_MAP_X" "2"
 SYSTEM_CONSTANT "INJCRV_POPPOI1BAS_MAP_Y" "2"
 SYSTEM_CONSTANT "INJCRV_POPPOI1ETSCOR_CUR_X" "2"
 SYSTEM_CONSTANT "INJCRV_POPPOI1RGN_MAP_X" "6"
 SYSTEM_CONSTANT "INJCRV_POPPOI1RGN_MAP_Y" "6"
 SYSTEM_CONSTANT "INJCRV_POPPOI2BAS_MAP_X" "6"
 SYSTEM_CONSTANT "INJCRV_POPPOI2BAS_MAP_Y" "6"
 SYSTEM_CONSTANT "INJCRV_POPPOI2ETSCOR_MAP_X" "6"
 SYSTEM_CONSTANT "INJCRV_POPPOI2ETSCOR_MAP_Y" "6"
 SYSTEM_CONSTANT "INJCRV_POPPOI2RGN_MAP_X" "6"
 SYSTEM_CONSTANT "INJCRV_POPPOI2RGN_MAP_Y" "6"
 SYSTEM_CONSTANT "INJCRV_QACT" "1"
 SYSTEM_CONSTANT "INJCRV_QMIN1_CUR_X" "25"
 SYSTEM_CONSTANT "INJCRV_QMIN2_CUR_X" "25"
 SYSTEM_CONSTANT "INJCRV_QMIN3_CUR_X" "25"
 SYSTEM_CONSTANT "INJCRV_QMIN4_CUR_X" "25"
 SYSTEM_CONSTANT "INJCRV_QMIN5_CUR_X" "25"
 SYSTEM_CONSTANT "INJCRV_QMIN_CUR_X" "16"
 SYSTEM_CONSTANT "INJCRV_QMIN_MAP_X" "16"
 SYSTEM_CONSTANT "INJCRV_QMIN_MAP_Y" "16"
 SYSTEM_CONSTANT "INJCRV_QPII1APSCORRGNX_AXIS" "16"
 SYSTEM_CONSTANT "INJCRV_QPII1APSCORRGNY_AXIS" "16"
 SYSTEM_CONSTANT "INJCRV_QPII1APSCOR_MAP_X" "16"
 SYSTEM_CONSTANT "INJCRV_QPII1APSCOR_MAP_Y" "8"
 SYSTEM_CONSTANT "INJCRV_QPII1APSCOR_X_AXIS" "16"
 SYSTEM_CONSTANT "INJCRV_QPII1APSCOR_Y_AXIS" "8"
 SYSTEM_CONSTANT "INJCRV_QPII1ATSCORRGNX_AXIS" "16"
 SYSTEM_CONSTANT "INJCRV_QPII1ATSCORRGNY_AXIS" "16"
 SYSTEM_CONSTANT "INJCRV_QPII1ATSCOR_MAP_X" "16"
 SYSTEM_CONSTANT "INJCRV_QPII1ATSCOR_MAP_Y" "8"
 SYSTEM_CONSTANT "INJCRV_QPII1ATSCOR_X_AXIS" "16"
 SYSTEM_CONSTANT "INJCRV_QPII1ATSCOR_Y_AXIS" "8"
 SYSTEM_CONSTANT "INJCRV_QPII1BASRGNX_AXIS" "16"
 SYSTEM_CONSTANT "INJCRV_QPII1BASRGNY_AXIS" "16"
 SYSTEM_CONSTANT "INJCRV_QPII1BAS_MAP_X" "16"
 SYSTEM_CONSTANT "INJCRV_QPII1BAS_MAP_Y" "16"
 SYSTEM_CONSTANT "INJCRV_QPII1BAS_X_AXIS" "16"
 SYSTEM_CONSTANT "INJCRV_QPII1BAS_Y_AXIS" "16"
 SYSTEM_CONSTANT "INJCRV_QPII1ETSCORRGNX_AXIS" "16"
 SYSTEM_CONSTANT "INJCRV_QPII1ETSCORRGNY_AXIS" "16"
 SYSTEM_CONSTANT "INJCRV_QPII1ETSCOR_MAP_X" "16"
 SYSTEM_CONSTANT "INJCRV_QPII1ETSCOR_MAP_Y" "8"
 SYSTEM_CONSTANT "INJCRV_QPII1ETSCOR_X_AXIS" "16"
 SYSTEM_CONSTANT "INJCRV_QPII1ETSCOR_Y_AXIS" "8"
 SYSTEM_CONSTANT "INJCRV_QPII1MAXRGN_MAP_X" "16"
 SYSTEM_CONSTANT "INJCRV_QPII1MAXRGN_MAP_Y" "16"
 SYSTEM_CONSTANT "INJCRV_QPII1MAX_MAP_X" "16"
 SYSTEM_CONSTANT "INJCRV_QPII1MAX_MAP_Y" "10"
 SYSTEM_CONSTANT "INJCRV_QPII1MAX_X_AXIS" "16"
 SYSTEM_CONSTANT "INJCRV_QPII1MAX_Y_AXIS" "10"
 SYSTEM_CONSTANT "INJCRV_QPII2APSCORRGNX_AXIS" "16"
 SYSTEM_CONSTANT "INJCRV_QPII2APSCORRGNY_AXIS" "16"
 SYSTEM_CONSTANT "INJCRV_QPII2APSCOR_MAP_X" "16"
 SYSTEM_CONSTANT "INJCRV_QPII2APSCOR_MAP_Y" "8"
 SYSTEM_CONSTANT "INJCRV_QPII2ATSCORRGNX_AXIS" "16"
 SYSTEM_CONSTANT "INJCRV_QPII2ATSCORRGNY_AXIS" "16"
 SYSTEM_CONSTANT "INJCRV_QPII2ATSCOR_MAP_X" "16"
 SYSTEM_CONSTANT "INJCRV_QPII2ATSCOR_MAP_Y" "8"
 SYSTEM_CONSTANT "INJCRV_QPII2BAS_MAP_X" "10"
 SYSTEM_CONSTANT "INJCRV_QPII2BAS_MAP_Y" "10"
 SYSTEM_CONSTANT "INJCRV_QPII2ETSCORRGNX_AXIS" "16"
 SYSTEM_CONSTANT "INJCRV_QPII2ETSCORRGNY_AXIS" "16"
 SYSTEM_CONSTANT "INJCRV_QPII2ETSCOR_MAP_X" "16"
 SYSTEM_CONSTANT "INJCRV_QPII2ETSCOR_MAP_Y" "8"
 SYSTEM_CONSTANT "INJCRV_QPII2MAX_MAP_X" "8"
 SYSTEM_CONSTANT "INJCRV_QPII2MAX_MAP_Y" "8"
 SYSTEM_CONSTANT "INJCRV_QPII3APSCOR_MAP_X" "16"
 SYSTEM_CONSTANT "INJCRV_QPII3APSCOR_MAP_Y" "8"
 SYSTEM_CONSTANT "INJCRV_QPII3ATSCOR_MAP_X" "16"
 SYSTEM_CONSTANT "INJCRV_QPII3ATSCOR_MAP_Y" "8"
 SYSTEM_CONSTANT "INJCRV_QPII3BAS_MAP_X" "16"
 SYSTEM_CONSTANT "INJCRV_QPII3BAS_MAP_Y" "16"
 SYSTEM_CONSTANT "INJCRV_QPII3ETSCOR_MAP_X" "16"
 SYSTEM_CONSTANT "INJCRV_QPII3ETSCOR_MAP_Y" "8"
 SYSTEM_CONSTANT "INJCRV_QPII3MAX_MAP_X" "16"
 SYSTEM_CONSTANT "INJCRV_QPII3MAX_MAP_Y" "10"
 SYSTEM_CONSTANT "INJCRV_QPIIAPSCOR_MAP_X" "16"
 SYSTEM_CONSTANT "INJCRV_QPIIAPSCOR_MAP_Y" "8"
 SYSTEM_CONSTANT "INJCRV_QPIIATSCOR_MAP_X" "16"
 SYSTEM_CONSTANT "INJCRV_QPIIATSCOR_MAP_Y" "8"
 SYSTEM_CONSTANT "INJCRV_QPIIETSCOR_MAP_X" "16"
 SYSTEM_CONSTANT "INJCRV_QPIIETSCOR_MAP_Y" "8"
 SYSTEM_CONSTANT "INJCRV_QPOI1APSCOR_MAP_X" "2"
 SYSTEM_CONSTANT "INJCRV_QPOI1APSCOR_MAP_Y" "2"
 SYSTEM_CONSTANT "INJCRV_QPOI1BASRGNX_AXIS" "16"
 SYSTEM_CONSTANT "INJCRV_QPOI1BASRGNY_AXIS" "16"
 SYSTEM_CONSTANT "INJCRV_QPOI1BAS_MAP_X" "2"
 SYSTEM_CONSTANT "INJCRV_QPOI1BAS_MAP_Y" "2"
 SYSTEM_CONSTANT "INJCRV_QPOI1CATCOR_MAP_X" "6"
 SYSTEM_CONSTANT "INJCRV_QPOI1CATCOR_MAP_Y" "6"
 SYSTEM_CONSTANT "INJCRV_QPOI1ETSCOR_MAP_X" "2"
 SYSTEM_CONSTANT "INJCRV_QPOI1ETSCOR_MAP_Y" "2"
 SYSTEM_CONSTANT "INJCRV_QPOI1MAX_MAP_X" "6"
 SYSTEM_CONSTANT "INJCRV_QPOI1MAX_MAP_Y" "6"
 SYSTEM_CONSTANT "INJCRV_QPOI2APSCORRGNX_AXIS" "16"
 SYSTEM_CONSTANT "INJCRV_QPOI2APSCORRGNY_AXIS" "16"
 SYSTEM_CONSTANT "INJCRV_QPOI2APSCOR_MAP_X" "6"
 SYSTEM_CONSTANT "INJCRV_QPOI2APSCOR_MAP_Y" "6"
 SYSTEM_CONSTANT "INJCRV_QPOI2ATSCORRGNX_AXIS" "16"
 SYSTEM_CONSTANT "INJCRV_QPOI2ATSCORRGNY_AXIS" "16"
 SYSTEM_CONSTANT "INJCRV_QPOI2ATSCOR_MAP_X" "6"
 SYSTEM_CONSTANT "INJCRV_QPOI2ATSCOR_MAP_Y" "6"
 SYSTEM_CONSTANT "INJCRV_QPOI2BASRGNX_AXIS" "16"
 SYSTEM_CONSTANT "INJCRV_QPOI2BASRGNY_AXIS" "16"
 SYSTEM_CONSTANT "INJCRV_QPOI2BAS_MAP_X" "8"
 SYSTEM_CONSTANT "INJCRV_QPOI2BAS_MAP_Y" "8"
 SYSTEM_CONSTANT "INJCRV_QPOI2ETSCORRGNX_AXIS" "16"
 SYSTEM_CONSTANT "INJCRV_QPOI2ETSCORRGNY_AXIS" "16"
 SYSTEM_CONSTANT "INJCRV_QPOI2ETSCOR_MAP_X" "6"
 SYSTEM_CONSTANT "INJCRV_QPOI2ETSCOR_MAP_Y" "6"
 SYSTEM_CONSTANT "INJCRV_QPOI2MIN_CUR_X" "6"
 SYSTEM_CONSTANT "INJCRV_QRAW" "0"
 SYSTEM_CONSTANT "INJCRV_STPIIRLSOPRNG1_MAP_X" "8"
 SYSTEM_CONSTANT "INJCRV_STPIIRLSOPRNG1_MAP_Y" "8"
 SYSTEM_CONSTANT "INJCRV_STPIIRLSOPRNG2_MAP_X" "8"
 SYSTEM_CONSTANT "INJCRV_STPIIRLSOPRNG2_MAP_Y" "8"
 SYSTEM_CONSTANT "INJCRV_STPIIRLSOPRNG3_MAP_X" "8"
 SYSTEM_CONSTANT "INJCRV_STPIIRLSOPRNG3_MAP_Y" "8"
 SYSTEM_CONSTANT "INJCRV_STPIIRLSOPRNG4_MAP_X" "8"
 SYSTEM_CONSTANT "INJCRV_STPIIRLSOPRNG4_MAP_Y" "8"
 SYSTEM_CONSTANT "INJCRV_STPIIRLSOPRNG5_MAP_X" "8"
 SYSTEM_CONSTANT "INJCRV_STPIIRLSOPRNG5_MAP_Y" "8"
 SYSTEM_CONSTANT "INJCRV_STRLSOPRNGTHRESRGN_MAP_X" "16"
 SYSTEM_CONSTANT "INJCRV_STRLSOPRNGTHRESRGN_MAP_Y" "16"
 SYSTEM_CONSTANT "INJCRV_STRLSOPRNGTHRES_MAP_X" "8"
 SYSTEM_CONSTANT "INJCRV_STRLSOPRNGTHRES_MAP_Y" "8"
 SYSTEM_CONSTANT "INJCRV_SWTPIIDBLCORMAP_TYPE" "2"
 SYSTEM_CONSTANT "INJCRV_SWTPIIDBLCORMAP_VAL" "0"
 SYSTEM_CONSTANT "INJCRV_SWTPIONOFF_TYPE" "0"
 SYSTEM_CONSTANT "INJCRV_SWTPIONOFF_VAL" "0"
 SYSTEM_CONSTANT "INJCRV_SWTTIPSE_TYPE" "2"
 SYSTEM_CONSTANT "INJCRV_SWTTIPSE_VAL" "0"
 SYSTEM_CONSTANT "INJCRV_TIPII1APSCOR1_MAP_X" "16"
 SYSTEM_CONSTANT "INJCRV_TIPII1APSCOR1_MAP_Y" "8"
 SYSTEM_CONSTANT "INJCRV_TIPII1APSCOR2_MAP_X" "16"
 SYSTEM_CONSTANT "INJCRV_TIPII1APSCOR2_MAP_Y" "8"
 SYSTEM_CONSTANT "INJCRV_TIPII1APSCORRGNX_AXIS" "16"
 SYSTEM_CONSTANT "INJCRV_TIPII1APSCORRGNY_AXIS" "16"
 SYSTEM_CONSTANT "INJCRV_TIPII1ATSCOR1_MAP_X" "16"
 SYSTEM_CONSTANT "INJCRV_TIPII1ATSCOR1_MAP_Y" "8"
 SYSTEM_CONSTANT "INJCRV_TIPII1ATSCOR2_MAP_X" "16"
 SYSTEM_CONSTANT "INJCRV_TIPII1ATSCOR2_MAP_Y" "8"
 SYSTEM_CONSTANT "INJCRV_TIPII1ATSCORRGNX_AXIS" "16"
 SYSTEM_CONSTANT "INJCRV_TIPII1ATSCORRGNY_AXIS" "16"
 SYSTEM_CONSTANT "INJCRV_TIPII1BAS1_MAP_X" "12"
 SYSTEM_CONSTANT "INJCRV_TIPII1BAS1_MAP_Y" "16"
 SYSTEM_CONSTANT "INJCRV_TIPII1BAS2_MAP_X" "10"
 SYSTEM_CONSTANT "INJCRV_TIPII1BAS2_MAP_Y" "12"
 SYSTEM_CONSTANT "INJCRV_TIPII1BAS3_MAP_X" "2"
 SYSTEM_CONSTANT "INJCRV_TIPII1BAS3_MAP_Y" "2"
 SYSTEM_CONSTANT "INJCRV_TIPII1BASRGNX_AXIS" "16"
 SYSTEM_CONSTANT "INJCRV_TIPII1BASRGNY_AXIS" "16"
 SYSTEM_CONSTANT "INJCRV_TIPII1ETSCOR1_MAP_X" "16"
 SYSTEM_CONSTANT "INJCRV_TIPII1ETSCOR1_MAP_Y" "8"
 SYSTEM_CONSTANT "INJCRV_TIPII1ETSCOR2_MAP_X" "16"
 SYSTEM_CONSTANT "INJCRV_TIPII1ETSCOR2_MAP_Y" "8"
 SYSTEM_CONSTANT "INJCRV_TIPII1ETSCORRGNX_AXIS" "16"
 SYSTEM_CONSTANT "INJCRV_TIPII1ETSCORRGNY_AXIS" "16"
 SYSTEM_CONSTANT "INJCRV_TIPII1ETSCOR_MAP_X" "16"
 SYSTEM_CONSTANT "INJCRV_TIPII1ETSCOR_MAP_Y" "8"
 SYSTEM_CONSTANT "INJCRV_TIPII2APSCORRGNX_AXIS" "16"
 SYSTEM_CONSTANT "INJCRV_TIPII2APSCORRGNY_AXIS" "16"
 SYSTEM_CONSTANT "INJCRV_TIPII2APSCOR_MAP_X" "16"
 SYSTEM_CONSTANT "INJCRV_TIPII2APSCOR_MAP_Y" "12"
 SYSTEM_CONSTANT "INJCRV_TIPII2ATSCORRGNX_AXIS" "16"
 SYSTEM_CONSTANT "INJCRV_TIPII2ATSCORRGNY_AXIS" "16"
 SYSTEM_CONSTANT "INJCRV_TIPII2ATSCOR_MAP_X" "16"
 SYSTEM_CONSTANT "INJCRV_TIPII2ATSCOR_MAP_Y" "12"
 SYSTEM_CONSTANT "INJCRV_TIPII2BAS_MAP_X" "10"
 SYSTEM_CONSTANT "INJCRV_TIPII2BAS_MAP_Y" "10"
 SYSTEM_CONSTANT "INJCRV_TIPII2ETSCORRGNX_AXIS" "16"
 SYSTEM_CONSTANT "INJCRV_TIPII2ETSCORRGNY_AXIS" "16"
 SYSTEM_CONSTANT "INJCRV_TIPII2ETSCOR_MAP_X" "16"
 SYSTEM_CONSTANT "INJCRV_TIPII2ETSCOR_MAP_Y" "16"
 SYSTEM_CONSTANT "INJCRV_TIPOI2APSCOR_MAP_X" "16"
 SYSTEM_CONSTANT "INJCRV_TIPOI2APSCOR_MAP_Y" "8"
 SYSTEM_CONSTANT "INJCRV_TIPOI2ATSCOR_MAP_X" "12"
 SYSTEM_CONSTANT "INJCRV_TIPOI2ATSCOR_MAP_Y" "8"
 SYSTEM_CONSTANT "INJCRV_TIPOI2BAS_MAP_X" "10"
 SYSTEM_CONSTANT "INJCRV_TIPOI2BAS_MAP_Y" "10"
 SYSTEM_CONSTANT "INJCRV_TIPOI2ETSCOR_MAP_X" "12"
 SYSTEM_CONSTANT "INJCRV_TIPOI2ETSCOR_MAP_Y" "8"
 SYSTEM_CONSTANT "INJCRV_TIPOI2MAX_MAP_X" "4"
 SYSTEM_CONSTANT "INJCRV_TIPOI2MAX_MAP_Y" "4"
 SYSTEM_CONSTANT "INJCRV_TIPSE_CONST" "0"
 SYSTEM_CONSTANT "INJCRV_TIPSE_UPD" "1"
 SYSTEM_CONSTANT "INJCRV_ZR" "0"
 SYSTEM_CONSTANT "INJCTL_QADJQNT_MAP_X" "8"
 SYSTEM_CONSTANT "INJCTL_QADJQNT_MAP_Y" "6"
 SYSTEM_CONSTANT "INJCTL_QLIMERR_CUR_X" "25"
 SYSTEM_CONSTANT "INJSYS_CRS_PII2" "1"
 SYSTEM_CONSTANT "INJSYS_CRS_PII3" "1"
 SYSTEM_CONSTANT "INJSYS_CRS_QWC" "1"
 SYSTEM_CONSTANT "INJSYS_SWTRC" "1"
 SYSTEM_CONSTANT "INJTIME_US_MAX" "400"
 SYSTEM_CONSTANT "INJTIME_US_ZERO" "0"
 SYSTEM_CONSTANT "INJUN_FACFLMASSCNV_MAP_X" "16"
 SYSTEM_CONSTANT "INJUN_FACFLMASSCNV_MAP_Y" "16"
 SYSTEM_CONSTANT "INJVCD_TIET2_MAP_X" "16"
 SYSTEM_CONSTANT "INJVCD_TIET2_MAP_Y" "20"
 SYSTEM_CONSTANT "INJVCD_TIET3_MAP_X" "16"
 SYSTEM_CONSTANT "INJVCD_TIET3_MAP_Y" "20"
 SYSTEM_CONSTANT "INJVCD_TIET4_MAP_X" "16"
 SYSTEM_CONSTANT "INJVCD_TIET4_MAP_Y" "20"
 SYSTEM_CONSTANT "INJVCD_TIET5_MAP_X" "16"
 SYSTEM_CONSTANT "INJVCD_TIET5_MAP_Y" "20"
 SYSTEM_CONSTANT "INJVCD_TIET6_MAP_X" "16"
 SYSTEM_CONSTANT "INJVCD_TIET6_MAP_Y" "20"
 SYSTEM_CONSTANT "INJVCD_TIET_MAP_X" "16"
 SYSTEM_CONSTANT "INJVCD_TIET_MAP_Y" "20"
 SYSTEM_CONSTANT "INJVCD_TIPICKUPCURR_CUR_X" "2"
 SYSTEM_CONSTANT "INJVLV_FACADDBALRLS_MAP_X" "3"
 SYSTEM_CONSTANT "INJVLV_FACADDBALRLS_MAP_Y" "2"
 SYSTEM_CONSTANT "INJVLV_FACPII1QNTCOR_CUR_X" "10"
 SYSTEM_CONSTANT "INJVLV_MI1" "2"
 SYSTEM_CONSTANT "INJVLV_MI2" "3"
 SYSTEM_CONSTANT "INJVLV_NUMINJCHRGBAL_MAP_X" "15"
 SYSTEM_CONSTANT "INJVLV_NUMINJCHRGBAL_MAP_Y" "6"
 SYSTEM_CONSTANT "INJVLV_NUM_BNK" "1"
 SYSTEM_CONSTANT "INJVLV_NUM_BUFVLTG" "1"
 SYSTEM_CONSTANT "INJVLV_NUM_BUF_PER_ADCCHN" "1"
 SYSTEM_CONSTANT "INJVLV_NUM_CHIPS" "1"
 SYSTEM_CONSTANT "INJVLV_NUM_INJ_PLC" "10"
 SYSTEM_CONSTANT "INJVLV_PII1" "4"
 SYSTEM_CONSTANT "INJVLV_PII2" "5"
 SYSTEM_CONSTANT "INJVLV_PII3" "6"
 SYSTEM_CONSTANT "INJVLV_PII4" "7"
 SYSTEM_CONSTANT "INJVLV_PMIN_CUR_X" "8"
 SYSTEM_CONSTANT "INJVLV_POI1" "0"
 SYSTEM_CONSTANT "INJVLV_POI2" "1"
 SYSTEM_CONSTANT "INJVLV_POI2EFF" "8"
 SYSTEM_CONSTANT "INJVLV_SEL_MI1" "6"
 SYSTEM_CONSTANT "INJVLV_SEL_MI1PII1" "7"
 SYSTEM_CONSTANT "INJVLV_SEL_MI1PII1PII2" "8"
 SYSTEM_CONSTANT "INJVLV_SEL_MI1PII1PII3" "9"
 SYSTEM_CONSTANT "INJVLV_SEL_MI1_ESTET" "3"
 SYSTEM_CONSTANT "INJVLV_SEL_PII1" "10"
 SYSTEM_CONSTANT "INJVLV_SEL_PII1PII2" "11"
 SYSTEM_CONSTANT "INJVLV_SEL_PII1_ESTET" "0"
 SYSTEM_CONSTANT "INJVLV_SEL_PII2" "12"
 SYSTEM_CONSTANT "INJVLV_SEL_PII2_ESTET" "1"
 SYSTEM_CONSTANT "INJVLV_SEL_PII3" "13"
 SYSTEM_CONSTANT "INJVLV_SEL_PII3_ESTET" "2"
 SYSTEM_CONSTANT "INJVLV_SEL_POI1" "14"
 SYSTEM_CONSTANT "INJVLV_SEL_POI1_ESTET" "4"
 SYSTEM_CONSTANT "INJVLV_SEL_POI2" "15"
 SYSTEM_CONSTANT "INJVLV_SEL_POI2_ESTET" "5"
 SYSTEM_CONSTANT "INJVLV_TCTLINJ" "63"
 SYSTEM_CONSTANT "INJVLV_TIET2_MAP_X" "16"
 SYSTEM_CONSTANT "INJVLV_TIET2_MAP_Y" "20"
 SYSTEM_CONSTANT "INJVLV_TIET3_MAP_X" "16"
 SYSTEM_CONSTANT "INJVLV_TIET3_MAP_Y" "20"
 SYSTEM_CONSTANT "INJVLV_TIET4_MAP_X" "16"
 SYSTEM_CONSTANT "INJVLV_TIET4_MAP_Y" "20"
 SYSTEM_CONSTANT "INJVLV_TIET5_MAP_X" "16"
 SYSTEM_CONSTANT "INJVLV_TIET5_MAP_Y" "20"
 SYSTEM_CONSTANT "INJVLV_TIET6_MAP_X" "16"
 SYSTEM_CONSTANT "INJVLV_TIET6_MAP_Y" "20"
 SYSTEM_CONSTANT "INJVLV_TIET_C011_MAP_Y" "40"
 SYSTEM_CONSTANT "INJVLV_TIET_MAP_X" "16"
 SYSTEM_CONSTANT "INJVLV_TIET_MAP_Y" "20"
 SYSTEM_CONSTANT "INJVLV_TIPICKUPCURR_CUR_X" "2"
 SYSTEM_CONSTANT "INJVLV_ZFC" "9"
 SYSTEM_CONSTANT "INJ_MASS100_MAX" "100"
 SYSTEM_CONSTANT "INJ_MASSCYC_MAX" "327.67"
 SYSTEM_CONSTANT "INJ_MASSCYC_MIN" "0"
 SYSTEM_CONSTANT "INJ_MASSCYC_RES" "0.01"
 SYSTEM_CONSTANT "INJ_MASSCYC_RES_INV" "100"
 SYSTEM_CONSTANT "INJ_MASSCYC_ZERO" "0"
 SYSTEM_CONSTANT "INJ_MASSETCTL_MAX" "200"
 SYSTEM_CONSTANT "INJ_MASSETCTL_MIN" "-200"
 SYSTEM_CONSTANT "INJ_MASSINJ_MAX" "327.67"
 SYSTEM_CONSTANT "INJ_MASSINJ_MIN" "0"
 SYSTEM_CONSTANT "INJ_MASSINJ_RES" "0.01"
 SYSTEM_CONSTANT "INJ_MASSINJ_RES_REV" "100"
 SYSTEM_CONSTANT "INJ_MASSMIN_MAX" "10"
 SYSTEM_CONSTANT "INJ_MASSPII1_MAX" "10"
 SYSTEM_CONSTANT "INJ_MASSPII2_MAX" "10"
 SYSTEM_CONSTANT "INJ_MASSPII3_MAX" "10"
 SYSTEM_CONSTANT "INJ_MASSPOI1_MAX" "10"
 SYSTEM_CONSTANT "INJ_MASSPOI2_MAX" "10"
 SYSTEM_CONSTANT "INJ_MASS_ETCTL" "0.1"
 SYSTEM_CONSTANT "INJ_MASS_MAX" "327.67"
 SYSTEM_CONSTANT "INJ_MASS_MIN" "0"
 SYSTEM_CONSTANT "INJ_MASS_ONE" "1"
 SYSTEM_CONSTANT "INJ_MASS_RES" "0.01"
 SYSTEM_CONSTANT "INJ_MASS_RES_FL" "0.01"
 SYSTEM_CONSTANT "INJ_MASS_RES_INV" "100"
 SYSTEM_CONSTANT "INJ_MASS_RES_INV_FL" "100"
 SYSTEM_CONSTANT "INJ_MASS_ZERO" "0"
 SYSTEM_CONSTANT "INJ_QNTINJ_MAX" "100"
 SYSTEM_CONSTANT "INJ_QNTINJ_MIN" "0"
 SYSTEM_CONSTANT "INJ_QNTINJ_RES" "0.01"
 SYSTEM_CONSTANT "INJ_QNTINJ_ZERO" "0"
 SYSTEM_CONSTANT "INJ_QNT_RES" "0.1"
 SYSTEM_CONSTANT "ISC_ACTIVE" "0"
 SYSTEM_CONSTANT "ISC_DNACCLIM_MAX" "12000"
 SYSTEM_CONSTANT "ISC_DNACCLIM_MIN" "0"
 SYSTEM_CONSTANT "ISC_DNDECLIM_MAX" "0"
 SYSTEM_CONSTANT "ISC_DNDECLIM_MIN" "-12000"
 SYSTEM_CONSTANT "ISC_EPM_N_MAX_FL" "6000"
 SYSTEM_CONSTANT "ISC_EPM_N_MIN_FL" "40"
 SYSTEM_CONSTANT "ISC_EPM_N_ZERO_FL" "0"
 SYSTEM_CONSTANT "ISC_INIRTIA_MAX" "20"
 SYSTEM_CONSTANT "ISC_INIRTIA_MIN" "0"
 SYSTEM_CONSTANT "ISC_LO_MAX_CONF" "10"
 SYSTEM_CONSTANT "ISC_NOEXTINIT" "255"
 SYSTEM_CONSTANT "ISC_NRFU_ENGICO" "128"
 SYSTEM_CONSTANT "ISC_NRFU_GSHDEM" "2"
 SYSTEM_CONSTANT "ISC_NRFU_HLSDEM" "1"
 SYSTEM_CONSTANT "ISC_NRFU_INVALID" "-1"
 SYSTEM_CONSTANT "ISC_NRFU_ISC" "0"
 SYSTEM_CONSTANT "ISC_NRFU_MAXNR" "2"
 SYSTEM_CONSTANT "ISC_NRFU_WESDEM" "3"
 SYSTEM_CONSTANT "ISC_N_RES_FL" "0.5"
 SYSTEM_CONSTANT "ISC_RNENGVVEH_MAX" "1000"
 SYSTEM_CONSTANT "ISC_RNENGVVEH_MIN" "0"
 SYSTEM_CONSTANT "ISC_SLIPDETEC_FAULT" "1"
 SYSTEM_CONSTANT "ISC_SLIP_DETEC" "0"
 SYSTEM_CONSTANT "ISC_STPRECTL_NEG" "-1"
 SYSTEM_CONSTANT "ISC_STPRECTL_POS" "1"
 SYSTEM_CONSTANT "ISC_ST_LOHIINVALID" "255"
 SYSTEM_CONSTANT "ISC_ST_LONENGHIGH" "3"
 SYSTEM_CONSTANT "ISC_ST_NENGLOWER" "1"
 SYSTEM_CONSTANT "ISC_ST_NENGUPPER" "2"
 SYSTEM_CONSTANT "ISC_ST_NOOP" "0"
 SYSTEM_CONSTANT "ISC_TIFLTNENG_MAX" "60"
 SYSTEM_CONSTANT "ISC_TIFLTNENG_MIN" "0"
 SYSTEM_CONSTANT "ISC_TIFLTTRQLOS_MAX" "60"
 SYSTEM_CONSTANT "ISC_TIFLTTRQLOS_MIN" "0"
 SYSTEM_CONSTANT "ISC_TIMEDELAY_S_LIN_16_RES_FL" "0.000152592547379986"
 SYSTEM_CONSTANT "ISC_TIME_DT_RES_FL" "1e-006"
 SYSTEM_CONSTANT "ISC_TIPT1TRQFLT_CUR_X" "25"
 SYSTEM_CONSTANT "ISC_TRJPLN_REQ" "8"
 SYSTEM_CONSTANT "ISC_TRQDEC" "12"
 SYSTEM_CONSTANT "ISC_TRQDEC_POW2" "4096"
 SYSTEM_CONSTANT "ISC_TRQINC" "11"
 SYSTEM_CONSTANT "ISC_TRQINC_POW2" "2048"
 SYSTEM_CONSTANT "ISC_TRQINIT_DONE" "2"
 SYSTEM_CONSTANT "ISC_TRQINIT_MODE0" "4"
 SYSTEM_CONSTANT "ISC_TRQINIT_MODE0_POW2" "16"
 SYSTEM_CONSTANT "ISC_TRQINIT_MODE1" "5"
 SYSTEM_CONSTANT "ISC_TRQINIT_MODE1_POW2" "32"
 SYSTEM_CONSTANT "ISC_TRQINIT_MODE2" "6"
 SYSTEM_CONSTANT "ISC_TRQINIT_MODE2_POW2" "64"
 SYSTEM_CONSTANT "ISC_TRQINIT_MODE3" "7"
 SYSTEM_CONSTANT "ISC_TRQINIT_MODE3_POW2" "128"
 SYSTEM_CONSTANT "ISC_TRQINIT_MULTIPLE" "3"
 SYSTEM_CONSTANT "ISC_TRQINIT_REQ" "1"
 SYSTEM_CONSTANT "ISC_TRQINIT_TRQLOS" "1"
 SYSTEM_CONSTANT "ISC_TRQ_RES_FL" "0.1"
 SYSTEM_CONSTANT "ISC_TRQ_ZERO16" "0"
 SYSTEM_CONSTANT "ISC_TRQ_ZERO32" "0"
 SYSTEM_CONSTANT "ISC_TRQ_ZERO_FL" "0"
 SYSTEM_CONSTANT "ISC_VEL_RES_REV_FL" "0.01"
 SYSTEM_CONSTANT "IVACTR_SWTSELTEMP_CLNT" "0"
 SYSTEM_CONSTANT "IVACTR_SWTSELTEMP_FUEL" "1"
 SYSTEM_CONSTANT "IVADJ_NUMCHKPNT" "5"
 SYSTEM_CONSTANT "IVADJ_NUMREPLVAL" "12"
 SYSTEM_CONSTANT "IVADJ_STQNTADJ_MAP_X" "5"
 SYSTEM_CONSTANT "IVADJ_STQNTADJ_MAP_Y" "6"
 SYSTEM_CONSTANT "IVDIA_ERR_MAX" "32"
 SYSTEM_CONSTANT "I_COIL_MAX" "5000"
 SYSTEM_CONSTANT "I_COIL_MIN" "0"
 SYSTEM_CONSTANT "KD_1_MAX" "50"
 SYSTEM_CONSTANT "KD_1_NRM" "7"
 SYSTEM_CONSTANT "KD_LIN_16_RES" "32767"
 SYSTEM_CONSTANT "KD_PRAIL2Q_1_MAX" "0.5"
 SYSTEM_CONSTANT "KD_PRAIL2Q_1_NRM" "4"
 SYSTEM_CONSTANT "KD_RED_RES" "512"
 SYSTEM_CONSTANT "KD_RED_RES_2" "64"
 SYSTEM_CONSTANT "KD_RES16_REV" "1024"
 SYSTEM_CONSTANT "KD_RES16_REV_FL" "1024"
 SYSTEM_CONSTANT "KD_RES_REV" "65536"
 SYSTEM_CONSTANT "KD_SHIFT_2" "1024"
 SYSTEM_CONSTANT "KFACT_MAX" "1"
 SYSTEM_CONSTANT "KFACT_MIN" "0"
 SYSTEM_CONSTANT "KGPHR2MGPSEC" "277.77"
 SYSTEM_CONSTANT "KIRMNSOTMS_INVRESO_SY" "2"
 SYSTEM_CONSTANT "KIRMNSOTMS_NRMEXPO_SY" "1"
 SYSTEM_CONSTANT "KI_1_MAX" "250"
 SYSTEM_CONSTANT "KI_1_NRM" "5"
 SYSTEM_CONSTANT "KI_EGR_RES_REV" "5368.70912"
 SYSTEM_CONSTANT "KI_EGTFACT_EXP" "1"
 SYSTEM_CONSTANT "KI_EGTFACT_NRM" "2"
 SYSTEM_CONSTANT "KI_ETCTLGOV_FAC_MAX" "0.06"
 SYSTEM_CONSTANT "KI_ETCTLGOV_FAC_MIN" "0"
 SYSTEM_CONSTANT "KI_ETCTLGOV_P0Q001_EXP" "1"
 SYSTEM_CONSTANT "KI_ETCTLGOV_P0Q001_NRM" "2"
 SYSTEM_CONSTANT "KI_ETCTL_MAX" "100"
 SYSTEM_CONSTANT "KI_ETCTL_MIN" "0"
 SYSTEM_CONSTANT "KI_FACTEGT_MAX" "0.06"
 SYSTEM_CONSTANT "KI_FACTEGT_MIN" "0"
 SYSTEM_CONSTANT "KI_MSOOT_RES_REV" "819"
 SYSTEM_CONSTANT "KI_PRAIL2Q_1_MAX" "2"
 SYSTEM_CONSTANT "KI_PRAIL2Q_1_NRM" "1"
 SYSTEM_CONSTANT "KI_PRCEGRRMP2PRC_ONE" "1"
 SYSTEM_CONSTANT "KI_RES_REV" "2147.483648"
 SYSTEM_CONSTANT "KI_RES_REV_2" "4294.967296"
 SYSTEM_CONSTANT "KI_THRVLV_RES_REV" "65"
 SYSTEM_CONSTANT "KP_1_MAX" "300"
 SYSTEM_CONSTANT "KP_1_NRM" "9"
 SYSTEM_CONSTANT "KP_EGTFACT_EXP" "7"
 SYSTEM_CONSTANT "KP_EGTFACT_RES_REV" "128"
 SYSTEM_CONSTANT "KP_ETCTLGOV_FAC_MAX" "0.06"
 SYSTEM_CONSTANT "KP_ETCTLGOV_FAC_MIN" "0"
 SYSTEM_CONSTANT "KP_ETCTLGOV_P0Q001_EXP" "7"
 SYSTEM_CONSTANT "KP_ETCTLGOV_P0Q001_RES_REV" "128"
 SYSTEM_CONSTANT "KP_ETCTL_MAX" "4"
 SYSTEM_CONSTANT "KP_ETCTL_MIN" "0"
 SYSTEM_CONSTANT "KP_LMBDREC2INJMASS_1_MAX" "250"
 SYSTEM_CONSTANT "KP_LMBDREC2INJMASS_1_NRM" "2"
 SYSTEM_CONSTANT "KP_LMBDREC2INJMASS_1_RES_REV" "4"
 SYSTEM_CONSTANT "KP_PRAIL2Q_1_MAX" "0.2"
 SYSTEM_CONSTANT "KP_PRAIL2Q_1_NRM" "2"
 SYSTEM_CONSTANT "KP_RES_REV" "32768"
 SYSTEM_CONSTANT "KP_RES_REV_2" "65536"
 SYSTEM_CONSTANT "LAMBDAREC_ONE" "1"
 SYSTEM_CONSTANT "LAMBDAREC_RES" "0.0001"
 SYSTEM_CONSTANT "LAMBDAREC_RESVAL" "0.001"
 SYSTEM_CONSTANT "LAMBDAREC_RESVAL_FL" "0.001"
 SYSTEM_CONSTANT "LAMBDAREC_RESVAL_REV" "1000"
 SYSTEM_CONSTANT "LAMBDAREC_RES_REV" "10000"
 SYSTEM_CONSTANT "LAMBDATEMPRESREV_SY" "1000"
 SYSTEM_CONSTANT "LAMBDA_INJMASS_RES" "1450"
 SYSTEM_CONSTANT "LAMBDA_RES" "0.001"
 SYSTEM_CONSTANT "LAMBDA_RES2LAMBDAREC_RES" "10"
 SYSTEM_CONSTANT "LAMBDA_RES_REV" "1000"
 SYSTEM_CONSTANT "LEARN" "3"
 SYSTEM_CONSTANT "LENGTH_RES" "1"
 SYSTEM_CONSTANT "LENGTH_RES_CPP_SY" "1e-005"
 SYSTEM_CONSTANT "LENGTH_RES_FINE" "0.001"
 SYSTEM_CONSTANT "LENGTH_RES_INV" "1"
 SYSTEM_CONSTANT "LSCOMPDYN_OFF" "0"
 SYSTEM_CONSTANT "LSCOMPDYN_ON" "1"
 SYSTEM_CONSTANT "LSCOMPDYN_SY" "0"
 SYSTEM_CONSTANT "LSU_CT_SENSORS" "1"
 SYSTEM_CONSTANT "LSU_CT_SENSORS_MAX" "4"
 SYSTEM_CONSTANT "LSU_NUM_SENSCMPCHKS" "0"
 SYSTEM_CONSTANT "MASSLENGTH_RES" "0.2"
 SYSTEM_CONSTANT "MASS_RES" "1"
 SYSTEM_CONSTANT "MAXSINT16" "32767"
 SYSTEM_CONSTANT "MAXSINT32" "2147483647"
 SYSTEM_CONSTANT "MAXSINT8" "127"
 SYSTEM_CONSTANT "MAXUINT16" "65535"
 SYSTEM_CONSTANT "MAXUINT32" "4294967295"
 SYSTEM_CONSTANT "MAXUINT8" "255"
 SYSTEM_CONSTANT "MEUN_FACCRNTCTLINIT_CUR_X" "6"
 SYSTEM_CONSTANT "MEUN_ICNVFLOWRATE_CUR_X" "10"
 SYSTEM_CONSTANT "MEUN_ILIN_CUR_X" "2"
 SYSTEM_CONSTANT "MEUN_RLIM_CUR_X" "2"
 SYSTEM_CONSTANT "MEUN_RSETLIN_CUR_X" "4"
 SYSTEM_CONSTANT "MEUN_TIPER_CUR_X" "30"
 SYSTEM_CONSTANT "MINSINT16" "-32768"
 SYSTEM_CONSTANT "MINSINT32" "-2147483648"
 SYSTEM_CONSTANT "MINSINT8" "-128"
 SYSTEM_CONSTANT "MOCCPU_FIT_SY" "1"
 SYSTEM_CONSTANT "MOCMEM_DATA_CHECK" "10"
 SYSTEM_CONSTANT "MOCMEM_DATA_DME_SY" "13"
 SYSTEM_CONSTANT "MOCMEM_DATA_ROM_SY" "10"
 SYSTEM_CONSTANT "MOCMEM_DATA_USAP_MEDC17_OFFSET_SY" "11"
 SYSTEM_CONSTANT "MOCMEM_DATA_USAP_MEDC17_R9_SY" "12"
 SYSTEM_CONSTANT "MOCSOP_CJ840AT_SY" "0"
 SYSTEM_CONSTANT "MOCSOP_CJ840_SY" "0"
 SYSTEM_CONSTANT "MOCSOP_GET_STATUS_FAIL" "255"
 SYSTEM_CONSTANT "MOCSOP_POWERSTAGE_OFF_SY" "0"
 SYSTEM_CONSTANT "MOCSOP_POWERSTAGE_ON_SY" "1"
 SYSTEM_CONSTANT "MOFACC_PTD_MSK" "1"
 SYSTEM_CONSTANT "MOFACC_SHUTOFF_MSK" "2"
 SYSTEM_CONSTANT "MOFCCTL_ACT_MSK" "1"
 SYSTEM_CONSTANT "MOFCCTL_SHUTOFF_MSK" "2"
 SYSTEM_CONSTANT "MOFEXTINT_DCSPTD_BP" "1"
 SYSTEM_CONSTANT "MOFEXTINT_TRQDCSIDC_MSK" "1"
 SYSTEM_CONSTANT "MOFEXTINT_TRQTSCIDC_MSK" "2"
 SYSTEM_CONSTANT "MOFEXTINT_TSCPTD_BP" "1"
 SYSTEM_CONSTANT "MOFINJDAT_FACINJEFF_MAP_X" "6"
 SYSTEM_CONSTANT "MOFINJDAT_FACINJEFF_MAP_Y" "4"
 SYSTEM_CONSTANT "MOFINJDAT_INJACTV_MSK" "1"
 SYSTEM_CONSTANT "MOFOVR_TILIMET_CUR_X" "4"
 SYSTEM_CONSTANT "MOMENT_INERTIA_RES" "100"
 SYSTEM_CONSTANT "MO_PRCMAX_SY" "256"
 SYSTEM_CONSTANT "MO_ROOM_RES_SY" "256"
 SYSTEM_CONSTANT "MUL_INJTIME_US" "5"
 SYSTEM_CONSTANT "M_OILASH_RES" "0.01"
 SYSTEM_CONSTANT "M_SOOT_MAX" "300"
 SYSTEM_CONSTANT "M_SOOT_MIN" "0"
 SYSTEM_CONSTANT "M_SOOT_RES" "0.01"
 SYSTEM_CONSTANT "NEUTVAL_S16" "-32768"
 SYSTEM_CONSTANT "NEUTVAL_S32" "-2147483648"
 SYSTEM_CONSTANT "NEUTVAL_S8" "-128"
 SYSTEM_CONSTANT "NEUTVAL_U16" "65534"
 SYSTEM_CONSTANT "NEUTVAL_U32" "4294967294"
 SYSTEM_CONSTANT "NEUTVAL_U8" "254"
 SYSTEM_CONSTANT "NOAC_GEAR" "4"
 SYSTEM_CONSTANT "NOAC_NOGEAR" "1"
 SYSTEM_CONSTANT "NORM_ACC2TRQPRPHIGH" "500"
 SYSTEM_CONSTANT "NORM_DVOLPERSTRK_X_N" "6666.66666666667"
 SYSTEM_CONSTANT "NORM_DVOL_X_DT" "360000"
 SYSTEM_CONSTANT "NORM_ENGN2RMPENGN" "3276.8"
 SYSTEM_CONSTANT "NORM_FANSPD2RELFANSPD" "8192"
 SYSTEM_CONSTANT "NORM_LMBD_RES" "0.00145"
 SYSTEM_CONSTANT "NORM_MINUTE_MICROSEC" "60000000"
 SYSTEM_CONSTANT "NORM_Q2PWR" "10644.4551086344"
 SYSTEM_CONSTANT "NORM_Q_BY_FAC" "8192"
 SYSTEM_CONSTANT "NORM_Q_BY_RHO" "1000"
 SYSTEM_CONSTANT "NORM_R_X_R" "100"
 SYSTEM_CONSTANT "NORM_R_X_TRQ" "100"
 SYSTEM_CONSTANT "NORM_TRQ2PWR" "3599.99660074774"
 SYSTEM_CONSTANT "NORM_TRQ2TRQPRP" "1600"
 SYSTEM_CONSTANT "NORM_TRQ2TRQPRPHIGH" "100"
 SYSTEM_CONSTANT "NORM_TRQPRPHIGH2ACC" "500"
 SYSTEM_CONSTANT "NORM_TRQTONSQR" "4000000"
 SYSTEM_CONSTANT "NORM_TRQ_BY_ETA" "1280"
 SYSTEM_CONSTANT "NORM_TRQ_BY_Q" "1280"
 SYSTEM_CONSTANT "NORM_TRQ_BY_R" "100"
 SYSTEM_CONSTANT "NORM_TRQ_INRT" "500"
 SYSTEM_CONSTANT "NORM_TRQ_X_FAC" "8192"
 SYSTEM_CONSTANT "NORM_VEL_LENGTH2ENGN" "50"
 SYSTEM_CONSTANT "NORM_WHL_RADIUS" "200"
 SYSTEM_CONSTANT "NOXMPT_RES" "0.1"
 SYSTEM_CONSTANT "NOXMPT_RES_REV" "10"
 SYSTEM_CONSTANT "NOXRESO_DIVADPT" "54000"
 SYSTEM_CONSTANT "NRM_DVOLPERSTRK_X_N" "6666.66666666667"
 SYSTEM_CONSTANT "NRM_DVOL_X_DT" "360000"
 SYSTEM_CONSTANT "NRM_EXPO_AG_CRS_HI_RESO" "7"
 SYSTEM_CONSTANT "NRM_EXPO_T_INC_PER_DUR_HI_RESO" "8"
 SYSTEM_CONSTANT "NRM_EXP_RES_TRIGO_FUNC" "12"
 SYSTEM_CONSTANT "NRM_Q_BY_RHO" "1000"
 SYSTEM_CONSTANT "NUMCASMAX" "1"
 SYSTEM_CONSTANT "NUMCYLACT_SY" "4"
 SYSTEM_CONSTANT "NUMCYLMAX_SY" "6"
 SYSTEM_CONSTANT "NUMFANS_SY" "2"
 SYSTEM_CONSTANT "NUM_BNK" "2"
 SYSTEM_CONSTANT "NUM_CHIP" "1"
 SYSTEM_CONSTANT "NUM_INJ_MAX" "6"
 SYSTEM_CONSTANT "NUM_MAX_FBC_SEG" "8"
 SYSTEM_CONSTANT "NUM_SINTAB_IDX" "30"
 SYSTEM_CONSTANT "NUM_SINTAB_INC" "2"
 SYSTEM_CONSTANT "O2MASS_MAX" "50"
 SYSTEM_CONSTANT "O2MASS_MIN" "0"
 SYSTEM_CONSTANT "O2MPT_RES" "0.01"
 SYSTEM_CONSTANT "O2MPT_RES_FL" "0.01"
 SYSTEM_CONSTANT "O2MPT_RES_REV" "100"
 SYSTEM_CONSTANT "O2_NORM" "0.21"
 SYSTEM_CONSTANT "O2_NORM_INV" "4.773"
 SYSTEM_CONSTANT "O2_RES" "1e-005"
 SYSTEM_CONSTANT "O2_RES_FL" "1e-005"
 SYSTEM_CONSTANT "O2_RES_REV" "100000"
 SYSTEM_CONSTANT "O2_RMASS_AIR" "0.2314975"
 SYSTEM_CONSTANT "O2_RMASS_AIR_FL" "0.2314975"
 SYSTEM_CONSTANT "O2_RVOL_AIR" "0.2095"
 SYSTEM_CONSTANT "O2_THRES1_ADD" "0.063"
 SYSTEM_CONSTANT "O2_THRES1_FAC" "0.7"
 SYSTEM_CONSTANT "O2_THRES2_ADD" "0.126"
 SYSTEM_CONSTANT "O2_THRES2_FAC" "0.4"
 SYSTEM_CONSTANT "ODD_SEGMENT" "1"
 SYSTEM_CONSTANT "OILMPT_RES" "0.0001"
 SYSTEM_CONSTANT "OIL_BSS_PERI_ID_SY" "4"
 SYSTEM_CONSTANT "OIL_BSS_USR_ID" "3"
 SYSTEM_CONSTANT "OIL_SENSTYP_QLT_SY" "0"
 SYSTEM_CONSTANT "ONE_FACT26" "1"
 SYSTEM_CONSTANT "ONE_LAMBDAREC_VAL" "1"
 SYSTEM_CONSTANT "OTSCD_TLIN_CUR_X" "25"
 SYSTEM_CONSTANT "OVRMON_TILIMET_CUR_X" "16"
 SYSTEM_CONSTANT "OVRRUN" "5"
 SYSTEM_CONSTANT "PCR_CURLIM" "0"
 SYSTEM_CONSTANT "PCR_FACAIRTEMPDESCORLPEOMQNT_CUR_X" "4"
 SYSTEM_CONSTANT "PCR_FACAIRTEMPDESCORLP_CUR_X" "3"
 SYSTEM_CONSTANT "PCR_FACCBYVLVRMP_CUR_X" "8"
 SYSTEM_CONSTANT "PCR_FACCTLIAT_CUR_X" "25"
 SYSTEM_CONSTANT "PCR_FACCTQNT_MAP_X" "16"
 SYSTEM_CONSTANT "PCR_FACCTQNT_MAP_Y" "16"
 SYSTEM_CONSTANT "PCR_FACDPCORR_CUR_X" "10"
 SYSTEM_CONSTANT "PCR_FACD_MAP_X" "10"
 SYSTEM_CONSTANT "PCR_FACD_MAP_Y" "4"
 SYSTEM_CONSTANT "PCR_FACENGTEMPCTLCOR_MAP_X" "16"
 SYSTEM_CONSTANT "PCR_FACENGTEMPCTLCOR_MAP_Y" "16"
 SYSTEM_CONSTANT "PCR_FACENVPRESCTLCOR_CUR_X" "16"
 SYSTEM_CONSTANT "PCR_FACENVPRESDESCORLPEOMQNT_CUR_X" "4"
 SYSTEM_CONSTANT "PCR_FACENVPRESDESCORLP_CUR_X" "4"
 SYSTEM_CONSTANT "PCR_FACGOVMAXCORR_CUR_X" "8"
 SYSTEM_CONSTANT "PCR_FACIAT_CUR_X" "16"
 SYSTEM_CONSTANT "PCR_FACI_MAP_X" "10"
 SYSTEM_CONSTANT "PCR_FACI_MAP_Y" "4"
 SYSTEM_CONSTANT "PCR_FACLPD_MAP_X" "4"
 SYSTEM_CONSTANT "PCR_FACLPD_MAP_Y" "4"
 SYSTEM_CONSTANT "PCR_FACLPI_MAP_X" "4"
 SYSTEM_CONSTANT "PCR_FACLPI_MAP_Y" "4"
 SYSTEM_CONSTANT "PCR_FACLPP_MAP_X" "4"
 SYSTEM_CONSTANT "PCR_FACLPP_MAP_Y" "4"
 SYSTEM_CONSTANT "PCR_FACMFLOWRAW_MAP_X" "10"
 SYSTEM_CONSTANT "PCR_FACMFLOWRAW_MAP_Y" "8"
 SYSTEM_CONSTANT "PCR_FACN_CUR_X" "6"
 SYSTEM_CONSTANT "PCR_FACP_MAP_X" "10"
 SYSTEM_CONSTANT "PCR_FACP_MAP_Y" "4"
 SYSTEM_CONSTANT "PCR_FACRMPVALDESCORLP_CUR_X" "16"
 SYSTEM_CONSTANT "PCR_FACT1LP_MAP_X" "4"
 SYSTEM_CONSTANT "PCR_FACT1LP_MAP_Y" "4"
 SYSTEM_CONSTANT "PCR_FACTEMPDESCORLPEOMQNT_MAP_X" "4"
 SYSTEM_CONSTANT "PCR_FACTEMPDESCORLPEOMQNT_MAP_Y" "4"
 SYSTEM_CONSTANT "PCR_FACTEMPDESCORLP_MAP_X" "4"
 SYSTEM_CONSTANT "PCR_FACTEMPDESCORLP_MAP_Y" "4"
 SYSTEM_CONSTANT "PCR_GOVOFFEOMLP_CUR_X" "8"
 SYSTEM_CONSTANT "PCR_GOVOFFLP_CUR_X" "8"
 SYSTEM_CONSTANT "PCR_GOVONEOMLP_CUR_X" "8"
 SYSTEM_CONSTANT "PCR_GOVONLP_CUR_X" "8"
 SYSTEM_CONSTANT "PCR_MAPLIM" "1"
 SYSTEM_CONSTANT "PCR_NUMCBYVLV" "1"
 SYSTEM_CONSTANT "PCR_NUMSTPRIOMON" "17"
 SYSTEM_CONSTANT "PCR_NUMSTPRIOMONLP" "8"
 SYSTEM_CONSTANT "PCR_PAPQNTCOR_MAP_X" "16"
 SYSTEM_CONSTANT "PCR_PAPQNTCOR_MAP_Y" "16"
 SYSTEM_CONSTANT "PCR_PDESBASLPEOMQNT_MAP_X" "12"
 SYSTEM_CONSTANT "PCR_PDESBASLPEOMQNT_MAP_Y" "12"
 SYSTEM_CONSTANT "PCR_PDESBASLPHIALTDEOMQNT_MAP_X" "6"
 SYSTEM_CONSTANT "PCR_PDESBASLPHIALTDEOMQNT_MAP_Y" "6"
 SYSTEM_CONSTANT "PCR_PDESBASLPHIALTD_MAP_X" "6"
 SYSTEM_CONSTANT "PCR_PDESBASLPHIALTD_MAP_Y" "6"
 SYSTEM_CONSTANT "PCR_PDESBASLP_MAP_X" "12"
 SYSTEM_CONSTANT "PCR_PDESBASLP_MAP_Y" "12"
 SYSTEM_CONSTANT "PCR_PDESBAS_MAP_X" "16"
 SYSTEM_CONSTANT "PCR_PDESBAS_MAP_Y" "16"
 SYSTEM_CONSTANT "PCR_PDESMAXAP_MAP_X" "16"
 SYSTEM_CONSTANT "PCR_PDESMAXAP_MAP_Y" "16"
 SYSTEM_CONSTANT "PCR_PDVTMAX_MAP_X" "12"
 SYSTEM_CONSTANT "PCR_PDVTMAX_MAP_Y" "12"
 SYSTEM_CONSTANT "PCR_PDVTMIN_MAP_X" "12"
 SYSTEM_CONSTANT "PCR_PDVTMIN_MAP_Y" "12"
 SYSTEM_CONSTANT "PCR_PMAXDESVALLP_MAP_X" "8"
 SYSTEM_CONSTANT "PCR_PMAXDESVALLP_MAP_Y" "8"
 SYSTEM_CONSTANT "PCR_PNQNTCTCOR_MAP_X" "16"
 SYSTEM_CONSTANT "PCR_PNQNTCTCOR_MAP_Y" "16"
 SYSTEM_CONSTANT "PCR_PRESPRCCNV" "82"
 SYSTEM_CONSTANT "PCR_PTEMPCORBASLPEOMQNT_MAP_X" "6"
 SYSTEM_CONSTANT "PCR_PTEMPCORBASLPEOMQNT_MAP_Y" "6"
 SYSTEM_CONSTANT "PCR_PTEMPCORBASLP_MAP_X" "16"
 SYSTEM_CONSTANT "PCR_PTEMPCORBASLP_MAP_Y" "16"
 SYSTEM_CONSTANT "PCR_QCBYVLVCLOSEEOM1_MAP_X" "12"
 SYSTEM_CONSTANT "PCR_QCBYVLVCLOSEEOM1_MAP_Y" "6"
 SYSTEM_CONSTANT "PCR_QCBYVLVCLOSE_MAP_X" "12"
 SYSTEM_CONSTANT "PCR_QCBYVLVCLOSE_MAP_Y" "6"
 SYSTEM_CONSTANT "PCR_QCBYVLVOPNEOM1_MAP_X" "12"
 SYSTEM_CONSTANT "PCR_QCBYVLVOPNEOM1_MAP_Y" "6"
 SYSTEM_CONSTANT "PCR_QCBYVLVOPN_MAP_X" "12"
 SYSTEM_CONSTANT "PCR_QCBYVLVOPN_MAP_Y" "6"
 SYSTEM_CONSTANT "PCR_QGVNROFF_CUR_X" "25"
 SYSTEM_CONSTANT "PCR_QGVNRON_CUR_X" "25"
 SYSTEM_CONSTANT "PCR_QNTCTL_QCURR" "0"
 SYSTEM_CONSTANT "PCR_QNTCTL_QRAW" "1"
 SYSTEM_CONSTANT "PCR_Q_QCURR" "0"
 SYSTEM_CONSTANT "PCR_Q_QRAW" "1"
 SYSTEM_CONSTANT "PCR_RAIRTEMPCTLCORBAS_MAP_X" "16"
 SYSTEM_CONSTANT "PCR_RAIRTEMPCTLCORBAS_MAP_Y" "16"
 SYSTEM_CONSTANT "PCR_RAIRTEMPCTLCOREOMBAS_MAP_X" "16"
 SYSTEM_CONSTANT "PCR_RAIRTEMPCTLCOREOMBAS_MAP_Y" "16"
 SYSTEM_CONSTANT "PCR_RCTLAPCOR_MAP_X" "16"
 SYSTEM_CONSTANT "PCR_RCTLAPCOR_MAP_Y" "16"
 SYSTEM_CONSTANT "PCR_RCTLBASHIALTD_MAP_X" "16"
 SYSTEM_CONSTANT "PCR_RCTLBASHIALTD_MAP_Y" "16"
 SYSTEM_CONSTANT "PCR_RCTLBAS_MAP_X" "16"
 SYSTEM_CONSTANT "PCR_RCTLBAS_MAP_Y" "16"
 SYSTEM_CONSTANT "PCR_RELABSLP_ABS" "0"
 SYSTEM_CONSTANT "PCR_RELABSLP_REL" "1"
 SYSTEM_CONSTANT "PCR_RELABS_ABS" "0"
 SYSTEM_CONSTANT "PCR_RELABS_REL" "1"
 SYSTEM_CONSTANT "PCR_RENGTEMPCORBASQNT_MAP_Y" "16"
 SYSTEM_CONSTANT "PCR_RENGTEMPCORBASTRQ_MAP_Y" "16"
 SYSTEM_CONSTANT "PCR_RENGTEMPCORBAS_MAP_X" "16"
 SYSTEM_CONSTANT "PCR_RGOVLPMAX_MAP_X" "6"
 SYSTEM_CONSTANT "PCR_RGOVLPMAX_MAP_Y" "6"
 SYSTEM_CONSTANT "PCR_RGOVLPMIN_MAP_X" "6"
 SYSTEM_CONSTANT "PCR_RGOVLPMIN_MAP_Y" "6"
 SYSTEM_CONSTANT "PCR_RGOVMAXCORR_MAP_X" "16"
 SYSTEM_CONSTANT "PCR_RGOVMAXCORR_MAP_Y" "10"
 SYSTEM_CONSTANT "PCR_RGOVMAXDYNCORR_MAP_X" "8"
 SYSTEM_CONSTANT "PCR_RGOVMAXDYNCORR_MAP_Y" "8"
 SYSTEM_CONSTANT "PCR_RGOVMAXDYN_MAP_X" "8"
 SYSTEM_CONSTANT "PCR_RGOVMAXDYN_MAP_Y" "8"
 SYSTEM_CONSTANT "PCR_RGVNRMAX_MAP_X" "16"
 SYSTEM_CONSTANT "PCR_RGVNRMAX_MAP_Y" "16"
 SYSTEM_CONSTANT "PCR_RGVNRMIN_MAP_X" "16"
 SYSTEM_CONSTANT "PCR_RGVNRMIN_MAP_Y" "16"
 SYSTEM_CONSTANT "PCR_ROFSRLSMAX_MAP_X" "8"
 SYSTEM_CONSTANT "PCR_ROFSRLSMAX_MAP_Y" "8"
 SYSTEM_CONSTANT "PCR_ROFSRLSMIN_MAP_X" "8"
 SYSTEM_CONSTANT "PCR_ROFSRLSMIN_MAP_Y" "8"
 SYSTEM_CONSTANT "PCR_ROUTIMAXLP_MAP_X" "4"
 SYSTEM_CONSTANT "PCR_ROUTIMAXLP_MAP_Y" "4"
 SYSTEM_CONSTANT "PCR_ROUTIMAX_MAP_X" "8"
 SYSTEM_CONSTANT "PCR_ROUTIMAX_MAP_Y" "8"
 SYSTEM_CONSTANT "PCR_ROUTIMINLP_MAP_X" "4"
 SYSTEM_CONSTANT "PCR_ROUTIMINLP_MAP_Y" "4"
 SYSTEM_CONSTANT "PCR_ROUTIMIN_MAP_X" "8"
 SYSTEM_CONSTANT "PCR_ROUTIMIN_MAP_Y" "8"
 SYSTEM_CONSTANT "PCR_SWTLIMSEL_TYPE" "0"
 SYSTEM_CONSTANT "PCR_SWTLIMSEL_VAL" "1"
 SYSTEM_CONSTANT "PCR_SWTQNTCTL_TYPE" "2"
 SYSTEM_CONSTANT "PCR_SWTQNTCTL_VAL" "0"
 SYSTEM_CONSTANT "PCR_SWTQNTDES_TYPE" "2"
 SYSTEM_CONSTANT "PCR_SWTQNTDES_VAL" "0"
 SYSTEM_CONSTANT "PCR_SWTRELABS_TYPE" "2"
 SYSTEM_CONSTANT "PCR_SWTRELABS_VAL" "0"
 SYSTEM_CONSTANT "PCR_SWTTEMPCOR_TYPE" "2"
 SYSTEM_CONSTANT "PCR_SWTTEMPCOR_VAL" "0"
 SYSTEM_CONSTANT "PCR_SWTTRQCTL_TYPE" "2"
 SYSTEM_CONSTANT "PCR_SWTTRQCTL_VAL" "0"
 SYSTEM_CONSTANT "PCR_SWTTRQDES_TYPE" "2"
 SYSTEM_CONSTANT "PCR_SWTTRQDES_VAL" "0"
 SYSTEM_CONSTANT "PCR_TAIR" "1"
 SYSTEM_CONSTANT "PCR_TENG" "0"
 SYSTEM_CONSTANT "PCR_TICLDSTRT_CUR_X" "30"
 SYSTEM_CONSTANT "PCR_TIGOVOFFDELLP_CUR_X" "4"
 SYSTEM_CONSTANT "PCR_TIGVNROFFDEL_CUR_X" "6"
 SYSTEM_CONSTANT "PCVCD_CTLSTATE_CONST" "0"
 SYSTEM_CONSTANT "PCVCD_CTLSTATE_DEP" "1"
 SYSTEM_CONSTANT "PCVCD_SWTCTLSTATE_TYPE" "2"
 SYSTEM_CONSTANT "PCVCD_SWTCTLSTATE_VAL" "0"
 SYSTEM_CONSTANT "PCV_CTLSTATE_CONST" "0"
 SYSTEM_CONSTANT "PCV_CTLSTATE_DEP" "1"
 SYSTEM_CONSTANT "PCV_DVOLLEAK_CUR_X" "6"
 SYSTEM_CONSTANT "PCV_DVOLUPLIM_CUR_X" "10"
 SYSTEM_CONSTANT "PCV_FACADAPTFLOW_MAP_X" "6"
 SYSTEM_CONSTANT "PCV_FACADAPTFLOW_MAP_Y" "4"
 SYSTEM_CONSTANT "PCV_FACCRNTCTLINIT_CUR_X" "6"
 SYSTEM_CONSTANT "PCV_ICNVPRES_CUR_X" "10"
 SYSTEM_CONSTANT "PCV_ILIN_CUR_X" "2"
 SYSTEM_CONSTANT "PCV_ISETCLOSE_CUR_X" "8"
 SYSTEM_CONSTANT "PCV_RSETLIN_CUR_X" "4"
 SYSTEM_CONSTANT "PCV_SWTCTLSTATE_TYPE" "2"
 SYSTEM_CONSTANT "PCV_SWTCTLSTATE_VAL" "0"
 SYSTEM_CONSTANT "PERIOD_MAX" "100"
 SYSTEM_CONSTANT "PERIOD_MIN" "10"
 SYSTEM_CONSTANT "PERIOD_RES" "100"
 SYSTEM_CONSTANT "PERMSPLYSYS_SY" "0"
 SYSTEM_CONSTANT "PER_CNT_MAX" "1000000"
 SYSTEM_CONSTANT "PER_DUR_RES" "1"
 SYSTEM_CONSTANT "PER_DUR_SHIFT" "256"
 SYSTEM_CONSTANT "PFLTENGPOPMAX_SY" "11"
 SYSTEM_CONSTANT "PFLTLD_DMSOTSIMRGNBAS_CUR_X" "8"
 SYSTEM_CONSTANT "PFLTLD_FACCNVCATNO2_CUR_X" "8"
 SYSTEM_CONSTANT "PFLTLD_FACO2SIMRGN_MAP_X" "8"
 SYSTEM_CONSTANT "PFLTLD_FACO2SIMRGN_MAP_Y" "8"
 SYSTEM_CONSTANT "PFLTLD_FACSOTSIMRGNNO2_CUR_X" "8"
 SYSTEM_CONSTANT "PFLTLD_FACTEMPNO2_CUR_X" "8"
 SYSTEM_CONSTANT "PFLTLD_FACTEMPSIMRGN_CUR_X" "8"
 SYSTEM_CONSTANT "PFLTLD_FACVOLFLWNO2_CUR_X" "8"
 SYSTEM_CONSTANT "PFLTLD_MSOTRESAFTRGN_MAP_X" "8"
 SYSTEM_CONSTANT "PFLTLD_MSOTRESAFTRGN_MAP_Y" "8"
 SYSTEM_CONSTANT "PFLTLD_RO2EGONE_SY" "1"
 SYSTEM_CONSTANT "PFLTLD_RO2EG_SY" "0.2315"
 SYSTEM_CONSTANT "PFLTLD_TIME_DT" "1000000"
 SYSTEM_CONSTANT "PFLTLD_TIME_S" "10000"
 SYSTEM_CONSTANT "PFLTLD_TINO2RGNDEL_MAP_X" "8"
 SYSTEM_CONSTANT "PFLTLD_TINO2RGNDEL_MAP_Y" "8"
 SYSTEM_CONSTANT "PFLTNUMCHNGIMMD_SY" "3"
 SYSTEM_CONSTANT "PFLTNUMCHNG_SY" "6"
 SYSTEM_CONSTANT "PFLTNUMRGNMAX_SY" "6"
 SYSTEM_CONSTANT "PFLTPOP_NUMTHRESH_X" "11"
 SYSTEM_CONSTANT "PFLTPOP_NUMTHRESH_Y" "2"
 SYSTEM_CONSTANT "PFLTPOP_QSETUNBAL_CUR_X" "8"
 SYSTEM_CONSTANT "PFLTRGNSTGMAX_SY" "10"
 SYSTEM_CONSTANT "PFLTRGN_ADYNMINLIM_MAP_X" "8"
 SYSTEM_CONSTANT "PFLTRGN_ADYNMINLIM_MAP_Y" "8"
 SYSTEM_CONSTANT "PFLTRGN_FACFULLLDCOR_MAP_X" "8"
 SYSTEM_CONSTANT "PFLTRGN_FACFULLLDCOR_MAP_Y" "8"
 SYSTEM_CONSTANT "PFLTRGN_NUMENGPOPDEL_CA_X" "12"
 SYSTEM_CONSTANT "PFLTRGN_NUMENGPOPDEL_CA_Y" "7"
 SYSTEM_CONSTANT "PFLTRGN_NUMENGPOP_CA_X" "12"
 SYSTEM_CONSTANT "PFLTRGN_NUMENGPOP_CA_Y" "7"
 SYSTEM_CONSTANT "PFLTRGN_RFULLLDBAS_MAP_X" "8"
 SYSTEM_CONSTANT "PFLTRGN_RFULLLDBAS_MAP_Y" "8"
 SYSTEM_CONSTANT "PFLTRGN_TICHNGRGNDELBAS_MAP_X" "8"
 SYSTEM_CONSTANT "PFLTRGN_TICHNGRGNDELBAS_MAP_Y" "8"
 SYSTEM_CONSTANT "PFLTRGN_TILCKRGNERR_CA_X" "7"
 SYSTEM_CONSTANT "PFLTRGN_TILCKRGN_CA_X" "7"
 SYSTEM_CONSTANT "PFLTRGN_TIRGNMAX_CA_X" "7"
 SYSTEM_CONSTANT "PFLT_ACTV_BP" "0"
 SYSTEM_CONSTANT "PFLT_NUMOPMODEMSK_SY" "2"
 SYSTEM_CONSTANT "PFLT_PDIFFCHARMONMIN_MAP_X" "8"
 SYSTEM_CONSTANT "PFLT_PDIFFCHARMONMIN_MAP_Y" "8"
 SYSTEM_CONSTANT "PFLT_PDIFFNODSTRMIN_CUR_X" "8"
 SYSTEM_CONSTANT "PFLT_PRIOMAX_SY" "2047"
 SYSTEM_CONSTANT "PFLT_RESFLWMAX_CUR_X" "8"
 SYSTEM_CONSTANT "PFLT_RESFLWMIN_CUR_X" "8"
 SYSTEM_CONSTANT "PFLT_STGMAX_SY" "15"
 SYSTEM_CONSTANT "PHC_EGRMAXDEV_MAP_X" "12"
 SYSTEM_CONSTANT "PHC_EGRMAXDEV_MAP_Y" "8"
 SYSTEM_CONSTANT "PHC_EGRMINDEV_MAP_X" "12"
 SYSTEM_CONSTANT "PHC_EGRMINDEV_MAP_Y" "8"
 SYSTEM_CONSTANT "PHC_STDIRSWT_CA_X" "4"
 SYSTEM_CONSTANT "PHC_TIOVRRUN_CUR_X" "25"
 SYSTEM_CONSTANT "PHC_TISTG2DELAY_CUR_X" "8"
 SYSTEM_CONSTANT "PHC_TRQINRHIGH_MAP_X" "16"
 SYSTEM_CONSTANT "PHC_TRQINRHIGH_MAP_Y" "8"
 SYSTEM_CONSTANT "PHC_TRQINRLOW_MAP_X" "16"
 SYSTEM_CONSTANT "PHC_TRQINRLOW_MAP_Y" "8"
 SYSTEM_CONSTANT "PHC_TRQINROVRRUN_CUR_X" "25"
 SYSTEM_CONSTANT "PHI_COR_MAX" "10"
 SYSTEM_CONSTANT "PHI_ETCTL_MAX" "200"
 SYSTEM_CONSTANT "PHI_ETCTL_MIN" "-200"
 SYSTEM_CONSTANT "PHI_INJBEG_UIS_EARL" "50"
 SYSTEM_CONSTANT "PHI_INJBEG_UIS_LATE" "-60"
 SYSTEM_CONSTANT "PHI_MI_EARL" "40"
 SYSTEM_CONSTANT "PHI_MI_LATE" "-10"
 SYSTEM_CONSTANT "PHI_PII_EARL_ABS" "100"
 SYSTEM_CONSTANT "PHI_PII_EARL_REL" "90"
 SYSTEM_CONSTANT "PHI_PII_LATE_REL" "5"
 SYSTEM_CONSTANT "PHI_POI1_EARL" "-40"
 SYSTEM_CONSTANT "PHI_POI1_LATE" "-100"
 SYSTEM_CONSTANT "PHI_POI1_ZERO" "0"
 SYSTEM_CONSTANT "PHI_POI2_LATE" "-40"
 SYSTEM_CONSTANT "PHI_TIME_BY_N" "1831.11056855983"
 SYSTEM_CONSTANT "PHI_ZERO" "0"
 SYSTEM_CONSTANT "PhyMod_pwrEGLos_MAP_X" "8"
 SYSTEM_CONSTANT "PhyMod_pwrEGLos_MAP_Y" "8"
 SYSTEM_CONSTANT "PHYMOD_QBAS_MAP_X" "16"
 SYSTEM_CONSTANT "PHYMOD_QBAS_MAP_Y" "16"
 SYSTEM_CONSTANT "PI" "3.14159265359"
 SYSTEM_CONSTANT "PMP_QNT_MAX" "1500"
 SYSTEM_CONSTANT "PMP_QNT_RES" "0.1"
 SYSTEM_CONSTANT "PMP_QNT_ZERO" "0"
 SYSTEM_CONSTANT "POSMCDES_RMP_FACT" "100"
 SYSTEM_CONSTANT "POSMCKD_RES" "6.94423251681857e-006"
 SYSTEM_CONSTANT "POSMCKD_RES_4" "2.77769300672743e-005"
 SYSTEM_CONSTANT "POSMCKI_RES" "0.000211921158350176"
 SYSTEM_CONSTANT "POSMCKI_RES_2" "0.000423842316700352"
 SYSTEM_CONSTANT "POSMCKP_RES" "1.38884650336371e-005"
 SYSTEM_CONSTANT "POSMCKP_RES_32" "0.000444430881076389"
 SYSTEM_CONSTANT "POSTDRV_SOFTRST_SY" "0"
 SYSTEM_CONSTANT "POSTDRV_T15RST_SY" "0"
 SYSTEM_CONSTANT "POS_PRC_RES_FL" "0.01220703125"
 SYSTEM_CONSTANT "PRC_100" "100"
 SYSTEM_CONSTANT "PRC_150" "150"
 SYSTEM_CONSTANT "PRC_50" "50"
 SYSTEM_CONSTANT "PRC_EGRRMP_RES" "0.152587890625"
 SYSTEM_CONSTANT "PRC_RES" "0.01220703125"
 SYSTEM_CONSTANT "PRC_RES_REV" "81.92"
 SYSTEM_CONSTANT "PRC_ZERO" "0"
 SYSTEM_CONSTANT "PRESHPA_FNRESO" "0.1"
 SYSTEM_CONSTANT "PRES_AC_HPA_RES" "2"
 SYSTEM_CONSTANT "PRES_AIR_MAX" "3500"
 SYSTEM_CONSTANT "PRES_AIR_MIN" "0"
 SYSTEM_CONSTANT "PRES_BAR_RES" "1"
 SYSTEM_CONSTANT "PRES_HPA_RES" "1"
 SYSTEM_CONSTANT "PRES_HPA_RES_FL" "1"
 SYSTEM_CONSTANT "PRES_HPA_RES_INV" "1"
 SYSTEM_CONSTANT "PRES_HPA_RES_REV" "1"
 SYSTEM_CONSTANT "PRES_HPA_ZERO" "0"
 SYSTEM_CONSTANT "PRES_RAIL_GRAD_TO_VAL" "4"
 SYSTEM_CONSTANT "PRES_RAIL_RES" "100"
 SYSTEM_CONSTANT "PRES_RES" "0.1"
 SYSTEM_CONSTANT "PRES_SI_RES" "100"
 SYSTEM_CONSTANT "PRES_TIME_RES" "400"
 SYSTEM_CONSTANT "PRP_RENG_MAP_X" "16"
 SYSTEM_CONSTANT "PRP_RENG_MAP_Y" "16"
 SYSTEM_CONSTANT "PRP_RPRP_MAP_X" "16"
 SYSTEM_CONSTANT "PRP_RPRP_MAP_Y" "16"
 SYSTEM_CONSTANT "PRP_TRQTHRESENG_CUR_X" "25"
 SYSTEM_CONSTANT "PRP_TRQTHRESPRP_CUR_X" "25"
 SYSTEM_CONSTANT "PSC_COEOM_EGT_NUMINP" "4"
 SYSTEM_CONSTANT "PSC_COEOM_RMP_MAX" "16384000"
 SYSTEM_CONSTANT "PSC_FACT_REC_RES" "3.05185094759972e-005"
 SYSTEM_CONSTANT "PSC_FACT_REC_RES_REV" "32767"
 SYSTEM_CONSTANT "PSC_LSIG_IDX_MAX" "14"
 SYSTEM_CONSTANT "PSC_NRMPHC_SPD_IDX_MAX" "13"
 SYSTEM_CONSTANT "PSC_NUMCYLMAX_SY" "5"
 SYSTEM_CONSTANT "PSC_WARNTHRES_FACT" "10000"
 SYSTEM_CONSTANT "PSPCTL_DVOLBASE_CUR_X" "8"
 SYSTEM_CONSTANT "PSPCTL_DVOLTEMPLIM_MAP_X" "6"
 SYSTEM_CONSTANT "PSPCTL_DVOLTEMPLIM_MAP_Y" "6"
 SYSTEM_CONSTANT "PSPCTL_FACFUELTCOR_CUR_X" "16"
 SYSTEM_CONSTANT "PSPCTL_TIT15DELAY_CUR_X" "8"
 SYSTEM_CONSTANT "PT1INIT_ZERO_SY" "0"
 SYSTEM_CONSTANT "PTHLEAD_STACTVMONLIMCURR_BP" "0"
 SYSTEM_CONSTANT "PTHLEAD_STACTVMONLIMLEAD_BP" "1"
 SYSTEM_CONSTANT "PTHSET_DTRQRMPDWN_CUR_X" "6"
 SYSTEM_CONSTANT "PTHSET_STACTVMONLIMSET_BP" "0"
 SYSTEM_CONSTANT "PTHSET_TIRMPSTRT_CUR_X" "6"
 SYSTEM_CONSTANT "PTHSET_TISWTOFF_CUR_X" "6"
 SYSTEM_CONSTANT "PTODI_40MS" "40000"
 SYSTEM_CONSTANT "PTPRTOVRDSSPDGOV_SY" "0"
 SYSTEM_CONSTANT "PTPRT_OVRDS_SPDGOV" "1"
 SYSTEM_CONSTANT "PT_CLTHCLSD_MSK" "30"
 SYSTEM_CONSTANT "PT_CLTHSLIP_MSK" "28"
 SYSTEM_CONSTANT "PT_CLTHTCHPNT_MSK" "24"
 SYSTEM_CONSTANT "PT_CONVNOSLIP_MSK" "31"
 SYSTEM_CONSTANT "PT_CONVSLIPCTL_MSK" "29"
 SYSTEM_CONSTANT "PT_CONVSLIPOPN_MSK" "17"
 SYSTEM_CONSTANT "PT_CONVSLIP_MSK" "25"
 SYSTEM_CONSTANT "PT_GRIPNOGRIP_BP" "4"
 SYSTEM_CONSTANT "PT_GRIP_BP" "0"
 SYSTEM_CONSTANT "PT_GRIP_CLTH_SLIP_CLSD_MSK" "0"
 SYSTEM_CONSTANT "PT_GRIP_CLTH_SWT_SS_MSK" "0"
 SYSTEM_CONSTANT "PT_GRIP_NO_GRIP_MSK" "0"
 SYSTEM_CONSTANT "PT_NOGRIP_MSK" "0"
 SYSTEM_CONSTANT "PT_RINVLDCALCRSLT" "0"
 SYSTEM_CONSTANT "PT_TRAGRIP_MSK" "31"
 SYSTEM_CONSTANT "PT_TRANOGRIP_MSK" "0"
 SYSTEM_CONSTANT "PWR2_RES" "18.84955592154"
 SYSTEM_CONSTANT "PWR_HIGH_RES" "0.1"
 SYSTEM_CONSTANT "PWR_HIGH_RES_REV" "10"
 SYSTEM_CONSTANT "PWR_HI_RES" "1"
 SYSTEM_CONSTANT "PWR_KW_RES" "0.01"
 SYSTEM_CONSTANT "PWR_RES" "9.42477796077"
 SYSTEM_CONSTANT "PWR_ZERO" "0"
 SYSTEM_CONSTANT "P_ENGPRT_MAX" "1500"
 SYSTEM_CONSTANT "P_ENGPRT_MIN" "0"
 SYSTEM_CONSTANT "QLAMBDARESREV_SY" "1000"
 SYSTEM_CONSTANT "QNTR_EXP" "10"
 SYSTEM_CONSTANT "QNTR_MAX" "24"
 SYSTEM_CONSTANT "QNTR_MIN" "0.0009765625"
 SYSTEM_CONSTANT "QNTR_RES" "0.0009765625"
 SYSTEM_CONSTANT "QNTR_RES_REV" "1024"
 SYSTEM_CONSTANT "Qp_RES" "10"
 SYSTEM_CONSTANT "QWC_FACCOR1_MAP_X" "8"
 SYSTEM_CONSTANT "QWC_FACCOR1_MAP_Y" "16"
 SYSTEM_CONSTANT "QWC_FACCOR2_MAP_X" "8"
 SYSTEM_CONSTANT "QWC_FACCOR2_MAP_Y" "16"
 SYSTEM_CONSTANT "QWC_FACFTS_MAP_X" "16"
 SYSTEM_CONSTANT "QWC_FACFTS_MAP_Y" "8"
 SYSTEM_CONSTANT "QWC_QCOR1_MAP_X" "32"
 SYSTEM_CONSTANT "QWC_QCOR1_MAP_Y" "10"
 SYSTEM_CONSTANT "QWC_QCOR2_MAP_X" "32"
 SYSTEM_CONSTANT "QWC_QCOR2_MAP_Y" "10"
 SYSTEM_CONSTANT "QWC_QNORM_CUR_X" "20"
 SYSTEM_CONSTANT "QWC_STDISBL" "0"
 SYSTEM_CONSTANT "QWC_STENA" "1"
 SYSTEM_CONSTANT "QWC_TCOR_MAP_X" "16"
 SYSTEM_CONSTANT "QWC_TCOR_MAP_Y" "16"
 SYSTEM_CONSTANT "QWC_TIDIFFHYD_MAP_X" "16"
 SYSTEM_CONSTANT "QWC_TIDIFFHYD_MAP_Y" "16"
 SYSTEM_CONSTANT "RAILP_PFLTWINNEG_CUR_X" "10"
 SYSTEM_CONSTANT "RAILP_PLIN_CUR_X" "4"
 SYSTEM_CONSTANT "RAILP_SSPMON1_SY" "1"
 SYSTEM_CONSTANT "RAILP_SSPMON2_SY" "2"
 SYSTEM_CONSTANT "RAILP_SSPMON3_SY" "3"
 SYSTEM_CONSTANT "RAILP_TIOFSTSTDEL_CUR_X" "6"
 SYSTEM_CONSTANT "RAIL_CALCBACK_I" "1"
 SYSTEM_CONSTANT "RAIL_CPC" "1"
 SYSTEM_CONSTANT "RAIL_DPDECMONMAX_CUR_X" "8"
 SYSTEM_CONSTANT "RAIL_DPSETPOINTINC_MAP_X" "12"
 SYSTEM_CONSTANT "RAIL_DPSETPOINTINC_MAP_Y" "8"
 SYSTEM_CONSTANT "RAIL_DP_MAX" "13000000"
 SYSTEM_CONSTANT "RAIL_DP_ZERO" "0"
 SYSTEM_CONSTANT "RAIL_DVOLLEAKAGED_MAP_X" "10"
 SYSTEM_CONSTANT "RAIL_DVOLLEAKAGED_MAP_Y" "10"
 SYSTEM_CONSTANT "RAIL_DVOLLEAK_MAP_X" "10"
 SYSTEM_CONSTANT "RAIL_DVOLLEAK_MAP_Y" "10"
 SYSTEM_CONSTANT "RAIL_DVOLMEUNCLOSE_CUR_X" "12"
 SYSTEM_CONSTANT "RAIL_DVOLMEUNCTLINITI_CUR_X" "3"
 SYSTEM_CONSTANT "RAIL_DVOLMEUNCTLUPLIM_CUR_X" "11"
 SYSTEM_CONSTANT "RAIL_DVOLMEUNOPN_CUR_X" "12"
 SYSTEM_CONSTANT "RAIL_DVOLMEUNOVRRUN_CUR_X" "8"
 SYSTEM_CONSTANT "RAIL_DVOLPCVCLOSE_CUR_X" "12"
 SYSTEM_CONSTANT "RAIL_DVOLPCVOPN_CUR_X" "12"
 SYSTEM_CONSTANT "RAIL_DVOLPRECTLBAS_MAP_X" "16"
 SYSTEM_CONSTANT "RAIL_DVOLPRECTLBAS_MAP_Y" "16"
 SYSTEM_CONSTANT "RAIL_DVOLPRECTLOFS_MAP_X" "8"
 SYSTEM_CONSTANT "RAIL_DVOLPRECTLOFS_MAP_Y" "8"
 SYSTEM_CONSTANT "RAIL_DVOLPRECTLPOI1_MAP_X" "2"
 SYSTEM_CONSTANT "RAIL_DVOLPRECTLPOI1_MAP_Y" "4"
 SYSTEM_CONSTANT "RAIL_DVOLPRECTLPOI2_MAP_X" "2"
 SYSTEM_CONSTANT "RAIL_DVOLPRECTLPOI2_MAP_Y" "4"
 SYSTEM_CONSTANT "RAIL_DVOLSTRT_MAP_X" "8"
 SYSTEM_CONSTANT "RAIL_DVOLSTRT_MAP_Y" "8"
 SYSTEM_CONSTANT "RAIL_FACAPSETPDYNCOR_CUR_X" "6"
 SYSTEM_CONSTANT "RAIL_FACDQSETPDYNCOR_CUR_X" "6"
 SYSTEM_CONSTANT "RAIL_FACETSETPDYNCOR_CUR_X" "6"
 SYSTEM_CONSTANT "RAIL_FACIASETPDYNCOR_CUR_X" "6"
 SYSTEM_CONSTANT "RAIL_FACMEUNCTLDCOR_CUR_X" "4"
 SYSTEM_CONSTANT "RAIL_FACMEUNCTLICOR_CUR_X" "4"
 SYSTEM_CONSTANT "RAIL_FACMEUNCTLPCOR_CUR_X" "4"
 SYSTEM_CONSTANT "RAIL_FACMEUNDVT_CUR_X" "12"
 SYSTEM_CONSTANT "RAIL_FACMEUNSETPOINT_CUR_X" "12"
 SYSTEM_CONSTANT "RAIL_FACPCVDVT_CUR_X" "12"
 SYSTEM_CONSTANT "RAIL_FACSETPOINTAPSCORRGN_AXIS" "12"
 SYSTEM_CONSTANT "RAIL_FACSETPOINTAPSCOR_CUR_X" "8"
 SYSTEM_CONSTANT "RAIL_FACSETPOINTAPSCSTRT_CUR_X" "8"
 SYSTEM_CONSTANT "RAIL_FACSETPOINTATSCORRGN_AXIS" "12"
 SYSTEM_CONSTANT "RAIL_FACSETPOINTATSCOR_CUR_X" "8"
 SYSTEM_CONSTANT "RAIL_FACSETPOINTATSCSTRT_CUR_X" "8"
 SYSTEM_CONSTANT "RAIL_FACSETPOINTETSCOR1_CUR_X" "8"
 SYSTEM_CONSTANT "RAIL_FACSETPOINTETSCORRGN_AXIS" "12"
 SYSTEM_CONSTANT "RAIL_FACSETPOINTETSCOR_CUR_X" "8"
 SYSTEM_CONSTANT "RAIL_FACSETPOINTETSCSTRT_CUR_X" "8"
 SYSTEM_CONSTANT "RAIL_FACSETPOINTFTSCOR_CUR_X" "6"
 SYSTEM_CONSTANT "RAIL_FACSETPOINTRMPVAL_CUR_X" "12"
 SYSTEM_CONSTANT "RAIL_FREEZE_I" "0"
 SYSTEM_CONSTANT "RAIL_MEUNCTLDKD_CUR_X" "3"
 SYSTEM_CONSTANT "RAIL_MEUNCTLIKINEG_CUR_X" "13"
 SYSTEM_CONSTANT "RAIL_MEUNCTLIKIPOS_CUR_X" "13"
 SYSTEM_CONSTANT "RAIL_MEUNCTLIKI_CUR_X" "13"
 SYSTEM_CONSTANT "RAIL_MEUNCTLPKPNEG_CUR_X" "13"
 SYSTEM_CONSTANT "RAIL_MEUNCTLPKPPOS_CUR_X" "13"
 SYSTEM_CONSTANT "RAIL_MEUNCTLPKP_CUR_X" "13"
 SYSTEM_CONSTANT "RAIL_MEUN_PCV" "0"
 SYSTEM_CONSTANT "RAIL_PCPCFLTMIN_CUR_X" "16"
 SYSTEM_CONSTANT "RAIL_PCVCTLDKD_CUR_X" "3"
 SYSTEM_CONSTANT "RAIL_PCVCTLIKINEG_CUR_X" "13"
 SYSTEM_CONSTANT "RAIL_PCVCTLIKIPOS_CUR_X" "13"
 SYSTEM_CONSTANT "RAIL_PCVCTLIKI_CUR_X" "13"
 SYSTEM_CONSTANT "RAIL_PCVCTLPKPNEG_CUR_X" "13"
 SYSTEM_CONSTANT "RAIL_PCVCTLPKPPOS_CUR_X" "13"
 SYSTEM_CONSTANT "RAIL_PCVCTLPKP_CUR_X" "13"
 SYSTEM_CONSTANT "RAIL_PMEUNDVTMAX_CUR_X" "4"
 SYSTEM_CONSTANT "RAIL_PMEUNDVTMIN_CUR_X" "4"
 SYSTEM_CONSTANT "RAIL_PMEUNFLTMIN_CUR_X" "16"
 SYSTEM_CONSTANT "RAIL_PNIPCVMAX_MAP_X" "6"
 SYSTEM_CONSTANT "RAIL_PNIPCVMAX_MAP_Y" "12"
 SYSTEM_CONSTANT "RAIL_PNIPCVMIN_MAP_X" "6"
 SYSTEM_CONSTANT "RAIL_PNIPCVMIN_MAP_Y" "12"
 SYSTEM_CONSTANT "RAIL_PPCVCLOSEOFS_CUR_X" "4"
 SYSTEM_CONSTANT "RAIL_PPCVDVTMAX_CUR_X" "4"
 SYSTEM_CONSTANT "RAIL_PPCVFLTMIN_CUR_X" "16"
 SYSTEM_CONSTANT "RAIL_PPCVINITI_MAP_X" "8"
 SYSTEM_CONSTANT "RAIL_PPCVINITI_MAP_Y" "12"
 SYSTEM_CONSTANT "RAIL_PPCVREDOFS_CUR_X" "4"
 SYSTEM_CONSTANT "RAIL_PPCVSETMAX_CUR_X" "4"
 SYSTEM_CONSTANT "RAIL_PPRECTL_MAP_X" "16"
 SYSTEM_CONSTANT "RAIL_PPRECTL_MAP_Y" "16"
 SYSTEM_CONSTANT "RAIL_PRESS_ABS" "0"
 SYSTEM_CONSTANT "RAIL_PRESS_DIF" "1"
 SYSTEM_CONSTANT "RAIL_PSETMIN_CUR_X" "4"
 SYSTEM_CONSTANT "RAIL_PSETPDYNCOR_MAP_X" "12"
 SYSTEM_CONSTANT "RAIL_PSETPDYNCOR_MAP_Y" "8"
 SYSTEM_CONSTANT "RAIL_PSETPOINTAPSCORRGNX_AXIS" "16"
 SYSTEM_CONSTANT "RAIL_PSETPOINTAPSCORRGNY_AXIS" "16"
 SYSTEM_CONSTANT "RAIL_PSETPOINTAPSCOR_MAP_X" "12"
 SYSTEM_CONSTANT "RAIL_PSETPOINTAPSCOR_MAP_Y" "8"
 SYSTEM_CONSTANT "RAIL_PSETPOINTAPSCSTRT_MAP_X" "8"
 SYSTEM_CONSTANT "RAIL_PSETPOINTAPSCSTRT_MAP_Y" "8"
 SYSTEM_CONSTANT "RAIL_PSETPOINTATSCOR_MAP_X" "12"
 SYSTEM_CONSTANT "RAIL_PSETPOINTATSCOR_MAP_Y" "8"
 SYSTEM_CONSTANT "RAIL_PSETPOINTATSCSTRT_MAP_X" "8"
 SYSTEM_CONSTANT "RAIL_PSETPOINTATSCSTRT_MAP_Y" "8"
 SYSTEM_CONSTANT "RAIL_PSETPOINTBASESTRT_MAP_X" "8"
 SYSTEM_CONSTANT "RAIL_PSETPOINTBASESTRT_MAP_Y" "8"
 SYSTEM_CONSTANT "RAIL_PSETPOINTBASE_MAP_X" "16"
 SYSTEM_CONSTANT "RAIL_PSETPOINTBASE_MAP_Y" "16"
 SYSTEM_CONSTANT "RAIL_PSETPOINTBASRGNX_AXIS" "16"
 SYSTEM_CONSTANT "RAIL_PSETPOINTBASRGNY_AXIS" "16"
 SYSTEM_CONSTANT "RAIL_PSETPOINTBATTMIN_CUR_X" "4"
 SYSTEM_CONSTANT "RAIL_PSETPOINTETSCOR1_MAP_X" "12"
 SYSTEM_CONSTANT "RAIL_PSETPOINTETSCOR1_MAP_Y" "8"
 SYSTEM_CONSTANT "RAIL_PSETPOINTETSCOR_MAP_X" "12"
 SYSTEM_CONSTANT "RAIL_PSETPOINTETSCOR_MAP_Y" "8"
 SYSTEM_CONSTANT "RAIL_PSETPOINTETSCSTRT_MAP_X" "8"
 SYSTEM_CONSTANT "RAIL_PSETPOINTETSCSTRT_MAP_Y" "8"
 SYSTEM_CONSTANT "RAIL_PSETPOINTFTSCOR_MAP_X" "8"
 SYSTEM_CONSTANT "RAIL_PSETPOINTFTSCOR_MAP_Y" "8"
 SYSTEM_CONSTANT "RAIL_PSETPOINTLIMNFLTEMP_MAP_X" "8"
 SYSTEM_CONSTANT "RAIL_PSETPOINTLIMNFLTEMP_MAP_Y" "8"
 SYSTEM_CONSTANT "RAIL_PSETPOINTMAXDEF_CUR_X" "6"
 SYSTEM_CONSTANT "RAIL_PSETPOINTMAXDEF_MAP_X" "6"
 SYSTEM_CONSTANT "RAIL_PSETPOINTMAXDEF_MAP_Y" "5"
 SYSTEM_CONSTANT "RAIL_PSETPOINTMAX_MAP_X" "5"
 SYSTEM_CONSTANT "RAIL_PSETPOINTMAX_MAP_Y" "6"
 SYSTEM_CONSTANT "RAIL_PSETPOINTMIN_MAP_X" "2"
 SYSTEM_CONSTANT "RAIL_PSETPOINTMIN_MAP_Y" "2"
 SYSTEM_CONSTANT "RAIL_PSETPOINTTEMPCORRGNX_AXIS" "16"
 SYSTEM_CONSTANT "RAIL_PSETPOINTTEMPCORRGNY_AXIS" "16"
 SYSTEM_CONSTANT "RAIL_P_MAX" "1800000"
 SYSTEM_CONSTANT "RAIL_P_ZERO" "0"
 SYSTEM_CONSTANT "RAIL_QCPCTLTYPE_CUR_X" "8"
 SYSTEM_CONSTANT "RAIL_QMEUNCTLTYPE_CUR_X" "8"
 SYSTEM_CONSTANT "RAIL_QPCVCTLTYPE_CUR_X" "8"
 SYSTEM_CONSTANT "RAIL_RZFCINITDWN_CUR_X" "6"
 SYSTEM_CONSTANT "RAIL_RZFCINITUP_CUR_X" "6"
 SYSTEM_CONSTANT "RAIL_SWTCTLSEL_TYPE" "2"
 SYSTEM_CONSTANT "RAIL_SWTCTLSEL_VAL" "0"
 SYSTEM_CONSTANT "RAIL_SWTPRECTL_TYPE" "2"
 SYSTEM_CONSTANT "RAIL_SWTPRECTL_VAL" "0"
 SYSTEM_CONSTANT "RAIL_SWTPRESS_TYPE" "2"
 SYSTEM_CONSTANT "RAIL_SWTPRESS_VAL" "0"
 SYSTEM_CONSTANT "RAIL_SWTWINDUP_TYPE" "2"
 SYSTEM_CONSTANT "RAIL_SWTWINDUP_VAL" "1"
 SYSTEM_CONSTANT "RAIL_TIMEUNCTLDT1_CUR_X" "5"
 SYSTEM_CONSTANT "RAIL_TIMEUNCTLPT1_CUR_X" "8"
 SYSTEM_CONSTANT "RAIL_TIMEUNRMPDUR_CUR_X" "8"
 SYSTEM_CONSTANT "RAIL_TIPCVCTLDT1_CUR_X" "5"
 SYSTEM_CONSTANT "RAIL_TIPCVRMPDUR_CUR_X" "8"
 SYSTEM_CONSTANT "RAIL_TMEUNCTLTYPE_CUR_X" "8"
 SYSTEM_CONSTANT "RAIL_TPCVCTLTYPE_CUR_X" "8"
 SYSTEM_CONSTANT "RAIL_WITHOUT_PRECTL" "0"
 SYSTEM_CONSTANT "RAIL_WITH_PRECTL" "1"
 SYSTEM_CONSTANT "RATAM_RES" "0.01"
 SYSTEM_CONSTANT "RATAM_RES_FL" "0.01"
 SYSTEM_CONSTANT "RATAM_RES_REV" "100"
 SYSTEM_CONSTANT "RATAM_ZERO" "0"
 SYSTEM_CONSTANT "RATASHM_RES" "1e-005"
 SYSTEM_CONSTANT "RATASHM_RES_REV" "100000"
 SYSTEM_CONSTANT "RATFM_ONE" "1"
 SYSTEM_CONSTANT "RATFM_RES" "0.01"
 SYSTEM_CONSTANT "RATFM_RES_REV" "100"
 SYSTEM_CONSTANT "RATFM_ZERO" "0"
 SYSTEM_CONSTANT "RATNOXM_RES" "1e-007"
 SYSTEM_CONSTANT "RATNOXM_RES_REV" "10000000"
 SYSTEM_CONSTANT "RATSOTM_RES" "1e-005"
 SYSTEM_CONSTANT "RATSOTM_RES_REV" "100000"
 SYSTEM_CONSTANT "RATSOTSOT_RESO" "0.001"
 SYSTEM_CONSTANT "RATSOXM_RES" "1e-008"
 SYSTEM_CONSTANT "RESIST_RES" "0.1"
 SYSTEM_CONSTANT "RESO_T_INC_PER_DUR_TTH_ADAP" "10"
 SYSTEM_CONSTANT "RESVCONST_SY" "1"
 SYSTEM_CONSTANT "RESVREL_SY" "1"
 SYSTEM_CONSTANT "RES_FACT_256" "256"
 SYSTEM_CONSTANT "REVCNT_RES" "16"
 SYSTEM_CONSTANT "REVCNT_RES_EXP" "4"
 SYSTEM_CONSTANT "REYNOLDS_NUM1_RES" "1000"
 SYSTEM_CONSTANT "REYNOLDS_NUM_RES" "100"
 SYSTEM_CONSTANT "RHO_FUEL_RES" "0.1"
 SYSTEM_CONSTANT "RHO_OILASH_RES" "0.1"
 SYSTEM_CONSTANT "RMPGOVRESREV_SY" "512"
 SYSTEM_CONSTANT "RMPSQRVLG_S_REF" "1000"
 SYSTEM_CONSTANT "RMPSQRVLG_S_RES" "65536"
 SYSTEM_CONSTANT "RMP_INTMIN_DT10" "6554"
 SYSTEM_CONSTANT "RMP_INTMIN_DT100" "656"
 SYSTEM_CONSTANT "RMP_INTMIN_DT20" "3277"
 SYSTEM_CONSTANT "RMP_NORM_FAC" "6554"
 SYSTEM_CONSTANT "RMP_NRM_EXP" "16"
 SYSTEM_CONSTANT "RMP_RES" "0.0152587890625"
 SYSTEM_CONSTANT "RMP_RES_1" "0.001"
 SYSTEM_CONSTANT "RMP_RES_1_REV" "1000"
 SYSTEM_CONSTANT "RMP_RES_INV" "65.536"
 SYSTEM_CONSTANT "RNGMOD_ADAP" "1"
 SYSTEM_CONSTANT "RNGMOD_NOADAP" "0"
 SYSTEM_CONSTANT "RNGMOD_REFUSEADAP" "2"
 SYSTEM_CONSTANT "RNGMOD_TRQCHEXCHLOSS_MAP_X" "16"
 SYSTEM_CONSTANT "RNGMOD_TRQCHEXCHLOSS_MAP_Y" "16"
 SYSTEM_CONSTANT "RNGMOD_TRQFRCLD_MAP_X" "16"
 SYSTEM_CONSTANT "RNGMOD_TRQFRCLD_MAP_Y" "16"
 SYSTEM_CONSTANT "RNGMOD_TRQFRC_MAP_X" "16"
 SYSTEM_CONSTANT "RNGMOD_TRQFRC_MAP_Y" "16"
 SYSTEM_CONSTANT "RNGMOD_TRQSPD_CUR_X" "25"
 SYSTEM_CONSTANT "ROOM_RES" "256"
 SYSTEM_CONSTANT "RPM2SEGTIME" "120000000"
 SYSTEM_CONSTANT "R_COIL_MAX" "5000"
 SYSTEM_CONSTANT "R_COIL_MIN" "0"
 SYSTEM_CONSTANT "R_LAMREC_MAX" "4"
 SYSTEM_CONSTANT "R_LAMREC_MIN" "0"
 SYSTEM_CONSTANT "R_RES" "1"
 SYSTEM_CONSTANT "R_STOICH_FL" "14.5"
 SYSTEM_CONSTANT "SEC_RES" "1"
 SYSTEM_CONSTANT "SETPOINTCALC_TRQBASED_SY" "0"
 SYSTEM_CONSTANT "Signals_Mode1PidSize_SY" "3"
 SYSTEM_CONSTANT "Signals_NumberPID_SY" "3"
 SYSTEM_CONSTANT "Signals_NumberSigNumExt_SY" "116"
 SYSTEM_CONSTANT "Signals_NumberSigNumInt_SY" "161"
 SYSTEM_CONSTANT "SIL_STFLAP_MAP_X" "8"
 SYSTEM_CONSTANT "SIL_STFLAP_MAP_Y" "8"
 SYSTEM_CONSTANT "SIXTY" "60000"
 SYSTEM_CONSTANT "SMKLIM_RLMBDFULLLD_MAP_X" "16"
 SYSTEM_CONSTANT "SMKLIM_RLMBDFULLLD_MAP_Y" "16"
 SYSTEM_CONSTANT "SMKLIM_RLMBDSMK_MAP_X" "16"
 SYSTEM_CONSTANT "SMKLIM_RLMBDSMK_MAP_Y" "16"
 SYSTEM_CONSTANT "SOOT_GPERLTR_RES" "0.01"
 SYSTEM_CONSTANT "SOOT_GPERLTR_RES_REV" "100"
 SYSTEM_CONSTANT "SOTMPT_RES" "0.01"
 SYSTEM_CONSTANT "SOTRESO_DIVADPT" "36"
 SYSTEM_CONSTANT "SOXMPT_RES" "0.0001"
 SYSTEM_CONSTANT "SPDGOV_LOWIDLE" "0"
 SYSTEM_CONSTANT "SPDGOV_NEGCURRTRQENA" "6"
 SYSTEM_CONSTANT "SPDGOV_NEGLDTRQENA" "5"
 SYSTEM_CONSTANT "SPDGOV_NGSH" "2"
 SYSTEM_CONSTANT "SPDGOV_NMAX" "1"
 SYSTEM_CONSTANT "SPDGOV_NSETP_ARRAY_CURR_POS" "0"
 SYSTEM_CONSTANT "SPDGOV_NSETP_ARRAY_GSHDEM_POS" "2"
 SYSTEM_CONSTANT "SPDGOV_NSETP_ARRAY_HLSDEM_POS" "1"
 SYSTEM_CONSTANT "SPDGOV_NWORK" "3"
 SYSTEM_CONSTANT "SPDGOV_OVRDS_PTPRT" "0"
 SYSTEM_CONSTANT "SPDGOV_RESVCONSTDEM" "8"
 SYSTEM_CONSTANT "SPDGOV_RESVRELDEM" "7"
 SYSTEM_CONSTANT "SPDGOV_SETPHI_ARRAYSIZE" "3"
 SYSTEM_CONSTANT "SPDGOV_SETPLO_ARRAYSIZE" "3"
 SYSTEM_CONSTANT "SPDGOV_TRQDEM" "4"
 SYSTEM_CONSTANT "SPDGOV_TRQFLT" "2"
 SYSTEM_CONSTANT "SPDGOV_TRQLEAD" "1"
 SYSTEM_CONSTANT "SPDGOV_TRQSET" "0"
 SYSTEM_CONSTANT "SPDIDX0" "16"
 SYSTEM_CONSTANT "SPDIDX1" "32"
 SYSTEM_CONSTANT "SPDIDX2" "17"
 SYSTEM_CONSTANT "SPDIDX3" "33"
 SYSTEM_CONSTANT "SPDIDXHI" "49"
 SYSTEM_CONSTANT "SPDIDXLO" "48"
 SYSTEM_CONSTANT "SPECIFICHEAT_RES" "0.0001"
 SYSTEM_CONSTANT "SQRVLTG_S_RES" "0.1"
 SYSTEM_CONSTANT "SQRVLTG_S_ZERO" "0"
 SYSTEM_CONSTANT "SSWTS_TYPE_DATASET" "2"
 SYSTEM_CONSTANT "SSWTS_TYPE_EEP" "1"
 SYSTEM_CONSTANT "STEEP_ADAPT" "1"
 SYSTEM_CONSTANT "STEEP_CPY" "4"
 SYSTEM_CONSTANT "STEEP_HOLD" "2"
 SYSTEM_CONSTANT "STROKE_PML_RES" "0.1"
 SYSTEM_CONSTANT "STROKE_PML_RES_REV" "10"
 SYSTEM_CONSTANT "STRTTRQ_OFF" "0"
 SYSTEM_CONSTANT "STRTTRQ_ON" "1"
 SYSTEM_CONSTANT "STSYS_NSTRTCUTOUT_MAP_X" "4"
 SYSTEM_CONSTANT "STSYS_NSTRTCUTOUT_MAP_Y" "4"
 SYSTEM_CONSTANT "STSYS_STRTTIP_ACTV" "1"
 SYSTEM_CONSTANT "STSYS_STRTTIP_NACTV" "0"
 SYSTEM_CONSTANT "STSYS_TRQSTRTBAS_MAP_X" "8"
 SYSTEM_CONSTANT "STSYS_TRQSTRTBAS_MAP_Y" "10"
 SYSTEM_CONSTANT "STWHL_DPHI_ZERO" "0"
 SYSTEM_CONSTANT "STWHL_PHI_ZERO" "0"
 SYSTEM_CONSTANT "ST_CHGREG" "4"
 SYSTEM_CONSTANT "ST_DYN" "1"
 SYSTEM_CONSTANT "ST_NOVRRUN" "2"
 SYSTEM_CONSTANT "ST_REGNV" "8"
 SYSTEM_CONSTANT "ST_RES_MAX" "2.5"
 SYSTEM_CONSTANT "ST_RES_MIN" "0"
 SYSTEM_CONSTANT "ST_RES_RES" "0.0001"
 SYSTEM_CONSTANT "ST_RES_RES_INV" "10000"
 SYSTEM_CONSTANT "SWT_DISABLED" "0"
 SYSTEM_CONSTANT "SWT_ENABLED" "1"
 SYSTEM_CONSTANT "SWT_TYPE_APPL" "2"
 SYSTEM_CONSTANT "SWT_TYPE_DATASET" "0"
 SYSTEM_CONSTANT "SWT_TYPE_EEP" "1"
 SYSTEM_CONSTANT "TAA_CFG_SPDRNG" "1"
 SYSTEM_CONSTANT "TAA_ENTRY_PHIDVT" "84"
 SYSTEM_CONSTANT "TAA_ENTRY_TINC" "60"
 SYSTEM_CONSTANT "TAA_INC_CMB" "30"
 SYSTEM_CONSTANT "TAA_INC_GAPHDL" "5"
 SYSTEM_CONSTANT "TAA_MAX_INC" "60"
 SYSTEM_CONSTANT "TAA_NUM_MAXGAP" "3"
 SYSTEM_CONSTANT "TAA_NUM_SPDRNG" "3"
 SYSTEM_CONSTANT "TAA_PHIMAX" "2.5"
 SYSTEM_CONSTANT "TCSOVRDSTSCINC_SY" "1"
 SYSTEM_CONSTANT "TCS_OVRDS_TSCINC" "1"
 SYSTEM_CONSTANT "TEGMOD_ALPHAEGPIPE_RES" "1280"
 SYSTEM_CONSTANT "TEGMOD_ALPHAPIPEENV_RES" "52428.8"
 SYSTEM_CONSTANT "TEGMOD_AREAPIPE_RES" "201.06192982976"
 SYSTEM_CONSTANT "TEGMOD_CMPRPWR_RES" "76747.2972710018"
 SYSTEM_CONSTANT "TEGMOD_DELTATEMP_RES" "100"
 SYSTEM_CONSTANT "TEGMOD_FACPT1_RES" "2812.5"
 SYSTEM_CONSTANT "TEGMOD_HEATFLOWKW_RES" "100000"
 SYSTEM_CONSTANT "TEGMOD_HEATFLOW_INTER_RES" "360"
 SYSTEM_CONSTANT "TEGMOD_HEATFLOW_RES" "1000"
 SYSTEM_CONSTANT "TEGMOD_HEATKJ_RES" "100"
 SYSTEM_CONSTANT "TEGMOD_HEATRANS_INTER_RES" "8192"
 SYSTEM_CONSTANT "TEGMOD_HEATRANS_RES" "10"
 SYSTEM_CONSTANT "TEGMOD_INTER1_RES" "0.01"
 SYSTEM_CONSTANT "TEGMOD_INTER_RES" "1"
 SYSTEM_CONSTANT "TEGMOD_PT1TIMECONST_RES" "335.54432"
 SYSTEM_CONSTANT "TEGMOD_REPIPEENV_RES" "17777.7777777778"
 SYSTEM_CONSTANT "TEGMOD_REPIPE_RES" "370.857896905592"
 SYSTEM_CONSTANT "TEGMOD_TEMPEG_INTER_RES" "2812.5"
 SYSTEM_CONSTANT "TEGMOD_TEMPEG_RES" "128"
 SYSTEM_CONSTANT "TEGMOD_TEMPTRBN_INTER_RES" "10485.76"
 SYSTEM_CONSTANT "TEGMOD_TEMPTRBN_RES" "9424.77796077"
 SYSTEM_CONSTANT "TEMP_CELS_RES" "0.1"
 SYSTEM_CONSTANT "TEMP_CELS_ZERO" "0"
 SYSTEM_CONSTANT "TEMP_ETCTL_SY" "25"
 SYSTEM_CONSTANT "TEMP_HIGH_RES" "0.01"
 SYSTEM_CONSTANT "TEMP_KELV_SEC_CTT_MON_RES" "0"
 SYSTEM_CONSTANT "TEMP_KELV_SEC_CTT_MON_RES_REV" "40960"
 SYSTEM_CONSTANT "TEMP_NULL_C" "-273.14"
 SYSTEM_CONSTANT "TEMP_NULL_F" "-459.652"
 SYSTEM_CONSTANT "TEMP_PA_MAX" "180"
 SYSTEM_CONSTANT "TEMP_PA_MIN" "-40"
 SYSTEM_CONSTANT "TEMP_RES" "0.1"
 SYSTEM_CONSTANT "TEMP_RES_FL" "0.1"
 SYSTEM_CONSTANT "TEMP_RES_INV" "10"
 SYSTEM_CONSTANT "TEMP_RES_REV" "10"
 SYSTEM_CONSTANT "TEMP_WVCOR_MAX" "140"
 SYSTEM_CONSTANT "TEMP_WVCOR_MIN" "-40"
 SYSTEM_CONSTANT "TEMP_ZERO" "-273.14"
 SYSTEM_CONSTANT "TEMP_ZERO_KELV" "0"
 SYSTEM_CONSTANT "TEN_THOUSAND" "10000"
 SYSTEM_CONSTANT "THERMAL_COEFF_RES" "0.1"
 SYSTEM_CONSTANT "THOUSAND" "1000"
 SYSTEM_CONSTANT "TIMEDELAY_S_2_MIN" "0.001"
 SYSTEM_CONSTANT "TIMEDELAY_S_2_NRM" "8"
 SYSTEM_CONSTANT "TIMEDELAY_S_LIN_16_MAX" "5"
 SYSTEM_CONSTANT "TIMEDELAY_S_LIN_16_MAX_ASDDC" "1.5"
 SYSTEM_CONSTANT "TIMEDELAY_S_LIN_16_MAX_ASDRF" "1.5"
 SYSTEM_CONSTANT "TIMEDELAY_S_LIN_16_REC_RES" "4294.967296"
 SYSTEM_CONSTANT "TIMEDELAY_S_LIN_16_RES" "0.000152592547379986"
 SYSTEM_CONSTANT "TIMEDELAY_S_LIN_16_RES_FL" "0.000152592547379986"
 SYSTEM_CONSTANT "TIMEDT_RES" "1e-006"
 SYSTEM_CONSTANT "TIMEDT_RES_REV" "1000000"
 SYSTEM_CONSTANT "TIMEENGON_RES_REV" "1"
 SYSTEM_CONSTANT "TIMEHRS_ENG_ON_RES" "100"
 SYSTEM_CONSTANT "TIME_20ms_CYCLE" "20000"
 SYSTEM_CONSTANT "TIME_DEB_10MS" "10000"
 SYSTEM_CONSTANT "TIME_DEB_NULL" "0"
 SYSTEM_CONSTANT "TIME_DEB_RES" "10"
 SYSTEM_CONSTANT "TIME_DEB_ZERO" "0"
 SYSTEM_CONSTANT "TIME_DT_1000MS" "1000000"
 SYSTEM_CONSTANT "TIME_DT_100MS" "100000"
 SYSTEM_CONSTANT "TIME_DT_10MS" "10000"
 SYSTEM_CONSTANT "TIME_DT_1MS" "1000"
 SYSTEM_CONSTANT "TIME_DT_200MS" "200000"
 SYSTEM_CONSTANT "TIME_DT_20MS" "20000"
 SYSTEM_CONSTANT "TIME_DT_2MS" "2000"
 SYSTEM_CONSTANT "TIME_DT_50MS" "50000"
 SYSTEM_CONSTANT "TIME_DT_5MS" "5000"
 SYSTEM_CONSTANT "TIME_DT_RES" "1"
 SYSTEM_CONSTANT "TIME_DT_RES_FL" "1"
 SYSTEM_CONSTANT "TIME_DT_S" "1000000"
 SYSTEM_CONSTANT "TIME_ENG_ON_RES" "1"
 SYSTEM_CONSTANT "TIME_GPTA_CLOCK_50ns" "0.05"
 SYSTEM_CONSTANT "TIME_GT0_CLOCK_400ns" "0.0004"
 SYSTEM_CONSTANT "TIME_HR_MAX" "16383"
 SYSTEM_CONSTANT "TIME_HR_MIN" "0"
 SYSTEM_CONSTANT "TIME_HR_RES" "0.5"
 SYSTEM_CONSTANT "TIME_HR_RES_REV" "2"
 SYSTEM_CONSTANT "TIME_MS_MAX" "655140"
 SYSTEM_CONSTANT "TIME_MS_SMAX" "327460"
 SYSTEM_CONSTANT "TIME_MS_ZERO" "0"
 SYSTEM_CONSTANT "TIME_PWM_HIGH_RES" "5e-008"
 SYSTEM_CONSTANT "TIME_PZOCHRGPSE_MAX" "20"
 SYSTEM_CONSTANT "TIME_PZOCHRGPSE_MIN" "2"
 SYSTEM_CONSTANT "TIME_PZOCHRGPSE_RES" "0.01"
 SYSTEM_CONSTANT "TIME_PZOCHRGPSE_ZERO" "0"
 SYSTEM_CONSTANT "TIME_PZOMEAS_RES" "0.0546"
 SYSTEM_CONSTANT "TIME_RED_MAX" "3600"
 SYSTEM_CONSTANT "TIME_RED_NRM" "4"
 SYSTEM_CONSTANT "TIME_RED_RES" "0.16"
 SYSTEM_CONSTANT "TIME_RED_RES_REV" "6.25"
 SYSTEM_CONSTANT "TIME_RED_ZERO" "0"
 SYSTEM_CONSTANT "TIME_RES_FL" "1e-006"
 SYSTEM_CONSTANT "TIME_RMP_RES" "53687091.2"
 SYSTEM_CONSTANT "TIME_SEC2HR" "1800"
 SYSTEM_CONSTANT "TIME_S_1_RES" "0.001"
 SYSTEM_CONSTANT "TIME_S_MAX" "327.46"
 SYSTEM_CONSTANT "TIME_S_ONE" "1"
 SYSTEM_CONSTANT "TIME_S_RES_REV" "100"
 SYSTEM_CONSTANT "TIME_S_TIACTRGN" "0.01"
 SYSTEM_CONSTANT "TIME_S_ZERO" "0"
 SYSTEM_CONSTANT "TIME_TICK" "10"
 SYSTEM_CONSTANT "TIME_TICK_S" "0.01"
 SYSTEM_CONSTANT "TIME_TICK_SEC_INV" "100"
 SYSTEM_CONSTANT "TIME_US_400NS_RES" "400"
 SYSTEM_CONSTANT "TIME_US_RES" "1"
 SYSTEM_CONSTANT "TIME_US_ZERO" "0"
 SYSTEM_CONSTANT "TIOP2MOILASH" "100"
 SYSTEM_CONSTANT "TI_DIFF_HYD_MAX" "5000"
 SYSTEM_CONSTANT "TI_DIFF_HYD_MIN" "-5000"
 SYSTEM_CONSTANT "TI_PII_EARL_REL" "13000"
 SYSTEM_CONSTANT "TI_POI2_LATE_REL" "-13000"
 SYSTEM_CONSTANT "TI_RMPSLP_MAX" "40"
 SYSTEM_CONSTANT "TI_RMPSLP_MIN" "1"
 SYSTEM_CONSTANT "TKM2HR" "100000"
 SYSTEM_CONSTANT "TOXICMOD_HEATFLOW_RES" "36"
 SYSTEM_CONSTANT "TOXICMOD_REMOXY_RES" "335600"
 SYSTEM_CONSTANT "TOXICMOD_UNBRNFL_RES" "100"
 SYSTEM_CONSTANT "TRANS_R_MAX" "32767"
 SYSTEM_CONSTANT "TRANS_R_ONE" "1"
 SYSTEM_CONSTANT "TRANS_R_RES" "0.01"
 SYSTEM_CONSTANT "TRANS_R_RES_REV" "100"
 SYSTEM_CONSTANT "TRAPRT_OVRDS_DCS" "0"
 SYSTEM_CONSTANT "TRATYPE_AST_SY" "2"
 SYSTEM_CONSTANT "TRATYPE_AT_SY" "1"
 SYSTEM_CONSTANT "TRATYPE_CVT_SY" "3"
 SYSTEM_CONSTANT "TRATYPE_MT_SY" "0"
 SYSTEM_CONSTANT "TRATYPE_NEW1_SY" "4"
 SYSTEM_CONSTANT "TRATYPE_NEW2_SY" "5"
 SYSTEM_CONSTANT "TRATYPE_NEW3_SY" "6"
 SYSTEM_CONSTANT "TRATYPE_NEW4_SY" "7"
 SYSTEM_CONSTANT "TRA_ASTINTVACTV_BP" "0"
 SYSTEM_CONSTANT "TRA_ASTNEUTR_BP" "1"
 SYSTEM_CONSTANT "TRA_LORNGACT_MSK" "2"
 SYSTEM_CONSTANT "TRA_STNSETP_FLT" "0"
 SYSTEM_CONSTANT "TRA_STNSETP_TIPIN" "2"
 SYSTEM_CONSTANT "TRA_STNSETP_UNFLT" "1"
 SYSTEM_CONSTANT "TRA_TRQFRC_DFLVAL" "0"
 SYSTEM_CONSTANT "TRA_TRQGEARBXMAX_ERRVAL" "1000"
 SYSTEM_CONSTANT "TRA_TSCPTD_BP" "0"
 SYSTEM_CONSTANT "TRQINRFACT_EXP" "8"
 SYSTEM_CONSTANT "TRQINRFACT_RES" "256"
 SYSTEM_CONSTANT "TRQINRKD_RES" "1.52587890625e-006"
 SYSTEM_CONSTANT "TRQINRKD_RES_16" "2.44140625e-005"
 SYSTEM_CONSTANT "TRQINRKI_RES" "4.65661287307739e-005"
 SYSTEM_CONSTANT "TRQINRKI_RES_8" "0.000372529029846191"
 SYSTEM_CONSTANT "TRQINRKP_RES" "3.0517578125e-006"
 SYSTEM_CONSTANT "TRQINRKP_RES_128" "0.000390625"
 SYSTEM_CONSTANT "TRQPRPHIGH_MAX" "50000"
 SYSTEM_CONSTANT "TRQPRPHIGH_MIN" "-50000"
 SYSTEM_CONSTANT "TRQPRPHIGH_RES" "0.1"
 SYSTEM_CONSTANT "TRQPRPHIGH_ZERO" "0"
 SYSTEM_CONSTANT "TRQPRP_NRM" "4"
 SYSTEM_CONSTANT "TRQPRP_RES" "1.6"
 SYSTEM_CONSTANT "TRQPRP_ZERO" "0"
 SYSTEM_CONSTANT "TRQTONSQR_RES" "1e-007"
 SYSTEM_CONSTANT "TRQWHL_ZERO" "0"
 SYSTEM_CONSTANT "TRQ_400" "400"
 SYSTEM_CONSTANT "TRQ_FRC_INI" "-50"
 SYSTEM_CONSTANT "TRQ_MAX" "1000"
 SYSTEM_CONSTANT "TRQ_MIN" "-500"
 SYSTEM_CONSTANT "TRQ_RES" "0.1"
 SYSTEM_CONSTANT "TRQ_RES_FL" "0.1"
 SYSTEM_CONSTANT "TRQ_RES_REV" "10"
 SYSTEM_CONSTANT "TRQ_WOTRAINTV_SY" "1"
 SYSTEM_CONSTANT "TRQ_ZERO" "0"
 SYSTEM_CONSTANT "TSCDEC_OVRDS_DCS" "0"
 SYSTEM_CONSTANT "TSCINC_OVRDS_DFFTLPRT" "0"
 SYSTEM_CONSTANT "TSCINC_OVRDS_TCS" "0"
 SYSTEM_CONSTANT "TURBODN_RES" "500"
 SYSTEM_CONSTANT "TURBON_RES" "10"
 SYSTEM_CONSTANT "TVACD_DCYCCONV_CUR_X" "25"
 SYSTEM_CONSTANT "TWO_EXP_16" "65536"
 SYSTEM_CONSTANT "TWO_PI" "314.159265359"
 SYSTEM_CONSTANT "TWO_POW_NRM_EXP_RES_TRIGO_FUNC" "4096"
 SYSTEM_CONSTANT "T_1SEC_RESO_SY" "1000000"
 SYSTEM_CONSTANT "T_AIR_MAX" "199.86"
 SYSTEM_CONSTANT "T_AIR_MIN" "-50.14"
 SYSTEM_CONSTANT "T_CLNT_MAX" "149.86"
 SYSTEM_CONSTANT "T_CLNT_MIN" "-50.14"
 SYSTEM_CONSTANT "T_EGAS_MAX" "1273"
 SYSTEM_CONSTANT "T_EGAS_MIN" "223"
 SYSTEM_CONSTANT "T_EGR_MIN" "-50"
 SYSTEM_CONSTANT "T_EGTGOV" "25"
 SYSTEM_CONSTANT "T_EGT_CORMAX_C" "0.5"
 SYSTEM_CONSTANT "T_EGT_CORMIN_C" "0"
 SYSTEM_CONSTANT "T_EGT_WINNEG" "-1000"
 SYSTEM_CONSTANT "T_EGT_WINPOS" "1000"
 SYSTEM_CONSTANT "T_ENG_MAX" "199.86"
 SYSTEM_CONSTANT "T_ENG_MIN" "-50.14"
 SYSTEM_CONSTANT "T_ETCTL_WINNEG_MAX" "100"
 SYSTEM_CONSTANT "T_ETCTL_WINNEG_MIN" "-1000"
 SYSTEM_CONSTANT "T_ETCTL_WINPOS_MAX" "1000"
 SYSTEM_CONSTANT "T_ETCTL_WINPOS_MIN" "-100"
 SYSTEM_CONSTANT "T_EXHGS_MAX" "1050"
 SYSTEM_CONSTANT "T_EXHGS_MIN" "-45"
 SYSTEM_CONSTANT "T_FUEL_MAX" "149.86"
 SYSTEM_CONSTANT "T_FUEL_MIN" "-50.14"
 SYSTEM_CONSTANT "T_GOVIO_MAX" "1500"
 SYSTEM_CONSTANT "T_GOVIO_MIN" "-100"
 SYSTEM_CONSTANT "T_GOV_MAX" "1500"
 SYSTEM_CONSTANT "T_GOV_MIN" "-100"
 SYSTEM_CONSTANT "T_INRCORMAX_MAX" "1500"
 SYSTEM_CONSTANT "T_INRCORMAX_MIN" "-100"
 SYSTEM_CONSTANT "T_INRCORMIN_MAX" "0"
 SYSTEM_CONSTANT "T_INRCORMIN_MIN" "-1500"
 SYSTEM_CONSTANT "T_LAMBDA_MAX" "1300"
 SYSTEM_CONSTANT "T_LAMBDA_MIN" "100"
 SYSTEM_CONSTANT "T_SURF_MAX" "800"
 SYSTEM_CONSTANT "T_SURF_MIN" "100"
 SYSTEM_CONSTANT "T_TEMPDIFF_NULL" "0"
 SYSTEM_CONSTANT "T_TEMP_NORM" "298"
 SYSTEM_CONSTANT "UBATT_ADC_REF" "20000"
 SYSTEM_CONSTANT "UBATT_MAX" "20782"
 SYSTEM_CONSTANT "UI_CURR_ADCMAX" "30000"
 SYSTEM_CONSTANT "UI_CURR_HWOFF" "34000"
 SYSTEM_CONSTANT "USEC2MSEC" "1000"
 SYSTEM_CONSTANT "U_ADC_MAX" "5200"
 SYSTEM_CONSTANT "U_ADC_MIN" "0"
 SYSTEM_CONSTANT "U_ADC_REF" "5000"
 SYSTEM_CONSTANT "U_GCVOLT_REF" "5000"
 SYSTEM_CONSTANT "U_RATED" "14000"
 SYSTEM_CONSTANT "U_RATED_PASS" "14000"
 SYSTEM_CONSTANT "U_RATED_TRUCK" "28000"
 SYSTEM_CONSTANT "U_TO_RESIST_RES" "0.001"
 SYSTEM_CONSTANT "U_TO_RESIST_REV_RES" "1000"
 SYSTEM_CONSTANT "V2N_NORM" "2000"
 SYSTEM_CONSTANT "V2N_RES" "1e-005"
 SYSTEM_CONSTANT "V2N_ZERO" "0"
 SYSTEM_CONSTANT "VEHMOT_DCS_BP" "1"
 SYSTEM_CONSTANT "VEHMOT_PI" "3.14159562"
 SYSTEM_CONSTANT "VEHMOT_TCS_BP" "0"
 SYSTEM_CONSTANT "VEHMOT_V_MIN" "3"
 SYSTEM_CONSTANT "VEHV_TIPER_MAX" "671088.65"
 SYSTEM_CONSTANT "VEL_MAX" "300"
 SYSTEM_CONSTANT "VEL_MIN" "0"
 SYSTEM_CONSTANT "VEL_RES" "0.01"
 SYSTEM_CONSTANT "VEL_RES_REV" "100"
 SYSTEM_CONSTANT "VEL_RES_SI" "0.00277777777777778"
 SYSTEM_CONSTANT "VEL_ZERO" "0"
 SYSTEM_CONSTANT "VLTG_PA_MAX" "250"
 SYSTEM_CONSTANT "VLTG_PA_MIN" "-250"
 SYSTEM_CONSTANT "VLTG_PA_RES" "0.01"
 SYSTEM_CONSTANT "VLTG_PA_ZERO" "0"
 SYSTEM_CONSTANT "VLV_VEL_RES" "0.1"
 SYSTEM_CONSTANT "VMSI_DCSPTD_BP" "0"
 SYSTEM_CONSTANT "VMSI_DCS_BP" "1"
 SYSTEM_CONSTANT "VMSI_STCFG_DCSSHOFFRMPENA_BP" "0"
 SYSTEM_CONSTANT "VMSI_TCS_BP" "0"
 SYSTEM_CONSTANT "VOLADD_ML_FINE_RES" "0.001"
 SYSTEM_CONSTANT "VOLADD_ML_FINE_RES_REV" "1000"
 SYSTEM_CONSTANT "VOLT_ADC_RES" "0.2"
 SYSTEM_CONSTANT "VOLT_BATT_RES" "20"
 SYSTEM_CONSTANT "VOLT_BATT_RES_REV" "0.05"
 SYSTEM_CONSTANT "VOLT_ZERO" "0"
 SYSTEM_CONSTANT "VOL_ADD_RES" "0.1"
 SYSTEM_CONSTANT "VOL_FL_L_TO_FL_2" "1000"
 SYSTEM_CONSTANT "VOL_PFLT_MAX" "100"
 SYSTEM_CONSTANT "VOL_PFLT_MIN" "0.01"
 SYSTEM_CONSTANT "VOL_RES" "0.01"
 SYSTEM_CONSTANT "VSACD_DCYCCONV_CUR_X" "25"
 SYSTEM_CONSTANT "VSWCTL_FACENGTEMPCTLCOR_CUR_X" "12"
 SYSTEM_CONSTANT "VSWCTL_FACENVPRESCTLCOREOM_CUR_X" "25"
 SYSTEM_CONSTANT "VSWCTL_FACENVPRESCTLCOR_CUR_X" "25"
 SYSTEM_CONSTANT "VSWCTL_FACRMPVALCTLCOR_CUR_X" "13"
 SYSTEM_CONSTANT "VSWCTL_NUMSTPRIOMON" "6"
 SYSTEM_CONSTANT "VSWCTL_RCTLBASEOM_MAP_X" "16"
 SYSTEM_CONSTANT "VSWCTL_RCTLBASEOM_MAP_Y" "16"
 SYSTEM_CONSTANT "VSWCTL_RCTLBASHIALTDEOM_MAP_X" "16"
 SYSTEM_CONSTANT "VSWCTL_RCTLBASHIALTDEOM_MAP_Y" "16"
 SYSTEM_CONSTANT "VSWCTL_RCTLBASHIALTD_MAP_X" "16"
 SYSTEM_CONSTANT "VSWCTL_RCTLBASHIALTD_MAP_Y" "16"
 SYSTEM_CONSTANT "VSWCTL_RCTLBAS_MAP_X" "16"
 SYSTEM_CONSTANT "VSWCTL_RCTLBAS_MAP_Y" "16"
 SYSTEM_CONSTANT "VSWCTL_RENGTEMPCORBAS_MAP_X" "8"
 SYSTEM_CONSTANT "VSWCTL_RENGTEMPCORBAS_MAP_Y" "8"
 SYSTEM_CONSTANT "VSWCTL_RVSAAIRTEMPCORR_CUR_X" "6"
 SYSTEM_CONSTANT "VSWCTL_TISTARTDELAY_CUR_X" "5"
 SYSTEM_CONSTANT "WAHTEL_STRECG_FALSE" "0"
 SYSTEM_CONSTANT "WAHTEL_STRECG_NOTREQD" "2"
 SYSTEM_CONSTANT "WAHTEL_STRECG_TRUE" "1"
 SYSTEM_CONSTANT "WAHT_NUM_HTRS" "3"
 SYSTEM_CONSTANT "WAHT_NUM_PS" "2"
 SYSTEM_CONSTANT "ZFC_BPFACINV_RES" "546.116666666667"
 SYSTEM_CONSTANT "ZFC_BPFAC_MAX" "30"
 SYSTEM_CONSTANT "ZFC_BPFAC_MIN" "-30"
 SYSTEM_CONSTANT "ZFC_BPFAC_RES" "0.00183111056855983"
 SYSTEM_CONSTANT "ZFC_BPFAC_RES_FL" "0.00183111056855983"
 SYSTEM_CONSTANT "ZFC_PHISET_CUR_X" "16"
 SYSTEM_CONSTANT "ZFC_SWTCLBACTV_TYPE" "2"
 SYSTEM_CONSTANT "ZFC_SWTCLBACTV_VAL" "1"
 SYSTEM_CONSTANT "ZFC_TICLDCHAM_CUR_X" "12" /end MOD_PAR
/begin MOD_COMMON "" BYTE_ORDER MSB_LAST ALIGNMENT_BYTE 1 ALIGNMENT_WORD 2 ALIGNMENT_LONG 4 ALIGNMENT_FLOAT32_IEEE 4 /end MOD_COMMON
/begin IF_DATA ASAP1B_Bypass
 /begin TP_BLOB 0x100 /* Bypass version */ 0x100 /end TP_BLOB
/end IF_DATA
/begin IF_DATA ASAP1B_CCP
 /begin SOURCE "segment synchronous" 103 1 /begin QP_BLOB 0 LENGTH 7 CAN_ID_FIXED 0x330 FIRST_PID 0 RASTER 0 /end QP_BLOB /end SOURCE
 /begin SOURCE "10ms time synchronous" 4 1 /begin QP_BLOB 1 LENGTH 11 CAN_ID_FIXED 0x340 FIRST_PID 7 RASTER 1 /end QP_BLOB /end SOURCE
 /begin SOURCE "100ms time synchronous" 4 10 /begin QP_BLOB 2 LENGTH 11 CAN_ID_FIXED 0x350 FIRST_PID 18 RASTER 2 /end QP_BLOB /end SOURCE
 /begin RASTER "segment synchronous" "seg_sync" 0 103 1 /end RASTER
 /begin RASTER "10ms time synchronous" "10_ms" 1 4 1 /end RASTER
 /begin RASTER "100ms time synchronous" "100_ms" 2 4 10 /end RASTER
 /begin SEED_KEY /* seed&key dll for CAL */ "" /* seed&key dll for DAQ */ "" /* seed&key dll for PGM */ "" /end SEED_KEY
 /begin TP_BLOB /* CCP version */ 0x201 0x204 /* CAN msg ID-send */ 0x310 /* CAN msg ID-recv */ 0x320 /* station address */ 0xAD01 /* byte order */ 2 BAUDRATE 500000 /* in Hz */ SAMPLE_POINT 60 /* in % */ SAMPLE_RATE 1 /* 1 or 3 */ BTL_CYCLES 19 SJW 3 SYNC_EDGE SINGLE /* SINGLE or DUAL */ DAQ_MODE BURST CONSISTENCY DAQ
  /begin CHECKSUM_PARAM /* algorithm */ 0xC001 /* limit */ 0xFFFFFFFF CHECKSUM_CALCULATION ACTIVE_PAGE /end CHECKSUM_PARAM
  /begin DEFINED_PAGES 1 /* page name */ "reference page" /* address ext. */ 0x0 /* base address */ 0x80040000 /* page length */ 0x3FF04 ROM /end DEFINED_PAGES
  /begin DEFINED_PAGES 2 /* page name */ "working page" /* address ext. */ 0x0 /* base address */ 0x40000 /* page length */ 0x3FF04 RAM RAM_INIT_BY_ECU /end DEFINED_PAGES
  OPTIONAL_CMD 0x11 /* SELECT_CAL_PAGE */ OPTIONAL_CMD 0xE /* BUILD_CHKSUM */ OPTIONAL_CMD 0x19 /* MOVE */ OPTIONAL_CMD 0x9 /* GET_ACTIVE_CAL_PAGE */ OPTIONAL_CMD 0xC /* SET_S_STATUS */ OPTIONAL_CMD 0xD /* GET_S_STATUS */ OPTIONAL_CMD 0x12 /* GET_SEED */ OPTIONAL_CMD 0x13 /* UNLOCK */ OPTIONAL_CMD 0x23 /* DNLOAD_6 */ OPTIONAL_CMD 0x8 /* START_STOP_ALL */ OPTIONAL_CMD 0x20 /* DIAG_SERVICE */ /end TP_BLOB
/end IF_DATA
/begin IF_DATA ASAP1B_KWP2000
 /begin SOURCE "10ms time synchronous" 4 1 QP_BLOB 0 BLOCKMODE 0xF0 0 20 /end SOURCE
 /begin TP_BLOB 0x101 /* ECU address on k line */ 0x11 /* requ. tester address */ 0xF1 /* ECU stimulation mode */ WUP /* byte order */ MSB_LAST 1 DATA_ACCESS /* Flash address */ 0x0 /* RAM address */ 0x0 /* Data Read */ 1 /* Code Verify */ 0 /* Code Read */ 0 /* Load mode */ 1
  /begin CHECKSUM /* Checksum Type */ 0x10201 /* only at active Page */ 1 /* loc Routine Id Checksum */ 1 RequestRoutineResults RNC_RESULT 0x21 0x23 0x78 /end CHECKSUM
  /begin FLASH_COPY NOFLASHBACK /* loc Routine Id Checksum */ 3 RequestRoutineResults RAM_InitByECU /* DiagModeCopyRamToFlash */ 0x86 COPY_FRAME 1 RNC_RESULT 0x21 0x23 0x78 0xFB 0xFC /end FLASH_COPY
  /begin DIAG_BAUD 38400 0xFA BD_PARA 0x50 /end DIAG_BAUD
  /begin DIAG_BAUD 10400 0xFA BD_PARA 0x14 /end DIAG_BAUD
  /begin DIAG_BAUD 57600 0xFA BD_PARA 0x64 /end DIAG_BAUD
  /begin DIAG_BAUD 125000 0xFA BD_PARA 0x87 /end DIAG_BAUD
  /* Timing Parameter: p1Max p2Min p2Max p3Min p3Max p4Min */ TIME_DEF 20 0 50 3 512 0 TIME_DEF 20 0 50 3 512 1 TIME_DEF 20 0 2000 0 5000 65440 /* Seed&Key Parameter: AccMode CalcMethod Delay */ /* SECURITY_ACCESS 9 1 0 */
  /begin PAGE_SWITCH ESCAPE_CODE ESCAPE_CODE_PARA_SET 0x90 ESCAPE_CODE_PARA_GET 0x91 PAGE_CODE 0x0 0x1 /end PAGE_SWITCH
 /end TP_BLOB
/end IF_DATA
/begin IF_DATA XCP
 /begin PAG /* MAX_SEGMENTS */ 8 /end PAG
 /begin XCP_ON_USB /* XCP on USB version */ 0x100 /* Vendor ID */ 0x58B /* Product ID */ 0x7 /* No of interface */ 2 HEADER_LEN_FILL_WORD /* OUT-EP for CMD and */ /* STIM (additional USB Endpoints may also be specified) */
  /begin OUT_EP_CMD_STIM 5 BULK_TRANSFER 64 0 MESSAGE_PACKING_SINGLE ALIGNMENT_32_BIT /end OUT_EP_CMD_STIM
  /* IN-EP for RES/ERR, */ /* DAQ (additional USB Endpoints may also be specified) */ /* and EV/SERV (if not specified otherwise) */
  /begin IN_EP_RESERR_DAQ_EVSERV 7 BULK_TRANSFER 64 0 MESSAGE_PACKING_SINGLE ALIGNMENT_32_BIT RECOMMENDED_HOST_BUFSIZE 1 /end IN_EP_RESERR_DAQ_EVSERV
  ALTERNATE_SETTING_NO 1 INTERFACE_STRING_DESCRIPTOR "XCP Slave 0001"
  /begin IN_EP_ONLY_DAQ 8 BULK_TRANSFER 64 0 MESSAGE_PACKING_SINGLE ALIGNMENT_32_BIT RECOMMENDED_HOST_BUFSIZE 16 /end IN_EP_ONLY_DAQ
  /begin DAQ_LIST_USB_ENDPOINT 0 FIXED_IN 8 /end DAQ_LIST_USB_ENDPOINT
  /begin DAQ_LIST_USB_ENDPOINT 1 FIXED_IN 8 /end DAQ_LIST_USB_ENDPOINT
  /begin DAQ_LIST_USB_ENDPOINT 2 FIXED_IN 8 /end DAQ_LIST_USB_ENDPOINT
  /*********** OVERRULE begins ***********/
  /begin PROTOCOL_LAYER /* XCP Version */ 0x100 1000 1000 0 0 0 0 0 /* MAX_CTO */ 60 /* MAX_DTO */ 60 BYTE_ORDER_MSB_LAST ADDRESS_GRANULARITY_BYTE OPTIONAL_CMD GET_ID OPTIONAL_CMD SET_MTA OPTIONAL_CMD UPLOAD OPTIONAL_CMD SHORT_UPLOAD OPTIONAL_CMD BUILD_CHECKSUM OPTIONAL_CMD DOWNLOAD_NEXT OPTIONAL_CMD COPY_CAL_PAGE OPTIONAL_CMD GET_DAQ_CLOCK COMMUNICATION_MODE_SUPPORTED /* optional modes supported */ BLOCK /* Block Mode for SLAVE */ SLAVE /* Block Mode for MASTER */ MASTER /* MAX_BS */ 4 /* MIN_ST unit is 100 us */ 0 /end PROTOCOL_LAYER
  /begin DAQ /* DAQ_CONFIG_TYPE */ STATIC /* MAX_DAQ */ 3 /* MAX_EVENT_CHANNEL */ 3 /* MIN_DAQ */ 0 OPTIMISATION_TYPE_DEFAULT ADDRESS_EXTENSION_FREE IDENTIFICATION_FIELD_TYPE_ABSOLUTE GRANULARITY_ODT_ENTRY_SIZE_DAQ_BYTE /* MAX_ODT_ENTRY_SIZE_DAQ */ 4 NO_OVERLOAD_INDICATION
   /begin TIMESTAMP_SUPPORTED /* TIMESTAMP_TICKS */ 5120 /* TIMESTAMP_SIZE */ SIZE_DWORD /* RESOLUTION */ UNIT_10NS /* TIMESTAMP_TYPE */ TIMESTAMP_FIXED /end TIMESTAMP_SUPPORTED
   /begin DAQ_LIST 0 DAQ_LIST_TYPE DAQ MAX_ODT 4 MAX_ODT_ENTRIES 30 FIRST_PID 0 EVENT_FIXED 0 /end DAQ_LIST
   /begin DAQ_LIST 1 DAQ_LIST_TYPE DAQ MAX_ODT 4 MAX_ODT_ENTRIES 30 FIRST_PID 4 EVENT_FIXED 1 /end DAQ_LIST
   /begin DAQ_LIST 2 DAQ_LIST_TYPE DAQ MAX_ODT 4 MAX_ODT_ENTRIES 30 FIRST_PID 8 EVENT_FIXED 2 /end DAQ_LIST
   /begin EVENT "segment synchronous" "seg-sync" 0 DAQ 1 0 0 7 /end EVENT
   /begin EVENT "10ms time synchronous" "10ms" 1 DAQ 1 10 6 6 /end EVENT
   /begin EVENT "100ms time synchronous" "100ms" 2 DAQ 1 100 6 5 /end EVENT
  /end DAQ
  /*********** OVERRULE ends ***********/ /end XCP_ON_USB
/end IF_DATA
/begin CHARACTERISTIC ACCI_aMax_C "" VALUE 0x8006D84A Val_Ws16 65.53500 Acc -32.76800 32.76700 FORMAT "%8.5" /end CHARACTERISTIC
/begin CHARACTERISTIC ACComp_facTrqCAN_C "Skalierungsfaktor für CAN-Größe" VALUE 0x8006D84C Val_Ws16 511.9922 Fact1 -256.0000 255.9922 FORMAT "%8.4" /end CHARACTERISTIC
/begin CHARACTERISTIC ACComp_stTrqCAN_CW "Codewort: Kompressor-Last über CAN" VALUE 0x8006D84E Val_Wu8 255.0 OneToOne 0.00 255.0 FORMAT "%5.1" /end CHARACTERISTIC
/begin CHARACTERISTIC ACComp_swtLd_CW "Codewort: Hartes / Weiches Zuschalten des Kompressors" VALUE 0x8006D84F Val_Wu8 255.0 OneToOne 0.00 255.0 FORMAT "%5.1" /end CHARACTERISTIC
/begin CHARACTERISTIC ACComp_tiTrqDyn_C "Filterzeitkonstante für Dynamisches Moment" VALUE 0x8006D850 Val_Wu32 4294.9672950 TimeDelay_s 0.000001000000000 4294.9672960 FORMAT "%12.7" /end CHARACTERISTIC
/begin CHARACTERISTIC ACComp_tiTrqResv_C "Dauer der Momenten-Reserve" VALUE 0x8006D854 Val_Ws32 4294967295.00 TimeDT -2147483648.00 2147483647.00 FORMAT "%13.2" /end CHARACTERISTIC
/begin CHARACTERISTIC ACComp_trqDyn_MAP "Dynamisches Moment" MAP 0x8006D85C Map_Xs16Ys16Ws16 6553.500 Trq -3276.800 3276.700 FORMAT "%8.3"
 /begin AXIS_DESCR STD_AXIS Epm_nEng EngN 4 -16384.00 16383.50 FORMAT "%8.2" DEPOSIT ABSOLUTE /end AXIS_DESCR
 /begin AXIS_DESCR STD_AXIS AirC_pClnt PresAC_hPa 4 -65536.00 65534.00 FORMAT "%8.2" DEPOSIT ABSOLUTE /end AXIS_DESCR
/end CHARACTERISTIC
/begin CHARACTERISTIC ACComp_trqOffsFlt_C "Offset für Startwert des Filters" VALUE 0x8006D858 Val_Ws16 6553.500 Trq -3276.800 3276.700 FORMAT "%8.3" /end CHARACTERISTIC
/begin CHARACTERISTIC ACComp_trqStat_MAP "Statisches Moment" MAP 0x8006D890 Map_Xs16Ys16Ws16 6553.500 Trq -3276.800 3276.700 FORMAT "%8.3"
 /begin AXIS_DESCR STD_AXIS Epm_nEng EngN 4 -16384.00 16383.50 FORMAT "%8.2" DEPOSIT ABSOLUTE /end AXIS_DESCR
 /begin AXIS_DESCR STD_AXIS AirC_pClnt PresAC_hPa 4 -65536.00 65534.00 FORMAT "%8.2" DEPOSIT ABSOLUTE /end AXIS_DESCR
/end CHARACTERISTIC
/begin CHARACTERISTIC AccPed_nErr_CUR "Kennlinie zur Veränderung der Leerlaufdrehzahl in Abhängigkeit des Getriebezustandes bei Plausibilitätsfehler" CURVE 0x8006D8C4 Kl_Xs16_Ws16 6000.000 EngN 0.00 6000.000 FORMAT "%8.3" EXTENDED_LIMITS -16384.00 16383.50
 /begin AXIS_DESCR STD_AXIS PT_numTraGear OneToOne 2 0.00 6.000 FORMAT "%5.3" EXTENDED_LIMITS 0.00 255.0 DEPOSIT ABSOLUTE /end AXIS_DESCR
/end CHARACTERISTIC
/begin CHARACTERISTIC AccPed_nMax_C "Maximaler Drehzahlwert bei Fahrpedalfehler" VALUE 0x8006D8CE Val_Ws16 32767.50 EngN -16384.00 16383.50 FORMAT "%8.2" /end CHARACTERISTIC
/begin CHARACTERISTIC AccPed_nMinBrkApp_C "Minimale Drehzahl bei Fahrpedal-Bremse Unplausibilität" VALUE 0x8006D8D0 Val_Ws16 32767.50 EngN -16384.00 16383.50 FORMAT "%8.2" /end CHARACTERISTIC
/begin CHARACTERISTIC AccPed_nMinBrk_C "Minimale Drehzahl bei Fahrpedalfehler und Bremse getreten" VALUE 0x8006D8D2 Val_Ws16 32767.50 EngN -16384.00 16383.50 FORMAT "%8.2" /end CHARACTERISTIC
/begin CHARACTERISTIC AccPed_nMinNoBrk_C "Minimale Drehzahl bei Fahrpedalfehler und Bremse nicht getreten" VALUE 0x8006D8DC Val_Ws16 32767.50 EngN -16384.00 16383.50 FORMAT "%8.2" /end CHARACTERISTIC
/begin CHARACTERISTIC AccPed_rOffset_C "Fahrpedal-Schwellwert für Wechsel auf Aufsetzpunkt ohne Schubabschaltung" VALUE 0x8006D8DE Val_Ws16 799.9878 Prc -400.0000 399.9878 FORMAT "%8.4" /end CHARACTERISTIC
/begin CHARACTERISTIC AccPed_rThresPrp_C "Endwert ""Overrun-Rampe""" VALUE 0x8006D8E0 Val_Ws16 799.9878 Prc -400.0000 399.9878 FORMAT "%8.4" /end CHARACTERISTIC
/begin CHARACTERISTIC AccPed_rZero_C "Anfangswert ""Overrun-Rampe""" VALUE 0x8006D8E2 Val_Ws16 799.9878 Prc -400.0000 399.9878 FORMAT "%8.4" /end CHARACTERISTIC
/begin CHARACTERISTIC AccPed_swtDrvBehav_C "Wert = 1 : Der Fahrerwunsch wird nur über ein Fahrverhaltenkennfeld (AccPed_trqEngLow_MAP) ermittelt." VALUE 0x8006D8E4 Kw_Wu8 1.000 OneToOne 0.00 1.000 FORMAT "%5.3" EXTENDED_LIMITS 0.00 255.0 /end CHARACTERISTIC
/begin CHARACTERISTIC AccPed_trqDemThres_C "Schwellwert Fahrerwunschmoment für Status Fahrerwunsch aktiv" VALUE 0x8006D8D4 Val_Ws32 429496729.500 TrqPrpHigh -214748364.800 214748364.700 FORMAT "%13.3" /end CHARACTERISTIC
/begin CHARACTERISTIC AccPed_trqEngHigh_MAP "Fahrverhaltenkennfeld für Maximalwert des Fahrerwunsches." MAP 0x8006D8E6 Kf_Xs16_Ys16_Ws16 6553.500 Trq -3276.800 3276.700 FORMAT "%8.3"
 /begin AXIS_DESCR STD_AXIS Epm_nEng EngN 14 -16384.00 16383.50 FORMAT "%8.2" DEPOSIT ABSOLUTE /end AXIS_DESCR
 /begin AXIS_DESCR STD_AXIS APP_r Prc 8 -400.0000 399.9878 FORMAT "%8.4" DEPOSIT ABSOLUTE /end AXIS_DESCR
/end CHARACTERISTIC
/begin CHARACTERISTIC AccPed_trqEngLow_MAP "Fahrverhaltenkennfeld für Minimalwert des Fahrerwunsches." MAP 0x8006D9F6 Kf_Xs16_Ys16_Ws16 6553.500 Trq -3276.800 3276.700 FORMAT "%8.3"
 /begin AXIS_DESCR STD_AXIS Epm_nEng EngN 14 -16384.00 16383.50 FORMAT "%8.2" DEPOSIT ABSOLUTE /end AXIS_DESCR
 /begin AXIS_DESCR STD_AXIS APP_r Prc 8 -400.0000 399.9878 FORMAT "%8.4" DEPOSIT ABSOLUTE /end AXIS_DESCR
/end CHARACTERISTIC
/begin CHARACTERISTIC AccPed_trqEngRev_MAP "Fahrverhaltenkennfeld Rückwärtsgang eingelegt" MAP 0x8006DB06 Kf_Xs16_Ys16_Ws16 6553.500 Trq -3276.800 3276.700 FORMAT "%8.3"
 /begin AXIS_DESCR STD_AXIS Epm_nEng EngN 16 -16384.00 16383.50 FORMAT "%8.2" DEPOSIT ABSOLUTE /end AXIS_DESCR
 /begin AXIS_DESCR STD_AXIS APP_r Prc 10 -400.0000 399.9878 FORMAT "%8.4" DEPOSIT ABSOLUTE /end AXIS_DESCR
/end CHARACTERISTIC
/begin CHARACTERISTIC AccPed_trqLimMax_C "Maximales Radmoment bei Fahrpedalfehler" VALUE 0x8006D8D8 Val_Ws32 429496729.500 TrqPrpHigh -214748364.800 214748364.700 FORMAT "%13.3" /end CHARACTERISTIC
/begin CHARACTERISTIC AccPed_trqPrp_MAP "Fahrverhaltenkennfeld Mastershift-Betrieb" MAP 0x8006DC7E Kf_Xs16_Ys16_Ws16 104856.0 TrqPrp -52428.80 52427.20 FORMAT "%8.2"
 /begin AXIS_DESCR STD_AXIS GlbDa_vX Vel 2 -327.6800 327.6700 FORMAT "%8.4" DEPOSIT ABSOLUTE /end AXIS_DESCR
 /begin AXIS_DESCR STD_AXIS APP_r Prc 2 -400.0000 399.9878 FORMAT "%8.4" DEPOSIT ABSOLUTE /end AXIS_DESCR
/end CHARACTERISTIC
/begin CHARACTERISTIC AccPed_vVehVmax_C "Maximalwert der Fahrzeuggeschwindigkeit für lineare Interpolation des Fahrerwunschmomentes." VALUE 0x8006DC92 Kw_Ws16 300.0000 Vel 0.00 300.0000 FORMAT "%8.4" EXTENDED_LIMITS -327.6800 327.6700 /end CHARACTERISTIC
/begin CHARACTERISTIC AccPed_vVehVmin_C "Minimalwert der Fahrzeuggeschwindigkeit für lineare Interpolation des Fahrerwunschmomentes." VALUE 0x8006DC94 Kw_Ws16 300.0000 Vel 0.00 300.0000 FORMAT "%8.4" EXTENDED_LIMITS -327.6800 327.6700 /end CHARACTERISTIC
/begin CHARACTERISTIC ACCtl_dtrqFullLoadLimDn_C "neg. Steigung für Umschaltung Volllastbegrenzung" VALUE 0x800469BC Val_Wu32 6553599.99847 RmpTrq 0.00 6553599.99847 FORMAT "%13.5" /end CHARACTERISTIC
/begin CHARACTERISTIC ACCtl_dtrqFullLoadLimUp_C "pos. Steigung für Umschaltung Volllastbegrenzung" VALUE 0x800469C0 Val_Wu32 6553599.99847 RmpTrq 0.00 6553599.99847 FORMAT "%13.5" /end CHARACTERISTIC
/begin CHARACTERISTIC ACCtl_nACThres_C "Schwellwert Drehzahl" VALUE 0x800469C4 Val_Ws16 65535.00 EngN -32768.00 32767.00 FORMAT "%8.2" EXTENDED_LIMITS -16384.00 16383.50 /end CHARACTERISTIC
/begin CHARACTERISTIC ACCtl_nFullLoadLimHi_C "Obere Drehzahlschwelle für Volllastbegrenzung" VALUE 0x800469C6 Val_Ws16 65535.00 EngN -32768.00 32767.00 FORMAT "%8.2" EXTENDED_LIMITS -16384.00 16383.50 /end CHARACTERISTIC
/begin CHARACTERISTIC ACCtl_nFullLoadLimLo_C "Untere Drehzahlschwelle für Volllastbegrenzung" VALUE 0x800469C8 Val_Ws16 65535.00 EngN -32768.00 32767.00 FORMAT "%8.2" EXTENDED_LIMITS -16384.00 16383.50 /end CHARACTERISTIC
/begin CHARACTERISTIC ACCtl_nMin_C "" VALUE 0x800469CA Val_Ws16 32767.50 EngN -16384.00 16383.50 FORMAT "%8.2" /end CHARACTERISTIC
/begin CHARACTERISTIC ACCtl_stResv_CW "" VALUE 0x800469CC Val_Wu8 255.0 OneToOne 0.00 255.0 FORMAT "%5.1" /end CHARACTERISTIC
/begin CHARACTERISTIC ACCtl_tiDebIdlSpd_C "" VALUE 0x800469D0 Val_Ws32 4294967295.00 TimeDT -2147483648.00 2147483647.00 FORMAT "%13.2" /end CHARACTERISTIC
/begin CHARACTERISTIC ACCtl_tiDebNEngOff_C "Heilzeit bei zu kleiner Motordrehzahl" VALUE 0x800469D4 Val_Wu16 5000.000 TimeDeb 0.00 5000.000 FORMAT "%8.3" EXTENDED_LIMITS 0.00 655350.0 /end CHARACTERISTIC
/begin CHARACTERISTIC ACCtl_tiDebNEngOn_C "Entprellzeit bei zu kleiner Motordrehzahl" VALUE 0x800469D6 Val_Wu16 8000.000 TimeDeb 0.00 8000.000 FORMAT "%8.3" EXTENDED_LIMITS 0.00 655350.0 /end CHARACTERISTIC
/begin CHARACTERISTIC ACCtl_tiDebStrtOff_C "Verzögerungszeit Starterkennung" VALUE 0x800469D8 Val_Wu16 5000.000 TimeDeb 0.00 5000.000 FORMAT "%8.3" EXTENDED_LIMITS 0.00 655350.0 /end CHARACTERISTIC
/begin CHARACTERISTIC ACCtl_tiDebStrtOn_C "Verzögerungszeit nach Startabwurf" VALUE 0x800469DA Val_Wu16 8000.000 TimeDeb 0.00 8000.000 FORMAT "%8.3" EXTENDED_LIMITS 0.00 655350.0 /end CHARACTERISTIC
/begin CHARACTERISTIC ACCtl_tiMnSwtDel_C "Entprellzeit des Klimahauptschalters" VALUE 0x800469DC Val_Ws32 4294967295.00 TimeDT -2147483648.00 2147483647.00 FORMAT "%13.2" /end CHARACTERISTIC
/begin CHARACTERISTIC ACCtl_tiOnLock_C "Ausschaltsperrzeit nach Überschreitrn des Drehmomentschwellwerts" VALUE 0x800469E0 Val_Wu16 655350.0 Time_ms 0.00 655350.0 FORMAT "%8.1" /end CHARACTERISTIC
/begin CHARACTERISTIC ACCtl_tiTrqResv_C "" VALUE 0x800469E4 Val_Ws32 2168958483.00 TimeDT -21474836.0000 2147483647.00 FORMAT "%13.2" EXTENDED_LIMITS -2147483648.00 2147483647.00 /end CHARACTERISTIC
/begin CHARACTERISTIC ACCtl_trqACMax_C "Maximalwert des Moments" VALUE 0x800469E8 Val_Ws16 6553.500 Trq -3276.800 3276.700 FORMAT "%8.3" /end CHARACTERISTIC
/begin CHARACTERISTIC ACCtl_trqACOff_C "" VALUE 0x800469EA Val_Ws16 6553.500 Trq -3276.800 3276.700 FORMAT "%8.3" /end CHARACTERISTIC
/begin CHARACTERISTIC ACCtl_trqACTrqErr_C "Grenzmoment bei Ausfall CAN-Signal Drehmomentanf. Klima" VALUE 0x800469EC Val_Ws16 6553.500 Trq -3276.800 3276.700 FORMAT "%8.3" /end CHARACTERISTIC
/begin CHARACTERISTIC ACCtl_trqFanErr_C "Grenzmoment bei defektem E-Lüfter" VALUE 0x800469EE Val_Ws16 6553.500 Trq -3276.800 3276.700 FORMAT "%8.3" /end CHARACTERISTIC
/begin CHARACTERISTIC ACCtl_trqFastLim_C "" VALUE 0x800469F0 Val_Ws16 6553.500 Trq -3276.800 3276.700 FORMAT "%8.3" /end CHARACTERISTIC
/begin CHARACTERISTIC ACCtl_trqFullLoadOfs_CUR "Abstand zur Volllast bei Anfahrbegrenzung" CURVE 0x800469F2 Cur_Xs16Ws16 35.00000 Trq -30.00000 5.000000 FORMAT "%8.5" EXTENDED_LIMITS -3276.800 3276.700
 /begin AXIS_DESCR STD_AXIS Epm_nEng EngN 3 0.00 4500.000 FORMAT "%8.3" EXTENDED_LIMITS -16384.00 16383.50 DEPOSIT ABSOLUTE /end AXIS_DESCR
/end CHARACTERISTIC
/begin CHARACTERISTIC ACCtl_trqRedAC_C "" VALUE 0x80046A00 Val_Ws16 6553.500 Trq -3276.800 3276.700 FORMAT "%8.3" /end CHARACTERISTIC
/begin CHARACTERISTIC ACCtl_trqShutOff_C "" VALUE 0x80046A02 Val_Ws16 6553.500 Trq -3276.800 3276.700 FORMAT "%8.3" /end CHARACTERISTIC
/begin CHARACTERISTIC ACCtl_trqTEngErr_C "Grenzmoment bei defektem Kühlmitteltemperatur-Sensor" VALUE 0x80046A04 Val_Ws16 6553.500 Trq -3276.800 3276.700 FORMAT "%8.3" /end CHARACTERISTIC
/begin CHARACTERISTIC ACCtl_trqTEngLim_MAP "Grenzmoment Klima über Motortemperatur" MAP 0x80046A06 Map_Xs16Ys16Ws16 40.00000 Trq 0.00 40.00000 FORMAT "%8.5" EXTENDED_LIMITS -3276.800 3276.700
 /begin AXIS_DESCR STD_AXIS EngDa_tEng Temp_Cels 5 -50.14000 199.8600 FORMAT "%8.4" EXTENDED_LIMITS -3549.940 3003.560 DEPOSIT ABSOLUTE /end AXIS_DESCR
 /begin AXIS_DESCR STD_AXIS GlbDa_vX Vel 3 0.00 250.0000 FORMAT "%8.4" EXTENDED_LIMITS -327.6800 327.6700 DEPOSIT ABSOLUTE /end AXIS_DESCR
/end CHARACTERISTIC
/begin CHARACTERISTIC ACCtl_trqTGearbxErr_C "Grenzmoment bei Ausfall CAN-Signal Getriebeöltemperatur" VALUE 0x80046A38 Val_Ws16 6553.500 Trq -3276.800 3276.700 FORMAT "%8.3" /end CHARACTERISTIC
/begin CHARACTERISTIC ACCtl_trqTGearbxLim_MAP "Grenzmoment Klima über Getriebetemperatur" MAP 0x80046A3A Map_Xs16Ys16Ws16 40.00000 Trq 0.00 40.00000 FORMAT "%8.5" EXTENDED_LIMITS -3276.800 3276.700
 /begin AXIS_DESCR STD_AXIS Tra_tOil Temp_Cels 5 -0.04000000 249.9600 FORMAT "%8.4" EXTENDED_LIMITS -3549.940 3003.560 DEPOSIT ABSOLUTE /end AXIS_DESCR
 /begin AXIS_DESCR STD_AXIS GlbDa_vX Vel 3 0.00 250.0000 FORMAT "%8.4" EXTENDED_LIMITS -327.6800 327.6700 DEPOSIT ABSOLUTE /end AXIS_DESCR
/end CHARACTERISTIC
/begin CHARACTERISTIC ACCtl_trqThres_C "Schwellwert Drehmoment" VALUE 0x80046A6C Val_Ws16 6553.500 Trq -3276.800 3276.700 FORMAT "%8.3" /end CHARACTERISTIC
/begin CHARACTERISTIC ACCtl_trqVehVErr_C "Grenzmoment bei defektem Geschwindigkeitsgeber" VALUE 0x80046A6E Val_Ws16 6553.500 Trq -3276.800 3276.700 FORMAT "%8.3" /end CHARACTERISTIC
/begin CHARACTERISTIC ACCtl_vThres_C "Schwellwert Geschwindigkeit" VALUE 0x80046A70 Val_Ws16 300.0000 Vel 0.00 300.0000 FORMAT "%8.4" EXTENDED_LIMITS -327.6800 327.6700 /end CHARACTERISTIC
/begin CHARACTERISTIC AC_dmClgACOff_CUR "Kühlanforderung bei AC aus" CURVE 0x8006D7FC Kl_Xs16_Ws16 799.9878 Prc -400.0000 399.9878 FORMAT "%8.4"
 /begin AXIS_DESCR STD_AXIS AirC_pClntHld Pres_hPa 4 -32768.00 3500.00 FORMAT "%8.2" EXTENDED_LIMITS -32768.00 32767.00 DEPOSIT ABSOLUTE /end AXIS_DESCR
/end CHARACTERISTIC
/begin CHARACTERISTIC AC_dmClgACOn_MAP "Kühlanforderung bei AC aus" MAP 0x8006D80E Kf_Xs16_Ys16_Ws16 799.9878 Prc -400.0000 399.9878 FORMAT "%8.4"
 /begin AXIS_DESCR STD_AXIS AirC_pClntHld Pres_hPa 4 -32768.00 3500.00 FORMAT "%8.2" EXTENDED_LIMITS -32768.00 32767.00 DEPOSIT ABSOLUTE /end AXIS_DESCR
 /begin AXIS_DESCR STD_AXIS GlbDa_tEnv Temp_Cels 4 -3549.940 3003.560 FORMAT "%8.3" DEPOSIT ABSOLUTE /end AXIS_DESCR
/end CHARACTERISTIC
/begin CHARACTERISTIC AC_rAdjValDef_C "" VALUE 0x8006DC96 Val_Ws16 0.00 Fact 1.000000 1.000000 FORMAT "%8.6" EXTENDED_LIMITS -4.000000 3.999878 /end CHARACTERISTIC
/begin CHARACTERISTIC AC_rAdjValMax_C "" VALUE 0x8006DC98 Val_Ws16 3.199951 Fact 0.00 3.199951 FORMAT "%8.6" EXTENDED_LIMITS -4.000000 3.999878 /end CHARACTERISTIC
/begin CHARACTERISTIC AC_rAdjValMin_C "" VALUE 0x8006DC9A Val_Ws16 3.199951 Fact 0.00 3.199951 FORMAT "%8.6" EXTENDED_LIMITS -4.000000 3.999878 /end CHARACTERISTIC
/begin CHARACTERISTIC AC_stClgDemCAN_CW "Umschalten zwischen CAN-Größe und Modell-Wert" VALUE 0x8006D842 Kw_Wu8 255.0 OneToOne 0.00 255.0 FORMAT "%5.1" /end CHARACTERISTIC
/begin CHARACTERISTIC AirC_dcycClntPresPwmInMax_C "" VALUE 0x800468FE Val_Wu16 655.3500 DtyCyc 0.00 655.3500 FORMAT "%8.4" /end CHARACTERISTIC
/begin CHARACTERISTIC AirC_dcycClntPresPwmInMin_C "" VALUE 0x80046900 Val_Wu16 655.3500 DtyCyc 0.00 655.3500 FORMAT "%8.4" /end CHARACTERISTIC
/begin CHARACTERISTIC AirC_DigOutCmpr.tiBtwTstSCB_C "/" VALUE 0x800469A4 Kw_Ws16 1000.000 Time_ms 0.00 1000.000 FORMAT "%8.3" EXTENDED_LIMITS -327680.0 327670.0 /end CHARACTERISTIC
/begin CHARACTERISTIC AirC_DigOutCmpr.tiBtwTstOT_C "/" VALUE 0x800469A6 Kw_Ws16 1000.000 Time_s 0.00 1000.000 FORMAT "%8.3" EXTENDED_LIMITS -327.6800 327.6700 /end CHARACTERISTIC
/begin CHARACTERISTIC AirC_DigOutCmpr.numTstMax_C "/" VALUE 0x800469A8 Kw_Wu16 65535.00 OneToOne 0.00 65535.00 FORMAT "%8.2" /end CHARACTERISTIC
/begin CHARACTERISTIC AirC_DigOutRedTrq.tiBtwTstSCB_C "/" VALUE 0x800469AA Kw_Ws16 1000.000 Time_ms 0.00 1000.000 FORMAT "%8.3" EXTENDED_LIMITS -327680.0 327670.0 /end CHARACTERISTIC
/begin CHARACTERISTIC AirC_DigOutRedTrq.tiBtwTstOT_C "/" VALUE 0x800469AC Kw_Ws16 1000.000 Time_s 0.00 1000.000 FORMAT "%8.3" EXTENDED_LIMITS -327.6800 327.6700 /end CHARACTERISTIC
/begin CHARACTERISTIC AirC_DigOutRedTrq.numTstMax_C "/" VALUE 0x800469AE Kw_Wu16 65535.00 OneToOne 0.00 65535.00 FORMAT "%8.2" /end CHARACTERISTIC
/begin CHARACTERISTIC AirC_HtrSwtDeb.tiHiLo_C "/" VALUE 0x80046A74 Kw_Ws16 5000.000 TimeDeb 0.00 5000.000 FORMAT "%8.3" EXTENDED_LIMITS -327680.0 327670.0 /end CHARACTERISTIC
/begin CHARACTERISTIC AirC_HtrSwtDeb.tiLoHi_C "/" VALUE 0x80046A76 Kw_Ws16 5000.000 TimeDeb 0.00 5000.000 FORMAT "%8.3" EXTENDED_LIMITS -327680.0 327670.0 /end CHARACTERISTIC
/begin CHARACTERISTIC AirC_nEngLoLim_C "" VALUE 0x80046902 Val_Ws16 32767.50 EngN -16384.00 16383.50 FORMAT "%8.2" /end CHARACTERISTIC
/begin CHARACTERISTIC AirC_pClntHi_C "Obere Hystereseschwelle für Klimakompressordruck" VALUE 0x8006D844 Kw_Ws16 36268.00 Pres_hPa -32768.00 3500.00 FORMAT "%8.2" EXTENDED_LIMITS -32768.00 32767.00 /end CHARACTERISTIC
/begin CHARACTERISTIC AirC_pClntLo_C "Untere Hystereseschwelle für Klimakompressordruck" VALUE 0x8006D846 Kw_Ws16 36268.00 Pres_hPa -32768.00 3500.00 FORMAT "%8.2" EXTENDED_LIMITS -32768.00 32767.00 /end CHARACTERISTIC
/begin CHARACTERISTIC AirC_pClntTransfAna_CUR "" CURVE 0x80046904 Cur_Xs16Ws16 35000.00 PresAC_hPa 0.00 35000.00 FORMAT "%8.2" EXTENDED_LIMITS -65536.00 65534.00
 /begin AXIS_DESCR STD_AXIS AirC_uAnaRawClnt Volt 16 0.00 5200.000 FORMAT "%8.3" EXTENDED_LIMITS -6553.600 6553.400 DEPOSIT ABSOLUTE /end AXIS_DESCR
/end CHARACTERISTIC
/begin CHARACTERISTIC AirC_pClntTransfPwm_CUR "" CURVE 0x80046946 Cur_Xs16Ws16 100.0000 PresAC_hPa 0.00 100.0000 FORMAT "%8.4" EXTENDED_LIMITS -65536.00 65534.00
 /begin AXIS_DESCR STD_AXIS AirC_rPwmRawClnt DtyCyc 16 0.00 100.0000 FORMAT "%8.4" EXTENDED_LIMITS -327.6800 327.6700 DEPOSIT ABSOLUTE /end AXIS_DESCR
/end CHARACTERISTIC
/begin CHARACTERISTIC AirC_pClnt_C "Ersatzwert für Klimakompressordruck" VALUE 0x8006D848 Kw_Ws16 36268.00 Pres_hPa -32768.00 3500.00 FORMAT "%8.2" EXTENDED_LIMITS -32768.00 32767.00 /end CHARACTERISTIC
/begin CHARACTERISTIC AirC_pDfl_C "" VALUE 0x80046994 Kw_Ws16 131070.0 PresAC_hPa -65536.00 65534.00 FORMAT "%8.2" /end CHARACTERISTIC
/begin CHARACTERISTIC AirC_RmpSlpClntP.Pos_C "/" VALUE 0x80046998 Kw_Ws32 65535999.9695 RmpPresAC_hPa 0.00 65535999.9695 FORMAT "%13.4" EXTENDED_LIMITS -65536000.0000 65535999.9695 /end CHARACTERISTIC
/begin CHARACTERISTIC AirC_RmpSlpClntP.Neg_C "/" VALUE 0x8004699C Kw_Ws32 65535999.9695 RmpPresAC_hPa 0.00 65535999.9695 FORMAT "%13.4" EXTENDED_LIMITS -65536000.0000 65535999.9695 /end CHARACTERISTIC
/begin CHARACTERISTIC AirC_stCmprPsDiaDisbl_C "" VALUE 0x800469B0 Val_Wu8 255.0 OneToOne 0.00 255.0 FORMAT "%5.1" /end CHARACTERISTIC
/begin CHARACTERISTIC AirC_stCmprPsDisbl_C "" VALUE 0x800469B1 Val_Wu8 255.0 OneToOne 0.00 255.0 FORMAT "%5.1" /end CHARACTERISTIC
/begin CHARACTERISTIC AirC_stCmprTyp_CW "" VALUE 0x800469B2 Val_Wu8 255.0 OneToOne 0.00 255.0 FORMAT "%5.1" /end CHARACTERISTIC
/begin CHARACTERISTIC AirC_stRedTrqPsDiaDisbl_C "" VALUE 0x800469B3 Val_Wu8 255.0 OneToOne 0.00 255.0 FORMAT "%5.1" /end CHARACTERISTIC
/begin CHARACTERISTIC AirC_stRedTrqPsDisbl_C "" VALUE 0x800469B4 Val_Wu8 255.0 OneToOne 0.00 255.0 FORMAT "%5.1" /end CHARACTERISTIC
/begin CHARACTERISTIC AirC_stSwtDfl_C "" VALUE 0x80046A7E Val_Wu8 255.0 OneToOne 0.00 255.0 FORMAT "%5.1" /end CHARACTERISTIC
/begin CHARACTERISTIC AirC_swtClntPresSel_C "" VALUE 0x80046988 Val_Wu8 255.0 OneToOne 0.00 255.0 FORMAT "%5.1" /end CHARACTERISTIC
/begin CHARACTERISTIC AirC_SwtDeb.tiHiLo_C "/" VALUE 0x80046A78 Val_Ws16 655350.0 TimeDeb -327680.0 327670.0 FORMAT "%8.1" /end CHARACTERISTIC
/begin CHARACTERISTIC AirC_SwtDeb.tiLoHi_C "/" VALUE 0x80046A7A Val_Ws16 655350.0 TimeDeb -327680.0 327670.0 FORMAT "%8.1" /end CHARACTERISTIC
/begin CHARACTERISTIC AirC_swtMnSwtSig_C "" VALUE 0x80046A7C Val_Wu8 255.0 OneToOne 0.00 255.0 FORMAT "%5.1" /end CHARACTERISTIC
/begin CHARACTERISTIC AirC_tAirLoLim_C "" VALUE 0x8004698A Val_Ws16 6553.500 Temp_Cels -3549.940 3003.560 FORMAT "%8.3" /end CHARACTERISTIC
/begin CHARACTERISTIC AirC_tiPerClntPresPwmInMax_C "" VALUE 0x8004698C Val_Wu16 5000.000 Time_PwmHigh 0.00 5000.000 FORMAT "%8.3" EXTENDED_LIMITS 0.00 3276.750 /end CHARACTERISTIC
/begin CHARACTERISTIC AirC_tiPerClntPresPwmInMin_C "" VALUE 0x8004698E Val_Wu16 5000.000 Time_PwmHigh 0.00 5000.000 FORMAT "%8.3" EXTENDED_LIMITS 0.00 3276.750 /end CHARACTERISTIC
/begin CHARACTERISTIC AirC_TransStageClntPar.Dfl_C "/" VALUE 0x800469A0 Kw_Ws16 131070.0 PresAC_hPa -65536.00 65534.00 FORMAT "%8.2" /end CHARACTERISTIC
/begin CHARACTERISTIC AirC_TransStageClntPar.stSensId_C "/" VALUE 0x800469A2 Kw_Wu8 255.0 OneToOne 0.00 255.0 FORMAT "%5.1" /end CHARACTERISTIC
/begin CHARACTERISTIC AirC_trqCmprMax_C "" VALUE 0x800469B6 Val_Ws16 1500.000 Trq -500.0000 1000.000 FORMAT "%8.3" EXTENDED_LIMITS -3276.800 3276.700 /end CHARACTERISTIC
/begin CHARACTERISTIC AirC_trqCmprMin_C "" VALUE 0x800469B8 Val_Ws16 1500.000 Trq -500.0000 1000.000 FORMAT "%8.3" EXTENDED_LIMITS -3276.800 3276.700 /end CHARACTERISTIC
/begin CHARACTERISTIC AirC_uSRCMaxClntPres_C "" VALUE 0x80046990 Val_Ws16 5200.000 Volt 0.00 5200.000 FORMAT "%8.3" EXTENDED_LIMITS -6553.600 6553.400 /end CHARACTERISTIC
/begin CHARACTERISTIC AirC_uSRCMinClntPres_C "" VALUE 0x80046992 Val_Ws16 5200.000 Volt 0.00 5200.000 FORMAT "%8.3" EXTENDED_LIMITS -6553.600 6553.400 /end CHARACTERISTIC
/begin CHARACTERISTIC Alt_rAdjValDef_C "" VALUE 0x8006DC9C Val_Ws16 0.00 Fact 1.000000 1.000000 FORMAT "%8.6" EXTENDED_LIMITS -4.000000 3.999878 /end CHARACTERISTIC
/begin CHARACTERISTIC Alt_rAdjValMax_C "" VALUE 0x8006DC9E Val_Ws16 3.199951 Fact 0.00 3.199951 FORMAT "%8.6" EXTENDED_LIMITS -4.000000 3.999878 /end CHARACTERISTIC
/begin CHARACTERISTIC Alt_rAdjValMin_C "" VALUE 0x8006DCA0 Val_Ws16 3.199951 Fact 0.00 3.199951 FORMAT "%8.6" EXTENDED_LIMITS -4.000000 3.999878 /end CHARACTERISTIC
/begin CHARACTERISTIC SrvPmp_rAdjValDef_C "" VALUE 0x8006DCA2 Val_Ws16 0.00 Fact 1.000000 1.000000 FORMAT "%8.6" EXTENDED_LIMITS -4.000000 3.999878 /end CHARACTERISTIC
/begin CHARACTERISTIC SrvPmp_rAdjValMax_C "" VALUE 0x8006DCA4 Val_Ws16 3.199951 Fact 0.00 3.199951 FORMAT "%8.6" EXTENDED_LIMITS -4.000000 3.999878 /end CHARACTERISTIC
/begin CHARACTERISTIC SrvPmp_rAdjValMin_C "" VALUE 0x8006DCA6 Val_Ws16 3.199951 Fact 0.00 3.199951 FORMAT "%8.6" EXTENDED_LIMITS -4.000000 3.999878 /end CHARACTERISTIC
/begin MEASUREMENT ACCI_aReq "" SWORD Acc 1 100 -32.76800 32.76700 FORMAT "%8.5" ECU_ADDRESS 0xD0006972 /end MEASUREMENT
/begin MEASUREMENT ACCI_stInActv "" UBYTE OneToOne 1 100 0.00 255.0 FORMAT "%5.1" ECU_ADDRESS 0xD0008EF1 /end MEASUREMENT
/begin MEASUREMENT ACCI_stReq "" UBYTE OneToOne 1 100 0.00 255.0 FORMAT "%5.1" ECU_ADDRESS 0xD0008EF2 /end MEASUREMENT
/begin MEASUREMENT ACComp_trqDesFltAbv_mp "Gefiltertes Wunsch-Moment" SWORD Trq 1 100 -3276.800 3276.700 FORMAT "%8.3" ECU_ADDRESS 0xC0000004 /end MEASUREMENT
/begin MEASUREMENT ACComp_trqDesFlt_mp "Gefiltertes Wunsch-Moment" SWORD Trq 1 100 -3276.800 3276.700 FORMAT "%8.3" ECU_ADDRESS 0xC0000006 /end MEASUREMENT
/begin MEASUREMENT ACComp_trqDyn_mp "Dynamisches Moment" SWORD Trq 1 100 -3276.800 3276.700 FORMAT "%8.3" ECU_ADDRESS 0xC0000008 /end MEASUREMENT
/begin MEASUREMENT ACComp_trqStat_mp "Statisches Moment" SWORD Trq 1 100 -3276.800 3276.700 FORMAT "%8.3" ECU_ADDRESS 0xC000000A /end MEASUREMENT
/begin MEASUREMENT AccPed_facCompAcs "Faktor ""Overrun-Rampe""" SWORD Fact 1 100 -4.000000 3.999878 FORMAT "%8.6" ECU_ADDRESS 0xD0006B28 /end MEASUREMENT
/begin MEASUREMENT AccPed_nMax "Maximale Drehzahl bei Fahrpedalfehler" SWORD EngN 1 100 -16384.00 16383.50 FORMAT "%8.2" ECU_ADDRESS 0xD0006B2A /end MEASUREMENT
/begin MEASUREMENT AccPed_nMin "Minimale Drehzahl bei Fahrpedalfehler" SWORD EngN 1 100 -16384.00 16383.50 FORMAT "%8.2" ECU_ADDRESS 0xD0006B2C /end MEASUREMENT
/begin MEASUREMENT AccPed_rTrq "Gesamttriebstrangübersetzung Motor - Rad" SWORD TransR 1 100 -327.6800 327.6700 FORMAT "%8.4" ECU_ADDRESS 0xD0006B2E /end MEASUREMENT
/begin MEASUREMENT AccPed_stMS "Fahrerwunschstatus Mastershift aktiv" UBYTE OneToOne 1 100 0.00 255.0 FORMAT "%5.1" ECU_ADDRESS 0xD0008F00 /end MEASUREMENT
/begin MEASUREMENT AccPed_stNSetP "Status der Drehzahlanforderung der Fahrerwunschinterpretation" UBYTE OneToOne 1 100 0.00 255.0 FORMAT "%5.1" ECU_ADDRESS 0xD0008F01 /end MEASUREMENT
/begin MEASUREMENT AccPed_trqDes "Fahrerwunschmoment Sollpfad" SLONG TrqPrpHigh 1 100 -214748364.800 214748364.700 FORMAT "%13.3" ECU_ADDRESS 0xD00042C0 /end MEASUREMENT
/begin MEASUREMENT AccPed_trqDesEngLinInt_mp "In Abhängigkeit der Fahrzeuggeschwindigkeit Interpolierter Wert des Fahrerwunsches." SWORD Trq 1 100 -3276.800 3276.700 FORMAT "%8.3" ECU_ADDRESS 0xC0000010 /end MEASUREMENT
/begin MEASUREMENT AccPed_trqDesOvrRun_mp "Fahrerwunschmoment Schubanteil Sollpfad" SLONG TrqPrpHigh 1 100 -214748364.800 214748364.700 FORMAT "%13.3" ECU_ADDRESS 0xC000000C /end MEASUREMENT
/begin MEASUREMENT AccPed_trqDesPull "Fahrerwunschmoment Zuganteil Sollpfad" SLONG TrqPrpHigh 1 100 -214748364.800 214748364.700 FORMAT "%13.3" ECU_ADDRESS 0xD00042C4 /end MEASUREMENT
/begin MEASUREMENT AccPed_trqEngHighDes_mp "Maximalwert des Fahrerwunsches" SWORD Trq 1 100 -3276.800 3276.700 FORMAT "%8.3" ECU_ADDRESS 0xC0000012 /end MEASUREMENT
/begin MEASUREMENT AccPed_trqEngHighLead_mp "Maximalwert des Fahrerwunsches (Lead-Pfad)" SWORD Trq 1 100 -3276.800 3276.700 FORMAT "%8.3" ECU_ADDRESS 0xC0000020 /end MEASUREMENT
/begin MEASUREMENT AccPed_trqEngLowDes_mp "Minalwert des Fahrerwunsches" SWORD Trq 1 100 -3276.800 3276.700 FORMAT "%8.3" ECU_ADDRESS 0xC0000014 /end MEASUREMENT
/begin MEASUREMENT AccPed_trqEngLowLead_mp "Minimalwert des Fahrerwunsches (Lead-Pfad)" SWORD Trq 1 100 -3276.800 3276.700 FORMAT "%8.3" ECU_ADDRESS 0xC0000022 /end MEASUREMENT
/begin MEASUREMENT AccPed_trqLead "Fahrerwunschmoment Vorhaltpfad" SLONG TrqPrpHigh 1 100 -214748364.800 214748364.700 FORMAT "%13.3" ECU_ADDRESS 0xD00042C8 /end MEASUREMENT
/begin MEASUREMENT AccPed_trqLeadEngLinInt_mp "In Abhängigkeit der Fahrzeuggeschwindigkeit Interpolierter Wert des Fahrerwunsches (Lead-Pfad)." SWORD Trq 1 100 -3276.800 3276.700 FORMAT "%8.3" ECU_ADDRESS 0xC0000024 /end MEASUREMENT
/begin MEASUREMENT AccPed_trqLeadOvrRun_mp "Fahrerwunschmoment Schubanteil Vorhaltpfad" SLONG TrqPrpHigh 1 100 -214748364.800 214748364.700 FORMAT "%13.3" ECU_ADDRESS 0xC0000018 /end MEASUREMENT
/begin MEASUREMENT AccPed_trqLeadPull_mp "Fahrerwunschmoment Zuganteil Vorhaltpfad" SLONG TrqPrpHigh 1 100 -214748364.800 214748364.700 FORMAT "%13.3" ECU_ADDRESS 0xC000001C /end MEASUREMENT
/begin MEASUREMENT AccPed_trqLimMax "Maximales Radmoment bei Fahrpedalfehler" SLONG TrqPrpHigh 1 100 -214748364.800 214748364.700 FORMAT "%13.3" ECU_ADDRESS 0xD00042CC /end MEASUREMENT
/begin MEASUREMENT ACCtl_stMnSwtTmr_mp "" SWORD OneToOne 1 100 -32768.00 32767.00 FORMAT "%8.2" ECU_ADDRESS 0xC0000026 /end MEASUREMENT
/begin MEASUREMENT ACCtl_stOut "" UBYTE OneToOne 1 100 0.00 255.0 FORMAT "%5.1" ECU_ADDRESS 0xD0008EF3 /end MEASUREMENT
/begin MEASUREMENT ACCtl_stTrqResv "" UBYTE OneToOne 1 100 0.00 255.0 FORMAT "%5.1" ECU_ADDRESS 0xD0008EF4 /end MEASUREMENT
/begin MEASUREMENT ACCtl_trqACFastOffLim_mp "Begrenzung Klimakompressor bei Anfahren wg. Volllast" SWORD Trq 1 100 -3276.800 3276.700 FORMAT "%8.3" ECU_ADDRESS 0xC0000028 /end MEASUREMENT
/begin MEASUREMENT ACCtl_trqACFastOffMax_mp "Maximaler Arbeitsbereich des Klimakompressors bei Volllast" SWORD Trq 1 100 -3276.800 3276.700 FORMAT "%8.3" ECU_ADDRESS 0xC000002A /end MEASUREMENT
/begin MEASUREMENT ACCtl_trqACTrqErr_mp "" SWORD Trq 1 100 -3276.800 3276.700 FORMAT "%8.3" ECU_ADDRESS 0xC000002C /end MEASUREMENT
/begin MEASUREMENT ACCtl_trqFanErr_mp "" SWORD Trq 1 100 -3276.800 3276.700 FORMAT "%8.3" ECU_ADDRESS 0xC000002E /end MEASUREMENT
/begin MEASUREMENT ACCtl_trqMaxAC "Maximal erlaubtes Kompressormoment" SWORD Trq 1 100 -3276.800 3276.700 FORMAT "%8.3" ECU_ADDRESS 0xD0006974 /end MEASUREMENT
/begin MEASUREMENT ACCtl_trqMaxAC_mp "" SWORD Trq 1 100 -3276.800 3276.700 FORMAT "%8.3" ECU_ADDRESS 0xC0000030 /end MEASUREMENT
/begin MEASUREMENT ACCtl_trqStrtLim_mp "" SWORD Trq 1 100 -3276.800 3276.700 FORMAT "%8.3" ECU_ADDRESS 0xC0000032 /end MEASUREMENT
/begin MEASUREMENT ACCtl_trqTEngErr_mp "" SWORD Trq 1 100 -3276.800 3276.700 FORMAT "%8.3" ECU_ADDRESS 0xC0000034 /end MEASUREMENT
/begin MEASUREMENT ACCtl_trqTEngLim_mp "" SWORD Trq 1 100 -3276.800 3276.700 FORMAT "%8.3" ECU_ADDRESS 0xC0000036 /end MEASUREMENT
/begin MEASUREMENT ACCtl_trqTGearbxErr_mp "" SWORD Trq 1 100 -3276.800 3276.700 FORMAT "%8.3" ECU_ADDRESS 0xC0000038 /end MEASUREMENT
/begin MEASUREMENT ACCtl_trqTGearbxLim_mp "" SWORD Trq 1 100 -3276.800 3276.700 FORMAT "%8.3" ECU_ADDRESS 0xC000003A /end MEASUREMENT
/begin MEASUREMENT ACCtl_trqVehVErr_mp "" SWORD Trq 1 100 -3276.800 3276.700 FORMAT "%8.3" ECU_ADDRESS 0xC000003C /end MEASUREMENT
/begin MEASUREMENT ActMod_trq "aktuelles Motorausgangsmoment" SWORD Trq 1 100 -3276.800 3276.700 FORMAT "%8.3" ECU_ADDRESS 0xD0006B30 /end MEASUREMENT
/begin MEASUREMENT ActMod_trqClth "aktuelles Kupplungsmoment" SWORD Trq 1 100 -3276.800 3276.700 FORMAT "%8.3" ECU_ADDRESS 0xD0006B32 /end MEASUREMENT
/begin MEASUREMENT ActMod_trqCurr_mp "aktuelles rückgerechnetes inneres Motormoment ohne Startmoment" SWORD Trq 1 100 -3276.800 3276.700 FORMAT "%8.3" ECU_ADDRESS 0xC000003E /end MEASUREMENT
/begin MEASUREMENT ActMod_trqInr "aktuelles rückgerechnetes inneres Motormoment" SWORD Trq 1 100 -3276.800 3276.700 FORMAT "%8.3" ECU_ADDRESS 0xD0006B36 /end MEASUREMENT
/begin MEASUREMENT AC_rClgDem "Prozentuale Kühlanforderung" SWORD Prc 1 100 -400.0000 399.9878 FORMAT "%8.4" ECU_ADDRESS 0xD0006976 /end MEASUREMENT
/begin MEASUREMENT AC_stRedAC "" UBYTE OneToOne 1 100 0.00 255.0 FORMAT "%5.1" ECU_ADDRESS 0xD0008EF5 /end MEASUREMENT
/begin MEASUREMENT AC_trqDes "Wunsch-Moment" SWORD Trq 1 100 -3276.800 3276.700 FORMAT "%8.3" ECU_ADDRESS 0xD0006978 /end MEASUREMENT
/begin MEASUREMENT AC_trqMaxAC "Erlaubte Kompressor Momentenlast" SWORD Trq 1 100 -3276.800 3276.700 FORMAT "%8.3" ECU_ADDRESS 0xD000697A /end MEASUREMENT
/begin MEASUREMENT AC_trqResv "Reserve-Momment" SWORD Trq 1 100 -3276.800 3276.700 FORMAT "%8.3" ECU_ADDRESS 0xD000697C /end MEASUREMENT
/begin MEASUREMENT AirC_pAnaClnt "" SWORD PresAC_hPa 1 100 -65536.00 65534.00 FORMAT "%8.2" ECU_ADDRESS 0xD0006B38 /end MEASUREMENT
/begin MEASUREMENT AirC_pClnt "" SWORD PresAC_hPa 1 100 -65536.00 65534.00 FORMAT "%8.2" ECU_ADDRESS 0xD0006B3A /end MEASUREMENT
/begin MEASUREMENT AirC_pClntHld "Gespeicherter Klimakompressordruck-Wert" SWORD Pres_hPa 1 100 -32768.00 3500.00 FORMAT "%8.2" ECU_ADDRESS 0xD0006B3C /end MEASUREMENT
/begin MEASUREMENT AirC_pHld "Klimakompressordruck" SWORD Pres_hPa 1 100 -32768.00 3500.00 FORMAT "%8.2" ECU_ADDRESS 0xD0006B3E /end MEASUREMENT
/begin MEASUREMENT AirC_pPWMClnt "" SWORD PresAC_hPa 1 100 -65536.00 65534.00 FORMAT "%8.2" ECU_ADDRESS 0xD0006B40 /end MEASUREMENT
/begin MEASUREMENT AirC_rPwmRawClnt "" SWORD DtyCyc 1 100 -327.6800 327.6700 FORMAT "%8.4" ECU_ADDRESS 0xD0006B44 /end MEASUREMENT
/begin MEASUREMENT AirC_stHtrSwt "" UBYTE OneToOne 1 100 0.00 255.0 FORMAT "%5.1" ECU_ADDRESS 0xD0008F02 /end MEASUREMENT
/begin MEASUREMENT AirC_stPsCmpr "" UBYTE OneToOne 1 100 0.00 255.0 FORMAT "%5.1" ECU_ADDRESS 0xD0008F03 /end MEASUREMENT
/begin MEASUREMENT AirC_stPsCmprRedTrq "" UBYTE OneToOne 1 100 0.00 255.0 FORMAT "%5.1" ECU_ADDRESS 0xD0008F04 /end MEASUREMENT
/begin MEASUREMENT AirC_stPsCmprRedTrq_mp "" UBYTE OneToOne 1 100 0.00 255.0 FORMAT "%5.1" ECU_ADDRESS 0xC0000002 /end MEASUREMENT
/begin MEASUREMENT AirC_stPsCmpr_mp "" UBYTE OneToOne 1 100 0.00 255.0 FORMAT "%5.1" ECU_ADDRESS 0xC0000003 /end MEASUREMENT
/begin MEASUREMENT AirC_stRawHtrSwt "" UBYTE OneToOne 1 100 0.00 255.0 FORMAT "%5.1" ECU_ADDRESS 0xD0008F05 /end MEASUREMENT
/begin MEASUREMENT AirC_stSwt "" UBYTE OneToOne 1 100 0.00 255.0 FORMAT "%5.1" ECU_ADDRESS 0xD0008F06 /end MEASUREMENT
/begin MEASUREMENT AirC_stSwtPrs "" UBYTE OneToOne 1 100 0.00 255.0 FORMAT "%5.1" ECU_ADDRESS 0xD0008F07 /end MEASUREMENT
/begin MEASUREMENT AirC_stSwtRaw "" UBYTE OneToOne 1 100 0.00 255.0 FORMAT "%5.1" ECU_ADDRESS 0xD0008F08 /end MEASUREMENT
/begin MEASUREMENT AirC_tiClntPer_mp "" SWORD Time_PwmHigh 1 100 -1638.400 1638.350 FORMAT "%8.3" ECU_ADDRESS 0xC0000000 /end MEASUREMENT
/begin MEASUREMENT AirC_trqCmprMax "" SWORD Trq 1 100 -3276.800 3276.700 FORMAT "%8.3" ECU_ADDRESS 0xD0006B46 /end MEASUREMENT
/begin MEASUREMENT AirC_uAnaRawClnt "" SWORD Volt 1 100 -6553.600 6553.400 FORMAT "%8.3" ECU_ADDRESS 0xD0006B4A /end MEASUREMENT
/begin MEASUREMENT TS_nMinAC "" SWORD EngN 1 100 -16384.00 16383.50 FORMAT "%8.2" ECU_ADDRESS 0xD0007560 /end MEASUREMENT
/begin MEASUREMENT TS_stMnSwtAC "Status: Klima-Hauptschalter" UBYTE OneToOne 1 100 0.00 255.0 FORMAT "%5.1" ECU_ADDRESS 0xD0009184 /end MEASUREMENT
/begin MEASUREMENT VehMot_drAccPedUnFlt "Ableitung ungefilterter Fahrpedalwert" SWORD PrcPerSec 1 100 -20000.00 19999.39 FORMAT "%8.2" ECU_ADDRESS 0xD00075E8 /end MEASUREMENT
/begin MEASUREMENT VehMot_facDesDyn "Dynamikfaktor Fahrerwunsch" SWORD Fact 1 100 -4.000000 3.999878 FORMAT "%8.6" ECU_ADDRESS 0xD00075EC /end MEASUREMENT
/begin MEASUREMENT VehMot_rAccPedFlt "Gefilterter Fahrpedalwert" SWORD Prc 1 100 -400.0000 399.9878 FORMAT "%8.4" ECU_ADDRESS 0xD00075F8 /end MEASUREMENT
/begin MEASUREMENT VehMot_stAccPedOvrRun "Status ""Overrun-Rampe"" appliziert" UBYTE OneToOne 1 100 0.00 255.0 FORMAT "%5.1" ECU_ADDRESS 0xD0009195 /end MEASUREMENT
/begin MEASUREMENT VehMot_stPrpAccPed "Status Vortriebsanforderung durch Fahrerwunsch" UBYTE OneToOne 1 100 0.00 255.0 FORMAT "%5.1" ECU_ADDRESS 0xD000919B /end MEASUREMENT
/begin FUNCTION acci_calcreq "" /begin DEF_CHARACTERISTIC ACCI_aMax_C /end DEF_CHARACTERISTIC /begin IN_MEASUREMENT MoFDrAs_stACCPtdMsg /end IN_MEASUREMENT /begin OUT_MEASUREMENT ACCI_aReq ACCI_stInActv ACCI_stReq /end OUT_MEASUREMENT /end FUNCTION
/begin FUNCTION ACClntP_DD ""
 /begin DEF_CHARACTERISTIC AirC_dcycClntPresPwmInMax_C AirC_dcycClntPresPwmInMin_C AirC_nEngLoLim_C AirC_pClntTransfAna_CUR AirC_pClntTransfPwm_CUR AirC_swtClntPresSel_C AirC_tAirLoLim_C AirC_tiPerClntPresPwmInMax_C AirC_tiPerClntPresPwmInMin_C AirC_uSRCMaxClntPres_C AirC_uSRCMinClntPres_C /end DEF_CHARACTERISTIC
 /begin IN_MEASUREMENT EnvT_t Epm_nEng /end IN_MEASUREMENT
 /begin OUT_MEASUREMENT AirC_pAnaClnt AirC_pPWMClnt AirC_rPwmRawClnt AirC_tiClntPer_mp AirC_uAnaRawClnt /end OUT_MEASUREMENT
/end FUNCTION
/begin FUNCTION ACClntp_VD ""
 /begin DEF_CHARACTERISTIC AirC_pDfl_C AirC_RmpSlpClntP.Pos_C AirC_RmpSlpClntP.Neg_C AirC_TransStageClntPar.Dfl_C AirC_TransStageClntPar.stSensId_C /end DEF_CHARACTERISTIC
 /begin OUT_MEASUREMENT AirC_pClnt /end OUT_MEASUREMENT
/end FUNCTION
/begin FUNCTION ACCmpr_DD ""
 /begin DEF_CHARACTERISTIC AirC_DigOutCmpr.tiBtwTstSCB_C AirC_DigOutCmpr.tiBtwTstOT_C AirC_DigOutCmpr.numTstMax_C AirC_DigOutRedTrq.tiBtwTstSCB_C AirC_DigOutRedTrq.tiBtwTstOT_C AirC_DigOutRedTrq.numTstMax_C AirC_stCmprPsDiaDisbl_C AirC_stCmprPsDisbl_C AirC_stCmprTyp_CW AirC_stRedTrqPsDiaDisbl_C AirC_stRedTrqPsDisbl_C AirC_trqCmprMax_C AirC_trqCmprMin_C /end DEF_CHARACTERISTIC
 /begin IN_MEASUREMENT AC_trqMaxAC DevLib_stPwrStgEnaCond /end IN_MEASUREMENT
 /begin OUT_MEASUREMENT AirC_stPsCmpr AirC_stPsCmprRedTrq AirC_stPsCmprRedTrq_mp AirC_stPsCmpr_mp AirC_trqCmprMax /end OUT_MEASUREMENT
/end FUNCTION
/begin FUNCTION accomp_demand ""
 /begin DEF_CHARACTERISTIC ACComp_facTrqCAN_C ACComp_stTrqCAN_CW ACComp_swtLd_CW ACComp_tiTrqDyn_C ACComp_tiTrqResv_C ACComp_trqOffsFlt_C /end DEF_CHARACTERISTIC
 /begin IN_MEASUREMENT ACCtl_stOut ACCtl_stTrqResv /end IN_MEASUREMENT
 /begin OUT_MEASUREMENT AC_trqDes AC_trqResv /end OUT_MEASUREMENT
 /begin LOC_MEASUREMENT ACComp_trqDesFltAbv_mp ACComp_trqDesFlt_mp ACComp_trqDyn_mp ACComp_trqStat_mp /end LOC_MEASUREMENT
/end FUNCTION
/begin FUNCTION accomp_demand_inl "" /begin DEF_CHARACTERISTIC ACComp_trqDyn_MAP ACComp_trqStat_MAP /end DEF_CHARACTERISTIC /begin IN_MEASUREMENT AirC_pClnt Epm_nEng /end IN_MEASUREMENT /end FUNCTION
/begin FUNCTION accped_docoordout ""
 /begin DEF_CHARACTERISTIC AccPed_nErr_CUR AccPed_nMax_C AccPed_nMinBrkApp_C AccPed_nMinBrk_C AccPed_trqDemThres_C AccPed_trqLimMax_C /end DEF_CHARACTERISTIC
 /begin IN_MEASUREMENT AccPed_trqDes APP_drUnFlt APP_r APP_stPlaBrkPres PT_numTraGear PT_rTrq PT_trqWhlMinEng VehMot_rTrqDfftl VehMot_stBrkPed /end IN_MEASUREMENT
 /begin OUT_MEASUREMENT AccPed_nMax AccPed_nMin AccPed_rTrq AccPed_stMS AccPed_stNSetP AccPed_trqLimMax VehMot_drAccPedUnFlt VehMot_facDesDyn VehMot_rAccPedFlt VehMot_stPrpAccPed /end OUT_MEASUREMENT
/end FUNCTION
/begin FUNCTION accped_docoordout_inl "" /begin DEF_CHARACTERISTIC AccPed_nMinNoBrk_C /end DEF_CHARACTERISTIC /begin IN_MEASUREMENT PT_stGrip PT_swtMstShft /end IN_MEASUREMENT /end FUNCTION
/begin FUNCTION accped_drvdemdes "" /begin DEF_CHARACTERISTIC AccPed_rOffset_C AccPed_rThresPrp_C AccPed_rZero_C /end DEF_CHARACTERISTIC
 /begin IN_MEASUREMENT AccPed_rTrq AccPed_trqLimMax APP_r APP_rUnFlt Epm_nEng GlbDa_vX PT_trqWhlMinEng PT_trqWhlMinWoCtOff /end IN_MEASUREMENT
 /begin OUT_MEASUREMENT AccPed_facCompAcs AccPed_trqDes AccPed_trqDesOvrRun_mp AccPed_trqDesPull VehMot_stAccPedOvrRun /end OUT_MEASUREMENT
/end FUNCTION
/begin FUNCTION accped_drvdemdes_inl ""
 /begin DEF_CHARACTERISTIC AccPed_swtDrvBehav_C AccPed_trqEngHigh_MAP AccPed_trqEngLow_MAP AccPed_trqEngRev_MAP AccPed_trqPrp_MAP AccPed_vVehVmax_C AccPed_vVehVmin_C /end DEF_CHARACTERISTIC
 /begin IN_MEASUREMENT AccPed_stMS APP_r Epm_nEng GlbDa_vX PT_stTraRevGear PT_trqSpdGovLtd /end IN_MEASUREMENT
 /begin LOC_MEASUREMENT AccPed_trqDesEngLinInt_mp AccPed_trqEngHighDes_mp AccPed_trqEngLowDes_mp /end LOC_MEASUREMENT
/end FUNCTION
/begin FUNCTION accped_drvdemlead ""
 /begin IN_MEASUREMENT AccPed_stMS AccPed_trqLimMax APP_rUnFlt Epm_nEng GlbDa_vX PT_rTrq PT_trqSpdGovLtd PT_trqWhlMinEng PT_trqWhlMinWoCtOff VehMot_rTrqDfftl /end IN_MEASUREMENT
 /begin OUT_MEASUREMENT AccPed_trqLead AccPed_trqLeadOvrRun_mp AccPed_trqLeadPull_mp /end OUT_MEASUREMENT
/end FUNCTION
/begin FUNCTION accped_drvdemlead_inl "" /begin IN_MEASUREMENT PT_stTraRevGear /end IN_MEASUREMENT
 /begin LOC_MEASUREMENT AccPed_trqEngHighLead_mp AccPed_trqEngLowLead_mp AccPed_trqLeadEngLinInt_mp /end LOC_MEASUREMENT
/end FUNCTION
/begin FUNCTION ACCtl_Demand ""
 /begin DEF_CHARACTERISTIC ACCtl_dtrqFullLoadLimDn_C ACCtl_dtrqFullLoadLimUp_C ACCtl_nACThres_C ACCtl_nFullLoadLimHi_C ACCtl_nFullLoadLimLo_C ACCtl_nMin_C ACCtl_stResv_CW ACCtl_tiDebIdlSpd_C ACCtl_tiDebNEngOff_C ACCtl_tiDebNEngOn_C ACCtl_tiDebStrtOff_C ACCtl_tiDebStrtOn_C ACCtl_tiMnSwtDel_C ACCtl_tiOnLock_C ACCtl_tiTrqResv_C ACCtl_trqACMax_C ACCtl_trqACOff_C ACCtl_trqACTrqErr_C ACCtl_trqFanErr_C ACCtl_trqFastLim_C ACCtl_trqFullLoadOfs_CUR ACCtl_trqRedAC_C ACCtl_trqShutOff_C ACCtl_trqTEngErr_C ACCtl_trqTEngLim_MAP ACCtl_trqTGearbxErr_C ACCtl_trqTGearbxLim_MAP ACCtl_trqThres_C ACCtl_trqVehVErr_C ACCtl_vThres_C /end DEF_CHARACTERISTIC
 /begin IN_MEASUREMENT AC_trqDes CoEng_st CoETS_trqInrSetSlow EngDa_tEng EngDem_trqInrLim Epm_nEng GlbDa_stTrqDem GlbDa_vX SpdGov_trqSet Tra_tOil TS_stMnSwtAC /end IN_MEASUREMENT
 /begin OUT_MEASUREMENT ACCtl_stTrqResv ACCtl_trqMaxAC AC_stRedAC AC_trqMaxAC /end OUT_MEASUREMENT
 /begin LOC_MEASUREMENT ACCtl_stMnSwtTmr_mp ACCtl_stOut ACCtl_trqACFastOffLim_mp ACCtl_trqACFastOffMax_mp ACCtl_trqACTrqErr_mp ACCtl_trqFanErr_mp ACCtl_trqMaxAC_mp ACCtl_trqStrtLim_mp ACCtl_trqTEngErr_mp ACCtl_trqTEngLim_mp ACCtl_trqTGearbxErr_mp ACCtl_trqTGearbxLim_mp ACCtl_trqVehVErr_mp TS_nMinAC /end LOC_MEASUREMENT
/end FUNCTION
/begin FUNCTION ACCtl_Demand_Inl "" /end FUNCTION
/begin FUNCTION ACHtrSwt_DD "" /begin DEF_CHARACTERISTIC AirC_HtrSwtDeb.tiHiLo_C AirC_HtrSwtDeb.tiLoHi_C /end DEF_CHARACTERISTIC /end FUNCTION
/begin FUNCTION ACHtrSwt_VD "" /begin OUT_MEASUREMENT AirC_stHtrSwt AirC_stRawHtrSwt /end OUT_MEASUREMENT /end FUNCTION
/begin FUNCTION aco ""
 /begin DEF_CHARACTERISTIC AC_rAdjValDef_C AC_rAdjValMax_C AC_rAdjValMin_C Alt_rAdjValDef_C Alt_rAdjValMax_C Alt_rAdjValMin_C SrvPmp_rAdjValDef_C SrvPmp_rAdjValMax_C SrvPmp_rAdjValMin_C /end DEF_CHARACTERISTIC
/end FUNCTION
/begin FUNCTION ACSwt_DD ""
 /begin DEF_CHARACTERISTIC AirC_SwtDeb.tiHiLo_C AirC_SwtDeb.tiLoHi_C AirC_swtMnSwtSig_C /end DEF_CHARACTERISTIC
 /begin OUT_MEASUREMENT AirC_stSwtRaw /end OUT_MEASUREMENT
/end FUNCTION
/begin FUNCTION ACSwt_VD "" /begin DEF_CHARACTERISTIC AirC_stSwtDfl_C /end DEF_CHARACTERISTIC /begin IN_MEASUREMENT Com_stAC /end IN_MEASUREMENT /begin OUT_MEASUREMENT AirC_stSwt AirC_stSwtPrs /end OUT_MEASUREMENT /end FUNCTION
/begin FUNCTION ActMod_Q2Trq "" /begin IN_MEASUREMENT CoEng_st InjCtl_qSetUnBal PhyMod_facEtaCor StSys_trqStrt /end IN_MEASUREMENT /begin OUT_MEASUREMENT ActMod_trqInr /end OUT_MEASUREMENT /begin LOC_MEASUREMENT ActMod_trqCurr_mp /end LOC_MEASUREMENT /end FUNCTION
/begin FUNCTION ActMod_TrqCalc "" /begin IN_MEASUREMENT CoVeh_trqAcs RngMod_trqMin /end IN_MEASUREMENT /begin OUT_MEASUREMENT ActMod_trq ActMod_trqClth /end OUT_MEASUREMENT /end FUNCTION
/begin FUNCTION ac_dataacq "" /begin IN_MEASUREMENT AirC_stSwtRaw /end IN_MEASUREMENT /begin OUT_MEASUREMENT TS_stMnSwtAC /end OUT_MEASUREMENT /end FUNCTION
/begin FUNCTION ac_demand ""
 /begin DEF_CHARACTERISTIC AC_dmClgACOff_CUR AC_dmClgACOn_MAP AC_stClgDemCAN_CW AirC_pClntHi_C AirC_pClntLo_C AirC_pClnt_C /end DEF_CHARACTERISTIC
 /begin IN_MEASUREMENT AirC_pClnt AirC_rClgDem AirC_stPsCmpr GlbDa_tEnv TS_stMnSwtAC /end IN_MEASUREMENT
 /begin OUT_MEASUREMENT AC_rClgDem AirC_pClntHld AirC_pHld /end OUT_MEASUREMENT
/end FUNCTION
/begin FUNCTION Adc "" /begin SUB_FUNCTION AdcI /end SUB_FUNCTION /end FUNCTION
/begin FUNCTION AdcI "" /end FUNCTION
/begin FUNCTION adc_auto "" /end FUNCTION
/begin COMPU_METHOD Acc "" RAT_FUNC "%6.5" "m/s^2" COEFFS 0 1000 0 0 0 1 /end COMPU_METHOD
/begin COMPU_METHOD AirSysSwt_S16 "" RAT_FUNC "%7.6" "-" COEFFS 0 16384 0 0 0 1 /end COMPU_METHOD
/begin COMPU_METHOD DEFAULT_FORMULA "DEFAULT_FORMULA" RAT_FUNC "%7.0" "" COEFFS 0 1 0 0 0 1 /end COMPU_METHOD
/begin COMPU_METHOD DEFAULT_FORMULA "DEFAULT_FORMULA" RAT_FUNC "%7.0" "" COEFFS 0 1 0 0 0 1 /end COMPU_METHOD
/begin COMPU_METHOD DtyCyc "" RAT_FUNC "%6.4" "%" COEFFS 0 100 0 0 0 1 /end COMPU_METHOD
/begin COMPU_METHOD EngN "" RAT_FUNC "%6.3" "rpm" COEFFS 0 2 0 0 0 1 /end COMPU_METHOD
/begin COMPU_METHOD Fact "" RAT_FUNC "%6.5" "-" COEFFS 0 8192 0 0 0 1 /end COMPU_METHOD
/begin COMPU_METHOD Fact1 "" RAT_FUNC "%6.4" "-" COEFFS 0 128 0 0 0 1 /end COMPU_METHOD
/begin COMPU_METHOD OneToOne "" RAT_FUNC "%6.2" "-" COEFFS 0 1 0 0 0 1 /end COMPU_METHOD
/begin COMPU_METHOD Prc "" RAT_FUNC "%6.4" "%" COEFFS 0 81.92 0 0 0 1 /end COMPU_METHOD
/begin COMPU_METHOD PrcPerSec "" RAT_FUNC "%6.3" "%/s" COEFFS 0 1.6384 0 0 0 1 /end COMPU_METHOD
/begin COMPU_METHOD PresAC_hPa "" RAT_FUNC "%6.2" "hPa" COEFFS 0 0.5 0 0 0 1 /end COMPU_METHOD
/begin COMPU_METHOD Pres_hPa "" RAT_FUNC "%6.2" "hPa" COEFFS 0 1 0 0 0 1 /end COMPU_METHOD
/begin COMPU_METHOD RmpPresAC_hPa "" RAT_FUNC "%6.4" "hPa/s" COEFFS 0 32.768 0 0 0 1 /end COMPU_METHOD
/begin COMPU_METHOD RmpTrq "" RAT_FUNC "%6.4" "Nm/s" COEFFS 0 655.36 0 0 0 1 /end COMPU_METHOD
/begin COMPU_METHOD Temp_Cels "" RAT_FUNC "%6.1" "deg C" COEFFS 0 10 2731.4 0 0 1 /end COMPU_METHOD
/begin COMPU_METHOD TimeDeb "" RAT_FUNC "%6.1" "ms" COEFFS 0 0.1 0 0 0 1 /end COMPU_METHOD
/begin COMPU_METHOD TimeDelay_s "" RAT_FUNC "%12.4" "s" COEFFS 0 0 1 0 0.00023283064365387 0 /end COMPU_METHOD
/begin COMPU_METHOD TimeDT "" RAT_FUNC "%6.2" "us" COEFFS 0 1 0 0 0 1 /end COMPU_METHOD
/begin COMPU_METHOD Time_ms "" RAT_FUNC "%6.1" "ms" COEFFS 0 0.1 0 0 0 1 /end COMPU_METHOD
/begin COMPU_METHOD Time_PwmHigh "" RAT_FUNC "%6.4" "us" COEFFS 0 20 0 0 0 1 /end COMPU_METHOD
/begin COMPU_METHOD Time_s "" RAT_FUNC "%6.4" "s" COEFFS 0 100 0 0 0 1 /end COMPU_METHOD
/begin COMPU_METHOD TransR "" RAT_FUNC "%6.4" "-" COEFFS 0 100 0 0 0 1 /end COMPU_METHOD
/begin COMPU_METHOD Trq "" RAT_FUNC "%6.3" "Nm" COEFFS 0 10 0 0 0 1 /end COMPU_METHOD
/begin COMPU_METHOD TrqPrp "" RAT_FUNC "%6.2" "Nm" COEFFS 0 0.625 0 0 0 1 /end COMPU_METHOD
/begin COMPU_METHOD TrqPrpHigh "" RAT_FUNC "%6.3" "Nm" COEFFS 0 10 0 0 0 1 /end COMPU_METHOD
/begin COMPU_METHOD Vel "" RAT_FUNC "%6.4" "km/h" COEFFS 0 100 0 0 0 1 /end COMPU_METHOD
/begin COMPU_METHOD Volt "" RAT_FUNC "%6.3" "mV" COEFFS 0 5 0 0 0 1 /end COMPU_METHOD
/begin RECORD_LAYOUT Cur_Xs16Ws16 NO_AXIS_PTS_X 1 SWORD AXIS_PTS_X 2 SWORD INDEX_INCR DIRECT FNC_VALUES 3 SWORD COLUMN_DIR DIRECT /end RECORD_LAYOUT
/begin RECORD_LAYOUT Kf_Xs16_Ys16_Ws16 NO_AXIS_PTS_X 1 SWORD NO_AXIS_PTS_Y 2 SWORD AXIS_PTS_X 3 SWORD INDEX_INCR DIRECT AXIS_PTS_Y 4 SWORD INDEX_INCR DIRECT FNC_VALUES 5 SWORD COLUMN_DIR DIRECT /end RECORD_LAYOUT
/begin RECORD_LAYOUT Kl_Xs16_Ws16 NO_AXIS_PTS_X 1 SWORD AXIS_PTS_X 2 SWORD INDEX_INCR DIRECT FNC_VALUES 3 SWORD COLUMN_DIR DIRECT /end RECORD_LAYOUT
/begin RECORD_LAYOUT Kw_Ws16 FNC_VALUES 1 SWORD COLUMN_DIR DIRECT /end RECORD_LAYOUT
/begin RECORD_LAYOUT Kw_Ws32 FNC_VALUES 1 SLONG COLUMN_DIR DIRECT /end RECORD_LAYOUT
/begin RECORD_LAYOUT Kw_Wu16 FNC_VALUES 1 UWORD COLUMN_DIR DIRECT /end RECORD_LAYOUT
/begin RECORD_LAYOUT Kw_Wu8 FNC_VALUES 1 UBYTE COLUMN_DIR DIRECT /end RECORD_LAYOUT
/begin RECORD_LAYOUT Map_Xs16Ys16Ws16 NO_AXIS_PTS_X 1 SWORD NO_AXIS_PTS_Y 2 SWORD AXIS_PTS_X 3 SWORD INDEX_INCR DIRECT AXIS_PTS_Y 4 SWORD INDEX_INCR DIRECT FNC_VALUES 5 SWORD COLUMN_DIR DIRECT /end RECORD_LAYOUT
/begin RECORD_LAYOUT Val_Ws16 FNC_VALUES 1 SWORD COLUMN_DIR DIRECT /end RECORD_LAYOUT
/begin RECORD_LAYOUT Val_Ws32 FNC_VALUES 1 SLONG COLUMN_DIR DIRECT /end RECORD_LAYOUT
/begin RECORD_LAYOUT Val_Wu16 FNC_VALUES 1 UWORD COLUMN_DIR DIRECT /end RECORD_LAYOUT
/begin RECORD_LAYOUT Val_Wu32 FNC_VALUES 1 ULONG COLUMN_DIR DIRECT /end RECORD_LAYOUT
/begin RECORD_LAYOUT Val_Wu8 FNC_VALUES 1 UBYTE COLUMN_DIR DIRECT /end RECORD_LAYOUT
/end MODULE
/end PROJECT
