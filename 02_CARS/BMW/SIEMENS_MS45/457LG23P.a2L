ASAP2_VERSION 1 31
/begin PROJECT MS45 "BMW Motorsteuerung R6"
/begin HEADER "_default_HeaderComment" PROJECT_NO _57 /end HEADER
/begin MODULE _default_ModuleName "_default_ModuleLongIdentifier"
/begin MOD_COMMON "_default_ModCommonComment" DEPOSIT ABSOLUTE BYTE_ORDER MSB_FIRST ALIGNMENT_BYTE 1 ALIGNMENT_WORD 2 ALIGNMENT_LONG 4 ALIGNMENT_FLOAT32_IEEE 4 ALIGNMENT_FLOAT64_IEEE 8 /end MOD_COMMON
/begin MEASUREMENT t_ast "Time after start" UWORD _CNV_A_R_LINEAR_____24_CM 1 100. 0. 6553.5 DISPLAY_IDENTIFIER T_AST ECU_ADDRESS 0x3fd868 BYTE_ORDER MSB_LAST FORMAT "%6.1" /end MEASUREMENT
/begin MEASUREMENT t_ast_rest "After start time for re-start" UWORD _CNV_A_R_LINEAR_____24_CM 1 100. 0. 6553.5 DISPLAY_IDENTIFIER T_AST_REST ECU_ADDRESS 0x3fd86a BYTE_ORDER MSB_LAST FORMAT "%6.1" /end MEASUREMENT
/begin CHARACTERISTIC c_n_max_fl_dly "Maximum engine speed for Full load recognition" VALUE 0xffe407e6 _REC_VAL_20_u1 8160. _CNV_A_R_LINEAR_____15_CM 0. 8160. DISPLAY_IDENTIFIER C_N_MAX_FL_DLY FORMAT "%4.0" /end CHARACTERISTIC
/begin CHARACTERISTIC c_n_min_fl_dly "Minimum engine speed for Full load recognition" VALUE 0xffe407f5 _REC_VAL_20_u1 8160. _CNV_A_R_LINEAR_____15_CM 0. 8160. DISPLAY_IDENTIFIER C_N_MIN_FL_DLY FORMAT "%4.0" /end CHARACTERISTIC
/begin CHARACTERISTIC c_t_max_fl_dly "Time after Start- Threshold value for Full load recognition" VALUE 0xffe41996 _REC_VAL_20_u2 6553.5 _CNV_A_R_LINEAR_____24_CM 0. 6553.5 DISPLAY_IDENTIFIER C_T_MAX_FL_DLY FORMAT "%5.1" /end CHARACTERISTIC
/begin CHARACTERISTIC c_t_ti_dly_fl_2 "Delay time Full load" VALUE 0xffe41a10 _REC_VAL_20_u2 655.35 _CNV_A_R_LINEAR_____4_CM 0. 655.35 DISPLAY_IDENTIFIER C_T_TI_DLY_FL_2 FORMAT "%6.2" /end CHARACTERISTIC
/begin CHARACTERISTIC c_t_ti_dly_fl_at_1 "Delay time Full load AT" VALUE 0xffe41a12 _REC_VAL_20_u2 655.35 _CNV_A_R_LINEAR_____4_CM 0. 655.35 DISPLAY_IDENTIFIER C_T_TI_DLY_FL_AT_1 FORMAT "%6.2" /end CHARACTERISTIC
/begin CHARACTERISTIC c_t_ti_dly_fl_at_2 "Delay time Full load AT" VALUE 0xffe41a14 _REC_VAL_20_u2 655.35 _CNV_A_R_LINEAR_____4_CM 0. 655.35 DISPLAY_IDENTIFIER C_T_TI_DLY_FL_AT_2 FORMAT "%6.2" /end CHARACTERISTIC
/begin CHARACTERISTIC c_tco_min_fl "Minimum temperature for FL" VALUE 0xffe40916 _REC_VAL_20_u1 28.575 _CNV_A_R_LINEAR_____11_CM -48. 142.5 DISPLAY_IDENTIFIER C_TCO_MIN_FL FORMAT "%5.1" /end CHARACTERISTIC
/begin CHARACTERISTIC c_vs_min_fl "Minimum velocity for FL" VALUE 0xffe409e4 _REC_VAL_20_u1 25.5 _CNV_A_R_LINEAR_____23_CM 0. 255. DISPLAY_IDENTIFIER C_VS_MIN_FL FORMAT "%3.0" /end CHARACTERISTIC
/begin MEASUREMENT lv_fl_raw "LV condition a) is fullfilled" UBYTE _CNV_S_2_RANGE______2_CM 1 100. 0. 1. DISPLAY_IDENTIFIER LV_FL_RAW ECU_ADDRESS 0x3fe788 /end MEASUREMENT
/begin MEASUREMENT lv_ti_ris "Basic function \"Reactivation fuel feed at idle\"" UBYTE _CNV_S_2_RANGE______21_CM 1 100. 0. 1. DISPLAY_IDENTIFIER LV_TI_RIS ECU_ADDRESS 0x3fe78a /end MEASUREMENT
/begin MEASUREMENT lv_ti_rpu "Basic function \"Reactivation fuel feed at trailing throttle\"" UBYTE _CNV_S_2_RANGE______21_CM 1 100. 0. 1. DISPLAY_IDENTIFIER LV_TI_RPU ECU_ADDRESS 0x3fe78b /end MEASUREMENT
/begin MEASUREMENT lv_ti_rpl "Basic function \"Reactivation fuel feed at part load\"" UBYTE _CNV_S_2_RANGE______21_CM 1 100. 0. 1. DISPLAY_IDENTIFIER LV_TI_RPL ECU_ADDRESS 0x3fe78c /end MEASUREMENT
/begin MEASUREMENT lv_ti_rae "Basic function \"Reactivation fuel feed at acceleration enrichment\"" UBYTE _CNV_S_2_RANGE______21_CM 1 100. 0. 1. DISPLAY_IDENTIFIER LV_TI_RAE ECU_ADDRESS 0x3fe78d /end MEASUREMENT
/begin MEASUREMENT lv_fl "Basic function FL" UBYTE _CNV_S_2_RANGE______21_CM 1 100. 0. 1. DISPLAY_IDENTIFIER LV_FL ECU_ADDRESS 0x3fe787 BIT_MASK 0x1 /end MEASUREMENT
/begin CHARACTERISTIC c_n_min_fl "Minimum engine speed for FL" VALUE 0xffe407f4 _REC_VAL_20_u1 816. _CNV_A_R_LINEAR_____15_CM 0. 8160. DISPLAY_IDENTIFIER C_N_MIN_FL FORMAT "%4.0" /end CHARACTERISTIC
/begin CHARACTERISTIC c_t_min_fl_dly "Time after Start- Threshold for Full load recognition" VALUE 0xffe419b2 _REC_VAL_20_u2 6553.5 _CNV_A_R_LINEAR_____24_CM 0. 6553.5 DISPLAY_IDENTIFIER C_T_MIN_FL_DLY FORMAT "%5.1" /end CHARACTERISTIC
/begin MEASUREMENT lv_inf "Basic function \" Intercept \"" UBYTE _CNV_S_2_RANGE______2_CM 1 100. 0. 1. DISPLAY_IDENTIFIER LV_INF ECU_ADDRESS 0x3fe789 BIT_MASK 0x1 /end MEASUREMENT
/begin MEASUREMENT lv_ti_reac "Basic function \"Reactivation fuel feed\"" UBYTE _CNV_S_2_RANGE______21_CM 1 100. 0. 1. DISPLAY_IDENTIFIER LV_TI_REAC ECU_ADDRESS 0x3fe78f /end MEASUREMENT
/begin CHARACTERISTIC c_t_ti_dly_fl_1 "Delay time Full load" VALUE 0xffe41a0e _REC_VAL_20_u2 655.35 _CNV_A_R_LINEAR_____4_CM 0. 655.35 DISPLAY_IDENTIFIER C_T_TI_DLY_FL_1 FORMAT "%6.2" /end CHARACTERISTIC
/begin CHARACTERISTIC c_n_min_cp_fl "Minimum engine speed for FL at high canister purge load" VALUE 0xffe407f2 _REC_VAL_20_u1 8160. _CNV_A_R_LINEAR_____15_CM 0. 8160. DISPLAY_IDENTIFIER C_N_MIN_CP_FL FORMAT "%4.0" /end CHARACTERISTIC
/begin CHARACTERISTIC c_cl_mmv_thd_fl "threshold for high canister load" VALUE 0xffe41532 _REC_VAL_20_u2 1.99996948 _CNV_A_R_LINEAR_____20_CM 0. 1.99996948 DISPLAY_IDENTIFIER C_CL_MMV_THD_FL FORMAT "%7.5" /end CHARACTERISTIC
/begin CHARACTERISTIC ip_pv_max_fl__n "PWG-demand for Full load recognition" CURVE 0xffe46ebb _REC_CUR_20_u1_u2 9.9609375 _CNV_A_R_LINEAR_____9_CM 0. 99.609375 DISPLAY_IDENTIFIER IP_PV_MAX_FL__N FORMAT "%5.2"
 /begin AXIS_DESCR COM_AXIS n _CNV_A_R_LINEAR_____10_CM 16 0. 8160. FORMAT "%4.0" AXIS_PTS_REF ldpm_n_2_3 /end AXIS_DESCR
/end CHARACTERISTIC
/begin AXIS_PTS ldpm_n_2_3 "" 0xffe51aac n _REC_AXS_20_u2 816. _CNV_A_R_LINEAR_____10_CM 16 0. 8160. DISPLAY_IDENTIFIER LDPM_N_2_3 FORMAT "%4.0" /end AXIS_PTS
/begin CHARACTERISTIC c_n_grd_min "engine speed  gradient threshold for activating the intercept function" VALUE 0xffe40390 _REC_VAL_20_s1 204.8 _CNV_A_R_LINEAR_____51_CM -4096. 0. DISPLAY_IDENTIFIER C_N_GRD_MIN FORMAT "%7.0" /end CHARACTERISTIC
/begin CHARACTERISTIC id_tps_grd_bol_ae__n__tps_av "Throttle position gradient threshold" MAP 0xffe443f6 _REC_MAP_20_u1_u1_u2 298.75 _CNV_A_R_LINEAR_____52_CM 0. 2987.5 DISPLAY_IDENTIFIER ID_TPS_GRD_BOL_AE__N__TPS_AV FORMAT "%4.0"
 /begin AXIS_DESCR COM_AXIS n_32 _CNV_A_R_LINEAR_____15_CM 6 0. 8160. FORMAT "%4.0" AXIS_PTS_REF ldp_n_23 /end AXIS_DESCR
 /begin AXIS_DESCR COM_AXIS tps_av _CNV_A_R_LINEAR_____53_CM 4 0. 119.5 FORMAT "%7.3" AXIS_PTS_REF ldp_tps_av_id_tps_grd_bol_ae /end AXIS_DESCR
/end CHARACTERISTIC
/begin AXIS_PTS ldp_n_23 "" 0xffe41078 n_32 _REC_AXS_20_u1 816. _CNV_A_R_LINEAR_____15_CM 6 0. 8160. DISPLAY_IDENTIFIER LDP_N_23 FORMAT "%4.0" /end AXIS_PTS
/begin AXIS_PTS ldp_tps_av_id_tps_grd_bol_ae "" 0xffe513aa tps_av _REC_AXS_20_u2 11.95 _CNV_A_R_LINEAR_____53_CM 4 0. 119.5 DISPLAY_IDENTIFIER LDP_TPS_AV_ID_TPS_GRD_BOL_AE FORMAT "%7.3" /end AXIS_PTS
/begin AXIS_PTS ldp_n_grd_n_max_inf "" 0xffe4113c n_grd _REC_AXS_20_u1 4096. _CNV_A_R_LINEAR_____54_CM 6 -4096. 0. DISPLAY_IDENTIFIER LDP_N_GRD_N_MAX_INF FORMAT "%5.0" /end AXIS_PTS
/begin CHARACTERISTIC ip_n_max_inf "Maximum engine speed for intercept function" CURVE 0xffe40d5d _REC_CUR_20_u1_u1 8160. _CNV_A_R_LINEAR_____15_CM 0. 8160. DISPLAY_IDENTIFIER IP_N_MAX_INF FORMAT "%4.0"
 /begin AXIS_DESCR COM_AXIS n_grd _CNV_A_R_LINEAR_____54_CM 6 -4096. 0. FORMAT "%5.0" AXIS_PTS_REF ldp_n_grd_n_max_inf /end AXIS_DESCR
/end CHARACTERISTIC
/begin MEASUREMENT lv_ti_ch "Auxiliary Function \" Catalyst Heating Injection\"." UBYTE _CNV_S_2_RANGE______2_CM 1 100. 0. 1. DISPLAY_IDENTIFIER LV_TI_CH ECU_ADDRESS 0x3fe795 BIT_MASK 0x1 /end MEASUREMENT
/begin MEASUREMENT lv_ch "Auxiliary Function \" Catalyst Heating Spark\"." UBYTE _CNV_S_2_RANGE______21_CM 1 100. 0. 1. DISPLAY_IDENTIFIER LV_CH ECU_ADDRESS 0x3fe794 BIT_MASK 0x1 /end MEASUREMENT
/begin MEASUREMENT lv_ch_tq_add "Catalyst Heating Function \"torque reserve\" (late ignition angle)" UBYTE _CNV_S_2_RANGE______21_CM 1 100. 0. 1. DISPLAY_IDENTIFIER LV_CH_TQ_ADD ECU_ADDRESS 0x3fe790 BIT_MASK 0x1 /end MEASUREMENT
/begin MEASUREMENT lv_ch_tq_add_is "Catalyst Heating Function \"torque reserve for first idle phases\"" UBYTE _CNV_S_2_RANGE______21_CM 1 100. 0. 1. DISPLAY_IDENTIFIER LV_CH_TQ_ADD_IS ECU_ADDRESS 0x3fe791 BIT_MASK 0x1 /end MEASUREMENT
/begin MEASUREMENT lv_ch_n_sp_is "Catalyst Heating Function \"increased idle speed setpoint\"" UBYTE _CNV_S_2_RANGE______21_CM 1 100. 0. 1. DISPLAY_IDENTIFIER LV_CH_N_SP_IS ECU_ADDRESS 0x3fe792 BIT_MASK 0x1 /end MEASUREMENT
/begin MEASUREMENT lv_ch_ivvt "Catalyst Heating Function \"increased valve overlap\"" UBYTE _CNV_S_2_RANGE______21_CM 1 100. 0. 1. DISPLAY_IDENTIFIER LV_CH_IVVT ECU_ADDRESS 0x3fe793 BIT_MASK 0x1 /end MEASUREMENT
/begin CHARACTERISTIC ip_t_ch_n_sp_is "Activation time for CAT heating function 'idle speed setpoint'" MAP 0xffe4e692 _REC_MAP_20_u2_u1_u2 6553.5 _CNV_A_R_LINEAR_____24_CM 0. 6553.5 DISPLAY_IDENTIFIER IP_T_CH_N_SP_IS FORMAT "%6.1"
 /begin AXIS_DESCR COM_AXIS tco _CNV_A_R_LINEAR_____11_CM 8 -48. 142.5 FORMAT "%5.1" AXIS_PTS_REF ldpm_tco_2 /end AXIS_DESCR
 /begin AXIS_DESCR COM_AXIS ctr_km_can _CNV_A_R_LINEAR_____88_CM 4 0. 655350. FORMAT "%7.0" AXIS_PTS_REF ldpm_ctr_km_can_1 /end AXIS_DESCR
/end CHARACTERISTIC
/begin CHARACTERISTIC id_t_ch_ti "Activation time after start to switch on the injection time correction for catalyst heating" CURVE 0xffe48d80 _REC_CUR_20_u2_u1 6553.5 _CNV_A_R_LINEAR_____24_CM 0. 6553.5 DISPLAY_IDENTIFIER ID_T_CH_TI FORMAT "%6.1"
 /begin AXIS_DESCR COM_AXIS tco _CNV_A_R_LINEAR_____11_CM 8 -48. 142.5 FORMAT "%5.1" AXIS_PTS_REF ldpm_tco_2 /end AXIS_DESCR
/end CHARACTERISTIC
/begin CHARACTERISTIC c_vs_max_ch_ivvt "Threshold for temporary abortion of CAT heating function 'VANOS'" VALUE 0xffe409d4 _REC_VAL_20_u1 255. _CNV_A_R_LINEAR_____23_CM 0. 255. DISPLAY_IDENTIFIER C_VS_MAX_CH_IVVT FORMAT "%3.0" /end CHARACTERISTIC
/begin MEASUREMENT lv_wup "Warm up functions active" UBYTE _CNV_S_2_RANGE______21_CM 1 100. 0. 1. DISPLAY_IDENTIFIER LV_WUP ECU_ADDRESS 0x3fe796 BIT_MASK 0x1 /end MEASUREMENT
/begin CHARACTERISTIC ip_t_ch_ivvt "Activation time for CAT heating function 'VANOS'" MAP 0xffe4e652 _REC_MAP_20_u2_u1_u2 6553.5 _CNV_A_R_LINEAR_____24_CM 0. 6553.5 DISPLAY_IDENTIFIER IP_T_CH_IVVT FORMAT "%6.1"
 /begin AXIS_DESCR COM_AXIS tco _CNV_A_R_LINEAR_____11_CM 8 -48. 142.5 FORMAT "%5.1" AXIS_PTS_REF ldpm_tco_2 /end AXIS_DESCR
 /begin AXIS_DESCR COM_AXIS ctr_km_can _CNV_A_R_LINEAR_____88_CM 4 0. 655350. FORMAT "%7.0" AXIS_PTS_REF ldpm_ctr_km_can_1 /end AXIS_DESCR
/end CHARACTERISTIC
/begin CHARACTERISTIC c_vs_max_ch_tq_add_is "Threshold for final abortion of CAT heating functions 'IGA at first idle phases' and 'VANOS'" VALUE 0xffe409d6 _REC_VAL_20_u1 255. _CNV_A_R_LINEAR_____23_CM 0. 255. DISPLAY_IDENTIFIER C_VS_MAX_CH_TQ_ADD_IS FORMAT "%3.0" /end CHARACTERISTIC
/begin CHARACTERISTIC c_vs_max_ch_n_sp_is "Threshold for final abortion of CAT heating functions 'Catalyst heating increased idle speed setpoint'" VALUE 0xffe409d5 _REC_VAL_20_u1 255. _CNV_A_R_LINEAR_____23_CM 0. 255. DISPLAY_IDENTIFIER C_VS_MAX_CH_N_SP_IS FORMAT "%3.0" /end CHARACTERISTIC
/begin AXIS_PTS ldpm_tco_2 "" 0xffe48611 tco _REC_AXS_20_u1 190.5 _CNV_A_R_LINEAR_____11_CM 8 -48. 142.5 DISPLAY_IDENTIFIER LDPM_TCO_2 FORMAT "%5.1" /end AXIS_PTS
/begin CHARACTERISTIC ip_t_ch_tq_add "Activation time for CAT heating function 'IGA'" MAP 0xffe4e6d2 _REC_MAP_20_u2_u1_u2 6553.5 _CNV_A_R_LINEAR_____24_CM 0. 6553.5 DISPLAY_IDENTIFIER IP_T_CH_TQ_ADD FORMAT "%6.1"
 /begin AXIS_DESCR COM_AXIS tco _CNV_A_R_LINEAR_____11_CM 8 -48. 142.5 FORMAT "%5.1" AXIS_PTS_REF ldpm_tco_2 /end AXIS_DESCR
 /begin AXIS_DESCR COM_AXIS ctr_km_can _CNV_A_R_LINEAR_____88_CM 4 0. 655350. FORMAT "%7.0" AXIS_PTS_REF ldpm_ctr_km_can_1 /end AXIS_DESCR
/end CHARACTERISTIC
/begin CHARACTERISTIC ip_t_ch_tq_add_wout_cat "Activation time for CAT heating function 'IGA', vehicle variant without catalyst" MAP 0xffe4e792 _REC_MAP_20_u2_u1_u2 6553.5 _CNV_A_R_LINEAR_____24_CM 0. 6553.5 DISPLAY_IDENTIFIER IP_T_CH_TQ_ADD_WOUT_CAT FORMAT "%6.1"
 /begin AXIS_DESCR COM_AXIS tco _CNV_A_R_LINEAR_____11_CM 8 -48. 142.5 FORMAT "%5.1" AXIS_PTS_REF ldpm_tco_2 /end AXIS_DESCR
 /begin AXIS_DESCR COM_AXIS ctr_km_can _CNV_A_R_LINEAR_____88_CM 4 0. 655350. FORMAT "%7.0" AXIS_PTS_REF ldpm_ctr_km_can_1 /end AXIS_DESCR
/end CHARACTERISTIC
/begin CHARACTERISTIC ip_t_ch_tq_add_is "Activation time for CAT heating function 'IGA at first idle phases'" MAP 0xffe4e712 _REC_MAP_20_u2_u1_u2 6553.5 _CNV_A_R_LINEAR_____24_CM 0. 6553.5 DISPLAY_IDENTIFIER IP_T_CH_TQ_ADD_IS FORMAT "%6.1"
 /begin AXIS_DESCR COM_AXIS tco _CNV_A_R_LINEAR_____11_CM 8 -48. 142.5 FORMAT "%5.1" AXIS_PTS_REF ldpm_tco_2 /end AXIS_DESCR
 /begin AXIS_DESCR COM_AXIS ctr_km_can _CNV_A_R_LINEAR_____88_CM 4 0. 655350. FORMAT "%7.0" AXIS_PTS_REF ldpm_ctr_km_can_1 /end AXIS_DESCR
/end CHARACTERISTIC
/begin CHARACTERISTIC ip_t_ch_tq_add_is_wout_cat "Activation time for CAT heating function 'IGA at first idle phases', vehicle variant without catalyst" MAP 0xffe4e752 _REC_MAP_20_u2_u1_u2 6553.5 _CNV_A_R_LINEAR_____24_CM 0. 6553.5 DISPLAY_IDENTIFIER IP_T_CH_TQ_ADD_IS_WOUT_CAT FORMAT "%6.1"
 /begin AXIS_DESCR COM_AXIS tco _CNV_A_R_LINEAR_____11_CM 8 -48. 142.5 FORMAT "%5.1" AXIS_PTS_REF ldpm_tco_2 /end AXIS_DESCR
 /begin AXIS_DESCR COM_AXIS ctr_km_can _CNV_A_R_LINEAR_____88_CM 4 0. 655350. FORMAT "%7.0" AXIS_PTS_REF ldpm_ctr_km_can_1 /end AXIS_DESCR
/end CHARACTERISTIC
/begin MEASUREMENT lv_clc_2seg "" UBYTE _CNV_S_2_RANGE______21_CM 1 100. 0. 1. DISPLAY_IDENTIFIER LV_CLC_2SEG ECU_ADDRESS 0x3fe7a9 BIT_MASK 0x1 /end MEASUREMENT
/begin MEASUREMENT lv_clc_2seg_ena "" UBYTE _CNV_S_2_RANGE______21_CM 1 100. 0. 1. DISPLAY_IDENTIFIER LV_CLC_2SEG_ENA ECU_ADDRESS 0x3fe7a8 BIT_MASK 0x1 /end MEASUREMENT
/begin CHARACTERISTIC c_n_seg_2_ena "" VALUE 0xffe407fe _REC_VAL_20_u1 8160. _CNV_A_R_LINEAR_____15_CM 0. 8160. DISPLAY_IDENTIFIER C_N_SEG_2_ENA FORMAT "%4.0" /end CHARACTERISTIC
/begin MEASUREMENT iga_av_1[0] "Intermediate ignition angle till gradiant limitation after start is terminated" UBYTE _CNV_A_R_LINEAR_____203_CM 1 100. -35.625 60. DISPLAY_IDENTIFIER IGA_AV_1_0 ECU_ADDRESS 0x3fe7c0 FORMAT "%5.1" /end MEASUREMENT
/begin MEASUREMENT iga_av_1[1] "Intermediate ignition angle till gradiant limitation after start is terminated" UBYTE _CNV_A_R_LINEAR_____203_CM 1 100. -35.625 60. DISPLAY_IDENTIFIER IGA_AV_1_1 ECU_ADDRESS 0x3fe7c1 FORMAT "%5.1" /end MEASUREMENT
/begin MEASUREMENT iga_av_1[2] "Intermediate ignition angle till gradiant limitation after start is terminated" UBYTE _CNV_A_R_LINEAR_____203_CM 1 100. -35.625 60. DISPLAY_IDENTIFIER IGA_AV_1_2 ECU_ADDRESS 0x3fe7c2 FORMAT "%5.1" /end MEASUREMENT
/begin MEASUREMENT iga_av_1[3] "Intermediate ignition angle till gradiant limitation after start is terminated" UBYTE _CNV_A_R_LINEAR_____203_CM 1 100. -35.625 60. DISPLAY_IDENTIFIER IGA_AV_1_3 ECU_ADDRESS 0x3fe7c3 FORMAT "%5.1" /end MEASUREMENT
/begin MEASUREMENT iga_av_1[4] "Intermediate ignition angle till gradiant limitation after start is terminated" UBYTE _CNV_A_R_LINEAR_____203_CM 1 100. -35.625 60. DISPLAY_IDENTIFIER IGA_AV_1_4 ECU_ADDRESS 0x3fe7c4 FORMAT "%5.1" /end MEASUREMENT
/begin MEASUREMENT iga_av_1[5] "Intermediate ignition angle till gradiant limitation after start is terminated" UBYTE _CNV_A_R_LINEAR_____203_CM 1 100. -35.625 60. DISPLAY_IDENTIFIER IGA_AV_1_5 ECU_ADDRESS 0x3fe7c5 FORMAT "%5.1" /end MEASUREMENT
/begin MEASUREMENT iga[0] "Basic ignition angle application correction and knock control included" UBYTE _CNV_A_R_LINEAR_____203_CM 1 100. -35.625 60. DISPLAY_IDENTIFIER IGA_0 ECU_ADDRESS 0x3fe7b0 FORMAT "%5.1" /end MEASUREMENT
/begin MEASUREMENT iga[1] "Basic ignition angle application correction and knock control included" UBYTE _CNV_A_R_LINEAR_____203_CM 1 100. -35.625 60. DISPLAY_IDENTIFIER IGA_1 ECU_ADDRESS 0x3fe7b1 FORMAT "%5.1" /end MEASUREMENT
/begin MEASUREMENT iga[2] "Basic ignition angle application correction and knock control included" UBYTE _CNV_A_R_LINEAR_____203_CM 1 100. -35.625 60. DISPLAY_IDENTIFIER IGA_2 ECU_ADDRESS 0x3fe7b2 FORMAT "%5.1" /end MEASUREMENT
/begin MEASUREMENT iga[3] "Basic ignition angle application correction and knock control included" UBYTE _CNV_A_R_LINEAR_____203_CM 1 100. -35.625 60. DISPLAY_IDENTIFIER IGA_3 ECU_ADDRESS 0x3fe7b3 FORMAT "%5.1" /end MEASUREMENT
/begin MEASUREMENT iga[4] "Basic ignition angle application correction and knock control included" UBYTE _CNV_A_R_LINEAR_____203_CM 1 100. -35.625 60. DISPLAY_IDENTIFIER IGA_4 ECU_ADDRESS 0x3fe7b4 FORMAT "%5.1" /end MEASUREMENT
/begin MEASUREMENT iga[5] "Basic ignition angle application correction and knock control included" UBYTE _CNV_A_R_LINEAR_____203_CM 1 100. -35.625 60. DISPLAY_IDENTIFIER IGA_5 ECU_ADDRESS 0x3fe7b5 FORMAT "%5.1" /end MEASUREMENT
/begin MEASUREMENT iga_min "Minimum ignition Angle" UBYTE _CNV_A_R_LINEAR_____203_CM 1 100. -35.625 60. DISPLAY_IDENTIFIER IGA_MIN ECU_ADDRESS 0x3fe7bc FORMAT "%5.1" /end MEASUREMENT
/begin MEASUREMENT eff_iga_bas_cor "Ignition efficiency  basic ignition angle" UWORD _CNV_A_R_LINEAR_____20_CM 1 100. 0. 1.99996948 DISPLAY_IDENTIFIER EFF_IGA_BAS_COR ECU_ADDRESS 0x3fd884 BYTE_ORDER MSB_LAST FORMAT "%7.5" /end MEASUREMENT
/begin MEASUREMENT eff_iga_ron_98_1 "Ignition efficiency actual ignition angle" UWORD _CNV_A_R_LINEAR_____20_CM 1 100. 0. 1.99996948 DISPLAY_IDENTIFIER EFF_IGA_RON_98_1 ECU_ADDRESS 0x3fd88e BYTE_ORDER MSB_LAST FORMAT "%7.5" /end MEASUREMENT
/begin MEASUREMENT eff_iga_ron_98_2 "Ignition efficiency actual ignition angle" UWORD _CNV_A_R_LINEAR_____20_CM 1 100. 0. 1.99996948 DISPLAY_IDENTIFIER EFF_IGA_RON_98_2 ECU_ADDRESS 0x3fd892 BYTE_ORDER MSB_LAST FORMAT "%7.5" /end MEASUREMENT
/begin MEASUREMENT eff_iga_av_1 "Ignition efficiency actual ignition angle bank selective" UWORD _CNV_A_R_LINEAR_____20_CM 1 100. 0. 1.99996948 DISPLAY_IDENTIFIER EFF_IGA_AV_1 ECU_ADDRESS 0x3fd890 BYTE_ORDER MSB_LAST FORMAT "%7.5" /end MEASUREMENT
/begin MEASUREMENT eff_iga_av_2 "Ignition efficiency actual ignition angle bank selective" UWORD _CNV_A_R_LINEAR_____20_CM 1 100. 0. 1.99996948 DISPLAY_IDENTIFIER EFF_IGA_AV_2 ECU_ADDRESS 0x3fd894 BYTE_ORDER MSB_LAST FORMAT "%7.5" /end MEASUREMENT
/begin MEASUREMENT eff_iga_min "Ignition efficiency minimum ignition angle" UWORD _CNV_A_R_LINEAR_____20_CM 1 100. 0. 1.99996948 DISPLAY_IDENTIFIER EFF_IGA_MIN ECU_ADDRESS 0x3fd88a BYTE_ORDER MSB_LAST FORMAT "%7.5" /end MEASUREMENT
/begin MEASUREMENT iga_bas_cor_knk_add "Basic corrected ignition angle knock  mean value IGA_MV_ADJ_KNK included" UBYTE _CNV_A_R_LINEAR_____203_CM 1 100. -35.625 60. DISPLAY_IDENTIFIER IGA_BAS_COR_KNK_ADD ECU_ADDRESS 0x3fe7cc FORMAT "%5.1" /end MEASUREMENT
/begin MEASUREMENT iga_av_mv_1 "Mean value of actual ignition angle" UBYTE _CNV_A_R_LINEAR_____203_CM 1 100. -35.625 60. DISPLAY_IDENTIFIER IGA_AV_MV_1 ECU_ADDRESS 0x3fe7d9 FORMAT "%5.1" /end MEASUREMENT
/begin MEASUREMENT iga_av_mv_2 "Mean value of actual ignition angle" UBYTE _CNV_A_R_LINEAR_____203_CM 1 100. -35.625 60. DISPLAY_IDENTIFIER IGA_AV_MV_2 ECU_ADDRESS 0x3fe7dc FORMAT "%5.1" /end MEASUREMENT
/begin MEASUREMENT iga_dif_bas "Difference of basic ignition angle to reference ignition angle" UBYTE _CNV_A_R_LINEAR_____204_CM 1 100. 0. -95.625 DISPLAY_IDENTIFIER IGA_DIF_BAS ECU_ADDRESS 0x3fe7d1 FORMAT "%5.1" /end MEASUREMENT
/begin MEASUREMENT iga_dif_av_1 "Difference of actual ignition angle to reference ignition angle" UBYTE _CNV_A_R_LINEAR_____204_CM 1 100. 0. -95.625 DISPLAY_IDENTIFIER IGA_DIF_AV_1 ECU_ADDRESS 0x3fe7da FORMAT "%5.1" /end MEASUREMENT
/begin MEASUREMENT iga_dif_av_2 "Difference of actual ignition angle to reference ignition angle" UBYTE _CNV_A_R_LINEAR_____204_CM 1 100. 0. -95.625 DISPLAY_IDENTIFIER IGA_DIF_AV_2 ECU_ADDRESS 0x3fe7dd FORMAT "%5.1" /end MEASUREMENT
/begin MEASUREMENT iga_dif_ron_98_1 "Difference of actual ignition angle to reference ignition angle" UBYTE _CNV_A_R_LINEAR_____204_CM 1 100. 0. -95.625 DISPLAY_IDENTIFIER IGA_DIF_RON_98_1 ECU_ADDRESS 0x3fe7db FORMAT "%5.1" /end MEASUREMENT
/begin MEASUREMENT iga_dif_ron_98_2 "Difference of actual ignition angle to reference ignition angle" UBYTE _CNV_A_R_LINEAR_____204_CM 1 100. 0. -95.625 DISPLAY_IDENTIFIER IGA_DIF_RON_98_2 ECU_ADDRESS 0x3fe7de FORMAT "%5.1" /end MEASUREMENT
/begin MEASUREMENT iga_mv_knk_fil "Filtered mean knock correction" SBYTE _CNV_A_R_LINEAR_____82_CM 1 100. -48. 47.625 DISPLAY_IDENTIFIER IGA_MV_KNK_FIL ECU_ADDRESS 0x3fe7d8 FORMAT "%5.1" /end MEASUREMENT
/begin MEASUREMENT iga_bas_cor_knk_fil "Corrected basic ignition angle with mean knock correction" UBYTE _CNV_A_R_LINEAR_____203_CM 1 100. -35.625 60. DISPLAY_IDENTIFIER IGA_BAS_COR_KNK_FIL ECU_ADDRESS 0x3fe7d4 FORMAT "%5.1" /end MEASUREMENT
/begin MEASUREMENT eff_iga_bas_cor_knk_fil "Ignition efficiency referenced to IGA_BAS_COR_KNK_FIL" UWORD _CNV_A_R_LINEAR_____20_CM 1 100. 0. 1.99996948 DISPLAY_IDENTIFIER EFF_IGA_BAS_COR_KNK_FIL ECU_ADDRESS 0x3fd88c BYTE_ORDER MSB_LAST FORMAT "%7.5" /end MEASUREMENT
/begin MEASUREMENT lv_iga_grd_act "FLag for ignition angle gradient limitation out of start active" UBYTE _CNV_S_2_RANGE______2_CM 1 100. 0. 1. DISPLAY_IDENTIFIER LV_IGA_GRD_ACT ECU_ADDRESS 0x3fe7bf /end MEASUREMENT
/begin CHARACTERISTIC c_crlc_iga_knk "Correlation constant knock correction filter" VALUE 0xffe40682 _REC_VAL_20_u1 0.9960940000000002 _CNV_A_R_LINEAR_____50_CM 0. 0.996094 DISPLAY_IDENTIFIER C_CRLC_IGA_KNK FORMAT "%5.3" /end CHARACTERISTIC
/begin MEASUREMENT iga_dif_bas_knk_fil "Difference of IGA_BAS_COR_KNK_FIL to reference ignition angle" UBYTE _CNV_A_R_LINEAR_____204_CM 1 100. 0. -95.625 DISPLAY_IDENTIFIER IGA_DIF_BAS_KNK_FIL ECU_ADDRESS 0x3fe7be FORMAT "%5.1" /end MEASUREMENT
/begin CHARACTERISTIC c_cycnr_iga_es "Number of cycles for wich ignition is maintained after detection of LV_IGK = 0" VALUE 0xffe406dc _REC_VAL_20_u1 15. _CNV_A_R_LINEAR_____0_CM 0. 15. DISPLAY_IDENTIFIER C_CYCNR_IGA_ES FORMAT "%2.0" /end CHARACTERISTIC
/begin MEASUREMENT iga_igc[0] "Ignition angle applied on cylinder CYL" UBYTE _CNV_A_R_LINEAR_____203_CM 1 100. -35.625 60. DISPLAY_IDENTIFIER IGA_IGC_0 ECU_ADDRESS 0x3fe7aa FORMAT "%5.1" /end MEASUREMENT
/begin MEASUREMENT iga_igc[1] "Ignition angle applied on cylinder CYL" UBYTE _CNV_A_R_LINEAR_____203_CM 1 100. -35.625 60. DISPLAY_IDENTIFIER IGA_IGC_1 ECU_ADDRESS 0x3fe7ab FORMAT "%5.1" /end MEASUREMENT
/begin MEASUREMENT iga_igc[2] "Ignition angle applied on cylinder CYL" UBYTE _CNV_A_R_LINEAR_____203_CM 1 100. -35.625 60. DISPLAY_IDENTIFIER IGA_IGC_2 ECU_ADDRESS 0x3fe7ac FORMAT "%5.1" /end MEASUREMENT
/begin MEASUREMENT iga_igc[3] "Ignition angle applied on cylinder CYL" UBYTE _CNV_A_R_LINEAR_____203_CM 1 100. -35.625 60. DISPLAY_IDENTIFIER IGA_IGC_3 ECU_ADDRESS 0x3fe7ad FORMAT "%5.1" /end MEASUREMENT
/begin MEASUREMENT iga_igc[4] "Ignition angle applied on cylinder CYL" UBYTE _CNV_A_R_LINEAR_____203_CM 1 100. -35.625 60. DISPLAY_IDENTIFIER IGA_IGC_4 ECU_ADDRESS 0x3fe7ae FORMAT "%5.1" /end MEASUREMENT
/begin MEASUREMENT iga_igc[5] "Ignition angle applied on cylinder CYL" UBYTE _CNV_A_R_LINEAR_____203_CM 1 100. -35.625 60. DISPLAY_IDENTIFIER IGA_IGC_5 ECU_ADDRESS 0x3fe7af FORMAT "%5.1" /end MEASUREMENT
/begin MEASUREMENT iga_wout_knk[0] "actual ignition angle" UBYTE _CNV_A_R_LINEAR_____203_CM 1 100. -35.625 60. DISPLAY_IDENTIFIER IGA_WOUT_KNK_0 ECU_ADDRESS 0x3fe7b6 FORMAT "%5.1" /end MEASUREMENT
/begin MEASUREMENT iga_wout_knk[1] "actual ignition angle" UBYTE _CNV_A_R_LINEAR_____203_CM 1 100. -35.625 60. DISPLAY_IDENTIFIER IGA_WOUT_KNK_1 ECU_ADDRESS 0x3fe7b7 FORMAT "%5.1" /end MEASUREMENT
/begin MEASUREMENT iga_wout_knk[2] "actual ignition angle" UBYTE _CNV_A_R_LINEAR_____203_CM 1 100. -35.625 60. DISPLAY_IDENTIFIER IGA_WOUT_KNK_2 ECU_ADDRESS 0x3fe7b8 FORMAT "%5.1" /end MEASUREMENT
/begin MEASUREMENT iga_wout_knk[3] "actual ignition angle" UBYTE _CNV_A_R_LINEAR_____203_CM 1 100. -35.625 60. DISPLAY_IDENTIFIER IGA_WOUT_KNK_3 ECU_ADDRESS 0x3fe7b9 FORMAT "%5.1" /end MEASUREMENT
/begin MEASUREMENT iga_wout_knk[4] "actual ignition angle" UBYTE _CNV_A_R_LINEAR_____203_CM 1 100. -35.625 60. DISPLAY_IDENTIFIER IGA_WOUT_KNK_4 ECU_ADDRESS 0x3fe7ba FORMAT "%5.1" /end MEASUREMENT
/begin MEASUREMENT iga_wout_knk[5] "actual ignition angle" UBYTE _CNV_A_R_LINEAR_____203_CM 1 100. -35.625 60. DISPLAY_IDENTIFIER IGA_WOUT_KNK_5 ECU_ADDRESS 0x3fe7bb FORMAT "%5.1" /end MEASUREMENT
/begin CHARACTERISTIC lc_iga_st_ena "Logical constant for seperated start ignition angle" VALUE 0xffe40f6d _REC_VAL_20_u1 1. _CNV_A_R_LINEAR_____22_CM 0. 1. DISPLAY_IDENTIFIER LC_IGA_ST_ENA FORMAT "%1.0" /end CHARACTERISTIC
/begin CHARACTERISTIC lc_inh_iga_tra_knk_eff "Logical constant to exclude IGA_TRA_KNK from efficiency calculation" VALUE 0xffe40f7c _REC_VAL_20_u1 1. _CNV_A_R_LINEAR_____22_CM 0. 1. DISPLAY_IDENTIFIER LC_INH_IGA_TRA_KNK_EFF FORMAT "%1.0" /end CHARACTERISTIC
/begin CHARACTERISTIC ip_iga_lgrd_ast "Gradient limitation IGA after start phase" CURVE 0xffe40cbd _REC_CUR_20_u1_u1 95.625 _CNV_A_R_LINEAR_____82_CM 0. 95.625 DISPLAY_IDENTIFIER IP_IGA_LGRD_AST FORMAT "%5.2"
 /begin AXIS_DESCR COM_AXIS tco _CNV_A_R_LINEAR_____11_CM 8 -48. 142.5 FORMAT "%5.1" AXIS_PTS_REF ldpm_tco_1_igsp /end AXIS_DESCR
/end CHARACTERISTIC
/begin MEASUREMENT eff_iga_av "Ignition efficiency actual ignition angle" UWORD _CNV_A_R_LINEAR_____20_CM 1 100. 0. 1.99996948 DISPLAY_IDENTIFIER EFF_IGA_AV ECU_ADDRESS 0x3fd886 BYTE_ORDER MSB_LAST FORMAT "%7.5" /end MEASUREMENT
/begin MEASUREMENT eff_iga_av_can "Ignition efficiency actual ignition angle for CAN" UWORD _CNV_A_R_LINEAR_____20_CM 1 100. 0. 1.99996948 DISPLAY_IDENTIFIER EFF_IGA_AV_CAN ECU_ADDRESS 0x3fd888 BYTE_ORDER MSB_LAST FORMAT "%7.5" /end MEASUREMENT
/begin MEASUREMENT iga_sp_max_1 "Maximum ignition angle depending on torque intervention" UBYTE _CNV_A_R_LINEAR_____203_CM 1 100. -35.625 60. DISPLAY_IDENTIFIER IGA_SP_MAX_1 ECU_ADDRESS 0x3fe7cd FORMAT "%5.1" /end MEASUREMENT
/begin MEASUREMENT iga_sp_max_1_can "Maximum ignition angle depending on torque intervention" UBYTE _CNV_A_R_LINEAR_____203_CM 1 100. -35.625 60. DISPLAY_IDENTIFIER IGA_SP_MAX_1_CAN ECU_ADDRESS 0x3fe7ce FORMAT "%5.1" /end MEASUREMENT
/begin MEASUREMENT iga_av_mv "Mean value of actual ignition angle" UBYTE _CNV_A_R_LINEAR_____203_CM 1 100. -35.625 60. DISPLAY_IDENTIFIER IGA_AV_MV ECU_ADDRESS 0x3fe7bd FORMAT "%5.1" /end MEASUREMENT
/begin MEASUREMENT iga_av_mv_can "Mean value of actual ignition angle" UBYTE _CNV_A_R_LINEAR_____203_CM 1 100. -35.625 60. DISPLAY_IDENTIFIER IGA_AV_MV_CAN ECU_ADDRESS 0x3fe7d0 FORMAT "%5.1" /end MEASUREMENT
/begin MEASUREMENT iga_dif_av "Difference of actual ignition angle to reference ignition angle" UBYTE _CNV_A_R_LINEAR_____204_CM 1 100. 0. -95.625 DISPLAY_IDENTIFIER IGA_DIF_AV ECU_ADDRESS 0x3fe7d2 FORMAT "%5.1" /end MEASUREMENT
/begin MEASUREMENT iga_dif_av_can "Difference of actual ignition angle to reference ignition angle for CAN" UBYTE _CNV_A_R_LINEAR_____204_CM 1 100. 0. -95.625 DISPLAY_IDENTIFIER IGA_DIF_AV_CAN ECU_ADDRESS 0x3fe7d3 FORMAT "%5.1" /end MEASUREMENT
/begin CHARACTERISTIC c_iga_ini "Init value for ignition angle" VALUE 0xffe40770 _REC_VAL_20_u1 95.625 _CNV_A_R_LINEAR_____203_CM -35.625 60. DISPLAY_IDENTIFIER C_IGA_INI FORMAT "%5.1" /end CHARACTERISTIC
/begin CHARACTERISTIC lc_iga_man "Logical constant for stratified mode" VALUE 0xffe40f6c _REC_VAL_20_u1 1. _CNV_A_R_LINEAR_____22_CM 0. 1. DISPLAY_IDENTIFIER LC_IGA_MAN FORMAT "%1.0" /end CHARACTERISTIC
/begin CHARACTERISTIC c_iga_as "Spark retard by application system global" VALUE 0xffe40386 _REC_VAL_20_s1 95.625 _CNV_A_R_LINEAR_____82_CM -48. 47.625 DISPLAY_IDENTIFIER C_IGA_AS FORMAT "%5.1" /end CHARACTERISTIC
/begin CHARACTERISTIC c_iga_man "Constant for stratified mode" VALUE 0xffe40771 _REC_VAL_20_u1 95.625 _CNV_A_R_LINEAR_____203_CM -35.625 60. DISPLAY_IDENTIFIER C_IGA_MAN FORMAT "%5.1" /end CHARACTERISTIC
/begin CHARACTERISTIC c_iga_as_cyl[0] "Spark retard by application system cyl. 0" VALUE 0xffe40387 _REC_VAL_20_s1 4.78125 _CNV_A_R_LINEAR_____82_CM -48. 47.625 DISPLAY_IDENTIFIER C_IGA_AS_CYL_0 FORMAT "%5.1" /end CHARACTERISTIC
/begin CHARACTERISTIC c_iga_as_cyl[1] "Spark retard by application system cyl. 1" VALUE 0xffe40388 _REC_VAL_20_s1 4.78125 _CNV_A_R_LINEAR_____82_CM -48. 47.625 DISPLAY_IDENTIFIER C_IGA_AS_CYL_1 FORMAT "%5.1" /end CHARACTERISTIC
/begin CHARACTERISTIC c_iga_as_cyl[2] "Spark retard by application system cyl. 2" VALUE 0xffe40389 _REC_VAL_20_s1 4.78125 _CNV_A_R_LINEAR_____82_CM -48. 47.625 DISPLAY_IDENTIFIER C_IGA_AS_CYL_2 FORMAT "%5.1" /end CHARACTERISTIC
/begin CHARACTERISTIC c_iga_as_cyl[3] "Spark retard by application system cyl. 3" VALUE 0xffe4038a _REC_VAL_20_s1 4.78125 _CNV_A_R_LINEAR_____82_CM -48. 47.625 DISPLAY_IDENTIFIER C_IGA_AS_CYL_3 FORMAT "%5.1" /end CHARACTERISTIC
/begin CHARACTERISTIC c_iga_as_cyl[4] "Spark retard by application system cyl. 4" VALUE 0xffe4038b _REC_VAL_20_s1 4.78125 _CNV_A_R_LINEAR_____82_CM -48. 47.625 DISPLAY_IDENTIFIER C_IGA_AS_CYL_4 FORMAT "%5.1" /end CHARACTERISTIC
/begin CHARACTERISTIC c_iga_as_cyl[5] "Spark retard by application system cyl. 5" VALUE 0xffe4038c _REC_VAL_20_s1 4.78125 _CNV_A_R_LINEAR_____82_CM -48. 47.625 DISPLAY_IDENTIFIER C_IGA_AS_CYL_5 FORMAT "%5.1" /end CHARACTERISTIC
/begin CHARACTERISTIC ipm_eff_iga__iga_dif "Basic Ignition Efficiency" CURVE 0xffe5091a _REC_CUR_20_u2_u1 1.99996948 _CNV_A_R_LINEAR_____20_CM 0. 1.99996948 DISPLAY_IDENTIFIER IPM_EFF_IGA__IGA_DIF FORMAT "%7.5"
 /begin AXIS_DESCR COM_AXIS iga_dif_min _CNV_A_R_LINEAR_____204_CM 16 0. -95.625 FORMAT "%5.1" AXIS_PTS_REF ldp_iga_dif_eff_iga /end AXIS_DESCR
/end CHARACTERISTIC
/begin AXIS_PTS ldp_iga_dif_eff_iga "" 0xffe47f8d iga_dif_min _REC_AXS_20_u1 -95.625 _CNV_A_R_LINEAR_____204_CM 16 0. -95.625 DISPLAY_IDENTIFIER LDP_IGA_DIF_EFF_IGA FORMAT "%5.1" /end AXIS_PTS
/begin AXIS_PTS ldpm_tco_1_igsp "" 0xffe485ff tco _REC_AXS_20_u1 190.5 _CNV_A_R_LINEAR_____11_CM 8 -48. 142.5 DISPLAY_IDENTIFIER LDPM_TCO_1_IGSP FORMAT "%5.1" /end AXIS_PTS
/begin CHARACTERISTIC c_iga_min_etc_lih "Absolute possible spark retard at ETC_LIH" VALUE 0xffe40774 _REC_VAL_20_u1 95.625 _CNV_A_R_LINEAR_____203_CM -35.625 60. DISPLAY_IDENTIFIER C_IGA_MIN_ETC_LIH FORMAT "%5.1" /end CHARACTERISTIC
/begin MEASUREMENT iga_bas_cor "Corrected basic ignition angle" UBYTE _CNV_A_R_LINEAR_____203_CM 1 100. -35.625 60. DISPLAY_IDENTIFIER IGA_BAS_COR ECU_ADDRESS 0x3fe7e1 FORMAT "%5.1" /end MEASUREMENT
/begin MEASUREMENT iga_bas_ivvt "basic ignition angle including influences of IVVT" UBYTE _CNV_A_R_LINEAR_____203_CM 1 100. -35.625 60. DISPLAY_IDENTIFIER IGA_BAS_IVVT ECU_ADDRESS 0x3fe7e2 FORMAT "%5.1" /end MEASUREMENT
/begin MEASUREMENT iga_bas_lamb_cor "additive LAMBDA correction of IGA_BAS_IVVT" SBYTE _CNV_A_R_LINEAR_____82_CM 1 100. -48. 47.625 DISPLAY_IDENTIFIER IGA_BAS_LAMB_COR ECU_ADDRESS 0x3fe7e5 FORMAT "%5.1" /end MEASUREMENT
/begin MEASUREMENT iga_bas_ivvt_ofs "additive basic ignition angle of influences of valve overlap" UBYTE _CNV_A_R_LINEAR_____203_CM 1 100. -35.625 60. DISPLAY_IDENTIFIER IGA_BAS_IVVT_OFS ECU_ADDRESS 0x3fe7e3 FORMAT "%5.1" /end MEASUREMENT
/begin MEASUREMENT iga_bas_ron "basic ignition angle of RON factor" UBYTE _CNV_A_R_LINEAR_____203_CM 1 100. -35.625 60. DISPLAY_IDENTIFIER IGA_BAS_RON ECU_ADDRESS 0x3fe7e4 FORMAT "%5.1" /end MEASUREMENT
/begin CHARACTERISTIC c_iga_bas_add_max "IGA max offset (VANOS)" VALUE 0xffe40769 _REC_VAL_20_u1 95.625 _CNV_A_R_LINEAR_____203_CM -35.625 60. DISPLAY_IDENTIFIER C_IGA_BAS_ADD_MAX FORMAT "%5.1" /end CHARACTERISTIC
/begin CHARACTERISTIC c_iga_bas_add_min "IGA min offset (VANOS)" VALUE 0xffe4076a _REC_VAL_20_u1 95.625 _CNV_A_R_LINEAR_____203_CM -35.625 60. DISPLAY_IDENTIFIER C_IGA_BAS_ADD_MIN FORMAT "%5.1" /end CHARACTERISTIC
/begin CHARACTERISTIC ip_iga_bas_ron_91__n__maf "Basic ignition angle for RON 91" MAP 0xffe4605c _REC_MAP_20_u1_u2_u2 95.625 _CNV_A_R_LINEAR_____203_CM -35.625 60. DISPLAY_IDENTIFIER IP_IGA_BAS_RON_91__N__MAF FORMAT "%5.1"
 /begin AXIS_DESCR COM_AXIS n _CNV_A_R_LINEAR_____10_CM 20 0. 8160. FORMAT "%4.0" AXIS_PTS_REF ldpm_n_14 /end AXIS_DESCR
 /begin AXIS_DESCR COM_AXIS maf _CNV_A_R_LINEAR_____108_CM 16 0. 1389. FORMAT "%7.2" AXIS_PTS_REF ldpm_maf_2 /end AXIS_DESCR
/end CHARACTERISTIC
/begin CHARACTERISTIC ip_iga_bas_add_max_ivvt__n__maf "Basic ignition angle offset VO max" MAP 0xffe45d9c _REC_MAP_20_u1_u2_u2 95.625 _CNV_A_R_LINEAR_____203_CM -35.625 60. DISPLAY_IDENTIFIER IP_IGA_BAS_ADD_MAX__IVVT__N__MAF FORMAT "%5.1"
 /begin AXIS_DESCR COM_AXIS n _CNV_A_R_LINEAR_____10_CM 20 0. 8160. FORMAT "%4.0" AXIS_PTS_REF ldpm_n_14 /end AXIS_DESCR
 /begin AXIS_DESCR COM_AXIS maf _CNV_A_R_LINEAR_____108_CM 16 0. 1389. FORMAT "%7.2" AXIS_PTS_REF ldpm_maf_2 /end AXIS_DESCR
/end CHARACTERISTIC
/begin CHARACTERISTIC ip_iga_bas_add_min_ivvt__n__maf "Basic ignition offset VO min" MAP 0xffe45edc _REC_MAP_20_u1_u2_u2 95.625 _CNV_A_R_LINEAR_____203_CM -35.625 60. DISPLAY_IDENTIFIER IP_IGA_BAS_ADD_MIN__IVVT__N__MAF FORMAT "%5.1"
 /begin AXIS_DESCR COM_AXIS n _CNV_A_R_LINEAR_____10_CM 20 0. 8160. FORMAT "%4.0" AXIS_PTS_REF ldpm_n_14 /end AXIS_DESCR
 /begin AXIS_DESCR COM_AXIS maf _CNV_A_R_LINEAR_____108_CM 16 0. 1389. FORMAT "%7.2" AXIS_PTS_REF ldpm_maf_2 /end AXIS_DESCR
/end CHARACTERISTIC
/begin CHARACTERISTIC ip_iga_bas_lamb__lamb_sp "additive lambda setpoint correction of IGA_BAS" CURVE 0xffe40c7d _REC_CUR_20_u1_u2 4.78125 _CNV_A_R_LINEAR_____205_CM -48. 47.625 DISPLAY_IDENTIFIER IP_IGA_BAS_LAMB_LAMB_SP FORMAT "%5.1"
 /begin AXIS_DESCR COM_AXIS lamb_sp _CNV_A_R_LINEAR_____206_CM 8 0. 31.99902344 FORMAT "%7.4" AXIS_PTS_REF ldp_lamb_sp__iga_bas_lamb /end AXIS_DESCR
/end CHARACTERISTIC
/begin CHARACTERISTIC ip_iga_bas__n__maf "Basic ignition angle IVVT passive" MAP 0xffe45c5c _REC_MAP_20_u1_u2_u2 95.625 _CNV_A_R_LINEAR_____203_CM -35.625 60. DISPLAY_IDENTIFIER IP_IGA_BAS__N__MAF FORMAT "%5.1"
 /begin AXIS_DESCR COM_AXIS n _CNV_A_R_LINEAR_____10_CM 20 0. 8160. FORMAT "%4.0" AXIS_PTS_REF ldpm_n_14 /end AXIS_DESCR
 /begin AXIS_DESCR COM_AXIS maf _CNV_A_R_LINEAR_____108_CM 16 0. 1389. FORMAT "%7.2" AXIS_PTS_REF ldpm_maf_2 /end AXIS_DESCR
/end CHARACTERISTIC
/begin AXIS_PTS ldp_lamb_sp__iga_bas_lamb "" 0xffe50c8e lamb_sp _REC_AXS_20_u2 31.99902344 _CNV_A_R_LINEAR_____206_CM 8 0. 31.99902344 DISPLAY_IDENTIFIER LDP_LAMB_SP__IGA_BAS_LAMB FORMAT "%7.4" /end AXIS_PTS
/begin CHARACTERISTIC ip_iga_bas_ron_98__n__maf "Basic ignition angle for RON 98" MAP 0xffe4619c _REC_MAP_20_u1_u2_u2 95.625 _CNV_A_R_LINEAR_____203_CM -35.625 60. DISPLAY_IDENTIFIER IP_IGA_BAS_RON_98__N__MAF FORMAT "%5.1"
 /begin AXIS_DESCR COM_AXIS n _CNV_A_R_LINEAR_____10_CM 20 0. 8160. FORMAT "%4.0" AXIS_PTS_REF ldpm_n_14 /end AXIS_DESCR
 /begin AXIS_DESCR COM_AXIS maf _CNV_A_R_LINEAR_____108_CM 16 0. 1389. FORMAT "%7.2" AXIS_PTS_REF ldpm_maf_2 /end AXIS_DESCR
/end CHARACTERISTIC
/begin AXIS_PTS ldpm_n_14 "" 0xffe51a5e n _REC_AXS_20_u2 8160. _CNV_A_R_LINEAR_____10_CM 20 0. 8160. DISPLAY_IDENTIFIER LDPM_N_14 FORMAT "%4.0" /end AXIS_PTS
/begin AXIS_PTS ldpm_maf_2 "" 0xffe518ea maf _REC_AXS_20_u2 69.45 _CNV_A_R_LINEAR_____108_CM 16 0. 1389. DISPLAY_IDENTIFIER LDPM_MAF_2 FORMAT "%7.2" /end AXIS_PTS
/begin MEASUREMENT iga_dif_min "Difference of minimum ignition angle to reference ignition angle" UBYTE _CNV_A_R_LINEAR_____204_CM 1 100. 0. -95.625 DISPLAY_IDENTIFIER IGA_DIF_MIN ECU_ADDRESS 0x3fe7fa FORMAT "%5.1" /end MEASUREMENT
/begin MEASUREMENT iga_dif_min_delta "Extra retard on IGA_DIF_MIN in case of torque intervention" UBYTE _CNV_A_R_LINEAR_____204_CM 1 100. 0. -95.625 DISPLAY_IDENTIFIER IGA_DIF_MIN_DELTA ECU_ADDRESS 0x3fe7fb FORMAT "%5.1" /end MEASUREMENT
/begin MEASUREMENT lv_iga_dif_min_delta_act "Flag to enable and declare the acting of the extra retard on IGA_DIF_MIN" UBYTE _CNV_S_2_RANGE______2_CM 1 100. 0. 1. DISPLAY_IDENTIFIER LV_IGA_DIF_MIN_DELTA_ACT ECU_ADDRESS 0x3fe80a /end MEASUREMENT
/begin MEASUREMENT iga_dif_min_ast "Intermediate variable: correction on IGA_DIF_MIN for combustion cycles after start management" SBYTE _CNV_A_R_LINEAR_____82_CM 1 100. -48. 47.625 DISPLAY_IDENTIFIER IGA_DIF_MIN_AST ECU_ADDRESS 0x3fe7fc FORMAT "%5.1" /end MEASUREMENT
/begin CHARACTERISTIC c_iga_dif_min_delta_temp_ena "Maintaining time of extra retard on IGA_DIF_MIN" VALUE 0xffe4076e _REC_VAL_20_u1 2.55 _CNV_A_R_LINEAR_____4_CM 0. 2.55 DISPLAY_IDENTIFIER C_IGA_DIF_MIN_DELTA_TEMP_ENA FORMAT "%4.2" /end CHARACTERISTIC
/begin CHARACTERISTIC c_iga_dif_min_delta_lgrd "Step gradient limitation after extra spark retard on IGA_DIF_MIN" VALUE 0xffe4076c _REC_VAL_20_u1 -95.625 _CNV_A_R_LINEAR_____204_CM 0. -95.625 DISPLAY_IDENTIFIER C_IGA_DIF_MIN_DELTA_LGRD FORMAT "%5.1" /end CHARACTERISTIC
/begin CHARACTERISTIC ip_iga_dif_min_tco "TCO correction for minimum ignition angle" CURVE 0xffe40ca5 _REC_CUR_20_u1_u1 95.625 _CNV_A_R_LINEAR_____205_CM -48. 47.625 DISPLAY_IDENTIFIER IP_IGA_DIF_MIN_TCO FORMAT "%5.1"
 /begin AXIS_DESCR COM_AXIS tco _CNV_A_R_LINEAR_____11_CM 8 -48. 142.5 FORMAT "%5.1" AXIS_PTS_REF ldpm_tco_1_igsp /end AXIS_DESCR
/end CHARACTERISTIC
/begin CHARACTERISTIC ip_iga_dif_min_delta "Extra spark retard on minimum ignition angle in case of torque intervention" MAP 0xffe464e0 _REC_MAP_20_u1_u1_u1 -95.625 _CNV_A_R_LINEAR_____204_CM 0. -95.625 DISPLAY_IDENTIFIER IP_IGA_DIF_MIN_DELTA FORMAT "%5.1"
 /begin AXIS_DESCR COM_AXIS n_32 _CNV_A_R_LINEAR_____15_CM 8 0. 8160. FORMAT "%4.0" AXIS_PTS_REF ldpm_n_32_2_igsp /end AXIS_DESCR
 /begin AXIS_DESCR COM_AXIS maf _CNV_A_R_LINEAR_____27_CM 6 0. 1389. FORMAT "%4.0" AXIS_PTS_REF ldpm_maf_hb_2_igsp /end AXIS_DESCR
/end CHARACTERISTIC
/begin CHARACTERISTIC c_iga_dif_min_delta_temp_dis "Disable time of extra spark retard on IGA_DIF_MIN after end of gradient return" VALUE 0xffe4076d _REC_VAL_20_u1 2.55 _CNV_A_R_LINEAR_____4_CM 0. 2.55 DISPLAY_IDENTIFIER C_IGA_DIF_MIN_DELTA_TEMP_DIS FORMAT "%4.2" /end CHARACTERISTIC
/begin AXIS_PTS ldpm_cyc_cast_ip_iga_dif_min "" 0xffe517d4 cyc_cast _REC_AXS_20_u2 65535. _CNV_A_R_LINEAR_____0_CM 8 0. 65535. DISPLAY_IDENTIFIER LDPM_CYC_CAST_IP_IGA_DIF_MIN FORMAT "%5.0" /end AXIS_PTS
/begin AXIS_PTS ldpm_n_32_2_igsp "" 0xffe484a1 n_32 _REC_AXS_20_u1 8160. _CNV_A_R_LINEAR_____15_CM 8 0. 8160. DISPLAY_IDENTIFIER LDPM_N_32_2_IGSP FORMAT "%4.0" /end AXIS_PTS
/begin AXIS_PTS ldpm_maf_hb_2_igsp "" 0xffe4136b maf _REC_AXS_20_u1 1389. _CNV_A_R_LINEAR_____27_CM 6 0. 1389. DISPLAY_IDENTIFIER LDPM_MAF_HB_2_IGSP FORMAT "%4.0" /end AXIS_PTS
/begin CHARACTERISTIC ip_iga_dif_min_cyc_mt "Correction on minimum ignition angle for combustion cycles after start for automatic transmission" MAP 0xffe464a0 _REC_MAP_20_u1_u2_u1 95.625 _CNV_A_R_LINEAR_____205_CM -48. 47.625 DISPLAY_IDENTIFIER IP_IGA_DIF_MIN_CYC_MT FORMAT "%5.1"
 /begin AXIS_DESCR COM_AXIS cyc_cast _CNV_A_R_LINEAR_____0_CM 8 0. 65535. FORMAT "%5.0" AXIS_PTS_REF ldpm_cyc_cast_ip_iga_dif_min /end AXIS_DESCR
 /begin AXIS_DESCR COM_AXIS tco _CNV_A_R_LINEAR_____11_CM 8 -48. 142.5 FORMAT "%5.1" AXIS_PTS_REF ldpm_tco_1_igsp /end AXIS_DESCR
/end CHARACTERISTIC
/begin CHARACTERISTIC ip_iga_dif_min_cyc_at "Correction on minimum ignition angle for combustion cycles after start for manual transmission" MAP 0xffe46460 _REC_MAP_20_u1_u2_u1 95.625 _CNV_A_R_LINEAR_____205_CM -48. 47.625 DISPLAY_IDENTIFIER IP_IGA_DIF_MIN_CYC_AT FORMAT "%5.1"
 /begin AXIS_DESCR COM_AXIS cyc_cast _CNV_A_R_LINEAR_____0_CM 8 0. 65535. FORMAT "%5.0" AXIS_PTS_REF ldpm_cyc_cast_ip_iga_dif_min /end AXIS_DESCR
 /begin AXIS_DESCR COM_AXIS tco _CNV_A_R_LINEAR_____11_CM 8 -48. 142.5 FORMAT "%5.1" AXIS_PTS_REF ldpm_tco_1_igsp /end AXIS_DESCR
/end CHARACTERISTIC
/begin AXIS_PTS ldp_amp_ip_iga_dif_min_cyc_amp "" 0xffe509b4 amp _REC_AXS_20_u2 5434. _CNV_A_R_LINEAR_____49_CM 6 0. 5434. DISPLAY_IDENTIFIER LDP_AMP_IP_IGA_DIF_MIN_CYC_AMP FORMAT "%7.2" /end AXIS_PTS
/begin CHARACTERISTIC ip_iga_dif_min_cyc_amp_at "Attitude correction on minimum ignition angle for after start for automatic transmission" MAP 0xffe46400 _REC_MAP_20_u1_u2_u1 95.625 _CNV_A_R_LINEAR_____205_CM -48. 47.625 DISPLAY_IDENTIFIER IP_IGA_DIF_MIN_CYC_AMP_AT FORMAT "%5.1"
 /begin AXIS_DESCR COM_AXIS amp _CNV_A_R_LINEAR_____49_CM 6 0. 5434. FORMAT "%7.2" AXIS_PTS_REF ldp_amp_ip_iga_dif_min_cyc_amp /end AXIS_DESCR
 /begin AXIS_DESCR COM_AXIS tco _CNV_A_R_LINEAR_____11_CM 8 -48. 142.5 FORMAT "%5.1" AXIS_PTS_REF ldpm_tco_1_igsp /end AXIS_DESCR
/end CHARACTERISTIC
/begin CHARACTERISTIC ip_iga_dif_min_cyc_amp_mt "Attitude correction on minimum ignition angle for after start for manual transmission" MAP 0xffe46430 _REC_MAP_20_u1_u2_u1 95.625 _CNV_A_R_LINEAR_____205_CM -48. 47.625 DISPLAY_IDENTIFIER IP_IGA_DIF_MIN_CYC_AMP_MT FORMAT "%5.1"
 /begin AXIS_DESCR COM_AXIS amp _CNV_A_R_LINEAR_____49_CM 6 0. 5434. FORMAT "%7.2" AXIS_PTS_REF ldp_amp_ip_iga_dif_min_cyc_amp /end AXIS_DESCR
 /begin AXIS_DESCR COM_AXIS tco _CNV_A_R_LINEAR_____11_CM 8 -48. 142.5 FORMAT "%5.1" AXIS_PTS_REF ldpm_tco_1_igsp /end AXIS_DESCR
/end CHARACTERISTIC
/begin MEASUREMENT lv_iga_min_ext "Flag to enable external IGA_MIN" UBYTE _CNV_S_2_RANGE______2_CM 1 100. 0. 1. DISPLAY_IDENTIFIER LV_IGA_MIN_EXT ECU_ADDRESS 0x3fe80c /end MEASUREMENT
/begin MEASUREMENT iga_min_bas "Basic minimum ignition angle" UBYTE _CNV_A_R_LINEAR_____203_CM 1 100. -35.625 60. DISPLAY_IDENTIFIER IGA_MIN_BAS ECU_ADDRESS 0x3fe7fd FORMAT "%5.1" /end MEASUREMENT
/begin MEASUREMENT iga_min_bas_1 "Intermediate value: Basic minimum ignition angle" UBYTE _CNV_A_R_LINEAR_____203_CM 1 100. -35.625 60. DISPLAY_IDENTIFIER IGA_MIN_BAS_1 ECU_ADDRESS 0x3fe7fe FORMAT "%5.1" /end MEASUREMENT
/begin MEASUREMENT iga_min_bas_ext "Intermediate value: Basic minimum ignition angle" UBYTE _CNV_A_R_LINEAR_____203_CM 1 100. -35.625 60. DISPLAY_IDENTIFIER IGA_MIN_BAS_EXT ECU_ADDRESS 0x3fe800 FORMAT "%5.1" /end MEASUREMENT
/begin MEASUREMENT iga_min_bas_int "Intermediate value: Basic minimum ignition angle" UBYTE _CNV_A_R_LINEAR_____203_CM 1 100. -35.625 60. DISPLAY_IDENTIFIER IGA_MIN_BAS_INT ECU_ADDRESS 0x3fe802 FORMAT "%5.1" /end MEASUREMENT
/begin CHARACTERISTIC ip_iga_min_n_maf_ext "Basic minimum ignition angle difference value" MAP 0xffe46560 _REC_MAP_20_u1_u1_u1 95.625 _CNV_A_R_LINEAR_____203_CM -35.625 60. DISPLAY_IDENTIFIER IP_IGA_MIN_N_MAF_EXT FORMAT "%5.1"
 /begin AXIS_DESCR COM_AXIS n_32 _CNV_A_R_LINEAR_____15_CM 8 0. 8160. FORMAT "%4.0" AXIS_PTS_REF ldpm_n_32_2_igsp /end AXIS_DESCR
 /begin AXIS_DESCR COM_AXIS maf _CNV_A_R_LINEAR_____27_CM 6 0. 1389. FORMAT "%4.0" AXIS_PTS_REF ldpm_maf_hb_2_igsp /end AXIS_DESCR
/end CHARACTERISTIC
/begin CHARACTERISTIC ip_iga_dif_min_tco_ext "TCO correction for minimum ignition angle" CURVE 0xffe40cad _REC_CUR_20_u1_u1 95.625 _CNV_A_R_LINEAR_____205_CM -48. 47.625 DISPLAY_IDENTIFIER IP_IGA_DIF_MIN_TCO_EXT FORMAT "%5.1"
 /begin AXIS_DESCR COM_AXIS tco _CNV_A_R_LINEAR_____11_CM 8 -48. 142.5 FORMAT "%5.1" AXIS_PTS_REF ldpm_tco_1_igsp /end AXIS_DESCR
/end CHARACTERISTIC
/begin CHARACTERISTIC ip_iga_min_n_maf "Basic minimum ignition angle difference value" MAP 0xffe46530 _REC_MAP_20_u1_u1_u1 95.625 _CNV_A_R_LINEAR_____203_CM -35.625 60. DISPLAY_IDENTIFIER IP_IGA_MIN_N_MAF FORMAT "%5.1"
 /begin AXIS_DESCR COM_AXIS n_32 _CNV_A_R_LINEAR_____15_CM 8 0. 8160. FORMAT "%4.0" AXIS_PTS_REF ldpm_n_32_2_igsp /end AXIS_DESCR
 /begin AXIS_DESCR COM_AXIS maf _CNV_A_R_LINEAR_____27_CM 6 0. 1389. FORMAT "%4.0" AXIS_PTS_REF ldpm_maf_hb_2_igsp /end AXIS_DESCR
/end CHARACTERISTIC
/begin CHARACTERISTIC ip_fac_iga_min_tco_ext "Scaling TCO correction for minimum ignition angle" MAP 0xffe45232 _REC_MAP_20_u1_u1_u1 0.9960940000000002 _CNV_A_R_LINEAR_____50_CM 0. 0.996094 DISPLAY_IDENTIFIER IP_FAC_IGA_MIN_TCO_EXT FORMAT "%5.3"
 /begin AXIS_DESCR COM_AXIS n_32 _CNV_A_R_LINEAR_____15_CM 8 0. 8160. FORMAT "%4.0" AXIS_PTS_REF ldpm_n_32_2_igsp /end AXIS_DESCR
 /begin AXIS_DESCR COM_AXIS maf _CNV_A_R_LINEAR_____27_CM 6 0. 1389. FORMAT "%4.0" AXIS_PTS_REF ldpm_maf_hb_2_igsp /end AXIS_DESCR
/end CHARACTERISTIC
/begin CHARACTERISTIC ip_fac_iga_dif_ast "Scaling N_DIF correction for minimum ignition angle after start" CURVE 0xffe40b7a _REC_CUR_20_u1_u2 1.9921875 _CNV_A_R_LINEAR_____117_CM 0. 1.9921875 DISPLAY_IDENTIFIER IP_FAC_IGA_DIF_AST FORMAT "%5.3"
 /begin AXIS_DESCR COM_AXIS n_dif _CNV_A_R_LINEAR_____207_CM 8 -32768. 32767. FORMAT "%6.0" AXIS_PTS_REF ldpm_n_dif_igsp /end AXIS_DESCR
/end CHARACTERISTIC
/begin CHARACTERISTIC ip_t_iga_min_puc "Scaling N_32 correction for minimum ignition angle after start" CURVE 0xffe40e2c _REC_CUR_20_u1_u1 2.55 _CNV_A_R_LINEAR_____4_CM 0. 2.55 DISPLAY_IDENTIFIER IP_T_IGA_MIN_PUC FORMAT "%4.2"
 /begin AXIS_DESCR COM_AXIS n_32 _CNV_A_R_LINEAR_____15_CM 8 0. 8160. FORMAT "%4.0" AXIS_PTS_REF ldpm_n_32_2_igsp /end AXIS_DESCR
/end CHARACTERISTIC
/begin CHARACTERISTIC c_iga_dif_min_bas_lgrd "Step gradient limitation" VALUE 0xffe4076b _REC_VAL_20_u1 95.625 _CNV_A_R_LINEAR_____82_CM 0. 95.625 DISPLAY_IDENTIFIER C_IGA_DIF_MIN_BAS_LGRD FORMAT "%5.2" /end CHARACTERISTIC
/begin CHARACTERISTIC c_iga_min_puc_lgrd "Step gradient limitation" VALUE 0xffe40775 _REC_VAL_20_u1 95.625 _CNV_A_R_LINEAR_____82_CM 0. 95.625 DISPLAY_IDENTIFIER C_IGA_MIN_PUC_LGRD FORMAT "%5.2" /end CHARACTERISTIC
/begin MEASUREMENT iga_min_bas_puc "Intermediate value: Basic minimum ignition angle" UBYTE _CNV_A_R_LINEAR_____203_CM 1 100. -35.625 60. DISPLAY_IDENTIFIER IGA_MIN_BAS_PUC ECU_ADDRESS 0x3fe801 FORMAT "%5.1" /end MEASUREMENT
/begin MEASUREMENT iga_min_bas_pu "Intermediate value: PU minimum ignition angle" UBYTE _CNV_A_R_LINEAR_____203_CM 1 100. -35.625 60. DISPLAY_IDENTIFIER IGA_MIN_BAS_PU ECU_ADDRESS 0x3fe7ff FORMAT "%5.1" /end MEASUREMENT
/begin CHARACTERISTIC ip_fac_iga_min_tco_pu "Scaling TCO correction for minimum ignition angle" MAP 0xffe45262 _REC_MAP_20_u1_u1_u1 0.9960940000000002 _CNV_A_R_LINEAR_____50_CM 0. 0.996094 DISPLAY_IDENTIFIER IP_FAC_IGA_MIN_TCO_PU FORMAT "%5.3"
 /begin AXIS_DESCR COM_AXIS n_32 _CNV_A_R_LINEAR_____15_CM 8 0. 8160. FORMAT "%4.0" AXIS_PTS_REF ldpm_n_32_2_igsp /end AXIS_DESCR
 /begin AXIS_DESCR COM_AXIS maf _CNV_A_R_LINEAR_____27_CM 6 0. 1389. FORMAT "%4.0" AXIS_PTS_REF ldpm_maf_hb_2_igsp /end AXIS_DESCR
/end CHARACTERISTIC
/begin CHARACTERISTIC ip_iga_dif_min_tco_pu "TCO correction for minimum ignition angle" CURVE 0xffe40cb5 _REC_CUR_20_u1_u1 95.625 _CNV_A_R_LINEAR_____205_CM -48. 47.625 DISPLAY_IDENTIFIER IP_IGA_DIF_MIN_TCO_PU FORMAT "%5.1"
 /begin AXIS_DESCR COM_AXIS tco _CNV_A_R_LINEAR_____11_CM 8 -48. 142.5 FORMAT "%5.1" AXIS_PTS_REF ldpm_tco_1_igsp /end AXIS_DESCR
/end CHARACTERISTIC
/begin CHARACTERISTIC ip_iga_min_n_maf_pu "Basic minimum ignition angle difference value" MAP 0xffe46590 _REC_MAP_20_u1_u1_u1 95.625 _CNV_A_R_LINEAR_____203_CM -35.625 60. DISPLAY_IDENTIFIER IP_IGA_MIN_N_MAF_PU FORMAT "%5.1"
 /begin AXIS_DESCR COM_AXIS n_32 _CNV_A_R_LINEAR_____15_CM 8 0. 8160. FORMAT "%4.0" AXIS_PTS_REF ldpm_n_32_2_igsp /end AXIS_DESCR
 /begin AXIS_DESCR COM_AXIS maf _CNV_A_R_LINEAR_____27_CM 6 0. 1389. FORMAT "%4.0" AXIS_PTS_REF ldpm_maf_hb_2_igsp /end AXIS_DESCR
/end CHARACTERISTIC
/begin AXIS_PTS ldpm_n_dif_igsp "" 0xffe51b7a n_dif _REC_AXS_20_u2 65535. _CNV_A_R_LINEAR_____207_CM 8 -32768. 32767. DISPLAY_IDENTIFIER LDPM_N_DIF_IGSP FORMAT "%6.0" /end AXIS_PTS
/begin CHARACTERISTIC ip_fac_iga_min_tco "Scaling TCO correction for minimum ignition angle" MAP 0xffe45202 _REC_MAP_20_u1_u1_u1 0.9960940000000002 _CNV_A_R_LINEAR_____50_CM 0. 0.996094 DISPLAY_IDENTIFIER IP_FAC_IGA_MIN_TCO FORMAT "%5.3"
 /begin AXIS_DESCR COM_AXIS n_32 _CNV_A_R_LINEAR_____15_CM 8 0. 8160. FORMAT "%4.0" AXIS_PTS_REF ldpm_n_32_2_igsp /end AXIS_DESCR
 /begin AXIS_DESCR COM_AXIS maf _CNV_A_R_LINEAR_____27_CM 6 0. 1389. FORMAT "%4.0" AXIS_PTS_REF ldpm_maf_hb_2_igsp /end AXIS_DESCR
/end CHARACTERISTIC
/begin CHARACTERISTIC ip_fac_iga_dif_min_amp "Scaling TCO correction for minimum ignition angle" CURVE 0xffe40b82 _REC_CUR_20_u1_u2 0.9960940000000002 _CNV_A_R_LINEAR_____50_CM 0. 0.996094 DISPLAY_IDENTIFIER IP_FAC_IGA_DIF_MIN_AMP FORMAT "%5.3"
 /begin AXIS_DESCR COM_AXIS cyc_cast _CNV_A_R_LINEAR_____0_CM 8 0. 65535. FORMAT "%5.0" AXIS_PTS_REF ldpm_cyc_cast_ip_iga_dif_min /end AXIS_DESCR
/end CHARACTERISTIC
/begin MEASUREMENT lv_mpl_iga_act "Status for multiple advance active" UBYTE _CNV_S_2_RANGE______21_CM 1 100. 0. 1. DISPLAY_IDENTIFIER LV_MPL_IGA_ACT ECU_ADDRESS 0x3fe810 BIT_MASK 0x1 /end MEASUREMENT
/begin MEASUREMENT td_mpl_dly "Spark duration" UBYTE _CNV_A_R_LINEAR_____165_CM 1 100. 0. 1.02 DISPLAY_IDENTIFIER TD_MPL_DLY ECU_ADDRESS 0x3fe811 FORMAT "%5.3" /end MEASUREMENT
/begin MEASUREMENT td_mpl "Dwell time with multiple spark" UWORD _CNV_A_R_LINEAR_____165_CM 1 100. 0. 50. DISPLAY_IDENTIFIER TD_MPL ECU_ADDRESS 0x3fd8a6 BYTE_ORDER MSB_LAST FORMAT "%7.4" /end MEASUREMENT
/begin MEASUREMENT ign_mpl_nr "Number of maximum allowed multiple sparks" UBYTE _CNV_A_R_LINEAR_____0_CM 1 100. 0. 255. DISPLAY_IDENTIFIER IGN_MPL_NR ECU_ADDRESS 0x3fe812 FORMAT "%3.0" /end MEASUREMENT
/begin CHARACTERISTIC c_tco_max_mpl_is "Max. Coolant Temp. at start to have multiple spark during idle" VALUE 0xffe40908 _REC_VAL_20_u1 190.5 _CNV_A_R_LINEAR_____11_CM -48. 142.5 DISPLAY_IDENTIFIER C_TCO_MAX_MPL_IS FORMAT "%5.1" /end CHARACTERISTIC
/begin CHARACTERISTIC c_tco_max_mpl_st "Max. Coolant Temp. at start to have multiple spark during engine start" VALUE 0xffe40909 _REC_VAL_20_u1 190.5 _CNV_A_R_LINEAR_____11_CM -48. 142.5 DISPLAY_IDENTIFIER C_TCO_MAX_MPL_ST FORMAT "%5.1" /end CHARACTERISTIC
/begin CHARACTERISTIC c_vb_max_mpl "Max. Battery voltage to have multiple spark (requested valve 16V)" VALUE 0xffe409b5 _REC_VAL_20_u1 25.8984 _CNV_A_R_LINEAR_____34_CM 0. 25.8984 DISPLAY_IDENTIFIER C_VB_MAX_MPL FORMAT "%3.1" /end CHARACTERISTIC
/begin CHARACTERISTIC c_td_t_mpl "Minimum time between two ignition" VALUE 0xffe4093e _REC_VAL_20_u1 1.02 _CNV_A_R_LINEAR_____165_CM 0. 1.02 DISPLAY_IDENTIFIER C_TD_T_MPL FORMAT "%5.3" /end CHARACTERISTIC
/begin CHARACTERISTIC c_n_max_ign_mpl "Maximum engine speed for multipla spark at idle" VALUE 0xffe407e7 _REC_VAL_20_u1 408. _CNV_A_R_LINEAR_____15_CM 0. 8160. DISPLAY_IDENTIFIER C_N_MAX_IGN_MPL FORMAT "%4.0" /end CHARACTERISTIC
/begin CHARACTERISTIC ip_nr_mpl_st "Dwell time for multiple spark" CURVE 0xffe40d7f _REC_CUR_20_u1_u1 255. _CNV_A_R_LINEAR_____0_CM 0. 255. DISPLAY_IDENTIFIER IP_NR_MPL_ST FORMAT "%3.0"
 /begin AXIS_DESCR COM_AXIS tco _CNV_A_R_LINEAR_____11_CM 8 -48. 142.5 FORMAT "%5.1" AXIS_PTS_REF ldp_tco__nr_mpl_st /end AXIS_DESCR
/end CHARACTERISTIC
/begin CHARACTERISTIC ip_nr_mpl_is "Number of successive ignition sparks for idle" CURVE 0xffe40d77 _REC_CUR_20_u1_u1 255. _CNV_A_R_LINEAR_____0_CM 0. 255. DISPLAY_IDENTIFIER IP_NR_MPL_IS FORMAT "%3.0"
 /begin AXIS_DESCR COM_AXIS tco _CNV_A_R_LINEAR_____11_CM 8 -48. 142.5 FORMAT "%5.1" AXIS_PTS_REF ldp_tco__nr_mpl_is /end AXIS_DESCR
/end CHARACTERISTIC
/begin AXIS_PTS ldp_tco__nr_mpl_st "" 0xffe48201 tco _REC_AXS_20_u1 190.5 _CNV_A_R_LINEAR_____11_CM 8 -48. 142.5 DISPLAY_IDENTIFIER LDP_TCO__NR_MPL_ST FORMAT "%5.1" /end AXIS_PTS
/begin AXIS_PTS ldp_tco__nr_mpl_is "" 0xffe481f8 tco _REC_AXS_20_u1 190.5 _CNV_A_R_LINEAR_____11_CM 8 -48. 142.5 DISPLAY_IDENTIFIER LDP_TCO__NR_MPL_IS FORMAT "%5.1" /end AXIS_PTS
/begin CHARACTERISTIC ip_td_mpl "Dwell time for multiple spark" CURVE 0xffe4ebb2 _REC_CUR_20_u2_u2 50. _CNV_A_R_LINEAR_____165_CM 0. 50. DISPLAY_IDENTIFIER IP_TD_MPL FORMAT "%7.4"
 /begin AXIS_DESCR COM_AXIS vb _CNV_A_R_LINEAR_____208_CM 8 0. 28.7055 FORMAT "%5.2" AXIS_PTS_REF ldpm_vb__td /end AXIS_DESCR
/end CHARACTERISTIC
/begin AXIS_PTS ldpm_vb__td "" 0xffe51e82 vb _REC_AXS_20_u2 28.7055 _CNV_A_R_LINEAR_____208_CM 8 0. 28.7055 DISPLAY_IDENTIFIER LDPM_VB__TD FORMAT "%5.2" /end AXIS_PTS
/begin CHARACTERISTIC ip_iga_dif_sp__eff_iga_sp "Setpoint spark retard for torque setpoint" CURVE 0xffe46520 _REC_CUR_20_u1_u2 -95.625 _CNV_A_R_LINEAR_____204_CM 0. -95.625 DISPLAY_IDENTIFIER IP_IGA_DIF_SP__EFF_IGA_SP FORMAT "%5.1"
 /begin AXIS_DESCR COM_AXIS eff_iga_sp _CNV_A_R_LINEAR_____20_CM 16 0. 1.99996948 FORMAT "%7.5" AXIS_PTS_REF ldp_eff_iga_sp_iga_dif_sp /end AXIS_DESCR
/end CHARACTERISTIC
/begin MEASUREMENT iga_dif_sp "Setpoint subtrahend ignition angle" UBYTE _CNV_A_R_LINEAR_____204_CM 1 100. 0. -95.625 DISPLAY_IDENTIFIER IGA_DIF_SP ECU_ADDRESS 0x3fe81c FORMAT "%5.1" /end MEASUREMENT
/begin MEASUREMENT lv_tq_iga_act "Logical variable torque intervention by spark retard is active" UBYTE _CNV_S_2_RANGE______2_CM 1 100. 0. 1. DISPLAY_IDENTIFIER LV_TQ_IGA_ACT ECU_ADDRESS 0x3fe81d /end MEASUREMENT
/begin MEASUREMENT lv_tq_iga_req "Logical variable torque intervention by spark retard is request" UBYTE _CNV_S_2_RANGE______2_CM 1 100. 0. 1. DISPLAY_IDENTIFIER LV_TQ_IGA_REQ ECU_ADDRESS 0x3fe81f BIT_MASK 0x1 /end MEASUREMENT
/begin CHARACTERISTIC lc_tq_iga_inh "Logical constant inhibition torque intervention by spark retard" VALUE 0xffe40ff1 _REC_VAL_20_u1 1. _CNV_A_R_LINEAR_____22_CM 0. 1. DISPLAY_IDENTIFIER LC_TQ_IGA_INH FORMAT "%1.0" /end CHARACTERISTIC
/begin CHARACTERISTIC c_eff_iga_thd_1 "Threshold ignition efficiency for deactivation spark retard" VALUE 0xffe415c4 _REC_VAL_20_u2 1.99996948 _CNV_A_R_LINEAR_____20_CM 0. 1.99996948 DISPLAY_IDENTIFIER C_EFF_IGA_THD_1 FORMAT "%7.5" /end CHARACTERISTIC
/begin CHARACTERISTIC c_eff_iga_thd_aj "Threshold ignition efficiency for deactivation spark retard in anti-jerk intervention" VALUE 0xffe415c6 _REC_VAL_20_u2 1.99996948 _CNV_A_R_LINEAR_____20_CM 0. 1.99996948 DISPLAY_IDENTIFIER C_EFF_IGA_THD_AJ FORMAT "%7.5" /end CHARACTERISTIC
/begin CHARACTERISTIC c_eff_iga_thd_is "Threshold ignition efficiency for deactivation spark retard" VALUE 0xffe415c8 _REC_VAL_20_u2 1.99996948 _CNV_A_R_LINEAR_____20_CM 0. 1.99996948 DISPLAY_IDENTIFIER C_EFF_IGA_THD_IS FORMAT "%7.5" /end CHARACTERISTIC
/begin AXIS_PTS ldp_eff_iga_sp_iga_dif_sp "" 0xffe50b02 eff_iga_sp _REC_AXS_20_u2 1.99996948 _CNV_A_R_LINEAR_____20_CM 16 0. 1.99996948 DISPLAY_IDENTIFIER LDP_EFF_IGA_SP_IGA_DIF_SP FORMAT "%7.5" /end AXIS_PTS
/begin MEASUREMENT eff_iga_sp "Setpoint ignition efficiency" UWORD _CNV_A_R_LINEAR_____20_CM 1 100. 0. 1.99996948 DISPLAY_IDENTIFIER EFF_IGA_SP ECU_ADDRESS 0x3fd8aa BYTE_ORDER MSB_LAST FORMAT "%7.5" /end MEASUREMENT
/begin MEASUREMENT eff_iga_sp_can "Setpoint ignition efficiency for CAN" UWORD _CNV_A_R_LINEAR_____20_CM 1 100. 0. 1.99996948 DISPLAY_IDENTIFIER EFF_IGA_SP_CAN ECU_ADDRESS 0x3fd8ae BYTE_ORDER MSB_LAST FORMAT "%7.5" /end MEASUREMENT
/begin MEASUREMENT eff_iga_sp_1 "Setpoint ignition efficiency" UWORD _CNV_A_R_LINEAR_____20_CM 1 100. 0. 1.99996948 DISPLAY_IDENTIFIER EFF_IGA_SP_1 ECU_ADDRESS 0x3fd8ac BYTE_ORDER MSB_LAST FORMAT "%7.5" /end MEASUREMENT
/begin MEASUREMENT eff_iga_sp_1_can "Setpoint ignition efficiency for CAN" UWORD _CNV_A_R_LINEAR_____20_CM 1 100. 0. 1.99996948 DISPLAY_IDENTIFIER EFF_IGA_SP_1_CAN ECU_ADDRESS 0x3fd8b0 BYTE_ORDER MSB_LAST FORMAT "%7.5" /end MEASUREMENT
/begin MEASUREMENT iga_sp "Setpoint ignition angle from torque management" UBYTE _CNV_A_R_LINEAR_____203_CM 1 100. -35.625 60. DISPLAY_IDENTIFIER IGA_SP ECU_ADDRESS 0x3fe81a FORMAT "%5.1" /end MEASUREMENT
/begin MEASUREMENT iga_sp_can "Setpoint ignition angle from torque management for CAN" UBYTE _CNV_A_R_LINEAR_____203_CM 1 100. -35.625 60. DISPLAY_IDENTIFIER IGA_SP_CAN ECU_ADDRESS 0x3fe81b FORMAT "%5.1" /end MEASUREMENT
/begin MEASUREMENT iga_st "Basic ignition angle at start" UBYTE _CNV_A_R_LINEAR_____203_CM 1 100. -35.625 60. DISPLAY_IDENTIFIER IGA_ST ECU_ADDRESS 0x3fe820 FORMAT "%5.1" /end MEASUREMENT
/begin CHARACTERISTIC ip_iga_st_bas "Basic ignition angle at start" MAP 0xffe468e4 _REC_MAP_20_u1_u2_u1 4.78125 _CNV_A_R_LINEAR_____203_CM -35.625 60. DISPLAY_IDENTIFIER IP_IGA_ST_BAS FORMAT "%5.1"
 /begin AXIS_DESCR COM_AXIS n _CNV_A_R_LINEAR_____10_CM 6 0. 8160. FORMAT "%4.0" AXIS_PTS_REF ldp_n_ip_iga_st_bas /end AXIS_DESCR
 /begin AXIS_DESCR COM_AXIS tco _CNV_A_R_LINEAR_____11_CM 8 -48. 142.5 FORMAT "%5.1" AXIS_PTS_REF ldpm_tco_1_igsp /end AXIS_DESCR
/end CHARACTERISTIC
/begin CHARACTERISTIC ip_iga_st_cyc_st_cor "Basic ignition angle at start" MAP 0xffe46914 _REC_MAP_20_u1_u1_u1 4.78125 _CNV_A_R_LINEAR_____205_CM -48. 47.625 DISPLAY_IDENTIFIER IP_IGA_ST_CYC_ST_COR FORMAT "%5.1"
 /begin AXIS_DESCR COM_AXIS NO_INPUT_QUANTITY _CNV_A_R_LINEAR_____0_CM 6 0. 255. FORMAT "%3.0" AXIS_PTS_REF ldp_cyc_st_ip_iga_st_cyc_st_cor /end AXIS_DESCR
 /begin AXIS_DESCR COM_AXIS tco _CNV_A_R_LINEAR_____11_CM 8 -48. 142.5 FORMAT "%5.1" AXIS_PTS_REF ldpm_tco_1_igsp /end AXIS_DESCR
/end CHARACTERISTIC
/begin CHARACTERISTIC ip_iga_st_amp_cor "Basic ignition angle at start" CURVE 0xffe40cd3 _REC_CUR_20_u1_u2 4.78125 _CNV_A_R_LINEAR_____205_CM -48. 47.625 DISPLAY_IDENTIFIER IP_IGA_ST_AMP_COR FORMAT "%5.1"
 /begin AXIS_DESCR COM_AXIS amp _CNV_A_R_LINEAR_____49_CM 6 0. 5434. FORMAT "%7.2" AXIS_PTS_REF ldp_amp_ip_iga_st_amp_cor /end AXIS_DESCR
/end CHARACTERISTIC
/begin AXIS_PTS ldp_cyc_st_ip_iga_st_cyc_st_cor "" 0xffe41015 NO_INPUT_QUANTITY _REC_AXS_20_u1 255. _CNV_A_R_LINEAR_____0_CM 6 0. 255. DISPLAY_IDENTIFIER LDP_CYC_ST_IP_IGA_ST_CYC_ST_COR FORMAT "%3.0" /end AXIS_PTS
/begin AXIS_PTS ldp_n_ip_iga_st_bas "" 0xffe510a6 n _REC_AXS_20_u2 8160. _CNV_A_R_LINEAR_____10_CM 6 0. 8160. DISPLAY_IDENTIFIER LDP_N_IP_IGA_ST_BAS FORMAT "%4.0" /end AXIS_PTS
/begin AXIS_PTS ldp_amp_ip_iga_st_amp_cor "" 0xffe509c2 amp _REC_AXS_20_u2 5434. _CNV_A_R_LINEAR_____49_CM 6 0. 5434. DISPLAY_IDENTIFIER LDP_AMP_IP_IGA_ST_AMP_COR FORMAT "%7.2" /end AXIS_PTS
/begin CHARACTERISTIC c_td_ini "initial value for dwell time control" VALUE 0xffe41a32 _REC_VAL_20_u2 10. _CNV_A_R_LINEAR_____165_CM 0. 10. DISPLAY_IDENTIFIER C_TD_INI FORMAT "%5.2" /end CHARACTERISTIC
/begin CHARACTERISTIC c_td_as "Application intervention" VALUE 0xffe4039d _REC_VAL_20_s1 16.32 _CNV_A_R_LINEAR_____211_CM -8.192 8.128 DISPLAY_IDENTIFIER C_TD_AS FORMAT "%6.2" /end CHARACTERISTIC
/begin MEASUREMENT td_max_wdt "Maximum executable dwell time" UWORD _CNV_A_R_LINEAR_____165_CM 1 100. 0. 50. DISPLAY_IDENTIFIER TD_MAX_WDT ECU_ADDRESS 0x3fd8b4 BYTE_ORDER MSB_LAST FORMAT "%7.4" /end MEASUREMENT
/begin MEASUREMENT td "Nominal dwell time" UWORD _CNV_A_R_LINEAR_____165_CM 1 100. 0. 50. DISPLAY_IDENTIFIER TD ECU_ADDRESS 0x3fd8b2 BYTE_ORDER MSB_LAST FORMAT "%7.4" /end MEASUREMENT
/begin CHARACTERISTIC ip_td__vb "Dwell time correction versus battery voltage" CURVE 0xffe4eba2 _REC_CUR_20_u2_u2 10. _CNV_A_R_LINEAR_____165_CM 0. 10. DISPLAY_IDENTIFIER IP_TD__VB FORMAT "%5.2"
 /begin AXIS_DESCR COM_AXIS vb _CNV_A_R_LINEAR_____208_CM 8 0. 28.7055 FORMAT "%5.2" AXIS_PTS_REF ldpm_vb__td /end AXIS_DESCR
/end CHARACTERISTIC
/begin MEASUREMENT state_cmb_ctl "States of the combustion management" UBYTE _CNV_S_9_RANGE_STAT_231_CM 1 100. 0. 8. DISPLAY_IDENTIFIER STATE_CMB_CTL ECU_ADDRESS 0x3fe737 /end MEASUREMENT
/begin AXIS_PTS ldpm_ctr_km_can_1 "" 0xffe517a4 ctr_km_can _REC_AXS_20_u2 655350. _CNV_A_R_LINEAR_____88_CM 4 0. 655350. DISPLAY_IDENTIFIER LDPM_CTR_KM_CAN_1 FORMAT "%7.0" /end AXIS_PTS
/begin MEASUREMENT lv_afl_ch "LV for activation SA or catalyst heating lambda coordination" UBYTE _CNV_S_2_RANGE______21_CM 1 100. 0. 1. DISPLAY_IDENTIFIER LV_AFL_CH ECU_ADDRESS 0x3fe4d1 BIT_MASK 0x1 /end MEASUREMENT
/begin MEASUREMENT maf_sp_s "MAF setpoint for stratified mode" UWORD _CNV_A_R_LINEAR_____108_CM 1 100. 0. 1389. DISPLAY_IDENTIFIER MAF_SP_S ECU_ADDRESS 0x3fd22e BYTE_ORDER MSB_LAST FORMAT "%6.2" /end MEASUREMENT
/begin MEASUREMENT fac_maf_max_s "Ratio between MAF and MAF_MAX for stratified mode" UWORD _CNV_A_R_LINEAR_____20_CM 1 100. 0. 1.99996948 DISPLAY_IDENTIFIER FAC_MAF_MAX_S ECU_ADDRESS 0x3fd234 BYTE_ORDER MSB_LAST FORMAT "%7.5" /end MEASUREMENT
/begin MEASUREMENT maf_dif_s "Air mass flow difference in stratified combustion" UWORD _CNV_A_R_LINEAR_____399_CM 1 100. -694.5 694.5 DISPLAY_IDENTIFIER MAF_DIF_S ECU_ADDRESS 0x3fd232 BYTE_ORDER MSB_LAST FORMAT "%7.2" /end MEASUREMENT
/begin CHARACTERISTIC ip_pq_egr_sp "MAF setpoint for stratified mode" MAP 0xffe4dc8a _REC_MAP_20_u2_u1_u2 0.99998474 _CNV_A_R_LINEAR_____37_CM 0. 0.99998474 DISPLAY_IDENTIFIER IP_PQ_EGR_SP FORMAT "%7.5"
 /begin AXIS_DESCR COM_AXIS n_32 _CNV_A_R_LINEAR_____15_CM 8 0. 8160. FORMAT "%4.0" AXIS_PTS_REF ldp_n_32__pq_egr_sp /end AXIS_DESCR
 /begin AXIS_DESCR COM_AXIS mff_sp_s _CNV_A_R_LINEAR_____108_CM 6 0. 1389. FORMAT "%7.2" AXIS_PTS_REF ldp_mff_sp_s__pq_egr_sp /end AXIS_DESCR
/end CHARACTERISTIC
/begin CHARACTERISTIC ip_fac_maf_max_s "Ratio between MAF and MAF_MAX for stratified mode" MAP 0xffe4b0f6 _REC_MAP_20_u2_u1_u2 1.99996948 _CNV_A_R_LINEAR_____20_CM 0. 1.99996948 DISPLAY_IDENTIFIER IP_FAC_MAF_MAX_S FORMAT "%7.5"
 /begin AXIS_DESCR COM_AXIS n_32 _CNV_A_R_LINEAR_____15_CM 8 0. 8160. FORMAT "%4.0" AXIS_PTS_REF ldp_n_32__fac_maf_max_s /end AXIS_DESCR
 /begin AXIS_DESCR COM_AXIS mff_sp_s _CNV_A_R_LINEAR_____108_CM 6 0. 1389. FORMAT "%7.2" AXIS_PTS_REF ldp_mff_sp_s__fac_maf_max_s /end AXIS_DESCR
/end CHARACTERISTIC
/begin CHARACTERISTIC ip_eff_maf_s "AIR efficiency in stratified combustion" CURVE 0xffe4a0b2 _REC_CUR_20_u2_u2 1.99996948 _CNV_A_R_LINEAR_____20_CM 0. 1.99996948 DISPLAY_IDENTIFIER IP_EFF_MAF_S FORMAT "%7.5"
 /begin AXIS_DESCR COM_AXIS maf_dif_s _CNV_A_R_LINEAR_____399_CM 16 -694.5 694.5 FORMAT "%7.2" AXIS_PTS_REF ldp_maf_dif_s__eff_maf_s /end AXIS_DESCR
/end CHARACTERISTIC
/begin CHARACTERISTIC lc_maf_sp_egr "Logical variable switch mass flow and partial pressure" VALUE 0xffe40fa6 _REC_VAL_20_u1 1. _CNV_A_R_LINEAR_____22_CM 0. 1. DISPLAY_IDENTIFIER LC_MAF_SP_EGR FORMAT "%1.0" /end CHARACTERISTIC
/begin AXIS_PTS ldp_n_32__pq_egr_sp "" 0xffe48088 n_32 _REC_AXS_20_u1 816. _CNV_A_R_LINEAR_____15_CM 8 0. 8160. DISPLAY_IDENTIFIER LDP_N_32__PQ_EGR_SP FORMAT "%4.0" /end AXIS_PTS
/begin AXIS_PTS ldp_n_32__fac_maf_max_s "" 0xffe4800c n_32 _REC_AXS_20_u1 816. _CNV_A_R_LINEAR_____15_CM 8 0. 8160. DISPLAY_IDENTIFIER LDP_N_32__FAC_MAF_MAX_S FORMAT "%4.0" /end AXIS_PTS
/begin AXIS_PTS ldp_mff_sp_s__fac_maf_max_s "" 0xffe50f60 mff_sp_s _REC_AXS_20_u2 1389. _CNV_A_R_LINEAR_____108_CM 6 0. 1389. DISPLAY_IDENTIFIER LDP_MFF_SP_S__FAC_MAF_MAX_S FORMAT "%7.2" /end AXIS_PTS
/begin AXIS_PTS ldp_maf_dif_s__eff_maf_s "" 0xffe50d66 maf_dif_s _REC_AXS_20_u2 1389. _CNV_A_R_LINEAR_____399_CM 16 -694.5 694.5 DISPLAY_IDENTIFIER LDP_MAF_DIF_S__EFF_MAF_S FORMAT "%7.2" /end AXIS_PTS
/begin AXIS_PTS ldp_mff_sp_s__pq_egr_sp "" 0xffe50f6e mff_sp_s _REC_AXS_20_u2 1389. _CNV_A_R_LINEAR_____108_CM 6 0. 1389. DISPLAY_IDENTIFIER LDP_MFF_SP_S__PQ_EGR_SP FORMAT "%7.2" /end AXIS_PTS
/begin MEASUREMENT maf_sp "MAF setpoint output for inverse air path" UWORD _CNV_A_R_LINEAR_____108_CM 1 100. 0. 1389. DISPLAY_IDENTIFIER MAF_SP ECU_ADDRESS 0x3fd33c BYTE_ORDER MSB_LAST FORMAT "%6.2" /end MEASUREMENT
/begin MEASUREMENT maf_sp_isa "MAF setpoint output for inverse air path of idle speed actuator (ISA)" UWORD _CNV_A_R_LINEAR_____108_CM 1 100. 0. 1389. DISPLAY_IDENTIFIER MAF_SP_ISA ECU_ADDRESS 0x3fd33e BYTE_ORDER MSB_LAST FORMAT "%6.2" /end MEASUREMENT
/begin CHARACTERISTIC lc_isa_ena "logical constant enabled idle speed actuator (ISA)" VALUE 0xffe40f8c _REC_VAL_20_u1 1. _CNV_A_R_LINEAR_____0_CM 0. 1. DISPLAY_IDENTIFIER LC_ISA_ENA FORMAT "%2.0" /end CHARACTERISTIC
/begin MEASUREMENT lv_isa_ena "logical variable for enabled idle speed actuator (ISA)" UBYTE _CNV_S_2_RANGE______2_CM 1 100. 0. 1. DISPLAY_IDENTIFIER LV_ISA_ENA ECU_ADDRESS 0x3fe497 /end MEASUREMENT
/begin CHARACTERISTIC ip_maf_sp_isa "Setpoint mass air flow idle speed actuator (ISA)" MAP 0xffe4d0ca _REC_MAP_20_u2_u1_u2 0.99998474 _CNV_A_R_LINEAR_____37_CM 0. 0.99998474 DISPLAY_IDENTIFIER IP_MAF_SP_ISA FORMAT "%7.5"
 /begin AXIS_DESCR COM_AXIS maf_turb_ratio_max _CNV_A_R_LINEAR_____129_CM 8 0. 3.984375 FORMAT "%4.2" AXIS_PTS_REF ldp_maf_turb_ratio__maf_sp_isa /end AXIS_DESCR
 /begin AXIS_DESCR COM_AXIS n _CNV_A_R_LINEAR_____10_CM 6 0. 8160. FORMAT "%4.0" AXIS_PTS_REF ldp_n__maf_sp_isa /end AXIS_DESCR
/end CHARACTERISTIC
/begin MEASUREMENT maf_turb_ratio_max "maximum mass air flow ratio turbolence system / total MAF" UBYTE _CNV_A_R_LINEAR_____129_CM 1 100. 0. 3.984375 DISPLAY_IDENTIFIER MAF_TURB_RATIO_MAX ECU_ADDRESS 0x3fe498 FORMAT "%4.2" /end MEASUREMENT
/begin AXIS_PTS ldp_maf_turb_ratio__maf_sp_isa "" 0xffe47fdc maf_turb_ratio_max _REC_AXS_20_u1 3.984375 _CNV_A_R_LINEAR_____129_CM 8 0. 3.984375 DISPLAY_IDENTIFIER LDP_MAF_TURB_RATIO__MAF_SP_ISA FORMAT "%4.2" /end AXIS_PTS
/begin AXIS_PTS ldp_n__maf_sp_isa "" 0xffe50fb2 n _REC_AXS_20_u2 816. _CNV_A_R_LINEAR_____10_CM 6 0. 8160. DISPLAY_IDENTIFIER LDP_N__MAF_SP_ISA FORMAT "%4.0" /end AXIS_PTS
/begin CHARACTERISTIC c_mtcpwm_i_max_pos "Limitation of I-share upwards" VALUE 0xffe40472 _REC_VAL_20_s2 199.99694824 _CNV_A_R_LINEAR_____321_CM -100. 99.99694824 DISPLAY_IDENTIFIER C_MTCPWM_I_MAX_POS FORMAT "%8.3" /end CHARACTERISTIC
/begin MEASUREMENT tps_dif "gradient of controller deviation" UWORD _CNV_A_R_LINEAR_____407_CM 1 100. -119.5 119.5 DISPLAY_IDENTIFIER TPS_DIF ECU_ADDRESS 0x3fdd02 BYTE_ORDER MSB_LAST FORMAT "%8.3" /end MEASUREMENT
/begin CHARACTERISTIC ip_mtcpwm_d__tps_dif_grd "Position controller D-share" CURVE 0xffe4d60a _REC_CUR_20_u2_u2 799.987793 _CNV_A_R_LINEAR_____408_CM -400. 399.987793 DISPLAY_IDENTIFIER IP_MTCPWM_D__TPS_DIF_GRD FORMAT "%7.2"
 /begin AXIS_DESCR COM_AXIS tps_dif_grd _CNV_A_R_LINEAR_____407_CM 8 -119.5 119.5 FORMAT "%8.3" AXIS_PTS_REF ldp_tps_dif_grd__mtcpwm_d /end AXIS_DESCR
/end CHARACTERISTIC
/begin CHARACTERISTIC ip_mtcpwm_i__tps_dif "Position controller I-share" CURVE 0xffe4d61a _REC_CUR_20_u2_u2 199.99694824 _CNV_A_R_LINEAR_____409_CM -100. 99.99694824 DISPLAY_IDENTIFIER IP_MTCPWM_I__TPS_DIF FORMAT "%8.3"
 /begin AXIS_DESCR COM_AXIS tps_dif _CNV_A_R_LINEAR_____407_CM 8 -119.5 119.5 FORMAT "%8.3" AXIS_PTS_REF ldp_tps_dif__mtcpwm_i /end AXIS_DESCR
/end CHARACTERISTIC
/begin CHARACTERISTIC ip_mtcpwm_p__tps_dif "Position controller P-share" CURVE 0xffe4d62a _REC_CUR_20_u2_u2 799.987793 _CNV_A_R_LINEAR_____408_CM -400. 399.987793 DISPLAY_IDENTIFIER IP_MTCPWM_P__TPS_DIF FORMAT "%7.2"
 /begin AXIS_DESCR COM_AXIS tps_dif _CNV_A_R_LINEAR_____407_CM 8 -119.5 119.5 FORMAT "%8.3" AXIS_PTS_REF ldp_tps_dif__mtcpwm_p /end AXIS_DESCR
/end CHARACTERISTIC
/begin CHARACTERISTIC ip_mtcpwm_vb_fac__vb "Battery voltage correction" CURVE 0xffe40d30 _REC_CUR_20_u1_u1 1.99220002 _CNV_A_R_LINEAR_____39_CM 0. 1.99220002 DISPLAY_IDENTIFIER IP_MTCPWM_VB_FAC__VB FORMAT "%5.3"
 /begin AXIS_DESCR COM_AXIS vb _CNV_A_R_LINEAR_____34_CM 8 0. 25.8984 FORMAT "%3.1" AXIS_PTS_REF ldp_vb__mtcpwm_vb_fac /end AXIS_DESCR
/end CHARACTERISTIC
/begin MEASUREMENT mtcpwm_add "Duty cycle of the feed-forward-control" SWORD _CNV_A_R_LINEAR_____321_CM 1 100. -100. 99.99694824 DISPLAY_IDENTIFIER MTCPWM_ADD ECU_ADDRESS 0x3fdd0a BYTE_ORDER MSB_LAST FORMAT "%8.3" /end MEASUREMENT
/begin MEASUREMENT mtcpwm_ctl "Duty cycle of the PID-controller" SLONG _CNV_A_R_LINEAR_____410_CM 1 100. -400. 400. DISPLAY_IDENTIFIER MTCPWM_CTL ECU_ADDRESS 0x3fd020 BYTE_ORDER MSB_LAST FORMAT "%8.3" /end MEASUREMENT
/begin MEASUREMENT mtcpwm_d "Duty cycle of the D-share" SWORD _CNV_A_R_LINEAR_____411_CM 1 100. -400. 399.987793 DISPLAY_IDENTIFIER MTCPWM_D ECU_ADDRESS 0x3fdd12 BYTE_ORDER MSB_LAST FORMAT "%7.2" /end MEASUREMENT
/begin MEASUREMENT mtcpwm_p "Duty cycle of the P-share" SWORD _CNV_A_R_LINEAR_____411_CM 1 100. -400. 399.987793 DISPLAY_IDENTIFIER MTCPWM_P ECU_ADDRESS 0x3fdd0e BYTE_ORDER MSB_LAST FORMAT "%7.2" /end MEASUREMENT
/begin MEASUREMENT mtcpwm_i "Duty cycle of the I-share" SWORD _CNV_A_R_LINEAR_____321_CM 1 100. -100. 99.99694824 DISPLAY_IDENTIFIER MTCPWM_I ECU_ADDRESS 0x3fdd10 BYTE_ORDER MSB_LAST FORMAT "%8.3" /end MEASUREMENT
/begin MEASUREMENT mtcpwm_i_add "Manipulated previous I-share" SWORD _CNV_A_R_LINEAR_____321_CM 1 100. -100. 99.99694824 DISPLAY_IDENTIFIER MTCPWM_I_ADD ECU_ADDRESS 0x3fdd16 BYTE_ORDER MSB_LAST FORMAT "%8.3" /end MEASUREMENT
/begin MEASUREMENT tps_sp_lih_dif "Difference between TPS_SP and TPS_LIH" UWORD _CNV_A_R_LINEAR_____407_CM 1 100. -119.5 119.5 DISPLAY_IDENTIFIER TPS_SP_LIH_DIF ECU_ADDRESS 0x3fdd08 BYTE_ORDER MSB_LAST FORMAT "%8.3" /end MEASUREMENT
/begin CHARACTERISTIC c_tps_sp_lih_dif_hys "Hysteresis for detection of direction change" VALUE 0xffe41aa8 _REC_VAL_20_u2 119.5 _CNV_A_R_LINEAR_____53_CM 0. 119.5 DISPLAY_IDENTIFIER C_TPS_SP_LIH_DIF_HYS FORMAT "%7.3" /end CHARACTERISTIC
/begin CHARACTERISTIC c_mtcpwm_i_max_neg "Limitation of I-share downwards" VALUE 0xffe40470 _REC_VAL_20_s2 199.99694824 _CNV_A_R_LINEAR_____321_CM -100. 99.99694824 DISPLAY_IDENTIFIER C_MTCPWM_I_MAX_NEG FORMAT "%8.3" /end CHARACTERISTIC
/begin CHARACTERISTIC c_mtcpwm_i_add "Init value for I-Part while TPS_SP_LIH_DIF is crossing LH" VALUE 0xffe4046c _REC_VAL_20_s2 199.99694824 _CNV_A_R_LINEAR_____321_CM -100. 99.99694824 DISPLAY_IDENTIFIER C_MTCPWM_I_ADD FORMAT "%8.3" /end CHARACTERISTIC
/begin CHARACTERISTIC c_mtcpwm_add_fil "Filter parameter" VALUE 0xffe407be _REC_VAL_20_u1 0.9960940000000002 _CNV_A_R_LINEAR_____50_CM 0. 0.996094 DISPLAY_IDENTIFIER C_MTCPWM_ADD_FIL FORMAT "%5.3" /end CHARACTERISTIC
/begin CHARACTERISTIC ip_mtcpwm_i_fac__tps_av_lih_dif "Angle dependent I-part manipulation" CURVE 0xffe40d28 _REC_CUR_20_u1_u2 7.96875 _CNV_A_R_LINEAR_____236_CM 0. 7.96875 DISPLAY_IDENTIFIER IP_MTCPWM_I_FAC__TPS_AV_LIH_DIF FORMAT "%4.2"
 /begin AXIS_DESCR COM_AXIS tps_av_lih_dif _CNV_A_R_LINEAR_____407_CM 8 -119.5 119.5 FORMAT "%8.3" AXIS_PTS_REF ldp_tps_av_lih_dif_mtcpwm_i /end AXIS_DESCR
/end CHARACTERISTIC
/begin CHARACTERISTIC ip_mtcpwm_add__tps_sp_lih_dif "Setpoint dependent Feed Forward Value" CURVE 0xffe4d5fa _REC_CUR_20_u2_u2 199.99694824 _CNV_A_R_LINEAR_____409_CM -100. 99.99694824 DISPLAY_IDENTIFIER IP_MTCPWM_ADD__TPS_SP_LIH_DIF FORMAT "%8.3"
 /begin AXIS_DESCR COM_AXIS tps_sp_lih_dif _CNV_A_R_LINEAR_____407_CM 8 -119.5 119.5 FORMAT "%8.3" AXIS_PTS_REF ldp_tps_sp_lih_dif__mtcpwm_add /end AXIS_DESCR
/end CHARACTERISTIC
/begin MEASUREMENT mtcpwm_vb_fac "Battery voltage correction" UBYTE _CNV_A_R_LINEAR_____39_CM 1 100. 0. 1.99220002 DISPLAY_IDENTIFIER MTCPWM_VB_FAC ECU_ADDRESS 0x3feac9 FORMAT "%5.3" /end MEASUREMENT
/begin MEASUREMENT tps_dif_grd "Controller deviation" UWORD _CNV_A_R_LINEAR_____407_CM 1 100. -119.5 119.5 DISPLAY_IDENTIFIER TPS_DIF_GRD ECU_ADDRESS 0x3fdd0c BYTE_ORDER MSB_LAST /end MEASUREMENT
/begin MEASUREMENT t_mtcpwm_close_act "time counter for closing condition" UWORD _CNV_A_R_LINEAR_____412_CM 1 100. 0. 5110. DISPLAY_IDENTIFIER T_MTCPWM_CLOSE_ACT ECU_ADDRESS 0x3fdd04 BYTE_ORDER MSB_LAST FORMAT "%5.0" /end MEASUREMENT
/begin MEASUREMENT tps_sp_ctl "throttle position setpoint ( + or - )" SWORD _CNV_A_R_LINEAR_____413_CM 1 100. -119.5 119.5 DISPLAY_IDENTIFIER TPS_SP_CTL ECU_ADDRESS 0x3fdd14 BYTE_ORDER MSB_LAST FORMAT "%8.3" /end MEASUREMENT
/begin MEASUREMENT lv_tps_sp_pos "position detection of TPS-setpoint (0: below LIH; 1: above LIH)" UBYTE _CNV_S_2_RANGE______2_CM 1 100. 0. 1. DISPLAY_IDENTIFIER LV_TPS_SP_POS ECU_ADDRESS 0x3feacb /end MEASUREMENT
/begin MEASUREMENT lv_tps_chg_pos "detection of changed direction from LV_TPS_SP_POS" UBYTE _CNV_S_2_RANGE______2_CM 1 100. 0. 1. DISPLAY_IDENTIFIER LV_TPS_CHG_POS ECU_ADDRESS 0x3feacc /end MEASUREMENT
/begin CHARACTERISTIC c_t_mtcpwm_close_act_max "Timer threshold for switching to closing duty cycle" VALUE 0xffe419be _REC_VAL_20_u2 5. _CNV_A_R_LINEAR_____414_CM 0. 5. DISPLAY_IDENTIFIER C_T_MTCPWM_CLOSE_ACT_MAX FORMAT "%5.3" /end CHARACTERISTIC
/begin CHARACTERISTIC c_mtcpwm_close_max "duty cycle limitation at bottom mechanical limit" VALUE 0xffe4046a _REC_VAL_20_s2 199.99694824 _CNV_A_R_LINEAR_____321_CM -100. 99.99694824 DISPLAY_IDENTIFIER C_MTCPWM_CLOSE_MAX FORMAT "%8.3" /end CHARACTERISTIC
/begin CHARACTERISTIC c_tps_sp_stop_hys "setpoint hysteresis for closing throttle" VALUE 0xffe41abc _REC_VAL_20_u2 119.5 _CNV_A_R_LINEAR_____53_CM 0. 119.5 DISPLAY_IDENTIFIER C_TPS_SP_STOP_HYS FORMAT "%7.3" /end CHARACTERISTIC
/begin CHARACTERISTIC c_tps_sp_stop_max "threshold for testing duty cycle on value" VALUE 0xffe41abe _REC_VAL_20_u2 119.5 _CNV_A_R_LINEAR_____53_CM 0. 119.5 DISPLAY_IDENTIFIER C_TPS_SP_STOP_MAX FORMAT "%7.3" /end CHARACTERISTIC
/begin CHARACTERISTIC c_mtcpwm_i_ini "initialization of MTCPWM_I" VALUE 0xffe4046e _REC_VAL_20_s2 199.99694824 _CNV_A_R_LINEAR_____321_CM -100. 99.99694824 DISPLAY_IDENTIFIER C_MTCPWM_I_INI FORMAT "%8.3" /end CHARACTERISTIC
/begin CHARACTERISTIC c_tps_sp_ctl_max "limitation of TPS_SP_CTL" VALUE 0xffe404a2 _REC_VAL_20_s2 119.5 _CNV_A_R_LINEAR_____413_CM -119.5 0. DISPLAY_IDENTIFIER C_TPS_SP_CTL_MAX FORMAT "%8.3" /end CHARACTERISTIC
/begin CHARACTERISTIC c_mtcpwm_close "closing duty cycle" VALUE 0xffe40468 _REC_VAL_20_s2 199.99694824 _CNV_A_R_LINEAR_____321_CM -100. 99.99694824 DISPLAY_IDENTIFIER C_MTCPWM_CLOSE FORMAT "%8.3" /end CHARACTERISTIC
/begin CHARACTERISTIC c_mtcpwm_hys "hysteresis to prevent MTCPWM-switching according to VB-changes" VALUE 0xffe417e4 _REC_VAL_20_u2 100. _CNV_A_R_LINEAR_____415_CM 0. 100. DISPLAY_IDENTIFIER C_MTCPWM_HYS FORMAT "%7.3" /end CHARACTERISTIC
/begin MEASUREMENT mtcpwm "Duty cycle of the ETC Position Controller" SWORD _CNV_A_R_LINEAR_____321_CM 1 100. -100. 99.99694824 DISPLAY_IDENTIFIER MTCPWM ECU_ADDRESS 0x3fdd00 BYTE_ORDER MSB_LAST FORMAT "%8.3" /end MEASUREMENT
/begin MEASUREMENT lv_mtcpwm_close_act "logical variable (is set, if closing duty cycle is active" UBYTE _CNV_S_2_RANGE______2_CM 1 100. 0. 1. DISPLAY_IDENTIFIER LV_MTCPWM_CLOSE_ACT ECU_ADDRESS 0x3feaca /end MEASUREMENT
/begin MEASUREMENT tps_av_lih_dif "Difference between TPS_AV and TPS_LIH" UWORD _CNV_A_R_LINEAR_____407_CM 1 100. -119.5 119.5 DISPLAY_IDENTIFIER TPS_AV_LIH_DIF ECU_ADDRESS 0x3fdd06 BYTE_ORDER MSB_LAST FORMAT "%8.3" /end MEASUREMENT
/begin AXIS_PTS ldp_tps_dif__mtcpwm_p "" 0xffe513d8 tps_dif _REC_AXS_20_u2 239. _CNV_A_R_LINEAR_____407_CM 8 -119.5 119.5 DISPLAY_IDENTIFIER LDP_TPS_DIF__MTCPWM_P FORMAT "%8.3" /end AXIS_PTS
/begin AXIS_PTS ldp_tps_dif__mtcpwm_i "" 0xffe513c6 tps_dif _REC_AXS_20_u2 239. _CNV_A_R_LINEAR_____407_CM 8 -119.5 119.5 DISPLAY_IDENTIFIER LDP_TPS_DIF__MTCPWM_I FORMAT "%8.3" /end AXIS_PTS
/begin AXIS_PTS ldp_tps_av_lih_dif_mtcpwm_i "" 0xffe513b4 tps_av_lih_dif _REC_AXS_20_u2 239. _CNV_A_R_LINEAR_____407_CM 8 -119.5 119.5 DISPLAY_IDENTIFIER LDP_TPS_AV_LIH_DIF_MTCPWM_I FORMAT "%8.3" /end AXIS_PTS
/begin AXIS_PTS ldp_tps_dif_grd__mtcpwm_d "" 0xffe513ea tps_dif_grd _REC_AXS_20_u2 239. _CNV_A_R_LINEAR_____407_CM 8 -119.5 119.5 DISPLAY_IDENTIFIER LDP_TPS_DIF_GRD__MTCPWM_D FORMAT "%8.3" /end AXIS_PTS
/begin AXIS_PTS ldp_tps_sp_lih_dif__mtcpwm_add "" 0xffe51438 tps_sp_lih_dif _REC_AXS_20_u2 239. _CNV_A_R_LINEAR_____407_CM 8 -119.5 119.5 DISPLAY_IDENTIFIER LDP_TPS_SP_LIH_DIF__MTCPWM_ADD FORMAT "%8.3" /end AXIS_PTS
/begin AXIS_PTS ldp_vb__mtcpwm_vb_fac "" 0xffe48308 vb _REC_AXS_20_u1 25.8984 _CNV_A_R_LINEAR_____34_CM 8 0. 25.8984 DISPLAY_IDENTIFIER LDP_VB__MTCPWM_VB_FAC FORMAT "%3.1" /end AXIS_PTS
/begin MEASUREMENT lv_inh_mtc_ctl "State Bit for Deactivation of the ETC Position Controller Output" UBYTE _CNV_S_2_RANGE______2_CM 1 100. 0. 1. DISPLAY_IDENTIFIER LV_INH_MTC_CTL ECU_ADDRESS 0x3feac4 /end MEASUREMENT
/begin MEASUREMENT opg_sp_st_isa "ISAPWM setpoint at start" UWORD _CNV_A_R_LINEAR_____8_CM 1 100. 0. 99.99847412 DISPLAY_IDENTIFIER OPG_SP_ST_ISA ECU_ADDRESS 0x3fdd18 BYTE_ORDER MSB_LAST /end MEASUREMENT
/begin MEASUREMENT opg_rel_st "relative ISAPWM setpoint at start" UWORD _CNV_A_R_LINEAR_____8_CM 1 100. 0. 99.99847412 DISPLAY_IDENTIFIER OPG_REL_ST ECU_ADDRESS 0x3fdd1a BYTE_ORDER MSB_LAST /end MEASUREMENT
/begin CHARACTERISTIC ip_opg_rel_st_isa_at "Specified relative ISAPWM setpoint at start" MAP 0xffe4d7be _REC_MAP_20_u2_u2_u1 99.99847412 _CNV_A_R_LINEAR_____8_CM 0. 99.99847412 DISPLAY_IDENTIFIER IP_OPG_REL_ST_ISA_AT
 /begin AXIS_DESCR COM_AXIS n _CNV_A_R_LINEAR_____10_CM 8 0. 8160. FORMAT "%4.0" AXIS_PTS_REF ldpm_n_1_thro /end AXIS_DESCR
 /begin AXIS_DESCR COM_AXIS tco _CNV_A_R_LINEAR_____11_CM 8 -48. 142.5 FORMAT "%5.1" AXIS_PTS_REF ldpm_tco_1_thro /end AXIS_DESCR
/end CHARACTERISTIC
/begin CHARACTERISTIC ip_opg_rel_st_isa_mt "Specified relative ISAPWM setpoint at start" MAP 0xffe4d83e _REC_MAP_20_u2_u2_u1 99.99847412 _CNV_A_R_LINEAR_____8_CM 0. 99.99847412 DISPLAY_IDENTIFIER IP_OPG_REL_ST_ISA_MT
 /begin AXIS_DESCR COM_AXIS n _CNV_A_R_LINEAR_____10_CM 8 0. 8160. FORMAT "%4.0" AXIS_PTS_REF ldpm_n_1_thro /end AXIS_DESCR
 /begin AXIS_DESCR COM_AXIS tco _CNV_A_R_LINEAR_____11_CM 8 -48. 142.5 FORMAT "%5.1" AXIS_PTS_REF ldpm_tco_1_thro /end AXIS_DESCR
/end CHARACTERISTIC
/begin CHARACTERISTIC ip_opg_rel_st_isa_pv "correction of the ralative ISAPWM setpoint at start via driver's demand" CURVE 0xffe4d8be _REC_CUR_20_u2_u1 99.99847412 _CNV_A_R_LINEAR_____8_CM 0. 99.99847412 DISPLAY_IDENTIFIER IP_OPG_REL_ST_ISA_PV
 /begin AXIS_DESCR COM_AXIS pv_av _CNV_A_R_LINEAR_____9_CM 6 0. 99.609375 FORMAT "%4.1" AXIS_PTS_REF ldp_pv_av_ip_opg_rel_st_isa_pv /end AXIS_DESCR
/end CHARACTERISTIC
/begin CHARACTERISTIC ip_fac_tia_opg_st_isa "TIA correction of the relative ISAPWM setpoint at start" CURVE 0xffe40c35 _REC_CUR_20_u1_u1 1.99220002 _CNV_A_R_LINEAR_____39_CM 0. 1.99220002 DISPLAY_IDENTIFIER IP_FAC_TIA_OPG_ST_ISA FORMAT "%5.3"
 /begin AXIS_DESCR COM_AXIS tia _CNV_A_R_LINEAR_____11_CM 6 -48. 142.5 FORMAT "%5.1" AXIS_PTS_REF ldp_tia_ip_fac_tia_opg_st_isa /end AXIS_DESCR
/end CHARACTERISTIC
/begin CHARACTERISTIC ip_fac_amp_opg_st_isa "Altitude correction of the relative ISAPWM setpoint at start" MAP 0xffe4503e _REC_MAP_20_u1_u2_u2 1.99220002 _CNV_A_R_LINEAR_____39_CM 0. 1.99220002 DISPLAY_IDENTIFIER IP_FAC_AMP_OPG_ST_ISA FORMAT "%5.3"
 /begin AXIS_DESCR COM_AXIS n _CNV_A_R_LINEAR_____10_CM 8 0. 8160. FORMAT "%4.0" AXIS_PTS_REF ldpm_n_1_thro /end AXIS_DESCR
 /begin AXIS_DESCR COM_AXIS amp _CNV_A_R_LINEAR_____49_CM 6 0. 5434. FORMAT "%7.2" AXIS_PTS_REF ldp_amp_ip_fac_amp_opg_st_isa /end AXIS_DESCR
/end CHARACTERISTIC
/begin CHARACTERISTIC ip_opg_sp_st_isa "ISAPWM at start" MAP 0xffe4d8ca _REC_MAP_20_u2_u2_u2 99.99847412 _CNV_A_R_LINEAR_____8_CM 0. 99.99847412 DISPLAY_IDENTIFIER IP_OPG_SP_ST_ISA
 /begin AXIS_DESCR COM_AXIS n _CNV_A_R_LINEAR_____10_CM 8 0. 8160. FORMAT "%4.0" AXIS_PTS_REF ldpm_n_1_thro /end AXIS_DESCR
 /begin AXIS_DESCR COM_AXIS opg_rel_st _CNV_A_R_LINEAR_____8_CM 12 0. 99.99847412 AXIS_PTS_REF ldp_opg_rel_st_ip_opg_sp_st_isa /end AXIS_DESCR
/end CHARACTERISTIC
/begin AXIS_PTS ldp_opg_rel_st_ip_opg_sp_st_isa "" 0xffe51176 opg_rel_st _REC_AXS_20_u2 99.99847412 _CNV_A_R_LINEAR_____8_CM 12 0. 99.99847412 DISPLAY_IDENTIFIER LDP_OPG_REL_ST_IP_OPG_SP_ST_ISA /end AXIS_PTS
/begin AXIS_PTS ldp_amp_ip_fac_amp_opg_st_isa "" 0xffe509a6 amp _REC_AXS_20_u2 5434. _CNV_A_R_LINEAR_____49_CM 6 0. 5434. DISPLAY_IDENTIFIER LDP_AMP_IP_FAC_AMP_OPG_ST_ISA FORMAT "%7.2" /end AXIS_PTS
/begin AXIS_PTS ldp_tia_ip_fac_tia_opg_st_isa "" 0xffe41293 tia _REC_AXS_20_u1 190.5 _CNV_A_R_LINEAR_____11_CM 6 -48. 142.5 DISPLAY_IDENTIFIER LDP_TIA_IP_FAC_TIA_OPG_ST_ISA FORMAT "%5.1" /end AXIS_PTS
/begin AXIS_PTS ldp_pv_av_ip_opg_rel_st_isa_pv "" 0xffe4115e pv_av _REC_AXS_20_u1 99.609375 _CNV_A_R_LINEAR_____9_CM 6 0. 99.609375 DISPLAY_IDENTIFIER LDP_PV_AV_IP_OPG_REL_ST_ISA_PV FORMAT "%4.1" /end AXIS_PTS
/begin MEASUREMENT map_sp "Setpoint of the manifold pressure" UWORD _CNV_A_R_LINEAR_____49_CM 1 100. 0. 5434. DISPLAY_IDENTIFIER MAP_SP ECU_ADDRESS 0x3fdc46 BYTE_ORDER MSB_LAST FORMAT "%7.2" /end MEASUREMENT
/begin MEASUREMENT pq_sp "Setpoint of the pressure quotient" UWORD _CNV_A_R_LINEAR_____37_CM 1 100. 0. 0.99998474 DISPLAY_IDENTIFIER PQ_SP ECU_ADDRESS 0x3fdc40 BYTE_ORDER MSB_LAST FORMAT "%7.5" /end MEASUREMENT
/begin MEASUREMENT maf_sp_ratio "Setpoint of the ratio MAF_SP / MAF_MAX_COR" UWORD _CNV_A_R_LINEAR_____37_CM 1 100. 0. 0.99998474 DISPLAY_IDENTIFIER MAF_SP_RATIO ECU_ADDRESS 0x3fdc52 BYTE_ORDER MSB_LAST FORMAT "%7.5" /end MEASUREMENT
/begin MEASUREMENT amp_mdl_ivs "Ambient pressure used for model adjustment inverse" UWORD _CNV_A_R_LINEAR_____49_CM 1 100. 0. 5434. DISPLAY_IDENTIFIER AMP_MDL_IVS ECU_ADDRESS 0x3fdc5a BYTE_ORDER MSB_LAST FORMAT "%7.2" /end MEASUREMENT
/begin MEASUREMENT prs_up_thr_ivs "Pressure upstream the throttle inverse" UWORD _CNV_A_R_LINEAR_____49_CM 1 100. 0. 5434. DISPLAY_IDENTIFIER PRS_UP_THR_IVS ECU_ADDRESS 0x3fdc5c BYTE_ORDER MSB_LAST FORMAT "%7.2" /end MEASUREMENT
/begin MEASUREMENT ar_red_sp_mmv_1 "Moving mean value of AR_RED_SP_1" UWORD _CNV_A_R_LINEAR_____382_CM 1 100. 0. 58.592855 DISPLAY_IDENTIFIER AR_RED_SP_MMV_1 ECU_ADDRESS 0x3fdc60 BYTE_ORDER MSB_LAST FORMAT "%7.4" /end MEASUREMENT
/begin MEASUREMENT ar_red_sp_mmv "Moving mean value of desired reduced area" UWORD _CNV_A_R_LINEAR_____382_CM 1 100. 0. 58.592855 DISPLAY_IDENTIFIER AR_RED_SP_MMV ECU_ADDRESS 0x3fdc62 BYTE_ORDER MSB_LAST FORMAT "%7.4" /end MEASUREMENT
/begin MEASUREMENT tps_sp_mdl_bas "Setpoint of the throttle position before maximum check         " UWORD _CNV_A_R_LINEAR_____53_CM 1 100. 0. 119.5 DISPLAY_IDENTIFIER TPS_SP_MDL_BAS ECU_ADDRESS 0x3fdc64 BYTE_ORDER MSB_LAST FORMAT "%7.3" /end MEASUREMENT
/begin MEASUREMENT tps_sp_mdl "Setpoint throttle position" UWORD _CNV_A_R_LINEAR_____53_CM 1 100. 0. 119.5 DISPLAY_IDENTIFIER TPS_SP_MDL ECU_ADDRESS 0x3fdc32 BYTE_ORDER MSB_LAST FORMAT "%7.3" /end MEASUREMENT
/begin MEASUREMENT tps_sp_mdl_max "Setpoint throttle position after limitation" UWORD _CNV_A_R_LINEAR_____53_CM 1 100. 0. 119.5 DISPLAY_IDENTIFIER TPS_SP_MDL_MAX ECU_ADDRESS 0x3fdc66 BYTE_ORDER MSB_LAST FORMAT "%7.3" /end MEASUREMENT
/begin MEASUREMENT tps_sp_mdl_bas_cor "Setpoint throttle position after linear interpolation      " UWORD _CNV_A_R_LINEAR_____53_CM 1 100. 0. 119.5 DISPLAY_IDENTIFIER TPS_SP_MDL_BAS_COR ECU_ADDRESS 0x3fdc68 BYTE_ORDER MSB_LAST FORMAT "%7.3" /end MEASUREMENT
/begin CHARACTERISTIC ip_amp_dec__maf_kgh_sp "pressure decrease in the air cleaner" CURVE 0xffe41c16 _REC_CUR_20_u2_u2 5434. _CNV_A_R_LINEAR_____49_CM 0. 5434. DISPLAY_IDENTIFIER IP_AMP_DEC__MAF_KGH_SP FORMAT "%7.2"
 /begin AXIS_DESCR COM_AXIS maf_kgh_sp _CNV_A_R_LINEAR_____115_CM 4 0. 2047.96875 FORMAT "%6.2" AXIS_PTS_REF ldp_maf_kgh_sp__amp_dec /end AXIS_DESCR
/end CHARACTERISTIC
/begin CHARACTERISTIC ip_tps_sp_mdl_max__n_32__maf_sp "Maximum throttle position setpoint at ignition key on" MAP 0xffe4f722 _REC_MAP_20_u2_u1_u2 119.5 _CNV_A_R_LINEAR_____53_CM 0. 119.5 DISPLAY_IDENTIFIER IP_TPS_SP_MDL_MAX__N_32__MAF_SP FORMAT "%7.3"
 /begin AXIS_DESCR COM_AXIS n_32 _CNV_A_R_LINEAR_____15_CM 8 0. 8160. FORMAT "%4.0" AXIS_PTS_REF ldp_n_32__tps_sp_mdl_max /end AXIS_DESCR
 /begin AXIS_DESCR COM_AXIS maf_sp _CNV_A_R_LINEAR_____108_CM 4 0. 1389. FORMAT "%7.2" AXIS_PTS_REF ldp_maf_sp__tps_sp_mdl_max /end AXIS_DESCR
/end CHARACTERISTIC
/begin CHARACTERISTIC lc_ar_red_fil_ena "Logical variable enabled for reduced throttle area filter" VALUE 0xffe40f3b _REC_VAL_20_u1 1. _CNV_A_R_LINEAR_____22_CM 0. 1. DISPLAY_IDENTIFIER LC_AR_RED_FIL_ENA FORMAT "%1.0" /end CHARACTERISTIC
/begin CHARACTERISTIC lc_tps_fil_ena "Logical variable enabled for throttle position setpoint filter" VALUE 0xffe40fe5 _REC_VAL_20_u1 1. _CNV_A_R_LINEAR_____22_CM 0. 1. DISPLAY_IDENTIFIER LC_TPS_FIL_ENA FORMAT "%1.0" /end CHARACTERISTIC
/begin CHARACTERISTIC ip_crlc_ar_red_sp "correlation constant for the moving mean value calculation of AR_RED_SP" CURVE 0xffe40ad7 _REC_CUR_20_u1_u2 0.9960940000000002 _CNV_A_R_LINEAR_____50_CM 0. 0.996094 DISPLAY_IDENTIFIER IP_CRLC_AR_RED_SP FORMAT "%5.3"
 /begin AXIS_DESCR COM_AXIS pq_sp _CNV_A_R_LINEAR_____37_CM 8 0. 0.99998474 FORMAT "%7.5" AXIS_PTS_REF ldp_pq_sp__crlc_ar_red_sp /end AXIS_DESCR
/end CHARACTERISTIC
/begin CHARACTERISTIC lc_inh_isapwm_man_as "logical variable to inhibit ISAPWM setpoint by application system" VALUE 0xffe40f7d _REC_VAL_20_u1 1. _CNV_A_R_LINEAR_____0_CM 0. 1. DISPLAY_IDENTIFIER LC_INH_ISAPWM_MAN_AS FORMAT "%2.0" /end CHARACTERISTIC
/begin CHARACTERISTIC c_cycnr_isa_off "Number of cycles at ignition key off for ISA shakers" VALUE 0xffe406dd _REC_VAL_20_u1 255. _CNV_A_R_LINEAR_____0_CM 0. 255. DISPLAY_IDENTIFIER C_CYCNR_ISA_OFF FORMAT "%3.0" /end CHARACTERISTIC
/begin CHARACTERISTIC c_isapwm_off_high "ISAPWM during opening phase" VALUE 0xffe41690 _REC_VAL_20_u2 99.99847412 _CNV_A_R_LINEAR_____8_CM 0. 99.99847412 DISPLAY_IDENTIFIER C_ISAPWM_OFF_HIGH /end CHARACTERISTIC
/begin CHARACTERISTIC c_isapwm_off_low "ISAPWM during closing phase" VALUE 0xffe41692 _REC_VAL_20_u2 99.99847412 _CNV_A_R_LINEAR_____8_CM 0. 99.99847412 DISPLAY_IDENTIFIER C_ISAPWM_OFF_LOW /end CHARACTERISTIC
/begin CHARACTERISTIC c_t_isapwm_off "Delay time ISAPWM" VALUE 0xffe4089b _REC_VAL_20_u1 2550. _CNV_A_R_LINEAR_____31_CM 0. 2550. DISPLAY_IDENTIFIER C_T_ISAPWM_OFF FORMAT "%4.0" /end CHARACTERISTIC
/begin CHARACTERISTIC c_lgrd_isapwm_off "Change limitation during shaking" VALUE 0xffe41708 _REC_VAL_20_u2 99.99847412 _CNV_A_R_LINEAR_____486_CM 0. 99.99847412 DISPLAY_IDENTIFIER C_LGRD_ISAPWM_OFF /end CHARACTERISTIC
/begin MEASUREMENT maf_kgh_sp_isa_clc "maximum setpoint ISA mass air flow at PSI_SP_ISA" UWORD _CNV_A_R_LINEAR_____115_CM 1 100. 0. 2047.96875 DISPLAY_IDENTIFIER MAF_KGH_SP_ISA_CLC ECU_ADDRESS 0x3fdc3e BYTE_ORDER MSB_LAST FORMAT "%7.2" /end MEASUREMENT
/begin MEASUREMENT pq_sp_isa "setpoint pressure quotient at ISA, corrected value" UWORD _CNV_A_R_LINEAR_____37_CM 1 100. 0. 0.99998474 DISPLAY_IDENTIFIER PQ_SP_ISA ECU_ADDRESS 0x3fdc74 BYTE_ORDER MSB_LAST FORMAT "%7.5" /end MEASUREMENT
/begin MEASUREMENT pq_sp_isa_1 "setpoint pressure quotient at ISA, interim value" UWORD _CNV_A_R_LINEAR_____37_CM 1 100. 0. 0.99998474 DISPLAY_IDENTIFIER PQ_SP_ISA_1 ECU_ADDRESS 0x3fdc72 BYTE_ORDER MSB_LAST FORMAT "%7.5" /end MEASUREMENT
/begin MEASUREMENT maf_kgh_sp_thr "setpoint throttle mass air" UWORD _CNV_A_R_LINEAR_____115_CM 1 100. 0. 2047.96875 DISPLAY_IDENTIFIER MAF_KGH_SP_THR ECU_ADDRESS 0x3fdc6e BYTE_ORDER MSB_LAST FORMAT "%7.2" /end MEASUREMENT
/begin MEASUREMENT maf_kgh_sp_isa_raw "setpoint mass air flow idle speed actuator" UWORD _CNV_A_R_LINEAR_____115_CM 1 100. 0. 2047.96875 DISPLAY_IDENTIFIER MAF_KGH_SP_ISA_RAW ECU_ADDRESS 0x3fdc70 BYTE_ORDER MSB_LAST FORMAT "%7.2" /end MEASUREMENT
/begin MEASUREMENT psi_sp "Setpoint air flow function rate" UWORD _CNV_A_R_LINEAR_____377_CM 1 100. 0. 8.880330000000001 DISPLAY_IDENTIFIER PSI_SP ECU_ADDRESS 0x3fdc58 BYTE_ORDER MSB_LAST FORMAT "%6.4" /end MEASUREMENT
/begin MEASUREMENT psi_sp_isa "Setpoint air flow function rate ISA" UWORD _CNV_A_R_LINEAR_____377_CM 1 100. 0. 8.880330000000001 DISPLAY_IDENTIFIER PSI_SP_ISA ECU_ADDRESS 0x3fdc76 BYTE_ORDER MSB_LAST FORMAT "%5.4" /end MEASUREMENT
/begin MEASUREMENT ar_red_isa_sp_mmv "filtered setpoint reduced area at ISA valve including AR_RED-controller share AR_RED_ISA_DIF_I_REL_MMV" UWORD _CNV_A_R_LINEAR_____382_CM 1 100. 0. 58.592855 DISPLAY_IDENTIFIER AR_RED_ISA_SP_MMV ECU_ADDRESS 0x3fdc44 BYTE_ORDER MSB_LAST FORMAT "%7.4" /end MEASUREMENT
/begin MEASUREMENT ar_red_isa_sp_mmv_1 "filtered setpoint reduced area at ISA valve" UWORD _CNV_A_R_LINEAR_____382_CM 1 100. 0. 58.592855 DISPLAY_IDENTIFIER AR_RED_ISA_SP_MMV_1 ECU_ADDRESS 0x3fdc7a BYTE_ORDER MSB_LAST FORMAT "%7.4" /end MEASUREMENT
/begin MEASUREMENT isapwm_isa_1 "idle speed actuator duty cycle coil 1 (opening)" UWORD _CNV_A_R_LINEAR_____8_CM 1 100. 0. 99.99847412 DISPLAY_IDENTIFIER ISAPWM_ISA_1 ECU_ADDRESS 0x3fdc3a BYTE_ORDER MSB_LAST FORMAT "%5.2" /end MEASUREMENT
/begin MEASUREMENT isapwm_isa_2 "idle speed actuator duty cycle coil 2 (closing)" UWORD _CNV_A_R_LINEAR_____8_CM 1 100. 0. 99.99847412 DISPLAY_IDENTIFIER ISAPWM_ISA_2 ECU_ADDRESS 0x3fdc3c BYTE_ORDER MSB_LAST FORMAT "%5.2" /end MEASUREMENT
/begin MEASUREMENT isapwm_mmv "moving mean value of idle speed actuator duty cycle" UWORD _CNV_A_R_LINEAR_____8_CM 1 100. 0. 99.99847412 DISPLAY_IDENTIFIER ISAPWM_MMV ECU_ADDRESS 0x3fdc38 BYTE_ORDER MSB_LAST FORMAT "%5.2" /end MEASUREMENT
/begin CHARACTERISTIC ip_crlc_ar_red_isa_sp "correlation constant for the moving mean value calculation of AR_RED_ISA_SP_MMV_1" CURVE 0xffe40acf _REC_CUR_20_u1_u2 0.9960940000000002 _CNV_A_R_LINEAR_____50_CM 0. 0.996094 DISPLAY_IDENTIFIER IP_CRLC_AR_RED_ISA_SP FORMAT "%5.3"
 /begin AXIS_DESCR COM_AXIS pq_sp_isa _CNV_A_R_LINEAR_____37_CM 8 0. 0.99998474 FORMAT "%7.5" AXIS_PTS_REF ldp_pq_sp_isa /end AXIS_DESCR
/end CHARACTERISTIC
/begin CHARACTERISTIC ip_isapwm_isa "ISA position setpoint" CURVE 0xffe4bc72 _REC_CUR_20_u2_u2 99.99847412 _CNV_A_R_LINEAR_____8_CM 0. 99.99847412 DISPLAY_IDENTIFIER IP_ISAPWM_ISA FORMAT "%5.2"
 /begin AXIS_DESCR COM_AXIS ar_red_isa_sp_mmv _CNV_A_R_LINEAR_____382_CM 16 0. 58.592855 FORMAT "%7.4" AXIS_PTS_REF ldp_ar_red_isa_sp_mmv /end AXIS_DESCR
/end CHARACTERISTIC
/begin CHARACTERISTIC c_isapwm_man_as "maximum reduced area at full opened idle speed actuator valve" VALUE 0xffe4168e _REC_VAL_20_u2 99.99847412 _CNV_A_R_LINEAR_____8_CM 0. 99.99847412 DISPLAY_IDENTIFIER C_ISAPWM_MAN_AS FORMAT "%5.2" /end CHARACTERISTIC
/begin CHARACTERISTIC c_isapwm_ofs_as "additive ISAPWM offset by application system" VALUE 0xffe4041a _REC_VAL_20_s2 99.99847412 _CNV_A_R_LINEAR_____111_CM -50. 49.99847412 DISPLAY_IDENTIFIER C_ISAPWM_OFS_AS FORMAT "%7.3" /end CHARACTERISTIC
/begin CHARACTERISTIC c_crlc_isapwm_mmv "correlation constant for moving mean value calculation of ISAPWM_ISA" VALUE 0xffe40684 _REC_VAL_20_u1 0.9960940000000002 _CNV_A_R_LINEAR_____50_CM 0. 0.996094 DISPLAY_IDENTIFIER C_CRLC_ISAPWM_MMV FORMAT "%5.3" /end CHARACTERISTIC
/begin CHARACTERISTIC c_isapwm_isa_diag "diagnosis substitute value in case of  \"STATE_ISA_DIAG = error active / substitute opening\"" VALUE 0xffe41688 _REC_VAL_20_u2 99.99847412 _CNV_A_R_LINEAR_____8_CM 0. 99.99847412 DISPLAY_IDENTIFIER C_ISAPWM_ISA_DIAG FORMAT "%5.2" /end CHARACTERISTIC
/begin CHARACTERISTIC ip_fac_isapwm_vb "battery voltage correction for ISAPWM duty cycle" CURVE 0xffe40b92 _REC_CUR_20_u1_u1 1.99220002 _CNV_A_R_LINEAR_____39_CM 0. 1.99220002 DISPLAY_IDENTIFIER IP_FAC_ISAPWM_VB FORMAT "%5.3"
 /begin AXIS_DESCR COM_AXIS vb _CNV_A_R_LINEAR_____34_CM 8 0. 25.8984 FORMAT "%3.1" AXIS_PTS_REF ldpm_vb_1 /end AXIS_DESCR
/end CHARACTERISTIC
/begin MEASUREMENT fac_isapwm_vb "battery voltage correction for idle speed actuator duty cycle" UBYTE _CNV_A_R_LINEAR_____39_CM 1 100. 0. 1.99220002 DISPLAY_IDENTIFIER FAC_ISAPWM_VB ECU_ADDRESS 0x3fea80 FORMAT "%5.3" /end MEASUREMENT
/begin MEASUREMENT maf_turb_ratio "mass air flow ratio of MAF_SP_ISA / MAF_SP" UBYTE _CNV_A_R_LINEAR_____50_CM 1 100. 0. 0.996094 DISPLAY_IDENTIFIER MAF_TURB_RATIO ECU_ADDRESS 0x3fea7f FORMAT "%5.3" /end MEASUREMENT
/begin CHARACTERISTIC c_tps_max_diag "TPS_SP_MDL Limitation at TPS limp home of channel 1 or 2" VALUE 0xffe41a98 _REC_VAL_20_u2 119.5 _CNV_A_R_LINEAR_____53_CM 0. 119.5 DISPLAY_IDENTIFIER C_TPS_MAX_DIAG FORMAT "%7.3" /end CHARACTERISTIC
/begin MEASUREMENT ar_red_isa_sp_1 "setpoint reduced area at ISA valve previous filtering" UWORD _CNV_A_R_LINEAR_____382_CM 1 100. 0. 58.592855 DISPLAY_IDENTIFIER AR_RED_ISA_SP_1 ECU_ADDRESS 0x3fdc78 BYTE_ORDER MSB_LAST FORMAT "%7.4" /end MEASUREMENT
/begin MEASUREMENT maf_kgh_sp_isa_min "Minimum setpoint ISA mass air flow at PSI_SP_ISA" UWORD _CNV_A_R_LINEAR_____115_CM 1 100. 0. 2047.96875 DISPLAY_IDENTIFIER MAF_KGH_SP_ISA_MIN ECU_ADDRESS 0x3fdc7c BYTE_ORDER MSB_LAST FORMAT "%7.2" /end MEASUREMENT
/begin MEASUREMENT maf_kgh_sp_thr_min "Minimum setpoint throttle mass air flow at PSI_SP" UWORD _CNV_A_R_LINEAR_____115_CM 1 100. 0. 2047.96875 DISPLAY_IDENTIFIER MAF_KGH_SP_THR_MIN ECU_ADDRESS 0x3fdc80 BYTE_ORDER MSB_LAST FORMAT "%7.2" /end MEASUREMENT
/begin MEASUREMENT ar_red_isa_min "Minimum reduced area at closed ISA" UWORD _CNV_A_R_LINEAR_____382_CM 1 100. 0. 58.592855 DISPLAY_IDENTIFIER AR_RED_ISA_MIN ECU_ADDRESS 0x3fdc7e BYTE_ORDER MSB_LAST FORMAT "%7.4" /end MEASUREMENT
/begin MEASUREMENT ar_red_min "Minimum reduced area at closed throttle" UWORD _CNV_A_R_LINEAR_____382_CM 1 100. 0. 58.592855 DISPLAY_IDENTIFIER AR_RED_MIN ECU_ADDRESS 0x3fdc82 BYTE_ORDER MSB_LAST FORMAT "%7.4" /end MEASUREMENT
/begin MEASUREMENT maf_kgh_sp_isa "setpoint ISA mass air flow" UWORD _CNV_A_R_LINEAR_____115_CM 1 100. 0. 2047.96875 DISPLAY_IDENTIFIER MAF_KGH_SP_ISA ECU_ADDRESS 0x3fdc6c BYTE_ORDER MSB_LAST FORMAT "%7.2" /end MEASUREMENT
/begin MEASUREMENT maf_kgh_sp_isa_1 "setpoint ISA mass air flow, intermediate value" UWORD _CNV_A_R_LINEAR_____115_CM 1 100. 0. 2047.96875 DISPLAY_IDENTIFIER MAF_KGH_SP_ISA_1 ECU_ADDRESS 0x3fdc6a BYTE_ORDER MSB_LAST FORMAT "%7.2" /end MEASUREMENT
/begin AXIS_PTS ldp_maf_kgh_sp__amp_dec "" 0xffe50e94 maf_kgh_sp _REC_AXS_20_u2 2047.96875 _CNV_A_R_LINEAR_____115_CM 4 0. 2047.96875 DISPLAY_IDENTIFIER LDP_MAF_KGH_SP__AMP_DEC FORMAT "%6.2" /end AXIS_PTS
/begin AXIS_PTS ldp_maf_sp__tps_sp_mdl_max "" 0xffe50eba maf_sp _REC_AXS_20_u2 1389. _CNV_A_R_LINEAR_____108_CM 4 0. 1389. DISPLAY_IDENTIFIER LDP_MAF_SP__TPS_SP_MDL_MAX FORMAT "%7.2" /end AXIS_PTS
/begin AXIS_PTS ldp_n_32__tps_sp_mdl_max "" 0xffe4809a n_32 _REC_AXS_20_u1 816. _CNV_A_R_LINEAR_____15_CM 8 0. 8160. DISPLAY_IDENTIFIER LDP_N_32__TPS_SP_MDL_MAX FORMAT "%4.0" /end AXIS_PTS
/begin AXIS_PTS ldp_pq_sp__crlc_ar_red_sp "" 0xffe511ee pq_sp _REC_AXS_20_u2 0.99998474 _CNV_A_R_LINEAR_____37_CM 8 0. 0.99998474 DISPLAY_IDENTIFIER LDP_PQ_SP__CRLC_AR_RED_SP FORMAT "%7.5" /end AXIS_PTS
/begin AXIS_PTS ldp_pq_sp_isa "" 0xffe51200 pq_sp_isa _REC_AXS_20_u2 0.99998474 _CNV_A_R_LINEAR_____37_CM 8 0. 0.99998474 DISPLAY_IDENTIFIER LDP_PQ_SP_ISA FORMAT "%7.5" /end AXIS_PTS
/begin AXIS_PTS ldp_ar_red_isa_sp_mmv "" 0xffe50a3a ar_red_isa_sp_mmv _REC_AXS_20_u2 58.592855 _CNV_A_R_LINEAR_____382_CM 16 0. 58.592855 DISPLAY_IDENTIFIER LDP_AR_RED_ISA_SP_MMV FORMAT "%7.4" /end AXIS_PTS
/begin AXIS_PTS ldpm_vb_1 "" 0xffe48701 vb _REC_AXS_20_u1 25.8984 _CNV_A_R_LINEAR_____34_CM 8 0. 25.8984 DISPLAY_IDENTIFIER LDPM_VB_1 FORMAT "%3.1" /end AXIS_PTS
/begin MEASUREMENT ar_red_sp_1 "Setpoint reduced throttle area" UWORD _CNV_A_R_LINEAR_____382_CM 1 100. 0. 58.592855 DISPLAY_IDENTIFIER AR_RED_SP_1 ECU_ADDRESS 0x3fdc5e BYTE_ORDER MSB_LAST FORMAT "%7.4" /end MEASUREMENT
/begin MEASUREMENT lv_h_load_tps_sp "logical value for 'very high load'" UBYTE _CNV_S_2_RANGE______2_CM 1 100. 0. 1. DISPLAY_IDENTIFIER LV_H_LOAD_TPS_SP ECU_ADDRESS 0x3fea84 /end MEASUREMENT
/begin CHARACTERISTIC c_pq_sp_max "Pressure quotient threshold" VALUE 0xffe41878 _REC_VAL_20_u2 0.99998474 _CNV_A_R_LINEAR_____37_CM 0. 0.99998474 DISPLAY_IDENTIFIER C_PQ_SP_MAX FORMAT "%7.5" /end CHARACTERISTIC
/begin CHARACTERISTIC c_pq_sp_max_hys "Hysteresis for pressure quotient threshold" VALUE 0xffe4187a _REC_VAL_20_u2 0.99998474 _CNV_A_R_LINEAR_____37_CM 0. 0.99998474 DISPLAY_IDENTIFIER C_PQ_SP_MAX_HYS FORMAT "%7.5" /end CHARACTERISTIC
/begin MEASUREMENT isapwm "idle speed actuator duty cycle for substitute mass air flow calculation" UWORD _CNV_A_R_LINEAR_____8_CM 1 100. 0. 99.99847412 DISPLAY_IDENTIFIER ISAPWM ECU_ADDRESS 0x3fdc36 BYTE_ORDER MSB_LAST FORMAT "%5.2" /end MEASUREMENT
/begin CHARACTERISTIC ip_isapwm_isa_pwl "ISAPWM setpoint by LV_TPS_PWL" CURVE 0xffe41c5a _REC_CUR_20_u2_u1 99.99847412 _CNV_A_R_LINEAR_____8_CM 0. 99.99847412 DISPLAY_IDENTIFIER IP_ISAPWM_ISA_PWL
 /begin AXIS_DESCR COM_AXIS n_32 _CNV_A_R_LINEAR_____15_CM 4 0. 8160. FORMAT "%4.0" AXIS_PTS_REF ldp_n_32__isapwm_isa_pwl /end AXIS_DESCR
/end CHARACTERISTIC
/begin CHARACTERISTIC ip_isapwm_ivs_cor_isa "ISAPWM setpoint without VB correction" CURVE 0xffe4bc92 _REC_CUR_20_u2_u2 99.99847412 _CNV_A_R_LINEAR_____8_CM 0. 99.99847412 DISPLAY_IDENTIFIER IP_ISAPWM_IVS_COR_ISA
 /begin AXIS_DESCR COM_AXIS isapwm_cor_isa _CNV_A_R_LINEAR_____8_CM 8 0. 99.99847412 AXIS_PTS_REF ldp_isapwm_cor_isa__isapwm_isa /end AXIS_DESCR
/end CHARACTERISTIC
/begin AXIS_PTS ldp_n_32__isapwm_isa_pwl "" 0xffe4109f n_32 _REC_AXS_20_u1 8160. _CNV_A_R_LINEAR_____15_CM 4 0. 8160. DISPLAY_IDENTIFIER LDP_N_32__ISAPWM_ISA_PWL FORMAT "%4.0" /end AXIS_PTS
/begin AXIS_PTS ldp_isapwm_cor_isa__isapwm_isa "" 0xffe50c00 isapwm_cor_isa _REC_AXS_20_u2 99.99847412 _CNV_A_R_LINEAR_____8_CM 8 0. 99.99847412 DISPLAY_IDENTIFIER LDP_ISAPWM_COR_ISA__ISAPWM_ISA /end AXIS_PTS
/begin MEASUREMENT isapwm_isa "idle speed actuator duty cycle" UWORD _CNV_A_R_LINEAR_____8_CM 1 100. 0. 99.99847412 DISPLAY_IDENTIFIER ISAPWM_ISA ECU_ADDRESS 0x3fdc34 BYTE_ORDER MSB_LAST FORMAT "%5.2" /end MEASUREMENT
/begin MEASUREMENT isapwm_cor_isa "idle speed actuator duty cycle" UWORD _CNV_A_R_LINEAR_____8_CM 1 100. 0. 99.99847412 DISPLAY_IDENTIFIER ISAPWM_COR_ISA ECU_ADDRESS 0x3fdc48 BYTE_ORDER MSB_LAST FORMAT "%5.2" /end MEASUREMENT
/begin MEASUREMENT maf_kgh_sp "Setpoint mass air flow into the manifold" UWORD _CNV_A_R_LINEAR_____115_CM 1 100. 0. 2047.96875 DISPLAY_IDENTIFIER MAF_KGH_SP ECU_ADDRESS 0x3fdc54 BYTE_ORDER MSB_LAST FORMAT "%7.2" /end MEASUREMENT
/begin MEASUREMENT maf_sp_add_fast_load_im "additional setpoint mass air flow" SWORD _CNV_A_R_LINEAR_____487_CM 1 100. -1389. 1388.957611 DISPLAY_IDENTIFIER MAF_SP_ADD_FAST_LOAD_IM ECU_ADDRESS 0x3fdc4a BYTE_ORDER MSB_LAST FORMAT "%8.2" /end MEASUREMENT
/begin MEASUREMENT fac_maf_dif_sp "factor air mass difference" UWORD _CNV_A_R_LINEAR_____20_CM 1 100. 0. 1.99996948 DISPLAY_IDENTIFIER FAC_MAF_DIF_SP ECU_ADDRESS 0x3fdc50 BYTE_ORDER MSB_LAST FORMAT "%7.5" /end MEASUREMENT
/begin MEASUREMENT pq_sp_wout_maf_add "setpoint pressure quotient manifold air pressure/ambient pressure" UWORD _CNV_A_R_LINEAR_____37_CM 1 100. 0. 0.99998474 DISPLAY_IDENTIFIER PQ_SP_WOUT_MAF_ADD ECU_ADDRESS 0x3fdc42 BYTE_ORDER MSB_LAST FORMAT "%7.5" /end MEASUREMENT
/begin MEASUREMENT map_sp_wout_maf_add "setpoint manifold air pressure without MAF_SP_ADD_FAST_LOAD_IM" UWORD _CNV_A_R_LINEAR_____49_CM 1 100. 0. 5434. DISPLAY_IDENTIFIER MAP_SP_WOUT_MAF_ADD ECU_ADDRESS 0x3fdc56 BYTE_ORDER MSB_LAST FORMAT "%7.2" /end MEASUREMENT
/begin CHARACTERISTIC ip_tps_sp_mdl_bas "throttle position setpoint (!inverse of IP_AR_RED_THR__TPS_SEG!)" CURVE 0xffe4f702 _REC_CUR_20_u2_u2 119.5 _CNV_A_R_LINEAR_____53_CM 0. 119.5 DISPLAY_IDENTIFIER IP_TPS_SP_MDL_BAS FORMAT "%7.3"
 /begin AXIS_DESCR COM_AXIS ar_red_sp_mmv _CNV_A_R_LINEAR_____382_CM 16 0. 58.592855 FORMAT "%7.4" AXIS_PTS_REF ldp_ar_red_sp_mmv /end AXIS_DESCR
/end CHARACTERISTIC
/begin AXIS_PTS ldp_ar_red_sp_mmv "" 0xffe50a5c ar_red_sp_mmv _REC_AXS_20_u2 58.592855 _CNV_A_R_LINEAR_____382_CM 16 0. 58.592855 DISPLAY_IDENTIFIER LDP_AR_RED_SP_MMV FORMAT "%7.4" /end AXIS_PTS
/begin CHARACTERISTIC ip_fac_maf_dif_sp "factor for air mass difference, raw value" MAP 0xffe4b076 _REC_MAP_20_u2_u2_u2 1.99996948 _CNV_A_R_LINEAR_____20_CM 0. 1.99996948 DISPLAY_IDENTIFIER IP_FAC_MAF_DIF_SP FORMAT "%7.5"
 /begin AXIS_DESCR COM_AXIS n _CNV_A_R_LINEAR_____10_CM 8 0. 8160. FORMAT "%4.0" AXIS_PTS_REF ldp_n_ip_fac_maf_dif_sp /end AXIS_DESCR
 /begin AXIS_DESCR COM_AXIS pq_sp_wout_maf_add _CNV_A_R_LINEAR_____37_CM 8 0. 0.99998474 FORMAT "%7.6" AXIS_PTS_REF ldp_pq_sp_wout_maf_add_ip_fac /end AXIS_DESCR
/end CHARACTERISTIC
/begin CHARACTERISTIC ip_maf_sp_add_fast_load_im "additional maf setpoint for fast manifold filling" CURVE 0xffe4d0ba _REC_CUR_20_u2_u2 2777.957611 _CNV_A_R_LINEAR_____488_CM -1389. 1388.957611 DISPLAY_IDENTIFIER IP_MAF_SP_ADD_FAST_LOAD_IM FORMAT "%8.2"
 /begin AXIS_DESCR COM_AXIS online_dummy _CNV_A_R_LINEAR_____489_CM 8 -8192. 8191.75 FORMAT "%8.2" AXIS_PTS_REF ldp_maf_dif_sp_cor_ip_maf_add /end AXIS_DESCR
/end CHARACTERISTIC
/begin AXIS_PTS ldp_n_ip_fac_maf_dif_sp "" 0xffe51094 n _REC_AXS_20_u2 8160. _CNV_A_R_LINEAR_____10_CM 8 0. 8160. DISPLAY_IDENTIFIER LDP_N_IP_FAC_MAF_DIF_SP FORMAT "%4.0" /end AXIS_PTS
/begin AXIS_PTS ldp_maf_dif_sp_cor_ip_maf_add "" 0xffe50d88 online_dummy _REC_AXS_20_u2 16383.75 _CNV_A_R_LINEAR_____489_CM 8 -8192. 8191.75 DISPLAY_IDENTIFIER LDP_MAF_DIF_SP_COR_IP_MAF_ADD FORMAT "%8.2" /end AXIS_PTS
/begin CHARACTERISTIC lc_ar_red_isa_fil_ena "logical variable to enable reduced ISA area filter" VALUE 0xffe40f3c _REC_VAL_20_u1 1. _CNV_A_R_LINEAR_____0_CM 0. 1. DISPLAY_IDENTIFIER LC_AR_RED_ISA_FIL_ENA FORMAT "%2.0" /end CHARACTERISTIC
/begin CHARACTERISTIC lc_pq_sp_isa_maf_add "1: ISA actuation including MAF_SP_ADD_FAST_LOAD_IM" VALUE 0xffe40fc8 _REC_VAL_20_u1 1. _CNV_A_R_LINEAR_____0_CM 0. 1. DISPLAY_IDENTIFIER LC_PQ_SP_ISA_MAF_ADD FORMAT "%2.0" /end CHARACTERISTIC
/begin MEASUREMENT maf_dif_sp "air mass difference, filtered value" SWORD _CNV_A_R_LINEAR_____490_CM 1 100. -8192. 8191.75 DISPLAY_IDENTIFIER MAF_DIF_SP ECU_ADDRESS 0x3fdc4e BYTE_ORDER MSB_LAST FORMAT "%8.2" /end MEASUREMENT
/begin MEASUREMENT maf_dif_sp_1 "air mass difference, raw value" SWORD _CNV_A_R_LINEAR_____490_CM 1 100. -8192. 8191.75 DISPLAY_IDENTIFIER MAF_DIF_SP_1 ECU_ADDRESS 0x3fdc4c BYTE_ORDER MSB_LAST FORMAT "%8.2" /end MEASUREMENT
/begin CHARACTERISTIC c_pq_sp_max_isa "Pressure quotient threshold at ISA valve" VALUE 0xffe4187c _REC_VAL_20_u2 0.99998474 _CNV_A_R_LINEAR_____37_CM 0. 0.99998474 DISPLAY_IDENTIFIER C_PQ_SP_MAX_ISA FORMAT "%7.5" /end CHARACTERISTIC
/begin CHARACTERISTIC c_crlc_maf_dif_sp "correction constant for MAF_DIF_SP filter" VALUE 0xffe4155c _REC_VAL_20_u2 0.99998474 _CNV_A_R_LINEAR_____37_CM 0. 0.99998474 DISPLAY_IDENTIFIER C_CRLC_MAF_DIF_SP FORMAT "%7.6" /end CHARACTERISTIC
/begin AXIS_PTS ldp_pq_sp_wout_maf_add_ip_fac "" 0xffe51212 pq_sp_wout_maf_add _REC_AXS_20_u2 0.99998474 _CNV_A_R_LINEAR_____37_CM 8 0. 0.99998474 DISPLAY_IDENTIFIER LDP_PQ_SP_WOUT_MAF_ADD_IP_FAC FORMAT "%7.6" /end AXIS_PTS
/begin MEASUREMENT lv_ast "Auxiliary function \"After-start\"" UBYTE _CNV_S_2_RANGE______2_CM 1 100. 0. 1. DISPLAY_IDENTIFIER LV_AST ECU_ADDRESS 0x3fe8b1 BIT_MASK 0x1 /end MEASUREMENT
/begin CHARACTERISTIC c_t_max_rest "Time delay after switching on from LV_ST to detect LV_REST" VALUE 0xffe408ac _REC_VAL_20_u1 25.4 _CNV_A_R_LINEAR_____30_CM 1. 255. DISPLAY_IDENTIFIER C_T_MAX_REST FORMAT "%4.0" /end CHARACTERISTIC
/begin CHARACTERISTIC c_tco_dif_max_rest "Coolant temperature threshold to detect LV_REST" VALUE 0xffe408f2 _REC_VAL_20_u1 0.6 _CNV_A_R_LINEAR_____12_CM 0. 60. DISPLAY_IDENTIFIER C_TCO_DIF_MAX_REST FORMAT "%4.1" /end CHARACTERISTIC
/begin MEASUREMENT tco_rest "Coolant temperature, stored to detect a re-start" UBYTE _CNV_A_R_LINEAR_____11_CM 1 100. -48. 142.5 DISPLAY_IDENTIFIER TCO_REST ECU_ADDRESS 0x3fe783 FORMAT "%3.0" /end MEASUREMENT
/begin MEASUREMENT lv_rest "Auxiliary function \"Re-start\"" UBYTE _CNV_S_2_RANGE______2_CM 1 100. 0. 1. DISPLAY_IDENTIFIER LV_REST ECU_ADDRESS 0x3fe785 BIT_MASK 0x1 /end MEASUREMENT
/begin MEASUREMENT cyc_cast "cycle counter at start and after start" UWORD _CNV_A_R_LINEAR_____0_CM 1 100. 0. 65535. DISPLAY_IDENTIFIER CYC_CAST ECU_ADDRESS 0x3fd86c BYTE_ORDER MSB_LAST FORMAT "%5.0" /end MEASUREMENT
/begin MEASUREMENT t_st_es "Time after transition from LV_ST to LV_ES" UWORD _CNV_A_R_LINEAR_____24_CM 1 100. 0.1 6553.5 DISPLAY_IDENTIFIER T_ST_ES ECU_ADDRESS 0x3fd870 BYTE_ORDER MSB_LAST FORMAT "%6.1" /end MEASUREMENT
/begin CHARACTERISTIC c_t_min_ecu_rest "Time threshold to detect new start after start-break off." VALUE 0xffe419b0 _REC_VAL_20_u2 6553.400000000001 _CNV_A_R_LINEAR_____24_CM 0.1 6553.5 DISPLAY_IDENTIFIER C_T_MIN_ECU_REST FORMAT "%6.1" /end CHARACTERISTIC
/begin CHARACTERISTIC c_cyc_cast_min_st_es "Min value of CYC_CAST for the detection of  LV_ST_ES" VALUE 0xffe415a4 _REC_VAL_20_u2 65535. _CNV_A_R_LINEAR_____0_CM 0. 65535. DISPLAY_IDENTIFIER C_CYC_CAST_MIN_ST_ES FORMAT "%5.0" /end CHARACTERISTIC
/begin MEASUREMENT lv_st_es "Detection of engine start break off (passive / active)" UBYTE _CNV_S_2_RANGE______2_CM 1 100. 0. 1. DISPLAY_IDENTIFIER LV_ST_ES ECU_ADDRESS 0x3fe786 /end MEASUREMENT
/begin MEASUREMENT lv_stall "Auxiliary function \"Engine Stall detected\"" UBYTE _CNV_S_2_RANGE______2_CM 1 100. 0. 1. DISPLAY_IDENTIFIER LV_STALL ECU_ADDRESS 0x3fe784 /end MEASUREMENT
/begin CHARACTERISTIC c_cyc_cast_max_st_es "Max value of CYC_CAST for the beginning of  incrementation if LV_ST_ES is set" VALUE 0xffe415a2 _REC_VAL_20_u2 65535. _CNV_A_R_LINEAR_____0_CM 0. 65535. DISPLAY_IDENTIFIER C_CYC_CAST_MAX_ST_ES FORMAT "%5.0" /end CHARACTERISTIC
/begin MEASUREMENT tps_sp_st "TPS setpoint at start" UWORD _CNV_A_R_LINEAR_____53_CM 1 100. 0. 119.5 DISPLAY_IDENTIFIER TPS_SP_ST ECU_ADDRESS 0x3fdcc0 BYTE_ORDER MSB_LAST FORMAT "%7.3" /end MEASUREMENT
/begin MEASUREMENT tps_rel_st "" UWORD _CNV_A_R_LINEAR_____8_CM 1 100. 0. 99.99847412 DISPLAY_IDENTIFIER TPS_REL_ST ECU_ADDRESS 0x3fdcc2 BYTE_ORDER MSB_LAST /end MEASUREMENT
/begin CHARACTERISTIC ip_tps_rel_st_at "Specified relative TPS setpoint at start" MAP 0xffe4f55a _REC_MAP_20_u2_u2_u1 99.99847412 _CNV_A_R_LINEAR_____8_CM 0. 99.99847412 DISPLAY_IDENTIFIER IP_TPS_REL_ST_AT
 /begin AXIS_DESCR COM_AXIS n _CNV_A_R_LINEAR_____10_CM 8 0. 8160. FORMAT "%4.0" AXIS_PTS_REF ldpm_n_1_thro /end AXIS_DESCR
 /begin AXIS_DESCR COM_AXIS tco _CNV_A_R_LINEAR_____11_CM 8 -48. 142.5 FORMAT "%5.1" AXIS_PTS_REF ldpm_tco_1_thro /end AXIS_DESCR
/end CHARACTERISTIC
/begin CHARACTERISTIC ip_tps_rel_st_mt "Specified relative TPS setpoint at start" MAP 0xffe4f5da _REC_MAP_20_u2_u2_u1 99.99847412 _CNV_A_R_LINEAR_____8_CM 0. 99.99847412 DISPLAY_IDENTIFIER IP_TPS_REL_ST_MT
 /begin AXIS_DESCR COM_AXIS n _CNV_A_R_LINEAR_____10_CM 8 0. 8160. FORMAT "%4.0" AXIS_PTS_REF ldpm_n_1_thro /end AXIS_DESCR
 /begin AXIS_DESCR COM_AXIS tco _CNV_A_R_LINEAR_____11_CM 8 -48. 142.5 FORMAT "%5.1" AXIS_PTS_REF ldpm_tco_1_thro /end AXIS_DESCR
/end CHARACTERISTIC
/begin CHARACTERISTIC ip_tps_rel_st_pv "correction of the ralative TPS setpoint at start via driver's demand" CURVE 0xffe4f65a _REC_CUR_20_u2_u1 99.99847412 _CNV_A_R_LINEAR_____8_CM 0. 99.99847412 DISPLAY_IDENTIFIER IP_TPS_REL_ST_PV
 /begin AXIS_DESCR COM_AXIS pv_av _CNV_A_R_LINEAR_____9_CM 6 0. 99.609375 FORMAT "%4.1" AXIS_PTS_REF ldp_pv_av_ip_tps_sp_st_pv /end AXIS_DESCR
/end CHARACTERISTIC
/begin CHARACTERISTIC ip_fac_amp_tps_rel_st "Altitude correction of the relative TPS setpoint at start" MAP 0xffe4506e _REC_MAP_20_u1_u2_u2 1.99220002 _CNV_A_R_LINEAR_____39_CM 0. 1.99220002 DISPLAY_IDENTIFIER IP_FAC_AMP_TPS_REL_ST FORMAT "%5.3"
 /begin AXIS_DESCR COM_AXIS n _CNV_A_R_LINEAR_____10_CM 8 0. 8160. FORMAT "%4.0" AXIS_PTS_REF ldpm_n_1_thro /end AXIS_DESCR
 /begin AXIS_DESCR COM_AXIS amp _CNV_A_R_LINEAR_____49_CM 6 0. 5434. FORMAT "%7.2" AXIS_PTS_REF ldp_amp_ip_tps_sp_st_amp /end AXIS_DESCR
/end CHARACTERISTIC
/begin CHARACTERISTIC ip_tps_sp_st "TPS setpoint at start" MAP 0xffe4f762 _REC_MAP_20_u2_u2_u2 119.5 _CNV_A_R_LINEAR_____500_CM 0. 119.5 DISPLAY_IDENTIFIER IP_TPS_SP_ST FORMAT "%7.3"
 /begin AXIS_DESCR COM_AXIS n _CNV_A_R_LINEAR_____10_CM 8 0. 8160. FORMAT "%4.0" AXIS_PTS_REF ldpm_n_1_thro /end AXIS_DESCR
 /begin AXIS_DESCR COM_AXIS tps_rel_st _CNV_A_R_LINEAR_____8_CM 12 0. 99.99847412 AXIS_PTS_REF ldp_tps_rel_st_ip_tps_sp_st /end AXIS_DESCR
/end CHARACTERISTIC
/begin CHARACTERISTIC ip_fac_tia_tps_rel_st "TIA correction of the relative TPS setpoint at start" CURVE 0xffe40c3b _REC_CUR_20_u1_u1 1.99220002 _CNV_A_R_LINEAR_____39_CM 0. 1.99220002 DISPLAY_IDENTIFIER IP_FAC_TIA_TPS_REL_ST FORMAT "%5.3"
 /begin AXIS_DESCR COM_AXIS tia _CNV_A_R_LINEAR_____11_CM 6 -48. 142.5 FORMAT "%5.1" AXIS_PTS_REF ldp_tia_ip_fac_tia_tps_sp_st /end AXIS_DESCR
/end CHARACTERISTIC
/begin AXIS_PTS ldp_pv_av_ip_tps_sp_st_pv "" 0xffe41165 pv_av _REC_AXS_20_u1 99.609375 _CNV_A_R_LINEAR_____9_CM 6 0. 99.609375 DISPLAY_IDENTIFIER LDP_PV_AV_IP_TPS_SP_ST_PV FORMAT "%4.1" /end AXIS_PTS
/begin AXIS_PTS ldp_tia_ip_fac_tia_tps_sp_st "" 0xffe4129a tia _REC_AXS_20_u1 190.5 _CNV_A_R_LINEAR_____11_CM 6 -48. 142.5 DISPLAY_IDENTIFIER LDP_TIA_IP_FAC_TIA_TPS_SP_ST FORMAT "%5.1" /end AXIS_PTS
/begin AXIS_PTS ldp_amp_ip_tps_sp_st_amp "" 0xffe509de amp _REC_AXS_20_u2 5434. _CNV_A_R_LINEAR_____49_CM 6 0. 5434. DISPLAY_IDENTIFIER LDP_AMP_IP_TPS_SP_ST_AMP FORMAT "%7.2" /end AXIS_PTS
/begin AXIS_PTS ldp_tps_rel_st_ip_tps_sp_st "" 0xffe513fc tps_rel_st _REC_AXS_20_u2 99.99847412 _CNV_A_R_LINEAR_____8_CM 12 0. 99.99847412 DISPLAY_IDENTIFIER LDP_TPS_REL_ST_IP_TPS_SP_ST /end AXIS_PTS
/begin MEASUREMENT lv_mtc_cur_off "Logical variable to switch off  the MTC-controller" UBYTE _CNV_S_2_RANGE______2_CM 1 100. 0. 1. DISPLAY_IDENTIFIER LV_MTC_CUR_OFF ECU_ADDRESS 0x3fea93 /end MEASUREMENT
/begin MEASUREMENT tps_sp_pwl "Throttle position setpoint during post operating phase" UWORD _CNV_A_R_LINEAR_____53_CM 1 100. 0. 119.5 DISPLAY_IDENTIFIER TPS_SP_PWL ECU_ADDRESS 0x3fdcae BYTE_ORDER MSB_LAST FORMAT "%7.3" /end MEASUREMENT
/begin MEASUREMENT lv_tps_pwl "Bit for throttle position" UBYTE _CNV_S_2_RANGE______21_CM 1 100. 0. 1. DISPLAY_IDENTIFIER LV_TPS_PWL ECU_ADDRESS 0x3fea95 /end MEASUREMENT
/begin CHARACTERISTIC c_tps_sp_pwl_lgrd "Gradiant limitation TPS" VALUE 0xffe41ab2 _REC_VAL_20_u2 119.5 _CNV_A_R_LINEAR_____507_CM 0. 119.5 DISPLAY_IDENTIFIER C_TPS_SP_PWL_LGRD FORMAT "%7.3" /end CHARACTERISTIC
/begin CHARACTERISTIC c_tps_sp_pwl_up "Threshold opening after power latch" VALUE 0xffe41ab4 _REC_VAL_20_u2 119.5 _CNV_A_R_LINEAR_____53_CM 0. 119.5 DISPLAY_IDENTIFIER C_TPS_SP_PWL_UP FORMAT "%7.3" /end CHARACTERISTIC
/begin CHARACTERISTIC c_tps_sp_as_man "Throttle position setpoint manual" VALUE 0xffe41a9e _REC_VAL_20_u2 119.5 _CNV_A_R_LINEAR_____53_CM 0. 119.5 DISPLAY_IDENTIFIER C_TPS_SP_AS_MAN FORMAT "%7.3" /end CHARACTERISTIC
/begin CHARACTERISTIC c_tps_sp_ext_adj_ena "Variable enabled for throttle position setpoint manual or about PV_AV" VALUE 0xffe40986 _REC_VAL_20_u1 3. _CNV_A_R_LINEAR_____0_CM 0. 3. DISPLAY_IDENTIFIER C_TPS_SP_EXT_ADJ_ENA FORMAT "%2.0" /end CHARACTERISTIC
/begin CHARACTERISTIC c_pv_av_ext_adj_min "Min. threshold for external ajustment about PV_AV" VALUE 0xffe4081f _REC_VAL_20_u1 99.609375 _CNV_A_R_LINEAR_____9_CM 0. 99.609375 DISPLAY_IDENTIFIER C_PV_AV_EXT_ADJ_MIN FORMAT "%4.1" /end CHARACTERISTIC
/begin CHARACTERISTIC ip_tps_sp_pwl "throttle position setpoint during post operating phase" CURVE 0xffe41cf0 _REC_CUR_20_u2_u1 119.5 _CNV_A_R_LINEAR_____53_CM 0. 119.5 DISPLAY_IDENTIFIER IP_TPS_SP_PWL FORMAT "%7.3"
 /begin AXIS_DESCR COM_AXIS n_32 _CNV_A_R_LINEAR_____15_CM 4 0. 8160. FORMAT "%4.0" AXIS_PTS_REF ldp_n_32_tps_sp_pwl /end AXIS_DESCR
/end CHARACTERISTIC
/begin MEASUREMENT tps_sp_ext_adj "Throttle position setpint of external device" UWORD _CNV_A_R_LINEAR_____53_CM 1 100. 0. 119.5 DISPLAY_IDENTIFIER TPS_SP_EXT_ADJ ECU_ADDRESS 0x3fdcac BYTE_ORDER MSB_LAST FORMAT "%7.3" /end MEASUREMENT
/begin MEASUREMENT tps_sp_ext_adj_1 "Throttle position setpint of external device about PV_AV" UWORD _CNV_A_R_LINEAR_____53_CM 1 100. 0. 119.5 DISPLAY_IDENTIFIER TPS_SP_EXT_ADJ_1 ECU_ADDRESS 0x3fdcb0 BYTE_ORDER MSB_LAST FORMAT "%7.3" /end MEASUREMENT
/begin MEASUREMENT lv_tps_sp_ext_adj "Bit active for external input of throtle position setpoint" UBYTE _CNV_S_2_RANGE______2_CM 1 100. 0. 1. DISPLAY_IDENTIFIER LV_TPS_SP_EXT_ADJ ECU_ADDRESS 0x3fea94 /end MEASUREMENT
/begin MEASUREMENT lv_tps_sp_ext_adj_1 "Bit active for external input of throtle position setpoint for PV_AV setpoint" UBYTE _CNV_S_2_RANGE______2_CM 1 100. 0. 1. DISPLAY_IDENTIFIER LV_TPS_SP_EXT_ADJ_1 ECU_ADDRESS 0x3fea96 /end MEASUREMENT
/begin MEASUREMENT lv_tps_sp_lih "Bit collecting the requests of all 3 monitoring levels to switch off MTC" UBYTE _CNV_S_2_RANGE______2_CM 1 100. 0. 1. DISPLAY_IDENTIFIER LV_TPS_SP_LIH ECU_ADDRESS 0x3fea92 /end MEASUREMENT
/begin CHARACTERISTIC ip_tps_sp_ext_adj "external adjustment setpoint" CURVE 0xffe4f676 _REC_CUR_20_u2_u1 119.5 _CNV_A_R_LINEAR_____53_CM 0. 119.5 DISPLAY_IDENTIFIER IP_TPS_SP_EXT_ADJ FORMAT "%7.3"
 /begin AXIS_DESCR COM_AXIS pv_av _CNV_A_R_LINEAR_____9_CM 6 0. 99.609375 FORMAT "%4.1" AXIS_PTS_REF ldp_pv_av__tps_sp_ext /end AXIS_DESCR
/end CHARACTERISTIC
/begin MEASUREMENT tps_sp_es "Throttle position setpoint for engine stopped" UWORD _CNV_A_R_LINEAR_____53_CM 1 100. 0. 119.5 DISPLAY_IDENTIFIER TPS_SP_ES ECU_ADDRESS 0x3fdcaa BYTE_ORDER MSB_LAST FORMAT "%7.3" /end MEASUREMENT
/begin CHARACTERISTIC ip_tps_sp_es "Throttle position setpoint for engine stopped" CURVE 0xffe4f666 _REC_CUR_20_u2_u1 119.5 _CNV_A_R_LINEAR_____53_CM 0. 119.5 DISPLAY_IDENTIFIER IP_TPS_SP_ES FORMAT "%7.3"
 /begin AXIS_DESCR COM_AXIS tco _CNV_A_R_LINEAR_____11_CM 8 -48. 142.5 FORMAT "%5.1" AXIS_PTS_REF ldpm_tco_1_thro /end AXIS_DESCR
/end CHARACTERISTIC
/begin AXIS_PTS ldp_n_32_tps_sp_pwl "" 0xffe41122 n_32 _REC_AXS_20_u1 816. _CNV_A_R_LINEAR_____15_CM 4 0. 8160. DISPLAY_IDENTIFIER LDP_N_32_TPS_SP_PWL FORMAT "%4.0" /end AXIS_PTS
/begin AXIS_PTS ldp_pv_av__tps_sp_ext "" 0xffe41157 pv_av _REC_AXS_20_u1 99.609375 _CNV_A_R_LINEAR_____9_CM 6 0. 99.609375 DISPLAY_IDENTIFIER LDP_PV_AV__TPS_SP_EXT FORMAT "%4.1" /end AXIS_PTS
/begin CHARACTERISTIC c_t_mtc_isa_off "Active time periodThrottle position setpoint" VALUE 0xffe408b9 _REC_VAL_20_u1 255. _CNV_A_R_LINEAR_____30_CM 0. 255. DISPLAY_IDENTIFIER C_T_MTC_ISA_OFF FORMAT "%3.0" /end CHARACTERISTIC
/begin AXIS_PTS ldpm_tco_1_thro "" 0xffe48608 tco _REC_AXS_20_u1 190.5 _CNV_A_R_LINEAR_____11_CM 8 -48. 142.5 DISPLAY_IDENTIFIER LDPM_TCO_1_THRO FORMAT "%5.1" /end AXIS_PTS
/begin MEASUREMENT tps_sp_sel "selected throttle position setpoint before limitation" UWORD _CNV_A_R_LINEAR_____53_CM 1 100. 0. 119.5 DISPLAY_IDENTIFIER TPS_SP_SEL ECU_ADDRESS 0x3fdcb6 BYTE_ORDER MSB_LAST FORMAT "%7.3" /end MEASUREMENT
/begin CHARACTERISTIC c_tps_av_bol "Lower limit (actual value) of the closing speed limitation of the throttle setpoint" VALUE 0xffe41a88 _REC_VAL_20_u2 119.5 _CNV_A_R_LINEAR_____53_CM 0. 119.5 DISPLAY_IDENTIFIER C_TPS_AV_BOL FORMAT "%7.3" /end CHARACTERISTIC
/begin CHARACTERISTIC c_tps_av_tol "Upper limit (actual value) of the closing speed limitation of the throttle setpoint" VALUE 0xffe41a8c _REC_VAL_20_u2 119.5 _CNV_A_R_LINEAR_____53_CM 0. 119.5 DISPLAY_IDENTIFIER C_TPS_AV_TOL FORMAT "%7.3" /end CHARACTERISTIC
/begin CHARACTERISTIC c_tps_sp_min "Lower limit of the throttle position setpoint" VALUE 0xffe41aae _REC_VAL_20_u2 119.5 _CNV_A_R_LINEAR_____53_CM 0. 119.5 DISPLAY_IDENTIFIER C_TPS_SP_MIN FORMAT "%7.3" /end CHARACTERISTIC
/begin CHARACTERISTIC c_tps_sp_min_tps_ad_req "Lower limit of the throttle position setpoint without throttle Adaptation" VALUE 0xffe41ab0 _REC_VAL_20_u2 119.5 _CNV_A_R_LINEAR_____53_CM 0. 119.5 DISPLAY_IDENTIFIER C_TPS_SP_MIN_TPS_AD_REQ FORMAT "%7.3" /end CHARACTERISTIC
/begin CHARACTERISTIC c_tps_sp_max_tps_ad_req "Upper limit of the throttle position setpoint without throttle Adaptation" VALUE 0xffe41aac _REC_VAL_20_u2 119.5 _CNV_A_R_LINEAR_____53_CM 0. 119.5 DISPLAY_IDENTIFIER C_TPS_SP_MAX_TPS_AD_REQ FORMAT "%7.3" /end CHARACTERISTIC
/begin CHARACTERISTIC c_tps_sp_max "Upper limit of the throttle position setpoint" VALUE 0xffe41aaa _REC_VAL_20_u2 119.5 _CNV_A_R_LINEAR_____53_CM 0. 119.5 DISPLAY_IDENTIFIER C_TPS_SP_MAX FORMAT "%7.3" /end CHARACTERISTIC
/begin CHARACTERISTIC c_tps_sp_tol "Upper limit of opening velocity limitation the throttle position setpoint" VALUE 0xffe41ac0 _REC_VAL_20_u2 119.5 _CNV_A_R_LINEAR_____53_CM 0. 119.5 DISPLAY_IDENTIFIER C_TPS_SP_TOL FORMAT "%7.3" /end CHARACTERISTIC
/begin CHARACTERISTIC c_tps_sp_tol_tps_ad_req "Upper limit of opening velocity limitation the throttle position setpoint without throttle Adaptation" VALUE 0xffe41ac2 _REC_VAL_20_u2 119.5 _CNV_A_R_LINEAR_____53_CM 0. 119.5 DISPLAY_IDENTIFIER C_TPS_SP_TOL_TPS_AD_REQ FORMAT "%7.3" /end CHARACTERISTIC
/begin CHARACTERISTIC c_tps_sp_bol_tps_ad_req "Lower limit of opening velocity limitation the throttle position setpoint without throttle Adaptation" VALUE 0xffe41aa2 _REC_VAL_20_u2 119.5 _CNV_A_R_LINEAR_____53_CM 0. 119.5 DISPLAY_IDENTIFIER C_TPS_SP_BOL_TPS_AD_REQ FORMAT "%7.3" /end CHARACTERISTIC
/begin CHARACTERISTIC c_tps_sp_bol "Lower limit of opening velocity limitation the throttle position setpoint" VALUE 0xffe41aa0 _REC_VAL_20_u2 119.5 _CNV_A_R_LINEAR_____53_CM 0. 119.5 DISPLAY_IDENTIFIER C_TPS_SP_BOL FORMAT "%7.3" /end CHARACTERISTIC
/begin CHARACTERISTIC c_tps_sp_lgrd_tot "Threshold opening after power latch" VALUE 0xffe41aa6 _REC_VAL_20_u2 119.5 _CNV_A_R_LINEAR_____53_CM 0. 119.5 DISPLAY_IDENTIFIER C_TPS_SP_LGRD_TOT FORMAT "%7.3" /end CHARACTERISTIC
/begin MEASUREMENT tps_sp "real throttle angle setpoint for MTC-position controller" UWORD _CNV_A_R_LINEAR_____53_CM 1 100. 0. 119.5 DISPLAY_IDENTIFIER TPS_SP ECU_ADDRESS 0x3fdcb4 BYTE_ORDER MSB_LAST FORMAT "%7.3" /end MEASUREMENT
/begin MEASUREMENT tps_sp_lim "limited throttle position setpoint" UWORD _CNV_A_R_LINEAR_____53_CM 1 100. 0. 119.5 DISPLAY_IDENTIFIER TPS_SP_LIM ECU_ADDRESS 0x3fdcb8 BYTE_ORDER MSB_LAST FORMAT "%7.3" /end MEASUREMENT
/begin MEASUREMENT tps_sp_lim_2 "Throttle position setpoint after gradient limitation over whole operating range" UWORD _CNV_A_R_LINEAR_____53_CM 1 100. 0. 119.5 DISPLAY_IDENTIFIER TPS_SP_LIM_2 ECU_ADDRESS 0x3fdcbc BYTE_ORDER MSB_LAST FORMAT "%7.3" /end MEASUREMENT
/begin MEASUREMENT tps_sp_lim_1 "Throttle position setpoint after absolute value limitation" UWORD _CNV_A_R_LINEAR_____53_CM 1 100. 0. 119.5 DISPLAY_IDENTIFIER TPS_SP_LIM_1 ECU_ADDRESS 0x3fdcba BYTE_ORDER MSB_LAST FORMAT "%7.3" /end MEASUREMENT
/begin MEASUREMENT lv_tps_sp_tra_st_mdl "Logical variable indicating transient phase after start" UBYTE _CNV_S_2_RANGE______2_CM 1 100. 0. 1. DISPLAY_IDENTIFIER LV_TPS_SP_TRA_ST_MDL ECU_ADDRESS 0x3fea97 /end MEASUREMENT
/begin MEASUREMENT tps_sp_tra_st_mdl "Throttle position setpoint for transient phase after start" UWORD _CNV_A_R_LINEAR_____53_CM 1 100. 0. 119.5 DISPLAY_IDENTIFIER TPS_SP_TRA_ST_MDL ECU_ADDRESS 0x3fdcbe BYTE_ORDER MSB_LAST FORMAT "%7.3" /end MEASUREMENT
/begin CHARACTERISTIC ip_tps_sp_lgrd_st "Admissible gradient of throttle position setpoint for transient phase after start" MAP 0xffe4f682 _REC_MAP_20_u2_u2_u1 119.492706 _CNV_A_R_LINEAR_____508_CM 7.294e-003 119.5 DISPLAY_IDENTIFIER IP_TPS_SP_LGRD_ST FORMAT "%7.3"
 /begin AXIS_DESCR COM_AXIS n _CNV_A_R_LINEAR_____10_CM 8 0. 8160. FORMAT "%4.0" AXIS_PTS_REF ldp_n_ip_tps_sp_lgrd_st /end AXIS_DESCR
 /begin AXIS_DESCR COM_AXIS tco _CNV_A_R_LINEAR_____11_CM 8 -48. 142.5 FORMAT "%5.1" AXIS_PTS_REF ldp_tco_ip_tps_sp_lgrd_st /end AXIS_DESCR
/end CHARACTERISTIC
/begin AXIS_PTS ldp_n_ip_tps_sp_lgrd_st "" 0xffe510b4 n _REC_AXS_20_u2 8160. _CNV_A_R_LINEAR_____10_CM 8 0. 8160. DISPLAY_IDENTIFIER LDP_N_IP_TPS_SP_LGRD_ST FORMAT "%4.0" /end AXIS_PTS
/begin AXIS_PTS ldp_tco_ip_tps_sp_lgrd_st "" 0xffe48242 tco _REC_AXS_20_u1 190.5 _CNV_A_R_LINEAR_____11_CM 8 -48. 142.5 DISPLAY_IDENTIFIER LDP_TCO_IP_TPS_SP_LGRD_ST FORMAT "%5.1" /end AXIS_PTS
/begin AXIS_PTS ldpm_n_1_thro "" 0xffe51a9a n _REC_AXS_20_u2 8160. _CNV_A_R_LINEAR_____10_CM 8 0. 8160. DISPLAY_IDENTIFIER LDPM_N_1_THRO FORMAT "%4.0" /end AXIS_PTS
/begin CHARACTERISTIC c_tps_sp_lgrd_stop "max. admissable gradient of throtle setpoint in the range of the top and bottom stop" VALUE 0xffe41aa4 _REC_VAL_20_u2 119.5 _CNV_A_R_LINEAR_____507_CM 0. 119.5 DISPLAY_IDENTIFIER C_TPS_SP_LGRD_STOP FORMAT "%7.3" /end CHARACTERISTIC
/begin COMPU_METHOD _CNV_A_R_LINEAR_____0_CM "" RAT_FUNC "%6.3" "-" COEFFS 0 1. 0. 0 0 1 /end COMPU_METHOD
/begin COMPU_METHOD _CNV_S_2_RANGE______2_CM "" TAB_VERB "%6.3" "[-]" COMPU_TAB_REF _CNV_S_2_RANGE______2 /end COMPU_METHOD
/begin COMPU_VTAB _CNV_S_2_RANGE______2 "" TAB_VERB 2 0 "0" 1 "1" /end COMPU_VTAB
/begin COMPU_METHOD _CNV_A_R_LINEAR_____4_CM "" RAT_FUNC "%6.3" "s" COEFFS 0 100. 0. 0 0 1 /end COMPU_METHOD
/begin COMPU_METHOD _CNV_A_R_LINEAR_____8_CM "" RAT_FUNC "%6.3" "%" COEFFS 0 655.3600000071681 0. 0 0 1 /end COMPU_METHOD
/begin COMPU_METHOD _CNV_A_R_LINEAR_____9_CM "" RAT_FUNC "%6.3" "%" COEFFS 0 2.56 0. 0 0 1 /end COMPU_METHOD
/begin COMPU_METHOD _CNV_A_R_LINEAR_____10_CM "" RAT_FUNC "%6.3" "rpm" COEFFS 0 1. 0. 0 0 1 /end COMPU_METHOD
/begin COMPU_METHOD _CNV_A_R_LINEAR_____11_CM "" RAT_FUNC "%6.3" "°C" COEFFS 0 1.333333333333333 64. 0 0 1 /end COMPU_METHOD
/begin COMPU_METHOD _CNV_A_R_LINEAR_____12_CM "" RAT_FUNC "%6.3" "°C" COEFFS 0 1.333333333333333 0. 0 0 1 /end COMPU_METHOD
/begin COMPU_METHOD _CNV_A_R_LINEAR_____15_CM "" RAT_FUNC "%6.3" "rpm" COEFFS 0 3.125e-002 0. 0 0 1 /end COMPU_METHOD
/begin COMPU_METHOD _CNV_A_R_LINEAR_____20_CM "" RAT_FUNC "%6.3" "-" COEFFS 0 32768.00003968061 0. 0 0 1 /end COMPU_METHOD
/begin COMPU_METHOD _CNV_S_2_RANGE______21_CM "" TAB_VERB "%6.3" "-" COMPU_TAB_REF _CNV_S_2_RANGE______21 /end COMPU_METHOD
/begin COMPU_VTAB _CNV_S_2_RANGE______21 "" TAB_VERB 2 0 "0" 1 "1" /end COMPU_VTAB
/begin COMPU_METHOD _CNV_A_R_LINEAR_____22_CM "" RAT_FUNC "%6.3" "[-]" COEFFS 0 1. 0. 0 0 1 /end COMPU_METHOD
/begin COMPU_METHOD _CNV_A_R_LINEAR_____23_CM "" RAT_FUNC "%6.3" "km/h" COEFFS 0 1. 0. 0 0 1 /end COMPU_METHOD
/begin COMPU_METHOD _CNV_A_R_LINEAR_____24_CM "" RAT_FUNC "%6.3" "s" COEFFS 0 10. 0. 0 0 1 /end COMPU_METHOD
/begin COMPU_METHOD _CNV_A_R_LINEAR_____27_CM "" RAT_FUNC "%6.3" "mg/stk" COEFFS 0 0.183585313174946 0. 0 0 1 /end COMPU_METHOD
/begin COMPU_METHOD _CNV_A_R_LINEAR_____30_CM "" RAT_FUNC "%6.3" "s" COEFFS 0 1. 0. 0 0 1 /end COMPU_METHOD
/begin COMPU_METHOD _CNV_A_R_LINEAR_____31_CM "" RAT_FUNC "%6.3" "ms" COEFFS 0 0.1 0. 0 0 1 /end COMPU_METHOD
/begin COMPU_METHOD _CNV_A_R_LINEAR_____34_CM "" RAT_FUNC "%6.3" "V" COEFFS 0 9.846168103048838 0. 0 0 1 /end COMPU_METHOD
/begin COMPU_METHOD _CNV_A_R_LINEAR_____37_CM "" RAT_FUNC "%6.3" "-" COEFFS 0 65536.00007936121 0. 0 0 1 /end COMPU_METHOD
/begin COMPU_METHOD _CNV_A_R_LINEAR_____39_CM "" RAT_FUNC "%6.3" "-" COEFFS 0 127.9991955827809 0. 0 0 1 /end COMPU_METHOD
/begin COMPU_METHOD _CNV_A_R_LINEAR_____49_CM "" RAT_FUNC "%6.3" "hPa" COEFFS 0 12.06017666543982 0. 0 0 1 /end COMPU_METHOD
/begin COMPU_METHOD _CNV_A_R_LINEAR_____50_CM "" RAT_FUNC "%6.3" "[-]" COEFFS 0 255.9999357490357 0. 0 0 1 /end COMPU_METHOD
/begin COMPU_METHOD _CNV_A_R_LINEAR_____51_CM "" RAT_FUNC "%6.3" "rpm/s" COEFFS 0 3.125e-002 0. 0 0 1 /end COMPU_METHOD
/begin COMPU_METHOD _CNV_A_R_LINEAR_____52_CM "" RAT_FUNC "%6.3" "°TPS/s" COEFFS 0 8.535564853556485e-002 0. 0 0 1 /end COMPU_METHOD
/begin COMPU_METHOD _CNV_A_R_LINEAR_____53_CM "" RAT_FUNC "%6.3" "°TPS" COEFFS 0 137.0962343096234 0. 0 0 1 /end COMPU_METHOD
/begin COMPU_METHOD _CNV_A_R_LINEAR_____54_CM "" RAT_FUNC "%6.3" "rpm/s" COEFFS 0 3.125e-002 128. 0 0 1 /end COMPU_METHOD
/begin COMPU_METHOD _CNV_A_R_LINEAR_____82_CM "" RAT_FUNC "%6.3" "°CRK" COEFFS 0 2.666666666666667 0. 0 0 1 /end COMPU_METHOD
/begin COMPU_METHOD _CNV_A_R_LINEAR_____88_CM "" RAT_FUNC "%6.3" "km" COEFFS 0 0.1 0. 0 0 1 /end COMPU_METHOD
/begin COMPU_METHOD _CNV_A_R_LINEAR_____108_CM "" RAT_FUNC "%6.3" "mg/stk" COEFFS 0 47.18142548596112 0. 0 0 1 /end COMPU_METHOD
/begin COMPU_METHOD _CNV_A_R_LINEAR_____111_CM "" RAT_FUNC "%6.3" "%" COEFFS 0 655.3600000071681 3.584063961170614e-007 0 0 1 /end COMPU_METHOD
/begin COMPU_METHOD _CNV_A_R_LINEAR_____115_CM "" RAT_FUNC "%6.3" "kg/h" COEFFS 0 32. 0. 0 0 1 /end COMPU_METHOD
/begin COMPU_METHOD _CNV_A_R_LINEAR_____117_CM "" RAT_FUNC "%6.3" "-" COEFFS 0 128. 0. 0 0 1 /end COMPU_METHOD
/begin COMPU_METHOD _CNV_A_R_LINEAR_____129_CM "" RAT_FUNC "%6.3" "[-]" COEFFS 0 64. 0. 0 0 1 /end COMPU_METHOD
/begin COMPU_METHOD _CNV_A_R_LINEAR_____165_CM "" RAT_FUNC "%6.3" "ms" COEFFS 0 250. 0. 0 0 1 /end COMPU_METHOD
/begin COMPU_METHOD _CNV_A_R_LINEAR_____203_CM "" RAT_FUNC "%6.3" "°CRK" COEFFS 0 2.666666666666667 95. 0 0 1 /end COMPU_METHOD
/begin COMPU_METHOD _CNV_A_R_LINEAR_____204_CM "" RAT_FUNC "%6.3" "°CRK" COEFFS 0 -2.666666666666667 0. 0 0 1 /end COMPU_METHOD
/begin COMPU_METHOD _CNV_A_R_LINEAR_____205_CM "" RAT_FUNC "%6.3" "°CRK" COEFFS 0 2.666666666666667 128. 0 0 1 /end COMPU_METHOD
/begin COMPU_METHOD _CNV_A_R_LINEAR_____206_CM "" RAT_FUNC "%6.3" "-" COEFFS 0 1023.999999919998 0. 0 0 1 /end COMPU_METHOD
/begin COMPU_METHOD _CNV_A_R_LINEAR_____207_CM "" RAT_FUNC "%6.3" "rpm" COEFFS 0 1. 32768. 0 0 1 /end COMPU_METHOD
/begin COMPU_METHOD _CNV_A_R_LINEAR_____208_CM "" RAT_FUNC "%6.3" "V" COEFFS 0 35.63776976537597 0. 0 0 1 /end COMPU_METHOD
/begin COMPU_METHOD _CNV_A_R_LINEAR_____211_CM "" RAT_FUNC "%6.3" "ms" COEFFS 0 15.625 0. 0 0 1 /end COMPU_METHOD
/begin COMPU_METHOD _CNV_S_9_RANGE_STAT_231_CM "" TAB_VERB "%6.3" "[-]" COMPU_TAB_REF _CNV_S_9_RANGE_STAT_231 /end COMPU_METHOD
/begin COMPU_VTAB _CNV_S_9_RANGE_STAT_231 "" TAB_VERB 9 0 "HOM_AFS" 1 "AFS_TO_AFL" 2 "HOM_AFL" 3 "AFL_TO_AFS" 4 "HOM_TO_S" 5 "BACKS" 6 "S" 7 "S_TO_HOM" 8 "BACKHOM" /end COMPU_VTAB
/begin COMPU_METHOD _CNV_A_R_LINEAR_____236_CM "" RAT_FUNC "%6.3" "-" COEFFS 0 32. 0. 0 0 1 /end COMPU_METHOD
/begin COMPU_METHOD _CNV_A_R_LINEAR_____321_CM "" RAT_FUNC "%6.3" "%" COEFFS 0 327.680000003584 3.584063961170614e-007 0 0 1 /end COMPU_METHOD
/begin COMPU_METHOD _CNV_A_R_LINEAR_____377_CM "" RAT_FUNC "%6.3" "-" COEFFS 0 7379.793318491542 0. 0 0 1 /end COMPU_METHOD
/begin COMPU_METHOD _CNV_A_R_LINEAR_____382_CM "" RAT_FUNC "%6.3" "cm²" COEFFS 0 1118.481084425738 0. 0 0 1 /end COMPU_METHOD
/begin COMPU_METHOD _CNV_A_R_LINEAR_____399_CM "" RAT_FUNC "%6.3" "mg/stk" COEFFS 0 47.18142548596112 32767.5 0 0 1 /end COMPU_METHOD
/begin COMPU_METHOD _CNV_A_R_LINEAR_____407_CM "" RAT_FUNC "%6.3" "°TPS" COEFFS 0 137.0962343096234 16383. 0 0 1 /end COMPU_METHOD
/begin COMPU_METHOD _CNV_A_R_LINEAR_____408_CM "" RAT_FUNC "%6.3" "%" COEFFS 0 81.91999999679995 32767.99999871998 0 0 1 /end COMPU_METHOD
/begin COMPU_METHOD _CNV_A_R_LINEAR_____409_CM "" RAT_FUNC "%6.3" "%" COEFFS 0 327.680000003584 32768.00000035841 0 0 1 /end COMPU_METHOD
/begin COMPU_METHOD _CNV_A_R_LINEAR_____410_CM "" RAT_FUNC "%6.3" "%" COEFFS 0 327.68 0. 0 0 1 /end COMPU_METHOD
/begin COMPU_METHOD _CNV_A_R_LINEAR_____411_CM "" RAT_FUNC "%6.3" "%" COEFFS 0 81.91999999679995 -1.280022843275219e-006 0 0 1 /end COMPU_METHOD
/begin COMPU_METHOD _CNV_A_R_LINEAR_____412_CM "" RAT_FUNC "%6.3" "ms" COEFFS 0 0.2 0. 0 0 1 /end COMPU_METHOD
/begin COMPU_METHOD _CNV_A_R_LINEAR_____413_CM "" RAT_FUNC "%6.3" "°TPS" COEFFS 0 137.0962343096234 1.818989403545857e-012 0 0 1 /end COMPU_METHOD
/begin COMPU_METHOD _CNV_A_R_LINEAR_____414_CM "" RAT_FUNC "%6.3" "s" COEFFS 0 200. 0. 0 0 1 /end COMPU_METHOD
/begin COMPU_METHOD _CNV_A_R_LINEAR_____415_CM "" RAT_FUNC "%6.3" "%" COEFFS 0 327.67 0. 0 0 1 /end COMPU_METHOD
/begin COMPU_METHOD _CNV_A_R_LINEAR_____486_CM "" RAT_FUNC "%6.3" "%/10ms" COEFFS 0 655.3600000071681 0. 0 0 1 /end COMPU_METHOD
/begin COMPU_METHOD _CNV_A_R_LINEAR_____487_CM "" RAT_FUNC "%6.3" "mg/stk" COEFFS 0 23.59107271489608 9.906580089591444e-007 0 0 1 /end COMPU_METHOD
/begin COMPU_METHOD _CNV_A_R_LINEAR_____488_CM "" RAT_FUNC "%6.3" "mg/stk" COEFFS 0 23.59107271489608 32768.00000099066 0 0 1 /end COMPU_METHOD
/begin COMPU_METHOD _CNV_A_R_LINEAR_____489_CM "" RAT_FUNC "%6.3" "mg" COEFFS 0 4. 32768. 0 0 1 /end COMPU_METHOD
/begin COMPU_METHOD _CNV_A_R_LINEAR_____490_CM "" RAT_FUNC "%6.3" "mg" COEFFS 0 4. 0. 0 0 1 /end COMPU_METHOD
/begin COMPU_METHOD _CNV_A_R_LINEAR_____500_CM "" RAT_FUNC "%6.3" "°TPS" COEFFS 0 548.4100418410042 0. 0 0 1 /end COMPU_METHOD
/begin COMPU_METHOD _CNV_A_R_LINEAR_____507_CM "" RAT_FUNC "%6.3" "°TPS/10ms" COEFFS 0 137.0962343096234 0. 0 0 1 /end COMPU_METHOD
/begin COMPU_METHOD _CNV_A_R_LINEAR_____508_CM "" RAT_FUNC "%6.3" "°TPS" COEFFS 0 137.0962341416889 2.006817052091492e-005 0 0 1 /end COMPU_METHOD
/begin RECORD_LAYOUT _REC_VAL_20_u1 FNC_VALUES 1 UBYTE COLUMN_DIR DIRECT /end RECORD_LAYOUT
/begin RECORD_LAYOUT _REC_VAL_20_u2 FNC_VALUES 1 UWORD COLUMN_DIR DIRECT /end RECORD_LAYOUT
/begin RECORD_LAYOUT _REC_CUR_20_u2_u1 FNC_VALUES 1 UWORD COLUMN_DIR DIRECT /end RECORD_LAYOUT
/begin RECORD_LAYOUT _REC_AXS_20_u1 NO_AXIS_PTS_X 1 UBYTE AXIS_PTS_X 2 UBYTE INDEX_INCR DIRECT /end RECORD_LAYOUT
/begin RECORD_LAYOUT _REC_MAP_20_u1_u1_u1 FNC_VALUES 1 UBYTE COLUMN_DIR DIRECT /end RECORD_LAYOUT
/begin RECORD_LAYOUT _REC_CUR_20_u1_u1 FNC_VALUES 1 UBYTE COLUMN_DIR DIRECT /end RECORD_LAYOUT
/begin RECORD_LAYOUT _REC_AXS_20_u2 NO_AXIS_PTS_X 1 UWORD AXIS_PTS_X 2 UWORD INDEX_INCR DIRECT /end RECORD_LAYOUT
/begin RECORD_LAYOUT _REC_MAP_20_u1_u1_u2 FNC_VALUES 1 UBYTE COLUMN_DIR DIRECT /end RECORD_LAYOUT
/begin RECORD_LAYOUT _REC_MAP_20_u2_u2_u1 FNC_VALUES 1 UWORD COLUMN_DIR DIRECT /end RECORD_LAYOUT
/begin RECORD_LAYOUT _REC_CUR_20_u1_u2 FNC_VALUES 1 UBYTE COLUMN_DIR DIRECT /end RECORD_LAYOUT
/begin RECORD_LAYOUT _REC_CUR_20_u2_u2 FNC_VALUES 1 UWORD COLUMN_DIR DIRECT /end RECORD_LAYOUT
/begin RECORD_LAYOUT _REC_VAL_20_s1 FNC_VALUES 1 SBYTE COLUMN_DIR DIRECT /end RECORD_LAYOUT
/begin RECORD_LAYOUT _REC_VAL_20_s2 FNC_VALUES 1 SWORD COLUMN_DIR DIRECT /end RECORD_LAYOUT
/begin RECORD_LAYOUT _REC_MAP_20_u2_u1_u2 FNC_VALUES 1 UWORD COLUMN_DIR DIRECT /end RECORD_LAYOUT
/begin RECORD_LAYOUT _REC_MAP_20_u1_u2_u2 FNC_VALUES 1 UBYTE COLUMN_DIR DIRECT /end RECORD_LAYOUT
/begin RECORD_LAYOUT _REC_MAP_20_u2_u2_u2 FNC_VALUES 1 UWORD COLUMN_DIR DIRECT /end RECORD_LAYOUT
/begin RECORD_LAYOUT _REC_MAP_20_u1_u2_u1 FNC_VALUES 1 UBYTE COLUMN_DIR DIRECT /end RECORD_LAYOUT
/begin FUNCTION EOS_Basic_functions__FL__INF___R "_Basic functions: FL, INF & REACX"
 /begin DEF_CHARACTERISTIC c_n_max_fl_dly c_n_min_fl_dly c_t_max_fl_dly c_t_ti_dly_fl_2 c_t_ti_dly_fl_at_1 c_t_ti_dly_fl_at_2 c_tco_min_fl c_vs_min_fl c_n_min_fl c_t_min_fl_dly c_t_ti_dly_fl_1 c_n_min_cp_fl c_cl_mmv_thd_fl ip_pv_max_fl__n c_n_grd_min id_tps_grd_bol_ae__n__tps_av ldp_n_grd_n_max_inf ip_n_max_inf /end DEF_CHARACTERISTIC
 /begin OUT_MEASUREMENT lv_fl_raw lv_ti_ris lv_ti_rpu lv_ti_rpl lv_ti_rae lv_fl lv_inf lv_ti_reac /end OUT_MEASUREMENT
/end FUNCTION
/begin FUNCTION EOS_Auxiliary_start_functions "_Auxiliary start functions"
 /begin DEF_CHARACTERISTIC c_t_max_rest c_tco_dif_max_rest c_t_min_ecu_rest c_cyc_cast_min_st_es c_cyc_cast_max_st_es /end DEF_CHARACTERISTIC
 /begin OUT_MEASUREMENT t_ast t_ast_rest lv_ast tco_rest lv_rest cyc_cast t_st_es lv_st_es lv_stall /end OUT_MEASUREMENT
/end FUNCTION
/begin FUNCTION EOS_Combustion_Management "_Combustion_Management" /begin OUT_MEASUREMENT state_cmb_ctl /end OUT_MEASUREMENT /end FUNCTION
/begin FUNCTION EOS_Catalyst_heating_functions "_Catalyst heating functions"
 /begin DEF_CHARACTERISTIC ip_t_ch_n_sp_is id_t_ch_ti c_vs_max_ch_ivvt ip_t_ch_ivvt c_vs_max_ch_tq_add_is c_vs_max_ch_n_sp_is ip_t_ch_tq_add ip_t_ch_tq_add_wout_cat ip_t_ch_tq_add_is ip_t_ch_tq_add_is_wout_cat /end DEF_CHARACTERISTIC
 /begin OUT_MEASUREMENT lv_ti_ch lv_ch lv_ch_tq_add lv_ch_tq_add_is lv_ch_n_sp_is lv_ch_ivvt lv_wup lv_afl_ch /end OUT_MEASUREMENT
/end FUNCTION
/begin FUNCTION EOS_Combustion_Mode_Switch "_Combustion Mode Switch" /end FUNCTION
/begin FUNCTION EOS_Combustion_switch_request_to "_Combustion switch request to homogeneous stoichiometric for torque plausibility check" /end FUNCTION
/begin FUNCTION EOS_Runtime_Optimization_by_Recu "_Runtime Optimization by Recurrence Switch" /begin DEF_CHARACTERISTIC c_n_seg_2_ena /end DEF_CHARACTERISTIC /begin OUT_MEASUREMENT lv_clc_2seg lv_clc_2seg_ena /end OUT_MEASUREMENT /end FUNCTION
/begin FUNCTION ETC_Electronic_Throttle_Control "ETC"
 /begin SUB_FUNCTION ETC_Calculation_of_the_driver_de ETC_Throttle_position_setpoint_c ETC_Position_controller ETC_MAF_setpoint_for_stratified_ ETC_MAF_coordinaton_homogeneous_ ETC_Throttle_position_setpoint_s ETC_Application_incidences_throt ETC_Throttle_setpoint_calculatio ETC_Idle_speed_actuator_opening_ /end SUB_FUNCTION
/end FUNCTION
/begin FUNCTION ETC_Calculation_of_the_driver_de "_Calculation of the driver demand" /end FUNCTION
/begin FUNCTION ETC_Throttle_position_setpoint_c "_Throttle position setpoint calculation"
 /begin DEF_CHARACTERISTIC ip_amp_dec__maf_kgh_sp ip_tps_sp_mdl_max__n_32__maf_sp lc_ar_red_fil_ena lc_tps_fil_ena ip_crlc_ar_red_sp lc_inh_isapwm_man_as c_cycnr_isa_off c_isapwm_off_high c_isapwm_off_low c_t_isapwm_off c_lgrd_isapwm_off ip_crlc_ar_red_isa_sp ip_isapwm_isa c_isapwm_man_as c_isapwm_ofs_as c_crlc_isapwm_mmv c_isapwm_isa_diag ip_fac_isapwm_vb c_tps_max_diag c_pq_sp_max c_pq_sp_max_hys ip_isapwm_isa_pwl ip_isapwm_ivs_cor_isa ip_tps_sp_mdl_bas ip_fac_maf_dif_sp ip_maf_sp_add_fast_load_im lc_ar_red_isa_fil_ena lc_pq_sp_isa_maf_add c_pq_sp_max_isa c_crlc_maf_dif_sp /end DEF_CHARACTERISTIC
 /begin OUT_MEASUREMENT map_sp pq_sp maf_sp_ratio amp_mdl_ivs prs_up_thr_ivs ar_red_sp_mmv_1 ar_red_sp_mmv tps_sp_mdl_bas tps_sp_mdl tps_sp_mdl_max tps_sp_mdl_bas_cor maf_kgh_sp_isa_clc pq_sp_isa pq_sp_isa_1 maf_kgh_sp_thr maf_kgh_sp_isa_raw psi_sp psi_sp_isa ar_red_isa_sp_mmv ar_red_isa_sp_mmv_1 isapwm_isa_1 isapwm_isa_2 isapwm_mmv fac_isapwm_vb maf_turb_ratio ar_red_isa_sp_1 maf_kgh_sp_isa_min maf_kgh_sp_thr_min ar_red_isa_min ar_red_min maf_kgh_sp_isa maf_kgh_sp_isa_1 ar_red_sp_1 lv_h_load_tps_sp isapwm isapwm_isa isapwm_cor_isa maf_kgh_sp maf_sp_add_fast_load_im fac_maf_dif_sp pq_sp_wout_maf_add map_sp_wout_maf_add maf_dif_sp maf_dif_sp_1 /end OUT_MEASUREMENT
/end FUNCTION
/begin FUNCTION ETC_Position_controller "_Position controller"
 /begin DEF_CHARACTERISTIC c_mtcpwm_i_max_pos ip_mtcpwm_d__tps_dif_grd ip_mtcpwm_i__tps_dif ip_mtcpwm_p__tps_dif ip_mtcpwm_vb_fac__vb c_tps_sp_lih_dif_hys c_mtcpwm_i_max_neg c_mtcpwm_i_add c_mtcpwm_add_fil ip_mtcpwm_i_fac__tps_av_lih_dif ip_mtcpwm_add__tps_sp_lih_dif c_t_mtcpwm_close_act_max c_mtcpwm_close_max c_tps_sp_stop_hys c_tps_sp_stop_max c_mtcpwm_i_ini c_tps_sp_ctl_max c_mtcpwm_close c_mtcpwm_hys /end DEF_CHARACTERISTIC
 /begin OUT_MEASUREMENT tps_dif mtcpwm_add mtcpwm_ctl mtcpwm_d mtcpwm_p mtcpwm_i mtcpwm_i_add tps_sp_lih_dif mtcpwm_vb_fac tps_dif_grd t_mtcpwm_close_act tps_sp_ctl lv_tps_sp_pos lv_tps_chg_pos mtcpwm lv_mtcpwm_close_act tps_av_lih_dif lv_inh_mtc_ctl /end OUT_MEASUREMENT
/end FUNCTION
/begin FUNCTION ETC_MAF_setpoint_for_stratified_ "_MAF setpoint for stratified mode" /begin DEF_CHARACTERISTIC ip_pq_egr_sp ip_fac_maf_max_s ip_eff_maf_s lc_maf_sp_egr /end DEF_CHARACTERISTIC /begin OUT_MEASUREMENT maf_sp_s fac_maf_max_s maf_dif_s /end OUT_MEASUREMENT /end FUNCTION
/begin FUNCTION ETC_MAF_coordinaton_homogeneous_ "_MAF coordinaton homogeneous - stratified" /begin DEF_CHARACTERISTIC lc_isa_ena ip_maf_sp_isa /end DEF_CHARACTERISTIC /begin OUT_MEASUREMENT maf_sp maf_sp_isa lv_isa_ena maf_turb_ratio_max /end OUT_MEASUREMENT /end FUNCTION
/begin FUNCTION ETC_Throttle_position_setpoint_s "_Throttle position setpoint selection"
 /begin DEF_CHARACTERISTIC c_tps_av_bol c_tps_av_tol c_tps_sp_min c_tps_sp_min_tps_ad_req c_tps_sp_max_tps_ad_req c_tps_sp_max c_tps_sp_tol c_tps_sp_tol_tps_ad_req c_tps_sp_bol_tps_ad_req c_tps_sp_bol c_tps_sp_lgrd_tot ip_tps_sp_lgrd_st c_tps_sp_lgrd_stop /end DEF_CHARACTERISTIC
 /begin OUT_MEASUREMENT lv_mtc_cur_off lv_tps_sp_lih tps_sp_sel tps_sp tps_sp_lim tps_sp_lim_2 tps_sp_lim_1 lv_tps_sp_tra_st_mdl tps_sp_tra_st_mdl /end OUT_MEASUREMENT
/end FUNCTION
/begin FUNCTION ETC_Application_incidences_throt "_Application incidences throttle position setpoint selection"
 /begin DEF_CHARACTERISTIC c_tps_sp_pwl_lgrd c_tps_sp_pwl_up c_tps_sp_as_man c_tps_sp_ext_adj_ena c_pv_av_ext_adj_min ip_tps_sp_pwl ip_tps_sp_ext_adj ip_tps_sp_es c_t_mtc_isa_off /end DEF_CHARACTERISTIC
 /begin OUT_MEASUREMENT tps_sp_pwl lv_tps_pwl tps_sp_ext_adj tps_sp_ext_adj_1 lv_tps_sp_ext_adj lv_tps_sp_ext_adj_1 tps_sp_es /end OUT_MEASUREMENT
/end FUNCTION
/begin FUNCTION ETC_Throttle_setpoint_calculatio "_Throttle setpoint calculation at start"
 /begin DEF_CHARACTERISTIC ip_tps_rel_st_at ip_tps_rel_st_mt ip_tps_rel_st_pv ip_fac_amp_tps_rel_st ip_tps_sp_st ip_fac_tia_tps_rel_st /end DEF_CHARACTERISTIC
 /begin OUT_MEASUREMENT tps_sp_st tps_rel_st /end OUT_MEASUREMENT
/end FUNCTION
/begin FUNCTION ETC_Idle_speed_actuator_opening_ "_Idle speed actuator opening at start"
 /begin DEF_CHARACTERISTIC ip_opg_rel_st_isa_at ip_opg_rel_st_isa_mt ip_opg_rel_st_isa_pv ip_fac_tia_opg_st_isa ip_fac_amp_opg_st_isa ip_opg_sp_st_isa /end DEF_CHARACTERISTIC
 /begin OUT_MEASUREMENT opg_sp_st_isa opg_rel_st /end OUT_MEASUREMENT
/end FUNCTION
/begin FUNCTION IGA_Ignition_Angle "IGA"
 /begin SUB_FUNCTION IGA_Ignition_angle_general IGA_Dwell_time_control_open_loop IGA_Ignition_with_multiple_spark IGA_Corrected_basic_ignition_ang IGA_Setpoint_ignition_angle IGA_Minimum_ignition_angle IGA_Basic_ignition_angle_at_star IGA_KnockControl IGA_Ignition_angle_for_stratifie IGA_Corrected_Reference_Ignition IGA_Ignition_angle_correction_du IGA_Temperature_Correction IGA_Minimum_IGA_limitation_for_e IGA_Catalyst_heating_correction IGA_RON_Adaptation IGA_Load_dynamics_correction /end SUB_FUNCTION
/end FUNCTION
/begin FUNCTION IGA_Ignition_angle_general "_Ignition angle general"
 /begin DEF_CHARACTERISTIC c_crlc_iga_knk c_cycnr_iga_es lc_iga_st_ena lc_inh_iga_tra_knk_eff ip_iga_lgrd_ast c_iga_ini lc_iga_man c_iga_as c_iga_man c_iga_as_cyl[0] c_iga_as_cyl[1] c_iga_as_cyl[2] c_iga_as_cyl[3] c_iga_as_cyl[4] c_iga_as_cyl[5] ipm_eff_iga__iga_dif c_iga_min_etc_lih /end DEF_CHARACTERISTIC
 /begin OUT_MEASUREMENT iga_av_1[0] iga_av_1[1] iga_av_1[2] iga_av_1[3] iga_av_1[4] iga_av_1[5] iga[0] iga[1] iga[2] iga[3] iga[4] iga[5] iga_min eff_iga_bas_cor eff_iga_ron_98_1 eff_iga_ron_98_2 eff_iga_av_1 eff_iga_av_2 eff_iga_min iga_bas_cor_knk_add iga_av_mv_1 iga_av_mv_2 iga_dif_bas iga_dif_av_1 iga_dif_av_2 iga_dif_ron_98_1 iga_dif_ron_98_2 iga_mv_knk_fil iga_bas_cor_knk_fil eff_iga_bas_cor_knk_fil lv_iga_grd_act iga_dif_bas_knk_fil iga_igc[0] iga_igc[1] iga_igc[2] iga_igc[3] iga_igc[4] iga_igc[5] iga_wout_knk[0] iga_wout_knk[1] iga_wout_knk[2] iga_wout_knk[3] iga_wout_knk[4] iga_wout_knk[5] eff_iga_av eff_iga_av_can iga_sp_max_1 iga_sp_max_1_can iga_av_mv iga_av_mv_can iga_dif_av iga_dif_av_can /end OUT_MEASUREMENT
/end FUNCTION
/begin FUNCTION IGA_Dwell_time_control_open_loop "_Dwell time control open loop" /begin DEF_CHARACTERISTIC c_td_ini c_td_as ip_td__vb /end DEF_CHARACTERISTIC /begin OUT_MEASUREMENT td_max_wdt td /end OUT_MEASUREMENT /end FUNCTION
/begin FUNCTION IGA_Ignition_with_multiple_spark "_Ignition with multiple spark"
 /begin DEF_CHARACTERISTIC c_tco_max_mpl_is c_tco_max_mpl_st c_vb_max_mpl c_td_t_mpl c_n_max_ign_mpl ip_nr_mpl_st ip_nr_mpl_is ldp_tco__nr_mpl_st ldp_tco__nr_mpl_is ip_td_mpl /end DEF_CHARACTERISTIC
 /begin OUT_MEASUREMENT lv_mpl_iga_act td_mpl_dly td_mpl ign_mpl_nr /end OUT_MEASUREMENT
/end FUNCTION
/begin FUNCTION IGA_Corrected_basic_ignition_ang "_Corrected basic ignition angle"
 /begin DEF_CHARACTERISTIC c_iga_bas_add_max c_iga_bas_add_min ip_iga_bas_ron_91__n__maf ip_iga_bas_add_max_ivvt__n__maf ip_iga_bas_add_min_ivvt__n__maf ip_iga_bas_lamb__lamb_sp ip_iga_bas__n__maf ip_iga_bas_ron_98__n__maf /end DEF_CHARACTERISTIC
 /begin OUT_MEASUREMENT iga_bas_cor iga_bas_ivvt iga_bas_lamb_cor iga_bas_ivvt_ofs iga_bas_ron /end OUT_MEASUREMENT
/end FUNCTION
/begin FUNCTION IGA_Setpoint_ignition_angle "_Setpoint ignition angle"
 /begin DEF_CHARACTERISTIC ip_iga_dif_sp__eff_iga_sp lc_tq_iga_inh c_eff_iga_thd_1 c_eff_iga_thd_aj c_eff_iga_thd_is /end DEF_CHARACTERISTIC
 /begin OUT_MEASUREMENT iga_dif_sp lv_tq_iga_act lv_tq_iga_req eff_iga_sp eff_iga_sp_can eff_iga_sp_1 eff_iga_sp_1_can iga_sp iga_sp_can /end OUT_MEASUREMENT
/end FUNCTION
/begin FUNCTION IGA_Minimum_ignition_angle "_Minimum ignition angle"
 /begin DEF_CHARACTERISTIC c_iga_dif_min_delta_temp_ena c_iga_dif_min_delta_lgrd ip_iga_dif_min_tco ip_iga_dif_min_delta c_iga_dif_min_delta_temp_dis ip_iga_dif_min_cyc_mt ip_iga_dif_min_cyc_at ip_iga_dif_min_cyc_amp_at ip_iga_dif_min_cyc_amp_mt ip_iga_min_n_maf_ext ip_iga_dif_min_tco_ext ip_iga_min_n_maf ip_fac_iga_min_tco_ext ip_fac_iga_dif_ast ip_t_iga_min_puc c_iga_dif_min_bas_lgrd c_iga_min_puc_lgrd ip_fac_iga_min_tco_pu ip_iga_dif_min_tco_pu ip_iga_min_n_maf_pu ip_fac_iga_min_tco ip_fac_iga_dif_min_amp /end DEF_CHARACTERISTIC
 /begin OUT_MEASUREMENT iga_dif_min iga_dif_min_delta lv_iga_dif_min_delta_act iga_dif_min_ast lv_iga_min_ext iga_min_bas iga_min_bas_1 iga_min_bas_ext iga_min_bas_int iga_min_bas_puc iga_min_bas_pu /end OUT_MEASUREMENT
/end FUNCTION
/begin FUNCTION IGA_Basic_ignition_angle_at_star "_Basic ignition angle at start" /begin DEF_CHARACTERISTIC ip_iga_st_bas ip_iga_st_cyc_st_cor ip_iga_st_amp_cor /end DEF_CHARACTERISTIC /begin OUT_MEASUREMENT iga_st /end OUT_MEASUREMENT /end FUNCTION
/end MODULE
/end PROJECT
