ASAP2_VERSION 1 31
/begin PROJECT MS45 "BMW Motorsteuerung R6"
/begin HEADER "_default_HeaderComment" PROJECT_NO _57 /end HEADER
/begin MODULE _default_ModuleName "_default_ModuleLongIdentifier"
/begin MOD_COMMON "_default_ModCommonComment" DEPOSIT ABSOLUTE BYTE_ORDER MSB_FIRST ALIGNMENT_BYTE 1 ALIGNMENT_WORD 2 ALIGNMENT_LONG 4 ALIGNMENT_FLOAT32_IEEE 4 ALIGNMENT_FLOAT64_IEEE 8 /end MOD_COMMON
/begin AXIS_PTS ldp_tco__ip_n_max_iv_diag "" 0xffe411cb tco _REC_AXS_20_u1 190.5 _CNV_A_R_LINEAR_____11_CM 6 -48. 142.5 DISPLAY_IDENTIFIER LDP_TCO__IP_N_MAX_IV_DIAG FORMAT "%5.1" /end AXIS_PTS
/begin MEASUREMENT tco_dif "" SBYTE _CNV_A_R_LINEAR_____12_CM 1 100. -96. 95.25 DISPLAY_IDENTIFIER TCO_DIF ECU_ADDRESS 0x3fe921 FORMAT "%3.1" /end MEASUREMENT
/begin AXIS_PTS ldpm_n_32_28 "" 0xffe48482 n_32 _REC_AXS_20_u1 8160. _CNV_A_R_LINEAR_____15_CM 12 0. 8160. DISPLAY_IDENTIFIER LDPM_N_32_28 FORMAT "%4.0" /end AXIS_PTS
/begin AXIS_PTS ldpm_fac_tq_req_ect_1 "" 0xffe5187c fac_tq_req _REC_AXS_20_u2 1.99996948 _CNV_A_R_LINEAR_____20_CM 6 0. 1.99996948 DISPLAY_IDENTIFIER LDPM_FAC_TQ_REQ_ECT_1 FORMAT "%7.5" /end AXIS_PTS
/begin AXIS_PTS ldpm_gear_ef_1 "" 0xffe4838f gear_ef _REC_AXS_20_u1 12. _CNV_A_R_LINEAR_____22_CM 13 0. 12. DISPLAY_IDENTIFIER LDPM_GEAR_EF_1 FORMAT "%3.0" /end AXIS_PTS
/begin AXIS_PTS ldpm_n_32__ef "" 0xffe413b2 n_32 _REC_AXS_20_u1 8160. _CNV_A_R_LINEAR_____15_CM 5 0. 8160. DISPLAY_IDENTIFIER LDPM_N_32__EF FORMAT "%4.0" /end AXIS_PTS
/begin AXIS_PTS ldp_maf__thd_is_er_diag "" 0xffe41059 maf _REC_AXS_20_u1 1389. _CNV_A_R_LINEAR_____27_CM 4 0. 1389. DISPLAY_IDENTIFIER LDP_MAF__THD_IS_ER_DIAG FORMAT "%4.0" /end AXIS_PTS
/begin AXIS_PTS ldp_n__thd_is_er_diag "" 0xffe51024 n _REC_AXS_20_u2 816. _CNV_A_R_LINEAR_____10_CM 4 0. 8160. DISPLAY_IDENTIFIER LDP_N__THD_IS_ER_DIAG FORMAT "%4.0" /end AXIS_PTS
/begin AXIS_PTS ldp_tco__fac_thd_is_er_diag "" 0xffe481c2 tco _REC_AXS_20_u1 190.5 _CNV_A_R_LINEAR_____11_CM 8 -48. 142.5 DISPLAY_IDENTIFIER LDP_TCO__FAC_THD_IS_ER_DIAG FORMAT "%5.1" /end AXIS_PTS
/begin AXIS_PTS ldpm_vs_wheel_grd_mmv_thd "" 0xffe48729 vs _REC_AXS_20_u1 255. _CNV_A_R_LINEAR_____23_CM 9 0. 255. DISPLAY_IDENTIFIER LDPM_VS_WHEEL_GRD_MMV_THD FORMAT "%3.0" /end AXIS_PTS
/begin AXIS_PTS ldp_vb_sof "" 0xffe48323 vb _REC_AXS_20_u1 25.8984 _CNV_A_R_LINEAR_____34_CM 8 0. 25.8984 DISPLAY_IDENTIFIER LDP_VB_SOF FORMAT "%3.1" /end AXIS_PTS
/begin AXIS_PTS ldp_tia_sof "" 0xffe4829c tia _REC_AXS_20_u1 190.5 _CNV_A_R_LINEAR_____11_CM 8 -48. 142.5 DISPLAY_IDENTIFIER LDP_TIA_SOF FORMAT "%5.1" /end AXIS_PTS
/begin AXIS_PTS ldpm_t_sof_act "" 0xffe51d3a t_sof_act _REC_AXS_20_u2 655.35 _CNV_A_R_LINEAR_____4_CM 15 0. 655.35 DISPLAY_IDENTIFIER LDPM_T_SOF_ACT FORMAT "%6.2" /end AXIS_PTS
/begin AXIS_PTS ldp_pv_av_sof_req_1 "" 0xffe41171 pv_av_sof_req _REC_AXS_20_u1 99.609375 _CNV_A_R_LINEAR_____9_CM 4 0. 99.609375 DISPLAY_IDENTIFIER LDP_PV_AV_SOF_REQ_1 FORMAT "%4.1" /end AXIS_PTS
/begin AXIS_PTS ldp_pv_av_sof_req_2 "" 0xffe41176 pv_av_sof_req _REC_AXS_20_u1 99.609375 _CNV_A_R_LINEAR_____9_CM 4 0. 99.609375 DISPLAY_IDENTIFIER LDP_PV_AV_SOF_REQ_2 FORMAT "%4.1" /end AXIS_PTS
/begin AXIS_PTS ldp_pv_av_sof_req_3 "" 0xffe4117b pv_av_sof_req _REC_AXS_20_u1 99.609375 _CNV_A_R_LINEAR_____9_CM 4 0. 99.609375 DISPLAY_IDENTIFIER LDP_PV_AV_SOF_REQ_3 FORMAT "%4.1" /end AXIS_PTS
/begin AXIS_PTS ldp_pv_av_sof_req_4 "" 0xffe41180 pv_av_sof_req _REC_AXS_20_u1 99.609375 _CNV_A_R_LINEAR_____9_CM 4 0. 99.609375 DISPLAY_IDENTIFIER LDP_PV_AV_SOF_REQ_4 FORMAT "%4.1" /end AXIS_PTS
/begin AXIS_PTS ldp_pv_av_sof_req_5 "" 0xffe41185 pv_av_sof_req _REC_AXS_20_u1 99.609375 _CNV_A_R_LINEAR_____9_CM 4 0. 99.609375 DISPLAY_IDENTIFIER LDP_PV_AV_SOF_REQ_5 FORMAT "%4.1" /end AXIS_PTS
/begin AXIS_PTS ldp_pv_av_sof_req_0 "" 0xffe4116c pv_av_sof_req _REC_AXS_20_u1 99.609375 _CNV_A_R_LINEAR_____9_CM 4 0. 99.609375 DISPLAY_IDENTIFIER LDP_PV_AV_SOF_REQ_0 FORMAT "%4.1" /end AXIS_PTS
/begin AXIS_PTS ldp_pv_av_sof_req_6 "" 0xffe4118a pv_av_sof_req _REC_AXS_20_u1 99.609375 _CNV_A_R_LINEAR_____9_CM 4 0. 99.609375 DISPLAY_IDENTIFIER LDP_PV_AV_SOF_REQ_6 FORMAT "%4.1" /end AXIS_PTS
/begin AXIS_PTS ldp_n_sof_req_1 "" 0xffe510e2 n_sof_req _REC_AXS_20_u2 8160. _CNV_A_R_LINEAR_____10_CM 6 0. 8160. DISPLAY_IDENTIFIER LDP_N_SOF_REQ_1 FORMAT "%4.0" /end AXIS_PTS
/begin AXIS_PTS ldp_n_sof_req_2 "" 0xffe510f0 n_sof_req _REC_AXS_20_u2 8160. _CNV_A_R_LINEAR_____10_CM 6 0. 8160. DISPLAY_IDENTIFIER LDP_N_SOF_REQ_2 FORMAT "%4.0" /end AXIS_PTS
/begin AXIS_PTS ldp_n_sof_req_3 "" 0xffe510fe n_sof_req _REC_AXS_20_u2 8160. _CNV_A_R_LINEAR_____10_CM 6 0. 8160. DISPLAY_IDENTIFIER LDP_N_SOF_REQ_3 FORMAT "%4.0" /end AXIS_PTS
/begin AXIS_PTS ldp_n_sof_req_4 "" 0xffe5110c n_sof_req _REC_AXS_20_u2 8160. _CNV_A_R_LINEAR_____10_CM 6 0. 8160. DISPLAY_IDENTIFIER LDP_N_SOF_REQ_4 FORMAT "%4.0" /end AXIS_PTS
/begin AXIS_PTS ldp_n_sof_req_5 "" 0xffe5111a n_sof_req _REC_AXS_20_u2 8160. _CNV_A_R_LINEAR_____10_CM 6 0. 8160. DISPLAY_IDENTIFIER LDP_N_SOF_REQ_5 FORMAT "%4.0" /end AXIS_PTS
/begin AXIS_PTS ldp_n_sof_req_0 "" 0xffe510d4 n_sof_req _REC_AXS_20_u2 8160. _CNV_A_R_LINEAR_____10_CM 6 0. 8160. DISPLAY_IDENTIFIER LDP_N_SOF_REQ_0 FORMAT "%4.0" /end AXIS_PTS
/begin AXIS_PTS ldp_n_sof_req_6 "" 0xffe51128 n_sof_req _REC_AXS_20_u2 8160. _CNV_A_R_LINEAR_____10_CM 6 0. 8160. DISPLAY_IDENTIFIER LDP_N_SOF_REQ_6 FORMAT "%4.0" /end AXIS_PTS
/begin MEASUREMENT lv_sof_swi_req_mon "Sport Mode required by switch" UBYTE _CNV_S_2_RANGE______21_CM 1 100. 0. 1. DISPLAY_IDENTIFIER LV_SOF_SWI_REQ_MON ECU_ADDRESS 0x3fec24 /end MEASUREMENT
/begin MEASUREMENT lv_sof_swi_mon "Sport Mode switch acting" UBYTE _CNV_S_2_RANGE______21_CM 1 100. 0. 1. DISPLAY_IDENTIFIER LV_SOF_SWI_MON ECU_ADDRESS 0x3fec32 /end MEASUREMENT
/begin MEASUREMENT lv_rng_l_mon "Logical variable for engaged low range monitoring" UBYTE _CNV_S_2_RANGE______2_CM 1 100. 0. 1. DISPLAY_IDENTIFIER LV_RNG_L_MON ECU_ADDRESS 0x3fec25 /end MEASUREMENT
/begin MEASUREMENT lv_rng_l_req_mon "Activation condition for low-range-mode" UBYTE _CNV_S_2_RANGE______2_CM 1 100. 0. 1. DISPLAY_IDENTIFIER LV_RNG_L_REQ_MON ECU_ADDRESS 0x3fec26 /end MEASUREMENT
/begin MEASUREMENT lv_err_sof_inh_mon "Error flag sport mode switch request monitoring" UBYTE _CNV_S_2_RANGE______1_R_CM 1 100. 0. 255. DISPLAY_IDENTIFIER LV_ERR_SOF_INH_MON ECU_ADDRESS 0x3fec27 /end MEASUREMENT
/begin MEASUREMENT abc_sof_inh_mon "Error flag sport mode switch request monitoring" UBYTE _CNV_A_R_LINEAR_____0_CM 1 100. 0. 255. DISPLAY_IDENTIFIER ABC_SOF_INH_MON ECU_ADDRESS 0x3fec28 FORMAT "%3.0" /end MEASUREMENT
/begin CHARACTERISTIC c_v_sof_swi_on_tol_mon "Voltage-Treshold top limit for sport mode ON" VALUE 0xffe522ea _REC_VAL_20_u2 4.99511719 _CNV_A_R_LINEAR_____3_CM 0. 4.99511719 DISPLAY_IDENTIFIER C_V_SOF_SWI_ON_TOL_MON FORMAT "%5.3" /end CHARACTERISTIC
/begin CHARACTERISTIC c_v_sof_swi_on_bol_mon "Voltage-Treshold bottom limit for sport mode ON" VALUE 0xffe522e8 _REC_VAL_20_u2 4.99511719 _CNV_A_R_LINEAR_____3_CM 0. 4.99511719 DISPLAY_IDENTIFIER C_V_SOF_SWI_ON_BOL_MON FORMAT "%5.3" /end CHARACTERISTIC
/begin CHARACTERISTIC lc_var_sof_swi_mon "Calibration sport switch (1 on / 0 off)" VALUE 0xffe521cd _REC_VAL_20_u1 1. _CNV_A_R_LINEAR_____0_CM 0. 1. DISPLAY_IDENTIFIER LC_VAR_SOF_SWI_MON FORMAT "%2.0" /end CHARACTERISTIC
/begin CHARACTERISTIC lc_rng_l_mon "Manual switch for low range detection monitoring" VALUE 0xffe521c9 _REC_VAL_20_u1 1. _CNV_A_R_LINEAR_____22_CM 0. 1. DISPLAY_IDENTIFIER LC_RNG_L_MON FORMAT "%1.0" /end CHARACTERISTIC
/begin CHARACTERISTIC lc_conf_city_ena_mon "Enable city mode off condition (1 on / 0 off)" VALUE 0xffe521c7 _REC_VAL_20_u1 1. _CNV_A_R_LINEAR_____0_CM 0. 1. DISPLAY_IDENTIFIER LC_CONF_CITY_ENA_MON FORMAT "%2.0" /end CHARACTERISTIC
/begin CHARACTERISTIC c_pv_av_sof_min_mon "PV_AV threshold for activation IP_FAC_TQ_REQ_DRIV_RNG_L_MON" VALUE 0xffe51f73 _REC_VAL_20_u1 99.609375 _CNV_A_R_LINEAR_____9_CM 0. 99.609375 DISPLAY_IDENTIFIER C_PV_AV_SOF_MIN_MON FORMAT "%4.1" /end CHARACTERISTIC
/begin CHARACTERISTIC c_fac_tq_req_driv_sof_max_mon "Scaling factor threshold for activation IP_FAC_TQ_REQ_DRIV_RNG_L_MON" VALUE 0xffe51f66 _REC_VAL_20_u1 1.99220002 _CNV_A_R_LINEAR_____39_CM 0. 1.99220002 DISPLAY_IDENTIFIER C_FAC_TQ_REQ_DRIV_SOF_MAX_MON FORMAT "%5.3" /end CHARACTERISTIC
/begin CHARACTERISTIC c_pv_av_grd_sof_max_mon "Pedal value gradient rheshold for recognition of LV_RNG_L_MON" VALUE 0xffe51f72 _REC_VAL_20_u1 2490.234 _CNV_A_R_LINEAR_____40_CM -1250. 1240.234 DISPLAY_IDENTIFIER C_PV_AV_GRD_SOF_MAX_MON FORMAT "%6.1" /end CHARACTERISTIC
/begin CHARACTERISTIC c_t_pv_av_grd_sof_max_mon "Minimum time for pedal value gradient for recognition of LV_RNG_L_MON" VALUE 0xffe51f85 _REC_VAL_20_u1 10.2 _CNV_A_R_LINEAR_____41_CM 0. 10.2 DISPLAY_IDENTIFIER C_T_PV_AV_GRD_SOF_MAX_MON FORMAT "%5.2" /end CHARACTERISTIC
/begin CHARACTERISTIC lc_rng_l_man_as_mon "Calibration constant for to activate IP_FAC_TQ_REQ_DRIV_RNG_L (low range mode) in case if LV_RNG_L = 0 (default value = 0)" VALUE 0xffe521c8 _REC_VAL_20_u1 1. _CNV_A_R_LINEAR_____0_CM 0. 1. DISPLAY_IDENTIFIER LC_RNG_L_MAN_AS_MON FORMAT "%2.0" /end CHARACTERISTIC
/begin CHARACTERISTIC c_v_sof_swi_min_mon "Input voltage threshold min" VALUE 0xffe522e6 _REC_VAL_20_u2 4.99511719 _CNV_A_R_LINEAR_____3_CM 0. 4.99511719 DISPLAY_IDENTIFIER C_V_SOF_SWI_MIN_MON FORMAT "%5.3" /end CHARACTERISTIC
/begin CHARACTERISTIC c_v_sof_swi_max_mon "Input voltage threshold max" VALUE 0xffe522e4 _REC_VAL_20_u2 4.99511719 _CNV_A_R_LINEAR_____3_CM 0. 4.99511719 DISPLAY_IDENTIFIER C_V_SOF_SWI_MAX_MON FORMAT "%5.3" /end CHARACTERISTIC
/begin AXIS_PTS ldpm_n_32__t_acc "" 0xffe413c6 n_32 _REC_AXS_20_u1 8160. _CNV_A_R_LINEAR_____15_CM 3 0. 8160. DISPLAY_IDENTIFIER LDPM_N_32__T_ACC FORMAT "%4.0" /end AXIS_PTS
/begin AXIS_PTS ldp_vs__amp_raw_cor "" 0xffe4833e vs _REC_AXS_20_u1 255. _CNV_A_R_LINEAR_____23_CM 8 0. 255. DISPLAY_IDENTIFIER LDP_VS__AMP_RAW_COR FORMAT "%3.0" /end AXIS_PTS
/begin AXIS_PTS ldp_v_amp_1__amp_raw "" 0xffe51584 v_amp _REC_AXS_20_u2 4.99511719 _CNV_A_R_LINEAR_____3_CM 8 0. 4.99511719 DISPLAY_IDENTIFIER LDP_V_AMP_1__AMP_RAW FORMAT "%5.3" /end AXIS_PTS
/begin AXIS_PTS ldp_v_amp_2__amp_raw "" 0xffe51596 v_amp _REC_AXS_20_u2 4.99511719 _CNV_A_R_LINEAR_____3_CM 8 0. 4.99511719 DISPLAY_IDENTIFIER LDP_V_AMP_2__AMP_RAW FORMAT "%5.3" /end AXIS_PTS
/begin AXIS_PTS ldpm_n_2_3 "" 0xffe51aac n _REC_AXS_20_u2 816. _CNV_A_R_LINEAR_____10_CM 16 0. 8160. DISPLAY_IDENTIFIER LDPM_N_2_3 FORMAT "%4.0" /end AXIS_PTS
/begin AXIS_PTS ldp_n_23 "" 0xffe41078 n_32 _REC_AXS_20_u1 816. _CNV_A_R_LINEAR_____15_CM 6 0. 8160. DISPLAY_IDENTIFIER LDP_N_23 FORMAT "%4.0" /end AXIS_PTS
/begin AXIS_PTS ldp_tps_av_id_tps_grd_bol_ae "" 0xffe513aa tps_av _REC_AXS_20_u2 11.95 _CNV_A_R_LINEAR_____53_CM 4 0. 119.5 DISPLAY_IDENTIFIER LDP_TPS_AV_ID_TPS_GRD_BOL_AE FORMAT "%7.3" /end AXIS_PTS
/begin AXIS_PTS ldp_toil__t_dly_poil_swi_can "" 0xffe412bc toil _REC_AXS_20_u1 200. _CNV_A_R_LINEAR_____14_CM 6 -40. 160. DISPLAY_IDENTIFIER LDP_TOIL__T_DLY_POIL_SWI_CAN FORMAT "%3.0" /end AXIS_PTS
/begin AXIS_PTS ldpm_cam_edge_nr_0__win_chk "" 0xffe41331 cam_edge_nr_0 _REC_AXS_20_u1 3. _CNV_A_R_LINEAR_____0_CM 4 0. 3. DISPLAY_IDENTIFIER LDPM_CAM_EDGE_NR_0__WIN_CHK FORMAT "%2.0" /end AXIS_PTS
/begin AXIS_PTS ldpm_cam_edge_nr_1__win_chk "" 0xffe41336 cam_edge_nr_1 _REC_AXS_20_u1 3. _CNV_A_R_LINEAR_____0_CM 4 0. 3. DISPLAY_IDENTIFIER LDPM_CAM_EDGE_NR_1__WIN_CHK FORMAT "%2.0" /end AXIS_PTS
/begin AXIS_PTS ldpm_ctr_km_can "" 0xffe5179a ctr_km_can _REC_AXS_20_u2 655340. _CNV_A_R_LINEAR_____88_CM 4 0. 655340. DISPLAY_IDENTIFIER LDPM_CTR_KM_CAN FORMAT "%6.0" /end AXIS_PTS
/begin AXIS_PTS ldp_vs_fil__tq_gs_inc_mon "" 0xffe523fe vs_fil _REC_AXS_20_u2 511.99218 _CNV_A_R_LINEAR_____85_CM 6 0. 511.99218 DISPLAY_IDENTIFIER LDP_VS_FIL__TQ_GS_INC_MON FORMAT "%7.3" /end AXIS_PTS
/begin AXIS_PTS ldp_n_32__tq_gs_inc_mon "" 0xffe52213 n_32 _REC_AXS_20_u1 8160. _CNV_A_R_LINEAR_____15_CM 6 0. 8160. DISPLAY_IDENTIFIER LDP_N_32__TQ_GS_INC_MON FORMAT "%4.0" /end AXIS_PTS
/begin AXIS_PTS ldpm_tco_2 "" 0xffe48611 tco _REC_AXS_20_u1 190.5 _CNV_A_R_LINEAR_____11_CM 8 -48. 142.5 DISPLAY_IDENTIFIER LDPM_TCO_2 FORMAT "%5.1" /end AXIS_PTS
/begin AXIS_PTS ldp_flow_cor_cps_ip_cppwm "" 0xffe50bb6 flow_cor_cps _REC_AXS_20_u2 7.99987793 _CNV_A_R_LINEAR_____113_CM 12 0. 7.99987793 DISPLAY_IDENTIFIER LDP_FLOW_COR_CPS_IP_CPPWM FORMAT "%7.4" /end AXIS_PTS
/begin AXIS_PTS ldpm_prs_cps_ip_cppwm "" 0xffe51c82 prs_cps _REC_AXS_20_u2 5434. _CNV_A_R_LINEAR_____116_CM 12 -2717. 2717. DISPLAY_IDENTIFIER LDPM_PRS_CPS_IP_CPPWM FORMAT "%7.2" /end AXIS_PTS
/begin AXIS_PTS ldp_amp_ip_fac_amp_cp "" 0xffe50998 amp _REC_AXS_20_u2 5434. _CNV_A_R_LINEAR_____49_CM 6 0. 5434. DISPLAY_IDENTIFIER LDP_AMP_IP_FAC_AMP_CP FORMAT "%7.2" /end AXIS_PTS
/begin AXIS_PTS ldp_tia_thr_ip_fac_tia_cp "" 0xffe412a4 tia _REC_AXS_20_u1 190.5 _CNV_A_R_LINEAR_____11_CM 6 -48. 142.5 DISPLAY_IDENTIFIER LDP_TIA_THR_IP_FAC_TIA_CP FORMAT "%5.1" /end AXIS_PTS
/begin AXIS_PTS ldp_cl_ip_rel_flow_fac_cp "" 0xffe50a7e cl _REC_AXS_20_u2 1.999878 _CNV_A_R_LINEAR_____122_CM 6 0. 1.999878 DISPLAY_IDENTIFIER LDP_CL_IP_REL_FLOW_FAC_CP FORMAT "%6.4" /end AXIS_PTS
/begin AXIS_PTS ldpm_maf_ip_rel_flow_max_cps "" 0xffe4842f maf _REC_AXS_20_u1 1389. _CNV_A_R_LINEAR_____27_CM 12 0. 1389. DISPLAY_IDENTIFIER LDPM_MAF_IP_REL_FLOW_MAX_CPS FORMAT "%4.0" /end AXIS_PTS
/begin AXIS_PTS ldpm_cl_mmv_ip_nr_step_cl "" 0xffe41d22 maf _REC_AXS_20_u2 1.99996948 _CNV_A_R_LINEAR_____20_CM 3 0. 1.99996948 DISPLAY_IDENTIFIER LDPM_CL_MMV_IP_NR_STEP_CL FORMAT "%7.5" /end AXIS_PTS
/begin AXIS_PTS ldp_tco_ip_rel_fuel_max_cp_cor "" 0xffe41213 tco _REC_AXS_20_u1 190.5 _CNV_A_R_LINEAR_____11_CM 5 -48. 142.5 DISPLAY_IDENTIFIER LDP_TCO_IP_REL_FUEL_MAX_CP_COR FORMAT "%5.1" /end AXIS_PTS
/begin AXIS_PTS ldpm_vb_ip_cppwm_vb "" 0xffe4870a vb _REC_AXS_20_u1 25.8984 _CNV_A_R_LINEAR_____34_CM 8 0. 25.8984 DISPLAY_IDENTIFIER LDPM_VB_IP_CPPWM_VB FORMAT "%3.1" /end AXIS_PTS
/begin AXIS_PTS ldp_cppwm_ref_ip_cppwm_cor_frq "" 0xffe47f17 cppwm_ref _REC_AXS_20_u1 99.609375 _CNV_A_R_LINEAR_____9_CM 8 0. 99.609375 DISPLAY_IDENTIFIER LDP_CPPWM_REF_IP_CPPWM_COR_FRQ FORMAT "%5.1" /end AXIS_PTS
/begin AXIS_PTS ldp_cl_mmv_ip_t_max_cp "" 0xffe50a9a cl_mmv _REC_AXS_20_u2 1.99996948 _CNV_A_R_LINEAR_____20_CM 6 0. 1.99996948 DISPLAY_IDENTIFIER LDP_CL_MMV_IP_T_MAX_CP FORMAT "%6.4" /end AXIS_PTS
/begin MEASUREMENT state_mff_ad_1_act "State of fixed adaptation phases" UBYTE _CNV_S_6_RANGE_STAT_134_CM 1 100. 0. 5. DISPLAY_IDENTIFIER STATE_MFF_AD_1_ACT ECU_ADDRESS 0x3fe39e /end MEASUREMENT
/begin AXIS_PTS ldpm_t_ctl_cru_1 "" 0xffe41415 t_ctl_cru _REC_AXS_20_u1 2.55 _CNV_A_R_LINEAR_____24_CM 5 0. 25.5 DISPLAY_IDENTIFIER LDPM_T_CTL_CRU_1 FORMAT "%4.1" /end AXIS_PTS
/begin AXIS_PTS ldp_vs_dif_cru__fac_prop_cru "" 0xffe516f0 vs_dif_cru _REC_AXS_20_u2 511.9921875 _CNV_A_R_LINEAR_____150_CM 4 -256. 255.9921875 DISPLAY_IDENTIFIER LDP_VS_DIF_CRU__FAC_PROP_CRU FORMAT "%7.3" /end AXIS_PTS
/begin AXIS_PTS ldpm_vs_sp_dif_cru_1 "" 0xffe51f02 vs_sp_dif_cru _REC_AXS_20_u2 511.9921875 _CNV_A_R_LINEAR_____150_CM 5 -256. 255.9921875 DISPLAY_IDENTIFIER LDPM_VS_SP_DIF_CRU_1 FORMAT "%7.3" /end AXIS_PTS
/begin AXIS_PTS ldpm_n_21 "" 0xffe4137e n_32 _REC_AXS_20_u1 8160. _CNV_A_R_LINEAR_____15_CM 3 0. 8160. DISPLAY_IDENTIFIER LDPM_N_21 FORMAT "%4.0" /end AXIS_PTS
/begin AXIS_PTS ldpm_vs_sp_cru_1 "" 0xffe51ef6 vs_sp_cru _REC_AXS_20_u2 511.99218 _CNV_A_R_LINEAR_____85_CM 5 0. 511.99218 DISPLAY_IDENTIFIER LDPM_VS_SP_CRU_1 FORMAT "%7.3" /end AXIS_PTS
/begin AXIS_PTS ldpm_ac_cru__fac_tq_cru "" 0xffe51716 ac_cru _REC_AXS_20_u2 31.43952 _CNV_A_R_LINEAR_____154_CM 6 -15.72 15.71952 DISPLAY_IDENTIFIER LDPM_AC_CRU__FAC_TQ_CRU FORMAT "%8.4" /end AXIS_PTS
/begin AXIS_PTS ldpm_gear__fac_tq_cru "" 0xffe48374 gear _REC_AXS_20_u1 255. _CNV_A_R_LINEAR_____0_CM 12 0. 255. DISPLAY_IDENTIFIER LDPM_GEAR__FAC_TQ_CRU FORMAT "%3.0" /end AXIS_PTS
/begin AXIS_PTS ldp_n_32__fac_tq_cru "" 0xffe41092 n_32 _REC_AXS_20_u1 816. _CNV_A_R_LINEAR_____15_CM 5 0. 8160. DISPLAY_IDENTIFIER LDP_N_32__FAC_TQ_CRU FORMAT "%4.0" /end AXIS_PTS
/begin AXIS_PTS ldpm_fac_tq_cru_1 "" 0xffe41d2a fac_tq_cru _REC_AXS_20_u2 99.99847412 _CNV_A_R_LINEAR_____8_CM 3 0. 99.99847412 DISPLAY_IDENTIFIER LDPM_FAC_TQ_CRU_1 /end AXIS_PTS
/begin AXIS_PTS ldp_n_32__fac_tq_req_clu_is "" 0xffe41098 n_32 _REC_AXS_20_u1 8160. _CNV_A_R_LINEAR_____15_CM 3 0. 8160. DISPLAY_IDENTIFIER LDP_N_32__FAC_TQ_REQ_CLU_IS FORMAT "%4.0" /end AXIS_PTS
/begin AXIS_PTS ldp_vls_cyl_sel_ip_lamb_2 "" 0xffe51680 online_dummy _REC_AXS_20_u2 4.99511719 _CNV_A_R_LINEAR_____3_CM 16 0. 4.99511719 DISPLAY_IDENTIFIER LDP_VLS_CYL_SEL_IP_LAMB_2 FORMAT "%5.3" /end AXIS_PTS
/begin AXIS_PTS ldp_vls_cyl_sel_ip_lamb_1 "" 0xffe5165e online_dummy _REC_AXS_20_u2 4.99511719 _CNV_A_R_LINEAR_____3_CM 16 0. 4.99511719 DISPLAY_IDENTIFIER LDP_VLS_CYL_SEL_IP_LAMB_1 FORMAT "%5.3" /end AXIS_PTS
/begin AXIS_PTS ldpm_fac_t_1_laco "" 0xffe5183a online_dummy _REC_AXS_20_u2 63.99902344 _CNV_A_R_LINEAR_____118_CM 16 0. 63.99902344 DISPLAY_IDENTIFIER LDPM_FAC_T_1_LACO FORMAT "%7.4" /end AXIS_PTS
/begin AXIS_PTS ldp_n_ip_crk_syn "" 0xffe51070 n _REC_AXS_20_u2 8160. _CNV_A_R_LINEAR_____10_CM 8 0. 8160. DISPLAY_IDENTIFIER LDP_N_IP_CRK_SYN FORMAT "%4.0" /end AXIS_PTS
/begin AXIS_PTS ldp_maf_ip_crk_syn "" 0xffe50db2 maf _REC_AXS_20_u2 1389. _CNV_A_R_LINEAR_____108_CM 8 0. 1389. DISPLAY_IDENTIFIER LDP_MAF_IP_CRK_SYN FORMAT "%7.2" /end AXIS_PTS
/begin AXIS_PTS ldp_t1_lamb_ip_fac_err_lam_sel "" 0xffe51280 online_dummy _REC_AXS_20_u2 1.99996948 _CNV_A_R_LINEAR_____163_CM 6 0. 1.99996948 DISPLAY_IDENTIFIER LDP_T1_LAMB_IP_FAC_ERR_LAM_SEL FORMAT "%6.4" /end AXIS_PTS
/begin AXIS_PTS ldp_n_ip_crlc_cyl_lam "" 0xffe51082 n _REC_AXS_20_u2 8160. _CNV_A_R_LINEAR_____10_CM 8 0. 8160. DISPLAY_IDENTIFIER LDP_N_IP_CRLC_CYL_LAM FORMAT "%4.0" /end AXIS_PTS
/begin AXIS_PTS ldp_maf_ip_crlc_cyl_lam "" 0xffe50dc4 maf_kgh _REC_AXS_20_u2 1389. _CNV_A_R_LINEAR_____108_CM 8 0. 1389. DISPLAY_IDENTIFIER LDP_MAF_IP_CRLC_CYL_LAM FORMAT "%7.2" /end AXIS_PTS
/begin AXIS_PTS ldp_n_32_ip_maf_delta_crk_max "" 0xffe410f8 n_32 _REC_AXS_20_u1 8160. _CNV_A_R_LINEAR_____15_CM 6 0. 8160. DISPLAY_IDENTIFIER LDP_N_32_IP_MAF_DELTA_CRK_MAX FORMAT "%4.0" /end AXIS_PTS
/begin AXIS_PTS ldp_n_32_ip_maf_delta_crk_min "" 0xffe410ff n_32 _REC_AXS_20_u1 8160. _CNV_A_R_LINEAR_____15_CM 6 0. 8160. DISPLAY_IDENTIFIER LDP_N_32_IP_MAF_DELTA_CRK_MIN FORMAT "%4.0" /end AXIS_PTS
/begin AXIS_PTS ldp_maf_kgh__crlc_vls_down "" 0xffe50e00 maf_kgh _REC_AXS_20_u2 2047.96875 _CNV_A_R_LINEAR_____115_CM 4 0. 2047.96875 DISPLAY_IDENTIFIER LDP_MAF_KGH__CRLC_VLS_DOWN FORMAT "%7.2" /end AXIS_PTS
/begin AXIS_PTS ldp_ftl__t_cur_dmtl_stat "" 0xffe47f29 ftl _REC_AXS_20_u1 126. _CNV_A_R_LINEAR_____96_CM 8 0. 126. DISPLAY_IDENTIFIER LDP_FTL__T_CUR_DMTL_STAT FORMAT "%3.0" /end AXIS_PTS
/begin AXIS_PTS ldp_ftl__t_small_leak_test "" 0xffe41037 ftl _REC_AXS_20_u1 126. _CNV_A_R_LINEAR_____96_CM 5 0. 126. DISPLAY_IDENTIFIER LDP_FTL__T_SMALL_LEAK_TEST FORMAT "%3.0" /end AXIS_PTS
/begin AXIS_PTS ldp_vb_dmtl_fil__fac_cur_dmtl "" 0xffe51630 vb_dmtl_fil _REC_AXS_20_u2 26. _CNV_A_R_LINEAR_____173_CM 6 0. 26. DISPLAY_IDENTIFIER LDP_VB_DMTL_FIL__FAC_CUR_DMTL FORMAT "%7.4" /end AXIS_PTS
/begin AXIS_PTS ldpm_cur_dmtldifrefroughleak_1 "" 0xffe517c2 cur_dmtl_dif_ref_rough_leak _REC_AXS_20_u2 400. _CNV_A_R_LINEAR_____168_CM 8 0. 400. DISPLAY_IDENTIFIER LDPM_CUR_DMTLDIFREFROUGHLEAK_1 FORMAT "%7.3" /end AXIS_PTS
/begin AXIS_PTS ldp_ftl__t_rough_leak_test "" 0xffe41031 ftl _REC_AXS_20_u1 126. _CNV_A_R_LINEAR_____96_CM 5 0. 126. DISPLAY_IDENTIFIER LDP_FTL__T_ROUGH_LEAK_TEST FORMAT "%3.0" /end AXIS_PTS
/begin AXIS_PTS ldp_n_ecf__n_ecf_min_accin "" 0xffe4812d n_ecf _REC_AXS_20_u1 15. _CNV_A_R_LINEAR_____0_CM 16 0. 15. DISPLAY_IDENTIFIER LDP_N_ECF__N_ECF_MIN_ACCIN FORMAT "%2.0" /end AXIS_PTS
/begin AXIS_PTS ldp_tco__temp_sub_ecf_ini "" 0xffe411f3 tco _REC_AXS_20_u1 190.5 _CNV_A_R_LINEAR_____11_CM 6 -48. 142.5 DISPLAY_IDENTIFIER LDP_TCO__TEMP_SUB_ECF_INI FORMAT "%5.1" /end AXIS_PTS
/begin AXIS_PTS ldp_n_ecf_cor_fil__n_perc_ecf "" 0xffe4112e n_ecf_cor_fil _REC_AXS_20_u1 15.9375 _CNV_A_R_LINEAR_____46_CM 6 0. 15.9375 DISPLAY_IDENTIFIER LDP_N_ECF_COR_FIL__N_PERC_ECF FORMAT "%5.2" /end AXIS_PTS
/begin AXIS_PTS ldp_tco_ex__n_ecf "" 0xffe4120c tco_ex _REC_AXS_20_u1 190.5 _CNV_A_R_LINEAR_____11_CM 6 -48. 142.5 DISPLAY_IDENTIFIER LDP_TCO_EX__N_ECF FORMAT "%5.1" /end AXIS_PTS
/begin AXIS_PTS ldp_tam__temp_sub_ecf_ini "" 0xffe411a4 tam _REC_AXS_20_u1 190.5 _CNV_A_R_LINEAR_____11_CM 6 -48. 142.5 DISPLAY_IDENTIFIER LDP_TAM__TEMP_SUB_ECF_INI FORMAT "%5.1" /end AXIS_PTS
/begin AXIS_PTS ldpm_temp_mmv_sub_cat_ecf_1 "" 0xffe4146c temp_mmv_sub_cat_ecf _REC_AXS_20_u1 1020. _CNV_A_R_LINEAR_____178_CM 6 -33. 987. DISPLAY_IDENTIFIER LDPM_TEMP_MMV_SUB_CAT_ECF_1 FORMAT "%3.0" /end AXIS_PTS
/begin AXIS_PTS ldp_vs__n_ecf_vs_cor "" 0xffe41300 vs _REC_AXS_20_u1 255. _CNV_A_R_LINEAR_____23_CM 5 0. 255. DISPLAY_IDENTIFIER LDP_VS__N_ECF_VS_COR FORMAT "%3.0" /end AXIS_PTS
/begin AXIS_PTS ldp_temp_gb__n_ecf_temp_gb "" 0xffe4125c temp_gb _REC_AXS_20_u1 255. _CNV_A_R_LINEAR_____14_CM 6 -40. 215. DISPLAY_IDENTIFIER LDP_TEMP_GB__N_ECF_TEMP_GB FORMAT "%3.0" /end AXIS_PTS
/begin AXIS_PTS ldp_tco__t_tooth_max "" 0xffe411ec tco _REC_AXS_20_u1 190.5 _CNV_A_R_LINEAR_____11_CM 6 -48. 142.5 DISPLAY_IDENTIFIER LDP_TCO__T_TOOTH_MAX FORMAT "%5.1" /end AXIS_PTS
/begin AXIS_PTS ldp_vb__t_tooth_max "" 0xffe412e6 tco _REC_AXS_20_u1 26. _CNV_A_R_LINEAR_____60_CM 6 0. 26. DISPLAY_IDENTIFIER LDP_VB__T_TOOTH_MAX FORMAT "%4.1" /end AXIS_PTS
/begin AXIS_PTS ldp_n_32_vff_efp "" 0xffe480fd n_32 _REC_AXS_20_u1 8160. _CNV_A_R_LINEAR_____15_CM 8 0. 8160. DISPLAY_IDENTIFIER LDP_N_32_VFF_EFP FORMAT "%4.0" /end AXIS_PTS
/begin AXIS_PTS ldp_tco_t_efp_ast_max "" 0xffe4123d tco _REC_AXS_20_u1 190.5 _CNV_A_R_LINEAR_____11_CM 6 -48. 142.5 DISPLAY_IDENTIFIER LDP_TCO_T_EFP_AST_MAX FORMAT "%5.1" /end AXIS_PTS
/begin AXIS_PTS ldp_ftl_vff_vepu_ftl "" 0xffe41044 ftl _REC_AXS_20_u1 127. _CNV_A_R_LINEAR_____96_CM 6 0. 127. DISPLAY_IDENTIFIER LDP_FTL_VFF_VEPU_FTL FORMAT "%3.0" /end AXIS_PTS
/begin AXIS_PTS ldp_ftl_dif_vff_vepu_ftl_dif "" 0xffe4103d ftl_dif _REC_AXS_20_u1 127. _CNV_A_R_LINEAR_____96_CM 6 0. 127. DISPLAY_IDENTIFIER LDP_FTL_DIF_VFF_VEPU_FTL_DIF FORMAT "%3.0" /end AXIS_PTS
/begin MEASUREMENT cycnr_puc "" UWORD _CNV_A_R_LINEAR_____0_CM 1 100. 0. 65535. DISPLAY_IDENTIFIER CYCNR_PUC ECU_ADDRESS 0x3fd880 BYTE_ORDER MSB_LAST FORMAT "%5.0" /end MEASUREMENT
/begin MEASUREMENT n_hys_puc "" UBYTE _CNV_A_R_LINEAR_____15_CM 1 100. 0. 8160. DISPLAY_IDENTIFIER N_HYS_PUC ECU_ADDRESS 0x3fe7a5 FORMAT "%4.0" /end MEASUREMENT
/begin MEASUREMENT n_min_puc "" UBYTE _CNV_A_R_LINEAR_____15_CM 1 100. 0. 8160. DISPLAY_IDENTIFIER N_MIN_PUC ECU_ADDRESS 0x3fe7a4 FORMAT "%4.0" /end MEASUREMENT
/begin AXIS_PTS ldpm_tco_1_6 "" 0xffe41426 tco _REC_AXS_20_u1 28.575 _CNV_A_R_LINEAR_____11_CM 6 -48. 142.5 DISPLAY_IDENTIFIER LDPM_TCO_1_6 FORMAT "%5.1" /end AXIS_PTS
/begin AXIS_PTS ldpm_gr_mt_3 "" 0xffe483d0 gr_mt _REC_AXS_20_u1 255. _CNV_A_R_LINEAR_____0_CM 13 0. 255. DISPLAY_IDENTIFIER LDPM_GR_MT_3 FORMAT "%3.0" /end AXIS_PTS
/begin AXIS_PTS ldpm_gr_at_3 "" 0xffe483ab gr_at _REC_AXS_20_u1 255. _CNV_A_R_LINEAR_____0_CM 13 0. 255. DISPLAY_IDENTIFIER LDPM_GR_AT_3 FORMAT "%3.0" /end AXIS_PTS
/begin AXIS_PTS ldp_tq_loss_ars_sp_can__puc "" 0xffe5148a tq_loss_ars_sp_can _REC_AXS_20_u2 2047.96875 _CNV_A_R_LINEAR_____187_CM 6 -1024. 1023.96875 DISPLAY_IDENTIFIER LDP_TQ_LOSS_ARS_SP_CAN__PUC FORMAT "%6.2" /end AXIS_PTS
/begin AXIS_PTS ldpm_tco_9 "" 0xffe4861a tco _REC_AXS_20_u1 28.575 _CNV_A_R_LINEAR_____11_CM 9 -48. 142.5 DISPLAY_IDENTIFIER LDPM_TCO_9 FORMAT "%5.1" /end AXIS_PTS
/begin AXIS_PTS ldp_n__t_min_pu "" 0xffe51012 n _REC_AXS_20_u2 8159. _CNV_A_R_LINEAR_____10_CM 8 1. 8160. DISPLAY_IDENTIFIER LDP_N__T_MIN_PU FORMAT "%4.0" /end AXIS_PTS
/begin AXIS_PTS ldp_tco__t_min_pu "" 0xffe411e5 tco _REC_AXS_20_u1 190.5 _CNV_A_R_LINEAR_____11_CM 6 -48. 142.5 DISPLAY_IDENTIFIER LDP_TCO__T_MIN_PU FORMAT "%5.1" /end AXIS_PTS
/begin AXIS_PTS ldp_n_grd_n_dif_max_is "" 0xffe41135 n_grd _REC_AXS_20_u1 8160. _CNV_A_R_LINEAR_____54_CM 6 -4096. 4064. DISPLAY_IDENTIFIER LDP_N_GRD_N_DIF_MAX_IS FORMAT "%5.0" /end AXIS_PTS
/begin AXIS_PTS ldp_amp_ip_load_clc_amp "" 0xffe509d0 amp _REC_AXS_20_u2 5434. _CNV_A_R_LINEAR_____49_CM 6 0. 5434. DISPLAY_IDENTIFIER LDP_AMP_IP_LOAD_CLC_AMP FORMAT "%7.2" /end AXIS_PTS
/begin AXIS_PTS ldp_n_32_ip_load_clc "" 0xffe480e2 n_32 _REC_AXS_20_u1 8160. _CNV_A_R_LINEAR_____15_CM 8 0. 8160. DISPLAY_IDENTIFIER LDP_N_32_IP_LOAD_CLC FORMAT "%4.0" /end AXIS_PTS
/begin AXIS_PTS ldp_maf_ip_load_clc "" 0xffe50dee maf _REC_AXS_20_u2 1389. _CNV_A_R_LINEAR_____108_CM 8 0. 1389. DISPLAY_IDENTIFIER LDP_MAF_IP_LOAD_CLC FORMAT "%7.2" /end AXIS_PTS
/begin AXIS_PTS ldp_n_vs_ratio_gr_mt "" 0xffe48162 n_vs_ratio _REC_AXS_20_u1 255. _CNV_A_R_LINEAR_____0_CM 13 0. 255. DISPLAY_IDENTIFIER LDP_N_VS_RATIO_GR_MT FORMAT "%3.0" /end AXIS_PTS
/begin AXIS_PTS ldp_iga_dif_eff_iga "" 0xffe47f8d iga_dif_min _REC_AXS_20_u1 -95.625 _CNV_A_R_LINEAR_____204_CM 16 0. -95.625 DISPLAY_IDENTIFIER LDP_IGA_DIF_EFF_IGA FORMAT "%5.1" /end AXIS_PTS
/begin AXIS_PTS ldpm_tco_1_igsp "" 0xffe485ff tco _REC_AXS_20_u1 190.5 _CNV_A_R_LINEAR_____11_CM 8 -48. 142.5 DISPLAY_IDENTIFIER LDPM_TCO_1_IGSP FORMAT "%5.1" /end AXIS_PTS
/begin AXIS_PTS ldp_lamb_sp__iga_bas_lamb "" 0xffe50c8e lamb_sp _REC_AXS_20_u2 31.99902344 _CNV_A_R_LINEAR_____206_CM 8 0. 31.99902344 DISPLAY_IDENTIFIER LDP_LAMB_SP__IGA_BAS_LAMB FORMAT "%7.4" /end AXIS_PTS
/begin AXIS_PTS ldpm_n_14 "" 0xffe51a5e n _REC_AXS_20_u2 8160. _CNV_A_R_LINEAR_____10_CM 20 0. 8160. DISPLAY_IDENTIFIER LDPM_N_14 FORMAT "%4.0" /end AXIS_PTS
/begin AXIS_PTS ldpm_maf_2 "" 0xffe518ea maf _REC_AXS_20_u2 69.45 _CNV_A_R_LINEAR_____108_CM 16 0. 1389. DISPLAY_IDENTIFIER LDPM_MAF_2 FORMAT "%7.2" /end AXIS_PTS
/begin AXIS_PTS ldp_tco__fac_iga_ch_tco "" 0xffe481b9 tco _REC_AXS_20_u1 190.5 _CNV_A_R_LINEAR_____11_CM 8 -48. 142.5 DISPLAY_IDENTIFIER LDP_TCO__FAC_IGA_CH_TCO FORMAT "%6.2" /end AXIS_PTS
/begin AXIS_PTS ldpm_n_32_1_iga "" 0xffe48470 n_32 _REC_AXS_20_u1 8160. _CNV_A_R_LINEAR_____15_CM 8 0. 8160. DISPLAY_IDENTIFIER LDPM_N_32_1_IGA FORMAT "%4.0" /end AXIS_PTS
/begin AXIS_PTS ldpm_t_ast_1_iga "" 0xffe51ce0 t_ast _REC_AXS_20_u2 6553.5 _CNV_A_R_LINEAR_____24_CM 8 0. 6553.5 DISPLAY_IDENTIFIER LDPM_T_AST_1_IGA FORMAT "%6.1" /end AXIS_PTS
/begin AXIS_PTS ldpm_tco_st_1_iga "" 0xffe48692 tco_st _REC_AXS_20_u1 190.5 _CNV_A_R_LINEAR_____11_CM 8 -48. 142.5 DISPLAY_IDENTIFIER LDPM_TCO_ST_1_IGA FORMAT "%5.1" /end AXIS_PTS
/begin AXIS_PTS ldp_fac_tq_req_clu__crlc_tq_add "" 0xffe50bac fac_tq_req_clu _REC_AXS_20_u2 1.99996948 _CNV_A_R_LINEAR_____20_CM 4 0. 1.99996948 DISPLAY_IDENTIFIER LDP_FAC_TQ_REQ_CLU__CRLC_TQ_ADD FORMAT "%7.5" /end AXIS_PTS
/begin AXIS_PTS ldpm_n_32_2_iga "" 0xffe48498 n_32 _REC_AXS_20_u1 8160. _CNV_A_R_LINEAR_____15_CM 8 0. 8160. DISPLAY_IDENTIFIER LDPM_N_32_2_IGA FORMAT "%4.0" /end AXIS_PTS
/begin AXIS_PTS ldpm_maf_hb_1_iga "" 0xffe483f0 maf _REC_AXS_20_u1 1389. _CNV_A_R_LINEAR_____27_CM 8 0. 1389. DISPLAY_IDENTIFIER LDPM_MAF_HB_1_IGA FORMAT "%4.0" /end AXIS_PTS
/begin AXIS_PTS ldp_tco__iga_bas_temp_cor "" 0xffe411b8 tco _REC_AXS_20_u1 190.5 _CNV_A_R_LINEAR_____11_CM 6 -48. 142.5 DISPLAY_IDENTIFIER LDP_TCO__IGA_BAS_TEMP_COR FORMAT "%5.1" /end AXIS_PTS
/begin AXIS_PTS ldp_tia__iga_bas_temp_cor "" 0xffe4126d tia _REC_AXS_20_u1 28.575 _CNV_A_R_LINEAR_____11_CM 6 -48. 142.5 DISPLAY_IDENTIFIER LDP_TIA__IGA_BAS_TEMP_COR FORMAT "%5.1" /end AXIS_PTS
/begin AXIS_PTS ldpm_n_32_fac_iga_pos_neg "" 0xffe4851d n_32 _REC_AXS_20_u1 8160. _CNV_A_R_LINEAR_____15_CM 8 0. 8160. DISPLAY_IDENTIFIER LDPM_N_32_FAC_IGA_POS_NEG FORMAT "%4.0" /end AXIS_PTS
/begin AXIS_PTS ldp_maf_fac_iga_pos_neg "" 0xffe41065 maf _REC_AXS_20_u1 1389. _CNV_A_R_LINEAR_____27_CM 6 0. 1389. DISPLAY_IDENTIFIER LDP_MAF_FAC_IGA_POS_NEG FORMAT "%4.0" /end AXIS_PTS
/begin AXIS_PTS ldpm_cyc_cast_ip_iga_dif_min "" 0xffe517d4 cyc_cast _REC_AXS_20_u2 65535. _CNV_A_R_LINEAR_____0_CM 8 0. 65535. DISPLAY_IDENTIFIER LDPM_CYC_CAST_IP_IGA_DIF_MIN FORMAT "%5.0" /end AXIS_PTS
/begin AXIS_PTS ldpm_n_32_2_igsp "" 0xffe484a1 n_32 _REC_AXS_20_u1 8160. _CNV_A_R_LINEAR_____15_CM 8 0. 8160. DISPLAY_IDENTIFIER LDPM_N_32_2_IGSP FORMAT "%4.0" /end AXIS_PTS
/begin AXIS_PTS ldpm_maf_hb_2_igsp "" 0xffe4136b maf _REC_AXS_20_u1 1389. _CNV_A_R_LINEAR_____27_CM 6 0. 1389. DISPLAY_IDENTIFIER LDPM_MAF_HB_2_IGSP FORMAT "%4.0" /end AXIS_PTS
/begin AXIS_PTS ldp_amp_ip_iga_dif_min_cyc_amp "" 0xffe509b4 amp _REC_AXS_20_u2 5434. _CNV_A_R_LINEAR_____49_CM 6 0. 5434. DISPLAY_IDENTIFIER LDP_AMP_IP_IGA_DIF_MIN_CYC_AMP FORMAT "%7.2" /end AXIS_PTS
/begin AXIS_PTS ldpm_n_dif_igsp "" 0xffe51b7a n_dif _REC_AXS_20_u2 65535. _CNV_A_R_LINEAR_____207_CM 8 -32768. 32767. DISPLAY_IDENTIFIER LDPM_N_DIF_IGSP FORMAT "%6.0" /end AXIS_PTS
/begin AXIS_PTS ldpm_vb__td "" 0xffe51e82 vb _REC_AXS_20_u2 28.7055 _CNV_A_R_LINEAR_____208_CM 8 0. 28.7055 DISPLAY_IDENTIFIER LDPM_VB__TD FORMAT "%5.2" /end AXIS_PTS
/begin AXIS_PTS ldp_lamb_sp_iga_ref_lamb "" 0xffe50ca0 lamb_sp _REC_AXS_20_u2 31.99902344 _CNV_A_R_LINEAR_____206_CM 8 0. 31.99902344 DISPLAY_IDENTIFIER LDP_LAMB_SP_IGA_REF_LAMB FORMAT "%7.4" /end AXIS_PTS
/begin AXIS_PTS ldp_n_iga_ref_temp "" 0xffe48147 n_32 _REC_AXS_20_u1 8160. _CNV_A_R_LINEAR_____15_CM 8 0. 8160. DISPLAY_IDENTIFIER LDP_N_IGA_REF_TEMP FORMAT "%4.0" /end AXIS_PTS
/begin AXIS_PTS ldp_maf_iga_ref_temp "" 0xffe41071 maf _REC_AXS_20_u1 1389. _CNV_A_R_LINEAR_____27_CM 6 0. 1389. DISPLAY_IDENTIFIER LDP_MAF_IGA_REF_TEMP FORMAT "%4.0" /end AXIS_PTS
/begin AXIS_PTS ldp_tia__iga_ref_temp_fac "" 0xffe41274 tia _REC_AXS_20_u1 190.5 _CNV_A_R_LINEAR_____11_CM 6 -48. 142.5 DISPLAY_IDENTIFIER LDP_TIA__IGA_REF_TEMP_FAC FORMAT "%5.1" /end AXIS_PTS
/begin AXIS_PTS ldp_n__iga_ref_vvt "" 0xffe48106 n_32 _REC_AXS_20_u1 8160. _CNV_A_R_LINEAR_____15_CM 16 0. 8160. DISPLAY_IDENTIFIER LDP_N__IGA_REF_VVT FORMAT "%4.0" /end AXIS_PTS
/begin AXIS_PTS ldp_tco__iga_ref_temp_fac "" 0xffe411bf tco _REC_AXS_20_u1 190.5 _CNV_A_R_LINEAR_____11_CM 6 -48. 142.5 DISPLAY_IDENTIFIER LDP_TCO__IGA_REF_TEMP_FAC FORMAT "%5.1" /end AXIS_PTS
/begin AXIS_PTS ldp_maf__iga_ref_vvt "" 0xffe47fa7 maf _REC_AXS_20_u1 1389. _CNV_A_R_LINEAR_____27_CM 12 0. 1389. DISPLAY_IDENTIFIER LDP_MAF__IGA_REF_VVT FORMAT "%4.0" /end AXIS_PTS
/begin AXIS_PTS ldp_egr_ratio_cor__iga_ref_egr "" 0xffe50b62 egr_ratio_cor _REC_AXS_20_u2 99.99847412 _CNV_A_R_LINEAR_____8_CM 6 0. 99.99847412 DISPLAY_IDENTIFIER LDP_EGR_RATIO_COR__IGA_REF_EGR /end AXIS_PTS
/begin AXIS_PTS ldp_maf__iga_ref_port "" 0xffe50cb2 maf _REC_AXS_20_u2 1389. _CNV_A_R_LINEAR_____108_CM 8 0. 1389. DISPLAY_IDENTIFIER LDP_MAF__IGA_REF_PORT FORMAT "%7.2" /end AXIS_PTS
/begin AXIS_PTS ldp_n_32__iga_bas_port "" 0xffe48027 n_32 _REC_AXS_20_u1 8160. _CNV_A_R_LINEAR_____15_CM 8 0. 8160. DISPLAY_IDENTIFIER LDP_N_32__IGA_BAS_PORT FORMAT "%4.0" /end AXIS_PTS
/begin AXIS_PTS ldp_port_av__fac_iga_bas_port "" 0xffe51190 port_av _REC_AXS_20_u2 99.99847412 _CNV_A_R_LINEAR_____210_CM 8 0. 99.99847412 DISPLAY_IDENTIFIER LDP_PORT_AV__FAC_IGA_BAS_PORT /end AXIS_PTS
/begin AXIS_PTS ldp_eff_iga_sp_iga_dif_sp "" 0xffe50b02 eff_iga_sp _REC_AXS_20_u2 1.99996948 _CNV_A_R_LINEAR_____20_CM 16 0. 1.99996948 DISPLAY_IDENTIFIER LDP_EFF_IGA_SP_IGA_DIF_SP FORMAT "%7.5" /end AXIS_PTS
/begin AXIS_PTS ldp_cyc_st_ip_iga_st_cyc_st_cor "" 0xffe41015 NO_INPUT_QUANTITY _REC_AXS_20_u1 255. _CNV_A_R_LINEAR_____0_CM 6 0. 255. DISPLAY_IDENTIFIER LDP_CYC_ST_IP_IGA_ST_CYC_ST_COR FORMAT "%3.0" /end AXIS_PTS
/begin AXIS_PTS ldp_n_ip_iga_st_bas "" 0xffe510a6 n _REC_AXS_20_u2 8160. _CNV_A_R_LINEAR_____10_CM 6 0. 8160. DISPLAY_IDENTIFIER LDP_N_IP_IGA_ST_BAS FORMAT "%4.0" /end AXIS_PTS
/begin AXIS_PTS ldp_amp_ip_iga_st_amp_cor "" 0xffe509c2 amp _REC_AXS_20_u2 5434. _CNV_A_R_LINEAR_____49_CM 6 0. 5434. DISPLAY_IDENTIFIER LDP_AMP_IP_IGA_ST_AMP_COR FORMAT "%7.2" /end AXIS_PTS
/begin AXIS_PTS ldp_teg_dyn_hys "" 0xffe512fc teg_dyn_hys _REC_AXS_20_u2 2047. _CNV_A_R_LINEAR_____6_CM 16 0. 2047. DISPLAY_IDENTIFIER LDP_TEG_DYN_HYS FORMAT "%7.2" /end AXIS_PTS
/begin AXIS_PTS ldp_n__v_dur_igc_min "" 0xffe48124 n_32 _REC_AXS_20_u1 816. _CNV_A_R_LINEAR_____15_CM 8 0. 8160. DISPLAY_IDENTIFIER LDP_N__V_DUR_IGC_MIN FORMAT "%4.0" /end AXIS_PTS
/begin AXIS_PTS ldp_maf__v_dur_igc_min "" 0xffe4105e maf _REC_AXS_20_u1 138.9 _CNV_A_R_LINEAR_____27_CM 6 0. 1389. DISPLAY_IDENTIFIER LDP_MAF__V_DUR_IGC_MIN FORMAT "%4.0" /end AXIS_PTS
/begin AXIS_PTS ldp_n_dif_cor__tq_i_dt_is "" 0xffe5103c n_dif_cor _REC_AXS_20_u2 65535. _CNV_A_R_LINEAR_____207_CM 12 -32768. 32767. DISPLAY_IDENTIFIER LDP_N_DIF_COR__TQ_I_DT_IS FORMAT "%6.0" /end AXIS_PTS
/begin AXIS_PTS ldp_n_dif_cor_tq_i_is "" 0xffe51056 n_dif_cor _REC_AXS_20_u2 65535. _CNV_A_R_LINEAR_____207_CM 12 -32768. 32767. DISPLAY_IDENTIFIER LDP_N_DIF_COR_TQ_I_IS FORMAT "%6.0" /end AXIS_PTS
/begin AXIS_PTS ldp_n_grd_tq_i_is "" 0xffe4813e n_grd _REC_AXS_20_u1 8160. _CNV_A_R_LINEAR_____54_CM 8 -4096. 4064. DISPLAY_IDENTIFIER LDP_N_GRD_TQ_I_IS FORMAT "%5.0" /end AXIS_PTS
/begin AXIS_PTS ldpm_tco_is_1 "" 0xffe48677 tco _REC_AXS_20_u1 190.5 _CNV_A_R_LINEAR_____11_CM 8 -48. 142.5 DISPLAY_IDENTIFIER LDPM_TCO_IS_1 FORMAT "%5.1" /end AXIS_PTS
/begin AXIS_PTS ldpm_gr_mt_2 "" 0xffe483c7 gr_mt _REC_AXS_20_u1 255. _CNV_A_R_LINEAR_____0_CM 8 0. 255. DISPLAY_IDENTIFIER LDPM_GR_MT_2 FORMAT "%3.0" /end AXIS_PTS
/begin AXIS_PTS ldpm_n_dif_cor_p_d_dt_is "" 0xffe51b3c n_dif_cor _REC_AXS_20_u2 65535. _CNV_A_R_LINEAR_____207_CM 12 -32768. 32767. DISPLAY_IDENTIFIER LDPM_N_DIF_COR_P_D_DT_IS FORMAT "%6.0" /end AXIS_PTS
/begin AXIS_PTS ldpm_n_grd_p_d_dt_is "" 0xffe48587 n_grd _REC_AXS_20_u1 8160. _CNV_A_R_LINEAR_____54_CM 8 -4096. 4064. DISPLAY_IDENTIFIER LDPM_N_GRD_P_D_DT_IS FORMAT "%5.0" /end AXIS_PTS
/begin AXIS_PTS ldpm_n_dif_cor_p_d_is "" 0xffe51b56 n_dif_cor _REC_AXS_20_u2 65535. _CNV_A_R_LINEAR_____207_CM 12 -32768. 32767. DISPLAY_IDENTIFIER LDPM_N_DIF_COR_P_D_IS FORMAT "%6.0" /end AXIS_PTS
/begin AXIS_PTS ldpm_n_grd_p_d_is "" 0xffe48590 n_grd _REC_AXS_20_u1 8160. _CNV_A_R_LINEAR_____54_CM 8 -4096. 4064. DISPLAY_IDENTIFIER LDPM_N_GRD_P_D_IS FORMAT "%5.0" /end AXIS_PTS
/begin AXIS_PTS ldpm_t_ast__fac_n_grd_is "" 0xffe51d04 t_ast _REC_AXS_20_u2 6553.5 _CNV_A_R_LINEAR_____24_CM 8 0. 6553.5 DISPLAY_IDENTIFIER LDPM_T_AST__FAC_N_GRD_IS FORMAT "%5.1" /end AXIS_PTS
/begin AXIS_PTS ldpm_tco__fac_n_grd_is "" 0xffe4862d tco _REC_AXS_20_u1 190.5 _CNV_A_R_LINEAR_____11_CM 8 -48. 142.5 DISPLAY_IDENTIFIER LDPM_TCO__FAC_N_GRD_IS FORMAT "%6.2" /end AXIS_PTS
/begin AXIS_PTS ldpm_n_dif_cor_tq_i_is "" 0xffe51b70 n_dif_cor _REC_AXS_20_u2 65535. _CNV_A_R_LINEAR_____207_CM 4 -32768. 32767. DISPLAY_IDENTIFIER LDPM_N_DIF_COR_TQ_I_IS FORMAT "%6.0" /end AXIS_PTS
/begin AXIS_PTS ldpm_n_grd_tq_i_is "" 0xffe41402 n_grd _REC_AXS_20_u1 8160. _CNV_A_R_LINEAR_____216_CM 4 -4096. 4064. DISPLAY_IDENTIFIER LDPM_N_GRD_TQ_I_IS FORMAT "%5.0" /end AXIS_PTS
/begin AXIS_PTS ldp_maf_lgrd_tq_add_is_bol "" 0xffe50e9e maf _REC_AXS_20_u2 1389. _CNV_A_R_LINEAR_____108_CM 6 0. 1389. DISPLAY_IDENTIFIER LDP_MAF_LGRD_TQ_ADD_IS_BOL FORMAT "%7.2" /end AXIS_PTS
/begin AXIS_PTS ldp_n_sp_is_tq_add_is_bol_bas "" 0xffe51148 n_sp_is _REC_AXS_20_u2 8160. _CNV_A_R_LINEAR_____10_CM 6 0. 8160. DISPLAY_IDENTIFIER LDP_N_SP_IS_TQ_ADD_IS_BOL_BAS FORMAT "%4.0" /end AXIS_PTS
/begin AXIS_PTS ldp_n_lgrd_tq_add_is_bol "" 0xffe510c6 n _REC_AXS_20_u2 8160. _CNV_A_R_LINEAR_____10_CM 6 0. 8160. DISPLAY_IDENTIFIER LDP_N_LGRD_TQ_ADD_IS_BOL FORMAT "%4.0" /end AXIS_PTS
/begin AXIS_PTS ldpm_maf_fac_tq_add_is "" 0xffe51956 maf _REC_AXS_20_u2 1389. _CNV_A_R_LINEAR_____108_CM 6 0. 1389. DISPLAY_IDENTIFIER LDPM_MAF_FAC_TQ_ADD_IS FORMAT "%7.2" /end AXIS_PTS
/begin AXIS_PTS ldp_tco_tq_add_is_bol_bas "" 0xffe41249 tco _REC_AXS_20_u1 190.5 _CNV_A_R_LINEAR_____11_CM 6 -48. 142.5 DISPLAY_IDENTIFIER LDP_TCO_TQ_ADD_IS_BOL_BAS FORMAT "%5.1" /end AXIS_PTS
/begin AXIS_PTS ldp_tia_ip_fac_temp_tq_add_is "" 0xffe4128c tia _REC_AXS_20_u1 190.5 _CNV_A_R_LINEAR_____11_CM 6 -48. 142.5 DISPLAY_IDENTIFIER LDP_TIA_IP_FAC_TEMP_TQ_ADD_IS FORMAT "%5.1" /end AXIS_PTS
/begin AXIS_PTS ldp_toil_ip_fac_temp_tq_add_is "" 0xffe412c3 toil _REC_AXS_20_u1 200. _CNV_A_R_LINEAR_____14_CM 6 -40. 160. DISPLAY_IDENTIFIER LDP_TOIL_IP_FAC_TEMP_TQ_ADD_IS FORMAT "%3.0" /end AXIS_PTS
/begin AXIS_PTS ldp_nr_pat__pat_ind "" 0xffe4114a online_dummy _REC_AXS_20_u1 255. _CNV_A_R_LINEAR_____0_CM 7 0. 255. DISPLAY_IDENTIFIER LDP_NR_PAT__PAT_IND FORMAT "%3.0" /end AXIS_PTS
/begin AXIS_PTS ldpm_tco_st_4 "" 0xffe486ad tco_st _REC_AXS_20_u1 190.5 _CNV_A_R_LINEAR_____11_CM 8 -48. 142.5 DISPLAY_IDENTIFIER LDPM_TCO_ST_4 FORMAT "%5.1" /end AXIS_PTS
/begin AXIS_PTS ldpm_n_11 "ldpm 6 points N for IGA" 0xffe51a2e n _REC_AXS_20_u2 8160. _CNV_A_R_LINEAR_____10_CM 16 0. 8160. DISPLAY_IDENTIFIER LDPM_N_11 FORMAT "%4.0" /end AXIS_PTS
/begin AXIS_PTS ldpm_maf_ivvt_1 "" 0xffe51990 maf_ivvt _REC_AXS_20_u2 1389. _CNV_A_R_LINEAR_____108_CM 6 0. 1389. DISPLAY_IDENTIFIER LDPM_MAF_IVVT_1 FORMAT "%7.2" /end AXIS_PTS
/begin AXIS_PTS ldpm_tco_17 "" 0xffe485f6 tco _REC_AXS_20_u1 190.5 _CNV_A_R_LINEAR_____11_CM 8 -48. 142.5 DISPLAY_IDENTIFIER LDPM_TCO_17 FORMAT "%5.1" /end AXIS_PTS
/begin AXIS_PTS ldpm_tco_st_1_ivvt "" 0xffe4869b tco_st _REC_AXS_20_u1 190.5 _CNV_A_R_LINEAR_____11_CM 8 -48. 142.5 DISPLAY_IDENTIFIER LDPM_TCO_ST_1_IVVT FORMAT "%5.1" /end AXIS_PTS
/begin AXIS_PTS ldpm_t_ast_1_ivvt "" 0xffe51cf2 t_ast _REC_AXS_20_u2 6553.5 _CNV_A_R_LINEAR_____24_CM 8 0. 6553.5 DISPLAY_IDENTIFIER LDPM_T_AST_1_IVVT FORMAT "%6.1" /end AXIS_PTS
/begin AXIS_PTS ldp_n_32__fac_cam_sp_ch_opp "" 0xffe50f96 n_32 _REC_AXS_20_u2 8160. _CNV_A_R_LINEAR_____10_CM 4 0. 8160. DISPLAY_IDENTIFIER LDP_N_32__FAC_CAM_SP_CH_OPP FORMAT "%4.0" /end AXIS_PTS
/begin AXIS_PTS ldp_dip__fac_cam_sp_ch_opp "" 0xffe50af8 online_dummy _REC_AXS_20_u2 5434. _CNV_A_R_LINEAR_____49_CM 4 0. 5434. DISPLAY_IDENTIFIER LDP_DIP__FAC_CAM_SP_CH_OPP FORMAT "%7.2" /end AXIS_PTS
/begin AXIS_PTS ldp_state_cmb_ctl_id_cmb_ivvt "" 0xffe48182 state_cmb_ctl _REC_AXS_20_u1 8. _CNV_A_R_LINEAR_____0_CM 9 0. 8. DISPLAY_IDENTIFIER LDP_STATE_CMB_CTL_ID_CMB_IVVT FORMAT "%2.0" /end AXIS_PTS
/begin AXIS_PTS ldpm_ctr_km_can_1 "" 0xffe517a4 ctr_km_can _REC_AXS_20_u2 655350. _CNV_A_R_LINEAR_____88_CM 4 0. 655350. DISPLAY_IDENTIFIER LDPM_CTR_KM_CAN_1 FORMAT "%7.0" /end AXIS_PTS
/begin AXIS_PTS ldpm_n_13 "" 0xffe51a50 n _REC_AXS_20_u2 8160. _CNV_A_R_LINEAR_____10_CM 6 0. 8160. DISPLAY_IDENTIFIER LDPM_N_13 FORMAT "%4.0" /end AXIS_PTS
/begin AXIS_PTS ldpm_n_5 "" 0xffe51ad8 n _REC_AXS_20_u2 8160. _CNV_A_R_LINEAR_____10_CM 16 0. 8160. DISPLAY_IDENTIFIER LDPM_N_5 FORMAT "%4.0" /end AXIS_PTS
/begin AXIS_PTS ldpm_maf_ivvt_2 "" 0xffe5199e maf _REC_AXS_20_u2 1389. _CNV_A_R_LINEAR_____108_CM 12 0. 1389. DISPLAY_IDENTIFIER LDPM_MAF_IVVT_2 FORMAT "%7.2" /end AXIS_PTS
/begin AXIS_PTS ldpm_toil_2_ivvt "" 0xffe4147a toil _REC_AXS_20_u1 200. _CNV_A_R_LINEAR_____14_CM 6 -40. 160. DISPLAY_IDENTIFIER LDPM_TOIL_2_IVVT FORMAT "%3.0" /end AXIS_PTS
/begin AXIS_PTS ldpm_cam_mdl_dif_ivvt "" 0xffe48347 ivvt_in_1.struct_ctl_ivvt.cam_mdl_dif_ivvt _REC_AXS_20_u1 60. _CNV_A_R_LINEAR_____82_CM 8 0. 60. DISPLAY_IDENTIFIER LDPM_CAM_MDL_DIF_IVVT /end AXIS_PTS
/begin AXIS_PTS ldpm_dly_ivvt_1_ivvt "" 0xffe41342 ivvt_in_1.struct_ctl_ivvt.dly_ivvt _REC_AXS_20_u1 2550. _CNV_A_R_LINEAR_____31_CM 6 0. 2550. DISPLAY_IDENTIFIER LDPM_DLY_IVVT_1_IVVT FORMAT "%4.0" /end AXIS_PTS
/begin AXIS_PTS ldpm_n_32_4_ivvt "" 0xffe413a8 n_32 _REC_AXS_20_u1 8160. _CNV_A_R_LINEAR_____15_CM 4 0. 8160. DISPLAY_IDENTIFIER LDPM_N_32_4_IVVT FORMAT "%4.0" /end AXIS_PTS
/begin AXIS_PTS ldpm_n_32_3_ivvt "" 0xffe413a1 n_32 _REC_AXS_20_u1 8160. _CNV_A_R_LINEAR_____15_CM 6 0. 8160. DISPLAY_IDENTIFIER LDPM_N_32_3_IVVT FORMAT "%4.0" /end AXIS_PTS
/begin AXIS_PTS ldpm_n_32_2_ivvt "" 0xffe484aa n_32 _REC_AXS_20_u1 8160. _CNV_A_R_LINEAR_____15_CM 8 0. 8160. DISPLAY_IDENTIFIER LDPM_N_32_2_IVVT FORMAT "%4.0" /end AXIS_PTS
/begin AXIS_PTS ldpm_n_32_1_ivvt "" 0xffe41390 n_32 _REC_AXS_20_u1 8160. _CNV_A_R_LINEAR_____15_CM 4 0. 8160. DISPLAY_IDENTIFIER LDPM_N_32_1_IVVT FORMAT "%4.0" /end AXIS_PTS
/begin AXIS_PTS ldpm_toil_1_ivvt "" 0xffe486d5 toil _REC_AXS_20_u1 200. _CNV_A_R_LINEAR_____14_CM 8 -40. 160. DISPLAY_IDENTIFIER LDPM_TOIL_1_IVVT FORMAT "%3.0" /end AXIS_PTS
/begin MEASUREMENT ivvt_in_1.struct_ctl_ivvt.t_add_min_ivvt_adh "Offset on energization time due to adhesion detection - inlet" UBYTE _CNV_A_R_LINEAR_____235_CM 1 100. 0. 159.375 DISPLAY_IDENTIFIER T_ADD_MIN_IVVT_ADH_IN_1 ECU_ADDRESS 0x3fc0ae FORMAT "%6.1" /end MEASUREMENT
/begin MEASUREMENT ivvt_in_1.struct_ctl_ivvt.lv_adh_cdn_ivvt "Logical variable: adhesion detection conditions inlet cam i fullfilled (=1) / not fullfilled (=0)" UBYTE _CNV_S_2_RANGE______2_CM 1 100. 0. 1. DISPLAY_IDENTIFIER LV_ADH_CDN_IVVT_IN_1 ECU_ADDRESS 0x3fc0b1 /end MEASUREMENT
/begin MEASUREMENT ivvt_in_1.struct_ctl_ivvt.t_sum_adh_ivvt "Energization time integral inlet cam i" UBYTE _CNV_A_R_LINEAR_____235_CM 1 100. 0. 159.375 DISPLAY_IDENTIFIER T_SUM_ADH_IVVT_IN_1 ECU_ADDRESS 0x3fc0b0 FORMAT "%6.1" /end MEASUREMENT
/begin MEASUREMENT ivvt_in_1.struct_ctl_ivvt.t_dly_adh_ivvt "Reaction time before adhesion detection inlet cam" UWORD _CNV_A_R_LINEAR_____235_CM 1 100. 0. 40959.375 DISPLAY_IDENTIFIER T_DLY_ADH_IVVT_IN_1 ECU_ADDRESS 0x3fc0a8 BYTE_ORDER MSB_LAST FORMAT "%7.1" /end MEASUREMENT
/begin MEASUREMENT ivvt_in_1.struct_ctl_ivvt.cam_adh_old "Inlet cam position at start of reaction time" UBYTE _CNV_A_R_LINEAR_____230_CM 1 100. 60. 155.625 DISPLAY_IDENTIFIER CAM_ADH_OLD_IN_1 ECU_ADDRESS 0x3fc0aa FORMAT "%8.3" /end MEASUREMENT
/begin MEASUREMENT ivvt_in_1.struct_ctl_ivvt.cam_adh_act "Inlet cam position closest to cam set point during reaction time" UBYTE _CNV_A_R_LINEAR_____230_CM 1 100. 60. 155.625 DISPLAY_IDENTIFIER CAM_ADH_ACT_IN_1 ECU_ADDRESS 0x3fc0ab FORMAT "%8.3" /end MEASUREMENT
/begin MEASUREMENT ivvt_in_1.struct_ctl_ivvt.cam_adj_dif_adh_ivvt "De-jittered movement  of inlet cam in target direction during reaction delay time" SWORD _CNV_A_R_LINEAR_____82_CM 1 100. -60. 60. DISPLAY_IDENTIFIER CAM_ADJ_DIF_ADH_IVVT_IN_1 ECU_ADDRESS 0x3fc0ac BYTE_ORDER MSB_LAST FORMAT "%7.3" /end MEASUREMENT
/begin MEASUREMENT ivvt_in_1.struct_ctl_ivvt.lv_err_ivvt_mec_ass "Logivcal variable for mechanical error assumed on inlet cam i" UBYTE _CNV_S_2_RANGE______2_CM 1 100. 0. 1. DISPLAY_IDENTIFIER LV_ERR_IVVT_MEC_ASS_IN_1 ECU_ADDRESS 0x3fc0b2 /end MEASUREMENT
/begin MEASUREMENT ivvt_in_1.struct_pwm_ivvt.t_drift_ivvthpwm "Time period for calculation of drift speed inlet cam" ULONG _CNV_A_R_LINEAR_____244_CM 1 100. 0. 17179869180. DISPLAY_IDENTIFIER T_DRIFT_IVVTHPWM_IN_1 ECU_ADDRESS 0x3fc0d0 BYTE_ORDER MSB_LAST FORMAT "%11.0" /end MEASUREMENT
/begin MEASUREMENT ivvt_in_1.struct_prj_ivvt.lv_ivvtpwm_ext_adj "activation bit for external adjustment inlet CAM" UBYTE _CNV_S_2_RANGE______2_CM 1 100. 0. 1. DISPLAY_IDENTIFIER LV_IVVTPWM_EXT_ADJ_IN_1 ECU_ADDRESS 0x3fc0ee /end MEASUREMENT
/begin MEASUREMENT ivvt_in_1.struct_prj_ivvt.ivvtpwm_ext_adj "Pulse width modulated signal for external adjustment of inlet CAM" UBYTE _CNV_A_R_LINEAR_____9_CM 1 100. 0. 99.609375 DISPLAY_IDENTIFIER IVVTPWM_EXT_ADJ_IN_1 ECU_ADDRESS 0x3fc0ed FORMAT "%4.1" /end MEASUREMENT
/begin MEASUREMENT ivvt_ex_1.struct_ctl_ivvt.t_add_min_ivvt_adh "Offset on energization time due to adhesion detection - exhaust" UBYTE _CNV_A_R_LINEAR_____235_CM 1 100. 0. 159.375 DISPLAY_IDENTIFIER T_ADD_MIN_IVVT_ADH_EX_1 ECU_ADDRESS 0x3fc1ca FORMAT "%6.1" /end MEASUREMENT
/begin MEASUREMENT ivvt_ex_1.struct_ctl_ivvt.lv_adh_cdn_ivvt "Logical variable: adhesion detection conditions exhaust cam i fullfilled (=1) / not fullfilled (=0)" UBYTE _CNV_S_2_RANGE______2_CM 1 100. 0. 1. DISPLAY_IDENTIFIER LV_ADH_CDN_IVVT_EX_1 ECU_ADDRESS 0x3fc1cd /end MEASUREMENT
/begin MEASUREMENT ivvt_ex_1.struct_ctl_ivvt.t_sum_adh_ivvt "Energization time integral exhaust cam i" UBYTE _CNV_A_R_LINEAR_____235_CM 1 100. 0. 159.375 DISPLAY_IDENTIFIER T_SUM_ADH_IVVT_EX_1 ECU_ADDRESS 0x3fc1cc FORMAT "%6.1" /end MEASUREMENT
/begin MEASUREMENT ivvt_ex_1.struct_ctl_ivvt.t_dly_adh_ivvt "Reaction time before adhesion detection exhaust cam" UWORD _CNV_A_R_LINEAR_____235_CM 1 100. 0. 40959.375 DISPLAY_IDENTIFIER T_DLY_ADH_IVVT_EX_1 ECU_ADDRESS 0x3fc1c4 BYTE_ORDER MSB_LAST FORMAT "%7.1" /end MEASUREMENT
/begin MEASUREMENT ivvt_ex_1.struct_ctl_ivvt.cam_adh_old "Exhaust cam position at start of reaction time" UBYTE _CNV_A_R_LINEAR_____227_CM 1 100. -40. -135.625 DISPLAY_IDENTIFIER CAM_ADH_OLD_EX_1 ECU_ADDRESS 0x3fc1c6 FORMAT "%8.3" /end MEASUREMENT
/begin MEASUREMENT ivvt_ex_1.struct_ctl_ivvt.cam_adh_act "Exhaust cam position closest to cam set point during reaction time" UBYTE _CNV_A_R_LINEAR_____227_CM 1 100. -40. -135.625 DISPLAY_IDENTIFIER CAM_ADH_ACT_EX_1 ECU_ADDRESS 0x3fc1c7 FORMAT "%8.3" /end MEASUREMENT
/begin MEASUREMENT ivvt_ex_1.struct_ctl_ivvt.cam_adj_dif_adh_ivvt "De-jittered movement  of exhaust cam in target direction during reaction delay time" SWORD _CNV_A_R_LINEAR_____82_CM 1 100. -60. 60. DISPLAY_IDENTIFIER CAM_ADJ_DIF_ADH_IVVT_EX_1 ECU_ADDRESS 0x3fc1c8 BYTE_ORDER MSB_LAST FORMAT "%7.3" /end MEASUREMENT
/begin MEASUREMENT ivvt_ex_1.struct_ctl_ivvt.lv_err_ivvt_mec_ass "Logivcal variable for mechanical error assumed on exhaust cam i" UBYTE _CNV_S_2_RANGE______2_CM 1 100. 0. 1. DISPLAY_IDENTIFIER LV_ERR_IVVT_MEC_ASS_EX_1 ECU_ADDRESS 0x3fc1ce /end MEASUREMENT
/begin MEASUREMENT ivvt_ex_1.struct_pwm_ivvt.t_drift_ivvthpwm "Time period for calculation of drift speed exhaust cam" ULONG _CNV_A_R_LINEAR_____244_CM 1 100. 0. 17179869180. DISPLAY_IDENTIFIER T_DRIFT_IVVTHPWM_EX_1 ECU_ADDRESS 0x3fc1ec BYTE_ORDER MSB_LAST FORMAT "%11.0" /end MEASUREMENT
/begin MEASUREMENT ivvt_ex_1.struct_prj_ivvt.lv_ivvtpwm_ext_adj "activation bit for external adjustment exhaust CAM" UBYTE _CNV_S_2_RANGE______2_CM 1 100. 0. 1. DISPLAY_IDENTIFIER LV_IVVTPWM_EXT_ADJ_EX_1 ECU_ADDRESS 0x3fc20a /end MEASUREMENT
/begin MEASUREMENT ivvt_ex_1.struct_prj_ivvt.ivvtpwm_ext_adj "Pulse width modulated signal for external adjustment of exhaust CAM" UBYTE _CNV_A_R_LINEAR_____9_CM 1 100. 0. 99.609375 DISPLAY_IDENTIFIER IVVTPWM_EXT_ADJ_EX_1 ECU_ADDRESS 0x3fc209 FORMAT "%4.1" /end MEASUREMENT
/begin AXIS_PTS ldpm_cam_edge_nr "" 0xffe4132c online_dummy _REC_AXS_20_u1 3. _CNV_A_R_LINEAR_____0_CM 4 0. 3. DISPLAY_IDENTIFIER LDPM_CAM_EDGE_NR FORMAT "%2.0" /end AXIS_PTS
/begin AXIS_PTS ldp_vb__fac_ivvtpwm "" 0xffe412e2 vb _REC_AXS_20_u1 26. _CNV_A_R_LINEAR_____60_CM 3 0. 26. DISPLAY_IDENTIFIER LDP_VB__FAC_IVVTPWM FORMAT "%4.1" /end AXIS_PTS
/begin AXIS_PTS ldp_vb_ip_ivvthpwm "" 0xffe412ed vb _REC_AXS_20_u1 26. _CNV_A_R_LINEAR_____60_CM 4 0. 26. DISPLAY_IDENTIFIER LDP_VB_IP_IVVTHPWM FORMAT "%4.1" /end AXIS_PTS
/begin AXIS_PTS ldpm_cam_dif_ivvt "" 0xffe5176c online_dummy _REC_AXS_20_u2 120. _CNV_A_R_LINEAR_____247_CM 5 -60. 60. DISPLAY_IDENTIFIER LDPM_CAM_DIF_IVVT FORMAT "%7.3" /end AXIS_PTS
/begin AXIS_PTS ldp_vel_drift_ip_ivvthpwm_cor "" 0xffe412f2 online_dummy _REC_AXS_20_u1 95.625 _CNV_A_R_LINEAR_____243_CM 6 0. 95.625 DISPLAY_IDENTIFIER LDP_VEL_DRIFT_IP_IVVTHPWM_COR FORMAT "%5.2" /end AXIS_PTS
/begin AXIS_PTS ldp_t_drift_ivvthpwm "" 0xffe512ce online_dummy _REC_AXS_20_u2 65535. _CNV_A_R_LINEAR_____142_CM 6 0. 65535. DISPLAY_IDENTIFIER LDP_T_DRIFT_IVVTHPWM FORMAT "%5.0" /end AXIS_PTS
/begin AXIS_PTS ldpm_tmag_ivvt_1_ivvt "" 0xffe486c8 tmag_ivvt _REC_AXS_20_u1 200. _CNV_A_R_LINEAR_____14_CM 12 -40. 160. DISPLAY_IDENTIFIER LDPM_TMAG_IVVT_1_IVVT FORMAT "%3.0" /end AXIS_PTS
/begin AXIS_PTS ldpm_mff_mmv "" 0xffe519fe mff_mmv _REC_AXS_20_u2 1389. _CNV_A_R_LINEAR_____108_CM 6 0. 1389. DISPLAY_IDENTIFIER LDPM_MFF_MMV FORMAT "%7.2" /end AXIS_PTS
/begin AXIS_PTS ldp_vo_fac_ivvt "" 0xffe48335 vo _REC_AXS_20_u1 95.625 _CNV_A_R_LINEAR_____82_CM 8 0. 95.625 DISPLAY_IDENTIFIER LDP_VO_FAC_IVVT FORMAT "%5.2" /end AXIS_PTS
/begin AXIS_PTS ldp_n_32__crlc_maf_ivvt "" 0xffe41084 n_32 _REC_AXS_20_u1 816. _CNV_A_R_LINEAR_____15_CM 6 0. 8160. DISPLAY_IDENTIFIER LDP_N_32__CRLC_MAF_IVVT FORMAT "%4.0" /end AXIS_PTS
/begin AXIS_PTS ldp_maf_sp__crlc_maf_ivvt "" 0xffe50eac maf_sp_tqi _REC_AXS_20_u2 1389. _CNV_A_R_LINEAR_____108_CM 6 0. 1389. DISPLAY_IDENTIFIER LDP_MAF_SP__CRLC_MAF_IVVT FORMAT "%7.2" /end AXIS_PTS
/begin AXIS_PTS ldpm_n_4_9 "" 0xffe413ed n_knk _REC_AXS_20_u1 8160. _CNV_A_R_LINEAR_____15_CM 3 0. 8160. DISPLAY_IDENTIFIER LDPM_N_4_9 FORMAT "%4.0" /end AXIS_PTS
/begin AXIS_PTS ldpm_n_6_4 "" 0xffe413f1 n_knk _REC_AXS_20_u1 8160. _CNV_A_R_LINEAR_____15_CM 4 0. 8160. DISPLAY_IDENTIFIER LDPM_N_6_4 FORMAT "%4.0" /end AXIS_PTS
/begin AXIS_PTS ldpm_n_iga_max_knk "" 0xffe485a2 n_32 _REC_AXS_20_u1 8160. _CNV_A_R_LINEAR_____15_CM 8 0. 8160. DISPLAY_IDENTIFIER LDPM_N_IGA_MAX_KNK FORMAT "%4.0" /end AXIS_PTS
/begin AXIS_PTS ldpm_maf_iga_max_knk "" 0xffe48426 maf _REC_AXS_20_u1 1389. _CNV_A_R_LINEAR_____27_CM 8 0. 1389. DISPLAY_IDENTIFIER LDPM_MAF_IGA_MAX_KNK FORMAT "%4.0" /end AXIS_PTS
/begin AXIS_PTS ldp_tco__fac_iga_max_knk "" 0xffe411ae tco _REC_AXS_20_u1 190.5 _CNV_A_R_LINEAR_____11_CM 4 -48. 142.5 DISPLAY_IDENTIFIER LDP_TCO__FAC_IGA_MAX_KNK FORMAT "%5.1" /end AXIS_PTS
/begin AXIS_PTS ldp_tia__fac_iga_max_knk "" 0xffe41263 tia _REC_AXS_20_u1 190.5 _CNV_A_R_LINEAR_____11_CM 4 -48. 142.5 DISPLAY_IDENTIFIER LDP_TIA__FAC_IGA_MAX_KNK FORMAT "%5.1" /end AXIS_PTS
/begin AXIS_PTS ldpm_n_2_9 "" 0xffe4844e n_knk _REC_AXS_20_u1 8160. _CNV_A_R_LINEAR_____15_CM 16 0. 8160. DISPLAY_IDENTIFIER LDPM_N_2_9 FORMAT "%4.0" /end AXIS_PTS
/begin AXIS_PTS ldpm_maf_1_9 "" 0xffe4135f maf_knk _REC_AXS_20_u1 69.45 _CNV_A_R_LINEAR_____27_CM 4 0. 1389. DISPLAY_IDENTIFIER LDPM_MAF_1_9 FORMAT "%4.0" /end AXIS_PTS
/begin AXIS_PTS ldp_n_32__maf_min_knk_ad_2 "" 0xffe48077 n_32 _REC_AXS_20_u1 8160. _CNV_A_R_LINEAR_____15_CM 16 0. 8160. DISPLAY_IDENTIFIER LDP_N_32__MAF_MIN_KNK_AD_2 FORMAT "%4.0" /end AXIS_PTS
/begin AXIS_PTS ldp_tia__ip_fac_ron_ad_max "" 0xffe4127b tia _REC_AXS_20_u1 190.5 _CNV_A_R_LINEAR_____11_CM 4 -48. 142.5 DISPLAY_IDENTIFIER LDP_TIA__IP_FAC_RON_AD_MAX FORMAT "%5.1" /end AXIS_PTS
/begin AXIS_PTS ldp_tco__ip_fac_ron_ad_max "" 0xffe411c6 tco _REC_AXS_20_u1 190.5 _CNV_A_R_LINEAR_____11_CM 4 -48. 142.5 DISPLAY_IDENTIFIER LDP_TCO__IP_FAC_RON_AD_MAX FORMAT "%5.1" /end AXIS_PTS
/begin AXIS_PTS ldpm_n_32_3_iga "" 0xffe4139c n_32 _REC_AXS_20_u1 8160. _CNV_A_R_LINEAR_____15_CM 4 0. 8160. DISPLAY_IDENTIFIER LDPM_N_32_3_IGA FORMAT "%4.0" /end AXIS_PTS
/begin AXIS_PTS ldp_maf_iga__iga_tra_knk "" 0xffe4106c maf _REC_AXS_20_u1 1389. _CNV_A_R_LINEAR_____27_CM 4 0. 1389. DISPLAY_IDENTIFIER LDP_MAF_IGA__IGA_TRA_KNK FORMAT "%4.0" /end AXIS_PTS
/begin AXIS_PTS ldpm_n_32_7 "" 0xffe413ad n_32 _REC_AXS_20_u1 8160. _CNV_A_R_LINEAR_____15_CM 4 0. 8160. DISPLAY_IDENTIFIER LDPM_N_32_7 FORMAT "%4.0" /end AXIS_PTS
/begin AXIS_PTS ldp_fac_ron_ad_fac_iga_tra "" 0xffe41028 fac_ron_ad _REC_AXS_20_u1 0.99610001 _CNV_A_R_LINEAR_____29_CM 3 0. 0.99610001 DISPLAY_IDENTIFIER LDP_FAC_RON_AD_FAC_IGA_TRA FORMAT "%5.3" /end AXIS_PTS
/begin AXIS_PTS ldp_tia_fac_iga_tra "" 0xffe41280 tia _REC_AXS_20_u1 190.5 _CNV_A_R_LINEAR_____11_CM 4 -48. 142.5 DISPLAY_IDENTIFIER LDP_TIA_FAC_IGA_TRA FORMAT "%5.1" /end AXIS_PTS
/begin AXIS_PTS ldpm_gear_1 "" 0xffe41350 gear _REC_AXS_20_u1 7. _CNV_A_R_LINEAR_____0_CM 6 0. 7. DISPLAY_IDENTIFIER LDPM_GEAR_1 FORMAT "%2.0" /end AXIS_PTS
/begin AXIS_PTS ldp_vs_fac_iga_tra_gear_mt "" 0xffe41314 vs _REC_AXS_20_u1 255. _CNV_A_R_LINEAR_____23_CM 6 0. 255. DISPLAY_IDENTIFIER LDP_VS_FAC_IGA_TRA_GEAR_MT FORMAT "%3.0" /end AXIS_PTS
/begin AXIS_PTS ldp_vs_fac_iga_tra_gear_at "" 0xffe4130d vs _REC_AXS_20_u1 255. _CNV_A_R_LINEAR_____23_CM 6 0. 255. DISPLAY_IDENTIFIER LDP_VS_FAC_IGA_TRA_GEAR_AT FORMAT "%3.0" /end AXIS_PTS
/begin AXIS_PTS ldp_maf_cyl_ip_crlc_lam_mv_lpf "" 0xffe50d46 maf_cyl _REC_AXS_20_u2 2047.96875 _CNV_A_R_LINEAR_____115_CM 6 0. 2047.96875 DISPLAY_IDENTIFIER LDP_MAF_CYL_IP_CRLC_LAM_MV_LPF FORMAT "%7.2" /end AXIS_PTS
/begin AXIS_PTS ldp_lam_mv_id_lam_cor_min_intr "" 0xffe50c46 lam_bank_1.lam_up.lam_mv _REC_AXS_20_u2 99.99847412 _CNV_A_R_LINEAR_____262_CM 8 -50. 49.99847412 DISPLAY_IDENTIFIER LDP_LAM_MV_ID_LAM_COR_MIN_INTR FORMAT "%7.3" /end AXIS_PTS
/begin AXIS_PTS ldp_lam_mv_id_lam_cor_max_intr "" 0xffe50c34 lam_bank_1.lam_up.lam_mv _REC_AXS_20_u2 99.99847412 _CNV_A_R_LINEAR_____262_CM 8 -50. 49.99847412 DISPLAY_IDENTIFIER LDP_LAM_MV_ID_LAM_COR_MAX_INTR FORMAT "%7.3" /end AXIS_PTS
/begin AXIS_PTS ldpm_n_1_laco "" 0xffe51a88 n _REC_AXS_20_u2 8160. _CNV_A_R_LINEAR_____10_CM 8 0. 8160. DISPLAY_IDENTIFIER LDPM_N_1_LACO FORMAT "%4.0" /end AXIS_PTS
/begin AXIS_PTS ldpm_t1_lamb_1_lamb_ctl "" 0xffe51cc4 online_dummy _REC_AXS_20_u2 1.99996948 _CNV_A_R_LINEAR_____163_CM 8 0. 1.99996948 DISPLAY_IDENTIFIER LDPM_T1_LAMB_1_LAMB_CTL FORMAT "%6.4" /end AXIS_PTS
/begin AXIS_PTS ldpm_t1_lamb_2_lamb_ctl "" 0xffe51cd6 online_dummy _REC_AXS_20_u2 1.99996948 _CNV_A_R_LINEAR_____163_CM 4 0. 1.99996948 DISPLAY_IDENTIFIER LDPM_T1_LAMB_2_LAMB_CTL FORMAT "%6.4" /end AXIS_PTS
/begin AXIS_PTS ldpm_dly_1_lamb_ctl "" 0xffe517e6 lam_bank_1.lam_up.dly _REC_AXS_20_u2 1.049983 _CNV_A_R_LINEAR_____264_CM 8 0. 1.049983 DISPLAY_IDENTIFIER LDPM_DLY_1_LAMB_CTL FORMAT "%6.4" /end AXIS_PTS
/begin AXIS_PTS ldpm_dly_2_lamb_ctl "" 0xffe517f8 lam_bank_1.lam_up.dly _REC_AXS_20_u2 1.049983 _CNV_A_R_LINEAR_____264_CM 4 0. 1.049983 DISPLAY_IDENTIFIER LDPM_DLY_2_LAMB_CTL FORMAT "%6.4" /end AXIS_PTS
/begin AXIS_PTS ldp_maf_int_puc_ip_lamb_sp "" 0xffe50da8 maf_int_puc _REC_AXS_20_u2 1820.4167 _CNV_A_R_LINEAR_____273_CM 4 0. 1820.4167 DISPLAY_IDENTIFIER LDP_MAF_INT_PUC_IP_LAMB_SP FORMAT "%9.4" /end AXIS_PTS
/begin AXIS_PTS ldpm_tco_st_2_lamb_ctl "" 0xffe41457 tco_st _REC_AXS_20_u1 190.5 _CNV_A_R_LINEAR_____11_CM 6 -48. 142.5 DISPLAY_IDENTIFIER LDPM_TCO_ST_2_LAMB_CTL FORMAT "%5.1" /end AXIS_PTS
/begin AXIS_PTS ldp_mff_ad_add_mmv_delta_add "" 0xffe50f1e online_dummy _REC_AXS_20_u2 1389.97 _CNV_A_R_LINEAR_____274_CM 8 -695. 694.97 DISPLAY_IDENTIFIER LDP_MFF_AD_ADD_MMV_DELTA_ADD FORMAT "%7.2" /end AXIS_PTS
/begin AXIS_PTS ldpm_tco_1_mff_ad "" 0xffe4142d tco _REC_AXS_20_u1 190.5 _CNV_A_R_LINEAR_____11_CM 5 -48. 142.5 DISPLAY_IDENTIFIER LDPM_TCO_1_MFF_AD FORMAT "%5.1" /end AXIS_PTS
/begin AXIS_PTS ldp_mff_ad_add_mmv_2_mff_add "" 0xffe50f12 online_dummy _REC_AXS_20_u2 1389.97 _CNV_A_R_LINEAR_____274_CM 5 -695. 694.97 DISPLAY_IDENTIFIER LDP_MFF_AD_ADD_MMV_2_MFF_ADD FORMAT "%7.2" /end AXIS_PTS
/begin AXIS_PTS ldp_mff_ad_fac_mmv_2_mff_fac "" 0xffe50f30 online_dummy _REC_AXS_20_u2 99.99847412 _CNV_A_R_LINEAR_____262_CM 5 -50. 49.99847412 DISPLAY_IDENTIFIER LDP_MFF_AD_FAC_MMV_2_MFF_FAC FORMAT "%7.3" /end AXIS_PTS
/begin AXIS_PTS ldpm_n_32_1_mff_ad "" 0xffe41395 n_32 _REC_AXS_20_u1 8160. _CNV_A_R_LINEAR_____15_CM 6 0. 8160. DISPLAY_IDENTIFIER LDPM_N_32_1_MFF_AD FORMAT "%4.0" /end AXIS_PTS
/begin AXIS_PTS ldp_mff_ad_fac_mmv_delta_h "" 0xffe50f3c online_dummy _REC_AXS_20_u2 99.99847412 _CNV_A_R_LINEAR_____262_CM 8 -50. 49.99847412 DISPLAY_IDENTIFIER LDP_MFF_AD_FAC_MMV_DELTA_H FORMAT "%7.3" /end AXIS_PTS
/begin AXIS_PTS ldp_mff_ad_fac_mmv_delta_l "" 0xffe50f4e online_dummy _REC_AXS_20_u2 99.99847412 _CNV_A_R_LINEAR_____262_CM 8 -50. 49.99847412 DISPLAY_IDENTIFIER LDP_MFF_AD_FAC_MMV_DELTA_L FORMAT "%7.3" /end AXIS_PTS
/begin AXIS_PTS ldp_n_32_maf_mff_ad_fac_l_max "" 0xffe4111b n_32 _REC_AXS_20_u1 816. _CNV_A_R_LINEAR_____15_CM 6 0. 8160. DISPLAY_IDENTIFIER LDP_N_32_MAF_MFF_AD_FAC_L_MAX FORMAT "%4.0" /end AXIS_PTS
/begin AXIS_PTS ldpm_n_32_maf_mff_ad_fac_l_min "" 0xffe413e6 n_32 _REC_AXS_20_u1 816. _CNV_A_R_LINEAR_____15_CM 6 0. 8160. DISPLAY_IDENTIFIER LDPM_N_32_MAF_MFF_AD_FAC_L_MIN FORMAT "%4.0" /end AXIS_PTS
/begin AXIS_PTS ldpm_n_32_maf_mff_ad_fac_h_min "" 0xffe413df n_32 _REC_AXS_20_u1 816. _CNV_A_R_LINEAR_____15_CM 6 0. 8160. DISPLAY_IDENTIFIER LDPM_N_32_MAF_MFF_AD_FAC_H_MIN FORMAT "%4.0" /end AXIS_PTS
/begin AXIS_PTS ldpm_maf_1_lasp "" 0xffe518d8 maf _REC_AXS_20_u2 1389. _CNV_A_R_LINEAR_____108_CM 8 0. 1389. DISPLAY_IDENTIFIER LDPM_MAF_1_LASP FORMAT "%7.2" /end AXIS_PTS
/begin AXIS_PTS ldpm_n_32_1_lasp "" 0xffe48479 n_32 _REC_AXS_20_u1 8160. _CNV_A_R_LINEAR_____15_CM 8 0. 8160. DISPLAY_IDENTIFIER LDPM_N_32_1_LASP FORMAT "%4.0" /end AXIS_PTS
/begin AXIS_PTS ldp_n_32_ip_lamb_afl_1 "" 0xffe480c7 n_32 _REC_AXS_20_u1 8160. _CNV_A_R_LINEAR_____15_CM 8 0. 8160. DISPLAY_IDENTIFIER LDP_N_32_IP_LAMB_AFL_1 FORMAT "%4.0" /end AXIS_PTS
/begin AXIS_PTS ldp_tqi_req_slow_ip_lamb_afl_1 "" 0xffe51500 tqi_req_slow _REC_AXS_20_u2 2047.96875 _CNV_A_R_LINEAR_____187_CM 8 -1024. 1023.96875 DISPLAY_IDENTIFIER LDP_TQI_REQ_SLOW_IP_LAMB_AFL_1 FORMAT "%6.2" /end AXIS_PTS
/begin AXIS_PTS ldp_tco_st_ip_lamb_bas_wup_cor "" 0xffe48281 tco_st _REC_AXS_20_u1 190.5 _CNV_A_R_LINEAR_____11_CM 8 -48. 142.5 DISPLAY_IDENTIFIER LDP_TCO_ST_IP_LAMB_BAS_WUP_COR FORMAT "%5.1" /end AXIS_PTS
/begin AXIS_PTS ldp_n_32_ip_lamb_hom_afl "" 0xffe480d0 n_32 _REC_AXS_20_u1 8160. _CNV_A_R_LINEAR_____15_CM 8 0. 8160. DISPLAY_IDENTIFIER LDP_N_32_IP_LAMB_HOM_AFL FORMAT "%4.0" /end AXIS_PTS
/begin AXIS_PTS ldp_tqi_req_slow_ip_lamb_hom_afl "" 0xffe51512 tqi_req_slow _REC_AXS_20_u2 2047.96875 _CNV_A_R_LINEAR_____187_CM 8 -1024. 1023.96875 DISPLAY_IDENTIFIER LDP_TQI_REQ_SLOW_IP_LAMB_HOM_AFL FORMAT "%6.2" /end AXIS_PTS
/begin AXIS_PTS ldp_tco_ip_lamb_bas_wup_cor "" 0xffe48225 tco _REC_AXS_20_u1 190.5 _CNV_A_R_LINEAR_____11_CM 8 -48. 142.5 DISPLAY_IDENTIFIER LDP_TCO_IP_LAMB_BAS_WUP_COR FORMAT "%5.1" /end AXIS_PTS
/begin AXIS_PTS ldp_n_32_ip_fac_lamb_wup "" 0xffe410ed n_32 _REC_AXS_20_u1 8160. _CNV_A_R_LINEAR_____15_CM 6 0. 8160. DISPLAY_IDENTIFIER LDP_N_32_IP_FAC_LAMB_WUP FORMAT "%4.0" /end AXIS_PTS
/begin AXIS_PTS ldp_n_32_ip_fac_lamb_wup_is "" 0xffe410f4 n_32 _REC_AXS_20_u1 8160. _CNV_A_R_LINEAR_____15_CM 3 0. 8160. DISPLAY_IDENTIFIER LDP_N_32_IP_FAC_LAMB_WUP_IS FORMAT "%4.0" /end AXIS_PTS
/begin AXIS_PTS ldp_maf_ip_fac_lamb_wup "" 0xffe50dd6 maf _REC_AXS_20_u2 1389. _CNV_A_R_LINEAR_____108_CM 6 0. 1389. DISPLAY_IDENTIFIER LDP_MAF_IP_FAC_LAMB_WUP FORMAT "%7.2" /end AXIS_PTS
/begin AXIS_PTS ldp_maf_ip_fac_lamb_wup_is "" 0xffe50de4 maf _REC_AXS_20_u2 1389. _CNV_A_R_LINEAR_____108_CM 4 0. 1389. DISPLAY_IDENTIFIER LDP_MAF_IP_FAC_LAMB_WUP_IS FORMAT "%7.2" /end AXIS_PTS
/begin AXIS_PTS ldp_tco__lamb_add_afl_ch "" 0xffe481cb tco _REC_AXS_20_u1 190.5 _CNV_A_R_LINEAR_____11_CM 8 -48. 142.5 DISPLAY_IDENTIFIER LDP_TCO__LAMB_ADD_AFL_CH FORMAT "%5.1" /end AXIS_PTS
/begin AXIS_PTS ldp_t_ast__lamb_add_afl_ch "" 0xffe5128e t_ast _REC_AXS_20_u2 983.025 _CNV_A_R_LINEAR_____24_CM 8 0. 6553.5 DISPLAY_IDENTIFIER LDP_T_AST__LAMB_ADD_AFL_CH FORMAT "%5.1" /end AXIS_PTS
/begin AXIS_PTS ldp_tqi_req_slow__lamb_ch_rgl "" 0xffe514ca tqi_req_slow _REC_AXS_20_u2 2047.96875 _CNV_A_R_LINEAR_____187_CM 8 -1024. 1023.96875 DISPLAY_IDENTIFIER LDP_TQI_REQ_SLOW__LAMB_CH_RGL FORMAT "%6.2" /end AXIS_PTS
/begin AXIS_PTS ldp_n_32__lamb_ch_rgl "" 0xffe48042 n_32 _REC_AXS_20_u1 8160. _CNV_A_R_LINEAR_____15_CM 8 0. 8160. DISPLAY_IDENTIFIER LDP_N_32__LAMB_CH_RGL FORMAT "%4.0" /end AXIS_PTS
/begin AXIS_PTS ldp_tqi_req_slow__lamb_ch_is "" 0xffe514b8 tqi_req_slow _REC_AXS_20_u2 2047.96875 _CNV_A_R_LINEAR_____187_CM 8 -1024. 1023.96875 DISPLAY_IDENTIFIER LDP_TQI_REQ_SLOW__LAMB_CH_IS FORMAT "%6.2" /end AXIS_PTS
/begin AXIS_PTS ldp_n_32__lamb_ch_is "" 0xffe48039 n_32 _REC_AXS_20_u1 8160. _CNV_A_R_LINEAR_____15_CM 8 0. 8160. DISPLAY_IDENTIFIER LDP_N_32__LAMB_CH_IS FORMAT "%4.0" /end AXIS_PTS
/begin AXIS_PTS ldp_t_cop_i__teg_cop "" 0xffe4119d online_dummy _REC_AXS_20_u1 127.5 _CNV_A_R_LINEAR_____279_CM 6 0. 127.5 DISPLAY_IDENTIFIER LDP_T_COP_I__TEG_COP FORMAT "%5.1" /end AXIS_PTS
/begin AXIS_PTS ldp_fac_cop_i__teg_cop "" 0xffe50b8a online_dummy _REC_AXS_20_u2 1.99996948 _CNV_A_R_LINEAR_____20_CM 16 0. 1.99996948 DISPLAY_IDENTIFIER LDP_FAC_COP_I__TEG_COP FORMAT "%7.5" /end AXIS_PTS
/begin AXIS_PTS ldpm_eff_iga_av_teg_i__teg_cop "" 0xffe51814 online_dummy _REC_AXS_20_u2 1.99996948 _CNV_A_R_LINEAR_____20_CM 4 0. 1.99996948 DISPLAY_IDENTIFIER LDPM_EFF_IGA_AV_TEG_I__TEG_COP FORMAT "%7.5" /end AXIS_PTS
/begin MEASUREMENT lam_bank_1.lam_sti.lamb_puls_o2l "" SBYTE _CNV_A_R_LINEAR_____290_CM 1 100. -0.125 0.124023 DISPLAY_IDENTIFIER LAMB_PULS_O2L_1 ECU_ADDRESS 0x3fc58b FORMAT "%7.4" /end MEASUREMENT
/begin MEASUREMENT lam_bank_1.lam_sti.fac_o2l_lamb_puls "" SWORD _CNV_A_R_LINEAR_____291_CM 1 100. -0.25 0.2499923 DISPLAY_IDENTIFIER FAC_O2L_LAMB_PULS_1 ECU_ADDRESS 0x3fc582 BYTE_ORDER MSB_LAST FORMAT "%8.6" /end MEASUREMENT
/begin MEASUREMENT lam_bank_1.lam_sti.maf_int_o2l "" SWORD _CNV_A_R_LINEAR_____292_CM 1 100. -182.0444 182.0389 DISPLAY_IDENTIFIER MAF_INT_O2L_1 ECU_ADDRESS 0x3fc584 BYTE_ORDER MSB_LAST FORMAT "%7.3" /end MEASUREMENT
/begin MEASUREMENT lam_bank_1.lam_sti.maf_int_o2l_sample_step "" SWORD _CNV_A_R_LINEAR_____293_CM 1 100. -0.3556 0.3555 DISPLAY_IDENTIFIER MAF_INT_O2L_SAMPLE_STEP_1 ECU_ADDRESS 0x3fc586 BYTE_ORDER MSB_LAST FORMAT "%7.5" /end MEASUREMENT
/begin MEASUREMENT lam_bank_1.lam_sti.lamb_puls_cor_afl "" SBYTE _CNV_A_R_LINEAR_____290_CM 1 100. -0.125 0.124023 DISPLAY_IDENTIFIER LAMB_PULS_COR_AFL_1 ECU_ADDRESS 0x3fc589 FORMAT "%7.4" /end MEASUREMENT
/begin MEASUREMENT lam_bank_1.lam_sti.lamb_puls_cor_afr "" SBYTE _CNV_A_R_LINEAR_____290_CM 1 100. -0.125 0.124023 DISPLAY_IDENTIFIER LAMB_PULS_COR_AFR_1 ECU_ADDRESS 0x3fc58c FORMAT "%7.4" /end MEASUREMENT
/begin MEASUREMENT lam_bank_1.lam_sti.lamb_puls_state "" UBYTE _CNV_S_3_RANGE_LAMB_294_CM 1 100. 0. 2. DISPLAY_IDENTIFIER LAMB_PULS_STATE_1 ECU_ADDRESS 0x3fc588 /end MEASUREMENT
/begin MEASUREMENT lam_bank_1.lam_sti.maf_int_o2l_it "" SLONG _CNV_A_R_LINEAR_____295_CM 1 100. -23301.68889 23301.68888 DISPLAY_IDENTIFIER MAF_INT_O2L_IT_1 ECU_ADDRESS 0x3fc57c BYTE_ORDER MSB_LAST FORMAT "%12.5" /end MEASUREMENT
/begin MEASUREMENT lam_bank_1.ls_down.bf.lv_vls_down_mmv_lmt "Boolean flag indicating VLS_DOWN_MMV_xxx_1 signals being limited when set" ULONG _CNV_S_2_RANGE______2_CM 1 100. 0. 1. DISPLAY_IDENTIFIER LV_VLS_DOWN_MMV_LMT_1 ECU_ADDRESS 0x3fc4a4 BYTE_ORDER MSB_LAST BIT_MASK 0x80000000 /end MEASUREMENT
/begin MEASUREMENT lam_bank_1.ls_down.vls_down "" UWORD _CNV_A_R_LINEAR_____3_CM 1 100. 0. 4.99511719 DISPLAY_IDENTIFIER VLS_DOWN_1 ECU_ADDRESS 0x3fc4a8 BYTE_ORDER MSB_LAST FORMAT "%5.3" /end MEASUREMENT
/begin MEASUREMENT lam_bank_1.ls_down.vls_down_bol "Variable switching threshold for calculation of VLS_DOWN_MMV_MIN_1" UWORD _CNV_A_R_LINEAR_____3_CM 1 100. 0. 4.99511719 DISPLAY_IDENTIFIER VLS_DOWN_BOL_1 ECU_ADDRESS 0x3fc4aa BYTE_ORDER MSB_LAST FORMAT "%5.3" /end MEASUREMENT
/begin MEASUREMENT lam_bank_1.ls_down.vls_down_tol "Variable switching threshold for calculation of VLS_DOWN_MMV_MAX_1" UWORD _CNV_A_R_LINEAR_____3_CM 1 100. 0. 4.99511719 DISPLAY_IDENTIFIER VLS_DOWN_TOL_1 ECU_ADDRESS 0x3fc4ac BYTE_ORDER MSB_LAST FORMAT "%5.3" /end MEASUREMENT
/begin MEASUREMENT lam_bank_1.ls_down.vls_down_mmv_max "Mean oxygen sensor rich voltage" UWORD _CNV_A_R_LINEAR_____252_CM 1 100. 0. 4.99992371 DISPLAY_IDENTIFIER VLS_DOWN_MMV_MAX_1 ECU_ADDRESS 0x3fc4ae BYTE_ORDER MSB_LAST FORMAT "%7.5" /end MEASUREMENT
/begin MEASUREMENT lam_bank_1.ls_down.vls_down_mmv_min "Mean oxygen sensor lean voltage" UWORD _CNV_A_R_LINEAR_____252_CM 1 100. 0. 4.99992371 DISPLAY_IDENTIFIER VLS_DOWN_MMV_MIN_1 ECU_ADDRESS 0x3fc4b0 BYTE_ORDER MSB_LAST FORMAT "%7.5" /end MEASUREMENT
/begin MEASUREMENT lam_bank_1.ls_down.vls_down_mmv_hys "Variable hysteresis used to determine switching thresholds" UWORD _CNV_A_R_LINEAR_____296_CM 1 100. 0. 1. DISPLAY_IDENTIFIER VLS_DOWN_MMV_HYS_1 ECU_ADDRESS 0x3fc4b2 BYTE_ORDER MSB_LAST FORMAT "%7.5" /end MEASUREMENT
/begin MEASUREMENT lam_bank_1.ls_down.drv1_vls_down_mmv "Mean of buffer containing 1st derivative of VLS_DOWN_1 signal" SWORD _CNV_A_R_LINEAR_____297_CM 1 100. -2.5 2.4999 DISPLAY_IDENTIFIER DRV1_VLS_DOWN_MMV_1 ECU_ADDRESS 0x3fc4b6 BYTE_ORDER MSB_LAST FORMAT "%7.4" /end MEASUREMENT
/begin MEASUREMENT lam_bank_1.ls_down.drv1_vls_down_abs_max "Absolute maximum value within buffer containing 1st derivative of VLS_DOWN_1 signal" UWORD _CNV_A_R_LINEAR_____298_CM 1 100. 0. 4.9999237 DISPLAY_IDENTIFIER DRV1_VLS_DOWN_ABS_MAX_1 ECU_ADDRESS 0x3fc4b4 BYTE_ORDER MSB_LAST FORMAT "%6.4" /end MEASUREMENT
/begin MEASUREMENT lam_bank_1.ls_down.drv1_vls_down_mmv_min "Minimum value of mean of buffer containing 1st derivative of VLS_DOWN_i signal in lean phase" SWORD _CNV_A_R_LINEAR_____297_CM 1 100. -2.5 2.4999 DISPLAY_IDENTIFIER DRV1_VLS_DOWN_MMV_MIN_1 ECU_ADDRESS 0x3fc4b8 BYTE_ORDER MSB_LAST FORMAT "%7.4" /end MEASUREMENT
/begin MEASUREMENT lam_bank_1.ls_up_diag.bf.lv_req_oc_lsl_if_osc_di "" UBYTE _CNV_S_2_RANGE______2_CM 1 100. 0. 1. DISPLAY_IDENTIFIER LV_REQ_OC_LSL_IF_OSC_DI_1 ECU_ADDRESS 0x3fc60c /end MEASUREMENT
/begin MEASUREMENT lam_bank_1.ls_up_diag.state_diag_oc_lsl "" UBYTE _CNV_S_3_RANGE_STAT_312_CM 1 100. 0. 2. DISPLAY_IDENTIFIER STATE_DIAG_OC_LSL_1 ECU_ADDRESS 0x3fc614 /end MEASUREMENT
/begin MEASUREMENT lam_bank_1.ls_up_diag.t_dly_diag_el_lsl "" UWORD _CNV_A_R_LINEAR_____4_CM 1 100. 0. 655.35 DISPLAY_IDENTIFIER T_DLY_DIAG_EL_LSL_1 ECU_ADDRESS 0x3fc610 BYTE_ORDER MSB_LAST FORMAT "%5.2" /end MEASUREMENT
/begin MEASUREMENT lam_bank_1.ls_up_diag.t_diag_oc_lsl "" UWORD _CNV_A_R_LINEAR_____24_CM 1 100. 0. 6553.5 DISPLAY_IDENTIFIER T_DIAG_OC_LSL_1 ECU_ADDRESS 0x3fc612 BYTE_ORDER MSB_LAST FORMAT "%5.1" /end MEASUREMENT
/begin MEASUREMENT lam_bank_1.ls_up_diag.t_end_diag_oc_lsl "" UWORD _CNV_A_R_LINEAR_____24_CM 1 100. 0. 6553.5 DISPLAY_IDENTIFIER T_END_DIAG_OC_LSL_1 ECU_ADDRESS 0x3fc60e BYTE_ORDER MSB_LAST FORMAT "%6.1" /end MEASUREMENT
/begin MEASUREMENT lam_bank_1.fsd_obd2.bf.lv_end_diag_win_fsd "End diagnosis cycle for similar conditions window" ULONG _CNV_S_2_RANGE______2_CM 1 100. 0. 1. DISPLAY_IDENTIFIER LV_END_DIAG_WIN_FSD_1 ECU_ADDRESS 0x3fc280 BYTE_ORDER MSB_LAST BIT_MASK 0x80000000 /end MEASUREMENT
/begin MEASUREMENT lam_bank_1.lsh_down_obd2.r_down_ls_thd_obd2_lsh_down "" UWORD _CNV_A_R_LINEAR_____309_CM 1 100. 0. 65535. DISPLAY_IDENTIFIER R_DOWN_LS_THD_OBD2_LSH_DOWN_1 ECU_ADDRESS 0x3fc400 BYTE_ORDER MSB_LAST FORMAT "%5.0" /end MEASUREMENT
/begin MEASUREMENT lam_bank_1.cat_eff_ldc_obd2.lv_lam_mv_ldc "" UBYTE _CNV_S_2_RANGE______2_CM 1 100. 0. 1. DISPLAY_IDENTIFIER LV_LAM_MV_LDC_1 ECU_ADDRESS 0x3fc248 /end MEASUREMENT
/begin MEASUREMENT lam_bank_1.cat_eff_obd2.ctr_cat_diag_lam_out "Counter of non valid cycle due to O2_CAT_MV_i is not in the right range" UBYTE _CNV_A_R_LINEAR_____0_CM 1 100. 0. 255. DISPLAY_IDENTIFIER CTR_CAT_DIAG_LAM_OUT ECU_ADDRESS 0x3fc26d FORMAT "%3.0" /end MEASUREMENT
/begin MEASUREMENT lam_bank_1.lam_sti_inci.t_vls_cyc_afr_wide_rng "" UWORD _CNV_A_R_LINEAR_____4_CM 1 100. 0. 655.35 DISPLAY_IDENTIFIER T_VLS_CYC_AFR_WIDE_RNG_1 ECU_ADDRESS 0x3fc5b8 BYTE_ORDER MSB_LAST FORMAT "%6.2" /end MEASUREMENT
/begin MEASUREMENT lam_bank_1.lam_sti_inci.t_vls_cyc_afl_hld_wide_rng "" UWORD _CNV_A_R_LINEAR_____4_CM 1 100. 0. 655.35 DISPLAY_IDENTIFIER T_VLS_CYC_AFL_HLD_WIDE_RNG_1 ECU_ADDRESS 0x3fc5ba BYTE_ORDER MSB_LAST FORMAT "%6.2" /end MEASUREMENT
/begin MEASUREMENT lam_bank_1.lam_sti_inci.lam_p_ctr "" UBYTE _CNV_A_R_LINEAR_____0_CM 1 100. 0. 255. DISPLAY_IDENTIFIER LAM_P_CTR_1 ECU_ADDRESS 0x3fc5bc FORMAT "%3.0" /end MEASUREMENT
/begin MEASUREMENT lam_bank_1.lam_sti_inci.bf.lv_vls_tra "" ULONG _CNV_S_2_RANGE______2_CM 1 100. 0. 1. DISPLAY_IDENTIFIER LV_VLS_TRA_1 ECU_ADDRESS 0x3fc5b4 BYTE_ORDER MSB_LAST BIT_MASK 0x80000000 /end MEASUREMENT
/begin MEASUREMENT lam_bank_1.lam_sti_afl.ctr_vls_afl_cyc "" UWORD _CNV_A_R_LINEAR_____0_CM 1 100. 0. 65535. DISPLAY_IDENTIFIER CTR_VLS_AFL_CYC_1 ECU_ADDRESS 0x3fc5b2 BYTE_ORDER MSB_LAST FORMAT "%5.0" /end MEASUREMENT
/begin MEASUREMENT lam_bank_1.lam_sti_afl.t_vls_cyc_afr "" UWORD _CNV_A_R_LINEAR_____4_CM 1 100. 0. 655.35 DISPLAY_IDENTIFIER T_VLS_CYC_AFR_1 ECU_ADDRESS 0x3fc5ac BYTE_ORDER MSB_LAST FORMAT "%6.2" /end MEASUREMENT
/begin MEASUREMENT lam_bank_1.lam_sti_afl.t_vls_cyc_afl "" UWORD _CNV_A_R_LINEAR_____4_CM 1 100. 0. 655.35 DISPLAY_IDENTIFIER T_VLS_CYC_AFL_1 ECU_ADDRESS 0x3fc5ae BYTE_ORDER MSB_LAST FORMAT "%6.2" /end MEASUREMENT
/begin MEASUREMENT lam_bank_1.lam_sti_afl.t_vls_cyc_afl_hld "" UWORD _CNV_A_R_LINEAR_____4_CM 1 100. 0. 655.35 DISPLAY_IDENTIFIER T_VLS_CYC_AFL_HLD_1 ECU_ADDRESS 0x3fc5b0 BYTE_ORDER MSB_LAST FORMAT "%6.2" /end MEASUREMENT
/begin MEASUREMENT lam_bank_1.lam_sti_afl.bf.lv_afl "" ULONG _CNV_S_2_RANGE______2_CM 1 100. 0. 1. DISPLAY_IDENTIFIER LV_AFL_1 ECU_ADDRESS 0x3fc5a8 BYTE_ORDER MSB_LAST BIT_MASK 0x80000000 /end MEASUREMENT
/begin MEASUREMENT lam_bank_1.ls_down_rdy.bf.lv_down_ls "Logical variable for operative readiness of downstream oxygen sensor(s)" ULONG _CNV_S_2_RANGE______2_CM 1 100. 0. 1. DISPLAY_IDENTIFIER LV_DOWN_LS_1 ECU_ADDRESS 0x3fc4d0 BYTE_ORDER MSB_LAST BIT_MASK 0x80000000 /end MEASUREMENT
/begin MEASUREMENT lam_bank_1.lam_diag_acq.lamb_diag "Mean lambda value for the diagnosis of sensor dynamic" UWORD _CNV_A_R_LINEAR_____206_CM 1 100. 0. 31.99902344 DISPLAY_IDENTIFIER LAMB_DIAG_1 ECU_ADDRESS 0x3fc6c4 BYTE_ORDER MSB_LAST FORMAT "%7.4" /end MEASUREMENT
/begin MEASUREMENT lam_bank_1.lam_diag_acq.vls_up_cyl_mmv "Mean value of the segment synchron WRAF sensor voltage" UWORD _CNV_A_R_LINEAR_____341_CM 1 100. 0. 4.995 DISPLAY_IDENTIFIER VLS_UP_CYL_MMV_1 ECU_ADDRESS 0x3fc6c6 BYTE_ORDER MSB_LAST FORMAT "%5.3" /end MEASUREMENT
/begin MEASUREMENT lam_bank_2.lam_sti.lamb_puls_o2l "" SBYTE _CNV_A_R_LINEAR_____290_CM 1 100. -0.125 0.124023 DISPLAY_IDENTIFIER LAMB_PULS_O2L_2 ECU_ADDRESS 0x3fca43 FORMAT "%7.4" /end MEASUREMENT
/begin MEASUREMENT lam_bank_2.lam_sti.fac_o2l_lamb_puls "" SWORD _CNV_A_R_LINEAR_____291_CM 1 100. -0.25 0.2499923 DISPLAY_IDENTIFIER FAC_O2L_LAMB_PULS_2 ECU_ADDRESS 0x3fca3a BYTE_ORDER MSB_LAST FORMAT "%8.6" /end MEASUREMENT
/begin MEASUREMENT lam_bank_2.lam_sti.maf_int_o2l "" SWORD _CNV_A_R_LINEAR_____292_CM 1 100. -182.0444 182.0389 DISPLAY_IDENTIFIER MAF_INT_O2L_2 ECU_ADDRESS 0x3fca3c BYTE_ORDER MSB_LAST FORMAT "%7.3" /end MEASUREMENT
/begin MEASUREMENT lam_bank_2.lam_sti.maf_int_o2l_sample_step "" SWORD _CNV_A_R_LINEAR_____293_CM 1 100. -0.3556 0.3555 DISPLAY_IDENTIFIER MAF_INT_O2L_SAMPLE_STEP_2 ECU_ADDRESS 0x3fca3e BYTE_ORDER MSB_LAST FORMAT "%7.5" /end MEASUREMENT
/begin MEASUREMENT lam_bank_2.lam_sti.lamb_puls_cor_afl "" SBYTE _CNV_A_R_LINEAR_____290_CM 1 100. -0.125 0.124023 DISPLAY_IDENTIFIER LAMB_PULS_COR_AFL_2 ECU_ADDRESS 0x3fca41 FORMAT "%7.4" /end MEASUREMENT
/begin MEASUREMENT lam_bank_2.lam_sti.lamb_puls_cor_afr "" SBYTE _CNV_A_R_LINEAR_____290_CM 1 100. -0.125 0.124023 DISPLAY_IDENTIFIER LAMB_PULS_COR_AFR_2 ECU_ADDRESS 0x3fca44 FORMAT "%7.4" /end MEASUREMENT
/begin MEASUREMENT lam_bank_2.lam_sti.lamb_puls_state "" UBYTE _CNV_S_3_RANGE_LAMB_294_CM 1 100. 0. 2. DISPLAY_IDENTIFIER LAMB_PULS_STATE_2 ECU_ADDRESS 0x3fca40 /end MEASUREMENT
/begin MEASUREMENT lam_bank_2.lam_sti.maf_int_o2l_it "" SLONG _CNV_A_R_LINEAR_____295_CM 1 100. -23301.68889 23301.68888 DISPLAY_IDENTIFIER MAF_INT_O2L_IT_2 ECU_ADDRESS 0x3fca34 BYTE_ORDER MSB_LAST FORMAT "%12.5" /end MEASUREMENT
/begin MEASUREMENT lam_bank_2.ls_down.bf.lv_vls_down_mmv_lmt "Boolean flag indicating VLS_DOWN_MMV_xxx_1 signals being limited when set" ULONG _CNV_S_2_RANGE______2_CM 1 100. 0. 1. DISPLAY_IDENTIFIER LV_VLS_DOWN_MMV_LMT_2 ECU_ADDRESS 0x3fc95c BYTE_ORDER MSB_LAST BIT_MASK 0x80000000 /end MEASUREMENT
/begin MEASUREMENT lam_bank_2.ls_down.vls_down "" UWORD _CNV_A_R_LINEAR_____3_CM 1 100. 0. 4.99511719 DISPLAY_IDENTIFIER VLS_DOWN_2 ECU_ADDRESS 0x3fc960 BYTE_ORDER MSB_LAST FORMAT "%5.3" /end MEASUREMENT
/begin MEASUREMENT lam_bank_2.ls_down.vls_down_bol "Variable switching threshold for calculation of VLS_DOWN_MMV_MIN_1" UWORD _CNV_A_R_LINEAR_____3_CM 1 100. 0. 4.99511719 DISPLAY_IDENTIFIER VLS_DOWN_BOL_2 ECU_ADDRESS 0x3fc962 BYTE_ORDER MSB_LAST FORMAT "%5.3" /end MEASUREMENT
/begin MEASUREMENT lam_bank_2.ls_down.vls_down_tol "Variable switching threshold for calculation of VLS_DOWN_MMV_MAX_1" UWORD _CNV_A_R_LINEAR_____3_CM 1 100. 0. 4.99511719 DISPLAY_IDENTIFIER VLS_DOWN_TOL_2 ECU_ADDRESS 0x3fc964 BYTE_ORDER MSB_LAST FORMAT "%5.3" /end MEASUREMENT
/begin MEASUREMENT lam_bank_2.ls_down.vls_down_mmv_max "Mean oxygen sensor rich voltage" UWORD _CNV_A_R_LINEAR_____252_CM 1 100. 0. 4.99992371 DISPLAY_IDENTIFIER VLS_DOWN_MMV_MAX_2 ECU_ADDRESS 0x3fc966 BYTE_ORDER MSB_LAST FORMAT "%7.5" /end MEASUREMENT
/begin MEASUREMENT lam_bank_2.ls_down.vls_down_mmv_min "Mean oxygen sensor lean voltage" UWORD _CNV_A_R_LINEAR_____252_CM 1 100. 0. 4.99992371 DISPLAY_IDENTIFIER VLS_DOWN_MMV_MIN_2 ECU_ADDRESS 0x3fc968 BYTE_ORDER MSB_LAST FORMAT "%7.5" /end MEASUREMENT
/begin MEASUREMENT lam_bank_2.ls_down.vls_down_mmv_hys "Variable hysteresis used to determine switching thresholds" UWORD _CNV_A_R_LINEAR_____296_CM 1 100. 0. 1. DISPLAY_IDENTIFIER VLS_DOWN_MMV_HYS_2 ECU_ADDRESS 0x3fc96a BYTE_ORDER MSB_LAST FORMAT "%7.5" /end MEASUREMENT
/begin MEASUREMENT lam_bank_2.ls_down.drv1_vls_down_mmv "Mean of buffer containing 1st derivative of VLS_DOWN_1 signal" SWORD _CNV_A_R_LINEAR_____297_CM 1 100. -2.5 2.4999 DISPLAY_IDENTIFIER DRV1_VLS_DOWN_MMV_2 ECU_ADDRESS 0x3fc96e BYTE_ORDER MSB_LAST FORMAT "%7.4" /end MEASUREMENT
/begin MEASUREMENT lam_bank_2.ls_down.drv1_vls_down_abs_max "Absolute maximum value within buffer containing 1st derivative of VLS_DOWN_1 signal" UWORD _CNV_A_R_LINEAR_____298_CM 1 100. 0. 4.9999237 DISPLAY_IDENTIFIER DRV1_VLS_DOWN_ABS_MAX_2 ECU_ADDRESS 0x3fc96c BYTE_ORDER MSB_LAST FORMAT "%6.4" /end MEASUREMENT
/begin MEASUREMENT lam_bank_2.ls_down.drv1_vls_down_mmv_min "Minimum value of mean of buffer containing 1st derivative of VLS_DOWN_i signal in lean phase" SWORD _CNV_A_R_LINEAR_____297_CM 1 100. -2.5 2.4999 DISPLAY_IDENTIFIER DRV1_VLS_DOWN_MMV_MIN_2 ECU_ADDRESS 0x3fc970 BYTE_ORDER MSB_LAST FORMAT "%7.4" /end MEASUREMENT
/begin MEASUREMENT lam_bank_2.ls_up_diag.bf.lv_req_oc_lsl_if_osc_di "" UBYTE _CNV_S_2_RANGE______2_CM 1 100. 0. 1. DISPLAY_IDENTIFIER LV_REQ_OC_LSL_IF_OSC_DI_2 ECU_ADDRESS 0x3fcac4 /end MEASUREMENT
/begin MEASUREMENT lam_bank_2.ls_up_diag.state_diag_oc_lsl "" UBYTE _CNV_S_3_RANGE_STAT_312_CM 1 100. 0. 2. DISPLAY_IDENTIFIER STATE_DIAG_OC_LSL_2 ECU_ADDRESS 0x3fcacc /end MEASUREMENT
/begin MEASUREMENT lam_bank_2.ls_up_diag.t_dly_diag_el_lsl "" UWORD _CNV_A_R_LINEAR_____4_CM 1 100. 0. 655.35 DISPLAY_IDENTIFIER T_DLY_DIAG_EL_LSL_2 ECU_ADDRESS 0x3fcac8 BYTE_ORDER MSB_LAST FORMAT "%5.2" /end MEASUREMENT
/begin MEASUREMENT lam_bank_2.ls_up_diag.t_diag_oc_lsl "" UWORD _CNV_A_R_LINEAR_____24_CM 1 100. 0. 6553.5 DISPLAY_IDENTIFIER T_DIAG_OC_LSL_2 ECU_ADDRESS 0x3fcaca BYTE_ORDER MSB_LAST FORMAT "%5.1" /end MEASUREMENT
/begin MEASUREMENT lam_bank_2.ls_up_diag.t_end_diag_oc_lsl "" UWORD _CNV_A_R_LINEAR_____24_CM 1 100. 0. 6553.5 DISPLAY_IDENTIFIER T_END_DIAG_OC_LSL_2 ECU_ADDRESS 0x3fcac6 BYTE_ORDER MSB_LAST FORMAT "%6.1" /end MEASUREMENT
/begin MEASUREMENT lam_bank_2.fsd_obd2.bf.lv_end_diag_win_fsd "End diagnosis cycle for similar conditions window" ULONG _CNV_S_2_RANGE______2_CM 1 100. 0. 1. DISPLAY_IDENTIFIER LV_END_DIAG_WIN_FSD_2 ECU_ADDRESS 0x3fc738 BYTE_ORDER MSB_LAST BIT_MASK 0x80000000 /end MEASUREMENT
/begin MEASUREMENT lam_bank_2.lsh_down_obd2.r_down_ls_thd_obd2_lsh_down "" UWORD _CNV_A_R_LINEAR_____309_CM 1 100. 0. 65535. DISPLAY_IDENTIFIER R_DOWN_LS_THD_OBD2_LSH_DOWN_2 ECU_ADDRESS 0x3fc8b8 BYTE_ORDER MSB_LAST FORMAT "%5.0" /end MEASUREMENT
/begin MEASUREMENT lam_bank_2.cat_eff_ldc_obd2.lv_lam_mv_ldc "" UBYTE _CNV_S_2_RANGE______2_CM 1 100. 0. 1. DISPLAY_IDENTIFIER LV_LAM_MV_LDC_2 ECU_ADDRESS 0x3fc700 /end MEASUREMENT
/begin MEASUREMENT lam_bank_2.cat_eff_obd2.ctr_cat_diag_lam_out "Counter of non valid cycle due to O2_CAT_MV_i is not in the right range" UBYTE _CNV_A_R_LINEAR_____0_CM 1 100. 0. 255. DISPLAY_IDENTIFIER CTR_CAT_DIAG_LAM_OUT ECU_ADDRESS 0x3fc725 FORMAT "%3.0" /end MEASUREMENT
/begin MEASUREMENT lam_bank_2.lam_sti_inci.t_vls_cyc_afr_wide_rng "" UWORD _CNV_A_R_LINEAR_____4_CM 1 100. 0. 655.35 DISPLAY_IDENTIFIER T_VLS_CYC_AFR_WIDE_RNG_2 ECU_ADDRESS 0x3fca70 BYTE_ORDER MSB_LAST FORMAT "%6.2" /end MEASUREMENT
/begin MEASUREMENT lam_bank_2.lam_sti_inci.t_vls_cyc_afl_hld_wide_rng "" UWORD _CNV_A_R_LINEAR_____4_CM 1 100. 0. 655.35 DISPLAY_IDENTIFIER T_VLS_CYC_AFL_HLD_WIDE_RNG_2 ECU_ADDRESS 0x3fca72 BYTE_ORDER MSB_LAST FORMAT "%6.2" /end MEASUREMENT
/begin MEASUREMENT lam_bank_2.lam_sti_inci.lam_p_ctr "" UBYTE _CNV_A_R_LINEAR_____0_CM 1 100. 0. 255. DISPLAY_IDENTIFIER LAM_P_CTR_2 ECU_ADDRESS 0x3fca74 FORMAT "%3.0" /end MEASUREMENT
/begin MEASUREMENT lam_bank_2.lam_sti_inci.bf.lv_vls_tra "" ULONG _CNV_S_2_RANGE______2_CM 1 100. 0. 1. DISPLAY_IDENTIFIER LV_VLS_TRA_2 ECU_ADDRESS 0x3fca6c BYTE_ORDER MSB_LAST BIT_MASK 0x80000000 /end MEASUREMENT
/begin MEASUREMENT lam_bank_2.lam_sti_afl.ctr_vls_afl_cyc "" UWORD _CNV_A_R_LINEAR_____0_CM 1 100. 0. 65535. DISPLAY_IDENTIFIER CTR_VLS_AFL_CYC_2 ECU_ADDRESS 0x3fca6a BYTE_ORDER MSB_LAST FORMAT "%5.0" /end MEASUREMENT
/begin MEASUREMENT lam_bank_2.lam_sti_afl.t_vls_cyc_afr "" UWORD _CNV_A_R_LINEAR_____4_CM 1 100. 0. 655.35 DISPLAY_IDENTIFIER T_VLS_CYC_AFR_2 ECU_ADDRESS 0x3fca64 BYTE_ORDER MSB_LAST FORMAT "%6.2" /end MEASUREMENT
/begin MEASUREMENT lam_bank_2.lam_sti_afl.t_vls_cyc_afl "" UWORD _CNV_A_R_LINEAR_____4_CM 1 100. 0. 655.35 DISPLAY_IDENTIFIER T_VLS_CYC_AFL_2 ECU_ADDRESS 0x3fca66 BYTE_ORDER MSB_LAST FORMAT "%6.2" /end MEASUREMENT
/begin MEASUREMENT lam_bank_2.lam_sti_afl.t_vls_cyc_afl_hld "" UWORD _CNV_A_R_LINEAR_____4_CM 1 100. 0. 655.35 DISPLAY_IDENTIFIER T_VLS_CYC_AFL_HLD_2 ECU_ADDRESS 0x3fca68 BYTE_ORDER MSB_LAST FORMAT "%6.2" /end MEASUREMENT
/begin MEASUREMENT lam_bank_2.lam_sti_afl.bf.lv_afl "" ULONG _CNV_S_2_RANGE______2_CM 1 100. 0. 1. DISPLAY_IDENTIFIER LV_AFL_2 ECU_ADDRESS 0x3fca60 BYTE_ORDER MSB_LAST BIT_MASK 0x80000000 /end MEASUREMENT
/begin MEASUREMENT lam_bank_2.ls_down_rdy.bf.lv_down_ls "Logical variable for operative readiness of downstream oxygen sensor(s)" ULONG _CNV_S_2_RANGE______2_CM 1 100. 0. 1. DISPLAY_IDENTIFIER LV_DOWN_LS_2 ECU_ADDRESS 0x3fc988 BYTE_ORDER MSB_LAST BIT_MASK 0x80000000 /end MEASUREMENT
/begin MEASUREMENT lam_bank_2.lam_diag_acq.lamb_diag "Mean lambda value for the diagnosis of sensor dynamic" UWORD _CNV_A_R_LINEAR_____206_CM 1 100. 0. 31.99902344 DISPLAY_IDENTIFIER LAMB_DIAG_2 ECU_ADDRESS 0x3fcb7c BYTE_ORDER MSB_LAST FORMAT "%7.4" /end MEASUREMENT
/begin MEASUREMENT lam_bank_2.lam_diag_acq.vls_up_cyl_mmv "Mean value of the segment synchron WRAF sensor voltage" UWORD _CNV_A_R_LINEAR_____341_CM 1 100. 0. 4.995 DISPLAY_IDENTIFIER VLS_UP_CYL_MMV_2 ECU_ADDRESS 0x3fcb7e BYTE_ORDER MSB_LAST FORMAT "%5.3" /end MEASUREMENT
/begin AXIS_PTS ldp_n__lamb_fl "" 0xffe48117 n_32 _REC_AXS_20_u1 8160. _CNV_A_R_LINEAR_____15_CM 12 0. 8160. DISPLAY_IDENTIFIER LDP_N__LAMB_FL FORMAT "%4.0" /end AXIS_PTS
/begin AXIS_PTS ldp_tco__lamb_ref_add "" 0xffe411d2 tco _REC_AXS_20_u1 190.5 _CNV_A_R_LINEAR_____11_CM 6 -48. 142.5 DISPLAY_IDENTIFIER LDP_TCO__LAMB_REF_ADD FORMAT "%5.1" /end AXIS_PTS
/begin AXIS_PTS ldp_n__lamb_ref "" 0xffe41127 n_32 _REC_AXS_20_u1 816. _CNV_A_R_LINEAR_____15_CM 6 0. 8160. DISPLAY_IDENTIFIER LDP_N__LAMB_REF FORMAT "%4.0" /end AXIS_PTS
/begin AXIS_PTS ldp_maf__lamb_ref "" 0xffe41052 maf _REC_AXS_20_u1 1389. _CNV_A_R_LINEAR_____27_CM 6 0. 1389. DISPLAY_IDENTIFIER LDP_MAF__LAMB_REF FORMAT "%4.0" /end AXIS_PTS
/begin AXIS_PTS ldp_lamb_dif__eff_lamb "" 0xffe50c58 online_dummy _REC_AXS_20_u2 63.99902344 _CNV_A_R_LINEAR_____277_CM 16 -32. 31.99902344 DISPLAY_IDENTIFIER LDP_LAMB_DIF__EFF_LAMB FORMAT "%8.4" /end AXIS_PTS
/begin AXIS_PTS ldp_ntl_ip_lamb_rgn_fac_mdl "" 0xffe51164 ntl _REC_AXS_20_u2 10485.6 _CNV_A_R_LINEAR_____350_CM 8 0. 10485.6 DISPLAY_IDENTIFIER LDP_NTL_IP_LAMB_RGN_FAC_MDL FORMAT "%7.1" /end AXIS_PTS
/begin AXIS_PTS ldp_vls_down_ip_lamb_rgn "" 0xffe516a2 online_dummy _REC_AXS_20_u2 4.99511719 _CNV_A_R_LINEAR_____3_CM 8 0. 4.99511719 DISPLAY_IDENTIFIER LDP_VLS_DOWN_IP_LAMB_RGN FORMAT "%5.3" /end AXIS_PTS
/begin AXIS_PTS ldp_n_32_ip_lamb_rgn_afr "" 0xffe480d9 n_32 _REC_AXS_20_u1 8160. _CNV_A_R_LINEAR_____15_CM 8 0. 8160. DISPLAY_IDENTIFIER LDP_N_32_IP_LAMB_RGN_AFR FORMAT "%4.0" /end AXIS_PTS
/begin AXIS_PTS ldp_maf_ip_lamb_rgn_afr "" 0xffe47fca maf _REC_AXS_20_u1 1389. _CNV_A_R_LINEAR_____27_CM 8 0. 1389. DISPLAY_IDENTIFIER LDP_MAF_IP_LAMB_RGN_AFR FORMAT "%4.0" /end AXIS_PTS
/begin AXIS_PTS ldp_tqi_req_slow__lamb_sawup "" 0xffe514dc tqi_req_slow _REC_AXS_20_u2 2047.96875 _CNV_A_R_LINEAR_____187_CM 8 -1024. 1023.96875 DISPLAY_IDENTIFIER LDP_TQI_REQ_SLOW__LAMB_SAWUP FORMAT "%6.2" /end AXIS_PTS
/begin AXIS_PTS ldp_tqi_req_slow__lamb_sawup_is "" 0xffe514ee tqi_req_slow _REC_AXS_20_u2 2047.96875 _CNV_A_R_LINEAR_____187_CM 8 -1024. 1023.96875 DISPLAY_IDENTIFIER LDP_TQI_REQ_SLOW__LAMB_SAWUP_IS FORMAT "%6.2" /end AXIS_PTS
/begin AXIS_PTS ldp_n_32__lamb_sawup "" 0xffe4805c n_32 _REC_AXS_20_u1 8160. _CNV_A_R_LINEAR_____15_CM 8 0. 8160. DISPLAY_IDENTIFIER LDP_N_32__LAMB_SAWUP FORMAT "%4.0" /end AXIS_PTS
/begin AXIS_PTS ldp_n_32__lamb_sawup_is "" 0xffe48065 n_32 _REC_AXS_20_u1 8160. _CNV_A_R_LINEAR_____15_CM 8 0. 8160. DISPLAY_IDENTIFIER LDP_N_32__LAMB_SAWUP_IS FORMAT "%4.0" /end AXIS_PTS
/begin AXIS_PTS ldp_t_ast__lamb_add_sawup "" 0xffe512a0 t_ast _REC_AXS_20_u2 6553.5 _CNV_A_R_LINEAR_____24_CM 8 0. 6553.5 DISPLAY_IDENTIFIER LDP_T_AST__LAMB_ADD_SAWUP FORMAT "%6.1" /end AXIS_PTS
/begin AXIS_PTS ldp_tco__lamb_add_sawup "" 0xffe481d4 tco _REC_AXS_20_u1 190.5 _CNV_A_R_LINEAR_____11_CM 8 -48. 142.5 DISPLAY_IDENTIFIER LDP_TCO__LAMB_ADD_SAWUP FORMAT "%5.1" /end AXIS_PTS
/begin AXIS_PTS ldp_eff_lamb_sp__lamb_dif_sp "" 0xffe50b24 eff_lamb_sp _REC_AXS_20_u2 0.199996948 _CNV_A_R_LINEAR_____20_CM 16 0. 1.99996948 DISPLAY_IDENTIFIER LDP_EFF_LAMB_SP__LAMB_DIF_SP FORMAT "%7.5" /end AXIS_PTS
/begin MEASUREMENT lv_err_mis_low_fuel "??????????????????????????????" UBYTE _CNV_S_2_RANGE______1_R_CM 1 100. 0. 255. DISPLAY_IDENTIFIER LV_ERR_MIS_LOW_FUEL ECU_ADDRESS 0x3fb9e0 /end MEASUREMENT
/begin MEASUREMENT seg_nr "" UBYTE _CNV_A_R_LINEAR_____0_CM 1 100. 0. 255. DISPLAY_IDENTIFIER SEG_NR ECU_ADDRESS 0x3fe5c1 FORMAT "%3.0" /end MEASUREMENT
/begin MEASUREMENT lv_fmy_exit_st "" UBYTE _CNV_S_2_RANGE______21_CM 1 100. 0. 1. DISPLAY_IDENTIFIER LV_FMY_EXIT_ST ECU_ADDRESS 0x3fe73c BIT_MASK 0x1 /end MEASUREMENT
/begin MEASUREMENT stk_av_egr "" UBYTE _CNV_A_R_LINEAR_____9_CM 1 100. 0. 99.609375 DISPLAY_IDENTIFIER STK_AV_EGR ECU_ADDRESS 0x3fe736 /end MEASUREMENT
/begin MEASUREMENT lv_err_delta_lamb_i_1 "" UBYTE _CNV_S_2_RANGE______1_R_CM 1 100. 0. 255. DISPLAY_IDENTIFIER LV_ERR_DELTA_LAMB_I_1 ECU_ADDRESS 0x3fbb78 /end MEASUREMENT
/begin MEASUREMENT lv_err_delta_lamb_i_2 "" UBYTE _CNV_S_2_RANGE______1_R_CM 1 100. 0. 255. DISPLAY_IDENTIFIER LV_ERR_DELTA_LAMB_I_2 ECU_ADDRESS 0x3fbb7c /end MEASUREMENT
/begin MEASUREMENT lv_inh_diag_ls_down_1 "" UBYTE _CNV_S_2_RANGE______2_CM 1 100. 0. 1. DISPLAY_IDENTIFIER LV_INH_DIAG_LS_DOWN_1 ECU_ADDRESS 0x3fea5b /end MEASUREMENT
/begin MEASUREMENT lv_inh_diag_ls_down_2 "" UBYTE _CNV_S_2_RANGE______2_CM 1 100. 0. 1. DISPLAY_IDENTIFIER LV_INH_DIAG_LS_DOWN_2 ECU_ADDRESS 0x3fea5c /end MEASUREMENT
/begin MEASUREMENT nox_sens_puc_1 "Byte variable for indication of PUC diagnosis state" UBYTE _CNV_A_R_LINEAR_____0_CM 1 100. 0. 15. DISPLAY_IDENTIFIER NOX_SENS_PUC_1 ECU_ADDRESS 0x3fea2d FORMAT "%2.0" /end MEASUREMENT
/begin MEASUREMENT nox_sens_puc_2 "Byte variable for indication of PUC diagnosis state" UBYTE _CNV_A_R_LINEAR_____0_CM 1 100. 0. 15. DISPLAY_IDENTIFIER NOX_SENS_PUC_2 ECU_ADDRESS 0x3fea2f FORMAT "%2.0" /end MEASUREMENT
/begin MEASUREMENT n_ratio_conv "" UBYTE _CNV_A_R_LINEAR_____403_CM 1 100. 0. 0.996094 DISPLAY_IDENTIFIER N_RATIO_CONV ECU_ADDRESS 0x3feb09 FORMAT "%4.3" /end MEASUREMENT
/begin MEASUREMENT tq_dif_tra "" SWORD _CNV_A_R_LINEAR_____55_CM 1 100. -1024. 1023.96875 DISPLAY_IDENTIFIER TQ_DIF_TRA ECU_ADDRESS 0x3fdf0e BYTE_ORDER MSB_LAST FORMAT "%6.2" /end MEASUREMENT
/begin MEASUREMENT B_dslfa "" UBYTE _CNV_A_R_LINEAR_____22_CM 1 100. 0. 255. DISPLAY_IDENTIFIER B_DSLFA ECU_ADDRESS 0x3fe42a BIT_MASK 0x1 /end MEASUREMENT
/begin MEASUREMENT B_fasls "" UBYTE _CNV_A_R_LINEAR_____22_CM 1 100. 0. 255. DISPLAY_IDENTIFIER B_FASLS ECU_ADDRESS 0x3fe42b BIT_MASK 0x1 /end MEASUREMENT
/begin MEASUREMENT imlpr "Relatives Luftmassenintegral bei Katheizung" UBYTE _CNV_R_R_fak_ub_b1_586_CM 1 100. 0. 0.99609375 DISPLAY_IDENTIFIER IMLPR ECU_ADDRESS 0x3fe429 FORMAT "%8.4" /end MEASUREMENT
/begin MEASUREMENT B_idlgspec "Bedingung LLR-Anforderung" UBYTE _CNV_A_R_LINEAR_____22_CM 1 100. 0. 255. DISPLAY_IDENTIFIER B_IDLGSPEC ECU_ADDRESS 0x3fa42b BIT_MASK 0x1 /end MEASUREMENT
/begin MEASUREMENT ozpermBits1_1s "???" UBYTE _CNV_A_R_LINEAR_____0_CM 1 100. 0. 255. DISPLAY_IDENTIFIER OZPERMBITS1_1S ECU_ADDRESS 0x3fad73 FORMAT "%3.0" /end MEASUREMENT
/begin MEASUREMENT ozpermBits1_1s.B_ozdperm "Bedingung Delta Er-Ermittlung aktiv" UBYTE _CNV_A_R_LINEAR_____0_CM 1 100. 0. 255. DISPLAY_IDENTIFIER B_OZDPERM ECU_ADDRESS 0x3fad73 FORMAT "%3.0" BIT_MASK 0x1 /end MEASUREMENT
/begin MEASUREMENT ozpermBits1_1s.B_ozer0ok "Bedingung Permittivität beim letztem Ölwechsel endgültig berechnet" UBYTE _CNV_A_R_LINEAR_____0_CM 1 100. 0. 255. DISPLAY_IDENTIFIER B_OZER0OK ECU_ADDRESS 0x3fad73 FORMAT "%3.0" BIT_MASK 0x2 /end MEASUREMENT
/begin MEASUREMENT ozpermBits1_1s.B_ozerplt "Bedingung Ausheizzeit erfüllt" UBYTE _CNV_A_R_LINEAR_____0_CM 1 100. 0. 255. DISPLAY_IDENTIFIER B_OZERPLT ECU_ADDRESS 0x3fad73 FORMAT "%3.0" BIT_MASK 0x4 /end MEASUREMENT
/begin MEASUREMENT ozpermBits1_1s.B_ozregstg "Bedingung Schieberegistersteuerung" UBYTE _CNV_A_R_LINEAR_____0_CM 1 100. 0. 255. DISPLAY_IDENTIFIER B_OZREGSTG ECU_ADDRESS 0x3fad73 FORMAT "%3.0" BIT_MASK 0x8 /end MEASUREMENT
/begin MEASUREMENT ozpermBits1_1s.B_ozeranz "Bedingung für Anzeige Restweg aus Er" UBYTE _CNV_A_R_LINEAR_____0_CM 1 100. 0. 255. DISPLAY_IDENTIFIER B_OZERANZ ECU_ADDRESS 0x3fad73 FORMAT "%3.0" BIT_MASK 0x10 /end MEASUREMENT
/begin MEASUREMENT ozpermBits3_1s "???" UBYTE _CNV_A_R_LINEAR_____0_CM 1 100. 0. 255. DISPLAY_IDENTIFIER OZPERMBITS3_1S ECU_ADDRESS 0x3fad74 FORMAT "%3.0" /end MEASUREMENT
/begin MEASUREMENT ozpermBits3_1s.B_ozper0ok "Bedingung gültiger Start-Permittivitätswert" UBYTE _CNV_A_R_LINEAR_____0_CM 1 100. 0. 255. DISPLAY_IDENTIFIER B_OZPER0OK ECU_ADDRESS 0x3fad74 FORMAT "%3.0" BIT_MASK 0x1 /end MEASUREMENT
/begin MEASUREMENT ozpermBits3_1s.B_calcdper "Bedingung für Berechnung Restweg aus Er" UBYTE _CNV_A_R_LINEAR_____0_CM 1 100. 0. 255. DISPLAY_IDENTIFIER B_CALCDPER ECU_ADDRESS 0x3fad74 FORMAT "%3.0" BIT_MASK 0x2 /end MEASUREMENT
/begin MEASUREMENT ozpermBits2_1s "???" UBYTE _CNV_A_R_LINEAR_____0_CM 1 100. 0. 255. DISPLAY_IDENTIFIER OZPERMBITS2_1S ECU_ADDRESS 0x3faad2 FORMAT "%3.0" /end MEASUREMENT
/begin MEASUREMENT ozpermBits2_1s.B_ozpermgl "Bedingung gültiger Start-Permittivitätswert" UBYTE _CNV_A_R_LINEAR_____0_CM 1 100. 0. 255. DISPLAY_IDENTIFIER B_OZPERMGL ECU_ADDRESS 0x3faad2 FORMAT "%3.0" BIT_MASK 0x1 /end MEASUREMENT
/begin MEASUREMENT ozpermBits2_1s.B_ozpermpl "Bedingung für Berechnung Restweg aus Er" UBYTE _CNV_A_R_LINEAR_____0_CM 1 100. 0. 255. DISPLAY_IDENTIFIER B_OZPERMPL ECU_ADDRESS 0x3faad2 FORMAT "%3.0" BIT_MASK 0x2 /end MEASUREMENT
/begin MEASUREMENT ozrestkmBits_1s "???" UBYTE _CNV_A_R_LINEAR_____0_CM 1 100. 0. 255. DISPLAY_IDENTIFIER OZRESTKMBITS_1S ECU_ADDRESS 0x3fad8a FORMAT "%3.0" /end MEASUREMENT
/begin MEASUREMENT ozrestkmBits_1s.B_ozcntini "Bedingung für Initialisierung Ölzeitzähler" UBYTE _CNV_A_R_LINEAR_____0_CM 1 100. 0. 255. DISPLAY_IDENTIFIER B_OZCNTINI ECU_ADDRESS 0x3fad8a FORMAT "%3.0" BIT_MASK 0x1 /end MEASUREMENT
/begin MEASUREMENT ozrestkmBits_1s.B_ozrwanz0 "Bedingung für Restweganzeige = NULL" UBYTE _CNV_A_R_LINEAR_____0_CM 1 100. 0. 255. DISPLAY_IDENTIFIER B_OZRWANZ0 ECU_ADDRESS 0x3fad8a FORMAT "%3.0" BIT_MASK 0x2 /end MEASUREMENT
/begin MEASUREMENT ugenslp "" UBYTE _CNV_R_R_spg_gencan_76_CM 1 100. 10.6 16.975 DISPLAY_IDENTIFIER UGENSLP ECU_ADDRESS 0x3fe3e4 FORMAT "%8.4" /end MEASUREMENT
/begin MEASUREMENT val_mo3_err_code_mc "error code of an error dtected by the MC" UBYTE _CNV_A_R_LINEAR_____0_CM 1 100. 0. 255. DISPLAY_IDENTIFIER VAL_MO3_ERR_CODE_MC ECU_ADDRESS 0x3fa0a2 FORMAT "%3.0" /end MEASUREMENT
/begin MEASUREMENT val_mo3_err_code_mu "error code of an error dtected by the MU" UBYTE _CNV_A_R_LINEAR_____0_CM 1 100. 0. 255. DISPLAY_IDENTIFIER VAL_MO3_ERR_CODE_MU ECU_ADDRESS 0x3fed42 FORMAT "%3.0" /end MEASUREMENT
/begin MEASUREMENT val_mo3_pwr_stag_dis_mc "" UBYTE _CNV_S_2_RANGE______21_CM 1 100. 0. 1. DISPLAY_IDENTIFIER VAL_MO3_PWR_STAG_DIS_MC ECU_ADDRESS 0x3fed3b BIT_MASK 0x1 /end MEASUREMENT
/begin MEASUREMENT val_mo3_pwr_stag_dis_mu "" UBYTE _CNV_S_2_RANGE______21_CM 1 100. 0. 1. DISPLAY_IDENTIFIER VAL_MO3_PWR_STAG_DIS_MU ECU_ADDRESS 0x3fed3c BIT_MASK 0x1 /end MEASUREMENT
/begin MEASUREMENT val_mo3_rst_ctr_mc "reset counter on MC" UBYTE _CNV_A_R_LINEAR_____0_CM 1 100. 0. 255. DISPLAY_IDENTIFIER VAL_MO3_RST_CTR_MC ECU_ADDRESS 0x3fa0ae FORMAT "%3.0" /end MEASUREMENT
/begin MEASUREMENT val_mo3_rst_ctr_mu "reset counter on MU" UBYTE _CNV_A_R_LINEAR_____0_CM 1 100. 0. 255. DISPLAY_IDENTIFIER VAL_MO3_RST_CTR_MU ECU_ADDRESS 0x3fed43 FORMAT "%3.0" /end MEASUREMENT
/begin MEASUREMENT cks_crc_ecu "" ULONG _CNV_A_R_LINEAR_____22_CM 1 100. 0. 4294967295. DISPLAY_IDENTIFIER CKS_CRC_ECU ECU_ADDRESS 0x3f9848 BYTE_ORDER MSB_LAST FORMAT "%11.0" /end MEASUREMENT
/begin MEASUREMENT state_iv "" UWORD _CNV_A_R_LINEAR_____0_CM 1 100. 0. 65535. DISPLAY_IDENTIFIER STATE_IV ECU_ADDRESS 0x3fb396 BYTE_ORDER MSB_LAST FORMAT "%5.0" /end MEASUREMENT
/begin MEASUREMENT cyl_id_sam_trig "" UBYTE _CNV_A_R_LINEAR_____177_CM 1 100. 1. 4. DISPLAY_IDENTIFIER CYL_ID_SAM_TRIG ECU_ADDRESS 0xffc5f3be FORMAT "%1.0" /end MEASUREMENT
/begin MEASUREMENT lv_lamb_puls_cat_diag "" ULONG _CNV_S_2_RANGE______2_CM 1 100. 0. 1. DISPLAY_IDENTIFIER LV_LAMB_PULS_CAT_DIAG ECU_ADDRESS 0x3fe530 BYTE_ORDER MSB_LAST /end MEASUREMENT
/begin MEASUREMENT B_ifbsa7 "" UBYTE _CNV_A_R_LINEAR_____22_CM 1 100. 0. 255. DISPLAY_IDENTIFIER B_IFBSA7 ECU_ADDRESS 0x3fabaa BIT_MASK 0x1 /end MEASUREMENT
/begin MEASUREMENT B_ifupla7 "" UBYTE _CNV_A_R_LINEAR_____22_CM 1 100. 0. 255. DISPLAY_IDENTIFIER B_IFUPLA7 ECU_ADDRESS 0x3fabab BIT_MASK 0x1 /end MEASUREMENT
/begin MEASUREMENT n_idlibs "Leerlaufdrehzahlvorgabe von LC-Powermanagement" UBYTE _CNV_R_R_dez_550_CM 1 100. 0. 255. DISPLAY_IDENTIFIER N_IDLIBS ECU_ADDRESS 0x3fabac FORMAT "%8.4" /end MEASUREMENT
/begin CHARACTERISTIC B_IFBSAKAP "Appl-para. für Bedingung Fehler vom BSD" VALUE 0xffe5b85c _REC_VAL_20_u1 0. _CNV_R_R_dez_550_CM 0. 255. FORMAT "%8.4" /end CHARACTERISTIC
/begin CHARACTERISTIC B_IFUPLAAP "Apll-par. für Bedg. Fehler vom IBS" VALUE 0xffe5b85d _REC_VAL_20_u1 0. _CNV_R_R_dez_550_CM 0. 255. FORMAT "%8.4" /end CHARACTERISTIC
/begin CHARACTERISTIC DFLLMIN "DF unterhalb derer die LLDZanh. zurueckgenommen wird." VALUE 0xffe5b85e _REC_VAL_20_u1 0. _CNV_R_R_rel_ub_b10_574_CM 0. 100. FORMAT "%8.4" /end CHARACTERISTIC
/begin CHARACTERISTIC DSOCLLANH "Delta zur Startfaehigkeitsgrenze, bei der die LLDZanh aktiviert wird." VALUE 0xffe5b858 _REC_VAL_20_u2 0. _CNV_R_R_fak_q0p004_635_CM 0. 100. FORMAT "%8.4" /end CHARACTERISTIC
/begin CHARACTERISTIC LLANHAPP "LLDZanh.-level, falls Generator fehlerhaft ist." VALUE 0xffe5b85f _REC_VAL_20_u1 0. _CNV_R_R_dez_550_CM 0. 255. FORMAT "%8.4" /end CHARACTERISTIC
/begin CHARACTERISTIC LLPMAPP "Handapplikationswert von Leerlaufdrehzahlvorgabe von LC-Powermanagement, aktiviert durch S_N_IDLIBS" VALUE 0xffe5b860 _REC_VAL_20_u1 0. _CNV_R_R_dez_550_CM 0. 255. FORMAT "%8.4" /end CHARACTERISTIC
/begin CHARACTERISTIC NLLMIN "Motordrehzahl unterhalb derer die LLDZanh. zurueckgenommen wird." VALUE 0xffe5b85a _REC_VAL_20_u2 0. _CNV_R_R_nmot_uw_q0_636_CM 0. 10000. FORMAT "%8.4" /end CHARACTERISTIC
/begin CHARACTERISTIC S_B_IFBSAK "manueller Schalter für Fehler BSD" VALUE 0xffe5b861 _REC_VAL_20_u1 0. _CNV_R_R_dez_550_CM 0. 255. FORMAT "%8.4" /end CHARACTERISTIC
/begin CHARACTERISTIC S_B_IFPLAK "manueller Schalter für Fehler IBS" VALUE 0xffe5b862 _REC_VAL_20_u1 0. _CNV_R_R_dez_550_CM 0. 255. FORMAT "%8.4" /end CHARACTERISTIC
/begin CHARACTERISTIC S_N_IDLIBS "Schalter zum manuellen Setzen von LL aktiv" VALUE 0xffe5b863 _REC_VAL_20_u1 0. _CNV_R_R_dez_550_CM 0. 255. FORMAT "%8.4" /end CHARACTERISTIC
/begin MEASUREMENT all2ptc "" UWORD _CNV_R_R_fak_uw_q0p_637_CM 1 100. -500. 550. DISPLAY_IDENTIFIER ALL2PTC ECU_ADDRESS 0x3fabc2 BYTE_ORDER MSB_LAST FORMAT "%9.5" /end MEASUREMENT
/begin MEASUREMENT allptcfilt "" UWORD _CNV_R_R_fak_uw_q0p_637_CM 1 100. 0. 550. DISPLAY_IDENTIFIER ALLPTCFILT ECU_ADDRESS 0x3fabc4 BYTE_ORDER MSB_LAST FORMAT "%9.3" /end MEASUREMENT
/begin MEASUREMENT B_dubt "" UBYTE _CNV_S_2_B_TRUE_582_CM 1 100. 0. 1. DISPLAY_IDENTIFIER B_DUBT ECU_ADDRESS 0x3fabb0 /end MEASUREMENT
/begin MEASUREMENT B_enwake7 "" UBYTE _CNV_S_2_B_TRUE_582_CM 1 100. 0. 1. DISPLAY_IDENTIFIER B_ENWAKE7 ECU_ADDRESS 0x3fabb1 /end MEASUREMENT
/begin MEASUREMENT B_enwakeup "" UBYTE _CNV_S_2_B_TRUE_582_CM 1 100. 0. 1. DISPLAY_IDENTIFIER B_ENWAKEUP ECU_ADDRESS 0x3fabb2 /end MEASUREMENT
/begin MEASUREMENT B_ibsakt7 "" UBYTE _CNV_S_2_B_TRUE_582_CM 1 100. 0. 1. DISPLAY_IDENTIFIER B_IBSAKT7 ECU_ADDRESS 0x3fabb3 /end MEASUREMENT
/begin MEASUREMENT B_ifbsak7 "" UBYTE _CNV_S_2_B_TRUE_582_CM 1 100. 0. 1. DISPLAY_IDENTIFIER B_IFBSAK7 ECU_ADDRESS 0x3fabb4 /end MEASUREMENT
/begin MEASUREMENT B_ifuplak7 "" UBYTE _CNV_S_2_B_TRUE_582_CM 1 100. 0. 1. DISPLAY_IDENTIFIER B_IFUPLAK7 ECU_ADDRESS 0x3fabb5 /end MEASUREMENT
/begin MEASUREMENT B_kl15_old "" UBYTE _CNV_S_2_B_TRUE_582_CM 1 100. 0. 1. DISPLAY_IDENTIFIER B_KL15_OLD ECU_ADDRESS 0x3fabb6 /end MEASUREMENT
/begin MEASUREMENT B_moteasy "" UBYTE _CNV_S_2_B_TRUE_582_CM 1 100. 0. 1. DISPLAY_IDENTIFIER B_MOTEASY ECU_ADDRESS 0x3fabb7 /end MEASUREMENT
/begin MEASUREMENT B_motover "" UBYTE _CNV_S_2_B_TRUE_582_CM 1 100. 0. 1. DISPLAY_IDENTIFIER B_MOTOVER ECU_ADDRESS 0x3fabb8 /end MEASUREMENT
/begin MEASUREMENT B_notlauf "" UBYTE _CNV_S_2_B_TRUE_582_CM 1 100. 0. 1. DISPLAY_IDENTIFIER B_NOTLAUF ECU_ADDRESS 0x3fabb9 /end MEASUREMENT
/begin MEASUREMENT B_pcoschg7 "" UBYTE _CNV_S_2_B_TRUE_582_CM 1 100. 0. 1. DISPLAY_IDENTIFIER B_PCOSCHG7 ECU_ADDRESS 0x3fabba /end MEASUREMENT
/begin MEASUREMENT B_PIReset "" UBYTE _CNV_S_2_B_TRUE_582_CM 1 100. 0. 1. DISPLAY_IDENTIFIER B_PIRESET ECU_ADDRESS 0x3fabbb /end MEASUREMENT
/begin MEASUREMENT B_pmbsdanf "" UBYTE _CNV_S_2_B_TRUE_582_CM 1 100. 0. 1. DISPLAY_IDENTIFIER B_PMBSDANF ECU_ADDRESS 0x3fabbc /end MEASUREMENT
/begin MEASUREMENT B_pmvsdanf "" UBYTE _CNV_S_2_B_TRUE_582_CM 1 100. 0. 1. DISPLAY_IDENTIFIER B_PMVSDANF ECU_ADDRESS 0x3fabbd /end MEASUREMENT
/begin MEASUREMENT B_socnpl7 "" UBYTE _CNV_S_2_B_TRUE_582_CM 1 100. 0. 1. DISPLAY_IDENTIFIER B_SOCNPL7 ECU_ADDRESS 0x3fabbe /end MEASUREMENT
/begin MEASUREMENT B_ubtlow "" UBYTE _CNV_S_2_B_TRUE_582_CM 1 100. 0. 1. DISPLAY_IDENTIFIER B_UBTLOW ECU_ADDRESS 0x3fabbf /end MEASUREMENT
/begin MEASUREMENT B_uloreset "" UBYTE _CNV_S_2_B_TRUE_582_CM 1 100. 0. 1. DISPLAY_IDENTIFIER B_ULORESET ECU_ADDRESS 0x3fabc0 /end MEASUREMENT
/begin MEASUREMENT cbattnenn "" UBYTE _CNV_R_R_cbatt_ub_b_638_CM 1 100. 1. 255. DISPLAY_IDENTIFIER CBATTNENN ECU_ADDRESS 0x3fac28 FORMAT "%7.3" /end MEASUREMENT
/begin MEASUREMENT cbattnenn7 "" UBYTE _CNV_R_R_cbatt_ub_b_638_CM 1 100. 1. 255. DISPLAY_IDENTIFIER CBATTNENN7 ECU_ADDRESS 0x3fac29 FORMAT "%7.3" /end MEASUREMENT
/begin MEASUREMENT cfallpi "" UWORD _CNV_R_R_fak_uw_q0p_637_CM 1 100. 0. 150. DISPLAY_IDENTIFIER CFALLPI ECU_ADDRESS 0x3fabc6 BYTE_ORDER MSB_LAST FORMAT "%9.5" /end MEASUREMENT
/begin MEASUREMENT ctrcbr "" UBYTE _CNV_R_R_dez_550_CM 1 100. 0. 255. DISPLAY_IDENTIFIER CTRCBR ECU_ADDRESS 0x3fac2a FORMAT "%5.1" /end MEASUREMENT
/begin MEASUREMENT ctrcbr7 "" UBYTE _CNV_R_R_dez_550_CM 1 100. 0. 255. DISPLAY_IDENTIFIER CTRCBR7 ECU_ADDRESS 0x3fac2b FORMAT "%5.1" /end MEASUREMENT
/begin MEASUREMENT ctrcbrmem "" UBYTE _CNV_R_R_dez_550_CM 1 100. 0. 255. DISPLAY_IDENTIFIER CTRCBRMEM ECU_ADDRESS 0x3fac2c FORMAT "%5.1" /end MEASUREMENT
/begin MEASUREMENT ctrpcos "" UBYTE _CNV_R_R_dez_550_CM 1 100. 0. 3. DISPLAY_IDENTIFIER CTRPCOS ECU_ADDRESS 0x3facc5 FORMAT "%5.3" /end MEASUREMENT
/begin MEASUREMENT ctrpcos7 "" UBYTE _CNV_R_R_dez_550_CM 1 100. 0. 3. DISPLAY_IDENTIFIER CTRPCOS7 ECU_ADDRESS 0x3fac2d FORMAT "%5.3" /end MEASUREMENT
/begin MEASUREMENT ctrpcosmem "" UBYTE _CNV_R_R_dez_550_CM 1 100. 0. 3. DISPLAY_IDENTIFIER CTRPCOSMEM ECU_ADDRESS 0x3fac2e FORMAT "%5.3" /end MEASUREMENT
/begin MEASUREMENT ctrprio "" UBYTE _CNV_R_R_dez_550_CM 1 100. 0. 7. DISPLAY_IDENTIFIER CTRPRIO ECU_ADDRESS 0x3fac2f FORMAT "%5.3" /end MEASUREMENT
/begin MEASUREMENT ctrprio7 "" UBYTE _CNV_R_R_dez_550_CM 1 100. 0. 7. DISPLAY_IDENTIFIER CTRPRIO7 ECU_ADDRESS 0x3fac30 FORMAT "%5.3" /end MEASUREMENT
/begin MEASUREMENT ctrpriocf "" UBYTE _CNV_R_R_dez_550_CM 1 100. 0. 7. DISPLAY_IDENTIFIER CTRPRIOCF ECU_ADDRESS 0x3fac31 FORMAT "%5.3" /end MEASUREMENT
/begin MEASUREMENT ctrpriocf7 "" UBYTE _CNV_R_R_dez_550_CM 1 100. 0. 7. DISPLAY_IDENTIFIER CTRPRIOCF7 ECU_ADDRESS 0x3fac32 FORMAT "%5.3" /end MEASUREMENT
/begin MEASUREMENT ctrpriocfm "" UBYTE _CNV_R_R_dez_550_CM 1 100. 0. 7. DISPLAY_IDENTIFIER CTRPRIOCFM ECU_ADDRESS 0x3fac33 FORMAT "%5.3" /end MEASUREMENT
/begin MEASUREMENT ctrpriomem "" UBYTE _CNV_R_R_dez_550_CM 1 100. 0. 7. DISPLAY_IDENTIFIER CTRPRIOMEM ECU_ADDRESS 0x3fac34 FORMAT "%5.3" /end MEASUREMENT
/begin MEASUREMENT ctrpwrcf "" UWORD _CNV_R_R_dez_550_CM 1 100. 0. 65535. DISPLAY_IDENTIFIER CTRPWRCF ECU_ADDRESS 0x3fabc8 BYTE_ORDER MSB_LAST FORMAT "%8.2" /end MEASUREMENT
/begin MEASUREMENT ctrpwrcos "" UWORD _CNV_R_R_dez_550_CM 1 100. 0. 65535. DISPLAY_IDENTIFIER CTRPWRCOS ECU_ADDRESS 0x3fabca BYTE_ORDER MSB_LAST FORMAT "%8.2" /end MEASUREMENT
/begin MEASUREMENT ctrpwrcos7 "" UWORD _CNV_R_R_dez_550_CM 1 100. 0. 65535. DISPLAY_IDENTIFIER CTRPWRCOS7 ECU_ADDRESS 0x3fabcc BYTE_ORDER MSB_LAST FORMAT "%8.2" /end MEASUREMENT
/begin MEASUREMENT ctrpwrdf "" UWORD _CNV_R_R_dez_550_CM 1 100. 0. 65535. DISPLAY_IDENTIFIER CTRPWRDF ECU_ADDRESS 0x3fabce BYTE_ORDER MSB_LAST FORMAT "%8.2" /end MEASUREMENT
/begin MEASUREMENT ctrpwrmem "" UWORD _CNV_R_R_dez_550_CM 1 100. 0. 65535. DISPLAY_IDENTIFIER CTRPWRMEM ECU_ADDRESS 0x3fabd0 BYTE_ORDER MSB_LAST FORMAT "%8.2" /end MEASUREMENT
/begin MEASUREMENT ctrpwspcos "" UBYTE _CNV_R_R_fak_q0p5_639_CM 1 100. 0. 127.5 DISPLAY_IDENTIFIER CTRPWSPCOS ECU_ADDRESS 0x3fac35 FORMAT "%5.1" /end MEASUREMENT
/begin MEASUREMENT ctrpwspcs7 "" UBYTE _CNV_R_R_fak_q0p5_639_CM 1 100. 0. 127.5 DISPLAY_IDENTIFIER CTRPWSPCS7 ECU_ADDRESS 0x3fac36 FORMAT "%5.1" /end MEASUREMENT
/begin MEASUREMENT df2pi "" UWORD _CNV_R_R_fak_uw_q0p_637_CM 1 100. -100. 100. DISPLAY_IDENTIFIER DF2PI ECU_ADDRESS 0x3fabd2 BYTE_ORDER MSB_LAST FORMAT "%9.5" /end MEASUREMENT
/begin MEASUREMENT dfall2pi "" UWORD _CNV_R_R_fak_uw_q0p_637_CM 1 100. -500. 500. DISPLAY_IDENTIFIER DFALL2PI ECU_ADDRESS 0x3fabd4 BYTE_ORDER MSB_LAST FORMAT "%9.5" /end MEASUREMENT
/begin MEASUREMENT dfallpi "" UWORD _CNV_R_R_fak_uw_q0p_637_CM 1 100. 0. 450. DISPLAY_IDENTIFIER DFALLPI ECU_ADDRESS 0x3fabd6 BYTE_ORDER MSB_LAST FORMAT "%9.3" /end MEASUREMENT
/begin MEASUREMENT dffgen7 "" UBYTE _CNV_R_R_rel_ub_b10_574_CM 1 100. 0. 100. DISPLAY_IDENTIFIER DFFGEN7 ECU_ADDRESS 0x3fac37 FORMAT "%5.1" /end MEASUREMENT
/begin MEASUREMENT dff_filt7 "" UBYTE _CNV_R_R_rel_ub_b10_574_CM 1 100. 0. 100. DISPLAY_IDENTIFIER DFF_FILT7 ECU_ADDRESS 0x3fac38 FORMAT "%5.1" /end MEASUREMENT
/begin MEASUREMENT dfpi2ptc "" UWORD _CNV_R_R_fak_uw_q0p_637_CM 1 100. 0. 100. DISPLAY_IDENTIFIER DFPI2PTC ECU_ADDRESS 0x3fabd8 BYTE_ORDER MSB_LAST FORMAT "%9.5" /end MEASUREMENT
/begin MEASUREMENT dfpt1filt "" UBYTE _CNV_R_R_rel_ub_b10_574_CM 1 100. 0. 100. DISPLAY_IDENTIFIER DFPT1FILT ECU_ADDRESS 0x3fac3a /end MEASUREMENT
/begin MEASUREMENT dfpt1ptc "" UBYTE _CNV_R_R_rel_ub_b10_574_CM 1 100. 0. 100. DISPLAY_IDENTIFIER DFPT1PTC ECU_ADDRESS 0x3fac3b /end MEASUREMENT
/begin MEASUREMENT dfpt1_2ptc "" UWORD _CNV_R_R_fak_uw_q0p_637_CM 1 100. -100. 100. DISPLAY_IDENTIFIER DFPT1_2PTC ECU_ADDRESS 0x3fabda BYTE_ORDER MSB_LAST FORMAT "%9.5" /end MEASUREMENT
/begin MEASUREMENT dsoc2pi "" UWORD _CNV_R_R_fak_uw_q0p_637_CM 1 100. -150. 150. DISPLAY_IDENTIFIER DSOC2PI ECU_ADDRESS 0x3fabdc BYTE_ORDER MSB_LAST FORMAT "%9.5" /end MEASUREMENT
/begin MEASUREMENT dsoc2ptc "" UWORD _CNV_R_R_fak_uw_q0p_637_CM 1 100. -150. 150. DISPLAY_IDENTIFIER DSOC2PTC ECU_ADDRESS 0x3fabde BYTE_ORDER MSB_LAST FORMAT "%9.5" /end MEASUREMENT
/begin MEASUREMENT dsoc_old "" UWORD _CNV_R_R_fak_q0p004_635_CM 1 100. -100. 100. DISPLAY_IDENTIFIER DSOC_OLD ECU_ADDRESS 0x3fabe0 BYTE_ORDER MSB_LAST FORMAT "%7.3" /end MEASUREMENT
/begin MEASUREMENT ehz_pwloc2 "" UBYTE _CNV_R_R_rel_ub_b10_574_CM 1 100. 0. 100. DISPLAY_IDENTIFIER EHZ_PWLOC2 ECU_ADDRESS 0x3fac3c FORMAT "%5.1" /end MEASUREMENT
/begin MEASUREMENT hkw_iant2 "" SWORD _CNV_R_R_rel_ub_b10_574_CM 1 100. -100. 100. DISPLAY_IDENTIFIER HKW_IANT2 ECU_ADDRESS 0x3fabe2 BYTE_ORDER MSB_LAST FORMAT "%8.4" /end MEASUREMENT
/begin MEASUREMENT hkw_ki2 "" UWORD _CNV_R_R_fak_uw_q0p_640_CM 1 100. 0. 10. DISPLAY_IDENTIFIER HKW_KI2 ECU_ADDRESS 0x3fabe4 BYTE_ORDER MSB_LAST FORMAT "%8.5" /end MEASUREMENT
/begin MEASUREMENT hkw_kp2 "" UWORD _CNV_R_R_fak_uw_q0p_640_CM 1 100. 0. 10. DISPLAY_IDENTIFIER HKW_KP2 ECU_ADDRESS 0x3fabe6 BYTE_ORDER MSB_LAST FORMAT "%8.5" /end MEASUREMENT
/begin MEASUREMENT hkw_lpgv2 "" UBYTE _CNV_R_R_rel_ub_b10_574_CM 1 100. 0. 100. DISPLAY_IDENTIFIER HKW_LPGV2 ECU_ADDRESS 0x3fac3d FORMAT "%5.1" /end MEASUREMENT
/begin MEASUREMENT hkw_pant2 "" SWORD _CNV_R_R_rel_ub_b10_574_CM 1 100. -1000. 1000. DISPLAY_IDENTIFIER HKW_PANT2 ECU_ADDRESS 0x3fabe8 BYTE_ORDER MSB_LAST FORMAT "%8.3" /end MEASUREMENT
/begin MEASUREMENT hkw_pi2 "" SWORD _CNV_R_R_rel_ub_b10_574_CM 1 100. -2000. 2000. DISPLAY_IDENTIFIER HKW_PI2 ECU_ADDRESS 0x3fabea BYTE_ORDER MSB_LAST FORMAT "%8.3" /end MEASUREMENT
/begin MEASUREMENT hkw_rdiff2 "" UBYTE _CNV_R_R_rel_ub_b10_574_CM 1 100. 0. 100. DISPLAY_IDENTIFIER HKW_RDIFF2 ECU_ADDRESS 0x3fac3e FORMAT "%5.1" /end MEASUREMENT
/begin MEASUREMENT hkw_sel_i2 "" UBYTE _CNV_R_R_dez_550_CM 1 100. 0. 10. DISPLAY_IDENTIFIER HKW_SEL_I2 ECU_ADDRESS 0x3fac3f FORMAT "%5.2" /end MEASUREMENT
/begin MEASUREMENT hkw_sel_p2 "" UBYTE _CNV_R_R_dez_550_CM 1 100. 0. 10. DISPLAY_IDENTIFIER HKW_SEL_P2 ECU_ADDRESS 0x3fac40 FORMAT "%5.2" /end MEASUREMENT
/begin MEASUREMENT hkw_sv2 "" UBYTE _CNV_R_R_rel_ub_b10_574_CM 1 100. 0. 100. DISPLAY_IDENTIFIER HKW_SV2 ECU_ADDRESS 0x3fac41 FORMAT "%5.1" /end MEASUREMENT
/begin MEASUREMENT ibatt_w7 "" UWORD _CNV_R_R_i_uw_q0p08_587_CM 1 100. -200. 1000. DISPLAY_IDENTIFIER IBATT_W7 ECU_ADDRESS 0x3fabec BYTE_ORDER MSB_LAST FORMAT "%7.2" /end MEASUREMENT
/begin MEASUREMENT ibtdiff "" UWORD _CNV_R_R_i_uw_q0p08_587_CM 1 100. -200. 2000. DISPLAY_IDENTIFIER IBTDIFF ECU_ADDRESS 0x3fabee BYTE_ORDER MSB_LAST FORMAT "%7.2" /end MEASUREMENT
/begin MEASUREMENT ibtdiff2pi "" UWORD _CNV_R_R_fak_uw_q0p_637_CM 1 100. -100. 100. DISPLAY_IDENTIFIER IBTDIFF2PI ECU_ADDRESS 0x3fabf0 BYTE_ORDER MSB_LAST FORMAT "%9.5" /end MEASUREMENT
/begin MEASUREMENT ibtsoll "" UWORD _CNV_R_R_i_uw_q0p08_587_CM 1 100. -200. 1000. DISPLAY_IDENTIFIER IBTSOLL ECU_ADDRESS 0x3fabf2 BYTE_ORDER MSB_LAST FORMAT "%7.2" /end MEASUREMENT
/begin MEASUREMENT idiff2ptc "" UWORD _CNV_R_R_fak_uw_q0p_637_CM 1 100. -100. 100. DISPLAY_IDENTIFIER IDIFF2PTC ECU_ADDRESS 0x3fabf4 BYTE_ORDER MSB_LAST FORMAT "%9.5" /end MEASUREMENT
/begin MEASUREMENT igenrest "" UBYTE _CNV_R_R_dez_550_CM 1 100. 0. 255. DISPLAY_IDENTIFIER IGENREST ECU_ADDRESS 0x3fac42 FORMAT "%5.1" /end MEASUREMENT
/begin MEASUREMENT ikurzogrz7 "" UBYTE _CNV_R_R_i_ub_q5p12_641_CM 1 100. 0. 998.4 DISPLAY_IDENTIFIER IKURZOGRZ7 ECU_ADDRESS 0x3fac43 FORMAT "%5.0" /end MEASUREMENT
/begin MEASUREMENT ikurzugrz7 "" UBYTE _CNV_R_R_i_ub_q5p12_641_CM 1 100. 0. 998.4 DISPLAY_IDENTIFIER IKURZUGRZ7 ECU_ADDRESS 0x3fac44 FORMAT "%5.0" /end MEASUREMENT
/begin MEASUREMENT ikurz_ogrz "" UBYTE _CNV_R_R_i_ub_q5p12_641_CM 1 100. 0. 998.4 DISPLAY_IDENTIFIER IKURZ_OGRZ ECU_ADDRESS 0x3fac45 FORMAT "%5.0" /end MEASUREMENT
/begin MEASUREMENT ikurz_ugrz "" UBYTE _CNV_R_R_i_ub_q5p12_641_CM 1 100. 0. 998.4 DISPLAY_IDENTIFIER IKURZ_UGRZ ECU_ADDRESS 0x3fac46 FORMAT "%5.0" /end MEASUREMENT
/begin MEASUREMENT ind_priocf "" UBYTE _CNV_R_R_dez_550_CM 1 100. 0. 6. DISPLAY_IDENTIFIER IND_PRIOCF ECU_ADDRESS 0x3fac47 FORMAT "%5.3" /end MEASUREMENT
/begin MEASUREMENT ind_priodf "" UBYTE _CNV_R_R_dez_550_CM 1 100. 0. 6. DISPLAY_IDENTIFIER IND_PRIODF ECU_ADDRESS 0x3fac48 FORMAT "%5.3" /end MEASUREMENT
/begin MEASUREMENT ind_pwrcf "" UBYTE _CNV_R_R_dez_550_CM 1 100. 0. 6. DISPLAY_IDENTIFIER IND_PWRCF ECU_ADDRESS 0x3fac49 FORMAT "%5.3" /end MEASUREMENT
/begin MEASUREMENT ind_pwrcos "" UBYTE _CNV_R_R_dez_550_CM 1 100. 0. 13. DISPLAY_IDENTIFIER IND_PWRCOS ECU_ADDRESS 0x3fac4a FORMAT "%5.2" /end MEASUREMENT
/begin MEASUREMENT isoll "" UWORD _CNV_R_R_i_uw_q0p08_587_CM 1 100. -200. 1000. DISPLAY_IDENTIFIER ISOLL ECU_ADDRESS 0x3fabf6 BYTE_ORDER MSB_LAST FORMAT "%7.2" /end MEASUREMENT
/begin MEASUREMENT isolldiff "" UWORD _CNV_R_R_i_uw_q0p08_587_CM 1 100. -200. 1000. DISPLAY_IDENTIFIER ISOLLDIFF ECU_ADDRESS 0x3fabf8 BYTE_ORDER MSB_LAST FORMAT "%7.2" /end MEASUREMENT
/begin MEASUREMENT iwakegrz7 "" UBYTE _CNV_R_R_i_ub_q0p02_589_CM 1 100. 0. 4. DISPLAY_IDENTIFIER IWAKEGRZ7 ECU_ADDRESS 0x3fac4b FORMAT "%7.5" /end MEASUREMENT
/begin MEASUREMENT kbmcount "" UBYTE _CNV_R_R_t_q0p1_642_CM 1 100. 0. 25.5 DISPLAY_IDENTIFIER KBMCOUNT ECU_ADDRESS 0x3fac4d FORMAT "%5.2" /end MEASUREMENT
/begin MEASUREMENT mem "" UBYTE _CNV_R_R_fak_q0p5_639_CM 1 100. 0. 127.5 DISPLAY_IDENTIFIER MEM ECU_ADDRESS 0x3fac4e FORMAT "%5.1" /end MEASUREMENT
/begin MEASUREMENT memprio1 "" UWORD _CNV_R_R_fak_uw_b51_643_CM 1 100. 0. 511.992 DISPLAY_IDENTIFIER MEMPRIO1 ECU_ADDRESS 0x3fabfa BYTE_ORDER MSB_LAST FORMAT "%8.4" /end MEASUREMENT
/begin MEASUREMENT memprio2 "" UWORD _CNV_R_R_fak_uw_b51_643_CM 1 100. 0. 511.992 DISPLAY_IDENTIFIER MEMPRIO2 ECU_ADDRESS 0x3fabfc BYTE_ORDER MSB_LAST FORMAT "%8.4" /end MEASUREMENT
/begin MEASUREMENT mempriocf1 "" UWORD _CNV_R_R_fak_uw_b51_643_CM 1 100. 0. 511.992 DISPLAY_IDENTIFIER MEMPRIOCF1 ECU_ADDRESS 0x3fabfe BYTE_ORDER MSB_LAST FORMAT "%8.4" /end MEASUREMENT
/begin MEASUREMENT mempriocf2 "" UWORD _CNV_R_R_fak_uw_b51_643_CM 1 100. 0. 511.992 DISPLAY_IDENTIFIER MEMPRIOCF2 ECU_ADDRESS 0x3fac00 BYTE_ORDER MSB_LAST FORMAT "%8.4" /end MEASUREMENT
/begin MEASUREMENT memptc1 "" UWORD _CNV_R_R_fak_uw_b51_643_CM 1 100. 0. 511.992 DISPLAY_IDENTIFIER MEMPTC1 ECU_ADDRESS 0x3fac02 BYTE_ORDER MSB_LAST FORMAT "%8.4" /end MEASUREMENT
/begin MEASUREMENT memptc2 "" UWORD _CNV_R_R_fak_uw_b51_643_CM 1 100. 0. 511.992 DISPLAY_IDENTIFIER MEMPTC2 ECU_ADDRESS 0x3fac04 BYTE_ORDER MSB_LAST FORMAT "%8.4" /end MEASUREMENT
/begin MEASUREMENT pgen2ptc "" UWORD _CNV_R_R_fak_uw_q0p_637_CM 1 100. -100. 0. DISPLAY_IDENTIFIER PGEN2PTC ECU_ADDRESS 0x3fac06 BYTE_ORDER MSB_LAST FORMAT "%9.5" /end MEASUREMENT
/begin MEASUREMENT pgenrest "" UWORD _CNV_R_R_fak_q0p1_644_CM 1 100. 0. 6400. DISPLAY_IDENTIFIER PGENREST ECU_ADDRESS 0x3fac08 BYTE_ORDER MSB_LAST /end MEASUREMENT
/begin MEASUREMENT picntr "" UBYTE _CNV_R_R_t_q0p1_642_CM 1 100. 0. 25.5 DISPLAY_IDENTIFIER PICNTR ECU_ADDRESS 0x3fac4f FORMAT "%5.2" /end MEASUREMENT
/begin MEASUREMENT pmbscount "" UBYTE _CNV_R_R_dez_550_CM 1 100. 0. 255. DISPLAY_IDENTIFIER PMBSCOUNT ECU_ADDRESS 0x3fac50 FORMAT "%5.1" /end MEASUREMENT
/begin MEASUREMENT pmvscount "" UBYTE _CNV_R_R_dez_550_CM 1 100. 0. 255. DISPLAY_IDENTIFIER PMVSCOUNT ECU_ADDRESS 0x3fac51 FORMAT "%5.1" /end MEASUREMENT
/begin MEASUREMENT priocf_loc "" UBYTE _CNV_R_R_dez_550_CM 1 100. 0. 7. DISPLAY_IDENTIFIER PRIOCF_LOC ECU_ADDRESS 0x3fac52 FORMAT "%6.2" /end MEASUREMENT
/begin MEASUREMENT ptc_pwr "" UBYTE _CNV_R_R_fak_q0p5_639_CM 1 100. 0. 127.5 DISPLAY_IDENTIFIER PTC_PWR ECU_ADDRESS 0x3fac53 FORMAT "%5.1" /end MEASUREMENT
/begin MEASUREMENT ptc_pwr7 "" UBYTE _CNV_R_R_fak_q0p5_639_CM 1 100. 0. 127.5 DISPLAY_IDENTIFIER PTC_PWR7 ECU_ADDRESS 0x3fac54 FORMAT "%5.1" /end MEASUREMENT
/begin MEASUREMENT rqpcos "" UBYTE _CNV_R_R_dez_550_CM 1 100. 0. 3. DISPLAY_IDENTIFIER RQPCOS ECU_ADDRESS 0x3fac55 FORMAT "%5.3" /end MEASUREMENT
/begin MEASUREMENT rqpcos7 "" UBYTE _CNV_R_R_dez_550_CM 1 100. 0. 3. DISPLAY_IDENTIFIER RQPCOS7 ECU_ADDRESS 0x3fac56 FORMAT "%5.3" /end MEASUREMENT
/begin MEASUREMENT rqpcosmem "" UBYTE _CNV_R_R_dez_550_CM 1 100. 0. 3. DISPLAY_IDENTIFIER RQPCOSMEM ECU_ADDRESS 0x3fac57 FORMAT "%5.3" /end MEASUREMENT
/begin MEASUREMENT selspcos "" UBYTE _CNV_R_R_dez_550_CM 1 100. 0. 15. DISPLAY_IDENTIFIER SELSPCOS ECU_ADDRESS 0x3fac58 FORMAT "%5.2" /end MEASUREMENT
/begin MEASUREMENT selspcos7 "" UBYTE _CNV_R_R_dez_550_CM 1 100. 0. 15. DISPLAY_IDENTIFIER SELSPCOS7 ECU_ADDRESS 0x3fac59 FORMAT "%5.2" /end MEASUREMENT
/begin MEASUREMENT selspcosme "" UBYTE _CNV_R_R_dez_550_CM 1 100. 0. 15. DISPLAY_IDENTIFIER SELSPCOSME ECU_ADDRESS 0x3fac5a FORMAT "%5.2" /end MEASUREMENT
/begin MEASUREMENT stpcos "" UBYTE _CNV_R_R_dez_550_CM 1 100. 0. 3. DISPLAY_IDENTIFIER STPCOS ECU_ADDRESS 0x3fac5b FORMAT "%5.3" /end MEASUREMENT
/begin MEASUREMENT stpcos7 "" UBYTE _CNV_R_R_dez_550_CM 1 100. 0. 3. DISPLAY_IDENTIFIER STPCOS7 ECU_ADDRESS 0x3fac5c FORMAT "%5.3" /end MEASUREMENT
/begin MEASUREMENT stpcosmem "" UBYTE _CNV_R_R_dez_550_CM 1 100. 0. 3. DISPLAY_IDENTIFIER STPCOSMEM ECU_ADDRESS 0x3fac5d FORMAT "%5.3" /end MEASUREMENT
/begin MEASUREMENT tbatt7 "" UBYTE _CNV_R_R_temp_uw_q0_577_CM 1 100. -48. 125.25 DISPLAY_IDENTIFIER TBATT7 ECU_ADDRESS 0x3fac5e FORMAT "%6.2" /end MEASUREMENT
/begin MEASUREMENT ubatt_w7 "" UWORD _CNV_R_R_spg_uw_q0p_591_CM 1 100. 6. 16. DISPLAY_IDENTIFIER UBATT_W7 ECU_ADDRESS 0x3fac0a BYTE_ORDER MSB_LAST FORMAT "%9.6" /end MEASUREMENT
/begin MEASUREMENT ubdiff "" UWORD _CNV_R_R_spg_q0p977_645_CM 1 100. -32. 31.999 DISPLAY_IDENTIFIER UBDIFF ECU_ADDRESS 0x3fac0c BYTE_ORDER MSB_LAST FORMAT "%9.6" /end MEASUREMENT
/begin MEASUREMENT ubdiff2pi "" UWORD _CNV_R_R_fak_uw_q0p_637_CM 1 100. -100. 100. DISPLAY_IDENTIFIER UBDIFF2PI ECU_ADDRESS 0x3fac0e BYTE_ORDER MSB_LAST FORMAT "%9.5" /end MEASUREMENT
/begin MEASUREMENT ubdifffilt "" UWORD _CNV_R_R_spg_q0p977_645_CM 1 100. -32. 31.999 DISPLAY_IDENTIFIER UBDIFFFILT ECU_ADDRESS 0x3fac10 BYTE_ORDER MSB_LAST FORMAT "%9.4" /end MEASUREMENT
/begin MEASUREMENT ubdiffptc "" UWORD _CNV_R_R_spg_q0p977_645_CM 1 100. -32. 31.999 DISPLAY_IDENTIFIER UBDIFFPTC ECU_ADDRESS 0x3fac12 BYTE_ORDER MSB_LAST FORMAT "%9.6" /end MEASUREMENT
/begin MEASUREMENT ubt "" UWORD _CNV_R_R_spg_uw_q0p_646_CM 1 100. 0. 61.425 DISPLAY_IDENTIFIER UBT ECU_ADDRESS 0x3fac14 BYTE_ORDER MSB_LAST FORMAT "%9.6" /end MEASUREMENT
/begin MEASUREMENT ubt7 "" UWORD _CNV_R_R_spg_uw_q0p_646_CM 1 100. 0. 61.425 DISPLAY_IDENTIFIER UBT7 ECU_ADDRESS 0x3fac16 BYTE_ORDER MSB_LAST FORMAT "%9.6" /end MEASUREMENT
/begin MEASUREMENT ubt7mem "" UWORD _CNV_R_R_spg_uw_q0p_647_CM 1 100. -61.425 61.425 DISPLAY_IDENTIFIER UBT7MEM ECU_ADDRESS 0x3fac18 BYTE_ORDER MSB_LAST FORMAT "%9.6" /end MEASUREMENT
/begin MEASUREMENT ubt7old "" UWORD _CNV_R_R_spg_uw_q0p_646_CM 1 100. 0. 61.425 DISPLAY_IDENTIFIER UBT7OLD ECU_ADDRESS 0x3fac1a BYTE_ORDER MSB_LAST FORMAT "%9.6" /end MEASUREMENT
/begin MEASUREMENT ubtpt12ptc "" UWORD _CNV_R_R_fak_uw_q0p_637_CM 1 100. -100. 100. DISPLAY_IDENTIFIER UBTPT12PTC ECU_ADDRESS 0x3fac1c BYTE_ORDER MSB_LAST FORMAT "%9.5" /end MEASUREMENT
/begin MEASUREMENT ubtpt1ptc "" UWORD _CNV_R_R_spg_q0p977_645_CM 1 100. -32. 31.999 DISPLAY_IDENTIFIER UBTPT1PTC ECU_ADDRESS 0x3fac1e BYTE_ORDER MSB_LAST FORMAT "%9.4" /end MEASUREMENT
/begin MEASUREMENT udeltaabsc "" ULONG _CNV_R_R_spg_uw_q0p_646_CM 1 100. 0. 61.425 DISPLAY_IDENTIFIER UDELTAABSC ECU_ADDRESS 0x3fac24 BYTE_ORDER MSB_LAST FORMAT "%9.6" /end MEASUREMENT
/begin MEASUREMENT udeltac "" UWORD _CNV_R_R_spg_uw_q0p_647_CM 1 100. -491.505 491.52 DISPLAY_IDENTIFIER UDELTAC ECU_ADDRESS 0x3fac20 BYTE_ORDER MSB_LAST FORMAT "%9.5" /end MEASUREMENT
/begin MEASUREMENT ulev "" UBYTE _CNV_R_R_dez_550_CM 1 100. 0. 15. DISPLAY_IDENTIFIER ULEV ECU_ADDRESS 0x3fac5f FORMAT "%5.2" /end MEASUREMENT
/begin MEASUREMENT ulev7 "" UBYTE _CNV_R_R_dez_550_CM 1 100. 0. 15. DISPLAY_IDENTIFIER ULEV7 ECU_ADDRESS 0x3fac60 FORMAT "%5.2" /end MEASUREMENT
/begin MEASUREMENT ulevmem "" UBYTE _CNV_R_R_dez_550_CM 1 100. 0. 15. DISPLAY_IDENTIFIER ULEVMEM ECU_ADDRESS 0x3fac61 FORMAT "%5.2" /end MEASUREMENT
/begin MEASUREMENT ulow "" UBYTE _CNV_R_R_dez_550_CM 1 100. 0. 255. DISPLAY_IDENTIFIER ULOW ECU_ADDRESS 0x3fac62 FORMAT "%5.1" /end MEASUREMENT
/begin MEASUREMENT ulowtimer "" UBYTE _CNV_R_R_t_q0p1_642_CM 1 100. 0. 25.5 DISPLAY_IDENTIFIER ULOWTIMER ECU_ADDRESS 0x3fac63 FORMAT "%5.2" /end MEASUREMENT
/begin CHARACTERISTIC ARY_PRIO "" VAL_BLK 0xffe5bb2c _REC_VAL_2_s1 7. _CNV_R_R_dez_550_CM 0. 7. FORMAT "%5.3" NUMBER 6 /end CHARACTERISTIC
/begin CHARACTERISTIC ARY_PRIOCF "" VAL_BLK 0xffe5bb32 _REC_VAL_2_u1 7. _CNV_R_R_dez_550_CM 0. 7. FORMAT "%5.3" NUMBER 7 /end CHARACTERISTIC
/begin CHARACTERISTIC ARY_PWRCF "" VAL_BLK 0xffe5babc _REC_VAL_2_u2 65535. _CNV_R_R_dez_550_CM 0. 65535. FORMAT "%8.2" NUMBER 7 /end CHARACTERISTIC
/begin CHARACTERISTIC ARY_PWRDF "" VAL_BLK 0xffe5baca _REC_VAL_2_u2 65535. _CNV_R_R_dez_550_CM 0. 65535. FORMAT "%8.2" NUMBER 14 /end CHARACTERISTIC
/begin CHARACTERISTIC B_SOCNPAPP "" VALUE 0xffe5bb62 _REC_VAL_20_u1 255. _CNV_R_R_dez_550_CM 0. 255. FORMAT "%5.1" /end CHARACTERISTIC
/begin CHARACTERISTIC CBATTAPP "" VALUE 0xffe5bb63 _REC_VAL_20_u1 254. _CNV_R_R_cbatt_ub_b_638_CM 1. 255. FORMAT "%7.3" /end CHARACTERISTIC
/begin CHARACTERISTIC CTRCBRAPP "" VALUE 0xffe5bb64 _REC_VAL_20_u1 255. _CNV_R_R_dez_550_CM 0. 255. FORMAT "%5.1" /end CHARACTERISTIC
/begin CHARACTERISTIC CTRPCOSAPP "" VALUE 0xffe5bb65 _REC_VAL_20_u1 3. _CNV_R_R_dez_550_CM 0. 3. FORMAT "%5.3" /end CHARACTERISTIC
/begin CHARACTERISTIC CTRPRIOAPP "" VALUE 0xffe5bb66 _REC_VAL_20_u1 7. _CNV_R_R_dez_550_CM 0. 7. FORMAT "%5.3" /end CHARACTERISTIC
/begin CHARACTERISTIC C_RESET_PI "" VALUE 0xffe5bb67 _REC_VAL_20_u1 25.5 _CNV_R_R_t_q0p1_642_CM 0. 25.5 FORMAT "%5.2" /end CHARACTERISTIC
/begin CHARACTERISTIC DFFGEN_APP "" VALUE 0xffe5bb68 _REC_VAL_20_u1 100. _CNV_R_R_rel_ub_b10_574_CM 0. 100. FORMAT "%5.1" /end CHARACTERISTIC
/begin CHARACTERISTIC DFFILT_APP "" VALUE 0xffe5bb69 _REC_VAL_20_u1 100. _CNV_R_R_rel_ub_b10_574_CM 0. 100. FORMAT "%5.1" /end CHARACTERISTIC
/begin CHARACTERISTIC DSOCPRIO4 "" VALUE 0xffe5bb3e _REC_VAL_20_u2 200. _CNV_R_R_fak_q0p004_635_CM -100. 100. FORMAT "%7.3" /end CHARACTERISTIC
/begin CHARACTERISTIC DSOCPRIO5 "" VALUE 0xffe5bb40 _REC_VAL_20_u2 200. _CNV_R_R_fak_q0p004_635_CM -100. 100. FORMAT "%7.3" /end CHARACTERISTIC
/begin CHARACTERISTIC DSOCPRIO6 "" VALUE 0xffe5bb42 _REC_VAL_20_u2 200. _CNV_R_R_fak_q0p004_635_CM -100. 100. FORMAT "%7.3" /end CHARACTERISTIC
/begin CHARACTERISTIC EHZOLDAPP "" VALUE 0xffe5bb6c _REC_VAL_20_u1 127.5 _CNV_R_R_fak_q0p5_639_CM 0. 127.5 FORMAT "%5.1" /end CHARACTERISTIC
/begin CHARACTERISTIC HKW_dT "" VALUE 0xffe5bb44 _REC_VAL_20_u2 1. _CNV_R_R_fak_uw_q0p_640_CM 0. 1. DISPLAY_IDENTIFIER HKW_DT FORMAT "%8.6" /end CHARACTERISTIC
/begin CHARACTERISTIC HKW_IKL2 "" VALUE 0xffe5bb46 _REC_VAL_20_u2 10. _CNV_R_R_fak_uw_q0p_640_CM 0. 10. FORMAT "%8.5" /end CHARACTERISTIC
/begin CHARACTERISTIC HKW_ING2 "" VALUE 0xffe5bb48 _REC_VAL_20_u2 10. _CNV_R_R_fak_uw_q0p_640_CM 0. 10. FORMAT "%8.5" /end CHARACTERISTIC
/begin CHARACTERISTIC HKW_IPG2 "" VALUE 0xffe5bb4a _REC_VAL_20_u2 10. _CNV_R_R_fak_uw_q0p_640_CM 0. 10. FORMAT "%8.5" /end CHARACTERISTIC
/begin CHARACTERISTIC HKW_IWIN2 "" VALUE 0xffe5bb6d _REC_VAL_20_u1 100. _CNV_R_R_rel_ub_b10_574_CM 0. 100. FORMAT "%5.1" /end CHARACTERISTIC
/begin CHARACTERISTIC HKW_NSTMX2 "" VALUE 0xffe5bb6e _REC_VAL_20_u1 100. _CNV_R_R_rel_ub_b10_574_CM 0. 100. FORMAT "%5.1" /end CHARACTERISTIC
/begin CHARACTERISTIC HKW_PIMAX2 "" VALUE 0xffe5bb6f _REC_VAL_20_u1 100. _CNV_R_R_rel_ub_b10_574_CM 0. 100. FORMAT "%5.1" /end CHARACTERISTIC
/begin CHARACTERISTIC HKW_PKL2 "" VALUE 0xffe5bb4c _REC_VAL_20_u2 10. _CNV_R_R_fak_uw_q0p_640_CM 0. 10. FORMAT "%8.5" /end CHARACTERISTIC
/begin CHARACTERISTIC HKW_PNG2 "" VALUE 0xffe5bb4e _REC_VAL_20_u2 10. _CNV_R_R_fak_uw_q0p_640_CM 0. 10. FORMAT "%8.5" /end CHARACTERISTIC
/begin CHARACTERISTIC HKW_PPG2 "" VALUE 0xffe5bb50 _REC_VAL_20_u2 10. _CNV_R_R_fak_uw_q0p_640_CM 0. 10. FORMAT "%8.5" /end CHARACTERISTIC
/begin CHARACTERISTIC HKW_PSTMX2 "" VALUE 0xffe5bb70 _REC_VAL_20_u1 100. _CNV_R_R_rel_ub_b10_574_CM 0. 100. FORMAT "%5.1" /end CHARACTERISTIC
/begin CHARACTERISTIC HKW_PWIN2 "" VALUE 0xffe5bb71 _REC_VAL_20_u1 100. _CNV_R_R_rel_ub_b10_574_CM 0. 100. FORMAT "%5.1" /end CHARACTERISTIC
/begin CHARACTERISTIC HKW_TGL2 "" VALUE 0xffe5bb72 _REC_VAL_20_u1 25.4 _CNV_R_R_fak_q0p1_644_CM 0.1 25.5 FORMAT "%5.2" /end CHARACTERISTIC
/begin CHARACTERISTIC HKW_TRGL2 "" VALUE 0xffe5bb73 _REC_VAL_20_u1 25.4 _CNV_R_R_fak_q0p1_644_CM 0.1 25.5 FORMAT "%5.2" /end CHARACTERISTIC
/begin CHARACTERISTIC IBATT_APP "" VALUE 0xffe5bb52 _REC_VAL_20_u2 1200. _CNV_R_R_i_uw_q0p08_587_CM -200. 1000. FORMAT "%7.2" /end CHARACTERISTIC
/begin CHARACTERISTIC IBSAKTAPP "" VALUE 0xffe5bb74 _REC_VAL_20_u1 255. _CNV_R_R_dez_550_CM 0. 255. FORMAT "%5.1" /end CHARACTERISTIC
/begin CHARACTERISTIC IBSWAKEAPP "" VALUE 0xffe5bb75 _REC_VAL_20_u1 255. _CNV_R_R_dez_550_CM 0. 255. FORMAT "%5.1" /end CHARACTERISTIC
/begin CHARACTERISTIC IFBSAKAPP "" VALUE 0xffe5bb76 _REC_VAL_20_u1 255. _CNV_R_R_dez_550_CM 0. 255. FORMAT "%5.1" /end CHARACTERISTIC
/begin CHARACTERISTIC IFUPLAKAPP "" VALUE 0xffe5bb77 _REC_VAL_20_u1 255. _CNV_R_R_dez_550_CM 0. 255. FORMAT "%5.1" /end CHARACTERISTIC
/begin CHARACTERISTIC KBMCNT_APP "" VALUE 0xffe5bb78 _REC_VAL_20_u1 25.5 _CNV_R_R_t_q0p1_642_CM 0. 25.5 FORMAT "%5.2" /end CHARACTERISTIC
/begin CHARACTERISTIC KDFPTC_LP "" VALUE 0xffe5bb79 _REC_VAL_20_u1 0.9961 _CNV_R_R_fak_ub_b1_648_CM 0. 0.9961 FORMAT "%6.4" /end CHARACTERISTIC
/begin CHARACTERISTIC KFISOLLPTC "" MAP 0xffe5b864 _REC_MAP_52_UBYTE_u2_u1_u2 1200. _CNV_R_R_i_uw_q0p08_587_CM -200. 1000. FORMAT "%7.2"
 /begin AXIS_DESCR STD_AXIS tbatt7 _CNV_R_R_temp_uw_q0_577_CM 5 -48. 125.3 FORMAT "%6.2" /end AXIS_DESCR
 /begin AXIS_DESCR STD_AXIS NO_INPUT_QUANTITY _CNV_R_R_fak_q0p004_635_CM 5 -100. 100. FORMAT "%7.3" /end AXIS_DESCR
/end CHARACTERISTIC
/begin CHARACTERISTIC KF_IBTSOLL "" MAP 0xffe5b8a8 _REC_MAP_52_UBYTE_u2_u1_u2 1200. _CNV_R_R_i_uw_q0p08_587_CM -200. 1000. FORMAT "%7.2"
 /begin AXIS_DESCR STD_AXIS tbatt7 _CNV_R_R_temp_uw_q0_577_CM 5 -48. 125.3 FORMAT "%6.2" /end AXIS_DESCR
 /begin AXIS_DESCR STD_AXIS NO_INPUT_QUANTITY _CNV_R_R_fak_q0p004_635_CM 5 -100. 100. FORMAT "%7.3" /end AXIS_DESCR
/end CHARACTERISTIC
/begin CHARACTERISTIC KLCF2PWRCF "" CURVE 0xffe5ba74 _REC_CUR_52_UBYTE_u2_u1 65535. _CNV_R_R_dez_550_CM 0. 65535. FORMAT "%8.2"
 /begin AXIS_DESCR STD_AXIS priocf_loc _CNV_R_R_dez_550_CM 4 0. 7. FORMAT "%6.2" /end AXIS_DESCR
/end CHARACTERISTIC
/begin CHARACTERISTIC KLHKWN2 "" CURVE 0xffe5b8ec _REC_CUR_52_UWORD_u2_u2 100. _CNV_R_R_rel_ub_b10_574_CM 0. 100. FORMAT "%8.4"
 /begin AXIS_DESCR STD_AXIS NO_INPUT_QUANTITY _CNV_R_R_nmot_uw_q0_636_CM 10 0. 16383.75 /end AXIS_DESCR
/end CHARACTERISTIC
/begin CHARACTERISTIC KLPRIO2PTC "" CURVE 0xffe5b916 _REC_CUR_52_UWORD_u2_u2 100. _CNV_R_R_fak_uw_q0p_637_CM 0. 100. FORMAT "%9.5"
 /begin AXIS_DESCR STD_AXIS dfallpi _CNV_R_R_fak_uw_q0p_637_CM 5 0. 450. FORMAT "%9.3" /end AXIS_DESCR
/end CHARACTERISTIC
/begin CHARACTERISTIC KLPRIO2PWR "" CURVE 0xffe5ba82 _REC_CUR_52_UBYTE_u2_u1 65535. _CNV_R_R_dez_550_CM 0. 65535. FORMAT "%8.2"
 /begin AXIS_DESCR STD_AXIS priocf_loc _CNV_R_R_dez_550_CM 4 0. 7. FORMAT "%6.2" /end AXIS_DESCR
/end CHARACTERISTIC
/begin CHARACTERISTIC KL_DFPRIO "" CURVE 0xffe5ba90 _REC_CUR_52_UBYTE_u2_u1 200. _CNV_R_R_fak_uw_q0p_637_CM -100. 100. FORMAT "%9.5" /begin AXIS_DESCR STD_AXIS dfpt1filt _CNV_R_R_rel_ub_b10_574_CM 7 0. 100. /end AXIS_DESCR /end CHARACTERISTIC
/begin CHARACTERISTIC KL_DFPTC "" CURVE 0xffe5baa6 _REC_CUR_52_UBYTE_u2_u1 200. _CNV_R_R_fak_uw_q0p_637_CM -100. 100. FORMAT "%9.5" /begin AXIS_DESCR STD_AXIS dfpt1ptc _CNV_R_R_rel_ub_b10_574_CM 7 0. 100. /end AXIS_DESCR /end CHARACTERISTIC
/begin CHARACTERISTIC KL_DSOCPTC "" CURVE 0xffe5b92c _REC_CUR_52_UWORD_u2_u2 300. _CNV_R_R_fak_uw_q0p_637_CM -150. 150. FORMAT "%9.5"
 /begin AXIS_DESCR STD_AXIS NO_INPUT_QUANTITY _CNV_R_R_fak_q0p004_635_CM 9 -100. 100. FORMAT "%7.3" /end AXIS_DESCR
/end CHARACTERISTIC
/begin CHARACTERISTIC KL_I2PTC "" CURVE 0xffe5b952 _REC_CUR_52_UWORD_u2_u2 200. _CNV_R_R_fak_uw_q0p_637_CM -100. 100. FORMAT "%9.5"
 /begin AXIS_DESCR STD_AXIS isolldiff _CNV_R_R_i_uw_q0p08_587_CM 10 -200. 2000. FORMAT "%7.2" /end AXIS_DESCR
/end CHARACTERISTIC
/begin CHARACTERISTIC KL_IREST "" CURVE 0xffe5b97c _REC_CUR_52_UWORD_u2_u2 100. _CNV_R_R_fak_uw_q0p_637_CM -100. 0. FORMAT "%9.5" /begin AXIS_DESCR STD_AXIS pgenrest _CNV_R_R_fak_q0p1_644_CM 10 0. 6400. /end AXIS_DESCR /end CHARACTERISTIC
/begin CHARACTERISTIC KL_ISOLLPR "" CURVE 0xffe5b9a6 _REC_CUR_52_UWORD_u2_u2 200. _CNV_R_R_fak_uw_q0p_637_CM -100. 100. FORMAT "%9.5"
 /begin AXIS_DESCR STD_AXIS ibtdiff _CNV_R_R_i_uw_q0p08_587_CM 10 -200. 2000. FORMAT "%7.2" /end AXIS_DESCR
/end CHARACTERISTIC
/begin CHARACTERISTIC KL_PTC "" CURVE 0xffe5b9d0 _REC_CUR_52_UWORD_u2_u2 127.5 _CNV_R_R_fak_q0p5_639_CM 0. 127.5 FORMAT "%8.4"
 /begin AXIS_DESCR STD_AXIS allptcfilt _CNV_R_R_fak_uw_q0p_637_CM 10 0. 550. FORMAT "%9.3" /end AXIS_DESCR
/end CHARACTERISTIC
/begin CHARACTERISTIC KL_SOCPRIO "" CURVE 0xffe5b9fa _REC_CUR_52_UWORD_u2_u2 300. _CNV_R_R_fak_uw_q0p_637_CM -150. 150. FORMAT "%9.5"
 /begin AXIS_DESCR STD_AXIS NO_INPUT_QUANTITY _CNV_R_R_fak_q0p004_635_CM 9 -100. 100. FORMAT "%7.3" /end AXIS_DESCR
/end CHARACTERISTIC
/begin CHARACTERISTIC KL_UBTPRIO "" CURVE 0xffe5ba20 _REC_CUR_52_UWORD_u2_u2 200. _CNV_R_R_fak_uw_q0p_637_CM -100. 100. FORMAT "%9.5"
 /begin AXIS_DESCR STD_AXIS ubdifffilt _CNV_R_R_spg_q0p977_645_CM 10 -32. 31.999023 FORMAT "%9.4" /end AXIS_DESCR
/end CHARACTERISTIC
/begin CHARACTERISTIC KL_UB_PTC "" CURVE 0xffe5ba4a _REC_CUR_52_UWORD_u2_u2 200. _CNV_R_R_fak_uw_q0p_637_CM -100. 100. FORMAT "%9.5"
 /begin AXIS_DESCR STD_AXIS ubtpt1ptc _CNV_R_R_spg_q0p977_645_CM 10 -32. 31.999023 FORMAT "%9.4" /end AXIS_DESCR
/end CHARACTERISTIC
/begin CHARACTERISTIC KSOGRZAPP "" VALUE 0xffe5bb7a _REC_VAL_20_u1 998.4 _CNV_R_R_i_ub_q5p12_641_CM 0. 998.4 FORMAT "%5.0" /end CHARACTERISTIC
/begin CHARACTERISTIC KSUGRZAPP "" VALUE 0xffe5bb7b _REC_VAL_20_u1 998.4 _CNV_R_R_i_ub_q5p12_641_CM 0. 998.4 FORMAT "%5.0" /end CHARACTERISTIC
/begin CHARACTERISTIC KUBPTC_LP "" VALUE 0xffe5bb54 _REC_VAL_20_u2 0.9999847 _CNV_R_R_fak_uw_b1_649_CM 0. 0.9999847 FORMAT "%9.7" /end CHARACTERISTIC
/begin CHARACTERISTIC K_DF_LP "" VALUE 0xffe5bb7c _REC_VAL_20_u1 0.9961 _CNV_R_R_fak_ub_b1_648_CM 0. 0.9961 FORMAT "%6.4" /end CHARACTERISTIC
/begin CHARACTERISTIC K_PTC_PI "" VALUE 0xffe5bb7d _REC_VAL_20_u1 1. _CNV_R_R_fak_ub_q0p_650_CM 0. 1. FORMAT "%5.3" /end CHARACTERISTIC
/begin CHARACTERISTIC K_PWRCF_PI "" VALUE 0xffe5bb7e _REC_VAL_20_u1 1. _CNV_R_R_fak_ub_q0p_650_CM 0. 1. FORMAT "%5.3" /end CHARACTERISTIC
/begin CHARACTERISTIC K_PWRDF_PI "" VALUE 0xffe5bb7f _REC_VAL_20_u1 1. _CNV_R_R_fak_ub_q0p_650_CM 0. 1. FORMAT "%5.3" /end CHARACTERISTIC
/begin CHARACTERISTIC K_UBAT_LP "" VALUE 0xffe5bb56 _REC_VAL_20_u2 0.9999847 _CNV_R_R_fak_uw_b1_649_CM 0. 0.9999847 FORMAT "%9.7" /end CHARACTERISTIC
/begin CHARACTERISTIC LLPMFILTK "" VALUE 0xffe5bb80 _REC_VAL_20_u1 1. _CNV_R_R_fak_ub_q0p_650_CM 0. 1. FORMAT "%5.3" /end CHARACTERISTIC
/begin CHARACTERISTIC MN_PRICFPI "" VALUE 0xffe5bb81 _REC_VAL_20_u1 150. _CNV_R_R_fak_ub_q5p_651_CM 0. 150. FORMAT "%7.3" /end CHARACTERISTIC
/begin CHARACTERISTIC MN_PTC_PI "" VALUE 0xffe5bb82 _REC_VAL_20_u1 450. _CNV_R_R_fak_ub_q5p_651_CM 0. 450. FORMAT "%7.3" /end CHARACTERISTIC
/begin CHARACTERISTIC MN_PWRDFPI "" VALUE 0xffe5bb83 _REC_VAL_20_u1 450. _CNV_R_R_fak_ub_q5p_651_CM 0. 450. FORMAT "%7.3" /end CHARACTERISTIC
/begin CHARACTERISTIC MX_PRICFPI "" VALUE 0xffe5bb84 _REC_VAL_20_u1 150. _CNV_R_R_fak_ub_q5p_651_CM 0. 150. FORMAT "%7.3" /end CHARACTERISTIC
/begin CHARACTERISTIC MX_PTC_PI "" VALUE 0xffe5bb85 _REC_VAL_20_u1 450. _CNV_R_R_fak_ub_q5p_651_CM 0. 450. FORMAT "%7.3" /end CHARACTERISTIC
/begin CHARACTERISTIC MX_PWRDFPI "" VALUE 0xffe5bb86 _REC_VAL_20_u1 450. _CNV_R_R_fak_ub_q5p_651_CM 0. 450. FORMAT "%7.3" /end CHARACTERISTIC
/begin CHARACTERISTIC PCOSCHGAPP "" VALUE 0xffe5bb87 _REC_VAL_20_u1 255. _CNV_R_R_dez_550_CM 0. 255. FORMAT "%5.1" /end CHARACTERISTIC
/begin CHARACTERISTIC PRIOCFAPP "" VALUE 0xffe5bb88 _REC_VAL_20_u1 7. _CNV_R_R_dez_550_CM 0. 7. FORMAT "%5.3" /end CHARACTERISTIC
/begin CHARACTERISTIC PTCPWRAPP "" VALUE 0xffe5bb89 _REC_VAL_20_u1 127.5 _CNV_R_R_fak_q0p5_639_CM 0. 127.5 FORMAT "%5.1" /end CHARACTERISTIC
/begin CHARACTERISTIC PWRCOSAPP "" VALUE 0xffe5bb58 _REC_VAL_20_u2 65535. _CNV_R_R_dez_550_CM 0. 65535. FORMAT "%8.2" /end CHARACTERISTIC
/begin CHARACTERISTIC PWRSPCSAPP "" VALUE 0xffe5bb8a _REC_VAL_20_u1 127.5 _CNV_R_R_fak_q0p5_639_CM 0. 127.5 FORMAT "%5.1" /end CHARACTERISTIC
/begin CHARACTERISTIC RQPCOSAPP "" VALUE 0xffe5bb8b _REC_VAL_20_u1 3. _CNV_R_R_dez_550_CM 0. 3. FORMAT "%5.3" /end CHARACTERISTIC
/begin CHARACTERISTIC SELSPCSAPP "" VALUE 0xffe5bb8c _REC_VAL_20_u1 15. _CNV_R_R_dez_550_CM 0. 15. FORMAT "%5.2" /end CHARACTERISTIC
/begin CHARACTERISTIC STPCOSAPP "" VALUE 0xffe5bb8d _REC_VAL_20_u1 3. _CNV_R_R_dez_550_CM 0. 3. FORMAT "%5.3" /end CHARACTERISTIC
/begin CHARACTERISTIC S_B_SOCNPL "" VALUE 0xffe5bb8e _REC_VAL_20_u1 255. _CNV_R_R_dez_550_CM 0. 255. FORMAT "%5.1" /end CHARACTERISTIC
/begin CHARACTERISTIC S_DFFGEN "" VALUE 0xffe5bb8f _REC_VAL_20_u1 255. _CNV_R_R_dez_550_CM 0. 255. FORMAT "%5.1" /end CHARACTERISTIC
/begin CHARACTERISTIC S_DF_FILT "" VALUE 0xffe5bb90 _REC_VAL_20_u1 255. _CNV_R_R_dez_550_CM 0. 255. FORMAT "%5.1" /end CHARACTERISTIC
/begin CHARACTERISTIC S_DME2IBS "" VALUE 0xffe5bb91 _REC_VAL_20_u1 255. _CNV_R_R_dez_550_CM 0. 255. FORMAT "%5.1" /end CHARACTERISTIC
/begin CHARACTERISTIC S_E65PRIO "" VALUE 0xffe5bb92 _REC_VAL_20_u1 255. _CNV_R_R_dez_550_CM 0. 255. FORMAT "%5.1" /end CHARACTERISTIC
/begin CHARACTERISTIC S_IBATTW "" VALUE 0xffe5bb93 _REC_VAL_20_u1 255. _CNV_R_R_dez_550_CM 0. 255. FORMAT "%5.1" /end CHARACTERISTIC
/begin CHARACTERISTIC S_IBSAKT7 "" VALUE 0xffe5bb94 _REC_VAL_20_u1 255. _CNV_R_R_dez_550_CM 0. 255. FORMAT "%5.1" /end CHARACTERISTIC
/begin CHARACTERISTIC S_IFBSAK7 "" VALUE 0xffe5bb95 _REC_VAL_20_u1 255. _CNV_R_R_dez_550_CM 0. 255. FORMAT "%5.1" /end CHARACTERISTIC
/begin CHARACTERISTIC S_IFUPLAK7 "" VALUE 0xffe5bb96 _REC_VAL_20_u1 255. _CNV_R_R_dez_550_CM 0. 255. FORMAT "%5.1" /end CHARACTERISTIC
/begin CHARACTERISTIC S_PCOSCHG "" VALUE 0xffe5bb97 _REC_VAL_20_u1 255. _CNV_R_R_dez_550_CM 0. 255. FORMAT "%5.1" /end CHARACTERISTIC
/begin CHARACTERISTIC S_PRIO_E60 "" VALUE 0xffe5bb98 _REC_VAL_20_u1 255. _CNV_R_R_dez_550_CM 0. 255. FORMAT "%5.1" /end CHARACTERISTIC
/begin CHARACTERISTIC S_PRIO_E65 "" VALUE 0xffe5bb99 _REC_VAL_20_u1 255. _CNV_R_R_dez_550_CM 0. 255. FORMAT "%5.1" /end CHARACTERISTIC
/begin CHARACTERISTIC S_PTCOLMAN "" VALUE 0xffe5bb9a _REC_VAL_20_u1 255. _CNV_R_R_dez_550_CM 0. 255. FORMAT "%5.1" /end CHARACTERISTIC
/begin CHARACTERISTIC S_PTC_OLD "" VALUE 0xffe5bb9b _REC_VAL_20_u1 255. _CNV_R_R_dez_550_CM 0. 255. FORMAT "%5.1" /end CHARACTERISTIC
/begin CHARACTERISTIC S_TBATT "" VALUE 0xffe5bb9c _REC_VAL_20_u1 255. _CNV_R_R_dez_550_CM 0. 255. FORMAT "%5.1" /end CHARACTERISTIC
/begin CHARACTERISTIC S_UBATTAPP "" VALUE 0xffe5bb9d _REC_VAL_20_u1 255. _CNV_R_R_dez_550_CM 0. 255. FORMAT "%5.1" /end CHARACTERISTIC
/begin CHARACTERISTIC TBATT_APP "" VALUE 0xffe5bb9e _REC_VAL_20_u1 173.3 _CNV_R_R_temp_uw_q0_577_CM -48. 125.3 FORMAT "%5.1" /end CHARACTERISTIC
/begin CHARACTERISTIC t_pmbs "" VALUE 0xffe5bb9f _REC_VAL_20_u1 255. _CNV_R_R_dez_550_CM 0. 255. DISPLAY_IDENTIFIER T_PMBS FORMAT "%5.1" /end CHARACTERISTIC
/begin CHARACTERISTIC t_pmvs "" VALUE 0xffe5bba0 _REC_VAL_20_u1 255. _CNV_R_R_dez_550_CM 0. 255. DISPLAY_IDENTIFIER T_PMVS FORMAT "%5.1" /end CHARACTERISTIC
/begin CHARACTERISTIC T_PRIODFPI "" VALUE 0xffe5bba1 _REC_VAL_20_u1 25.4 _CNV_R_R_fak_q0p1_644_CM 0.1 25.5 FORMAT "%5.2" /end CHARACTERISTIC
/begin CHARACTERISTIC T_PTC_PI "" VALUE 0xffe5bba2 _REC_VAL_20_u1 25.4 _CNV_R_R_fak_q0p1_644_CM 0.1 25.5 FORMAT "%5.2" /end CHARACTERISTIC
/begin CHARACTERISTIC T_PWRDF_PI "" VALUE 0xffe5bba3 _REC_VAL_20_u1 25.4 _CNV_R_R_fak_q0p1_644_CM 0.1 25.5 FORMAT "%5.2" /end CHARACTERISTIC
/begin CHARACTERISTIC UBATTW_APP "" VALUE 0xffe5bb5a _REC_VAL_20_u2 10. _CNV_R_R_spg_uw_q0p_591_CM 6. 16. FORMAT "%9.6" /end CHARACTERISTIC
/begin CHARACTERISTIC UBTAPP "" VALUE 0xffe5bb5c _REC_VAL_20_u2 61.425 _CNV_R_R_spg_uw_q0p_646_CM 0. 61.425 FORMAT "%9.6" /end CHARACTERISTIC
/begin CHARACTERISTIC UBTLOWMAX "" VALUE 0xffe5bb5e _REC_VAL_20_u2 10. _CNV_R_R_spg_uw_q0p_591_CM 6. 16. FORMAT "%9.6" /end CHARACTERISTIC
/begin CHARACTERISTIC UBTLOWMIN "" VALUE 0xffe5bb60 _REC_VAL_20_u2 10. _CNV_R_R_spg_uw_q0p_591_CM 6. 16. FORMAT "%9.6" /end CHARACTERISTIC
/begin CHARACTERISTIC ULEVAPP "" VALUE 0xffe5bba4 _REC_VAL_20_u1 15. _CNV_R_R_dez_550_CM 0. 15. FORMAT "%5.2" /end CHARACTERISTIC
/begin CHARACTERISTIC ULOWSETAPP "" VALUE 0xffe5bba5 _REC_VAL_20_u1 25.5 _CNV_R_R_t_q0p1_642_CM 0. 25.5 FORMAT "%5.2" /end CHARACTERISTIC
/begin CHARACTERISTIC WAKEGRZAPP "" VALUE 0xffe5bba6 _REC_VAL_20_u1 5.1 _CNV_R_R_i_ub_q0p02_589_CM 0. 5.1 FORMAT "%7.5" /end CHARACTERISTIC
/begin CHARACTERISTIC WGH_PRIO "" VAL_BLK 0xffe5bae6 _REC_VAL_2_u2 450.25 _CNV_R_R_fak_uw_q0p_637_CM 0. 450.25 FORMAT "%9.5" NUMBER 7 /end CHARACTERISTIC
/begin CHARACTERISTIC WGH_PRIOCF "" VAL_BLK 0xffe5baf4 _REC_VAL_2_u2 150.25 _CNV_R_R_fak_uw_q0p_637_CM 0. 150.25 FORMAT "%9.5" NUMBER 7 /end CHARACTERISTIC
/begin CHARACTERISTIC WGH_PWRCF "" VAL_BLK 0xffe5bb02 _REC_VAL_2_s2 150.25 _CNV_R_R_fak_uw_q0p_637_CM 0. 150.25 FORMAT "%9.5" NUMBER 7 /end CHARACTERISTIC
/begin CHARACTERISTIC WGH_PWRDF "" VAL_BLK 0xffe5bb10 _REC_VAL_2_u2 450.25 _CNV_R_R_fak_uw_q0p_637_CM 0. 450.25 FORMAT "%9.5" NUMBER 14 /end CHARACTERISTIC
/begin CHARACTERISTIC DSOCPCOS "" VALUE 0xffe5bb3c _REC_VAL_20_u2 200. _CNV_R_R_fak_q0p004_635_CM -100. 100. FORMAT "%7.3" /end CHARACTERISTIC
/begin CHARACTERISTIC DSOCHYST "" VALUE 0xffe5bb3a _REC_VAL_20_u2 200. _CNV_R_R_fak_q0p004_635_CM -100. 100. FORMAT "%7.3" /end CHARACTERISTIC
/begin CHARACTERISTIC DFMIN "" VALUE 0xffe5bb6b _REC_VAL_20_u1 100. _CNV_R_R_rel_ub_b10_574_CM 0. 100. FORMAT "%5.1" /end CHARACTERISTIC
/begin CHARACTERISTIC DFMAX "" VALUE 0xffe5bb6a _REC_VAL_20_u1 100. _CNV_R_R_rel_ub_b10_574_CM 0. 100. FORMAT "%5.1" /end CHARACTERISTIC
/begin MEASUREMENT pm_rishow "Innenwiderstand der Batterie aus der Fitberechnung" UBYTE _CNV_R_R_r_q0p1em3_652_CM 1 100. 0. 0.255 DISPLAY_IDENTIFIER PM_RISHOW ECU_ADDRESS 0x3fac78 FORMAT "%8.4" /end MEASUREMENT
/begin MEASUREMENT pm_socfit3 "SoC Filtereingangswert " UWORD _CNV_R_R_rel_uw_b10_575_CM 1 100. 0. 99.998474 DISPLAY_IDENTIFIER PM_SOCFIT3 ECU_ADDRESS 0x3fac76 BYTE_ORDER MSB_LAST FORMAT "%8.4" /end MEASUREMENT
/begin MEASUREMENT pm_ubatts "Hilfswert Spannung aus Fitberechnung" UWORD _CNV_R_R_spg_uw_q0p_591_CM 1 100. 6. 16. DISPLAY_IDENTIFIER PM_UBATTS ECU_ADDRESS 0x3fa47c BYTE_ORDER MSB_LAST FORMAT "%8.4" /end MEASUREMENT
/begin MEASUREMENT soc_fit "SoC aus der Fitformel" UWORD _CNV_R_R_rel_uw_b10_575_CM 1 100. 0. 99.998474 DISPLAY_IDENTIFIER SOC_FIT ECU_ADDRESS 0x3facd4 BYTE_ORDER MSB_LAST FORMAT "%8.4" /end MEASUREMENT
/begin MEASUREMENT ubatts2 "Hilfswert2 Spannung aus Fitberechnung" UWORD _CNV_R_R_spg_uw_q0p_591_CM 1 100. 6. 16. DISPLAY_IDENTIFIER UBATTS2 ECU_ADDRESS 0x3fa47e BYTE_ORDER MSB_LAST FORMAT "%8.4" /end MEASUREMENT
/begin CHARACTERISTIC KFPMRIBATT "Kennfeld Innenwiderstand Batterie" MAP 0xffe5bc3a _REC_MAP_52_UBYTE_u1_u1_u2 0. _CNV_R_R_r_q0p1em3_652_CM 0. 0.255 FORMAT "%8.4"
 /begin AXIS_DESCR STD_AXIS NO_INPUT_QUANTITY _CNV_R_R_temp_ub_q0_549_CM 4 -48. 143.25 FORMAT "%8.4" /end AXIS_DESCR
 /begin AXIS_DESCR STD_AXIS NO_INPUT_QUANTITY _CNV_R_R_i_uw_q0p08_587_CM 6 -200. 1000. FORMAT "%8.4" /end AXIS_DESCR
/end CHARACTERISTIC
/begin CHARACTERISTIC KLPMSOCVU "SoC-Wert aus der Fitberechnung" CURVE 0xffe5bc64 _REC_CUR_52_UWORD_u2_u2 0. _CNV_R_R_rel_uw_b10_575_CM 0. 99.998474 FORMAT "%8.4"
 /begin AXIS_DESCR STD_AXIS NO_INPUT_QUANTITY _CNV_R_R_spg_uw_q0p_591_CM 3 6. 16. FORMAT "%8.4" /end AXIS_DESCR
/end CHARACTERISTIC
/begin CHARACTERISTIC S_PMSOCFIT "Schalter zur Applikation SoC aus der Fitberechnung" VALUE 0xffe5bc76 _REC_VAL_20_u1 0. _CNV_R_R_dez_550_CM 0. 255. FORMAT "%8.4" /end CHARACTERISTIC
/begin CHARACTERISTIC SOCFITAPP "Applikationwert Soc aus der Fitberechnung" VALUE 0xffe5bc72 _REC_VAL_20_u2 0. _CNV_R_R_rel_uw_b10_575_CM 0. 99.998474 FORMAT "%8.4" /end CHARACTERISTIC
/begin CHARACTERISTIC ZK_PMSOC "Zeitfaktor" VALUE 0xffe5bc74 _REC_VAL_20_u2 0. _CNV_R_R_fak_uw_b1_649_CM 0. 0.99998474 FORMAT "%8.4" /end CHARACTERISTIC
/begin MEASUREMENT absch_korr "Korrekturwert Abschaltung" UWORD _CNV_R_R_fak_q0p004_635_CM 1 100. -40. 40. DISPLAY_IDENTIFIER ABSCH_KORR ECU_ADDRESS 0x3facd8 BYTE_ORDER MSB_LAST FORMAT "%8.4" /end MEASUREMENT
/begin MEASUREMENT B_abschfit "Bedingung Korrektur Startfähigkeitsgrenze durchgeführt" UBYTE _CNV_A_R_LINEAR_____22_CM 1 100. 0. 255. DISPLAY_IDENTIFIER B_ABSCHFIT ECU_ADDRESS 0x3fac7a BIT_MASK 0x1 /end MEASUREMENT
/begin MEASUREMENT B_pm_fit2 "Bedingung Hilfsvariable Fit 2" UBYTE _CNV_A_R_LINEAR_____22_CM 1 100. 0. 255. DISPLAY_IDENTIFIER B_PM_FIT2 ECU_ADDRESS 0x3fac7c BIT_MASK 0x1 /end MEASUREMENT
/begin MEASUREMENT B_pm_fit3 "Bedingung Hilfsvariable Fit 3" UBYTE _CNV_A_R_LINEAR_____22_CM 1 100. 0. 255. DISPLAY_IDENTIFIER B_PM_FIT3 ECU_ADDRESS 0x3fac7d BIT_MASK 0x1 /end MEASUREMENT
/begin MEASUREMENT B_pmsocini "wird beim INIT wahr um den Timer zurückzusetzen" UBYTE _CNV_A_R_LINEAR_____22_CM 1 100. 0. 255. DISPLAY_IDENTIFIER B_PMSOCINI ECU_ADDRESS 0x3fac7b BIT_MASK 0x1 /end MEASUREMENT
/begin MEASUREMENT B_q_start "Bedingung Startqualität vollständig berechnet" UBYTE _CNV_A_R_LINEAR_____22_CM 1 100. 0. 255. DISPLAY_IDENTIFIER B_Q_START ECU_ADDRESS 0x3fac7e BIT_MASK 0x1 /end MEASUREMENT
/begin MEASUREMENT B_soc_npl "Bedingung SoC-Wert nicht plausibel" UBYTE _CNV_A_R_LINEAR_____22_CM 1 100. 0. 255. DISPLAY_IDENTIFIER B_SOC_NPL ECU_ADDRESS 0x3fac7f BIT_MASK 0x1 /end MEASUREMENT
/begin MEASUREMENT d_soc "Abstand zur Startfähigkeitsgrenze" UWORD _CNV_R_R_fak_q0p004_635_CM 1 100. -100. 100. DISPLAY_IDENTIFIER D_SOC ECU_ADDRESS 0x3facda BYTE_ORDER MSB_LAST FORMAT "%8.4" /end MEASUREMENT
/begin MEASUREMENT d_socw "Delta SoC" UWORD _CNV_R_R_fak_q0p004_635_CM 1 100. -100. 100. DISPLAY_IDENTIFIER D_SOCW ECU_ADDRESS 0x3fac82 BYTE_ORDER MSB_LAST FORMAT "%8.4" /end MEASUREMENT
/begin MEASUREMENT d_socw_1 "Delta SoC" UWORD _CNV_R_R_rel_uw_b10_653_CM 1 100. 0. 99.998474 DISPLAY_IDENTIFIER D_SOCW_1 ECU_ADDRESS 0x3fac84 BYTE_ORDER MSB_LAST FORMAT "%8.4" /end MEASUREMENT
/begin MEASUREMENT pm_ibslog "" UBYTE _CNV_A_R_LINEAR_____22_CM 1 100. 0. 255. DISPLAY_IDENTIFIER PM_IBSLOG ECU_ADDRESS 0x3fac80 BIT_MASK 0x1 /end MEASUREMENT
/begin MEASUREMENT pm_tsrdy "Status Berechnung Tsaison" UBYTE _CNV_A_R_LINEAR_____22_CM 1 100. 0. 255. DISPLAY_IDENTIFIER PM_TSRDY ECU_ADDRESS 0x3facd6 BIT_MASK 0x1 /end MEASUREMENT
/begin MEASUREMENT pmsoc_help "Hilfsvariable für SoC aus der Startfähigkeitsberechnung" UWORD _CNV_R_R_fak_q0p002_654_CM 1 100. 0. 100. DISPLAY_IDENTIFIER PMSOC_HELP ECU_ADDRESS 0x3fac86 BYTE_ORDER MSB_LAST FORMAT "%8.4" /end MEASUREMENT
/begin MEASUREMENT q_startfgk "Abstand zur Startfähigkeitsgrenze" UWORD _CNV_R_R_qlad_uw_q0_590_CM 1 100. 0. 1193.0283 DISPLAY_IDENTIFIER Q_STARTFGK ECU_ADDRESS 0x3facdc BYTE_ORDER MSB_LAST FORMAT "%8.4" /end MEASUREMENT
/begin MEASUREMENT soc_korr "Korrekturwert soc_bila" UWORD _CNV_R_R_fak_q0p004_635_CM 1 100. -100. 100. DISPLAY_IDENTIFIER SOC_KORR ECU_ADDRESS 0x3facde BYTE_ORDER MSB_LAST FORMAT "%8.4" /end MEASUREMENT
/begin MEASUREMENT soc_q_kor "Korrekturwert Genauigkeit Ladezustandsbestimmung" UWORD _CNV_R_R_qlad_uw_q0_590_CM 1 100. 0. 1193.0283 DISPLAY_IDENTIFIER SOC_Q_KOR ECU_ADDRESS 0x3face0 BYTE_ORDER MSB_LAST FORMAT "%8.4" /end MEASUREMENT
/begin MEASUREMENT soc_rel "Relativzähler für Ladezustand SoC" UWORD _CNV_R_R_rel_uw_b10_653_CM 1 100. 0. 99.998474 DISPLAY_IDENTIFIER SOC_REL ECU_ADDRESS 0x3face2 BYTE_ORDER MSB_LAST FORMAT "%8.4" /end MEASUREMENT
/begin MEASUREMENT soc_stfgk "Startfähigkeitsgrenze" UWORD _CNV_R_R_rel_uw_b10_653_CM 1 100. 0. 99.998474 DISPLAY_IDENTIFIER SOC_STFGK ECU_ADDRESS 0x3face4 BYTE_ORDER MSB_LAST FORMAT "%8.4" /end MEASUREMENT
/begin MEASUREMENT soc_stfgkw "SoC Startfähigkeit" UWORD _CNV_R_R_rel_uw_b10_653_CM 1 100. 0. 99.998474 DISPLAY_IDENTIFIER SOC_STFGKW ECU_ADDRESS 0x3fac88 BYTE_ORDER MSB_LAST FORMAT "%8.4" /end MEASUREMENT
/begin MEASUREMENT t_saison "Saison -Temperatur" UWORD _CNV_R_R_temp_uw_q0_655_CM 1 100. -48. 148.605 DISPLAY_IDENTIFIER T_SAISON ECU_ADDRESS 0x3face6 BYTE_ORDER MSB_LAST FORMAT "%8.4" /end MEASUREMENT
/begin MEASUREMENT tsaisonalt "letzter Wert Saisontemperatur" UWORD _CNV_R_R_temp_uw_q0_655_CM 1 100. -48. 148.605 DISPLAY_IDENTIFIER TSAISONALT ECU_ADDRESS 0x3fac8a BYTE_ORDER MSB_LAST FORMAT "%8.4" /end MEASUREMENT
/begin CHARACTERISTIC ABSCHKORA "Applikationswert für Korrektur Abschaltung" VALUE 0xffe5bc8a _REC_VAL_20_u2 0. _CNV_R_R_fak_q0p004_635_CM -100. 100. FORMAT "%8.4" /end CHARACTERISTIC
/begin CHARACTERISTIC D_AB_KORR1 "Korrekturkonstante 1 für Abschaltung" VALUE 0xffe5bc90 _REC_VAL_20_u2 0. _CNV_R_R_fak_q0p004_635_CM -100. 100. FORMAT "%8.4" /end CHARACTERISTIC
/begin CHARACTERISTIC D_AB_KORR2 "Korrekturkonstante 2 für Abschaltung" VALUE 0xffe5bc92 _REC_VAL_20_u2 0. _CNV_R_R_fak_q0p004_635_CM -100. 100. FORMAT "%8.4" /end CHARACTERISTIC
/begin CHARACTERISTIC D_AB_KORR3 "Korrekturkonstante 3 für Abschaltung" VALUE 0xffe5bc94 _REC_VAL_20_u2 0. _CNV_R_R_fak_q0p004_635_CM -100. 100. FORMAT "%8.4" /end CHARACTERISTIC
/begin CHARACTERISTIC DSOCA "Applikationsgrösse für d_soc" VALUE 0xffe5bc8c _REC_VAL_20_u2 0. _CNV_R_R_fak_q0p004_635_CM -100. 100. FORMAT "%8.4" /end CHARACTERISTIC
/begin CHARACTERISTIC DSOCABSCH "Applikationsgrösse für d_soc" VALUE 0xffe5bc8e _REC_VAL_20_u2 0. _CNV_R_R_fak_q0p004_635_CM -100. 100. FORMAT "%8.4" /end CHARACTERISTIC
/begin CHARACTERISTIC I_FIT_AUSW "Grenzwert für die Auswertung des Batteriestromes" VALUE 0xffe5bc96 _REC_VAL_20_u2 0. _CNV_R_R_i_uw_q0p08_587_CM -200. 1000. FORMAT "%8.4" /end CHARACTERISTIC
/begin CHARACTERISTIC KL_SSOC "soc_s in Abh. von tsaison" CURVE 0xffe5bc78 _REC_CUR_52_UWORD_u2_u2 0. _CNV_R_R_fak_q0p002_654_CM 0. 100. FORMAT "%8.4"
 /begin AXIS_DESCR STD_AXIS t_saison _CNV_R_R_temp_uw_q0_655_CM 4 -48. 148.605 FORMAT "%8.4" /end AXIS_DESCR
/end CHARACTERISTIC
/begin CHARACTERISTIC PM_TABSMN "Applikationsgrösse für Abstellzeit tabsmn_w" VALUE 0xffe5bc98 _REC_VAL_20_u2 0. _CNV_R_R_dez_550_CM 0. 65535. FORMAT "%8.4" /end CHARACTERISTIC
/begin CHARACTERISTIC PMTIMERSQ1 "Startwert Timer für soc_quali" VALUE 0xffe5bca6 _REC_VAL_20_u1 0. _CNV_R_R_t6minxmin__656_CM 0. 1530. FORMAT "%8.4" /end CHARACTERISTIC
/begin CHARACTERISTIC QSOCCL3 "Grenze zur Ladezustandsqualitätsklasse3" VALUE 0xffe5bc9a _REC_VAL_20_u2 0. _CNV_R_R_qlad_uw_q0_590_CM 0. 1193.0283 FORMAT "%8.4" /end CHARACTERISTIC
/begin CHARACTERISTIC QSTARTFGA "Applikationswert für q_startfgk" VALUE 0xffe5bc9c _REC_VAL_20_u2 0. _CNV_R_R_qlad_uw_q0_590_CM 0. 1193.0283 FORMAT "%8.4" /end CHARACTERISTIC
/begin CHARACTERISTIC S_ABSCHK "Schalter für Applikationswert absch_korr" VALUE 0xffe5bca7 _REC_VAL_20_u1 0. _CNV_R_R_dez_550_CM 0. 255. FORMAT "%8.4" /end CHARACTERISTIC
/begin CHARACTERISTIC S_DSOCS "Schalter für Applikationswert Delta SoC" VALUE 0xffe5bca8 _REC_VAL_20_u1 0. _CNV_R_R_dez_550_CM 0. 255. FORMAT "%8.4" /end CHARACTERISTIC
/begin CHARACTERISTIC S_PMTABSMN "Schalter für Applikation der Abstellzeit tabsmn_w" VALUE 0xffe5bca9 _REC_VAL_20_u1 0. _CNV_R_R_dez_550_CM 0. 255. FORMAT "%8.4" /end CHARACTERISTIC
/begin CHARACTERISTIC S_QSTARTFK "Schalter für Applikation q_startfgk" VALUE 0xffe5bcaa _REC_VAL_20_u1 0. _CNV_R_R_dez_550_CM 0. 255. FORMAT "%8.4" /end CHARACTERISTIC
/begin CHARACTERISTIC S_SOCSTAFK "Schalter für Applikation SoC aus der Startfähigkeit" VALUE 0xffe5bcab _REC_VAL_20_u1 0. _CNV_R_R_dez_550_CM 0. 255. FORMAT "%8.4" /end CHARACTERISTIC
/begin CHARACTERISTIC SOC_STAFGA "Applikationswert für SoC aus der Startfähigkeit" VALUE 0xffe5bca2 _REC_VAL_20_u2 0. _CNV_R_R_rel_uw_b10_653_CM 0. 99.998474 FORMAT "%8.4" /end CHARACTERISTIC
/begin CHARACTERISTIC SOCFITABW "Applikationskonstante zur Abwertung SoC aus der Fitberechnung" VALUE 0xffe5bc9e _REC_VAL_20_u2 0. _CNV_R_R_rel_uw_b10_653_CM 0. 99.998474 FORMAT "%8.4" /end CHARACTERISTIC
/begin CHARACTERISTIC SOCFITGRZ "Grenzwert für soc_fit" VALUE 0xffe5bca0 _REC_VAL_20_u2 0. _CNV_R_R_rel_uw_b10_653_CM 0. 99.998474 FORMAT "%8.4" /end CHARACTERISTIC
/begin CHARACTERISTIC TSAISONFIL "Filterkonstante für t_saison" VALUE 0xffe5bca4 _REC_VAL_20_u2 0. _CNV_R_R_dez_550_CM 1. 65535. FORMAT "%8.4" /end CHARACTERISTIC
/begin MEASUREMENT B_pm_aux10 "Bedingung Hilfsgrösse 2 f Grenze Innenwiderstand Batterie" UBYTE _CNV_A_R_LINEAR_____22_CM 1 100. 0. 255. DISPLAY_IDENTIFIER B_PM_AUX10 ECU_ADDRESS 0x3fac8e BIT_MASK 0x1 /end MEASUREMENT
/begin MEASUREMENT B_pm_aux11 "Bedingung Hilfsgrösse 3 f. Inenewiderstand" UBYTE _CNV_A_R_LINEAR_____22_CM 1 100. 0. 255. DISPLAY_IDENTIFIER B_PM_AUX11 ECU_ADDRESS 0x3fac8f BIT_MASK 0x1 /end MEASUREMENT
/begin MEASUREMENT B_pm_aux2 "Bedingung Hilfsgrösse2 RS_NMOT1 und B_pmsqrdy" UBYTE _CNV_A_R_LINEAR_____22_CM 1 100. 0. 255. DISPLAY_IDENTIFIER B_PM_AUX2 ECU_ADDRESS 0x3fac90 BIT_MASK 0x1 /end MEASUREMENT
/begin MEASUREMENT B_pm_aux3 "Bedingung Hilfsgrösse RS_START" UBYTE _CNV_A_R_LINEAR_____22_CM 1 100. 0. 255. DISPLAY_IDENTIFIER B_PM_AUX3 ECU_ADDRESS 0x3fac91 BIT_MASK 0x1 /end MEASUREMENT
/begin MEASUREMENT B_pm_aux4 "Bedingung Hilfsgrösse für RS_NMOT2" UBYTE _CNV_A_R_LINEAR_____22_CM 1 100. 0. 255. DISPLAY_IDENTIFIER B_PM_AUX4 ECU_ADDRESS 0x3fac92 BIT_MASK 0x1 /end MEASUREMENT
/begin MEASUREMENT B_pm_aux8 "Bedingung Hilfsgrösse 4 f. Innenwiderstand" UBYTE _CNV_A_R_LINEAR_____22_CM 1 100. 0. 255. DISPLAY_IDENTIFIER B_PM_AUX8 ECU_ADDRESS 0x3fac93 BIT_MASK 0x1 /end MEASUREMENT
/begin MEASUREMENT B_pm_aux9 "Bedingung Hilfsgrösse 1 f. Innenwiderstand Batterie" UBYTE _CNV_A_R_LINEAR_____22_CM 1 100. 0. 255. DISPLAY_IDENTIFIER B_PM_AUX9 ECU_ADDRESS 0x3fac94 BIT_MASK 0x1 /end MEASUREMENT
/begin MEASUREMENT B_pmaux1 "Bedingung Hilfsgrösse RS_NMOT1" UBYTE _CNV_A_R_LINEAR_____22_CM 1 100. 0. 255. DISPLAY_IDENTIFIER B_PMAUX1 ECU_ADDRESS 0x3fac8c BIT_MASK 0x1 /end MEASUREMENT
/begin MEASUREMENT B_pmaux5 "Bedingung Hilfsgrösse Motor steht" UBYTE _CNV_A_R_LINEAR_____22_CM 1 100. 0. 255. DISPLAY_IDENTIFIER B_PMAUX5 ECU_ADDRESS 0x3fac8d BIT_MASK 0x1 /end MEASUREMENT
/begin MEASUREMENT B_pmsqrdy "Bedingung Berechnung Startqualität fertig" UBYTE _CNV_A_R_LINEAR_____22_CM 1 100. 0. 255. DISPLAY_IDENTIFIER B_PMSQRDY ECU_ADDRESS 0x3face8 BIT_MASK 0x1 /end MEASUREMENT
/begin MEASUREMENT B_pmstartq "Bedingung Startqualität" UBYTE _CNV_A_R_LINEAR_____22_CM 1 100. 0. 255. DISPLAY_IDENTIFIER B_PMSTARTQ ECU_ADDRESS 0x3face9 BIT_MASK 0x1 /end MEASUREMENT
/begin MEASUREMENT B_resetsta "Bedingung Reset Startauswertung" UBYTE _CNV_A_R_LINEAR_____22_CM 1 100. 0. 255. DISPLAY_IDENTIFIER B_RESETSTA ECU_ADDRESS 0x3fac95 BIT_MASK 0x1 /end MEASUREMENT
/begin MEASUREMENT idelta "Differenz der Startströme" UWORD _CNV_R_R_i_ub_q0p02_589_CM 1 100. 2.e-002 1000. DISPLAY_IDENTIFIER IDELTA ECU_ADDRESS 0x3fa480 BYTE_ORDER MSB_LAST FORMAT "%8.4" /end MEASUREMENT
/begin MEASUREMENT nnstartb "Motordrehzahl nach Motorstart als Byte" UBYTE _CNV_R_R_nmot_ub_q1_657_CM 1 100. 0. 2550. DISPLAY_IDENTIFIER NNSTARTB ECU_ADDRESS 0x3fa482 FORMAT "%8.4" /end MEASUREMENT
/begin MEASUREMENT pmstartsta "Schalter für Ablaufsteuerung" UBYTE _CNV_R_R_dez_550_CM 1 100. 0. 255. DISPLAY_IDENTIFIER PMSTARTSTA ECU_ADDRESS 0x3fa483 FORMAT "%8.4" /end MEASUREMENT
/begin MEASUREMENT rin_start "Innenwiderstand Batterie beim Start" UBYTE _CNV_R_R_r_q0p125_658_CM 1 100. 0. 31.875 DISPLAY_IDENTIFIER RIN_START ECU_ADDRESS 0x3fa484 FORMAT "%8.4" /end MEASUREMENT
/begin MEASUREMENT status "" UBYTE _CNV_A_R_LINEAR_____22_CM 1 100. 0. 255. DISPLAY_IDENTIFIER STATUS ECU_ADDRESS 0x3fe440 BIT_MASK 0x1 /end MEASUREMENT
/begin MEASUREMENT u_grenz "Grenzwert Spannung" UBYTE _CNV_R_R_spg_ub_q0p_659_CM 1 100. 6. 22.32 DISPLAY_IDENTIFIER U_GRENZ ECU_ADDRESS 0x3fa485 FORMAT "%8.4" /end MEASUREMENT
/begin CHARACTERISTIC KLUNSTART "Startspannung abhängig v.Motordrehzahl" CURVE 0xffe5bcac _REC_CUR_52_UBYTE_u1_u1 0. _CNV_R_R_spg_ub_q0p_659_CM 6. 22.32 FORMAT "%8.4"
 /begin AXIS_DESCR STD_AXIS NO_INPUT_QUANTITY _CNV_R_R_nmot_ub_q1_657_CM 2 0. 2550. FORMAT "%8.4" /end AXIS_DESCR
/end CHARACTERISTIC
/begin CHARACTERISTIC KLUTSTART "Startspannung in Abhängigkeit von Temperatur Batterie" CURVE 0xffe5bcb1 _REC_CUR_52_UBYTE_s1_u1 0. _CNV_R_R_spg_q0p064_660_CM -8.128 8.128 FORMAT "%8.4"
 /begin AXIS_DESCR STD_AXIS NO_INPUT_QUANTITY _CNV_R_R_temp_ub_q0_549_CM 3 -48. 143.25 FORMAT "%8.4" /end AXIS_DESCR
/end CHARACTERISTIC
/begin CHARACTERISTIC RIN_GRENZ "Grenzwert Innenwiderstand Batt" VALUE 0xffe5bcba _REC_VAL_20_u1 0. _CNV_R_R_r_q0p125_658_CM 0. 31.875 FORMAT "%8.4" /end CHARACTERISTIC
/begin CHARACTERISTIC S_PM_TEST1 "Applikationsschalter um die Startberechnung zu erzwingen" VALUE 0xffe5bcbc _REC_VAL_20_u1 0. _CNV_R_R_dez_550_CM 0. 255. FORMAT "%8.4" /end CHARACTERISTIC
/begin CHARACTERISTIC S_PMSTARTQ "Applikationsschalter f. B_pmstartq" VALUE 0xffe5bcbb _REC_VAL_20_u1 0. _CNV_R_R_dez_550_CM 0. 255. FORMAT "%8.4" /end CHARACTERISTIC
/begin CHARACTERISTIC S_RIN "Schalter Applikation Innenwiderstandsprüfung" VALUE 0xffe5bcbd _REC_VAL_20_u1 0. _CNV_R_R_dez_550_CM 0. 255. FORMAT "%8.4" /end CHARACTERISTIC
/begin CHARACTERISTIC USTARTGRZ "Spannungsgrenzwert für Startauswertung " VALUE 0xffe5bcb8 _REC_VAL_20_u2 0. _CNV_R_R_spg_uw_q0p_591_CM 6. 16. FORMAT "%8.4" /end CHARACTERISTIC
/begin MEASUREMENT B_genclcon "Wird auf true gesetzt wenn Motor und Generator bereits T_B_NMOT-Sekunden laufen." UBYTE _CNV_A_R_LINEAR_____22_CM 1 100. 0. 255. DISPLAY_IDENTIFIER B_GENCLCON ECU_ADDRESS 0x3fac96 BIT_MASK 0x1 /end MEASUREMENT
/begin MEASUREMENT B_ifbsk7 "" UBYTE _CNV_A_R_LINEAR_____22_CM 1 100. 0. 255. DISPLAY_IDENTIFIER B_IFBSK7 ECU_ADDRESS 0x3fac97 BIT_MASK 0x1 /end MEASUREMENT
/begin MEASUREMENT B_ifplak7 "" UBYTE _CNV_A_R_LINEAR_____22_CM 1 100. 0. 255. DISPLAY_IDENTIFIER B_IFPLAK7 ECU_ADDRESS 0x3fac98 BIT_MASK 0x1 /end MEASUREMENT
/begin MEASUREMENT t_bnmotakt "Zeit nachdem der Motor laeuft, hoert nach T_B_NMOT Sekunden auf." UBYTE _CNV_R_R_t_q1_661_CM 1 100. 0. 255. DISPLAY_IDENTIFIER T_BNMOTAKT ECU_ADDRESS 0x3fac9c FORMAT "%8.4" /end MEASUREMENT
/begin MEASUREMENT t_delta "Zeit, die seit letzem Prozessaufruf verstrichen ist. Dient zur Taskkompatibilitaet." UBYTE _CNV_R_R_t_q1_661_CM 1 100. 0. 255. DISPLAY_IDENTIFIER T_DELTA ECU_ADDRESS 0x3fac9d FORMAT "%8.4" /end MEASUREMENT
/begin MEASUREMENT ubattsoll "Batteriesollspannung aufgrund Batterietemperatur und Batt.-ladezustand. Weitere Nutzung in PMPRSVCALC." UWORD _CNV_R_R_spg_uw_q0p_591_CM 1 100. 6. 16. DISPLAY_IDENTIFIER UBATTSOLL ECU_ADDRESS 0x3fac9a BYTE_ORDER MSB_LAST FORMAT "%8.4" /end MEASUREMENT
/begin MEASUREMENT ubattsoll7 "lokales ubattsoll" UBYTE _CNV_R_R_spg_ub_q0p_659_CM 1 100. 6. 17. DISPLAY_IDENTIFIER UBATTSOLL7 ECU_ADDRESS 0x3fac9e FORMAT "%8.4" /end MEASUREMENT
/begin MEASUREMENT udelta "Delta zw. Battsollspg und Battspg" SBYTE _CNV_R_R_spg_q0p064_660_CM 1 100. -8.192 8.128 DISPLAY_IDENTIFIER UDELTA ECU_ADDRESS 0x3fac9f FORMAT "%8.4" /end MEASUREMENT
/begin MEASUREMENT udeltaabs "Absolutwert von udelta" UBYTE _CNV_R_R_spg_q0p064_660_CM 1 100. 0. 16.32 DISPLAY_IDENTIFIER UDELTAABS ECU_ADDRESS 0x3faca0 FORMAT "%8.4" /end MEASUREMENT
/begin MEASUREMENT uibs "Generatorspannungsvorgabe von IBS" UBYTE _CNV_R_R_spg_gencan_76_CM 1 100. 10.6 16.975 DISPLAY_IDENTIFIER UIBS ECU_ADDRESS 0x3faca1 FORMAT "%8.4" /end MEASUREMENT
/begin MEASUREMENT uibs7 "lokales uibs" UBYTE _CNV_R_R_spg_gencan_76_CM 1 100. 10.6 16.975 DISPLAY_IDENTIFIER UIBS7 ECU_ADDRESS 0x3faca2 FORMAT "%8.4" /end MEASUREMENT
/begin CHARACTERISTIC B_IFBSAAPP "Appl-para. für Bedingung Fehler vom BSD" VALUE 0xffe5bcdb _REC_VAL_20_u1 0. _CNV_R_R_dez_550_CM 0. 255. FORMAT "%8.4" /end CHARACTERISTIC
/begin CHARACTERISTIC B_IFUPLAPP "Apll-par. für Bedg. Fehler vom IBS" VALUE 0xffe5bcdc _REC_VAL_20_u1 0. _CNV_R_R_dez_550_CM 0. 255. FORMAT "%8.4" /end CHARACTERISTIC
/begin CHARACTERISTIC DFOVERRIDE "Schwellwert wann Generator als ueberlastet erkannt wird" VALUE 0xffe5bcdd _REC_VAL_20_u1 0. _CNV_R_R_rel_ub_b10_574_CM 0. 100. FORMAT "%8.4" /end CHARACTERISTIC
/begin CHARACTERISTIC KFUSOLL "Batteriesollspannung aufgrund der Temperatur und soc." MAP 0xffe5bcbe _REC_MAP_52_UBYTE_u1_u1_u2 0. _CNV_R_R_spg_ub_q0p_659_CM 6. 17.008 FORMAT "%8.4"
 /begin AXIS_DESCR STD_AXIS NO_INPUT_QUANTITY _CNV_R_R_temp_ub_q0_549_CM 3 -48. 125. FORMAT "%8.4" /end AXIS_DESCR
 /begin AXIS_DESCR STD_AXIS NO_INPUT_QUANTITY _CNV_R_R_rel_uw_b10_575_CM 3 0. 99.998474 FORMAT "%8.4" /end AXIS_DESCR
/end CHARACTERISTIC
/begin CHARACTERISTIC KLUSOLL "Batteriesollspannung aufgrund von tbatt" CURVE 0xffe5bcd4 _REC_CUR_52_UBYTE_u1_u1 0. _CNV_R_R_spg_ub_q0p_659_CM 6. 17.008 FORMAT "%8.4"
 /begin AXIS_DESCR STD_AXIS NO_INPUT_QUANTITY _CNV_R_R_temp_ub_q0_549_CM 3 -48. 125.25 FORMAT "%8.4" /end AXIS_DESCR
/end CHARACTERISTIC
/begin CHARACTERISTIC PMUBAT_MAX "Max. zugelassene Batteriespg " VALUE 0xffe5bcde _REC_VAL_20_u1 0. _CNV_R_R_spg_ub_q0p_659_CM 6. 17. FORMAT "%8.4" /end CHARACTERISTIC
/begin CHARACTERISTIC PMUBAT_MIN "Min. zugelassene Batteriespg" VALUE 0xffe5bcdf _REC_VAL_20_u1 0. _CNV_R_R_spg_ub_q0p_659_CM 6. 17. FORMAT "%8.4" /end CHARACTERISTIC
/begin CHARACTERISTIC PMUGEN_MAX "Max zugelassene Generatorspg" VALUE 0xffe5bce0 _REC_VAL_20_u1 0. _CNV_R_R_spg_gencan_76_CM 10.6 16.975 FORMAT "%8.4" /end CHARACTERISTIC
/begin CHARACTERISTIC PMUGEN_MIN "Min zugelassene Generatorspg" VALUE 0xffe5bce1 _REC_VAL_20_u1 0. _CNV_R_R_spg_gencan_76_CM 10.6 16.975 FORMAT "%8.4" /end CHARACTERISTIC
/begin CHARACTERISTIC S_B_IFBSAC "manueller Schalter für Fehler BSD" VALUE 0xffe5bce2 _REC_VAL_20_u1 0. _CNV_R_R_dez_550_CM 0. 255. FORMAT "%8.4" /end CHARACTERISTIC
/begin CHARACTERISTIC S_B_IFUPLA "manueller Schalter für Fehler IBS" VALUE 0xffe5bce3 _REC_VAL_20_u1 0. _CNV_R_R_dez_550_CM 0. 255. FORMAT "%8.4" /end CHARACTERISTIC
/begin CHARACTERISTIC S_UIBS "Schalter für UIBS, wenn True dann uibs=UIBSAPP" VALUE 0xffe5bce4 _REC_VAL_20_u1 0. _CNV_R_R_dez_550_CM 0. 255. FORMAT "%8.4" /end CHARACTERISTIC
/begin CHARACTERISTIC T_B_NMOT "Zeit nach Motorlauf, wo die stufenweise (USTEPMIN) Berechnung von uibs aktiviert wird." VALUE 0xffe5bce5 _REC_VAL_20_u1 0. _CNV_R_R_t_q1_661_CM 0. 255. FORMAT "%8.4" /end CHARACTERISTIC
/begin CHARACTERISTIC T_PMUGEN "Taskzeit von PMUGENCALC, = Zeit wo die stufenweise Setzung von uibs berechnet wird." VALUE 0xffe5bce6 _REC_VAL_20_u1 0. _CNV_R_R_t_q1_661_CM 0. 255. FORMAT "%8.4" /end CHARACTERISTIC
/begin CHARACTERISTIC UGENNORM "Generator Normspannung" VALUE 0xffe5bce7 _REC_VAL_20_u1 0. _CNV_R_R_spg_gencan_76_CM 10.6 16.975 FORMAT "%8.4" /end CHARACTERISTIC
/begin CHARACTERISTIC UIBSAPP "Manueller Applikationswert von Uibs an UGENKOR" VALUE 0xffe5bce8 _REC_VAL_20_u1 0. _CNV_R_R_spg_gencan_76_CM 10.6 16.975 FORMAT "%8.4" /end CHARACTERISTIC
/begin CHARACTERISTIC USTEPMIN "Min. Delta zw. Battsollspg und Battspg damit uibs veraendert wird." VALUE 0xffe5bce9 _REC_VAL_20_u1 0. _CNV_R_R_spg_q0p05_662_CM 0. 12.75 FORMAT "%8.4" /end CHARACTERISTIC
/begin MEASUREMENT B_soc_pwf "Uo Kalibrierung durchgeführt" UBYTE _CNV_A_R_LINEAR_____22_CM 1 100. 0. 255. DISPLAY_IDENTIFIER B_SOC_PWF ECU_ADDRESS 0x3fac65 BIT_MASK 0x1 /end MEASUREMENT
/begin MEASUREMENT B_soccalc "Uo Kalibrierung durchgeführt" UBYTE _CNV_A_R_LINEAR_____22_CM 1 100. 0. 255. DISPLAY_IDENTIFIER B_SOCCALC ECU_ADDRESS 0x3fac64 BIT_MASK 0x1 /end MEASUREMENT
/begin MEASUREMENT cbatt_lo "Nennkapazität Batterie, lokal" UBYTE _CNV_R_R_dez_550_CM 1 100. 20. 150. DISPLAY_IDENTIFIER CBATT_LO ECU_ADDRESS 0x3fac72 FORMAT "%8.4" /end MEASUREMENT
/begin MEASUREMENT d_qelad "Delta Kapazität entladen" UWORD _CNV_R_R_qlad_uw_q0_590_CM 1 100. 0. 1193.0283 DISPLAY_IDENTIFIER D_QELAD ECU_ADDRESS 0x3fac66 BYTE_ORDER MSB_LAST FORMAT "%8.4" /end MEASUREMENT
/begin MEASUREMENT d_qlad "Delta Kapazität geladen" UWORD _CNV_R_R_qlad_uw_q0_590_CM 1 100. 0. 1193.0283 DISPLAY_IDENTIFIER D_QLAD ECU_ADDRESS 0x3fac68 BYTE_ORDER MSB_LAST FORMAT "%8.4" /end MEASUREMENT
/begin MEASUREMENT ib_commcnt "Zähler Taskaufrufe zwischen periodischer Abfrage qlad und qelad" UBYTE _CNV_R_R_dez_550_CM 1 100. 0. 255. DISPLAY_IDENTIFIER IB_COMMCNT ECU_ADDRESS 0x3fac73 FORMAT "%8.4" /end MEASUREMENT
/begin MEASUREMENT ib_commsta "Statemaschine zeiger zur Abfrage qlad und qelad" UBYTE _CNV_R_R_dez_550_CM 1 100. 0. 255. DISPLAY_IDENTIFIER IB_COMMSTA ECU_ADDRESS 0x3fac74 FORMAT "%8.4" /end MEASUREMENT
/begin MEASUREMENT isoc0loc "Batteriestrom zum Zeitpunkt der Ruhespannungsmessung (lokal)" UWORD _CNV_R_R_i_uw_q0p02_588_CM 1 100. -200. 1110.7 DISPLAY_IDENTIFIER ISOC0LOC ECU_ADDRESS 0x3fac6a BYTE_ORDER MSB_LAST FORMAT "%8.4" /end MEASUREMENT
/begin MEASUREMENT q_bila "Kapazität Batterie (long)" ULONG _CNV_R_R_qlad_ul_q2_676_CM 1 100. 0. 150. DISPLAY_IDENTIFIER Q_BILA ECU_ADDRESS 0x3facd0 BYTE_ORDER MSB_LAST FORMAT "%8.4" /end MEASUREMENT
/begin MEASUREMENT qeladold "Kapazität Entladen vor Abstellen" UWORD _CNV_R_R_qlad_uw_q0_590_CM 1 100. 0. 1193.0283 DISPLAY_IDENTIFIER QELADOLD ECU_ADDRESS 0x3facc8 BYTE_ORDER MSB_LAST FORMAT "%8.4" /end MEASUREMENT
/begin MEASUREMENT qladold "Kapazität Getladen vor Abstellen" UWORD _CNV_R_R_qlad_uw_q0_590_CM 1 100. 0. 1193.0283 DISPLAY_IDENTIFIER QLADOLD ECU_ADDRESS 0x3facca BYTE_ORDER MSB_LAST FORMAT "%8.4" /end MEASUREMENT
/begin MEASUREMENT sco_b_loc "lokal soc_bila f. KFSOCLF" UWORD _CNV_R_R_rel_uw_b10_575_CM 1 100. 0. 99.998474 DISPLAY_IDENTIFIER SCO_B_LOC ECU_ADDRESS 0x3faccc BYTE_ORDER MSB_LAST FORMAT "%8.4" /end MEASUREMENT
/begin MEASUREMENT soc_bila "Ladezustand durch Bilanzierung und Ruhespannungsmessung ermittelt" UWORD _CNV_R_R_rel_uw_b10_575_CM 1 100. 0. 99.998474 DISPLAY_IDENTIFIER SOC_BILA ECU_ADDRESS 0x3fac6c BYTE_ORDER MSB_LAST FORMAT "%8.4" /end MEASUREMENT
/begin MEASUREMENT soc_q_loc "lokaler Zähler Genauigkeit Ladeztustandsbestimmung" UWORD _CNV_R_R_qlad_uw_q0_590_CM 1 100. 0. 1193.0283 DISPLAY_IDENTIFIER SOC_Q_LOC ECU_ADDRESS 0x3facce BYTE_ORDER MSB_LAST FORMAT "%8.4" /end MEASUREMENT
/begin MEASUREMENT soc_quali "Zähler Genauigkeit Ladeztustandsbestimmung" UWORD _CNV_R_R_qlad_uw_q0_590_CM 1 100. 0. 1193.0283 DISPLAY_IDENTIFIER SOC_QUALI ECU_ADDRESS 0x3fac6e BYTE_ORDER MSB_LAST FORMAT "%8.4" /end MEASUREMENT
/begin MEASUREMENT tsocloc "Batterietemperatur zum Zeitpunkt der Ruhespannungsmessung (lokal)" UBYTE _CNV_R_R_temp_ub_q0_549_CM 1 100. -48. 143.25 DISPLAY_IDENTIFIER TSOCLOC ECU_ADDRESS 0x3fac75 FORMAT "%8.4" /end MEASUREMENT
/begin MEASUREMENT ubatt0 "Aus Wertetripel ausgewählter Ruhespannungswert" UWORD _CNV_R_R_spg_uw_q0p_591_CM 1 100. 6. 22.38375 DISPLAY_IDENTIFIER UBATT0 ECU_ADDRESS 0x3fac70 BYTE_ORDER MSB_LAST FORMAT "%8.4" /end MEASUREMENT
/begin CHARACTERISTIC CBATT_DEF "Ersatzwert Batteriekapazität" VALUE 0xffe5bc34 _REC_VAL_20_u1 0. _CNV_R_R_dez_550_CM 1. 255. FORMAT "%8.4" /end CHARACTERISTIC
/begin CHARACTERISTIC IB_COMMVAL "Anzahl Taskaufrufe zwischen periodischer Abfrage qlad und qelad" VALUE 0xffe5bc35 _REC_VAL_20_u1 0. _CNV_R_R_dez_550_CM 0. 255. FORMAT "%8.4" /end CHARACTERISTIC
/begin CHARACTERISTIC KFSOC0UBIB "Ladezustand in Abhängigkeit von Ruhespannung und Strom" MAP 0xffe5bba8 _REC_MAP_52_UWORD_u2_u2_u2 0. _CNV_R_R_rel_uw_b10_575_CM 0. 99.998474 FORMAT "%8.4"
 /begin AXIS_DESCR STD_AXIS NO_INPUT_QUANTITY _CNV_R_R_spg_uw_q0p_591_CM 3 6. 22.38375 FORMAT "%8.4" /end AXIS_DESCR
 /begin AXIS_DESCR STD_AXIS isoc0loc _CNV_R_R_i_uw_q0p02_588_CM 10 -200. 1110.7 FORMAT "%8.4" /end AXIS_DESCR
/end CHARACTERISTIC
/begin CHARACTERISTIC KFSOCLF "Ladefaktor in Abhängigkeit von Temperatur und Ladezustand" MAP 0xffe5bc02 _REC_MAP_52_UBYTE_u1_u1_u2 0. _CNV_R_R_fak_uw_b10_677_CM 1.5625e-002 3.984375 FORMAT "%8.4"
 /begin AXIS_DESCR STD_AXIS NO_INPUT_QUANTITY _CNV_R_R_temp_ub_q0_549_CM 3 -48. 143.25 FORMAT "%8.4" /end AXIS_DESCR
 /begin AXIS_DESCR STD_AXIS NO_INPUT_QUANTITY _CNV_R_R_rel_uw_b10_575_CM 3 0. 99.998474 FORMAT "%8.4" /end AXIS_DESCR
/end CHARACTERISTIC
/begin CHARACTERISTIC KLSOC0TEMP "Temperaturabhängige Stromkorrektur für Ruhespannungsmessung" CURVE 0xffe5bc18 _REC_CUR_52_UBYTE_u1_u1 0. _CNV_R_R_fak_uw_b51_643_CM 0. 1.9921875 FORMAT "%8.4"
 /begin AXIS_DESCR STD_AXIS tsocloc _CNV_R_R_temp_ub_q0_549_CM 5 -48. 143.25 FORMAT "%8.4" /end AXIS_DESCR
/end CHARACTERISTIC
/begin CHARACTERISTIC PMQ_UX "Ruhespannung Extrapolationsteiler" VALUE 0xffe5bc36 _REC_VAL_20_u1 0. _CNV_R_R_dez_550_CM 1. 255. FORMAT "%8.4" /end CHARACTERISTIC
/begin CHARACTERISTIC Q_BILAPWF "Defaultwert für q_bila nach Powerfail" VALUE 0xffe5bc30 _REC_VAL_20_u4 0. _CNV_R_R_qlad_ul_q2_676_CM 0. 1193.0465 FORMAT "%8.4" /end CHARACTERISTIC
/begin CHARACTERISTIC QSOCCL1 "Grenze zur Ladezustandsqualitätsklasse1" VALUE 0xffe5bc24 _REC_VAL_20_u2 0. _CNV_R_R_qlad_uw_q0_590_CM 0. 1193.0283 FORMAT "%8.4" /end CHARACTERISTIC
/begin CHARACTERISTIC QSOCCL2 "Grenze zur Ladezustandsqualitätsklasse2" VALUE 0xffe5bc26 _REC_VAL_20_u2 0. _CNV_R_R_qlad_uw_q0_590_CM 0. 1193.0283 FORMAT "%8.4" /end CHARACTERISTIC
/begin CHARACTERISTIC S_BSOCCALC "Enable Rücksetzten Ruhespannungen IBS" VALUE 0xffe5bc37 _REC_VAL_20_u1 0. _CNV_R_R_dez_550_CM 0. 255. FORMAT "%8.4" /end CHARACTERISTIC
/begin CHARACTERISTIC S_SOC_BILA "Schalter für Applik. soc_bila" VALUE 0xffe5bc38 _REC_VAL_20_u1 0. _CNV_R_R_dez_550_CM 0. 255. FORMAT "%8.4" /end CHARACTERISTIC
/begin CHARACTERISTIC S_SOC_QUAL "Schalter für Applik. soc_quali" VALUE 0xffe5bc39 _REC_VAL_20_u1 0. _CNV_R_R_dez_550_CM 0. 255. FORMAT "%8.4" /end CHARACTERISTIC
/begin CHARACTERISTIC SOC_BILAWA "Applikationswert soc_bila" VALUE 0xffe5bc28 _REC_VAL_20_u2 0. _CNV_R_R_rel_uw_b10_575_CM 0. 99.998474 FORMAT "%8.4" /end CHARACTERISTIC
/begin CHARACTERISTIC SOC_Q_PWF "Ladezustandsqualität nach Powerfail" VALUE 0xffe5bc2c _REC_VAL_20_u2 0. _CNV_R_R_qlad_uw_q0_590_CM 0. 1193.0283 FORMAT "%8.4" /end CHARACTERISTIC
/begin CHARACTERISTIC SOC_QUALIA "Applikationswert soc_quali" VALUE 0xffe5bc2a _REC_VAL_20_u2 0. _CNV_R_R_rel_uw_b10_575_CM 0. 99.998474 FORMAT "%8.4" /end CHARACTERISTIC
/begin COMPU_METHOD _CNV_A_R_LINEAR_____0_CM "" RAT_FUNC "%6.3" "-" COEFFS 0 1. 0. 0 0 1 /end COMPU_METHOD
/begin COMPU_METHOD _CNV_S_2_RANGE______1_R_CM "" TAB_VERB "%6.3" "[-]" COMPU_TAB_REF _CNV_S_2_RANGE______1_R /end COMPU_METHOD
/begin COMPU_VTAB_RANGE _CNV_S_2_RANGE______1_R "" 2 0 0 "0" 1 255 "1" /end COMPU_VTAB_RANGE
/begin COMPU_METHOD _CNV_S_2_RANGE______2_CM "" TAB_VERB "%6.3" "[-]" COMPU_TAB_REF _CNV_S_2_RANGE______2 /end COMPU_METHOD
/begin COMPU_VTAB _CNV_S_2_RANGE______2 "" TAB_VERB 2 0 "0" 1 "1" /end COMPU_VTAB
/begin COMPU_METHOD _CNV_A_R_LINEAR_____3_CM "" RAT_FUNC "%6.3" "V" COEFFS 0 204.7999998974999 0. 0 0 1 /end COMPU_METHOD
/begin COMPU_METHOD _CNV_A_R_LINEAR_____4_CM "" RAT_FUNC "%6.3" "s" COEFFS 0 100. 0. 0 0 1 /end COMPU_METHOD
/begin COMPU_METHOD _CNV_A_R_LINEAR_____6_CM "" RAT_FUNC "%6.3" "°C" COEFFS 0 16. 0. 0 0 1 /end COMPU_METHOD
/begin COMPU_METHOD _CNV_A_R_LINEAR_____8_CM "" RAT_FUNC "%6.3" "%" COEFFS 0 655.3600000071681 0. 0 0 1 /end COMPU_METHOD
/begin COMPU_METHOD _CNV_A_R_LINEAR_____9_CM "" RAT_FUNC "%6.3" "%" COEFFS 0 2.56 0. 0 0 1 /end COMPU_METHOD
/begin COMPU_METHOD _CNV_A_R_LINEAR_____10_CM "" RAT_FUNC "%6.3" "rpm" COEFFS 0 1. 0. 0 0 1 /end COMPU_METHOD
/begin COMPU_METHOD _CNV_A_R_LINEAR_____11_CM "" RAT_FUNC "%6.3" "°C" COEFFS 0 1.333333333333333 64. 0 0 1 /end COMPU_METHOD
/begin COMPU_METHOD _CNV_A_R_LINEAR_____12_CM "" RAT_FUNC "%6.3" "°C" COEFFS 0 1.333333333333333 0. 0 0 1 /end COMPU_METHOD
/begin COMPU_METHOD _CNV_A_R_LINEAR_____14_CM "" RAT_FUNC "%6.3" "°C" COEFFS 0 1. 40. 0 0 1 /end COMPU_METHOD
/begin COMPU_METHOD _CNV_A_R_LINEAR_____15_CM "" RAT_FUNC "%6.3" "rpm" COEFFS 0 3.125e-002 0. 0 0 1 /end COMPU_METHOD
/begin COMPU_METHOD _CNV_A_R_LINEAR_____20_CM "" RAT_FUNC "%6.3" "-" COEFFS 0 32768.00003968061 0. 0 0 1 /end COMPU_METHOD
/begin COMPU_METHOD _CNV_S_2_RANGE______21_CM "" TAB_VERB "%6.3" "-" COMPU_TAB_REF _CNV_S_2_RANGE______21 /end COMPU_METHOD
/begin COMPU_VTAB _CNV_S_2_RANGE______21 "" TAB_VERB 2 0 "0" 1 "1" /end COMPU_VTAB
/begin COMPU_METHOD _CNV_A_R_LINEAR_____22_CM "" RAT_FUNC "%6.3" "[-]" COEFFS 0 1. 0. 0 0 1 /end COMPU_METHOD
/begin COMPU_METHOD _CNV_A_R_LINEAR_____23_CM "" RAT_FUNC "%6.3" "km/h" COEFFS 0 1. 0. 0 0 1 /end COMPU_METHOD
/begin COMPU_METHOD _CNV_A_R_LINEAR_____24_CM "" RAT_FUNC "%6.3" "s" COEFFS 0 10. 0. 0 0 1 /end COMPU_METHOD
/begin COMPU_METHOD _CNV_A_R_LINEAR_____27_CM "" RAT_FUNC "%6.3" "mg/stk" COEFFS 0 0.183585313174946 0. 0 0 1 /end COMPU_METHOD
/begin COMPU_METHOD _CNV_A_R_LINEAR_____29_CM "" RAT_FUNC "%6.3" "-" COEFFS 0 255.9983911655618 0. 0 0 1 /end COMPU_METHOD
/begin COMPU_METHOD _CNV_A_R_LINEAR_____31_CM "" RAT_FUNC "%6.3" "ms" COEFFS 0 0.1 0. 0 0 1 /end COMPU_METHOD
/begin COMPU_METHOD _CNV_A_R_LINEAR_____34_CM "" RAT_FUNC "%6.3" "V" COEFFS 0 9.846168103048838 0. 0 0 1 /end COMPU_METHOD
/begin COMPU_METHOD _CNV_A_R_LINEAR_____39_CM "" RAT_FUNC "%6.3" "-" COEFFS 0 127.9991955827809 0. 0 0 1 /end COMPU_METHOD
/begin COMPU_METHOD _CNV_A_R_LINEAR_____40_CM "" RAT_FUNC "%6.3" "%/s" COEFFS 0 0.1024000154202376 128.000019275297 0 0 1 /end COMPU_METHOD
/begin COMPU_METHOD _CNV_A_R_LINEAR_____41_CM "" RAT_FUNC "%6.3" "s" COEFFS 0 25. 0. 0 0 1 /end COMPU_METHOD
/begin COMPU_METHOD _CNV_A_R_LINEAR_____46_CM "" RAT_FUNC "%6.3" "-" COEFFS 0 16. 0. 0 0 1 /end COMPU_METHOD
/begin COMPU_METHOD _CNV_A_R_LINEAR_____49_CM "" RAT_FUNC "%6.3" "hPa" COEFFS 0 12.06017666543982 0. 0 0 1 /end COMPU_METHOD
/begin COMPU_METHOD _CNV_A_R_LINEAR_____53_CM "" RAT_FUNC "%6.3" "°TPS" COEFFS 0 137.0962343096234 0. 0 0 1 /end COMPU_METHOD
/begin COMPU_METHOD _CNV_A_R_LINEAR_____54_CM "" RAT_FUNC "%6.3" "rpm/s" COEFFS 0 3.125e-002 128. 0 0 1 /end COMPU_METHOD
/begin COMPU_METHOD _CNV_A_R_LINEAR_____55_CM "" RAT_FUNC "%6.3" "Nm" COEFFS 0 32. 0. 0 0 1 /end COMPU_METHOD
/begin COMPU_METHOD _CNV_A_R_LINEAR_____60_CM "" RAT_FUNC "%6.3" "V" COEFFS 0 9.807692307692308 0. 0 0 1 /end COMPU_METHOD
/begin COMPU_METHOD _CNV_R_R_spg_gencan_76_CM "" RAT_FUNC "%6.3" "V" COEFFS 0. 40. -424. 0. 0. 1. /end COMPU_METHOD
/begin COMPU_METHOD _CNV_A_R_LINEAR_____82_CM "" RAT_FUNC "%6.3" "°CRK" COEFFS 0 2.666666666666667 0. 0 0 1 /end COMPU_METHOD
/begin COMPU_METHOD _CNV_A_R_LINEAR_____85_CM "" RAT_FUNC "%6.3" "km/h" COEFFS 0 128.0000018750286 0. 0 0 1 /end COMPU_METHOD
/begin COMPU_METHOD _CNV_A_R_LINEAR_____88_CM "" RAT_FUNC "%6.3" "km" COEFFS 0 0.1 0. 0 0 1 /end COMPU_METHOD
/begin COMPU_METHOD _CNV_A_R_LINEAR_____96_CM "" RAT_FUNC "%6.3" "l" COEFFS 0 1. 0. 0 0 1 /end COMPU_METHOD
/begin COMPU_METHOD _CNV_A_R_LINEAR_____108_CM "" RAT_FUNC "%6.3" "mg/stk" COEFFS 0 47.18142548596112 0. 0 0 1 /end COMPU_METHOD
/begin COMPU_METHOD _CNV_A_R_LINEAR_____113_CM "" RAT_FUNC "%6.3" "kg/h" COEFFS 0 8191.999999679995 0. 0 0 1 /end COMPU_METHOD
/begin COMPU_METHOD _CNV_A_R_LINEAR_____115_CM "" RAT_FUNC "%6.3" "kg/h" COEFFS 0 32. 0. 0 0 1 /end COMPU_METHOD
/begin COMPU_METHOD _CNV_A_R_LINEAR_____116_CM "" RAT_FUNC "%6.3" "hPa" COEFFS 0 12.06017666543982 32767.5 0 0 1 /end COMPU_METHOD
/begin COMPU_METHOD _CNV_A_R_LINEAR_____118_CM "" RAT_FUNC "%6.3" "-" COEFFS 0 1023.999999959999 0. 0 0 1 /end COMPU_METHOD
/begin COMPU_METHOD _CNV_A_R_LINEAR_____122_CM "" RAT_FUNC "%6.3" "[-]" COEFFS 0 32769.4989394353 0. 0 0 1 /end COMPU_METHOD
/begin COMPU_METHOD _CNV_S_6_RANGE_STAT_134_CM "" TAB_VERB "%6.3" "-" COMPU_TAB_REF _CNV_S_6_RANGE_STAT_134 /end COMPU_METHOD
/begin COMPU_VTAB _CNV_S_6_RANGE_STAT_134 "" TAB_VERB 6 0 "ST_FIX_MFF_AD" 1 "S1_FIX_MFF_AD" 2 "S2_FIX_MFF_AD" 3 "S3_FIX_MFF_AD" 4 "S4_FIX_MFF_AD" 5 "END_FIX_MFF_AD" /end COMPU_VTAB
/begin COMPU_METHOD _CNV_A_R_LINEAR_____142_CM "" RAT_FUNC "%6.3" "ms" COEFFS 0 1. 0. 0 0 1 /end COMPU_METHOD
/begin COMPU_METHOD _CNV_A_R_LINEAR_____150_CM "" RAT_FUNC "%6.3" "km/h" COEFFS 0 128. 32768. 0 0 1 /end COMPU_METHOD
/begin COMPU_METHOD _CNV_A_R_LINEAR_____154_CM "" RAT_FUNC "%6.3" "%" COEFFS 0 2084.478388983038 32768.00027481336 0 0 1 /end COMPU_METHOD
/begin COMPU_METHOD _CNV_A_R_LINEAR_____163_CM "" RAT_FUNC "%6.3" "s" COEFFS 0 32768.00003968061 0. 0 0 1 /end COMPU_METHOD
/begin COMPU_METHOD _CNV_A_R_LINEAR_____168_CM "" RAT_FUNC "%6.3" "mA" COEFFS 0 163.8375 0. 0 0 1 /end COMPU_METHOD
/begin COMPU_METHOD _CNV_A_R_LINEAR_____173_CM "" RAT_FUNC "%6.3" "V" COEFFS 0 2510.769230769231 0. 0 0 1 /end COMPU_METHOD
/begin COMPU_METHOD _CNV_A_R_LINEAR_____177_CM "" RAT_FUNC "%6.3" "-" COEFFS 0 1. -1. 0 0 1 /end COMPU_METHOD
/begin COMPU_METHOD _CNV_A_R_LINEAR_____178_CM "" RAT_FUNC "%6.3" "°C" COEFFS 0 0.25 8.25 0 0 1 /end COMPU_METHOD
/begin COMPU_METHOD _CNV_A_R_LINEAR_____187_CM "" RAT_FUNC "%6.3" "Nm" COEFFS 0 32. 32768. 0 0 1 /end COMPU_METHOD
/begin COMPU_METHOD _CNV_A_R_LINEAR_____204_CM "" RAT_FUNC "%6.3" "°CRK" COEFFS 0 -2.666666666666667 0. 0 0 1 /end COMPU_METHOD
/begin COMPU_METHOD _CNV_A_R_LINEAR_____206_CM "" RAT_FUNC "%6.3" "-" COEFFS 0 1023.999999919998 0. 0 0 1 /end COMPU_METHOD
/begin COMPU_METHOD _CNV_A_R_LINEAR_____207_CM "" RAT_FUNC "%6.3" "rpm" COEFFS 0 1. 32768. 0 0 1 /end COMPU_METHOD
/begin COMPU_METHOD _CNV_A_R_LINEAR_____208_CM "" RAT_FUNC "%6.3" "V" COEFFS 0 35.63776976537597 0. 0 0 1 /end COMPU_METHOD
/begin COMPU_METHOD _CNV_A_R_LINEAR_____210_CM "" RAT_FUNC "%6.3" "°PORT" COEFFS 0 655.3600000071681 0. 0 0 1 /end COMPU_METHOD
/begin COMPU_METHOD _CNV_A_R_LINEAR_____216_CM "" RAT_FUNC "%6.3" "rpm" COEFFS 0 3.125e-002 128. 0 0 1 /end COMPU_METHOD
/begin COMPU_METHOD _CNV_A_R_LINEAR_____227_CM "" RAT_FUNC "%6.3" "°CRK" COEFFS 0 -2.666666666666667 -106.6666666666667 0 0 1 /end COMPU_METHOD
/begin COMPU_METHOD _CNV_A_R_LINEAR_____230_CM "" RAT_FUNC "%6.3" "°CRK" COEFFS 0 2.666666666666667 -160. 0 0 1 /end COMPU_METHOD
/begin COMPU_METHOD _CNV_A_R_LINEAR_____235_CM "" RAT_FUNC "%6.3" "ms" COEFFS 0 1.6 0. 0 0 1 /end COMPU_METHOD
/begin COMPU_METHOD _CNV_A_R_LINEAR_____243_CM "" RAT_FUNC "%6.3" "°CRK/s" COEFFS 0 2.666666666666667 0. 0 0 1 /end COMPU_METHOD
/begin COMPU_METHOD _CNV_A_R_LINEAR_____244_CM "" RAT_FUNC "%6.3" "µs" COEFFS 0 0.25 0. 0 0 1 /end COMPU_METHOD
/begin COMPU_METHOD _CNV_A_R_LINEAR_____247_CM "" RAT_FUNC "%6.3" "°CRK" COEFFS 0 2.666666666666667 160. 0 0 1 /end COMPU_METHOD
/begin COMPU_METHOD _CNV_A_R_LINEAR_____252_CM "" RAT_FUNC "%6.3" "V" COEFFS 0 13107.19998965744 0. 0 0 1 /end COMPU_METHOD
/begin COMPU_METHOD _CNV_A_R_LINEAR_____262_CM "" RAT_FUNC "%6.3" "%" COEFFS 0 655.3600000071681 32768.00000035841 0 0 1 /end COMPU_METHOD
/begin COMPU_METHOD _CNV_A_R_LINEAR_____264_CM "" RAT_FUNC "%6.3" "s" COEFFS 0 62415.29624765353 0. 0 0 1 /end COMPU_METHOD
/begin COMPU_METHOD _CNV_A_R_LINEAR_____273_CM "" RAT_FUNC "%6.3" "g" COEFFS 0 35.99999934081027 0. 0 0 1 /end COMPU_METHOD
/begin COMPU_METHOD _CNV_A_R_LINEAR_____274_CM "" RAT_FUNC "%6.3" "mg/stk" COEFFS 0 47.14849960790521 32768.20722749412 0 0 1 /end COMPU_METHOD
/begin COMPU_METHOD _CNV_A_R_LINEAR_____277_CM "" RAT_FUNC "%6.3" "[-]" COEFFS 0 1023.999999959999 32767.99999871998 0 0 1 /end COMPU_METHOD
/begin COMPU_METHOD _CNV_A_R_LINEAR_____279_CM "" RAT_FUNC "%6.3" "s" COEFFS 0 2. 0. 0 0 1 /end COMPU_METHOD
/begin COMPU_METHOD _CNV_A_R_LINEAR_____290_CM "" RAT_FUNC "%6.3" "-" COEFFS 0 1024.001799030612 2.248788264580526e-004 0 0 1 /end COMPU_METHOD
/begin COMPU_METHOD _CNV_A_R_LINEAR_____291_CM "" RAT_FUNC "%6.3" "-" COEFFS 0 131072.018509085 4.62727125704987e-003 0 0 1 /end COMPU_METHOD
/begin COMPU_METHOD _CNV_A_R_LINEAR_____292_CM "" RAT_FUNC "%6.3" "g" COEFFS 0 180.0000164797451 -4.999954682716634e-003 0 0 1 /end COMPU_METHOD
/begin COMPU_METHOD _CNV_A_R_LINEAR_____293_CM "" RAT_FUNC "%6.3" "g" COEFFS 0 92160.03375052735 4.108001687527576 0 0 1 /end COMPU_METHOD
/begin COMPU_METHOD _CNV_S_3_RANGE_LAMB_294_CM "" TAB_VERB "%6.3" "[-]" COMPU_TAB_REF _CNV_S_3_RANGE_LAMB_294 /end COMPU_METHOD
/begin COMPU_VTAB _CNV_S_3_RANGE_LAMB_294 "" TAB_VERB 3 0 "IDLE" 1 "LEAN" 2 "RICH" /end COMPU_VTAB
/begin COMPU_METHOD _CNV_A_R_LINEAR_____295_CM "" RAT_FUNC "%6.3" "g" COEFFS 0 92159.99999392318 -3.92000675201416e-002 0 0 1 /end COMPU_METHOD
/begin COMPU_METHOD _CNV_A_R_LINEAR_____296_CM "" RAT_FUNC "%6.3" "V" COEFFS 0 13107. 0. 0 0 1 /end COMPU_METHOD
/begin COMPU_METHOD _CNV_A_R_LINEAR_____297_CM "" RAT_FUNC "%6.3" "V/10ms" COEFFS 0 13107.26214524291 0.1553631072602002 0 0 1 /end COMPU_METHOD
/begin COMPU_METHOD _CNV_A_R_LINEAR_____298_CM "" RAT_FUNC "%6.3" "V/10ms" COEFFS 0 13107.20001587224 0. 0 0 1 /end COMPU_METHOD
/begin COMPU_METHOD _CNV_A_R_LINEAR_____309_CM "" RAT_FUNC "%6.3" "ohm" COEFFS 0 1. 0. 0 0 1 /end COMPU_METHOD
/begin COMPU_METHOD _CNV_S_3_RANGE_STAT_312_CM "" TAB_VERB "%6.3" "[-]" COMPU_TAB_REF _CNV_S_3_RANGE_STAT_312 /end COMPU_METHOD
/begin COMPU_VTAB _CNV_S_3_RANGE_STAT_312 "" TAB_VERB 3 0 "PASSIVE" 1 "ACTIVE" 2 "END" /end COMPU_VTAB
/begin COMPU_METHOD _CNV_A_R_LINEAR_____341_CM "" RAT_FUNC "%6.3" "V" COEFFS 0 204.8048048048048 0. 0 0 1 /end COMPU_METHOD
/begin COMPU_METHOD _CNV_A_R_LINEAR_____350_CM "" RAT_FUNC "%6.3" "mg" COEFFS 0 6.25 0. 0 0 1 /end COMPU_METHOD
/begin COMPU_METHOD _CNV_A_R_LINEAR_____403_CM "" RAT_FUNC "%6.3" "-" COEFFS 0 255.9999357490357 0. 0 0 1 /end COMPU_METHOD
/begin COMPU_METHOD _CNV_R_R_temp_ub_q0_549_CM "" RAT_FUNC "%6.3" "°C" COEFFS 0. 1. 48. 0. 0. 0.75 /end COMPU_METHOD
/begin COMPU_METHOD _CNV_R_R_dez_550_CM "" RAT_FUNC "%6.3" "[-]" COEFFS 0. 1. 0. 0. 0. 1. /end COMPU_METHOD
/begin COMPU_METHOD _CNV_R_R_rel_ub_b10_574_CM "" RAT_FUNC "%6.3" "%" COEFFS 0. 255. 0. 0. 0. 100. /end COMPU_METHOD
/begin COMPU_METHOD _CNV_R_R_rel_uw_b10_575_CM "" RAT_FUNC "%6.3" "%" COEFFS 0. 65536. 0. 0. 0. 100. /end COMPU_METHOD
/begin COMPU_METHOD _CNV_R_R_temp_uw_q0_577_CM "" RAT_FUNC "%6.3" "Grad C" COEFFS 0. 1. 48. 0. 0. 0.75 /end COMPU_METHOD
/begin COMPU_METHOD _CNV_S_2_B_TRUE_582_CM "" TAB_VERB "%6.3" "[-]" COMPU_TAB_REF _CNV_S_2_B_TRUE_582 /end COMPU_METHOD
/begin COMPU_VTAB _CNV_S_2_B_TRUE_582 "" TAB_VERB 2 0 "----" 1 "TRUE" /end COMPU_VTAB
/begin COMPU_METHOD _CNV_R_R_fak_ub_b1_586_CM "" RAT_FUNC "%6.3" "[-]" COEFFS 0. 256. 0. 0. 0. 1. /end COMPU_METHOD
/begin COMPU_METHOD _CNV_R_R_i_uw_q0p08_587_CM "" RAT_FUNC "%6.3" "A" COEFFS 0. 1. 200. 0. 0. 8.e-002 /end COMPU_METHOD
/begin COMPU_METHOD _CNV_R_R_i_uw_q0p02_588_CM "" RAT_FUNC "%6.3" "A" COEFFS 0. 1. 200. 0. 0. 2.e-002 /end COMPU_METHOD
/begin COMPU_METHOD _CNV_R_R_i_ub_q0p02_589_CM "" RAT_FUNC "%6.3" "A" COEFFS 0. 1. 0. 0. 0. 2.e-002 /end COMPU_METHOD
/begin COMPU_METHOD _CNV_R_R_qlad_uw_q0_590_CM "" RAT_FUNC "%6.3" "Ah" COEFFS 0. 3600000. 0. 0. 0. 65536. /end COMPU_METHOD
/begin COMPU_METHOD _CNV_R_R_spg_uw_q0p_591_CM "" RAT_FUNC "%6.3" "V" COEFFS 0. 1. -6. 0. 0. 2.5e-004 /end COMPU_METHOD
/begin COMPU_METHOD _CNV_R_R_fak_q0p004_635_CM "" RAT_FUNC "%6.3" "%" COEFFS 0. 1. 100. 0. 0. 4.e-003 /end COMPU_METHOD
/begin COMPU_METHOD _CNV_R_R_nmot_uw_q0_636_CM "" RAT_FUNC "%6.3" "1/min" COEFFS 0. 1. 0. 0. 0. 0.25 /end COMPU_METHOD
/begin COMPU_METHOD _CNV_R_R_fak_uw_q0p_637_CM "" RAT_FUNC "%6.3" "[-]" COEFFS 0. 1. 500. 0. 0. 0.25 /end COMPU_METHOD
/begin COMPU_METHOD _CNV_R_R_cbatt_ub_b_638_CM "" RAT_FUNC "%6.3" "Ah" COEFFS 0. 1. 0. 0. 0. 1. /end COMPU_METHOD
/begin COMPU_METHOD _CNV_R_R_fak_q0p5_639_CM "" RAT_FUNC "%6.3" "-" COEFFS 0. 2. 0. 0. 0. 1. /end COMPU_METHOD
/begin COMPU_METHOD _CNV_R_R_fak_uw_q0p_640_CM "" RAT_FUNC "%6.3" "-" COEFFS 0. 65536. 0. 0. 0. 65.536 /end COMPU_METHOD
/begin COMPU_METHOD _CNV_R_R_i_ub_q5p12_641_CM "" RAT_FUNC "%6.3" "A" COEFFS 0. 100. 0. 0. 0. 512. /end COMPU_METHOD
/begin COMPU_METHOD _CNV_R_R_t_q0p1_642_CM "" RAT_FUNC "%6.3" "s" COEFFS 0. 10. 0. 0. 0. 1. /end COMPU_METHOD
/begin COMPU_METHOD _CNV_R_R_fak_uw_b51_643_CM "" RAT_FUNC "%6.3" "-" COEFFS 0. 65536. 0. 0. 0. 512. /end COMPU_METHOD
/begin COMPU_METHOD _CNV_R_R_fak_q0p1_644_CM "" RAT_FUNC "%6.3" "-" COEFFS 0. 1. 0. 0. 0. 0.1 /end COMPU_METHOD
/begin COMPU_METHOD _CNV_R_R_spg_q0p977_645_CM "" RAT_FUNC "%6.3" "[-]" COEFFS 0. 1. 32. 0. 0. 9.765625e-004 /end COMPU_METHOD
/begin COMPU_METHOD _CNV_R_R_spg_uw_q0p_646_CM "" RAT_FUNC "%6.3" "V" COEFFS 0. 1. 0. 0. 0. 1.5e-002 /end COMPU_METHOD
/begin COMPU_METHOD _CNV_R_R_spg_uw_q0p_647_CM "" RAT_FUNC "%6.3" "V" COEFFS 0. 1. 491.505 0. 0. 1.5e-002 /end COMPU_METHOD
/begin COMPU_METHOD _CNV_R_R_fak_ub_b1_648_CM "" RAT_FUNC "%6.3" "-" COEFFS 0. 256. 0. 0. 0. 1. /end COMPU_METHOD
/begin COMPU_METHOD _CNV_R_R_fak_uw_b1_649_CM "" RAT_FUNC "%6.3" "-" COEFFS 0. 65536. 0. 0. 0. 1. /end COMPU_METHOD
/begin COMPU_METHOD _CNV_R_R_fak_ub_q0p_650_CM "" RAT_FUNC "%6.3" "-" COEFFS 0. 255. 0. 0. 0. 1. /end COMPU_METHOD
/begin COMPU_METHOD _CNV_R_R_fak_ub_q5p_651_CM "" RAT_FUNC "%6.3" "[-]" COEFFS 0. 1. 0. 0. 0. 5. /end COMPU_METHOD
/begin COMPU_METHOD _CNV_R_R_r_q0p1em3_652_CM "" RAT_FUNC "%6.3" "Ohm" COEFFS 0. 1000. 0. 0. 0. 1. /end COMPU_METHOD
/begin COMPU_METHOD _CNV_R_R_rel_uw_b10_653_CM "" RAT_FUNC "%6.3" "[-]" COEFFS 0. 65536. 0. 0. 0. 100. /end COMPU_METHOD
/begin COMPU_METHOD _CNV_R_R_fak_q0p002_654_CM "" RAT_FUNC "%6.3" "%" COEFFS 0. 500. 0. 0. 0. 1. /end COMPU_METHOD
/begin COMPU_METHOD _CNV_R_R_temp_uw_q0_655_CM "" RAT_FUNC "%6.3" "°C" COEFFS 0. 1. 48. 0. 0. 3.e-003 /end COMPU_METHOD
/begin COMPU_METHOD _CNV_R_R_t6minxmin__656_CM "" RAT_FUNC "%6.3" "[-]" COEFFS 0. 1. 0. 0. 0. 6. /end COMPU_METHOD
/begin COMPU_METHOD _CNV_R_R_nmot_ub_q1_657_CM "" RAT_FUNC "%6.3" "1/min" COEFFS 0. 1. 0. 0. 0. 10. /end COMPU_METHOD
/begin COMPU_METHOD _CNV_R_R_r_q0p125_658_CM "" RAT_FUNC "%6.3" "mOhm" COEFFS 0. 256. 0. 0. 0. 32. /end COMPU_METHOD
/begin COMPU_METHOD _CNV_R_R_spg_ub_q0p_659_CM "" RAT_FUNC "%6.3" "V" COEFFS 0. 1. -6. 0. 0. 6.4e-002 /end COMPU_METHOD
/begin COMPU_METHOD _CNV_R_R_spg_q0p064_660_CM "" RAT_FUNC "%6.3" "V" COEFFS 0. 1. 0. 0. 0. 6.4e-002 /end COMPU_METHOD
/begin COMPU_METHOD _CNV_R_R_t_q1_661_CM "" RAT_FUNC "%6.3" "s" COEFFS 0. 1. 0. 0. 0. 1. /end COMPU_METHOD
/begin COMPU_METHOD _CNV_R_R_spg_q0p05_662_CM "" RAT_FUNC "%6.3" "V" COEFFS 0. 20. 0. 0. 0. 1. /end COMPU_METHOD
/begin COMPU_METHOD _CNV_R_R_qlad_ul_q2_676_CM "" RAT_FUNC "%6.3" "Ah" COEFFS 0. 3600000. 0. 0. 0. 1. /end COMPU_METHOD
/begin COMPU_METHOD _CNV_R_R_fak_uw_b10_677_CM "" RAT_FUNC "%6.3" "-" COEFFS 0. 65536. 0. 0. 0. 1024. /end COMPU_METHOD
/begin RECORD_LAYOUT _REC_VAL_20_u1 FNC_VALUES 1 UBYTE COLUMN_DIR DIRECT /end RECORD_LAYOUT
/begin RECORD_LAYOUT _REC_VAL_20_u2 FNC_VALUES 1 UWORD COLUMN_DIR DIRECT /end RECORD_LAYOUT
/begin RECORD_LAYOUT _REC_AXS_20_u1 NO_AXIS_PTS_X 1 UBYTE AXIS_PTS_X 2 UBYTE INDEX_INCR DIRECT /end RECORD_LAYOUT
/begin RECORD_LAYOUT _REC_AXS_20_u2 NO_AXIS_PTS_X 1 UWORD AXIS_PTS_X 2 UWORD INDEX_INCR DIRECT /end RECORD_LAYOUT
/begin RECORD_LAYOUT _REC_VAL_20_u4 FNC_VALUES 1 ULONG COLUMN_DIR DIRECT /end RECORD_LAYOUT
/begin RECORD_LAYOUT _REC_CUR_52_UBYTE_u2_u1 NO_AXIS_PTS_X 1 UBYTE AXIS_PTS_X 2 UBYTE INDEX_INCR DIRECT FNC_VALUES 3 UWORD COLUMN_DIR DIRECT /end RECORD_LAYOUT
/begin RECORD_LAYOUT _REC_CUR_52_UBYTE_s1_u1 NO_AXIS_PTS_X 1 UBYTE AXIS_PTS_X 2 UBYTE INDEX_INCR DIRECT FNC_VALUES 3 SBYTE COLUMN_DIR DIRECT /end RECORD_LAYOUT
/begin RECORD_LAYOUT _REC_CUR_52_UWORD_u2_u2 NO_AXIS_PTS_X 1 UWORD AXIS_PTS_X 2 UWORD INDEX_INCR DIRECT FNC_VALUES 3 UWORD COLUMN_DIR DIRECT /end RECORD_LAYOUT
/begin RECORD_LAYOUT _REC_VAL_2_u1 FNC_VALUES 1 UBYTE COLUMN_DIR DIRECT /end RECORD_LAYOUT
/begin RECORD_LAYOUT _REC_CUR_52_UBYTE_u1_u1 NO_AXIS_PTS_X 1 UBYTE AXIS_PTS_X 2 UBYTE INDEX_INCR DIRECT FNC_VALUES 3 UBYTE COLUMN_DIR DIRECT /end RECORD_LAYOUT
/begin RECORD_LAYOUT _REC_MAP_52_UBYTE_u1_u1_u2 NO_AXIS_PTS_X 1 UBYTE NO_AXIS_PTS_Y 2 UBYTE AXIS_PTS_X 3 UBYTE INDEX_INCR DIRECT AXIS_PTS_Y 4 UWORD INDEX_INCR DIRECT FNC_VALUES 5 UBYTE COLUMN_DIR DIRECT /end RECORD_LAYOUT
/begin RECORD_LAYOUT _REC_VAL_2_s1 FNC_VALUES 1 SBYTE COLUMN_DIR DIRECT /end RECORD_LAYOUT
/begin RECORD_LAYOUT _REC_VAL_2_u2 FNC_VALUES 1 UWORD COLUMN_DIR DIRECT /end RECORD_LAYOUT
/begin RECORD_LAYOUT _REC_MAP_52_UBYTE_u2_u1_u2 NO_AXIS_PTS_X 1 UBYTE NO_AXIS_PTS_Y 2 UBYTE AXIS_PTS_X 3 UBYTE INDEX_INCR DIRECT AXIS_PTS_Y 4 UWORD INDEX_INCR DIRECT FNC_VALUES 5 UWORD COLUMN_DIR DIRECT /end RECORD_LAYOUT
/begin RECORD_LAYOUT _REC_VAL_2_s2 FNC_VALUES 1 SWORD COLUMN_DIR DIRECT /end RECORD_LAYOUT
/begin RECORD_LAYOUT _REC_MAP_52_UWORD_u2_u2_u2 NO_AXIS_PTS_X 1 UWORD NO_AXIS_PTS_Y 2 UWORD AXIS_PTS_X 3 UWORD INDEX_INCR DIRECT AXIS_PTS_Y 4 UWORD INDEX_INCR DIRECT FNC_VALUES 5 UWORD COLUMN_DIR DIRECT /end RECORD_LAYOUT
/begin FUNCTION MON_Fault_Reaction_of_Processor_ "_Fault Reaction of Processor Monitoring"
 /begin OUT_MEASUREMENT val_mo3_err_code_mc val_mo3_err_code_mu val_mo3_pwr_stag_dis_mc val_mo3_pwr_stag_dis_mu val_mo3_rst_ctr_mc val_mo3_rst_ctr_mu /end OUT_MEASUREMENT
/end FUNCTION
/begin FUNCTION MON_Monitoring_of_sport_switch ""
 /begin DEF_CHARACTERISTIC c_v_sof_swi_on_tol_mon c_v_sof_swi_on_bol_mon lc_var_sof_swi_mon lc_rng_l_mon lc_conf_city_ena_mon c_pv_av_sof_min_mon c_fac_tq_req_driv_sof_max_mon c_pv_av_grd_sof_max_mon c_t_pv_av_grd_sof_max_mon lc_rng_l_man_as_mon c_v_sof_swi_min_mon c_v_sof_swi_max_mon /end DEF_CHARACTERISTIC
 /begin OUT_MEASUREMENT lv_sof_swi_req_mon lv_sof_swi_mon lv_rng_l_mon lv_rng_l_req_mon lv_err_sof_inh_mon abc_sof_inh_mon /end OUT_MEASUREMENT
/end FUNCTION
/begin FUNCTION LLPMCTRL ""
 /begin DEF_CHARACTERISTIC B_IFBSAKAP B_IFUPLAAP DFLLMIN DSOCLLANH LLANHAPP LLPMAPP NLLMIN S_B_IFBSAK S_B_IFPLAK S_N_IDLIBS /end DEF_CHARACTERISTIC
 /begin OUT_MEASUREMENT B_ifbsa7 B_ifupla7 n_idlibs /end OUT_MEASUREMENT
/end FUNCTION
/begin FUNCTION PMPDIAG "" /end FUNCTION
/begin FUNCTION PMPRSVCALC ""
 /begin DEF_CHARACTERISTIC ARY_PRIO ARY_PRIOCF ARY_PWRCF ARY_PWRDF B_SOCNPAPP CBATTAPP CTRCBRAPP CTRPCOSAPP CTRPRIOAPP C_RESET_PI DFFGEN_APP DFFILT_APP DSOCPRIO4 DSOCPRIO5 DSOCPRIO6 EHZOLDAPP HKW_dT HKW_IKL2 HKW_ING2 HKW_IPG2 HKW_IWIN2 HKW_NSTMX2 HKW_PIMAX2 HKW_PKL2 HKW_PNG2 HKW_PPG2 HKW_PSTMX2 HKW_PWIN2 HKW_TGL2 HKW_TRGL2 IBATT_APP IBSAKTAPP IBSWAKEAPP IFBSAKAPP IFUPLAKAPP KBMCNT_APP KDFPTC_LP KFISOLLPTC KF_IBTSOLL KLCF2PWRCF KLHKWN2 KLPRIO2PTC KLPRIO2PWR KL_DFPRIO KL_DFPTC KL_DSOCPTC KL_I2PTC KL_IREST KL_ISOLLPR KL_PTC KL_SOCPRIO KL_UBTPRIO KL_UB_PTC KSOGRZAPP KSUGRZAPP KUBPTC_LP K_DF_LP K_PTC_PI K_PWRCF_PI K_PWRDF_PI K_UBAT_LP LLPMFILTK MN_PRICFPI MN_PTC_PI MN_PWRDFPI MX_PRICFPI MX_PTC_PI MX_PWRDFPI PCOSCHGAPP PRIOCFAPP PTCPWRAPP PWRCOSAPP PWRSPCSAPP RQPCOSAPP SELSPCSAPP STPCOSAPP S_B_SOCNPL S_DFFGEN S_DF_FILT S_DME2IBS S_E65PRIO S_IBATTW S_IBSAKT7 S_IFBSAK7 S_IFUPLAK7 S_PCOSCHG S_PRIO_E60 S_PRIO_E65 S_PTCOLMAN S_PTC_OLD S_TBATT S_UBATTAPP TBATT_APP t_pmbs t_pmvs T_PRIODFPI T_PTC_PI T_PWRDF_PI UBATTW_APP UBTAPP UBTLOWMAX UBTLOWMIN ULEVAPP ULOWSETAPP WAKEGRZAPP WGH_PRIO WGH_PRIOCF WGH_PWRCF WGH_PWRDF DSOCPCOS DSOCHYST DFMIN DFMAX /end DEF_CHARACTERISTIC
 /begin OUT_MEASUREMENT all2ptc allptcfilt B_dubt B_enwake7 B_enwakeup B_ibsakt7 B_ifbsak7 B_ifuplak7 B_kl15_old B_moteasy B_motover B_notlauf B_pcoschg7 B_PIReset B_pmbsdanf B_pmvsdanf B_socnpl7 B_ubtlow B_uloreset cbattnenn cbattnenn7 cfallpi ctrcbr ctrcbr7 ctrcbrmem ctrpcos ctrpcos7 ctrpcosmem ctrprio ctrprio7 ctrpriocf ctrpriocf7 ctrpriocfm ctrpriomem ctrpwrcf ctrpwrcos ctrpwrcos7 ctrpwrdf ctrpwrmem ctrpwspcos ctrpwspcs7 df2pi dfall2pi dfallpi dffgen7 dff_filt7 dfpi2ptc dfpt1filt dfpt1ptc dfpt1_2ptc dsoc2pi dsoc2ptc dsoc_old ehz_pwloc2 hkw_iant2 hkw_ki2 hkw_kp2 hkw_lpgv2 hkw_pant2 hkw_pi2 hkw_rdiff2 hkw_sel_i2 hkw_sel_p2 hkw_sv2 ibatt_w7 ibtdiff ibtdiff2pi ibtsoll idiff2ptc igenrest ikurzogrz7 ikurzugrz7 ikurz_ogrz ikurz_ugrz ind_priocf ind_priodf ind_pwrcf ind_pwrcos isoll isolldiff iwakegrz7 kbmcount mem memprio1 memprio2 mempriocf1 mempriocf2 memptc1 memptc2 pgen2ptc pgenrest picntr pmbscount pmvscount priocf_loc ptc_pwr ptc_pwr7 rqpcos rqpcos7 rqpcosmem selspcos selspcos7 selspcosme stpcos stpcos7 stpcosmem tbatt7 ubatt_w7 ubdiff ubdiff2pi ubdifffilt ubdiffptc ubt ubt7 ubt7mem ubt7old ubtpt12ptc ubtpt1ptc udeltaabsc udeltac ulev ulev7 ulevmem ulow ulowtimer /end OUT_MEASUREMENT
/end FUNCTION
/begin FUNCTION PMSOCFIT "" /begin DEF_CHARACTERISTIC KFPMRIBATT KLPMSOCVU S_PMSOCFIT SOCFITAPP ZK_PMSOC /end DEF_CHARACTERISTIC /begin OUT_MEASUREMENT pm_rishow pm_socfit3 pm_ubatts soc_fit ubatts2 /end OUT_MEASUREMENT /end FUNCTION
/begin FUNCTION PMSOCKOR ""
 /begin DEF_CHARACTERISTIC ABSCHKORA D_AB_KORR1 D_AB_KORR2 D_AB_KORR3 DSOCA DSOCABSCH I_FIT_AUSW KL_SSOC PM_TABSMN PMTIMERSQ1 QSOCCL3 QSTARTFGA S_ABSCHK S_DSOCS S_PMTABSMN S_QSTARTFK S_SOCSTAFK SOC_STAFGA SOCFITABW SOCFITGRZ TSAISONFIL /end DEF_CHARACTERISTIC
 /begin OUT_MEASUREMENT absch_korr B_abschfit B_pm_fit2 B_pm_fit3 B_pmsocini B_q_start B_soc_npl d_soc d_socw d_socw_1 pm_ibslog pm_tsrdy pmsoc_help q_startfgk soc_korr soc_q_kor soc_rel soc_stfgk soc_stfgkw t_saison tsaisonalt /end OUT_MEASUREMENT
/end FUNCTION
/begin FUNCTION PMSOCSTART ""
 /begin DEF_CHARACTERISTIC KLUNSTART KLUTSTART RIN_GRENZ S_PM_TEST1 S_PMSTARTQ S_RIN USTARTGRZ /end DEF_CHARACTERISTIC
 /begin OUT_MEASUREMENT B_pm_aux10 B_pm_aux11 B_pm_aux2 B_pm_aux3 B_pm_aux4 B_pm_aux8 B_pm_aux9 B_pmaux1 B_pmaux5 B_pmsqrdy B_pmstartq B_resetsta idelta nnstartb pmstartsta rin_start status u_grenz /end OUT_MEASUREMENT
/end FUNCTION
/begin FUNCTION PMUGENCALC ""
 /begin DEF_CHARACTERISTIC B_IFBSAAPP B_IFUPLAPP DFOVERRIDE KFUSOLL KLUSOLL PMUBAT_MAX PMUBAT_MIN PMUGEN_MAX PMUGEN_MIN S_B_IFBSAC S_B_IFUPLA S_UIBS T_B_NMOT T_PMUGEN UGENNORM UIBSAPP USTEPMIN /end DEF_CHARACTERISTIC
 /begin OUT_MEASUREMENT B_genclcon B_ifbsk7 B_ifplak7 t_bnmotakt t_delta ubattsoll ubattsoll7 udelta udeltaabs uibs uibs7 /end OUT_MEASUREMENT
/end FUNCTION
/begin FUNCTION PMSOCCALC ""
 /begin DEF_CHARACTERISTIC CBATT_DEF IB_COMMVAL KFSOC0UBIB KFSOCLF KLSOC0TEMP PMQ_UX Q_BILAPWF QSOCCL1 QSOCCL2 S_BSOCCALC S_SOC_BILA S_SOC_QUAL SOC_BILAWA SOC_Q_PWF SOC_QUALIA /end DEF_CHARACTERISTIC
 /begin OUT_MEASUREMENT B_soc_pwf B_soccalc cbatt_lo d_qelad d_qlad ib_commcnt ib_commsta isoc0loc q_bila qeladold qladold sco_b_loc soc_bila soc_q_loc soc_quali tsocloc ubatt0 /end OUT_MEASUREMENT
/end FUNCTION
/begin FUNCTION X__DDS_EXPA2_DEFAULT_FUNC__ "X__DDS_EXPA2_DEFAULT_FUNC__"
 /begin DEF_CHARACTERISTIC ldp_tco__ip_n_max_iv_diag ldpm_n_32_28 ldpm_fac_tq_req_ect_1 ldpm_gear_ef_1 ldpm_n_32__ef ldp_maf__thd_is_er_diag ldp_n__thd_is_er_diag ldp_tco__fac_thd_is_er_diag ldpm_vs_wheel_grd_mmv_thd ldp_vb_sof ldp_tia_sof ldpm_t_sof_act ldp_pv_av_sof_req_1 ldp_pv_av_sof_req_2 ldp_pv_av_sof_req_3 ldp_pv_av_sof_req_4 ldp_pv_av_sof_req_5 ldp_pv_av_sof_req_0 ldp_pv_av_sof_req_6 ldp_n_sof_req_1 ldp_n_sof_req_2 ldp_n_sof_req_3 ldp_n_sof_req_4 ldp_n_sof_req_5 ldp_n_sof_req_0 ldp_n_sof_req_6 ldpm_n_32__t_acc ldp_vs__amp_raw_cor ldp_v_amp_1__amp_raw ldp_v_amp_2__amp_raw ldpm_n_2_3 ldp_n_23 ldp_tps_av_id_tps_grd_bol_ae ldp_toil__t_dly_poil_swi_can ldpm_cam_edge_nr_0__win_chk ldpm_cam_edge_nr_1__win_chk ldpm_ctr_km_can ldp_vs_fil__tq_gs_inc_mon ldp_n_32__tq_gs_inc_mon ldpm_tco_2 ldp_flow_cor_cps_ip_cppwm ldpm_prs_cps_ip_cppwm ldp_amp_ip_fac_amp_cp ldp_tia_thr_ip_fac_tia_cp ldp_cl_ip_rel_flow_fac_cp ldpm_maf_ip_rel_flow_max_cps ldpm_cl_mmv_ip_nr_step_cl ldp_tco_ip_rel_fuel_max_cp_cor ldpm_vb_ip_cppwm_vb ldp_cppwm_ref_ip_cppwm_cor_frq ldp_cl_mmv_ip_t_max_cp ldpm_t_ctl_cru_1 ldp_vs_dif_cru__fac_prop_cru ldpm_vs_sp_dif_cru_1 ldpm_n_21 ldpm_vs_sp_cru_1 ldpm_ac_cru__fac_tq_cru ldpm_gear__fac_tq_cru ldp_n_32__fac_tq_cru ldpm_fac_tq_cru_1 ldp_n_32__fac_tq_req_clu_is ldp_vls_cyl_sel_ip_lamb_2 ldp_vls_cyl_sel_ip_lamb_1 ldpm_fac_t_1_laco ldp_n_ip_crk_syn ldp_maf_ip_crk_syn ldp_t1_lamb_ip_fac_err_lam_sel ldp_n_ip_crlc_cyl_lam ldp_maf_ip_crlc_cyl_lam ldp_n_32_ip_maf_delta_crk_max ldp_n_32_ip_maf_delta_crk_min ldp_maf_kgh__crlc_vls_down ldp_ftl__t_cur_dmtl_stat ldp_ftl__t_small_leak_test ldp_vb_dmtl_fil__fac_cur_dmtl ldpm_cur_dmtldifrefroughleak_1 ldp_ftl__t_rough_leak_test ldp_n_ecf__n_ecf_min_accin ldp_tco__temp_sub_ecf_ini ldp_n_ecf_cor_fil__n_perc_ecf ldp_tco_ex__n_ecf ldp_tam__temp_sub_ecf_ini ldpm_temp_mmv_sub_cat_ecf_1 ldp_vs__n_ecf_vs_cor ldp_temp_gb__n_ecf_temp_gb ldp_tco__t_tooth_max ldp_vb__t_tooth_max ldp_n_32_vff_efp ldp_tco_t_efp_ast_max ldp_ftl_vff_vepu_ftl ldp_ftl_dif_vff_vepu_ftl_dif ldpm_tco_1_6 ldpm_gr_mt_3 ldpm_gr_at_3 ldp_tq_loss_ars_sp_can__puc ldpm_tco_9 ldp_n__t_min_pu ldp_tco__t_min_pu ldp_n_grd_n_dif_max_is ldp_amp_ip_load_clc_amp ldp_n_32_ip_load_clc ldp_maf_ip_load_clc ldp_n_vs_ratio_gr_mt ldp_iga_dif_eff_iga ldpm_tco_1_igsp ldp_lamb_sp__iga_bas_lamb ldpm_n_14 ldpm_maf_2 ldp_tco__fac_iga_ch_tco ldpm_n_32_1_iga ldpm_t_ast_1_iga ldpm_tco_st_1_iga ldp_fac_tq_req_clu__crlc_tq_add ldpm_n_32_2_iga ldpm_maf_hb_1_iga ldp_tco__iga_bas_temp_cor ldp_tia__iga_bas_temp_cor ldpm_n_32_fac_iga_pos_neg ldp_maf_fac_iga_pos_neg ldpm_cyc_cast_ip_iga_dif_min ldpm_n_32_2_igsp ldpm_maf_hb_2_igsp ldp_amp_ip_iga_dif_min_cyc_amp ldpm_n_dif_igsp ldpm_vb__td ldp_lamb_sp_iga_ref_lamb ldp_n_iga_ref_temp ldp_maf_iga_ref_temp ldp_tia__iga_ref_temp_fac ldp_n__iga_ref_vvt ldp_tco__iga_ref_temp_fac ldp_maf__iga_ref_vvt ldp_egr_ratio_cor__iga_ref_egr ldp_maf__iga_ref_port ldp_n_32__iga_bas_port ldp_port_av__fac_iga_bas_port ldp_eff_iga_sp_iga_dif_sp ldp_cyc_st_ip_iga_st_cyc_st_cor ldp_n_ip_iga_st_bas ldp_amp_ip_iga_st_amp_cor ldp_teg_dyn_hys ldp_n__v_dur_igc_min ldp_maf__v_dur_igc_min ldp_n_dif_cor__tq_i_dt_is ldp_n_dif_cor_tq_i_is ldp_n_grd_tq_i_is ldpm_tco_is_1 ldpm_gr_mt_2 ldpm_n_dif_cor_p_d_dt_is ldpm_n_grd_p_d_dt_is ldpm_n_dif_cor_p_d_is ldpm_n_grd_p_d_is ldpm_t_ast__fac_n_grd_is ldpm_tco__fac_n_grd_is ldpm_n_dif_cor_tq_i_is ldpm_n_grd_tq_i_is ldp_maf_lgrd_tq_add_is_bol ldp_n_sp_is_tq_add_is_bol_bas ldp_n_lgrd_tq_add_is_bol ldpm_maf_fac_tq_add_is ldp_tco_tq_add_is_bol_bas ldp_tia_ip_fac_temp_tq_add_is ldp_toil_ip_fac_temp_tq_add_is ldp_nr_pat__pat_ind ldpm_tco_st_4 ldpm_n_11 ldpm_maf_ivvt_1 ldpm_tco_17 ldpm_tco_st_1_ivvt ldpm_t_ast_1_ivvt ldp_n_32__fac_cam_sp_ch_opp ldp_dip__fac_cam_sp_ch_opp ldp_state_cmb_ctl_id_cmb_ivvt ldpm_ctr_km_can_1 ldpm_n_13 ldpm_n_5 ldpm_maf_ivvt_2 ldpm_toil_2_ivvt ldpm_cam_mdl_dif_ivvt ldpm_dly_ivvt_1_ivvt ldpm_n_32_4_ivvt ldpm_n_32_3_ivvt ldpm_n_32_2_ivvt ldpm_n_32_1_ivvt ldpm_toil_1_ivvt ldpm_cam_edge_nr ldp_vb__fac_ivvtpwm ldp_vb_ip_ivvthpwm ldpm_cam_dif_ivvt ldp_vel_drift_ip_ivvthpwm_cor ldp_t_drift_ivvthpwm ldpm_tmag_ivvt_1_ivvt ldpm_mff_mmv ldp_vo_fac_ivvt ldp_n_32__crlc_maf_ivvt ldp_maf_sp__crlc_maf_ivvt ldpm_n_4_9 ldpm_n_6_4 ldpm_n_iga_max_knk ldpm_maf_iga_max_knk ldp_tco__fac_iga_max_knk ldp_tia__fac_iga_max_knk ldpm_n_2_9 ldpm_maf_1_9 ldp_n_32__maf_min_knk_ad_2 ldp_tia__ip_fac_ron_ad_max ldp_tco__ip_fac_ron_ad_max ldpm_n_32_3_iga ldp_maf_iga__iga_tra_knk ldpm_n_32_7 ldp_fac_ron_ad_fac_iga_tra ldp_tia_fac_iga_tra ldpm_gear_1 ldp_vs_fac_iga_tra_gear_mt ldp_vs_fac_iga_tra_gear_at ldp_maf_cyl_ip_crlc_lam_mv_lpf ldp_lam_mv_id_lam_cor_min_intr ldp_lam_mv_id_lam_cor_max_intr ldpm_n_1_laco ldpm_t1_lamb_1_lamb_ctl ldpm_t1_lamb_2_lamb_ctl ldpm_dly_1_lamb_ctl ldpm_dly_2_lamb_ctl ldp_maf_int_puc_ip_lamb_sp ldpm_tco_st_2_lamb_ctl ldp_mff_ad_add_mmv_delta_add ldpm_tco_1_mff_ad ldp_mff_ad_add_mmv_2_mff_add ldp_mff_ad_fac_mmv_2_mff_fac ldpm_n_32_1_mff_ad ldp_mff_ad_fac_mmv_delta_h ldp_mff_ad_fac_mmv_delta_l ldp_n_32_maf_mff_ad_fac_l_max ldpm_n_32_maf_mff_ad_fac_l_min ldpm_n_32_maf_mff_ad_fac_h_min ldpm_maf_1_lasp ldpm_n_32_1_lasp ldp_n_32_ip_lamb_afl_1 ldp_tqi_req_slow_ip_lamb_afl_1 ldp_tco_st_ip_lamb_bas_wup_cor ldp_n_32_ip_lamb_hom_afl ldp_tqi_req_slow_ip_lamb_hom_afl ldp_tco_ip_lamb_bas_wup_cor ldp_n_32_ip_fac_lamb_wup ldp_n_32_ip_fac_lamb_wup_is ldp_maf_ip_fac_lamb_wup ldp_maf_ip_fac_lamb_wup_is ldp_tco__lamb_add_afl_ch ldp_t_ast__lamb_add_afl_ch ldp_tqi_req_slow__lamb_ch_rgl ldp_n_32__lamb_ch_rgl ldp_tqi_req_slow__lamb_ch_is ldp_n_32__lamb_ch_is ldp_t_cop_i__teg_cop ldp_fac_cop_i__teg_cop ldpm_eff_iga_av_teg_i__teg_cop ldp_n__lamb_fl ldp_tco__lamb_ref_add ldp_n__lamb_ref ldp_maf__lamb_ref ldp_lamb_dif__eff_lamb ldp_ntl_ip_lamb_rgn_fac_mdl ldp_vls_down_ip_lamb_rgn ldp_n_32_ip_lamb_rgn_afr ldp_maf_ip_lamb_rgn_afr ldp_tqi_req_slow__lamb_sawup ldp_tqi_req_slow__lamb_sawup_is ldp_n_32__lamb_sawup ldp_n_32__lamb_sawup_is ldp_t_ast__lamb_add_sawup ldp_tco__lamb_add_sawup ldp_eff_lamb_sp__lamb_dif_sp /end DEF_CHARACTERISTIC
 /begin OUT_MEASUREMENT tco_dif state_mff_ad_1_act cycnr_puc n_hys_puc n_min_puc ivvt_in_1.struct_ctl_ivvt.t_add_min_ivvt_adh ivvt_in_1.struct_ctl_ivvt.lv_adh_cdn_ivvt ivvt_in_1.struct_ctl_ivvt.t_sum_adh_ivvt ivvt_in_1.struct_ctl_ivvt.t_dly_adh_ivvt ivvt_in_1.struct_ctl_ivvt.cam_adh_old ivvt_in_1.struct_ctl_ivvt.cam_adh_act ivvt_in_1.struct_ctl_ivvt.cam_adj_dif_adh_ivvt ivvt_in_1.struct_ctl_ivvt.lv_err_ivvt_mec_ass ivvt_in_1.struct_pwm_ivvt.t_drift_ivvthpwm ivvt_in_1.struct_prj_ivvt.lv_ivvtpwm_ext_adj ivvt_in_1.struct_prj_ivvt.ivvtpwm_ext_adj ivvt_ex_1.struct_ctl_ivvt.t_add_min_ivvt_adh ivvt_ex_1.struct_ctl_ivvt.lv_adh_cdn_ivvt ivvt_ex_1.struct_ctl_ivvt.t_sum_adh_ivvt ivvt_ex_1.struct_ctl_ivvt.t_dly_adh_ivvt ivvt_ex_1.struct_ctl_ivvt.cam_adh_old ivvt_ex_1.struct_ctl_ivvt.cam_adh_act ivvt_ex_1.struct_ctl_ivvt.cam_adj_dif_adh_ivvt ivvt_ex_1.struct_ctl_ivvt.lv_err_ivvt_mec_ass ivvt_ex_1.struct_pwm_ivvt.t_drift_ivvthpwm ivvt_ex_1.struct_prj_ivvt.lv_ivvtpwm_ext_adj ivvt_ex_1.struct_prj_ivvt.ivvtpwm_ext_adj lam_bank_1.lam_sti.lamb_puls_o2l lam_bank_1.lam_sti.fac_o2l_lamb_puls lam_bank_1.lam_sti.maf_int_o2l lam_bank_1.lam_sti.maf_int_o2l_sample_step lam_bank_1.lam_sti.lamb_puls_cor_afl lam_bank_1.lam_sti.lamb_puls_cor_afr lam_bank_1.lam_sti.lamb_puls_state lam_bank_1.lam_sti.maf_int_o2l_it lam_bank_1.ls_down.bf.lv_vls_down_mmv_lmt lam_bank_1.ls_down.vls_down lam_bank_1.ls_down.vls_down_bol lam_bank_1.ls_down.vls_down_tol lam_bank_1.ls_down.vls_down_mmv_max lam_bank_1.ls_down.vls_down_mmv_min lam_bank_1.ls_down.vls_down_mmv_hys lam_bank_1.ls_down.drv1_vls_down_mmv lam_bank_1.ls_down.drv1_vls_down_abs_max lam_bank_1.ls_down.drv1_vls_down_mmv_min lam_bank_1.ls_up_diag.bf.lv_req_oc_lsl_if_osc_di lam_bank_1.ls_up_diag.state_diag_oc_lsl lam_bank_1.ls_up_diag.t_dly_diag_el_lsl lam_bank_1.ls_up_diag.t_diag_oc_lsl lam_bank_1.ls_up_diag.t_end_diag_oc_lsl lam_bank_1.fsd_obd2.bf.lv_end_diag_win_fsd lam_bank_1.lsh_down_obd2.r_down_ls_thd_obd2_lsh_down lam_bank_1.cat_eff_ldc_obd2.lv_lam_mv_ldc lam_bank_1.cat_eff_obd2.ctr_cat_diag_lam_out lam_bank_1.lam_sti_inci.t_vls_cyc_afr_wide_rng lam_bank_1.lam_sti_inci.t_vls_cyc_afl_hld_wide_rng lam_bank_1.lam_sti_inci.lam_p_ctr lam_bank_1.lam_sti_inci.bf.lv_vls_tra lam_bank_1.lam_sti_afl.ctr_vls_afl_cyc lam_bank_1.lam_sti_afl.t_vls_cyc_afr lam_bank_1.lam_sti_afl.t_vls_cyc_afl lam_bank_1.lam_sti_afl.t_vls_cyc_afl_hld lam_bank_1.lam_sti_afl.bf.lv_afl lam_bank_1.ls_down_rdy.bf.lv_down_ls lam_bank_1.lam_diag_acq.lamb_diag lam_bank_1.lam_diag_acq.vls_up_cyl_mmv lam_bank_2.lam_sti.lamb_puls_o2l lam_bank_2.lam_sti.fac_o2l_lamb_puls lam_bank_2.lam_sti.maf_int_o2l lam_bank_2.lam_sti.maf_int_o2l_sample_step lam_bank_2.lam_sti.lamb_puls_cor_afl lam_bank_2.lam_sti.lamb_puls_cor_afr lam_bank_2.lam_sti.lamb_puls_state lam_bank_2.lam_sti.maf_int_o2l_it lam_bank_2.ls_down.bf.lv_vls_down_mmv_lmt lam_bank_2.ls_down.vls_down lam_bank_2.ls_down.vls_down_bol lam_bank_2.ls_down.vls_down_tol lam_bank_2.ls_down.vls_down_mmv_max lam_bank_2.ls_down.vls_down_mmv_min lam_bank_2.ls_down.vls_down_mmv_hys lam_bank_2.ls_down.drv1_vls_down_mmv lam_bank_2.ls_down.drv1_vls_down_abs_max lam_bank_2.ls_down.drv1_vls_down_mmv_min lam_bank_2.ls_up_diag.bf.lv_req_oc_lsl_if_osc_di lam_bank_2.ls_up_diag.state_diag_oc_lsl lam_bank_2.ls_up_diag.t_dly_diag_el_lsl lam_bank_2.ls_up_diag.t_diag_oc_lsl lam_bank_2.ls_up_diag.t_end_diag_oc_lsl lam_bank_2.fsd_obd2.bf.lv_end_diag_win_fsd lam_bank_2.lsh_down_obd2.r_down_ls_thd_obd2_lsh_down lam_bank_2.cat_eff_ldc_obd2.lv_lam_mv_ldc lam_bank_2.cat_eff_obd2.ctr_cat_diag_lam_out lam_bank_2.lam_sti_inci.t_vls_cyc_afr_wide_rng lam_bank_2.lam_sti_inci.t_vls_cyc_afl_hld_wide_rng lam_bank_2.lam_sti_inci.lam_p_ctr lam_bank_2.lam_sti_inci.bf.lv_vls_tra lam_bank_2.lam_sti_afl.ctr_vls_afl_cyc lam_bank_2.lam_sti_afl.t_vls_cyc_afr lam_bank_2.lam_sti_afl.t_vls_cyc_afl lam_bank_2.lam_sti_afl.t_vls_cyc_afl_hld lam_bank_2.lam_sti_afl.bf.lv_afl lam_bank_2.ls_down_rdy.bf.lv_down_ls lam_bank_2.lam_diag_acq.lamb_diag lam_bank_2.lam_diag_acq.vls_up_cyl_mmv lv_err_mis_low_fuel seg_nr lv_fmy_exit_st stk_av_egr lv_err_delta_lamb_i_1 lv_err_delta_lamb_i_2 lv_inh_diag_ls_down_1 lv_inh_diag_ls_down_2 nox_sens_puc_1 nox_sens_puc_2 n_ratio_conv tq_dif_tra B_dslfa B_fasls imlpr B_idlgspec ozpermBits1_1s ozpermBits1_1s.B_ozdperm ozpermBits1_1s.B_ozer0ok ozpermBits1_1s.B_ozerplt ozpermBits1_1s.B_ozregstg ozpermBits1_1s.B_ozeranz ozpermBits3_1s ozpermBits3_1s.B_ozper0ok ozpermBits3_1s.B_calcdper ozpermBits2_1s ozpermBits2_1s.B_ozpermgl ozpermBits2_1s.B_ozpermpl ozrestkmBits_1s ozrestkmBits_1s.B_ozcntini ozrestkmBits_1s.B_ozrwanz0 ugenslp cks_crc_ecu state_iv cyl_id_sam_trig lv_lamb_puls_cat_diag /end OUT_MEASUREMENT
/end FUNCTION
/end MODULE
/end PROJECT
