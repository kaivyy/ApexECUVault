ASAP2_VERSION 1 3
/begin PROJECT P390 "BMW DDE6.2 6-Zylinder VR0.1 15.03.2004 CAN11/12H"
/begin HEADER "" VERSION "VR0.1_6Z_CAN11/12H" PROJECT_NO P390 /end HEADER
/begin MODULE DIM ""
/begin MOD_COMMON "" BYTE_ORDER MSB_FIRST ALIGNMENT_BYTE 1 ALIGNMENT_WORD 2 ALIGNMENT_LONG 4 ALIGNMENT_FLOAT32_IEEE 4 /end MOD_COMMON
/begin CHARACTERISTIC FrmMng_ACCSelfRec_C "Switch to disable/enable ACC self recognition" VALUE 0xD5BD4 Kw_Wu8 1.000 OneToOne 0.00 1.000 FORMAT "%5.3" EXTENDED_LIMITS 0.00 255.0 /end CHARACTERISTIC
/begin CHARACTERISTIC FrmMng_ACSelfRec_C "" VALUE 0xD5BD5 Kw_Wu8 1.000 OneToOne 0.00 1.000 FORMAT "%5.3" EXTENDED_LIMITS 0.00 255.0 /end CHARACTERISTIC
/begin CHARACTERISTIC FrmMng_aDirectDef_C "" VALUE 0xD5BD6 Kw_Ws16 65.53500 Acc -32.76800 32.76700 FORMAT "%8.5" /end CHARACTERISTIC
/begin CHARACTERISTIC FrmMng_AFSSelfRec_C "Switch for enabling self recognition of AFS" VALUE 0xD5BD8 Kw_Wu8 1.000 OneToOne 0.00 1.000 FORMAT "%5.3" EXTENDED_LIMITS 0.00 255.0 /end CHARACTERISTIC
/begin CHARACTERISTIC FrmMng_ARSSelfRec_C "Switch to disable ARS recognition" VALUE 0xD5BD9 Kw_Wu8 1.000 OneToOne 0.00 1.000 FORMAT "%5.3" EXTENDED_LIMITS 0.00 255.0 /end CHARACTERISTIC
/begin CHARACTERISTIC FrmMng_aSideDef_C "#SSD Defektwert für FrmMng_aSideDef_C Botschaft" VALUE 0xD5BDA Kw_Ws16 65.53500 Acc -32.76800 32.76700 FORMAT "%8.5" /end CHARACTERISTIC
/begin CHARACTERISTIC FrmMng_cnvAccmLimTrq_Offset_C "#SSD HEATING_CURRENT" VALUE 0xD5BDC Kw_Ws16 6553.500 Trq -3276.800 3276.700 FORMAT "%8.3" /end CHARACTERISTIC
/begin CHARACTERISTIC FrmMng_cnvAccmLimTrq_Slope_C "#SSD HEATING_CURRENT" VALUE 0xD5BDE Kw_Ws16 65.53500 SlopeRes1000 -32.76800 32.76700 FORMAT "%8.5" /end CHARACTERISTIC
/begin CHARACTERISTIC FrmMng_cnvACCtrq_Offset_C "#SSD DREHMOMENT_ANF_ACC   Signal: TORQ_TAR_ACC" VALUE 0xD5BE0 Kw_Ws16 6553.500 Trq -3276.800 3276.700 FORMAT "%8.3" /end CHARACTERISTIC
/begin CHARACTERISTIC FrmMng_cnvACCtrq_Slope_C "#SSD DREHMOMENT_ANF_ACC   Signal: TORQ_TAR_ACC" VALUE 0xD5BE2 Kw_Ws16 65.53500 SlopeRes1000 -32.76800 32.76700 FORMAT "%8.5" /end CHARACTERISTIC
/begin CHARACTERISTIC FrmMng_cnvAVA_DSC_Offset_C "#SSD Offset for conversion of ACLN_VEH_ACRO_DSC" VALUE 0xD5BE4 Kw_Ws16 65.53500 Acc -32.76800 32.76700 FORMAT "%8.5" /end CHARACTERISTIC
/begin CHARACTERISTIC FrmMng_cnvAVA_DSC_Slope_C "#SSD slope for conversion of ACLN_VEH_ACRO_DSC" VALUE 0xD5BE6 Kw_Ws16 65.53500 SlopeRes1000 -32.76800 32.76700 FORMAT "%8.5" /end CHARACTERISTIC
/begin CHARACTERISTIC FrmMng_cnvLN_DSC_Offset_C "" VALUE 0xD5BE8 Kw_Ws16 65.53500 Acc -32.76800 32.76700 FORMAT "%8.5" /end CHARACTERISTIC
/begin CHARACTERISTIC FrmMng_cnvLN_DSC_Slope_C "" VALUE 0xD5BEA Kw_Ws16 65.53500 SlopeRes1000 -32.76800 32.76700 FORMAT "%8.5" /end CHARACTERISTIC
/begin CHARACTERISTIC FrmMng_cnvAFStrq_Offset_C "#SSD Offset for calculation of ST_TORQ_AVL & TORQ_TAR_AFS" VALUE 0xD5BEC Kw_Ws16 6553.500 Trq -3276.800 3276.700 FORMAT "%8.3" /end CHARACTERISTIC
/begin CHARACTERISTIC FrmMng_cnvAFStrq_Slope_C "#SSD Slope for calculation of ST_TORQ_AVL & TORQ_TAR_AFS" VALUE 0xD5BEE Kw_Ws16 65.53500 SlopeRes1000 -32.76800 32.76700 FORMAT "%8.5" /end CHARACTERISTIC
/begin CHARACTERISTIC FrmMng_cnvAipEng_Offset_C "#SSD Offset fuer Umwandlung von AIP_ENG" VALUE 0xD5BF0 Kw_Ws16 65535.00 Pres_hPa -32768.00 32767.00 FORMAT "%8.2" /end CHARACTERISTIC
/begin CHARACTERISTIC FrmMng_cnvAipEng_Slope_C "#SSD Steigung fuer Umwandlung von AIP_ENG" VALUE 0xD5BF2 Kw_Ws16 65.53500 SlopeRes1000 -32.76800 32.76700 FORMAT "%8.5" /end CHARACTERISTIC
/begin CHARACTERISTIC FrmMng_cnvAngAcpd_Offset_C "#SSD Offset fuer Umwandlung von ANG_ACPD" VALUE 0xD5BF4 Kw_Ws16 799.9878 Prc -400.0000 399.9878 FORMAT "%8.4" /end CHARACTERISTIC
/begin CHARACTERISTIC FrmMng_cnvAngAcpd_Slope_C "#SSD Steigung fuer Umwandlung von ANG_ACPD" VALUE 0xD5BF6 Kw_Ws16 65.53500 SlopeRes1000 -32.76800 32.76700 FORMAT "%8.5" /end CHARACTERISTIC
/begin CHARACTERISTIC FrmMng_cnvAPP_Offset_C "Offset fuer ANG_ACPD_REAL und ANG_ACPD_TAR signale" VALUE 0xD5BF8 Kw_Ws16 799.9878 Prc -400.0000 399.9878 FORMAT "%8.4" /end CHARACTERISTIC
/begin CHARACTERISTIC FrmMng_cnvAPP_Slope_C "Slope fuer ANG_ACPD_REAL und ANG_ACPD_TAR signale" VALUE 0xD5BFA Kw_Ws16 65.53500 SlopeRes1000 -32.76800 32.76700 FORMAT "%8.5" /end CHARACTERISTIC
/begin CHARACTERISTIC FrmMng_cnvARStrq_Offset_C "#SSD offset for conversion of ARS-torque" VALUE 0xD5BFC Kw_Ws16 13107.00 TrqPrp -6553.600 6553.400 FORMAT "%8.3" /end CHARACTERISTIC
/begin CHARACTERISTIC FrmMng_cnvARStrq_Slope_C "#SSD slope for conversion of ARS-torque" VALUE 0xD5BFE Kw_Ws16 65.53500 SlopeRes1000 -32.76800 32.76700 FORMAT "%8.5" /end CHARACTERISTIC
/begin CHARACTERISTIC FrmMng_cnvDCCtrq_Offset_C "Offset für Umrechnung von WMOM_PT_TAR in FrmMng_trqDCC_TrqDes" VALUE 0xD5C00 Kw_Ws16 65535.00 TrqPrpHigh -32768.00 32767.00 FORMAT "%8.2" /end CHARACTERISTIC
/begin CHARACTERISTIC FrmMng_cnvDCCtrq_Slope_C "Stiegung für Umrechnung von WMOM_PT_TAR in FrmMng_trqDCC_TrqDes" VALUE 0xD5C02 Kw_Ws16 65.53500 SlopeRes1000 -32.76800 32.76700 FORMAT "%8.5" /end CHARACTERISTIC
/begin CHARACTERISTIC FrmMng_cnvdLRADWINKStrg_Offset_C "Offset for calculation dphiStrg from CAN" VALUE 0xD5C04 Kw_Ws16 2880.263 AngleGradPerSec -1440.154 1440.110 FORMAT "%8.3" /end CHARACTERISTIC
/begin CHARACTERISTIC FrmMng_cnvdLRADWINKStrg_Slope_C "Slope for calculation  dphiStrg from CAN" VALUE 0xD5C06 Kw_Ws16 65.53500 SlopeRes1000 -32.76800 32.76700 FORMAT "%8.5" /end CHARACTERISTIC
/begin CHARACTERISTIC FrmMng_cnvDSCtrq_Offset_C "#SSD offset for conversion of DSC-torque" VALUE 0xD5C08 Kw_Ws16 6553.500 Trq -3276.800 3276.700 FORMAT "%8.3" /end CHARACTERISTIC
/begin CHARACTERISTIC FrmMng_cnvDSCtrq_Slope_C "#SSD slope for conversion of DSC-torque" VALUE 0xD5C0A Kw_Ws16 65.53500 SlopeRes1000 -32.76800 32.76700 FORMAT "%8.5" /end CHARACTERISTIC
/begin CHARACTERISTIC FrmMng_cnvIjvFu_Offset_C "#SSD Offset fuer Umwandlung von IJV_FU" VALUE 0xD5C0C Kw_Ws16 65535.00 FlConsum_ul -32768.00 32767.00 FORMAT "%8.2" /end CHARACTERISTIC
/begin CHARACTERISTIC FrmMng_cnvIjvFu_Slope_C "#SSD Steigung fuer Umwandlung von IJV_FU" VALUE 0xD5C0E Kw_Ws16 65.53500 SlopeRes1000 -32.76800 32.76700 FORMAT "%8.5" /end CHARACTERISTIC
/begin CHARACTERISTIC FrmMng_cnvKOMBIv_Offset_C "#SSD Conversion V_VEH_SPDM -> FrmMng_vDisp" VALUE 0xD5C10 Kw_Ws16 655.3500 Vel -327.6800 327.6700 FORMAT "%8.4" /end CHARACTERISTIC
/begin CHARACTERISTIC FrmMng_cnvKOMBIv_Slope_C "#SSD Conversion V_VEH_SPDM -> FrmMng_vDisp" VALUE 0xD5C12 Kw_Ws16 65.53500 SlopeRes1000 -32.76800 32.76700 FORMAT "%8.5" /end CHARACTERISTIC
/begin CHARACTERISTIC FrmMng_cnvLimRpmEng_Offset_C "Offset for conversion of LIM_RPM_ENG" VALUE 0xD5C14 Kw_Ws16 65535.00 EngN -32768.00 32767.00 FORMAT "%8.2" /end CHARACTERISTIC
/begin CHARACTERISTIC FrmMng_cnvLimRpmEng_Slope_C "Slope for the conversion of LIM_RPM_ENG" VALUE 0xD5C16 Kw_Ws16 65.53500 SlopeRes1000 -32.76800 32.76700 FORMAT "%8.5" /end CHARACTERISTIC
/begin CHARACTERISTIC FrmMng_cnvLRADWINKStrg_Offset_C "Offset for calculation of LRADWINK signal" VALUE 0xD5C18 Kw_Ws16 2880.263 AngleGrad -1440.154 1440.110 FORMAT "%8.3" /end CHARACTERISTIC
/begin CHARACTERISTIC FrmMng_cnvLRADWINKStrg_Slope_C "Slope for calculation of LRADWINK signal" VALUE 0xD5C1A Kw_Ws16 65.53500 SlopeRes1000 -32.76800 32.76700 FORMAT "%8.5" /end CHARACTERISTIC
/begin CHARACTERISTIC FrmMng_cnvnEngRpm_Offset_C "Offset for the calculation of RPM_TEMP_DOM_1 and RPM_TEMP_DOM_2" VALUE 0xD5C1C Kw_Ws16 65535.00 EngN -32768.00 32767.00 FORMAT "%8.2" /end CHARACTERISTIC
/begin CHARACTERISTIC FrmMng_cnvnEngRpm_Slope_C "Slope for the calculation of RPM_TEMP_DOM_1 &  RPM_TEMP_DOM_2 signals" VALUE 0xD5C1E Kw_Ws16 655.3500 SlopeRes100 -327.6800 327.6700 FORMAT "%8.4" /end CHARACTERISTIC
/begin CHARACTERISTIC FrmMng_cnvnSetpoint_Offset_C "Offset Wert für Byte 7 der ENGINE1 CAN Botschaft" VALUE 0xD5C20 Kw_Ws16 65535.00 EngN -32768.00 32767.00 FORMAT "%8.2" /end CHARACTERISTIC
/begin CHARACTERISTIC FrmMng_cnvnSetpoint_Slope_C "Steigungs Wert für Byte 7 der ENGINE1 CAN Botschaft" VALUE 0xD5C22 Kw_Ws16 65.53500 SlopeRes1000 -32.76800 32.76700 FORMAT "%8.5" /end CHARACTERISTIC
/begin CHARACTERISTIC FrmMng_cnvpBrkSys_Offset_C "Offset für Umrechnung von BRP in FrmMng_pBrkSys" VALUE 0xD5C24 Kw_Ws16 65535.00 Pres_bar -32768.00 32767.00 FORMAT "%8.2" /end CHARACTERISTIC
/begin CHARACTERISTIC FrmMng_cnvpBrkSys_Slope_C "Steigung für Umrechnung von BRP in FrmMng_pBrkSys" VALUE 0xD5C26 Kw_Ws16 65.53500 SlopeRes1000 -32.76800 32.76700 FORMAT "%8.5" /end CHARACTERISTIC
/begin CHARACTERISTIC FrmMng_cnvrHtFlow_Offset_C "Conversion HTFL_RQ_AIC -> FrmMng_rHtFlowReq" VALUE 0xD5C28 Kw_Ws16 799.9878 Prc -400.0000 399.9878 FORMAT "%8.4" /end CHARACTERISTIC
/begin CHARACTERISTIC FrmMng_cnvrHtFlow_Slope_C "Conversion HTFL_RQ_AIC -> FrmMng_rHtFlowReq" VALUE 0xD5C2A Kw_Ws16 655.3500 SlopeRes100 -327.6800 327.6700 FORMAT "%8.4" /end CHARACTERISTIC
/begin CHARACTERISTIC FrmMng_cnvRpmEng_Offset_C "#SSD Offset fuer Umwandlung von RPM_ENG" VALUE 0xD5C2C Kw_Ws16 65535.00 EngN -32768.00 32767.00 FORMAT "%8.2" /end CHARACTERISTIC
/begin CHARACTERISTIC FrmMng_cnvRpmEng_Slope_C "#SSD Steigung fuer Umwandlung von RPM_ENG" VALUE 0xD5C2E Kw_Ws16 65.53500 SlopeRes1000 -32.76800 32.76700 FORMAT "%8.5" /end CHARACTERISTIC
/begin CHARACTERISTIC FrmMng_cnvRPM_GRB_TURB_Offset_C "" VALUE 0xD5C30 Kw_Ws16 65535.00 EngN -32768.00 32767.00 FORMAT "%8.2" /end CHARACTERISTIC
/begin CHARACTERISTIC FrmMng_cnvRPM_GRB_TURB_Slope_C "" VALUE 0xD5C32 Kw_Ws16 65.53500 SlopeRes1000 -32.76800 32.76700 FORMAT "%8.5" /end CHARACTERISTIC
/begin CHARACTERISTIC FrmMng_cnvRqamFu_Offset_C "#SSD required-amount fuel Offset" VALUE 0xD5C34 Kw_Ws16 655.3500 FlConsum_l_h -327.6800 327.6700 FORMAT "%8.4" /end CHARACTERISTIC
/begin CHARACTERISTIC FrmMng_cnvRqamFu_Slope_C "#SSD required-amount fuel Slope" VALUE 0xD5C36 Kw_Ws16 655.3500 SlopeRes100 -327.6800 327.6700 FORMAT "%8.4" /end CHARACTERISTIC
/begin CHARACTERISTIC FrmMng_cnvrTransDT_Offset_C "Offset für Umrechnung von Getriebsstrang Verstärkung (GRDT_REIN) in FrmMng_rTransDT" VALUE 0xD5C38 Kw_Ws16 655.3500 TransR -327.6800 327.6700 FORMAT "%8.4" /end CHARACTERISTIC
/begin CHARACTERISTIC FrmMng_cnvrTransDT_Slope_C "Stiegung für Umrechnung von Getriebsstrang Verstärkung (GRDT_REIN) in FrmMng_rTransDT" VALUE 0xD5C3A Kw_Ws16 65.53500 SlopeRes1000 -32.76800 32.76700 FORMAT "%8.5" /end CHARACTERISTIC
/begin CHARACTERISTIC FrmMng_cnvrWaterVlv_Offset_C "Offset value for CTR_APE_WV" VALUE 0xD5C3C Kw_Ws16 799.9878 Prc -400.0000 399.9878 FORMAT "%8.4" /end CHARACTERISTIC
/begin CHARACTERISTIC FrmMng_cnvrWaterVlv_Slope_C "Slope value for CTR_APE_WV" VALUE 0xD5C3E Kw_Ws16 6553.500 SlopeRes10 -3276.800 3276.700 FORMAT "%8.3" /end CHARACTERISTIC
/begin CHARACTERISTIC FrmMng_cnvTempEng_Offset_C "#SSD Offset fuer Umwandlung von TEMP_ENG" VALUE 0xD5C40 Kw_Ws16 950.000 Temp_Cels -50.140 899.860 FORMAT "%8.3" EXTENDED_LIMITS -3549.940 3003.560 /end CHARACTERISTIC
/begin CHARACTERISTIC FrmMng_cnvTempEng_Slope_C "#SSD Steigung fuer Umwandlung von TEMP_ENG" VALUE 0xD5C42 Kw_Ws16 65.53500 SlopeRes1000 -32.76800 32.76700 FORMAT "%8.5" /end CHARACTERISTIC
/begin CHARACTERISTIC FrmMng_cnvtOil_Offset_C "#SSD Conversion TEMP_GRB -> FrmMng_tOil" VALUE 0xD5C44 Kw_Ws16 950.000 Temp_Cels -50.140 899.860 FORMAT "%8.3" EXTENDED_LIMITS -3549.940 3003.560 /end CHARACTERISTIC
/begin CHARACTERISTIC FrmMng_cnvtOil_Slope_C "#SSD Conversion TEMP_GRB -> FrmMng_tOil" VALUE 0xD5C46 Kw_Ws16 65.53500 SlopeRes1000 -32.76800 32.76700 FORMAT "%8.5" /end CHARACTERISTIC
/begin CHARACTERISTIC FrmMng_cnvTrqAvl_Offset_C "#SSD Offset fuer Umwandlung von TORQ_AVL" VALUE 0xD5C48 Kw_Ws16 6553.500 Trq -3276.800 3276.700 FORMAT "%8.3" /end CHARACTERISTIC
/begin CHARACTERISTIC FrmMng_cnvTrqAvl_Slope_C "#SSD Steigung fuer Umwandlung von TORQ_AVL" VALUE 0xD5C4A Kw_Ws16 65.53500 SlopeRes1000 -32.76800 32.76700 FORMAT "%8.5" /end CHARACTERISTIC
/begin CHARACTERISTIC FrmMng_cnvTrqDvch_Offset_C "#SSD Offset fuer Umwandlung von TORQ_DVCH" VALUE 0xD5C4C Kw_Ws16 6553.500 Trq -3276.800 3276.700 FORMAT "%8.3" /end CHARACTERISTIC
/begin CHARACTERISTIC FrmMng_cnvTrqDvch_Slope_C "#SSD Steigung fuer Umwandlung von TORQ_DVCH" VALUE 0xD5C4E Kw_Ws16 65.53500 SlopeRes1000 -32.76800 32.76700 FORMAT "%8.5" /end CHARACTERISTIC
/begin CHARACTERISTIC FrmMng_cnvtrqWheel_Offset_C "Offset Umrechnung TORQ_AVL" VALUE 0xD5C50 Kw_Ws16 65535.00 TrqPrpHigh -32768.00 32767.00 FORMAT "%8.2" /end CHARACTERISTIC
/begin CHARACTERISTIC FrmMng_cnvtrqWheel_Slope_C "Slope fuer WMOM_PT_AVL ,WMOM_PT_MIN_LOW und WMOM_PT_MAX signale" VALUE 0xD5C52 Kw_Ws16 65.53500 SlopeRes1000 -32.76800 32.76700 FORMAT "%8.5" /end CHARACTERISTIC
/begin CHARACTERISTIC FrmMng_cnvtrq_Offset_C "#SSD offset for message FrmMng_trqGearbxFrc" VALUE 0xD5C54 Kw_Ws16 6553.500 Trq -3276.800 3276.700 FORMAT "%8.3" /end CHARACTERISTIC
/begin CHARACTERISTIC FrmMng_cnvtrq_Slope_C "#SSD Slope for the message FrmMng_trqGearbxFrc" VALUE 0xD5C56 Kw_Ws16 65.53500 SlopeRes1000 -32.76800 32.76700 FORMAT "%8.5" /end CHARACTERISTIC
/begin CHARACTERISTIC FrmMng_cnvvMrk_Offset_C "#SSD SPEED_CLCTR" VALUE 0xD5C58 Kw_Ws16 655.3500 Vel -327.6800 327.6700 FORMAT "%8.4" /end CHARACTERISTIC
/begin CHARACTERISTIC FrmMng_cnvvMrk_Slope_C "#SSD SPEED_CLCTR" VALUE 0xD5C5A Kw_Ws16 65.53500 SlopeRes1000 -32.76800 32.76700 FORMAT "%8.5" /end CHARACTERISTIC
/begin CHARACTERISTIC FrmMng_cnvV_VEH_Offset_C "#SSD Offset für Fahrgeschwindigkeitsumrechnung" VALUE 0xD5C5C Kw_Ws16 655.3500 Vel -327.6800 327.6700 FORMAT "%8.4" /end CHARACTERISTIC
/begin CHARACTERISTIC FrmMng_cnvV_VEH_Slope_C "#SSD Steigung für Geschwindigkeitsumrechnung" VALUE 0xD5C5E Kw_Ws16 65.53500 SlopeRes1000 -32.76800 32.76700 FORMAT "%8.5" /end CHARACTERISTIC
/begin CHARACTERISTIC FrmMng_cnv_BattCls_Offset_C "#SSD Offsetwert für FrmMng_nBattCls" VALUE 0xD5C60 Kw_Ws16 65535.00 DEZ -32768.00 32767.00 FORMAT "%8.2" /end CHARACTERISTIC
/begin CHARACTERISTIC FrmMng_cnv_BattCls_Slope_C "#SSD Steigungswert für FrmMng_nBattCls" VALUE 0xD5C62 Kw_Ws16 65.53500 SlopeRes1000 -32.76800 32.76700 FORMAT "%8.5" /end CHARACTERISTIC
/begin CHARACTERISTIC FrmMng_cnv_HiLimCurr_Offset_C "#SSD Offsetwert für FrmMng_iHiLimCurr" VALUE 0xD5C64 Kw_Ws16 655350. i_ub_q10p0 -327680. 327670. FORMAT "%5.0" /end CHARACTERISTIC
/begin CHARACTERISTIC FrmMng_cnv_HiLimCurr_Slope_C "#SSD Steigungswert für FrmMng_iHiLimCurr" VALUE 0xD5C66 Kw_Ws16 65.53500 SlopeRes1000 -32.76800 32.76700 FORMAT "%8.5" /end CHARACTERISTIC
/begin CHARACTERISTIC FrmMng_cnv_LoLimCurr_Offset_C "#SSD Offsetwert für FrmMng_iLoLimCurr" VALUE 0xD5C68 Kw_Ws16 655350. i_ub_q10p0 -327680. 327670. FORMAT "%5.0" /end CHARACTERISTIC
/begin CHARACTERISTIC FrmMng_cnv_LoLimCurr_Slope_C "#SSD Steigungswert für FrmMng_iLoLimCurr" VALUE 0xD5C6A Kw_Ws16 65.53500 SlopeRes1000 -32.76800 32.76700 FORMAT "%8.5" /end CHARACTERISTIC
/begin CHARACTERISTIC FrmMng_cnv_ZrCurrLim_Offset_C "#SSD Offsetwert für FrmMng_iZrCurrLim" VALUE 0xD5C6C Kw_Ws16 65.53 i_ub_q0p001 -32.77 32.77 FORMAT "%5.2" /end CHARACTERISTIC
/begin CHARACTERISTIC FrmMng_cnv_ZrCurrLim_Slope_C "#SSD Steigungswert für FrmMng_iZrCurrLim" VALUE 0xD5C6E Kw_Ws16 65.53500 SlopeRes1000 -32.76800 32.76700 FORMAT "%8.5" /end CHARACTERISTIC
/begin CHARACTERISTIC FrmMng_ctASCDef_C "Defektentprellzähler, ASC-Plausibilisierung" VALUE 0xD5F8C Kw_Wu8 255.0 OneToOne 0.00 255.0 FORMAT "%5.1" /end CHARACTERISTIC
/begin CHARACTERISTIC FrmMng_ctDebAlvDMANFAFSDef_C "#SSD Defect time for DREHMOMENT_ANF_AFS  message alive counter error" VALUE 0xD5C70 Kw_Wu16 65535.00 OneToOne 0.00 65535.00 FORMAT "%8.2" /end CHARACTERISTIC
/begin CHARACTERISTIC FrmMng_ctDebAlvDMANFAFSOk_C "Healing time for DREHMOMENT_ANF_AFS  message alive counter error" VALUE 0xD5C72 Kw_Wu16 65535.00 OneToOne 0.00 65535.00 FORMAT "%8.2" /end CHARACTERISTIC
/begin CHARACTERISTIC FrmMng_ctDebAlvDRMANFSSGDef_C "measuring point for evluating ST_SW_WAUP signal" VALUE 0xD5C74 Kw_Wu16 65535.00 OneToOne 0.00 65535.00 FORMAT "%8.2" /end CHARACTERISTIC
/begin CHARACTERISTIC FrmMng_ctDebAlvDRMANFSSGOk_C "Healing time" VALUE 0xD5C76 Kw_Wu16 65535.00 OneToOne 0.00 65535.00 FORMAT "%8.2" /end CHARACTERISTIC
/begin CHARACTERISTIC FrmMng_ctDebCsDMANFAFSDef_C "#SSD Defect time for DREHMOMENT_ANF_AFS message check sum error" VALUE 0xD5C78 Kw_Wu16 65535.00 OneToOne 0.00 65535.00 FORMAT "%8.2" /end CHARACTERISTIC
/begin CHARACTERISTIC FrmMng_ctDebCsDMANFAFSOk_C "Healing time for DREHMOMENT_ANF_AFS message check sum error" VALUE 0xD5C7A Kw_Wu16 65535.00 OneToOne 0.00 65535.00 FORMAT "%8.2" /end CHARACTERISTIC
/begin CHARACTERISTIC FrmMng_ctDebCsDRMANFSSGDef_C " Defect time" VALUE 0xD5C7C Kw_Wu16 65535.00 OneToOne 0.00 65535.00 FORMAT "%8.2" /end CHARACTERISTIC
/begin CHARACTERISTIC FrmMng_ctDebCsDRMANFSSGOk_C "Healing time" VALUE 0xD5C7E Kw_Wu16 65535.00 OneToOne 0.00 65535.00 FORMAT "%8.2" /end CHARACTERISTIC
/begin CHARACTERISTIC FrmMng_ctDebSigDMANFAFSDef_C "#SSD Defect time for DREHMOMENT_ANF_AFS message signal error" VALUE 0xD5C80 Kw_Wu16 65535.00 OneToOne 0.00 65535.00 FORMAT "%8.2" /end CHARACTERISTIC
/begin CHARACTERISTIC FrmMng_ctDebSigDMANFAFSOk_C "Healing time for DREHMOMENT_ANF_AFS message signal error" VALUE 0xD5C82 Kw_Wu16 65535.00 OneToOne 0.00 65535.00 FORMAT "%8.2" /end CHARACTERISTIC
/begin CHARACTERISTIC FrmMng_ctDebSigDRMANFSSGDef_C "Defect time for DREHMOMENT_ANF_SSG message signal error" VALUE 0xD5C84 Kw_Wu16 65535.00 OneToOne 0.00 65535.00 FORMAT "%8.2" /end CHARACTERISTIC
/begin CHARACTERISTIC FrmMng_ctDebSigDRMANFSSGOk_C "Healing time for DREHMOMENT_ANF_SSG messages signal error" VALUE 0xD5C86 Kw_Wu16 65535.00 OneToOne 0.00 65535.00 FORMAT "%8.2" /end CHARACTERISTIC
/begin CHARACTERISTIC FrmMng_ctDebSigLRADWINKDef_C "Defect time for LENKRADWINKEL messages signal error" VALUE 0xD5C88 Kw_Wu16 65535.00 OneToOne 0.00 65535.00 FORMAT "%8.2" /end CHARACTERISTIC
/begin CHARACTERISTIC FrmMng_ctDebSigLRADWINKOk_C "Healing time for LENKRADWINKEL messages signal error" VALUE 0xD5C8A Kw_Wu16 65535.00 OneToOne 0.00 65535.00 FORMAT "%8.2" /end CHARACTERISTIC
/begin CHARACTERISTIC FrmMng_ctDebSigstCurrDef_C "Defektentprellung für Signal Fehler von CODIERUNG_PM Botschaft" VALUE 0xD5C8C Kw_Wu16 65535.00 OneToOne 0.00 65535.00 FORMAT "%8.2" /end CHARACTERISTIC
/begin CHARACTERISTIC FrmMng_ctDebSigstCurrOk_C "Heilentprellung für Signal Fehler von CODIERUNG_PM Botschaft" VALUE 0xD5C8E Kw_Wu16 65535.00 OneToOne 0.00 65535.00 FORMAT "%8.2" /end CHARACTERISTIC
/begin CHARACTERISTIC FrmMng_ctDebSigswtPSPOffDef_C "Defektentprellung für Signal Fehler von  CTR_CRASH_SWO_EKP Botschaft" VALUE 0xD5C90 Kw_Wu16 65535.00 OneToOne 0.00 65535.00 FORMAT "%8.2" /end CHARACTERISTIC
/begin CHARACTERISTIC FrmMng_ctDebSigswtPSPOffOk_C "Heilentprellung für Signal Fehler von  CTR_CRASH_SWO_EKP Botschaft" VALUE 0xD5C92 Kw_Wu16 65535.00 OneToOne 0.00 65535.00 FORMAT "%8.2" /end CHARACTERISTIC
/begin CHARACTERISTIC FrmMng_ctDebToDMANFAFSDef_C "#SSD Defect time for DREHMOMENT_ANF_AFS messages Timeout" VALUE 0xD5C94 Kw_Wu16 65535.00 OneToOne 0.00 65535.00 FORMAT "%8.2" /end CHARACTERISTIC
/begin CHARACTERISTIC FrmMng_ctDebToDMANFAFSOk_C "Healing time for DREHMOMENT_ANF_AFS messages Timeout" VALUE 0xD5C96 Kw_Wu16 65535.00 OneToOne 0.00 65535.00 FORMAT "%8.2" /end CHARACTERISTIC
/begin CHARACTERISTIC FrmMng_ctDebToDRMANFSSGDef_C "Defect time for DREHMOMENT_ANF_SSG messages Timeout" VALUE 0xD5C98 Kw_Wu16 65535.00 OneToOne 0.00 65535.00 FORMAT "%8.2" /end CHARACTERISTIC
/begin CHARACTERISTIC FrmMng_ctDebToDRMANFSSGOk_C "Healing time for DREHMOMENT_ANF_SSG messages Timeout" VALUE 0xD5C9A Kw_Wu16 65535.00 OneToOne 0.00 65535.00 FORMAT "%8.2" /end CHARACTERISTIC
/begin CHARACTERISTIC FrmMng_ctDebToLRADWINKDef_C "Defect time for LENKRADWINKEL messages time out error" VALUE 0xD5C9C Kw_Wu16 65535.00 OneToOne 0.00 65535.00 FORMAT "%8.2" /end CHARACTERISTIC
/begin CHARACTERISTIC FrmMng_ctDebToLRADWINKOk_C "Healing  time for LENKRADWINKEL messages time out error" VALUE 0xD5C9E Kw_Wu16 65535.00 OneToOne 0.00 65535.00 FORMAT "%8.2" /end CHARACTERISTIC
/begin CHARACTERISTIC FrmMng_ctDebTostCurrDef_C "Defektentprellung für Timeout-Fehler von  CODIERUNG_PM Botschaft" VALUE 0xD5CA0 Kw_Wu16 65535.00 OneToOne 0.00 65535.00 FORMAT "%8.2" /end CHARACTERISTIC
/begin CHARACTERISTIC FrmMng_ctDebTostCurrOk_C "Heilentprellung für Timeout-Fehler von  CODIERUNG_PM Botschaft" VALUE 0xD5CA2 Kw_Wu16 65535.00 OneToOne 0.00 65535.00 FORMAT "%8.2" /end CHARACTERISTIC
/begin CHARACTERISTIC FrmMng_ctDebToswtPSPOffDef_C "Defect time for ASC2-messages Timeout" VALUE 0xD5CA4 Kw_Wu16 65535.00 OneToOne 0.00 65535.00 FORMAT "%8.2" /end CHARACTERISTIC
/begin CHARACTERISTIC FrmMng_ctDebToswtPSPOffOk_C "Heilentprellung für Timeout-Fehler von  CTR_CRASH_SWO_EKP Botschaft" VALUE 0xD5CA6 Kw_Wu16 65535.00 OneToOne 0.00 65535.00 FORMAT "%8.2" /end CHARACTERISTIC
/begin CHARACTERISTIC FrmMng_ctMulDDE2_C "Anzahl  der zu multiplexenden  - DDE2 Messages" VALUE 0xD5F8E Kw_Wu16 4.000000 OneToOne 0.00 4.000000 FORMAT "%8.6" EXTENDED_LIMITS 0.00 65535.00 /end CHARACTERISTIC
/begin CHARACTERISTIC FrmMng_ctrRelDef_C "Defektwert für FrmMng_tRelDef_C Botschaft" VALUE 0xD5CA8 Kw_Wu32 4294967295.00 OneToOne 0.00 4294967295.00 FORMAT "%13.2" /end CHARACTERISTIC
/begin CHARACTERISTIC FrmMng_cnvCTR_GEN_U_TAR_Offset_C "" VALUE 0xD5CAC Kw_Ws16 65535.00 OneToOne -32768.00 32767.00 FORMAT "%8.2" /end CHARACTERISTIC
/begin CHARACTERISTIC FrmMng_cnvCTR_GEN_U_TAR_Slope_C "" VALUE 0xD5CAE Kw_Ws16 65.53500 SlopeRes1000 -32.76800 32.76700 FORMAT "%8.5" /end CHARACTERISTIC
/begin CHARACTERISTIC FrmMng_dCanState_C "Multiplexinfo für MUL_COD = 0" VALUE 0xD5F90 Kw_Wu8 63.00 OneToOne 0.00 63.00 FORMAT "%5.2" EXTENDED_LIMITS 0.00 255.0 /end CHARACTERISTIC
/begin CHARACTERISTIC FrmMng_DebACTrqDef_C "#SSD debouncing of ACTrq for defect detection" VALUE 0xD5CB0 Kw_Wu16 65535.00 OneToOne 0.00 65535.00 FORMAT "%8.2" /end CHARACTERISTIC
/begin CHARACTERISTIC FrmMng_DebACTrqOk_C "debouncing of ACTrq for healing" VALUE 0xD5CB2 Kw_Wu16 65535.00 OneToOne 0.00 65535.00 FORMAT "%8.2" /end CHARACTERISTIC
/begin CHARACTERISTIC FrmMng_DebAlvANFRADMOMPTDef_C "Defektentprellung für RADMOM_PT_1-messages Alive-Zähler" VALUE 0xD5CB4 Kw_Wu16 65535.00 OneToOne 0.00 65535.00 FORMAT "%8.2" /end CHARACTERISTIC
/begin CHARACTERISTIC FrmMng_DebAlvANFRADMOMPTOk_C "Heilentprellung für RADMOM_PT_1-messages Alive-Zähler" VALUE 0xD5CB6 Kw_Wu16 65535.00 OneToOne 0.00 65535.00 FORMAT "%8.2" /end CHARACTERISTIC
/begin CHARACTERISTIC FrmMng_DebAlvDMOMENT_ACCDef_C "#SSD Defect time of DMOMENT_ACC aliv" VALUE 0xD5CB8 Kw_Wu16 65535.00 OneToOne 0.00 65535.00 FORMAT "%8.2" /end CHARACTERISTIC
/begin CHARACTERISTIC FrmMng_DebAlvDMOMENT_ACCOk_C "Healing time  of  DMOMENT_ACC aliv" VALUE 0xD5CBA Kw_Wu16 65535.00 OneToOne 0.00 65535.00 FORMAT "%8.2" /end CHARACTERISTIC
/begin CHARACTERISTIC FrmMng_DebAlvOPCRCTLACCDef_C "#SSD debouncing of alive-ctr.-error OPCRCTLACC (no.of events)" VALUE 0xD5CBC Kw_Wu16 65535.00 OneToOne 0.00 65535.00 FORMAT "%8.2" /end CHARACTERISTIC
/begin CHARACTERISTIC FrmMng_DebAlvOPCRCTLACCOk_C "debouncing of alive-ctr.-error OPCRCTLACC (no.of events)" VALUE 0xD5CBE Kw_Wu16 65535.00 OneToOne 0.00 65535.00 FORMAT "%8.2" /end CHARACTERISTIC
/begin CHARACTERISTIC FrmMng_DebAlvSTAT_ARSDef_C "#SSD debouncing of alive-ctr.-error STAT_ARS (no.of events)" VALUE 0xD5CC0 Kw_Wu16 65535.00 OneToOne 0.00 65535.00 FORMAT "%8.2" /end CHARACTERISTIC
/begin CHARACTERISTIC FrmMng_DebAlvSTAT_ARSOk_C "debouncing of alive-ctr.-error STAT_ARS (no.of events)" VALUE 0xD5CC2 Kw_Wu16 65535.00 OneToOne 0.00 65535.00 FORMAT "%8.2" /end CHARACTERISTIC
/begin CHARACTERISTIC FrmMng_DebAlvSTAT_KOMBIDef_C "#SSD debouncing of alive-ctr.-error STAT_KOMBI (no.of events)" VALUE 0xD5CC4 Kw_Wu16 65535.00 OneToOne 0.00 65535.00 FORMAT "%8.2" /end CHARACTERISTIC
/begin CHARACTERISTIC FrmMng_DebAlvSTAT_KOMBIOk_C "debouncing of alive-ctr.-error STAT_KOMBI (no.of events)" VALUE 0xD5CC6 Kw_Wu16 65535.00 OneToOne 0.00 65535.00 FORMAT "%8.2" /end CHARACTERISTIC
/begin CHARACTERISTIC FrmMng_DebAlvTERMINALDef_C "debouncing of alive-ctr.-error TERMINAL (no.of events)" VALUE 0xD5CC8 Kw_Wu16 65535.00 OneToOne 0.00 65535.00 FORMAT "%8.2" /end CHARACTERISTIC
/begin CHARACTERISTIC FrmMng_DebAlvTERMINALOk_C "debouncing of alive-ctr.-error TERMINAL (no.of events)" VALUE 0xD5CCA Kw_Wu16 65535.00 OneToOne 0.00 65535.00 FORMAT "%8.2" /end CHARACTERISTIC
/begin CHARACTERISTIC FrmMng_DebAlvTORQUE_DSCDef_C "#SSD debouncing of alive-ctr.-error TORQUE_DSC (no.of events)" VALUE 0xD5CCC Kw_Wu16 65535.00 OneToOne 0.00 65535.00 FORMAT "%8.2" /end CHARACTERISTIC
/begin CHARACTERISTIC FrmMng_DebAlvTORQUE_DSCOk_C "debouncing of alive-ctr.-error TORQUE_DSC (no.of events)" VALUE 0xD5CCE Kw_Wu16 65535.00 OneToOne 0.00 65535.00 FORMAT "%8.2" /end CHARACTERISTIC
/begin CHARACTERISTIC FrmMng_DebAlvTORQUE_GEARBXDef_C "#SSD debouncing of alive-ctr.-error TORQUE_GEARBX (no.of events)" VALUE 0xD5CD0 Kw_Wu16 65535.00 OneToOne 0.00 65535.00 FORMAT "%8.2" /end CHARACTERISTIC
/begin CHARACTERISTIC FrmMng_DebAlvTORQUE_GEARBXOk_C "debouncing of alive-ctr.-error TORQUE_GEARBX (no.of events)" VALUE 0xD5CD2 Kw_Wu16 65535.00 OneToOne 0.00 65535.00 FORMAT "%8.2" /end CHARACTERISTIC
/begin CHARACTERISTIC FrmMng_DebAlvVEH_MODDef_C "Defect time for VEH_MOD signal" VALUE 0xD5CD4 Kw_Wu16 65535.00 OneToOne 0.00 65535.00 FORMAT "%8.2" /end CHARACTERISTIC
/begin CHARACTERISTIC FrmMng_DebAlvVEH_MODOk_C "debounce OK time for alive counter for VEH_MOD signal" VALUE 0xD5CD6 Kw_Wu16 65535.00 OneToOne 0.00 65535.00 FORMAT "%8.2" /end CHARACTERISTIC
/begin CHARACTERISTIC FrmMng_DebCsANFRADMOMPTDef_C "Defektentprellung für RADMOM_PT_1-messages Checksum" VALUE 0xD5CD8 Kw_Wu16 65535.00 OneToOne 0.00 65535.00 FORMAT "%8.2" /end CHARACTERISTIC
/begin CHARACTERISTIC FrmMng_DebCsANFRADMOMPTOk_C "Heilentprellung für RADMOM_PT_1-messages Checksum" VALUE 0xD5CDA Kw_Wu16 65535.00 OneToOne 0.00 65535.00 FORMAT "%8.2" /end CHARACTERISTIC
/begin CHARACTERISTIC FrmMng_DebCsDMOMENT_ACCDef_C "#SSD Defect time of DMOMENT_ACC   check sum" VALUE 0xD5CDC Kw_Wu16 65535.00 OneToOne 0.00 65535.00 FORMAT "%8.2" /end CHARACTERISTIC
/begin CHARACTERISTIC FrmMng_DebCsDMOMENT_ACCOk_C "Healing time  of  DMOMENT_ACC check sum" VALUE 0xD5CDE Kw_Wu16 65535.00 OneToOne 0.00 65535.00 FORMAT "%8.2" /end CHARACTERISTIC
/begin CHARACTERISTIC FrmMng_DebCsOPCRCTLACCDef_C "#SSD debouncing of checksum-error OPCRCTLACC (no.of events)" VALUE 0xD5CE0 Kw_Wu16 65535.00 OneToOne 0.00 65535.00 FORMAT "%8.2" /end CHARACTERISTIC
/begin CHARACTERISTIC FrmMng_DebCsOPCRCTLACCOk_C "debouncing of checksum-error OPCRCTLACC (no.of events)" VALUE 0xD5CE2 Kw_Wu16 65535.00 OneToOne 0.00 65535.00 FORMAT "%8.2" /end CHARACTERISTIC
/begin CHARACTERISTIC FrmMng_DebCsTERMINALDef_C "debouncing of checksum-error TERMINAL (no.of events)" VALUE 0xD5CE4 Kw_Wu16 65535.00 OneToOne 0.00 65535.00 FORMAT "%8.2" /end CHARACTERISTIC
/begin CHARACTERISTIC FrmMng_DebCsTERMINALOk_C "debouncing of checksum-error TERMINAL (no.of events)" VALUE 0xD5CE6 Kw_Wu16 65535.00 OneToOne 0.00 65535.00 FORMAT "%8.2" /end CHARACTERISTIC
/begin CHARACTERISTIC FrmMng_DebCsTORQUE_DSCDef_C "#SSD debouncing of checksum-error TORQUE_DSC (no.of events)" VALUE 0xD5CE8 Kw_Wu16 65535.00 OneToOne 0.00 65535.00 FORMAT "%8.2" /end CHARACTERISTIC
/begin CHARACTERISTIC FrmMng_DebCsTORQUE_DSCOk_C "debouncing of checksum-error TORQUE_DSC (no.of events)" VALUE 0xD5CEA Kw_Wu16 65535.00 OneToOne 0.00 65535.00 FORMAT "%8.2" /end CHARACTERISTIC
/begin CHARACTERISTIC FrmMng_DebCsTORQUE_GEARBXDef_C "#SSD debouncing of checksum-error TORQUE_GEARBX (no.of events)" VALUE 0xD5CEC Kw_Wu16 65535.00 OneToOne 0.00 65535.00 FORMAT "%8.2" /end CHARACTERISTIC
/begin CHARACTERISTIC FrmMng_DebCsTORQUE_GEARBXOk_C "debouncing of checksum-error TORQUE_GEARBX (no.of events)" VALUE 0xD5CEE Kw_Wu16 65535.00 OneToOne 0.00 65535.00 FORMAT "%8.2" /end CHARACTERISTIC
/begin CHARACTERISTIC FrmMng_DebCsVEH_MODDef_C "defect time for VEH_MOD" VALUE 0xD5CF0 Kw_Wu16 65535.00 OneToOne 0.00 65535.00 FORMAT "%8.2" /end CHARACTERISTIC
/begin CHARACTERISTIC FrmMng_DebCsVEH_MODOk_C "Defect debouncing for check sum for VEH_MOD signal" VALUE 0xD5CF2 Kw_Wu16 65535.00 OneToOne 0.00 65535.00 FORMAT "%8.2" /end CHARACTERISTIC
/begin CHARACTERISTIC FrmMng_DebSigANFRADMOMPTDef_C "Defektentprellung für RADMOM_PT_1-messages Signalfehler" VALUE 0xD5CF4 Kw_Wu16 65535.00 OneToOne 0.00 65535.00 FORMAT "%8.2" /end CHARACTERISTIC
/begin CHARACTERISTIC FrmMng_DebSigANFRADMOMPTOk_C "Heilentprellung für RADMOM_PT_1-messages Signalfehler" VALUE 0xD5CF6 Kw_Wu16 65535.00 OneToOne 0.00 65535.00 FORMAT "%8.2" /end CHARACTERISTIC
/begin CHARACTERISTIC FrmMng_ctDebSigASC1Def_C "Entprellung von Signalfehler bei ASC1" VALUE 0xD5F92 Kw_Wu16 65535.00 OneToOne 0.00 65535.00 FORMAT "%8.2" /end CHARACTERISTIC
/begin CHARACTERISTIC FrmMng_ctDebSigASC1Ok_C "Entprellung von Signalfehler bei ASC1" VALUE 0xD5F94 Kw_Wu16 65535.00 OneToOne 0.00 65535.00 FORMAT "%8.2" /end CHARACTERISTIC
/begin CHARACTERISTIC FrmMng_ctDebSigASC2Def_C "Entprellung von Signalfehler bei ASC2" VALUE 0xD5F96 Kw_Wu16 65535.00 OneToOne 0.00 65535.00 FORMAT "%8.2" /end CHARACTERISTIC
/begin CHARACTERISTIC FrmMng_ctDebSigASC2Ok_C "Entprellung von Signalfehler bei ASC2" VALUE 0xD5F98 Kw_Wu16 65535.00 OneToOne 0.00 65535.00 FORMAT "%8.2" /end CHARACTERISTIC
/begin CHARACTERISTIC FrmMng_ctDebSigASC3Def_C "Entprellung von Signalfehler bei ASC3" VALUE 0xD5F9A Kw_Wu16 65535.00 OneToOne 0.00 65535.00 FORMAT "%8.2" /end CHARACTERISTIC
/begin CHARACTERISTIC FrmMng_ctDebSigASC3Ok_C "Entprellung von Signalfehler bei ASC3" VALUE 0xD5F9C Kw_Wu16 65535.00 OneToOne 0.00 65535.00 FORMAT "%8.2" /end CHARACTERISTIC
/begin CHARACTERISTIC FrmMng_ctDebSigASC4Def_C "Debounce für signal Fehler defekt im Botschaft ASC4" VALUE 0xD5F9E Kw_Wu16 65535.00 OneToOne 0.00 65535.00 FORMAT "%8.2" /end CHARACTERISTIC
/begin CHARACTERISTIC FrmMng_ctDebSigASC4Ok_C "Entprellung von Signalfehler bei ASC4" VALUE 0xD5FA0 Kw_Wu16 65535.00 OneToOne 0.00 65535.00 FORMAT "%8.2" /end CHARACTERISTIC
/begin CHARACTERISTIC FrmMng_DebSigBOS_RESET_2Def_C "" VALUE 0xD5CF8 Kw_Wu16 65535.00 OneToOne 0.00 65535.00 FORMAT "%8.2" /end CHARACTERISTIC
/begin CHARACTERISTIC FrmMng_DebSigBOS_RESET_2Ok_C "" VALUE 0xD5CFA Kw_Wu16 65535.00 OneToOne 0.00 65535.00 FORMAT "%8.2" /end CHARACTERISTIC
/begin CHARACTERISTIC FrmMng_DebSigBOS_RESETDef_C "debouncing of signal-error BOS_RESET (no.of events)" VALUE 0xD5CFC Kw_Wu16 65535.00 OneToOne 0.00 65535.00 FORMAT "%8.2" /end CHARACTERISTIC
/begin CHARACTERISTIC FrmMng_DebSigBOS_RESETOk_C "debouncing of signal-error BOS_RESET (no.of events)" VALUE 0xD5CFE Kw_Wu16 65535.00 OneToOne 0.00 65535.00 FORMAT "%8.2" /end CHARACTERISTIC
/begin CHARACTERISTIC FrmMng_DebSigDMOMENT_ACCDef_C "#SSD Defect time of DMOMENT_ACC sig" VALUE 0xD5D00 Kw_Wu16 65535.00 OneToOne 0.00 65535.00 FORMAT "%8.2" /end CHARACTERISTIC
/begin CHARACTERISTIC FrmMng_DebSigDMOMENT_ACCOk_C "Healing time of  DMOMENT_ACC sig" VALUE 0xD5D02 Kw_Wu16 65535.00 OneToOne 0.00 65535.00 FORMAT "%8.2" /end CHARACTERISTIC
/begin CHARACTERISTIC FrmMng_ctDebSigEGS1Def_C "Entprellung von Signalfehler bei EGS1" VALUE 0xD5FA2 Kw_Wu16 65535.00 OneToOne 0.00 65535.00 FORMAT "%8.2" /end CHARACTERISTIC
/begin CHARACTERISTIC FrmMng_ctDebSigEGS1Ok_C "Entprellung von Signalfehler bei EGS1" VALUE 0xD5FA4 Kw_Wu16 65535.00 OneToOne 0.00 65535.00 FORMAT "%8.2" /end CHARACTERISTIC
/begin CHARACTERISTIC FrmMng_ctDebSigEGS2Def_C "Entprellung von Signalfehler bei EGS2" VALUE 0xD5FA6 Kw_Wu16 65535.00 OneToOne 0.00 65535.00 FORMAT "%8.2" /end CHARACTERISTIC
/begin CHARACTERISTIC FrmMng_ctDebSigEGS2Ok_C "Entprellung von Signalfehler bei EGS2" VALUE 0xD5FA8 Kw_Wu16 65535.00 OneToOne 0.00 65535.00 FORMAT "%8.2" /end CHARACTERISTIC
/begin CHARACTERISTIC FrmMng_DebSigGEARBX_DATA2Def_C "debouncing of signal-error GEARBX_DATA2 (no.of events)" VALUE 0xD5D04 Kw_Wu16 65535.00 OneToOne 0.00 65535.00 FORMAT "%8.2" /end CHARACTERISTIC
/begin CHARACTERISTIC FrmMng_DebSigGEARBX_DATA2Ok_C "debouncing of signal-error GEARBX_DATA (no.of events)" VALUE 0xD5D06 Kw_Wu16 65535.00 OneToOne 0.00 65535.00 FORMAT "%8.2" /end CHARACTERISTIC
/begin CHARACTERISTIC FrmMng_DebSigGEARBX_DATADef_C "debouncing of signal-error GEARBX_DATA (no.of events)" VALUE 0xD5D08 Kw_Wu16 65535.00 OneToOne 0.00 65535.00 FORMAT "%8.2" /end CHARACTERISTIC
/begin CHARACTERISTIC FrmMng_DebSigGEARBX_DATAOk_C "debouncing of signal-error GEARBX_DATA (no.of events)" VALUE 0xD5D0A Kw_Wu16 65535.00 OneToOne 0.00 65535.00 FORMAT "%8.2" /end CHARACTERISTIC
/begin CHARACTERISTIC FrmMng_DebSigHEAT_ACDef_C "debouncing of signal-error HEAT_AC (no.of events)" VALUE 0xD5D0C Kw_Wu16 65535.00 OneToOne 0.00 65535.00 FORMAT "%8.2" /end CHARACTERISTIC
/begin CHARACTERISTIC FrmMng_DebSigHEAT_ACOk_C "debouncing of signal-error HEAT_AC (no.of events)" VALUE 0xD5D0E Kw_Wu16 65535.00 OneToOne 0.00 65535.00 FORMAT "%8.2" /end CHARACTERISTIC
/begin CHARACTERISTIC FrmMng_ctDebSigINSTR2Def_C "Defekterkennung von Signalfehlern der INSTR2-Botschaft" VALUE 0xD5FAA Kw_Wu16 65535.00 OneToOne 0.00 65535.00 FORMAT "%8.2" /end CHARACTERISTIC
/begin CHARACTERISTIC FrmMng_ctDebSigINSTR2Ok_C "Heilerkennung von Signalfehlern der INSTR2-Botschaft" VALUE 0xD5FAC Kw_Wu16 65535.00 OneToOne 0.00 65535.00 FORMAT "%8.2" /end CHARACTERISTIC
/begin CHARACTERISTIC FrmMng_ctDebSigINSTR3Def_C "Defekterkennung Signalfehler der INSTR3-Botschaft" VALUE 0xD5FAE Kw_Wu16 65535.00 OneToOne 0.00 65535.00 FORMAT "%8.2" /end CHARACTERISTIC
/begin CHARACTERISTIC FrmMng_ctDebSigINSTR3Ok_C "Heilerkennung Signalfehler der INSTR3-Botschaft" VALUE 0xD5FB0 Kw_Wu16 65535.00 OneToOne 0.00 65535.00 FORMAT "%8.2" /end CHARACTERISTIC
/begin CHARACTERISTIC FrmMng_DebSigMILEAGE_RANGEDef_C "#SSD debouncing of signal-error MILEAGE_RANGE ( no of events )" VALUE 0xD5D10 Kw_Wu16 65535.00 OneToOne 0.00 65535.00 FORMAT "%8.2" /end CHARACTERISTIC
/begin CHARACTERISTIC FrmMng_DebSigMILEAGE_RANGEOk_C "debounce of signal - error MILEAGE_RANGE( no of events)" VALUE 0xD5D12 Kw_Wu16 65535.00 OneToOne 0.00 65535.00 FORMAT "%8.2" /end CHARACTERISTIC
/begin CHARACTERISTIC FrmMng_DebSigOPCRCTLACCDef_C "#SSD debouncing of signal OPCRCTLACC (no.of events)" VALUE 0xD5D14 Kw_Wu16 65535.00 OneToOne 0.00 65535.00 FORMAT "%8.2" /end CHARACTERISTIC
/begin CHARACTERISTIC FrmMng_DebSigOPCRCTLACCOk_C "debouncing of signal OPCRCTLACC (no.of events)" VALUE 0xD5D16 Kw_Wu16 65535.00 OneToOne 0.00 65535.00 FORMAT "%8.2" /end CHARACTERISTIC
/begin CHARACTERISTIC FrmMng_DebSigParkConsumerDef_C "Defektentprellzeit des Signalfehlers der CAN-Botschaft PWMG_STANDVERBR" VALUE 0xD5D18 Kw_Wu16 65535.00 OneToOne 0.00 65535.00 FORMAT "%8.2" /end CHARACTERISTIC
/begin CHARACTERISTIC FrmMng_DebSigParkConsumerOk_C "Heilungsentprellzeit des Signalfehlers der CAN-Botschaft PWMG_STANDVERBR" VALUE 0xD5D1A Kw_Wu16 65535.00 OneToOne 0.00 65535.00 FORMAT "%8.2" /end CHARACTERISTIC
/begin CHARACTERISTIC FrmMng_DebSigPRGG_CCTRDef_C "Defect time for PRGG_CCTR-signalerror" VALUE 0xD5D1C Kw_Wu16 65535.00 OneToOne 0.00 65535.00 FORMAT "%8.2" /end CHARACTERISTIC
/begin CHARACTERISTIC FrmMng_DebSigPRGG_CCTROk_C "Healing time for PRGG_CCTR-signalerror" VALUE 0xD5D1E Kw_Wu16 65535.00 OneToOne 0.00 65535.00 FORMAT "%8.2" /end CHARACTERISTIC
/begin CHARACTERISTIC FrmMng_DebSigPWRMNG_LOADVDef_C "" VALUE 0xD5D20 Kw_Wu16 65535.00 OneToOne 0.00 65535.00 FORMAT "%8.2" /end CHARACTERISTIC
/begin CHARACTERISTIC FrmMng_DebSigPWRMNG_LOADVOk_C "" VALUE 0xD5D22 Kw_Wu16 65535.00 OneToOne 0.00 65535.00 FORMAT "%8.2" /end CHARACTERISTIC
/begin CHARACTERISTIC FrmMng_DebSigRQ_STG_EFANDef_C "Defektentprellung für RQ_STG_EFAN-messages Signalfehler" VALUE 0xD5D24 Kw_Wu16 65535.00 OneToOne 0.00 65535.00 FORMAT "%8.2" /end CHARACTERISTIC
/begin CHARACTERISTIC FrmMng_DebSigRQ_STG_EFANOk_C "Heilentprellung für RQ_STG_EFAN messages Signalfehler" VALUE 0xD5D26 Kw_Wu16 65535.00 OneToOne 0.00 65535.00 FORMAT "%8.2" /end CHARACTERISTIC
/begin CHARACTERISTIC FrmMng_ctDebSigSITZGURTDef_C "STAT_SITZBELEGUNG_GURT rohes messagebyte 0" VALUE 0xD5D28 Kw_Wu16 65535.00 OneToOne 0.00 65535.00 FORMAT "%8.2" /end CHARACTERISTIC
/begin CHARACTERISTIC FrmMng_ctDebSigSITZGURTOk_C "Heilentprellung für STAT_SITZBELEGUNG_GURT-messages Signalfehler" VALUE 0xD5D2A Kw_Wu16 65535.00 OneToOne 0.00 65535.00 FORMAT "%8.2" /end CHARACTERISTIC
/begin CHARACTERISTIC FrmMng_DebSigSTAT_ANHDef_C "" VALUE 0xD5D2C Kw_Wu16 65535.00 OneToOne 0.00 65535.00 FORMAT "%8.2" /end CHARACTERISTIC
/begin CHARACTERISTIC FrmMng_DebSigSTAT_ANHOk_C "" VALUE 0xD5D2E Kw_Wu16 65535.00 OneToOne 0.00 65535.00 FORMAT "%8.2" /end CHARACTERISTIC
/begin CHARACTERISTIC FrmMng_DebSigSTAT_ARSDef_C "#SSD debouncing of signal-error STAT_ARS (no.of events)" VALUE 0xD5D30 Kw_Wu16 65535.00 OneToOne 0.00 65535.00 FORMAT "%8.2" /end CHARACTERISTIC
/begin CHARACTERISTIC FrmMng_DebSigSTAT_ARSOk_C "debouncing of signal-error STAT_ARS (no.of events)" VALUE 0xD5D32 Kw_Wu16 65535.00 OneToOne 0.00 65535.00 FORMAT "%8.2" /end CHARACTERISTIC
/begin CHARACTERISTIC FrmMng_DebSigSTAT_DSCDef_C "#SSD debouncing of signal-error STAT_DSC (no.of events)" VALUE 0xD5D34 Kw_Wu16 65535.00 OneToOne 0.00 65535.00 FORMAT "%8.2" /end CHARACTERISTIC
/begin CHARACTERISTIC FrmMng_DebSigSTAT_DSCOk_C "debouncing of signal-error STAT_DSC (no.of events)" VALUE 0xD5D36 Kw_Wu16 65535.00 OneToOne 0.00 65535.00 FORMAT "%8.2" /end CHARACTERISTIC
/begin CHARACTERISTIC FrmMng_DebSigSTAT_EKPDef_C "Defektentprellung für STAT_EKP-messages Signalfehler" VALUE 0xD5D38 Kw_Wu16 65535.00 OneToOne 0.00 65535.00 FORMAT "%8.2" /end CHARACTERISTIC
/begin CHARACTERISTIC FrmMng_DebSigSTAT_EKPOk_C "Heilentprellung für STAT_EKP messages Signalfehler" VALUE 0xD5D3A Kw_Wu16 65535.00 OneToOne 0.00 65535.00 FORMAT "%8.2" /end CHARACTERISTIC
/begin CHARACTERISTIC FrmMng_DebSigSTAT_KOMBIDef_C "#SSD debouncing of signal-error STAT_KOMBI (no.of events)" VALUE 0xD5D3C Kw_Wu16 65535.00 OneToOne 0.00 65535.00 FORMAT "%8.2" /end CHARACTERISTIC
/begin CHARACTERISTIC FrmMng_DebSigSTAT_KOMBIOk_C "debouncing of signal-error STAT_KOMBI (no.of events)" VALUE 0xD5D3E Kw_Wu16 65535.00 OneToOne 0.00 65535.00 FORMAT "%8.2" /end CHARACTERISTIC
/begin CHARACTERISTIC FrmMng_ctDebOBDGbxMilOfDef_C "Defektl-Entprellzähler für MilOf" VALUE 0xD5D40 Kw_Wu16 655350.0 Time_ms 0.00 655350.0 FORMAT "%8.1" /end CHARACTERISTIC
/begin CHARACTERISTIC FrmMng_ctDebSigStOBDGbxMilOfOk_C "Healing time for MIL off" VALUE 0xD5D42 Kw_Wu16 655350.0 Time_ms 0.00 655350.0 FORMAT "%8.1" /end CHARACTERISTIC
/begin CHARACTERISTIC FrmMng_ctDebOBDGbxMilOnDef_C "Defekt-Entprellzähler für MilOn" VALUE 0xD5D44 Kw_Wu16 655350.0 Time_ms 0.00 655350.0 FORMAT "%8.1" /end CHARACTERISTIC
/begin CHARACTERISTIC FrmMng_ctDebSigStOBDGbxMilOnOk_C "Healing time for MIL on" VALUE 0xD5D46 Kw_Wu16 655350.0 Time_ms 0.00 655350.0 FORMAT "%8.1" /end CHARACTERISTIC
/begin CHARACTERISTIC FrmMng_DebSigTEMPRELTIMEDef_C "debouncing of signal-error PWRMNGLOADV (no.of events)" VALUE 0xD5D48 Kw_Wu16 65535.00 OneToOne 0.00 65535.00 FORMAT "%8.2" /end CHARACTERISTIC
/begin CHARACTERISTIC FrmMng_DebSigTEMPRELTIMEOk_C "debouncing of signal-error PWRMNGLOADV (no.of events)" VALUE 0xD5D4A Kw_Wu16 65535.00 OneToOne 0.00 65535.00 FORMAT "%8.2" /end CHARACTERISTIC
/begin CHARACTERISTIC FrmMng_DebSigTERMINALDef_C "debouncing of signal-error TERMINAL(no.of events)" VALUE 0xD5D4C Kw_Wu16 65535.00 OneToOne 0.00 65535.00 FORMAT "%8.2" /end CHARACTERISTIC
/begin CHARACTERISTIC FrmMng_DebSigTERMINALOk_C "debouncing of signal-error TERMINAL(no.of events)" VALUE 0xD5D4E Kw_Wu16 65535.00 OneToOne 0.00 65535.00 FORMAT "%8.2" /end CHARACTERISTIC
/begin CHARACTERISTIC FrmMng_DebSigTIME_DATEDef_C "" VALUE 0xD5D50 Kw_Wu16 65535.00 OneToOne 0.00 65535.00 FORMAT "%8.2" /end CHARACTERISTIC
/begin CHARACTERISTIC FrmMng_DebSigTIME_DATEOk_C "" VALUE 0xD5D52 Kw_Wu16 65535.00 OneToOne 0.00 65535.00 FORMAT "%8.2" /end CHARACTERISTIC
/begin CHARACTERISTIC FrmMng_DebSigTORQUE_DSCDef_C "#SSD debouncing of signal-error TORQUE_DSC (no.of events)" VALUE 0xD5D54 Kw_Wu16 65535.00 OneToOne 0.00 65535.00 FORMAT "%8.2" /end CHARACTERISTIC
/begin CHARACTERISTIC FrmMng_DebSigTORQUE_DSCOk_C "debouncing of signal-error TORQUE_DSC (no.of events)" VALUE 0xD5D56 Kw_Wu16 65535.00 OneToOne 0.00 65535.00 FORMAT "%8.2" /end CHARACTERISTIC
/begin CHARACTERISTIC FrmMng_DebSigTORQUE_GEARBXDef_C "#SSD debouncing of signal-error TORQUE_GEARBX (no.of events)" VALUE 0xD5D58 Kw_Wu16 65535.00 OneToOne 0.00 65535.00 FORMAT "%8.2" /end CHARACTERISTIC
/begin CHARACTERISTIC FrmMng_DebSigTORQUE_GEARBXOk_C "debouncing of signal-error TORQUE_GEARBX (no.of events)" VALUE 0xD5D5A Kw_Wu16 65535.00 OneToOne 0.00 65535.00 FORMAT "%8.2" /end CHARACTERISTIC
/begin CHARACTERISTIC FrmMng_DebSigVEH_MODDef_C "defect debouncing time for signal error for VEH_MOD signal" VALUE 0xD5D5C Kw_Wu16 65535.00 OneToOne 0.00 65535.00 FORMAT "%8.2" /end CHARACTERISTIC
/begin CHARACTERISTIC FrmMng_DebSigVEH_MODOk_C "Debouncing time for sig error for VEH_MOD signal" VALUE 0xD5D5E Kw_Wu16 65535.00 OneToOne 0.00 65535.00 FORMAT "%8.2" /end CHARACTERISTIC
/begin CHARACTERISTIC FrmMng_DebSigVELOCITYDef_C "debouncing of signal-error VELOCITY (no.of events)" VALUE 0xD5D60 Kw_Wu16 65535.00 OneToOne 0.00 65535.00 FORMAT "%8.2" /end CHARACTERISTIC
/begin CHARACTERISTIC FrmMng_DebSigVELOCITYOk_C "debouncing of signal-error VELOCITY (no.of events)" VALUE 0xD5D62 Kw_Wu16 65535.00 OneToOne 0.00 65535.00 FORMAT "%8.2" /end CHARACTERISTIC
/begin CHARACTERISTIC FrmMng_ctDebSigWHEEL_SPEEDDef_C "Fehlerentprellzeit für CAN message Wheel Speed (Signalfehler)" VALUE 0xD5D64 Kw_Wu16 65535.00 OneToOne 0.00 65535.00 FORMAT "%8.2" /end CHARACTERISTIC
/begin CHARACTERISTIC FrmMng_ctDebSigWHEEL_SPEEDOk_C "Heilungsentprellzeit für CAN message Wheel Speed (Signalfehler)" VALUE 0xD5D66 Kw_Wu16 65535.00 OneToOne 0.00 65535.00 FORMAT "%8.2" /end CHARACTERISTIC
/begin CHARACTERISTIC FrmMng_DebTGearbxDef_C "debouncing of TGearbx for defect detection" VALUE 0xD5D68 Kw_Wu16 65535.00 OneToOne 0.00 65535.00 FORMAT "%8.2" /end CHARACTERISTIC
/begin CHARACTERISTIC FrmMng_DebTGearbxOk_C "debouncing of TGearbx for healing" VALUE 0xD5D6A Kw_Wu16 65535.00 OneToOne 0.00 65535.00 FORMAT "%8.2" /end CHARACTERISTIC
/begin CHARACTERISTIC FrmMng_DebToANFRADMOMPTDef_C "Defektentprellung für RADMOM_PT_1-messages Timeout" VALUE 0xD5D6C Kw_Wu16 65535.00 OneToOne 0.00 65535.00 FORMAT "%8.2" /end CHARACTERISTIC
/begin CHARACTERISTIC FrmMng_DebToANFRADMOMPTOk_C "Heilentprellung für RADMOM_PT_1-messages Timeout" VALUE 0xD5D6E Kw_Wu16 65535.00 OneToOne 0.00 65535.00 FORMAT "%8.2" /end CHARACTERISTIC
/begin CHARACTERISTIC FrmMng_ctDebToASC1Def_C "Entprellung von Signal-Timeout bei ASC1" VALUE 0xD5FB2 Kw_Wu16 65535.00 OneToOne 0.00 65535.00 FORMAT "%8.2" /end CHARACTERISTIC
/begin CHARACTERISTIC FrmMng_ctDebToASC1Ok_C "Entprellzähler, Heilung ASC1 Signal-Timeout" VALUE 0xD5FB4 Kw_Wu16 65535.00 OneToOne 0.00 65535.00 FORMAT "%8.2" /end CHARACTERISTIC
/begin CHARACTERISTIC FrmMng_ctDebToASC2Def_C "Entprellung des timeout - Error ASC2" VALUE 0xD5FB6 Kw_Wu16 65535.00 OneToOne 0.00 65535.00 FORMAT "%8.2" /end CHARACTERISTIC
/begin CHARACTERISTIC FrmMng_ctDebToASC2Ok_C "Entprellung des timeout - Error ASC2" VALUE 0xD5FB8 Kw_Wu16 65535.00 OneToOne 0.00 65535.00 FORMAT "%8.2" /end CHARACTERISTIC
/begin CHARACTERISTIC FrmMng_ctDebToASC3Def_C "Entprellung des timeout - Error ASC3" VALUE 0xD5FBA Kw_Wu16 65535.00 OneToOne 0.00 65535.00 FORMAT "%8.2" /end CHARACTERISTIC
/begin CHARACTERISTIC FrmMng_ctDebToASC3Ok_C "Entprellung des timeout - Error ACS3" VALUE 0xD5FBC Kw_Wu16 65535.00 OneToOne 0.00 65535.00 FORMAT "%8.2" /end CHARACTERISTIC
/begin CHARACTERISTIC FrmMng_ctDebToASC4Def_C "Debounce für Timeout Fehler von Botschaft ASC4" VALUE 0xD5FBE Kw_Wu16 65535.00 OneToOne 0.00 65535.00 FORMAT "%8.2" /end CHARACTERISTIC
/begin CHARACTERISTIC FrmMng_ctDebToASC4Ok_C "Heilentprellung für ASC4-Botschaft Timeout" VALUE 0xD5FC0 Kw_Wu16 65535.00 OneToOne 0.00 65535.00 FORMAT "%8.2" /end CHARACTERISTIC
/begin CHARACTERISTIC FrmMng_DebToBOS_RESET_2Def_C "" VALUE 0xD5D70 Kw_Wu16 65535.00 OneToOne 0.00 65535.00 FORMAT "%8.2" /end CHARACTERISTIC
/begin CHARACTERISTIC FrmMng_DebToBOS_RESET_2Ok_C "" VALUE 0xD5D72 Kw_Wu16 65535.00 OneToOne 0.00 65535.00 FORMAT "%8.2" /end CHARACTERISTIC
/begin CHARACTERISTIC FrmMng_DebToBOS_RESETDef_C "debouncing of timeout-error BOS_RESET (no.of events)" VALUE 0xD5D74 Kw_Wu16 65535.00 OneToOne 0.00 65535.00 FORMAT "%8.2" /end CHARACTERISTIC
/begin CHARACTERISTIC FrmMng_DebToBOS_RESETOk_C "debouncing of timeout-error BOS_RESET (no.of events)" VALUE 0xD5D76 Kw_Wu16 65535.00 OneToOne 0.00 65535.00 FORMAT "%8.2" /end CHARACTERISTIC
/begin CHARACTERISTIC FrmMng_DebToDMOMENT_ACCDef_C "#SSD Defect time of DMOMENT_ACC time out" VALUE 0xD5D78 Kw_Wu16 65535.00 OneToOne 0.00 65535.00 FORMAT "%8.2" /end CHARACTERISTIC
/begin CHARACTERISTIC FrmMng_DebToDMOMENT_ACCOk_C "Healing time  of  DMOMENT_ACC  time out" VALUE 0xD5D7A Kw_Wu16 65535.00 OneToOne 0.00 65535.00 FORMAT "%8.2" /end CHARACTERISTIC
/begin CHARACTERISTIC FrmMng_ctDebToEGS1Def_C "Entprellung des timeout - Error EGS1" VALUE 0xD5FC2 Kw_Wu16 65535.00 OneToOne 0.00 65535.00 FORMAT "%8.2" /end CHARACTERISTIC
/begin CHARACTERISTIC FrmMng_ctDebToEGS1Ok_C "Entprellung des Timeout - Error" VALUE 0xD5FC4 Kw_Wu16 65535.00 OneToOne 0.00 65535.00 FORMAT "%8.2" /end CHARACTERISTIC
/begin CHARACTERISTIC FrmMng_ctDebToEGS2Def_C "Entprellung des timeout - Error EGS2" VALUE 0xD5FC6 Kw_Wu16 65535.00 OneToOne 0.00 65535.00 FORMAT "%8.2" /end CHARACTERISTIC
/begin CHARACTERISTIC FrmMng_ctDebToEGS2Ok_C "Entprellung des timeout - Error EGS2" VALUE 0xD5FC8 Kw_Wu16 65535.00 OneToOne 0.00 65535.00 FORMAT "%8.2" /end CHARACTERISTIC
/begin CHARACTERISTIC FrmMng_DebToGEARBX_DATA2Def_C "debouncing of timeout-error GEARBX_DATA2 (no.of events)" VALUE 0xD5D7C Kw_Wu16 65535.00 OneToOne 0.00 65535.00 FORMAT "%8.2" /end CHARACTERISTIC
/begin CHARACTERISTIC FrmMng_DebToGEARBX_DATA2Ok_C "Healing time for GEARBX_DATA2-messages Timeout" VALUE 0xD5D7E Kw_Wu16 65535.00 OneToOne 0.00 65535.00 FORMAT "%8.2" /end CHARACTERISTIC
/begin CHARACTERISTIC FrmMng_DebToGEARBX_DATADef_C "debouncing of timeout-error GEARBX_DATA (no.of events)" VALUE 0xD5D80 Kw_Wu16 65535.00 OneToOne 0.00 65535.00 FORMAT "%8.2" /end CHARACTERISTIC
/begin CHARACTERISTIC FrmMng_DebToGEARBX_DATAOk_C "debouncing of timeout-error GEARBX_DATA (no.of events)" VALUE 0xD5D82 Kw_Wu16 65535.00 OneToOne 0.00 65535.00 FORMAT "%8.2" /end CHARACTERISTIC
/begin CHARACTERISTIC FrmMng_DebToHEAT_ACDef_C "debouncing of timeout-error HEAT_AC (no.of events)" VALUE 0xD5D84 Kw_Wu16 65535.00 OneToOne 0.00 65535.00 FORMAT "%8.2" /end CHARACTERISTIC
/begin CHARACTERISTIC FrmMng_DebToHEAT_ACOk_C "debouncing of timeout-error HEAT_AC (no.of events)" VALUE 0xD5D86 Kw_Wu16 65535.00 OneToOne 0.00 65535.00 FORMAT "%8.2" /end CHARACTERISTIC
/begin CHARACTERISTIC FrmMng_ctDebToINSTR2Def_C "Defekterkennung Timeout INSTR2-Botschaft" VALUE 0xD5FCA Kw_Wu16 65535.00 OneToOne 0.00 65535.00 FORMAT "%8.2" /end CHARACTERISTIC
/begin CHARACTERISTIC FrmMng_ctDebToINSTR2Ok_C "Heilerkennung Timeout INSTR2-Botschaft" VALUE 0xD5FCC Kw_Wu16 65535.00 OneToOne 0.00 65535.00 FORMAT "%8.2" /end CHARACTERISTIC
/begin CHARACTERISTIC FrmMng_ctDebToINSTR3Def_C "Defekterkennung Timeout INSTR3-Botschaft" VALUE 0xD5FCE Kw_Wu16 65535.00 OneToOne 0.00 65535.00 FORMAT "%8.2" /end CHARACTERISTIC
/begin CHARACTERISTIC FrmMng_ctDebToINSTR3Ok_C "Heilerkennung Timeout INSTR3-Botschaft" VALUE 0xD5FD0 Kw_Wu16 65535.00 OneToOne 0.00 65535.00 FORMAT "%8.2" /end CHARACTERISTIC
/begin CHARACTERISTIC FrmMng_DebToMILEAGE_RANGEDef_C "#SSD debouncing of timeout - error MILEAGE_RANGE(no of events)" VALUE 0xD5D88 Kw_Wu16 65535.00 OneToOne 0.00 65535.00 FORMAT "%8.2" /end CHARACTERISTIC
/begin CHARACTERISTIC FrmMng_DebToMILEAGE_RANGEOk_C "debouncing of timeout - error MILEAGE_RANGE (no of events)" VALUE 0xD5D8A Kw_Wu16 65535.00 OneToOne 0.00 65535.00 FORMAT "%8.2" /end CHARACTERISTIC
/begin CHARACTERISTIC FrmMng_DebToOPCRCTLACCDef_C "#SSD debouncing of timeout-error OPCRCTLACC (no.of events)" VALUE 0xD5D8C Kw_Wu16 65535.00 OneToOne 0.00 65535.00 FORMAT "%8.2" /end CHARACTERISTIC
/begin CHARACTERISTIC FrmMng_DebToOPCRCTLACCOk_C "debouncing of timeout-error OPCRCTLACC (no.of events)" VALUE 0xD5D8E Kw_Wu16 65535.00 OneToOne 0.00 65535.00 FORMAT "%8.2" /end CHARACTERISTIC
/begin CHARACTERISTIC FrmMng_DebToParkConsumerDef_C "Defektentprellzeit Botschaftsausfall PWMG_STANDVERBR" VALUE 0xD5D90 Kw_Wu16 65535.00 OneToOne 0.00 65535.00 FORMAT "%8.2" /end CHARACTERISTIC
/begin CHARACTERISTIC FrmMng_DebToParkConsumerOk_C "Heilentprellzeit Botschaftsausfall PWMG_STANDVERBR" VALUE 0xD5D92 Kw_Wu16 65535.00 OneToOne 0.00 65535.00 FORMAT "%8.2" /end CHARACTERISTIC
/begin CHARACTERISTIC FrmMng_DebToPRGG_CCTRDef_C "Defect time for PRGG_CCTR-messages Timeout" VALUE 0xD5D94 Kw_Wu16 65535.00 OneToOne 0.00 65535.00 FORMAT "%8.2" /end CHARACTERISTIC
/begin CHARACTERISTIC FrmMng_DebToPRGG_CCTROk_C "Healing time for PRGG_CCTR-messages Timeout" VALUE 0xD5D96 Kw_Wu16 65535.00 OneToOne 0.00 65535.00 FORMAT "%8.2" /end CHARACTERISTIC
/begin CHARACTERISTIC FrmMng_DebToPWRMNG_LOADVDef_C "" VALUE 0xD5D98 Kw_Wu16 65535.00 OneToOne 0.00 65535.00 FORMAT "%8.2" /end CHARACTERISTIC
/begin CHARACTERISTIC FrmMng_DebToPWRMNG_LOADVOk_C "" VALUE 0xD5D9A Kw_Wu16 65535.00 OneToOne 0.00 65535.00 FORMAT "%8.2" /end CHARACTERISTIC
/begin CHARACTERISTIC FrmMng_DebToRQ_STG_EFANDef_C "Defektentprellung für RQ_STG_EFAN - messages timeout" VALUE 0xD5D9C Kw_Wu16 65535.00 OneToOne 0.00 65535.00 FORMAT "%8.2" /end CHARACTERISTIC
/begin CHARACTERISTIC FrmMng_DebToRQ_STG_EFANOk_C "Heilentprellung für RQ_STG_EFAN - messages timeout" VALUE 0xD5D9E Kw_Wu16 65535.00 OneToOne 0.00 65535.00 FORMAT "%8.2" /end CHARACTERISTIC
/begin CHARACTERISTIC FrmMng_ctDebToSITZGURTDef_C "Defektentprellung für STAT_SITZBELEGUNG_GURT-messages Timeout" VALUE 0xD5DA0 Kw_Wu16 65535.00 OneToOne 0.00 65535.00 FORMAT "%8.2" /end CHARACTERISTIC
/begin CHARACTERISTIC FrmMng_ctDebToSITZGURTOk_C "Heilentprellung für STAT_SITZBELEGUNG_GURT-messages Timeout" VALUE 0xD5DA2 Kw_Wu16 65535.00 OneToOne 0.00 65535.00 FORMAT "%8.2" /end CHARACTERISTIC
/begin CHARACTERISTIC FrmMng_DebToSTAT_ANHDef_C "" VALUE 0xD5DA4 Kw_Wu16 65535.00 OneToOne 0.00 65535.00 FORMAT "%8.2" /end CHARACTERISTIC
/begin CHARACTERISTIC FrmMng_DebToSTAT_ANHOk_C "" VALUE 0xD5DA6 Kw_Wu16 65535.00 OneToOne 0.00 65535.00 FORMAT "%8.2" /end CHARACTERISTIC
/begin CHARACTERISTIC FrmMng_DebToSTAT_ARSDef_C "#SSD debouncing of timeout-error STAT_ARS (no.of events)" VALUE 0xD5DA8 Kw_Wu16 65535.00 OneToOne 0.00 65535.00 FORMAT "%8.2" /end CHARACTERISTIC
/begin CHARACTERISTIC FrmMng_DebToSTAT_ARSOk_C "debouncing of timeout-error STAT_ARS (no.of events)" VALUE 0xD5DAA Kw_Wu16 65535.00 OneToOne 0.00 65535.00 FORMAT "%8.2" /end CHARACTERISTIC
/begin CHARACTERISTIC FrmMng_DebToSTAT_DSCDef_C "#SSD debouncing of timeout-error STAT_DSC (no.of events)" VALUE 0xD5DAC Kw_Wu16 65535.00 OneToOne 0.00 65535.00 FORMAT "%8.2" /end CHARACTERISTIC
/begin CHARACTERISTIC FrmMng_DebToSTAT_DSCOk_C "debouncing of timeout-error STAT_DSC (no.of events)" VALUE 0xD5DAE Kw_Wu16 65535.00 OneToOne 0.00 65535.00 FORMAT "%8.2" /end CHARACTERISTIC
/begin CHARACTERISTIC FrmMng_DebToSTAT_EKPDef_C "Defektentprellung für STAT_EKPmessages  Timeout fehler" VALUE 0xD5DB0 Kw_Wu16 65535.00 OneToOne 0.00 65535.00 FORMAT "%8.2" /end CHARACTERISTIC
/begin CHARACTERISTIC FrmMng_DebToSTAT_EKPOk_C "Heilentprellung  für STAT_EKP-messages Timeout lfehler" VALUE 0xD5DB2 Kw_Wu16 65535.00 OneToOne 0.00 65535.00 FORMAT "%8.2" /end CHARACTERISTIC
/begin CHARACTERISTIC FrmMng_DebToSTAT_KOMBIDef_C "#SSD debouncing of timeout - error STAT_KOMBI (no of events)" VALUE 0xD5DB4 Kw_Wu16 65535.00 OneToOne 0.00 65535.00 FORMAT "%8.2" /end CHARACTERISTIC
/begin CHARACTERISTIC FrmMng_DebToSTAT_KOMBIOk_C "debouncing of timeout - error STAT_KOMBI (no of events)" VALUE 0xD5DB6 Kw_Wu16 65535.00 OneToOne 0.00 65535.00 FORMAT "%8.2" /end CHARACTERISTIC
/begin CHARACTERISTIC FrmMng_DebToTEMPRELTIMEDef_C "debouncing of timeout-error TEMPRELTIME (no.of events)" VALUE 0xD5DB8 Kw_Wu16 65535.00 OneToOne 0.00 65535.00 FORMAT "%8.2" /end CHARACTERISTIC
/begin CHARACTERISTIC FrmMng_DebToTEMPRELTIMEOk_C "debouncing of timeout-error TEMPRELTIME (no.of events)" VALUE 0xD5DBA Kw_Wu16 65535.00 OneToOne 0.00 65535.00 FORMAT "%8.2" /end CHARACTERISTIC
/begin CHARACTERISTIC FrmMng_DebToTERMINALDef_C "debouncing of timeout-error TERMINAL (no.of events)" VALUE 0xD5DBC Kw_Wu16 65535.00 OneToOne 0.00 65535.00 FORMAT "%8.2" /end CHARACTERISTIC
/begin CHARACTERISTIC FrmMng_DebToTERMINALOk_C "debouncing of timeout-error TERMINAL (no.of events)" VALUE 0xD5DBE Kw_Wu16 65535.00 OneToOne 0.00 65535.00 FORMAT "%8.2" /end CHARACTERISTIC
/begin CHARACTERISTIC FrmMng_DebToTIME_DATEDef_C "" VALUE 0xD5DC0 Kw_Wu16 65535.00 OneToOne 0.00 65535.00 FORMAT "%8.2" /end CHARACTERISTIC
/begin CHARACTERISTIC FrmMng_DebToTIME_DATEOk_C "" VALUE 0xD5DC2 Kw_Wu16 65535.00 OneToOne 0.00 65535.00 FORMAT "%8.2" /end CHARACTERISTIC
/begin CHARACTERISTIC FrmMng_DebToTORQUE_DSCDef_C "#SSD debouncing of timeout-error TORQUE_DSC (no.of events)" VALUE 0xD5DC4 Kw_Wu16 65535.00 OneToOne 0.00 65535.00 FORMAT "%8.2" /end CHARACTERISTIC
/begin CHARACTERISTIC FrmMng_DebToTORQUE_DSCOk_C "debouncing of timeout-error TORQUE_DSC (no.of events)" VALUE 0xD5DC6 Kw_Wu16 65535.00 OneToOne 0.00 65535.00 FORMAT "%8.2" /end CHARACTERISTIC
/begin CHARACTERISTIC FrmMng_DebToTORQUE_GEARBXDef_C "#SSD debouncing of timeout-error TORQUE_GEARBX (no.of events)" VALUE 0xD5DC8 Kw_Wu16 65535.00 OneToOne 0.00 65535.00 FORMAT "%8.2" /end CHARACTERISTIC
/begin CHARACTERISTIC FrmMng_DebToTORQUE_GEARBXOk_C "debouncing of timeout-error TORQUE_GEARBX (no.of events)" VALUE 0xD5DCA Kw_Wu16 65535.00 OneToOne 0.00 65535.00 FORMAT "%8.2" /end CHARACTERISTIC
/begin CHARACTERISTIC FrmMng_DebToVEH_MODDef_C "Defect debouncing time VEH_MOD" VALUE 0xD5DCC Kw_Wu16 65535.00 OneToOne 0.00 65535.00 FORMAT "%8.2" /end CHARACTERISTIC
/begin CHARACTERISTIC FrmMng_DebToVEH_MODOk_C "Debouncing OK time for VEH_MOD signal" VALUE 0xD5DCE Kw_Wu16 65535.00 OneToOne 0.00 65535.00 FORMAT "%8.2" /end CHARACTERISTIC
/begin CHARACTERISTIC FrmMng_DebToVELOCITYDef_C "debouncing of timeout-error VELOCITY (no.of events)" VALUE 0xD5DD0 Kw_Wu16 65535.00 OneToOne 0.00 65535.00 FORMAT "%8.2" /end CHARACTERISTIC
/begin CHARACTERISTIC FrmMng_DebToVELOCITYOk_C "debouncing of timeout-error VELOCITY (no.of events)" VALUE 0xD5DD2 Kw_Wu16 65535.00 OneToOne 0.00 65535.00 FORMAT "%8.2" /end CHARACTERISTIC
/begin CHARACTERISTIC FrmMng_ctDebToWHEEL_SPEEDDef_C "#SSD Fehlerentprellzeit für CAN message Wheel Speed (timeout)" VALUE 0xD5DD4 Kw_Wu16 65535.00 OneToOne 0.00 65535.00 FORMAT "%8.2" /end CHARACTERISTIC
/begin CHARACTERISTIC FrmMng_ctDebToWHEEL_SPEEDOk_C "Fehlerheilungszeit für CAN message Wheel Speed (timeout)" VALUE 0xD5DD6 Kw_Wu16 65535.00 OneToOne 0.00 65535.00 FORMAT "%8.2" /end CHARACTERISTIC
/begin CHARACTERISTIC FrmMng_dEngGearbox_C "gearboxcode for multiplexinfo[1]" VALUE 0xD5FD2 Kw_Wu8 63.00 OneToOne 0.00 63.00 FORMAT "%5.2" EXTENDED_LIMITS 0.00 255.0 /end CHARACTERISTIC
/begin CHARACTERISTIC FrmMng_dOBDCtrl_C "mulinfo[3] of DDE2" VALUE 0xD5FD3 Kw_Wu8 63.00 OneToOne 0.00 63.00 FORMAT "%5.2" EXTENDED_LIMITS 0.00 255.0 /end CHARACTERISTIC
/begin CHARACTERISTIC FrmMng_drAPP1Min_C "threshold for accelerator padel 1 value" VALUE 0xD5DD8 Kw_Ws16 5000.000 PrcPerSec 0.00 5000.000 FORMAT "%8.3" EXTENDED_LIMITS -20000.00 19999.39 /end CHARACTERISTIC
/begin CHARACTERISTIC FrmMng_dstGearbx_C "Umrechnung fuer GANG_INF" VAL_BLK 0xD5FD4 Kwb_Wu8 16.00 OneToOne 0.00 16.00 FORMAT "%5.2" EXTENDED_LIMITS 0.00 255.0 NUMBER 8 /end CHARACTERISTIC
/begin CHARACTERISTIC FrmMng_dstGear_C "#SSD translationtable ST_GR_GRB to FrmMng_stGear" VAL_BLK 0xD5DDA Kwb_Wu8 14.00 OneToOne 0.00 14.00 FORMAT "%5.2" EXTENDED_LIMITS 0.00 255.0 NUMBER 15 /end CHARACTERISTIC
/begin CHARACTERISTIC FrmMng_dTrqWheelRmpUp_C "Negative Radmoment Rampensteigung" VALUE 0xD5DEC Kw_Wu32 13107199.9969 RmpTrqPrp 0.00 13107199.9969 FORMAT "%13.4" /end CHARACTERISTIC
/begin CHARACTERISTIC FrmMng_dTrqWheelRmpDwn_C "Positive Radmoment Rampensteigung" VALUE 0xD5DF0 Kw_Wu32 13107199.9969 RmpTrqPrp 0.00 13107199.9969 FORMAT "%13.4" /end CHARACTERISTIC
/begin CHARACTERISTIC FrmMng_factrqInrStrt_C "Faktor zur Minimierung des inneren Moments im Startfall" VALUE 0xD5DF4 Kw_Wu16 7.999878 Fact 0.00 7.999878 FORMAT "%8.6" /end CHARACTERISTIC
/begin CHARACTERISTIC FrmMng_FDCSelfRec_C "Schalter zur Auswahl des FDC Selbstanerkennung" VALUE 0xD5DF6 Kw_Wu8 1.000 OneToOne 0.00 1.000 FORMAT "%5.3" EXTENDED_LIMITS 0.00 255.0 /end CHARACTERISTIC
/begin CHARACTERISTIC FrmMng_FGRSelfRec_C "Switch to disable/enable FGR self recognition" VALUE 0xD5DF7 Kw_Wu8 1.000 OneToOne 0.00 1.000 FORMAT "%5.3" EXTENDED_LIMITS 0.00 255.0 /end CHARACTERISTIC
/begin CHARACTERISTIC FrmMng_cnvFLLV_FUTA_Offset_C "#SSD Offset to calculate FST from CAN" VALUE 0xD5DF8 Kw_Ws16 65535.00 OneToOne -32768.00 32767.00 FORMAT "%8.2" /end CHARACTERISTIC
/begin CHARACTERISTIC FrmMng_cnvFLLV_FUTA_Slope_C "#SSD Slope to calculate FST from CAN" VALUE 0xD5DFA Kw_Ws16 65.53500 SlopeRes1000 -32.76800 32.76700 FORMAT "%8.5" /end CHARACTERISTIC
/begin CHARACTERISTIC FrmMng_fst_Offset_C "Umrechnung Füllstand CAN-->intern Offset" VALUE 0xD5FDC Kw_Ws16 65535.00 OneToOne -32768.00 32767.00 FORMAT "%8.2" /end CHARACTERISTIC
/begin CHARACTERISTIC FrmMng_fst_Slope_C "Umrechnung Füllstand CAN-->intern Steigung" VALUE 0xD5FDE Kw_Ws16 65.53500 SlopeRes1000 -32.76800 32.76700 FORMAT "%8.5" /end CHARACTERISTIC
/begin CHARACTERISTIC FrmMng_kmst_Offset_C "Offset für Kilometerstandsumrechnung" VALUE 0xD5FE0 Kw_Ws16 65535.00 OneToOne -32768.00 32767.00 FORMAT "%8.2" /end CHARACTERISTIC
/begin CHARACTERISTIC FrmMng_kmst_Slope_C "Slope für Kilometerstandsumrechnung" VALUE 0xD5FE2 Kw_Ws16 65.53500 SlopeRes1000 -32.76800 32.76700 FORMAT "%8.5" /end CHARACTERISTIC
/begin CHARACTERISTIC FrmMng_mskDM_ANF_ACC_0x800_C "" VALUE 0xD5DFC Kw_Wu8 255.0 OneToOne 0.00 255.0 FORMAT "%5.1" /end CHARACTERISTIC
/begin CHARACTERISTIC FrmMng_mskDM_ANF_AFS_C "mask for the status bits to supress unwanted errors" VALUE 0xD5DFD Kw_Wu8 255.0 OneToOne 0.00 255.0 FORMAT "%5.1" /end CHARACTERISTIC
/begin CHARACTERISTIC FrmMng_mskDM_ANF_SSG_C "Maske um mittels Status Bits div. Fehler auszublenden" VALUE 0xD5DFE Kw_Wu8 255.0 OneToOne 0.00 255.0 FORMAT "%5.1" /end CHARACTERISTIC
/begin CHARACTERISTIC FrmMng_mskSTAT_ARS_C "mask signalerrors" VALUE 0xD5DFF Kw_Wu8 255.0 OneToOne 0.00 255.0 FORMAT "%5.1" /end CHARACTERISTIC
/begin CHARACTERISTIC FrmMng_mskTORQUE_DSC_C "mask signal errors" VALUE 0xD5E00 Kw_Wu8 255.0 OneToOne 0.00 255.0 FORMAT "%5.1" /end CHARACTERISTIC
/begin CHARACTERISTIC FrmMng_mskTORQUE_GEARBX_C " mask signalerrors" VALUE 0xD5E01 Kw_Wu8 255.0 OneToOne 0.00 255.0 FORMAT "%5.1" /end CHARACTERISTIC
/begin CHARACTERISTIC FrmMng_nAvrg_Def_C "Fehlerwert für nAvrg" VALUE 0xD5FE4 Kw_Wu16 10240.00 EngN 0.00 10240.00 FORMAT "%8.2" EXTENDED_LIMITS 0.00 65535.00 /end CHARACTERISTIC
/begin CHARACTERISTIC FrmMng_nAvrg_Slope_C "Slope für nAvrg" VALUE 0xD5FE6 Kw_Wu16 32767.00 OneToOne 0.00 32767.00 FORMAT "%8.2" EXTENDED_LIMITS 0.00 65535.00 /end CHARACTERISTIC
/begin CHARACTERISTIC FrmMng_nDiv_Fac_C "Divisionsfaktor für nAvrg Slope" VALUE 0xD5FE8 Kw_Wu16 32767.00 OneToOne 0.00 32767.00 FORMAT "%8.2" EXTENDED_LIMITS 0.00 65535.00 /end CHARACTERISTIC
/begin CHARACTERISTIC FrmMng_nEngOFF_C "Engine speed threshold for engine state" VALUE 0xD5E02 Kw_Ws16 8000.000 EngN 0.00 8000.000 FORMAT "%8.3" EXTENDED_LIMITS -32768.00 32767.00 /end CHARACTERISTIC
/begin CHARACTERISTIC FrmMng_nEngRpm1_CUR "Curve for calculating the engine speed threshold 1" CURVE 0xD5E04 Kl_Xs16_Ws16 5960.000 EngN 40.00000 6000.000 FORMAT "%8.3" EXTENDED_LIMITS -32768.00 32767.00
 /begin AXIS_DESCR STD_AXIS FrmMng_tEngRpm_mp Temp_Cels 6 -50.14000 199.8600 FORMAT "%8.4" EXTENDED_LIMITS -3549.940 3003.560 DEPOSIT ABSOLUTE /end AXIS_DESCR
/end CHARACTERISTIC
/begin CHARACTERISTIC FrmMng_nEngRpm2_CUR "Curve for calculating the engine speed threshold 2" CURVE 0xD5E1E Kl_Xs16_Ws16 5960.000 EngN 40.00000 6000.000 FORMAT "%8.3" EXTENDED_LIMITS -32768.00 32767.00
 /begin AXIS_DESCR STD_AXIS FrmMng_tEngRpm_mp Temp_Cels 6 -50.14000 199.8600 FORMAT "%8.4" EXTENDED_LIMITS -3549.940 3003.560 DEPOSIT ABSOLUTE /end AXIS_DESCR
/end CHARACTERISTIC
/begin CHARACTERISTIC FrmMng_nFanDflt_C "Unterlassungs-Fan eilt" VALUE 0xD5E38 Kw_Wu16 3000.000 FanSpd 0.00 3000.000 FORMAT "%8.3" EXTENDED_LIMITS 0.00 6000.092 /end CHARACTERISTIC
/begin CHARACTERISTIC FrmMng_nFanErr_C "Fehlerwert für Lüfterdrehzahl" VALUE 0xD5FEA Kw_Ws16 6000.092 FanSpd -3000.092 3000.000 FORMAT "%8.3" /end CHARACTERISTIC
/begin CHARACTERISTIC FrmMng_nFan_C "Umsetzungstabelle Lüfterstufe --> Lüfterdrehzahl" VAL_BLK 0xD5FEC Kwb_Ws16 3000.000 FanSpd 0.00 3000.000 FORMAT "%8.3" EXTENDED_LIMITS -3000.092 3000.000 NUMBER 16 /end CHARACTERISTIC
/begin CHARACTERISTIC FrmMng_nFan_CUR "Umsetzungstabelle Lüfterstufe --> Lüfterdrehzahl" CURVE 0xD5E3A Kl_Xs16_Ws16 3000.000 FanSpd 0.00 3000.000 FORMAT "%8.3" EXTENDED_LIMITS -3000.092 3000.000
 /begin AXIS_DESCR STD_AXIS FrmMng_numACFanDes OneToOne 4 0.00 15.00 FORMAT "%5.2" EXTENDED_LIMITS 0.00 255.0 DEPOSIT ABSOLUTE /end AXIS_DESCR
/end CHARACTERISTIC
/begin CHARACTERISTIC FrmMng_nHtgUpActMax_C "speed threshold for evaluating ST_SW_WAUP signal" VALUE 0xD5E4C Kw_Ws16 5960.000 EngN 40.00000 6000.000 FORMAT "%8.3" EXTENDED_LIMITS -32768.00 32767.00 /end CHARACTERISTIC
/begin CHARACTERISTIC FrmMng_nHtgUpCrCtlMax_C "max cruise control speed switch" VALUE 0xD5E4E Kw_Ws16 5960.000 EngN 40.00000 6000.000 FORMAT "%8.3" EXTENDED_LIMITS -32768.00 32767.00 /end CHARACTERISTIC
/begin CHARACTERISTIC FrmMng_nLIGovOffs_C "ST_SW_LEV_RPM - status switch level RPM" VALUE 0xD5E50 Kw_Ws16 5960.000 EngN 40.00000 6000.000 FORMAT "%8.3" EXTENDED_LIMITS -32768.00 32767.00 /end CHARACTERISTIC
/begin CHARACTERISTIC FrmMng_nLimSSGErr_C "Error value for Maximum engine speed in phase 2 of the switching process" VALUE 0xD5E52 Kw_Ws16 5960.000 EngN 40.00000 6000.000 FORMAT "%8.3" EXTENDED_LIMITS -32768.00 32767.00 /end CHARACTERISTIC
/begin CHARACTERISTIC FrmMng_nLISetPoint_Offset_C "Low idle speed offset value for normalisation" VALUE 0xD600C Kw_Ws16 65535.00 EngN -32768.00 32767.00 FORMAT "%8.2" /end CHARACTERISTIC
/begin CHARACTERISTIC FrmMng_nLISetPoint_Slope_C "Low idle speed slope value for normalisation" VALUE 0xD600E Kw_Ws16 65.53500 SlopeRes1000 -32.76800 32.76700 FORMAT "%8.5" /end CHARACTERISTIC
/begin CHARACTERISTIC FrmMng_nML_C "Applikationswert zur Begrezung der Motorlaufzustand über CAN" VALUE 0xD6010 Kw_Ws16 5960.000 EngN 40.00000 6000.000 FORMAT "%8.3" EXTENDED_LIMITS -32768.00 32767.00 /end CHARACTERISTIC
/begin CHARACTERISTIC FrmMng_cnvnPSPSpd_Offset_C "Offset for the calculation of RPM_FU_PP_EL signal" VALUE 0xD5E54 Kw_Ws16 65535.00 PSP_Spd -32768.00 32767.00 FORMAT "%8.2" /end CHARACTERISTIC
/begin CHARACTERISTIC FrmMng_cnvnPSPSpd_Slope_C "Slope for the calculation of RPM_FU_PP_EL signal" VALUE 0xD5E56 Kw_Ws16 655.3500 SlopeRes100 -327.6800 327.6700 FORMAT "%8.4" /end CHARACTERISTIC
/begin CHARACTERISTIC FrmMng_nRqStgEFan_CUR "Kennlinie zur Berechnung der Lüfterdrehzal aus der Lüfterstufe" CURVE 0xD5E58 Kl_Xs16_Ws16 3000.000 FanSpd 0.00 3000.000 FORMAT "%8.3" EXTENDED_LIMITS -3000.092 3000.000
 /begin AXIS_DESCR STD_AXIS FrmMng_numRqStgEFan OneToOne 4 0.00 15.00 FORMAT "%5.2" EXTENDED_LIMITS 0.00 255.0 DEPOSIT ABSOLUTE /end AXIS_DESCR
/end CHARACTERISTIC
/begin CHARACTERISTIC FrmMng_nTSCErr_C "Fehlerwert für Eingangsturbinendrehzahl" VALUE 0xD6012 Kw_Wu16 65535.00 EngN 0.00 65535.00 FORMAT "%8.2" /end CHARACTERISTIC
/begin CHARACTERISTIC FrmMng_nTSC_Offset_C "Offset für Eingangsturbinendrehzahl" VALUE 0xD6014 Kw_Ws16 65535.00 EngN -32768.00 32767.00 FORMAT "%8.2" /end CHARACTERISTIC
/begin CHARACTERISTIC FrmMng_nTSC_Slope_C "Steigung für Eingangsturbinendrehzahl" VALUE 0xD6016 Kw_Ws16 65.53500 SlopeRes1000 -32.76800 32.76700 FORMAT "%8.5" /end CHARACTERISTIC
/begin CHARACTERISTIC FrmMng_numACFanDesDef_C "Defektwert für FrmMng_numACFanDesDef_C Botschaft" VALUE 0xD5E6A Kw_Wu8 255.0 OneToOne 0.00 255.0 FORMAT "%5.1" /end CHARACTERISTIC
/begin CHARACTERISTIC FrmMng_numCCAddLevlFlsh_C "State flash cycle for Checkcontroll message 11" VALUE 0xD5E6B Kw_Wu8 3.000 OneToOne 0.00 3.000 FORMAT "%5.3" EXTENDED_LIMITS 0.00 255.0 /end CHARACTERISTIC
/begin CHARACTERISTIC FrmMng_numCCAddLevlNum_C "#SSD Number Checkcontroll message 11" VALUE 0xD5E6C Kw_Wu16 65535.00 OneToOne 0.00 65535.00 FORMAT "%8.2" /end CHARACTERISTIC
/begin CHARACTERISTIC FrmMng_numCCBrkDefFlsh_C "Status Blinken Takt CC-Meldung Bremslichtschalter defekt" VALUE 0xD5E6E Kw_Wu8 3.000 OneToOne 0.00 3.000 FORMAT "%5.3" EXTENDED_LIMITS 0.00 255.0 /end CHARACTERISTIC
/begin CHARACTERISTIC FrmMng_numCCBrkDefNum_C "Nummer CC-Meldung Bremslichtschalter defekt" VALUE 0xD5E70 Kw_Wu16 65535.00 OneToOne 0.00 65535.00 FORMAT "%8.2" /end CHARACTERISTIC
/begin CHARACTERISTIC FrmMng_numCCbtnachFlsh_C "State flash cycle for Checkcontroll message 17" VALUE 0xD5E72 Kw_Wu8 3.000 OneToOne 0.00 3.000 FORMAT "%5.3" EXTENDED_LIMITS 0.00 255.0 /end CHARACTERISTIC
/begin CHARACTERISTIC FrmMng_numCCbtnachNum_C "#SSD Number Checkcontroll message 17" VALUE 0xD5E74 Kw_Wu16 65535.00 OneToOne 0.00 65535.00 FORMAT "%8.2" /end CHARACTERISTIC
/begin CHARACTERISTIC FrmMng_numCCbttdfkFlsh_C "State flash cycle for Checkcontroll message 19" VALUE 0xD5E76 Kw_Wu8 3.000 OneToOne 0.00 3.000 FORMAT "%5.3" EXTENDED_LIMITS 0.00 255.0 /end CHARACTERISTIC
/begin CHARACTERISTIC FrmMng_numCCbttdfkNum_C "#SSD Number Checkcontroll message 19" VALUE 0xD5E78 Kw_Wu16 65535.00 OneToOne 0.00 65535.00 FORMAT "%8.2" /end CHARACTERISTIC
/begin CHARACTERISTIC FrmMng_numCCbttkntFlsh_C "State flash cycle for Checkcontroll message 20" VALUE 0xD5E7A Kw_Wu8 3.000 OneToOne 0.00 3.000 FORMAT "%5.3" EXTENDED_LIMITS 0.00 255.0 /end CHARACTERISTIC
/begin CHARACTERISTIC FrmMng_numCCbttkntNum_C "#SSD Number Checkcontroll message 20" VALUE 0xD5E7C Kw_Wu16 65535.00 OneToOne 0.00 65535.00 FORMAT "%8.2" /end CHARACTERISTIC
/begin CHARACTERISTIC FrmMng_numCCGenDef2Flsh_C "State flash cycle for Checkcontroll message 14" VALUE 0xD5E7E Kw_Wu8 3.000 OneToOne 0.00 3.000 FORMAT "%5.3" EXTENDED_LIMITS 0.00 255.0 /end CHARACTERISTIC
/begin CHARACTERISTIC FrmMng_numCCGenDef2Num_C "#SSD Number Checkcontroll message 14" VALUE 0xD5E80 Kw_Wu16 65535.00 OneToOne 0.00 65535.00 FORMAT "%8.2" /end CHARACTERISTIC
/begin CHARACTERISTIC FrmMng_numCCNoCrCtlFlsh_C "Status Blinken Takt der Checkcontrol Meldung Geschwindigkeitsregelung ohne Funktion" VALUE 0xD5E82 Kw_Wu8 3.000 OneToOne 0.00 3.000 FORMAT "%5.3" EXTENDED_LIMITS 0.00 255.0 /end CHARACTERISTIC
/begin CHARACTERISTIC FrmMng_numCCNoCrCtlNum_C "#SSD Nummer der Checkcontrol Meldung Geschwindigkeitsregelung ohne Funktion" VALUE 0xD5E84 Kw_Wu16 65535.00 OneToOne 0.00 65535.00 FORMAT "%8.2" /end CHARACTERISTIC
/begin CHARACTERISTIC FrmMng_numCCOelLevlFlsh_C "State flash cycle for Checkcontroll message 10" VALUE 0xD5E86 Kw_Wu8 3.000 OneToOne 0.00 3.000 FORMAT "%5.3" EXTENDED_LIMITS 0.00 255.0 /end CHARACTERISTIC
/begin CHARACTERISTIC FrmMng_numCCOelLevlNum_C "#SSD Number Checkcontroll message 10" VALUE 0xD5E88 Kw_Wu16 65535.00 OneToOne 0.00 65535.00 FORMAT "%8.2" /end CHARACTERISTIC
/begin CHARACTERISTIC FrmMng_numCCOelVerbFlsh_C "State flash cycle for Checkcontroll message 8" VALUE 0xD5E8A Kw_Wu8 3.000 OneToOne 0.00 3.000 FORMAT "%5.3" EXTENDED_LIMITS 0.00 255.0 /end CHARACTERISTIC
/begin CHARACTERISTIC FrmMng_numCCOelVerbNum_C "#SSD Number Checkcontroll message 8" VALUE 0xD5E8C Kw_Wu16 65535.00 OneToOne 0.00 65535.00 FORMAT "%8.2" /end CHARACTERISTIC
/begin CHARACTERISTIC FrmMng_numCCOelVerlFlsh_C "State flash cycle for Checkcontroll message 9" VALUE 0xD5E8E Kw_Wu8 3.000 OneToOne 0.00 3.000 FORMAT "%5.3" EXTENDED_LIMITS 0.00 255.0 /end CHARACTERISTIC
/begin CHARACTERISTIC FrmMng_numCCOelVerlNum_C "#SSD Number Checkcontroll message 9" VALUE 0xD5E90 Kw_Wu16 65535.00 OneToOne 0.00 65535.00 FORMAT "%8.2" /end CHARACTERISTIC
/begin CHARACTERISTIC FrmMng_numCCOilPresFlsh_C "State flash cycle for Checkcontroll message 4" VALUE 0xD5E92 Kw_Wu8 3.000 OneToOne 0.00 3.000 FORMAT "%5.3" EXTENDED_LIMITS 0.00 255.0 /end CHARACTERISTIC
/begin CHARACTERISTIC FrmMng_numCCOilPresNum_C "#SSD Number Checkcontroll message 4" VALUE 0xD5E94 Kw_Wu16 65535.00 OneToOne 0.00 65535.00 FORMAT "%8.2" /end CHARACTERISTIC
/begin CHARACTERISTIC FrmMng_numCCOvrTem2Flsh_C "State flash cycle for Checkcontroll message 6" VALUE 0xD5E96 Kw_Wu8 3.000 OneToOne 0.00 3.000 FORMAT "%5.3" EXTENDED_LIMITS 0.00 255.0 /end CHARACTERISTIC
/begin CHARACTERISTIC FrmMng_numCCOvrTem2Num_C "#SSD Number Checkcontroll message 6" VALUE 0xD5E98 Kw_Wu16 65535.00 OneToOne 0.00 65535.00 FORMAT "%8.2" /end CHARACTERISTIC
/begin CHARACTERISTIC FrmMng_numCCOvrTempFlsh_C "State flash cycle for Checkcontroll message 5" VALUE 0xD5E9A Kw_Wu8 3.000 OneToOne 0.00 3.000 FORMAT "%5.3" EXTENDED_LIMITS 0.00 255.0 /end CHARACTERISTIC
/begin CHARACTERISTIC FrmMng_numCCOvrTempNum_C "#SSD Number Checkcontroll message 5" VALUE 0xD5E9C Kw_Wu16 65535.00 OneToOne 0.00 65535.00 FORMAT "%8.2" /end CHARACTERISTIC
/begin CHARACTERISTIC FrmMng_numCCPFltDefFlsh_C "State flash cycle for Checkcontroll message 12" VALUE 0xD5E9E Kw_Wu8 3.000 OneToOne 0.00 3.000 FORMAT "%5.3" EXTENDED_LIMITS 0.00 255.0 /end CHARACTERISTIC
/begin CHARACTERISTIC FrmMng_numCCPFltDefNum_C "#SSD Number Checkcontroll message 12" VALUE 0xD5EA0 Kw_Wu16 65535.00 OneToOne 0.00 65535.00 FORMAT "%8.2" /end CHARACTERISTIC
/begin CHARACTERISTIC FrmMng_numCCpmerrFlsh_C "State flash cycle for Checkcontroll message 18" VALUE 0xD5EA2 Kw_Wu8 3.000 OneToOne 0.00 3.000 FORMAT "%5.3" EXTENDED_LIMITS 0.00 255.0 /end CHARACTERISTIC
/begin CHARACTERISTIC FrmMng_numCCpmerrNum_C "#SSD Number Checkcontroll message 18" VALUE 0xD5EA4 Kw_Wu16 65535.00 OneToOne 0.00 65535.00 FORMAT "%8.2" /end CHARACTERISTIC
/begin CHARACTERISTIC FrmMng_numCCPreGlowFlsh_C "Status Blinken Takt der Checkcontrol Meldung Vorglühen" VALUE 0xD5EA6 Kw_Wu8 3.000 OneToOne 0.00 3.000 FORMAT "%5.3" EXTENDED_LIMITS 0.00 255.0 /end CHARACTERISTIC
/begin CHARACTERISTIC FrmMng_numCCPreGlowNum_C "#SSD Nummer der Checkcontrol Meldung Vorglühen" VALUE 0xD5EA8 Kw_Wu16 65535.00 OneToOne 0.00 65535.00 FORMAT "%8.2" /end CHARACTERISTIC
/begin CHARACTERISTIC FrmMng_numCCprioFlsh_C "State flash cycle for Checkcontroll message 21" VALUE 0xD5EAA Kw_Wu8 3.000 OneToOne 0.00 3.000 FORMAT "%5.3" EXTENDED_LIMITS 0.00 255.0 /end CHARACTERISTIC
/begin CHARACTERISTIC FrmMng_numCCprioNum_C "#SSD Number Checkcontroll message 21" VALUE 0xD5EAC Kw_Wu16 65535.00 OneToOne 0.00 65535.00 FORMAT "%8.2" /end CHARACTERISTIC
/begin CHARACTERISTIC FrmMng_numCCruhverFlsh_C "State flash cycle for Checkcontroll message 16" VALUE 0xD5EAE Kw_Wu8 3.000 OneToOne 0.00 3.000 FORMAT "%5.3" EXTENDED_LIMITS 0.00 255.0 /end CHARACTERISTIC
/begin CHARACTERISTIC FrmMng_numCCruhverNum_C "#SSD Number Checkcontroll message 16" VALUE 0xD5EB0 Kw_Wu16 65535.00 OneToOne 0.00 65535.00 FORMAT "%8.2" /end CHARACTERISTIC
/begin CHARACTERISTIC FrmMng_numCCStatMilFlsh_C "State flash cycle for Checkcontroll message 7" VALUE 0xD5EB2 Kw_Wu8 3.000 OneToOne 0.00 3.000 FORMAT "%5.3" EXTENDED_LIMITS 0.00 255.0 /end CHARACTERISTIC
/begin CHARACTERISTIC FrmMng_numCCStatMilLmpTstFlsh_C "State flash cycle for Checkcontroll message 34" VALUE 0xD5EB3 Kw_Wu8 3.000 OneToOne 0.00 3.000 FORMAT "%5.3" EXTENDED_LIMITS 0.00 255.0 /end CHARACTERISTIC
/begin CHARACTERISTIC FrmMng_numCCStatMilLmpTstNum_C "#SSD Number Checkcontroll message 34" VALUE 0xD5EB4 Kw_Wu16 65535.00 OneToOne 0.00 65535.00 FORMAT "%8.2" /end CHARACTERISTIC
/begin CHARACTERISTIC FrmMng_numCCStatMilNum_C "#SSD Number Checkcontroll message 7" VALUE 0xD5EB6 Kw_Wu16 65535.00 OneToOne 0.00 65535.00 FORMAT "%8.2" /end CHARACTERISTIC
/begin CHARACTERISTIC FrmMng_numCCSysLampFlsh_C "Status Blinken Takt der Checkcontrol Meldung Motornotprogramm" VALUE 0xD5EB8 Kw_Wu8 3.000 OneToOne 0.00 3.000 FORMAT "%5.3" EXTENDED_LIMITS 0.00 255.0 /end CHARACTERISTIC
/begin CHARACTERISTIC FrmMng_numCCSysLampNum_C "#SSD Nummer der Checkcontrolmessage Motornotprogramm" VALUE 0xD5EBA Kw_Wu16 65535.00 OneToOne 0.00 65535.00 FORMAT "%8.2" /end CHARACTERISTIC
/begin CHARACTERISTIC FrmMng_numInqyID_C "#SSD Number Inquiry message 1" VALUE 0xD5EBC Kw_Wu16 65535.00 OneToOne 0.00 65535.00 FORMAT "%8.2" /end CHARACTERISTIC
/begin CHARACTERISTIC FrmMng_numRecACCMax_C "Number of allowed errors for ACC recognition" VALUE 0xD5EBE Kw_Wu8 119.0 OneToOne 1.000 120.0 FORMAT "%5.1" EXTENDED_LIMITS 0.00 255.0 /end CHARACTERISTIC
/begin CHARACTERISTIC FrmMng_numRecACMax_C "" VALUE 0xD5EBF Kw_Wu8 119.0 OneToOne 1.000 120.0 FORMAT "%5.1" EXTENDED_LIMITS 0.00 255.0 /end CHARACTERISTIC
/begin CHARACTERISTIC FrmMng_numRecAFSMax_C "Maximum number of messages received" VALUE 0xD5EC0 Kw_Wu8 119.0 OneToOne 1.000 120.0 FORMAT "%5.1" EXTENDED_LIMITS 0.00 255.0 /end CHARACTERISTIC
/begin CHARACTERISTIC FrmMng_numRecARSMax_C "No of errors for ARS detection" VALUE 0xD5EC1 Kw_Wu8 119.0 OneToOne 1.000 120.0 FORMAT "%5.1" EXTENDED_LIMITS 0.00 255.0 /end CHARACTERISTIC
/begin CHARACTERISTIC FrmMng_numRecDCCMax_C "Anzahl Botschaften für Erkennung Empfang Radmomentanforderung-Botschaft" VALUE 0xD5EC2 Kw_Wu8 119.0 OneToOne 1.000 120.0 FORMAT "%5.1" EXTENDED_LIMITS 0.00 255.0 /end CHARACTERISTIC
/begin CHARACTERISTIC FrmMng_numRecFDCMax_C "Z" VALUE 0xD5EC3 Kw_Wu8 119.0 OneToOne 1.000 120.0 FORMAT "%5.1" EXTENDED_LIMITS 0.00 255.0 /end CHARACTERISTIC
/begin CHARACTERISTIC FrmMng_numRecFGRMax_C "Number of allowed errors for FGR recognition" VALUE 0xD5EC4 Kw_Wu8 119.0 OneToOne 1.000 120.0 FORMAT "%5.1" EXTENDED_LIMITS 0.00 255.0 /end CHARACTERISTIC
/begin CHARACTERISTIC FrmMng_dtrqOvrRunRmpUp_C "parameter for overrun shut off ramp up  slope" VALUE 0xD5EC8 Kw_Wu32 6553584.99908 RmpTrq 14.9993896484 6553599.99847 FORMAT "%13.5" EXTENDED_LIMITS 0.00 6553599.99847 READ_ONLY /end CHARACTERISTIC
/begin CHARACTERISTIC FrmMng_dtrqOvrRunRmpDwn_C "#SSD parameter for overrun shut off ramp down  slope" VALUE 0xD5ECC Kw_Wu32 6553584.99908 RmpTrq 14.9993896484 6553599.99847 FORMAT "%13.5" EXTENDED_LIMITS 0.00 6553599.99847 /end CHARACTERISTIC
/begin CHARACTERISTIC FrmMng_pVal_Offset_C "Offset für pVal" VALUE 0xD6018 Kw_Ws16 65535.00 OneToOne -32768.00 32767.00 FORMAT "%8.2" /end CHARACTERISTIC
/begin CHARACTERISTIC FrmMng_pVal_Slope_C "Offset für pVal" VALUE 0xD601A Kw_Ws16 65.53500 SlopeRes1000 -32.76800 32.76700 FORMAT "%8.5" /end CHARACTERISTIC
/begin CHARACTERISTIC FrmMng_qOvrRun_C "ST_INFS - status over-run-fuel-shutoff" VALUE 0xD5ED0 Kw_Ws16 327.6700 InjMass 0.00 327.6700 FORMAT "%8.4" EXTENDED_LIMITS -327.6800 327.6700 /end CHARACTERISTIC
/begin CHARACTERISTIC FrmMng_rFlt_Offset_C "Offset für rFlt" VALUE 0xD601C Kw_Ws16 65535.00 OneToOne -32768.00 32767.00 FORMAT "%8.2" /end CHARACTERISTIC
/begin CHARACTERISTIC FrmMng_rFlt_Slope_C "Steigung für rFlt" VALUE 0xD601E Kw_Ws16 65.53500 SlopeRes1000 -32.76800 32.76700 FORMAT "%8.5" /end CHARACTERISTIC
/begin CHARACTERISTIC FrmMng_cnvrPSPSetPoint_Offset_C "Offset Wert für die SETQ_FU_PP_EL signale" VALUE 0xD5ED2 Kw_Ws16 799.9878 Prc -400.0000 399.9878 FORMAT "%8.4" /end CHARACTERISTIC
/begin CHARACTERISTIC FrmMng_cnvrPSPSetPoint_Slope_C "Steigungs Wert für SETQ_FU_PP_EL der STAT_EKP  CAN Botschaft" VALUE 0xD5ED4 Kw_Ws16 655.3500 SlopeRes100 -327.6800 327.6700 FORMAT "%8.4" /end CHARACTERISTIC
/begin CHARACTERISTIC FrmMng_rWaterVlvClose_C "value for water valve fully closed" VALUE 0xD5ED6 Kw_Wu16 100.0000 Prc 0.00 100.0000 FORMAT "%8.4" EXTENDED_LIMITS 0.00 799.9878 /end CHARACTERISTIC
/begin CHARACTERISTIC FrmMng_rWaterVlvCtl_C "Control value for water valve" VALUE 0xD5ED8 Kw_Wu16 100.0000 Prc 0.00 100.0000 FORMAT "%8.4" EXTENDED_LIMITS 0.00 799.9878 /end CHARACTERISTIC
/begin CHARACTERISTIC FrmMng_rWaterVlvOpen_C "value for water valve fully open" VALUE 0xD5EDA Kw_Wu16 100.0000 Prc 0.00 100.0000 FORMAT "%8.4" EXTENDED_LIMITS 0.00 799.9878 /end CHARACTERISTIC
/begin CHARACTERISTIC FrmMng_stBltbDrDef_C "Ersatzwert" VALUE 0xD5EDC Kw_Wu8 255.0 OneToOne 0.00 255.0 FORMAT "%5.1" /end CHARACTERISTIC
/begin CHARACTERISTIC FrmMng_stClCtrDEF_C "#SSD defekt value for FrmMng_stClCtr (CAN message ST_CLCTR)" VALUE 0xD5EDD Kw_Wu8 255.0 OneToOne 0.00 255.0 FORMAT "%5.1" /end CHARACTERISTIC
/begin CHARACTERISTIC FrmMng_stConvErr_C "#SSD Status der Wandlerkupplung, Wert im Fehlerfall" VALUE 0xD5EDE Kw_Wu8 15.00 OneToOne 0.00 15.00 FORMAT "%5.2" EXTENDED_LIMITS 0.00 255.0 /end CHARACTERISTIC
/begin CHARACTERISTIC FrmMng_stFDC_C "application parameter for FrmMng_stFDC value" VALUE 0xD5EDF Kw_Wu8 2.000 OneToOne 0.00 2.000 FORMAT "%5.3" EXTENDED_LIMITS 0.00 255.0 /end CHARACTERISTIC
/begin CHARACTERISTIC FrmMng_stGbxErr_C "Schaltung aktiv, Vorgabewert im Fehlerfall" VALUE 0xD5EE0 Kw_Wu8 15.00 OneToOne 0.00 15.00 FORMAT "%5.2" EXTENDED_LIMITS 0.00 255.0 /end CHARACTERISTIC
/begin CHARACTERISTIC Frmmng_stGearbxHtgUpActMsk_C "Masking value for measuring point  Frmmng_stGearbxHtgUpAct_mp" VALUE 0xD5EE1 Kw_Wu8 255.0 OneToOne 0.00 255.0 FORMAT "%5.1" /end CHARACTERISTIC
/begin CHARACTERISTIC FrmMng_stGearErr_C "Vorgabewert bei EGS1 Botschaftsausfall" VALUE 0xD6020 Kw_Wu8 255.0 OneToOne 0.00 255.0 FORMAT "%5.1" /end CHARACTERISTIC
/begin CHARACTERISTIC Frmmng_stGearHtgUpAct_C "velocity threshold for evaluating ST_SW_WAUP signal" VALUE 0xD5EE2 Kw_Wu8 6.000 OneToOne 0.00 6.000 FORMAT "%5.3" EXTENDED_LIMITS 0.00 255.0 /end CHARACTERISTIC
/begin CHARACTERISTIC FrmMng_stKeyVldDef_C "Ersatzwert" VALUE 0xD5EE3 Kw_Wu8 255.0 OneToOne 0.00 255.0 FORMAT "%5.1" /end CHARACTERISTIC
/begin CHARACTERISTIC FrmMng_stRgnHtgUp_C "Masking for EGT_CmpSt function" VALUE 0xD5EE4 Kw_Wu32 2147483647.00 OneToOne 0.00 2147483647.00 FORMAT "%13.2" EXTENDED_LIMITS 0.00 4294967295.00 /end CHARACTERISTIC
/begin CHARACTERISTIC FrmMng_stT15Def_C "Intern Fehlerwert für T15" VALUE 0xD5EE8 Kw_Wu8 255.0 OneToOne 0.00 255.0 FORMAT "%5.1" /end CHARACTERISTIC
/begin CHARACTERISTIC FrmMng_stT50Def_C "#SSD Defektwert für FrmMng_numACFanDesDef_C Botschaft" VALUE 0xD5EE9 Kw_Wu8 255.0 OneToOne 0.00 255.0 FORMAT "%5.1" /end CHARACTERISTIC
/begin CHARACTERISTIC FrmMng_Sttorqavl_Errval_C "Error value for status torque actual-value" VALUE 0xD5EEA Kw_Wu8 10.00 OneToOne 0.00 10.00 FORMAT "%5.2" EXTENDED_LIMITS 0.00 255.0 /end CHARACTERISTIC
/begin CHARACTERISTIC FrmMng_stTRadioDef_C "defekt value for FrmMng_stTRadio" VALUE 0xD5EEB Kw_Wu8 255.0 OneToOne 0.00 255.0 FORMAT "%5.1" /end CHARACTERISTIC
/begin CHARACTERISTIC FrmMng_stWghSeatDrDef_C "Ersatzwert" VALUE 0xD5EEC Kw_Wu8 255.0 OneToOne 0.00 255.0 FORMAT "%5.1" /end CHARACTERISTIC
/begin CHARACTERISTIC FrmMng_swtANFRADMOMPT_C "Aktivierung der Botschaft ANF_RADMOM_PT" VALUE 0xD5EED Kw_Wu8 1.000 OneToOne 0.00 1.000 FORMAT "%5.3" EXTENDED_LIMITS 0.00 255.0 /end CHARACTERISTIC
/begin CHARACTERISTIC FrmMng_swtANFRAGE_C "Schalter, um die Verarbeitung der Message zu deaktivieren (1: aktiviert, 0: deaktiviert)" VALUE 0xD5EEE Kw_Wu8 1.000 OneToOne 0.00 1.000 FORMAT "%5.3" EXTENDED_LIMITS 0.00 255.0 /end CHARACTERISTIC
/begin CHARACTERISTIC FrmMng_swtASC1_C "ASC1 Botschaft aktivieren bzw. deaktivieren (1: aktiviert, 0: deaktiviert)" VALUE 0xD6021 Kw_Wu8 1.000 OneToOne 0.00 1.000 FORMAT "%5.3" EXTENDED_LIMITS 0.00 255.0 /end CHARACTERISTIC
/begin CHARACTERISTIC FrmMng_swtASC2_C "ASC2 Botschaft aktivieren bzw.  deaktivieren (1: aktiviert, 0: deaktiviert)" VALUE 0xD6022 Kw_Wu8 1.000 OneToOne 0.00 1.000 FORMAT "%5.3" EXTENDED_LIMITS 0.00 255.0 /end CHARACTERISTIC
/begin CHARACTERISTIC FrmMng_swtASC3_C "ASC3 Botschaft aktivieren bzw. deaktivieren (1: aktiviert, 0: deaktiviert)" VALUE 0xD6023 Kw_Wu8 1.000 OneToOne 0.00 1.000 FORMAT "%5.3" EXTENDED_LIMITS 0.00 255.0 /end CHARACTERISTIC
/begin CHARACTERISTIC FrmMng_swtASC4_C "ASC4 Botschaft aktivieren bzw. deaktivieren (1: aktiviert, 0: deaktiviert)" VALUE 0xD6024 Kw_Wu8 1.000 OneToOne 0.00 1.000 FORMAT "%5.3" EXTENDED_LIMITS 0.00 255.0 /end CHARACTERISTIC
/begin CHARACTERISTIC FrmMng_swtASDdc_C "Schalter um die ASDdc message zu deaktivieren (1...enabled, 0...disabled)" VALUE 0xD5EEF Kw_Wu8 1.000 OneToOne 0.00 1.000 FORMAT "%5.3" EXTENDED_LIMITS 0.00 255.0 /end CHARACTERISTIC
/begin CHARACTERISTIC FrmMng_swtBOS_Oil_2_C "Aktivieren der CAN-Botschaft BOS Meldung Oil 2 (1...aktiev, 0...inaktiev)" VALUE 0xD5EF0 Kw_Wu8 1.000 OneToOne 0.00 1.000 FORMAT "%5.3" EXTENDED_LIMITS 0.00 255.0 /end CHARACTERISTIC
/begin CHARACTERISTIC FrmMng_swtBOS_Oil_C "Schalter zum deaktivieren der Message (0: aktiev, 1: inaktiev)" VALUE 0xD5EF1 Kw_Wu8 1.000 OneToOne 0.00 1.000 FORMAT "%5.3" EXTENDED_LIMITS 0.00 255.0 /end CHARACTERISTIC
/begin CHARACTERISTIC FrmMng_swtBOS_PFlt_C "Schalter, um die Message BOS_MELDUNG_PFLT zu aktivieren (1...enabled,. 0...disabled)" VALUE 0xD5EF2 Kw_Wu8 1.000 OneToOne 0.00 1.000 FORMAT "%5.3" EXTENDED_LIMITS 0.00 255.0 /end CHARACTERISTIC
/begin CHARACTERISTIC FrmMng_swtBOS_RESET_2_C "Schalter zum deaktivieren der Auswertung der Message (1: aktiev, 0: inaktiev)" VALUE 0xD5EF3 Kw_Wu8 1.000 OneToOne 0.00 1.000 FORMAT "%5.3" EXTENDED_LIMITS 0.00 255.0 /end CHARACTERISTIC
/begin CHARACTERISTIC FrmMng_swtBOS_RESET_C "Schalter zum deaktivieren der auswertung von BOS_RESET (1: aktiev, 0: deaktiev)" VALUE 0xD5EF4 Kw_Wu8 1.000 OneToOne 0.00 1.000 FORMAT "%5.3" EXTENDED_LIMITS 0.00 255.0 /end CHARACTERISTIC
/begin CHARACTERISTIC FrmMng_swtCalcV_C "Radgeschwindigkeiten zur Mitelwertsbildung herangezogen (0...nicht, 1...herangezogen)  Bit0: LV, Bit1: RV, Bit2: LH, Bit3: RH" VALUE 0xD5EF5 Kw_Wu8 15.00 OneToOne 0.00 15.00 FORMAT "%5.2" EXTENDED_LIMITS 0.00 255.0 /end CHARACTERISTIC
/begin CHARACTERISTIC FrmMng_swtCANA_C "Schalter zum Deaktivieren der Kommunikation des CAN A, 1=AUS" VALUE 0xD6025 Kw_Wu8 1.000 OneToOne 0.00 1.000 FORMAT "%5.3" EXTENDED_LIMITS 0.00 255.0 /end CHARACTERISTIC
/begin CHARACTERISTIC FrmMng_swtCarType_C "Schaltet CAN zwischen 0: E60, 1: E65 und 2: E90" VALUE 0xD5EF6 Kw_Wu8 2.00000000000 CarType 0.00 2.00000000000 FORMAT "%13.11" EXTENDED_LIMITS 0.00 4.00000000000 /end CHARACTERISTIC
/begin CHARACTERISTIC FrmMng_swtCCMsg_C "Unterdrücken aller Checkcontrol Meldungen (0=AUS, 1...EIN)" VALUE 0xD5EF7 Kw_Wu8 1.000 OneToOne 0.00 1.000 FORMAT "%5.3" EXTENDED_LIMITS 0.00 255.0 /end CHARACTERISTIC
/begin CHARACTERISTIC FrmMng_swtCCNoCrCtl_C "Setzten/Löschen der Checkcontrol Meldung Geschwindigkeitsregelung ohne Funktion (1...setzen,. 0...löschen)" VALUE 0xD5EF8 Kw_Wu8 1.000 OneToOne 0.00 1.000 FORMAT "%5.3" EXTENDED_LIMITS 0.00 255.0 /end CHARACTERISTIC
/begin CHARACTERISTIC FrmMng_swtCorTrqACC_C "Schalter zur Korrektur von FrmMng_trqACC_TrqDes mit Gearbx_trqFrc (1...Korrektur, 0...keine Korrektur)" VALUE 0xD5EF9 Kw_Wu8 1.000 OneToOne 0.00 1.000 FORMAT "%5.3" EXTENDED_LIMITS 0.00 255.0 /end CHARACTERISTIC
/begin CHARACTERISTIC FrmMng_swtCorTrqDSC_C "Schalter zur Korrektur des DSC-Moment durch Gearbx_trqFrc (1...Korrektur, 0...keine Korrektur)" VALUE 0xD5EFA Kw_Wu8 1.000 OneToOne 0.00 1.000 FORMAT "%5.3" EXTENDED_LIMITS 0.00 255.0 /end CHARACTERISTIC
/begin CHARACTERISTIC FrmMng_swtDCCSelfRec_C "Status Aktivierung Erkennung Empfang Radmomentanforderung Botschaft" VALUE 0xD5EFB Kw_Wu8 1.000 OneToOne 0.00 1.000 FORMAT "%5.3" EXTENDED_LIMITS 0.00 255.0 /end CHARACTERISTIC
/begin CHARACTERISTIC FrmMng_swtDDE1_C "DDE1 Botschaft aktivieren/deaktivieren (1...enabled, 0...disabled)" VALUE 0xD6026 Kw_Wu8 1.000 OneToOne 0.00 1.000 FORMAT "%5.3" EXTENDED_LIMITS 0.00 255.0 /end CHARACTERISTIC
/begin CHARACTERISTIC FrmMng_swtDDE2_C "DDE2 Botschaft aktivieren / deaktivieren (1...enabled, 0...disabled)" VALUE 0xD6027 Kw_Wu8 1.000 OneToOne 0.00 1.000 FORMAT "%5.3" EXTENDED_LIMITS 0.00 255.0 /end CHARACTERISTIC
/begin CHARACTERISTIC FrmMng_swtDDE4_C "DDE4 Botschaft aktivieren / deaktivieren (1...enabled, 0...disabled)" VALUE 0xD6028 Kw_Wu8 1.000 OneToOne 0.00 1.000 FORMAT "%5.3" EXTENDED_LIMITS 0.00 255.0 /end CHARACTERISTIC
/begin CHARACTERISTIC FrmMng_swtDMOMENT_ACC_C "#SSD Schalter zum deaktivieren der Message DREHMOMENT_ANF_ACC (1...enabled, 0...disabled)" VALUE 0xD5EFC Kw_Wu8 1.000 OneToOne 0.00 1.000 FORMAT "%5.3" EXTENDED_LIMITS 0.00 255.0 /end CHARACTERISTIC
/begin CHARACTERISTIC FrmMng_swtDM_ANF_AFS_C "Schalter zum aktivieren der Message DREHMOMENT_ANF_AFS (1...enabled, 0...disabled)" VALUE 0xD5EFD Kw_Wu8 1.000 OneToOne 0.00 1.000 FORMAT "%5.3" EXTENDED_LIMITS 0.00 255.0 /end CHARACTERISTIC
/begin CHARACTERISTIC FrmMng_swtDRMANFSSG_C "#SSD SChalter zum aktivieren der Message DREHMOMENT_ANF_SSG  (1...enabled, 0...disabled)" VALUE 0xD5EFE Kw_Wu8 1.000 OneToOne 0.00 1.000 FORMAT "%5.3" EXTENDED_LIMITS 0.00 255.0 /end CHARACTERISTIC
/begin CHARACTERISTIC FrmMng_swtDSCBrkAct_C "Auswahl zwischen 0: DSC-brake intervention, 1: DSC control and 2: ASC control" VALUE 0xD6029 Kw_Wu8 7.000 OneToOne 0.00 7.000 FORMAT "%5.3" EXTENDED_LIMITS 0.00 255.0 /end CHARACTERISTIC
/begin CHARACTERISTIC FrmMng_swtEGS1_C "EGS1 Botschaft aktivieren oder deaktivieren (1...enabled, 0...disabled)" VALUE 0xD602A Kw_Wu8 1.000 OneToOne 0.00 1.000 FORMAT "%5.3" EXTENDED_LIMITS 0.00 255.0 /end CHARACTERISTIC
/begin CHARACTERISTIC FrmMng_swtEGS2_C "EGS2 Botschaft aktivieren bzw. deaktivieren (1...enabled, 0...disabled)" VALUE 0xD602B Kw_Wu8 1.000 OneToOne 0.00 1.000 FORMAT "%5.3" EXTENDED_LIMITS 0.00 255.0 /end CHARACTERISTIC
/begin CHARACTERISTIC FrmMng_swtEKP_C "Schalter für EKP-Botschaft (1...on, 0...off)" VALUE 0xD602C Kw_Wu8 1.000 OneToOne 0.00 1.000 FORMAT "%5.3" EXTENDED_LIMITS 0.00 255.0 /end CHARACTERISTIC
/begin CHARACTERISTIC FrmMng_swtENGINE1_C "Schalter zur Abschaltung der Berechnung von ENGINE1 (1...enabled, 0...disabled)" VALUE 0xD5EFF Kw_Wu8 1.000 OneToOne 0.00 1.000 FORMAT "%5.3" EXTENDED_LIMITS 0.00 255.0 /end CHARACTERISTIC
/begin CHARACTERISTIC FrmMng_swtENGINE_RPM_C "Aktivierung Botschaft ENGINE_RPM (1...enabled, 0...disableb)" VALUE 0xD5F00 Kw_Wu8 1.000 OneToOne 0.00 1.000 FORMAT "%5.3" EXTENDED_LIMITS 0.00 255.0 /end CHARACTERISTIC
/begin CHARACTERISTIC FrmMng_swtEngRpmTempSel_C "Schalter, um die Kuehler- oder die Motor Oel Temperatur auszuwaehlen (1...oel, 0...Kuehler)" VALUE 0xD5F01 Kw_Wu8 1.000 OneToOne 0.00 1.000 FORMAT "%5.3" EXTENDED_LIMITS 0.00 255.0 /end CHARACTERISTIC
/begin CHARACTERISTIC FrmMng_swtFDC_C "Schalter, um den FrmMng_stFDC- Wert auszuwählen (1...Applikationswert, 0...lokaler Wert)" VALUE 0xD5F02 Kw_Wu8 1.000 OneToOne 0.00 1.000 FORMAT "%5.3" EXTENDED_LIMITS 0.00 255.0 /end CHARACTERISTIC
/begin CHARACTERISTIC FrmMng_swtGEARBX_DATA2_C "Schalter, um die Message GEARBX_DATA2 zu aktivieren (1...enabled,. 0...disabled)" VALUE 0xD5F03 Kw_Wu8 1.000 OneToOne 0.00 1.000 FORMAT "%5.3" EXTENDED_LIMITS 0.00 255.0 /end CHARACTERISTIC
/begin CHARACTERISTIC FrmMng_swtGEARBX_DATA_C "Schalter um die Message  GEARBX_DATA zu aktivieren (1...enabled,. 0...disabled)" VALUE 0xD5F04 Kw_Wu8 1.000 OneToOne 0.00 1.000 FORMAT "%5.3" EXTENDED_LIMITS 0.00 255.0 /end CHARACTERISTIC
/begin CHARACTERISTIC FrmMng_swtHEATINGCURRENT_C "Aktivierung und deaktivierung der Message HEATING_CURRENT (1...enabled,. 0...disabled)" VALUE 0xD5F05 Kw_Wu8 1.000 OneToOne 0.00 1.000 FORMAT "%5.3" EXTENDED_LIMITS 0.00 255.0 /end CHARACTERISTIC
/begin CHARACTERISTIC FrmMng_swtHEAT_AC_C "Schalter, um die Message HEAT_AC zu aktivieren (1...enabled,. 0...disabled)" VALUE 0xD5F06 Kw_Wu8 1.000 OneToOne 0.00 1.000 FORMAT "%5.3" EXTENDED_LIMITS 0.00 255.0 /end CHARACTERISTIC
/begin CHARACTERISTIC FrmMng_swtINSTR2_C "Schalter, um die Message INSTR2 zu aktivieren (1...enabled,. 0...disabled)" VALUE 0xD602D Kw_Wu8 1.000 OneToOne 0.00 1.000 FORMAT "%5.3" EXTENDED_LIMITS 0.00 255.0 /end CHARACTERISTIC
/begin CHARACTERISTIC FrmMng_swtINSTR3_C "Schalter, um die Message INSTR3 zu aktivieren (1...enabled,. 0...disabled)" VALUE 0xD602E Kw_Wu8 1.000 OneToOne 0.00 1.000 FORMAT "%5.3" EXTENDED_LIMITS 0.00 255.0 /end CHARACTERISTIC
/begin CHARACTERISTIC FrmMng_swtLENKRADWINKEL_C "Schalter, um die Message LENKRADWINKEL zu aktivieren (1...enabled,. 0...disabled)" VALUE 0xD5F07 Kw_Wu8 1.000 OneToOne 0.00 1.000 FORMAT "%5.3" EXTENDED_LIMITS 0.00 255.0 /end CHARACTERISTIC
/begin CHARACTERISTIC FrmMng_swtMILEAGE_RANGE_C "Schalter, um die Message MILEAGE_RANGE zu aktivieren (1...enabled,. 0...disabled)" VALUE 0xD5F08 Kw_Wu8 1.000 OneToOne 0.00 1.000 FORMAT "%5.3" EXTENDED_LIMITS 0.00 255.0 /end CHARACTERISTIC
/begin CHARACTERISTIC FrmMng_swtOEL_MESS_C "" VALUE 0xD5F09 Kw_Wu8 1.000 OneToOne 0.00 1.000 FORMAT "%5.3" EXTENDED_LIMITS 0.00 255.0 /end CHARACTERISTIC
/begin CHARACTERISTIC FrmMng_swtOPCRCTLACC_C "Schalter, um die Message OP_CRCTLACC zu aktivieren (1...enabled,. 0...disabled)" VALUE 0xD5F0A Kw_Wu8 1.000 OneToOne 0.00 1.000 FORMAT "%5.3" EXTENDED_LIMITS 0.00 255.0 /end CHARACTERISTIC
/begin CHARACTERISTIC FrmMng_swtParkConsumer_C "Schalter, um die Message PWRMNG_STANDVBR zu aktivieren (1...enabled,. 0...disabled)" VALUE 0xD5F0B Kw_Wu8 1.000 OneToOne 0.00 1.000 FORMAT "%5.3" EXTENDED_LIMITS 0.00 255.0 /end CHARACTERISTIC
/begin CHARACTERISTIC FrmMng_swtPlausOn_C "Schalter, um die Momenteneingriffsmessage zu aktivieren (1...enabled,. 0...disabled)" VALUE 0xD5F0C Kw_Wu8 1.000 OneToOne 0.00 1.000 FORMAT "%5.3" EXTENDED_LIMITS 0.00 255.0 /end CHARACTERISTIC
/begin CHARACTERISTIC FrmMng_swtPOWERMGMTBATTSP_C "Schalter, um die Message POWERMGMT_BATTERIESPANNUNG zu aktivieren (1...enabled,. 0...disabled)" VALUE 0xD5F0D Kw_Wu8 1.000 OneToOne 0.00 1.000 FORMAT "%5.3" EXTENDED_LIMITS 0.00 255.0 /end CHARACTERISTIC
/begin CHARACTERISTIC FrmMng_swtPRGG_CCTR_C "Schalter, um die Message PRGG_CCTR zu aktivieren (1...enabled,. 0...disabled)" VALUE 0xD5F0E Kw_Wu8 1.000 OneToOne 0.00 1.000 FORMAT "%5.3" EXTENDED_LIMITS 0.00 255.0 /end CHARACTERISTIC
/begin CHARACTERISTIC FrmMng_swtPSPOffErr_C "Schalter, um die Message CTR_CR_SWO_EKP zu aktivieren (1...enabled,. 0...disabled)" VALUE 0xD5F0F Kw_Wu8 255.0 OneToOne 0.00 255.0 FORMAT "%5.1" /end CHARACTERISTIC
/begin CHARACTERISTIC FrmMng_swtPSPOff_C "Schalter, um die Message CTR_CRASH_SWO_EKP zu aktivieren (1...enabled,. 0...disabled)" VALUE 0xD5F10 Kw_Wu8 1.000 OneToOne 0.00 1.000 FORMAT "%5.3" EXTENDED_LIMITS 0.00 255.0 /end CHARACTERISTIC
/begin CHARACTERISTIC FrmMng_swtPWRMNG_CTR_COS_C "Schalter, um die Message PWRMNG_CTR_COS zu aktivieren (1...enabled,. 0...disabled)" VALUE 0xD5F11 Kw_Wu8 1.000 OneToOne 0.00 1.000 FORMAT "%5.3" EXTENDED_LIMITS 0.00 255.0 /end CHARACTERISTIC
/begin CHARACTERISTIC FrmMng_swtPWRMNG_LOADV_C "Schalter, um die Message PWRMNG_LOADV zu aktivieren (1...enabled,. 0...disabled)" VALUE 0xD5F12 Kw_Wu8 1.000 OneToOne 0.00 1.000 FORMAT "%5.3" EXTENDED_LIMITS 0.00 255.0 /end CHARACTERISTIC
/begin CHARACTERISTIC FrmMng_swtRADMOM_PT1_C "Aktivierung der Botschaft RADMOM_PT_1" VALUE 0xD5F13 Kw_Wu8 1.000 OneToOne 0.00 1.000 FORMAT "%5.3" EXTENDED_LIMITS 0.00 255.0 /end CHARACTERISTIC
/begin CHARACTERISTIC FrmMng_swtRADMOM_PT2_C "Aktivierung der Botschaft RADMOM_PT_2" VALUE 0xD5F14 Kw_Wu8 1.000 OneToOne 0.00 1.000 FORMAT "%5.3" EXTENDED_LIMITS 0.00 255.0 /end CHARACTERISTIC
/begin CHARACTERISTIC FrmMng_swtRPM_STA_C "Schalter, um die Message RPM_STA zu aktivieren (1...enabled,. 0...disabled)" VALUE 0xD5F15 Kw_Wu8 1.000 OneToOne 0.00 1.000 FORMAT "%5.3" EXTENDED_LIMITS 0.00 255.0 /end CHARACTERISTIC
/begin CHARACTERISTIC FrmMng_swtRQ_STG_EFAN_C "Schalter, um die Message PRQ_STG_EFAN zu aktivieren (1...enabled,. 0...disabled)" VALUE 0xD5F16 Kw_Wu8 1.000 OneToOne 0.00 1.000 FORMAT "%5.3" EXTENDED_LIMITS 0.00 255.0 /end CHARACTERISTIC
/begin CHARACTERISTIC FrmMng_swtSITZGURT_C "Schalter, um die Message STAT_SITZBELEGUNG_GURT zu aktivieren (1...enabled,. 0...disabled)" VALUE 0xD5F17 Kw_Wu8 1.000 OneToOne 0.00 1.000 FORMAT "%5.3" EXTENDED_LIMITS 0.00 255.0 /end CHARACTERISTIC
/begin CHARACTERISTIC FrmMng_swtSPEED_CLCTR_C "Schalter, um die cruise control Message zu aktivieren (1...enabled,. 0...disabled)" VALUE 0xD5F18 Kw_Wu8 1.000 OneToOne 0.00 1.000 FORMAT "%5.3" EXTENDED_LIMITS 0.00 255.0 /end CHARACTERISTIC
/begin CHARACTERISTIC FrmMng_swtSTAT_ANH_C "Schalter, um die Message STAT_ANH zu aktivieren (1...enabled,. 0...disabled)" VALUE 0xD5F19 Kw_Wu8 1.000 OneToOne 0.00 1.000 FORMAT "%5.3" EXTENDED_LIMITS 0.00 255.0 /end CHARACTERISTIC
/begin CHARACTERISTIC FrmMng_swtSTAT_ARS_C "Schalter, um die Message STAT_ARS zu aktivieren (1...enabled,. 0...disabled)" VALUE 0xD5F1A Kw_Wu8 1.000 OneToOne 0.00 1.000 FORMAT "%5.3" EXTENDED_LIMITS 0.00 255.0 /end CHARACTERISTIC
/begin CHARACTERISTIC FrmMng_swtSTAT_DSC_C "Schalter, um die Message STAT_DSC zu aktivieren (1...enabled,. 0...disabled)" VALUE 0xD5F1B Kw_Wu8 1.000 OneToOne 0.00 1.000 FORMAT "%5.3" EXTENDED_LIMITS 0.00 255.0 /end CHARACTERISTIC
/begin CHARACTERISTIC FrmMng_swtSTAT_EKP_C "Schalter, um die Message STAT_EKP zu aktivieren (1...enabled,. 0...disabled)" VALUE 0xD5F1C Kw_Wu8 1.000 OneToOne 0.00 1.000 FORMAT "%5.3" EXTENDED_LIMITS 0.00 255.0 /end CHARACTERISTIC
/begin CHARACTERISTIC FrmMng_swtSTAT_KOMBI_C "Schalter, um die Message STAT_KOMBI zu aktivieren (1...enabled,. 0...disabled)" VALUE 0xD5F1D Kw_Wu8 1.000 OneToOne 0.00 1.000 FORMAT "%5.3" EXTENDED_LIMITS 0.00 255.0 /end CHARACTERISTIC
/begin CHARACTERISTIC FrmMng_swtstCurr_C "Schalter, um die Message CODIERUNG_PM zu aktivieren (1...enabled,. 0...disabled)" VALUE 0xD5F1E Kw_Wu8 1.000 OneToOne 0.00 1.000 FORMAT "%5.3" EXTENDED_LIMITS 0.00 255.0 /end CHARACTERISTIC
/begin CHARACTERISTIC FrmMng_swtTEMPRELTIME_C "Schalter, um die Message A_TEMP_RELATIVZEIT zu aktivieren (1...enabled,. 0...disabled)" VALUE 0xD5F1F Kw_Wu8 1.000 OneToOne 0.00 1.000 FORMAT "%5.3" EXTENDED_LIMITS 0.00 255.0 /end CHARACTERISTIC
/begin CHARACTERISTIC FrmMng_swtTERMINAL_C "Schalter, um die Message TERMINAL zu aktivieren (1...enabled,. 0...disabled)" VALUE 0xD5F20 Kw_Wu8 1.000 OneToOne 0.00 1.000 FORMAT "%5.3" EXTENDED_LIMITS 0.00 255.0 /end CHARACTERISTIC
/begin CHARACTERISTIC FrmMng_swtTIME_DATE_C "Schalter, um die Message TIME_DATE zu aktivieren (1...enabled,. 0...disabled)" VALUE 0xD5F21 Kw_Wu8 1.000 OneToOne 0.00 1.000 FORMAT "%5.3" EXTENDED_LIMITS 0.00 255.0 /end CHARACTERISTIC
/begin CHARACTERISTIC FrmMng_swtTORQUE1_C "Schalter, um die Message TORQUE1 zu aktivieren (1...enabled,. 0...disabled)" VALUE 0xD5F22 Kw_Wu8 1.000 OneToOne 0.00 1.000 FORMAT "%5.3" EXTENDED_LIMITS 0.00 255.0 /end CHARACTERISTIC
/begin CHARACTERISTIC FrmMng_swtTORQUE2_C "Schalter, um die Message TORQUE2 zu aktivieren (1...enabled,. 0...disabled)" VALUE 0xD5F23 Kw_Wu8 1.000 OneToOne 0.00 1.000 FORMAT "%5.3" EXTENDED_LIMITS 0.00 255.0 /end CHARACTERISTIC
/begin CHARACTERISTIC FrmMng_swtTORQUE3_C "Schalter, um die Message TORQUE3 zu aktivieren (1...enabled,. 0...disabled)" VALUE 0xD5F24 Kw_Wu8 1.000 OneToOne 0.00 1.000 FORMAT "%5.3" EXTENDED_LIMITS 0.00 255.0 /end CHARACTERISTIC
/begin CHARACTERISTIC FrmMng_swtTORQUE_DSC_C "Schalter, um die Message TORQUE_DSC zu aktivieren (1...enabled,. 0...disabled)" VALUE 0xD5F25 Kw_Wu8 1.000 OneToOne 0.00 1.000 FORMAT "%5.3" EXTENDED_LIMITS 0.00 255.0 /end CHARACTERISTIC
/begin CHARACTERISTIC FrmMng_swtTORQUE_GEARBX_C "Schalter, um die Message TORQUE_GEARBX zu aktivieren (1...enabled,. 0...disabled)" VALUE 0xD5F26 Kw_Wu8 1.000 OneToOne 0.00 1.000 FORMAT "%5.3" EXTENDED_LIMITS 0.00 255.0 /end CHARACTERISTIC
/begin CHARACTERISTIC FrmMng_swtVEH_MOD_C "Schalter, um die Message VEH_MOD zu aktivieren (1...enabled,. 0...disabled)" VALUE 0xD5F27 Kw_Wu8 1.000 OneToOne 0.00 1.000 FORMAT "%5.3" EXTENDED_LIMITS 0.00 255.0 /end CHARACTERISTIC
/begin CHARACTERISTIC FrmMng_swtVELOCITY_C "Schalter, um die Message VELOCITY zu aktivieren (1...enabled,. 0...disabled)" VALUE 0xD5F28 Kw_Wu8 1.000 OneToOne 0.00 1.000 FORMAT "%5.3" EXTENDED_LIMITS 0.00 255.0 /end CHARACTERISTIC
/begin CHARACTERISTIC FrmMng_swtWHEEL_SPEED_C "Schalter, um die Wheel Speed Message zu aktivieren (1...enabled,. 0...disabled)" VALUE 0xD5F29 Kw_Wu8 1.000 OneToOne 0.00 1.000 FORMAT "%5.3" EXTENDED_LIMITS 0.00 255.0 /end CHARACTERISTIC
/begin CHARACTERISTIC FrmMng_cnvTEMP_EX_Offset_C "#SSD Offset to calculate TEMP_EX from CAN" VALUE 0xD5F2A Kw_Ws16 65535.00 OneToOne -32768.00 32767.00 FORMAT "%8.2" /end CHARACTERISTIC
/begin CHARACTERISTIC FrmMng_cnvTEMP_EX_Slope_C "#SSD Slope to calculate TEMP_EX from CAN" VALUE 0xD5F2C Kw_Ws16 655.3500 SlopeRes100 -327.6800 327.6700 FORMAT "%8.4" /end CHARACTERISTIC
/begin CHARACTERISTIC FrmMng_tEngLimHi_C "obere Temperaturschwelle für Motortemperatur" VALUE 0xD5F2E Kw_Ws16 250.0000 Temp_Cels -50.14000 199.8600 FORMAT "%8.4" EXTENDED_LIMITS -3549.940 3003.560 /end CHARACTERISTIC
/begin CHARACTERISTIC FrmMng_tEngLimLo_C "Untere Temperaturschwelle für Motortemperatur" VALUE 0xD5F30 Kw_Ws16 250.0000 Temp_Cels -50.14000 199.8600 FORMAT "%8.4" EXTENDED_LIMITS -3549.940 3003.560 /end CHARACTERISTIC
/begin CHARACTERISTIC FrmMng_tEng_Offset_C "Offset für Motortemperatur" VALUE 0xD6030 Kw_Ws16 65535.00 OneToOne -32768.00 32767.00 FORMAT "%8.2" /end CHARACTERISTIC
/begin CHARACTERISTIC FrmMng_tEng_Slope_C "Steigung für Motortemperatur" VALUE 0xD6032 Kw_Ws16 65.53500 SlopeRes1000 -32.76800 32.76700 FORMAT "%8.5" /end CHARACTERISTIC
/begin CHARACTERISTIC FrmMng_tEnvDef_C "Defektwert für FrmMng_tEnvDef_C Botschaft" VALUE 0xD5F32 Kw_Ws16 950.000 Temp_Cels -50.140 899.860 FORMAT "%8.3" EXTENDED_LIMITS -3549.940 3003.560 /end CHARACTERISTIC
/begin CHARACTERISTIC FrmMng_tEnvErr_C "Fehlerwert für Umgebungstemperatur" VALUE 0xD6034 Kw_Ws16 250.0000 Temp_Cels -50.1400 199.8600 FORMAT "%8.4" EXTENDED_LIMITS -3549.940 3003.560 /end CHARACTERISTIC
/begin CHARACTERISTIC FrmMng_tiCCAddLevlCycle_C "#SSD Transmit cycle time in s for Checkcontroll message 11" VALUE 0xD5F34 Kw_Wu8 13.00 Time_fulls 1.000 14.00 FORMAT "%5.2" EXTENDED_LIMITS 0.00 255.0 /end CHARACTERISTIC
/begin CHARACTERISTIC FrmMng_tiCCBrkDefCycle_C "Sendeart CC-Meldung Bremslichtschalter defekt" VALUE 0xD5F35 Kw_Wu8 13.00 Time_fulls 1.000 14.00 FORMAT "%5.2" EXTENDED_LIMITS 0.00 255.0 /end CHARACTERISTIC
/begin CHARACTERISTIC FrmMng_tiCCbtnachCycle_C "#SSD Transmit cycle time in s for Checkcontroll message 17" VALUE 0xD5F36 Kw_Wu8 13.00 Time_fulls 1.000 14.00 FORMAT "%5.2" EXTENDED_LIMITS 0.00 255.0 /end CHARACTERISTIC
/begin CHARACTERISTIC FrmMng_tiCCbttdfkCycle_C "#SSD Transmit cycle time in s for Checkcontroll message 19" VALUE 0xD5F37 Kw_Wu8 13.00 Time_fulls 1.000 14.00 FORMAT "%5.2" EXTENDED_LIMITS 0.00 255.0 /end CHARACTERISTIC
/begin CHARACTERISTIC FrmMng_tiCCbttkntCycle_C "#SSD Transmit cycle time in s for Checkcontroll message 20" VALUE 0xD5F38 Kw_Wu8 13.00 Time_fulls 1.000 14.00 FORMAT "%5.2" EXTENDED_LIMITS 0.00 255.0 /end CHARACTERISTIC
/begin CHARACTERISTIC FrmMng_tiCCGenDef2Cycle_C "#SSD Transmit cycle time in s for Checkcontroll message 14" VALUE 0xD5F39 Kw_Wu8 13.00 Time_fulls 1.000 14.00 FORMAT "%5.2" EXTENDED_LIMITS 0.00 255.0 /end CHARACTERISTIC
/begin CHARACTERISTIC FrmMng_tiCCNoCrCtlCycle_C "#SSD Sendeart der Checkcontrol Meldung Geschwindigkeitsregelung ohne Funktion" VALUE 0xD5F3A Kw_Wu8 13.00 Time_fulls 1.000 14.00 FORMAT "%5.2" EXTENDED_LIMITS 0.00 255.0 /end CHARACTERISTIC
/begin CHARACTERISTIC FrmMng_tiCCOelLevlCycle_C "#SSD Transmit cycle time in s for Checkcontroll message 10" VALUE 0xD5F3B Kw_Wu8 13.00 Time_fulls 1.000 14.00 FORMAT "%5.2" EXTENDED_LIMITS 0.00 255.0 /end CHARACTERISTIC
/begin CHARACTERISTIC FrmMng_tiCCOelVerbCycle_C "#SSD Transmit cycle time in s for Checkcontroll message 8" VALUE 0xD5F3C Kw_Wu8 13.00 Time_fulls 1.000 14.00 FORMAT "%5.2" EXTENDED_LIMITS 0.00 255.0 /end CHARACTERISTIC
/begin CHARACTERISTIC FrmMng_tiCCOelVerlCycle_C "#SSD Transmit cycle time in s for Checkcontroll message 9" VALUE 0xD5F3D Kw_Wu8 13.00 Time_fulls 1.000 14.00 FORMAT "%5.2" EXTENDED_LIMITS 0.00 255.0 /end CHARACTERISTIC
/begin CHARACTERISTIC FrmMng_tiCCOilPresCycle_C "#SSD Transmit cycle time in s for Checkcontroll message 4" VALUE 0xD5F3E Kw_Wu8 13.00 Time_fulls 1.000 14.00 FORMAT "%5.2" EXTENDED_LIMITS 0.00 255.0 /end CHARACTERISTIC
/begin CHARACTERISTIC FrmMng_tiCCOvrTem2Cycle_C "#SSD Transmit cycle time in s for Checkcontroll message 6" VALUE 0xD5F3F Kw_Wu8 13.00 Time_fulls 1.000 14.00 FORMAT "%5.2" EXTENDED_LIMITS 0.00 255.0 /end CHARACTERISTIC
/begin CHARACTERISTIC FrmMng_tiCCOvrTempCycle_C "#SSD Transmit cycle time in s for Checkcontroll message 5" VALUE 0xD5F40 Kw_Wu8 13.00 Time_fulls 1.000 14.00 FORMAT "%5.2" EXTENDED_LIMITS 0.00 255.0 /end CHARACTERISTIC
/begin CHARACTERISTIC FrmMng_tiCCPFltDefCycle_C "#SSD Transmit cycle time in s for Checkcontroll message 12" VALUE 0xD5F41 Kw_Wu8 13.00 Time_fulls 1.000 14.00 FORMAT "%5.2" EXTENDED_LIMITS 0.00 255.0 /end CHARACTERISTIC
/begin CHARACTERISTIC FrmMng_tiCCpmerrCycle_C "#SSD Transmit cycle time in s for Checkcontroll message 18" VALUE 0xD5F42 Kw_Wu8 13.00 Time_fulls 1.000 14.00 FORMAT "%5.2" EXTENDED_LIMITS 0.00 255.0 /end CHARACTERISTIC
/begin CHARACTERISTIC FrmMng_tiCCPreGlowCycle_C "#SSD Sendeart der Checkcontrol Meldung Vorglühen" VALUE 0xD5F43 Kw_Wu8 13.00 Time_fulls 1.000 14.00 FORMAT "%5.2" EXTENDED_LIMITS 0.00 255.0 /end CHARACTERISTIC
/begin CHARACTERISTIC FrmMng_tiCCprioCycle_C "#SSD Transmit cycle time in s for Checkcontroll message 21" VALUE 0xD5F44 Kw_Wu8 13.00 Time_fulls 1.000 14.00 FORMAT "%5.2" EXTENDED_LIMITS 0.00 255.0 /end CHARACTERISTIC
/begin CHARACTERISTIC FrmMng_tiCCruhverCycle_C "#SSD Transmit cycle time in s for Checkcontroll message 16" VALUE 0xD5F45 Kw_Wu8 13.00 Time_fulls 1.000 14.00 FORMAT "%5.2" EXTENDED_LIMITS 0.00 255.0 /end CHARACTERISTIC
/begin CHARACTERISTIC FrmMng_tiCCStatMilCycle_C "#SSD Transmit cycle time in s for Checkcontroll message 7" VALUE 0xD5F46 Kw_Wu8 13.00 Time_fulls 1.000 14.00 FORMAT "%5.2" EXTENDED_LIMITS 0.00 255.0 /end CHARACTERISTIC
/begin CHARACTERISTIC FrmMng_tiCCStatMilLmpTstCycle_C "#SSD Transmit cycle time in s for Checkcontroll message 34" VALUE 0xD5F47 Kw_Wu8 13.00 Time_fulls 1.000 14.00 FORMAT "%5.2" EXTENDED_LIMITS 0.00 255.0 /end CHARACTERISTIC
/begin CHARACTERISTIC FrmMng_tiCCSysLampCycle_C "#SSD Sendeart der Checkcontrol Meldung Motornotprogramm" VALUE 0xD5F48 Kw_Wu8 13.00 Time_fulls 1.000 14.00 FORMAT "%5.2" EXTENDED_LIMITS 0.00 255.0 /end CHARACTERISTIC
/begin CHARACTERISTIC FrmMng_tiCCTxDeb_C "#SSD Mindestentprelldauer zwischen zwei aufeinanderfolgende Checkcontrol Meldungen" VALUE 0xD5F4A Kw_Wu16 1000.000 Time_ms 0.00 1000.000 FORMAT "%8.3" EXTENDED_LIMITS 0.00 655350.0 /end CHARACTERISTIC
/begin CHARACTERISTIC FrmMng_tiDebARS_C "Delay time for debouncing ASCquit" VALUE 0xD5F4C Kw_Wu16 655350.0 Time_ms 0.00 655350.0 FORMAT "%8.1" /end CHARACTERISTIC
/begin CHARACTERISTIC FrmMng_tiDebDSC_C "Delay time for debouncing ASCquit" VALUE 0xD5F4E Kw_Wu16 655350.0 Time_ms 0.00 655350.0 FORMAT "%8.1" /end CHARACTERISTIC
/begin CHARACTERISTIC FrmMng_tiDebEGS_C "Delay time for debouncing ASCquit" VALUE 0xD5F50 Kw_Wu16 655350.0 Time_ms 0.00 655350.0 FORMAT "%8.1" /end CHARACTERISTIC
/begin CHARACTERISTIC FrmMng_tiDebHtgUpShutOff_C "Zeit Debounce für Heizungsabsperrvorrichtung" VALUE 0xD5F52 Kw_Wu16 655350.0 Time_ms 0.00 655350.0 FORMAT "%8.1" /end CHARACTERISTIC
/begin CHARACTERISTIC FrmMng_tiDebHtgUpShutOn_C "Zeit Debounce für Heizungsabsperrvorrichtung" VALUE 0xD5F54 Kw_Wu16 655350.0 Time_ms 0.00 655350.0 FORMAT "%8.1" /end CHARACTERISTIC
/begin CHARACTERISTIC FrmMng_tiDebSSGDebCltTO_C "Time duration for transmit debouncing" VALUE 0xD5F56 Kw_Wu16 1000.000 Time_ms 0.00 1000.000 FORMAT "%8.3" EXTENDED_LIMITS 0.00 655350.0 /end CHARACTERISTIC
/begin CHARACTERISTIC FrmMng_tiDebSSGErrDef_C "defect time for SSG signals plausibility error" VALUE 0xD5F58 Kw_Wu16 655350.0 Time_ms 0.00 655350.0 FORMAT "%8.1" /end CHARACTERISTIC
/begin CHARACTERISTIC FrmMng_tiDebSSGErrOk_C "Healing time for SSG signals plausibility error" VALUE 0xD5F5A Kw_Wu16 655350.0 Time_ms 0.00 655350.0 FORMAT "%8.1" /end CHARACTERISTIC
/begin CHARACTERISTIC FrmMng_tiDebSSGShftPla_C "Time duration for transmit debouncing" VALUE 0xD5F5C Kw_Wu16 1000.000 Time_ms 0.00 1000.000 FORMAT "%8.3" EXTENDED_LIMITS 0.00 655350.0 /end CHARACTERISTIC
/begin CHARACTERISTIC FrmMng_tiDebSSGShOffDef_C "Defect time for SSG signals plausibility error" VALUE 0xD5F5E Kw_Wu16 655350.0 Time_ms 0.00 655350.0 FORMAT "%8.1" /end CHARACTERISTIC
/begin CHARACTERISTIC FrmMng_tiDebSSGShOffOk_C "Healing time for SSG signals plausibility error" VALUE 0xD5F60 Kw_Wu16 655350.0 Time_ms 0.00 655350.0 FORMAT "%8.1" /end CHARACTERISTIC
/begin CHARACTERISTIC FrmMng_tiDebSSGTrqIncPla_C "Time duration for transmit debouncing" VALUE 0xD5F62 Kw_Wu16 1000.000 Time_ms 0.00 1000.000 FORMAT "%8.3" EXTENDED_LIMITS 0.00 655350.0 /end CHARACTERISTIC
/begin CHARACTERISTIC FrmMng_tiDSCDelay1_C "Totzeit für DSC Eingriff" VALUE 0xD6036 Kw_Wu16 655350.0 Time_ms 0.00 655350.0 FORMAT "%8.1" /end CHARACTERISTIC
/begin CHARACTERISTIC FrmMng_tiDSCDelay2_C "Totzeit für DSC Regelung" VALUE 0xD6038 Kw_Wu16 655350.0 Time_ms 0.00 655350.0 FORMAT "%8.1" /end CHARACTERISTIC
/begin CHARACTERISTIC FrmMng_tiDSCDelay3_C "Totzeit für ASC Regelung" VALUE 0xD603A Kw_Wu16 655350.0 Time_ms 0.00 655350.0 FORMAT "%8.1" /end CHARACTERISTIC
/begin CHARACTERISTIC FrmMng_tiRecACCMax_C "Time 10 ms quantum" VALUE 0xD5F64 Kw_Wu16 9980.000 Time_ms 20.00000 10000.00 FORMAT "%8.2" EXTENDED_LIMITS 0.00 655350.0 /end CHARACTERISTIC
/begin CHARACTERISTIC FrmMng_tiRecACMax_C "" VALUE 0xD5F66 Kw_Wu16 9980.000 Time_ms 20.00000 10000.00 FORMAT "%8.2" EXTENDED_LIMITS 0.00 655350.0 /end CHARACTERISTIC
/begin CHARACTERISTIC FrmMng_tiRecAFSMax_C "Time 10 ms quantum" VALUE 0xD5F68 Kw_Wu16 9980.000 Time_ms 20.00000 10000.00 FORMAT "%8.2" EXTENDED_LIMITS 0.00 655350.0 /end CHARACTERISTIC
/begin CHARACTERISTIC FrmMng_tiRecARSMax_C "Time 10 ms quantum - ARS" VALUE 0xD5F6A Kw_Wu16 9980.000 Time_ms 20.00000 10000.00 FORMAT "%8.2" EXTENDED_LIMITS 0.00 655350.0 /end CHARACTERISTIC
/begin CHARACTERISTIC FrmMng_tiRecDCCMax_C "Zeitfenster für Erkennung Empfang Radmomentanforderung-Botschaft" VALUE 0xD5F6C Kw_Wu8 2380. Time_ms 20.00 2400. FORMAT "%5.0" EXTENDED_LIMITS 0.00 2550. /end CHARACTERISTIC
/begin CHARACTERISTIC FrmMng_tiRecFDCMax_C "Zeitfenster für Erkennug Empfang Fahrzeugmodus Botschaft" VALUE 0xD5F6E Kw_Wu16 9980.000 Time_ms 20.00000 10000.00 FORMAT "%8.2" EXTENDED_LIMITS 0.00 655350.0 /end CHARACTERISTIC
/begin CHARACTERISTIC FrmMng_tiRecFGRMax_C "Maximum time for FGR recognition" VALUE 0xD5F70 Kw_Wu16 9980.000 Time_ms 20.00000 10000.00 FORMAT "%8.2" EXTENDED_LIMITS 0.00 655350.0 /end CHARACTERISTIC
/begin CHARACTERISTIC FrmMng_tiStartDelay_C "Verzögerungszeit des Start Systems" VALUE 0xD5F72 Kw_Wu16 655350.0 Time_ms 0.00 655350.0 FORMAT "%8.1" /end CHARACTERISTIC
/begin CHARACTERISTIC FrmMng_trqACErr_C "Klimakompressor Lastmoment im Fehlerfall" VALUE 0xD603C Kw_Ws16 31.00000 Trq 0.00 31.00000 FORMAT "%8.5" EXTENDED_LIMITS -3276.800 3276.700 /end CHARACTERISTIC
/begin CHARACTERISTIC FrmMng_trqARSCurDef_C "Error value for FrmMng_trqARSCur" VALUE 0xD5F74 Kw_Ws16 11000.00 TrqPrp -5000.000 6000.000 FORMAT "%8.3" EXTENDED_LIMITS -6553.600 6553.400 /end CHARACTERISTIC
/begin CHARACTERISTIC FrmMng_trqARSDesDef_C "applicationvalue for desired torque ARS in case of message error" VALUE 0xD5F76 Kw_Ws16 11000.00 TrqPrp -5000.000 6000.000 FORMAT "%8.3" EXTENDED_LIMITS -6553.600 6553.400 /end CHARACTERISTIC
/begin CHARACTERISTIC FrmMng_trqGearbxFrc_C "" VALUE 0xD5F78 Kw_Ws16 1500.000 Trq -500.0000 1000.000 FORMAT "%8.3" EXTENDED_LIMITS -3276.800 3276.700 /end CHARACTERISTIC
/begin CHARACTERISTIC FrmMng_trqGearbxMaxSubs_C "#SSD Ersatzwert für maximales Getriebemoment im heat modus bei ausgefallenen CAN" VALUE 0xD5F7A Kw_Ws16 1500.000 Trq -500.0000 1000.000 FORMAT "%8.3" EXTENDED_LIMITS -3276.800 3276.700 /end CHARACTERISTIC
/begin CHARACTERISTIC FrmMng_trqLiGovMin_C "tarque switch for evaluating ST_SW_WAUP signal" VALUE 0xD5F7C Kw_Ws16 1500.000 Trq -500.0000 1000.000 FORMAT "%8.3" EXTENDED_LIMITS -3276.800 3276.700 /end CHARACTERISTIC
/begin CHARACTERISTIC FrmMng_trqLim_CUR "torque limit at system error" CURVE 0xD603E Kl_Xs16_Ws16 11000.00 TrqPrp -5000.000 6000.000 FORMAT "%8.3" EXTENDED_LIMITS -6553.600 6553.400
 /begin AXIS_DESCR STD_AXIS Eng_nAvrg EngN 10 -32768.00 6000.000 FORMAT "%8.2" EXTENDED_LIMITS -32768.00 32767.00 DEPOSIT ABSOLUTE /end AXIS_DESCR
/end CHARACTERISTIC
/begin CHARACTERISTIC FrmMng_trqNorm_C "Normwert für Momente" VALUE 0xD6068 Kw_Wu16 1008.000 Trq 0.00 1008.000 FORMAT "%8.3" EXTENDED_LIMITS 0.00 6553.500 /end CHARACTERISTIC
/begin CHARACTERISTIC FrmMng_trqSSGPlaThres_C "torque threhold" VALUE 0xD5F7E Kw_Ws16 1500.000 Trq -500.0000 1000.000 FORMAT "%8.3" EXTENDED_LIMITS -3276.800 3276.700 /end CHARACTERISTIC
/begin CHARACTERISTIC FrmMng_trq_Offset_C "Offset Umrechung SG->CAN für Momente" VALUE 0xD606A Kw_Ws16 799.9878 Prc -400.0000 399.9878 FORMAT "%8.4" /end CHARACTERISTIC
/begin CHARACTERISTIC FrmMng_trq_Slope_C "Steigung Umrechung SG->CAN für Momente" VALUE 0xD606C Kw_Ws16 65.53500 SlopeRes1000 -32.76800 32.76700 FORMAT "%8.5" /end CHARACTERISTIC
/begin CHARACTERISTIC FrmMng_tWaterVlv_C "" VALUE 0xD5F80 Kw_Ws16 950.0000 Temp_Cels -50.1400 899.8600 FORMAT "%8.4" EXTENDED_LIMITS -3549.940 3003.560 /end CHARACTERISTIC
/begin CHARACTERISTIC FrmMng_ubtMin_C "minimale Batteriespannungsänderung um POWERMGMT_BATTERIESPANNUNG zu versenden" VALUE 0xD5F82 Kw_Wu8 3.8250000 spg_uw_q0p015 0.00 3.8250000 FORMAT "%9.7" /end CHARACTERISTIC
/begin CHARACTERISTIC FrmMng_vHtgUpActMax_C "velocity threshold for evaluating ST_SW_WAUP signal" VALUE 0xD5F84 Kw_Ws16 300.0000 Vel 0.00 300.0000 FORMAT "%8.4" EXTENDED_LIMITS -327.6800 327.6700 /end CHARACTERISTIC
/begin CHARACTERISTIC FrmMng_cnvvPrgNo_Offset_C "#SSD Offset for calculation V_PRGG_CCTR_IDX_NO_X from CAN" VALUE 0xD5F86 Kw_Ws16 65535.00 OneToOne -32768.00 32767.00 FORMAT "%8.2" /end CHARACTERISTIC
/begin CHARACTERISTIC FrmMng_cnvvPrgNo_Slope_C "#SSD Slope for calculation V_PRGG_CCTR_IDX_NO_X from CAN" VALUE 0xD5F88 Kw_Ws16 655.3500 SlopeRes100 -327.6800 327.6700 FORMAT "%8.4" /end CHARACTERISTIC
/begin CHARACTERISTIC FrmMng_vSSGPlaThres_C "vehicle speed threhold" VALUE 0xD5F8A Kw_Wu16 300.0000 Vel 0.00 300.0000 FORMAT "%8.4" EXTENDED_LIMITS 0.00 655.3500 /end CHARACTERISTIC
/begin MEASUREMENT FrmMng_ctrIdxNo "index counter for velocities" UBYTE OneToOne 1 100 0.00 255.0 FORMAT "%5.1" ECU_ADDRESS 0x7F888F /end MEASUREMENT
/begin MEASUREMENT FrmMng_dOBDCtl_mp "Measuring Point for OBD status" UBYTE OneToOne 1 100 0.00 255.0 FORMAT "%5.1" ECU_ADDRESS 0x8FF02E /end MEASUREMENT
/begin MEASUREMENT FrmMng_nPSP "Ist-Drehzahl EKP" SWORD PSP_Spd 1 100 -32768.00 32767.00 FORMAT "%8.2" ECU_ADDRESS 0x7F8CFA /end MEASUREMENT
/begin MEASUREMENT FrmMng_numASC1byte0_mp "Rohwerte von der CAN-Botschaft ASC1" UBYTE OneToOne 1 100 0.00 255.0 FORMAT "%5.1" ECU_ADDRESS 0x8FF02F /end MEASUREMENT
/begin MEASUREMENT FrmMng_numASC1byte1_mp "Rohwerte von der CAN-Botschaft ASC1" UBYTE OneToOne 1 100 0.00 255.0 FORMAT "%5.1" ECU_ADDRESS 0x8FF030 /end MEASUREMENT
/begin MEASUREMENT FrmMng_numASC1byte2_mp "Rohwerte von der CAN-Botschaft ASC1" UBYTE OneToOne 1 100 0.00 255.0 FORMAT "%5.1" ECU_ADDRESS 0x8FF031 /end MEASUREMENT
/begin MEASUREMENT FrmMng_numASC1byte3_mp "Rohwerte von der CAN-Botschaft ASC1" UBYTE OneToOne 1 100 0.00 255.0 FORMAT "%5.1" ECU_ADDRESS 0x8FF032 /end MEASUREMENT
/begin MEASUREMENT FrmMng_numASC1byte4_mp "Rohwerte von der CAN-Botschaft ASC1" UBYTE OneToOne 1 100 0.00 255.0 FORMAT "%5.1" ECU_ADDRESS 0x8FF033 /end MEASUREMENT
/begin MEASUREMENT FrmMng_numASC1byte5_mp "Rohwerte von der CAN-Botschaft ASC1" UBYTE OneToOne 1 100 0.00 255.0 FORMAT "%5.1" ECU_ADDRESS 0x8FF034 /end MEASUREMENT
/begin MEASUREMENT FrmMng_numASC1byte6_mp "Rohwerte von der CAN-Botschaft ASC1" UBYTE OneToOne 1 100 0.00 255.0 FORMAT "%5.1" ECU_ADDRESS 0x8FF035 /end MEASUREMENT
/begin MEASUREMENT FrmMng_numASC1byte7_mp "Rohwerte von der CAN-Botschaft ASC1" UBYTE OneToOne 1 100 0.00 255.0 FORMAT "%5.1" ECU_ADDRESS 0x8FF036 /end MEASUREMENT
/begin MEASUREMENT FrmMng_numASC2byte0_mp "Rohwerte von der CAN-Botschaft ASC2" UBYTE OneToOne 1 100 0.00 255.0 FORMAT "%5.1" ECU_ADDRESS 0x8FF037 /end MEASUREMENT
/begin MEASUREMENT FrmMng_numASC2byte1_mp "Rohwerte von der CAN-Botschaft ASC2" UBYTE OneToOne 1 100 0.00 255.0 FORMAT "%5.1" ECU_ADDRESS 0x8FF038 /end MEASUREMENT
/begin MEASUREMENT FrmMng_numASC2byte2_mp "Rohwerte von der CAN-Botschaft ASC2" UBYTE OneToOne 1 100 0.00 255.0 FORMAT "%5.1" ECU_ADDRESS 0x8FF039 /end MEASUREMENT
/begin MEASUREMENT FrmMng_numASC2byte3_mp "Rohwerte von der CAN-Botschaft ASC2" UBYTE OneToOne 1 100 0.00 255.0 FORMAT "%5.1" ECU_ADDRESS 0x8FF03A /end MEASUREMENT
/begin MEASUREMENT FrmMng_numASC2byte4_mp "Rohwerte von der CAN-Botschaft ASC2" UBYTE OneToOne 1 100 0.00 255.0 FORMAT "%5.1" ECU_ADDRESS 0x8FF03B /end MEASUREMENT
/begin MEASUREMENT FrmMng_numASC2byte5_mp "Rohwerte von der CAN-Botschaft ASC2" UBYTE OneToOne 1 100 0.00 255.0 FORMAT "%5.1" ECU_ADDRESS 0x8FF03C /end MEASUREMENT
/begin MEASUREMENT FrmMng_numASC2byte6_mp "Rohwerte von der CAN-Botschaft ASC2" UBYTE OneToOne 1 100 0.00 255.0 FORMAT "%5.1" ECU_ADDRESS 0x8FF03D /end MEASUREMENT
/begin MEASUREMENT FrmMng_numASC2byte7_mp "Rohwerte von der CAN-Botschaft ASC2" UBYTE OneToOne 1 100 0.00 255.0 FORMAT "%5.1" ECU_ADDRESS 0x8FF03E /end MEASUREMENT
/begin MEASUREMENT FrmMng_numASC3byte0_mp "Rohwerte von der CAN-Botschaft ASC3" UBYTE OneToOne 1 100 0.00 255.0 FORMAT "%5.1" ECU_ADDRESS 0x8FF03F /end MEASUREMENT
/begin MEASUREMENT FrmMng_numASC3byte1_mp "Rohwerte von der CAN-Botschaft ASC3" UBYTE OneToOne 1 100 0.00 255.0 FORMAT "%5.1" ECU_ADDRESS 0x8FF040 /end MEASUREMENT
/begin MEASUREMENT FrmMng_numASC3byte2_mp "Rohwerte von der CAN-Botschaft ASC3" UBYTE OneToOne 1 100 0.00 255.0 FORMAT "%5.1" ECU_ADDRESS 0x8FF041 /end MEASUREMENT
/begin MEASUREMENT FrmMng_numASC3byte3_mp "Rohwerte von der CAN-Botschaft ASC3" UBYTE OneToOne 1 100 0.00 255.0 FORMAT "%5.1" ECU_ADDRESS 0x8FF042 /end MEASUREMENT
/begin MEASUREMENT FrmMng_numASC3byte4_mp "Rohwerte von der CAN-Botschaft ASC3" UBYTE OneToOne 1 100 0.00 255.0 FORMAT "%5.1" ECU_ADDRESS 0x8FF043 /end MEASUREMENT
/begin MEASUREMENT FrmMng_numASC3byte5_mp "Rohwerte von der CAN-Botschaft ASC3" UBYTE OneToOne 1 100 0.00 255.0 FORMAT "%5.1" ECU_ADDRESS 0x8FF044 /end MEASUREMENT
/begin MEASUREMENT FrmMng_numASC3byte6_mp "Rohwerte von der CAN-Botschaft ASC3" UBYTE OneToOne 1 100 0.00 255.0 FORMAT "%5.1" ECU_ADDRESS 0x8FF045 /end MEASUREMENT
/begin MEASUREMENT FrmMng_numASC3byte7_mp "Rohwerte von der CAN-Botschaft ASC3" UBYTE OneToOne 1 100 0.00 255.0 FORMAT "%5.1" ECU_ADDRESS 0x8FF046 /end MEASUREMENT
/begin MEASUREMENT FrmMng_numASC4byte0_mp "Rohwerte von der CAN-Botschaft ASC4" UBYTE OneToOne 1 100 0.00 255.0 FORMAT "%5.1" ECU_ADDRESS 0x8FF047 /end MEASUREMENT
/begin MEASUREMENT FrmMng_numASC4byte1_mp "Rohwerte von der CAN-Botschaft ASC4" UBYTE OneToOne 1 100 0.00 255.0 FORMAT "%5.1" ECU_ADDRESS 0x8FF048 /end MEASUREMENT
/begin MEASUREMENT FrmMng_numASC4byte2_mp "Rohwerte von der CAN-Botschaft ASC4" UBYTE OneToOne 1 100 0.00 255.0 FORMAT "%5.1" ECU_ADDRESS 0x8FF049 /end MEASUREMENT
/begin MEASUREMENT FrmMng_numASC4byte3_mp "Rohwerte von der CAN-Botschaft ASC4" UBYTE OneToOne 1 100 0.00 255.0 FORMAT "%5.1" ECU_ADDRESS 0x8FF04A /end MEASUREMENT
/begin MEASUREMENT FrmMng_numASC4byte4_mp "Rohwerte von der CAN-Botschaft ASC4" UBYTE OneToOne 1 100 0.00 255.0 FORMAT "%5.1" ECU_ADDRESS 0x8FF04B /end MEASUREMENT
/begin MEASUREMENT FrmMng_numASC4byte5_mp "Rohwerte von der CAN-Botschaft ASC4" UBYTE OneToOne 1 100 0.00 255.0 FORMAT "%5.1" ECU_ADDRESS 0x8FF04C /end MEASUREMENT
/begin MEASUREMENT FrmMng_numASC4byte6_mp "Rohwerte von der CAN-Botschaft ASC4" UBYTE OneToOne 1 100 0.00 255.0 FORMAT "%5.1" ECU_ADDRESS 0x8FF04D /end MEASUREMENT
/begin MEASUREMENT FrmMng_numASC4byte7_mp "Rohwerte von der CAN-Botschaft ASC4" UBYTE OneToOne 1 100 0.00 255.0 FORMAT "%5.1" ECU_ADDRESS 0x8FF04E /end MEASUREMENT
/begin MEASUREMENT FrmMng_numDDE1byte0_mp "Rohwerte für DDE1" UBYTE OneToOne 1 100 0.00 255.0 FORMAT "%5.1" ECU_ADDRESS 0x8FF04F /end MEASUREMENT
/begin MEASUREMENT FrmMng_numDDE1byte1_mp "Rohwete für DDE1" UBYTE OneToOne 1 100 0.00 255.0 FORMAT "%5.1" ECU_ADDRESS 0x8FF050 /end MEASUREMENT
/begin MEASUREMENT FrmMng_numDDE1byte2_mp "Rohwerte für DDE1" UBYTE OneToOne 1 100 0.00 255.0 FORMAT "%5.1" ECU_ADDRESS 0x8FF051 /end MEASUREMENT
/begin MEASUREMENT FrmMng_numDDE1byte3_mp "Rohwerte für DDE1" UBYTE OneToOne 1 100 0.00 255.0 FORMAT "%5.1" ECU_ADDRESS 0x8FF052 /end MEASUREMENT
/begin MEASUREMENT FrmMng_numDDE1byte4_mp "Rohwerte für DDE1" UBYTE OneToOne 1 100 0.00 255.0 FORMAT "%5.1" ECU_ADDRESS 0x8FF053 /end MEASUREMENT
/begin MEASUREMENT FrmMng_numDDE1byte5_mp "Rohwerte für DDE1" UBYTE OneToOne 1 100 0.00 255.0 FORMAT "%5.1" ECU_ADDRESS 0x8FF054 /end MEASUREMENT
/begin MEASUREMENT FrmMng_numDDE1byte6_mp "Rohwerte für DDE1" UBYTE OneToOne 1 100 0.00 255.0 FORMAT "%5.1" ECU_ADDRESS 0x8FF055 /end MEASUREMENT
/begin MEASUREMENT FrmMng_numDDE1byte7_mp "Rohwerte für DDE1" UBYTE OneToOne 1 100 0.00 255.0 FORMAT "%5.1" ECU_ADDRESS 0x8FF056 /end MEASUREMENT
/begin MEASUREMENT FrmMng_numDDE2byte0_mp "Rohwerte für DDE2" UBYTE OneToOne 1 100 0.00 255.0 FORMAT "%5.1" ECU_ADDRESS 0x8FF057 /end MEASUREMENT
/begin MEASUREMENT FrmMng_numDDE2byte1_mp "Rohwerte für DDE2" UBYTE OneToOne 1 100 0.00 255.0 FORMAT "%5.1" ECU_ADDRESS 0x8FF058 /end MEASUREMENT
/begin MEASUREMENT FrmMng_numDDE2byte2_mp "Rohwerte für DDE2" UBYTE OneToOne 1 100 0.00 255.0 FORMAT "%5.1" ECU_ADDRESS 0x8FF059 /end MEASUREMENT
/begin MEASUREMENT FrmMng_numDDE2byte3_mp "Rohwerte für DDE2" UBYTE OneToOne 1 100 0.00 255.0 FORMAT "%5.1" ECU_ADDRESS 0x8FF05A /end MEASUREMENT
/begin MEASUREMENT FrmMng_numDDE2byte4_mp "Rohwerte für DDE2" UBYTE OneToOne 1 100 0.00 255.0 FORMAT "%5.1" ECU_ADDRESS 0x8FF05B /end MEASUREMENT
/begin MEASUREMENT FrmMng_numDDE2byte5_mp "Rohwerte für DDE2" UBYTE OneToOne 1 100 0.00 255.0 FORMAT "%5.1" ECU_ADDRESS 0x8FF05C /end MEASUREMENT
/begin MEASUREMENT FrmMng_numDDE2byte6_mp "Rohwerte für DDE2" UBYTE OneToOne 1 100 0.00 255.0 FORMAT "%5.1" ECU_ADDRESS 0x8FF05D /end MEASUREMENT
/begin MEASUREMENT FrmMng_numDDE2byte7_mp "Rohwerte für DDE2" UBYTE OneToOne 1 100 0.00 255.0 FORMAT "%5.1" ECU_ADDRESS 0x8FF05E /end MEASUREMENT
/begin MEASUREMENT FrmMng_numDDE4byte0_mp "Rohwerte für DDE4" UBYTE OneToOne 1 100 0.00 255.0 FORMAT "%5.1" ECU_ADDRESS 0x8FF05F /end MEASUREMENT
/begin MEASUREMENT FrmMng_numDDE4byte1_mp "Rohwerte für DDE4" UBYTE OneToOne 1 100 0.00 255.0 FORMAT "%5.1" ECU_ADDRESS 0x8FF060 /end MEASUREMENT
/begin MEASUREMENT FrmMng_numDDE4byte2_mp "Rohwerte für DDE4" UBYTE OneToOne 1 100 0.00 255.0 FORMAT "%5.1" ECU_ADDRESS 0x8FF061 /end MEASUREMENT
/begin MEASUREMENT FrmMng_numDDE4byte3_mp "Rohwerte für DDE4" UBYTE OneToOne 1 100 0.00 255.0 FORMAT "%5.1" ECU_ADDRESS 0x8FF062 /end MEASUREMENT
/begin MEASUREMENT FrmMng_numDDE4byte4_mp "Rohwerte für DDE4" UBYTE OneToOne 1 100 0.00 255.0 FORMAT "%5.1" ECU_ADDRESS 0x8FF063 /end MEASUREMENT
/begin MEASUREMENT FrmMng_numDDE4byte5_mp "Rohwerte für DDE4" UBYTE OneToOne 1 100 0.00 255.0 FORMAT "%5.1" ECU_ADDRESS 0x8FF064 /end MEASUREMENT
/begin MEASUREMENT FrmMng_numDDE4byte6_mp "Rohwerte für DDE4" UBYTE OneToOne 1 100 0.00 255.0 FORMAT "%5.1" ECU_ADDRESS 0x8FF065 /end MEASUREMENT
/begin MEASUREMENT FrmMng_numDDE4byte7_mp "Rohwerte für DDE4" UBYTE OneToOne 1 100 0.00 255.0 FORMAT "%5.1" ECU_ADDRESS 0x8FF066 /end MEASUREMENT
/begin MEASUREMENT FrmMng_numEGS1byte0_mp "Rohwerte von der Can-Botschaft EGS1" UBYTE OneToOne 1 100 0.00 255.0 FORMAT "%5.1" ECU_ADDRESS 0x8FF067 /end MEASUREMENT
/begin MEASUREMENT FrmMng_numEGS1byte1_mp "Rohwerte von der Can-Botschaft EGS1" UBYTE OneToOne 1 100 0.00 255.0 FORMAT "%5.1" ECU_ADDRESS 0x8FF068 /end MEASUREMENT
/begin MEASUREMENT FrmMng_numEGS1byte2_mp "Rohwerte von der Can-Botschaft EGS1" UBYTE OneToOne 1 100 0.00 255.0 FORMAT "%5.1" ECU_ADDRESS 0x8FF069 /end MEASUREMENT
/begin MEASUREMENT FrmMng_numEGS1byte3_mp "Rohwerte von der Can-Botschaft EGS1" UBYTE OneToOne 1 100 0.00 255.0 FORMAT "%5.1" ECU_ADDRESS 0x8FF06A /end MEASUREMENT
/begin MEASUREMENT FrmMng_numEGS1byte4_mp "Rohwerte von der Can - Botschaft EGS1" UBYTE OneToOne 1 100 0.00 255.0 FORMAT "%5.1" ECU_ADDRESS 0x8FF06B /end MEASUREMENT
/begin MEASUREMENT FrmMng_numEGS1byte5_mp "Rohwerte von der Can - Botschaft EGS1" UBYTE OneToOne 1 100 0.00 255.0 FORMAT "%5.1" ECU_ADDRESS 0x8FF06C /end MEASUREMENT
/begin MEASUREMENT FrmMng_numEGS1byte6_mp "Rohwerte von der Canbotschaft EGS1" UBYTE OneToOne 1 100 0.00 255.0 FORMAT "%5.1" ECU_ADDRESS 0x8FF06D /end MEASUREMENT
/begin MEASUREMENT FrmMng_numEGS1byte7_mp "Rohwerte von der Canbotschaft EGS1" UBYTE OneToOne 1 100 0.00 255.0 FORMAT "%5.1" ECU_ADDRESS 0x8FF06E /end MEASUREMENT
/begin MEASUREMENT FrmMng_numEGS2byte0_mp "Rohwerte von der CAN-Botschaft EGS2" UBYTE OneToOne 1 100 0.00 255.0 FORMAT "%5.1" ECU_ADDRESS 0x8FF06F /end MEASUREMENT
/begin MEASUREMENT FrmMng_numEGS2byte1_mp "Rohwerte von der CAN-Botschaft EGS2" UBYTE OneToOne 1 100 0.00 255.0 FORMAT "%5.1" ECU_ADDRESS 0x8FF070 /end MEASUREMENT
/begin MEASUREMENT FrmMng_numEGS2byte2_mp "Rohwerte von der CAN-Botschaft EGS2" UBYTE OneToOne 1 100 0.00 255.0 FORMAT "%5.1" ECU_ADDRESS 0x8FF071 /end MEASUREMENT
/begin MEASUREMENT FrmMng_numEGS2byte3_mp "Rohwerte von der CAN-Botschaft EGS2" UBYTE OneToOne 1 100 0.00 255.0 FORMAT "%5.1" ECU_ADDRESS 0x8FF072 /end MEASUREMENT
/begin MEASUREMENT FrmMng_numEGS2byte4_mp "Rohwerte von der CAN-Botschaft EGS2" UBYTE OneToOne 1 100 0.00 255.0 FORMAT "%5.1" ECU_ADDRESS 0x8FF073 /end MEASUREMENT
/begin MEASUREMENT FrmMng_numEGS2byte5_mp "Rohwerte von der CAN-Botschaft EGS2" UBYTE OneToOne 1 100 0.00 255.0 FORMAT "%5.1" ECU_ADDRESS 0x8FF074 /end MEASUREMENT
/begin MEASUREMENT FrmMng_numEGS2byte6_mp "Rohwerte von der CAN-Botschaft EGS2" UBYTE OneToOne 1 100 0.00 255.0 FORMAT "%5.1" ECU_ADDRESS 0x8FF075 /end MEASUREMENT
/begin MEASUREMENT FrmMng_numEGS2byte7_mp "Rohwerte von der CAN-Botschaft EGS2" UBYTE OneToOne 1 100 0.00 255.0 FORMAT "%5.1" ECU_ADDRESS 0x8FF076 /end MEASUREMENT
/begin MEASUREMENT FrmMng_numEKPbyte0_mp "Byte 1 von EKP-CAN-Botschaft" UBYTE OneToOne 1 100 0.00 255.0 FORMAT "%5.1" ECU_ADDRESS 0x8FF077 /end MEASUREMENT
/begin MEASUREMENT FrmMng_numEKPbyte1_mp "Byte 2 von EKP-CAN-Botschaft" UBYTE OneToOne 1 100 0.00 255.0 FORMAT "%5.1" ECU_ADDRESS 0x8FF078 /end MEASUREMENT
/begin MEASUREMENT FrmMng_numEKPbyte2_mp "Byte 3 von EKP-CAN-Botschaft" UBYTE OneToOne 1 100 0.00 255.0 FORMAT "%5.1" ECU_ADDRESS 0x8FF079 /end MEASUREMENT
/begin MEASUREMENT FrmMng_numEKPbyte3_mp "Byte 4 von EKP-CAN-Botschaft" UBYTE OneToOne 1 100 0.00 255.0 FORMAT "%5.1" ECU_ADDRESS 0x8FF07A /end MEASUREMENT
/begin MEASUREMENT FrmMng_numINSTR2byte0_mp "Rohwert INSTR2-Byte0" UBYTE OneToOne 1 100 0.00 255.0 FORMAT "%5.1" ECU_ADDRESS 0x8FF07B /end MEASUREMENT
/begin MEASUREMENT FrmMng_numINSTR2byte1_mp "Rohwert INSTR2-Byte1" UBYTE OneToOne 1 100 0.00 255.0 FORMAT "%5.1" ECU_ADDRESS 0x8FF07C /end MEASUREMENT
/begin MEASUREMENT FrmMng_numINSTR2byte2_mp "Rohwert INSTR2-Byte2" UBYTE OneToOne 1 100 0.00 255.0 FORMAT "%5.1" ECU_ADDRESS 0x8FF07D /end MEASUREMENT
/begin MEASUREMENT FrmMng_numINSTR2byte3_mp "Rohwert INSTR2-Byte3" UBYTE OneToOne 1 100 0.00 255.0 FORMAT "%5.1" ECU_ADDRESS 0x8FF07E /end MEASUREMENT
/begin MEASUREMENT FrmMng_numINSTR2byte4_mp "Rohwert INSTR2-Byte4" UBYTE OneToOne 1 100 0.00 255.0 FORMAT "%5.1" ECU_ADDRESS 0x8FF07F /end MEASUREMENT
/begin MEASUREMENT FrmMng_numINSTR2byte5_mp "Rohwert INSTR2-Byte5" UBYTE OneToOne 1 100 0.00 255.0 FORMAT "%5.1" ECU_ADDRESS 0x8FF080 /end MEASUREMENT
/begin MEASUREMENT FrmMng_numINSTR2byte6_mp "Rohwert INSTR2-Byte6" UBYTE OneToOne 1 100 0.00 255.0 FORMAT "%5.1" ECU_ADDRESS 0x8FF081 /end MEASUREMENT
/begin MEASUREMENT FrmMng_numINSTR2byte7_mp "Rohwert INSTR2-Byte7" UBYTE OneToOne 1 100 0.00 255.0 FORMAT "%5.1" ECU_ADDRESS 0x8FF082 /end MEASUREMENT
/begin MEASUREMENT FrmMng_numINSTR3byte0_mp "Rohwert INSTR3-Byte0" UBYTE OneToOne 1 100 0.00 255.0 FORMAT "%5.1" ECU_ADDRESS 0x8FF083 /end MEASUREMENT
/begin MEASUREMENT FrmMng_numINSTR3byte1_mp "Rohwert INSTR3-Byte1" UBYTE OneToOne 1 100 0.00 255.0 FORMAT "%5.1" ECU_ADDRESS 0x8FF084 /end MEASUREMENT
/begin MEASUREMENT FrmMng_numINSTR3byte2_mp "Rohwert INSTR3-Byte2" UBYTE OneToOne 1 100 0.00 255.0 FORMAT "%5.1" ECU_ADDRESS 0x8FF085 /end MEASUREMENT
/begin MEASUREMENT FrmMng_numINSTR3byte3_mp "Rohwert INSTR3-Byte3" UBYTE OneToOne 1 100 0.00 255.0 FORMAT "%5.1" ECU_ADDRESS 0x8FF086 /end MEASUREMENT
/begin MEASUREMENT FrmMng_numINSTR3byte4_mp "Rohwert INSTR3-Byte4" UBYTE OneToOne 1 100 0.00 255.0 FORMAT "%5.1" ECU_ADDRESS 0x8FF087 /end MEASUREMENT
/begin MEASUREMENT FrmMng_numINSTR3byte5_mp "Rohwert INSTR3-Byte5" UBYTE OneToOne 1 100 0.00 255.0 FORMAT "%5.1" ECU_ADDRESS 0x8FF088 /end MEASUREMENT
/begin MEASUREMENT FrmMng_numINSTR3byte6_mp "Rohwert INSTR3-Byte6" UBYTE OneToOne 1 100 0.00 255.0 FORMAT "%5.1" ECU_ADDRESS 0x8FF089 /end MEASUREMENT
/begin MEASUREMENT FrmMng_numINSTR3byte7_mp "Rohwert INSTR3-Byte7" UBYTE OneToOne 1 100 0.00 255.0 FORMAT "%5.1" ECU_ADDRESS 0x8FF08A /end MEASUREMENT
/begin MEASUREMENT FrmMng_pAir "Atmosphärendruck über CAN" SWORD Pres_hPa 1 100 -32768.00 32767.00 FORMAT "%8.2" ECU_ADDRESS 0x7F8D04 /end MEASUREMENT
/begin MEASUREMENT FrmMng_rPSPSetPoint "Aktuelle Stellgröße der EKP-Regelung" SWORD Prc 1 100 -400.0000 399.9878 FORMAT "%8.4" ECU_ADDRESS 0x7F8D10 /end MEASUREMENT
/begin MEASUREMENT FrmMng_rTrqDCS_mp "Meßpunkt für Verhältnis MSR-Anforderungsmoment / Maximalmoment" SWORD Prc 1 100 -400.0000 399.9878 FORMAT "%8.4" ECU_ADDRESS 0x8FF08C /end MEASUREMENT
/begin MEASUREMENT FrmMng_rTrqGearbxFrc_mp "MD_GETRIEBE nach Normalisation" SWORD Prc 1 100 -400.0000 399.9878 FORMAT "%8.4" ECU_ADDRESS 0x8FF08E /end MEASUREMENT
/begin MEASUREMENT FrmMng_rTrqGearbx_mp "MD_IND_GS nach Normalisation" SWORD Prc 1 100 -400.0000 399.9878 FORMAT "%8.4" ECU_ADDRESS 0x8FF090 /end MEASUREMENT
/begin MEASUREMENT FrmMng_rTrqTCS_mp "Meßpunkt für Verhältnis ASR-Anforderungsmoment / Maximalmoment" SWORD Prc 1 100 -400.0000 399.9878 FORMAT "%8.4" ECU_ADDRESS 0x8FF092 /end MEASUREMENT
/begin MEASUREMENT FrmMng_stAC "Klimaanlagenzustand über CAN" UWORD OneToOne 1 100 0.00 65535.00 FORMAT "%8.2" ECU_ADDRESS 0x7F8D14 /end MEASUREMENT
/begin MEASUREMENT FrmMng_stASC1Sig_mp "Signal-Error-Status ASC1" UWORD OneToOne 1 100 0.00 65535.00 FORMAT "%8.2" ECU_ADDRESS 0x8FF094 /end MEASUREMENT
/begin MEASUREMENT FrmMng_stASC2Sig_mp "Signal-Error-Status ASC2" UWORD OneToOne 1 100 0.00 65535.00 FORMAT "%8.2" ECU_ADDRESS 0x8FF096 /end MEASUREMENT
/begin MEASUREMENT FrmMng_stASC3Sig_mp "Signal-Error-Status ASC3" UWORD OneToOne 1 100 0.00 65535.00 FORMAT "%8.2" ECU_ADDRESS 0x8FF098 /end MEASUREMENT
/begin MEASUREMENT FrmMng_stASC4Sig_mp "Signalerrorstate ASC4" UWORD OneToOne 1 100 0.00 65535.00 FORMAT "%8.2" ECU_ADDRESS 0x8FF09A /end MEASUREMENT
/begin MEASUREMENT FrmMng_stASCok "status ASC Eingriff" UBYTE OneToOne 1 100 0.00 255.0 FORMAT "%5.1" ECU_ADDRESS 0x7F88A1 /end MEASUREMENT
/begin MEASUREMENT FrmMng_stBrkTCS_mp "Bremsstatus TCS" UBYTE OneToOne 1 100 0.00 255.0 FORMAT "%5.1" ECU_ADDRESS 0x8FF09C /end MEASUREMENT
/begin MEASUREMENT FrmMng_stCrCCDKey_mp "Bediensignal FGR" UBYTE OneToOne 1 100 0.00 255.0 FORMAT "%5.1" ECU_ADDRESS 0x8FF09D /end MEASUREMENT
/begin MEASUREMENT FrmMng_stCrCtlOff_mp "FGR Abschaltung von DSC" UBYTE OneToOne 1 100 0.00 255.0 FORMAT "%5.1" ECU_ADDRESS 0x8FF09E /end MEASUREMENT
/begin MEASUREMENT FrmMng_stDCSActive_mp "Signal B_MSR von CAN, MSR Eingriff aktiv" UBYTE OneToOne 1 100 0.00 255.0 FORMAT "%5.1" ECU_ADDRESS 0x8FF09F /end MEASUREMENT
/begin MEASUREMENT FrmMng_stDSCCtrl_mp "DSC Eingriff" UBYTE OneToOne 1 100 0.00 255.0 FORMAT "%5.1" ECU_ADDRESS 0x8FF0A0 /end MEASUREMENT
/begin MEASUREMENT FrmMng_stDSCDelay_mp "Status für DSC delay" UBYTE OneToOne 1 100 0.00 255.0 FORMAT "%5.1" ECU_ADDRESS 0x8FF0A1 /end MEASUREMENT
/begin MEASUREMENT FrmMng_stEGS1Sig_mp "Zustand des Getriebes" UWORD OneToOne 1 100 0.00 65535.00 FORMAT "%8.2" ECU_ADDRESS 0x8FF0A2 /end MEASUREMENT
/begin MEASUREMENT FrmMng_stEGS2Sig_mp "Signal-Error-Status EGS2" UWORD OneToOne 1 100 0.00 65535.00 FORMAT "%8.2" ECU_ADDRESS 0x8FF0A4 /end MEASUREMENT
/begin MEASUREMENT FrmMng_stEngRun_mp "Motorlaufzustand über CAN" UBYTE OneToOne 1 100 0.00 255.0 FORMAT "%5.1" ECU_ADDRESS 0x8FF0A6 /end MEASUREMENT
/begin MEASUREMENT FrmMng_stExc_ASC1_mp "Exceptionstate von CAN-Botschaft (errors, freeze, ...)" UWORD OneToOne 1 100 0.00 65535.00 FORMAT "%8.2" ECU_ADDRESS 0x8FF0A8 /end MEASUREMENT
/begin MEASUREMENT FrmMng_stExc_ASC2_mp "Exceptionstate von CAN-Botschaft (errors, freeze, ...)" UWORD OneToOne 1 100 0.00 65535.00 FORMAT "%8.2" ECU_ADDRESS 0x8FF0AA /end MEASUREMENT
/begin MEASUREMENT FrmMng_stExc_ASC3_mp "Exceptionstate von CAN-Botschaft (errors, freeze, ...)" UWORD OneToOne 1 100 0.00 65535.00 FORMAT "%8.2" ECU_ADDRESS 0x8FF0AC /end MEASUREMENT
/begin MEASUREMENT FrmMng_stExc_ASC4_mp "" UWORD OneToOne 1 100 0.00 65535.00 FORMAT "%8.2" ECU_ADDRESS 0x8FF0AE /end MEASUREMENT
/begin MEASUREMENT FrmMng_stExc_EGS1_mp "Exceptionstate von CAN-Botschaft ( errors, freeze, ... )" UWORD OneToOne 1 100 0.00 65535.00 FORMAT "%8.2" ECU_ADDRESS 0x8FF0B0 /end MEASUREMENT
/begin MEASUREMENT FrmMng_stExc_EGS2_mp "Exceptionstate von CAN-Botschaft (errors, freeze, ...)" UWORD OneToOne 1 100 0.00 65535.00 FORMAT "%8.2" ECU_ADDRESS 0x8FF0B2 /end MEASUREMENT
/begin MEASUREMENT FrmMng_stExc_INSTR2_mp "Exception-State INSTR2" UWORD OneToOne 1 100 0.00 65535.00 FORMAT "%8.2" ECU_ADDRESS 0x8FF0B4 /end MEASUREMENT
/begin MEASUREMENT FrmMng_stExc_INSTR3_mp "Exception-State INSTR3" UWORD OneToOne 1 100 0.00 65535.00 FORMAT "%8.2" ECU_ADDRESS 0x8FF0B6 /end MEASUREMENT
/begin MEASUREMENT FrmMng_stINSTR2Sig_mp "Signalerrorstatus INSTR2" UWORD OneToOne 1 100 0.00 65535.00 FORMAT "%8.2" ECU_ADDRESS 0x8FF0B8 /end MEASUREMENT
/begin MEASUREMENT FrmMng_stINSTR3Sig_mp "Signalerrorstatus INSTR3" UWORD OneToOne 1 100 0.00 65535.00 FORMAT "%8.2" ECU_ADDRESS 0x8FF0BA /end MEASUREMENT
/begin MEASUREMENT FrmMng_stOldstStart "vorheriger Start-Status" UBYTE OneToOne 1 100 0.00 255.0 FORMAT "%5.1" ECU_ADDRESS 0x7F88C3 /end MEASUREMENT
/begin MEASUREMENT FrmMng_stPRGG_CCTRSig "signalerrorstatus-message PRGG_CCTR" UWORD OneToOne 1 100 0.00 65535.00 FORMAT "%8.2" ECU_ADDRESS 0x7F8D36 /end MEASUREMENT
/begin MEASUREMENT FrmMng_stPSP "status der Diagnose der geregelten elektronischen Kraftstoffpumpe" UBYTE OneToOne 1 100 0.00 255.0 FORMAT "%5.1" ECU_ADDRESS 0x7F88C5 /end MEASUREMENT
/begin MEASUREMENT FrmMng_stSTAT_HDC "Zustand CAN-Botschaft S_HDC" UBYTE OneToOne 1 100 0.00 255.0 FORMAT "%5.1" ECU_ADDRESS 0x7F88D0 /end MEASUREMENT
/begin MEASUREMENT FrmMng_stTCSActive_mp "CAN-Signal B_ASC, ASC Eingriff aktiv" UBYTE OneToOne 1 100 0.00 255.0 FORMAT "%5.1" ECU_ADDRESS 0x8FF0BC /end MEASUREMENT
/begin MEASUREMENT FrmMng_stTCSCtrl_mp "ASC Eingriff" UBYTE OneToOne 1 100 0.00 255.0 FORMAT "%5.1" ECU_ADDRESS 0x8FF0BD /end MEASUREMENT
/begin MEASUREMENT FrmMng_stTrqDCSOk_mp "Status Freigabe MSR Eingriff" UBYTE OneToOne 1 100 0.00 255.0 FORMAT "%5.1" ECU_ADDRESS 0x8FF0BE /end MEASUREMENT
/begin MEASUREMENT FrmMng_stTrqTCSOk_mp "Status Freigabe ASC Eingriff" UBYTE OneToOne 1 100 0.00 255.0 FORMAT "%5.1" ECU_ADDRESS 0x8FF0BF /end MEASUREMENT
/begin MEASUREMENT FrmMng_stTSCDec "Status der reduzierenden Getriebeeingriffsanforderung vom Getriebesteuergerät (EGS)" UWORD OneToOne 1 100 0.00 65535.00 FORMAT "%8.2" ECU_ADDRESS 0x7F8D58 /end MEASUREMENT
/begin MEASUREMENT FrmMng_stTSCInc "Status der erhöhenden Getriebeeingriffsanforderung vom Getriebesteuergerät (EGS)" UWORD OneToOne 1 100 0.00 65535.00 FORMAT "%8.2" ECU_ADDRESS 0x7F8D5A /end MEASUREMENT
/begin MEASUREMENT FrmMng_tEnv "Umgebungstemperatur" SWORD Temp_Cels 1 100 -50.140 899.860 FORMAT "%8.3" ECU_ADDRESS 0x7F8D68 /end MEASUREMENT
/begin MEASUREMENT FrmMng_tiDayCouAbsl "day counter" UWORD OneToOne 1 100 0.00 65535.00 FORMAT "%8.2" ECU_ADDRESS 0x7F8D6C /end MEASUREMENT
/begin MEASUREMENT FrmMng_trqDCS "vom MSR gefordertes Getriebeausgangsmoment" SWORD Trq 1 100 -3276.800 3276.700 FORMAT "%8.3" ECU_ADDRESS 0x7F8D7A /end MEASUREMENT
/begin MEASUREMENT FrmMng_trqDCSRaw_mp "MSR Eingriff über CAN, Momentenrohwert" SWORD Trq 1 100 -3276.800 3276.700 FORMAT "%8.3" ECU_ADDRESS 0x8FF0C0 /end MEASUREMENT
/begin MEASUREMENT FrmMng_trqFrc "Reibmoment" SWORD Trq 1 100 -3276.800 3276.700 FORMAT "%8.3" ECU_ADDRESS 0x7F8D84 /end MEASUREMENT
/begin MEASUREMENT FrmMng_trqGbx "Torque set value from Gearbox" SWORD Trq 1 100 -3276.800 3276.700 FORMAT "%8.3" ECU_ADDRESS 0x7F8D86 /end MEASUREMENT
/begin MEASUREMENT FrmMng_trqGearbxDes_mp "Meßpunkt fuer Getriebe-Sollmoment" SWORD Trq 1 100 -3276.800 3276.700 FORMAT "%8.3" ECU_ADDRESS 0x8FF0C2 /end MEASUREMENT
/begin MEASUREMENT FrmMng_trqGearbxRaw_mp "= FrmMng_trqGearbxDec - EngM_trqFrc" SWORD Trq 1 100 -3276.800 3276.700 FORMAT "%8.3" ECU_ADDRESS 0x8FF0C4 /end MEASUREMENT
/begin MEASUREMENT FrmMng_trqTCS "vom ASR gefordertes Getriebeausgangsmoment" SWORD Trq 1 100 -3276.800 3276.700 FORMAT "%8.3" ECU_ADDRESS 0x7F8D94 /end MEASUREMENT
/begin MEASUREMENT FrmMng_trqTCSRaw_mp "ASC Eingriff über CAN, Momentenrohwert" SWORD Trq 1 100 -3276.800 3276.700 FORMAT "%8.3" ECU_ADDRESS 0x8FF0C6 /end MEASUREMENT
/begin MEASUREMENT FrmMng_trqTSCDec "Gefordertes reduzierende Kupplungsmoment vom Getriebesteuergerät (EGS)" SWORD Trq 1 100 -3276.800 3276.700 FORMAT "%8.3" ECU_ADDRESS 0x7F8D96 /end MEASUREMENT
/begin MEASUREMENT FrmMng_trqTSCInc "Gefordertes erhöhende Kupplungsmoment vom Getriebesteuergerät (EGS)" SWORD Trq 1 100 -3276.800 3276.700 FORMAT "%8.3" ECU_ADDRESS 0x7F8D98 /end MEASUREMENT
/begin MEASUREMENT FrmMng_vPrgNo1 "velocity No. 0,3,6,9,12" UWORD vfzg_uw_b512 1 100 0.00 511.9922 FORMAT "%8.4" ECU_ADDRESS 0x7F8DA4 /end MEASUREMENT
/begin MEASUREMENT FrmMng_vPrgNo2 "velocity No. 1,4,7,10,13" UWORD vfzg_uw_b512 1 100 0.00 511.9922 FORMAT "%8.4" ECU_ADDRESS 0x7F8DA6 /end MEASUREMENT
/begin MEASUREMENT FrmMng_vPrgNo3 "velocity No. 2,5,8,11,14" UWORD vfzg_uw_b512 1 100 0.00 511.9922 FORMAT "%8.4" ECU_ADDRESS 0x7F8DA8 /end MEASUREMENT
/begin FUNCTION frmmng "CAN Message Frames für Übertragung und Empfang"
 /begin DEF_CHARACTERISTIC FrmMng_ACCSelfRec_C FrmMng_ACSelfRec_C FrmMng_aDirectDef_C FrmMng_AFSSelfRec_C FrmMng_ARSSelfRec_C FrmMng_aSideDef_C FrmMng_cnvAccmLimTrq_Offset_C FrmMng_cnvAccmLimTrq_Slope_C FrmMng_cnvACCtrq_Offset_C FrmMng_cnvACCtrq_Slope_C FrmMng_cnvAVA_DSC_Offset_C FrmMng_cnvAVA_DSC_Slope_C FrmMng_cnvLN_DSC_Offset_C FrmMng_cnvLN_DSC_Slope_C FrmMng_cnvAFStrq_Offset_C FrmMng_cnvAFStrq_Slope_C FrmMng_cnvAipEng_Offset_C FrmMng_cnvAipEng_Slope_C FrmMng_cnvAngAcpd_Offset_C FrmMng_cnvAngAcpd_Slope_C FrmMng_cnvAPP_Offset_C FrmMng_cnvAPP_Slope_C FrmMng_cnvARStrq_Offset_C FrmMng_cnvARStrq_Slope_C FrmMng_cnvDCCtrq_Offset_C FrmMng_cnvDCCtrq_Slope_C FrmMng_cnvdLRADWINKStrg_Offset_C FrmMng_cnvdLRADWINKStrg_Slope_C FrmMng_cnvDSCtrq_Offset_C FrmMng_cnvDSCtrq_Slope_C FrmMng_cnvIjvFu_Offset_C FrmMng_cnvIjvFu_Slope_C FrmMng_cnvKOMBIv_Offset_C FrmMng_cnvKOMBIv_Slope_C FrmMng_cnvLimRpmEng_Offset_C FrmMng_cnvLimRpmEng_Slope_C FrmMng_cnvLRADWINKStrg_Offset_C FrmMng_cnvLRADWINKStrg_Slope_C FrmMng_cnvnEngRpm_Offset_C FrmMng_cnvnEngRpm_Slope_C FrmMng_cnvnSetpoint_Offset_C FrmMng_cnvnSetpoint_Slope_C FrmMng_cnvpBrkSys_Offset_C FrmMng_cnvpBrkSys_Slope_C FrmMng_cnvrHtFlow_Offset_C FrmMng_cnvrHtFlow_Slope_C FrmMng_cnvRpmEng_Offset_C FrmMng_cnvRpmEng_Slope_C FrmMng_cnvRPM_GRB_TURB_Offset_C FrmMng_cnvRPM_GRB_TURB_Slope_C FrmMng_cnvRqamFu_Offset_C FrmMng_cnvRqamFu_Slope_C FrmMng_cnvrTransDT_Offset_C FrmMng_cnvrTransDT_Slope_C FrmMng_cnvrWaterVlv_Offset_C FrmMng_cnvrWaterVlv_Slope_C FrmMng_cnvTempEng_Offset_C FrmMng_cnvTempEng_Slope_C FrmMng_cnvtOil_Offset_C FrmMng_cnvtOil_Slope_C FrmMng_cnvTrqAvl_Offset_C FrmMng_cnvTrqAvl_Slope_C FrmMng_cnvTrqDvch_Offset_C FrmMng_cnvTrqDvch_Slope_C FrmMng_cnvtrqWheel_Offset_C FrmMng_cnvtrqWheel_Slope_C FrmMng_cnvtrq_Offset_C FrmMng_cnvtrq_Slope_C FrmMng_cnvvMrk_Offset_C FrmMng_cnvvMrk_Slope_C FrmMng_cnvV_VEH_Offset_C FrmMng_cnvV_VEH_Slope_C FrmMng_cnv_BattCls_Offset_C FrmMng_cnv_BattCls_Slope_C FrmMng_cnv_HiLimCurr_Offset_C FrmMng_cnv_HiLimCurr_Slope_C FrmMng_cnv_LoLimCurr_Offset_C FrmMng_cnv_LoLimCurr_Slope_C FrmMng_cnv_ZrCurrLim_Offset_C FrmMng_cnv_ZrCurrLim_Slope_C FrmMng_ctDebAlvDMANFAFSDef_C FrmMng_ctDebAlvDMANFAFSOk_C FrmMng_ctDebAlvDRMANFSSGDef_C FrmMng_ctDebAlvDRMANFSSGOk_C FrmMng_ctDebCsDMANFAFSDef_C FrmMng_ctDebCsDMANFAFSOk_C FrmMng_ctDebCsDRMANFSSGDef_C FrmMng_ctDebCsDRMANFSSGOk_C FrmMng_ctDebSigDMANFAFSDef_C FrmMng_ctDebSigDMANFAFSOk_C FrmMng_ctDebSigDRMANFSSGDef_C FrmMng_ctDebSigDRMANFSSGOk_C FrmMng_ctDebSigLRADWINKDef_C FrmMng_ctDebSigLRADWINKOk_C FrmMng_ctDebSigstCurrDef_C FrmMng_ctDebSigstCurrOk_C FrmMng_ctDebSigswtPSPOffDef_C FrmMng_ctDebSigswtPSPOffOk_C FrmMng_ctDebToDMANFAFSDef_C FrmMng_ctDebToDMANFAFSOk_C FrmMng_ctDebToDRMANFSSGDef_C FrmMng_ctDebToDRMANFSSGOk_C FrmMng_ctDebToLRADWINKDef_C FrmMng_ctDebToLRADWINKOk_C FrmMng_ctDebTostCurrDef_C FrmMng_ctDebTostCurrOk_C FrmMng_ctDebToswtPSPOffDef_C FrmMng_ctDebToswtPSPOffOk_C FrmMng_ctrRelDef_C FrmMng_cnvCTR_GEN_U_TAR_Offset_C FrmMng_cnvCTR_GEN_U_TAR_Slope_C FrmMng_DebACTrqDef_C FrmMng_DebACTrqOk_C FrmMng_DebAlvANFRADMOMPTDef_C FrmMng_DebAlvANFRADMOMPTOk_C FrmMng_DebAlvDMOMENT_ACCDef_C FrmMng_DebAlvDMOMENT_ACCOk_C FrmMng_DebAlvOPCRCTLACCDef_C FrmMng_DebAlvOPCRCTLACCOk_C FrmMng_DebAlvSTAT_ARSDef_C FrmMng_DebAlvSTAT_ARSOk_C FrmMng_DebAlvSTAT_KOMBIDef_C FrmMng_DebAlvSTAT_KOMBIOk_C FrmMng_DebAlvTERMINALDef_C FrmMng_DebAlvTERMINALOk_C FrmMng_DebAlvTORQUE_DSCDef_C FrmMng_DebAlvTORQUE_DSCOk_C FrmMng_DebAlvTORQUE_GEARBXDef_C FrmMng_DebAlvTORQUE_GEARBXOk_C FrmMng_DebAlvVEH_MODDef_C FrmMng_DebAlvVEH_MODOk_C FrmMng_DebCsANFRADMOMPTDef_C FrmMng_DebCsANFRADMOMPTOk_C FrmMng_DebCsDMOMENT_ACCDef_C FrmMng_DebCsDMOMENT_ACCOk_C FrmMng_DebCsOPCRCTLACCDef_C FrmMng_DebCsOPCRCTLACCOk_C FrmMng_DebCsTERMINALDef_C FrmMng_DebCsTERMINALOk_C FrmMng_DebCsTORQUE_DSCDef_C FrmMng_DebCsTORQUE_DSCOk_C FrmMng_DebCsTORQUE_GEARBXDef_C FrmMng_DebCsTORQUE_GEARBXOk_C FrmMng_DebCsVEH_MODDef_C FrmMng_DebCsVEH_MODOk_C FrmMng_DebSigANFRADMOMPTDef_C FrmMng_DebSigANFRADMOMPTOk_C FrmMng_DebSigBOS_RESET_2Def_C FrmMng_DebSigBOS_RESET_2Ok_C FrmMng_DebSigBOS_RESETDef_C FrmMng_DebSigBOS_RESETOk_C FrmMng_DebSigDMOMENT_ACCDef_C FrmMng_DebSigDMOMENT_ACCOk_C FrmMng_DebSigGEARBX_DATA2Def_C FrmMng_DebSigGEARBX_DATA2Ok_C FrmMng_DebSigGEARBX_DATADef_C FrmMng_DebSigGEARBX_DATAOk_C FrmMng_DebSigHEAT_ACDef_C FrmMng_DebSigHEAT_ACOk_C FrmMng_DebSigMILEAGE_RANGEDef_C FrmMng_DebSigMILEAGE_RANGEOk_C FrmMng_DebSigOPCRCTLACCDef_C FrmMng_DebSigOPCRCTLACCOk_C FrmMng_DebSigParkConsumerDef_C FrmMng_DebSigParkConsumerOk_C FrmMng_DebSigPRGG_CCTRDef_C FrmMng_DebSigPRGG_CCTROk_C FrmMng_DebSigPWRMNG_LOADVDef_C FrmMng_DebSigPWRMNG_LOADVOk_C FrmMng_DebSigRQ_STG_EFANDef_C FrmMng_DebSigRQ_STG_EFANOk_C FrmMng_ctDebSigSITZGURTDef_C FrmMng_ctDebSigSITZGURTOk_C FrmMng_DebSigSTAT_ANHDef_C FrmMng_DebSigSTAT_ANHOk_C FrmMng_DebSigSTAT_ARSDef_C FrmMng_DebSigSTAT_ARSOk_C FrmMng_DebSigSTAT_DSCDef_C FrmMng_DebSigSTAT_DSCOk_C FrmMng_DebSigSTAT_EKPDef_C FrmMng_DebSigSTAT_EKPOk_C FrmMng_DebSigSTAT_KOMBIDef_C FrmMng_DebSigSTAT_KOMBIOk_C FrmMng_ctDebOBDGbxMilOfDef_C FrmMng_ctDebSigStOBDGbxMilOfOk_C FrmMng_ctDebOBDGbxMilOnDef_C FrmMng_ctDebSigStOBDGbxMilOnOk_C FrmMng_DebSigTEMPRELTIMEDef_C FrmMng_DebSigTEMPRELTIMEOk_C FrmMng_DebSigTERMINALDef_C FrmMng_DebSigTERMINALOk_C FrmMng_DebSigTIME_DATEDef_C FrmMng_DebSigTIME_DATEOk_C FrmMng_DebSigTORQUE_DSCDef_C FrmMng_DebSigTORQUE_DSCOk_C FrmMng_DebSigTORQUE_GEARBXDef_C FrmMng_DebSigTORQUE_GEARBXOk_C FrmMng_DebSigVEH_MODDef_C FrmMng_DebSigVEH_MODOk_C FrmMng_DebSigVELOCITYDef_C FrmMng_DebSigVELOCITYOk_C FrmMng_ctDebSigWHEEL_SPEEDDef_C FrmMng_ctDebSigWHEEL_SPEEDOk_C FrmMng_DebTGearbxDef_C FrmMng_DebTGearbxOk_C FrmMng_DebToANFRADMOMPTDef_C FrmMng_DebToANFRADMOMPTOk_C FrmMng_DebToBOS_RESET_2Def_C FrmMng_DebToBOS_RESET_2Ok_C FrmMng_DebToBOS_RESETDef_C FrmMng_DebToBOS_RESETOk_C FrmMng_DebToDMOMENT_ACCDef_C FrmMng_DebToDMOMENT_ACCOk_C FrmMng_DebToGEARBX_DATA2Def_C FrmMng_DebToGEARBX_DATA2Ok_C FrmMng_DebToGEARBX_DATADef_C FrmMng_DebToGEARBX_DATAOk_C FrmMng_DebToHEAT_ACDef_C FrmMng_DebToHEAT_ACOk_C FrmMng_DebToMILEAGE_RANGEDef_C FrmMng_DebToMILEAGE_RANGEOk_C FrmMng_DebToOPCRCTLACCDef_C FrmMng_DebToOPCRCTLACCOk_C FrmMng_DebToParkConsumerDef_C FrmMng_DebToParkConsumerOk_C FrmMng_DebToPRGG_CCTRDef_C FrmMng_DebToPRGG_CCTROk_C FrmMng_DebToPWRMNG_LOADVDef_C FrmMng_DebToPWRMNG_LOADVOk_C FrmMng_DebToRQ_STG_EFANDef_C FrmMng_DebToRQ_STG_EFANOk_C FrmMng_ctDebToSITZGURTDef_C FrmMng_ctDebToSITZGURTOk_C FrmMng_DebToSTAT_ANHDef_C FrmMng_DebToSTAT_ANHOk_C FrmMng_DebToSTAT_ARSDef_C FrmMng_DebToSTAT_ARSOk_C FrmMng_DebToSTAT_DSCDef_C FrmMng_DebToSTAT_DSCOk_C FrmMng_DebToSTAT_EKPDef_C FrmMng_DebToSTAT_EKPOk_C FrmMng_DebToSTAT_KOMBIDef_C FrmMng_DebToSTAT_KOMBIOk_C FrmMng_DebToTEMPRELTIMEDef_C FrmMng_DebToTEMPRELTIMEOk_C FrmMng_DebToTERMINALDef_C FrmMng_DebToTERMINALOk_C FrmMng_DebToTIME_DATEDef_C FrmMng_DebToTIME_DATEOk_C FrmMng_DebToTORQUE_DSCDef_C FrmMng_DebToTORQUE_DSCOk_C FrmMng_DebToTORQUE_GEARBXDef_C FrmMng_DebToTORQUE_GEARBXOk_C FrmMng_DebToVEH_MODDef_C FrmMng_DebToVEH_MODOk_C FrmMng_DebToVELOCITYDef_C FrmMng_DebToVELOCITYOk_C FrmMng_ctDebToWHEEL_SPEEDDef_C FrmMng_ctDebToWHEEL_SPEEDOk_C FrmMng_drAPP1Min_C FrmMng_dstGear_C FrmMng_dTrqWheelRmpUp_C FrmMng_dTrqWheelRmpDwn_C FrmMng_factrqInrStrt_C FrmMng_FDCSelfRec_C FrmMng_FGRSelfRec_C FrmMng_cnvFLLV_FUTA_Offset_C FrmMng_cnvFLLV_FUTA_Slope_C FrmMng_mskDM_ANF_ACC_0x800_C FrmMng_mskDM_ANF_AFS_C FrmMng_mskDM_ANF_SSG_C FrmMng_mskSTAT_ARS_C FrmMng_mskTORQUE_DSC_C FrmMng_mskTORQUE_GEARBX_C FrmMng_nEngOFF_C FrmMng_nEngRpm1_CUR FrmMng_nEngRpm2_CUR FrmMng_nFanDflt_C FrmMng_nFan_CUR FrmMng_nHtgUpActMax_C FrmMng_nHtgUpCrCtlMax_C FrmMng_nLIGovOffs_C FrmMng_nLimSSGErr_C FrmMng_cnvnPSPSpd_Offset_C FrmMng_cnvnPSPSpd_Slope_C FrmMng_nRqStgEFan_CUR FrmMng_numACFanDesDef_C FrmMng_numCCAddLevlFlsh_C FrmMng_numCCAddLevlNum_C FrmMng_numCCBrkDefFlsh_C FrmMng_numCCBrkDefNum_C FrmMng_numCCbtnachFlsh_C FrmMng_numCCbtnachNum_C FrmMng_numCCbttdfkFlsh_C FrmMng_numCCbttdfkNum_C FrmMng_numCCbttkntFlsh_C FrmMng_numCCbttkntNum_C FrmMng_numCCGenDef2Flsh_C FrmMng_numCCGenDef2Num_C FrmMng_numCCNoCrCtlFlsh_C FrmMng_numCCNoCrCtlNum_C FrmMng_numCCOelLevlFlsh_C FrmMng_numCCOelLevlNum_C FrmMng_numCCOelVerbFlsh_C FrmMng_numCCOelVerbNum_C FrmMng_numCCOelVerlFlsh_C FrmMng_numCCOelVerlNum_C FrmMng_numCCOilPresFlsh_C FrmMng_numCCOilPresNum_C FrmMng_numCCOvrTem2Flsh_C FrmMng_numCCOvrTem2Num_C FrmMng_numCCOvrTempFlsh_C FrmMng_numCCOvrTempNum_C FrmMng_numCCPFltDefFlsh_C FrmMng_numCCPFltDefNum_C FrmMng_numCCpmerrFlsh_C FrmMng_numCCpmerrNum_C FrmMng_numCCPreGlowFlsh_C FrmMng_numCCPreGlowNum_C FrmMng_numCCprioFlsh_C FrmMng_numCCprioNum_C FrmMng_numCCruhverFlsh_C FrmMng_numCCruhverNum_C FrmMng_numCCStatMilFlsh_C FrmMng_numCCStatMilLmpTstFlsh_C FrmMng_numCCStatMilLmpTstNum_C FrmMng_numCCStatMilNum_C FrmMng_numCCSysLampFlsh_C FrmMng_numCCSysLampNum_C FrmMng_numInqyID_C FrmMng_numRecACCMax_C FrmMng_numRecACMax_C FrmMng_numRecAFSMax_C FrmMng_numRecARSMax_C FrmMng_numRecDCCMax_C FrmMng_numRecFDCMax_C FrmMng_numRecFGRMax_C FrmMng_dtrqOvrRunRmpUp_C FrmMng_dtrqOvrRunRmpDwn_C FrmMng_qOvrRun_C FrmMng_cnvrPSPSetPoint_Offset_C FrmMng_cnvrPSPSetPoint_Slope_C FrmMng_rWaterVlvClose_C FrmMng_rWaterVlvCtl_C FrmMng_rWaterVlvOpen_C FrmMng_stBltbDrDef_C FrmMng_stClCtrDEF_C FrmMng_stConvErr_C FrmMng_stFDC_C FrmMng_stGbxErr_C Frmmng_stGearbxHtgUpActMsk_C Frmmng_stGearHtgUpAct_C FrmMng_stKeyVldDef_C FrmMng_stRgnHtgUp_C FrmMng_stT15Def_C FrmMng_stT50Def_C FrmMng_Sttorqavl_Errval_C FrmMng_stTRadioDef_C FrmMng_stWghSeatDrDef_C FrmMng_swtANFRADMOMPT_C FrmMng_swtANFRAGE_C FrmMng_swtASDdc_C FrmMng_swtBOS_Oil_2_C FrmMng_swtBOS_Oil_C FrmMng_swtBOS_PFlt_C FrmMng_swtBOS_RESET_2_C FrmMng_swtBOS_RESET_C FrmMng_swtCalcV_C FrmMng_swtCarType_C FrmMng_swtCCMsg_C FrmMng_swtCCNoCrCtl_C FrmMng_swtCorTrqACC_C FrmMng_swtCorTrqDSC_C FrmMng_swtDCCSelfRec_C FrmMng_swtDMOMENT_ACC_C FrmMng_swtDM_ANF_AFS_C FrmMng_swtDRMANFSSG_C FrmMng_swtENGINE1_C FrmMng_swtENGINE_RPM_C FrmMng_swtEngRpmTempSel_C FrmMng_swtFDC_C FrmMng_swtGEARBX_DATA2_C FrmMng_swtGEARBX_DATA_C FrmMng_swtHEATINGCURRENT_C FrmMng_swtHEAT_AC_C FrmMng_swtLENKRADWINKEL_C FrmMng_swtMILEAGE_RANGE_C FrmMng_swtOEL_MESS_C FrmMng_swtOPCRCTLACC_C FrmMng_swtParkConsumer_C FrmMng_swtPlausOn_C FrmMng_swtPOWERMGMTBATTSP_C FrmMng_swtPRGG_CCTR_C FrmMng_swtPSPOffErr_C FrmMng_swtPSPOff_C FrmMng_swtPWRMNG_CTR_COS_C FrmMng_swtPWRMNG_LOADV_C FrmMng_swtRADMOM_PT1_C FrmMng_swtRADMOM_PT2_C FrmMng_swtRPM_STA_C FrmMng_swtRQ_STG_EFAN_C FrmMng_swtSITZGURT_C FrmMng_swtSPEED_CLCTR_C FrmMng_swtSTAT_ANH_C FrmMng_swtSTAT_ARS_C FrmMng_swtSTAT_DSC_C FrmMng_swtSTAT_EKP_C FrmMng_swtSTAT_KOMBI_C FrmMng_swtstCurr_C FrmMng_swtTEMPRELTIME_C FrmMng_swtTERMINAL_C FrmMng_swtTIME_DATE_C FrmMng_swtTORQUE1_C FrmMng_swtTORQUE2_C FrmMng_swtTORQUE3_C FrmMng_swtTORQUE_DSC_C FrmMng_swtTORQUE_GEARBX_C FrmMng_swtVEH_MOD_C FrmMng_swtVELOCITY_C FrmMng_swtWHEEL_SPEED_C FrmMng_cnvTEMP_EX_Offset_C FrmMng_cnvTEMP_EX_Slope_C FrmMng_tEngLimHi_C FrmMng_tEngLimLo_C FrmMng_tEnvDef_C FrmMng_tiCCAddLevlCycle_C FrmMng_tiCCBrkDefCycle_C FrmMng_tiCCbtnachCycle_C FrmMng_tiCCbttdfkCycle_C FrmMng_tiCCbttkntCycle_C FrmMng_tiCCGenDef2Cycle_C FrmMng_tiCCNoCrCtlCycle_C FrmMng_tiCCOelLevlCycle_C FrmMng_tiCCOelVerbCycle_C FrmMng_tiCCOelVerlCycle_C FrmMng_tiCCOilPresCycle_C FrmMng_tiCCOvrTem2Cycle_C FrmMng_tiCCOvrTempCycle_C FrmMng_tiCCPFltDefCycle_C FrmMng_tiCCpmerrCycle_C FrmMng_tiCCPreGlowCycle_C FrmMng_tiCCprioCycle_C FrmMng_tiCCruhverCycle_C FrmMng_tiCCStatMilCycle_C FrmMng_tiCCStatMilLmpTstCycle_C FrmMng_tiCCSysLampCycle_C FrmMng_tiCCTxDeb_C FrmMng_tiDebARS_C FrmMng_tiDebDSC_C FrmMng_tiDebEGS_C FrmMng_tiDebHtgUpShutOff_C FrmMng_tiDebHtgUpShutOn_C FrmMng_tiDebSSGDebCltTO_C FrmMng_tiDebSSGErrDef_C FrmMng_tiDebSSGErrOk_C FrmMng_tiDebSSGShftPla_C FrmMng_tiDebSSGShOffDef_C FrmMng_tiDebSSGShOffOk_C FrmMng_tiDebSSGTrqIncPla_C FrmMng_tiRecACCMax_C FrmMng_tiRecACMax_C FrmMng_tiRecAFSMax_C FrmMng_tiRecARSMax_C FrmMng_tiRecDCCMax_C FrmMng_tiRecFDCMax_C FrmMng_tiRecFGRMax_C FrmMng_tiStartDelay_C FrmMng_trqARSCurDef_C FrmMng_trqARSDesDef_C FrmMng_trqGearbxFrc_C FrmMng_trqGearbxMaxSubs_C FrmMng_trqLiGovMin_C FrmMng_trqSSGPlaThres_C FrmMng_tWaterVlv_C FrmMng_ubtMin_C FrmMng_vHtgUpActMax_C FrmMng_cnvvPrgNo_Offset_C FrmMng_cnvvPrgNo_Slope_C FrmMng_vSSGPlaThres_C /end DEF_CHARACTERISTIC
 /begin IN_MEASUREMENT FrmMng_numACFanDes FrmMng_numRqStgEFan FrmMng_tEngRpm_mp /end IN_MEASUREMENT
/end FUNCTION
/begin FUNCTION frmmng_11hex ""
 /begin DEF_CHARACTERISTIC FrmMng_ctASCDef_C FrmMng_ctMulDDE2_C FrmMng_dCanState_C FrmMng_ctDebSigASC1Def_C FrmMng_ctDebSigASC1Ok_C FrmMng_ctDebSigASC2Def_C FrmMng_ctDebSigASC2Ok_C FrmMng_ctDebSigASC3Def_C FrmMng_ctDebSigASC3Ok_C FrmMng_ctDebSigASC4Def_C FrmMng_ctDebSigASC4Ok_C FrmMng_ctDebSigEGS1Def_C FrmMng_ctDebSigEGS1Ok_C FrmMng_ctDebSigEGS2Def_C FrmMng_ctDebSigEGS2Ok_C FrmMng_ctDebSigINSTR2Def_C FrmMng_ctDebSigINSTR2Ok_C FrmMng_ctDebSigINSTR3Def_C FrmMng_ctDebSigINSTR3Ok_C FrmMng_ctDebToASC1Def_C FrmMng_ctDebToASC1Ok_C FrmMng_ctDebToASC2Def_C FrmMng_ctDebToASC2Ok_C FrmMng_ctDebToASC3Def_C FrmMng_ctDebToASC3Ok_C FrmMng_ctDebToASC4Def_C FrmMng_ctDebToASC4Ok_C FrmMng_ctDebToEGS1Def_C FrmMng_ctDebToEGS1Ok_C FrmMng_ctDebToEGS2Def_C FrmMng_ctDebToEGS2Ok_C FrmMng_ctDebToINSTR2Def_C FrmMng_ctDebToINSTR2Ok_C FrmMng_ctDebToINSTR3Def_C FrmMng_ctDebToINSTR3Ok_C FrmMng_dEngGearbox_C FrmMng_dOBDCtrl_C FrmMng_dstGearbx_C FrmMng_fst_Offset_C FrmMng_fst_Slope_C FrmMng_kmst_Offset_C FrmMng_kmst_Slope_C FrmMng_nAvrg_Def_C FrmMng_nAvrg_Slope_C FrmMng_nDiv_Fac_C FrmMng_nFanErr_C FrmMng_nFan_C FrmMng_nLISetPoint_Offset_C FrmMng_nLISetPoint_Slope_C FrmMng_nML_C FrmMng_nTSCErr_C FrmMng_nTSC_Offset_C FrmMng_nTSC_Slope_C FrmMng_pVal_Offset_C FrmMng_pVal_Slope_C FrmMng_rFlt_Offset_C FrmMng_rFlt_Slope_C FrmMng_stGearErr_C FrmMng_swtASC1_C FrmMng_swtASC2_C FrmMng_swtASC3_C FrmMng_swtASC4_C FrmMng_swtCANA_C FrmMng_swtDDE1_C FrmMng_swtDDE2_C FrmMng_swtDDE4_C FrmMng_swtDSCBrkAct_C FrmMng_swtEGS1_C FrmMng_swtEGS2_C FrmMng_swtEKP_C FrmMng_swtINSTR2_C FrmMng_swtINSTR3_C FrmMng_tEng_Offset_C FrmMng_tEng_Slope_C FrmMng_tEnvErr_C FrmMng_tiDSCDelay1_C FrmMng_tiDSCDelay2_C FrmMng_tiDSCDelay3_C FrmMng_trqACErr_C FrmMng_trqLim_CUR FrmMng_trqNorm_C FrmMng_trq_Offset_C FrmMng_trq_Slope_C /end DEF_CHARACTERISTIC
 /begin IN_MEASUREMENT Eng_nAvrg /end IN_MEASUREMENT
/end FUNCTION
/begin FUNCTION frmmng_11hex_rx100ms_msg ""
 /begin OUT_MEASUREMENT FrmMng_stAC FrmMng_stSTAT_HDC FrmMng_stTSCDec FrmMng_stTSCInc FrmMng_trqTSCDec FrmMng_trqTSCInc /end OUT_MEASUREMENT
/end FUNCTION
/begin FUNCTION frmmng_11hex_uic ""
 /begin OUT_MEASUREMENT FrmMng_dOBDCtl_mp FrmMng_numASC1byte0_mp FrmMng_numASC1byte1_mp FrmMng_numASC1byte2_mp FrmMng_numASC1byte3_mp FrmMng_numASC1byte4_mp FrmMng_numASC1byte5_mp FrmMng_numASC1byte6_mp FrmMng_numASC1byte7_mp FrmMng_numASC2byte0_mp FrmMng_numASC2byte1_mp FrmMng_numASC2byte2_mp FrmMng_numASC2byte3_mp FrmMng_numASC2byte4_mp FrmMng_numASC2byte5_mp FrmMng_numASC2byte6_mp FrmMng_numASC2byte7_mp FrmMng_numASC3byte0_mp FrmMng_numASC3byte1_mp FrmMng_numASC3byte2_mp FrmMng_numASC3byte3_mp FrmMng_numASC3byte4_mp FrmMng_numASC3byte5_mp FrmMng_numASC3byte6_mp FrmMng_numASC3byte7_mp FrmMng_numASC4byte0_mp FrmMng_numASC4byte1_mp FrmMng_numASC4byte2_mp FrmMng_numASC4byte3_mp FrmMng_numASC4byte4_mp FrmMng_numASC4byte5_mp FrmMng_numASC4byte6_mp FrmMng_numASC4byte7_mp FrmMng_numDDE1byte0_mp FrmMng_numDDE1byte1_mp FrmMng_numDDE1byte2_mp FrmMng_numDDE1byte3_mp FrmMng_numDDE1byte4_mp FrmMng_numDDE1byte5_mp FrmMng_numDDE1byte6_mp FrmMng_numDDE1byte7_mp FrmMng_numDDE2byte0_mp FrmMng_numDDE2byte1_mp FrmMng_numDDE2byte2_mp FrmMng_numDDE2byte3_mp FrmMng_numDDE2byte4_mp FrmMng_numDDE2byte5_mp FrmMng_numDDE2byte6_mp FrmMng_numDDE2byte7_mp FrmMng_numDDE4byte0_mp FrmMng_numDDE4byte1_mp FrmMng_numDDE4byte2_mp FrmMng_numDDE4byte3_mp FrmMng_numDDE4byte4_mp FrmMng_numDDE4byte5_mp FrmMng_numDDE4byte6_mp FrmMng_numDDE4byte7_mp FrmMng_numEGS1byte0_mp FrmMng_numEGS1byte1_mp FrmMng_numEGS1byte2_mp FrmMng_numEGS1byte3_mp FrmMng_numEGS1byte4_mp FrmMng_numEGS1byte5_mp FrmMng_numEGS1byte6_mp FrmMng_numEGS1byte7_mp FrmMng_numEGS2byte0_mp FrmMng_numEGS2byte1_mp FrmMng_numEGS2byte2_mp FrmMng_numEGS2byte3_mp FrmMng_numEGS2byte4_mp FrmMng_numEGS2byte5_mp FrmMng_numEGS2byte6_mp FrmMng_numEGS2byte7_mp FrmMng_numEKPbyte0_mp FrmMng_numEKPbyte1_mp FrmMng_numEKPbyte2_mp FrmMng_numEKPbyte3_mp FrmMng_numINSTR2byte0_mp FrmMng_numINSTR2byte1_mp FrmMng_numINSTR2byte2_mp FrmMng_numINSTR2byte3_mp FrmMng_numINSTR2byte4_mp FrmMng_numINSTR2byte5_mp FrmMng_numINSTR2byte6_mp FrmMng_numINSTR2byte7_mp FrmMng_numINSTR3byte0_mp FrmMng_numINSTR3byte1_mp FrmMng_numINSTR3byte2_mp FrmMng_numINSTR3byte3_mp FrmMng_numINSTR3byte4_mp FrmMng_numINSTR3byte5_mp FrmMng_numINSTR3byte6_mp FrmMng_numINSTR3byte7_mp FrmMng_rTrqDCS_mp FrmMng_rTrqGearbxFrc_mp FrmMng_rTrqGearbx_mp FrmMng_rTrqTCS_mp FrmMng_stASC1Sig_mp FrmMng_stASC2Sig_mp FrmMng_stASC3Sig_mp FrmMng_stASC4Sig_mp FrmMng_stBrkTCS_mp FrmMng_stCrCCDKey_mp FrmMng_stCrCtlOff_mp FrmMng_stDCSActive_mp FrmMng_stDSCCtrl_mp FrmMng_stDSCDelay_mp FrmMng_stEGS1Sig_mp FrmMng_stEGS2Sig_mp FrmMng_stEngRun_mp FrmMng_stExc_ASC1_mp FrmMng_stExc_ASC2_mp FrmMng_stExc_ASC3_mp FrmMng_stExc_ASC4_mp FrmMng_stExc_EGS1_mp FrmMng_stExc_EGS2_mp FrmMng_stExc_INSTR2_mp FrmMng_stExc_INSTR3_mp FrmMng_stINSTR2Sig_mp FrmMng_stINSTR3Sig_mp FrmMng_stTCSActive_mp FrmMng_stTCSCtrl_mp FrmMng_stTrqDCSOk_mp FrmMng_stTrqTCSOk_mp FrmMng_trqDCSRaw_mp FrmMng_trqGearbxDes_mp FrmMng_trqGearbxRaw_mp FrmMng_trqTCSRaw_mp /end OUT_MEASUREMENT
/end FUNCTION
/begin FUNCTION frmmng_11hex_var_msg "" /begin OUT_MEASUREMENT FrmMng_stASCok FrmMng_stOldstStart FrmMng_trqFrc /end OUT_MEASUREMENT /end FUNCTION
/begin FUNCTION frmmng_conv "" /end FUNCTION
/begin FUNCTION frmmng_rx100ms_msg ""
 /begin OUT_MEASUREMENT FrmMng_ctrIdxNo FrmMng_nPSP FrmMng_pAir FrmMng_rPSPSetPoint FrmMng_stPRGG_CCTRSig FrmMng_stPSP FrmMng_tEnv FrmMng_tiDayCouAbsl FrmMng_trqDCS FrmMng_trqGbx FrmMng_trqTCS FrmMng_vPrgNo1 FrmMng_vPrgNo2 FrmMng_vPrgNo3 /end OUT_MEASUREMENT
/end FUNCTION
/begin COMPU_METHOD Acc "Fahrzeugbeschleunigung" RAT_FUNC "%6.5" "m/s^2" COEFFS 0 1000 0 0 0 1 /end COMPU_METHOD
/begin COMPU_METHOD AngleGrad "Winkelanzeige in Grad" RAT_FUNC "%6.4" "Grad" COEFFS 0 22.7531285551763 0 0 0 1 /end COMPU_METHOD
/begin COMPU_METHOD AngleGradPerSec "Winkelanzeige in Grad pro Sekunde" RAT_FUNC "%6.4" "Grad/s" COEFFS 0 22.7531285551763 0 0 0 1 /end COMPU_METHOD
/begin COMPU_METHOD CarType "" TAB_VERB "%6.3" "-" COMPU_TAB_REF CarType /end COMPU_METHOD
/begin COMPU_VTAB CarType "" TAB_VERB 5 0 "E60" 1 "E65" 2 "E90" 3 "E83" 4 "E87" /end COMPU_VTAB
/begin COMPU_METHOD DEZ "K3 Umwandlungen" RAT_FUNC "%6.2" "-" COEFFS 0 1 0 0 0 1 /end COMPU_METHOD
/begin COMPU_METHOD EngN "Motordrehzahl" RAT_FUNC "%6.2" "rpm" COEFFS 0 1 0 0 0 1 /end COMPU_METHOD
/begin COMPU_METHOD Fact "Faktor mit Auflösung 1 / 8192, hauptsächlich für einen Faktorenbereich 0...1 verwendet" RAT_FUNC "%6.5" "-" COEFFS 0 8192 0 0 0 1 /end COMPU_METHOD
/begin COMPU_METHOD FanSpd "(MAXSINT16 / FANSPD_MAX) * phys" RAT_FUNC "%6.3" "1/min" COEFFS 0 10.9223333333333 0 0 0 1 /end COMPU_METHOD
/begin COMPU_METHOD FlConsum_l_h "Kraftstoffverbrauch" RAT_FUNC "%6.4" "l/h" COEFFS 0 100 0 0 0 1 /end COMPU_METHOD
/begin COMPU_METHOD FlConsum_ul "Verbrauchsintegral (in Mikroliter)" RAT_FUNC "%6.2" "ul" COEFFS 0 1 0 0 0 1 /end COMPU_METHOD
/begin COMPU_METHOD InjMass "Einspritzmenge" RAT_FUNC "%6.4" "mg/hub" COEFFS 0 100 0 0 0 1 /end COMPU_METHOD
/begin COMPU_METHOD i_ub_q0p001 "K3 Umwandlungen" RAT_FUNC "%5.4" "A" COEFFS 0 1 0 0 0 0.001 /end COMPU_METHOD
/begin COMPU_METHOD i_ub_q10p0 "K3 Umwandlungen" RAT_FUNC "%5.1" "A" COEFFS 0 1 0 0 0 10 /end COMPU_METHOD
/begin COMPU_METHOD OneToOne "eins zu eins (physikalischer Wert ist gleich dem internen Wert)" RAT_FUNC "%6.2" "-" COEFFS 0 1 0 0 0 1 /end COMPU_METHOD
/begin COMPU_METHOD Prc "Prozent, gleiche interne Auflösung wie Fact, aber Darstellung in Prozent (0...100%)" RAT_FUNC "%6.4" "%" COEFFS 0 81.92 0 0 0 1 /end COMPU_METHOD
/begin COMPU_METHOD PrcPerSec "Prozentänderung pro Sekunde für 20ms-Tasks" RAT_FUNC "%6.3" "%/s" COEFFS 0 1.6384 0 0 0 1 /end COMPU_METHOD
/begin COMPU_METHOD Pres_bar "Druck (angezeigt in bar)" RAT_FUNC "%6.2" "bar" COEFFS 0 1 0 0 0 1 /end COMPU_METHOD
/begin COMPU_METHOD Pres_hPa "Druck (angezeigt in [hPa])" RAT_FUNC "%6.2" "hPa" COEFFS 0 1 0 0 0 1 /end COMPU_METHOD
/begin COMPU_METHOD PSP_Spd "PSP speed in rpm" RAT_FUNC "%6.2" "rpm" COEFFS 0 1 0 0 0 1 /end COMPU_METHOD
/begin COMPU_METHOD RmpTrq "Rampengradient für Motormoment" RAT_FUNC "%6.4" "Nm/s" COEFFS 0 655.36 0 0 0 1 /end COMPU_METHOD
/begin COMPU_METHOD RmpTrqPrp "Rampenanstieg für Vortriebsmoment [Nm/s]" RAT_FUNC "%6.4" "Nm/s" COEFFS 0 327.68 0 0 0 1 /end COMPU_METHOD
/begin COMPU_METHOD SlopeRes10 "Umrechnung für Slope: Slopewert mit Verhältnis 0,1" RAT_FUNC "%6.3" "-" COEFFS 0 10 0 0 0 1 /end COMPU_METHOD
/begin COMPU_METHOD SlopeRes100 "Umrechnung für Slope: Slopewert mit Verhältnis 0,01" RAT_FUNC "%6.4" "-" COEFFS 0 100 0 0 0 1 /end COMPU_METHOD
/begin COMPU_METHOD SlopeRes1000 "Umrechnung für Slope: Slopewert mit Verhältnis 0,001" RAT_FUNC "%6.5" "-" COEFFS 0 1000 0 0 0 1 /end COMPU_METHOD
/begin COMPU_METHOD spg_uw_q0p015 "K3 Umwandlungen" RAT_FUNC "%9.5" "V" COEFFS 0 1 0 0 0 0.015 /end COMPU_METHOD
/begin COMPU_METHOD Temp_Cels "Temperatur dargestellt in °C (gleiche interne Darstellung wie Temp_Kelv)" RAT_FUNC "%6.1" "deg C" COEFFS 0 10 2731.4 0 0 1 /end COMPU_METHOD
/begin COMPU_METHOD Time_fulls "for application labels only in full seconds" RAT_FUNC "%6.2" "s" COEFFS 0 1 0 0 0 1 /end COMPU_METHOD
/begin COMPU_METHOD Time_ms "Zeit in ms für Fehlerentprellung (DSM) und SW-Timer" RAT_FUNC "%6.1" "ms" COEFFS 0 0.1 0 0 0 1 /end COMPU_METHOD
/begin COMPU_METHOD TransR "Übersetzungsverhältnis (Getriebe etc.)" RAT_FUNC "%6.4" "-" COEFFS 0 100 0 0 0 1 /end COMPU_METHOD
/begin COMPU_METHOD Trq "Motormoment" RAT_FUNC "%6.3" "Nm" COEFFS 0 10 0 0 0 1 /end COMPU_METHOD
/begin COMPU_METHOD TrqPrp "Vortriebsmoment" RAT_FUNC "%6.3" "Nm" COEFFS 0 5 0 0 0 1 /end COMPU_METHOD
/begin COMPU_METHOD TrqPrpHigh "vortriebsmoment" RAT_FUNC "%6.2" "Nm" COEFFS 0 1 0 0 0 1 /end COMPU_METHOD
/begin COMPU_METHOD Vel "Fahrzeuggeschwindigkeit, gleiche interne Auflösung wie Vel_SI" RAT_FUNC "%6.4" "km/h" COEFFS 0 100 0 0 0 1 /end COMPU_METHOD
/begin COMPU_METHOD vfzg_uw_b512 "ME9 Umwandlungen" RAT_FUNC "%6.4" "km/h" COEFFS 0 65536 0 0 0 512 /end COMPU_METHOD
/begin RECORD_LAYOUT Kl_Xs16_Ws16 NO_AXIS_PTS_X 1 SWORD AXIS_PTS_X 2 SWORD INDEX_INCR DIRECT FNC_VALUES 3 SWORD COLUMN_DIR DIRECT /end RECORD_LAYOUT
/begin RECORD_LAYOUT Kwb_Ws16 FNC_VALUES 1 SWORD COLUMN_DIR DIRECT /end RECORD_LAYOUT
/begin RECORD_LAYOUT Kwb_Wu8 FNC_VALUES 1 UBYTE COLUMN_DIR DIRECT /end RECORD_LAYOUT
/begin RECORD_LAYOUT Kw_Ws16 FNC_VALUES 1 SWORD COLUMN_DIR DIRECT /end RECORD_LAYOUT
/begin RECORD_LAYOUT Kw_Wu16 FNC_VALUES 1 UWORD COLUMN_DIR DIRECT /end RECORD_LAYOUT
/begin RECORD_LAYOUT Kw_Wu32 FNC_VALUES 1 ULONG COLUMN_DIR DIRECT /end RECORD_LAYOUT
/begin RECORD_LAYOUT Kw_Wu8 FNC_VALUES 1 UBYTE COLUMN_DIR DIRECT /end RECORD_LAYOUT
/end MODULE
/end PROJECT
