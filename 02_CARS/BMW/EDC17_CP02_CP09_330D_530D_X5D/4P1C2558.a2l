ASAP2_VERSION 1 4
/begin PROJECT P_558 "EDC17_CP02"
/begin HEADER "" VERSION "V1C1" PROJECT_NO P_558 /end HEADER
/begin MODULE DIM ""
/begin MOD_COMMON "" BYTE_ORDER MSB_LAST ALIGNMENT_BYTE 1 ALIGNMENT_WORD 2 ALIGNMENT_LONG 4 ALIGNMENT_FLOAT32_IEEE 4 /end MOD_COMMON
/begin CHARACTERISTIC Com_dTrqOvrRunRmp.Pos_C "/" VALUE 0x8004D76C Kw_Ws32 214748364.700 dTrq 0.00 214748364.700 FORMAT "%13.3" EXTENDED_LIMITS -214748364.800 214748364.700 /end CHARACTERISTIC
/begin CHARACTERISTIC Com_dTrqOvrRunRmp.Neg_C "/" VALUE 0x8004D770 Kw_Ws32 214748364.700 dTrq 0.00 214748364.700 FORMAT "%13.3" EXTENDED_LIMITS -214748364.800 214748364.700 /end CHARACTERISTIC
/begin CHARACTERISTIC Com_facTrqInrStrt_C "" VALUE 0x8004D774 Val_Ws16 655.3500 Fact100 -327.6800 327.6700 FORMAT "%8.4" /end CHARACTERISTIC
/begin CHARACTERISTIC Com_nEISGovOffs_C "" VALUE 0x8004D776 Val_Ws16 32767.50 EngN -16384.00 16383.50 FORMAT "%8.2" /end CHARACTERISTIC
/begin CHARACTERISTIC Com_nEngOn_C "" VALUE 0x8004D778 Val_Ws16 32767.50 EngN -16384.00 16383.50 FORMAT "%8.2" /end CHARACTERISTIC
/begin CHARACTERISTIC Com_nEngRpm1_CUR "" CURVE 0x8004D77A Cur_Xs16Ws16 5300.000 EngN 700.0000 6000.000 FORMAT "%8.3" EXTENDED_LIMITS -16384.00 16383.50
 /begin AXIS_DESCR STD_AXIS Com_tEngRpm_mp Temp_Cels 6 -3549.940 3003.560 FORMAT "%8.3" DEPOSIT ABSOLUTE /end AXIS_DESCR
/end CHARACTERISTIC
/begin CHARACTERISTIC Com_nEngRpm2_CUR "" CURVE 0x8004D794 Cur_Xs16Ws16 5300.000 EngN 700.0000 6000.000 FORMAT "%8.3" EXTENDED_LIMITS -16384.00 16383.50
 /begin AXIS_DESCR STD_AXIS Com_tEngRpm_mp Temp_Cels 6 -3549.940 3003.560 FORMAT "%8.3" DEPOSIT ABSOLUTE /end AXIS_DESCR
/end CHARACTERISTIC
/begin CHARACTERISTIC Com_qOvrRun_C "" VALUE 0x8004D7AE Val_Ws16 655.3500 InjMass -327.6800 327.6700 FORMAT "%8.4" /end CHARACTERISTIC
/begin CHARACTERISTIC Com_rWaterVlvClose_C "" VALUE 0x8004D7B0 Val_Ws16 100.0000 Prc 0.00 100.0000 FORMAT "%8.4" EXTENDED_LIMITS -400.0000 399.9878 /end CHARACTERISTIC
/begin CHARACTERISTIC Com_rWaterVlvCtl_C "" VALUE 0x8004D7B2 Val_Ws16 100.0000 Prc 0.00 100.0000 FORMAT "%8.4" EXTENDED_LIMITS -400.0000 399.9878 /end CHARACTERISTIC
/begin CHARACTERISTIC Com_rWaterVlvOpen_C "" VALUE 0x8004D7B4 Val_Ws16 100.0000 Prc 0.00 100.0000 FORMAT "%8.4" EXTENDED_LIMITS -400.0000 399.9878 /end CHARACTERISTIC
/begin CHARACTERISTIC Com_stTrqInrErr_C "" VALUE 0x8004D7B6 Val_Wu8 3.000 OneToOne 0.00 3.000 FORMAT "%5.3" EXTENDED_LIMITS 0.00 255.0 /end CHARACTERISTIC
/begin CHARACTERISTIC Com_swtASDdc_C "" VALUE 0x8004D7B7 Val_Wu8 255.0 OneToOne 0.00 255.0 FORMAT "%5.1" /end CHARACTERISTIC
/begin CHARACTERISTIC Com_swtEngRpmTempSel_C "" VALUE 0x8004D7B8 Val_Wu8 2.00000000000 EngTempFldSel 0.00 2.00000000000 FORMAT "%13.11" /end CHARACTERISTIC
/begin CHARACTERISTIC Com_swtHtgUpTempSel_C "" VALUE 0x8004D7B9 Val_Wu8 2.00000000000 EngTempFldSel 0.00 2.00000000000 FORMAT "%13.11" /end CHARACTERISTIC
/begin CHARACTERISTIC Com_tEngLimHi_C "" VALUE 0x8004D7BA Val_Ws16 6553.500 Temp_Cels -3549.940 3003.560 FORMAT "%8.3" /end CHARACTERISTIC
/begin CHARACTERISTIC Com_tEngLimLo_C "" VALUE 0x8004D7BC Val_Ws16 6553.500 Temp_Cels -3549.940 3003.560 FORMAT "%8.3" /end CHARACTERISTIC
/begin CHARACTERISTIC Com_tiDebDscAck.tiHiLo_C "/" VALUE 0x8004D7BE Val_Ws16 655350.0 TimeDeb -327680.0 327670.0 FORMAT "%8.1" /end CHARACTERISTIC
/begin CHARACTERISTIC Com_tiDebDscAck.tiLoHi_C "/" VALUE 0x8004D7C0 Val_Ws16 655350.0 TimeDeb -327680.0 327670.0 FORMAT "%8.1" /end CHARACTERISTIC
/begin CHARACTERISTIC Com_tiDebGbxAck.tiHiLo_C "/" VALUE 0x8004D7C2 Val_Ws16 655350.0 TimeDeb -327680.0 327670.0 FORMAT "%8.1" /end CHARACTERISTIC
/begin CHARACTERISTIC Com_tiDebGbxAck.tiLoHi_C "/" VALUE 0x8004D7C4 Val_Ws16 655350.0 TimeDeb -327680.0 327670.0 FORMAT "%8.1" /end CHARACTERISTIC
/begin CHARACTERISTIC Com_tWaterVlv_C "" VALUE 0x8004D7C6 Val_Ws16 100.0000 Temp_Cels -0.04000000 99.96000 FORMAT "%8.4" EXTENDED_LIMITS -3549.940 3003.560 /end CHARACTERISTIC
/begin CHARACTERISTIC EngICO_dnRmp.Pos_C "/" VALUE 0x8004D7C8 Kw_Ws32 16383999.9924 RmpEngN 0.00 16383999.9924 FORMAT "%13.4" EXTENDED_LIMITS -16384000.0000 16383999.9924 /end CHARACTERISTIC
/begin CHARACTERISTIC EngICO_dnRmp.Neg_C "/" VALUE 0x8004D7CC Kw_Ws32 16383999.9924 RmpEngN 0.00 16383999.9924 FORMAT "%13.4" EXTENDED_LIMITS -16384000.0000 16383999.9924 /end CHARACTERISTIC
/begin CHARACTERISTIC EngICO_nCtOff_C "Maximal zulässige Motordrehzahl bei angeforderter Einspritzmengenausblendung" VALUE 0x8004D7D0 Val_Ws16 6000.000 EngN 0.00 6000.000 FORMAT "%8.3" EXTENDED_LIMITS -16384.00 16383.50 /end CHARACTERISTIC
/begin CHARACTERISTIC EngICO_stMode_C "" VALUE 0x8004D7D2 Val_Wu8 255.0 OneToOne 0.00 255.0 FORMAT "%5.1" /end CHARACTERISTIC
/begin CHARACTERISTIC EngPrt_facAPSPrv_MAP "Überhitzungsschutz-Kennfeld" MAP 0x800798C8 Kf_Xs16_Ys16_Ws16 3.999878 Fact 0.00 3.999878 FORMAT "%8.6" EXTENDED_LIMITS -4.000000 3.999878
 /begin AXIS_DESCR STD_AXIS EnvP_p Pres_hPa 9 -32768.00 3500.00 FORMAT "%8.2" EXTENDED_LIMITS -32768.00 32767.00 DEPOSIT ABSOLUTE /end AXIS_DESCR
 /begin AXIS_DESCR STD_AXIS Epm_nEng EngN 9 0.00 16383.50 FORMAT "%8.2" EXTENDED_LIMITS -16384.00 16383.50 DEPOSIT ABSOLUTE /end AXIS_DESCR
/end CHARACTERISTIC
/begin CHARACTERISTIC EngPrt_facOvhtPrvCT_CUR "Überhitzungsschutz-Kennlinie Kühlwassertemperatur in Faktor" CURVE 0x80079992 Cur_Xs16Ws16 1.000000 Fact 0.00 1.000000 FORMAT "%8.6" EXTENDED_LIMITS -4.000000 3.999878
 /begin AXIS_DESCR STD_AXIS CEngDsT_t Temp_Cels 25 -50.14000 149.8600 FORMAT "%8.4" EXTENDED_LIMITS -3549.940 3003.560 DEPOSIT ABSOLUTE /end AXIS_DESCR
/end CHARACTERISTIC
/begin CHARACTERISTIC EngPrt_facOvhtPrvFT_CUR "Überhitzungsschutz-Kennlinie Kraftstofftemperatur in Faktor" CURVE 0x800799F8 Cur_Xs16Ws16 1.000000 Fact 0.00 1.000000 FORMAT "%8.6" EXTENDED_LIMITS -4.000000 3.999878
 /begin AXIS_DESCR STD_AXIS FuelT_t Temp_Cels 25 -50.14000 149.8600 FORMAT "%8.4" EXTENDED_LIMITS -3549.940 3003.560 DEPOSIT ABSOLUTE /end AXIS_DESCR
/end CHARACTERISTIC
/begin CHARACTERISTIC EngPrt_facOvhtPrvOT_CUR "Überhitzungsschutz-Kennlinie Motoröltemperatur in Faktor" CURVE 0x80079A5E Cur_Xs16Ws16 1.000000 Fact 0.00 1.000000 FORMAT "%8.6" EXTENDED_LIMITS -4.000000 3.999878
 /begin AXIS_DESCR STD_AXIS Oil_tSwmp Temp_Cels 25 -50.14000 199.8600 FORMAT "%8.4" EXTENDED_LIMITS -3549.940 3003.560 DEPOSIT ABSOLUTE /end AXIS_DESCR
/end CHARACTERISTIC
/begin CHARACTERISTIC EngPrt_facOvhtPrv_MAP "Überhitzungsschutz-Kennfeld" MAP 0x80079AC4 Kf_Xs16_Ys16_Ws16 3.999878 Fact 0.00 3.999878 FORMAT "%8.6" EXTENDED_LIMITS -4.000000 3.999878
 /begin AXIS_DESCR STD_AXIS EngPrt_tEngDaFld_mp Temp_Cels 7 -3549.940 3003.560 FORMAT "%8.3" DEPOSIT ABSOLUTE /end AXIS_DESCR
 /begin AXIS_DESCR STD_AXIS VehV_v Vel 7 0.00 327.6700 FORMAT "%8.4" EXTENDED_LIMITS -327.6800 327.6700 DEPOSIT ABSOLUTE /end AXIS_DESCR
/end CHARACTERISTIC
/begin CHARACTERISTIC EngPrt_nOvrSpd_C "Schwelle für Überdrehzahlerkennung" VALUE 0x8004D7D6 Val_Ws16 6000.000 EngN 0.00 6000.000 FORMAT "%8.3" EXTENDED_LIMITS -16384.00 16383.50 /end CHARACTERISTIC
/begin CHARACTERISTIC EngPrt_nTrqShutOff_C "Drehzahlschwelle" VALUE 0x8004D7D4 Kw_Ws16 6000.000 EngN 0.00 6000.000 FORMAT "%8.3" EXTENDED_LIMITS -16384.00 16383.50 /end CHARACTERISTIC
/begin CHARACTERISTIC EngPrt_numEngTempOvhtPrv_C "" VALUE 0x80079B46 Kw_Wu8 3.000 OneToOne 0.00 3.000 FORMAT "%5.3" EXTENDED_LIMITS 0.00 255.0 /end CHARACTERISTIC
/begin CHARACTERISTIC EngPrt_pAPSPrvDfl_C "Default-Wert bei Ausfall des Atmosphärendrucksensors" VALUE 0x80079B48 Kw_Ws16 3500.000 Pres_hPa 0.00 3500.000 FORMAT "%8.3" EXTENDED_LIMITS -32768.00 32767.00 /end CHARACTERISTIC
/begin CHARACTERISTIC EngPrt_qOvhtPrvNRng_MAP "Überhitzungsschutz-Kennfeld für Drehzahl" MAP 0x80079B4A Map_Xs16Ys16Ws16 327.6700 InjMass 0.00 327.6700 FORMAT "%8.4" EXTENDED_LIMITS -327.6800 327.6700
 /begin AXIS_DESCR STD_AXIS Epm_nEng EngN 16 40.00000 6000.000 FORMAT "%8.3" EXTENDED_LIMITS -16384.00 16383.50 DEPOSIT ABSOLUTE /end AXIS_DESCR
 /begin AXIS_DESCR STD_AXIS EngPrt_facOvhtPrv_mp Fact 16 0.00 1.000000 FORMAT "%8.6" EXTENDED_LIMITS -4.000000 3.999878 DEPOSIT ABSOLUTE /end AXIS_DESCR
/end CHARACTERISTIC
/begin CHARACTERISTIC EngPrt_qOvhtPrvVRng_MAP "Überhitzungsschutz-Kennfeld für Fahrzeuggeschwindigkeit" MAP 0x80079D8E Map_Xs16Ys16Ws16 327.6700 InjMass 0.00 327.6700 FORMAT "%8.4" EXTENDED_LIMITS -327.6800 327.6700
 /begin AXIS_DESCR STD_AXIS EngPrt_facOvhtPrv_mp Fact 16 0.00 1.000000 FORMAT "%8.6" EXTENDED_LIMITS -4.000000 3.999878 DEPOSIT ABSOLUTE /end AXIS_DESCR
 /begin AXIS_DESCR STD_AXIS VehV_v Vel 16 0.00 300.0000 FORMAT "%8.4" EXTENDED_LIMITS -327.6800 327.6700 DEPOSIT ABSOLUTE /end AXIS_DESCR
/end CHARACTERISTIC
/begin CHARACTERISTIC EngPrt_RmpCBLim.Pos_C "/" VALUE 0x80079660 Kw_Ws32 3276794.99817 RmpTrq 5.00030517578 3276799.99847 FORMAT "%13.5" EXTENDED_LIMITS -3276800.00000 3276799.99847 /end CHARACTERISTIC
/begin CHARACTERISTIC EngPrt_RmpCBLim.Neg_C "/" VALUE 0x80079664 Kw_Ws32 3276794.99817 RmpTrq 5.00030517578 3276799.99847 FORMAT "%13.5" EXTENDED_LIMITS -3276800.00000 3276799.99847 /end CHARACTERISTIC
/begin CHARACTERISTIC EngPrt_RmpNLim.Pos_C "/" VALUE 0x80079668 Kw_Ws32 3276794.99817 RmpTrq 5.00030517578 3276799.99847 FORMAT "%13.5" EXTENDED_LIMITS -3276800.00000 3276799.99847 /end CHARACTERISTIC
/begin CHARACTERISTIC EngPrt_RmpNLim.Neg_C "/" VALUE 0x8007966C Kw_Ws32 3276794.99817 RmpTrq 5.00030517578 3276799.99847 FORMAT "%13.5" EXTENDED_LIMITS -3276800.00000 3276799.99847 /end CHARACTERISTIC
/begin CHARACTERISTIC EngPrt_RmpTrqLim.Pos_C "/" VALUE 0x80079670 Kw_Ws32 3276799.99847 RmpTrq 0.00 3276799.99847 FORMAT "%13.5" EXTENDED_LIMITS -3276800.00000 3276799.99847 /end CHARACTERISTIC
/begin CHARACTERISTIC EngPrt_RmpTrqLim.Neg_C "/" VALUE 0x80079674 Kw_Ws32 3276799.99847 RmpTrq 0.00 3276799.99847 FORMAT "%13.5" EXTENDED_LIMITS -3276800.00000 3276799.99847 /end CHARACTERISTIC
/begin CHARACTERISTIC EngPrt_rVnDAMax_C "Maximum v/n Verhältnis" VALUE 0x80079678 Kw_Ws16 0.3276700 VelToN 0.00 0.3276700 FORMAT "%9.7" EXTENDED_LIMITS -0.3276800 0.3276700 /end CHARACTERISTIC
/begin CHARACTERISTIC EngPrt_rVnDAMin_C "Minimum v/n Verhältnis" VALUE 0x8007967A Kw_Ws16 0.3276700 VelToN 0.00 0.3276700 FORMAT "%9.7" EXTENDED_LIMITS -0.3276800 0.3276700 /end CHARACTERISTIC
/begin CHARACTERISTIC EngPrt_rVnTrqMax_C "Maximum v/n Verhältnis)" VALUE 0x8007967C Kw_Ws16 0.3276700 VelToN 0.00 0.3276700 FORMAT "%9.7" EXTENDED_LIMITS -0.3276800 0.3276700 /end CHARACTERISTIC
/begin CHARACTERISTIC EngPrt_rVnTrqMin_C "Minimum v/n Verhältnis" VALUE 0x8007967E Kw_Ws16 0.3276700 VelToN 0.00 0.3276700 FORMAT "%9.7" EXTENDED_LIMITS -0.3276800 0.3276700 /end CHARACTERISTIC
/begin CHARACTERISTIC EngPrt_swtTrqGear_CUR "applizierbare Gänge: Wert = 0 nicht aktiv; Wert = 1 aktiv" CURVE 0x80079680 Kl_Xs16_Ws16 65535.00 OneToOne -32768.00 32767.00 FORMAT "%8.2"
 /begin AXIS_DESCR STD_AXIS PT_numTraGear OneToOne 8 0.00 255.0 FORMAT "%5.1" DEPOSIT ABSOLUTE /end AXIS_DESCR
/end CHARACTERISTIC
/begin CHARACTERISTIC EngPrt_trqCBLim1_CUR "Drehmomentbegrenzung bei geoeffnetem Verdichterbypass" CURVE 0x800796A2 Kl_Xs16_Ws16 3276.700 Trq 0.00 3276.700 FORMAT "%8.3" EXTENDED_LIMITS -3276.800 3276.700
 /begin AXIS_DESCR STD_AXIS Epm_nEng EngN 20 0.00 16383.50 FORMAT "%8.2" EXTENDED_LIMITS -16384.00 16383.50 DEPOSIT ABSOLUTE /end AXIS_DESCR
/end CHARACTERISTIC
/begin CHARACTERISTIC EngPrt_trqCBLim_CUR "Drehmomentbegrenzung bei geoeffnetem Verdichterbypass" CURVE 0x800796F4 Kl_Xs16_Ws16 3276.700 Trq 0.00 3276.700 FORMAT "%8.3" EXTENDED_LIMITS -3276.800 3276.700
 /begin AXIS_DESCR STD_AXIS Epm_nEng EngN 20 0.00 16383.50 FORMAT "%8.2" EXTENDED_LIMITS -16384.00 16383.50 DEPOSIT ABSOLUTE /end AXIS_DESCR
/end CHARACTERISTIC
/begin CHARACTERISTIC EngPrt_trqLim1_CUR "Momentenbegrenzungskurve für AT mit geschlossener Wandlerkupplung und aktueller Gang muß in EngPrt_swtTrqGear_CUR 1 sein." CURVE 0x80079746 Kl_Xs16_Ws16 3276.700 Trq 0.00 3276.700 FORMAT "%8.3" EXTENDED_LIMITS -3276.800 3276.700
 /begin AXIS_DESCR STD_AXIS Epm_nEng EngN 21 0.00 16383.50 FORMAT "%8.2" EXTENDED_LIMITS -16384.00 16383.50 DEPOSIT ABSOLUTE /end AXIS_DESCR
/end CHARACTERISTIC
/begin CHARACTERISTIC EngPrt_trqLimDA_CUR "Anfahrdrehmomentenbegrenzungskennlinie" CURVE 0x8007979C Kl_Xs16_Ws16 3276.700 Trq 0.00 3276.700 FORMAT "%8.3" EXTENDED_LIMITS -3276.800 3276.700
 /begin AXIS_DESCR STD_AXIS Epm_nEng EngN 21 0.00 16383.50 FORMAT "%8.2" EXTENDED_LIMITS -16384.00 16383.50 DEPOSIT ABSOLUTE /end AXIS_DESCR
/end CHARACTERISTIC
/begin CHARACTERISTIC EngPrt_trqLim_CUR "Kennlinie die Drehmomentbegrenzung (je nach Application inneres oder äußeres Motormoment)" CURVE 0x800797F2 Kl_Xs16_Ws16 3276.700 Trq 0.00 3276.700 FORMAT "%8.3" EXTENDED_LIMITS -3276.800 3276.700
 /begin AXIS_DESCR STD_AXIS Epm_nEng EngN 21 0.00 16383.50 FORMAT "%8.2" EXTENDED_LIMITS -16384.00 16383.50 DEPOSIT ABSOLUTE /end AXIS_DESCR
/end CHARACTERISTIC
/begin CHARACTERISTIC EngPrt_trqNLimSpr_CUR "Kennlinie für Motordrehzahlbegrenzung bei Systemfehler (als Begrenzungsmoment)" CURVE 0x80079848 Kl_Xs16_Ws16 3276.700 Trq 0.00 3276.700 FORMAT "%8.3" EXTENDED_LIMITS -3276.800 3276.700
 /begin AXIS_DESCR STD_AXIS Epm_nEng EngN 10 0.00 16383.50 FORMAT "%8.2" EXTENDED_LIMITS -16384.00 16383.50 DEPOSIT ABSOLUTE /end AXIS_DESCR
/end CHARACTERISTIC
/begin CHARACTERISTIC EngPrt_trqNLim_CUR "Kennlinie für Drehzahlbegrenzung im Normalbetrieb (inneres Motormoment)" CURVE 0x80079872 Kl_Xs16_Ws16 3276.700 Trq 0.00 3276.700 FORMAT "%8.3" EXTENDED_LIMITS -3276.800 3276.700
 /begin AXIS_DESCR STD_AXIS Epm_nEng EngN 21 0.00 16383.50 FORMAT "%8.2" EXTENDED_LIMITS -16384.00 16383.50 DEPOSIT ABSOLUTE /end AXIS_DESCR
/end CHARACTERISTIC
/begin CHARACTERISTIC EngReq_nSlpLimMin_C "Drehzahlschwelle zur Aktivierung Turboschub-Begrenzung" VALUE 0x8004D7D8 Val_Ws16 16383.50 EngN 0.00 16383.50 FORMAT "%8.2" EXTENDED_LIMITS -16384.00 16383.50 /end CHARACTERISTIC
/begin CHARACTERISTIC EngReq_SlpLim.Pos_C "/" VALUE 0x8004D7DC Kw_Ws32 3276799.99847 RmpTrq 0.00 3276799.99847 FORMAT "%13.5" EXTENDED_LIMITS -3276800.00000 3276799.99847 /end CHARACTERISTIC
/begin CHARACTERISTIC EngReq_SlpLim.Neg_C "/" VALUE 0x8004D7E0 Kw_Ws32 3276799.99847 RmpTrq 0.00 3276799.99847 FORMAT "%13.5" EXTENDED_LIMITS -3276800.00000 3276799.99847 READ_ONLY /end CHARACTERISTIC
/begin CHARACTERISTIC EngStA_DigOut.tiBtwTstSCB_C "/" VALUE 0x8004D7E4 Kw_Ws16 1000.000 Time_ms 0.00 1000.000 FORMAT "%8.3" EXTENDED_LIMITS -327680.0 327670.0 /end CHARACTERISTIC
/begin CHARACTERISTIC EngStA_DigOut.tiBtwTstOT_C "/" VALUE 0x8004D7E6 Kw_Ws16 1000.000 Time_s 0.00 1000.000 FORMAT "%8.3" EXTENDED_LIMITS -327.6800 327.6700 /end CHARACTERISTIC
/begin CHARACTERISTIC EngStA_DigOut.numTstMax_C "/" VALUE 0x8004D7E8 Kw_Wu16 65535.00 OneToOne 0.00 65535.00 FORMAT "%8.2" /end CHARACTERISTIC
/begin CHARACTERISTIC EngStA_stPsDiaDisbl_C "" VALUE 0x8004D7EA Val_Wu8 255.0 OneToOne 0.00 255.0 FORMAT "%5.1" /end CHARACTERISTIC
/begin CHARACTERISTIC EngStA_stPsDisbl_C "" VALUE 0x8004D7EB Val_Wu8 255.0 OneToOne 0.00 255.0 FORMAT "%5.1" /end CHARACTERISTIC
/begin CHARACTERISTIC EngTrqPtd_nEngMin_C "Drehzahlschwelle oberhalb der eine Begrenzung der Ebene 1 aus der Überwachung erfolgen kann" VALUE 0x8004D7F4 Val_Ws16 32767.50 EngN -16384.00 16383.50 FORMAT "%8.2" /end CHARACTERISTIC
/begin CHARACTERISTIC EngTrqPtd_rTrqNOfs_MAP "Kennfeld zur Bedatung des Ebene 1 Offsets der Momentenbegrenzung (n-synchrone Berechnung)" MAP 0x8004D7F6 Map_Xs16Ys16Ws16 99.60938 Mo_r_prc_q0p39 0.00 99.60938 FORMAT "%8.5" EXTENDED_LIMITS -12800.00 12799.61
 /begin AXIS_DESCR STD_AXIS EngTrqPtd_rTrqNPtd_mp Mo_r_prc_q0p39 8 0.00 99.61 FORMAT "%5.2" DEPOSIT ABSOLUTE /end AXIS_DESCR
 /begin AXIS_DESCR STD_AXIS Epm_nEng EngN 8 -16384.00 16383.50 FORMAT "%8.2" DEPOSIT ABSOLUTE /end AXIS_DESCR
/end CHARACTERISTIC
/begin CHARACTERISTIC EngTrqPtd_rTrqTOfs_MAP "Kennfeld zur Bedatung des Ebene 1 Offsets der Momentenbegrenzung (t-synchrone Berechnung)" MAP 0x8004D89A Map_Xs16Ys16Ws16 99.60938 Mo_r_prc_q0p39 0.00 99.60938 FORMAT "%8.5" EXTENDED_LIMITS -12800.00 12799.61
 /begin AXIS_DESCR STD_AXIS EngTrqPtd_rTrqTPtd_mp Mo_r_prc_q0p39 8 0.00 99.61 FORMAT "%5.2" DEPOSIT ABSOLUTE /end AXIS_DESCR
 /begin AXIS_DESCR STD_AXIS Epm_nEng EngN 8 -16384.00 16383.50 FORMAT "%8.2" DEPOSIT ABSOLUTE /end AXIS_DESCR
/end CHARACTERISTIC
/begin CHARACTERISTIC EngTrqPtd_tiPthSetDeb_C "Entprellzeit der Ebene 1 motorseitigen Sollwertpfadbegrenzung" VALUE 0x8004D940 Val_Ws32 4294967295.00 TimeDT -2147483648.00 2147483647.00 FORMAT "%13.2" /end CHARACTERISTIC
/begin CHARACTERISTIC EngTrqPtd_tiT1_C "PT1 Filterzeitkonstante der Ruckeldämpferüberwachung der Ebene 1 Begrenzung" VALUE 0x8004D7EC Val_Ws32 4294.9672940 TimeDelay_s 0.000002000000001 4294.9672960 FORMAT "%12.7" /end CHARACTERISTIC
/begin CHARACTERISTIC EngTrqPtd_trqFltMax_C "Maximaler Stellbereich der gefilterten Ruckeldämpferstellgröße der Ebene 1 Begrenzung" VALUE 0x8004D7F0 Val_Ws16 200.0000 Mo_trq_nm_q0p1 0.00 200.0000 FORMAT "%8.4" EXTENDED_LIMITS -3276.800 3276.700 /end CHARACTERISTIC
/begin CHARACTERISTIC EngTrqPtd_trqMax_C "Maximaler Stellbereich der Ruckeldämpferstellgröße der Ebene 1 Begrenzung" VALUE 0x8004D7F2 Val_Ws16 200.0000 Mo_trq_nm_q0p1 0.00 200.0000 FORMAT "%8.4" EXTENDED_LIMITS -3276.800 3276.700 /end CHARACTERISTIC
/begin CHARACTERISTIC EngTrqPtd_trqSpdGPtd_MAP "zulässiges Moment des Drehzahlreglers abhängig von Drehzahl und Motortemperatur" MAP 0x8004D944 Map_Xs16Ys16Ws16 6553.500 Mo_trq_nm_q0p1 -3276.800 3276.700 FORMAT "%8.3"
 /begin AXIS_DESCR STD_AXIS Epm_nEng EngN 6 -16384.00 16383.50 FORMAT "%8.2" DEPOSIT ABSOLUTE /end AXIS_DESCR
 /begin AXIS_DESCR STD_AXIS EngDa_tEng Temp_Cels 6 -3549.940 3003.560 FORMAT "%8.3" DEPOSIT ABSOLUTE /end AXIS_DESCR
/end CHARACTERISTIC
/begin CHARACTERISTIC EnvP_nLimHigh_C "Hochsteschwelle der Motordrehzahl, oberhalb der der Umgebungsdruck aus dem Ladedruck nicht modelliert werden können" VALUE 0x8004DA24 Val_Ws16 6000.000 EngN 0.00 6000.000 FORMAT "%8.3" EXTENDED_LIMITS -16384.00 16383.50 /end CHARACTERISTIC
/begin CHARACTERISTIC EnvP_pCorr_MAP "Kennfeld der aus Ladedruck berechneten Umgebungstemperaturkorrektur" MAP 0x8004DA26 Map_Xs16Ys16Ws16 3850.000 Pres_hPa -350.0000 3500.000 FORMAT "%8.3" EXTENDED_LIMITS -32768.00 32767.00
 /begin AXIS_DESCR STD_AXIS Epm_nEng EngN 2 0.00 6000.000 FORMAT "%8.3" EXTENDED_LIMITS -16384.00 16383.50 DEPOSIT ABSOLUTE /end AXIS_DESCR
 /begin AXIS_DESCR STD_AXIS Epm_nEngDiff EngN 2 -6000.000 6000.000 FORMAT "%8.3" EXTENDED_LIMITS -16384.00 16383.50 DEPOSIT ABSOLUTE /end AXIS_DESCR
/end CHARACTERISTIC
/begin CHARACTERISTIC EnvP_pTransf_CUR "Umwandlungsskennlinie für Umgebungsdruck" CURVE 0x8004D9A8 Cur_Xs16Ws16 3500.000 Pres_hPa 0.00 3500.000 FORMAT "%8.3" EXTENDED_LIMITS -32768.00 32767.00
 /begin AXIS_DESCR STD_AXIS EnvP_uRaw Volt 25 0.00 5000.000 FORMAT "%8.3" EXTENDED_LIMITS -6553.600 6553.400 DEPOSIT ABSOLUTE /end AXIS_DESCR
/end CHARACTERISTIC
/begin CHARACTERISTIC EnvP_RmpSlp.Pos_C "/" VALUE 0x8004DA14 Kw_Ws32 32767949.9817 RmpPres_hPa 50.0030517578 32767999.9847 FORMAT "%13.4" EXTENDED_LIMITS -32768000.0000 32767999.9847 /end CHARACTERISTIC
/begin CHARACTERISTIC EnvP_RmpSlp.Neg_C "/" VALUE 0x8004DA18 Kw_Ws32 32767949.9817 RmpPres_hPa 50.0030517578 32767999.9847 FORMAT "%13.4" EXTENDED_LIMITS -32768000.0000 32767999.9847 /end CHARACTERISTIC
/begin CHARACTERISTIC EnvP_SRC.uMin_C "/" VALUE 0x8004DA0E Kw_Ws16 5200.000 Volt 0.00 5200.000 FORMAT "%8.3" EXTENDED_LIMITS -6553.600 6553.400 /end CHARACTERISTIC
/begin CHARACTERISTIC EnvP_SRC.uMax_C "/" VALUE 0x8004DA10 Kw_Ws16 5200.000 Volt 0.00 5200.000 FORMAT "%8.3" EXTENDED_LIMITS -6553.600 6553.400 /end CHARACTERISTIC
/begin CHARACTERISTIC EnvP_swtSensPres_C "Schalter zur Festlegung von dem Vorhandensein oder Nichtvorhandensein des Umgebungsdrucksensors" VALUE 0x8004DA1C Val_Wu8 1.000 OneToOne 0.00 1.000 FORMAT "%5.3" EXTENDED_LIMITS 0.00 255.0 /end CHARACTERISTIC
/begin CHARACTERISTIC EnvP_swtSig_C "Schalter zur Bewertung des angeschlossenen Sensortyps." VALUE 0x8004DA12 Val_Wu8 255.0 OneToOne 0.00 255.0 FORMAT "%5.1" /end CHARACTERISTIC
/begin CHARACTERISTIC EnvP_tiDel_C "Zeitverzögerung zur Sperrung der Modellberechnung, nachdem die Motordrehzahl eine höhere Schwelle überschreitet" VALUE 0x8004DA3A Val_Wu16 655350.0 Time_ms 0.00 655350.0 FORMAT "%8.1" /end CHARACTERISTIC
/begin CHARACTERISTIC EnvP_TransStg.Dfl_C "/" VALUE 0x8004DA1E Kw_Ws16 3500.000 Pres_hPa 0.00 3500.000 FORMAT "%8.3" EXTENDED_LIMITS -32768.00 32767.00 /end CHARACTERISTIC
/begin CHARACTERISTIC EnvP_TransStg.stSensId_C "/" VALUE 0x8004DA20 Kw_Wu8 255.0 OneToOne 0.00 255.0 FORMAT "%5.1" /end CHARACTERISTIC
/begin CHARACTERISTIC EnvT_RmpSlp.Pos_C "/" VALUE 0x8004DAA8 Kw_Ws32 3276798.99750 RmpTemp 1.00097656250 3276799.99847 FORMAT "%13.5" EXTENDED_LIMITS -3276800.00000 3276799.99847 /end CHARACTERISTIC
/begin CHARACTERISTIC EnvT_RmpSlp.Neg_C "/" VALUE 0x8004DAAC Kw_Ws32 3276798.99750 RmpTemp 1.00097656250 3276799.99847 FORMAT "%13.5" EXTENDED_LIMITS -3276800.00000 3276799.99847 /end CHARACTERISTIC
/begin CHARACTERISTIC EnvT_SRC.uMin_C "/" VALUE 0x8004DA3C Kw_Ws16 5200.000 Volt 0.00 5200.000 FORMAT "%8.3" EXTENDED_LIMITS -6553.600 6553.400 /end CHARACTERISTIC
/begin CHARACTERISTIC EnvT_SRC.uMax_C "/" VALUE 0x8004DA3E Kw_Ws16 5200.000 Volt 0.00 5200.000 FORMAT "%8.3" EXTENDED_LIMITS -6553.600 6553.400 /end CHARACTERISTIC
/begin CHARACTERISTIC EnvT_swtSensPres_C "Schalter zur Auswahl von dem Vorhandensein oder Nichtvorhandensein des Umgebungslufttemperatursensors" VALUE 0x8004DAB0 Val_Wu8 1.000 OneToOne 0.00 1.000 FORMAT "%5.3" EXTENDED_LIMITS 0.00 255.0 /end CHARACTERISTIC
/begin CHARACTERISTIC EnvT_swtSig_C "Signalquelleauswahlschalter" VALUE 0x8004DA40 Val_Wu8 255.0 OneToOne 0.00 255.0 FORMAT "%5.1" /end CHARACTERISTIC
/begin CHARACTERISTIC EnvT_tAirCorr_MAP "Kennfeld zur Lufttemperaturberechnung" MAP 0x8004DAB2 Map_Xs16Ys16Ws16 6553.500 Temp_Cels -3549.940 3003.560 FORMAT "%8.3"
 /begin AXIS_DESCR STD_AXIS Air_tCACDs Temp_Cels 16 -3549.940 3003.560 FORMAT "%8.3" DEPOSIT ABSOLUTE /end AXIS_DESCR
 /begin AXIS_DESCR STD_AXIS Air_pCACDs Pres_hPa 16 -32768.00 3500.00 FORMAT "%8.2" EXTENDED_LIMITS -32768.00 32767.00 DEPOSIT ABSOLUTE /end AXIS_DESCR
/end CHARACTERISTIC
/begin CHARACTERISTIC EnvT_tClntMod_CUR "Kennlinie zur Bewertung des Temperaturwerts aus Kühlmitteltemperatur" CURVE 0x8004DCF6 Cur_Xs16Ws16 6553.500 Temp_Cels -3549.940 3003.560 FORMAT "%8.3"
 /begin AXIS_DESCR STD_AXIS EnvT_tClntPT1_mp Temp_Cels 16 -3549.940 3003.560 FORMAT "%8.3" DEPOSIT ABSOLUTE /end AXIS_DESCR
/end CHARACTERISTIC
/begin CHARACTERISTIC EnvT_tiLPFiltPT1_C "PT1-Filterzeitkonstante für Umgebungstemperatur." VALUE 0x8004DD38 Val_Ws32 4294.9672940 TimeDelay_s 0.000002000000001 4294.9672960 FORMAT "%12.7" /end CHARACTERISTIC
/begin CHARACTERISTIC EnvT_tiTempAirPT1_C "PT1-Filterzeitkonstante für korrigierte Lufttemperatur." VALUE 0x8004DD3C Val_Ws16 4294.8362200 TimeDelay_s 0.13107600012 4294.9672960 FORMAT "%12.7" /end CHARACTERISTIC
/begin CHARACTERISTIC EnvT_tiTempClntPT1_C "PT1-Filterzeitkonstante für Kühlmitteltemperatur." VALUE 0x8004DD3E Val_Ws16 4294.8362200 TimeDelay_s 0.13107600012 4294.9672960 FORMAT "%12.7" /end CHARACTERISTIC
/begin CHARACTERISTIC EnvT_TransStg.Dfl_C "/" VALUE 0x8004DD40 Kw_Ws16 250.0000 Temp_Cels -50.04000 199.9600 FORMAT "%8.4" EXTENDED_LIMITS -3549.940 3003.560 /end CHARACTERISTIC
/begin CHARACTERISTIC EnvT_TransStg.stSensId_C "/" VALUE 0x8004DD42 Kw_Wu8 255.0 OneToOne 0.00 255.0 FORMAT "%5.1" /end CHARACTERISTIC
/begin CHARACTERISTIC EnvT_tTransf_CUR "Umwandlungskennlinie der Umgebungslufttemperatur" CURVE 0x8004DA42 Cur_Xs16Ws16 250.0000 Temp_Cels -50.04000 199.9600 FORMAT "%8.4" EXTENDED_LIMITS -3549.940 3003.560
 /begin AXIS_DESCR STD_AXIS EnvT_uRaw Volt 25 0.00 5200.000 FORMAT "%8.3" EXTENDED_LIMITS -6553.600 6553.400 DEPOSIT ABSOLUTE /end AXIS_DESCR
/end CHARACTERISTIC
/begin CHARACTERISTIC EpmBCr_phiTimeoutInt_C "Winkel bis zum Timeout-Interrupts wenn der Motor abgebremst wird" VALUE 0x80079FE8 Val_Ws16 1440.022 AngleCrS -720.0220 720.0000 FORMAT "%8.4" /end CHARACTERISTIC
/begin CHARACTERISTIC EpmCaS_dSegSeries_CA "Reihenfolge der Nockenwellensegmente" VAL_BLK 0x80079FF8 ValA_Wu8 255.0 OneToOne 0.00 255.0 FORMAT "%5.1" NUMBER 10 /end CHARACTERISTIC
/begin CHARACTERISTIC EpmCaS_facPlausHigh_GCUR "Faktor für die obere Grenze der Plausibilitätsprüfung des Nockenwellensignals" CURVE 0x8007A002 CurG_Ws16 65.53500 EpmCaS_Fac_Plaus -32.76800 32.76700 FORMAT "%8.5"
 /begin AXIS_DESCR COM_AXIS Epm_nEng EngN 8 -16384.00 16383.50 FORMAT "%8.2" AXIS_PTS_REF EpmCaS_facPlaus_DST /end AXIS_DESCR
/end CHARACTERISTIC
/begin CHARACTERISTIC EpmCaS_facPlausLow_GCUR "Faktor für die untere Grenze der Plausibilitätsprüfung des Nockenwellensignals" CURVE 0x8007A012 CurG_Ws16 65.53500 EpmCaS_Fac_Plaus -32.76800 32.76700 FORMAT "%8.5"
 /begin AXIS_DESCR COM_AXIS Epm_nEng EngN 8 -16384.00 16383.50 FORMAT "%8.2" AXIS_PTS_REF EpmCaS_facPlaus_DST /end AXIS_DESCR
/end CHARACTERISTIC
/begin AXIS_PTS EpmCaS_facPlaus_DST "Stützstellen für die Kennlinien der Plausibilätsprüfung des Nockenwellensignals" 0x8007A022 Epm_nEng Axis_Xs16 32767.50 EngN 8 -16384.00 16383.50 FORMAT "%8.2" DEPOSIT ABSOLUTE /end AXIS_PTS
/begin CHARACTERISTIC EpmCaS_numEdgeTol_C "Anzahl der zu tolerierenden fehlerhaften NW-Flanken für Diagnose und Winkelversatz" VALUE 0x80079FEA Val_Wu8 30.00 OneToOne 0.00 30.00 FORMAT "%5.2" EXTENDED_LIMITS 0.00 255.0 /end CHARACTERISTIC
/begin CHARACTERISTIC EpmCaS_numErrSigDef_C "Schwelle des Entprellzählers für die Defekterkennung bei einer Nockenwellenstörung" VALUE 0x80079FEC Val_Wu16 1092.250 CrSRev2CrSInc 0.00 1092.250 FORMAT "%8.3" /end CHARACTERISTIC
/begin CHARACTERISTIC EpmCaS_numErrSigOk_C "Schwelle des Entprellzählers für die Heilung einer erkannten Nockenwellenstörung" VALUE 0x80079FEE Val_Wu16 99.98333 CrSRev2CrSInc 0.01666667 100.0000 FORMAT "%8.4" EXTENDED_LIMITS 0.00 1092.250 /end CHARACTERISTIC
/begin CHARACTERISTIC EpmCaS_numNoSigDef_C "Schwelle des Entprellzählers für die Erkennung des Ausfalls eines Nockenwellensignals" VALUE 0x80079FF0 Val_Wu16 1092.250 CrSRev2CrSInc 0.00 1092.250 FORMAT "%8.3" /end CHARACTERISTIC
/begin CHARACTERISTIC EpmCaS_numOfsErr_C "Anzahl Nockenwellenumdrehung bis Feher DFC_EpmCaS..OfsErr gesetzt wird" VALUE 0x8007F6A2 Val_Wu8 255.0 OneToOne 0.00 255.0 FORMAT "%5.1" /end CHARACTERISTIC
/begin CHARACTERISTIC EpmCaS_numPlausErrMax_C "" VALUE 0x8007A034 Val_Wu8 255.0 OneToOne 0.00 255.0 FORMAT "%5.1" /end CHARACTERISTIC
/begin CHARACTERISTIC EpmCaS_numSegSerLst_C "Index des letzten Segments in EpmCaS_dSegSeries" VALUE 0x8007A035 Val_Wu8 255.0 OneToOne 0.00 255.0 FORMAT "%5.1" /end CHARACTERISTIC
/begin CHARACTERISTIC EpmCaS_phiNCor_CUR "drehzahlabhängiger Winkelkorrekturwert des Nockenwellensignals" CURVE 0x8007A036 Cur_Xs16Ws16 1440.022 AngleCrS -720.0220 720.0000 FORMAT "%8.4"
 /begin AXIS_DESCR STD_AXIS Epm_nEng EngN 6 -16384.00 16383.50 FORMAT "%8.2" DEPOSIT ABSOLUTE /end AXIS_DESCR
/end CHARACTERISTIC
/begin CHARACTERISTIC EpmCaS_phiOfsMax_C "max. Verdrehwinkel zwischen Nockenwelle und Kurbelwelle" VALUE 0x8007F6A4 Val_Ws16 1440.022 AngleCrS -720.0220 720.0000 FORMAT "%8.4" /end CHARACTERISTIC
/begin CHARACTERISTIC EpmCaS_phiOfsTolc_C "Toleranzbereich einer Nockenwellenflanke zur Berechnung der Nockenwellenverdrehung" VALUE 0x8007F6A6 Val_Ws16 1440.022 AngleCrS -720.0220 720.0000 FORMAT "%8.4" /end CHARACTERISTIC
/begin CHARACTERISTIC EpmCaS_phiSegLenTol_CA "Toleranz für jede Segmentlänge" VAL_BLK 0x8007A050 ValA_Ws16 1440.022 AngleCrS -720.0220 720.0000 FORMAT "%8.4" NUMBER 10 /end CHARACTERISTIC
/begin CHARACTERISTIC EpmCaS_phiSegLen_CA "Länge der Nockenwellensegmente" VAL_BLK 0x8007A064 ValA_Ws16 1440.022 AngleCrS -720.0220 720.0000 FORMAT "%8.4" NUMBER 10 /end CHARACTERISTIC
/begin CHARACTERISTIC EpmCaS_phiSegOfs_CA "Winkel zwischen Nullpunkt des Winkelsystems und Beginn von EpmCaS_dSegSeries_C" VAL_BLK 0x8007A078 ValA_Ws16 1440.022 AngleCrS -720.0220 720.0000 FORMAT "%8.4" NUMBER 1 /end CHARACTERISTIC
/begin AXIS_PTS EpmCaS_phiTempCor05_DST "Stützstellen der Temperaturverteilung für die Winkelkorrekturwerte der Nockenwellen" 0x8007A07A EngDa_tEng Axis_Xs16 6553.500 Temp_Cels 5 -3549.940 3003.560 FORMAT "%8.3" DEPOSIT ABSOLUTE /end AXIS_PTS
/begin CHARACTERISTIC EpmCaS_phiTempCorI1_GCUR "Winkelkorrekturwerte für die erste Einlassnockenwelle" CURVE 0x8007A086 CurG_Ws16 1440.022 AngleCrS -720.0220 720.0000 FORMAT "%8.4"
 /begin AXIS_DESCR COM_AXIS EngDa_tEng Temp_Cels 5 -3549.940 3003.560 FORMAT "%8.3" AXIS_PTS_REF EpmCaS_phiTempCor05_DST /end AXIS_DESCR
/end CHARACTERISTIC
/begin CHARACTERISTIC EpmCaS_stActEdge_C "Zu erfassende Nockenwellenflanke(n)" VALUE 0x8007A090 Val_Wu8 255.0 OneToOne 0.00 255.0 FORMAT "%5.1" /end CHARACTERISTIC
/begin CHARACTERISTIC EpmCaS_stDiagMode_C "Abschalten der Nockenwellendiagnose in EPM_MODE_OK , wenn ein Nockenwellenfehler erkannt ist." VALUE 0x80079FF2 Val_Wu8 255.0 OneToOne 0.00 255.0 FORMAT "%5.1" /end CHARACTERISTIC
/begin CHARACTERISTIC EpmCaS_stOfsDiagMode_C "Abschalten der Winkelversatzdiagnose in EPM_MODE_OK" VALUE 0x80079FF4 Val_Wu8 255.0 OneToOne 0.00 255.0 FORMAT "%5.1" /end CHARACTERISTIC
/begin CHARACTERISTIC EpmCaS_tiGlitchFilter_C "Filterzeit für das Nockenwellensignal" VALUE 0x8007A094 Val_Ws32 42949672950.0 Time_ms -21474836480.0 21474836470.0 FORMAT "%13.1" /end CHARACTERISTIC
/begin CHARACTERISTIC EpmCaS_tiOfsPT1_C "Zeitkonstante für gefilterten Nockenwellenverdrehwinkel" VALUE 0x8007F6A8 Val_Wu16 4294901.7590 TimeDelay_ms 65.537000015 4294967.2960 FORMAT "%12.4" /end CHARACTERISTIC
/begin CHARACTERISTIC EpmCaS_tiTimeout_C "Zeitdauer nach der die Zeitstempel der Nockenwelle auf ungültig gesetzt werden wenn keine neuen Flanken anliegen" VALUE 0x8007A098 Val_Ws32 42949672950.0 Time_ms -21474836480.0 21474836470.0 FORMAT "%13.1" /end CHARACTERISTIC
/begin CHARACTERISTIC EpmCrS_dnEngMax_C "max. Motorverzögerung bei der noch die Diagnose auf gestörtes KW Signal durchgeführt wird" VALUE 0x8007A09C Val_Ws16 65534.00 EngNGrd -32767.00 32767.00 FORMAT "%8.2" EXTENDED_LIMITS -16384.00 16383.50 /end CHARACTERISTIC
/begin CHARACTERISTIC EpmCrS_facGapCrit1_C "Faktor für erstes Lückenkriterium" VALUE 0x8007A0B0 Val_Wu8 15.94 EPM_FAC_PLAUS 0.00 15.94 FORMAT "%5.2" /end CHARACTERISTIC
/begin CHARACTERISTIC EpmCrS_facGapCrit2_C "Faktor für zweites Lückenkriterium" VALUE 0x8007A0B1 Val_Wu8 15.94 EPM_FAC_PLAUS 0.00 15.94 FORMAT "%5.2" /end CHARACTERISTIC
/begin CHARACTERISTIC EpmCrS_facGapPlausHigh_CA "Verhältnis zur Bestimmung der oberen Grenze des Fensters zur Lückenplausibilisierung des Inkrementsignals" VAL_BLK 0x8007A0B2 ValA_Wu8 15.94 EPM_FAC_PLAUS 0.00 15.94 FORMAT "%5.2" NUMBER 4 /end CHARACTERISTIC
/begin CHARACTERISTIC EpmCrS_facIncPlausHigh_CA "Faktor obere Plausibilitätsgrenze Kurbelwellensignal" VAL_BLK 0x8007A0B6 ValA_Wu8 15.94 EPM_FAC_PLAUS 0.00 15.94 FORMAT "%5.2" NUMBER 4 /end CHARACTERISTIC
/begin CHARACTERISTIC EpmCrS_facIncPlausLow_CA "Faktor untere Plausibilitätsgrenze Kurbelwellensignal" VAL_BLK 0x8007A0BA ValA_Wu8 15.94 EPM_FAC_PLAUS 0.00 15.94 FORMAT "%5.2" NUMBER 4 /end CHARACTERISTIC
/begin CHARACTERISTIC EpmCrS_facScale_C "TTMeasure - Auflösung der gemessenen Zahnzeiten" VALUE 0x8007A0F8 Val_Wu8 10.00 OneToOne 0.00 10.00 FORMAT "%5.2" EXTENDED_LIMITS 0.00 255.0 /end CHARACTERISTIC
/begin CHARACTERISTIC EpmCrS_nDiagOff_C "Drehzahlschwelle zum deaktivieren der KW Diagnose" VALUE 0x8007A09E Val_Ws16 8000.000 EngN 0.00 8000.000 FORMAT "%8.3" EXTENDED_LIMITS -16384.00 16383.50 /end CHARACTERISTIC
/begin CHARACTERISTIC EpmCrS_nDiagOn_C "Drehzahlschwelle zum aktivieren der KW Diagnose" VALUE 0x8007A0A0 Val_Ws16 8000.000 EngN 0.00 8000.000 FORMAT "%8.3" EXTENDED_LIMITS -16384.00 16383.50 /end CHARACTERISTIC
/begin CHARACTERISTIC EpmCrS_nFacScale_C "TTMeasure - Drehzahlschwelle zur Umschaltung der Auflösung der gemessenen Zahnzeiten" VALUE 0x8007A0FA Val_Ws16 10000.00 EngN 0.00 10000.00 FORMAT "%8.2" EXTENDED_LIMITS -16384.00 16383.50 /end CHARACTERISTIC
/begin CHARACTERISTIC EpmCrS_nMaxInc_C "max Inkrementdrehzahl" VALUE 0x8007A0BE Val_Ws16 9980.000 EngN 20.00000 10000.00 FORMAT "%8.2" EXTENDED_LIMITS -16384.00 16383.50 /end CHARACTERISTIC
/begin CHARACTERISTIC EpmCrS_nMinInc_C "min Inkrementdrehzahl" VALUE 0x8007A0C0 Val_Ws16 9980.000 EngN 20.00000 10000.00 FORMAT "%8.2" EXTENDED_LIMITS -16384.00 16383.50 /end CHARACTERISTIC
/begin CHARACTERISTIC EpmCrS_nThreshRange_CA "Drehzahlschwellen der Drehzahlbereiche in der dynamischen Plausibilisierung" VAL_BLK 0x8007A0C4 ValA_Ws32 16319.868465052328 EngN2tiIncPer 19.999999000000049 16339.868464052328 FORMAT "%19.13" EXTENDED_LIMITS 0.001164153160604 2499999.8750000061 NUMBER 4 /end CHARACTERISTIC
/begin CHARACTERISTIC EpmCrS_nTiIncPerAvrg_CA "Drehzahlschwellen zur Bestimmung der Anzahl von Kurbelwellenzähne über die die Zahnzeit gemittelt wird" VAL_BLK 0x8007A0D4 ValA_Ws16 16363.00 EngN 20.00000 16383.00 FORMAT "%8.2" EXTENDED_LIMITS -16384.00 16383.50 NUMBER 4 /end CHARACTERISTIC
/begin CHARACTERISTIC EpmCrS_numErrSigGlitMax_C "Grenzwert für den Fehlereintrag für den Glitchfehler auf der Kurbelwelle" VALUE 0x8007A0A2 Val_Ws16 32767.00 OneToOne 0.00 32767.00 FORMAT "%8.2" EXTENDED_LIMITS -32768.00 32767.00 /end CHARACTERISTIC
/begin CHARACTERISTIC EpmCrS_numErrSigIncDef_C "Schrittweite Defektentprellung KW Störung" VALUE 0x8007A0A4 Val_Ws16 32767.00 OneToOne 0.00 32767.00 FORMAT "%8.2" EXTENDED_LIMITS -32768.00 32767.00 /end CHARACTERISTIC
/begin CHARACTERISTIC EpmCrS_numErrSigMaxDef_C "max. Anzahl Störungen bis Fehlereintrag KW Störung" VALUE 0x8007A0A6 Val_Ws16 32767.00 OneToOne 0.00 32767.00 FORMAT "%8.2" EXTENDED_LIMITS -32768.00 32767.00 /end CHARACTERISTIC
/begin CHARACTERISTIC EpmCrS_numErrSigMinOK_C "min. Anzahl von plausieblen Kurbelwellenumdrehungen bis Fehler geheilt wird" VALUE 0x8007A0A8 Val_Ws16 32767.00 OneToOne 0.00 32767.00 FORMAT "%8.2" EXTENDED_LIMITS -32768.00 32767.00 /end CHARACTERISTIC
/begin CHARACTERISTIC EpmCrS_numIgnInc_C "Anzahl KW Zähne, die ausgeblendet werden" VALUE 0x8007A0DC Val_Wu8 255.0 OneToOne 0.00 255.0 FORMAT "%5.1" /end CHARACTERISTIC
/begin CHARACTERISTIC EpmCrS_numNoSigDef_C "Anzahl NW-Umdrehungen bis Fehlereintrag KW-Ausfall" VALUE 0x8007A0AA Val_Ws16 32767.00 OneToOne 0.00 32767.00 FORMAT "%8.2" EXTENDED_LIMITS -32768.00 32767.00 /end CHARACTERISTIC
/begin CHARACTERISTIC EpmCrS_numTiIncPerAvrg_CA "Anzahl der Kurbelwellenzähne zur Berechnung der gemittelten Zahnzeit" VAL_BLK 0x8007A0DD ValA_Wu8 50.00 OneToOne 0.00 50.00 FORMAT "%5.2" EXTENDED_LIMITS 0.00 255.0 NUMBER 4 /end CHARACTERISTIC
/begin CHARACTERISTIC EpmCrS_stDiagT50Reset_C "KL50 Information für KW Diagnose verwenden" VALUE 0x8007A0AC Val_Wu8 255.0 OneToOne 0.00 255.0 FORMAT "%5.1" /end CHARACTERISTIC
/begin CHARACTERISTIC EpmCrS_stTTMeasureOn_C "TTMeasure - Einschalten (=1) der Zahnzeiten Messfunktion" VALUE 0x8007A0FC Val_Wu8 1.000 OneToOne 0.00 1.000 FORMAT "%5.3" EXTENDED_LIMITS 0.00 255.0 /end CHARACTERISTIC
/begin CHARACTERISTIC EpmCrS_swtEnableDiag_C "Abschalten der KW Diagnose" VALUE 0x8007A0AD Val_Wu8 255.0 OneToOne 0.00 255.0 FORMAT "%5.1" /end CHARACTERISTIC
/begin CHARACTERISTIC EpmCrS_swtIncSrc_C "TTMeasure - Rohwerte oder durch die TAA korrigierte Werte" VALUE 0x8007A0FD Val_Wu8 1.000 OneToOne 0.00 1.000 FORMAT "%5.3" EXTENDED_LIMITS 0.00 255.0 /end CHARACTERISTIC
/begin CHARACTERISTIC EpmCrS_tiGlitchFilter_CA "Glitchfilterzeit Kurbelwellensignal" VAL_BLK 0x8007A0E4 ValA_Ws32 100000.000000 OneToOne_us 0.00 100000.000000 FORMAT "%13.6" EXTENDED_LIMITS -2147483648.00 2147483647.00 NUMBER 4 /end CHARACTERISTIC
/begin CHARACTERISTIC EpmCrS_tiIgnSig_C "Zeit zum Ausblenden des KW-Signals" VALUE 0x8007A0F4 Val_Ws32 100000.000000 OneToOne_ms 0.00 100000.000000 FORMAT "%13.6" EXTENDED_LIMITS -2147483648.00 2147483647.00 /end CHARACTERISTIC
/begin CHARACTERISTIC EpmRRS_nEngDiffMin_C "Drehzahldifferenz fuer EpmRRS" VALUE 0x8007F66E Val_Ws16 32767.50 EngN -16384.00 16383.50 FORMAT "%8.2" /end CHARACTERISTIC
/begin CHARACTERISTIC EpmRRS_nEngMax_C "Drehzahlobergrenze fuer EpmRRS" VALUE 0x8007F670 Val_Ws16 32767.50 EngN -16384.00 16383.50 FORMAT "%8.2" /end CHARACTERISTIC
/begin CHARACTERISTIC EpmRRS_phiMax_C "maximal erlaubter Rückdrehwinkel" VALUE 0x8007F672 Val_Ws16 1440.022 AngleCrS -720.0220 720.0000 FORMAT "%8.4" /end CHARACTERISTIC
/begin CHARACTERISTIC EpmRRS_phiUndef_C "Winkel zur Rückdreh-Erkennung" VALUE 0x8007F674 Val_Ws16 1440.022 AngleCrS -720.0220 720.0000 FORMAT "%8.4" /end CHARACTERISTIC
/begin CHARACTERISTIC EpmRRS_tiTemp_CUR "maximale Zahnzeiten abhängig von der Temperatur" CURVE 0x8007F676 Cur_Xs16Ws16 65535.00 OneToOne_us -32768.00 32767.00 FORMAT "%8.2"
 /begin AXIS_DESCR STD_AXIS EngDa_tEng Temp_Cels 3 -3549.940 3003.560 FORMAT "%8.3" DEPOSIT ABSOLUTE /end AXIS_DESCR
/end CHARACTERISTIC
/begin CHARACTERISTIC EpmRRS_uDiffMax_C "Differenzspannung fuer Starter-Erkennung" VALUE 0x8007F684 Val_Ws16 1310700. Volt_Batt -655360.0 655340.0 FORMAT "%8.1" /end CHARACTERISTIC
/begin CHARACTERISTIC EpmSeq_nMaxStrtInt_C "maximale Drehzahl bei der noch ein Startinterrupt ausgelöst werden kann" VALUE 0x8007A0FE Val_Ws16 10000.00 EngN 0.00 10000.00 FORMAT "%8.2" EXTENDED_LIMITS -16384.00 16383.50 /end CHARACTERISTIC
/begin CHARACTERISTIC EpmSeq_phiIntBCr_CA "Interruptpositionen bezogen auf OT während des Notlaufs Kurbelwelle" VAL_BLK 0x8007A100 ValA_Ws16 1440.022 AngleCrS -720.0220 720.0000 FORMAT "%8.4" NUMBER 2 /end CHARACTERISTIC
/begin CHARACTERISTIC EpmSeq_phiInt_CA "Interruptpositionen bezogen auf OT" VAL_BLK 0x8007A104 ValA_Ws16 1440.022 AngleCrS -720.0220 720.0000 FORMAT "%8.4" NUMBER 2 /end CHARACTERISTIC
/begin CHARACTERISTIC EpmSeq_phiStrtInt_CA "Interruptpositionen bezogen auf OT im Start" VAL_BLK 0x8007A108 ValA_Ws16 1440.022 AngleCrS -720.0220 720.0000 FORMAT "%8.4" NUMBER 2 /end CHARACTERISTIC
/begin CHARACTERISTIC EpmSeq_phiSyncInt_C "Lage des ersten Interrupt zur Dynchronisation" VALUE 0x8007A10C Val_Ws16 1440.022 AngleCrS -720.0220 720.0000 FORMAT "%8.4" /end CHARACTERISTIC
/begin CHARACTERISTIC EpmSyn_dCaSSegMsk_C "Maskieren der gültigen Information in EpmCaS_dSegSeries_C" VALUE 0x8007A10E Val_Wu8 255.0 OneToOne 0.00 255.0 FORMAT "%5.1" /end CHARACTERISTIC
/begin CHARACTERISTIC EpmSyn_dTrigMsk_C "Triggermaske für vorlaeufige Segmenterkennung" VALUE 0x8007A10F Val_Wu8 255.0 OneToOne 0.00 255.0 FORMAT "%5.1" /end CHARACTERISTIC
/begin CHARACTERISTIC EpmSyn_dTrigRslt_C "Triggerergebnis der vorlaeufigen Segmenterkennung" VALUE 0x8007A110 Val_Wu8 255.0 OneToOne 0.00 255.0 FORMAT "%5.1" /end CHARACTERISTIC
/begin CHARACTERISTIC EpmSyn_phiTrig_C "Triggerwinkel für vorlaeufige Segmenterkennung" VALUE 0x8007A112 Val_Ws16 1440.022 AngleCrS -720.0220 720.0000 FORMAT "%8.4" /end CHARACTERISTIC
/begin CHARACTERISTIC EpmSyn_stSigTabGapVerify_C "" VALUE 0x8007A114 Val_Wu8 255.0 OneToOne 0.00 255.0 FORMAT "%5.1" /end CHARACTERISTIC
/begin CHARACTERISTIC Epm_nNoSyncVerify_C "Keine sync. Während der Überprüfung der Phasenlage" VALUE 0x80079FDE Val_Ws16 10000.00 EngN 0.00 10000.00 FORMAT "%8.2" EXTENDED_LIMITS -16384.00 16383.50 /end CHARACTERISTIC
/begin CHARACTERISTIC Epm_numCyl_C "Tatsächliche Anzahl der Zylinder" VALUE 0x80079FD2 Val_Wu8 4.000 OneToOne 0.00 4.000 FORMAT "%5.3" EXTENDED_LIMITS 0.00 255.0 /end CHARACTERISTIC
/begin CHARACTERISTIC Epm_numFireSeg_C "Zündreihenfolge" VAL_BLK 0x80079FD3 ValA_Wu8 3.000 OneToOne 1.000 4.000 FORMAT "%5.3" EXTENDED_LIMITS 0.00 255.0 NUMBER 6 /end CHARACTERISTIC
/begin CHARACTERISTIC Epm_numReSync_C "Anzehl der zulässigne Synchronisationsversuche" VALUE 0x80079FE0 Val_Wu8 100.0 OneToOne 0.00 100.0 FORMAT "%5.1" EXTENDED_LIMITS 0.00 255.0 /end CHARACTERISTIC
/begin CHARACTERISTIC Epm_phiGap2Zero_C "Winkel zwischen KW-Lücke und Nullpunkt des Winkelsystems" VALUE 0x80079FDA Val_Ws16 1440.022 AngleCrS -720.0220 720.0000 FORMAT "%8.4" /end CHARACTERISTIC
/begin CHARACTERISTIC Epm_phiTdc1_C "Winkel zwischen erstem OT und Nullpunkt des Winkelsystems" VALUE 0x80079FDC Val_Ws16 720.0000 AngleCrS 0.00 720.0000 FORMAT "%8.4" EXTENDED_LIMITS -720.0220 720.0000 /end CHARACTERISTIC
/begin CHARACTERISTIC Epm_swtBlkInjCaSSync_C "Keine Synchronisation vor der KW-Lücke" VALUE 0x80079FE1 Val_Wu8 1.000 OneToOne 0.00 1.000 FORMAT "%5.3" EXTENDED_LIMITS 0.00 255.0 /end CHARACTERISTIC
/begin CHARACTERISTIC Epm_tiSpd2Zero_C "Zeit bis Motordrehzahl Null" VALUE 0x80079FE2 Val_Wu16 655350.0 Time_ms 0.00 655350.0 FORMAT "%8.1" /end CHARACTERISTIC
/begin CHARACTERISTIC Epm_tiSpdGrdFlt_C "Filterzeit für Tiefpassfilter zur Berechnung des gefilterten Drehzahlgradienten" VALUE 0x80079FE4 Val_Ws32 998.99238550 TimeDelay_ms 1.0000000689 999.99238556 FORMAT "%12.7" EXTENDED_LIMITS 0.0020000000009 4294967.2960 /end CHARACTERISTIC
/begin CHARACTERISTIC ErrLmp_MIL.nThres_C "/" VALUE 0x8004DD44 Val_Ws16 32767.50 EngN -16384.00 16383.50 FORMAT "%8.2" /end CHARACTERISTIC
/begin CHARACTERISTIC ErrLmp_MIL.tiMax_C "/" VALUE 0x8004DD46 Val_Ws16 655350.0 Time_ms -327680.0 327670.0 FORMAT "%8.1" /end CHARACTERISTIC
/begin CHARACTERISTIC ErrLmp_MIL.tiTst_C "/" VALUE 0x8004DD48 Val_Ws16 655350.0 Time_ms -327680.0 327670.0 FORMAT "%8.1" /end CHARACTERISTIC
/begin CHARACTERISTIC ErrLmp_MIL.tiDel_C "/" VALUE 0x8004DD4A Val_Ws16 655350.0 Time_ms -327680.0 327670.0 FORMAT "%8.1" /end CHARACTERISTIC
/begin CHARACTERISTIC ErrLmp_MIL.tiBln_C "/" VALUE 0x8004DD4C Val_Ws16 655350.0 Time_ms -327680.0 327670.0 FORMAT "%8.1" /end CHARACTERISTIC
/begin CHARACTERISTIC ErrLmp_MIL.stEna_C "/" VALUE 0x8004DD4E Val_Wu8 255.0 OneToOne 0.00 255.0 FORMAT "%5.1" /end CHARACTERISTIC
/begin CHARACTERISTIC ErrLmp_MILOut.tiBtwTstSCB_C "/" VALUE 0x8004DD50 Kw_Ws16 1000.000 Time_ms 0.00 1000.000 FORMAT "%8.3" EXTENDED_LIMITS -327680.0 327670.0 /end CHARACTERISTIC
/begin CHARACTERISTIC ErrLmp_MILOut.tiBtwTstOT_C "/" VALUE 0x8004DD52 Kw_Ws16 1000.000 Time_s 0.00 1000.000 FORMAT "%8.3" EXTENDED_LIMITS -327.6800 327.6700 /end CHARACTERISTIC
/begin CHARACTERISTIC ErrLmp_MILOut.numTstMax_C "/" VALUE 0x8004DD54 Kw_Wu16 65535.00 OneToOne 0.00 65535.00 FORMAT "%8.2" /end CHARACTERISTIC
/begin CHARACTERISTIC ErrLmp_Rdy.st_C "/" VALUE 0x8004DD56 Val_Wu8 1.000 OneToOne 0.00 1.000 FORMAT "%5.3" EXTENDED_LIMITS 0.00 255.0 /end CHARACTERISTIC
/begin CHARACTERISTIC ErrLmp_Rdy.ti_C "/" VALUE 0x8004DD58 Val_Ws16 655350.0 Time_ms -327680.0 327670.0 FORMAT "%8.1" /end CHARACTERISTIC
/begin CHARACTERISTIC ErrLmp_Rdy.tiBlnOn_C "/" VALUE 0x8004DD5A Val_Ws16 655350.0 Time_ms -327680.0 327670.0 FORMAT "%8.1" /end CHARACTERISTIC
/begin CHARACTERISTIC ErrLmp_Rdy.tiBlnOff_C "/" VALUE 0x8004DD5C Val_Ws16 655350.0 Time_ms -327680.0 327670.0 FORMAT "%8.1" /end CHARACTERISTIC
/begin CHARACTERISTIC ErrLmp_stPsMILDiaDisbl_C "" VALUE 0x8004DD5E Val_Wu8 255.0 OneToOne 0.00 255.0 FORMAT "%5.1" /end CHARACTERISTIC
/begin CHARACTERISTIC ErrLmp_stPsMILDisbl_C "" VALUE 0x8004DD5F Val_Wu8 255.0 OneToOne 0.00 255.0 FORMAT "%5.1" /end CHARACTERISTIC
/begin CHARACTERISTIC ErrLmp_stPsSVSDiaDisbl_C "" VALUE 0x8004DD60 Val_Wu8 255.0 OneToOne 0.00 255.0 FORMAT "%5.1" /end CHARACTERISTIC
/begin CHARACTERISTIC ErrLmp_stPsSVSDisbl_C "" VALUE 0x8004DD61 Val_Wu8 255.0 OneToOne 0.00 255.0 FORMAT "%5.1" /end CHARACTERISTIC
/begin CHARACTERISTIC ErrLmp_SVS.nThres_C "/" VALUE 0x8004DD62 Val_Ws16 32767.50 EngN -16384.00 16383.50 FORMAT "%8.2" /end CHARACTERISTIC
/begin CHARACTERISTIC ErrLmp_SVS.tiMax_C "/" VALUE 0x8004DD64 Val_Ws16 655350.0 Time_ms -327680.0 327670.0 FORMAT "%8.1" /end CHARACTERISTIC
/begin CHARACTERISTIC ErrLmp_SVS.tiTst_C "/" VALUE 0x8004DD66 Val_Ws16 655350.0 Time_ms -327680.0 327670.0 FORMAT "%8.1" /end CHARACTERISTIC
/begin CHARACTERISTIC ErrLmp_SVS.tiDel_C "/" VALUE 0x8004DD68 Val_Ws16 655350.0 Time_ms -327680.0 327670.0 FORMAT "%8.1" /end CHARACTERISTIC
/begin CHARACTERISTIC ErrLmp_SVS.tiBln_C "/" VALUE 0x8004DD6A Val_Ws16 655350.0 Time_ms -327680.0 327670.0 FORMAT "%8.1" /end CHARACTERISTIC
/begin CHARACTERISTIC ErrLmp_SVS.stEna_C "/" VALUE 0x8004DD6C Val_Wu8 255.0 OneToOne 0.00 255.0 FORMAT "%5.1" /end CHARACTERISTIC
/begin CHARACTERISTIC ErrLmp_SVSOut.tiBtwTstSCB_C "/" VALUE 0x8004DD6E Kw_Ws16 1000.000 Time_ms 0.00 1000.000 FORMAT "%8.3" EXTENDED_LIMITS -327680.0 327670.0 /end CHARACTERISTIC
/begin CHARACTERISTIC ErrLmp_SVSOut.tiBtwTstOT_C "/" VALUE 0x8004DD70 Kw_Ws16 1000.000 Time_s 0.00 1000.000 FORMAT "%8.3" EXTENDED_LIMITS -327.6800 327.6700 /end CHARACTERISTIC
/begin CHARACTERISTIC ErrLmp_SVSOut.numTstMax_C "/" VALUE 0x8004DD72 Kw_Wu16 65535.00 OneToOne 0.00 65535.00 FORMAT "%8.2" /end CHARACTERISTIC
/begin CHARACTERISTIC ErrLmp_swtSVSEqGlwLmp_C "" VALUE 0x8004DD74 Val_Wu8 255.0 OneToOne 0.00 255.0 FORMAT "%5.1" /end CHARACTERISTIC
/begin CHARACTERISTIC ESC_dLimCond_ASD_CA "Abschrankbedingung für winkelsynchrone Berechnungen im ASD-Kontainer" VAL_BLK 0x8007A116 ValA_Wu8 255.0 OneToOne 0.00 255.0 FORMAT "%5.1" NUMBER 3 /end CHARACTERISTIC
/begin CHARACTERISTIC ESC_dLimCond_Common_CA "Abschrankbedingung für winkelsynchrone Berechnungen im Common-Kontainer" VAL_BLK 0x8007A119 ValA_Wu8 255.0 OneToOne 0.00 255.0 FORMAT "%5.1" NUMBER 3 /end CHARACTERISTIC
/begin CHARACTERISTIC ESC_dLimCond_FBC_CA "Abschrankbedingung für winkelsynchrone Berechnungen im FBC-Kontainer" VAL_BLK 0x8007A11C ValA_Wu8 255.0 OneToOne 0.00 255.0 FORMAT "%5.1" NUMBER 3 /end CHARACTERISTIC
/begin CHARACTERISTIC ESC_dLimCond_Joint_CA "Abschrankbedingung für winkelsynchrone Berechnungen im Joint-Kontainer" VAL_BLK 0x8007A11F ValA_Wu8 255.0 OneToOne 0.00 255.0 FORMAT "%5.1" NUMBER 3 /end CHARACTERISTIC
/begin CHARACTERISTIC ESC_dLimCond_LiGov_CA "Abschrankbedingung für winkelsynchrone Berechnungen im LiGoV-Kontainer" VAL_BLK 0x8007A122 ValA_Wu8 255.0 OneToOne 0.00 255.0 FORMAT "%5.1" NUMBER 3 /end CHARACTERISTIC
/begin CHARACTERISTIC ESC_dLimCond_S0_A_CA "Abschrankbedingung für winkelsynchrone Berechnungen im S0_A-Kontainer" VAL_BLK 0x8007A125 ValA_Wu8 255.0 OneToOne 0.00 255.0 FORMAT "%5.1" NUMBER 3 /end CHARACTERISTIC
/begin CHARACTERISTIC ESC_dLimCond_S0_B_CA "Abschrankbedingung für winkelsynchrone Berechnungen im S0_B-Kontainer" VAL_BLK 0x8007A128 ValA_Wu8 255.0 OneToOne 0.00 255.0 FORMAT "%5.1" NUMBER 3 /end CHARACTERISTIC
/begin CHARACTERISTIC ESC_dLimCond_S1_A_CA "Abschrankbedingung für winkelsynchrone Berechnungen im S1_A-Kontainer" VAL_BLK 0x8007A12B ValA_Wu8 255.0 OneToOne 0.00 255.0 FORMAT "%5.1" NUMBER 3 /end CHARACTERISTIC
/begin CHARACTERISTIC ESC_dLimCond_S1_B_CA "Abschrankbedingung für winkelsynchrone Berechnungen im S1_B-Kontainer" VAL_BLK 0x8007A12E ValA_Wu8 255.0 OneToOne 0.00 255.0 FORMAT "%5.1" NUMBER 3 /end CHARACTERISTIC
/begin CHARACTERISTIC ESC_dLimCond_UnitInjector_CA "Abschrankbedingung für winkelsynchrone Berechnungen im UnitInjector-Kontainer" VAL_BLK 0x8007A131 ValA_Wu8 255.0 OneToOne 0.00 255.0 FORMAT "%5.1" NUMBER 3 /end CHARACTERISTIC
/begin CHARACTERISTIC ESC_dLimCond_Update_CA "Abschrankbedingung für winkelsynchrone Berechnungen im Update-Kontainer" VAL_BLK 0x8007A134 ValA_Wu8 255.0 OneToOne 0.00 255.0 FORMAT "%5.1" NUMBER 3 /end CHARACTERISTIC
/begin CHARACTERISTIC ESC_nInjLock_C "Drehzahlgrenze ab der keine winkelsynchrone Berechnungen mehr ausgeführt werden" VALUE 0x8007A138 Val_Ws16 10000.00 EngN 0.00 10000.00 FORMAT "%8.2" EXTENDED_LIMITS -16384.00 16383.50 /end CHARACTERISTIC
/begin CHARACTERISTIC ESC_nLimInj_C "Drehzahlgrenze zum Umschalten zwischen Sx_A und Sx_B Kontainer" VALUE 0x8007A13A Val_Ws16 32767.50 EngN -16384.00 16383.50 FORMAT "%8.2" /end CHARACTERISTIC
/begin CHARACTERISTIC ESC_nLimThreshHyst_CA "Drehzahlhystereseschwelle für die Umschaltung der Abschrankbedingungen" VAL_BLK 0x8007A13C ValA_Wu16 600.0000 EngN 0.00 600.0000 FORMAT "%8.4" EXTENDED_LIMITS 0.00 32767.50 NUMBER 3 /end CHARACTERISTIC
/begin CHARACTERISTIC ESC_nLimThresh_CA "Drechzahlschwellen zur Umschaltung der Abschrankbedingungen" VAL_BLK 0x8007A142 ValA_Wu16 6000.000 EngN 0.00 6000.000 FORMAT "%8.3" EXTENDED_LIMITS 0.00 32767.50 NUMBER 3 /end CHARACTERISTIC
/begin CHARACTERISTIC ESC_numLimInj_C "Anzahl wie oft Sx_B Kontainer aktiviert wird, bevor wieder Sx_A Kontainer aktiviert wird" VALUE 0x8007A148 Val_Wu8 9.000 OneToOne 1.000 10.00 FORMAT "%5.2" EXTENDED_LIMITS 0.00 255.0 /end CHARACTERISTIC
/begin CHARACTERISTIC ESC_stS1FrstSched_C "Winkelsynchrones Scheduling beginnt immer mit einem S1Task (Berechnung der PILOT Injections)" VALUE 0x8007A14A Val_Wu8 1.000 OneToOne 0.00 1.000 FORMAT "%5.3" EXTENDED_LIMITS 0.00 255.0 /end CHARACTERISTIC
/begin CHARACTERISTIC ETClb_CorActv.xVal_C "SW-Schalter zur Aktivierung der Ansteuerdauerkorrektur der Nullmengenkalibrierung/" VALUE 0x8004BB9C Kw_Wu8 1.000 OneToOne 0.00 1.000 FORMAT "%5.3" EXTENDED_LIMITS 0.00 255.0 /end CHARACTERISTIC
/begin CHARACTERISTIC ETClb_CorActv.xTyp_C "SW-Schalter zur Aktivierung der Ansteuerdauerkorrektur der Nullmengenkalibrierung/" VALUE 0x8004BB9D Kw_Wu8 2.000 OneToOne 0.00 2.000 FORMAT "%5.3" EXTENDED_LIMITS 0.00 255.0 /end CHARACTERISTIC
/begin CHARACTERISTIC ETClb_ctDflLrnAllw_CA "Defaultwert für die Zahl der erlaubten Kalibrierzyklen pro Raildruckkalibrierpunkt" VAL_BLK 0x8004BBD8 ValA_Wu8 255.0 OneToOne 0.00 255.0 FORMAT "%5.1" NUMBER 2 /end CHARACTERISTIC
/begin CHARACTERISTIC ETClb_ctDflLrn_CA "Defaultwerte für die applikative Änderung der Lernzykluszähler der Ansteuerdauerkalibrierung für die ZFC" VAL_BLK 0x8004BBDA ValA_Wu16 65535.00 OneToOne 0.00 65535.00 FORMAT "%8.2" NUMBER 2 /end CHARACTERISTIC
/begin CHARACTERISTIC ETClb_ctLrnPerDelta_C "Anzahl der freigegebenen Lernzyklen pro Streckenintervall" VALUE 0x8004BBDE Val_Wu8 254.0 OneToOne 1.000 255.0 FORMAT "%5.1" EXTENDED_LIMITS 0.00 255.0 /end CHARACTERISTIC
/begin CHARACTERISTIC ETClb_ctLrnThresQck_C "Anzahl der Lernzyklen für die Freigabe der Ansteuerdauerkorrektur durch die Ansteuerdauerkalibrierung bei Schnellkalibrierung" VALUE 0x8004BB9E Val_Wu16 65535.00 OneToOne 0.00 65535.00 FORMAT "%8.2" /end CHARACTERISTIC
/begin CHARACTERISTIC ETClb_ctLrnThresRC_C "Anzahl der Lernzyklen für die Freigabe der Ansteuerdauerkorrektur bei Rollenprüfstands-Kalibrierung" VALUE 0x8004BBA0 Val_Wu16 10.00000 OneToOne 0.00 10.00000 FORMAT "%8.5" EXTENDED_LIMITS 0.00 65535.00 /end CHARACTERISTIC
/begin CHARACTERISTIC ETClb_ctLrnThres_C "Anzahl der Lernzyklen für die Freigabe der Ansteuerdauerkorrektur durch die Ansteuerdauerkalibrierung" VALUE 0x8004BBA2 Val_Wu16 65535.00 OneToOne 0.00 65535.00 FORMAT "%8.2" /end CHARACTERISTIC
/begin CHARACTERISTIC ETClb_dpRailLim_CA "Raildruck-Kalibrierpunkt abhängige max. Abweichung des Raildrucks für die Nullmengenkalibrierung" VAL_BLK 0x8004BBA4 ValA_Ws16 2000.000 Pres_Rail 0.00 2000.000 FORMAT "%5.3" EXTENDED_LIMITS -3276.800 3276.700 NUMBER 2 /end CHARACTERISTIC
/begin CHARACTERISTIC ETClb_dtiDflETFlt0_CA "Defaultwerte für die gefilterte Ansteuerdauerdifferenz der Ansteuerdauerkalibrierung für den Raildruck-Kalibrierpunkt 0" VAL_BLK 0x8004BBE0 ValA_Ws16 5200.000 InjTime_us -200.0000 5000.000 FORMAT "%8.3" EXTENDED_LIMITS -13107.20 13106.80 NUMBER 6 /end CHARACTERISTIC
/begin CHARACTERISTIC ETClb_dtiDflETFlt1_CA "Defaultwerte für die gefilterte Ansteuerdauerdifferenz der Ansteuerdauerkalibrierung für den Raildruck-Kalibrierpunkt 1" VAL_BLK 0x8004BBEC ValA_Ws16 5200.000 InjTime_us -200.0000 5000.000 FORMAT "%8.3" EXTENDED_LIMITS -13107.20 13106.80 NUMBER 6 /end CHARACTERISTIC
/begin CHARACTERISTIC ETClb_dtiDflETFlt2_CA "" VAL_BLK 0x8004BBF8 ValA_Ws16 5200.000 InjTime_us -200.0000 5000.000 FORMAT "%8.3" EXTENDED_LIMITS -13107.20 13106.80 NUMBER 6 /end CHARACTERISTIC
/begin CHARACTERISTIC ETClb_dtiDflETFlt3_CA "" VAL_BLK 0x8004BC04 ValA_Ws16 5200.000 InjTime_us -200.0000 5000.000 FORMAT "%8.3" EXTENDED_LIMITS -13107.20 13106.80 NUMBER 6 /end CHARACTERISTIC
/begin CHARACTERISTIC ETClb_dtiDflETFlt4_CA "" VAL_BLK 0x8004BC10 ValA_Ws16 5200.000 InjTime_us -200.0000 5000.000 FORMAT "%8.3" EXTENDED_LIMITS -13107.20 13106.80 NUMBER 6 /end CHARACTERISTIC
/begin CHARACTERISTIC ETClb_dtiDflETFlt5_CA "" VAL_BLK 0x8004BC1C ValA_Ws16 5200.000 InjTime_us -200.0000 5000.000 FORMAT "%8.3" EXTENDED_LIMITS -13107.20 13106.80 NUMBER 6 /end CHARACTERISTIC
/begin CHARACTERISTIC ETClb_dtiDflETFlt6_CA "" VAL_BLK 0x8004BC28 ValA_Ws16 5200.000 InjTime_us -200.0000 5000.000 FORMAT "%8.3" EXTENDED_LIMITS -13107.20 13106.80 NUMBER 6 /end CHARACTERISTIC
/begin CHARACTERISTIC ETClb_facFltQck_C "Filterkonstante für die Ansteuerdauerdifferenz der Ansteuerdauerkalibrierung bei Schnellkalibrierung" VALUE 0x8004BBA8 Val_Wu16 1.000000 Fact 0.00 1.000000 FORMAT "%8.6" EXTENDED_LIMITS 0.00 7.999878 /end CHARACTERISTIC
/begin CHARACTERISTIC ETClb_facFltRC_C "Filterkonstante für die Ansteuerdauerdifferenz der Ansteuerdauerkalibrierung bei Rollenprüfstands-Kalibrierung" VALUE 0x8004BBAA Val_Wu16 1.000000 Fact 0.00 1.000000 FORMAT "%8.6" EXTENDED_LIMITS 0.00 7.999878 /end CHARACTERISTIC
/begin CHARACTERISTIC ETClb_facFlt_C "Filterkonstante für die Ansteuerdauerdifferenz der Ansteuerdauerkalibrierung" VALUE 0x8004BBAC Val_Wu16 1.000000 Fact 0.00 1.000000 FORMAT "%8.6" EXTENDED_LIMITS 0.00 7.999878 /end CHARACTERISTIC
/begin CHARACTERISTIC ETClb_lDelta_C "Toleranz beim Streckenvergleich für Begrenzung der Lernhäufigkeit" VALUE 0x8004BC34 Val_Wu16 990.0000 Length 10.00000 1000.000 FORMAT "%8.3" EXTENDED_LIMITS 0.00 65535.00 /end CHARACTERISTIC
/begin CHARACTERISTIC ETClb_lLrnDelta_C "Länge des Streckenintervalls zur Begrenzung der Lernhäufigkeit" VALUE 0x8004BC38 Val_Wu32 19872000.0000 Length 128000.000000 20000000.0000 FORMAT "%13.4" EXTENDED_LIMITS 0.00 4294967295.00 /end CHARACTERISTIC
/begin CHARACTERISTIC ETClb_numCyclMeas_C "Anzahl der Einspritzzyklen für die Messung der Ansteuerdauerkalibrierung" VALUE 0x8004BBAE Val_Wu16 65535.00 OneToOne 0.00 65535.00 FORMAT "%8.2" /end CHARACTERISTIC
/begin CHARACTERISTIC ETClb_numCyclNoDyn_C "Anzahl der Einspritzzyklen bis die Ansteuerdauerkalibrierung den maximalen Drehzahlanstieg prüft" VALUE 0x8004BBB0 Val_Wu16 65535.00 OneToOne 0.00 65535.00 FORMAT "%8.2" /end CHARACTERISTIC
/begin CHARACTERISTIC ETClb_numCyclStartEnergize_C "Anzahl der Einspritzzyklen bis die Ansteuerdauerkalibrierung für die Messung eingeschwungen ist" VALUE 0x8004BBB2 Val_Wu16 65535.00 OneToOne 0.00 65535.00 FORMAT "%8.2" /end CHARACTERISTIC
/begin CHARACTERISTIC ETClb_numDflCylCur_CA "Testwerte für die aktuellen Zylinder der Ansteuerdauerkalibrierung für jeden Raildruck-Kalibrierpunkt" VAL_BLK 0x8004BC3C ValA_Wu8 5.000 OneToOne 1.000 6.000 FORMAT "%5.3" EXTENDED_LIMITS 0.00 255.0 NUMBER 2 /end CHARACTERISTIC
/begin CHARACTERISTIC ETClb_pRailSet_CA "Raildruck-Kalibrierpunkte für die Ansteuerdauerkalibrierung" VAL_BLK 0x8004BBB4 ValA_Ws16 2000.000 Pres_Rail 0.00 2000.000 FORMAT "%5.3" EXTENDED_LIMITS -3276.800 3276.700 NUMBER 2 /end CHARACTERISTIC
/begin CHARACTERISTIC ETClb_SigThres_CA "Raildurck-Kalibrierpunkt abhängige Signalschwelle der Nullmengenkalibrierung" VAL_BLK 0x8004BBB8 ValA_Ws16 200.0000 OneToOne 0.00 200.0000 FORMAT "%8.4" EXTENDED_LIMITS -32768.00 32767.00 NUMBER 2 /end CHARACTERISTIC
/begin CHARACTERISTIC ETClb_stRlsCylCorDfl_C "Defaultwert für die zylinderspezifische Korrekturfreigabe" VALUE 0x8004BC3E Val_Wu8 255.0 OneToOne 0.00 255.0 FORMAT "%5.1" /end CHARACTERISTIC
/begin CHARACTERISTIC ETClb_swtDflLimClbFrq_C "Schalter zum Schreiben der Defaultwerte für Funktion Begrenzung der Lernhäufigkeit" VALUE 0x8004BC3F Val_Wu8 1.000 OneToOne 0.00 1.000 FORMAT "%5.3" EXTENDED_LIMITS 0.00 255.0 /end CHARACTERISTIC
/begin CHARACTERISTIC ETClb_swtDflQckClb_C "Testwert zum Umschalten auf Schnellkalibrierung der Ansteuerdauerkalibrierung" VALUE 0x8004BC40 Val_Wu8 1.000 OneToOne 0.00 1.000 FORMAT "%5.3" EXTENDED_LIMITS 0.00 255.0 /end CHARACTERISTIC
/begin CHARACTERISTIC ETClb_swtLimClbFrqOff_C "Schalter zum Abschalten der Begrenzung der Lernhäufigkeit (1=ausgeschaltet)" VALUE 0x8004BC41 Val_Wu8 1.000 OneToOne 0.00 1.000 FORMAT "%5.3" EXTENDED_LIMITS 0.00 255.0 /end CHARACTERISTIC
/begin CHARACTERISTIC ETClb_swtWrDflVal_C "Aktivierung zum Schreiben der Testwerte für die Ansteuerdauerkalibrierung bei Wechsel von 0 nach 1" VALUE 0x8004BBBC Val_Wu8 1.000 OneToOne 0.00 1.000 FORMAT "%5.3" EXTENDED_LIMITS 0.00 255.0 /end CHARACTERISTIC
/begin CHARACTERISTIC ETClb_tiDflETCur_CA "Testwert der aktuellen Ansteuerdauer für die Ansteuerdauerkalibrierung bei jedem Raildruck-Kalibrierpunkt" VAL_BLK 0x8004BC42 ValA_Ws16 4850.000 InjTime_us 150.0000 5000.000 FORMAT "%8.3" EXTENDED_LIMITS -13107.20 13106.80 NUMBER 2 /end CHARACTERISTIC
/begin CHARACTERISTIC ETClb_tiETOfs_CA "Offset der max. gefilterten Ansteuerdauer zur max. Ansteuerdauer für jeden Raildruck-Kalibrierpunkt" VAL_BLK 0x8004BC46 ValA_Ws16 5000.0000 InjTime_us 0.00 5000.0000 FORMAT "%8.4" EXTENDED_LIMITS -13107.20 13106.80 NUMBER 2 /end CHARACTERISTIC
/begin CHARACTERISTIC ETClb_tiETStep_CA "Schrittweite der Ansteuerdauer für die Anhebung oder Senkung der Ansteuerdauer von der Ansteuerdauer-Kalibrierung" VAL_BLK 0x8004BBCA ValA_Ws16 5000.000 InjTime_us 0.00 5000.000 FORMAT "%8.3" EXTENDED_LIMITS -13107.20 13106.80 NUMBER 2 /end CHARACTERISTIC
/begin CHARACTERISTIC ETClb_tiET_MAX_CA "Maximale Ansteuerdauer der Einspritzungen für die Ansteuerdauerkalibrierung für jeden Raildruck-Kalibirierpunkt" VAL_BLK 0x8004BBCE ValA_Ws16 5000.00 InjTime_us 0.00 5000.00 FORMAT "%8.2" EXTENDED_LIMITS -13107.20 13106.80 NUMBER 2 /end CHARACTERISTIC
/begin CHARACTERISTIC ETClb_tiET_MIN_CA "Minimale Ansteuerdauer der Einspritzungen für die Ansteuerdauerkalibrierung für jeden Raildruck-Kalibirierpunkt" VAL_BLK 0x8004BBD2 ValA_Ws16 5000.00 InjTime_us 0.00 5000.00 FORMAT "%8.2" EXTENDED_LIMITS -13107.20 13106.80 NUMBER 2 /end CHARACTERISTIC
/begin CHARACTERISTIC ETClb_volEffectiveMin_CA "Menge der Wirkgrenze für die Ansteuerdauerkalibrierung" VAL_BLK 0x8004BBBE ValA_Ws16 100.0000 InjQntInj 0.00 100.0000 FORMAT "%8.4" EXTENDED_LIMITS -327.6800 327.6700 NUMBER 2 /end CHARACTERISTIC
/begin CHARACTERISTIC ETClb_vStartClb_CA "Minimale Fahrzeuggeschwindigkeit zum Starten der Ansteuerdauerkalibrierung bei jedem Raildruck-Kalibrierpunkt" VAL_BLK 0x8004BBC2 ValA_Ws16 200.0000 Vel 0.00 200.0000 FORMAT "%8.4" EXTENDED_LIMITS -327.6800 327.6700 NUMBER 2 /end CHARACTERISTIC
/begin CHARACTERISTIC ETClb_vStopClb_CA "Minimale Fahrzeuggeschwindigkeit der Ansteuerdauerkalibrierung bei jedem Raildruck-Kalibrierpunkt" VAL_BLK 0x8004BBC6 ValA_Ws16 200.0000 Vel 0.00 200.0000 FORMAT "%8.4" EXTENDED_LIMITS -327.6800 327.6700 NUMBER 2 /end CHARACTERISTIC
/begin CHARACTERISTIC ETCtl_DebPoI.tiHiLo_C "Entprellzeit für Nacheinspritzung/" VALUE 0x8004C7E0 Kw_Ws16 655.3500 Time_s -327.6800 327.6700 FORMAT "%8.4" /end CHARACTERISTIC
/begin CHARACTERISTIC ETCtl_DebPoI.tiLoHi_C "Entprellzeit für Nacheinspritzung/" VALUE 0x8004C7E2 Kw_Ws16 655.3500 Time_s -327.6800 327.6700 FORMAT "%8.4" /end CHARACTERISTIC
/begin CHARACTERISTIC ETCtl_DebTemp.tiHiLo_C "Entprellzeit der Aktivierungsschwellen der Regelkreisen/" VALUE 0x8004C7E4 Kw_Ws16 30.00000 Time_s 0.00 30.00000 FORMAT "%8.5" EXTENDED_LIMITS -327.6800 327.6700 /end CHARACTERISTIC
/begin CHARACTERISTIC ETCtl_DebTemp.tiLoHi_C "Entprellzeit der Aktivierungsschwellen der Regelkreisen/" VALUE 0x8004C7E6 Kw_Ws16 30.00000 Time_s 0.00 30.00000 FORMAT "%8.5" EXTENDED_LIMITS -327.6800 327.6700 /end CHARACTERISTIC
/begin CHARACTERISTIC ETCtl_facKiAirMsPT_CUR "Grundwert I-Anteil des Reglereingriffs über Luftmasse" CURVE 0x8004BC50 Cur_Xs16Ws16 0.06000046 ETCtlGovKi_fac 0.00 0.06000046 FORMAT "%10.8" EXTENDED_LIMITS -0.07629395 0.07629162
 /begin AXIS_DESCR STD_AXIS Epm_nEng EngN 8 0.00 6000.000 FORMAT "%8.3" EXTENDED_LIMITS -16384.00 16383.50 DEPOSIT ABSOLUTE /end AXIS_DESCR
/end CHARACTERISTIC
/begin CHARACTERISTIC ETCtl_facKiNegInr_C "Korrekturfaktor des I-Anteil bei negativer Großsignalverstärkung - Innerer Regelkreis" VALUE 0x8004BC74 Val_Wu32 100.000000000 Fact1 0.00 100.000000000 FORMAT "%13.9" EXTENDED_LIMITS 0.00 33554431.9922 /end CHARACTERISTIC
/begin CHARACTERISTIC ETCtl_facKiNegOutr_C "Korrekturfaktor des I-Anteil bei negativer Großsignalverstärkung - Äußerer Regelkreis" VALUE 0x8004C810 Val_Wu32 100.000000000 Fact1 0.00 100.000000000 FORMAT "%13.9" EXTENDED_LIMITS 0.00 33554431.9922 /end CHARACTERISTIC
/begin CHARACTERISTIC ETCtl_facKiPosInr_C "Korrekturfaktor des I-Anteil bei positiver Großsignalverstärkung - Innerer Regelkreis" VALUE 0x8004BC78 Val_Wu32 100.000000000 Fact1 0.00 100.000000000 FORMAT "%13.9" EXTENDED_LIMITS 0.00 33554431.9922 /end CHARACTERISTIC
/begin CHARACTERISTIC ETCtl_facKiPosOutr_C "Korrekturfaktor des I-Anteil bei positiver Großsignalverstärkung - Äußerer Regelkreis" VALUE 0x8004C814 Val_Wu32 100.000000000 Fact1 0.00 100.000000000 FORMAT "%13.9" EXTENDED_LIMITS 0.00 33554431.9922 /end CHARACTERISTIC
/begin CHARACTERISTIC ETCtl_facKiQntPoI1_MAP "Grundwert I-Anteil des äußeren Regelkreises bei Eingriff über Einspritzung" MAP 0x8004C818 Map_Xs16Ys16Ws16 0.06000046 ETCtlGovKi_fac 0.00 0.06000046 FORMAT "%10.8" EXTENDED_LIMITS -0.07629395 0.07629162
 /begin AXIS_DESCR STD_AXIS Epm_nEng EngN 8 0.00 6000.000 FORMAT "%8.3" EXTENDED_LIMITS -16384.00 16383.50 DEPOSIT ABSOLUTE /end AXIS_DESCR
 /begin AXIS_DESCR STD_AXIS InjCtl_qSetUnBal InjMass 8 0.00 327.6700 FORMAT "%8.4" EXTENDED_LIMITS -327.6800 327.6700 DEPOSIT ABSOLUTE /end AXIS_DESCR
/end CHARACTERISTIC
/begin CHARACTERISTIC ETCtl_facKiQntPoI2_MAP "Grundwert I-Anteil des inneren Regelkreises bei Eingriff über Einspritzung" MAP 0x8004BC7C Map_Xs16Ys16Ws16 0.06000046 ETCtlGovKi_fac 0.00 0.06000046 FORMAT "%10.8" EXTENDED_LIMITS -0.07629395 0.07629162
 /begin AXIS_DESCR STD_AXIS Epm_nEng EngN 8 0.00 6000.000 FORMAT "%8.3" EXTENDED_LIMITS -16384.00 16383.50 DEPOSIT ABSOLUTE /end AXIS_DESCR
 /begin AXIS_DESCR STD_AXIS InjCtl_qSetUnBal InjMass 8 0.00 327.6700 FORMAT "%8.4" EXTENDED_LIMITS -327.6800 327.6700 DEPOSIT ABSOLUTE /end AXIS_DESCR
/end CHARACTERISTIC
/begin CHARACTERISTIC ETCtl_facKiTempInrCor_MAP "Grundwert I-Anteil des äußeren Regelkreises bei Eingriff über Temperatursollwert des inneren Regelkreises" MAP 0x8004C8BC Map_Xs16Ys16Ws16 0.06000046 ETCtlGovKi_fac 0.00 0.06000046 FORMAT "%10.8" EXTENDED_LIMITS -0.07629395 0.07629162
 /begin AXIS_DESCR STD_AXIS Epm_nEng EngN 8 0.00 6000.000 FORMAT "%8.3" EXTENDED_LIMITS -16384.00 16383.50 DEPOSIT ABSOLUTE /end AXIS_DESCR
 /begin AXIS_DESCR STD_AXIS InjCtl_qSetUnBal InjMass 8 0.00 327.6700 FORMAT "%8.4" EXTENDED_LIMITS -327.6800 327.6700 DEPOSIT ABSOLUTE /end AXIS_DESCR
/end CHARACTERISTIC
/begin CHARACTERISTIC ETCtl_facKpAirMsPT_CUR "Grundwert P-Anteil des Reglereingriffs über Luftmasse" CURVE 0x8004BD20 Cur_Xs16Ws16 0.06000000 ETCtlGovKp_fac 0.00 0.06000000 FORMAT "%10.8" EXTENDED_LIMITS -1.280000 1.279961
 /begin AXIS_DESCR STD_AXIS Epm_nEng EngN 8 0.00 6000.000 FORMAT "%8.3" EXTENDED_LIMITS -16384.00 16383.50 DEPOSIT ABSOLUTE /end AXIS_DESCR
/end CHARACTERISTIC
/begin CHARACTERISTIC ETCtl_facKpNegInr_C "Korrekturfaktor des P-Anteil bei negativer Großsignalverstärkung - Innerer Regelkreis" VALUE 0x8004BD44 Val_Ws32 4.00000000000 Fact1 0.00 4.00000000000 FORMAT "%13.11" EXTENDED_LIMITS -16777216.0000 16777215.9922 /end CHARACTERISTIC
/begin CHARACTERISTIC ETCtl_facKpNegOutr_C "Korrekturfaktor des P-Anteil bei negativer Großsignalverstärkung - Äußerer Regelkreis" VALUE 0x8004C960 Val_Ws32 4.00000000000 Fact1 0.00 4.00000000000 FORMAT "%13.11" EXTENDED_LIMITS -16777216.0000 16777215.9922 /end CHARACTERISTIC
/begin CHARACTERISTIC ETCtl_facKpPosInr_C "Korrekturfaktor des P-Anteil bei positiver Großsignalverstärkung - Innerer Regelkreis" VALUE 0x8004BD48 Val_Ws32 4.00000000000 Fact1 0.00 4.00000000000 FORMAT "%13.11" EXTENDED_LIMITS -16777216.0000 16777215.9922 /end CHARACTERISTIC
/begin CHARACTERISTIC ETCtl_facKpPosOutr_C "Korrekturfaktor des P-Anteil bei positiver Großsignalverstärkung - Äußerer Regelkreis" VALUE 0x8004C964 Val_Ws32 4.00000000000 Fact1 0.00 4.00000000000 FORMAT "%13.11" EXTENDED_LIMITS -16777216.0000 16777215.9922 /end CHARACTERISTIC
/begin CHARACTERISTIC ETCtl_facKpQntPoI1_MAP "Grundwert P-Anteil des äußeren Regelkreises bei Eingriff über Einspritzung" MAP 0x8004C968 Map_Xs16Ys16Ws16 0.06000000 ETCtlGovKp_fac 0.00 0.06000000 FORMAT "%10.8" EXTENDED_LIMITS -1.280000 1.279961
 /begin AXIS_DESCR STD_AXIS Epm_nEng EngN 8 0.00 6000.000 FORMAT "%8.3" EXTENDED_LIMITS -16384.00 16383.50 DEPOSIT ABSOLUTE /end AXIS_DESCR
 /begin AXIS_DESCR STD_AXIS InjCtl_qSetUnBal InjMass 8 0.00 327.6700 FORMAT "%8.4" EXTENDED_LIMITS -327.6800 327.6700 DEPOSIT ABSOLUTE /end AXIS_DESCR
/end CHARACTERISTIC
/begin CHARACTERISTIC ETCtl_facKpQntPoI2_MAP "Grundwert P-Anteil des inneren Regelkreises bei Eingriff über Einspritzung" MAP 0x8004BD4C Map_Xs16Ys16Ws16 0.06000000 ETCtlGovKp_fac 0.00 0.06000000 FORMAT "%10.8" EXTENDED_LIMITS -1.280000 1.279961
 /begin AXIS_DESCR STD_AXIS Epm_nEng EngN 8 0.00 6000.000 FORMAT "%8.3" EXTENDED_LIMITS -16384.00 16383.50 DEPOSIT ABSOLUTE /end AXIS_DESCR
 /begin AXIS_DESCR STD_AXIS InjCtl_qSetUnBal InjMass 8 0.00 327.6700 FORMAT "%8.4" EXTENDED_LIMITS -327.6800 327.6700 DEPOSIT ABSOLUTE /end AXIS_DESCR
/end CHARACTERISTIC
/begin CHARACTERISTIC ETCtl_facKpTempInrCor_MAP "Grundwert P-Anteil des äußeren Regelkreises bei Eingriff über Temperatursollwert des inneren Regelkreises" MAP 0x8004CA0C Map_Xs16Ys16Ws16 0.06000000 ETCtlGovKp_fac 0.00 0.06000000 FORMAT "%10.8" EXTENDED_LIMITS -1.280000 1.279961
 /begin AXIS_DESCR STD_AXIS Epm_nEng EngN 8 0.00 6000.000 FORMAT "%8.3" EXTENDED_LIMITS -16384.00 16383.50 DEPOSIT ABSOLUTE /end AXIS_DESCR
 /begin AXIS_DESCR STD_AXIS InjCtl_qSetUnBal InjMass 8 0.00 327.6700 FORMAT "%8.4" EXTENDED_LIMITS -327.6800 327.6700 DEPOSIT ABSOLUTE /end AXIS_DESCR
/end CHARACTERISTIC
/begin CHARACTERISTIC ETCtl_facPoI2PoI1Dist_C "Anteil der vom inneren Regelkreis geforderten Menge die auf die PoI2 entfällt." VALUE 0x8004BDF0 Val_Ws16 1.000000 ETCtlGov_p0q001 0.00 1.000000 FORMAT "%8.6" EXTENDED_LIMITS -32.76800 32.76700 /end CHARACTERISTIC
/begin CHARACTERISTIC ETCtl_mAirLam_CUR "Luftmassenkorrektur über Lambdawert" CURVE 0x8004BDF2 Cur_Xs16Ws16 10000.00 AirMassPerCyl -5000.000 5000.000 FORMAT "%8.3" EXTENDED_LIMITS -3276.800 3276.700
 /begin AXIS_DESCR STD_AXIS ETCtl_rLamRecExhMnfDs_mp AirMassPerCyl 8 0.00 4.000000 FORMAT "%8.6" EXTENDED_LIMITS -3276.800 3276.700 DEPOSIT ABSOLUTE /end AXIS_DESCR
/end CHARACTERISTIC
/begin CHARACTERISTIC ETCtl_mAirMax_MAP "Maximal mögliche Luftmassensollwertkorrektur" MAP 0x8004BE14 Map_Xs16Ys16Ws16 5000.000 AirMassPerCyl 0.00 5000.000 FORMAT "%8.3" EXTENDED_LIMITS -3276.800 3276.700
 /begin AXIS_DESCR STD_AXIS Epm_nEng EngN 16 0.00 6000.000 FORMAT "%8.3" EXTENDED_LIMITS -16384.00 16383.50 DEPOSIT ABSOLUTE /end AXIS_DESCR
 /begin AXIS_DESCR STD_AXIS InjCtl_qSetUnBal InjMass 16 0.00 327.6700 FORMAT "%8.4" EXTENDED_LIMITS -327.6800 327.6700 DEPOSIT ABSOLUTE /end AXIS_DESCR
/end CHARACTERISTIC
/begin CHARACTERISTIC ETCtl_mAirMin_MAP "Minimal mögliche Luftmassensollwertkorrektur" MAP 0x8004C058 Map_Xs16Ys16Ws16 5000.000 AirMassPerCyl -5000.000 0.00 FORMAT "%8.3" EXTENDED_LIMITS -3276.800 3276.700
 /begin AXIS_DESCR STD_AXIS Epm_nEng EngN 16 0.00 6000.000 FORMAT "%8.3" EXTENDED_LIMITS -16384.00 16383.50 DEPOSIT ABSOLUTE /end AXIS_DESCR
 /begin AXIS_DESCR STD_AXIS InjCtl_qSetUnBal InjMass 16 0.00 327.6700 FORMAT "%8.4" EXTENDED_LIMITS -327.6800 327.6700 DEPOSIT ABSOLUTE /end AXIS_DESCR
/end CHARACTERISTIC
/begin CHARACTERISTIC ETCtl_mAirThresOff_C "Abschaltschwelle für Luftmassen-Eingriff" VALUE 0x8004C29C Val_Ws16 5000.000 AirMassPerCyl 0.00 5000.000 FORMAT "%8.3" EXTENDED_LIMITS -3276.800 3276.700 /end CHARACTERISTIC
/begin CHARACTERISTIC ETCtl_numTempSensOutrLp_C "" VALUE 0x8004CAB0 Val_Wu8 8.000 OneToOne 0.00 8.000 FORMAT "%5.3" EXTENDED_LIMITS 0.00 255.0 /end CHARACTERISTIC
/begin CHARACTERISTIC ETCtl_phiPoI1Cor_MAP "Additive Korrektur des Winkels der späten Nacheinspritzung" MAP 0x8004CAB2 Map_Xs16Ys16Ws16 400.0024 AngleCrS -200.0012 200.0012 FORMAT "%8.4" EXTENDED_LIMITS -720.0220 720.0000
 /begin AXIS_DESCR STD_AXIS Epm_nEng EngN 8 0.00 6000.000 FORMAT "%8.3" EXTENDED_LIMITS -16384.00 16383.50 DEPOSIT ABSOLUTE /end AXIS_DESCR
 /begin AXIS_DESCR STD_AXIS InjCtl_qSetUnBal InjMass 8 0.00 327.6700 FORMAT "%8.4" EXTENDED_LIMITS -327.6800 327.6700 DEPOSIT ABSOLUTE /end AXIS_DESCR
/end CHARACTERISTIC
/begin CHARACTERISTIC ETCtl_phiPoI2Cor_MAP "Additive Korrektur des Winkels der angelagerten Nacheinspritzung" MAP 0x8004C29E Map_Xs16Ys16Ws16 400.0024 AngleCrS -200.0012 200.0012 FORMAT "%8.4" EXTENDED_LIMITS -720.0220 720.0000
 /begin AXIS_DESCR STD_AXIS Epm_nEng EngN 8 0.00 6000.000 FORMAT "%8.3" EXTENDED_LIMITS -16384.00 16383.50 DEPOSIT ABSOLUTE /end AXIS_DESCR
 /begin AXIS_DESCR STD_AXIS InjCtl_qSetUnBal InjMass 8 0.00 327.6700 FORMAT "%8.4" EXTENDED_LIMITS -327.6800 327.6700 DEPOSIT ABSOLUTE /end AXIS_DESCR
/end CHARACTERISTIC
/begin CHARACTERISTIC ETCtl_qPoI1Max_MAP "Maximal mögliche Korrektur der angelagerten Nacheinspritzung" MAP 0x8004CB56 Map_Xs16Ys16Ws16 200.0000 InjMassInj 0.00 200.0000 FORMAT "%8.4" EXTENDED_LIMITS -327.6800 327.6700
 /begin AXIS_DESCR STD_AXIS Epm_nEng EngN 16 0.00 6000.000 FORMAT "%8.3" EXTENDED_LIMITS -16384.00 16383.50 DEPOSIT ABSOLUTE /end AXIS_DESCR
 /begin AXIS_DESCR STD_AXIS InjCtl_qSetUnBal InjMass 16 0.00 327.6700 FORMAT "%8.4" EXTENDED_LIMITS -327.6800 327.6700 DEPOSIT ABSOLUTE /end AXIS_DESCR
/end CHARACTERISTIC
/begin CHARACTERISTIC ETCtl_qPoI1Min_C "Minimalwert der angelagerten Nacheinspritzung" VALUE 0x8004CD9A Val_Ws16 327.6700 InjMassInj 0.00 327.6700 FORMAT "%8.4" EXTENDED_LIMITS -327.6800 327.6700 /end CHARACTERISTIC
/begin CHARACTERISTIC ETCtl_qPoI1Min_MAP "Minimal mögliche Korrektur der angelagerten Nacheinspritzung" MAP 0x8004CD9C Map_Xs16Ys16Ws16 655.3500 InjMassInj -327.6800 327.6700 FORMAT "%8.4"
 /begin AXIS_DESCR STD_AXIS Epm_nEng EngN 16 -16384.00 16383.50 FORMAT "%8.2" DEPOSIT ABSOLUTE /end AXIS_DESCR
 /begin AXIS_DESCR STD_AXIS InjCtl_qSetUnBal InjMass 16 -327.6800 327.6700 FORMAT "%8.4" DEPOSIT ABSOLUTE /end AXIS_DESCR
/end CHARACTERISTIC
/begin CHARACTERISTIC ETCtl_qPoI1ThresOff_C "Abschaltschwelle für PoI1-Eingriff" VALUE 0x8004CFE0 Val_Ws16 327.6700 InjMassInj 0.00 327.6700 FORMAT "%8.4" EXTENDED_LIMITS -327.6800 327.6700 /end CHARACTERISTIC
/begin CHARACTERISTIC ETCtl_qPoI2Max_MAP "Maximal mögliche Korrektur der späten Nacheinspritzung" MAP 0x8004C342 Map_Xs16Ys16Ws16 200.0000 InjMassInj 0.00 200.0000 FORMAT "%8.4" EXTENDED_LIMITS -327.6800 327.6700
 /begin AXIS_DESCR STD_AXIS Epm_nEng EngN 16 0.00 6000.000 FORMAT "%8.3" EXTENDED_LIMITS -16384.00 16383.50 DEPOSIT ABSOLUTE /end AXIS_DESCR
 /begin AXIS_DESCR STD_AXIS InjCtl_qSetUnBal InjMass 16 0.00 327.6700 FORMAT "%8.4" EXTENDED_LIMITS -327.6800 327.6700 DEPOSIT ABSOLUTE /end AXIS_DESCR
/end CHARACTERISTIC
/begin CHARACTERISTIC ETCtl_qPoI2Min_C "Untere Grenze des Basiswertkennfelds für abgastemperaturreglerbedingte Korrektur der PoI2-Menge" VALUE 0x8004C586 Val_Ws16 327.6700 InjMassInj 0.00 327.6700 FORMAT "%8.4" EXTENDED_LIMITS -327.6800 327.6700 /end CHARACTERISTIC
/begin CHARACTERISTIC ETCtl_qPoI2Min_MAP "Minimal mögliche Korrektur der späten Nacheinspritzung" MAP 0x8004C588 Map_Xs16Ys16Ws16 200.0000 InjMassInj -200.0000 0.00 FORMAT "%8.4" EXTENDED_LIMITS -327.6800 327.6700
 /begin AXIS_DESCR STD_AXIS Epm_nEng EngN 16 0.00 6000.000 FORMAT "%8.3" EXTENDED_LIMITS -16384.00 16383.50 DEPOSIT ABSOLUTE /end AXIS_DESCR
 /begin AXIS_DESCR STD_AXIS InjCtl_qSetUnBal InjMass 16 0.00 327.6700 FORMAT "%8.4" EXTENDED_LIMITS -327.6800 327.6700 DEPOSIT ABSOLUTE /end AXIS_DESCR
/end CHARACTERISTIC
/begin CHARACTERISTIC ETCtl_qPoI2ThresOff_C "Abschaltschwelle für PoI2-Eingriff" VALUE 0x8004C7CC Val_Ws16 327.6700 InjMassInj 0.00 327.6700 FORMAT "%8.4" EXTENDED_LIMITS -327.6800 327.6700 /end CHARACTERISTIC
/begin CHARACTERISTIC ETCtl_rDeltaMaxInr_C "" VALUE 0x8004C7CE Val_Ws16 6.000000 ETCtlGov_p0q001 -3.000000 3.000000 FORMAT "%8.6" EXTENDED_LIMITS -32.76800 32.76700 /end CHARACTERISTIC
/begin CHARACTERISTIC ETCtl_rDeltaMaxOutr_C "" VALUE 0x8004CFE2 Val_Ws16 6.000000 ETCtlGov_p0q001 -3.000000 3.000000 FORMAT "%8.6" EXTENDED_LIMITS -32.76800 32.76700 /end CHARACTERISTIC
/begin CHARACTERISTIC ETCtl_stMskClsThrVlv_C "Bitmaske Anforderung maximale Androsselung" VALUE 0x8004C7D0 Val_Wu32 4294967295.00 OneToOne 0.00 4294967295.00 FORMAT "%13.2" /end CHARACTERISTIC
/begin CHARACTERISTIC ETCtl_stMskInr_CA "Maske Aktivierung innerer Regelkreis" VAL_BLK 0x8004C7E8 ValA_Wu32 4294967295.00 OneToOne 0.00 4294967295.00 FORMAT "%13.2" NUMBER 2 /end CHARACTERISTIC
/begin CHARACTERISTIC ETCtl_stMskNSC_C "Maske Aktivierung der Regeneration des NOx-Speicherkatalysators" VALUE 0x8004C7F0 Val_Wu32 4294967295.00 OneToOne 0.00 4294967295.00 FORMAT "%13.2" /end CHARACTERISTIC
/begin CHARACTERISTIC ETCtl_stMskOutr_CA "Maske Aktivierung äußerer Regelkreis" VAL_BLK 0x8004C7F4 ValA_Wu32 4294967295.00 OneToOne 0.00 4294967295.00 FORMAT "%13.2" NUMBER 2 /end CHARACTERISTIC
/begin CHARACTERISTIC ETCtl_swtActv_C "Status Funktionalität des Abgastemperaturreglers aktiv" VALUE 0x8004BC4C Val_Wu8 1.000 OneToOne 0.00 1.000 FORMAT "%5.3" EXTENDED_LIMITS 0.00 255.0 /end CHARACTERISTIC
/begin CHARACTERISTIC ETCtl_swtPoI1PoI2Dist_C "Schalter zur Auswahl der Verteilung der Nacheinspritzmenge" VALUE 0x8004CFE4 Val_Wu8 1.000 OneToOne 0.00 1.000 FORMAT "%5.3" EXTENDED_LIMITS 0.00 255.0 /end CHARACTERISTIC
/begin CHARACTERISTIC ETCtl_swtPoI2PoI1Dist_C "Aktivierung Durchgriff des inneren Regelkreises auf PoI1" VALUE 0x8004C7D4 Val_Wu8 1.000 OneToOne 0.00 1.000 FORMAT "%5.3" EXTENDED_LIMITS 0.00 255.0 /end CHARACTERISTIC
/begin CHARACTERISTIC ETCtl_tInrCorMax_MAP "Maximal erlaubte Sollwertkorrektur des inneren Regelkreises" MAP 0x8004CFE6 Map_Xs16Ys16Ws16 1600.000 TempDiff_Kelv -100.0000 1500.000 FORMAT "%8.3" EXTENDED_LIMITS -3276.800 3276.700
 /begin AXIS_DESCR STD_AXIS Epm_nEng EngN 16 0.00 6000.000 FORMAT "%8.3" EXTENDED_LIMITS -16384.00 16383.50 DEPOSIT ABSOLUTE /end AXIS_DESCR
 /begin AXIS_DESCR STD_AXIS InjCtl_qSetUnBal InjMass 16 0.00 327.6700 FORMAT "%8.4" EXTENDED_LIMITS -327.6800 327.6700 DEPOSIT ABSOLUTE /end AXIS_DESCR
/end CHARACTERISTIC
/begin CHARACTERISTIC ETCtl_tInrCorMin_MAP "Minimal erlaubte Sollwertkorrektur des inneren Regelkreises" MAP 0x8004D22A Map_Xs16Ys16Ws16 1500.000 TempDiff_Kelv -1500.000 0.00 FORMAT "%8.3" EXTENDED_LIMITS -3276.800 3276.700
 /begin AXIS_DESCR STD_AXIS Epm_nEng EngN 16 0.00 6000.000 FORMAT "%8.3" EXTENDED_LIMITS -16384.00 16383.50 DEPOSIT ABSOLUTE /end AXIS_DESCR
 /begin AXIS_DESCR STD_AXIS InjCtl_qSetUnBal InjMass 16 0.00 327.6700 FORMAT "%8.4" EXTENDED_LIMITS -327.6800 327.6700 DEPOSIT ABSOLUTE /end AXIS_DESCR
/end CHARACTERISTIC
/begin CHARACTERISTIC ETCtl_tInrCorThresOff_C "Abschaltschwelle für Sollwert-Eingriff" VALUE 0x8004D46E Val_Ws16 6553.500 TempDiff_Kelv -3276.800 3276.700 FORMAT "%8.3" /end CHARACTERISTIC
/begin CHARACTERISTIC ETCtl_tInrDvtMax_C "Maximale Regelabweichung des inneren Regelkreises für die Überwachung auf permanente Regelabweichung" VALUE 0x8004C7FC Val_Ws16 1000.000 TempDiff_Kelv -500.0000 500.0000 FORMAT "%8.4" EXTENDED_LIMITS -3276.800 3276.700 /end CHARACTERISTIC
/begin CHARACTERISTIC ETCtl_tInrDvtMin_C "Minimale Regelabweichung des inneren Regelkreises für die Überwachung auf permanente Regelabweichung" VALUE 0x8004C7FE Val_Ws16 1000.000 TempDiff_Kelv -500.0000 500.0000 FORMAT "%8.4" EXTENDED_LIMITS -3276.800 3276.700 /end CHARACTERISTIC
/begin CHARACTERISTIC ETCtl_tInrThresDwn_C "Untere Temperaturschwelle des inneren Regelkreises" VALUE 0x8004C800 Val_Ws16 1500.000 Temp_Cels -0.04000000 1499.960 FORMAT "%8.3" EXTENDED_LIMITS -3549.940 3003.560 /end CHARACTERISTIC
/begin CHARACTERISTIC ETCtl_tInrThresUp_C "Obere Temperaturschwelle des inneren Regelkreises" VALUE 0x8004C802 Val_Ws16 1500.000 Temp_Cels -0.04000000 1499.960 FORMAT "%8.3" EXTENDED_LIMITS -3549.940 3003.560 /end CHARACTERISTIC
/begin CHARACTERISTIC ETCtl_tiRmpInr_C "Steigung der Rampe für die Regelabweichung des inneren Regelkreises" VALUE 0x8004C7D8 Val_Wu32 31.775030303030302 ETCtlGovRmp 0.992969696969697 32.768000000000001 FORMAT "%19.16" EXTENDED_LIMITS 0.000000015258789 65.536000000000001 /end CHARACTERISTIC
/begin CHARACTERISTIC ETCtl_tiRmpOutr_C "Steigung der Rampe für die Regelabweichung des äußeren Regelkreises" VALUE 0x8004D470 Val_Wu32 31.775030303030302 ETCtlGovRmp 0.992969696969697 32.768000000000001 FORMAT "%19.16" EXTENDED_LIMITS 0.000000015258789 65.536000000000001 /end CHARACTERISTIC
/begin CHARACTERISTIC ETCtl_tOutrDvtMax_C "Maximale Regelabweichung des äußeren Regelkreises für die Überwachung auf permanente Regelabweichung" VALUE 0x8004C804 Val_Ws16 1000.000 TempDiff_Kelv -500.0000 500.0000 FORMAT "%8.4" EXTENDED_LIMITS -3276.800 3276.700 /end CHARACTERISTIC
/begin CHARACTERISTIC ETCtl_tOutrDvtMin_C "Minimale Regelabweichung des äußeren Regelkreises für die Überwachung auf permanente Regelabweichung" VALUE 0x8004C806 Val_Ws16 1000.000 TempDiff_Kelv -500.0000 500.0000 FORMAT "%8.4" EXTENDED_LIMITS -3276.800 3276.700 /end CHARACTERISTIC
/begin CHARACTERISTIC ETCtl_tOutrThresDwn_C "Untere Temperaturschwelle des äußeren Regelkreises" VALUE 0x8004C808 Val_Ws16 1500.000 Temp_Cels -0.04000000 1499.960 FORMAT "%8.3" EXTENDED_LIMITS -3549.940 3003.560 /end CHARACTERISTIC
/begin CHARACTERISTIC ETCtl_tOutrThresUp_C "Obere Temperaturschwelle des äußeren Regelkreises" VALUE 0x8004C80A Val_Ws16 1500.000 Temp_Cels -0.04000000 1499.960 FORMAT "%8.3" EXTENDED_LIMITS -3549.940 3003.560 /end CHARACTERISTIC
/begin CHARACTERISTIC ETCtl_tOxiCatUsThresBrn_C "Untere Schwelle Temperatur vor Oxidationskatalysator des äußeren Regelkreises" VALUE 0x8004C80C Val_Ws16 1500.000 Temp_Cels -0.04000000 1499.960 FORMAT "%8.3" EXTENDED_LIMITS -3549.940 3003.560 /end CHARACTERISTIC
/begin CHARACTERISTIC ETCtl_tWinNegInr_C "Negative Großsignalverstärkungsschwelle innerer Regler" VALUE 0x8004C7DC Val_Ws16 2000.000 TempDiff_Kelv -1000.000 1000.000 FORMAT "%8.3" EXTENDED_LIMITS -3276.800 3276.700 /end CHARACTERISTIC
/begin CHARACTERISTIC ETCtl_tWinNegOutr_C "Negative Großsignalverstärkungsschwelle äußerer Regler" VALUE 0x8004D474 Val_Ws16 6553.500 TempDiff_Kelv -3276.800 3276.700 FORMAT "%8.3" /end CHARACTERISTIC
/begin CHARACTERISTIC ETCtl_tWinPosInr_C "Positive Großsignalverstärkungsschwelle innerer Regler" VALUE 0x8004C7DE Val_Ws16 2000.000 TempDiff_Kelv -1000.000 1000.000 FORMAT "%8.3" EXTENDED_LIMITS -3276.800 3276.700 /end CHARACTERISTIC
/begin CHARACTERISTIC ETCtl_tWinPosOutr_C "Positive Großsignalverstärkungsschwelle äußerer Regler" VALUE 0x8004D476 Val_Ws16 1100.000 TempDiff_Kelv -100.0000 1000.000 FORMAT "%8.3" EXTENDED_LIMITS -3276.800 3276.700 /end CHARACTERISTIC
/begin CHARACTERISTIC Etc_MaxReqTO_C "" VALUE 0x8007A14C Val_Wu16 65535.00 OneToOne 0.00 65535.00 FORMAT "%8.2" /end CHARACTERISTIC
/begin CHARACTERISTIC FanCtl_dcycAftRun_C "TV für 10Hz Nachlauf" VALUE 0x8004DE9C Val_Ws16 100.0000 DtyCyc 0.00 100.0000 FORMAT "%8.4" EXTENDED_LIMITS -327.6800 327.6700 /end CHARACTERISTIC
/begin CHARACTERISTIC FanCtl_dcycHysDelta_C "Hystereseschwelle" VALUE 0x8004DE9E Val_Ws16 100.0000 DtyCyc 0.00 100.0000 FORMAT "%8.4" EXTENDED_LIMITS -327.6800 327.6700 /end CHARACTERISTIC
/begin CHARACTERISTIC FanCtl_dcycMax_C "Maximalwert" VALUE 0x8004DEA0 Val_Ws16 100.0000 DtyCyc 0.00 100.0000 FORMAT "%8.4" EXTENDED_LIMITS -327.6800 327.6700 /end CHARACTERISTIC
/begin CHARACTERISTIC FanCtl_dcycMinOff_C "Minimumwert, ""Lüfter aus""" VALUE 0x8004DEA2 Val_Ws16 100.0000 DtyCyc 0.00 100.0000 FORMAT "%8.4" EXTENDED_LIMITS -327.6800 327.6700 /end CHARACTERISTIC
/begin CHARACTERISTIC FanCtl_dcycSwtLimOff_C "Schwelle für Erkennung ""Lüfter aus""" VALUE 0x8004DEA4 Val_Ws16 100.0000 DtyCyc 0.00 100.0000 FORMAT "%8.4" EXTENDED_LIMITS -327.6800 327.6700 /end CHARACTERISTIC
/begin CHARACTERISTIC FanCtl_dcycSwtLimOn_C "Schwelle für Erkennung ""Lüfter ein""" VALUE 0x8004DEA6 Val_Ws16 100.0000 DtyCyc 0.00 100.0000 FORMAT "%8.4" EXTENDED_LIMITS -327.6800 327.6700 /end CHARACTERISTIC
/begin CHARACTERISTIC FanCtl_dcyc_CUR "Umrechnungs-KL, Drehzahl / Tastverhältnis" CURVE 0x8004DEA8 Cur_Xs16Ws16 100.0000 DtyCyc 0.00 100.0000 FORMAT "%8.4" EXTENDED_LIMITS -327.6800 327.6700
 /begin AXIS_DESCR STD_AXIS FanCtl_nSetPoint FanSpd 4 0.00 3000.000 FORMAT "%8.3" EXTENDED_LIMITS -3000.092 3000.000 DEPOSIT ABSOLUTE /end AXIS_DESCR
/end CHARACTERISTIC
/begin CHARACTERISTIC FanCtl_facCorErr_C "" VALUE 0x8007A14E Val_Ws16 799.9878 Prc -400.0000 399.9878 FORMAT "%8.4" /end CHARACTERISTIC
/begin CHARACTERISTIC FanCtl_facWghFctr_CUR "Gewichtungskennlinie Fahrgeschwindigkeit" CURVE 0x8004DEBA Cur_Xs16Ws16 10.00000 Fact 0.00 10.00000 FORMAT "%8.5" EXTENDED_LIMITS -4.000000 3.999878
 /begin AXIS_DESCR STD_AXIS GlbDa_vX Vel 4 0.00 300.0000 FORMAT "%8.4" EXTENDED_LIMITS -327.6800 327.6700 DEPOSIT ABSOLUTE /end AXIS_DESCR
/end CHARACTERISTIC
/begin CHARACTERISTIC FanCtl_nDemFanOffLim_C "Drehzahlausschaltschwelle für hohe Lenköltemperaturen" VALUE 0x8004DECC Val_Ws16 5960.000 EngN 40.00000 6000.000 FORMAT "%8.3" EXTENDED_LIMITS -16384.00 16383.50 /end CHARACTERISTIC
/begin CHARACTERISTIC FanCtl_nDemFanOn_C "Drehzahl Vorgabewert des Lüfters für hohe Lenköltemperaturen" VALUE 0x8004DECE Val_Ws16 5960.000 EngN 40.00000 6000.000 FORMAT "%8.3" EXTENDED_LIMITS -16384.00 16383.50 /end CHARACTERISTIC
/begin CHARACTERISTIC FanCtl_nMin_C "Drehzahlschwelle für ""Lüfter ein""" VALUE 0x8004DED0 Val_Ws16 5960.000 EngN 40.00000 6000.000 FORMAT "%8.3" EXTENDED_LIMITS -16384.00 16383.50 /end CHARACTERISTIC
/begin CHARACTERISTIC FanCtl_nSetGbxOil_MAP "Sollwert-Kennfeld, Getriebeöltemp. abhängig" MAP 0x8004DED2 Map_Xs16Ys16Ws16 3000.000 FanSpd 0.00 3000.000 FORMAT "%8.3" EXTENDED_LIMITS -3000.092 3000.000
 /begin AXIS_DESCR STD_AXIS GlbDa_vX Vel 4 0.00 300.0000 FORMAT "%8.4" EXTENDED_LIMITS -327.6800 327.6700 DEPOSIT ABSOLUTE /end AXIS_DESCR
 /begin AXIS_DESCR STD_AXIS FanCtl_tGbxOil_mp Temp_Cels 8 -50.04000 149.8600 FORMAT "%8.4" EXTENDED_LIMITS -3549.940 3003.560 DEPOSIT ABSOLUTE /end AXIS_DESCR
/end CHARACTERISTIC
/begin CHARACTERISTIC FanCtl_nSetPnt_MAP "Sollwert-Kennfeld, Kühlmitteltemp. abhängig" MAP 0x8004DF2E Map_Xs16Ys16Ws16 3000.000 FanSpd 0.00 3000.000 FORMAT "%8.3" EXTENDED_LIMITS -3000.092 3000.000
 /begin AXIS_DESCR STD_AXIS GlbDa_vX Vel 4 0.00 300.0000 FORMAT "%8.4" EXTENDED_LIMITS -327.6800 327.6700 DEPOSIT ABSOLUTE /end AXIS_DESCR
 /begin AXIS_DESCR STD_AXIS FanCtl_tClnt_mp Temp_Cels 10 -50.54000 149.8600 FORMAT "%8.4" EXTENDED_LIMITS -3549.940 3003.560 DEPOSIT ABSOLUTE /end AXIS_DESCR
/end CHARACTERISTIC
/begin CHARACTERISTIC FanCtl_nSetPointFanOn_C "Drehzahl Vorgabewert des Lüfters für hohe Lenköltemperaturen" VALUE 0x8004DF9E Val_Ws16 3050.539 FanSpd -50.53865 3000.000 FORMAT "%8.3" EXTENDED_LIMITS -3000.092 3000.000 /end CHARACTERISTIC
/begin CHARACTERISTIC FanCtl_nSpd2Win1L_C "" VALUE 0x8007A150 Val_Ws16 32767.50 EngN -16384.00 16383.50 FORMAT "%8.2" /end CHARACTERISTIC
/begin CHARACTERISTIC FanCtl_nSpd2Win1R_C "" VALUE 0x8007A152 Val_Ws16 32767.50 EngN -16384.00 16383.50 FORMAT "%8.2" /end CHARACTERISTIC
/begin CHARACTERISTIC FanCtl_nSpd2Win2L_C "" VALUE 0x8007A154 Val_Ws16 32767.50 EngN -16384.00 16383.50 FORMAT "%8.2" /end CHARACTERISTIC
/begin CHARACTERISTIC FanCtl_nSpd2Win2R_C "" VALUE 0x8007A156 Val_Ws16 32767.50 EngN -16384.00 16383.50 FORMAT "%8.2" /end CHARACTERISTIC
/begin CHARACTERISTIC FanCtl_nSpd2Win3L_C "" VALUE 0x8007A158 Val_Ws16 32767.50 EngN -16384.00 16383.50 FORMAT "%8.2" /end CHARACTERISTIC
/begin CHARACTERISTIC FanCtl_nSpd2Win3R_C "" VALUE 0x8007A15A Val_Ws16 32767.50 EngN -16384.00 16383.50 FORMAT "%8.2" /end CHARACTERISTIC
/begin CHARACTERISTIC FanCtl_nSpdWin1L_C "" VALUE 0x8007A15C Val_Ws16 32767.50 EngN -16384.00 16383.50 FORMAT "%8.2" /end CHARACTERISTIC
/begin CHARACTERISTIC FanCtl_nSpdWin1R_C "" VALUE 0x8007A15E Val_Ws16 32767.50 EngN -16384.00 16383.50 FORMAT "%8.2" /end CHARACTERISTIC
/begin CHARACTERISTIC FanCtl_nSpdWin2L_C "" VALUE 0x8007A160 Val_Ws16 32767.50 EngN -16384.00 16383.50 FORMAT "%8.2" /end CHARACTERISTIC
/begin CHARACTERISTIC FanCtl_nSpdWin2R_C "" VALUE 0x8007A162 Val_Ws16 32767.50 EngN -16384.00 16383.50 FORMAT "%8.2" /end CHARACTERISTIC
/begin CHARACTERISTIC FanCtl_nSpdWin3L_C "" VALUE 0x8007A164 Val_Ws16 32767.50 EngN -16384.00 16383.50 FORMAT "%8.2" /end CHARACTERISTIC
/begin CHARACTERISTIC FanCtl_nSpdWin3R_C "" VALUE 0x8007A166 Val_Ws16 32767.50 EngN -16384.00 16383.50 FORMAT "%8.2" /end CHARACTERISTIC
/begin CHARACTERISTIC FanCtl_stDemFanOffGear_C "Gang bei dem der Lüfter ausgeschaltet wird um die Lenköltemperatur zu veringern" VALUE 0x8004DFA0 Val_Ws8 7.000 OneToOne -1.000 6.000 FORMAT "%5.3" EXTENDED_LIMITS -128.0 127.0 /end CHARACTERISTIC
/begin CHARACTERISTIC FanCtl_stDemFanOnGear_C "Gang bei dem der Lüfter eingeschaltet wird um die Lenköltemperatur zu veringern" VALUE 0x8004DFA1 Val_Ws8 7.000 OneToOne -1.000 6.000 FORMAT "%5.3" EXTENDED_LIMITS -128.0 127.0 /end CHARACTERISTIC
/begin CHARACTERISTIC FanCtl_swtBattCor_C "Schalter zur Aktivierung Ubatt Korrektur (0...aus / 1...ein)" VALUE 0x8004DFA2 Val_Ws16 1.000000 OneToOne 0.00 1.000000 FORMAT "%8.6" EXTENDED_LIMITS -32768.00 32767.00 /end CHARACTERISTIC
/begin CHARACTERISTIC FanCtl_tClntDfl_C "Kühlmitteltemp. Ersatzwert" VALUE 0x8004DFA4 Val_Ws16 200.0000 Temp_Cels -50.14000 149.8600 FORMAT "%8.4" EXTENDED_LIMITS -3549.940 3003.560 /end CHARACTERISTIC
/begin CHARACTERISTIC FanCtl_tDemFanOffLim_C "Ausschalttemperaturschwelle für hohe Lenköltemperaturen" VALUE 0x8004DFA6 Val_Ws16 250.0000 Temp_Cels -50.14000 199.8600 FORMAT "%8.4" EXTENDED_LIMITS -3549.940 3003.560 /end CHARACTERISTIC
/begin CHARACTERISTIC FanCtl_tDemFanOnLim_C "Einschalttemperaturschwelle für hohe Lenköltemperaturen" VALUE 0x8004DFA8 Val_Ws16 250.0000 Temp_Cels -50.14000 199.8600 FORMAT "%8.4" EXTENDED_LIMITS -3549.940 3003.560 /end CHARACTERISTIC
/begin CHARACTERISTIC FanCtl_tEngAftRunThres_C "Motortemp. Schwelle für 10Hz Nachlauf" VALUE 0x8004DFAA Val_Ws16 250.0000 Temp_Cels -50.14000 199.8600 FORMAT "%8.4" EXTENDED_LIMITS -3549.940 3003.560 /end CHARACTERISTIC
/begin CHARACTERISTIC FanCtl_tGbxOilDfl_C "Getriebeöltemp. Ersatzwert" VALUE 0x8004DFAC Val_Ws16 250.0000 Temp_Cels -50.04000 199.9600 FORMAT "%8.4" EXTENDED_LIMITS -3549.940 3003.560 /end CHARACTERISTIC
/begin CHARACTERISTIC FanCtl_tiDemFanOn_C "Zeit bis die Lüfterdrehzahl auf den Vorgabewert für hohe Lenköltemperaturen umgeschaltet wird" VALUE 0x8004DFB0 Val_Wu32 42949672.9500 Time_s 0.00 42949672.9500 FORMAT "%13.4" /end CHARACTERISTIC
/begin CHARACTERISTIC FanCtl_tiMinAftRunOfs_C "neg. Offset zur min. SG-Nachlaufzeit" VALUE 0x8004DFB4 Val_Wu32 42949672950.0 Time_ms 0.00 42949672950.0 FORMAT "%13.1" /end CHARACTERISTIC
/begin CHARACTERISTIC FanCtl_uBattRef_C "Batteriespannungs, Referenzwert" VALUE 0x8004DFB8 Val_Ws16 28600.00 Volt_Batt 0.00 28600.00 FORMAT "%8.2" EXTENDED_LIMITS -655360.0 655340.0 /end CHARACTERISTIC
/begin CHARACTERISTIC FanCtl_vDemFanOffMax_C "Obere Ausschaltgeschwindigkeitsschwelle für hohe Lenköltemperaturen" VALUE 0x8004DFBA Val_Ws16 327.6700 Vel 0.00 327.6700 FORMAT "%8.4" EXTENDED_LIMITS -327.6800 327.6700 /end CHARACTERISTIC
/begin CHARACTERISTIC FanCtl_vDemFanOffMin_C "Untere Ausschaltgeschwindigkeitsschwelle für hohe Lenköltemperaturen" VALUE 0x8004DFBC Val_Ws16 327.6700 Vel 0.00 327.6700 FORMAT "%8.4" EXTENDED_LIMITS -327.6800 327.6700 /end CHARACTERISTIC
/begin CHARACTERISTIC FanCtl_vDemFanOnMax_C "Obere Einschaltgeschwindigkeitsschwelle für hohe Lenköltemperaturen" VALUE 0x8004DFBE Val_Ws16 327.6700 Vel 0.00 327.6700 FORMAT "%8.4" EXTENDED_LIMITS -327.6800 327.6700 /end CHARACTERISTIC
/begin CHARACTERISTIC FanCtl_vDemFanOnMin_C "Untere Einschaltgeschwindigkeitsschwelle für hohe Lenköltemperaturen" VALUE 0x8004DFC0 Val_Ws16 327.6700 Vel 0.00 327.6700 FORMAT "%8.4" EXTENDED_LIMITS -327.6800 327.6700 /end CHARACTERISTIC
/begin CHARACTERISTIC Fans_facVelCorErr_C "Korrekturfaktor im Fehlerfall" VALUE 0x8007A184 Val_Ws16 7.999878 Fact -4.000000 3.999878 FORMAT "%8.6" /end CHARACTERISTIC
/begin CHARACTERISTIC Fans_facVelCor_CUR "Kühlung durch Fahrzeuggeschwindigkeit" CURVE 0x8007A168 Cur_Xs16Ws16 7.999878 Fact -4.000000 3.999878 FORMAT "%8.6"
 /begin AXIS_DESCR STD_AXIS GlbDa_vX Vel 4 -327.6800 327.6700 FORMAT "%8.4" DEPOSIT ABSOLUTE /end AXIS_DESCR
/end CHARACTERISTIC
/begin CHARACTERISTIC Fans_rRampP.Pos_C "Steigung des Rampenfilters ( positiv u. negativ )/" VALUE 0x8007A17C Kw_Ws32 399999.999814 RmpPrc 0.00 399999.999814 FORMAT "%13.6" EXTENDED_LIMITS -400000.000000 399999.999814 /end CHARACTERISTIC
/begin CHARACTERISTIC Fans_rRampP.Neg_C "Steigung des Rampenfilters ( positiv u. negativ )/" VALUE 0x8007A180 Kw_Ws32 399999.999814 RmpPrc 0.00 399999.999814 FORMAT "%13.6" EXTENDED_LIMITS -400000.000000 399999.999814 /end CHARACTERISTIC
/begin CHARACTERISTIC Fan_4WinSigDur.tiErr1Min_C "/" VALUE 0x8004DFC4 Kw_Ws16 655350.0 Time_ms -327680.0 327670.0 FORMAT "%8.1" /end CHARACTERISTIC
/begin CHARACTERISTIC Fan_4WinSigDur.tiErr1Max_C "/" VALUE 0x8004DFC6 Kw_Ws16 655350.0 Time_ms -327680.0 327670.0 FORMAT "%8.1" /end CHARACTERISTIC
/begin CHARACTERISTIC Fan_4WinSigDur.tiErr2Min_C "/" VALUE 0x8004DFC8 Kw_Ws16 655350.0 Time_ms -327680.0 327670.0 FORMAT "%8.1" /end CHARACTERISTIC
/begin CHARACTERISTIC Fan_4WinSigDur.tiErr2Max_C "/" VALUE 0x8004DFCA Kw_Ws16 655350.0 Time_ms -327680.0 327670.0 FORMAT "%8.1" /end CHARACTERISTIC
/begin CHARACTERISTIC Fan_4WinSigDur.tiErr3Min_C "/" VALUE 0x8004DFCC Kw_Ws16 655350.0 Time_ms -327680.0 327670.0 FORMAT "%8.1" /end CHARACTERISTIC
/begin CHARACTERISTIC Fan_4WinSigDur.tiErr3Max_C "/" VALUE 0x8004DFCE Kw_Ws16 655350.0 Time_ms -327680.0 327670.0 FORMAT "%8.1" /end CHARACTERISTIC
/begin CHARACTERISTIC Fan_4WinSigDur.tiErr4Min_C "/" VALUE 0x8004DFD0 Kw_Ws16 655350.0 Time_ms -327680.0 327670.0 FORMAT "%8.1" /end CHARACTERISTIC
/begin CHARACTERISTIC Fan_4WinSigDur.tiErr4Max_C "/" VALUE 0x8004DFD2 Kw_Ws16 655350.0 Time_ms -327680.0 327670.0 FORMAT "%8.1" /end CHARACTERISTIC
/begin CHARACTERISTIC Fan_Pwm.tiPer_C "/" VALUE 0x8004DFD4 Kw_Ws16 9.900000 Period 0.1000000 10.00000 FORMAT "%8.5" EXTENDED_LIMITS -3276.800 3276.700 /end CHARACTERISTIC
/begin CHARACTERISTIC Fan_Pwm.stLvl_C "/" VALUE 0x8004DFD6 Kw_Wu8 1.000 OneToOne 0.00 1.000 FORMAT "%5.3" EXTENDED_LIMITS 0.00 255.0 /end CHARACTERISTIC
/begin CHARACTERISTIC Fan_Pwm.rMaxDty_C "/" VALUE 0x8004DFD8 Kw_Ws16 100.0000 DtyCyc 0.00 100.0000 FORMAT "%8.4" EXTENDED_LIMITS -327.6800 327.6700 /end CHARACTERISTIC
/begin CHARACTERISTIC Fan_Pwm.rPerUn_C "/" VALUE 0x8004DFDA Kw_Ws16 3276.700 Period 0.00 3276.700 FORMAT "%8.3" EXTENDED_LIMITS -3276.800 3276.700 /end CHARACTERISTIC
/begin CHARACTERISTIC Fan_Pwm.tiPh_C "/" VALUE 0x8004DFDC Kw_Ws16 65535.00 OneToOne -32768.00 32767.00 FORMAT "%8.2" /end CHARACTERISTIC
/begin CHARACTERISTIC Fan_PwmOut.rMin_C "/" VALUE 0x8004DFDE Kw_Ws16 100.0000 DtyCyc 0.00 100.0000 FORMAT "%8.4" EXTENDED_LIMITS -327.6800 327.6700 /end CHARACTERISTIC
/begin CHARACTERISTIC Fan_PwmOut.rMax_C "/" VALUE 0x8004DFE0 Kw_Ws16 100.0000 DtyCyc 0.00 100.0000 FORMAT "%8.4" EXTENDED_LIMITS -327.6800 327.6700 /end CHARACTERISTIC
/begin CHARACTERISTIC Fan_PwmOut.tiBtwTstSCB_C "/" VALUE 0x8004DFE2 Kw_Ws16 1000.000 Time_ms 0.00 1000.000 FORMAT "%8.3" EXTENDED_LIMITS -327680.0 327670.0 /end CHARACTERISTIC
/begin CHARACTERISTIC Fan_PwmOut.tiBtwTstOT_C "/" VALUE 0x8004DFE4 Kw_Ws16 1000.000 Time_s 0.00 1000.000 FORMAT "%8.3" EXTENDED_LIMITS -327.6800 327.6700 /end CHARACTERISTIC
/begin CHARACTERISTIC Fan_PwmOut.numTstMax_C "/" VALUE 0x8004DFE6 Kw_Wu16 65535.00 OneToOne 0.00 65535.00 FORMAT "%8.2" /end CHARACTERISTIC
/begin CHARACTERISTIC Fan_PwmOut.swtBattCor_C "/" VALUE 0x8004DFE8 Kw_Wu8 1.000 OneToOne 0.00 1.000 FORMAT "%5.3" EXTENDED_LIMITS 0.00 255.0 /end CHARACTERISTIC
/begin CHARACTERISTIC Fan_PwmOut.swtPsInv_C "/" VALUE 0x8004DFE9 Kw_Wu8 255.0 OneToOne 0.00 255.0 FORMAT "%5.1" /end CHARACTERISTIC
/begin CHARACTERISTIC Fan_rCnv_CUR "" CURVE 0x8004DFEA Cur_Xs16Ws16 655.3500 DtyCyc -327.6800 327.6700 FORMAT "%8.4"
 /begin AXIS_DESCR STD_AXIS Fan_r Prc 10 0.00 100.0000 FORMAT "%8.4" EXTENDED_LIMITS -400.0000 399.9878 DEPOSIT ABSOLUTE /end AXIS_DESCR
/end CHARACTERISTIC
/begin CHARACTERISTIC Fan_rPsDisbl_C "" VALUE 0x8004E014 Val_Ws16 100.0000 DtyCyc 0.00 100.0000 FORMAT "%8.4" EXTENDED_LIMITS -327.6800 327.6700 /end CHARACTERISTIC
/begin CHARACTERISTIC Fan_stPsDiaDisbl_C "" VALUE 0x8004E016 Val_Wu8 255.0 OneToOne 0.00 255.0 FORMAT "%5.1" /end CHARACTERISTIC
/begin CHARACTERISTIC Fan_stPsDisbl_C "" VALUE 0x8004E017 Val_Wu8 255.0 OneToOne 0.00 255.0 FORMAT "%5.1" /end CHARACTERISTIC
/begin CHARACTERISTIC Fan_typ4WinDia_C "" VALUE 0x8004E018 Val_Wu8 0.00 Typ4WinDia 0.00 0.00 FORMAT "%13.2" EXTENDED_LIMITS 0.00 3.00000000000 /end CHARACTERISTIC
/begin MEASUREMENT Com_dEngineCTR "Alive Counter" UWORD OneToOne 1 100 0.00 65535.00 FORMAT "%8.2" ECU_ADDRESS 0xD0007628 /end MEASUREMENT
/begin MEASUREMENT Com_dStatusMSACHK "" UBYTE OneToOne 1 100 0.00 255.0 FORMAT "%5.1" ECU_ADDRESS 0xD0008F75 /end MEASUREMENT
/begin MEASUREMENT Com_dStatusMSACTR "" UWORD OneToOne 1 100 0.00 65535.00 FORMAT "%8.2" ECU_ADDRESS 0xD000762C /end MEASUREMENT
/begin MEASUREMENT Com_dTorque1CHK "Prüfsumme" UBYTE OneToOne 1 100 0.00 255.0 FORMAT "%5.1" ECU_ADDRESS 0xD0008F77 /end MEASUREMENT
/begin MEASUREMENT Com_dTorque1CTR "Alive Counter" UWORD OneToOne 1 100 0.00 65535.00 FORMAT "%8.2" ECU_ADDRESS 0xD0007634 /end MEASUREMENT
/begin MEASUREMENT Com_dTorque1Dummy1 "Prüfsumme" ULONG OneToOne 1 100 0.00 4294967295.00 FORMAT "%13.2" ECU_ADDRESS 0xD00044F4 /end MEASUREMENT
/begin MEASUREMENT Com_dTorque1Dummy2 "Prüfsumme" ULONG OneToOne 1 100 0.00 4294967295.00 FORMAT "%13.2" ECU_ADDRESS 0xD00044F8 /end MEASUREMENT
/begin MEASUREMENT Com_dTorque1Dummy3 "Prüfsumme" ULONG OneToOne 1 100 0.00 4294967295.00 FORMAT "%13.2" ECU_ADDRESS 0xD00044FC /end MEASUREMENT
/begin MEASUREMENT Com_dTorque2CHK "Prüfsumme" UBYTE OneToOne 1 100 0.00 255.0 FORMAT "%5.1" ECU_ADDRESS 0xD0008F78 /end MEASUREMENT
/begin MEASUREMENT Com_dTorque2CTR "Alive Counter" UWORD OneToOne 1 100 0.00 65535.00 FORMAT "%8.2" ECU_ADDRESS 0xD0007636 /end MEASUREMENT
/begin MEASUREMENT Com_dTorque3CHK "Prüfsumme" UBYTE OneToOne 1 100 0.00 255.0 FORMAT "%5.1" ECU_ADDRESS 0xD0008F79 /end MEASUREMENT
/begin MEASUREMENT Com_dTorque3CTR "Alive Counter" UWORD OneToOne 1 100 0.00 65535.00 FORMAT "%8.2" ECU_ADDRESS 0xD0007638 /end MEASUREMENT
/begin MEASUREMENT Com_dTorque3Dummy2 "Prüfsumme" UWORD OneToOne 1 100 0.00 65535.00 FORMAT "%8.2" ECU_ADDRESS 0xD000763A /end MEASUREMENT
/begin MEASUREMENT Com_nEngRpm1 "" SWORD EngN 1 100 -16384.00 16383.50 FORMAT "%8.2" ECU_ADDRESS 0xD0006CE4 /end MEASUREMENT
/begin MEASUREMENT Com_nEngRpm2 "" SWORD EngN 1 100 -16384.00 16383.50 FORMAT "%8.2" ECU_ADDRESS 0xD0006CE6 /end MEASUREMENT
/begin MEASUREMENT Com_rWaterVlv "" SWORD Prc 1 100 -400.0000 399.9878 FORMAT "%8.4" ECU_ADDRESS 0xD0006D02 /end MEASUREMENT
/begin MEASUREMENT Com_stBrk "Status Bremse" UBYTE OneToOne 1 100 0.00 255.0 FORMAT "%5.1" ECU_ADDRESS 0xD0008F81 /end MEASUREMENT
/begin MEASUREMENT Com_stBrkPedal "Status Klemme Radio" UBYTE OneToOne 1 100 0.00 255.0 FORMAT "%5.1" ECU_ADDRESS 0xD0008F82 /end MEASUREMENT
/begin MEASUREMENT Com_stDscAck "Status Klemme Radio" UBYTE OneToOne 1 100 0.00 255.0 FORMAT "%5.1" ECU_ADDRESS 0xD0008F8B /end MEASUREMENT
/begin MEASUREMENT Com_stEng "" UBYTE OneToOne 1 100 0.00 255.0 FORMAT "%5.1" ECU_ADDRESS 0xD0008F8C /end MEASUREMENT
/begin MEASUREMENT Com_stGbxAck "Status Klemme Radio" UBYTE OneToOne 1 100 0.00 255.0 FORMAT "%5.1" ECU_ADDRESS 0xD0008F8E /end MEASUREMENT
/begin MEASUREMENT Com_stHtgUp "Status Klemme Radio" UBYTE OneToOne 1 100 0.00 255.0 FORMAT "%5.1" ECU_ADDRESS 0xD0008F91 /end MEASUREMENT
/begin MEASUREMENT Com_stInjDu "Status momentenerhöhender Eingriff" UBYTE OneToOne 1 100 0.00 255.0 FORMAT "%5.1" ECU_ADDRESS 0xD0008F92 /end MEASUREMENT
/begin MEASUREMENT Com_stMSAFct "" UBYTE OneToOne 1 100 0.00 255.0 FORMAT "%5.1" ECU_ADDRESS 0xD0008F95 /end MEASUREMENT
/begin MEASUREMENT Com_stMSAStart "" UBYTE OneToOne 1 100 0.00 255.0 FORMAT "%5.1" ECU_ADDRESS 0xD0008F96 /end MEASUREMENT
/begin MEASUREMENT Com_stMSAStop "" UBYTE OneToOne 1 100 0.00 255.0 FORMAT "%5.1" ECU_ADDRESS 0xD0008F97 /end MEASUREMENT
/begin MEASUREMENT Com_stnEng "Status Klemme Radio" UBYTE OneToOne 1 100 0.00 255.0 FORMAT "%5.1" ECU_ADDRESS 0xD0008FAC /end MEASUREMENT
/begin MEASUREMENT Com_stOvrRun "Status Klemme Radio" UBYTE OneToOne 1 100 0.00 255.0 FORMAT "%5.1" ECU_ADDRESS 0xD0008F98 /end MEASUREMENT
/begin MEASUREMENT Com_stSLck "Status Klemme Radio" UBYTE OneToOne 1 100 0.00 255.0 FORMAT "%5.1" ECU_ADDRESS 0xD0008F9B /end MEASUREMENT
/begin MEASUREMENT Com_stSwLevRpm "Status Klemme Radio" UBYTE OneToOne 1 100 0.00 255.0 FORMAT "%5.1" ECU_ADDRESS 0xD0008FA0 /end MEASUREMENT
/begin MEASUREMENT Com_stTrqInr "" UBYTE OneToOne 1 100 0.00 255.0 FORMAT "%5.1" ECU_ADDRESS 0xD0008FA9 /end MEASUREMENT
/begin MEASUREMENT Com_tEngRpm_mp "" SWORD Temp_Cels 1 100 -3549.940 3003.560 FORMAT "%8.3" ECU_ADDRESS 0xC0000776 /end MEASUREMENT
/begin MEASUREMENT Com_trqBefRmp_mp "" SWORD Trq 1 100 -3276.800 3276.700 FORMAT "%8.3" ECU_ADDRESS 0xC0000778 /end MEASUREMENT
/begin MEASUREMENT Com_trqDVCH "" SWORD Trq 1 100 -3276.800 3276.700 FORMAT "%8.3" ECU_ADDRESS 0xD0006D1C /end MEASUREMENT
/begin MEASUREMENT Com_trqGbx "" SWORD Trq 1 100 -3276.800 3276.700 FORMAT "%8.3" ECU_ADDRESS 0xD0006D1E /end MEASUREMENT
/begin MEASUREMENT Com_trqInr "" SWORD Trq 1 100 -3276.800 3276.700 FORMAT "%8.3" ECU_ADDRESS 0xD0006D2A /end MEASUREMENT
/begin MEASUREMENT Com_trqInrLtd_mp "" SWORD Trq 1 100 -3276.800 3276.700 FORMAT "%8.3" ECU_ADDRESS 0xC000077A /end MEASUREMENT
/begin MEASUREMENT Com_trqResPos "" SWORD Trq 1 100 -3276.800 3276.700 FORMAT "%8.3" ECU_ADDRESS 0xD0006D2C /end MEASUREMENT
/begin MEASUREMENT Com_tstHtgUp_mp "" SWORD Temp_Cels 1 100 -3549.940 3003.560 FORMAT "%8.3" ECU_ADDRESS 0xC000077C /end MEASUREMENT
/begin MEASUREMENT EngICO_nCtOff "Maximale Solldrehzahl zur Ausblendung der Einspritzungen durch Enddrehzahlregler (Komfort EMB)" SWORD EngN 1 100 -16384.00 16383.50 FORMAT "%8.2" ECU_ADDRESS 0xD0006E36 /end MEASUREMENT
/begin MEASUREMENT EngICO_stICO "Anforderung zur Ausblendung der Einspritzungen" UBYTE OneToOne 1 100 0.00 255.0 FORMAT "%5.1" ECU_ADDRESS 0xD0008FEB /end MEASUREMENT
/begin MEASUREMENT EngPrt_facOvhtPrvCT_mp "Faktor aus Kühlmitteltemperatur" SWORD Fact 1 100 -4.000000 3.999878 FORMAT "%8.6" ECU_ADDRESS 0xC000078E /end MEASUREMENT
/begin MEASUREMENT EngPrt_facOvhtPrvFT_mp "Faktor aus Kraftstofftemperatur" SWORD Fact 1 100 -4.000000 3.999878 FORMAT "%8.6" ECU_ADDRESS 0xC0000790 /end MEASUREMENT
/begin MEASUREMENT EngPrt_facOvhtPrvOT_mp "Faktor aus Motoröltemperatur" SWORD Fact 1 100 -4.000000 3.999878 FORMAT "%8.6" ECU_ADDRESS 0xC0000792 /end MEASUREMENT
/begin MEASUREMENT EngPrt_facOvhtPrv_mp "Minimum der Temperaturfaktoren" SWORD Fact 1 100 -4.000000 3.999878 FORMAT "%8.6" ECU_ADDRESS 0xC0000794 /end MEASUREMENT
/begin MEASUREMENT EngPrt_facPrtLim "Begrenzungfaktor des Motorschutzes" SWORD Fact 1 100 -4.000000 3.999878 FORMAT "%8.6" ECU_ADDRESS 0xD0006E38 /end MEASUREMENT
/begin MEASUREMENT EngPrt_qLimOvhtPrv "Begrenzungmenge zum thermischen Motorschutz" SWORD InjMass 1 100 -327.6800 327.6700 FORMAT "%8.4" ECU_ADDRESS 0xD0006E3C /end MEASUREMENT
/begin MEASUREMENT EngPrt_qOvhtPrvNRng_mp "Begrenzungsmenge auf Grund der mittleren Drehzahl" SWORD InjMass 1 100 -327.6800 327.6700 FORMAT "%8.4" ECU_ADDRESS 0xC0000796 /end MEASUREMENT
/begin MEASUREMENT EngPrt_qOvhtPrvVRng_mp "Begrenzungsmenge auf Grund der Fahrzeuggeschwindigkeit" SWORD InjMass 1 100 -327.6800 327.6700 FORMAT "%8.4" ECU_ADDRESS 0xC0000798 /end MEASUREMENT
/begin MEASUREMENT EngPrt_stOvrSpd "Überdrehzahl-Status" UBYTE OneToOne 1 100 0.00 255.0 FORMAT "%5.1" ECU_ADDRESS 0xD0008FEC /end MEASUREMENT
/begin MEASUREMENT EngPrt_stTrqRampSwitch_mp "status of rampswitch" UWORD OneToOne 1 100 0.00 65535.00 FORMAT "%8.2" ECU_ADDRESS 0xC0000786 /end MEASUREMENT
/begin MEASUREMENT EngPrt_tEngDaFld_mp "" SWORD Temp_Cels 1 100 -3549.940 3003.560 FORMAT "%8.3" ECU_ADDRESS 0xC000078C /end MEASUREMENT
/begin MEASUREMENT EngPrt_tiSeg "" SLONG OneToOne_us 1 100 -2147483648.00 2147483647.00 FORMAT "%13.2" ARRAY_SIZE 4 ECU_ADDRESS 0xD0004314 /end MEASUREMENT
/begin MEASUREMENT EngPrt_tiSegMax_mp "" SLONG OneToOne_us 1 100 -2147483648.00 2147483647.00 FORMAT "%13.2" ECU_ADDRESS 0xC0000780 /end MEASUREMENT
/begin MEASUREMENT EngPrt_trqLim "Begrenzungsmoment zum Schutz vor zu hohem Drehmoment (als inneres Motormoment)" SWORD Trq 1 100 -3276.800 3276.700 FORMAT "%8.3" ECU_ADDRESS 0xD0006E3E /end MEASUREMENT
/begin MEASUREMENT EngPrt_trqLimDA_mp "Drehmomentbegrenzung (als inneres Moment)" SWORD Trq 1 100 -3276.800 3276.700 FORMAT "%8.3" ECU_ADDRESS 0xC0000784 /end MEASUREMENT
/begin MEASUREMENT EngPrt_trqLimLead "resultierendes Begrenzungsmoment Motorschutz Lead-Pfad" SWORD Trq 1 100 -3276.800 3276.700 FORMAT "%8.3" ECU_ADDRESS 0xD0006E40 /end MEASUREMENT
/begin MEASUREMENT EngPrt_trqLimMech "resultierendes Begrenzungsmoment für Motormechanikschutz (inneres Motormoment)" SWORD Trq 1 100 -3276.800 3276.700 FORMAT "%8.3" ECU_ADDRESS 0xD0006E42 /end MEASUREMENT
/begin MEASUREMENT EngPrt_trqLimOvhtPrv "" SWORD Trq 1 100 -3276.800 3276.700 FORMAT "%8.3" ECU_ADDRESS 0xD0006E44 /end MEASUREMENT
/begin MEASUREMENT EngPrt_trqLimPrvLim "uic-Datei für Motormechanikschutz" SWORD Trq 1 100 -3276.800 3276.700 FORMAT "%8.3" ECU_ADDRESS 0xD0006E46 /end MEASUREMENT
/begin MEASUREMENT EngPrt_trqNLim "Begrenzungsmoment zum Schutz vor zu hoher Drehzahl (als inneres Motormoment)" SWORD Trq 1 100 -3276.800 3276.700 FORMAT "%8.3" ECU_ADDRESS 0xD0006E48 /end MEASUREMENT
/begin MEASUREMENT EngPrt_trqPrtLim "Begrenzungsmoment zum Schutz vor zu hohem Drehmoment (als inneres Motormoment)" SWORD Trq 1 100 -3276.800 3276.700 FORMAT "%8.3" ECU_ADDRESS 0xD0006E4A /end MEASUREMENT
/begin MEASUREMENT EngPrt_trqRamLim1_mp "Ausgang der Sekunde rampswitch" SWORD Trq 1 100 -3276.800 3276.700 FORMAT "%8.3" ECU_ADDRESS 0xC0000788 /end MEASUREMENT
/begin MEASUREMENT EngPrt_trqRamLim_mp "Ausgang von erstem rampswitch" SWORD Trq 1 100 -3276.800 3276.700 FORMAT "%8.3" ECU_ADDRESS 0xC000078A /end MEASUREMENT
/begin MEASUREMENT EngReq_trqInrLimInj "Begrenzungsmoment aus Einspritzsystem" SWORD Trq 1 100 -3276.800 3276.700 FORMAT "%8.3" ECU_ADDRESS 0xD0006E4C /end MEASUREMENT
/begin MEASUREMENT EngReq_trqInrLimSmk "Begrenzungsmoment Rauchgrenze" SWORD Trq 1 100 -3276.800 3276.700 FORMAT "%8.3" ECU_ADDRESS 0xD0006E4E /end MEASUREMENT
/begin MEASUREMENT EngReq_trqLim "resultierendes Begrenzungsmoment aus Motorvorgaben" SWORD Trq 1 100 -3276.800 3276.700 FORMAT "%8.3" ECU_ADDRESS 0xD0006E50 /end MEASUREMENT
/begin MEASUREMENT EngReq_trqLimLead "resultierendes Begrenzungsmoment nur langanhaltende Begrenzungen aus Motorvorgaben" SWORD Trq 1 100 -3276.800 3276.700 FORMAT "%8.3" ECU_ADDRESS 0xD0006E52 /end MEASUREMENT
/begin MEASUREMENT EngReq_trqLimSmkUnLim_mp "Begrenzungsmoment durch Rauchgrenze ohne Anstiegsbegrenzung" SWORD Trq 1 100 -3276.800 3276.700 FORMAT "%8.3" ECU_ADDRESS 0xC000079A /end MEASUREMENT
/begin MEASUREMENT EngStA_st "" UBYTE OneToOne 1 100 0.00 255.0 FORMAT "%5.1" ECU_ADDRESS 0xD0008FED /end MEASUREMENT
/begin MEASUREMENT EngStA_stPs "" UBYTE OneToOne 1 100 0.00 255.0 FORMAT "%5.1" ECU_ADDRESS 0xD0008FEE /end MEASUREMENT
/begin MEASUREMENT EngTrqPtd_ctProc10ms "Zähler zur Bildung der 40ms Zeitscheibe aus 10ms" UBYTE OneToOne 1 100 0.00 255.0 FORMAT "%5.1" ECU_ADDRESS 0xD0008FEF /end MEASUREMENT
/begin MEASUREMENT EngTrqPtd_ctProcSet "Prozessaufrufzähler zur Momenten-Mittelwertbildung n-synchroner Größen über 40ms" UBYTE OneToOne 1 100 0.00 255.0 FORMAT "%5.1" ECU_ADDRESS 0xD0008FF0 /end MEASUREMENT
/begin MEASUREMENT EngTrqPtd_rTrqNPtd_mp "Begrenzungsmoment ohne Ebene 1 Offset (n-synchrone Berechnung)" UBYTE Mo_r_prc_q0p39 1 100 0.00 99.61 FORMAT "%5.2" ECU_ADDRESS 0xC000079C /end MEASUREMENT
/begin MEASUREMENT EngTrqPtd_rTrqPtdOld "Zulässiges Motormoment aus der Ebene 2 verzögert um einen Zeitschritt" UBYTE Mo_r_prc_q0p39 1 100 0.00 99.61 FORMAT "%5.2" ECU_ADDRESS 0xD0008FF1 /end MEASUREMENT
/begin MEASUREMENT EngTrqPtd_rTrqTPtd_mp "Zeitsynchron berechnete zulässige Moment ohne Ebene 1 Offset" UBYTE Mo_r_prc_q0p39 1 100 0.00 99.61 FORMAT "%5.2" ECU_ADDRESS 0xC000079D /end MEASUREMENT
/begin MEASUREMENT EngTrqPtd_stLim "Status der Begrenzungsfreigabe bei permanenten Momentenforderungen des Ruckeldämpfers" UBYTE OneToOne 1 100 0.00 255.0 FORMAT "%5.1" ECU_ADDRESS 0xD0008FF2 /end MEASUREMENT
/begin MEASUREMENT EngTrqPtd_stLimDeb_mp "Entprellter Status der Ebene 1 Sollwertpfadebegrenzung der Überwachung" UBYTE OneToOne 1 100 0.00 255.0 FORMAT "%5.1" ECU_ADDRESS 0xC000079E /end MEASUREMENT
/begin MEASUREMENT EngTrqPtd_stLimUnDeb_mp "Unentprellter Status der Ebene 1 Sollwertpfadebegrenzung der Überwachung" UBYTE OneToOne 1 100 0.00 255.0 FORMAT "%5.1" ECU_ADDRESS 0xC000079F /end MEASUREMENT
/begin MEASUREMENT EngTrqPtd_stPthLim "" UBYTE OneToOne 1 100 0.00 255.0 FORMAT "%5.1" ECU_ADDRESS 0xD0008FF3 /end MEASUREMENT
/begin MEASUREMENT EngTrqPtd_trqASD "Plausibilisiertes Ruckeldämpfermoment" SWORD Mo_trq_nm_q0p1 1 100 -3276.800 3276.700 FORMAT "%8.3" ECU_ADDRESS 0xD0006E54 /end MEASUREMENT
/begin MEASUREMENT EngTrqPtd_trqASDAvrg_mp "Gemittelter Ruckeldämpfereingriff zur Bestimmung des Begrenzungsstatus" SWORD Mo_trq_nm_q0p1 1 100 -3276.800 3276.700 FORMAT "%8.3" ECU_ADDRESS 0xC00007A0 /end MEASUREMENT
/begin MEASUREMENT EngTrqPtd_trqASDFlt "Begrenztes Ruckeldämpfermoment der Überwachungbegrenzung" SWORD Mo_trq_nm_q0p1 1 100 -3276.800 3276.700 FORMAT "%8.3" ECU_ADDRESS 0xD0006E56 /end MEASUREMENT
/begin MEASUREMENT EngTrqPtd_trqASDSum "Summenmoment des Ruckeldämpfereingriffs zur Mittelwertbildung über 40ms" ULONG Mo_trq_nm_q0p1 1 100 0.00 429496729.500 FORMAT "%13.3" ECU_ADDRESS 0xD0004324 /end MEASUREMENT
/begin MEASUREMENT EngTrqPtd_trqFlt "" SLONG Mo_trq_nm_q0p00000152587890625 1 100 -3276.80000000 3276.79999847 FORMAT "%13.8" ECU_ADDRESS 0xD0004328 /end MEASUREMENT
/begin MEASUREMENT EngTrqPtd_trqInrAvrg_mp "Gemitteltes inners Sollwertpfadmoment der Ebene 1" SWORD Mo_trq_nm_q0p1 1 100 -3276.800 3276.700 FORMAT "%8.3" ECU_ADDRESS 0xC00007A2 /end MEASUREMENT
/begin MEASUREMENT EngTrqPtd_trqInrSet_mp "Maximal zulässiges Moment der Ebene 2" SWORD Mo_trq_nm_q0p1 1 100 -3276.800 3276.700 FORMAT "%8.3" ECU_ADDRESS 0xC00007A4 /end MEASUREMENT
/begin MEASUREMENT EngTrqPtd_trqLim "" SWORD Mo_trq_nm_q0p1 1 100 -3276.800 3276.700 FORMAT "%8.3" ECU_ADDRESS 0xD0006E58 /end MEASUREMENT
/begin MEASUREMENT EngTrqPtd_trqSpdG "zulässiges Moment des Drehzahlreglers" SWORD Mo_trq_nm_q0p1 1 100 -3276.800 3276.700 FORMAT "%8.3" ECU_ADDRESS 0xD0006E5A /end MEASUREMENT
/begin MEASUREMENT EngTrqPtd_trqSpdGAvrg_mp "Gemittelter Drehzahlreglereingriff zur Bestimmung des Begrenzungsstatus" SWORD Mo_trq_nm_q0p1 1 100 -3276.800 3276.700 FORMAT "%8.3" ECU_ADDRESS 0xC00007A6 /end MEASUREMENT
/begin MEASUREMENT EngTrqPtd_trqSpdGSum "Summenmoment des Drezahlreglereingriffs zur Mittelwertbildung über 40ms" SLONG Mo_trq_nm_q0p1 1 100 -214748364.800 214748364.700 FORMAT "%13.3" ECU_ADDRESS 0xD000432C /end MEASUREMENT
/begin MEASUREMENT EngTrqPtd_trqTOfs_mp "Ebene 1 Offset zur Berechnung des zulässigen Moments der Ebene 2" SWORD Mo_trq_nm_q0p1 1 100 -3276.800 3276.700 FORMAT "%8.3" ECU_ADDRESS 0xC00007A8 /end MEASUREMENT
/begin MEASUREMENT EnvP_p "Umgebungsluftdruck" SWORD Pres_hPa 1 100 -32768.00 3500.00 FORMAT "%8.2" ECU_ADDRESS 0xD0006E5C /end MEASUREMENT
/begin MEASUREMENT EnvP_pSens "Erfasster Umgebungsdruck" SWORD Pres_hPa 1 100 -32768.00 3500.00 FORMAT "%8.2" ECU_ADDRESS 0xD0006E5E /end MEASUREMENT
/begin MEASUREMENT EnvP_uRaw "Rohspannung aus ADC für Umgebungsdruck" SWORD Volt 1 100 -6553.600 6553.400 FORMAT "%8.3" ECU_ADDRESS 0xD0006E60 /end MEASUREMENT
/begin MEASUREMENT EnvT_t "Umgebungstemperatur" SWORD Temp_Cels 1 100 -3549.940 3003.560 FORMAT "%8.3" ECU_ADDRESS 0xD0006E62 /end MEASUREMENT
/begin MEASUREMENT EnvT_tAirCorrPT1_mp "Gefilterte Modelllufttemperatur" SWORD Temp_Cels 1 100 -3549.940 3003.560 FORMAT "%8.3" ECU_ADDRESS 0xC00007AA /end MEASUREMENT
/begin MEASUREMENT EnvT_tAirCorr_mp "Die aus der Ansauglufttemperatur und dem Ansaugluftdruck modellierte Lufttemperatur" SWORD Temp_Cels 1 100 -3549.940 3003.560 FORMAT "%8.3" ECU_ADDRESS 0xC00007AC /end MEASUREMENT
/begin MEASUREMENT EnvT_tClntModCur_mp "Aus Kühlmitteltemperatur berechnete Lufttemperatur" SWORD Temp_Cels 1 100 -3549.940 3003.560 FORMAT "%8.3" ECU_ADDRESS 0xC00007AE /end MEASUREMENT
/begin MEASUREMENT EnvT_tClntPT1_mp "Gefilterte Kühlmitteltemperatur" SWORD Temp_Cels 1 100 -3549.940 3003.560 FORMAT "%8.3" ECU_ADDRESS 0xC00007B0 /end MEASUREMENT
/begin MEASUREMENT EnvT_tMod "Modellierte Umgebungslufttemperatur" SWORD Temp_Cels 1 100 -3549.940 3003.560 FORMAT "%8.3" ECU_ADDRESS 0xD0006E64 /end MEASUREMENT
/begin MEASUREMENT EnvT_tSens "Erfasste Umgebungslufttemperatur" SWORD Temp_Cels 1 100 -3549.940 3003.560 FORMAT "%8.3" ECU_ADDRESS 0xD0006E66 /end MEASUREMENT
/begin MEASUREMENT EnvT_uRaw "Rohsignal aus dem Umgebungstemperatursensor" SWORD Volt 1 100 0.00 5000.000 FORMAT "%8.3" ECU_ADDRESS 0xD0006E68 /end MEASUREMENT
/begin MEASUREMENT EpmBCr_stIntrCo "Status des Interruptkoordinators während des Notlaufs Kurbelwelle" UBYTE EpmBCr_stIntrCo_State_t 1 100 0.00 0.00 FORMAT "%13.2" ECU_ADDRESS 0xD0008A5B /end MEASUREMENT
/begin MEASUREMENT EpmCaS_ctEdgeDiff_mp "Anzahl der neuen NW Flanken seit dem letzten Aufruf" UBYTE OneToOne 1 100 0.00 255.0 FORMAT "%5.1" ECU_ADDRESS 0xC00007B2 /end MEASUREMENT
/begin MEASUREMENT EpmCaS_ctEdgeEquid "Offset der letzten equidistanten Nockenwellenflanke in EpmSyn_ctEdgeMapEquid" UBYTE OneToOne 1 100 0.00 255.0 FORMAT "%5.1" ARRAY_SIZE 1 ECU_ADDRESS 0xD0008FF7 /end MEASUREMENT
/begin MEASUREMENT EpmCaS_ctErrSigDef "Anzahl von Kurbelwellen-Inkrements während das Nockenwellen Pattern Matching Fehler liefert" UWORD OneToOne 1 100 0.00 65535.00 FORMAT "%8.2" ARRAY_SIZE 1 ECU_ADDRESS 0xD00064AC /end MEASUREMENT
/begin MEASUREMENT EpmCaS_ctErrSigOk "Entprellzähler Heilung Nockenwellenstörung" UWORD OneToOne 1 100 0.00 65535.00 FORMAT "%8.2" ARRAY_SIZE 1 ECU_ADDRESS 0xD00064AE /end MEASUREMENT
/begin MEASUREMENT EpmCaS_ctNoSig "Anzahl der Kurbelwellen-Inkrements bei fehlendem Nockenwellensignal" UWORD OneToOne 1 100 0.00 65535.00 FORMAT "%8.2" ARRAY_SIZE 1 ECU_ADDRESS 0xD00064AA /end MEASUREMENT
/begin MEASUREMENT EpmCaS_ctOfsErr_mp "Entprellzähler Verdrehung Nockenwelle" UBYTE OneToOne 1 100 0.00 255.0 FORMAT "%5.1" ECU_ADDRESS 0xC00007B3 /end MEASUREMENT
/begin MEASUREMENT EpmCaS_ctOfsOk_mp "Heilungszähler für Nockenwellen-Winkelversatzfehler" UBYTE OneToOne 1 100 0.00 255.0 FORMAT "%5.1" ECU_ADDRESS 0xC00007B4 /end MEASUREMENT
/begin MEASUREMENT EpmCaS_nEng "Motordrehzahl aufgrund einer NW-Umdrehung" SWORD EngN 1 100 -16384.00 16383.50 FORMAT "%8.2" ECU_ADDRESS 0xD0006E6E /end MEASUREMENT
/begin MEASUREMENT EpmCaS_numBufEntry_mp "Index des nächsten freien Elements im Puffer" UBYTE OneToOne 1 100 0.00 255.0 FORMAT "%5.1" ECU_ADDRESS 0xC00007B5 /end MEASUREMENT
/begin MEASUREMENT EpmCaS_numCurrEdge "Anzahl der aktuell erkannten Nockenwellenflanken" UWORD OneToOne 1 100 0.00 65535.00 FORMAT "%8.2" ARRAY_SIZE 1 ECU_ADDRESS 0xD00064A8 /end MEASUREMENT
/begin MEASUREMENT EpmCaS_numSegTeeth_mp "Anzahl der äquidistanten Segmentflanken über eine NW-Umdrehung" UBYTE OneToOne 1 100 0.00 255.0 FORMAT "%5.1" ECU_ADDRESS 0xC00007B6 /end MEASUREMENT
/begin MEASUREMENT EpmCaS_numValidTeeth_mp "Anzahl der äquidistanten Segmentflanken, die während eines Prozess Aufrufs gefunden wurden." UBYTE OneToOne 1 100 0.00 255.0 FORMAT "%5.1" ECU_ADDRESS 0xC00007B7 /end MEASUREMENT
/begin MEASUREMENT EpmCaS_phiCaSOfsAvg "gemittelter Verdrehwinkel der Nockenwelle" SLONG AngleCrS 1 100 -47187360.0439 47187360.0220 FORMAT "%13.4" ECU_ADDRESS 0xD0004330 /end MEASUREMENT
/begin MEASUREMENT EpmCaS_phiCor "Winkelkorrekturwert der Nockenwelle über Drehzahl und Temperatur" SWORD AngleCrS 1 100 -720.0220 720.0000 FORMAT "%8.4" ARRAY_SIZE 1 ECU_ADDRESS 0xD0006E70 /end MEASUREMENT
/begin MEASUREMENT EpmCaS_phiDiff "Abweichung der aktuellen NW Position von der adaptierten bzw realen Referenzposition" SWORD AngleCrS 1 100 -720.0220 720.0000 FORMAT "%8.4" ARRAY_SIZE 1 ECU_ADDRESS 0xD0006E72 /end MEASUREMENT
/begin MEASUREMENT EpmCaS_phiEdge "Winkel der NW Flanke" SWORD AngleCrS 1 100 -720.0220 720.0000 FORMAT "%8.4" ARRAY_SIZE 1 ECU_ADDRESS 0xD0006E74 /end MEASUREMENT
/begin MEASUREMENT EpmCaS_phiMissedSeg_mp "Erwarteter Winkel einer fehlenden äquidistanten NW-Flanke" SWORD AngleCrS 1 100 -720.0220 720.0000 FORMAT "%8.4" ECU_ADDRESS 0xC00007B8 /end MEASUREMENT
/begin MEASUREMENT EpmCaS_phiOfsCorr "gefilterter Nockenwellenverdrehwinkel" SWORD AngleCrS 1 100 -720.0220 720.0000 FORMAT "%8.4" ECU_ADDRESS 0xD0006E76 /end MEASUREMENT
/begin MEASUREMENT EpmCaS_phiSegLenTolc_mp "Berechnete Toleranz für den Flankenabstand von äquidistanten NW-Flanken" SWORD AngleCrS 1 100 -720.0220 720.0000 FORMAT "%8.4" ECU_ADDRESS 0xC00007BA /end MEASUREMENT
/begin MEASUREMENT EpmCaS_phiSpeedSegLen_mp "Berechnete Segmentlänge von äquidistanten NW-Flanken für den Winkelversatz" SWORD AngleCrS 1 100 -720.0220 720.0000 FORMAT "%8.4" ECU_ADDRESS 0xC00007BC /end MEASUREMENT
/begin MEASUREMENT EpmCaS_phiTempCor "Winkelkorrekturwert für jede Nockenwelle abhängig von der Temperatur" SWORD AngleCrS 1 100 -720.0220 720.0000 FORMAT "%8.4" ARRAY_SIZE 1 ECU_ADDRESS 0xD0006E78 /end MEASUREMENT
/begin MEASUREMENT EpmCaS_stAdap "Status der Nockenwellenadaption" UBYTE EpmCaS_stAdap_State 1 100 0.00 4.00000000000 FORMAT "%13.11" ARRAY_SIZE 1 ECU_ADDRESS 0xD0008A5C /end MEASUREMENT
/begin MEASUREMENT EpmCaS_stDiag "Zustand der Nockenwellendiagnose" UBYTE OneToOne 1 100 0.00 255.0 FORMAT "%5.1" ARRAY_SIZE 1 ECU_ADDRESS 0xD0008A5E /end MEASUREMENT
/begin MEASUREMENT EpmCaS_stErrSig "Fehlerzustand für Nockenwellenstörung" UBYTE OneToOne 1 100 0.00 255.0 FORMAT "%5.1" ARRAY_SIZE 1 ECU_ADDRESS 0xD0008A5F /end MEASUREMENT
/begin MEASUREMENT EpmCaS_stNEng "Status der Nockenwellendrehzahl" UBYTE OneToOne 1 100 0.00 255.0 FORMAT "%5.1" ECU_ADDRESS 0xD0008FF8 /end MEASUREMENT
/begin MEASUREMENT EpmCaS_stNoSig "Fehlerzustand für Nockenwellenausfall" UBYTE OneToOne 1 100 0.00 255.0 FORMAT "%5.1" ARRAY_SIZE 1 ECU_ADDRESS 0xD0008A60 /end MEASUREMENT
/begin MEASUREMENT EpmCaS_stOfs "Zustand der NW-Verdrehberechnung" UBYTE OneToOne 1 100 0.00 255.0 FORMAT "%5.1" ECU_ADDRESS 0xD0008EEF /end MEASUREMENT
/begin MEASUREMENT EpmCaS_stOfsErr "Fehlerzustand der NW-Verdrehberechnung" UBYTE OneToOne 1 100 0.00 255.0 FORMAT "%5.1" ECU_ADDRESS 0xD0009233 /end MEASUREMENT
/begin MEASUREMENT EpmCaS_tiEdge "Zeitpunkt der NW Flanke" SLONG Per_Dur 1 100 -2147483648.00 2147483647.00 FORMAT "%13.2" ARRAY_SIZE 1 ECU_ADDRESS 0xD0004334 /end MEASUREMENT
/begin MEASUREMENT EpmCrS_ctCaSRev_mp "Entprellzähler für Ausfall Kurbelwellensignal" SWORD OneToOne 1 100 -32768.00 32767.00 FORMAT "%8.2" ECU_ADDRESS 0xC00007BE /end MEASUREMENT
/begin MEASUREMENT EpmCrS_ctErrSig "Entprellzähler für Störung Kurbelwellensignal" SWORD OneToOne 1 100 -32768.00 32767.00 FORMAT "%8.2" ECU_ADDRESS 0xD0006504 /end MEASUREMENT
/begin MEASUREMENT EpmCrS_ctGlitch "Entprellzähler für Glitch - Ereignisse an der Kurbelwelle" SWORD OneToOne 1 100 -32768.00 32767.00 FORMAT "%8.2" ECU_ADDRESS 0xD0006506 /end MEASUREMENT
/begin MEASUREMENT EpmCrS_ctGlitchRev_mp "Anzahl der Glitches pro KW-Umdrehung" SBYTE OneToOne 1 100 -128.0 127.0 FORMAT "%5.1" ECU_ADDRESS 0xC00007C0 /end MEASUREMENT
/begin MEASUREMENT EpmCrS_ctRange_mp "Zähler zur Auswahl der Drehzahlbereiche in der dynamischen Plausibilisierung" UBYTE OneToOne 1 100 0.00 255.0 FORMAT "%5.1" ECU_ADDRESS 0xC00007C3 /end MEASUREMENT
/begin MEASUREMENT EpmCrS_ctRev100msLim_mp "Zähler der Kurbelwellenumdrehungen in 100ms" SBYTE OneToOne 1 100 -128.0 127.0 FORMAT "%5.1" ECU_ADDRESS 0xC00007C1 /end MEASUREMENT
/begin MEASUREMENT EpmCrS_ctRevCnt "Motorumdrehungszähler" UWORD RevCnt 1 100 0.00 4095.938 FORMAT "%8.3" ECU_ADDRESS 0xD000765C /end MEASUREMENT
/begin MEASUREMENT EpmCrS_ctRevIni "Kurbelwellenumdrehungen seit Synchronisation" SWORD OneToOne 1 100 -32768.00 32767.00 FORMAT "%8.2" ECU_ADDRESS 0xD0006E7A /end MEASUREMENT
/begin MEASUREMENT EpmCrS_ctRevStrt "Motorumdrehungszähler seit Startabwurf" SWORD OneToOne 1 100 -32768.00 32767.00 FORMAT "%8.2" ECU_ADDRESS 0xD0006E7C /end MEASUREMENT
/begin MEASUREMENT EpmCrS_ctRevWaitDiag "Heilungsentprellzähler Störung Kurbelwellensignal" SWORD OneToOne 1 100 -32768.00 32767.00 FORMAT "%8.2" ECU_ADDRESS 0xD0006502 /end MEASUREMENT
/begin MEASUREMENT EpmCrS_facScale_mp "TTMeasure - aktuell eingestellte Auflösung für die Ausgabe der Zahnzeiten" UBYTE OneToOne 1 100 0.00 255.0 FORMAT "%5.1" ECU_ADDRESS 0xC00007CC /end MEASUREMENT
/begin MEASUREMENT EpmCrS_numNewInc_mp "TTMeasure - Anzahl der neuen Zahnzeiten seit dem letzten Interrupt" UBYTE OneToOne 1 100 0.00 255.0 FORMAT "%5.1" ECU_ADDRESS 0xC00007CD /end MEASUREMENT
/begin MEASUREMENT EpmCrS_numSeg "Teilsegmentzähler" UBYTE OneToOne 1 100 0.00 255.0 FORMAT "%5.1" ECU_ADDRESS 0xD0008FF9 /end MEASUREMENT
/begin MEASUREMENT EpmCrS_numTiIncPerAvrg_mp "aktuelle Anzahl der Kurbelwellenzähne zur Berechnung der gemittelten Zahnzeit" UBYTE OneToOne 1 100 0.00 255.0 FORMAT "%5.1" ECU_ADDRESS 0xC00007C4 /end MEASUREMENT
/begin MEASUREMENT EpmCrS_stDiag "Status der Kurbelwellen diagnose" UBYTE OneToOne 1 100 0.00 255.0 FORMAT "%5.1" ECU_ADDRESS 0xD0008FFA /end MEASUREMENT
/begin MEASUREMENT EpmCrS_stDiagErrSig "Aktueller Status des Fehlers ErrSig" UBYTE OneToOne 1 100 0.00 255.0 FORMAT "%5.1" ECU_ADDRESS 0xD0008FFB /end MEASUREMENT
/begin MEASUREMENT EpmCrS_stDiagNoSig "Aktueller Status des Fehlers NoSig" UBYTE OneToOne 1 100 0.00 255.0 FORMAT "%5.1" ECU_ADDRESS 0xD0008FFC /end MEASUREMENT
/begin MEASUREMENT EpmCrS_stResetDiag_mp "Status Rücksetzen der Kurbelwellendiagnose" UBYTE OneToOne 1 100 0.00 255.0 FORMAT "%5.1" ECU_ADDRESS 0xC00007C2 /end MEASUREMENT
/begin MEASUREMENT EpmCrS_stSigDiagSrc "Fehlerursache Kurbelwellensignal" UWORD OneToOne 1 100 0.00 65535.00 FORMAT "%8.2" ECU_ADDRESS 0xD000765E /end MEASUREMENT
/begin MEASUREMENT EpmCrS_stSigMode "Status Kurbelwellensignalauswertung" UBYTE OneToOne 1 100 0.00 255.0 FORMAT "%5.1" ECU_ADDRESS 0xD0008FFD /end MEASUREMENT
/begin MEASUREMENT EpmCrS_tiIncPer_mp "aktuelle Zahnzeit der Kurbelwelle" SLONG TimeGT0Tic 1 100 -858993.459200 858993.458800 FORMAT "%13.6" ECU_ADDRESS 0xC00007C8 /end MEASUREMENT
/begin MEASUREMENT EpmCrs_tiInc_mp "TTmeasure - KW-Zahnzeiten seit dem letzten Interrupt" UWORD TimeGPTATick 1 100 0.00 3276.750 FORMAT "%8.3" ARRAY_SIZE 20 ECU_ADDRESS 0xC00007CE /end MEASUREMENT
/begin MEASUREMENT EpmCrS_tiSeg "Segmentzeit" SLONG Per_Dur 1 100 -2147483648.00 2147483647.00 FORMAT "%13.2" ECU_ADDRESS 0xD0004338 /end MEASUREMENT
/begin MEASUREMENT EpmCrS_tiSegCurr "Teilsegmentzähler" SLONG Per_Dur 1 100 -2147483648.00 2147483647.00 FORMAT "%13.2" ECU_ADDRESS 0xD000433C /end MEASUREMENT
/begin MEASUREMENT EpmHCrS_stSigErr "Kurbelwellensignalfehler" UWORD OneToOne 1 100 0.00 65535.00 FORMAT "%8.2" ECU_ADDRESS 0xD000651A /end MEASUREMENT
/begin MEASUREMENT EpmHCrS_stSigMode "Zustand der Kurbelwellensignalauswertung" UBYTE OneToOne 1 100 0.00 255.0 FORMAT "%5.1" ECU_ADDRESS 0xD0008A81 /end MEASUREMENT
/begin MEASUREMENT EpmRRS_bEngStopAg_mp "Gültigkeit Motorstopp-Position/Abstellwinkel" UBYTE EpmRRS_bEngStopAg_t 1 100 0.00 1.00000000000 FORMAT "%13.11" ECU_ADDRESS 0xC00007F6 /end MEASUREMENT
/begin MEASUREMENT EpmRRS_bEngSwOff "" UBYTE default 1 100 0.00 1.000 BIT_MASK 0x1 FORMAT "%5.3" ECU_ADDRESS 0xD000922C /end MEASUREMENT
/begin MEASUREMENT EpmRRS_ctInc10msRev_mp "" UWORD OneToOne 1 100 0.00 65535.00 FORMAT "%8.2" ECU_ADDRESS 0xC00007F8 /end MEASUREMENT
/begin MEASUREMENT EpmRRS_ctInc10ms_mp "letzte Zahnnummer der HWE" UWORD OneToOne 1 100 0.00 65535.00 FORMAT "%8.2" ECU_ADDRESS 0xC00007FA /end MEASUREMENT
/begin MEASUREMENT EpmRRS_ctIncEngStop_mp "Zahnnummer bei Motorstopp" UWORD OneToOne 1 100 0.00 65535.00 FORMAT "%8.2" ECU_ADDRESS 0xC00007FC /end MEASUREMENT
/begin MEASUREMENT EpmRRS_ctIncMax_mp "Zahnnummer mit maximaler Zahnzeit" UWORD OneToOne 1 100 0.00 65535.00 FORMAT "%8.2" ECU_ADDRESS 0xC00007FE /end MEASUREMENT
/begin MEASUREMENT EpmRRS_phiEngStop_mp "Winkel bei Motorstopp" SWORD AngleCrS 1 100 -720.0220 720.0000 FORMAT "%8.4" ECU_ADDRESS 0xC0000800 /end MEASUREMENT
/begin MEASUREMENT EpmRRS_phiLowerLimit_mp "" SWORD AngleCrS 1 100 -720.0220 720.0000 FORMAT "%8.4" ECU_ADDRESS 0xC0000802 /end MEASUREMENT
/begin MEASUREMENT EpmRRS_phiMax_mp "Winkel bei Zahnzeitmaximum" SWORD AngleCrS 1 100 -720.0220 720.0000 FORMAT "%8.4" ECU_ADDRESS 0xC0000804 /end MEASUREMENT
/begin MEASUREMENT EpmRRS_phiTdcCritCyl_mp "" SWORD AngleCrS 1 100 -720.0220 720.0000 FORMAT "%8.4" ECU_ADDRESS 0xC0000806 /end MEASUREMENT
/begin MEASUREMENT EpmRRS_phiUpperLimit_mp "" SWORD AngleCrS 1 100 -720.0220 720.0000 FORMAT "%8.4" ECU_ADDRESS 0xC0000808 /end MEASUREMENT
/begin MEASUREMENT EpmRRS_stAgDetect_mp "Zustand des Zustandautomaten" UBYTE EpmRRS_stAgDetect_t 1 100 0.00 6.00000000000 FORMAT "%13.11" ECU_ADDRESS 0xC000080A /end MEASUREMENT
/begin MEASUREMENT EpmRRS_stToothAngleCond_mp "Zahnzeit- und Winkelbedingungen" UBYTE OneToOne 1 100 0.00 255.0 FORMAT "%5.1" ECU_ADDRESS 0xC000080B /end MEASUREMENT
/begin MEASUREMENT EpmRRS_tiSwOffTmr_mp "" SLONG OneToOne_us 1 100 -2147483648.00 2147483647.00 FORMAT "%13.2" ECU_ADDRESS 0xC000080C /end MEASUREMENT
/begin MEASUREMENT EpmRRS_tiToothPer_mp "" SLONG OneToOne_us 1 100 -2147483648.00 2147483647.00 FORMAT "%13.2" ARRAY_SIZE 10 ECU_ADDRESS 0xC0000810 /end MEASUREMENT
/begin MEASUREMENT EpmRRS_tiTrnOffTmr_mp "" SLONG OneToOne_us 1 100 -2147483648.00 2147483647.00 FORMAT "%13.2" ECU_ADDRESS 0xC0000838 /end MEASUREMENT
/begin MEASUREMENT EpmRRS_uIniMin_mp "Spannung bei Initialisierung" SWORD Volt_Batt 1 100 -655360.0 655340.0 FORMAT "%8.1" ECU_ADDRESS 0xC000083C /end MEASUREMENT
/begin MEASUREMENT EpmSeq_numInt "Interrupttyp des Sequencemanagers" UBYTE EpmSeq_numInt_Compu 1 100 0.00 16.0000000000 FORMAT "%13.10" ECU_ADDRESS 0xD0008FFE /end MEASUREMENT
/begin MEASUREMENT EpmSeq_phiNxtInt "Winkel des nächsten auszulösenden Syncrointerrupts" SWORD AngleCrS 1 100 0.00 720.0000 FORMAT "%8.4" ECU_ADDRESS 0xD0006E7E /end MEASUREMENT
/begin MEASUREMENT EpmSeq_stInt "Status des Sequencemanagers" UBYTE EpmSeq_stInt_Compu 1 100 0.00 8.00000000000 FORMAT "%13.11" ECU_ADDRESS 0xD0009234 /end MEASUREMENT
/begin MEASUREMENT EpmSyn_CaSData "Signaltabelle mit den erfassten Nockenwellensegmenten" UBYTE OneToOne 1 100 0.00 255.0 FORMAT "%5.1" ARRAY_SIZE 16 ECU_ADDRESS 0xD0006534 /end MEASUREMENT
/begin MEASUREMENT EpmSyn_ctEdgeEarly "Anzahl der tolerierten NW-Flanken, die zu früh kommen" UBYTE OneToOne 1 100 0.00 255.0 FORMAT "%5.1" ARRAY_SIZE 1 ECU_ADDRESS 0xD0008A95 /end MEASUREMENT
/begin MEASUREMENT EpmSyn_ctEdgeLate "Anzahl der tolerierten Nockenwellenflanken, die zu spät kommen" UBYTE OneToOne 1 100 0.00 255.0 FORMAT "%5.1" ARRAY_SIZE 1 ECU_ADDRESS 0xD0008A96 /end MEASUREMENT
/begin MEASUREMENT EpmSyn_ctLstEdge_mp "Letzter Wert des KW-Flankenzählers" SWORD OneToOne 1 100 -32768.00 32767.00 FORMAT "%8.2" ECU_ADDRESS 0xC000083E /end MEASUREMENT
/begin MEASUREMENT EpmSyn_ctSigTabLstEntr_mp "Index des letzten Eintrags in der Signaltabelle" SBYTE OneToOne 1 100 -128.0 127.0 FORMAT "%5.1" ECU_ADDRESS 0xC0000840 /end MEASUREMENT
/begin MEASUREMENT EpmSyn_EdgeFailType "Fehlerart beim Tolerieren von Nockenwellenstörungen" UBYTE EpmSyn_EdgeFailTypes 1 100 0.00 2.00000000000 FORMAT "%13.11" ARRAY_SIZE 1 ECU_ADDRESS 0xD0008A94 /end MEASUREMENT
/begin MEASUREMENT EpmSyn_numCaSSync "Nockenwelle mit der die Syncronisation durchgeführt wird" UBYTE OneToOne 1 100 0.00 255.0 FORMAT "%5.1" ECU_ADDRESS 0xD0008A86 /end MEASUREMENT
/begin MEASUREMENT EpmSyn_numMatches_mp "Anzahl Übereinstimmungen zwischen EpmCaS_dSegSeries und Signaltabelle" UBYTE OneToOne 1 100 0.00 255.0 FORMAT "%5.1" ECU_ADDRESS 0xC0000841 /end MEASUREMENT
/begin MEASUREMENT EpmSyn_numMatchPos "Position bei der EpmCas_dSegSeries_C mit dem erfassten Muster übereinstimmt" SBYTE OneToOne 1 100 -128.0 127.0 FORMAT "%5.1" ARRAY_SIZE 1 ECU_ADDRESS 0xD0008A93 /end MEASUREMENT
/begin MEASUREMENT EpmSyn_numMatchPos_mp "Position der Übereinstimmung" UBYTE OneToOne 1 100 0.00 255.0 FORMAT "%5.1" ECU_ADDRESS 0xC0000842 /end MEASUREMENT
/begin MEASUREMENT EpmSyn_numNewEdges_mp "Anzahl neuer NW Flanken seit dem letzten Aufruf" UBYTE OneToOne 1 100 0.00 255.0 FORMAT "%5.1" ECU_ADDRESS 0xC0000843 /end MEASUREMENT
/begin MEASUREMENT EpmSyn_numSegInSigTab_mp "Anzahl der Segmenteinträge in der Signaltabelle" UBYTE OneToOne 1 100 0.00 255.0 FORMAT "%5.1" ECU_ADDRESS 0xC0000844 /end MEASUREMENT
/begin MEASUREMENT EpmSyn_phiCaSPos "Nockenwellenwinkel nach Mustererkennung" SWORD AngleCrS 1 100 -720.0220 720.0000 FORMAT "%8.4" ARRAY_SIZE 1 ECU_ADDRESS 0xD0006532 /end MEASUREMENT
/begin MEASUREMENT EpmSyn_phiDiff_mp "Differenz zwischen Nocken- und Kurbellwelle" SWORD AngleCrS 1 100 -720.0220 720.0000 FORMAT "%8.4" ECU_ADDRESS 0xD0006554 /end MEASUREMENT
/begin MEASUREMENT EpmSyn_phiInt "Position des Syncro interrupts" SWORD AngleCrS 1 100 -720.0220 720.0000 FORMAT "%8.4" ECU_ADDRESS 0xD0006E80 /end MEASUREMENT
/begin MEASUREMENT EpmSyn_phiSegLenUncorr "unkorrigierte segmentlänge des toleranten Nockenwellenmustervergleichs" SLONG OneToOne 1 100 -2147483648.00 2147483647.00 FORMAT "%13.2" ARRAY_SIZE 1 ECU_ADDRESS 0xD0003680 /end MEASUREMENT
/begin MEASUREMENT EpmSyn_stCasEval "Zustand der Nockenwellenauswertung" UBYTE OneToOne 1 100 0.00 255.0 FORMAT "%5.1" ECU_ADDRESS 0xD0008A99 /end MEASUREMENT
/begin MEASUREMENT EpmSyn_stCaSPos "Zustand der Nockenwellenposition" UBYTE OneToOne 1 100 0.00 255.0 FORMAT "%5.1" ARRAY_SIZE 1 ECU_ADDRESS 0xD0008A87 /end MEASUREMENT
/begin MEASUREMENT EpmSyn_stCrSPos "Zustand Kurbelwellenposition" UBYTE OneToOne 1 100 0.00 255.0 FORMAT "%5.1" ECU_ADDRESS 0xD0008FFF /end MEASUREMENT
/begin MEASUREMENT EpmSyn_stCrSPosErr "Fehler der Kurbelwellenposition" UWORD OneToOne 1 100 0.00 65535.00 FORMAT "%8.2" ECU_ADDRESS 0xD0006552 /end MEASUREMENT
/begin MEASUREMENT EpmSyn_stGapPos "1=Lückenposition zur Phasenüberprüfung verwenden" UBYTE OneToOne 1 100 0.00 255.0 FORMAT "%5.1" ECU_ADDRESS 0xD0008A9A /end MEASUREMENT
/begin MEASUREMENT EpmSyn_stPreSeg_mp "Zustand der vorläufigen Segmenterkennung" UBYTE OneToOne 1 100 0.00 255.0 FORMAT "%5.1" ECU_ADDRESS 0xC0000845 /end MEASUREMENT
/begin MEASUREMENT Epm_ctCyl "aktuelle Zylindernummer" UBYTE OneToOne 1 100 0.00 255.0 FORMAT "%5.1" ECU_ADDRESS 0xD0009000 /end MEASUREMENT
/begin MEASUREMENT Epm_dnEng "Drehzahlgradient berechnet über das aktuelle Segment (S0-S0 oder S1-S1)" SWORD EngNGrd 1 100 -16384.00 16383.50 FORMAT "%8.2" ECU_ADDRESS 0xD0006E82 /end MEASUREMENT
/begin MEASUREMENT Epm_dnEngFlt "Gefilterter Drehzahlgradient berechnet über das aktuelle Segment (S0-S0 oder S1-S1)" SWORD EngNGrd 1 100 -16384.00 16383.50 FORMAT "%8.2" ECU_ADDRESS 0xD0006E84 /end MEASUREMENT
/begin MEASUREMENT Epm_nEng "" SWORD EngN 1 100 -16384.00 16383.50 FORMAT "%8.2" ECU_ADDRESS 0xD0006956 /end MEASUREMENT
/begin MEASUREMENT Epm_nEngCurr "Aktuelle Motordrehzahl" SWORD EngN 1 100 -16384.00 16383.50 FORMAT "%8.2" ECU_ADDRESS 0xD0006E86 /end MEASUREMENT
/begin MEASUREMENT Epm_nEngDiff "Differenzdrehzahl berechnet über das aktuelle Segment (S0-S0 oder S1-S1)" SWORD EngN 1 100 -16384.00 16383.50 FORMAT "%8.2" ECU_ADDRESS 0xD0006E88 /end MEASUREMENT
/begin MEASUREMENT Epm_nEngLRes "" UBYTE EngN_LRes 1 100 0.00 10200. FORMAT "%5.0" ECU_ADDRESS 0xD0009002 /end MEASUREMENT
/begin MEASUREMENT Epm_nEngOldS0_mp "Drehzahl des letzten S0-Synchros" SWORD EngN 1 100 -16384.00 16383.50 FORMAT "%8.2" ECU_ADDRESS 0xC000084C /end MEASUREMENT
/begin MEASUREMENT Epm_nEngOldS1_mp "Drehzahl des letzten S1-Synchros" SWORD EngN 1 100 -16384.00 16383.50 FORMAT "%8.2" ECU_ADDRESS 0xC000084E /end MEASUREMENT
/begin MEASUREMENT Epm_numCyl "Tatsächliche Anzahl der Zylinder" UBYTE OneToOne 1 100 0.00 255.0 FORMAT "%5.1" ECU_ADDRESS 0xD0009003 /end MEASUREMENT
/begin MEASUREMENT Epm_numVersion "" UWORD OneToOne 1 100 0.00 65535.00 FORMAT "%8.2" ECU_ADDRESS 0xD0001198 /end MEASUREMENT
/begin MEASUREMENT Epm_phiDiffTDC "Abstand zwischen zwei Zylinder" SWORD AngleCrS 1 100 -720.0220 720.0000 FORMAT "%8.4" ECU_ADDRESS 0xD0006E8A /end MEASUREMENT
/begin MEASUREMENT Epm_phiIntDelay_mp "Winkeldifferenz zwischen Soll und Ist Position des Syncro Interrupts" SWORD AngleCrS 1 100 -720.0220 720.0000 FORMAT "%8.4" ECU_ADDRESS 0xC0000846 /end MEASUREMENT
/begin MEASUREMENT Epm_stCmbTestReq "Zustand für Anforderung des Verbrennungstests" UBYTE OneToOne 1 100 0.00 255.0 FORMAT "%5.1" ECU_ADDRESS 0xD0009004 /end MEASUREMENT
/begin MEASUREMENT Epm_stOpMode "Zustand Betriebsmodus" UBYTE OneToOne 1 100 0.00 255.0 FORMAT "%5.1" ECU_ADDRESS 0xD0009005 /end MEASUREMENT
/begin MEASUREMENT Epm_stReSyncReason_mp "Ursache für Umsynchronisatin / Verlust der Synchronisation im Zustand Epm_stOpMode = 33" UBYTE OneToOne 1 100 0.00 255.0 FORMAT "%5.1" ECU_ADDRESS 0xC0000848 /end MEASUREMENT
/begin MEASUREMENT Epm_stSpd "Auswahl der Motordrehzahl" UBYTE OneToOne 1 100 0.00 255.0 FORMAT "%5.1" ECU_ADDRESS 0xD0009007 /end MEASUREMENT
/begin MEASUREMENT Epm_stSync "Zustand Synchronisation" UBYTE OneToOne 1 100 0.00 255.0 FORMAT "%5.1" ECU_ADDRESS 0xD0009008 /end MEASUREMENT
/begin MEASUREMENT Epm_tiSpd2Zero_mp "Timer bis Motordrehzahl Null" UWORD Time_ms 1 100 0.00 655350.0 FORMAT "%8.1" ECU_ADDRESS 0xC000084A /end MEASUREMENT
/begin MEASUREMENT ErrLmp_stMIL "" UBYTE OneToOne 1 100 0.00 255.0 FORMAT "%5.1" ECU_ADDRESS 0xD0009009 /end MEASUREMENT
/begin MEASUREMENT ErrLmp_stMILDigOut_mp "" UBYTE OneToOne 1 100 0.00 255.0 FORMAT "%5.1" ECU_ADDRESS 0xC0000850 /end MEASUREMENT
/begin MEASUREMENT ErrLmp_stMILReq "" UBYTE OneToOne 1 100 0.00 255.0 FORMAT "%5.1" ECU_ADDRESS 0xD000900A /end MEASUREMENT
/begin MEASUREMENT ErrLmp_stOrdGlwLmp "" UBYTE OneToOne 1 100 0.00 255.0 FORMAT "%5.1" ECU_ADDRESS 0xD000900B /end MEASUREMENT
/begin MEASUREMENT ErrLmp_stSVS "" UBYTE OneToOne 1 100 0.00 255.0 FORMAT "%5.1" ECU_ADDRESS 0xD000900C /end MEASUREMENT
/begin MEASUREMENT ErrLmp_stSVSDigOut_mp "" UBYTE OneToOne 1 100 0.00 255.0 FORMAT "%5.1" ECU_ADDRESS 0xC0000851 /end MEASUREMENT
/begin MEASUREMENT ErrLmp_stSVSReq "" UBYTE OneToOne 1 100 0.00 255.0 FORMAT "%5.1" ECU_ADDRESS 0xD000900D /end MEASUREMENT
/begin MEASUREMENT ESC_stErr "Abtastzeit Stack-Überlauffehler" UBYTE OneToOne 1 100 0.00 255.0 FORMAT "%5.1" ECU_ADDRESS 0xD0008AA6 /end MEASUREMENT
/begin MEASUREMENT ESC_stSchdCtl_mp "Scheduling Status" UBYTE OneToOne 1 100 0.00 255.0 FORMAT "%5.1" ARRAY_SIZE 22 ECU_ADDRESS 0xC0000852 /end MEASUREMENT
/begin MEASUREMENT ESC_tiSampling "Abtastzeit" SLONG Per_Dur 1 100 -2147483648.00 2147483647.00 FORMAT "%13.2" ECU_ADDRESS 0xD0003698 /end MEASUREMENT
/begin MEASUREMENT ETClb_ctDelta_mp "Zähler für Anzahl der zurückgelegten Intervalle der Länge ETClb_lLrnDelta_C" UWORD OneToOne 1 100 0.00 65535.00 FORMAT "%8.2" ECU_ADDRESS 0xC0000936 /end MEASUREMENT
/begin MEASUREMENT ETClb_ctInjCycl_mp "Aktuelle Anzahl der Einspritzzyklen für die Ansteuerdauerkalibrierung" UWORD OneToOne 1 100 0.00 65535.00 FORMAT "%8.2" ECU_ADDRESS 0xC0000868 /end MEASUREMENT
/begin MEASUREMENT ETClb_ctLrnCyclAllw_mp "Anzahl der erlaubten Lernzyklen für jeden Raildruckkalibrierpunkt" UBYTE OneToOne 1 100 0.00 255.0 FORMAT "%5.1" ARRAY_SIZE 2 ECU_ADDRESS 0xC0000938 /end MEASUREMENT
/begin MEASUREMENT ETClb_ctLrn_mp "Lernzykluszähler für jeden Raildruck-Kalibrierpunkt der Ansteuerdauerkalibrierung" UWORD OneToOne 1 100 0.00 65535.00 FORMAT "%8.2" ARRAY_SIZE 2 ECU_ADDRESS 0xC000086A /end MEASUREMENT
/begin MEASUREMENT ETClb_dtiETFlt0_mp "Gefilterte Ansteuerdauerdifferenz der Ansteuerdauerkalibrierung für jeden Zylinder beim Raildruck-Kalibrierpunkt 0" SWORD InjTime_us 1 100 -13107.20 5000.00 FORMAT "%8.2" ARRAY_SIZE 6 ECU_ADDRESS 0xC000086E /end MEASUREMENT
/begin MEASUREMENT ETClb_dtiETFlt1_mp "Gefilterte Ansteuerdauerdifferenz der Ansteuerdauerkalibrierung für jeden Zylinder beim Raildruck-Kalibrierpunkt 1" SWORD InjTime_us 1 100 -13107.20 5000.00 FORMAT "%8.2" ARRAY_SIZE 6 ECU_ADDRESS 0xC000087A /end MEASUREMENT
/begin MEASUREMENT ETClb_dtiETFlt2_mp "" SWORD InjTime_us 1 100 -13107.20 5000.00 FORMAT "%8.2" ARRAY_SIZE 6 ECU_ADDRESS 0xC0000886 /end MEASUREMENT
/begin MEASUREMENT ETClb_dtiETFlt3_mp "" SWORD InjTime_us 1 100 -13107.20 5000.00 FORMAT "%8.2" ARRAY_SIZE 6 ECU_ADDRESS 0xC0000892 /end MEASUREMENT
/begin MEASUREMENT ETClb_dtiETFlt4_mp "" SWORD InjTime_us 1 100 -13107.20 5000.00 FORMAT "%8.2" ARRAY_SIZE 6 ECU_ADDRESS 0xC000089E /end MEASUREMENT
/begin MEASUREMENT ETClb_dtiETFlt5_mp "" SWORD InjTime_us 1 100 -13107.20 5000.00 FORMAT "%8.2" ARRAY_SIZE 6 ECU_ADDRESS 0xC00008AA /end MEASUREMENT
/begin MEASUREMENT ETClb_dtiETFlt6_mp "" SWORD InjTime_us 1 100 -13107.20 5000.00 FORMAT "%8.2" ARRAY_SIZE 6 ECU_ADDRESS 0xC00008B6 /end MEASUREMENT
/begin MEASUREMENT ETClb_numCylCur_mp "Aktueller Zylinder für die Ansteuerdauerkalibrierung bei jedem Raildruck-Kalibrierpunkt" UBYTE OneToOne 1 100 0.00 255.0 FORMAT "%5.1" ARRAY_SIZE 2 ECU_ADDRESS 0xC00008C2 /end MEASUREMENT
/begin MEASUREMENT ETClb_numPres_mp "Aktueller Raildruck-Kalibrierpunkt der Ansteuerdauerkalibrierung" UBYTE OneToOne 1 100 0.00 255.0 FORMAT "%5.1" ECU_ADDRESS 0xC00008C4 /end MEASUREMENT
/begin MEASUREMENT ETClb_numRailPresClbPnt_mp "Anzahl der Raildruck-Kalibrierpunkte für die Ansteuerdauerkalibrierung" UBYTE OneToOne 1 100 0.00 255.0 FORMAT "%5.1" ECU_ADDRESS 0xC00008C5 /end MEASUREMENT
/begin MEASUREMENT ETClb_stCor "Statusanzeige der Freigaben für die Ansteuerdauerkorrektur der Nullmengenkalibrierung" UBYTE OneToOne 1 100 0.00 255.0 FORMAT "%5.1" ECU_ADDRESS 0xD0008FDF /end MEASUREMENT
/begin MEASUREMENT ETClb_stDemCor_mp "Anforderung der Ansteuerdauerkorrektur der Ansteuerdauerkalibrierung" UBYTE OneToOne 1 100 0.00 255.0 FORMAT "%5.1" ECU_ADDRESS 0xC00008C6 /end MEASUREMENT
/begin MEASUREMENT ETClb_stEvalResult_mp "Ergebnis der Ansteuerdauerkalibrierungs-Einspritzungen" UBYTE ETClb_Eval_Rslt 1 100 0.00 2.00000000000 FORMAT "%13.11" ECU_ADDRESS 0xC0000926 /end MEASUREMENT
/begin MEASUREMENT ETClb_stEval_mp "Zustand des Zustandsautomaten zur Auswertung der Ansteuerdauerkalibrierung" UBYTE ETClb_Eval_State 1 100 0.00 2.00000000000 FORMAT "%13.11" ARRAY_SIZE 2 ECU_ADDRESS 0xC0000927 /end MEASUREMENT
/begin MEASUREMENT ETClb_stLimClbFrq "Freigabestatus der Begrenzung der Lernhäufigkeit" UBYTE OneToOne 1 100 0.00 255.0 FORMAT "%5.1" ECU_ADDRESS 0xD0008FE0 /end MEASUREMENT
/begin MEASUREMENT ETClb_stRailpClbPntMaxErr_mp "Ergebnis der Ansteuerdauerkalibrierungs-Einspritzungen" UBYTE OneToOne 1 100 0.00 255.0 FORMAT "%5.1" ARRAY_SIZE 6 ECU_ADDRESS 0xC0000929 /end MEASUREMENT
/begin MEASUREMENT ETClb_stRailpClbPntMinErr_mp "Ergebnis der Ansteuerdauerkalibrierungs-Einspritzungen" UBYTE OneToOne 1 100 0.00 255.0 FORMAT "%5.1" ARRAY_SIZE 6 ECU_ADDRESS 0xC000092F /end MEASUREMENT
/begin MEASUREMENT ETClb_stRlsCylCor_mp "Zylinderspezifische Freigabe der Ansteuerdauerkorrektur der Ansteuerdauerkalibrierung" UBYTE OneToOne 1 100 0.00 255.0 FORMAT "%5.1" ECU_ADDRESS 0xC00008C7 /end MEASUREMENT
/begin MEASUREMENT ETClb_st_mp "Zustand der Ansteuerdauerkalibrierung" UBYTE ETClb_State 1 100 0.00 3.00000000000 FORMAT "%13.11" ECU_ADDRESS 0xC00008C8 /end MEASUREMENT
/begin MEASUREMENT ETClb_swtCorActv "SW-Schalter zur Aktivierung der Ansteuerdauerkorrektur der Nullmengenkalibrierung" UBYTE OneToOne 1 100 0.00 255.0 FORMAT "%5.1" ECU_ADDRESS 0xD0008FE1 /end MEASUREMENT
/begin MEASUREMENT ETClb_swtQckClb_mp "Anzeiger der Umschaltung auf schnelle Ansteuerdauerkalibrierung" UBYTE OneToOne 1 100 0.00 255.0 FORMAT "%5.1" ECU_ADDRESS 0xC00008C9 /end MEASUREMENT
/begin MEASUREMENT ETClb_swtRCClb_mp "Anzeige für Rollenprüfstandskalibrierung eingeschaltet" UBYTE OneToOne 1 100 0.00 255.0 FORMAT "%5.1" ECU_ADDRESS 0xC000093A /end MEASUREMENT
/begin MEASUREMENT ETClb_tiETChkCor0_mp "Ansteuerdauer der Nullmenge der ZFC nach Korrektur durch die IMA für Raildruck-Kalibrierpunkt 0" SWORD InjTime_us 1 100 -13107.20 5000.00 FORMAT "%8.2" ARRAY_SIZE 6 ECU_ADDRESS 0xC000093C /end MEASUREMENT
/begin MEASUREMENT ETClb_tiETChkCor1_mp "Ansteuerdauer der Nullmenge der ZFC nach Korrektur durch die IMA für Raildruck-Kalibrierpunkt 1" SWORD InjTime_us 1 100 -13107.20 5000.00 FORMAT "%8.2" ARRAY_SIZE 6 ECU_ADDRESS 0xC0000948 /end MEASUREMENT
/begin MEASUREMENT ETClb_tiETChkCor2_mp "" SWORD InjTime_us 1 100 -13107.20 5000.00 FORMAT "%8.2" ARRAY_SIZE 6 ECU_ADDRESS 0xC0000954 /end MEASUREMENT
/begin MEASUREMENT ETClb_tiETChkCor3_mp "" SWORD InjTime_us 1 100 -13107.20 5000.00 FORMAT "%8.2" ARRAY_SIZE 6 ECU_ADDRESS 0xC0000960 /end MEASUREMENT
/begin MEASUREMENT ETClb_tiETChkCor4_mp "" SWORD InjTime_us 1 100 -13107.20 5000.00 FORMAT "%8.2" ARRAY_SIZE 6 ECU_ADDRESS 0xC000096C /end MEASUREMENT
/begin MEASUREMENT ETClb_tiETChkCor5_mp "" SWORD InjTime_us 1 100 -13107.20 5000.00 FORMAT "%8.2" ARRAY_SIZE 6 ECU_ADDRESS 0xC0000978 /end MEASUREMENT
/begin MEASUREMENT ETClb_tiETChkCor6_mp "" SWORD InjTime_us 1 100 -13107.20 5000.00 FORMAT "%8.2" ARRAY_SIZE 6 ECU_ADDRESS 0xC0000984 /end MEASUREMENT
/begin MEASUREMENT ETClb_tiETCor0_mp "Ansteuerdauerkorrekturwert der Ansteuerdauer-Kalibrierung für den Raildruck-Kalibrierpunkt 0" SWORD InjTime_us 1 100 -13107.20 5000.00 FORMAT "%8.2" ARRAY_SIZE 6 ECU_ADDRESS 0xC00008CA /end MEASUREMENT
/begin MEASUREMENT ETClb_tiETCor1_mp "Ansteuerdauerkorrekturwert der Ansteuerdauer-Kalibrierung für den Raildruck-Kalibrierpunkt 1" SWORD InjTime_us 1 100 -13107.20 5000.00 FORMAT "%8.2" ARRAY_SIZE 6 ECU_ADDRESS 0xC00008D6 /end MEASUREMENT
/begin MEASUREMENT ETClb_tiETCor2_mp "" SWORD InjTime_us 1 100 -13107.20 5000.00 FORMAT "%8.2" ARRAY_SIZE 6 ECU_ADDRESS 0xC00008E2 /end MEASUREMENT
/begin MEASUREMENT ETClb_tiETCor3_mp "" SWORD InjTime_us 1 100 -13107.20 5000.00 FORMAT "%8.2" ARRAY_SIZE 6 ECU_ADDRESS 0xC00008EE /end MEASUREMENT
/begin MEASUREMENT ETClb_tiETCor4_mp "" SWORD InjTime_us 1 100 -13107.20 5000.00 FORMAT "%8.2" ARRAY_SIZE 6 ECU_ADDRESS 0xC00008FA /end MEASUREMENT
/begin MEASUREMENT ETClb_tiETCor5_mp "" SWORD InjTime_us 1 100 -13107.20 5000.00 FORMAT "%8.2" ARRAY_SIZE 6 ECU_ADDRESS 0xC0000906 /end MEASUREMENT
/begin MEASUREMENT ETClb_tiETCor6_mp "" SWORD InjTime_us 1 100 -13107.20 5000.00 FORMAT "%8.2" ARRAY_SIZE 6 ECU_ADDRESS 0xC0000912 /end MEASUREMENT
/begin MEASUREMENT ETClb_tiETCur_mp "Aktuelle Ansteuerdauer der Ansteuerdauer-Kalibrierung für jeden Raildruck-Kalibrierpunkt" SWORD InjTime_us 1 100 -13107.20 5000.00 FORMAT "%8.2" ARRAY_SIZE 2 ECU_ADDRESS 0xC000091E /end MEASUREMENT
/begin MEASUREMENT ETClb_tiETMinEff_mp "Ansteuerdauer der Nullmenge des aktuellen Zylinder für jeden Raildruck-Kalibrierpunkt" SWORD InjTime_us 1 100 -13107.20 5000.00 FORMAT "%8.2" ARRAY_SIZE 2 ECU_ADDRESS 0xC0000922 /end MEASUREMENT
/begin MEASUREMENT ETCtl_mAirDesVal "" SWORD AirMassPerCyl 1 100 -3276.800 3276.700 FORMAT "%8.3" ECU_ADDRESS 0xD0006E02 /end MEASUREMENT
/begin MEASUREMENT ETCtl_mAirDes_mp "rohe additive Korrektur des Luftmassensollwerts" SWORD AirMassPerCyl 1 100 -3276.800 3276.700 FORMAT "%8.3" ECU_ADDRESS 0xC0000990 /end MEASUREMENT
/begin MEASUREMENT ETCtl_mAirLam_mp "lamda-abhängige Erhöhung der additiven Korrektur des Luftmassensollwerts" SWORD AirMassPerCyl 1 100 -3276.800 3276.700 FORMAT "%8.3" ECU_ADDRESS 0xC0000992 /end MEASUREMENT
/begin MEASUREMENT ETCtl_mAirMin_mp "minimale additive Korrektur des Luftmassensollwerts" SWORD AirMassPerCyl 1 100 -3276.800 3276.700 FORMAT "%8.3" ECU_ADDRESS 0xC0000994 /end MEASUREMENT
/begin MEASUREMENT ETCtl_mAirRng_mp "Spanne der additiven Korrektur des Luftmassensollwerts" SWORD AirMassPerCyl 1 100 -3276.800 3276.700 FORMAT "%8.3" ECU_ADDRESS 0xC0000996 /end MEASUREMENT
/begin MEASUREMENT ETCtl_phiPoI1Cor "Abgastemperaturreglerbedingte Korrektur für PoI1-SOE-Winkel" SWORD AngleCrS 1 100 -720.0220 720.0000 FORMAT "%8.4" ECU_ADDRESS 0xD0006E0A /end MEASUREMENT
/begin MEASUREMENT ETCtl_phiPoI2Cor "Abgastemperaturreglerbedingte Korrektur für PoI2-SOE-Winkel" SWORD AngleCrS 1 100 -720.0220 720.0000 FORMAT "%8.4" ECU_ADDRESS 0xD0006E0C /end MEASUREMENT
/begin MEASUREMENT ETCtl_qPoI1 "Abgastemperaturreglerbedingte Korrektur für PoI1-Menge" SWORD InjMassInj 1 100 -327.6800 327.6700 FORMAT "%8.4" ECU_ADDRESS 0xD0006E0E /end MEASUREMENT
/begin MEASUREMENT ETCtl_qPoI1Min_mp "minimale additive Korrektur von später Nacheinspritzmenge" SWORD InjMassInj 1 100 -327.6800 327.6700 FORMAT "%8.4" ECU_ADDRESS 0xC00009B0 /end MEASUREMENT
/begin MEASUREMENT ETCtl_qPoI1Raw "aus dem äußeren Regelkreis gefordete Additive Korrektur von später Nacheinspritzmenge" SWORD InjMassInj 1 100 -327.6800 327.6700 FORMAT "%8.4" ECU_ADDRESS 0xD0006E10 /end MEASUREMENT
/begin MEASUREMENT ETCtl_qPoI1RawTmp_mp "rohe additive Korrektur von später Nacheinspritzmenge" SWORD InjMassInj 1 100 -327.6800 327.6700 FORMAT "%8.4" ECU_ADDRESS 0xC00009B2 /end MEASUREMENT
/begin MEASUREMENT ETCtl_qPoI1Rng_mp "Spanne der additiven Korrektur von später Nacheinspritzmenge" SWORD InjMassInj 1 100 -327.6800 327.6700 FORMAT "%8.4" ECU_ADDRESS 0xC00009B4 /end MEASUREMENT
/begin MEASUREMENT ETCtl_qPoI2 "Abgastemperaturreglerbedingte Korrektur für PoI2-Menge" SWORD InjMassInj 1 100 -327.6800 327.6700 FORMAT "%8.4" ECU_ADDRESS 0xD0006E12 /end MEASUREMENT
/begin MEASUREMENT ETCtl_qPoI2Min_mp "minimale additive Korrektur von angelagerter Nacheinspritzmenge" SWORD InjMassInj 1 100 -327.6800 327.6700 FORMAT "%8.4" ECU_ADDRESS 0xC0000998 /end MEASUREMENT
/begin MEASUREMENT ETCtl_qPoI2Raw_mp "rohe additive Korrektur von angelagerter Nacheinspritzmenge" SWORD InjMassInj 1 100 -327.6800 327.6700 FORMAT "%8.4" ECU_ADDRESS 0xC000099A /end MEASUREMENT
/begin MEASUREMENT ETCtl_qPoI2Rng_mp "Spanne der additiven Korrektur von angelagerter Nacheinspritzmenge" SWORD InjMassInj 1 100 -327.6800 327.6700 FORMAT "%8.4" ECU_ADDRESS 0xC000099C /end MEASUREMENT
/begin MEASUREMENT ETCtl_rIInr_mp "I-Anteil des Ausgangs des inneren Regelkreises" SWORD ETCtlGov_p0q001 1 100 -32.76800 32.76700 FORMAT "%8.5" ECU_ADDRESS 0xC000099E /end MEASUREMENT
/begin MEASUREMENT ETCtl_rInr_mp "Ausgang des inneren Regelkreises" SWORD ETCtlGov_p0q001 1 100 -32.76800 32.76700 FORMAT "%8.5" ECU_ADDRESS 0xC00009A0 /end MEASUREMENT
/begin MEASUREMENT ETCtl_rIOutr_mp "I-Anteil des Ausgangs des äußeren Regelkreises" SWORD ETCtlGov_p0q001 1 100 -32.76800 32.76700 FORMAT "%8.5" ECU_ADDRESS 0xC00009B6 /end MEASUREMENT
/begin MEASUREMENT ETCtl_rLamRecExhMnfDs_mp "" SWORD AirMassPerCyl 1 100 -3276.800 3276.700 FORMAT "%8.3" ECU_ADDRESS 0xC00009A2 /end MEASUREMENT
/begin MEASUREMENT ETCtl_rMaxInr_mp "maximaler Ausgang des inneren Regelkreises" SWORD ETCtlGov_p0q001 1 100 -32.76800 32.76700 FORMAT "%8.5" ECU_ADDRESS 0xC00009A4 /end MEASUREMENT
/begin MEASUREMENT ETCtl_rMaxOutr_mp "maximaler Ausgang des äußeren Regelkreises" SWORD ETCtlGov_p0q001 1 100 -32.76800 32.76700 FORMAT "%8.5" ECU_ADDRESS 0xC00009B8 /end MEASUREMENT
/begin MEASUREMENT ETCtl_rMinInr_mp "minimaler Ausgang des inneren Regelkreises" SWORD ETCtlGov_p0q001 1 100 -32.76800 32.76700 FORMAT "%8.5" ECU_ADDRESS 0xC00009A6 /end MEASUREMENT
/begin MEASUREMENT ETCtl_rMinOutr_mp "minimaler Ausgang des äußeren Regelkreises" SWORD ETCtlGov_p0q001 1 100 -32.76800 32.76700 FORMAT "%8.5" ECU_ADDRESS 0xC00009BA /end MEASUREMENT
/begin MEASUREMENT ETCtl_rOutr_mp "Ausgang des äußeren Regelkreises" SWORD ETCtlGov_p0q001 1 100 -32.76800 32.76700 FORMAT "%8.5" ECU_ADDRESS 0xC00009BC /end MEASUREMENT
/begin MEASUREMENT ETCtl_rPInr_mp "P-Anteil des Ausgangs des inneren Regelkreises" SWORD ETCtlGov_p0q001 1 100 -32.76800 32.76700 FORMAT "%8.5" ECU_ADDRESS 0xC00009A8 /end MEASUREMENT
/begin MEASUREMENT ETCtl_rPOutr_mp "I-Anteil des Ausgangs des äußeren Regelkreises" SWORD ETCtlGov_p0q001 1 100 -32.76800 32.76700 FORMAT "%8.5" ECU_ADDRESS 0xC00009BE /end MEASUREMENT
/begin MEASUREMENT ETCtl_rStyInr_mp "Modellierter stationärer Reglerausgang des inneren Regelkreises" SWORD ETCtlGov_p0q001 1 100 -32.76800 32.76700 FORMAT "%8.5" ECU_ADDRESS 0xC00009AA /end MEASUREMENT
/begin MEASUREMENT ETCtl_rStyOutr_mp "Modellierter stationärer Reglerausgang des äußeren Regelkreises" SWORD ETCtlGov_p0q001 1 100 -32.76800 32.76700 FORMAT "%8.5" ECU_ADDRESS 0xC00009C0 /end MEASUREMENT
/begin MEASUREMENT ETCtl_st "Status-Bitwort des Abgastemperaturreglers" UBYTE OneToOne 1 100 0.00 255.0 FORMAT "%5.1" ECU_ADDRESS 0xD0008FE2 /end MEASUREMENT
/begin MEASUREMENT ETCtl_stClsThrVlv_mp "Status maximale Androsselung aktiv" UBYTE OneToOne 1 100 0.00 255.0 FORMAT "%5.1" ECU_ADDRESS 0xC00009AC /end MEASUREMENT
/begin MEASUREMENT ETCtl_swtActv "Schalter zur Deaktivierung der Funktionalität des Abgastemperaturreglers" UBYTE OneToOne 1 100 0.00 255.0 FORMAT "%5.1" ECU_ADDRESS 0xD0008FE3 /end MEASUREMENT
/begin MEASUREMENT ETCtl_tDvtInr "Regelabweichung des inneren Regelkreises" SWORD TempDiff_Kelv 1 100 -3276.800 3276.700 FORMAT "%8.3" ECU_ADDRESS 0xD0006E14 /end MEASUREMENT
/begin MEASUREMENT ETCtl_tDvtInrRaw_mp "unverarbeitete Regelabweichung des inneren Regelkreises" SWORD TempDiff_Kelv 1 100 -3276.800 3276.700 FORMAT "%8.3" ECU_ADDRESS 0xC00009AE /end MEASUREMENT
/begin MEASUREMENT ETCtl_tDvtOutr "Regelabweichung des äußeren Regelkreises" SWORD TempDiff_Kelv 1 100 -3276.800 3276.700 FORMAT "%8.3" ECU_ADDRESS 0xD0006E16 /end MEASUREMENT
/begin MEASUREMENT ETCtl_tDvtOutrRaw_mp "unverarbeitete Regelabweichung des äußeren Regelkreises" SWORD TempDiff_Kelv 1 100 -3276.800 3276.700 FORMAT "%8.3" ECU_ADDRESS 0xC00009C2 /end MEASUREMENT
/begin MEASUREMENT ETCtl_tInrCorMax_mp "Maximale additive Korrektur des Sollwerts des inneren Regelkreises" SWORD TempDiff_Kelv 1 100 -3276.800 3276.700 FORMAT "%8.3" ECU_ADDRESS 0xC00009C4 /end MEASUREMENT
/begin MEASUREMENT ETCtl_tInrCorRng_mp "Spanne der additiven Korrektur des Sollwerts des inneren Regelkreises" SWORD TempDiff_Kelv 1 100 -3276.800 3276.700 FORMAT "%8.3" ECU_ADDRESS 0xC00009C6 /end MEASUREMENT
/begin MEASUREMENT ETCtl_tInrDesCor "Additive Korrektur des Sollwerts des inneren Regelkreises" SWORD TempDiff_Kelv 1 100 -3276.800 3276.700 FORMAT "%8.3" ECU_ADDRESS 0xD0006E18 /end MEASUREMENT
/begin MEASUREMENT ETCtl_tInrDesCorRaw_mp "unverarbeitete additive Korrektur des Sollwerts des inneren Regelkreises" SWORD TempDiff_Kelv 1 100 -3276.800 3276.700 FORMAT "%8.3" ECU_ADDRESS 0xC00009C8 /end MEASUREMENT
/begin MEASUREMENT ETCtl_tPFltUs_mp "" SWORD Temp_Cels 1 100 -3549.940 3003.560 FORMAT "%8.3" ECU_ADDRESS 0xC00009CA /end MEASUREMENT
/begin MEASUREMENT FanCtl_dcycAftRun_mp "Tastverhältnis im NL" SWORD DtyCyc 1 100 -327.6800 327.6700 FORMAT "%8.4" ECU_ADDRESS 0xC00009CC /end MEASUREMENT
/begin MEASUREMENT FanCtl_dcycBattCor_mp "TV nach Batt-Korr. und Hysteresefunktion" SWORD DtyCyc 1 100 -327.6800 327.6700 FORMAT "%8.4" ECU_ADDRESS 0xC00009CE /end MEASUREMENT
/begin MEASUREMENT FanCtl_dcycHysStart_mp "Startwert der Hysterese" SWORD DtyCyc 1 100 -327.6800 327.6700 FORMAT "%8.4" ECU_ADDRESS 0xC00009D0 /end MEASUREMENT
/begin MEASUREMENT FanCtl_dcycHys_mp "TV am Ausgang der Hysteresefunktion" SWORD DtyCyc 1 100 -327.6800 327.6700 FORMAT "%8.4" ECU_ADDRESS 0xC00009D2 /end MEASUREMENT
/begin MEASUREMENT FanCtl_dcycRaw_mp "Tastverhältnis Rohwert" SWORD DtyCyc 1 100 -327.6800 327.6700 FORMAT "%8.4" ECU_ADDRESS 0xC00009D4 /end MEASUREMENT
/begin MEASUREMENT FanCtl_facWghFctr_mp "Gewichtungsfaktor für Lüfterstufe aus Klimasteuerung" SWORD Fact 1 100 -4.000000 3.999878 FORMAT "%8.6" ECU_ADDRESS 0xC00009D6 /end MEASUREMENT
/begin MEASUREMENT FanCtl_nSetGbxOilMap_mp "Lüfter-Drehzahlsollwert aus Getriebeöltemp." SWORD FanSpd 1 100 -3000.092 3000.000 FORMAT "%8.3" ECU_ADDRESS 0xC00009D8 /end MEASUREMENT
/begin MEASUREMENT FanCtl_nSetPntCAN_mp "gewichteter Lüfter-Drehzahlsollwert aus Klimasteuerung" SWORD FanSpd 1 100 -3000.092 3000.000 FORMAT "%8.3" ECU_ADDRESS 0xC00009DA /end MEASUREMENT
/begin MEASUREMENT FanCtl_nSetPntMap_mp "Lüfter-Drehzahlsollwert aus Kühlmitteltemp." SWORD FanSpd 1 100 -3000.092 3000.000 FORMAT "%8.3" ECU_ADDRESS 0xC00009DC /end MEASUREMENT
/begin MEASUREMENT FanCtl_nSetPoint "Endgültige Soll- Lüfterdrehzahl" SWORD FanSpd 1 100 -3000.092 3000.000 FORMAT "%8.3" ECU_ADDRESS 0xD0006F1A /end MEASUREMENT
/begin MEASUREMENT FanCtl_nSetPoint_mp "Lüfter-Drehzahlsollwert" SWORD FanSpd 1 100 -3000.092 3000.000 FORMAT "%8.3" ECU_ADDRESS 0xC00009DE /end MEASUREMENT
/begin MEASUREMENT FanCtl_stAftRun "Statuswort, Lüftersteuerung" UBYTE OneToOne 1 100 0.00 255.0 FORMAT "%5.1" ECU_ADDRESS 0xD0009016 /end MEASUREMENT
/begin MEASUREMENT FanCtl_stDemFanShOff_mp "Ausschaltbitleiste für hohe Lenköltemperaturen" UBYTE OneToOne 1 100 0.00 255.0 FORMAT "%5.1" ECU_ADDRESS 0xC00009E0 /end MEASUREMENT
/begin MEASUREMENT FanCtl_stDemFan_mp "Einschaltbitleiste für hohe Lenköltemperaturen" UBYTE OneToOne 1 100 0.00 255.0 FORMAT "%5.1" ECU_ADDRESS 0xC00009E1 /end MEASUREMENT
/begin MEASUREMENT FanCtl_stHys_mp "Statuswort der Hysteresefunktion" UBYTE OneToOne 1 100 0.00 255.0 FORMAT "%5.1" ECU_ADDRESS 0xC00009E2 /end MEASUREMENT
/begin MEASUREMENT FanCtl_stLogic_mp "Statuswort der Ansteuerlogik" UBYTE OneToOne 1 100 0.00 255.0 FORMAT "%5.1" ECU_ADDRESS 0xC00009E3 /end MEASUREMENT
/begin MEASUREMENT FanCtl_tClnt_mp "Kühlmitteltemperatur für Sollwertberechnung" SWORD Temp_Cels 1 100 -3549.940 3003.560 FORMAT "%8.3" ECU_ADDRESS 0xC00009E4 /end MEASUREMENT
/begin MEASUREMENT FanCtl_tGbxOil_mp "Getriebeöltemp" SWORD Temp_Cels 1 100 -3549.940 3003.560 FORMAT "%8.3" ECU_ADDRESS 0xC00009E6 /end MEASUREMENT
/begin MEASUREMENT Fans_rClgDem "Prozentuale Kühlleistung des Lüfters" SWORD Prc 1 100 -400.0000 399.9878 FORMAT "%8.4" ECU_ADDRESS 0xD0006F20 /end MEASUREMENT
/begin MEASUREMENT Fans_rClgDemFan_mp "Prozentuale Kühlleistung des Lüfters" SWORD Prc 1 100 -400.0000 399.9878 FORMAT "%8.4" ECU_ADDRESS 0xC00009E8 /end MEASUREMENT
/begin MEASUREMENT Fans_rClgDesFan "Prozentuale Kühlforderung an den Lüfter" SWORD Prc 1 100 -400.0000 399.9878 FORMAT "%8.4" ECU_ADDRESS 0xD0006F22 /end MEASUREMENT
/begin MEASUREMENT Fans_trqCons "Lüfter-Momentenlast" SWORD Trq 1 100 -3276.800 3276.700 FORMAT "%8.3" ECU_ADDRESS 0xD0006F24 /end MEASUREMENT
/begin MEASUREMENT Fan_r "Tastverhältnis, Lüfter" SWORD Prc 1 100 -400.0000 399.9878 FORMAT "%8.4" ECU_ADDRESS 0xD0006F1C /end MEASUREMENT
/begin MEASUREMENT Fan_rCalc_mp "" SWORD DtyCyc 1 100 -327.6800 327.6700 FORMAT "%8.4" ECU_ADDRESS 0xC00009EA /end MEASUREMENT
/begin MEASUREMENT Fan_rCor_mp "" SWORD DtyCyc 1 100 -327.6800 327.6700 FORMAT "%8.4" ECU_ADDRESS 0xC00009EC /end MEASUREMENT
/begin MEASUREMENT Fan_rPs "" SWORD DtyCyc 1 100 -327.6800 327.6700 FORMAT "%8.4" ECU_ADDRESS 0xD0006F1E /end MEASUREMENT
/begin MEASUREMENT Fan_stErrMsg_mp "" UBYTE OneToOne 1 100 0.00 255.0 FORMAT "%5.1" ECU_ADDRESS 0xC00009EE /end MEASUREMENT
/begin FUNCTION EngECU_co ""
 /begin DEF_CHARACTERISTIC Com_dTrqOvrRunRmp.Pos_C Com_dTrqOvrRunRmp.Neg_C Com_facTrqInrStrt_C Com_nEISGovOffs_C Com_nEngOn_C Com_nEngRpm1_CUR Com_nEngRpm2_CUR Com_qOvrRun_C Com_rWaterVlvClose_C Com_rWaterVlvCtl_C Com_rWaterVlvOpen_C Com_stTrqInrErr_C Com_swtASDdc_C Com_swtEngRpmTempSel_C Com_swtHtgUpTempSel_C Com_tEngLimHi_C Com_tEngLimLo_C Com_tiDebDscAck.tiHiLo_C Com_tiDebDscAck.tiLoHi_C Com_tiDebGbxAck.tiHiLo_C Com_tiDebGbxAck.tiLoHi_C Com_tWaterVlv_C /end DEF_CHARACTERISTIC
 /begin OUT_MEASUREMENT Com_dEngineCTR Com_dTorque1CHK Com_dTorque1CTR Com_dTorque1Dummy1 Com_dTorque1Dummy2 Com_dTorque1Dummy3 Com_dTorque2CHK Com_dTorque2CTR Com_dTorque3CHK Com_dTorque3CTR Com_dTorque3Dummy2 Com_nEngRpm1 Com_nEngRpm2 Com_stBrk Com_stBrkPedal Com_stDscAck Com_stEng Com_stGbxAck Com_stHtgUp Com_stInjDu Com_stnEng Com_stOvrRun Com_stSLck Com_stSwLevRpm Com_stTrqInr Com_trqDVCH Com_trqGbx Com_trqInr Com_trqResPos /end OUT_MEASUREMENT
 /begin LOC_MEASUREMENT Com_dStatusMSACHK Com_dStatusMSACTR Com_rWaterVlv Com_stMSAFct Com_stMSAStart Com_stMSAStop Com_tEngRpm_mp Com_trqBefRmp_mp Com_trqInrLtd_mp Com_tstHtgUp_mp /end LOC_MEASUREMENT
/end FUNCTION
/begin FUNCTION EngICO_Co ""
 /begin DEF_CHARACTERISTIC EngICO_dnRmp.Pos_C EngICO_dnRmp.Neg_C EngICO_nCtOff_C EngICO_stMode_C /end DEF_CHARACTERISTIC
 /begin IN_MEASUREMENT Epm_nEng Mo_stICOMsg SpdGov_nSetPHi /end IN_MEASUREMENT
 /begin OUT_MEASUREMENT EngICO_nCtOff EngICO_stICO /end OUT_MEASUREMENT
/end FUNCTION
/begin FUNCTION EngPrt_FWOscDet "" /begin DEF_CHARACTERISTIC EngPrt_nTrqShutOff_C /end DEF_CHARACTERISTIC
 /begin IN_MEASUREMENT CoEng_st EpmSeq_numInt EpmSyn_phiInt Epm_numCyl FBC_numAASeg /end IN_MEASUREMENT
 /begin OUT_MEASUREMENT EngPrt_tiSeg /end OUT_MEASUREMENT
 /begin LOC_MEASUREMENT EngPrt_tiSegMax_mp /end LOC_MEASUREMENT
/end FUNCTION
/begin FUNCTION EngPrt_OvrSpd "" /begin DEF_CHARACTERISTIC EngPrt_nOvrSpd_C /end DEF_CHARACTERISTIC /begin IN_MEASUREMENT Epm_nEng /end IN_MEASUREMENT /begin OUT_MEASUREMENT EngPrt_stOvrSpd /end OUT_MEASUREMENT /end FUNCTION
/begin FUNCTION engprt_prtlimmech ""
 /begin DEF_CHARACTERISTIC EngPrt_RmpCBLim.Pos_C EngPrt_RmpCBLim.Neg_C EngPrt_RmpNLim.Pos_C EngPrt_RmpNLim.Neg_C EngPrt_RmpTrqLim.Pos_C EngPrt_RmpTrqLim.Neg_C EngPrt_rVnDAMax_C EngPrt_rVnDAMin_C EngPrt_rVnTrqMax_C EngPrt_rVnTrqMin_C EngPrt_swtTrqGear_CUR EngPrt_trqCBLim1_CUR EngPrt_trqCBLim_CUR EngPrt_trqLim1_CUR EngPrt_trqLimDA_CUR EngPrt_trqLim_CUR EngPrt_trqNLimSpr_CUR EngPrt_trqNLim_CUR /end DEF_CHARACTERISTIC
 /begin IN_MEASUREMENT EngDa_tEng EnvP_p Epm_nEng PT_numTraGear /end IN_MEASUREMENT
 /begin OUT_MEASUREMENT EngPrt_stTrqRampSwitch_mp EngPrt_trqLimMech EngPrt_trqLimPrvLim EngPrt_trqNLim EngPrt_trqPrtLim EngPrt_trqRamLim1_mp EngPrt_trqRamLim_mp /end OUT_MEASUREMENT
 /begin LOC_MEASUREMENT EngPrt_trqLimDA_mp /end LOC_MEASUREMENT
/end FUNCTION
/begin FUNCTION engprt_prtlimovht ""
 /begin DEF_CHARACTERISTIC EngPrt_facAPSPrv_MAP EngPrt_facOvhtPrvCT_CUR EngPrt_facOvhtPrvFT_CUR EngPrt_facOvhtPrvOT_CUR EngPrt_facOvhtPrv_MAP EngPrt_numEngTempOvhtPrv_C EngPrt_pAPSPrvDfl_C EngPrt_qOvhtPrvNRng_MAP EngPrt_qOvhtPrvVRng_MAP /end DEF_CHARACTERISTIC
 /begin IN_MEASUREMENT CEngDsT_t EnvP_p Epm_nEng FuelT_t Oil_tSwmp VehV_v /end IN_MEASUREMENT
 /begin OUT_MEASUREMENT EngPrt_facOvhtPrvCT_mp EngPrt_facOvhtPrvFT_mp EngPrt_facOvhtPrvOT_mp EngPrt_facOvhtPrv_mp EngPrt_facPrtLim EngPrt_qLimOvhtPrv EngPrt_qOvhtPrvNRng_mp EngPrt_qOvhtPrvVRng_mp EngPrt_trqLimOvhtPrv /end OUT_MEASUREMENT
 /begin LOC_MEASUREMENT EngPrt_tEngDaFld_mp /end LOC_MEASUREMENT
/end FUNCTION
/begin FUNCTION EngPrt_TrqLimCalc "" /begin IN_MEASUREMENT EngPrt_trqLimMech EngPrt_trqLimOvhtPrv /end IN_MEASUREMENT /begin OUT_MEASUREMENT EngPrt_trqLim EngPrt_trqLimLead /end OUT_MEASUREMENT /end FUNCTION
/begin FUNCTION EngReq_InjLimCalc "" /begin IN_MEASUREMENT InjSys_qLim PhyMod_facEtaCor /end IN_MEASUREMENT /begin OUT_MEASUREMENT EngReq_trqInrLimInj /end OUT_MEASUREMENT /end FUNCTION
/begin FUNCTION EngReq_SmkLimCalc ""
 /begin DEF_CHARACTERISTIC EngReq_nSlpLimMin_C EngReq_SlpLim.Pos_C EngReq_SlpLim.Neg_C /end DEF_CHARACTERISTIC
 /begin IN_MEASUREMENT Epm_nEng PhyMod_facEtaCor SmkLim_qLimSmk /end IN_MEASUREMENT
 /begin OUT_MEASUREMENT EngReq_trqInrLimSmk /end OUT_MEASUREMENT
 /begin LOC_MEASUREMENT EngReq_trqLimSmkUnLim_mp /end LOC_MEASUREMENT
/end FUNCTION
/begin FUNCTION EngReq_TrqLimCalc "" /begin IN_MEASUREMENT EngReq_trqInrLimInj EngReq_trqInrLimSmk /end IN_MEASUREMENT /begin OUT_MEASUREMENT EngReq_trqLim EngReq_trqLimLead /end OUT_MEASUREMENT /end FUNCTION
/begin FUNCTION EngStA_DD ""
 /begin DEF_CHARACTERISTIC EngStA_DigOut.tiBtwTstSCB_C EngStA_DigOut.tiBtwTstOT_C EngStA_DigOut.numTstMax_C EngStA_stPsDiaDisbl_C EngStA_stPsDisbl_C /end DEF_CHARACTERISTIC
 /begin IN_MEASUREMENT DevLib_stPwrStgEnaCond /end IN_MEASUREMENT
 /begin OUT_MEASUREMENT EngStA_st EngStA_stPs /end OUT_MEASUREMENT
/end FUNCTION
/begin FUNCTION EngTrqPtd_ASD "" /begin DEF_CHARACTERISTIC EngTrqPtd_tiT1_C EngTrqPtd_trqFltMax_C EngTrqPtd_trqMax_C /end DEF_CHARACTERISTIC /begin IN_MEASUREMENT ASDdc_trq /end IN_MEASUREMENT
 /begin OUT_MEASUREMENT EngTrqPtd_stLim EngTrqPtd_trqASD EngTrqPtd_trqASDFlt EngTrqPtd_trqFlt /end OUT_MEASUREMENT
/end FUNCTION
/begin FUNCTION EngTrqPtd_CoOfs ""
 /begin DEF_CHARACTERISTIC EngTrqPtd_nEngMin_C EngTrqPtd_rTrqNOfs_MAP EngTrqPtd_rTrqTOfs_MAP EngTrqPtd_tiPthSetDeb_C /end DEF_CHARACTERISTIC
 /begin REF_CHARACTERISTIC Mo_trqIdcMax_C /end REF_CHARACTERISTIC
 /begin IN_MEASUREMENT EngTrqPtd_trqASD Epm_nEng MoFCoOfs_rTrqPtdMsg PthSet_ctProcSet PthSet_trqInrSetNoMo PthSet_trqInrSetSum SpdGov_trqSet /end IN_MEASUREMENT
 /begin OUT_MEASUREMENT EngTrqPtd_ctProc10ms EngTrqPtd_ctProcSet EngTrqPtd_rTrqPtdOld EngTrqPtd_stPthLim EngTrqPtd_trqASDSum EngTrqPtd_trqLim EngTrqPtd_trqSpdGSum /end OUT_MEASUREMENT
 /begin LOC_MEASUREMENT EngTrqPtd_rTrqNPtd_mp EngTrqPtd_rTrqTPtd_mp EngTrqPtd_stLimDeb_mp EngTrqPtd_stLimUnDeb_mp EngTrqPtd_trqASDAvrg_mp EngTrqPtd_trqInrAvrg_mp EngTrqPtd_trqInrSet_mp EngTrqPtd_trqSpdGAvrg_mp EngTrqPtd_trqTOfs_mp /end LOC_MEASUREMENT
/end FUNCTION
/begin FUNCTION EngTrqPtd_SpdG "" /begin DEF_CHARACTERISTIC EngTrqPtd_trqSpdGPtd_MAP /end DEF_CHARACTERISTIC /begin IN_MEASUREMENT EngDa_tEng Epm_nEng /end IN_MEASUREMENT /begin OUT_MEASUREMENT EngTrqPtd_trqSpdG /end OUT_MEASUREMENT /end FUNCTION
/begin FUNCTION EnvP_DD ""
 /begin DEF_CHARACTERISTIC EnvP_pTransf_CUR EnvP_SRC.uMin_C EnvP_SRC.uMax_C EnvP_swtSig_C /end DEF_CHARACTERISTIC
 /begin OUT_MEASUREMENT EnvP_pSens EnvP_uRaw /end OUT_MEASUREMENT
/end FUNCTION
/begin FUNCTION EnvP_VD ""
 /begin DEF_CHARACTERISTIC EnvP_RmpSlp.Pos_C EnvP_RmpSlp.Neg_C EnvP_swtSensPres_C EnvP_TransStg.Dfl_C EnvP_TransStg.stSensId_C /end DEF_CHARACTERISTIC
 /begin OUT_MEASUREMENT EnvP_p /end OUT_MEASUREMENT
/end FUNCTION
/begin FUNCTION EnvP_VDModel "" /begin DEF_CHARACTERISTIC EnvP_nLimHigh_C EnvP_pCorr_MAP EnvP_tiDel_C /end DEF_CHARACTERISTIC /begin IN_MEASUREMENT Air_pCACDs Epm_nEng Epm_nEngDiff /end IN_MEASUREMENT /end FUNCTION
/begin FUNCTION EnvT_DD ""
 /begin DEF_CHARACTERISTIC EnvT_SRC.uMin_C EnvT_SRC.uMax_C EnvT_swtSig_C EnvT_tTransf_CUR /end DEF_CHARACTERISTIC
 /begin IN_MEASUREMENT Com_tEnvT /end IN_MEASUREMENT
 /begin LOC_MEASUREMENT EnvT_tSens EnvT_uRaw /end LOC_MEASUREMENT
/end FUNCTION
/begin FUNCTION EnvT_VD ""
 /begin DEF_CHARACTERISTIC EnvT_RmpSlp.Pos_C EnvT_RmpSlp.Neg_C EnvT_swtSensPres_C EnvT_tAirCorr_MAP EnvT_tClntMod_CUR EnvT_tiLPFiltPT1_C EnvT_tiTempAirPT1_C EnvT_tiTempClntPT1_C EnvT_TransStg.Dfl_C EnvT_TransStg.stSensId_C /end DEF_CHARACTERISTIC
 /begin IN_MEASUREMENT Air_pCACDs Air_tCACDs CEngDsT_t EnvP_p /end IN_MEASUREMENT
 /begin OUT_MEASUREMENT EnvT_t EnvT_tMod /end OUT_MEASUREMENT
 /begin LOC_MEASUREMENT EnvT_tAirCorrPT1_mp EnvT_tAirCorr_mp EnvT_tClntModCur_mp EnvT_tClntPT1_mp /end LOC_MEASUREMENT
/end FUNCTION
/begin FUNCTION EOS "" /begin SUB_FUNCTION SB CB Reset MemLay OS Rtmo /end SUB_FUNCTION /end FUNCTION
/begin FUNCTION epmbcr_intrco "" /begin DEF_CHARACTERISTIC EpmBCr_phiTimeoutInt_C /end DEF_CHARACTERISTIC /begin LOC_MEASUREMENT EpmBCr_stIntrCo /end LOC_MEASUREMENT /end FUNCTION
/begin FUNCTION epmcas_adap "" /begin LOC_MEASUREMENT EpmCaS_stAdap /end LOC_MEASUREMENT /end FUNCTION
/begin FUNCTION epmcas_diag ""
 /begin DEF_CHARACTERISTIC EpmCaS_numEdgeTol_C EpmCaS_numErrSigDef_C EpmCaS_numErrSigOk_C EpmCaS_numNoSigDef_C EpmCaS_stDiagMode_C /end DEF_CHARACTERISTIC
 /begin LOC_MEASUREMENT EpmCaS_ctErrSigDef EpmCaS_ctErrSigOk EpmCaS_ctNoSig EpmCaS_numCurrEdge EpmCaS_stDiag EpmCaS_stErrSig EpmCaS_stNoSig /end LOC_MEASUREMENT
/end FUNCTION
/begin FUNCTION epmcas_ofsdiag ""
 /begin DEF_CHARACTERISTIC EpmCaS_numOfsErr_C EpmCaS_phiOfsMax_C EpmCaS_phiOfsTolc_C EpmCaS_stOfsDiagMode_C EpmCaS_tiOfsPT1_C /end DEF_CHARACTERISTIC
 /begin LOC_MEASUREMENT EpmCaS_ctEdgeDiff_mp EpmCaS_ctOfsErr_mp EpmCaS_ctOfsOk_mp EpmCaS_numBufEntry_mp EpmCaS_numSegTeeth_mp EpmCaS_numValidTeeth_mp EpmCaS_phiCaSOfsAvg EpmCaS_phiMissedSeg_mp EpmCaS_phiOfsCorr EpmCaS_phiSegLenTolc_mp EpmCaS_phiSpeedSegLen_mp EpmCaS_stOfs EpmCaS_stOfsErr /end LOC_MEASUREMENT
/end FUNCTION
/begin FUNCTION epmcas_seg ""
 /begin DEF_CHARACTERISTIC EpmCaS_dSegSeries_CA EpmCaS_facPlausHigh_GCUR EpmCaS_facPlausLow_GCUR EpmCaS_facPlaus_DST EpmCaS_numPlausErrMax_C EpmCaS_numSegSerLst_C EpmCaS_phiNCor_CUR EpmCaS_phiSegLenTol_CA EpmCaS_phiSegLen_CA EpmCaS_phiSegOfs_CA EpmCaS_phiTempCor05_DST EpmCaS_phiTempCorI1_GCUR EpmCaS_stActEdge_C EpmCaS_tiGlitchFilter_C EpmCaS_tiTimeout_C /end DEF_CHARACTERISTIC
 /begin IN_MEASUREMENT EngDa_tEng Epm_nEng /end IN_MEASUREMENT
 /begin LOC_MEASUREMENT EpmCaS_ctEdgeEquid EpmCaS_nEng EpmCaS_phiCor EpmCaS_phiDiff EpmCaS_phiEdge EpmCaS_phiTempCor EpmCaS_stNEng EpmCaS_tiEdge /end LOC_MEASUREMENT
/end FUNCTION
/begin FUNCTION epmcas_segcor "" /end FUNCTION
/begin FUNCTION epmcrs_diag ""
 /begin DEF_CHARACTERISTIC EpmCrS_dnEngMax_C EpmCrS_nDiagOff_C EpmCrS_nDiagOn_C EpmCrS_numErrSigGlitMax_C EpmCrS_numErrSigIncDef_C EpmCrS_numErrSigMaxDef_C EpmCrS_numErrSigMinOK_C EpmCrS_numNoSigDef_C EpmCrS_stDiagT50Reset_C EpmCrS_swtEnableDiag_C /end DEF_CHARACTERISTIC
 /begin LOC_MEASUREMENT EpmCrS_ctCaSRev_mp EpmCrS_ctErrSig EpmCrS_ctGlitch EpmCrS_ctGlitchRev_mp EpmCrS_ctRev100msLim_mp EpmCrS_ctRevWaitDiag EpmCrS_stDiag EpmCrS_stDiagErrSig EpmCrS_stDiagNoSig EpmCrS_stResetDiag_mp EpmCrS_stSigDiagSrc /end LOC_MEASUREMENT
/end FUNCTION
/begin FUNCTION epmcrs_plaus ""
 /begin DEF_CHARACTERISTIC EpmCrS_facGapCrit1_C EpmCrS_facGapCrit2_C EpmCrS_facGapPlausHigh_CA EpmCrS_facIncPlausHigh_CA EpmCrS_facIncPlausLow_CA EpmCrS_nMaxInc_C EpmCrS_nMinInc_C EpmCrS_nThreshRange_CA EpmCrS_nTiIncPerAvrg_CA EpmCrS_numIgnInc_C EpmCrS_numTiIncPerAvrg_CA EpmCrS_tiGlitchFilter_CA EpmCrS_tiIgnSig_C /end DEF_CHARACTERISTIC
 /begin IN_MEASUREMENT EpmCrS_stSigMode Epm_nEng /end IN_MEASUREMENT
 /begin LOC_MEASUREMENT EpmCrS_ctRange_mp EpmCrS_numTiIncPerAvrg_mp EpmCrS_tiIncPer_mp /end LOC_MEASUREMENT
/end FUNCTION
/begin FUNCTION epmcrs_revcnt "" /begin OUT_MEASUREMENT EpmCrS_ctRevIni EpmCrS_ctRevStrt /end OUT_MEASUREMENT /begin LOC_MEASUREMENT EpmCrS_ctRevCnt /end LOC_MEASUREMENT /end FUNCTION
/begin FUNCTION epmcrs_seg ""
 /begin DEF_CHARACTERISTIC EpmCrS_facScale_C EpmCrS_nFacScale_C EpmCrS_stTTMeasureOn_C EpmCrS_swtIncSrc_C /end DEF_CHARACTERISTIC
 /begin OUT_MEASUREMENT EpmCrS_numSeg EpmCrS_stSigMode EpmCrS_tiSeg EpmCrS_tiSegCurr /end OUT_MEASUREMENT
 /begin LOC_MEASUREMENT EpmCrS_facScale_mp EpmCrS_numNewInc_mp EpmCrs_tiInc_mp /end LOC_MEASUREMENT
/end FUNCTION
/begin FUNCTION epmhcas_sigbuf "" /end FUNCTION
/begin FUNCTION epmhcas_sigeval "" /end FUNCTION
/begin FUNCTION epmhcrs_sigbuf "" /end FUNCTION
/begin FUNCTION epmhcrs_sigeval "" /begin OUT_MEASUREMENT EpmHCrS_stSigErr EpmHCrS_stSigMode /end OUT_MEASUREMENT /end FUNCTION
/begin FUNCTION epmhint_intgen "" /end FUNCTION
/begin FUNCTION EpmRRS_AgDetect ""
 /begin DEF_CHARACTERISTIC EpmRRS_nEngDiffMin_C EpmRRS_nEngMax_C EpmRRS_phiMax_C EpmRRS_phiUndef_C EpmRRS_tiTemp_CUR EpmRRS_uDiffMax_C /end DEF_CHARACTERISTIC
 /begin REF_CHARACTERISTIC Epm_phiTdc1_C /end REF_CHARACTERISTIC
 /begin IN_MEASUREMENT BattU_u EngDa_tEng Epm_nEng Epm_nEngDiff Epm_phiDiffTDC Epm_stSync VehV_v /end IN_MEASUREMENT
 /begin OUT_MEASUREMENT EpmRRS_bEngSwOff /end OUT_MEASUREMENT
 /begin LOC_MEASUREMENT EpmRRS_bEngStopAg_mp EpmRRS_ctInc10msRev_mp EpmRRS_ctInc10ms_mp EpmRRS_ctIncEngStop_mp EpmRRS_ctIncMax_mp EpmRRS_phiEngStop_mp EpmRRS_phiLowerLimit_mp EpmRRS_phiMax_mp EpmRRS_phiTdcCritCyl_mp EpmRRS_phiUpperLimit_mp EpmRRS_stAgDetect_mp EpmRRS_stToothAngleCond_mp EpmRRS_tiSwOffTmr_mp EpmRRS_tiToothPer_mp EpmRRS_tiTrnOffTmr_mp EpmRRS_uIniMin_mp /end LOC_MEASUREMENT
/end FUNCTION
/begin FUNCTION epmseq_statemn ""
 /begin DEF_CHARACTERISTIC EpmSeq_nMaxStrtInt_C EpmSeq_phiIntBCr_CA EpmSeq_phiInt_CA EpmSeq_phiStrtInt_CA EpmSeq_phiSyncInt_C /end DEF_CHARACTERISTIC
 /begin OUT_MEASUREMENT EpmSeq_numInt EpmSeq_phiNxtInt /end OUT_MEASUREMENT
 /begin LOC_MEASUREMENT EpmSeq_stInt /end LOC_MEASUREMENT
/end FUNCTION
/begin FUNCTION epmsrv_lib "" /end FUNCTION
/begin FUNCTION epmsyn_caspos ""
 /begin DEF_CHARACTERISTIC EpmSyn_dCaSSegMsk_C EpmSyn_dTrigMsk_C EpmSyn_dTrigRslt_C EpmSyn_phiTrig_C EpmSyn_stSigTabGapVerify_C /end DEF_CHARACTERISTIC
 /begin OUT_MEASUREMENT EpmSyn_phiCaSPos EpmSyn_stCaSPos /end OUT_MEASUREMENT
 /begin LOC_MEASUREMENT EpmSyn_CaSData EpmSyn_ctEdgeEarly EpmSyn_ctEdgeLate EpmSyn_ctLstEdge_mp EpmSyn_ctSigTabLstEntr_mp EpmSyn_EdgeFailType EpmSyn_numCaSSync EpmSyn_numMatches_mp EpmSyn_numMatchPos EpmSyn_numMatchPos_mp EpmSyn_numNewEdges_mp EpmSyn_numSegInSigTab_mp EpmSyn_phiSegLenUncorr EpmSyn_stCasEval EpmSyn_stGapPos EpmSyn_stPreSeg_mp /end LOC_MEASUREMENT
/end FUNCTION
/begin FUNCTION epmsyn_crspos "" /begin OUT_MEASUREMENT EpmSyn_phiInt EpmSyn_stCrSPos /end OUT_MEASUREMENT /begin LOC_MEASUREMENT EpmSyn_phiDiff_mp EpmSyn_stCrSPosErr /end LOC_MEASUREMENT /end FUNCTION
/begin FUNCTION epm_auto "" /begin LOC_MEASUREMENT Epm_numVersion /end LOC_MEASUREMENT /end FUNCTION
/begin FUNCTION epm_ini ""
 /begin DEF_CHARACTERISTIC Epm_numCyl_C Epm_numFireSeg_C Epm_phiGap2Zero_C Epm_phiTdc1_C /end DEF_CHARACTERISTIC
 /begin OUT_MEASUREMENT Epm_numCyl Epm_phiDiffTDC /end OUT_MEASUREMENT
/end FUNCTION
/begin FUNCTION epm_opmode "" /begin DEF_CHARACTERISTIC Epm_nNoSyncVerify_C Epm_numReSync_C Epm_swtBlkInjCaSSync_C /end DEF_CHARACTERISTIC /begin OUT_MEASUREMENT Epm_ctCyl Epm_stCmbTestReq Epm_stOpMode Epm_stSync /end OUT_MEASUREMENT /begin LOC_MEASUREMENT Epm_phiIntDelay_mp Epm_stReSyncReason_mp /end LOC_MEASUREMENT /end FUNCTION
/begin FUNCTION epm_spd "" /begin DEF_CHARACTERISTIC Epm_tiSpd2Zero_C /end DEF_CHARACTERISTIC /begin OUT_MEASUREMENT Epm_nEng Epm_nEngCurr Epm_nEngLRes Epm_stSpd /end OUT_MEASUREMENT /begin LOC_MEASUREMENT Epm_tiSpd2Zero_mp /end LOC_MEASUREMENT /end FUNCTION
/begin FUNCTION epm_spdgrd "" /begin DEF_CHARACTERISTIC Epm_tiSpdGrdFlt_C /end DEF_CHARACTERISTIC /begin IN_MEASUREMENT EpmCrS_tiSeg Epm_nEng Epm_stSync /end IN_MEASUREMENT /begin OUT_MEASUREMENT Epm_dnEng Epm_dnEngFlt Epm_nEngDiff /end OUT_MEASUREMENT /begin LOC_MEASUREMENT Epm_nEngOldS0_mp Epm_nEngOldS1_mp /end LOC_MEASUREMENT /end FUNCTION
/begin FUNCTION ErrLmp_DD ""
 /begin DEF_CHARACTERISTIC ErrLmp_MIL.nThres_C ErrLmp_MIL.tiMax_C ErrLmp_MIL.tiTst_C ErrLmp_MIL.tiDel_C ErrLmp_MIL.tiBln_C ErrLmp_MIL.stEna_C ErrLmp_MILOut.tiBtwTstSCB_C ErrLmp_MILOut.tiBtwTstOT_C ErrLmp_MILOut.numTstMax_C ErrLmp_Rdy.st_C ErrLmp_Rdy.ti_C ErrLmp_Rdy.tiBlnOn_C ErrLmp_Rdy.tiBlnOff_C ErrLmp_stPsMILDiaDisbl_C ErrLmp_stPsMILDisbl_C ErrLmp_stPsSVSDiaDisbl_C ErrLmp_stPsSVSDisbl_C ErrLmp_SVS.nThres_C ErrLmp_SVS.tiMax_C ErrLmp_SVS.tiTst_C ErrLmp_SVS.tiDel_C ErrLmp_SVS.tiBln_C ErrLmp_SVS.stEna_C ErrLmp_SVSOut.tiBtwTstSCB_C ErrLmp_SVSOut.tiBtwTstOT_C ErrLmp_SVSOut.numTstMax_C ErrLmp_swtSVSEqGlwLmp_C /end DEF_CHARACTERISTIC
 /begin IN_MEASUREMENT CoEng_st Com_stMILReq Com_stSVSReq DFES_stErrLamp Epm_nEng /end IN_MEASUREMENT
 /begin OUT_MEASUREMENT ErrLmp_stMIL ErrLmp_stMILReq ErrLmp_stOrdGlwLmp ErrLmp_stSVS ErrLmp_stSVSReq /end OUT_MEASUREMENT
 /begin LOC_MEASUREMENT ErrLmp_stMILDigOut_mp ErrLmp_stSVSDigOut_mp /end LOC_MEASUREMENT
/end FUNCTION
/begin FUNCTION ErrLmp_DD_TstState "" /end FUNCTION
/begin FUNCTION esc_seqsched ""
 /begin DEF_CHARACTERISTIC ESC_dLimCond_ASD_CA ESC_dLimCond_Common_CA ESC_dLimCond_FBC_CA ESC_dLimCond_Joint_CA ESC_dLimCond_LiGov_CA ESC_dLimCond_S0_A_CA ESC_dLimCond_S0_B_CA ESC_dLimCond_S1_A_CA ESC_dLimCond_S1_B_CA ESC_dLimCond_UnitInjector_CA ESC_dLimCond_Update_CA ESC_nInjLock_C ESC_nLimInj_C ESC_nLimThreshHyst_CA ESC_nLimThresh_CA ESC_numLimInj_C /end DEF_CHARACTERISTIC
 /begin IN_MEASUREMENT EpmSeq_numInt ESC_tiSampling /end IN_MEASUREMENT
 /begin LOC_MEASUREMENT ESC_stSchdCtl_mp /end LOC_MEASUREMENT
/end FUNCTION
/begin FUNCTION esc_stack "" /begin OUT_MEASUREMENT ESC_tiSampling /end OUT_MEASUREMENT /begin LOC_MEASUREMENT ESC_stErr /end LOC_MEASUREMENT /end FUNCTION
/begin FUNCTION esc_tasklink "" /begin DEF_CHARACTERISTIC ESC_stS1FrstSched_C /end DEF_CHARACTERISTIC /begin IN_MEASUREMENT SyC_stSub /end IN_MEASUREMENT /end FUNCTION
/begin FUNCTION ETClb_AVS "" /end FUNCTION
/begin FUNCTION ETClb_Calibration ""
 /begin DEF_CHARACTERISTIC ETClb_CorActv.xVal_C ETClb_CorActv.xTyp_C ETClb_ctLrnThresQck_C ETClb_ctLrnThresRC_C ETClb_ctLrnThres_C ETClb_dpRailLim_CA ETClb_facFltQck_C ETClb_facFltRC_C ETClb_facFlt_C ETClb_numCyclMeas_C ETClb_numCyclNoDyn_C ETClb_numCyclStartEnergize_C ETClb_pRailSet_CA ETClb_SigThres_CA ETClb_swtWrDflVal_C ETClb_volEffectiveMin_CA ETClb_vStartClb_CA ETClb_vStopClb_CA /end DEF_CHARACTERISTIC
 /begin REF_CHARACTERISTIC ETClb_tiET_MAX_CA ETClb_tiET_MIN_CA InjVlv_stZFCETCorActv_C InjVlv_swtZFCCorOvrRunOn_C /end REF_CHARACTERISTIC
 /begin IN_MEASUREMENT ETClb_stLimClbFrq MoFOvR_stActvMsg PthSet_stOvrRunCoord VehV_v /end IN_MEASUREMENT
 /begin OUT_MEASUREMENT ETClb_stCor ETClb_swtCorActv /end OUT_MEASUREMENT
 /begin LOC_MEASUREMENT ETClb_ctInjCycl_mp ETClb_ctLrn_mp ETClb_dtiETFlt0_mp ETClb_dtiETFlt1_mp ETClb_dtiETFlt2_mp ETClb_dtiETFlt3_mp ETClb_dtiETFlt4_mp ETClb_dtiETFlt5_mp ETClb_dtiETFlt6_mp ETClb_numCylCur_mp ETClb_numPres_mp ETClb_numRailPresClbPnt_mp ETClb_stDemCor_mp ETClb_stRlsCylCor_mp ETClb_st_mp ETClb_swtQckClb_mp ETClb_tiETCor0_mp ETClb_tiETCor1_mp ETClb_tiETCor2_mp ETClb_tiETCor3_mp ETClb_tiETCor4_mp ETClb_tiETCor5_mp ETClb_tiETCor6_mp ETClb_tiETCur_mp ETClb_tiETMinEff_mp /end LOC_MEASUREMENT
/end FUNCTION
/begin FUNCTION ETClb_Eval "" /begin DEF_CHARACTERISTIC ETClb_tiETStep_CA ETClb_tiET_MAX_CA ETClb_tiET_MIN_CA /end DEF_CHARACTERISTIC
 /begin LOC_MEASUREMENT ETClb_stEvalResult_mp ETClb_stEval_mp ETClb_stRailpClbPntMaxErr_mp ETClb_stRailpClbPntMinErr_mp /end LOC_MEASUREMENT
/end FUNCTION
/begin FUNCTION ETClb_Lib ""
 /begin DEF_CHARACTERISTIC ETClb_ctDflLrnAllw_CA ETClb_ctDflLrn_CA ETClb_ctLrnPerDelta_C ETClb_dtiDflETFlt0_CA ETClb_dtiDflETFlt1_CA ETClb_dtiDflETFlt2_CA ETClb_dtiDflETFlt3_CA ETClb_dtiDflETFlt4_CA ETClb_dtiDflETFlt5_CA ETClb_dtiDflETFlt6_CA ETClb_lDelta_C ETClb_lLrnDelta_C ETClb_numDflCylCur_CA ETClb_stRlsCylCorDfl_C ETClb_swtDflLimClbFrq_C ETClb_swtDflQckClb_C ETClb_swtLimClbFrqOff_C ETClb_tiDflETCur_CA ETClb_tiETOfs_CA /end DEF_CHARACTERISTIC
 /begin REF_CHARACTERISTIC ETClb_ctLrnThres_C ETClb_pRailSet_CA ETClb_swtWrDflVal_C ETClb_tiET_MAX_CA ETClb_tiET_MIN_CA ETClb_volEffectiveMin_CA InjVlv_stZFCETCorActv_C InjVlv_swtZFCCorOvrRunOn_C /end REF_CHARACTERISTIC
 /begin IN_MEASUREMENT Epm_numCyl ETClb_stCor ETClb_swtCorActv GlbDa_lTotDst MoFOvR_stActvMsg /end IN_MEASUREMENT
 /begin OUT_MEASUREMENT ETClb_stLimClbFrq /end OUT_MEASUREMENT
 /begin LOC_MEASUREMENT ETClb_ctDelta_mp ETClb_ctLrnCyclAllw_mp ETClb_swtRCClb_mp ETClb_tiETChkCor0_mp ETClb_tiETChkCor1_mp ETClb_tiETChkCor2_mp ETClb_tiETChkCor3_mp ETClb_tiETChkCor4_mp ETClb_tiETChkCor5_mp ETClb_tiETChkCor6_mp /end LOC_MEASUREMENT
/end FUNCTION
/begin FUNCTION ETCtl_Ini "" /begin DEF_CHARACTERISTIC ETCtl_swtActv_C /end DEF_CHARACTERISTIC /begin OUT_MEASUREMENT ETCtl_swtActv /end OUT_MEASUREMENT /end FUNCTION
/begin FUNCTION ETCtl_InrLp ""
 /begin DEF_CHARACTERISTIC ETCtl_facKiAirMsPT_CUR ETCtl_facKiNegInr_C ETCtl_facKiPosInr_C ETCtl_facKiQntPoI2_MAP ETCtl_facKpAirMsPT_CUR ETCtl_facKpNegInr_C ETCtl_facKpPosInr_C ETCtl_facKpQntPoI2_MAP ETCtl_facPoI2PoI1Dist_C ETCtl_mAirLam_CUR ETCtl_mAirMax_MAP ETCtl_mAirMin_MAP ETCtl_mAirThresOff_C ETCtl_phiPoI2Cor_MAP ETCtl_qPoI2Max_MAP ETCtl_qPoI2Min_C ETCtl_qPoI2Min_MAP ETCtl_qPoI2ThresOff_C ETCtl_rDeltaMaxInr_C ETCtl_stMskClsThrVlv_C ETCtl_swtPoI2PoI1Dist_C ETCtl_tiRmpInr_C ETCtl_tWinNegInr_C ETCtl_tWinPosInr_C /end DEF_CHARACTERISTIC
 /begin IN_MEASUREMENT ASMod_rLamRecExhMnfDs CoEOM_stOpModeAct Epm_nEng ETCtl_qPoI1Raw ETCtl_st ETCtl_swtActv ETCtl_tInrDesCor Exh_tAdapTTrbnUs InjCtl_qSetUnBal PFlt_tInrDes /end IN_MEASUREMENT
 /begin OUT_MEASUREMENT ETCtl_mAirDesVal ETCtl_phiPoI2Cor ETCtl_qPoI1 ETCtl_qPoI2 ETCtl_tDvtInr /end OUT_MEASUREMENT
 /begin LOC_MEASUREMENT ETCtl_mAirDes_mp ETCtl_mAirLam_mp ETCtl_mAirMin_mp ETCtl_mAirRng_mp ETCtl_qPoI2Min_mp ETCtl_qPoI2Raw_mp ETCtl_qPoI2Rng_mp ETCtl_rIInr_mp ETCtl_rInr_mp ETCtl_rLamRecExhMnfDs_mp ETCtl_rMaxInr_mp ETCtl_rMinInr_mp ETCtl_rPInr_mp ETCtl_rStyInr_mp ETCtl_stClsThrVlv_mp ETCtl_tDvtInrRaw_mp /end LOC_MEASUREMENT
/end FUNCTION
/begin FUNCTION ETCtl_Mon ""
 /begin DEF_CHARACTERISTIC ETCtl_DebPoI.tiHiLo_C ETCtl_DebPoI.tiLoHi_C ETCtl_DebTemp.tiHiLo_C ETCtl_DebTemp.tiLoHi_C ETCtl_stMskInr_CA ETCtl_stMskNSC_C ETCtl_stMskOutr_CA ETCtl_tInrDvtMax_C ETCtl_tInrDvtMin_C ETCtl_tInrThresDwn_C ETCtl_tInrThresUp_C ETCtl_tOutrDvtMax_C ETCtl_tOutrDvtMin_C ETCtl_tOutrThresDwn_C ETCtl_tOutrThresUp_C ETCtl_tOxiCatUsThresBrn_C /end DEF_CHARACTERISTIC
 /begin IN_MEASUREMENT CoEOM_stOpModeAct ETCtl_swtActv ETCtl_tDvtInr ETCtl_tDvtOutr Exh_tAdapTOxiCatUs Exh_tAdapTPFltUs Exh_tAdapTTrbnUs InjCrv_stInjCharActVal /end IN_MEASUREMENT
 /begin OUT_MEASUREMENT ETCtl_st /end OUT_MEASUREMENT
/end FUNCTION
/begin FUNCTION ETCtl_OutrLp ""
 /begin DEF_CHARACTERISTIC ETCtl_facKiNegOutr_C ETCtl_facKiPosOutr_C ETCtl_facKiQntPoI1_MAP ETCtl_facKiTempInrCor_MAP ETCtl_facKpNegOutr_C ETCtl_facKpPosOutr_C ETCtl_facKpQntPoI1_MAP ETCtl_facKpTempInrCor_MAP ETCtl_numTempSensOutrLp_C ETCtl_phiPoI1Cor_MAP ETCtl_qPoI1Max_MAP ETCtl_qPoI1Min_C ETCtl_qPoI1Min_MAP ETCtl_qPoI1ThresOff_C ETCtl_rDeltaMaxOutr_C ETCtl_swtPoI1PoI2Dist_C ETCtl_tInrCorMax_MAP ETCtl_tInrCorMin_MAP ETCtl_tInrCorThresOff_C ETCtl_tiRmpOutr_C ETCtl_tWinNegOutr_C ETCtl_tWinPosOutr_C /end DEF_CHARACTERISTIC
 /begin IN_MEASUREMENT Epm_nEng ETCtl_st ETCtl_swtActv Exh_tFld InjCtl_qSetUnBal PFlt_tOutrDes /end IN_MEASUREMENT
 /begin OUT_MEASUREMENT ETCtl_phiPoI1Cor ETCtl_qPoI1Raw ETCtl_tDvtOutr ETCtl_tInrDesCor /end OUT_MEASUREMENT
 /begin LOC_MEASUREMENT ETCtl_qPoI1Min_mp ETCtl_qPoI1RawTmp_mp ETCtl_qPoI1Rng_mp ETCtl_rIOutr_mp ETCtl_rMaxOutr_mp ETCtl_rMinOutr_mp ETCtl_rOutr_mp ETCtl_rPOutr_mp ETCtl_rStyOutr_mp ETCtl_tDvtOutrRaw_mp ETCtl_tInrCorMax_mp ETCtl_tInrCorRng_mp ETCtl_tInrDesCorRaw_mp ETCtl_tPFltUs_mp /end LOC_MEASUREMENT
/end FUNCTION
/begin FUNCTION etc_auto "" /begin DEF_CHARACTERISTIC Etc_MaxReqTO_C /end DEF_CHARACTERISTIC /end FUNCTION
/begin FUNCTION ExeCon "" /end FUNCTION
/begin FUNCTION execon_auto "" /end FUNCTION
/begin FUNCTION FanCtl_Spd ""
 /begin DEF_CHARACTERISTIC FanCtl_dcycAftRun_C FanCtl_dcycHysDelta_C FanCtl_dcycMax_C FanCtl_dcycMinOff_C FanCtl_dcycSwtLimOff_C FanCtl_dcycSwtLimOn_C FanCtl_dcyc_CUR FanCtl_facWghFctr_CUR FanCtl_nDemFanOffLim_C FanCtl_nDemFanOn_C FanCtl_nMin_C FanCtl_nSetGbxOil_MAP FanCtl_nSetPnt_MAP FanCtl_nSetPointFanOn_C FanCtl_stDemFanOffGear_C FanCtl_stDemFanOnGear_C FanCtl_swtBattCor_C FanCtl_tClntDfl_C FanCtl_tDemFanOffLim_C FanCtl_tDemFanOnLim_C FanCtl_tEngAftRunThres_C FanCtl_tGbxOilDfl_C FanCtl_tiDemFanOn_C FanCtl_tiMinAftRunOfs_C FanCtl_uBattRef_C FanCtl_vDemFanOffMax_C FanCtl_vDemFanOffMin_C FanCtl_vDemFanOnMax_C FanCtl_vDemFanOnMin_C /end DEF_CHARACTERISTIC
 /begin IN_MEASUREMENT GlbDa_vX /end IN_MEASUREMENT
 /begin OUT_MEASUREMENT FanCtl_nSetPoint FanCtl_stAftRun /end OUT_MEASUREMENT
 /begin LOC_MEASUREMENT FanCtl_dcycAftRun_mp FanCtl_dcycBattCor_mp FanCtl_dcycHysStart_mp FanCtl_dcycHys_mp FanCtl_dcycRaw_mp FanCtl_facWghFctr_mp FanCtl_nSetGbxOilMap_mp FanCtl_nSetPntCAN_mp FanCtl_nSetPntMap_mp FanCtl_nSetPoint_mp FanCtl_stDemFanShOff_mp FanCtl_stDemFan_mp FanCtl_stHys_mp FanCtl_stLogic_mp FanCtl_tClnt_mp FanCtl_tGbxOil_mp /end LOC_MEASUREMENT
/end FUNCTION
/begin FUNCTION fanctl_spd_inl ""
 /begin DEF_CHARACTERISTIC FanCtl_facCorErr_C FanCtl_nSpd2Win1L_C FanCtl_nSpd2Win1R_C FanCtl_nSpd2Win2L_C FanCtl_nSpd2Win2R_C FanCtl_nSpd2Win3L_C FanCtl_nSpd2Win3R_C FanCtl_nSpdWin1L_C FanCtl_nSpdWin1R_C FanCtl_nSpdWin2L_C FanCtl_nSpdWin2R_C FanCtl_nSpdWin3L_C FanCtl_nSpdWin3R_C /end DEF_CHARACTERISTIC
/end FUNCTION
/begin FUNCTION fans_clgdem "" /begin DEF_CHARACTERISTIC Fans_facVelCor_CUR Fans_rRampP.Pos_C Fans_rRampP.Neg_C /end DEF_CHARACTERISTIC /begin IN_MEASUREMENT AC_rClgDem CoTS_rClgDem ETM_rClgDem GlbDa_vX /end IN_MEASUREMENT /begin OUT_MEASUREMENT Fans_rClgDesFan /end OUT_MEASUREMENT /begin LOC_MEASUREMENT Fans_rClgDem Fans_rClgDemFan_mp /end LOC_MEASUREMENT /end FUNCTION
/begin FUNCTION fans_clgdem_inl "" /begin DEF_CHARACTERISTIC Fans_facVelCorErr_C /end DEF_CHARACTERISTIC /end FUNCTION
/begin FUNCTION fans_trq "" /begin OUT_MEASUREMENT Fans_trqCons /end OUT_MEASUREMENT /end FUNCTION
/begin FUNCTION Fan_DD ""
 /begin DEF_CHARACTERISTIC Fan_4WinSigDur.tiErr1Min_C Fan_4WinSigDur.tiErr1Max_C Fan_4WinSigDur.tiErr2Min_C Fan_4WinSigDur.tiErr2Max_C Fan_4WinSigDur.tiErr3Min_C Fan_4WinSigDur.tiErr3Max_C Fan_4WinSigDur.tiErr4Min_C Fan_4WinSigDur.tiErr4Max_C Fan_Pwm.tiPer_C Fan_Pwm.stLvl_C Fan_Pwm.rMaxDty_C Fan_Pwm.rPerUn_C Fan_Pwm.tiPh_C Fan_PwmOut.rMin_C Fan_PwmOut.rMax_C Fan_PwmOut.tiBtwTstSCB_C Fan_PwmOut.tiBtwTstOT_C Fan_PwmOut.numTstMax_C Fan_PwmOut.swtBattCor_C Fan_PwmOut.swtPsInv_C Fan_rCnv_CUR Fan_rPsDisbl_C Fan_stPsDiaDisbl_C Fan_stPsDisbl_C Fan_typ4WinDia_C /end DEF_CHARACTERISTIC
 /begin IN_MEASUREMENT BattU_facCor DevLib_stPwrStgEnaCond FanCtl_stAftRun /end IN_MEASUREMENT
 /begin OUT_MEASUREMENT Fan_r Fan_rPs /end OUT_MEASUREMENT
 /begin LOC_MEASUREMENT Fan_rCalc_mp Fan_rCor_mp Fan_stErrMsg_mp /end LOC_MEASUREMENT
/end FUNCTION
/begin COMPU_METHOD AirMassPerCyl "" RAT_FUNC "%6.3" "mg/Hub" COEFFS 0 10 0 0 0 1 /end COMPU_METHOD
/begin COMPU_METHOD AngleCrS "" RAT_FUNC "%6.4" "deg CrS" COEFFS 0 45.5097222222222 0 0 0 1 /end COMPU_METHOD
/begin COMPU_METHOD CrSRev2CrSInc "" RAT_FUNC "%6.4" "-" COEFFS 0 60 0 0 0 1 /end COMPU_METHOD
/begin COMPU_METHOD CylPresVolt "" RAT_FUNC "%6.2" "mV" COEFFS 0 1.24090909090909 0 0 0 1 /end COMPU_METHOD
/begin COMPU_METHOD dFlConsum "" RAT_FUNC "%6.4" "l/h/s" COEFFS 0 100 0 0 0 1 /end COMPU_METHOD
/begin COMPU_METHOD dTrq "" RAT_FUNC "%6.3" "Nm/s" COEFFS 0 10 0 0 0 1 /end COMPU_METHOD
/begin COMPU_METHOD DtyCyc "" RAT_FUNC "%6.4" "%" COEFFS 0 100 0 0 0 1 /end COMPU_METHOD
/begin COMPU_METHOD ECUOFF_TMR_SY_Compu "" TAB_VERB "%6.3" "-" COMPU_TAB_REF ECUOFF_TMR_SY_Compu /end COMPU_METHOD
/begin COMPU_VTAB ECUOFF_TMR_SY_Compu "" TAB_VERB 2 0 "0" 1 "1" /end COMPU_VTAB
/begin COMPU_METHOD EGTFact "" RAT_FUNC "%6.5" "-" COEFFS 0 1000 0 0 0 1 /end COMPU_METHOD
/begin COMPU_METHOD EGTSwt "" RAT_FUNC "%10.9" "-" COEFFS 0 16384000 0 0 0 1 /end COMPU_METHOD
/begin COMPU_METHOD EngN "" RAT_FUNC "%6.3" "rpm" COEFFS 0 2 0 0 0 1 /end COMPU_METHOD
/begin COMPU_METHOD EngN2tiIncPer "" RAT_FUNC "%8.0" "rpm" COEFFS 0 0 1 0 4.0000002e-007 0 /end COMPU_METHOD
/begin COMPU_METHOD EngNGrd "" RAT_FUNC "%6.3" "rpm/s" COEFFS 0 2 0 0 0 1 /end COMPU_METHOD
/begin COMPU_METHOD EngN_LRes "" RAT_FUNC "%6.1" "rpm" COEFFS 0 0.025 0 0 0 1 /end COMPU_METHOD
/begin COMPU_METHOD EngTempFldSel "" TAB_VERB "%6.3" "-" COMPU_TAB_REF EngTempFldSel /end COMPU_METHOD
/begin COMPU_VTAB EngTempFldSel "" TAB_VERB 3 0 "Coolant_Temperature" 1 "Oil_Temperature" 2 "EngDa_tEng" /end COMPU_VTAB
/begin COMPU_METHOD EpmBCr_stIntrCo_State_t "" TAB_VERB "%6.3" "-" COMPU_TAB_REF EpmBCr_stIntrCo_State_t /end COMPU_METHOD
/begin COMPU_VTAB EpmBCr_stIntrCo_State_t "" TAB_VERB 1 0 "EPMBCR_STINTRCO_NOPOS" /end COMPU_VTAB
/begin COMPU_METHOD EpmCaS_Fac_Plaus "" RAT_FUNC "%6.5" "-" COEFFS 0 1000 0 0 0 1 /end COMPU_METHOD
/begin COMPU_METHOD EpmCaS_stAdap_State "" TAB_VERB "%6.3" "-" COMPU_TAB_REF EpmCaS_stAdap_State /end COMPU_METHOD
/begin COMPU_VTAB EpmCaS_stAdap_State "" TAB_VERB 5 0 "EPMCAS_STNOADAP" 1 "EPMCAS_STERRADAP" 2 "EPMCAS_STADAP" 3 "EPMCAS_STADAPSTOP" 4 "EPMCAS_STFULLADAP" /end COMPU_VTAB
/begin COMPU_METHOD EpmRRS_bEngStopAg_t "Umrechnungsformel für Gültigkeitsbit" TAB_VERB "%6.3" "-" COMPU_TAB_REF EpmRRS_bEngStopAg_t /end COMPU_METHOD
/begin COMPU_VTAB EpmRRS_bEngStopAg_t "Umrechnungsformel für Gültigkeitsbit" TAB_VERB 2 0 "EPMRRS_STOP_AG_NOT_VALID" 1 "EPMRRS_STOP_AG_VALID" /end COMPU_VTAB
/begin COMPU_METHOD EpmRRS_stAgDetect_t "Umrechnungsformel für Zustandsvariable" TAB_VERB "%6.3" "-" COMPU_TAB_REF EpmRRS_stAgDetect_t /end COMPU_METHOD
/begin COMPU_VTAB EpmRRS_stAgDetect_t "Umrechnungsformel für Zustandsvariable" TAB_VERB 7 0 "EPMRRS_DISABLE" 1 "EPMRRS_ENABLE" 2 "EPMRRS_SEARCH" 3 "EPMRRS_REJECT" 4 "EPMRRS_POSSIBLE" 5 "EPMRRS_CONFIRM" 6 "EPMRRS_UNDEF" /end COMPU_VTAB
/begin COMPU_METHOD EpmSeq_numInt_Compu "" TAB_VERB "%6.3" "-" COMPU_TAB_REF EpmSeq_numInt_Compu /end COMPU_METHOD
/begin COMPU_VTAB EpmSeq_numInt_Compu "" TAB_VERB 8 0 "S_0" 1 "S_1" 2 "S_0_FIRST" 3 "S_1_FIRST" 6 "S_0_FIRST_START" 7 "S_1_FIRST_START" 8 "S_EPM" 16 "S_INI" /end COMPU_VTAB
/begin COMPU_METHOD EpmSeq_stInt_Compu "" TAB_VERB "%6.3" "-" COMPU_TAB_REF EpmSeq_stInt_Compu /end COMPU_METHOD
/begin COMPU_VTAB EpmSeq_stInt_Compu "" TAB_VERB 5 0 "ST_S_0" 1 "ST_S_1" 4 "ST_S_0_START" 5 "ST_S_1_START" 8 "ST_EPM" /end COMPU_VTAB
/begin COMPU_METHOD EpmSyn_EdgeFailTypes "" TAB_VERB "%6.3" "-" COMPU_TAB_REF EpmSyn_EdgeFailTypes /end COMPU_METHOD
/begin COMPU_VTAB EpmSyn_EdgeFailTypes "" TAB_VERB 3 0 "EPMSYN_EDGE_OK" 1 "EPMSYN_EDGE_EARLY" 2 "EPMSYN_EDGE_LATE" /end COMPU_VTAB
/begin COMPU_METHOD EPM_FAC_PLAUS "" RAT_FUNC "%6.4" "-" COEFFS 0 16 0 0 0 1 /end COMPU_METHOD
/begin COMPU_METHOD ETClb_Eval_Rslt "" TAB_VERB "%6.3" "-" COMPU_TAB_REF ETClb_Eval_Rslt /end COMPU_METHOD
/begin COMPU_VTAB ETClb_Eval_Rslt "" TAB_VERB 3 0 "ZFC_ST_CLB_CONT" 1 "ZFC_ST_CLB_END" 2 "ZFC_ST_CLB_ERR" /end COMPU_VTAB
/begin COMPU_METHOD ETClb_Eval_State "" TAB_VERB "%6.3" "-" COMPU_TAB_REF ETClb_Eval_State /end COMPU_METHOD
/begin COMPU_VTAB ETClb_Eval_State "" TAB_VERB 3 0 "ETCLB_ST_EVAL_INIT" 1 "ETCLB_ST_EVAL_ADD" 2 "ETCLB_ST_EVAL_SUB" /end COMPU_VTAB
/begin COMPU_METHOD ETClb_State "" TAB_VERB "%6.3" "-" COMPU_TAB_REF ETClb_State /end COMPU_METHOD
/begin COMPU_VTAB ETClb_State "" TAB_VERB 4 0 "ETCLB_ST_NOT_ACTV" 1 "ETCLB_ST_START_ENERGIZE" 2 "ETCLB_ST_MEASURE" 3 "ETCLB_ST_EVALUATE" /end COMPU_VTAB
/begin COMPU_METHOD ETCtlGovKi_fac "" RAT_FUNC "%8.7" "-" COEFFS 0 429496.7296 0 0 0 1 /end COMPU_METHOD
/begin COMPU_METHOD ETCtlGovKp_fac "" RAT_FUNC "%7.6" "-" COEFFS 0 25600 0 0 0 1 /end COMPU_METHOD
/begin COMPU_METHOD ETCtlGovRmp "" RAT_FUNC "%6.3" "s" COEFFS 0 0 1 0 0.0152587890625 0 /end COMPU_METHOD
/begin COMPU_METHOD ETCtlGov_p0q001 "" RAT_FUNC "%6.5" "-" COEFFS 0 1000 0 0 0 1 /end COMPU_METHOD
/begin COMPU_METHOD Fact "" RAT_FUNC "%6.5" "-" COEFFS 0 8192 0 0 0 1 /end COMPU_METHOD
/begin COMPU_METHOD Fact1 "" RAT_FUNC "%6.4" "-" COEFFS 0 128 0 0 0 1 /end COMPU_METHOD
/begin COMPU_METHOD Fact100 "" RAT_FUNC "%6.4" "-" COEFFS 0 100 0 0 0 1 /end COMPU_METHOD
/begin COMPU_METHOD FanSpd "" RAT_FUNC "%6.3" "rpm" COEFFS 0 10.9223333333333 0 0 0 1 /end COMPU_METHOD
/begin COMPU_METHOD InjMass "" RAT_FUNC "%6.4" "mg/hub" COEFFS 0 100 0 0 0 1 /end COMPU_METHOD
/begin COMPU_METHOD InjMassInj "" RAT_FUNC "%6.4" "mg/inj" COEFFS 0 100 0 0 0 1 /end COMPU_METHOD
/begin COMPU_METHOD InjQntInj "" RAT_FUNC "%6.4" "mm^3/inj" COEFFS 0 100 0 0 0 1 /end COMPU_METHOD
/begin COMPU_METHOD InjTime_us "" RAT_FUNC "%6.3" "us" COEFFS 0 2.5 0 0 0 1 /end COMPU_METHOD
/begin COMPU_METHOD Length "" RAT_FUNC "%6.2" "m" COEFFS 0 1 0 0 0 1 /end COMPU_METHOD
/begin COMPU_METHOD Mo_r_prc_q0p39 "" RAT_FUNC "%6.3" "%" COEFFS 0 256 0 0 0 100 /end COMPU_METHOD
/begin COMPU_METHOD Mo_trq_nm_q0p00000152587890625 "" RAT_FUNC "%8.7" "Nm" COEFFS 0 655360 0 0 0 1 /end COMPU_METHOD
/begin COMPU_METHOD Mo_trq_nm_q0p1 "" RAT_FUNC "%6.3" "Nm" COEFFS 0 10 0 0 0 1 /end COMPU_METHOD
/begin COMPU_METHOD OneToOne "" RAT_FUNC "%6.2" "-" COEFFS 0 1 0 0 0 1 /end COMPU_METHOD
/begin COMPU_METHOD OneToOne_ms "" RAT_FUNC "%6.2" "ms" COEFFS 0 1 0 0 0 1 /end COMPU_METHOD
/begin COMPU_METHOD OneToOne_us "" RAT_FUNC "%6.2" "us" COEFFS 0 1 0 0 0 1 /end COMPU_METHOD
/begin COMPU_METHOD Period "" RAT_FUNC "%6.3" "ms" COEFFS 0 10 0 0 0 1 /end COMPU_METHOD
/begin COMPU_METHOD Per_Dur "" RAT_FUNC "%6.2" "usec" COEFFS 0 1 0 0 0 1 /end COMPU_METHOD
/begin COMPU_METHOD Prc "" RAT_FUNC "%6.4" "%" COEFFS 0 81.92 0 0 0 1 /end COMPU_METHOD
/begin COMPU_METHOD Pres_hPa "" RAT_FUNC "%6.2" "hPa" COEFFS 0 1 0 0 0 1 /end COMPU_METHOD
/begin COMPU_METHOD Pres_Rail "" RAT_FUNC "%4.3" "bar" COEFFS 0 10.000000 0 0 0 1 /end COMPU_METHOD
/begin COMPU_METHOD RevCnt "" RAT_FUNC "%6.4" "-" COEFFS 0 16 0 0 0 1 /end COMPU_METHOD
/begin COMPU_METHOD RmpEngN "" RAT_FUNC "%6.4" "rpm/s" COEFFS 0 131.072 0 0 0 1 /end COMPU_METHOD
/begin COMPU_METHOD RmpPrc "" RAT_FUNC "%6.5" "%/s" COEFFS 0 5368.70912 0 0 0 1 /end COMPU_METHOD
/begin COMPU_METHOD RmpPres_hPa "" RAT_FUNC "%6.4" "hPa/s" COEFFS 0 65.536 0 0 0 1 /end COMPU_METHOD
/begin COMPU_METHOD RmpTemp "" RAT_FUNC "%6.4" "K/s" COEFFS 0 655.36 0 0 0 1 /end COMPU_METHOD
/begin COMPU_METHOD RmpTrq "" RAT_FUNC "%6.4" "Nm/s" COEFFS 0 655.36 0 0 0 1 /end COMPU_METHOD
/begin COMPU_METHOD TempDiff_Kelv "" RAT_FUNC "%6.3" "K" COEFFS 0 10 0 0 0 1 /end COMPU_METHOD
/begin COMPU_METHOD Temp_Cels "" RAT_FUNC "%6.1" "deg C" COEFFS 0 10 2731.4 0 0 1 /end COMPU_METHOD
/begin COMPU_METHOD TimeDeb "" RAT_FUNC "%6.1" "ms" COEFFS 0 0.1 0 0 0 1 /end COMPU_METHOD
/begin COMPU_METHOD TimeDelay_ms "" RAT_FUNC "%12.1" "ms" COEFFS 0 0 1 0 2.3283064365387e-007 0 /end COMPU_METHOD
/begin COMPU_METHOD TimeDelay_s "" RAT_FUNC "%12.4" "s" COEFFS 0 0 1 0 0.00023283064365387 0 /end COMPU_METHOD
/begin COMPU_METHOD TimeDT "" RAT_FUNC "%6.2" "us" COEFFS 0 1 0 0 0 1 /end COMPU_METHOD
/begin COMPU_METHOD TimeGPTATick "" RAT_FUNC "%6.4" "ns" COEFFS 0 20 0 0 0 1 /end COMPU_METHOD
/begin COMPU_METHOD TimeGT0Tic "" RAT_FUNC "%6.5" "ns" COEFFS 0 2500 0 0 0 1 /end COMPU_METHOD
/begin COMPU_METHOD Time_ms "" RAT_FUNC "%6.1" "ms" COEFFS 0 0.1 0 0 0 1 /end COMPU_METHOD
/begin COMPU_METHOD Time_s "" RAT_FUNC "%6.4" "s" COEFFS 0 100 0 0 0 1 /end COMPU_METHOD
/begin COMPU_METHOD Trq "" RAT_FUNC "%6.3" "Nm" COEFFS 0 10 0 0 0 1 /end COMPU_METHOD
/begin COMPU_METHOD Typ4WinDia "" TAB_VERB "%6.3" "-" COMPU_TAB_REF Typ4WinDia /end COMPU_METHOD
/begin COMPU_VTAB Typ4WinDia "" TAB_VERB 4 0 "4 Window diagnosis over PWM control line" 1 "4 Window diagnosis through Digital input" 2 "4 Window diagnosis over external interface" 3 "No 4 Window diagnosis." /end COMPU_VTAB
/begin COMPU_METHOD Vel "" RAT_FUNC "%6.4" "km/h" COEFFS 0 100 0 0 0 1 /end COMPU_METHOD
/begin COMPU_METHOD VelToN "" RAT_FUNC "%8.7" "(km/h)/rpm" COEFFS 0 100000 0 0 0 1 /end COMPU_METHOD
/begin COMPU_METHOD Volt "" RAT_FUNC "%6.3" "mV" COEFFS 0 5 0 0 0 1 /end COMPU_METHOD
/begin COMPU_METHOD Volt_Batt "" RAT_FUNC "%6.1" "mV" COEFFS 0 0.05 0 0 0 1 /end COMPU_METHOD
/begin COMPU_METHOD default "" RAT_FUNC "%6.2" "-" COEFFS 0 1 0 0 0 1 /end COMPU_METHOD
/begin RECORD_LAYOUT Axis_Xs16 NO_AXIS_PTS_X 1 SWORD AXIS_PTS_X 2 SWORD INDEX_INCR DIRECT /end RECORD_LAYOUT
/begin RECORD_LAYOUT CurG_Ws16 FNC_VALUES 1 SWORD COLUMN_DIR DIRECT /end RECORD_LAYOUT
/begin RECORD_LAYOUT Cur_Xs16Ws16 NO_AXIS_PTS_X 1 SWORD AXIS_PTS_X 2 SWORD INDEX_INCR DIRECT FNC_VALUES 3 SWORD COLUMN_DIR DIRECT /end RECORD_LAYOUT
/begin RECORD_LAYOUT Kf_Xs16_Ys16_Ws16 NO_AXIS_PTS_X 1 SWORD NO_AXIS_PTS_Y 2 SWORD AXIS_PTS_X 3 SWORD INDEX_INCR DIRECT AXIS_PTS_Y 4 SWORD INDEX_INCR DIRECT FNC_VALUES 5 SWORD COLUMN_DIR DIRECT /end RECORD_LAYOUT
/begin RECORD_LAYOUT Kl_Xs16_Ws16 NO_AXIS_PTS_X 1 SWORD AXIS_PTS_X 2 SWORD INDEX_INCR DIRECT FNC_VALUES 3 SWORD COLUMN_DIR DIRECT /end RECORD_LAYOUT
/begin RECORD_LAYOUT Kw_Ws16 FNC_VALUES 1 SWORD COLUMN_DIR DIRECT /end RECORD_LAYOUT
/begin RECORD_LAYOUT Kw_Ws32 FNC_VALUES 1 SLONG COLUMN_DIR DIRECT /end RECORD_LAYOUT
/begin RECORD_LAYOUT Kw_Wu16 FNC_VALUES 1 UWORD COLUMN_DIR DIRECT /end RECORD_LAYOUT
/begin RECORD_LAYOUT Kw_Wu8 FNC_VALUES 1 UBYTE COLUMN_DIR DIRECT /end RECORD_LAYOUT
/begin RECORD_LAYOUT Map_Xs16Ys16Ws16 NO_AXIS_PTS_X 1 SWORD NO_AXIS_PTS_Y 2 SWORD AXIS_PTS_X 3 SWORD INDEX_INCR DIRECT AXIS_PTS_Y 4 SWORD INDEX_INCR DIRECT FNC_VALUES 5 SWORD COLUMN_DIR DIRECT /end RECORD_LAYOUT
/begin RECORD_LAYOUT ValA_Ws16 FNC_VALUES 1 SWORD COLUMN_DIR DIRECT /end RECORD_LAYOUT
/begin RECORD_LAYOUT ValA_Ws32 FNC_VALUES 1 SLONG COLUMN_DIR DIRECT /end RECORD_LAYOUT
/begin RECORD_LAYOUT ValA_Wu16 FNC_VALUES 1 UWORD COLUMN_DIR DIRECT /end RECORD_LAYOUT
/begin RECORD_LAYOUT ValA_Wu32 FNC_VALUES 1 ULONG COLUMN_DIR DIRECT /end RECORD_LAYOUT
/begin RECORD_LAYOUT ValA_Wu8 FNC_VALUES 1 UBYTE COLUMN_DIR DIRECT /end RECORD_LAYOUT
/begin RECORD_LAYOUT Val_Ws16 FNC_VALUES 1 SWORD COLUMN_DIR DIRECT /end RECORD_LAYOUT
/begin RECORD_LAYOUT Val_Ws32 FNC_VALUES 1 SLONG COLUMN_DIR DIRECT /end RECORD_LAYOUT
/begin RECORD_LAYOUT Val_Ws8 FNC_VALUES 1 SBYTE COLUMN_DIR DIRECT /end RECORD_LAYOUT
/begin RECORD_LAYOUT Val_Wu16 FNC_VALUES 1 UWORD COLUMN_DIR DIRECT /end RECORD_LAYOUT
/begin RECORD_LAYOUT Val_Wu32 FNC_VALUES 1 ULONG COLUMN_DIR DIRECT /end RECORD_LAYOUT
/begin RECORD_LAYOUT Val_Wu8 FNC_VALUES 1 UBYTE COLUMN_DIR DIRECT /end RECORD_LAYOUT
/end MODULE
/end PROJECT
